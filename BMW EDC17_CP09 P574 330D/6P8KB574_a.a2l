ASAP2_VERSION 1 4
/begin PROJECT P_574 "EDC17_CP09"
/begin HEADER "" VERSION "V8KB" PROJECT_NO P_574 /end HEADER
/begin MODULE DIM ""
/begin MOD_COMMON "" BYTE_ORDER MSB_LAST ALIGNMENT_BYTE 1 ALIGNMENT_WORD 2 ALIGNMENT_LONG 4 ALIGNMENT_FLOAT32_IEEE 4 /end MOD_COMMON
/begin CHARACTERISTIC DFES_numClsPndDlt_CA "Fehlerklassenparameter: Initialisierungswert Löschzähler aus Zustand Pending DLC" VAL_BLK 0x80023893 ValA_Wu8 255.0 DFES_OneToOne 0.00 255.0 NUMBER 30 /end CHARACTERISTIC
/begin CHARACTERISTIC DFES_numClsSvcDlt_CA "Fehlerklassenparameter: Initialisierungswert Löschzähler DLC" VAL_BLK 0x800238B1 ValA_Wu8 255.0 DFES_OneToOne 0.00 255.0 NUMBER 30 /end CHARACTERISTIC
/begin CHARACTERISTIC DFES_numClsSVSFaultCycl_CA "Fehlerklassenparameter: Initialisierungswert SVS-Anzeige Fehlerzähler" VAL_BLK 0x800238CF ValA_Wu8 255.0 DFES_OneToOne 0.00 255.0 NUMBER 30 /end CHARACTERISTIC
/begin CHARACTERISTIC DFES_numClsSVSHealCycl_CA "Fehlerklassenparameter: Initialisierungswert SVS-Anzeige Heilungszähler" VAL_BLK 0x800238ED ValA_Wu8 255.0 DFES_OneToOne 0.00 255.0 NUMBER 30 /end CHARACTERISTIC
/begin CHARACTERISTIC DFES_Severity.DFC_ACCIPlausDrvAst_C "DFES/Projektspezifische Applikationdaten (pro DSM Element) DFC_ACCIPlausDrvAst" VALUE 0x8002B1C4 Val_Wu8 255.0 OneToOne 0.00 255.0 /end CHARACTERISTIC
/begin CHARACTERISTIC DFES_Severity.DFC_ACCIPlausTrqDes_C "DFES/Projektspezifische Applikationdaten (pro DSM Element) DFC_ACCIPlausTrqDes" VALUE 0x8002B1C5 Val_Wu8 255.0 OneToOne 0.00 255.0 /end CHARACTERISTIC
/begin CHARACTERISTIC DFES_Severity.DFC_AirCtlGovDvtEOMMax_C "DFES/Projektspezifische Applikationdaten (pro DSM Element) DFC_AirCtlGovDvtEOMMax" VALUE 0x8002B1C6 Val_Wu8 255.0 OneToOne 0.00 255.0 /end CHARACTERISTIC
/begin CHARACTERISTIC DFES_Severity.DFC_AirCtlGovDvtEOMMin_C "DFES/Projektspezifische Applikationdaten (pro DSM Element) DFC_AirCtlGovDvtEOMMin" VALUE 0x8002B1C7 Val_Wu8 255.0 OneToOne 0.00 255.0 /end CHARACTERISTIC
/begin CHARACTERISTIC DFES_Severity.DFC_AirCtlGovDvtMax_C "DFES/Projektspezifische Applikationdaten (pro DSM Element) DFC_AirCtlGovDvtMax" VALUE 0x8002B1C8 Val_Wu8 255.0 OneToOne 0.00 255.0 /end CHARACTERISTIC
/begin CHARACTERISTIC DFES_Severity.DFC_AirCtlGovDvtMin_C "DFES/Projektspezifische Applikationdaten (pro DSM Element) DFC_AirCtlGovDvtMin" VALUE 0x8002B1C9 Val_Wu8 255.0 OneToOne 0.00 255.0 /end CHARACTERISTIC
/begin CHARACTERISTIC DFES_Severity.DFC_AirCtlGovLPDvtMax_C "DFES/" VALUE 0x8002B1CA Val_Wu8 255.0 OneToOne 0.00 255.0 /end CHARACTERISTIC
/begin CHARACTERISTIC DFES_Severity.DFC_AirCtlGovLPDvtMin_C "DFES/" VALUE 0x8002B1CB Val_Wu8 255.0 OneToOne 0.00 255.0 /end CHARACTERISTIC
/begin CHARACTERISTIC DFES_Severity.DFC_AltIOComErr_C "DFES/Projektspezifische Applikationdaten (pro DSM Element) DFC_AltIOComErr" VALUE 0x8002B1CC Val_Wu8 255.0 OneToOne 0.00 255.0 /end CHARACTERISTIC
/begin CHARACTERISTIC DFES_Severity.DFC_AltIOComNpl_C "DFES/Projektspezifische Applikationdaten (pro DSM Element) DFC_AltIOComNpl" VALUE 0x8002B1CD Val_Wu8 255.0 OneToOne 0.00 255.0 /end CHARACTERISTIC
/begin CHARACTERISTIC DFES_Severity.DFC_BusDiagBusOffFlexRay_C "DFES/" VALUE 0x8002B1CE Val_Wu8 255.0 OneToOne 0.00 255.0 /end CHARACTERISTIC
/begin CHARACTERISTIC DFES_Severity.DFC_BusDiagBusOffNodeA_C "DFES/Projektspezifische Applikationdaten (pro DSM Element) DFC_BusDiagBusOffNodeA" VALUE 0x8002B1CF Val_Wu8 255.0 OneToOne 0.00 255.0 /end CHARACTERISTIC
/begin CHARACTERISTIC DFES_Severity.DFC_BusDiagBusOffNodeB_C "DFES/Projektspezifische Applikationdaten (pro DSM Element) DFC_BusDiagBusOffNodeB" VALUE 0x8002B1D0 Val_Wu8 255.0 OneToOne 0.00 255.0 /end CHARACTERISTIC
/begin CHARACTERISTIC DFES_Severity.DFC_BusDiagBusOffNodeC_C "DFES/Projektspezifische Applikationdaten (pro DSM Element) DFC_BusDiagBusOffNodeC" VALUE 0x8002B1D1 Val_Wu8 255.0 OneToOne 0.00 255.0 /end CHARACTERISTIC
/begin CHARACTERISTIC DFES_Severity.DFC_BusDiagHwFlexRay_C "DFES/" VALUE 0x8002B1D2 Val_Wu8 255.0 OneToOne 0.00 255.0 /end CHARACTERISTIC
/begin CHARACTERISTIC DFES_Severity.DFC_Cj945SpiCom1_C "DFES/Projektspezifische Applikationdaten (pro DSM Element) DFC_Cj945SpiCom1" VALUE 0x8002B1D3 Val_Wu8 255.0 OneToOne 0.00 255.0 /end CHARACTERISTIC
/begin CHARACTERISTIC DFES_Severity.DFC_ComACDemandSig_FA_C "DFES/Projektspezifische Applikationdaten (pro DSM Element) DFC_ComACDemandSig_FA" VALUE 0x8002B1D4 Val_Wu8 255.0 OneToOne 0.00 255.0 /end CHARACTERISTIC
/begin CHARACTERISTIC DFES_Severity.DFC_ComACDemandTo_FA_C "DFES/Projektspezifische Applikationdaten (pro DSM Element) DFC_ComACDemandTo_FA" VALUE 0x8002B1D5 Val_Wu8 255.0 OneToOne 0.00 255.0 /end CHARACTERISTIC
/begin CHARACTERISTIC DFES_Severity.DFC_ComATempSig_FA_C "DFES/Projektspezifische Applikationdaten (pro DSM Element) DFC_ComATempSig_FA" VALUE 0x8002B1D6 Val_Wu8 255.0 OneToOne 0.00 255.0 /end CHARACTERISTIC
/begin CHARACTERISTIC DFES_Severity.DFC_ComATempTo_FA_C "DFES/Projektspezifische Applikationdaten (pro DSM Element) DFC_ComATempTo_FA" VALUE 0x8002B1D7 Val_Wu8 255.0 OneToOne 0.00 255.0 /end CHARACTERISTIC
/begin CHARACTERISTIC DFES_Severity.DFC_ComATempTo_FX_C "DFES/Projektspezifische Applikationdaten (pro DSM Element) DFC_ComATempTo_FX" VALUE 0x8002B1D8 Val_Wu8 255.0 OneToOne 0.00 255.0 /end CHARACTERISTIC
/begin CHARACTERISTIC DFES_Severity.DFC_ComBrkTrqSumChk_FX_C "DFES/Projektspezifische Applikationdaten (pro DSM Element) DFC_ComBrkTrqSumChk_FX" VALUE 0x8002B1D9 Val_Wu8 255.0 OneToOne 0.00 255.0 /end CHARACTERISTIC
/begin CHARACTERISTIC DFES_Severity.DFC_ComBrkTrqSumCtr_FX_C "DFES/Projektspezifische Applikationdaten (pro DSM Element) DFC_ComBrkTrqSumCtr_FX" VALUE 0x8002B1DA Val_Wu8 255.0 OneToOne 0.00 255.0 /end CHARACTERISTIC
/begin CHARACTERISTIC DFES_Severity.DFC_ComBrkTrqSumTo_FX_C "DFES/Projektspezifische Applikationdaten (pro DSM Element) DFC_ComBrkTrqSumTo_FX" VALUE 0x8002B1DB Val_Wu8 255.0 OneToOne 0.00 255.0 /end CHARACTERISTIC
/begin CHARACTERISTIC DFES_Severity.DFC_ComBtnDrvDynChk_FX_C "DFES/Projektspezifische Applikationdaten (pro DSM Element) DFC_ComBtnDrvDynChk_FX" VALUE 0x8002B1DC Val_Wu8 255.0 OneToOne 0.00 255.0 /end CHARACTERISTIC
/begin CHARACTERISTIC DFES_Severity.DFC_ComBtnDrvDynCtr_FX_C "DFES/Projektspezifische Applikationdaten (pro DSM Element) DFC_ComBtnDrvDynCtr_FX" VALUE 0x8002B1DD Val_Wu8 255.0 OneToOne 0.00 255.0 /end CHARACTERISTIC
/begin CHARACTERISTIC DFES_Severity.DFC_ComBtnDrvDynTo_FX_C "DFES/Projektspezifische Applikationdaten (pro DSM Element) DFC_ComBtnDrvDynTo_FX" VALUE 0x8002B1DE Val_Wu8 255.0 OneToOne 0.00 255.0 /end CHARACTERISTIC
/begin CHARACTERISTIC DFES_Severity.DFC_ComButtonMSASig_C "DFES/Projektspezifische Applikationdaten (pro DSM Element) DFC_ComButtonMSASig" VALUE 0x8002B1DF Val_Wu8 255.0 OneToOne 0.00 255.0 /end CHARACTERISTIC
/begin CHARACTERISTIC DFES_Severity.DFC_ComButtonMSATo_C "DFES/Projektspezifische Applikationdaten (pro DSM Element) DFC_ComButtonMSATo" VALUE 0x8002B1E0 Val_Wu8 255.0 OneToOne 0.00 255.0 /end CHARACTERISTIC
/begin CHARACTERISTIC DFES_Severity.DFC_ComCodierungPwrmngSig_C "DFES/Projektspezifische Applikationdaten (pro DSM Element) DFC_ComCodierungPwrmngSig" VALUE 0x8002B1E1 Val_Wu8 255.0 OneToOne 0.00 255.0 /end CHARACTERISTIC
/begin CHARACTERISTIC DFES_Severity.DFC_ComCodierungPwrmngSig_FA_C "DFES/Projektspezifische Applikationdaten (pro DSM Element) DFC_ComCodierungPwrmngSig_FA" VALUE 0x8002B1E2 Val_Wu8 255.0 OneToOne 0.00 255.0 /end CHARACTERISTIC
/begin CHARACTERISTIC DFES_Severity.DFC_ComCrCtlLvrChk_C "DFES/Projektspezifische Applikationdaten (pro DSM Element) DFC_ComCrCtlLvrChk" VALUE 0x8002B1E3 Val_Wu8 255.0 OneToOne 0.00 255.0 /end CHARACTERISTIC
/begin CHARACTERISTIC DFES_Severity.DFC_ComCrCtlLvrCtr_C "DFES/Projektspezifische Applikationdaten (pro DSM Element) DFC_ComCrCtlLvrCtr" VALUE 0x8002B1E4 Val_Wu8 255.0 OneToOne 0.00 255.0 /end CHARACTERISTIC
/begin CHARACTERISTIC DFES_Severity.DFC_ComCrCtlLvrSig_C "DFES/Projektspezifische Applikationdaten (pro DSM Element) DFC_ComCrCtlLvrSig" VALUE 0x8002B1E5 Val_Wu8 255.0 OneToOne 0.00 255.0 /end CHARACTERISTIC
/begin CHARACTERISTIC DFES_Severity.DFC_ComCrCtlLvrTo_C "DFES/Projektspezifische Applikationdaten (pro DSM Element) DFC_ComCrCtlLvrTo" VALUE 0x8002B1E6 Val_Wu8 255.0 OneToOne 0.00 255.0 /end CHARACTERISTIC
/begin CHARACTERISTIC DFES_Severity.DFC_ComCtrCrshSwoEkpSig_FA_C "DFES/Projektspezifische Applikationdaten (pro DSM Element) DFC_ComCtrCrshSwoEkpSig_FA" VALUE 0x8002B1E7 Val_Wu8 255.0 OneToOne 0.00 255.0 /end CHARACTERISTIC
/begin CHARACTERISTIC DFES_Severity.DFC_ComCtrCrshSwoEkpTo_FA_C "DFES/Projektspezifische Applikationdaten (pro DSM Element) DFC_ComCtrCrshSwoEkpTo_FA" VALUE 0x8002B1E8 Val_Wu8 255.0 OneToOne 0.00 255.0 /end CHARACTERISTIC
/begin CHARACTERISTIC DFES_Severity.DFC_ComCtrSecInt_C "DFES/Projektspezifische Applikationdaten (pro DSM Element) DFC_ComCtrSecInt" VALUE 0x8002B1E9 Val_Wu8 255.0 OneToOne 0.00 255.0 /end CHARACTERISTIC
/begin CHARACTERISTIC DFES_Severity.DFC_ComDiaOBDGbxSig_A_C "DFES/Projektspezifische Applikationdaten (pro DSM Element) DFC_ComDiaOBDGbxSig_A" VALUE 0x8002B1EA Val_Wu8 255.0 OneToOne 0.00 255.0 /end CHARACTERISTIC
/begin CHARACTERISTIC DFES_Severity.DFC_ComDiaOBDGbxTo_A_C "DFES/Projektspezifische Applikationdaten (pro DSM Element) DFC_ComDiaOBDGbxTo_A" VALUE 0x8002B1EB Val_Wu8 255.0 OneToOne 0.00 255.0 /end CHARACTERISTIC
/begin CHARACTERISTIC DFES_Severity.DFC_ComFahrzeugtypSig_C "DFES/Projektspezifische Applikationdaten (pro DSM Element) DFC_ComFahrzeugtypSig" VALUE 0x8002B1EC Val_Wu8 255.0 OneToOne 0.00 255.0 /end CHARACTERISTIC
/begin CHARACTERISTIC DFES_Severity.DFC_ComFahrzeugtypSig_FA_C "DFES/Projektspezifische Applikationdaten (pro DSM Element) DFC_ComFahrzeugtypSig_FA" VALUE 0x8002B1ED Val_Wu8 255.0 OneToOne 0.00 255.0 /end CHARACTERISTIC
/begin CHARACTERISTIC DFES_Severity.DFC_ComFllupGpwsupSig_FA_C "DFES/Projektspezifische Applikationdaten (pro DSM Element) DFC_ComFllupGpwsupSig_FA" VALUE 0x8002B1EE Val_Wu8 255.0 OneToOne 0.00 255.0 /end CHARACTERISTIC
/begin CHARACTERISTIC DFES_Severity.DFC_ComFllupGpwsupTo_FA_C "DFES/Projektspezifische Applikationdaten (pro DSM Element) DFC_ComFllupGpwsupTo_FA" VALUE 0x8002B1EF Val_Wu8 255.0 OneToOne 0.00 255.0 /end CHARACTERISTIC
/begin CHARACTERISTIC DFES_Severity.DFC_ComGbxDataChk_A_C "DFES/Projektspezifische Applikationdaten (pro DSM Element) DFC_ComGbxDataChk_A" VALUE 0x8002B1F0 Val_Wu8 255.0 OneToOne 0.00 255.0 /end CHARACTERISTIC
/begin CHARACTERISTIC DFES_Severity.DFC_ComGbxDataChk_FA_C "DFES/Projektspezifische Applikationdaten (pro DSM Element) DFC_ComGbxDataChk_FA" VALUE 0x8002B1F1 Val_Wu8 255.0 OneToOne 0.00 255.0 /end CHARACTERISTIC
/begin CHARACTERISTIC DFES_Severity.DFC_ComGbxDataCtr_A_C "DFES/Projektspezifische Applikationdaten (pro DSM Element) DFC_ComGbxDataCtr_A" VALUE 0x8002B1F2 Val_Wu8 255.0 OneToOne 0.00 255.0 /end CHARACTERISTIC
/begin CHARACTERISTIC DFES_Severity.DFC_ComGbxDataCtr_FA_C "DFES/Projektspezifische Applikationdaten (pro DSM Element) DFC_ComGbxDataCtr_FA" VALUE 0x8002B1F3 Val_Wu8 255.0 OneToOne 0.00 255.0 /end CHARACTERISTIC
/begin CHARACTERISTIC DFES_Severity.DFC_ComGbxDataSig_A_C "DFES/Projektspezifische Applikationdaten (pro DSM Element) DFC_ComGbxDataSig_A" VALUE 0x8002B1F4 Val_Wu8 255.0 OneToOne 0.00 255.0 /end CHARACTERISTIC
/begin CHARACTERISTIC DFES_Severity.DFC_ComGbxDataSig_FA_C "DFES/Projektspezifische Applikationdaten (pro DSM Element) DFC_ComGbxDataSig_FA" VALUE 0x8002B1F5 Val_Wu8 255.0 OneToOne 0.00 255.0 /end CHARACTERISTIC
/begin CHARACTERISTIC DFES_Severity.DFC_ComGbxDataTo_A_C "DFES/Projektspezifische Applikationdaten (pro DSM Element) DFC_ComGbxDataTo_A" VALUE 0x8002B1F6 Val_Wu8 255.0 OneToOne 0.00 255.0 /end CHARACTERISTIC
/begin CHARACTERISTIC DFES_Severity.DFC_ComGbxDataTo_FA_C "DFES/Projektspezifische Applikationdaten (pro DSM Element) DFC_ComGbxDataTo_FA" VALUE 0x8002B1F7 Val_Wu8 255.0 OneToOne 0.00 255.0 /end CHARACTERISTIC
/begin CHARACTERISTIC DFES_Severity.DFC_ComKlemmenChk_FA_C "DFES/Projektspezifische Applikationdaten (pro DSM Element) DFC_ComKlemmenChk_FA" VALUE 0x8002B1F8 Val_Wu8 255.0 OneToOne 0.00 255.0 /end CHARACTERISTIC
/begin CHARACTERISTIC DFES_Severity.DFC_ComKlemmenCtr_FA_C "DFES/Projektspezifische Applikationdaten (pro DSM Element) DFC_ComKlemmenCtr_FA" VALUE 0x8002B1F9 Val_Wu8 255.0 OneToOne 0.00 255.0 /end CHARACTERISTIC
/begin CHARACTERISTIC DFES_Severity.DFC_ComKlemmenSig_FA_C "DFES/Projektspezifische Applikationdaten (pro DSM Element) DFC_ComKlemmenSig_FA" VALUE 0x8002B1FA Val_Wu8 255.0 OneToOne 0.00 255.0 /end CHARACTERISTIC
/begin CHARACTERISTIC DFES_Severity.DFC_ComKlemmenTo_FA_C "DFES/Projektspezifische Applikationdaten (pro DSM Element) DFC_ComKlemmenTo_FA" VALUE 0x8002B1FB Val_Wu8 255.0 OneToOne 0.00 255.0 /end CHARACTERISTIC
/begin CHARACTERISTIC DFES_Severity.DFC_ComLenkradwinkelSig_C "DFES/Projektspezifische Applikationdaten (pro DSM Element) DFC_ComLenkradwinkelSig" VALUE 0x8002B1FC Val_Wu8 255.0 OneToOne 0.00 255.0 /end CHARACTERISTIC
/begin CHARACTERISTIC DFES_Severity.DFC_ComLenkradwinkelTo_C "DFES/Projektspezifische Applikationdaten (pro DSM Element) DFC_ComLenkradwinkelTo" VALUE 0x8002B1FD Val_Wu8 255.0 OneToOne 0.00 255.0 /end CHARACTERISTIC
/begin CHARACTERISTIC DFES_Severity.DFC_ComMileageRangeSig_FA_C "DFES/Projektspezifische Applikationdaten (pro DSM Element) DFC_ComMileageRangeSig_FA" VALUE 0x8002B1FE Val_Wu8 255.0 OneToOne 0.00 255.0 /end CHARACTERISTIC
/begin CHARACTERISTIC DFES_Severity.DFC_ComMileageRangeTo_FA_C "DFES/Projektspezifische Applikationdaten (pro DSM Element) DFC_ComMileageRangeTo_FA" VALUE 0x8002B1FF Val_Wu8 255.0 OneToOne 0.00 255.0 /end CHARACTERISTIC
/begin CHARACTERISTIC DFES_Severity.DFC_ComPspSig_C "DFES/Projektspezifische Applikationdaten (pro DSM Element) DFC_ComPspSig" VALUE 0x8002B200 Val_Wu8 255.0 OneToOne 0.00 255.0 /end CHARACTERISTIC
/begin CHARACTERISTIC DFES_Severity.DFC_ComPspTo_C "DFES/Projektspezifische Applikationdaten (pro DSM Element) DFC_ComPspTo" VALUE 0x8002B201 Val_Wu8 255.0 OneToOne 0.00 255.0 /end CHARACTERISTIC
/begin CHARACTERISTIC DFES_Severity.DFC_ComRelTimeSig_FA_C "DFES/Projektspezifische Applikationdaten (pro DSM Element) DFC_ComRelTimeSig_FA" VALUE 0x8002B202 Val_Wu8 255.0 OneToOne 0.00 255.0 /end CHARACTERISTIC
/begin CHARACTERISTIC DFES_Severity.DFC_ComRelTimeTo_FA_C "DFES/Projektspezifische Applikationdaten (pro DSM Element) DFC_ComRelTimeTo_FA" VALUE 0x8002B203 Val_Wu8 255.0 OneToOne 0.00 255.0 /end CHARACTERISTIC
/begin CHARACTERISTIC DFES_Severity.DFC_ComRequestEMFChk_C "DFES/Projektspezifische Applikationdaten (pro DSM Element) DFC_ComRequestEMFChk" VALUE 0x8002B204 Val_Wu8 255.0 OneToOne 0.00 255.0 /end CHARACTERISTIC
/begin CHARACTERISTIC DFES_Severity.DFC_ComRequestEMFCtr_C "DFES/Projektspezifische Applikationdaten (pro DSM Element) DFC_ComRequestEMFCtr" VALUE 0x8002B205 Val_Wu8 255.0 OneToOne 0.00 255.0 /end CHARACTERISTIC
/begin CHARACTERISTIC DFES_Severity.DFC_ComRequestEMFSig_C "DFES/Projektspezifische Applikationdaten (pro DSM Element) DFC_ComRequestEMFSig" VALUE 0x8002B206 Val_Wu8 255.0 OneToOne 0.00 255.0 /end CHARACTERISTIC
/begin CHARACTERISTIC DFES_Severity.DFC_ComRequestEMFTo_C "DFES/Projektspezifische Applikationdaten (pro DSM Element) DFC_ComRequestEMFTo" VALUE 0x8002B207 Val_Wu8 255.0 OneToOne 0.00 255.0 /end CHARACTERISTIC
/begin CHARACTERISTIC DFES_Severity.DFC_ComRpmWhlChk_FX_C "DFES/Projektspezifische Applikationdaten (pro DSM Element) DFC_ComRpmWhlChk_FX" VALUE 0x8002B208 Val_Wu8 255.0 OneToOne 0.00 255.0 /end CHARACTERISTIC
/begin CHARACTERISTIC DFES_Severity.DFC_ComRpmWhlCtr_FX_C "DFES/Projektspezifische Applikationdaten (pro DSM Element) DFC_ComRpmWhlCtr_FX" VALUE 0x8002B209 Val_Wu8 255.0 OneToOne 0.00 255.0 /end CHARACTERISTIC
/begin CHARACTERISTIC DFES_Severity.DFC_ComRpmWhlTo_FX_C "DFES/Projektspezifische Applikationdaten (pro DSM Element) DFC_ComRpmWhlTo_FX" VALUE 0x8002B20A Val_Wu8 255.0 OneToOne 0.00 255.0 /end CHARACTERISTIC
/begin CHARACTERISTIC DFES_Severity.DFC_ComSecCtrRelSig_FA_C "DFES/Projektspezifische Applikationdaten (pro DSM Element) DFC_ComSecCtrRelSig_FA" VALUE 0x8002B20B Val_Wu8 255.0 OneToOne 0.00 255.0 /end CHARACTERISTIC
/begin CHARACTERISTIC DFES_Severity.DFC_ComSecCtrRelTo_FA_C "DFES/Projektspezifische Applikationdaten (pro DSM Element) DFC_ComSecCtrRelTo_FA" VALUE 0x8002B20C Val_Wu8 255.0 OneToOne 0.00 255.0 /end CHARACTERISTIC
/begin CHARACTERISTIC DFES_Severity.DFC_ComSensNOxGndSig_C "DFES/" VALUE 0x8002B20D Val_Wu8 255.0 OneToOne 0.00 255.0 /end CHARACTERISTIC
/begin CHARACTERISTIC DFES_Severity.DFC_ComSensNOxGndTo_C "DFES/" VALUE 0x8002B20E Val_Wu8 255.0 OneToOne 0.00 255.0 /end CHARACTERISTIC
/begin CHARACTERISTIC DFES_Severity.DFC_ComSensNOxMode_C "DFES/" VALUE 0x8002B20F Val_Wu8 255.0 OneToOne 0.00 255.0 /end CHARACTERISTIC
/begin CHARACTERISTIC DFES_Severity.DFC_ComSensNOxUbattSig_C "DFES/" VALUE 0x8002B210 Val_Wu8 255.0 OneToOne 0.00 255.0 /end CHARACTERISTIC
/begin CHARACTERISTIC DFES_Severity.DFC_ComSensNOxUbattTo_C "DFES/" VALUE 0x8002B211 Val_Wu8 255.0 OneToOne 0.00 255.0 /end CHARACTERISTIC
/begin CHARACTERISTIC DFES_Severity.DFC_ComShiftPaddleTo_FX_C "DFES/Projektspezifische Applikationdaten (pro DSM Element) DFC_ComShiftPaddleTo_FX" VALUE 0x8002B212 Val_Wu8 255.0 OneToOne 0.00 255.0 /end CHARACTERISTIC
/begin CHARACTERISTIC DFES_Severity.DFC_ComShutOffPSPSig_C "DFES/Projektspezifische Applikationdaten (pro DSM Element) DFC_ComShutOffPSPSig" VALUE 0x8002B213 Val_Wu8 255.0 OneToOne 0.00 255.0 /end CHARACTERISTIC
/begin CHARACTERISTIC DFES_Severity.DFC_ComShutOffPSPTo_C "DFES/Projektspezifische Applikationdaten (pro DSM Element) DFC_ComShutOffPSPTo" VALUE 0x8002B214 Val_Wu8 255.0 OneToOne 0.00 255.0 /end CHARACTERISTIC
/begin CHARACTERISTIC DFES_Severity.DFC_ComSlrdiGlbFZMTo_FA_C "DFES/Projektspezifische Applikationdaten (pro DSM Element) DFC_ComSlrdiGlbFZMTo_FA" VALUE 0x8002B215 Val_Wu8 255.0 OneToOne 0.00 255.0 /end CHARACTERISTIC
/begin CHARACTERISTIC DFES_Severity.DFC_ComSlrdiGlbFZMTo_FX_C "DFES/Projektspezifische Applikationdaten (pro DSM Element) DFC_ComSlrdiGlbFZMTo_FX" VALUE 0x8002B216 Val_Wu8 255.0 OneToOne 0.00 255.0 /end CHARACTERISTIC
/begin CHARACTERISTIC DFES_Severity.DFC_ComSpeedVehicleChk_FX_C "DFES/Projektspezifische Applikationdaten (pro DSM Element) DFC_ComSpeedVehicleChk_FX" VALUE 0x8002B217 Val_Wu8 255.0 OneToOne 0.00 255.0 /end CHARACTERISTIC
/begin CHARACTERISTIC DFES_Severity.DFC_ComSpeedVehicleCtr_FX_C "DFES/Projektspezifische Applikationdaten (pro DSM Element) DFC_ComSpeedVehicleCtr_FX" VALUE 0x8002B218 Val_Wu8 255.0 OneToOne 0.00 255.0 /end CHARACTERISTIC
/begin CHARACTERISTIC DFES_Severity.DFC_ComSpeedVehicleTo_FX_C "DFES/Projektspezifische Applikationdaten (pro DSM Element) DFC_ComSpeedVehicleTo_FX" VALUE 0x8002B219 Val_Wu8 255.0 OneToOne 0.00 255.0 /end CHARACTERISTIC
/begin CHARACTERISTIC DFES_Severity.DFC_ComStConintDSCChk_FX_C "DFES/Projektspezifische Applikationdaten (pro DSM Element) DFC_ComStConintDSCChk_FX" VALUE 0x8002B21A Val_Wu8 255.0 OneToOne 0.00 255.0 /end CHARACTERISTIC
/begin CHARACTERISTIC DFES_Severity.DFC_ComStConintDSCCtr_FX_C "DFES/Projektspezifische Applikationdaten (pro DSM Element) DFC_ComStConintDSCCtr_FX" VALUE 0x8002B21B Val_Wu8 255.0 OneToOne 0.00 255.0 /end CHARACTERISTIC
/begin CHARACTERISTIC DFES_Severity.DFC_ComStConintDSCTo_FX_C "DFES/Projektspezifische Applikationdaten (pro DSM Element) DFC_ComStConintDSCTo_FX" VALUE 0x8002B21C Val_Wu8 255.0 OneToOne 0.00 255.0 /end CHARACTERISTIC
/begin CHARACTERISTIC DFES_Severity.DFC_ComStatACFrontSig_FA_C "DFES/Projektspezifische Applikationdaten (pro DSM Element) DFC_ComStatACFrontSig_FA" VALUE 0x8002B21D Val_Wu8 255.0 OneToOne 0.00 255.0 /end CHARACTERISTIC
/begin CHARACTERISTIC DFES_Severity.DFC_ComStatACFrontTo_FA_C "DFES/Projektspezifische Applikationdaten (pro DSM Element) DFC_ComStatACFrontTo_FA" VALUE 0x8002B21E Val_Wu8 255.0 OneToOne 0.00 255.0 /end CHARACTERISTIC
/begin CHARACTERISTIC DFES_Severity.DFC_ComStatEkpSig_A_C "DFES/Projektspezifische Applikationdaten (pro DSM Element) DFC_ComStatEkpSig_A" VALUE 0x8002B21F Val_Wu8 255.0 OneToOne 0.00 255.0 /end CHARACTERISTIC
/begin CHARACTERISTIC DFES_Severity.DFC_ComStatEkpTo_A_C "DFES/Projektspezifische Applikationdaten (pro DSM Element) DFC_ComStatEkpTo_A" VALUE 0x8002B220 Val_Wu8 255.0 OneToOne 0.00 255.0 /end CHARACTERISTIC
/begin CHARACTERISTIC DFES_Severity.DFC_ComStatGearRevSig_FA_C "DFES/Projektspezifische Applikationdaten (pro DSM Element) DFC_ComStatGearRevSig_FA" VALUE 0x8002B221 Val_Wu8 255.0 OneToOne 0.00 255.0 /end CHARACTERISTIC
/begin CHARACTERISTIC DFES_Severity.DFC_ComStatGearRevTo_FA_C "DFES/Projektspezifische Applikationdaten (pro DSM Element) DFC_ComStatGearRevTo_FA" VALUE 0x8002B222 Val_Wu8 255.0 OneToOne 0.00 255.0 /end CHARACTERISTIC
/begin CHARACTERISTIC DFES_Severity.DFC_ComStatZVKlappenSig_FA_C "DFES/Projektspezifische Applikationdaten (pro DSM Element) DFC_ComStatZVKlappenSig_FA" VALUE 0x8002B223 Val_Wu8 255.0 OneToOne 0.00 255.0 /end CHARACTERISTIC
/begin CHARACTERISTIC DFES_Severity.DFC_ComStatZVKlappenTo_FA_C "DFES/Projektspezifische Applikationdaten (pro DSM Element) DFC_ComStatZVKlappenTo_FA" VALUE 0x8002B224 Val_Wu8 255.0 OneToOne 0.00 255.0 /end CHARACTERISTIC
/begin CHARACTERISTIC DFES_Severity.DFC_ComStateARSCtr_C "DFES/Projektspezifische Applikationdaten (pro DSM Element) DFC_ComStateARSCtr" VALUE 0x8002B225 Val_Wu8 255.0 OneToOne 0.00 255.0 /end CHARACTERISTIC
/begin CHARACTERISTIC DFES_Severity.DFC_ComStateARSSig_C "DFES/Projektspezifische Applikationdaten (pro DSM Element) DFC_ComStateARSSig" VALUE 0x8002B226 Val_Wu8 255.0 OneToOne 0.00 255.0 /end CHARACTERISTIC
/begin CHARACTERISTIC DFES_Severity.DFC_ComStateARSTo_C "DFES/Projektspezifische Applikationdaten (pro DSM Element) DFC_ComStateARSTo" VALUE 0x8002B227 Val_Wu8 255.0 OneToOne 0.00 255.0 /end CHARACTERISTIC
/begin CHARACTERISTIC DFES_Severity.DFC_ComStateDscSig_C "DFES/Projektspezifische Applikationdaten (pro DSM Element) DFC_ComStateDscSig" VALUE 0x8002B228 Val_Wu8 255.0 OneToOne 0.00 255.0 /end CHARACTERISTIC
/begin CHARACTERISTIC DFES_Severity.DFC_ComStateDscTo_C "DFES/Projektspezifische Applikationdaten (pro DSM Element) DFC_ComStateDscTo" VALUE 0x8002B229 Val_Wu8 255.0 OneToOne 0.00 255.0 /end CHARACTERISTIC
/begin CHARACTERISTIC DFES_Severity.DFC_ComStateSeatSig_C "DFES/Projektspezifische Applikationdaten (pro DSM Element) DFC_ComStateSeatSig" VALUE 0x8002B22A Val_Wu8 255.0 OneToOne 0.00 255.0 /end CHARACTERISTIC
/begin CHARACTERISTIC DFES_Severity.DFC_ComStateSeatSig_FA_C "DFES/Projektspezifische Applikationdaten (pro DSM Element) DFC_ComStateSeatSig_FA" VALUE 0x8002B22B Val_Wu8 255.0 OneToOne 0.00 255.0 /end CHARACTERISTIC
/begin CHARACTERISTIC DFES_Severity.DFC_ComStateSeatTo_C "DFES/Projektspezifische Applikationdaten (pro DSM Element) DFC_ComStateSeatTo" VALUE 0x8002B22C Val_Wu8 255.0 OneToOne 0.00 255.0 /end CHARACTERISTIC
/begin CHARACTERISTIC DFES_Severity.DFC_ComStateSeatTo_FA_C "DFES/Projektspezifische Applikationdaten (pro DSM Element) DFC_ComStateSeatTo_FA" VALUE 0x8002B22D Val_Wu8 255.0 OneToOne 0.00 255.0 /end CHARACTERISTIC
/begin CHARACTERISTIC DFES_Severity.DFC_ComStatusEGSSig_A_C "DFES/Projektspezifische Applikationdaten (pro DSM Element) DFC_ComStatusEGSSig_A" VALUE 0x8002B22E Val_Wu8 255.0 OneToOne 0.00 255.0 /end CHARACTERISTIC
/begin CHARACTERISTIC DFES_Severity.DFC_ComStatusEGSSig_FA_C "DFES/Projektspezifische Applikationdaten (pro DSM Element) DFC_ComStatusEGSSig_FA" VALUE 0x8002B22F Val_Wu8 255.0 OneToOne 0.00 255.0 /end CHARACTERISTIC
/begin CHARACTERISTIC DFES_Severity.DFC_ComStatusEGSTo_A_C "DFES/Projektspezifische Applikationdaten (pro DSM Element) DFC_ComStatusEGSTo_A" VALUE 0x8002B230 Val_Wu8 255.0 OneToOne 0.00 255.0 /end CHARACTERISTIC
/begin CHARACTERISTIC DFES_Severity.DFC_ComStatusEGSTo_FA_C "DFES/Projektspezifische Applikationdaten (pro DSM Element) DFC_ComStatusEGSTo_FA" VALUE 0x8002B231 Val_Wu8 255.0 OneToOne 0.00 255.0 /end CHARACTERISTIC
/begin CHARACTERISTIC DFES_Severity.DFC_ComStatusEMFChk_C "DFES/Projektspezifische Applikationdaten (pro DSM Element) DFC_ComStatusEMFChk" VALUE 0x8002B232 Val_Wu8 255.0 OneToOne 0.00 255.0 /end CHARACTERISTIC
/begin CHARACTERISTIC DFES_Severity.DFC_ComStatusEMFCtr_C "DFES/Projektspezifische Applikationdaten (pro DSM Element) DFC_ComStatusEMFCtr" VALUE 0x8002B233 Val_Wu8 255.0 OneToOne 0.00 255.0 /end CHARACTERISTIC
/begin CHARACTERISTIC DFES_Severity.DFC_ComStatusEMFSig_C "DFES/Projektspezifische Applikationdaten (pro DSM Element) DFC_ComStatusEMFSig" VALUE 0x8002B234 Val_Wu8 255.0 OneToOne 0.00 255.0 /end CHARACTERISTIC
/begin CHARACTERISTIC DFES_Severity.DFC_ComStatusEMFTo_C "DFES/Projektspezifische Applikationdaten (pro DSM Element) DFC_ComStatusEMFTo" VALUE 0x8002B235 Val_Wu8 255.0 OneToOne 0.00 255.0 /end CHARACTERISTIC
/begin CHARACTERISTIC DFES_Severity.DFC_ComStatusRGangSig_C "DFES/Projektspezifische Applikationdaten (pro DSM Element) DFC_ComStatusRGangSig" VALUE 0x8002B236 Val_Wu8 255.0 OneToOne 0.00 255.0 /end CHARACTERISTIC
/begin CHARACTERISTIC DFES_Severity.DFC_ComStatusRGangTo_C "DFES/Projektspezifische Applikationdaten (pro DSM Element) DFC_ComStatusRGangTo" VALUE 0x8002B237 Val_Wu8 255.0 OneToOne 0.00 255.0 /end CHARACTERISTIC
/begin CHARACTERISTIC DFES_Severity.DFC_ComSteeringAngleChk_FX_C "DFES/Projektspezifische Applikationdaten (pro DSM Element) DFC_ComSteeringAngleChk_FX" VALUE 0x8002B238 Val_Wu8 255.0 OneToOne 0.00 255.0 /end CHARACTERISTIC
/begin CHARACTERISTIC DFES_Severity.DFC_ComSteeringAngleCtr_FX_C "DFES/Projektspezifische Applikationdaten (pro DSM Element) DFC_ComSteeringAngleCtr_FX" VALUE 0x8002B239 Val_Wu8 255.0 OneToOne 0.00 255.0 /end CHARACTERISTIC
/begin CHARACTERISTIC DFES_Severity.DFC_ComSteeringAngleTo_FX_C "DFES/Projektspezifische Applikationdaten (pro DSM Element) DFC_ComSteeringAngleTo_FX" VALUE 0x8002B23A Val_Wu8 255.0 OneToOne 0.00 255.0 /end CHARACTERISTIC
/begin CHARACTERISTIC DFES_Severity.DFC_ComTerminalChk_C "DFES/Projektspezifische Applikationdaten (pro DSM Element) DFC_ComTerminalChk" VALUE 0x8002B23B Val_Wu8 255.0 OneToOne 0.00 255.0 /end CHARACTERISTIC
/begin CHARACTERISTIC DFES_Severity.DFC_ComTerminalCtr_C "DFES/Projektspezifische Applikationdaten (pro DSM Element) DFC_ComTerminalCtr" VALUE 0x8002B23C Val_Wu8 255.0 OneToOne 0.00 255.0 /end CHARACTERISTIC
/begin CHARACTERISTIC DFES_Severity.DFC_ComTerminalSig_C "DFES/Projektspezifische Applikationdaten (pro DSM Element) DFC_ComTerminalSig" VALUE 0x8002B23D Val_Wu8 255.0 OneToOne 0.00 255.0 /end CHARACTERISTIC
/begin CHARACTERISTIC DFES_Severity.DFC_ComTerminalTo_C "DFES/Projektspezifische Applikationdaten (pro DSM Element) DFC_ComTerminalTo" VALUE 0x8002B23E Val_Wu8 255.0 OneToOne 0.00 255.0 /end CHARACTERISTIC
/begin CHARACTERISTIC DFES_Severity.DFC_ComTimeDateSig_FA_C "DFES/Projektspezifische Applikationdaten (pro DSM Element) DFC_ComTimeDateSig_FA" VALUE 0x8002B23F Val_Wu8 255.0 OneToOne 0.00 255.0 /end CHARACTERISTIC
/begin CHARACTERISTIC DFES_Severity.DFC_ComTimeDateTo_FA_C "DFES/Projektspezifische Applikationdaten (pro DSM Element) DFC_ComTimeDateTo_FA" VALUE 0x8002B240 Val_Wu8 255.0 OneToOne 0.00 255.0 /end CHARACTERISTIC
/begin CHARACTERISTIC DFES_Severity.DFC_ComTrailerSig_C "DFES/Projektspezifische Applikationdaten (pro DSM Element) DFC_ComTrailerSig" VALUE 0x8002B241 Val_Wu8 255.0 OneToOne 0.00 255.0 /end CHARACTERISTIC
/begin CHARACTERISTIC DFES_Severity.DFC_ComTrailerSig_FA_C "DFES/Projektspezifische Applikationdaten (pro DSM Element) DFC_ComTrailerSig_FA" VALUE 0x8002B242 Val_Wu8 255.0 OneToOne 0.00 255.0 /end CHARACTERISTIC
/begin CHARACTERISTIC DFES_Severity.DFC_ComTrailerTo_C "DFES/Projektspezifische Applikationdaten (pro DSM Element) DFC_ComTrailerTo" VALUE 0x8002B243 Val_Wu8 255.0 OneToOne 0.00 255.0 /end CHARACTERISTIC
/begin CHARACTERISTIC DFES_Severity.DFC_ComTrailerTo_FA_C "DFES/Projektspezifische Applikationdaten (pro DSM Element) DFC_ComTrailerTo_FA" VALUE 0x8002B244 Val_Wu8 255.0 OneToOne 0.00 255.0 /end CHARACTERISTIC
/begin CHARACTERISTIC DFES_Severity.DFC_ComTrqDemCrshDrDyChk_FX_C "DFES/Projektspezifische Applikationdaten (pro DSM Element) DFC_ComTrqDemCrshDrDyChk_FX" VALUE 0x8002B245 Val_Wu8 255.0 OneToOne 0.00 255.0 /end CHARACTERISTIC
/begin CHARACTERISTIC DFES_Severity.DFC_ComTrqDemCrshDrDyCtr_FX_C "DFES/Projektspezifische Applikationdaten (pro DSM Element) DFC_ComTrqDemCrshDrDyCtr_FX" VALUE 0x8002B246 Val_Wu8 255.0 OneToOne 0.00 255.0 /end CHARACTERISTIC
/begin CHARACTERISTIC DFES_Severity.DFC_ComTrqDemCrshDrDyTo_FX_C "DFES/Projektspezifische Applikationdaten (pro DSM Element) DFC_ComTrqDemCrshDrDyTo_FX" VALUE 0x8002B247 Val_Wu8 255.0 OneToOne 0.00 255.0 /end CHARACTERISTIC
/begin CHARACTERISTIC DFES_Severity.DFC_ComTrqDemandDesSig_C "DFES/Projektspezifische Applikationdaten (pro DSM Element) DFC_ComTrqDemandDesSig" VALUE 0x8002B248 Val_Wu8 255.0 OneToOne 0.00 255.0 /end CHARACTERISTIC
/begin CHARACTERISTIC DFES_Severity.DFC_ComTrqDemandDesTo_C "DFES/Projektspezifische Applikationdaten (pro DSM Element) DFC_ComTrqDemandDesTo" VALUE 0x8002B249 Val_Wu8 255.0 OneToOne 0.00 255.0 /end CHARACTERISTIC
/begin CHARACTERISTIC DFES_Severity.DFC_ComTrqDemandDscChk_C "DFES/Projektspezifische Applikationdaten (pro DSM Element) DFC_ComTrqDemandDscChk" VALUE 0x8002B24A Val_Wu8 255.0 OneToOne 0.00 255.0 /end CHARACTERISTIC
/begin CHARACTERISTIC DFES_Severity.DFC_ComTrqDemandDscCtr_C "DFES/Projektspezifische Applikationdaten (pro DSM Element) DFC_ComTrqDemandDscCtr" VALUE 0x8002B24B Val_Wu8 255.0 OneToOne 0.00 255.0 /end CHARACTERISTIC
/begin CHARACTERISTIC DFES_Severity.DFC_ComTrqDemandDscSig_C "DFES/Projektspezifische Applikationdaten (pro DSM Element) DFC_ComTrqDemandDscSig" VALUE 0x8002B24C Val_Wu8 255.0 OneToOne 0.00 255.0 /end CHARACTERISTIC
/begin CHARACTERISTIC DFES_Severity.DFC_ComTrqDemandDscTo_C "DFES/Projektspezifische Applikationdaten (pro DSM Element) DFC_ComTrqDemandDscTo" VALUE 0x8002B24D Val_Wu8 255.0 OneToOne 0.00 255.0 /end CHARACTERISTIC
/begin CHARACTERISTIC DFES_Severity.DFC_ComTrqDemandGbxChk_A_C "DFES/Projektspezifische Applikationdaten (pro DSM Element) DFC_ComTrqDemandGbxChk_A" VALUE 0x8002B24E Val_Wu8 255.0 OneToOne 0.00 255.0 /end CHARACTERISTIC
/begin CHARACTERISTIC DFES_Severity.DFC_ComTrqDemandGbxChk_FA_C "DFES/Projektspezifische Applikationdaten (pro DSM Element) DFC_ComTrqDemandGbxChk_FA" VALUE 0x8002B24F Val_Wu8 255.0 OneToOne 0.00 255.0 /end CHARACTERISTIC
/begin CHARACTERISTIC DFES_Severity.DFC_ComTrqDemandGbxCtr_A_C "DFES/Projektspezifische Applikationdaten (pro DSM Element) DFC_ComTrqDemandGbxCtr_A" VALUE 0x8002B250 Val_Wu8 255.0 OneToOne 0.00 255.0 /end CHARACTERISTIC
/begin CHARACTERISTIC DFES_Severity.DFC_ComTrqDemandGbxCtr_FA_C "DFES/Projektspezifische Applikationdaten (pro DSM Element) DFC_ComTrqDemandGbxCtr_FA" VALUE 0x8002B251 Val_Wu8 255.0 OneToOne 0.00 255.0 /end CHARACTERISTIC
/begin CHARACTERISTIC DFES_Severity.DFC_ComTrqDemandGbxSig_A_C "DFES/Projektspezifische Applikationdaten (pro DSM Element) DFC_ComTrqDemandGbxSig_A" VALUE 0x8002B252 Val_Wu8 255.0 OneToOne 0.00 255.0 /end CHARACTERISTIC
/begin CHARACTERISTIC DFES_Severity.DFC_ComTrqDemandGbxSig_FA_C "DFES/Projektspezifische Applikationdaten (pro DSM Element) DFC_ComTrqDemandGbxSig_FA" VALUE 0x8002B253 Val_Wu8 255.0 OneToOne 0.00 255.0 /end CHARACTERISTIC
/begin CHARACTERISTIC DFES_Severity.DFC_ComTrqDemandGbxTo_A_C "DFES/Projektspezifische Applikationdaten (pro DSM Element) DFC_ComTrqDemandGbxTo_A" VALUE 0x8002B254 Val_Wu8 255.0 OneToOne 0.00 255.0 /end CHARACTERISTIC
/begin CHARACTERISTIC DFES_Severity.DFC_ComTrqDemandGbxTo_FA_C "DFES/Projektspezifische Applikationdaten (pro DSM Element) DFC_ComTrqDemandGbxTo_FA" VALUE 0x8002B255 Val_Wu8 255.0 OneToOne 0.00 255.0 /end CHARACTERISTIC
/begin CHARACTERISTIC DFES_Severity.DFC_ComTrqWhlDemChk_C "DFES/Projektspezifische Applikationdaten (pro DSM Element) DFC_ComTrqWhlDemChk" VALUE 0x8002B256 Val_Wu8 255.0 OneToOne 0.00 255.0 /end CHARACTERISTIC
/begin CHARACTERISTIC DFES_Severity.DFC_ComTrqWhlDemCtr_C "DFES/Projektspezifische Applikationdaten (pro DSM Element) DFC_ComTrqWhlDemCtr" VALUE 0x8002B257 Val_Wu8 255.0 OneToOne 0.00 255.0 /end CHARACTERISTIC
/begin CHARACTERISTIC DFES_Severity.DFC_ComTrqWhlDemFASChk_FX_C "DFES/Projektspezifische Applikationdaten (pro DSM Element) DFC_ComTrqWhlDemFASChk_FX" VALUE 0x8002B258 Val_Wu8 255.0 OneToOne 0.00 255.0 /end CHARACTERISTIC
/begin CHARACTERISTIC DFES_Severity.DFC_ComTrqWhlDemFASCtr_FX_C "DFES/Projektspezifische Applikationdaten (pro DSM Element) DFC_ComTrqWhlDemFASCtr_FX" VALUE 0x8002B259 Val_Wu8 255.0 OneToOne 0.00 255.0 /end CHARACTERISTIC
/begin CHARACTERISTIC DFES_Severity.DFC_ComTrqWhlDemFASTo_FX_C "DFES/Projektspezifische Applikationdaten (pro DSM Element) DFC_ComTrqWhlDemFASTo_FX" VALUE 0x8002B25A Val_Wu8 255.0 OneToOne 0.00 255.0 /end CHARACTERISTIC
/begin CHARACTERISTIC DFES_Severity.DFC_ComTrqWhlDemSig_C "DFES/Projektspezifische Applikationdaten (pro DSM Element) DFC_ComTrqWhlDemSig" VALUE 0x8002B25B Val_Wu8 255.0 OneToOne 0.00 255.0 /end CHARACTERISTIC
/begin CHARACTERISTIC DFES_Severity.DFC_ComTrqWhlDemTo_C "DFES/Projektspezifische Applikationdaten (pro DSM Element) DFC_ComTrqWhlDemTo" VALUE 0x8002B25C Val_Wu8 255.0 OneToOne 0.00 255.0 /end CHARACTERISTIC
/begin CHARACTERISTIC DFES_Severity.DFC_ComVelocityChk_FA_C "DFES/Projektspezifische Applikationdaten (pro DSM Element) DFC_ComVelocityChk_FA" VALUE 0x8002B25D Val_Wu8 255.0 OneToOne 0.00 255.0 /end CHARACTERISTIC
/begin CHARACTERISTIC DFES_Severity.DFC_ComVelocityCtr_FA_C "DFES/Projektspezifische Applikationdaten (pro DSM Element) DFC_ComVelocityCtr_FA" VALUE 0x8002B25E Val_Wu8 255.0 OneToOne 0.00 255.0 /end CHARACTERISTIC
/begin CHARACTERISTIC DFES_Severity.DFC_ComVelocitySig_C "DFES/Projektspezifische Applikationdaten (pro DSM Element) DFC_ComVelocitySig" VALUE 0x8002B25F Val_Wu8 255.0 OneToOne 0.00 255.0 /end CHARACTERISTIC
/begin CHARACTERISTIC DFES_Severity.DFC_ComVelocitySig_FA_C "DFES/Projektspezifische Applikationdaten (pro DSM Element) DFC_ComVelocitySig_FA" VALUE 0x8002B260 Val_Wu8 255.0 OneToOne 0.00 255.0 /end CHARACTERISTIC
/begin CHARACTERISTIC DFES_Severity.DFC_ComVelocityTo_C "DFES/Projektspezifische Applikationdaten (pro DSM Element) DFC_ComVelocityTo" VALUE 0x8002B261 Val_Wu8 255.0 OneToOne 0.00 255.0 /end CHARACTERISTIC
/begin CHARACTERISTIC DFES_Severity.DFC_ComVelocityTo_FA_C "DFES/Projektspezifische Applikationdaten (pro DSM Element) DFC_ComVelocityTo_FA" VALUE 0x8002B262 Val_Wu8 255.0 OneToOne 0.00 255.0 /end CHARACTERISTIC
/begin CHARACTERISTIC DFES_Severity.DFC_ComVerbraucherTo_C "DFES/Projektspezifische Applikationdaten (pro DSM Element) DFC_ComVerbraucherTo" VALUE 0x8002B263 Val_Wu8 255.0 OneToOne 0.00 255.0 /end CHARACTERISTIC
/begin CHARACTERISTIC DFES_Severity.DFC_ComWMomPTStabChk_FX_C "DFES/Projektspezifische Applikationdaten (pro DSM Element) DFC_ComWMomPTStabChk_FX" VALUE 0x8002B264 Val_Wu8 255.0 OneToOne 0.00 255.0 /end CHARACTERISTIC
/begin CHARACTERISTIC DFES_Severity.DFC_ComWMomPTStabCtr_FX_C "DFES/Projektspezifische Applikationdaten (pro DSM Element) DFC_ComWMomPTStabCtr_FX" VALUE 0x8002B265 Val_Wu8 255.0 OneToOne 0.00 255.0 /end CHARACTERISTIC
/begin CHARACTERISTIC DFES_Severity.DFC_ComWMomPTStabTo_FX_C "DFES/Projektspezifische Applikationdaten (pro DSM Element) DFC_ComWMomPTStabTo_FX" VALUE 0x8002B266 Val_Wu8 255.0 OneToOne 0.00 255.0 /end CHARACTERISTIC
/begin CHARACTERISTIC DFES_Severity.DFC_ComWheelSpeedSig_C "DFES/Projektspezifische Applikationdaten (pro DSM Element) DFC_ComWheelSpeedSig" VALUE 0x8002B267 Val_Wu8 255.0 OneToOne 0.00 255.0 /end CHARACTERISTIC
/begin CHARACTERISTIC DFES_Severity.DFC_ComWheelSpeedTo_C "DFES/Projektspezifische Applikationdaten (pro DSM Element) DFC_ComWheelSpeedTo" VALUE 0x8002B268 Val_Wu8 255.0 OneToOne 0.00 255.0 /end CHARACTERISTIC
/begin CHARACTERISTIC DFES_Severity.DFC_ComZvKlappenSig_C "DFES/Projektspezifische Applikationdaten (pro DSM Element) DFC_ComZvKlappenSig" VALUE 0x8002B269 Val_Wu8 255.0 OneToOne 0.00 255.0 /end CHARACTERISTIC
/begin CHARACTERISTIC DFES_Severity.DFC_ComZvKlappenTo_C "DFES/Projektspezifische Applikationdaten (pro DSM Element) DFC_ComZvKlappenTo" VALUE 0x8002B26A Val_Wu8 255.0 OneToOne 0.00 255.0 /end CHARACTERISTIC
/begin CHARACTERISTIC DFES_Severity.DFC_ComaDirectChk_FX_C "DFES/Projektspezifische Applikationdaten (pro DSM Element) DFC_ComaDirectChk_FX" VALUE 0x8002B26B Val_Wu8 255.0 OneToOne 0.00 255.0 /end CHARACTERISTIC
/begin CHARACTERISTIC DFES_Severity.DFC_ComaDirectCtr_FX_C "DFES/Projektspezifische Applikationdaten (pro DSM Element) DFC_ComaDirectCtr_FX" VALUE 0x8002B26C Val_Wu8 255.0 OneToOne 0.00 255.0 /end CHARACTERISTIC
/begin CHARACTERISTIC DFES_Severity.DFC_ComaDirectTo_FX_C "DFES/Projektspezifische Applikationdaten (pro DSM Element) DFC_ComaDirectTo_FX" VALUE 0x8002B26D Val_Wu8 255.0 OneToOne 0.00 255.0 /end CHARACTERISTIC
/begin CHARACTERISTIC DFES_Severity.DFC_ComaSideChk_FX_C "DFES/Projektspezifische Applikationdaten (pro DSM Element) DFC_ComaSideChk_FX" VALUE 0x8002B26E Val_Wu8 255.0 OneToOne 0.00 255.0 /end CHARACTERISTIC
/begin CHARACTERISTIC DFES_Severity.DFC_ComaSideCtr_FX_C "DFES/Projektspezifische Applikationdaten (pro DSM Element) DFC_ComaSideCtr_FX" VALUE 0x8002B26F Val_Wu8 255.0 OneToOne 0.00 255.0 /end CHARACTERISTIC
/begin CHARACTERISTIC DFES_Severity.DFC_ComaSideTo_FX_C "DFES/Projektspezifische Applikationdaten (pro DSM Element) DFC_ComaSideTo_FX" VALUE 0x8002B270 Val_Wu8 255.0 OneToOne 0.00 255.0 /end CHARACTERISTIC
/begin CHARACTERISTIC DFES_Severity.DFC_Cy320SpiCom_C "DFES/Projektspezifische Applikationdaten (pro DSM Element) DFC_Cy320SpiCom" VALUE 0x8002B271 Val_Wu8 255.0 OneToOne 0.00 255.0 /end CHARACTERISTIC
/begin CHARACTERISTIC DFES_Severity.DFC_ETCtlDvtInrMax_C "DFES/Projektspezifische Applikationdaten (pro DSM Element) DFC_ETCtlDvtInrMax" VALUE 0x8002B272 Val_Wu8 255.0 OneToOne 0.00 255.0 /end CHARACTERISTIC
/begin CHARACTERISTIC DFES_Severity.DFC_ETCtlDvtInrMin_C "DFES/Projektspezifische Applikationdaten (pro DSM Element) DFC_ETCtlDvtInrMin" VALUE 0x8002B273 Val_Wu8 255.0 OneToOne 0.00 255.0 /end CHARACTERISTIC
/begin CHARACTERISTIC DFES_Severity.DFC_ETCtlDvtOutrMax_C "DFES/Projektspezifische Applikationdaten (pro DSM Element) DFC_ETCtlDvtOutrMax" VALUE 0x8002B274 Val_Wu8 255.0 OneToOne 0.00 255.0 /end CHARACTERISTIC
/begin CHARACTERISTIC DFES_Severity.DFC_ETCtlDvtOutrMin_C "DFES/Projektspezifische Applikationdaten (pro DSM Element) DFC_ETCtlDvtOutrMin" VALUE 0x8002B275 Val_Wu8 255.0 OneToOne 0.00 255.0 /end CHARACTERISTIC
/begin CHARACTERISTIC DFES_Severity.DFC_FBCqDvtMax_C "DFES/" VALUE 0x8002B276 Val_Wu8 255.0 OneToOne 0.00 255.0 /end CHARACTERISTIC
/begin CHARACTERISTIC DFES_Severity.DFC_FBCqDvtMin_C "DFES/" VALUE 0x8002B277 Val_Wu8 255.0 OneToOne 0.00 255.0 /end CHARACTERISTIC
/begin CHARACTERISTIC DFES_Severity.DFC_Fan4WinErr1_C "DFES/Projektspezifische Applikationdaten (pro DSM Element) DFC_Fan4WinErr1" VALUE 0x8002B278 Val_Wu8 255.0 OneToOne 0.00 255.0 /end CHARACTERISTIC
/begin CHARACTERISTIC DFES_Severity.DFC_Fan4WinErr2_C "DFES/Projektspezifische Applikationdaten (pro DSM Element) DFC_Fan4WinErr2" VALUE 0x8002B279 Val_Wu8 255.0 OneToOne 0.00 255.0 /end CHARACTERISTIC
/begin CHARACTERISTIC DFES_Severity.DFC_Fan4WinErr3_C "DFES/Projektspezifische Applikationdaten (pro DSM Element) DFC_Fan4WinErr3" VALUE 0x8002B27A Val_Wu8 255.0 OneToOne 0.00 255.0 /end CHARACTERISTIC
/begin CHARACTERISTIC DFES_Severity.DFC_Fan4WinErr4_C "DFES/Projektspezifische Applikationdaten (pro DSM Element) DFC_Fan4WinErr4" VALUE 0x8002B27B Val_Wu8 255.0 OneToOne 0.00 255.0 /end CHARACTERISTIC
/begin CHARACTERISTIC DFES_Severity.DFC_FanSCG_C "DFES/Projektspezifische Applikationdaten (pro DSM Element) DFC_FanSCG" VALUE 0x8002B27C Val_Wu8 255.0 OneToOne 0.00 255.0 /end CHARACTERISTIC
/begin CHARACTERISTIC DFES_Severity.DFC_FlFCBS_C "DFES/Projektspezifische Applikationdaten (pro DSM Element) DFC_FlFCBS" VALUE 0x8002B27D Val_Wu8 255.0 OneToOne 0.00 255.0 /end CHARACTERISTIC
/begin CHARACTERISTIC DFES_Severity.DFC_GlwEcuConfigErr_C "DFES/Projektspezifische Applikationdaten (pro DSM Element) DFC_GlwEcuConfigErr" VALUE 0x8002B27E Val_Wu8 255.0 OneToOne 0.00 255.0 /end CHARACTERISTIC
/begin CHARACTERISTIC DFES_Severity.DFC_GlwEcuEepErr_C "DFES/Projektspezifische Applikationdaten (pro DSM Element) DFC_GlwEcuEepErr" VALUE 0x8002B27F Val_Wu8 255.0 OneToOne 0.00 255.0 /end CHARACTERISTIC
/begin CHARACTERISTIC DFES_Severity.DFC_GlwEcuFrmErr_C "DFES/Projektspezifische Applikationdaten (pro DSM Element) DFC_GlwEcuFrmErr" VALUE 0x8002B280 Val_Wu8 255.0 OneToOne 0.00 255.0 /end CHARACTERISTIC
/begin CHARACTERISTIC DFES_Severity.DFC_GlwEcuGPCMFaultInfo_C "DFES/Projektspezifische Applikationdaten (pro DSM Element) DFC_GlwEcuGPCMFaultInfo" VALUE 0x8002B281 Val_Wu8 255.0 OneToOne 0.00 255.0 /end CHARACTERISTIC
/begin CHARACTERISTIC DFES_Severity.DFC_GlwEcuGPCMInfo_C "DFES/Projektspezifische Applikationdaten (pro DSM Element) DFC_GlwEcuGPCMInfo" VALUE 0x8002B282 Val_Wu8 255.0 OneToOne 0.00 255.0 /end CHARACTERISTIC
/begin CHARACTERISTIC DFES_Severity.DFC_GlwEcuGk1HSS_C "DFES/Projektspezifische Applikationdaten (pro DSM Element) DFC_GlwEcuGk1HSS" VALUE 0x8002B283 Val_Wu8 255.0 OneToOne 0.00 255.0 /end CHARACTERISTIC
/begin CHARACTERISTIC DFES_Severity.DFC_GlwEcuGk1OL_C "DFES/Projektspezifische Applikationdaten (pro DSM Element) DFC_GlwEcuGk1OL" VALUE 0x8002B284 Val_Wu8 255.0 OneToOne 0.00 255.0 /end CHARACTERISTIC
/begin CHARACTERISTIC DFES_Severity.DFC_GlwEcuGk1SC_C "DFES/Projektspezifische Applikationdaten (pro DSM Element) DFC_GlwEcuGk1SC" VALUE 0x8002B285 Val_Wu8 255.0 OneToOne 0.00 255.0 /end CHARACTERISTIC
/begin CHARACTERISTIC DFES_Severity.DFC_GlwEcuGk1Wdst_C "DFES/Projektspezifische Applikationdaten (pro DSM Element) DFC_GlwEcuGk1Wdst" VALUE 0x8002B286 Val_Wu8 255.0 OneToOne 0.00 255.0 /end CHARACTERISTIC
/begin CHARACTERISTIC DFES_Severity.DFC_GlwEcuGk2HSS_C "DFES/Projektspezifische Applikationdaten (pro DSM Element) DFC_GlwEcuGk2HSS" VALUE 0x8002B287 Val_Wu8 255.0 OneToOne 0.00 255.0 /end CHARACTERISTIC
/begin CHARACTERISTIC DFES_Severity.DFC_GlwEcuGk2OL_C "DFES/Projektspezifische Applikationdaten (pro DSM Element) DFC_GlwEcuGk2OL" VALUE 0x8002B288 Val_Wu8 255.0 OneToOne 0.00 255.0 /end CHARACTERISTIC
/begin CHARACTERISTIC DFES_Severity.DFC_GlwEcuGk2SC_C "DFES/Projektspezifische Applikationdaten (pro DSM Element) DFC_GlwEcuGk2SC" VALUE 0x8002B289 Val_Wu8 255.0 OneToOne 0.00 255.0 /end CHARACTERISTIC
/begin CHARACTERISTIC DFES_Severity.DFC_GlwEcuGk2Wdst_C "DFES/Projektspezifische Applikationdaten (pro DSM Element) DFC_GlwEcuGk2Wdst" VALUE 0x8002B28A Val_Wu8 255.0 OneToOne 0.00 255.0 /end CHARACTERISTIC
/begin CHARACTERISTIC DFES_Severity.DFC_GlwEcuGk3HSS_C "DFES/Projektspezifische Applikationdaten (pro DSM Element) DFC_GlwEcuGk3HSS" VALUE 0x8002B28B Val_Wu8 255.0 OneToOne 0.00 255.0 /end CHARACTERISTIC
/begin CHARACTERISTIC DFES_Severity.DFC_GlwEcuGk3OL_C "DFES/Projektspezifische Applikationdaten (pro DSM Element) DFC_GlwEcuGk3OL" VALUE 0x8002B28C Val_Wu8 255.0 OneToOne 0.00 255.0 /end CHARACTERISTIC
/begin CHARACTERISTIC DFES_Severity.DFC_GlwEcuGk3SC_C "DFES/Projektspezifische Applikationdaten (pro DSM Element) DFC_GlwEcuGk3SC" VALUE 0x8002B28D Val_Wu8 255.0 OneToOne 0.00 255.0 /end CHARACTERISTIC
/begin CHARACTERISTIC DFES_Severity.DFC_GlwEcuGk3Wdst_C "DFES/Projektspezifische Applikationdaten (pro DSM Element) DFC_GlwEcuGk3Wdst" VALUE 0x8002B28E Val_Wu8 255.0 OneToOne 0.00 255.0 /end CHARACTERISTIC
/begin CHARACTERISTIC DFES_Severity.DFC_GlwEcuGk4HSS_C "DFES/Projektspezifische Applikationdaten (pro DSM Element) DFC_GlwEcuGk4HSS" VALUE 0x8002B28F Val_Wu8 255.0 OneToOne 0.00 255.0 /end CHARACTERISTIC
/begin CHARACTERISTIC DFES_Severity.DFC_GlwEcuGk4OL_C "DFES/Projektspezifische Applikationdaten (pro DSM Element) DFC_GlwEcuGk4OL" VALUE 0x8002B290 Val_Wu8 255.0 OneToOne 0.00 255.0 /end CHARACTERISTIC
/begin CHARACTERISTIC DFES_Severity.DFC_GlwEcuGk4SC_C "DFES/Projektspezifische Applikationdaten (pro DSM Element) DFC_GlwEcuGk4SC" VALUE 0x8002B291 Val_Wu8 255.0 OneToOne 0.00 255.0 /end CHARACTERISTIC
/begin CHARACTERISTIC DFES_Severity.DFC_GlwEcuGk4Wdst_C "DFES/Projektspezifische Applikationdaten (pro DSM Element) DFC_GlwEcuGk4Wdst" VALUE 0x8002B292 Val_Wu8 255.0 OneToOne 0.00 255.0 /end CHARACTERISTIC
/begin CHARACTERISTIC DFES_Severity.DFC_GlwEcuGk5HSS_C "DFES/Projektspezifische Applikationdaten (pro DSM Element) DFC_GlwEcuGk5HSS" VALUE 0x8002B293 Val_Wu8 255.0 OneToOne 0.00 255.0 /end CHARACTERISTIC
/begin CHARACTERISTIC DFES_Severity.DFC_GlwEcuGk5OL_C "DFES/Projektspezifische Applikationdaten (pro DSM Element) DFC_GlwEcuGk5OL" VALUE 0x8002B294 Val_Wu8 255.0 OneToOne 0.00 255.0 /end CHARACTERISTIC
/begin CHARACTERISTIC DFES_Severity.DFC_GlwEcuGk5SC_C "DFES/Projektspezifische Applikationdaten (pro DSM Element) DFC_GlwEcuGk5SC" VALUE 0x8002B295 Val_Wu8 255.0 OneToOne 0.00 255.0 /end CHARACTERISTIC
/begin CHARACTERISTIC DFES_Severity.DFC_GlwEcuGk5Wdst_C "DFES/Projektspezifische Applikationdaten (pro DSM Element) DFC_GlwEcuGk5Wdst" VALUE 0x8002B296 Val_Wu8 255.0 OneToOne 0.00 255.0 /end CHARACTERISTIC
/begin CHARACTERISTIC DFES_Severity.DFC_GlwEcuGk6HSS_C "DFES/Projektspezifische Applikationdaten (pro DSM Element) DFC_GlwEcuGk6HSS" VALUE 0x8002B297 Val_Wu8 255.0 OneToOne 0.00 255.0 /end CHARACTERISTIC
/begin CHARACTERISTIC DFES_Severity.DFC_GlwEcuGk6OL_C "DFES/Projektspezifische Applikationdaten (pro DSM Element) DFC_GlwEcuGk6OL" VALUE 0x8002B298 Val_Wu8 255.0 OneToOne 0.00 255.0 /end CHARACTERISTIC
/begin CHARACTERISTIC DFES_Severity.DFC_GlwEcuGk6SC_C "DFES/Projektspezifische Applikationdaten (pro DSM Element) DFC_GlwEcuGk6SC" VALUE 0x8002B299 Val_Wu8 255.0 OneToOne 0.00 255.0 /end CHARACTERISTIC
/begin CHARACTERISTIC DFES_Severity.DFC_GlwEcuGk6Wdst_C "DFES/Projektspezifische Applikationdaten (pro DSM Element) DFC_GlwEcuGk6Wdst" VALUE 0x8002B29A Val_Wu8 255.0 OneToOne 0.00 255.0 /end CHARACTERISTIC
/begin CHARACTERISTIC DFES_Severity.DFC_GlwEcuGndErr_C "DFES/Projektspezifische Applikationdaten (pro DSM Element) DFC_GlwEcuGndErr" VALUE 0x8002B29B Val_Wu8 255.0 OneToOne 0.00 255.0 /end CHARACTERISTIC
/begin CHARACTERISTIC DFES_Severity.DFC_GlwEcuIntErr_C "DFES/Projektspezifische Applikationdaten (pro DSM Element) DFC_GlwEcuIntErr" VALUE 0x8002B29C Val_Wu8 255.0 OneToOne 0.00 255.0 /end CHARACTERISTIC
/begin CHARACTERISTIC DFES_Severity.DFC_GlwEcuMsgTimeout_C "DFES/Projektspezifische Applikationdaten (pro DSM Element) DFC_GlwEcuMsgTimeout" VALUE 0x8002B29D Val_Wu8 255.0 OneToOne 0.00 255.0 /end CHARACTERISTIC
/begin CHARACTERISTIC DFES_Severity.DFC_GlwEcuT30Err_C "DFES/Projektspezifische Applikationdaten (pro DSM Element) DFC_GlwEcuT30Err" VALUE 0x8002B29E Val_Wu8 255.0 OneToOne 0.00 255.0 /end CHARACTERISTIC
/begin CHARACTERISTIC DFES_Severity.DFC_GlwEcuTempErr_C "DFES/Projektspezifische Applikationdaten (pro DSM Element) DFC_GlwEcuTempErr" VALUE 0x8002B29F Val_Wu8 255.0 OneToOne 0.00 255.0 /end CHARACTERISTIC
/begin CHARACTERISTIC DFES_Severity.DFC_GlwEcuUdiffT30_C "DFES/Projektspezifische Applikationdaten (pro DSM Element) DFC_GlwEcuUdiffT30" VALUE 0x8002B2A0 Val_Wu8 255.0 OneToOne 0.00 255.0 /end CHARACTERISTIC
/begin CHARACTERISTIC DFES_Severity.DFC_IBSComErr_C "DFES/Projektspezifische Applikationdaten (pro DSM Element) DFC_IBSComErr" VALUE 0x8002B2A1 Val_Wu8 255.0 OneToOne 0.00 255.0 /end CHARACTERISTIC
/begin CHARACTERISTIC DFES_Severity.DFC_LubSRCOilFldtCrit_C "DFES/Projektspezifische Applikationdaten (pro DSM Element) DFC_LubSRCOilFldtCrit" VALUE 0x8002B2A2 Val_Wu8 255.0 OneToOne 0.00 255.0 /end CHARACTERISTIC
/begin CHARACTERISTIC DFES_Severity.DFC_LubSRCOilFldtCritDflMin_C "DFES/Projektspezifische Applikationdaten (pro DSM Element) DFC_LubSRCOilFldtCritDflMin" VALUE 0x8002B2A3 Val_Wu8 255.0 OneToOne 0.00 255.0 /end CHARACTERISTIC
/begin CHARACTERISTIC DFES_Severity.DFC_LubSRCOilLvlCritMax_C "DFES/Projektspezifische Applikationdaten (pro DSM Element) DFC_LubSRCOilLvlCritMax" VALUE 0x8002B2A4 Val_Wu8 255.0 OneToOne 0.00 255.0 /end CHARACTERISTIC
/begin CHARACTERISTIC DFES_Severity.DFC_LubSRCOilLvlCritMin_C "DFES/Projektspezifische Applikationdaten (pro DSM Element) DFC_LubSRCOilLvlCritMin" VALUE 0x8002B2A5 Val_Wu8 255.0 OneToOne 0.00 255.0 /end CHARACTERISTIC
/begin CHARACTERISTIC DFES_Severity.DFC_LubSRCTot_C "DFES/Projektspezifische Applikationdaten (pro DSM Element) DFC_LubSRCTot" VALUE 0x8002B2A6 Val_Wu8 255.0 OneToOne 0.00 255.0 /end CHARACTERISTIC
/begin CHARACTERISTIC DFES_Severity.DFC_MonUMaxSupply1_C "DFES/Projektspezifische Applikationdaten (pro DSM Element) DFC_MonUMaxSupply1" VALUE 0x8002B2A7 Val_Wu8 255.0 OneToOne 0.00 255.0 /end CHARACTERISTIC
/begin CHARACTERISTIC DFES_Severity.DFC_MonUMinSupply1_C "DFES/Projektspezifische Applikationdaten (pro DSM Element) DFC_MonUMinSupply1" VALUE 0x8002B2A8 Val_Wu8 255.0 OneToOne 0.00 255.0 /end CHARACTERISTIC
/begin CHARACTERISTIC DFES_Severity.DFC_OilComNpl_C "DFES/Projektspezifische Applikationdaten (pro DSM Element) DFC_OilComNpl" VALUE 0x8002B2A9 Val_Wu8 255.0 OneToOne 0.00 255.0 /end CHARACTERISTIC
/begin CHARACTERISTIC DFES_Severity.DFC_PCBS_C "DFES/Projektspezifische Applikationdaten (pro DSM Element) DFC_PCBS" VALUE 0x8002B2AA Val_Wu8 255.0 OneToOne 0.00 255.0 /end CHARACTERISTIC
/begin CHARACTERISTIC DFES_Severity.DFC_PCBSPFltChg_C "DFES/Projektspezifische Applikationdaten (pro DSM Element) DFC_PCBSPFltChg" VALUE 0x8002B2AB Val_Wu8 255.0 OneToOne 0.00 255.0 /end CHARACTERISTIC
/begin CHARACTERISTIC DFES_Severity.DFC_PCRGovDvtLPMax_C "DFES/Projektspezifische Applikationdaten (pro DSM Element) DFC_PCRGovDvtLPMax" VALUE 0x8002B2AC Val_Wu8 255.0 OneToOne 0.00 255.0 /end CHARACTERISTIC
/begin CHARACTERISTIC DFES_Severity.DFC_PCRGovDvtLPMin_C "DFES/Projektspezifische Applikationdaten (pro DSM Element) DFC_PCRGovDvtLPMin" VALUE 0x8002B2AD Val_Wu8 255.0 OneToOne 0.00 255.0 /end CHARACTERISTIC
/begin CHARACTERISTIC DFES_Severity.DFC_PCRGovDvtMax_C "DFES/Projektspezifische Applikationdaten (pro DSM Element) DFC_PCRGovDvtMax" VALUE 0x8002B2AE Val_Wu8 255.0 OneToOne 0.00 255.0 /end CHARACTERISTIC
/begin CHARACTERISTIC DFES_Severity.DFC_PCRGovDvtMin_C "DFES/Projektspezifische Applikationdaten (pro DSM Element) DFC_PCRGovDvtMin" VALUE 0x8002B2AF Val_Wu8 255.0 OneToOne 0.00 255.0 /end CHARACTERISTIC
/begin CHARACTERISTIC DFES_Severity.DFC_PFltAPSPlausMAX_C "DFES/Projektspezifische Applikationdaten (pro DSM Element) DFC_PFltAPSPlausMAX" VALUE 0x8002B2B0 Val_Wu8 255.0 OneToOne 0.00 255.0 /end CHARACTERISTIC
/begin CHARACTERISTIC DFES_Severity.DFC_PFltAPSPlausMIN_C "DFES/Projektspezifische Applikationdaten (pro DSM Element) DFC_PFltAPSPlausMIN" VALUE 0x8002B2B1 Val_Wu8 255.0 OneToOne 0.00 255.0 /end CHARACTERISTIC
/begin CHARACTERISTIC DFES_Severity.DFC_PFltBPSPlausMAX_C "DFES/Projektspezifische Applikationdaten (pro DSM Element) DFC_PFltBPSPlausMAX" VALUE 0x8002B2B2 Val_Wu8 255.0 OneToOne 0.00 255.0 /end CHARACTERISTIC
/begin CHARACTERISTIC DFES_Severity.DFC_PFltBPSPlausMIN_C "DFES/Projektspezifische Applikationdaten (pro DSM Element) DFC_PFltBPSPlausMIN" VALUE 0x8002B2B3 Val_Wu8 255.0 OneToOne 0.00 255.0 /end CHARACTERISTIC
/begin CHARACTERISTIC DFES_Severity.DFC_PFltOvldInhRgn_C "DFES/Projektspezifische Applikationdaten (pro DSM Element) DFC_PFltOvldInhRgn" VALUE 0x8002B2B4 Val_Wu8 255.0 OneToOne 0.00 255.0 /end CHARACTERISTIC
/begin CHARACTERISTIC DFES_Severity.DFC_PFltOvldTrqLim_C "DFES/Projektspezifische Applikationdaten (pro DSM Element) DFC_PFltOvldTrqLim" VALUE 0x8002B2B5 Val_Wu8 255.0 OneToOne 0.00 255.0 /end CHARACTERISTIC
/begin CHARACTERISTIC DFES_Severity.DFC_PFltPresPlausMAX_C "DFES/Projektspezifische Applikationdaten (pro DSM Element) DFC_PFltPresPlausMAX" VALUE 0x8002B2B6 Val_Wu8 255.0 OneToOne 0.00 255.0 /end CHARACTERISTIC
/begin CHARACTERISTIC DFES_Severity.DFC_PFltPresPlausMIN_C "DFES/Projektspezifische Applikationdaten (pro DSM Element) DFC_PFltPresPlausMIN" VALUE 0x8002B2B7 Val_Wu8 255.0 OneToOne 0.00 255.0 /end CHARACTERISTIC
/begin CHARACTERISTIC DFES_Severity.DFC_PFltTraRpmRdc_C "DFES/Projektspezifische Applikationdaten (pro DSM Element) DFC_PFltTraRpmRdc" VALUE 0x8002B2B8 Val_Wu8 255.0 OneToOne 0.00 255.0 /end CHARACTERISTIC
/begin CHARACTERISTIC DFES_Severity.DFC_PFlt_tOxiPreMax_C "DFES/Projektspezifische Applikationdaten (pro DSM Element) DFC_PFlt_tOxiPreMax" VALUE 0x8002B2B9 Val_Wu8 255.0 OneToOne 0.00 255.0 /end CHARACTERISTIC
/begin CHARACTERISTIC DFES_Severity.DFC_PFlt_tOxiPreMaxRgn_C "DFES/Projektspezifische Applikationdaten (pro DSM Element) DFC_PFlt_tOxiPreMaxRgn" VALUE 0x8002B2BA Val_Wu8 255.0 OneToOne 0.00 255.0 /end CHARACTERISTIC
/begin CHARACTERISTIC DFES_Severity.DFC_PFlt_tOxiPreNpl_C "DFES/Projektspezifische Applikationdaten (pro DSM Element) DFC_PFlt_tOxiPreNpl" VALUE 0x8002B2BB Val_Wu8 255.0 OneToOne 0.00 255.0 /end CHARACTERISTIC
/begin CHARACTERISTIC DFES_Severity.DFC_PFlt_tPreMax_C "DFES/Projektspezifische Applikationdaten (pro DSM Element) DFC_PFlt_tPreMax" VALUE 0x8002B2BC Val_Wu8 255.0 OneToOne 0.00 255.0 /end CHARACTERISTIC
/begin CHARACTERISTIC DFES_Severity.DFC_PFlt_tPreMaxRgn_C "DFES/Projektspezifische Applikationdaten (pro DSM Element) DFC_PFlt_tPreMaxRgn" VALUE 0x8002B2BD Val_Wu8 255.0 OneToOne 0.00 255.0 /end CHARACTERISTIC
/begin CHARACTERISTIC DFES_Severity.DFC_PFlt_tPreNpl_C "DFES/Projektspezifische Applikationdaten (pro DSM Element) DFC_PFlt_tPreNpl" VALUE 0x8002B2BE Val_Wu8 255.0 OneToOne 0.00 255.0 /end CHARACTERISTIC
/begin CHARACTERISTIC DFES_Severity.DFC_PFltmSotDiffMAX_C "DFES/Projektspezifische Applikationdaten (pro DSM Element) DFC_PFltmSotDiffMAX" VALUE 0x8002B2BF Val_Wu8 255.0 OneToOne 0.00 255.0 /end CHARACTERISTIC
/begin CHARACTERISTIC DFES_Severity.DFC_PFltmSotDiffMIN_C "DFES/Projektspezifische Applikationdaten (pro DSM Element) DFC_PFltmSotDiffMIN" VALUE 0x8002B2C0 Val_Wu8 255.0 OneToOne 0.00 255.0 /end CHARACTERISTIC
/begin CHARACTERISTIC DFES_Severity.DFC_PFltmSotDiffSIG_C "DFES/Projektspezifische Applikationdaten (pro DSM Element) DFC_PFltmSotDiffSIG" VALUE 0x8002B2C1 Val_Wu8 255.0 OneToOne 0.00 255.0 /end CHARACTERISTIC
/begin CHARACTERISTIC DFES_Severity.DFC_PIntkVUsEnvPPls_C "DFES/Projektspezifische Applikationdaten (pro DSM Element) DFC_PIntkVUsEnvPPls" VALUE 0x8002B2C2 Val_Wu8 255.0 OneToOne 0.00 255.0 /end CHARACTERISTIC
/begin CHARACTERISTIC DFES_Severity.DFC_PresPlausDblDef_C "DFES/Projektspezifische Applikationdaten (pro DSM Element) DFC_PresPlausDblDef" VALUE 0x8002B2C3 Val_Wu8 255.0 OneToOne 0.00 255.0 /end CHARACTERISTIC
/begin CHARACTERISTIC DFES_Severity.DFC_RailCPC1_C "DFES/Projektspezifische Applikationdaten (pro DSM Element) DFC_RailCPC1" VALUE 0x8002B2C4 Val_Wu8 255.0 OneToOne 0.00 255.0 /end CHARACTERISTIC
/begin CHARACTERISTIC DFES_Severity.DFC_RailCPC3_C "DFES/Projektspezifische Applikationdaten (pro DSM Element) DFC_RailCPC3" VALUE 0x8002B2C5 Val_Wu8 255.0 OneToOne 0.00 255.0 /end CHARACTERISTIC
/begin CHARACTERISTIC DFES_Severity.DFC_RailCPC4_C "DFES/Projektspezifische Applikationdaten (pro DSM Element) DFC_RailCPC4" VALUE 0x8002B2C6 Val_Wu8 255.0 OneToOne 0.00 255.0 /end CHARACTERISTIC
/begin CHARACTERISTIC DFES_Severity.DFC_RailMeUn0_C "DFES/Projektspezifische Applikationdaten (pro DSM Element) DFC_RailMeUn0" VALUE 0x8002B2C7 Val_Wu8 255.0 OneToOne 0.00 255.0 /end CHARACTERISTIC
/begin CHARACTERISTIC DFES_Severity.DFC_RailMeUn1_C "DFES/Projektspezifische Applikationdaten (pro DSM Element) DFC_RailMeUn1" VALUE 0x8002B2C8 Val_Wu8 255.0 OneToOne 0.00 255.0 /end CHARACTERISTIC
/begin CHARACTERISTIC DFES_Severity.DFC_RailMeUn2_C "DFES/Projektspezifische Applikationdaten (pro DSM Element) DFC_RailMeUn2" VALUE 0x8002B2C9 Val_Wu8 255.0 OneToOne 0.00 255.0 /end CHARACTERISTIC
/begin CHARACTERISTIC DFES_Severity.DFC_RailMeUn22_C "DFES/Projektspezifische Applikationdaten (pro DSM Element) DFC_RailMeUn22" VALUE 0x8002B2CA Val_Wu8 255.0 OneToOne 0.00 255.0 /end CHARACTERISTIC
/begin CHARACTERISTIC DFES_Severity.DFC_RailMeUn3_C "DFES/Projektspezifische Applikationdaten (pro DSM Element) DFC_RailMeUn3" VALUE 0x8002B2CB Val_Wu8 255.0 OneToOne 0.00 255.0 /end CHARACTERISTIC
/begin CHARACTERISTIC DFES_Severity.DFC_RailMeUn4_C "DFES/Projektspezifische Applikationdaten (pro DSM Element) DFC_RailMeUn4" VALUE 0x8002B2CC Val_Wu8 255.0 OneToOne 0.00 255.0 /end CHARACTERISTIC
/begin CHARACTERISTIC DFES_Severity.DFC_RailMeUn42_C "DFES/Projektspezifische Applikationdaten (pro DSM Element) DFC_RailMeUn42" VALUE 0x8002B2CD Val_Wu8 255.0 OneToOne 0.00 255.0 /end CHARACTERISTIC
/begin CHARACTERISTIC DFES_Severity.DFC_RailMeUn5_C "DFES/Projektspezifische Applikationdaten (pro DSM Element) DFC_RailMeUn5" VALUE 0x8002B2CE Val_Wu8 255.0 OneToOne 0.00 255.0 /end CHARACTERISTIC
/begin CHARACTERISTIC DFES_Severity.DFC_RailPCV0_C "DFES/Projektspezifische Applikationdaten (pro DSM Element) DFC_RailPCV0" VALUE 0x8002B2CF Val_Wu8 255.0 OneToOne 0.00 255.0 /end CHARACTERISTIC
/begin CHARACTERISTIC DFES_Severity.DFC_RailPCV1_C "DFES/Projektspezifische Applikationdaten (pro DSM Element) DFC_RailPCV1" VALUE 0x8002B2D0 Val_Wu8 255.0 OneToOne 0.00 255.0 /end CHARACTERISTIC
/begin CHARACTERISTIC DFES_Severity.DFC_RailPCV2_C "DFES/Projektspezifische Applikationdaten (pro DSM Element) DFC_RailPCV2" VALUE 0x8002B2D1 Val_Wu8 255.0 OneToOne 0.00 255.0 /end CHARACTERISTIC
/begin CHARACTERISTIC DFES_Severity.DFC_RailPCV22_C "DFES/Projektspezifische Applikationdaten (pro DSM Element) DFC_RailPCV22" VALUE 0x8002B2D2 Val_Wu8 255.0 OneToOne 0.00 255.0 /end CHARACTERISTIC
/begin CHARACTERISTIC DFES_Severity.DFC_RailPCV3_C "DFES/Projektspezifische Applikationdaten (pro DSM Element) DFC_RailPCV3" VALUE 0x8002B2D3 Val_Wu8 255.0 OneToOne 0.00 255.0 /end CHARACTERISTIC
/begin CHARACTERISTIC DFES_Severity.DFC_RailPCV4_C "DFES/Projektspezifische Applikationdaten (pro DSM Element) DFC_RailPCV4" VALUE 0x8002B2D4 Val_Wu8 255.0 OneToOne 0.00 255.0 /end CHARACTERISTIC
/begin CHARACTERISTIC DFES_Severity.DFC_RailPCV42_C "DFES/Projektspezifische Applikationdaten (pro DSM Element) DFC_RailPCV42" VALUE 0x8002B2D5 Val_Wu8 255.0 OneToOne 0.00 255.0 /end CHARACTERISTIC
/begin CHARACTERISTIC DFES_Severity.DFC_RailPMonStrt_C "DFES/Projektspezifische Applikationdaten (pro DSM Element) DFC_RailPMonStrt" VALUE 0x8002B2D6 Val_Wu8 255.0 OneToOne 0.00 255.0 /end CHARACTERISTIC
/begin CHARACTERISTIC DFES_Severity.DFC_SSpMon1_C "DFES/Projektspezifische Applikationdaten (pro DSM Element) DFC_SSpMon1" VALUE 0x8002B2D7 Val_Wu8 255.0 OneToOne 0.00 255.0 /end CHARACTERISTIC
/begin CHARACTERISTIC DFES_Severity.DFC_SSpMon2_C "DFES/Projektspezifische Applikationdaten (pro DSM Element) DFC_SSpMon2" VALUE 0x8002B2D8 Val_Wu8 255.0 OneToOne 0.00 255.0 /end CHARACTERISTIC
/begin CHARACTERISTIC DFES_Severity.DFC_SSpMon3_C "DFES/Projektspezifische Applikationdaten (pro DSM Element) DFC_SSpMon3" VALUE 0x8002B2D9 Val_Wu8 255.0 OneToOne 0.00 255.0 /end CHARACTERISTIC
/begin CHARACTERISTIC DFES_Severity.DFC_ThrVlv4WinErr1_C "DFES/Projektspezifische Applikationdaten (pro DSM Element) DFC_ThrVlv4WinErr1" VALUE 0x8002B2DA Val_Wu8 255.0 OneToOne 0.00 255.0 /end CHARACTERISTIC
/begin CHARACTERISTIC DFES_Severity.DFC_ThrVlv4WinErr2_C "DFES/Projektspezifische Applikationdaten (pro DSM Element) DFC_ThrVlv4WinErr2" VALUE 0x8002B2DB Val_Wu8 255.0 OneToOne 0.00 255.0 /end CHARACTERISTIC
/begin CHARACTERISTIC DFES_Severity.DFC_ThrVlv4WinErr3_C "DFES/Projektspezifische Applikationdaten (pro DSM Element) DFC_ThrVlv4WinErr3" VALUE 0x8002B2DC Val_Wu8 255.0 OneToOne 0.00 255.0 /end CHARACTERISTIC
/begin CHARACTERISTIC DFES_Severity.DFC_ThrVlv4WinErr4_C "DFES/Projektspezifische Applikationdaten (pro DSM Element) DFC_ThrVlv4WinErr4" VALUE 0x8002B2DD Val_Wu8 255.0 OneToOne 0.00 255.0 /end CHARACTERISTIC
/begin CHARACTERISTIC DFES_Severity.DFC_ThrVlvSCG_C "DFES/Projektspezifische Applikationdaten (pro DSM Element) DFC_ThrVlvSCG" VALUE 0x8002B2DE Val_Wu8 255.0 OneToOne 0.00 255.0 /end CHARACTERISTIC
/begin CHARACTERISTIC DFES_Severity.DFC_Tle6232Spi1_C "DFES/Projektspezifische Applikationdaten (pro DSM Element) DFC_Tle6232Spi1" VALUE 0x8002B2DF Val_Wu8 255.0 OneToOne 0.00 255.0 /end CHARACTERISTIC
/begin CHARACTERISTIC DFES_Severity.DFC_TrbCh4WinErr1_C "DFES/Projektspezifische Applikationdaten (pro DSM Element) DFC_TrbCh4WinErr1" VALUE 0x8002B2E0 Val_Wu8 255.0 OneToOne 0.00 255.0 /end CHARACTERISTIC
/begin CHARACTERISTIC DFES_Severity.DFC_TrbCh4WinErr2_C "DFES/Projektspezifische Applikationdaten (pro DSM Element) DFC_TrbCh4WinErr2" VALUE 0x8002B2E1 Val_Wu8 255.0 OneToOne 0.00 255.0 /end CHARACTERISTIC
/begin CHARACTERISTIC DFES_Severity.DFC_TrbCh4WinErr3_C "DFES/Projektspezifische Applikationdaten (pro DSM Element) DFC_TrbCh4WinErr3" VALUE 0x8002B2E2 Val_Wu8 255.0 OneToOne 0.00 255.0 /end CHARACTERISTIC
/begin CHARACTERISTIC DFES_Severity.DFC_TrbCh4WinErr4_C "DFES/Projektspezifische Applikationdaten (pro DSM Element) DFC_TrbCh4WinErr4" VALUE 0x8002B2E3 Val_Wu8 255.0 OneToOne 0.00 255.0 /end CHARACTERISTIC
/begin CHARACTERISTIC DFES_Severity.DFC_TrbChSCG_C "DFES/Projektspezifische Applikationdaten (pro DSM Element) DFC_TrbChSCG" VALUE 0x8002B2E4 Val_Wu8 255.0 OneToOne 0.00 255.0 /end CHARACTERISTIC
/begin CHARACTERISTIC DFES_Severity.DFC_TrbChSRCMax_C "DFES/Projektspezifische Applikationdaten (pro DSM Element) DFC_TrbChSRCMax" VALUE 0x8002B2E5 Val_Wu8 255.0 OneToOne 0.00 255.0 /end CHARACTERISTIC
/begin CHARACTERISTIC DFES_Severity.DFC_TrbChSRCMin_C "DFES/Projektspezifische Applikationdaten (pro DSM Element) DFC_TrbChSRCMin" VALUE 0x8002B2E6 Val_Wu8 255.0 OneToOne 0.00 255.0 /end CHARACTERISTIC
/begin CHARACTERISTIC DFES_Severity.DFC_WaHtEl4WinErr1_C "DFES/Projektspezifische Applikationdaten (pro DSM Element) DFC_WaHtEl4WinErr1" VALUE 0x8002B2E7 Val_Wu8 255.0 OneToOne 0.00 255.0 /end CHARACTERISTIC
/begin CHARACTERISTIC DFES_Severity.DFC_WaHtEl4WinErr2_C "DFES/Projektspezifische Applikationdaten (pro DSM Element) DFC_WaHtEl4WinErr2" VALUE 0x8002B2E8 Val_Wu8 255.0 OneToOne 0.00 255.0 /end CHARACTERISTIC
/begin CHARACTERISTIC DFES_Severity.DFC_WaHtEl4WinErr3_C "DFES/Projektspezifische Applikationdaten (pro DSM Element) DFC_WaHtEl4WinErr3" VALUE 0x8002B2E9 Val_Wu8 255.0 OneToOne 0.00 255.0 /end CHARACTERISTIC
/begin CHARACTERISTIC DFES_Severity.DFC_WaHtEl4WinErr4_C "DFES/Projektspezifische Applikationdaten (pro DSM Element) DFC_WaHtEl4WinErr4" VALUE 0x8002B2EA Val_Wu8 255.0 OneToOne 0.00 255.0 /end CHARACTERISTIC
/begin CHARACTERISTIC DFES_Severity.DFC_WaHtElSCG_C "DFES/Projektspezifische Applikationdaten (pro DSM Element) DFC_WaHtElSCG" VALUE 0x8002B2EB Val_Wu8 255.0 OneToOne 0.00 255.0 /end CHARACTERISTIC
/begin CHARACTERISTIC DFES_Severity.DFC_ETClbETFltMax_0_C "DFES/Projektspezifische Applikationdaten (pro DSM Element) DFC_ETClbETFltMax_0" VALUE 0x8002B2EC Val_Wu8 255.0 OneToOne 0.00 255.0 /end CHARACTERISTIC
/begin CHARACTERISTIC DFES_Severity.DFC_ETClbETFltMax_1_C "DFES/Projektspezifische Applikationdaten (pro DSM Element) DFC_ETClbETFltMax_1" VALUE 0x8002B2ED Val_Wu8 255.0 OneToOne 0.00 255.0 /end CHARACTERISTIC
/begin CHARACTERISTIC DFES_Severity.DFC_ETClbETFltMax_2_C "DFES/Projektspezifische Applikationdaten (pro DSM Element) DFC_ETClbETFltMax_2" VALUE 0x8002B2EE Val_Wu8 255.0 OneToOne 0.00 255.0 /end CHARACTERISTIC
/begin CHARACTERISTIC DFES_Severity.DFC_ETClbETFltMax_3_C "DFES/Projektspezifische Applikationdaten (pro DSM Element) DFC_ETClbETFltMax_3" VALUE 0x8002B2EF Val_Wu8 255.0 OneToOne 0.00 255.0 /end CHARACTERISTIC
/begin CHARACTERISTIC DFES_Severity.DFC_ETClbETFltMax_4_C "DFES/Projektspezifische Applikationdaten (pro DSM Element) DFC_ETClbETFltMax_4" VALUE 0x8002B2F0 Val_Wu8 255.0 OneToOne 0.00 255.0 /end CHARACTERISTIC
/begin CHARACTERISTIC DFES_Severity.DFC_ETClbETFltMax_5_C "DFES/Projektspezifische Applikationdaten (pro DSM Element) DFC_ETClbETFltMax_5" VALUE 0x8002B2F1 Val_Wu8 255.0 OneToOne 0.00 255.0 /end CHARACTERISTIC
/begin CHARACTERISTIC DFES_Severity.DFC_ETClbETFltMin_0_C "DFES/Projektspezifische Applikationdaten (pro DSM Element) DFC_ETClbETFltMin_0" VALUE 0x8002B2F2 Val_Wu8 255.0 OneToOne 0.00 255.0 /end CHARACTERISTIC
/begin CHARACTERISTIC DFES_Severity.DFC_ETClbETFltMin_1_C "DFES/Projektspezifische Applikationdaten (pro DSM Element) DFC_ETClbETFltMin_1" VALUE 0x8002B2F3 Val_Wu8 255.0 OneToOne 0.00 255.0 /end CHARACTERISTIC
/begin CHARACTERISTIC DFES_Severity.DFC_ETClbETFltMin_2_C "DFES/Projektspezifische Applikationdaten (pro DSM Element) DFC_ETClbETFltMin_2" VALUE 0x8002B2F4 Val_Wu8 255.0 OneToOne 0.00 255.0 /end CHARACTERISTIC
/begin CHARACTERISTIC DFES_Severity.DFC_ETClbETFltMin_3_C "DFES/Projektspezifische Applikationdaten (pro DSM Element) DFC_ETClbETFltMin_3" VALUE 0x8002B2F5 Val_Wu8 255.0 OneToOne 0.00 255.0 /end CHARACTERISTIC
/begin CHARACTERISTIC DFES_Severity.DFC_ETClbETFltMin_4_C "DFES/Projektspezifische Applikationdaten (pro DSM Element) DFC_ETClbETFltMin_4" VALUE 0x8002B2F6 Val_Wu8 255.0 OneToOne 0.00 255.0 /end CHARACTERISTIC
/begin CHARACTERISTIC DFES_Severity.DFC_ETClbETFltMin_5_C "DFES/Projektspezifische Applikationdaten (pro DSM Element) DFC_ETClbETFltMin_5" VALUE 0x8002B2F7 Val_Wu8 255.0 OneToOne 0.00 255.0 /end CHARACTERISTIC
/begin CHARACTERISTIC DFES_Severity.DFC_InjCrvInjLimChrgBal_C "DFES/Projektspezifische Applikationdaten (pro DSM Element) DFC_InjCrvInjLimChrgBal" VALUE 0x8002B2F8 Val_Wu8 255.0 OneToOne 0.00 255.0 /end CHARACTERISTIC
/begin CHARACTERISTIC DFES_Severity.DFC_InjCrvInjLimQntBal_C "DFES/Projektspezifische Applikationdaten (pro DSM Element) DFC_InjCrvInjLimQntBal" VALUE 0x8002B2F9 Val_Wu8 255.0 OneToOne 0.00 255.0 /end CHARACTERISTIC
/begin CHARACTERISTIC DFES_Severity.DFC_InjCrvInjLimSys_C "DFES/Projektspezifische Applikationdaten (pro DSM Element) DFC_InjCrvInjLimSys" VALUE 0x8002B2FA Val_Wu8 255.0 OneToOne 0.00 255.0 /end CHARACTERISTIC
/begin CHARACTERISTIC DFES_Severity.DFC_InjCrvNumInjRtmLim_C "DFES/Projektspezifische Applikationdaten (pro DSM Element) DFC_InjCrvNumInjRtmLim" VALUE 0x8002B2FB Val_Wu8 255.0 OneToOne 0.00 255.0 /end CHARACTERISTIC
/begin CHARACTERISTIC DFES_Severity.DFC_LSUHtCoupSig_C "DFES/Projektspezifische Applikationdaten (pro DSM Element) DFC_LSUHtCoupSig" VALUE 0x8002B2FC Val_Wu8 255.0 OneToOne 0.00 255.0 /end CHARACTERISTIC
/begin CHARACTERISTIC DFES_Severity.DFC_AFS_SSpShOffOL_C "DFES/Projektspezifische Applikationdaten (pro DSM Element) DFC_AFS_SSpShOffOL" VALUE 0x8002B2FD Val_Wu8 255.0 OneToOne 0.00 255.0 /end CHARACTERISTIC
/begin CHARACTERISTIC DFES_Severity.DFC_AFS_SSpShOffOvrTemp_C "DFES/Projektspezifische Applikationdaten (pro DSM Element) DFC_AFS_SSpShOffOvrTemp" VALUE 0x8002B2FE Val_Wu8 255.0 OneToOne 0.00 255.0 /end CHARACTERISTIC
/begin CHARACTERISTIC DFES_Severity.DFC_AFS_SSpShOffSCB_C "DFES/Projektspezifische Applikationdaten (pro DSM Element) DFC_AFS_SSpShOffSCB" VALUE 0x8002B2FF Val_Wu8 255.0 OneToOne 0.00 255.0 /end CHARACTERISTIC
/begin CHARACTERISTIC DFES_Severity.DFC_AFS_SSpShOffSCG_C "DFES/Projektspezifische Applikationdaten (pro DSM Element) DFC_AFS_SSpShOffSCG" VALUE 0x8002B300 Val_Wu8 255.0 OneToOne 0.00 255.0 /end CHARACTERISTIC
/begin CHARACTERISTIC DFES_Severity.DFC_AirCCmprOL_C "DFES/Projektspezifische Applikationdaten (pro DSM Element) DFC_AirCCmprOL" VALUE 0x8002B301 Val_Wu8 255.0 OneToOne 0.00 255.0 /end CHARACTERISTIC
/begin CHARACTERISTIC DFES_Severity.DFC_AirCCmprOvrTemp_C "DFES/Projektspezifische Applikationdaten (pro DSM Element) DFC_AirCCmprOvrTemp" VALUE 0x8002B302 Val_Wu8 255.0 OneToOne 0.00 255.0 /end CHARACTERISTIC
/begin CHARACTERISTIC DFES_Severity.DFC_AirCCmprSCB_C "DFES/Projektspezifische Applikationdaten (pro DSM Element) DFC_AirCCmprSCB" VALUE 0x8002B303 Val_Wu8 255.0 OneToOne 0.00 255.0 /end CHARACTERISTIC
/begin CHARACTERISTIC DFES_Severity.DFC_AirCCmprSCG_C "DFES/Projektspezifische Applikationdaten (pro DSM Element) DFC_AirCCmprSCG" VALUE 0x8002B304 Val_Wu8 255.0 OneToOne 0.00 255.0 /end CHARACTERISTIC
/begin CHARACTERISTIC DFES_Severity.DFC_CByVlvOL_C "DFES/Projektspezifische Applikationdaten (pro DSM Element) DFC_CByVlvOL" VALUE 0x8002B305 Val_Wu8 255.0 OneToOne 0.00 255.0 /end CHARACTERISTIC
/begin CHARACTERISTIC DFES_Severity.DFC_CByVlvOvrTemp_C "DFES/Projektspezifische Applikationdaten (pro DSM Element) DFC_CByVlvOvrTemp" VALUE 0x8002B306 Val_Wu8 255.0 OneToOne 0.00 255.0 /end CHARACTERISTIC
/begin CHARACTERISTIC DFES_Severity.DFC_CByVlvSCB_C "DFES/Projektspezifische Applikationdaten (pro DSM Element) DFC_CByVlvSCB" VALUE 0x8002B307 Val_Wu8 255.0 OneToOne 0.00 255.0 /end CHARACTERISTIC
/begin CHARACTERISTIC DFES_Severity.DFC_CByVlvSCG_C "DFES/Projektspezifische Applikationdaten (pro DSM Element) DFC_CByVlvSCG" VALUE 0x8002B308 Val_Wu8 255.0 OneToOne 0.00 255.0 /end CHARACTERISTIC
/begin CHARACTERISTIC DFES_Severity.DFC_CThmstOL_C "DFES/Projektspezifische Applikationdaten (pro DSM Element) DFC_CThmstOL" VALUE 0x8002B309 Val_Wu8 255.0 OneToOne 0.00 255.0 /end CHARACTERISTIC
/begin CHARACTERISTIC DFES_Severity.DFC_CThmstOvrTemp_C "DFES/Projektspezifische Applikationdaten (pro DSM Element) DFC_CThmstOvrTemp" VALUE 0x8002B30A Val_Wu8 255.0 OneToOne 0.00 255.0 /end CHARACTERISTIC
/begin CHARACTERISTIC DFES_Severity.DFC_CThmstSCB_C "DFES/Projektspezifische Applikationdaten (pro DSM Element) DFC_CThmstSCB" VALUE 0x8002B30B Val_Wu8 255.0 OneToOne 0.00 255.0 /end CHARACTERISTIC
/begin CHARACTERISTIC DFES_Severity.DFC_CThmstSCG_C "DFES/Projektspezifische Applikationdaten (pro DSM Element) DFC_CThmstSCG" VALUE 0x8002B30C Val_Wu8 255.0 OneToOne 0.00 255.0 /end CHARACTERISTIC
/begin CHARACTERISTIC DFES_Severity.DFC_DSMDummy_C "DFES/Projektspezifische Applikationdaten (pro DSM Element) DFC_DSMDummy" VALUE 0x8002B30D Val_Wu8 255.0 OneToOne 0.00 255.0 /end CHARACTERISTIC
/begin CHARACTERISTIC DFES_Severity.DFC_EBxFanOL_C "DFES/Projektspezifische Applikationdaten (pro DSM Element) DFC_EBxFanOL" VALUE 0x8002B30E Val_Wu8 255.0 OneToOne 0.00 255.0 /end CHARACTERISTIC
/begin CHARACTERISTIC DFES_Severity.DFC_EBxFanOvrTemp_C "DFES/Projektspezifische Applikationdaten (pro DSM Element) DFC_EBxFanOvrTemp" VALUE 0x8002B30F Val_Wu8 255.0 OneToOne 0.00 255.0 /end CHARACTERISTIC
/begin CHARACTERISTIC DFES_Severity.DFC_EBxFanSCB_C "DFES/Projektspezifische Applikationdaten (pro DSM Element) DFC_EBxFanSCB" VALUE 0x8002B310 Val_Wu8 255.0 OneToOne 0.00 255.0 /end CHARACTERISTIC
/begin CHARACTERISTIC DFES_Severity.DFC_EBxFanSCG_C "DFES/Projektspezifische Applikationdaten (pro DSM Element) DFC_EBxFanSCG" VALUE 0x8002B311 Val_Wu8 255.0 OneToOne 0.00 255.0 /end CHARACTERISTIC
/begin CHARACTERISTIC DFES_Severity.DFC_ECBVlvOL_C "DFES/Projektspezifische Applikationdaten (pro DSM Element) DFC_ECBVlvOL" VALUE 0x8002B312 Val_Wu8 255.0 OneToOne 0.00 255.0 /end CHARACTERISTIC
/begin CHARACTERISTIC DFES_Severity.DFC_ECBVlvOvrTemp_C "DFES/Projektspezifische Applikationdaten (pro DSM Element) DFC_ECBVlvOvrTemp" VALUE 0x8002B313 Val_Wu8 255.0 OneToOne 0.00 255.0 /end CHARACTERISTIC
/begin CHARACTERISTIC DFES_Severity.DFC_ECBVlvSCB_C "DFES/Projektspezifische Applikationdaten (pro DSM Element) DFC_ECBVlvSCB" VALUE 0x8002B314 Val_Wu8 255.0 OneToOne 0.00 255.0 /end CHARACTERISTIC
/begin CHARACTERISTIC DFES_Severity.DFC_ECBVlvSCG_C "DFES/Projektspezifische Applikationdaten (pro DSM Element) DFC_ECBVlvSCG" VALUE 0x8002B315 Val_Wu8 255.0 OneToOne 0.00 255.0 /end CHARACTERISTIC
/begin CHARACTERISTIC DFES_Severity.DFC_EMDmpOL_0_C "DFES/Projektspezifische Applikationdaten (pro DSM Element) DFC_EMDmpOL_0" VALUE 0x8002B316 Val_Wu8 255.0 OneToOne 0.00 255.0 /end CHARACTERISTIC
/begin CHARACTERISTIC DFES_Severity.DFC_EMDmpOL_1_C "DFES/Projektspezifische Applikationdaten (pro DSM Element) DFC_EMDmpOL_1" VALUE 0x8002B317 Val_Wu8 255.0 OneToOne 0.00 255.0 /end CHARACTERISTIC
/begin CHARACTERISTIC DFES_Severity.DFC_EMDmpOvrTemp_0_C "DFES/Projektspezifische Applikationdaten (pro DSM Element) DFC_EMDmpOvrTemp_0" VALUE 0x8002B318 Val_Wu8 255.0 OneToOne 0.00 255.0 /end CHARACTERISTIC
/begin CHARACTERISTIC DFES_Severity.DFC_EMDmpOvrTemp_1_C "DFES/Projektspezifische Applikationdaten (pro DSM Element) DFC_EMDmpOvrTemp_1" VALUE 0x8002B319 Val_Wu8 255.0 OneToOne 0.00 255.0 /end CHARACTERISTIC
/begin CHARACTERISTIC DFES_Severity.DFC_EMDmpSCB_0_C "DFES/Projektspezifische Applikationdaten (pro DSM Element) DFC_EMDmpSCB_0" VALUE 0x8002B31A Val_Wu8 255.0 OneToOne 0.00 255.0 /end CHARACTERISTIC
/begin CHARACTERISTIC DFES_Severity.DFC_EMDmpSCB_1_C "DFES/Projektspezifische Applikationdaten (pro DSM Element) DFC_EMDmpSCB_1" VALUE 0x8002B31B Val_Wu8 255.0 OneToOne 0.00 255.0 /end CHARACTERISTIC
/begin CHARACTERISTIC DFES_Severity.DFC_EMDmpSCG_0_C "DFES/Projektspezifische Applikationdaten (pro DSM Element) DFC_EMDmpSCG_0" VALUE 0x8002B31C Val_Wu8 255.0 OneToOne 0.00 255.0 /end CHARACTERISTIC
/begin CHARACTERISTIC DFES_Severity.DFC_EMDmpSCG_1_C "DFES/Projektspezifische Applikationdaten (pro DSM Element) DFC_EMDmpSCG_1" VALUE 0x8002B31D Val_Wu8 255.0 OneToOne 0.00 255.0 /end CHARACTERISTIC
/begin CHARACTERISTIC DFES_Severity.DFC_EngStAOL_C "DFES/Projektspezifische Applikationdaten (pro DSM Element) DFC_EngStAOL" VALUE 0x8002B31E Val_Wu8 255.0 OneToOne 0.00 255.0 /end CHARACTERISTIC
/begin CHARACTERISTIC DFES_Severity.DFC_EngStAOvrTemp_C "DFES/Projektspezifische Applikationdaten (pro DSM Element) DFC_EngStAOvrTemp" VALUE 0x8002B31F Val_Wu8 255.0 OneToOne 0.00 255.0 /end CHARACTERISTIC
/begin CHARACTERISTIC DFES_Severity.DFC_EngStASCB_C "DFES/Projektspezifische Applikationdaten (pro DSM Element) DFC_EngStASCB" VALUE 0x8002B320 Val_Wu8 255.0 OneToOne 0.00 255.0 /end CHARACTERISTIC
/begin CHARACTERISTIC DFES_Severity.DFC_EngStASCG_C "DFES/Projektspezifische Applikationdaten (pro DSM Element) DFC_EngStASCG" VALUE 0x8002B321 Val_Wu8 255.0 OneToOne 0.00 255.0 /end CHARACTERISTIC
/begin CHARACTERISTIC DFES_Severity.DFC_FanOL_C "DFES/Projektspezifische Applikationdaten (pro DSM Element) DFC_FanOL" VALUE 0x8002B322 Val_Wu8 255.0 OneToOne 0.00 255.0 /end CHARACTERISTIC
/begin CHARACTERISTIC DFES_Severity.DFC_FanOvrTemp_C "DFES/Projektspezifische Applikationdaten (pro DSM Element) DFC_FanOvrTemp" VALUE 0x8002B323 Val_Wu8 255.0 OneToOne 0.00 255.0 /end CHARACTERISTIC
/begin CHARACTERISTIC DFES_Severity.DFC_FanSCB_C "DFES/Projektspezifische Applikationdaten (pro DSM Element) DFC_FanSCB" VALUE 0x8002B324 Val_Wu8 255.0 OneToOne 0.00 255.0 /end CHARACTERISTIC
/begin CHARACTERISTIC DFES_Severity.DFC_FlFltHtOL_C "DFES/Projektspezifische Applikationdaten (pro DSM Element) DFC_FlFltHtOL" VALUE 0x8002B325 Val_Wu8 255.0 OneToOne 0.00 255.0 /end CHARACTERISTIC
/begin CHARACTERISTIC DFES_Severity.DFC_FlFltHtOvrTemp_C "DFES/Projektspezifische Applikationdaten (pro DSM Element) DFC_FlFltHtOvrTemp" VALUE 0x8002B326 Val_Wu8 255.0 OneToOne 0.00 255.0 /end CHARACTERISTIC
/begin CHARACTERISTIC DFES_Severity.DFC_FlFltHtSCB_C "DFES/Projektspezifische Applikationdaten (pro DSM Element) DFC_FlFltHtSCB" VALUE 0x8002B327 Val_Wu8 255.0 OneToOne 0.00 255.0 /end CHARACTERISTIC
/begin CHARACTERISTIC DFES_Severity.DFC_FlFltHtSCG_C "DFES/Projektspezifische Applikationdaten (pro DSM Element) DFC_FlFltHtSCG" VALUE 0x8002B328 Val_Wu8 255.0 OneToOne 0.00 255.0 /end CHARACTERISTIC
/begin CHARACTERISTIC DFES_Severity.DFC_LSUHtrMax_C "DFES/Projektspezifische Applikationdaten (pro DSM Element) DFC_LSUHtrMax" VALUE 0x8002B329 Val_Wu8 255.0 OneToOne 0.00 255.0 /end CHARACTERISTIC
/begin CHARACTERISTIC DFES_Severity.DFC_LSUHtrMin_C "DFES/Projektspezifische Applikationdaten (pro DSM Element) DFC_LSUHtrMin" VALUE 0x8002B32A Val_Wu8 255.0 OneToOne 0.00 255.0 /end CHARACTERISTIC
/begin CHARACTERISTIC DFES_Severity.DFC_LSUHtrNpl_C "DFES/Projektspezifische Applikationdaten (pro DSM Element) DFC_LSUHtrNpl" VALUE 0x8002B32B Val_Wu8 255.0 OneToOne 0.00 255.0 /end CHARACTERISTIC
/begin CHARACTERISTIC DFES_Severity.DFC_LSUHtrSig_C "DFES/Projektspezifische Applikationdaten (pro DSM Element) DFC_LSUHtrSig" VALUE 0x8002B32C Val_Wu8 255.0 OneToOne 0.00 255.0 /end CHARACTERISTIC
/begin CHARACTERISTIC DFES_Severity.DFC_LSUtExcMax_C "DFES/Projektspezifische Applikationdaten (pro DSM Element) DFC_LSUtExcMax" VALUE 0x8002B32D Val_Wu8 255.0 OneToOne 0.00 255.0 /end CHARACTERISTIC
/begin CHARACTERISTIC DFES_Severity.DFC_LSUtExcMin_C "DFES/Projektspezifische Applikationdaten (pro DSM Element) DFC_LSUtExcMin" VALUE 0x8002B32E Val_Wu8 255.0 OneToOne 0.00 255.0 /end CHARACTERISTIC
/begin CHARACTERISTIC DFES_Severity.DFC_MeUnOL_C "DFES/Projektspezifische Applikationdaten (pro DSM Element) DFC_MeUnOL" VALUE 0x8002B32F Val_Wu8 255.0 OneToOne 0.00 255.0 /end CHARACTERISTIC
/begin CHARACTERISTIC DFES_Severity.DFC_MeUnSCB_C "DFES/Projektspezifische Applikationdaten (pro DSM Element) DFC_MeUnSCB" VALUE 0x8002B330 Val_Wu8 255.0 OneToOne 0.00 255.0 /end CHARACTERISTIC
/begin CHARACTERISTIC DFES_Severity.DFC_MeUnSRCMax_C "DFES/Projektspezifische Applikationdaten (pro DSM Element) DFC_MeUnSRCMax" VALUE 0x8002B331 Val_Wu8 255.0 OneToOne 0.00 255.0 /end CHARACTERISTIC
/begin CHARACTERISTIC DFES_Severity.DFC_MeUnSRCMin_C "DFES/Projektspezifische Applikationdaten (pro DSM Element) DFC_MeUnSRCMin" VALUE 0x8002B332 Val_Wu8 255.0 OneToOne 0.00 255.0 /end CHARACTERISTIC
/begin CHARACTERISTIC DFES_Severity.DFC_PCVOL_C "DFES/Projektspezifische Applikationdaten (pro DSM Element) DFC_PCVOL" VALUE 0x8002B333 Val_Wu8 255.0 OneToOne 0.00 255.0 /end CHARACTERISTIC
/begin CHARACTERISTIC DFES_Severity.DFC_PCVSCB_C "DFES/Projektspezifische Applikationdaten (pro DSM Element) DFC_PCVSCB" VALUE 0x8002B334 Val_Wu8 255.0 OneToOne 0.00 255.0 /end CHARACTERISTIC
/begin CHARACTERISTIC DFES_Severity.DFC_PCVSRCMax_C "DFES/Projektspezifische Applikationdaten (pro DSM Element) DFC_PCVSRCMax" VALUE 0x8002B335 Val_Wu8 255.0 OneToOne 0.00 255.0 /end CHARACTERISTIC
/begin CHARACTERISTIC DFES_Severity.DFC_PCVSRCMin_C "DFES/Projektspezifische Applikationdaten (pro DSM Element) DFC_PCVSRCMin" VALUE 0x8002B336 Val_Wu8 255.0 OneToOne 0.00 255.0 /end CHARACTERISTIC
/begin CHARACTERISTIC DFES_Severity.DFC_RailPSRCMax_C "DFES/Projektspezifische Applikationdaten (pro DSM Element) DFC_RailPSRCMax" VALUE 0x8002B337 Val_Wu8 255.0 OneToOne 0.00 255.0 /end CHARACTERISTIC
/begin CHARACTERISTIC DFES_Severity.DFC_RailPSRCMin_C "DFES/Projektspezifische Applikationdaten (pro DSM Element) DFC_RailPSRCMin" VALUE 0x8002B338 Val_Wu8 255.0 OneToOne 0.00 255.0 /end CHARACTERISTIC
/begin CHARACTERISTIC DFES_Severity.DFC_ShtrOL_C "DFES/Projektspezifische Applikationdaten (pro DSM Element) DFC_ShtrOL" VALUE 0x8002B339 Val_Wu8 255.0 OneToOne 0.00 255.0 /end CHARACTERISTIC
/begin CHARACTERISTIC DFES_Severity.DFC_ShtrOvrTemp_C "DFES/Projektspezifische Applikationdaten (pro DSM Element) DFC_ShtrOvrTemp" VALUE 0x8002B33A Val_Wu8 255.0 OneToOne 0.00 255.0 /end CHARACTERISTIC
/begin CHARACTERISTIC DFES_Severity.DFC_ShtrSCB_C "DFES/Projektspezifische Applikationdaten (pro DSM Element) DFC_ShtrSCB" VALUE 0x8002B33B Val_Wu8 255.0 OneToOne 0.00 255.0 /end CHARACTERISTIC
/begin CHARACTERISTIC DFES_Severity.DFC_ShtrSCG_C "DFES/Projektspezifische Applikationdaten (pro DSM Element) DFC_ShtrSCG" VALUE 0x8002B33C Val_Wu8 255.0 OneToOne 0.00 255.0 /end CHARACTERISTIC
/begin CHARACTERISTIC DFES_Severity.DFC_StrtOL_C "DFES/Projektspezifische Applikationdaten (pro DSM Element) DFC_StrtOL" VALUE 0x8002B33D Val_Wu8 255.0 OneToOne 0.00 255.0 /end CHARACTERISTIC
/begin CHARACTERISTIC DFES_Severity.DFC_StrtOvrTemp_C "DFES/Projektspezifische Applikationdaten (pro DSM Element) DFC_StrtOvrTemp" VALUE 0x8002B33E Val_Wu8 255.0 OneToOne 0.00 255.0 /end CHARACTERISTIC
/begin CHARACTERISTIC DFES_Severity.DFC_StrtSCB_C "DFES/Projektspezifische Applikationdaten (pro DSM Element) DFC_StrtSCB" VALUE 0x8002B33F Val_Wu8 255.0 OneToOne 0.00 255.0 /end CHARACTERISTIC
/begin CHARACTERISTIC DFES_Severity.DFC_StrtSCG_C "DFES/Projektspezifische Applikationdaten (pro DSM Element) DFC_StrtSCG" VALUE 0x8002B340 Val_Wu8 255.0 OneToOne 0.00 255.0 /end CHARACTERISTIC
/begin CHARACTERISTIC DFES_Severity.DFC_ThrVlvOL_C "DFES/Projektspezifische Applikationdaten (pro DSM Element) DFC_ThrVlvOL" VALUE 0x8002B341 Val_Wu8 255.0 OneToOne 0.00 255.0 /end CHARACTERISTIC
/begin CHARACTERISTIC DFES_Severity.DFC_ThrVlvOvrTemp_C "DFES/Projektspezifische Applikationdaten (pro DSM Element) DFC_ThrVlvOvrTemp" VALUE 0x8002B342 Val_Wu8 255.0 OneToOne 0.00 255.0 /end CHARACTERISTIC
/begin CHARACTERISTIC DFES_Severity.DFC_ThrVlvSCB_C "DFES/Projektspezifische Applikationdaten (pro DSM Element) DFC_ThrVlvSCB" VALUE 0x8002B343 Val_Wu8 255.0 OneToOne 0.00 255.0 /end CHARACTERISTIC
/begin CHARACTERISTIC DFES_Severity.DFC_TrbChOL_C "DFES/Projektspezifische Applikationdaten (pro DSM Element) DFC_TrbChOL" VALUE 0x8002B344 Val_Wu8 255.0 OneToOne 0.00 255.0 /end CHARACTERISTIC
/begin CHARACTERISTIC DFES_Severity.DFC_TrbChOvrTemp_C "DFES/Projektspezifische Applikationdaten (pro DSM Element) DFC_TrbChOvrTemp" VALUE 0x8002B345 Val_Wu8 255.0 OneToOne 0.00 255.0 /end CHARACTERISTIC
/begin CHARACTERISTIC DFES_Severity.DFC_TrbChSCB_C "DFES/Projektspezifische Applikationdaten (pro DSM Element) DFC_TrbChSCB" VALUE 0x8002B346 Val_Wu8 255.0 OneToOne 0.00 255.0 /end CHARACTERISTIC
/begin CHARACTERISTIC DFES_Severity.DFC_UDosVlvOL_C "DFES/" VALUE 0x8002B347 Val_Wu8 255.0 OneToOne 0.00 255.0 /end CHARACTERISTIC
/begin CHARACTERISTIC DFES_Severity.DFC_UDosVlvOvrTemp_C "DFES/" VALUE 0x8002B348 Val_Wu8 255.0 OneToOne 0.00 255.0 /end CHARACTERISTIC
/begin CHARACTERISTIC DFES_Severity.DFC_UDosVlvSCB_C "DFES/" VALUE 0x8002B349 Val_Wu8 255.0 OneToOne 0.00 255.0 /end CHARACTERISTIC
/begin CHARACTERISTIC DFES_Severity.DFC_UDosVlvSCG_C "DFES/" VALUE 0x8002B34A Val_Wu8 255.0 OneToOne 0.00 255.0 /end CHARACTERISTIC
/begin CHARACTERISTIC DFES_Severity.DFC_UPmpMotOL_C "DFES/" VALUE 0x8002B34B Val_Wu8 255.0 OneToOne 0.00 255.0 /end CHARACTERISTIC
/begin CHARACTERISTIC DFES_Severity.DFC_UPmpMotOvrTemp_C "DFES/" VALUE 0x8002B34C Val_Wu8 255.0 OneToOne 0.00 255.0 /end CHARACTERISTIC
/begin CHARACTERISTIC DFES_Severity.DFC_UPmpMotSCB_C "DFES/" VALUE 0x8002B34D Val_Wu8 255.0 OneToOne 0.00 255.0 /end CHARACTERISTIC
/begin CHARACTERISTIC DFES_Severity.DFC_UPmpMotSCG_C "DFES/" VALUE 0x8002B34E Val_Wu8 255.0 OneToOne 0.00 255.0 /end CHARACTERISTIC
/begin CHARACTERISTIC DFES_Severity.DFC_WaHtElOL_C "DFES/Projektspezifische Applikationdaten (pro DSM Element) DFC_WaHtElOL" VALUE 0x8002B34F Val_Wu8 255.0 OneToOne 0.00 255.0 /end CHARACTERISTIC
/begin CHARACTERISTIC DFES_Severity.DFC_WaHtElOvrTemp_C "DFES/Projektspezifische Applikationdaten (pro DSM Element) DFC_WaHtElOvrTemp" VALUE 0x8002B350 Val_Wu8 255.0 OneToOne 0.00 255.0 /end CHARACTERISTIC
/begin CHARACTERISTIC DFES_Severity.DFC_WaHtElSCB_C "DFES/Projektspezifische Applikationdaten (pro DSM Element) DFC_WaHtElSCB" VALUE 0x8002B351 Val_Wu8 255.0 OneToOne 0.00 255.0 /end CHARACTERISTIC
/begin CHARACTERISTIC DFES_Severity.DFC_IVActrUChSRCMax_C "DFES/Projektspezifische Applikationdaten (pro DSM Element) DFC_IVActrUChSRCMax" VALUE 0x8002B352 Val_Wu8 255.0 OneToOne 0.00 255.0 /end CHARACTERISTIC
/begin CHARACTERISTIC DFES_Severity.DFC_IVActrUChSRCMin_C "DFES/Projektspezifische Applikationdaten (pro DSM Element) DFC_IVActrUChSRCMin" VALUE 0x8002B353 Val_Wu8 255.0 OneToOne 0.00 255.0 /end CHARACTERISTIC
/begin CHARACTERISTIC DFES_Severity.DFC_IVActrVltgSRCMax_C "DFES/Projektspezifische Applikationdaten (pro DSM Element) DFC_IVActrVltgSRCMax" VALUE 0x8002B354 Val_Wu8 255.0 OneToOne 0.00 255.0 /end CHARACTERISTIC
/begin CHARACTERISTIC DFES_Severity.DFC_IVActrVltgSRCMin_C "DFES/Projektspezifische Applikationdaten (pro DSM Element) DFC_IVActrVltgSRCMin" VALUE 0x8002B355 Val_Wu8 255.0 OneToOne 0.00 255.0 /end CHARACTERISTIC
/begin CHARACTERISTIC DFES_Severity.DFC_IVDiaTunDet_C "DFES/" VALUE 0x8002B356 Val_Wu8 255.0 OneToOne 0.00 255.0 /end CHARACTERISTIC
/begin CHARACTERISTIC DFES_Severity.DFC_IVPSplyStopDCDC_C "DFES/Projektspezifische Applikationdaten (pro DSM Element) DFC_IVPSplyStopDCDC" VALUE 0x8002B357 Val_Wu8 255.0 OneToOne 0.00 255.0 /end CHARACTERISTIC
/begin CHARACTERISTIC DFES_Severity.DFC_IVPSplyVltgSRCMax_C "DFES/Projektspezifische Applikationdaten (pro DSM Element) DFC_IVPSplyVltgSRCMax" VALUE 0x8002B358 Val_Wu8 255.0 OneToOne 0.00 255.0 /end CHARACTERISTIC
/begin CHARACTERISTIC DFES_Severity.DFC_IVPSplyVltgSRCMin_C "DFES/Projektspezifische Applikationdaten (pro DSM Element) DFC_IVPSplyVltgSRCMin" VALUE 0x8002B359 Val_Wu8 255.0 OneToOne 0.00 255.0 /end CHARACTERISTIC
/begin CHARACTERISTIC DFES_Severity.DFC_SCREtaErr_C "DFES/" VALUE 0x8002B35A Val_Wu8 255.0 OneToOne 0.00 255.0 /end CHARACTERISTIC
/begin CHARACTERISTIC DFES_Severity.DFC_SCREtaErr1_C "DFES/" VALUE 0x8002B35B Val_Wu8 255.0 OneToOne 0.00 255.0 /end CHARACTERISTIC
/begin CHARACTERISTIC DFES_Severity.DFC_SCREtaErr2_C "DFES/" VALUE 0x8002B35C Val_Wu8 255.0 OneToOne 0.00 255.0 /end CHARACTERISTIC
/begin CHARACTERISTIC DFES_Severity.DFC_SCRMonMetCtlPresErr_C "DFES/" VALUE 0x8002B35D Val_Wu8 255.0 OneToOne 0.00 255.0 /end CHARACTERISTIC
/begin CHARACTERISTIC DFES_Severity.DFC_SCRMonPresBuildUpErr_C "DFES/" VALUE 0x8002B35E Val_Wu8 255.0 OneToOne 0.00 255.0 /end CHARACTERISTIC
/begin CHARACTERISTIC DFES_Severity.DFC_SCRMonPresRdcErr_C "DFES/" VALUE 0x8002B35F Val_Wu8 255.0 OneToOne 0.00 255.0 /end CHARACTERISTIC
/begin CHARACTERISTIC DFES_Severity.DFC_AFSOffsDrftMax_C "DFES/Projektspezifische Applikationdaten (pro DSM Element) DFC_AFSOffsDrftMax" VALUE 0x8002B360 Val_Wu8 255.0 OneToOne 0.00 255.0 /end CHARACTERISTIC
/begin CHARACTERISTIC DFES_Severity.DFC_AFSOffsDrftMin_C "DFES/Projektspezifische Applikationdaten (pro DSM Element) DFC_AFSOffsDrftMin" VALUE 0x8002B361 Val_Wu8 255.0 OneToOne 0.00 255.0 /end CHARACTERISTIC
/begin CHARACTERISTIC DFES_Severity.DFC_AFSSRCCorMax_C "DFES/Projektspezifische Applikationdaten (pro DSM Element) DFC_AFSSRCCorMax" VALUE 0x8002B362 Val_Wu8 255.0 OneToOne 0.00 255.0 /end CHARACTERISTIC
/begin CHARACTERISTIC DFES_Severity.DFC_AFSSRCCorMin_C "DFES/Projektspezifische Applikationdaten (pro DSM Element) DFC_AFSSRCCorMin" VALUE 0x8002B363 Val_Wu8 255.0 OneToOne 0.00 255.0 /end CHARACTERISTIC
/begin CHARACTERISTIC DFES_Severity.DFC_AFSSRCRawMax_C "DFES/Projektspezifische Applikationdaten (pro DSM Element) DFC_AFSSRCRawMax" VALUE 0x8002B364 Val_Wu8 255.0 OneToOne 0.00 255.0 /end CHARACTERISTIC
/begin CHARACTERISTIC DFES_Severity.DFC_AFSSRCRawMin_C "DFES/Projektspezifische Applikationdaten (pro DSM Element) DFC_AFSSRCRawMin" VALUE 0x8002B365 Val_Wu8 255.0 OneToOne 0.00 255.0 /end CHARACTERISTIC
/begin CHARACTERISTIC DFES_Severity.DFC_AFSSetyDrftMax_C "DFES/Projektspezifische Applikationdaten (pro DSM Element) DFC_AFSSetyDrftMax" VALUE 0x8002B366 Val_Wu8 255.0 OneToOne 0.00 255.0 /end CHARACTERISTIC
/begin CHARACTERISTIC DFES_Severity.DFC_AFSSetyDrftMin_C "DFES/Projektspezifische Applikationdaten (pro DSM Element) DFC_AFSSetyDrftMin" VALUE 0x8002B367 Val_Wu8 255.0 OneToOne 0.00 255.0 /end CHARACTERISTIC
/begin CHARACTERISTIC DFES_Severity.DFC_AirCSwtNpl_C "DFES/Projektspezifische Applikationdaten (pro DSM Element) DFC_AirCSwtNpl" VALUE 0x8002B368 Val_Wu8 255.0 OneToOne 0.00 255.0 /end CHARACTERISTIC
/begin CHARACTERISTIC DFES_Severity.DFC_AirCSwtSig_C "DFES/Projektspezifische Applikationdaten (pro DSM Element) DFC_AirCSwtSig" VALUE 0x8002B369 Val_Wu8 255.0 OneToOne 0.00 255.0 /end CHARACTERISTIC
/begin CHARACTERISTIC DFES_Severity.DFC_BattUSRCMax_C "DFES/Projektspezifische Applikationdaten (pro DSM Element) DFC_BattUSRCMax" VALUE 0x8002B36A Val_Wu8 255.0 OneToOne 0.00 255.0 /end CHARACTERISTIC
/begin CHARACTERISTIC DFES_Severity.DFC_BattUSRCMin_C "DFES/Projektspezifische Applikationdaten (pro DSM Element) DFC_BattUSRCMin" VALUE 0x8002B36B Val_Wu8 255.0 OneToOne 0.00 255.0 /end CHARACTERISTIC
/begin CHARACTERISTIC DFES_Severity.DFC_BrkNpl_C "DFES/Projektspezifische Applikationdaten (pro DSM Element) DFC_BrkNpl" VALUE 0x8002B36C Val_Wu8 255.0 OneToOne 0.00 255.0 /end CHARACTERISTIC
/begin CHARACTERISTIC DFES_Severity.DFC_BrkPSRCMax_C "DFES/Projektspezifische Applikationdaten (pro DSM Element) DFC_BrkPSRCMax" VALUE 0x8002B36D Val_Wu8 255.0 OneToOne 0.00 255.0 /end CHARACTERISTIC
/begin CHARACTERISTIC DFES_Severity.DFC_BrkPSRCMin_C "DFES/Projektspezifische Applikationdaten (pro DSM Element) DFC_BrkPSRCMin" VALUE 0x8002B36E Val_Wu8 255.0 OneToOne 0.00 255.0 /end CHARACTERISTIC
/begin CHARACTERISTIC DFES_Severity.DFC_CEngDsTSRCMax_C "DFES/Projektspezifische Applikationdaten (pro DSM Element) DFC_CEngDsTSRCMax" VALUE 0x8002B36F Val_Wu8 255.0 OneToOne 0.00 255.0 /end CHARACTERISTIC
/begin CHARACTERISTIC DFES_Severity.DFC_CEngDsTSRCMin_C "DFES/Projektspezifische Applikationdaten (pro DSM Element) DFC_CEngDsTSRCMin" VALUE 0x8002B370 Val_Wu8 255.0 OneToOne 0.00 255.0 /end CHARACTERISTIC
/begin CHARACTERISTIC DFES_Severity.DFC_CrCUIDet_C "DFES/Projektspezifische Applikationdaten (pro DSM Element) DFC_CrCUIDet" VALUE 0x8002B371 Val_Wu8 255.0 OneToOne 0.00 255.0 /end CHARACTERISTIC
/begin CHARACTERISTIC DFES_Severity.DFC_ECBVlvSRCMax_C "DFES/Projektspezifische Applikationdaten (pro DSM Element) DFC_ECBVlvSRCMax" VALUE 0x8002B372 Val_Wu8 255.0 OneToOne 0.00 255.0 /end CHARACTERISTIC
/begin CHARACTERISTIC DFES_Severity.DFC_ECBVlvSRCMin_C "DFES/Projektspezifische Applikationdaten (pro DSM Element) DFC_ECBVlvSRCMin" VALUE 0x8002B373 Val_Wu8 255.0 OneToOne 0.00 255.0 /end CHARACTERISTIC
/begin CHARACTERISTIC DFES_Severity.DFC_ECUOvrTemp_C "DFES/" VALUE 0x8002B374 Val_Wu8 255.0 OneToOne 0.00 255.0 /end CHARACTERISTIC
/begin CHARACTERISTIC DFES_Severity.DFC_EGRVlvGovDvtMax_C "DFES/Projektspezifische Applikationdaten (pro DSM Element) DFC_EGRVlvGovDvtMax" VALUE 0x8002B375 Val_Wu8 255.0 OneToOne 0.00 255.0 /end CHARACTERISTIC
/begin CHARACTERISTIC DFES_Severity.DFC_EGRVlvGovDvtMin_C "DFES/Projektspezifische Applikationdaten (pro DSM Element) DFC_EGRVlvGovDvtMin" VALUE 0x8002B376 Val_Wu8 255.0 OneToOne 0.00 255.0 /end CHARACTERISTIC
/begin CHARACTERISTIC DFES_Severity.DFC_EGRVlvHBrgOpnLd_C "DFES/Projektspezifische Applikationdaten (pro DSM Element) DFC_EGRVlvHBrgOpnLd" VALUE 0x8002B377 Val_Wu8 255.0 OneToOne 0.00 255.0 /end CHARACTERISTIC
/begin CHARACTERISTIC DFES_Severity.DFC_EGRVlvHBrgOvrCurr_C "DFES/Projektspezifische Applikationdaten (pro DSM Element) DFC_EGRVlvHBrgOvrCurr" VALUE 0x8002B378 Val_Wu8 255.0 OneToOne 0.00 255.0 /end CHARACTERISTIC
/begin CHARACTERISTIC DFES_Severity.DFC_EGRVlvHBrgOvrTemp_C "DFES/Projektspezifische Applikationdaten (pro DSM Element) DFC_EGRVlvHBrgOvrTemp" VALUE 0x8002B379 Val_Wu8 255.0 OneToOne 0.00 255.0 /end CHARACTERISTIC
/begin CHARACTERISTIC DFES_Severity.DFC_EGRVlvHBrgShCirBatt1_C "DFES/Projektspezifische Applikationdaten (pro DSM Element) DFC_EGRVlvHBrgShCirBatt1" VALUE 0x8002B37A Val_Wu8 255.0 OneToOne 0.00 255.0 /end CHARACTERISTIC
/begin CHARACTERISTIC DFES_Severity.DFC_EGRVlvHBrgShCirBatt2_C "DFES/Projektspezifische Applikationdaten (pro DSM Element) DFC_EGRVlvHBrgShCirBatt2" VALUE 0x8002B37B Val_Wu8 255.0 OneToOne 0.00 255.0 /end CHARACTERISTIC
/begin CHARACTERISTIC DFES_Severity.DFC_EGRVlvHBrgShCirGnd1_C "DFES/Projektspezifische Applikationdaten (pro DSM Element) DFC_EGRVlvHBrgShCirGnd1" VALUE 0x8002B37C Val_Wu8 255.0 OneToOne 0.00 255.0 /end CHARACTERISTIC
/begin CHARACTERISTIC DFES_Severity.DFC_EGRVlvHBrgShCirGnd2_C "DFES/Projektspezifische Applikationdaten (pro DSM Element) DFC_EGRVlvHBrgShCirGnd2" VALUE 0x8002B37D Val_Wu8 255.0 OneToOne 0.00 255.0 /end CHARACTERISTIC
/begin CHARACTERISTIC DFES_Severity.DFC_EGRVlvHBrgShCirOvrLd_C "DFES/Projektspezifische Applikationdaten (pro DSM Element) DFC_EGRVlvHBrgShCirOvrLd" VALUE 0x8002B37E Val_Wu8 255.0 OneToOne 0.00 255.0 /end CHARACTERISTIC
/begin CHARACTERISTIC DFES_Severity.DFC_EGRVlvHBrgTempOvrCurr_C "DFES/Projektspezifische Applikationdaten (pro DSM Element) DFC_EGRVlvHBrgTempOvrCurr" VALUE 0x8002B37F Val_Wu8 255.0 OneToOne 0.00 255.0 /end CHARACTERISTIC
/begin CHARACTERISTIC DFES_Severity.DFC_EGRVlvHBrgUndrVltg_C "DFES/Projektspezifische Applikationdaten (pro DSM Element) DFC_EGRVlvHBrgUndrVltg" VALUE 0x8002B380 Val_Wu8 255.0 OneToOne 0.00 255.0 /end CHARACTERISTIC
/begin CHARACTERISTIC DFES_Severity.DFC_EGRVlvLPGovDvtMax_C "DFES/" VALUE 0x8002B381 Val_Wu8 255.0 OneToOne 0.00 255.0 /end CHARACTERISTIC
/begin CHARACTERISTIC DFES_Severity.DFC_EGRVlvLPGovDvtMin_C "DFES/" VALUE 0x8002B382 Val_Wu8 255.0 OneToOne 0.00 255.0 /end CHARACTERISTIC
/begin CHARACTERISTIC DFES_Severity.DFC_EGRVlvLPHBrgOpnLd_C "DFES/" VALUE 0x8002B383 Val_Wu8 255.0 OneToOne 0.00 255.0 /end CHARACTERISTIC
/begin CHARACTERISTIC DFES_Severity.DFC_EGRVlvLPHBrgOvrCurr_C "DFES/" VALUE 0x8002B384 Val_Wu8 255.0 OneToOne 0.00 255.0 /end CHARACTERISTIC
/begin CHARACTERISTIC DFES_Severity.DFC_EGRVlvLPHBrgOvrTemp_C "DFES/" VALUE 0x8002B385 Val_Wu8 255.0 OneToOne 0.00 255.0 /end CHARACTERISTIC
/begin CHARACTERISTIC DFES_Severity.DFC_EGRVlvLPHBrgShCirBatt1_C "DFES/" VALUE 0x8002B386 Val_Wu8 255.0 OneToOne 0.00 255.0 /end CHARACTERISTIC
/begin CHARACTERISTIC DFES_Severity.DFC_EGRVlvLPHBrgShCirBatt2_C "DFES/" VALUE 0x8002B387 Val_Wu8 255.0 OneToOne 0.00 255.0 /end CHARACTERISTIC
/begin CHARACTERISTIC DFES_Severity.DFC_EGRVlvLPHBrgShCirGnd1_C "DFES/" VALUE 0x8002B388 Val_Wu8 255.0 OneToOne 0.00 255.0 /end CHARACTERISTIC
/begin CHARACTERISTIC DFES_Severity.DFC_EGRVlvLPHBrgShCirGnd2_C "DFES/" VALUE 0x8002B389 Val_Wu8 255.0 OneToOne 0.00 255.0 /end CHARACTERISTIC
/begin CHARACTERISTIC DFES_Severity.DFC_EGRVlvLPHBrgShCirOvrLd_C "DFES/" VALUE 0x8002B38A Val_Wu8 255.0 OneToOne 0.00 255.0 /end CHARACTERISTIC
/begin CHARACTERISTIC DFES_Severity.DFC_EGRVlvLPHBrgTempOvrCurr_C "DFES/" VALUE 0x8002B38B Val_Wu8 255.0 OneToOne 0.00 255.0 /end CHARACTERISTIC
/begin CHARACTERISTIC DFES_Severity.DFC_EGRVlvLPHBrgUndrVltg_C "DFES/" VALUE 0x8002B38C Val_Wu8 255.0 OneToOne 0.00 255.0 /end CHARACTERISTIC
/begin CHARACTERISTIC DFES_Severity.DFC_EGRVlvLPOL_C "DFES/" VALUE 0x8002B38D Val_Wu8 255.0 OneToOne 0.00 255.0 /end CHARACTERISTIC
/begin CHARACTERISTIC DFES_Severity.DFC_EGRVlvLPSCB_C "DFES/" VALUE 0x8002B38E Val_Wu8 255.0 OneToOne 0.00 255.0 /end CHARACTERISTIC
/begin CHARACTERISTIC DFES_Severity.DFC_EGRVlvLPSCG_C "DFES/" VALUE 0x8002B38F Val_Wu8 255.0 OneToOne 0.00 255.0 /end CHARACTERISTIC
/begin CHARACTERISTIC DFES_Severity.DFC_EGRVlvLPSRCMax_C "DFES/" VALUE 0x8002B390 Val_Wu8 255.0 OneToOne 0.00 255.0 /end CHARACTERISTIC
/begin CHARACTERISTIC DFES_Severity.DFC_EGRVlvLPSRCMin_C "DFES/" VALUE 0x8002B391 Val_Wu8 255.0 OneToOne 0.00 255.0 /end CHARACTERISTIC
/begin CHARACTERISTIC DFES_Severity.DFC_EGRVlvOL_C "DFES/Projektspezifische Applikationdaten (pro DSM Element) DFC_EGRVlvOL" VALUE 0x8002B392 Val_Wu8 255.0 OneToOne 0.00 255.0 /end CHARACTERISTIC
/begin CHARACTERISTIC DFES_Severity.DFC_EGRVlvSCB_C "DFES/Projektspezifische Applikationdaten (pro DSM Element) DFC_EGRVlvSCB" VALUE 0x8002B393 Val_Wu8 255.0 OneToOne 0.00 255.0 /end CHARACTERISTIC
/begin CHARACTERISTIC DFES_Severity.DFC_EGRVlvSCG_C "DFES/Projektspezifische Applikationdaten (pro DSM Element) DFC_EGRVlvSCG" VALUE 0x8002B394 Val_Wu8 255.0 OneToOne 0.00 255.0 /end CHARACTERISTIC
/begin CHARACTERISTIC DFES_Severity.DFC_EGRVlvSRCMax_C "DFES/Projektspezifische Applikationdaten (pro DSM Element) DFC_EGRVlvSRCMax" VALUE 0x8002B395 Val_Wu8 255.0 OneToOne 0.00 255.0 /end CHARACTERISTIC
/begin CHARACTERISTIC DFES_Severity.DFC_EGRVlvSRCMin_C "DFES/Projektspezifische Applikationdaten (pro DSM Element) DFC_EGRVlvSRCMin" VALUE 0x8002B396 Val_Wu8 255.0 OneToOne 0.00 255.0 /end CHARACTERISTIC
/begin CHARACTERISTIC DFES_Severity.DFC_EngPrtOvrSpd_C "DFES/Projektspezifische Applikationdaten (pro DSM Element) DFC_EngPrtOvrSpd" VALUE 0x8002B397 Val_Wu8 255.0 OneToOne 0.00 255.0 /end CHARACTERISTIC
/begin CHARACTERISTIC DFES_Severity.DFC_EngSpdOL_C "DFES/Projektspezifische Applikationdaten (pro DSM Element) DFC_EngSpdOL" VALUE 0x8002B398 Val_Wu8 255.0 OneToOne 0.00 255.0 /end CHARACTERISTIC
/begin CHARACTERISTIC DFES_Severity.DFC_EngSpdSCB_C "DFES/Projektspezifische Applikationdaten (pro DSM Element) DFC_EngSpdSCB" VALUE 0x8002B399 Val_Wu8 255.0 OneToOne 0.00 255.0 /end CHARACTERISTIC
/begin CHARACTERISTIC DFES_Severity.DFC_EngSpdSCG_C "DFES/Projektspezifische Applikationdaten (pro DSM Element) DFC_EngSpdSCG" VALUE 0x8002B39A Val_Wu8 255.0 OneToOne 0.00 255.0 /end CHARACTERISTIC
/begin CHARACTERISTIC DFES_Severity.DFC_EnhSRCMaxPPFltDiff_C "DFES/Projektspezifische Applikationdaten (pro DSM Element) DFC_EnhSRCMaxPPFltDiff" VALUE 0x8002B39B Val_Wu8 255.0 OneToOne 0.00 255.0 /end CHARACTERISTIC
/begin CHARACTERISTIC DFES_Severity.DFC_EnhSRCMaxT1ExhTMon_C "DFES/Projektspezifische Applikationdaten (pro DSM Element) DFC_EnhSRCMaxT1ExhTMon" VALUE 0x8002B39C Val_Wu8 255.0 OneToOne 0.00 255.0 /end CHARACTERISTIC
/begin CHARACTERISTIC DFES_Severity.DFC_EnhSRCMaxT2ExhTMon_C "DFES/Projektspezifische Applikationdaten (pro DSM Element) DFC_EnhSRCMaxT2ExhTMon" VALUE 0x8002B39D Val_Wu8 255.0 OneToOne 0.00 255.0 /end CHARACTERISTIC
/begin CHARACTERISTIC DFES_Severity.DFC_EnhSRCMaxT3ExhTMon_C "DFES/Projektspezifische Applikationdaten (pro DSM Element) DFC_EnhSRCMaxT3ExhTMon" VALUE 0x8002B39E Val_Wu8 255.0 OneToOne 0.00 255.0 /end CHARACTERISTIC
/begin CHARACTERISTIC DFES_Severity.DFC_EnhSRCMinPPFltDiff_C "DFES/Projektspezifische Applikationdaten (pro DSM Element) DFC_EnhSRCMinPPFltDiff" VALUE 0x8002B39F Val_Wu8 255.0 OneToOne 0.00 255.0 /end CHARACTERISTIC
/begin CHARACTERISTIC DFES_Severity.DFC_EnhSRCMinT1ExhTMon_C "DFES/Projektspezifische Applikationdaten (pro DSM Element) DFC_EnhSRCMinT1ExhTMon" VALUE 0x8002B3A0 Val_Wu8 255.0 OneToOne 0.00 255.0 /end CHARACTERISTIC
/begin CHARACTERISTIC DFES_Severity.DFC_EnhSRCMinT2ExhTMon_C "DFES/Projektspezifische Applikationdaten (pro DSM Element) DFC_EnhSRCMinT2ExhTMon" VALUE 0x8002B3A1 Val_Wu8 255.0 OneToOne 0.00 255.0 /end CHARACTERISTIC
/begin CHARACTERISTIC DFES_Severity.DFC_EnhSRCMinT3ExhTMon_C "DFES/Projektspezifische Applikationdaten (pro DSM Element) DFC_EnhSRCMinT3ExhTMon" VALUE 0x8002B3A2 Val_Wu8 255.0 OneToOne 0.00 255.0 /end CHARACTERISTIC
/begin CHARACTERISTIC DFES_Severity.DFC_EnvPSRCMax_C "DFES/Projektspezifische Applikationdaten (pro DSM Element) DFC_EnvPSRCMax" VALUE 0x8002B3A3 Val_Wu8 255.0 OneToOne 0.00 255.0 /end CHARACTERISTIC
/begin CHARACTERISTIC DFES_Severity.DFC_EnvPSRCMin_C "DFES/Projektspezifische Applikationdaten (pro DSM Element) DFC_EnvPSRCMin" VALUE 0x8002B3A4 Val_Wu8 255.0 OneToOne 0.00 255.0 /end CHARACTERISTIC
/begin CHARACTERISTIC DFES_Severity.DFC_ExhTMonPlaus_C "DFES/Projektspezifische Applikationdaten (pro DSM Element) DFC_ExhTMonPlaus" VALUE 0x8002B3A5 Val_Wu8 255.0 OneToOne 0.00 255.0 /end CHARACTERISTIC
/begin CHARACTERISTIC DFES_Severity.DFC_ExhTMonPlausPos1_C "DFES/Projektspezifische Applikationdaten (pro DSM Element) DFC_ExhTMonPlausPos1" VALUE 0x8002B3A6 Val_Wu8 255.0 OneToOne 0.00 255.0 /end CHARACTERISTIC
/begin CHARACTERISTIC DFES_Severity.DFC_ExhTMonPlausPos2_C "DFES/Projektspezifische Applikationdaten (pro DSM Element) DFC_ExhTMonPlausPos2" VALUE 0x8002B3A7 Val_Wu8 255.0 OneToOne 0.00 255.0 /end CHARACTERISTIC
/begin CHARACTERISTIC DFES_Severity.DFC_ExhTMonPlausPos3_C "DFES/Projektspezifische Applikationdaten (pro DSM Element) DFC_ExhTMonPlausPos3" VALUE 0x8002B3A8 Val_Wu8 255.0 OneToOne 0.00 255.0 /end CHARACTERISTIC
/begin CHARACTERISTIC DFES_Severity.DFC_ExhTMonT1Plaus_C "DFES/Projektspezifische Applikationdaten (pro DSM Element) DFC_ExhTMonT1Plaus" VALUE 0x8002B3A9 Val_Wu8 255.0 OneToOne 0.00 255.0 /end CHARACTERISTIC
/begin CHARACTERISTIC DFES_Severity.DFC_ExhTMonT2Plaus_C "DFES/Projektspezifische Applikationdaten (pro DSM Element) DFC_ExhTMonT2Plaus" VALUE 0x8002B3AA Val_Wu8 255.0 OneToOne 0.00 255.0 /end CHARACTERISTIC
/begin CHARACTERISTIC DFES_Severity.DFC_ExhTMonT3Plaus_C "DFES/Projektspezifische Applikationdaten (pro DSM Element) DFC_ExhTMonT3Plaus" VALUE 0x8002B3AB Val_Wu8 255.0 OneToOne 0.00 255.0 /end CHARACTERISTIC
/begin CHARACTERISTIC DFES_Severity.DFC_FlFltDsPSRCMax_C "DFES/Projektspezifische Applikationdaten (pro DSM Element) DFC_FlFltDsPSRCMax" VALUE 0x8002B3AC Val_Wu8 255.0 OneToOne 0.00 255.0 /end CHARACTERISTIC
/begin CHARACTERISTIC DFES_Severity.DFC_FlFltDsPSRCMin_C "DFES/Projektspezifische Applikationdaten (pro DSM Element) DFC_FlFltDsPSRCMin" VALUE 0x8002B3AD Val_Wu8 255.0 OneToOne 0.00 255.0 /end CHARACTERISTIC
/begin CHARACTERISTIC DFES_Severity.DFC_FlFltSig_C "DFES/Projektspezifische Applikationdaten (pro DSM Element) DFC_FlFltSig" VALUE 0x8002B3AE Val_Wu8 255.0 OneToOne 0.00 255.0 /end CHARACTERISTIC
/begin CHARACTERISTIC DFES_Severity.DFC_FlFltUsPSRCMax_C "DFES/Projektspezifische Applikationdaten (pro DSM Element) DFC_FlFltUsPSRCMax" VALUE 0x8002B3AF Val_Wu8 255.0 OneToOne 0.00 255.0 /end CHARACTERISTIC
/begin CHARACTERISTIC DFES_Severity.DFC_FlFltUsPSRCMin_C "DFES/Projektspezifische Applikationdaten (pro DSM Element) DFC_FlFltUsPSRCMin" VALUE 0x8002B3B0 Val_Wu8 255.0 OneToOne 0.00 255.0 /end CHARACTERISTIC
/begin CHARACTERISTIC DFES_Severity.DFC_FuelTSRCMax_C "DFES/Projektspezifische Applikationdaten (pro DSM Element) DFC_FuelTSRCMax" VALUE 0x8002B3B1 Val_Wu8 255.0 OneToOne 0.00 255.0 /end CHARACTERISTIC
/begin CHARACTERISTIC DFES_Severity.DFC_FuelTSRCMin_C "DFES/Projektspezifische Applikationdaten (pro DSM Element) DFC_FuelTSRCMin" VALUE 0x8002B3B2 Val_Wu8 255.0 OneToOne 0.00 255.0 /end CHARACTERISTIC
/begin CHARACTERISTIC DFES_Severity.DFC_GbxNPosPPerSRCMax_C "DFES/Projektspezifische Applikationdaten (pro DSM Element) DFC_GbxNPosPPerSRCMax" VALUE 0x8002B3B3 Val_Wu8 255.0 OneToOne 0.00 255.0 /end CHARACTERISTIC
/begin CHARACTERISTIC DFES_Severity.DFC_GbxNPosPPerSRCMin_C "DFES/Projektspezifische Applikationdaten (pro DSM Element) DFC_GbxNPosPPerSRCMin" VALUE 0x8002B3B4 Val_Wu8 255.0 OneToOne 0.00 255.0 /end CHARACTERISTIC
/begin CHARACTERISTIC DFES_Severity.DFC_GbxNPosPdcycSRCMax_C "DFES/Projektspezifische Applikationdaten (pro DSM Element) DFC_GbxNPosPdcycSRCMax" VALUE 0x8002B3B5 Val_Wu8 255.0 OneToOne 0.00 255.0 /end CHARACTERISTIC
/begin CHARACTERISTIC DFES_Severity.DFC_GbxNPosPdcycSRCMin_C "DFES/Projektspezifische Applikationdaten (pro DSM Element) DFC_GbxNPosPdcycSRCMin" VALUE 0x8002B3B6 Val_Wu8 255.0 OneToOne 0.00 255.0 /end CHARACTERISTIC
/begin CHARACTERISTIC DFES_Severity.DFC_InjVlvPresMin_C "DFES/Projektspezifische Applikationdaten (pro DSM Element) DFC_InjVlvPresMin" VALUE 0x8002B3B7 Val_Wu8 255.0 OneToOne 0.00 255.0 /end CHARACTERISTIC
/begin CHARACTERISTIC DFES_Severity.DFC_LSUCircNernstSig_C "DFES/Projektspezifische Applikationdaten (pro DSM Element) DFC_LSUCircNernstSig" VALUE 0x8002B3B8 Val_Wu8 255.0 OneToOne 0.00 255.0 /end CHARACTERISTIC
/begin CHARACTERISTIC DFES_Severity.DFC_LSUCircPmpCurSig_C "DFES/Projektspezifische Applikationdaten (pro DSM Element) DFC_LSUCircPmpCurSig" VALUE 0x8002B3B9 Val_Wu8 255.0 OneToOne 0.00 255.0 /end CHARACTERISTIC
/begin CHARACTERISTIC DFES_Severity.DFC_LSUCircVirtGndSig_C "DFES/Projektspezifische Applikationdaten (pro DSM Element) DFC_LSUCircVirtGndSig" VALUE 0x8002B3BA Val_Wu8 255.0 OneToOne 0.00 255.0 /end CHARACTERISTIC
/begin CHARACTERISTIC DFES_Severity.DFC_LSUO2Max_C "DFES/Projektspezifische Applikationdaten (pro DSM Element) DFC_LSUO2Max" VALUE 0x8002B3BB Val_Wu8 255.0 OneToOne 0.00 255.0 /end CHARACTERISTIC
/begin CHARACTERISTIC DFES_Severity.DFC_LSUO2Min_C "DFES/Projektspezifische Applikationdaten (pro DSM Element) DFC_LSUO2Min" VALUE 0x8002B3BC Val_Wu8 255.0 OneToOne 0.00 255.0 /end CHARACTERISTIC
/begin CHARACTERISTIC DFES_Severity.DFC_LSUSPIBattLowMin_C "DFES/Projektspezifische Applikationdaten (pro DSM Element) DFC_LSUSPIBattLowMin" VALUE 0x8002B3BD Val_Wu8 255.0 OneToOne 0.00 255.0 /end CHARACTERISTIC
/begin CHARACTERISTIC DFES_Severity.DFC_LSUWireSCB_C "DFES/Projektspezifische Applikationdaten (pro DSM Element) DFC_LSUWireSCB" VALUE 0x8002B3BE Val_Wu8 255.0 OneToOne 0.00 255.0 /end CHARACTERISTIC
/begin CHARACTERISTIC DFES_Severity.DFC_LSUWireSCG_C "DFES/Projektspezifische Applikationdaten (pro DSM Element) DFC_LSUWireSCG" VALUE 0x8002B3BF Val_Wu8 255.0 OneToOne 0.00 255.0 /end CHARACTERISTIC
/begin CHARACTERISTIC DFES_Severity.DFC_MeUnSCG_C "DFES/Projektspezifische Applikationdaten (pro DSM Element) DFC_MeUnSCG" VALUE 0x8002B3C0 Val_Wu8 255.0 OneToOne 0.00 255.0 /end CHARACTERISTIC
/begin CHARACTERISTIC DFES_Severity.DFC_NSCDsCmpChk_C "DFES/" VALUE 0x8002B3C1 Val_Wu8 255.0 OneToOne 0.00 255.0 /end CHARACTERISTIC
/begin CHARACTERISTIC DFES_Severity.DFC_NSCDsLamBinSRCMax_C "DFES/" VALUE 0x8002B3C2 Val_Wu8 255.0 OneToOne 0.00 255.0 /end CHARACTERISTIC
/begin CHARACTERISTIC DFES_Severity.DFC_NSCDsLamBinSRCMin_C "DFES/" VALUE 0x8002B3C3 Val_Wu8 255.0 OneToOne 0.00 255.0 /end CHARACTERISTIC
/begin CHARACTERISTIC DFES_Severity.DFC_NSCDsLamLinSRCMax_C "DFES/" VALUE 0x8002B3C4 Val_Wu8 255.0 OneToOne 0.00 255.0 /end CHARACTERISTIC
/begin CHARACTERISTIC DFES_Severity.DFC_NSCDsLamLinSRCMin_C "DFES/" VALUE 0x8002B3C5 Val_Wu8 255.0 OneToOne 0.00 255.0 /end CHARACTERISTIC
/begin CHARACTERISTIC DFES_Severity.DFC_NSCDsLamPlausMax_C "DFES/" VALUE 0x8002B3C6 Val_Wu8 255.0 OneToOne 0.00 255.0 /end CHARACTERISTIC
/begin CHARACTERISTIC DFES_Severity.DFC_NSCDsLamPlausMin_C "DFES/" VALUE 0x8002B3C7 Val_Wu8 255.0 OneToOne 0.00 255.0 /end CHARACTERISTIC
/begin CHARACTERISTIC DFES_Severity.DFC_NSCDsNOxSRCMax_C "DFES/" VALUE 0x8002B3C8 Val_Wu8 255.0 OneToOne 0.00 255.0 /end CHARACTERISTIC
/begin CHARACTERISTIC DFES_Severity.DFC_NSCDsNOxSRCMin_C "DFES/" VALUE 0x8002B3C9 Val_Wu8 255.0 OneToOne 0.00 255.0 /end CHARACTERISTIC
/begin CHARACTERISTIC DFES_Severity.DFC_NSCDsOpCir_C "DFES/" VALUE 0x8002B3CA Val_Wu8 255.0 OneToOne 0.00 255.0 /end CHARACTERISTIC
/begin CHARACTERISTIC DFES_Severity.DFC_NSCDsShCir_C "DFES/" VALUE 0x8002B3CB Val_Wu8 255.0 OneToOne 0.00 255.0 /end CHARACTERISTIC
/begin CHARACTERISTIC DFES_Severity.DFC_NoCat2DsCmpChk_C "DFES/" VALUE 0x8002B3CC Val_Wu8 255.0 OneToOne 0.00 255.0 /end CHARACTERISTIC
/begin CHARACTERISTIC DFES_Severity.DFC_NoCat2DsLamBinSRCMax_C "DFES/" VALUE 0x8002B3CD Val_Wu8 255.0 OneToOne 0.00 255.0 /end CHARACTERISTIC
/begin CHARACTERISTIC DFES_Severity.DFC_NoCat2DsLamBinSRCMin_C "DFES/" VALUE 0x8002B3CE Val_Wu8 255.0 OneToOne 0.00 255.0 /end CHARACTERISTIC
/begin CHARACTERISTIC DFES_Severity.DFC_NoCat2DsLamLinSRCMax_C "DFES/" VALUE 0x8002B3CF Val_Wu8 255.0 OneToOne 0.00 255.0 /end CHARACTERISTIC
/begin CHARACTERISTIC DFES_Severity.DFC_NoCat2DsLamLinSRCMin_C "DFES/" VALUE 0x8002B3D0 Val_Wu8 255.0 OneToOne 0.00 255.0 /end CHARACTERISTIC
/begin CHARACTERISTIC DFES_Severity.DFC_NoCat2DsLamPlausMax_C "DFES/" VALUE 0x8002B3D1 Val_Wu8 255.0 OneToOne 0.00 255.0 /end CHARACTERISTIC
/begin CHARACTERISTIC DFES_Severity.DFC_NoCat2DsLamPlausMin_C "DFES/" VALUE 0x8002B3D2 Val_Wu8 255.0 OneToOne 0.00 255.0 /end CHARACTERISTIC
/begin CHARACTERISTIC DFES_Severity.DFC_NoCat2DsNOxSRCMax_C "DFES/" VALUE 0x8002B3D3 Val_Wu8 255.0 OneToOne 0.00 255.0 /end CHARACTERISTIC
/begin CHARACTERISTIC DFES_Severity.DFC_NoCat2DsNOxSRCMin_C "DFES/" VALUE 0x8002B3D4 Val_Wu8 255.0 OneToOne 0.00 255.0 /end CHARACTERISTIC
/begin CHARACTERISTIC DFES_Severity.DFC_NoCat2DsOpCir_C "DFES/" VALUE 0x8002B3D5 Val_Wu8 255.0 OneToOne 0.00 255.0 /end CHARACTERISTIC
/begin CHARACTERISTIC DFES_Severity.DFC_NoCat2DsShCir_C "DFES/" VALUE 0x8002B3D6 Val_Wu8 255.0 OneToOne 0.00 255.0 /end CHARACTERISTIC
/begin CHARACTERISTIC DFES_Severity.DFC_NplDynPPFltDiff_C "DFES/Projektspezifische Applikationdaten (pro DSM Element) DFC_NplDynPPFltDiff" VALUE 0x8002B3D7 Val_Wu8 255.0 OneToOne 0.00 255.0 /end CHARACTERISTIC
/begin CHARACTERISTIC DFES_Severity.DFC_NplHsChngPPFltDiff_C "DFES/Projektspezifische Applikationdaten (pro DSM Element) DFC_NplHsChngPPFltDiff" VALUE 0x8002B3D8 Val_Wu8 255.0 OneToOne 0.00 255.0 /end CHARACTERISTIC
/begin CHARACTERISTIC DFES_Severity.DFC_NplHsLnPPFltDiff_C "DFES/Projektspezifische Applikationdaten (pro DSM Element) DFC_NplHsLnPPFltDiff" VALUE 0x8002B3D9 Val_Wu8 255.0 OneToOne 0.00 255.0 /end CHARACTERISTIC
/begin CHARACTERISTIC DFES_Severity.DFC_NplTOxiCatUs_C "DFES/Projektspezifische Applikationdaten (pro DSM Element) DFC_NplTOxiCatUs" VALUE 0x8002B3DA Val_Wu8 255.0 OneToOne 0.00 255.0 /end CHARACTERISTIC
/begin CHARACTERISTIC DFES_Severity.DFC_NplTPFltUs_C "DFES/Projektspezifische Applikationdaten (pro DSM Element) DFC_NplTPFltUs" VALUE 0x8002B3DB Val_Wu8 255.0 OneToOne 0.00 255.0 /end CHARACTERISTIC
/begin CHARACTERISTIC DFES_Severity.DFC_NplTTrbnUs_C "DFES/" VALUE 0x8002B3DC Val_Wu8 255.0 OneToOne 0.00 255.0 /end CHARACTERISTIC
/begin CHARACTERISTIC DFES_Severity.DFC_OilPSwmpSRCMax_C "DFES/Projektspezifische Applikationdaten (pro DSM Element) DFC_OilPSwmpSRCMax" VALUE 0x8002B3DD Val_Wu8 255.0 OneToOne 0.00 255.0 /end CHARACTERISTIC
/begin CHARACTERISTIC DFES_Severity.DFC_OilPSwmpSRCMin_C "DFES/Projektspezifische Applikationdaten (pro DSM Element) DFC_OilPSwmpSRCMin" VALUE 0x8002B3DE Val_Wu8 255.0 OneToOne 0.00 255.0 /end CHARACTERISTIC
/begin CHARACTERISTIC DFES_Severity.DFC_PCVSCG_C "DFES/Projektspezifische Applikationdaten (pro DSM Element) DFC_PCVSCG" VALUE 0x8002B3DF Val_Wu8 255.0 OneToOne 0.00 255.0 /end CHARACTERISTIC
/begin CHARACTERISTIC DFES_Severity.DFC_PFltCharPDiffMin_C "DFES/Projektspezifische Applikationdaten (pro DSM Element) DFC_PFltCharPDiffMin" VALUE 0x8002B3E0 Val_Wu8 255.0 OneToOne 0.00 255.0 /end CHARACTERISTIC
/begin CHARACTERISTIC DFES_Severity.DFC_PFltDstrMin_C "DFES/Projektspezifische Applikationdaten (pro DSM Element) DFC_PFltDstrMin" VALUE 0x8002B3E1 Val_Wu8 255.0 OneToOne 0.00 255.0 /end CHARACTERISTIC
/begin CHARACTERISTIC DFES_Severity.DFC_PFltEngPrt_C "DFES/Projektspezifische Applikationdaten (pro DSM Element) DFC_PFltEngPrt" VALUE 0x8002B3E2 Val_Wu8 255.0 OneToOne 0.00 255.0 /end CHARACTERISTIC
/begin CHARACTERISTIC DFES_Severity.DFC_PFltRgnPerm_C "DFES/Projektspezifische Applikationdaten (pro DSM Element) DFC_PFltRgnPerm" VALUE 0x8002B3E3 Val_Wu8 255.0 OneToOne 0.00 255.0 /end CHARACTERISTIC
/begin CHARACTERISTIC DFES_Severity.DFC_PFltSRCMaxFlwRstn_C "DFES/Projektspezifische Applikationdaten (pro DSM Element) DFC_PFltSRCMaxFlwRstn" VALUE 0x8002B3E4 Val_Wu8 255.0 OneToOne 0.00 255.0 /end CHARACTERISTIC
/begin CHARACTERISTIC DFES_Severity.DFC_PFltSRCMinFlwRstn_C "DFES/Projektspezifische Applikationdaten (pro DSM Element) DFC_PFltSRCMinFlwRstn" VALUE 0x8002B3E5 Val_Wu8 255.0 OneToOne 0.00 255.0 /end CHARACTERISTIC
/begin CHARACTERISTIC DFES_Severity.DFC_PFltSotMsDvtMax_C "DFES/Projektspezifische Applikationdaten (pro DSM Element) DFC_PFltSotMsDvtMax" VALUE 0x8002B3E6 Val_Wu8 255.0 OneToOne 0.00 255.0 /end CHARACTERISTIC
/begin CHARACTERISTIC DFES_Severity.DFC_PFltSotMsDvtMin_C "DFES/Projektspezifische Applikationdaten (pro DSM Element) DFC_PFltSotMsDvtMin" VALUE 0x8002B3E7 Val_Wu8 255.0 OneToOne 0.00 255.0 /end CHARACTERISTIC
/begin CHARACTERISTIC DFES_Severity.DFC_PFltSotMsMax_C "DFES/Projektspezifische Applikationdaten (pro DSM Element) DFC_PFltSotMsMax" VALUE 0x8002B3E8 Val_Wu8 255.0 OneToOne 0.00 255.0 /end CHARACTERISTIC
/begin CHARACTERISTIC DFES_Severity.DFC_PIntkVUsSRCMax_C "DFES/Projektspezifische Applikationdaten (pro DSM Element) DFC_PIntkVUsSRCMax" VALUE 0x8002B3E9 Val_Wu8 255.0 OneToOne 0.00 255.0 /end CHARACTERISTIC
/begin CHARACTERISTIC DFES_Severity.DFC_PIntkVUsSRCMin_C "DFES/Projektspezifische Applikationdaten (pro DSM Element) DFC_PIntkVUsSRCMin" VALUE 0x8002B3EA Val_Wu8 255.0 OneToOne 0.00 255.0 /end CHARACTERISTIC
/begin CHARACTERISTIC DFES_Severity.DFC_SRCHighAPP1_C "DFES/Projektspezifische Applikationdaten (pro DSM Element) DFC_SRCHighAPP1" VALUE 0x8002B3EB Val_Wu8 255.0 OneToOne 0.00 255.0 /end CHARACTERISTIC
/begin CHARACTERISTIC DFES_Severity.DFC_SRCHighAPP2_C "DFES/Projektspezifische Applikationdaten (pro DSM Element) DFC_SRCHighAPP2" VALUE 0x8002B3EC Val_Wu8 255.0 OneToOne 0.00 255.0 /end CHARACTERISTIC
/begin CHARACTERISTIC DFES_Severity.DFC_SRCLowAPP1_C "DFES/Projektspezifische Applikationdaten (pro DSM Element) DFC_SRCLowAPP1" VALUE 0x8002B3ED Val_Wu8 255.0 OneToOne 0.00 255.0 /end CHARACTERISTIC
/begin CHARACTERISTIC DFES_Severity.DFC_SRCLowAPP2_C "DFES/Projektspezifische Applikationdaten (pro DSM Element) DFC_SRCLowAPP2" VALUE 0x8002B3EE Val_Wu8 255.0 OneToOne 0.00 255.0 /end CHARACTERISTIC
/begin CHARACTERISTIC DFES_Severity.DFC_SRCMaxPPFltDiff_C "DFES/Projektspezifische Applikationdaten (pro DSM Element) DFC_SRCMaxPPFltDiff" VALUE 0x8002B3EF Val_Wu8 255.0 OneToOne 0.00 255.0 /end CHARACTERISTIC
/begin CHARACTERISTIC DFES_Severity.DFC_SRCMaxPPFltUs_C "DFES/Projektspezifische Applikationdaten (pro DSM Element) DFC_SRCMaxPPFltUs" VALUE 0x8002B3F0 Val_Wu8 255.0 OneToOne 0.00 255.0 /end CHARACTERISTIC
/begin CHARACTERISTIC DFES_Severity.DFC_SRCMaxTECU_C "DFES/Projektspezifische Applikationdaten (pro DSM Element) DFC_SRCMaxTECU" VALUE 0x8002B3F1 Val_Wu8 255.0 OneToOne 0.00 255.0 /end CHARACTERISTIC
/begin CHARACTERISTIC DFES_Severity.DFC_SRCMaxTOxiCatUs_C "DFES/Projektspezifische Applikationdaten (pro DSM Element) DFC_SRCMaxTOxiCatUs" VALUE 0x8002B3F2 Val_Wu8 255.0 OneToOne 0.00 255.0 /end CHARACTERISTIC
/begin CHARACTERISTIC DFES_Severity.DFC_SRCMaxTPFltUs_C "DFES/Projektspezifische Applikationdaten (pro DSM Element) DFC_SRCMaxTPFltUs" VALUE 0x8002B3F3 Val_Wu8 255.0 OneToOne 0.00 255.0 /end CHARACTERISTIC
/begin CHARACTERISTIC DFES_Severity.DFC_SRCMaxTTrbnUs_C "DFES/" VALUE 0x8002B3F4 Val_Wu8 255.0 OneToOne 0.00 255.0 /end CHARACTERISTIC
/begin CHARACTERISTIC DFES_Severity.DFC_SRCMaxUCatUsT_C "DFES/" VALUE 0x8002B3F5 Val_Wu8 255.0 OneToOne 0.00 255.0 /end CHARACTERISTIC
/begin CHARACTERISTIC DFES_Severity.DFC_SRCMaxUPmpP_C "DFES/" VALUE 0x8002B3F6 Val_Wu8 255.0 OneToOne 0.00 255.0 /end CHARACTERISTIC
/begin CHARACTERISTIC DFES_Severity.DFC_SRCMinPPFltDiff_C "DFES/Projektspezifische Applikationdaten (pro DSM Element) DFC_SRCMinPPFltDiff" VALUE 0x8002B3F7 Val_Wu8 255.0 OneToOne 0.00 255.0 /end CHARACTERISTIC
/begin CHARACTERISTIC DFES_Severity.DFC_SRCMinPPFltUs_C "DFES/Projektspezifische Applikationdaten (pro DSM Element) DFC_SRCMinPPFltUs" VALUE 0x8002B3F8 Val_Wu8 255.0 OneToOne 0.00 255.0 /end CHARACTERISTIC
/begin CHARACTERISTIC DFES_Severity.DFC_SRCMinTECU_C "DFES/Projektspezifische Applikationdaten (pro DSM Element) DFC_SRCMinTECU" VALUE 0x8002B3F9 Val_Wu8 255.0 OneToOne 0.00 255.0 /end CHARACTERISTIC
/begin CHARACTERISTIC DFES_Severity.DFC_SRCMinTOxiCatUs_C "DFES/Projektspezifische Applikationdaten (pro DSM Element) DFC_SRCMinTOxiCatUs" VALUE 0x8002B3FA Val_Wu8 255.0 OneToOne 0.00 255.0 /end CHARACTERISTIC
/begin CHARACTERISTIC DFES_Severity.DFC_SRCMinTPFltUs_C "DFES/Projektspezifische Applikationdaten (pro DSM Element) DFC_SRCMinTPFltUs" VALUE 0x8002B3FB Val_Wu8 255.0 OneToOne 0.00 255.0 /end CHARACTERISTIC
/begin CHARACTERISTIC DFES_Severity.DFC_SRCMinTTrbnUs_C "DFES/" VALUE 0x8002B3FC Val_Wu8 255.0 OneToOne 0.00 255.0 /end CHARACTERISTIC
/begin CHARACTERISTIC DFES_Severity.DFC_SRCMinUCatUsT_C "DFES/" VALUE 0x8002B3FD Val_Wu8 255.0 OneToOne 0.00 255.0 /end CHARACTERISTIC
/begin CHARACTERISTIC DFES_Severity.DFC_SRCMinUPmpP_C "DFES/" VALUE 0x8002B3FE Val_Wu8 255.0 OneToOne 0.00 255.0 /end CHARACTERISTIC
/begin CHARACTERISTIC DFES_Severity.DFC_SigUCatUsT_C "DFES/" VALUE 0x8002B3FF Val_Wu8 255.0 OneToOne 0.00 255.0 /end CHARACTERISTIC
/begin CHARACTERISTIC DFES_Severity.DFC_SigUPmpP_C "DFES/" VALUE 0x8002B400 Val_Wu8 255.0 OneToOne 0.00 255.0 /end CHARACTERISTIC
/begin CHARACTERISTIC DFES_Severity.DFC_SyncAPP_C "DFES/Projektspezifische Applikationdaten (pro DSM Element) DFC_SyncAPP" VALUE 0x8002B401 Val_Wu8 255.0 OneToOne 0.00 255.0 /end CHARACTERISTIC
/begin CHARACTERISTIC DFES_Severity.DFC_T15Npl_C "DFES/Projektspezifische Applikationdaten (pro DSM Element) DFC_T15Npl" VALUE 0x8002B402 Val_Wu8 255.0 OneToOne 0.00 255.0 /end CHARACTERISTIC
/begin CHARACTERISTIC DFES_Severity.DFC_TAFSDtyCycHi_C "DFES/Projektspezifische Applikationdaten (pro DSM Element) DFC_TAFSDtyCycHi" VALUE 0x8002B403 Val_Wu8 255.0 OneToOne 0.00 255.0 /end CHARACTERISTIC
/begin CHARACTERISTIC DFES_Severity.DFC_TAFSDtyCycLo_C "DFES/Projektspezifische Applikationdaten (pro DSM Element) DFC_TAFSDtyCycLo" VALUE 0x8002B404 Val_Wu8 255.0 OneToOne 0.00 255.0 /end CHARACTERISTIC
/begin CHARACTERISTIC DFES_Severity.DFC_TAFSPerHi_C "DFES/Projektspezifische Applikationdaten (pro DSM Element) DFC_TAFSPerHi" VALUE 0x8002B405 Val_Wu8 255.0 OneToOne 0.00 255.0 /end CHARACTERISTIC
/begin CHARACTERISTIC DFES_Severity.DFC_TAFSPerLo_C "DFES/Projektspezifische Applikationdaten (pro DSM Element) DFC_TAFSPerLo" VALUE 0x8002B406 Val_Wu8 255.0 OneToOne 0.00 255.0 /end CHARACTERISTIC
/begin CHARACTERISTIC DFES_Severity.DFC_TCACDsSRCMax_C "DFES/Projektspezifische Applikationdaten (pro DSM Element) DFC_TCACDsSRCMax" VALUE 0x8002B407 Val_Wu8 255.0 OneToOne 0.00 255.0 /end CHARACTERISTIC
/begin CHARACTERISTIC DFES_Severity.DFC_TCACDsSRCMin_C "DFES/Projektspezifische Applikationdaten (pro DSM Element) DFC_TCACDsSRCMin" VALUE 0x8002B408 Val_Wu8 255.0 OneToOne 0.00 255.0 /end CHARACTERISTIC
/begin CHARACTERISTIC DFES_Severity.DFC_ThrVlvSRCMax_C "DFES/Projektspezifische Applikationdaten (pro DSM Element) DFC_ThrVlvSRCMax" VALUE 0x8002B409 Val_Wu8 255.0 OneToOne 0.00 255.0 /end CHARACTERISTIC
/begin CHARACTERISTIC DFES_Severity.DFC_ThrVlvSRCMin_C "DFES/Projektspezifische Applikationdaten (pro DSM Element) DFC_ThrVlvSRCMin" VALUE 0x8002B40A Val_Wu8 255.0 OneToOne 0.00 255.0 /end CHARACTERISTIC
/begin CHARACTERISTIC DFES_Severity.DFC_TrbChLPOL_C "DFES/Projektspezifische Applikationdaten (pro DSM Element) DFC_TrbChLPOL" VALUE 0x8002B40B Val_Wu8 255.0 OneToOne 0.00 255.0 /end CHARACTERISTIC
/begin CHARACTERISTIC DFES_Severity.DFC_TrbChLPSCB_C "DFES/Projektspezifische Applikationdaten (pro DSM Element) DFC_TrbChLPSCB" VALUE 0x8002B40C Val_Wu8 255.0 OneToOne 0.00 255.0 /end CHARACTERISTIC
/begin CHARACTERISTIC DFES_Severity.DFC_TrbChLPSCG_C "DFES/Projektspezifische Applikationdaten (pro DSM Element) DFC_TrbChLPSCG" VALUE 0x8002B40D Val_Wu8 255.0 OneToOne 0.00 255.0 /end CHARACTERISTIC
/begin CHARACTERISTIC DFES_Severity.DFC_UHtrPLOL_C "DFES/" VALUE 0x8002B40E Val_Wu8 255.0 OneToOne 0.00 255.0 /end CHARACTERISTIC
/begin CHARACTERISTIC DFES_Severity.DFC_UHtrPLSCB_C "DFES/" VALUE 0x8002B40F Val_Wu8 255.0 OneToOne 0.00 255.0 /end CHARACTERISTIC
/begin CHARACTERISTIC DFES_Severity.DFC_UHtrPLSCG_C "DFES/" VALUE 0x8002B410 Val_Wu8 255.0 OneToOne 0.00 255.0 /end CHARACTERISTIC
/begin CHARACTERISTIC DFES_Severity.DFC_UHtrPLSRCMaxDia_C "DFES/" VALUE 0x8002B411 Val_Wu8 255.0 OneToOne 0.00 255.0 /end CHARACTERISTIC
/begin CHARACTERISTIC DFES_Severity.DFC_UHtrPLSRCMinDia_C "DFES/" VALUE 0x8002B412 Val_Wu8 255.0 OneToOne 0.00 255.0 /end CHARACTERISTIC
/begin CHARACTERISTIC DFES_Severity.DFC_UHtrTnkOL_C "DFES/" VALUE 0x8002B413 Val_Wu8 255.0 OneToOne 0.00 255.0 /end CHARACTERISTIC
/begin CHARACTERISTIC DFES_Severity.DFC_UHtrTnkSCB_C "DFES/" VALUE 0x8002B414 Val_Wu8 255.0 OneToOne 0.00 255.0 /end CHARACTERISTIC
/begin CHARACTERISTIC DFES_Severity.DFC_UHtrTnkSCG_C "DFES/" VALUE 0x8002B415 Val_Wu8 255.0 OneToOne 0.00 255.0 /end CHARACTERISTIC
/begin CHARACTERISTIC DFES_Severity.DFC_UHtrTnkSRCMaxDia_C "DFES/" VALUE 0x8002B416 Val_Wu8 255.0 OneToOne 0.00 255.0 /end CHARACTERISTIC
/begin CHARACTERISTIC DFES_Severity.DFC_UHtrTnkSRCMinDia_C "DFES/" VALUE 0x8002B417 Val_Wu8 255.0 OneToOne 0.00 255.0 /end CHARACTERISTIC
/begin CHARACTERISTIC DFES_Severity.DFC_URevVlvOL_C "DFES/" VALUE 0x8002B418 Val_Wu8 255.0 OneToOne 0.00 255.0 /end CHARACTERISTIC
/begin CHARACTERISTIC DFES_Severity.DFC_URevVlvSCB_C "DFES/" VALUE 0x8002B419 Val_Wu8 255.0 OneToOne 0.00 255.0 /end CHARACTERISTIC
/begin CHARACTERISTIC DFES_Severity.DFC_URevVlvSCG_C "DFES/" VALUE 0x8002B41A Val_Wu8 255.0 OneToOne 0.00 255.0 /end CHARACTERISTIC
/begin CHARACTERISTIC DFES_Severity.DFC_UTnkTSRCMax_C "DFES/" VALUE 0x8002B41B Val_Wu8 255.0 OneToOne 0.00 255.0 /end CHARACTERISTIC
/begin CHARACTERISTIC DFES_Severity.DFC_UTnkTSRCMin_C "DFES/" VALUE 0x8002B41C Val_Wu8 255.0 OneToOne 0.00 255.0 /end CHARACTERISTIC
/begin CHARACTERISTIC DFES_Severity.DFC_UTnkTSig_C "DFES/" VALUE 0x8002B41D Val_Wu8 255.0 OneToOne 0.00 255.0 /end CHARACTERISTIC
/begin CHARACTERISTIC DFES_Severity.DFC_VSwVlvGovDvtMax_C "DFES/Projektspezifische Applikationdaten (pro DSM Element) DFC_VSwVlvGovDvtMax" VALUE 0x8002B41E Val_Wu8 255.0 OneToOne 0.00 255.0 /end CHARACTERISTIC
/begin CHARACTERISTIC DFES_Severity.DFC_VSwVlvGovDvtMin_C "DFES/Projektspezifische Applikationdaten (pro DSM Element) DFC_VSwVlvGovDvtMin" VALUE 0x8002B41F Val_Wu8 255.0 OneToOne 0.00 255.0 /end CHARACTERISTIC
/begin CHARACTERISTIC DFES_Severity.DFC_VSwVlvHBrgOpnLd_C "DFES/Projektspezifische Applikationdaten (pro DSM Element) DFC_VSwVlvHBrgOpnLd" VALUE 0x8002B420 Val_Wu8 255.0 OneToOne 0.00 255.0 /end CHARACTERISTIC
/begin CHARACTERISTIC DFES_Severity.DFC_VSwVlvHBrgOvrCurr_C "DFES/Projektspezifische Applikationdaten (pro DSM Element) DFC_VSwVlvHBrgOvrCurr" VALUE 0x8002B421 Val_Wu8 255.0 OneToOne 0.00 255.0 /end CHARACTERISTIC
/begin CHARACTERISTIC DFES_Severity.DFC_VSwVlvHBrgOvrTemp_C "DFES/Projektspezifische Applikationdaten (pro DSM Element) DFC_VSwVlvHBrgOvrTemp" VALUE 0x8002B422 Val_Wu8 255.0 OneToOne 0.00 255.0 /end CHARACTERISTIC
/begin CHARACTERISTIC DFES_Severity.DFC_VSwVlvHBrgShCirBatt1_C "DFES/Projektspezifische Applikationdaten (pro DSM Element) DFC_VSwVlvHBrgShCirBatt1" VALUE 0x8002B423 Val_Wu8 255.0 OneToOne 0.00 255.0 /end CHARACTERISTIC
/begin CHARACTERISTIC DFES_Severity.DFC_VSwVlvHBrgShCirBatt2_C "DFES/Projektspezifische Applikationdaten (pro DSM Element) DFC_VSwVlvHBrgShCirBatt2" VALUE 0x8002B424 Val_Wu8 255.0 OneToOne 0.00 255.0 /end CHARACTERISTIC
/begin CHARACTERISTIC DFES_Severity.DFC_VSwVlvHBrgShCirGnd1_C "DFES/Projektspezifische Applikationdaten (pro DSM Element) DFC_VSwVlvHBrgShCirGnd1" VALUE 0x8002B425 Val_Wu8 255.0 OneToOne 0.00 255.0 /end CHARACTERISTIC
/begin CHARACTERISTIC DFES_Severity.DFC_VSwVlvHBrgShCirGnd2_C "DFES/Projektspezifische Applikationdaten (pro DSM Element) DFC_VSwVlvHBrgShCirGnd2" VALUE 0x8002B426 Val_Wu8 255.0 OneToOne 0.00 255.0 /end CHARACTERISTIC
/begin CHARACTERISTIC DFES_Severity.DFC_VSwVlvHBrgShCirOvrLd_C "DFES/Projektspezifische Applikationdaten (pro DSM Element) DFC_VSwVlvHBrgShCirOvrLd" VALUE 0x8002B427 Val_Wu8 255.0 OneToOne 0.00 255.0 /end CHARACTERISTIC
/begin CHARACTERISTIC DFES_Severity.DFC_VSwVlvHBrgTempOvrCurr_C "DFES/Projektspezifische Applikationdaten (pro DSM Element) DFC_VSwVlvHBrgTempOvrCurr" VALUE 0x8002B428 Val_Wu8 255.0 OneToOne 0.00 255.0 /end CHARACTERISTIC
/begin CHARACTERISTIC DFES_Severity.DFC_VSwVlvHBrgUndrVltg_C "DFES/Projektspezifische Applikationdaten (pro DSM Element) DFC_VSwVlvHBrgUndrVltg" VALUE 0x8002B429 Val_Wu8 255.0 OneToOne 0.00 255.0 /end CHARACTERISTIC
/begin CHARACTERISTIC DFES_Severity.DFC_VSwVlvOL_C "DFES/" VALUE 0x8002B42A Val_Wu8 255.0 OneToOne 0.00 255.0 /end CHARACTERISTIC
/begin CHARACTERISTIC DFES_Severity.DFC_VSwVlvSCB_C "DFES/" VALUE 0x8002B42B Val_Wu8 255.0 OneToOne 0.00 255.0 /end CHARACTERISTIC
/begin CHARACTERISTIC DFES_Severity.DFC_VSwVlvSCG_C "DFES/" VALUE 0x8002B42C Val_Wu8 255.0 OneToOne 0.00 255.0 /end CHARACTERISTIC
/begin CHARACTERISTIC DFES_Severity.DFC_VSwVlvSRCMax_C "DFES/Projektspezifische Applikationdaten (pro DSM Element) DFC_VSwVlvSRCMax" VALUE 0x8002B42D Val_Wu8 255.0 OneToOne 0.00 255.0 /end CHARACTERISTIC
/begin CHARACTERISTIC DFES_Severity.DFC_VSwVlvSRCMin_C "DFES/Projektspezifische Applikationdaten (pro DSM Element) DFC_VSwVlvSRCMin" VALUE 0x8002B42E Val_Wu8 255.0 OneToOne 0.00 255.0 /end CHARACTERISTIC
/begin CHARACTERISTIC DFES_Severity.DFC_ClthNpl_C "DFES/Projektspezifische Applikationdaten (pro DSM Element) DFC_ClthNpl" VALUE 0x8002B42F Val_Wu8 255.0 OneToOne 0.00 255.0 /end CHARACTERISTIC
/begin CHARACTERISTIC DFES_Severity.DFC_ETClbETMax_0_C "DFES/Projektspezifische Applikationdaten (pro DSM Element) DFC_ETClbETMax_0" VALUE 0x8002B430 Val_Wu8 255.0 OneToOne 0.00 255.0 /end CHARACTERISTIC
/begin CHARACTERISTIC DFES_Severity.DFC_ETClbETMax_1_C "DFES/Projektspezifische Applikationdaten (pro DSM Element) DFC_ETClbETMax_1" VALUE 0x8002B431 Val_Wu8 255.0 OneToOne 0.00 255.0 /end CHARACTERISTIC
/begin CHARACTERISTIC DFES_Severity.DFC_ETClbETMax_2_C "DFES/Projektspezifische Applikationdaten (pro DSM Element) DFC_ETClbETMax_2" VALUE 0x8002B432 Val_Wu8 255.0 OneToOne 0.00 255.0 /end CHARACTERISTIC
/begin CHARACTERISTIC DFES_Severity.DFC_ETClbETMax_3_C "DFES/Projektspezifische Applikationdaten (pro DSM Element) DFC_ETClbETMax_3" VALUE 0x8002B433 Val_Wu8 255.0 OneToOne 0.00 255.0 /end CHARACTERISTIC
/begin CHARACTERISTIC DFES_Severity.DFC_ETClbETMax_4_C "DFES/Projektspezifische Applikationdaten (pro DSM Element) DFC_ETClbETMax_4" VALUE 0x8002B434 Val_Wu8 255.0 OneToOne 0.00 255.0 /end CHARACTERISTIC
/begin CHARACTERISTIC DFES_Severity.DFC_ETClbETMax_5_C "DFES/Projektspezifische Applikationdaten (pro DSM Element) DFC_ETClbETMax_5" VALUE 0x8002B435 Val_Wu8 255.0 OneToOne 0.00 255.0 /end CHARACTERISTIC
/begin CHARACTERISTIC DFES_Severity.DFC_ETClbETMin_0_C "DFES/Projektspezifische Applikationdaten (pro DSM Element) DFC_ETClbETMin_0" VALUE 0x8002B436 Val_Wu8 255.0 OneToOne 0.00 255.0 /end CHARACTERISTIC
/begin CHARACTERISTIC DFES_Severity.DFC_ETClbETMin_1_C "DFES/Projektspezifische Applikationdaten (pro DSM Element) DFC_ETClbETMin_1" VALUE 0x8002B437 Val_Wu8 255.0 OneToOne 0.00 255.0 /end CHARACTERISTIC
/begin CHARACTERISTIC DFES_Severity.DFC_ETClbETMin_2_C "DFES/Projektspezifische Applikationdaten (pro DSM Element) DFC_ETClbETMin_2" VALUE 0x8002B438 Val_Wu8 255.0 OneToOne 0.00 255.0 /end CHARACTERISTIC
/begin CHARACTERISTIC DFES_Severity.DFC_ETClbETMin_3_C "DFES/Projektspezifische Applikationdaten (pro DSM Element) DFC_ETClbETMin_3" VALUE 0x8002B439 Val_Wu8 255.0 OneToOne 0.00 255.0 /end CHARACTERISTIC
/begin CHARACTERISTIC DFES_Severity.DFC_ETClbETMin_4_C "DFES/Projektspezifische Applikationdaten (pro DSM Element) DFC_ETClbETMin_4" VALUE 0x8002B43A Val_Wu8 255.0 OneToOne 0.00 255.0 /end CHARACTERISTIC
/begin CHARACTERISTIC DFES_Severity.DFC_ETClbETMin_5_C "DFES/Projektspezifische Applikationdaten (pro DSM Element) DFC_ETClbETMin_5" VALUE 0x8002B43B Val_Wu8 255.0 OneToOne 0.00 255.0 /end CHARACTERISTIC
/begin CHARACTERISTIC DFES_Severity.DFC_IVActrEnrgMax_0_C "DFES/Projektspezifische Applikationdaten (pro DSM Element) DFC_IVActrEnrgMax_0" VALUE 0x8002B43C Val_Wu8 255.0 OneToOne 0.00 255.0 /end CHARACTERISTIC
/begin CHARACTERISTIC DFES_Severity.DFC_IVActrEnrgMax_1_C "DFES/Projektspezifische Applikationdaten (pro DSM Element) DFC_IVActrEnrgMax_1" VALUE 0x8002B43D Val_Wu8 255.0 OneToOne 0.00 255.0 /end CHARACTERISTIC
/begin CHARACTERISTIC DFES_Severity.DFC_IVActrEnrgMax_2_C "DFES/Projektspezifische Applikationdaten (pro DSM Element) DFC_IVActrEnrgMax_2" VALUE 0x8002B43E Val_Wu8 255.0 OneToOne 0.00 255.0 /end CHARACTERISTIC
/begin CHARACTERISTIC DFES_Severity.DFC_IVActrEnrgMax_3_C "DFES/Projektspezifische Applikationdaten (pro DSM Element) DFC_IVActrEnrgMax_3" VALUE 0x8002B43F Val_Wu8 255.0 OneToOne 0.00 255.0 /end CHARACTERISTIC
/begin CHARACTERISTIC DFES_Severity.DFC_IVActrEnrgMax_4_C "DFES/Projektspezifische Applikationdaten (pro DSM Element) DFC_IVActrEnrgMax_4" VALUE 0x8002B440 Val_Wu8 255.0 OneToOne 0.00 255.0 /end CHARACTERISTIC
/begin CHARACTERISTIC DFES_Severity.DFC_IVActrEnrgMax_5_C "DFES/Projektspezifische Applikationdaten (pro DSM Element) DFC_IVActrEnrgMax_5" VALUE 0x8002B441 Val_Wu8 255.0 OneToOne 0.00 255.0 /end CHARACTERISTIC
/begin CHARACTERISTIC DFES_Severity.DFC_IVActrEnrgMax_6_C "DFES/Projektspezifische Applikationdaten (pro DSM Element) DFC_IVActrEnrgMax_6" VALUE 0x8002B442 Val_Wu8 255.0 OneToOne 0.00 255.0 /end CHARACTERISTIC
/begin CHARACTERISTIC DFES_Severity.DFC_IVActrEnrgMax_7_C "DFES/Projektspezifische Applikationdaten (pro DSM Element) DFC_IVActrEnrgMax_7" VALUE 0x8002B443 Val_Wu8 255.0 OneToOne 0.00 255.0 /end CHARACTERISTIC
/begin CHARACTERISTIC DFES_Severity.DFC_IVActrEnrgMin_0_C "DFES/Projektspezifische Applikationdaten (pro DSM Element) DFC_IVActrEnrgMin_0" VALUE 0x8002B444 Val_Wu8 255.0 OneToOne 0.00 255.0 /end CHARACTERISTIC
/begin CHARACTERISTIC DFES_Severity.DFC_IVActrEnrgMin_1_C "DFES/Projektspezifische Applikationdaten (pro DSM Element) DFC_IVActrEnrgMin_1" VALUE 0x8002B445 Val_Wu8 255.0 OneToOne 0.00 255.0 /end CHARACTERISTIC
/begin CHARACTERISTIC DFES_Severity.DFC_IVActrEnrgMin_2_C "DFES/Projektspezifische Applikationdaten (pro DSM Element) DFC_IVActrEnrgMin_2" VALUE 0x8002B446 Val_Wu8 255.0 OneToOne 0.00 255.0 /end CHARACTERISTIC
/begin CHARACTERISTIC DFES_Severity.DFC_IVActrEnrgMin_3_C "DFES/Projektspezifische Applikationdaten (pro DSM Element) DFC_IVActrEnrgMin_3" VALUE 0x8002B447 Val_Wu8 255.0 OneToOne 0.00 255.0 /end CHARACTERISTIC
/begin CHARACTERISTIC DFES_Severity.DFC_IVActrEnrgMin_4_C "DFES/Projektspezifische Applikationdaten (pro DSM Element) DFC_IVActrEnrgMin_4" VALUE 0x8002B448 Val_Wu8 255.0 OneToOne 0.00 255.0 /end CHARACTERISTIC
/begin CHARACTERISTIC DFES_Severity.DFC_IVActrEnrgMin_5_C "DFES/Projektspezifische Applikationdaten (pro DSM Element) DFC_IVActrEnrgMin_5" VALUE 0x8002B449 Val_Wu8 255.0 OneToOne 0.00 255.0 /end CHARACTERISTIC
/begin CHARACTERISTIC DFES_Severity.DFC_IVActrEnrgMin_6_C "DFES/Projektspezifische Applikationdaten (pro DSM Element) DFC_IVActrEnrgMin_6" VALUE 0x8002B44A Val_Wu8 255.0 OneToOne 0.00 255.0 /end CHARACTERISTIC
/begin CHARACTERISTIC DFES_Severity.DFC_IVActrEnrgMin_7_C "DFES/Projektspezifische Applikationdaten (pro DSM Element) DFC_IVActrEnrgMin_7" VALUE 0x8002B44B Val_Wu8 255.0 OneToOne 0.00 255.0 /end CHARACTERISTIC
/begin CHARACTERISTIC DFES_Severity.DFC_IVActrEnrgPlaus_0_C "DFES/Projektspezifische Applikationdaten (pro DSM Element) DFC_IVActrEnrgPlaus_0" VALUE 0x8002B44C Val_Wu8 255.0 OneToOne 0.00 255.0 /end CHARACTERISTIC
/begin CHARACTERISTIC DFES_Severity.DFC_IVActrEnrgPlaus_1_C "DFES/Projektspezifische Applikationdaten (pro DSM Element) DFC_IVActrEnrgPlaus_1" VALUE 0x8002B44D Val_Wu8 255.0 OneToOne 0.00 255.0 /end CHARACTERISTIC
/begin CHARACTERISTIC DFES_Severity.DFC_IVActrEnrgPlaus_2_C "DFES/Projektspezifische Applikationdaten (pro DSM Element) DFC_IVActrEnrgPlaus_2" VALUE 0x8002B44E Val_Wu8 255.0 OneToOne 0.00 255.0 /end CHARACTERISTIC
/begin CHARACTERISTIC DFES_Severity.DFC_IVActrEnrgPlaus_3_C "DFES/Projektspezifische Applikationdaten (pro DSM Element) DFC_IVActrEnrgPlaus_3" VALUE 0x8002B44F Val_Wu8 255.0 OneToOne 0.00 255.0 /end CHARACTERISTIC
/begin CHARACTERISTIC DFES_Severity.DFC_IVActrEnrgPlaus_4_C "DFES/Projektspezifische Applikationdaten (pro DSM Element) DFC_IVActrEnrgPlaus_4" VALUE 0x8002B450 Val_Wu8 255.0 OneToOne 0.00 255.0 /end CHARACTERISTIC
/begin CHARACTERISTIC DFES_Severity.DFC_IVActrEnrgPlaus_5_C "DFES/Projektspezifische Applikationdaten (pro DSM Element) DFC_IVActrEnrgPlaus_5" VALUE 0x8002B451 Val_Wu8 255.0 OneToOne 0.00 255.0 /end CHARACTERISTIC
/begin CHARACTERISTIC DFES_Severity.DFC_IVActrEnrgPlaus_6_C "DFES/Projektspezifische Applikationdaten (pro DSM Element) DFC_IVActrEnrgPlaus_6" VALUE 0x8002B452 Val_Wu8 255.0 OneToOne 0.00 255.0 /end CHARACTERISTIC
/begin CHARACTERISTIC DFES_Severity.DFC_IVActrEnrgPlaus_7_C "DFES/Projektspezifische Applikationdaten (pro DSM Element) DFC_IVActrEnrgPlaus_7" VALUE 0x8002B453 Val_Wu8 255.0 OneToOne 0.00 255.0 /end CHARACTERISTIC
/begin CHARACTERISTIC DFES_Severity.DFC_IVCtlTiDiff_0_C "DFES/Projektspezifische Applikationdaten (pro DSM Element) DFC_IVCtlTiDiff_0" VALUE 0x8002B454 Val_Wu8 255.0 OneToOne 0.00 255.0 /end CHARACTERISTIC
/begin CHARACTERISTIC DFES_Severity.DFC_IVCtlTiDiff_1_C "DFES/Projektspezifische Applikationdaten (pro DSM Element) DFC_IVCtlTiDiff_1" VALUE 0x8002B455 Val_Wu8 255.0 OneToOne 0.00 255.0 /end CHARACTERISTIC
/begin CHARACTERISTIC DFES_Severity.DFC_IVCtlTiDiff_2_C "DFES/Projektspezifische Applikationdaten (pro DSM Element) DFC_IVCtlTiDiff_2" VALUE 0x8002B456 Val_Wu8 255.0 OneToOne 0.00 255.0 /end CHARACTERISTIC
/begin CHARACTERISTIC DFES_Severity.DFC_IVCtlTiDiff_3_C "DFES/Projektspezifische Applikationdaten (pro DSM Element) DFC_IVCtlTiDiff_3" VALUE 0x8002B457 Val_Wu8 255.0 OneToOne 0.00 255.0 /end CHARACTERISTIC
/begin CHARACTERISTIC DFES_Severity.DFC_IVCtlTiDiff_4_C "DFES/Projektspezifische Applikationdaten (pro DSM Element) DFC_IVCtlTiDiff_4" VALUE 0x8002B458 Val_Wu8 255.0 OneToOne 0.00 255.0 /end CHARACTERISTIC
/begin CHARACTERISTIC DFES_Severity.DFC_IVCtlTiDiff_5_C "DFES/Projektspezifische Applikationdaten (pro DSM Element) DFC_IVCtlTiDiff_5" VALUE 0x8002B459 Val_Wu8 255.0 OneToOne 0.00 255.0 /end CHARACTERISTIC
/begin CHARACTERISTIC DFES_Severity.DFC_IVCtlUDiffUp_0_C "DFES/Projektspezifische Applikationdaten (pro DSM Element) DFC_IVCtlUDiffUp_0" VALUE 0x8002B45A Val_Wu8 255.0 OneToOne 0.00 255.0 /end CHARACTERISTIC
/begin CHARACTERISTIC DFES_Severity.DFC_IVCtlUDiffUp_1_C "DFES/Projektspezifische Applikationdaten (pro DSM Element) DFC_IVCtlUDiffUp_1" VALUE 0x8002B45B Val_Wu8 255.0 OneToOne 0.00 255.0 /end CHARACTERISTIC
/begin CHARACTERISTIC DFES_Severity.DFC_IVCtlUDiffUp_2_C "DFES/Projektspezifische Applikationdaten (pro DSM Element) DFC_IVCtlUDiffUp_2" VALUE 0x8002B45C Val_Wu8 255.0 OneToOne 0.00 255.0 /end CHARACTERISTIC
/begin CHARACTERISTIC DFES_Severity.DFC_IVCtlUDiffUp_3_C "DFES/Projektspezifische Applikationdaten (pro DSM Element) DFC_IVCtlUDiffUp_3" VALUE 0x8002B45D Val_Wu8 255.0 OneToOne 0.00 255.0 /end CHARACTERISTIC
/begin CHARACTERISTIC DFES_Severity.DFC_IVCtlUDiffUp_4_C "DFES/Projektspezifische Applikationdaten (pro DSM Element) DFC_IVCtlUDiffUp_4" VALUE 0x8002B45E Val_Wu8 255.0 OneToOne 0.00 255.0 /end CHARACTERISTIC
/begin CHARACTERISTIC DFES_Severity.DFC_IVCtlUDiffUp_5_C "DFES/Projektspezifische Applikationdaten (pro DSM Element) DFC_IVCtlUDiffUp_5" VALUE 0x8002B45F Val_Wu8 255.0 OneToOne 0.00 255.0 /end CHARACTERISTIC
/begin CHARACTERISTIC DFES_Severity.DFC_IVCtlUUp_0_C "DFES/Projektspezifische Applikationdaten (pro DSM Element) DFC_IVCtlUUp_0" VALUE 0x8002B460 Val_Wu8 255.0 OneToOne 0.00 255.0 /end CHARACTERISTIC
/begin CHARACTERISTIC DFES_Severity.DFC_IVCtlUUp_1_C "DFES/Projektspezifische Applikationdaten (pro DSM Element) DFC_IVCtlUUp_1" VALUE 0x8002B461 Val_Wu8 255.0 OneToOne 0.00 255.0 /end CHARACTERISTIC
/begin CHARACTERISTIC DFES_Severity.DFC_IVCtlUUp_2_C "DFES/Projektspezifische Applikationdaten (pro DSM Element) DFC_IVCtlUUp_2" VALUE 0x8002B462 Val_Wu8 255.0 OneToOne 0.00 255.0 /end CHARACTERISTIC
/begin CHARACTERISTIC DFES_Severity.DFC_IVCtlUUp_3_C "DFES/Projektspezifische Applikationdaten (pro DSM Element) DFC_IVCtlUUp_3" VALUE 0x8002B463 Val_Wu8 255.0 OneToOne 0.00 255.0 /end CHARACTERISTIC
/begin CHARACTERISTIC DFES_Severity.DFC_IVCtlUUp_4_C "DFES/Projektspezifische Applikationdaten (pro DSM Element) DFC_IVCtlUUp_4" VALUE 0x8002B464 Val_Wu8 255.0 OneToOne 0.00 255.0 /end CHARACTERISTIC
/begin CHARACTERISTIC DFES_Severity.DFC_IVCtlUUp_5_C "DFES/Projektspezifische Applikationdaten (pro DSM Element) DFC_IVCtlUUp_5" VALUE 0x8002B465 Val_Wu8 255.0 OneToOne 0.00 255.0 /end CHARACTERISTIC
/begin CHARACTERISTIC DFES_Severity.DFC_IVDiaBnkShCir_0_C "DFES/Projektspezifische Applikationdaten (pro DSM Element) DFC_IVDiaBnkShCir_0" VALUE 0x8002B466 Val_Wu8 255.0 OneToOne 0.00 255.0 /end CHARACTERISTIC
/begin CHARACTERISTIC DFES_Severity.DFC_IVDiaBnkShCir_1_C "DFES/Projektspezifische Applikationdaten (pro DSM Element) DFC_IVDiaBnkShCir_1" VALUE 0x8002B467 Val_Wu8 255.0 OneToOne 0.00 255.0 /end CHARACTERISTIC
/begin CHARACTERISTIC DFES_Severity.DFC_IVDiaBnkShCirChSwt_0_C "DFES/Projektspezifische Applikationdaten (pro DSM Element) DFC_IVDiaBnkShCirChSwt_0" VALUE 0x8002B468 Val_Wu8 255.0 OneToOne 0.00 255.0 /end CHARACTERISTIC
/begin CHARACTERISTIC DFES_Severity.DFC_IVDiaBnkShCirChSwt_1_C "DFES/Projektspezifische Applikationdaten (pro DSM Element) DFC_IVDiaBnkShCirChSwt_1" VALUE 0x8002B469 Val_Wu8 255.0 OneToOne 0.00 255.0 /end CHARACTERISTIC
/begin CHARACTERISTIC DFES_Severity.DFC_IVDiaChp_0_C "DFES/Projektspezifische Applikationdaten (pro DSM Element) DFC_IVDiaChp_0" VALUE 0x8002B46A Val_Wu8 255.0 OneToOne 0.00 255.0 /end CHARACTERISTIC
/begin CHARACTERISTIC DFES_Severity.DFC_IVDiaChp_1_C "DFES/Projektspezifische Applikationdaten (pro DSM Element) DFC_IVDiaChp_1" VALUE 0x8002B46B Val_Wu8 255.0 OneToOne 0.00 255.0 /end CHARACTERISTIC
/begin CHARACTERISTIC DFES_Severity.DFC_IVDiaCylNoCls_0_C "DFES/Projektspezifische Applikationdaten (pro DSM Element) DFC_IVDiaCylNoCls_0" VALUE 0x8002B46C Val_Wu8 255.0 OneToOne 0.00 255.0 /end CHARACTERISTIC
/begin CHARACTERISTIC DFES_Severity.DFC_IVDiaCylNoCls_1_C "DFES/Projektspezifische Applikationdaten (pro DSM Element) DFC_IVDiaCylNoCls_1" VALUE 0x8002B46D Val_Wu8 255.0 OneToOne 0.00 255.0 /end CHARACTERISTIC
/begin CHARACTERISTIC DFES_Severity.DFC_IVDiaCylNoCls_2_C "DFES/Projektspezifische Applikationdaten (pro DSM Element) DFC_IVDiaCylNoCls_2" VALUE 0x8002B46E Val_Wu8 255.0 OneToOne 0.00 255.0 /end CHARACTERISTIC
/begin CHARACTERISTIC DFES_Severity.DFC_IVDiaCylNoCls_3_C "DFES/Projektspezifische Applikationdaten (pro DSM Element) DFC_IVDiaCylNoCls_3" VALUE 0x8002B46F Val_Wu8 255.0 OneToOne 0.00 255.0 /end CHARACTERISTIC
/begin CHARACTERISTIC DFES_Severity.DFC_IVDiaCylNoCls_4_C "DFES/Projektspezifische Applikationdaten (pro DSM Element) DFC_IVDiaCylNoCls_4" VALUE 0x8002B470 Val_Wu8 255.0 OneToOne 0.00 255.0 /end CHARACTERISTIC
/begin CHARACTERISTIC DFES_Severity.DFC_IVDiaCylNoCls_5_C "DFES/Projektspezifische Applikationdaten (pro DSM Element) DFC_IVDiaCylNoCls_5" VALUE 0x8002B471 Val_Wu8 255.0 OneToOne 0.00 255.0 /end CHARACTERISTIC
/begin CHARACTERISTIC DFES_Severity.DFC_IVDiaCylNoLd_0_C "DFES/Projektspezifische Applikationdaten (pro DSM Element) DFC_IVDiaCylNoLd_0" VALUE 0x8002B472 Val_Wu8 255.0 OneToOne 0.00 255.0 /end CHARACTERISTIC
/begin CHARACTERISTIC DFES_Severity.DFC_IVDiaCylNoLd_1_C "DFES/Projektspezifische Applikationdaten (pro DSM Element) DFC_IVDiaCylNoLd_1" VALUE 0x8002B473 Val_Wu8 255.0 OneToOne 0.00 255.0 /end CHARACTERISTIC
/begin CHARACTERISTIC DFES_Severity.DFC_IVDiaCylNoLd_2_C "DFES/Projektspezifische Applikationdaten (pro DSM Element) DFC_IVDiaCylNoLd_2" VALUE 0x8002B474 Val_Wu8 255.0 OneToOne 0.00 255.0 /end CHARACTERISTIC
/begin CHARACTERISTIC DFES_Severity.DFC_IVDiaCylNoLd_3_C "DFES/Projektspezifische Applikationdaten (pro DSM Element) DFC_IVDiaCylNoLd_3" VALUE 0x8002B475 Val_Wu8 255.0 OneToOne 0.00 255.0 /end CHARACTERISTIC
/begin CHARACTERISTIC DFES_Severity.DFC_IVDiaCylNoLd_4_C "DFES/Projektspezifische Applikationdaten (pro DSM Element) DFC_IVDiaCylNoLd_4" VALUE 0x8002B476 Val_Wu8 255.0 OneToOne 0.00 255.0 /end CHARACTERISTIC
/begin CHARACTERISTIC DFES_Severity.DFC_IVDiaCylNoLd_5_C "DFES/Projektspezifische Applikationdaten (pro DSM Element) DFC_IVDiaCylNoLd_5" VALUE 0x8002B477 Val_Wu8 255.0 OneToOne 0.00 255.0 /end CHARACTERISTIC
/begin CHARACTERISTIC DFES_Severity.DFC_IVDiaCylShCir_0_C "DFES/Projektspezifische Applikationdaten (pro DSM Element) DFC_IVDiaCylShCir_0" VALUE 0x8002B478 Val_Wu8 255.0 OneToOne 0.00 255.0 /end CHARACTERISTIC
/begin CHARACTERISTIC DFES_Severity.DFC_IVDiaCylShCir_1_C "DFES/Projektspezifische Applikationdaten (pro DSM Element) DFC_IVDiaCylShCir_1" VALUE 0x8002B479 Val_Wu8 255.0 OneToOne 0.00 255.0 /end CHARACTERISTIC
/begin CHARACTERISTIC DFES_Severity.DFC_IVDiaCylShCir_2_C "DFES/Projektspezifische Applikationdaten (pro DSM Element) DFC_IVDiaCylShCir_2" VALUE 0x8002B47A Val_Wu8 255.0 OneToOne 0.00 255.0 /end CHARACTERISTIC
/begin CHARACTERISTIC DFES_Severity.DFC_IVDiaCylShCir_3_C "DFES/Projektspezifische Applikationdaten (pro DSM Element) DFC_IVDiaCylShCir_3" VALUE 0x8002B47B Val_Wu8 255.0 OneToOne 0.00 255.0 /end CHARACTERISTIC
/begin CHARACTERISTIC DFES_Severity.DFC_IVDiaCylShCir_4_C "DFES/Projektspezifische Applikationdaten (pro DSM Element) DFC_IVDiaCylShCir_4" VALUE 0x8002B47C Val_Wu8 255.0 OneToOne 0.00 255.0 /end CHARACTERISTIC
/begin CHARACTERISTIC DFES_Severity.DFC_IVDiaCylShCir_5_C "DFES/Projektspezifische Applikationdaten (pro DSM Element) DFC_IVDiaCylShCir_5" VALUE 0x8002B47D Val_Wu8 255.0 OneToOne 0.00 255.0 /end CHARACTERISTIC
/begin CHARACTERISTIC DFES_Severity.DFC_IVDiaCylShCirHSLS_0_C "DFES/Projektspezifische Applikationdaten (pro DSM Element) DFC_IVDiaCylShCirHSLS_0" VALUE 0x8002B47E Val_Wu8 255.0 OneToOne 0.00 255.0 /end CHARACTERISTIC
/begin CHARACTERISTIC DFES_Severity.DFC_IVDiaCylShCirHSLS_1_C "DFES/Projektspezifische Applikationdaten (pro DSM Element) DFC_IVDiaCylShCirHSLS_1" VALUE 0x8002B47F Val_Wu8 255.0 OneToOne 0.00 255.0 /end CHARACTERISTIC
/begin CHARACTERISTIC DFES_Severity.DFC_IVDiaCylShCirHSLS_2_C "DFES/Projektspezifische Applikationdaten (pro DSM Element) DFC_IVDiaCylShCirHSLS_2" VALUE 0x8002B480 Val_Wu8 255.0 OneToOne 0.00 255.0 /end CHARACTERISTIC
/begin CHARACTERISTIC DFES_Severity.DFC_IVDiaCylShCirHSLS_3_C "DFES/Projektspezifische Applikationdaten (pro DSM Element) DFC_IVDiaCylShCirHSLS_3" VALUE 0x8002B481 Val_Wu8 255.0 OneToOne 0.00 255.0 /end CHARACTERISTIC
/begin CHARACTERISTIC DFES_Severity.DFC_IVDiaCylShCirHSLS_4_C "DFES/Projektspezifische Applikationdaten (pro DSM Element) DFC_IVDiaCylShCirHSLS_4" VALUE 0x8002B482 Val_Wu8 255.0 OneToOne 0.00 255.0 /end CHARACTERISTIC
/begin CHARACTERISTIC DFES_Severity.DFC_IVDiaCylShCirHSLS_5_C "DFES/Projektspezifische Applikationdaten (pro DSM Element) DFC_IVDiaCylShCirHSLS_5" VALUE 0x8002B483 Val_Wu8 255.0 OneToOne 0.00 255.0 /end CHARACTERISTIC
/begin CHARACTERISTIC DFES_Severity.DFC_IVDiaCylShCirMeas_0_C "DFES/Projektspezifische Applikationdaten (pro DSM Element) DFC_IVDiaCylShCirMeas_0" VALUE 0x8002B484 Val_Wu8 255.0 OneToOne 0.00 255.0 /end CHARACTERISTIC
/begin CHARACTERISTIC DFES_Severity.DFC_IVDiaCylShCirMeas_1_C "DFES/Projektspezifische Applikationdaten (pro DSM Element) DFC_IVDiaCylShCirMeas_1" VALUE 0x8002B485 Val_Wu8 255.0 OneToOne 0.00 255.0 /end CHARACTERISTIC
/begin CHARACTERISTIC DFES_Severity.DFC_IVDiaCylShCirMeas_2_C "DFES/Projektspezifische Applikationdaten (pro DSM Element) DFC_IVDiaCylShCirMeas_2" VALUE 0x8002B486 Val_Wu8 255.0 OneToOne 0.00 255.0 /end CHARACTERISTIC
/begin CHARACTERISTIC DFES_Severity.DFC_IVDiaCylShCirMeas_3_C "DFES/Projektspezifische Applikationdaten (pro DSM Element) DFC_IVDiaCylShCirMeas_3" VALUE 0x8002B487 Val_Wu8 255.0 OneToOne 0.00 255.0 /end CHARACTERISTIC
/begin CHARACTERISTIC DFES_Severity.DFC_IVDiaCylShCirMeas_4_C "DFES/Projektspezifische Applikationdaten (pro DSM Element) DFC_IVDiaCylShCirMeas_4" VALUE 0x8002B488 Val_Wu8 255.0 OneToOne 0.00 255.0 /end CHARACTERISTIC
/begin CHARACTERISTIC DFES_Severity.DFC_IVDiaCylShCirMeas_5_C "DFES/Projektspezifische Applikationdaten (pro DSM Element) DFC_IVDiaCylShCirMeas_5" VALUE 0x8002B489 Val_Wu8 255.0 OneToOne 0.00 255.0 /end CHARACTERISTIC
/begin CHARACTERISTIC DFES_Severity.DFC_LSUDynChk_C "DFES/Projektspezifische Applikationdaten (pro DSM Element) DFC_LSUDynChk" VALUE 0x8002B48A Val_Wu8 255.0 OneToOne 0.00 255.0 /end CHARACTERISTIC
/begin CHARACTERISTIC DFES_Severity.DFC_LSUO2ClbMax_C "DFES/Projektspezifische Applikationdaten (pro DSM Element) DFC_LSUO2ClbMax" VALUE 0x8002B48B Val_Wu8 255.0 OneToOne 0.00 255.0 /end CHARACTERISTIC
/begin CHARACTERISTIC DFES_Severity.DFC_LSUO2ClbMin_C "DFES/Projektspezifische Applikationdaten (pro DSM Element) DFC_LSUO2ClbMin" VALUE 0x8002B48C Val_Wu8 255.0 OneToOne 0.00 255.0 /end CHARACTERISTIC
/begin CHARACTERISTIC DFES_Severity.DFC_LSUO2PlausMaxFLd_C "DFES/Projektspezifische Applikationdaten (pro DSM Element) DFC_LSUO2PlausMaxFLd" VALUE 0x8002B48D Val_Wu8 255.0 OneToOne 0.00 255.0 /end CHARACTERISTIC
/begin CHARACTERISTIC DFES_Severity.DFC_LSUO2PlausMaxOvrRun_C "DFES/Projektspezifische Applikationdaten (pro DSM Element) DFC_LSUO2PlausMaxOvrRun" VALUE 0x8002B48E Val_Wu8 255.0 OneToOne 0.00 255.0 /end CHARACTERISTIC
/begin CHARACTERISTIC DFES_Severity.DFC_LSUO2PlausMaxPartLd_C "DFES/Projektspezifische Applikationdaten (pro DSM Element) DFC_LSUO2PlausMaxPartLd" VALUE 0x8002B48F Val_Wu8 255.0 OneToOne 0.00 255.0 /end CHARACTERISTIC
/begin CHARACTERISTIC DFES_Severity.DFC_LSUO2PlausMinFLd_C "DFES/Projektspezifische Applikationdaten (pro DSM Element) DFC_LSUO2PlausMinFLd" VALUE 0x8002B490 Val_Wu8 255.0 OneToOne 0.00 255.0 /end CHARACTERISTIC
/begin CHARACTERISTIC DFES_Severity.DFC_LSUO2PlausMinOvrRun_C "DFES/Projektspezifische Applikationdaten (pro DSM Element) DFC_LSUO2PlausMinOvrRun" VALUE 0x8002B491 Val_Wu8 255.0 OneToOne 0.00 255.0 /end CHARACTERISTIC
/begin CHARACTERISTIC DFES_Severity.DFC_LSUO2PlausMinPartLd_C "DFES/Projektspezifische Applikationdaten (pro DSM Element) DFC_LSUO2PlausMinPartLd" VALUE 0x8002B492 Val_Wu8 255.0 OneToOne 0.00 255.0 /end CHARACTERISTIC
/begin CHARACTERISTIC DFES_Severity.DFC_LSURiClbMax_C "DFES/Projektspezifische Applikationdaten (pro DSM Element) DFC_LSURiClbMax" VALUE 0x8002B493 Val_Wu8 255.0 OneToOne 0.00 255.0 /end CHARACTERISTIC
/begin CHARACTERISTIC DFES_Severity.DFC_LSURiClbMin_C "DFES/Projektspezifische Applikationdaten (pro DSM Element) DFC_LSURiClbMin" VALUE 0x8002B494 Val_Wu8 255.0 OneToOne 0.00 255.0 /end CHARACTERISTIC
/begin CHARACTERISTIC DFES_Severity.DFC_LSUWireIPSig_C "DFES/Projektspezifische Applikationdaten (pro DSM Element) DFC_LSUWireIPSig" VALUE 0x8002B495 Val_Wu8 255.0 OneToOne 0.00 255.0 /end CHARACTERISTIC
/begin CHARACTERISTIC DFES_Severity.DFC_Layer_BSDMax_C "DFES/Projektspezifische Applikationdaten (pro DSM Element) DFC_Layer_BSDMax" VALUE 0x8002B496 Val_Wu8 255.0 OneToOne 0.00 255.0 /end CHARACTERISTIC
/begin CHARACTERISTIC DFES_Severity.DFC_Layer_BSDMin_C "DFES/Projektspezifische Applikationdaten (pro DSM Element) DFC_Layer_BSDMin" VALUE 0x8002B497 Val_Wu8 255.0 OneToOne 0.00 255.0 /end CHARACTERISTIC
/begin CHARACTERISTIC DFES_Severity.DFC_Layer_BSDNpl_C "DFES/Projektspezifische Applikationdaten (pro DSM Element) DFC_Layer_BSDNpl" VALUE 0x8002B498 Val_Wu8 255.0 OneToOne 0.00 255.0 /end CHARACTERISTIC
/begin CHARACTERISTIC DFES_Severity.DFC_Layer_BSDSig_C "DFES/Projektspezifische Applikationdaten (pro DSM Element) DFC_Layer_BSDSig" VALUE 0x8002B499 Val_Wu8 255.0 OneToOne 0.00 255.0 /end CHARACTERISTIC
/begin CHARACTERISTIC DFES_Severity.DFC_Layer_FltMngTstMax_C "DFES/Projektspezifische Applikationdaten (pro DSM Element) DFC_Layer_FltMngTstMax" VALUE 0x8002B49A Val_Wu8 255.0 OneToOne 0.00 255.0 /end CHARACTERISTIC
/begin CHARACTERISTIC DFES_Severity.DFC_Layer_FltMngTstMin_C "DFES/Projektspezifische Applikationdaten (pro DSM Element) DFC_Layer_FltMngTstMin" VALUE 0x8002B49B Val_Wu8 255.0 OneToOne 0.00 255.0 /end CHARACTERISTIC
/begin CHARACTERISTIC DFES_Severity.DFC_Layer_FltMngTstNpl_C "DFES/Projektspezifische Applikationdaten (pro DSM Element) DFC_Layer_FltMngTstNpl" VALUE 0x8002B49C Val_Wu8 255.0 OneToOne 0.00 255.0 /end CHARACTERISTIC
/begin CHARACTERISTIC DFES_Severity.DFC_Layer_FltMngTstSig_C "DFES/Projektspezifische Applikationdaten (pro DSM Element) DFC_Layer_FltMngTstSig" VALUE 0x8002B49D Val_Wu8 255.0 OneToOne 0.00 255.0 /end CHARACTERISTIC
/begin CHARACTERISTIC DFES_Severity.DFC_Layer_GENELBMax_C "DFES/Projektspezifische Applikationdaten (pro DSM Element) DFC_Layer_GENELBMax" VALUE 0x8002B49E Val_Wu8 255.0 OneToOne 0.00 255.0 /end CHARACTERISTIC
/begin CHARACTERISTIC DFES_Severity.DFC_Layer_GENELBMin_C "DFES/Projektspezifische Applikationdaten (pro DSM Element) DFC_Layer_GENELBMin" VALUE 0x8002B49F Val_Wu8 255.0 OneToOne 0.00 255.0 /end CHARACTERISTIC
/begin CHARACTERISTIC DFES_Severity.DFC_Layer_GENELBNpl_C "DFES/Projektspezifische Applikationdaten (pro DSM Element) DFC_Layer_GENELBNpl" VALUE 0x8002B4A0 Val_Wu8 255.0 OneToOne 0.00 255.0 /end CHARACTERISTIC
/begin CHARACTERISTIC DFES_Severity.DFC_Layer_GENELBSig_C "DFES/Projektspezifische Applikationdaten (pro DSM Element) DFC_Layer_GENELBSig" VALUE 0x8002B4A1 Val_Wu8 255.0 OneToOne 0.00 255.0 /end CHARACTERISTIC
/begin CHARACTERISTIC DFES_Severity.DFC_Layer_GENELMax_C "DFES/Projektspezifische Applikationdaten (pro DSM Element) DFC_Layer_GENELMax" VALUE 0x8002B4A2 Val_Wu8 255.0 OneToOne 0.00 255.0 /end CHARACTERISTIC
/begin CHARACTERISTIC DFES_Severity.DFC_Layer_GENELMin_C "DFES/Projektspezifische Applikationdaten (pro DSM Element) DFC_Layer_GENELMin" VALUE 0x8002B4A3 Val_Wu8 255.0 OneToOne 0.00 255.0 /end CHARACTERISTIC
/begin CHARACTERISTIC DFES_Severity.DFC_Layer_GENELNpl_C "DFES/Projektspezifische Applikationdaten (pro DSM Element) DFC_Layer_GENELNpl" VALUE 0x8002B4A4 Val_Wu8 255.0 OneToOne 0.00 255.0 /end CHARACTERISTIC
/begin CHARACTERISTIC DFES_Severity.DFC_Layer_GENELSig_C "DFES/Projektspezifische Applikationdaten (pro DSM Element) DFC_Layer_GENELSig" VALUE 0x8002B4A5 Val_Wu8 255.0 OneToOne 0.00 255.0 /end CHARACTERISTIC
/begin CHARACTERISTIC DFES_Severity.DFC_Layer_GENHTBMax_C "DFES/Projektspezifische Applikationdaten (pro DSM Element) DFC_Layer_GENHTBMax" VALUE 0x8002B4A6 Val_Wu8 255.0 OneToOne 0.00 255.0 /end CHARACTERISTIC
/begin CHARACTERISTIC DFES_Severity.DFC_Layer_GENHTBMin_C "DFES/Projektspezifische Applikationdaten (pro DSM Element) DFC_Layer_GENHTBMin" VALUE 0x8002B4A7 Val_Wu8 255.0 OneToOne 0.00 255.0 /end CHARACTERISTIC
/begin CHARACTERISTIC DFES_Severity.DFC_Layer_GENHTBNpl_C "DFES/Projektspezifische Applikationdaten (pro DSM Element) DFC_Layer_GENHTBNpl" VALUE 0x8002B4A8 Val_Wu8 255.0 OneToOne 0.00 255.0 /end CHARACTERISTIC
/begin CHARACTERISTIC DFES_Severity.DFC_Layer_GENHTBSig_C "DFES/Projektspezifische Applikationdaten (pro DSM Element) DFC_Layer_GENHTBSig" VALUE 0x8002B4A9 Val_Wu8 255.0 OneToOne 0.00 255.0 /end CHARACTERISTIC
/begin CHARACTERISTIC DFES_Severity.DFC_Layer_GENHTMax_C "DFES/Projektspezifische Applikationdaten (pro DSM Element) DFC_Layer_GENHTMax" VALUE 0x8002B4AA Val_Wu8 255.0 OneToOne 0.00 255.0 /end CHARACTERISTIC
/begin CHARACTERISTIC DFES_Severity.DFC_Layer_GENHTMin_C "DFES/Projektspezifische Applikationdaten (pro DSM Element) DFC_Layer_GENHTMin" VALUE 0x8002B4AB Val_Wu8 255.0 OneToOne 0.00 255.0 /end CHARACTERISTIC
/begin CHARACTERISTIC DFES_Severity.DFC_Layer_GENHTNpl_C "DFES/Projektspezifische Applikationdaten (pro DSM Element) DFC_Layer_GENHTNpl" VALUE 0x8002B4AC Val_Wu8 255.0 OneToOne 0.00 255.0 /end CHARACTERISTIC
/begin CHARACTERISTIC DFES_Severity.DFC_Layer_GENHTSig_C "DFES/Projektspezifische Applikationdaten (pro DSM Element) DFC_Layer_GENHTSig" VALUE 0x8002B4AD Val_Wu8 255.0 OneToOne 0.00 255.0 /end CHARACTERISTIC
/begin CHARACTERISTIC DFES_Severity.DFC_Layer_GENKOMMMax_C "DFES/Projektspezifische Applikationdaten (pro DSM Element) DFC_Layer_GENKOMMMax" VALUE 0x8002B4AE Val_Wu8 255.0 OneToOne 0.00 255.0 /end CHARACTERISTIC
/begin CHARACTERISTIC DFES_Severity.DFC_Layer_GENKOMMMin_C "DFES/Projektspezifische Applikationdaten (pro DSM Element) DFC_Layer_GENKOMMMin" VALUE 0x8002B4AF Val_Wu8 255.0 OneToOne 0.00 255.0 /end CHARACTERISTIC
/begin CHARACTERISTIC DFES_Severity.DFC_Layer_GENKOMMNpl_C "DFES/Projektspezifische Applikationdaten (pro DSM Element) DFC_Layer_GENKOMMNpl" VALUE 0x8002B4B0 Val_Wu8 255.0 OneToOne 0.00 255.0 /end CHARACTERISTIC
/begin CHARACTERISTIC DFES_Severity.DFC_Layer_GENKOMMSig_C "DFES/Projektspezifische Applikationdaten (pro DSM Element) DFC_Layer_GENKOMMSig" VALUE 0x8002B4B1 Val_Wu8 255.0 OneToOne 0.00 255.0 /end CHARACTERISTIC
/begin CHARACTERISTIC DFES_Severity.DFC_Layer_GENMECHMax_C "DFES/Projektspezifische Applikationdaten (pro DSM Element) DFC_Layer_GENMECHMax" VALUE 0x8002B4B2 Val_Wu8 255.0 OneToOne 0.00 255.0 /end CHARACTERISTIC
/begin CHARACTERISTIC DFES_Severity.DFC_Layer_GENMECHMin_C "DFES/Projektspezifische Applikationdaten (pro DSM Element) DFC_Layer_GENMECHMin" VALUE 0x8002B4B3 Val_Wu8 255.0 OneToOne 0.00 255.0 /end CHARACTERISTIC
/begin CHARACTERISTIC DFES_Severity.DFC_Layer_GENMECHNpl_C "DFES/Projektspezifische Applikationdaten (pro DSM Element) DFC_Layer_GENMECHNpl" VALUE 0x8002B4B4 Val_Wu8 255.0 OneToOne 0.00 255.0 /end CHARACTERISTIC
/begin CHARACTERISTIC DFES_Severity.DFC_Layer_GENMECHSig_C "DFES/Projektspezifische Applikationdaten (pro DSM Element) DFC_Layer_GENMECHSig" VALUE 0x8002B4B5 Val_Wu8 255.0 OneToOne 0.00 255.0 /end CHARACTERISTIC
/begin CHARACTERISTIC DFES_Severity.DFC_Layer_GENMax_C "DFES/Projektspezifische Applikationdaten (pro DSM Element) DFC_Layer_GENMax" VALUE 0x8002B4B6 Val_Wu8 255.0 OneToOne 0.00 255.0 /end CHARACTERISTIC
/begin CHARACTERISTIC DFES_Severity.DFC_Layer_GENMin_C "DFES/Projektspezifische Applikationdaten (pro DSM Element) DFC_Layer_GENMin" VALUE 0x8002B4B7 Val_Wu8 255.0 OneToOne 0.00 255.0 /end CHARACTERISTIC
/begin CHARACTERISTIC DFES_Severity.DFC_Layer_GENNpl_C "DFES/Projektspezifische Applikationdaten (pro DSM Element) DFC_Layer_GENNpl" VALUE 0x8002B4B8 Val_Wu8 255.0 OneToOne 0.00 255.0 /end CHARACTERISTIC
/begin CHARACTERISTIC DFES_Severity.DFC_Layer_GENREGUPLMax_C "DFES/Projektspezifische Applikationdaten (pro DSM Element) DFC_Layer_GENREGUPLMax" VALUE 0x8002B4B9 Val_Wu8 255.0 OneToOne 0.00 255.0 /end CHARACTERISTIC
/begin CHARACTERISTIC DFES_Severity.DFC_Layer_GENREGUPLMin_C "DFES/Projektspezifische Applikationdaten (pro DSM Element) DFC_Layer_GENREGUPLMin" VALUE 0x8002B4BA Val_Wu8 255.0 OneToOne 0.00 255.0 /end CHARACTERISTIC
/begin CHARACTERISTIC DFES_Severity.DFC_Layer_GENREGUPLNpl_C "DFES/Projektspezifische Applikationdaten (pro DSM Element) DFC_Layer_GENREGUPLNpl" VALUE 0x8002B4BB Val_Wu8 255.0 OneToOne 0.00 255.0 /end CHARACTERISTIC
/begin CHARACTERISTIC DFES_Severity.DFC_Layer_GENREGUPLSig_C "DFES/Projektspezifische Applikationdaten (pro DSM Element) DFC_Layer_GENREGUPLSig" VALUE 0x8002B4BC Val_Wu8 255.0 OneToOne 0.00 255.0 /end CHARACTERISTIC
/begin CHARACTERISTIC DFES_Severity.DFC_Layer_GENSig_C "DFES/Projektspezifische Applikationdaten (pro DSM Element) DFC_Layer_GENSig" VALUE 0x8002B4BD Val_Wu8 255.0 OneToOne 0.00 255.0 /end CHARACTERISTIC
/begin CHARACTERISTIC DFES_Severity.DFC_Layer_GENUPLMax_C "DFES/Projektspezifische Applikationdaten (pro DSM Element) DFC_Layer_GENUPLMax" VALUE 0x8002B4BE Val_Wu8 255.0 OneToOne 0.00 255.0 /end CHARACTERISTIC
/begin CHARACTERISTIC DFES_Severity.DFC_Layer_GENUPLMin_C "DFES/Projektspezifische Applikationdaten (pro DSM Element) DFC_Layer_GENUPLMin" VALUE 0x8002B4BF Val_Wu8 255.0 OneToOne 0.00 255.0 /end CHARACTERISTIC
/begin CHARACTERISTIC DFES_Severity.DFC_Layer_GENUPLNpl_C "DFES/Projektspezifische Applikationdaten (pro DSM Element) DFC_Layer_GENUPLNpl" VALUE 0x8002B4C0 Val_Wu8 255.0 OneToOne 0.00 255.0 /end CHARACTERISTIC
/begin CHARACTERISTIC DFES_Severity.DFC_Layer_GENUPLSig_C "DFES/Projektspezifische Applikationdaten (pro DSM Element) DFC_Layer_GENUPLSig" VALUE 0x8002B4C1 Val_Wu8 255.0 OneToOne 0.00 255.0 /end CHARACTERISTIC
/begin CHARACTERISTIC DFES_Severity.DFC_Layer_IBS1Max_C "DFES/Projektspezifische Applikationdaten (pro DSM Element) DFC_Layer_IBS1Max" VALUE 0x8002B4C2 Val_Wu8 255.0 OneToOne 0.00 255.0 /end CHARACTERISTIC
/begin CHARACTERISTIC DFES_Severity.DFC_Layer_IBS1Min_C "DFES/Projektspezifische Applikationdaten (pro DSM Element) DFC_Layer_IBS1Min" VALUE 0x8002B4C3 Val_Wu8 255.0 OneToOne 0.00 255.0 /end CHARACTERISTIC
/begin CHARACTERISTIC DFES_Severity.DFC_Layer_IBS1Npl_C "DFES/Projektspezifische Applikationdaten (pro DSM Element) DFC_Layer_IBS1Npl" VALUE 0x8002B4C4 Val_Wu8 255.0 OneToOne 0.00 255.0 /end CHARACTERISTIC
/begin CHARACTERISTIC DFES_Severity.DFC_Layer_IBS1Sig_C "DFES/Projektspezifische Applikationdaten (pro DSM Element) DFC_Layer_IBS1Sig" VALUE 0x8002B4C5 Val_Wu8 255.0 OneToOne 0.00 255.0 /end CHARACTERISTIC
/begin CHARACTERISTIC DFES_Severity.DFC_Layer_IBS2Max_C "DFES/Projektspezifische Applikationdaten (pro DSM Element) DFC_Layer_IBS2Max" VALUE 0x8002B4C6 Val_Wu8 255.0 OneToOne 0.00 255.0 /end CHARACTERISTIC
/begin CHARACTERISTIC DFES_Severity.DFC_Layer_IBS2Min_C "DFES/Projektspezifische Applikationdaten (pro DSM Element) DFC_Layer_IBS2Min" VALUE 0x8002B4C7 Val_Wu8 255.0 OneToOne 0.00 255.0 /end CHARACTERISTIC
/begin CHARACTERISTIC DFES_Severity.DFC_Layer_IBS2Npl_C "DFES/Projektspezifische Applikationdaten (pro DSM Element) DFC_Layer_IBS2Npl" VALUE 0x8002B4C8 Val_Wu8 255.0 OneToOne 0.00 255.0 /end CHARACTERISTIC
/begin CHARACTERISTIC DFES_Severity.DFC_Layer_IBS2Sig_C "DFES/Projektspezifische Applikationdaten (pro DSM Element) DFC_Layer_IBS2Sig" VALUE 0x8002B4C9 Val_Wu8 255.0 OneToOne 0.00 255.0 /end CHARACTERISTIC
/begin CHARACTERISTIC DFES_Severity.DFC_Layer_IBS3Max_C "DFES/Projektspezifische Applikationdaten (pro DSM Element) DFC_Layer_IBS3Max" VALUE 0x8002B4CA Val_Wu8 255.0 OneToOne 0.00 255.0 /end CHARACTERISTIC
/begin CHARACTERISTIC DFES_Severity.DFC_Layer_IBS3Min_C "DFES/Projektspezifische Applikationdaten (pro DSM Element) DFC_Layer_IBS3Min" VALUE 0x8002B4CB Val_Wu8 255.0 OneToOne 0.00 255.0 /end CHARACTERISTIC
/begin CHARACTERISTIC DFES_Severity.DFC_Layer_IBS3Npl_C "DFES/Projektspezifische Applikationdaten (pro DSM Element) DFC_Layer_IBS3Npl" VALUE 0x8002B4CC Val_Wu8 255.0 OneToOne 0.00 255.0 /end CHARACTERISTIC
/begin CHARACTERISTIC DFES_Severity.DFC_Layer_IBS3Sig_C "DFES/Projektspezifische Applikationdaten (pro DSM Element) DFC_Layer_IBS3Sig" VALUE 0x8002B4CD Val_Wu8 255.0 OneToOne 0.00 255.0 /end CHARACTERISTIC
/begin CHARACTERISTIC DFES_Severity.DFC_Layer_MANDETEKMax_C "DFES/Projektspezifische Applikationdaten (pro DSM Element) DFC_Layer_MANDETEKMax" VALUE 0x8002B4CE Val_Wu8 255.0 OneToOne 0.00 255.0 /end CHARACTERISTIC
/begin CHARACTERISTIC DFES_Severity.DFC_Layer_MANDETEKMin_C "DFES/Projektspezifische Applikationdaten (pro DSM Element) DFC_Layer_MANDETEKMin" VALUE 0x8002B4CF Val_Wu8 255.0 OneToOne 0.00 255.0 /end CHARACTERISTIC
/begin CHARACTERISTIC DFES_Severity.DFC_Layer_MANDETEKNpl_C "DFES/Projektspezifische Applikationdaten (pro DSM Element) DFC_Layer_MANDETEKNpl" VALUE 0x8002B4D0 Val_Wu8 255.0 OneToOne 0.00 255.0 /end CHARACTERISTIC
/begin CHARACTERISTIC DFES_Severity.DFC_Layer_MANDETEKSig_C "DFES/Projektspezifische Applikationdaten (pro DSM Element) DFC_Layer_MANDETEKSig" VALUE 0x8002B4D1 Val_Wu8 255.0 OneToOne 0.00 255.0 /end CHARACTERISTIC
/begin CHARACTERISTIC DFES_Severity.DFC_Layer_NDR1Max_C "DFES/Projektspezifische Applikationdaten (pro DSM Element) DFC_Layer_NDR1Max" VALUE 0x8002B4D2 Val_Wu8 255.0 OneToOne 0.00 255.0 /end CHARACTERISTIC
/begin CHARACTERISTIC DFES_Severity.DFC_Layer_NDR1Min_C "DFES/Projektspezifische Applikationdaten (pro DSM Element) DFC_Layer_NDR1Min" VALUE 0x8002B4D3 Val_Wu8 255.0 OneToOne 0.00 255.0 /end CHARACTERISTIC
/begin CHARACTERISTIC DFES_Severity.DFC_Layer_NDR1Npl_C "DFES/Projektspezifische Applikationdaten (pro DSM Element) DFC_Layer_NDR1Npl" VALUE 0x8002B4D4 Val_Wu8 255.0 OneToOne 0.00 255.0 /end CHARACTERISTIC
/begin CHARACTERISTIC DFES_Severity.DFC_Layer_NDR1Sig_C "DFES/Projektspezifische Applikationdaten (pro DSM Element) DFC_Layer_NDR1Sig" VALUE 0x8002B4D5 Val_Wu8 255.0 OneToOne 0.00 255.0 /end CHARACTERISTIC
/begin CHARACTERISTIC DFES_Severity.DFC_Layer_NDR2Max_C "DFES/Projektspezifische Applikationdaten (pro DSM Element) DFC_Layer_NDR2Max" VALUE 0x8002B4D6 Val_Wu8 255.0 OneToOne 0.00 255.0 /end CHARACTERISTIC
/begin CHARACTERISTIC DFES_Severity.DFC_Layer_NDR2Min_C "DFES/Projektspezifische Applikationdaten (pro DSM Element) DFC_Layer_NDR2Min" VALUE 0x8002B4D7 Val_Wu8 255.0 OneToOne 0.00 255.0 /end CHARACTERISTIC
/begin CHARACTERISTIC DFES_Severity.DFC_Layer_NDR2Npl_C "DFES/Projektspezifische Applikationdaten (pro DSM Element) DFC_Layer_NDR2Npl" VALUE 0x8002B4D8 Val_Wu8 255.0 OneToOne 0.00 255.0 /end CHARACTERISTIC
/begin CHARACTERISTIC DFES_Severity.DFC_Layer_NDR2Sig_C "DFES/Projektspezifische Applikationdaten (pro DSM Element) DFC_Layer_NDR2Sig" VALUE 0x8002B4D9 Val_Wu8 255.0 OneToOne 0.00 255.0 /end CHARACTERISTIC
/begin CHARACTERISTIC DFES_Severity.DFC_Layer_NGLERNMax_C "DFES/Projektspezifische Applikationdaten (pro DSM Element) DFC_Layer_NGLERNMax" VALUE 0x8002B4DA Val_Wu8 255.0 OneToOne 0.00 255.0 /end CHARACTERISTIC
/begin CHARACTERISTIC DFES_Severity.DFC_Layer_NGLERNMin_C "DFES/Projektspezifische Applikationdaten (pro DSM Element) DFC_Layer_NGLERNMin" VALUE 0x8002B4DB Val_Wu8 255.0 OneToOne 0.00 255.0 /end CHARACTERISTIC
/begin CHARACTERISTIC DFES_Severity.DFC_Layer_NGLERNNpl_C "DFES/Projektspezifische Applikationdaten (pro DSM Element) DFC_Layer_NGLERNNpl" VALUE 0x8002B4DC Val_Wu8 255.0 OneToOne 0.00 255.0 /end CHARACTERISTIC
/begin CHARACTERISTIC DFES_Severity.DFC_Layer_NGLERNSig_C "DFES/Projektspezifische Applikationdaten (pro DSM Element) DFC_Layer_NGLERNSig" VALUE 0x8002B4DD Val_Wu8 255.0 OneToOne 0.00 255.0 /end CHARACTERISTIC
/begin CHARACTERISTIC DFES_Severity.DFC_Layer_PMBATTMax_C "DFES/Projektspezifische Applikationdaten (pro DSM Element) DFC_Layer_PMBATTMax" VALUE 0x8002B4DE Val_Wu8 255.0 OneToOne 0.00 255.0 /end CHARACTERISTIC
/begin CHARACTERISTIC DFES_Severity.DFC_Layer_PMBATTMin_C "DFES/Projektspezifische Applikationdaten (pro DSM Element) DFC_Layer_PMBATTMin" VALUE 0x8002B4DF Val_Wu8 255.0 OneToOne 0.00 255.0 /end CHARACTERISTIC
/begin CHARACTERISTIC DFES_Severity.DFC_Layer_PMBATTNpl_C "DFES/Projektspezifische Applikationdaten (pro DSM Element) DFC_Layer_PMBATTNpl" VALUE 0x8002B4E0 Val_Wu8 255.0 OneToOne 0.00 255.0 /end CHARACTERISTIC
/begin CHARACTERISTIC DFES_Severity.DFC_Layer_PMBATTSig_C "DFES/Projektspezifische Applikationdaten (pro DSM Element) DFC_Layer_PMBATTSig" VALUE 0x8002B4E1 Val_Wu8 255.0 OneToOne 0.00 255.0 /end CHARACTERISTIC
/begin CHARACTERISTIC DFES_Severity.DFC_Layer_PMBNMax_C "DFES/Projektspezifische Applikationdaten (pro DSM Element) DFC_Layer_PMBNMax" VALUE 0x8002B4E2 Val_Wu8 255.0 OneToOne 0.00 255.0 /end CHARACTERISTIC
/begin CHARACTERISTIC DFES_Severity.DFC_Layer_PMBNMin_C "DFES/Projektspezifische Applikationdaten (pro DSM Element) DFC_Layer_PMBNMin" VALUE 0x8002B4E3 Val_Wu8 255.0 OneToOne 0.00 255.0 /end CHARACTERISTIC
/begin CHARACTERISTIC DFES_Severity.DFC_Layer_PMBNNpl_C "DFES/Projektspezifische Applikationdaten (pro DSM Element) DFC_Layer_PMBNNpl" VALUE 0x8002B4E4 Val_Wu8 255.0 OneToOne 0.00 255.0 /end CHARACTERISTIC
/begin CHARACTERISTIC DFES_Severity.DFC_Layer_PMBNSig_C "DFES/Projektspezifische Applikationdaten (pro DSM Element) DFC_Layer_PMBNSig" VALUE 0x8002B4E5 Val_Wu8 255.0 OneToOne 0.00 255.0 /end CHARACTERISTIC
/begin CHARACTERISTIC DFES_Severity.DFC_Layer_PMRUHVERLMax_C "DFES/Projektspezifische Applikationdaten (pro DSM Element) DFC_Layer_PMRUHVERLMax" VALUE 0x8002B4E6 Val_Wu8 255.0 OneToOne 0.00 255.0 /end CHARACTERISTIC
/begin CHARACTERISTIC DFES_Severity.DFC_Layer_PMRUHVERLMin_C "DFES/Projektspezifische Applikationdaten (pro DSM Element) DFC_Layer_PMRUHVERLMin" VALUE 0x8002B4E7 Val_Wu8 255.0 OneToOne 0.00 255.0 /end CHARACTERISTIC
/begin CHARACTERISTIC DFES_Severity.DFC_Layer_PMRUHVERLNpl_C "DFES/Projektspezifische Applikationdaten (pro DSM Element) DFC_Layer_PMRUHVERLNpl" VALUE 0x8002B4E8 Val_Wu8 255.0 OneToOne 0.00 255.0 /end CHARACTERISTIC
/begin CHARACTERISTIC DFES_Severity.DFC_Layer_PMRUHVERLSig_C "DFES/Projektspezifische Applikationdaten (pro DSM Element) DFC_Layer_PMRUHVERLSig" VALUE 0x8002B4E9 Val_Wu8 255.0 OneToOne 0.00 255.0 /end CHARACTERISTIC
/begin CHARACTERISTIC DFES_Severity.DFC_Layer_QLTMax_C "DFES/Projektspezifische Applikationdaten (pro DSM Element) DFC_Layer_QLTMax" VALUE 0x8002B4EA Val_Wu8 255.0 OneToOne 0.00 255.0 /end CHARACTERISTIC
/begin CHARACTERISTIC DFES_Severity.DFC_Layer_QLTMin_C "DFES/Projektspezifische Applikationdaten (pro DSM Element) DFC_Layer_QLTMin" VALUE 0x8002B4EB Val_Wu8 255.0 OneToOne 0.00 255.0 /end CHARACTERISTIC
/begin CHARACTERISTIC DFES_Severity.DFC_Layer_QLTNpl_C "DFES/Projektspezifische Applikationdaten (pro DSM Element) DFC_Layer_QLTNpl" VALUE 0x8002B4EC Val_Wu8 255.0 OneToOne 0.00 255.0 /end CHARACTERISTIC
/begin CHARACTERISTIC DFES_Severity.DFC_Layer_QLTSig_C "DFES/Projektspezifische Applikationdaten (pro DSM Element) DFC_Layer_QLTSig" VALUE 0x8002B4ED Val_Wu8 255.0 OneToOne 0.00 255.0 /end CHARACTERISTIC
/begin CHARACTERISTIC DFES_Severity.DFC_Layer_TOENSMax_C "DFES/Projektspezifische Applikationdaten (pro DSM Element) DFC_Layer_TOENSMax" VALUE 0x8002B4EE Val_Wu8 255.0 OneToOne 0.00 255.0 /end CHARACTERISTIC
/begin CHARACTERISTIC DFES_Severity.DFC_Layer_TOENSMin_C "DFES/Projektspezifische Applikationdaten (pro DSM Element) DFC_Layer_TOENSMin" VALUE 0x8002B4EF Val_Wu8 255.0 OneToOne 0.00 255.0 /end CHARACTERISTIC
/begin CHARACTERISTIC DFES_Severity.DFC_Layer_TOENSNpl_C "DFES/Projektspezifische Applikationdaten (pro DSM Element) DFC_Layer_TOENSNpl" VALUE 0x8002B4F0 Val_Wu8 255.0 OneToOne 0.00 255.0 /end CHARACTERISTIC
/begin CHARACTERISTIC DFES_Severity.DFC_Layer_TOENSSig_C "DFES/Projektspezifische Applikationdaten (pro DSM Element) DFC_Layer_TOENSSig" VALUE 0x8002B4F1 Val_Wu8 255.0 OneToOne 0.00 255.0 /end CHARACTERISTIC
/begin CHARACTERISTIC DFES_Severity.DFC_MonLimCurr_C "DFES/Projektspezifische Applikationdaten (pro DSM Element) DFC_MonLimCurr" VALUE 0x8002B4F2 Val_Wu8 255.0 OneToOne 0.00 255.0 /end CHARACTERISTIC
/begin CHARACTERISTIC DFES_Severity.DFC_MonLimLead_C "DFES/Projektspezifische Applikationdaten (pro DSM Element) DFC_MonLimLead" VALUE 0x8002B4F3 Val_Wu8 255.0 OneToOne 0.00 255.0 /end CHARACTERISTIC
/begin CHARACTERISTIC DFES_Severity.DFC_MonLimSet_C "DFES/Projektspezifische Applikationdaten (pro DSM Element) DFC_MonLimSet" VALUE 0x8002B4F4 Val_Wu8 255.0 OneToOne 0.00 255.0 /end CHARACTERISTIC
/begin CHARACTERISTIC DFES_Severity.DFC_NSCDsNOxOfsMax_C "DFES/" VALUE 0x8002B4F5 Val_Wu8 255.0 OneToOne 0.00 255.0 /end CHARACTERISTIC
/begin CHARACTERISTIC DFES_Severity.DFC_NSCDsNOxOfsMin_C "DFES/" VALUE 0x8002B4F6 Val_Wu8 255.0 OneToOne 0.00 255.0 /end CHARACTERISTIC
/begin CHARACTERISTIC DFES_Severity.DFC_NSCDsNOxPlausMin_C "DFES/" VALUE 0x8002B4F7 Val_Wu8 255.0 OneToOne 0.00 255.0 /end CHARACTERISTIC
/begin CHARACTERISTIC DFES_Severity.DFC_NoCat2DsNOxOfsMax_C "DFES/" VALUE 0x8002B4F8 Val_Wu8 255.0 OneToOne 0.00 255.0 /end CHARACTERISTIC
/begin CHARACTERISTIC DFES_Severity.DFC_NoCat2DsNOxOfsMin_C "DFES/" VALUE 0x8002B4F9 Val_Wu8 255.0 OneToOne 0.00 255.0 /end CHARACTERISTIC
/begin CHARACTERISTIC DFES_Severity.DFC_NoCat2DsNOxPlausMin_C "DFES/" VALUE 0x8002B4FA Val_Wu8 255.0 OneToOne 0.00 255.0 /end CHARACTERISTIC
/begin CHARACTERISTIC DFES_Severity.DFC_PCVNoStrt_C "DFES/Projektspezifische Applikationdaten (pro DSM Element) DFC_PCVNoStrt" VALUE 0x8002B4FB Val_Wu8 255.0 OneToOne 0.00 255.0 /end CHARACTERISTIC
/begin CHARACTERISTIC DFES_Severity.DFC_RailPGradMon_C "DFES/" VALUE 0x8002B4FC Val_Wu8 255.0 OneToOne 0.00 255.0 /end CHARACTERISTIC
/begin CHARACTERISTIC DFES_Severity.DFC_SCRPODPresBuildUp_C "DFES/" VALUE 0x8002B4FD Val_Wu8 255.0 OneToOne 0.00 255.0 /end CHARACTERISTIC
/begin CHARACTERISTIC DFES_Severity.DFC_AFSDrftIdlAdjVal_C "DFES/Projektspezifische Applikationdaten (pro DSM Element) DFC_AFSDrftIdlAdjVal" VALUE 0x8002B4FE Val_Wu8 255.0 OneToOne 0.00 255.0 /end CHARACTERISTIC
/begin CHARACTERISTIC DFES_Severity.DFC_AFSDrftLdAdjVal_C "DFES/Projektspezifische Applikationdaten (pro DSM Element) DFC_AFSDrftLdAdjVal" VALUE 0x8002B4FF Val_Wu8 255.0 OneToOne 0.00 255.0 /end CHARACTERISTIC
/begin CHARACTERISTIC DFES_Severity.DFC_AdcIADC0Cal_C "DFES/Projektspezifische Applikationdaten (pro DSM Element) DFC_AdcIADC0Cal" VALUE 0x8002B500 Val_Wu8 255.0 OneToOne 0.00 255.0 /end CHARACTERISTIC
/begin CHARACTERISTIC DFES_Severity.DFC_AdcIADC0Conv_C "DFES/Projektspezifische Applikationdaten (pro DSM Element) DFC_AdcIADC0Conv" VALUE 0x8002B501 Val_Wu8 255.0 OneToOne 0.00 255.0 /end CHARACTERISTIC
/begin CHARACTERISTIC DFES_Severity.DFC_AdcIADC1Cal_C "DFES/Projektspezifische Applikationdaten (pro DSM Element) DFC_AdcIADC1Cal" VALUE 0x8002B502 Val_Wu8 255.0 OneToOne 0.00 255.0 /end CHARACTERISTIC
/begin CHARACTERISTIC DFES_Severity.DFC_AdcIADC1Conv_C "DFES/Projektspezifische Applikationdaten (pro DSM Element) DFC_AdcIADC1Conv" VALUE 0x8002B503 Val_Wu8 255.0 OneToOne 0.00 255.0 /end CHARACTERISTIC
/begin CHARACTERISTIC DFES_Severity.DFC_CmbChbMisfireMax_0_C "DFES/Projektspezifische Applikationdaten (pro DSM Element) DFC_CmbChbMisfireMax_0" VALUE 0x8002B504 Val_Wu8 255.0 OneToOne 0.00 255.0 /end CHARACTERISTIC
/begin CHARACTERISTIC DFES_Severity.DFC_CmbChbMisfireMax_1_C "DFES/Projektspezifische Applikationdaten (pro DSM Element) DFC_CmbChbMisfireMax_1" VALUE 0x8002B505 Val_Wu8 255.0 OneToOne 0.00 255.0 /end CHARACTERISTIC
/begin CHARACTERISTIC DFES_Severity.DFC_CmbChbMisfireMax_2_C "DFES/Projektspezifische Applikationdaten (pro DSM Element) DFC_CmbChbMisfireMax_2" VALUE 0x8002B506 Val_Wu8 255.0 OneToOne 0.00 255.0 /end CHARACTERISTIC
/begin CHARACTERISTIC DFES_Severity.DFC_CmbChbMisfireMax_3_C "DFES/Projektspezifische Applikationdaten (pro DSM Element) DFC_CmbChbMisfireMax_3" VALUE 0x8002B507 Val_Wu8 255.0 OneToOne 0.00 255.0 /end CHARACTERISTIC
/begin CHARACTERISTIC DFES_Severity.DFC_CmbChbMisfireMax_4_C "DFES/Projektspezifische Applikationdaten (pro DSM Element) DFC_CmbChbMisfireMax_4" VALUE 0x8002B508 Val_Wu8 255.0 OneToOne 0.00 255.0 /end CHARACTERISTIC
/begin CHARACTERISTIC DFES_Severity.DFC_CmbChbMisfireMax_5_C "DFES/Projektspezifische Applikationdaten (pro DSM Element) DFC_CmbChbMisfireMax_5" VALUE 0x8002B509 Val_Wu8 255.0 OneToOne 0.00 255.0 /end CHARACTERISTIC
/begin CHARACTERISTIC DFES_Severity.DFC_CmbChbMisfireMul_C "DFES/Projektspezifische Applikationdaten (pro DSM Element) DFC_CmbChbMisfireMul" VALUE 0x8002B50A Val_Wu8 255.0 OneToOne 0.00 255.0 /end CHARACTERISTIC
/begin CHARACTERISTIC DFES_Severity.DFC_EGRVlvLPOfsNeutr_C "DFES/" VALUE 0x8002B50B Val_Wu8 255.0 OneToOne 0.00 255.0 /end CHARACTERISTIC
/begin CHARACTERISTIC DFES_Severity.DFC_EGRVlvOfsNeutr_C "DFES/Projektspezifische Applikationdaten (pro DSM Element) DFC_EGRVlvOfsNeutr" VALUE 0x8002B50C Val_Wu8 255.0 OneToOne 0.00 255.0 /end CHARACTERISTIC
/begin CHARACTERISTIC DFES_Severity.DFC_FMAErrModMax_C "DFES/Projektspezifische Applikationdaten (pro DSM Element) DFC_FMAErrModMax" VALUE 0x8002B50D Val_Wu8 255.0 OneToOne 0.00 255.0 /end CHARACTERISTIC
/begin CHARACTERISTIC DFES_Severity.DFC_FMAErrModMin_C "DFES/Projektspezifische Applikationdaten (pro DSM Element) DFC_FMAErrModMin" VALUE 0x8002B50E Val_Wu8 255.0 OneToOne 0.00 255.0 /end CHARACTERISTIC
/begin CHARACTERISTIC DFES_Severity.DFC_FlSysTnkLo_C "DFES/Projektspezifische Applikationdaten (pro DSM Element) DFC_FlSysTnkLo" VALUE 0x8002B50F Val_Wu8 255.0 OneToOne 0.00 255.0 /end CHARACTERISTIC
/begin FUNCTION DFES ""
 /begin DEF_CHARACTERISTIC DFES_numClsPndDlt_CA DFES_numClsSvcDlt_CA DFES_numClsSVSFaultCycl_CA DFES_numClsSVSHealCycl_CA DFES_Severity.DFC_ACCIPlausDrvAst_C DFES_Severity.DFC_ACCIPlausTrqDes_C DFES_Severity.DFC_AirCtlGovDvtEOMMax_C DFES_Severity.DFC_AirCtlGovDvtEOMMin_C DFES_Severity.DFC_AirCtlGovDvtMax_C DFES_Severity.DFC_AirCtlGovDvtMin_C DFES_Severity.DFC_AirCtlGovLPDvtMax_C DFES_Severity.DFC_AirCtlGovLPDvtMin_C DFES_Severity.DFC_AltIOComErr_C DFES_Severity.DFC_AltIOComNpl_C DFES_Severity.DFC_BusDiagBusOffFlexRay_C DFES_Severity.DFC_BusDiagBusOffNodeA_C DFES_Severity.DFC_BusDiagBusOffNodeB_C DFES_Severity.DFC_BusDiagBusOffNodeC_C DFES_Severity.DFC_BusDiagHwFlexRay_C DFES_Severity.DFC_Cj945SpiCom1_C DFES_Severity.DFC_ComACDemandSig_FA_C DFES_Severity.DFC_ComACDemandTo_FA_C DFES_Severity.DFC_ComATempSig_FA_C DFES_Severity.DFC_ComATempTo_FA_C DFES_Severity.DFC_ComATempTo_FX_C DFES_Severity.DFC_ComBrkTrqSumChk_FX_C DFES_Severity.DFC_ComBrkTrqSumCtr_FX_C DFES_Severity.DFC_ComBrkTrqSumTo_FX_C DFES_Severity.DFC_ComBtnDrvDynChk_FX_C DFES_Severity.DFC_ComBtnDrvDynCtr_FX_C DFES_Severity.DFC_ComBtnDrvDynTo_FX_C DFES_Severity.DFC_ComButtonMSASig_C DFES_Severity.DFC_ComButtonMSATo_C DFES_Severity.DFC_ComCodierungPwrmngSig_C DFES_Severity.DFC_ComCodierungPwrmngSig_FA_C DFES_Severity.DFC_ComCrCtlLvrChk_C DFES_Severity.DFC_ComCrCtlLvrCtr_C DFES_Severity.DFC_ComCrCtlLvrSig_C DFES_Severity.DFC_ComCrCtlLvrTo_C DFES_Severity.DFC_ComCtrCrshSwoEkpSig_FA_C DFES_Severity.DFC_ComCtrCrshSwoEkpTo_FA_C DFES_Severity.DFC_ComCtrSecInt_C DFES_Severity.DFC_ComDiaOBDGbxSig_A_C DFES_Severity.DFC_ComDiaOBDGbxTo_A_C DFES_Severity.DFC_ComFahrzeugtypSig_C DFES_Severity.DFC_ComFahrzeugtypSig_FA_C DFES_Severity.DFC_ComFllupGpwsupSig_FA_C DFES_Severity.DFC_ComFllupGpwsupTo_FA_C DFES_Severity.DFC_ComGbxDataChk_A_C DFES_Severity.DFC_ComGbxDataChk_FA_C DFES_Severity.DFC_ComGbxDataCtr_A_C DFES_Severity.DFC_ComGbxDataCtr_FA_C DFES_Severity.DFC_ComGbxDataSig_A_C DFES_Severity.DFC_ComGbxDataSig_FA_C DFES_Severity.DFC_ComGbxDataTo_A_C DFES_Severity.DFC_ComGbxDataTo_FA_C DFES_Severity.DFC_ComKlemmenChk_FA_C DFES_Severity.DFC_ComKlemmenCtr_FA_C DFES_Severity.DFC_ComKlemmenSig_FA_C DFES_Severity.DFC_ComKlemmenTo_FA_C DFES_Severity.DFC_ComLenkradwinkelSig_C DFES_Severity.DFC_ComLenkradwinkelTo_C DFES_Severity.DFC_ComMileageRangeSig_FA_C DFES_Severity.DFC_ComMileageRangeTo_FA_C DFES_Severity.DFC_ComPspSig_C DFES_Severity.DFC_ComPspTo_C DFES_Severity.DFC_ComRelTimeSig_FA_C DFES_Severity.DFC_ComRelTimeTo_FA_C DFES_Severity.DFC_ComRequestEMFChk_C DFES_Severity.DFC_ComRequestEMFCtr_C DFES_Severity.DFC_ComRequestEMFSig_C DFES_Severity.DFC_ComRequestEMFTo_C DFES_Severity.DFC_ComRpmWhlChk_FX_C DFES_Severity.DFC_ComRpmWhlCtr_FX_C DFES_Severity.DFC_ComRpmWhlTo_FX_C DFES_Severity.DFC_ComSecCtrRelSig_FA_C DFES_Severity.DFC_ComSecCtrRelTo_FA_C DFES_Severity.DFC_ComSensNOxGndSig_C DFES_Severity.DFC_ComSensNOxGndTo_C DFES_Severity.DFC_ComSensNOxMode_C DFES_Severity.DFC_ComSensNOxUbattSig_C DFES_Severity.DFC_ComSensNOxUbattTo_C DFES_Severity.DFC_ComShiftPaddleTo_FX_C DFES_Severity.DFC_ComShutOffPSPSig_C DFES_Severity.DFC_ComShutOffPSPTo_C DFES_Severity.DFC_ComSlrdiGlbFZMTo_FA_C DFES_Severity.DFC_ComSlrdiGlbFZMTo_FX_C DFES_Severity.DFC_ComSpeedVehicleChk_FX_C DFES_Severity.DFC_ComSpeedVehicleCtr_FX_C DFES_Severity.DFC_ComSpeedVehicleTo_FX_C DFES_Severity.DFC_ComStConintDSCChk_FX_C DFES_Severity.DFC_ComStConintDSCCtr_FX_C DFES_Severity.DFC_ComStConintDSCTo_FX_C DFES_Severity.DFC_ComStatACFrontSig_FA_C DFES_Severity.DFC_ComStatACFrontTo_FA_C DFES_Severity.DFC_ComStatEkpSig_A_C DFES_Severity.DFC_ComStatEkpTo_A_C DFES_Severity.DFC_ComStatGearRevSig_FA_C DFES_Severity.DFC_ComStatGearRevTo_FA_C DFES_Severity.DFC_ComStatZVKlappenSig_FA_C DFES_Severity.DFC_ComStatZVKlappenTo_FA_C DFES_Severity.DFC_ComStateARSCtr_C DFES_Severity.DFC_ComStateARSSig_C DFES_Severity.DFC_ComStateARSTo_C DFES_Severity.DFC_ComStateDscSig_C DFES_Severity.DFC_ComStateDscTo_C DFES_Severity.DFC_ComStateSeatSig_C DFES_Severity.DFC_ComStateSeatSig_FA_C DFES_Severity.DFC_ComStateSeatTo_C DFES_Severity.DFC_ComStateSeatTo_FA_C DFES_Severity.DFC_ComStatusEGSSig_A_C DFES_Severity.DFC_ComStatusEGSSig_FA_C DFES_Severity.DFC_ComStatusEGSTo_A_C DFES_Severity.DFC_ComStatusEGSTo_FA_C DFES_Severity.DFC_ComStatusEMFChk_C DFES_Severity.DFC_ComStatusEMFCtr_C DFES_Severity.DFC_ComStatusEMFSig_C DFES_Severity.DFC_ComStatusEMFTo_C DFES_Severity.DFC_ComStatusRGangSig_C DFES_Severity.DFC_ComStatusRGangTo_C DFES_Severity.DFC_ComSteeringAngleChk_FX_C DFES_Severity.DFC_ComSteeringAngleCtr_FX_C DFES_Severity.DFC_ComSteeringAngleTo_FX_C DFES_Severity.DFC_ComTerminalChk_C DFES_Severity.DFC_ComTerminalCtr_C DFES_Severity.DFC_ComTerminalSig_C DFES_Severity.DFC_ComTerminalTo_C DFES_Severity.DFC_ComTimeDateSig_FA_C DFES_Severity.DFC_ComTimeDateTo_FA_C DFES_Severity.DFC_ComTrailerSig_C DFES_Severity.DFC_ComTrailerSig_FA_C DFES_Severity.DFC_ComTrailerTo_C DFES_Severity.DFC_ComTrailerTo_FA_C DFES_Severity.DFC_ComTrqDemCrshDrDyChk_FX_C DFES_Severity.DFC_ComTrqDemCrshDrDyCtr_FX_C DFES_Severity.DFC_ComTrqDemCrshDrDyTo_FX_C DFES_Severity.DFC_ComTrqDemandDesSig_C DFES_Severity.DFC_ComTrqDemandDesTo_C DFES_Severity.DFC_ComTrqDemandDscChk_C DFES_Severity.DFC_ComTrqDemandDscCtr_C DFES_Severity.DFC_ComTrqDemandDscSig_C DFES_Severity.DFC_ComTrqDemandDscTo_C DFES_Severity.DFC_ComTrqDemandGbxChk_A_C DFES_Severity.DFC_ComTrqDemandGbxChk_FA_C DFES_Severity.DFC_ComTrqDemandGbxCtr_A_C DFES_Severity.DFC_ComTrqDemandGbxCtr_FA_C DFES_Severity.DFC_ComTrqDemandGbxSig_A_C DFES_Severity.DFC_ComTrqDemandGbxSig_FA_C DFES_Severity.DFC_ComTrqDemandGbxTo_A_C DFES_Severity.DFC_ComTrqDemandGbxTo_FA_C DFES_Severity.DFC_ComTrqWhlDemChk_C DFES_Severity.DFC_ComTrqWhlDemCtr_C DFES_Severity.DFC_ComTrqWhlDemFASChk_FX_C DFES_Severity.DFC_ComTrqWhlDemFASCtr_FX_C DFES_Severity.DFC_ComTrqWhlDemFASTo_FX_C DFES_Severity.DFC_ComTrqWhlDemSig_C DFES_Severity.DFC_ComTrqWhlDemTo_C DFES_Severity.DFC_ComVelocityChk_FA_C DFES_Severity.DFC_ComVelocityCtr_FA_C DFES_Severity.DFC_ComVelocitySig_C DFES_Severity.DFC_ComVelocitySig_FA_C DFES_Severity.DFC_ComVelocityTo_C DFES_Severity.DFC_ComVelocityTo_FA_C DFES_Severity.DFC_ComVerbraucherTo_C DFES_Severity.DFC_ComWMomPTStabChk_FX_C DFES_Severity.DFC_ComWMomPTStabCtr_FX_C DFES_Severity.DFC_ComWMomPTStabTo_FX_C DFES_Severity.DFC_ComWheelSpeedSig_C DFES_Severity.DFC_ComWheelSpeedTo_C DFES_Severity.DFC_ComZvKlappenSig_C DFES_Severity.DFC_ComZvKlappenTo_C DFES_Severity.DFC_ComaDirectChk_FX_C DFES_Severity.DFC_ComaDirectCtr_FX_C DFES_Severity.DFC_ComaDirectTo_FX_C DFES_Severity.DFC_ComaSideChk_FX_C DFES_Severity.DFC_ComaSideCtr_FX_C DFES_Severity.DFC_ComaSideTo_FX_C DFES_Severity.DFC_Cy320SpiCom_C DFES_Severity.DFC_ETCtlDvtInrMax_C DFES_Severity.DFC_ETCtlDvtInrMin_C DFES_Severity.DFC_ETCtlDvtOutrMax_C DFES_Severity.DFC_ETCtlDvtOutrMin_C DFES_Severity.DFC_FBCqDvtMax_C DFES_Severity.DFC_FBCqDvtMin_C DFES_Severity.DFC_Fan4WinErr1_C DFES_Severity.DFC_Fan4WinErr2_C DFES_Severity.DFC_Fan4WinErr3_C DFES_Severity.DFC_Fan4WinErr4_C DFES_Severity.DFC_FanSCG_C DFES_Severity.DFC_FlFCBS_C DFES_Severity.DFC_GlwEcuConfigErr_C DFES_Severity.DFC_GlwEcuEepErr_C DFES_Severity.DFC_GlwEcuFrmErr_C DFES_Severity.DFC_GlwEcuGPCMFaultInfo_C DFES_Severity.DFC_GlwEcuGPCMInfo_C DFES_Severity.DFC_GlwEcuGk1HSS_C DFES_Severity.DFC_GlwEcuGk1OL_C DFES_Severity.DFC_GlwEcuGk1SC_C DFES_Severity.DFC_GlwEcuGk1Wdst_C DFES_Severity.DFC_GlwEcuGk2HSS_C DFES_Severity.DFC_GlwEcuGk2OL_C DFES_Severity.DFC_GlwEcuGk2SC_C DFES_Severity.DFC_GlwEcuGk2Wdst_C DFES_Severity.DFC_GlwEcuGk3HSS_C DFES_Severity.DFC_GlwEcuGk3OL_C DFES_Severity.DFC_GlwEcuGk3SC_C DFES_Severity.DFC_GlwEcuGk3Wdst_C DFES_Severity.DFC_GlwEcuGk4HSS_C DFES_Severity.DFC_GlwEcuGk4OL_C DFES_Severity.DFC_GlwEcuGk4SC_C DFES_Severity.DFC_GlwEcuGk4Wdst_C DFES_Severity.DFC_GlwEcuGk5HSS_C DFES_Severity.DFC_GlwEcuGk5OL_C DFES_Severity.DFC_GlwEcuGk5SC_C DFES_Severity.DFC_GlwEcuGk5Wdst_C DFES_Severity.DFC_GlwEcuGk6HSS_C DFES_Severity.DFC_GlwEcuGk6OL_C DFES_Severity.DFC_GlwEcuGk6SC_C DFES_Severity.DFC_GlwEcuGk6Wdst_C DFES_Severity.DFC_GlwEcuGndErr_C DFES_Severity.DFC_GlwEcuIntErr_C DFES_Severity.DFC_GlwEcuMsgTimeout_C DFES_Severity.DFC_GlwEcuT30Err_C DFES_Severity.DFC_GlwEcuTempErr_C DFES_Severity.DFC_GlwEcuUdiffT30_C DFES_Severity.DFC_IBSComErr_C DFES_Severity.DFC_LubSRCOilFldtCrit_C DFES_Severity.DFC_LubSRCOilFldtCritDflMin_C DFES_Severity.DFC_LubSRCOilLvlCritMax_C DFES_Severity.DFC_LubSRCOilLvlCritMin_C DFES_Severity.DFC_LubSRCTot_C DFES_Severity.DFC_MonUMaxSupply1_C DFES_Severity.DFC_MonUMinSupply1_C DFES_Severity.DFC_OilComNpl_C DFES_Severity.DFC_PCBS_C DFES_Severity.DFC_PCBSPFltChg_C DFES_Severity.DFC_PCRGovDvtLPMax_C DFES_Severity.DFC_PCRGovDvtLPMin_C DFES_Severity.DFC_PCRGovDvtMax_C DFES_Severity.DFC_PCRGovDvtMin_C DFES_Severity.DFC_PFltAPSPlausMAX_C DFES_Severity.DFC_PFltAPSPlausMIN_C DFES_Severity.DFC_PFltBPSPlausMAX_C DFES_Severity.DFC_PFltBPSPlausMIN_C DFES_Severity.DFC_PFltOvldInhRgn_C DFES_Severity.DFC_PFltOvldTrqLim_C DFES_Severity.DFC_PFltPresPlausMAX_C DFES_Severity.DFC_PFltPresPlausMIN_C DFES_Severity.DFC_PFltTraRpmRdc_C DFES_Severity.DFC_PFlt_tOxiPreMax_C DFES_Severity.DFC_PFlt_tOxiPreMaxRgn_C DFES_Severity.DFC_PFlt_tOxiPreNpl_C DFES_Severity.DFC_PFlt_tPreMax_C DFES_Severity.DFC_PFlt_tPreMaxRgn_C DFES_Severity.DFC_PFlt_tPreNpl_C DFES_Severity.DFC_PFltmSotDiffMAX_C DFES_Severity.DFC_PFltmSotDiffMIN_C DFES_Severity.DFC_PFltmSotDiffSIG_C DFES_Severity.DFC_PIntkVUsEnvPPls_C DFES_Severity.DFC_PresPlausDblDef_C DFES_Severity.DFC_RailCPC1_C DFES_Severity.DFC_RailCPC3_C DFES_Severity.DFC_RailCPC4_C DFES_Severity.DFC_RailMeUn0_C DFES_Severity.DFC_RailMeUn1_C DFES_Severity.DFC_RailMeUn2_C DFES_Severity.DFC_RailMeUn22_C DFES_Severity.DFC_RailMeUn3_C DFES_Severity.DFC_RailMeUn4_C DFES_Severity.DFC_RailMeUn42_C DFES_Severity.DFC_RailMeUn5_C DFES_Severity.DFC_RailPCV0_C DFES_Severity.DFC_RailPCV1_C DFES_Severity.DFC_RailPCV2_C DFES_Severity.DFC_RailPCV22_C DFES_Severity.DFC_RailPCV3_C DFES_Severity.DFC_RailPCV4_C DFES_Severity.DFC_RailPCV42_C DFES_Severity.DFC_RailPMonStrt_C DFES_Severity.DFC_SSpMon1_C DFES_Severity.DFC_SSpMon2_C DFES_Severity.DFC_SSpMon3_C DFES_Severity.DFC_ThrVlv4WinErr1_C DFES_Severity.DFC_ThrVlv4WinErr2_C DFES_Severity.DFC_ThrVlv4WinErr3_C DFES_Severity.DFC_ThrVlv4WinErr4_C DFES_Severity.DFC_ThrVlvSCG_C DFES_Severity.DFC_Tle6232Spi1_C DFES_Severity.DFC_TrbCh4WinErr1_C DFES_Severity.DFC_TrbCh4WinErr2_C DFES_Severity.DFC_TrbCh4WinErr3_C DFES_Severity.DFC_TrbCh4WinErr4_C DFES_Severity.DFC_TrbChSCG_C DFES_Severity.DFC_TrbChSRCMax_C DFES_Severity.DFC_TrbChSRCMin_C DFES_Severity.DFC_WaHtEl4WinErr1_C DFES_Severity.DFC_WaHtEl4WinErr2_C DFES_Severity.DFC_WaHtEl4WinErr3_C DFES_Severity.DFC_WaHtEl4WinErr4_C DFES_Severity.DFC_WaHtElSCG_C DFES_Severity.DFC_ETClbETFltMax_0_C DFES_Severity.DFC_ETClbETFltMax_1_C DFES_Severity.DFC_ETClbETFltMax_2_C DFES_Severity.DFC_ETClbETFltMax_3_C DFES_Severity.DFC_ETClbETFltMax_4_C DFES_Severity.DFC_ETClbETFltMax_5_C DFES_Severity.DFC_ETClbETFltMin_0_C DFES_Severity.DFC_ETClbETFltMin_1_C DFES_Severity.DFC_ETClbETFltMin_2_C DFES_Severity.DFC_ETClbETFltMin_3_C DFES_Severity.DFC_ETClbETFltMin_4_C DFES_Severity.DFC_ETClbETFltMin_5_C DFES_Severity.DFC_InjCrvInjLimChrgBal_C DFES_Severity.DFC_InjCrvInjLimQntBal_C DFES_Severity.DFC_InjCrvInjLimSys_C DFES_Severity.DFC_InjCrvNumInjRtmLim_C DFES_Severity.DFC_LSUHtCoupSig_C DFES_Severity.DFC_AFS_SSpShOffOL_C DFES_Severity.DFC_AFS_SSpShOffOvrTemp_C DFES_Severity.DFC_AFS_SSpShOffSCB_C DFES_Severity.DFC_AFS_SSpShOffSCG_C DFES_Severity.DFC_AirCCmprOL_C DFES_Severity.DFC_AirCCmprOvrTemp_C DFES_Severity.DFC_AirCCmprSCB_C DFES_Severity.DFC_AirCCmprSCG_C DFES_Severity.DFC_CByVlvOL_C DFES_Severity.DFC_CByVlvOvrTemp_C DFES_Severity.DFC_CByVlvSCB_C DFES_Severity.DFC_CByVlvSCG_C DFES_Severity.DFC_CThmstOL_C DFES_Severity.DFC_CThmstOvrTemp_C DFES_Severity.DFC_CThmstSCB_C DFES_Severity.DFC_CThmstSCG_C DFES_Severity.DFC_DSMDummy_C DFES_Severity.DFC_EBxFanOL_C DFES_Severity.DFC_EBxFanOvrTemp_C DFES_Severity.DFC_EBxFanSCB_C DFES_Severity.DFC_EBxFanSCG_C DFES_Severity.DFC_ECBVlvOL_C DFES_Severity.DFC_ECBVlvOvrTemp_C DFES_Severity.DFC_ECBVlvSCB_C DFES_Severity.DFC_ECBVlvSCG_C DFES_Severity.DFC_EMDmpOL_0_C DFES_Severity.DFC_EMDmpOL_1_C DFES_Severity.DFC_EMDmpOvrTemp_0_C DFES_Severity.DFC_EMDmpOvrTemp_1_C DFES_Severity.DFC_EMDmpSCB_0_C DFES_Severity.DFC_EMDmpSCB_1_C DFES_Severity.DFC_EMDmpSCG_0_C DFES_Severity.DFC_EMDmpSCG_1_C DFES_Severity.DFC_EngStAOL_C DFES_Severity.DFC_EngStAOvrTemp_C DFES_Severity.DFC_EngStASCB_C DFES_Severity.DFC_EngStASCG_C DFES_Severity.DFC_FanOL_C DFES_Severity.DFC_FanOvrTemp_C DFES_Severity.DFC_FanSCB_C DFES_Severity.DFC_FlFltHtOL_C DFES_Severity.DFC_FlFltHtOvrTemp_C DFES_Severity.DFC_FlFltHtSCB_C DFES_Severity.DFC_FlFltHtSCG_C DFES_Severity.DFC_LSUHtrMax_C DFES_Severity.DFC_LSUHtrMin_C DFES_Severity.DFC_LSUHtrNpl_C DFES_Severity.DFC_LSUHtrSig_C DFES_Severity.DFC_LSUtExcMax_C DFES_Severity.DFC_LSUtExcMin_C DFES_Severity.DFC_MeUnOL_C DFES_Severity.DFC_MeUnSCB_C DFES_Severity.DFC_MeUnSRCMax_C DFES_Severity.DFC_MeUnSRCMin_C DFES_Severity.DFC_PCVOL_C DFES_Severity.DFC_PCVSCB_C DFES_Severity.DFC_PCVSRCMax_C DFES_Severity.DFC_PCVSRCMin_C DFES_Severity.DFC_RailPSRCMax_C DFES_Severity.DFC_RailPSRCMin_C DFES_Severity.DFC_ShtrOL_C DFES_Severity.DFC_ShtrOvrTemp_C DFES_Severity.DFC_ShtrSCB_C DFES_Severity.DFC_ShtrSCG_C DFES_Severity.DFC_StrtOL_C DFES_Severity.DFC_StrtOvrTemp_C DFES_Severity.DFC_StrtSCB_C DFES_Severity.DFC_StrtSCG_C DFES_Severity.DFC_ThrVlvOL_C DFES_Severity.DFC_ThrVlvOvrTemp_C DFES_Severity.DFC_ThrVlvSCB_C DFES_Severity.DFC_TrbChOL_C DFES_Severity.DFC_TrbChOvrTemp_C DFES_Severity.DFC_TrbChSCB_C DFES_Severity.DFC_UDosVlvOL_C DFES_Severity.DFC_UDosVlvOvrTemp_C DFES_Severity.DFC_UDosVlvSCB_C DFES_Severity.DFC_UDosVlvSCG_C DFES_Severity.DFC_UPmpMotOL_C DFES_Severity.DFC_UPmpMotOvrTemp_C DFES_Severity.DFC_UPmpMotSCB_C DFES_Severity.DFC_UPmpMotSCG_C DFES_Severity.DFC_WaHtElOL_C DFES_Severity.DFC_WaHtElOvrTemp_C DFES_Severity.DFC_WaHtElSCB_C DFES_Severity.DFC_IVActrUChSRCMax_C DFES_Severity.DFC_IVActrUChSRCMin_C DFES_Severity.DFC_IVActrVltgSRCMax_C DFES_Severity.DFC_IVActrVltgSRCMin_C DFES_Severity.DFC_IVDiaTunDet_C DFES_Severity.DFC_IVPSplyStopDCDC_C DFES_Severity.DFC_IVPSplyVltgSRCMax_C DFES_Severity.DFC_IVPSplyVltgSRCMin_C DFES_Severity.DFC_SCREtaErr_C DFES_Severity.DFC_SCREtaErr1_C DFES_Severity.DFC_SCREtaErr2_C DFES_Severity.DFC_SCRMonMetCtlPresErr_C DFES_Severity.DFC_SCRMonPresBuildUpErr_C DFES_Severity.DFC_SCRMonPresRdcErr_C DFES_Severity.DFC_AFSOffsDrftMax_C DFES_Severity.DFC_AFSOffsDrftMin_C DFES_Severity.DFC_AFSSRCCorMax_C DFES_Severity.DFC_AFSSRCCorMin_C DFES_Severity.DFC_AFSSRCRawMax_C DFES_Severity.DFC_AFSSRCRawMin_C DFES_Severity.DFC_AFSSetyDrftMax_C DFES_Severity.DFC_AFSSetyDrftMin_C DFES_Severity.DFC_AirCSwtNpl_C DFES_Severity.DFC_AirCSwtSig_C DFES_Severity.DFC_BattUSRCMax_C DFES_Severity.DFC_BattUSRCMin_C DFES_Severity.DFC_BrkNpl_C DFES_Severity.DFC_BrkPSRCMax_C DFES_Severity.DFC_BrkPSRCMin_C DFES_Severity.DFC_CEngDsTSRCMax_C DFES_Severity.DFC_CEngDsTSRCMin_C DFES_Severity.DFC_CrCUIDet_C DFES_Severity.DFC_ECBVlvSRCMax_C DFES_Severity.DFC_ECBVlvSRCMin_C DFES_Severity.DFC_ECUOvrTemp_C DFES_Severity.DFC_EGRVlvGovDvtMax_C DFES_Severity.DFC_EGRVlvGovDvtMin_C DFES_Severity.DFC_EGRVlvHBrgOpnLd_C DFES_Severity.DFC_EGRVlvHBrgOvrCurr_C DFES_Severity.DFC_EGRVlvHBrgOvrTemp_C DFES_Severity.DFC_EGRVlvHBrgShCirBatt1_C DFES_Severity.DFC_EGRVlvHBrgShCirBatt2_C DFES_Severity.DFC_EGRVlvHBrgShCirGnd1_C DFES_Severity.DFC_EGRVlvHBrgShCirGnd2_C DFES_Severity.DFC_EGRVlvHBrgShCirOvrLd_C DFES_Severity.DFC_EGRVlvHBrgTempOvrCurr_C DFES_Severity.DFC_EGRVlvHBrgUndrVltg_C DFES_Severity.DFC_EGRVlvLPGovDvtMax_C DFES_Severity.DFC_EGRVlvLPGovDvtMin_C DFES_Severity.DFC_EGRVlvLPHBrgOpnLd_C DFES_Severity.DFC_EGRVlvLPHBrgOvrCurr_C DFES_Severity.DFC_EGRVlvLPHBrgOvrTemp_C DFES_Severity.DFC_EGRVlvLPHBrgShCirBatt1_C DFES_Severity.DFC_EGRVlvLPHBrgShCirBatt2_C DFES_Severity.DFC_EGRVlvLPHBrgShCirGnd1_C DFES_Severity.DFC_EGRVlvLPHBrgShCirGnd2_C DFES_Severity.DFC_EGRVlvLPHBrgShCirOvrLd_C DFES_Severity.DFC_EGRVlvLPHBrgTempOvrCurr_C DFES_Severity.DFC_EGRVlvLPHBrgUndrVltg_C DFES_Severity.DFC_EGRVlvLPOL_C DFES_Severity.DFC_EGRVlvLPSCB_C DFES_Severity.DFC_EGRVlvLPSCG_C DFES_Severity.DFC_EGRVlvLPSRCMax_C DFES_Severity.DFC_EGRVlvLPSRCMin_C DFES_Severity.DFC_EGRVlvOL_C DFES_Severity.DFC_EGRVlvSCB_C DFES_Severity.DFC_EGRVlvSCG_C DFES_Severity.DFC_EGRVlvSRCMax_C DFES_Severity.DFC_EGRVlvSRCMin_C DFES_Severity.DFC_EngPrtOvrSpd_C DFES_Severity.DFC_EngSpdOL_C DFES_Severity.DFC_EngSpdSCB_C DFES_Severity.DFC_EngSpdSCG_C DFES_Severity.DFC_EnhSRCMaxPPFltDiff_C DFES_Severity.DFC_EnhSRCMaxT1ExhTMon_C DFES_Severity.DFC_EnhSRCMaxT2ExhTMon_C DFES_Severity.DFC_EnhSRCMaxT3ExhTMon_C DFES_Severity.DFC_EnhSRCMinPPFltDiff_C DFES_Severity.DFC_EnhSRCMinT1ExhTMon_C DFES_Severity.DFC_EnhSRCMinT2ExhTMon_C DFES_Severity.DFC_EnhSRCMinT3ExhTMon_C DFES_Severity.DFC_EnvPSRCMax_C DFES_Severity.DFC_EnvPSRCMin_C DFES_Severity.DFC_ExhTMonPlaus_C DFES_Severity.DFC_ExhTMonPlausPos1_C DFES_Severity.DFC_ExhTMonPlausPos2_C DFES_Severity.DFC_ExhTMonPlausPos3_C DFES_Severity.DFC_ExhTMonT1Plaus_C DFES_Severity.DFC_ExhTMonT2Plaus_C DFES_Severity.DFC_ExhTMonT3Plaus_C DFES_Severity.DFC_FlFltDsPSRCMax_C DFES_Severity.DFC_FlFltDsPSRCMin_C DFES_Severity.DFC_FlFltSig_C DFES_Severity.DFC_FlFltUsPSRCMax_C DFES_Severity.DFC_FlFltUsPSRCMin_C DFES_Severity.DFC_FuelTSRCMax_C DFES_Severity.DFC_FuelTSRCMin_C DFES_Severity.DFC_GbxNPosPPerSRCMax_C DFES_Severity.DFC_GbxNPosPPerSRCMin_C DFES_Severity.DFC_GbxNPosPdcycSRCMax_C DFES_Severity.DFC_GbxNPosPdcycSRCMin_C DFES_Severity.DFC_InjVlvPresMin_C DFES_Severity.DFC_LSUCircNernstSig_C DFES_Severity.DFC_LSUCircPmpCurSig_C DFES_Severity.DFC_LSUCircVirtGndSig_C DFES_Severity.DFC_LSUO2Max_C DFES_Severity.DFC_LSUO2Min_C DFES_Severity.DFC_LSUSPIBattLowMin_C DFES_Severity.DFC_LSUWireSCB_C DFES_Severity.DFC_LSUWireSCG_C DFES_Severity.DFC_MeUnSCG_C DFES_Severity.DFC_NSCDsCmpChk_C DFES_Severity.DFC_NSCDsLamBinSRCMax_C DFES_Severity.DFC_NSCDsLamBinSRCMin_C DFES_Severity.DFC_NSCDsLamLinSRCMax_C DFES_Severity.DFC_NSCDsLamLinSRCMin_C DFES_Severity.DFC_NSCDsLamPlausMax_C DFES_Severity.DFC_NSCDsLamPlausMin_C DFES_Severity.DFC_NSCDsNOxSRCMax_C DFES_Severity.DFC_NSCDsNOxSRCMin_C DFES_Severity.DFC_NSCDsOpCir_C DFES_Severity.DFC_NSCDsShCir_C DFES_Severity.DFC_NoCat2DsCmpChk_C DFES_Severity.DFC_NoCat2DsLamBinSRCMax_C DFES_Severity.DFC_NoCat2DsLamBinSRCMin_C DFES_Severity.DFC_NoCat2DsLamLinSRCMax_C DFES_Severity.DFC_NoCat2DsLamLinSRCMin_C DFES_Severity.DFC_NoCat2DsLamPlausMax_C DFES_Severity.DFC_NoCat2DsLamPlausMin_C DFES_Severity.DFC_NoCat2DsNOxSRCMax_C DFES_Severity.DFC_NoCat2DsNOxSRCMin_C DFES_Severity.DFC_NoCat2DsOpCir_C DFES_Severity.DFC_NoCat2DsShCir_C DFES_Severity.DFC_NplDynPPFltDiff_C DFES_Severity.DFC_NplHsChngPPFltDiff_C DFES_Severity.DFC_NplHsLnPPFltDiff_C DFES_Severity.DFC_NplTOxiCatUs_C DFES_Severity.DFC_NplTPFltUs_C DFES_Severity.DFC_NplTTrbnUs_C DFES_Severity.DFC_OilPSwmpSRCMax_C DFES_Severity.DFC_OilPSwmpSRCMin_C DFES_Severity.DFC_PCVSCG_C DFES_Severity.DFC_PFltCharPDiffMin_C DFES_Severity.DFC_PFltDstrMin_C DFES_Severity.DFC_PFltEngPrt_C DFES_Severity.DFC_PFltRgnPerm_C DFES_Severity.DFC_PFltSRCMaxFlwRstn_C DFES_Severity.DFC_PFltSRCMinFlwRstn_C DFES_Severity.DFC_PFltSotMsDvtMax_C DFES_Severity.DFC_PFltSotMsDvtMin_C DFES_Severity.DFC_PFltSotMsMax_C DFES_Severity.DFC_PIntkVUsSRCMax_C DFES_Severity.DFC_PIntkVUsSRCMin_C DFES_Severity.DFC_SRCHighAPP1_C DFES_Severity.DFC_SRCHighAPP2_C DFES_Severity.DFC_SRCLowAPP1_C DFES_Severity.DFC_SRCLowAPP2_C DFES_Severity.DFC_SRCMaxPPFltDiff_C DFES_Severity.DFC_SRCMaxPPFltUs_C DFES_Severity.DFC_SRCMaxTECU_C DFES_Severity.DFC_SRCMaxTOxiCatUs_C DFES_Severity.DFC_SRCMaxTPFltUs_C DFES_Severity.DFC_SRCMaxTTrbnUs_C DFES_Severity.DFC_SRCMaxUCatUsT_C DFES_Severity.DFC_SRCMaxUPmpP_C DFES_Severity.DFC_SRCMinPPFltDiff_C DFES_Severity.DFC_SRCMinPPFltUs_C DFES_Severity.DFC_SRCMinTECU_C DFES_Severity.DFC_SRCMinTOxiCatUs_C DFES_Severity.DFC_SRCMinTPFltUs_C DFES_Severity.DFC_SRCMinTTrbnUs_C DFES_Severity.DFC_SRCMinUCatUsT_C DFES_Severity.DFC_SRCMinUPmpP_C DFES_Severity.DFC_SigUCatUsT_C DFES_Severity.DFC_SigUPmpP_C DFES_Severity.DFC_SyncAPP_C DFES_Severity.DFC_T15Npl_C DFES_Severity.DFC_TAFSDtyCycHi_C DFES_Severity.DFC_TAFSDtyCycLo_C DFES_Severity.DFC_TAFSPerHi_C DFES_Severity.DFC_TAFSPerLo_C DFES_Severity.DFC_TCACDsSRCMax_C DFES_Severity.DFC_TCACDsSRCMin_C DFES_Severity.DFC_ThrVlvSRCMax_C DFES_Severity.DFC_ThrVlvSRCMin_C DFES_Severity.DFC_TrbChLPOL_C DFES_Severity.DFC_TrbChLPSCB_C DFES_Severity.DFC_TrbChLPSCG_C DFES_Severity.DFC_UHtrPLOL_C DFES_Severity.DFC_UHtrPLSCB_C DFES_Severity.DFC_UHtrPLSCG_C DFES_Severity.DFC_UHtrPLSRCMaxDia_C DFES_Severity.DFC_UHtrPLSRCMinDia_C DFES_Severity.DFC_UHtrTnkOL_C DFES_Severity.DFC_UHtrTnkSCB_C DFES_Severity.DFC_UHtrTnkSCG_C DFES_Severity.DFC_UHtrTnkSRCMaxDia_C DFES_Severity.DFC_UHtrTnkSRCMinDia_C DFES_Severity.DFC_URevVlvOL_C DFES_Severity.DFC_URevVlvSCB_C DFES_Severity.DFC_URevVlvSCG_C DFES_Severity.DFC_UTnkTSRCMax_C DFES_Severity.DFC_UTnkTSRCMin_C DFES_Severity.DFC_UTnkTSig_C DFES_Severity.DFC_VSwVlvGovDvtMax_C DFES_Severity.DFC_VSwVlvGovDvtMin_C DFES_Severity.DFC_VSwVlvHBrgOpnLd_C DFES_Severity.DFC_VSwVlvHBrgOvrCurr_C DFES_Severity.DFC_VSwVlvHBrgOvrTemp_C DFES_Severity.DFC_VSwVlvHBrgShCirBatt1_C DFES_Severity.DFC_VSwVlvHBrgShCirBatt2_C DFES_Severity.DFC_VSwVlvHBrgShCirGnd1_C DFES_Severity.DFC_VSwVlvHBrgShCirGnd2_C DFES_Severity.DFC_VSwVlvHBrgShCirOvrLd_C DFES_Severity.DFC_VSwVlvHBrgTempOvrCurr_C DFES_Severity.DFC_VSwVlvHBrgUndrVltg_C DFES_Severity.DFC_VSwVlvOL_C DFES_Severity.DFC_VSwVlvSCB_C DFES_Severity.DFC_VSwVlvSCG_C DFES_Severity.DFC_VSwVlvSRCMax_C DFES_Severity.DFC_VSwVlvSRCMin_C DFES_Severity.DFC_ClthNpl_C DFES_Severity.DFC_ETClbETMax_0_C DFES_Severity.DFC_ETClbETMax_1_C DFES_Severity.DFC_ETClbETMax_2_C DFES_Severity.DFC_ETClbETMax_3_C DFES_Severity.DFC_ETClbETMax_4_C DFES_Severity.DFC_ETClbETMax_5_C DFES_Severity.DFC_ETClbETMin_0_C DFES_Severity.DFC_ETClbETMin_1_C DFES_Severity.DFC_ETClbETMin_2_C DFES_Severity.DFC_ETClbETMin_3_C DFES_Severity.DFC_ETClbETMin_4_C DFES_Severity.DFC_ETClbETMin_5_C DFES_Severity.DFC_IVActrEnrgMax_0_C DFES_Severity.DFC_IVActrEnrgMax_1_C DFES_Severity.DFC_IVActrEnrgMax_2_C DFES_Severity.DFC_IVActrEnrgMax_3_C DFES_Severity.DFC_IVActrEnrgMax_4_C DFES_Severity.DFC_IVActrEnrgMax_5_C DFES_Severity.DFC_IVActrEnrgMax_6_C DFES_Severity.DFC_IVActrEnrgMax_7_C DFES_Severity.DFC_IVActrEnrgMin_0_C DFES_Severity.DFC_IVActrEnrgMin_1_C DFES_Severity.DFC_IVActrEnrgMin_2_C DFES_Severity.DFC_IVActrEnrgMin_3_C DFES_Severity.DFC_IVActrEnrgMin_4_C DFES_Severity.DFC_IVActrEnrgMin_5_C DFES_Severity.DFC_IVActrEnrgMin_6_C DFES_Severity.DFC_IVActrEnrgMin_7_C DFES_Severity.DFC_IVActrEnrgPlaus_0_C DFES_Severity.DFC_IVActrEnrgPlaus_1_C DFES_Severity.DFC_IVActrEnrgPlaus_2_C DFES_Severity.DFC_IVActrEnrgPlaus_3_C DFES_Severity.DFC_IVActrEnrgPlaus_4_C DFES_Severity.DFC_IVActrEnrgPlaus_5_C DFES_Severity.DFC_IVActrEnrgPlaus_6_C DFES_Severity.DFC_IVActrEnrgPlaus_7_C DFES_Severity.DFC_IVCtlTiDiff_0_C DFES_Severity.DFC_IVCtlTiDiff_1_C DFES_Severity.DFC_IVCtlTiDiff_2_C DFES_Severity.DFC_IVCtlTiDiff_3_C DFES_Severity.DFC_IVCtlTiDiff_4_C DFES_Severity.DFC_IVCtlTiDiff_5_C DFES_Severity.DFC_IVCtlUDiffUp_0_C DFES_Severity.DFC_IVCtlUDiffUp_1_C DFES_Severity.DFC_IVCtlUDiffUp_2_C DFES_Severity.DFC_IVCtlUDiffUp_3_C DFES_Severity.DFC_IVCtlUDiffUp_4_C DFES_Severity.DFC_IVCtlUDiffUp_5_C DFES_Severity.DFC_IVCtlUUp_0_C DFES_Severity.DFC_IVCtlUUp_1_C DFES_Severity.DFC_IVCtlUUp_2_C DFES_Severity.DFC_IVCtlUUp_3_C DFES_Severity.DFC_IVCtlUUp_4_C DFES_Severity.DFC_IVCtlUUp_5_C DFES_Severity.DFC_IVDiaBnkShCir_0_C DFES_Severity.DFC_IVDiaBnkShCir_1_C DFES_Severity.DFC_IVDiaBnkShCirChSwt_0_C DFES_Severity.DFC_IVDiaBnkShCirChSwt_1_C DFES_Severity.DFC_IVDiaChp_0_C DFES_Severity.DFC_IVDiaChp_1_C DFES_Severity.DFC_IVDiaCylNoCls_0_C DFES_Severity.DFC_IVDiaCylNoCls_1_C DFES_Severity.DFC_IVDiaCylNoCls_2_C DFES_Severity.DFC_IVDiaCylNoCls_3_C DFES_Severity.DFC_IVDiaCylNoCls_4_C DFES_Severity.DFC_IVDiaCylNoCls_5_C DFES_Severity.DFC_IVDiaCylNoLd_0_C DFES_Severity.DFC_IVDiaCylNoLd_1_C DFES_Severity.DFC_IVDiaCylNoLd_2_C DFES_Severity.DFC_IVDiaCylNoLd_3_C DFES_Severity.DFC_IVDiaCylNoLd_4_C DFES_Severity.DFC_IVDiaCylNoLd_5_C DFES_Severity.DFC_IVDiaCylShCir_0_C DFES_Severity.DFC_IVDiaCylShCir_1_C DFES_Severity.DFC_IVDiaCylShCir_2_C DFES_Severity.DFC_IVDiaCylShCir_3_C DFES_Severity.DFC_IVDiaCylShCir_4_C DFES_Severity.DFC_IVDiaCylShCir_5_C DFES_Severity.DFC_IVDiaCylShCirHSLS_0_C DFES_Severity.DFC_IVDiaCylShCirHSLS_1_C DFES_Severity.DFC_IVDiaCylShCirHSLS_2_C DFES_Severity.DFC_IVDiaCylShCirHSLS_3_C DFES_Severity.DFC_IVDiaCylShCirHSLS_4_C DFES_Severity.DFC_IVDiaCylShCirHSLS_5_C DFES_Severity.DFC_IVDiaCylShCirMeas_0_C DFES_Severity.DFC_IVDiaCylShCirMeas_1_C DFES_Severity.DFC_IVDiaCylShCirMeas_2_C DFES_Severity.DFC_IVDiaCylShCirMeas_3_C DFES_Severity.DFC_IVDiaCylShCirMeas_4_C DFES_Severity.DFC_IVDiaCylShCirMeas_5_C DFES_Severity.DFC_LSUDynChk_C DFES_Severity.DFC_LSUO2ClbMax_C DFES_Severity.DFC_LSUO2ClbMin_C DFES_Severity.DFC_LSUO2PlausMaxFLd_C DFES_Severity.DFC_LSUO2PlausMaxOvrRun_C DFES_Severity.DFC_LSUO2PlausMaxPartLd_C DFES_Severity.DFC_LSUO2PlausMinFLd_C DFES_Severity.DFC_LSUO2PlausMinOvrRun_C DFES_Severity.DFC_LSUO2PlausMinPartLd_C DFES_Severity.DFC_LSURiClbMax_C DFES_Severity.DFC_LSURiClbMin_C DFES_Severity.DFC_LSUWireIPSig_C DFES_Severity.DFC_Layer_BSDMax_C DFES_Severity.DFC_Layer_BSDMin_C DFES_Severity.DFC_Layer_BSDNpl_C DFES_Severity.DFC_Layer_BSDSig_C DFES_Severity.DFC_Layer_FltMngTstMax_C DFES_Severity.DFC_Layer_FltMngTstMin_C DFES_Severity.DFC_Layer_FltMngTstNpl_C DFES_Severity.DFC_Layer_FltMngTstSig_C DFES_Severity.DFC_Layer_GENELBMax_C DFES_Severity.DFC_Layer_GENELBMin_C DFES_Severity.DFC_Layer_GENELBNpl_C DFES_Severity.DFC_Layer_GENELBSig_C DFES_Severity.DFC_Layer_GENELMax_C DFES_Severity.DFC_Layer_GENELMin_C DFES_Severity.DFC_Layer_GENELNpl_C DFES_Severity.DFC_Layer_GENELSig_C DFES_Severity.DFC_Layer_GENHTBMax_C DFES_Severity.DFC_Layer_GENHTBMin_C DFES_Severity.DFC_Layer_GENHTBNpl_C DFES_Severity.DFC_Layer_GENHTBSig_C DFES_Severity.DFC_Layer_GENHTMax_C DFES_Severity.DFC_Layer_GENHTMin_C DFES_Severity.DFC_Layer_GENHTNpl_C DFES_Severity.DFC_Layer_GENHTSig_C DFES_Severity.DFC_Layer_GENKOMMMax_C DFES_Severity.DFC_Layer_GENKOMMMin_C DFES_Severity.DFC_Layer_GENKOMMNpl_C DFES_Severity.DFC_Layer_GENKOMMSig_C DFES_Severity.DFC_Layer_GENMECHMax_C DFES_Severity.DFC_Layer_GENMECHMin_C DFES_Severity.DFC_Layer_GENMECHNpl_C DFES_Severity.DFC_Layer_GENMECHSig_C DFES_Severity.DFC_Layer_GENMax_C DFES_Severity.DFC_Layer_GENMin_C DFES_Severity.DFC_Layer_GENNpl_C DFES_Severity.DFC_Layer_GENREGUPLMax_C DFES_Severity.DFC_Layer_GENREGUPLMin_C DFES_Severity.DFC_Layer_GENREGUPLNpl_C DFES_Severity.DFC_Layer_GENREGUPLSig_C DFES_Severity.DFC_Layer_GENSig_C DFES_Severity.DFC_Layer_GENUPLMax_C DFES_Severity.DFC_Layer_GENUPLMin_C DFES_Severity.DFC_Layer_GENUPLNpl_C DFES_Severity.DFC_Layer_GENUPLSig_C DFES_Severity.DFC_Layer_IBS1Max_C DFES_Severity.DFC_Layer_IBS1Min_C DFES_Severity.DFC_Layer_IBS1Npl_C DFES_Severity.DFC_Layer_IBS1Sig_C DFES_Severity.DFC_Layer_IBS2Max_C DFES_Severity.DFC_Layer_IBS2Min_C DFES_Severity.DFC_Layer_IBS2Npl_C DFES_Severity.DFC_Layer_IBS2Sig_C DFES_Severity.DFC_Layer_IBS3Max_C DFES_Severity.DFC_Layer_IBS3Min_C DFES_Severity.DFC_Layer_IBS3Npl_C DFES_Severity.DFC_Layer_IBS3Sig_C DFES_Severity.DFC_Layer_MANDETEKMax_C DFES_Severity.DFC_Layer_MANDETEKMin_C DFES_Severity.DFC_Layer_MANDETEKNpl_C DFES_Severity.DFC_Layer_MANDETEKSig_C DFES_Severity.DFC_Layer_NDR1Max_C DFES_Severity.DFC_Layer_NDR1Min_C DFES_Severity.DFC_Layer_NDR1Npl_C DFES_Severity.DFC_Layer_NDR1Sig_C DFES_Severity.DFC_Layer_NDR2Max_C DFES_Severity.DFC_Layer_NDR2Min_C DFES_Severity.DFC_Layer_NDR2Npl_C DFES_Severity.DFC_Layer_NDR2Sig_C DFES_Severity.DFC_Layer_NGLERNMax_C DFES_Severity.DFC_Layer_NGLERNMin_C DFES_Severity.DFC_Layer_NGLERNNpl_C DFES_Severity.DFC_Layer_NGLERNSig_C DFES_Severity.DFC_Layer_PMBATTMax_C DFES_Severity.DFC_Layer_PMBATTMin_C DFES_Severity.DFC_Layer_PMBATTNpl_C DFES_Severity.DFC_Layer_PMBATTSig_C DFES_Severity.DFC_Layer_PMBNMax_C DFES_Severity.DFC_Layer_PMBNMin_C DFES_Severity.DFC_Layer_PMBNNpl_C DFES_Severity.DFC_Layer_PMBNSig_C DFES_Severity.DFC_Layer_PMRUHVERLMax_C DFES_Severity.DFC_Layer_PMRUHVERLMin_C DFES_Severity.DFC_Layer_PMRUHVERLNpl_C DFES_Severity.DFC_Layer_PMRUHVERLSig_C DFES_Severity.DFC_Layer_QLTMax_C DFES_Severity.DFC_Layer_QLTMin_C DFES_Severity.DFC_Layer_QLTNpl_C DFES_Severity.DFC_Layer_QLTSig_C DFES_Severity.DFC_Layer_TOENSMax_C DFES_Severity.DFC_Layer_TOENSMin_C DFES_Severity.DFC_Layer_TOENSNpl_C DFES_Severity.DFC_Layer_TOENSSig_C DFES_Severity.DFC_MonLimCurr_C DFES_Severity.DFC_MonLimLead_C DFES_Severity.DFC_MonLimSet_C DFES_Severity.DFC_NSCDsNOxOfsMax_C DFES_Severity.DFC_NSCDsNOxOfsMin_C DFES_Severity.DFC_NSCDsNOxPlausMin_C DFES_Severity.DFC_NoCat2DsNOxOfsMax_C DFES_Severity.DFC_NoCat2DsNOxOfsMin_C DFES_Severity.DFC_NoCat2DsNOxPlausMin_C DFES_Severity.DFC_PCVNoStrt_C DFES_Severity.DFC_RailPGradMon_C DFES_Severity.DFC_SCRPODPresBuildUp_C DFES_Severity.DFC_AFSDrftIdlAdjVal_C DFES_Severity.DFC_AFSDrftLdAdjVal_C DFES_Severity.DFC_AdcIADC0Cal_C DFES_Severity.DFC_AdcIADC0Conv_C DFES_Severity.DFC_AdcIADC1Cal_C DFES_Severity.DFC_AdcIADC1Conv_C DFES_Severity.DFC_CmbChbMisfireMax_0_C DFES_Severity.DFC_CmbChbMisfireMax_1_C DFES_Severity.DFC_CmbChbMisfireMax_2_C DFES_Severity.DFC_CmbChbMisfireMax_3_C DFES_Severity.DFC_CmbChbMisfireMax_4_C DFES_Severity.DFC_CmbChbMisfireMax_5_C DFES_Severity.DFC_CmbChbMisfireMul_C DFES_Severity.DFC_EGRVlvLPOfsNeutr_C DFES_Severity.DFC_EGRVlvOfsNeutr_C DFES_Severity.DFC_FMAErrModMax_C DFES_Severity.DFC_FMAErrModMin_C DFES_Severity.DFC_FlSysTnkLo_C /end DEF_CHARACTERISTIC
/end FUNCTION
/begin COMPU_METHOD DFES_OneToOne "" RAT_FUNC "%6.0" "-" COEFFS 0 1 0 0 0 1 /end COMPU_METHOD
/begin COMPU_METHOD OneToOne "" RAT_FUNC "%6.0" "-" COEFFS 0 1 0 0 0 1 /end COMPU_METHOD
/begin RECORD_LAYOUT ValA_Wu8 FNC_VALUES 1 UBYTE COLUMN_DIR DIRECT /end RECORD_LAYOUT
/begin RECORD_LAYOUT Val_Wu8 FNC_VALUES 1 UBYTE COLUMN_DIR DIRECT /end RECORD_LAYOUT
/end MODULE
/end PROJECT

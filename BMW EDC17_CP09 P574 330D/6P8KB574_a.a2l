ASAP2_VERSION 1 4
/begin PROJECT P_574 "EDC17_CP09"
/begin HEADER "" VERSION "V8KB" PROJECT_NO P_574 /end HEADER
/begin MODULE DIM ""
/begin MOD_COMMON "" BYTE_ORDER MSB_LAST ALIGNMENT_BYTE 1 ALIGNMENT_WORD 2 ALIGNMENT_LONG 4 ALIGNMENT_FLOAT32_IEEE 4 /end MOD_COMMON
/begin CHARACTERISTIC AirCtl_AirTempCor.xVal_C "/" VALUE 0x80031940 Kw_Wu8 0.00 OneToOne 0.00 0.00 EXTENDED_LIMITS 0.00 255.0 /end CHARACTERISTIC
/begin CHARACTERISTIC AirCtl_AirTempCor.xTyp_C "/" VALUE 0x80031941 Kw_Wu8 0.00 OneToOne 0.00 0.00 EXTENDED_LIMITS 0.00 255.0 /end CHARACTERISTIC
/begin CHARACTERISTIC AirCtl_AirTempCorBasEOMQnt1_MAP "" MAP 0x80031942 Kf_Xs16_Ys16_Ws16 1.000000 AirMassPerCyl 0.00 1.000000 EXTENDED_LIMITS -3276.800 3276.700
 /begin AXIS_DESCR STD_AXIS Epm_nEng EngN 12 0.00 10000.00 EXTENDED_LIMITS -16384.00 16383.50 DEPOSIT ABSOLUTE /end AXIS_DESCR
 /begin AXIS_DESCR STD_AXIS AirCtl_qDesValInl_mp InjMass 12 0.00 327.6700 EXTENDED_LIMITS -327.6800 327.6700 DEPOSIT ABSOLUTE /end AXIS_DESCR
/end CHARACTERISTIC
/begin CHARACTERISTIC AirCtl_AirTempCorBasEOMQnt2_MAP "" MAP 0x80031A96 Kf_Xs16_Ys16_Ws16 1.000000 AirMassPerCyl 0.00 1.000000 EXTENDED_LIMITS -3276.800 3276.700
 /begin AXIS_DESCR STD_AXIS Epm_nEng EngN 12 0.00 10000.00 EXTENDED_LIMITS -16384.00 16383.50 DEPOSIT ABSOLUTE /end AXIS_DESCR
 /begin AXIS_DESCR STD_AXIS AirCtl_qDesValInl_mp InjMass 12 0.00 327.6700 EXTENDED_LIMITS -327.6800 327.6700 DEPOSIT ABSOLUTE /end AXIS_DESCR
/end CHARACTERISTIC
/begin CHARACTERISTIC AirCtl_AirTempCorBasEOMQnt3_MAP "" MAP 0x80031BEA Kf_Xs16_Ys16_Ws16 1.000000 AirMassPerCyl 0.00 1.000000 EXTENDED_LIMITS -3276.800 3276.700
 /begin AXIS_DESCR STD_AXIS Epm_nEng EngN 2 0.00 10000.00 EXTENDED_LIMITS -16384.00 16383.50 DEPOSIT ABSOLUTE /end AXIS_DESCR
 /begin AXIS_DESCR STD_AXIS AirCtl_qDesValInl_mp InjMass 2 0.00 327.6700 EXTENDED_LIMITS -327.6800 327.6700 DEPOSIT ABSOLUTE /end AXIS_DESCR
/end CHARACTERISTIC
/begin CHARACTERISTIC AirCtl_AirTempCorBas_MAP "" MAP 0x80031BFE Kf_Xs16_Ys16_Ws16 1.000000 AirMassPerCyl 0.00 1.000000 EXTENDED_LIMITS -3276.800 3276.700
 /begin AXIS_DESCR STD_AXIS Epm_nEng EngN 16 0.00 10000.00 EXTENDED_LIMITS -16384.00 16383.50 DEPOSIT ABSOLUTE /end AXIS_DESCR
 /begin AXIS_DESCR STD_AXIS AirCtl_qDesVal_mp InjMass 16 0.00 327.6700 EXTENDED_LIMITS -327.6800 327.6700 DEPOSIT ABSOLUTE /end AXIS_DESCR
/end CHARACTERISTIC
/begin CHARACTERISTIC AirCtl_AirTempLPCorBas_MAP "" MAP 0x80034D40 Kf_Xs16_Ys16_Ws16 1500.000 AirMassPerCyl 0.00 1500.000 EXTENDED_LIMITS -3276.800 3276.700
 /begin AXIS_DESCR STD_AXIS Epm_nEng EngN 16 0.00 10000.00 EXTENDED_LIMITS -16384.00 16383.50 DEPOSIT ABSOLUTE /end AXIS_DESCR
 /begin AXIS_DESCR STD_AXIS AirCtl_qDesVal InjMass 16 0.00 327.6700 EXTENDED_LIMITS -327.6800 327.6700 DEPOSIT ABSOLUTE /end AXIS_DESCR
/end CHARACTERISTIC
/begin CHARACTERISTIC AirCtl_DKdEOM_C "" VALUE 0x80035B5C Kw_Ws32 3999.99999814 Kd_Ampc2Prc 0.00 3999.99999814 FORMAT "%13.8" EXTENDED_LIMITS -4000.00000000 3999.99999814 /end CHARACTERISTIC
/begin CHARACTERISTIC AirCtl_DkDesLPDyn_C "" VALUE 0x80034F84 Kw_Ws32 32767.9999847 Kd 0.00 32767.9999847 FORMAT "%13.7" EXTENDED_LIMITS -32768.0000000 32767.9999847 /end CHARACTERISTIC
/begin CHARACTERISTIC AirCtl_DKdmDes_C "" VALUE 0x80031E44 Kw_Ws32 32767.9999847 Kd 0.00 32767.9999847 FORMAT "%13.7" EXTENDED_LIMITS -32768.0000000 32767.9999847 /end CHARACTERISTIC
/begin CHARACTERISTIC AirCtl_DkDNegDesLPDyn_CUR "" CURVE 0x80034F88 Kl_Xs16_Ws16 511.9844 Kd_RedRes 0.00 511.9844 FORMAT "%8.4" EXTENDED_LIMITS -512.0000 511.9844
 /begin AXIS_DESCR STD_AXIS AirCtl_dmDesLPCor_mp AirMassPerCyl 10 -5000.000 5000.000 EXTENDED_LIMITS -3276.800 3276.700 DEPOSIT ABSOLUTE /end AXIS_DESCR
/end CHARACTERISTIC
/begin CHARACTERISTIC AirCtl_DKdNegGovEOM_MAP "" MAP 0x80035B60 Kf_Xs16_Ys16_Ws16 62.49809 Kd_Ampc2PrcRedRes 0.00 62.49809 FORMAT "%8.5" EXTENDED_LIMITS -62.50000 62.49809
 /begin AXIS_DESCR STD_AXIS Epm_nEng EngN 8 0.00 10000.00 EXTENDED_LIMITS -16384.00 16383.50 DEPOSIT ABSOLUTE /end AXIS_DESCR
 /begin AXIS_DESCR STD_AXIS AirCtl_qGov InjMass 8 -327.6800 327.6700 DEPOSIT ABSOLUTE /end AXIS_DESCR
/end CHARACTERISTIC
/begin CHARACTERISTIC AirCtl_DKdNegMDes_MAP "" MAP 0x80031E48 Kf_Xs16_Ys16_Ws16 511.9844 Kd_RedRes 0.00 511.9844 FORMAT "%8.4" EXTENDED_LIMITS -512.0000 511.9844
 /begin AXIS_DESCR STD_AXIS AirCtl_dmDesCor AirMassPerCyl 2 -5000.000 5000.000 EXTENDED_LIMITS -3276.800 3276.700 DEPOSIT ABSOLUTE /end AXIS_DESCR
 /begin AXIS_DESCR STD_AXIS AirCtl_mGovDvt AirMassPerCyl 2 -5000.000 5000.000 EXTENDED_LIMITS -3276.800 3276.700 DEPOSIT ABSOLUTE /end AXIS_DESCR
/end CHARACTERISTIC
/begin CHARACTERISTIC AirCtl_DKdNegPGovOff_MAP "" MAP 0x80035C04 Kf_Xs16_Ys16_Ws16 62.49809 Kd_Ampc2PrcRedRes 0.00 62.49809 FORMAT "%8.5" EXTENDED_LIMITS -62.50000 62.49809
 /begin AXIS_DESCR STD_AXIS Epm_nEng EngN 8 0.00 10000.00 EXTENDED_LIMITS -16384.00 16383.50 DEPOSIT ABSOLUTE /end AXIS_DESCR
 /begin AXIS_DESCR STD_AXIS AirCtl_qGov InjMass 8 -327.6800 327.6700 DEPOSIT ABSOLUTE /end AXIS_DESCR
/end CHARACTERISTIC
/begin CHARACTERISTIC AirCtl_DKdNegPGovOn_C "" VALUE 0x80035CA8 Kw_Ws32 3999.99999814 Kd_Ampc2Prc 0.00 3999.99999814 FORMAT "%13.8" EXTENDED_LIMITS -4000.00000000 3999.99999814 /end CHARACTERISTIC
/begin CHARACTERISTIC AirCtl_DKdPGovOff_C "" VALUE 0x80035CAC Kw_Ws32 3999.99999814 Kd_Ampc2Prc 0.00 3999.99999814 FORMAT "%13.8" EXTENDED_LIMITS -4000.00000000 3999.99999814 /end CHARACTERISTIC
/begin CHARACTERISTIC AirCtl_DkDPosDesLPDyn_CUR "" CURVE 0x80034FB2 Kl_Xs16_Ws16 511.9844 Kd_RedRes 0.00 511.9844 FORMAT "%8.4" EXTENDED_LIMITS -512.0000 511.9844
 /begin AXIS_DESCR STD_AXIS AirCtl_dmDesLPCor_mp AirMassPerCyl 10 -5000.000 5000.000 EXTENDED_LIMITS -3276.800 3276.700 DEPOSIT ABSOLUTE /end AXIS_DESCR
/end CHARACTERISTIC
/begin CHARACTERISTIC AirCtl_DKdPosGovEOM_MAP "" MAP 0x80035CB0 Kf_Xs16_Ys16_Ws16 62.49809 Kd_Ampc2PrcRedRes 0.00 62.49809 FORMAT "%8.5" EXTENDED_LIMITS -62.50000 62.49809
 /begin AXIS_DESCR STD_AXIS Epm_nEng EngN 8 0.00 10000.00 EXTENDED_LIMITS -16384.00 16383.50 DEPOSIT ABSOLUTE /end AXIS_DESCR
 /begin AXIS_DESCR STD_AXIS AirCtl_qGov InjMass 8 -327.6800 327.6700 DEPOSIT ABSOLUTE /end AXIS_DESCR
/end CHARACTERISTIC
/begin CHARACTERISTIC AirCtl_DKdPosMDes_MAP "" MAP 0x80031E5C Kf_Xs16_Ys16_Ws16 511.9844 Kd_RedRes 0.00 511.9844 FORMAT "%8.4" EXTENDED_LIMITS -512.0000 511.9844
 /begin AXIS_DESCR STD_AXIS AirCtl_dmDesCor AirMassPerCyl 8 -5000.000 5000.000 EXTENDED_LIMITS -3276.800 3276.700 DEPOSIT ABSOLUTE /end AXIS_DESCR
 /begin AXIS_DESCR STD_AXIS AirCtl_mGovDvt AirMassPerCyl 8 -5000.000 5000.000 EXTENDED_LIMITS -3276.800 3276.700 DEPOSIT ABSOLUTE /end AXIS_DESCR
/end CHARACTERISTIC
/begin CHARACTERISTIC AirCtl_DKdPosPGovOff_MAP "" MAP 0x80035D54 Kf_Xs16_Ys16_Ws16 62.49809 Kd_Ampc2PrcRedRes 0.00 62.49809 FORMAT "%8.5" EXTENDED_LIMITS -62.50000 62.49809
 /begin AXIS_DESCR STD_AXIS Epm_nEng EngN 8 0.00 10000.00 EXTENDED_LIMITS -16384.00 16383.50 DEPOSIT ABSOLUTE /end AXIS_DESCR
 /begin AXIS_DESCR STD_AXIS AirCtl_qGov InjMass 8 0.00 327.6700 EXTENDED_LIMITS -327.6800 327.6700 DEPOSIT ABSOLUTE /end AXIS_DESCR
/end CHARACTERISTIC
/begin CHARACTERISTIC AirCtl_DKdPosPGovOn_C "" VALUE 0x80035DF8 Kw_Ws32 3999.99999814 Kd_Ampc2Prc 0.00 3999.99999814 FORMAT "%13.8" EXTENDED_LIMITS -4000.00000000 3999.99999814 /end CHARACTERISTIC
/begin CHARACTERISTIC AirCtl_DKd_C "" VALUE 0x80035DFC Kw_Ws32 3999.99999814 Kd_Ampc2Prc 0.00 3999.99999814 FORMAT "%13.8" EXTENDED_LIMITS -4000.00000000 3999.99999814 /end CHARACTERISTIC
/begin CHARACTERISTIC AirCtl_dmDesBas.Pos_C "/" VALUE 0x80031F00 Kw_Ws32 3276799.99847 RmpAirMassPerCyl 0.00 3276799.99847 FORMAT "%13.5" EXTENDED_LIMITS -3276800.00000 3276799.99847 /end CHARACTERISTIC
/begin CHARACTERISTIC AirCtl_dmDesBas.Neg_C "/" VALUE 0x80031F04 Kw_Ws32 3276799.99847 RmpAirMassPerCyl 0.00 3276799.99847 FORMAT "%13.5" EXTENDED_LIMITS -3276800.00000 3276799.99847 /end CHARACTERISTIC
/begin CHARACTERISTIC AirCtl_dmDesBasLP.Pos_C "/" VALUE 0x80034FDC Kw_Ws32 3276799.99847 RmpAirMassPerCyl 0.00 3276799.99847 FORMAT "%13.5" EXTENDED_LIMITS -3276800.00000 3276799.99847 /end CHARACTERISTIC
/begin CHARACTERISTIC AirCtl_dmDesBasLP.Neg_C "/" VALUE 0x80034FE0 Kw_Ws32 3276799.99847 RmpAirMassPerCyl 0.00 3276799.99847 FORMAT "%13.5" EXTENDED_LIMITS -3276800.00000 3276799.99847 /end CHARACTERISTIC
/begin CHARACTERISTIC AirCtl_dmDWinNegDesLPDyn_C "" VALUE 0x80034FE4 Kw_Ws16 3276.800 AirMassPerCyl -3276.800 0.00 EXTENDED_LIMITS -3276.800 3276.700 /end CHARACTERISTIC
/begin CHARACTERISTIC AirCtl_dmDWinNegDes_C "" VALUE 0x80031F08 Kw_Ws16 3276.800 AirMassPerCyl -3276.800 0.00 EXTENDED_LIMITS -3276.800 3276.700 /end CHARACTERISTIC
/begin CHARACTERISTIC AirCtl_dmDWinNegEOM_C "" VALUE 0x80035E00 Kw_Ws16 6553.500 AirMassPerCyl -3276.800 3276.700 /end CHARACTERISTIC
/begin CHARACTERISTIC AirCtl_dmDWinNegPGovOff_C "" VALUE 0x80035E02 Kw_Ws16 3276.800 AirMassPerCyl -3276.800 0.00 EXTENDED_LIMITS -3276.800 3276.700 /end CHARACTERISTIC
/begin CHARACTERISTIC AirCtl_dmDWinNeg_C "" VALUE 0x80035E04 Kw_Ws16 3276.800 AirMassPerCyl -3276.800 0.00 EXTENDED_LIMITS -3276.800 3276.700 /end CHARACTERISTIC
/begin CHARACTERISTIC AirCtl_dmDWinPosDesLPDyn_C "" VALUE 0x80034FE6 Kw_Ws16 3276.700 AirMassPerCyl 0.00 3276.700 EXTENDED_LIMITS -3276.800 3276.700 /end CHARACTERISTIC
/begin CHARACTERISTIC AirCtl_dmDWinPosDes_C "" VALUE 0x80031F0A Kw_Ws16 3276.700 AirMassPerCyl 0.00 3276.700 EXTENDED_LIMITS -3276.800 3276.700 /end CHARACTERISTIC
/begin CHARACTERISTIC AirCtl_dmDWinPosEOM_C "" VALUE 0x80035E06 Kw_Ws16 3276.700 AirMassPerCyl 0.00 3276.700 EXTENDED_LIMITS -3276.800 3276.700 /end CHARACTERISTIC
/begin CHARACTERISTIC AirCtl_dmDWinPosPGovOff_C "" VALUE 0x80035E08 Kw_Ws16 3276.700 AirMassPerCyl 0.00 3276.700 EXTENDED_LIMITS -3276.800 3276.700 /end CHARACTERISTIC
/begin CHARACTERISTIC AirCtl_dmDWinPos_C "" VALUE 0x80035E0A Kw_Ws16 3276.700 AirMassPerCyl 0.00 3276.700 EXTENDED_LIMITS -3276.800 3276.700 /end CHARACTERISTIC
/begin CHARACTERISTIC AirCtl_dnSurgeHigh_CUR "" CURVE 0x80037014 Kl_Xs16_Ws16 3000.000 dn_dZ20 0.00 3000.000 FORMAT "%8.3" EXTENDED_LIMITS -163840.0 163835.0
 /begin AXIS_DESCR STD_AXIS Epm_nEng EngN 2 0.00 6000.000 EXTENDED_LIMITS -16384.00 16383.50 DEPOSIT ABSOLUTE /end AXIS_DESCR
/end CHARACTERISTIC
/begin CHARACTERISTIC AirCtl_dnSurgeLow_CUR "" CURVE 0x8003701E Kl_Xs16_Ws16 3000.000 dn_dZ20 0.00 3000.000 FORMAT "%8.3" EXTENDED_LIMITS -163840.0 163835.0
 /begin AXIS_DESCR STD_AXIS Epm_nEng EngN 2 0.00 6000.000 EXTENDED_LIMITS -16384.00 16383.50 DEPOSIT ABSOLUTE /end AXIS_DESCR
/end CHARACTERISTIC
/begin CHARACTERISTIC AirCtl_drBrkRmp.Pos_C "/" VALUE 0x80037028 Kw_Ws32 399999.999814 RmpPrc 0.00 399999.999814 FORMAT "%13.6" EXTENDED_LIMITS -400000.000000 399999.999814 /end CHARACTERISTIC
/begin CHARACTERISTIC AirCtl_drBrkRmp.Neg_C "/" VALUE 0x8003702C Kw_Ws32 399999.999814 RmpPrc 0.00 399999.999814 FORMAT "%13.6" EXTENDED_LIMITS -400000.000000 399999.999814 /end CHARACTERISTIC
/begin CHARACTERISTIC AirCtl_drDynMin.Pos_C "/" VALUE 0x80035E0C Kw_Ws32 3999.99991059 RmpPrc 0.00 3999.99991059 FORMAT "%13.8" EXTENDED_LIMITS -400000.000000 399999.999814 /end CHARACTERISTIC
/begin CHARACTERISTIC AirCtl_drDynMin.Neg_C "/" VALUE 0x80035E10 Kw_Ws32 3999.99991059 RmpPrc 0.00 3999.99991059 FORMAT "%13.8" EXTENDED_LIMITS -400000.000000 399999.999814 /end CHARACTERISTIC
/begin CHARACTERISTIC AirCtl_drDynOut1.Pos_C "/" VALUE 0x80035E14 Kw_Ws32 3999.99991059 RmpPrc 0.00 3999.99991059 FORMAT "%13.8" EXTENDED_LIMITS -400000.000000 399999.999814 /end CHARACTERISTIC
/begin CHARACTERISTIC AirCtl_drDynOut1.Neg_C "/" VALUE 0x80035E18 Kw_Ws32 3999.99991059 RmpPrc 0.00 3999.99991059 FORMAT "%13.8" EXTENDED_LIMITS -400000.000000 399999.999814 /end CHARACTERISTIC
/begin CHARACTERISTIC AirCtl_drDynOut2.Pos_C "/" VALUE 0x80035E1C Kw_Ws32 3999.99991059 RmpPrc 0.00 3999.99991059 FORMAT "%13.8" EXTENDED_LIMITS -400000.000000 399999.999814 /end CHARACTERISTIC
/begin CHARACTERISTIC AirCtl_drDynOut2.Neg_C "/" VALUE 0x80035E20 Kw_Ws32 3999.99991059 RmpPrc 0.00 3999.99991059 FORMAT "%13.8" EXTENDED_LIMITS -400000.000000 399999.999814 /end CHARACTERISTIC
/begin CHARACTERISTIC AirCtl_drGovDynMin.Pos_C "/" VALUE 0x80035E24 Kw_Ws32 3999.99991059 RmpPrc 0.00 3999.99991059 FORMAT "%13.8" EXTENDED_LIMITS -400000.000000 399999.999814 /end CHARACTERISTIC
/begin CHARACTERISTIC AirCtl_drGovDynMin.Neg_C "/" VALUE 0x80035E28 Kw_Ws32 3999.99991059 RmpPrc 0.00 3999.99991059 FORMAT "%13.8" EXTENDED_LIMITS -400000.000000 399999.999814 /end CHARACTERISTIC
/begin CHARACTERISTIC AirCtl_drTVACtlOvrRunRmp.Pos_C "/" VALUE 0x80035E2C Kw_Ws32 399999.999814 RmpPrc 0.00 399999.999814 FORMAT "%13.6" EXTENDED_LIMITS -400000.000000 399999.999814 /end CHARACTERISTIC
/begin CHARACTERISTIC AirCtl_drTVACtlOvrRunRmp.Neg_C "/" VALUE 0x80035E30 Kw_Ws32 399999.999814 RmpPrc 0.00 399999.999814 FORMAT "%13.6" EXTENDED_LIMITS -400000.000000 399999.999814 /end CHARACTERISTIC
/begin CHARACTERISTIC AirCtl_EOMI.Ki_C "/" VALUE 0x80035E34 Kw_Ws32 5.00000396642 Ki_Ampc2Prc 0.00 5.00000396642 FORMAT "%13.11" EXTENDED_LIMITS -122070.312500 122070.312443 /end CHARACTERISTIC
/begin CHARACTERISTIC AirCtl_EOMI.KiPos_C "/" VALUE 0x80035E38 Kw_Ws32 5.00000396642 Ki_Ampc2Prc 0.00 5.00000396642 FORMAT "%13.11" EXTENDED_LIMITS -122070.312500 122070.312443 /end CHARACTERISTIC
/begin CHARACTERISTIC AirCtl_EOMI.KiNeg_C "/" VALUE 0x80035E3C Kw_Ws32 5.00000396642 Ki_Ampc2Prc 0.00 5.00000396642 FORMAT "%13.11" EXTENDED_LIMITS -122070.312500 122070.312443 /end CHARACTERISTIC
/begin CHARACTERISTIC AirCtl_EOMI.WinPos_C "/" VALUE 0x80035E40 Kw_Ws32 1500.00000000 AirMassPerCyl 0.00 1500.00000000 EXTENDED_LIMITS -214748364.800 214748364.700 /end CHARACTERISTIC
/begin CHARACTERISTIC AirCtl_EOMI.WinNeg_C "/" VALUE 0x80035E44 Kw_Ws32 1500.00000000 AirMassPerCyl -1500.00000000 0.00 EXTENDED_LIMITS -214748364.800 214748364.700 /end CHARACTERISTIC
/begin CHARACTERISTIC AirCtl_EOMP.Kp_C "/" VALUE 0x80035E48 Kw_Ws32 10.0000016391 Kp_Ampc2Prc 0.00 10.0000016391 FORMAT "%13.10" EXTENDED_LIMITS -8000.00000000 7999.99999627 /end CHARACTERISTIC
/begin CHARACTERISTIC AirCtl_EOMP.KpPos_C "/" VALUE 0x80035E4C Kw_Ws32 10.0000016391 Kp_Ampc2Prc 0.00 10.0000016391 FORMAT "%13.10" EXTENDED_LIMITS -8000.00000000 7999.99999627 /end CHARACTERISTIC
/begin CHARACTERISTIC AirCtl_EOMP.KpNeg_C "/" VALUE 0x80035E50 Kw_Ws32 10.0000016391 Kp_Ampc2Prc 0.00 10.0000016391 FORMAT "%13.10" EXTENDED_LIMITS -8000.00000000 7999.99999627 /end CHARACTERISTIC
/begin CHARACTERISTIC AirCtl_EOMP.WinPos_C "/" VALUE 0x80035E54 Kw_Ws32 1500.00000000 AirMassPerCyl 0.00 1500.00000000 EXTENDED_LIMITS -214748364.800 214748364.700 /end CHARACTERISTIC
/begin CHARACTERISTIC AirCtl_EOMP.WinNeg_C "/" VALUE 0x80035E58 Kw_Ws32 1500.00000000 AirMassPerCyl -1500.00000000 0.00 EXTENDED_LIMITS -214748364.800 214748364.700 /end CHARACTERISTIC
/begin CHARACTERISTIC AirCtl_facActDesValLP_C "" VALUE 0x8003779C Val_Wu16 0.1999512 Fact 0.8000488 1.000000 EXTENDED_LIMITS 0.00 7.999878 /end CHARACTERISTIC
/begin CHARACTERISTIC AirCtl_facActDesVal_C "" VALUE 0x80037030 Val_Wu16 0.1999512 Fact 0.8000488 1.000000 EXTENDED_LIMITS 0.00 7.999878 /end CHARACTERISTIC
/begin CHARACTERISTIC AirCtl_facAirTempCorEOMQnt1_MAP "" MAP 0x80031F0C Kf_Xs16_Ys16_Ws16 1.000000 Fact 0.00 1.000000 EXTENDED_LIMITS -4.000000 3.999878
 /begin AXIS_DESCR STD_AXIS Epm_nEng EngN 16 0.00 10000.00 EXTENDED_LIMITS -16384.00 16383.50 DEPOSIT ABSOLUTE /end AXIS_DESCR
 /begin AXIS_DESCR STD_AXIS AirCtl_tAirDesVal_mp Temp_Cels 12 -50.14000 199.8600 EXTENDED_LIMITS -3549.940 3003.560 DEPOSIT ABSOLUTE /end AXIS_DESCR
/end CHARACTERISTIC
/begin CHARACTERISTIC AirCtl_facAirTempCorEOMQnt2_MAP "" MAP 0x800320C8 Kf_Xs16_Ys16_Ws16 1.000000 Fact 0.00 1.000000 EXTENDED_LIMITS -4.000000 3.999878
 /begin AXIS_DESCR STD_AXIS Epm_nEng EngN 16 0.00 10000.00 EXTENDED_LIMITS -16384.00 16383.50 DEPOSIT ABSOLUTE /end AXIS_DESCR
 /begin AXIS_DESCR STD_AXIS AirCtl_tAirDesVal_mp Temp_Cels 12 -50.14000 199.8600 EXTENDED_LIMITS -3549.940 3003.560 DEPOSIT ABSOLUTE /end AXIS_DESCR
/end CHARACTERISTIC
/begin CHARACTERISTIC AirCtl_facAirTempCorEOMQnt3_MAP "" MAP 0x80032284 Kf_Xs16_Ys16_Ws16 1.000000 Fact 0.00 1.000000 EXTENDED_LIMITS -4.000000 3.999878
 /begin AXIS_DESCR STD_AXIS Epm_nEng EngN 2 0.00 10000.00 EXTENDED_LIMITS -16384.00 16383.50 DEPOSIT ABSOLUTE /end AXIS_DESCR
 /begin AXIS_DESCR STD_AXIS AirCtl_tAirDesVal_mp Temp_Cels 2 -50.14000 199.8600 EXTENDED_LIMITS -3549.940 3003.560 DEPOSIT ABSOLUTE /end AXIS_DESCR
/end CHARACTERISTIC
/begin CHARACTERISTIC AirCtl_facAirTempCor_MAP "" MAP 0x80032298 Kf_Xs16_Ys16_Ws16 1.000000 Fact 0.00 1.000000 EXTENDED_LIMITS -4.000000 3.999878
 /begin AXIS_DESCR STD_AXIS Epm_nEng EngN 16 0.00 10000.00 EXTENDED_LIMITS -16384.00 16383.50 DEPOSIT ABSOLUTE /end AXIS_DESCR
 /begin AXIS_DESCR STD_AXIS AirCtl_tAirDesVal_mp Temp_Cels 16 -50.14000 199.8600 EXTENDED_LIMITS -3549.940 3003.560 DEPOSIT ABSOLUTE /end AXIS_DESCR
/end CHARACTERISTIC
/begin CHARACTERISTIC AirCtl_facAirTempLPCor_MAP "" MAP 0x80034FE8 Kf_Xs16_Ys16_Ws16 2.000000 Fact 0.00 2.000000 EXTENDED_LIMITS -4.000000 3.999878
 /begin AXIS_DESCR STD_AXIS Epm_nEng EngN 5 0.00 10000.00 EXTENDED_LIMITS -16384.00 16383.50 DEPOSIT ABSOLUTE /end AXIS_DESCR
 /begin AXIS_DESCR STD_AXIS AirCtl_tAirDesVal_mp Temp_Cels 12 -50.14000 199.8600 EXTENDED_LIMITS -3549.940 3003.560 DEPOSIT ABSOLUTE /end AXIS_DESCR
/end CHARACTERISTIC
/begin CHARACTERISTIC AirCtl_facDesEGRHighMCor_MAP "" MAP 0x800324DC Map_Xs16Ys16Ws16 1.000000 Fact 0.00 1.000000 EXTENDED_LIMITS -4.000000 3.999878
 /begin AXIS_DESCR STD_AXIS AirCtl_mEGRDiff AirMassPerCyl 4 -3276.800 3276.700 DEPOSIT ABSOLUTE /end AXIS_DESCR
 /begin AXIS_DESCR STD_AXIS AirCtl_qDesVal InjMass 4 -327.6800 327.6700 DEPOSIT ABSOLUTE /end AXIS_DESCR
/end CHARACTERISTIC
/begin CHARACTERISTIC AirCtl_facDesLPEngTempVCor_CUR "" CURVE 0x80035086 Kl_Xs16_Ws16 1.000000 Fact 0.00 1.000000 EXTENDED_LIMITS -4.000000 3.999878
 /begin AXIS_DESCR STD_AXIS CEngDsT_t Temp_Cels 8 -50.14000 149.8600 EXTENDED_LIMITS -3549.940 3003.560 DEPOSIT ABSOLUTE /end AXIS_DESCR
/end CHARACTERISTIC
/begin CHARACTERISTIC AirCtl_facDesLPVehVCor_CUR "" CURVE 0x800350A8 Kl_Xs16_Ws16 1.000000 Fact 0.00 1.000000 EXTENDED_LIMITS -4.000000 3.999878
 /begin AXIS_DESCR STD_AXIS VehV_v Vel 4 0.00 300.0000 EXTENDED_LIMITS -327.6800 327.6700 DEPOSIT ABSOLUTE /end AXIS_DESCR
/end CHARACTERISTIC
/begin CHARACTERISTIC AirCtl_facEGRCorAltEOMQnt1_CUR "" CURVE 0x80035E5C Cur_Xs16Ws16 2.000000 Fact1 0.00 2.000000 EXTENDED_LIMITS -256.0000 255.9922
 /begin AXIS_DESCR STD_AXIS EnvP_p Pres_hPa 6 0.00 3500.000 EXTENDED_LIMITS -32768.00 32767.00 DEPOSIT ABSOLUTE /end AXIS_DESCR
/end CHARACTERISTIC
/begin CHARACTERISTIC AirCtl_facEGRCorAltEOMQnt2_CUR "" CURVE 0x80035E76 Cur_Xs16Ws16 2.000000 Fact1 0.00 2.000000 EXTENDED_LIMITS -256.0000 255.9922
 /begin AXIS_DESCR STD_AXIS EnvP_p Pres_hPa 6 0.00 3500.000 EXTENDED_LIMITS -32768.00 32767.00 DEPOSIT ABSOLUTE /end AXIS_DESCR
/end CHARACTERISTIC
/begin CHARACTERISTIC AirCtl_facEngTempCor2_CUR "" CURVE 0x80032510 Kl_Xs16_Ws16 1.000000 Fact 0.00 1.000000 EXTENDED_LIMITS -4.000000 3.999878
 /begin AXIS_DESCR STD_AXIS AirCtl_tEngDesVal_mp Temp_Cels 16 -0.04000000 9999.960 EXTENDED_LIMITS -3549.940 3003.560 DEPOSIT ABSOLUTE /end AXIS_DESCR
/end CHARACTERISTIC
/begin CHARACTERISTIC AirCtl_facEngTempCorEOMQnt1_MAP "" MAP 0x80032552 Kf_Xs16_Ys16_Ws16 1.000000 Fact 0.00 1.000000 EXTENDED_LIMITS -4.000000 3.999878
 /begin AXIS_DESCR STD_AXIS Epm_nEng EngN 2 0.00 10000.00 EXTENDED_LIMITS -16384.00 16383.50 DEPOSIT ABSOLUTE /end AXIS_DESCR
 /begin AXIS_DESCR STD_AXIS AirCtl_tEngDesVal_mp Temp_Cels 2 -50.14000 199.8600 EXTENDED_LIMITS -3549.940 3003.560 DEPOSIT ABSOLUTE /end AXIS_DESCR
/end CHARACTERISTIC
/begin CHARACTERISTIC AirCtl_facEngTempCorEOMQnt2_MAP "" MAP 0x80032566 Kf_Xs16_Ys16_Ws16 1.000000 Fact 0.00 1.000000 EXTENDED_LIMITS -4.000000 3.999878
 /begin AXIS_DESCR STD_AXIS Epm_nEng EngN 2 0.00 10000.00 EXTENDED_LIMITS -16384.00 16383.50 DEPOSIT ABSOLUTE /end AXIS_DESCR
 /begin AXIS_DESCR STD_AXIS AirCtl_tEngDesVal_mp Temp_Cels 2 -50.14000 199.8600 EXTENDED_LIMITS -3549.940 3003.560 DEPOSIT ABSOLUTE /end AXIS_DESCR
/end CHARACTERISTIC
/begin CHARACTERISTIC AirCtl_facEngTempCorEOMQnt3_MAP "" MAP 0x8003257A Kf_Xs16_Ys16_Ws16 1.000000 Fact 0.00 1.000000 EXTENDED_LIMITS -4.000000 3.999878
 /begin AXIS_DESCR STD_AXIS Epm_nEng EngN 2 0.00 10000.00 EXTENDED_LIMITS -16384.00 16383.50 DEPOSIT ABSOLUTE /end AXIS_DESCR
 /begin AXIS_DESCR STD_AXIS AirCtl_tEngDesVal_mp Temp_Cels 2 -50.14000 199.8600 EXTENDED_LIMITS -3549.940 3003.560 DEPOSIT ABSOLUTE /end AXIS_DESCR
/end CHARACTERISTIC
/begin CHARACTERISTIC AirCtl_facEngTempCor_MAP "" MAP 0x8003258E Kf_Xs16_Ys16_Ws16 1.000000 Fact 0.00 1.000000 EXTENDED_LIMITS -4.000000 3.999878
 /begin AXIS_DESCR STD_AXIS Epm_nEng EngN 16 0.00 10000.00 EXTENDED_LIMITS -16384.00 16383.50 DEPOSIT ABSOLUTE /end AXIS_DESCR
 /begin AXIS_DESCR STD_AXIS AirCtl_tEngDesVal_mp Temp_Cels 16 -50.14000 199.8600 EXTENDED_LIMITS -3549.940 3003.560 DEPOSIT ABSOLUTE /end AXIS_DESCR
/end CHARACTERISTIC
/begin CHARACTERISTIC AirCtl_facEngTempLPCor2_CUR "" CURVE 0x800350BA Kl_Xs16_Ws16 1.000000 Fact 0.00 1.000000 EXTENDED_LIMITS -4.000000 3.999878
 /begin AXIS_DESCR STD_AXIS AirCtl_tEngDesVal_mp Temp_Cels 8 -0.04000000 9999.960 EXTENDED_LIMITS -3549.940 3003.560 DEPOSIT ABSOLUTE /end AXIS_DESCR
/end CHARACTERISTIC
/begin CHARACTERISTIC AirCtl_facEngTempLPCor_MAP "" MAP 0x800350DC Kf_Xs16_Ys16_Ws16 2.000000 Fact 0.00 2.000000 EXTENDED_LIMITS -4.000000 3.999878
 /begin AXIS_DESCR STD_AXIS Epm_nEng EngN 3 0.00 10000.00 EXTENDED_LIMITS -16384.00 16383.50 DEPOSIT ABSOLUTE /end AXIS_DESCR
 /begin AXIS_DESCR STD_AXIS AirCtl_tEngDesVal_mp Temp_Cels 8 -50.14000 199.8600 EXTENDED_LIMITS -3549.940 3003.560 DEPOSIT ABSOLUTE /end AXIS_DESCR
/end CHARACTERISTIC
/begin CHARACTERISTIC AirCtl_facEnvPresCorDef_CUR "" CURVE 0x800327D2 Kl_Xs16_Ws16 1.000000 Fact 0.00 1.000000 EXTENDED_LIMITS -4.000000 3.999878
 /begin AXIS_DESCR STD_AXIS EnvP_p Pres_hPa 6 0.00 3500.000 EXTENDED_LIMITS -32768.00 32767.00 DEPOSIT ABSOLUTE /end AXIS_DESCR
/end CHARACTERISTIC
/begin CHARACTERISTIC AirCtl_facEnvPresCorEOMQnt1_CUR "" CURVE 0x800327EC Kl_Xs16_Ws16 20.00000 Fact1 -10.00000 10.00000 EXTENDED_LIMITS -256.0000 255.9922
 /begin AXIS_DESCR STD_AXIS EnvP_p Pres_hPa 12 0.00 3500.000 EXTENDED_LIMITS -32768.00 32767.00 DEPOSIT ABSOLUTE /end AXIS_DESCR
/end CHARACTERISTIC
/begin CHARACTERISTIC AirCtl_facEnvPresCorEOMQnt2_CUR "" CURVE 0x8003281E Kl_Xs16_Ws16 20.00000 Fact1 -10.00000 10.00000 EXTENDED_LIMITS -256.0000 255.9922
 /begin AXIS_DESCR STD_AXIS EnvP_p Pres_hPa 16 0.00 3500.000 EXTENDED_LIMITS -32768.00 32767.00 DEPOSIT ABSOLUTE /end AXIS_DESCR
/end CHARACTERISTIC
/begin CHARACTERISTIC AirCtl_facEnvPresCorEOMQnt3_CUR "" CURVE 0x80032860 Kl_Xs16_Ws16 20.00000 Fact1 -10.00000 10.00000 EXTENDED_LIMITS -256.0000 255.9922
 /begin AXIS_DESCR STD_AXIS EnvP_p Pres_hPa 2 0.00 3500.000 EXTENDED_LIMITS -32768.00 32767.00 DEPOSIT ABSOLUTE /end AXIS_DESCR
/end CHARACTERISTIC
/begin CHARACTERISTIC AirCtl_facEnvPresCor_CUR "" CURVE 0x8003286A Kl_Xs16_Ws16 20.00000 Fact1 -10.00000 10.00000 EXTENDED_LIMITS -256.0000 255.9922
 /begin AXIS_DESCR STD_AXIS EnvP_p Pres_hPa 8 0.00 3500.000 EXTENDED_LIMITS -32768.00 32767.00 DEPOSIT ABSOLUTE /end AXIS_DESCR
/end CHARACTERISTIC
/begin CHARACTERISTIC AirCtl_facEnvPresLPCorDef_CUR "" CURVE 0x80035126 Kl_Xs16_Ws16 1.000000 Fact 0.00 1.000000 EXTENDED_LIMITS -4.000000 3.999878
 /begin AXIS_DESCR STD_AXIS EnvP_p Pres_hPa 6 0.00 3500.000 EXTENDED_LIMITS -32768.00 32767.00 DEPOSIT ABSOLUTE /end AXIS_DESCR
/end CHARACTERISTIC
/begin CHARACTERISTIC AirCtl_facEnvPresLPCor_CUR "" CURVE 0x80035140 Kl_Xs16_Ws16 2.000000 Fact 0.00 2.000000 EXTENDED_LIMITS -4.000000 3.999878
 /begin AXIS_DESCR STD_AXIS EnvP_p Pres_hPa 10 0.00 3500.000 EXTENDED_LIMITS -32768.00 32767.00 DEPOSIT ABSOLUTE /end AXIS_DESCR
/end CHARACTERISTIC
/begin CHARACTERISTIC AirCtl_facIParBas_MAP "" MAP 0x80035E90 Kf_Xs16_Ys16_Ws16 20.00000 Fact1 0.00 20.00000 EXTENDED_LIMITS -256.0000 255.9922
 /begin AXIS_DESCR STD_AXIS Epm_nEng EngN 6 0.00 8000.000 EXTENDED_LIMITS -16384.00 16383.50 DEPOSIT ABSOLUTE /end AXIS_DESCR
 /begin AXIS_DESCR STD_AXIS AirCtl_qGov_mp InjMass 6 0.00 327.6700 EXTENDED_LIMITS -327.6800 327.6700 DEPOSIT ABSOLUTE /end AXIS_DESCR
/end CHARACTERISTIC
/begin CHARACTERISTIC AirCtl_facIParNegBas_MAP "" MAP 0x80035EF4 Kf_Xs16_Ys16_Ws16 20.00000 Fact1 0.00 20.00000 EXTENDED_LIMITS -256.0000 255.9922
 /begin AXIS_DESCR STD_AXIS Epm_nEng EngN 6 0.00 8000.000 EXTENDED_LIMITS -16384.00 16383.50 DEPOSIT ABSOLUTE /end AXIS_DESCR
 /begin AXIS_DESCR STD_AXIS AirCtl_qGov_mp InjMass 6 0.00 327.6700 EXTENDED_LIMITS -327.6800 327.6700 DEPOSIT ABSOLUTE /end AXIS_DESCR
/end CHARACTERISTIC
/begin CHARACTERISTIC AirCtl_facIParPosBas_MAP "" MAP 0x80035F58 Kf_Xs16_Ys16_Ws16 20.00000 Fact1 0.00 20.00000 EXTENDED_LIMITS -256.0000 255.9922
 /begin AXIS_DESCR STD_AXIS Epm_nEng EngN 6 0.00 8000.000 EXTENDED_LIMITS -16384.00 16383.50 DEPOSIT ABSOLUTE /end AXIS_DESCR
 /begin AXIS_DESCR STD_AXIS AirCtl_qGov_mp InjMass 6 0.00 327.6700 EXTENDED_LIMITS -327.6800 327.6700 DEPOSIT ABSOLUTE /end AXIS_DESCR
/end CHARACTERISTIC
/begin CHARACTERISTIC AirCtl_facMaxTrmValEOM_C "" VALUE 0x8003288C Kw_Ws16 7.999878 Fact -4.000000 3.999878 /end CHARACTERISTIC
/begin CHARACTERISTIC AirCtl_facMaxTrmVal_C "" VALUE 0x8003288E Kw_Ws16 1.000000 Fact 0.00 1.000000 EXTENDED_LIMITS -4.000000 3.999878 /end CHARACTERISTIC
/begin CHARACTERISTIC AirCtl_facmDesVehTempCorr_CUR "" CURVE 0x80032890 Kl_Xs16_Ws16 1.000000 Fact 0.00 1.000000 EXTENDED_LIMITS -4.000000 3.999878
 /begin AXIS_DESCR STD_AXIS CEngDsT_t Temp_Cels 8 -50.14000 149.8600 EXTENDED_LIMITS -3549.940 3003.560 DEPOSIT ABSOLUTE /end AXIS_DESCR
/end CHARACTERISTIC
/begin CHARACTERISTIC AirCtl_facmDesVehVCorr_CUR "" CURVE 0x800328B2 Kl_Xs16_Ws16 1.000000 Fact 0.00 1.000000 EXTENDED_LIMITS -4.000000 3.999878
 /begin AXIS_DESCR STD_AXIS VehV_v Vel 4 0.00 300.0000 EXTENDED_LIMITS -327.6800 327.6700 DEPOSIT ABSOLUTE /end AXIS_DESCR
/end CHARACTERISTIC
/begin CHARACTERISTIC AirCtl_facMinTrmValEOM_C "" VALUE 0x800328C4 Kw_Ws16 7.999878 Fact -4.000000 3.999878 /end CHARACTERISTIC
/begin CHARACTERISTIC AirCtl_facMinTrmVal_C "" VALUE 0x800328C6 Kw_Ws16 1.000000 Fact 0.00 1.000000 EXTENDED_LIMITS -4.000000 3.999878 /end CHARACTERISTIC
/begin CHARACTERISTIC AirCtl_facParAirTempEOM_CUR "" CURVE 0x80035FBC Cur_Xs16Ws16 3.000000 Fact1 0.00 3.000000 EXTENDED_LIMITS -256.0000 255.9922
 /begin AXIS_DESCR STD_AXIS AirCtl_tAirGov_mp Temp_Cels 10 -50.14000 199.8600 EXTENDED_LIMITS -3549.940 3003.560 DEPOSIT ABSOLUTE /end AXIS_DESCR
/end CHARACTERISTIC
/begin CHARACTERISTIC AirCtl_facParAirTemp_CUR "" CURVE 0x80035FE6 Cur_Xs16Ws16 3.000000 Fact1 0.00 3.000000 EXTENDED_LIMITS -256.0000 255.9922
 /begin AXIS_DESCR STD_AXIS AirCtl_tAirGov_mp Temp_Cels 10 -50.14000 199.8600 EXTENDED_LIMITS -3549.940 3003.560 DEPOSIT ABSOLUTE /end AXIS_DESCR
/end CHARACTERISTIC
/begin CHARACTERISTIC AirCtl_facParBasEOM_MAP "" MAP 0x80036010 Kf_Xs16_Ys16_Ws16 20.00000 Fact1 0.00 20.00000 EXTENDED_LIMITS -256.0000 255.9922
 /begin AXIS_DESCR STD_AXIS Epm_nEng EngN 2 0.00 10000.00 EXTENDED_LIMITS -16384.00 16383.50 DEPOSIT ABSOLUTE /end AXIS_DESCR
 /begin AXIS_DESCR STD_AXIS AirCtl_qDesVal InjMass 2 0.00 327.6700 EXTENDED_LIMITS -327.6800 327.6700 DEPOSIT ABSOLUTE /end AXIS_DESCR
/end CHARACTERISTIC
/begin CHARACTERISTIC AirCtl_facParLPAirTemp_CUR "" CURVE 0x80036D28 Cur_Xs16Ws16 3.000000 Fact1 0.00 3.000000 EXTENDED_LIMITS -256.0000 255.9922
 /begin AXIS_DESCR STD_AXIS AirCtl_tAirGovLP_mp Temp_Cels 10 -3549.940 3003.560 DEPOSIT ABSOLUTE /end AXIS_DESCR
/end CHARACTERISTIC
/begin CHARACTERISTIC AirCtl_facParLPBas_MAP "" MAP 0x80036D52 Map_Xs16Ys16Ws16 20.00000 Fact1 0.00 20.00000 EXTENDED_LIMITS -256.0000 255.9922
 /begin AXIS_DESCR STD_AXIS Epm_nEng EngN 10 -16384.00 16383.50 DEPOSIT ABSOLUTE /end AXIS_DESCR
 /begin AXIS_DESCR STD_AXIS AirCtl_qGov InjMass 10 -327.6800 327.6700 DEPOSIT ABSOLUTE /end AXIS_DESCR
/end CHARACTERISTIC
/begin CHARACTERISTIC AirCtl_facParPresDiff_CUR "" CURVE 0x80036024 Kl_Xs16_Ws16 3.000000 Fact1 0.00 3.000000 EXTENDED_LIMITS -256.0000 255.9922
 /begin AXIS_DESCR STD_AXIS AirCtl_pFltPPFltDiff_mp Pres_hPa 12 0.00 3500.000 EXTENDED_LIMITS -32768.00 32767.00 DEPOSIT ABSOLUTE /end AXIS_DESCR
/end CHARACTERISTIC
/begin CHARACTERISTIC AirCtl_facParPresEGRDiff_CUR "" CURVE 0x80036056 Kl_Xs16_Ws16 2.000000 Fact1 0.00 2.000000 EXTENDED_LIMITS -256.0000 255.9922
 /begin AXIS_DESCR STD_AXIS ASMod_rPresEGRDiff Fact 6 -2000.000 2000.000 EXTENDED_LIMITS -4.000000 3.999878 DEPOSIT ABSOLUTE /end AXIS_DESCR
/end CHARACTERISTIC
/begin CHARACTERISTIC AirCtl_facPCRCorNeg_MAP "" MAP 0x80036070 Kf_Xs16_Ys16_Ws16 4.000000 Fact 0.00 4.000000 EXTENDED_LIMITS -4.000000 3.999878
 /begin AXIS_DESCR STD_AXIS Epm_nEng EngN 8 20.00000 10000.00 EXTENDED_LIMITS -16384.00 16383.50 DEPOSIT ABSOLUTE /end AXIS_DESCR
 /begin AXIS_DESCR STD_AXIS AirCtl_qGov InjMass 8 0.00 327.6700 EXTENDED_LIMITS -327.6800 327.6700 DEPOSIT ABSOLUTE /end AXIS_DESCR
/end CHARACTERISTIC
/begin CHARACTERISTIC AirCtl_facPCRCorPos_MAP "" MAP 0x80036114 Kf_Xs16_Ys16_Ws16 4.000000 Fact 0.00 4.000000 EXTENDED_LIMITS -4.000000 3.999878
 /begin AXIS_DESCR STD_AXIS Epm_nEng EngN 8 20.00000 10000.00 EXTENDED_LIMITS -16384.00 16383.50 DEPOSIT ABSOLUTE /end AXIS_DESCR
 /begin AXIS_DESCR STD_AXIS AirCtl_qGov InjMass 8 0.00 327.6700 EXTENDED_LIMITS -327.6800 327.6700 DEPOSIT ABSOLUTE /end AXIS_DESCR
/end CHARACTERISTIC
/begin CHARACTERISTIC AirCtl_facPParBas_MAP "" MAP 0x800361B8 Kf_Xs16_Ys16_Ws16 20.00000 Fact1 0.00 20.00000 EXTENDED_LIMITS -256.0000 255.9922
 /begin AXIS_DESCR STD_AXIS Epm_nEng EngN 6 0.00 8000.000 EXTENDED_LIMITS -16384.00 16383.50 DEPOSIT ABSOLUTE /end AXIS_DESCR
 /begin AXIS_DESCR STD_AXIS AirCtl_qGov_mp InjMass 6 0.00 327.6700 EXTENDED_LIMITS -327.6800 327.6700 DEPOSIT ABSOLUTE /end AXIS_DESCR
/end CHARACTERISTIC
/begin CHARACTERISTIC AirCtl_facPParNegBas_MAP "" MAP 0x8003621C Kf_Xs16_Ys16_Ws16 20.00000 Fact1 0.00 20.00000 EXTENDED_LIMITS -256.0000 255.9922
 /begin AXIS_DESCR STD_AXIS Epm_nEng EngN 6 0.00 8000.000 EXTENDED_LIMITS -16384.00 16383.50 DEPOSIT ABSOLUTE /end AXIS_DESCR
 /begin AXIS_DESCR STD_AXIS AirCtl_qGov_mp InjMass 6 0.00 327.6700 EXTENDED_LIMITS -327.6800 327.6700 DEPOSIT ABSOLUTE /end AXIS_DESCR
/end CHARACTERISTIC
/begin CHARACTERISTIC AirCtl_facPParPosBas_MAP "" MAP 0x80036280 Kf_Xs16_Ys16_Ws16 20.00000 Fact1 0.00 20.00000 EXTENDED_LIMITS -256.0000 255.9922
 /begin AXIS_DESCR STD_AXIS Epm_nEng EngN 6 0.00 8000.000 EXTENDED_LIMITS -16384.00 16383.50 DEPOSIT ABSOLUTE /end AXIS_DESCR
 /begin AXIS_DESCR STD_AXIS AirCtl_qGov_mp InjMass 6 0.00 327.6700 EXTENDED_LIMITS -327.6800 327.6700 DEPOSIT ABSOLUTE /end AXIS_DESCR
/end CHARACTERISTIC
/begin CHARACTERISTIC AirCtl_facRmpEGRCls_C "" VALUE 0x800362E4 Kw_Ws16 4998.932 PrcEGRRmp 1.068115 5000.000 FORMAT "%8.3" EXTENDED_LIMITS -5000.000 4999.847 /end CHARACTERISTIC
/begin CHARACTERISTIC AirCtl_facRmpEGROpn_C "" VALUE 0x800362E6 Kw_Ws16 4998.932 PrcEGRRmp -5000.000 -1.068115 FORMAT "%8.3" EXTENDED_LIMITS -5000.000 4999.847 /end CHARACTERISTIC
/begin CHARACTERISTIC AirCtl_facRmpValCor_CUR "" CURVE 0x800328C8 Kl_Xs16_Ws16 3.999939 CoEOMSwt_S16 -2.000000 1.999939 FORMAT "%8.6"
 /begin AXIS_DESCR STD_AXIS CoEOM_facRmpVal CoEOMSwt_S16 13 -2.000000 1.999939 FORMAT "%8.6" DEPOSIT ABSOLUTE /end AXIS_DESCR
/end CHARACTERISTIC
/begin CHARACTERISTIC AirCtl_facTrimAdjMax_C "" VALUE 0x800328FE Kw_Ws16 7.999878 Fact -4.000000 3.999878 /end CHARACTERISTIC
/begin CHARACTERISTIC AirCtl_facTrimAdjMin_C "" VALUE 0x80032900 Kw_Ws16 7.999878 Fact -4.000000 3.999878 /end CHARACTERISTIC
/begin CHARACTERISTIC AirCtl_facTVACtlATCor_CUR "" CURVE 0x800362E8 Cur_Xs16Ws16 5.000000 Fact1 0.00 5.000000 EXTENDED_LIMITS -256.0000 255.9922
 /begin AXIS_DESCR STD_AXIS Air_tAFS Temp_Cels 8 -50.04000 49.96000 EXTENDED_LIMITS -3549.940 3003.560 DEPOSIT ABSOLUTE /end AXIS_DESCR
/end CHARACTERISTIC
/begin CHARACTERISTIC AirCtl_facTVACtlCTCor_CUR "" CURVE 0x8003630A Cur_Xs16Ws16 5.000000 Fact1 0.00 5.000000 EXTENDED_LIMITS -256.0000 255.9922
 /begin AXIS_DESCR STD_AXIS CEngDsT_t Temp_Cels 8 -50.04000 49.96000 EXTENDED_LIMITS -3549.940 3003.560 DEPOSIT ABSOLUTE /end AXIS_DESCR
/end CHARACTERISTIC
/begin CHARACTERISTIC AirCtl_Gov.xVal_C "/" VALUE 0x8003632C Kw_Wu8 1.000 OneToOne 0.00 1.000 EXTENDED_LIMITS 0.00 255.0 /end CHARACTERISTIC
/begin CHARACTERISTIC AirCtl_Gov.xTyp_C "/" VALUE 0x8003632D Kw_Wu8 1.000 OneToOne 1.000 2.000 EXTENDED_LIMITS 0.00 255.0 /end CHARACTERISTIC
/begin CHARACTERISTIC AirCtl_GradGovOut.T1_C "/" VALUE 0x80036330 Kw_Ws32 3998.9384507 TimeDelay_ms 0.099999999907 3999.0384507 FORMAT "%12.7" EXTENDED_LIMITS 0.0020000000009 4294967.2960 /end CHARACTERISTIC
/begin CHARACTERISTIC AirCtl_GradGovOut.Kd_C "/" VALUE 0x80036334 Kw_Ws32 4.00000000000 Kd -2.00000000000 2.00000000000 FORMAT "%13.11" EXTENDED_LIMITS -32768.0000000 32767.9999847 /end CHARACTERISTIC
/begin CHARACTERISTIC AirCtl_I.Ki_C "/" VALUE 0x80036338 Kw_Ws32 5.00000396642 Ki_Ampc2Prc 0.00 5.00000396642 FORMAT "%13.11" EXTENDED_LIMITS -122070.312500 122070.312443 /end CHARACTERISTIC
/begin CHARACTERISTIC AirCtl_I.KiPos_C "/" VALUE 0x8003633C Kw_Ws32 5.00000396642 Ki_Ampc2Prc 0.00 5.00000396642 FORMAT "%13.11" EXTENDED_LIMITS -122070.312500 122070.312443 /end CHARACTERISTIC
/begin CHARACTERISTIC AirCtl_I.KiNeg_C "/" VALUE 0x80036340 Kw_Ws32 5.00000396642 Ki_Ampc2Prc 0.00 5.00000396642 FORMAT "%13.11" EXTENDED_LIMITS -122070.312500 122070.312443 /end CHARACTERISTIC
/begin CHARACTERISTIC AirCtl_I.WinPos_C "/" VALUE 0x80036344 Kw_Ws32 1500.00000000 AirMassPerCyl 0.00 1500.00000000 EXTENDED_LIMITS -214748364.800 214748364.700 /end CHARACTERISTIC
/begin CHARACTERISTIC AirCtl_I.WinNeg_C "/" VALUE 0x80036348 Kw_Ws32 1500.00000000 AirMassPerCyl -1500.00000000 0.00 EXTENDED_LIMITS -214748364.800 214748364.700 /end CHARACTERISTIC
/begin CHARACTERISTIC AirCtl_IPGovOff.Ki_C "/" VALUE 0x8003634C Kw_Ws32 5.00000396642 Ki_Ampc2Prc 0.00 5.00000396642 FORMAT "%13.11" EXTENDED_LIMITS -122070.312500 122070.312443 /end CHARACTERISTIC
/begin CHARACTERISTIC AirCtl_IPGovOff.KiPos_C "/" VALUE 0x80036350 Kw_Ws32 5.00000396642 Ki_Ampc2Prc 0.00 5.00000396642 FORMAT "%13.11" EXTENDED_LIMITS -122070.312500 122070.312443 /end CHARACTERISTIC
/begin CHARACTERISTIC AirCtl_IPGovOff.KiNeg_C "/" VALUE 0x80036354 Kw_Ws32 5.00000396642 Ki_Ampc2Prc 0.00 5.00000396642 FORMAT "%13.11" EXTENDED_LIMITS -122070.312500 122070.312443 /end CHARACTERISTIC
/begin CHARACTERISTIC AirCtl_IPGovOff.WinPos_C "/" VALUE 0x80036358 Kw_Ws32 1500.00000000 AirMassPerCyl 0.00 1500.00000000 EXTENDED_LIMITS -214748364.800 214748364.700 /end CHARACTERISTIC
/begin CHARACTERISTIC AirCtl_IPGovOff.WinNeg_C "/" VALUE 0x8003635C Kw_Ws32 1500.00000000 AirMassPerCyl -1500.00000000 0.00 EXTENDED_LIMITS -214748364.800 214748364.700 /end CHARACTERISTIC
/begin CHARACTERISTIC AirCtl_LpI.Ki_C "/" VALUE 0x80036E48 Kw_Ws32 10.0000079328 Ki_Ampc2Prc 0.00 10.0000079328 FORMAT "%13.10" EXTENDED_LIMITS -122070.312500 122070.312443 /end CHARACTERISTIC
/begin CHARACTERISTIC AirCtl_LpI.KiPos_C "/" VALUE 0x80036E4C Kw_Ws32 5.00000396642 Ki_Ampc2Prc 0.00 5.00000396642 FORMAT "%13.11" EXTENDED_LIMITS -122070.312500 122070.312443 /end CHARACTERISTIC
/begin CHARACTERISTIC AirCtl_LpI.KiNeg_C "/" VALUE 0x80036E50 Kw_Ws32 5.00000396642 Ki_Ampc2Prc 0.00 5.00000396642 FORMAT "%13.11" EXTENDED_LIMITS -122070.312500 122070.312443 /end CHARACTERISTIC
/begin CHARACTERISTIC AirCtl_LpI.WinPos_C "/" VALUE 0x80036E54 Kw_Ws32 1500.00000000 AirMassPerCyl 0.00 1500.00000000 EXTENDED_LIMITS -214748364.800 214748364.700 /end CHARACTERISTIC
/begin CHARACTERISTIC AirCtl_LpI.WinNeg_C "/" VALUE 0x80036E58 Kw_Ws32 1500.00000000 AirMassPerCyl -1500.00000000 0.00 EXTENDED_LIMITS -214748364.800 214748364.700 /end CHARACTERISTIC
/begin CHARACTERISTIC AirCtl_LpP.Kp_C "/" VALUE 0x80036E5C Kw_Ws32 10.0000016391 Kp_Ampc2Prc 0.00 10.0000016391 FORMAT "%13.10" EXTENDED_LIMITS -8000.00000000 7999.99999627 /end CHARACTERISTIC
/begin CHARACTERISTIC AirCtl_LpP.KpPos_C "/" VALUE 0x80036E60 Kw_Ws32 10.0000016391 Kp_Ampc2Prc 0.00 10.0000016391 FORMAT "%13.10" EXTENDED_LIMITS -8000.00000000 7999.99999627 /end CHARACTERISTIC
/begin CHARACTERISTIC AirCtl_LpP.KpNeg_C "/" VALUE 0x80036E64 Kw_Ws32 10.0000016391 Kp_Ampc2Prc 0.00 10.0000016391 FORMAT "%13.10" EXTENDED_LIMITS -8000.00000000 7999.99999627 /end CHARACTERISTIC
/begin CHARACTERISTIC AirCtl_LpP.WinPos_C "/" VALUE 0x80036E68 Kw_Ws32 1500.00000000 AirMassPerCyl 0.00 1500.00000000 EXTENDED_LIMITS -214748364.800 214748364.700 /end CHARACTERISTIC
/begin CHARACTERISTIC AirCtl_LpP.WinNeg_C "/" VALUE 0x80036E6C Kw_Ws32 1500.00000000 AirMassPerCyl -1500.00000000 0.00 EXTENDED_LIMITS -214748364.800 214748364.700 /end CHARACTERISTIC
/begin CHARACTERISTIC AirCtl_mDesACCorr_CUR "" CURVE 0x80032902 Kl_Xs16_Ws16 3000.000 AirMassPerCyl -1500.000 1500.000 EXTENDED_LIMITS -3276.800 3276.700
 /begin AXIS_DESCR STD_AXIS Epm_nEng EngN 8 0.00 10000.00 EXTENDED_LIMITS -16384.00 16383.50 DEPOSIT ABSOLUTE /end AXIS_DESCR
/end CHARACTERISTIC
/begin CHARACTERISTIC AirCtl_mDesAddEOMMax_C "" VALUE 0x80032924 Kw_Ws16 1500.000 AirMassPerCyl 0.00 1500.000 EXTENDED_LIMITS -3276.800 3276.700 /end CHARACTERISTIC
/begin CHARACTERISTIC AirCtl_mDesAddEOMMin_C "" VALUE 0x80032926 Kw_Ws16 1500.000 AirMassPerCyl 0.00 1500.000 EXTENDED_LIMITS -3276.800 3276.700 /end CHARACTERISTIC
/begin CHARACTERISTIC AirCtl_mDesAddMax_C "" VALUE 0x80032928 Kw_Ws16 1500.000 AirMassPerCyl 0.00 1500.000 EXTENDED_LIMITS -3276.800 3276.700 /end CHARACTERISTIC
/begin CHARACTERISTIC AirCtl_mDesAddMin_C "" VALUE 0x8003292A Kw_Ws16 1500.000 AirMassPerCyl 0.00 1500.000 EXTENDED_LIMITS -3276.800 3276.700 /end CHARACTERISTIC
/begin CHARACTERISTIC AirCtl_mDesBasDef_MAP "" MAP 0x8003292C Kf_Xs16_Ys16_Ws16 1500.000 AirMassPerCyl 0.00 1500.000 EXTENDED_LIMITS -3276.800 3276.700
 /begin AXIS_DESCR STD_AXIS Epm_nEng EngN 16 0.00 10000.00 EXTENDED_LIMITS -16384.00 16383.50 DEPOSIT ABSOLUTE /end AXIS_DESCR
 /begin AXIS_DESCR STD_AXIS AirCtl_qDesVal InjMass 16 0.00 327.6700 EXTENDED_LIMITS -327.6800 327.6700 DEPOSIT ABSOLUTE /end AXIS_DESCR
/end CHARACTERISTIC
/begin CHARACTERISTIC AirCtl_mDesBasEOMQnt1_MAP "" MAP 0x80032B70 Kf_Xs16_Ys16_Ws16 1500.000 AirMassPerCyl 0.00 1500.000 EXTENDED_LIMITS -3276.800 3276.700
 /begin AXIS_DESCR STD_AXIS Epm_nEng EngN 16 0.00 10000.00 EXTENDED_LIMITS -16384.00 16383.50 DEPOSIT ABSOLUTE /end AXIS_DESCR
 /begin AXIS_DESCR STD_AXIS AirCtl_qDesValInl_mp InjMass 16 0.00 327.6700 EXTENDED_LIMITS -327.6800 327.6700 DEPOSIT ABSOLUTE /end AXIS_DESCR
/end CHARACTERISTIC
/begin CHARACTERISTIC AirCtl_mDesBasEOMQnt2_MAP "" MAP 0x80032DB4 Kf_Xs16_Ys16_Ws16 1500.000 AirMassPerCyl 0.00 1500.000 EXTENDED_LIMITS -3276.800 3276.700
 /begin AXIS_DESCR STD_AXIS Epm_nEng EngN 16 0.00 10000.00 EXTENDED_LIMITS -16384.00 16383.50 DEPOSIT ABSOLUTE /end AXIS_DESCR
 /begin AXIS_DESCR STD_AXIS AirCtl_qDesValInl_mp InjMass 16 0.00 327.6700 EXTENDED_LIMITS -327.6800 327.6700 DEPOSIT ABSOLUTE /end AXIS_DESCR
/end CHARACTERISTIC
/begin CHARACTERISTIC AirCtl_mDesBasEOMQnt3_MAP "" MAP 0x80032FF8 Kf_Xs16_Ys16_Ws16 1500.000 AirMassPerCyl 0.00 1500.000 EXTENDED_LIMITS -3276.800 3276.700
 /begin AXIS_DESCR STD_AXIS Epm_nEng EngN 2 0.00 10000.00 EXTENDED_LIMITS -16384.00 16383.50 DEPOSIT ABSOLUTE /end AXIS_DESCR
 /begin AXIS_DESCR STD_AXIS AirCtl_qDesValInl_mp InjMass 2 0.00 327.6700 EXTENDED_LIMITS -327.6800 327.6700 DEPOSIT ABSOLUTE /end AXIS_DESCR
/end CHARACTERISTIC
/begin CHARACTERISTIC AirCtl_mDesBasHiAltdDef_MAP "" MAP 0x8003300C Kf_Xs16_Ys16_Ws16 1500.000 AirMassPerCyl 0.00 1500.000 EXTENDED_LIMITS -3276.800 3276.700
 /begin AXIS_DESCR STD_AXIS Epm_nEng EngN 16 0.00 10000.00 EXTENDED_LIMITS -16384.00 16383.50 DEPOSIT ABSOLUTE /end AXIS_DESCR
 /begin AXIS_DESCR STD_AXIS AirCtl_qDesVal InjMass 16 0.00 327.6700 EXTENDED_LIMITS -327.6800 327.6700 DEPOSIT ABSOLUTE /end AXIS_DESCR
/end CHARACTERISTIC
/begin CHARACTERISTIC AirCtl_mDesBasHiAltdEOMQnt1_MAP "" MAP 0x80033250 Kf_Xs16_Ys16_Ws16 1500.000 AirMassPerCyl 0.00 1500.000 EXTENDED_LIMITS -3276.800 3276.700
 /begin AXIS_DESCR STD_AXIS Epm_nEng EngN 16 0.00 10000.00 EXTENDED_LIMITS -16384.00 16383.50 DEPOSIT ABSOLUTE /end AXIS_DESCR
 /begin AXIS_DESCR STD_AXIS AirCtl_qDesValInl_mp InjMass 16 0.00 327.6700 EXTENDED_LIMITS -327.6800 327.6700 DEPOSIT ABSOLUTE /end AXIS_DESCR
/end CHARACTERISTIC
/begin CHARACTERISTIC AirCtl_mDesBasHiAltdEOMQnt2_MAP "" MAP 0x80033494 Kf_Xs16_Ys16_Ws16 1500.000 AirMassPerCyl 0.00 1500.000 EXTENDED_LIMITS -3276.800 3276.700
 /begin AXIS_DESCR STD_AXIS Epm_nEng EngN 16 0.00 10000.00 EXTENDED_LIMITS -16384.00 16383.50 DEPOSIT ABSOLUTE /end AXIS_DESCR
 /begin AXIS_DESCR STD_AXIS AirCtl_qDesValInl_mp InjMass 16 0.00 327.6700 EXTENDED_LIMITS -327.6800 327.6700 DEPOSIT ABSOLUTE /end AXIS_DESCR
/end CHARACTERISTIC
/begin CHARACTERISTIC AirCtl_mDesBasHiAltdEOMQnt3_MAP "" MAP 0x800336D8 Kf_Xs16_Ys16_Ws16 1500.000 AirMassPerCyl 0.00 1500.000 EXTENDED_LIMITS -3276.800 3276.700
 /begin AXIS_DESCR STD_AXIS Epm_nEng EngN 2 0.00 10000.00 EXTENDED_LIMITS -16384.00 16383.50 DEPOSIT ABSOLUTE /end AXIS_DESCR
 /begin AXIS_DESCR STD_AXIS AirCtl_qDesValInl_mp InjMass 2 0.00 327.6700 EXTENDED_LIMITS -327.6800 327.6700 DEPOSIT ABSOLUTE /end AXIS_DESCR
/end CHARACTERISTIC
/begin CHARACTERISTIC AirCtl_mDesBasHiAltd_MAP "" MAP 0x800336EC Kf_Xs16_Ys16_Ws16 1500.000 AirMassPerCyl 0.00 1500.000 EXTENDED_LIMITS -3276.800 3276.700
 /begin AXIS_DESCR STD_AXIS Epm_nEng EngN 16 0.00 10000.00 EXTENDED_LIMITS -16384.00 16383.50 DEPOSIT ABSOLUTE /end AXIS_DESCR
 /begin AXIS_DESCR STD_AXIS AirCtl_qDesVal_mp InjMass 16 0.00 327.6700 EXTENDED_LIMITS -327.6800 327.6700 DEPOSIT ABSOLUTE /end AXIS_DESCR
/end CHARACTERISTIC
/begin CHARACTERISTIC AirCtl_mDesBasLPDef_MAP "" MAP 0x8003516A Map_Xs16Ys16Ws16 1500.000 AirMassPerCyl 0.00 1500.000 EXTENDED_LIMITS -3276.800 3276.700
 /begin AXIS_DESCR STD_AXIS Epm_nEng EngN 8 0.00 10000.00 EXTENDED_LIMITS -16384.00 16383.50 DEPOSIT ABSOLUTE /end AXIS_DESCR
 /begin AXIS_DESCR STD_AXIS AirCtl_qDesVal InjMass 12 0.00 327.6700 EXTENDED_LIMITS -327.6800 327.6700 DEPOSIT ABSOLUTE /end AXIS_DESCR
/end CHARACTERISTIC
/begin CHARACTERISTIC AirCtl_mDesBasLPHiAltdDef_MAP "" MAP 0x80035256 Map_Xs16Ys16Ws16 1500.000 AirMassPerCyl 0.00 1500.000 EXTENDED_LIMITS -3276.800 3276.700
 /begin AXIS_DESCR STD_AXIS Epm_nEng EngN 8 0.00 10000.00 EXTENDED_LIMITS -16384.00 16383.50 DEPOSIT ABSOLUTE /end AXIS_DESCR
 /begin AXIS_DESCR STD_AXIS AirCtl_qDesVal InjMass 12 0.00 327.6700 EXTENDED_LIMITS -327.6800 327.6700 DEPOSIT ABSOLUTE /end AXIS_DESCR
/end CHARACTERISTIC
/begin CHARACTERISTIC AirCtl_mDesBasLPHiAltd_MAP "" MAP 0x80035342 Kf_Xs16_Ys16_Ws16 1500.000 AirMassPerCyl 0.00 1500.000 EXTENDED_LIMITS -3276.800 3276.700
 /begin AXIS_DESCR STD_AXIS Epm_nEng EngN 16 0.00 10000.00 EXTENDED_LIMITS -16384.00 16383.50 DEPOSIT ABSOLUTE /end AXIS_DESCR
 /begin AXIS_DESCR STD_AXIS AirCtl_qDesVal InjMass 16 0.00 327.6700 EXTENDED_LIMITS -327.6800 327.6700 DEPOSIT ABSOLUTE /end AXIS_DESCR
/end CHARACTERISTIC
/begin CHARACTERISTIC AirCtl_mDesBasLP_MAP "" MAP 0x80035586 Kf_Xs16_Ys16_Ws16 1500.000 AirMassPerCyl 0.00 1500.000 EXTENDED_LIMITS -3276.800 3276.700
 /begin AXIS_DESCR STD_AXIS Epm_nEng EngN 16 0.00 10000.00 EXTENDED_LIMITS -16384.00 16383.50 DEPOSIT ABSOLUTE /end AXIS_DESCR
 /begin AXIS_DESCR STD_AXIS AirCtl_qDesVal InjMass 16 0.00 327.6700 EXTENDED_LIMITS -327.6800 327.6700 DEPOSIT ABSOLUTE /end AXIS_DESCR
/end CHARACTERISTIC
/begin CHARACTERISTIC AirCtl_mDesBas_MAP "" MAP 0x80033930 Kf_Xs16_Ys16_Ws16 1500.000 AirMassPerCyl 0.00 1500.000 EXTENDED_LIMITS -3276.800 3276.700
 /begin AXIS_DESCR STD_AXIS Epm_nEng EngN 16 0.00 10000.00 EXTENDED_LIMITS -16384.00 16383.50 DEPOSIT ABSOLUTE /end AXIS_DESCR
 /begin AXIS_DESCR STD_AXIS AirCtl_qDesVal_mp InjMass 16 0.00 327.6700 EXTENDED_LIMITS -327.6800 327.6700 DEPOSIT ABSOLUTE /end AXIS_DESCR
/end CHARACTERISTIC
/begin CHARACTERISTIC AirCtl_mDesConvBas_C "" VALUE 0x80033B74 Kw_Ws16 1500.000 AirMassPerCyl 0.00 1500.000 EXTENDED_LIMITS -3276.800 3276.700 /end CHARACTERISTIC
/begin CHARACTERISTIC AirCtl_mDesConvEOM_C "" VALUE 0x80033B76 Kw_Ws16 1500.000 AirMassPerCyl 0.00 1500.000 EXTENDED_LIMITS -3276.800 3276.700 /end CHARACTERISTIC
/begin CHARACTERISTIC AirCtl_mDesEGRClgBypLim_MAP "" MAP 0x80033B78 Map_Xs16Ys16Ws16 1500.000 AirMassPerCyl 0.00 1500.000 EXTENDED_LIMITS -3276.800 3276.700
 /begin AXIS_DESCR STD_AXIS Epm_nEng EngN 2 0.00 5000.000 EXTENDED_LIMITS -16384.00 16383.50 DEPOSIT ABSOLUTE /end AXIS_DESCR
 /begin AXIS_DESCR STD_AXIS InjCtl_qRaw InjMass 2 0.00 50.00000 EXTENDED_LIMITS -327.6800 327.6700 DEPOSIT ABSOLUTE /end AXIS_DESCR
/end CHARACTERISTIC
/begin CHARACTERISTIC AirCtl_mDesGearEOM_MAP "" MAP 0x80033B8C Kf_Xs16_Ys16_Ws16 3000.000 AirMassPerCyl -1500.000 1500.000 EXTENDED_LIMITS -3276.800 3276.700
 /begin AXIS_DESCR STD_AXIS Epm_nEng EngN 4 0.00 6000.000 EXTENDED_LIMITS -16384.00 16383.50 DEPOSIT ABSOLUTE /end AXIS_DESCR
 /begin AXIS_DESCR STD_AXIS AirCtl_qDesVal InjMass 4 0.00 327.6700 EXTENDED_LIMITS -327.6800 327.6700 DEPOSIT ABSOLUTE /end AXIS_DESCR
/end CHARACTERISTIC
/begin CHARACTERISTIC AirCtl_mDesGear_MAP "" MAP 0x80033BC0 Kf_Xs16_Ys16_Ws16 3000.000 AirMassPerCyl -1500.000 1500.000 EXTENDED_LIMITS -3276.800 3276.700
 /begin AXIS_DESCR STD_AXIS Epm_nEng EngN 8 -16384.00 16383.50 DEPOSIT ABSOLUTE /end AXIS_DESCR
 /begin AXIS_DESCR STD_AXIS AirCtl_qDesVal InjMass 8 0.00 327.6700 EXTENDED_LIMITS -327.6800 327.6700 DEPOSIT ABSOLUTE /end AXIS_DESCR
/end CHARACTERISTIC
/begin CHARACTERISTIC AirCtl_mDesLPACCor_CUR "" CURVE 0x800357CA Kl_Xs16_Ws16 3000.000 AirMassPerCyl -1500.000 1500.000 EXTENDED_LIMITS -3276.800 3276.700
 /begin AXIS_DESCR STD_AXIS Epm_nEng EngN 8 0.00 10000.00 EXTENDED_LIMITS -16384.00 16383.50 DEPOSIT ABSOLUTE /end AXIS_DESCR
/end CHARACTERISTIC
/begin CHARACTERISTIC AirCtl_mDesLPAddMax_C "" VALUE 0x800357EC Kw_Ws16 1500.000 AirMassPerCyl 0.00 1500.000 EXTENDED_LIMITS -3276.800 3276.700 /end CHARACTERISTIC
/begin CHARACTERISTIC AirCtl_mDesLPAddMin_C "" VALUE 0x800357EE Kw_Ws16 1500.000 AirMassPerCyl 0.00 1500.000 EXTENDED_LIMITS -3276.800 3276.700 /end CHARACTERISTIC
/begin CHARACTERISTIC AirCtl_mDesLPClthBas_C "" VALUE 0x800357F0 Kw_Ws16 1500.000 AirMassPerCyl 0.00 1500.000 EXTENDED_LIMITS -3276.800 3276.700 /end CHARACTERISTIC
/begin CHARACTERISTIC AirCtl_mDesLPGear_MAP "" MAP 0x800357F2 Map_Xs16Ys16Ws16 1000.000 AirMassPerCyl 0.00 1000.000 EXTENDED_LIMITS -3276.800 3276.700
 /begin AXIS_DESCR STD_AXIS Epm_nEng EngN 4 -16384.00 16383.50 DEPOSIT ABSOLUTE /end AXIS_DESCR
 /begin AXIS_DESCR STD_AXIS AirCtl_qDesVal InjMass 4 -327.6800 327.6700 DEPOSIT ABSOLUTE /end AXIS_DESCR
/end CHARACTERISTIC
/begin CHARACTERISTIC AirCtl_mDesLPPil2Cor_C "" VALUE 0x80035826 Kw_Ws16 6553.500 AirMassPerCyl -3276.800 3276.700 /end CHARACTERISTIC
/begin CHARACTERISTIC AirCtl_mDesLPStrg_MAP "" MAP 0x80035828 Kf_Xs16_Ys16_Ws16 1000.000 AirMassPerCyl 0.00 1000.000 EXTENDED_LIMITS -3276.800 3276.700
 /begin AXIS_DESCR STD_AXIS Com_phiStWhlAg AngleStWhl 4 -180.0000 180.0000 FORMAT "%8.4" EXTENDED_LIMITS -1024.000 1023.969 DEPOSIT ABSOLUTE /end AXIS_DESCR
 /begin AXIS_DESCR STD_AXIS Com_dphiStWhlAg AngleVelStWhl 4 -1024.000 1023.969 FORMAT "%8.3" DEPOSIT ABSOLUTE /end AXIS_DESCR
/end CHARACTERISTIC
/begin CHARACTERISTIC AirCtl_mDesLPVehVCor_MAP "" MAP 0x8003585C Kf_Xs16_Ys16_Ws16 3000.000 AirMassPerCyl -1500.000 1500.000 EXTENDED_LIMITS -3276.800 3276.700
 /begin AXIS_DESCR STD_AXIS Epm_nEng EngN 4 0.00 10000.00 EXTENDED_LIMITS -16384.00 16383.50 DEPOSIT ABSOLUTE /end AXIS_DESCR
 /begin AXIS_DESCR STD_AXIS InjCtl_qCurr InjMass 6 0.00 100.0000 EXTENDED_LIMITS -327.6800 327.6700 DEPOSIT ABSOLUTE /end AXIS_DESCR
/end CHARACTERISTIC
/begin CHARACTERISTIC AirCtl_mDesMaxValEOM_C "" VALUE 0x80033C64 Kw_Ws16 1500.000 AirMassPerCyl 0.00 1500.000 EXTENDED_LIMITS -3276.800 3276.700 /end CHARACTERISTIC
/begin CHARACTERISTIC AirCtl_mDesMaxVal_C "" VALUE 0x80033C66 Kw_Ws16 1500.000 AirMassPerCyl 0.00 1500.000 EXTENDED_LIMITS -3276.800 3276.700 /end CHARACTERISTIC
/begin CHARACTERISTIC AirCtl_mDesMinValEOM_C "" VALUE 0x80033C68 Kw_Ws16 1500.000 AirMassPerCyl 0.00 1500.000 EXTENDED_LIMITS -3276.800 3276.700 /end CHARACTERISTIC
/begin CHARACTERISTIC AirCtl_mDesMinVal_C "" VALUE 0x80033C6A Kw_Ws16 1500.000 AirMassPerCyl 0.00 1500.000 EXTENDED_LIMITS -3276.800 3276.700 /end CHARACTERISTIC
/begin CHARACTERISTIC AirCtl_mDesRmp_CUR "" CURVE 0x80033C6C Kl_Xs16_Ws16 10000.00 AirMassPerCyl -5000.000 5000.000 EXTENDED_LIMITS -3276.800 3276.700
 /begin AXIS_DESCR STD_AXIS AirCtl_mDesCorCalc2_mp AirMassPerCyl 7 -5000.000 5000.000 EXTENDED_LIMITS -3276.800 3276.700 DEPOSIT ABSOLUTE /end AXIS_DESCR
/end CHARACTERISTIC
/begin CHARACTERISTIC AirCtl_mDesStrgCorrEOM_MAP "" MAP 0x80033C8A Kf_Xs16_Ys16_Ws16 3000.000 AirMassPerCyl -1500.000 1500.000 EXTENDED_LIMITS -3276.800 3276.700
 /begin AXIS_DESCR STD_AXIS Com_phiStWhlAg AngleStWhl 4 -180.0000 180.0000 FORMAT "%8.4" EXTENDED_LIMITS -1024.000 1023.969 DEPOSIT ABSOLUTE /end AXIS_DESCR
 /begin AXIS_DESCR STD_AXIS Com_dphiStWhlAg AngleVelStWhl 4 -1024.000 1023.969 FORMAT "%8.3" DEPOSIT ABSOLUTE /end AXIS_DESCR
/end CHARACTERISTIC
/begin CHARACTERISTIC AirCtl_mDesStrgCorr_MAP "" MAP 0x80033CBE Kf_Xs16_Ys16_Ws16 3000.000 AirMassPerCyl -1500.000 1500.000 EXTENDED_LIMITS -3276.800 3276.700
 /begin AXIS_DESCR STD_AXIS Com_phiStWhlAg AngleStWhl 4 -180.0000 180.0000 FORMAT "%8.4" EXTENDED_LIMITS -1024.000 1023.969 DEPOSIT ABSOLUTE /end AXIS_DESCR
 /begin AXIS_DESCR STD_AXIS Com_dphiStWhlAg AngleVelStWhl 4 -1024.000 1023.969 FORMAT "%8.3" DEPOSIT ABSOLUTE /end AXIS_DESCR
/end CHARACTERISTIC
/begin CHARACTERISTIC AirCtl_mDesValEgrHPMax_C "" VALUE 0x80036FC4 Val_Ws16 100.0000 AirMassPerCyl 0.00 100.0000 EXTENDED_LIMITS -3276.800 3276.700 /end CHARACTERISTIC
/begin CHARACTERISTIC AirCtl_mDesValEgrHPMin_C "" VALUE 0x80036FC6 Val_Ws16 100.0000 AirMassPerCyl 0.00 100.0000 EXTENDED_LIMITS -3276.800 3276.700 /end CHARACTERISTIC
/begin CHARACTERISTIC AirCtl_mDesValFltInit_C "" VALUE 0x80033CF2 Val_Ws16 1000.000 AirMassPerCyl 200.0000 1200.000 EXTENDED_LIMITS -3276.800 3276.700 /end CHARACTERISTIC
/begin CHARACTERISTIC AirCtl_mDesValLPAIIMax_C "" VALUE 0x800358A4 Kw_Ws16 1500.000 AirMassPerCyl 0.00 1500.000 EXTENDED_LIMITS -3276.800 3276.700 /end CHARACTERISTIC
/begin CHARACTERISTIC AirCtl_mDesValLPMax_C "" VALUE 0x800358A6 Kw_Ws16 1500.000 AirMassPerCyl 0.00 1500.000 EXTENDED_LIMITS -3276.800 3276.700 /end CHARACTERISTIC
/begin CHARACTERISTIC AirCtl_mDesValLPMin_C "" VALUE 0x800358A8 Kw_Ws16 1500.000 AirMassPerCyl 0.00 1500.000 EXTENDED_LIMITS -3276.800 3276.700 /end CHARACTERISTIC
/begin CHARACTERISTIC AirCtl_mDesVehVCorr_MAP "" MAP 0x80033CF4 Kf_Xs16_Ys16_Ws16 3000.000 AirMassPerCyl -1500.000 1500.000 EXTENDED_LIMITS -3276.800 3276.700
 /begin AXIS_DESCR STD_AXIS Epm_nEng EngN 16 0.00 10000.00 EXTENDED_LIMITS -16384.00 16383.50 DEPOSIT ABSOLUTE /end AXIS_DESCR
 /begin AXIS_DESCR STD_AXIS InjCtl_qCurr InjMass 16 0.00 100.0000 EXTENDED_LIMITS -327.6800 327.6700 DEPOSIT ABSOLUTE /end AXIS_DESCR
/end CHARACTERISTIC
/begin CHARACTERISTIC AirCtl_mEngTempCorBas2_MAP "" MAP 0x80033F38 Kf_Xs16_Ys16_Ws16 1500.000 AirMassPerCyl 0.00 1500.000 EXTENDED_LIMITS -3276.800 3276.700
 /begin AXIS_DESCR STD_AXIS Epm_nEng EngN 16 -16384.00 16383.50 DEPOSIT ABSOLUTE /end AXIS_DESCR
 /begin AXIS_DESCR STD_AXIS AirCtl_qDesVal InjMass 16 -327.6800 327.6700 DEPOSIT ABSOLUTE /end AXIS_DESCR
/end CHARACTERISTIC
/begin CHARACTERISTIC AirCtl_mEngTempCorBasEOMQnt1_MAP "" MAP 0x8003417C Kf_Xs16_Ys16_Ws16 1500.000 AirMassPerCyl 0.00 1500.000 EXTENDED_LIMITS -3276.800 3276.700
 /begin AXIS_DESCR STD_AXIS Epm_nEng EngN 16 0.00 10000.00 EXTENDED_LIMITS -16384.00 16383.50 DEPOSIT ABSOLUTE /end AXIS_DESCR
 /begin AXIS_DESCR STD_AXIS AirCtl_qDesValInl_mp InjMass 16 0.00 327.6700 EXTENDED_LIMITS -327.6800 327.6700 DEPOSIT ABSOLUTE /end AXIS_DESCR
/end CHARACTERISTIC
/begin CHARACTERISTIC AirCtl_mEngTempCorBasEOMQnt2_MAP "" MAP 0x800343C0 Kf_Xs16_Ys16_Ws16 1500.000 AirMassPerCyl 0.00 1500.000 EXTENDED_LIMITS -3276.800 3276.700
 /begin AXIS_DESCR STD_AXIS Epm_nEng EngN 16 0.00 10000.00 EXTENDED_LIMITS -16384.00 16383.50 DEPOSIT ABSOLUTE /end AXIS_DESCR
 /begin AXIS_DESCR STD_AXIS AirCtl_qDesValInl_mp InjMass 16 0.00 327.6700 EXTENDED_LIMITS -327.6800 327.6700 DEPOSIT ABSOLUTE /end AXIS_DESCR
/end CHARACTERISTIC
/begin CHARACTERISTIC AirCtl_mEngTempCorBasEOMQnt3_MAP "" MAP 0x80034604 Kf_Xs16_Ys16_Ws16 1500.000 AirMassPerCyl 0.00 1500.000 EXTENDED_LIMITS -3276.800 3276.700
 /begin AXIS_DESCR STD_AXIS Epm_nEng EngN 2 0.00 10000.00 EXTENDED_LIMITS -16384.00 16383.50 DEPOSIT ABSOLUTE /end AXIS_DESCR
 /begin AXIS_DESCR STD_AXIS AirCtl_qDesValInl_mp InjMass 2 0.00 327.6700 EXTENDED_LIMITS -327.6800 327.6700 DEPOSIT ABSOLUTE /end AXIS_DESCR
/end CHARACTERISTIC
/begin CHARACTERISTIC AirCtl_mEngTempCorBas_MAP "" MAP 0x80034618 Kf_Xs16_Ys16_Ws16 1500.000 AirMassPerCyl 0.00 1500.000 EXTENDED_LIMITS -3276.800 3276.700
 /begin AXIS_DESCR STD_AXIS Epm_nEng EngN 16 0.00 10000.00 EXTENDED_LIMITS -16384.00 16383.50 DEPOSIT ABSOLUTE /end AXIS_DESCR
 /begin AXIS_DESCR STD_AXIS AirCtl_qDesVal_mp InjMass 16 0.00 327.6700 EXTENDED_LIMITS -327.6800 327.6700 DEPOSIT ABSOLUTE /end AXIS_DESCR
/end CHARACTERISTIC
/begin CHARACTERISTIC AirCtl_mEngTempLPCorBas2_MAP "" MAP 0x800358AA Map_Xs16Ys16Ws16 1500.000 AirMassPerCyl 0.00 1500.000 EXTENDED_LIMITS -3276.800 3276.700
 /begin AXIS_DESCR STD_AXIS Epm_nEng EngN 8 0.00 10000.00 EXTENDED_LIMITS -16384.00 16383.50 DEPOSIT ABSOLUTE /end AXIS_DESCR
 /begin AXIS_DESCR STD_AXIS AirCtl_qDesVal InjMass 8 0.00 327.6700 EXTENDED_LIMITS -327.6800 327.6700 DEPOSIT ABSOLUTE /end AXIS_DESCR
/end CHARACTERISTIC
/begin CHARACTERISTIC AirCtl_mEngTempLPCorBas_MAP "" MAP 0x8003594E Kf_Xs16_Ys16_Ws16 1500.000 AirMassPerCyl 0.00 1500.000 EXTENDED_LIMITS -3276.800 3276.700
 /begin AXIS_DESCR STD_AXIS Epm_nEng EngN 12 0.00 10000.00 EXTENDED_LIMITS -16384.00 16383.50 DEPOSIT ABSOLUTE /end AXIS_DESCR
 /begin AXIS_DESCR STD_AXIS AirCtl_qDesVal InjMass 16 0.00 327.6700 EXTENDED_LIMITS -327.6800 327.6700 DEPOSIT ABSOLUTE /end AXIS_DESCR
/end CHARACTERISTIC
/begin CHARACTERISTIC AirCtl_mLiCor_C "" VALUE 0x8003485C Kw_Ws16 6000.000 AirMassPerCyl 0.00 6000.000 EXTENDED_LIMITS -3276.800 3276.700 /end CHARACTERISTIC
/begin CHARACTERISTIC AirCtl_mLiEgrLPCor_C "" VALUE 0x80035B0A Kw_Ws16 1500.000 AirMassPerCyl 0.00 1500.000 EXTENDED_LIMITS -3276.800 3276.700 /end CHARACTERISTIC
/begin CHARACTERISTIC AirCtl_mMaxDesValEOM_C "" VALUE 0x8003485E Kw_Ws16 1500.000 AirMassPerCyl 0.00 1500.000 EXTENDED_LIMITS -3276.800 3276.700 /end CHARACTERISTIC
/begin CHARACTERISTIC AirCtl_mMaxDesVal_C "" VALUE 0x80034860 Kw_Ws16 1500.000 AirMassPerCyl 0.00 1500.000 EXTENDED_LIMITS -3276.800 3276.700 /end CHARACTERISTIC
/begin CHARACTERISTIC AirCtl_mMaxDvtEOM_MAP "" MAP 0x80037032 Map_Xs16Ys16Ws16 200.0000 AirMassPerCyl 0.00 200.0000 EXTENDED_LIMITS -3276.800 3276.700
 /begin AXIS_DESCR STD_AXIS Epm_nEng EngN 16 0.00 6000.000 EXTENDED_LIMITS -16384.00 16383.50 DEPOSIT ABSOLUTE /end AXIS_DESCR
 /begin AXIS_DESCR STD_AXIS AirCtl_qMon InjMass 16 0.00 200.0000 EXTENDED_LIMITS -327.6800 327.6700 DEPOSIT ABSOLUTE /end AXIS_DESCR
/end CHARACTERISTIC
/begin CHARACTERISTIC AirCtl_mMaxDvt_MAP "" MAP 0x80037276 Map_Xs16Ys16Ws16 3276.700 AirMassPerCyl 0.00 3276.700 EXTENDED_LIMITS -3276.800 3276.700
 /begin AXIS_DESCR STD_AXIS Epm_nEng EngN 6 0.00 8000.000 EXTENDED_LIMITS -16384.00 16383.50 DEPOSIT ABSOLUTE /end AXIS_DESCR
 /begin AXIS_DESCR STD_AXIS AirCtl_qMon InjMass 6 0.00 200.0000 EXTENDED_LIMITS -327.6800 327.6700 DEPOSIT ABSOLUTE /end AXIS_DESCR
/end CHARACTERISTIC
/begin CHARACTERISTIC AirCtl_mMaxLPDvt_MAP "" MAP 0x8003779E Map_Xs16Ys16Ws16 200.0000 AirMassPerCyl 0.00 200.0000 EXTENDED_LIMITS -3276.800 3276.700
 /begin AXIS_DESCR STD_AXIS Epm_nEng EngN 6 0.00 10000.00 EXTENDED_LIMITS -16384.00 16383.50 DEPOSIT ABSOLUTE /end AXIS_DESCR
 /begin AXIS_DESCR STD_AXIS AirCtl_qMon InjMass 6 0.00 200.0000 EXTENDED_LIMITS -327.6800 327.6700 DEPOSIT ABSOLUTE /end AXIS_DESCR
/end CHARACTERISTIC
/begin CHARACTERISTIC AirCtl_mMinDesValEOM_C "" VALUE 0x80034862 Kw_Ws16 1500.000 AirMassPerCyl 0.00 1500.000 EXTENDED_LIMITS -3276.800 3276.700 /end CHARACTERISTIC
/begin CHARACTERISTIC AirCtl_mMinDesVal_C "" VALUE 0x80034864 Kw_Ws16 1500.000 AirMassPerCyl 0.00 1500.000 EXTENDED_LIMITS -3276.800 3276.700 /end CHARACTERISTIC
/begin CHARACTERISTIC AirCtl_mMinDvtEOM_MAP "" MAP 0x800372DA Map_Xs16Ys16Ws16 200.0000 AirMassPerCyl -200.0000 0.00 EXTENDED_LIMITS -3276.800 3276.700
 /begin AXIS_DESCR STD_AXIS Epm_nEng EngN 10 0.00 6000.000 EXTENDED_LIMITS -16384.00 16383.50 DEPOSIT ABSOLUTE /end AXIS_DESCR
 /begin AXIS_DESCR STD_AXIS AirCtl_qMon InjMass 10 0.00 200.0000 EXTENDED_LIMITS -327.6800 327.6700 DEPOSIT ABSOLUTE /end AXIS_DESCR
/end CHARACTERISTIC
/begin CHARACTERISTIC AirCtl_mMinDvt_MAP "" MAP 0x800373CE Map_Xs16Ys16Ws16 3276.800 AirMassPerCyl -3276.800 0.00 EXTENDED_LIMITS -3276.800 3276.700
 /begin AXIS_DESCR STD_AXIS Epm_nEng EngN 6 0.00 8000.000 EXTENDED_LIMITS -16384.00 16383.50 DEPOSIT ABSOLUTE /end AXIS_DESCR
 /begin AXIS_DESCR STD_AXIS AirCtl_qMon InjMass 6 0.00 200.0000 EXTENDED_LIMITS -327.6800 327.6700 DEPOSIT ABSOLUTE /end AXIS_DESCR
/end CHARACTERISTIC
/begin CHARACTERISTIC AirCtl_mMinLPDvt_MAP "" MAP 0x80037802 Map_Xs16Ys16Ws16 200.0000 AirMassPerCyl -200.0000 0.00 EXTENDED_LIMITS -3276.800 3276.700
 /begin AXIS_DESCR STD_AXIS Epm_nEng EngN 6 0.00 10000.00 EXTENDED_LIMITS -16384.00 16383.50 DEPOSIT ABSOLUTE /end AXIS_DESCR
 /begin AXIS_DESCR STD_AXIS AirCtl_qMon InjMass 6 0.00 200.0000 EXTENDED_LIMITS -327.6800 327.6700 DEPOSIT ABSOLUTE /end AXIS_DESCR
/end CHARACTERISTIC
/begin CHARACTERISTIC AirCtl_mPil2CorBas_C "" VALUE 0x80034866 Kw_Ws16 3000.000 AirMassPerCyl -1500.000 1500.000 EXTENDED_LIMITS -3276.800 3276.700 /end CHARACTERISTIC
/begin CHARACTERISTIC AirCtl_mPil2CorEOM_C "" VALUE 0x80034868 Kw_Ws16 3000.000 AirMassPerCyl -1500.000 1500.000 EXTENDED_LIMITS -3276.800 3276.700 /end CHARACTERISTIC
/begin CHARACTERISTIC AirCtl_mskDesLPGear_C "" VALUE 0x80035B0C Kw_Wu8 255.0 OneToOne 0.00 255.0 /end CHARACTERISTIC
/begin CHARACTERISTIC AirCtl_mskGear_C "" VALUE 0x8003486A Kw_Ws8 255.0 OneToOne -128.0 127.0 /end CHARACTERISTIC
/begin CHARACTERISTIC AirCtl_mskGovMin_C "" VALUE 0x80036360 Val_Wu8 255.0 OneToOne 0.00 255.0 /end CHARACTERISTIC
/begin CHARACTERISTIC AirCtl_mskStGovDyn1_C "" VALUE 0x80036361 Val_Wu8 255.0 OneToOne 0.00 255.0 /end CHARACTERISTIC
/begin CHARACTERISTIC AirCtl_mskStGovDyn2_C "" VALUE 0x80036362 Val_Wu8 255.0 OneToOne 0.00 255.0 /end CHARACTERISTIC
/begin CHARACTERISTIC AirCtl_mTrmEOM_MAP "" MAP 0x8003486C Kf_Xs16_Ys16_Ws16 202.0000 AirMassPerCyl -101.0000 101.0000 EXTENDED_LIMITS -3276.800 3276.700
 /begin AXIS_DESCR STD_AXIS Epm_nEng EngN 16 0.00 6000.000 EXTENDED_LIMITS -16384.00 16383.50 DEPOSIT ABSOLUTE /end AXIS_DESCR
 /begin AXIS_DESCR STD_AXIS AirCtl_qDesVal InjMass 16 0.00 327.6700 EXTENDED_LIMITS -327.6800 327.6700 DEPOSIT ABSOLUTE /end AXIS_DESCR
/end CHARACTERISTIC
/begin CHARACTERISTIC AirCtl_mTrmVal_MAP "" MAP 0x80034AB0 Kf_Xs16_Ys16_Ws16 3000.000 AirMassPerCyl -1500.000 1500.000 EXTENDED_LIMITS -3276.800 3276.700
 /begin AXIS_DESCR STD_AXIS Epm_nEng EngN 16 0.00 10000.00 EXTENDED_LIMITS -16384.00 16383.50 DEPOSIT ABSOLUTE /end AXIS_DESCR
 /begin AXIS_DESCR STD_AXIS AirCtl_qDesVal InjMass 16 0.00 327.6700 EXTENDED_LIMITS -327.6800 327.6700 DEPOSIT ABSOLUTE /end AXIS_DESCR
/end CHARACTERISTIC
/begin CHARACTERISTIC AirCtl_nHealHi_C "" VALUE 0x80037432 Val_Ws16 8000.000 EngN1 0.00 8000.000 FORMAT "%8.3" EXTENDED_LIMITS -16384.00 16383.50 /end CHARACTERISTIC
/begin CHARACTERISTIC AirCtl_nHealLo_C "" VALUE 0x80037434 Val_Ws16 8000.000 EngN1 0.00 8000.000 FORMAT "%8.3" EXTENDED_LIMITS -16384.00 16383.50 /end CHARACTERISTIC
/begin CHARACTERISTIC AirCtl_nHealLPHi_C "" VALUE 0x80037866 Val_Ws16 10000.00 EngN1 0.00 10000.00 FORMAT "%8.2" EXTENDED_LIMITS -16384.00 16383.50 /end CHARACTERISTIC
/begin CHARACTERISTIC AirCtl_nHealLPLo_C "" VALUE 0x80037868 Val_Ws16 10000.00 EngN1 0.00 10000.00 FORMAT "%8.2" EXTENDED_LIMITS -16384.00 16383.50 /end CHARACTERISTIC
/begin CHARACTERISTIC AirCtl_nLiEGRLPCor_C "" VALUE 0x80035B0E Kw_Ws16 6000.000 EngN 0.00 6000.000 EXTENDED_LIMITS -16384.00 16383.50 /end CHARACTERISTIC
/begin CHARACTERISTIC AirCtl_nLiEGR_C "" VALUE 0x80034CF4 Kw_Ws16 6000.000 EngN 0.00 6000.000 EXTENDED_LIMITS -16384.00 16383.50 /end CHARACTERISTIC
/begin CHARACTERISTIC AirCtl_nLoIdl_C "" VALUE 0x80037436 Val_Ws16 8000.000 EngN1 0.00 8000.000 FORMAT "%8.3" EXTENDED_LIMITS -16384.00 16383.50 /end CHARACTERISTIC
/begin CHARACTERISTIC AirCtl_nLPLoIdl_C "" VALUE 0x8003786A Val_Ws16 10000.00 EngN1 0.00 10000.00 FORMAT "%8.2" EXTENDED_LIMITS -16384.00 16383.50 /end CHARACTERISTIC
/begin CHARACTERISTIC AirCtl_nLPOvrRun_C "" VALUE 0x8003786C Val_Ws16 10000.00 EngN1 0.00 10000.00 FORMAT "%8.2" EXTENDED_LIMITS -16384.00 16383.50 /end CHARACTERISTIC
/begin CHARACTERISTIC AirCtl_nOvrRun_C "" VALUE 0x80037438 Val_Ws16 8000.000 EngN1 0.00 8000.000 FORMAT "%8.3" EXTENDED_LIMITS -16384.00 16383.50 /end CHARACTERISTIC
/begin CHARACTERISTIC AirCtl_numAirTempDesValLP_C "" VALUE 0x80035B10 Kw_Wu8 3.00000000000 AirTempFldSel 0.00 3.00000000000 FORMAT "%13.11" /end CHARACTERISTIC
/begin CHARACTERISTIC AirCtl_numAirTempDesVal_C "" VALUE 0x80034CF6 Kw_Wu8 3.00000000000 AirTempFldSel 0.00 3.00000000000 FORMAT "%13.11" /end CHARACTERISTIC
/begin CHARACTERISTIC AirCtl_numAirTempGovLP_C "" VALUE 0x80036E70 Val_Wu8 3.00000000000 AirTempFldSel 0.00 3.00000000000 FORMAT "%13.11" /end CHARACTERISTIC
/begin CHARACTERISTIC AirCtl_numAirTempGov_C "" VALUE 0x80036363 Val_Wu8 3.00000000000 AirTempFldSel 0.00 3.00000000000 FORMAT "%13.11" /end CHARACTERISTIC
/begin CHARACTERISTIC AirCtl_numAirTempMonLP_C "" VALUE 0x8003786E Val_Wu8 3.00000000000 AirTempFldSel 0.00 3.00000000000 FORMAT "%13.11" /end CHARACTERISTIC
/begin CHARACTERISTIC AirCtl_numAirTempMon_C "" VALUE 0x8003743A Val_Wu8 2.00000000000 AirTempFldSel 0.00 2.00000000000 FORMAT "%13.11" EXTENDED_LIMITS 0.00 3.00000000000 /end CHARACTERISTIC
/begin CHARACTERISTIC AirCtl_numEngTempDesValLP_C "" VALUE 0x80035B11 Kw_Wu8 3.00000000000 EngTempFldSel 0.00 3.00000000000 FORMAT "%13.11" /end CHARACTERISTIC
/begin CHARACTERISTIC AirCtl_numEngTempDesVal_C "" VALUE 0x80034CF7 Kw_Wu8 3.00000000000 EngTempFldSel 0.00 3.00000000000 FORMAT "%13.11" /end CHARACTERISTIC
/begin CHARACTERISTIC AirCtl_numEngTempMonLP_C "" VALUE 0x8003786F Val_Wu8 3.00000000000 EngTempFldSel 0.00 3.00000000000 FORMAT "%13.11" /end CHARACTERISTIC
/begin CHARACTERISTIC AirCtl_numEngTempMon_C "" VALUE 0x8003743B Val_Wu8 2.00000000000 EngTempFldSel 0.00 2.00000000000 FORMAT "%13.11" EXTENDED_LIMITS 0.00 3.00000000000 /end CHARACTERISTIC
/begin CHARACTERISTIC AirCtl_OvrRun_C "" VALUE 0x8003743C Val_Ws16 327.6700 InjMass 0.00 327.6700 EXTENDED_LIMITS -327.6800 327.6700 /end CHARACTERISTIC
/begin CHARACTERISTIC AirCtl_P.Kp_C "/" VALUE 0x80036364 Kw_Ws32 10.0000016391 Kp_Ampc2Prc 0.00 10.0000016391 FORMAT "%13.10" EXTENDED_LIMITS -8000.00000000 7999.99999627 /end CHARACTERISTIC
/begin CHARACTERISTIC AirCtl_P.KpPos_C "/" VALUE 0x80036368 Kw_Ws32 10.0000016391 Kp_Ampc2Prc 0.00 10.0000016391 FORMAT "%13.10" EXTENDED_LIMITS -8000.00000000 7999.99999627 /end CHARACTERISTIC
/begin CHARACTERISTIC AirCtl_P.KpNeg_C "/" VALUE 0x8003636C Kw_Ws32 10.0000016391 Kp_Ampc2Prc 0.00 10.0000016391 FORMAT "%13.10" EXTENDED_LIMITS -8000.00000000 7999.99999627 /end CHARACTERISTIC
/begin CHARACTERISTIC AirCtl_P.WinPos_C "/" VALUE 0x80036370 Kw_Ws32 1500.00000000 AirMassPerCyl 0.00 1500.00000000 EXTENDED_LIMITS -214748364.800 214748364.700 /end CHARACTERISTIC
/begin CHARACTERISTIC AirCtl_P.WinNeg_C "/" VALUE 0x80036374 Kw_Ws32 1500.00000000 AirMassPerCyl -1500.00000000 0.00 EXTENDED_LIMITS -214748364.800 214748364.700 /end CHARACTERISTIC
/begin CHARACTERISTIC AirCtl_pAirHiLP_C "" VALUE 0x80037870 Val_Ws16 2800.000 Pres_hPa 700.0000 3500.000 EXTENDED_LIMITS -32768.00 32767.00 /end CHARACTERISTIC
/begin CHARACTERISTIC AirCtl_pAirHi_C "" VALUE 0x8003743E Val_Ws16 36268.00 Pres_hPa -32768.00 3500.00 EXTENDED_LIMITS -32768.00 32767.00 /end CHARACTERISTIC
/begin CHARACTERISTIC AirCtl_pAirLoLP_C "" VALUE 0x80037872 Val_Ws16 2800.000 Pres_hPa 700.0000 3500.000 EXTENDED_LIMITS -32768.00 32767.00 /end CHARACTERISTIC
/begin CHARACTERISTIC AirCtl_pAirLo_C "" VALUE 0x80037440 Val_Ws16 36268.00 Pres_hPa -32768.00 3500.00 EXTENDED_LIMITS -32768.00 32767.00 /end CHARACTERISTIC
/begin CHARACTERISTIC AirCtl_ParAdDT1.T1_C "/" VALUE 0x80034CF8 Kw_Ws32 4294.9672940 TimeDelay_s 0.000002000000001 4294.9672960 FORMAT "%12.7" /end CHARACTERISTIC
/begin CHARACTERISTIC AirCtl_ParAdDT1.Kd_C "/" VALUE 0x80034CFC Kw_Ws32 65535.9999847 Kd -32768.0000000 32767.9999847 FORMAT "%13.7" /end CHARACTERISTIC
/begin CHARACTERISTIC AirCtl_ParAdLPDT1.T1_C "/" VALUE 0x80035B14 Kw_Ws32 4294.9672940 TimeDelay_s 0.000002000000001 4294.9672960 FORMAT "%12.7" /end CHARACTERISTIC
/begin CHARACTERISTIC AirCtl_ParAdLPDT1.Kd_C "/" VALUE 0x80035B18 Kw_Ws32 65535.9999847 Kd -32768.0000000 32767.9999847 FORMAT "%13.7" /end CHARACTERISTIC
/begin CHARACTERISTIC AirCtl_pBstPresLPRef_MAP "" MAP 0x80035B1C Kf_Xs16_Ys16_Ws16 3500.000 Pres_hPa 0.00 3500.000 EXTENDED_LIMITS -32768.00 32767.00
 /begin AXIS_DESCR STD_AXIS Epm_nEng EngN 4 0.00 10000.00 EXTENDED_LIMITS -16384.00 16383.50 DEPOSIT ABSOLUTE /end AXIS_DESCR
 /begin AXIS_DESCR STD_AXIS AirCtl_qDesVal InjMass 4 0.00 327.6700 EXTENDED_LIMITS -327.6800 327.6700 DEPOSIT ABSOLUTE /end AXIS_DESCR
/end CHARACTERISTIC
/begin CHARACTERISTIC AirCtl_pBstPresRef_MAP "" MAP 0x80034D00 Kf_Xs16_Ys16_Ws16 3500.000 Pres_hPa 0.00 3500.000 EXTENDED_LIMITS -32768.00 32767.00
 /begin AXIS_DESCR STD_AXIS Epm_nEng EngN 2 0.00 10000.00 EXTENDED_LIMITS -16384.00 16383.50 DEPOSIT ABSOLUTE /end AXIS_DESCR
 /begin AXIS_DESCR STD_AXIS AirCtl_qDesVal_mp InjMass 2 0.00 327.6700 EXTENDED_LIMITS -327.6800 327.6700 DEPOSIT ABSOLUTE /end AXIS_DESCR
/end CHARACTERISTIC
/begin CHARACTERISTIC AirCtl_PPGovOff.Kp_C "/" VALUE 0x80036378 Kw_Ws32 10.0000016391 Kp_Ampc2Prc 0.00 10.0000016391 FORMAT "%13.10" EXTENDED_LIMITS -8000.00000000 7999.99999627 /end CHARACTERISTIC
/begin CHARACTERISTIC AirCtl_PPGovOff.KpPos_C "/" VALUE 0x8003637C Kw_Ws32 10.0000016391 Kp_Ampc2Prc 0.00 10.0000016391 FORMAT "%13.10" EXTENDED_LIMITS -8000.00000000 7999.99999627 /end CHARACTERISTIC
/begin CHARACTERISTIC AirCtl_PPGovOff.KpNeg_C "/" VALUE 0x80036380 Kw_Ws32 10.0000016391 Kp_Ampc2Prc 0.00 10.0000016391 FORMAT "%13.10" EXTENDED_LIMITS -8000.00000000 7999.99999627 /end CHARACTERISTIC
/begin CHARACTERISTIC AirCtl_PPGovOff.WinPos_C "/" VALUE 0x80036384 Kw_Ws32 1500.00000000 AirMassPerCyl 0.00 1500.00000000 EXTENDED_LIMITS -214748364.800 214748364.700 /end CHARACTERISTIC
/begin CHARACTERISTIC AirCtl_PPGovOff.WinNeg_C "/" VALUE 0x80036388 Kw_Ws32 1500.00000000 AirMassPerCyl -1500.00000000 0.00 EXTENDED_LIMITS -214748364.800 214748364.700 /end CHARACTERISTIC
/begin CHARACTERISTIC AirCtl_pTVACtlOffEnvP_C "" VALUE 0x8003638C Val_Ws16 3500.000 Pres_hPa 0.00 3500.000 EXTENDED_LIMITS -32768.00 32767.00 /end CHARACTERISTIC
/begin CHARACTERISTIC AirCtl_qHealHi_C "" VALUE 0x80037442 Val_Ws16 200.0000 InjMass 0.00 200.0000 EXTENDED_LIMITS -327.6800 327.6700 /end CHARACTERISTIC
/begin CHARACTERISTIC AirCtl_qHealLo_C "" VALUE 0x80037444 Val_Ws16 200.0000 InjMass 0.00 200.0000 EXTENDED_LIMITS -327.6800 327.6700 /end CHARACTERISTIC
/begin CHARACTERISTIC AirCtl_qHealLPHi_C "" VALUE 0x80037874 Val_Ws16 100.0000 InjMass 0.00 100.0000 EXTENDED_LIMITS -327.6800 327.6700 /end CHARACTERISTIC
/begin CHARACTERISTIC AirCtl_qHealLPLo_C "" VALUE 0x80037876 Val_Ws16 100.0000 InjMass 0.00 100.0000 EXTENDED_LIMITS -327.6800 327.6700 /end CHARACTERISTIC
/begin CHARACTERISTIC AirCtl_qHiEOM_CUR "" CURVE 0x80037446 Kl_Xs16_Ws16 200.0000 InjMass 0.00 200.0000 EXTENDED_LIMITS -327.6800 327.6700
 /begin AXIS_DESCR STD_AXIS Epm_nEng EngN 16 0.00 10000.00 EXTENDED_LIMITS -16384.00 16383.50 DEPOSIT ABSOLUTE /end AXIS_DESCR
/end CHARACTERISTIC
/begin CHARACTERISTIC AirCtl_qHi_CUR "" CURVE 0x80037488 Kl_Xs16_Ws16 200.0000 InjMass 0.00 200.0000 EXTENDED_LIMITS -327.6800 327.6700
 /begin AXIS_DESCR STD_AXIS Epm_nEng EngN 16 0.00 10000.00 EXTENDED_LIMITS -16384.00 16383.50 DEPOSIT ABSOLUTE /end AXIS_DESCR
/end CHARACTERISTIC
/begin CHARACTERISTIC AirCtl_qHPMixOff_CUR "" CURVE 0x80036FC8 Cur_Xs16Ws16 100.0000 InjMass 0.00 100.0000 EXTENDED_LIMITS -327.6800 327.6700
 /begin AXIS_DESCR STD_AXIS Epm_nEng EngN 8 -16384.00 16383.50 DEPOSIT ABSOLUTE /end AXIS_DESCR
/end CHARACTERISTIC
/begin CHARACTERISTIC AirCtl_qHPMixOn_CUR "" CURVE 0x80036FEA Cur_Xs16Ws16 100.0000 InjMass 0.00 100.0000 EXTENDED_LIMITS -327.6800 327.6700
 /begin AXIS_DESCR STD_AXIS Epm_nEng EngN 8 -16384.00 16383.50 DEPOSIT ABSOLUTE /end AXIS_DESCR
/end CHARACTERISTIC
/begin CHARACTERISTIC AirCtl_qLoEOM_CUR "" CURVE 0x800374CA Kl_Xs16_Ws16 200.0000 InjMass 0.00 200.0000 EXTENDED_LIMITS -327.6800 327.6700
 /begin AXIS_DESCR STD_AXIS Epm_nEng EngN 16 0.00 10000.00 EXTENDED_LIMITS -16384.00 16383.50 DEPOSIT ABSOLUTE /end AXIS_DESCR
/end CHARACTERISTIC
/begin CHARACTERISTIC AirCtl_qLo_CUR "" CURVE 0x8003750C Kl_Xs16_Ws16 200.0000 InjMass 0.00 200.0000 EXTENDED_LIMITS -327.6800 327.6700
 /begin AXIS_DESCR STD_AXIS Epm_nEng EngN 16 0.00 10000.00 EXTENDED_LIMITS -16384.00 16383.50 DEPOSIT ABSOLUTE /end AXIS_DESCR
/end CHARACTERISTIC
/begin CHARACTERISTIC AirCtl_qLPHi_CUR "" CURVE 0x80037878 Cur_Xs16Ws16 100.0000 InjMass 0.00 100.0000 EXTENDED_LIMITS -327.6800 327.6700
 /begin AXIS_DESCR STD_AXIS Epm_nEng EngN 12 0.00 10000.00 EXTENDED_LIMITS -16384.00 16383.50 DEPOSIT ABSOLUTE /end AXIS_DESCR
/end CHARACTERISTIC
/begin CHARACTERISTIC AirCtl_qLPLo_CUR "" CURVE 0x800378AA Cur_Xs16Ws16 100.0000 InjMass 0.00 100.0000 EXTENDED_LIMITS -327.6800 327.6700
 /begin AXIS_DESCR STD_AXIS Epm_nEng EngN 12 0.00 10000.00 EXTENDED_LIMITS -16384.00 16383.50 DEPOSIT ABSOLUTE /end AXIS_DESCR
/end CHARACTERISTIC
/begin CHARACTERISTIC AirCtl_qLPOvrRun_C "" VALUE 0x800378DC Val_Ws16 10.00000 InjMass 0.00 10.00000 EXTENDED_LIMITS -327.6800 327.6700 /end CHARACTERISTIC
/begin CHARACTERISTIC AirCtl_qSurgeHigh_CUR "" CURVE 0x8003754E Kl_Xs16_Ws16 100.0000 InjMass 0.00 100.0000 EXTENDED_LIMITS -327.6800 327.6700
 /begin AXIS_DESCR STD_AXIS Epm_nEng EngN 2 0.00 6000.000 EXTENDED_LIMITS -16384.00 16383.50 DEPOSIT ABSOLUTE /end AXIS_DESCR
/end CHARACTERISTIC
/begin CHARACTERISTIC AirCtl_qSurgeLow_CUR "" CURVE 0x80037558 Kl_Xs16_Ws16 100.0000 InjMass 0.00 100.0000 EXTENDED_LIMITS -327.6800 327.6700
 /begin AXIS_DESCR STD_AXIS Epm_nEng EngN 2 0.00 6000.000 EXTENDED_LIMITS -16384.00 16383.50 DEPOSIT ABSOLUTE /end AXIS_DESCR
/end CHARACTERISTIC
/begin CHARACTERISTIC AirCtl_rBrkDelta_C "" VALUE 0x80037562 Val_Ws16 100.0000 Prc 0.00 100.0000 EXTENDED_LIMITS -400.0000 399.9878 /end CHARACTERISTIC
/begin CHARACTERISTIC AirCtl_rBrkXHigh_C "" VALUE 0x80037564 Val_Ws16 100.0000 Prc 0.00 100.0000 EXTENDED_LIMITS -400.0000 399.9878 /end CHARACTERISTIC
/begin CHARACTERISTIC AirCtl_rBrkXLow_C "" VALUE 0x80037566 Val_Ws16 100.0000 Prc 0.00 100.0000 EXTENDED_LIMITS -400.0000 399.9878 /end CHARACTERISTIC
/begin CHARACTERISTIC AirCtl_rCtlValLPNrm_MAP "" MAP 0x80036E72 Map_Xs16Ys16Ws16 159.9976 Prc -9.997559 150.0000 EXTENDED_LIMITS -400.0000 399.9878
 /begin AXIS_DESCR STD_AXIS Epm_nEng EngN 4 -16384.00 16383.50 DEPOSIT ABSOLUTE /end AXIS_DESCR
 /begin AXIS_DESCR STD_AXIS AirCtl_qGov InjMass 4 -327.6800 327.6700 DEPOSIT ABSOLUTE /end AXIS_DESCR
/end CHARACTERISTIC
/begin CHARACTERISTIC AirCtl_rDflValEOM_CA "" VAL_BLK 0x8003638E ValA_Ws16 100.0000 Prc 0.00 100.0000 EXTENDED_LIMITS -400.0000 399.9878 NUMBER 31 /end CHARACTERISTIC
/begin CHARACTERISTIC AirCtl_rDflVal_CA "" VAL_BLK 0x800363CC ValA_Ws16 799.9878 Prc -400.0000 399.9878 NUMBER 31 /end CHARACTERISTIC
/begin CHARACTERISTIC AirCtl_rDiffDynMin_CUR "" CURVE 0x8003640A Cur_Xs16Ws16 100.0000 Prc 0.00 100.0000 EXTENDED_LIMITS -400.0000 399.9878
 /begin AXIS_DESCR STD_AXIS Epm_nEng EngN 6 0.00 6000.000 EXTENDED_LIMITS -16384.00 16383.50 DEPOSIT ABSOLUTE /end AXIS_DESCR
/end CHARACTERISTIC
/begin CHARACTERISTIC AirCtl_rDynEnd_C "" VALUE 0x80036424 Val_Ws16 200.0000 Prc -100.0000 100.0000 EXTENDED_LIMITS -400.0000 399.9878 /end CHARACTERISTIC
/begin CHARACTERISTIC AirCtl_rDynMinEOM1_MAP "" MAP 0x80036426 Map_Xs16Ys16Ws16 300.0000 Prc -100.0000 200.0000 EXTENDED_LIMITS -400.0000 399.9878
 /begin AXIS_DESCR STD_AXIS Epm_nEng EngN 2 0.00 6000.000 EXTENDED_LIMITS -16384.00 16383.50 DEPOSIT ABSOLUTE /end AXIS_DESCR
 /begin AXIS_DESCR STD_AXIS InjCtl_qRaw InjMass 2 0.00 327.6700 EXTENDED_LIMITS -327.6800 327.6700 DEPOSIT ABSOLUTE /end AXIS_DESCR
/end CHARACTERISTIC
/begin CHARACTERISTIC AirCtl_rDynMin_MAP "" MAP 0x8003643A Map_Xs16Ys16Ws16 300.0000 Prc -100.0000 200.0000 EXTENDED_LIMITS -400.0000 399.9878
 /begin AXIS_DESCR STD_AXIS Epm_nEng EngN 2 0.00 6000.000 EXTENDED_LIMITS -16384.00 16383.50 DEPOSIT ABSOLUTE /end AXIS_DESCR
 /begin AXIS_DESCR STD_AXIS TCPrt_rPresRat Prc 2 0.00 6000.000 EXTENDED_LIMITS -400.0000 399.9878 DEPOSIT ABSOLUTE /end AXIS_DESCR
/end CHARACTERISTIC
/begin CHARACTERISTIC AirCtl_rDynStart_C "" VALUE 0x8003644E Val_Ws16 200.0000 Prc -100.0000 100.0000 EXTENDED_LIMITS -400.0000 399.9878 /end CHARACTERISTIC
/begin CHARACTERISTIC AirCtl_rEGRClgOn_C "" VALUE 0x80034D14 Val_Ws16 100.0000 Prc 0.00 100.0000 EXTENDED_LIMITS -400.0000 399.9878 /end CHARACTERISTIC
/begin CHARACTERISTIC AirCtl_rEGRCorAltEOMErr_C "" VALUE 0x80036450 Val_Ws16 200.0000 Prc -100.0000 100.0000 EXTENDED_LIMITS -400.0000 399.9878 /end CHARACTERISTIC
/begin CHARACTERISTIC AirCtl_rEGRCorAltEOMQnt1_MAP "" MAP 0x80036452 Map_Xs16Ys16Ws16 200.0000 Prc -100.0000 100.0000 EXTENDED_LIMITS -400.0000 399.9878
 /begin AXIS_DESCR STD_AXIS Epm_nEng EngN 6 0.00 6000.000 EXTENDED_LIMITS -16384.00 16383.50 DEPOSIT ABSOLUTE /end AXIS_DESCR
 /begin AXIS_DESCR STD_AXIS AirCtl_qGov InjMass 6 -327.6800 327.6700 DEPOSIT ABSOLUTE /end AXIS_DESCR
/end CHARACTERISTIC
/begin CHARACTERISTIC AirCtl_rEGRCorAltEOMQnt2_MAP "" MAP 0x800364B6 Map_Xs16Ys16Ws16 200.0000 Prc -100.0000 100.0000 EXTENDED_LIMITS -400.0000 399.9878
 /begin AXIS_DESCR STD_AXIS Epm_nEng EngN 6 0.00 6000.000 EXTENDED_LIMITS -16384.00 16383.50 DEPOSIT ABSOLUTE /end AXIS_DESCR
 /begin AXIS_DESCR STD_AXIS AirCtl_qGov InjMass 6 0.00 327.6700 EXTENDED_LIMITS -327.6800 327.6700 DEPOSIT ABSOLUTE /end AXIS_DESCR
/end CHARACTERISTIC
/begin CHARACTERISTIC AirCtl_rEGRDflVal_CA "" VAL_BLK 0x80037568 ValA_Ws16 799.9878 Prc -400.0000 399.9878 NUMBER 31 /end CHARACTERISTIC
/begin CHARACTERISTIC AirCtl_rEGREOMQnt2_MAP "" MAP 0x8003651A Map_Xs16Ys16Ws16 300.0000 Prc -100.0000 200.0000 EXTENDED_LIMITS -400.0000 399.9878
 /begin AXIS_DESCR STD_AXIS Epm_nEng EngN 12 0.00 10000.00 EXTENDED_LIMITS -16384.00 16383.50 DEPOSIT ABSOLUTE /end AXIS_DESCR
 /begin AXIS_DESCR STD_AXIS AirCtl_qGov InjMass 10 0.00 327.6700 EXTENDED_LIMITS -327.6800 327.6700 DEPOSIT ABSOLUTE /end AXIS_DESCR
/end CHARACTERISTIC
/begin CHARACTERISTIC AirCtl_rEGREOM_MAP "" MAP 0x8003663A Kf_Xs16_Ys16_Ws16 300.0000 Prc -100.0000 200.0000 EXTENDED_LIMITS -400.0000 399.9878
 /begin AXIS_DESCR STD_AXIS Epm_nEng EngN 12 0.00 10000.00 EXTENDED_LIMITS -16384.00 16383.50 DEPOSIT ABSOLUTE /end AXIS_DESCR
 /begin AXIS_DESCR STD_AXIS AirCtl_qGov_mp InjMass 10 0.00 327.6700 EXTENDED_LIMITS -327.6800 327.6700 DEPOSIT ABSOLUTE /end AXIS_DESCR
/end CHARACTERISTIC
/begin CHARACTERISTIC AirCtl_rEGRInvModMax_C "" VALUE 0x8003700C Val_Ws16 50.00000 Prc 50.00000 100.0000 EXTENDED_LIMITS -400.0000 399.9878 /end CHARACTERISTIC
/begin CHARACTERISTIC AirCtl_rEGRInvModMin_C "" VALUE 0x8003700E Val_Ws16 50.00000 Prc 0.00 50.00000 EXTENDED_LIMITS -400.0000 399.9878 /end CHARACTERISTIC
/begin CHARACTERISTIC AirCtl_rEGRInv_MAP "" MAP 0x8003675A Kf_Xs16_Ys16_Ws16 300.0000 Prc -100.0000 200.0000 EXTENDED_LIMITS -400.0000 399.9878
 /begin AXIS_DESCR STD_AXIS ASMod_rPresEGRDiff Fact 6 0.00 10000.00 EXTENDED_LIMITS -4.000000 3.999878 DEPOSIT ABSOLUTE /end AXIS_DESCR
 /begin AXIS_DESCR STD_AXIS AirCtl_rGovEGR_mp Prc 11 -100.0000 200.0000 EXTENDED_LIMITS -400.0000 399.9878 DEPOSIT ABSOLUTE /end AXIS_DESCR
/end CHARACTERISTIC
/begin CHARACTERISTIC AirCtl_rEGRLP_MAP "" MAP 0x80036EA6 Map_Xs16Ys16Ws16 300.0000 Prc -100.0000 200.0000 EXTENDED_LIMITS -400.0000 399.9878
 /begin AXIS_DESCR STD_AXIS Epm_nEng EngN 8 -16384.00 16383.50 DEPOSIT ABSOLUTE /end AXIS_DESCR
 /begin AXIS_DESCR STD_AXIS AirCtl_rGovOutLP_mp Prc 8 -400.0000 399.9878 DEPOSIT ABSOLUTE /end AXIS_DESCR
/end CHARACTERISTIC
/begin CHARACTERISTIC AirCtl_rEGRMax_C "" VALUE 0x80036804 Kw_Ws16 100.0000 Prc 0.00 100.0000 EXTENDED_LIMITS -400.0000 399.9878 /end CHARACTERISTIC
/begin CHARACTERISTIC AirCtl_rEGRMin_C "" VALUE 0x80036806 Kw_Ws16 100.0000 Prc 0.00 100.0000 EXTENDED_LIMITS -400.0000 399.9878 /end CHARACTERISTIC
/begin CHARACTERISTIC AirCtl_rEGR_MAP "" MAP 0x80036808 Map_Xs16Ys16Ws16 300.0000 Prc -100.0000 200.0000 EXTENDED_LIMITS -400.0000 399.9878
 /begin AXIS_DESCR STD_AXIS ASMod_rPresEGRDiff Fact 6 -2000.000 2000.000 EXTENDED_LIMITS -4.000000 3.999878 DEPOSIT ABSOLUTE /end AXIS_DESCR
 /begin AXIS_DESCR STD_AXIS AirCtl_rGovOut_mp Prc 11 -100.0000 200.0000 EXTENDED_LIMITS -400.0000 399.9878 DEPOSIT ABSOLUTE /end AXIS_DESCR
/end CHARACTERISTIC
/begin CHARACTERISTIC AirCtl_rGovBgnNrmEOM_C "" VALUE 0x800368B2 Kw_Ws16 100.0000 Prc 0.00 100.0000 EXTENDED_LIMITS -400.0000 399.9878 /end CHARACTERISTIC
/begin CHARACTERISTIC AirCtl_rGovDynMinEOM1_CUR "" CURVE 0x800368B4 Cur_Xs16Ws16 100.0000 Prc 0.00 100.0000 EXTENDED_LIMITS -400.0000 399.9878
 /begin AXIS_DESCR STD_AXIS AirCtl_rPCRCtl_mp Prc 2 0.00 100.0000 EXTENDED_LIMITS -400.0000 399.9878 DEPOSIT ABSOLUTE /end AXIS_DESCR
/end CHARACTERISTIC
/begin CHARACTERISTIC AirCtl_rGovDynMin_CUR "" CURVE 0x800368BE Cur_Xs16Ws16 100.0000 Prc 0.00 100.0000 EXTENDED_LIMITS -400.0000 399.9878
 /begin AXIS_DESCR STD_AXIS AirCtl_rPCRCtl_mp Prc 2 0.00 100.0000 EXTENDED_LIMITS -400.0000 399.9878 DEPOSIT ABSOLUTE /end AXIS_DESCR
/end CHARACTERISTIC
/begin CHARACTERISTIC AirCtl_rGovLPMax_C "" VALUE 0x80036F4A Val_Ws16 300.0000 Prc -100.0000 200.0000 EXTENDED_LIMITS -400.0000 399.9878 /end CHARACTERISTIC
/begin CHARACTERISTIC AirCtl_rGovLPMin_MAP "" MAP 0x80036F4C Map_Xs16Ys16Ws16 119.9951 Prc -19.99512 100.0000 EXTENDED_LIMITS -400.0000 399.9878
 /begin AXIS_DESCR STD_AXIS Epm_nEng EngN 5 -16384.00 16383.50 DEPOSIT ABSOLUTE /end AXIS_DESCR
 /begin AXIS_DESCR STD_AXIS AirCtl_qGov InjMass 5 -327.6800 327.6700 DEPOSIT ABSOLUTE /end AXIS_DESCR
/end CHARACTERISTIC
/begin CHARACTERISTIC AirCtl_rGovMax_C "" VALUE 0x800368C8 Val_Ws16 300.0000 Prc -100.0000 200.0000 EXTENDED_LIMITS -400.0000 399.9878 /end CHARACTERISTIC
/begin CHARACTERISTIC AirCtl_rGovMin_C "" VALUE 0x800368CA Val_Ws16 300.0000 Prc -100.0000 200.0000 EXTENDED_LIMITS -400.0000 399.9878 /end CHARACTERISTIC
/begin CHARACTERISTIC AirCtl_rGovThresBgnNrm_C "" VALUE 0x800368CC Kw_Ws16 100.0000 Prc 0.00 100.0000 EXTENDED_LIMITS -400.0000 399.9878 /end CHARACTERISTIC
/begin CHARACTERISTIC AirCtl_rHPMixDflVal_C "" VALUE 0x80037010 Val_Ws16 100.0000 Prc 0.00 100.0000 EXTENDED_LIMITS -400.0000 399.9878 /end CHARACTERISTIC
/begin CHARACTERISTIC AirCtl_rLpEGRDflVal_CA "" VAL_BLK 0x800378DE ValA_Ws16 200.0000 Prc -100.0000 100.0000 EXTENDED_LIMITS -400.0000 399.9878 NUMBER 21 /end CHARACTERISTIC
/begin CHARACTERISTIC AirCtl_rLpIDflVal_CA "" VAL_BLK 0x80036F96 ValA_Ws16 100.0000 Prc 0.00 100.0000 EXTENDED_LIMITS -400.0000 399.9878 NUMBER 21 /end CHARACTERISTIC
/begin CHARACTERISTIC AirCtl_rPCRCorDiff_CUR "" CURVE 0x800368CE Cur_Xs16Ws16 200.0000 Prc -100.0000 100.0000 EXTENDED_LIMITS -400.0000 399.9878
 /begin AXIS_DESCR STD_AXIS AirCtl_drGovOutUnLim_mp PrcPerSec 12 0.00 100.0977 FORMAT "%8.4" EXTENDED_LIMITS -20000.00 19999.39 DEPOSIT ABSOLUTE /end AXIS_DESCR
/end CHARACTERISTIC
/begin CHARACTERISTIC AirCtl_rSurgeHigh_MAP "" MAP 0x800375A6 Kf_Xs16_Ys16_Ws16 799.9878 Prc -400.0000 399.9878
 /begin AXIS_DESCR STD_AXIS Epm_nEng EngN 6 0.00 6000.000 EXTENDED_LIMITS -16384.00 16383.50 DEPOSIT ABSOLUTE /end AXIS_DESCR
 /begin AXIS_DESCR STD_AXIS EnvP_p Pres_hPa 4 0.00 3500.000 EXTENDED_LIMITS -32768.00 32767.00 DEPOSIT ABSOLUTE /end AXIS_DESCR
/end CHARACTERISTIC
/begin CHARACTERISTIC AirCtl_rSurgeOfs_CUR "" CURVE 0x800375EE Kl_Xs16_Ws16 799.9878 Prc -400.0000 399.9878
 /begin AXIS_DESCR STD_AXIS Epm_nEng EngN 5 0.00 6000.000 EXTENDED_LIMITS -16384.00 16383.50 DEPOSIT ABSOLUTE /end AXIS_DESCR
/end CHARACTERISTIC
/begin CHARACTERISTIC AirCtl_rTVACtlATCor_MAP "" MAP 0x80036900 Map_Xs16Ys16Ws16 200.0000 Prc 0.00 200.0000 EXTENDED_LIMITS -400.0000 399.9878
 /begin AXIS_DESCR STD_AXIS Epm_nEng EngN 8 0.00 10000.00 EXTENDED_LIMITS -16384.00 16383.50 DEPOSIT ABSOLUTE /end AXIS_DESCR
 /begin AXIS_DESCR STD_AXIS InjCtl_qRaw InjMass 8 0.00 327.6700 EXTENDED_LIMITS -327.6800 327.6700 DEPOSIT ABSOLUTE /end AXIS_DESCR
/end CHARACTERISTIC
/begin CHARACTERISTIC AirCtl_rTVACtlBasOvrRunOff_C "" VALUE 0x800369A4 Val_Ws16 100.0000 Prc 0.00 100.0000 EXTENDED_LIMITS -400.0000 399.9878 /end CHARACTERISTIC
/begin CHARACTERISTIC AirCtl_rTVACtlBasOvrRun_MAP "" MAP 0x800369A6 Map_Xs16Ys16Ws16 100.0000 Prc 0.00 100.0000 EXTENDED_LIMITS -400.0000 399.9878
 /begin AXIS_DESCR STD_AXIS Epm_nEng EngN 6 0.00 10000.00 EXTENDED_LIMITS -16384.00 16383.50 DEPOSIT ABSOLUTE /end AXIS_DESCR
 /begin AXIS_DESCR STD_AXIS InjCtl_qRaw InjMass 2 0.00 327.6700 EXTENDED_LIMITS -327.6800 327.6700 DEPOSIT ABSOLUTE /end AXIS_DESCR
/end CHARACTERISTIC
/begin CHARACTERISTIC AirCtl_rTVACtlBas_MAP "" MAP 0x800369D2 Map_Xs16Ys16Ws16 200.0000 Prc 0.00 200.0000 EXTENDED_LIMITS -400.0000 399.9878
 /begin AXIS_DESCR STD_AXIS Epm_nEng EngN 10 0.00 10000.00 EXTENDED_LIMITS -16384.00 16383.50 DEPOSIT ABSOLUTE /end AXIS_DESCR
 /begin AXIS_DESCR STD_AXIS InjCtl_qRaw InjMass 10 0.00 327.6700 EXTENDED_LIMITS -327.6800 327.6700 DEPOSIT ABSOLUTE /end AXIS_DESCR
/end CHARACTERISTIC
/begin CHARACTERISTIC AirCtl_rTVACtlCTCor_MAP "" MAP 0x80036AC6 Map_Xs16Ys16Ws16 200.0000 Prc 0.00 200.0000 EXTENDED_LIMITS -400.0000 399.9878
 /begin AXIS_DESCR STD_AXIS Epm_nEng EngN 8 0.00 10000.00 EXTENDED_LIMITS -16384.00 16383.50 DEPOSIT ABSOLUTE /end AXIS_DESCR
 /begin AXIS_DESCR STD_AXIS InjCtl_qRaw InjMass 8 0.00 327.6700 EXTENDED_LIMITS -327.6800 327.6700 DEPOSIT ABSOLUTE /end AXIS_DESCR
/end CHARACTERISTIC
/begin CHARACTERISTIC AirCtl_rTVACtlEnvPCor_CUR "" CURVE 0x80036B6A Cur_Xs16Ws16 200.0000 Prc 0.00 200.0000 EXTENDED_LIMITS -400.0000 399.9878
 /begin AXIS_DESCR STD_AXIS EnvP_p Pres_hPa 6 0.00 3500.000 EXTENDED_LIMITS -32768.00 32767.00 DEPOSIT ABSOLUTE /end AXIS_DESCR
/end CHARACTERISTIC
/begin CHARACTERISTIC AirCtl_rTVADflVal_CA "" VAL_BLK 0x80037604 ValA_Ws16 799.9878 Prc -400.0000 399.9878 NUMBER 31 /end CHARACTERISTIC
/begin CHARACTERISTIC AirCtl_rTVAEOM_MAP "" MAP 0x80036B84 Kf_Xs16_Ys16_Ws16 300.0000 Prc -100.0000 200.0000 EXTENDED_LIMITS -400.0000 399.9878
 /begin AXIS_DESCR STD_AXIS Epm_nEng EngN 4 0.00 10000.00 EXTENDED_LIMITS -16384.00 16383.50 DEPOSIT ABSOLUTE /end AXIS_DESCR
 /begin AXIS_DESCR STD_AXIS AirCtl_rGovOut_mp Prc 8 -400.0000 399.9878 DEPOSIT ABSOLUTE /end AXIS_DESCR
/end CHARACTERISTIC
/begin CHARACTERISTIC AirCtl_rTVA_MAP "" MAP 0x80036BE0 Map_Xs16Ys16Ws16 300.0000 Prc -100.0000 200.0000 EXTENDED_LIMITS -400.0000 399.9878
 /begin AXIS_DESCR STD_AXIS Epm_nEng EngN 6 0.00 8000.000 EXTENDED_LIMITS -16384.00 16383.50 DEPOSIT ABSOLUTE /end AXIS_DESCR
 /begin AXIS_DESCR STD_AXIS AirCtl_rGovOut_mp Prc 11 -100.0000 200.0000 EXTENDED_LIMITS -400.0000 399.9878 DEPOSIT ABSOLUTE /end AXIS_DESCR
/end CHARACTERISTIC
/begin CHARACTERISTIC AirCtl_stBitMskEOM_CA "" VAL_BLK 0x80037644 ValA_Wu32 4294967295.00 OneToOne 0.00 4294967295.00 NUMBER 4 /end CHARACTERISTIC
/begin CHARACTERISTIC AirCtl_stCurrQntHiEOMMsk_C "" VALUE 0x80037654 Kw_Wu32 4294967295.00 OneToOne 0.00 4294967295.00 /end CHARACTERISTIC
/begin CHARACTERISTIC AirCtl_stCurrQntLoEOMMsk_C "" VALUE 0x80037658 Kw_Wu32 4294967295.00 OneToOne 0.00 4294967295.00 /end CHARACTERISTIC
/begin CHARACTERISTIC AirCtl_stCurrTrqHiEOMMsk_C "" VALUE 0x8003765C Kw_Wu32 4294967295.00 OneToOne 0.00 4294967295.00 /end CHARACTERISTIC
/begin CHARACTERISTIC AirCtl_stCurrTrqLoEOMMsk_C "" VALUE 0x80037660 Kw_Wu32 4294967295.00 OneToOne 0.00 4294967295.00 /end CHARACTERISTIC
/begin CHARACTERISTIC AirCtl_stDesValEGRHighMNrm_C "" VALUE 0x80034D18 Val_Wu32 4294967295.00 OneToOne 0.00 4294967295.00 /end CHARACTERISTIC
/begin CHARACTERISTIC AirCtl_stDesValEOMLim_C "" VALUE 0x80034D1C Kw_Wu32 4294967295.00 OneToOne 0.00 4294967295.00 /end CHARACTERISTIC
/begin CHARACTERISTIC AirCtl_stDesValEOMMsk_CA "" VAL_BLK 0x80034D20 ValA_Wu32 4294967295.00 OneToOne 0.00 4294967295.00 NUMBER 3 /end CHARACTERISTIC
/begin CHARACTERISTIC AirCtl_stGovEOMMsk2_C "" VALUE 0x80036C8C Val_Wu32 4294967295.00 OneToOne 0.00 4294967295.00 /end CHARACTERISTIC
/begin CHARACTERISTIC AirCtl_stGovEOMMsk_C "" VALUE 0x80036C90 Kw_Wu32 4294967295.00 OneToOne 0.00 4294967295.00 /end CHARACTERISTIC
/begin CHARACTERISTIC AirCtl_stLPBitMskNrm_C "" VALUE 0x80037908 Val_Wu32 4294967295.00 OneToOne 0.00 4294967295.00 /end CHARACTERISTIC
/begin CHARACTERISTIC AirCtl_stMonEOMMsk_CA "" VAL_BLK 0x80037664 ValA_Wu32 4294967295.00 OneToOne 0.00 4294967295.00 NUMBER 4 /end CHARACTERISTIC
/begin CHARACTERISTIC AirCtl_stPrioMonLP_CA "" VAL_BLK 0x8003790C ValA_Ws16 20.00000 OneToOne 0.00 20.00000 EXTENDED_LIMITS -32768.00 32767.00 NUMBER 21 /end CHARACTERISTIC
/begin CHARACTERISTIC AirCtl_stPrioMon_CA "" VAL_BLK 0x80037674 ValA_Ws16 65535.00 OneToOne -32768.00 32767.00 NUMBER 31 /end CHARACTERISTIC
/begin CHARACTERISTIC AirCtl_stShOffEOMMsk_C "" VALUE 0x800376B4 Kw_Wu32 4294967295.00 OneToOne 0.00 4294967295.00 /end CHARACTERISTIC
/begin CHARACTERISTIC AirCtl_swtAirMs_C "" VALUE 0x80036C94 Kw_Wu8 1.000 OneToOne 0.00 1.000 EXTENDED_LIMITS 0.00 255.0 /end CHARACTERISTIC
/begin CHARACTERISTIC AirCtl_swtAirUnit_C "" VALUE 0x80036C95 Val_Wu8 1.000 OneToOne 0.00 1.000 EXTENDED_LIMITS 0.00 255.0 /end CHARACTERISTIC
/begin CHARACTERISTIC AirCtl_swtBstPresCorVal_C "" VALUE 0x80034D2C Kw_Wu8 255.0 OneToOne 0.00 255.0 /end CHARACTERISTIC
/begin CHARACTERISTIC AirCtl_swtBstPresLPCorVal_C "" VALUE 0x80035B50 Kw_Wu8 1.000 OneToOne 0.00 1.000 EXTENDED_LIMITS 0.00 255.0 /end CHARACTERISTIC
/begin CHARACTERISTIC AirCtl_swtDesValFltActv_C "" VALUE 0x80034D2D Val_Wu8 1.000 OneToOne 0.00 1.000 EXTENDED_LIMITS 0.00 255.0 /end CHARACTERISTIC
/begin CHARACTERISTIC AirCtl_swtEGRLPActv_C "" VALUE 0x80035B51 Kw_Wu8 2.000 OneToOne 0.00 2.000 EXTENDED_LIMITS 0.00 255.0 /end CHARACTERISTIC
/begin CHARACTERISTIC AirCtl_swtMonOffBrkRepActv_C "" VALUE 0x800376B8 Val_Wu8 255.0 OneToOne 0.00 255.0 /end CHARACTERISTIC
/begin CHARACTERISTIC AirCtl_swtPreCtlPos_C "" VALUE 0x80036C96 Val_Wu8 1.000 OneToOne 0.00 1.000 EXTENDED_LIMITS 0.00 255.0 /end CHARACTERISTIC
/begin CHARACTERISTIC AirCtl_swtTVACtlOvrRunOff_C "" VALUE 0x80036C97 Val_Wu8 1.000 OneToOne 0.00 1.000 EXTENDED_LIMITS 0.00 255.0 /end CHARACTERISTIC
/begin CHARACTERISTIC AirCtl_swtTVACtl_C "" VALUE 0x80036C98 Val_Wu8 3.000 OneToOne 0.00 3.000 EXTENDED_LIMITS 0.00 255.0 /end CHARACTERISTIC
/begin CHARACTERISTIC AirCtl_tAirCldHiLP_C "" VALUE 0x80037936 Val_Ws16 180.0000 Temp_Cels -30.04000 149.9600 EXTENDED_LIMITS -3549.940 3003.560 /end CHARACTERISTIC
/begin CHARACTERISTIC AirCtl_tAirCldHi_C "" VALUE 0x800376BA Val_Ws16 190.0000 Temp_Cels -40.14000 149.8600 EXTENDED_LIMITS -3549.940 3003.560 /end CHARACTERISTIC
/begin CHARACTERISTIC AirCtl_tAirCldLoLP_C "" VALUE 0x80037938 Val_Ws16 180.0000 Temp_Cels -30.04000 149.9600 EXTENDED_LIMITS -3549.940 3003.560 /end CHARACTERISTIC
/begin CHARACTERISTIC AirCtl_tAirCldLo_C "" VALUE 0x800376BC Val_Ws16 240.0000 Temp_Cels -40.14000 199.8600 EXTENDED_LIMITS -3549.940 3003.560 /end CHARACTERISTIC
/begin CHARACTERISTIC AirCtl_tAirWrmHiLP_C "" VALUE 0x8003793A Val_Ws16 180.0000 Temp_Cels -30.04000 149.9600 EXTENDED_LIMITS -3549.940 3003.560 /end CHARACTERISTIC
/begin CHARACTERISTIC AirCtl_tAirWrmHi_C "" VALUE 0x800376BE Val_Ws16 240.0000 Temp_Cels -40.14000 199.8600 EXTENDED_LIMITS -3549.940 3003.560 /end CHARACTERISTIC
/begin CHARACTERISTIC AirCtl_tAirWrmLoLP_C "" VALUE 0x8003793C Val_Ws16 180.0000 Temp_Cels -30.04000 149.9600 EXTENDED_LIMITS -3549.940 3003.560 /end CHARACTERISTIC
/begin CHARACTERISTIC AirCtl_tAirWrmLo_C "" VALUE 0x800376C0 Val_Ws16 190.0000 Temp_Cels -40.14000 149.8600 EXTENDED_LIMITS -3549.940 3003.560 /end CHARACTERISTIC
/begin CHARACTERISTIC AirCtl_tClntCldHiLP_C "" VALUE 0x8003793E Val_Ws16 180.0000 Temp_Cels -30.04000 149.9600 EXTENDED_LIMITS -3549.940 3003.560 /end CHARACTERISTIC
/begin CHARACTERISTIC AirCtl_tClntCldHi_C "" VALUE 0x800376C2 Val_Ws16 190.0000 Temp_Cels -40.14000 149.8600 EXTENDED_LIMITS -3549.940 3003.560 /end CHARACTERISTIC
/begin CHARACTERISTIC AirCtl_tClntCldLoLP_C "" VALUE 0x80037940 Val_Ws16 180.0000 Temp_Cels -30.04000 149.9600 EXTENDED_LIMITS -3549.940 3003.560 /end CHARACTERISTIC
/begin CHARACTERISTIC AirCtl_tClntCldLo_C "" VALUE 0x800376C4 Val_Ws16 240.0000 Temp_Cels -40.14000 199.8600 EXTENDED_LIMITS -3549.940 3003.560 /end CHARACTERISTIC
/begin CHARACTERISTIC AirCtl_tClntWrmHiLP_C "" VALUE 0x80037942 Val_Ws16 180.0000 Temp_Cels -30.04000 149.9600 EXTENDED_LIMITS -3549.940 3003.560 /end CHARACTERISTIC
/begin CHARACTERISTIC AirCtl_tClntWrmHi_C "" VALUE 0x800376C6 Val_Ws16 240.0000 Temp_Cels -40.14000 199.8600 EXTENDED_LIMITS -3549.940 3003.560 /end CHARACTERISTIC
/begin CHARACTERISTIC AirCtl_tClntWrmLoLP_C "" VALUE 0x80037944 Val_Ws16 180.0000 Temp_Cels -30.04000 149.9600 EXTENDED_LIMITS -3549.940 3003.560 /end CHARACTERISTIC
/begin CHARACTERISTIC AirCtl_tClntWrmLo_C "" VALUE 0x800376C8 Val_Ws16 190.0000 Temp_Cels -40.14000 149.8600 EXTENDED_LIMITS -3549.940 3003.560 /end CHARACTERISTIC
/begin CHARACTERISTIC AirCtl_tiAFSPT1_MAP "" MAP 0x80036C9A Map_Xs16Ys16Ws16 3999.756 TimeDelay_ms_Lin_16 0.00 3999.756 FORMAT "%8.3" EXTENDED_LIMITS -20000.61 20000.00
 /begin AXIS_DESCR STD_AXIS Epm_nEng EngN 6 0.00 6000.000 EXTENDED_LIMITS -16384.00 16383.50 DEPOSIT ABSOLUTE /end AXIS_DESCR
 /begin AXIS_DESCR STD_AXIS AirCtl_pRelCACDs_mp Pres_hPa 6 0.00 3500.000 EXTENDED_LIMITS -32768.00 32767.00 DEPOSIT ABSOLUTE /end AXIS_DESCR
/end CHARACTERISTIC
/begin CHARACTERISTIC AirCtl_tiCldStrtLP_CUR "" CURVE 0x80037946 Cur_Xs16Ws16 33000.00 Time_ms 0.00 33000.00 EXTENDED_LIMITS -327680.0 327670.0
 /begin AXIS_DESCR STD_AXIS AirCtl_tEngMonLP_mp Temp_Cels 26 -30.04000 149.9600 EXTENDED_LIMITS -3549.940 3003.560 DEPOSIT ABSOLUTE /end AXIS_DESCR
/end CHARACTERISTIC
/begin CHARACTERISTIC AirCtl_tiCldStrt_CUR "" CURVE 0x800376CA Cur_Xs16Ws16 33000.00 Time_ms 0.00 33000.00 EXTENDED_LIMITS -327680.0 327670.0
 /begin AXIS_DESCR STD_AXIS AirCtl_tEngMon_mp Temp_Cels 8 -100.1400 199.8600 EXTENDED_LIMITS -3549.940 3003.560 DEPOSIT ABSOLUTE /end AXIS_DESCR
/end CHARACTERISTIC
/begin CHARACTERISTIC AirCtl_tiClth_C "" VALUE 0x800376EC Val_Wu16 655350.0 TimeDeb 0.00 655350.0 /end CHARACTERISTIC
/begin CHARACTERISTIC AirCtl_tiDesValFlt_C "" VALUE 0x80034D30 Val_Ws32 998.99238550 TimeDelay_ms 1.0000000689 999.99238556 FORMAT "%12.7" EXTENDED_LIMITS 0.0020000000009 4294967.2960 /end CHARACTERISTIC
/begin CHARACTERISTIC AirCtl_tiDT1EOM_C "" VALUE 0x80036D00 Kw_Wu32 4294.9662960 TimeDelay_s 0.0010000000689 4294.9672960 FORMAT "%12.7" EXTENDED_LIMITS 0.000001000000000 4294.9672960 /end CHARACTERISTIC
/begin CHARACTERISTIC AirCtl_tiDT1LPDesLPDyn_C "" VALUE 0x80035B54 Kw_Ws32 4294.9662960 TimeDelay_s 0.0010000000689 4294.9672960 FORMAT "%12.7" EXTENDED_LIMITS 0.000002000000001 4294.9672960 /end CHARACTERISTIC
/begin CHARACTERISTIC AirCtl_tiDT1mDes_C "" VALUE 0x80034D34 Kw_Ws32 4294.9662960 TimeDelay_s 0.0010000000689 4294.9672960 FORMAT "%12.7" EXTENDED_LIMITS 0.000002000000001 4294.9672960 /end CHARACTERISTIC
/begin CHARACTERISTIC AirCtl_tiDT1PGovOff_C "" VALUE 0x80036D04 Kw_Wu32 4294.9662960 TimeDelay_s 0.0010000000689 4294.9672960 FORMAT "%12.7" EXTENDED_LIMITS 0.000001000000000 4294.9672960 /end CHARACTERISTIC
/begin CHARACTERISTIC AirCtl_tiDT1_C "" VALUE 0x80036D08 Kw_Wu32 4294.9662960 TimeDelay_s 0.0010000000689 4294.9672960 FORMAT "%12.7" EXTENDED_LIMITS 0.000001000000000 4294.9672960 /end CHARACTERISTIC
/begin CHARACTERISTIC AirCtl_tiDynAirCtl_C "" VALUE 0x80036D0C Val_Wu16 4000.000 Time_ms 0.00 4000.000 EXTENDED_LIMITS 0.00 655350.0 /end CHARACTERISTIC
/begin CHARACTERISTIC AirCtl_tiEOMNrmMax_C "" VALUE 0x80036D10 Kw_Ws32 21474836.4700 Time_s 0.00 21474836.4700 EXTENDED_LIMITS -21474836.4800 21474836.4700 /end CHARACTERISTIC
/begin CHARACTERISTIC AirCtl_tiGovLPDvtMaxDebDef_C "" VALUE 0x800379B0 Val_Wu16 4294970000. TimeDeb 0.00 4294970000. EXTENDED_LIMITS 0.00 655350.0 /end CHARACTERISTIC
/begin CHARACTERISTIC AirCtl_tiGovLPDvtMaxDebOk_C "" VALUE 0x800379B2 Val_Wu16 4294970000. TimeDeb 0.00 4294970000. EXTENDED_LIMITS 0.00 655350.0 /end CHARACTERISTIC
/begin CHARACTERISTIC AirCtl_tiGovLPDvtMinDebDef_C "" VALUE 0x800379B4 Val_Wu16 4294970000. TimeDeb 0.00 4294970000. EXTENDED_LIMITS 0.00 655350.0 /end CHARACTERISTIC
/begin CHARACTERISTIC AirCtl_tiGovLPDvtMinDebOk_C "" VALUE 0x800379B6 Val_Wu16 4294970000. TimeDeb 0.00 4294970000. EXTENDED_LIMITS 0.00 655350.0 /end CHARACTERISTIC
/begin CHARACTERISTIC AirCtl_tiHiQntDlyLoHiLP_C "" VALUE 0x800379B8 Val_Wu16 320.0000 TimeDeb 0.00 320.0000 EXTENDED_LIMITS 0.00 655350.0 /end CHARACTERISTIC
/begin CHARACTERISTIC AirCtl_tiHiQntTrqDebHiLoEOM_C "" VALUE 0x800376EE Kw_Ws16 320.0000 TimeDeb 0.00 320.0000 EXTENDED_LIMITS -327680.0 327670.0 /end CHARACTERISTIC
/begin CHARACTERISTIC AirCtl_tiHiQntTrqDebHiLo_C "" VALUE 0x800376F0 Kw_Ws16 320.0000 TimeDeb 0.00 320.0000 EXTENDED_LIMITS -327680.0 327670.0 /end CHARACTERISTIC
/begin CHARACTERISTIC AirCtl_tiLiEGRLPCorDly_C "" VALUE 0x80035B58 Kw_Wu32 250.000000000 Time_s 0.00 250.000000000 EXTENDED_LIMITS 0.00 42949672.9500 /end CHARACTERISTIC
/begin CHARACTERISTIC AirCtl_tiLiEGR_C "" VALUE 0x80034D38 Kw_Wu32 21474836.4700 Time_s 0.00 21474836.4700 EXTENDED_LIMITS 0.00 42949672.9500 /end CHARACTERISTIC
/begin CHARACTERISTIC AirCtl_tiLoIdl_C "" VALUE 0x800376F2 Val_Ws16 655.3500 Time_s -327.6800 327.6700 /end CHARACTERISTIC
/begin CHARACTERISTIC AirCtl_tiLPClth_C "" VALUE 0x800379BA Val_Wu16 655350.0 TimeDeb 0.00 655350.0 /end CHARACTERISTIC
/begin CHARACTERISTIC AirCtl_tiLPLoIdl_C "" VALUE 0x800379BC Val_Wu16 327.4600 Time_s 0.00 327.4600 EXTENDED_LIMITS 0.00 655.3500 /end CHARACTERISTIC
/begin CHARACTERISTIC AirCtl_tiLPRmp_C "" VALUE 0x80036FC0 Val_Wu32 65.535999984741210 TimeCoEOMRmp 0.000000015258789 65.536000000000001 FORMAT "%19.16" /end CHARACTERISTIC
/begin CHARACTERISTIC AirCtl_tiMonEOM_CA "" VAL_BLK 0x800376F4 ValA_Ws16 655350.0 TimeDeb -327680.0 327670.0 NUMBER 4 /end CHARACTERISTIC
/begin CHARACTERISTIC AirCtl_tiPCRCtl.tiHiLo_C "/" VALUE 0x80036D14 Kw_Ws16 327670.0 TimeDeb 0.00 327670.0 EXTENDED_LIMITS -327680.0 327670.0 /end CHARACTERISTIC
/begin CHARACTERISTIC AirCtl_tiPCRCtl.tiLoHi_C "/" VALUE 0x80036D16 Kw_Ws16 327670.0 TimeDeb 0.00 327670.0 EXTENDED_LIMITS -327680.0 327670.0 /end CHARACTERISTIC
/begin CHARACTERISTIC AirCtl_tiSurgePT1_C "" VALUE 0x800376FC Val_Ws32 4294.9662960 TimeDelay_s 0.0010000000689 4294.9672960 FORMAT "%12.7" EXTENDED_LIMITS 0.000002000000001 4294.9672960 /end CHARACTERISTIC
/begin CHARACTERISTIC AirCtl_tiTVACtlOffTime_C "" VALUE 0x80036D18 Val_Wu32 1000000.00000 Time_ms 0.00 1000000.00000 EXTENDED_LIMITS 0.00 42949672950.0 /end CHARACTERISTIC
/begin CHARACTERISTIC AirCtl_tiTVACtlOvrRunActv_C "" VALUE 0x80036D1C Val_Wu16 30000.00 Time_ms 0.00 30000.00 EXTENDED_LIMITS 0.00 655350.0 /end CHARACTERISTIC
/begin CHARACTERISTIC AirCtl_TrimAdjMax_C "" VALUE 0x80034D3C Kw_Ws16 10.00000 AirMassPerCyl 0.00 10.00000 EXTENDED_LIMITS -3276.800 3276.700 /end CHARACTERISTIC
/begin CHARACTERISTIC AirCtl_TrimAdjMin_C "" VALUE 0x80034D3E Kw_Ws16 10.00000 AirMassPerCyl 0.00 10.00000 EXTENDED_LIMITS -3276.800 3276.700 /end CHARACTERISTIC
/begin CHARACTERISTIC AirCtl_trqHiEOM_CUR "" CURVE 0x80037700 Kl_Xs16_Ws16 1500.000 Trq -500.0000 1000.000 EXTENDED_LIMITS -3276.800 3276.700
 /begin AXIS_DESCR STD_AXIS Epm_nEng EngN 2 0.00 10000.00 EXTENDED_LIMITS -16384.00 16383.50 DEPOSIT ABSOLUTE /end AXIS_DESCR
/end CHARACTERISTIC
/begin CHARACTERISTIC AirCtl_trqHi_CUR "" CURVE 0x8003770A Kl_Xs16_Ws16 1500.000 Trq -500.0000 1000.000 EXTENDED_LIMITS -3276.800 3276.700
 /begin AXIS_DESCR STD_AXIS Epm_nEng EngN 16 0.00 10000.00 EXTENDED_LIMITS -16384.00 16383.50 DEPOSIT ABSOLUTE /end AXIS_DESCR
/end CHARACTERISTIC
/begin CHARACTERISTIC AirCtl_trqLoEOM_CUR "" CURVE 0x8003774C Kl_Xs16_Ws16 1500.000 Trq -500.0000 1000.000 EXTENDED_LIMITS -3276.800 3276.700
 /begin AXIS_DESCR STD_AXIS Epm_nEng EngN 2 0.00 10000.00 EXTENDED_LIMITS -16384.00 16383.50 DEPOSIT ABSOLUTE /end AXIS_DESCR
/end CHARACTERISTIC
/begin CHARACTERISTIC AirCtl_trqLo_CUR "" CURVE 0x80037756 Kl_Xs16_Ws16 1500.000 Trq -500.0000 1000.000 EXTENDED_LIMITS -3276.800 3276.700
 /begin AXIS_DESCR STD_AXIS Epm_nEng EngN 16 0.00 10000.00 EXTENDED_LIMITS -16384.00 16383.50 DEPOSIT ABSOLUTE /end AXIS_DESCR
/end CHARACTERISTIC
/begin CHARACTERISTIC AirCtl_tTVACtlAirTempHi_C "" VALUE 0x80036D1E Val_Ws16 250.0000 Temp_Cels -50.14000 199.8600 EXTENDED_LIMITS -3549.940 3003.560 /end CHARACTERISTIC
/begin CHARACTERISTIC AirCtl_tTVACtlAirTempLo_C "" VALUE 0x80036D20 Val_Ws16 250.0000 Temp_Cels -50.14000 199.8600 EXTENDED_LIMITS -3549.940 3003.560 /end CHARACTERISTIC
/begin CHARACTERISTIC AirCtl_tTVACtlClntTempHi_C "" VALUE 0x80036D22 Val_Ws16 200.0000 Temp_Cels -50.14000 149.8600 EXTENDED_LIMITS -3549.940 3003.560 /end CHARACTERISTIC
/begin CHARACTERISTIC AirCtl_tTVACtlClntTempLo_C "" VALUE 0x80036D24 Val_Ws16 200.0000 Temp_Cels -50.14000 149.8600 EXTENDED_LIMITS -3549.940 3003.560 /end CHARACTERISTIC
/begin CHARACTERISTIC AirCtl_uBattThresLP_C "" VALUE 0x800379BE Val_Ws16 12000.00 Volt_Batt 0.00 12000.00 EXTENDED_LIMITS -655360.0 655340.0 /end CHARACTERISTIC
/begin CHARACTERISTIC AirCtl_uBattThres_C "" VALUE 0x80037798 Val_Ws16 1310700. Volt_Batt -655360.0 655340.0 /end CHARACTERISTIC
/begin CHARACTERISTIC AirSys_nMaxAirSysTst_C "maximale Motordrehzahl für den Luftmassensystemtest" VALUE 0x800379C0 Val_Ws16 5000.000 EngN 0.00 5000.000 EXTENDED_LIMITS -16384.00 16383.50 /end CHARACTERISTIC
/begin CHARACTERISTIC AirSys_pDesValLimHi_C "obere Grenze für Ladedruck" VALUE 0x800379C2 Val_Ws16 3500.000 Pres_hPa 0.00 3500.000 EXTENDED_LIMITS -32768.00 32767.00 /end CHARACTERISTIC
/begin CHARACTERISTIC AirSys_pDesValLimLow_C "untere Grenze für Ladedruck" VALUE 0x800379C4 Val_Ws16 3500.000 Pres_hPa 0.00 3500.000 EXTENDED_LIMITS -32768.00 32767.00 /end CHARACTERISTIC
/begin CHARACTERISTIC AirSys_pDiffFltMax_C "maximaler Partikelfilter Differenzdruck" VALUE 0x800379C6 Val_Ws16 3500.000 Pres_hPa 0.00 3500.000 EXTENDED_LIMITS -32768.00 32767.00 /end CHARACTERISTIC
/begin CHARACTERISTIC AirSys_pMaxAirSysTst_C "" VALUE 0x800379C8 Val_Ws16 3500.000 Pres_hPa 0.00 3500.000 EXTENDED_LIMITS -32768.00 32767.00 /end CHARACTERISTIC
/begin CHARACTERISTIC AirSys_stMskCoEOMOpModeAirSysTst_C "" VALUE 0x800379CC Val_Wu32 65535.0000000 OneToOne 0.00 65535.0000000 EXTENDED_LIMITS 0.00 4294967295.00 /end CHARACTERISTIC
/begin CHARACTERISTIC AirSys_tiLoopMeanVal_C "" VALUE 0x800379D0 Val_Ws16 655350.0 Time_ms -327680.0 327670.0 /end CHARACTERISTIC
/begin CHARACTERISTIC AltIO_swtAltTyp_C "" VALUE 0x80037A12 Val_Wu8 1.00000000000 AltTyp_COMPU_VERB 1.00000000000 2.00000000000 FORMAT "%13.11" EXTENDED_LIMITS 1.00000000000 3.00000000000 /end CHARACTERISTIC
/begin CHARACTERISTIC AltIO_swtLROff_C "" VALUE 0x80037A13 Val_Wu8 1.000 OneToOne 0.00 1.000 EXTENDED_LIMITS 0.00 255.0 /end CHARACTERISTIC
/begin CHARACTERISTIC AltIO_tiBtwRegRd_C "" VALUE 0x80037A14 Val_Ws16 1980.000 Time_ms 20.00000 2000.000 EXTENDED_LIMITS -327680.0 327670.0 /end CHARACTERISTIC
/begin CHARACTERISTIC AltIO_tiLRAltMax_C "Maximale Grenze der Generator Last-Reaktionszeit" VALUE 0x80037A16 Kw_Ws16 65535.00 OneToOne -32768.00 32767.00 /end CHARACTERISTIC
/begin CHARACTERISTIC AltIO_tiLRAltMin_C "Minimale Grenze der Generator Last-Reaktionszeit" VALUE 0x80037A18 Kw_Ws16 65535.00 OneToOne -32768.00 32767.00 /end CHARACTERISTIC
/begin CHARACTERISTIC AltIO_uAltDesMax_C "Maximale Grenze des Generatorspannungssollwerts" VALUE 0x80037A1A Kw_Ws16 6553.500 AltVltg_V_q0p1_COMPU -3266.200 3287.300 FORMAT "%8.3" /end CHARACTERISTIC
/begin CHARACTERISTIC AltIO_uAltDesMin_C "Minimale Grenze des Generatorspannungssollwerts" VALUE 0x80037A1C Kw_Ws16 6553.500 AltVltg_V_q0p1_COMPU -3266.200 3287.300 FORMAT "%8.3" /end CHARACTERISTIC
/begin CHARACTERISTIC APP_AliveDeb.tiHiLo_C "Entprellzeiten für Lebenderkennung des Fahrpedals/" VALUE 0x8002C008 Kw_Ws16 500.0000 Time_ms 0.00 500.0000 EXTENDED_LIMITS -327680.0 327670.0 /end CHARACTERISTIC
/begin CHARACTERISTIC APP_AliveDeb.tiLoHi_C "Entprellzeiten für Lebenderkennung des Fahrpedals/" VALUE 0x8002C00A Kw_Ws16 500.0000 Time_ms 0.00 500.0000 EXTENDED_LIMITS -327680.0 327670.0 /end CHARACTERISTIC
/begin CHARACTERISTIC APP_drLim.Pos_C "Rampensteigungen für Ersatzwert bei Fahrpedal/Bremse Plausibilitätsverletzung/" VALUE 0x8002C00C Kw_Ws32 200.000032783 RmpPrc 0.00 200.000032783 FORMAT "%13.9" EXTENDED_LIMITS -400000.000000 399999.999814 /end CHARACTERISTIC
/begin CHARACTERISTIC APP_drLim.Neg_C "Rampensteigungen für Ersatzwert bei Fahrpedal/Bremse Plausibilitätsverletzung/" VALUE 0x8002C010 Kw_Ws32 200.000032783 RmpPrc 0.00 200.000032783 FORMAT "%13.9" EXTENDED_LIMITS -400000.000000 399999.999814 /end CHARACTERISTIC
/begin CHARACTERISTIC APP_drLimpMax_C "Grenze für Fahrpedalwertgradient im Ersatzbetrieb" VALUE 0x8002C014 Val_Ws16 200.1953 PrcPerSec 0.00 200.1953 FORMAT "%8.4" EXTENDED_LIMITS -20000.00 19999.39 /end CHARACTERISTIC
/begin CHARACTERISTIC APP_drPlaMaxVal.Pos_C "/" VALUE 0x8002C018 Kw_Ws32 200.000032783 RmpPrc 0.00 200.000032783 FORMAT "%13.9" EXTENDED_LIMITS -400000.000000 399999.999814 /end CHARACTERISTIC
/begin CHARACTERISTIC APP_drPlaMaxVal.Neg_C "/" VALUE 0x8002C01C Kw_Ws32 200.000032783 RmpPrc 0.00 200.000032783 FORMAT "%13.9" EXTENDED_LIMITS -400000.000000 399999.999814 /end CHARACTERISTIC
/begin CHARACTERISTIC APP_drUnFltLim_C "Schwelle für Fahrpedalwertgradient zum Rücksetzen der Plausibilität mit der Bremse" VALUE 0x8002C060 Val_Ws16 200.1953 PrcPerSec_10ms 0.00 200.1953 FORMAT "%8.4" EXTENDED_LIMITS -40000.00 39998.78 /end CHARACTERISTIC
/begin CHARACTERISTIC APP_GradCondDeb.tiHiLo_C "Entprellzeiten für Gradientenbedingung bei Fahrpedal/Bremse Plausibilisierung/" VALUE 0x8002C062 Kw_Ws16 1000.000 Time_ms 0.00 1000.000 EXTENDED_LIMITS -327680.0 327670.0 /end CHARACTERISTIC
/begin CHARACTERISTIC APP_GradCondDeb.tiLoHi_C "Entprellzeiten für Gradientenbedingung bei Fahrpedal/Bremse Plausibilisierung/" VALUE 0x8002C064 Kw_Ws16 1000.000 Time_ms 0.00 1000.000 EXTENDED_LIMITS -327680.0 327670.0 /end CHARACTERISTIC
/begin CHARACTERISTIC APP_nLim_C "Drehzahlschwelle für Freigabe der Fahrpedal-Bremse-Plausibilisierung" VALUE 0x8002C066 Val_Ws16 6000.000 EngN 0.00 6000.000 EXTENDED_LIMITS -16384.00 16383.50 /end CHARACTERISTIC
/begin CHARACTERISTIC APP_PlaBrkDetDeb.tiHiLo_C "Entprellzeiten für Erkennung der Fahrpedal/Bremse Plausibilisierung/" VALUE 0x8002C068 Kw_Ws16 0.00 Time_ms 0.00 0.00 EXTENDED_LIMITS -327680.0 327670.0 /end CHARACTERISTIC
/begin CHARACTERISTIC APP_PlaBrkDetDeb.tiLoHi_C "Entprellzeiten für Erkennung der Fahrpedal/Bremse Plausibilisierung/" VALUE 0x8002C06A Kw_Ws16 1000.000 Time_ms 0.00 1000.000 EXTENDED_LIMITS -327680.0 327670.0 /end CHARACTERISTIC
/begin CHARACTERISTIC APP_PlaBrkRstDeb.tiHiLo_C "Entprellzeit für den Reset des Plausibiliserungsfehlers PWG/Bremse/" VALUE 0x8002C06C Kw_Ws16 0.00 Time_ms 0.00 0.00 EXTENDED_LIMITS -327680.0 327670.0 /end CHARACTERISTIC
/begin CHARACTERISTIC APP_PlaBrkRstDeb.tiLoHi_C "Entprellzeit für den Reset des Plausibiliserungsfehlers PWG/Bremse/" VALUE 0x8002C06E Kw_Ws16 1000.000 Time_ms 0.00 1000.000 EXTENDED_LIMITS -327680.0 327670.0 /end CHARACTERISTIC
/begin CHARACTERISTIC APP_rLimpMax_C "Grenze für Fahrpedalwert im Ersatzbetrieb" VALUE 0x8002C020 Val_Ws16 100.0000 Prc 0.00 100.0000 EXTENDED_LIMITS -400.0000 399.9878 /end CHARACTERISTIC
/begin CHARACTERISTIC APP_rPlaMaxVal_C "Maximalwert für Fahrpedal bei Plausibilitätsverletzung mit der Bremse" VALUE 0x8002C022 Val_Ws16 100.0000 Prc 0.00 100.0000 EXTENDED_LIMITS -400.0000 399.9878 /end CHARACTERISTIC
/begin CHARACTERISTIC APP_rPlaMaxVal_CUR "Bremse druckabhängige APP Wiederbeschaffungswert Curve" CURVE 0x8002C024 Kl_Xs16_Ws16 100.0000 Prc 0.00 100.0000 EXTENDED_LIMITS -400.0000 399.9878
 /begin AXIS_DESCR STD_AXIS Com_trqBrkDVCH Trq 6 0.00 100.000000000 EXTENDED_LIMITS -214748364.800 214748364.700 DEPOSIT ABSOLUTE /end AXIS_DESCR
/end CHARACTERISTIC
/begin CHARACTERISTIC APP_rPlaRls_C "" VALUE 0x8002C070 Val_Ws16 200.0000 Prc 0.00 200.0000 EXTENDED_LIMITS -400.0000 399.9878 /end CHARACTERISTIC
/begin CHARACTERISTIC APP_rThresAliveDet_C "Schwelle für Fahrpedal Lebenderkennung" VALUE 0x8002C03E Val_Ws16 100.0000 Prc 0.00 100.0000 EXTENDED_LIMITS -400.0000 399.9878 /end CHARACTERISTIC
/begin CHARACTERISTIC APP_swtAliveDetEna_C "Schalter zur Aktivierung der Fahrpedal-Lebenderkennung" VALUE 0x8002C040 Val_Wu8 1.000 OneToOne 0.00 1.000 EXTENDED_LIMITS 0.00 255.0 /end CHARACTERISTIC
/begin CHARACTERISTIC APP_swtAppGradEna_C "Schalter um Rücksetzen der Fahrpedal-Bremse-Plausibilität durch Fahrpedalgradient zu aktivieren" VALUE 0x8002C072 Val_Wu8 1.000 OneToOne 0.00 1.000 EXTENDED_LIMITS 0.00 255.0 /end CHARACTERISTIC
/begin CHARACTERISTIC APP_swtBrkDet_C "Schalter zur Auswahl der Bremserkennung über Wert oder Flanke" VALUE 0x8002C073 Val_Wu8 1.000 OneToOne 0.00 1.000 EXTENDED_LIMITS 0.00 255.0 /end CHARACTERISTIC
/begin CHARACTERISTIC APP_swtBrkTrq_C "" VALUE 0x8002C074 Kw_Wu8 1.000 OneToOne 0.00 1.000 EXTENDED_LIMITS 0.00 255.0 /end CHARACTERISTIC
/begin CHARACTERISTIC APP_swtPlaChkEna_C "Schalter zur Aktivierung der Fahrpedal-Bremse-Plausibilisierung" VALUE 0x8002C041 Val_Wu8 1.000 OneToOne 0.00 1.000 EXTENDED_LIMITS 0.00 255.0 /end CHARACTERISTIC
/begin CHARACTERISTIC APP_swtRstCon_C "Schalter zur Auswahl der Rücksetzbedingungen der Fahrpedal-Bremse-Plausibilisierung" VALUE 0x8002C075 Val_Wu8 1.000 OneToOne 0.00 1.000 EXTENDED_LIMITS 0.00 255.0 /end CHARACTERISTIC
/begin CHARACTERISTIC APP_swtVehDynReqd_C "Schalter zur Deaktivierung der Fahrpedal-Bremse-Plausibilisierung bei aktiven externen Eingriffen" VALUE 0x8002C076 Val_Wu8 1.000 OneToOne 0.00 1.000 EXTENDED_LIMITS 0.00 255.0 /end CHARACTERISTIC
/begin CHARACTERISTIC APP_trqBrkHigh_C "" VALUE 0x8002C078 Kw_Ws32 858993459.000 Trq -429496729.500 429496729.500 EXTENDED_LIMITS -214748364.800 214748364.700 /end CHARACTERISTIC
/begin CHARACTERISTIC APP_trqBrkLow_C "" VALUE 0x8002C07C Kw_Ws32 858993459.000 Trq -429496729.500 429496729.500 EXTENDED_LIMITS -214748364.800 214748364.700 /end CHARACTERISTIC
/begin CHARACTERISTIC APP_uKDHighAPP_C "Obere Hystereschwelle für Kickdownerkennung" VALUE 0x8002C04C Val_Ws16 5200.000 Volt 0.00 5200.000 EXTENDED_LIMITS -6553.600 6553.400 /end CHARACTERISTIC
/begin CHARACTERISTIC APP_uKDLowAPP_C "Untere Hystereseschwelle für Kickdownerkennung" VALUE 0x8002C04E Val_Ws16 11753.60 Volt -6553.600 5200.000 EXTENDED_LIMITS -6553.600 6553.400 /end CHARACTERISTIC
/begin CHARACTERISTIC APP_uRaw1SRCHigh_C "SRC high Schwelle für Sensor 1" VALUE 0x8002C044 Val_Ws16 5200.000 Volt 0.00 5200.000 EXTENDED_LIMITS -6553.600 6553.400 /end CHARACTERISTIC
/begin CHARACTERISTIC APP_uRaw1SRCLow_C "SRC low Schwelle für Sensor 1" VALUE 0x8002C046 Val_Ws16 5200.000 Volt 0.00 5200.000 EXTENDED_LIMITS -6553.600 6553.400 /end CHARACTERISTIC
/begin CHARACTERISTIC APP_uRaw2SRCHigh_C "SRC high Schwelle für Sensor 2" VALUE 0x8002C048 Val_Ws16 5200.000 Volt 0.00 5200.000 EXTENDED_LIMITS -6553.600 6553.400 /end CHARACTERISTIC
/begin CHARACTERISTIC APP_uRaw2SRCLow_C "SRC low Schwelle für Sensor 2" VALUE 0x8002C04A Val_Ws16 5200.000 Volt 0.00 5200.000 EXTENDED_LIMITS -6553.600 6553.400 /end CHARACTERISTIC
/begin CHARACTERISTIC APP_uSyncMin_C "Untere Spannungsschwelle für Gleichlaufprüfung Sensor1/Sensor2" VALUE 0x8002C050 Val_Ws16 5200.000 Volt 0.00 5200.000 EXTENDED_LIMITS -6553.600 6553.400 /end CHARACTERISTIC
/begin CHARACTERISTIC APP_uSync_CUR "Kennlinie zur Bestimmung der maximal zulässigen Abweichung zwischen Sensor 1 und Sensor 2" CURVE 0x8002C052 Cur_Xs16Ws16 5200.000 Volt 0.00 5200.000 EXTENDED_LIMITS -6553.600 6553.400
 /begin AXIS_DESCR STD_AXIS APP_uMin12half_mp Volt 3 0.00 5200.000 EXTENDED_LIMITS -6553.600 6553.400 DEPOSIT ABSOLUTE /end AXIS_DESCR
/end CHARACTERISTIC
/begin CHARACTERISTIC APP_vLim_C "Geschwindigkeitsschwelle zur Freigabe der Fahrpedal-Bremse-Plausibilisierung" VALUE 0x8002C080 Val_Ws16 250.0000 Vel 0.00 250.0000 EXTENDED_LIMITS -327.6800 327.6700 /end CHARACTERISTIC
/begin MEASUREMENT AirCtlLP_mGovDvt "" SWORD AirMassPerCyl 1 100 -3276.800 3276.700 ECU_ADDRESS 0xD0000598 /end MEASUREMENT
/begin MEASUREMENT AirCtl_AirTempCorBasEOMQnt1_mp "" SWORD AirMassPerCyl 1 100 -3276.800 3276.700 ECU_ADDRESS 0xC0009638 /end MEASUREMENT
/begin MEASUREMENT AirCtl_AirTempCorBasEOMQnt2_mp "" SWORD AirMassPerCyl 1 100 -3276.800 3276.700 ECU_ADDRESS 0xC000963A /end MEASUREMENT
/begin MEASUREMENT AirCtl_AirTempCorBasEOMQnt3_mp "" SWORD AirMassPerCyl 1 100 -3276.800 3276.700 ECU_ADDRESS 0xC000963C /end MEASUREMENT
/begin MEASUREMENT AirCtl_AirTempCorBas_mp "" SWORD AirMassPerCyl 1 100 -3276.800 3276.700 ECU_ADDRESS 0xC000963E /end MEASUREMENT
/begin MEASUREMENT AirCtl_AirTempCorEOMQnt1_mp "" SWORD AirMassPerCyl 1 100 -3276.800 3276.700 ECU_ADDRESS 0xC0009640 /end MEASUREMENT
/begin MEASUREMENT AirCtl_AirTempCorEOMQnt2_mp "" SWORD AirMassPerCyl 1 100 -3276.800 3276.700 ECU_ADDRESS 0xC0009642 /end MEASUREMENT
/begin MEASUREMENT AirCtl_AirTempCorEOMQnt3_mp "" SWORD AirMassPerCyl 1 100 -3276.800 3276.700 ECU_ADDRESS 0xC0009644 /end MEASUREMENT
/begin MEASUREMENT AirCtl_AirTempCor_mp "" SWORD AirMassPerCyl 1 100 -3276.800 3276.700 ECU_ADDRESS 0xC0009646 /end MEASUREMENT
/begin MEASUREMENT AirCtl_AirTempLPCorBas_mp "" SWORD AirMassPerCyl 1 100 -3276.800 3276.700 ECU_ADDRESS 0xC000973A /end MEASUREMENT
/begin MEASUREMENT AirCtl_DKdEOM_mp "" SLONG Kd_Ampc2Prc 1 100 -4000.00000000 3999.99999814 FORMAT "%13.8" ECU_ADDRESS 0xC0008C08 /end MEASUREMENT
/begin MEASUREMENT AirCtl_DKdmDes_mp "" SLONG Kd 1 100 -32768.0000000 32767.9999847 FORMAT "%13.7" ECU_ADDRESS 0xC0008BFC /end MEASUREMENT
/begin MEASUREMENT AirCtl_DKdmLPDes_mp "" SLONG Kd 1 100 -32768.0000000 32767.9999847 FORMAT "%13.7" ECU_ADDRESS 0xC0008C04 /end MEASUREMENT
/begin MEASUREMENT AirCtl_DkdNegDesLPDyn_mp "" SWORD Kd_RedRes 1 100 -512.0000 511.9844 FORMAT "%8.4" ECU_ADDRESS 0xC000973C /end MEASUREMENT
/begin MEASUREMENT AirCtl_DKdNegEOM_mp "" SLONG Kd_Ampc2Prc 1 100 -4000.00000000 3999.99999814 FORMAT "%13.8" ECU_ADDRESS 0xC0008C0C /end MEASUREMENT
/begin MEASUREMENT AirCtl_DKdNegMDes_mp "" SWORD Kd_RedRes 1 100 -512.0000 511.9844 FORMAT "%8.4" ECU_ADDRESS 0xC0009648 /end MEASUREMENT
/begin MEASUREMENT AirCtl_DKdNegNrm_mp "" SLONG Kd_Ampc2Prc 1 100 -4000.00000000 3999.99999814 FORMAT "%13.8" ECU_ADDRESS 0xC0008C10 /end MEASUREMENT
/begin MEASUREMENT AirCtl_DKdNrm_mp "" SLONG Kd_Ampc2Prc 1 100 -4000.00000000 3999.99999814 FORMAT "%13.8" ECU_ADDRESS 0xC0008C14 /end MEASUREMENT
/begin MEASUREMENT AirCtl_DkdPosDesLPDyn_mp "" SWORD Kd_RedRes 1 100 -512.0000 511.9844 FORMAT "%8.4" ECU_ADDRESS 0xC000973E /end MEASUREMENT
/begin MEASUREMENT AirCtl_DKdPosEOM_mp "" SLONG Kd_Ampc2Prc 1 100 -4000.00000000 3999.99999814 FORMAT "%13.8" ECU_ADDRESS 0xC0008C18 /end MEASUREMENT
/begin MEASUREMENT AirCtl_DKdPosMDes_mp "" SWORD Kd_RedRes 1 100 -512.0000 511.9844 FORMAT "%8.4" ECU_ADDRESS 0xC000964A /end MEASUREMENT
/begin MEASUREMENT AirCtl_DKdPosNrm_mp "" SLONG Kd_Ampc2Prc 1 100 -4000.00000000 3999.99999814 FORMAT "%13.8" ECU_ADDRESS 0xC0008C1C /end MEASUREMENT
/begin MEASUREMENT AirCtl_dmDesCor "" SWORD AirMassPerCyl 1 100 -3276.800 3276.700 ECU_ADDRESS 0xD000059A /end MEASUREMENT
/begin MEASUREMENT AirCtl_dmDesLPCor_mp "" SWORD AirMassPerCyl 1 100 -3276.800 3276.700 ECU_ADDRESS 0xC0009740 /end MEASUREMENT
/begin MEASUREMENT AirCtl_dmDesVal_mp "" SWORD AirMassPerCyl 1 100 -3276.800 3276.700 ECU_ADDRESS 0xC00097AA /end MEASUREMENT
/begin MEASUREMENT AirCtl_dmDWinNegDesLPDyn_mp "" SWORD AirMassPerCyl 1 100 -3276.800 3276.700 ECU_ADDRESS 0xC0009742 /end MEASUREMENT
/begin MEASUREMENT AirCtl_dmDWinNegDes_mp "" SWORD AirMassPerCyl 1 100 -3276.800 3276.700 ECU_ADDRESS 0xC000964C /end MEASUREMENT
/begin MEASUREMENT AirCtl_dmDWinPosDesLPDyn_mp "" SWORD AirMassPerCyl 1 100 -3276.800 3276.700 ECU_ADDRESS 0xC0009744 /end MEASUREMENT
/begin MEASUREMENT AirCtl_dmDWinPosDes_mp "" SWORD AirMassPerCyl 1 100 -3276.800 3276.700 ECU_ADDRESS 0xC000964E /end MEASUREMENT
/begin MEASUREMENT AirCtl_dmEGRDs "" SWORD AirMassPerTime 1 100 -3276.800 3276.700 ECU_ADDRESS 0xD000059C /end MEASUREMENT
/begin MEASUREMENT AirCtl_drGovOutUnLim_mp "" SWORD PrcPerSec 1 100 -20000.00 19999.39 FORMAT "%8.2" ECU_ADDRESS 0xC00097AC /end MEASUREMENT
/begin MEASUREMENT AirCtl_facAirTempCorEOMQnt1_mp "" SWORD Fact 1 100 -4.000000 3.999878 ECU_ADDRESS 0xC0009650 /end MEASUREMENT
/begin MEASUREMENT AirCtl_facAirTempCorEOMQnt2_mp "" SWORD Fact 1 100 -4.000000 3.999878 ECU_ADDRESS 0xC0009652 /end MEASUREMENT
/begin MEASUREMENT AirCtl_facAirTempCorEOMQnt3_mp "" SWORD Fact 1 100 -4.000000 3.999878 ECU_ADDRESS 0xC0009654 /end MEASUREMENT
/begin MEASUREMENT AirCtl_facAirTempCor_mp "" SWORD Fact 1 100 -4.000000 3.999878 ECU_ADDRESS 0xC0009656 /end MEASUREMENT
/begin MEASUREMENT AirCtl_facAirTempLPCor_mp "" SWORD Fact 1 100 -4.000000 3.999878 ECU_ADDRESS 0xC0009746 /end MEASUREMENT
/begin MEASUREMENT AirCtl_facBstPresCor_mp "" SWORD Fact 1 100 -4.000000 3.999878 ECU_ADDRESS 0xC0009658 /end MEASUREMENT
/begin MEASUREMENT AirCtl_facBstPresLPCor_mp "" SWORD Fact 1 100 -4.000000 3.999878 ECU_ADDRESS 0xC0009748 /end MEASUREMENT
/begin MEASUREMENT AirCtl_facDesEGRHighMCor_mp "" SWORD Fact 1 100 -4.000000 3.999878 ECU_ADDRESS 0xC000965A /end MEASUREMENT
/begin MEASUREMENT AirCtl_facDesLPEngTempVCor_mp "" SWORD Fact 1 100 -4.000000 3.999878 ECU_ADDRESS 0xC000974A /end MEASUREMENT
/begin MEASUREMENT AirCtl_facDesLPVehV_mp "" SWORD Fact 1 100 -4.000000 3.999878 ECU_ADDRESS 0xC000974C /end MEASUREMENT
/begin MEASUREMENT AirCtl_facEGRCorAltEOMQnt1_mp "" SWORD Fact1 1 100 -256.0000 255.9922 ECU_ADDRESS 0xC00097AE /end MEASUREMENT
/begin MEASUREMENT AirCtl_facEGRCorAltEOMQnt2_mp "" SWORD Fact1 1 100 -256.0000 255.9922 ECU_ADDRESS 0xC00097B0 /end MEASUREMENT
/begin MEASUREMENT AirCtl_facEngTempCor2_mp "" SWORD Fact 1 100 -4.000000 3.999878 ECU_ADDRESS 0xC000965C /end MEASUREMENT
/begin MEASUREMENT AirCtl_facEngTempCorEOMQnt1_mp "" SWORD Fact 1 100 -4.000000 3.999878 ECU_ADDRESS 0xC000965E /end MEASUREMENT
/begin MEASUREMENT AirCtl_facEngTempCorEOMQnt2_mp "" SWORD Fact 1 100 -4.000000 3.999878 ECU_ADDRESS 0xC0009660 /end MEASUREMENT
/begin MEASUREMENT AirCtl_facEngTempCorEOMQnt3_mp "" SWORD Fact 1 100 -4.000000 3.999878 ECU_ADDRESS 0xC0009662 /end MEASUREMENT
/begin MEASUREMENT AirCtl_facEngTempCor_mp "" SWORD Fact 1 100 -4.000000 3.999878 ECU_ADDRESS 0xC0009664 /end MEASUREMENT
/begin MEASUREMENT AirCtl_facEngTempLPCor2_mp "" SWORD Fact 1 100 -4.000000 3.999878 ECU_ADDRESS 0xC000974E /end MEASUREMENT
/begin MEASUREMENT AirCtl_facEngTempLPCor_mp "" SWORD Fact 1 100 -4.000000 3.999878 ECU_ADDRESS 0xC0009750 /end MEASUREMENT
/begin MEASUREMENT AirCtl_facEnvPresCorDef_mp "" SWORD Fact 1 100 -4.000000 3.999878 ECU_ADDRESS 0xC0009666 /end MEASUREMENT
/begin MEASUREMENT AirCtl_facEnvPresCorEOMQnt1_mp "" SWORD Fact1 1 100 -256.0000 255.9922 ECU_ADDRESS 0xC0009668 /end MEASUREMENT
/begin MEASUREMENT AirCtl_facEnvPresCorEOMQnt2_mp "" SWORD Fact1 1 100 -256.0000 255.9922 ECU_ADDRESS 0xC000966A /end MEASUREMENT
/begin MEASUREMENT AirCtl_facEnvPresCorEOMQnt3_mp "" SWORD Fact1 1 100 -256.0000 255.9922 ECU_ADDRESS 0xC000966C /end MEASUREMENT
/begin MEASUREMENT AirCtl_facEnvPresCor_mp "" SWORD Fact1 1 100 -256.0000 255.9922 ECU_ADDRESS 0xC000966E /end MEASUREMENT
/begin MEASUREMENT AirCtl_facEnvPresLPCorDef_mp "" SWORD Fact 1 100 -4.000000 3.999878 ECU_ADDRESS 0xC0009752 /end MEASUREMENT
/begin MEASUREMENT AirCtl_facEnvPresLPCor_mp "" SWORD Fact 1 100 -4.000000 3.999878 ECU_ADDRESS 0xC0009754 /end MEASUREMENT
/begin MEASUREMENT AirCtl_facIParBas_mp "" SWORD Fact1 1 100 -256.0000 255.9922 ECU_ADDRESS 0xC00097B2 /end MEASUREMENT
/begin MEASUREMENT AirCtl_facIParCor_mp "" SWORD Fact1 1 100 -256.0000 255.9922 ECU_ADDRESS 0xC00097B4 /end MEASUREMENT
/begin MEASUREMENT AirCtl_facIParNegBas_mp "" SWORD Fact1 1 100 -256.0000 255.9922 ECU_ADDRESS 0xC00097B6 /end MEASUREMENT
/begin MEASUREMENT AirCtl_facIParNegCor_mp "" SWORD Fact1 1 100 -256.0000 255.9922 ECU_ADDRESS 0xC00097B8 /end MEASUREMENT
/begin MEASUREMENT AirCtl_facIParNegNrm_mp "" SWORD Fact1 1 100 -256.0000 255.9922 ECU_ADDRESS 0xC00097BA /end MEASUREMENT
/begin MEASUREMENT AirCtl_facIParNrm_mp "" SWORD Fact1 1 100 -256.0000 255.9922 ECU_ADDRESS 0xC00097BC /end MEASUREMENT
/begin MEASUREMENT AirCtl_facIParPosBas_mp "" SWORD Fact1 1 100 -256.0000 255.9922 ECU_ADDRESS 0xC00097BE /end MEASUREMENT
/begin MEASUREMENT AirCtl_facIParPosCor_mp "" SWORD Fact1 1 100 -256.0000 255.9922 ECU_ADDRESS 0xC00097C0 /end MEASUREMENT
/begin MEASUREMENT AirCtl_facIParPosNrm_mp "" SWORD Fact1 1 100 -256.0000 255.9922 ECU_ADDRESS 0xC00097C2 /end MEASUREMENT
/begin MEASUREMENT AirCtl_facParAirTempEOM_mp "" SWORD Fact1 1 100 -256.0000 255.9922 ECU_ADDRESS 0xC00097C4 /end MEASUREMENT
/begin MEASUREMENT AirCtl_facParAirTemp_mp "" SWORD Fact1 1 100 -256.0000 255.9922 ECU_ADDRESS 0xC00097C6 /end MEASUREMENT
/begin MEASUREMENT AirCtl_facParBasEOM_mp "" SWORD Fact1 1 100 -256.0000 255.9922 ECU_ADDRESS 0xC00097C8 /end MEASUREMENT
/begin MEASUREMENT AirCtl_facParCorEOM_mp "" SWORD Fact1 1 100 -256.0000 255.9922 ECU_ADDRESS 0xC00097CA /end MEASUREMENT
/begin MEASUREMENT AirCtl_facParLPAirTemp_mp "" SWORD Fact1 1 100 -256.0000 255.9922 ECU_ADDRESS 0xC0009856 /end MEASUREMENT
/begin MEASUREMENT AirCtl_facParLPBas_mp "" SWORD Fact1 1 100 -256.0000 255.9922 ECU_ADDRESS 0xC0009858 /end MEASUREMENT
/begin MEASUREMENT AirCtl_facParLPCor_mp "" SWORD Fact1 1 100 -256.0000 255.9922 ECU_ADDRESS 0xC000985A /end MEASUREMENT
/begin MEASUREMENT AirCtl_facParLPNrm_mp "" SWORD Fact1 1 100 -256.0000 255.9922 ECU_ADDRESS 0xC000985C /end MEASUREMENT
/begin MEASUREMENT AirCtl_facParPresDiff_mp "" SWORD Fact1 1 100 -256.0000 255.9922 ECU_ADDRESS 0xC00097CC /end MEASUREMENT
/begin MEASUREMENT AirCtl_facParPresEGRDiff_mp "" SWORD Fact1 1 100 -256.0000 255.9922 ECU_ADDRESS 0xC00097CE /end MEASUREMENT
/begin MEASUREMENT AirCtl_facPCRCorNeg_mp "" SWORD Fact 1 100 -4.000000 3.999878 ECU_ADDRESS 0xC00097D0 /end MEASUREMENT
/begin MEASUREMENT AirCtl_facPCRCorPos_mp "" SWORD Fact 1 100 -4.000000 3.999878 ECU_ADDRESS 0xC00097D2 /end MEASUREMENT
/begin MEASUREMENT AirCtl_facPParBas_mp "" SWORD Fact1 1 100 -256.0000 255.9922 ECU_ADDRESS 0xC00097D4 /end MEASUREMENT
/begin MEASUREMENT AirCtl_facPParCor_mp "" SWORD Fact1 1 100 -256.0000 255.9922 ECU_ADDRESS 0xC00097D6 /end MEASUREMENT
/begin MEASUREMENT AirCtl_facPParNegBas_mp "" SWORD Fact1 1 100 -256.0000 255.9922 ECU_ADDRESS 0xC00097D8 /end MEASUREMENT
/begin MEASUREMENT AirCtl_facPParNegCor_mp "" SWORD Fact1 1 100 -256.0000 255.9922 ECU_ADDRESS 0xC00097DA /end MEASUREMENT
/begin MEASUREMENT AirCtl_facPParNegNrm_mp "" SWORD Fact1 1 100 -256.0000 255.9922 ECU_ADDRESS 0xC00097DC /end MEASUREMENT
/begin MEASUREMENT AirCtl_facPParNrm_mp "" SWORD Fact1 1 100 -256.0000 255.9922 ECU_ADDRESS 0xC00097DE /end MEASUREMENT
/begin MEASUREMENT AirCtl_facPParPosBas_mp "" SWORD Fact1 1 100 -256.0000 255.9922 ECU_ADDRESS 0xC00097E0 /end MEASUREMENT
/begin MEASUREMENT AirCtl_facPParPosCor_mp "" SWORD Fact1 1 100 -256.0000 255.9922 ECU_ADDRESS 0xC00097E2 /end MEASUREMENT
/begin MEASUREMENT AirCtl_facPParPosNrm_mp "" SWORD Fact1 1 100 -256.0000 255.9922 ECU_ADDRESS 0xC00097E4 /end MEASUREMENT
/begin MEASUREMENT AirCtl_facRmpValCor_mp "" SWORD CoEOMSwt_S16 1 100 -2.000000 1.999939 FORMAT "%8.6" ECU_ADDRESS 0xC0009670 /end MEASUREMENT
/begin MEASUREMENT AirCtl_facTrmEOM_mp "" SWORD Fact 1 100 -4.000000 3.999878 ECU_ADDRESS 0xC0009672 /end MEASUREMENT
/begin MEASUREMENT AirCtl_facTrmVal_mp "" SWORD Fact 1 100 -4.000000 3.999878 ECU_ADDRESS 0xC0009674 /end MEASUREMENT
/begin MEASUREMENT AirCtl_InDT1_mp "" SWORD AirMassPerCyl 1 100 -3276.800 3276.700 ECU_ADDRESS 0xC00097E6 /end MEASUREMENT
/begin MEASUREMENT AirCtl_mActValLP_mp "" SWORD AirMassPerCyl 1 100 -3276.800 3276.700 ECU_ADDRESS 0xC000985E /end MEASUREMENT
/begin MEASUREMENT AirCtl_mActVal_mp "" SWORD AirMassPerCyl 1 100 -3276.800 3276.700 ECU_ADDRESS 0xC00097E8 /end MEASUREMENT
/begin MEASUREMENT AirCtl_mAirTempLPCor_mp "" SWORD AirMassPerCyl 1 100 -3276.800 3276.700 ECU_ADDRESS 0xC0009756 /end MEASUREMENT
/begin MEASUREMENT AirCtl_mDes2Cor_mp "" SWORD AirMassPerCyl 1 100 -3276.800 3276.700 ECU_ADDRESS 0xC0009676 /end MEASUREMENT
/begin MEASUREMENT AirCtl_mDes2Red_mp "" SWORD AirMassPerCyl 1 100 -3276.800 3276.700 ECU_ADDRESS 0xC0009678 /end MEASUREMENT
/begin MEASUREMENT AirCtl_mDesACCorrSwt_mp "" SWORD AirMassPerCyl 1 100 -3276.800 3276.700 ECU_ADDRESS 0xC000967A /end MEASUREMENT
/begin MEASUREMENT AirCtl_mDesACCorr_mp "" SWORD AirMassPerCyl 1 100 -3276.800 3276.700 ECU_ADDRESS 0xC000967C /end MEASUREMENT
/begin MEASUREMENT AirCtl_mDesAdd1_mp "" SWORD AirMassPerCyl 1 100 -3276.800 3276.700 ECU_ADDRESS 0xC000967E /end MEASUREMENT
/begin MEASUREMENT AirCtl_mDesAddBas_mp "" SWORD AirMassPerCyl 1 100 -3276.800 3276.700 ECU_ADDRESS 0xC0009680 /end MEASUREMENT
/begin MEASUREMENT AirCtl_mDesAddEOM1_mp "" SWORD AirMassPerCyl 1 100 -3276.800 3276.700 ECU_ADDRESS 0xC0009682 /end MEASUREMENT
/begin MEASUREMENT AirCtl_mDesAddEOM_mp "" SWORD AirMassPerCyl 1 100 -3276.800 3276.700 ECU_ADDRESS 0xC0009684 /end MEASUREMENT
/begin MEASUREMENT AirCtl_mDesAddUnLimEOM_mp "" SWORD AirMassPerCyl 1 100 -3276.800 3276.700 ECU_ADDRESS 0xC0009686 /end MEASUREMENT
/begin MEASUREMENT AirCtl_mDesAddUnLim_mp "" SWORD AirMassPerCyl 1 100 -3276.800 3276.700 ECU_ADDRESS 0xC0009688 /end MEASUREMENT
/begin MEASUREMENT AirCtl_mDesAdd_mp "" SWORD AirMassPerCyl 1 100 -3276.800 3276.700 ECU_ADDRESS 0xC000968A /end MEASUREMENT
/begin MEASUREMENT AirCtl_mDesBas "" SWORD AirMassPerCyl 1 100 -3276.800 3276.700 ECU_ADDRESS 0xD000059E /end MEASUREMENT
/begin MEASUREMENT AirCtl_mDesBasAddEOM_mp "" SWORD AirMassPerCyl 1 100 -3276.800 3276.700 ECU_ADDRESS 0xC000968C /end MEASUREMENT
/begin MEASUREMENT AirCtl_mDesBasDef_mp "" SWORD AirMassPerCyl 1 100 -3276.800 3276.700 ECU_ADDRESS 0xC000968E /end MEASUREMENT
/begin MEASUREMENT AirCtl_mDesBasEOMQnt1_mp "" SWORD AirMassPerCyl 1 100 -3276.800 3276.700 ECU_ADDRESS 0xC0009690 /end MEASUREMENT
/begin MEASUREMENT AirCtl_mDesBasEOMQnt2_mp "" SWORD AirMassPerCyl 1 100 -3276.800 3276.700 ECU_ADDRESS 0xC0009692 /end MEASUREMENT
/begin MEASUREMENT AirCtl_mDesBasEOMQnt3_mp "" SWORD AirMassPerCyl 1 100 -3276.800 3276.700 ECU_ADDRESS 0xC0009694 /end MEASUREMENT
/begin MEASUREMENT AirCtl_mDesBasHiAltdDef_mp "" SWORD AirMassPerCyl 1 100 -3276.800 3276.700 ECU_ADDRESS 0xC0009696 /end MEASUREMENT
/begin MEASUREMENT AirCtl_mDesBasHiAltdEOMQnt1_mp "" SWORD AirMassPerCyl 1 100 -3276.800 3276.700 ECU_ADDRESS 0xC0009698 /end MEASUREMENT
/begin MEASUREMENT AirCtl_mDesBasHiAltdEOMQnt2_mp "" SWORD AirMassPerCyl 1 100 -3276.800 3276.700 ECU_ADDRESS 0xC000969A /end MEASUREMENT
/begin MEASUREMENT AirCtl_mDesBasHiAltdEOMQnt3_mp "" SWORD AirMassPerCyl 1 100 -3276.800 3276.700 ECU_ADDRESS 0xC000969C /end MEASUREMENT
/begin MEASUREMENT AirCtl_mDesBasHiAltd_mp "" SWORD AirMassPerCyl 1 100 -3276.800 3276.700 ECU_ADDRESS 0xC000969E /end MEASUREMENT
/begin MEASUREMENT AirCtl_mDesBasLPDef_mp "" SWORD AirMassPerCyl 1 100 -3276.800 3276.700 ECU_ADDRESS 0xC0009758 /end MEASUREMENT
/begin MEASUREMENT AirCtl_mDesBasLPHiAltdDef_mp "" SWORD AirMassPerCyl 1 100 -3276.800 3276.700 ECU_ADDRESS 0xC000975A /end MEASUREMENT
/begin MEASUREMENT AirCtl_mDesBasLPHiAltd_mp "" SWORD AirMassPerCyl 1 100 -3276.800 3276.700 ECU_ADDRESS 0xC000975C /end MEASUREMENT
/begin MEASUREMENT AirCtl_mDesBasLP_mp "" SWORD AirMassPerCyl 1 100 -3276.800 3276.700 ECU_ADDRESS 0xC000975E /end MEASUREMENT
/begin MEASUREMENT AirCtl_mDesConvBas_mp "" SWORD AirMassPerCyl 1 100 -3276.800 3276.700 ECU_ADDRESS 0xC00096A0 /end MEASUREMENT
/begin MEASUREMENT AirCtl_mDesConvEOM_mp "" SWORD AirMassPerCyl 1 100 -3276.800 3276.700 ECU_ADDRESS 0xC00096A2 /end MEASUREMENT
/begin MEASUREMENT AirCtl_mDesCorCalc1 "" SWORD AirMassPerCyl 1 100 -3276.800 3276.700 ECU_ADDRESS 0xD00005A4 /end MEASUREMENT
/begin MEASUREMENT AirCtl_mDesCorCalc2_mp "" SWORD AirMassPerCyl 1 100 -3276.800 3276.700 ECU_ADDRESS 0xC00096A4 /end MEASUREMENT
/begin MEASUREMENT AirCtl_mDesCorCalc3_mp "" SWORD AirMassPerCyl 1 100 -3276.800 3276.700 ECU_ADDRESS 0xC00096A6 /end MEASUREMENT
/begin MEASUREMENT AirCtl_mDesCorCalc4_mp "" SWORD AirMassPerCyl 1 100 -3276.800 3276.700 ECU_ADDRESS 0xC00096A8 /end MEASUREMENT
/begin MEASUREMENT AirCtl_mDesCor_mp "" SWORD AirMassPerCyl 1 100 -3276.800 3276.700 ECU_ADDRESS 0xC00096AA /end MEASUREMENT
/begin MEASUREMENT AirCtl_mDesDef_mp "" SWORD AirMassPerCyl 1 100 -3276.800 3276.700 ECU_ADDRESS 0xC00096AC /end MEASUREMENT
/begin MEASUREMENT AirCtl_mDesDyn_mp "" SWORD AirMassPerCyl 1 100 -3276.800 3276.700 ECU_ADDRESS 0xC00096AE /end MEASUREMENT
/begin MEASUREMENT AirCtl_mDesEGRClgBypLim_mp "" SWORD AirMassPerCyl 1 100 0.00 1500.000 ECU_ADDRESS 0xC00096B0 /end MEASUREMENT
/begin MEASUREMENT AirCtl_mDesEGRHighMCor_mp "" SWORD AirMassPerCyl 1 100 -3276.800 3276.700 ECU_ADDRESS 0xC00096B2 /end MEASUREMENT
/begin MEASUREMENT AirCtl_mDesGearEOM_mp "" SWORD AirMassPerCyl 1 100 -3276.800 3276.700 ECU_ADDRESS 0xC00096B4 /end MEASUREMENT
/begin MEASUREMENT AirCtl_mDesGearSwtEOM_mp "" SWORD AirMassPerCyl 1 100 -3276.800 3276.700 ECU_ADDRESS 0xC00096B6 /end MEASUREMENT
/begin MEASUREMENT AirCtl_mDesGearSwt_mp "" SWORD AirMassPerCyl 1 100 -3276.800 3276.700 ECU_ADDRESS 0xC00096B8 /end MEASUREMENT
/begin MEASUREMENT AirCtl_mDesGear_mp "" SWORD AirMassPerCyl 1 100 -3276.800 3276.700 ECU_ADDRESS 0xC00096BA /end MEASUREMENT
/begin MEASUREMENT AirCtl_mDesLPACCorRaw_mp "" SWORD AirMassPerCyl 1 100 -3276.800 3276.700 ECU_ADDRESS 0xC0009760 /end MEASUREMENT
/begin MEASUREMENT AirCtl_mDesLPACCor_mp "" SWORD AirMassPerCyl 1 100 -3276.800 3276.700 ECU_ADDRESS 0xC0009762 /end MEASUREMENT
/begin MEASUREMENT AirCtl_mDesLPAdd1_mp "" SWORD AirMassPerCyl 1 100 -3276.800 3276.700 ECU_ADDRESS 0xC0009764 /end MEASUREMENT
/begin MEASUREMENT AirCtl_mDesLPAdd2_mp "" SWORD AirMassPerCyl 1 100 -3276.800 3276.700 ECU_ADDRESS 0xC0009766 /end MEASUREMENT
/begin MEASUREMENT AirCtl_mDesLPAddGS_mp "" SWORD AirMassPerCyl 1 100 -3276.800 3276.700 ECU_ADDRESS 0xC0009768 /end MEASUREMENT
/begin MEASUREMENT AirCtl_mDesLPAddUnLim_mp "" SWORD AirMassPerCyl 1 100 -3276.800 3276.700 ECU_ADDRESS 0xC000976A /end MEASUREMENT
/begin MEASUREMENT AirCtl_mDesLPAdd_mp "" SWORD AirMassPerCyl 1 100 -3276.800 3276.700 ECU_ADDRESS 0xC000976C /end MEASUREMENT
/begin MEASUREMENT AirCtl_mDesLPClthBas_mp "" SWORD AirMassPerCyl 1 100 -3276.800 3276.700 ECU_ADDRESS 0xC000976E /end MEASUREMENT
/begin MEASUREMENT AirCtl_mDesLPCor2_mp "" SWORD AirMassPerCyl 1 100 -3276.800 3276.700 ECU_ADDRESS 0xC0009770 /end MEASUREMENT
/begin MEASUREMENT AirCtl_mDesLPDyn_mp "" SWORD AirMassPerCyl 1 100 -3276.800 3276.700 ECU_ADDRESS 0xC0009772 /end MEASUREMENT
/begin MEASUREMENT AirCtl_mDesLPGearCorRaw_mp "" SWORD AirMassPerCyl 1 100 -3276.800 3276.700 ECU_ADDRESS 0xC0009774 /end MEASUREMENT
/begin MEASUREMENT AirCtl_mDesLPGearCor_mp "" SWORD AirMassPerCyl 1 100 -3276.800 3276.700 ECU_ADDRESS 0xC0009776 /end MEASUREMENT
/begin MEASUREMENT AirCtl_mDesLPMax_mp "" SWORD AirMassPerCyl 1 100 -3276.800 3276.700 ECU_ADDRESS 0xC00098A2 /end MEASUREMENT
/begin MEASUREMENT AirCtl_mDesLPPil2Bas_mp "" SWORD AirMassPerCyl 1 100 -3276.800 3276.700 ECU_ADDRESS 0xC0009778 /end MEASUREMENT
/begin MEASUREMENT AirCtl_mDesLPStat_mp "" SWORD AirMassPerCyl 1 100 -3276.800 3276.700 ECU_ADDRESS 0xC000977A /end MEASUREMENT
/begin MEASUREMENT AirCtl_mDesLPStrgCorRaw_mp "" SWORD AirMassPerCyl 1 100 -3276.800 3276.700 ECU_ADDRESS 0xC000977C /end MEASUREMENT
/begin MEASUREMENT AirCtl_mDesLPStrgCor_mp "" SWORD AirMassPerCyl 1 100 -3276.800 3276.700 ECU_ADDRESS 0xC000977E /end MEASUREMENT
/begin MEASUREMENT AirCtl_mDesLPSum_mp "" SWORD AirMassPerCyl 1 100 -3276.800 3276.700 ECU_ADDRESS 0xC0009780 /end MEASUREMENT
/begin MEASUREMENT AirCtl_mDesLPVehVCor1_mp "" SWORD AirMassPerCyl 1 100 -3276.800 3276.700 ECU_ADDRESS 0xC0009782 /end MEASUREMENT
/begin MEASUREMENT AirCtl_mDesLPVehVCorRaw_mp "" SWORD AirMassPerCyl 1 100 -3276.800 3276.700 ECU_ADDRESS 0xC0009784 /end MEASUREMENT
/begin MEASUREMENT AirCtl_mDesLPVehVCor_mp "" SWORD AirMassPerCyl 1 100 -3276.800 3276.700 ECU_ADDRESS 0xC0009786 /end MEASUREMENT
/begin MEASUREMENT AirCtl_mDesMaxVal_mp "" SWORD AirMassPerCyl 1 100 -3276.800 3276.700 ECU_ADDRESS 0xC00096BC /end MEASUREMENT
/begin MEASUREMENT AirCtl_mDesMax_mp "" SWORD AirMassPerCyl 1 100 -3276.800 3276.700 ECU_ADDRESS 0xC0009874 /end MEASUREMENT
/begin MEASUREMENT AirCtl_mDesMinVal_mp "" SWORD AirMassPerCyl 1 100 -3276.800 3276.700 ECU_ADDRESS 0xC00096BE /end MEASUREMENT
/begin MEASUREMENT AirCtl_mDesPil2CorBas_mp "" SWORD AirMassPerCyl 1 100 -3276.800 3276.700 ECU_ADDRESS 0xC00096C0 /end MEASUREMENT
/begin MEASUREMENT AirCtl_mDesPil2CorEOM_mp "" SWORD AirMassPerCyl 1 100 -3276.800 3276.700 ECU_ADDRESS 0xC00096C2 /end MEASUREMENT
/begin MEASUREMENT AirCtl_mDesStat "" SWORD AirMassPerCyl 1 100 -3276.800 3276.700 ECU_ADDRESS 0xD00005A6 /end MEASUREMENT
/begin MEASUREMENT AirCtl_mDesStrgCorrEOM_mp "" SWORD AirMassPerCyl 1 100 -3276.800 3276.700 ECU_ADDRESS 0xC00096C4 /end MEASUREMENT
/begin MEASUREMENT AirCtl_mDesStrgCorrSwtEOM_mp "" SWORD AirMassPerCyl 1 100 -3276.800 3276.700 ECU_ADDRESS 0xC00096C6 /end MEASUREMENT
/begin MEASUREMENT AirCtl_mDesStrgCorrSwt_mp "" SWORD AirMassPerCyl 1 100 -3276.800 3276.700 ECU_ADDRESS 0xC00096C8 /end MEASUREMENT
/begin MEASUREMENT AirCtl_mDesStrgCorr_mp "" SWORD AirMassPerCyl 1 100 -3276.800 3276.700 ECU_ADDRESS 0xC00096CA /end MEASUREMENT
/begin MEASUREMENT AirCtl_mDesVal "" SWORD AirMassPerCyl 1 100 -3276.800 3276.700 ECU_ADDRESS 0xD00005AC /end MEASUREMENT
/begin MEASUREMENT AirCtl_mDesVal1Cor_mp "" SWORD AirMassPerCyl 1 100 -3276.800 3276.700 ECU_ADDRESS 0xC00096CC /end MEASUREMENT
/begin MEASUREMENT AirCtl_mDesVal1EOMQnt1_mp "" SWORD AirMassPerCyl 1 100 -3276.800 3276.700 ECU_ADDRESS 0xC00096CE /end MEASUREMENT
/begin MEASUREMENT AirCtl_mDesVal1EOMQnt2_mp "" SWORD AirMassPerCyl 1 100 -3276.800 3276.700 ECU_ADDRESS 0xC00096D0 /end MEASUREMENT
/begin MEASUREMENT AirCtl_mDesVal1EOMQnt3_mp "" SWORD AirMassPerCyl 1 100 -3276.800 3276.700 ECU_ADDRESS 0xC00096D2 /end MEASUREMENT
/begin MEASUREMENT AirCtl_mDesVal1_mp "" SWORD AirMassPerCyl 1 100 -3276.800 3276.700 ECU_ADDRESS 0xC00096D4 /end MEASUREMENT
/begin MEASUREMENT AirCtl_mDesVal2EOMQnt1_mp "" SWORD AirMassPerCyl 1 100 -3276.800 3276.700 ECU_ADDRESS 0xC00096D6 /end MEASUREMENT
/begin MEASUREMENT AirCtl_mDesVal2EOMQnt2_mp "" SWORD AirMassPerCyl 1 100 -3276.800 3276.700 ECU_ADDRESS 0xC00096D8 /end MEASUREMENT
/begin MEASUREMENT AirCtl_mDesVal2EOMQnt3_mp "" SWORD AirMassPerCyl 1 100 -3276.800 3276.700 ECU_ADDRESS 0xC00096DA /end MEASUREMENT
/begin MEASUREMENT AirCtl_mDesVal2_mp "" SWORD AirMassPerCyl 1 100 -3276.800 3276.700 ECU_ADDRESS 0xC00096DC /end MEASUREMENT
/begin MEASUREMENT AirCtl_mDesVal3EOMQnt1_mp "" SWORD AirMassPerCyl 1 100 -3276.800 3276.700 ECU_ADDRESS 0xC00096DE /end MEASUREMENT
/begin MEASUREMENT AirCtl_mDesVal3EOMQnt2_mp "" SWORD AirMassPerCyl 1 100 -3276.800 3276.700 ECU_ADDRESS 0xC00096E0 /end MEASUREMENT
/begin MEASUREMENT AirCtl_mDesVal3EOMQnt3_mp "" SWORD AirMassPerCyl 1 100 -3276.800 3276.700 ECU_ADDRESS 0xC00096E2 /end MEASUREMENT
/begin MEASUREMENT AirCtl_mDesVal3_mp "" SWORD AirMassPerCyl 1 100 -3276.800 3276.700 ECU_ADDRESS 0xC00096E4 /end MEASUREMENT
/begin MEASUREMENT AirCtl_mDesVal4EOMQnt1_mp "" SWORD AirMassPerCyl 1 100 -3276.800 3276.700 ECU_ADDRESS 0xC00096E6 /end MEASUREMENT
/begin MEASUREMENT AirCtl_mDesVal4EOMQnt2_mp "" SWORD AirMassPerCyl 1 100 -3276.800 3276.700 ECU_ADDRESS 0xC00096E8 /end MEASUREMENT
/begin MEASUREMENT AirCtl_mDesVal4EOMQnt3_mp "" SWORD AirMassPerCyl 1 100 -3276.800 3276.700 ECU_ADDRESS 0xC00096EA /end MEASUREMENT
/begin MEASUREMENT AirCtl_mDesVal4_mp "" SWORD AirMassPerCyl 1 100 -3276.800 3276.700 ECU_ADDRESS 0xC00096EC /end MEASUREMENT
/begin MEASUREMENT AirCtl_mDesVal5CorEOMQnt1_mp "" SWORD AirMassPerCyl 1 100 -3276.800 3276.700 ECU_ADDRESS 0xC00096EE /end MEASUREMENT
/begin MEASUREMENT AirCtl_mDesVal5CorEOMQnt2_mp "" SWORD AirMassPerCyl 1 100 -3276.800 3276.700 ECU_ADDRESS 0xC00096F0 /end MEASUREMENT
/begin MEASUREMENT AirCtl_mDesVal5CorEOMQnt3_mp "" SWORD AirMassPerCyl 1 100 -3276.800 3276.700 ECU_ADDRESS 0xC00096F2 /end MEASUREMENT
/begin MEASUREMENT AirCtl_mDesVal5Cor_mp "" SWORD AirMassPerCyl 1 100 -3276.800 3276.700 ECU_ADDRESS 0xC00096F4 /end MEASUREMENT
/begin MEASUREMENT AirCtl_mDesVal5EOMCor_mp "" SWORD AirMassPerCyl 1 100 -3276.800 3276.700 ARRAY_SIZE 3 ECU_ADDRESS 0xC000B6B4 /end MEASUREMENT
/begin MEASUREMENT AirCtl_mDesVal5EOMQnt1_mp "" SWORD AirMassPerCyl 1 100 -3276.800 3276.700 ECU_ADDRESS 0xC00096F6 /end MEASUREMENT
/begin MEASUREMENT AirCtl_mDesVal5EOMQnt2_mp "" SWORD AirMassPerCyl 1 100 -3276.800 3276.700 ECU_ADDRESS 0xC00096F8 /end MEASUREMENT
/begin MEASUREMENT AirCtl_mDesVal5EOMQnt3_mp "" SWORD AirMassPerCyl 1 100 -3276.800 3276.700 ECU_ADDRESS 0xC00096FA /end MEASUREMENT
/begin MEASUREMENT AirCtl_mDesVal5_mp "" SWORD AirMassPerCyl 1 100 -3276.800 3276.700 ECU_ADDRESS 0xC00096FC /end MEASUREMENT
/begin MEASUREMENT AirCtl_mDesValHPMix_mp "" SWORD AirMassPerCyl 1 100 -3276.800 3276.700 ECU_ADDRESS 0xC0009872 /end MEASUREMENT
/begin MEASUREMENT AirCtl_mDesValLP "" SWORD AirMassPerCyl 1 100 -3276.800 3276.700 ECU_ADDRESS 0xD00005B2 /end MEASUREMENT
/begin MEASUREMENT AirCtl_mDesValLP1Cor_mp "" SWORD AirMassPerCyl 1 100 -3276.800 3276.700 ECU_ADDRESS 0xC0009788 /end MEASUREMENT
/begin MEASUREMENT AirCtl_mDesValLP1Rmp_mp "" SWORD AirMassPerCyl 1 100 -3276.800 3276.700 ECU_ADDRESS 0xC000978A /end MEASUREMENT
/begin MEASUREMENT AirCtl_mDesValLP1_mp "" SWORD AirMassPerCyl 1 100 -3276.800 3276.700 ECU_ADDRESS 0xC000978C /end MEASUREMENT
/begin MEASUREMENT AirCtl_mDesValLP3_mp "" SWORD AirMassPerCyl 1 100 -3276.800 3276.700 ECU_ADDRESS 0xC000978E /end MEASUREMENT
/begin MEASUREMENT AirCtl_mDesValLP4_mp "" SWORD AirMassPerCyl 1 100 -3276.800 3276.700 ECU_ADDRESS 0xC0009790 /end MEASUREMENT
/begin MEASUREMENT AirCtl_mDesValLP5_mp "" SWORD AirMassPerCyl 1 100 -3276.800 3276.700 ECU_ADDRESS 0xC0009792 /end MEASUREMENT
/begin MEASUREMENT AirCtl_mDesValLPCust_mp "" SWORD AirMassPerCyl 1 100 -3276.800 3276.700 ECU_ADDRESS 0xC0009794 /end MEASUREMENT
/begin MEASUREMENT AirCtl_mDesValLPDef_mp "" SWORD AirMassPerCyl 1 100 -3276.800 3276.700 ECU_ADDRESS 0xC0009796 /end MEASUREMENT
/begin MEASUREMENT AirCtl_mDesValLPNrm_mp "" SWORD AirMassPerCyl 1 100 -3276.800 3276.700 ECU_ADDRESS 0xC0009798 /end MEASUREMENT
/begin MEASUREMENT AirCtl_mDesValNrm_mp "" SWORD AirMassPerCyl 1 100 -3276.800 3276.700 ECU_ADDRESS 0xC00096FE /end MEASUREMENT
/begin MEASUREMENT AirCtl_mDesValRaw "" SWORD AirMassPerCyl 1 100 -3276.800 3276.700 ECU_ADDRESS 0xD00005B4 /end MEASUREMENT
/begin MEASUREMENT AirCtl_mDesValUnLim1_mp "" SWORD AirMassPerCyl 1 100 -3276.800 3276.700 ECU_ADDRESS 0xC0009700 /end MEASUREMENT
/begin MEASUREMENT AirCtl_mDesValUnLim2_mp "" SWORD AirMassPerCyl 1 100 -3276.800 3276.700 ECU_ADDRESS 0xC0009702 /end MEASUREMENT
/begin MEASUREMENT AirCtl_mDesVal_mp "" SWORD AirMassPerCyl 1 100 -3276.800 3276.700 ECU_ADDRESS 0xC0009704 /end MEASUREMENT
/begin MEASUREMENT AirCtl_mDesVehCorrSwt_mp "" SWORD AirMassPerCyl 1 100 -3276.800 3276.700 ECU_ADDRESS 0xC0009706 /end MEASUREMENT
/begin MEASUREMENT AirCtl_mDesVehCorr_mp "" SWORD AirMassPerCyl 1 100 -3276.800 3276.700 ECU_ADDRESS 0xC0009708 /end MEASUREMENT
/begin MEASUREMENT AirCtl_mEGRDiff "" SWORD AirMassPerCyl 1 100 -3276.800 3276.700 ECU_ADDRESS 0xD00005B6 /end MEASUREMENT
/begin MEASUREMENT AirCtl_mEGRDs_mp "" SWORD AirMassPerCyl 1 100 -3276.800 3276.700 ECU_ADDRESS 0xC000970A /end MEASUREMENT
/begin MEASUREMENT AirCtl_mEngTempCor2_mp "" SWORD AirMassPerCyl 1 100 -3276.800 3276.700 ECU_ADDRESS 0xC000970C /end MEASUREMENT
/begin MEASUREMENT AirCtl_mEngTempCorBas2_mp "" SWORD AirMassPerCyl 1 100 -3276.800 3276.700 ECU_ADDRESS 0xC000970E /end MEASUREMENT
/begin MEASUREMENT AirCtl_mEngTempCorBasEOMQnt1_mp "" SWORD AirMassPerCyl 1 100 -3276.800 3276.700 ECU_ADDRESS 0xC0009710 /end MEASUREMENT
/begin MEASUREMENT AirCtl_mEngTempCorBasEOMQnt2_mp "" SWORD AirMassPerCyl 1 100 -3276.800 3276.700 ECU_ADDRESS 0xC0009712 /end MEASUREMENT
/begin MEASUREMENT AirCtl_mEngTempCorBasEOMQnt3_mp "" SWORD AirMassPerCyl 1 100 -3276.800 3276.700 ECU_ADDRESS 0xC0009714 /end MEASUREMENT
/begin MEASUREMENT AirCtl_mEngTempCorBas_mp "" SWORD AirMassPerCyl 1 100 -3276.800 3276.700 ECU_ADDRESS 0xC0009716 /end MEASUREMENT
/begin MEASUREMENT AirCtl_mEngTempCorEOMQnt1_mp "" SWORD AirMassPerCyl 1 100 -3276.800 3276.700 ECU_ADDRESS 0xC0009718 /end MEASUREMENT
/begin MEASUREMENT AirCtl_mEngTempCorEOMQnt2_mp "" SWORD AirMassPerCyl 1 100 -3276.800 3276.700 ECU_ADDRESS 0xC000971A /end MEASUREMENT
/begin MEASUREMENT AirCtl_mEngTempCorEOMQnt3_mp "" SWORD AirMassPerCyl 1 100 -3276.800 3276.700 ECU_ADDRESS 0xC000971C /end MEASUREMENT
/begin MEASUREMENT AirCtl_mEngTempCor_mp "" SWORD AirMassPerCyl 1 100 -3276.800 3276.700 ECU_ADDRESS 0xC000971E /end MEASUREMENT
/begin MEASUREMENT AirCtl_mEngTempLPCor2_mp "" SWORD AirMassPerCyl 1 100 -3276.800 3276.700 ECU_ADDRESS 0xC000979A /end MEASUREMENT
/begin MEASUREMENT AirCtl_mEngTempLPCorBas2_mp "" SWORD AirMassPerCyl 1 100 -3276.800 3276.700 ECU_ADDRESS 0xC000979C /end MEASUREMENT
/begin MEASUREMENT AirCtl_mEngTempLPCorBas_mp "" SWORD AirMassPerCyl 1 100 -3276.800 3276.700 ECU_ADDRESS 0xC000979E /end MEASUREMENT
/begin MEASUREMENT AirCtl_mEngTempLPCor_mp "" SWORD AirMassPerCyl 1 100 -3276.800 3276.700 ECU_ADDRESS 0xC00097A0 /end MEASUREMENT
/begin MEASUREMENT AirCtl_mGovDvt "" SWORD AirMassPerCyl 1 100 -3276.800 3276.700 ECU_ADDRESS 0xD00005BA /end MEASUREMENT
/begin MEASUREMENT AirCtl_mIntMnfDsRef_mp "" SWORD AirMassPerCyl 1 100 -3276.800 3276.700 ECU_ADDRESS 0xC0009720 /end MEASUREMENT
/begin MEASUREMENT AirCtl_mLIEgrLPCor_mp "" SWORD AirMassPerCyl 1 100 -3276.800 3276.700 ECU_ADDRESS 0xC00097A2 /end MEASUREMENT
/begin MEASUREMENT AirCtl_mMaxDesVal_mp "" SWORD AirMassPerCyl 1 100 -3276.800 3276.700 ECU_ADDRESS 0xC0009722 /end MEASUREMENT
/begin MEASUREMENT AirCtl_mMaxDvt "" SWORD AirMassPerCyl 1 100 -3276.800 3276.700 ECU_ADDRESS 0xD00005C0 /end MEASUREMENT
/begin MEASUREMENT AirCtl_mMaxDvt1EOM_mp "" SWORD AirMassPerCyl 1 100 -3276.800 3276.700 ECU_ADDRESS 0xC0009890 /end MEASUREMENT
/begin MEASUREMENT AirCtl_mMaxDvt1_mp "" SWORD AirMassPerCyl 1 100 -3276.800 3276.700 ECU_ADDRESS 0xC0009892 /end MEASUREMENT
/begin MEASUREMENT AirCtl_mMaxLPDvt "" SWORD AirMassPerCyl 1 100 -3276.800 3276.700 ECU_ADDRESS 0xD00005C6 /end MEASUREMENT
/begin MEASUREMENT AirCtl_mMinDesVal_mp "" SWORD AirMassPerCyl 1 100 -3276.800 3276.700 ECU_ADDRESS 0xC0009724 /end MEASUREMENT
/begin MEASUREMENT AirCtl_mMinDvt "" SWORD AirMassPerCyl 1 100 -3276.800 3276.700 ECU_ADDRESS 0xD00005C8 /end MEASUREMENT
/begin MEASUREMENT AirCtl_mMinDvt1EOM_mp "" SWORD AirMassPerCyl 1 100 -3276.800 3276.700 ECU_ADDRESS 0xC0009894 /end MEASUREMENT
/begin MEASUREMENT AirCtl_mMinDvt1_mp "" SWORD AirMassPerCyl 1 100 -3276.800 3276.700 ECU_ADDRESS 0xC0009896 /end MEASUREMENT
/begin MEASUREMENT AirCtl_mMinLPDvt "" SWORD AirMassPerCyl 1 100 -3276.800 3276.700 ECU_ADDRESS 0xD00005CE /end MEASUREMENT
/begin MEASUREMENT AirCtl_mTrmEOMCor_mp "" SWORD AirMassPerCyl 1 100 -3276.800 3276.700 ECU_ADDRESS 0xC0009726 /end MEASUREMENT
/begin MEASUREMENT AirCtl_mTrmEOM_mp "" SWORD AirMassPerCyl 1 100 -3276.800 3276.700 ECU_ADDRESS 0xC0009728 /end MEASUREMENT
/begin MEASUREMENT AirCtl_mTrmValNrm_mp "" SWORD AirMassPerCyl 1 100 -3276.800 3276.700 ECU_ADDRESS 0xC000972A /end MEASUREMENT
/begin MEASUREMENT AirCtl_mTrmVal_mp "" SWORD AirMassPerCyl 1 100 -3276.800 3276.700 ECU_ADDRESS 0xC000972C /end MEASUREMENT
/begin MEASUREMENT AirCtl_numEOMMode_mp "" UBYTE OneToOne 1 100 0.00 255.0 ECU_ADDRESS 0xC000B080 /end MEASUREMENT
/begin MEASUREMENT AirCtl_pBstPresLPRef_mp "" SWORD Pres_hPa 1 100 -32768.00 3500.00 ECU_ADDRESS 0xC00097A4 /end MEASUREMENT
/begin MEASUREMENT AirCtl_pBstPresRef_mp "" SWORD Pres_hPa 1 100 -32768.00 3500.00 ECU_ADDRESS 0xC000972E /end MEASUREMENT
/begin MEASUREMENT AirCtl_pFltPPFltDiff_mp "" SWORD Pres_hPa 1 100 -32768.00 3500.00 ECU_ADDRESS 0xC00097EA /end MEASUREMENT
/begin MEASUREMENT AirCtl_pRelCACDs_mp "" SWORD Pres_hPa 1 100 -32768.00 3500.00 ECU_ADDRESS 0xC00097EC /end MEASUREMENT
/begin MEASUREMENT AirCtl_qDesValInl_mp "" SWORD InjMass 1 100 -327.6800 327.6700 ECU_ADDRESS 0xC0009730 /end MEASUREMENT
/begin MEASUREMENT AirCtl_qDesVal_mp "" SWORD InjMass 1 100 -327.6800 327.6700 ECU_ADDRESS 0xC0009732 /end MEASUREMENT
/begin MEASUREMENT AirCtl_qGov_mp "" SWORD InjMass 1 100 -327.6800 327.6700 ECU_ADDRESS 0xC00097EE /end MEASUREMENT
/begin MEASUREMENT AirCtl_qHi_mp "" SWORD InjMass 1 100 -327.6800 327.6700 ECU_ADDRESS 0xC0009876 /end MEASUREMENT
/begin MEASUREMENT AirCtl_qLo_mp "" SWORD InjMass 1 100 -327.6800 327.6700 ECU_ADDRESS 0xC0009878 /end MEASUREMENT
/begin MEASUREMENT AirCtl_qLPHi_mp "" SWORD InjMass 1 100 -327.6800 327.6700 ECU_ADDRESS 0xC00098A4 /end MEASUREMENT
/begin MEASUREMENT AirCtl_qLPLo_mp "" SWORD InjMass 1 100 -327.6800 327.6700 ECU_ADDRESS 0xC00098A6 /end MEASUREMENT
/begin MEASUREMENT AirCtl_qSurgeHigh_mp "" SWORD InjMass 1 100 -327.6800 327.6700 ECU_ADDRESS 0xC0009898 /end MEASUREMENT
/begin MEASUREMENT AirCtl_qSurgeLow_mp "" SWORD InjMass 1 100 -327.6800 327.6700 ECU_ADDRESS 0xC000989A /end MEASUREMENT
/begin MEASUREMENT AirCtl_rBrkRmp_mp "" SWORD Prc 1 100 -400.0000 399.9878 ECU_ADDRESS 0xC000987A /end MEASUREMENT
/begin MEASUREMENT AirCtl_rCtlValLP_mp "" SWORD Prc 1 100 -400.0000 399.9878 ECU_ADDRESS 0xC0009860 /end MEASUREMENT
/begin MEASUREMENT AirCtl_rDiffDynMin_mp "" SWORD Prc 1 100 -400.0000 399.9878 ECU_ADDRESS 0xC00097F0 /end MEASUREMENT
/begin MEASUREMENT AirCtl_rDynMinEOM1_mp "" SWORD Prc 1 100 -400.0000 399.9878 ECU_ADDRESS 0xC00097F2 /end MEASUREMENT
/begin MEASUREMENT AirCtl_rDynMinNrm_mp "" SWORD Prc 1 100 -400.0000 399.9878 ECU_ADDRESS 0xC00097F4 /end MEASUREMENT
/begin MEASUREMENT AirCtl_rDynMin_mp "" SWORD Prc 1 100 -400.0000 399.9878 ECU_ADDRESS 0xC00097F6 /end MEASUREMENT
/begin MEASUREMENT AirCtl_rDynRmp_mp "" SWORD Prc 1 100 -400.0000 399.9878 ECU_ADDRESS 0xC00097F8 /end MEASUREMENT
/begin MEASUREMENT AirCtl_rEGR "" SWORD Prc 1 100 -400.0000 399.9878 ECU_ADDRESS 0xD00005F0 /end MEASUREMENT
/begin MEASUREMENT AirCtl_rEGRCorAltBasEOMQnt1_mp "" SWORD Prc 1 100 -400.0000 399.9878 ECU_ADDRESS 0xC00097FA /end MEASUREMENT
/begin MEASUREMENT AirCtl_rEGRCorAltBasEOMQnt2_mp "" SWORD Prc 1 100 -400.0000 399.9878 ECU_ADDRESS 0xC00097FC /end MEASUREMENT
/begin MEASUREMENT AirCtl_rEGRCorAltEOMQnt1_mp "" SWORD Prc 1 100 -400.0000 399.9878 ECU_ADDRESS 0xC00097FE /end MEASUREMENT
/begin MEASUREMENT AirCtl_rEGRCorAltEOMQnt2_mp "" SWORD Prc 1 100 -400.0000 399.9878 ECU_ADDRESS 0xC0009800 /end MEASUREMENT
/begin MEASUREMENT AirCtl_rEGREOMCor_mp "" SWORD Prc 1 100 -400.0000 399.9878 ECU_ADDRESS 0xC0009802 /end MEASUREMENT
/begin MEASUREMENT AirCtl_rEGREOMNrm_mp "" SWORD Prc 1 100 -400.0000 399.9878 ECU_ADDRESS 0xC0009804 /end MEASUREMENT
/begin MEASUREMENT AirCtl_rEGREOMQnt2_mp "" SWORD Prc 1 100 -400.0000 399.9878 ECU_ADDRESS 0xC0009806 /end MEASUREMENT
/begin MEASUREMENT AirCtl_rEGREOMQnt_mp "" SWORD Prc 1 100 -400.0000 399.9878 ECU_ADDRESS 0xC0009808 /end MEASUREMENT
/begin MEASUREMENT AirCtl_rEGREOM_mp "" SWORD Prc 1 100 -400.0000 399.9878 ECU_ADDRESS 0xC000980A /end MEASUREMENT
/begin MEASUREMENT AirCtl_rEGRHPPosDes "" SWORD Prc 1 100 -400.0000 399.9878 ECU_ADDRESS 0xD00005F2 /end MEASUREMENT
/begin MEASUREMENT AirCtl_rEGRInv_mp "" SWORD Prc 1 100 -400.0000 399.9878 ECU_ADDRESS 0xC000980C /end MEASUREMENT
/begin MEASUREMENT AirCtl_rEGRNrmEOM_mp "" SWORD Prc 1 100 -400.0000 399.9878 ECU_ADDRESS 0xC000980E /end MEASUREMENT
/begin MEASUREMENT AirCtl_rEGR_mp "" SWORD Prc 1 100 -400.0000 399.9878 ECU_ADDRESS 0xC0009810 /end MEASUREMENT
/begin MEASUREMENT AirCtl_rEOMBgnInit_mp "" SWORD Prc 1 100 -400.0000 399.9878 ECU_ADDRESS 0xC0009812 /end MEASUREMENT
/begin MEASUREMENT AirCtl_rEOMEndInit_mp "" SWORD Prc 1 100 -400.0000 399.9878 ECU_ADDRESS 0xC0009814 /end MEASUREMENT
/begin MEASUREMENT AirCtl_rGovDvtNrm "" SWORD Prc 1 100 -400.0000 399.9878 ECU_ADDRESS 0xD00005F4 /end MEASUREMENT
/begin MEASUREMENT AirCtl_rGovDynMin2_mp "" SWORD Prc 1 100 -400.0000 399.9878 ECU_ADDRESS 0xC0009816 /end MEASUREMENT
/begin MEASUREMENT AirCtl_rGovDynMinEOM1_mp "" SWORD Prc 1 100 -400.0000 399.9878 ECU_ADDRESS 0xC0009818 /end MEASUREMENT
/begin MEASUREMENT AirCtl_rGovDynMinNrm_mp "" SWORD Prc 1 100 -400.0000 399.9878 ECU_ADDRESS 0xC000981A /end MEASUREMENT
/begin MEASUREMENT AirCtl_rGovDynMin_mp "" SWORD Prc 1 100 -400.0000 399.9878 ECU_ADDRESS 0xC000981C /end MEASUREMENT
/begin MEASUREMENT AirCtl_rGovEGR "" SWORD Prc 1 100 -400.0000 399.9878 ECU_ADDRESS 0xD00005FA /end MEASUREMENT
/begin MEASUREMENT AirCtl_rGovEGRNrm_mp "" SWORD Prc 1 100 -400.0000 399.9878 ECU_ADDRESS 0xC000981E /end MEASUREMENT
/begin MEASUREMENT AirCtl_rGovEGR_mp "" SWORD Prc 1 100 -400.0000 399.9878 ECU_ADDRESS 0xC0009820 /end MEASUREMENT
/begin MEASUREMENT AirCtl_rGovLPDvtNrm "" SWORD Prc 1 100 -400.0000 399.9878 ECU_ADDRESS 0xD0000600 /end MEASUREMENT
/begin MEASUREMENT AirCtl_rGovLPEGR "" SWORD Prc 1 100 -400.0000 399.9878 ECU_ADDRESS 0xD0000602 /end MEASUREMENT
/begin MEASUREMENT AirCtl_rGovLPMin_mp "" SWORD Prc 1 100 -400.0000 399.9878 ECU_ADDRESS 0xC0009862 /end MEASUREMENT
/begin MEASUREMENT AirCtl_rGovMinDyn1_mp "" SWORD Prc 1 100 -400.0000 399.9878 ECU_ADDRESS 0xC0009822 /end MEASUREMENT
/begin MEASUREMENT AirCtl_rGovMin_mp "" SWORD Prc 1 100 -400.0000 399.9878 ECU_ADDRESS 0xC0009824 /end MEASUREMENT
/begin MEASUREMENT AirCtl_rGovOutLPUnLimCor_mp "" SWORD Prc 1 100 -400.0000 399.9878 ECU_ADDRESS 0xC0009864 /end MEASUREMENT
/begin MEASUREMENT AirCtl_rGovOutLPUnLim_mp "" SWORD Prc 1 100 -400.0000 399.9878 ECU_ADDRESS 0xC0009866 /end MEASUREMENT
/begin MEASUREMENT AirCtl_rGovOutLP_mp "" SWORD Prc 1 100 -400.0000 399.9878 ECU_ADDRESS 0xC0009868 /end MEASUREMENT
/begin MEASUREMENT AirCtl_rGovOutUnLimCor_mp "" SWORD Prc 1 100 -400.0000 399.9878 ECU_ADDRESS 0xC0009826 /end MEASUREMENT
/begin MEASUREMENT AirCtl_rGovOutUnLim_mp "" SWORD Prc 1 100 -400.0000 399.9878 ECU_ADDRESS 0xC0009828 /end MEASUREMENT
/begin MEASUREMENT AirCtl_rGovOut_mp "" SWORD Prc 1 100 -400.0000 399.9878 ECU_ADDRESS 0xC000982A /end MEASUREMENT
/begin MEASUREMENT AirCtl_rGovTVA "" SWORD Prc 1 100 -400.0000 399.9878 ECU_ADDRESS 0xD0000604 /end MEASUREMENT
/begin MEASUREMENT AirCtl_rGovTVANrm_mp "" SWORD Prc 1 100 -400.0000 399.9878 ECU_ADDRESS 0xC000982C /end MEASUREMENT
/begin MEASUREMENT AirCtl_rOutD_mp "" SWORD Prc 1 100 -400.0000 399.9878 ECU_ADDRESS 0xC000982E /end MEASUREMENT
/begin MEASUREMENT AirCtl_rOutI_mp "" SWORD Prc 1 100 -400.0000 399.9878 ECU_ADDRESS 0xC0009830 /end MEASUREMENT
/begin MEASUREMENT AirCtl_rOutLpI_mp "" SWORD Prc 1 100 -400.0000 399.9878 ECU_ADDRESS 0xC000986A /end MEASUREMENT
/begin MEASUREMENT AirCtl_rOutLpP_mp "" SWORD Prc 1 100 -400.0000 399.9878 ECU_ADDRESS 0xC000986C /end MEASUREMENT
/begin MEASUREMENT AirCtl_rOutP_mp "" SWORD Prc 1 100 -400.0000 399.9878 ECU_ADDRESS 0xC0009832 /end MEASUREMENT
/begin MEASUREMENT AirCtl_rPCRCorDiff_mp "" SWORD Prc 1 100 -400.0000 399.9878 ECU_ADDRESS 0xC0009834 /end MEASUREMENT
/begin MEASUREMENT AirCtl_rPCRCtl_mp "" SWORD Prc 1 100 -400.0000 399.9878 ECU_ADDRESS 0xC0009836 /end MEASUREMENT
/begin MEASUREMENT AirCtl_rPCRDiffCoupling "" SWORD Prc 1 100 -400.0000 399.9878 ECU_ADDRESS 0xD000060A /end MEASUREMENT
/begin MEASUREMENT AirCtl_rPIDCtlLP_mp "" SWORD Prc 1 100 -400.0000 399.9878 ECU_ADDRESS 0xC000986E /end MEASUREMENT
/begin MEASUREMENT AirCtl_rPIDCtl_mp "" SWORD Prc 1 100 -400.0000 399.9878 ECU_ADDRESS 0xC0009838 /end MEASUREMENT
/begin MEASUREMENT AirCtl_rSurgeHigh_mp "" SWORD Prc 1 100 -400.0000 399.9878 ECU_ADDRESS 0xC000989C /end MEASUREMENT
/begin MEASUREMENT AirCtl_rSurgeLow_mp "" SWORD Prc 1 100 -400.0000 399.9878 ECU_ADDRESS 0xC000989E /end MEASUREMENT
/begin MEASUREMENT AirCtl_rSurgeOfs_mp "" SWORD Prc 1 100 -400.0000 399.9878 ECU_ADDRESS 0xC00098A0 /end MEASUREMENT
/begin MEASUREMENT AirCtl_rTVACtlATCor_mp "" SWORD Prc 1 100 -400.0000 399.9878 ECU_ADDRESS 0xC000983A /end MEASUREMENT
/begin MEASUREMENT AirCtl_rTVACtlBasOvrRun_mp "" SWORD Prc 1 100 -400.0000 399.9878 ECU_ADDRESS 0xC000983C /end MEASUREMENT
/begin MEASUREMENT AirCtl_rTVACtlBas_mp "" SWORD Prc 1 100 -400.0000 399.9878 ECU_ADDRESS 0xC000983E /end MEASUREMENT
/begin MEASUREMENT AirCtl_rTVACtlCTCor_mp "" SWORD Prc 1 100 -400.0000 399.9878 ECU_ADDRESS 0xC0009840 /end MEASUREMENT
/begin MEASUREMENT AirCtl_rTVACtlEnvPCor_mp "" SWORD Prc 1 100 -400.0000 399.9878 ECU_ADDRESS 0xC0009842 /end MEASUREMENT
/begin MEASUREMENT AirCtl_rTVACtlMax_mp "" SWORD Prc 1 100 -400.0000 399.9878 ECU_ADDRESS 0xC0009844 /end MEASUREMENT
/begin MEASUREMENT AirCtl_rTVACtlOvrRun_mp "" SWORD Prc 1 100 -400.0000 399.9878 ECU_ADDRESS 0xC0009846 /end MEASUREMENT
/begin MEASUREMENT AirCtl_rTVACtlSum_mp "" SWORD Prc 1 100 -400.0000 399.9878 ECU_ADDRESS 0xC0009848 /end MEASUREMENT
/begin MEASUREMENT AirCtl_rTVACtl_mp "" SWORD Prc 1 100 -400.0000 399.9878 ECU_ADDRESS 0xC000984A /end MEASUREMENT
/begin MEASUREMENT AirCtl_rTVAEOMCor_mp "" SWORD Prc 1 100 -400.0000 399.9878 ECU_ADDRESS 0xC000984C /end MEASUREMENT
/begin MEASUREMENT AirCtl_rTVAEOM_mp "" SWORD Prc 1 100 -400.0000 399.9878 ECU_ADDRESS 0xC000984E /end MEASUREMENT
/begin MEASUREMENT AirCtl_rTVA_mp "" SWORD Prc 1 100 -400.0000 399.9878 ECU_ADDRESS 0xC0009850 /end MEASUREMENT
/begin MEASUREMENT AirCtl_stAirCtlBits "" ULONG OneToOne 1 100 0.00 4294967295.00 ECU_ADDRESS 0xD0003088 /end MEASUREMENT
/begin MEASUREMENT AirCtl_stAirCtlLPBits_mp "" ULONG OneToOne 1 100 0.00 4294967295.00 ECU_ADDRESS 0xC0008C34 /end MEASUREMENT
/begin MEASUREMENT AirCtl_stAirDyn "" UBYTE OneToOne 1 100 0.00 255.0 ECU_ADDRESS 0xD0001BFA /end MEASUREMENT
/begin MEASUREMENT AirCtl_stBitMskEOM_mp "" ULONG OneToOne 1 100 0.00 4294967295.00 ECU_ADDRESS 0xC0008C24 /end MEASUREMENT
/begin MEASUREMENT AirCtl_stDebDefLP_mp "" UBYTE OneToOne 1 100 0.00 255.0 ECU_ADDRESS 0xC000B088 /end MEASUREMENT
/begin MEASUREMENT AirCtl_stDebDef_mp "" UBYTE OneToOne 1 100 0.00 255.0 ECU_ADDRESS 0xC000B081 /end MEASUREMENT
/begin MEASUREMENT AirCtl_stDesChkLP_mp "" UBYTE OneToOne 1 100 0.00 255.0 ECU_ADDRESS 0xC000B089 /end MEASUREMENT
/begin MEASUREMENT AirCtl_stDesChk_mp "" UBYTE OneToOne 1 100 0.00 255.0 ECU_ADDRESS 0xC000B082 /end MEASUREMENT
/begin MEASUREMENT AirCtl_stDesEOM "" UBYTE OneToOne 1 100 0.00 255.0 ECU_ADDRESS 0xD0001BFB /end MEASUREMENT
/begin MEASUREMENT AirCtl_stDesValEOMLim_mp "" UBYTE OneToOne 1 100 0.00 255.0 ECU_ADDRESS 0xC000B07A /end MEASUREMENT
/begin MEASUREMENT AirCtl_stDyn_mp "" UBYTE OneToOne 1 100 0.00 255.0 ECU_ADDRESS 0xC000B07B /end MEASUREMENT
/begin MEASUREMENT AirCtl_stEGRHPMixActv "" UBYTE OneToOne 1 100 0.00 255.0 ECU_ADDRESS 0xD0001BFE /end MEASUREMENT
/begin MEASUREMENT AirCtl_stEGRHPMixActvCond_mp "" UBYTE OneToOne 1 100 0.00 255.0 ECU_ADDRESS 0xC000B07F /end MEASUREMENT
/begin MEASUREMENT AirCtl_stEOMDesVal_mp "" ULONG OneToOne 1 100 0.00 4294967295.00 ECU_ADDRESS 0xC0008C00 /end MEASUREMENT
/begin MEASUREMENT AirCtl_stEOMMon "" ULONG OneToOne 1 100 0.00 4294967295.00 ECU_ADDRESS 0xD000308C /end MEASUREMENT
/begin MEASUREMENT AirCtl_stGov "" UBYTE OneToOne 1 100 0.00 255.0 ECU_ADDRESS 0xD0001BFF /end MEASUREMENT
/begin MEASUREMENT AirCtl_stGovDvtMonEna_mp "" SWORD OneToOne 1 100 -32768.00 32767.00 ECU_ADDRESS 0xC000987C /end MEASUREMENT
/begin MEASUREMENT AirCtl_stGovDvtNegMonEna "" UBYTE OneToOne 1 100 0.00 255.0 ECU_ADDRESS 0xD0001C02 /end MEASUREMENT
/begin MEASUREMENT AirCtl_stGovLP "" UBYTE OneToOne 1 100 0.00 255.0 ECU_ADDRESS 0xD0001C03 /end MEASUREMENT
/begin MEASUREMENT AirCtl_stGovLPDvtMonEna_mp "" UBYTE OneToOne 1 100 0.00 255.0 ECU_ADDRESS 0xC000B08A /end MEASUREMENT
/begin MEASUREMENT AirCtl_stGovMin_mp "" UBYTE OneToOne 1 100 0.00 255.0 ECU_ADDRESS 0xC000B07C /end MEASUREMENT
/begin MEASUREMENT AirCtl_stHealDef_mp "" UBYTE OneToOne 1 100 0.00 255.0 ECU_ADDRESS 0xC000B083 /end MEASUREMENT
/begin MEASUREMENT AirCtl_stHealLPDef_mp "" UBYTE OneToOne 1 100 0.00 255.0 ECU_ADDRESS 0xC000B08B /end MEASUREMENT
/begin MEASUREMENT AirCtl_stMaxDvt_mp "" UBYTE OneToOne 1 100 0.00 255.0 ECU_ADDRESS 0xC000B084 /end MEASUREMENT
/begin MEASUREMENT AirCtl_stMaxLPDvt_mp "" UBYTE OneToOne 1 100 0.00 255.0 ECU_ADDRESS 0xC000B08C /end MEASUREMENT
/begin MEASUREMENT AirCtl_stMinDvt_mp "" UBYTE OneToOne 1 100 0.00 255.0 ECU_ADDRESS 0xC000B085 /end MEASUREMENT
/begin MEASUREMENT AirCtl_stMinLPDvt_mp "" UBYTE OneToOne 1 100 0.00 255.0 ECU_ADDRESS 0xC000B08D /end MEASUREMENT
/begin MEASUREMENT AirCtl_stMon "" UBYTE OneToOne 1 100 0.00 255.0 ECU_ADDRESS 0xD0001C04 /end MEASUREMENT
/begin MEASUREMENT AirCtl_stMonBits_mp "" ULONG OneToOne 1 100 0.00 4294967295.00 ECU_ADDRESS 0xC0008C28 /end MEASUREMENT
/begin MEASUREMENT AirCtl_stMonLP "" UBYTE OneToOne 1 100 0.00 255.0 ECU_ADDRESS 0xD0001C07 /end MEASUREMENT
/begin MEASUREMENT AirCtl_stMonLPBits_mp "" ULONG OneToOne 1 100 0.00 4294967295.00 ECU_ADDRESS 0xC0008C30 /end MEASUREMENT
/begin MEASUREMENT AirCtl_stMonLPNoDeb "" UBYTE OneToOne 1 100 0.00 255.0 ECU_ADDRESS 0xD0001C08 /end MEASUREMENT
/begin MEASUREMENT AirCtl_stMonOffBrkRep_mp "" UBYTE OneToOne 1 100 0.00 255.0 ECU_ADDRESS 0xC000B086 /end MEASUREMENT
/begin MEASUREMENT AirCtl_stMonOffNegDev_mp "" UBYTE OneToOne 1 100 0.00 255.0 ECU_ADDRESS 0xC000B087 /end MEASUREMENT
/begin MEASUREMENT AirCtl_stSelBitMskEOM_mp "" ULONG OneToOne 1 100 0.00 4294967295.00 ECU_ADDRESS 0xC0008C2C /end MEASUREMENT
/begin MEASUREMENT AirCtl_stTVACtlOvrRunActv_mp "" UBYTE OneToOne 1 100 0.00 255.0 ECU_ADDRESS 0xC000B07D /end MEASUREMENT
/begin MEASUREMENT AirCtl_stTVACtlOvrRun_mp "" UBYTE OneToOne 1 100 0.00 255.0 ECU_ADDRESS 0xC000B07E /end MEASUREMENT
/begin MEASUREMENT AirCtl_swtAirTempCor "" UBYTE OneToOne 1 100 0.00 255.0 ECU_ADDRESS 0xD0001C09 /end MEASUREMENT
/begin MEASUREMENT AirCtl_swtEGRLPActv "" UBYTE OneToOne 1 100 0.00 255.0 ECU_ADDRESS 0xD0001C0A /end MEASUREMENT
/begin MEASUREMENT AirCtl_swtGov "" UBYTE OneToOne 1 100 0.00 255.0 ECU_ADDRESS 0xD0001C0B /end MEASUREMENT
/begin MEASUREMENT AirCtl_swtGovEna "" UBYTE OneToOne 1 100 0.00 255.0 ECU_ADDRESS 0xD0001C0C /end MEASUREMENT
/begin MEASUREMENT AirCtl_swtGovLPEna "" UBYTE OneToOne 1 100 0.00 255.0 ECU_ADDRESS 0xD0001C0D /end MEASUREMENT
/begin MEASUREMENT AirCtl_tAirDesValLP_mp "" SWORD Temp_Cels 1 100 -3549.940 3003.560 ECU_ADDRESS 0xC00097A6 /end MEASUREMENT
/begin MEASUREMENT AirCtl_tAirDesVal_mp "" SWORD Temp_Cels 1 100 -3549.940 3003.560 ECU_ADDRESS 0xC0009734 /end MEASUREMENT
/begin MEASUREMENT AirCtl_tAirGovLP_mp "" SWORD Temp_Cels 1 100 -3549.940 3003.560 ECU_ADDRESS 0xC0009870 /end MEASUREMENT
/begin MEASUREMENT AirCtl_tAirGov_mp "" SWORD Temp_Cels 1 100 -3549.940 3003.560 ECU_ADDRESS 0xC0009852 /end MEASUREMENT
/begin MEASUREMENT AirCtl_tAirMonLP_mp "" SWORD Temp_Cels 1 100 -3549.940 3003.560 ECU_ADDRESS 0xC00098A8 /end MEASUREMENT
/begin MEASUREMENT AirCtl_tAirMon_mp "" SWORD Temp_Cels 1 100 -3549.940 3003.560 ECU_ADDRESS 0xC000987E /end MEASUREMENT
/begin MEASUREMENT AirCtl_tEngDesValLP_mp "" SWORD Temp_Cels 1 100 -3549.940 3003.560 ECU_ADDRESS 0xC00097A8 /end MEASUREMENT
/begin MEASUREMENT AirCtl_tEngDesVal_mp "" SWORD Temp_Cels 1 100 -3549.940 3003.560 ECU_ADDRESS 0xC0009736 /end MEASUREMENT
/begin MEASUREMENT AirCtl_tEngMonLP_mp "" SWORD Temp_Cels 1 100 -3549.940 3003.560 ECU_ADDRESS 0xC00098AA /end MEASUREMENT
/begin MEASUREMENT AirCtl_tEngMon_mp "" SWORD Temp_Cels 1 100 -3549.940 3003.560 ECU_ADDRESS 0xC0009880 /end MEASUREMENT
/begin MEASUREMENT AirCtl_tiAFSPT1Nrm_mp "" SLONG TimeDelay_ms 1 100 0.0020000000009 4294967.2960 FORMAT "%12.4" ECU_ADDRESS 0xC0008C20 /end MEASUREMENT
/begin MEASUREMENT AirCtl_tiAFSPT1_mp "" SWORD TimeDelay_ms_Lin_16 1 100 -20000.61 20000.00 FORMAT "%8.2" ECU_ADDRESS 0xC0009854 /end MEASUREMENT
/begin MEASUREMENT AirCtl_tiCldStrtLP_mp "" UWORD Time_ms 1 100 0.00 655350.0 ECU_ADDRESS 0xC00098AC /end MEASUREMENT
/begin MEASUREMENT AirCtl_tiCldStrt_mp "" UWORD Time_ms 1 100 0.00 655350.0 ECU_ADDRESS 0xC0009882 /end MEASUREMENT
/begin MEASUREMENT AirCtl_tiMonEOM_mp "" SWORD TimeDeb 1 100 -327680.0 327670.0 ECU_ADDRESS 0xC0009884 /end MEASUREMENT
/begin MEASUREMENT AirCtl_trqDesValInl_mp "" SWORD Trq 1 100 -3276.800 3276.700 ECU_ADDRESS 0xC0009738 /end MEASUREMENT
/begin MEASUREMENT AirCtl_trqHi_mp "" SWORD Trq 1 100 -3276.800 3276.700 ECU_ADDRESS 0xC0009886 /end MEASUREMENT
/begin MEASUREMENT AirCtl_trqLo_mp "" SWORD Trq 1 100 -3276.800 3276.700 ECU_ADDRESS 0xC0009888 /end MEASUREMENT
/begin MEASUREMENT AirSys_dRED1_mp "" SWORD SlopeRes10 1 100 -3276.800 3276.700 FORMAT "%8.3" ECU_ADDRESS 0xC00098AE /end MEASUREMENT
/begin MEASUREMENT AirSys_dRED2_mp "" SWORD SlopeRes10 1 100 -3276.800 3276.700 FORMAT "%8.3" ECU_ADDRESS 0xC00098B0 /end MEASUREMENT
/begin MEASUREMENT AirSys_GetAbrtReason_mp "" UBYTE OneToOne 1 100 0.00 255.0 ECU_ADDRESS 0xC000B08E /end MEASUREMENT
/begin MEASUREMENT AirSys_GetSt_mp "" UBYTE OneToOne 1 100 0.00 255.0 ECU_ADDRESS 0xC000B08F /end MEASUREMENT
/begin MEASUREMENT AirSys_mLBer1_mp "" SLONG AirMassPerTime 1 100 -214748364.800 214748364.700 ECU_ADDRESS 0xC0008C38 /end MEASUREMENT
/begin MEASUREMENT AirSys_mLBer2_mp "" SLONG AirMassPerTime 1 100 -214748364.800 214748364.700 ECU_ADDRESS 0xC0008C3C /end MEASUREMENT
/begin MEASUREMENT AirSys_mLHFM1_mp "" SLONG AirMassPerTime 1 100 -214748364.800 214748364.700 ECU_ADDRESS 0xC0008C40 /end MEASUREMENT
/begin MEASUREMENT AirSys_mLHFM2_mp "" SLONG AirMassPerTime 1 100 -214748364.800 214748364.700 ECU_ADDRESS 0xC0008C44 /end MEASUREMENT
/begin MEASUREMENT AirSys_mLM10_mp "" SLONG AirMassPerTime 1 100 -214748364.800 214748364.700 ECU_ADDRESS 0xC0008C48 /end MEASUREMENT
/begin MEASUREMENT AirSys_mLM11_mp "" SLONG AirMassPerTime 1 100 -214748364.800 214748364.700 ECU_ADDRESS 0xC0008C4C /end MEASUREMENT
/begin MEASUREMENT AirSys_mLM12_mp "" SLONG AirMassPerTime 1 100 -214748364.800 214748364.700 ECU_ADDRESS 0xC0008C50 /end MEASUREMENT
/begin MEASUREMENT AirSys_mLM13_mp "" SLONG AirMassPerTime 1 100 -214748364.800 214748364.700 ECU_ADDRESS 0xC0008C54 /end MEASUREMENT
/begin MEASUREMENT AirSys_mLM20_mp "" SLONG AirMassPerTime 1 100 -214748364.800 214748364.700 ECU_ADDRESS 0xC0008C58 /end MEASUREMENT
/begin MEASUREMENT AirSys_mLM21_mp "" SLONG AirMassPerTime 1 100 -214748364.800 214748364.700 ECU_ADDRESS 0xC0008C5C /end MEASUREMENT
/begin MEASUREMENT AirSys_mLM22_mp "" SLONG AirMassPerTime 1 100 -214748364.800 214748364.700 ECU_ADDRESS 0xC0008C60 /end MEASUREMENT
/begin MEASUREMENT AirSys_nDes_mp "" UWORD EngN 1 100 0.00 32767.50 ECU_ADDRESS 0xC00098B2 /end MEASUREMENT
/begin MEASUREMENT AirSys_p21max1_mp "" SWORD Pres_hPa 1 100 -32768.00 3500.00 ECU_ADDRESS 0xC00098B4 /end MEASUREMENT
/begin MEASUREMENT AirSys_p21max2_mp "" SWORD Pres_hPa 1 100 -32768.00 3500.00 ECU_ADDRESS 0xC00098B6 /end MEASUREMENT
/begin MEASUREMENT AirSys_pDesValTst "" UWORD OneToOne 1 100 0.00 65535.00 ECU_ADDRESS 0xD00014D8 /end MEASUREMENT
/begin MEASUREMENT AirSys_rDIFF1_mp "" SWORD SlopeRes10 1 100 -3276.800 3276.700 FORMAT "%8.3" ECU_ADDRESS 0xC00098B8 /end MEASUREMENT
/begin MEASUREMENT AirSys_rDIFF2_mp "" SWORD SlopeRes10 1 100 -3276.800 3276.700 FORMAT "%8.3" ECU_ADDRESS 0xC00098BA /end MEASUREMENT
/begin MEASUREMENT AirSys_rLverh1_mp "" SWORD SlopeRes100 1 100 -327.6800 327.6700 FORMAT "%8.4" ECU_ADDRESS 0xC0008C64 /end MEASUREMENT
/begin MEASUREMENT AirSys_rLverh2_mp "" SWORD SlopeRes100 1 100 -327.6800 327.6700 FORMAT "%8.4" ECU_ADDRESS 0xC00098BC /end MEASUREMENT
/begin MEASUREMENT AirSys_rRED10_mp "" SWORD OneToOne 1 100 -32768.00 32767.00 ECU_ADDRESS 0xC00098BE /end MEASUREMENT
/begin MEASUREMENT AirSys_rRED11_mp "" SWORD SlopeRes10 1 100 -3276.800 3276.700 FORMAT "%8.3" ECU_ADDRESS 0xC00098C0 /end MEASUREMENT
/begin MEASUREMENT AirSys_rRED12_mp "" SWORD SlopeRes10 1 100 -3276.800 3276.700 FORMAT "%8.3" ECU_ADDRESS 0xC00098C2 /end MEASUREMENT
/begin MEASUREMENT AirSys_rRED13_mp "" SWORD SlopeRes10 1 100 -3276.800 3276.700 FORMAT "%8.3" ECU_ADDRESS 0xC00098C4 /end MEASUREMENT
/begin MEASUREMENT AirSys_rRED20_mp "" SWORD OneToOne 1 100 -32768.00 32767.00 ECU_ADDRESS 0xC00098C6 /end MEASUREMENT
/begin MEASUREMENT AirSys_rRED21_mp "" SWORD SlopeRes10 1 100 -3276.800 3276.700 FORMAT "%8.3" ECU_ADDRESS 0xC00098C8 /end MEASUREMENT
/begin MEASUREMENT AirSys_rRED22_mp "" SWORD SlopeRes10 1 100 -3276.800 3276.700 FORMAT "%8.3" ECU_ADDRESS 0xC00098CA /end MEASUREMENT
/begin MEASUREMENT AirSys_stpDesValSysTst "" UBYTE OneToOne 1 100 0.00 255.0 ECU_ADDRESS 0xD0001C0E /end MEASUREMENT
/begin MEASUREMENT AirSys_ststateSysTst_mp "" UBYTE OneToOne 1 100 0.00 255.0 ECU_ADDRESS 0xC000B090 /end MEASUREMENT
/begin MEASUREMENT AirSys_stsubstateSysTst_mp "" UBYTE OneToOne 1 100 0.00 255.0 ECU_ADDRESS 0xC000B091 /end MEASUREMENT
/begin MEASUREMENT AirSys_stSysTst "" ULONG OneToOne 1 100 0.00 4294967295.00 ECU_ADDRESS 0xD0003098 /end MEASUREMENT
/begin MEASUREMENT AirSys_tFld "Temperaturfeld Ansaugtrakt" SWORD Temp_Cels 1 100 -3549.940 3003.560 ARRAY_SIZE 4 ECU_ADDRESS 0xD0000624 /end MEASUREMENT
/begin MEASUREMENT AltIO_iLim "" SWORD AltCrntLim_A_q0p25_COMPU 1 100 -8192.000 8191.750 FORMAT "%8.3" ECU_ADDRESS 0xD000064E /end MEASUREMENT
/begin MEASUREMENT AltIO_iOut "" SWORD AltCrntOut_A_q0p125_COMPU 1 100 -4096.000 4095.875 FORMAT "%8.3" ECU_ADDRESS 0xD0000650 /end MEASUREMENT
/begin MEASUREMENT AltIO_numAltTyp "" UBYTE OneToOne 1 100 0.00 255.0 ECU_ADDRESS 0xD0001C10 /end MEASUREMENT
/begin MEASUREMENT AltIO_numChpVers "" UBYTE OneToOne 1 100 0.00 255.0 ECU_ADDRESS 0xD0001C11 /end MEASUREMENT
/begin MEASUREMENT AltIO_numGovTyp "" UBYTE OneToOne 1 100 0.00 255.0 ECU_ADDRESS 0xD0001C12 /end MEASUREMENT
/begin MEASUREMENT AltIO_numLdRng "" UBYTE OneToOne 1 100 0.00 255.0 ECU_ADDRESS 0xD0001C13 /end MEASUREMENT
/begin MEASUREMENT AltIO_numMnfcCod "" UBYTE OneToOne 1 100 0.00 255.0 ECU_ADDRESS 0xD0001C14 /end MEASUREMENT
/begin MEASUREMENT AltIO_rAltLoad "Rohlast an den Generator" SWORD AltLd_q3p125_COMPU 1 100 -102400.0 102396.9 FORMAT "%8.1" ECU_ADDRESS 0xD0000652 /end MEASUREMENT
/begin MEASUREMENT AltIO_stErrAlt "Generatorfehlermeldung" UBYTE OneToOne 1 100 0.00 255.0 ECU_ADDRESS 0xD0001C15 /end MEASUREMENT
/begin MEASUREMENT AltIO_swtAltTyp "" UBYTE AltTyp_COMPU_VERB 1 100 1.00000000000 3.00000000000 FORMAT "%13.11" ECU_ADDRESS 0xD0001C16 /end MEASUREMENT
/begin MEASUREMENT AltIO_tChp "" SWORD AltChpTemp_q8p0_COMPU 1 100 -262176.0 262104.0 FORMAT "%8.1" ECU_ADDRESS 0xD0000654 /end MEASUREMENT
/begin MEASUREMENT AltIO_tiLR "" SWORD OneToOne 1 100 -32768.00 32767.00 ECU_ADDRESS 0xD0000656 /end MEASUREMENT
/begin MEASUREMENT AltIO_tiLRAlt "Generator Last-Reaktionszeit" SWORD OneToOne 1 100 -32768.00 32767.00 ECU_ADDRESS 0xD0000658 /end MEASUREMENT
/begin MEASUREMENT AltIO_uAlt "" SWORD AltVltg_V_q0p1_COMPU 1 100 -3266.200 3287.300 FORMAT "%8.3" ECU_ADDRESS 0xD000065C /end MEASUREMENT
/begin MEASUREMENT AltIO_uAltDes "Generatorsollwertspannung" SWORD AltVltg_V_q0p1_COMPU 1 100 -3266.200 3287.300 FORMAT "%8.3" ECU_ADDRESS 0xD000065E /end MEASUREMENT
/begin MEASUREMENT AltIO_uNom "" SWORD AltVltgNom_COMPU_VERB 1 100 0.00 2.00000000000 FORMAT "%13.11" ECU_ADDRESS 0xD0000660 /end MEASUREMENT
/begin MEASUREMENT APP_rPlaMaxVal_mp "Maximaler APP Wert, als Glaubwürdigkeit mit Bremse ausfiel" SWORD Prc 1 100 -400.0000 399.9878 ECU_ADDRESS 0xC00098CC /end MEASUREMENT
/begin MEASUREMENT APP_rPla_mp "Fahrpedalwert nach der Plausibilisierung mit der Bremse" SWORD Prc 1 100 -400.0000 399.9878 ECU_ADDRESS 0xC00098CE /end MEASUREMENT
/begin MEASUREMENT APP_rUnLim_mp "Fahrpedalwert ohne Begrenzung durch die Lebenderkennung" SWORD Prc 1 100 -400.0000 399.9878 ECU_ADDRESS 0xC00098D0 /end MEASUREMENT
/begin MEASUREMENT APP_stAlive_mp "Status der Lebenderkennung des Fahrpedals" UBYTE OneToOne 1 100 0.00 255.0 ECU_ADDRESS 0xC000B092 /end MEASUREMENT
/begin MEASUREMENT APP_stPlaBrkDet_mp "Status der Erkennung der Plausibilität mit der Bremse" UBYTE OneToOne 1 100 0.00 255.0 ECU_ADDRESS 0xC000B093 /end MEASUREMENT
/begin MEASUREMENT APP_stPlaBrkRst_mp "Status der Rücksetzbedingung für die Plausibilität mit der Bremse" UBYTE OneToOne 1 100 0.00 255.0 ECU_ADDRESS 0xC000B094 /end MEASUREMENT
/begin MEASUREMENT APP_uDiffMax_mp "Zulässige Abweichung der Signalspannung von Sensor 1 und Sensor 2" SWORD Volt 1 100 -6553.600 6553.400 ECU_ADDRESS 0xC00098D2 /end MEASUREMENT
/begin MEASUREMENT APP_uDiff_mp "Abweichung der Signalspannung von Sensor 1 und Sensor 2" SWORD Volt 1 100 -6553.600 6553.400 ECU_ADDRESS 0xC00098D4 /end MEASUREMENT
/begin MEASUREMENT APP_uMin12half_mp "Minimum von Signal 1 und Signal 2 in der Auflösung von Signal 2" SWORD Volt 1 100 -6553.600 6553.400 ECU_ADDRESS 0xC00098D6 /end MEASUREMENT
/begin FUNCTION AirCtl_DesValCalc ""
 /begin DEF_CHARACTERISTIC AirCtl_AirTempCor.xVal_C AirCtl_AirTempCor.xTyp_C AirCtl_AirTempCorBasEOMQnt1_MAP AirCtl_AirTempCorBasEOMQnt2_MAP AirCtl_AirTempCorBasEOMQnt3_MAP AirCtl_AirTempCorBas_MAP AirCtl_DKdmDes_C AirCtl_DKdNegMDes_MAP AirCtl_DKdPosMDes_MAP AirCtl_dmDesBas.Pos_C AirCtl_dmDesBas.Neg_C AirCtl_dmDWinNegDes_C AirCtl_dmDWinPosDes_C AirCtl_facAirTempCorEOMQnt1_MAP AirCtl_facAirTempCorEOMQnt2_MAP AirCtl_facAirTempCorEOMQnt3_MAP AirCtl_facAirTempCor_MAP AirCtl_facDesEGRHighMCor_MAP AirCtl_facEngTempCor2_CUR AirCtl_facEngTempCorEOMQnt1_MAP AirCtl_facEngTempCorEOMQnt2_MAP AirCtl_facEngTempCorEOMQnt3_MAP AirCtl_facEngTempCor_MAP AirCtl_facEnvPresCorDef_CUR AirCtl_facEnvPresCorEOMQnt1_CUR AirCtl_facEnvPresCorEOMQnt2_CUR AirCtl_facEnvPresCorEOMQnt3_CUR AirCtl_facEnvPresCor_CUR AirCtl_facMaxTrmValEOM_C AirCtl_facMaxTrmVal_C AirCtl_facmDesVehTempCorr_CUR AirCtl_facmDesVehVCorr_CUR AirCtl_facMinTrmValEOM_C AirCtl_facMinTrmVal_C AirCtl_facRmpValCor_CUR AirCtl_facTrimAdjMax_C AirCtl_facTrimAdjMin_C AirCtl_mDesACCorr_CUR AirCtl_mDesAddEOMMax_C AirCtl_mDesAddEOMMin_C AirCtl_mDesAddMax_C AirCtl_mDesAddMin_C AirCtl_mDesBasDef_MAP AirCtl_mDesBasEOMQnt1_MAP AirCtl_mDesBasEOMQnt2_MAP AirCtl_mDesBasEOMQnt3_MAP AirCtl_mDesBasHiAltdDef_MAP AirCtl_mDesBasHiAltdEOMQnt1_MAP AirCtl_mDesBasHiAltdEOMQnt2_MAP AirCtl_mDesBasHiAltdEOMQnt3_MAP AirCtl_mDesBasHiAltd_MAP AirCtl_mDesBas_MAP AirCtl_mDesConvBas_C AirCtl_mDesConvEOM_C AirCtl_mDesEGRClgBypLim_MAP AirCtl_mDesGearEOM_MAP AirCtl_mDesGear_MAP AirCtl_mDesMaxValEOM_C AirCtl_mDesMaxVal_C AirCtl_mDesMinValEOM_C AirCtl_mDesMinVal_C AirCtl_mDesRmp_CUR AirCtl_mDesStrgCorrEOM_MAP AirCtl_mDesStrgCorr_MAP AirCtl_mDesValFltInit_C AirCtl_mDesVehVCorr_MAP AirCtl_mEngTempCorBas2_MAP AirCtl_mEngTempCorBasEOMQnt1_MAP AirCtl_mEngTempCorBasEOMQnt2_MAP AirCtl_mEngTempCorBasEOMQnt3_MAP AirCtl_mEngTempCorBas_MAP AirCtl_mLiCor_C AirCtl_mMaxDesValEOM_C AirCtl_mMaxDesVal_C AirCtl_mMinDesValEOM_C AirCtl_mMinDesVal_C AirCtl_mPil2CorBas_C AirCtl_mPil2CorEOM_C AirCtl_mskGear_C AirCtl_mTrmEOM_MAP AirCtl_mTrmVal_MAP AirCtl_nLiEGR_C AirCtl_numAirTempDesVal_C AirCtl_numEngTempDesVal_C AirCtl_ParAdDT1.T1_C AirCtl_ParAdDT1.Kd_C AirCtl_pBstPresRef_MAP AirCtl_rEGRClgOn_C AirCtl_stDesValEGRHighMNrm_C AirCtl_stDesValEOMLim_C AirCtl_stDesValEOMMsk_CA AirCtl_swtBstPresCorVal_C AirCtl_swtDesValFltActv_C AirCtl_tiDesValFlt_C AirCtl_tiDT1mDes_C AirCtl_tiLiEGR_C AirCtl_TrimAdjMax_C AirCtl_TrimAdjMin_C /end DEF_CHARACTERISTIC
 /begin IN_MEASUREMENT AirCtl_mGovDvt AirCtl_qDesVal AirCtl_trqDesVal AirSys_tFld Air_pIntkVUs ASMod_dmEGRDs ASMod_dmIntMnfDsRef CEngDsT_t Clth_st CoEOM_facRmpVal CoEOM_stOpModeAct Com_dphiStWhlAg Com_phiStWhlAg Com_stAC ECBVlv_r EngDa_tFld EnvP_p Epm_ctCyl Epm_nEng Epm_numCyl ETCtl_mAirDesVal InjCrv_stInjCharActVal InjCtl_qCurr InjCtl_qRaw Tra_numGear VehV_v /end IN_MEASUREMENT
 /begin OUT_MEASUREMENT AirCtl_dmDesCor AirCtl_mDesBas AirCtl_mDesCorCalc1 AirCtl_mDesStat AirCtl_mDesVal AirCtl_mDesValRaw AirCtl_mEGRDiff AirCtl_swtAirTempCor /end OUT_MEASUREMENT
 /begin LOC_MEASUREMENT AirCtl_AirTempCorBasEOMQnt1_mp AirCtl_AirTempCorBasEOMQnt2_mp AirCtl_AirTempCorBasEOMQnt3_mp AirCtl_AirTempCorBas_mp AirCtl_AirTempCorEOMQnt1_mp AirCtl_AirTempCorEOMQnt2_mp AirCtl_AirTempCorEOMQnt3_mp AirCtl_AirTempCor_mp AirCtl_DKdmDes_mp AirCtl_DKdNegMDes_mp AirCtl_DKdPosMDes_mp AirCtl_dmDWinNegDes_mp AirCtl_dmDWinPosDes_mp AirCtl_facAirTempCorEOMQnt1_mp AirCtl_facAirTempCorEOMQnt2_mp AirCtl_facAirTempCorEOMQnt3_mp AirCtl_facAirTempCor_mp AirCtl_facBstPresCor_mp AirCtl_facDesEGRHighMCor_mp AirCtl_facEngTempCor2_mp AirCtl_facEngTempCorEOMQnt1_mp AirCtl_facEngTempCorEOMQnt2_mp AirCtl_facEngTempCorEOMQnt3_mp AirCtl_facEngTempCor_mp AirCtl_facEnvPresCorDef_mp AirCtl_facEnvPresCorEOMQnt1_mp AirCtl_facEnvPresCorEOMQnt2_mp AirCtl_facEnvPresCorEOMQnt3_mp AirCtl_facEnvPresCor_mp AirCtl_facRmpValCor_mp AirCtl_facTrmEOM_mp AirCtl_facTrmVal_mp AirCtl_mDes2Cor_mp AirCtl_mDes2Red_mp AirCtl_mDesACCorrSwt_mp AirCtl_mDesACCorr_mp AirCtl_mDesAdd1_mp AirCtl_mDesAddBas_mp AirCtl_mDesAddEOM1_mp AirCtl_mDesAddEOM_mp AirCtl_mDesAddUnLimEOM_mp AirCtl_mDesAddUnLim_mp AirCtl_mDesAdd_mp AirCtl_mDesBasAddEOM_mp AirCtl_mDesBasDef_mp AirCtl_mDesBasEOMQnt1_mp AirCtl_mDesBasEOMQnt2_mp AirCtl_mDesBasEOMQnt3_mp AirCtl_mDesBasHiAltdDef_mp AirCtl_mDesBasHiAltdEOMQnt1_mp AirCtl_mDesBasHiAltdEOMQnt2_mp AirCtl_mDesBasHiAltdEOMQnt3_mp AirCtl_mDesBasHiAltd_mp AirCtl_mDesConvBas_mp AirCtl_mDesConvEOM_mp AirCtl_mDesCorCalc2_mp AirCtl_mDesCorCalc3_mp AirCtl_mDesCorCalc4_mp AirCtl_mDesCor_mp AirCtl_mDesDef_mp AirCtl_mDesDyn_mp AirCtl_mDesEGRClgBypLim_mp AirCtl_mDesEGRHighMCor_mp AirCtl_mDesGearEOM_mp AirCtl_mDesGearSwtEOM_mp AirCtl_mDesGearSwt_mp AirCtl_mDesGear_mp AirCtl_mDesMaxVal_mp AirCtl_mDesMinVal_mp AirCtl_mDesPil2CorBas_mp AirCtl_mDesPil2CorEOM_mp AirCtl_mDesStrgCorrEOM_mp AirCtl_mDesStrgCorrSwtEOM_mp AirCtl_mDesStrgCorrSwt_mp AirCtl_mDesStrgCorr_mp AirCtl_mDesVal1Cor_mp AirCtl_mDesVal1EOMQnt1_mp AirCtl_mDesVal1EOMQnt2_mp AirCtl_mDesVal1EOMQnt3_mp AirCtl_mDesVal1_mp AirCtl_mDesVal2EOMQnt1_mp AirCtl_mDesVal2EOMQnt2_mp AirCtl_mDesVal2EOMQnt3_mp AirCtl_mDesVal2_mp AirCtl_mDesVal3EOMQnt1_mp AirCtl_mDesVal3EOMQnt2_mp AirCtl_mDesVal3EOMQnt3_mp AirCtl_mDesVal3_mp AirCtl_mDesVal4EOMQnt1_mp AirCtl_mDesVal4EOMQnt2_mp AirCtl_mDesVal4EOMQnt3_mp AirCtl_mDesVal4_mp AirCtl_mDesVal5CorEOMQnt1_mp AirCtl_mDesVal5CorEOMQnt2_mp AirCtl_mDesVal5CorEOMQnt3_mp AirCtl_mDesVal5Cor_mp AirCtl_mDesVal5EOMCor_mp AirCtl_mDesVal5EOMQnt1_mp AirCtl_mDesVal5EOMQnt2_mp AirCtl_mDesVal5EOMQnt3_mp AirCtl_mDesVal5_mp AirCtl_mDesValNrm_mp AirCtl_mDesValUnLim1_mp AirCtl_mDesValUnLim2_mp AirCtl_mDesVal_mp AirCtl_mDesVehCorrSwt_mp AirCtl_mDesVehCorr_mp AirCtl_mEGRDs_mp AirCtl_mEngTempCor2_mp AirCtl_mEngTempCorBas2_mp AirCtl_mEngTempCorBasEOMQnt1_mp AirCtl_mEngTempCorBasEOMQnt2_mp AirCtl_mEngTempCorBasEOMQnt3_mp AirCtl_mEngTempCorBas_mp AirCtl_mEngTempCorEOMQnt1_mp AirCtl_mEngTempCorEOMQnt2_mp AirCtl_mEngTempCorEOMQnt3_mp AirCtl_mEngTempCor_mp AirCtl_mIntMnfDsRef_mp AirCtl_mMaxDesVal_mp AirCtl_mMinDesVal_mp AirCtl_mTrmEOMCor_mp AirCtl_mTrmEOM_mp AirCtl_mTrmValNrm_mp AirCtl_mTrmVal_mp AirCtl_pBstPresRef_mp AirCtl_qDesValInl_mp AirCtl_qDesVal_mp AirCtl_stDesValEOMLim_mp AirCtl_stEOMDesVal_mp AirCtl_tAirDesVal_mp AirCtl_tEngDesVal_mp AirCtl_trqDesValInl_mp /end LOC_MEASUREMENT
 /begin SUB_FUNCTION AirCtl_DesValCalc /end SUB_FUNCTION
/end FUNCTION
/begin FUNCTION AirCtl_DesValCalcLP ""
 /begin DEF_CHARACTERISTIC AirCtl_AirTempLPCorBas_MAP AirCtl_DkDesLPDyn_C AirCtl_DkDNegDesLPDyn_CUR AirCtl_DkDPosDesLPDyn_CUR AirCtl_dmDesBasLP.Pos_C AirCtl_dmDesBasLP.Neg_C AirCtl_dmDWinNegDesLPDyn_C AirCtl_dmDWinPosDesLPDyn_C AirCtl_facAirTempLPCor_MAP AirCtl_facDesLPEngTempVCor_CUR AirCtl_facDesLPVehVCor_CUR AirCtl_facEngTempLPCor2_CUR AirCtl_facEngTempLPCor_MAP AirCtl_facEnvPresLPCorDef_CUR AirCtl_facEnvPresLPCor_CUR AirCtl_mDesBasLPDef_MAP AirCtl_mDesBasLPHiAltdDef_MAP AirCtl_mDesBasLPHiAltd_MAP AirCtl_mDesBasLP_MAP AirCtl_mDesLPACCor_CUR AirCtl_mDesLPAddMax_C AirCtl_mDesLPAddMin_C AirCtl_mDesLPClthBas_C AirCtl_mDesLPGear_MAP AirCtl_mDesLPPil2Cor_C AirCtl_mDesLPStrg_MAP AirCtl_mDesLPVehVCor_MAP AirCtl_mDesValLPAIIMax_C AirCtl_mDesValLPMax_C AirCtl_mDesValLPMin_C AirCtl_mEngTempLPCorBas2_MAP AirCtl_mEngTempLPCorBas_MAP AirCtl_mLiEgrLPCor_C AirCtl_mskDesLPGear_C AirCtl_nLiEGRLPCor_C AirCtl_numAirTempDesValLP_C AirCtl_numEngTempDesValLP_C AirCtl_ParAdLPDT1.T1_C AirCtl_ParAdLPDT1.Kd_C AirCtl_pBstPresLPRef_MAP AirCtl_swtBstPresLPCorVal_C AirCtl_swtEGRLPActv_C AirCtl_tiDT1LPDesLPDyn_C AirCtl_tiLiEGRLPCorDly_C /end DEF_CHARACTERISTIC
 /begin IN_MEASUREMENT AirCtl_qDesVal AirCtl_tAirDesVal_mp AirCtl_tEngDesVal_mp AirSys_tFld Air_pIntkVUs CEngDsT_t Clth_st Com_dphiStWhlAg Com_phiStWhlAg Com_swtAC EngDa_tFld EnvP_p Epm_nEng InjCrv_stInjCharActVal InjCtl_qCurr Tra_numGear VehV_v /end IN_MEASUREMENT
 /begin OUT_MEASUREMENT AirCtl_mDesValLP AirCtl_swtEGRLPActv /end OUT_MEASUREMENT
 /begin LOC_MEASUREMENT AirCtl_AirTempLPCorBas_mp AirCtl_DKdmLPDes_mp AirCtl_DkdNegDesLPDyn_mp AirCtl_DkdPosDesLPDyn_mp AirCtl_dmDesLPCor_mp AirCtl_dmDWinNegDesLPDyn_mp AirCtl_dmDWinPosDesLPDyn_mp AirCtl_facAirTempLPCor_mp AirCtl_facBstPresLPCor_mp AirCtl_facDesLPEngTempVCor_mp AirCtl_facDesLPVehV_mp AirCtl_facEngTempLPCor2_mp AirCtl_facEngTempLPCor_mp AirCtl_facEnvPresLPCorDef_mp AirCtl_facEnvPresLPCor_mp AirCtl_mAirTempLPCor_mp AirCtl_mDesBasLPDef_mp AirCtl_mDesBasLPHiAltdDef_mp AirCtl_mDesBasLPHiAltd_mp AirCtl_mDesBasLP_mp AirCtl_mDesLPACCorRaw_mp AirCtl_mDesLPACCor_mp AirCtl_mDesLPAdd1_mp AirCtl_mDesLPAdd2_mp AirCtl_mDesLPAddGS_mp AirCtl_mDesLPAddUnLim_mp AirCtl_mDesLPAdd_mp AirCtl_mDesLPClthBas_mp AirCtl_mDesLPCor2_mp AirCtl_mDesLPDyn_mp AirCtl_mDesLPGearCorRaw_mp AirCtl_mDesLPGearCor_mp AirCtl_mDesLPPil2Bas_mp AirCtl_mDesLPStat_mp AirCtl_mDesLPStrgCorRaw_mp AirCtl_mDesLPStrgCor_mp AirCtl_mDesLPSum_mp AirCtl_mDesLPVehVCor1_mp AirCtl_mDesLPVehVCorRaw_mp AirCtl_mDesLPVehVCor_mp AirCtl_mDesValLP1Cor_mp AirCtl_mDesValLP1Rmp_mp AirCtl_mDesValLP1_mp AirCtl_mDesValLP3_mp AirCtl_mDesValLP4_mp AirCtl_mDesValLP5_mp AirCtl_mDesValLPCust_mp AirCtl_mDesValLPDef_mp AirCtl_mDesValLPNrm_mp AirCtl_mEngTempLPCor2_mp AirCtl_mEngTempLPCorBas2_mp AirCtl_mEngTempLPCorBas_mp AirCtl_mEngTempLPCor_mp AirCtl_mLIEgrLPCor_mp AirCtl_pBstPresLPRef_mp AirCtl_tAirDesValLP_mp AirCtl_tEngDesValLP_mp /end LOC_MEASUREMENT
/end FUNCTION
/begin FUNCTION AirCtl_Gov ""
 /begin DEF_CHARACTERISTIC AirCtl_DKdEOM_C AirCtl_DKdNegGovEOM_MAP AirCtl_DKdNegPGovOff_MAP AirCtl_DKdNegPGovOn_C AirCtl_DKdPGovOff_C AirCtl_DKdPosGovEOM_MAP AirCtl_DKdPosPGovOff_MAP AirCtl_DKdPosPGovOn_C AirCtl_DKd_C AirCtl_dmDWinNegEOM_C AirCtl_dmDWinNegPGovOff_C AirCtl_dmDWinNeg_C AirCtl_dmDWinPosEOM_C AirCtl_dmDWinPosPGovOff_C AirCtl_dmDWinPos_C AirCtl_drDynMin.Pos_C AirCtl_drDynMin.Neg_C AirCtl_drDynOut1.Pos_C AirCtl_drDynOut1.Neg_C AirCtl_drDynOut2.Pos_C AirCtl_drDynOut2.Neg_C AirCtl_drGovDynMin.Pos_C AirCtl_drGovDynMin.Neg_C AirCtl_drTVACtlOvrRunRmp.Pos_C AirCtl_drTVACtlOvrRunRmp.Neg_C AirCtl_EOMI.Ki_C AirCtl_EOMI.KiPos_C AirCtl_EOMI.KiNeg_C AirCtl_EOMI.WinPos_C AirCtl_EOMI.WinNeg_C AirCtl_EOMP.Kp_C AirCtl_EOMP.KpPos_C AirCtl_EOMP.KpNeg_C AirCtl_EOMP.WinPos_C AirCtl_EOMP.WinNeg_C AirCtl_facEGRCorAltEOMQnt1_CUR AirCtl_facEGRCorAltEOMQnt2_CUR AirCtl_facIParBas_MAP AirCtl_facIParNegBas_MAP AirCtl_facIParPosBas_MAP AirCtl_facParAirTempEOM_CUR AirCtl_facParAirTemp_CUR AirCtl_facParBasEOM_MAP AirCtl_facParPresDiff_CUR AirCtl_facParPresEGRDiff_CUR AirCtl_facPCRCorNeg_MAP AirCtl_facPCRCorPos_MAP AirCtl_facPParBas_MAP AirCtl_facPParNegBas_MAP AirCtl_facPParPosBas_MAP AirCtl_facRmpEGRCls_C AirCtl_facRmpEGROpn_C AirCtl_facTVACtlATCor_CUR AirCtl_facTVACtlCTCor_CUR AirCtl_Gov.xVal_C AirCtl_Gov.xTyp_C AirCtl_GradGovOut.T1_C AirCtl_GradGovOut.Kd_C AirCtl_I.Ki_C AirCtl_I.KiPos_C AirCtl_I.KiNeg_C AirCtl_I.WinPos_C AirCtl_I.WinNeg_C AirCtl_IPGovOff.Ki_C AirCtl_IPGovOff.KiPos_C AirCtl_IPGovOff.KiNeg_C AirCtl_IPGovOff.WinPos_C AirCtl_IPGovOff.WinNeg_C AirCtl_mskGovMin_C AirCtl_mskStGovDyn1_C AirCtl_mskStGovDyn2_C AirCtl_numAirTempGov_C AirCtl_P.Kp_C AirCtl_P.KpPos_C AirCtl_P.KpNeg_C AirCtl_P.WinPos_C AirCtl_P.WinNeg_C AirCtl_PPGovOff.Kp_C AirCtl_PPGovOff.KpPos_C AirCtl_PPGovOff.KpNeg_C AirCtl_PPGovOff.WinPos_C AirCtl_PPGovOff.WinNeg_C AirCtl_pTVACtlOffEnvP_C AirCtl_rDflValEOM_CA AirCtl_rDflVal_CA AirCtl_rDiffDynMin_CUR AirCtl_rDynEnd_C AirCtl_rDynMinEOM1_MAP AirCtl_rDynMin_MAP AirCtl_rDynStart_C AirCtl_rEGRCorAltEOMErr_C AirCtl_rEGRCorAltEOMQnt1_MAP AirCtl_rEGRCorAltEOMQnt2_MAP AirCtl_rEGREOMQnt2_MAP AirCtl_rEGREOM_MAP AirCtl_rEGRInv_MAP AirCtl_rEGRMax_C AirCtl_rEGRMin_C AirCtl_rEGR_MAP AirCtl_rGovBgnNrmEOM_C AirCtl_rGovDynMinEOM1_CUR AirCtl_rGovDynMin_CUR AirCtl_rGovMax_C AirCtl_rGovMin_C AirCtl_rGovThresBgnNrm_C AirCtl_rPCRCorDiff_CUR AirCtl_rTVACtlATCor_MAP AirCtl_rTVACtlBasOvrRunOff_C AirCtl_rTVACtlBasOvrRun_MAP AirCtl_rTVACtlBas_MAP AirCtl_rTVACtlCTCor_MAP AirCtl_rTVACtlEnvPCor_CUR AirCtl_rTVAEOM_MAP AirCtl_rTVA_MAP AirCtl_stGovEOMMsk2_C AirCtl_stGovEOMMsk_C AirCtl_swtAirMs_C AirCtl_swtAirUnit_C AirCtl_swtPreCtlPos_C AirCtl_swtTVACtlOvrRunOff_C AirCtl_swtTVACtl_C AirCtl_tiAFSPT1_MAP AirCtl_tiDT1EOM_C AirCtl_tiDT1PGovOff_C AirCtl_tiDT1_C AirCtl_tiDynAirCtl_C AirCtl_tiEOMNrmMax_C AirCtl_tiPCRCtl.tiHiLo_C AirCtl_tiPCRCtl.tiLoHi_C AirCtl_tiTVACtlOffTime_C AirCtl_tiTVACtlOvrRunActv_C AirCtl_tTVACtlAirTempHi_C AirCtl_tTVACtlAirTempLo_C AirCtl_tTVACtlClntTempHi_C AirCtl_tTVACtlClntTempLo_C /end DEF_CHARACTERISTIC
 /begin REF_CHARACTERISTIC HESrv_swtPOpVis_C HESrv_swtScndFlwActv_C /end REF_CHARACTERISTIC
 /begin IN_MEASUREMENT AFS_dm AFS_mAirPerCyl AirCtl_dmDesCor AirCtl_mDesStat AirCtl_qDesVal AirCtl_qGov AirCtl_rCtlVal AirCtl_rCtlValB1 AirCtl_rCtlValB2 AirCtl_stMon AirCtl_trqGov Air_pIntkVUs Air_tAFS ASMod_dmIntMnfUs ASMod_mAirPerCylCor ASMod_pDiffEngGsFlw ASMod_rPresEGRDiff CEngDsT_t Clth_st CoEng_tiNormal CoEOM_stOpModeAct EGRVlv_stPosGovOn EnvP_p Epm_nEng Epm_numCyl Exh_pFltPPFltDiff InjCtl_qRaw Layer_rGovHPEGR PCR_rAirCtlDiffCoupling PCR_rCtlVal PCR_rGov PthSet_stOvrRunCoord PT_stTraType TCPrt_rPresRat /end IN_MEASUREMENT
 /begin OUT_MEASUREMENT AirCtl_mGovDvt AirCtl_rEGR AirCtl_rPCRDiffCoupling AirCtl_stAirDyn AirCtl_stDesEOM AirCtl_stGov AirCtl_swtGov /end OUT_MEASUREMENT
 /begin LOC_MEASUREMENT AirCtl_DKdEOM_mp AirCtl_DKdNegEOM_mp AirCtl_DKdNegNrm_mp AirCtl_DKdNrm_mp AirCtl_DKdPosEOM_mp AirCtl_DKdPosNrm_mp AirCtl_dmDesVal_mp AirCtl_drGovOutUnLim_mp AirCtl_facEGRCorAltEOMQnt1_mp AirCtl_facEGRCorAltEOMQnt2_mp AirCtl_facIParBas_mp AirCtl_facIParCor_mp AirCtl_facIParNegBas_mp AirCtl_facIParNegCor_mp AirCtl_facIParNegNrm_mp AirCtl_facIParNrm_mp AirCtl_facIParPosBas_mp AirCtl_facIParPosCor_mp AirCtl_facIParPosNrm_mp AirCtl_facParAirTempEOM_mp AirCtl_facParAirTemp_mp AirCtl_facParBasEOM_mp AirCtl_facParCorEOM_mp AirCtl_facParPresDiff_mp AirCtl_facParPresEGRDiff_mp AirCtl_facPCRCorNeg_mp AirCtl_facPCRCorPos_mp AirCtl_facPParBas_mp AirCtl_facPParCor_mp AirCtl_facPParNegBas_mp AirCtl_facPParNegCor_mp AirCtl_facPParNegNrm_mp AirCtl_facPParNrm_mp AirCtl_facPParPosBas_mp AirCtl_facPParPosCor_mp AirCtl_facPParPosNrm_mp AirCtl_InDT1_mp AirCtl_mActVal_mp AirCtl_pFltPPFltDiff_mp AirCtl_pRelCACDs_mp AirCtl_qGov_mp AirCtl_rDiffDynMin_mp AirCtl_rDynMinEOM1_mp AirCtl_rDynMinNrm_mp AirCtl_rDynMin_mp AirCtl_rDynRmp_mp AirCtl_rEGRCorAltBasEOMQnt1_mp AirCtl_rEGRCorAltBasEOMQnt2_mp AirCtl_rEGRCorAltEOMQnt1_mp AirCtl_rEGRCorAltEOMQnt2_mp AirCtl_rEGREOMCor_mp AirCtl_rEGREOMNrm_mp AirCtl_rEGREOMQnt2_mp AirCtl_rEGREOMQnt_mp AirCtl_rEGREOM_mp AirCtl_rEGRInv_mp AirCtl_rEGRNrmEOM_mp AirCtl_rEGR_mp AirCtl_rEOMBgnInit_mp AirCtl_rEOMEndInit_mp AirCtl_rGovDynMin2_mp AirCtl_rGovDynMinEOM1_mp AirCtl_rGovDynMinNrm_mp AirCtl_rGovDynMin_mp AirCtl_rGovEGR AirCtl_rGovEGRNrm_mp AirCtl_rGovEGR_mp AirCtl_rGovMinDyn1_mp AirCtl_rGovMin_mp AirCtl_rGovOutUnLimCor_mp AirCtl_rGovOutUnLim_mp AirCtl_rGovOut_mp AirCtl_rGovTVA AirCtl_rGovTVANrm_mp AirCtl_rOutD_mp AirCtl_rOutI_mp AirCtl_rOutP_mp AirCtl_rPCRCorDiff_mp AirCtl_rPCRCtl_mp AirCtl_rPIDCtl_mp AirCtl_rTVACtlATCor_mp AirCtl_rTVACtlBasOvrRun_mp AirCtl_rTVACtlBas_mp AirCtl_rTVACtlCTCor_mp AirCtl_rTVACtlEnvPCor_mp AirCtl_rTVACtlMax_mp AirCtl_rTVACtlOvrRun_mp AirCtl_rTVACtlSum_mp AirCtl_rTVACtl_mp AirCtl_rTVAEOMCor_mp AirCtl_rTVAEOM_mp AirCtl_rTVA_mp AirCtl_stDyn_mp AirCtl_stGovMin_mp AirCtl_stTVACtlOvrRunActv_mp AirCtl_stTVACtlOvrRun_mp AirCtl_swtGovEna AirCtl_tAirGov_mp AirCtl_tiAFSPT1Nrm_mp AirCtl_tiAFSPT1_mp /end LOC_MEASUREMENT
/end FUNCTION
/begin FUNCTION AirCtl_GovLP ""
 /begin DEF_CHARACTERISTIC AirCtl_facParLPAirTemp_CUR AirCtl_facParLPBas_MAP AirCtl_LpI.Ki_C AirCtl_LpI.KiPos_C AirCtl_LpI.KiNeg_C AirCtl_LpI.WinPos_C AirCtl_LpI.WinNeg_C AirCtl_LpP.Kp_C AirCtl_LpP.KpPos_C AirCtl_LpP.KpNeg_C AirCtl_LpP.WinPos_C AirCtl_LpP.WinNeg_C AirCtl_numAirTempGovLP_C AirCtl_rCtlValLPNrm_MAP AirCtl_rEGRLP_MAP AirCtl_rGovLPMax_C AirCtl_rGovLPMin_MAP AirCtl_rLpIDflVal_CA AirCtl_tiLPRmp_C /end DEF_CHARACTERISTIC
 /begin IN_MEASUREMENT AFS_mAirPerCyl AirCtl_qGov AirCtl_stMonLP AirCtl_stMonLPNoDeb AirCtl_swtEGRLPActv AirSys_tFld Epm_nEng Layer_rGovLPEGR /end IN_MEASUREMENT
 /begin OUT_MEASUREMENT AirCtlLP_mGovDvt AirCtl_rGovLPEGR AirCtl_stGovLP AirCtl_swtGovLPEna /end OUT_MEASUREMENT
 /begin LOC_MEASUREMENT AirCtl_facParLPAirTemp_mp AirCtl_facParLPBas_mp AirCtl_facParLPCor_mp AirCtl_facParLPNrm_mp AirCtl_mActValLP_mp AirCtl_rCtlValLP_mp AirCtl_rGovLPMin_mp AirCtl_rGovOutLPUnLimCor_mp AirCtl_rGovOutLPUnLim_mp AirCtl_rGovOutLP_mp AirCtl_rOutLpI_mp AirCtl_rOutLpP_mp AirCtl_rPIDCtlLP_mp AirCtl_tAirGovLP_mp /end LOC_MEASUREMENT
/end FUNCTION
/begin FUNCTION AirCtl_InvEGRMod ""
 /begin DEF_CHARACTERISTIC AirCtl_mDesValEgrHPMax_C AirCtl_mDesValEgrHPMin_C AirCtl_qHPMixOff_CUR AirCtl_qHPMixOn_CUR AirCtl_rEGRInvModMax_C AirCtl_rEGRInvModMin_C AirCtl_rHPMixDflVal_C /end DEF_CHARACTERISTIC
 /begin IN_MEASUREMENT AirCtl_mDesVal AirCtl_qInvEGRMod AirCtl_stMonLP Air_pIntkVUs ASMod_tEGRDs Epm_nEng Exh_pTrbnUs Exh_tTrbnUs /end IN_MEASUREMENT
 /begin OUT_MEASUREMENT AirCtl_dmEGRDs AirCtl_rEGRHPPosDes AirCtl_stEGRHPMixActv /end OUT_MEASUREMENT
 /begin LOC_MEASUREMENT AirCtl_mDesValHPMix_mp AirCtl_stEGRHPMixActvCond_mp /end LOC_MEASUREMENT
/end FUNCTION
/begin FUNCTION AirCtl_Lib "" /end FUNCTION
/begin FUNCTION AirCtl_Mon ""
 /begin DEF_CHARACTERISTIC AirCtl_dnSurgeHigh_CUR AirCtl_dnSurgeLow_CUR AirCtl_drBrkRmp.Pos_C AirCtl_drBrkRmp.Neg_C AirCtl_facActDesVal_C AirCtl_mMaxDvtEOM_MAP AirCtl_mMaxDvt_MAP AirCtl_mMinDvtEOM_MAP AirCtl_mMinDvt_MAP AirCtl_nHealHi_C AirCtl_nHealLo_C AirCtl_nLoIdl_C AirCtl_nOvrRun_C AirCtl_numAirTempMon_C AirCtl_numEngTempMon_C AirCtl_OvrRun_C AirCtl_pAirHi_C AirCtl_pAirLo_C AirCtl_qHealHi_C AirCtl_qHealLo_C AirCtl_qHiEOM_CUR AirCtl_qHi_CUR AirCtl_qLoEOM_CUR AirCtl_qLo_CUR AirCtl_qSurgeHigh_CUR AirCtl_qSurgeLow_CUR AirCtl_rBrkDelta_C AirCtl_rBrkXHigh_C AirCtl_rBrkXLow_C AirCtl_rEGRDflVal_CA AirCtl_rSurgeHigh_MAP AirCtl_rSurgeOfs_CUR AirCtl_rTVADflVal_CA AirCtl_stBitMskEOM_CA AirCtl_stCurrQntHiEOMMsk_C AirCtl_stCurrQntLoEOMMsk_C AirCtl_stCurrTrqHiEOMMsk_C AirCtl_stCurrTrqLoEOMMsk_C AirCtl_stMonEOMMsk_CA AirCtl_stPrioMon_CA AirCtl_stShOffEOMMsk_C AirCtl_swtMonOffBrkRepActv_C AirCtl_tAirCldHi_C AirCtl_tAirCldLo_C AirCtl_tAirWrmHi_C AirCtl_tAirWrmLo_C AirCtl_tClntCldHi_C AirCtl_tClntCldLo_C AirCtl_tClntWrmHi_C AirCtl_tClntWrmLo_C AirCtl_tiCldStrt_CUR AirCtl_tiClth_C AirCtl_tiHiQntTrqDebHiLoEOM_C AirCtl_tiHiQntTrqDebHiLo_C AirCtl_tiLoIdl_C AirCtl_tiMonEOM_CA AirCtl_tiSurgePT1_C AirCtl_trqHiEOM_CUR AirCtl_trqHi_CUR AirCtl_trqLoEOM_CUR AirCtl_trqLo_CUR AirCtl_uBattThres_C /end DEF_CHARACTERISTIC
 /begin REF_CHARACTERISTIC HESrv_swtPOpVis_C /end REF_CHARACTERISTIC
 /begin IN_MEASUREMENT AFS_stFIdAFSSysOk AirCtl_qMon AirCtl_stAirDyn AirCtl_stMonLP AirCtl_swtGovEna AirCtl_trqMon ASMod_stFIdASModT20ok Brk_stMn CoEOM_stOpModeAct EGRVlv_stMon EnvP_p Epm_dnEng Epm_nEng TCPrt_rPresRat /end IN_MEASUREMENT
 /begin OUT_MEASUREMENT AirCtl_mMaxDvt AirCtl_mMaxDvt1EOM_mp AirCtl_mMaxDvt1_mp AirCtl_mMinDvt AirCtl_mMinDvt1EOM_mp AirCtl_mMinDvt1_mp AirCtl_qSurgeHigh_mp AirCtl_qSurgeLow_mp AirCtl_rGovDvtNrm AirCtl_rSurgeHigh_mp AirCtl_rSurgeLow_mp AirCtl_rSurgeOfs_mp AirCtl_stAirCtlBits AirCtl_stEOMMon AirCtl_stGovDvtNegMonEna AirCtl_stMon /end OUT_MEASUREMENT
 /begin LOC_MEASUREMENT AirCtl_mDesMax_mp AirCtl_numEOMMode_mp AirCtl_qHi_mp AirCtl_qLo_mp AirCtl_rBrkRmp_mp AirCtl_stBitMskEOM_mp AirCtl_stDebDef_mp AirCtl_stDesChk_mp AirCtl_stGovDvtMonEna_mp AirCtl_stHealDef_mp AirCtl_stMaxDvt_mp AirCtl_stMinDvt_mp AirCtl_stMonBits_mp AirCtl_stMonOffBrkRep_mp AirCtl_stMonOffNegDev_mp AirCtl_stSelBitMskEOM_mp AirCtl_tAirMon_mp AirCtl_tEngMon_mp AirCtl_tiCldStrt_mp AirCtl_tiMonEOM_mp AirCtl_trqHi_mp AirCtl_trqLo_mp /end LOC_MEASUREMENT
/end FUNCTION
/begin FUNCTION AirCtl_MonLP ""
 /begin DEF_CHARACTERISTIC AirCtl_facActDesValLP_C AirCtl_mMaxLPDvt_MAP AirCtl_mMinLPDvt_MAP AirCtl_nHealLPHi_C AirCtl_nHealLPLo_C AirCtl_nLPLoIdl_C AirCtl_nLPOvrRun_C AirCtl_numAirTempMonLP_C AirCtl_numEngTempMonLP_C AirCtl_pAirHiLP_C AirCtl_pAirLoLP_C AirCtl_qHealLPHi_C AirCtl_qHealLPLo_C AirCtl_qLPHi_CUR AirCtl_qLPLo_CUR AirCtl_qLPOvrRun_C AirCtl_rLpEGRDflVal_CA AirCtl_stLPBitMskNrm_C AirCtl_stPrioMonLP_CA AirCtl_tAirCldHiLP_C AirCtl_tAirCldLoLP_C AirCtl_tAirWrmHiLP_C AirCtl_tAirWrmLoLP_C AirCtl_tClntCldHiLP_C AirCtl_tClntCldLoLP_C AirCtl_tClntWrmHiLP_C AirCtl_tClntWrmLoLP_C AirCtl_tiCldStrtLP_CUR AirCtl_tiGovLPDvtMaxDebDef_C AirCtl_tiGovLPDvtMaxDebOk_C AirCtl_tiGovLPDvtMinDebDef_C AirCtl_tiGovLPDvtMinDebOk_C AirCtl_tiHiQntDlyLoHiLP_C AirCtl_tiLPClth_C AirCtl_tiLPLoIdl_C AirCtl_uBattThresLP_C /end DEF_CHARACTERISTIC
 /begin IN_MEASUREMENT AFS_stDrft AirCtlLP_mGovDvt AirCtl_mDesValLP AirCtl_qMon AirCtl_swtGovLPEna AirSys_tFld ASMod_dmIndAirRef BattU_u Clth_st CoEng_st CoEng_stShutOffPath CoEng_tiNormal EngDa_tFld EnvP_p Epm_nEng Epm_numCyl /end IN_MEASUREMENT
 /begin OUT_MEASUREMENT AirCtl_mMaxLPDvt AirCtl_mMinLPDvt AirCtl_rGovLPDvtNrm AirCtl_stAirCtlLPBits_mp AirCtl_stMonLP AirCtl_stMonLPNoDeb /end OUT_MEASUREMENT
 /begin LOC_MEASUREMENT AirCtl_mDesLPMax_mp AirCtl_qLPHi_mp AirCtl_qLPLo_mp AirCtl_stDebDefLP_mp AirCtl_stDesChkLP_mp AirCtl_stGovLPDvtMonEna_mp AirCtl_stHealLPDef_mp AirCtl_stMaxLPDvt_mp AirCtl_stMinLPDvt_mp AirCtl_stMonLPBits_mp AirCtl_tAirMonLP_mp AirCtl_tEngMonLP_mp AirCtl_tiCldStrtLP_mp /end LOC_MEASUREMENT
/end FUNCTION
/begin FUNCTION AirSys_AirTemp "" /begin OUT_MEASUREMENT AirSys_tFld /end OUT_MEASUREMENT /end FUNCTION
/begin FUNCTION AirSys_Lib "" /end FUNCTION
/begin FUNCTION AirSys_SysTst ""
 /begin DEF_CHARACTERISTIC AirSys_nMaxAirSysTst_C AirSys_pDesValLimHi_C AirSys_pDesValLimLow_C AirSys_pDiffFltMax_C AirSys_pMaxAirSysTst_C AirSys_stMskCoEOMOpModeAirSysTst_C AirSys_tiLoopMeanVal_C /end DEF_CHARACTERISTIC
 /begin IN_MEASUREMENT AFS_dmSens Air_pSensPIntkVUs ASMod_dmIndAirRef Brk_st Clth_st CoEng_st CoEOM_stOpModeAct Epm_nEng Exh_pPFltDiff VehV_v /end IN_MEASUREMENT
 /begin OUT_MEASUREMENT AirSys_pDesValTst AirSys_stpDesValSysTst AirSys_stSysTst /end OUT_MEASUREMENT
 /begin LOC_MEASUREMENT AirSys_dRED1_mp AirSys_dRED2_mp AirSys_GetAbrtReason_mp AirSys_GetSt_mp AirSys_mLBer1_mp AirSys_mLBer2_mp AirSys_mLHFM1_mp AirSys_mLHFM2_mp AirSys_mLM10_mp AirSys_mLM11_mp AirSys_mLM12_mp AirSys_mLM13_mp AirSys_mLM20_mp AirSys_mLM21_mp AirSys_mLM22_mp AirSys_nDes_mp AirSys_p21max1_mp AirSys_p21max2_mp AirSys_rDIFF1_mp AirSys_rDIFF2_mp AirSys_rLverh1_mp AirSys_rLverh2_mp AirSys_rRED10_mp AirSys_rRED11_mp AirSys_rRED12_mp AirSys_rRED13_mp AirSys_rRED20_mp AirSys_rRED21_mp AirSys_rRED22_mp AirSys_ststateSysTst_mp AirSys_stsubstateSysTst_mp /end LOC_MEASUREMENT
/end FUNCTION
/begin FUNCTION AltIO_DD ""
 /begin DEF_CHARACTERISTIC AltIO_swtAltTyp_C AltIO_swtLROff_C AltIO_tiBtwRegRd_C AltIO_tiLRAltMax_C AltIO_tiLRAltMin_C AltIO_uAltDesMax_C AltIO_uAltDesMin_C /end DEF_CHARACTERISTIC
 /begin OUT_MEASUREMENT AltIO_iLim AltIO_iOut AltIO_numAltTyp AltIO_numChpVers AltIO_numGovTyp AltIO_numLdRng AltIO_numMnfcCod AltIO_rAltLoad AltIO_stErrAlt AltIO_swtAltTyp AltIO_tChp AltIO_tiLR AltIO_tiLRAlt AltIO_uAlt AltIO_uAltDes AltIO_uNom /end OUT_MEASUREMENT
/end FUNCTION
/begin FUNCTION Amd29BDD160 "" /end FUNCTION
/begin FUNCTION Amd29BDD320 "" /end FUNCTION
/begin FUNCTION APP_ChkSig ""
 /begin DEF_CHARACTERISTIC APP_AliveDeb.tiHiLo_C APP_AliveDeb.tiLoHi_C APP_drLim.Pos_C APP_drLim.Neg_C APP_drLimpMax_C APP_drPlaMaxVal.Pos_C APP_drPlaMaxVal.Neg_C APP_rLimpMax_C APP_rPlaMaxVal_C APP_rPlaMaxVal_CUR APP_rThresAliveDet_C APP_swtAliveDetEna_C APP_swtPlaChkEna_C /end DEF_CHARACTERISTIC
 /begin IN_MEASUREMENT APP_rUnFlt Brk_st Com_trqBrkDVCH /end IN_MEASUREMENT
 /begin LOC_MEASUREMENT APP_rPlaMaxVal_mp APP_rPla_mp APP_rUnLim_mp APP_stAlive_mp /end LOC_MEASUREMENT
/end FUNCTION
/begin FUNCTION APP_DD1 "" /begin DEF_CHARACTERISTIC APP_uRaw1SRCHigh_C APP_uRaw1SRCLow_C /end DEF_CHARACTERISTIC /end FUNCTION
/begin FUNCTION APP_DD2 "" /begin DEF_CHARACTERISTIC APP_uRaw2SRCHigh_C APP_uRaw2SRCLow_C /end DEF_CHARACTERISTIC /begin IN_MEASUREMENT MoCADC_st /end IN_MEASUREMENT /end FUNCTION
/begin FUNCTION APP_Kickdown "" /begin DEF_CHARACTERISTIC APP_uKDHighAPP_C APP_uKDLowAPP_C /end DEF_CHARACTERISTIC /end FUNCTION
/begin FUNCTION APP_Plaus12 "" /begin DEF_CHARACTERISTIC APP_uSyncMin_C APP_uSync_CUR /end DEF_CHARACTERISTIC /begin LOC_MEASUREMENT APP_uDiffMax_mp APP_uDiff_mp APP_uMin12half_mp /end LOC_MEASUREMENT /end FUNCTION
/begin FUNCTION APP_PlausBrk ""
 /begin DEF_CHARACTERISTIC APP_drUnFltLim_C APP_GradCondDeb.tiHiLo_C APP_GradCondDeb.tiLoHi_C APP_nLim_C APP_PlaBrkDetDeb.tiHiLo_C APP_PlaBrkDetDeb.tiLoHi_C APP_PlaBrkRstDeb.tiHiLo_C APP_PlaBrkRstDeb.tiLoHi_C APP_rPlaRls_C APP_swtAppGradEna_C APP_swtBrkDet_C APP_swtBrkTrq_C APP_swtRstCon_C APP_swtVehDynReqd_C APP_trqBrkHigh_C APP_trqBrkLow_C APP_vLim_C /end DEF_CHARACTERISTIC
 /begin IN_MEASUREMENT Brk_stMn Brk_stRed Epm_nEng GlbDa_stTrqDem VehV_v /end IN_MEASUREMENT
 /begin LOC_MEASUREMENT APP_stPlaBrkDet_mp APP_stPlaBrkRst_mp /end LOC_MEASUREMENT
/end FUNCTION
/begin COMPU_METHOD AIRC_ATSINTVMODREDTRQ_SY_Compu "" TAB_VERB "%6.3" "" COMPU_TAB_REF AIRC_ATSINTVMODREDTRQ_SY_Compu /end COMPU_METHOD
/begin COMPU_VTAB AIRC_ATSINTVMODREDTRQ_SY_Compu "" TAB_VERB 2 0 "False" 1 "True" /end COMPU_VTAB
/begin COMPU_METHOD AirMassPerCyl "" RAT_FUNC "%5.1" "mg/Hub" COEFFS 0 10 0 0 0 1 /end COMPU_METHOD
/begin COMPU_METHOD AirMassPerTime "" RAT_FUNC "%5.1" "Kg/h" COEFFS 0 10 0 0 0 1 /end COMPU_METHOD
/begin COMPU_METHOD AirTempFldSel "" TAB_VERB "%6.3" "" COMPU_TAB_REF AirTempFldSel /end COMPU_METHOD
/begin COMPU_VTAB AirTempFldSel "" TAB_VERB 4 0 "Air_tCACDs" 1 "Air_tAFS" 2 "EnvT_t" 3 "Air_tAFSCorr" /end COMPU_VTAB
/begin COMPU_METHOD AltChpTemp_q8p0_COMPU "" RAT_FUNC "%6.2" "deg C" COEFFS 0 0.125 4 0 0 1 /end COMPU_METHOD
/begin COMPU_METHOD AltCrntLim_A_q0p25_COMPU "" RAT_FUNC "%6.3" "A" COEFFS 0 4 0 0 0 1 /end COMPU_METHOD
/begin COMPU_METHOD AltCrntOut_A_q0p125_COMPU "" RAT_FUNC "%6.3" "A" COEFFS 0 8 0 0 0 1 /end COMPU_METHOD
/begin COMPU_METHOD AltLd_q3p125_COMPU "" RAT_FUNC "%6.2" "%" COEFFS 0 0.32 0 0 0 1 /end COMPU_METHOD
/begin COMPU_METHOD AltTyp_COMPU_VERB "" TAB_VERB "%6.3" "" COMPU_TAB_REF AltTyp_COMPU_VERB /end COMPU_METHOD
/begin COMPU_VTAB AltTyp_COMPU_VERB "" TAB_VERB 3 1 "BSS1" 2 "BSS2" 3 "Undefined alternator type" /end COMPU_VTAB
/begin COMPU_METHOD AltVltgNom_COMPU_VERB "" TAB_VERB "%6.3" "V" COMPU_TAB_REF AltVltgNom_COMPU_VERB /end COMPU_METHOD
/begin COMPU_VTAB AltVltgNom_COMPU_VERB "" TAB_VERB 3 0 "14" 1 "42" 2 "" DEFAULT_VALUE "Undefined value" /end COMPU_VTAB
/begin COMPU_METHOD AltVltg_V_q0p1_COMPU "" RAT_FUNC "%6.2" "V" COEFFS 0 10 -106 0 0 1 /end COMPU_METHOD
/begin COMPU_METHOD AngleStWhl "" RAT_FUNC "%6.4" "deg StWhl" COEFFS 0 32 0 0 0 1 /end COMPU_METHOD
/begin COMPU_METHOD AngleVelStWhl "" RAT_FUNC "%6.4" "deg StWhl/s" COEFFS 0 32 0 0 0 1 /end COMPU_METHOD
/begin COMPU_METHOD CoEOMSwt_S16 "" RAT_FUNC "%7.6" "-" COEFFS 0 16384 0 0 0 1 /end COMPU_METHOD
/begin COMPU_METHOD dn_dZ20 "" RAT_FUNC "%6.2" "rpm/s" COEFFS 0 0.2 0 0 0 1 /end COMPU_METHOD
/begin COMPU_METHOD EngN "" RAT_FUNC "%5.1" "rpm" COEFFS 0 2 0 0 0 1 /end COMPU_METHOD
/begin COMPU_METHOD EngN1 "" RAT_FUNC "%6.3" "rpm" COEFFS 0 2 0 0 0 1 /end COMPU_METHOD
/begin COMPU_METHOD EngTempFldSel "" TAB_VERB "%6.3" "" COMPU_TAB_REF EngTempFldSel /end COMPU_METHOD
/begin COMPU_VTAB EngTempFldSel "" TAB_VERB 4 0 "Coolant_Temperature" 1 "Oil_Temperature" 2 "EngDa_tEng" 3 "Chamberwall_Temperature" /end COMPU_VTAB
/begin COMPU_METHOD Fact "" RAT_FUNC "%6.5" "-" COEFFS 0 8192 0 0 0 1 /end COMPU_METHOD
/begin COMPU_METHOD Fact1 "" RAT_FUNC "%6.4" "-" COEFFS 0 128 0 0 0 1 /end COMPU_METHOD
/begin COMPU_METHOD InjMass "" RAT_FUNC "%5.2" "mg/hub" COEFFS 0 100 0 0 0 1 /end COMPU_METHOD
/begin COMPU_METHOD Kd "" RAT_FUNC "%7.6" "1/1" COEFFS 0 65536 0 0 0 1 /end COMPU_METHOD
/begin COMPU_METHOD Kd_Ampc2Prc "" RAT_FUNC "%8.7" "%/(mg/Hub Luft)" COEFFS 0 536870.912 0 0 0 1 /end COMPU_METHOD
/begin COMPU_METHOD Kd_Ampc2PrcRedRes "" RAT_FUNC "%6.4" "%/(mg/Hub Luft)" COEFFS 0 524.288 0 0 0 1 /end COMPU_METHOD
/begin COMPU_METHOD Kd_RedRes "" RAT_FUNC "%6.4" "1/1" COEFFS 0 64 0 0 0 1 /end COMPU_METHOD
/begin COMPU_METHOD Ki_Ampc2Prc "" RAT_FUNC "%7.6" "%/(mg/Hub Luft)/s" COEFFS 0 17592.186044416 0 0 0 1 /end COMPU_METHOD
/begin COMPU_METHOD Kp_Ampc2Prc "" RAT_FUNC "%8.7" "%/(mg/Hub Luft)" COEFFS 0 268435.456 0 0 0 1 /end COMPU_METHOD
/begin COMPU_METHOD OneToOne "" RAT_FUNC "%6.0" "-" COEFFS 0 1 0 0 0 1 /end COMPU_METHOD
/begin COMPU_METHOD Prc "" RAT_FUNC "%6.4" "%" COEFFS 0 81.92 0 0 0 1 /end COMPU_METHOD
/begin COMPU_METHOD PrcEGRRmp "" RAT_FUNC "%6.3" "%" COEFFS 0 6.5536 0 0 0 1 /end COMPU_METHOD
/begin COMPU_METHOD PrcPerSec "" RAT_FUNC "%6.3" "%/s" COEFFS 0 1.6384 0 0 0 1 /end COMPU_METHOD
/begin COMPU_METHOD PrcPerSec_10ms "" RAT_FUNC "%6.2" "%/s" COEFFS 0 0.8192 0 0 0 1 /end COMPU_METHOD
/begin COMPU_METHOD Pres_hPa "" RAT_FUNC "%5.1" "hPa" COEFFS 0 1 0 0 0 1 /end COMPU_METHOD
/begin COMPU_METHOD RmpAirMassPerCyl "" RAT_FUNC "%6.4" "mg/hub/s" COEFFS 0 655.36 0 0 0 1 /end COMPU_METHOD
/begin COMPU_METHOD RmpPrc "" RAT_FUNC "%6.5" "%/s" COEFFS 0 5368.70912 0 0 0 1 /end COMPU_METHOD
/begin COMPU_METHOD SlopeRes10 "" RAT_FUNC "%6.3" "-" COEFFS 0 10 0 0 0 1 /end COMPU_METHOD
/begin COMPU_METHOD SlopeRes100 "" RAT_FUNC "%6.4" "-" COEFFS 0 100 0 0 0 1 /end COMPU_METHOD
/begin COMPU_METHOD Temp_Cels "" RAT_FUNC "%5.1" "deg C" COEFFS 0 10 2731.4 0 0 1 /end COMPU_METHOD
/begin COMPU_METHOD TimeCoEOMRmp "" RAT_FUNC "%6.3" "s" COEFFS 0 0 1 0 0.0152587890625 0 /end COMPU_METHOD
/begin COMPU_METHOD TimeDeb "" RAT_FUNC "%5.0" "ms" COEFFS 0 0.1 0 0 0 1 /end COMPU_METHOD
/begin COMPU_METHOD TimeDelay_ms "" RAT_FUNC "%12.1" "ms" COEFFS 0 0 1 0 2.3283064365387e-007 0 /end COMPU_METHOD
/begin COMPU_METHOD TimeDelay_ms_Lin_16 "" RAT_FUNC "%6.3" "ms" COEFFS 0 1.63835 0 0 0 1 /end COMPU_METHOD
/begin COMPU_METHOD TimeDelay_s "" RAT_FUNC "%12.4" "s" COEFFS 0 0 1 0 0.00023283064365387 0 /end COMPU_METHOD
/begin COMPU_METHOD Time_ms "" RAT_FUNC "%5.0" "ms" COEFFS 0 0.1 0 0 0 1 /end COMPU_METHOD
/begin COMPU_METHOD Time_s "" RAT_FUNC "%5.2" "s" COEFFS 0 100 0 0 0 1 /end COMPU_METHOD
/begin COMPU_METHOD Trq "" RAT_FUNC "%5.1" "Nm" COEFFS 0 10 0 0 0 1 /end COMPU_METHOD
/begin COMPU_METHOD Vel "" RAT_FUNC "%5.2" "km/h" COEFFS 0 100 0 0 0 1 /end COMPU_METHOD
/begin COMPU_METHOD Volt "" RAT_FUNC "%6.1" "mV" COEFFS 0 5 0 0 0 1 /end COMPU_METHOD
/begin COMPU_METHOD Volt_Batt "" RAT_FUNC "%5.0" "mV" COEFFS 0 0.05 0 0 0 1 /end COMPU_METHOD
/begin RECORD_LAYOUT Cur_Xs16Ws16 NO_AXIS_PTS_X 1 SWORD AXIS_PTS_X 2 SWORD INDEX_INCR DIRECT FNC_VALUES 3 SWORD COLUMN_DIR DIRECT /end RECORD_LAYOUT
/begin RECORD_LAYOUT Kf_Xs16_Ys16_Ws16 NO_AXIS_PTS_X 1 SWORD NO_AXIS_PTS_Y 2 SWORD AXIS_PTS_X 3 SWORD INDEX_INCR DIRECT AXIS_PTS_Y 4 SWORD INDEX_INCR DIRECT FNC_VALUES 5 SWORD COLUMN_DIR DIRECT /end RECORD_LAYOUT
/begin RECORD_LAYOUT Kl_Xs16_Ws16 NO_AXIS_PTS_X 1 SWORD AXIS_PTS_X 2 SWORD INDEX_INCR DIRECT FNC_VALUES 3 SWORD COLUMN_DIR DIRECT /end RECORD_LAYOUT
/begin RECORD_LAYOUT Kw_Ws16 FNC_VALUES 1 SWORD COLUMN_DIR DIRECT /end RECORD_LAYOUT
/begin RECORD_LAYOUT Kw_Ws32 FNC_VALUES 1 SLONG COLUMN_DIR DIRECT /end RECORD_LAYOUT
/begin RECORD_LAYOUT Kw_Ws8 FNC_VALUES 1 SBYTE COLUMN_DIR DIRECT /end RECORD_LAYOUT
/begin RECORD_LAYOUT Kw_Wu32 FNC_VALUES 1 ULONG COLUMN_DIR DIRECT /end RECORD_LAYOUT
/begin RECORD_LAYOUT Kw_Wu8 FNC_VALUES 1 UBYTE COLUMN_DIR DIRECT /end RECORD_LAYOUT
/begin RECORD_LAYOUT Map_Xs16Ys16Ws16 NO_AXIS_PTS_X 1 SWORD NO_AXIS_PTS_Y 2 SWORD AXIS_PTS_X 3 SWORD INDEX_INCR DIRECT AXIS_PTS_Y 4 SWORD INDEX_INCR DIRECT FNC_VALUES 5 SWORD COLUMN_DIR DIRECT /end RECORD_LAYOUT
/begin RECORD_LAYOUT ValA_Ws16 FNC_VALUES 1 SWORD COLUMN_DIR DIRECT /end RECORD_LAYOUT
/begin RECORD_LAYOUT ValA_Wu32 FNC_VALUES 1 ULONG COLUMN_DIR DIRECT /end RECORD_LAYOUT
/begin RECORD_LAYOUT Val_Ws16 FNC_VALUES 1 SWORD COLUMN_DIR DIRECT /end RECORD_LAYOUT
/begin RECORD_LAYOUT Val_Ws32 FNC_VALUES 1 SLONG COLUMN_DIR DIRECT /end RECORD_LAYOUT
/begin RECORD_LAYOUT Val_Wu16 FNC_VALUES 1 UWORD COLUMN_DIR DIRECT /end RECORD_LAYOUT
/begin RECORD_LAYOUT Val_Wu32 FNC_VALUES 1 ULONG COLUMN_DIR DIRECT /end RECORD_LAYOUT
/begin RECORD_LAYOUT Val_Wu8 FNC_VALUES 1 UBYTE COLUMN_DIR DIRECT /end RECORD_LAYOUT
/end MODULE
/end PROJECT

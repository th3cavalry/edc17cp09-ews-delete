ASAP2_VERSION 1 4
/begin PROJECT P_574 "EDC17_CP09"
/begin HEADER "" VERSION "V8KB" PROJECT_NO P_574 /end HEADER
/begin MODULE DIM ""
/begin MOD_COMMON "" BYTE_ORDER MSB_LAST ALIGNMENT_BYTE 1 ALIGNMENT_WORD 2 ALIGNMENT_LONG 4 ALIGNMENT_FLOAT32_IEEE 4 /end MOD_COMMON
/begin CHARACTERISTIC CByVlv_DigOut.tiBtwTstSCB_C "/" VALUE 0x80037AE2 Kw_Ws16 655350.0 Time_ms -327680.0 327670.0 /end CHARACTERISTIC
/begin CHARACTERISTIC CByVlv_DigOut.tiBtwTstOT_C "/" VALUE 0x80037AE4 Kw_Ws16 655.3500 Time_s -327.6800 327.6700 /end CHARACTERISTIC
/begin CHARACTERISTIC CByVlv_DigOut.numTstMax_C "/" VALUE 0x80037AE6 Kw_Wu16 65535.00 OneToOne 0.00 65535.00 /end CHARACTERISTIC
/begin CHARACTERISTIC CByVlv_stPsDiaDisbl_C "Maske zur Auswahl der Sperrbedingungen von der Diagnose" VALUE 0x80037AE8 Val_Wu8 255.0 OneToOne 0.00 255.0 /end CHARACTERISTIC
/begin CHARACTERISTIC CByVlv_stPsDisbl_C "Maske zur Auswahl der Sperrbedingungen von der Endstufe" VALUE 0x80037AE9 Val_Wu8 255.0 OneToOne 0.00 255.0 /end CHARACTERISTIC
/begin CHARACTERISTIC CEngDsT_dtFlTempDwn_C "" VALUE 0x80063A40 Val_Ws32 4294967295.00 TempCels_100ms -2147483648.00 2147483647.00 FORMAT "%13.2" /end CHARACTERISTIC
/begin CHARACTERISTIC CEngDsT_dtFlTempUp_C "" VALUE 0x80063A44 Val_Ws32 4294967295.00 TempCels_100ms -2147483648.00 2147483647.00 FORMAT "%13.2" /end CHARACTERISTIC
/begin CHARACTERISTIC CEngDsT_dtMinDynTst_C "" VALUE 0x80037B60 Val_Ws16 6553.500 TempDiff_Kelv -3276.800 3276.700 /end CHARACTERISTIC
/begin CHARACTERISTIC CEngDsT_nMinEnaDynTst_C "" VALUE 0x80037B62 Val_Ws16 10000.00 EngN 0.00 10000.00 EXTENDED_LIMITS -16384.00 16383.50 /end CHARACTERISTIC
/begin CHARACTERISTIC CEngDsT_qMinEnaDynTst_C "" VALUE 0x80037B64 Val_Ws16 327.6700 InjMass 0.00 327.6700 EXTENDED_LIMITS -327.6800 327.6700 /end CHARACTERISTIC
/begin CHARACTERISTIC CEngDsT_Rmp1.Pos_C "/" VALUE 0x80037B44 Kw_Ws32 3276798.99750 RmpTemp 1.00097656250 3276799.99847 FORMAT "%13.5" EXTENDED_LIMITS -3276800.00000 3276799.99847 /end CHARACTERISTIC
/begin CHARACTERISTIC CEngDsT_Rmp1.Neg_C "/" VALUE 0x80037B48 Kw_Ws32 3276798.99750 RmpTemp 1.00097656250 3276799.99847 FORMAT "%13.5" EXTENDED_LIMITS -3276800.00000 3276799.99847 /end CHARACTERISTIC
/begin CHARACTERISTIC CEngDsT_Rmp2.Pos_C "/" VALUE 0x80037B4C Kw_Ws32 3276798.99750 RmpTemp 1.00097656250 3276799.99847 FORMAT "%13.5" EXTENDED_LIMITS -3276800.00000 3276799.99847 /end CHARACTERISTIC
/begin CHARACTERISTIC CEngDsT_Rmp2.Neg_C "/" VALUE 0x80037B50 Kw_Ws32 3276798.99750 RmpTemp 1.00097656250 3276799.99847 FORMAT "%13.5" EXTENDED_LIMITS -3276800.00000 3276799.99847 /end CHARACTERISTIC
/begin CHARACTERISTIC CEngDsT_SRC.uMin_C "/" VALUE 0x80037AEA Kw_Ws16 5200.000 Volt 0.00 5200.000 EXTENDED_LIMITS -6553.600 6553.400 /end CHARACTERISTIC
/begin CHARACTERISTIC CEngDsT_SRC.uMax_C "/" VALUE 0x80037AEC Kw_Ws16 5200.000 Volt 0.00 5200.000 EXTENDED_LIMITS -6553.600 6553.400 /end CHARACTERISTIC
/begin CHARACTERISTIC CEngDsT_stSensID_C "" VALUE 0x80037B54 Kw_Wu8 255.0 OneToOne 0.00 255.0 /end CHARACTERISTIC
/begin CHARACTERISTIC CEngDsT_swtPHtrIgnoreCAN_C "" VALUE 0x80063A48 Val_Ws16 1.000000 OneToOne 0.00 1.000000 EXTENDED_LIMITS -32768.00 32767.00 /end CHARACTERISTIC
/begin CHARACTERISTIC CEngDsT_swtSensPres_C "" VALUE 0x80037AEE Val_Wu8 1.000 OneToOne 0.00 1.000 EXTENDED_LIMITS 0.00 255.0 /end CHARACTERISTIC
/begin CHARACTERISTIC CEngDsT_tClntMin_C "" VALUE 0x80063A4A Val_Ws16 200.0000 Temp_Cels -50.14000 149.8600 EXTENDED_LIMITS -3549.940 3003.560 /end CHARACTERISTIC
/begin CHARACTERISTIC CEngDsT_tDflCold_C "" VALUE 0x80037B56 Kw_Ws16 250.0000 Temp_Cels -50.04000 199.9600 EXTENDED_LIMITS -3549.940 3003.560 /end CHARACTERISTIC
/begin CHARACTERISTIC CEngDsT_tDflWarm_C "" VALUE 0x80037B58 Kw_Ws16 250.0000 Temp_Cels -50.04000 199.9600 EXTENDED_LIMITS -3549.940 3003.560 /end CHARACTERISTIC
/begin CHARACTERISTIC CEngDsT_tDiffThres_C "" VALUE 0x80063A4C Val_Ws16 200.0000 TempDiff_Kelv -50.10000 149.9000 EXTENDED_LIMITS -3276.800 3276.700 /end CHARACTERISTIC
/begin CHARACTERISTIC CEngDsT_tFlSysMin_C "" VALUE 0x80063A4E Val_Ws16 200.0000 Temp_Cels -50.14000 149.8600 EXTENDED_LIMITS -3549.940 3003.560 /end CHARACTERISTIC
/begin CHARACTERISTIC CEngDsT_tiMaxDynTst_CUR "" CURVE 0x80037B66 Cur_Xs16Ws16 167769.6 Time_DynTst -83886.08 83883.52 FORMAT "%8.2"
 /begin AXIS_DESCR STD_AXIS CEngDsT_tStrt Temp_Cels 10 -50.14000 149.8600 EXTENDED_LIMITS -3549.940 3003.560 DEPOSIT ABSOLUTE /end AXIS_DESCR
/end CHARACTERISTIC
/begin CHARACTERISTIC CEngDsT_tiPT1T1_C "" VALUE 0x80037B5C Val_Ws32 4294.9672940 TimeDelay_s 0.000002000000001 4294.9672960 FORMAT "%12.7" /end CHARACTERISTIC
/begin CHARACTERISTIC CEngDsT_tiWait_C "" VALUE 0x80063A50 Val_Ws16 655350.0 Time_ms -327680.0 327670.0 /end CHARACTERISTIC
/begin CHARACTERISTIC CEngDsT_tMinDynTst_C "" VALUE 0x80037B90 Val_Ws16 200.0000 Temp_Cels -50.14000 149.8600 EXTENDED_LIMITS -3549.940 3003.560 /end CHARACTERISTIC
/begin CHARACTERISTIC CEngDsT_tTransf_CUR "" CURVE 0x80037AF0 Cur_Xs16Ws16 250.0000 Temp_Cels -50.04000 199.9600 EXTENDED_LIMITS -3549.940 3003.560
 /begin AXIS_DESCR STD_AXIS CEngDsT_uRaw Volt 20 0.00 5200.000 EXTENDED_LIMITS -6553.600 6553.400 DEPOSIT ABSOLUTE /end AXIS_DESCR
/end CHARACTERISTIC
/begin CHARACTERISTIC Clth_Deb.tiHiLo_C "Struktur zum Speichern der Parameter zur Entprellung des Kupplungsignals/" VALUE 0x80037BF0 Kw_Ws16 655350.0 TimeDeb -327680.0 327670.0 /end CHARACTERISTIC
/begin CHARACTERISTIC Clth_Deb.tiLoHi_C "Struktur zum Speichern der Parameter zur Entprellung des Kupplungsignals/" VALUE 0x80037BF2 Kw_Ws16 655350.0 TimeDeb -327680.0 327670.0 /end CHARACTERISTIC
/begin CHARACTERISTIC Clth_nNoGearShftDet_C "Drehzahlschwelle zur Erkennung des Gangwechsels" VALUE 0x80037BFA Val_Ws16 6000.000 EngN 0.00 6000.000 EXTENDED_LIMITS -16384.00 16383.50 /end CHARACTERISTIC
/begin CHARACTERISTIC Clth_stDflVal_C "Vorgegebener Wert des Kupplungssignals im Fehlerfall" VALUE 0x80037BFC Val_Wu8 255.0 OneToOne 0.00 255.0 /end CHARACTERISTIC
/begin CHARACTERISTIC Clth_stOpn_C "Bitmaske zur Erkennung des offenen Kupplungsstatus" VALUE 0x80037BF4 Val_Wu8 255.0 OneToOne 0.00 255.0 /end CHARACTERISTIC
/begin CHARACTERISTIC Clth_stSlipClsd_C "Bitmaske zur Erkennung des Schlupfs, während die Kupplung geschlossen ist" VALUE 0x80037BF5 Val_Wu8 255.0 OneToOne 0.00 255.0 /end CHARACTERISTIC
/begin CHARACTERISTIC Clth_stSlipOpn_C "Bitmaske zur Erkennung des Schlupfs, während die Kupplung offen ist" VALUE 0x80037BF6 Val_Wu8 255.0 OneToOne 0.00 255.0 /end CHARACTERISTIC
/begin CHARACTERISTIC Clth_stSlip_C "Bitmaske zur Erkennung, ob es einen Schlupf in der Kupplung gibt" VALUE 0x80037BF7 Val_Wu8 255.0 OneToOne 0.00 255.0 /end CHARACTERISTIC
/begin CHARACTERISTIC Clth_swtSig_C "Schalter zur Auswahl der Kupplungssignalquelle" VALUE 0x80037BF8 Val_Wu8 255.0 OneToOne 0.00 255.0 /end CHARACTERISTIC
/begin CHARACTERISTIC Clth_tiGearShft_C "Zeit zur Erkennung eines Gangwechsels" VALUE 0x80037BFE Val_Ws16 327570.0 Time_ms 0.00 327570.0 EXTENDED_LIMITS -327680.0 327670.0 /end CHARACTERISTIC
/begin CHARACTERISTIC Clth_vNoGearShftDet_C "Fahrgeschwindigkeitsschwelle zur Erkennung der Gangänderung" VALUE 0x80037C00 Val_Ws16 300.0000 Vel 0.00 300.0000 EXTENDED_LIMITS -327.6800 327.6700 /end CHARACTERISTIC
/begin CHARACTERISTIC CmbChb_ctEngRevPerBlk_C "Blockgroesse (UpM) f. Ausbl./Test/Ausw.verz." VALUE 0x80037C06 Val_Ws16 65535.00 OneToOne -32768.00 32767.00 /end CHARACTERISTIC
/begin CHARACTERISTIC CmbChb_ctMisfMax_C "maximale Anzahl von Aussetzern pro Test" VALUE 0x80037C08 Val_Ws16 65535.00 OneToOne -32768.00 32767.00 /end CHARACTERISTIC
/begin CHARACTERISTIC CmbChb_ctMisfTempSel_C "Auszulesende Motortemperatur aus dem Motortemperaturenfeld" VALUE 0x80037C18 Val_Wu8 3.00000000000 EngTempFldSel 0.00 3.00000000000 FORMAT "%13.11" /end CHARACTERISTIC
/begin CHARACTERISTIC CmbChb_ctSegTDC1_C "Offset für internen Segmentzähler in Aussetzererkennung" VALUE 0x80037C0A Val_Ws16 24.00000 OneToOne 0.00 24.00000 EXTENDED_LIMITS -32768.00 32767.00 /end CHARACTERISTIC
/begin CHARACTERISTIC CmbChb_nEngThresHi_C "maximale Drehzahl fuer Ueberwachung" VALUE 0x80037C1A Val_Ws16 6000.000 EngN1 0.00 6000.000 FORMAT "%8.3" EXTENDED_LIMITS -16384.00 16383.50 /end CHARACTERISTIC
/begin CHARACTERISTIC CmbChb_nEngThresLo_C "minimale Drehzahl fuer Ueberwachung" VALUE 0x80037C1C Val_Ws16 6000.000 EngN1 0.00 6000.000 FORMAT "%8.3" EXTENDED_LIMITS -16384.00 16383.50 /end CHARACTERISTIC
/begin CHARACTERISTIC CmbChb_numBlk_C "Blockanzahl fuer Test" VALUE 0x80037C0C Val_Ws16 65535.00 OneToOne -32768.00 32767.00 /end CHARACTERISTIC
/begin CHARACTERISTIC CmbChb_phiSegLngth_CA "Segmentlänge für gerade und ungerade Segmente" VAL_BLK 0x80037C0E ValA_Ws16 113.9941 AngleCrS 5.998535 119.9927 EXTENDED_LIMITS -720.0000 719.9780 NUMBER 2 /end CHARACTERISTIC
/begin CHARACTERISTIC CmbChb_phiSegPosOfs_CA "Segmentoffset für Berechnung Segment-Endposition" VAL_BLK 0x80037C12 ValA_Ws16 119.9927 AngleCrS 0.00 119.9927 EXTENDED_LIMITS -720.0000 719.9780 NUMBER 2 /end CHARACTERISTIC
/begin CHARACTERISTIC CmbChb_qSetThresHi_C "obere Mengenschwelle für Aktivierung Aussetzererkennung" VALUE 0x80037C1E Val_Ws16 655.3500 InjMass -327.6800 327.6700 /end CHARACTERISTIC
/begin CHARACTERISTIC CmbChb_qSetThresLo_C "untere Mengenschwelle für Aktivierung Aussetzererkennung" VALUE 0x80037C20 Val_Ws16 655.3500 InjMass -327.6800 327.6700 /end CHARACTERISTIC
/begin CHARACTERISTIC CmbChb_rSpdIncrMin_C "Verhältnis minimaler zu durchschnittlicher Drehzahlanstieg" VALUE 0x80037C16 Val_Ws16 799.9878 Prc -400.0000 399.9878 /end CHARACTERISTIC
/begin CHARACTERISTIC CmbChb_stClth_C "Schalter: Aktivierung der Aussetzererkennung abhängig vom Kupplungszustand" VALUE 0x80037C22 Val_Wu8 3.000 default 0.00 3.000 FORMAT "%5.3" EXTENDED_LIMITS 0.00 255.0 /end CHARACTERISTIC
/begin CHARACTERISTIC CmbChb_tEngThresLo_C "minimale Motortemperatur für Aktivierung Aussetzererkennung" VALUE 0x80037C24 Val_Ws16 3003.700 Temp_Cels -0.1400000 3003.560 EXTENDED_LIMITS -3549.940 3003.560 /end CHARACTERISTIC
/begin CHARACTERISTIC CmbChb_tiDebClthChng_C "Entprellzeit für die Zustandsänderung des Kupplungssignals" VALUE 0x80037C26 Val_Ws16 655350.0 Time_ms -327680.0 327670.0 /end CHARACTERISTIC
/begin CHARACTERISTIC CmbChb_tiDelStrt_C "Startausblendezeit für Aussetzererkennung" VALUE 0x80037C28 Val_Wu16 655350.0 Time_ms 0.00 655350.0 /end CHARACTERISTIC
/begin CHARACTERISTIC CmbChb_vThresHi_C "maximale Geschwindigkeit fuer Ueberwachung" VALUE 0x80037C2A Val_Ws16 327.6700 Vel 0.00 327.6700 EXTENDED_LIMITS -327.6800 327.6700 /end CHARACTERISTIC
/begin CHARACTERISTIC CmbCWT_TransStg.Dfl_C "/" VALUE 0x80037C02 Kw_Ws16 490.0000 Temp_Cels 9.960000 499.9600 EXTENDED_LIMITS -3549.940 3003.560 /end CHARACTERISTIC
/begin CHARACTERISTIC CmbCWT_TransStg.stSensId_C "/" VALUE 0x80037C04 Kw_Wu8 255.0 OneToOne 0.00 255.0 /end CHARACTERISTIC
/begin CHARACTERISTIC CnvLead_facRmpVal_CUR "Kennlinie für Rampenfaktor Umschaltrampe" CURVE 0x80037C2C Cur_Xs16Ws16 1.000000 CoEOMSwt_S16 0.00 1.000000 FORMAT "%8.6" EXTENDED_LIMITS -2.000000 1.999939
 /begin AXIS_DESCR STD_AXIS CoEOM_facRmpVal CoEOMSwt_S16 11 0.00 1.000000 FORMAT "%8.6" EXTENDED_LIMITS -2.000000 1.999939 DEPOSIT ABSOLUTE /end AXIS_DESCR
/end CHARACTERISTIC
/begin CHARACTERISTIC CnvSet_eta0_C "Umrechnungswirkungsgrad während Start" VALUE 0x80037C5A Val_Ws16 20.00000 Eta3 0.00 20.00000 FORMAT "%8.5" EXTENDED_LIMITS -256.0000 255.9922 /end CHARACTERISTIC
/begin CHARACTERISTIC CnvSet_etaIni_C "Initialisierungswert für Umrechnungswirkungsgrade" VALUE 0x80037C5C Val_Ws16 20.00000 Eta3 0.00 20.00000 FORMAT "%8.5" EXTENDED_LIMITS -256.0000 255.9922 /end CHARACTERISTIC
/begin CHARACTERISTIC CnvSet_facRmpVal_CUR "Kennlinie für Rampenfaktor Umschaltrampe" CURVE 0x80037C5E Cur_Xs16Ws16 1.000000 CoEOMSwt_S16 0.00 1.000000 FORMAT "%8.6" EXTENDED_LIMITS -2.000000 1.999939
 /begin AXIS_DESCR STD_AXIS CoEOM_facRmpVal CoEOMSwt_S16 11 0.00 1.000000 FORMAT "%8.6" EXTENDED_LIMITS -2.000000 1.999939 DEPOSIT ABSOLUTE /end AXIS_DESCR
/end CHARACTERISTIC
/begin CHARACTERISTIC CodVar_mskFlLPCSelfRec_C "" VALUE 0x800384F2 Val_Wu8 3.000 OneToOne 0.00 3.000 EXTENDED_LIMITS 0.00 255.0 /end CHARACTERISTIC
/begin CHARACTERISTIC CodVar_stFlLPCSelfRec_C "" VALUE 0x800384F3 Val_Wu8 255.0 OneToOne 0.00 255.0 /end CHARACTERISTIC
/begin CHARACTERISTIC CoEng_AftRunShOff_C "Das Label um Abschalt-Pfad im Zustand after-run zu setzen." VALUE 0x800383D0 Val_Wu32 4294967295.00 OneToOne 0.00 4294967295.00 /end CHARACTERISTIC
/begin CHARACTERISTIC CoEng_nSoftShOffMax_C "Maximale Drehzahlschwelle um soft shutoff zu aktivieren" VALUE 0x800383D4 Val_Ws16 6000.000 EngN 0.00 6000.000 EXTENDED_LIMITS -16384.00 16383.50 /end CHARACTERISTIC
/begin CHARACTERISTIC CoEng_nSoftShOffMinRls_C "" VALUE 0x800383D6 Val_Ws16 6000.000 EngN 0.00 6000.000 EXTENDED_LIMITS -16384.00 16383.50 /end CHARACTERISTIC
/begin CHARACTERISTIC CoEng_nSoftShOffMin_C "Minimale Drehzahlschwelle um soft shutoff zu aktivieren" VALUE 0x800383D8 Val_Ws16 6000.000 EngN 0.00 6000.000 EXTENDED_LIMITS -16384.00 16383.50 /end CHARACTERISTIC
/begin CHARACTERISTIC CoEng_nThresCranking_C "Drehzahlschwelle für den Übergang von COENG_READY nach COENG_CRANKING" VALUE 0x800383EC Val_Ws16 32767.50 EngN -16384.00 16383.50 /end CHARACTERISTIC
/begin CHARACTERISTIC CoEng_nThresNrml2Strt_C "Motordrehzahlschwelle für Zustandsübergang von NORMAL nach START" VALUE 0x800383EE Val_Ws16 8000.000 EngN 0.00 8000.000 EXTENDED_LIMITS -16384.00 16383.50 /end CHARACTERISTIC
/begin CHARACTERISTIC CoEng_qSoftShOffMax_C "Maximale Einspritzmenge um soft shutoff zu aktivieren" VALUE 0x800383DA Val_Ws16 50.00000 InjMass 0.00 50.00000 EXTENDED_LIMITS -327.6800 327.6700 /end CHARACTERISTIC
/begin CHARACTERISTIC CoEng_SoftShOff_C "Activated soft shut off path" VALUE 0x800383DC Val_Wu32 4294967295.00 OneToOne 0.00 4294967295.00 /end CHARACTERISTIC
/begin CHARACTERISTIC CoEng_stShutOffInit_C "Das Applikations-label welches CoEng_stShutOffPath mit dem Default- wert initialisiert." VALUE 0x800383E0 Val_Wu32 4294967295.00 OneToOne 0.00 4294967295.00 /end CHARACTERISTIC
/begin CHARACTERISTIC CoEng_stStandbyShOff_C "Label um Abschalt-Pfade im Zustand Standby zu setzen" VALUE 0x800383E4 Val_Wu32 4294967295.00 OneToOne 0.00 4294967295.00 /end CHARACTERISTIC
/begin CHARACTERISTIC CoEng_stStopEna_C "Wählt ob Motorstopp erlaubt oder verboten ist" VALUE 0x800383F4 Val_Wu8 255.0 OneToOne 0.00 255.0 /end CHARACTERISTIC
/begin CHARACTERISTIC CoEng_stStrtEna_C "Wählt ob Motorstart erlaubt oder verboten ist" VALUE 0x800383F5 Val_Wu8 255.0 OneToOne 0.00 255.0 /end CHARACTERISTIC
/begin CHARACTERISTIC CoEng_tiNrml2Strt_C "Entprellzeit für Zustandsübergang von NORMAL nach START" VALUE 0x800383F0 Val_Ws16 655350.0 Time_ms -327680.0 327670.0 /end CHARACTERISTIC
/begin CHARACTERISTIC CoEng_tiPwrStgDiaRdy_C "Verzoegerungszeit, um im Nachlauf abgeschaltete Steller zu diagnostizieren" VALUE 0x800383F2 Val_Ws16 655350.0 Time_ms -327680.0 327670.0 /end CHARACTERISTIC
/begin CHARACTERISTIC CoEng_tiSoftShOff_C "Verzögerungszeit der Mengenabstellung bei Komforabschaltung" VALUE 0x800383E8 Val_Wu16 300.0000 Time_ms 0.00 300.0000 EXTENDED_LIMITS 0.00 655350.0 /end CHARACTERISTIC
/begin CHARACTERISTIC CoEng_vSoftShOffMax_C "Schwelle für Fahrgeschwindigkeit um Soft shut off zu aktivieren" VALUE 0x800383EA Val_Ws16 20.00000 Vel 0.00 20.00000 EXTENDED_LIMITS -327.6800 327.6700 /end CHARACTERISTIC
/begin CHARACTERISTIC CoEOM_Prio2_CA "Priorität zur Gewichtung der Betriebsartenwünsche" VAL_BLK 0x800383AC ValA_Wu8 4.000 OneToOne 0.00 4.000 EXTENDED_LIMITS 0.00 255.0 NUMBER 9 /end CHARACTERISTIC
/begin CHARACTERISTIC CoEOM_stDSCHEDPrio_C "Priorität der Betriebsartenanforderung von DSCHED" VALUE 0x800383B5 Val_Wu8 15.00 OneToOne 0.00 15.00 EXTENDED_LIMITS 0.00 255.0 /end CHARACTERISTIC
/begin CHARACTERISTIC CoEOM_stNxtOpMode_CA "Matrix mit Bitmasken der Betriebsarten, die von der aktuellen Betriebsart aus direkt aktiviert werden können." MAP 0x80037C8C Kf_Xs16_Ys16_Ws16 65535.00 OneToOne -32768.00 32767.00
 /begin AXIS_DESCR STD_AXIS CoEOM_numOpModeAct_mp OneToOne 16 0.00 255.0 DEPOSIT ABSOLUTE /end AXIS_DESCR
 /begin AXIS_DESCR STD_AXIS CoEOM_numStageAct_mp OneToOne 11 0.00 255.0 DEPOSIT ABSOLUTE /end AXIS_DESCR
/end CHARACTERISTIC
/begin CHARACTERISTIC CoEOM_stNxtStage_CA "Matrix mit Bitmasken der Stufen, die von der aktuelle Betriebsart aus direkt aktiviert werden können" MAP 0x80037E26 Kf_Xs16_Ys16_Ws16 65535.00 OneToOne -32768.00 32767.00
 /begin AXIS_DESCR STD_AXIS CoEOM_numOpModeAct_mp OneToOne 16 0.00 255.0 DEPOSIT ABSOLUTE /end AXIS_DESCR
 /begin AXIS_DESCR STD_AXIS CoEOM_numStageAct_mp OneToOne 11 0.00 255.0 DEPOSIT ABSOLUTE /end AXIS_DESCR
/end CHARACTERISTIC
/begin CHARACTERISTIC CoEOM_stOpModeAirCtlHPMix_C "" VALUE 0x800383B8 Kw_Wu32 4294967295.00 OneToOne 0.00 4294967295.00 /end CHARACTERISTIC
/begin CHARACTERISTIC CoEOM_stOpModeCByVlv_C "" VALUE 0x800383BC Val_Wu32 4294967295.00 OneToOne 0.00 4294967295.00 /end CHARACTERISTIC
/begin CHARACTERISTIC CoEOM_stOpModeDes_C "Label zur direkten Vorgabe der Betriebsart" VALUE 0x80037FC0 Kw_Wu32 4294967295.00 OneToOne 0.00 4294967295.00 /end CHARACTERISTIC
/begin CHARACTERISTIC CoEOM_stOpModeDL_CA "Matrix mit Betriebsarten zum Beenden der aktuellen Betriebsart bei einem Deadlock" MAP 0x80037FC4 Kf_Xs16_Ys16_Ws16 65535.00 OneToOne -32768.00 32767.00
 /begin AXIS_DESCR STD_AXIS CoEOM_numOpModeAct_mp OneToOne 16 0.00 255.0 DEPOSIT ABSOLUTE /end AXIS_DESCR
 /begin AXIS_DESCR STD_AXIS CoEOM_numStageAct_mp OneToOne 11 0.00 255.0 DEPOSIT ABSOLUTE /end AXIS_DESCR
/end CHARACTERISTIC
/begin CHARACTERISTIC CoEOM_stOpModeMax_C "Bitmaske zum Verbieten von Betriebsarten" VALUE 0x80038160 Kw_Wu32 65535.0000000 OneToOne 0.00 65535.0000000 EXTENDED_LIMITS 0.00 4294967295.00 /end CHARACTERISTIC
/begin CHARACTERISTIC CoEOM_stOpModePil2_C "" VALUE 0x800383C0 Val_Wu32 4294967295.00 OneToOne 0.00 4294967295.00 /end CHARACTERISTIC
/begin CHARACTERISTIC CoEOM_stOpMode_C "Basis-Betriebsartenwunsch, wenn keine andere Betriebsart gewünscht wird" VALUE 0x800383C4 Kw_Wu32 4294967295.00 OneToOne 0.00 4294967295.00 /end CHARACTERISTIC
/begin CHARACTERISTIC CoEOM_tiRmpMax_C "Maximale Rampenlaufzeit" VALUE 0x80038164 Kw_Ws16 16.323985348 TimeCoEOMRmp 0.060014652015 16.384000000 FORMAT "%12.9" EXTENDED_LIMITS 0.0020000610370 65.536000000 /end CHARACTERISTIC
/begin CHARACTERISTIC CoEOM_tiRmpMin_C "Minimale Rampenlaufzeit" VALUE 0x80038166 Kw_Ws16 16.323985348 TimeCoEOMRmp 0.060014652015 16.384000000 FORMAT "%12.9" EXTENDED_LIMITS 0.0020000610370 65.536000000 /end CHARACTERISTIC
/begin CHARACTERISTIC CoEOM_tiRmp_CA "Matrix mit Rampenlaufzeiten für die unterschiedlichen Betriebsartenumschaltungen" MAP 0x80038168 Kf_Xs16_Ys16_Ws16 65.533999939 TimeCoEOMRmp 0.0020000610370 65.536000000 FORMAT "%12.9"
 /begin AXIS_DESCR STD_AXIS CoEOM_numOpModeAct_mp OneToOne 16 0.00 255.0 DEPOSIT ABSOLUTE /end AXIS_DESCR
 /begin AXIS_DESCR STD_AXIS CoEOM_numOpModeOld_mp OneToOne 16 0.00 255.0 DEPOSIT ABSOLUTE /end AXIS_DESCR
/end CHARACTERISTIC
/begin CHARACTERISTIC CoES_MskDewDet_C "" VALUE 0x800383C8 Kw_Wu8 255.0 OneToOne 0.00 255.0 /end CHARACTERISTIC
/begin CHARACTERISTIC CoES_MskFMA_C "" VALUE 0x800383C9 Kw_Wu8 255.0 OneToOne 0.00 255.0 /end CHARACTERISTIC
/begin CHARACTERISTIC CoES_MskLSU_C "" VALUE 0x800383CA Kw_Wu8 255.0 OneToOne 0.00 255.0 /end CHARACTERISTIC
/begin CHARACTERISTIC CoETS_nTrqRatMin_C "Drehzahlschwelle ab der die aktuelle Last bestimmt wird" VALUE 0x800383CC Val_Ws16 600.0000 EngN 0.00 600.0000 EXTENDED_LIMITS -16384.00 16383.50 /end CHARACTERISTIC
/begin CHARACTERISTIC CoETS_trqSetMax_C "Maximum-Drehmoment" VALUE 0x800383CE Val_Ws16 400.0000 Trq 0.00 400.0000 EXTENDED_LIMITS -3276.800 3276.700 /end CHARACTERISTIC
/begin CHARACTERISTIC Conv_BrkDebP.tiHiLo_C "---/" VALUE 0x80038738 Kw_Ws16 655350.0 TimeDeb -327680.0 327670.0 /end CHARACTERISTIC
/begin CHARACTERISTIC Conv_BrkDebP.tiLoHi_C "---/" VALUE 0x8003873A Kw_Ws16 655350.0 TimeDeb -327680.0 327670.0 /end CHARACTERISTIC
/begin CHARACTERISTIC Conv_facClthClsd_GCUR "Öltemperaturabhängiger Faktor für Kupplung geschlossen" CURVE 0x8003873C Gkl_Ws16 0.006553500 TrqToNSqr -0.003276800 0.003276700 FORMAT "%11.9"
 /begin AXIS_DESCR COM_AXIS Conv_tOilBuf_mp Temp_Cels 10 -3549.940 3003.560 AXIS_PTS_REF Conv_tPntDST_AXIS /end AXIS_DESCR
/end CHARACTERISTIC
/begin CHARACTERISTIC Conv_facClthOpnd_GCUR "Öltemperaturabhängiger Faktor für Kupplung geöffnet" CURVE 0x80038750 Gkl_Ws16 0.006553500 TrqToNSqr -0.003276800 0.003276700 FORMAT "%11.9"
 /begin AXIS_DESCR COM_AXIS Conv_tOilBuf_mp Temp_Cels 10 -3549.940 3003.560 AXIS_PTS_REF Conv_tPntDST_AXIS /end AXIS_DESCR
/end CHARACTERISTIC
/begin CHARACTERISTIC Conv_facDepNTrbnNStat_CUR "Faktor abhängig von der Turbinendrehzahl und der stationären Drehzahl" CURVE 0x800384F4 Cur_Xs16Ws16 7.999878 Fact -4.000000 3.999878
 /begin AXIS_DESCR STD_AXIS Conv_rNTrbnNStat_mp TransR 6 -327.6800 327.6700 DEPOSIT ABSOLUTE /end AXIS_DESCR
/end CHARACTERISTIC
/begin CHARACTERISTIC Conv_facDfl_C "Faktor für Ölpumpe" VALUE 0x80038764 Val_Ws16 0.006553500 TrqToNSqr -0.003276800 0.003276700 FORMAT "%11.9" /end CHARACTERISTIC
/begin CHARACTERISTIC Conv_facGnTrqHiInc_C "Kalibrierungsfaktor für große Momentenerhöhung" VALUE 0x8003850E Kw_Ws16 511.9922 Fact1 -256.0000 255.9922 /end CHARACTERISTIC
/begin CHARACTERISTIC Conv_facGnTrqResv_C "Verstärkungsfaktor zur Berechnung der Momentenreserve" VALUE 0x80038510 Kw_Ws16 7.999878 Fact -4.000000 3.999878 /end CHARACTERISTIC
/begin CHARACTERISTIC Conv_facNTrbnCorr_C "Korrekturfaktor für die Turbinendrehzahl" VALUE 0x80038512 Kw_Ws16 7.999878 Fact -4.000000 3.999878 /end CHARACTERISTIC
/begin CHARACTERISTIC Conv_facVelErr_C "Kalibrierungsfaktor für Geschwindigkeitsfehler" VALUE 0x80038514 Kw_Ws16 7.999878 Fact -4.000000 3.999878 /end CHARACTERISTIC
/begin CHARACTERISTIC Conv_facVelNoErr_C "Kalibrierungsfaktor für kein Geschwindigkeitsfehler" VALUE 0x80038516 Kw_Ws16 7.999878 Fact -4.000000 3.999878 /end CHARACTERISTIC
/begin CHARACTERISTIC Conv_LvrOffDebP.tiHiLo_C "---/" VALUE 0x80038518 Kw_Ws16 655350.0 TimeDeb -327680.0 327670.0 /end CHARACTERISTIC
/begin CHARACTERISTIC Conv_LvrOffDebP.tiLoHi_C "---/" VALUE 0x8003851A Kw_Ws16 655350.0 TimeDeb -327680.0 327670.0 /end CHARACTERISTIC
/begin CHARACTERISTIC Conv_LvrPosOffDebP.tiHiLo_C "---/" VALUE 0x8003851C Kw_Ws16 655350.0 TimeDeb -327680.0 327670.0 /end CHARACTERISTIC
/begin CHARACTERISTIC Conv_LvrPosOffDebP.tiLoHi_C "---/" VALUE 0x8003851E Kw_Ws16 655350.0 TimeDeb -327680.0 327670.0 /end CHARACTERISTIC
/begin CHARACTERISTIC Conv_nTrbnLoLim_C "untere Begrenzung Turbinendrehzahl" VALUE 0x80038520 Kw_Ws16 32767.50 EngN -16384.00 16383.50 /end CHARACTERISTIC
/begin CHARACTERISTIC Conv_nTrbnMinCorrVal_C "minimaler Korrekturfaktor für die Turbinendrehzahl" VALUE 0x80038522 Kw_Ws16 32767.50 EngN -16384.00 16383.50 /end CHARACTERISTIC
/begin CHARACTERISTIC Conv_nTrbn_C "Turbinendrehzahl" VALUE 0x80038524 Kw_Ws16 32767.50 EngN -16384.00 16383.50 /end CHARACTERISTIC
/begin CHARACTERISTIC Conv_rTrq_C "Parameter für Wandlerübersetzungsverhältnis" VALUE 0x80038824 Kw_Ws16 654.0000 TransR -327.0000 327.0000 EXTENDED_LIMITS -327.6800 327.6700 /end CHARACTERISTIC
/begin CHARACTERISTIC Conv_tiDfl_C "Initialzeitwert" VALUE 0x80038766 Val_Ws16 655350.0 TimeDeb -327680.0 327670.0 /end CHARACTERISTIC
/begin CHARACTERISTIC Conv_tiDwnRglPT1_C "Zeitkonstante für Abregelung der Momentenlast des Wandlers" VALUE 0x80038528 Kw_Ws32 4294.9672940 TimeDelay_s 0.000002000000001 4294.9672960 FORMAT "%12.7" /end CHARACTERISTIC
/begin CHARACTERISTIC Conv_tiPT1_C "Filterzeitkonstante für die Drehmomentbelastung" VALUE 0x8003852C Kw_Ws32 4294.9672940 TimeDelay_s 0.000002000000001 4294.9672960 FORMAT "%12.7" /end CHARACTERISTIC
/begin CHARACTERISTIC Conv_tiRevLvrOff_GCUR "Entprellzeit Temperatur kein Rückwärtsgang" CURVE 0x80038768 Gkl_Ws16 655350.0 TimeDeb -327680.0 327670.0
 /begin AXIS_DESCR COM_AXIS Conv_tOilBuf_mp Temp_Cels 10 -3549.940 3003.560 AXIS_PTS_REF Conv_tPntDST_AXIS /end AXIS_DESCR
/end CHARACTERISTIC
/begin CHARACTERISTIC Conv_tiRevLvrOn_GCUR "Entprellzeit Temperatur Rückwärtsgang" CURVE 0x8003877C Gkl_Ws16 655350.0 TimeDeb -327680.0 327670.0
 /begin AXIS_DESCR COM_AXIS Conv_tOilBuf_mp Temp_Cels 10 -3549.940 3003.560 AXIS_PTS_REF Conv_tPntDST_AXIS /end AXIS_DESCR
/end CHARACTERISTIC
/begin CHARACTERISTIC Conv_tiRTraGearPT1_C "Filterzeitkonstante für die Turbinendrehzahl" VALUE 0x80038530 Kw_Ws32 4294.9672940 TimeDelay_s 0.000002000000001 4294.9672960 FORMAT "%12.7" /end CHARACTERISTIC
/begin CHARACTERISTIC Conv_tiTempDepLvrOff_GCUR "Entprellzeit Temperatur kein Gang eingelegt" CURVE 0x80038790 Gkl_Ws16 655350.0 TimeDeb -327680.0 327670.0
 /begin AXIS_DESCR COM_AXIS Conv_tOilBuf_mp Temp_Cels 10 -3549.940 3003.560 AXIS_PTS_REF Conv_tPntDST_AXIS /end AXIS_DESCR
/end CHARACTERISTIC
/begin CHARACTERISTIC Conv_tiTempDepLvrOn_GCUR "Entprellzeit Temperatur Gang eingelegt" CURVE 0x800387A4 Gkl_Ws16 655350.0 TimeDeb -327680.0 327670.0
 /begin AXIS_DESCR COM_AXIS Conv_tOilBuf_mp Temp_Cels 10 -3549.940 3003.560 AXIS_PTS_REF Conv_tPntDST_AXIS /end AXIS_DESCR
/end CHARACTERISTIC
/begin CHARACTERISTIC Conv_tiTrbnPT1_C "" VALUE 0x80038534 Val_Wr32 32767.0000 Time_s_float 0.00 32767.0000 FORMAT "%10.4" EXTENDED_LIMITS -1.00000000E+037 1.00000000E+037 /end CHARACTERISTIC
/begin CHARACTERISTIC Conv_tiTrqLdPT1_C "Filterzeitkonstante für die Momentenlast" VALUE 0x80038538 Kw_Ws32 4294.9672940 TimeDelay_s 0.000002000000001 4294.9672960 FORMAT "%12.7" /end CHARACTERISTIC
/begin CHARACTERISTIC Conv_tiTrqResvPT1_C "Filterzeitkonstante für die Momentenreserve" VALUE 0x8003853C Kw_Ws32 4294.9672940 TimeDelay_s 0.000002000000001 4294.9672960 FORMAT "%12.7" /end CHARACTERISTIC
/begin CHARACTERISTIC Conv_tiUpRglPT1_C "Zeitkonstante für die Abregelung der Momentenlast des Wandlers" VALUE 0x80038540 Kw_Ws32 4294.9672940 TimeDelay_s 0.000002000000001 4294.9672960 FORMAT "%12.7" /end CHARACTERISTIC
/begin AXIS_PTS Conv_tPntDST_AXIS "Temperaturverteilung Wandler" 0x800387B8 Conv_tOilBuf_mp GSst_Xs16 6553.500 Temp_Cels 10 -3549.940 3003.560 FORMAT "%8.3" DEPOSIT ABSOLUTE /end AXIS_PTS
/begin CHARACTERISTIC Conv_trqDfl_C "Parameter Lastmoment" VALUE 0x800387CE Val_Ws16 6553.500 Trq -3276.800 3276.700 /end CHARACTERISTIC
/begin CHARACTERISTIC Conv_trqGbx_MAP "" MAP 0x80038544 Map_Xs16Ys16Ws16 200.0000 Trq -100.0000 100.0000 EXTENDED_LIMITS -3276.800 3276.700
 /begin AXIS_DESCR STD_AXIS Epm_nEng EngN 8 -16384.00 16383.50 DEPOSIT ABSOLUTE /end AXIS_DESCR
 /begin AXIS_DESCR STD_AXIS Conv_nTrbn EngN 12 -16384.00 16383.50 DEPOSIT ABSOLUTE /end AXIS_DESCR
/end CHARACTERISTIC
/begin CHARACTERISTIC Conv_trqLdActv_CW "Codeword zum Aktivieren des Wandlers" VALUE 0x800387D0 Val_Wu8 255.0 OneToOne 0.00 255.0 /end CHARACTERISTIC
/begin CHARACTERISTIC Conv_trqLdGnFacHysDec_C "Offset für die Senkung der Momentenlast" VALUE 0x80038630 Kw_Ws16 6553.500 Trq -3276.800 3276.700 /end CHARACTERISTIC
/begin CHARACTERISTIC Conv_trqLdLvrPosNeutr_GCUR "Lastmoment für Leerlauf" CURVE 0x800387D2 Gkl_Ws16 6553.500 Trq -3276.800 3276.700
 /begin AXIS_DESCR COM_AXIS Conv_tOilBuf_mp Temp_Cels 10 -3549.940 3003.560 AXIS_PTS_REF Conv_tPntDST_AXIS /end AXIS_DESCR
/end CHARACTERISTIC
/begin CHARACTERISTIC Conv_trqLdMaxLim_MAP "Begrenzung der Momentenlast vom CAN" MAP 0x80038632 Map_Xs16Ys16Ws16 6553.500 Trq -3276.800 3276.700
 /begin AXIS_DESCR STD_AXIS GlbDa_vXFlt Vel 10 -327.6800 327.6700 DEPOSIT ABSOLUTE /end AXIS_DESCR
 /begin AXIS_DESCR STD_AXIS TS_tClntEngOut Temp_Cels 10 -3549.940 3003.560 DEPOSIT ABSOLUTE /end AXIS_DESCR
/end CHARACTERISTIC
/begin CHARACTERISTIC Conv_trqLdReplCan_C "Ersetzen der Momentenlast im Falle eines Fehles" VALUE 0x80038726 Kw_Ws16 6553.500 Trq -3276.800 3276.700 /end CHARACTERISTIC
/begin CHARACTERISTIC Conv_trqLdRevLvrPos_GCUR "Lastmoment für Rückwärtsgang" CURVE 0x800387E6 Gkl_Ws16 6553.500 Trq -3276.800 3276.700
 /begin AXIS_DESCR COM_AXIS Conv_tOilBuf_mp Temp_Cels 10 -3549.940 3003.560 AXIS_PTS_REF Conv_tPntDST_AXIS /end AXIS_DESCR
/end CHARACTERISTIC
/begin CHARACTERISTIC Conv_trqLdTempDepLim_GCUR "Temperaturabhängiger Wert zur Begrenzung des Lastmomentes" CURVE 0x800387FA Gkl_Ws16 6553.500 Trq -3276.800 3276.700
 /begin AXIS_DESCR COM_AXIS Conv_tOilBuf_mp Temp_Cels 10 -3549.940 3003.560 AXIS_PTS_REF Conv_tPntDST_AXIS /end AXIS_DESCR
/end CHARACTERISTIC
/begin CHARACTERISTIC Conv_trqLd_CW "Codeword für Lastmoment-Berechnung" VALUE 0x8003880E Val_Wu8 255.0 OneToOne 0.00 255.0 /end CHARACTERISTIC
/begin CHARACTERISTIC Conv_TrqResvDebP.tiHiLo_C "Timer für CAN-Zulässigkeit/" VALUE 0x80038728 Kw_Ws16 655350.0 TimeDeb -327680.0 327670.0 /end CHARACTERISTIC
/begin CHARACTERISTIC Conv_TrqResvDebP.tiLoHi_C "Timer für CAN-Zulässigkeit/" VALUE 0x8003872A Kw_Ws16 655350.0 TimeDeb -327680.0 327670.0 /end CHARACTERISTIC
/begin CHARACTERISTIC Conv_trqResvLoLim_C "minimaler Wert der Momentenreserve" VALUE 0x8003872C Kw_Ws16 6553.500 Trq -3276.800 3276.700 /end CHARACTERISTIC
/begin CHARACTERISTIC Conv_trqResvMinLim_C "Begrenzung der Momentenreserve" VALUE 0x8003872E Kw_Ws16 6553.500 Trq -3276.800 3276.700 /end CHARACTERISTIC
/begin CHARACTERISTIC Conv_trqResvNeutrLvrPos_C "minimaler Wert der Momentenreserve wenn die Wählhebelposition neutral" VALUE 0x80038730 Kw_Ws16 6553.500 Trq -3276.800 3276.700 /end CHARACTERISTIC
/begin CHARACTERISTIC Conv_trqResvPreFlt_C "vorgefilterter Wert der Momentenlast für zusätzliche Momentenreserve" VALUE 0x80038732 Kw_Ws16 6553.500 Trq -3276.800 3276.700 /end CHARACTERISTIC
/begin CHARACTERISTIC Conv_trqResvRepl_C "Ersetzen der Momentenreserve" VALUE 0x80038734 Kw_Ws16 6553.500 Trq -3276.800 3276.700 /end CHARACTERISTIC
/begin CHARACTERISTIC Conv_trqResvTempDep_GCUR "Temperaturabhängiges Reservemoment" CURVE 0x80038810 Gkl_Ws16 6553.500 Trq -3276.800 3276.700
 /begin AXIS_DESCR COM_AXIS Conv_tOilBuf_mp Temp_Cels 10 -3549.940 3003.560 AXIS_PTS_REF Conv_tPntDST_AXIS /end AXIS_DESCR
/end CHARACTERISTIC
/begin CHARACTERISTIC Conv_trqStatSqLvrPosNeutr_C "Pumpenmoment wenn Wählhebelposition neutral" VALUE 0x80038736 Kw_Ws16 6553.500 Trq -3276.800 3276.700 /end CHARACTERISTIC
/begin CHARACTERISTIC CoPT_dtrqCurrCorP.Pos_C "Rampenparameter für einen Reduzierenden Vorhaltmomenteingriff des Getriebes (Raildruckpfad)./" VALUE 0x800383F8 Kw_Ws32 3276799.99847 RmpTrq 0.00 3276799.99847 EXTENDED_LIMITS -3276800.00000 3276799.99847 /end CHARACTERISTIC
/begin CHARACTERISTIC CoPT_dtrqCurrCorP.Neg_C "Rampenparameter für einen Reduzierenden Vorhaltmomenteingriff des Getriebes (Raildruckpfad)./" VALUE 0x800383FC Kw_Ws32 3276799.99847 RmpTrq 0.00 3276799.99847 EXTENDED_LIMITS -3276800.00000 3276799.99847 /end CHARACTERISTIC
/begin CHARACTERISTIC CoPT_dtrqLeadCorP.Pos_C "Rampenparameter für einen Reduzierenden Vorhaltmomenteingriff des Getriebes./" VALUE 0x80038400 Kw_Ws32 3276799.99847 RmpTrq 0.00 3276799.99847 EXTENDED_LIMITS -3276800.00000 3276799.99847 /end CHARACTERISTIC
/begin CHARACTERISTIC CoPT_dtrqLeadCorP.Neg_C "Rampenparameter für einen Reduzierenden Vorhaltmomenteingriff des Getriebes./" VALUE 0x80038404 Kw_Ws32 3276799.99847 RmpTrq 0.00 3276799.99847 EXTENDED_LIMITS -3276800.00000 3276799.99847 /end CHARACTERISTIC
/begin CHARACTERISTIC CoPT_tiDebCurr_C "Entprellzeit für einen Reduzierenden Vorhaltmomenteingriff des Getriebes (Raildruckpfad)." VALUE 0x80038408 Kw_Ws32 4294967295.00 TimeDT -2147483648.00 2147483647.00 FORMAT "%13.2" /end CHARACTERISTIC
/begin CHARACTERISTIC CoPT_tiDebLead_C "Entprellzeit für einen Reduzierenden Vorhaltmomenteingriff des Getriebes." VALUE 0x8003840C Kw_Ws32 4294967295.00 TimeDT -2147483648.00 2147483647.00 FORMAT "%13.2" /end CHARACTERISTIC
/begin CHARACTERISTIC CoTemp_rClgDes_CUR "Kennlinie zur Auswahl der Kühlanforderung des Verbrennungsmotors, Eingang ist die Motortemperatur" CURVE 0x80038410 Cur_Xs16Ws16 2000.000 Prc -1000.000 1000.000 EXTENDED_LIMITS -400.0000 399.9878
 /begin AXIS_DESCR STD_AXIS EngDa_tEng Temp_Cels 5 19.96000 139.9600 EXTENDED_LIMITS -3549.940 3003.560 DEPOSIT ABSOLUTE /end AXIS_DESCR
/end CHARACTERISTIC
/begin CHARACTERISTIC CoTemp_tEngClntAftRunDes_C "Kühlmittelsolltemperatur des Verbrennungsmotors im Nachlauf" VALUE 0x80038426 Val_Ws16 6553.500 Temp_Cels -3549.940 3003.560 /end CHARACTERISTIC
/begin CHARACTERISTIC CoTemp_tEngClntIniDes_C "Initialisierungswert der Kühlmittelsolltemperatur des Verbrennungsmotors" VALUE 0x80038428 Val_Ws16 120.0000 Temp_Cels 19.96000 139.9600 EXTENDED_LIMITS -3549.940 3003.560 /end CHARACTERISTIC
/begin CHARACTERISTIC CoTemp_tEngDesBaseNTrq_MAP "KENNFELD für Kühlmitteltemperatur in Abhängigkeit von aktueller Drehzahl und Sollmoment" MAP 0x8003842A Map_Xs16Ys16Ws16 120.0000 Temp_Cels 19.96000 139.9600 EXTENDED_LIMITS -3549.940 3003.560
 /begin AXIS_DESCR STD_AXIS Epm_nEng EngN 2 -16384.00 16383.50 DEPOSIT ABSOLUTE /end AXIS_DESCR
 /begin AXIS_DESCR STD_AXIS PthSet_trqInrSet Trq 2 -3276.800 3276.700 DEPOSIT ABSOLUTE /end AXIS_DESCR
/end CHARACTERISTIC
/begin CHARACTERISTIC CoTemp_tEngDesBaseTempVel_MAP "Kennfeld für die Kühlmittelsolltemperatur des Verbrennungsmotors basierend auf der Motortemperatur und der Geschwindigkeit" MAP 0x8003843E Map_Xs16Ys16Ws16 120.0000 Temp_Cels 19.96000 139.9600 EXTENDED_LIMITS -3549.940 3003.560
 /begin AXIS_DESCR STD_AXIS EnvT_t Temp_Cels 2 -3549.940 3003.560 DEPOSIT ABSOLUTE /end AXIS_DESCR
 /begin AXIS_DESCR STD_AXIS VehV_v Vel 2 -327.6800 327.6700 DEPOSIT ABSOLUTE /end AXIS_DESCR
/end CHARACTERISTIC
/begin CHARACTERISTIC CoVeh_trqLim_CUR "Systemfehlerbegrenzungskennlinie (Radmoment)" CURVE 0x800384D4 Kl_Xs16_Ws16 104856.0 TrqPrp -52428.80 52427.20
 /begin AXIS_DESCR STD_AXIS Epm_nEng EngN 7 -16384.00 16383.50 DEPOSIT ABSOLUTE /end AXIS_DESCR
/end CHARACTERISTIC
/begin CHARACTERISTIC CoVMD_dtrqLim.Pos_C "/" VALUE 0x80038454 Kw_Ws32 3276798.99902 RmpTrqPrpHigh 0.999450683594 3276799.99847 FORMAT "%13.5" EXTENDED_LIMITS -3276800.00000 3276799.99847 /end CHARACTERISTIC
/begin CHARACTERISTIC CoVMD_dtrqLim.Neg_C "/" VALUE 0x80038458 Kw_Ws32 3276798.99902 RmpTrqPrpHigh 0.999450683594 3276799.99847 FORMAT "%13.5" EXTENDED_LIMITS -3276800.00000 3276799.99847 /end CHARACTERISTIC
/begin CHARACTERISTIC CoVMD_swtCCSelVal_C "Schalter für Auswahl Cruise Control (CrCtl, ACCI)" VALUE 0x80038464 Kw_Wu8 255.0 OneToOne 0.00 255.0 /end CHARACTERISTIC
/begin CHARACTERISTIC CoVMD_swtCCSel_C "Auswahl ob Beschleunigungsanforderung durch Applikationswert oder Selbsterkennung ausgewählt wird" VALUE 0x80038465 Kw_Wu8 255.0 OneToOne 0.00 255.0 /end CHARACTERISTIC
/begin CHARACTERISTIC CoVMD_swtOvrRunCrCtl_C "Auswahl ob Kompensationsmoment bei der Beschleunigungs-Momenten-Umrechnung addiert wird" VALUE 0x80038466 Kw_Wu8 255.0 OneToOne 0.00 255.0 /end CHARACTERISTIC
/begin CHARACTERISTIC CoVMD_trqLimPBr_C "" VALUE 0x8003845C Val_Ws32 214748363.700 TrqPrpHigh 1.00000000000 214748364.700 EXTENDED_LIMITS -214748364.800 214748364.700 /end CHARACTERISTIC
/begin CHARACTERISTIC CoVMD_trqThresCrCtlL_C "Untere Schwelle für CrCtl Status" VALUE 0x80038470 Kw_Ws32 429496729.500 TrqPrpHigh -214748364.800 214748364.700 /end CHARACTERISTIC
/begin CHARACTERISTIC CoVMD_trqThresCrCtlR_C "Obere Schwelle für CrCtl Status" VALUE 0x80038474 Kw_Ws32 429496729.500 TrqPrpHigh -214748364.800 214748364.700 /end CHARACTERISTIC
/begin CHARACTERISTIC CoVMD_trqThresCtOffLo_C "Untere Schwelle für Schubabschalteverbot" VALUE 0x80038468 Kw_Ws32 429496729.500 TrqPrpHigh -214748364.800 214748364.700 /end CHARACTERISTIC
/begin CHARACTERISTIC CoVMD_trqThresCtOffUp_C "Obere Schwelle für Schubabschalteverbot" VALUE 0x8003846C Kw_Ws32 429496729.500 TrqPrpHigh -214748364.800 214748364.700 /end CHARACTERISTIC
/begin CHARACTERISTIC CoVMD_trqThresLLimL_C "Untere Schwelle für LLim Status" VALUE 0x80038478 Kw_Ws32 429496729.500 TrqPrpHigh -214748364.800 214748364.700 /end CHARACTERISTIC
/begin CHARACTERISTIC CoVMD_trqThresLLimR_C "Obere Schwelle für LLim Status" VALUE 0x8003847C Kw_Ws32 429496729.500 TrqPrpHigh -214748364.800 214748364.700 /end CHARACTERISTIC
/begin CHARACTERISTIC CoVMD_vLimPBr_C "" VALUE 0x80038460 Val_Ws16 20.00000 Vel 0.00 20.00000 EXTENDED_LIMITS -327.6800 327.6700 /end CHARACTERISTIC
/begin CHARACTERISTIC CoVM_dtrqLeadCorP.Pos_C "/" VALUE 0x800384C8 Kw_Ws32 3276799.99847 RmpTrq 0.00 3276799.99847 EXTENDED_LIMITS -3276800.00000 3276799.99847 /end CHARACTERISTIC
/begin CHARACTERISTIC CoVM_dtrqLeadCorP.Neg_C "/" VALUE 0x800384CC Kw_Ws32 3276799.99847 RmpTrq 0.00 3276799.99847 EXTENDED_LIMITS -3276800.00000 3276799.99847 /end CHARACTERISTIC
/begin CHARACTERISTIC CoVM_facStWhlRL_CUR "" CURVE 0x80038480 Cur_Xs16Ws16 2.000000 Fact 0.00 2.000000 EXTENDED_LIMITS -4.000000 3.999878
 /begin AXIS_DESCR STD_AXIS Com_phiStWhlAgRaw AngleStWhl 8 -500.000000000 500.000000000 FORMAT "%13.9" EXTENDED_LIMITS -67108864.0000 67108863.9688 DEPOSIT ABSOLUTE /end AXIS_DESCR
/end CHARACTERISTIC
/begin CHARACTERISTIC CoVM_facStWhlRR_CUR "" CURVE 0x800384A2 Cur_Xs16Ws16 2.000000 Fact 0.00 2.000000 EXTENDED_LIMITS -4.000000 3.999878
 /begin AXIS_DESCR STD_AXIS Com_phiStWhlAgRaw AngleStWhl 8 -500.000000000 500.000000000 FORMAT "%13.9" EXTENDED_LIMITS -67108864.0000 67108863.9688 DEPOSIT ABSOLUTE /end AXIS_DESCR
/end CHARACTERISTIC
/begin CHARACTERISTIC CoVM_TrqRedMaxP.tiHiLo_C "/" VALUE 0x800384D0 Kw_Ws16 655350.0 TimeDeb -327680.0 327670.0 /end CHARACTERISTIC
/begin CHARACTERISTIC CoVM_TrqRedMaxP.tiLoHi_C "/" VALUE 0x800384D2 Kw_Ws16 655350.0 TimeDeb -327680.0 327670.0 /end CHARACTERISTIC
/begin CHARACTERISTIC Cpu_swtClrEnvRAMVals_C "" VALUE 0x80038826 Val_Wu8 255.0 OneToOne 0.00 255.0 /end CHARACTERISTIC
/begin CHARACTERISTIC CrCtl_aMax_C "Maximal zulässige Beschleunigung für Fahrgeschwindigkeitsregelung" VALUE 0x8003882C Val_Ws16 65.53500 Acc -32.76800 32.76700 FORMAT "%8.5" /end CHARACTERISTIC
/begin CHARACTERISTIC CrCtl_aMin_C "Minimal zulässige Beschleunigung für Fahrgeschwindigkeitsregelung" VALUE 0x8003882E Val_Ws16 65.53500 Acc -32.76800 32.76700 FORMAT "%8.5" /end CHARACTERISTIC
/begin CHARACTERISTIC CrCtl_aReqAcc_C "Beschleunigungsanforderung für den Zustand Beschleunigen" VALUE 0x80038830 Val_Ws16 65.53500 Acc -32.76800 32.76700 FORMAT "%8.5" /end CHARACTERISTIC
/begin CHARACTERISTIC CrCtl_aReqDecl_C "Beschleunigungsanforderung für den Zustand Verzögern" VALUE 0x80038832 Val_Ws16 65.53500 Acc -32.76800 32.76700 FORMAT "%8.5" /end CHARACTERISTIC
/begin CHARACTERISTIC CrCtl_aReq_MAP "Beschleunigungsanforderung des FGR für die Zustände Cruise, Tip und Resume" MAP 0x80038834 Map_Xs16Ys16Ws16 20.00000 Acc -10.00000 10.00000 FORMAT "%8.5" EXTENDED_LIMITS -32.76800 32.76700
 /begin AXIS_DESCR STD_AXIS CrCtl_vDiff_mp Vel 14 -100.0000 100.0000 EXTENDED_LIMITS -327.6800 327.6700 DEPOSIT ABSOLUTE /end AXIS_DESCR
 /begin AXIS_DESCR STD_AXIS CrCtl_vX Vel 7 -100.0000 250.0000 EXTENDED_LIMITS -327.6800 327.6700 DEPOSIT ABSOLUTE /end AXIS_DESCR
/end CHARACTERISTIC
/begin CHARACTERISTIC CrCtl_daAccDeclTrans_C "Steigung der Komfortfilterrampe im Falle schnelle Rampe" VALUE 0x80038928 Val_Ws32 65535.9999847 RmpAcc -32768.0000000 32767.9999847 FORMAT "%13.7" /end CHARACTERISTIC
/begin CHARACTERISTIC CrCtl_daCruise_C "Steigung der Komfortfilterrampe im Zustand Cruise" VALUE 0x8003892C Val_Ws32 65535.9999847 RmpAcc -32768.0000000 32767.9999847 FORMAT "%13.7" /end CHARACTERISTIC
/begin CHARACTERISTIC CrCtl_daNgvAccDecl_C "Negative Steigung der Komfortfilterrampe in den Zuständen Beschleunigung, Verzögerung" VALUE 0x80038930 Val_Ws32 65535.9999847 RmpAcc -32768.0000000 32767.9999847 FORMAT "%13.7" /end CHARACTERISTIC
/begin CHARACTERISTIC CrCtl_daNgvRes_C "Negative Steigung der Komfortfilterrampe in den Zuständen Resume" VALUE 0x80038934 Val_Ws32 65535.9999847 RmpAcc -32768.0000000 32767.9999847 FORMAT "%13.7" /end CHARACTERISTIC
/begin CHARACTERISTIC CrCtl_daPsvAccDecl_C "Positive Steigung der Komfortfilterrampe in den Zuständen Beschleunigung, Verzögerung" VALUE 0x80038938 Val_Ws32 65535.9999847 RmpAcc -32768.0000000 32767.9999847 FORMAT "%13.7" /end CHARACTERISTIC
/begin CHARACTERISTIC CrCtl_daPsvRes_C "Positive Steigung der Komfortfilterrampe in den Zuständen Resume" VALUE 0x8003893C Val_Ws32 65535.9999847 RmpAcc -32768.0000000 32767.9999847 FORMAT "%13.7" /end CHARACTERISTIC
/begin CHARACTERISTIC CrCtl_daThresShOffRmp_C "Schwelle Abschalt-Rampe" VALUE 0x80038940 Val_Ws32 65535.9999847 RmpAcc -32768.0000000 32767.9999847 FORMAT "%13.7" /end CHARACTERISTIC
/begin CHARACTERISTIC CrCtl_numGearAllwMax_C "Höchster erlaubter Gang bei FGR-Betrieb" VALUE 0x80038948 Val_Wu8 255.0 OneToOne 0.00 255.0 /end CHARACTERISTIC
/begin CHARACTERISTIC CrCtl_numGearAllwMin_C "Niedrigster erlaubter Gang bei FGR-Betrieb" VALUE 0x80038949 Val_Wu8 255.0 OneToOne 0.00 255.0 /end CHARACTERISTIC
/begin CHARACTERISTIC CrCtl_rDvtV2NMax_C "Maximal erlaubte Abweichung des v/n-Verhältnisses nach FGR-Aktivierung" VALUE 0x8003894A Val_Ws16 0.6553500 VelToN -0.3276800 0.3276700 FORMAT "%9.7" /end CHARACTERISTIC
/begin CHARACTERISTIC CrCtl_stAccHld_C "Zustandsübergangsmaske für steigende Flanke an Bedienteilstatus ""Beschleunigen"" (Langdruck auf ""Plus"")" VALUE 0x800389A4 Val_Wu16 65535.00 OneToOne 0.00 65535.00 /end CHARACTERISTIC
/begin CHARACTERISTIC CrCtl_stAccNgv_C "Zustandübergangsmaske für fallende Flanke an Bedienteilstatus ""Plus""" VALUE 0x800389A6 Val_Wu16 65535.00 OneToOne 0.00 65535.00 /end CHARACTERISTIC
/begin CHARACTERISTIC CrCtl_stAccPsv_C "Zustandsübergangsmaske für steigende Flanke an Bedienteilstatus ""Plus""" VALUE 0x800389A8 Val_Wu16 65535.00 OneToOne 0.00 65535.00 /end CHARACTERISTIC
/begin CHARACTERISTIC CrCtl_stClrVDesBtnMsk_C "Bitmaske zur Auswahl von Bedienaktionen die im Shutoff-Fall zur Löschung der Wunschgeschwindigkeit führen" VALUE 0x8003894C Val_Wu16 65535.00 OneToOne 0.00 65535.00 /end CHARACTERISTIC
/begin CHARACTERISTIC CrCtl_stClrVDesShOffMsk_C "Bitmaske zur Auswahl von Abschaltbedingungen, die zu einer Löschung der Wunschgeschwindigkeit führen" VALUE 0x80038950 Val_Wu32 4294967295.00 OneToOne 0.00 4294967295.00 /end CHARACTERISTIC
/begin CHARACTERISTIC CrCtl_stDeclHld_C "Zustandsübergangsmaske für steigende Flanke an Bedienteilstatus ""Verzögern"" (Langdruck auf ""Minus"")" VALUE 0x800389AA Val_Wu16 65535.00 OneToOne 0.00 65535.00 /end CHARACTERISTIC
/begin CHARACTERISTIC CrCtl_stDeclNgv_C "Zustandsübergangsmaske für fallende Flanke an Bedienteilstatus ""Minus""" VALUE 0x800389AC Val_Wu16 65535.00 OneToOne 0.00 65535.00 /end CHARACTERISTIC
/begin CHARACTERISTIC CrCtl_stDeclPsv_C "Zustandsübergangsmaske für steigende Flanke an Bedienteilstatus ""Minus""" VALUE 0x800389AE Val_Wu16 65535.00 OneToOne 0.00 65535.00 /end CHARACTERISTIC
/begin CHARACTERISTIC CrCtl_stResPsv_C "Zustandsübergangsmaske für steigende Flanke an Bedienteilstatus ""Wiederaufnahme""" VALUE 0x800389B0 Val_Wu16 65535.00 OneToOne 0.00 65535.00 /end CHARACTERISTIC
/begin CHARACTERISTIC CrCtl_stSetPsv_C "Zustandsübergangsmaske für steigende Flanke an Bedienteilstatus ""Setzen""" VALUE 0x800389B2 Val_Wu16 65535.00 OneToOne 0.00 65535.00 /end CHARACTERISTIC
/begin CHARACTERISTIC CrCtl_stShOffFstMsk_C "Bitmaske zur Auswahl von Abschaltbedingungen, die zu einer schnellen Abschaltung führen" VALUE 0x80038954 Val_Wu32 4294967295.00 OneToOne 0.00 4294967295.00 /end CHARACTERISTIC
/begin CHARACTERISTIC CrCtl_stShOffIrvMsk_C "Bitmaske zur Auswahl von Abschaltbedingungen, die zu einer irreversiblen Abschaltung führen" VALUE 0x80038958 Val_Wu32 4294967295.00 OneToOne 0.00 4294967295.00 /end CHARACTERISTIC
/begin CHARACTERISTIC CrCtl_stShOffRvMsk_C "Bitmaske zur Auswahl von Abschaltbedingungen, die zu einer reversiblen Abschaltung führen" VALUE 0x8003895C Val_Wu32 4294967295.00 OneToOne 0.00 4294967295.00 /end CHARACTERISTIC
/begin CHARACTERISTIC CrCtl_tiDebAscLoHi_C "Entprellzeit für Abschaltung durch ASC-Eingriff" VALUE 0x80038960 Val_Ws16 655350.0 Time_ms -327680.0 327670.0 /end CHARACTERISTIC
/begin CHARACTERISTIC CrCtl_tiDebDscLoHi_C "Entprellzeit für Abschaltung durch DSC-Eingriff" VALUE 0x80038962 Val_Ws16 655350.0 Time_ms -327680.0 327670.0 /end CHARACTERISTIC
/begin CHARACTERISTIC CrCtl_tiFltvXOfs_C "Zeitkonstante zur PT1-Filterung von CrCtl_vXOfs_mp" VALUE 0x80038964 Val_Ws32 4294967.2940 TimeDelay_ms 0.0020000000009 4294967.2960 FORMAT "%12.4" /end CHARACTERISTIC
/begin CHARACTERISTIC CrCtl_tiFltvX_C "Zeitkonstante zur PT1-Filterung der FGR-Istgeschwindigkeit" VALUE 0x80038968 Val_Ws32 4294967.2940 TimeDelay_ms 0.0020000000009 4294967.2960 FORMAT "%12.4" /end CHARACTERISTIC
/begin CHARACTERISTIC CrCtl_tiMoF_C "Entprellzeit für Abschaltung durch Überwachung" VALUE 0x8003896C Val_Ws16 655350.0 Time_ms -327680.0 327670.0 /end CHARACTERISTIC
/begin CHARACTERISTIC CrCtl_tiShOffFst_C "Rampenzeit für Herunterrampen der Beschleunigungsanforderung im Falle schneller Abschaltung" VALUE 0x8003896E Val_Ws16 655350.0 Time_ms -327680.0 327670.0 /end CHARACTERISTIC
/begin CHARACTERISTIC CrCtl_tiShOffSlw_C "Rampenzeit für Herunterrampen der Beschleunigungsanforderung im Falle langsamer Abschaltung" VALUE 0x80038970 Val_Ws16 655350.0 Time_ms -327680.0 327670.0 /end CHARACTERISTIC
/begin CHARACTERISTIC CrCtl_vAccOfs_C "Korrekturwert für die Wunschgeschwindigkeit im Zustand Beschleunigung" VALUE 0x80038988 Val_Ws16 655.3500 Vel -327.6800 327.6700 /end CHARACTERISTIC
/begin CHARACTERISTIC CrCtl_vCrCtlMaxKmh_C "Maximal erlaubte FGR-Betriebsgeschwindigkeit bei Anzeige in km/h" VALUE 0x80038972 Val_Ws16 655.3500 Vel -327.6800 327.6700 /end CHARACTERISTIC
/begin CHARACTERISTIC CrCtl_vCrCtlMaxMph_C "Maximal erlaubte FGR-Betriebsgeschwindigkeit bei Anzeige in Mph" VALUE 0x80038974 Val_Ws16 655.3500 Vel -327.6800 327.6700 /end CHARACTERISTIC
/begin CHARACTERISTIC CrCtl_vCrCtlMinKmh_C "Minimal erlaubte FGR-Betriebsgeschwindigkeit bei Anzeige in km/h" VALUE 0x80038976 Val_Ws16 655.3500 Vel -327.6800 327.6700 /end CHARACTERISTIC
/begin CHARACTERISTIC CrCtl_vCrCtlMinMph_C "Minimal erlaubte FGR-Betriebsgeschwindigkeit bei Anzeige in Mph" VALUE 0x80038978 Val_Ws16 655.3500 Vel -327.6800 327.6700 /end CHARACTERISTIC
/begin CHARACTERISTIC CrCtl_vDeclOfs_C "Korrekturwert für die Wunschgeschwindigkeit im Zustand Verzögerung" VALUE 0x8003898A Val_Ws16 655.3500 Vel -327.6800 327.6700 /end CHARACTERISTIC
/begin CHARACTERISTIC CrCtl_vDesMaxKmh_C "Maximal erlaubte FGR-Wunschgeschwindigkeit bei Anzeige in km/h" VALUE 0x8003897A Val_Ws16 655.3500 Vel -327.6800 327.6700 /end CHARACTERISTIC
/begin CHARACTERISTIC CrCtl_vDesMaxMph_C "Maximal erlaubte FGR-Wunschgeschwindigkeit bei Anzeige in Mph" VALUE 0x8003897C Val_Ws16 655.3500 Vel -327.6800 327.6700 /end CHARACTERISTIC
/begin CHARACTERISTIC CrCtl_vDesMinKmh_C "Minimal erlaubte FGR-Wunschgeschwindigkeit bei Anzeige in km/h" VALUE 0x8003897E Val_Ws16 655.3500 Vel -327.6800 327.6700 /end CHARACTERISTIC
/begin CHARACTERISTIC CrCtl_vDesMinMph_C "Minimal erlaubte FGR-Wunschgeschwindigkeit bei Anzeige in Mph" VALUE 0x80038980 Val_Ws16 655.3500 Vel -327.6800 327.6700 /end CHARACTERISTIC
/begin CHARACTERISTIC CrCtl_vOfsCruise_CUR "Korrekturwert für die Wunschgeschwindigkeit beim Übergang Standby-Cruise" CURVE 0x8003898C Cur_Xs16Ws16 655.3500 Vel -327.6800 327.6700
 /begin AXIS_DESCR STD_AXIS GlbDa_aXFlt Acc 5 -32.76800 32.76700 FORMAT "%8.5" DEPOSIT ABSOLUTE /end AXIS_DESCR
/end CHARACTERISTIC
/begin CHARACTERISTIC CrCtl_vThresAccMax_C "Schwelle für Beschleunigungsreduzierung bei Annäherung an Wunschgeschwindigkeitsgrenzen" VALUE 0x80038944 Val_Ws16 655.3500 Vel -327.6800 327.6700 /end CHARACTERISTIC
/begin CHARACTERISTIC CrCtl_vThresCruise_C "Schwelle Geschwindigkeit Zustände Resume, Tip up und Tip down" VALUE 0x800389A2 Val_Ws16 655.3500 Vel -327.6800 327.6700 /end CHARACTERISTIC
/begin CHARACTERISTIC CrCtl_vTipStpKmh_C "Schrittgröße für tip up/down bei Anzeige in km/h" VALUE 0x80038982 Val_Ws16 655.3500 Vel -327.6800 327.6700 /end CHARACTERISTIC
/begin CHARACTERISTIC CrCtl_vTipStpMph_C "Schrittgröße für tip up/down bei Anzeige in Mph" VALUE 0x80038984 Val_Ws16 655.3500 Vel -327.6800 327.6700 /end CHARACTERISTIC
/begin CHARACTERISTIC CrCtl_vXOfsFltMax_C "Maximal erlaubter Wert von CrCtl_vXOfsFlt_mp" VALUE 0x80038986 Val_Ws16 655.3500 Vel -327.6800 327.6700 /end CHARACTERISTIC
/begin CHARACTERISTIC CrCUI_tiPerm_C "Minimale Zeit für Druck auf ""Plus"" um Zustand ""Beschleunigung"" zu erreichen" VALUE 0x80038828 Val_Ws16 655350.0 Time_ms -327680.0 327670.0 /end CHARACTERISTIC
/begin CHARACTERISTIC CThmst_Pwm.tiPer_C "Struktur, die Kalibrierungs- und Umsetzungsdatentypen für den Kühlmittelthermostatsteller enthält/" VALUE 0x80037B92 Kw_Ws16 9.900000 Period 0.1000000 10.00000 FORMAT "%8.5" EXTENDED_LIMITS -3276.800 3276.700 /end CHARACTERISTIC
/begin CHARACTERISTIC CThmst_Pwm.stLvl_C "Struktur, die Kalibrierungs- und Umsetzungsdatentypen für den Kühlmittelthermostatsteller enthält/" VALUE 0x80037B94 Kw_Wu8 1.000 OneToOne 0.00 1.000 EXTENDED_LIMITS 0.00 255.0 /end CHARACTERISTIC
/begin CHARACTERISTIC CThmst_Pwm.rMaxDty_C "Struktur, die Kalibrierungs- und Umsetzungsdatentypen für den Kühlmittelthermostatsteller enthält/" VALUE 0x80037B96 Kw_Ws16 100.0000 DtyCyc 0.00 100.0000 EXTENDED_LIMITS -327.6800 327.6700 /end CHARACTERISTIC
/begin CHARACTERISTIC CThmst_Pwm.rPerUn_C "Struktur, die Kalibrierungs- und Umsetzungsdatentypen für den Kühlmittelthermostatsteller enthält/" VALUE 0x80037B98 Kw_Ws16 6553.500 Period -3276.800 3276.700 FORMAT "%8.3" /end CHARACTERISTIC
/begin CHARACTERISTIC CThmst_Pwm.tiPh_C "Struktur, die Kalibrierungs- und Umsetzungsdatentypen für den Kühlmittelthermostatsteller enthält/" VALUE 0x80037B9A Kw_Ws16 65535.00 OneToOne -32768.00 32767.00 /end CHARACTERISTIC
/begin CHARACTERISTIC CThmst_PwmOut.rMin_C "Struktur, die Parameter zur Fehlerbehandlung der PWM-Ausgangsendstufe für den Kühlmittelthermostatsteller enthält/" VALUE 0x80037B9C Kw_Ws16 100.0000 DtyCyc 0.00 100.0000 EXTENDED_LIMITS -327.6800 327.6700 /end CHARACTERISTIC
/begin CHARACTERISTIC CThmst_PwmOut.rMax_C "Struktur, die Parameter zur Fehlerbehandlung der PWM-Ausgangsendstufe für den Kühlmittelthermostatsteller enthält/" VALUE 0x80037B9E Kw_Ws16 100.0000 DtyCyc 0.00 100.0000 EXTENDED_LIMITS -327.6800 327.6700 /end CHARACTERISTIC
/begin CHARACTERISTIC CThmst_PwmOut.tiBtwTstSCB_C "Struktur, die Parameter zur Fehlerbehandlung der PWM-Ausgangsendstufe für den Kühlmittelthermostatsteller enthält/" VALUE 0x80037BA0 Kw_Ws16 1000.000 Time_ms 0.00 1000.000 EXTENDED_LIMITS -327680.0 327670.0 /end CHARACTERISTIC
/begin CHARACTERISTIC CThmst_PwmOut.tiBtwTstOT_C "Struktur, die Parameter zur Fehlerbehandlung der PWM-Ausgangsendstufe für den Kühlmittelthermostatsteller enthält/" VALUE 0x80037BA2 Kw_Ws16 327.6700 Time_s 0.00 327.6700 EXTENDED_LIMITS -327.6800 327.6700 /end CHARACTERISTIC
/begin CHARACTERISTIC CThmst_PwmOut.numTstMax_C "Struktur, die Parameter zur Fehlerbehandlung der PWM-Ausgangsendstufe für den Kühlmittelthermostatsteller enthält/" VALUE 0x80037BA4 Kw_Wu16 65535.00 OneToOne 0.00 65535.00 /end CHARACTERISTIC
/begin CHARACTERISTIC CThmst_PwmOut.swtBattCor_C "Struktur, die Parameter zur Fehlerbehandlung der PWM-Ausgangsendstufe für den Kühlmittelthermostatsteller enthält/" VALUE 0x80037BA6 Kw_Wu8 1.000 OneToOne 0.00 1.000 EXTENDED_LIMITS 0.00 255.0 /end CHARACTERISTIC
/begin CHARACTERISTIC CThmst_PwmOut.swtPsInv_C "Struktur, die Parameter zur Fehlerbehandlung der PWM-Ausgangsendstufe für den Kühlmittelthermostatsteller enthält/" VALUE 0x80037BA7 Kw_Wu8 1.000 OneToOne 0.00 1.000 EXTENDED_LIMITS 0.00 255.0 /end CHARACTERISTIC
/begin CHARACTERISTIC CThmst_rCnv_CUR "Umwandlungskennlinie zur Umsetzung des Spannungswerts in das Tastverhältnis für den Sollwert" CURVE 0x80037BA8 Cur_Xs16Ws16 100.0000 DtyCyc 0.00 100.0000 EXTENDED_LIMITS -327.6800 327.6700
 /begin AXIS_DESCR STD_AXIS CThmst_r Prc 16 -400.0000 399.9878 DEPOSIT ABSOLUTE /end AXIS_DESCR
/end CHARACTERISTIC
/begin CHARACTERISTIC CThmst_rPsDisbl_C "Ausgangstastverhältnis, wenn Endstufe deaktiviert ist." VALUE 0x80037BEA Val_Ws16 655.3500 DtyCyc -327.6800 327.6700 /end CHARACTERISTIC
/begin CHARACTERISTIC CThmst_stPwrStgDiaDis_C "Applikationsparameter zur Sperrung der Diagnose der Endstufe für den Kühlmittelthermostatsteller unter bestimmten Batterie- und Motorbedingungen" VALUE 0x80037BEC Val_Wu8 255.0 OneToOne 0.00 255.0 /end CHARACTERISTIC
/begin CHARACTERISTIC CThmst_stPwrStgDis_C "Applikationsparameter zur Sperrung der Endstufe für den Kühlmittelthermostatsteller unter bestimmten Batterie- und Motorbedingungen" VALUE 0x80037BED Val_Wu8 255.0 OneToOne 0.00 255.0 /end CHARACTERISTIC
/begin CHARACTERISTIC CustDiag_dDatasetVer_C "" ASCII 0x800389B4 ValA_Wu8 255.0 defaultAscii 0.00 255.0 NUMBER 14 /end CHARACTERISTIC
/begin CHARACTERISTIC CustDiag_dSGBDIdx_CA "" VAL_BLK 0x800389C3 ValA_Wu8 255.0 OneToOne 0.00 255.0 NUMBER 3 /end CHARACTERISTIC
/begin CHARACTERISTIC DDRC_DurDeb.TrbCh_tiOLDebOk_C "DDRC/Dauer der Heilungsentprellung für Prüfung DFC_TrbChOL" VALUE 0x80022310 Val_Wu16 655350.0 DDRCTime_ms 0.00 655350.0 /end CHARACTERISTIC
/begin CHARACTERISTIC DDRC_DurDeb.TrbCh_tiOLDebDef_C "DDRC/Dauer der Fehlerentprellung für Prüfung DFC_TrbChOL" VALUE 0x80022312 Val_Wu16 655350.0 DDRCTime_ms 0.00 655350.0 /end CHARACTERISTIC
/begin CHARACTERISTIC DDRC_DurDeb.ThrVlv_tiOLDebOk_C "DDRC/Dauer der Heilungsentprellung für Prüfung DFC_ThrVlvOL" VALUE 0x80022314 Val_Wu16 655350.0 DDRCTime_ms 0.00 655350.0 /end CHARACTERISTIC
/begin CHARACTERISTIC DDRC_DurDeb.ThrVlv_tiOLDebDef_C "DDRC/Dauer der Fehlerentprellung für Prüfung DFC_ThrVlvOL" VALUE 0x80022316 Val_Wu16 655350.0 DDRCTime_ms 0.00 655350.0 /end CHARACTERISTIC
/begin CHARACTERISTIC DDRC_DurDeb.WaHtEl_tiSCBDebOk_C "DDRC/Dauer der Heilungsentprellung für Prüfung DFC_WaHtElSCB" VALUE 0x80022318 Val_Wu16 655350.0 DDRCTime_ms 0.00 655350.0 /end CHARACTERISTIC
/begin CHARACTERISTIC DDRC_DurDeb.WaHtEl_tiSCBDebDef_C "DDRC/Dauer der Fehlerentprellung für Prüfung DFC_WaHtElSCB" VALUE 0x8002231A Val_Wu16 655350.0 DDRCTime_ms 0.00 655350.0 /end CHARACTERISTIC
/begin CHARACTERISTIC DDRC_DurDeb.EBxFan_tiOvrTempDebOk_C "DDRC/Dauer der Heilungsentprellung für Prüfung DFC_EBxFanOvrTemp" VALUE 0x8002231C Val_Wu16 655350.0 DDRCTime_ms 0.00 655350.0 /end CHARACTERISTIC
/begin CHARACTERISTIC DDRC_DurDeb.EBxFan_tiOvrTempDebDef_C "DDRC/Dauer der Fehlerentprellung für Prüfung DFC_EBxFanOvrTemp" VALUE 0x8002231E Val_Wu16 655350.0 DDRCTime_ms 0.00 655350.0 /end CHARACTERISTIC
/begin CHARACTERISTIC DDRC_DurDeb.RailP_tiSRCMinDebOk_C "DDRC/Dauer der Heilungsentprellung für Prüfung DFC_RailPSRCMin" VALUE 0x80022320 Val_Wu16 655350.0 DDRCTime_ms 0.00 655350.0 /end CHARACTERISTIC
/begin CHARACTERISTIC DDRC_DurDeb.RailP_tiSRCMinDebDef_C "DDRC/Dauer der Fehlerentprellung für Prüfung DFC_RailPSRCMin" VALUE 0x80022322 Val_Wu16 655350.0 DDRCTime_ms 0.00 655350.0 /end CHARACTERISTIC
/begin CHARACTERISTIC DDRC_DurDeb.Fan_tiOLDebOk_C "DDRC/Dauer der Heilungsentprellung für Prüfung DFC_FanOL" VALUE 0x80022324 Val_Wu16 655350.0 DDRCTime_ms 0.00 655350.0 /end CHARACTERISTIC
/begin CHARACTERISTIC DDRC_DurDeb.Fan_tiOLDebDef_C "DDRC/Dauer der Fehlerentprellung für Prüfung DFC_FanOL" VALUE 0x80022326 Val_Wu16 655350.0 DDRCTime_ms 0.00 655350.0 /end CHARACTERISTIC
/begin CHARACTERISTIC DDRC_DurDeb.ECBVlv_tiOvrTempDebOk_C "DDRC/Dauer der Heilungsentprellung für Prüfung DFC_ECBVlvOvrTemp" VALUE 0x80022328 Val_Wu16 655350.0 DDRCTime_ms 0.00 655350.0 /end CHARACTERISTIC
/begin CHARACTERISTIC DDRC_DurDeb.ECBVlv_tiOvrTempDebDef_C "DDRC/Dauer der Fehlerentprellung für Prüfung DFC_ECBVlvOvrTemp" VALUE 0x8002232A Val_Wu16 655350.0 DDRCTime_ms 0.00 655350.0 /end CHARACTERISTIC
/begin CHARACTERISTIC DDRC_DurDeb.EBxFan_tiSCGDebOk_C "DDRC/Dauer der Heilungsentprellung für Prüfung DFC_EBxFanSCG" VALUE 0x8002232C Val_Wu16 655350.0 DDRCTime_ms 0.00 655350.0 /end CHARACTERISTIC
/begin CHARACTERISTIC DDRC_DurDeb.EBxFan_tiSCGDebDef_C "DDRC/Dauer der Fehlerentprellung für Prüfung DFC_EBxFanSCG" VALUE 0x8002232E Val_Wu16 655350.0 DDRCTime_ms 0.00 655350.0 /end CHARACTERISTIC
/begin CHARACTERISTIC DDRC_DurDeb.UPmpMot_tiOLDebOk_C "DDRC/Dauer der Heilungsentprellung für Prüfung DFC_UPmpMotOL" VALUE 0x80022330 Val_Wu16 655350.0 DDRCTime_ms 0.00 655350.0 /end CHARACTERISTIC
/begin CHARACTERISTIC DDRC_DurDeb.UPmpMot_tiOLDebDef_C "DDRC/Dauer der Fehlerentprellung für Prüfung DFC_UPmpMotOL" VALUE 0x80022332 Val_Wu16 655350.0 DDRCTime_ms 0.00 655350.0 /end CHARACTERISTIC
/begin CHARACTERISTIC DDRC_DurDeb.AirC_tiCmprOLDebOk_C "DDRC/Dauer der Heilungsentprellung für Prüfung DFC_AirCCmprOL" VALUE 0x80022334 Val_Wu16 655350.0 DDRCTime_ms 0.00 655350.0 /end CHARACTERISTIC
/begin CHARACTERISTIC DDRC_DurDeb.AirC_tiCmprOLDebDef_C "DDRC/Dauer der Fehlerentprellung für Prüfung DFC_AirCCmprOL" VALUE 0x80022336 Val_Wu16 655350.0 DDRCTime_ms 0.00 655350.0 /end CHARACTERISTIC
/begin CHARACTERISTIC DDRC_DurDeb.UDosVlv_tiOLDebOk_C "DDRC/Dauer der Heilungsentprellung für Prüfung DFC_UDosVlvOL" VALUE 0x80022338 Val_Wu16 655350.0 DDRCTime_ms 0.00 655350.0 /end CHARACTERISTIC
/begin CHARACTERISTIC DDRC_DurDeb.UDosVlv_tiOLDebDef_C "DDRC/Dauer der Fehlerentprellung für Prüfung DFC_UDosVlvOL" VALUE 0x8002233A Val_Wu16 655350.0 DDRCTime_ms 0.00 655350.0 /end CHARACTERISTIC
/begin CHARACTERISTIC DDRC_DurDeb.ThrVlv_tiSCBDebOk_C "DDRC/Dauer der Heilungsentprellung für Prüfung DFC_ThrVlvSCB" VALUE 0x8002233C Val_Wu16 655350.0 DDRCTime_ms 0.00 655350.0 /end CHARACTERISTIC
/begin CHARACTERISTIC DDRC_DurDeb.ThrVlv_tiSCBDebDef_C "DDRC/Dauer der Fehlerentprellung für Prüfung DFC_ThrVlvSCB" VALUE 0x8002233E Val_Wu16 655350.0 DDRCTime_ms 0.00 655350.0 /end CHARACTERISTIC
/begin CHARACTERISTIC DDRC_DurDeb.CThmst_tiOvrTempDebOk_C "DDRC/Dauer der Heilungsentprellung für Prüfung DFC_CThmstOvrTemp" VALUE 0x80022340 Val_Wu16 655350.0 DDRCTime_ms 0.00 655350.0 /end CHARACTERISTIC
/begin CHARACTERISTIC DDRC_DurDeb.CThmst_tiOvrTempDebDef_C "DDRC/Dauer der Fehlerentprellung für Prüfung DFC_CThmstOvrTemp" VALUE 0x80022342 Val_Wu16 655350.0 DDRCTime_ms 0.00 655350.0 /end CHARACTERISTIC
/begin CHARACTERISTIC DDRC_DurDeb.UDosVlv_tiSCGDebOk_C "DDRC/Dauer der Heilungsentprellung für Prüfung DFC_UDosVlvSCG" VALUE 0x80022344 Val_Wu16 655350.0 DDRCTime_ms 0.00 655350.0 /end CHARACTERISTIC
/begin CHARACTERISTIC DDRC_DurDeb.UDosVlv_tiSCGDebDef_C "DDRC/Dauer der Fehlerentprellung für Prüfung DFC_UDosVlvSCG" VALUE 0x80022346 Val_Wu16 655350.0 DDRCTime_ms 0.00 655350.0 /end CHARACTERISTIC
/begin CHARACTERISTIC DDRC_DurDeb.Strt_tiSCBDebOk_C "DDRC/Dauer der Heilungsentprellung für Prüfung DFC_StrtSCB" VALUE 0x80022348 Val_Wu16 655350.0 DDRCTime_ms 0.00 655350.0 /end CHARACTERISTIC
/begin CHARACTERISTIC DDRC_DurDeb.Strt_tiSCBDebDef_C "DDRC/Dauer der Fehlerentprellung für Prüfung DFC_StrtSCB" VALUE 0x8002234A Val_Wu16 655350.0 DDRCTime_ms 0.00 655350.0 /end CHARACTERISTIC
/begin CHARACTERISTIC DDRC_DurDeb.CByVlv_tiSCGDebOk_C "DDRC/Dauer der Heilungsentprellung für Prüfung DFC_CByVlvSCG" VALUE 0x8002234C Val_Wu16 655350.0 DDRCTime_ms 0.00 655350.0 /end CHARACTERISTIC
/begin CHARACTERISTIC DDRC_DurDeb.CByVlv_tiSCGDebDef_C "DDRC/Dauer der Fehlerentprellung für Prüfung DFC_CByVlvSCG" VALUE 0x8002234E Val_Wu16 655350.0 DDRCTime_ms 0.00 655350.0 /end CHARACTERISTIC
/begin CHARACTERISTIC DDRC_DurDeb.TrbCh_tiOvrTempDebOk_C "DDRC/Dauer der Heilungsentprellung für Prüfung DFC_TrbChOvrTemp" VALUE 0x80022350 Val_Wu16 655350.0 DDRCTime_ms 0.00 655350.0 /end CHARACTERISTIC
/begin CHARACTERISTIC DDRC_DurDeb.TrbCh_tiOvrTempDebDef_C "DDRC/Dauer der Fehlerentprellung für Prüfung DFC_TrbChOvrTemp" VALUE 0x80022352 Val_Wu16 655350.0 DDRCTime_ms 0.00 655350.0 /end CHARACTERISTIC
/begin CHARACTERISTIC DDRC_DurDeb.EBxFan_tiSCBDebOk_C "DDRC/Dauer der Heilungsentprellung für Prüfung DFC_EBxFanSCB" VALUE 0x80022354 Val_Wu16 655350.0 DDRCTime_ms 0.00 655350.0 /end CHARACTERISTIC
/begin CHARACTERISTIC DDRC_DurDeb.EBxFan_tiSCBDebDef_C "DDRC/Dauer der Fehlerentprellung für Prüfung DFC_EBxFanSCB" VALUE 0x80022356 Val_Wu16 655350.0 DDRCTime_ms 0.00 655350.0 /end CHARACTERISTIC
/begin CHARACTERISTIC DDRC_DurDeb.Strt_tiOvrTempDebOk_C "DDRC/Dauer der Heilungsentprellung für Prüfung DFC_StrtOvrTemp" VALUE 0x80022358 Val_Wu16 655350.0 DDRCTime_ms 0.00 655350.0 /end CHARACTERISTIC
/begin CHARACTERISTIC DDRC_DurDeb.Strt_tiOvrTempDebDef_C "DDRC/Dauer der Fehlerentprellung für Prüfung DFC_StrtOvrTemp" VALUE 0x8002235A Val_Wu16 655350.0 DDRCTime_ms 0.00 655350.0 /end CHARACTERISTIC
/begin CHARACTERISTIC DDRC_DurDeb.ECBVlv_tiSCBDebOk_C "DDRC/Dauer der Heilungsentprellung für Prüfung DFC_ECBVlvSCB" VALUE 0x8002235C Val_Wu16 655350.0 DDRCTime_ms 0.00 655350.0 /end CHARACTERISTIC
/begin CHARACTERISTIC DDRC_DurDeb.ECBVlv_tiSCBDebDef_C "DDRC/Dauer der Fehlerentprellung für Prüfung DFC_ECBVlvSCB" VALUE 0x8002235E Val_Wu16 655350.0 DDRCTime_ms 0.00 655350.0 /end CHARACTERISTIC
/begin CHARACTERISTIC DDRC_DurDeb.EngStA_tiOvrTempDebOk_C "DDRC/Dauer der Heilungsentprellung für Prüfung DFC_FlFltHtOvrTemp" VALUE 0x80022360 Val_Wu16 655350.0 DDRCTime_ms 0.00 655350.0 /end CHARACTERISTIC
/begin CHARACTERISTIC DDRC_DurDeb.EngStA_tiOvrTempDebDef_C "DDRC/Dauer der Fehlerentprellung für Prüfung DFC_FlFltHtOvrTemp" VALUE 0x80022362 Val_Wu16 655350.0 DDRCTime_ms 0.00 655350.0 /end CHARACTERISTIC
/begin CHARACTERISTIC DDRC_DurDeb.UPmpMot_tiSCGDebOk_C "DDRC/Dauer der Heilungsentprellung für Prüfung DFC_UPmpMotSCG" VALUE 0x80022364 Val_Wu16 655350.0 DDRCTime_ms 0.00 655350.0 /end CHARACTERISTIC
/begin CHARACTERISTIC DDRC_DurDeb.UPmpMot_tiSCGDebDef_C "DDRC/Dauer der Fehlerentprellung für Prüfung DFC_UPmpMotSCG" VALUE 0x80022366 Val_Wu16 655350.0 DDRCTime_ms 0.00 655350.0 /end CHARACTERISTIC
/begin CHARACTERISTIC DDRC_DurDeb.WaHtEl_tiOvrTempDebOk_C "DDRC/Dauer der Heilungsentprellung für Prüfung DFC_WaHtElOvrTemp" VALUE 0x80022368 Val_Wu16 655350.0 DDRCTime_ms 0.00 655350.0 /end CHARACTERISTIC
/begin CHARACTERISTIC DDRC_DurDeb.WaHtEl_tiOvrTempDebDef_C "DDRC/Dauer der Fehlerentprellung für Prüfung DFC_WaHtElOvrTemp" VALUE 0x8002236A Val_Wu16 655350.0 DDRCTime_ms 0.00 655350.0 /end CHARACTERISTIC
/begin CHARACTERISTIC DDRC_DurDeb.CByVlv_tiOLDebOk_C "DDRC/Dauer der Heilungsentprellung für Prüfung DFC_CByVlvOL" VALUE 0x8002236C Val_Wu16 655350.0 DDRCTime_ms 0.00 655350.0 /end CHARACTERISTIC
/begin CHARACTERISTIC DDRC_DurDeb.CByVlv_tiOLDebDef_C "DDRC/Dauer der Fehlerentprellung für Prüfung DFC_CByVlvOL" VALUE 0x8002236E Val_Wu16 655350.0 DDRCTime_ms 0.00 655350.0 /end CHARACTERISTIC
/begin CHARACTERISTIC DDRC_DurDeb.UDosVlv_tiOvrTempDebOk_C "DDRC/Dauer der Heilungsentprellung für Prüfung DFC_UDosVlvOvrTemp" VALUE 0x80022370 Val_Wu16 655350.0 DDRCTime_ms 0.00 655350.0 /end CHARACTERISTIC
/begin CHARACTERISTIC DDRC_DurDeb.UDosVlv_tiOvrTempDebDef_C "DDRC/Dauer der Fehlerentprellung für Prüfung DFC_UDosVlvOvrTemp" VALUE 0x80022372 Val_Wu16 655350.0 DDRCTime_ms 0.00 655350.0 /end CHARACTERISTIC
/begin CHARACTERISTIC DDRC_DurDeb.CThmst_tiSCBDebOk_C "DDRC/Dauer der Heilungsentprellung für Prüfung DFC_CThmstSCB" VALUE 0x80022374 Val_Wu16 655350.0 DDRCTime_ms 0.00 655350.0 /end CHARACTERISTIC
/begin CHARACTERISTIC DDRC_DurDeb.CThmst_tiSCBDebDef_C "DDRC/Dauer der Fehlerentprellung für Prüfung DFC_CThmstSCB" VALUE 0x80022376 Val_Wu16 655350.0 DDRCTime_ms 0.00 655350.0 /end CHARACTERISTIC
/begin CHARACTERISTIC DDRC_DurDeb.CThmst_tiOLDebOk_C "DDRC/Dauer der Heilungsentprellung für Prüfung DFC_CThmstOL" VALUE 0x80022378 Val_Wu16 655350.0 DDRCTime_ms 0.00 655350.0 /end CHARACTERISTIC
/begin CHARACTERISTIC DDRC_DurDeb.CThmst_tiOLDebDef_C "DDRC/Dauer der Fehlerentprellung für Prüfung DFC_CThmstOL" VALUE 0x8002237A Val_Wu16 655350.0 DDRCTime_ms 0.00 655350.0 /end CHARACTERISTIC
/begin CHARACTERISTIC DDRC_DurDeb.PCV_tiOLDebOk_C "DDRC/Dauer der Heilungsentprellung für Prüfung DFC_PCVOL" VALUE 0x8002237C Val_Wu16 655350.0 DDRCTime_ms 0.00 655350.0 /end CHARACTERISTIC
/begin CHARACTERISTIC DDRC_DurDeb.PCV_tiOLDebDef_C "DDRC/Dauer der Fehlerentprellung für Prüfung DFC_PCVOL" VALUE 0x8002237E Val_Wu16 655350.0 DDRCTime_ms 0.00 655350.0 /end CHARACTERISTIC
/begin CHARACTERISTIC DDRC_DurDeb.LSU_tiHtrMinDebOk_C "DDRC/Dauer der Heilungsentprellung für Prüfung DFC_LSUHtrMin" VALUE 0x80022380 Val_Wu16 655350.0 DDRCTime_ms 0.00 655350.0 /end CHARACTERISTIC
/begin CHARACTERISTIC DDRC_DurDeb.LSU_tiHtrMinDebDef_C "DDRC/Dauer der Fehlerentprellung für Prüfung DFC_LSUHtrMin" VALUE 0x80022382 Val_Wu16 655350.0 DDRCTime_ms 0.00 655350.0 /end CHARACTERISTIC
/begin CHARACTERISTIC DDRC_DurDeb.Fan_tiSCBDebOk_C "DDRC/Dauer der Heilungsentprellung für Prüfung DFC_FanSCB" VALUE 0x80022384 Val_Wu16 655350.0 DDRCTime_ms 0.00 655350.0 /end CHARACTERISTIC
/begin CHARACTERISTIC DDRC_DurDeb.Fan_tiSCBDebDef_C "DDRC/Dauer der Fehlerentprellung für Prüfung DFC_FanSCB" VALUE 0x80022386 Val_Wu16 655350.0 DDRCTime_ms 0.00 655350.0 /end CHARACTERISTIC
/begin CHARACTERISTIC DDRC_DurDeb.ECBVlv_tiOLDebOk_C "DDRC/Dauer der Heilungsentprellung für Prüfung DFC_ECBVlvOL" VALUE 0x80022388 Val_Wu16 655350.0 DDRCTime_ms 0.00 655350.0 /end CHARACTERISTIC
/begin CHARACTERISTIC DDRC_DurDeb.ECBVlv_tiOLDebDef_C "DDRC/Dauer der Fehlerentprellung für Prüfung DFC_ECBVlvOL" VALUE 0x8002238A Val_Wu16 655350.0 DDRCTime_ms 0.00 655350.0 /end CHARACTERISTIC
/begin CHARACTERISTIC DDRC_DurDeb.UPmpMot_tiSCBDebOk_C "DDRC/Dauer der Heilungsentprellung für Prüfung DFC_UPmpMotSCB" VALUE 0x8002238C Val_Wu16 655350.0 DDRCTime_ms 0.00 655350.0 /end CHARACTERISTIC
/begin CHARACTERISTIC DDRC_DurDeb.UPmpMot_tiSCBDebDef_C "DDRC/Dauer der Fehlerentprellung für Prüfung DFC_UPmpMotSCB" VALUE 0x8002238E Val_Wu16 655350.0 DDRCTime_ms 0.00 655350.0 /end CHARACTERISTIC
/begin CHARACTERISTIC DDRC_DurDeb.ThrVlv_tiOvrTempDebOk_C "DDRC/Dauer der Heilungsentprellung für Prüfung DFC_ThrVlvOvrTemp" VALUE 0x80022390 Val_Wu16 655350.0 DDRCTime_ms 0.00 655350.0 /end CHARACTERISTIC
/begin CHARACTERISTIC DDRC_DurDeb.ThrVlv_tiOvrTempDebDef_C "DDRC/Dauer der Fehlerentprellung für Prüfung DFC_ThrVlvOvrTemp" VALUE 0x80022392 Val_Wu16 655350.0 DDRCTime_ms 0.00 655350.0 /end CHARACTERISTIC
/begin CHARACTERISTIC DDRC_DurDeb.FlFltHt_tiSCBDebOk_C "DDRC/Dauer der Heilungsentprellung für Prüfung DFC_FlFltHtSCB" VALUE 0x80022394 Val_Wu16 655350.0 DDRCTime_ms 0.00 655350.0 /end CHARACTERISTIC
/begin CHARACTERISTIC DDRC_DurDeb.FlFltHt_tiSCBDebDef_C "DDRC/Dauer der Fehlerentprellung für Prüfung DFC_FlFltHtSCB" VALUE 0x80022396 Val_Wu16 655350.0 DDRCTime_ms 0.00 655350.0 /end CHARACTERISTIC
/begin CHARACTERISTIC DDRC_DurDeb.EBxFan_tiOLDebOk_C "DDRC/Dauer der Heilungsentprellung für Prüfung DFC_EBxFanOL" VALUE 0x80022398 Val_Wu16 655350.0 DDRCTime_ms 0.00 655350.0 /end CHARACTERISTIC
/begin CHARACTERISTIC DDRC_DurDeb.EBxFan_tiOLDebDef_C "DDRC/Dauer der Fehlerentprellung für Prüfung DFC_EBxFanOL" VALUE 0x8002239A Val_Wu16 655350.0 DDRCTime_ms 0.00 655350.0 /end CHARACTERISTIC
/begin CHARACTERISTIC DDRC_DurDeb.LSU_titExcMinDebOk_C "DDRC/Dauer der Heilungsentprellung für Prüfung DFC_LSUtExcMin" VALUE 0x8002239C Val_Wu16 655350.0 DDRCTime_ms 0.00 655350.0 /end CHARACTERISTIC
/begin CHARACTERISTIC DDRC_DurDeb.LSU_titExcMinDebDef_C "DDRC/Dauer der Fehlerentprellung für Prüfung DFC_LSUtExcMin" VALUE 0x8002239E Val_Wu16 655350.0 DDRCTime_ms 0.00 655350.0 /end CHARACTERISTIC
/begin CHARACTERISTIC DDRC_DurDeb.DSMTst_ExampleDebOk_C "DDRC/Dauer der Heilungsentprellung für Prüfung DFC_DSMDummy" VALUE 0x800223A0 Val_Wu16 655350.0 DDRCTime_ms 0.00 655350.0 /end CHARACTERISTIC
/begin CHARACTERISTIC DDRC_DurDeb.DSMTst_ExampleDebDef_C "DDRC/Dauer der Fehlerentprellung für Prüfung DFC_DSMDummy" VALUE 0x800223A2 Val_Wu16 655350.0 DDRCTime_ms 0.00 655350.0 /end CHARACTERISTIC
/begin CHARACTERISTIC DDRC_DurDeb.AirC_tiCmprSCBDebOk_C "DDRC/Dauer der Heilungsentprellung für Prüfung DFC_AirCCmprSCB" VALUE 0x800223A4 Val_Wu16 655350.0 DDRCTime_ms 0.00 655350.0 /end CHARACTERISTIC
/begin CHARACTERISTIC DDRC_DurDeb.AirC_tiCmprSCBDebDef_C "DDRC/Dauer der Fehlerentprellung für Prüfung DFC_AirCCmprSCB" VALUE 0x800223A6 Val_Wu16 655350.0 DDRCTime_ms 0.00 655350.0 /end CHARACTERISTIC
/begin CHARACTERISTIC DDRC_DurDeb.EMDmp_tiSCBDebOk_C "DDRC/Dauer der Heilungsentprellung für Prüfung DFC_EMDmpSCB" VALUE 0x800223A8 Val_Wu16 655350.0 DDRCTime_ms 0.00 655350.0 /end CHARACTERISTIC
/begin CHARACTERISTIC DDRC_DurDeb.EMDmp_tiSCBDebDef_C "DDRC/Dauer der Fehlerentprellung für Prüfung DFC_EMDmpSCB" VALUE 0x800223AA Val_Wu16 655350.0 DDRCTime_ms 0.00 655350.0 /end CHARACTERISTIC
/begin CHARACTERISTIC DDRC_DurDeb.Shtr_tiOvrTempDebOk_C "DDRC/Dauer der Heilungsentprellung für Prüfung DFC_ShtrOvrTemp" VALUE 0x800223AC Val_Wu16 655350.0 DDRCTime_ms 0.00 655350.0 /end CHARACTERISTIC
/begin CHARACTERISTIC DDRC_DurDeb.Shtr_tiOvrTempDebDef_C "DDRC/Dauer der Fehlerentprellung für Prüfung DFC_ShtrOvrTemp" VALUE 0x800223AE Val_Wu16 655350.0 DDRCTime_ms 0.00 655350.0 /end CHARACTERISTIC
/begin CHARACTERISTIC DDRC_DurDeb.LSU_tiHtrSigDebOk_C "DDRC/Dauer der Heilungsentprellung für Prüfung DFC_LSUHtrSig" VALUE 0x800223B0 Val_Wu16 655350.0 DDRCTime_ms 0.00 655350.0 /end CHARACTERISTIC
/begin CHARACTERISTIC DDRC_DurDeb.LSU_tiHtrSigDebDef_C "DDRC/Dauer der Fehlerentprellung für Prüfung DFC_LSUHtrSig" VALUE 0x800223B2 Val_Wu16 655350.0 DDRCTime_ms 0.00 655350.0 /end CHARACTERISTIC
/begin CHARACTERISTIC DDRC_DurDeb.WaHtEl_tiOLDebOk_C "DDRC/Dauer der Heilungsentprellung für Prüfung DFC_WaHtElOL" VALUE 0x800223B4 Val_Wu16 655350.0 DDRCTime_ms 0.00 655350.0 /end CHARACTERISTIC
/begin CHARACTERISTIC KF_NKW_TN "Zeit / Drehzahl anpassung" MAP 0x800636BC MapTKF_UW_SW_UB 2.550 Def_lf_ub_q0p01 0.00 2.550 FORMAT "%5.3"
 /begin AXIS_DESCR STD_AXIS Nkw Def_n_sw_q1p0 4 -32768. 32767. FORMAT "%5.0" DEPOSIT ABSOLUTE /end AXIS_DESCR
 /begin AXIS_DESCR STD_AXIS Y_KF_NKW_TN_no_input_quantity Def_td_uw_q0p01 4 0.00 655.350 FORMAT "%7.3" DEPOSIT ABSOLUTE /end AXIS_DESCR
/end CHARACTERISTIC
/begin CHARACTERISTIC KF_RUSS_KALT "Russkennfeld kalt" MAP 0x800636DE MapTKF_SW_SW_UW 655.3500 Def_russ_uw_q0p01 0.00 655.3500 FORMAT "%8.4"
 /begin AXIS_DESCR STD_AXIS Nkw Def_n_sw_q1p0 12 -32768. 32767. FORMAT "%5.0" DEPOSIT ABSOLUTE /end AXIS_DESCR
 /begin AXIS_DESCR STD_AXIS Y_KF_RUSS_KALT_no_input_quantity Def_m_sw_q0p1 12 -3276.80 3276.70 FORMAT "%7.2" DEPOSIT ABSOLUTE /end AXIS_DESCR
/end CHARACTERISTIC
/begin CHARACTERISTIC KF_RUSS_WARM "Russkennfeld warm" MAP 0x80063830 MapTKF_SW_SW_UW 655.3500 Def_russ_uw_q0p01 0.00 655.3500 FORMAT "%8.4"
 /begin AXIS_DESCR STD_AXIS Nkw Def_n_sw_q1p0 12 -32768. 32767. FORMAT "%5.0" DEPOSIT ABSOLUTE /end AXIS_DESCR
 /begin AXIS_DESCR STD_AXIS Y_KF_RUSS_WARM_no_input_quantity Def_m_sw_q0p1 12 -3276.80 3276.70 FORMAT "%7.2" DEPOSIT ABSOLUTE /end AXIS_DESCR
/end CHARACTERISTIC
/begin CHARACTERISTIC KL_KMST_FAK "Kilometerfaktor" CURVE 0x80063982 CurTKL_UW_VV_UB 2.550 Def_lf_ub_q0p01 0.00 2.550 FORMAT "%5.3"
 /begin AXIS_DESCR STD_AXIS Km_st Def_km_uw_q10 6 0.00 655350. FORMAT "%5.0" DEPOSIT ABSOLUTE /end AXIS_DESCR
/end CHARACTERISTIC
/begin CHARACTERISTIC KL_OZBEFKL "Befüllkennlinie" CURVE 0x80063996 CurTKL_UB_VV_UB 25.50 Def_niv_ub_q0p1 0.00 25.50 FORMAT "%5.2"
 /begin AXIS_DESCR STD_AXIS Oz_nivlangt Def_niv_ub_b75 6 0.00 74.71 DEPOSIT ABSOLUTE /end AXIS_DESCR
/end CHARACTERISTIC
/begin CHARACTERISTIC KL_OZTKKVB "Temperaturkompensation Kraftstoffverbrauch" CURVE 0x800639A4 CurTKL_SW_VV_UB 7.969 Def_f_ub_b8 0.00 7.969
 /begin AXIS_DESCR STD_AXIS Toel_oz Def_t_sw_q0p1 6 -3276.8 3276.7 FORMAT "%6.1" DEPOSIT ABSOLUTE /end AXIS_DESCR
/end CHARACTERISTIC
/begin CHARACTERISTIC KL_OZVERDFAK "Verdünnungsfaktor von Dieseleintrag" CURVE 0x800639B8 CurTKL_UW_VV_UW 0.9999847412109 Def_f_uw_b1 0.00 0.9999847412109 FORMAT "%15.13"
 /begin AXIS_DESCR STD_AXIS X_KL_OZVERDFAK_no_input_quantity Def_f_uw_b1 5 0.00 0.9998931884766 FORMAT "%15.13" EXTENDED_LIMITS 0.00 0.9999847412109 DEPOSIT ABSOLUTE /end AXIS_DESCR
/end CHARACTERISTIC
/begin CHARACTERISTIC KL_TEMP_FAK "Temperaturanpassung" CURVE 0x800639CE CurTKL_SW_VV_UW 7.9997559 Def_f_uw_b8 0.00 7.9997559 EXTENDED_LIMITS 0.00 7.9998779
 /begin AXIS_DESCR STD_AXIS Tmot Def_t_sw_q0p01 6 -327.680 327.670 FORMAT "%7.3" DEPOSIT ABSOLUTE /end AXIS_DESCR
/end CHARACTERISTIC
/begin CHARACTERISTIC KL_WKRM_FAK "zylinderindividueller Zündwinkelspätverstellungsfaktor" CURVE 0x800639E8 CurTKL_SW_VV_UB 1.9922 Def_f_ub_b2 0.00 1.9922
 /begin AXIS_DESCR STD_AXIS Dzw_mkr Def_zw_sw_q0p1 12 -50.000 60.000 EXTENDED_LIMITS -3276.8 3276.7 DEPOSIT ABSOLUTE /end AXIS_DESCR
/end CHARACTERISTIC
/begin CHARACTERISTIC K_CW_CBS "Konfiguration CBS Teilnehmer" VALUE 0x80063A38 Val_Wu32 4294967295. Def_dez_ul_q1 0.00 4294967295. FORMAT "%7.0" /end CHARACTERISTIC
/begin CHARACTERISTIC K_CW_CBSOZ "Codeword OZ 1" VALUE 0x80063A0E Val_Wu16 65535. Def_dez_uw_q1 0.00 65535. FORMAT "%5.0" /end CHARACTERISTIC
/begin CHARACTERISTIC K_OELREST "Faktor für Restrusssumme im Öl nach Ölwechsel" VALUE 0x80063A10 Val_Wu8 0.8000 Def_lf_ub_q0p01 0.00 0.8000 FORMAT "%6.4" EXTENDED_LIMITS 0.00 2.550 /end CHARACTERISTIC
/begin CHARACTERISTIC K_OZANFANZ "BOS-Startanzeigewert Restlaufstrecke" VALUE 0x80063A12 Val_Wu16 655350. Def_km_uw_q10 0.00 655350. FORMAT "%5.0" /end CHARACTERISTIC
/begin CHARACTERISTIC K_OZBZKMSTK1 "Bezugsintervall" VALUE 0x80063A34 Val_Wu8 255000. Def_km_ub_q1000 0.00 255000. FORMAT "%3.0" /end CHARACTERISTIC
/begin CHARACTERISTIC K_OZDAEMPF "Dänmpfung für die Mittelwert Kraftstoffverbrauch-Berechnung" VALUE 0x80063A14 Val_Wu8 0.249023 Def_f_ub_b0p25 0.00 0.249023 FORMAT "%8.6" /end CHARACTERISTIC
/begin CHARACTERISTIC K_OZKMMAXK11 "Maximalintervall" VALUE 0x80063A16 Val_Wu16 655350. Def_km_uw_q10 0.00 655350. FORMAT "%5.0" /end CHARACTERISTIC
/begin CHARACTERISTIC K_OZKMUPL "Für die Kontrolle der Km_st-Plausibilität" VALUE 0x80063A36 Val_Wu16 655350. Def_km_uw_q10 0.00 655350. FORMAT "%5.0" /end CHARACTERISTIC
/begin CHARACTERISTIC K_OZKVB96 "Typprüfkraftstoffverbrauch" VALUE 0x80063A18 Val_Wu8 31.88 Def_f_ub_b32 0.00 31.88 /end CHARACTERISTIC
/begin CHARACTERISTIC K_OZKVB96A "Typprüfkraftstoffverbrauch Automatikgetriebe" VALUE 0x80063A19 Val_Wu8 31.88 Def_f_ub_b32 0.00 31.88 /end CHARACTERISTIC
/begin CHARACTERISTIC K_OZKVBMXK18 "maximal zulässige Gesamtkraftstoffbonusmenge" VALUE 0x80063A1A Val_Wu16 65535. Def_dez_uw_q1 0.00 65535. FORMAT "%5.0" /end CHARACTERISTIC
/begin CHARACTERISTIC K_OZKVBOK16 "Kraftstoffbonusmenge in [l] je 0,5l Ölnachfüllung" VALUE 0x80063A1C Val_Wu16 65535. Def_dez_uw_q1 0.00 65535. FORMAT "%5.0" /end CHARACTERISTIC
/begin CHARACTERISTIC K_OZLF1 "Länderfaktor 1 Festwert" VALUE 0x80063A1E Val_Wu8 2.550 Def_lf_ub_q0p01 0.00 2.550 FORMAT "%5.3" /end CHARACTERISTIC
/begin CHARACTERISTIC K_OZLF2 "Länderfaktor 2 Festwert" VALUE 0x80063A1F Val_Wu8 2.550 Def_lf_ub_q0p01 0.00 2.550 FORMAT "%5.3" /end CHARACTERISTIC
/begin CHARACTERISTIC K_OZMAXBS "Max Betriebstunden für das Ölwechsel" VALUE 0x80063A20 Val_Wu8 2550. Def_th_ub_q10 0.00 2550. /end CHARACTERISTIC
/begin CHARACTERISTIC K_OZMNKMBO "Wegstrecke ab der eine Bonuszuteilung erfolgt" VALUE 0x80063A22 Val_Wu16 655350. Def_km_uw_q10 0.00 655350. FORMAT "%5.0" /end CHARACTERISTIC
/begin CHARACTERISTIC K_OZMXOHK15 "Max Tage für den Ölservice" VALUE 0x80063A24 Val_Wu16 999.0 Def_dez_uw_q1 1.000 1000. FORMAT "%5.0" EXTENDED_LIMITS 0.00 65535. /end CHARACTERISTIC
/begin CHARACTERISTIC K_OZOELMEN "Ölmenge für den Dieseleintrag" VALUE 0x80063A26 Val_Wu8 25.50 Def_niv_ub_q0p1 0.00 25.50 FORMAT "%5.2" /end CHARACTERISTIC
/begin CHARACTERISTIC K_OZRUSSMX "max Russsumme im Öl" VALUE 0x80063A28 Val_Wu32 8999999. Def_dez_ul_q1 1.00000 9000000. FORMAT "%7.0" EXTENDED_LIMITS 0.00 4294967295. /end CHARACTERISTIC
/begin CHARACTERISTIC K_OZTAGCTERR "Wert für unplausibel Tagezähler" VALUE 0x80063A2C Val_Wu16 65535. Def_dez_uw_q1 0.00 65535. FORMAT "%5.0" /end CHARACTERISTIC
/begin CHARACTERISTIC K_OZUEBERTEMP "Schwelle für die Ölsübertemperatur-Kontrolle" VALUE 0x80063A2E Val_Ws16 6553.5 Def_t_sw_q0p1 -3276.8 3276.7 FORMAT "%6.1" /end CHARACTERISTIC
/begin CHARACTERISTIC K_OZUTFAK "Faktor für den Kraftstoffverbrauch bei Übertemperatur" VALUE 0x80063A30 Val_Wu8 255. Def_dez_ub_q1 0.00 255. FORMAT "%3.0" /end CHARACTERISTIC
/begin CHARACTERISTIC K_OZZEITFAKT "Bereich der gesamten Laufstrecke wo die Berechnung des Zeit-RW Beainfluss hat" VALUE 0x80063A31 Val_Wu8 0.99609 Def_f_ub_b1 0.00 0.99609 FORMAT "%7.5" /end CHARACTERISTIC
/begin CHARACTERISTIC K_OZZEITINT "Zeitintervall für Ölwechsel in Monate (CBS4)" VALUE 0x80063A32 Val_Wu8 254. Def_dez_ub_q1 1.0 255. FORMAT "%3.0" EXTENDED_LIMITS 0.00 255. /end CHARACTERISTIC
/begin CHARACTERISTIC K_OZZYKCBS "Zeitabstand fürs zyklisch Senden der CBS-Nachricht" VALUE 0x80063A3C Val_Wu8 255. Def_dez_ub_q1 0.00 255. FORMAT "%3.0" /end CHARACTERISTIC
/begin CHARACTERISTIC VehMot_rvSlipThres_C "" VALUE 0x800384C4 Val_Ws16 655.3500 Fact100 -327.6800 327.6700 FORMAT "%8.4" /end CHARACTERISTIC
/begin MEASUREMENT Bosbtvfbk "Rest-Verfügbarkeit Motoröl in Prozent" UBYTE Def_dez_ub_q1 1 100 0.00 255. FORMAT "%3.0" ECU_ADDRESS 0xC000B0D4 /end MEASUREMENT
/begin MEASUREMENT Bosconf "Aktive CBS-Komponente" ULONG Def_dez_ul_q1 1 100 0.00 4294967295. FORMAT "%7.0" ECU_ADDRESS 0xC0008E5C /end MEASUREMENT
/begin MEASUREMENT Bosfxid2 "Zieltermin_Monat_BOS_Rückstellung_2" UWORD Def_dez_uw_q1 1 100 0.00 65535. FORMAT "%5.0" ECU_ADDRESS 0xC0009B9A /end MEASUREMENT
/begin MEASUREMENT Bosid2 "Zieltermin_Monat_BOS_Rückstellung_2" UBYTE Def_dez_ub_q1 1 100 0.00 255. FORMAT "%3.0" ECU_ADDRESS 0xC000B0D5 /end MEASUREMENT
/begin MEASUREMENT Bosjziel "Zieltermin_Monat_BOS_Rückstellung_2" UBYTE Def_dez_ub_q1 1 100 0.00 255. FORMAT "%3.0" ECU_ADDRESS 0xC000B0D6 /end MEASUREMENT
/begin MEASUREMENT Bosmanip "Manipulationsbyte" UBYTE Def_dez_ub_q1 1 100 0.00 255. FORMAT "%3.0" ECU_ADDRESS 0xC000B0D7 /end MEASUREMENT
/begin MEASUREMENT Bosmziel "Zieltermin_Monat_BOS_Meldung_2" UBYTE Def_dez_ub_q1 1 100 0.00 255. FORMAT "%3.0" ECU_ADDRESS 0xC000B0D8 /end MEASUREMENT
/begin MEASUREMENT Bosprog2 "Prognose_Intervall_Zeit_BOS_Meldung_2" UBYTE Def_dez_ub_q1 1 100 0.00 255. FORMAT "%3.0" ECU_ADDRESS 0xC000B0D9 /end MEASUREMENT
/begin MEASUREMENT Bosres "Zieltermin_Monat_BOS_Rückstellung_2" UBYTE Def_dez_ub_q1 1 100 0.00 255. FORMAT "%3.0" ECU_ADDRESS 0xC000B0DA /end MEASUREMENT
/begin MEASUREMENT Bosrlsm "Ausgabewert Restlaufstrecke Motoröl" SWORD Def_dez_sw_q1 1 100 -32768. 32767. FORMAT "%5.0" ECU_ADDRESS 0xC0009B9C /end MEASUREMENT
/begin MEASUREMENT Bosrw2 "Prognose_Intervall_Weg_BOS_Meldung_2" UBYTE Def_km_ub_q1000 1 100 0.00 255000. FORMAT "%3.0" ECU_ADDRESS 0xC000B0DB /end MEASUREMENT
/begin MEASUREMENT Bosstate "Einheit der BOS-Info (km)" UBYTE Def_dez_ub_q1 1 100 0.00 255. FORMAT "%3.0" ECU_ADDRESS 0xC000B0DC /end MEASUREMENT
/begin MEASUREMENT Bostoken "Ampel für die Belegung der CBS-Schnittstelle" UBYTE Def_dez_ub_q1 1 100 0.00 255. FORMAT "%3.0" ECU_ADDRESS 0xC000B0DD /end MEASUREMENT
/begin MEASUREMENT CByVlv_st "Status der Kompressor bypass ventil" UBYTE OneToOne 1 100 0.00 255.0 ECU_ADDRESS 0xD0001C2A /end MEASUREMENT
/begin MEASUREMENT CByVlv_stPs "Digitalausgang des Stellers nach Diagnose" UBYTE OneToOne 1 100 0.00 255.0 ECU_ADDRESS 0xD0001C2B /end MEASUREMENT
/begin MEASUREMENT CEngDsT_dt "" SWORD TempCels_100ms 1 100 -32768.00 32767.00 FORMAT "%8.2" ECU_ADDRESS 0xD0000680 /end MEASUREMENT
/begin MEASUREMENT CEngDsT_dtDynTst_mp "" SWORD TempDiff_Kelv 1 100 -3276.800 3276.700 ECU_ADDRESS 0xC0009BA6 /end MEASUREMENT
/begin MEASUREMENT CEngDsT_stErrIni "" UBYTE OneToOne 1 100 0.00 255.0 ECU_ADDRESS 0xD0001C2C /end MEASUREMENT
/begin MEASUREMENT CEngDsT_stPHtr_mp "" UBYTE OneToOne 1 100 0.00 255.0 ECU_ADDRESS 0xC000B0EA /end MEASUREMENT
/begin MEASUREMENT CEngDsT_t "" SWORD Temp_Cels 1 100 -3549.940 3003.560 ECU_ADDRESS 0xD00003D4 /end MEASUREMENT
/begin MEASUREMENT CEngDsT_tDiff_mp "" SWORD TempDiff_Kelv 1 100 -3276.800 3276.700 ECU_ADDRESS 0xC0009BAA /end MEASUREMENT
/begin MEASUREMENT CEngDsT_tEndDynTst_mp "" SWORD Temp_Cels 1 100 -3549.940 3003.560 ECU_ADDRESS 0xC0009BA8 /end MEASUREMENT
/begin MEASUREMENT CEngDsT_tiDynTst_mp "" SLONG Time_s 1 100 -21474836.4800 21474836.4700 ECU_ADDRESS 0xC0008E60 /end MEASUREMENT
/begin MEASUREMENT CEngDsT_tiMaxDynTst "" SLONG Time_s 1 100 -21474836.4800 21474836.4700 ECU_ADDRESS 0xD0002E0C /end MEASUREMENT
/begin MEASUREMENT CEngDsT_tSens "" SWORD Temp_Cels 1 100 -3549.940 3003.560 ECU_ADDRESS 0xD0000682 /end MEASUREMENT
/begin MEASUREMENT CEngDsT_tStrt "" SWORD Temp_Cels 1 100 -3549.940 3003.560 ECU_ADDRESS 0xD0000684 /end MEASUREMENT
/begin MEASUREMENT CEngDsT_tTmp_mp "" SWORD Temp_Cels 1 100 -3549.940 3003.560 ECU_ADDRESS 0xC0009BAC /end MEASUREMENT
/begin MEASUREMENT CEngDsT_t_mp "" SWORD Temp_Cels 1 100 -3549.940 3003.560 ECU_ADDRESS 0xC0009BA4 /end MEASUREMENT
/begin MEASUREMENT CEngDsT_uRaw "" SWORD Volt 1 100 -6553.600 6553.400 ECU_ADDRESS 0xD0000686 /end MEASUREMENT
/begin MEASUREMENT Clth_st "Kupplungsstatusinformation" UBYTE OneToOne 1 100 0.00 255.0 ECU_ADDRESS 0xD0001C2D /end MEASUREMENT
/begin MEASUREMENT Clth_stIntDebVal "Interner entprellter Kupplungssensorwert" UBYTE OneToOne 1 100 0.00 255.0 ECU_ADDRESS 0xD0001C2E /end MEASUREMENT
/begin MEASUREMENT Clth_stLastGear "Gang aus letztem Taskzyklus" SBYTE OneToOne 1 100 -128.0 127.0 ECU_ADDRESS 0xD0001BC7 /end MEASUREMENT
/begin MEASUREMENT Clth_stOldGear "Letzter gültiger Gang" SBYTE OneToOne 1 100 -128.0 127.0 ECU_ADDRESS 0xD0001BC8 /end MEASUREMENT
/begin MEASUREMENT Clth_stOpnMark "Kupplungszustandsmarker: Kupplung ist offen" UBYTE OneToOne 1 100 0.00 255.0 ECU_ADDRESS 0xD0001C2F /end MEASUREMENT
/begin MEASUREMENT Clth_stRaw "Rohwert des Kupplungssignals" UBYTE OneToOne 1 100 0.00 255.0 ECU_ADDRESS 0xD0001C30 /end MEASUREMENT
/begin MEASUREMENT CmbChb_ctEngRevLogBuf1_mp "Meßpunkt für die Anzahl bewerteten Motorumdrehungen der Kurbelwelle des Puffer1" UWORD OneToOne 1 100 0.00 65535.00 ECU_ADDRESS 0xC0009BAE /end MEASUREMENT
/begin MEASUREMENT CmbChb_ctEngRevLogBuf2_mp "Meßpunkt für die Anzahl bewerteten Motorumdrehungen der Kurbelwelle des Puffer2" UWORD OneToOne 1 100 0.00 65535.00 ECU_ADDRESS 0xC0009BB0 /end MEASUREMENT
/begin MEASUREMENT CmbChb_ctEngRevLogMem_mp "Kurbelwellen-Umdrehungszähler" UWORD OneToOne 1 100 0.00 65535.00 ECU_ADDRESS 0xC0009BB2 /end MEASUREMENT
/begin MEASUREMENT CmbChb_ctEngRevPerBlk_mp "Meßpunkt für die Anzahl der Blockgroesse für die bewerteten Motorumdrehungen der Kurbelwelle" UWORD OneToOne 1 100 0.00 65535.00 ECU_ADDRESS 0xC0009BB4 /end MEASUREMENT
/begin MEASUREMENT CmbChb_ctMifBuf1_mp "Meßpunkt für die Erkennung der Fehlzündungen der einzelnen Zylinder, Puffer1" SWORD OneToOne 1 100 -32768.00 32767.00 ARRAY_SIZE 7 ECU_ADDRESS 0xC000B92A /end MEASUREMENT
/begin MEASUREMENT CmbChb_ctMifBuf2_mp "Meßpunkt für die Erkennung der Fehlzündungen der einzelnen Zylinder, Puffer2" SWORD OneToOne 1 100 -32768.00 32767.00 ARRAY_SIZE 7 ECU_ADDRESS 0xC000B938 /end MEASUREMENT
/begin MEASUREMENT CmbChb_ctMifMem_mp "Meßpunkt für die Erkennung der Fehlzündungen der einzelnen Zylinder, Logging Speicher" SWORD OneToOne 1 100 -32768.00 32767.00 ARRAY_SIZE 7 ECU_ADDRESS 0xC000B946 /end MEASUREMENT
/begin MEASUREMENT CmbChb_nMisf "Drehzahlsignal für OBD-Zündaussetzererkennung" SWORD EngN1 1 100 -16384.00 16383.50 FORMAT "%8.2" ECU_ADDRESS 0xD0000690 /end MEASUREMENT
/begin MEASUREMENT CmbChb_nSegEven_mp "Summe der Drehzahl fuer jede gerade Segmentnummer (von zwei Umdrehungen)" SLONG EngN1 1 100 -1073741824.00 1073741823.50 FORMAT "%13.2" ECU_ADDRESS 0xC0008E64 /end MEASUREMENT
/begin MEASUREMENT CmbChb_nSegOdd_mp "Summe der Drehzahl fuer jede ungerade Segmentnummer (von zwei Umdrehungen)" SLONG EngN1 1 100 -1073741824.00 1073741823.50 FORMAT "%13.2" ECU_ADDRESS 0xC0008E68 /end MEASUREMENT
/begin MEASUREMENT CmbChb_nSpdIncrCurr_mp "aktueller Drehzahlanstieg" SWORD EngN1 1 100 -16384.00 16383.50 FORMAT "%8.2" ECU_ADDRESS 0xC0009BB6 /end MEASUREMENT
/begin MEASUREMENT CmbChb_nSpdIncrMin_mp "minimaler Drehzahlanstieg pro Zylinder" SWORD EngN1 1 100 -16384.00 16383.50 FORMAT "%8.2" ECU_ADDRESS 0xC0009BB8 /end MEASUREMENT
/begin MEASUREMENT CmbChb_st "Status der Fehlzündungserkennung" UBYTE OneToOne 1 100 0.00 255.0 ECU_ADDRESS 0xD0001C32 /end MEASUREMENT
/begin MEASUREMENT CmbChb_stDelMisf "Verschiebung Segmentsystem für Aussetzererkennung" SBYTE OneToOne 1 100 -128.0 127.0 ECU_ADDRESS 0xD0001BC9 /end MEASUREMENT
/begin MEASUREMENT CmbCWT_t "" SWORD Temp_Cels 1 100 -3549.940 3003.560 ECU_ADDRESS 0xD000068E /end MEASUREMENT
/begin MEASUREMENT CnvLead_facRmpVal "Rampenfaktor" SWORD CoEOMSwt_S16 1 100 -2.000000 1.999939 FORMAT "%8.6" ECU_ADDRESS 0xD0000692 /end MEASUREMENT
/begin MEASUREMENT CnvLead_qCurr "Einspritzmenge Curr-Pfad" SWORD InjMass 1 100 -327.6800 327.6700 ECU_ADDRESS 0xD0000694 /end MEASUREMENT
/begin MEASUREMENT CnvLead_qCurrNxt "Einspritzmenge Curr-Pfad für künftige Betriebsart" SWORD InjMass 1 100 -327.6800 327.6700 ECU_ADDRESS 0xD0000696 /end MEASUREMENT
/begin MEASUREMENT CnvLead_qCurrPrs "Einspritzmenge Curr-Pfad für aktuelle Betriebsart" SWORD InjMass 1 100 -327.6800 327.6700 ECU_ADDRESS 0xD0000698 /end MEASUREMENT
/begin MEASUREMENT CnvLead_qRaw "Einspritzmenge Raw-Pfad" SWORD InjMass 1 100 -327.6800 327.6700 ECU_ADDRESS 0xD000069A /end MEASUREMENT
/begin MEASUREMENT CnvLead_qRawNxt "Einspritzmenge Raw-Pfad für künftige Betriebsart" SWORD InjMass 1 100 -327.6800 327.6700 ECU_ADDRESS 0xD000069C /end MEASUREMENT
/begin MEASUREMENT CnvLead_qRawPrs "Einspritzmenge Raw-Pfad für aktuelle Betriebsart" SWORD InjMass 1 100 -327.6800 327.6700 ECU_ADDRESS 0xD000069E /end MEASUREMENT
/begin MEASUREMENT CnvSet_etaCurr "aktueller Umrechnungswirkungsgrad" SWORD Eta3 1 100 -256.0000 255.9922 FORMAT "%8.4" ECU_ADDRESS 0xD00006A0 /end MEASUREMENT
/begin MEASUREMENT CnvSet_etaCurrNxt "Umrechnungswirkungsgrad künftige Betriebsart" SWORD Eta3 1 100 -256.0000 255.9922 FORMAT "%8.4" ECU_ADDRESS 0xD00006A2 /end MEASUREMENT
/begin MEASUREMENT CnvSet_facRmpVal "Rampenwert für die Betriebsartenumschaltung" SWORD CoEOMSwt_S16 1 100 -2.000000 1.999939 FORMAT "%8.6" ECU_ADDRESS 0xD00006A4 /end MEASUREMENT
/begin MEASUREMENT CnvSet_qNrm "" SWORD InjMass 1 100 -327.6800 327.6700 ECU_ADDRESS 0xD00006A6 /end MEASUREMENT
/begin MEASUREMENT CnvSet_qSet "Soll-Einspritzmenge" SWORD InjMass 1 100 -327.6800 327.6700 ECU_ADDRESS 0xD00006A8 /end MEASUREMENT
/begin MEASUREMENT CnvSet_qSetNxt "Soll-Einspritzmenge künftige Betriebsart" SWORD InjMass 1 100 -327.6800 327.6700 ECU_ADDRESS 0xD00006AA /end MEASUREMENT
/begin MEASUREMENT CnvSet_qSetOptNxt_mp "Soll-Einspritzmenge ohne Korrekturen künftige Betriebsart" SWORD InjMass 1 100 -327.6800 327.6700 ECU_ADDRESS 0xC0009BBA /end MEASUREMENT
/begin MEASUREMENT CnvSet_qSetOpt_mp "Soll-Einspritzmenge ohne Korrekturen" SWORD InjMass 1 100 -327.6800 327.6700 ECU_ADDRESS 0xC0009BBC /end MEASUREMENT
/begin MEASUREMENT CnvSet_qSetPrs "Soll-Einspritzmenge aktuelle Betriebsart" SWORD InjMass 1 100 -327.6800 327.6700 ECU_ADDRESS 0xD00006AC /end MEASUREMENT
/begin MEASUREMENT CnvSet_qStrt "Start-Einspritzmenge" SWORD InjMass 1 100 -327.6800 327.6700 ECU_ADDRESS 0xD00006AE /end MEASUREMENT
/begin MEASUREMENT CoAS_stEGRVlv "Status ARF-Steller" ULONG OneToOne 1 100 0.00 4294967295.00 ECU_ADDRESS 0xD000309C /end MEASUREMENT
/begin MEASUREMENT CoAS_stThrVlv "Status Drosselklappen-Steller" ULONG OneToOne 1 100 0.00 4294967295.00 ECU_ADDRESS 0xD00030A0 /end MEASUREMENT
/begin MEASUREMENT CoAS_stTrbCh "Status Ladedruck-Steller" ULONG OneToOne 1 100 0.00 4294967295.00 ECU_ADDRESS 0xD00030A4 /end MEASUREMENT
/begin MEASUREMENT CodVar_stBlk0_mp "" UWORD OneToOne 1 100 0.00 65535.00 ECU_ADDRESS 0xC0009BBE /end MEASUREMENT
/begin MEASUREMENT CodVar_stBlk1_mp "" UWORD OneToOne 1 100 0.00 65535.00 ECU_ADDRESS 0xC0009BC0 /end MEASUREMENT
/begin MEASUREMENT CodVar_stBlk2_mp "" UWORD OneToOne 1 100 0.00 65535.00 ECU_ADDRESS 0xC0009BC2 /end MEASUREMENT
/begin MEASUREMENT CodVar_stBlk3_mp "" UWORD OneToOne 1 100 0.00 65535.00 ECU_ADDRESS 0xC0009BC4 /end MEASUREMENT
/begin MEASUREMENT CodVar_stFlLPCActv "" UBYTE OneToOne 1 100 0.00 255.0 ECU_ADDRESS 0xD0001C5B /end MEASUREMENT
/begin MEASUREMENT CodVar_stFlLPCSelfRecClct_mp "" UBYTE OneToOne 1 100 0.00 255.0 ECU_ADDRESS 0xC000B0EB /end MEASUREMENT
/begin MEASUREMENT CodVar_stMIL "" UBYTE OneToOne 1 100 0.00 255.0 ECU_ADDRESS 0xD0001C5C /end MEASUREMENT
/begin MEASUREMENT CodVar_stTrqClth "" UBYTE OneToOne 1 100 0.00 255.0 ECU_ADDRESS 0xD0001C5D /end MEASUREMENT
/begin MEASUREMENT CodVar_stTrqClthCpl "" UBYTE OneToOne 1 100 0.00 255.0 ECU_ADDRESS 0xD0001C5E /end MEASUREMENT
/begin MEASUREMENT CodVar_stTrqInr "" UBYTE OneToOne 1 100 0.00 255.0 ECU_ADDRESS 0xD0001C5F /end MEASUREMENT
/begin MEASUREMENT CodVar_stVMax "" UBYTE OneToOne 1 100 0.00 255.0 ECU_ADDRESS 0xD0001C60 /end MEASUREMENT
/begin MEASUREMENT CoEng_st "" UBYTE OneToOne 1 100 0.00 255.0 ECU_ADDRESS 0xD0001BBE /end MEASUREMENT
/begin MEASUREMENT CoEng_stDiaReq "Diagnoseschnittstelle" UBYTE OneToOne 1 100 0.00 255.0 ECU_ADDRESS 0xD0001C40 /end MEASUREMENT
/begin MEASUREMENT CoEng_stIRevShutOff "irreversible Abschaltursachen (nach Maskierung)" ULONG OneToOne 1 100 0.00 4294967295.00 ECU_ADDRESS 0xD0003108 /end MEASUREMENT
/begin MEASUREMENT CoEng_stMSAStp "" UBYTE OneToOne 1 100 0.00 255.0 ECU_ADDRESS 0xD0001C41 /end MEASUREMENT
/begin MEASUREMENT CoEng_stOld "Motorstatus vor aktuellem Status" UBYTE OneToOne 1 100 0.00 255.0 ECU_ADDRESS 0xD0001BBF /end MEASUREMENT
/begin MEASUREMENT CoEng_stOldOld "" UBYTE OneToOne 1 100 0.00 255.0 ECU_ADDRESS 0xD0001C42 /end MEASUREMENT
/begin MEASUREMENT CoEng_stRevShutOff "reversible Abschaltursachen (nach Maskierung)" ULONG OneToOne 1 100 0.00 4294967295.00 ECU_ADDRESS 0xD000310C /end MEASUREMENT
/begin MEASUREMENT CoEng_stShOff "Absperrvorrichtungsstatus" UBYTE OneToOne 1 100 0.00 255.0 ECU_ADDRESS 0xD0001C43 /end MEASUREMENT
/begin MEASUREMENT CoEng_stShOffActv_mp "" UBYTE OneToOne 1 100 0.00 255.0 ECU_ADDRESS 0xC000B0EC /end MEASUREMENT
/begin MEASUREMENT CoEng_stShutOff "" UBYTE OneToOne 1 100 0.00 255.0 ECU_ADDRESS 0xD0001C44 /end MEASUREMENT
/begin MEASUREMENT CoEng_stShutOffPath "aktive Abstellpfade resultierend aus aktiven reversiblen, irreversiblen und Nachlauf-Abstellpfaden" ULONG OneToOne 1 100 0.00 4294967295.00 ECU_ADDRESS 0xD0003110 /end MEASUREMENT
/begin MEASUREMENT CoEng_stSoftShOffRls_mp "Status-Information für soft shutoff Freigabe." UBYTE OneToOne 1 100 0.00 255.0 ECU_ADDRESS 0xC000B0ED /end MEASUREMENT
/begin MEASUREMENT CoEng_stState_mp "" UBYTE OneToOne 1 100 0.00 255.0 ECU_ADDRESS 0xC000B0EE /end MEASUREMENT
/begin MEASUREMENT CoEng_stStopEna "Motorstopp ist vom Motor erlaubt" UBYTE OneToOne 1 100 0.00 255.0 ECU_ADDRESS 0xD0001C45 /end MEASUREMENT
/begin MEASUREMENT CoEng_stStrtEna "Motorstart ist vom Motor erlaubt" UBYTE OneToOne 1 100 0.00 255.0 ECU_ADDRESS 0xD0001C46 /end MEASUREMENT
/begin MEASUREMENT CoEng_tiAfterrun "Zeit seit Erreichen des Motorzustands Nachlauf (COENG_STOPPING & COENG_FINISH)" ULONG Time_ms 1 100 0.00 42949672950.0 ECU_ADDRESS 0xD0003114 /end MEASUREMENT
/begin MEASUREMENT CoEng_tiAfterrunRed "Zeit seit Erreichen des Motorzustands Nachlauf (COENG_STOPPING & COENG_FINISH) mit reduzierter Auflösung als KL/KF Eingang" SWORD TimeRed 1 100 -5242.880 5242.720 FORMAT "%8.3" ECU_ADDRESS 0xD00006DC /end MEASUREMENT
/begin MEASUREMENT CoEng_tiNormal "" ULONG Time_ms 1 100 0.00 42949672950.0 ECU_ADDRESS 0xD0003118 /end MEASUREMENT
/begin MEASUREMENT CoEng_tiNormalRed "" SWORD TimeRed 1 100 -5242.880 5242.720 FORMAT "%8.3" ECU_ADDRESS 0xD00006DE /end MEASUREMENT
/begin MEASUREMENT CoEng_tiStandby "Zeit seit Erreichen Motorzustand COENG_STANDBY" ULONG Time_ms 1 100 0.00 42949672950.0 ECU_ADDRESS 0xD000311C /end MEASUREMENT
/begin MEASUREMENT CoEng_tiStandbyRed "Zeit seit Erreichen Motorzustand COENG_STANDBY, mit reduzierter Auflösung als KL/KF Eingang" SWORD TimeRed 1 100 -5242.880 5242.720 FORMAT "%8.3" ECU_ADDRESS 0xD00006E0 /end MEASUREMENT
/begin MEASUREMENT CoEng_tiStart "Zeit seit Erreichen Motorzustand (COENG_READY & COENG_CRANKING)" ULONG Time_ms 1 100 0.00 42949672950.0 ECU_ADDRESS 0xD0002CE0 /end MEASUREMENT
/begin MEASUREMENT CoEng_tiStartRed "Zeit seit Erreichen Motorzustand (COENG_READY & COENG_CRANKING), mit reduzierter Auflösung als KL/KF Eingang" SWORD TimeRed 1 100 -5242.880 5242.720 FORMAT "%8.3" ECU_ADDRESS 0xD00006E2 /end MEASUREMENT
/begin MEASUREMENT CoEng_tiStrtDly "Verzögerungszeit beim Startvorgang" SWORD Time_ms 1 100 -327680.0 327670.0 ECU_ADDRESS 0xD00006E4 /end MEASUREMENT
/begin MEASUREMENT CoEOM_facRmpVal "Zentraler Rampenwert für die Betriebsartenumschaltung" SWORD CoEOMSwt_S16 1 100 -2.000000 1.999939 FORMAT "%8.6" ECU_ADDRESS 0xD00006B0 /end MEASUREMENT
/begin MEASUREMENT CoEOM_numOpModeAct "Nummer der aktuellen Betriebsart" UBYTE OneToOne 1 100 0.00 255.0 ECU_ADDRESS 0xD0001C34 /end MEASUREMENT
/begin MEASUREMENT CoEOM_numOpModeAct_mp "Nummer der aktuellen Betriebsart" UBYTE OneToOne 1 100 0.00 255.0 ECU_ADDRESS 0xC000B0EF /end MEASUREMENT
/begin MEASUREMENT CoEOM_numOpModeOld "Nummer der letzten Betriebsart" UBYTE OneToOne 1 100 0.00 255.0 ECU_ADDRESS 0xD0001C35 /end MEASUREMENT
/begin MEASUREMENT CoEOM_numOpModeOld_mp "Nummer der letzten Betriebsart" UBYTE OneToOne 1 100 0.00 255.0 ECU_ADDRESS 0xC000B0F0 /end MEASUREMENT
/begin MEASUREMENT CoEOM_numStageAct "Nummer der aktuellen Stufe" UBYTE OneToOne 1 100 0.00 255.0 ECU_ADDRESS 0xD0001C36 /end MEASUREMENT
/begin MEASUREMENT CoEOM_numStageAct_mp "Nummer der aktuellen Stufe" UBYTE OneToOne 1 100 0.00 255.0 ECU_ADDRESS 0xC000B0F1 /end MEASUREMENT
/begin MEASUREMENT CoEOM_stDeadlck "Status ob ein Deadlock während der Betriebsarten-Auswahl aufgetreten ist" UBYTE OneToOne 1 100 0.00 255.0 ECU_ADDRESS 0xD0001C37 /end MEASUREMENT
/begin MEASUREMENT CoEOM_stDSCHEDDem "Betriebsartenanforderung von DSCHED" UWORD OneToOne 1 100 0.00 65535.00 ECU_ADDRESS 0xD00014E4 /end MEASUREMENT
/begin MEASUREMENT CoEOM_stEndOpMode "Anforderung an die Komponenten, die aktuelle Betriebsart zu beenden" UBYTE OneToOne 1 100 0.00 255.0 ECU_ADDRESS 0xD0001C38 /end MEASUREMENT
/begin MEASUREMENT CoEOM_stNxtOpMode "Bitmaske der Betriebsarten, die von der aktuellen Betriebsart direkt aktiviert werden können" UWORD OneToOne 1 100 0.00 65535.00 ECU_ADDRESS 0xD00014E6 /end MEASUREMENT
/begin MEASUREMENT CoEOM_stNxtStage "Bitmaske der Stufen, die von der aktuellen Betriebsart aus direkt aktiviert werden können." UWORD OneToOne 1 100 0.00 65535.00 ECU_ADDRESS 0xD00014E8 /end MEASUREMENT
/begin MEASUREMENT CoEOM_stOpModeAct "Aktuelle Betriebsart" ULONG OneToOne 1 100 0.00 4294967295.00 ECU_ADDRESS 0xD00030A8 /end MEASUREMENT
/begin MEASUREMENT CoEOM_stOpModeActTSync "" ULONG OneToOne 1 100 0.00 4294967295.00 ECU_ADDRESS 0xD00030B4 /end MEASUREMENT
/begin MEASUREMENT CoEOM_stOpModeDem "Ausgewählter Betriebsartenwunsch bei einem Deadlock" ULONG OneToOne 1 100 0.00 4294967295.00 ECU_ADDRESS 0xD00030B8 /end MEASUREMENT
/begin MEASUREMENT CoEOM_stOpModeDes "Durch den Betriebsartenkoordinator ausgewählte Betriebsart" ULONG OneToOne 1 100 0.00 4294967295.00 ECU_ADDRESS 0xD00030BC /end MEASUREMENT
/begin MEASUREMENT CoEOM_stOpModeItm "Array mit den eingesammelten Betriebsartenwünschen" ULONG OneToOne 1 100 0.00 4294967295.00 ARRAY_SIZE 6 ECU_ADDRESS 0xD00030C0 /end MEASUREMENT
/begin MEASUREMENT CoEOM_stOpModeLck "Lockbit zum Synchronisieren" UBYTE OneToOne 1 100 0.00 255.0 ECU_ADDRESS 0xD0001C39 /end MEASUREMENT
/begin MEASUREMENT CoEOM_stOpModeLckTSync "Statusbit zur Synchronisation zwischen zeit- und Winkelsynchronen Tasks" UBYTE OneToOne 1 100 0.00 255.0 ECU_ADDRESS 0xD0001C3A /end MEASUREMENT
/begin MEASUREMENT CoEOM_stOpModeOld "Letzte Betriebsart" ULONG OneToOne 1 100 0.00 4294967295.00 ECU_ADDRESS 0xD00030D8 /end MEASUREMENT
/begin MEASUREMENT CoEOM_stOpModeOldTSync "Letzte Betriebsart (zeitsynchron)" ULONG OneToOne 1 100 0.00 4294967295.00 ECU_ADDRESS 0xD00030DC /end MEASUREMENT
/begin MEASUREMENT CoEOM_stOpModePos "Bitmaske der möglichen Betriebsarten für den DSM-Scheduler" UWORD OneToOne 1 100 0.00 65535.00 ECU_ADDRESS 0xD00014EA /end MEASUREMENT
/begin MEASUREMENT CoEOM_stOpModePrio2 "Priorität_2 der ausgewählten Betriebsart" UBYTE OneToOne 1 100 0.00 255.0 ECU_ADDRESS 0xD0001C3B /end MEASUREMENT
/begin MEASUREMENT CoEOM_stOpModeReq "Schnittstelle für Austausch von betriebsarten Informationenen zwischen den Komponenten" ULONG OneToOne 1 100 0.00 4294967295.00 ECU_ADDRESS 0xD00030E0 /end MEASUREMENT
/begin MEASUREMENT CoEOM_stOpModeSort "Array mit den sortierten Betriebsartenwünschen" ULONG OneToOne 1 100 0.00 4294967295.00 ARRAY_SIZE 5 ECU_ADDRESS 0xD00030E4 /end MEASUREMENT
/begin MEASUREMENT CoEOM_stRisePrio "Status welches Element von CoEOM_stOpModeItm[] auf das höchstwertige Element kopiert wurde" UBYTE OneToOne 1 100 0.00 255.0 ECU_ADDRESS 0xD0001C3C /end MEASUREMENT
/begin MEASUREMENT CoEOM_stSyncLck "Status um eine doppelte Berechnung der n-synchronen CoEOM Botschaften durch die Prozesse CoEOM_swtTSync und CoEOM_swtNSync zu verhindern" UBYTE OneToOne 1 100 0.00 255.0 ECU_ADDRESS 0xD00025C9 /end MEASUREMENT
/begin MEASUREMENT CoEOM_stTiRmpDem "Status welche Komponenten eine Rampenzeit mit dem Betriebsartenwunsch senden." ULONG OneToOne 1 100 0.00 4294967295.00 ECU_ADDRESS 0xD00030F8 /end MEASUREMENT
/begin MEASUREMENT CoEOM_stTransActv "Status ob eine Betriebsartenumschaltung aktiv ist" UBYTE OneToOne 1 100 0.00 255.0 ECU_ADDRESS 0xD00025CA /end MEASUREMENT
/begin MEASUREMENT CoEOM_tiOpModeChng "Zeit seit letztem Betriebsartenwechsel" ULONG Time_s 1 100 0.00 42949672.9500 ECU_ADDRESS 0xD00030FC /end MEASUREMENT
/begin MEASUREMENT CoEOM_tiOpModeChngTSync "Zeit seit der letzten Betriebsartenumschaltung (zeitsynchron)" ULONG Time_s 1 100 0.00 42949672.9500 ECU_ADDRESS 0xD0003100 /end MEASUREMENT
/begin MEASUREMENT CoEOM_tiRmpDem "Array mit den eingesammelten Rampen-Laufzeiten" SWORD TimeCoEOMRmp 1 100 0.0020000610370 65.536000000 FORMAT "%12.9" ARRAY_SIZE 5 ECU_ADDRESS 0xD00006B6 /end MEASUREMENT
/begin MEASUREMENT CoEOM_tiRmpSlp "Rampenlaufzeit für Betriebsartenumschaltung" ULONG TimeCoEOMRmp 1 100 0.000000015258789 65.536000000000001 FORMAT "%19.16" ECU_ADDRESS 0xD0003104 /end MEASUREMENT
/begin MEASUREMENT CoES_stAVSCoLSU "" UBYTE OneToOne 1 100 0.00 255.0 ECU_ADDRESS 0xD0001C3D /end MEASUREMENT
/begin MEASUREMENT CoES_stAVSCoLSU_mp "" UBYTE OneToOne 1 100 0.00 255.0 ECU_ADDRESS 0xC000B0F2 /end MEASUREMENT
/begin MEASUREMENT CoES_stSig_mp "" UBYTE OneToOne 1 100 0.00 255.0 ECU_ADDRESS 0xC000B0F3 /end MEASUREMENT
/begin MEASUREMENT CoES_stTrmMod_mp "" UBYTE OneToOne 1 100 0.00 255.0 ECU_ADDRESS 0xC000B0F4 /end MEASUREMENT
/begin MEASUREMENT CoETS_rTrq "Verhältnis aktuelles Moment zu Maximalmoment" SWORD Prc 1 100 -400.0000 399.9878 ECU_ADDRESS 0xD00006C0 /end MEASUREMENT
/begin MEASUREMENT CoETS_stCurrLim "Statuswort zur Markierung der niedrigsten Begrenzungsmomente" UWORD OneToOne 1 100 0.00 65535.00 ECU_ADDRESS 0xD00014EC /end MEASUREMENT
/begin MEASUREMENT CoETS_stCurrLimActive "Statuswort zur Markierung der wirksamen niedrigsten Begrenzungsmomente" UWORD OneToOne 1 100 0.00 65535.00 ECU_ADDRESS 0xD00014EE /end MEASUREMENT
/begin MEASUREMENT CoETS_stSetTrqActv "" UBYTE OneToOne 1 100 0.00 255.0 ECU_ADDRESS 0xD0001C3F /end MEASUREMENT
/begin MEASUREMENT CoETS_stSetTrqAlw_mp "" UBYTE OneToOne 1 100 0.00 255.0 ECU_ADDRESS 0xC000B0F5 /end MEASUREMENT
/begin MEASUREMENT CoETS_trqInrCurr "aktuelles inneres Moment" SWORD Trq 1 100 -3276.800 3276.700 ECU_ADDRESS 0xD00006C2 /end MEASUREMENT
/begin MEASUREMENT CoETS_trqInrCurrFast "inneres Moment Wunschwert (schneller Pfad) erzeugt aus CoPT_trqCurrEng" SWORD Trq 1 100 -3276.800 3276.700 ECU_ADDRESS 0xD00006C4 /end MEASUREMENT
/begin MEASUREMENT CoETS_trqInrCurrLim "aktuell kleinstes Begrenzungsmoment (inneres Motormoment)" SWORD Trq 1 100 -3276.800 3276.700 ECU_ADDRESS 0xD00006C6 /end MEASUREMENT
/begin MEASUREMENT CoETS_trqInrLead "Momentenwunsch (inneres Moment) Führungswert (ohne Filter/mit Vorhalt)" SWORD Trq 1 100 -3276.800 3276.700 ECU_ADDRESS 0xD00006C8 /end MEASUREMENT
/begin MEASUREMENT CoETS_trqInrLeadFast "Wunschmoment (inneres Motormoment) (schneller Pfad) erzeugt aus CoPT_trqLeadEng" SWORD Trq 1 100 -3276.800 3276.700 ECU_ADDRESS 0xD00006CA /end MEASUREMENT
/begin MEASUREMENT CoETS_trqInrLim "Begrenzungsmoment (als inneres Motormoment)" SWORD Trq 1 100 -3276.800 3276.700 ECU_ADDRESS 0xD00006CC /end MEASUREMENT
/begin MEASUREMENT CoETS_trqInrLimSet "Begrenzungsmoment ohne die Anteile des Drehzahlreglers" SWORD Trq 1 100 -3276.800 3276.700 ECU_ADDRESS 0xD00006CE /end MEASUREMENT
/begin MEASUREMENT CoETS_trqInrLtd "inneres Moment Sollwert nach Begrenzung, vor ASD" SWORD Trq 1 100 -3276.800 3276.700 ECU_ADDRESS 0xD00006D0 /end MEASUREMENT
/begin MEASUREMENT CoETS_trqInrSetSlow "inneres Moment Wunschwert (normaler Pfad) erzeugt aus CoPT_trqDesEng" SWORD Trq 1 100 -3276.800 3276.700 ECU_ADDRESS 0xD00006D2 /end MEASUREMENT
/begin MEASUREMENT CoETS_trqInrTraIntv "Ist-Moment mit Getriebeeingriff" SWORD Trq 1 100 -3276.800 3276.700 ECU_ADDRESS 0xD00006D4 /end MEASUREMENT
/begin MEASUREMENT CoETS_trqInrVehLimMin_mp "koordiniertes Begrenzungsmoment der Fahrzeugfunktionen (inneres Moment)" SWORD Trq 1 100 -3276.800 3276.700 ECU_ADDRESS 0xC0009BC6 /end MEASUREMENT
/begin MEASUREMENT CoETS_trqSetDiag "" SWORD Trq 1 100 -3276.800 3276.700 ECU_ADDRESS 0xD00006D6 /end MEASUREMENT
/begin MEASUREMENT CoETS_trqSet_mp "" SWORD OneToOne 1 100 -32768.00 32767.00 ECU_ADDRESS 0xC0009BC8 /end MEASUREMENT
/begin MEASUREMENT CoETS_trqUnFltLtd "Begrenztes Leerlaufreglermoment" SWORD Trq 1 100 -3276.800 3276.700 ECU_ADDRESS 0xD00006D8 /end MEASUREMENT
/begin MEASUREMENT CoETS_trqUnFltLtdSet "Kompensationsmoment der Nebenaggregate" SWORD Trq 1 100 -3276.800 3276.700 ECU_ADDRESS 0xD00006DA /end MEASUREMENT
/begin MEASUREMENT CoME_nMax "Maximaldrehzahlbegrenzung der Nebenaggregate" SWORD EngN 1 100 -16384.00 16383.50 ECU_ADDRESS 0xD00006E6 /end MEASUREMENT
/begin MEASUREMENT CoME_nMin "Minimale Leerlaufdrehzahlforderung der Nebenaggregate" SWORD EngN 1 100 -16384.00 16383.50 ECU_ADDRESS 0xD00006E8 /end MEASUREMENT
/begin MEASUREMENT CoME_stNSetP "Status: Art der Leerlaufdrehzahlerhöhung" UBYTE OneToOne 1 100 0.00 255.0 ECU_ADDRESS 0xD0001C48 /end MEASUREMENT
/begin MEASUREMENT CoME_trqDesComp "Momentenforderung des mechanischen Koordinators" SWORD Trq 1 100 -3276.800 3276.700 ECU_ADDRESS 0xD00006EA /end MEASUREMENT
/begin MEASUREMENT CoME_trqResv "Reservemomentenforderung des mechanischen Koordinators" SWORD Trq 1 100 -3276.800 3276.700 ECU_ADDRESS 0xD00006EC /end MEASUREMENT
/begin MEASUREMENT Conv_bCalc "Flag für die Berechnung der Momentenreserve und Momentenlast" UBYTE OneToOne 1 100 0.00 255.0 ECU_ADDRESS 0xD0001DB8 /end MEASUREMENT
/begin MEASUREMENT Conv_bCalcActv_mp "Flag für Berechnung aktiv" UBYTE OneToOne 1 100 0.00 255.0 ECU_ADDRESS 0xC000B0F6 /end MEASUREMENT
/begin MEASUREMENT Conv_bConvActv "Flag für Wandler aktiv/inaktiv" UBYTE OneToOne 1 100 0.00 255.0 ECU_ADDRESS 0xD0001DB9 /end MEASUREMENT
/begin MEASUREMENT Conv_bGearOff "Flag für Lastmoment" UBYTE OneToOne 1 100 0.00 255.0 ECU_ADDRESS 0xD0001DBA /end MEASUREMENT
/begin MEASUREMENT Conv_bRevLvrPos "Flag für Zustand Rückwärtsgang" UBYTE OneToOne 1 100 0.00 255.0 ECU_ADDRESS 0xD0001DBB /end MEASUREMENT
/begin MEASUREMENT Conv_bTrbnSpdCan "Flag für Turbinendrehzahl über CAN" UBYTE OneToOne 1 100 0.00 255.0 ECU_ADDRESS 0xD0001DBC /end MEASUREMENT
/begin MEASUREMENT Conv_bTrqLdCan "Flag für Lastmoment über CAN" UBYTE OneToOne 1 100 0.00 255.0 ECU_ADDRESS 0xD0001DBD /end MEASUREMENT
/begin MEASUREMENT Conv_bTrqLdFlt "Flag für gefiltertes Lastmoment" UBYTE OneToOne 1 100 0.00 255.0 ECU_ADDRESS 0xD0001DBE /end MEASUREMENT
/begin MEASUREMENT Conv_bTrqResv "Flag für ""Building"" Momentenreserve" UBYTE OneToOne 1 100 0.00 255.0 ECU_ADDRESS 0xD0001DBF /end MEASUREMENT
/begin MEASUREMENT Conv_bTrqResvBrkEnd "Flag für Lastreserve nach Bremsen" UBYTE OneToOne 1 100 0.00 255.0 ECU_ADDRESS 0xD0001DC0 /end MEASUREMENT
/begin MEASUREMENT Conv_bTrqResvLvrOff "Flag für Lastreserve im Leerlauf" UBYTE OneToOne 1 100 0.00 255.0 ECU_ADDRESS 0xD0001DC1 /end MEASUREMENT
/begin MEASUREMENT Conv_dnTrbn "" SLONG ConvRpm 1 100 -21474836.4800 21474836.4700 FORMAT "%13.4" ECU_ADDRESS 0xD0002E98 /end MEASUREMENT
/begin MEASUREMENT Conv_dnTrbnUnFlt_mp "" SLONG ConvRpm 1 100 -21474836.4800 21474836.4700 FORMAT "%13.4" ECU_ADDRESS 0xC0008E6C /end MEASUREMENT
/begin MEASUREMENT Conv_facDepNTrbnNStat_mp "Faktor für die Umrechnung von Turbinendrehzahl auf stationäre Drehzahl" SWORD Fact 1 100 -4.000000 3.999878 ECU_ADDRESS 0xC0009BCA /end MEASUREMENT
/begin MEASUREMENT Conv_facOilTempDepTrqPmp "Öltemperatur abhängiger Faktor" SWORD TrqToNSqr 1 100 -0.003276800 0.003276700 FORMAT "%11.9" ECU_ADDRESS 0xD0000880 /end MEASUREMENT
/begin MEASUREMENT Conv_nTrbn "Turbinendrehzahl" SWORD EngN 1 100 -16384.00 16383.50 ECU_ADDRESS 0xD0000882 /end MEASUREMENT
/begin MEASUREMENT Conv_nTrbnCorrVal_mp "Wert für die Korrektur der Turbinendrehzahl" SWORD EngN 1 100 -16384.00 16383.50 ECU_ADDRESS 0xC0009BCC /end MEASUREMENT
/begin MEASUREMENT Conv_nTrbnDiff_mp "Turbinendrehzahldifferenz" SWORD EngN 1 100 -16384.00 16383.50 ECU_ADDRESS 0xC0009BCE /end MEASUREMENT
/begin MEASUREMENT Conv_nTrbnExp_mp "erwartete Turbinendrehzahl" SWORD EngN 1 100 -16384.00 16383.50 ECU_ADDRESS 0xC0009BD0 /end MEASUREMENT
/begin MEASUREMENT Conv_nTrbnMod "modellierte Turbinendrehzahl" SWORD EngN 1 100 -16384.00 16383.50 ECU_ADDRESS 0xD0000884 /end MEASUREMENT
/begin MEASUREMENT Conv_nTrbnOld "alte Turbinendrehzahl" SWORD EngN 1 100 -16384.00 16383.50 ECU_ADDRESS 0xD0000886 /end MEASUREMENT
/begin MEASUREMENT Conv_rNTrbnNStat_mp "Verhältnis Turbinendrehzahl stationären Drehzahl" SWORD TransR 1 100 -327.6800 327.6700 ECU_ADDRESS 0xC0009BD2 /end MEASUREMENT
/begin MEASUREMENT Conv_rTrq "Wandlerübersetzungsverhältnis" SWORD TransR 1 100 -327.6800 327.6700 ECU_ADDRESS 0xD0000888 /end MEASUREMENT
/begin MEASUREMENT Conv_tiTempDepLvrDebNeg "Entprellzeit Temperatur kein Gang" SLONG TimeDeb 1 100 -21474836480.0 21474836470.0 ECU_ADDRESS 0xD000088A /end MEASUREMENT
/begin MEASUREMENT Conv_tiTempDepLvrDebPos "Entprellzeit Temperatur Gang eingelegt" SLONG TimeDeb 1 100 -21474836480.0 21474836470.0 ECU_ADDRESS 0xD000088C /end MEASUREMENT
/begin MEASUREMENT Conv_tiTempDepRevLvrDebNeg "Entprellzeit Temperatur kein Rückwärtsgang" SLONG TimeDeb 1 100 -21474836480.0 21474836470.0 ECU_ADDRESS 0xD000088E /end MEASUREMENT
/begin MEASUREMENT Conv_tiTempDepRevLvrDebPos "Entprellzeit Temperatur Rückwärtsgang" SLONG TimeDeb 1 100 -21474836480.0 21474836470.0 ECU_ADDRESS 0xD0000890 /end MEASUREMENT
/begin MEASUREMENT Conv_tOilBuf_mp "Puffer für Öltemperatur" SWORD Temp_Cels 1 100 -3549.940 3003.560 ECU_ADDRESS 0xC0009BEA /end MEASUREMENT
/begin MEASUREMENT Conv_trqFlt "" SWORD Trq 1 100 -3276.800 3276.700 ECU_ADDRESS 0xD0000892 /end MEASUREMENT
/begin MEASUREMENT Conv_trqLd "Momentenlast vom Wandler" SWORD Trq 1 100 -3276.800 3276.700 ECU_ADDRESS 0xD0000894 /end MEASUREMENT
/begin MEASUREMENT Conv_trqLdBefLim_mp "Momentenlast vor Momentenbegrenzung" SWORD Trq 1 100 -3276.800 3276.700 ECU_ADDRESS 0xC0009BD4 /end MEASUREMENT
/begin MEASUREMENT Conv_trqLdDiff_mp "Momentenlastdifferenz" SWORD Trq 1 100 -3276.800 3276.700 ECU_ADDRESS 0xC0009BD6 /end MEASUREMENT
/begin MEASUREMENT Conv_trqLdFlt "gefilterte Momentenlast" SWORD Trq 1 100 -3276.800 3276.700 ECU_ADDRESS 0xD0000896 /end MEASUREMENT
/begin MEASUREMENT Conv_trqLdFltRslt_mp "gefilterte Momentenlast zur Berechnung der Momentenreserve" SWORD Trq 1 100 -3276.800 3276.700 ECU_ADDRESS 0xC0009BD8 /end MEASUREMENT
/begin MEASUREMENT Conv_trqLdLvrPosNeutr "Lastmoment für kein Gang eingelegt" SWORD Trq 1 100 -3276.800 3276.700 ECU_ADDRESS 0xD0000898 /end MEASUREMENT
/begin MEASUREMENT Conv_trqLdMaxLim_mp "aktuelle Begrenzung für Momentenlast vom CAN" SWORD Trq 1 100 -3276.800 3276.700 ECU_ADDRESS 0xC0009BDA /end MEASUREMENT
/begin MEASUREMENT Conv_trqLdMod "modellierte Berechnung der Momentenlast" SWORD Trq 1 100 -3276.800 3276.700 ECU_ADDRESS 0xD000089A /end MEASUREMENT
/begin MEASUREMENT Conv_trqLdOfs_mp "Offset der Momentenlast" SWORD Trq 1 100 -3276.800 3276.700 ECU_ADDRESS 0xC0009BDC /end MEASUREMENT
/begin MEASUREMENT Conv_trqLdPreFlt "vorgefilterte Momentenlast" SWORD Trq 1 100 -3276.800 3276.700 ECU_ADDRESS 0xD000089C /end MEASUREMENT
/begin MEASUREMENT Conv_trqLdResvAdd_mp "zusätzliche Momentenreserve für eingelegten Gang" SWORD Trq 1 100 -3276.800 3276.700 ECU_ADDRESS 0xC0009BDE /end MEASUREMENT
/begin MEASUREMENT Conv_trqLdResvFlt_mp "gefilterte zusätzliche Momentenreserve" SWORD Trq 1 100 -3276.800 3276.700 ECU_ADDRESS 0xC0009BE0 /end MEASUREMENT
/begin MEASUREMENT Conv_trqLdRevLvrPos "Lastmoment für Gang eingelegt" SWORD Trq 1 100 -3276.800 3276.700 ECU_ADDRESS 0xD000089E /end MEASUREMENT
/begin MEASUREMENT Conv_trqLdTempDepLim "Temperaturabhängiger Wert für Begrenzung Lastmoment" SWORD Trq 1 100 -3276.800 3276.700 ECU_ADDRESS 0xD00008A0 /end MEASUREMENT
/begin MEASUREMENT Conv_trqLdTrqResvTotBuf_mp "Momentenlastpuffer für die Summe von Momentenlast und Momentenreserve" SWORD Trq 1 100 -3276.800 3276.700 ECU_ADDRESS 0xC0009BE2 /end MEASUREMENT
/begin MEASUREMENT Conv_trqPmpBuf_mp "Pumpenmoment" SWORD Trq 1 100 -3276.800 3276.700 ECU_ADDRESS 0xC0009BE4 /end MEASUREMENT
/begin MEASUREMENT Conv_trqResv "Momentenreserve vom Wandler" SWORD Trq 1 100 -3276.800 3276.700 ECU_ADDRESS 0xD00008A2 /end MEASUREMENT
/begin MEASUREMENT Conv_trqResvHiInc_mp "Faktor für zusätzliche Momentenreserve" SWORD Trq 1 100 -3276.800 3276.700 ECU_ADDRESS 0xC0009BE6 /end MEASUREMENT
/begin MEASUREMENT Conv_trqResvTempDep "Temperaturabhängiges Reservemoment" SWORD Trq 1 100 -3276.800 3276.700 ECU_ADDRESS 0xD00008A4 /end MEASUREMENT
/begin MEASUREMENT Conv_trqStatSqBuf_mp "Puffer für Pumpenmoment" SWORD Trq 1 100 -3276.800 3276.700 ECU_ADDRESS 0xC0009BE8 /end MEASUREMENT
/begin MEASUREMENT CoPT_rClgDes "Gesamtkühlanforderung des Antriebsstrangs an den Lüfter" SWORD Prc 1 100 -400.0000 399.9878 ECU_ADDRESS 0xD0000702 /end MEASUREMENT
/begin MEASUREMENT CoPT_stIARls "Zündwinkelfreigabe durch erhöhenden bzw. reduzierenden Getriebeeingriff" UBYTE OneToOne 1 100 0.00 255.0 ECU_ADDRESS 0xD0001C4A /end MEASUREMENT
/begin MEASUREMENT CoPT_tClntDes "Kühlmittelsolltemperatur des Antriebsstrangs" SWORD Temp_Cels 1 100 -3549.940 3003.560 ECU_ADDRESS 0xD0000704 /end MEASUREMENT
/begin MEASUREMENT CoPT_trqCurr "Vorhaltmomentenauftrag (Raildruckregelung) an Momentensteller (Kupplungsmoment)" SWORD Trq 1 100 -3276.800 3276.700 ECU_ADDRESS 0xD0000708 /end MEASUREMENT
/begin MEASUREMENT CoPT_trqCurrDecMin_mp "Vorhaltmoment (Raildruckregelung) nach Koordination des Reduzierenden Getriebeeingriffs (Kupplungsmoment)" SWORD Trq 1 100 -3276.800 3276.700 ECU_ADDRESS 0xC0009BF2 /end MEASUREMENT
/begin MEASUREMENT CoPT_trqDCSClth "MSR-Momenteneingriff (Kupplungsmoment)" SWORD Trq 1 100 -3276.800 3276.700 ECU_ADDRESS 0xD000070C /end MEASUREMENT
/begin MEASUREMENT CoPT_trqDes "Summenmomentenauftrag an Momentensteller (Kupplungsmoment)" SWORD Trq 1 100 -3276.800 3276.700 ECU_ADDRESS 0xD000070E /end MEASUREMENT
/begin MEASUREMENT CoPT_trqDesClth_mp "Sollmomentenauftrag an Antriebsstrang (Kupplungsmoment)" SWORD Trq 1 100 -3276.800 3276.700 ECU_ADDRESS 0xC0009BEC /end MEASUREMENT
/begin MEASUREMENT CoPT_trqDesDecMin_mp "Sollmoment nach Koordination mir reduzierendem Getriebeeingriff (Kupplungsmoment)" SWORD Trq 1 100 -3276.800 3276.700 ECU_ADDRESS 0xC0009BEE /end MEASUREMENT
/begin MEASUREMENT CoPT_trqDesIncMax_mp "Sollmoment nach Koordination mir erhöhendem Getriebeeingriff (Kupplungsmoment)" SWORD Trq 1 100 -3276.800 3276.700 ECU_ADDRESS 0xC0009BF0 /end MEASUREMENT
/begin MEASUREMENT CoPT_trqDesTCSClth "ASR-Sollmomenteneingriff (Kupplungsmoment)" SWORD Trq 1 100 -3276.800 3276.700 ECU_ADDRESS 0xD0000714 /end MEASUREMENT
/begin MEASUREMENT CoPT_trqLead "Vorhaltmomentenauftrag an Momentensteller (Kupplungsmoment)" SWORD Trq 1 100 -3276.800 3276.700 ECU_ADDRESS 0xD0000716 /end MEASUREMENT
/begin MEASUREMENT CoPT_trqLeadClth_mp "Vorhaltvortiebsmoment (clutch torque)" SWORD Trq 1 100 -3276.800 3276.700 ECU_ADDRESS 0xC0009BF4 /end MEASUREMENT
/begin MEASUREMENT CoPT_trqLeadDecMin_mp "Vorhaltmoment nach Koordination des reduzierenden Getriebeeingriffs (Kupplungsmoment)" SWORD Trq 1 100 -3276.800 3276.700 ECU_ADDRESS 0xC0009BF6 /end MEASUREMENT
/begin MEASUREMENT CoPT_trqLeadIncMax_mp "Vorhaltmoment nach Koordination des reduzierenden Getriebeeingriffs (Kupplungsmoment)" SWORD Trq 1 100 -3276.800 3276.700 ECU_ADDRESS 0xC0009BF8 /end MEASUREMENT
/begin MEASUREMENT CoPT_trqLeadPOp "Vorhaltmomen an Momentensteller zur Auswahl der BDE-Betriebsart (Kupplungsmoment)" SWORD Trq 1 100 -3276.800 3276.700 ECU_ADDRESS 0xD000071A /end MEASUREMENT
/begin MEASUREMENT CoPT_trqLeadTCSClth "ASR-Vorhaltmomenteneingriff (Kupplungsmoment)" SWORD Trq 1 100 -3276.800 3276.700 ECU_ADDRESS 0xD000071E /end MEASUREMENT
/begin MEASUREMENT CoPT_trqPTPrt "Antriebsstrangschutzmoment (Kupplungsmoment)" SWORD Trq 1 100 -3276.800 3276.700 ECU_ADDRESS 0xD0000720 /end MEASUREMENT
/begin MEASUREMENT CoPT_trqTraDes "Sollmoment ohne Getriebeeingriff (Kupplungsmoment)" SWORD Trq 1 100 -3276.800 3276.700 ECU_ADDRESS 0xD0000724 /end MEASUREMENT
/begin MEASUREMENT CoSCR_cntEntryAftrun "" UWORD OneToOne 1 100 0.00 65535.00 ECU_ADDRESS 0xD0000726 /end MEASUREMENT
/begin MEASUREMENT CoSCR_cntEntryAftrunEmpt "" UWORD OneToOne 1 100 0.00 65535.00 ECU_ADDRESS 0xD0000728 /end MEASUREMENT
/begin MEASUREMENT CoSCR_cntEntryAftrunTempWait "" UWORD OneToOne 1 100 0.00 65535.00 ECU_ADDRESS 0xD000072A /end MEASUREMENT
/begin MEASUREMENT CoSCR_cntEntryMetCtl "Unterzustandszähler" UWORD OneToOne 1 100 0.00 65535.00 ECU_ADDRESS 0xD000072C /end MEASUREMENT
/begin MEASUREMENT CoSCR_cntEntryNoPresCtl "Zustandszähler" UWORD OneToOne 1 100 0.00 65535.00 ECU_ADDRESS 0xD000072E /end MEASUREMENT
/begin MEASUREMENT CoSCR_cntEntryPresBuildUp "Unterzustandszähler" UWORD OneToOne 1 100 0.00 65535.00 ECU_ADDRESS 0xD0000730 /end MEASUREMENT
/begin MEASUREMENT CoSCR_cntEntryPresCtl "Zustandszähler" UWORD OneToOne 1 100 0.00 65535.00 ECU_ADDRESS 0xD0000732 /end MEASUREMENT
/begin MEASUREMENT CoSCR_cntEntryPresRdc "Zustandszähler" UWORD OneToOne 1 100 0.00 65535.00 ECU_ADDRESS 0xD0000734 /end MEASUREMENT
/begin MEASUREMENT CoSCR_cntEntryReFl "Unterzustandszähler" UWORD OneToOne 1 100 0.00 65535.00 ECU_ADDRESS 0xD0000736 /end MEASUREMENT
/begin MEASUREMENT CoSCR_cntEntryStBy "Eintrittszähler in den Zustand STANDBY" UWORD OneToOne 1 100 0.00 65535.00 ECU_ADDRESS 0xD0000738 /end MEASUREMENT
/begin MEASUREMENT CoSCR_cntEntryVtln "Unterzustandszähler" UWORD OneToOne 1 100 0.00 65535.00 ECU_ADDRESS 0xD000073A /end MEASUREMENT
/begin MEASUREMENT CoSCR_st "Zustand des Hydraulischen SCR Systems" UBYTE SCRCon_State_01 1 100 0.00 6.00000000000 FORMAT "%13.11" ECU_ADDRESS 0xD0001C4E /end MEASUREMENT
/begin MEASUREMENT CoSCR_stOld "letzter Zustand des Hydraulischen SCR Systems" UBYTE SCRCon_State_01 1 100 0.00 6.00000000000 FORMAT "%13.11" ECU_ADDRESS 0xD0001C4F /end MEASUREMENT
/begin MEASUREMENT CoSCR_stSub "Unterzustand des Hydraulischen SCR Systems" UBYTE SCRCon_State_02 1 100 0.00 6.00000000000 FORMAT "%13.11" ECU_ADDRESS 0xD0001C50 /end MEASUREMENT
/begin MEASUREMENT CoSCR_stSubOld "letzter Unterzustand des Hydraulischen SCR Systems" UBYTE SCRCon_State_02 1 100 0.00 6.00000000000 FORMAT "%13.11" ECU_ADDRESS 0xD0001C51 /end MEASUREMENT
/begin MEASUREMENT CoSCR_tiAftrun "" ULONG Time_ms 1 100 0.00 42949672950.0 ECU_ADDRESS 0xD0003120 /end MEASUREMENT
/begin MEASUREMENT CoSCR_tiAftrunEmpt "" ULONG Time_ms 1 100 0.00 42949672950.0 ECU_ADDRESS 0xD0003124 /end MEASUREMENT
/begin MEASUREMENT CoSCR_tiAftrunTempWait "" ULONG Time_ms 1 100 0.00 42949672950.0 ECU_ADDRESS 0xD0003128 /end MEASUREMENT
/begin MEASUREMENT CoSCR_tiMetCtl "Unterzustandsverweildauer" ULONG Time_ms 1 100 0.00 42949672950.0 ECU_ADDRESS 0xD000312C /end MEASUREMENT
/begin MEASUREMENT CoSCR_tiNoPresCtl "Verweilzeit im Zustand NOPRESSURECONTROL" ULONG Time_ms 1 100 0.00 42949672950.0 ECU_ADDRESS 0xD0003130 /end MEASUREMENT
/begin MEASUREMENT CoSCR_tiPresBuildUp "Unterzustandsverweildauer" ULONG Time_ms 1 100 0.00 42949672950.0 ECU_ADDRESS 0xD0003134 /end MEASUREMENT
/begin MEASUREMENT CoSCR_tiPresCtl "Verweilzeit im Zustand PRESSURECONTROL" ULONG Time_ms 1 100 0.00 42949672950.0 ECU_ADDRESS 0xD0003138 /end MEASUREMENT
/begin MEASUREMENT CoSCR_tiPresRdc "Zustandsverweildauer" ULONG Time_ms 1 100 0.00 42949672950.0 ECU_ADDRESS 0xD000313C /end MEASUREMENT
/begin MEASUREMENT CoSCR_tiReFl "Unterzustandsverweildauer" ULONG Time_ms 1 100 0.00 42949672950.0 ECU_ADDRESS 0xD0003140 /end MEASUREMENT
/begin MEASUREMENT CoSCR_tiStBy "Statusvariable des Zustands STANDBY" ULONG Time_ms 1 100 0.00 42949672950.0 ECU_ADDRESS 0xD0003144 /end MEASUREMENT
/begin MEASUREMENT CoSCR_tiVtln "Unterzustandsverweildauer" ULONG Time_ms 1 100 0.00 42949672950.0 ECU_ADDRESS 0xD0003148 /end MEASUREMENT
/begin MEASUREMENT CoTemp_rClgDes "Kühlanforderung des Verbrennungsmotors" SWORD Prc 1 100 -400.0000 399.9878 ECU_ADDRESS 0xD000073C /end MEASUREMENT
/begin MEASUREMENT CoTemp_tEngDes "Kühlmittelsolltemperatur des Verbrennungsmotors" SWORD Temp_Cels 1 100 -3549.940 3003.560 ECU_ADDRESS 0xD000073E /end MEASUREMENT
/begin MEASUREMENT CoVeh_nMaxSysErr "Maximaldrehzahlbegrenzung bei Systemfehler" SWORD EngN 1 100 -16384.00 16383.50 ECU_ADDRESS 0xD0000744 /end MEASUREMENT
/begin MEASUREMENT CoVeh_nMinSysErr "Minimaldrehzahlbegrenzung bei Systemfehler" SWORD EngN 1 100 -16384.00 16383.50 ECU_ADDRESS 0xD0000746 /end MEASUREMENT
/begin MEASUREMENT CoVeh_rClgDes "Gewünschter relativer Luftmassenstrom" SWORD Prc 1 100 -400.0000 399.9878 ECU_ADDRESS 0xD0000748 /end MEASUREMENT
/begin MEASUREMENT CoVeh_stLimSysErr "Status Momentendurchgriff Systemfehlerbegrenzung" UBYTE OneToOne 1 100 0.00 255.0 ECU_ADDRESS 0xD0001C59 /end MEASUREMENT
/begin MEASUREMENT CoVeh_stNSetPSysErr "Statuswort das Umsetzung der Systemfehlerdrehzahlanforderungen definiert" UBYTE OneToOne 1 100 0.00 255.0 ECU_ADDRESS 0xD0001C5A /end MEASUREMENT
/begin MEASUREMENT CoVeh_tClntDes "Gewünschte Kühlmitteltemperatur" SWORD Temp_Cels 1 100 -3549.940 3003.560 ECU_ADDRESS 0xD000074A /end MEASUREMENT
/begin MEASUREMENT CoVeh_trqAcs "Momentenforderung der Nebenaggregate" SWORD Trq 1 100 -3276.800 3276.700 ECU_ADDRESS 0xD000074C /end MEASUREMENT
/begin MEASUREMENT CoVeh_trqDes "Sollmomentenauftrag an den Antrieb (Getriebeausgangsmoment)" SLONG TrqPrpHigh 1 100 -214748364.800 214748364.700 ECU_ADDRESS 0xD0002E28 /end MEASUREMENT
/begin MEASUREMENT CoVeh_trqLead "Vorhaltmomentenauftrag an den Antriebsstrang (Getriebeausgangsmoment)" SLONG TrqPrpHigh 1 100 -214748364.800 214748364.700 ECU_ADDRESS 0xD0002E2C /end MEASUREMENT
/begin MEASUREMENT CoVeh_trqLim_mp "Systemfehlerbgrenzungsmoment (Radmoment)" SLONG TrqPrpHigh 1 100 -214748364.800 214748364.700 ECU_ADDRESS 0xC0008E70 /end MEASUREMENT
/begin MEASUREMENT CoVeh_trqPrpLimErr "Systemfehlerbgrenzungsmoment (Getriebeausgangsmoment)" SLONG TrqPrpHigh 1 100 -214748364.800 214748364.700 ECU_ADDRESS 0xD0002E30 /end MEASUREMENT
/begin MEASUREMENT CoVMD_aReqCrCtl_mp "Beschleunigungsanforderung der CrCtl" SWORD Acc 1 100 -32.76800 32.76700 FORMAT "%8.5" ECU_ADDRESS 0xC0009BFA /end MEASUREMENT
/begin MEASUREMENT CoVMD_facCompAcsCrCtl "Faktor Nebenaggregatekompensation durch CrCtl" SWORD Fact 1 100 -4.000000 3.999878 ECU_ADDRESS 0xD0000740 /end MEASUREMENT
/begin MEASUREMENT CoVMD_facCompAcsLLim "Faktor Nebenaggregatekompensation durch LLim" SWORD Fact 1 100 -4.000000 3.999878 ECU_ADDRESS 0xD0000742 /end MEASUREMENT
/begin MEASUREMENT CoVMD_stCtOffPhdCrCtl "Status Schubabschalteverbot durch Cruise Control" UBYTE OneToOne 1 100 0.00 255.0 ECU_ADDRESS 0xD0001C52 /end MEASUREMENT
/begin MEASUREMENT CoVMD_stCtOffPhdLLim "Status Schubabschalteverbot durch Longitudinalbegrenzer (LLim)" UBYTE OneToOne 1 100 0.00 255.0 ECU_ADDRESS 0xD0001C53 /end MEASUREMENT
/begin MEASUREMENT CoVMD_stReqCrCtl "Koordinierter Status der Beschleunigungsanforderung" UBYTE OneToOne 1 100 0.00 255.0 ECU_ADDRESS 0xD0001C54 /end MEASUREMENT
/begin MEASUREMENT CoVMD_swtCCSel "Schalter für Auswahl Cruise Control (CrCtl, ACCI)" UBYTE OneToOne 1 100 0.00 255.0 ECU_ADDRESS 0xD0001C55 /end MEASUREMENT
/begin MEASUREMENT CoVMD_swtRmpPBr_mp "" UBYTE OneToOne 1 100 0.00 255.0 ECU_ADDRESS 0xC000B0F7 /end MEASUREMENT
/begin MEASUREMENT CoVMD_trqCrCtl "Vortriebsmoment der CrCtl" SLONG TrqPrpHigh 1 100 -214748364.800 214748364.700 ECU_ADDRESS 0xD0002E10 /end MEASUREMENT
/begin MEASUREMENT CoVMD_trqCrCtl_mp "berechnetes Fahrgeschwindigkeitsregler- Moment ohne Begrenzungen" SLONG TrqPrpHigh 1 100 -214748364.800 214748364.700 ECU_ADDRESS 0xC0008E74 /end MEASUREMENT
/begin MEASUREMENT CoVMD_trqLLim "Vortriebsmoment des Longitudinalbegrenzers (LLim)" SLONG TrqPrpHigh 1 100 -214748364.800 214748364.700 ECU_ADDRESS 0xD0002E14 /end MEASUREMENT
/begin MEASUREMENT CoVMD_trqLLim_mp "berechnetes Höchstgeschwindigkeitsbegrenzer- Moment ohne Begrenzungen" SLONG TrqPrpHigh 1 100 -214748364.800 214748364.700 ECU_ADDRESS 0xC0008E78 /end MEASUREMENT
/begin MEASUREMENT CoVMD_trqPrpLimPBr "Begrenzungsmoment bei Systemfehler bei aktiver Feststellbremse" SLONG TrqPrpHigh 1 100 -214748364.800 214748364.700 ECU_ADDRESS 0xD0002E18 /end MEASUREMENT
/begin MEASUREMENT CoVM_facStWhlRL_mp "" SWORD Fact 1 100 -4.000000 3.999878 ECU_ADDRESS 0xC0009BFC /end MEASUREMENT
/begin MEASUREMENT CoVM_facStWhlRR_mp "" SWORD Fact 1 100 -4.000000 3.999878 ECU_ADDRESS 0xC0009BFE /end MEASUREMENT
/begin MEASUREMENT CoVM_stIARls "Zündwinkelfreigabe durch ESP-Eingriffe" UBYTE OneToOne 1 100 0.00 255.0 ECU_ADDRESS 0xD0001C56 /end MEASUREMENT
/begin MEASUREMENT CoVM_trqDes "Vortriebssollmoment nach Koordination mit ESP-Eingriffen (Radmoment)" SLONG TrqPrpHigh 1 100 -214748364.800 214748364.700 ECU_ADDRESS 0xD0002E1C /end MEASUREMENT
/begin MEASUREMENT CoVM_trqDesIncMax_mp "Vortriebssollmoment nach Koordination mit erhöhendem ESP-Eingriff (Radmoment)" SLONG TrqPrpHigh 1 100 -214748364.800 214748364.700 ECU_ADDRESS 0xC0008E7C /end MEASUREMENT
/begin MEASUREMENT CoVM_trqLead "Vortriebsvorhaltmoment nach Koordination mit ESP-Eingriffen (Radmoment)" SLONG TrqPrpHigh 1 100 -214748364.800 214748364.700 ECU_ADDRESS 0xD0002E20 /end MEASUREMENT
/begin MEASUREMENT CoVM_trqLeadIncMax_mp "Vortriebsvorhaltmoment nach Koordination mit Koordination mit erhöhendem ESP-Eingriff (Radmoment)" SLONG TrqPrpHigh 1 100 -214748364.800 214748364.700 ECU_ADDRESS 0xC0008E80 /end MEASUREMENT
/begin MEASUREMENT CoVM_trqLeadPOp "Vorhaltmoment zur Auswahl der BDE-Betriebsart nach Koordination mit erhöhendem ESP-Eingriff (Radmoment)" SLONG TrqPrpHigh 1 100 -214748364.800 214748364.700 ECU_ADDRESS 0xD0002E24 /end MEASUREMENT
/begin MEASUREMENT Cpu_rCurCSACons_mp "" UWORD Ratio_045_COMPU 1 100 0.00 99.99847 FORMAT "%8.5" ECU_ADDRESS 0xC0009C04 /end MEASUREMENT
/begin MEASUREMENT Cpu_rCurSysStackCons_mp "" UWORD Ratio_045_COMPU 1 100 0.00 99.99847 FORMAT "%8.5" ECU_ADDRESS 0xC0009C06 /end MEASUREMENT
/begin MEASUREMENT Cpu_rCurUsrStackCons_mp "" UWORD Ratio_045_COMPU 1 100 0.00 99.99847 FORMAT "%8.5" ECU_ADDRESS 0xC0009C08 /end MEASUREMENT
/begin MEASUREMENT Cpu_rMaxCSACons_mp "" UWORD Ratio_045_COMPU 1 100 0.00 99.99847 FORMAT "%8.5" ECU_ADDRESS 0xC0009C0A /end MEASUREMENT
/begin MEASUREMENT Cpu_rMaxSysStackCons_mp "" UWORD Ratio_045_COMPU 1 100 0.00 99.99847 FORMAT "%8.5" ECU_ADDRESS 0xC0009C0C /end MEASUREMENT
/begin MEASUREMENT Cpu_rMaxUsrStackCons_mp "" UWORD Ratio_045_COMPU 1 100 0.00 99.99847 FORMAT "%8.5" ECU_ADDRESS 0xC0009C0E /end MEASUREMENT
/begin MEASUREMENT CrCtl_aReq "Beschleunigungsanforderung des Fahrgeschwindigkeitsreglers" SWORD Acc 1 100 -32.76800 32.76700 FORMAT "%8.5" ECU_ADDRESS 0xD00008AA /end MEASUREMENT
/begin MEASUREMENT CrCtl_aReqFlt_mp "Gefilterter Rohwert der FGR-Beschleunigungsanforderung" SWORD Acc 1 100 -32.76800 32.76700 FORMAT "%8.5" ECU_ADDRESS 0xC0009C10 /end MEASUREMENT
/begin MEASUREMENT CrCtl_aReqRaw_mp "Beschleunigungsanforderung des Fahrgeschwindigkeitsreglers (Rohwert)" SWORD Acc 1 100 -32.76800 32.76700 FORMAT "%8.5" ECU_ADDRESS 0xC0009C16 /end MEASUREMENT
/begin MEASUREMENT CrCtl_aShOffRmp_mp "Erforderliche Beschleunigungsdifferenz für die Abschaltrampe" SWORD Acc 1 100 -32.76800 32.76700 FORMAT "%8.5" ECU_ADDRESS 0xC0009C12 /end MEASUREMENT
/begin MEASUREMENT CrCtl_daRmpFltNgv_mp "Negative Steigung der Komfortfilter-Rampe" SLONG RmpAcc 1 100 -32768.0000000 32767.9999847 FORMAT "%13.7" ECU_ADDRESS 0xC0008E84 /end MEASUREMENT
/begin MEASUREMENT CrCtl_daRmpFltPsv_mp "Positive Steigung der Komfortfilter-Rampe" SLONG RmpAcc 1 100 -32768.0000000 32767.9999847 FORMAT "%13.7" ECU_ADDRESS 0xC0008E88 /end MEASUREMENT
/begin MEASUREMENT CrCtl_daShOffRmpAct_mp "Steigung der Abschalt-Rampe permanent berechnet" SLONG RmpAcc 1 100 -32768.0000000 32767.9999847 FORMAT "%13.7" ECU_ADDRESS 0xC0008E8C /end MEASUREMENT
/begin MEASUREMENT CrCtl_daShOffRmp_mp "Steigung der Abschalt-Rampe" SLONG RmpAcc 1 100 -32768.0000000 32767.9999847 FORMAT "%13.7" ECU_ADDRESS 0xC0008E90 /end MEASUREMENT
/begin MEASUREMENT CrCtl_rTraV2NBgn "v/n-Verhältnis zum Zeitpunkt der letzten FGR-Aktivierung" SWORD VelToN 1 100 -0.3276800 0.3276700 FORMAT "%9.7" ECU_ADDRESS 0xD00008AC /end MEASUREMENT
/begin MEASUREMENT CrCtl_st "Zustand der Fahrgeschwindigkeitsregelung" UBYTE OneToOne 1 100 0.00 255.0 ECU_ADDRESS 0xD0001DC4 /end MEASUREMENT
/begin MEASUREMENT CrCtl_stCLCTRV "FGR-Status aufbereitet für das CAN-Signal ST_CLCTR_V" UBYTE OneToOne 1 100 0.00 255.0 ECU_ADDRESS 0xD0001DC5 /end MEASUREMENT
/begin MEASUREMENT CrCtl_stClrVelDes "Anforderung Löschen der Zielgeschwindigkeit" UBYTE OneToOne 1 100 0.00 255.0 ECU_ADDRESS 0xD0001DC6 /end MEASUREMENT
/begin MEASUREMENT CrCtl_stDspl "Anzeige-Status für FGR, CAN-Signal CTR_DISP_CCTR" UBYTE OneToOne 1 100 0.00 255.0 ECU_ADDRESS 0xD0001DC7 /end MEASUREMENT
/begin MEASUREMENT CrCtl_stFstRmp_mp "Status schnelle Komfortfilter-Rampe aktiv" UBYTE OneToOne 1 100 0.00 255.0 ECU_ADDRESS 0xC000B0F8 /end MEASUREMENT
/begin MEASUREMENT CrCtl_stImmdShOff_mp "Zwischenergebnis für Entscheidung auf unmittelbare Abschaltung" UBYTE OneToOne 1 100 0.00 255.0 ECU_ADDRESS 0xC000B0F9 /end MEASUREMENT
/begin MEASUREMENT CrCtl_stOld "Zustand der Fahrgeschwindigkeitsregelung im letzten Zyklus" UBYTE OneToOne 1 100 0.00 255.0 ECU_ADDRESS 0xD0001DC8 /end MEASUREMENT
/begin MEASUREMENT CrCtl_stPtd "Cruise Control ist aktiv oder im Stand-By" UBYTE OneToOne 1 100 0.00 255.0 ECU_ADDRESS 0xD0001DC9 /end MEASUREMENT
/begin MEASUREMENT CrCtl_stReq "Cruise Control ist aktiv" UBYTE OneToOne 1 100 0.00 255.0 ECU_ADDRESS 0xD0001DCA /end MEASUREMENT
/begin MEASUREMENT CrCtl_stShOff "Abschaltstatus für Fahrgeschwindigkeitsregler" UBYTE OneToOne 1 100 0.00 255.0 ECU_ADDRESS 0xD0001DCB /end MEASUREMENT
/begin MEASUREMENT CrCtl_stShOffConFstActv_mp "Meßpunkt Status aktuelle Abschaltbedingungen (schnell)" ULONG OneToOne 1 100 0.00 4294967295.00 ECU_ADDRESS 0xC0008E94 /end MEASUREMENT
/begin MEASUREMENT CrCtl_stShOffConIrvActv_mp "Meßpunkt Status aktuelle Abschaltbedingungen (irreversibel)" ULONG OneToOne 1 100 0.00 4294967295.00 ECU_ADDRESS 0xC0008E98 /end MEASUREMENT
/begin MEASUREMENT CrCtl_stShOffConRvActv_mp "Meßpunkt Status aktuelle Abschaltbedingungen (reversibel)" ULONG OneToOne 1 100 0.00 4294967295.00 ECU_ADDRESS 0xC0008E9C /end MEASUREMENT
/begin MEASUREMENT CrCtl_stShOffCon_mp "Statuswort für Abschaltbedingungen Fahrgeschwindigkeitsregler" ULONG OneToOne 1 100 0.00 4294967295.00 ECU_ADDRESS 0xC0008EA0 /end MEASUREMENT
/begin MEASUREMENT CrCtl_stShOffRmpEnd_mp "Status Abschaltrampen-Ende erreicht" UBYTE OneToOne 1 100 0.00 255.0 ECU_ADDRESS 0xC000B0FA /end MEASUREMENT
/begin MEASUREMENT CrCtl_stStTrans "Zustandsübergangsanforderung an den Zustandsautomaten des Fahrgeschwindigkeitsreglers" UWORD OneToOne 1 100 0.00 65535.00 ECU_ADDRESS 0xD00015A0 /end MEASUREMENT
/begin MEASUREMENT CrCtl_stTipEna_mp "Status Tips erlaubt" UBYTE OneToOne 1 100 0.00 255.0 ECU_ADDRESS 0xC000B0FB /end MEASUREMENT
/begin MEASUREMENT CrCtl_stVClsdLop "Zustand des FGR aufbereitet für das CAN-Signal ST_V_CLCTR_CCTR" UBYTE OneToOne 1 100 0.00 255.0 ECU_ADDRESS 0xD0001DCC /end MEASUREMENT
/begin MEASUREMENT CrCtl_tiShOff "Zeit für Herunterrampen der FGR-Beschleunigungsanforderung" SWORD Time_ms 1 100 -327680.0 327670.0 ECU_ADDRESS 0xD00008AE /end MEASUREMENT
/begin MEASUREMENT CrCtl_vClsdLop "FGR-Wunschgeschwindigkeit für das CAN-Signal V_CLCTR_CCTR" SWORD Vel 1 100 -327.6800 327.6700 ECU_ADDRESS 0xD00008B0 /end MEASUREMENT
/begin MEASUREMENT CrCtl_vCrCtlMax "Maximal erlaubte FGR-Betriebsgeschwindigkeit" SWORD Vel 1 100 -327.6800 327.6700 ECU_ADDRESS 0xD00008B2 /end MEASUREMENT
/begin MEASUREMENT CrCtl_vCrCtlMin "Minimal erlaubte FGR-Betriebsgeschwindigkeit" SWORD Vel 1 100 -327.6800 327.6700 ECU_ADDRESS 0xD00008B4 /end MEASUREMENT
/begin MEASUREMENT CrCtl_vDes "Wunschgeschwindigkeit der Fahrgeschwindigkeitsregelung" SWORD Vel 1 100 -327.6800 327.6700 ECU_ADDRESS 0xD00008B6 /end MEASUREMENT
/begin MEASUREMENT CrCtl_vDesMax "Maximal erlaubte FGR-Wunschgeschwindigkeit" SWORD Vel 1 100 -327.6800 327.6700 ECU_ADDRESS 0xD00008B8 /end MEASUREMENT
/begin MEASUREMENT CrCtl_vDesMin "Minimal erlaubte FGR-Wunschgeschwindigkeit" SWORD Vel 1 100 -327.6800 327.6700 ECU_ADDRESS 0xD00008BA /end MEASUREMENT
/begin MEASUREMENT CrCtl_vDesOfs_mp "Angepasste FGR-Wunschgeschwindigkeit in den Zuständen Beschleunigen/Verzögern" SWORD Vel 1 100 -327.6800 327.6700 ECU_ADDRESS 0xC0009C1E /end MEASUREMENT
/begin MEASUREMENT CrCtl_vDiff_mp "Differenz aus Wunschgeschwindigkeit und Istgeschwindigkeit" SWORD Vel 1 100 -327.6800 327.6700 ECU_ADDRESS 0xC0009C14 /end MEASUREMENT
/begin MEASUREMENT CrCtl_vTipStp "Schrittgröße für tip up/down" SWORD Vel 1 100 -327.6800 327.6700 ECU_ADDRESS 0xD00008BC /end MEASUREMENT
/begin MEASUREMENT CrCtl_vX "Ist-Geschwindigkeit für den FGR" SWORD Vel 1 100 -327.6800 327.6700 ECU_ADDRESS 0xD00008BE /end MEASUREMENT
/begin MEASUREMENT CrCtl_vXLim_mp "begrenzte Geschwindigkeit für Setzwert" SWORD Vel 1 100 -327.6800 327.6700 ECU_ADDRESS 0xC0009C20 /end MEASUREMENT
/begin MEASUREMENT CrCtl_vXOfsFlt_mp "PT1-gefilterte Differenz aus angezeiger Geschwindigkeit und Fahrzeuggeschwindigkeit" SWORD Vel 1 100 -327.6800 327.6700 ECU_ADDRESS 0xC0009C18 /end MEASUREMENT
/begin MEASUREMENT CrCtl_vXOfs_mp "Differenz aus angezeiger Geschwindigkeit und Fahrzeuggeschwindigkeit" SWORD Vel 1 100 -327.6800 327.6700 ECU_ADDRESS 0xC0009C1A /end MEASUREMENT
/begin MEASUREMENT CrCtl_vXUnFlt_mp "Ist-Geschwindigkeit für den FGR vor PT1-Filterung" SWORD Vel 1 100 -327.6800 327.6700 ECU_ADDRESS 0xC0009C1C /end MEASUREMENT
/begin MEASUREMENT CrCUI_stBtn "Zustand Bedienteil-Betätigung" UWORD OneToOne 1 100 0.00 65535.00 ECU_ADDRESS 0xD0001596 /end MEASUREMENT
/begin MEASUREMENT CrCUI_stBtnOld "Zustand Bedienteil-Betätigung im letzten Zyklus" UWORD OneToOne 1 100 0.00 65535.00 ECU_ADDRESS 0xD0001598 /end MEASUREMENT
/begin MEASUREMENT CrCUI_stDetUI "Status Betdienteil-Selbsterkennung" UBYTE OneToOne 1 100 0.00 255.0 ECU_ADDRESS 0xD000159A /end MEASUREMENT
/begin MEASUREMENT CrCUI_stErr "Status Fehler- Information" UBYTE OneToOne 1 100 0.00 255.0 ECU_ADDRESS 0xD0001DC2 /end MEASUREMENT
/begin MEASUREMENT CrCUI_stNoBtnActv "Status kein Taster betätigt" UBYTE OneToOne 1 100 0.00 255.0 ECU_ADDRESS 0xD0001DC3 /end MEASUREMENT
/begin MEASUREMENT CrC_stErr "" UWORD OneToOne 1 100 0.00 65535.00 ECU_ADDRESS 0xD000159C /end MEASUREMENT
/begin MEASUREMENT CrC_stKey "" UWORD OneToOne 1 100 0.00 65535.00 ECU_ADDRESS 0xD000159E /end MEASUREMENT
/begin MEASUREMENT CThmst_r "Sollwert für den Kühlmittelthermostatsteller" SWORD Prc 1 100 -400.0000 399.9878 ECU_ADDRESS 0xD000068A /end MEASUREMENT
/begin MEASUREMENT CThmst_rCnv_mp "Messpunkt für Ausgang der Umwandlungskennlinie (von Spannung in physikalischen Wert)" SWORD DtyCyc 1 100 -327.6800 327.6700 ECU_ADDRESS 0xC0009C22 /end MEASUREMENT
/begin MEASUREMENT CThmst_rPs "Ausgangstastverhältnis an die Endstufe" SWORD DtyCyc 1 100 -327.6800 327.6700 ECU_ADDRESS 0xD000068C /end MEASUREMENT
/begin MEASUREMENT CustDiag_stPwrDwn "" UBYTE OneToOne 1 100 0.00 255.0 ECU_ADDRESS 0xD0001DCD /end MEASUREMENT
/begin MEASUREMENT DSM_xTabVersion "DSM Versions-Identifikations-Signatur" UWORD DFC_OneToOne 1 100 0.00 65535.00 ECU_ADDRESS 0xD00055B2 /end MEASUREMENT
/begin MEASUREMENT Id_bosmg "Kennung für BOS-Meldung = Ölservice-Info" UWORD Def_dez_uw_q1 1 100 0.00 65535. FORMAT "%5.0" ECU_ADDRESS 0xC0009B9E /end MEASUREMENT
/begin MEASUREMENT Id_bosmgt "Kennung für BOS-Meldung vom Tester" UBYTE Def_dez_ub_q1 1 100 0.00 255. FORMAT "%3.0" ECU_ADDRESS 0xC000B0DE /end MEASUREMENT
/begin MEASUREMENT Id_bosmsg "Kennung für BOS-Meldung vom Kombi" UBYTE Def_dez_ub_q1 1 100 0.00 255. FORMAT "%3.0" ECU_ADDRESS 0xC000B0DF /end MEASUREMENT
/begin MEASUREMENT Id_bosrtak "Acknowledge für den Empfang der CBS-Anforderungen" UBYTE Def_dez_ub_q1 1 100 0.00 255. FORMAT "%3.0" ECU_ADDRESS 0xC000B0CA /end MEASUREMENT
/begin MEASUREMENT Oz_bsz "Betriebstundenzähler (in sek)" ULONG Def_td_ul_q1 1 100 0.00 4294967295. FORMAT "%7.0" ECU_ADDRESS 0xC0008E40 /end MEASUREMENT
/begin MEASUREMENT Oz_cttagini "Tag beim Ölwechsel" SWORD Def_dez_sw_q1 1 100 -32768. 32767. FORMAT "%5.0" ECU_ADDRESS 0xC0009B5A /end MEASUREMENT
/begin MEASUREMENT Oz_deabzug "Abzug durch Dieseleintrag" UWORD Def_km_uw_q10 1 100 0.00 655350. FORMAT "%5.0" ECU_ADDRESS 0xC0009B5C /end MEASUREMENT
/begin MEASUREMENT Oz_dkvb "Kraftstoffverbrauch innerhalb der letzten Sekunde" UWORD Def_dez_uw_q1 1 100 0.00 65535. FORMAT "%5.0" ECU_ADDRESS 0xC0009B5E /end MEASUREMENT
/begin MEASUREMENT Oz_dkvbrest "Rest bei der Aufsummierung Kraftstoffverbrauch" UWORD Def_dez_uw_q1 1 100 0.00 65535. FORMAT "%5.0" ECU_ADDRESS 0xC0009B60 /end MEASUREMENT
/begin MEASUREMENT Oz_intprog "Prognose_Intervall_Zeit_BOS_Meldung_2" UBYTE Def_dez_ub_q1 1 100 0.00 255. FORMAT "%3.0" ECU_ADDRESS 0xC000B0BC /end MEASUREMENT
/begin MEASUREMENT Oz_kmlow "Kilometerstand letzter Ölwechsel" SWORD Def_km_sw_q10 1 100 -327680. 327670. FORMAT "%6.0" ECU_ADDRESS 0xC0009B94 /end MEASUREMENT
/begin MEASUREMENT Oz_kmstalt "Referenz-Kilometerstand für die Berechnung von Oz_kvbmw" UWORD Def_km_uw_q10 1 100 0.00 655350. FORMAT "%5.0" ECU_ADDRESS 0xC0009B62 /end MEASUREMENT
/begin MEASUREMENT Oz_kmstrw0 "Kilometerstand bei Restweg = Null" UWORD Def_km_uw_q10 1 100 0.00 655350. FORMAT "%5.0" ECU_ADDRESS 0xC0009B64 /end MEASUREMENT
/begin MEASUREMENT Oz_kvbalt "Kraftstoffverbrauch um einen Abtastwert verzögert" UWORD Def_dez_uw_q1 1 100 0.00 65535. FORMAT "%5.0" ECU_ADDRESS 0xC0009B66 /end MEASUREMENT
/begin MEASUREMENT Oz_kvbdiff "Delta Kraftstoffverbrauch der letzten 10 km" ULONG Def_fuel_ul_q0p000122 1 100 0.00 100.0000000 FORMAT "%11.7" ECU_ADDRESS 0xC0008E44 /end MEASUREMENT
/begin MEASUREMENT Oz_kvbmw "Mittelwert Kraftstoffverbrauch" ULONG Def_fuel_ul_q0p000122 1 100 0.00 100.0000000 FORMAT "%11.7" ECU_ADDRESS 0xC0008E48 /end MEASUREMENT
/begin MEASUREMENT Oz_kvbmwtmp "Mittelwert Kraftstoffverbrauch auf 16bit reduziert" UWORD Def_f_uw_b64 1 100 0.00 63.999023 ECU_ADDRESS 0xC0009B68 /end MEASUREMENT
/begin MEASUREMENT Oz_kvbmx "Gesammte Kraftstoffmenge + Bonus" UWORD Def_dez_uw_q1 1 100 0.00 65535. FORMAT "%5.0" ECU_ADDRESS 0xC0009B6A /end MEASUREMENT
/begin MEASUREMENT Oz_kvbog "zugeteilte Bonuskraftstoffmenge" UWORD Def_dez_uw_q1 1 100 0.00 65535. FORMAT "%5.0" ECU_ADDRESS 0xC0009B6C /end MEASUREMENT
/begin MEASUREMENT Oz_kvbsm "Verbrauchte Kraftstoffmenge" ULONG Def_fuel_ul_q0p000122 1 100 0.00 10000.00000 FORMAT "%11.5" ECU_ADDRESS 0xC0008E4C /end MEASUREMENT
/begin MEASUREMENT Oz_kvbsmalt "Referenz-verbrauchter Kraftstoff für dei Berechnung von Oz_kvbmw" ULONG Def_fuel_ul_q0p000122 1 100 0.00 10000.00000 FORMAT "%11.5" ECU_ADDRESS 0xC0008E50 /end MEASUREMENT
/begin MEASUREMENT Oz_kvbsm_ul "Aufsummierte Kraftstoffmenge" ULONG Def_fuel_ul_q0p000122 1 100 0.00 255000.0000 FORMAT "%11.4" ECU_ADDRESS 0xC0008E54 /end MEASUREMENT
/begin MEASUREMENT Oz_kvbtmp2 "Tmp für die CBS RW-Berechnung" UWORD Def_km_uw_q10 1 100 0.00 655350. FORMAT "%5.0" ECU_ADDRESS 0xC0009B6E /end MEASUREMENT
/begin MEASUREMENT Oz_lf1t "Länderfaktor 1" UBYTE Def_lf_ub_q0p01 1 100 0.00 2.550 FORMAT "%5.3" ECU_ADDRESS 0xC000B0BD /end MEASUREMENT
/begin MEASUREMENT Oz_lf2t "Länderfaktor 2" UBYTE Def_lf_ub_q0p01 1 100 0.00 2.550 FORMAT "%5.3" ECU_ADDRESS 0xC000B0BE /end MEASUREMENT
/begin MEASUREMENT Oz_litges "Gesamtverbrauch für Ölwechsel" UWORD Def_dez_uw_q1 1 100 0.00 65535. FORMAT "%5.0" ECU_ADDRESS 0xC0009B70 /end MEASUREMENT
/begin MEASUREMENT Oz_manip "Öl-CBS manipuliert" UBYTE Def_dez_ub_q1 1 100 0.00 255. FORMAT "%3.0" ECU_ADDRESS 0xC000B0E0 /end MEASUREMENT
/begin MEASUREMENT Oz_manipt "Manipulation" UBYTE Def_dez_ub_q1 1 100 0.00 255. FORMAT "%3.0" ECU_ADDRESS 0xC000B0CB /end MEASUREMENT
/begin MEASUREMENT Oz_nivlanglit "LangMw in Liter" UBYTE Def_niv_ub_q0p1 1 100 0.00 25.50 FORMAT "%5.2" ECU_ADDRESS 0xC000B0BF /end MEASUREMENT
/begin MEASUREMENT Oz_nivlangt "Langmittelwert für den Tester" UBYTE Def_niv_ub_b75 1 100 0.00 74.71 ECU_ADDRESS 0xC000B0C0 /end MEASUREMENT
/begin MEASUREMENT Oz_nivnfm "Nachfüllmenge" UBYTE Def_niv_ub_b8 1 100 0.00 7.969 ECU_ADDRESS 0xC000B0C1 /end MEASUREMENT
/begin MEASUREMENT Oz_oelkm "Ölkilometer" UWORD Def_km_uw_q10 1 100 0.00 655350. FORMAT "%5.0" ECU_ADDRESS 0xC0009B96 /end MEASUREMENT
/begin MEASUREMENT Oz_oelzeit "Öl-Alter in Monate" UWORD Def_dez_uw_q1 1 100 0.00 65535. FORMAT "%5.0" ECU_ADDRESS 0xC0009B72 /end MEASUREMENT
/begin MEASUREMENT Oz_oelzeitt "Öl-Alter in Tage" UWORD Def_dez_uw_q1 1 100 0.00 1000. FORMAT "%5.0" ECU_ADDRESS 0xC0009B74 /end MEASUREMENT
/begin MEASUREMENT Oz_reset "Zieltermin_Monat_BOS_Rückstellung_2" UBYTE Def_dez_ub_q1 1 100 0.00 255. FORMAT "%3.0" ECU_ADDRESS 0xC000B0E1 /end MEASUREMENT
/begin MEASUREMENT Oz_russkalt "Russ kalt" UWORD Def_russ_uw_q0p01 1 100 0.00 655.3500 FORMAT "%8.4" ECU_ADDRESS 0xC0009B76 /end MEASUREMENT
/begin MEASUREMENT Oz_russsum "Russsumme im Öl" ULONG Def_dez_ul_q1 1 100 0.00 9000000. FORMAT "%7.0" ECU_ADDRESS 0xC0008E58 /end MEASUREMENT
/begin MEASUREMENT Oz_russwarm "Russ warm" UWORD Def_russ_uw_q0p01 1 100 0.00 655.3500 FORMAT "%8.4" ECU_ADDRESS 0xC0009B78 /end MEASUREMENT
/begin MEASUREMENT Oz_rwanz "anzuzeigender Restweg" SWORD Def_km_sw_q10 1 100 -327680. 327670. FORMAT "%6.0" ECU_ADDRESS 0xC0009B7A /end MEASUREMENT
/begin MEASUREMENT Oz_rwbsz "Restweg aus der Betriebstundenberechnung" SWORD Def_km_sw_q10 1 100 -327680. 327670. FORMAT "%6.0" ECU_ADDRESS 0xC0009B7C /end MEASUREMENT
/begin MEASUREMENT Oz_rwde "Restweg laut Dieseleintrag" SWORD Def_km_sw_q10 1 100 -327680. 327670. FORMAT "%6.0" ECU_ADDRESS 0xC0009B7E /end MEASUREMENT
/begin MEASUREMENT Oz_rwkvb "Restweg aus dem Kraftstoffverbrauch" SWORD Def_km_sw_q10 1 100 -327680. 327670. FORMAT "%6.0" ECU_ADDRESS 0xC0009B80 /end MEASUREMENT
/begin MEASUREMENT Oz_rwout "Restweg Ausgabe CBS-Öl" SWORD Def_km_sw_q10 1 100 -327680. 327670. FORMAT "%6.0" ECU_ADDRESS 0xC0009BA0 /end MEASUREMENT
/begin MEASUREMENT Oz_rwp "Zwischengröße Restwegberechnung" SWORD Def_km_sw_q10 1 100 -327680. 327670. FORMAT "%6.0" ECU_ADDRESS 0xC0009B82 /end MEASUREMENT
/begin MEASUREMENT Oz_rwpeil "Resweg im Sensorfehlerfall" SWORD Def_km_sw_q10 1 100 -327680. 327670. FORMAT "%6.0" ECU_ADDRESS 0xC0009BA2 /end MEASUREMENT
/begin MEASUREMENT Oz_rwprog "Prognose_Intervall_Weg_BOS_Meldung_2" UWORD Def_km_uw_q10 1 100 0.00 655350. FORMAT "%5.0" ECU_ADDRESS 0xC0009B84 /end MEASUREMENT
/begin MEASUREMENT Oz_rwprout "RW-Prognose ausgebe CBS-Öl" UBYTE Def_km_ub_q1000 1 100 0.00 255000. FORMAT "%3.0" ECU_ADDRESS 0xC000B0E2 /end MEASUREMENT
/begin MEASUREMENT Oz_rwprueck "Neue CBS Prognose zu übernehmen" UBYTE Def_km_ub_q1000 1 100 0.00 255000. FORMAT "%3.0" ECU_ADDRESS 0xC000B0CC /end MEASUREMENT
/begin MEASUREMENT Oz_rwrueck "Neuer CBS Restweg zu übernehmen" SWORD Def_km_sw_q10 1 100 -327680. 327670. FORMAT "%6.0" ECU_ADDRESS 0xC0009B98 /end MEASUREMENT
/begin MEASUREMENT Oz_rwruss "Restweg aus der Russberechnung" SWORD Def_km_sw_q10 1 100 -327680. 327670. FORMAT "%6.0" ECU_ADDRESS 0xC0009B86 /end MEASUREMENT
/begin MEASUREMENT Oz_rwzeit "Restweg laut Zeitverlauf" SWORD Def_km_sw_q10 1 100 -327680. 327670. FORMAT "%6.0" ECU_ADDRESS 0xC0009B88 /end MEASUREMENT
/begin MEASUREMENT Oz_servcnt "Anzuzeigender Zähler für durchgeführten Ölservice" UBYTE Def_dez_ub_q1 1 100 0.00 255. FORMAT "%3.0" ECU_ADDRESS 0xC000B0E3 /end MEASUREMENT
/begin MEASUREMENT Oz_svcntchg "geänderter Servicezähler" UBYTE Def_dez_ub_q1 1 100 0.00 255. FORMAT "%3.0" ECU_ADDRESS 0xC000B0CD /end MEASUREMENT
/begin MEASUREMENT Oz_vfanz "anzuzeigende Verfügbarkeit" UBYTE Def_lf_ub_q0p01 1 100 0.00 2.550 FORMAT "%5.3" ECU_ADDRESS 0xC000B0C2 /end MEASUREMENT
/begin MEASUREMENT Oz_vfbdmew "Verfügbarkeit aus Kombi bei DME-Wechsel" SBYTE Def_dez_sb_q1 1 100 -128. 127. FORMAT "%3.0" ECU_ADDRESS 0xC000B0CE /end MEASUREMENT
/begin MEASUREMENT Oz_vfbsz "Verfügbarkeit aus der Betriebstundenzählerberechnung" UBYTE Def_lf_ub_q0p01 1 100 0.00 2.550 FORMAT "%5.3" ECU_ADDRESS 0xC000B0C3 /end MEASUREMENT
/begin MEASUREMENT Oz_vfkvb "Verfügbarkeit aus Kraftstoffverbrauch" UBYTE Def_lf_ub_q0p01 1 100 0.00 2.550 FORMAT "%5.3" ECU_ADDRESS 0xC000B0C4 /end MEASUREMENT
/begin MEASUREMENT Oz_vfout "Verfügbarkeit CBS-Öl" UBYTE Def_dez_ub_q1 1 100 0.00 255. FORMAT "%3.0" ECU_ADDRESS 0xC000B0E4 /end MEASUREMENT
/begin MEASUREMENT Oz_vfruss "Verfügbarkeit aus der Russberechnung" UBYTE Def_lf_ub_q0p01 1 100 0.00 2.550 FORMAT "%5.3" ECU_ADDRESS 0xC000B0C5 /end MEASUREMENT
/begin MEASUREMENT Oz_vfzeit "Verfügbarkeit aus Zeit" UBYTE Def_lf_ub_q0p01 1 100 0.00 2.550 FORMAT "%5.3" ECU_ADDRESS 0xC000B0C6 /end MEASUREMENT
/begin MEASUREMENT Oz_zieljahr "Jahr für den nächsten Ölwechsel" UBYTE Def_dez_ub_q1 1 100 0.00 255. FORMAT "%3.0" ECU_ADDRESS 0xC000B0C7 /end MEASUREMENT
/begin MEASUREMENT Oz_zielmon "Monat für den nächsten Ölwechsel" UBYTE Def_dez_ub_q1 1 100 0.00 255. FORMAT "%3.0" ECU_ADDRESS 0xC000B0C8 /end MEASUREMENT
/begin MEASUREMENT Oz_zjahrout "Zieltermin Jahr CBS-Öl" UBYTE Def_dez_ub_q1 1 100 0.00 255. FORMAT "%3.0" ECU_ADDRESS 0xC000B0E5 /end MEASUREMENT
/begin MEASUREMENT Oz_zjbdmew "Neues Ziel-Jahr zu übernehmen" UBYTE Def_dez_ub_q1 1 100 0.00 255. FORMAT "%3.0" ECU_ADDRESS 0xC000B0CF /end MEASUREMENT
/begin MEASUREMENT Oz_zmbdmew "Neuer Ziel-Monat zu übernehmen" UBYTE Def_dez_ub_q1 1 100 0.00 255. FORMAT "%3.0" ECU_ADDRESS 0xC000B0D0 /end MEASUREMENT
/begin MEASUREMENT Oz_zmonout "Zieltermin Jahr CBS-Öl" UBYTE Def_dez_ub_q1 1 100 0.00 255. FORMAT "%3.0" ECU_ADDRESS 0xC000B0E6 /end MEASUREMENT
/begin MEASUREMENT PT_stConvGrip "Kraftschlußzustand Kupplung" UBYTE OneToOne 1 100 0.00 255.0 ECU_ADDRESS 0xD0002053 /end MEASUREMENT
/begin MEASUREMENT PT_stIARls "Zündwinkelfreigabe durch Getriebeeingriffe incl. Getriebeschutz" UBYTE OneToOne 1 100 0.00 255.0 ECU_ADDRESS 0xD0002055 /end MEASUREMENT
/begin MEASUREMENT PT_stTraIntv "Status Momentendurchgriff Getriebeeingriffe" UBYTE OneToOne 1 100 0.00 255.0 ECU_ADDRESS 0xD0002058 /end MEASUREMENT
/begin MEASUREMENT SCRCtl_stMetMod "" UBYTE OneToOne 1 100 0.00 255.0 ECU_ADDRESS 0xD0002096 /end MEASUREMENT
/begin MEASUREMENT SSEUI_stStopStrtSwt "" UBYTE OneToOne 1 100 0.00 255.0 ECU_ADDRESS 0xD00020AA /end MEASUREMENT
/begin MEASUREMENT St_cbsozin0 "Statuswort" UBYTE Def_st_ub_q1 1 100 0.00 255. FORMAT "%3.0" ECU_ADDRESS 0xC000B0D1 /end MEASUREMENT
/begin MEASUREMENT St_cbsozin1 "Statuswort" UBYTE Def_st_ub_q1 1 100 0.00 255. FORMAT "%3.0" ECU_ADDRESS 0xC000B0D2 /end MEASUREMENT
/begin MEASUREMENT St_cbsozin_nv0 "Statuswort" UBYTE Def_st_ub_q1 1 100 0.00 255. FORMAT "%3.0" ECU_ADDRESS 0xC000B0D3 /end MEASUREMENT
/begin MEASUREMENT St_cbsozout0 "Statuswort" UBYTE Def_st_ub_q1 1 100 0.00 255. FORMAT "%3.0" ECU_ADDRESS 0xC000B0E7 /end MEASUREMENT
/begin MEASUREMENT St_cbsozout_nv0 "Statuswort" UBYTE Def_st_ub_q1 1 100 0.00 255. FORMAT "%3.0" ECU_ADDRESS 0xC000B0E8 /end MEASUREMENT
/begin MEASUREMENT St_cbsoz_nv0 "Statuswort" UBYTE Def_st_ub_q1 1 100 0.00 255. FORMAT "%3.0" ECU_ADDRESS 0xC000B0C9 /end MEASUREMENT
/begin MEASUREMENT Toel_oz "ozbg.dat" SWORD Def_t_sw_q0p1 1 100 -3276.8 3276.7 FORMAT "%6.1" ECU_ADDRESS 0xC0009B8A /end MEASUREMENT
/begin MEASUREMENT TS_nMax "" SWORD EngN 1 100 -16384.00 16383.50 ECU_ADDRESS 0xD00013DA /end MEASUREMENT
/begin MEASUREMENT TS_nMin "" SWORD EngN 1 100 -16384.00 16383.50 ECU_ADDRESS 0xD00013DC /end MEASUREMENT
/begin MEASUREMENT TS_trqDesAcs "" SWORD Trq 1 100 -3276.800 3276.700 ECU_ADDRESS 0xD00013E4 /end MEASUREMENT
/begin MEASUREMENT TS_trqResvAcs "" SWORD Trq 1 100 -3276.800 3276.700 ECU_ADDRESS 0xD00013E6 /end MEASUREMENT
/begin MEASUREMENT VehMot_facCompAcs "Koordinierter Faktor der Nebenaggregatekompensation" SWORD Fact 1 100 -4.000000 3.999878 ECU_ADDRESS 0xD00014BA /end MEASUREMENT
/begin MEASUREMENT VehMot_nMax "Maximaldrehzahlanforderung von VehMot" SWORD EngN 1 100 -16384.00 16383.50 ECU_ADDRESS 0xD00014BE /end MEASUREMENT
/begin MEASUREMENT VehMot_nMaxAcs "Maximaldrehzahlanforderung der Nebenaggregate innerhalb VehMot" SWORD EngN 1 100 -16384.00 16383.50 ECU_ADDRESS 0xD00014C0 /end MEASUREMENT
/begin MEASUREMENT VehMot_nMin "Minimaldrehzahlanforderung von VehMot" SWORD EngN 1 100 -16384.00 16383.50 ECU_ADDRESS 0xD00014C2 /end MEASUREMENT
/begin MEASUREMENT VehMot_nMinAcs "Minimaldrehzahlanforderung der Nebenaggregate innerhalb VehMot" SWORD EngN 1 100 -16384.00 16383.50 ECU_ADDRESS 0xD00014C4 /end MEASUREMENT
/begin MEASUREMENT VehMot_rvActSlip_mp "" SWORD Fact100 1 100 -327.6800 327.6700 FORMAT "%8.4" ECU_ADDRESS 0xC0009C00 /end MEASUREMENT
/begin MEASUREMENT VehMot_stCtOffPhd "Status Schubabschalteverbot durch Fahrerassistenzfunktionen" UBYTE OneToOne 1 100 0.00 255.0 ECU_ADDRESS 0xD00025B6 /end MEASUREMENT
/begin MEASUREMENT VehMot_stIARls "Zündwinkelfreigabe von Fahrzeugbewegungsanforderungen." UBYTE OneToOne 1 100 0.00 255.0 ECU_ADDRESS 0xD00025B7 /end MEASUREMENT
/begin MEASUREMENT VehMot_stNSetP "Statuswort das Umsetzung der Drehzahlanforderungen von VehMot definiert" UBYTE OneToOne 1 100 0.00 255.0 ECU_ADDRESS 0xD00025B9 /end MEASUREMENT
/begin MEASUREMENT VehMot_stPrpCrCtl "Status CrCtl-Anforderung übersteigt Fahrerwunsch" UBYTE OneToOne 1 100 0.00 255.0 ECU_ADDRESS 0xD00025BB /end MEASUREMENT
/begin MEASUREMENT VehMot_stPrpLLim "Status Longitudinalbegrenzer (LLim) beeinflusst Vortriebsmoment" UBYTE OneToOne 1 100 0.00 255.0 ECU_ADDRESS 0xD00025BC /end MEASUREMENT
/begin MEASUREMENT VehMot_stSlip "" UBYTE OneToOne 1 100 0.00 255.0 ECU_ADDRESS 0xD00025BD /end MEASUREMENT
/begin MEASUREMENT VehMot_stStabIntv "Status Momentendurchgriff ESP-Eingriffe" UBYTE OneToOne 1 100 0.00 255.0 ECU_ADDRESS 0xD00025BE /end MEASUREMENT
/begin MEASUREMENT VehMot_trqDesAcs "Benötigtes Moment der Nebenaggregate innerhalb Vehicle Motion" SWORD Trq 1 100 -3276.800 3276.700 ECU_ADDRESS 0xD00014CA /end MEASUREMENT
/begin MEASUREMENT VehMot_trqResvAcs "Gewünschre Momentenreserve der Nebenaggregate innerhalb Vehicle Motion" SWORD Trq 1 100 -3276.800 3276.700 ECU_ADDRESS 0xD00014CC /end MEASUREMENT
/begin MEASUREMENT VehMot_vDvtWheel_mp "" SWORD Vel 1 100 -327.6800 327.6700 ECU_ADDRESS 0xC0009C02 /end MEASUREMENT
/begin MEASUREMENT VMD_nMax "Maximal erlaubte Drehzahl nach Koordination mit Fahrerassistenzfunktionen" SWORD EngN 1 100 -16384.00 16383.50 ECU_ADDRESS 0xD0001478 /end MEASUREMENT
/begin MEASUREMENT VMD_nMin "Minimal erlaubte Drehzahl nach Koordination mit Fahrerassistenzfunktionen" SWORD EngN 1 100 -16384.00 16383.50 ECU_ADDRESS 0xD000147A /end MEASUREMENT
/begin MEASUREMENT VMD_stNSetP "Status Drehzahlbegrenzung nach Koordination mit Fahrerassistenzfunktionen" UBYTE OneToOne 1 100 0.00 255.0 ECU_ADDRESS 0xD00025AB /end MEASUREMENT
/begin MEASUREMENT VMD_trqDes "Vortriebsmoment nach Koordination mit Fahrerassistenzfunktionen" SLONG TrqPrpHigh 1 100 -214748364.800 214748364.700 ECU_ADDRESS 0xD0003048 /end MEASUREMENT
/begin MEASUREMENT VMD_trqLead "Vortriebsvorhaltemoment nach Koordination mit" SLONG TrqPrpHigh 1 100 -214748364.800 214748364.700 ECU_ADDRESS 0xD000304C /end MEASUREMENT
/begin MEASUREMENT VMD_trqLeadPOp "Vortriebsvorhaltemoment, erhöhend, für GDI-Betriebsmodus" SLONG TrqPrpHigh 1 100 -214748364.800 214748364.700 ECU_ADDRESS 0xD0003050 /end MEASUREMENT
/begin MEASUREMENT X_KL_OZVERDFAK_no_input_quantity "This variable is artificially generated, since DAMOS does not (yet) support 'NO_INPUT_QUANTITY' references at PaVaSt files. It is exclusively referenced by the X axis of calibration parameter 'KL_OZVERDFAK'." UWORD Def_f_uw_b1 1 100 0.00 0.9998931884766 FORMAT "%15.13" ECU_ADDRESS 0xC0009B8C /end MEASUREMENT
/begin MEASUREMENT Y_KF_NKW_TN_no_input_quantity "This variable is artificially generated, since DAMOS does not (yet) support 'NO_INPUT_QUANTITY' references at PaVaSt files. It is exclusively referenced by the Y axis of calibration parameter 'KF_NKW_TN'." UWORD Def_td_uw_q0p01 1 100 0.00 655.350 FORMAT "%7.3" ECU_ADDRESS 0xC0009B8E /end MEASUREMENT
/begin MEASUREMENT Y_KF_RUSS_KALT_no_input_quantity "This variable is artificially generated, since DAMOS does not (yet) support 'NO_INPUT_QUANTITY' references at PaVaSt files. It is exclusively referenced by the Y axis of calibration parameter 'KF_RUSS_KALT'." SWORD Def_m_sw_q0p1 1 100 -3276.80 3276.70 FORMAT "%7.2" ECU_ADDRESS 0xC0009B90 /end MEASUREMENT
/begin MEASUREMENT Y_KF_RUSS_WARM_no_input_quantity "This variable is artificially generated, since DAMOS does not (yet) support 'NO_INPUT_QUANTITY' references at PaVaSt files. It is exclusively referenced by the Y axis of calibration parameter 'KF_RUSS_WARM'." SWORD Def_m_sw_q0p1 1 100 -3276.80 3276.70 FORMAT "%7.2" ECU_ADDRESS 0xC0009B92 /end MEASUREMENT
/begin MEASUREMENT Zrbosmld "anzuzeigender Zähler für durchgeführten Ölservice" UBYTE Def_dez_ub_q1 1 100 0.00 255. FORMAT "%3.0" ECU_ADDRESS 0xC000B0E9 /end MEASUREMENT
/begin FUNCTION cbsoz ""
 /begin DEF_CHARACTERISTIC KF_NKW_TN KF_RUSS_KALT KF_RUSS_WARM KL_KMST_FAK KL_OZBEFKL KL_OZTKKVB KL_OZVERDFAK KL_TEMP_FAK KL_WKRM_FAK K_CW_CBSOZ K_OELREST K_OZANFANZ K_OZDAEMPF K_OZKMMAXK11 K_OZKVB96 K_OZKVB96A K_OZKVBMXK18 K_OZKVBOK16 K_OZLF1 K_OZLF2 K_OZMAXBS K_OZMNKMBO K_OZMXOHK15 K_OZOELMEN K_OZRUSSMX K_OZTAGCTERR K_OZUEBERTEMP K_OZUTFAK K_OZZEITFAKT K_OZZEITINT /end DEF_CHARACTERISTIC
 /begin IN_MEASUREMENT Dzw_mkr Km_st Nkw Tmot /end IN_MEASUREMENT
 /begin OUT_MEASUREMENT Oz_bsz Oz_cttagini Oz_deabzug Oz_dkvb Oz_dkvbrest Oz_intprog Oz_kmstalt Oz_kmstrw0 Oz_kvbalt Oz_kvbdiff Oz_kvbmw Oz_kvbmwtmp Oz_kvbmx Oz_kvbog Oz_kvbsm Oz_kvbsmalt Oz_kvbsm_ul Oz_kvbtmp2 Oz_lf1t Oz_lf2t Oz_litges Oz_nivlanglit Oz_nivlangt Oz_nivnfm Oz_oelzeit Oz_oelzeitt Oz_russkalt Oz_russsum Oz_russwarm Oz_rwanz Oz_rwbsz Oz_rwde Oz_rwkvb Oz_rwp Oz_rwprog Oz_rwruss Oz_rwzeit Oz_vfanz Oz_vfbsz Oz_vfkvb Oz_vfruss Oz_vfzeit Oz_zieljahr Oz_zielmon St_cbsoz_nv0 Toel_oz X_KL_OZVERDFAK_no_input_quantity Y_KF_NKW_TN_no_input_quantity Y_KF_RUSS_KALT_no_input_quantity Y_KF_RUSS_WARM_no_input_quantity /end OUT_MEASUREMENT
/end FUNCTION
/begin FUNCTION cbsozin "" /begin DEF_CHARACTERISTIC K_OZBZKMSTK1 K_OZKMUPL /end DEF_CHARACTERISTIC
 /begin OUT_MEASUREMENT Id_bosrtak Oz_kmlow Oz_manipt Oz_oelkm Oz_rwprueck Oz_rwrueck Oz_svcntchg Oz_vfbdmew Oz_zjbdmew Oz_zmbdmew St_cbsozin0 St_cbsozin1 St_cbsozin_nv0 /end OUT_MEASUREMENT
/end FUNCTION
/begin FUNCTION cbsozout "" /begin DEF_CHARACTERISTIC K_CW_CBS K_OZZYKCBS /end DEF_CHARACTERISTIC
 /begin OUT_MEASUREMENT Bosbtvfbk Bosconf Bosfxid2 Bosid2 Bosjziel Bosmanip Bosmziel Bosprog2 Bosres Bosrlsm Bosrw2 Bosstate Bostoken Id_bosmg Id_bosmgt Id_bosmsg Oz_manip Oz_reset Oz_rwout Oz_rwpeil Oz_rwprout Oz_servcnt Oz_vfout Oz_zjahrout Oz_zmonout St_cbsozout0 St_cbsozout_nv0 Zrbosmld /end OUT_MEASUREMENT
/end FUNCTION
/begin FUNCTION CBTarget "" /end FUNCTION
/begin FUNCTION CBTProt "" /end FUNCTION
/begin FUNCTION CBUAcc "" /end FUNCTION
/begin FUNCTION CBUtil "" /end FUNCTION
/begin FUNCTION CBVW "" /end FUNCTION
/begin FUNCTION CByVlv_DD ""
 /begin DEF_CHARACTERISTIC CByVlv_DigOut.tiBtwTstSCB_C CByVlv_DigOut.tiBtwTstOT_C CByVlv_DigOut.numTstMax_C CByVlv_stPsDiaDisbl_C CByVlv_stPsDisbl_C /end DEF_CHARACTERISTIC
 /begin IN_MEASUREMENT DevLib_stPwrStgEnaCond /end IN_MEASUREMENT
 /begin OUT_MEASUREMENT CByVlv_st CByVlv_stPs /end OUT_MEASUREMENT
/end FUNCTION
/begin FUNCTION CcpAppl_Std "" /end FUNCTION
/begin FUNCTION CcpNC "" /end FUNCTION
/begin FUNCTION ccp_auto "" /end FUNCTION
/begin FUNCTION Ccp_Std "" /end FUNCTION
/begin FUNCTION CEngDsT_DD ""
 /begin DEF_CHARACTERISTIC CEngDsT_SRC.uMin_C CEngDsT_SRC.uMax_C CEngDsT_swtSensPres_C CEngDsT_tTransf_CUR /end DEF_CHARACTERISTIC
 /begin OUT_MEASUREMENT CEngDsT_stErrIni CEngDsT_tSens CEngDsT_uRaw /end OUT_MEASUREMENT
/end FUNCTION
/begin FUNCTION CEngDsT_VD ""
 /begin DEF_CHARACTERISTIC CEngDsT_Rmp1.Pos_C CEngDsT_Rmp1.Neg_C CEngDsT_Rmp2.Pos_C CEngDsT_Rmp2.Neg_C CEngDsT_stSensID_C CEngDsT_tDflCold_C CEngDsT_tDflWarm_C CEngDsT_tiPT1T1_C /end DEF_CHARACTERISTIC
 /begin IN_MEASUREMENT CoEng_st /end IN_MEASUREMENT
 /begin OUT_MEASUREMENT CEngDsT_dt CEngDsT_t /end OUT_MEASUREMENT
 /begin LOC_MEASUREMENT CEngDsT_t_mp /end LOC_MEASUREMENT
/end FUNCTION
/begin FUNCTION CEngDsT_VDDynTst ""
 /begin DEF_CHARACTERISTIC CEngDsT_dtMinDynTst_C CEngDsT_nMinEnaDynTst_C CEngDsT_qMinEnaDynTst_C CEngDsT_tiMaxDynTst_CUR CEngDsT_tMinDynTst_C /end DEF_CHARACTERISTIC
 /begin IN_MEASUREMENT Epm_nEng InjCtl_qSetUnBal /end IN_MEASUREMENT
 /begin OUT_MEASUREMENT CEngDsT_dtDynTst_mp CEngDsT_tEndDynTst_mp CEngDsT_tiDynTst_mp CEngDsT_tiMaxDynTst CEngDsT_tStrt /end OUT_MEASUREMENT
/end FUNCTION
/begin FUNCTION cengdst_vd_inl ""
 /begin DEF_CHARACTERISTIC CEngDsT_dtFlTempDwn_C CEngDsT_dtFlTempUp_C CEngDsT_swtPHtrIgnoreCAN_C CEngDsT_tClntMin_C CEngDsT_tDiffThres_C CEngDsT_tFlSysMin_C CEngDsT_tiWait_C /end DEF_CHARACTERISTIC
 /begin IN_MEASUREMENT CoEng_st Com_stPHtr FuelT_tFlSys T15_st /end IN_MEASUREMENT
 /begin LOC_MEASUREMENT CEngDsT_stPHtr_mp CEngDsT_tDiff_mp CEngDsT_tTmp_mp /end LOC_MEASUREMENT
/end FUNCTION
/begin FUNCTION Cj125 "" /end FUNCTION
/begin FUNCTION Cj230 "" /end FUNCTION
/begin FUNCTION Cj945 "" /end FUNCTION
/begin FUNCTION Clth_DD ""
 /begin DEF_CHARACTERISTIC Clth_Deb.tiHiLo_C Clth_Deb.tiLoHi_C Clth_stOpn_C Clth_stSlipClsd_C Clth_stSlipOpn_C Clth_stSlip_C Clth_swtSig_C /end DEF_CHARACTERISTIC
/end FUNCTION
/begin FUNCTION Clth_VD ""
 /begin DEF_CHARACTERISTIC Clth_nNoGearShftDet_C Clth_stDflVal_C Clth_tiGearShft_C Clth_vNoGearShftDet_C /end DEF_CHARACTERISTIC
 /begin IN_MEASUREMENT Com_stClth Epm_nEng SyC_stSub Tra_numGear VehV_v /end IN_MEASUREMENT
 /begin OUT_MEASUREMENT Clth_st /end OUT_MEASUREMENT
 /begin LOC_MEASUREMENT Clth_stIntDebVal Clth_stLastGear Clth_stOldGear Clth_stOpnMark Clth_stRaw /end LOC_MEASUREMENT
/end FUNCTION
/begin FUNCTION CmbChb_Misfire ""
 /begin DEF_CHARACTERISTIC CmbChb_ctEngRevPerBlk_C CmbChb_ctMisfMax_C CmbChb_ctSegTDC1_C CmbChb_numBlk_C CmbChb_phiSegLngth_CA CmbChb_phiSegPosOfs_CA CmbChb_rSpdIncrMin_C /end DEF_CHARACTERISTIC
 /begin IN_MEASUREMENT CmbChb_st EpmCrS_numSeg EpmSyn_phiInt Epm_nEngCurr Epm_numCyl /end IN_MEASUREMENT
 /begin OUT_MEASUREMENT CmbChb_nMisf CmbChb_stDelMisf /end OUT_MEASUREMENT
 /begin LOC_MEASUREMENT CmbChb_ctEngRevLogBuf1_mp CmbChb_ctEngRevLogBuf2_mp CmbChb_ctEngRevLogMem_mp CmbChb_ctEngRevPerBlk_mp CmbChb_ctMifBuf1_mp CmbChb_ctMifBuf2_mp CmbChb_ctMifMem_mp CmbChb_nSegEven_mp CmbChb_nSegOdd_mp CmbChb_nSpdIncrCurr_mp CmbChb_nSpdIncrMin_mp /end LOC_MEASUREMENT
/end FUNCTION
/begin FUNCTION CmbChb_MisfireEn ""
 /begin DEF_CHARACTERISTIC CmbChb_ctMisfTempSel_C CmbChb_nEngThresHi_C CmbChb_nEngThresLo_C CmbChb_qSetThresHi_C CmbChb_qSetThresLo_C CmbChb_stClth_C CmbChb_tEngThresLo_C CmbChb_tiDebClthChng_C CmbChb_tiDelStrt_C CmbChb_vThresHi_C /end DEF_CHARACTERISTIC
 /begin IN_MEASUREMENT Clth_st CoEng_st CoEng_tiNormal EngDa_tFld Epm_nEng InjCtl_qSetUnBal VehV_v /end IN_MEASUREMENT
 /begin OUT_MEASUREMENT CmbChb_st /end OUT_MEASUREMENT
/end FUNCTION
/begin FUNCTION CmbCWT_VD "" /begin DEF_CHARACTERISTIC CmbCWT_TransStg.Dfl_C CmbCWT_TransStg.stSensId_C /end DEF_CHARACTERISTIC /begin OUT_MEASUREMENT CmbCWT_t /end OUT_MEASUREMENT /end FUNCTION
/begin FUNCTION CnvLead_Trq2Q "" /begin DEF_CHARACTERISTIC CnvLead_facRmpVal_CUR /end DEF_CHARACTERISTIC
 /begin IN_MEASUREMENT CnvSet_etaCurr CnvSet_etaCurrNxt CoEng_stShutOffPath CoEOM_facRmpVal PthLead_trqInrCurr PthLead_trqInrLead /end IN_MEASUREMENT
 /begin OUT_MEASUREMENT CnvLead_facRmpVal CnvLead_qCurr CnvLead_qCurrNxt CnvLead_qCurrPrs CnvLead_qRaw CnvLead_qRawNxt CnvLead_qRawPrs /end OUT_MEASUREMENT
/end FUNCTION
/begin FUNCTION CnvSet_Trq2q "" /begin DEF_CHARACTERISTIC CnvSet_eta0_C CnvSet_etaIni_C CnvSet_facRmpVal_CUR /end DEF_CHARACTERISTIC
 /begin IN_MEASUREMENT CoEng_stShutOffPath CoEOM_facRmpVal Epm_nEng PhyMod_facEtaCor0 PhyMod_stNxt PhyMod_stPrs PthSet_trqInrSet StSys_trqStrt /end IN_MEASUREMENT
 /begin OUT_MEASUREMENT CnvSet_etaCurr CnvSet_etaCurrNxt CnvSet_facRmpVal CnvSet_qNrm CnvSet_qSet CnvSet_qSetNxt CnvSet_qSetPrs CnvSet_qStrt /end OUT_MEASUREMENT
 /begin LOC_MEASUREMENT CnvSet_qSetOptNxt_mp CnvSet_qSetOpt_mp /end LOC_MEASUREMENT
/end FUNCTION
/begin FUNCTION CoAS_RlsCmpn "" /begin REF_CHARACTERISTIC AirCtl_stPrioMon_CA /end REF_CHARACTERISTIC /begin IN_MEASUREMENT AirCtl_rEGRHPPosDes AirCtl_stEGRHPMixActv AirCtl_stMon /end IN_MEASUREMENT /begin OUT_MEASUREMENT CoAS_stEGRVlv CoAS_stThrVlv CoAS_stTrbCh /end OUT_MEASUREMENT /end FUNCTION
/begin FUNCTION CodVar_CoSelfRec "" /begin DEF_CHARACTERISTIC CodVar_mskFlLPCSelfRec_C CodVar_stFlLPCSelfRec_C /end DEF_CHARACTERISTIC /begin IN_MEASUREMENT FlFltDsP_bRec FlFltHt_bRec /end IN_MEASUREMENT /begin OUT_MEASUREMENT CodVar_stFlLPCActv /end OUT_MEASUREMENT
 /begin LOC_MEASUREMENT CodVar_stBlk0_mp CodVar_stBlk1_mp CodVar_stBlk2_mp CodVar_stBlk3_mp CodVar_stFlLPCSelfRecClct_mp /end LOC_MEASUREMENT
/end FUNCTION
/begin FUNCTION CodVar_VarSwt ""
 /begin OUT_MEASUREMENT CodVar_stMIL CodVar_stTrqClth CodVar_stTrqClthCpl CodVar_stTrqInr CodVar_stVMax /end OUT_MEASUREMENT
/end FUNCTION
/begin FUNCTION CoEng_Mon ""
 /begin DEF_CHARACTERISTIC CoEng_AftRunShOff_C CoEng_nSoftShOffMax_C CoEng_nSoftShOffMinRls_C CoEng_nSoftShOffMin_C CoEng_qSoftShOffMax_C CoEng_SoftShOff_C CoEng_stShutOffInit_C CoEng_stStandbyShOff_C CoEng_tiSoftShOff_C CoEng_vSoftShOffMax_C /end DEF_CHARACTERISTIC
 /begin IN_MEASUREMENT CoEng_st /end IN_MEASUREMENT
 /begin OUT_MEASUREMENT CoEng_stMSAStp CoEng_stShOff CoEng_stShutOffPath /end OUT_MEASUREMENT
 /begin LOC_MEASUREMENT CoEng_stShOffActv_mp CoEng_stSoftShOffRls_mp /end LOC_MEASUREMENT
/end FUNCTION
/begin FUNCTION CoEng_MonAdap ""
 /begin OUT_MEASUREMENT CoEng_stDiaReq CoEng_stIRevShutOff CoEng_stRevShutOff CoEng_stShutOff /end OUT_MEASUREMENT
/end FUNCTION
/begin FUNCTION CoEng_StEng ""
 /begin DEF_CHARACTERISTIC CoEng_nThresCranking_C CoEng_nThresNrml2Strt_C CoEng_tiNrml2Strt_C CoEng_tiPwrStgDiaRdy_C /end DEF_CHARACTERISTIC
 /begin IN_MEASUREMENT CoEng_stMSAStp Epm_nEng StSys_stStrt /end IN_MEASUREMENT
 /begin OUT_MEASUREMENT CoEng_st CoEng_stOld CoEng_stOldOld CoEng_tiAfterrun CoEng_tiAfterrunRed CoEng_tiNormal CoEng_tiNormalRed CoEng_tiStandby CoEng_tiStandbyRed CoEng_tiStart CoEng_tiStartRed /end OUT_MEASUREMENT
 /begin LOC_MEASUREMENT CoEng_stState_mp /end LOC_MEASUREMENT
/end FUNCTION
/begin FUNCTION CoEng_StrtCtl "" /begin DEF_CHARACTERISTIC CoEng_stStopEna_C CoEng_stStrtEna_C /end DEF_CHARACTERISTIC /begin IN_MEASUREMENT GlwCtl_tiPreGlwRmn /end IN_MEASUREMENT /begin OUT_MEASUREMENT CoEng_stStopEna CoEng_stStrtEna CoEng_tiStrtDly /end OUT_MEASUREMENT /end FUNCTION
/begin FUNCTION CoEOM_Co ""
 /begin DEF_CHARACTERISTIC CoEOM_stNxtOpMode_CA CoEOM_stNxtStage_CA CoEOM_stOpModeDes_C CoEOM_stOpModeDL_CA CoEOM_stOpModeMax_C /end DEF_CHARACTERISTIC
 /begin IN_MEASUREMENT CoEOM_numOpModeAct CoEOM_numOpModeAct_mp CoEOM_numStageAct CoEOM_numStageAct_mp CoEOM_stOpModeAct CoEOM_stOpModeActTSync CoEOM_stOpModeItm MoFMode_stOpModeMsg /end IN_MEASUREMENT
 /begin OUT_MEASUREMENT CoEOM_stDeadlck CoEOM_stEndOpMode CoEOM_stNxtOpMode CoEOM_stNxtStage CoEOM_stOpModeDem CoEOM_stOpModeDes CoEOM_stOpModePos CoEOM_stOpModePrio2 CoEOM_stOpModeSort /end OUT_MEASUREMENT
/end FUNCTION
/begin FUNCTION CoEOM_Lib "" /end FUNCTION
/begin FUNCTION CoEOM_RmpCalc ""
 /begin IN_MEASUREMENT CoEOM_stOpModeActTSync CoEOM_stOpModeLckTSync CoEOM_stOpModeOldTSync CoEOM_tiOpModeChngTSync CoEOM_tiRmpSlp /end IN_MEASUREMENT
 /begin OUT_MEASUREMENT CoEOM_facRmpVal CoEOM_stOpModeAct CoEOM_stOpModeLck CoEOM_stOpModeOld CoEOM_tiOpModeChng /end OUT_MEASUREMENT
/end FUNCTION
/begin FUNCTION CoEOM_SwtNSync "" /begin IN_MEASUREMENT CoEOM_stSyncLck /end IN_MEASUREMENT /end FUNCTION
/begin FUNCTION CoEOM_SwtTSync "" /begin DEF_CHARACTERISTIC CoEOM_tiRmpMax_C CoEOM_tiRmpMin_C CoEOM_tiRmp_CA /end DEF_CHARACTERISTIC /begin REF_CHARACTERISTIC CoEOM_stOpModeDes_C /end REF_CHARACTERISTIC
 /begin IN_MEASUREMENT CoEng_st CoEOM_facRmpVal CoEOM_stDeadlck CoEOM_stEndOpMode CoEOM_stOpModeDes CoEOM_stOpModePrio2 CoEOM_stTiRmpDem CoEOM_tiRmpDem /end IN_MEASUREMENT
 /begin OUT_MEASUREMENT CoEOM_numOpModeAct CoEOM_numOpModeOld CoEOM_numStageAct CoEOM_stOpModeActTSync CoEOM_stOpModeLckTSync CoEOM_stOpModeOldTSync CoEOM_stSyncLck CoEOM_stTransActv CoEOM_tiOpModeChngTSync CoEOM_tiRmpSlp /end OUT_MEASUREMENT
 /begin LOC_MEASUREMENT CoEOM_numOpModeAct_mp CoEOM_numOpModeOld_mp CoEOM_numStageAct_mp /end LOC_MEASUREMENT
/end FUNCTION
/begin FUNCTION CoEOM_Trans ""
 /begin DEF_CHARACTERISTIC CoEOM_Prio2_CA CoEOM_stDSCHEDPrio_C CoEOM_stOpModeAirCtlHPMix_C CoEOM_stOpModeCByVlv_C CoEOM_stOpModePil2_C CoEOM_stOpMode_C /end DEF_CHARACTERISTIC
 /begin IN_MEASUREMENT AirCtl_stEGRHPMixActv CoEOM_stOpModePrio2 Epm_ctCyl InjCrv_stInjCharActVal PCR_stCByVlvOpn PFltRgn_stOpMode /end IN_MEASUREMENT
 /begin OUT_MEASUREMENT CoEOM_stDSCHEDDem CoEOM_stOpModeItm CoEOM_stOpModeReq CoEOM_stRisePrio CoEOM_stTiRmpDem CoEOM_tiRmpDem /end OUT_MEASUREMENT
/end FUNCTION
/begin FUNCTION CoES_AVSCoLSU "" /begin DEF_CHARACTERISTIC CoES_MskDewDet_C CoES_MskFMA_C CoES_MskLSU_C /end DEF_CHARACTERISTIC /begin IN_MEASUREMENT CoEng_st /end IN_MEASUREMENT /begin OUT_MEASUREMENT CoES_stAVSCoLSU /end OUT_MEASUREMENT /begin LOC_MEASUREMENT CoES_stAVSCoLSU_mp CoES_stSig_mp CoES_stTrmMod_mp /end LOC_MEASUREMENT /end FUNCTION
/begin FUNCTION CoETS_StTrqLimCalc "" /begin DEF_CHARACTERISTIC CoETS_nTrqRatMin_C /end DEF_CHARACTERISTIC
 /begin IN_MEASUREMENT ActMod_trqInr CoETS_trqInrLimSet CoETS_trqInrSetSlow EngDem_facAdj EngDem_trqInrLim EngDem_trqLimErr EngPrt_trqLim EngPrt_trqLimMech EngPrt_trqLimOvhtPrv EngReq_trqInrLimSmk Epm_nEng GlbDa_stVehLimMin GlbDa_trqVehLimMin RngMod_trqMin /end IN_MEASUREMENT
 /begin OUT_MEASUREMENT CoETS_rTrq CoETS_stCurrLim CoETS_stCurrLimActive CoETS_trqInrCurrLim CoETS_trqInrVehLimMin_mp /end OUT_MEASUREMENT
/end FUNCTION
/begin FUNCTION CoETS_TrqCalc "" /begin DEF_CHARACTERISTIC CoETS_trqSetMax_C /end DEF_CHARACTERISTIC
 /begin IN_MEASUREMENT CoPT_trqCurrEng CoPT_trqDCSClth CoPT_trqDesCompEng CoPT_trqDesEng CoPT_trqLeadEng CoPT_trqPTPrt CoPT_trqResvEng EngDem_trqInrLim EngDem_trqInrLimLead RngMod_trqClthMin SpdGov_st SpdGov_trqFlt SpdGov_trqInrLimSet /end IN_MEASUREMENT
 /begin OUT_MEASUREMENT CoETS_stSetTrqActv CoETS_trqInrCurr CoETS_trqInrCurrFast CoETS_trqInrLead CoETS_trqInrLeadFast CoETS_trqInrLim CoETS_trqInrLimSet CoETS_trqInrLtd CoETS_trqInrSetSlow CoETS_trqInrTraIntv CoETS_trqSetDiag CoETS_trqUnFltLtd CoETS_trqUnFltLtdSet /end OUT_MEASUREMENT
 /begin LOC_MEASUREMENT CoETS_stSetTrqAlw_mp CoETS_trqSet_mp /end LOC_MEASUREMENT
/end FUNCTION
/begin FUNCTION comcil "" /begin REF_CHARACTERISTIC Com_stGear_C /end REF_CHARACTERISTIC
 /begin SUB_FUNCTION comcil ACCECU AircECU DsplECU BrkECU EngECU GbxECU Misc StrgECU /end SUB_FUNCTION
/end FUNCTION
/begin FUNCTION comcil_can100ms "" /end FUNCTION
/begin FUNCTION comcil_can10ms "" /end FUNCTION
/begin FUNCTION comcil_can20ms "" /begin IN_MEASUREMENT T15_st /end IN_MEASUREMENT /end FUNCTION
/begin FUNCTION ComCIL_CanInit "" /end FUNCTION
/begin FUNCTION ComCIL_SensCan100ms "" /end FUNCTION
/begin FUNCTION ComCIL_SensCan10ms "" /end FUNCTION
/begin FUNCTION come_demcoord ""
 /begin IN_MEASUREMENT Alt_trqDes Alt_trqResv PT_trqLosComp PT_trqResv TS_nMax TS_nMin TS_nMinAC TS_trqDesAcs TS_trqResvAcs VehMot_nMaxAcs VehMot_nMinAcs VehMot_trqDesAcs VehMot_trqResvAcs /end IN_MEASUREMENT
 /begin OUT_MEASUREMENT CoME_nMax CoME_nMin CoME_stNSetP CoME_trqDesComp CoME_trqResv CoVeh_trqAcs /end OUT_MEASUREMENT
/end FUNCTION
/begin FUNCTION Conv_GripIntrlck "" /begin IN_MEASUREMENT Clth_st /end IN_MEASUREMENT /begin OUT_MEASUREMENT PT_stConvGrip /end OUT_MEASUREMENT /end FUNCTION
/begin FUNCTION Conv_LdCalc ""
 /begin DEF_CHARACTERISTIC Conv_facDepNTrbnNStat_CUR Conv_facGnTrqHiInc_C Conv_facGnTrqResv_C Conv_facNTrbnCorr_C Conv_facVelErr_C Conv_facVelNoErr_C Conv_LvrOffDebP.tiHiLo_C Conv_LvrOffDebP.tiLoHi_C Conv_LvrPosOffDebP.tiHiLo_C Conv_LvrPosOffDebP.tiLoHi_C Conv_nTrbnLoLim_C Conv_nTrbnMinCorrVal_C Conv_nTrbn_C Conv_tiDwnRglPT1_C Conv_tiPT1_C Conv_tiRTraGearPT1_C Conv_tiTrbnPT1_C Conv_tiTrqLdPT1_C Conv_tiTrqResvPT1_C Conv_tiUpRglPT1_C Conv_trqGbx_MAP Conv_trqLdGnFacHysDec_C Conv_trqLdMaxLim_MAP Conv_trqLdReplCan_C Conv_TrqResvDebP.tiHiLo_C Conv_TrqResvDebP.tiLoHi_C Conv_trqResvLoLim_C Conv_trqResvMinLim_C Conv_trqResvNeutrLvrPos_C Conv_trqResvPreFlt_C Conv_trqResvRepl_C Conv_trqStatSqLvrPosNeutr_C /end DEF_CHARACTERISTIC
 /begin IN_MEASUREMENT Conv_bCalc Conv_bConvActv Conv_bGearOff Conv_bTrbnSpdCan Conv_bTrqLdCan Conv_bTrqLdFlt Conv_bTrqResvBrkEnd Conv_bTrqResvLvrOff Conv_facOilTempDepTrqPmp Conv_tiTempDepLvrDebNeg Conv_tiTempDepLvrDebPos Conv_tiTempDepRevLvrDebNeg Conv_tiTempDepRevLvrDebPos Conv_trqLdLvrPosNeutr Conv_trqLdRevLvrPos Conv_trqLdTempDepLim Conv_trqResvTempDep Epm_nEng Gbx_nTrbn Gbx_trqConvLos GlbDa_lWhlCirc GlbDa_vXFlt HLSDem_nSetPLo PT_rTraGear PT_stConvGrip PT_stTraGrip PT_stTraRevGear PT_stTraType Tra_numGear TS_tClntEngOut VehMot_rTrqDfftl VehMot_stBrkPed /end IN_MEASUREMENT
 /begin OUT_MEASUREMENT Conv_bRevLvrPos Conv_bTrqResv Conv_dnTrbn Conv_nTrbn Conv_nTrbnMod Conv_nTrbnOld Conv_trqFlt Conv_trqLd Conv_trqLdFlt Conv_trqLdMod Conv_trqLdPreFlt Conv_trqResv /end OUT_MEASUREMENT
 /begin LOC_MEASUREMENT Conv_bCalcActv_mp Conv_dnTrbnUnFlt_mp Conv_facDepNTrbnNStat_mp Conv_nTrbnCorrVal_mp Conv_nTrbnDiff_mp Conv_nTrbnExp_mp Conv_rNTrbnNStat_mp Conv_trqLdBefLim_mp Conv_trqLdDiff_mp Conv_trqLdFltRslt_mp Conv_trqLdMaxLim_mp Conv_trqLdOfs_mp Conv_trqLdResvAdd_mp Conv_trqLdResvFlt_mp Conv_trqLdTrqResvTotBuf_mp Conv_trqPmpBuf_mp Conv_trqResvHiInc_mp Conv_trqStatSqBuf_mp /end LOC_MEASUREMENT
/end FUNCTION
/begin FUNCTION Conv_LdData ""
 /begin DEF_CHARACTERISTIC Conv_BrkDebP.tiHiLo_C Conv_BrkDebP.tiLoHi_C Conv_facClthClsd_GCUR Conv_facClthOpnd_GCUR Conv_facDfl_C Conv_tiDfl_C Conv_tiRevLvrOff_GCUR Conv_tiRevLvrOn_GCUR Conv_tiTempDepLvrOff_GCUR Conv_tiTempDepLvrOn_GCUR Conv_tPntDST_AXIS Conv_trqDfl_C Conv_trqLdActv_CW Conv_trqLdLvrPosNeutr_GCUR Conv_trqLdRevLvrPos_GCUR Conv_trqLdTempDepLim_GCUR Conv_trqLd_CW Conv_trqResvTempDep_GCUR /end DEF_CHARACTERISTIC
 /begin IN_MEASUREMENT Gbx_tOilConv TS_tClntEngOut VehMot_stBrkPed /end IN_MEASUREMENT
 /begin OUT_MEASUREMENT Conv_bCalc Conv_bConvActv Conv_bGearOff Conv_bTrbnSpdCan Conv_bTrqLdCan Conv_bTrqLdFlt Conv_bTrqResvBrkEnd Conv_bTrqResvLvrOff Conv_facOilTempDepTrqPmp Conv_tiTempDepLvrDebNeg Conv_tiTempDepLvrDebPos Conv_tiTempDepRevLvrDebNeg Conv_tiTempDepRevLvrDebPos Conv_trqLdLvrPosNeutr Conv_trqLdRevLvrPos Conv_trqLdTempDepLim Conv_trqResvTempDep /end OUT_MEASUREMENT
 /begin LOC_MEASUREMENT Conv_tOilBuf_mp /end LOC_MEASUREMENT
/end FUNCTION
/begin FUNCTION Conv_TrqRat "" /begin DEF_CHARACTERISTIC Conv_rTrq_C /end DEF_CHARACTERISTIC /begin OUT_MEASUREMENT Conv_rTrq /end OUT_MEASUREMENT /end FUNCTION
/begin FUNCTION CoPT_ThermDem "" /begin IN_MEASUREMENT CoTemp_rClgDes CoTemp_tEngDes Tra_rClgDem Tra_tClntDes /end IN_MEASUREMENT /begin OUT_MEASUREMENT CoPT_rClgDes CoPT_tClntDes /end OUT_MEASUREMENT /end FUNCTION
/begin FUNCTION CoPT_TrqDesCoord ""
 /begin IN_MEASUREMENT ActMod_trqClthWoDstC CoVeh_trqDes PT_rTrq PT_trqLos PT_trqTraPrt RngMod_trqClthBs Tra_trqDesMax Tra_trqDesMin VehMot_trqDCS VehMot_trqDesTCS VehMot_trqPrtDfftl /end IN_MEASUREMENT
 /begin OUT_MEASUREMENT CoPT_stIARls CoPT_trqDCSClth CoPT_trqDes CoPT_trqDesTCSClth CoPT_trqPTPrt CoPT_trqTraDes PT_stIARls PT_stTraIntv /end OUT_MEASUREMENT
 /begin LOC_MEASUREMENT CoPT_trqDesClth_mp CoPT_trqDesDecMin_mp CoPT_trqDesIncMax_mp /end LOC_MEASUREMENT
/end FUNCTION
/begin FUNCTION CoPT_TrqLeadCoord ""
 /begin DEF_CHARACTERISTIC CoPT_dtrqCurrCorP.Pos_C CoPT_dtrqCurrCorP.Neg_C CoPT_dtrqLeadCorP.Pos_C CoPT_dtrqLeadCorP.Neg_C CoPT_tiDebCurr_C CoPT_tiDebLead_C /end DEF_CHARACTERISTIC
 /begin IN_MEASUREMENT CoVeh_trqLead PT_rTrq PT_trqLos PT_trqTraPrt Tra_trqLeadMax Tra_trqLeadMin VehMot_trqDCS VehMot_trqLeadPOp VehMot_trqLeadTCS VehMot_trqPrtDfftl /end IN_MEASUREMENT
 /begin OUT_MEASUREMENT CoPT_trqCurr CoPT_trqLead CoPT_trqLeadPOp CoPT_trqLeadTCSClth /end OUT_MEASUREMENT
 /begin LOC_MEASUREMENT CoPT_trqCurrDecMin_mp CoPT_trqLeadClth_mp CoPT_trqLeadDecMin_mp CoPT_trqLeadIncMax_mp /end LOC_MEASUREMENT
/end FUNCTION
/begin FUNCTION Core_Env "" /end FUNCTION
/begin FUNCTION CoSCR "" /begin SUB_FUNCTION SCRMon SCRCon CoSCR_Main /end SUB_FUNCTION /end FUNCTION
/begin FUNCTION CoSCR_Main ""
 /begin IN_MEASUREMENT SCRMon_stAftrun SCRMon_stAftrunEmpt SCRMon_stAftrunTempWait SCRMon_stMetCtl SCRMon_stNoPresCtl SCRMon_stPresBuildUp SCRMon_stPresCtl SCRMon_stPresRdc SCRMon_stReFl SCRMon_stStBy SCRMon_stVtln /end IN_MEASUREMENT
 /begin OUT_MEASUREMENT CoSCR_cntEntryAftrun CoSCR_cntEntryAftrunEmpt CoSCR_cntEntryAftrunTempWait CoSCR_cntEntryMetCtl CoSCR_cntEntryNoPresCtl CoSCR_cntEntryPresBuildUp CoSCR_cntEntryPresCtl CoSCR_cntEntryPresRdc CoSCR_cntEntryReFl CoSCR_cntEntryStBy CoSCR_cntEntryVtln CoSCR_st CoSCR_stOld CoSCR_stSub CoSCR_stSubOld CoSCR_tiAftrun CoSCR_tiAftrunEmpt CoSCR_tiAftrunTempWait CoSCR_tiMetCtl CoSCR_tiNoPresCtl CoSCR_tiPresBuildUp CoSCR_tiPresCtl CoSCR_tiPresRdc CoSCR_tiReFl CoSCR_tiStBy CoSCR_tiVtln SCRCtl_stMetMod /end OUT_MEASUREMENT
/end FUNCTION
/begin FUNCTION CoTemp_DmAirDesVal "" /begin DEF_CHARACTERISTIC CoTemp_rClgDes_CUR /end DEF_CHARACTERISTIC /begin IN_MEASUREMENT EngDa_tEng /end IN_MEASUREMENT /begin OUT_MEASUREMENT CoTemp_rClgDes /end OUT_MEASUREMENT /end FUNCTION
/begin FUNCTION CoTemp_TEngDesVal ""
 /begin DEF_CHARACTERISTIC CoTemp_tEngClntAftRunDes_C CoTemp_tEngClntIniDes_C CoTemp_tEngDesBaseNTrq_MAP CoTemp_tEngDesBaseTempVel_MAP /end DEF_CHARACTERISTIC
 /begin IN_MEASUREMENT EnvT_t Epm_nEng PthSet_trqInrSet SyC_stSub VehV_v /end IN_MEASUREMENT
 /begin OUT_MEASUREMENT CoTemp_tEngDes /end OUT_MEASUREMENT
/end FUNCTION
/begin FUNCTION CoTE_ThermDem "" /begin IN_MEASUREMENT CoPT_rClgDes CoPT_tClntDes /end IN_MEASUREMENT /begin OUT_MEASUREMENT CoVeh_rClgDes CoVeh_tClntDes /end OUT_MEASUREMENT /end FUNCTION
/begin FUNCTION CoTS_MechDem "" /begin IN_MEASUREMENT AC_trqDes AC_trqResv WaHt_nMin /end IN_MEASUREMENT /begin OUT_MEASUREMENT TS_nMax TS_nMin TS_trqDesAcs TS_trqResvAcs /end OUT_MEASUREMENT /end FUNCTION
/begin FUNCTION CoVehAdapt_Adapt "" /begin OUT_MEASUREMENT SSEUI_stStopStrtSwt /end OUT_MEASUREMENT /end FUNCTION
/begin FUNCTION CoVeh_CalcTrqPrpLimErr "" /begin DEF_CHARACTERISTIC CoVeh_trqLim_CUR /end DEF_CHARACTERISTIC /begin IN_MEASUREMENT Epm_nEng VehMot_rTrqDfftl /end IN_MEASUREMENT /begin OUT_MEASUREMENT CoVeh_trqPrpLimErr /end OUT_MEASUREMENT /begin LOC_MEASUREMENT CoVeh_trqLim_mp /end LOC_MEASUREMENT /end FUNCTION
/begin FUNCTION CoVeh_SpdCoord "" /begin IN_MEASUREMENT VehMot_nMax VehMot_nMin VehMot_stNSetP /end IN_MEASUREMENT /begin OUT_MEASUREMENT CoVeh_nMaxSysErr CoVeh_nMinSysErr CoVeh_stNSetPSysErr /end OUT_MEASUREMENT /end FUNCTION
/begin FUNCTION CoVeh_TrqDesCoord "" /begin IN_MEASUREMENT CoVeh_trqPrpLimErr CoVMD_trqPrpLimPBr VehMot_trqDes /end IN_MEASUREMENT /begin OUT_MEASUREMENT CoVeh_stLimSysErr CoVeh_trqDes /end OUT_MEASUREMENT /end FUNCTION
/begin FUNCTION CoVeh_TrqLeadCoord "" /begin IN_MEASUREMENT CoVeh_trqPrpLimErr CoVMD_trqPrpLimPBr VehMot_trqLead /end IN_MEASUREMENT /begin OUT_MEASUREMENT CoVeh_trqLead /end OUT_MEASUREMENT /end FUNCTION
/begin FUNCTION CoVMD_CalcTrqPrpLimPBr ""
 /begin DEF_CHARACTERISTIC CoVMD_dtrqLim.Pos_C CoVMD_dtrqLim.Neg_C CoVMD_trqLimPBr_C CoVMD_vLimPBr_C /end DEF_CHARACTERISTIC
 /begin IN_MEASUREMENT Com_stPBrComf Com_stPBrHold Com_stPBrHyd GlbDa_vX Tra_numGear /end IN_MEASUREMENT
 /begin OUT_MEASUREMENT CoVMD_trqPrpLimPBr /end OUT_MEASUREMENT
 /begin LOC_MEASUREMENT CoVMD_swtRmpPBr_mp /end LOC_MEASUREMENT
/end FUNCTION
/begin FUNCTION CoVMD_SpdCoord "" /begin IN_MEASUREMENT AccPed_nMax AccPed_nMin AccPed_stNSetP /end IN_MEASUREMENT /begin OUT_MEASUREMENT VMD_nMax VMD_nMin VMD_stNSetP /end OUT_MEASUREMENT /end FUNCTION
/begin FUNCTION CoVMD_TrqCalc ""
 /begin DEF_CHARACTERISTIC CoVMD_swtCCSelVal_C CoVMD_swtCCSel_C CoVMD_swtOvrRunCrCtl_C CoVMD_trqThresCtOffLo_C CoVMD_trqThresCtOffUp_C /end DEF_CHARACTERISTIC
 /begin IN_MEASUREMENT ACCI_aReq ACCI_stReq CrCtl_aReq CrCtl_stReq CrCUI_stDetUI LLim_trqSpdLim MoFDrAs_stPtdMsg PT_swtMstShft PT_trqSpdGovLtd PT_trqWhlMaxEng PT_trqWhlMinEng PT_trqWhlMinWoCtOff VehMot_a2trq VehMot_stAccPedOvrRun VehMot_trqDrag VehMot_trqThresComp /end IN_MEASUREMENT
 /begin OUT_MEASUREMENT CoVMD_aReqCrCtl_mp CoVMD_facCompAcsCrCtl CoVMD_facCompAcsLLim CoVMD_stCtOffPhdCrCtl CoVMD_stCtOffPhdLLim CoVMD_stReqCrCtl CoVMD_swtCCSel CoVMD_trqCrCtl CoVMD_trqCrCtl_mp CoVMD_trqLLim CoVMD_trqLLim_mp /end OUT_MEASUREMENT
/end FUNCTION
/begin FUNCTION CoVMD_TrqDesCoord ""
 /begin DEF_CHARACTERISTIC CoVMD_trqThresCrCtlL_C CoVMD_trqThresCrCtlR_C CoVMD_trqThresLLimL_C CoVMD_trqThresLLimR_C /end DEF_CHARACTERISTIC
 /begin IN_MEASUREMENT ACCI_trqDes AccPed_facCompAcs AccPed_trqDes CoVMD_facCompAcsCrCtl CoVMD_stCtOffPhdCrCtl CoVMD_stCtOffPhdLLim CoVMD_stReqCrCtl CoVMD_trqCrCtl CoVMD_trqLLim /end IN_MEASUREMENT
 /begin OUT_MEASUREMENT VehMot_facCompAcs VehMot_stCtOffPhd VehMot_stPrpCrCtl VehMot_stPrpLLim VMD_trqDes /end OUT_MEASUREMENT
/end FUNCTION
/begin FUNCTION CoVMD_TrqLeadCoord "" /begin IN_MEASUREMENT ACCI_trqDes AccPed_trqLead CoVMD_trqCrCtl CoVMD_trqLLim /end IN_MEASUREMENT /begin OUT_MEASUREMENT VMD_trqLead VMD_trqLeadPOp /end OUT_MEASUREMENT /end FUNCTION
/begin FUNCTION CoVM_IARlsCoord "" /begin IN_MEASUREMENT CoVM_stIARls Prp_stIARls /end IN_MEASUREMENT /begin OUT_MEASUREMENT VehMot_stIARls /end OUT_MEASUREMENT /end FUNCTION
/begin FUNCTION CoVM_SlipDet ""
 /begin DEF_CHARACTERISTIC CoVM_facStWhlRL_CUR CoVM_facStWhlRR_CUR VehMot_rvSlipThres_C /end DEF_CHARACTERISTIC
 /begin IN_MEASUREMENT Com_phiStWhlAgRaw Com_vBd Com_vWheelRL Com_vWheelRR /end IN_MEASUREMENT
 /begin OUT_MEASUREMENT VehMot_stSlip /end OUT_MEASUREMENT
 /begin LOC_MEASUREMENT CoVM_facStWhlRL_mp CoVM_facStWhlRR_mp VehMot_rvActSlip_mp VehMot_vDvtWheel_mp /end LOC_MEASUREMENT
/end FUNCTION
/begin FUNCTION CoVM_SpdCoord "" /begin IN_MEASUREMENT VMD_nMax VMD_nMin VMD_stNSetP /end IN_MEASUREMENT
 /begin OUT_MEASUREMENT VehMot_nMax VehMot_nMaxAcs VehMot_nMin VehMot_nMinAcs VehMot_stNSetP /end OUT_MEASUREMENT
/end FUNCTION
/begin FUNCTION CoVM_TrqAcsCoord "" /begin IN_MEASUREMENT Strg_trqDes Strg_trqResv /end IN_MEASUREMENT /begin OUT_MEASUREMENT VehMot_trqDesAcs VehMot_trqResvAcs /end OUT_MEASUREMENT /end FUNCTION
/begin FUNCTION CoVM_TrqDesCoord ""
 /begin IN_MEASUREMENT PT_trqWhlBs PT_trqWhlWoDstC VMD_trqDes VMSI_trqDesMax VMSI_trqMin /end IN_MEASUREMENT
 /begin OUT_MEASUREMENT CoVM_stIARls CoVM_trqDes VehMot_stStabIntv /end OUT_MEASUREMENT
 /begin LOC_MEASUREMENT CoVM_trqDesIncMax_mp /end LOC_MEASUREMENT
/end FUNCTION
/begin FUNCTION CoVM_TrqLeadCoord ""
 /begin DEF_CHARACTERISTIC CoVM_dtrqLeadCorP.Pos_C CoVM_dtrqLeadCorP.Neg_C CoVM_TrqRedMaxP.tiHiLo_C CoVM_TrqRedMaxP.tiLoHi_C /end DEF_CHARACTERISTIC
 /begin IN_MEASUREMENT VMD_trqLead VMD_trqLeadPOp VMSI_trqLeadMax VMSI_trqMin /end IN_MEASUREMENT
 /begin OUT_MEASUREMENT CoVM_trqLead CoVM_trqLeadPOp /end OUT_MEASUREMENT
 /begin LOC_MEASUREMENT CoVM_trqLeadIncMax_mp /end LOC_MEASUREMENT
/end FUNCTION
/begin FUNCTION Cpu "" /begin DEF_CHARACTERISTIC Cpu_swtClrEnvRAMVals_C /end DEF_CHARACTERISTIC
 /begin LOC_MEASUREMENT Cpu_rCurCSACons_mp Cpu_rCurSysStackCons_mp Cpu_rCurUsrStackCons_mp Cpu_rMaxCSACons_mp Cpu_rMaxSysStackCons_mp Cpu_rMaxUsrStackCons_mp /end LOC_MEASUREMENT
/end FUNCTION
/begin FUNCTION CrCtl_Governor ""
 /begin DEF_CHARACTERISTIC CrCtl_aMax_C CrCtl_aMin_C CrCtl_aReqAcc_C CrCtl_aReqDecl_C CrCtl_aReq_MAP CrCtl_daAccDeclTrans_C CrCtl_daCruise_C CrCtl_daNgvAccDecl_C CrCtl_daNgvRes_C CrCtl_daPsvAccDecl_C CrCtl_daPsvRes_C CrCtl_daThresShOffRmp_C CrCtl_vThresAccMax_C /end DEF_CHARACTERISTIC
 /begin IN_MEASUREMENT CrCtl_st CrCtl_stOld CrCtl_tiShOff CrCtl_vDes CrCtl_vDesMax CrCtl_vDesMin CrCtl_vX VehMot_aPrpCurr VehMot_aPrpMin VehMot_stPrpCrCtl /end IN_MEASUREMENT
 /begin OUT_MEASUREMENT CrCtl_aReq CrCtl_stPtd CrCtl_stReq /end OUT_MEASUREMENT
 /begin LOC_MEASUREMENT CrCtl_aReqFlt_mp CrCtl_aReqRaw_mp CrCtl_aShOffRmp_mp CrCtl_daRmpFltNgv_mp CrCtl_daRmpFltPsv_mp CrCtl_daShOffRmpAct_mp CrCtl_daShOffRmp_mp CrCtl_stFstRmp_mp CrCtl_stImmdShOff_mp CrCtl_stShOffRmpEnd_mp CrCtl_vDiff_mp /end LOC_MEASUREMENT
/end FUNCTION
/begin FUNCTION CrCtl_ShOff ""
 /begin DEF_CHARACTERISTIC CrCtl_numGearAllwMax_C CrCtl_numGearAllwMin_C CrCtl_rDvtV2NMax_C CrCtl_stClrVDesBtnMsk_C CrCtl_stClrVDesShOffMsk_C CrCtl_stShOffFstMsk_C CrCtl_stShOffIrvMsk_C CrCtl_stShOffRvMsk_C CrCtl_tiDebAscLoHi_C CrCtl_tiDebDscLoHi_C CrCtl_tiFltvXOfs_C CrCtl_tiFltvX_C CrCtl_tiMoF_C CrCtl_tiShOffFst_C CrCtl_tiShOffSlw_C CrCtl_vCrCtlMaxKmh_C CrCtl_vCrCtlMaxMph_C CrCtl_vCrCtlMinKmh_C CrCtl_vCrCtlMinMph_C CrCtl_vDesMaxKmh_C CrCtl_vDesMaxMph_C CrCtl_vDesMinKmh_C CrCtl_vDesMinMph_C CrCtl_vTipStpKmh_C CrCtl_vTipStpMph_C CrCtl_vXOfsFltMax_C /end DEF_CHARACTERISTIC
 /begin IN_MEASUREMENT Brk_st Clth_st CoEng_st Com_stClCtr Com_stCrCtlKombi Com_stDSC Com_stHDC Com_stLmpPrkBrk Com_stUnVel Com_vDspl Com_vVeh CrCtl_rTraV2NBgn CrCtl_st CrCtl_stReq CrCUI_stBtn CrCUI_stErr GlbDa_vXFlt MoFDrAs_stCCtlPtdMsg PT_rTraV2N PT_stTraType Tra_numGear /end IN_MEASUREMENT
 /begin OUT_MEASUREMENT CrCtl_stClrVelDes CrCtl_stShOff CrCtl_tiShOff CrCtl_vCrCtlMax CrCtl_vCrCtlMin CrCtl_vDesMax CrCtl_vDesMin CrCtl_vTipStp CrCtl_vX /end OUT_MEASUREMENT
 /begin LOC_MEASUREMENT CrCtl_stShOffConFstActv_mp CrCtl_stShOffConIrvActv_mp CrCtl_stShOffConRvActv_mp CrCtl_stShOffCon_mp CrCtl_vXOfsFlt_mp CrCtl_vXOfs_mp CrCtl_vXUnFlt_mp /end LOC_MEASUREMENT
/end FUNCTION
/begin FUNCTION CrCtl_StM ""
 /begin DEF_CHARACTERISTIC CrCtl_vAccOfs_C CrCtl_vDeclOfs_C CrCtl_vOfsCruise_CUR CrCtl_vThresCruise_C /end DEF_CHARACTERISTIC
 /begin IN_MEASUREMENT APP_r APP_stKD CrCtl_aReq CrCtl_stClrVelDes CrCtl_stShOff CrCtl_stStTrans CrCtl_vCrCtlMax CrCtl_vCrCtlMin CrCtl_vDesMax CrCtl_vDesMin CrCtl_vTipStp CrCUI_stNoBtnActv GlbDa_aXFlt GlbDa_vXFlt PT_rTraV2N VehMot_aPrpMax VehMot_aPrpMin VehMot_stPrpCrCtl /end IN_MEASUREMENT
 /begin OUT_MEASUREMENT CrCtl_rTraV2NBgn CrCtl_st CrCtl_stCLCTRV CrCtl_stDspl CrCtl_stOld CrCtl_stVClsdLop CrCtl_vClsdLop CrCtl_vDes /end OUT_MEASUREMENT
 /begin LOC_MEASUREMENT CrCtl_stTipEna_mp CrCtl_vDesOfs_mp CrCtl_vXLim_mp /end LOC_MEASUREMENT
/end FUNCTION
/begin FUNCTION CrCtl_StTrans ""
 /begin DEF_CHARACTERISTIC CrCtl_stAccHld_C CrCtl_stAccNgv_C CrCtl_stAccPsv_C CrCtl_stDeclHld_C CrCtl_stDeclNgv_C CrCtl_stDeclPsv_C CrCtl_stResPsv_C CrCtl_stSetPsv_C /end DEF_CHARACTERISTIC
 /begin IN_MEASUREMENT CrCUI_stBtn CrCUI_stBtnOld /end IN_MEASUREMENT
 /begin OUT_MEASUREMENT CrCtl_stStTrans /end OUT_MEASUREMENT
/end FUNCTION
/begin FUNCTION CrCUI_GetUI "" /begin DEF_CHARACTERISTIC CrCUI_tiPerm_C /end DEF_CHARACTERISTIC /begin IN_MEASUREMENT Com_bRecCrCtlLvr Com_stCrCtlLvr /end IN_MEASUREMENT
 /begin OUT_MEASUREMENT CrCUI_stBtn CrCUI_stBtnOld CrCUI_stDetUI CrCUI_stErr CrCUI_stNoBtnActv /end OUT_MEASUREMENT
/end FUNCTION
/begin FUNCTION CrC_VD "" /begin OUT_MEASUREMENT CrC_stErr CrC_stKey /end OUT_MEASUREMENT /end FUNCTION
/begin FUNCTION CrntCtl_VDSet "" /begin IN_MEASUREMENT FuelT_tFlSys /end IN_MEASUREMENT /end FUNCTION
/begin FUNCTION CThmst_DD ""
 /begin DEF_CHARACTERISTIC CThmst_Pwm.tiPer_C CThmst_Pwm.stLvl_C CThmst_Pwm.rMaxDty_C CThmst_Pwm.rPerUn_C CThmst_Pwm.tiPh_C CThmst_PwmOut.rMin_C CThmst_PwmOut.rMax_C CThmst_PwmOut.tiBtwTstSCB_C CThmst_PwmOut.tiBtwTstOT_C CThmst_PwmOut.numTstMax_C CThmst_PwmOut.swtBattCor_C CThmst_PwmOut.swtPsInv_C CThmst_rCnv_CUR CThmst_rPsDisbl_C CThmst_stPwrStgDiaDis_C CThmst_stPwrStgDis_C /end DEF_CHARACTERISTIC
 /begin IN_MEASUREMENT BattU_facCor DevLib_stPwrStgEnaCond /end IN_MEASUREMENT
 /begin OUT_MEASUREMENT CThmst_r CThmst_rPs /end OUT_MEASUREMENT
 /begin LOC_MEASUREMENT CThmst_rCnv_mp /end LOC_MEASUREMENT
/end FUNCTION
/begin FUNCTION CustDiag ""
 /begin IN_MEASUREMENT Brk_st Clth_st CoEng_st Com_stTRadio PT_stTraType SyC_stSub Tra_numGear VehV_v /end IN_MEASUREMENT
 /begin OUT_MEASUREMENT CustDiag_stPwrDwn /end OUT_MEASUREMENT
 /begin SUB_FUNCTION CustDiag_Util /end SUB_FUNCTION
/end FUNCTION
/begin FUNCTION CustDiag_Util "" /begin DEF_CHARACTERISTIC CustDiag_dDatasetVer_C CustDiag_dSGBDIdx_CA /end DEF_CHARACTERISTIC /end FUNCTION
/begin FUNCTION Cy100 "" /end FUNCTION
/begin FUNCTION Cy320 "" /end FUNCTION
/begin FUNCTION DcanAppl_Std "" /end FUNCTION
/begin FUNCTION Dcan_Std "" /end FUNCTION
/begin FUNCTION DDRC ""
 /begin DEF_CHARACTERISTIC DDRC_DurDeb.TrbCh_tiOLDebOk_C DDRC_DurDeb.TrbCh_tiOLDebDef_C DDRC_DurDeb.ThrVlv_tiOLDebOk_C DDRC_DurDeb.ThrVlv_tiOLDebDef_C DDRC_DurDeb.WaHtEl_tiSCBDebOk_C DDRC_DurDeb.WaHtEl_tiSCBDebDef_C DDRC_DurDeb.EBxFan_tiOvrTempDebOk_C DDRC_DurDeb.EBxFan_tiOvrTempDebDef_C DDRC_DurDeb.RailP_tiSRCMinDebOk_C DDRC_DurDeb.RailP_tiSRCMinDebDef_C DDRC_DurDeb.Fan_tiOLDebOk_C DDRC_DurDeb.Fan_tiOLDebDef_C DDRC_DurDeb.ECBVlv_tiOvrTempDebOk_C DDRC_DurDeb.ECBVlv_tiOvrTempDebDef_C DDRC_DurDeb.EBxFan_tiSCGDebOk_C DDRC_DurDeb.EBxFan_tiSCGDebDef_C DDRC_DurDeb.UPmpMot_tiOLDebOk_C DDRC_DurDeb.UPmpMot_tiOLDebDef_C DDRC_DurDeb.AirC_tiCmprOLDebOk_C DDRC_DurDeb.AirC_tiCmprOLDebDef_C DDRC_DurDeb.UDosVlv_tiOLDebOk_C DDRC_DurDeb.UDosVlv_tiOLDebDef_C DDRC_DurDeb.ThrVlv_tiSCBDebOk_C DDRC_DurDeb.ThrVlv_tiSCBDebDef_C DDRC_DurDeb.CThmst_tiOvrTempDebOk_C DDRC_DurDeb.CThmst_tiOvrTempDebDef_C DDRC_DurDeb.UDosVlv_tiSCGDebOk_C DDRC_DurDeb.UDosVlv_tiSCGDebDef_C DDRC_DurDeb.Strt_tiSCBDebOk_C DDRC_DurDeb.Strt_tiSCBDebDef_C DDRC_DurDeb.CByVlv_tiSCGDebOk_C DDRC_DurDeb.CByVlv_tiSCGDebDef_C DDRC_DurDeb.TrbCh_tiOvrTempDebOk_C DDRC_DurDeb.TrbCh_tiOvrTempDebDef_C DDRC_DurDeb.EBxFan_tiSCBDebOk_C DDRC_DurDeb.EBxFan_tiSCBDebDef_C DDRC_DurDeb.Strt_tiOvrTempDebOk_C DDRC_DurDeb.Strt_tiOvrTempDebDef_C DDRC_DurDeb.ECBVlv_tiSCBDebOk_C DDRC_DurDeb.ECBVlv_tiSCBDebDef_C DDRC_DurDeb.EngStA_tiOvrTempDebOk_C DDRC_DurDeb.EngStA_tiOvrTempDebDef_C DDRC_DurDeb.UPmpMot_tiSCGDebOk_C DDRC_DurDeb.UPmpMot_tiSCGDebDef_C DDRC_DurDeb.WaHtEl_tiOvrTempDebOk_C DDRC_DurDeb.WaHtEl_tiOvrTempDebDef_C DDRC_DurDeb.CByVlv_tiOLDebOk_C DDRC_DurDeb.CByVlv_tiOLDebDef_C DDRC_DurDeb.UDosVlv_tiOvrTempDebOk_C DDRC_DurDeb.UDosVlv_tiOvrTempDebDef_C DDRC_DurDeb.CThmst_tiSCBDebOk_C DDRC_DurDeb.CThmst_tiSCBDebDef_C DDRC_DurDeb.CThmst_tiOLDebOk_C DDRC_DurDeb.CThmst_tiOLDebDef_C DDRC_DurDeb.PCV_tiOLDebOk_C DDRC_DurDeb.PCV_tiOLDebDef_C DDRC_DurDeb.LSU_tiHtrMinDebOk_C DDRC_DurDeb.LSU_tiHtrMinDebDef_C DDRC_DurDeb.Fan_tiSCBDebOk_C DDRC_DurDeb.Fan_tiSCBDebDef_C DDRC_DurDeb.ECBVlv_tiOLDebOk_C DDRC_DurDeb.ECBVlv_tiOLDebDef_C DDRC_DurDeb.UPmpMot_tiSCBDebOk_C DDRC_DurDeb.UPmpMot_tiSCBDebDef_C DDRC_DurDeb.ThrVlv_tiOvrTempDebOk_C DDRC_DurDeb.ThrVlv_tiOvrTempDebDef_C DDRC_DurDeb.FlFltHt_tiSCBDebOk_C DDRC_DurDeb.FlFltHt_tiSCBDebDef_C DDRC_DurDeb.EBxFan_tiOLDebOk_C DDRC_DurDeb.EBxFan_tiOLDebDef_C DDRC_DurDeb.LSU_titExcMinDebOk_C DDRC_DurDeb.LSU_titExcMinDebDef_C DDRC_DurDeb.DSMTst_ExampleDebOk_C DDRC_DurDeb.DSMTst_ExampleDebDef_C DDRC_DurDeb.AirC_tiCmprSCBDebOk_C DDRC_DurDeb.AirC_tiCmprSCBDebDef_C DDRC_DurDeb.EMDmp_tiSCBDebOk_C DDRC_DurDeb.EMDmp_tiSCBDebDef_C DDRC_DurDeb.Shtr_tiOvrTempDebOk_C DDRC_DurDeb.Shtr_tiOvrTempDebDef_C DDRC_DurDeb.LSU_tiHtrSigDebOk_C DDRC_DurDeb.LSU_tiHtrSigDebDef_C DDRC_DurDeb.WaHtEl_tiOLDebOk_C /end DEF_CHARACTERISTIC
 /begin LOC_MEASUREMENT DSM_xTabVersion /end LOC_MEASUREMENT
/end FUNCTION
/begin COMPU_METHOD Acc "" RAT_FUNC "%6.5" "m/s^2" COEFFS 0 1000 0 0 0 1 /end COMPU_METHOD
/begin COMPU_METHOD AirSysSwt_S16 "" RAT_FUNC "%7.6" "-" COEFFS 0 16384 0 0 0 1 /end COMPU_METHOD
/begin COMPU_METHOD AMPTgPerSec "" RAT_FUNC "%6.4" "g/s" COEFFS 0 20 0 0 0 1 /end COMPU_METHOD
/begin COMPU_METHOD AngleCrS "" RAT_FUNC "%6.3" "deg CrS" COEFFS 0 45.5111111111 0 0 0 1 /end COMPU_METHOD
/begin COMPU_METHOD AngleStWhl "" RAT_FUNC "%6.4" "deg StWhl" COEFFS 0 32 0 0 0 1 /end COMPU_METHOD
/begin COMPU_METHOD CoEOMSwt_S16 "" RAT_FUNC "%7.6" "-" COEFFS 0 16384 0 0 0 1 /end COMPU_METHOD
/begin COMPU_METHOD ConvRpm "" RAT_FUNC "%6.4" "rpm/s" COEFFS 0 100 0 0 0 1 /end COMPU_METHOD
/begin COMPU_METHOD DDRCTime_ms "" RAT_FUNC "%5.0" "ms" COEFFS 0 1 0 0 0 10 /end COMPU_METHOD
/begin COMPU_METHOD Def_dez_sb_q1 "" RAT_FUNC "%3.1" "-" COEFFS 0 1 0 0 0 1 /end COMPU_METHOD
/begin COMPU_METHOD Def_dez_sw_q1 "" RAT_FUNC "%5.2" "-" COEFFS 0 1 0 0 0 1 /end COMPU_METHOD
/begin COMPU_METHOD Def_dez_ub_q1 "" RAT_FUNC "%3.1" "-" COEFFS 0 1 0 0 0 1 /end COMPU_METHOD
/begin COMPU_METHOD Def_dez_ul_q1 "" RAT_FUNC "%7.3" "-" COEFFS 0 1 0 0 0 1 /end COMPU_METHOD
/begin COMPU_METHOD Def_dez_uw_q1 "" RAT_FUNC "%5.2" "-" COEFFS 0 1 0 0 0 1 /end COMPU_METHOD
/begin COMPU_METHOD Def_fuel_ul_q0p000122 "" RAT_FUNC "%11.8" "" COEFFS 0 8192 0 0 0 1 /end COMPU_METHOD
/begin COMPU_METHOD Def_f_ub_b0p25 "" RAT_FUNC "%7.5" "-" COEFFS 0 1024 0 0 0 1 /end COMPU_METHOD
/begin COMPU_METHOD Def_f_ub_b1 "" RAT_FUNC "%6.4" "-" COEFFS 0 256 0 0 0 1 /end COMPU_METHOD
/begin COMPU_METHOD Def_f_ub_b2 "" RAT_FUNC "%6.4" "-" COEFFS 0 128 0 0 0 1 /end COMPU_METHOD
/begin COMPU_METHOD Def_f_ub_b32 "" RAT_FUNC "%5.2" "-" COEFFS 0 8 0 0 0 1 /end COMPU_METHOD
/begin COMPU_METHOD Def_f_ub_b8 "" RAT_FUNC "%5.3" "-" COEFFS 0 32 0 0 0 1 /end COMPU_METHOD
/begin COMPU_METHOD Def_f_uw_b1 "" RAT_FUNC "%14.10" "-" COEFFS 0 65536 0 0 0 1 /end COMPU_METHOD
/begin COMPU_METHOD Def_f_uw_b64 "" RAT_FUNC "%9.6" "-" COEFFS 0 1024 0 0 0 1 /end COMPU_METHOD
/begin COMPU_METHOD Def_f_uw_b8 "" RAT_FUNC "%9.7" "-" COEFFS 0 8192 0 0 0 1 /end COMPU_METHOD
/begin COMPU_METHOD Def_km_sw_q10 "" RAT_FUNC "%6.1" "km" COEFFS 0 0.1 0 0 0 1 /end COMPU_METHOD
/begin COMPU_METHOD Def_km_ub_q1000 "" RAT_FUNC "%5.0" "km" COEFFS 0 0.001 0 0 0 1 /end COMPU_METHOD
/begin COMPU_METHOD Def_km_uw_q10 "" RAT_FUNC "%5.1" "km" COEFFS 0 0.1 0 0 0 1 /end COMPU_METHOD
/begin COMPU_METHOD Def_lf_ub_q0p01 "" RAT_FUNC "%5.4" "-" COEFFS 0 100 0 0 0 1 /end COMPU_METHOD
/begin COMPU_METHOD Def_m_sw_q0p1 "" RAT_FUNC "%7.4" "Nm" COEFFS 0 10 0 0 0 1 /end COMPU_METHOD
/begin COMPU_METHOD Def_niv_ub_b75 "" RAT_FUNC "%5.2" "mm" COEFFS 0 3.41333333333333 0 0 0 1 /end COMPU_METHOD
/begin COMPU_METHOD Def_niv_ub_b8 "" RAT_FUNC "%5.3" "" COEFFS 0 32 0 0 0 1 /end COMPU_METHOD
/begin COMPU_METHOD Def_niv_ub_q0p1 "" RAT_FUNC "%5.3" "l" COEFFS 0 10 0 0 0 1 /end COMPU_METHOD
/begin COMPU_METHOD Def_n_sw_q1p0 "" RAT_FUNC "%5.2" "Upm" COEFFS 0 1 0 0 0 1 /end COMPU_METHOD
/begin COMPU_METHOD Def_russ_uw_q0p01 "" RAT_FUNC "%8.5" "mg" COEFFS 0 100 0 0 0 1 /end COMPU_METHOD
/begin COMPU_METHOD Def_st_ub_q1 "" RAT_FUNC "%3.1" "-" COEFFS 0 1 0 0 0 1 /end COMPU_METHOD
/begin COMPU_METHOD Def_td_ul_q1 "" RAT_FUNC "%7.3" "ms" COEFFS 0 1 0 0 0 1 /end COMPU_METHOD
/begin COMPU_METHOD Def_td_uw_q0p01 "" RAT_FUNC "%7.5" "s" COEFFS 0 100 0 0 0 1 /end COMPU_METHOD
/begin COMPU_METHOD Def_th_ub_q10 "" RAT_FUNC "%3.0" "h" COEFFS 0 0.1 0 0 0 1 /end COMPU_METHOD
/begin COMPU_METHOD Def_t_sw_q0p01 "" RAT_FUNC "%7.5" "°C" COEFFS 0 100 0 0 0 1 /end COMPU_METHOD
/begin COMPU_METHOD Def_t_sw_q0p1 "" RAT_FUNC "%6.3" "°C" COEFFS 0 10 0 0 0 1 /end COMPU_METHOD
/begin COMPU_METHOD Def_zw_sw_q0p1 "" RAT_FUNC "%6.3" "°" COEFFS 0 10 0 0 0 1 /end COMPU_METHOD
/begin COMPU_METHOD DFC_OneToOne "" RAT_FUNC "%6.0" "-" COEFFS 0 1 0 0 0 1 /end COMPU_METHOD
/begin COMPU_METHOD DtyCyc "" RAT_FUNC "%5.2" "%" COEFFS 0 100 0 0 0 1 /end COMPU_METHOD
/begin COMPU_METHOD EngN "" RAT_FUNC "%5.1" "rpm" COEFFS 0 2 0 0 0 1 /end COMPU_METHOD
/begin COMPU_METHOD EngN1 "" RAT_FUNC "%6.3" "rpm" COEFFS 0 2 0 0 0 1 /end COMPU_METHOD
/begin COMPU_METHOD EngTempFldSel "" TAB_VERB "%6.3" "" COMPU_TAB_REF EngTempFldSel /end COMPU_METHOD
/begin COMPU_VTAB EngTempFldSel "" TAB_VERB 4 0 "Coolant_Temperature" 1 "Oil_Temperature" 2 "EngDa_tEng" 3 "Chamberwall_Temperature" /end COMPU_VTAB
/begin COMPU_METHOD Eta3 "" RAT_FUNC "%6.4" "Nm/(mg/hub)" COEFFS 0 128 0 0 0 1 /end COMPU_METHOD
/begin COMPU_METHOD Fact "" RAT_FUNC "%6.5" "-" COEFFS 0 8192 0 0 0 1 /end COMPU_METHOD
/begin COMPU_METHOD Fact1 "" RAT_FUNC "%6.4" "-" COEFFS 0 128 0 0 0 1 /end COMPU_METHOD
/begin COMPU_METHOD Fact100 "" RAT_FUNC "%6.4" "-" COEFFS 0 100 0 0 0 1 /end COMPU_METHOD
/begin COMPU_METHOD InjMass "" RAT_FUNC "%5.2" "mg/hub" COEFFS 0 100 0 0 0 1 /end COMPU_METHOD
/begin COMPU_METHOD OneToOne "" RAT_FUNC "%6.0" "-" COEFFS 0 1 0 0 0 1 /end COMPU_METHOD
/begin COMPU_METHOD Period "" RAT_FUNC "%6.3" "ms" COEFFS 0 10 0 0 0 1 /end COMPU_METHOD
/begin COMPU_METHOD Prc "" RAT_FUNC "%6.4" "%" COEFFS 0 81.92 0 0 0 1 /end COMPU_METHOD
/begin COMPU_METHOD Ratio_045_COMPU "" RAT_FUNC "%6.4" "%" COEFFS 0 655.36 0 0 0 1 /end COMPU_METHOD
/begin COMPU_METHOD RmpAcc "" RAT_FUNC "%7.6" "deg" COEFFS 0 65536 0 0 0 1 /end COMPU_METHOD
/begin COMPU_METHOD RmpTemp "" RAT_FUNC "%6.4" "K/s" COEFFS 0 655.36 0 0 0 1 /end COMPU_METHOD
/begin COMPU_METHOD RmpTrq "" RAT_FUNC "%6.4" "Nm/s" COEFFS 0 655.36 0 0 0 1 /end COMPU_METHOD
/begin COMPU_METHOD RmpTrqPrpHigh "" RAT_FUNC "%6.4" "Nm/s" COEFFS 0 655.36 0 0 0 1 /end COMPU_METHOD
/begin COMPU_METHOD SCRCon_State_01 "" TAB_VERB "%6.3" "" COMPU_TAB_REF SCRCon_State_01 /end COMPU_METHOD
/begin COMPU_VTAB SCRCon_State_01 "" TAB_VERB 7 0 "COSCR_INIT" 1 "COSCR_STANDBY" 2 "COSCR_NOPRESSURECTL" 3 "COSCR_DIAG" 4 "COSCR_PRESSURECTL" 5 "COSCR_PRESSUREREDUCTION" 6 "COSCR_AFTERRUN" /end COMPU_VTAB
/begin COMPU_METHOD SCRCon_State_02 "" TAB_VERB "%6.3" "" COMPU_TAB_REF SCRCon_State_02 /end COMPU_METHOD
/begin COMPU_VTAB SCRCon_State_02 "" TAB_VERB 7 0 "COSCR_AFTERRUN_TEMPWAIT" 1 "COSCR_AFTERRUN_EMPTYING" 2 "COSCR_WAITING_FOR_SHUTOFF" 3 "COSCR_REFILL" 4 "COSCR_PRESSUREBUILDUP" 5 "COSCR_VENTILATION" 6 "COSCR_METERINGCONTROL" /end COMPU_VTAB
/begin COMPU_METHOD TempCels_100ms "" RAT_FUNC "%6.2" "deg C/s" COEFFS 0 1 0 0 0 1 /end COMPU_METHOD
/begin COMPU_METHOD TempDiff_Kelv "" RAT_FUNC "%4.1" "K" COEFFS 0 10 0 0 0 1 /end COMPU_METHOD
/begin COMPU_METHOD Temp_Cels "" RAT_FUNC "%5.1" "deg C" COEFFS 0 10 2731.4 0 0 1 /end COMPU_METHOD
/begin COMPU_METHOD TimeCoEOMRmp "" RAT_FUNC "%6.3" "s" COEFFS 0 0 1 0 0.0152587890625 0 /end COMPU_METHOD
/begin COMPU_METHOD TimeDeb "" RAT_FUNC "%5.0" "ms" COEFFS 0 0.1 0 0 0 1 /end COMPU_METHOD
/begin COMPU_METHOD TimeDelay_ms "" RAT_FUNC "%12.1" "ms" COEFFS 0 0 1 0 2.3283064365387e-007 0 /end COMPU_METHOD
/begin COMPU_METHOD TimeDelay_s "" RAT_FUNC "%12.4" "s" COEFFS 0 0 1 0 0.00023283064365387 0 /end COMPU_METHOD
/begin COMPU_METHOD TimeDT "" RAT_FUNC "%6.2" "us" COEFFS 0 1 0 0 0 1 /end COMPU_METHOD
/begin COMPU_METHOD TimeRed "" RAT_FUNC "%6.3" "s" COEFFS 0 6.25 0 0 0 1 /end COMPU_METHOD
/begin COMPU_METHOD Time_DynTst "" RAT_FUNC "%6.2" "s" COEFFS 0 0.390625 0 0 0 1 /end COMPU_METHOD
/begin COMPU_METHOD Time_ms "" RAT_FUNC "%5.0" "ms" COEFFS 0 0.1 0 0 0 1 /end COMPU_METHOD
/begin COMPU_METHOD Time_s "" RAT_FUNC "%5.2" "s" COEFFS 0 100 0 0 0 1 /end COMPU_METHOD
/begin COMPU_METHOD Time_s_float "" RAT_FUNC "%6.2" "s" COEFFS 0 1 0 0 0 1 /end COMPU_METHOD
/begin COMPU_METHOD TransR "" RAT_FUNC "%4.2" "-" COEFFS 0 100 0 0 0 1 /end COMPU_METHOD
/begin COMPU_METHOD Trq "" RAT_FUNC "%5.1" "Nm" COEFFS 0 10 0 0 0 1 /end COMPU_METHOD
/begin COMPU_METHOD TrqPrp "" RAT_FUNC "%5.1" "Nm" COEFFS 0 0.625 0 0 0 1 /end COMPU_METHOD
/begin COMPU_METHOD TrqPrpHigh "" RAT_FUNC "%5.1" "Nm" COEFFS 0 10 0 0 0 1 /end COMPU_METHOD
/begin COMPU_METHOD TrqToNSqr "" RAT_FUNC "%10.9" "-" COEFFS 0 10000000 0 0 0 1 /end COMPU_METHOD
/begin COMPU_METHOD Vel "" RAT_FUNC "%5.2" "km/h" COEFFS 0 100 0 0 0 1 /end COMPU_METHOD
/begin COMPU_METHOD VelToN "" RAT_FUNC "%8.7" "(km/h)/rpm" COEFFS 0 100000 0 0 0 1 /end COMPU_METHOD
/begin COMPU_METHOD Volt "" RAT_FUNC "%6.1" "mV" COEFFS 0 5 0 0 0 1 /end COMPU_METHOD
/begin COMPU_METHOD default "" RAT_FUNC "%6.2" "" COEFFS 0 1 0 0 0 1 /end COMPU_METHOD
/begin COMPU_METHOD defaultAscii "" RAT_FUNC "%6.2" "" COEFFS 0 1 0 0 0 1 /end COMPU_METHOD
/begin RECORD_LAYOUT CurTKL_SW_VV_UB NO_AXIS_PTS_X 1 UBYTE RESERVED 2 BYTE AXIS_PTS_X 3 SWORD INDEX_INCR DIRECT FNC_VALUES 4 UBYTE COLUMN_DIR DIRECT /end RECORD_LAYOUT
/begin RECORD_LAYOUT CurTKL_SW_VV_UW NO_AXIS_PTS_X 1 UBYTE RESERVED 2 BYTE AXIS_PTS_X 3 SWORD INDEX_INCR DIRECT FNC_VALUES 4 UWORD COLUMN_DIR DIRECT /end RECORD_LAYOUT
/begin RECORD_LAYOUT CurTKL_UB_VV_UB NO_AXIS_PTS_X 1 UBYTE RESERVED 2 BYTE AXIS_PTS_X 3 UBYTE INDEX_INCR DIRECT FNC_VALUES 4 UBYTE COLUMN_DIR DIRECT /end RECORD_LAYOUT
/begin RECORD_LAYOUT CurTKL_UW_VV_UB NO_AXIS_PTS_X 1 UBYTE RESERVED 2 BYTE AXIS_PTS_X 3 UWORD INDEX_INCR DIRECT FNC_VALUES 4 UBYTE COLUMN_DIR DIRECT /end RECORD_LAYOUT
/begin RECORD_LAYOUT CurTKL_UW_VV_UW NO_AXIS_PTS_X 1 UBYTE RESERVED 2 BYTE AXIS_PTS_X 3 UWORD INDEX_INCR DIRECT FNC_VALUES 4 UWORD COLUMN_DIR DIRECT /end RECORD_LAYOUT
/begin RECORD_LAYOUT Cur_Xs16Ws16 NO_AXIS_PTS_X 1 SWORD AXIS_PTS_X 2 SWORD INDEX_INCR DIRECT FNC_VALUES 3 SWORD COLUMN_DIR DIRECT /end RECORD_LAYOUT
/begin RECORD_LAYOUT Gkl_Ws16 FNC_VALUES 1 SWORD COLUMN_DIR DIRECT /end RECORD_LAYOUT
/begin RECORD_LAYOUT GSst_Xs16 NO_AXIS_PTS_X 1 SWORD AXIS_PTS_X 2 SWORD INDEX_INCR DIRECT /end RECORD_LAYOUT
/begin RECORD_LAYOUT Kf_Xs16_Ys16_Ws16 NO_AXIS_PTS_X 1 SWORD NO_AXIS_PTS_Y 2 SWORD AXIS_PTS_X 3 SWORD INDEX_INCR DIRECT AXIS_PTS_Y 4 SWORD INDEX_INCR DIRECT FNC_VALUES 5 SWORD COLUMN_DIR DIRECT /end RECORD_LAYOUT
/begin RECORD_LAYOUT Kl_Xs16_Ws16 NO_AXIS_PTS_X 1 SWORD AXIS_PTS_X 2 SWORD INDEX_INCR DIRECT FNC_VALUES 3 SWORD COLUMN_DIR DIRECT /end RECORD_LAYOUT
/begin RECORD_LAYOUT Kw_Ws16 FNC_VALUES 1 SWORD COLUMN_DIR DIRECT /end RECORD_LAYOUT
/begin RECORD_LAYOUT Kw_Ws32 FNC_VALUES 1 SLONG COLUMN_DIR DIRECT /end RECORD_LAYOUT
/begin RECORD_LAYOUT Kw_Wu16 FNC_VALUES 1 UWORD COLUMN_DIR DIRECT /end RECORD_LAYOUT
/begin RECORD_LAYOUT Kw_Wu32 FNC_VALUES 1 ULONG COLUMN_DIR DIRECT /end RECORD_LAYOUT
/begin RECORD_LAYOUT Kw_Wu8 FNC_VALUES 1 UBYTE COLUMN_DIR DIRECT /end RECORD_LAYOUT
/begin RECORD_LAYOUT MapTKF_SW_SW_UW NO_AXIS_PTS_X 1 UBYTE NO_AXIS_PTS_Y 2 UBYTE AXIS_PTS_X 3 SWORD INDEX_INCR DIRECT AXIS_PTS_Y 4 SWORD INDEX_INCR DIRECT FNC_VALUES 5 UWORD COLUMN_DIR DIRECT /end RECORD_LAYOUT
/begin RECORD_LAYOUT MapTKF_UW_SW_UB NO_AXIS_PTS_X 1 UBYTE NO_AXIS_PTS_Y 2 UBYTE AXIS_PTS_X 3 SWORD INDEX_INCR DIRECT AXIS_PTS_Y 4 UWORD INDEX_INCR DIRECT FNC_VALUES 5 UBYTE COLUMN_DIR DIRECT /end RECORD_LAYOUT
/begin RECORD_LAYOUT Map_Xs16Ys16Ws16 NO_AXIS_PTS_X 1 SWORD NO_AXIS_PTS_Y 2 SWORD AXIS_PTS_X 3 SWORD INDEX_INCR DIRECT AXIS_PTS_Y 4 SWORD INDEX_INCR DIRECT FNC_VALUES 5 SWORD COLUMN_DIR DIRECT /end RECORD_LAYOUT
/begin RECORD_LAYOUT ValA_Ws16 FNC_VALUES 1 SWORD COLUMN_DIR DIRECT /end RECORD_LAYOUT
/begin RECORD_LAYOUT ValA_Wu8 FNC_VALUES 1 UBYTE COLUMN_DIR DIRECT /end RECORD_LAYOUT
/begin RECORD_LAYOUT Val_Wr32 FNC_VALUES 1 FLOAT32_IEEE COLUMN_DIR DIRECT /end RECORD_LAYOUT
/begin RECORD_LAYOUT Val_Ws16 FNC_VALUES 1 SWORD COLUMN_DIR DIRECT /end RECORD_LAYOUT
/begin RECORD_LAYOUT Val_Ws32 FNC_VALUES 1 SLONG COLUMN_DIR DIRECT /end RECORD_LAYOUT
/begin RECORD_LAYOUT Val_Wu16 FNC_VALUES 1 UWORD COLUMN_DIR DIRECT /end RECORD_LAYOUT
/begin RECORD_LAYOUT Val_Wu32 FNC_VALUES 1 ULONG COLUMN_DIR DIRECT /end RECORD_LAYOUT
/begin RECORD_LAYOUT Val_Wu8 FNC_VALUES 1 UBYTE COLUMN_DIR DIRECT /end RECORD_LAYOUT
/end MODULE
/end PROJECT

ASAP2_VERSION 1 4
/begin PROJECT P_574 "EDC17_CP09"
/begin HEADER "" VERSION "V8KB" PROJECT_NO P_574 /end HEADER
/begin MODULE DIM ""
/begin MOD_COMMON "" BYTE_ORDER MSB_LAST ALIGNMENT_BYTE 1 ALIGNMENT_WORD 2 ALIGNMENT_LONG 4 ALIGNMENT_FLOAT32_IEEE 4 /end MOD_COMMON
/begin CHARACTERISTIC DFES_DbLv.DFC_Layer_PMBATTMax_C "DFES/Entprelllevel zur Erstellung eines DFES Eintrages für Prüfung DFC_Layer_PMBATTMax" VALUE 0x80029C69 Val_Wu8 15.00 DFES_OneToOne 0.00 15.00 EXTENDED_LIMITS 0.00 255.0 /end CHARACTERISTIC
/begin CHARACTERISTIC DFES_DbLv.DFC_Layer_PMBATTMin_C "DFES/Entprelllevel zur Erstellung eines DFES Eintrages für Prüfung DFC_Layer_PMBATTMin" VALUE 0x80029C6A Val_Wu8 15.00 DFES_OneToOne 0.00 15.00 EXTENDED_LIMITS 0.00 255.0 /end CHARACTERISTIC
/begin CHARACTERISTIC DFES_DbLv.DFC_Layer_PMBATTNpl_C "DFES/Entprelllevel zur Erstellung eines DFES Eintrages für Prüfung DFC_Layer_PMBATTNpl" VALUE 0x80029C6B Val_Wu8 15.00 DFES_OneToOne 0.00 15.00 EXTENDED_LIMITS 0.00 255.0 /end CHARACTERISTIC
/begin CHARACTERISTIC DFES_DbLv.DFC_Layer_PMBATTSig_C "DFES/Entprelllevel zur Erstellung eines DFES Eintrages für Prüfung DFC_Layer_PMBATTSig" VALUE 0x80029C6C Val_Wu8 15.00 DFES_OneToOne 0.00 15.00 EXTENDED_LIMITS 0.00 255.0 /end CHARACTERISTIC
/begin CHARACTERISTIC DFES_DbLv.DFC_Layer_PMBNMax_C "DFES/Entprelllevel zur Erstellung eines DFES Eintrages für Prüfung DFC_Layer_PMBNMax" VALUE 0x80029C6D Val_Wu8 15.00 DFES_OneToOne 0.00 15.00 EXTENDED_LIMITS 0.00 255.0 /end CHARACTERISTIC
/begin CHARACTERISTIC DFES_DbLv.DFC_Layer_PMBNMin_C "DFES/Entprelllevel zur Erstellung eines DFES Eintrages für Prüfung DFC_Layer_PMBNMin" VALUE 0x80029C6E Val_Wu8 15.00 DFES_OneToOne 0.00 15.00 EXTENDED_LIMITS 0.00 255.0 /end CHARACTERISTIC
/begin CHARACTERISTIC DFES_DbLv.DFC_Layer_PMBNNpl_C "DFES/Entprelllevel zur Erstellung eines DFES Eintrages für Prüfung DFC_Layer_PMBNNpl" VALUE 0x80029C6F Val_Wu8 15.00 DFES_OneToOne 0.00 15.00 EXTENDED_LIMITS 0.00 255.0 /end CHARACTERISTIC
/begin CHARACTERISTIC DFES_DbLv.DFC_Layer_PMBNSig_C "DFES/Entprelllevel zur Erstellung eines DFES Eintrages für Prüfung DFC_Layer_PMBNSig" VALUE 0x80029C70 Val_Wu8 15.00 DFES_OneToOne 0.00 15.00 EXTENDED_LIMITS 0.00 255.0 /end CHARACTERISTIC
/begin CHARACTERISTIC DFES_DbLv.DFC_Layer_PMRUHVERLMax_C "DFES/Entprelllevel zur Erstellung eines DFES Eintrages für Prüfung DFC_Layer_PMRUHVERLMax" VALUE 0x80029C71 Val_Wu8 15.00 DFES_OneToOne 0.00 15.00 EXTENDED_LIMITS 0.00 255.0 /end CHARACTERISTIC
/begin CHARACTERISTIC DFES_DbLv.DFC_Layer_PMRUHVERLMin_C "DFES/Entprelllevel zur Erstellung eines DFES Eintrages für Prüfung DFC_Layer_PMRUHVERLMin" VALUE 0x80029C72 Val_Wu8 15.00 DFES_OneToOne 0.00 15.00 EXTENDED_LIMITS 0.00 255.0 /end CHARACTERISTIC
/begin CHARACTERISTIC DFES_DbLv.DFC_Layer_PMRUHVERLNpl_C "DFES/Entprelllevel zur Erstellung eines DFES Eintrages für Prüfung DFC_Layer_PMRUHVERLNpl" VALUE 0x80029C73 Val_Wu8 15.00 DFES_OneToOne 0.00 15.00 EXTENDED_LIMITS 0.00 255.0 /end CHARACTERISTIC
/begin CHARACTERISTIC DFES_DbLv.DFC_Layer_PMRUHVERLSig_C "DFES/Entprelllevel zur Erstellung eines DFES Eintrages für Prüfung DFC_Layer_PMRUHVERLSig" VALUE 0x80029C74 Val_Wu8 15.00 DFES_OneToOne 0.00 15.00 EXTENDED_LIMITS 0.00 255.0 /end CHARACTERISTIC
/begin CHARACTERISTIC DFES_DbLv.DFC_Layer_QLTMax_C "DFES/Entprelllevel zur Erstellung eines DFES Eintrages für Prüfung DFC_Layer_QLTMax" VALUE 0x80029C75 Val_Wu8 15.00 DFES_OneToOne 0.00 15.00 EXTENDED_LIMITS 0.00 255.0 /end CHARACTERISTIC
/begin CHARACTERISTIC DFES_DbLv.DFC_Layer_QLTMin_C "DFES/Entprelllevel zur Erstellung eines DFES Eintrages für Prüfung DFC_Layer_QLTMin" VALUE 0x80029C76 Val_Wu8 15.00 DFES_OneToOne 0.00 15.00 EXTENDED_LIMITS 0.00 255.0 /end CHARACTERISTIC
/begin CHARACTERISTIC DFES_DbLv.DFC_Layer_QLTNpl_C "DFES/Entprelllevel zur Erstellung eines DFES Eintrages für Prüfung DFC_Layer_QLTNpl" VALUE 0x80029C77 Val_Wu8 15.00 DFES_OneToOne 0.00 15.00 EXTENDED_LIMITS 0.00 255.0 /end CHARACTERISTIC
/begin CHARACTERISTIC DFES_DbLv.DFC_Layer_QLTSig_C "DFES/Entprelllevel zur Erstellung eines DFES Eintrages für Prüfung DFC_Layer_QLTSig" VALUE 0x80029C78 Val_Wu8 15.00 DFES_OneToOne 0.00 15.00 EXTENDED_LIMITS 0.00 255.0 /end CHARACTERISTIC
/begin CHARACTERISTIC DFES_DbLv.DFC_Layer_TOENSMax_C "DFES/Entprelllevel zur Erstellung eines DFES Eintrages für Prüfung DFC_Layer_TOENSMax" VALUE 0x80029C79 Val_Wu8 15.00 DFES_OneToOne 0.00 15.00 EXTENDED_LIMITS 0.00 255.0 /end CHARACTERISTIC
/begin CHARACTERISTIC DFES_DbLv.DFC_Layer_TOENSMin_C "DFES/Entprelllevel zur Erstellung eines DFES Eintrages für Prüfung DFC_Layer_TOENSMin" VALUE 0x80029C7A Val_Wu8 15.00 DFES_OneToOne 0.00 15.00 EXTENDED_LIMITS 0.00 255.0 /end CHARACTERISTIC
/begin CHARACTERISTIC DFES_DbLv.DFC_Layer_TOENSNpl_C "DFES/Entprelllevel zur Erstellung eines DFES Eintrages für Prüfung DFC_Layer_TOENSNpl" VALUE 0x80029C7B Val_Wu8 15.00 DFES_OneToOne 0.00 15.00 EXTENDED_LIMITS 0.00 255.0 /end CHARACTERISTIC
/begin CHARACTERISTIC DFES_DbLv.DFC_Layer_TOENSSig_C "DFES/Entprelllevel zur Erstellung eines DFES Eintrages für Prüfung DFC_Layer_TOENSSig" VALUE 0x80029C7C Val_Wu8 15.00 DFES_OneToOne 0.00 15.00 EXTENDED_LIMITS 0.00 255.0 /end CHARACTERISTIC
/begin CHARACTERISTIC DFES_DbLv.DFC_MonLimCurr_C "DFES/Entprelllevel zur Erstellung eines DFES Eintrages für Prüfung DFC_MonLimCurr" VALUE 0x80029C7D Val_Wu8 15.00 DFES_OneToOne 0.00 15.00 EXTENDED_LIMITS 0.00 255.0 /end CHARACTERISTIC
/begin CHARACTERISTIC DFES_DbLv.DFC_MonLimLead_C "DFES/Entprelllevel zur Erstellung eines DFES Eintrages für Prüfung DFC_MonLimLead" VALUE 0x80029C7E Val_Wu8 15.00 DFES_OneToOne 0.00 15.00 EXTENDED_LIMITS 0.00 255.0 /end CHARACTERISTIC
/begin CHARACTERISTIC DFES_DbLv.DFC_MonLimSet_C "DFES/Entprelllevel zur Erstellung eines DFES Eintrages für Prüfung DFC_MonLimSet" VALUE 0x80029C7F Val_Wu8 15.00 DFES_OneToOne 0.00 15.00 EXTENDED_LIMITS 0.00 255.0 /end CHARACTERISTIC
/begin CHARACTERISTIC DFES_DbLv.DFC_NSCDsNOxOfsMax_C "DFES/Entprelllevel zur Erstellung eines DFES Eintrages für Prüfung DFC_NSCDsNOxOfsMax" VALUE 0x80029C80 Val_Wu8 15.00 DFES_OneToOne 0.00 15.00 EXTENDED_LIMITS 0.00 255.0 /end CHARACTERISTIC
/begin CHARACTERISTIC DFES_DbLv.DFC_NSCDsNOxOfsMin_C "DFES/Entprelllevel zur Erstellung eines DFES Eintrages für Prüfung DFC_NSCDsNOxOfsMin" VALUE 0x80029C81 Val_Wu8 15.00 DFES_OneToOne 0.00 15.00 EXTENDED_LIMITS 0.00 255.0 /end CHARACTERISTIC
/begin CHARACTERISTIC DFES_DbLv.DFC_NSCDsNOxPlausMin_C "DFES/Entprelllevel zur Erstellung eines DFES Eintrages für Prüfung DFC_NSCDsNOxPlausMin" VALUE 0x80029C82 Val_Wu8 15.00 DFES_OneToOne 0.00 15.00 EXTENDED_LIMITS 0.00 255.0 /end CHARACTERISTIC
/begin CHARACTERISTIC DFES_DbLv.DFC_NoCat2DsNOxOfsMax_C "DFES/Entprelllevel zur Erstellung eines DFES Eintrages für Prüfung DFC_NoCat2DsNOxOfsMax" VALUE 0x80029C83 Val_Wu8 15.00 DFES_OneToOne 0.00 15.00 EXTENDED_LIMITS 0.00 255.0 /end CHARACTERISTIC
/begin CHARACTERISTIC DFES_DbLv.DFC_NoCat2DsNOxOfsMin_C "DFES/Entprelllevel zur Erstellung eines DFES Eintrages für Prüfung DFC_NoCat2DsNOxOfsMin" VALUE 0x80029C84 Val_Wu8 15.00 DFES_OneToOne 0.00 15.00 EXTENDED_LIMITS 0.00 255.0 /end CHARACTERISTIC
/begin CHARACTERISTIC DFES_DbLv.DFC_NoCat2DsNOxPlausMin_C "DFES/Entprelllevel zur Erstellung eines DFES Eintrages für Prüfung DFC_NoCat2DsNOxPlausMin" VALUE 0x80029C85 Val_Wu8 15.00 DFES_OneToOne 0.00 15.00 EXTENDED_LIMITS 0.00 255.0 /end CHARACTERISTIC
/begin CHARACTERISTIC DFES_DbLv.DFC_PCVNoStrt_C "DFES/Entprelllevel zur Erstellung eines DFES Eintrages für Prüfung DFC_PCVNoStrt" VALUE 0x80029C86 Val_Wu8 15.00 DFES_OneToOne 0.00 15.00 EXTENDED_LIMITS 0.00 255.0 /end CHARACTERISTIC
/begin CHARACTERISTIC DFES_DbLv.DFC_RailPGradMon_C "DFES/Entprelllevel zur Erstellung eines DFES Eintrages für Prüfung DFC_RailPGradMon" VALUE 0x80029C87 Val_Wu8 15.00 DFES_OneToOne 0.00 15.00 EXTENDED_LIMITS 0.00 255.0 /end CHARACTERISTIC
/begin CHARACTERISTIC DFES_DbLv.DFC_SCRPODPresBuildUp_C "DFES/Entprelllevel zur Erstellung eines DFES Eintrages für Prüfung DFC_SCRPODPresBuildUp" VALUE 0x80029C88 Val_Wu8 15.00 DFES_OneToOne 0.00 15.00 EXTENDED_LIMITS 0.00 255.0 /end CHARACTERISTIC
/begin CHARACTERISTIC DFES_DbLv.DFC_AFSDrftIdlAdjVal_C "DFES/Entprelllevel zur Erstellung eines DFES Eintrages für Prüfung DFC_AFSDrftIdlAdjVal" VALUE 0x80029C89 Val_Wu8 15.00 DFES_OneToOne 0.00 15.00 EXTENDED_LIMITS 0.00 255.0 /end CHARACTERISTIC
/begin CHARACTERISTIC DFES_DbLv.DFC_AFSDrftLdAdjVal_C "DFES/Entprelllevel zur Erstellung eines DFES Eintrages für Prüfung DFC_AFSDrftLdAdjVal" VALUE 0x80029C8A Val_Wu8 15.00 DFES_OneToOne 0.00 15.00 EXTENDED_LIMITS 0.00 255.0 /end CHARACTERISTIC
/begin CHARACTERISTIC DFES_DbLv.DFC_AdcIADC0Cal_C "DFES/Entprelllevel zur Erstellung eines DFES Eintrages für Prüfung DFC_AdcIADC0Cal" VALUE 0x80029C8B Val_Wu8 15.00 DFES_OneToOne 0.00 15.00 EXTENDED_LIMITS 0.00 255.0 /end CHARACTERISTIC
/begin CHARACTERISTIC DFES_DbLv.DFC_AdcIADC0Conv_C "DFES/Entprelllevel zur Erstellung eines DFES Eintrages für Prüfung DFC_AdcIADC0Conv" VALUE 0x80029C8C Val_Wu8 15.00 DFES_OneToOne 0.00 15.00 EXTENDED_LIMITS 0.00 255.0 /end CHARACTERISTIC
/begin CHARACTERISTIC DFES_DbLv.DFC_AdcIADC1Cal_C "DFES/Entprelllevel zur Erstellung eines DFES Eintrages für Prüfung DFC_AdcIADC1Cal" VALUE 0x80029C8D Val_Wu8 15.00 DFES_OneToOne 0.00 15.00 EXTENDED_LIMITS 0.00 255.0 /end CHARACTERISTIC
/begin CHARACTERISTIC DFES_DbLv.DFC_AdcIADC1Conv_C "DFES/Entprelllevel zur Erstellung eines DFES Eintrages für Prüfung DFC_AdcIADC1Conv" VALUE 0x80029C8E Val_Wu8 15.00 DFES_OneToOne 0.00 15.00 EXTENDED_LIMITS 0.00 255.0 /end CHARACTERISTIC
/begin CHARACTERISTIC DFES_DbLv.DFC_CmbChbMisfireMax_0_C "DFES/Entprelllevel zur Erstellung eines DFES Eintrages für Prüfung DFC_CmbChbMisfireMax_0" VALUE 0x80029C8F Val_Wu8 15.00 DFES_OneToOne 0.00 15.00 EXTENDED_LIMITS 0.00 255.0 /end CHARACTERISTIC
/begin CHARACTERISTIC DFES_DbLv.DFC_CmbChbMisfireMax_1_C "DFES/Entprelllevel zur Erstellung eines DFES Eintrages für Prüfung DFC_CmbChbMisfireMax_1" VALUE 0x80029C90 Val_Wu8 15.00 DFES_OneToOne 0.00 15.00 EXTENDED_LIMITS 0.00 255.0 /end CHARACTERISTIC
/begin CHARACTERISTIC DFES_DbLv.DFC_CmbChbMisfireMax_2_C "DFES/Entprelllevel zur Erstellung eines DFES Eintrages für Prüfung DFC_CmbChbMisfireMax_2" VALUE 0x80029C91 Val_Wu8 15.00 DFES_OneToOne 0.00 15.00 EXTENDED_LIMITS 0.00 255.0 /end CHARACTERISTIC
/begin CHARACTERISTIC DFES_DbLv.DFC_CmbChbMisfireMax_3_C "DFES/Entprelllevel zur Erstellung eines DFES Eintrages für Prüfung DFC_CmbChbMisfireMax_3" VALUE 0x80029C92 Val_Wu8 15.00 DFES_OneToOne 0.00 15.00 EXTENDED_LIMITS 0.00 255.0 /end CHARACTERISTIC
/begin CHARACTERISTIC DFES_DbLv.DFC_CmbChbMisfireMax_4_C "DFES/Entprelllevel zur Erstellung eines DFES Eintrages für Prüfung DFC_CmbChbMisfireMax_4" VALUE 0x80029C93 Val_Wu8 15.00 DFES_OneToOne 0.00 15.00 EXTENDED_LIMITS 0.00 255.0 /end CHARACTERISTIC
/begin CHARACTERISTIC DFES_DbLv.DFC_CmbChbMisfireMax_5_C "DFES/Entprelllevel zur Erstellung eines DFES Eintrages für Prüfung DFC_CmbChbMisfireMax_5" VALUE 0x80029C94 Val_Wu8 15.00 DFES_OneToOne 0.00 15.00 EXTENDED_LIMITS 0.00 255.0 /end CHARACTERISTIC
/begin CHARACTERISTIC DFES_DbLv.DFC_CmbChbMisfireMul_C "DFES/Entprelllevel zur Erstellung eines DFES Eintrages für Prüfung DFC_CmbChbMisfireMul" VALUE 0x80029C95 Val_Wu8 15.00 DFES_OneToOne 0.00 15.00 EXTENDED_LIMITS 0.00 255.0 /end CHARACTERISTIC
/begin CHARACTERISTIC DFES_DbLv.DFC_EGRVlvLPOfsNeutr_C "DFES/" VALUE 0x80029C96 Val_Wu8 15.00 DFES_OneToOne 0.00 15.00 EXTENDED_LIMITS 0.00 255.0 /end CHARACTERISTIC
/begin CHARACTERISTIC DFES_DbLv.DFC_EGRVlvOfsNeutr_C "DFES/Entprelllevel zur Erstellung eines DFES Eintrages für Prüfung DFC_EGRVlvOfsNeutr" VALUE 0x80029C97 Val_Wu8 15.00 DFES_OneToOne 0.00 15.00 EXTENDED_LIMITS 0.00 255.0 /end CHARACTERISTIC
/begin CHARACTERISTIC DFES_DbLv.DFC_FMAErrModMax_C "DFES/Entprelllevel zur Erstellung eines DFES Eintrages für Prüfung DFC_FMAErrModMax" VALUE 0x80029C98 Val_Wu8 15.00 DFES_OneToOne 0.00 15.00 EXTENDED_LIMITS 0.00 255.0 /end CHARACTERISTIC
/begin CHARACTERISTIC DFES_DbLv.DFC_FMAErrModMin_C "DFES/Entprelllevel zur Erstellung eines DFES Eintrages für Prüfung DFC_FMAErrModMin" VALUE 0x80029C99 Val_Wu8 15.00 DFES_OneToOne 0.00 15.00 EXTENDED_LIMITS 0.00 255.0 /end CHARACTERISTIC
/begin CHARACTERISTIC DFES_DbLv.DFC_FlSysTnkLo_C "DFES/Entprelllevel zur Erstellung eines DFES Eintrages für Prüfung DFC_FlSysTnkLo" VALUE 0x80029C9A Val_Wu8 15.00 DFES_OneToOne 0.00 15.00 EXTENDED_LIMITS 0.00 255.0 /end CHARACTERISTIC
/begin CHARACTERISTIC DFES_DbLv.DFC_GbxNPosPlaus_C "DFES/Entprelllevel zur Erstellung eines DFES Eintrages für Prüfung DFC_GbxNPosPlaus" VALUE 0x80029C9B Val_Wu8 15.00 DFES_OneToOne 0.00 15.00 EXTENDED_LIMITS 0.00 255.0 /end CHARACTERISTIC
/begin CHARACTERISTIC DFES_DbLv.DFC_I14229_ROETst_Appl_C "DFES/" VALUE 0x80029C9C Val_Wu8 15.00 DFES_OneToOne 0.00 15.00 EXTENDED_LIMITS 0.00 255.0 /end CHARACTERISTIC
/begin CHARACTERISTIC DFES_DbLv.DFC_I14229_ROETst_Netw_C "DFES/" VALUE 0x80029C9D Val_Wu8 15.00 DFES_OneToOne 0.00 15.00 EXTENDED_LIMITS 0.00 255.0 /end CHARACTERISTIC
/begin CHARACTERISTIC DFES_DbLv.DFC_I14229_ROE_BufFull_C "DFES/" VALUE 0x80029C9E Val_Wu8 15.00 DFES_OneToOne 0.00 15.00 EXTENDED_LIMITS 0.00 255.0 /end CHARACTERISTIC
/begin CHARACTERISTIC DFES_DbLv.DFC_IVAdjDiaIVAdj_C "DFES/Entprelllevel zur Erstellung eines DFES Eintrages für Prüfung DFC_IVAdjDiaIVAdj" VALUE 0x80029C9F Val_Wu8 15.00 DFES_OneToOne 0.00 15.00 EXTENDED_LIMITS 0.00 255.0 /end CHARACTERISTIC
/begin CHARACTERISTIC DFES_DbLv.DFC_IVAdjIVA_0_C "DFES/Entprelllevel zur Erstellung eines DFES Eintrages für Prüfung DFC_IVAdjIVA_0" VALUE 0x80029CA0 Val_Wu8 15.00 DFES_OneToOne 0.00 15.00 EXTENDED_LIMITS 0.00 255.0 /end CHARACTERISTIC
/begin CHARACTERISTIC DFES_DbLv.DFC_IVAdjIVA_1_C "DFES/Entprelllevel zur Erstellung eines DFES Eintrages für Prüfung DFC_IVAdjIVA_1" VALUE 0x80029CA1 Val_Wu8 15.00 DFES_OneToOne 0.00 15.00 EXTENDED_LIMITS 0.00 255.0 /end CHARACTERISTIC
/begin CHARACTERISTIC DFES_DbLv.DFC_IVAdjIVA_2_C "DFES/Entprelllevel zur Erstellung eines DFES Eintrages für Prüfung DFC_IVAdjIVA_2" VALUE 0x80029CA2 Val_Wu8 15.00 DFES_OneToOne 0.00 15.00 EXTENDED_LIMITS 0.00 255.0 /end CHARACTERISTIC
/begin CHARACTERISTIC DFES_DbLv.DFC_IVAdjIVA_3_C "DFES/Entprelllevel zur Erstellung eines DFES Eintrages für Prüfung DFC_IVAdjIVA_3" VALUE 0x80029CA3 Val_Wu8 15.00 DFES_OneToOne 0.00 15.00 EXTENDED_LIMITS 0.00 255.0 /end CHARACTERISTIC
/begin CHARACTERISTIC DFES_DbLv.DFC_IVAdjIVA_4_C "DFES/Entprelllevel zur Erstellung eines DFES Eintrages für Prüfung DFC_IVAdjIVA_4" VALUE 0x80029CA4 Val_Wu8 15.00 DFES_OneToOne 0.00 15.00 EXTENDED_LIMITS 0.00 255.0 /end CHARACTERISTIC
/begin CHARACTERISTIC DFES_DbLv.DFC_IVAdjIVA_5_C "DFES/Entprelllevel zur Erstellung eines DFES Eintrages für Prüfung DFC_IVAdjIVA_5" VALUE 0x80029CA5 Val_Wu8 15.00 DFES_OneToOne 0.00 15.00 EXTENDED_LIMITS 0.00 255.0 /end CHARACTERISTIC
/begin CHARACTERISTIC DFES_DbLv.DFC_IVPSplyDCDCOff_0_C "DFES/Entprelllevel zur Erstellung eines DFES Eintrages für Prüfung DFC_IVPSplyDCDCOff_0" VALUE 0x80029CA6 Val_Wu8 15.00 DFES_OneToOne 0.00 15.00 EXTENDED_LIMITS 0.00 255.0 /end CHARACTERISTIC
/begin CHARACTERISTIC DFES_DbLv.DFC_IVPSplyDCDCOff_1_C "DFES/Entprelllevel zur Erstellung eines DFES Eintrages für Prüfung DFC_IVPSplyDCDCOff_1" VALUE 0x80029CA7 Val_Wu8 15.00 DFES_OneToOne 0.00 15.00 EXTENDED_LIMITS 0.00 255.0 /end CHARACTERISTIC
/begin CHARACTERISTIC DFES_DbLv.DFC_IVPSplyDCDCOff_2_C "DFES/Entprelllevel zur Erstellung eines DFES Eintrages für Prüfung DFC_IVPSplyDCDCOff_2" VALUE 0x80029CA8 Val_Wu8 15.00 DFES_OneToOne 0.00 15.00 EXTENDED_LIMITS 0.00 255.0 /end CHARACTERISTIC
/begin CHARACTERISTIC DFES_DbLv.DFC_IVPSplyDCDCOff_3_C "DFES/Entprelllevel zur Erstellung eines DFES Eintrages für Prüfung DFC_IVPSplyDCDCOff_3" VALUE 0x80029CA9 Val_Wu8 15.00 DFES_OneToOne 0.00 15.00 EXTENDED_LIMITS 0.00 255.0 /end CHARACTERISTIC
/begin CHARACTERISTIC DFES_DbLv.DFC_InjCtlAdjQntEEPCS_C "DFES/Entprelllevel zur Erstellung eines DFES Eintrages für Prüfung DFC_InjCtlAdjQntEEPCS" VALUE 0x80029CAA Val_Wu8 15.00 DFES_OneToOne 0.00 15.00 EXTENDED_LIMITS 0.00 255.0 /end CHARACTERISTIC
/begin CHARACTERISTIC DFES_DbLv.DFC_LSUSPISig_C "DFES/Entprelllevel zur Erstellung eines DFES Eintrages für Prüfung DFC_LSUSPISig" VALUE 0x80029CAB Val_Wu8 15.00 DFES_OneToOne 0.00 15.00 EXTENDED_LIMITS 0.00 255.0 /end CHARACTERISTIC
/begin CHARACTERISTIC DFES_DbLv.DFC_Layer_Dummy_C "DFES/Entprelllevel zur Erstellung eines DFES Eintrages für Prüfung DFC_Layer_Dummy" VALUE 0x80029CAC Val_Wu8 15.00 DFES_OneToOne 0.00 15.00 EXTENDED_LIMITS 0.00 255.0 /end CHARACTERISTIC
/begin CHARACTERISTIC DFES_DbLv.DFC_NplEnvPSensPPFltDiff_C "DFES/Entprelllevel zur Erstellung eines DFES Eintrages für Prüfung DFC_NplEnvPSensPPFltDiff" VALUE 0x80029CAD Val_Wu8 15.00 DFES_OneToOne 0.00 15.00 EXTENDED_LIMITS 0.00 255.0 /end CHARACTERISTIC
/begin CHARACTERISTIC DFES_DbLv.DFC_NplPresSensPPFltDiff_C "DFES/Entprelllevel zur Erstellung eines DFES Eintrages für Prüfung DFC_NplPresSensPPFltDiff" VALUE 0x80029CAE Val_Wu8 15.00 DFES_OneToOne 0.00 15.00 EXTENDED_LIMITS 0.00 255.0 /end CHARACTERISTIC
/begin CHARACTERISTIC DFES_DbLv.DFC_OilLvlPlaus_C "DFES/Entprelllevel zur Erstellung eines DFES Eintrages für Prüfung DFC_OilLvlPlaus" VALUE 0x80029CAF Val_Wu8 15.00 DFES_OneToOne 0.00 15.00 EXTENDED_LIMITS 0.00 255.0 /end CHARACTERISTIC
/begin CHARACTERISTIC DFES_DbLv.DFC_OilTOutLvl_C "DFES/Entprelllevel zur Erstellung eines DFES Eintrages für Prüfung DFC_OilTOutLvl" VALUE 0x80029CB0 Val_Wu8 15.00 DFES_OneToOne 0.00 15.00 EXTENDED_LIMITS 0.00 255.0 /end CHARACTERISTIC
/begin CHARACTERISTIC DFES_DbLv.DFC_PCVfacAdaptMax_C "DFES/Entprelllevel zur Erstellung eines DFES Eintrages für Prüfung DFC_PCVfacAdaptMax" VALUE 0x80029CB1 Val_Wu8 15.00 DFES_OneToOne 0.00 15.00 EXTENDED_LIMITS 0.00 255.0 /end CHARACTERISTIC
/begin CHARACTERISTIC DFES_DbLv.DFC_PCVfacAdaptMin_C "DFES/Entprelllevel zur Erstellung eines DFES Eintrages für Prüfung DFC_PCVfacAdaptMin" VALUE 0x80029CB2 Val_Wu8 15.00 DFES_OneToOne 0.00 15.00 EXTENDED_LIMITS 0.00 255.0 /end CHARACTERISTIC
/begin CHARACTERISTIC DFES_DbLv.DFC_SensFrzPPFltUs_C "DFES/Entprelllevel zur Erstellung eines DFES Eintrages für Prüfung DFC_SensFrzPPFltUs" VALUE 0x80029CB3 Val_Wu8 15.00 DFES_OneToOne 0.00 15.00 EXTENDED_LIMITS 0.00 255.0 /end CHARACTERISTIC
/begin CHARACTERISTIC DFES_DbLv.DFC_SensMonUTnkLvl_C "DFES/Entprelllevel zur Erstellung eines DFES Eintrages für Prüfung DFC_SensMonUTnkLvl" VALUE 0x80029CB4 Val_Wu8 15.00 DFES_OneToOne 0.00 15.00 EXTENDED_LIMITS 0.00 255.0 /end CHARACTERISTIC
/begin CHARACTERISTIC DFES_DbLv.DFC_T15Sig_C "DFES/Entprelllevel zur Erstellung eines DFES Eintrages für Prüfung DFC_T15Sig" VALUE 0x80029CB5 Val_Wu8 15.00 DFES_OneToOne 0.00 15.00 EXTENDED_LIMITS 0.00 255.0 /end CHARACTERISTIC
/begin CHARACTERISTIC DFES_DbLv.DFC_AirCtlRmpTOut_C "DFES/Entprelllevel zur Erstellung eines DFES Eintrages für Prüfung DFC_AirCtlRmpTOut" VALUE 0x80029CB6 Val_Wu8 15.00 DFES_OneToOne 0.00 15.00 EXTENDED_LIMITS 0.00 255.0 /end CHARACTERISTIC
/begin CHARACTERISTIC DFES_DbLv.DFC_BrkPPlaus_C "DFES/Entprelllevel zur Erstellung eines DFES Eintrages für Prüfung DFC_BrkPPlaus" VALUE 0x80029CB7 Val_Wu8 15.00 DFES_OneToOne 0.00 15.00 EXTENDED_LIMITS 0.00 255.0 /end CHARACTERISTIC
/begin CHARACTERISTIC DFES_DbLv.DFC_CEngDsTDynTst_C "DFES/Entprelllevel zur Erstellung eines DFES Eintrages für Prüfung DFC_CEngDsTDynTst" VALUE 0x80029CB8 Val_Wu8 15.00 DFES_OneToOne 0.00 15.00 EXTENDED_LIMITS 0.00 255.0 /end CHARACTERISTIC
/begin CHARACTERISTIC DFES_DbLv.DFC_EEPEraseErr_C "DFES/Entprelllevel zur Erstellung eines DFES Eintrages für Prüfung DFC_EEPEraseErr" VALUE 0x80029CB9 Val_Wu8 15.00 DFES_OneToOne 0.00 15.00 EXTENDED_LIMITS 0.00 255.0 /end CHARACTERISTIC
/begin CHARACTERISTIC DFES_DbLv.DFC_EEPRdErr_C "DFES/Entprelllevel zur Erstellung eines DFES Eintrages für Prüfung DFC_EEPRdErr" VALUE 0x80029CBA Val_Wu8 15.00 DFES_OneToOne 0.00 15.00 EXTENDED_LIMITS 0.00 255.0 /end CHARACTERISTIC
/begin CHARACTERISTIC DFES_DbLv.DFC_EEPWrErr_C "DFES/Entprelllevel zur Erstellung eines DFES Eintrages für Prüfung DFC_EEPWrErr" VALUE 0x80029CBB Val_Wu8 15.00 DFES_OneToOne 0.00 15.00 EXTENDED_LIMITS 0.00 255.0 /end CHARACTERISTIC
/begin CHARACTERISTIC DFES_DbLv.DFC_EGRVlvJamVlvClsd_C "DFES/Entprelllevel zur Erstellung eines DFES Eintrages für Prüfung DFC_EGRVlvJamVlvClsd" VALUE 0x80029CBC Val_Wu8 15.00 DFES_OneToOne 0.00 15.00 EXTENDED_LIMITS 0.00 255.0 /end CHARACTERISTIC
/begin CHARACTERISTIC DFES_DbLv.DFC_EGRVlvJamVlvOpn_C "DFES/Entprelllevel zur Erstellung eines DFES Eintrages für Prüfung DFC_EGRVlvJamVlvOpn" VALUE 0x80029CBD Val_Wu8 15.00 DFES_OneToOne 0.00 15.00 EXTENDED_LIMITS 0.00 255.0 /end CHARACTERISTIC
/begin CHARACTERISTIC DFES_DbLv.DFC_EGRVlvLPJamVlvClsd_C "DFES/Entprelllevel zur Erstellung eines DFES Eintrages für Prüfung DFC_EGRVlvLPJamVlvClsd" VALUE 0x80029CBE Val_Wu8 15.00 DFES_OneToOne 0.00 15.00 EXTENDED_LIMITS 0.00 255.0 /end CHARACTERISTIC
/begin CHARACTERISTIC DFES_DbLv.DFC_EGRVlvLPJamVlvOpn_C "DFES/Entprelllevel zur Erstellung eines DFES Eintrages für Prüfung DFC_EGRVlvLPJamVlvOpn" VALUE 0x80029CBF Val_Wu8 15.00 DFES_OneToOne 0.00 15.00 EXTENDED_LIMITS 0.00 255.0 /end CHARACTERISTIC
/begin CHARACTERISTIC DFES_DbLv.DFC_EGRVlvLPLgTDrft_C "DFES/Entprelllevel zur Erstellung eines DFES Eintrages für Prüfung DFC_EGRVlvLPLgTDrft" VALUE 0x80029CC0 Val_Wu8 15.00 DFES_OneToOne 0.00 15.00 EXTENDED_LIMITS 0.00 255.0 /end CHARACTERISTIC
/begin CHARACTERISTIC DFES_DbLv.DFC_EGRVlvLPOfsLrnJamVlv_C "DFES/Entprelllevel zur Erstellung eines DFES Eintrages für Prüfung DFC_EGRVlvLPOfsLrnJamVlv" VALUE 0x80029CC1 Val_Wu8 15.00 DFES_OneToOne 0.00 15.00 EXTENDED_LIMITS 0.00 255.0 /end CHARACTERISTIC
/begin CHARACTERISTIC DFES_DbLv.DFC_EGRVlvLPShTDrft_C "DFES/Entprelllevel zur Erstellung eines DFES Eintrages für Prüfung DFC_EGRVlvLPShTDrft" VALUE 0x80029CC2 Val_Wu8 15.00 DFES_OneToOne 0.00 15.00 EXTENDED_LIMITS 0.00 255.0 /end CHARACTERISTIC
/begin CHARACTERISTIC DFES_DbLv.DFC_EGRVlvLgTDrft_C "DFES/Entprelllevel zur Erstellung eines DFES Eintrages für Prüfung DFC_EGRVlvLgTDrft" VALUE 0x80029CC3 Val_Wu8 15.00 DFES_OneToOne 0.00 15.00 EXTENDED_LIMITS 0.00 255.0 /end CHARACTERISTIC
/begin CHARACTERISTIC DFES_DbLv.DFC_EGRVlvOfsLrnJamVlv_C "DFES/Entprelllevel zur Erstellung eines DFES Eintrages für Prüfung DFC_EGRVlvOfsLrnJamVlv" VALUE 0x80029CC4 Val_Wu8 15.00 DFES_OneToOne 0.00 15.00 EXTENDED_LIMITS 0.00 255.0 /end CHARACTERISTIC
/begin CHARACTERISTIC DFES_DbLv.DFC_EGRVlvShTDrft_C "DFES/Entprelllevel zur Erstellung eines DFES Eintrages für Prüfung DFC_EGRVlvShTDrft" VALUE 0x80029CC5 Val_Wu8 15.00 DFES_OneToOne 0.00 15.00 EXTENDED_LIMITS 0.00 255.0 /end CHARACTERISTIC
/begin CHARACTERISTIC DFES_DbLv.DFC_EngICO_C "DFES/Entprelllevel zur Erstellung eines DFES Eintrages für Prüfung DFC_EngICO" VALUE 0x80029CC6 Val_Wu8 15.00 DFES_OneToOne 0.00 15.00 EXTENDED_LIMITS 0.00 255.0 /end CHARACTERISTIC
/begin CHARACTERISTIC DFES_DbLv.DFC_EpmCaSI1ErrSig_C "DFES/Entprelllevel zur Erstellung eines DFES Eintrages für Prüfung DFC_EpmCaSI1ErrSig" VALUE 0x80029CC7 Val_Wu8 15.00 DFES_OneToOne 0.00 15.00 EXTENDED_LIMITS 0.00 255.0 /end CHARACTERISTIC
/begin CHARACTERISTIC DFES_DbLv.DFC_EpmCaSI1NoSig_C "DFES/Entprelllevel zur Erstellung eines DFES Eintrages für Prüfung DFC_EpmCaSI1NoSig" VALUE 0x80029CC8 Val_Wu8 15.00 DFES_OneToOne 0.00 15.00 EXTENDED_LIMITS 0.00 255.0 /end CHARACTERISTIC
/begin CHARACTERISTIC DFES_DbLv.DFC_EpmCaSI1OfsErr_C "DFES/Entprelllevel zur Erstellung eines DFES Eintrages für Prüfung DFC_EpmCaSI1OfsErr" VALUE 0x80029CC9 Val_Wu8 15.00 DFES_OneToOne 0.00 15.00 EXTENDED_LIMITS 0.00 255.0 /end CHARACTERISTIC
/begin CHARACTERISTIC DFES_DbLv.DFC_EpmCrSErrSig_C "DFES/Entprelllevel zur Erstellung eines DFES Eintrages für Prüfung DFC_EpmCrSErrSig" VALUE 0x80029CCA Val_Wu8 15.00 DFES_OneToOne 0.00 15.00 EXTENDED_LIMITS 0.00 255.0 /end CHARACTERISTIC
/begin CHARACTERISTIC DFES_DbLv.DFC_EpmCrSNoSig_C "DFES/Entprelllevel zur Erstellung eines DFES Eintrages für Prüfung DFC_EpmCrSNoSig" VALUE 0x80029CCB Val_Wu8 15.00 DFES_OneToOne 0.00 15.00 EXTENDED_LIMITS 0.00 255.0 /end CHARACTERISTIC
/begin CHARACTERISTIC DFES_DbLv.DFC_IVPlausComprTst_C "DFES/Entprelllevel zur Erstellung eines DFES Eintrages für Prüfung DFC_IVPlausComprTst" VALUE 0x80029CCC Val_Wu8 15.00 DFES_OneToOne 0.00 15.00 EXTENDED_LIMITS 0.00 255.0 /end CHARACTERISTIC
/begin CHARACTERISTIC DFES_DbLv.DFC_IVPlausRunUpTst_C "DFES/Entprelllevel zur Erstellung eines DFES Eintrages für Prüfung DFC_IVPlausRunUpTst" VALUE 0x80029CCD Val_Wu8 15.00 DFES_OneToOne 0.00 15.00 EXTENDED_LIMITS 0.00 255.0 /end CHARACTERISTIC
/begin CHARACTERISTIC DFES_DbLv.DFC_InjCrvShOffTst_C "DFES/Entprelllevel zur Erstellung eines DFES Eintrages für Prüfung DFC_InjCrvShOffTst" VALUE 0x80029CCE Val_Wu8 15.00 DFES_OneToOne 0.00 15.00 EXTENDED_LIMITS 0.00 255.0 /end CHARACTERISTIC
/begin CHARACTERISTIC DFES_DbLv.DFC_LayerEnSavModProd_C "DFES/Entprelllevel zur Erstellung eines DFES Eintrages für Prüfung DFC_LayerEnSavModProd" VALUE 0x80029CCF Val_Wu8 15.00 DFES_OneToOne 0.00 15.00 EXTENDED_LIMITS 0.00 255.0 /end CHARACTERISTIC
/begin CHARACTERISTIC DFES_DbLv.DFC_LayerEnSavModRep_C "DFES/Entprelllevel zur Erstellung eines DFES Eintrages für Prüfung DFC_LayerEnSavModRep" VALUE 0x80029CD0 Val_Wu8 15.00 DFES_OneToOne 0.00 15.00 EXTENDED_LIMITS 0.00 255.0 /end CHARACTERISTIC
/begin CHARACTERISTIC DFES_DbLv.DFC_LayerEnSavModShip_C "DFES/Entprelllevel zur Erstellung eines DFES Eintrages für Prüfung DFC_LayerEnSavModShip" VALUE 0x80029CD1 Val_Wu8 15.00 DFES_OneToOne 0.00 15.00 EXTENDED_LIMITS 0.00 255.0 /end CHARACTERISTIC
/begin CHARACTERISTIC DFES_DbLv.DFC_MRlyErlyOpng_C "DFES/Entprelllevel zur Erstellung eines DFES Eintrages für Prüfung DFC_MRlyErlyOpng" VALUE 0x80029CD2 Val_Wu8 15.00 DFES_OneToOne 0.00 15.00 EXTENDED_LIMITS 0.00 255.0 /end CHARACTERISTIC
/begin CHARACTERISTIC DFES_DbLv.DFC_MRlyStk_C "DFES/Entprelllevel zur Erstellung eines DFES Eintrages für Prüfung DFC_MRlyStk" VALUE 0x80029CD3 Val_Wu8 15.00 DFES_OneToOne 0.00 15.00 EXTENDED_LIMITS 0.00 255.0 /end CHARACTERISTIC
/begin CHARACTERISTIC DFES_DbLv.DFC_MeUnActrTst_C "DFES/Entprelllevel zur Erstellung eines DFES Eintrages für Prüfung DFC_MeUnActrTst" VALUE 0x80029CD4 Val_Wu8 15.00 DFES_OneToOne 0.00 15.00 EXTENDED_LIMITS 0.00 255.0 /end CHARACTERISTIC
/begin CHARACTERISTIC DFES_DbLv.DFC_MoCADCCmp_C "DFES/Entprelllevel zur Erstellung eines DFES Eintrages für Prüfung DFC_MoCADCCmp" VALUE 0x80029CD5 Val_Wu8 15.00 DFES_OneToOne 0.00 15.00 EXTENDED_LIMITS 0.00 255.0 /end CHARACTERISTIC
/begin CHARACTERISTIC DFES_DbLv.DFC_MoCADCTst_C "DFES/Entprelllevel zur Erstellung eines DFES Eintrages für Prüfung DFC_MoCADCTst" VALUE 0x80029CD6 Val_Wu8 15.00 DFES_OneToOne 0.00 15.00 EXTENDED_LIMITS 0.00 255.0 /end CHARACTERISTIC
/begin CHARACTERISTIC DFES_DbLv.DFC_MoCADCVltgRatio_C "DFES/Entprelllevel zur Erstellung eines DFES Eintrages für Prüfung DFC_MoCADCVltgRatio" VALUE 0x80029CD7 Val_Wu8 15.00 DFES_OneToOne 0.00 15.00 EXTENDED_LIMITS 0.00 255.0 /end CHARACTERISTIC
/begin CHARACTERISTIC DFES_DbLv.DFC_MoCComErrCnt_C "DFES/Entprelllevel zur Erstellung eines DFES Eintrages für Prüfung DFC_MoCComErrCnt" VALUE 0x80029CD8 Val_Wu8 15.00 DFES_OneToOne 0.00 15.00 EXTENDED_LIMITS 0.00 255.0 /end CHARACTERISTIC
/begin CHARACTERISTIC DFES_DbLv.DFC_MoCComSPI_C "DFES/Entprelllevel zur Erstellung eines DFES Eintrages für Prüfung DFC_MoCComSPI" VALUE 0x80029CD9 Val_Wu8 15.00 DFES_OneToOne 0.00 15.00 EXTENDED_LIMITS 0.00 255.0 /end CHARACTERISTIC
/begin CHARACTERISTIC DFES_DbLv.DFC_MoCROMErrXPg_C "DFES/Entprelllevel zur Erstellung eines DFES Eintrages für Prüfung DFC_MoCROMErrXPg" VALUE 0x80029CDA Val_Wu8 15.00 DFES_OneToOne 0.00 15.00 EXTENDED_LIMITS 0.00 255.0 /end CHARACTERISTIC
/begin CHARACTERISTIC DFES_DbLv.DFC_MoCSOPHwNoRdy_C "DFES/Entprelllevel zur Erstellung eines DFES Eintrages für Prüfung DFC_MoCSOPHwNoRdy" VALUE 0x80029CDB Val_Wu8 15.00 DFES_OneToOne 0.00 15.00 EXTENDED_LIMITS 0.00 255.0 /end CHARACTERISTIC
/begin CHARACTERISTIC DFES_DbLv.DFC_MoCSOPLoLi_C "DFES/Entprelllevel zur Erstellung eines DFES Eintrages für Prüfung DFC_MoCSOPLoLi" VALUE 0x80029CDC Val_Wu8 15.00 DFES_OneToOne 0.00 15.00 EXTENDED_LIMITS 0.00 255.0 /end CHARACTERISTIC
/begin CHARACTERISTIC DFES_DbLv.DFC_MoCSOPMM_C "DFES/Entprelllevel zur Erstellung eines DFES Eintrages für Prüfung DFC_MoCSOPMM" VALUE 0x80029CDD Val_Wu8 15.00 DFES_OneToOne 0.00 15.00 EXTENDED_LIMITS 0.00 255.0 /end CHARACTERISTIC
/begin CHARACTERISTIC DFES_DbLv.DFC_MoCSOPTimeOut_C "DFES/Entprelllevel zur Erstellung eines DFES Eintrages für Prüfung DFC_MoCSOPTimeOut" VALUE 0x80029CDE Val_Wu8 15.00 DFES_OneToOne 0.00 15.00 EXTENDED_LIMITS 0.00 255.0 /end CHARACTERISTIC
/begin CHARACTERISTIC DFES_DbLv.DFC_MoCSOPUpLi_C "DFES/Entprelllevel zur Erstellung eines DFES Eintrages für Prüfung DFC_MoCSOPUpLi" VALUE 0x80029CDF Val_Wu8 15.00 DFES_OneToOne 0.00 15.00 EXTENDED_LIMITS 0.00 255.0 /end CHARACTERISTIC
/begin CHARACTERISTIC DFES_DbLv.DFC_MoFAPP_C "DFES/Entprelllevel zur Erstellung eines DFES Eintrages für Prüfung DFC_MoFAPP" VALUE 0x80029CE0 Val_Wu8 15.00 DFES_OneToOne 0.00 15.00 EXTENDED_LIMITS 0.00 255.0 /end CHARACTERISTIC
/begin CHARACTERISTIC DFES_DbLv.DFC_MoFESpd_C "DFES/Entprelllevel zur Erstellung eines DFES Eintrages für Prüfung DFC_MoFESpd" VALUE 0x80029CE1 Val_Wu8 15.00 DFES_OneToOne 0.00 15.00 EXTENDED_LIMITS 0.00 255.0 /end CHARACTERISTIC
/begin CHARACTERISTIC DFES_DbLv.DFC_MoFInjDatPhi_C "DFES/Entprelllevel zur Erstellung eines DFES Eintrages für Prüfung DFC_MoFInjDatPhi" VALUE 0x80029CE2 Val_Wu8 15.00 DFES_OneToOne 0.00 15.00 EXTENDED_LIMITS 0.00 255.0 /end CHARACTERISTIC
/begin CHARACTERISTIC DFES_DbLv.DFC_MoFInjDatQnt_C "DFES/Entprelllevel zur Erstellung eines DFES Eintrages für Prüfung DFC_MoFInjDatQnt" VALUE 0x80029CE3 Val_Wu8 15.00 DFES_OneToOne 0.00 15.00 EXTENDED_LIMITS 0.00 255.0 /end CHARACTERISTIC
/begin CHARACTERISTIC DFES_DbLv.DFC_MoFInjQnt_C "DFES/Entprelllevel zur Erstellung eines DFES Eintrages für Prüfung DFC_MoFInjQnt" VALUE 0x80029CE4 Val_Wu8 15.00 DFES_OneToOne 0.00 15.00 EXTENDED_LIMITS 0.00 255.0 /end CHARACTERISTIC
/begin CHARACTERISTIC DFES_DbLv.DFC_MoFMode1PoI1_C "DFES/Entprelllevel zur Erstellung eines DFES Eintrages für Prüfung DFC_MoFMode1PoI1" VALUE 0x80029CE5 Val_Wu8 15.00 DFES_OneToOne 0.00 15.00 EXTENDED_LIMITS 0.00 255.0 /end CHARACTERISTIC
/begin CHARACTERISTIC DFES_DbLv.DFC_MoFMode1PoI2_C "DFES/Entprelllevel zur Erstellung eines DFES Eintrages für Prüfung DFC_MoFMode1PoI2" VALUE 0x80029CE6 Val_Wu8 15.00 DFES_OneToOne 0.00 15.00 EXTENDED_LIMITS 0.00 255.0 /end CHARACTERISTIC
/begin CHARACTERISTIC DFES_DbLv.DFC_MoFMode2PoI1_C "DFES/Entprelllevel zur Erstellung eines DFES Eintrages für Prüfung DFC_MoFMode2PoI1" VALUE 0x80029CE7 Val_Wu8 15.00 DFES_OneToOne 0.00 15.00 EXTENDED_LIMITS 0.00 255.0 /end CHARACTERISTIC
/begin CHARACTERISTIC DFES_DbLv.DFC_MoFMode2PoI2_C "DFES/Entprelllevel zur Erstellung eines DFES Eintrages für Prüfung DFC_MoFMode2PoI2" VALUE 0x80029CE8 Val_Wu8 15.00 DFES_OneToOne 0.00 15.00 EXTENDED_LIMITS 0.00 255.0 /end CHARACTERISTIC
/begin CHARACTERISTIC DFES_DbLv.DFC_MoFOvR_C "DFES/Entprelllevel zur Erstellung eines DFES Eintrages für Prüfung DFC_MoFOvR" VALUE 0x80029CE9 Val_Wu8 15.00 DFES_OneToOne 0.00 15.00 EXTENDED_LIMITS 0.00 255.0 /end CHARACTERISTIC
/begin CHARACTERISTIC DFES_DbLv.DFC_MoFQntCor_C "DFES/Entprelllevel zur Erstellung eines DFES Eintrages für Prüfung DFC_MoFQntCor" VALUE 0x80029CEA Val_Wu8 15.00 DFES_OneToOne 0.00 15.00 EXTENDED_LIMITS 0.00 255.0 /end CHARACTERISTIC
/begin CHARACTERISTIC DFES_DbLv.DFC_MoFRailP_C "DFES/Entprelllevel zur Erstellung eines DFES Eintrages für Prüfung DFC_MoFRailP" VALUE 0x80029CEB Val_Wu8 15.00 DFES_OneToOne 0.00 15.00 EXTENDED_LIMITS 0.00 255.0 /end CHARACTERISTIC
/begin CHARACTERISTIC DFES_DbLv.DFC_MoFTrqCmp_C "DFES/Entprelllevel zur Erstellung eines DFES Eintrages für Prüfung DFC_MoFTrqCmp" VALUE 0x80029CEC Val_Wu8 15.00 DFES_OneToOne 0.00 15.00 EXTENDED_LIMITS 0.00 255.0 /end CHARACTERISTIC
/begin CHARACTERISTIC DFES_DbLv.DFC_NSCDsHtrSetP_C "DFES/Entprelllevel zur Erstellung eines DFES Eintrages für Prüfung DFC_NSCDsHtrSetP" VALUE 0x80029CED Val_Wu8 15.00 DFES_OneToOne 0.00 15.00 EXTENDED_LIMITS 0.00 255.0 /end CHARACTERISTIC
/begin CHARACTERISTIC DFES_DbLv.DFC_NoCat2DsHtrSetP_C "DFES/Entprelllevel zur Erstellung eines DFES Eintrages für Prüfung DFC_NoCat2DsHtrSetP" VALUE 0x80029CEE Val_Wu8 15.00 DFES_OneToOne 0.00 15.00 EXTENDED_LIMITS 0.00 255.0 /end CHARACTERISTIC
/begin CHARACTERISTIC DFES_DbLv.DFC_PCVActrTst_C "DFES/Entprelllevel zur Erstellung eines DFES Eintrages für Prüfung DFC_PCVActrTst" VALUE 0x80029CEF Val_Wu8 15.00 DFES_OneToOne 0.00 15.00 EXTENDED_LIMITS 0.00 255.0 /end CHARACTERISTIC
/begin CHARACTERISTIC DFES_DbLv.DFC_PhyModNonMonMapNpl_C "DFES/Entprelllevel zur Erstellung eines DFES Eintrages für Prüfung DFC_PhyModNonMonMapNpl" VALUE 0x80029CF0 Val_Wu8 15.00 DFES_OneToOne 0.00 15.00 EXTENDED_LIMITS 0.00 255.0 /end CHARACTERISTIC
/begin CHARACTERISTIC DFES_DbLv.DFC_RailHpTst_C "DFES/Entprelllevel zur Erstellung eines DFES Eintrages für Prüfung DFC_RailHpTst" VALUE 0x80029CF1 Val_Wu8 15.00 DFES_OneToOne 0.00 15.00 EXTENDED_LIMITS 0.00 255.0 /end CHARACTERISTIC
/begin CHARACTERISTIC DFES_DbLv.DFC_RailPOfsTstMax_C "DFES/Entprelllevel zur Erstellung eines DFES Eintrages für Prüfung DFC_RailPOfsTstMax" VALUE 0x80029CF2 Val_Wu8 15.00 DFES_OneToOne 0.00 15.00 EXTENDED_LIMITS 0.00 255.0 /end CHARACTERISTIC
/begin CHARACTERISTIC DFES_DbLv.DFC_RailPOfsTstMin_C "DFES/Entprelllevel zur Erstellung eines DFES Eintrages für Prüfung DFC_RailPOfsTstMin" VALUE 0x80029CF3 Val_Wu8 15.00 DFES_OneToOne 0.00 15.00 EXTENDED_LIMITS 0.00 255.0 /end CHARACTERISTIC
/begin CHARACTERISTIC DFES_DbLv.DFC_SIA_E1max_C "DFES/Entprelllevel zur Erstellung eines DFES Eintrages für Prüfung DFC_SIA_E1max" VALUE 0x80029CF4 Val_Wu8 15.00 DFES_OneToOne 0.00 15.00 EXTENDED_LIMITS 0.00 255.0 /end CHARACTERISTIC
/begin CHARACTERISTIC DFES_DbLv.DFC_SIA_E1min_C "DFES/Entprelllevel zur Erstellung eines DFES Eintrages für Prüfung DFC_SIA_E1min" VALUE 0x80029CF5 Val_Wu8 15.00 DFES_OneToOne 0.00 15.00 EXTENDED_LIMITS 0.00 255.0 /end CHARACTERISTIC
/begin CHARACTERISTIC DFES_DbLv.DFC_SIA_E1npl_C "DFES/Entprelllevel zur Erstellung eines DFES Eintrages für Prüfung DFC_SIA_E1npl" VALUE 0x80029CF6 Val_Wu8 15.00 DFES_OneToOne 0.00 15.00 EXTENDED_LIMITS 0.00 255.0 /end CHARACTERISTIC
/begin CHARACTERISTIC DFES_DbLv.DFC_SIA_E1sig_C "DFES/Entprelllevel zur Erstellung eines DFES Eintrages für Prüfung DFC_SIA_E1sig" VALUE 0x80029CF7 Val_Wu8 15.00 DFES_OneToOne 0.00 15.00 EXTENDED_LIMITS 0.00 255.0 /end CHARACTERISTIC
/begin CHARACTERISTIC DFES_DbLv.DFC_SIA_E2max_C "DFES/Entprelllevel zur Erstellung eines DFES Eintrages für Prüfung DFC_SIA_E2max" VALUE 0x80029CF8 Val_Wu8 15.00 DFES_OneToOne 0.00 15.00 EXTENDED_LIMITS 0.00 255.0 /end CHARACTERISTIC
/begin CHARACTERISTIC DFES_DbLv.DFC_SIA_E2min_C "DFES/Entprelllevel zur Erstellung eines DFES Eintrages für Prüfung DFC_SIA_E2min" VALUE 0x80029CF9 Val_Wu8 15.00 DFES_OneToOne 0.00 15.00 EXTENDED_LIMITS 0.00 255.0 /end CHARACTERISTIC
/begin CHARACTERISTIC DFES_DbLv.DFC_SIA_E2npl_C "DFES/Entprelllevel zur Erstellung eines DFES Eintrages für Prüfung DFC_SIA_E2npl" VALUE 0x80029CFA Val_Wu8 15.00 DFES_OneToOne 0.00 15.00 EXTENDED_LIMITS 0.00 255.0 /end CHARACTERISTIC
/begin CHARACTERISTIC DFES_DbLv.DFC_SIA_E2sig_C "DFES/Entprelllevel zur Erstellung eines DFES Eintrages für Prüfung DFC_SIA_E2sig" VALUE 0x80029CFB Val_Wu8 15.00 DFES_OneToOne 0.00 15.00 EXTENDED_LIMITS 0.00 255.0 /end CHARACTERISTIC
/begin CHARACTERISTIC DFES_DbLv.DFC_SIA_E3max_C "DFES/Entprelllevel zur Erstellung eines DFES Eintrages für Prüfung DFC_SIA_E3max" VALUE 0x80029CFC Val_Wu8 15.00 DFES_OneToOne 0.00 15.00 EXTENDED_LIMITS 0.00 255.0 /end CHARACTERISTIC
/begin CHARACTERISTIC DFES_DbLv.DFC_SIA_E3min_C "DFES/Entprelllevel zur Erstellung eines DFES Eintrages für Prüfung DFC_SIA_E3min" VALUE 0x80029CFD Val_Wu8 15.00 DFES_OneToOne 0.00 15.00 EXTENDED_LIMITS 0.00 255.0 /end CHARACTERISTIC
/begin CHARACTERISTIC DFES_DbLv.DFC_SIA_E3npl_C "DFES/Entprelllevel zur Erstellung eines DFES Eintrages für Prüfung DFC_SIA_E3npl" VALUE 0x80029CFE Val_Wu8 15.00 DFES_OneToOne 0.00 15.00 EXTENDED_LIMITS 0.00 255.0 /end CHARACTERISTIC
/begin CHARACTERISTIC DFES_DbLv.DFC_SIA_E3sig_C "DFES/Entprelllevel zur Erstellung eines DFES Eintrages für Prüfung DFC_SIA_E3sig" VALUE 0x80029CFF Val_Wu8 15.00 DFES_OneToOne 0.00 15.00 EXTENDED_LIMITS 0.00 255.0 /end CHARACTERISTIC
/begin CHARACTERISTIC DFES_DbLv.DFC_SIA_E4max_C "DFES/Entprelllevel zur Erstellung eines DFES Eintrages für Prüfung DFC_SIA_E4max" VALUE 0x80029D00 Val_Wu8 15.00 DFES_OneToOne 0.00 15.00 EXTENDED_LIMITS 0.00 255.0 /end CHARACTERISTIC
/begin CHARACTERISTIC DFES_DbLv.DFC_SIA_E4min_C "DFES/Entprelllevel zur Erstellung eines DFES Eintrages für Prüfung DFC_SIA_E4min" VALUE 0x80029D01 Val_Wu8 15.00 DFES_OneToOne 0.00 15.00 EXTENDED_LIMITS 0.00 255.0 /end CHARACTERISTIC
/begin CHARACTERISTIC DFES_DbLv.DFC_SIA_E4npl_C "DFES/Entprelllevel zur Erstellung eines DFES Eintrages für Prüfung DFC_SIA_E4npl" VALUE 0x80029D02 Val_Wu8 15.00 DFES_OneToOne 0.00 15.00 EXTENDED_LIMITS 0.00 255.0 /end CHARACTERISTIC
/begin CHARACTERISTIC DFES_DbLv.DFC_SIA_E4sig_C "DFES/Entprelllevel zur Erstellung eines DFES Eintrages für Prüfung DFC_SIA_E4sig" VALUE 0x80029D03 Val_Wu8 15.00 DFES_OneToOne 0.00 15.00 EXTENDED_LIMITS 0.00 255.0 /end CHARACTERISTIC
/begin CHARACTERISTIC DFES_DbLv.DFC_SWReset_0_C "DFES/Entprelllevel zur Erstellung eines DFES Eintrages für Prüfung DFC_SWReset_0" VALUE 0x80029D04 Val_Wu8 15.00 DFES_OneToOne 0.00 15.00 EXTENDED_LIMITS 0.00 255.0 /end CHARACTERISTIC
/begin CHARACTERISTIC DFES_DbLv.DFC_SWReset_1_C "DFES/Entprelllevel zur Erstellung eines DFES Eintrages für Prüfung DFC_SWReset_1" VALUE 0x80029D05 Val_Wu8 15.00 DFES_OneToOne 0.00 15.00 EXTENDED_LIMITS 0.00 255.0 /end CHARACTERISTIC
/begin CHARACTERISTIC DFES_DbLv.DFC_SWReset_2_C "DFES/Entprelllevel zur Erstellung eines DFES Eintrages für Prüfung DFC_SWReset_2" VALUE 0x80029D06 Val_Wu8 15.00 DFES_OneToOne 0.00 15.00 EXTENDED_LIMITS 0.00 255.0 /end CHARACTERISTIC
/begin CHARACTERISTIC DFES_DbLv.DFC_ShtrAKKMax_C "DFES/Entprelllevel zur Erstellung eines DFES Eintrages für Prüfung DFC_ShtrAKKMax" VALUE 0x80029D07 Val_Wu8 15.00 DFES_OneToOne 0.00 15.00 EXTENDED_LIMITS 0.00 255.0 /end CHARACTERISTIC
/begin CHARACTERISTIC DFES_DbLv.DFC_ShtrAKKMin_C "DFES/Entprelllevel zur Erstellung eines DFES Eintrages für Prüfung DFC_ShtrAKKMin" VALUE 0x80029D08 Val_Wu8 15.00 DFES_OneToOne 0.00 15.00 EXTENDED_LIMITS 0.00 255.0 /end CHARACTERISTIC
/begin CHARACTERISTIC DFES_DbLv.DFC_ShtrAKKNpl_C "DFES/Entprelllevel zur Erstellung eines DFES Eintrages für Prüfung DFC_ShtrAKKNpl" VALUE 0x80029D09 Val_Wu8 15.00 DFES_OneToOne 0.00 15.00 EXTENDED_LIMITS 0.00 255.0 /end CHARACTERISTIC
/begin CHARACTERISTIC DFES_DbLv.DFC_ShtrPKKMax_C "DFES/Entprelllevel zur Erstellung eines DFES Eintrages für Prüfung DFC_ShtrPKKMax" VALUE 0x80029D0A Val_Wu8 15.00 DFES_OneToOne 0.00 15.00 EXTENDED_LIMITS 0.00 255.0 /end CHARACTERISTIC
/begin CHARACTERISTIC DFES_DbLv.DFC_StopCntTmr_C "DFES/Entprelllevel zur Erstellung eines DFES Eintrages für Prüfung DFC_StopCntTmr" VALUE 0x80029D0B Val_Wu8 15.00 DFES_OneToOne 0.00 15.00 EXTENDED_LIMITS 0.00 255.0 /end CHARACTERISTIC
/begin CHARACTERISTIC DFES_DbLv.DFC_ThrVlvMon_C "DFES/Entprelllevel zur Erstellung eines DFES Eintrages für Prüfung DFC_ThrVlvMon" VALUE 0x80029D0C Val_Wu8 15.00 DFES_OneToOne 0.00 15.00 EXTENDED_LIMITS 0.00 255.0 /end CHARACTERISTIC
/begin CHARACTERISTIC DFES_DbLv.DFC_VSwVlvJamVlv_C "DFES/Entprelllevel zur Erstellung eines DFES Eintrages für Prüfung DFC_VSwVlvJamVlv" VALUE 0x80029D0D Val_Wu8 15.00 DFES_OneToOne 0.00 15.00 EXTENDED_LIMITS 0.00 255.0 /end CHARACTERISTIC
/begin CHARACTERISTIC DFES_DbLv.DFC_VSwVlvLgTDrft_C "DFES/Entprelllevel zur Erstellung eines DFES Eintrages für Prüfung DFC_VSwVlvLgTDrft" VALUE 0x80029D0E Val_Wu8 15.00 DFES_OneToOne 0.00 15.00 EXTENDED_LIMITS 0.00 255.0 /end CHARACTERISTIC
/begin CHARACTERISTIC DFES_DbLv.DFC_VSwVlvOfsLrnJamVlv_C "DFES/Entprelllevel zur Erstellung eines DFES Eintrages für Prüfung DFC_VSwVlvOfsLrnJamVlv" VALUE 0x80029D0F Val_Wu8 15.00 DFES_OneToOne 0.00 15.00 EXTENDED_LIMITS 0.00 255.0 /end CHARACTERISTIC
/begin CHARACTERISTIC DFES_DbLv.DFC_VSwVlvOfsNeutr_C "DFES/Entprelllevel zur Erstellung eines DFES Eintrages für Prüfung DFC_VSwVlvOfsNeutr" VALUE 0x80029D10 Val_Wu8 15.00 DFES_OneToOne 0.00 15.00 EXTENDED_LIMITS 0.00 255.0 /end CHARACTERISTIC
/begin CHARACTERISTIC DFES_DbLv.DFC_VSwVlvShTDrft_C "DFES/Entprelllevel zur Erstellung eines DFES Eintrages für Prüfung DFC_VSwVlvShTDrft" VALUE 0x80029D11 Val_Wu8 15.00 DFES_OneToOne 0.00 15.00 EXTENDED_LIMITS 0.00 255.0 /end CHARACTERISTIC
/begin CHARACTERISTIC DFES_DbLv.DFC_VSwVlvSpgDef_C "DFES/Entprelllevel zur Erstellung eines DFES Eintrages für Prüfung DFC_VSwVlvSpgDef" VALUE 0x80029D12 Val_Wu8 15.00 DFES_OneToOne 0.00 15.00 EXTENDED_LIMITS 0.00 255.0 /end CHARACTERISTIC
/begin CHARACTERISTIC DFES_DTCM.DFC_Unused_C "DFES/intern benötigter Parameter für nicht existierende Fehlerprüfung DFC_Unused" VALUE 0x80026650 Val_Wu16 65535.00 DFES_OneToOne 0.00 65535.00 READ_ONLY /end CHARACTERISTIC
/begin CHARACTERISTIC DFES_DTCM.DFC_ACCIPlausDrvAst_C "DFES/Hersteller spezifischer Fehlercode für Prüfung DFC_ACCIPlausDrvAst" VALUE 0x80026652 Val_Wu16 65535.00 DFES_OneToOne 0.00 65535.00 /end CHARACTERISTIC
/begin CHARACTERISTIC DFES_DTCM.DFC_ACCIPlausTrqDes_C "DFES/Hersteller spezifischer Fehlercode für Prüfung DFC_ACCIPlausTrqDes" VALUE 0x80026654 Val_Wu16 65535.00 DFES_OneToOne 0.00 65535.00 /end CHARACTERISTIC
/begin CHARACTERISTIC DFES_DTCM.DFC_AirCtlGovDvtEOMMax_C "DFES/Hersteller spezifischer Fehlercode für Prüfung DFC_AirCtlGovDvtEOMMax" VALUE 0x80026656 Val_Wu16 65535.00 DFES_OneToOne 0.00 65535.00 /end CHARACTERISTIC
/begin CHARACTERISTIC DFES_DTCM.DFC_AirCtlGovDvtEOMMin_C "DFES/Hersteller spezifischer Fehlercode für Prüfung DFC_AirCtlGovDvtEOMMin" VALUE 0x80026658 Val_Wu16 65535.00 DFES_OneToOne 0.00 65535.00 /end CHARACTERISTIC
/begin CHARACTERISTIC DFES_DTCM.DFC_AirCtlGovDvtMax_C "DFES/Hersteller spezifischer Fehlercode für Prüfung DFC_AirCtlGovDvtMax" VALUE 0x8002665A Val_Wu16 65535.00 DFES_OneToOne 0.00 65535.00 /end CHARACTERISTIC
/begin CHARACTERISTIC DFES_DTCM.DFC_AirCtlGovDvtMin_C "DFES/Hersteller spezifischer Fehlercode für Prüfung DFC_AirCtlGovDvtMin" VALUE 0x8002665C Val_Wu16 65535.00 DFES_OneToOne 0.00 65535.00 /end CHARACTERISTIC
/begin CHARACTERISTIC DFES_DTCM.DFC_AirCtlGovLPDvtMax_C "DFES/Hersteller spezifischer Fehlercode für Prüfung DFC_AirCtlGovLPDvtMax" VALUE 0x8002665E Val_Wu16 65535.00 DFES_OneToOne 0.00 65535.00 /end CHARACTERISTIC
/begin CHARACTERISTIC DFES_DTCM.DFC_AirCtlGovLPDvtMin_C "DFES/Hersteller spezifischer Fehlercode für Prüfung DFC_AirCtlGovLPDvtMin" VALUE 0x80026660 Val_Wu16 65535.00 DFES_OneToOne 0.00 65535.00 /end CHARACTERISTIC
/begin CHARACTERISTIC DFES_DTCM.DFC_AltIOComErr_C "DFES/Hersteller spezifischer Fehlercode für Prüfung DFC_AltIOComErr" VALUE 0x80026662 Val_Wu16 65535.00 DFES_OneToOne 0.00 65535.00 /end CHARACTERISTIC
/begin CHARACTERISTIC DFES_DTCM.DFC_AltIOComNpl_C "DFES/Hersteller spezifischer Fehlercode für Prüfung DFC_AltIOComNpl" VALUE 0x80026664 Val_Wu16 65535.00 DFES_OneToOne 0.00 65535.00 /end CHARACTERISTIC
/begin CHARACTERISTIC DFES_DTCM.DFC_BusDiagBusOffFlexRay_C "DFES/" VALUE 0x80026666 Val_Wu16 65535.00 DFES_OneToOne 0.00 65535.00 /end CHARACTERISTIC
/begin CHARACTERISTIC DFES_DTCM.DFC_BusDiagBusOffNodeA_C "DFES/Hersteller spezifischer Fehlercode für Prüfung DFC_BusDiagBusOffNodeA" VALUE 0x80026668 Val_Wu16 65535.00 DFES_OneToOne 0.00 65535.00 /end CHARACTERISTIC
/begin CHARACTERISTIC DFES_DTCM.DFC_BusDiagBusOffNodeB_C "DFES/Hersteller spezifischer Fehlercode für Prüfung DFC_BusDiagBusOffNodeB" VALUE 0x8002666A Val_Wu16 65535.00 DFES_OneToOne 0.00 65535.00 /end CHARACTERISTIC
/begin CHARACTERISTIC DFES_DTCM.DFC_BusDiagBusOffNodeC_C "DFES/Hersteller spezifischer Fehlercode für Prüfung DFC_BusDiagBusOffNodeC" VALUE 0x8002666C Val_Wu16 65535.00 DFES_OneToOne 0.00 65535.00 /end CHARACTERISTIC
/begin CHARACTERISTIC DFES_DTCM.DFC_BusDiagHwFlexRay_C "DFES/" VALUE 0x8002666E Val_Wu16 65535.00 DFES_OneToOne 0.00 65535.00 /end CHARACTERISTIC
/begin CHARACTERISTIC DFES_DTCM.DFC_Cj945SpiCom1_C "DFES/Hersteller spezifischer Fehlercode für Prüfung DFC_Cj945SpiCom1" VALUE 0x80026670 Val_Wu16 65535.00 DFES_OneToOne 0.00 65535.00 /end CHARACTERISTIC
/begin CHARACTERISTIC DFES_DTCM.DFC_ComACDemandSig_FA_C "DFES/Hersteller spezifischer Fehlercode für Prüfung DFC_ComACDemandSig_FA" VALUE 0x80026672 Val_Wu16 65535.00 DFES_OneToOne 0.00 65535.00 /end CHARACTERISTIC
/begin CHARACTERISTIC DFES_DTCM.DFC_ComACDemandTo_FA_C "DFES/Hersteller spezifischer Fehlercode für Prüfung DFC_ComACDemandTo_FA" VALUE 0x80026674 Val_Wu16 65535.00 DFES_OneToOne 0.00 65535.00 /end CHARACTERISTIC
/begin CHARACTERISTIC DFES_DTCM.DFC_ComATempSig_FA_C "DFES/Hersteller spezifischer Fehlercode für Prüfung DFC_ComATempSig_FA" VALUE 0x80026676 Val_Wu16 65535.00 DFES_OneToOne 0.00 65535.00 /end CHARACTERISTIC
/begin CHARACTERISTIC DFES_DTCM.DFC_ComATempTo_FA_C "DFES/Hersteller spezifischer Fehlercode für Prüfung DFC_ComATempTo_FA" VALUE 0x80026678 Val_Wu16 65535.00 DFES_OneToOne 0.00 65535.00 /end CHARACTERISTIC
/begin CHARACTERISTIC DFES_DTCM.DFC_ComATempTo_FX_C "DFES/Hersteller spezifischer Fehlercode für Prüfung DFC_ComATempTo_FX" VALUE 0x8002667A Val_Wu16 65535.00 DFES_OneToOne 0.00 65535.00 /end CHARACTERISTIC
/begin CHARACTERISTIC DFES_DTCM.DFC_ComBrkTrqSumChk_FX_C "DFES/Hersteller spezifischer Fehlercode für Prüfung DFC_ComBrkTrqSumChk_FX" VALUE 0x8002667C Val_Wu16 65535.00 DFES_OneToOne 0.00 65535.00 /end CHARACTERISTIC
/begin CHARACTERISTIC DFES_DTCM.DFC_ComBrkTrqSumCtr_FX_C "DFES/Hersteller spezifischer Fehlercode für Prüfung DFC_ComBrkTrqSumCtr_FX" VALUE 0x8002667E Val_Wu16 65535.00 DFES_OneToOne 0.00 65535.00 /end CHARACTERISTIC
/begin CHARACTERISTIC DFES_DTCM.DFC_ComBrkTrqSumTo_FX_C "DFES/Hersteller spezifischer Fehlercode für Prüfung DFC_ComBrkTrqSumTo_FX" VALUE 0x80026680 Val_Wu16 65535.00 DFES_OneToOne 0.00 65535.00 /end CHARACTERISTIC
/begin CHARACTERISTIC DFES_DTCM.DFC_ComBtnDrvDynChk_FX_C "DFES/Hersteller spezifischer Fehlercode für Prüfung DFC_ComBtnDrvDynChk_FX" VALUE 0x80026682 Val_Wu16 65535.00 DFES_OneToOne 0.00 65535.00 /end CHARACTERISTIC
/begin CHARACTERISTIC DFES_DTCM.DFC_ComBtnDrvDynCtr_FX_C "DFES/Hersteller spezifischer Fehlercode für Prüfung DFC_ComBtnDrvDynCtr_FX" VALUE 0x80026684 Val_Wu16 65535.00 DFES_OneToOne 0.00 65535.00 /end CHARACTERISTIC
/begin CHARACTERISTIC DFES_DTCM.DFC_ComBtnDrvDynTo_FX_C "DFES/Hersteller spezifischer Fehlercode für Prüfung DFC_ComBtnDrvDynTo_FX" VALUE 0x80026686 Val_Wu16 65535.00 DFES_OneToOne 0.00 65535.00 /end CHARACTERISTIC
/begin CHARACTERISTIC DFES_DTCM.DFC_ComButtonMSASig_C "DFES/Hersteller spezifischer Fehlercode für Prüfung DFC_ComButtonMSASig" VALUE 0x80026688 Val_Wu16 65535.00 DFES_OneToOne 0.00 65535.00 /end CHARACTERISTIC
/begin CHARACTERISTIC DFES_DTCM.DFC_ComButtonMSATo_C "DFES/Hersteller spezifischer Fehlercode für Prüfung DFC_ComButtonMSATo" VALUE 0x8002668A Val_Wu16 65535.00 DFES_OneToOne 0.00 65535.00 /end CHARACTERISTIC
/begin CHARACTERISTIC DFES_DTCM.DFC_ComCodierungPwrmngSig_C "DFES/Hersteller spezifischer Fehlercode für Prüfung DFC_ComCodierungPwrmngSig" VALUE 0x8002668C Val_Wu16 65535.00 DFES_OneToOne 0.00 65535.00 /end CHARACTERISTIC
/begin CHARACTERISTIC DFES_DTCM.DFC_ComCodierungPwrmngSig_FA_C "DFES/Hersteller spezifischer Fehlercode für Prüfung DFC_ComCodierungPwrmngSig_FA" VALUE 0x8002668E Val_Wu16 65535.00 DFES_OneToOne 0.00 65535.00 /end CHARACTERISTIC
/begin CHARACTERISTIC DFES_DTCM.DFC_ComCrCtlLvrChk_C "DFES/Hersteller spezifischer Fehlercode für Prüfung DFC_ComCrCtlLvrChk" VALUE 0x80026690 Val_Wu16 65535.00 DFES_OneToOne 0.00 65535.00 /end CHARACTERISTIC
/begin CHARACTERISTIC DFES_DTCM.DFC_ComCrCtlLvrCtr_C "DFES/Hersteller spezifischer Fehlercode für Prüfung DFC_ComCrCtlLvrCtr" VALUE 0x80026692 Val_Wu16 65535.00 DFES_OneToOne 0.00 65535.00 /end CHARACTERISTIC
/begin CHARACTERISTIC DFES_DTCM.DFC_ComCrCtlLvrSig_C "DFES/Hersteller spezifischer Fehlercode für Prüfung DFC_ComCrCtlLvrSig" VALUE 0x80026694 Val_Wu16 65535.00 DFES_OneToOne 0.00 65535.00 /end CHARACTERISTIC
/begin CHARACTERISTIC DFES_DTCM.DFC_ComCrCtlLvrTo_C "DFES/Hersteller spezifischer Fehlercode für Prüfung DFC_ComCrCtlLvrTo" VALUE 0x80026696 Val_Wu16 65535.00 DFES_OneToOne 0.00 65535.00 /end CHARACTERISTIC
/begin CHARACTERISTIC DFES_DTCM.DFC_ComCtrCrshSwoEkpSig_FA_C "DFES/Hersteller spezifischer Fehlercode für Prüfung DFC_ComCtrCrshSwoEkpSig_FA" VALUE 0x80026698 Val_Wu16 65535.00 DFES_OneToOne 0.00 65535.00 /end CHARACTERISTIC
/begin CHARACTERISTIC DFES_DTCM.DFC_ComCtrCrshSwoEkpTo_FA_C "DFES/Hersteller spezifischer Fehlercode für Prüfung DFC_ComCtrCrshSwoEkpTo_FA" VALUE 0x8002669A Val_Wu16 65535.00 DFES_OneToOne 0.00 65535.00 /end CHARACTERISTIC
/begin CHARACTERISTIC DFES_DTCM.DFC_ComCtrSecInt_C "DFES/Hersteller spezifischer Fehlercode für Prüfung DFC_ComCtrSecInt" VALUE 0x8002669C Val_Wu16 65535.00 DFES_OneToOne 0.00 65535.00 /end CHARACTERISTIC
/begin CHARACTERISTIC DFES_DTCM.DFC_ComDiaOBDGbxSig_A_C "DFES/Hersteller spezifischer Fehlercode für Prüfung DFC_ComDiaOBDGbxSig_A" VALUE 0x8002669E Val_Wu16 65535.00 DFES_OneToOne 0.00 65535.00 /end CHARACTERISTIC
/begin CHARACTERISTIC DFES_DTCM.DFC_ComDiaOBDGbxTo_A_C "DFES/Hersteller spezifischer Fehlercode für Prüfung DFC_ComDiaOBDGbxTo_A" VALUE 0x800266A0 Val_Wu16 65535.00 DFES_OneToOne 0.00 65535.00 /end CHARACTERISTIC
/begin CHARACTERISTIC DFES_DTCM.DFC_ComFahrzeugtypSig_C "DFES/Hersteller spezifischer Fehlercode für Prüfung DFC_ComFahrzeugtypSig" VALUE 0x800266A2 Val_Wu16 65535.00 DFES_OneToOne 0.00 65535.00 /end CHARACTERISTIC
/begin CHARACTERISTIC DFES_DTCM.DFC_ComFahrzeugtypSig_FA_C "DFES/Hersteller spezifischer Fehlercode für Prüfung DFC_ComFahrzeugtypSig_FA" VALUE 0x800266A4 Val_Wu16 65535.00 DFES_OneToOne 0.00 65535.00 /end CHARACTERISTIC
/begin CHARACTERISTIC DFES_DTCM.DFC_ComFllupGpwsupSig_FA_C "DFES/Hersteller spezifischer Fehlercode für Prüfung DFC_ComFllupGpwsupSig_FA" VALUE 0x800266A6 Val_Wu16 65535.00 DFES_OneToOne 0.00 65535.00 /end CHARACTERISTIC
/begin CHARACTERISTIC DFES_DTCM.DFC_ComFllupGpwsupTo_FA_C "DFES/Hersteller spezifischer Fehlercode für Prüfung DFC_ComFllupGpwsupTo_FA" VALUE 0x800266A8 Val_Wu16 65535.00 DFES_OneToOne 0.00 65535.00 /end CHARACTERISTIC
/begin CHARACTERISTIC DFES_DTCM.DFC_ComGbxDataChk_A_C "DFES/Hersteller spezifischer Fehlercode für Prüfung DFC_ComGbxDataChk_A" VALUE 0x800266AA Val_Wu16 65535.00 DFES_OneToOne 0.00 65535.00 /end CHARACTERISTIC
/begin CHARACTERISTIC DFES_DTCM.DFC_ComGbxDataChk_FA_C "DFES/Hersteller spezifischer Fehlercode für Prüfung DFC_ComGbxDataChk_FA" VALUE 0x800266AC Val_Wu16 65535.00 DFES_OneToOne 0.00 65535.00 /end CHARACTERISTIC
/begin CHARACTERISTIC DFES_DTCM.DFC_ComGbxDataCtr_A_C "DFES/Hersteller spezifischer Fehlercode für Prüfung DFC_ComGbxDataCtr_A" VALUE 0x800266AE Val_Wu16 65535.00 DFES_OneToOne 0.00 65535.00 /end CHARACTERISTIC
/begin CHARACTERISTIC DFES_DTCM.DFC_ComGbxDataCtr_FA_C "DFES/Hersteller spezifischer Fehlercode für Prüfung DFC_ComGbxDataCtr_FA" VALUE 0x800266B0 Val_Wu16 65535.00 DFES_OneToOne 0.00 65535.00 /end CHARACTERISTIC
/begin CHARACTERISTIC DFES_DTCM.DFC_ComGbxDataSig_A_C "DFES/Hersteller spezifischer Fehlercode für Prüfung DFC_ComGbxDataSig_A" VALUE 0x800266B2 Val_Wu16 65535.00 DFES_OneToOne 0.00 65535.00 /end CHARACTERISTIC
/begin CHARACTERISTIC DFES_DTCM.DFC_ComGbxDataSig_FA_C "DFES/Hersteller spezifischer Fehlercode für Prüfung DFC_ComGbxDataSig_FA" VALUE 0x800266B4 Val_Wu16 65535.00 DFES_OneToOne 0.00 65535.00 /end CHARACTERISTIC
/begin CHARACTERISTIC DFES_DTCM.DFC_ComGbxDataTo_A_C "DFES/Hersteller spezifischer Fehlercode für Prüfung DFC_ComGbxDataTo_A" VALUE 0x800266B6 Val_Wu16 65535.00 DFES_OneToOne 0.00 65535.00 /end CHARACTERISTIC
/begin CHARACTERISTIC DFES_DTCM.DFC_ComGbxDataTo_FA_C "DFES/Hersteller spezifischer Fehlercode für Prüfung DFC_ComGbxDataTo_FA" VALUE 0x800266B8 Val_Wu16 65535.00 DFES_OneToOne 0.00 65535.00 /end CHARACTERISTIC
/begin CHARACTERISTIC DFES_DTCM.DFC_ComKlemmenChk_FA_C "DFES/Hersteller spezifischer Fehlercode für Prüfung DFC_ComKlemmenChk_FA" VALUE 0x800266BA Val_Wu16 65535.00 DFES_OneToOne 0.00 65535.00 /end CHARACTERISTIC
/begin CHARACTERISTIC DFES_DTCM.DFC_ComKlemmenCtr_FA_C "DFES/Hersteller spezifischer Fehlercode für Prüfung DFC_ComKlemmenCtr_FA" VALUE 0x800266BC Val_Wu16 65535.00 DFES_OneToOne 0.00 65535.00 /end CHARACTERISTIC
/begin CHARACTERISTIC DFES_DTCM.DFC_ComKlemmenSig_FA_C "DFES/Hersteller spezifischer Fehlercode für Prüfung DFC_ComKlemmenSig_FA" VALUE 0x800266BE Val_Wu16 65535.00 DFES_OneToOne 0.00 65535.00 /end CHARACTERISTIC
/begin CHARACTERISTIC DFES_DTCM.DFC_ComKlemmenTo_FA_C "DFES/Hersteller spezifischer Fehlercode für Prüfung DFC_ComKlemmenTo_FA" VALUE 0x800266C0 Val_Wu16 65535.00 DFES_OneToOne 0.00 65535.00 /end CHARACTERISTIC
/begin CHARACTERISTIC DFES_DTCM.DFC_ComLenkradwinkelSig_C "DFES/Hersteller spezifischer Fehlercode für Prüfung DFC_ComLenkradwinkelSig" VALUE 0x800266C2 Val_Wu16 65535.00 DFES_OneToOne 0.00 65535.00 /end CHARACTERISTIC
/begin CHARACTERISTIC DFES_DTCM.DFC_ComLenkradwinkelTo_C "DFES/Hersteller spezifischer Fehlercode für Prüfung DFC_ComLenkradwinkelTo" VALUE 0x800266C4 Val_Wu16 65535.00 DFES_OneToOne 0.00 65535.00 /end CHARACTERISTIC
/begin CHARACTERISTIC DFES_DTCM.DFC_ComMileageRangeSig_FA_C "DFES/Hersteller spezifischer Fehlercode für Prüfung DFC_ComMileageRangeSig_FA" VALUE 0x800266C6 Val_Wu16 65535.00 DFES_OneToOne 0.00 65535.00 /end CHARACTERISTIC
/begin CHARACTERISTIC DFES_DTCM.DFC_ComMileageRangeTo_FA_C "DFES/Hersteller spezifischer Fehlercode für Prüfung DFC_ComMileageRangeTo_FA" VALUE 0x800266C8 Val_Wu16 65535.00 DFES_OneToOne 0.00 65535.00 /end CHARACTERISTIC
/begin CHARACTERISTIC DFES_DTCM.DFC_ComPspSig_C "DFES/Hersteller spezifischer Fehlercode für Prüfung DFC_ComPspSig" VALUE 0x800266CA Val_Wu16 65535.00 DFES_OneToOne 0.00 65535.00 /end CHARACTERISTIC
/begin CHARACTERISTIC DFES_DTCM.DFC_ComPspTo_C "DFES/Hersteller spezifischer Fehlercode für Prüfung DFC_ComPspTo" VALUE 0x800266CC Val_Wu16 65535.00 DFES_OneToOne 0.00 65535.00 /end CHARACTERISTIC
/begin CHARACTERISTIC DFES_DTCM.DFC_ComRelTimeSig_FA_C "DFES/Hersteller spezifischer Fehlercode für Prüfung DFC_ComRelTimeSig_FA" VALUE 0x800266CE Val_Wu16 65535.00 DFES_OneToOne 0.00 65535.00 /end CHARACTERISTIC
/begin CHARACTERISTIC DFES_DTCM.DFC_ComRelTimeTo_FA_C "DFES/Hersteller spezifischer Fehlercode für Prüfung DFC_ComRelTimeTo_FA" VALUE 0x800266D0 Val_Wu16 65535.00 DFES_OneToOne 0.00 65535.00 /end CHARACTERISTIC
/begin CHARACTERISTIC DFES_DTCM.DFC_ComRequestEMFChk_C "DFES/Hersteller spezifischer Fehlercode für Prüfung DFC_ComRequestEMFChk" VALUE 0x800266D2 Val_Wu16 65535.00 DFES_OneToOne 0.00 65535.00 /end CHARACTERISTIC
/begin CHARACTERISTIC DFES_DTCM.DFC_ComRequestEMFCtr_C "DFES/Hersteller spezifischer Fehlercode für Prüfung DFC_ComRequestEMFCtr" VALUE 0x800266D4 Val_Wu16 65535.00 DFES_OneToOne 0.00 65535.00 /end CHARACTERISTIC
/begin CHARACTERISTIC DFES_DTCM.DFC_ComRequestEMFSig_C "DFES/Hersteller spezifischer Fehlercode für Prüfung DFC_ComRequestEMFSig" VALUE 0x800266D6 Val_Wu16 65535.00 DFES_OneToOne 0.00 65535.00 /end CHARACTERISTIC
/begin CHARACTERISTIC DFES_DTCM.DFC_ComRequestEMFTo_C "DFES/Hersteller spezifischer Fehlercode für Prüfung DFC_ComRequestEMFTo" VALUE 0x800266D8 Val_Wu16 65535.00 DFES_OneToOne 0.00 65535.00 /end CHARACTERISTIC
/begin CHARACTERISTIC DFES_DTCM.DFC_ComRpmWhlChk_FX_C "DFES/Hersteller spezifischer Fehlercode für Prüfung DFC_ComRpmWhlChk_FX" VALUE 0x800266DA Val_Wu16 65535.00 DFES_OneToOne 0.00 65535.00 /end CHARACTERISTIC
/begin CHARACTERISTIC DFES_DTCM.DFC_ComRpmWhlCtr_FX_C "DFES/Hersteller spezifischer Fehlercode für Prüfung DFC_ComRpmWhlCtr_FX" VALUE 0x800266DC Val_Wu16 65535.00 DFES_OneToOne 0.00 65535.00 /end CHARACTERISTIC
/begin CHARACTERISTIC DFES_DTCM.DFC_ComRpmWhlTo_FX_C "DFES/Hersteller spezifischer Fehlercode für Prüfung DFC_ComRpmWhlTo_FX" VALUE 0x800266DE Val_Wu16 65535.00 DFES_OneToOne 0.00 65535.00 /end CHARACTERISTIC
/begin CHARACTERISTIC DFES_DTCM.DFC_ComSecCtrRelSig_FA_C "DFES/Hersteller spezifischer Fehlercode für Prüfung DFC_ComSecCtrRelSig_FA" VALUE 0x800266E0 Val_Wu16 65535.00 DFES_OneToOne 0.00 65535.00 /end CHARACTERISTIC
/begin CHARACTERISTIC DFES_DTCM.DFC_ComSecCtrRelTo_FA_C "DFES/Hersteller spezifischer Fehlercode für Prüfung DFC_ComSecCtrRelTo_FA" VALUE 0x800266E2 Val_Wu16 65535.00 DFES_OneToOne 0.00 65535.00 /end CHARACTERISTIC
/begin CHARACTERISTIC DFES_DTCM.DFC_ComSensNOxGndSig_C "DFES/Hersteller spezifischer Fehlercode für Prüfung DFC_ComSensNOxGndSig" VALUE 0x800266E4 Val_Wu16 65535.00 DFES_OneToOne 0.00 65535.00 /end CHARACTERISTIC
/begin CHARACTERISTIC DFES_DTCM.DFC_ComSensNOxGndTo_C "DFES/Hersteller spezifischer Fehlercode für Prüfung DFC_ComSensNOxGndTo" VALUE 0x800266E6 Val_Wu16 65535.00 DFES_OneToOne 0.00 65535.00 /end CHARACTERISTIC
/begin CHARACTERISTIC DFES_DTCM.DFC_ComSensNOxMode_C "DFES/Hersteller spezifischer Fehlercode für Prüfung DFC_ComSensNOxMode" VALUE 0x800266E8 Val_Wu16 65535.00 DFES_OneToOne 0.00 65535.00 /end CHARACTERISTIC
/begin CHARACTERISTIC DFES_DTCM.DFC_ComSensNOxUbattSig_C "DFES/Hersteller spezifischer Fehlercode für Prüfung DFC_ComSensNOxUbattSig" VALUE 0x800266EA Val_Wu16 65535.00 DFES_OneToOne 0.00 65535.00 /end CHARACTERISTIC
/begin CHARACTERISTIC DFES_DTCM.DFC_ComSensNOxUbattTo_C "DFES/Hersteller spezifischer Fehlercode für Prüfung DFC_ComSensNOxUbattTo" VALUE 0x800266EC Val_Wu16 65535.00 DFES_OneToOne 0.00 65535.00 /end CHARACTERISTIC
/begin CHARACTERISTIC DFES_DTCM.DFC_ComShiftPaddleTo_FX_C "DFES/Hersteller spezifischer Fehlercode für Prüfung DFC_ComShiftPaddleTo_FX" VALUE 0x800266EE Val_Wu16 65535.00 DFES_OneToOne 0.00 65535.00 /end CHARACTERISTIC
/begin CHARACTERISTIC DFES_DTCM.DFC_ComShutOffPSPSig_C "DFES/Hersteller spezifischer Fehlercode für Prüfung DFC_ComShutOffPSPSig" VALUE 0x800266F0 Val_Wu16 65535.00 DFES_OneToOne 0.00 65535.00 /end CHARACTERISTIC
/begin CHARACTERISTIC DFES_DTCM.DFC_ComShutOffPSPTo_C "DFES/Hersteller spezifischer Fehlercode für Prüfung DFC_ComShutOffPSPTo" VALUE 0x800266F2 Val_Wu16 65535.00 DFES_OneToOne 0.00 65535.00 /end CHARACTERISTIC
/begin CHARACTERISTIC DFES_DTCM.DFC_ComSlrdiGlbFZMTo_FA_C "DFES/Hersteller spezifischer Fehlercode für Prüfung DFC_ComSlrdiGlbFZMTo_FA" VALUE 0x800266F4 Val_Wu16 65535.00 DFES_OneToOne 0.00 65535.00 /end CHARACTERISTIC
/begin CHARACTERISTIC DFES_DTCM.DFC_ComSlrdiGlbFZMTo_FX_C "DFES/Hersteller spezifischer Fehlercode für Prüfung DFC_ComSlrdiGlbFZMTo_FX" VALUE 0x800266F6 Val_Wu16 65535.00 DFES_OneToOne 0.00 65535.00 /end CHARACTERISTIC
/begin CHARACTERISTIC DFES_DTCM.DFC_ComSpeedVehicleChk_FX_C "DFES/Hersteller spezifischer Fehlercode für Prüfung DFC_ComSpeedVehicleChk_FX" VALUE 0x800266F8 Val_Wu16 65535.00 DFES_OneToOne 0.00 65535.00 /end CHARACTERISTIC
/begin CHARACTERISTIC DFES_DTCM.DFC_ComSpeedVehicleCtr_FX_C "DFES/Hersteller spezifischer Fehlercode für Prüfung DFC_ComSpeedVehicleCtr_FX" VALUE 0x800266FA Val_Wu16 65535.00 DFES_OneToOne 0.00 65535.00 /end CHARACTERISTIC
/begin CHARACTERISTIC DFES_DTCM.DFC_ComSpeedVehicleTo_FX_C "DFES/Hersteller spezifischer Fehlercode für Prüfung DFC_ComSpeedVehicleTo_FX" VALUE 0x800266FC Val_Wu16 65535.00 DFES_OneToOne 0.00 65535.00 /end CHARACTERISTIC
/begin CHARACTERISTIC DFES_DTCM.DFC_ComStConintDSCChk_FX_C "DFES/Hersteller spezifischer Fehlercode für Prüfung DFC_ComStConintDSCChk_FX" VALUE 0x800266FE Val_Wu16 65535.00 DFES_OneToOne 0.00 65535.00 /end CHARACTERISTIC
/begin CHARACTERISTIC DFES_DTCM.DFC_ComStConintDSCCtr_FX_C "DFES/Hersteller spezifischer Fehlercode für Prüfung DFC_ComStConintDSCCtr_FX" VALUE 0x80026700 Val_Wu16 65535.00 DFES_OneToOne 0.00 65535.00 /end CHARACTERISTIC
/begin CHARACTERISTIC DFES_DTCM.DFC_ComStConintDSCTo_FX_C "DFES/Hersteller spezifischer Fehlercode für Prüfung DFC_ComStConintDSCTo_FX" VALUE 0x80026702 Val_Wu16 65535.00 DFES_OneToOne 0.00 65535.00 /end CHARACTERISTIC
/begin CHARACTERISTIC DFES_DTCM.DFC_ComStatACFrontSig_FA_C "DFES/Hersteller spezifischer Fehlercode für Prüfung DFC_ComStatACFrontSig_FA" VALUE 0x80026704 Val_Wu16 65535.00 DFES_OneToOne 0.00 65535.00 /end CHARACTERISTIC
/begin CHARACTERISTIC DFES_DTCM.DFC_ComStatACFrontTo_FA_C "DFES/Hersteller spezifischer Fehlercode für Prüfung DFC_ComStatACFrontTo_FA" VALUE 0x80026706 Val_Wu16 65535.00 DFES_OneToOne 0.00 65535.00 /end CHARACTERISTIC
/begin CHARACTERISTIC DFES_DTCM.DFC_ComStatEkpSig_A_C "DFES/Hersteller spezifischer Fehlercode für Prüfung DFC_ComStatEkpSig_A" VALUE 0x80026708 Val_Wu16 65535.00 DFES_OneToOne 0.00 65535.00 /end CHARACTERISTIC
/begin CHARACTERISTIC DFES_DTCM.DFC_ComStatEkpTo_A_C "DFES/Hersteller spezifischer Fehlercode für Prüfung DFC_ComStatEkpTo_A" VALUE 0x8002670A Val_Wu16 65535.00 DFES_OneToOne 0.00 65535.00 /end CHARACTERISTIC
/begin CHARACTERISTIC DFES_DTCM.DFC_ComStatGearRevSig_FA_C "DFES/Hersteller spezifischer Fehlercode für Prüfung DFC_ComStatGearRevSig_FA" VALUE 0x8002670C Val_Wu16 65535.00 DFES_OneToOne 0.00 65535.00 /end CHARACTERISTIC
/begin CHARACTERISTIC DFES_DTCM.DFC_ComStatGearRevTo_FA_C "DFES/Hersteller spezifischer Fehlercode für Prüfung DFC_ComStatGearRevTo_FA" VALUE 0x8002670E Val_Wu16 65535.00 DFES_OneToOne 0.00 65535.00 /end CHARACTERISTIC
/begin CHARACTERISTIC DFES_DTCM.DFC_ComStatZVKlappenSig_FA_C "DFES/Hersteller spezifischer Fehlercode für Prüfung DFC_ComStatZVKlappenSig_FA" VALUE 0x80026710 Val_Wu16 65535.00 DFES_OneToOne 0.00 65535.00 /end CHARACTERISTIC
/begin CHARACTERISTIC DFES_DTCM.DFC_ComStatZVKlappenTo_FA_C "DFES/Hersteller spezifischer Fehlercode für Prüfung DFC_ComStatZVKlappenTo_FA" VALUE 0x80026712 Val_Wu16 65535.00 DFES_OneToOne 0.00 65535.00 /end CHARACTERISTIC
/begin CHARACTERISTIC DFES_DTCM.DFC_ComStateARSCtr_C "DFES/Hersteller spezifischer Fehlercode für Prüfung DFC_ComStateARSCtr" VALUE 0x80026714 Val_Wu16 65535.00 DFES_OneToOne 0.00 65535.00 /end CHARACTERISTIC
/begin CHARACTERISTIC DFES_DTCM.DFC_ComStateARSSig_C "DFES/Hersteller spezifischer Fehlercode für Prüfung DFC_ComStateARSSig" VALUE 0x80026716 Val_Wu16 65535.00 DFES_OneToOne 0.00 65535.00 /end CHARACTERISTIC
/begin CHARACTERISTIC DFES_DTCM.DFC_ComStateARSTo_C "DFES/Hersteller spezifischer Fehlercode für Prüfung DFC_ComStateARSTo" VALUE 0x80026718 Val_Wu16 65535.00 DFES_OneToOne 0.00 65535.00 /end CHARACTERISTIC
/begin CHARACTERISTIC DFES_DTCM.DFC_ComStateDscSig_C "DFES/Hersteller spezifischer Fehlercode für Prüfung DFC_ComStateDscSig" VALUE 0x8002671A Val_Wu16 65535.00 DFES_OneToOne 0.00 65535.00 /end CHARACTERISTIC
/begin CHARACTERISTIC DFES_DTCM.DFC_ComStateDscTo_C "DFES/Hersteller spezifischer Fehlercode für Prüfung DFC_ComStateDscTo" VALUE 0x8002671C Val_Wu16 65535.00 DFES_OneToOne 0.00 65535.00 /end CHARACTERISTIC
/begin CHARACTERISTIC DFES_DTCM.DFC_ComStateSeatSig_C "DFES/Hersteller spezifischer Fehlercode für Prüfung DFC_ComStateSeatSig" VALUE 0x8002671E Val_Wu16 65535.00 DFES_OneToOne 0.00 65535.00 /end CHARACTERISTIC
/begin CHARACTERISTIC DFES_DTCM.DFC_ComStateSeatSig_FA_C "DFES/Hersteller spezifischer Fehlercode für Prüfung DFC_ComStateSeatSig_FA" VALUE 0x80026720 Val_Wu16 65535.00 DFES_OneToOne 0.00 65535.00 /end CHARACTERISTIC
/begin CHARACTERISTIC DFES_DTCM.DFC_ComStateSeatTo_C "DFES/Hersteller spezifischer Fehlercode für Prüfung DFC_ComStateSeatTo" VALUE 0x80026722 Val_Wu16 65535.00 DFES_OneToOne 0.00 65535.00 /end CHARACTERISTIC
/begin CHARACTERISTIC DFES_DTCM.DFC_ComStateSeatTo_FA_C "DFES/Hersteller spezifischer Fehlercode für Prüfung DFC_ComStateSeatTo_FA" VALUE 0x80026724 Val_Wu16 65535.00 DFES_OneToOne 0.00 65535.00 /end CHARACTERISTIC
/begin CHARACTERISTIC DFES_DTCM.DFC_ComStatusEGSSig_A_C "DFES/Hersteller spezifischer Fehlercode für Prüfung DFC_ComStatusEGSSig_A" VALUE 0x80026726 Val_Wu16 65535.00 DFES_OneToOne 0.00 65535.00 /end CHARACTERISTIC
/begin CHARACTERISTIC DFES_DTCM.DFC_ComStatusEGSSig_FA_C "DFES/Hersteller spezifischer Fehlercode für Prüfung DFC_ComStatusEGSSig_FA" VALUE 0x80026728 Val_Wu16 65535.00 DFES_OneToOne 0.00 65535.00 /end CHARACTERISTIC
/begin CHARACTERISTIC DFES_DTCM.DFC_ComStatusEGSTo_A_C "DFES/Hersteller spezifischer Fehlercode für Prüfung DFC_ComStatusEGSTo_A" VALUE 0x8002672A Val_Wu16 65535.00 DFES_OneToOne 0.00 65535.00 /end CHARACTERISTIC
/begin CHARACTERISTIC DFES_DTCM.DFC_ComStatusEGSTo_FA_C "DFES/Hersteller spezifischer Fehlercode für Prüfung DFC_ComStatusEGSTo_FA" VALUE 0x8002672C Val_Wu16 65535.00 DFES_OneToOne 0.00 65535.00 /end CHARACTERISTIC
/begin CHARACTERISTIC DFES_DTCM.DFC_ComStatusEMFChk_C "DFES/Hersteller spezifischer Fehlercode für Prüfung DFC_ComStatusEMFChk" VALUE 0x8002672E Val_Wu16 65535.00 DFES_OneToOne 0.00 65535.00 /end CHARACTERISTIC
/begin CHARACTERISTIC DFES_DTCM.DFC_ComStatusEMFCtr_C "DFES/Hersteller spezifischer Fehlercode für Prüfung DFC_ComStatusEMFCtr" VALUE 0x80026730 Val_Wu16 65535.00 DFES_OneToOne 0.00 65535.00 /end CHARACTERISTIC
/begin CHARACTERISTIC DFES_DTCM.DFC_ComStatusEMFSig_C "DFES/Hersteller spezifischer Fehlercode für Prüfung DFC_ComStatusEMFSig" VALUE 0x80026732 Val_Wu16 65535.00 DFES_OneToOne 0.00 65535.00 /end CHARACTERISTIC
/begin CHARACTERISTIC DFES_DTCM.DFC_ComStatusEMFTo_C "DFES/Hersteller spezifischer Fehlercode für Prüfung DFC_ComStatusEMFTo" VALUE 0x80026734 Val_Wu16 65535.00 DFES_OneToOne 0.00 65535.00 /end CHARACTERISTIC
/begin CHARACTERISTIC DFES_DTCM.DFC_ComStatusRGangSig_C "DFES/Hersteller spezifischer Fehlercode für Prüfung DFC_ComStatusRGangSig" VALUE 0x80026736 Val_Wu16 65535.00 DFES_OneToOne 0.00 65535.00 /end CHARACTERISTIC
/begin CHARACTERISTIC DFES_DTCM.DFC_ComStatusRGangTo_C "DFES/Hersteller spezifischer Fehlercode für Prüfung DFC_ComStatusRGangTo" VALUE 0x80026738 Val_Wu16 65535.00 DFES_OneToOne 0.00 65535.00 /end CHARACTERISTIC
/begin CHARACTERISTIC DFES_DTCM.DFC_ComSteeringAngleChk_FX_C "DFES/Hersteller spezifischer Fehlercode für Prüfung DFC_ComSteeringAngleChk_FX" VALUE 0x8002673A Val_Wu16 65535.00 DFES_OneToOne 0.00 65535.00 /end CHARACTERISTIC
/begin CHARACTERISTIC DFES_DTCM.DFC_ComSteeringAngleCtr_FX_C "DFES/Hersteller spezifischer Fehlercode für Prüfung DFC_ComSteeringAngleCtr_FX" VALUE 0x8002673C Val_Wu16 65535.00 DFES_OneToOne 0.00 65535.00 /end CHARACTERISTIC
/begin CHARACTERISTIC DFES_DTCM.DFC_ComSteeringAngleTo_FX_C "DFES/Hersteller spezifischer Fehlercode für Prüfung DFC_ComSteeringAngleTo_FX" VALUE 0x8002673E Val_Wu16 65535.00 DFES_OneToOne 0.00 65535.00 /end CHARACTERISTIC
/begin CHARACTERISTIC DFES_DTCM.DFC_ComTerminalChk_C "DFES/Hersteller spezifischer Fehlercode für Prüfung DFC_ComTerminalChk" VALUE 0x80026740 Val_Wu16 65535.00 DFES_OneToOne 0.00 65535.00 /end CHARACTERISTIC
/begin CHARACTERISTIC DFES_DTCM.DFC_ComTerminalCtr_C "DFES/Hersteller spezifischer Fehlercode für Prüfung DFC_ComTerminalCtr" VALUE 0x80026742 Val_Wu16 65535.00 DFES_OneToOne 0.00 65535.00 /end CHARACTERISTIC
/begin CHARACTERISTIC DFES_DTCM.DFC_ComTerminalSig_C "DFES/Hersteller spezifischer Fehlercode für Prüfung DFC_ComTerminalSig" VALUE 0x80026744 Val_Wu16 65535.00 DFES_OneToOne 0.00 65535.00 /end CHARACTERISTIC
/begin CHARACTERISTIC DFES_DTCM.DFC_ComTerminalTo_C "DFES/Hersteller spezifischer Fehlercode für Prüfung DFC_ComTerminalTo" VALUE 0x80026746 Val_Wu16 65535.00 DFES_OneToOne 0.00 65535.00 /end CHARACTERISTIC
/begin CHARACTERISTIC DFES_DTCM.DFC_ComTimeDateSig_FA_C "DFES/Hersteller spezifischer Fehlercode für Prüfung DFC_ComTimeDateSig_FA" VALUE 0x80026748 Val_Wu16 65535.00 DFES_OneToOne 0.00 65535.00 /end CHARACTERISTIC
/begin CHARACTERISTIC DFES_DTCM.DFC_ComTimeDateTo_FA_C "DFES/Hersteller spezifischer Fehlercode für Prüfung DFC_ComTimeDateTo_FA" VALUE 0x8002674A Val_Wu16 65535.00 DFES_OneToOne 0.00 65535.00 /end CHARACTERISTIC
/begin CHARACTERISTIC DFES_DTCM.DFC_ComTrailerSig_C "DFES/Hersteller spezifischer Fehlercode für Prüfung DFC_ComTrailerSig" VALUE 0x8002674C Val_Wu16 65535.00 DFES_OneToOne 0.00 65535.00 /end CHARACTERISTIC
/begin CHARACTERISTIC DFES_DTCM.DFC_ComTrailerSig_FA_C "DFES/Hersteller spezifischer Fehlercode für Prüfung DFC_ComTrailerSig_FA" VALUE 0x8002674E Val_Wu16 65535.00 DFES_OneToOne 0.00 65535.00 /end CHARACTERISTIC
/begin CHARACTERISTIC DFES_DTCM.DFC_ComTrailerTo_C "DFES/Hersteller spezifischer Fehlercode für Prüfung DFC_ComTrailerTo" VALUE 0x80026750 Val_Wu16 65535.00 DFES_OneToOne 0.00 65535.00 /end CHARACTERISTIC
/begin CHARACTERISTIC DFES_DTCM.DFC_ComTrailerTo_FA_C "DFES/Hersteller spezifischer Fehlercode für Prüfung DFC_ComTrailerTo_FA" VALUE 0x80026752 Val_Wu16 65535.00 DFES_OneToOne 0.00 65535.00 /end CHARACTERISTIC
/begin CHARACTERISTIC DFES_DTCM.DFC_ComTrqDemCrshDrDyChk_FX_C "DFES/Hersteller spezifischer Fehlercode für Prüfung DFC_ComTrqDemCrshDrDyChk_FX" VALUE 0x80026754 Val_Wu16 65535.00 DFES_OneToOne 0.00 65535.00 /end CHARACTERISTIC
/begin CHARACTERISTIC DFES_DTCM.DFC_ComTrqDemCrshDrDyCtr_FX_C "DFES/Hersteller spezifischer Fehlercode für Prüfung DFC_ComTrqDemCrshDrDyCtr_FX" VALUE 0x80026756 Val_Wu16 65535.00 DFES_OneToOne 0.00 65535.00 /end CHARACTERISTIC
/begin CHARACTERISTIC DFES_DTCM.DFC_ComTrqDemCrshDrDyTo_FX_C "DFES/Hersteller spezifischer Fehlercode für Prüfung DFC_ComTrqDemCrshDrDyTo_FX" VALUE 0x80026758 Val_Wu16 65535.00 DFES_OneToOne 0.00 65535.00 /end CHARACTERISTIC
/begin CHARACTERISTIC DFES_DTCM.DFC_ComTrqDemandDesSig_C "DFES/Hersteller spezifischer Fehlercode für Prüfung DFC_ComTrqDemandDesSig" VALUE 0x8002675A Val_Wu16 65535.00 DFES_OneToOne 0.00 65535.00 /end CHARACTERISTIC
/begin CHARACTERISTIC DFES_DTCM.DFC_ComTrqDemandDesTo_C "DFES/Hersteller spezifischer Fehlercode für Prüfung DFC_ComTrqDemandDesTo" VALUE 0x8002675C Val_Wu16 65535.00 DFES_OneToOne 0.00 65535.00 /end CHARACTERISTIC
/begin CHARACTERISTIC DFES_DTCM.DFC_ComTrqDemandDscChk_C "DFES/Hersteller spezifischer Fehlercode für Prüfung DFC_ComTrqDemandDscChk" VALUE 0x8002675E Val_Wu16 65535.00 DFES_OneToOne 0.00 65535.00 /end CHARACTERISTIC
/begin CHARACTERISTIC DFES_DTCM.DFC_ComTrqDemandDscCtr_C "DFES/Hersteller spezifischer Fehlercode für Prüfung DFC_ComTrqDemandDscCtr" VALUE 0x80026760 Val_Wu16 65535.00 DFES_OneToOne 0.00 65535.00 /end CHARACTERISTIC
/begin CHARACTERISTIC DFES_DTCM.DFC_ComTrqDemandDscSig_C "DFES/Hersteller spezifischer Fehlercode für Prüfung DFC_ComTrqDemandDscSig" VALUE 0x80026762 Val_Wu16 65535.00 DFES_OneToOne 0.00 65535.00 /end CHARACTERISTIC
/begin CHARACTERISTIC DFES_DTCM.DFC_ComTrqDemandDscTo_C "DFES/Hersteller spezifischer Fehlercode für Prüfung DFC_ComTrqDemandDscTo" VALUE 0x80026764 Val_Wu16 65535.00 DFES_OneToOne 0.00 65535.00 /end CHARACTERISTIC
/begin CHARACTERISTIC DFES_DTCM.DFC_ComTrqDemandGbxChk_A_C "DFES/Hersteller spezifischer Fehlercode für Prüfung DFC_ComTrqDemandGbxChk_A" VALUE 0x80026766 Val_Wu16 65535.00 DFES_OneToOne 0.00 65535.00 /end CHARACTERISTIC
/begin CHARACTERISTIC DFES_DTCM.DFC_ComTrqDemandGbxChk_FA_C "DFES/Hersteller spezifischer Fehlercode für Prüfung DFC_ComTrqDemandGbxChk_FA" VALUE 0x80026768 Val_Wu16 65535.00 DFES_OneToOne 0.00 65535.00 /end CHARACTERISTIC
/begin CHARACTERISTIC DFES_DTCM.DFC_ComTrqDemandGbxCtr_A_C "DFES/Hersteller spezifischer Fehlercode für Prüfung DFC_ComTrqDemandGbxCtr_A" VALUE 0x8002676A Val_Wu16 65535.00 DFES_OneToOne 0.00 65535.00 /end CHARACTERISTIC
/begin CHARACTERISTIC DFES_DTCM.DFC_ComTrqDemandGbxCtr_FA_C "DFES/Hersteller spezifischer Fehlercode für Prüfung DFC_ComTrqDemandGbxCtr_FA" VALUE 0x8002676C Val_Wu16 65535.00 DFES_OneToOne 0.00 65535.00 /end CHARACTERISTIC
/begin CHARACTERISTIC DFES_DTCM.DFC_ComTrqDemandGbxSig_A_C "DFES/Hersteller spezifischer Fehlercode für Prüfung DFC_ComTrqDemandGbxSig_A" VALUE 0x8002676E Val_Wu16 65535.00 DFES_OneToOne 0.00 65535.00 /end CHARACTERISTIC
/begin CHARACTERISTIC DFES_DTCM.DFC_ComTrqDemandGbxSig_FA_C "DFES/Hersteller spezifischer Fehlercode für Prüfung DFC_ComTrqDemandGbxSig_FA" VALUE 0x80026770 Val_Wu16 65535.00 DFES_OneToOne 0.00 65535.00 /end CHARACTERISTIC
/begin CHARACTERISTIC DFES_DTCM.DFC_ComTrqDemandGbxTo_A_C "DFES/Hersteller spezifischer Fehlercode für Prüfung DFC_ComTrqDemandGbxTo_A" VALUE 0x80026772 Val_Wu16 65535.00 DFES_OneToOne 0.00 65535.00 /end CHARACTERISTIC
/begin CHARACTERISTIC DFES_DTCM.DFC_ComTrqDemandGbxTo_FA_C "DFES/Hersteller spezifischer Fehlercode für Prüfung DFC_ComTrqDemandGbxTo_FA" VALUE 0x80026774 Val_Wu16 65535.00 DFES_OneToOne 0.00 65535.00 /end CHARACTERISTIC
/begin CHARACTERISTIC DFES_DTCM.DFC_ComTrqWhlDemChk_C "DFES/Hersteller spezifischer Fehlercode für Prüfung DFC_ComTrqWhlDemChk" VALUE 0x80026776 Val_Wu16 65535.00 DFES_OneToOne 0.00 65535.00 /end CHARACTERISTIC
/begin CHARACTERISTIC DFES_DTCM.DFC_ComTrqWhlDemCtr_C "DFES/Hersteller spezifischer Fehlercode für Prüfung DFC_ComTrqWhlDemCtr" VALUE 0x80026778 Val_Wu16 65535.00 DFES_OneToOne 0.00 65535.00 /end CHARACTERISTIC
/begin CHARACTERISTIC DFES_DTCM.DFC_ComTrqWhlDemFASChk_FX_C "DFES/Hersteller spezifischer Fehlercode für Prüfung DFC_ComTrqWhlDemFASChk_FX" VALUE 0x8002677A Val_Wu16 65535.00 DFES_OneToOne 0.00 65535.00 /end CHARACTERISTIC
/begin CHARACTERISTIC DFES_DTCM.DFC_ComTrqWhlDemFASCtr_FX_C "DFES/Hersteller spezifischer Fehlercode für Prüfung DFC_ComTrqWhlDemFASCtr_FX" VALUE 0x8002677C Val_Wu16 65535.00 DFES_OneToOne 0.00 65535.00 /end CHARACTERISTIC
/begin CHARACTERISTIC DFES_DTCM.DFC_ComTrqWhlDemFASTo_FX_C "DFES/Hersteller spezifischer Fehlercode für Prüfung DFC_ComTrqWhlDemFASTo_FX" VALUE 0x8002677E Val_Wu16 65535.00 DFES_OneToOne 0.00 65535.00 /end CHARACTERISTIC
/begin CHARACTERISTIC DFES_DTCM.DFC_ComTrqWhlDemSig_C "DFES/Hersteller spezifischer Fehlercode für Prüfung DFC_ComTrqWhlDemSig" VALUE 0x80026780 Val_Wu16 65535.00 DFES_OneToOne 0.00 65535.00 /end CHARACTERISTIC
/begin CHARACTERISTIC DFES_DTCM.DFC_ComTrqWhlDemTo_C "DFES/Hersteller spezifischer Fehlercode für Prüfung DFC_ComTrqWhlDemTo" VALUE 0x80026782 Val_Wu16 65535.00 DFES_OneToOne 0.00 65535.00 /end CHARACTERISTIC
/begin CHARACTERISTIC DFES_DTCM.DFC_ComVelocityChk_FA_C "DFES/Hersteller spezifischer Fehlercode für Prüfung DFC_ComVelocityChk_FA" VALUE 0x80026784 Val_Wu16 65535.00 DFES_OneToOne 0.00 65535.00 /end CHARACTERISTIC
/begin CHARACTERISTIC DFES_DTCM.DFC_ComVelocityCtr_FA_C "DFES/Hersteller spezifischer Fehlercode für Prüfung DFC_ComVelocityCtr_FA" VALUE 0x80026786 Val_Wu16 65535.00 DFES_OneToOne 0.00 65535.00 /end CHARACTERISTIC
/begin CHARACTERISTIC DFES_DTCM.DFC_ComVelocitySig_C "DFES/Hersteller spezifischer Fehlercode für Prüfung DFC_ComVelocitySig" VALUE 0x80026788 Val_Wu16 65535.00 DFES_OneToOne 0.00 65535.00 /end CHARACTERISTIC
/begin CHARACTERISTIC DFES_DTCM.DFC_ComVelocitySig_FA_C "DFES/Hersteller spezifischer Fehlercode für Prüfung DFC_ComVelocitySig_FA" VALUE 0x8002678A Val_Wu16 65535.00 DFES_OneToOne 0.00 65535.00 /end CHARACTERISTIC
/begin CHARACTERISTIC DFES_DTCM.DFC_ComVelocityTo_C "DFES/Hersteller spezifischer Fehlercode für Prüfung DFC_ComVelocityTo" VALUE 0x8002678C Val_Wu16 65535.00 DFES_OneToOne 0.00 65535.00 /end CHARACTERISTIC
/begin CHARACTERISTIC DFES_DTCM.DFC_ComVelocityTo_FA_C "DFES/Hersteller spezifischer Fehlercode für Prüfung DFC_ComVelocityTo_FA" VALUE 0x8002678E Val_Wu16 65535.00 DFES_OneToOne 0.00 65535.00 /end CHARACTERISTIC
/begin CHARACTERISTIC DFES_DTCM.DFC_ComVerbraucherTo_C "DFES/Hersteller spezifischer Fehlercode für Prüfung DFC_ComVerbraucherTo" VALUE 0x80026790 Val_Wu16 65535.00 DFES_OneToOne 0.00 65535.00 /end CHARACTERISTIC
/begin CHARACTERISTIC DFES_DTCM.DFC_ComWMomPTStabChk_FX_C "DFES/Hersteller spezifischer Fehlercode für Prüfung DFC_ComWMomPTStabChk_FX" VALUE 0x80026792 Val_Wu16 65535.00 DFES_OneToOne 0.00 65535.00 /end CHARACTERISTIC
/begin CHARACTERISTIC DFES_DTCM.DFC_ComWMomPTStabCtr_FX_C "DFES/Hersteller spezifischer Fehlercode für Prüfung DFC_ComWMomPTStabCtr_FX" VALUE 0x80026794 Val_Wu16 65535.00 DFES_OneToOne 0.00 65535.00 /end CHARACTERISTIC
/begin CHARACTERISTIC DFES_DTCM.DFC_ComWMomPTStabTo_FX_C "DFES/Hersteller spezifischer Fehlercode für Prüfung DFC_ComWMomPTStabTo_FX" VALUE 0x80026796 Val_Wu16 65535.00 DFES_OneToOne 0.00 65535.00 /end CHARACTERISTIC
/begin CHARACTERISTIC DFES_DTCM.DFC_ComWheelSpeedSig_C "DFES/Hersteller spezifischer Fehlercode für Prüfung DFC_ComWheelSpeedSig" VALUE 0x80026798 Val_Wu16 65535.00 DFES_OneToOne 0.00 65535.00 /end CHARACTERISTIC
/begin CHARACTERISTIC DFES_DTCM.DFC_ComWheelSpeedTo_C "DFES/Hersteller spezifischer Fehlercode für Prüfung DFC_ComWheelSpeedTo" VALUE 0x8002679A Val_Wu16 65535.00 DFES_OneToOne 0.00 65535.00 /end CHARACTERISTIC
/begin CHARACTERISTIC DFES_DTCM.DFC_ComZvKlappenSig_C "DFES/Hersteller spezifischer Fehlercode für Prüfung DFC_ComZvKlappenSig" VALUE 0x8002679C Val_Wu16 65535.00 DFES_OneToOne 0.00 65535.00 /end CHARACTERISTIC
/begin CHARACTERISTIC DFES_DTCM.DFC_ComZvKlappenTo_C "DFES/Hersteller spezifischer Fehlercode für Prüfung DFC_ComZvKlappenTo" VALUE 0x8002679E Val_Wu16 65535.00 DFES_OneToOne 0.00 65535.00 /end CHARACTERISTIC
/begin CHARACTERISTIC DFES_DTCM.DFC_ComaDirectChk_FX_C "DFES/Hersteller spezifischer Fehlercode für Prüfung DFC_ComaDirectChk_FX" VALUE 0x800267A0 Val_Wu16 65535.00 DFES_OneToOne 0.00 65535.00 /end CHARACTERISTIC
/begin CHARACTERISTIC DFES_DTCM.DFC_ComaDirectCtr_FX_C "DFES/Hersteller spezifischer Fehlercode für Prüfung DFC_ComaDirectCtr_FX" VALUE 0x800267A2 Val_Wu16 65535.00 DFES_OneToOne 0.00 65535.00 /end CHARACTERISTIC
/begin CHARACTERISTIC DFES_DTCM.DFC_ComaDirectTo_FX_C "DFES/Hersteller spezifischer Fehlercode für Prüfung DFC_ComaDirectTo_FX" VALUE 0x800267A4 Val_Wu16 65535.00 DFES_OneToOne 0.00 65535.00 /end CHARACTERISTIC
/begin CHARACTERISTIC DFES_DTCM.DFC_ComaSideChk_FX_C "DFES/Hersteller spezifischer Fehlercode für Prüfung DFC_ComaSideChk_FX" VALUE 0x800267A6 Val_Wu16 65535.00 DFES_OneToOne 0.00 65535.00 /end CHARACTERISTIC
/begin CHARACTERISTIC DFES_DTCM.DFC_ComaSideCtr_FX_C "DFES/Hersteller spezifischer Fehlercode für Prüfung DFC_ComaSideCtr_FX" VALUE 0x800267A8 Val_Wu16 65535.00 DFES_OneToOne 0.00 65535.00 /end CHARACTERISTIC
/begin CHARACTERISTIC DFES_DTCM.DFC_ComaSideTo_FX_C "DFES/Hersteller spezifischer Fehlercode für Prüfung DFC_ComaSideTo_FX" VALUE 0x800267AA Val_Wu16 65535.00 DFES_OneToOne 0.00 65535.00 /end CHARACTERISTIC
/begin CHARACTERISTIC DFES_DTCM.DFC_Cy320SpiCom_C "DFES/Hersteller spezifischer Fehlercode für Prüfung DFC_Cy320SpiCom" VALUE 0x800267AC Val_Wu16 65535.00 DFES_OneToOne 0.00 65535.00 /end CHARACTERISTIC
/begin CHARACTERISTIC DFES_DTCM.DFC_ETCtlDvtInrMax_C "DFES/Hersteller spezifischer Fehlercode für Prüfung DFC_ETCtlDvtInrMax" VALUE 0x800267AE Val_Wu16 65535.00 DFES_OneToOne 0.00 65535.00 /end CHARACTERISTIC
/begin CHARACTERISTIC DFES_DTCM.DFC_ETCtlDvtInrMin_C "DFES/Hersteller spezifischer Fehlercode für Prüfung DFC_ETCtlDvtInrMin" VALUE 0x800267B0 Val_Wu16 65535.00 DFES_OneToOne 0.00 65535.00 /end CHARACTERISTIC
/begin CHARACTERISTIC DFES_DTCM.DFC_ETCtlDvtOutrMax_C "DFES/Hersteller spezifischer Fehlercode für Prüfung DFC_ETCtlDvtOutrMax" VALUE 0x800267B2 Val_Wu16 65535.00 DFES_OneToOne 0.00 65535.00 /end CHARACTERISTIC
/begin CHARACTERISTIC DFES_DTCM.DFC_ETCtlDvtOutrMin_C "DFES/Hersteller spezifischer Fehlercode für Prüfung DFC_ETCtlDvtOutrMin" VALUE 0x800267B4 Val_Wu16 65535.00 DFES_OneToOne 0.00 65535.00 /end CHARACTERISTIC
/begin CHARACTERISTIC DFES_DTCM.DFC_FBCqDvtMax_C "DFES/Hersteller spezifischer Fehlercode für Prüfung DFC_FBCqDvtMax" VALUE 0x800267B6 Val_Wu16 65535.00 DFES_OneToOne 0.00 65535.00 /end CHARACTERISTIC
/begin CHARACTERISTIC DFES_DTCM.DFC_FBCqDvtMin_C "DFES/Hersteller spezifischer Fehlercode für Prüfung DFC_FBCqDvtMin" VALUE 0x800267B8 Val_Wu16 65535.00 DFES_OneToOne 0.00 65535.00 /end CHARACTERISTIC
/begin CHARACTERISTIC DFES_DTCM.DFC_Fan4WinErr1_C "DFES/Hersteller spezifischer Fehlercode für Prüfung DFC_Fan4WinErr1" VALUE 0x800267BA Val_Wu16 65535.00 DFES_OneToOne 0.00 65535.00 /end CHARACTERISTIC
/begin CHARACTERISTIC DFES_DTCM.DFC_Fan4WinErr2_C "DFES/Hersteller spezifischer Fehlercode für Prüfung DFC_Fan4WinErr2" VALUE 0x800267BC Val_Wu16 65535.00 DFES_OneToOne 0.00 65535.00 /end CHARACTERISTIC
/begin CHARACTERISTIC DFES_DTCM.DFC_Fan4WinErr3_C "DFES/Hersteller spezifischer Fehlercode für Prüfung DFC_Fan4WinErr3" VALUE 0x800267BE Val_Wu16 65535.00 DFES_OneToOne 0.00 65535.00 /end CHARACTERISTIC
/begin CHARACTERISTIC DFES_DTCM.DFC_Fan4WinErr4_C "DFES/Hersteller spezifischer Fehlercode für Prüfung DFC_Fan4WinErr4" VALUE 0x800267C0 Val_Wu16 65535.00 DFES_OneToOne 0.00 65535.00 /end CHARACTERISTIC
/begin CHARACTERISTIC DFES_DTCM.DFC_FanSCG_C "DFES/Hersteller spezifischer Fehlercode für Prüfung DFC_FanSCG" VALUE 0x800267C2 Val_Wu16 65535.00 DFES_OneToOne 0.00 65535.00 /end CHARACTERISTIC
/begin CHARACTERISTIC DFES_DTCM.DFC_FlFCBS_C "DFES/Hersteller spezifischer Fehlercode für Prüfung DFC_FlFCBS" VALUE 0x800267C4 Val_Wu16 65535.00 DFES_OneToOne 0.00 65535.00 /end CHARACTERISTIC
/begin CHARACTERISTIC DFES_DTCM.DFC_GlwEcuConfigErr_C "DFES/Hersteller spezifischer Fehlercode für Prüfung DFC_GlwEcuConfigErr" VALUE 0x800267C6 Val_Wu16 65535.00 DFES_OneToOne 0.00 65535.00 /end CHARACTERISTIC
/begin CHARACTERISTIC DFES_DTCM.DFC_GlwEcuEepErr_C "DFES/Hersteller spezifischer Fehlercode für Prüfung DFC_GlwEcuEepErr" VALUE 0x800267C8 Val_Wu16 65535.00 DFES_OneToOne 0.00 65535.00 /end CHARACTERISTIC
/begin CHARACTERISTIC DFES_DTCM.DFC_GlwEcuFrmErr_C "DFES/Hersteller spezifischer Fehlercode für Prüfung DFC_GlwEcuFrmErr" VALUE 0x800267CA Val_Wu16 65535.00 DFES_OneToOne 0.00 65535.00 /end CHARACTERISTIC
/begin CHARACTERISTIC DFES_DTCM.DFC_GlwEcuGPCMFaultInfo_C "DFES/Hersteller spezifischer Fehlercode für Prüfung DFC_GlwEcuGPCMFaultInfo" VALUE 0x800267CC Val_Wu16 65535.00 DFES_OneToOne 0.00 65535.00 /end CHARACTERISTIC
/begin CHARACTERISTIC DFES_DTCM.DFC_GlwEcuGPCMInfo_C "DFES/Hersteller spezifischer Fehlercode für Prüfung DFC_GlwEcuGPCMInfo" VALUE 0x800267CE Val_Wu16 65535.00 DFES_OneToOne 0.00 65535.00 /end CHARACTERISTIC
/begin CHARACTERISTIC DFES_DTCM.DFC_GlwEcuGk1HSS_C "DFES/Hersteller spezifischer Fehlercode für Prüfung DFC_GlwEcuGk1HSS" VALUE 0x800267D0 Val_Wu16 65535.00 DFES_OneToOne 0.00 65535.00 /end CHARACTERISTIC
/begin CHARACTERISTIC DFES_DTCM.DFC_GlwEcuGk1OL_C "DFES/Hersteller spezifischer Fehlercode für Prüfung DFC_GlwEcuGk1OL" VALUE 0x800267D2 Val_Wu16 65535.00 DFES_OneToOne 0.00 65535.00 /end CHARACTERISTIC
/begin CHARACTERISTIC DFES_DTCM.DFC_GlwEcuGk1SC_C "DFES/Hersteller spezifischer Fehlercode für Prüfung DFC_GlwEcuGk1SC" VALUE 0x800267D4 Val_Wu16 65535.00 DFES_OneToOne 0.00 65535.00 /end CHARACTERISTIC
/begin CHARACTERISTIC DFES_DTCM.DFC_GlwEcuGk1Wdst_C "DFES/Hersteller spezifischer Fehlercode für Prüfung DFC_GlwEcuGk1Wdst" VALUE 0x800267D6 Val_Wu16 65535.00 DFES_OneToOne 0.00 65535.00 /end CHARACTERISTIC
/begin CHARACTERISTIC DFES_DTCM.DFC_GlwEcuGk2HSS_C "DFES/Hersteller spezifischer Fehlercode für Prüfung DFC_GlwEcuGk2HSS" VALUE 0x800267D8 Val_Wu16 65535.00 DFES_OneToOne 0.00 65535.00 /end CHARACTERISTIC
/begin CHARACTERISTIC DFES_DTCM.DFC_GlwEcuGk2OL_C "DFES/Hersteller spezifischer Fehlercode für Prüfung DFC_GlwEcuGk2OL" VALUE 0x800267DA Val_Wu16 65535.00 DFES_OneToOne 0.00 65535.00 /end CHARACTERISTIC
/begin CHARACTERISTIC DFES_DTCM.DFC_GlwEcuGk2SC_C "DFES/Hersteller spezifischer Fehlercode für Prüfung DFC_GlwEcuGk2SC" VALUE 0x800267DC Val_Wu16 65535.00 DFES_OneToOne 0.00 65535.00 /end CHARACTERISTIC
/begin CHARACTERISTIC DFES_DTCM.DFC_GlwEcuGk2Wdst_C "DFES/Hersteller spezifischer Fehlercode für Prüfung DFC_GlwEcuGk2Wdst" VALUE 0x800267DE Val_Wu16 65535.00 DFES_OneToOne 0.00 65535.00 /end CHARACTERISTIC
/begin CHARACTERISTIC DFES_DTCM.DFC_GlwEcuGk3HSS_C "DFES/Hersteller spezifischer Fehlercode für Prüfung DFC_GlwEcuGk3HSS" VALUE 0x800267E0 Val_Wu16 65535.00 DFES_OneToOne 0.00 65535.00 /end CHARACTERISTIC
/begin CHARACTERISTIC DFES_DTCM.DFC_GlwEcuGk3OL_C "DFES/Hersteller spezifischer Fehlercode für Prüfung DFC_GlwEcuGk3OL" VALUE 0x800267E2 Val_Wu16 65535.00 DFES_OneToOne 0.00 65535.00 /end CHARACTERISTIC
/begin CHARACTERISTIC DFES_DTCM.DFC_GlwEcuGk3SC_C "DFES/Hersteller spezifischer Fehlercode für Prüfung DFC_GlwEcuGk3SC" VALUE 0x800267E4 Val_Wu16 65535.00 DFES_OneToOne 0.00 65535.00 /end CHARACTERISTIC
/begin CHARACTERISTIC DFES_DTCM.DFC_GlwEcuGk3Wdst_C "DFES/Hersteller spezifischer Fehlercode für Prüfung DFC_GlwEcuGk3Wdst" VALUE 0x800267E6 Val_Wu16 65535.00 DFES_OneToOne 0.00 65535.00 /end CHARACTERISTIC
/begin CHARACTERISTIC DFES_DTCM.DFC_GlwEcuGk4HSS_C "DFES/Hersteller spezifischer Fehlercode für Prüfung DFC_GlwEcuGk4HSS" VALUE 0x800267E8 Val_Wu16 65535.00 DFES_OneToOne 0.00 65535.00 /end CHARACTERISTIC
/begin CHARACTERISTIC DFES_DTCM.DFC_GlwEcuGk4OL_C "DFES/Hersteller spezifischer Fehlercode für Prüfung DFC_GlwEcuGk4OL" VALUE 0x800267EA Val_Wu16 65535.00 DFES_OneToOne 0.00 65535.00 /end CHARACTERISTIC
/begin CHARACTERISTIC DFES_DTCM.DFC_GlwEcuGk4SC_C "DFES/Hersteller spezifischer Fehlercode für Prüfung DFC_GlwEcuGk4SC" VALUE 0x800267EC Val_Wu16 65535.00 DFES_OneToOne 0.00 65535.00 /end CHARACTERISTIC
/begin CHARACTERISTIC DFES_DTCM.DFC_GlwEcuGk4Wdst_C "DFES/Hersteller spezifischer Fehlercode für Prüfung DFC_GlwEcuGk4Wdst" VALUE 0x800267EE Val_Wu16 65535.00 DFES_OneToOne 0.00 65535.00 /end CHARACTERISTIC
/begin CHARACTERISTIC DFES_DTCM.DFC_GlwEcuGk5HSS_C "DFES/Hersteller spezifischer Fehlercode für Prüfung DFC_GlwEcuGk5HSS" VALUE 0x800267F0 Val_Wu16 65535.00 DFES_OneToOne 0.00 65535.00 /end CHARACTERISTIC
/begin CHARACTERISTIC DFES_DTCM.DFC_GlwEcuGk5OL_C "DFES/Hersteller spezifischer Fehlercode für Prüfung DFC_GlwEcuGk5OL" VALUE 0x800267F2 Val_Wu16 65535.00 DFES_OneToOne 0.00 65535.00 /end CHARACTERISTIC
/begin CHARACTERISTIC DFES_DTCM.DFC_GlwEcuGk5SC_C "DFES/Hersteller spezifischer Fehlercode für Prüfung DFC_GlwEcuGk5SC" VALUE 0x800267F4 Val_Wu16 65535.00 DFES_OneToOne 0.00 65535.00 /end CHARACTERISTIC
/begin CHARACTERISTIC DFES_DTCM.DFC_GlwEcuGk5Wdst_C "DFES/Hersteller spezifischer Fehlercode für Prüfung DFC_GlwEcuGk5Wdst" VALUE 0x800267F6 Val_Wu16 65535.00 DFES_OneToOne 0.00 65535.00 /end CHARACTERISTIC
/begin CHARACTERISTIC DFES_DTCM.DFC_GlwEcuGk6HSS_C "DFES/Hersteller spezifischer Fehlercode für Prüfung DFC_GlwEcuGk6HSS" VALUE 0x800267F8 Val_Wu16 65535.00 DFES_OneToOne 0.00 65535.00 /end CHARACTERISTIC
/begin CHARACTERISTIC DFES_DTCM.DFC_GlwEcuGk6OL_C "DFES/Hersteller spezifischer Fehlercode für Prüfung DFC_GlwEcuGk6OL" VALUE 0x800267FA Val_Wu16 65535.00 DFES_OneToOne 0.00 65535.00 /end CHARACTERISTIC
/begin CHARACTERISTIC DFES_DTCM.DFC_GlwEcuGk6SC_C "DFES/Hersteller spezifischer Fehlercode für Prüfung DFC_GlwEcuGk6SC" VALUE 0x800267FC Val_Wu16 65535.00 DFES_OneToOne 0.00 65535.00 /end CHARACTERISTIC
/begin CHARACTERISTIC DFES_DTCM.DFC_GlwEcuGk6Wdst_C "DFES/Hersteller spezifischer Fehlercode für Prüfung DFC_GlwEcuGk6Wdst" VALUE 0x800267FE Val_Wu16 65535.00 DFES_OneToOne 0.00 65535.00 /end CHARACTERISTIC
/begin CHARACTERISTIC DFES_DTCM.DFC_GlwEcuGndErr_C "DFES/Hersteller spezifischer Fehlercode für Prüfung DFC_GlwEcuGndErr" VALUE 0x80026800 Val_Wu16 65535.00 DFES_OneToOne 0.00 65535.00 /end CHARACTERISTIC
/begin CHARACTERISTIC DFES_DTCM.DFC_GlwEcuIntErr_C "DFES/Hersteller spezifischer Fehlercode für Prüfung DFC_GlwEcuIntErr" VALUE 0x80026802 Val_Wu16 65535.00 DFES_OneToOne 0.00 65535.00 /end CHARACTERISTIC
/begin CHARACTERISTIC DFES_DTCM.DFC_GlwEcuMsgTimeout_C "DFES/Hersteller spezifischer Fehlercode für Prüfung DFC_GlwEcuMsgTimeout" VALUE 0x80026804 Val_Wu16 65535.00 DFES_OneToOne 0.00 65535.00 /end CHARACTERISTIC
/begin CHARACTERISTIC DFES_DTCM.DFC_GlwEcuT30Err_C "DFES/Hersteller spezifischer Fehlercode für Prüfung DFC_GlwEcuT30Err" VALUE 0x80026806 Val_Wu16 65535.00 DFES_OneToOne 0.00 65535.00 /end CHARACTERISTIC
/begin CHARACTERISTIC DFES_DTCM.DFC_GlwEcuTempErr_C "DFES/Hersteller spezifischer Fehlercode für Prüfung DFC_GlwEcuTempErr" VALUE 0x80026808 Val_Wu16 65535.00 DFES_OneToOne 0.00 65535.00 /end CHARACTERISTIC
/begin CHARACTERISTIC DFES_DTCM.DFC_GlwEcuUdiffT30_C "DFES/Hersteller spezifischer Fehlercode für Prüfung DFC_GlwEcuUdiffT30" VALUE 0x8002680A Val_Wu16 65535.00 DFES_OneToOne 0.00 65535.00 /end CHARACTERISTIC
/begin CHARACTERISTIC DFES_DTCM.DFC_IBSComErr_C "DFES/Hersteller spezifischer Fehlercode für Prüfung DFC_IBSComErr" VALUE 0x8002680C Val_Wu16 65535.00 DFES_OneToOne 0.00 65535.00 /end CHARACTERISTIC
/begin CHARACTERISTIC DFES_DTCM.DFC_LubSRCOilFldtCrit_C "DFES/Hersteller spezifischer Fehlercode für Prüfung DFC_LubSRCOilFldtCrit" VALUE 0x8002680E Val_Wu16 65535.00 DFES_OneToOne 0.00 65535.00 /end CHARACTERISTIC
/begin CHARACTERISTIC DFES_DTCM.DFC_LubSRCOilFldtCritDflMin_C "DFES/Hersteller spezifischer Fehlercode für Prüfung DFC_LubSRCOilFldtCritDflMin" VALUE 0x80026810 Val_Wu16 65535.00 DFES_OneToOne 0.00 65535.00 /end CHARACTERISTIC
/begin CHARACTERISTIC DFES_DTCM.DFC_LubSRCOilLvlCritMax_C "DFES/Hersteller spezifischer Fehlercode für Prüfung DFC_LubSRCOilLvlCritMax" VALUE 0x80026812 Val_Wu16 65535.00 DFES_OneToOne 0.00 65535.00 /end CHARACTERISTIC
/begin CHARACTERISTIC DFES_DTCM.DFC_LubSRCOilLvlCritMin_C "DFES/Hersteller spezifischer Fehlercode für Prüfung DFC_LubSRCOilLvlCritMin" VALUE 0x80026814 Val_Wu16 65535.00 DFES_OneToOne 0.00 65535.00 /end CHARACTERISTIC
/begin CHARACTERISTIC DFES_DTCM.DFC_LubSRCTot_C "DFES/Hersteller spezifischer Fehlercode für Prüfung DFC_LubSRCTot" VALUE 0x80026816 Val_Wu16 65535.00 DFES_OneToOne 0.00 65535.00 /end CHARACTERISTIC
/begin CHARACTERISTIC DFES_DTCM.DFC_MonUMaxSupply1_C "DFES/Hersteller spezifischer Fehlercode für Prüfung DFC_MonUMaxSupply1" VALUE 0x80026818 Val_Wu16 65535.00 DFES_OneToOne 0.00 65535.00 /end CHARACTERISTIC
/begin CHARACTERISTIC DFES_DTCM.DFC_MonUMinSupply1_C "DFES/Hersteller spezifischer Fehlercode für Prüfung DFC_MonUMinSupply1" VALUE 0x8002681A Val_Wu16 65535.00 DFES_OneToOne 0.00 65535.00 /end CHARACTERISTIC
/begin CHARACTERISTIC DFES_DTCM.DFC_OilComNpl_C "DFES/Hersteller spezifischer Fehlercode für Prüfung DFC_OilComNpl" VALUE 0x8002681C Val_Wu16 65535.00 DFES_OneToOne 0.00 65535.00 /end CHARACTERISTIC
/begin CHARACTERISTIC DFES_DTCM.DFC_PCBS_C "DFES/Hersteller spezifischer Fehlercode für Prüfung DFC_PCBS" VALUE 0x8002681E Val_Wu16 65535.00 DFES_OneToOne 0.00 65535.00 /end CHARACTERISTIC
/begin CHARACTERISTIC DFES_DTCM.DFC_PCBSPFltChg_C "DFES/Hersteller spezifischer Fehlercode für Prüfung DFC_PCBSPFltChg" VALUE 0x80026820 Val_Wu16 65535.00 DFES_OneToOne 0.00 65535.00 /end CHARACTERISTIC
/begin CHARACTERISTIC DFES_DTCM.DFC_PCRGovDvtLPMax_C "DFES/Hersteller spezifischer Fehlercode für Prüfung DFC_PCRGovDvtLPMax" VALUE 0x80026822 Val_Wu16 65535.00 DFES_OneToOne 0.00 65535.00 /end CHARACTERISTIC
/begin CHARACTERISTIC DFES_DTCM.DFC_PCRGovDvtLPMin_C "DFES/Hersteller spezifischer Fehlercode für Prüfung DFC_PCRGovDvtLPMin" VALUE 0x80026824 Val_Wu16 65535.00 DFES_OneToOne 0.00 65535.00 /end CHARACTERISTIC
/begin CHARACTERISTIC DFES_DTCM.DFC_PCRGovDvtMax_C "DFES/Hersteller spezifischer Fehlercode für Prüfung DFC_PCRGovDvtMax" VALUE 0x80026826 Val_Wu16 65535.00 DFES_OneToOne 0.00 65535.00 /end CHARACTERISTIC
/begin CHARACTERISTIC DFES_DTCM.DFC_PCRGovDvtMin_C "DFES/Hersteller spezifischer Fehlercode für Prüfung DFC_PCRGovDvtMin" VALUE 0x80026828 Val_Wu16 65535.00 DFES_OneToOne 0.00 65535.00 /end CHARACTERISTIC
/begin CHARACTERISTIC DFES_DTCM.DFC_PFltAPSPlausMAX_C "DFES/Hersteller spezifischer Fehlercode für Prüfung DFC_PFltAPSPlausMAX" VALUE 0x8002682A Val_Wu16 65535.00 DFES_OneToOne 0.00 65535.00 /end CHARACTERISTIC
/begin CHARACTERISTIC DFES_DTCM.DFC_PFltAPSPlausMIN_C "DFES/Hersteller spezifischer Fehlercode für Prüfung DFC_PFltAPSPlausMIN" VALUE 0x8002682C Val_Wu16 65535.00 DFES_OneToOne 0.00 65535.00 /end CHARACTERISTIC
/begin CHARACTERISTIC DFES_DTCM.DFC_PFltBPSPlausMAX_C "DFES/Hersteller spezifischer Fehlercode für Prüfung DFC_PFltBPSPlausMAX" VALUE 0x8002682E Val_Wu16 65535.00 DFES_OneToOne 0.00 65535.00 /end CHARACTERISTIC
/begin CHARACTERISTIC DFES_DTCM.DFC_PFltBPSPlausMIN_C "DFES/Hersteller spezifischer Fehlercode für Prüfung DFC_PFltBPSPlausMIN" VALUE 0x80026830 Val_Wu16 65535.00 DFES_OneToOne 0.00 65535.00 /end CHARACTERISTIC
/begin CHARACTERISTIC DFES_DTCM.DFC_PFltOvldInhRgn_C "DFES/Hersteller spezifischer Fehlercode für Prüfung DFC_PFltOvldInhRgn" VALUE 0x80026832 Val_Wu16 65535.00 DFES_OneToOne 0.00 65535.00 /end CHARACTERISTIC
/begin CHARACTERISTIC DFES_DTCM.DFC_PFltOvldTrqLim_C "DFES/Hersteller spezifischer Fehlercode für Prüfung DFC_PFltOvldTrqLim" VALUE 0x80026834 Val_Wu16 65535.00 DFES_OneToOne 0.00 65535.00 /end CHARACTERISTIC
/begin CHARACTERISTIC DFES_DTCM.DFC_PFltPresPlausMAX_C "DFES/Hersteller spezifischer Fehlercode für Prüfung DFC_PFltPresPlausMAX" VALUE 0x80026836 Val_Wu16 65535.00 DFES_OneToOne 0.00 65535.00 /end CHARACTERISTIC
/begin CHARACTERISTIC DFES_DTCM.DFC_PFltPresPlausMIN_C "DFES/Hersteller spezifischer Fehlercode für Prüfung DFC_PFltPresPlausMIN" VALUE 0x80026838 Val_Wu16 65535.00 DFES_OneToOne 0.00 65535.00 /end CHARACTERISTIC
/begin CHARACTERISTIC DFES_DTCM.DFC_PFltTraRpmRdc_C "DFES/Hersteller spezifischer Fehlercode für Prüfung DFC_PFltTraRpmRdc" VALUE 0x8002683A Val_Wu16 65535.00 DFES_OneToOne 0.00 65535.00 /end CHARACTERISTIC
/begin CHARACTERISTIC DFES_DTCM.DFC_PFlt_tOxiPreMax_C "DFES/Hersteller spezifischer Fehlercode für Prüfung DFC_PFlt_tOxiPreMax" VALUE 0x8002683C Val_Wu16 65535.00 DFES_OneToOne 0.00 65535.00 /end CHARACTERISTIC
/begin CHARACTERISTIC DFES_DTCM.DFC_PFlt_tOxiPreMaxRgn_C "DFES/Hersteller spezifischer Fehlercode für Prüfung DFC_PFlt_tOxiPreMaxRgn" VALUE 0x8002683E Val_Wu16 65535.00 DFES_OneToOne 0.00 65535.00 /end CHARACTERISTIC
/begin CHARACTERISTIC DFES_DTCM.DFC_PFlt_tOxiPreNpl_C "DFES/Hersteller spezifischer Fehlercode für Prüfung DFC_PFlt_tOxiPreNpl" VALUE 0x80026840 Val_Wu16 65535.00 DFES_OneToOne 0.00 65535.00 /end CHARACTERISTIC
/begin CHARACTERISTIC DFES_DTCM.DFC_PFlt_tPreMax_C "DFES/Hersteller spezifischer Fehlercode für Prüfung DFC_PFlt_tPreMax" VALUE 0x80026842 Val_Wu16 65535.00 DFES_OneToOne 0.00 65535.00 /end CHARACTERISTIC
/begin CHARACTERISTIC DFES_DTCM.DFC_PFlt_tPreMaxRgn_C "DFES/Hersteller spezifischer Fehlercode für Prüfung DFC_PFlt_tPreMaxRgn" VALUE 0x80026844 Val_Wu16 65535.00 DFES_OneToOne 0.00 65535.00 /end CHARACTERISTIC
/begin CHARACTERISTIC DFES_DTCM.DFC_PFlt_tPreNpl_C "DFES/Hersteller spezifischer Fehlercode für Prüfung DFC_PFlt_tPreNpl" VALUE 0x80026846 Val_Wu16 65535.00 DFES_OneToOne 0.00 65535.00 /end CHARACTERISTIC
/begin CHARACTERISTIC DFES_DTCM.DFC_PFltmSotDiffMAX_C "DFES/Hersteller spezifischer Fehlercode für Prüfung DFC_PFltmSotDiffMAX" VALUE 0x80026848 Val_Wu16 65535.00 DFES_OneToOne 0.00 65535.00 /end CHARACTERISTIC
/begin CHARACTERISTIC DFES_DTCM.DFC_PFltmSotDiffMIN_C "DFES/Hersteller spezifischer Fehlercode für Prüfung DFC_PFltmSotDiffMIN" VALUE 0x8002684A Val_Wu16 65535.00 DFES_OneToOne 0.00 65535.00 /end CHARACTERISTIC
/begin CHARACTERISTIC DFES_DTCM.DFC_PFltmSotDiffSIG_C "DFES/Hersteller spezifischer Fehlercode für Prüfung DFC_PFltmSotDiffSIG" VALUE 0x8002684C Val_Wu16 65535.00 DFES_OneToOne 0.00 65535.00 /end CHARACTERISTIC
/begin CHARACTERISTIC DFES_DTCM.DFC_PIntkVUsEnvPPls_C "DFES/Hersteller spezifischer Fehlercode für Prüfung DFC_PIntkVUsEnvPPls" VALUE 0x8002684E Val_Wu16 65535.00 DFES_OneToOne 0.00 65535.00 /end CHARACTERISTIC
/begin CHARACTERISTIC DFES_DTCM.DFC_PresPlausDblDef_C "DFES/Hersteller spezifischer Fehlercode für Prüfung DFC_PresPlausDblDef" VALUE 0x80026850 Val_Wu16 65535.00 DFES_OneToOne 0.00 65535.00 /end CHARACTERISTIC
/begin CHARACTERISTIC DFES_DTCM.DFC_RailCPC1_C "DFES/Hersteller spezifischer Fehlercode für Prüfung DFC_RailCPC1" VALUE 0x80026852 Val_Wu16 65535.00 DFES_OneToOne 0.00 65535.00 /end CHARACTERISTIC
/begin CHARACTERISTIC DFES_DTCM.DFC_RailCPC3_C "DFES/Hersteller spezifischer Fehlercode für Prüfung DFC_RailCPC3" VALUE 0x80026854 Val_Wu16 65535.00 DFES_OneToOne 0.00 65535.00 /end CHARACTERISTIC
/begin CHARACTERISTIC DFES_DTCM.DFC_RailCPC4_C "DFES/Hersteller spezifischer Fehlercode für Prüfung DFC_RailCPC4" VALUE 0x80026856 Val_Wu16 65535.00 DFES_OneToOne 0.00 65535.00 /end CHARACTERISTIC
/begin CHARACTERISTIC DFES_DTCM.DFC_RailMeUn0_C "DFES/Hersteller spezifischer Fehlercode für Prüfung DFC_RailMeUn0" VALUE 0x80026858 Val_Wu16 65535.00 DFES_OneToOne 0.00 65535.00 /end CHARACTERISTIC
/begin CHARACTERISTIC DFES_DTCM.DFC_RailMeUn1_C "DFES/Hersteller spezifischer Fehlercode für Prüfung DFC_RailMeUn1" VALUE 0x8002685A Val_Wu16 65535.00 DFES_OneToOne 0.00 65535.00 /end CHARACTERISTIC
/begin CHARACTERISTIC DFES_DTCM.DFC_RailMeUn2_C "DFES/Hersteller spezifischer Fehlercode für Prüfung DFC_RailMeUn2" VALUE 0x8002685C Val_Wu16 65535.00 DFES_OneToOne 0.00 65535.00 /end CHARACTERISTIC
/begin CHARACTERISTIC DFES_DTCM.DFC_RailMeUn22_C "DFES/Hersteller spezifischer Fehlercode für Prüfung DFC_RailMeUn22" VALUE 0x8002685E Val_Wu16 65535.00 DFES_OneToOne 0.00 65535.00 /end CHARACTERISTIC
/begin CHARACTERISTIC DFES_DTCM.DFC_RailMeUn3_C "DFES/Hersteller spezifischer Fehlercode für Prüfung DFC_RailMeUn3" VALUE 0x80026860 Val_Wu16 65535.00 DFES_OneToOne 0.00 65535.00 /end CHARACTERISTIC
/begin CHARACTERISTIC DFES_DTCM.DFC_RailMeUn4_C "DFES/Hersteller spezifischer Fehlercode für Prüfung DFC_RailMeUn4" VALUE 0x80026862 Val_Wu16 65535.00 DFES_OneToOne 0.00 65535.00 /end CHARACTERISTIC
/begin CHARACTERISTIC DFES_DTCM.DFC_RailMeUn42_C "DFES/Hersteller spezifischer Fehlercode für Prüfung DFC_RailMeUn42" VALUE 0x80026864 Val_Wu16 65535.00 DFES_OneToOne 0.00 65535.00 /end CHARACTERISTIC
/begin CHARACTERISTIC DFES_DTCM.DFC_RailMeUn5_C "DFES/Hersteller spezifischer Fehlercode für Prüfung DFC_RailMeUn5" VALUE 0x80026866 Val_Wu16 65535.00 DFES_OneToOne 0.00 65535.00 /end CHARACTERISTIC
/begin CHARACTERISTIC DFES_DTCM.DFC_RailPCV0_C "DFES/Hersteller spezifischer Fehlercode für Prüfung DFC_RailPCV0" VALUE 0x80026868 Val_Wu16 65535.00 DFES_OneToOne 0.00 65535.00 /end CHARACTERISTIC
/begin CHARACTERISTIC DFES_DTCM.DFC_RailPCV1_C "DFES/Hersteller spezifischer Fehlercode für Prüfung DFC_RailPCV1" VALUE 0x8002686A Val_Wu16 65535.00 DFES_OneToOne 0.00 65535.00 /end CHARACTERISTIC
/begin CHARACTERISTIC DFES_DTCM.DFC_RailPCV2_C "DFES/Hersteller spezifischer Fehlercode für Prüfung DFC_RailPCV2" VALUE 0x8002686C Val_Wu16 65535.00 DFES_OneToOne 0.00 65535.00 /end CHARACTERISTIC
/begin CHARACTERISTIC DFES_DTCM.DFC_RailPCV22_C "DFES/Hersteller spezifischer Fehlercode für Prüfung DFC_RailPCV22" VALUE 0x8002686E Val_Wu16 65535.00 DFES_OneToOne 0.00 65535.00 /end CHARACTERISTIC
/begin CHARACTERISTIC DFES_DTCM.DFC_RailPCV3_C "DFES/Hersteller spezifischer Fehlercode für Prüfung DFC_RailPCV3" VALUE 0x80026870 Val_Wu16 65535.00 DFES_OneToOne 0.00 65535.00 /end CHARACTERISTIC
/begin CHARACTERISTIC DFES_DTCM.DFC_RailPCV4_C "DFES/Hersteller spezifischer Fehlercode für Prüfung DFC_RailPCV4" VALUE 0x80026872 Val_Wu16 65535.00 DFES_OneToOne 0.00 65535.00 /end CHARACTERISTIC
/begin CHARACTERISTIC DFES_DTCM.DFC_RailPCV42_C "DFES/Hersteller spezifischer Fehlercode für Prüfung DFC_RailPCV42" VALUE 0x80026874 Val_Wu16 65535.00 DFES_OneToOne 0.00 65535.00 /end CHARACTERISTIC
/begin CHARACTERISTIC DFES_DTCM.DFC_RailPMonStrt_C "DFES/Hersteller spezifischer Fehlercode für Prüfung DFC_RailPMonStrt" VALUE 0x80026876 Val_Wu16 65535.00 DFES_OneToOne 0.00 65535.00 /end CHARACTERISTIC
/begin CHARACTERISTIC DFES_DTCM.DFC_SSpMon1_C "DFES/Hersteller spezifischer Fehlercode für Prüfung DFC_SSpMon1" VALUE 0x80026878 Val_Wu16 65535.00 DFES_OneToOne 0.00 65535.00 /end CHARACTERISTIC
/begin CHARACTERISTIC DFES_DTCM.DFC_SSpMon2_C "DFES/Hersteller spezifischer Fehlercode für Prüfung DFC_SSpMon2" VALUE 0x8002687A Val_Wu16 65535.00 DFES_OneToOne 0.00 65535.00 /end CHARACTERISTIC
/begin CHARACTERISTIC DFES_DTCM.DFC_SSpMon3_C "DFES/Hersteller spezifischer Fehlercode für Prüfung DFC_SSpMon3" VALUE 0x8002687C Val_Wu16 65535.00 DFES_OneToOne 0.00 65535.00 /end CHARACTERISTIC
/begin CHARACTERISTIC DFES_DTCM.DFC_ThrVlv4WinErr1_C "DFES/Hersteller spezifischer Fehlercode für Prüfung DFC_ThrVlv4WinErr1" VALUE 0x8002687E Val_Wu16 65535.00 DFES_OneToOne 0.00 65535.00 /end CHARACTERISTIC
/begin CHARACTERISTIC DFES_DTCM.DFC_ThrVlv4WinErr2_C "DFES/Hersteller spezifischer Fehlercode für Prüfung DFC_ThrVlv4WinErr2" VALUE 0x80026880 Val_Wu16 65535.00 DFES_OneToOne 0.00 65535.00 /end CHARACTERISTIC
/begin CHARACTERISTIC DFES_DTCM.DFC_ThrVlv4WinErr3_C "DFES/Hersteller spezifischer Fehlercode für Prüfung DFC_ThrVlv4WinErr3" VALUE 0x80026882 Val_Wu16 65535.00 DFES_OneToOne 0.00 65535.00 /end CHARACTERISTIC
/begin CHARACTERISTIC DFES_DTCM.DFC_ThrVlv4WinErr4_C "DFES/Hersteller spezifischer Fehlercode für Prüfung DFC_ThrVlv4WinErr4" VALUE 0x80026884 Val_Wu16 65535.00 DFES_OneToOne 0.00 65535.00 /end CHARACTERISTIC
/begin CHARACTERISTIC DFES_DTCM.DFC_ThrVlvSCG_C "DFES/Hersteller spezifischer Fehlercode für Prüfung DFC_ThrVlvSCG" VALUE 0x80026886 Val_Wu16 65535.00 DFES_OneToOne 0.00 65535.00 /end CHARACTERISTIC
/begin CHARACTERISTIC DFES_DTCM.DFC_Tle6232Spi1_C "DFES/Hersteller spezifischer Fehlercode für Prüfung DFC_Tle6232Spi1" VALUE 0x80026888 Val_Wu16 65535.00 DFES_OneToOne 0.00 65535.00 /end CHARACTERISTIC
/begin CHARACTERISTIC DFES_DTCM.DFC_TrbCh4WinErr1_C "DFES/Hersteller spezifischer Fehlercode für Prüfung DFC_TrbCh4WinErr1" VALUE 0x8002688A Val_Wu16 65535.00 DFES_OneToOne 0.00 65535.00 /end CHARACTERISTIC
/begin CHARACTERISTIC DFES_DTCM.DFC_TrbCh4WinErr2_C "DFES/Hersteller spezifischer Fehlercode für Prüfung DFC_TrbCh4WinErr2" VALUE 0x8002688C Val_Wu16 65535.00 DFES_OneToOne 0.00 65535.00 /end CHARACTERISTIC
/begin CHARACTERISTIC DFES_DTCM.DFC_TrbCh4WinErr3_C "DFES/Hersteller spezifischer Fehlercode für Prüfung DFC_TrbCh4WinErr3" VALUE 0x8002688E Val_Wu16 65535.00 DFES_OneToOne 0.00 65535.00 /end CHARACTERISTIC
/begin CHARACTERISTIC DFES_DTCM.DFC_TrbCh4WinErr4_C "DFES/Hersteller spezifischer Fehlercode für Prüfung DFC_TrbCh4WinErr4" VALUE 0x80026890 Val_Wu16 65535.00 DFES_OneToOne 0.00 65535.00 /end CHARACTERISTIC
/begin CHARACTERISTIC DFES_DTCM.DFC_TrbChSCG_C "DFES/Hersteller spezifischer Fehlercode für Prüfung DFC_TrbChSCG" VALUE 0x80026892 Val_Wu16 65535.00 DFES_OneToOne 0.00 65535.00 /end CHARACTERISTIC
/begin CHARACTERISTIC DFES_DTCM.DFC_TrbChSRCMax_C "DFES/Hersteller spezifischer Fehlercode für Prüfung DFC_TrbChSRCMax" VALUE 0x80026894 Val_Wu16 65535.00 DFES_OneToOne 0.00 65535.00 /end CHARACTERISTIC
/begin CHARACTERISTIC DFES_DTCM.DFC_TrbChSRCMin_C "DFES/Hersteller spezifischer Fehlercode für Prüfung DFC_TrbChSRCMin" VALUE 0x80026896 Val_Wu16 65535.00 DFES_OneToOne 0.00 65535.00 /end CHARACTERISTIC
/begin CHARACTERISTIC DFES_DTCM.DFC_WaHtEl4WinErr1_C "DFES/Hersteller spezifischer Fehlercode für Prüfung DFC_WaHtEl4WinErr1" VALUE 0x80026898 Val_Wu16 65535.00 DFES_OneToOne 0.00 65535.00 /end CHARACTERISTIC
/begin CHARACTERISTIC DFES_DTCM.DFC_WaHtEl4WinErr2_C "DFES/Hersteller spezifischer Fehlercode für Prüfung DFC_WaHtEl4WinErr2" VALUE 0x8002689A Val_Wu16 65535.00 DFES_OneToOne 0.00 65535.00 /end CHARACTERISTIC
/begin CHARACTERISTIC DFES_DTCM.DFC_WaHtEl4WinErr3_C "DFES/Hersteller spezifischer Fehlercode für Prüfung DFC_WaHtEl4WinErr3" VALUE 0x8002689C Val_Wu16 65535.00 DFES_OneToOne 0.00 65535.00 /end CHARACTERISTIC
/begin CHARACTERISTIC DFES_DTCM.DFC_WaHtEl4WinErr4_C "DFES/Hersteller spezifischer Fehlercode für Prüfung DFC_WaHtEl4WinErr4" VALUE 0x8002689E Val_Wu16 65535.00 DFES_OneToOne 0.00 65535.00 /end CHARACTERISTIC
/begin CHARACTERISTIC DFES_DTCM.DFC_WaHtElSCG_C "DFES/Hersteller spezifischer Fehlercode für Prüfung DFC_WaHtElSCG" VALUE 0x800268A0 Val_Wu16 65535.00 DFES_OneToOne 0.00 65535.00 /end CHARACTERISTIC
/begin CHARACTERISTIC DFES_DTCM.DFC_ETClbETFltMax_0_C "DFES/Hersteller spezifischer Fehlercode für Prüfung DFC_ETClbETFltMax_0" VALUE 0x800268A2 Val_Wu16 65535.00 DFES_OneToOne 0.00 65535.00 /end CHARACTERISTIC
/begin CHARACTERISTIC DFES_DTCM.DFC_ETClbETFltMax_1_C "DFES/Hersteller spezifischer Fehlercode für Prüfung DFC_ETClbETFltMax_1" VALUE 0x800268A4 Val_Wu16 65535.00 DFES_OneToOne 0.00 65535.00 /end CHARACTERISTIC
/begin CHARACTERISTIC DFES_DTCM.DFC_ETClbETFltMax_2_C "DFES/Hersteller spezifischer Fehlercode für Prüfung DFC_ETClbETFltMax_2" VALUE 0x800268A6 Val_Wu16 65535.00 DFES_OneToOne 0.00 65535.00 /end CHARACTERISTIC
/begin CHARACTERISTIC DFES_DTCM.DFC_ETClbETFltMax_3_C "DFES/Hersteller spezifischer Fehlercode für Prüfung DFC_ETClbETFltMax_3" VALUE 0x800268A8 Val_Wu16 65535.00 DFES_OneToOne 0.00 65535.00 /end CHARACTERISTIC
/begin CHARACTERISTIC DFES_DTCM.DFC_ETClbETFltMax_4_C "DFES/Hersteller spezifischer Fehlercode für Prüfung DFC_ETClbETFltMax_4" VALUE 0x800268AA Val_Wu16 65535.00 DFES_OneToOne 0.00 65535.00 /end CHARACTERISTIC
/begin CHARACTERISTIC DFES_DTCM.DFC_ETClbETFltMax_5_C "DFES/Hersteller spezifischer Fehlercode für Prüfung DFC_ETClbETFltMax_5" VALUE 0x800268AC Val_Wu16 65535.00 DFES_OneToOne 0.00 65535.00 /end CHARACTERISTIC
/begin CHARACTERISTIC DFES_DTCM.DFC_ETClbETFltMin_0_C "DFES/Hersteller spezifischer Fehlercode für Prüfung DFC_ETClbETFltMin_0" VALUE 0x800268AE Val_Wu16 65535.00 DFES_OneToOne 0.00 65535.00 /end CHARACTERISTIC
/begin CHARACTERISTIC DFES_DTCM.DFC_ETClbETFltMin_1_C "DFES/Hersteller spezifischer Fehlercode für Prüfung DFC_ETClbETFltMin_1" VALUE 0x800268B0 Val_Wu16 65535.00 DFES_OneToOne 0.00 65535.00 /end CHARACTERISTIC
/begin CHARACTERISTIC DFES_DTCM.DFC_ETClbETFltMin_2_C "DFES/Hersteller spezifischer Fehlercode für Prüfung DFC_ETClbETFltMin_2" VALUE 0x800268B2 Val_Wu16 65535.00 DFES_OneToOne 0.00 65535.00 /end CHARACTERISTIC
/begin CHARACTERISTIC DFES_DTCM.DFC_ETClbETFltMin_3_C "DFES/Hersteller spezifischer Fehlercode für Prüfung DFC_ETClbETFltMin_3" VALUE 0x800268B4 Val_Wu16 65535.00 DFES_OneToOne 0.00 65535.00 /end CHARACTERISTIC
/begin CHARACTERISTIC DFES_DTCM.DFC_ETClbETFltMin_4_C "DFES/Hersteller spezifischer Fehlercode für Prüfung DFC_ETClbETFltMin_4" VALUE 0x800268B6 Val_Wu16 65535.00 DFES_OneToOne 0.00 65535.00 /end CHARACTERISTIC
/begin CHARACTERISTIC DFES_DTCM.DFC_ETClbETFltMin_5_C "DFES/Hersteller spezifischer Fehlercode für Prüfung DFC_ETClbETFltMin_5" VALUE 0x800268B8 Val_Wu16 65535.00 DFES_OneToOne 0.00 65535.00 /end CHARACTERISTIC
/begin CHARACTERISTIC DFES_DTCM.DFC_InjCrvInjLimChrgBal_C "DFES/Hersteller spezifischer Fehlercode für Prüfung DFC_InjCrvInjLimChrgBal" VALUE 0x800268BA Val_Wu16 65535.00 DFES_OneToOne 0.00 65535.00 /end CHARACTERISTIC
/begin CHARACTERISTIC DFES_DTCM.DFC_InjCrvInjLimQntBal_C "DFES/Hersteller spezifischer Fehlercode für Prüfung DFC_InjCrvInjLimQntBal" VALUE 0x800268BC Val_Wu16 65535.00 DFES_OneToOne 0.00 65535.00 /end CHARACTERISTIC
/begin CHARACTERISTIC DFES_DTCM.DFC_InjCrvInjLimSys_C "DFES/Hersteller spezifischer Fehlercode für Prüfung DFC_InjCrvInjLimSys" VALUE 0x800268BE Val_Wu16 65535.00 DFES_OneToOne 0.00 65535.00 /end CHARACTERISTIC
/begin CHARACTERISTIC DFES_DTCM.DFC_InjCrvNumInjRtmLim_C "DFES/Hersteller spezifischer Fehlercode für Prüfung DFC_InjCrvNumInjRtmLim" VALUE 0x800268C0 Val_Wu16 65535.00 DFES_OneToOne 0.00 65535.00 /end CHARACTERISTIC
/begin CHARACTERISTIC DFES_DTCM.DFC_LSUHtCoupSig_C "DFES/Hersteller spezifischer Fehlercode für Prüfung DFC_LSUHtCoupSig" VALUE 0x800268C2 Val_Wu16 65535.00 DFES_OneToOne 0.00 65535.00 /end CHARACTERISTIC
/begin CHARACTERISTIC DFES_DTCM.DFC_AFS_SSpShOffOL_C "DFES/Hersteller spezifischer Fehlercode für Prüfung DFC_AFS_SSpShOffOL" VALUE 0x800268C4 Val_Wu16 65535.00 DFES_OneToOne 0.00 65535.00 /end CHARACTERISTIC
/begin CHARACTERISTIC DFES_DTCM.DFC_AFS_SSpShOffOvrTemp_C "DFES/Hersteller spezifischer Fehlercode für Prüfung DFC_AFS_SSpShOffOvrTemp" VALUE 0x800268C6 Val_Wu16 65535.00 DFES_OneToOne 0.00 65535.00 /end CHARACTERISTIC
/begin CHARACTERISTIC DFES_DTCM.DFC_AFS_SSpShOffSCB_C "DFES/Hersteller spezifischer Fehlercode für Prüfung DFC_AFS_SSpShOffSCB" VALUE 0x800268C8 Val_Wu16 65535.00 DFES_OneToOne 0.00 65535.00 /end CHARACTERISTIC
/begin CHARACTERISTIC DFES_DTCM.DFC_AFS_SSpShOffSCG_C "DFES/Hersteller spezifischer Fehlercode für Prüfung DFC_AFS_SSpShOffSCG" VALUE 0x800268CA Val_Wu16 65535.00 DFES_OneToOne 0.00 65535.00 /end CHARACTERISTIC
/begin CHARACTERISTIC DFES_DTCM.DFC_AirCCmprOL_C "DFES/Hersteller spezifischer Fehlercode für Prüfung DFC_AirCCmprOL" VALUE 0x800268CC Val_Wu16 65535.00 DFES_OneToOne 0.00 65535.00 /end CHARACTERISTIC
/begin CHARACTERISTIC DFES_DTCM.DFC_AirCCmprOvrTemp_C "DFES/Hersteller spezifischer Fehlercode für Prüfung DFC_AirCCmprOvrTemp" VALUE 0x800268CE Val_Wu16 65535.00 DFES_OneToOne 0.00 65535.00 /end CHARACTERISTIC
/begin CHARACTERISTIC DFES_DTCM.DFC_AirCCmprSCB_C "DFES/Hersteller spezifischer Fehlercode für Prüfung DFC_AirCCmprSCB" VALUE 0x800268D0 Val_Wu16 65535.00 DFES_OneToOne 0.00 65535.00 /end CHARACTERISTIC
/begin CHARACTERISTIC DFES_DTCM.DFC_AirCCmprSCG_C "DFES/Hersteller spezifischer Fehlercode für Prüfung DFC_AirCCmprSCG" VALUE 0x800268D2 Val_Wu16 65535.00 DFES_OneToOne 0.00 65535.00 /end CHARACTERISTIC
/begin CHARACTERISTIC DFES_DTCM.DFC_CByVlvOL_C "DFES/Hersteller spezifischer Fehlercode für Prüfung DFC_CByVlvOL" VALUE 0x800268D4 Val_Wu16 65535.00 DFES_OneToOne 0.00 65535.00 /end CHARACTERISTIC
/begin CHARACTERISTIC DFES_DTCM.DFC_CByVlvOvrTemp_C "DFES/Hersteller spezifischer Fehlercode für Prüfung DFC_CByVlvOvrTemp" VALUE 0x800268D6 Val_Wu16 65535.00 DFES_OneToOne 0.00 65535.00 /end CHARACTERISTIC
/begin CHARACTERISTIC DFES_DTCM.DFC_CByVlvSCB_C "DFES/Hersteller spezifischer Fehlercode für Prüfung DFC_CByVlvSCB" VALUE 0x800268D8 Val_Wu16 65535.00 DFES_OneToOne 0.00 65535.00 /end CHARACTERISTIC
/begin CHARACTERISTIC DFES_DTCM.DFC_CByVlvSCG_C "DFES/Hersteller spezifischer Fehlercode für Prüfung DFC_CByVlvSCG" VALUE 0x800268DA Val_Wu16 65535.00 DFES_OneToOne 0.00 65535.00 /end CHARACTERISTIC
/begin CHARACTERISTIC DFES_DTCM.DFC_CThmstOL_C "DFES/Hersteller spezifischer Fehlercode für Prüfung DFC_CThmstOL" VALUE 0x800268DC Val_Wu16 65535.00 DFES_OneToOne 0.00 65535.00 /end CHARACTERISTIC
/begin CHARACTERISTIC DFES_DTCM.DFC_CThmstOvrTemp_C "DFES/Hersteller spezifischer Fehlercode für Prüfung DFC_CThmstOvrTemp" VALUE 0x800268DE Val_Wu16 65535.00 DFES_OneToOne 0.00 65535.00 /end CHARACTERISTIC
/begin CHARACTERISTIC DFES_DTCM.DFC_CThmstSCB_C "DFES/Hersteller spezifischer Fehlercode für Prüfung DFC_CThmstSCB" VALUE 0x800268E0 Val_Wu16 65535.00 DFES_OneToOne 0.00 65535.00 /end CHARACTERISTIC
/begin CHARACTERISTIC DFES_DTCM.DFC_CThmstSCG_C "DFES/Hersteller spezifischer Fehlercode für Prüfung DFC_CThmstSCG" VALUE 0x800268E2 Val_Wu16 65535.00 DFES_OneToOne 0.00 65535.00 /end CHARACTERISTIC
/begin CHARACTERISTIC DFES_DTCM.DFC_DSMDummy_C "DFES/Hersteller spezifischer Fehlercode für Prüfung DFC_DSMDummy" VALUE 0x800268E4 Val_Wu16 65535.00 DFES_OneToOne 0.00 65535.00 /end CHARACTERISTIC
/begin CHARACTERISTIC DFES_DTCM.DFC_EBxFanOL_C "DFES/Hersteller spezifischer Fehlercode für Prüfung DFC_EBxFanOL" VALUE 0x800268E6 Val_Wu16 65535.00 DFES_OneToOne 0.00 65535.00 /end CHARACTERISTIC
/begin CHARACTERISTIC DFES_DTCM.DFC_EBxFanOvrTemp_C "DFES/Hersteller spezifischer Fehlercode für Prüfung DFC_EBxFanOvrTemp" VALUE 0x800268E8 Val_Wu16 65535.00 DFES_OneToOne 0.00 65535.00 /end CHARACTERISTIC
/begin CHARACTERISTIC DFES_DTCM.DFC_EBxFanSCB_C "DFES/Hersteller spezifischer Fehlercode für Prüfung DFC_EBxFanSCB" VALUE 0x800268EA Val_Wu16 65535.00 DFES_OneToOne 0.00 65535.00 /end CHARACTERISTIC
/begin CHARACTERISTIC DFES_DTCM.DFC_EBxFanSCG_C "DFES/Hersteller spezifischer Fehlercode für Prüfung DFC_EBxFanSCG" VALUE 0x800268EC Val_Wu16 65535.00 DFES_OneToOne 0.00 65535.00 /end CHARACTERISTIC
/begin CHARACTERISTIC DFES_DTCM.DFC_ECBVlvOL_C "DFES/Hersteller spezifischer Fehlercode für Prüfung DFC_ECBVlvOL" VALUE 0x800268EE Val_Wu16 65535.00 DFES_OneToOne 0.00 65535.00 /end CHARACTERISTIC
/begin CHARACTERISTIC DFES_DTCM.DFC_ECBVlvOvrTemp_C "DFES/Hersteller spezifischer Fehlercode für Prüfung DFC_ECBVlvOvrTemp" VALUE 0x800268F0 Val_Wu16 65535.00 DFES_OneToOne 0.00 65535.00 /end CHARACTERISTIC
/begin CHARACTERISTIC DFES_DTCM.DFC_ECBVlvSCB_C "DFES/Hersteller spezifischer Fehlercode für Prüfung DFC_ECBVlvSCB" VALUE 0x800268F2 Val_Wu16 65535.00 DFES_OneToOne 0.00 65535.00 /end CHARACTERISTIC
/begin CHARACTERISTIC DFES_DTCM.DFC_ECBVlvSCG_C "DFES/Hersteller spezifischer Fehlercode für Prüfung DFC_ECBVlvSCG" VALUE 0x800268F4 Val_Wu16 65535.00 DFES_OneToOne 0.00 65535.00 /end CHARACTERISTIC
/begin CHARACTERISTIC DFES_DTCM.DFC_EMDmpOL_0_C "DFES/Hersteller spezifischer Fehlercode für Prüfung DFC_EMDmpOL_0" VALUE 0x800268F6 Val_Wu16 65535.00 DFES_OneToOne 0.00 65535.00 /end CHARACTERISTIC
/begin CHARACTERISTIC DFES_DTCM.DFC_EMDmpOL_1_C "DFES/Hersteller spezifischer Fehlercode für Prüfung DFC_EMDmpOL_1" VALUE 0x800268F8 Val_Wu16 65535.00 DFES_OneToOne 0.00 65535.00 /end CHARACTERISTIC
/begin CHARACTERISTIC DFES_DTCM.DFC_EMDmpOvrTemp_0_C "DFES/Hersteller spezifischer Fehlercode für Prüfung DFC_EMDmpOvrTemp_0" VALUE 0x800268FA Val_Wu16 65535.00 DFES_OneToOne 0.00 65535.00 /end CHARACTERISTIC
/begin CHARACTERISTIC DFES_DTCM.DFC_EMDmpOvrTemp_1_C "DFES/Hersteller spezifischer Fehlercode für Prüfung DFC_EMDmpOvrTemp_1" VALUE 0x800268FC Val_Wu16 65535.00 DFES_OneToOne 0.00 65535.00 /end CHARACTERISTIC
/begin CHARACTERISTIC DFES_DTCM.DFC_EMDmpSCB_0_C "DFES/Hersteller spezifischer Fehlercode für Prüfung DFC_EMDmpSCB_0" VALUE 0x800268FE Val_Wu16 65535.00 DFES_OneToOne 0.00 65535.00 /end CHARACTERISTIC
/begin CHARACTERISTIC DFES_DTCM.DFC_EMDmpSCB_1_C "DFES/Hersteller spezifischer Fehlercode für Prüfung DFC_EMDmpSCB_1" VALUE 0x80026900 Val_Wu16 65535.00 DFES_OneToOne 0.00 65535.00 /end CHARACTERISTIC
/begin CHARACTERISTIC DFES_DTCM.DFC_EMDmpSCG_0_C "DFES/Hersteller spezifischer Fehlercode für Prüfung DFC_EMDmpSCG_0" VALUE 0x80026902 Val_Wu16 65535.00 DFES_OneToOne 0.00 65535.00 /end CHARACTERISTIC
/begin CHARACTERISTIC DFES_DTCM.DFC_EMDmpSCG_1_C "DFES/Hersteller spezifischer Fehlercode für Prüfung DFC_EMDmpSCG_1" VALUE 0x80026904 Val_Wu16 65535.00 DFES_OneToOne 0.00 65535.00 /end CHARACTERISTIC
/begin CHARACTERISTIC DFES_DTCM.DFC_EngStAOL_C "DFES/Hersteller spezifischer Fehlercode für Prüfung DFC_EngStAOL" VALUE 0x80026906 Val_Wu16 65535.00 DFES_OneToOne 0.00 65535.00 /end CHARACTERISTIC
/begin CHARACTERISTIC DFES_DTCM.DFC_EngStAOvrTemp_C "DFES/Hersteller spezifischer Fehlercode für Prüfung DFC_EngStAOvrTemp" VALUE 0x80026908 Val_Wu16 65535.00 DFES_OneToOne 0.00 65535.00 /end CHARACTERISTIC
/begin CHARACTERISTIC DFES_DTCM.DFC_EngStASCB_C "DFES/Hersteller spezifischer Fehlercode für Prüfung DFC_EngStASCB" VALUE 0x8002690A Val_Wu16 65535.00 DFES_OneToOne 0.00 65535.00 /end CHARACTERISTIC
/begin CHARACTERISTIC DFES_DTCM.DFC_EngStASCG_C "DFES/Hersteller spezifischer Fehlercode für Prüfung DFC_EngStASCG" VALUE 0x8002690C Val_Wu16 65535.00 DFES_OneToOne 0.00 65535.00 /end CHARACTERISTIC
/begin CHARACTERISTIC DFES_DTCM.DFC_FanOL_C "DFES/Hersteller spezifischer Fehlercode für Prüfung DFC_FanOL" VALUE 0x8002690E Val_Wu16 65535.00 DFES_OneToOne 0.00 65535.00 /end CHARACTERISTIC
/begin CHARACTERISTIC DFES_DTCM.DFC_FanOvrTemp_C "DFES/Hersteller spezifischer Fehlercode für Prüfung DFC_FanOvrTemp" VALUE 0x80026910 Val_Wu16 65535.00 DFES_OneToOne 0.00 65535.00 /end CHARACTERISTIC
/begin CHARACTERISTIC DFES_DTCM.DFC_FanSCB_C "DFES/Hersteller spezifischer Fehlercode für Prüfung DFC_FanSCB" VALUE 0x80026912 Val_Wu16 65535.00 DFES_OneToOne 0.00 65535.00 /end CHARACTERISTIC
/begin CHARACTERISTIC DFES_DTCM.DFC_FlFltHtOL_C "DFES/Hersteller spezifischer Fehlercode für Prüfung DFC_FlFltHtOL" VALUE 0x80026914 Val_Wu16 65535.00 DFES_OneToOne 0.00 65535.00 /end CHARACTERISTIC
/begin CHARACTERISTIC DFES_DTCM.DFC_FlFltHtOvrTemp_C "DFES/Hersteller spezifischer Fehlercode für Prüfung DFC_FlFltHtOvrTemp" VALUE 0x80026916 Val_Wu16 65535.00 DFES_OneToOne 0.00 65535.00 /end CHARACTERISTIC
/begin CHARACTERISTIC DFES_DTCM.DFC_FlFltHtSCB_C "DFES/Hersteller spezifischer Fehlercode für Prüfung DFC_FlFltHtSCB" VALUE 0x80026918 Val_Wu16 65535.00 DFES_OneToOne 0.00 65535.00 /end CHARACTERISTIC
/begin CHARACTERISTIC DFES_DTCM.DFC_FlFltHtSCG_C "DFES/Hersteller spezifischer Fehlercode für Prüfung DFC_FlFltHtSCG" VALUE 0x8002691A Val_Wu16 65535.00 DFES_OneToOne 0.00 65535.00 /end CHARACTERISTIC
/begin CHARACTERISTIC DFES_DTCM.DFC_LSUHtrMax_C "DFES/Hersteller spezifischer Fehlercode für Prüfung DFC_LSUHtrMax" VALUE 0x8002691C Val_Wu16 65535.00 DFES_OneToOne 0.00 65535.00 /end CHARACTERISTIC
/begin CHARACTERISTIC DFES_DTCM.DFC_LSUHtrMin_C "DFES/Hersteller spezifischer Fehlercode für Prüfung DFC_LSUHtrMin" VALUE 0x8002691E Val_Wu16 65535.00 DFES_OneToOne 0.00 65535.00 /end CHARACTERISTIC
/begin CHARACTERISTIC DFES_DTCM.DFC_LSUHtrNpl_C "DFES/Hersteller spezifischer Fehlercode für Prüfung DFC_LSUHtrNpl" VALUE 0x80026920 Val_Wu16 65535.00 DFES_OneToOne 0.00 65535.00 /end CHARACTERISTIC
/begin CHARACTERISTIC DFES_DTCM.DFC_LSUHtrSig_C "DFES/Hersteller spezifischer Fehlercode für Prüfung DFC_LSUHtrSig" VALUE 0x80026922 Val_Wu16 65535.00 DFES_OneToOne 0.00 65535.00 /end CHARACTERISTIC
/begin CHARACTERISTIC DFES_DTCM.DFC_LSUtExcMax_C "DFES/Hersteller spezifischer Fehlercode für Prüfung DFC_LSUtExcMax" VALUE 0x80026924 Val_Wu16 65535.00 DFES_OneToOne 0.00 65535.00 /end CHARACTERISTIC
/begin CHARACTERISTIC DFES_DTCM.DFC_LSUtExcMin_C "DFES/Hersteller spezifischer Fehlercode für Prüfung DFC_LSUtExcMin" VALUE 0x80026926 Val_Wu16 65535.00 DFES_OneToOne 0.00 65535.00 /end CHARACTERISTIC
/begin CHARACTERISTIC DFES_DTCM.DFC_MeUnOL_C "DFES/Hersteller spezifischer Fehlercode für Prüfung DFC_MeUnOL" VALUE 0x80026928 Val_Wu16 65535.00 DFES_OneToOne 0.00 65535.00 /end CHARACTERISTIC
/begin CHARACTERISTIC DFES_DTCM.DFC_MeUnSCB_C "DFES/Hersteller spezifischer Fehlercode für Prüfung DFC_MeUnSCB" VALUE 0x8002692A Val_Wu16 65535.00 DFES_OneToOne 0.00 65535.00 /end CHARACTERISTIC
/begin CHARACTERISTIC DFES_DTCM.DFC_MeUnSRCMax_C "DFES/Hersteller spezifischer Fehlercode für Prüfung DFC_MeUnSRCMax" VALUE 0x8002692C Val_Wu16 65535.00 DFES_OneToOne 0.00 65535.00 /end CHARACTERISTIC
/begin CHARACTERISTIC DFES_DTCM.DFC_MeUnSRCMin_C "DFES/Hersteller spezifischer Fehlercode für Prüfung DFC_MeUnSRCMin" VALUE 0x8002692E Val_Wu16 65535.00 DFES_OneToOne 0.00 65535.00 /end CHARACTERISTIC
/begin CHARACTERISTIC DFES_DTCM.DFC_PCVOL_C "DFES/Hersteller spezifischer Fehlercode für Prüfung DFC_PCVOL" VALUE 0x80026930 Val_Wu16 65535.00 DFES_OneToOne 0.00 65535.00 /end CHARACTERISTIC
/begin CHARACTERISTIC DFES_DTCM.DFC_PCVSCB_C "DFES/Hersteller spezifischer Fehlercode für Prüfung DFC_PCVSCB" VALUE 0x80026932 Val_Wu16 65535.00 DFES_OneToOne 0.00 65535.00 /end CHARACTERISTIC
/begin CHARACTERISTIC DFES_DTCM.DFC_PCVSRCMax_C "DFES/Hersteller spezifischer Fehlercode für Prüfung DFC_PCVSRCMax" VALUE 0x80026934 Val_Wu16 65535.00 DFES_OneToOne 0.00 65535.00 /end CHARACTERISTIC
/begin CHARACTERISTIC DFES_DTCM.DFC_PCVSRCMin_C "DFES/Hersteller spezifischer Fehlercode für Prüfung DFC_PCVSRCMin" VALUE 0x80026936 Val_Wu16 65535.00 DFES_OneToOne 0.00 65535.00 /end CHARACTERISTIC
/begin CHARACTERISTIC DFES_DTCM.DFC_RailPSRCMax_C "DFES/Hersteller spezifischer Fehlercode für Prüfung DFC_RailPSRCMax" VALUE 0x80026938 Val_Wu16 65535.00 DFES_OneToOne 0.00 65535.00 /end CHARACTERISTIC
/begin CHARACTERISTIC DFES_DTCM.DFC_RailPSRCMin_C "DFES/Hersteller spezifischer Fehlercode für Prüfung DFC_RailPSRCMin" VALUE 0x8002693A Val_Wu16 65535.00 DFES_OneToOne 0.00 65535.00 /end CHARACTERISTIC
/begin CHARACTERISTIC DFES_DTCM.DFC_ShtrOL_C "DFES/Hersteller spezifischer Fehlercode für Prüfung DFC_ShtrOL" VALUE 0x8002693C Val_Wu16 65535.00 DFES_OneToOne 0.00 65535.00 /end CHARACTERISTIC
/begin CHARACTERISTIC DFES_DTCM.DFC_ShtrOvrTemp_C "DFES/Hersteller spezifischer Fehlercode für Prüfung DFC_ShtrOvrTemp" VALUE 0x8002693E Val_Wu16 65535.00 DFES_OneToOne 0.00 65535.00 /end CHARACTERISTIC
/begin CHARACTERISTIC DFES_DTCM.DFC_ShtrSCB_C "DFES/Hersteller spezifischer Fehlercode für Prüfung DFC_ShtrSCB" VALUE 0x80026940 Val_Wu16 65535.00 DFES_OneToOne 0.00 65535.00 /end CHARACTERISTIC
/begin CHARACTERISTIC DFES_DTCM.DFC_ShtrSCG_C "DFES/Hersteller spezifischer Fehlercode für Prüfung DFC_ShtrSCG" VALUE 0x80026942 Val_Wu16 65535.00 DFES_OneToOne 0.00 65535.00 /end CHARACTERISTIC
/begin CHARACTERISTIC DFES_DTCM.DFC_StrtOL_C "DFES/Hersteller spezifischer Fehlercode für Prüfung DFC_StrtOL" VALUE 0x80026944 Val_Wu16 65535.00 DFES_OneToOne 0.00 65535.00 /end CHARACTERISTIC
/begin CHARACTERISTIC DFES_DTCM.DFC_StrtOvrTemp_C "DFES/Hersteller spezifischer Fehlercode für Prüfung DFC_StrtOvrTemp" VALUE 0x80026946 Val_Wu16 65535.00 DFES_OneToOne 0.00 65535.00 /end CHARACTERISTIC
/begin CHARACTERISTIC DFES_DTCM.DFC_StrtSCB_C "DFES/Hersteller spezifischer Fehlercode für Prüfung DFC_StrtSCB" VALUE 0x80026948 Val_Wu16 65535.00 DFES_OneToOne 0.00 65535.00 /end CHARACTERISTIC
/begin CHARACTERISTIC DFES_DTCM.DFC_StrtSCG_C "DFES/Hersteller spezifischer Fehlercode für Prüfung DFC_StrtSCG" VALUE 0x8002694A Val_Wu16 65535.00 DFES_OneToOne 0.00 65535.00 /end CHARACTERISTIC
/begin CHARACTERISTIC DFES_DTCM.DFC_ThrVlvOL_C "DFES/Hersteller spezifischer Fehlercode für Prüfung DFC_ThrVlvOL" VALUE 0x8002694C Val_Wu16 65535.00 DFES_OneToOne 0.00 65535.00 /end CHARACTERISTIC
/begin CHARACTERISTIC DFES_DTCM.DFC_ThrVlvOvrTemp_C "DFES/Hersteller spezifischer Fehlercode für Prüfung DFC_ThrVlvOvrTemp" VALUE 0x8002694E Val_Wu16 65535.00 DFES_OneToOne 0.00 65535.00 /end CHARACTERISTIC
/begin CHARACTERISTIC DFES_DTCM.DFC_ThrVlvSCB_C "DFES/Hersteller spezifischer Fehlercode für Prüfung DFC_ThrVlvSCB" VALUE 0x80026950 Val_Wu16 65535.00 DFES_OneToOne 0.00 65535.00 /end CHARACTERISTIC
/begin CHARACTERISTIC DFES_DTCM.DFC_TrbChOL_C "DFES/Hersteller spezifischer Fehlercode für Prüfung DFC_TrbChOL" VALUE 0x80026952 Val_Wu16 65535.00 DFES_OneToOne 0.00 65535.00 /end CHARACTERISTIC
/begin CHARACTERISTIC DFES_DTCM.DFC_TrbChOvrTemp_C "DFES/Hersteller spezifischer Fehlercode für Prüfung DFC_TrbChOvrTemp" VALUE 0x80026954 Val_Wu16 65535.00 DFES_OneToOne 0.00 65535.00 /end CHARACTERISTIC
/begin CHARACTERISTIC DFES_DTCM.DFC_TrbChSCB_C "DFES/Hersteller spezifischer Fehlercode für Prüfung DFC_TrbChSCB" VALUE 0x80026956 Val_Wu16 65535.00 DFES_OneToOne 0.00 65535.00 /end CHARACTERISTIC
/begin CHARACTERISTIC DFES_DTCM.DFC_UDosVlvOL_C "DFES/Hersteller spezifischer Fehlercode für Prüfung DFC_UDosVlvOL" VALUE 0x80026958 Val_Wu16 65535.00 DFES_OneToOne 0.00 65535.00 /end CHARACTERISTIC
/begin CHARACTERISTIC DFES_DTCM.DFC_UDosVlvOvrTemp_C "DFES/Hersteller spezifischer Fehlercode für Prüfung DFC_UDosVlvOvrTemp" VALUE 0x8002695A Val_Wu16 65535.00 DFES_OneToOne 0.00 65535.00 /end CHARACTERISTIC
/begin CHARACTERISTIC DFES_DTCM.DFC_UDosVlvSCB_C "DFES/Hersteller spezifischer Fehlercode für Prüfung DFC_UDosVlvSCB" VALUE 0x8002695C Val_Wu16 65535.00 DFES_OneToOne 0.00 65535.00 /end CHARACTERISTIC
/begin CHARACTERISTIC DFES_DTCM.DFC_UDosVlvSCG_C "DFES/Hersteller spezifischer Fehlercode für Prüfung DFC_UDosVlvSCG" VALUE 0x8002695E Val_Wu16 65535.00 DFES_OneToOne 0.00 65535.00 /end CHARACTERISTIC
/begin CHARACTERISTIC DFES_DTCM.DFC_UPmpMotOL_C "DFES/Hersteller spezifischer Fehlercode für Prüfung DFC_UPmpMotOL" VALUE 0x80026960 Val_Wu16 65535.00 DFES_OneToOne 0.00 65535.00 /end CHARACTERISTIC
/begin CHARACTERISTIC DFES_DTCM.DFC_UPmpMotOvrTemp_C "DFES/Hersteller spezifischer Fehlercode für Prüfung DFC_UPmpMotOvrTemp" VALUE 0x80026962 Val_Wu16 65535.00 DFES_OneToOne 0.00 65535.00 /end CHARACTERISTIC
/begin CHARACTERISTIC DFES_DTCM.DFC_UPmpMotSCB_C "DFES/Hersteller spezifischer Fehlercode für Prüfung DFC_UPmpMotSCB" VALUE 0x80026964 Val_Wu16 65535.00 DFES_OneToOne 0.00 65535.00 /end CHARACTERISTIC
/begin CHARACTERISTIC DFES_DTCM.DFC_UPmpMotSCG_C "DFES/Hersteller spezifischer Fehlercode für Prüfung DFC_UPmpMotSCG" VALUE 0x80026966 Val_Wu16 65535.00 DFES_OneToOne 0.00 65535.00 /end CHARACTERISTIC
/begin CHARACTERISTIC DFES_DTCM.DFC_WaHtElOL_C "DFES/Hersteller spezifischer Fehlercode für Prüfung DFC_WaHtElOL" VALUE 0x80026968 Val_Wu16 65535.00 DFES_OneToOne 0.00 65535.00 /end CHARACTERISTIC
/begin CHARACTERISTIC DFES_DTCM.DFC_WaHtElOvrTemp_C "DFES/Hersteller spezifischer Fehlercode für Prüfung DFC_WaHtElOvrTemp" VALUE 0x8002696A Val_Wu16 65535.00 DFES_OneToOne 0.00 65535.00 /end CHARACTERISTIC
/begin CHARACTERISTIC DFES_DTCM.DFC_WaHtElSCB_C "DFES/Hersteller spezifischer Fehlercode für Prüfung DFC_WaHtElSCB" VALUE 0x8002696C Val_Wu16 65535.00 DFES_OneToOne 0.00 65535.00 /end CHARACTERISTIC
/begin CHARACTERISTIC DFES_DTCM.DFC_IVActrUChSRCMax_C "DFES/Hersteller spezifischer Fehlercode für Prüfung DFC_IVActrUChSRCMax" VALUE 0x8002696E Val_Wu16 65535.00 DFES_OneToOne 0.00 65535.00 /end CHARACTERISTIC
/begin CHARACTERISTIC DFES_DTCM.DFC_IVActrUChSRCMin_C "DFES/Hersteller spezifischer Fehlercode für Prüfung DFC_IVActrUChSRCMin" VALUE 0x80026970 Val_Wu16 65535.00 DFES_OneToOne 0.00 65535.00 /end CHARACTERISTIC
/begin CHARACTERISTIC DFES_DTCM.DFC_IVActrVltgSRCMax_C "DFES/Hersteller spezifischer Fehlercode für Prüfung DFC_IVActrVltgSRCMax" VALUE 0x80026972 Val_Wu16 65535.00 DFES_OneToOne 0.00 65535.00 /end CHARACTERISTIC
/begin CHARACTERISTIC DFES_DTCM.DFC_IVActrVltgSRCMin_C "DFES/Hersteller spezifischer Fehlercode für Prüfung DFC_IVActrVltgSRCMin" VALUE 0x80026974 Val_Wu16 65535.00 DFES_OneToOne 0.00 65535.00 /end CHARACTERISTIC
/begin CHARACTERISTIC DFES_DTCM.DFC_IVDiaTunDet_C "DFES/Hersteller spezifischer Fehlercode für Prüfung DFC_IVDiaTunDet" VALUE 0x80026976 Val_Wu16 65535.00 DFES_OneToOne 0.00 65535.00 /end CHARACTERISTIC
/begin CHARACTERISTIC DFES_DTCM.DFC_IVPSplyStopDCDC_C "DFES/Hersteller spezifischer Fehlercode für Prüfung DFC_IVPSplyStopDCDC" VALUE 0x80026978 Val_Wu16 65535.00 DFES_OneToOne 0.00 65535.00 /end CHARACTERISTIC
/begin CHARACTERISTIC DFES_DTCM.DFC_IVPSplyVltgSRCMax_C "DFES/Hersteller spezifischer Fehlercode für Prüfung DFC_IVPSplyVltgSRCMax" VALUE 0x8002697A Val_Wu16 65535.00 DFES_OneToOne 0.00 65535.00 /end CHARACTERISTIC
/begin CHARACTERISTIC DFES_DTCM.DFC_IVPSplyVltgSRCMin_C "DFES/Hersteller spezifischer Fehlercode für Prüfung DFC_IVPSplyVltgSRCMin" VALUE 0x8002697C Val_Wu16 65535.00 DFES_OneToOne 0.00 65535.00 /end CHARACTERISTIC
/begin CHARACTERISTIC DFES_DTCM.DFC_SCREtaErr_C "DFES/Hersteller spezifischer Fehlercode für Prüfung DFC_SCREtaErr" VALUE 0x8002697E Val_Wu16 65535.00 DFES_OneToOne 0.00 65535.00 /end CHARACTERISTIC
/begin CHARACTERISTIC DFES_DTCM.DFC_SCREtaErr1_C "DFES/Hersteller spezifischer Fehlercode für Prüfung DFC_SCREtaErr1" VALUE 0x80026980 Val_Wu16 65535.00 DFES_OneToOne 0.00 65535.00 /end CHARACTERISTIC
/begin CHARACTERISTIC DFES_DTCM.DFC_SCREtaErr2_C "DFES/Hersteller spezifischer Fehlercode für Prüfung DFC_SCREtaErr2" VALUE 0x80026982 Val_Wu16 65535.00 DFES_OneToOne 0.00 65535.00 /end CHARACTERISTIC
/begin CHARACTERISTIC DFES_DTCM.DFC_SCRMonMetCtlPresErr_C "DFES/Hersteller spezifischer Fehlercode für Prüfung DFC_SCRMonMetCtlPresErr" VALUE 0x80026984 Val_Wu16 65535.00 DFES_OneToOne 0.00 65535.00 /end CHARACTERISTIC
/begin CHARACTERISTIC DFES_DTCM.DFC_SCRMonPresBuildUpErr_C "DFES/Hersteller spezifischer Fehlercode für Prüfung DFC_SCRMonPresBuildUpErr" VALUE 0x80026986 Val_Wu16 65535.00 DFES_OneToOne 0.00 65535.00 /end CHARACTERISTIC
/begin CHARACTERISTIC DFES_DTCM.DFC_SCRMonPresRdcErr_C "DFES/Hersteller spezifischer Fehlercode für Prüfung DFC_SCRMonPresRdcErr" VALUE 0x80026988 Val_Wu16 65535.00 DFES_OneToOne 0.00 65535.00 /end CHARACTERISTIC
/begin CHARACTERISTIC DFES_DTCM.DFC_AFSOffsDrftMax_C "DFES/Hersteller spezifischer Fehlercode für Prüfung DFC_AFSOffsDrftMax" VALUE 0x8002698A Val_Wu16 65535.00 DFES_OneToOne 0.00 65535.00 /end CHARACTERISTIC
/begin CHARACTERISTIC DFES_DTCM.DFC_AFSOffsDrftMin_C "DFES/Hersteller spezifischer Fehlercode für Prüfung DFC_AFSOffsDrftMin" VALUE 0x8002698C Val_Wu16 65535.00 DFES_OneToOne 0.00 65535.00 /end CHARACTERISTIC
/begin CHARACTERISTIC DFES_DTCM.DFC_AFSSRCCorMax_C "DFES/Hersteller spezifischer Fehlercode für Prüfung DFC_AFSSRCCorMax" VALUE 0x8002698E Val_Wu16 65535.00 DFES_OneToOne 0.00 65535.00 /end CHARACTERISTIC
/begin CHARACTERISTIC DFES_DTCM.DFC_AFSSRCCorMin_C "DFES/Hersteller spezifischer Fehlercode für Prüfung DFC_AFSSRCCorMin" VALUE 0x80026990 Val_Wu16 65535.00 DFES_OneToOne 0.00 65535.00 /end CHARACTERISTIC
/begin CHARACTERISTIC DFES_DTCM.DFC_AFSSRCRawMax_C "DFES/Hersteller spezifischer Fehlercode für Prüfung DFC_AFSSRCRawMax" VALUE 0x80026992 Val_Wu16 65535.00 DFES_OneToOne 0.00 65535.00 /end CHARACTERISTIC
/begin CHARACTERISTIC DFES_DTCM.DFC_AFSSRCRawMin_C "DFES/Hersteller spezifischer Fehlercode für Prüfung DFC_AFSSRCRawMin" VALUE 0x80026994 Val_Wu16 65535.00 DFES_OneToOne 0.00 65535.00 /end CHARACTERISTIC
/begin CHARACTERISTIC DFES_DTCM.DFC_AFSSetyDrftMax_C "DFES/Hersteller spezifischer Fehlercode für Prüfung DFC_AFSSetyDrftMax" VALUE 0x80026996 Val_Wu16 65535.00 DFES_OneToOne 0.00 65535.00 /end CHARACTERISTIC
/begin CHARACTERISTIC DFES_DTCM.DFC_AFSSetyDrftMin_C "DFES/Hersteller spezifischer Fehlercode für Prüfung DFC_AFSSetyDrftMin" VALUE 0x80026998 Val_Wu16 65535.00 DFES_OneToOne 0.00 65535.00 /end CHARACTERISTIC
/begin CHARACTERISTIC DFES_DTCM.DFC_AirCSwtNpl_C "DFES/Hersteller spezifischer Fehlercode für Prüfung DFC_AirCSwtNpl" VALUE 0x8002699A Val_Wu16 65535.00 DFES_OneToOne 0.00 65535.00 /end CHARACTERISTIC
/begin CHARACTERISTIC DFES_DTCM.DFC_AirCSwtSig_C "DFES/Hersteller spezifischer Fehlercode für Prüfung DFC_AirCSwtSig" VALUE 0x8002699C Val_Wu16 65535.00 DFES_OneToOne 0.00 65535.00 /end CHARACTERISTIC
/begin CHARACTERISTIC DFES_DTCM.DFC_BattUSRCMax_C "DFES/Hersteller spezifischer Fehlercode für Prüfung DFC_BattUSRCMax" VALUE 0x8002699E Val_Wu16 65535.00 DFES_OneToOne 0.00 65535.00 /end CHARACTERISTIC
/begin CHARACTERISTIC DFES_DTCM.DFC_BattUSRCMin_C "DFES/Hersteller spezifischer Fehlercode für Prüfung DFC_BattUSRCMin" VALUE 0x800269A0 Val_Wu16 65535.00 DFES_OneToOne 0.00 65535.00 /end CHARACTERISTIC
/begin CHARACTERISTIC DFES_DTCM.DFC_BrkNpl_C "DFES/Hersteller spezifischer Fehlercode für Prüfung DFC_BrkNpl" VALUE 0x800269A2 Val_Wu16 65535.00 DFES_OneToOne 0.00 65535.00 /end CHARACTERISTIC
/begin CHARACTERISTIC DFES_DTCM.DFC_BrkPSRCMax_C "DFES/Hersteller spezifischer Fehlercode für Prüfung DFC_BrkPSRCMax" VALUE 0x800269A4 Val_Wu16 65535.00 DFES_OneToOne 0.00 65535.00 /end CHARACTERISTIC
/begin CHARACTERISTIC DFES_DTCM.DFC_BrkPSRCMin_C "DFES/Hersteller spezifischer Fehlercode für Prüfung DFC_BrkPSRCMin" VALUE 0x800269A6 Val_Wu16 65535.00 DFES_OneToOne 0.00 65535.00 /end CHARACTERISTIC
/begin CHARACTERISTIC DFES_DTCM.DFC_CEngDsTSRCMax_C "DFES/Hersteller spezifischer Fehlercode für Prüfung DFC_CEngDsTSRCMax" VALUE 0x800269A8 Val_Wu16 65535.00 DFES_OneToOne 0.00 65535.00 /end CHARACTERISTIC
/begin CHARACTERISTIC DFES_DTCM.DFC_CEngDsTSRCMin_C "DFES/Hersteller spezifischer Fehlercode für Prüfung DFC_CEngDsTSRCMin" VALUE 0x800269AA Val_Wu16 65535.00 DFES_OneToOne 0.00 65535.00 /end CHARACTERISTIC
/begin CHARACTERISTIC DFES_DTCM.DFC_CrCUIDet_C "DFES/Hersteller spezifischer Fehlercode für Prüfung DFC_CrCUIDet" VALUE 0x800269AC Val_Wu16 65535.00 DFES_OneToOne 0.00 65535.00 /end CHARACTERISTIC
/begin CHARACTERISTIC DFES_DTCM.DFC_ECBVlvSRCMax_C "DFES/Hersteller spezifischer Fehlercode für Prüfung DFC_ECBVlvSRCMax" VALUE 0x800269AE Val_Wu16 65535.00 DFES_OneToOne 0.00 65535.00 /end CHARACTERISTIC
/begin CHARACTERISTIC DFES_DTCM.DFC_ECBVlvSRCMin_C "DFES/Hersteller spezifischer Fehlercode für Prüfung DFC_ECBVlvSRCMin" VALUE 0x800269B0 Val_Wu16 65535.00 DFES_OneToOne 0.00 65535.00 /end CHARACTERISTIC
/begin CHARACTERISTIC DFES_DTCM.DFC_ECUOvrTemp_C "DFES/Hersteller spezifischer Fehlercode für Prüfung DFC_ECUOvrTemp" VALUE 0x800269B2 Val_Wu16 65535.00 DFES_OneToOne 0.00 65535.00 /end CHARACTERISTIC
/begin CHARACTERISTIC DFES_DTCM.DFC_EGRVlvGovDvtMax_C "DFES/Hersteller spezifischer Fehlercode für Prüfung DFC_EGRVlvGovDvtMax" VALUE 0x800269B4 Val_Wu16 65535.00 DFES_OneToOne 0.00 65535.00 /end CHARACTERISTIC
/begin CHARACTERISTIC DFES_DTCM.DFC_EGRVlvGovDvtMin_C "DFES/Hersteller spezifischer Fehlercode für Prüfung DFC_EGRVlvGovDvtMin" VALUE 0x800269B6 Val_Wu16 65535.00 DFES_OneToOne 0.00 65535.00 /end CHARACTERISTIC
/begin CHARACTERISTIC DFES_DTCM.DFC_EGRVlvHBrgOpnLd_C "DFES/Hersteller spezifischer Fehlercode für Prüfung DFC_EGRVlvHBrgOpnLd" VALUE 0x800269B8 Val_Wu16 65535.00 DFES_OneToOne 0.00 65535.00 /end CHARACTERISTIC
/begin CHARACTERISTIC DFES_DTCM.DFC_EGRVlvHBrgOvrCurr_C "DFES/Hersteller spezifischer Fehlercode für Prüfung DFC_EGRVlvHBrgOvrCurr" VALUE 0x800269BA Val_Wu16 65535.00 DFES_OneToOne 0.00 65535.00 /end CHARACTERISTIC
/begin CHARACTERISTIC DFES_DTCM.DFC_EGRVlvHBrgOvrTemp_C "DFES/Hersteller spezifischer Fehlercode für Prüfung DFC_EGRVlvHBrgOvrTemp" VALUE 0x800269BC Val_Wu16 65535.00 DFES_OneToOne 0.00 65535.00 /end CHARACTERISTIC
/begin CHARACTERISTIC DFES_DTCM.DFC_EGRVlvHBrgShCirBatt1_C "DFES/Hersteller spezifischer Fehlercode für Prüfung DFC_EGRVlvHBrgShCirBatt1" VALUE 0x800269BE Val_Wu16 65535.00 DFES_OneToOne 0.00 65535.00 /end CHARACTERISTIC
/begin CHARACTERISTIC DFES_DTCM.DFC_EGRVlvHBrgShCirBatt2_C "DFES/Hersteller spezifischer Fehlercode für Prüfung DFC_EGRVlvHBrgShCirBatt2" VALUE 0x800269C0 Val_Wu16 65535.00 DFES_OneToOne 0.00 65535.00 /end CHARACTERISTIC
/begin CHARACTERISTIC DFES_DTCM.DFC_EGRVlvHBrgShCirGnd1_C "DFES/Hersteller spezifischer Fehlercode für Prüfung DFC_EGRVlvHBrgShCirGnd1" VALUE 0x800269C2 Val_Wu16 65535.00 DFES_OneToOne 0.00 65535.00 /end CHARACTERISTIC
/begin CHARACTERISTIC DFES_DTCM.DFC_EGRVlvHBrgShCirGnd2_C "DFES/Hersteller spezifischer Fehlercode für Prüfung DFC_EGRVlvHBrgShCirGnd2" VALUE 0x800269C4 Val_Wu16 65535.00 DFES_OneToOne 0.00 65535.00 /end CHARACTERISTIC
/begin CHARACTERISTIC DFES_DTCM.DFC_EGRVlvHBrgShCirOvrLd_C "DFES/Hersteller spezifischer Fehlercode für Prüfung DFC_EGRVlvHBrgShCirOvrLd" VALUE 0x800269C6 Val_Wu16 65535.00 DFES_OneToOne 0.00 65535.00 /end CHARACTERISTIC
/begin CHARACTERISTIC DFES_DTCM.DFC_EGRVlvHBrgTempOvrCurr_C "DFES/Hersteller spezifischer Fehlercode für Prüfung DFC_EGRVlvHBrgTempOvrCurr" VALUE 0x800269C8 Val_Wu16 65535.00 DFES_OneToOne 0.00 65535.00 /end CHARACTERISTIC
/begin CHARACTERISTIC DFES_DTCM.DFC_EGRVlvHBrgUndrVltg_C "DFES/Hersteller spezifischer Fehlercode für Prüfung DFC_EGRVlvHBrgUndrVltg" VALUE 0x800269CA Val_Wu16 65535.00 DFES_OneToOne 0.00 65535.00 /end CHARACTERISTIC
/begin CHARACTERISTIC DFES_DTCM.DFC_EGRVlvLPGovDvtMax_C "DFES/Hersteller spezifischer Fehlercode für Prüfung DFC_EGRVlvLPGovDvtMax" VALUE 0x800269CC Val_Wu16 65535.00 DFES_OneToOne 0.00 65535.00 /end CHARACTERISTIC
/begin CHARACTERISTIC DFES_DTCM.DFC_EGRVlvLPGovDvtMin_C "DFES/Hersteller spezifischer Fehlercode für Prüfung DFC_EGRVlvLPGovDvtMin" VALUE 0x800269CE Val_Wu16 65535.00 DFES_OneToOne 0.00 65535.00 /end CHARACTERISTIC
/begin CHARACTERISTIC DFES_DTCM.DFC_EGRVlvLPHBrgOpnLd_C "DFES/Hersteller spezifischer Fehlercode für Prüfung DFC_EGRVlvLPHBrgOpnLd" VALUE 0x800269D0 Val_Wu16 65535.00 DFES_OneToOne 0.00 65535.00 /end CHARACTERISTIC
/begin CHARACTERISTIC DFES_DTCM.DFC_EGRVlvLPHBrgOvrCurr_C "DFES/Hersteller spezifischer Fehlercode für Prüfung DFC_EGRVlvLPHBrgOvrCurr" VALUE 0x800269D2 Val_Wu16 65535.00 DFES_OneToOne 0.00 65535.00 /end CHARACTERISTIC
/begin CHARACTERISTIC DFES_DTCM.DFC_EGRVlvLPHBrgOvrTemp_C "DFES/Hersteller spezifischer Fehlercode für Prüfung DFC_EGRVlvLPHBrgOvrTemp" VALUE 0x800269D4 Val_Wu16 65535.00 DFES_OneToOne 0.00 65535.00 /end CHARACTERISTIC
/begin CHARACTERISTIC DFES_DTCM.DFC_EGRVlvLPHBrgShCirBatt1_C "DFES/Hersteller spezifischer Fehlercode für Prüfung DFC_EGRVlvLPHBrgShCirBatt1" VALUE 0x800269D6 Val_Wu16 65535.00 DFES_OneToOne 0.00 65535.00 /end CHARACTERISTIC
/begin CHARACTERISTIC DFES_DTCM.DFC_EGRVlvLPHBrgShCirBatt2_C "DFES/Hersteller spezifischer Fehlercode für Prüfung DFC_EGRVlvLPHBrgShCirBatt2" VALUE 0x800269D8 Val_Wu16 65535.00 DFES_OneToOne 0.00 65535.00 /end CHARACTERISTIC
/begin CHARACTERISTIC DFES_DTCM.DFC_EGRVlvLPHBrgShCirGnd1_C "DFES/Hersteller spezifischer Fehlercode für Prüfung DFC_EGRVlvLPHBrgShCirGnd1" VALUE 0x800269DA Val_Wu16 65535.00 DFES_OneToOne 0.00 65535.00 /end CHARACTERISTIC
/begin CHARACTERISTIC DFES_DTCM.DFC_EGRVlvLPHBrgShCirGnd2_C "DFES/Hersteller spezifischer Fehlercode für Prüfung DFC_EGRVlvLPHBrgShCirGnd2" VALUE 0x800269DC Val_Wu16 65535.00 DFES_OneToOne 0.00 65535.00 /end CHARACTERISTIC
/begin CHARACTERISTIC DFES_DTCM.DFC_EGRVlvLPHBrgShCirOvrLd_C "DFES/Hersteller spezifischer Fehlercode für Prüfung DFC_EGRVlvLPHBrgShCirOvrLd" VALUE 0x800269DE Val_Wu16 65535.00 DFES_OneToOne 0.00 65535.00 /end CHARACTERISTIC
/begin CHARACTERISTIC DFES_DTCM.DFC_EGRVlvLPHBrgTempOvrCurr_C "DFES/Hersteller spezifischer Fehlercode für Prüfung DFC_EGRVlvLPHBrgTempOvrCurr" VALUE 0x800269E0 Val_Wu16 65535.00 DFES_OneToOne 0.00 65535.00 /end CHARACTERISTIC
/begin CHARACTERISTIC DFES_DTCM.DFC_EGRVlvLPHBrgUndrVltg_C "DFES/Hersteller spezifischer Fehlercode für Prüfung DFC_EGRVlvLPHBrgUndrVltg" VALUE 0x800269E2 Val_Wu16 65535.00 DFES_OneToOne 0.00 65535.00 /end CHARACTERISTIC
/begin CHARACTERISTIC DFES_DTCM.DFC_EGRVlvLPOL_C "DFES/Hersteller spezifischer Fehlercode für Prüfung DFC_EGRVlvLPOL" VALUE 0x800269E4 Val_Wu16 65535.00 DFES_OneToOne 0.00 65535.00 /end CHARACTERISTIC
/begin CHARACTERISTIC DFES_DTCM.DFC_EGRVlvLPSCB_C "DFES/Hersteller spezifischer Fehlercode für Prüfung DFC_EGRVlvLPSCB" VALUE 0x800269E6 Val_Wu16 65535.00 DFES_OneToOne 0.00 65535.00 /end CHARACTERISTIC
/begin CHARACTERISTIC DFES_DTCM.DFC_EGRVlvLPSCG_C "DFES/Hersteller spezifischer Fehlercode für Prüfung DFC_EGRVlvLPSCG" VALUE 0x800269E8 Val_Wu16 65535.00 DFES_OneToOne 0.00 65535.00 /end CHARACTERISTIC
/begin CHARACTERISTIC DFES_DTCM.DFC_EGRVlvLPSRCMax_C "DFES/Hersteller spezifischer Fehlercode für Prüfung DFC_EGRVlvLPSRCMax" VALUE 0x800269EA Val_Wu16 65535.00 DFES_OneToOne 0.00 65535.00 /end CHARACTERISTIC
/begin CHARACTERISTIC DFES_DTCM.DFC_EGRVlvLPSRCMin_C "DFES/Hersteller spezifischer Fehlercode für Prüfung DFC_EGRVlvLPSRCMin" VALUE 0x800269EC Val_Wu16 65535.00 DFES_OneToOne 0.00 65535.00 /end CHARACTERISTIC
/begin CHARACTERISTIC DFES_DTCM.DFC_EGRVlvOL_C "DFES/Hersteller spezifischer Fehlercode für Prüfung DFC_EGRVlvOL" VALUE 0x800269EE Val_Wu16 65535.00 DFES_OneToOne 0.00 65535.00 /end CHARACTERISTIC
/begin CHARACTERISTIC DFES_DTCM.DFC_EGRVlvSCB_C "DFES/Hersteller spezifischer Fehlercode für Prüfung DFC_EGRVlvSCB" VALUE 0x800269F0 Val_Wu16 65535.00 DFES_OneToOne 0.00 65535.00 /end CHARACTERISTIC
/begin CHARACTERISTIC DFES_DTCM.DFC_EGRVlvSCG_C "DFES/Hersteller spezifischer Fehlercode für Prüfung DFC_EGRVlvSCG" VALUE 0x800269F2 Val_Wu16 65535.00 DFES_OneToOne 0.00 65535.00 /end CHARACTERISTIC
/begin CHARACTERISTIC DFES_DTCM.DFC_EGRVlvSRCMax_C "DFES/Hersteller spezifischer Fehlercode für Prüfung DFC_EGRVlvSRCMax" VALUE 0x800269F4 Val_Wu16 65535.00 DFES_OneToOne 0.00 65535.00 /end CHARACTERISTIC
/begin CHARACTERISTIC DFES_DTCM.DFC_EGRVlvSRCMin_C "DFES/Hersteller spezifischer Fehlercode für Prüfung DFC_EGRVlvSRCMin" VALUE 0x800269F6 Val_Wu16 65535.00 DFES_OneToOne 0.00 65535.00 /end CHARACTERISTIC
/begin CHARACTERISTIC DFES_DTCM.DFC_EngPrtOvrSpd_C "DFES/Hersteller spezifischer Fehlercode für Prüfung DFC_EngPrtOvrSpd" VALUE 0x800269F8 Val_Wu16 65535.00 DFES_OneToOne 0.00 65535.00 /end CHARACTERISTIC
/begin CHARACTERISTIC DFES_DTCM.DFC_EngSpdOL_C "DFES/Hersteller spezifischer Fehlercode für Prüfung DFC_EngSpdOL" VALUE 0x800269FA Val_Wu16 65535.00 DFES_OneToOne 0.00 65535.00 /end CHARACTERISTIC
/begin CHARACTERISTIC DFES_DTCM.DFC_EngSpdSCB_C "DFES/Hersteller spezifischer Fehlercode für Prüfung DFC_EngSpdSCB" VALUE 0x800269FC Val_Wu16 65535.00 DFES_OneToOne 0.00 65535.00 /end CHARACTERISTIC
/begin CHARACTERISTIC DFES_DTCM.DFC_EngSpdSCG_C "DFES/Hersteller spezifischer Fehlercode für Prüfung DFC_EngSpdSCG" VALUE 0x800269FE Val_Wu16 65535.00 DFES_OneToOne 0.00 65535.00 /end CHARACTERISTIC
/begin CHARACTERISTIC DFES_DTCM.DFC_EnhSRCMaxPPFltDiff_C "DFES/Hersteller spezifischer Fehlercode für Prüfung DFC_EnhSRCMaxPPFltDiff" VALUE 0x80026A00 Val_Wu16 65535.00 DFES_OneToOne 0.00 65535.00 /end CHARACTERISTIC
/begin CHARACTERISTIC DFES_DTCM.DFC_EnhSRCMaxT1ExhTMon_C "DFES/Hersteller spezifischer Fehlercode für Prüfung DFC_EnhSRCMaxT1ExhTMon" VALUE 0x80026A02 Val_Wu16 65535.00 DFES_OneToOne 0.00 65535.00 /end CHARACTERISTIC
/begin CHARACTERISTIC DFES_DTCM.DFC_EnhSRCMaxT2ExhTMon_C "DFES/Hersteller spezifischer Fehlercode für Prüfung DFC_EnhSRCMaxT2ExhTMon" VALUE 0x80026A04 Val_Wu16 65535.00 DFES_OneToOne 0.00 65535.00 /end CHARACTERISTIC
/begin CHARACTERISTIC DFES_DTCM.DFC_EnhSRCMaxT3ExhTMon_C "DFES/Hersteller spezifischer Fehlercode für Prüfung DFC_EnhSRCMaxT3ExhTMon" VALUE 0x80026A06 Val_Wu16 65535.00 DFES_OneToOne 0.00 65535.00 /end CHARACTERISTIC
/begin CHARACTERISTIC DFES_DTCM.DFC_EnhSRCMinPPFltDiff_C "DFES/Hersteller spezifischer Fehlercode für Prüfung DFC_EnhSRCMinPPFltDiff" VALUE 0x80026A08 Val_Wu16 65535.00 DFES_OneToOne 0.00 65535.00 /end CHARACTERISTIC
/begin CHARACTERISTIC DFES_DTCM.DFC_EnhSRCMinT1ExhTMon_C "DFES/Hersteller spezifischer Fehlercode für Prüfung DFC_EnhSRCMinT1ExhTMon" VALUE 0x80026A0A Val_Wu16 65535.00 DFES_OneToOne 0.00 65535.00 /end CHARACTERISTIC
/begin CHARACTERISTIC DFES_DTCM.DFC_EnhSRCMinT2ExhTMon_C "DFES/Hersteller spezifischer Fehlercode für Prüfung DFC_EnhSRCMinT2ExhTMon" VALUE 0x80026A0C Val_Wu16 65535.00 DFES_OneToOne 0.00 65535.00 /end CHARACTERISTIC
/begin CHARACTERISTIC DFES_DTCM.DFC_EnhSRCMinT3ExhTMon_C "DFES/Hersteller spezifischer Fehlercode für Prüfung DFC_EnhSRCMinT3ExhTMon" VALUE 0x80026A0E Val_Wu16 65535.00 DFES_OneToOne 0.00 65535.00 /end CHARACTERISTIC
/begin CHARACTERISTIC DFES_DTCM.DFC_EnvPSRCMax_C "DFES/Hersteller spezifischer Fehlercode für Prüfung DFC_EnvPSRCMax" VALUE 0x80026A10 Val_Wu16 65535.00 DFES_OneToOne 0.00 65535.00 /end CHARACTERISTIC
/begin CHARACTERISTIC DFES_DTCM.DFC_EnvPSRCMin_C "DFES/Hersteller spezifischer Fehlercode für Prüfung DFC_EnvPSRCMin" VALUE 0x80026A12 Val_Wu16 65535.00 DFES_OneToOne 0.00 65535.00 /end CHARACTERISTIC
/begin CHARACTERISTIC DFES_DTCM.DFC_ExhTMonPlaus_C "DFES/Hersteller spezifischer Fehlercode für Prüfung DFC_ExhTMonPlaus" VALUE 0x80026A14 Val_Wu16 65535.00 DFES_OneToOne 0.00 65535.00 /end CHARACTERISTIC
/begin CHARACTERISTIC DFES_DTCM.DFC_ExhTMonPlausPos1_C "DFES/Hersteller spezifischer Fehlercode für Prüfung DFC_ExhTMonPlausPos1" VALUE 0x80026A16 Val_Wu16 65535.00 DFES_OneToOne 0.00 65535.00 /end CHARACTERISTIC
/begin CHARACTERISTIC DFES_DTCM.DFC_ExhTMonPlausPos2_C "DFES/Hersteller spezifischer Fehlercode für Prüfung DFC_ExhTMonPlausPos2" VALUE 0x80026A18 Val_Wu16 65535.00 DFES_OneToOne 0.00 65535.00 /end CHARACTERISTIC
/begin CHARACTERISTIC DFES_DTCM.DFC_ExhTMonPlausPos3_C "DFES/Hersteller spezifischer Fehlercode für Prüfung DFC_ExhTMonPlausPos3" VALUE 0x80026A1A Val_Wu16 65535.00 DFES_OneToOne 0.00 65535.00 /end CHARACTERISTIC
/begin CHARACTERISTIC DFES_DTCM.DFC_ExhTMonT1Plaus_C "DFES/Hersteller spezifischer Fehlercode für Prüfung DFC_ExhTMonT1Plaus" VALUE 0x80026A1C Val_Wu16 65535.00 DFES_OneToOne 0.00 65535.00 /end CHARACTERISTIC
/begin CHARACTERISTIC DFES_DTCM.DFC_ExhTMonT2Plaus_C "DFES/Hersteller spezifischer Fehlercode für Prüfung DFC_ExhTMonT2Plaus" VALUE 0x80026A1E Val_Wu16 65535.00 DFES_OneToOne 0.00 65535.00 /end CHARACTERISTIC
/begin CHARACTERISTIC DFES_DTCM.DFC_ExhTMonT3Plaus_C "DFES/Hersteller spezifischer Fehlercode für Prüfung DFC_ExhTMonT3Plaus" VALUE 0x80026A20 Val_Wu16 65535.00 DFES_OneToOne 0.00 65535.00 /end CHARACTERISTIC
/begin CHARACTERISTIC DFES_DTCM.DFC_FlFltDsPSRCMax_C "DFES/Hersteller spezifischer Fehlercode für Prüfung DFC_FlFltDsPSRCMax" VALUE 0x80026A22 Val_Wu16 65535.00 DFES_OneToOne 0.00 65535.00 /end CHARACTERISTIC
/begin CHARACTERISTIC DFES_DTCM.DFC_FlFltDsPSRCMin_C "DFES/Hersteller spezifischer Fehlercode für Prüfung DFC_FlFltDsPSRCMin" VALUE 0x80026A24 Val_Wu16 65535.00 DFES_OneToOne 0.00 65535.00 /end CHARACTERISTIC
/begin CHARACTERISTIC DFES_DTCM.DFC_FlFltSig_C "DFES/Hersteller spezifischer Fehlercode für Prüfung DFC_FlFltSig" VALUE 0x80026A26 Val_Wu16 65535.00 DFES_OneToOne 0.00 65535.00 /end CHARACTERISTIC
/begin CHARACTERISTIC DFES_DTCM.DFC_FlFltUsPSRCMax_C "DFES/Hersteller spezifischer Fehlercode für Prüfung DFC_FlFltUsPSRCMax" VALUE 0x80026A28 Val_Wu16 65535.00 DFES_OneToOne 0.00 65535.00 /end CHARACTERISTIC
/begin CHARACTERISTIC DFES_DTCM.DFC_FlFltUsPSRCMin_C "DFES/Hersteller spezifischer Fehlercode für Prüfung DFC_FlFltUsPSRCMin" VALUE 0x80026A2A Val_Wu16 65535.00 DFES_OneToOne 0.00 65535.00 /end CHARACTERISTIC
/begin CHARACTERISTIC DFES_DTCM.DFC_FuelTSRCMax_C "DFES/Hersteller spezifischer Fehlercode für Prüfung DFC_FuelTSRCMax" VALUE 0x80026A2C Val_Wu16 65535.00 DFES_OneToOne 0.00 65535.00 /end CHARACTERISTIC
/begin CHARACTERISTIC DFES_DTCM.DFC_FuelTSRCMin_C "DFES/Hersteller spezifischer Fehlercode für Prüfung DFC_FuelTSRCMin" VALUE 0x80026A2E Val_Wu16 65535.00 DFES_OneToOne 0.00 65535.00 /end CHARACTERISTIC
/begin CHARACTERISTIC DFES_DTCM.DFC_GbxNPosPPerSRCMax_C "DFES/Hersteller spezifischer Fehlercode für Prüfung DFC_GbxNPosPPerSRCMax" VALUE 0x80026A30 Val_Wu16 65535.00 DFES_OneToOne 0.00 65535.00 /end CHARACTERISTIC
/begin CHARACTERISTIC DFES_DTCM.DFC_GbxNPosPPerSRCMin_C "DFES/Hersteller spezifischer Fehlercode für Prüfung DFC_GbxNPosPPerSRCMin" VALUE 0x80026A32 Val_Wu16 65535.00 DFES_OneToOne 0.00 65535.00 /end CHARACTERISTIC
/begin CHARACTERISTIC DFES_DTCM.DFC_GbxNPosPdcycSRCMax_C "DFES/Hersteller spezifischer Fehlercode für Prüfung DFC_GbxNPosPdcycSRCMax" VALUE 0x80026A34 Val_Wu16 65535.00 DFES_OneToOne 0.00 65535.00 /end CHARACTERISTIC
/begin CHARACTERISTIC DFES_DTCM.DFC_GbxNPosPdcycSRCMin_C "DFES/Hersteller spezifischer Fehlercode für Prüfung DFC_GbxNPosPdcycSRCMin" VALUE 0x80026A36 Val_Wu16 65535.00 DFES_OneToOne 0.00 65535.00 /end CHARACTERISTIC
/begin CHARACTERISTIC DFES_DTCM.DFC_InjVlvPresMin_C "DFES/Hersteller spezifischer Fehlercode für Prüfung DFC_InjVlvPresMin" VALUE 0x80026A38 Val_Wu16 65535.00 DFES_OneToOne 0.00 65535.00 /end CHARACTERISTIC
/begin CHARACTERISTIC DFES_DTCM.DFC_LSUCircNernstSig_C "DFES/Hersteller spezifischer Fehlercode für Prüfung DFC_LSUCircNernstSig" VALUE 0x80026A3A Val_Wu16 65535.00 DFES_OneToOne 0.00 65535.00 /end CHARACTERISTIC
/begin CHARACTERISTIC DFES_DTCM.DFC_LSUCircPmpCurSig_C "DFES/Hersteller spezifischer Fehlercode für Prüfung DFC_LSUCircPmpCurSig" VALUE 0x80026A3C Val_Wu16 65535.00 DFES_OneToOne 0.00 65535.00 /end CHARACTERISTIC
/begin CHARACTERISTIC DFES_DTCM.DFC_LSUCircVirtGndSig_C "DFES/Hersteller spezifischer Fehlercode für Prüfung DFC_LSUCircVirtGndSig" VALUE 0x80026A3E Val_Wu16 65535.00 DFES_OneToOne 0.00 65535.00 /end CHARACTERISTIC
/begin CHARACTERISTIC DFES_DTCM.DFC_LSUO2Max_C "DFES/Hersteller spezifischer Fehlercode für Prüfung DFC_LSUO2Max" VALUE 0x80026A40 Val_Wu16 65535.00 DFES_OneToOne 0.00 65535.00 /end CHARACTERISTIC
/begin CHARACTERISTIC DFES_DTCM.DFC_LSUO2Min_C "DFES/Hersteller spezifischer Fehlercode für Prüfung DFC_LSUO2Min" VALUE 0x80026A42 Val_Wu16 65535.00 DFES_OneToOne 0.00 65535.00 /end CHARACTERISTIC
/begin CHARACTERISTIC DFES_DTCM.DFC_LSUSPIBattLowMin_C "DFES/Hersteller spezifischer Fehlercode für Prüfung DFC_LSUSPIBattLowMin" VALUE 0x80026A44 Val_Wu16 65535.00 DFES_OneToOne 0.00 65535.00 /end CHARACTERISTIC
/begin CHARACTERISTIC DFES_DTCM.DFC_LSUWireSCB_C "DFES/Hersteller spezifischer Fehlercode für Prüfung DFC_LSUWireSCB" VALUE 0x80026A46 Val_Wu16 65535.00 DFES_OneToOne 0.00 65535.00 /end CHARACTERISTIC
/begin CHARACTERISTIC DFES_DTCM.DFC_LSUWireSCG_C "DFES/Hersteller spezifischer Fehlercode für Prüfung DFC_LSUWireSCG" VALUE 0x80026A48 Val_Wu16 65535.00 DFES_OneToOne 0.00 65535.00 /end CHARACTERISTIC
/begin CHARACTERISTIC DFES_DTCM.DFC_MeUnSCG_C "DFES/Hersteller spezifischer Fehlercode für Prüfung DFC_MeUnSCG" VALUE 0x80026A4A Val_Wu16 65535.00 DFES_OneToOne 0.00 65535.00 /end CHARACTERISTIC
/begin CHARACTERISTIC DFES_DTCM.DFC_NSCDsCmpChk_C "DFES/Hersteller spezifischer Fehlercode für Prüfung DFC_NSCDsCmpChk" VALUE 0x80026A4C Val_Wu16 65535.00 DFES_OneToOne 0.00 65535.00 /end CHARACTERISTIC
/begin CHARACTERISTIC DFES_DTCM.DFC_NSCDsLamBinSRCMax_C "DFES/Hersteller spezifischer Fehlercode für Prüfung DFC_NSCDsLamBinSRCMax" VALUE 0x80026A4E Val_Wu16 65535.00 DFES_OneToOne 0.00 65535.00 /end CHARACTERISTIC
/begin CHARACTERISTIC DFES_DTCM.DFC_NSCDsLamBinSRCMin_C "DFES/Hersteller spezifischer Fehlercode für Prüfung DFC_NSCDsLamBinSRCMin" VALUE 0x80026A50 Val_Wu16 65535.00 DFES_OneToOne 0.00 65535.00 /end CHARACTERISTIC
/begin CHARACTERISTIC DFES_DTCM.DFC_NSCDsLamLinSRCMax_C "DFES/Hersteller spezifischer Fehlercode für Prüfung DFC_NSCDsLamLinSRCMax" VALUE 0x80026A52 Val_Wu16 65535.00 DFES_OneToOne 0.00 65535.00 /end CHARACTERISTIC
/begin CHARACTERISTIC DFES_DTCM.DFC_NSCDsLamLinSRCMin_C "DFES/Hersteller spezifischer Fehlercode für Prüfung DFC_NSCDsLamLinSRCMin" VALUE 0x80026A54 Val_Wu16 65535.00 DFES_OneToOne 0.00 65535.00 /end CHARACTERISTIC
/begin CHARACTERISTIC DFES_DTCM.DFC_NSCDsLamPlausMax_C "DFES/Hersteller spezifischer Fehlercode für Prüfung DFC_NSCDsLamPlausMax" VALUE 0x80026A56 Val_Wu16 65535.00 DFES_OneToOne 0.00 65535.00 /end CHARACTERISTIC
/begin CHARACTERISTIC DFES_DTCM.DFC_NSCDsLamPlausMin_C "DFES/Hersteller spezifischer Fehlercode für Prüfung DFC_NSCDsLamPlausMin" VALUE 0x80026A58 Val_Wu16 65535.00 DFES_OneToOne 0.00 65535.00 /end CHARACTERISTIC
/begin CHARACTERISTIC DFES_DTCM.DFC_NSCDsNOxSRCMax_C "DFES/Hersteller spezifischer Fehlercode für Prüfung DFC_NSCDsNOxSRCMax" VALUE 0x80026A5A Val_Wu16 65535.00 DFES_OneToOne 0.00 65535.00 /end CHARACTERISTIC
/begin CHARACTERISTIC DFES_DTCM.DFC_NSCDsNOxSRCMin_C "DFES/Hersteller spezifischer Fehlercode für Prüfung DFC_NSCDsNOxSRCMin" VALUE 0x80026A5C Val_Wu16 65535.00 DFES_OneToOne 0.00 65535.00 /end CHARACTERISTIC
/begin CHARACTERISTIC DFES_DTCM.DFC_NSCDsOpCir_C "DFES/Hersteller spezifischer Fehlercode für Prüfung DFC_NSCDsOpCir" VALUE 0x80026A5E Val_Wu16 65535.00 DFES_OneToOne 0.00 65535.00 /end CHARACTERISTIC
/begin CHARACTERISTIC DFES_DTCM.DFC_NSCDsShCir_C "DFES/Hersteller spezifischer Fehlercode für Prüfung DFC_NSCDsShCir" VALUE 0x80026A60 Val_Wu16 65535.00 DFES_OneToOne 0.00 65535.00 /end CHARACTERISTIC
/begin CHARACTERISTIC DFES_DTCM.DFC_NoCat2DsCmpChk_C "DFES/Hersteller spezifischer Fehlercode für Prüfung DFC_NoCat2DsCmpChk" VALUE 0x80026A62 Val_Wu16 65535.00 DFES_OneToOne 0.00 65535.00 /end CHARACTERISTIC
/begin CHARACTERISTIC DFES_DTCM.DFC_NoCat2DsLamBinSRCMax_C "DFES/Hersteller spezifischer Fehlercode für Prüfung DFC_NoCat2DsLamBinSRCMax" VALUE 0x80026A64 Val_Wu16 65535.00 DFES_OneToOne 0.00 65535.00 /end CHARACTERISTIC
/begin CHARACTERISTIC DFES_DTCM.DFC_NoCat2DsLamBinSRCMin_C "DFES/Hersteller spezifischer Fehlercode für Prüfung DFC_NoCat2DsLamBinSRCMin" VALUE 0x80026A66 Val_Wu16 65535.00 DFES_OneToOne 0.00 65535.00 /end CHARACTERISTIC
/begin CHARACTERISTIC DFES_DTCM.DFC_NoCat2DsLamLinSRCMax_C "DFES/Hersteller spezifischer Fehlercode für Prüfung DFC_NoCat2DsLamLinSRCMax" VALUE 0x80026A68 Val_Wu16 65535.00 DFES_OneToOne 0.00 65535.00 /end CHARACTERISTIC
/begin CHARACTERISTIC DFES_DTCM.DFC_NoCat2DsLamLinSRCMin_C "DFES/Hersteller spezifischer Fehlercode für Prüfung DFC_NoCat2DsLamLinSRCMin" VALUE 0x80026A6A Val_Wu16 65535.00 DFES_OneToOne 0.00 65535.00 /end CHARACTERISTIC
/begin CHARACTERISTIC DFES_DTCM.DFC_NoCat2DsLamPlausMax_C "DFES/Hersteller spezifischer Fehlercode für Prüfung DFC_NoCat2DsLamPlausMax" VALUE 0x80026A6C Val_Wu16 65535.00 DFES_OneToOne 0.00 65535.00 /end CHARACTERISTIC
/begin CHARACTERISTIC DFES_DTCM.DFC_NoCat2DsLamPlausMin_C "DFES/Hersteller spezifischer Fehlercode für Prüfung DFC_NoCat2DsLamPlausMin" VALUE 0x80026A6E Val_Wu16 65535.00 DFES_OneToOne 0.00 65535.00 /end CHARACTERISTIC
/begin CHARACTERISTIC DFES_DTCM.DFC_NoCat2DsNOxSRCMax_C "DFES/Hersteller spezifischer Fehlercode für Prüfung DFC_NoCat2DsNOxSRCMax" VALUE 0x80026A70 Val_Wu16 65535.00 DFES_OneToOne 0.00 65535.00 /end CHARACTERISTIC
/begin CHARACTERISTIC DFES_DTCM.DFC_NoCat2DsNOxSRCMin_C "DFES/Hersteller spezifischer Fehlercode für Prüfung DFC_NoCat2DsNOxSRCMin" VALUE 0x80026A72 Val_Wu16 65535.00 DFES_OneToOne 0.00 65535.00 /end CHARACTERISTIC
/begin CHARACTERISTIC DFES_DTCM.DFC_NoCat2DsOpCir_C "DFES/Hersteller spezifischer Fehlercode für Prüfung DFC_NoCat2DsOpCir" VALUE 0x80026A74 Val_Wu16 65535.00 DFES_OneToOne 0.00 65535.00 /end CHARACTERISTIC
/begin CHARACTERISTIC DFES_DTCM.DFC_NoCat2DsShCir_C "DFES/Hersteller spezifischer Fehlercode für Prüfung DFC_NoCat2DsShCir" VALUE 0x80026A76 Val_Wu16 65535.00 DFES_OneToOne 0.00 65535.00 /end CHARACTERISTIC
/begin CHARACTERISTIC DFES_DTCM.DFC_NplDynPPFltDiff_C "DFES/Hersteller spezifischer Fehlercode für Prüfung DFC_NplDynPPFltDiff" VALUE 0x80026A78 Val_Wu16 65535.00 DFES_OneToOne 0.00 65535.00 /end CHARACTERISTIC
/begin CHARACTERISTIC DFES_DTCM.DFC_NplHsChngPPFltDiff_C "DFES/Hersteller spezifischer Fehlercode für Prüfung DFC_NplHsChngPPFltDiff" VALUE 0x80026A7A Val_Wu16 65535.00 DFES_OneToOne 0.00 65535.00 /end CHARACTERISTIC
/begin CHARACTERISTIC DFES_DTCM.DFC_NplHsLnPPFltDiff_C "DFES/Hersteller spezifischer Fehlercode für Prüfung DFC_NplHsLnPPFltDiff" VALUE 0x80026A7C Val_Wu16 65535.00 DFES_OneToOne 0.00 65535.00 /end CHARACTERISTIC
/begin CHARACTERISTIC DFES_DTCM.DFC_NplTOxiCatUs_C "DFES/Hersteller spezifischer Fehlercode für Prüfung DFC_NplTOxiCatUs" VALUE 0x80026A7E Val_Wu16 65535.00 DFES_OneToOne 0.00 65535.00 /end CHARACTERISTIC
/begin CHARACTERISTIC DFES_DTCM.DFC_NplTPFltUs_C "DFES/Hersteller spezifischer Fehlercode für Prüfung DFC_NplTPFltUs" VALUE 0x80026A80 Val_Wu16 65535.00 DFES_OneToOne 0.00 65535.00 /end CHARACTERISTIC
/begin CHARACTERISTIC DFES_DTCM.DFC_NplTTrbnUs_C "DFES/Hersteller spezifischer Fehlercode für Prüfung DFC_NplTTrbnUs" VALUE 0x80026A82 Val_Wu16 65535.00 DFES_OneToOne 0.00 65535.00 /end CHARACTERISTIC
/begin CHARACTERISTIC DFES_DTCM.DFC_OilPSwmpSRCMax_C "DFES/Hersteller spezifischer Fehlercode für Prüfung DFC_OilPSwmpSRCMax" VALUE 0x80026A84 Val_Wu16 65535.00 DFES_OneToOne 0.00 65535.00 /end CHARACTERISTIC
/begin CHARACTERISTIC DFES_DTCM.DFC_OilPSwmpSRCMin_C "DFES/Hersteller spezifischer Fehlercode für Prüfung DFC_OilPSwmpSRCMin" VALUE 0x80026A86 Val_Wu16 65535.00 DFES_OneToOne 0.00 65535.00 /end CHARACTERISTIC
/begin CHARACTERISTIC DFES_DTCM.DFC_PCVSCG_C "DFES/Hersteller spezifischer Fehlercode für Prüfung DFC_PCVSCG" VALUE 0x80026A88 Val_Wu16 65535.00 DFES_OneToOne 0.00 65535.00 /end CHARACTERISTIC
/begin CHARACTERISTIC DFES_DTCM.DFC_PFltCharPDiffMin_C "DFES/Hersteller spezifischer Fehlercode für Prüfung DFC_PFltCharPDiffMin" VALUE 0x80026A8A Val_Wu16 65535.00 DFES_OneToOne 0.00 65535.00 /end CHARACTERISTIC
/begin CHARACTERISTIC DFES_DTCM.DFC_PFltDstrMin_C "DFES/Hersteller spezifischer Fehlercode für Prüfung DFC_PFltDstrMin" VALUE 0x80026A8C Val_Wu16 65535.00 DFES_OneToOne 0.00 65535.00 /end CHARACTERISTIC
/begin CHARACTERISTIC DFES_DTCM.DFC_PFltEngPrt_C "DFES/Hersteller spezifischer Fehlercode für Prüfung DFC_PFltEngPrt" VALUE 0x80026A8E Val_Wu16 65535.00 DFES_OneToOne 0.00 65535.00 /end CHARACTERISTIC
/begin CHARACTERISTIC DFES_DTCM.DFC_PFltRgnPerm_C "DFES/Hersteller spezifischer Fehlercode für Prüfung DFC_PFltRgnPerm" VALUE 0x80026A90 Val_Wu16 65535.00 DFES_OneToOne 0.00 65535.00 /end CHARACTERISTIC
/begin CHARACTERISTIC DFES_DTCM.DFC_PFltSRCMaxFlwRstn_C "DFES/Hersteller spezifischer Fehlercode für Prüfung DFC_PFltSRCMaxFlwRstn" VALUE 0x80026A92 Val_Wu16 65535.00 DFES_OneToOne 0.00 65535.00 /end CHARACTERISTIC
/begin CHARACTERISTIC DFES_DTCM.DFC_PFltSRCMinFlwRstn_C "DFES/Hersteller spezifischer Fehlercode für Prüfung DFC_PFltSRCMinFlwRstn" VALUE 0x80026A94 Val_Wu16 65535.00 DFES_OneToOne 0.00 65535.00 /end CHARACTERISTIC
/begin CHARACTERISTIC DFES_DTCM.DFC_PFltSotMsDvtMax_C "DFES/Hersteller spezifischer Fehlercode für Prüfung DFC_PFltSotMsDvtMax" VALUE 0x80026A96 Val_Wu16 65535.00 DFES_OneToOne 0.00 65535.00 /end CHARACTERISTIC
/begin CHARACTERISTIC DFES_DTCM.DFC_PFltSotMsDvtMin_C "DFES/Hersteller spezifischer Fehlercode für Prüfung DFC_PFltSotMsDvtMin" VALUE 0x80026A98 Val_Wu16 65535.00 DFES_OneToOne 0.00 65535.00 /end CHARACTERISTIC
/begin CHARACTERISTIC DFES_DTCM.DFC_PFltSotMsMax_C "DFES/Hersteller spezifischer Fehlercode für Prüfung DFC_PFltSotMsMax" VALUE 0x80026A9A Val_Wu16 65535.00 DFES_OneToOne 0.00 65535.00 /end CHARACTERISTIC
/begin CHARACTERISTIC DFES_DTCM.DFC_PIntkVUsSRCMax_C "DFES/Hersteller spezifischer Fehlercode für Prüfung DFC_PIntkVUsSRCMax" VALUE 0x80026A9C Val_Wu16 65535.00 DFES_OneToOne 0.00 65535.00 /end CHARACTERISTIC
/begin CHARACTERISTIC DFES_DTCM.DFC_PIntkVUsSRCMin_C "DFES/Hersteller spezifischer Fehlercode für Prüfung DFC_PIntkVUsSRCMin" VALUE 0x80026A9E Val_Wu16 65535.00 DFES_OneToOne 0.00 65535.00 /end CHARACTERISTIC
/begin CHARACTERISTIC DFES_DTCM.DFC_SRCHighAPP1_C "DFES/Hersteller spezifischer Fehlercode für Prüfung DFC_SRCHighAPP1" VALUE 0x80026AA0 Val_Wu16 65535.00 DFES_OneToOne 0.00 65535.00 /end CHARACTERISTIC
/begin CHARACTERISTIC DFES_DTCM.DFC_SRCHighAPP2_C "DFES/Hersteller spezifischer Fehlercode für Prüfung DFC_SRCHighAPP2" VALUE 0x80026AA2 Val_Wu16 65535.00 DFES_OneToOne 0.00 65535.00 /end CHARACTERISTIC
/begin CHARACTERISTIC DFES_DTCM.DFC_SRCLowAPP1_C "DFES/Hersteller spezifischer Fehlercode für Prüfung DFC_SRCLowAPP1" VALUE 0x80026AA4 Val_Wu16 65535.00 DFES_OneToOne 0.00 65535.00 /end CHARACTERISTIC
/begin CHARACTERISTIC DFES_DTCM.DFC_SRCLowAPP2_C "DFES/Hersteller spezifischer Fehlercode für Prüfung DFC_SRCLowAPP2" VALUE 0x80026AA6 Val_Wu16 65535.00 DFES_OneToOne 0.00 65535.00 /end CHARACTERISTIC
/begin CHARACTERISTIC DFES_DTCM.DFC_SRCMaxPPFltDiff_C "DFES/Hersteller spezifischer Fehlercode für Prüfung DFC_SRCMaxPPFltDiff" VALUE 0x80026AA8 Val_Wu16 65535.00 DFES_OneToOne 0.00 65535.00 /end CHARACTERISTIC
/begin CHARACTERISTIC DFES_DTCM.DFC_SRCMaxPPFltUs_C "DFES/Hersteller spezifischer Fehlercode für Prüfung DFC_SRCMaxPPFltUs" VALUE 0x80026AAA Val_Wu16 65535.00 DFES_OneToOne 0.00 65535.00 /end CHARACTERISTIC
/begin CHARACTERISTIC DFES_DTCM.DFC_SRCMaxTECU_C "DFES/Hersteller spezifischer Fehlercode für Prüfung DFC_SRCMaxTECU" VALUE 0x80026AAC Val_Wu16 65535.00 DFES_OneToOne 0.00 65535.00 /end CHARACTERISTIC
/begin CHARACTERISTIC DFES_DTCM.DFC_SRCMaxTOxiCatUs_C "DFES/Hersteller spezifischer Fehlercode für Prüfung DFC_SRCMaxTOxiCatUs" VALUE 0x80026AAE Val_Wu16 65535.00 DFES_OneToOne 0.00 65535.00 /end CHARACTERISTIC
/begin CHARACTERISTIC DFES_DTCM.DFC_SRCMaxTPFltUs_C "DFES/Hersteller spezifischer Fehlercode für Prüfung DFC_SRCMaxTPFltUs" VALUE 0x80026AB0 Val_Wu16 65535.00 DFES_OneToOne 0.00 65535.00 /end CHARACTERISTIC
/begin CHARACTERISTIC DFES_DTCM.DFC_SRCMaxTTrbnUs_C "DFES/Hersteller spezifischer Fehlercode für Prüfung DFC_SRCMaxTTrbnUs" VALUE 0x80026AB2 Val_Wu16 65535.00 DFES_OneToOne 0.00 65535.00 /end CHARACTERISTIC
/begin CHARACTERISTIC DFES_DTCM.DFC_SRCMaxUCatUsT_C "DFES/Hersteller spezifischer Fehlercode für Prüfung DFC_SRCMaxUCatUsT" VALUE 0x80026AB4 Val_Wu16 65535.00 DFES_OneToOne 0.00 65535.00 /end CHARACTERISTIC
/begin CHARACTERISTIC DFES_DTCM.DFC_SRCMaxUPmpP_C "DFES/Hersteller spezifischer Fehlercode für Prüfung DFC_SRCMaxUPmpP" VALUE 0x80026AB6 Val_Wu16 65535.00 DFES_OneToOne 0.00 65535.00 /end CHARACTERISTIC
/begin CHARACTERISTIC DFES_DTCM.DFC_SRCMinPPFltDiff_C "DFES/Hersteller spezifischer Fehlercode für Prüfung DFC_SRCMinPPFltDiff" VALUE 0x80026AB8 Val_Wu16 65535.00 DFES_OneToOne 0.00 65535.00 /end CHARACTERISTIC
/begin CHARACTERISTIC DFES_DTCM.DFC_SRCMinPPFltUs_C "DFES/Hersteller spezifischer Fehlercode für Prüfung DFC_SRCMinPPFltUs" VALUE 0x80026ABA Val_Wu16 65535.00 DFES_OneToOne 0.00 65535.00 /end CHARACTERISTIC
/begin CHARACTERISTIC DFES_DTCM.DFC_SRCMinTECU_C "DFES/Hersteller spezifischer Fehlercode für Prüfung DFC_SRCMinTECU" VALUE 0x80026ABC Val_Wu16 65535.00 DFES_OneToOne 0.00 65535.00 /end CHARACTERISTIC
/begin CHARACTERISTIC DFES_DTCM.DFC_SRCMinTOxiCatUs_C "DFES/Hersteller spezifischer Fehlercode für Prüfung DFC_SRCMinTOxiCatUs" VALUE 0x80026ABE Val_Wu16 65535.00 DFES_OneToOne 0.00 65535.00 /end CHARACTERISTIC
/begin CHARACTERISTIC DFES_DTCM.DFC_SRCMinTPFltUs_C "DFES/Hersteller spezifischer Fehlercode für Prüfung DFC_SRCMinTPFltUs" VALUE 0x80026AC0 Val_Wu16 65535.00 DFES_OneToOne 0.00 65535.00 /end CHARACTERISTIC
/begin CHARACTERISTIC DFES_DTCM.DFC_SRCMinTTrbnUs_C "DFES/Hersteller spezifischer Fehlercode für Prüfung DFC_SRCMinTTrbnUs" VALUE 0x80026AC2 Val_Wu16 65535.00 DFES_OneToOne 0.00 65535.00 /end CHARACTERISTIC
/begin CHARACTERISTIC DFES_DTCM.DFC_SRCMinUCatUsT_C "DFES/Hersteller spezifischer Fehlercode für Prüfung DFC_SRCMinUCatUsT" VALUE 0x80026AC4 Val_Wu16 65535.00 DFES_OneToOne 0.00 65535.00 /end CHARACTERISTIC
/begin CHARACTERISTIC DFES_DTCM.DFC_SRCMinUPmpP_C "DFES/Hersteller spezifischer Fehlercode für Prüfung DFC_SRCMinUPmpP" VALUE 0x80026AC6 Val_Wu16 65535.00 DFES_OneToOne 0.00 65535.00 /end CHARACTERISTIC
/begin CHARACTERISTIC DFES_DTCM.DFC_SigUCatUsT_C "DFES/Hersteller spezifischer Fehlercode für Prüfung DFC_SigUCatUsT" VALUE 0x80026AC8 Val_Wu16 65535.00 DFES_OneToOne 0.00 65535.00 /end CHARACTERISTIC
/begin CHARACTERISTIC DFES_DTCM.DFC_SigUPmpP_C "DFES/Hersteller spezifischer Fehlercode für Prüfung DFC_SigUPmpP" VALUE 0x80026ACA Val_Wu16 65535.00 DFES_OneToOne 0.00 65535.00 /end CHARACTERISTIC
/begin CHARACTERISTIC DFES_DTCM.DFC_SyncAPP_C "DFES/Hersteller spezifischer Fehlercode für Prüfung DFC_SyncAPP" VALUE 0x80026ACC Val_Wu16 65535.00 DFES_OneToOne 0.00 65535.00 /end CHARACTERISTIC
/begin CHARACTERISTIC DFES_DTCM.DFC_T15Npl_C "DFES/Hersteller spezifischer Fehlercode für Prüfung DFC_T15Npl" VALUE 0x80026ACE Val_Wu16 65535.00 DFES_OneToOne 0.00 65535.00 /end CHARACTERISTIC
/begin CHARACTERISTIC DFES_DTCM.DFC_TAFSDtyCycHi_C "DFES/Hersteller spezifischer Fehlercode für Prüfung DFC_TAFSDtyCycHi" VALUE 0x80026AD0 Val_Wu16 65535.00 DFES_OneToOne 0.00 65535.00 /end CHARACTERISTIC
/begin CHARACTERISTIC DFES_DTCM.DFC_TAFSDtyCycLo_C "DFES/Hersteller spezifischer Fehlercode für Prüfung DFC_TAFSDtyCycLo" VALUE 0x80026AD2 Val_Wu16 65535.00 DFES_OneToOne 0.00 65535.00 /end CHARACTERISTIC
/begin CHARACTERISTIC DFES_DTCM.DFC_TAFSPerHi_C "DFES/Hersteller spezifischer Fehlercode für Prüfung DFC_TAFSPerHi" VALUE 0x80026AD4 Val_Wu16 65535.00 DFES_OneToOne 0.00 65535.00 /end CHARACTERISTIC
/begin CHARACTERISTIC DFES_DTCM.DFC_TAFSPerLo_C "DFES/Hersteller spezifischer Fehlercode für Prüfung DFC_TAFSPerLo" VALUE 0x80026AD6 Val_Wu16 65535.00 DFES_OneToOne 0.00 65535.00 /end CHARACTERISTIC
/begin CHARACTERISTIC DFES_DTCM.DFC_TCACDsSRCMax_C "DFES/Hersteller spezifischer Fehlercode für Prüfung DFC_TCACDsSRCMax" VALUE 0x80026AD8 Val_Wu16 65535.00 DFES_OneToOne 0.00 65535.00 /end CHARACTERISTIC
/begin CHARACTERISTIC DFES_DTCM.DFC_TCACDsSRCMin_C "DFES/Hersteller spezifischer Fehlercode für Prüfung DFC_TCACDsSRCMin" VALUE 0x80026ADA Val_Wu16 65535.00 DFES_OneToOne 0.00 65535.00 /end CHARACTERISTIC
/begin CHARACTERISTIC DFES_DTCM.DFC_ThrVlvSRCMax_C "DFES/Hersteller spezifischer Fehlercode für Prüfung DFC_ThrVlvSRCMax" VALUE 0x80026ADC Val_Wu16 65535.00 DFES_OneToOne 0.00 65535.00 /end CHARACTERISTIC
/begin CHARACTERISTIC DFES_DTCM.DFC_ThrVlvSRCMin_C "DFES/Hersteller spezifischer Fehlercode für Prüfung DFC_ThrVlvSRCMin" VALUE 0x80026ADE Val_Wu16 65535.00 DFES_OneToOne 0.00 65535.00 /end CHARACTERISTIC
/begin CHARACTERISTIC DFES_DTCM.DFC_TrbChLPOL_C "DFES/Hersteller spezifischer Fehlercode für Prüfung DFC_TrbChLPOL" VALUE 0x80026AE0 Val_Wu16 65535.00 DFES_OneToOne 0.00 65535.00 /end CHARACTERISTIC
/begin CHARACTERISTIC DFES_DTCM.DFC_TrbChLPSCB_C "DFES/Hersteller spezifischer Fehlercode für Prüfung DFC_TrbChLPSCB" VALUE 0x80026AE2 Val_Wu16 65535.00 DFES_OneToOne 0.00 65535.00 /end CHARACTERISTIC
/begin CHARACTERISTIC DFES_DTCM.DFC_TrbChLPSCG_C "DFES/Hersteller spezifischer Fehlercode für Prüfung DFC_TrbChLPSCG" VALUE 0x80026AE4 Val_Wu16 65535.00 DFES_OneToOne 0.00 65535.00 /end CHARACTERISTIC
/begin CHARACTERISTIC DFES_DTCM.DFC_UHtrPLOL_C "DFES/Hersteller spezifischer Fehlercode für Prüfung DFC_UHtrPLOL" VALUE 0x80026AE6 Val_Wu16 65535.00 DFES_OneToOne 0.00 65535.00 /end CHARACTERISTIC
/begin CHARACTERISTIC DFES_DTCM.DFC_UHtrPLSCB_C "DFES/Hersteller spezifischer Fehlercode für Prüfung DFC_UHtrPLSCB" VALUE 0x80026AE8 Val_Wu16 65535.00 DFES_OneToOne 0.00 65535.00 /end CHARACTERISTIC
/begin CHARACTERISTIC DFES_DTCM.DFC_UHtrPLSCG_C "DFES/Hersteller spezifischer Fehlercode für Prüfung DFC_UHtrPLSCG" VALUE 0x80026AEA Val_Wu16 65535.00 DFES_OneToOne 0.00 65535.00 /end CHARACTERISTIC
/begin CHARACTERISTIC DFES_DTCM.DFC_UHtrPLSRCMaxDia_C "DFES/Hersteller spezifischer Fehlercode für Prüfung DFC_UHtrPLSRCMaxDia" VALUE 0x80026AEC Val_Wu16 65535.00 DFES_OneToOne 0.00 65535.00 /end CHARACTERISTIC
/begin CHARACTERISTIC DFES_DTCM.DFC_UHtrPLSRCMinDia_C "DFES/Hersteller spezifischer Fehlercode für Prüfung DFC_UHtrPLSRCMinDia" VALUE 0x80026AEE Val_Wu16 65535.00 DFES_OneToOne 0.00 65535.00 /end CHARACTERISTIC
/begin CHARACTERISTIC DFES_DTCM.DFC_UHtrTnkOL_C "DFES/Hersteller spezifischer Fehlercode für Prüfung DFC_UHtrTnkOL" VALUE 0x80026AF0 Val_Wu16 65535.00 DFES_OneToOne 0.00 65535.00 /end CHARACTERISTIC
/begin CHARACTERISTIC DFES_DTCM.DFC_UHtrTnkSCB_C "DFES/Hersteller spezifischer Fehlercode für Prüfung DFC_UHtrTnkSCB" VALUE 0x80026AF2 Val_Wu16 65535.00 DFES_OneToOne 0.00 65535.00 /end CHARACTERISTIC
/begin CHARACTERISTIC DFES_DTCM.DFC_UHtrTnkSCG_C "DFES/Hersteller spezifischer Fehlercode für Prüfung DFC_UHtrTnkSCG" VALUE 0x80026AF4 Val_Wu16 65535.00 DFES_OneToOne 0.00 65535.00 /end CHARACTERISTIC
/begin CHARACTERISTIC DFES_DTCM.DFC_UHtrTnkSRCMaxDia_C "DFES/Hersteller spezifischer Fehlercode für Prüfung DFC_UHtrTnkSRCMaxDia" VALUE 0x80026AF6 Val_Wu16 65535.00 DFES_OneToOne 0.00 65535.00 /end CHARACTERISTIC
/begin CHARACTERISTIC DFES_DTCM.DFC_UHtrTnkSRCMinDia_C "DFES/Hersteller spezifischer Fehlercode für Prüfung DFC_UHtrTnkSRCMinDia" VALUE 0x80026AF8 Val_Wu16 65535.00 DFES_OneToOne 0.00 65535.00 /end CHARACTERISTIC
/begin CHARACTERISTIC DFES_DTCM.DFC_URevVlvOL_C "DFES/Hersteller spezifischer Fehlercode für Prüfung DFC_URevVlvOL" VALUE 0x80026AFA Val_Wu16 65535.00 DFES_OneToOne 0.00 65535.00 /end CHARACTERISTIC
/begin CHARACTERISTIC DFES_DTCM.DFC_URevVlvSCB_C "DFES/Hersteller spezifischer Fehlercode für Prüfung DFC_URevVlvSCB" VALUE 0x80026AFC Val_Wu16 65535.00 DFES_OneToOne 0.00 65535.00 /end CHARACTERISTIC
/begin CHARACTERISTIC DFES_DTCM.DFC_URevVlvSCG_C "DFES/Hersteller spezifischer Fehlercode für Prüfung DFC_URevVlvSCG" VALUE 0x80026AFE Val_Wu16 65535.00 DFES_OneToOne 0.00 65535.00 /end CHARACTERISTIC
/begin CHARACTERISTIC DFES_DTCM.DFC_UTnkTSRCMax_C "DFES/Hersteller spezifischer Fehlercode für Prüfung DFC_UTnkTSRCMax" VALUE 0x80026B00 Val_Wu16 65535.00 DFES_OneToOne 0.00 65535.00 /end CHARACTERISTIC
/begin CHARACTERISTIC DFES_DTCM.DFC_UTnkTSRCMin_C "DFES/Hersteller spezifischer Fehlercode für Prüfung DFC_UTnkTSRCMin" VALUE 0x80026B02 Val_Wu16 65535.00 DFES_OneToOne 0.00 65535.00 /end CHARACTERISTIC
/begin CHARACTERISTIC DFES_DTCM.DFC_UTnkTSig_C "DFES/Hersteller spezifischer Fehlercode für Prüfung DFC_UTnkTSig" VALUE 0x80026B04 Val_Wu16 65535.00 DFES_OneToOne 0.00 65535.00 /end CHARACTERISTIC
/begin CHARACTERISTIC DFES_DTCM.DFC_VSwVlvGovDvtMax_C "DFES/Hersteller spezifischer Fehlercode für Prüfung DFC_VSwVlvGovDvtMax" VALUE 0x80026B06 Val_Wu16 65535.00 DFES_OneToOne 0.00 65535.00 /end CHARACTERISTIC
/begin CHARACTERISTIC DFES_DTCM.DFC_VSwVlvGovDvtMin_C "DFES/Hersteller spezifischer Fehlercode für Prüfung DFC_VSwVlvGovDvtMin" VALUE 0x80026B08 Val_Wu16 65535.00 DFES_OneToOne 0.00 65535.00 /end CHARACTERISTIC
/begin CHARACTERISTIC DFES_DTCM.DFC_VSwVlvHBrgOpnLd_C "DFES/Hersteller spezifischer Fehlercode für Prüfung DFC_VSwVlvHBrgOpnLd" VALUE 0x80026B0A Val_Wu16 65535.00 DFES_OneToOne 0.00 65535.00 /end CHARACTERISTIC
/begin CHARACTERISTIC DFES_DTCM.DFC_VSwVlvHBrgOvrCurr_C "DFES/Hersteller spezifischer Fehlercode für Prüfung DFC_VSwVlvHBrgOvrCurr" VALUE 0x80026B0C Val_Wu16 65535.00 DFES_OneToOne 0.00 65535.00 /end CHARACTERISTIC
/begin CHARACTERISTIC DFES_DTCM.DFC_VSwVlvHBrgOvrTemp_C "DFES/Hersteller spezifischer Fehlercode für Prüfung DFC_VSwVlvHBrgOvrTemp" VALUE 0x80026B0E Val_Wu16 65535.00 DFES_OneToOne 0.00 65535.00 /end CHARACTERISTIC
/begin CHARACTERISTIC DFES_DTCM.DFC_VSwVlvHBrgShCirBatt1_C "DFES/Hersteller spezifischer Fehlercode für Prüfung DFC_VSwVlvHBrgShCirBatt1" VALUE 0x80026B10 Val_Wu16 65535.00 DFES_OneToOne 0.00 65535.00 /end CHARACTERISTIC
/begin CHARACTERISTIC DFES_DTCM.DFC_VSwVlvHBrgShCirBatt2_C "DFES/Hersteller spezifischer Fehlercode für Prüfung DFC_VSwVlvHBrgShCirBatt2" VALUE 0x80026B12 Val_Wu16 65535.00 DFES_OneToOne 0.00 65535.00 /end CHARACTERISTIC
/begin CHARACTERISTIC DFES_DTCM.DFC_VSwVlvHBrgShCirGnd1_C "DFES/Hersteller spezifischer Fehlercode für Prüfung DFC_VSwVlvHBrgShCirGnd1" VALUE 0x80026B14 Val_Wu16 65535.00 DFES_OneToOne 0.00 65535.00 /end CHARACTERISTIC
/begin CHARACTERISTIC DFES_DTCM.DFC_VSwVlvHBrgShCirGnd2_C "DFES/Hersteller spezifischer Fehlercode für Prüfung DFC_VSwVlvHBrgShCirGnd2" VALUE 0x80026B16 Val_Wu16 65535.00 DFES_OneToOne 0.00 65535.00 /end CHARACTERISTIC
/begin CHARACTERISTIC DFES_DTCM.DFC_VSwVlvHBrgShCirOvrLd_C "DFES/Hersteller spezifischer Fehlercode für Prüfung DFC_VSwVlvHBrgShCirOvrLd" VALUE 0x80026B18 Val_Wu16 65535.00 DFES_OneToOne 0.00 65535.00 /end CHARACTERISTIC
/begin CHARACTERISTIC DFES_DTCM.DFC_VSwVlvHBrgTempOvrCurr_C "DFES/Hersteller spezifischer Fehlercode für Prüfung DFC_VSwVlvHBrgTempOvrCurr" VALUE 0x80026B1A Val_Wu16 65535.00 DFES_OneToOne 0.00 65535.00 /end CHARACTERISTIC
/begin CHARACTERISTIC DFES_DTCM.DFC_VSwVlvHBrgUndrVltg_C "DFES/Hersteller spezifischer Fehlercode für Prüfung DFC_VSwVlvHBrgUndrVltg" VALUE 0x80026B1C Val_Wu16 65535.00 DFES_OneToOne 0.00 65535.00 /end CHARACTERISTIC
/begin CHARACTERISTIC DFES_DTCM.DFC_VSwVlvOL_C "DFES/Hersteller spezifischer Fehlercode für Prüfung DFC_VSwVlvOL" VALUE 0x80026B1E Val_Wu16 65535.00 DFES_OneToOne 0.00 65535.00 /end CHARACTERISTIC
/begin CHARACTERISTIC DFES_DTCM.DFC_VSwVlvSCB_C "DFES/Hersteller spezifischer Fehlercode für Prüfung DFC_VSwVlvSCB" VALUE 0x80026B20 Val_Wu16 65535.00 DFES_OneToOne 0.00 65535.00 /end CHARACTERISTIC
/begin CHARACTERISTIC DFES_DTCM.DFC_VSwVlvSCG_C "DFES/Hersteller spezifischer Fehlercode für Prüfung DFC_VSwVlvSCG" VALUE 0x80026B22 Val_Wu16 65535.00 DFES_OneToOne 0.00 65535.00 /end CHARACTERISTIC
/begin CHARACTERISTIC DFES_DTCM.DFC_VSwVlvSRCMax_C "DFES/Hersteller spezifischer Fehlercode für Prüfung DFC_VSwVlvSRCMax" VALUE 0x80026B24 Val_Wu16 65535.00 DFES_OneToOne 0.00 65535.00 /end CHARACTERISTIC
/begin CHARACTERISTIC DFES_DTCM.DFC_VSwVlvSRCMin_C "DFES/Hersteller spezifischer Fehlercode für Prüfung DFC_VSwVlvSRCMin" VALUE 0x80026B26 Val_Wu16 65535.00 DFES_OneToOne 0.00 65535.00 /end CHARACTERISTIC
/begin CHARACTERISTIC DFES_DTCM.DFC_ClthNpl_C "DFES/Hersteller spezifischer Fehlercode für Prüfung DFC_ClthNpl" VALUE 0x80026B28 Val_Wu16 65535.00 DFES_OneToOne 0.00 65535.00 /end CHARACTERISTIC
/begin CHARACTERISTIC DFES_DTCM.DFC_ETClbETMax_0_C "DFES/Hersteller spezifischer Fehlercode für Prüfung DFC_ETClbETMax_0" VALUE 0x80026B2A Val_Wu16 65535.00 DFES_OneToOne 0.00 65535.00 /end CHARACTERISTIC
/begin CHARACTERISTIC DFES_DTCM.DFC_ETClbETMax_1_C "DFES/Hersteller spezifischer Fehlercode für Prüfung DFC_ETClbETMax_1" VALUE 0x80026B2C Val_Wu16 65535.00 DFES_OneToOne 0.00 65535.00 /end CHARACTERISTIC
/begin CHARACTERISTIC DFES_DTCM.DFC_ETClbETMax_2_C "DFES/Hersteller spezifischer Fehlercode für Prüfung DFC_ETClbETMax_2" VALUE 0x80026B2E Val_Wu16 65535.00 DFES_OneToOne 0.00 65535.00 /end CHARACTERISTIC
/begin CHARACTERISTIC DFES_DTCM.DFC_ETClbETMax_3_C "DFES/Hersteller spezifischer Fehlercode für Prüfung DFC_ETClbETMax_3" VALUE 0x80026B30 Val_Wu16 65535.00 DFES_OneToOne 0.00 65535.00 /end CHARACTERISTIC
/begin CHARACTERISTIC DFES_DTCM.DFC_ETClbETMax_4_C "DFES/Hersteller spezifischer Fehlercode für Prüfung DFC_ETClbETMax_4" VALUE 0x80026B32 Val_Wu16 65535.00 DFES_OneToOne 0.00 65535.00 /end CHARACTERISTIC
/begin CHARACTERISTIC DFES_DTCM.DFC_ETClbETMax_5_C "DFES/Hersteller spezifischer Fehlercode für Prüfung DFC_ETClbETMax_5" VALUE 0x80026B34 Val_Wu16 65535.00 DFES_OneToOne 0.00 65535.00 /end CHARACTERISTIC
/begin CHARACTERISTIC DFES_DTCM.DFC_ETClbETMin_0_C "DFES/Hersteller spezifischer Fehlercode für Prüfung DFC_ETClbETMin_0" VALUE 0x80026B36 Val_Wu16 65535.00 DFES_OneToOne 0.00 65535.00 /end CHARACTERISTIC
/begin CHARACTERISTIC DFES_DTCM.DFC_ETClbETMin_1_C "DFES/Hersteller spezifischer Fehlercode für Prüfung DFC_ETClbETMin_1" VALUE 0x80026B38 Val_Wu16 65535.00 DFES_OneToOne 0.00 65535.00 /end CHARACTERISTIC
/begin CHARACTERISTIC DFES_DTCM.DFC_ETClbETMin_2_C "DFES/Hersteller spezifischer Fehlercode für Prüfung DFC_ETClbETMin_2" VALUE 0x80026B3A Val_Wu16 65535.00 DFES_OneToOne 0.00 65535.00 /end CHARACTERISTIC
/begin CHARACTERISTIC DFES_DTCM.DFC_ETClbETMin_3_C "DFES/Hersteller spezifischer Fehlercode für Prüfung DFC_ETClbETMin_3" VALUE 0x80026B3C Val_Wu16 65535.00 DFES_OneToOne 0.00 65535.00 /end CHARACTERISTIC
/begin CHARACTERISTIC DFES_DTCM.DFC_ETClbETMin_4_C "DFES/Hersteller spezifischer Fehlercode für Prüfung DFC_ETClbETMin_4" VALUE 0x80026B3E Val_Wu16 65535.00 DFES_OneToOne 0.00 65535.00 /end CHARACTERISTIC
/begin CHARACTERISTIC DFES_DTCM.DFC_ETClbETMin_5_C "DFES/Hersteller spezifischer Fehlercode für Prüfung DFC_ETClbETMin_5" VALUE 0x80026B40 Val_Wu16 65535.00 DFES_OneToOne 0.00 65535.00 /end CHARACTERISTIC
/begin CHARACTERISTIC DFES_DTCM.DFC_IVActrEnrgMax_0_C "DFES/Hersteller spezifischer Fehlercode für Prüfung DFC_IVActrEnrgMax_0" VALUE 0x80026B42 Val_Wu16 65535.00 DFES_OneToOne 0.00 65535.00 /end CHARACTERISTIC
/begin CHARACTERISTIC DFES_DTCM.DFC_IVActrEnrgMax_1_C "DFES/Hersteller spezifischer Fehlercode für Prüfung DFC_IVActrEnrgMax_1" VALUE 0x80026B44 Val_Wu16 65535.00 DFES_OneToOne 0.00 65535.00 /end CHARACTERISTIC
/begin CHARACTERISTIC DFES_DTCM.DFC_IVActrEnrgMax_2_C "DFES/Hersteller spezifischer Fehlercode für Prüfung DFC_IVActrEnrgMax_2" VALUE 0x80026B46 Val_Wu16 65535.00 DFES_OneToOne 0.00 65535.00 /end CHARACTERISTIC
/begin CHARACTERISTIC DFES_DTCM.DFC_IVActrEnrgMax_3_C "DFES/Hersteller spezifischer Fehlercode für Prüfung DFC_IVActrEnrgMax_3" VALUE 0x80026B48 Val_Wu16 65535.00 DFES_OneToOne 0.00 65535.00 /end CHARACTERISTIC
/begin CHARACTERISTIC DFES_DTCM.DFC_IVActrEnrgMax_4_C "DFES/Hersteller spezifischer Fehlercode für Prüfung DFC_IVActrEnrgMax_4" VALUE 0x80026B4A Val_Wu16 65535.00 DFES_OneToOne 0.00 65535.00 /end CHARACTERISTIC
/begin CHARACTERISTIC DFES_DTCM.DFC_IVActrEnrgMax_5_C "DFES/Hersteller spezifischer Fehlercode für Prüfung DFC_IVActrEnrgMax_5" VALUE 0x80026B4C Val_Wu16 65535.00 DFES_OneToOne 0.00 65535.00 /end CHARACTERISTIC
/begin FUNCTION DFES ""
 /begin DEF_CHARACTERISTIC DFES_DbLv.DFC_Layer_PMBATTMax_C DFES_DbLv.DFC_Layer_PMBATTMin_C DFES_DbLv.DFC_Layer_PMBATTNpl_C DFES_DbLv.DFC_Layer_PMBATTSig_C DFES_DbLv.DFC_Layer_PMBNMax_C DFES_DbLv.DFC_Layer_PMBNMin_C DFES_DbLv.DFC_Layer_PMBNNpl_C DFES_DbLv.DFC_Layer_PMBNSig_C DFES_DbLv.DFC_Layer_PMRUHVERLMax_C DFES_DbLv.DFC_Layer_PMRUHVERLMin_C DFES_DbLv.DFC_Layer_PMRUHVERLNpl_C DFES_DbLv.DFC_Layer_PMRUHVERLSig_C DFES_DbLv.DFC_Layer_QLTMax_C DFES_DbLv.DFC_Layer_QLTMin_C DFES_DbLv.DFC_Layer_QLTNpl_C DFES_DbLv.DFC_Layer_QLTSig_C DFES_DbLv.DFC_Layer_TOENSMax_C DFES_DbLv.DFC_Layer_TOENSMin_C DFES_DbLv.DFC_Layer_TOENSNpl_C DFES_DbLv.DFC_Layer_TOENSSig_C DFES_DbLv.DFC_MonLimCurr_C DFES_DbLv.DFC_MonLimLead_C DFES_DbLv.DFC_MonLimSet_C DFES_DbLv.DFC_NSCDsNOxOfsMax_C DFES_DbLv.DFC_NSCDsNOxOfsMin_C DFES_DbLv.DFC_NSCDsNOxPlausMin_C DFES_DbLv.DFC_NoCat2DsNOxOfsMax_C DFES_DbLv.DFC_NoCat2DsNOxOfsMin_C DFES_DbLv.DFC_NoCat2DsNOxPlausMin_C DFES_DbLv.DFC_PCVNoStrt_C DFES_DbLv.DFC_RailPGradMon_C DFES_DbLv.DFC_SCRPODPresBuildUp_C DFES_DbLv.DFC_AFSDrftIdlAdjVal_C DFES_DbLv.DFC_AFSDrftLdAdjVal_C DFES_DbLv.DFC_AdcIADC0Cal_C DFES_DbLv.DFC_AdcIADC0Conv_C DFES_DbLv.DFC_AdcIADC1Cal_C DFES_DbLv.DFC_AdcIADC1Conv_C DFES_DbLv.DFC_CmbChbMisfireMax_0_C DFES_DbLv.DFC_CmbChbMisfireMax_1_C DFES_DbLv.DFC_CmbChbMisfireMax_2_C DFES_DbLv.DFC_CmbChbMisfireMax_3_C DFES_DbLv.DFC_CmbChbMisfireMax_4_C DFES_DbLv.DFC_CmbChbMisfireMax_5_C DFES_DbLv.DFC_CmbChbMisfireMul_C DFES_DbLv.DFC_EGRVlvLPOfsNeutr_C DFES_DbLv.DFC_EGRVlvOfsNeutr_C DFES_DbLv.DFC_FMAErrModMax_C DFES_DbLv.DFC_FMAErrModMin_C DFES_DbLv.DFC_FlSysTnkLo_C DFES_DbLv.DFC_GbxNPosPlaus_C DFES_DbLv.DFC_I14229_ROETst_Appl_C DFES_DbLv.DFC_I14229_ROETst_Netw_C DFES_DbLv.DFC_I14229_ROE_BufFull_C DFES_DbLv.DFC_IVAdjDiaIVAdj_C DFES_DbLv.DFC_IVAdjIVA_0_C DFES_DbLv.DFC_IVAdjIVA_1_C DFES_DbLv.DFC_IVAdjIVA_2_C DFES_DbLv.DFC_IVAdjIVA_3_C DFES_DbLv.DFC_IVAdjIVA_4_C DFES_DbLv.DFC_IVAdjIVA_5_C DFES_DbLv.DFC_IVPSplyDCDCOff_0_C DFES_DbLv.DFC_IVPSplyDCDCOff_1_C DFES_DbLv.DFC_IVPSplyDCDCOff_2_C DFES_DbLv.DFC_IVPSplyDCDCOff_3_C DFES_DbLv.DFC_InjCtlAdjQntEEPCS_C DFES_DbLv.DFC_LSUSPISig_C DFES_DbLv.DFC_Layer_Dummy_C DFES_DbLv.DFC_NplEnvPSensPPFltDiff_C DFES_DbLv.DFC_NplPresSensPPFltDiff_C DFES_DbLv.DFC_OilLvlPlaus_C DFES_DbLv.DFC_OilTOutLvl_C DFES_DbLv.DFC_PCVfacAdaptMax_C DFES_DbLv.DFC_PCVfacAdaptMin_C DFES_DbLv.DFC_SensFrzPPFltUs_C DFES_DbLv.DFC_SensMonUTnkLvl_C DFES_DbLv.DFC_T15Sig_C DFES_DbLv.DFC_AirCtlRmpTOut_C DFES_DbLv.DFC_BrkPPlaus_C DFES_DbLv.DFC_CEngDsTDynTst_C DFES_DbLv.DFC_EEPEraseErr_C DFES_DbLv.DFC_EEPRdErr_C DFES_DbLv.DFC_EEPWrErr_C DFES_DbLv.DFC_EGRVlvJamVlvClsd_C DFES_DbLv.DFC_EGRVlvJamVlvOpn_C DFES_DbLv.DFC_EGRVlvLPJamVlvClsd_C DFES_DbLv.DFC_EGRVlvLPJamVlvOpn_C DFES_DbLv.DFC_EGRVlvLPLgTDrft_C DFES_DbLv.DFC_EGRVlvLPOfsLrnJamVlv_C DFES_DbLv.DFC_EGRVlvLPShTDrft_C DFES_DbLv.DFC_EGRVlvLgTDrft_C DFES_DbLv.DFC_EGRVlvOfsLrnJamVlv_C DFES_DbLv.DFC_EGRVlvShTDrft_C DFES_DbLv.DFC_EngICO_C DFES_DbLv.DFC_EpmCaSI1ErrSig_C DFES_DbLv.DFC_EpmCaSI1NoSig_C DFES_DbLv.DFC_EpmCaSI1OfsErr_C DFES_DbLv.DFC_EpmCrSErrSig_C DFES_DbLv.DFC_EpmCrSNoSig_C DFES_DbLv.DFC_IVPlausComprTst_C DFES_DbLv.DFC_IVPlausRunUpTst_C DFES_DbLv.DFC_InjCrvShOffTst_C DFES_DbLv.DFC_LayerEnSavModProd_C DFES_DbLv.DFC_LayerEnSavModRep_C DFES_DbLv.DFC_LayerEnSavModShip_C DFES_DbLv.DFC_MRlyErlyOpng_C DFES_DbLv.DFC_MRlyStk_C DFES_DbLv.DFC_MeUnActrTst_C DFES_DbLv.DFC_MoCADCCmp_C DFES_DbLv.DFC_MoCADCTst_C DFES_DbLv.DFC_MoCADCVltgRatio_C DFES_DbLv.DFC_MoCComErrCnt_C DFES_DbLv.DFC_MoCComSPI_C DFES_DbLv.DFC_MoCROMErrXPg_C DFES_DbLv.DFC_MoCSOPHwNoRdy_C DFES_DbLv.DFC_MoCSOPLoLi_C DFES_DbLv.DFC_MoCSOPMM_C DFES_DbLv.DFC_MoCSOPTimeOut_C DFES_DbLv.DFC_MoCSOPUpLi_C DFES_DbLv.DFC_MoFAPP_C DFES_DbLv.DFC_MoFESpd_C DFES_DbLv.DFC_MoFInjDatPhi_C DFES_DbLv.DFC_MoFInjDatQnt_C DFES_DbLv.DFC_MoFInjQnt_C DFES_DbLv.DFC_MoFMode1PoI1_C DFES_DbLv.DFC_MoFMode1PoI2_C DFES_DbLv.DFC_MoFMode2PoI1_C DFES_DbLv.DFC_MoFMode2PoI2_C DFES_DbLv.DFC_MoFOvR_C DFES_DbLv.DFC_MoFQntCor_C DFES_DbLv.DFC_MoFRailP_C DFES_DbLv.DFC_MoFTrqCmp_C DFES_DbLv.DFC_NSCDsHtrSetP_C DFES_DbLv.DFC_NoCat2DsHtrSetP_C DFES_DbLv.DFC_PCVActrTst_C DFES_DbLv.DFC_PhyModNonMonMapNpl_C DFES_DbLv.DFC_RailHpTst_C DFES_DbLv.DFC_RailPOfsTstMax_C DFES_DbLv.DFC_RailPOfsTstMin_C DFES_DbLv.DFC_SIA_E1max_C DFES_DbLv.DFC_SIA_E1min_C DFES_DbLv.DFC_SIA_E1npl_C DFES_DbLv.DFC_SIA_E1sig_C DFES_DbLv.DFC_SIA_E2max_C DFES_DbLv.DFC_SIA_E2min_C DFES_DbLv.DFC_SIA_E2npl_C DFES_DbLv.DFC_SIA_E2sig_C DFES_DbLv.DFC_SIA_E3max_C DFES_DbLv.DFC_SIA_E3min_C DFES_DbLv.DFC_SIA_E3npl_C DFES_DbLv.DFC_SIA_E3sig_C DFES_DbLv.DFC_SIA_E4max_C DFES_DbLv.DFC_SIA_E4min_C DFES_DbLv.DFC_SIA_E4npl_C DFES_DbLv.DFC_SIA_E4sig_C DFES_DbLv.DFC_SWReset_0_C DFES_DbLv.DFC_SWReset_1_C DFES_DbLv.DFC_SWReset_2_C DFES_DbLv.DFC_ShtrAKKMax_C DFES_DbLv.DFC_ShtrAKKMin_C DFES_DbLv.DFC_ShtrAKKNpl_C DFES_DbLv.DFC_ShtrPKKMax_C DFES_DbLv.DFC_StopCntTmr_C DFES_DbLv.DFC_ThrVlvMon_C DFES_DbLv.DFC_VSwVlvJamVlv_C DFES_DbLv.DFC_VSwVlvLgTDrft_C DFES_DbLv.DFC_VSwVlvOfsLrnJamVlv_C DFES_DbLv.DFC_VSwVlvOfsNeutr_C DFES_DbLv.DFC_VSwVlvShTDrft_C DFES_DbLv.DFC_VSwVlvSpgDef_C DFES_DTCM.DFC_Unused_C DFES_DTCM.DFC_ACCIPlausDrvAst_C DFES_DTCM.DFC_ACCIPlausTrqDes_C DFES_DTCM.DFC_AirCtlGovDvtEOMMax_C DFES_DTCM.DFC_AirCtlGovDvtEOMMin_C DFES_DTCM.DFC_AirCtlGovDvtMax_C DFES_DTCM.DFC_AirCtlGovDvtMin_C DFES_DTCM.DFC_AirCtlGovLPDvtMax_C DFES_DTCM.DFC_AirCtlGovLPDvtMin_C DFES_DTCM.DFC_AltIOComErr_C DFES_DTCM.DFC_AltIOComNpl_C DFES_DTCM.DFC_BusDiagBusOffFlexRay_C DFES_DTCM.DFC_BusDiagBusOffNodeA_C DFES_DTCM.DFC_BusDiagBusOffNodeB_C DFES_DTCM.DFC_BusDiagBusOffNodeC_C DFES_DTCM.DFC_BusDiagHwFlexRay_C DFES_DTCM.DFC_Cj945SpiCom1_C DFES_DTCM.DFC_ComACDemandSig_FA_C DFES_DTCM.DFC_ComACDemandTo_FA_C DFES_DTCM.DFC_ComATempSig_FA_C DFES_DTCM.DFC_ComATempTo_FA_C DFES_DTCM.DFC_ComATempTo_FX_C DFES_DTCM.DFC_ComBrkTrqSumChk_FX_C DFES_DTCM.DFC_ComBrkTrqSumCtr_FX_C DFES_DTCM.DFC_ComBrkTrqSumTo_FX_C DFES_DTCM.DFC_ComBtnDrvDynChk_FX_C DFES_DTCM.DFC_ComBtnDrvDynCtr_FX_C DFES_DTCM.DFC_ComBtnDrvDynTo_FX_C DFES_DTCM.DFC_ComButtonMSASig_C DFES_DTCM.DFC_ComButtonMSATo_C DFES_DTCM.DFC_ComCodierungPwrmngSig_C DFES_DTCM.DFC_ComCodierungPwrmngSig_FA_C DFES_DTCM.DFC_ComCrCtlLvrChk_C DFES_DTCM.DFC_ComCrCtlLvrCtr_C DFES_DTCM.DFC_ComCrCtlLvrSig_C DFES_DTCM.DFC_ComCrCtlLvrTo_C DFES_DTCM.DFC_ComCtrCrshSwoEkpSig_FA_C DFES_DTCM.DFC_ComCtrCrshSwoEkpTo_FA_C DFES_DTCM.DFC_ComCtrSecInt_C DFES_DTCM.DFC_ComDiaOBDGbxSig_A_C DFES_DTCM.DFC_ComDiaOBDGbxTo_A_C DFES_DTCM.DFC_ComFahrzeugtypSig_C DFES_DTCM.DFC_ComFahrzeugtypSig_FA_C DFES_DTCM.DFC_ComFllupGpwsupSig_FA_C DFES_DTCM.DFC_ComFllupGpwsupTo_FA_C DFES_DTCM.DFC_ComGbxDataChk_A_C DFES_DTCM.DFC_ComGbxDataChk_FA_C DFES_DTCM.DFC_ComGbxDataCtr_A_C DFES_DTCM.DFC_ComGbxDataCtr_FA_C DFES_DTCM.DFC_ComGbxDataSig_A_C DFES_DTCM.DFC_ComGbxDataSig_FA_C DFES_DTCM.DFC_ComGbxDataTo_A_C DFES_DTCM.DFC_ComGbxDataTo_FA_C DFES_DTCM.DFC_ComKlemmenChk_FA_C DFES_DTCM.DFC_ComKlemmenCtr_FA_C DFES_DTCM.DFC_ComKlemmenSig_FA_C DFES_DTCM.DFC_ComKlemmenTo_FA_C DFES_DTCM.DFC_ComLenkradwinkelSig_C DFES_DTCM.DFC_ComLenkradwinkelTo_C DFES_DTCM.DFC_ComMileageRangeSig_FA_C DFES_DTCM.DFC_ComMileageRangeTo_FA_C DFES_DTCM.DFC_ComPspSig_C DFES_DTCM.DFC_ComPspTo_C DFES_DTCM.DFC_ComRelTimeSig_FA_C DFES_DTCM.DFC_ComRelTimeTo_FA_C DFES_DTCM.DFC_ComRequestEMFChk_C DFES_DTCM.DFC_ComRequestEMFCtr_C DFES_DTCM.DFC_ComRequestEMFSig_C DFES_DTCM.DFC_ComRequestEMFTo_C DFES_DTCM.DFC_ComRpmWhlChk_FX_C DFES_DTCM.DFC_ComRpmWhlCtr_FX_C DFES_DTCM.DFC_ComRpmWhlTo_FX_C DFES_DTCM.DFC_ComSecCtrRelSig_FA_C DFES_DTCM.DFC_ComSecCtrRelTo_FA_C DFES_DTCM.DFC_ComSensNOxGndSig_C DFES_DTCM.DFC_ComSensNOxGndTo_C DFES_DTCM.DFC_ComSensNOxMode_C DFES_DTCM.DFC_ComSensNOxUbattSig_C DFES_DTCM.DFC_ComSensNOxUbattTo_C DFES_DTCM.DFC_ComShiftPaddleTo_FX_C DFES_DTCM.DFC_ComShutOffPSPSig_C DFES_DTCM.DFC_ComShutOffPSPTo_C DFES_DTCM.DFC_ComSlrdiGlbFZMTo_FA_C DFES_DTCM.DFC_ComSlrdiGlbFZMTo_FX_C DFES_DTCM.DFC_ComSpeedVehicleChk_FX_C DFES_DTCM.DFC_ComSpeedVehicleCtr_FX_C DFES_DTCM.DFC_ComSpeedVehicleTo_FX_C DFES_DTCM.DFC_ComStConintDSCChk_FX_C DFES_DTCM.DFC_ComStConintDSCCtr_FX_C DFES_DTCM.DFC_ComStConintDSCTo_FX_C DFES_DTCM.DFC_ComStatACFrontSig_FA_C DFES_DTCM.DFC_ComStatACFrontTo_FA_C DFES_DTCM.DFC_ComStatEkpSig_A_C DFES_DTCM.DFC_ComStatEkpTo_A_C DFES_DTCM.DFC_ComStatGearRevSig_FA_C DFES_DTCM.DFC_ComStatGearRevTo_FA_C DFES_DTCM.DFC_ComStatZVKlappenSig_FA_C DFES_DTCM.DFC_ComStatZVKlappenTo_FA_C DFES_DTCM.DFC_ComStateARSCtr_C DFES_DTCM.DFC_ComStateARSSig_C DFES_DTCM.DFC_ComStateARSTo_C DFES_DTCM.DFC_ComStateDscSig_C DFES_DTCM.DFC_ComStateDscTo_C DFES_DTCM.DFC_ComStateSeatSig_C DFES_DTCM.DFC_ComStateSeatSig_FA_C DFES_DTCM.DFC_ComStateSeatTo_C DFES_DTCM.DFC_ComStateSeatTo_FA_C DFES_DTCM.DFC_ComStatusEGSSig_A_C DFES_DTCM.DFC_ComStatusEGSSig_FA_C DFES_DTCM.DFC_ComStatusEGSTo_A_C DFES_DTCM.DFC_ComStatusEGSTo_FA_C DFES_DTCM.DFC_ComStatusEMFChk_C DFES_DTCM.DFC_ComStatusEMFCtr_C DFES_DTCM.DFC_ComStatusEMFSig_C DFES_DTCM.DFC_ComStatusEMFTo_C DFES_DTCM.DFC_ComStatusRGangSig_C DFES_DTCM.DFC_ComStatusRGangTo_C DFES_DTCM.DFC_ComSteeringAngleChk_FX_C DFES_DTCM.DFC_ComSteeringAngleCtr_FX_C DFES_DTCM.DFC_ComSteeringAngleTo_FX_C DFES_DTCM.DFC_ComTerminalChk_C DFES_DTCM.DFC_ComTerminalCtr_C DFES_DTCM.DFC_ComTerminalSig_C DFES_DTCM.DFC_ComTerminalTo_C DFES_DTCM.DFC_ComTimeDateSig_FA_C DFES_DTCM.DFC_ComTimeDateTo_FA_C DFES_DTCM.DFC_ComTrailerSig_C DFES_DTCM.DFC_ComTrailerSig_FA_C DFES_DTCM.DFC_ComTrailerTo_C DFES_DTCM.DFC_ComTrailerTo_FA_C DFES_DTCM.DFC_ComTrqDemCrshDrDyChk_FX_C DFES_DTCM.DFC_ComTrqDemCrshDrDyCtr_FX_C DFES_DTCM.DFC_ComTrqDemCrshDrDyTo_FX_C DFES_DTCM.DFC_ComTrqDemandDesSig_C DFES_DTCM.DFC_ComTrqDemandDesTo_C DFES_DTCM.DFC_ComTrqDemandDscChk_C DFES_DTCM.DFC_ComTrqDemandDscCtr_C DFES_DTCM.DFC_ComTrqDemandDscSig_C DFES_DTCM.DFC_ComTrqDemandDscTo_C DFES_DTCM.DFC_ComTrqDemandGbxChk_A_C DFES_DTCM.DFC_ComTrqDemandGbxChk_FA_C DFES_DTCM.DFC_ComTrqDemandGbxCtr_A_C DFES_DTCM.DFC_ComTrqDemandGbxCtr_FA_C DFES_DTCM.DFC_ComTrqDemandGbxSig_A_C DFES_DTCM.DFC_ComTrqDemandGbxSig_FA_C DFES_DTCM.DFC_ComTrqDemandGbxTo_A_C DFES_DTCM.DFC_ComTrqDemandGbxTo_FA_C DFES_DTCM.DFC_ComTrqWhlDemChk_C DFES_DTCM.DFC_ComTrqWhlDemCtr_C DFES_DTCM.DFC_ComTrqWhlDemFASChk_FX_C DFES_DTCM.DFC_ComTrqWhlDemFASCtr_FX_C DFES_DTCM.DFC_ComTrqWhlDemFASTo_FX_C DFES_DTCM.DFC_ComTrqWhlDemSig_C DFES_DTCM.DFC_ComTrqWhlDemTo_C DFES_DTCM.DFC_ComVelocityChk_FA_C DFES_DTCM.DFC_ComVelocityCtr_FA_C DFES_DTCM.DFC_ComVelocitySig_C DFES_DTCM.DFC_ComVelocitySig_FA_C DFES_DTCM.DFC_ComVelocityTo_C DFES_DTCM.DFC_ComVelocityTo_FA_C DFES_DTCM.DFC_ComVerbraucherTo_C DFES_DTCM.DFC_ComWMomPTStabChk_FX_C DFES_DTCM.DFC_ComWMomPTStabCtr_FX_C DFES_DTCM.DFC_ComWMomPTStabTo_FX_C DFES_DTCM.DFC_ComWheelSpeedSig_C DFES_DTCM.DFC_ComWheelSpeedTo_C DFES_DTCM.DFC_ComZvKlappenSig_C DFES_DTCM.DFC_ComZvKlappenTo_C DFES_DTCM.DFC_ComaDirectChk_FX_C DFES_DTCM.DFC_ComaDirectCtr_FX_C DFES_DTCM.DFC_ComaDirectTo_FX_C DFES_DTCM.DFC_ComaSideChk_FX_C DFES_DTCM.DFC_ComaSideCtr_FX_C DFES_DTCM.DFC_ComaSideTo_FX_C DFES_DTCM.DFC_Cy320SpiCom_C DFES_DTCM.DFC_ETCtlDvtInrMax_C DFES_DTCM.DFC_ETCtlDvtInrMin_C DFES_DTCM.DFC_ETCtlDvtOutrMax_C DFES_DTCM.DFC_ETCtlDvtOutrMin_C DFES_DTCM.DFC_FBCqDvtMax_C DFES_DTCM.DFC_FBCqDvtMin_C DFES_DTCM.DFC_Fan4WinErr1_C DFES_DTCM.DFC_Fan4WinErr2_C DFES_DTCM.DFC_Fan4WinErr3_C DFES_DTCM.DFC_Fan4WinErr4_C DFES_DTCM.DFC_FanSCG_C DFES_DTCM.DFC_FlFCBS_C DFES_DTCM.DFC_GlwEcuConfigErr_C DFES_DTCM.DFC_GlwEcuEepErr_C DFES_DTCM.DFC_GlwEcuFrmErr_C DFES_DTCM.DFC_GlwEcuGPCMFaultInfo_C DFES_DTCM.DFC_GlwEcuGPCMInfo_C DFES_DTCM.DFC_GlwEcuGk1HSS_C DFES_DTCM.DFC_GlwEcuGk1OL_C DFES_DTCM.DFC_GlwEcuGk1SC_C DFES_DTCM.DFC_GlwEcuGk1Wdst_C DFES_DTCM.DFC_GlwEcuGk2HSS_C DFES_DTCM.DFC_GlwEcuGk2OL_C DFES_DTCM.DFC_GlwEcuGk2SC_C DFES_DTCM.DFC_GlwEcuGk2Wdst_C DFES_DTCM.DFC_GlwEcuGk3HSS_C DFES_DTCM.DFC_GlwEcuGk3OL_C DFES_DTCM.DFC_GlwEcuGk3SC_C DFES_DTCM.DFC_GlwEcuGk3Wdst_C DFES_DTCM.DFC_GlwEcuGk4HSS_C DFES_DTCM.DFC_GlwEcuGk4OL_C DFES_DTCM.DFC_GlwEcuGk4SC_C DFES_DTCM.DFC_GlwEcuGk4Wdst_C DFES_DTCM.DFC_GlwEcuGk5HSS_C DFES_DTCM.DFC_GlwEcuGk5OL_C DFES_DTCM.DFC_GlwEcuGk5SC_C DFES_DTCM.DFC_GlwEcuGk5Wdst_C DFES_DTCM.DFC_GlwEcuGk6HSS_C DFES_DTCM.DFC_GlwEcuGk6OL_C DFES_DTCM.DFC_GlwEcuGk6SC_C DFES_DTCM.DFC_GlwEcuGk6Wdst_C DFES_DTCM.DFC_GlwEcuGndErr_C DFES_DTCM.DFC_GlwEcuIntErr_C DFES_DTCM.DFC_GlwEcuMsgTimeout_C DFES_DTCM.DFC_GlwEcuT30Err_C DFES_DTCM.DFC_GlwEcuTempErr_C DFES_DTCM.DFC_GlwEcuUdiffT30_C DFES_DTCM.DFC_IBSComErr_C DFES_DTCM.DFC_LubSRCOilFldtCrit_C DFES_DTCM.DFC_LubSRCOilFldtCritDflMin_C DFES_DTCM.DFC_LubSRCOilLvlCritMax_C DFES_DTCM.DFC_LubSRCOilLvlCritMin_C DFES_DTCM.DFC_LubSRCTot_C DFES_DTCM.DFC_MonUMaxSupply1_C DFES_DTCM.DFC_MonUMinSupply1_C DFES_DTCM.DFC_OilComNpl_C DFES_DTCM.DFC_PCBS_C DFES_DTCM.DFC_PCBSPFltChg_C DFES_DTCM.DFC_PCRGovDvtLPMax_C DFES_DTCM.DFC_PCRGovDvtLPMin_C DFES_DTCM.DFC_PCRGovDvtMax_C DFES_DTCM.DFC_PCRGovDvtMin_C DFES_DTCM.DFC_PFltAPSPlausMAX_C DFES_DTCM.DFC_PFltAPSPlausMIN_C DFES_DTCM.DFC_PFltBPSPlausMAX_C DFES_DTCM.DFC_PFltBPSPlausMIN_C DFES_DTCM.DFC_PFltOvldInhRgn_C DFES_DTCM.DFC_PFltOvldTrqLim_C DFES_DTCM.DFC_PFltPresPlausMAX_C DFES_DTCM.DFC_PFltPresPlausMIN_C DFES_DTCM.DFC_PFltTraRpmRdc_C DFES_DTCM.DFC_PFlt_tOxiPreMax_C DFES_DTCM.DFC_PFlt_tOxiPreMaxRgn_C DFES_DTCM.DFC_PFlt_tOxiPreNpl_C DFES_DTCM.DFC_PFlt_tPreMax_C DFES_DTCM.DFC_PFlt_tPreMaxRgn_C DFES_DTCM.DFC_PFlt_tPreNpl_C DFES_DTCM.DFC_PFltmSotDiffMAX_C DFES_DTCM.DFC_PFltmSotDiffMIN_C DFES_DTCM.DFC_PFltmSotDiffSIG_C DFES_DTCM.DFC_PIntkVUsEnvPPls_C DFES_DTCM.DFC_PresPlausDblDef_C DFES_DTCM.DFC_RailCPC1_C DFES_DTCM.DFC_RailCPC3_C DFES_DTCM.DFC_RailCPC4_C DFES_DTCM.DFC_RailMeUn0_C DFES_DTCM.DFC_RailMeUn1_C DFES_DTCM.DFC_RailMeUn2_C DFES_DTCM.DFC_RailMeUn22_C DFES_DTCM.DFC_RailMeUn3_C DFES_DTCM.DFC_RailMeUn4_C DFES_DTCM.DFC_RailMeUn42_C DFES_DTCM.DFC_RailMeUn5_C DFES_DTCM.DFC_RailPCV0_C DFES_DTCM.DFC_RailPCV1_C DFES_DTCM.DFC_RailPCV2_C DFES_DTCM.DFC_RailPCV22_C DFES_DTCM.DFC_RailPCV3_C DFES_DTCM.DFC_RailPCV4_C DFES_DTCM.DFC_RailPCV42_C DFES_DTCM.DFC_RailPMonStrt_C DFES_DTCM.DFC_SSpMon1_C DFES_DTCM.DFC_SSpMon2_C DFES_DTCM.DFC_SSpMon3_C DFES_DTCM.DFC_ThrVlv4WinErr1_C DFES_DTCM.DFC_ThrVlv4WinErr2_C DFES_DTCM.DFC_ThrVlv4WinErr3_C DFES_DTCM.DFC_ThrVlv4WinErr4_C DFES_DTCM.DFC_ThrVlvSCG_C DFES_DTCM.DFC_Tle6232Spi1_C DFES_DTCM.DFC_TrbCh4WinErr1_C DFES_DTCM.DFC_TrbCh4WinErr2_C DFES_DTCM.DFC_TrbCh4WinErr3_C DFES_DTCM.DFC_TrbCh4WinErr4_C DFES_DTCM.DFC_TrbChSCG_C DFES_DTCM.DFC_TrbChSRCMax_C DFES_DTCM.DFC_TrbChSRCMin_C DFES_DTCM.DFC_WaHtEl4WinErr1_C DFES_DTCM.DFC_WaHtEl4WinErr2_C DFES_DTCM.DFC_WaHtEl4WinErr3_C DFES_DTCM.DFC_WaHtEl4WinErr4_C DFES_DTCM.DFC_WaHtElSCG_C DFES_DTCM.DFC_ETClbETFltMax_0_C DFES_DTCM.DFC_ETClbETFltMax_1_C DFES_DTCM.DFC_ETClbETFltMax_2_C DFES_DTCM.DFC_ETClbETFltMax_3_C DFES_DTCM.DFC_ETClbETFltMax_4_C DFES_DTCM.DFC_ETClbETFltMax_5_C DFES_DTCM.DFC_ETClbETFltMin_0_C DFES_DTCM.DFC_ETClbETFltMin_1_C DFES_DTCM.DFC_ETClbETFltMin_2_C DFES_DTCM.DFC_ETClbETFltMin_3_C DFES_DTCM.DFC_ETClbETFltMin_4_C DFES_DTCM.DFC_ETClbETFltMin_5_C DFES_DTCM.DFC_InjCrvInjLimChrgBal_C DFES_DTCM.DFC_InjCrvInjLimQntBal_C DFES_DTCM.DFC_InjCrvInjLimSys_C DFES_DTCM.DFC_InjCrvNumInjRtmLim_C DFES_DTCM.DFC_LSUHtCoupSig_C DFES_DTCM.DFC_AFS_SSpShOffOL_C DFES_DTCM.DFC_AFS_SSpShOffOvrTemp_C DFES_DTCM.DFC_AFS_SSpShOffSCB_C DFES_DTCM.DFC_AFS_SSpShOffSCG_C DFES_DTCM.DFC_AirCCmprOL_C DFES_DTCM.DFC_AirCCmprOvrTemp_C DFES_DTCM.DFC_AirCCmprSCB_C DFES_DTCM.DFC_AirCCmprSCG_C DFES_DTCM.DFC_CByVlvOL_C DFES_DTCM.DFC_CByVlvOvrTemp_C DFES_DTCM.DFC_CByVlvSCB_C DFES_DTCM.DFC_CByVlvSCG_C DFES_DTCM.DFC_CThmstOL_C DFES_DTCM.DFC_CThmstOvrTemp_C DFES_DTCM.DFC_CThmstSCB_C DFES_DTCM.DFC_CThmstSCG_C DFES_DTCM.DFC_DSMDummy_C DFES_DTCM.DFC_EBxFanOL_C DFES_DTCM.DFC_EBxFanOvrTemp_C DFES_DTCM.DFC_EBxFanSCB_C DFES_DTCM.DFC_EBxFanSCG_C DFES_DTCM.DFC_ECBVlvOL_C DFES_DTCM.DFC_ECBVlvOvrTemp_C DFES_DTCM.DFC_ECBVlvSCB_C DFES_DTCM.DFC_ECBVlvSCG_C DFES_DTCM.DFC_EMDmpOL_0_C DFES_DTCM.DFC_EMDmpOL_1_C DFES_DTCM.DFC_EMDmpOvrTemp_0_C DFES_DTCM.DFC_EMDmpOvrTemp_1_C DFES_DTCM.DFC_EMDmpSCB_0_C DFES_DTCM.DFC_EMDmpSCB_1_C DFES_DTCM.DFC_EMDmpSCG_0_C DFES_DTCM.DFC_EMDmpSCG_1_C DFES_DTCM.DFC_EngStAOL_C DFES_DTCM.DFC_EngStAOvrTemp_C DFES_DTCM.DFC_EngStASCB_C DFES_DTCM.DFC_EngStASCG_C DFES_DTCM.DFC_FanOL_C DFES_DTCM.DFC_FanOvrTemp_C DFES_DTCM.DFC_FanSCB_C DFES_DTCM.DFC_FlFltHtOL_C DFES_DTCM.DFC_FlFltHtOvrTemp_C DFES_DTCM.DFC_FlFltHtSCB_C DFES_DTCM.DFC_FlFltHtSCG_C DFES_DTCM.DFC_LSUHtrMax_C DFES_DTCM.DFC_LSUHtrMin_C DFES_DTCM.DFC_LSUHtrNpl_C DFES_DTCM.DFC_LSUHtrSig_C DFES_DTCM.DFC_LSUtExcMax_C DFES_DTCM.DFC_LSUtExcMin_C DFES_DTCM.DFC_MeUnOL_C DFES_DTCM.DFC_MeUnSCB_C DFES_DTCM.DFC_MeUnSRCMax_C DFES_DTCM.DFC_MeUnSRCMin_C DFES_DTCM.DFC_PCVOL_C DFES_DTCM.DFC_PCVSCB_C DFES_DTCM.DFC_PCVSRCMax_C DFES_DTCM.DFC_PCVSRCMin_C DFES_DTCM.DFC_RailPSRCMax_C DFES_DTCM.DFC_RailPSRCMin_C DFES_DTCM.DFC_ShtrOL_C DFES_DTCM.DFC_ShtrOvrTemp_C DFES_DTCM.DFC_ShtrSCB_C DFES_DTCM.DFC_ShtrSCG_C DFES_DTCM.DFC_StrtOL_C DFES_DTCM.DFC_StrtOvrTemp_C DFES_DTCM.DFC_StrtSCB_C DFES_DTCM.DFC_StrtSCG_C DFES_DTCM.DFC_ThrVlvOL_C DFES_DTCM.DFC_ThrVlvOvrTemp_C DFES_DTCM.DFC_ThrVlvSCB_C DFES_DTCM.DFC_TrbChOL_C DFES_DTCM.DFC_TrbChOvrTemp_C DFES_DTCM.DFC_TrbChSCB_C DFES_DTCM.DFC_UDosVlvOL_C DFES_DTCM.DFC_UDosVlvOvrTemp_C DFES_DTCM.DFC_UDosVlvSCB_C DFES_DTCM.DFC_UDosVlvSCG_C DFES_DTCM.DFC_UPmpMotOL_C DFES_DTCM.DFC_UPmpMotOvrTemp_C DFES_DTCM.DFC_UPmpMotSCB_C DFES_DTCM.DFC_UPmpMotSCG_C DFES_DTCM.DFC_WaHtElOL_C DFES_DTCM.DFC_WaHtElOvrTemp_C DFES_DTCM.DFC_WaHtElSCB_C DFES_DTCM.DFC_IVActrUChSRCMax_C DFES_DTCM.DFC_IVActrUChSRCMin_C DFES_DTCM.DFC_IVActrVltgSRCMax_C DFES_DTCM.DFC_IVActrVltgSRCMin_C DFES_DTCM.DFC_IVDiaTunDet_C DFES_DTCM.DFC_IVPSplyStopDCDC_C DFES_DTCM.DFC_IVPSplyVltgSRCMax_C DFES_DTCM.DFC_IVPSplyVltgSRCMin_C DFES_DTCM.DFC_SCREtaErr_C DFES_DTCM.DFC_SCREtaErr1_C DFES_DTCM.DFC_SCREtaErr2_C DFES_DTCM.DFC_SCRMonMetCtlPresErr_C DFES_DTCM.DFC_SCRMonPresBuildUpErr_C DFES_DTCM.DFC_SCRMonPresRdcErr_C DFES_DTCM.DFC_AFSOffsDrftMax_C DFES_DTCM.DFC_AFSOffsDrftMin_C DFES_DTCM.DFC_AFSSRCCorMax_C DFES_DTCM.DFC_AFSSRCCorMin_C DFES_DTCM.DFC_AFSSRCRawMax_C DFES_DTCM.DFC_AFSSRCRawMin_C DFES_DTCM.DFC_AFSSetyDrftMax_C DFES_DTCM.DFC_AFSSetyDrftMin_C DFES_DTCM.DFC_AirCSwtNpl_C DFES_DTCM.DFC_AirCSwtSig_C DFES_DTCM.DFC_BattUSRCMax_C DFES_DTCM.DFC_BattUSRCMin_C DFES_DTCM.DFC_BrkNpl_C DFES_DTCM.DFC_BrkPSRCMax_C DFES_DTCM.DFC_BrkPSRCMin_C DFES_DTCM.DFC_CEngDsTSRCMax_C DFES_DTCM.DFC_CEngDsTSRCMin_C DFES_DTCM.DFC_CrCUIDet_C DFES_DTCM.DFC_ECBVlvSRCMax_C DFES_DTCM.DFC_ECBVlvSRCMin_C DFES_DTCM.DFC_ECUOvrTemp_C DFES_DTCM.DFC_EGRVlvGovDvtMax_C DFES_DTCM.DFC_EGRVlvGovDvtMin_C DFES_DTCM.DFC_EGRVlvHBrgOpnLd_C DFES_DTCM.DFC_EGRVlvHBrgOvrCurr_C DFES_DTCM.DFC_EGRVlvHBrgOvrTemp_C DFES_DTCM.DFC_EGRVlvHBrgShCirBatt1_C DFES_DTCM.DFC_EGRVlvHBrgShCirBatt2_C DFES_DTCM.DFC_EGRVlvHBrgShCirGnd1_C DFES_DTCM.DFC_EGRVlvHBrgShCirGnd2_C DFES_DTCM.DFC_EGRVlvHBrgShCirOvrLd_C DFES_DTCM.DFC_EGRVlvHBrgTempOvrCurr_C DFES_DTCM.DFC_EGRVlvHBrgUndrVltg_C DFES_DTCM.DFC_EGRVlvLPGovDvtMax_C DFES_DTCM.DFC_EGRVlvLPGovDvtMin_C DFES_DTCM.DFC_EGRVlvLPHBrgOpnLd_C DFES_DTCM.DFC_EGRVlvLPHBrgOvrCurr_C DFES_DTCM.DFC_EGRVlvLPHBrgOvrTemp_C DFES_DTCM.DFC_EGRVlvLPHBrgShCirBatt1_C DFES_DTCM.DFC_EGRVlvLPHBrgShCirBatt2_C DFES_DTCM.DFC_EGRVlvLPHBrgShCirGnd1_C DFES_DTCM.DFC_EGRVlvLPHBrgShCirGnd2_C DFES_DTCM.DFC_EGRVlvLPHBrgShCirOvrLd_C DFES_DTCM.DFC_EGRVlvLPHBrgTempOvrCurr_C DFES_DTCM.DFC_EGRVlvLPHBrgUndrVltg_C DFES_DTCM.DFC_EGRVlvLPOL_C DFES_DTCM.DFC_EGRVlvLPSCB_C DFES_DTCM.DFC_EGRVlvLPSCG_C DFES_DTCM.DFC_EGRVlvLPSRCMax_C DFES_DTCM.DFC_EGRVlvLPSRCMin_C DFES_DTCM.DFC_EGRVlvOL_C DFES_DTCM.DFC_EGRVlvSCB_C DFES_DTCM.DFC_EGRVlvSCG_C DFES_DTCM.DFC_EGRVlvSRCMax_C DFES_DTCM.DFC_EGRVlvSRCMin_C DFES_DTCM.DFC_EngPrtOvrSpd_C DFES_DTCM.DFC_EngSpdOL_C DFES_DTCM.DFC_EngSpdSCB_C DFES_DTCM.DFC_EngSpdSCG_C DFES_DTCM.DFC_EnhSRCMaxPPFltDiff_C DFES_DTCM.DFC_EnhSRCMaxT1ExhTMon_C DFES_DTCM.DFC_EnhSRCMaxT2ExhTMon_C DFES_DTCM.DFC_EnhSRCMaxT3ExhTMon_C DFES_DTCM.DFC_EnhSRCMinPPFltDiff_C DFES_DTCM.DFC_EnhSRCMinT1ExhTMon_C DFES_DTCM.DFC_EnhSRCMinT2ExhTMon_C DFES_DTCM.DFC_EnhSRCMinT3ExhTMon_C DFES_DTCM.DFC_EnvPSRCMax_C DFES_DTCM.DFC_EnvPSRCMin_C DFES_DTCM.DFC_ExhTMonPlaus_C DFES_DTCM.DFC_ExhTMonPlausPos1_C DFES_DTCM.DFC_ExhTMonPlausPos2_C DFES_DTCM.DFC_ExhTMonPlausPos3_C DFES_DTCM.DFC_ExhTMonT1Plaus_C DFES_DTCM.DFC_ExhTMonT2Plaus_C DFES_DTCM.DFC_ExhTMonT3Plaus_C DFES_DTCM.DFC_FlFltDsPSRCMax_C DFES_DTCM.DFC_FlFltDsPSRCMin_C DFES_DTCM.DFC_FlFltSig_C DFES_DTCM.DFC_FlFltUsPSRCMax_C DFES_DTCM.DFC_FlFltUsPSRCMin_C DFES_DTCM.DFC_FuelTSRCMax_C DFES_DTCM.DFC_FuelTSRCMin_C DFES_DTCM.DFC_GbxNPosPPerSRCMax_C DFES_DTCM.DFC_GbxNPosPPerSRCMin_C DFES_DTCM.DFC_GbxNPosPdcycSRCMax_C DFES_DTCM.DFC_GbxNPosPdcycSRCMin_C DFES_DTCM.DFC_InjVlvPresMin_C DFES_DTCM.DFC_LSUCircNernstSig_C DFES_DTCM.DFC_LSUCircPmpCurSig_C DFES_DTCM.DFC_LSUCircVirtGndSig_C DFES_DTCM.DFC_LSUO2Max_C DFES_DTCM.DFC_LSUO2Min_C DFES_DTCM.DFC_LSUSPIBattLowMin_C DFES_DTCM.DFC_LSUWireSCB_C DFES_DTCM.DFC_LSUWireSCG_C DFES_DTCM.DFC_MeUnSCG_C DFES_DTCM.DFC_NSCDsCmpChk_C DFES_DTCM.DFC_NSCDsLamBinSRCMax_C DFES_DTCM.DFC_NSCDsLamBinSRCMin_C DFES_DTCM.DFC_NSCDsLamLinSRCMax_C DFES_DTCM.DFC_NSCDsLamLinSRCMin_C DFES_DTCM.DFC_NSCDsLamPlausMax_C DFES_DTCM.DFC_NSCDsLamPlausMin_C DFES_DTCM.DFC_NSCDsNOxSRCMax_C DFES_DTCM.DFC_NSCDsNOxSRCMin_C DFES_DTCM.DFC_NSCDsOpCir_C DFES_DTCM.DFC_NSCDsShCir_C DFES_DTCM.DFC_NoCat2DsCmpChk_C DFES_DTCM.DFC_NoCat2DsLamBinSRCMax_C DFES_DTCM.DFC_NoCat2DsLamBinSRCMin_C DFES_DTCM.DFC_NoCat2DsLamLinSRCMax_C DFES_DTCM.DFC_NoCat2DsLamLinSRCMin_C DFES_DTCM.DFC_NoCat2DsLamPlausMax_C DFES_DTCM.DFC_NoCat2DsLamPlausMin_C DFES_DTCM.DFC_NoCat2DsNOxSRCMax_C DFES_DTCM.DFC_NoCat2DsNOxSRCMin_C DFES_DTCM.DFC_NoCat2DsOpCir_C DFES_DTCM.DFC_NoCat2DsShCir_C DFES_DTCM.DFC_NplDynPPFltDiff_C DFES_DTCM.DFC_NplHsChngPPFltDiff_C DFES_DTCM.DFC_NplHsLnPPFltDiff_C DFES_DTCM.DFC_NplTOxiCatUs_C DFES_DTCM.DFC_NplTPFltUs_C DFES_DTCM.DFC_NplTTrbnUs_C DFES_DTCM.DFC_OilPSwmpSRCMax_C DFES_DTCM.DFC_OilPSwmpSRCMin_C DFES_DTCM.DFC_PCVSCG_C DFES_DTCM.DFC_PFltCharPDiffMin_C DFES_DTCM.DFC_PFltDstrMin_C DFES_DTCM.DFC_PFltEngPrt_C DFES_DTCM.DFC_PFltRgnPerm_C DFES_DTCM.DFC_PFltSRCMaxFlwRstn_C DFES_DTCM.DFC_PFltSRCMinFlwRstn_C DFES_DTCM.DFC_PFltSotMsDvtMax_C DFES_DTCM.DFC_PFltSotMsDvtMin_C DFES_DTCM.DFC_PFltSotMsMax_C DFES_DTCM.DFC_PIntkVUsSRCMax_C DFES_DTCM.DFC_PIntkVUsSRCMin_C DFES_DTCM.DFC_SRCHighAPP1_C DFES_DTCM.DFC_SRCHighAPP2_C DFES_DTCM.DFC_SRCLowAPP1_C DFES_DTCM.DFC_SRCLowAPP2_C DFES_DTCM.DFC_SRCMaxPPFltDiff_C DFES_DTCM.DFC_SRCMaxPPFltUs_C DFES_DTCM.DFC_SRCMaxTECU_C DFES_DTCM.DFC_SRCMaxTOxiCatUs_C DFES_DTCM.DFC_SRCMaxTPFltUs_C DFES_DTCM.DFC_SRCMaxTTrbnUs_C DFES_DTCM.DFC_SRCMaxUCatUsT_C DFES_DTCM.DFC_SRCMaxUPmpP_C DFES_DTCM.DFC_SRCMinPPFltDiff_C DFES_DTCM.DFC_SRCMinPPFltUs_C DFES_DTCM.DFC_SRCMinTECU_C DFES_DTCM.DFC_SRCMinTOxiCatUs_C DFES_DTCM.DFC_SRCMinTPFltUs_C DFES_DTCM.DFC_SRCMinTTrbnUs_C DFES_DTCM.DFC_SRCMinUCatUsT_C DFES_DTCM.DFC_SRCMinUPmpP_C DFES_DTCM.DFC_SigUCatUsT_C DFES_DTCM.DFC_SigUPmpP_C DFES_DTCM.DFC_SyncAPP_C DFES_DTCM.DFC_T15Npl_C DFES_DTCM.DFC_TAFSDtyCycHi_C DFES_DTCM.DFC_TAFSDtyCycLo_C DFES_DTCM.DFC_TAFSPerHi_C DFES_DTCM.DFC_TAFSPerLo_C DFES_DTCM.DFC_TCACDsSRCMax_C DFES_DTCM.DFC_TCACDsSRCMin_C DFES_DTCM.DFC_ThrVlvSRCMax_C DFES_DTCM.DFC_ThrVlvSRCMin_C DFES_DTCM.DFC_TrbChLPOL_C DFES_DTCM.DFC_TrbChLPSCB_C DFES_DTCM.DFC_TrbChLPSCG_C DFES_DTCM.DFC_UHtrPLOL_C DFES_DTCM.DFC_UHtrPLSCB_C DFES_DTCM.DFC_UHtrPLSCG_C DFES_DTCM.DFC_UHtrPLSRCMaxDia_C DFES_DTCM.DFC_UHtrPLSRCMinDia_C DFES_DTCM.DFC_UHtrTnkOL_C DFES_DTCM.DFC_UHtrTnkSCB_C DFES_DTCM.DFC_UHtrTnkSCG_C DFES_DTCM.DFC_UHtrTnkSRCMaxDia_C DFES_DTCM.DFC_UHtrTnkSRCMinDia_C DFES_DTCM.DFC_URevVlvOL_C DFES_DTCM.DFC_URevVlvSCB_C DFES_DTCM.DFC_URevVlvSCG_C DFES_DTCM.DFC_UTnkTSRCMax_C DFES_DTCM.DFC_UTnkTSRCMin_C DFES_DTCM.DFC_UTnkTSig_C DFES_DTCM.DFC_VSwVlvGovDvtMax_C DFES_DTCM.DFC_VSwVlvGovDvtMin_C DFES_DTCM.DFC_VSwVlvHBrgOpnLd_C DFES_DTCM.DFC_VSwVlvHBrgOvrCurr_C DFES_DTCM.DFC_VSwVlvHBrgOvrTemp_C DFES_DTCM.DFC_VSwVlvHBrgShCirBatt1_C DFES_DTCM.DFC_VSwVlvHBrgShCirBatt2_C DFES_DTCM.DFC_VSwVlvHBrgShCirGnd1_C DFES_DTCM.DFC_VSwVlvHBrgShCirGnd2_C DFES_DTCM.DFC_VSwVlvHBrgShCirOvrLd_C DFES_DTCM.DFC_VSwVlvHBrgTempOvrCurr_C DFES_DTCM.DFC_VSwVlvHBrgUndrVltg_C DFES_DTCM.DFC_VSwVlvOL_C DFES_DTCM.DFC_VSwVlvSCB_C DFES_DTCM.DFC_VSwVlvSCG_C DFES_DTCM.DFC_VSwVlvSRCMax_C DFES_DTCM.DFC_VSwVlvSRCMin_C DFES_DTCM.DFC_ClthNpl_C DFES_DTCM.DFC_ETClbETMax_0_C DFES_DTCM.DFC_ETClbETMax_1_C DFES_DTCM.DFC_ETClbETMax_2_C DFES_DTCM.DFC_ETClbETMax_3_C DFES_DTCM.DFC_ETClbETMax_4_C DFES_DTCM.DFC_ETClbETMax_5_C DFES_DTCM.DFC_ETClbETMin_0_C DFES_DTCM.DFC_ETClbETMin_1_C DFES_DTCM.DFC_ETClbETMin_2_C DFES_DTCM.DFC_ETClbETMin_3_C DFES_DTCM.DFC_ETClbETMin_4_C DFES_DTCM.DFC_ETClbETMin_5_C DFES_DTCM.DFC_IVActrEnrgMax_0_C DFES_DTCM.DFC_IVActrEnrgMax_1_C DFES_DTCM.DFC_IVActrEnrgMax_2_C DFES_DTCM.DFC_IVActrEnrgMax_3_C DFES_DTCM.DFC_IVActrEnrgMax_4_C DFES_DTCM.DFC_IVActrEnrgMax_5_C /end DEF_CHARACTERISTIC
/end FUNCTION
/begin COMPU_METHOD DFES_OneToOne "" RAT_FUNC "%6.0" "-" COEFFS 0 1 0 0 0 1 /end COMPU_METHOD
/begin RECORD_LAYOUT Val_Wu16 FNC_VALUES 1 UWORD COLUMN_DIR DIRECT /end RECORD_LAYOUT
/begin RECORD_LAYOUT Val_Wu8 FNC_VALUES 1 UBYTE COLUMN_DIR DIRECT /end RECORD_LAYOUT
/end MODULE
/end PROJECT

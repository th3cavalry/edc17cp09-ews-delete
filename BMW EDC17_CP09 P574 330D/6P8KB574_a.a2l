ASAP2_VERSION 1 4
/begin PROJECT P_574 "EDC17_CP09"
/begin HEADER "" VERSION "V8KB" PROJECT_NO P_574 /end HEADER
/begin MODULE DIM ""
/begin MOD_COMMON "" BYTE_ORDER MSB_LAST ALIGNMENT_BYTE 1 ALIGNMENT_WORD 2 ALIGNMENT_LONG 4 ALIGNMENT_FLOAT32_IEEE 4 /end MOD_COMMON
/begin MEASUREMENT FBC_DXS_mp02 "relative Zahnteilungsfehler (ungefiltert)" SWORD FBC_Dxs_s16 1 100 -0.7812500 0.7812262 FORMAT "%9.7" ECU_ADDRESS 0xC000BD74 /end MEASUREMENT
/begin MEASUREMENT FBC_DXS_mp03 "relative Zahnteilungsfehler (ungefiltert)" SWORD FBC_Dxs_s16 1 100 -0.7812500 0.7812262 FORMAT "%9.7" ECU_ADDRESS 0xC000BD76 /end MEASUREMENT
/begin MEASUREMENT FBC_DXS_mp04 "relative Zahnteilungsfehler (ungefiltert)" SWORD FBC_Dxs_s16 1 100 -0.7812500 0.7812262 FORMAT "%9.7" ECU_ADDRESS 0xC000BD78 /end MEASUREMENT
/begin MEASUREMENT FBC_DXS_mp05 "relative Zahnteilungsfehler (ungefiltert)" SWORD FBC_Dxs_s16 1 100 -0.7812500 0.7812262 FORMAT "%9.7" ECU_ADDRESS 0xC000BD7A /end MEASUREMENT
/begin MEASUREMENT FBC_DXS_mp06 "relative Zahnteilungsfehler (ungefiltert)" SWORD FBC_Dxs_s16 1 100 -0.7812500 0.7812262 FORMAT "%9.7" ECU_ADDRESS 0xC000BD7C /end MEASUREMENT
/begin MEASUREMENT FBC_DXS_mp07 "relative Zahnteilungsfehler (ungefiltert)" SWORD FBC_Dxs_s16 1 100 -0.7812500 0.7812262 FORMAT "%9.7" ECU_ADDRESS 0xC000BD7E /end MEASUREMENT
/begin MEASUREMENT FBC_DXS_mp08 "relative Zahnteilungsfehler (ungefiltert)" SWORD FBC_Dxs_s16 1 100 -0.7812500 0.7812262 FORMAT "%9.7" ECU_ADDRESS 0xC000BD80 /end MEASUREMENT
/begin MEASUREMENT FBC_DXS_mp09 "relative Zahnteilungsfehler (ungefiltert)" SWORD FBC_Dxs_s16 1 100 -0.7812500 0.7812262 FORMAT "%9.7" ECU_ADDRESS 0xC000BD82 /end MEASUREMENT
/begin MEASUREMENT FBC_DXS_mp10 "relative Zahnteilungsfehler (ungefiltert)" SWORD FBC_Dxs_s16 1 100 -0.7812500 0.7812262 FORMAT "%9.7" ECU_ADDRESS 0xC000BD84 /end MEASUREMENT
/begin MEASUREMENT FBC_DXS_mp11 "relative Zahnteilungsfehler (ungefiltert)" SWORD FBC_Dxs_s16 1 100 -0.7812500 0.7812262 FORMAT "%9.7" ECU_ADDRESS 0xC000BD86 /end MEASUREMENT
/begin MEASUREMENT FBC_facBPNum_mp00 "aktuell angewendete Bandpassverstärkung" SWORD FBC_BPfac 1 100 -60.00183 60.00000 FORMAT "%8.5" ECU_ADDRESS 0xC000BCCC /end MEASUREMENT
/begin MEASUREMENT FBC_facBPNum_mp01 "aktuell angewendete Bandpassverstärkung" SWORD FBC_BPfac 1 100 -60.00183 60.00000 FORMAT "%8.5" ECU_ADDRESS 0xC000BCCE /end MEASUREMENT
/begin MEASUREMENT FBC_facBPNum_mp02 "aktuell angewendete Bandpassverstärkung" SWORD FBC_BPfac 1 100 -60.00183 60.00000 FORMAT "%8.5" ECU_ADDRESS 0xC000BCD0 /end MEASUREMENT
/begin MEASUREMENT FBC_facSegVal_mp00 "aktuell angewendete Segmentwahl" UWORD Per_Ratio 1 100 0.00 255.9961 FORMAT "%8.4" ECU_ADDRESS 0xC000BCD2 /end MEASUREMENT
/begin MEASUREMENT FBC_facSegVal_mp01 "aktuell angewendete Segmentwahl" UWORD Per_Ratio 1 100 0.00 255.9961 FORMAT "%8.4" ECU_ADDRESS 0xC000BCD4 /end MEASUREMENT
/begin MEASUREMENT FBC_facSegVal_mp02 "aktuell angewendete Segmentwahl" UWORD Per_Ratio 1 100 0.00 255.9961 FORMAT "%8.4" ECU_ADDRESS 0xC000BCD6 /end MEASUREMENT
/begin MEASUREMENT FBC_qArr00 "Ausgangsmenge der Mengenausgleichsregelung, Schnittstelle zum Einspritzsystem" SWORD InjMass 1 100 -327.6800 327.6700 ECU_ADDRESS 0xD0000AC4 /end MEASUREMENT
/begin MEASUREMENT FBC_qArr01 "Ausgangsmenge der Mengenausgleichsregelung, Schnittstelle zum Einspritzsystem" SWORD InjMass 1 100 -327.6800 327.6700 ECU_ADDRESS 0xD0000AC6 /end MEASUREMENT
/begin MEASUREMENT FBC_qArr02 "Ausgangsmenge der Mengenausgleichsregelung, Schnittstelle zum Einspritzsystem" SWORD InjMass 1 100 -327.6800 327.6700 ECU_ADDRESS 0xD0000AC8 /end MEASUREMENT
/begin MEASUREMENT FBC_qArr03 "Ausgangsmenge der Mengenausgleichsregelung, Schnittstelle zum Einspritzsystem" SWORD InjMass 1 100 -327.6800 327.6700 ECU_ADDRESS 0xD0000ACA /end MEASUREMENT
/begin MEASUREMENT FBC_qArr04 "Ausgangsmenge der Mengenausgleichsregelung, Schnittstelle zum Einspritzsystem" SWORD InjMass 1 100 -327.6800 327.6700 ECU_ADDRESS 0xD0000ACC /end MEASUREMENT
/begin MEASUREMENT FBC_qArr05 "Ausgangsmenge der Mengenausgleichsregelung, Schnittstelle zum Einspritzsystem" SWORD InjMass 1 100 -327.6800 327.6700 ECU_ADDRESS 0xD0000ACE /end MEASUREMENT
/begin MEASUREMENT FBC_qDvtCyl00 "aktuelle zylinderindividuelle Korrekturmenge: I-Anteile in Zündfolge" SWORD InjMass 1 100 -327.6800 327.6700 ECU_ADDRESS 0xD0000ADC /end MEASUREMENT
/begin MEASUREMENT FBC_qDvtCyl01 "aktuelle zylinderindividuelle Korrekturmenge: I-Anteile in Zündfolge" SWORD InjMass 1 100 -327.6800 327.6700 ECU_ADDRESS 0xD0000ADE /end MEASUREMENT
/begin MEASUREMENT FBC_qDvtCyl02 "aktuelle zylinderindividuelle Korrekturmenge: I-Anteile in Zündfolge" SWORD InjMass 1 100 -327.6800 327.6700 ECU_ADDRESS 0xD0000AE0 /end MEASUREMENT
/begin MEASUREMENT FBC_qDvtCyl03 "aktuelle zylinderindividuelle Korrekturmenge: I-Anteile in Zündfolge" SWORD InjMass 1 100 -327.6800 327.6700 ECU_ADDRESS 0xD0000AE2 /end MEASUREMENT
/begin MEASUREMENT FBC_qDvtCyl04 "aktuelle zylinderindividuelle Korrekturmenge: I-Anteile in Zündfolge" SWORD InjMass 1 100 -327.6800 327.6700 ECU_ADDRESS 0xD0000AE4 /end MEASUREMENT
/begin MEASUREMENT FBC_qDvtCyl05 "aktuelle zylinderindividuelle Korrekturmenge: I-Anteile in Zündfolge" SWORD InjMass 1 100 -327.6800 327.6700 ECU_ADDRESS 0xD0000AE6 /end MEASUREMENT
/begin MEASUREMENT FBC_qDvtCylPhys00 "aktuelle zylinderindividuelle Korrekturmenge: I-Anteile in geometrischer Reihenfolge" SWORD InjMass 1 100 -327.6800 327.6700 ECU_ADDRESS 0xD0000AD0 /end MEASUREMENT
/begin MEASUREMENT FBC_qDvtCylPhys01 "aktuelle zylinderindividuelle Korrekturmenge: I-Anteile in geometrischer Reihenfolge" SWORD InjMass 1 100 -327.6800 327.6700 ECU_ADDRESS 0xD0000AD2 /end MEASUREMENT
/begin MEASUREMENT FBC_qDvtCylPhys02 "aktuelle zylinderindividuelle Korrekturmenge: I-Anteile in geometrischer Reihenfolge" SWORD InjMass 1 100 -327.6800 327.6700 ECU_ADDRESS 0xD0000AD4 /end MEASUREMENT
/begin MEASUREMENT FBC_qDvtCylPhys03 "aktuelle zylinderindividuelle Korrekturmenge: I-Anteile in geometrischer Reihenfolge" SWORD InjMass 1 100 -327.6800 327.6700 ECU_ADDRESS 0xD0000AD6 /end MEASUREMENT
/begin MEASUREMENT FBC_qDvtCylPhys04 "aktuelle zylinderindividuelle Korrekturmenge: I-Anteile in geometrischer Reihenfolge" SWORD InjMass 1 100 -327.6800 327.6700 ECU_ADDRESS 0xD0000AD8 /end MEASUREMENT
/begin MEASUREMENT FBC_qDvtCylPhys05 "aktuelle zylinderindividuelle Korrekturmenge: I-Anteile in geometrischer Reihenfolge" SWORD InjMass 1 100 -327.6800 327.6700 ECU_ADDRESS 0xD0000ADA /end MEASUREMENT
/begin MEASUREMENT FBC_qIntegrator_mp00 "Ausgangsmenge der Mengenausgleichsregelung, Integratorinhalte" SWORD InjMass 1 100 -327.6800 327.6700 ECU_ADDRESS 0xC000BCD8 /end MEASUREMENT
/begin MEASUREMENT FBC_qIntegrator_mp01 "Ausgangsmenge der Mengenausgleichsregelung, Integratorinhalte" SWORD InjMass 1 100 -327.6800 327.6700 ECU_ADDRESS 0xC000BCDA /end MEASUREMENT
/begin MEASUREMENT FBC_qIntegrator_mp02 "Ausgangsmenge der Mengenausgleichsregelung, Integratorinhalte" SWORD InjMass 1 100 -327.6800 327.6700 ECU_ADDRESS 0xC000BCDC /end MEASUREMENT
/begin MEASUREMENT FBC_qIntegrator_mp03 "Ausgangsmenge der Mengenausgleichsregelung, Integratorinhalte" SWORD InjMass 1 100 -327.6800 327.6700 ECU_ADDRESS 0xC000BCDE /end MEASUREMENT
/begin MEASUREMENT FBC_qIntegrator_mp04 "Ausgangsmenge der Mengenausgleichsregelung, Integratorinhalte" SWORD InjMass 1 100 -327.6800 327.6700 ECU_ADDRESS 0xC000BCE0 /end MEASUREMENT
/begin MEASUREMENT FBC_qIntegrator_mp05 "Ausgangsmenge der Mengenausgleichsregelung, Integratorinhalte" SWORD InjMass 1 100 -327.6800 327.6700 ECU_ADDRESS 0xC000BCE2 /end MEASUREMENT
/begin MEASUREMENT FBC_stBufSubSeg_mp00 "Rückgabewerte der Funktion EpmHCrS_GetBufSegFBC für FBC-Teilsegmente" UBYTE OneToOne 1 100 0.00 255.0 ECU_ADDRESS 0xC000BD88 /end MEASUREMENT
/begin MEASUREMENT FBC_stBufSubSeg_mp01 "Rückgabewerte der Funktion EpmHCrS_GetBufSegFBC für FBC-Teilsegmente" UBYTE OneToOne 1 100 0.00 255.0 ECU_ADDRESS 0xC000BD89 /end MEASUREMENT
/begin MEASUREMENT FBC_stBufSubSeg_mp02 "Rückgabewerte der Funktion EpmHCrS_GetBufSegFBC für FBC-Teilsegmente" UBYTE OneToOne 1 100 0.00 255.0 ECU_ADDRESS 0xC000BD8A /end MEASUREMENT
/begin MEASUREMENT FBC_stBufSubSeg_mp03 "Rückgabewerte der Funktion EpmHCrS_GetBufSegFBC für FBC-Teilsegmente" UBYTE OneToOne 1 100 0.00 255.0 ECU_ADDRESS 0xC000BD8B /end MEASUREMENT
/begin MEASUREMENT FBC_TSmCoef_mp00 "Koeffizienten für Mittelwertfilter" FLOAT32_IEEE OneToOne 1 100 -11.5000000 12.5000000 FORMAT "%10.7" ECU_ADDRESS 0xC000BD8C /end MEASUREMENT
/begin MEASUREMENT FBC_TSmCoef_mp01 "Koeffizienten für Mittelwertfilter" FLOAT32_IEEE OneToOne 1 100 -11.5000000 12.5000000 FORMAT "%10.7" ECU_ADDRESS 0xC000BD90 /end MEASUREMENT
/begin MEASUREMENT FMA_qMapRow0_mp00 "Kennfeldwerte für erste Mengenstützstelle (erste zeile von adaptive Kennfeld)" SWORD InjMass 1 100 -327.6800 327.6700 ECU_ADDRESS 0xC000BD94 /end MEASUREMENT
/begin MEASUREMENT FMA_qMapRow0_mp01 "Kennfeldwerte für erste Mengenstützstelle (erste zeile von adaptive Kennfeld)" SWORD InjMass 1 100 -327.6800 327.6700 ECU_ADDRESS 0xC000BD96 /end MEASUREMENT
/begin MEASUREMENT FMA_qMapRow0_mp02 "Kennfeldwerte für erste Mengenstützstelle (erste zeile von adaptive Kennfeld)" SWORD InjMass 1 100 -327.6800 327.6700 ECU_ADDRESS 0xC000BD98 /end MEASUREMENT
/begin MEASUREMENT FMA_qMapRow0_mp03 "Kennfeldwerte für erste Mengenstützstelle (erste zeile von adaptive Kennfeld)" SWORD InjMass 1 100 -327.6800 327.6700 ECU_ADDRESS 0xC000BD9A /end MEASUREMENT
/begin MEASUREMENT FMA_qMapRow0_mp04 "Kennfeldwerte für erste Mengenstützstelle (erste zeile von adaptive Kennfeld)" SWORD InjMass 1 100 -327.6800 327.6700 ECU_ADDRESS 0xC000BD9C /end MEASUREMENT
/begin MEASUREMENT FMA_qMapRow0_mp05 "Kennfeldwerte für erste Mengenstützstelle (erste zeile von adaptive Kennfeld)" SWORD InjMass 1 100 -327.6800 327.6700 ECU_ADDRESS 0xC000BD9E /end MEASUREMENT
/begin MEASUREMENT FMA_qMapRow0_mp06 "Kennfeldwerte für erste Mengenstützstelle (erste zeile von adaptive Kennfeld)" SWORD InjMass 1 100 -327.6800 327.6700 ECU_ADDRESS 0xC000BDA0 /end MEASUREMENT
/begin MEASUREMENT FMA_qMapRow0_mp07 "Kennfeldwerte für erste Mengenstützstelle (erste zeile von adaptive Kennfeld)" SWORD InjMass 1 100 -327.6800 327.6700 ECU_ADDRESS 0xC000BDA2 /end MEASUREMENT
/begin MEASUREMENT FMA_qMapRow1_mp00 "Kennfeldwerte für zweite Mengenstützstelle (zweite zeile von adaptive Kennfeld)" SWORD InjMass 1 100 -327.6800 327.6700 ECU_ADDRESS 0xC000BDA4 /end MEASUREMENT
/begin MEASUREMENT FMA_qMapRow1_mp01 "Kennfeldwerte für zweite Mengenstützstelle (zweite zeile von adaptive Kennfeld)" SWORD InjMass 1 100 -327.6800 327.6700 ECU_ADDRESS 0xC000BDA6 /end MEASUREMENT
/begin MEASUREMENT FMA_qMapRow1_mp02 "Kennfeldwerte für zweite Mengenstützstelle (zweite zeile von adaptive Kennfeld)" SWORD InjMass 1 100 -327.6800 327.6700 ECU_ADDRESS 0xC000BDA8 /end MEASUREMENT
/begin MEASUREMENT FMA_qMapRow1_mp03 "Kennfeldwerte für zweite Mengenstützstelle (zweite zeile von adaptive Kennfeld)" SWORD InjMass 1 100 -327.6800 327.6700 ECU_ADDRESS 0xC000BDAA /end MEASUREMENT
/begin MEASUREMENT FMA_qMapRow1_mp04 "Kennfeldwerte für zweite Mengenstützstelle (zweite zeile von adaptive Kennfeld)" SWORD InjMass 1 100 -327.6800 327.6700 ECU_ADDRESS 0xC000BDAC /end MEASUREMENT
/begin MEASUREMENT FMA_qMapRow1_mp05 "Kennfeldwerte für zweite Mengenstützstelle (zweite zeile von adaptive Kennfeld)" SWORD InjMass 1 100 -327.6800 327.6700 ECU_ADDRESS 0xC000BDAE /end MEASUREMENT
/begin MEASUREMENT FMA_qMapRow1_mp06 "Kennfeldwerte für zweite Mengenstützstelle (zweite zeile von adaptive Kennfeld)" SWORD InjMass 1 100 -327.6800 327.6700 ECU_ADDRESS 0xC000BDB0 /end MEASUREMENT
/begin MEASUREMENT FMA_qMapRow1_mp07 "Kennfeldwerte für zweite Mengenstützstelle (zweite zeile von adaptive Kennfeld)" SWORD InjMass 1 100 -327.6800 327.6700 ECU_ADDRESS 0xC000BDB2 /end MEASUREMENT
/begin MEASUREMENT FMA_qMapRow2_mp00 "Kennfeldwerte für dritte Mengenstützstelle (dritte zeile von adaptive Kennfeld)" SWORD InjMass 1 100 -327.6800 327.6700 ECU_ADDRESS 0xC000BDB4 /end MEASUREMENT
/begin MEASUREMENT FMA_qMapRow2_mp01 "Kennfeldwerte für dritte Mengenstützstelle (dritte zeile von adaptive Kennfeld)" SWORD InjMass 1 100 -327.6800 327.6700 ECU_ADDRESS 0xC000BDB6 /end MEASUREMENT
/begin MEASUREMENT FMA_qMapRow2_mp02 "Kennfeldwerte für dritte Mengenstützstelle (dritte zeile von adaptive Kennfeld)" SWORD InjMass 1 100 -327.6800 327.6700 ECU_ADDRESS 0xC000BDB8 /end MEASUREMENT
/begin MEASUREMENT FMA_qMapRow2_mp03 "Kennfeldwerte für dritte Mengenstützstelle (dritte zeile von adaptive Kennfeld)" SWORD InjMass 1 100 -327.6800 327.6700 ECU_ADDRESS 0xC000BDBA /end MEASUREMENT
/begin MEASUREMENT FMA_qMapRow2_mp04 "Kennfeldwerte für dritte Mengenstützstelle (dritte zeile von adaptive Kennfeld)" SWORD InjMass 1 100 -327.6800 327.6700 ECU_ADDRESS 0xC000BDBC /end MEASUREMENT
/begin MEASUREMENT FMA_qMapRow2_mp05 "Kennfeldwerte für dritte Mengenstützstelle (dritte zeile von adaptive Kennfeld)" SWORD InjMass 1 100 -327.6800 327.6700 ECU_ADDRESS 0xC000BDBE /end MEASUREMENT
/begin MEASUREMENT FMA_qMapRow2_mp06 "Kennfeldwerte für dritte Mengenstützstelle (dritte zeile von adaptive Kennfeld)" SWORD InjMass 1 100 -327.6800 327.6700 ECU_ADDRESS 0xC000BDC0 /end MEASUREMENT
/begin MEASUREMENT FMA_qMapRow2_mp07 "Kennfeldwerte für dritte Mengenstützstelle (dritte zeile von adaptive Kennfeld)" SWORD InjMass 1 100 -327.6800 327.6700 ECU_ADDRESS 0xC000BDC2 /end MEASUREMENT
/begin MEASUREMENT FMA_qMapRow3_mp00 "Kennfeldwerte für vierte Mengenstützstelle (vierte zeile von adaptive Kennfeld)" SWORD InjMass 1 100 -327.6800 327.6700 ECU_ADDRESS 0xC000BDC4 /end MEASUREMENT
/begin MEASUREMENT FMA_qMapRow3_mp01 "Kennfeldwerte für vierte Mengenstützstelle (vierte zeile von adaptive Kennfeld)" SWORD InjMass 1 100 -327.6800 327.6700 ECU_ADDRESS 0xC000BDC6 /end MEASUREMENT
/begin MEASUREMENT FMA_qMapRow3_mp02 "Kennfeldwerte für vierte Mengenstützstelle (vierte zeile von adaptive Kennfeld)" SWORD InjMass 1 100 -327.6800 327.6700 ECU_ADDRESS 0xC000BDC8 /end MEASUREMENT
/begin MEASUREMENT FMA_qMapRow3_mp03 "Kennfeldwerte für vierte Mengenstützstelle (vierte zeile von adaptive Kennfeld)" SWORD InjMass 1 100 -327.6800 327.6700 ECU_ADDRESS 0xC000BDCA /end MEASUREMENT
/begin MEASUREMENT FMA_qMapRow3_mp04 "Kennfeldwerte für vierte Mengenstützstelle (vierte zeile von adaptive Kennfeld)" SWORD InjMass 1 100 -327.6800 327.6700 ECU_ADDRESS 0xC000BDCC /end MEASUREMENT
/begin MEASUREMENT FMA_qMapRow3_mp05 "Kennfeldwerte für vierte Mengenstützstelle (vierte zeile von adaptive Kennfeld)" SWORD InjMass 1 100 -327.6800 327.6700 ECU_ADDRESS 0xC000BDCE /end MEASUREMENT
/begin MEASUREMENT FMA_qMapRow3_mp06 "Kennfeldwerte für vierte Mengenstützstelle (vierte zeile von adaptive Kennfeld)" SWORD InjMass 1 100 -327.6800 327.6700 ECU_ADDRESS 0xC000BDD0 /end MEASUREMENT
/begin MEASUREMENT FMA_qMapRow3_mp07 "Kennfeldwerte für vierte Mengenstützstelle (vierte zeile von adaptive Kennfeld)" SWORD InjMass 1 100 -327.6800 327.6700 ECU_ADDRESS 0xC000BDD2 /end MEASUREMENT
/begin MEASUREMENT FMA_qMapRow4_mp00 "Kennfeldwerte für fünfte Mengenstützstelle (fünfte zeile von adaptive Kennfeld)" SWORD InjMass 1 100 -327.6800 327.6700 ECU_ADDRESS 0xC000BDD4 /end MEASUREMENT
/begin MEASUREMENT FMA_qMapRow4_mp01 "Kennfeldwerte für fünfte Mengenstützstelle (fünfte zeile von adaptive Kennfeld)" SWORD InjMass 1 100 -327.6800 327.6700 ECU_ADDRESS 0xC000BDD6 /end MEASUREMENT
/begin MEASUREMENT FMA_qMapRow4_mp02 "Kennfeldwerte für fünfte Mengenstützstelle (fünfte zeile von adaptive Kennfeld)" SWORD InjMass 1 100 -327.6800 327.6700 ECU_ADDRESS 0xC000BDD8 /end MEASUREMENT
/begin MEASUREMENT FMA_qMapRow4_mp03 "Kennfeldwerte für fünfte Mengenstützstelle (fünfte zeile von adaptive Kennfeld)" SWORD InjMass 1 100 -327.6800 327.6700 ECU_ADDRESS 0xC000BDDA /end MEASUREMENT
/begin MEASUREMENT FMA_qMapRow4_mp04 "Kennfeldwerte für fünfte Mengenstützstelle (fünfte zeile von adaptive Kennfeld)" SWORD InjMass 1 100 -327.6800 327.6700 ECU_ADDRESS 0xC000BDDC /end MEASUREMENT
/begin MEASUREMENT FMA_qMapRow4_mp05 "Kennfeldwerte für fünfte Mengenstützstelle (fünfte zeile von adaptive Kennfeld)" SWORD InjMass 1 100 -327.6800 327.6700 ECU_ADDRESS 0xC000BDDE /end MEASUREMENT
/begin MEASUREMENT FMA_qMapRow4_mp06 "Kennfeldwerte für fünfte Mengenstützstelle (fünfte zeile von adaptive Kennfeld)" SWORD InjMass 1 100 -327.6800 327.6700 ECU_ADDRESS 0xC000BDE0 /end MEASUREMENT
/begin MEASUREMENT FMA_qMapRow4_mp07 "Kennfeldwerte für fünfte Mengenstützstelle (fünfte zeile von adaptive Kennfeld)" SWORD InjMass 1 100 -327.6800 327.6700 ECU_ADDRESS 0xC000BDE2 /end MEASUREMENT
/begin MEASUREMENT FMA_qMapRow5_mp00 "Kennfeldwerte für sechste Mengenstützstelle (sechste zeile von adaptive Kennfeld)" SWORD InjMass 1 100 -327.6800 327.6700 ECU_ADDRESS 0xC000BDE4 /end MEASUREMENT
/begin MEASUREMENT FMA_qMapRow5_mp01 "Kennfeldwerte für sechste Mengenstützstelle (sechste zeile von adaptive Kennfeld)" SWORD InjMass 1 100 -327.6800 327.6700 ECU_ADDRESS 0xC000BDE6 /end MEASUREMENT
/begin MEASUREMENT FMA_qMapRow5_mp02 "Kennfeldwerte für sechste Mengenstützstelle (sechste zeile von adaptive Kennfeld)" SWORD InjMass 1 100 -327.6800 327.6700 ECU_ADDRESS 0xC000BDE8 /end MEASUREMENT
/begin MEASUREMENT FMA_qMapRow5_mp03 "Kennfeldwerte für sechste Mengenstützstelle (sechste zeile von adaptive Kennfeld)" SWORD InjMass 1 100 -327.6800 327.6700 ECU_ADDRESS 0xC000BDEA /end MEASUREMENT
/begin MEASUREMENT FMA_qMapRow5_mp04 "Kennfeldwerte für sechste Mengenstützstelle (sechste zeile von adaptive Kennfeld)" SWORD InjMass 1 100 -327.6800 327.6700 ECU_ADDRESS 0xC000BDEC /end MEASUREMENT
/begin MEASUREMENT FMA_qMapRow5_mp05 "Kennfeldwerte für sechste Mengenstützstelle (sechste zeile von adaptive Kennfeld)" SWORD InjMass 1 100 -327.6800 327.6700 ECU_ADDRESS 0xC000BDEE /end MEASUREMENT
/begin MEASUREMENT FMA_qMapRow5_mp06 "Kennfeldwerte für sechste Mengenstützstelle (sechste zeile von adaptive Kennfeld)" SWORD InjMass 1 100 -327.6800 327.6700 ECU_ADDRESS 0xC000BDF0 /end MEASUREMENT
/begin MEASUREMENT FMA_qMapRow5_mp07 "Kennfeldwerte für sechste Mengenstützstelle (sechste zeile von adaptive Kennfeld)" SWORD InjMass 1 100 -327.6800 327.6700 ECU_ADDRESS 0xC000BDF2 /end MEASUREMENT
/begin MEASUREMENT FMA_qMapRow6_mp00 "Kennfeldwerte für siebte Mengenstützstelle (siebte zeile von adaptive Kennfeld)" SWORD InjMass 1 100 -327.6800 327.6700 ECU_ADDRESS 0xC000BDF4 /end MEASUREMENT
/begin MEASUREMENT FMA_qMapRow6_mp01 "Kennfeldwerte für siebte Mengenstützstelle (siebte zeile von adaptive Kennfeld)" SWORD InjMass 1 100 -327.6800 327.6700 ECU_ADDRESS 0xC000BDF6 /end MEASUREMENT
/begin MEASUREMENT FMA_qMapRow6_mp02 "Kennfeldwerte für siebte Mengenstützstelle (siebte zeile von adaptive Kennfeld)" SWORD InjMass 1 100 -327.6800 327.6700 ECU_ADDRESS 0xC000BDF8 /end MEASUREMENT
/begin MEASUREMENT FMA_qMapRow6_mp03 "Kennfeldwerte für siebte Mengenstützstelle (siebte zeile von adaptive Kennfeld)" SWORD InjMass 1 100 -327.6800 327.6700 ECU_ADDRESS 0xC000BDFA /end MEASUREMENT
/begin MEASUREMENT FMA_qMapRow6_mp04 "Kennfeldwerte für siebte Mengenstützstelle (siebte zeile von adaptive Kennfeld)" SWORD InjMass 1 100 -327.6800 327.6700 ECU_ADDRESS 0xC000BDFC /end MEASUREMENT
/begin MEASUREMENT FMA_qMapRow6_mp05 "Kennfeldwerte für siebte Mengenstützstelle (siebte zeile von adaptive Kennfeld)" SWORD InjMass 1 100 -327.6800 327.6700 ECU_ADDRESS 0xC000BDFE /end MEASUREMENT
/begin MEASUREMENT FMA_qMapRow6_mp06 "Kennfeldwerte für siebte Mengenstützstelle (siebte zeile von adaptive Kennfeld)" SWORD InjMass 1 100 -327.6800 327.6700 ECU_ADDRESS 0xC000BE00 /end MEASUREMENT
/begin MEASUREMENT FMA_qMapRow6_mp07 "Kennfeldwerte für siebte Mengenstützstelle (siebte zeile von adaptive Kennfeld)" SWORD InjMass 1 100 -327.6800 327.6700 ECU_ADDRESS 0xC000BE02 /end MEASUREMENT
/begin MEASUREMENT FMA_qMapRow7_mp00 "Kennfeldwerte für achte Mengenstützstelle (achte zeile von adaptive Kennfeld)" SWORD InjMass 1 100 -327.6800 327.6700 ECU_ADDRESS 0xC000BE04 /end MEASUREMENT
/begin MEASUREMENT FMA_qMapRow7_mp01 "Kennfeldwerte für achte Mengenstützstelle (achte zeile von adaptive Kennfeld)" SWORD InjMass 1 100 -327.6800 327.6700 ECU_ADDRESS 0xC000BE06 /end MEASUREMENT
/begin MEASUREMENT FMA_qMapRow7_mp02 "Kennfeldwerte für achte Mengenstützstelle (achte zeile von adaptive Kennfeld)" SWORD InjMass 1 100 -327.6800 327.6700 ECU_ADDRESS 0xC000BE08 /end MEASUREMENT
/begin MEASUREMENT FMA_qMapRow7_mp03 "Kennfeldwerte für achte Mengenstützstelle (achte zeile von adaptive Kennfeld)" SWORD InjMass 1 100 -327.6800 327.6700 ECU_ADDRESS 0xC000BE0A /end MEASUREMENT
/begin MEASUREMENT FMA_qMapRow7_mp04 "Kennfeldwerte für achte Mengenstützstelle (achte zeile von adaptive Kennfeld)" SWORD InjMass 1 100 -327.6800 327.6700 ECU_ADDRESS 0xC000BE0C /end MEASUREMENT
/begin MEASUREMENT FMA_qMapRow7_mp05 "Kennfeldwerte für achte Mengenstützstelle (achte zeile von adaptive Kennfeld)" SWORD InjMass 1 100 -327.6800 327.6700 ECU_ADDRESS 0xC000BE0E /end MEASUREMENT
/begin MEASUREMENT FMA_qMapRow7_mp06 "Kennfeldwerte für achte Mengenstützstelle (achte zeile von adaptive Kennfeld)" SWORD InjMass 1 100 -327.6800 327.6700 ECU_ADDRESS 0xC000BE10 /end MEASUREMENT
/begin MEASUREMENT FMA_qMapRow7_mp07 "Kennfeldwerte für achte Mengenstützstelle (achte zeile von adaptive Kennfeld)" SWORD InjMass 1 100 -327.6800 327.6700 ECU_ADDRESS 0xC000BE12 /end MEASUREMENT
/begin MEASUREMENT Gen_arrayerr_nv00 "Hier könnte Ihr Langbezeichner stehen" UBYTE Def_st_ub_q1 1 100 0.00 255. FORMAT "%3.0" ECU_ADDRESS 0xC000BA94 /end MEASUREMENT
/begin MEASUREMENT Gen_arrayerr_nv01 "Hier könnte Ihr Langbezeichner stehen" UBYTE Def_st_ub_q1 1 100 0.00 255. FORMAT "%3.0" ECU_ADDRESS 0xC000BA95 /end MEASUREMENT
/begin MEASUREMENT Gen_arrayerr_nv02 "Hier könnte Ihr Langbezeichner stehen" UBYTE Def_st_ub_q1 1 100 0.00 255. FORMAT "%3.0" ECU_ADDRESS 0xC000BA96 /end MEASUREMENT
/begin MEASUREMENT Gen_arrayerr_nv03 "Hier könnte Ihr Langbezeichner stehen" UBYTE Def_st_ub_q1 1 100 0.00 255. FORMAT "%3.0" ECU_ADDRESS 0xC000BA97 /end MEASUREMENT
/begin MEASUREMENT Gen_arrayerr_nv04 "Hier könnte Ihr Langbezeichner stehen" UBYTE Def_st_ub_q1 1 100 0.00 255. FORMAT "%3.0" ECU_ADDRESS 0xC000BA98 /end MEASUREMENT
/begin MEASUREMENT Gen_arrayerr_nv05 "Hier könnte Ihr Langbezeichner stehen" UBYTE Def_st_ub_q1 1 100 0.00 255. FORMAT "%3.0" ECU_ADDRESS 0xC000BA99 /end MEASUREMENT
/begin MEASUREMENT Gen_arrayerr_nv06 "Hier könnte Ihr Langbezeichner stehen" UBYTE Def_st_ub_q1 1 100 0.00 255. FORMAT "%3.0" ECU_ADDRESS 0xC000BA9A /end MEASUREMENT
/begin MEASUREMENT Gen_arrayerr_nv07 "Hier könnte Ihr Langbezeichner stehen" UBYTE Def_st_ub_q1 1 100 0.00 255. FORMAT "%3.0" ECU_ADDRESS 0xC000BA9B /end MEASUREMENT
/begin MEASUREMENT Gen_arrayerr_nv08 "Hier könnte Ihr Langbezeichner stehen" UBYTE Def_st_ub_q1 1 100 0.00 255. FORMAT "%3.0" ECU_ADDRESS 0xC000BA9C /end MEASUREMENT
/begin MEASUREMENT Gen_arrayerr_nv09 "Hier könnte Ihr Langbezeichner stehen" UBYTE Def_st_ub_q1 1 100 0.00 255. FORMAT "%3.0" ECU_ADDRESS 0xC000BA9D /end MEASUREMENT
/begin MEASUREMENT Gen_arrayerr_nv10 "Hier könnte Ihr Langbezeichner stehen" UBYTE Def_st_ub_q1 1 100 0.00 255. FORMAT "%3.0" ECU_ADDRESS 0xC000BA9E /end MEASUREMENT
/begin MEASUREMENT Gen_arrayerr_nv11 "Hier könnte Ihr Langbezeichner stehen" UBYTE Def_st_ub_q1 1 100 0.00 255. FORMAT "%3.0" ECU_ADDRESS 0xC000BA9F /end MEASUREMENT
/begin MEASUREMENT Gen_arrayerr_nv12 "Hier könnte Ihr Langbezeichner stehen" UBYTE Def_st_ub_q1 1 100 0.00 255. FORMAT "%3.0" ECU_ADDRESS 0xC000BAA0 /end MEASUREMENT
/begin MEASUREMENT Gen_arrayerr_nv13 "Hier könnte Ihr Langbezeichner stehen" UBYTE Def_st_ub_q1 1 100 0.00 255. FORMAT "%3.0" ECU_ADDRESS 0xC000BAA1 /end MEASUREMENT
/begin MEASUREMENT Gen_arrayerr_nv14 "Hier könnte Ihr Langbezeichner stehen" UBYTE Def_st_ub_q1 1 100 0.00 255. FORMAT "%3.0" ECU_ADDRESS 0xC000BAA2 /end MEASUREMENT
/begin MEASUREMENT Gen_arrayerr_nv15 "Hier könnte Ihr Langbezeichner stehen" UBYTE Def_st_ub_q1 1 100 0.00 255. FORMAT "%3.0" ECU_ADDRESS 0xC000BAA3 /end MEASUREMENT
/begin MEASUREMENT Gen_arrayerr_nv16 "Hier könnte Ihr Langbezeichner stehen" UBYTE Def_st_ub_q1 1 100 0.00 255. FORMAT "%3.0" ECU_ADDRESS 0xC000BAA4 /end MEASUREMENT
/begin MEASUREMENT Gen_arrayerr_nv17 "Hier könnte Ihr Langbezeichner stehen" UBYTE Def_st_ub_q1 1 100 0.00 255. FORMAT "%3.0" ECU_ADDRESS 0xC000BAA5 /end MEASUREMENT
/begin MEASUREMENT Gen_arrayerr_nv18 "Hier könnte Ihr Langbezeichner stehen" UBYTE Def_st_ub_q1 1 100 0.00 255. FORMAT "%3.0" ECU_ADDRESS 0xC000BAA6 /end MEASUREMENT
/begin MEASUREMENT Gen_arrayerr_nv19 "Hier könnte Ihr Langbezeichner stehen" UBYTE Def_st_ub_q1 1 100 0.00 255. FORMAT "%3.0" ECU_ADDRESS 0xC000BAA7 /end MEASUREMENT
/begin MEASUREMENT Gen_arrayerr_nv20 "Hier könnte Ihr Langbezeichner stehen" UBYTE Def_st_ub_q1 1 100 0.00 255. FORMAT "%3.0" ECU_ADDRESS 0xC000BAA8 /end MEASUREMENT
/begin MEASUREMENT Gen_arrayerr_nv21 "Hier könnte Ihr Langbezeichner stehen" UBYTE Def_st_ub_q1 1 100 0.00 255. FORMAT "%3.0" ECU_ADDRESS 0xC000BAA9 /end MEASUREMENT
/begin MEASUREMENT Gen_arrayerr_nv22 "Hier könnte Ihr Langbezeichner stehen" UBYTE Def_st_ub_q1 1 100 0.00 255. FORMAT "%3.0" ECU_ADDRESS 0xC000BAAA /end MEASUREMENT
/begin MEASUREMENT Gen_arrayerr_nv23 "Hier könnte Ihr Langbezeichner stehen" UBYTE Def_st_ub_q1 1 100 0.00 255. FORMAT "%3.0" ECU_ADDRESS 0xC000BAAB /end MEASUREMENT
/begin MEASUREMENT Gen_arrayerr_nv24 "Hier könnte Ihr Langbezeichner stehen" UBYTE Def_st_ub_q1 1 100 0.00 255. FORMAT "%3.0" ECU_ADDRESS 0xC000BAAC /end MEASUREMENT
/begin MEASUREMENT Gen_arrayerr_nv25 "Hier könnte Ihr Langbezeichner stehen" UBYTE Def_st_ub_q1 1 100 0.00 255. FORMAT "%3.0" ECU_ADDRESS 0xC000BAAD /end MEASUREMENT
/begin MEASUREMENT Gen_arrayerr_nv26 "Hier könnte Ihr Langbezeichner stehen" UBYTE Def_st_ub_q1 1 100 0.00 255. FORMAT "%3.0" ECU_ADDRESS 0xC000BAAE /end MEASUREMENT
/begin MEASUREMENT Gen_arrayerr_nv27 "Hier könnte Ihr Langbezeichner stehen" UBYTE Def_st_ub_q1 1 100 0.00 255. FORMAT "%3.0" ECU_ADDRESS 0xC000BAAF /end MEASUREMENT
/begin MEASUREMENT Gen_arrayerr_nv28 "Hier könnte Ihr Langbezeichner stehen" UBYTE Def_st_ub_q1 1 100 0.00 255. FORMAT "%3.0" ECU_ADDRESS 0xC000BAB0 /end MEASUREMENT
/begin MEASUREMENT Gen_arrayerr_nv29 "Hier könnte Ihr Langbezeichner stehen" UBYTE Def_st_ub_q1 1 100 0.00 255. FORMAT "%3.0" ECU_ADDRESS 0xC000BAB1 /end MEASUREMENT
/begin MEASUREMENT Gen_arrayierrg_nv00 "Hier könnte Ihr Langbezeichner stehen" UBYTE Def_i_ub_q0p125 1 100 0.00 31.875 ECU_ADDRESS 0xC000BAB2 /end MEASUREMENT
/begin MEASUREMENT Gen_arrayierrg_nv01 "Hier könnte Ihr Langbezeichner stehen" UBYTE Def_i_ub_q0p125 1 100 0.00 31.875 ECU_ADDRESS 0xC000BAB3 /end MEASUREMENT
/begin MEASUREMENT Gen_arrayierrg_nv02 "Hier könnte Ihr Langbezeichner stehen" UBYTE Def_i_ub_q0p125 1 100 0.00 31.875 ECU_ADDRESS 0xC000BAB4 /end MEASUREMENT
/begin MEASUREMENT Gen_arrayierrg_nv03 "Hier könnte Ihr Langbezeichner stehen" UBYTE Def_i_ub_q0p125 1 100 0.00 31.875 ECU_ADDRESS 0xC000BAB5 /end MEASUREMENT
/begin MEASUREMENT Gen_arrayierrg_nv04 "Hier könnte Ihr Langbezeichner stehen" UBYTE Def_i_ub_q0p125 1 100 0.00 31.875 ECU_ADDRESS 0xC000BAB6 /end MEASUREMENT
/begin MEASUREMENT Gen_arrayierrg_nv05 "Hier könnte Ihr Langbezeichner stehen" UBYTE Def_i_ub_q0p125 1 100 0.00 31.875 ECU_ADDRESS 0xC000BAB7 /end MEASUREMENT
/begin MEASUREMENT Gen_arrayierrg_nv06 "Hier könnte Ihr Langbezeichner stehen" UBYTE Def_i_ub_q0p125 1 100 0.00 31.875 ECU_ADDRESS 0xC000BAB8 /end MEASUREMENT
/begin MEASUREMENT Gen_arrayierrg_nv07 "Hier könnte Ihr Langbezeichner stehen" UBYTE Def_i_ub_q0p125 1 100 0.00 31.875 ECU_ADDRESS 0xC000BAB9 /end MEASUREMENT
/begin MEASUREMENT Gen_arrayierrg_nv08 "Hier könnte Ihr Langbezeichner stehen" UBYTE Def_i_ub_q0p125 1 100 0.00 31.875 ECU_ADDRESS 0xC000BABA /end MEASUREMENT
/begin MEASUREMENT Gen_arrayierrg_nv09 "Hier könnte Ihr Langbezeichner stehen" UBYTE Def_i_ub_q0p125 1 100 0.00 31.875 ECU_ADDRESS 0xC000BABB /end MEASUREMENT
/begin MEASUREMENT Gen_arrayierrg_nv10 "Hier könnte Ihr Langbezeichner stehen" UBYTE Def_i_ub_q0p125 1 100 0.00 31.875 ECU_ADDRESS 0xC000BABC /end MEASUREMENT
/begin MEASUREMENT Gen_arrayierrg_nv11 "Hier könnte Ihr Langbezeichner stehen" UBYTE Def_i_ub_q0p125 1 100 0.00 31.875 ECU_ADDRESS 0xC000BABD /end MEASUREMENT
/begin MEASUREMENT Gen_arrayierrg_nv12 "Hier könnte Ihr Langbezeichner stehen" UBYTE Def_i_ub_q0p125 1 100 0.00 31.875 ECU_ADDRESS 0xC000BABE /end MEASUREMENT
/begin MEASUREMENT Gen_arrayierrg_nv13 "Hier könnte Ihr Langbezeichner stehen" UBYTE Def_i_ub_q0p125 1 100 0.00 31.875 ECU_ADDRESS 0xC000BABF /end MEASUREMENT
/begin MEASUREMENT Gen_arrayierrg_nv14 "Hier könnte Ihr Langbezeichner stehen" UBYTE Def_i_ub_q0p125 1 100 0.00 31.875 ECU_ADDRESS 0xC000BAC0 /end MEASUREMENT
/begin MEASUREMENT Gen_arrayierrg_nv15 "Hier könnte Ihr Langbezeichner stehen" UBYTE Def_i_ub_q0p125 1 100 0.00 31.875 ECU_ADDRESS 0xC000BAC1 /end MEASUREMENT
/begin MEASUREMENT Gen_arrayierrg_nv16 "Hier könnte Ihr Langbezeichner stehen" UBYTE Def_i_ub_q0p125 1 100 0.00 31.875 ECU_ADDRESS 0xC000BAC2 /end MEASUREMENT
/begin MEASUREMENT Gen_arrayierrg_nv17 "Hier könnte Ihr Langbezeichner stehen" UBYTE Def_i_ub_q0p125 1 100 0.00 31.875 ECU_ADDRESS 0xC000BAC3 /end MEASUREMENT
/begin MEASUREMENT Gen_arrayierrg_nv18 "Hier könnte Ihr Langbezeichner stehen" UBYTE Def_i_ub_q0p125 1 100 0.00 31.875 ECU_ADDRESS 0xC000BAC4 /end MEASUREMENT
/begin MEASUREMENT Gen_arrayierrg_nv19 "Hier könnte Ihr Langbezeichner stehen" UBYTE Def_i_ub_q0p125 1 100 0.00 31.875 ECU_ADDRESS 0xC000BAC5 /end MEASUREMENT
/begin MEASUREMENT Gen_arrayierrg_nv20 "Hier könnte Ihr Langbezeichner stehen" UBYTE Def_i_ub_q0p125 1 100 0.00 31.875 ECU_ADDRESS 0xC000BAC6 /end MEASUREMENT
/begin MEASUREMENT Gen_arrayierrg_nv21 "Hier könnte Ihr Langbezeichner stehen" UBYTE Def_i_ub_q0p125 1 100 0.00 31.875 ECU_ADDRESS 0xC000BAC7 /end MEASUREMENT
/begin MEASUREMENT Gen_arrayierrg_nv22 "Hier könnte Ihr Langbezeichner stehen" UBYTE Def_i_ub_q0p125 1 100 0.00 31.875 ECU_ADDRESS 0xC000BAC8 /end MEASUREMENT
/begin MEASUREMENT Gen_arrayierrg_nv23 "Hier könnte Ihr Langbezeichner stehen" UBYTE Def_i_ub_q0p125 1 100 0.00 31.875 ECU_ADDRESS 0xC000BAC9 /end MEASUREMENT
/begin MEASUREMENT Gen_arrayierrg_nv24 "Hier könnte Ihr Langbezeichner stehen" UBYTE Def_i_ub_q0p125 1 100 0.00 31.875 ECU_ADDRESS 0xC000BACA /end MEASUREMENT
/begin MEASUREMENT Gen_arrayierrg_nv25 "Hier könnte Ihr Langbezeichner stehen" UBYTE Def_i_ub_q0p125 1 100 0.00 31.875 ECU_ADDRESS 0xC000BACB /end MEASUREMENT
/begin MEASUREMENT Gen_arrayierrg_nv26 "Hier könnte Ihr Langbezeichner stehen" UBYTE Def_i_ub_q0p125 1 100 0.00 31.875 ECU_ADDRESS 0xC000BACC /end MEASUREMENT
/begin MEASUREMENT Gen_arrayierrg_nv27 "Hier könnte Ihr Langbezeichner stehen" UBYTE Def_i_ub_q0p125 1 100 0.00 31.875 ECU_ADDRESS 0xC000BACD /end MEASUREMENT
/begin MEASUREMENT Gen_arrayierrg_nv28 "Hier könnte Ihr Langbezeichner stehen" UBYTE Def_i_ub_q0p125 1 100 0.00 31.875 ECU_ADDRESS 0xC000BACE /end MEASUREMENT
/begin MEASUREMENT Gen_arrayierrg_nv29 "Hier könnte Ihr Langbezeichner stehen" UBYTE Def_i_ub_q0p125 1 100 0.00 31.875 ECU_ADDRESS 0xC000BACF /end MEASUREMENT
/begin MEASUREMENT Gen_arrayub_nv00 "Hier könnte Ihr Langbezeichner stehen" UBYTE Def_u_ub_q0p1 1 100 0.00 25.50 FORMAT "%5.2" ECU_ADDRESS 0xC000BAD0 /end MEASUREMENT
/begin MEASUREMENT Gen_arrayub_nv01 "Hier könnte Ihr Langbezeichner stehen" UBYTE Def_u_ub_q0p1 1 100 0.00 25.50 FORMAT "%5.2" ECU_ADDRESS 0xC000BAD1 /end MEASUREMENT
/begin MEASUREMENT Gen_arrayub_nv02 "Hier könnte Ihr Langbezeichner stehen" UBYTE Def_u_ub_q0p1 1 100 0.00 25.50 FORMAT "%5.2" ECU_ADDRESS 0xC000BAD2 /end MEASUREMENT
/begin MEASUREMENT Gen_arrayub_nv03 "Hier könnte Ihr Langbezeichner stehen" UBYTE Def_u_ub_q0p1 1 100 0.00 25.50 FORMAT "%5.2" ECU_ADDRESS 0xC000BAD3 /end MEASUREMENT
/begin MEASUREMENT Gen_arrayub_nv04 "Hier könnte Ihr Langbezeichner stehen" UBYTE Def_u_ub_q0p1 1 100 0.00 25.50 FORMAT "%5.2" ECU_ADDRESS 0xC000BAD4 /end MEASUREMENT
/begin MEASUREMENT Gen_arrayub_nv05 "Hier könnte Ihr Langbezeichner stehen" UBYTE Def_u_ub_q0p1 1 100 0.00 25.50 FORMAT "%5.2" ECU_ADDRESS 0xC000BAD5 /end MEASUREMENT
/begin MEASUREMENT Gen_arrayub_nv06 "Hier könnte Ihr Langbezeichner stehen" UBYTE Def_u_ub_q0p1 1 100 0.00 25.50 FORMAT "%5.2" ECU_ADDRESS 0xC000BAD6 /end MEASUREMENT
/begin MEASUREMENT Gen_arrayub_nv07 "Hier könnte Ihr Langbezeichner stehen" UBYTE Def_u_ub_q0p1 1 100 0.00 25.50 FORMAT "%5.2" ECU_ADDRESS 0xC000BAD7 /end MEASUREMENT
/begin MEASUREMENT Gen_arrayub_nv08 "Hier könnte Ihr Langbezeichner stehen" UBYTE Def_u_ub_q0p1 1 100 0.00 25.50 FORMAT "%5.2" ECU_ADDRESS 0xC000BAD8 /end MEASUREMENT
/begin MEASUREMENT Gen_arrayub_nv09 "Hier könnte Ihr Langbezeichner stehen" UBYTE Def_u_ub_q0p1 1 100 0.00 25.50 FORMAT "%5.2" ECU_ADDRESS 0xC000BAD9 /end MEASUREMENT
/begin MEASUREMENT Gen_arrayub_nv10 "Hier könnte Ihr Langbezeichner stehen" UBYTE Def_u_ub_q0p1 1 100 0.00 25.50 FORMAT "%5.2" ECU_ADDRESS 0xC000BADA /end MEASUREMENT
/begin MEASUREMENT Gen_arrayub_nv11 "Hier könnte Ihr Langbezeichner stehen" UBYTE Def_u_ub_q0p1 1 100 0.00 25.50 FORMAT "%5.2" ECU_ADDRESS 0xC000BADB /end MEASUREMENT
/begin MEASUREMENT Gen_arrayub_nv12 "Hier könnte Ihr Langbezeichner stehen" UBYTE Def_u_ub_q0p1 1 100 0.00 25.50 FORMAT "%5.2" ECU_ADDRESS 0xC000BADC /end MEASUREMENT
/begin MEASUREMENT Gen_arrayub_nv13 "Hier könnte Ihr Langbezeichner stehen" UBYTE Def_u_ub_q0p1 1 100 0.00 25.50 FORMAT "%5.2" ECU_ADDRESS 0xC000BADD /end MEASUREMENT
/begin MEASUREMENT Gen_arrayub_nv14 "Hier könnte Ihr Langbezeichner stehen" UBYTE Def_u_ub_q0p1 1 100 0.00 25.50 FORMAT "%5.2" ECU_ADDRESS 0xC000BADE /end MEASUREMENT
/begin MEASUREMENT Gen_arrayub_nv15 "Hier könnte Ihr Langbezeichner stehen" UBYTE Def_u_ub_q0p1 1 100 0.00 25.50 FORMAT "%5.2" ECU_ADDRESS 0xC000BADF /end MEASUREMENT
/begin MEASUREMENT Gen_arrayub_nv16 "Hier könnte Ihr Langbezeichner stehen" UBYTE Def_u_ub_q0p1 1 100 0.00 25.50 FORMAT "%5.2" ECU_ADDRESS 0xC000BAE0 /end MEASUREMENT
/begin MEASUREMENT Gen_arrayub_nv17 "Hier könnte Ihr Langbezeichner stehen" UBYTE Def_u_ub_q0p1 1 100 0.00 25.50 FORMAT "%5.2" ECU_ADDRESS 0xC000BAE1 /end MEASUREMENT
/begin MEASUREMENT Gen_arrayub_nv18 "Hier könnte Ihr Langbezeichner stehen" UBYTE Def_u_ub_q0p1 1 100 0.00 25.50 FORMAT "%5.2" ECU_ADDRESS 0xC000BAE2 /end MEASUREMENT
/begin MEASUREMENT Gen_arrayub_nv19 "Hier könnte Ihr Langbezeichner stehen" UBYTE Def_u_ub_q0p1 1 100 0.00 25.50 FORMAT "%5.2" ECU_ADDRESS 0xC000BAE3 /end MEASUREMENT
/begin MEASUREMENT Gen_arrayub_nv20 "Hier könnte Ihr Langbezeichner stehen" UBYTE Def_u_ub_q0p1 1 100 0.00 25.50 FORMAT "%5.2" ECU_ADDRESS 0xC000BAE4 /end MEASUREMENT
/begin MEASUREMENT Gen_arrayub_nv21 "Hier könnte Ihr Langbezeichner stehen" UBYTE Def_u_ub_q0p1 1 100 0.00 25.50 FORMAT "%5.2" ECU_ADDRESS 0xC000BAE5 /end MEASUREMENT
/begin MEASUREMENT Gen_arrayub_nv22 "Hier könnte Ihr Langbezeichner stehen" UBYTE Def_u_ub_q0p1 1 100 0.00 25.50 FORMAT "%5.2" ECU_ADDRESS 0xC000BAE6 /end MEASUREMENT
/begin MEASUREMENT Gen_arrayub_nv23 "Hier könnte Ihr Langbezeichner stehen" UBYTE Def_u_ub_q0p1 1 100 0.00 25.50 FORMAT "%5.2" ECU_ADDRESS 0xC000BAE7 /end MEASUREMENT
/begin MEASUREMENT Gen_arrayub_nv24 "Hier könnte Ihr Langbezeichner stehen" UBYTE Def_u_ub_q0p1 1 100 0.00 25.50 FORMAT "%5.2" ECU_ADDRESS 0xC000BAE8 /end MEASUREMENT
/begin MEASUREMENT Gen_arrayub_nv25 "Hier könnte Ihr Langbezeichner stehen" UBYTE Def_u_ub_q0p1 1 100 0.00 25.50 FORMAT "%5.2" ECU_ADDRESS 0xC000BAE9 /end MEASUREMENT
/begin MEASUREMENT Gen_arrayub_nv26 "Hier könnte Ihr Langbezeichner stehen" UBYTE Def_u_ub_q0p1 1 100 0.00 25.50 FORMAT "%5.2" ECU_ADDRESS 0xC000BAEA /end MEASUREMENT
/begin MEASUREMENT Gen_arrayub_nv27 "Hier könnte Ihr Langbezeichner stehen" UBYTE Def_u_ub_q0p1 1 100 0.00 25.50 FORMAT "%5.2" ECU_ADDRESS 0xC000BAEB /end MEASUREMENT
/begin MEASUREMENT Gen_arrayub_nv28 "Hier könnte Ihr Langbezeichner stehen" UBYTE Def_u_ub_q0p1 1 100 0.00 25.50 FORMAT "%5.2" ECU_ADDRESS 0xC000BAEC /end MEASUREMENT
/begin MEASUREMENT Gen_arrayub_nv29 "Hier könnte Ihr Langbezeichner stehen" UBYTE Def_u_ub_q0p1 1 100 0.00 25.50 FORMAT "%5.2" ECU_ADDRESS 0xC000BAED /end MEASUREMENT
/begin MEASUREMENT Gen_arrayugen_nv00 "Hier könnte Ihr Langbezeichner stehen" UBYTE Def_u_ub_q0p1 1 100 0.00 25.50 FORMAT "%5.2" ECU_ADDRESS 0xC000BAEE /end MEASUREMENT
/begin MEASUREMENT Gen_arrayugen_nv01 "Hier könnte Ihr Langbezeichner stehen" UBYTE Def_u_ub_q0p1 1 100 0.00 25.50 FORMAT "%5.2" ECU_ADDRESS 0xC000BAEF /end MEASUREMENT
/begin MEASUREMENT Gen_arrayugen_nv02 "Hier könnte Ihr Langbezeichner stehen" UBYTE Def_u_ub_q0p1 1 100 0.00 25.50 FORMAT "%5.2" ECU_ADDRESS 0xC000BAF0 /end MEASUREMENT
/begin MEASUREMENT Gen_arrayugen_nv03 "Hier könnte Ihr Langbezeichner stehen" UBYTE Def_u_ub_q0p1 1 100 0.00 25.50 FORMAT "%5.2" ECU_ADDRESS 0xC000BAF1 /end MEASUREMENT
/begin MEASUREMENT Gen_arrayugen_nv04 "Hier könnte Ihr Langbezeichner stehen" UBYTE Def_u_ub_q0p1 1 100 0.00 25.50 FORMAT "%5.2" ECU_ADDRESS 0xC000BAF2 /end MEASUREMENT
/begin MEASUREMENT Gen_arrayugen_nv05 "Hier könnte Ihr Langbezeichner stehen" UBYTE Def_u_ub_q0p1 1 100 0.00 25.50 FORMAT "%5.2" ECU_ADDRESS 0xC000BAF3 /end MEASUREMENT
/begin MEASUREMENT Gen_arrayugen_nv06 "Hier könnte Ihr Langbezeichner stehen" UBYTE Def_u_ub_q0p1 1 100 0.00 25.50 FORMAT "%5.2" ECU_ADDRESS 0xC000BAF4 /end MEASUREMENT
/begin MEASUREMENT Gen_arrayugen_nv07 "Hier könnte Ihr Langbezeichner stehen" UBYTE Def_u_ub_q0p1 1 100 0.00 25.50 FORMAT "%5.2" ECU_ADDRESS 0xC000BAF5 /end MEASUREMENT
/begin MEASUREMENT Gen_arrayugen_nv08 "Hier könnte Ihr Langbezeichner stehen" UBYTE Def_u_ub_q0p1 1 100 0.00 25.50 FORMAT "%5.2" ECU_ADDRESS 0xC000BAF6 /end MEASUREMENT
/begin MEASUREMENT Gen_arrayugen_nv09 "Hier könnte Ihr Langbezeichner stehen" UBYTE Def_u_ub_q0p1 1 100 0.00 25.50 FORMAT "%5.2" ECU_ADDRESS 0xC000BAF7 /end MEASUREMENT
/begin MEASUREMENT Gen_arrayugen_nv10 "Hier könnte Ihr Langbezeichner stehen" UBYTE Def_u_ub_q0p1 1 100 0.00 25.50 FORMAT "%5.2" ECU_ADDRESS 0xC000BAF8 /end MEASUREMENT
/begin MEASUREMENT Gen_arrayugen_nv11 "Hier könnte Ihr Langbezeichner stehen" UBYTE Def_u_ub_q0p1 1 100 0.00 25.50 FORMAT "%5.2" ECU_ADDRESS 0xC000BAF9 /end MEASUREMENT
/begin MEASUREMENT Gen_arrayugen_nv12 "Hier könnte Ihr Langbezeichner stehen" UBYTE Def_u_ub_q0p1 1 100 0.00 25.50 FORMAT "%5.2" ECU_ADDRESS 0xC000BAFA /end MEASUREMENT
/begin MEASUREMENT Gen_arrayugen_nv13 "Hier könnte Ihr Langbezeichner stehen" UBYTE Def_u_ub_q0p1 1 100 0.00 25.50 FORMAT "%5.2" ECU_ADDRESS 0xC000BAFB /end MEASUREMENT
/begin MEASUREMENT Gen_arrayugen_nv14 "Hier könnte Ihr Langbezeichner stehen" UBYTE Def_u_ub_q0p1 1 100 0.00 25.50 FORMAT "%5.2" ECU_ADDRESS 0xC000BAFC /end MEASUREMENT
/begin MEASUREMENT Gen_arrayugen_nv15 "Hier könnte Ihr Langbezeichner stehen" UBYTE Def_u_ub_q0p1 1 100 0.00 25.50 FORMAT "%5.2" ECU_ADDRESS 0xC000BAFD /end MEASUREMENT
/begin MEASUREMENT Gen_arrayugen_nv16 "Hier könnte Ihr Langbezeichner stehen" UBYTE Def_u_ub_q0p1 1 100 0.00 25.50 FORMAT "%5.2" ECU_ADDRESS 0xC000BAFE /end MEASUREMENT
/begin MEASUREMENT Gen_arrayugen_nv17 "Hier könnte Ihr Langbezeichner stehen" UBYTE Def_u_ub_q0p1 1 100 0.00 25.50 FORMAT "%5.2" ECU_ADDRESS 0xC000BAFF /end MEASUREMENT
/begin MEASUREMENT Gen_arrayugen_nv18 "Hier könnte Ihr Langbezeichner stehen" UBYTE Def_u_ub_q0p1 1 100 0.00 25.50 FORMAT "%5.2" ECU_ADDRESS 0xC000BB00 /end MEASUREMENT
/begin MEASUREMENT Gen_arrayugen_nv19 "Hier könnte Ihr Langbezeichner stehen" UBYTE Def_u_ub_q0p1 1 100 0.00 25.50 FORMAT "%5.2" ECU_ADDRESS 0xC000BB01 /end MEASUREMENT
/begin MEASUREMENT Gen_arrayugen_nv20 "Hier könnte Ihr Langbezeichner stehen" UBYTE Def_u_ub_q0p1 1 100 0.00 25.50 FORMAT "%5.2" ECU_ADDRESS 0xC000BB02 /end MEASUREMENT
/begin MEASUREMENT Gen_arrayugen_nv21 "Hier könnte Ihr Langbezeichner stehen" UBYTE Def_u_ub_q0p1 1 100 0.00 25.50 FORMAT "%5.2" ECU_ADDRESS 0xC000BB03 /end MEASUREMENT
/begin MEASUREMENT Gen_arrayugen_nv22 "Hier könnte Ihr Langbezeichner stehen" UBYTE Def_u_ub_q0p1 1 100 0.00 25.50 FORMAT "%5.2" ECU_ADDRESS 0xC000BB04 /end MEASUREMENT
/begin MEASUREMENT Gen_arrayugen_nv23 "Hier könnte Ihr Langbezeichner stehen" UBYTE Def_u_ub_q0p1 1 100 0.00 25.50 FORMAT "%5.2" ECU_ADDRESS 0xC000BB05 /end MEASUREMENT
/begin MEASUREMENT Gen_arrayugen_nv24 "Hier könnte Ihr Langbezeichner stehen" UBYTE Def_u_ub_q0p1 1 100 0.00 25.50 FORMAT "%5.2" ECU_ADDRESS 0xC000BB06 /end MEASUREMENT
/begin MEASUREMENT Gen_arrayugen_nv25 "Hier könnte Ihr Langbezeichner stehen" UBYTE Def_u_ub_q0p1 1 100 0.00 25.50 FORMAT "%5.2" ECU_ADDRESS 0xC000BB07 /end MEASUREMENT
/begin MEASUREMENT Gen_arrayugen_nv26 "Hier könnte Ihr Langbezeichner stehen" UBYTE Def_u_ub_q0p1 1 100 0.00 25.50 FORMAT "%5.2" ECU_ADDRESS 0xC000BB08 /end MEASUREMENT
/begin MEASUREMENT Gen_arrayugen_nv27 "Hier könnte Ihr Langbezeichner stehen" UBYTE Def_u_ub_q0p1 1 100 0.00 25.50 FORMAT "%5.2" ECU_ADDRESS 0xC000BB09 /end MEASUREMENT
/begin MEASUREMENT Gen_arrayugen_nv28 "Hier könnte Ihr Langbezeichner stehen" UBYTE Def_u_ub_q0p1 1 100 0.00 25.50 FORMAT "%5.2" ECU_ADDRESS 0xC000BB0A /end MEASUREMENT
/begin MEASUREMENT Gen_arrayugen_nv29 "Hier könnte Ihr Langbezeichner stehen" UBYTE Def_u_ub_q0p1 1 100 0.00 25.50 FORMAT "%5.2" ECU_ADDRESS 0xC000BB0B /end MEASUREMENT
/begin MEASUREMENT GlbDa_ctLoadPrimRow0_mp00 "Primärkennfeld Fahrzeugnutzungsprofil" UWORD OneToOne 1 100 0.00 65535.00 ECU_ADDRESS 0xC000BE6C /end MEASUREMENT
/begin MEASUREMENT GlbDa_ctLoadPrimRow0_mp01 "Primärkennfeld Fahrzeugnutzungsprofil" UWORD OneToOne 1 100 0.00 65535.00 ECU_ADDRESS 0xC000BE6E /end MEASUREMENT
/begin MEASUREMENT GlbDa_ctLoadPrimRow0_mp02 "Primärkennfeld Fahrzeugnutzungsprofil" UWORD OneToOne 1 100 0.00 65535.00 ECU_ADDRESS 0xC000BE70 /end MEASUREMENT
/begin MEASUREMENT GlbDa_ctLoadPrimRow0_mp03 "Primärkennfeld Fahrzeugnutzungsprofil" UWORD OneToOne 1 100 0.00 65535.00 ECU_ADDRESS 0xC000BE72 /end MEASUREMENT
/begin MEASUREMENT GlbDa_ctLoadPrimRow0_mp04 "Primärkennfeld Fahrzeugnutzungsprofil" UWORD OneToOne 1 100 0.00 65535.00 ECU_ADDRESS 0xC000BE74 /end MEASUREMENT
/begin MEASUREMENT GlbDa_ctLoadPrimRow0_mp05 "Primärkennfeld Fahrzeugnutzungsprofil" UWORD OneToOne 1 100 0.00 65535.00 ECU_ADDRESS 0xC000BE76 /end MEASUREMENT
/begin MEASUREMENT GlbDa_ctLoadPrimRow0_mp06 "Primärkennfeld Fahrzeugnutzungsprofil" UWORD OneToOne 1 100 0.00 65535.00 ECU_ADDRESS 0xC000BE78 /end MEASUREMENT
/begin MEASUREMENT GlbDa_ctLoadPrimRow0_mp07 "Primärkennfeld Fahrzeugnutzungsprofil" UWORD OneToOne 1 100 0.00 65535.00 ECU_ADDRESS 0xC000BE7A /end MEASUREMENT
/begin MEASUREMENT GlbDa_ctLoadPrimRow1_mp00 "Primärkennfeld Fahrzeugnutzungsprofil" UWORD OneToOne 1 100 0.00 65535.00 ECU_ADDRESS 0xC000BE7C /end MEASUREMENT
/begin MEASUREMENT GlbDa_ctLoadPrimRow1_mp01 "Primärkennfeld Fahrzeugnutzungsprofil" UWORD OneToOne 1 100 0.00 65535.00 ECU_ADDRESS 0xC000BE7E /end MEASUREMENT
/begin MEASUREMENT GlbDa_ctLoadPrimRow1_mp02 "Primärkennfeld Fahrzeugnutzungsprofil" UWORD OneToOne 1 100 0.00 65535.00 ECU_ADDRESS 0xC000BE80 /end MEASUREMENT
/begin MEASUREMENT GlbDa_ctLoadPrimRow1_mp03 "Primärkennfeld Fahrzeugnutzungsprofil" UWORD OneToOne 1 100 0.00 65535.00 ECU_ADDRESS 0xC000BE82 /end MEASUREMENT
/begin MEASUREMENT GlbDa_ctLoadPrimRow1_mp04 "Primärkennfeld Fahrzeugnutzungsprofil" UWORD OneToOne 1 100 0.00 65535.00 ECU_ADDRESS 0xC000BE84 /end MEASUREMENT
/begin MEASUREMENT GlbDa_ctLoadPrimRow1_mp05 "Primärkennfeld Fahrzeugnutzungsprofil" UWORD OneToOne 1 100 0.00 65535.00 ECU_ADDRESS 0xC000BE86 /end MEASUREMENT
/begin MEASUREMENT GlbDa_ctLoadPrimRow1_mp06 "Primärkennfeld Fahrzeugnutzungsprofil" UWORD OneToOne 1 100 0.00 65535.00 ECU_ADDRESS 0xC000BE88 /end MEASUREMENT
/begin MEASUREMENT GlbDa_ctLoadPrimRow1_mp07 "Primärkennfeld Fahrzeugnutzungsprofil" UWORD OneToOne 1 100 0.00 65535.00 ECU_ADDRESS 0xC000BE8A /end MEASUREMENT
/begin MEASUREMENT GlbDa_ctLoadPrimRow2_mp00 "Primärkennfeld Fahrzeugnutzungsprofil" UWORD OneToOne 1 100 0.00 65535.00 ECU_ADDRESS 0xC000BE8C /end MEASUREMENT
/begin MEASUREMENT GlbDa_ctLoadPrimRow2_mp01 "Primärkennfeld Fahrzeugnutzungsprofil" UWORD OneToOne 1 100 0.00 65535.00 ECU_ADDRESS 0xC000BE8E /end MEASUREMENT
/begin MEASUREMENT GlbDa_ctLoadPrimRow2_mp02 "Primärkennfeld Fahrzeugnutzungsprofil" UWORD OneToOne 1 100 0.00 65535.00 ECU_ADDRESS 0xC000BE90 /end MEASUREMENT
/begin MEASUREMENT GlbDa_ctLoadPrimRow2_mp03 "Primärkennfeld Fahrzeugnutzungsprofil" UWORD OneToOne 1 100 0.00 65535.00 ECU_ADDRESS 0xC000BE92 /end MEASUREMENT
/begin MEASUREMENT GlbDa_ctLoadPrimRow2_mp04 "Primärkennfeld Fahrzeugnutzungsprofil" UWORD OneToOne 1 100 0.00 65535.00 ECU_ADDRESS 0xC000BE94 /end MEASUREMENT
/begin MEASUREMENT GlbDa_ctLoadPrimRow2_mp05 "Primärkennfeld Fahrzeugnutzungsprofil" UWORD OneToOne 1 100 0.00 65535.00 ECU_ADDRESS 0xC000BE96 /end MEASUREMENT
/begin MEASUREMENT GlbDa_ctLoadPrimRow2_mp06 "Primärkennfeld Fahrzeugnutzungsprofil" UWORD OneToOne 1 100 0.00 65535.00 ECU_ADDRESS 0xC000BE98 /end MEASUREMENT
/begin MEASUREMENT GlbDa_ctLoadPrimRow2_mp07 "Primärkennfeld Fahrzeugnutzungsprofil" UWORD OneToOne 1 100 0.00 65535.00 ECU_ADDRESS 0xC000BE9A /end MEASUREMENT
/begin MEASUREMENT GlbDa_ctLoadPrimRow3_mp00 "Primärkennfeld Fahrzeugnutzungsprofil" UWORD OneToOne 1 100 0.00 65535.00 ECU_ADDRESS 0xC000BE9C /end MEASUREMENT
/begin MEASUREMENT GlbDa_ctLoadPrimRow3_mp01 "Primärkennfeld Fahrzeugnutzungsprofil" UWORD OneToOne 1 100 0.00 65535.00 ECU_ADDRESS 0xC000BE9E /end MEASUREMENT
/begin MEASUREMENT GlbDa_ctLoadPrimRow3_mp02 "Primärkennfeld Fahrzeugnutzungsprofil" UWORD OneToOne 1 100 0.00 65535.00 ECU_ADDRESS 0xC000BEA0 /end MEASUREMENT
/begin MEASUREMENT GlbDa_ctLoadPrimRow3_mp03 "Primärkennfeld Fahrzeugnutzungsprofil" UWORD OneToOne 1 100 0.00 65535.00 ECU_ADDRESS 0xC000BEA2 /end MEASUREMENT
/begin MEASUREMENT GlbDa_ctLoadPrimRow3_mp04 "Primärkennfeld Fahrzeugnutzungsprofil" UWORD OneToOne 1 100 0.00 65535.00 ECU_ADDRESS 0xC000BEA4 /end MEASUREMENT
/begin MEASUREMENT GlbDa_ctLoadPrimRow3_mp05 "Primärkennfeld Fahrzeugnutzungsprofil" UWORD OneToOne 1 100 0.00 65535.00 ECU_ADDRESS 0xC000BEA6 /end MEASUREMENT
/begin MEASUREMENT GlbDa_ctLoadPrimRow3_mp06 "Primärkennfeld Fahrzeugnutzungsprofil" UWORD OneToOne 1 100 0.00 65535.00 ECU_ADDRESS 0xC000BEA8 /end MEASUREMENT
/begin MEASUREMENT GlbDa_ctLoadPrimRow3_mp07 "Primärkennfeld Fahrzeugnutzungsprofil" UWORD OneToOne 1 100 0.00 65535.00 ECU_ADDRESS 0xC000BEAA /end MEASUREMENT
/begin MEASUREMENT GlbDa_ctLoadPrimRow4_mp00 "Primärkennfeld Fahrzeugnutzungsprofil" UWORD OneToOne 1 100 0.00 65535.00 ECU_ADDRESS 0xC000BEAC /end MEASUREMENT
/begin MEASUREMENT GlbDa_ctLoadPrimRow4_mp01 "Primärkennfeld Fahrzeugnutzungsprofil" UWORD OneToOne 1 100 0.00 65535.00 ECU_ADDRESS 0xC000BEAE /end MEASUREMENT
/begin MEASUREMENT GlbDa_ctLoadPrimRow4_mp02 "Primärkennfeld Fahrzeugnutzungsprofil" UWORD OneToOne 1 100 0.00 65535.00 ECU_ADDRESS 0xC000BEB0 /end MEASUREMENT
/begin MEASUREMENT GlbDa_ctLoadPrimRow4_mp03 "Primärkennfeld Fahrzeugnutzungsprofil" UWORD OneToOne 1 100 0.00 65535.00 ECU_ADDRESS 0xC000BEB2 /end MEASUREMENT
/begin MEASUREMENT GlbDa_ctLoadPrimRow4_mp04 "Primärkennfeld Fahrzeugnutzungsprofil" UWORD OneToOne 1 100 0.00 65535.00 ECU_ADDRESS 0xC000BEB4 /end MEASUREMENT
/begin MEASUREMENT GlbDa_ctLoadPrimRow4_mp05 "Primärkennfeld Fahrzeugnutzungsprofil" UWORD OneToOne 1 100 0.00 65535.00 ECU_ADDRESS 0xC000BEB6 /end MEASUREMENT
/begin MEASUREMENT GlbDa_ctLoadPrimRow4_mp06 "Primärkennfeld Fahrzeugnutzungsprofil" UWORD OneToOne 1 100 0.00 65535.00 ECU_ADDRESS 0xC000BEB8 /end MEASUREMENT
/begin MEASUREMENT GlbDa_ctLoadPrimRow4_mp07 "Primärkennfeld Fahrzeugnutzungsprofil" UWORD OneToOne 1 100 0.00 65535.00 ECU_ADDRESS 0xC000BEBA /end MEASUREMENT
/begin MEASUREMENT GlbDa_ctLoadPrimRow5_mp00 "Primärkennfeld Fahrzeugnutzungsprofil" UWORD OneToOne 1 100 0.00 65535.00 ECU_ADDRESS 0xC000BEBC /end MEASUREMENT
/begin MEASUREMENT GlbDa_ctLoadPrimRow5_mp01 "Primärkennfeld Fahrzeugnutzungsprofil" UWORD OneToOne 1 100 0.00 65535.00 ECU_ADDRESS 0xC000BEBE /end MEASUREMENT
/begin MEASUREMENT GlbDa_ctLoadPrimRow5_mp02 "Primärkennfeld Fahrzeugnutzungsprofil" UWORD OneToOne 1 100 0.00 65535.00 ECU_ADDRESS 0xC000BEC0 /end MEASUREMENT
/begin MEASUREMENT GlbDa_ctLoadPrimRow5_mp03 "Primärkennfeld Fahrzeugnutzungsprofil" UWORD OneToOne 1 100 0.00 65535.00 ECU_ADDRESS 0xC000BEC2 /end MEASUREMENT
/begin MEASUREMENT GlbDa_ctLoadPrimRow5_mp04 "Primärkennfeld Fahrzeugnutzungsprofil" UWORD OneToOne 1 100 0.00 65535.00 ECU_ADDRESS 0xC000BEC4 /end MEASUREMENT
/begin MEASUREMENT GlbDa_ctLoadPrimRow5_mp05 "Primärkennfeld Fahrzeugnutzungsprofil" UWORD OneToOne 1 100 0.00 65535.00 ECU_ADDRESS 0xC000BEC6 /end MEASUREMENT
/begin MEASUREMENT GlbDa_ctLoadPrimRow5_mp06 "Primärkennfeld Fahrzeugnutzungsprofil" UWORD OneToOne 1 100 0.00 65535.00 ECU_ADDRESS 0xC000BEC8 /end MEASUREMENT
/begin MEASUREMENT GlbDa_ctLoadPrimRow5_mp07 "Primärkennfeld Fahrzeugnutzungsprofil" UWORD OneToOne 1 100 0.00 65535.00 ECU_ADDRESS 0xC000BECA /end MEASUREMENT
/begin MEASUREMENT GlbDa_ctLoadSecRow0_mp00 "Sekundärkennfeld Fahrzeugnutzungsprofil" UBYTE OneToOne 1 100 0.00 255.0 ECU_ADDRESS 0xC000BECC /end MEASUREMENT
/begin MEASUREMENT GlbDa_ctLoadSecRow0_mp01 "Sekundärkennfeld Fahrzeugnutzungsprofil" UBYTE OneToOne 1 100 0.00 255.0 ECU_ADDRESS 0xC000BECD /end MEASUREMENT
/begin MEASUREMENT GlbDa_ctLoadSecRow0_mp02 "Sekundärkennfeld Fahrzeugnutzungsprofil" UBYTE OneToOne 1 100 0.00 255.0 ECU_ADDRESS 0xC000BECE /end MEASUREMENT
/begin MEASUREMENT GlbDa_ctLoadSecRow0_mp03 "Sekundärkennfeld Fahrzeugnutzungsprofil" UBYTE OneToOne 1 100 0.00 255.0 ECU_ADDRESS 0xC000BECF /end MEASUREMENT
/begin MEASUREMENT GlbDa_ctLoadSecRow0_mp04 "Sekundärkennfeld Fahrzeugnutzungsprofil" UBYTE OneToOne 1 100 0.00 255.0 ECU_ADDRESS 0xC000BED0 /end MEASUREMENT
/begin MEASUREMENT GlbDa_ctLoadSecRow0_mp05 "Sekundärkennfeld Fahrzeugnutzungsprofil" UBYTE OneToOne 1 100 0.00 255.0 ECU_ADDRESS 0xC000BED1 /end MEASUREMENT
/begin MEASUREMENT GlbDa_ctLoadSecRow0_mp06 "Sekundärkennfeld Fahrzeugnutzungsprofil" UBYTE OneToOne 1 100 0.00 255.0 ECU_ADDRESS 0xC000BED2 /end MEASUREMENT
/begin MEASUREMENT GlbDa_ctLoadSecRow0_mp07 "Sekundärkennfeld Fahrzeugnutzungsprofil" UBYTE OneToOne 1 100 0.00 255.0 ECU_ADDRESS 0xC000BED3 /end MEASUREMENT
/begin MEASUREMENT GlbDa_ctLoadSecRow1_mp00 "Sekundärkennfeld Fahrzeugnutzungsprofil" UBYTE OneToOne 1 100 0.00 255.0 ECU_ADDRESS 0xC000BED4 /end MEASUREMENT
/begin MEASUREMENT GlbDa_ctLoadSecRow1_mp01 "Sekundärkennfeld Fahrzeugnutzungsprofil" UBYTE OneToOne 1 100 0.00 255.0 ECU_ADDRESS 0xC000BED5 /end MEASUREMENT
/begin MEASUREMENT GlbDa_ctLoadSecRow1_mp02 "Sekundärkennfeld Fahrzeugnutzungsprofil" UBYTE OneToOne 1 100 0.00 255.0 ECU_ADDRESS 0xC000BED6 /end MEASUREMENT
/begin MEASUREMENT GlbDa_ctLoadSecRow1_mp03 "Sekundärkennfeld Fahrzeugnutzungsprofil" UBYTE OneToOne 1 100 0.00 255.0 ECU_ADDRESS 0xC000BED7 /end MEASUREMENT
/begin MEASUREMENT GlbDa_ctLoadSecRow1_mp04 "Sekundärkennfeld Fahrzeugnutzungsprofil" UBYTE OneToOne 1 100 0.00 255.0 ECU_ADDRESS 0xC000BED8 /end MEASUREMENT
/begin MEASUREMENT GlbDa_ctLoadSecRow1_mp05 "Sekundärkennfeld Fahrzeugnutzungsprofil" UBYTE OneToOne 1 100 0.00 255.0 ECU_ADDRESS 0xC000BED9 /end MEASUREMENT
/begin MEASUREMENT GlbDa_ctLoadSecRow1_mp06 "Sekundärkennfeld Fahrzeugnutzungsprofil" UBYTE OneToOne 1 100 0.00 255.0 ECU_ADDRESS 0xC000BEDA /end MEASUREMENT
/begin MEASUREMENT GlbDa_ctLoadSecRow1_mp07 "Sekundärkennfeld Fahrzeugnutzungsprofil" UBYTE OneToOne 1 100 0.00 255.0 ECU_ADDRESS 0xC000BEDB /end MEASUREMENT
/begin MEASUREMENT GlbDa_ctLoadSecRow2_mp00 "Sekundärkennfeld Fahrzeugnutzungsprofil" UBYTE OneToOne 1 100 0.00 255.0 ECU_ADDRESS 0xC000BEDC /end MEASUREMENT
/begin MEASUREMENT GlbDa_ctLoadSecRow2_mp01 "Sekundärkennfeld Fahrzeugnutzungsprofil" UBYTE OneToOne 1 100 0.00 255.0 ECU_ADDRESS 0xC000BEDD /end MEASUREMENT
/begin MEASUREMENT GlbDa_ctLoadSecRow2_mp02 "Sekundärkennfeld Fahrzeugnutzungsprofil" UBYTE OneToOne 1 100 0.00 255.0 ECU_ADDRESS 0xC000BEDE /end MEASUREMENT
/begin MEASUREMENT GlbDa_ctLoadSecRow2_mp03 "Sekundärkennfeld Fahrzeugnutzungsprofil" UBYTE OneToOne 1 100 0.00 255.0 ECU_ADDRESS 0xC000BEDF /end MEASUREMENT
/begin MEASUREMENT GlbDa_ctLoadSecRow2_mp04 "Sekundärkennfeld Fahrzeugnutzungsprofil" UBYTE OneToOne 1 100 0.00 255.0 ECU_ADDRESS 0xC000BEE0 /end MEASUREMENT
/begin MEASUREMENT GlbDa_ctLoadSecRow2_mp05 "Sekundärkennfeld Fahrzeugnutzungsprofil" UBYTE OneToOne 1 100 0.00 255.0 ECU_ADDRESS 0xC000BEE1 /end MEASUREMENT
/begin MEASUREMENT GlbDa_ctLoadSecRow2_mp06 "Sekundärkennfeld Fahrzeugnutzungsprofil" UBYTE OneToOne 1 100 0.00 255.0 ECU_ADDRESS 0xC000BEE2 /end MEASUREMENT
/begin MEASUREMENT GlbDa_ctLoadSecRow2_mp07 "Sekundärkennfeld Fahrzeugnutzungsprofil" UBYTE OneToOne 1 100 0.00 255.0 ECU_ADDRESS 0xC000BEE3 /end MEASUREMENT
/begin MEASUREMENT GlbDa_ctLoadSecRow3_mp00 "Sekundärkennfeld Fahrzeugnutzungsprofil" UBYTE OneToOne 1 100 0.00 255.0 ECU_ADDRESS 0xC000BEE4 /end MEASUREMENT
/begin MEASUREMENT GlbDa_ctLoadSecRow3_mp01 "Sekundärkennfeld Fahrzeugnutzungsprofil" UBYTE OneToOne 1 100 0.00 255.0 ECU_ADDRESS 0xC000BEE5 /end MEASUREMENT
/begin MEASUREMENT GlbDa_ctLoadSecRow3_mp02 "Sekundärkennfeld Fahrzeugnutzungsprofil" UBYTE OneToOne 1 100 0.00 255.0 ECU_ADDRESS 0xC000BEE6 /end MEASUREMENT
/begin MEASUREMENT GlbDa_ctLoadSecRow3_mp03 "Sekundärkennfeld Fahrzeugnutzungsprofil" UBYTE OneToOne 1 100 0.00 255.0 ECU_ADDRESS 0xC000BEE7 /end MEASUREMENT
/begin MEASUREMENT GlbDa_ctLoadSecRow3_mp04 "Sekundärkennfeld Fahrzeugnutzungsprofil" UBYTE OneToOne 1 100 0.00 255.0 ECU_ADDRESS 0xC000BEE8 /end MEASUREMENT
/begin MEASUREMENT GlbDa_ctLoadSecRow3_mp05 "Sekundärkennfeld Fahrzeugnutzungsprofil" UBYTE OneToOne 1 100 0.00 255.0 ECU_ADDRESS 0xC000BEE9 /end MEASUREMENT
/begin MEASUREMENT GlbDa_ctLoadSecRow3_mp06 "Sekundärkennfeld Fahrzeugnutzungsprofil" UBYTE OneToOne 1 100 0.00 255.0 ECU_ADDRESS 0xC000BEEA /end MEASUREMENT
/begin MEASUREMENT GlbDa_ctLoadSecRow3_mp07 "Sekundärkennfeld Fahrzeugnutzungsprofil" UBYTE OneToOne 1 100 0.00 255.0 ECU_ADDRESS 0xC000BEEB /end MEASUREMENT
/begin MEASUREMENT GlbDa_ctLoadSecRow4_mp00 "Sekundärkennfeld Fahrzeugnutzungsprofil" UBYTE OneToOne 1 100 0.00 255.0 ECU_ADDRESS 0xC000BEEC /end MEASUREMENT
/begin MEASUREMENT GlbDa_ctLoadSecRow4_mp01 "Sekundärkennfeld Fahrzeugnutzungsprofil" UBYTE OneToOne 1 100 0.00 255.0 ECU_ADDRESS 0xC000BEED /end MEASUREMENT
/begin MEASUREMENT GlbDa_ctLoadSecRow4_mp02 "Sekundärkennfeld Fahrzeugnutzungsprofil" UBYTE OneToOne 1 100 0.00 255.0 ECU_ADDRESS 0xC000BEEE /end MEASUREMENT
/begin MEASUREMENT GlbDa_ctLoadSecRow4_mp03 "Sekundärkennfeld Fahrzeugnutzungsprofil" UBYTE OneToOne 1 100 0.00 255.0 ECU_ADDRESS 0xC000BEEF /end MEASUREMENT
/begin MEASUREMENT GlbDa_ctLoadSecRow4_mp04 "Sekundärkennfeld Fahrzeugnutzungsprofil" UBYTE OneToOne 1 100 0.00 255.0 ECU_ADDRESS 0xC000BEF0 /end MEASUREMENT
/begin MEASUREMENT GlbDa_ctLoadSecRow4_mp05 "Sekundärkennfeld Fahrzeugnutzungsprofil" UBYTE OneToOne 1 100 0.00 255.0 ECU_ADDRESS 0xC000BEF1 /end MEASUREMENT
/begin MEASUREMENT GlbDa_ctLoadSecRow4_mp06 "Sekundärkennfeld Fahrzeugnutzungsprofil" UBYTE OneToOne 1 100 0.00 255.0 ECU_ADDRESS 0xC000BEF2 /end MEASUREMENT
/begin MEASUREMENT GlbDa_ctLoadSecRow4_mp07 "Sekundärkennfeld Fahrzeugnutzungsprofil" UBYTE OneToOne 1 100 0.00 255.0 ECU_ADDRESS 0xC000BEF3 /end MEASUREMENT
/begin MEASUREMENT GlbDa_ctLoadSecRow5_mp00 "Sekundärkennfeld Fahrzeugnutzungsprofil" UBYTE OneToOne 1 100 0.00 255.0 ECU_ADDRESS 0xC000BEF4 /end MEASUREMENT
/begin MEASUREMENT GlbDa_ctLoadSecRow5_mp01 "Sekundärkennfeld Fahrzeugnutzungsprofil" UBYTE OneToOne 1 100 0.00 255.0 ECU_ADDRESS 0xC000BEF5 /end MEASUREMENT
/begin MEASUREMENT GlbDa_ctLoadSecRow5_mp02 "Sekundärkennfeld Fahrzeugnutzungsprofil" UBYTE OneToOne 1 100 0.00 255.0 ECU_ADDRESS 0xC000BEF6 /end MEASUREMENT
/begin MEASUREMENT GlbDa_ctLoadSecRow5_mp03 "Sekundärkennfeld Fahrzeugnutzungsprofil" UBYTE OneToOne 1 100 0.00 255.0 ECU_ADDRESS 0xC000BEF7 /end MEASUREMENT
/begin MEASUREMENT GlbDa_ctLoadSecRow5_mp04 "Sekundärkennfeld Fahrzeugnutzungsprofil" UBYTE OneToOne 1 100 0.00 255.0 ECU_ADDRESS 0xC000BEF8 /end MEASUREMENT
/begin MEASUREMENT GlbDa_ctLoadSecRow5_mp05 "Sekundärkennfeld Fahrzeugnutzungsprofil" UBYTE OneToOne 1 100 0.00 255.0 ECU_ADDRESS 0xC000BEF9 /end MEASUREMENT
/begin MEASUREMENT GlbDa_ctLoadSecRow5_mp06 "Sekundärkennfeld Fahrzeugnutzungsprofil" UBYTE OneToOne 1 100 0.00 255.0 ECU_ADDRESS 0xC000BEFA /end MEASUREMENT
/begin MEASUREMENT GlbDa_ctLoadSecRow5_mp07 "Sekundärkennfeld Fahrzeugnutzungsprofil" UBYTE OneToOne 1 100 0.00 255.0 ECU_ADDRESS 0xC000BEFB /end MEASUREMENT
/begin MEASUREMENT Ibsl_buffer00 "ELIN Datenpuffer, bidirektional" UBYTE Def_dez_ub_q1 1 100 0.00 255. FORMAT "%3.0" ECU_ADDRESS 0xC000BF74 /end MEASUREMENT
/begin MEASUREMENT Ibsl_buffer01 "ELIN Datenpuffer, bidirektional" UBYTE Def_dez_ub_q1 1 100 0.00 255. FORMAT "%3.0" ECU_ADDRESS 0xC000BF75 /end MEASUREMENT
/begin MEASUREMENT Ibsl_buffer02 "ELIN Datenpuffer, bidirektional" UBYTE Def_dez_ub_q1 1 100 0.00 255. FORMAT "%3.0" ECU_ADDRESS 0xC000BF76 /end MEASUREMENT
/begin MEASUREMENT Ibsl_buffer03 "ELIN Datenpuffer, bidirektional" UBYTE Def_dez_ub_q1 1 100 0.00 255. FORMAT "%3.0" ECU_ADDRESS 0xC000BF77 /end MEASUREMENT
/begin MEASUREMENT Ibsl_buffer04 "ELIN Datenpuffer, bidirektional" UBYTE Def_dez_ub_q1 1 100 0.00 255. FORMAT "%3.0" ECU_ADDRESS 0xC000BF78 /end MEASUREMENT
/begin MEASUREMENT Ibsl_buffer05 "ELIN Datenpuffer, bidirektional" UBYTE Def_dez_ub_q1 1 100 0.00 255. FORMAT "%3.0" ECU_ADDRESS 0xC000BF79 /end MEASUREMENT
/begin MEASUREMENT Ibsl_buffer06 "ELIN Datenpuffer, bidirektional" UBYTE Def_dez_ub_q1 1 100 0.00 255. FORMAT "%3.0" ECU_ADDRESS 0xC000BF7A /end MEASUREMENT
/begin MEASUREMENT Ibsl_buffer07 "ELIN Datenpuffer, bidirektional" UBYTE Def_dez_ub_q1 1 100 0.00 255. FORMAT "%3.0" ECU_ADDRESS 0xC000BF7B /end MEASUREMENT
/begin MEASUREMENT Ibs_asic00 "Seriennummer" ULONG Def_dez_ul_q1 1 100 0.00 4294967295. FORMAT "%7.0" ECU_ADDRESS 0xC000BF7C /end MEASUREMENT
/begin MEASUREMENT Ibs_asic01 "Seriennummer" ULONG Def_dez_ul_q1 1 100 0.00 4294967295. FORMAT "%7.0" ECU_ADDRESS 0xC000BF80 /end MEASUREMENT
/begin MEASUREMENT Igrinfo00 "Infospeicher iGR" UBYTE Def_dez_ub_q1 1 100 0.00 255. FORMAT "%3.0" ECU_ADDRESS 0xC000B627 /end MEASUREMENT
/begin MEASUREMENT Igrinfo01 "Infospeicher iGR" UBYTE Def_dez_ub_q1 1 100 0.00 255. FORMAT "%3.0" ECU_ADDRESS 0xC000B628 /end MEASUREMENT
/begin MEASUREMENT Igrinfo02 "Infospeicher iGR" UBYTE Def_dez_ub_q1 1 100 0.00 255. FORMAT "%3.0" ECU_ADDRESS 0xC000B629 /end MEASUREMENT
/begin MEASUREMENT Igrinfo03 "Infospeicher iGR" UBYTE Def_dez_ub_q1 1 100 0.00 255. FORMAT "%3.0" ECU_ADDRESS 0xC000B62A /end MEASUREMENT
/begin MEASUREMENT Igrinfo04 "Infospeicher iGR" UBYTE Def_dez_ub_q1 1 100 0.00 255. FORMAT "%3.0" ECU_ADDRESS 0xC000B62B /end MEASUREMENT
/begin MEASUREMENT Igrinfo05 "Infospeicher iGR" UBYTE Def_dez_ub_q1 1 100 0.00 255. FORMAT "%3.0" ECU_ADDRESS 0xC000B62C /end MEASUREMENT
/begin MEASUREMENT Igrinfo06 "Infospeicher iGR" UBYTE Def_dez_ub_q1 1 100 0.00 255. FORMAT "%3.0" ECU_ADDRESS 0xC000B62D /end MEASUREMENT
/begin MEASUREMENT Igrinfo07 "Infospeicher iGR" UBYTE Def_dez_ub_q1 1 100 0.00 255. FORMAT "%3.0" ECU_ADDRESS 0xC000B62E /end MEASUREMENT
/begin MEASUREMENT Igrinfo08 "Infospeicher iGR" UBYTE Def_dez_ub_q1 1 100 0.00 255. FORMAT "%3.0" ECU_ADDRESS 0xC000B62F /end MEASUREMENT
/begin MEASUREMENT Igrinfo09 "Infospeicher iGR" UBYTE Def_dez_ub_q1 1 100 0.00 255. FORMAT "%3.0" ECU_ADDRESS 0xC000B630 /end MEASUREMENT
/begin MEASUREMENT Igrinfo10 "Infospeicher iGR" UBYTE Def_dez_ub_q1 1 100 0.00 255. FORMAT "%3.0" ECU_ADDRESS 0xC000B631 /end MEASUREMENT
/begin MEASUREMENT Igrinfo11 "Infospeicher iGR" UBYTE Def_dez_ub_q1 1 100 0.00 255. FORMAT "%3.0" ECU_ADDRESS 0xC000B632 /end MEASUREMENT
/begin MEASUREMENT Igrinfo12 "Infospeicher iGR" UBYTE Def_dez_ub_q1 1 100 0.00 255. FORMAT "%3.0" ECU_ADDRESS 0xC000B633 /end MEASUREMENT
/begin MEASUREMENT Igrinfo13 "Infospeicher iGR" UBYTE Def_dez_ub_q1 1 100 0.00 255. FORMAT "%3.0" ECU_ADDRESS 0xC000B634 /end MEASUREMENT
/begin MEASUREMENT Igrinfo14 "Infospeicher iGR" UBYTE Def_dez_ub_q1 1 100 0.00 255. FORMAT "%3.0" ECU_ADDRESS 0xC000B635 /end MEASUREMENT
/begin MEASUREMENT Igrinfo15 "Infospeicher iGR" UBYTE Def_dez_ub_q1 1 100 0.00 255. FORMAT "%3.0" ECU_ADDRESS 0xC000B636 /end MEASUREMENT
/begin MEASUREMENT Igrinfo16 "Infospeicher iGR" UBYTE Def_dez_ub_q1 1 100 0.00 255. FORMAT "%3.0" ECU_ADDRESS 0xC000B637 /end MEASUREMENT
/begin MEASUREMENT Igrinfo17 "Infospeicher iGR" UBYTE Def_dez_ub_q1 1 100 0.00 255. FORMAT "%3.0" ECU_ADDRESS 0xC000B638 /end MEASUREMENT
/begin MEASUREMENT Igrinfo18 "Infospeicher iGR" UBYTE Def_dez_ub_q1 1 100 0.00 255. FORMAT "%3.0" ECU_ADDRESS 0xC000B639 /end MEASUREMENT
/begin MEASUREMENT Igrinfo19 "Infospeicher iGR" UBYTE Def_dez_ub_q1 1 100 0.00 255. FORMAT "%3.0" ECU_ADDRESS 0xC000B63A /end MEASUREMENT
/begin MEASUREMENT Igrinfo20 "Infospeicher iGR" UBYTE Def_dez_ub_q1 1 100 0.00 255. FORMAT "%3.0" ECU_ADDRESS 0xC000B63B /end MEASUREMENT
/begin MEASUREMENT Igrinfo21 "Infospeicher iGR" UBYTE Def_dez_ub_q1 1 100 0.00 255. FORMAT "%3.0" ECU_ADDRESS 0xC000B63C /end MEASUREMENT
/begin MEASUREMENT Igrinfo22 "Infospeicher iGR" UBYTE Def_dez_ub_q1 1 100 0.00 255. FORMAT "%3.0" ECU_ADDRESS 0xC000B63D /end MEASUREMENT
/begin MEASUREMENT Igrinfo23 "Infospeicher iGR" UBYTE Def_dez_ub_q1 1 100 0.00 255. FORMAT "%3.0" ECU_ADDRESS 0xC000B63E /end MEASUREMENT
/begin MEASUREMENT Igrinfo24 "Infospeicher iGR" UBYTE Def_dez_ub_q1 1 100 0.00 255. FORMAT "%3.0" ECU_ADDRESS 0xC000B63F /end MEASUREMENT
/begin MEASUREMENT Igrinfo25 "Infospeicher iGR" UBYTE Def_dez_ub_q1 1 100 0.00 255. FORMAT "%3.0" ECU_ADDRESS 0xC000B640 /end MEASUREMENT
/begin MEASUREMENT Igrinfo26 "Infospeicher iGR" UBYTE Def_dez_ub_q1 1 100 0.00 255. FORMAT "%3.0" ECU_ADDRESS 0xC000B641 /end MEASUREMENT
/begin MEASUREMENT Igrinfo27 "Infospeicher iGR" UBYTE Def_dez_ub_q1 1 100 0.00 255. FORMAT "%3.0" ECU_ADDRESS 0xC000B642 /end MEASUREMENT
/begin MEASUREMENT Igrinfo28 "Infospeicher iGR" UBYTE Def_dez_ub_q1 1 100 0.00 255. FORMAT "%3.0" ECU_ADDRESS 0xC000B643 /end MEASUREMENT
/begin MEASUREMENT Igrinfo29 "Infospeicher iGR" UBYTE Def_dez_ub_q1 1 100 0.00 255. FORMAT "%3.0" ECU_ADDRESS 0xC000B644 /end MEASUREMENT
/begin MEASUREMENT InjCrv_facMI1APSSOECorRgn00 "luftdruckabhängige Korrekturfaktoren der Ansaugluft für die MI1 im Regenerationsbetrieb" SWORD Fact 1 100 -4.000000 3.999878 ECU_ADDRESS 0xD0000CF6 /end MEASUREMENT
/begin MEASUREMENT InjCrv_facMI1APSSOECorRgn01 "luftdruckabhängige Korrekturfaktoren der Ansaugluft für die MI1 im Regenerationsbetrieb" SWORD Fact 1 100 -4.000000 3.999878 ECU_ADDRESS 0xD0000CF8 /end MEASUREMENT
/begin MEASUREMENT InjCrv_facMI1ATSSOECorRgn00 "temperaturabhängige Korrekturfaktoren der Ansaugluft für die MI1 im Regenerationsbetrieb" SWORD Fact 1 100 -4.000000 3.999878 ECU_ADDRESS 0xD0000CFA /end MEASUREMENT
/begin MEASUREMENT InjCrv_facMI1ATSSOECorRgn01 "temperaturabhängige Korrekturfaktoren der Ansaugluft für die MI1 im Regenerationsbetrieb" SWORD Fact 1 100 -4.000000 3.999878 ECU_ADDRESS 0xD0000CFC /end MEASUREMENT
/begin MEASUREMENT InjCrv_facMI1ETSSOECorRgn00 "motortemperaturabhängige Korrekturfaktoren für die MI1 im Regenerationsbetrieb" SWORD Fact 1 100 -4.000000 3.999878 ECU_ADDRESS 0xD0000D00 /end MEASUREMENT
/begin MEASUREMENT InjCrv_facMI1ETSSOECorRgn01 "motortemperaturabhängige Korrekturfaktoren für die MI1 im Regenerationsbetrieb" SWORD Fact 1 100 -4.000000 3.999878 ECU_ADDRESS 0xD0000D02 /end MEASUREMENT
/begin MEASUREMENT InjCrv_facPiI1APSQCorRgn100 "Atmosphärendruckabhängiger Mengenkorrekturfaktor 1 für Voreinspritzung 1 im Regenerationsbetrieb" SWORD Fact 1 100 -4.000000 3.999878 ECU_ADDRESS 0xD0000D2A /end MEASUREMENT
/begin MEASUREMENT InjCrv_facPiI1APSQCorRgn101 "Atmosphärendruckabhängiger Mengenkorrekturfaktor 1 für Voreinspritzung 1 im Regenerationsbetrieb" SWORD Fact 1 100 -4.000000 3.999878 ECU_ADDRESS 0xD0000D2C /end MEASUREMENT
/begin MEASUREMENT InjCrv_facPiI1APSQCorRgn200 "Atmosphärendruckabhängiger Mengenkorrekturfaktor 2 für Voreinspritzung 1 im Regenerationsbetrieb" SWORD Fact 1 100 -4.000000 3.999878 ECU_ADDRESS 0xD0000D2E /end MEASUREMENT
/begin MEASUREMENT InjCrv_facPiI1APSQCorRgn201 "Atmosphärendruckabhängiger Mengenkorrekturfaktor 2 für Voreinspritzung 1 im Regenerationsbetrieb" SWORD Fact 1 100 -4.000000 3.999878 ECU_ADDRESS 0xD0000D30 /end MEASUREMENT
/begin MEASUREMENT InjCrv_facPiI1APSSOECorRgn100 "Luftdruckabhängiger Ansteuerbeginnkorrekturfaktor 1 für Voreinspritzung 1 im Regenerationsbetrieb" SWORD Fact 1 100 -4.000000 3.999878 ECU_ADDRESS 0xD0000D38 /end MEASUREMENT
/begin MEASUREMENT InjCrv_facPiI1APSSOECorRgn101 "Luftdruckabhängiger Ansteuerbeginnkorrekturfaktor 1 für Voreinspritzung 1 im Regenerationsbetrieb" SWORD Fact 1 100 -4.000000 3.999878 ECU_ADDRESS 0xD0000D3A /end MEASUREMENT
/begin MEASUREMENT InjCrv_facPiI1APSSOECorRgn200 "Luftdruckabhängiger Ansteuerbeginnkorrekturfaktor 2 für Voreinspritzung 1 im Regenerationsbetrieb" SWORD Fact 1 100 -4.000000 3.999878 ECU_ADDRESS 0xD0000D3C /end MEASUREMENT
/begin MEASUREMENT InjCrv_facPiI1APSSOECorRgn201 "Luftdruckabhängiger Ansteuerbeginnkorrekturfaktor 2 für Voreinspritzung 1 im Regenerationsbetrieb" SWORD Fact 1 100 -4.000000 3.999878 ECU_ADDRESS 0xD0000D3E /end MEASUREMENT
/begin MEASUREMENT InjCrv_facPiI1ATSQCorRgn100 "Ansauglufttemperaturabhängiger Mengenkorrekturfaktor 1 für Voreinspritzung 1 im Regenerationsbetrieb" SWORD Fact 1 100 -4.000000 3.999878 ECU_ADDRESS 0xD0000D44 /end MEASUREMENT
/begin MEASUREMENT InjCrv_facPiI1ATSQCorRgn101 "Ansauglufttemperaturabhängiger Mengenkorrekturfaktor 1 für Voreinspritzung 1 im Regenerationsbetrieb" SWORD Fact 1 100 -4.000000 3.999878 ECU_ADDRESS 0xD0000D46 /end MEASUREMENT
/begin MEASUREMENT InjCrv_facPiI1ATSQCorRgn200 "Ansauglufttemperaturabhängiger Mengenkorrekturfaktor 2 für Voreinspritzung 1 im Regenerationsbetrieb" SWORD Fact 1 100 -4.000000 3.999878 ECU_ADDRESS 0xD0000D48 /end MEASUREMENT
/begin MEASUREMENT InjCrv_facPiI1ATSQCorRgn201 "Ansauglufttemperaturabhängiger Mengenkorrekturfaktor 2 für Voreinspritzung 1 im Regenerationsbetrieb" SWORD Fact 1 100 -4.000000 3.999878 ECU_ADDRESS 0xD0000D4A /end MEASUREMENT
/begin MEASUREMENT InjCrv_facPiI1ATSSOECorRgn100 "Ansauglufttemperaturabhängiger Ansteuerbeginnkorrekturfaktor 1 für Voreinspritzung 1 im Regenerationsbetrieb" SWORD Fact 1 100 -4.000000 3.999878 ECU_ADDRESS 0xD0000D52 /end MEASUREMENT
/begin MEASUREMENT InjCrv_facPiI1ATSSOECorRgn101 "Ansauglufttemperaturabhängiger Ansteuerbeginnkorrekturfaktor 1 für Voreinspritzung 1 im Regenerationsbetrieb" SWORD Fact 1 100 -4.000000 3.999878 ECU_ADDRESS 0xD0000D54 /end MEASUREMENT
/begin MEASUREMENT InjCrv_facPiI1ATSSOECorRgn200 "Ansauglufttemperaturabhängiger Ansteuerbeginnkorrekturfaktor 2 für Voreinspritzung 1 im Regenerationsbetrieb" SWORD Fact 1 100 -4.000000 3.999878 ECU_ADDRESS 0xD0000D56 /end MEASUREMENT
/begin MEASUREMENT InjCrv_facPiI1ATSSOECorRgn201 "Ansauglufttemperaturabhängiger Ansteuerbeginnkorrekturfaktor 2 für Voreinspritzung 1 im Regenerationsbetrieb" SWORD Fact 1 100 -4.000000 3.999878 ECU_ADDRESS 0xD0000D58 /end MEASUREMENT
/begin MEASUREMENT InjCrv_facPiI1ETSQCorRgn100 "Motortemperaturabhängiger Mengenkorrekturfaktor 1 für Voreinspritzung 1 im Regenerationsbetrieb" SWORD Fact 1 100 -4.000000 3.999878 ECU_ADDRESS 0xD0000D6C /end MEASUREMENT
/begin MEASUREMENT InjCrv_facPiI1ETSQCorRgn101 "Motortemperaturabhängiger Mengenkorrekturfaktor 1 für Voreinspritzung 1 im Regenerationsbetrieb" SWORD Fact 1 100 -4.000000 3.999878 ECU_ADDRESS 0xD0000D6E /end MEASUREMENT
/begin MEASUREMENT InjCrv_facPiI1ETSQCorRgn200 "Motortemperaturabhängiger Mengenkorrekturfaktor 2 für Voreinspritzung 1 im Regenerationsbetrieb" SWORD Fact 1 100 -4.000000 3.999878 ECU_ADDRESS 0xD0000D70 /end MEASUREMENT
/begin MEASUREMENT InjCrv_facPiI1ETSQCorRgn201 "Motortemperaturabhängiger Mengenkorrekturfaktor 2 für Voreinspritzung 1 im Regenerationsbetrieb" SWORD Fact 1 100 -4.000000 3.999878 ECU_ADDRESS 0xD0000D72 /end MEASUREMENT
/begin MEASUREMENT InjCrv_facPiI1ETSSOECorRgn100 "Motortemperaturabhängiger Ansteuerbeginnkorrekturfaktor 1 für Voreinspritzung 1 im Regenerationsbetrieb" SWORD Fact 1 100 -4.000000 3.999878 ECU_ADDRESS 0xD0000D7E /end MEASUREMENT
/begin MEASUREMENT InjCrv_facPiI1ETSSOECorRgn101 "Motortemperaturabhängiger Ansteuerbeginnkorrekturfaktor 1 für Voreinspritzung 1 im Regenerationsbetrieb" SWORD Fact 1 100 -4.000000 3.999878 ECU_ADDRESS 0xD0000D80 /end MEASUREMENT
/begin MEASUREMENT InjCrv_facPiI1ETSSOECorRgn200 "Motortemperaturabhängiger Ansteuerbeginnkorrekturfaktor 2 für Voreinspritzung 1 im Regenerationsbetrieb" SWORD Fact 1 100 -4.000000 3.999878 ECU_ADDRESS 0xD0000D82 /end MEASUREMENT
/begin MEASUREMENT InjCrv_facPiI1ETSSOECorRgn201 "Motortemperaturabhängiger Ansteuerbeginnkorrekturfaktor 2 für Voreinspritzung 1 im Regenerationsbetrieb" SWORD Fact 1 100 -4.000000 3.999878 ECU_ADDRESS 0xD0000D84 /end MEASUREMENT
/begin MEASUREMENT InjCrv_facPiI2APSQCorRgn00 "Atmosphärendruckabhängiger Mengenkorrekturfaktor für Voreinspritzung 2 im Regenerationsbetrieb" SWORD Fact 1 100 -4.000000 3.999878 ECU_ADDRESS 0xD0000D8A /end MEASUREMENT
/begin MEASUREMENT InjCrv_facPiI2APSQCorRgn01 "Atmosphärendruckabhängiger Mengenkorrekturfaktor für Voreinspritzung 2 im Regenerationsbetrieb" SWORD Fact 1 100 -4.000000 3.999878 ECU_ADDRESS 0xD0000D8C /end MEASUREMENT
/begin MEASUREMENT InjCrv_facPiI2APSSOECorRgn00 "Luftruckabhängiger Ansteuerbeginnkorrekturfaktor für Voreinspritzung 2 im Regenerationsbetrieb" SWORD Fact 1 100 -4.000000 3.999878 ECU_ADDRESS 0xD0000D92 /end MEASUREMENT
/begin MEASUREMENT InjCrv_facPiI2APSSOECorRgn01 "Luftruckabhängiger Ansteuerbeginnkorrekturfaktor für Voreinspritzung 2 im Regenerationsbetrieb" SWORD Fact 1 100 -4.000000 3.999878 ECU_ADDRESS 0xD0000D94 /end MEASUREMENT
/begin MEASUREMENT InjCrv_facPiI2ATSQCorRgn00 "Ansauglufttemperaturabhängiger Mengenkorrekturfaktor für Voreinspritzung 2 im Regenerationsbetrieb" SWORD Fact 1 100 -4.000000 3.999878 ECU_ADDRESS 0xD0000D9A /end MEASUREMENT
/begin MEASUREMENT InjCrv_facPiI2ATSQCorRgn01 "Ansauglufttemperaturabhängiger Mengenkorrekturfaktor für Voreinspritzung 2 im Regenerationsbetrieb" SWORD Fact 1 100 -4.000000 3.999878 ECU_ADDRESS 0xD0000D9C /end MEASUREMENT
/begin MEASUREMENT InjCrv_facPiI2ATSSOECorRgn00 "Ansauglufttemperaturabhängiger Ansteuerbeginnkorrekturfaktor für Voreinspritzung 2 im Regenerationsbetrieb" SWORD Fact 1 100 -4.000000 3.999878 ECU_ADDRESS 0xD0000DA2 /end MEASUREMENT
/begin MEASUREMENT InjCrv_facPiI2ATSSOECorRgn01 "Ansauglufttemperaturabhängiger Ansteuerbeginnkorrekturfaktor für Voreinspritzung 2 im Regenerationsbetrieb" SWORD Fact 1 100 -4.000000 3.999878 ECU_ADDRESS 0xD0000DA4 /end MEASUREMENT
/begin MEASUREMENT InjCrv_facPiI2ETSQCorRgn00 "Motortemperaturabhängiger Mengenkorrekturfaktor für Voreinspritzung 2 im Regenerationsbetrieb" SWORD Fact 1 100 -4.000000 3.999878 ECU_ADDRESS 0xD0000DAA /end MEASUREMENT
/begin MEASUREMENT InjCrv_facPiI2ETSQCorRgn01 "Motortemperaturabhängiger Mengenkorrekturfaktor für Voreinspritzung 2 im Regenerationsbetrieb" SWORD Fact 1 100 -4.000000 3.999878 ECU_ADDRESS 0xD0000DAC /end MEASUREMENT
/begin MEASUREMENT InjCrv_facPiI2ETSSOECorRgn00 "motortemperaturabhängiger Ansteuerbeginnkorrekturfaktor für Voreinspritzung 2 im Regenerationsbetrieb" SWORD Fact 1 100 -4.000000 3.999878 ECU_ADDRESS 0xD0000DB2 /end MEASUREMENT
/begin MEASUREMENT InjCrv_facPiI2ETSSOECorRgn01 "motortemperaturabhängiger Ansteuerbeginnkorrekturfaktor für Voreinspritzung 2 im Regenerationsbetrieb" SWORD Fact 1 100 -4.000000 3.999878 ECU_ADDRESS 0xD0000DB4 /end MEASUREMENT
/begin MEASUREMENT InjCrv_facPoI1EffRgn00 "" SWORD Fact 1 100 -4.000000 3.999878 ECU_ADDRESS 0xD0000DC0 /end MEASUREMENT
/begin MEASUREMENT InjCrv_facPoI1EffRgn01 "" SWORD Fact 1 100 -4.000000 3.999878 ECU_ADDRESS 0xD0000DC2 /end MEASUREMENT
/begin MEASUREMENT InjCrv_facPoI2APSQCorRgn00 "atmosphärendruckabhängiger Korrekturfaktor für die PoI2 im Regenerationsbetrieb" SWORD Fact 1 100 -4.000000 3.999878 ECU_ADDRESS 0xD0000DC8 /end MEASUREMENT
/begin MEASUREMENT InjCrv_facPoI2APSQCorRgn01 "atmosphärendruckabhängiger Korrekturfaktor für die PoI2 im Regenerationsbetrieb" SWORD Fact 1 100 -4.000000 3.999878 ECU_ADDRESS 0xD0000DCA /end MEASUREMENT
/begin MEASUREMENT InjCrv_facPoI2APSSOECorRgn00 "atmosphärendruckabhängiger Winkelkorrekturfaktoren für PoI2 im Regenerationsbetrieb" SWORD Fact 1 100 -4.000000 3.999878 ECU_ADDRESS 0xD0000DD0 /end MEASUREMENT
/begin MEASUREMENT InjCrv_facPoI2APSSOECorRgn01 "atmosphärendruckabhängiger Winkelkorrekturfaktoren für PoI2 im Regenerationsbetrieb" SWORD Fact 1 100 -4.000000 3.999878 ECU_ADDRESS 0xD0000DD2 /end MEASUREMENT
/begin MEASUREMENT InjCrv_facPoI2APSTICorRgn00 "atmosphärendruckabhängiger Ansteuerbeginn zeit korrektur faktoren für PoI2 im Regenerationsbetrieb" SWORD Fact 1 100 -4.000000 3.999878 ECU_ADDRESS 0xD0000DD4 /end MEASUREMENT
/begin MEASUREMENT InjCrv_facPoI2APSTICorRgn01 "atmosphärendruckabhängiger Ansteuerbeginn zeit korrektur faktoren für PoI2 im Regenerationsbetrieb" SWORD Fact 1 100 -4.000000 3.999878 ECU_ADDRESS 0xD0000DD6 /end MEASUREMENT
/begin MEASUREMENT InjCrv_facPoI2ATSQCorRgn00 "ansauglufttemperaturabhängiger Mengenkorrekturfaktor für den Regenerationsbetrieb für die PoI2" SWORD Fact 1 100 -4.000000 3.999878 ECU_ADDRESS 0xD0000DDA /end MEASUREMENT
/begin MEASUREMENT InjCrv_facPoI2ATSQCorRgn01 "ansauglufttemperaturabhängiger Mengenkorrekturfaktor für den Regenerationsbetrieb für die PoI2" SWORD Fact 1 100 -4.000000 3.999878 ECU_ADDRESS 0xD0000DDC /end MEASUREMENT
/begin MEASUREMENT InjCrv_facPoI2ATSSOECorRgn00 "Ansauglufttemperaturabhängige Winkelkorrekturfaktoren für PoI2 im Regenerationsbetrieb" SWORD Fact 1 100 -4.000000 3.999878 ECU_ADDRESS 0xD0000DE2 /end MEASUREMENT
/begin MEASUREMENT InjCrv_facPoI2ATSSOECorRgn01 "Ansauglufttemperaturabhängige Winkelkorrekturfaktoren für PoI2 im Regenerationsbetrieb" SWORD Fact 1 100 -4.000000 3.999878 ECU_ADDRESS 0xD0000DE4 /end MEASUREMENT
/begin MEASUREMENT InjCrv_facPoI2EffRgn00 "Faktor für den drehmomentbildenden Anteil der Einspritzmenge PoI2 im Regenerationsmodus" SWORD Fact 1 100 -4.000000 3.999878 ECU_ADDRESS 0xD0000DFA /end MEASUREMENT
/begin MEASUREMENT InjCrv_facPoI2EffRgn01 "Faktor für den drehmomentbildenden Anteil der Einspritzmenge PoI2 im Regenerationsmodus" SWORD Fact 1 100 -4.000000 3.999878 ECU_ADDRESS 0xD0000DFC /end MEASUREMENT
/begin MEASUREMENT InjCrv_facPoI2ETSQCorRgn00 "motortemperaturabhängiger Mengenkorrekturfaktor für den Regenerationsbetrieb für die PoI2" SWORD Fact 1 100 -4.000000 3.999878 ECU_ADDRESS 0xD0000DE8 /end MEASUREMENT
/begin MEASUREMENT InjCrv_facPoI2ETSQCorRgn01 "motortemperaturabhängiger Mengenkorrekturfaktor für den Regenerationsbetrieb für die PoI2" SWORD Fact 1 100 -4.000000 3.999878 ECU_ADDRESS 0xD0000DEA /end MEASUREMENT
/begin MEASUREMENT InjCrv_facPoI2ETSSOECorRgn00 "motortemperaturabhängiger Ansteuerbeginnkorrekturfaktor für den Regenerationsbetrieb für die PoI2" SWORD Fact 1 100 -4.000000 3.999878 ECU_ADDRESS 0xD0000DF0 /end MEASUREMENT
/begin MEASUREMENT InjCrv_facPoI2ETSSOECorRgn01 "motortemperaturabhängiger Ansteuerbeginnkorrekturfaktor für den Regenerationsbetrieb für die PoI2" SWORD Fact 1 100 -4.000000 3.999878 ECU_ADDRESS 0xD0000DF2 /end MEASUREMENT
/begin MEASUREMENT InjCrv_facPoI2ETSTICorRgn00 "motortemperaturabhängiger Ansteuerbeginn zeit korrektur faktoren für PoI2 im Regenerationsbetrieb" SWORD Fact 1 100 -4.000000 3.999878 ECU_ADDRESS 0xD0000DF6 /end MEASUREMENT
/begin MEASUREMENT InjCrv_facPoI2ETSTICorRgn01 "motortemperaturabhängiger Ansteuerbeginn zeit korrektur faktoren für PoI2 im Regenerationsbetrieb" SWORD Fact 1 100 -4.000000 3.999878 ECU_ADDRESS 0xD0000DF8 /end MEASUREMENT
/begin MEASUREMENT InjCrv_phiMI1APSCorRgn_mp00 "Gewichtete Winkelkorrekturen abhängig von dem Umgebungsluftdruck für die MI1 im Regenerationsbetrieb" SWORD AngleCrS 1 100 -720.0000 719.9780 ECU_ADDRESS 0xC000C004 /end MEASUREMENT
/begin MEASUREMENT InjCrv_phiMI1APSCorRgn_mp01 "Gewichtete Winkelkorrekturen abhängig von dem Umgebungsluftdruck für die MI1 im Regenerationsbetrieb" SWORD AngleCrS 1 100 -720.0000 719.9780 ECU_ADDRESS 0xC000C006 /end MEASUREMENT
/begin MEASUREMENT InjCrv_phiMI1ATSCorRgn_mp00 "Gewichteter Korrekturwert abhängig von der Ansauglufttemperatur abhängig vom Ansteuerbeginn der MI1 im Regenerationsbetrieb" SWORD AngleCrS 1 100 -720.0000 719.9780 ECU_ADDRESS 0xC000C008 /end MEASUREMENT
/begin MEASUREMENT InjCrv_phiMI1ATSCorRgn_mp01 "Gewichteter Korrekturwert abhängig von der Ansauglufttemperatur abhängig vom Ansteuerbeginn der MI1 im Regenerationsbetrieb" SWORD AngleCrS 1 100 -720.0000 719.9780 ECU_ADDRESS 0xC000C00A /end MEASUREMENT
/begin MEASUREMENT InjCrv_phiMI1BasRgn_mp00 "Regenerationswert für den Ansteuerbeginn der MI1" SWORD AngleCrS 1 100 -720.0000 719.9780 ECU_ADDRESS 0xC000C010 /end MEASUREMENT
/begin MEASUREMENT InjCrv_phiMI1BasRgn_mp01 "Regenerationswert für den Ansteuerbeginn der MI1" SWORD AngleCrS 1 100 -720.0000 719.9780 ECU_ADDRESS 0xC000C012 /end MEASUREMENT
/begin MEASUREMENT InjCrv_phiMI1CylOffs00 "Messpunkt Array Zyl[1-8] Offset Einspritzwinkel der MI1" SWORD AngleCrS 1 100 -720.0000 719.9780 ECU_ADDRESS 0xD0000E10 /end MEASUREMENT
/begin MEASUREMENT InjCrv_phiMI1CylOffs01 "Messpunkt Array Zyl[1-8] Offset Einspritzwinkel der MI1" SWORD AngleCrS 1 100 -720.0000 719.9780 ECU_ADDRESS 0xD0000E12 /end MEASUREMENT
/begin MEASUREMENT InjCrv_phiMI1CylOffs02 "Messpunkt Array Zyl[1-8] Offset Einspritzwinkel der MI1" SWORD AngleCrS 1 100 -720.0000 719.9780 ECU_ADDRESS 0xD0000E14 /end MEASUREMENT
/begin MEASUREMENT InjCrv_phiMI1CylOffs03 "Messpunkt Array Zyl[1-8] Offset Einspritzwinkel der MI1" SWORD AngleCrS 1 100 -720.0000 719.9780 ECU_ADDRESS 0xD0000E16 /end MEASUREMENT
/begin MEASUREMENT InjCrv_phiMI1CylOffs04 "Messpunkt Array Zyl[1-8] Offset Einspritzwinkel der MI1" SWORD AngleCrS 1 100 -720.0000 719.9780 ECU_ADDRESS 0xD0000E18 /end MEASUREMENT
/begin MEASUREMENT InjCrv_phiMI1CylOffs05 "Messpunkt Array Zyl[1-8] Offset Einspritzwinkel der MI1" SWORD AngleCrS 1 100 -720.0000 719.9780 ECU_ADDRESS 0xD0000E1A /end MEASUREMENT
/begin MEASUREMENT InjCrv_phiMI1EnvCorRgn00 "Ansteuerbeginn Korrekturwinkel für MI1 im Regenerationsbetrieb" SWORD AngleCrS 1 100 -720.0000 719.9780 ECU_ADDRESS 0xD0000E2A /end MEASUREMENT
/begin MEASUREMENT InjCrv_phiMI1EnvCorRgn01 "Ansteuerbeginn Korrekturwinkel für MI1 im Regenerationsbetrieb" SWORD AngleCrS 1 100 -720.0000 719.9780 ECU_ADDRESS 0xD0000E2C /end MEASUREMENT
/begin MEASUREMENT InjCrv_phiMI1ETSCorRgn_mp00 "Gewichteter Korrekturwert abhängig von der Motortemperatur abhängig vom Ansteuerbeginn der MI1 im Regenerationsbetrieb" SWORD AngleCrS 1 100 -720.0000 719.9780 ECU_ADDRESS 0xC000C00C /end MEASUREMENT
/begin MEASUREMENT InjCrv_phiMI1ETSCorRgn_mp01 "Gewichteter Korrekturwert abhängig von der Motortemperatur abhängig vom Ansteuerbeginn der MI1 im Regenerationsbetrieb" SWORD AngleCrS 1 100 -720.0000 719.9780 ECU_ADDRESS 0xC000C00E /end MEASUREMENT
/begin MEASUREMENT InjCrv_phiMI1Rgn00 "Regenerationswert für den Ansteuerbeginn der MI1" SWORD AngleCrS 1 100 -720.0000 719.9780 ECU_ADDRESS 0xD0000E34 /end MEASUREMENT
/begin MEASUREMENT InjCrv_phiMI1Rgn01 "Regenerationswert für den Ansteuerbeginn der MI1" SWORD AngleCrS 1 100 -720.0000 719.9780 ECU_ADDRESS 0xD0000E36 /end MEASUREMENT
/begin MEASUREMENT InjCrv_phiMI1RgnAdd_mp00 "Additiver Bypasseingrif für Winkel der Haupteinspritzung im Regenerationsbetrieb" SWORD AngleCrS 1 100 -720.0000 719.9780 ECU_ADDRESS 0xC000C014 /end MEASUREMENT
/begin MEASUREMENT InjCrv_phiMI1RgnAdd_mp01 "Additiver Bypasseingrif für Winkel der Haupteinspritzung im Regenerationsbetrieb" SWORD AngleCrS 1 100 -720.0000 719.9780 ECU_ADDRESS 0xC000C016 /end MEASUREMENT
/begin MEASUREMENT InjCrv_phiPoI2APSCorRgn_mp00 "Gewichtete Winkelkorrekturen abhängig von dem Umgebungsluftdruck für die PoI2 im Regenerationsbetrieb" SWORD AngleCrS 1 100 -720.0000 719.9780 ECU_ADDRESS 0xC000C0D4 /end MEASUREMENT
/begin MEASUREMENT InjCrv_phiPoI2APSCorRgn_mp01 "Gewichtete Winkelkorrekturen abhängig von dem Umgebungsluftdruck für die PoI2 im Regenerationsbetrieb" SWORD AngleCrS 1 100 -720.0000 719.9780 ECU_ADDRESS 0xC000C0D6 /end MEASUREMENT
/begin MEASUREMENT InjCrv_phiPoI2ATSCorRgn_mp00 "Gewichtete Winkelkorrekturen abhängig von der Ansauglufttemperatur für die PoI2 im Regenerationsbetrieb" SWORD AngleCrS 1 100 -720.0000 719.9780 ECU_ADDRESS 0xC000C0D8 /end MEASUREMENT
/begin MEASUREMENT InjCrv_phiPoI2ATSCorRgn_mp01 "Gewichtete Winkelkorrekturen abhängig von der Ansauglufttemperatur für die PoI2 im Regenerationsbetrieb" SWORD AngleCrS 1 100 -720.0000 719.9780 ECU_ADDRESS 0xC000C0DA /end MEASUREMENT
/begin MEASUREMENT InjCrv_phiPoI2BasRgn_mp00 "Grundwert der Winkelkomponente Ansteuerbeginn PoI2 im Regenerationsbetrieb" SWORD AngleCrS 1 100 -720.0000 719.9780 ECU_ADDRESS 0xC000C0F4 /end MEASUREMENT
/begin MEASUREMENT InjCrv_phiPoI2BasRgn_mp01 "Grundwert der Winkelkomponente Ansteuerbeginn PoI2 im Regenerationsbetrieb" SWORD AngleCrS 1 100 -720.0000 719.9780 ECU_ADDRESS 0xC000C0F6 /end MEASUREMENT
/begin MEASUREMENT InjCrv_phiPoI2EnvCorRgn00 "Umgebungsbedingungsabhängige Korrekturwinkel für Nacheinspritzung 2 im Regenerationsbetrieb" SWORD AngleCrS 1 100 -720.0000 719.9780 ECU_ADDRESS 0xD0000E58 /end MEASUREMENT
/begin MEASUREMENT InjCrv_phiPoI2EnvCorRgn01 "Umgebungsbedingungsabhängige Korrekturwinkel für Nacheinspritzung 2 im Regenerationsbetrieb" SWORD AngleCrS 1 100 -720.0000 719.9780 ECU_ADDRESS 0xD0000E5A /end MEASUREMENT
/begin MEASUREMENT InjCrv_phiPoI2ETSCorRgn_mp00 "Gewichtete Winkelkorrekturen abhängig von der Motortemperatur für die PoI2 im Regenerationsbetrieb" SWORD AngleCrS 1 100 -720.0000 719.9780 ECU_ADDRESS 0xC000C0DC /end MEASUREMENT
/begin MEASUREMENT InjCrv_phiPoI2ETSCorRgn_mp01 "Gewichtete Winkelkorrekturen abhängig von der Motortemperatur für die PoI2 im Regenerationsbetrieb" SWORD AngleCrS 1 100 -720.0000 719.9780 ECU_ADDRESS 0xC000C0DE /end MEASUREMENT
/begin MEASUREMENT InjCrv_phiPoI2Rgn00 "Grundwert der Winkelkomponente Ansteuerbeginn PoI2 im Regenerationsbetrieb" SWORD AngleCrS 1 100 -720.0000 719.9780 ECU_ADDRESS 0xD0000E5C /end MEASUREMENT
/begin MEASUREMENT InjCrv_phiPoI2Rgn01 "Grundwert der Winkelkomponente Ansteuerbeginn PoI2 im Regenerationsbetrieb" SWORD AngleCrS 1 100 -720.0000 719.9780 ECU_ADDRESS 0xD0000E5E /end MEASUREMENT
/begin MEASUREMENT InjCrv_phiPoI2RgnAdd_mp00 "Additiver Bypasseingriff für Winkel der Nacheinspritzung 2 im Regenerationsbetrieb" SWORD AngleCrS 1 100 -720.0000 719.9780 ECU_ADDRESS 0xC000C0F8 /end MEASUREMENT
/begin MEASUREMENT InjCrv_phiPoI2RgnAdd_mp01 "Additiver Bypasseingriff für Winkel der Nacheinspritzung 2 im Regenerationsbetrieb" SWORD AngleCrS 1 100 -720.0000 719.9780 ECU_ADDRESS 0xC000C0FA /end MEASUREMENT
/begin MEASUREMENT InjCrv_qMI1CorRgn00 "Regenerationskorrekturwert für die Menge der MI1" SWORD InjMass 1 100 -327.6800 327.6700 ECU_ADDRESS 0xD0000E66 /end MEASUREMENT
/begin MEASUREMENT InjCrv_qMI1CorRgn01 "Regenerationskorrekturwert für die Menge der MI1" SWORD InjMass 1 100 -327.6800 327.6700 ECU_ADDRESS 0xD0000E68 /end MEASUREMENT
/begin MEASUREMENT InjCrv_qPiI1APSCorRgn1_mp00 "Druckabhängiger Basismengenkorrekturwert 1 der Voreinspritzung 1 im Regenerationsbetrieb" SWORD InjMass 1 100 -327.6800 327.6700 ECU_ADDRESS 0xC000C03C /end MEASUREMENT
/begin MEASUREMENT InjCrv_qPiI1APSCorRgn1_mp01 "Druckabhängiger Basismengenkorrekturwert 1 der Voreinspritzung 1 im Regenerationsbetrieb" SWORD InjMass 1 100 -327.6800 327.6700 ECU_ADDRESS 0xC000C03E /end MEASUREMENT
/begin MEASUREMENT InjCrv_qPiI1APSCorRgn2_mp00 "Druckabhängiger Basismengenkorrekturwert 1 der Voreinspritzung 1 im Regenerationsbetrieb" SWORD InjMass 1 100 -327.6800 327.6700 ECU_ADDRESS 0xC000C040 /end MEASUREMENT
/begin MEASUREMENT InjCrv_qPiI1APSCorRgn2_mp01 "Druckabhängiger Basismengenkorrekturwert 1 der Voreinspritzung 1 im Regenerationsbetrieb" SWORD InjMass 1 100 -327.6800 327.6700 ECU_ADDRESS 0xC000C042 /end MEASUREMENT
/begin MEASUREMENT InjCrv_qPiI1ATSCorRgn1_mp00 "Lufttemperaturabhängiger Basismengenkorrekturwert 1 der PiI1 im Regenerationsbetrieb" SWORD InjMass 1 100 -327.6800 327.6700 ECU_ADDRESS 0xC000C044 /end MEASUREMENT
/begin MEASUREMENT InjCrv_qPiI1ATSCorRgn1_mp01 "Lufttemperaturabhängiger Basismengenkorrekturwert 1 der PiI1 im Regenerationsbetrieb" SWORD InjMass 1 100 -327.6800 327.6700 ECU_ADDRESS 0xC000C046 /end MEASUREMENT
/begin MEASUREMENT InjCrv_qPiI1ATSCorRgn2_mp00 "Lufttemperaturabhängiger Basismengenkorrekturwert 2 der PiI1 im Regenerationsbetrieb" SWORD InjMass 1 100 -327.6800 327.6700 ECU_ADDRESS 0xC000C048 /end MEASUREMENT
/begin MEASUREMENT InjCrv_qPiI1ATSCorRgn2_mp01 "Lufttemperaturabhängiger Basismengenkorrekturwert 2 der PiI1 im Regenerationsbetrieb" SWORD InjMass 1 100 -327.6800 327.6700 ECU_ADDRESS 0xC000C04A /end MEASUREMENT
/begin MEASUREMENT InjCrv_qPiI1BasRgn_mp00 "Basiswert für die Mengenkorrektur der Voreinspritzung 1 im Regenerationsbetrieb" SWORD InjMass 1 100 -327.6800 327.6700 ECU_ADDRESS 0xC000C06C /end MEASUREMENT
/begin MEASUREMENT InjCrv_qPiI1BasRgn_mp01 "Basiswert für die Mengenkorrektur der Voreinspritzung 1 im Regenerationsbetrieb" SWORD InjMass 1 100 -327.6800 327.6700 ECU_ADDRESS 0xC000C06E /end MEASUREMENT
/begin MEASUREMENT InjCrv_qPiI1CylOffs00 "Messpunkt Array Zyl[1-8] Offset Einspritzmenge der PiI1" SWORD InjMassInj 1 100 -327.6800 327.6700 ECU_ADDRESS 0xD0000E7A /end MEASUREMENT
/begin MEASUREMENT InjCrv_qPiI1CylOffs01 "Messpunkt Array Zyl[1-8] Offset Einspritzmenge der PiI1" SWORD InjMassInj 1 100 -327.6800 327.6700 ECU_ADDRESS 0xD0000E7C /end MEASUREMENT
/begin MEASUREMENT InjCrv_qPiI1CylOffs02 "Messpunkt Array Zyl[1-8] Offset Einspritzmenge der PiI1" SWORD InjMassInj 1 100 -327.6800 327.6700 ECU_ADDRESS 0xD0000E7E /end MEASUREMENT
/begin MEASUREMENT InjCrv_qPiI1CylOffs03 "Messpunkt Array Zyl[1-8] Offset Einspritzmenge der PiI1" SWORD InjMassInj 1 100 -327.6800 327.6700 ECU_ADDRESS 0xD0000E80 /end MEASUREMENT
/begin MEASUREMENT InjCrv_qPiI1CylOffs04 "Messpunkt Array Zyl[1-8] Offset Einspritzmenge der PiI1" SWORD InjMassInj 1 100 -327.6800 327.6700 ECU_ADDRESS 0xD0000E82 /end MEASUREMENT
/begin MEASUREMENT InjCrv_qPiI1CylOffs05 "Messpunkt Array Zyl[1-8] Offset Einspritzmenge der PiI1" SWORD InjMassInj 1 100 -327.6800 327.6700 ECU_ADDRESS 0xD0000E84 /end MEASUREMENT
/begin MEASUREMENT InjCrv_qPiI1Des00 "gewünschte Einspritzmenge PiI 1" SWORD InjMass 1 100 -327.6800 327.6700 ECU_ADDRESS 0xD0000E86 /end MEASUREMENT
/begin MEASUREMENT InjCrv_qPiI1Des01 "gewünschte Einspritzmenge PiI 1" SWORD InjMass 1 100 -327.6800 327.6700 ECU_ADDRESS 0xD0000E88 /end MEASUREMENT
/begin MEASUREMENT InjCrv_qPiI1Des02 "gewünschte Einspritzmenge PiI 1" SWORD InjMass 1 100 -327.6800 327.6700 ECU_ADDRESS 0xD0000E8A /end MEASUREMENT
/begin MEASUREMENT InjCrv_qPiI1Des03 "gewünschte Einspritzmenge PiI 1" SWORD InjMass 1 100 -327.6800 327.6700 ECU_ADDRESS 0xD0000E8C /end MEASUREMENT
/begin MEASUREMENT InjCrv_qPiI1Des04 "gewünschte Einspritzmenge PiI 1" SWORD InjMass 1 100 -327.6800 327.6700 ECU_ADDRESS 0xD0000E8E /end MEASUREMENT
/begin MEASUREMENT InjCrv_qPiI1Des05 "gewünschte Einspritzmenge PiI 1" SWORD InjMass 1 100 -327.6800 327.6700 ECU_ADDRESS 0xD0000E90 /end MEASUREMENT
/begin MEASUREMENT InjCrv_qPiI1DesAdd_mp00 "Additiver Bypasseingriff für gewünschte Menge der Voreinspritzung 1" SWORD InjMass 1 100 -327.6800 327.6700 ECU_ADDRESS 0xC000C018 /end MEASUREMENT
/begin MEASUREMENT InjCrv_qPiI1DesAdd_mp01 "Additiver Bypasseingriff für gewünschte Menge der Voreinspritzung 1" SWORD InjMass 1 100 -327.6800 327.6700 ECU_ADDRESS 0xC000C01A /end MEASUREMENT
/begin MEASUREMENT InjCrv_qPiI1DesAdd_mp02 "Additiver Bypasseingriff für gewünschte Menge der Voreinspritzung 1" SWORD InjMass 1 100 -327.6800 327.6700 ECU_ADDRESS 0xC000C01C /end MEASUREMENT
/begin MEASUREMENT InjCrv_qPiI1DesAdd_mp03 "Additiver Bypasseingriff für gewünschte Menge der Voreinspritzung 1" SWORD InjMass 1 100 -327.6800 327.6700 ECU_ADDRESS 0xC000C01E /end MEASUREMENT
/begin MEASUREMENT InjCrv_qPiI1DesAdd_mp04 "Additiver Bypasseingriff für gewünschte Menge der Voreinspritzung 1" SWORD InjMass 1 100 -327.6800 327.6700 ECU_ADDRESS 0xC000C020 /end MEASUREMENT
/begin MEASUREMENT InjCrv_qPiI1DesAdd_mp05 "Additiver Bypasseingriff für gewünschte Menge der Voreinspritzung 1" SWORD InjMass 1 100 -327.6800 327.6700 ECU_ADDRESS 0xC000C022 /end MEASUREMENT
/begin MEASUREMENT InjCrv_qPiI1EnvCorRgn100 "Korrekturmenge 1 für Voreinspritzung 1 im Regenerationsbetrieb" SWORD InjMass 1 100 -327.6800 327.6700 ECU_ADDRESS 0xD0000E96 /end MEASUREMENT
/begin MEASUREMENT InjCrv_qPiI1EnvCorRgn101 "Korrekturmenge 1 für Voreinspritzung 1 im Regenerationsbetrieb" SWORD InjMass 1 100 -327.6800 327.6700 ECU_ADDRESS 0xD0000E98 /end MEASUREMENT
/begin MEASUREMENT InjCrv_qPiI1EnvCorRgn200 "Korrekturmenge 2 für Voreinspritzung 1 im Regenerationsbetrieb" SWORD InjMass 1 100 -327.6800 327.6700 ECU_ADDRESS 0xD0000E9A /end MEASUREMENT
/begin MEASUREMENT InjCrv_qPiI1EnvCorRgn201 "Korrekturmenge 2 für Voreinspritzung 1 im Regenerationsbetrieb" SWORD InjMass 1 100 -327.6800 327.6700 ECU_ADDRESS 0xD0000E9C /end MEASUREMENT
/begin MEASUREMENT InjCrv_qPiI1ETSCorRgn1_mp00 "Motortemperaturabhängiger Basismengenkorrekturwert 1 der PiI1 im Regenerationsbetrieb" SWORD InjMass 1 100 -327.6800 327.6700 ECU_ADDRESS 0xC000C04C /end MEASUREMENT
/begin MEASUREMENT InjCrv_qPiI1ETSCorRgn1_mp01 "Motortemperaturabhängiger Basismengenkorrekturwert 1 der PiI1 im Regenerationsbetrieb" SWORD InjMass 1 100 -327.6800 327.6700 ECU_ADDRESS 0xC000C04E /end MEASUREMENT
/begin MEASUREMENT InjCrv_qPiI1ETSCorRgn2_mp00 "Motortemperaturabhängiger Basismengenkorrekturwert 2 der PiI1 im Regenerationsbetrieb" SWORD InjMass 1 100 -327.6800 327.6700 ECU_ADDRESS 0xC000C050 /end MEASUREMENT
/begin MEASUREMENT InjCrv_qPiI1ETSCorRgn2_mp01 "Motortemperaturabhängiger Basismengenkorrekturwert 2 der PiI1 im Regenerationsbetrieb" SWORD InjMass 1 100 -327.6800 327.6700 ECU_ADDRESS 0xC000C052 /end MEASUREMENT
/begin MEASUREMENT InjCrv_qPiI1Rgn00 "Regenerationswert für die Einspritmenge der PiI1" SWORD InjMass 1 100 -327.6800 327.6700 ECU_ADDRESS 0xD0000E9E /end MEASUREMENT
/begin MEASUREMENT InjCrv_qPiI1Rgn01 "Regenerationswert für die Einspritmenge der PiI1" SWORD InjMass 1 100 -327.6800 327.6700 ECU_ADDRESS 0xD0000EA0 /end MEASUREMENT
/begin MEASUREMENT InjCrv_qPiI1RgnAdd_mp00 "Additiver Bypasseingriff für Menge der Voreinspritzung 1 im Regenerationsbetrieb" SWORD InjMass 1 100 -327.6800 327.6700 ECU_ADDRESS 0xC000C070 /end MEASUREMENT
/begin MEASUREMENT InjCrv_qPiI1RgnAdd_mp01 "Additiver Bypasseingriff für Menge der Voreinspritzung 1 im Regenerationsbetrieb" SWORD InjMass 1 100 -327.6800 327.6700 ECU_ADDRESS 0xC000C072 /end MEASUREMENT
/begin MEASUREMENT InjCrv_qPiI2APSCorRgn_mp00 "Druckabhängiger Basismengenkorrekturwert der Voreinspritzung 2 im Regenerationsbetrieb" SWORD InjMassInj 1 100 -327.6800 327.6700 ECU_ADDRESS 0xC000C07C /end MEASUREMENT
/begin MEASUREMENT InjCrv_qPiI2APSCorRgn_mp01 "Druckabhängiger Basismengenkorrekturwert der Voreinspritzung 2 im Regenerationsbetrieb" SWORD InjMassInj 1 100 -327.6800 327.6700 ECU_ADDRESS 0xC000C07E /end MEASUREMENT
/begin MEASUREMENT InjCrv_qPiI2ATSCorRgn_mp00 "Ansauglufttemperaturabhängiger Basismengenkorrekturwert der PiI2 im Regenerationsbetrieb" SWORD InjMassInj 1 100 -327.6800 327.6700 ECU_ADDRESS 0xC000C080 /end MEASUREMENT
/begin MEASUREMENT InjCrv_qPiI2ATSCorRgn_mp01 "Ansauglufttemperaturabhängiger Basismengenkorrekturwert der PiI2 im Regenerationsbetrieb" SWORD InjMassInj 1 100 -327.6800 327.6700 ECU_ADDRESS 0xC000C082 /end MEASUREMENT
/begin MEASUREMENT InjCrv_qPiI2BasRgn_mp00 "Basiswert für die Mengenkorrektur der Voreinspritzung 2 im Regenerationsbetrieb" SWORD InjMass 1 100 -327.6800 327.6700 ECU_ADDRESS 0xC000C094 /end MEASUREMENT
/begin MEASUREMENT InjCrv_qPiI2BasRgn_mp01 "Basiswert für die Mengenkorrektur der Voreinspritzung 2 im Regenerationsbetrieb" SWORD InjMass 1 100 -327.6800 327.6700 ECU_ADDRESS 0xC000C096 /end MEASUREMENT
/begin MEASUREMENT InjCrv_qPiI2Des00 "gewünschte Einspritzmenge PiI 2" SWORD InjMass 1 100 -327.6800 327.6700 ECU_ADDRESS 0xD0000EA8 /end MEASUREMENT
/begin MEASUREMENT InjCrv_qPiI2Des01 "gewünschte Einspritzmenge PiI 2" SWORD InjMass 1 100 -327.6800 327.6700 ECU_ADDRESS 0xD0000EAA /end MEASUREMENT
/begin MEASUREMENT InjCrv_qPiI2Des02 "gewünschte Einspritzmenge PiI 2" SWORD InjMass 1 100 -327.6800 327.6700 ECU_ADDRESS 0xD0000EAC /end MEASUREMENT
/begin MEASUREMENT InjCrv_qPiI2Des03 "gewünschte Einspritzmenge PiI 2" SWORD InjMass 1 100 -327.6800 327.6700 ECU_ADDRESS 0xD0000EAE /end MEASUREMENT
/begin MEASUREMENT InjCrv_qPiI2Des04 "gewünschte Einspritzmenge PiI 2" SWORD InjMass 1 100 -327.6800 327.6700 ECU_ADDRESS 0xD0000EB0 /end MEASUREMENT
/begin MEASUREMENT InjCrv_qPiI2Des05 "gewünschte Einspritzmenge PiI 2" SWORD InjMass 1 100 -327.6800 327.6700 ECU_ADDRESS 0xD0000EB2 /end MEASUREMENT
/begin MEASUREMENT InjCrv_qPiI2DesAdd_mp00 "Additiver Bypasseingriff für gewünschte Menge der Voreinspritzung 2" SWORD InjMass 1 100 -327.6800 327.6700 ECU_ADDRESS 0xC000C024 /end MEASUREMENT
/begin MEASUREMENT InjCrv_qPiI2DesAdd_mp01 "Additiver Bypasseingriff für gewünschte Menge der Voreinspritzung 2" SWORD InjMass 1 100 -327.6800 327.6700 ECU_ADDRESS 0xC000C026 /end MEASUREMENT
/begin MEASUREMENT InjCrv_qPiI2DesAdd_mp02 "Additiver Bypasseingriff für gewünschte Menge der Voreinspritzung 2" SWORD InjMass 1 100 -327.6800 327.6700 ECU_ADDRESS 0xC000C028 /end MEASUREMENT
/begin MEASUREMENT InjCrv_qPiI2DesAdd_mp03 "Additiver Bypasseingriff für gewünschte Menge der Voreinspritzung 2" SWORD InjMass 1 100 -327.6800 327.6700 ECU_ADDRESS 0xC000C02A /end MEASUREMENT
/begin MEASUREMENT InjCrv_qPiI2DesAdd_mp04 "Additiver Bypasseingriff für gewünschte Menge der Voreinspritzung 2" SWORD InjMass 1 100 -327.6800 327.6700 ECU_ADDRESS 0xC000C02C /end MEASUREMENT
/begin MEASUREMENT InjCrv_qPiI2DesAdd_mp05 "Additiver Bypasseingriff für gewünschte Menge der Voreinspritzung 2" SWORD InjMass 1 100 -327.6800 327.6700 ECU_ADDRESS 0xC000C02E /end MEASUREMENT
/begin MEASUREMENT InjCrv_qPiI2EnvCorRgn00 "Korrekturmenge für Voreinspritzung 2 im Regenerationsbetrieb" SWORD InjMassInj 1 100 -327.6800 327.6700 ECU_ADDRESS 0xD0000EB6 /end MEASUREMENT
/begin MEASUREMENT InjCrv_qPiI2EnvCorRgn01 "Korrekturmenge für Voreinspritzung 2 im Regenerationsbetrieb" SWORD InjMassInj 1 100 -327.6800 327.6700 ECU_ADDRESS 0xD0000EB8 /end MEASUREMENT
/begin MEASUREMENT InjCrv_qPiI2ETSCorRgn_mp00 "Motortemperaturabhängiger Basismengenkorrekturwert der PiI2 im Regenerationsbetrieb" SWORD InjMassInj 1 100 -327.6800 327.6700 ECU_ADDRESS 0xC000C084 /end MEASUREMENT
/begin MEASUREMENT InjCrv_qPiI2ETSCorRgn_mp01 "Motortemperaturabhängiger Basismengenkorrekturwert der PiI2 im Regenerationsbetrieb" SWORD InjMassInj 1 100 -327.6800 327.6700 ECU_ADDRESS 0xC000C086 /end MEASUREMENT
/begin MEASUREMENT InjCrv_qPiI2Rgn00 "Regenerationswert für die Einspritzmenge der PiI2" SWORD InjMass 1 100 -327.6800 327.6700 ECU_ADDRESS 0xD0000EBA /end MEASUREMENT
/begin MEASUREMENT InjCrv_qPiI2Rgn01 "Regenerationswert für die Einspritzmenge der PiI2" SWORD InjMass 1 100 -327.6800 327.6700 ECU_ADDRESS 0xD0000EBC /end MEASUREMENT
/begin MEASUREMENT InjCrv_qPiI2RgnAdd_mp00 "Additiver Bypasseingriff für Menge der Voreinspritzung 2 im Regenerationsbetrieb" SWORD InjMass 1 100 -327.6800 327.6700 ECU_ADDRESS 0xC000C098 /end MEASUREMENT
/begin MEASUREMENT InjCrv_qPiI2RgnAdd_mp01 "Additiver Bypasseingriff für Menge der Voreinspritzung 2 im Regenerationsbetrieb" SWORD InjMass 1 100 -327.6800 327.6700 ECU_ADDRESS 0xC000C09A /end MEASUREMENT
/begin MEASUREMENT InjCrv_qPiI3Des00 "gewünschte Einspritzmenge PiI 3" SWORD InjMass 1 100 -327.6800 327.6700 ECU_ADDRESS 0xD0000EBE /end MEASUREMENT
/begin MEASUREMENT InjCrv_qPiI3Des01 "gewünschte Einspritzmenge PiI 3" SWORD InjMass 1 100 -327.6800 327.6700 ECU_ADDRESS 0xD0000EC0 /end MEASUREMENT
/begin MEASUREMENT InjCrv_qPiI3Des02 "gewünschte Einspritzmenge PiI 3" SWORD InjMass 1 100 -327.6800 327.6700 ECU_ADDRESS 0xD0000EC2 /end MEASUREMENT
/begin MEASUREMENT InjCrv_qPiI3Des03 "gewünschte Einspritzmenge PiI 3" SWORD InjMass 1 100 -327.6800 327.6700 ECU_ADDRESS 0xD0000EC4 /end MEASUREMENT
/begin MEASUREMENT InjCrv_qPiI3Des04 "gewünschte Einspritzmenge PiI 3" SWORD InjMass 1 100 -327.6800 327.6700 ECU_ADDRESS 0xD0000EC6 /end MEASUREMENT
/begin MEASUREMENT InjCrv_qPiI3Des05 "gewünschte Einspritzmenge PiI 3" SWORD InjMass 1 100 -327.6800 327.6700 ECU_ADDRESS 0xD0000EC8 /end MEASUREMENT
/begin MEASUREMENT InjCrv_qPiI3DesAdd_mp00 "Additiver Bypasseingriff für gewünschte Menge der Voreinspritzung 3" SWORD InjMass 1 100 -327.6800 327.6700 ECU_ADDRESS 0xC000C030 /end MEASUREMENT
/begin MEASUREMENT InjCrv_qPiI3DesAdd_mp01 "Additiver Bypasseingriff für gewünschte Menge der Voreinspritzung 3" SWORD InjMass 1 100 -327.6800 327.6700 ECU_ADDRESS 0xC000C032 /end MEASUREMENT
/begin MEASUREMENT InjCrv_qPiI3DesAdd_mp02 "Additiver Bypasseingriff für gewünschte Menge der Voreinspritzung 3" SWORD InjMass 1 100 -327.6800 327.6700 ECU_ADDRESS 0xC000C034 /end MEASUREMENT
/begin MEASUREMENT InjCrv_qPiI3DesAdd_mp03 "Additiver Bypasseingriff für gewünschte Menge der Voreinspritzung 3" SWORD InjMass 1 100 -327.6800 327.6700 ECU_ADDRESS 0xC000C036 /end MEASUREMENT
/begin MEASUREMENT InjCrv_qPiI3DesAdd_mp04 "Additiver Bypasseingriff für gewünschte Menge der Voreinspritzung 3" SWORD InjMass 1 100 -327.6800 327.6700 ECU_ADDRESS 0xC000C038 /end MEASUREMENT
/begin MEASUREMENT InjCrv_qPiI3DesAdd_mp05 "Additiver Bypasseingriff für gewünschte Menge der Voreinspritzung 3" SWORD InjMass 1 100 -327.6800 327.6700 ECU_ADDRESS 0xC000C03A /end MEASUREMENT
/begin MEASUREMENT InjCrv_qPoI1BasRgn_mp00 "Basiswert für die Mengenkorrektur der Nacheinspritzung 1 im Regenerationsbetrieb" SWORD InjMass 1 100 -327.6800 327.6700 ECU_ADDRESS 0xC000C0B0 /end MEASUREMENT
/begin MEASUREMENT InjCrv_qPoI1BasRgn_mp01 "Basiswert für die Mengenkorrektur der Nacheinspritzung 1 im Regenerationsbetrieb" SWORD InjMass 1 100 -327.6800 327.6700 ECU_ADDRESS 0xC000C0B2 /end MEASUREMENT
/begin MEASUREMENT InjCrv_qPoI1Des00 "gewünschte Einspritzmenge PoI1" SWORD InjMass 1 100 -327.6800 327.6700 ECU_ADDRESS 0xD0000ECE /end MEASUREMENT
/begin MEASUREMENT InjCrv_qPoI1Des01 "gewünschte Einspritzmenge PoI1" SWORD InjMass 1 100 -327.6800 327.6700 ECU_ADDRESS 0xD0000ED0 /end MEASUREMENT
/begin MEASUREMENT InjCrv_qPoI1Des02 "gewünschte Einspritzmenge PoI1" SWORD InjMass 1 100 -327.6800 327.6700 ECU_ADDRESS 0xD0000ED2 /end MEASUREMENT
/begin MEASUREMENT InjCrv_qPoI1Des03 "gewünschte Einspritzmenge PoI1" SWORD InjMass 1 100 -327.6800 327.6700 ECU_ADDRESS 0xD0000ED4 /end MEASUREMENT
/begin MEASUREMENT InjCrv_qPoI1Des04 "gewünschte Einspritzmenge PoI1" SWORD InjMass 1 100 -327.6800 327.6700 ECU_ADDRESS 0xD0000ED6 /end MEASUREMENT
/begin MEASUREMENT InjCrv_qPoI1Des05 "gewünschte Einspritzmenge PoI1" SWORD InjMass 1 100 -327.6800 327.6700 ECU_ADDRESS 0xD0000ED8 /end MEASUREMENT
/begin MEASUREMENT InjCrv_qPoI1DesAdd_mp00 "Additiver Bypasseingriff für gewünschte Menge der Nacheinspritzung 1" SWORD InjMass 1 100 -327.6800 327.6700 ECU_ADDRESS 0xC000C0A4 /end MEASUREMENT
/begin MEASUREMENT InjCrv_qPoI1DesAdd_mp01 "Additiver Bypasseingriff für gewünschte Menge der Nacheinspritzung 1" SWORD InjMass 1 100 -327.6800 327.6700 ECU_ADDRESS 0xC000C0A6 /end MEASUREMENT
/begin MEASUREMENT InjCrv_qPoI1DesAdd_mp02 "Additiver Bypasseingriff für gewünschte Menge der Nacheinspritzung 1" SWORD InjMass 1 100 -327.6800 327.6700 ECU_ADDRESS 0xC000C0A8 /end MEASUREMENT
/begin MEASUREMENT InjCrv_qPoI1DesAdd_mp03 "Additiver Bypasseingriff für gewünschte Menge der Nacheinspritzung 1" SWORD InjMass 1 100 -327.6800 327.6700 ECU_ADDRESS 0xC000C0AA /end MEASUREMENT
/begin MEASUREMENT InjCrv_qPoI1DesAdd_mp04 "Additiver Bypasseingriff für gewünschte Menge der Nacheinspritzung 1" SWORD InjMass 1 100 -327.6800 327.6700 ECU_ADDRESS 0xC000C0AC /end MEASUREMENT
/begin MEASUREMENT InjCrv_qPoI1DesAdd_mp05 "Additiver Bypasseingriff für gewünschte Menge der Nacheinspritzung 1" SWORD InjMass 1 100 -327.6800 327.6700 ECU_ADDRESS 0xC000C0AE /end MEASUREMENT
/begin MEASUREMENT InjCrv_qPoI1Eff00 "" SWORD InjMass 1 100 -327.6800 327.6700 ECU_ADDRESS 0xD0000EDA /end MEASUREMENT
/begin MEASUREMENT InjCrv_qPoI1Eff01 "" SWORD InjMass 1 100 -327.6800 327.6700 ECU_ADDRESS 0xD0000EDC /end MEASUREMENT
/begin MEASUREMENT InjCrv_qPoI1Eff02 "" SWORD InjMass 1 100 -327.6800 327.6700 ECU_ADDRESS 0xD0000EDE /end MEASUREMENT
/begin MEASUREMENT InjCrv_qPoI1Eff03 "" SWORD InjMass 1 100 -327.6800 327.6700 ECU_ADDRESS 0xD0000EE0 /end MEASUREMENT
/begin MEASUREMENT InjCrv_qPoI1Eff04 "" SWORD InjMass 1 100 -327.6800 327.6700 ECU_ADDRESS 0xD0000EE2 /end MEASUREMENT
/begin MEASUREMENT InjCrv_qPoI1Eff05 "" SWORD InjMass 1 100 -327.6800 327.6700 ECU_ADDRESS 0xD0000EE4 /end MEASUREMENT
/begin MEASUREMENT InjCrv_qPoI1Rgn00 "Grundwert Einspritzmenge PoI1 im Regenerationsbetrieb" SWORD InjMass 1 100 -327.6800 327.6700 ECU_ADDRESS 0xD0000EE8 /end MEASUREMENT
/begin MEASUREMENT InjCrv_qPoI1Rgn01 "Grundwert Einspritzmenge PoI1 im Regenerationsbetrieb" SWORD InjMass 1 100 -327.6800 327.6700 ECU_ADDRESS 0xD0000EEA /end MEASUREMENT
/begin MEASUREMENT InjCrv_qPoI1RgnAdd_mp00 "Additiver Bypasseingriff für Menge der Nacheinspritzung 1 im Regenerationsbetrieb" SWORD InjMass 1 100 -327.6800 327.6700 ECU_ADDRESS 0xC000C0B4 /end MEASUREMENT
/begin MEASUREMENT InjCrv_qPoI1RgnAdd_mp01 "Additiver Bypasseingriff für Menge der Nacheinspritzung 1 im Regenerationsbetrieb" SWORD InjMass 1 100 -327.6800 327.6700 ECU_ADDRESS 0xC000C0B6 /end MEASUREMENT
/begin MEASUREMENT InjCrv_qPoI2APSCorRgn_mp00 "Luftdruckbhängiger Basismengenkorrekturwert der PoI2 im Regenerationsbetrieb" SWORD InjMass 1 100 -327.6800 327.6700 ECU_ADDRESS 0xC000C0E0 /end MEASUREMENT
/begin MEASUREMENT InjCrv_qPoI2APSCorRgn_mp01 "Luftdruckbhängiger Basismengenkorrekturwert der PoI2 im Regenerationsbetrieb" SWORD InjMass 1 100 -327.6800 327.6700 ECU_ADDRESS 0xC000C0E2 /end MEASUREMENT
/begin MEASUREMENT InjCrv_qPoI2ATSCorRgn_mp00 "Lufttemperaturabhängiger Basismengenkorrekturwert der PoI2 im Regenerationsbetrieb" SWORD InjMass 1 100 -327.6800 327.6700 ECU_ADDRESS 0xC000C0E4 /end MEASUREMENT
/begin MEASUREMENT InjCrv_qPoI2ATSCorRgn_mp01 "Lufttemperaturabhängiger Basismengenkorrekturwert der PoI2 im Regenerationsbetrieb" SWORD InjMass 1 100 -327.6800 327.6700 ECU_ADDRESS 0xC000C0E6 /end MEASUREMENT
/begin MEASUREMENT InjCrv_qPoI2BasRgn_mp00 "Einspritzmenge PoI2 Grundwert für den Regenerationsbetrieb" SWORD InjMass 1 100 -327.6800 327.6700 ECU_ADDRESS 0xC000C0FC /end MEASUREMENT
/begin MEASUREMENT InjCrv_qPoI2BasRgn_mp01 "Einspritzmenge PoI2 Grundwert für den Regenerationsbetrieb" SWORD InjMass 1 100 -327.6800 327.6700 ECU_ADDRESS 0xC000C0FE /end MEASUREMENT
/begin MEASUREMENT InjCrv_qPoI2Des00 "Sollmenge Nacheinspritzung 2" SWORD InjMass 1 100 -327.6800 327.6700 ECU_ADDRESS 0xD0000EEE /end MEASUREMENT
/begin MEASUREMENT InjCrv_qPoI2Des01 "Sollmenge Nacheinspritzung 2" SWORD InjMass 1 100 -327.6800 327.6700 ECU_ADDRESS 0xD0000EF0 /end MEASUREMENT
/begin MEASUREMENT InjCrv_qPoI2Des02 "Sollmenge Nacheinspritzung 2" SWORD InjMass 1 100 -327.6800 327.6700 ECU_ADDRESS 0xD0000EF2 /end MEASUREMENT
/begin MEASUREMENT InjCrv_qPoI2Des03 "Sollmenge Nacheinspritzung 2" SWORD InjMass 1 100 -327.6800 327.6700 ECU_ADDRESS 0xD0000EF4 /end MEASUREMENT
/begin MEASUREMENT InjCrv_qPoI2Des04 "Sollmenge Nacheinspritzung 2" SWORD InjMass 1 100 -327.6800 327.6700 ECU_ADDRESS 0xD0000EF6 /end MEASUREMENT
/begin MEASUREMENT InjCrv_qPoI2Des05 "Sollmenge Nacheinspritzung 2" SWORD InjMass 1 100 -327.6800 327.6700 ECU_ADDRESS 0xD0000EF8 /end MEASUREMENT
/begin MEASUREMENT InjCrv_qPoI2DesAdd_mp00 "Additiver Bypasseingriff für gewünschte Menge der Nacheinspritzung 2" SWORD InjMass 1 100 -327.6800 327.6700 ECU_ADDRESS 0xC000C0BC /end MEASUREMENT
/begin MEASUREMENT InjCrv_qPoI2DesAdd_mp01 "Additiver Bypasseingriff für gewünschte Menge der Nacheinspritzung 2" SWORD InjMass 1 100 -327.6800 327.6700 ECU_ADDRESS 0xC000C0BE /end MEASUREMENT
/begin MEASUREMENT InjCrv_qPoI2DesAdd_mp02 "Additiver Bypasseingriff für gewünschte Menge der Nacheinspritzung 2" SWORD InjMass 1 100 -327.6800 327.6700 ECU_ADDRESS 0xC000C0C0 /end MEASUREMENT
/begin MEASUREMENT InjCrv_qPoI2DesAdd_mp03 "Additiver Bypasseingriff für gewünschte Menge der Nacheinspritzung 2" SWORD InjMass 1 100 -327.6800 327.6700 ECU_ADDRESS 0xC000C0C2 /end MEASUREMENT
/begin MEASUREMENT InjCrv_qPoI2DesAdd_mp04 "Additiver Bypasseingriff für gewünschte Menge der Nacheinspritzung 2" SWORD InjMass 1 100 -327.6800 327.6700 ECU_ADDRESS 0xC000C0C4 /end MEASUREMENT
/begin MEASUREMENT InjCrv_qPoI2DesAdd_mp05 "Additiver Bypasseingriff für gewünschte Menge der Nacheinspritzung 2" SWORD InjMass 1 100 -327.6800 327.6700 ECU_ADDRESS 0xC000C0C6 /end MEASUREMENT
/begin MEASUREMENT InjCrv_qPoI2Eff00 "wirksame Einspritzmenge PoI2" SWORD InjMass 1 100 -327.6800 327.6700 ECU_ADDRESS 0xD0000EFA /end MEASUREMENT
/begin MEASUREMENT InjCrv_qPoI2Eff01 "wirksame Einspritzmenge PoI2" SWORD InjMass 1 100 -327.6800 327.6700 ECU_ADDRESS 0xD0000EFC /end MEASUREMENT
/begin MEASUREMENT InjCrv_qPoI2Eff02 "wirksame Einspritzmenge PoI2" SWORD InjMass 1 100 -327.6800 327.6700 ECU_ADDRESS 0xD0000EFE /end MEASUREMENT
/begin MEASUREMENT InjCrv_qPoI2Eff03 "wirksame Einspritzmenge PoI2" SWORD InjMass 1 100 -327.6800 327.6700 ECU_ADDRESS 0xD0000F00 /end MEASUREMENT
/begin MEASUREMENT InjCrv_qPoI2Eff04 "wirksame Einspritzmenge PoI2" SWORD InjMass 1 100 -327.6800 327.6700 ECU_ADDRESS 0xD0000F02 /end MEASUREMENT
/begin MEASUREMENT InjCrv_qPoI2Eff05 "wirksame Einspritzmenge PoI2" SWORD InjMass 1 100 -327.6800 327.6700 ECU_ADDRESS 0xD0000F04 /end MEASUREMENT
/begin MEASUREMENT InjCrv_qPoI2EffAdd_mp00 "Additiver Bypasseingriff für Effektivmenge der Nacheinspritzung 2" SWORD InjMass 1 100 -327.6800 327.6700 ECU_ADDRESS 0xC000C0C8 /end MEASUREMENT
/begin MEASUREMENT InjCrv_qPoI2EffAdd_mp01 "Additiver Bypasseingriff für Effektivmenge der Nacheinspritzung 2" SWORD InjMass 1 100 -327.6800 327.6700 ECU_ADDRESS 0xC000C0CA /end MEASUREMENT
/begin MEASUREMENT InjCrv_qPoI2EffAdd_mp02 "Additiver Bypasseingriff für Effektivmenge der Nacheinspritzung 2" SWORD InjMass 1 100 -327.6800 327.6700 ECU_ADDRESS 0xC000C0CC /end MEASUREMENT
/begin MEASUREMENT InjCrv_qPoI2EffAdd_mp03 "Additiver Bypasseingriff für Effektivmenge der Nacheinspritzung 2" SWORD InjMass 1 100 -327.6800 327.6700 ECU_ADDRESS 0xC000C0CE /end MEASUREMENT
/begin MEASUREMENT InjCrv_qPoI2EffAdd_mp04 "Additiver Bypasseingriff für Effektivmenge der Nacheinspritzung 2" SWORD InjMass 1 100 -327.6800 327.6700 ECU_ADDRESS 0xC000C0D0 /end MEASUREMENT
/begin MEASUREMENT InjCrv_qPoI2EffAdd_mp05 "Additiver Bypasseingriff für Effektivmenge der Nacheinspritzung 2" SWORD InjMass 1 100 -327.6800 327.6700 ECU_ADDRESS 0xC000C0D2 /end MEASUREMENT
/begin MEASUREMENT InjCrv_qPoI2EnvCorRgn00 "Umgebungsbedingungsabhängige Korrekturmenge für Nacheinspritzung 2 im Regenerationsbetrieb" SWORD InjMass 1 100 -327.6800 327.6700 ECU_ADDRESS 0xD0000F08 /end MEASUREMENT
/begin MEASUREMENT InjCrv_qPoI2EnvCorRgn01 "Umgebungsbedingungsabhängige Korrekturmenge für Nacheinspritzung 2 im Regenerationsbetrieb" SWORD InjMass 1 100 -327.6800 327.6700 ECU_ADDRESS 0xD0000F0A /end MEASUREMENT
/begin MEASUREMENT InjCrv_qPoI2ETSCorRgn_mp00 "Motortemperaturabhängiger Basismengenkorrekturwert der PoI2 im Regenerationsbetrieb" SWORD InjMass 1 100 -327.6800 327.6700 ECU_ADDRESS 0xC000C0E8 /end MEASUREMENT
/begin MEASUREMENT InjCrv_qPoI2ETSCorRgn_mp01 "Motortemperaturabhängiger Basismengenkorrekturwert der PoI2 im Regenerationsbetrieb" SWORD InjMass 1 100 -327.6800 327.6700 ECU_ADDRESS 0xC000C0EA /end MEASUREMENT
/begin MEASUREMENT InjCrv_qPoI2Rgn00 "Grundwert Einspritzmenge PoI2 im Regenerationsbetrieb" SWORD InjMass 1 100 -327.6800 327.6700 ECU_ADDRESS 0xD0000F0E /end MEASUREMENT
/begin MEASUREMENT InjCrv_qPoI2Rgn01 "Grundwert Einspritzmenge PoI2 im Regenerationsbetrieb" SWORD InjMass 1 100 -327.6800 327.6700 ECU_ADDRESS 0xD0000F10 /end MEASUREMENT
/begin MEASUREMENT InjCrv_qPoI2RgnAdd_mp00 "Additiver Bypasseingriff für Menge der Nacheinspritzung 2 im Regenerationsbtrieb" SWORD InjMass 1 100 -327.6800 327.6700 ECU_ADDRESS 0xC000C100 /end MEASUREMENT
/begin MEASUREMENT InjCrv_qPoI2RgnAdd_mp01 "Additiver Bypasseingriff für Menge der Nacheinspritzung 2 im Regenerationsbtrieb" SWORD InjMass 1 100 -327.6800 327.6700 ECU_ADDRESS 0xC000C102 /end MEASUREMENT
/begin MEASUREMENT InjCrv_qPoIRem00 "" SWORD InjMass 1 100 -327.6800 327.6700 ECU_ADDRESS 0xD0000F12 /end MEASUREMENT
/begin MEASUREMENT InjCrv_qPoIRem01 "" SWORD InjMass 1 100 -327.6800 327.6700 ECU_ADDRESS 0xD0000F14 /end MEASUREMENT
/begin MEASUREMENT InjCrv_qPoIRem02 "" SWORD InjMass 1 100 -327.6800 327.6700 ECU_ADDRESS 0xD0000F16 /end MEASUREMENT
/begin MEASUREMENT InjCrv_qPoIRem03 "" SWORD InjMass 1 100 -327.6800 327.6700 ECU_ADDRESS 0xD0000F18 /end MEASUREMENT
/begin MEASUREMENT InjCrv_qPoIRem04 "" SWORD InjMass 1 100 -327.6800 327.6700 ECU_ADDRESS 0xD0000F1A /end MEASUREMENT
/begin MEASUREMENT InjCrv_qPoIRem05 "" SWORD InjMass 1 100 -327.6800 327.6700 ECU_ADDRESS 0xD0000F1C /end MEASUREMENT
/begin MEASUREMENT InjCrv_stInjCharActValCyl00 "Zylinderspezifischer Einspritzfreigabestatus" UBYTE OneToOne 1 100 0.00 255.0 ECU_ADDRESS 0xD0001F04 /end MEASUREMENT
/begin MEASUREMENT InjCrv_stInjCharActValCyl01 "Zylinderspezifischer Einspritzfreigabestatus" UBYTE OneToOne 1 100 0.00 255.0 ECU_ADDRESS 0xD0001F05 /end MEASUREMENT
/begin MEASUREMENT InjCrv_stInjCharActValCyl02 "Zylinderspezifischer Einspritzfreigabestatus" UBYTE OneToOne 1 100 0.00 255.0 ECU_ADDRESS 0xD0001F06 /end MEASUREMENT
/begin MEASUREMENT InjCrv_stInjCharActValCyl03 "Zylinderspezifischer Einspritzfreigabestatus" UBYTE OneToOne 1 100 0.00 255.0 ECU_ADDRESS 0xD0001F07 /end MEASUREMENT
/begin MEASUREMENT InjCrv_stInjCharActValCyl04 "Zylinderspezifischer Einspritzfreigabestatus" UBYTE OneToOne 1 100 0.00 255.0 ECU_ADDRESS 0xD0001F08 /end MEASUREMENT
/begin MEASUREMENT InjCrv_stInjCharActValCyl05 "Zylinderspezifischer Einspritzfreigabestatus" UBYTE OneToOne 1 100 0.00 255.0 ECU_ADDRESS 0xD0001F09 /end MEASUREMENT
/begin MEASUREMENT InjCrv_stInjCharShOffTst00 "Einspritzcharakteristik im Fall des Abschallttests" UBYTE OneToOne 1 100 0.00 255.0 ECU_ADDRESS 0xD0001F0F /end MEASUREMENT
/begin MEASUREMENT InjCrv_stInjCharShOffTst01 "Einspritzcharakteristik im Fall des Abschallttests" UBYTE OneToOne 1 100 0.00 255.0 ECU_ADDRESS 0xD0001F10 /end MEASUREMENT
/begin MEASUREMENT InjCrv_stInjCharShOffTst02 "Einspritzcharakteristik im Fall des Abschallttests" UBYTE OneToOne 1 100 0.00 255.0 ECU_ADDRESS 0xD0001F11 /end MEASUREMENT
/begin MEASUREMENT InjCrv_stInjCharShOffTst03 "Einspritzcharakteristik im Fall des Abschallttests" UBYTE OneToOne 1 100 0.00 255.0 ECU_ADDRESS 0xD0001F12 /end MEASUREMENT
/begin MEASUREMENT InjCrv_stInjCharShOffTst04 "Einspritzcharakteristik im Fall des Abschallttests" UBYTE OneToOne 1 100 0.00 255.0 ECU_ADDRESS 0xD0001F13 /end MEASUREMENT
/begin MEASUREMENT InjCrv_stInjCharShOffTst05 "Einspritzcharakteristik im Fall des Abschallttests" UBYTE OneToOne 1 100 0.00 255.0 ECU_ADDRESS 0xD0001F14 /end MEASUREMENT
/begin MEASUREMENT InjCrv_tiPiI1APSCorRgn1_mp00 "Luftdruckabhängiger Basisansteuerbeginnkorrekturwert 1 der PiI1 im Regenerationsbetrieb" SWORD InjTime_us 1 100 -13107.20 5000.00 ECU_ADDRESS 0xC000C054 /end MEASUREMENT
/begin MEASUREMENT InjCrv_tiPiI1APSCorRgn1_mp01 "Luftdruckabhängiger Basisansteuerbeginnkorrekturwert 1 der PiI1 im Regenerationsbetrieb" SWORD InjTime_us 1 100 -13107.20 5000.00 ECU_ADDRESS 0xC000C056 /end MEASUREMENT
/begin MEASUREMENT InjCrv_tiPiI1APSCorRgn2_mp00 "Luftdruckabhängiger Basisansteuerbeginnkorrekturwert 2 der PiI1 im Regenerationsbetrieb" SWORD InjTime_us 1 100 -13107.20 5000.00 ECU_ADDRESS 0xC000C058 /end MEASUREMENT
/begin MEASUREMENT InjCrv_tiPiI1APSCorRgn2_mp01 "Luftdruckabhängiger Basisansteuerbeginnkorrekturwert 2 der PiI1 im Regenerationsbetrieb" SWORD InjTime_us 1 100 -13107.20 5000.00 ECU_ADDRESS 0xC000C05A /end MEASUREMENT
/begin MEASUREMENT InjCrv_tiPiI1ATSCorRgn1_mp00 "Lufttemperaturabhängiger Basisansteuerbeginnkorrekturwert 1 der PiI1 im Regenerationsbetrieb" SWORD InjTime_us 1 100 -13107.20 5000.00 ECU_ADDRESS 0xC000C05C /end MEASUREMENT
/begin MEASUREMENT InjCrv_tiPiI1ATSCorRgn1_mp01 "Lufttemperaturabhängiger Basisansteuerbeginnkorrekturwert 1 der PiI1 im Regenerationsbetrieb" SWORD InjTime_us 1 100 -13107.20 5000.00 ECU_ADDRESS 0xC000C05E /end MEASUREMENT
/begin MEASUREMENT InjCrv_tiPiI1ATSCorRgn2_mp00 "Lufttemperaturabhängiger Basisansteuerbeginnkorrekturwert 2 der PiI1 im Regenerationsbetrieb" SWORD InjTime_us 1 100 -13107.20 5000.00 ECU_ADDRESS 0xC000C060 /end MEASUREMENT
/begin MEASUREMENT InjCrv_tiPiI1ATSCorRgn2_mp01 "Lufttemperaturabhängiger Basisansteuerbeginnkorrekturwert 2 der PiI1 im Regenerationsbetrieb" SWORD InjTime_us 1 100 -13107.20 5000.00 ECU_ADDRESS 0xC000C062 /end MEASUREMENT
/begin MEASUREMENT InjCrv_tiPiI1BasRgn_mp00 "Basiswert Ansteuerbeginn der Voreinspritzung 1 im Regenerationsbetrieb" SWORD InjTime_us 1 100 -13107.20 5000.00 ECU_ADDRESS 0xC000C074 /end MEASUREMENT
/begin MEASUREMENT InjCrv_tiPiI1BasRgn_mp01 "Basiswert Ansteuerbeginn der Voreinspritzung 1 im Regenerationsbetrieb" SWORD InjTime_us 1 100 -13107.20 5000.00 ECU_ADDRESS 0xC000C076 /end MEASUREMENT
/begin MEASUREMENT InjCrv_tiPiI1CylOffs00 "Messpunkt Array Zyl[1-8] Offset Einspritzzeitpunkt der PiI1" SWORD InjTime_us 1 100 -13107.20 5000.00 ECU_ADDRESS 0xD0000F38 /end MEASUREMENT
/begin MEASUREMENT InjCrv_tiPiI1CylOffs01 "Messpunkt Array Zyl[1-8] Offset Einspritzzeitpunkt der PiI1" SWORD InjTime_us 1 100 -13107.20 5000.00 ECU_ADDRESS 0xD0000F3A /end MEASUREMENT
/begin MEASUREMENT InjCrv_tiPiI1CylOffs02 "Messpunkt Array Zyl[1-8] Offset Einspritzzeitpunkt der PiI1" SWORD InjTime_us 1 100 -13107.20 5000.00 ECU_ADDRESS 0xD0000F3C /end MEASUREMENT
/begin MEASUREMENT InjCrv_tiPiI1CylOffs03 "Messpunkt Array Zyl[1-8] Offset Einspritzzeitpunkt der PiI1" SWORD InjTime_us 1 100 -13107.20 5000.00 ECU_ADDRESS 0xD0000F3E /end MEASUREMENT
/begin MEASUREMENT InjCrv_tiPiI1CylOffs04 "Messpunkt Array Zyl[1-8] Offset Einspritzzeitpunkt der PiI1" SWORD InjTime_us 1 100 -13107.20 5000.00 ECU_ADDRESS 0xD0000F40 /end MEASUREMENT
/begin MEASUREMENT InjCrv_tiPiI1CylOffs05 "Messpunkt Array Zyl[1-8] Offset Einspritzzeitpunkt der PiI1" SWORD InjTime_us 1 100 -13107.20 5000.00 ECU_ADDRESS 0xD0000F42 /end MEASUREMENT
/begin MEASUREMENT InjCrv_tiPiI1EnvCorRgn100 "Korrekturansteuerbeginn 1 im Regeneration Betrieb von PiI1" SWORD InjTime_us 1 100 -13107.20 5000.00 ECU_ADDRESS 0xD0000F4A /end MEASUREMENT
/begin MEASUREMENT InjCrv_tiPiI1EnvCorRgn101 "Korrekturansteuerbeginn 1 im Regeneration Betrieb von PiI1" SWORD InjTime_us 1 100 -13107.20 5000.00 ECU_ADDRESS 0xD0000F4C /end MEASUREMENT
/begin MEASUREMENT InjCrv_tiPiI1EnvCorRgn200 "Korrekturansteuerbeginn 2 im Regeneration Betrieb von PiI1" SWORD InjTime_us 1 100 -13107.20 5000.00 ECU_ADDRESS 0xD0000F4E /end MEASUREMENT
/begin MEASUREMENT InjCrv_tiPiI1EnvCorRgn201 "Korrekturansteuerbeginn 2 im Regeneration Betrieb von PiI1" SWORD InjTime_us 1 100 -13107.20 5000.00 ECU_ADDRESS 0xD0000F50 /end MEASUREMENT
/begin MEASUREMENT InjCrv_tiPiI1ETSCorRgn1_mp00 "Motortemperaturabhängiger Basisansteuerbeginnkorrekturwert 1 der PiI1 im Regenerationsbetrieb" SWORD InjTime_us 1 100 -13107.20 5000.00 ECU_ADDRESS 0xC000C064 /end MEASUREMENT
/begin MEASUREMENT InjCrv_tiPiI1ETSCorRgn1_mp01 "Motortemperaturabhängiger Basisansteuerbeginnkorrekturwert 1 der PiI1 im Regenerationsbetrieb" SWORD InjTime_us 1 100 -13107.20 5000.00 ECU_ADDRESS 0xC000C066 /end MEASUREMENT
/begin MEASUREMENT InjCrv_tiPiI1ETSCorRgn2_mp00 "Motortemperaturabhängiger Basisansteuerbeginnkorrekturwert 2 der PiI1 im Regenerationsbetrieb" SWORD InjTime_us 1 100 -13107.20 5000.00 ECU_ADDRESS 0xC000C068 /end MEASUREMENT
/begin MEASUREMENT InjCrv_tiPiI1ETSCorRgn2_mp01 "Motortemperaturabhängiger Basisansteuerbeginnkorrekturwert 2 der PiI1 im Regenerationsbetrieb" SWORD InjTime_us 1 100 -13107.20 5000.00 ECU_ADDRESS 0xC000C06A /end MEASUREMENT
/begin MEASUREMENT InjCrv_tiPiI1Rgn00 "Regenerationswert für die Zeitkomponente des Ansteuerbeginns der PiI1" SWORD InjTime_us 1 100 -13107.20 5000.00 ECU_ADDRESS 0xD0000F52 /end MEASUREMENT
/begin MEASUREMENT InjCrv_tiPiI1Rgn01 "Regenerationswert für die Zeitkomponente des Ansteuerbeginns der PiI1" SWORD InjTime_us 1 100 -13107.20 5000.00 ECU_ADDRESS 0xD0000F54 /end MEASUREMENT
/begin MEASUREMENT InjCrv_tiPiI1RgnAdd_mp00 "Additiver Bypasseingriff für Zeit der Voreinspritzung 1 im Regenerationsbetrieb" SWORD InjTime_us 1 100 -13107.20 5000.00 ECU_ADDRESS 0xC000C078 /end MEASUREMENT
/begin MEASUREMENT InjCrv_tiPiI1RgnAdd_mp01 "Additiver Bypasseingriff für Zeit der Voreinspritzung 1 im Regenerationsbetrieb" SWORD InjTime_us 1 100 -13107.20 5000.00 ECU_ADDRESS 0xC000C07A /end MEASUREMENT
/begin MEASUREMENT InjCrv_tiPiI2APSCorRgn_mp00 "Luftdruckabhängiger Basisansteuerungskorrekturwert der PiI2 im Regenerationsbetrieb" SWORD InjTime_us 1 100 -13107.20 5000.00 ECU_ADDRESS 0xC000C088 /end MEASUREMENT
/begin MEASUREMENT InjCrv_tiPiI2APSCorRgn_mp01 "Luftdruckabhängiger Basisansteuerungskorrekturwert der PiI2 im Regenerationsbetrieb" SWORD InjTime_us 1 100 -13107.20 5000.00 ECU_ADDRESS 0xC000C08A /end MEASUREMENT
/begin MEASUREMENT InjCrv_tiPiI2ATSCorRgn_mp00 "Ansauglufttemperaturabhängiger Basisansteuerungskorrekturwert der PiI2 im Regenerationsbetrieb" SWORD InjTime_us 1 100 -13107.20 5000.00 ECU_ADDRESS 0xC000C08C /end MEASUREMENT
/begin MEASUREMENT InjCrv_tiPiI2ATSCorRgn_mp01 "Ansauglufttemperaturabhängiger Basisansteuerungskorrekturwert der PiI2 im Regenerationsbetrieb" SWORD InjTime_us 1 100 -13107.20 5000.00 ECU_ADDRESS 0xC000C08E /end MEASUREMENT
/begin MEASUREMENT InjCrv_tiPiI2BasRgn_mp00 "Basiswert Ansteuerbeginn der Voreinspritzung 2 im Regenerationsbetrieb" SWORD InjTime_us 1 100 -13107.20 5000.00 ECU_ADDRESS 0xC000C09C /end MEASUREMENT
/begin MEASUREMENT InjCrv_tiPiI2BasRgn_mp01 "Basiswert Ansteuerbeginn der Voreinspritzung 2 im Regenerationsbetrieb" SWORD InjTime_us 1 100 -13107.20 5000.00 ECU_ADDRESS 0xC000C09E /end MEASUREMENT
/begin MEASUREMENT InjCrv_tiPiI2CylOffs00 "Messpunkt Array Zyl[1-8] Offset Ansteuerbeginns der PiI2" SWORD InjTime_us 1 100 -13107.20 5000.00 ECU_ADDRESS 0xD0000F5C /end MEASUREMENT
/begin MEASUREMENT InjCrv_tiPiI2CylOffs01 "Messpunkt Array Zyl[1-8] Offset Ansteuerbeginns der PiI2" SWORD InjTime_us 1 100 -13107.20 5000.00 ECU_ADDRESS 0xD0000F5E /end MEASUREMENT
/begin MEASUREMENT InjCrv_tiPiI2CylOffs02 "Messpunkt Array Zyl[1-8] Offset Ansteuerbeginns der PiI2" SWORD InjTime_us 1 100 -13107.20 5000.00 ECU_ADDRESS 0xD0000F60 /end MEASUREMENT
/begin MEASUREMENT InjCrv_tiPiI2CylOffs03 "Messpunkt Array Zyl[1-8] Offset Ansteuerbeginns der PiI2" SWORD InjTime_us 1 100 -13107.20 5000.00 ECU_ADDRESS 0xD0000F62 /end MEASUREMENT
/begin MEASUREMENT InjCrv_tiPiI2CylOffs04 "Messpunkt Array Zyl[1-8] Offset Ansteuerbeginns der PiI2" SWORD InjTime_us 1 100 -13107.20 5000.00 ECU_ADDRESS 0xD0000F64 /end MEASUREMENT
/begin MEASUREMENT InjCrv_tiPiI2CylOffs05 "Messpunkt Array Zyl[1-8] Offset Ansteuerbeginns der PiI2" SWORD InjTime_us 1 100 -13107.20 5000.00 ECU_ADDRESS 0xD0000F66 /end MEASUREMENT
/begin MEASUREMENT InjCrv_tiPiI2EnvCorRgn00 "Ansteuerungskorrekturwert in Regenerationsbetrieb der PiI2" SWORD InjTime_us 1 100 -13107.20 5000.00 ECU_ADDRESS 0xD0000F6C /end MEASUREMENT
/begin MEASUREMENT InjCrv_tiPiI2EnvCorRgn01 "Ansteuerungskorrekturwert in Regenerationsbetrieb der PiI2" SWORD InjTime_us 1 100 -13107.20 5000.00 ECU_ADDRESS 0xD0000F6E /end MEASUREMENT
/begin MEASUREMENT InjCrv_tiPiI2ETSCorRgn_mp00 "Motortemperaturabhängiger Basisansteuerungskorrekturwert der PiI2 im Regenerationsbetrieb" SWORD InjTime_us 1 100 -13107.20 5000.00 ECU_ADDRESS 0xC000C090 /end MEASUREMENT
/begin MEASUREMENT InjCrv_tiPiI2ETSCorRgn_mp01 "Motortemperaturabhängiger Basisansteuerungskorrekturwert der PiI2 im Regenerationsbetrieb" SWORD InjTime_us 1 100 -13107.20 5000.00 ECU_ADDRESS 0xC000C092 /end MEASUREMENT
/begin MEASUREMENT InjCrv_tiPiI2Rgn00 "Regenerationswert für die Zeitkomponente des Ansteuerbeginns der PiI2" SWORD InjTime_us 1 100 -13107.20 5000.00 ECU_ADDRESS 0xD0000F70 /end MEASUREMENT
/begin MEASUREMENT InjCrv_tiPiI2Rgn01 "Regenerationswert für die Zeitkomponente des Ansteuerbeginns der PiI2" SWORD InjTime_us 1 100 -13107.20 5000.00 ECU_ADDRESS 0xD0000F72 /end MEASUREMENT
/begin MEASUREMENT InjCrv_tiPiI2RgnAdd_mp00 "Additiver Bypasseingriff für Zeit der Voreinspritzung 2 im Regenerationsbetrieb" SWORD InjTime_us 1 100 -13107.20 5000.00 ECU_ADDRESS 0xC000C0A0 /end MEASUREMENT
/begin MEASUREMENT InjCrv_tiPiI2RgnAdd_mp01 "Additiver Bypasseingriff für Zeit der Voreinspritzung 2 im Regenerationsbetrieb" SWORD InjTime_us 1 100 -13107.20 5000.00 ECU_ADDRESS 0xC000C0A2 /end MEASUREMENT
/begin MEASUREMENT InjCrv_tiPoI1BasRgn_mp00 "Kundenvspecifiz korrektur für Nacheinspritzung beim Regeneration" SWORD InjTime_us 1 100 -13107.20 5000.00 ECU_ADDRESS 0xC000C0B8 /end MEASUREMENT
/begin MEASUREMENT InjCrv_tiPoI1BasRgn_mp01 "Kundenvspecifiz korrektur für Nacheinspritzung beim Regeneration" SWORD InjTime_us 1 100 -13107.20 5000.00 ECU_ADDRESS 0xC000C0BA /end MEASUREMENT
/begin MEASUREMENT InjCrv_tiPoI1Rgn00 "" SWORD InjTime_us 1 100 -13107.20 5000.00 ECU_ADDRESS 0xD0000F7A /end MEASUREMENT
/begin MEASUREMENT InjCrv_tiPoI1Rgn01 "" SWORD InjTime_us 1 100 -13107.20 5000.00 ECU_ADDRESS 0xD0000F7C /end MEASUREMENT
/begin MEASUREMENT InjCrv_tiPoI2APSCorRgn_mp00 "Gewichtete Zeit korrekturen abhängig von dem Umgebungsluftdruck für die PoI2 im Regenerationsbetrieb" SWORD InjTime_us 1 100 -13107.20 5000.00 ECU_ADDRESS 0xC000C0EC /end MEASUREMENT
/begin MEASUREMENT InjCrv_tiPoI2APSCorRgn_mp01 "Gewichtete Zeit korrekturen abhängig von dem Umgebungsluftdruck für die PoI2 im Regenerationsbetrieb" SWORD InjTime_us 1 100 -13107.20 5000.00 ECU_ADDRESS 0xC000C0EE /end MEASUREMENT
/begin MEASUREMENT InjCrv_tiPoI2BasRgn_mp00 "Grundwert der Zeit komponente Ansteuerbeginn PoI2 im Regenerationsbetrieb" SWORD InjTime_us 1 100 -13107.20 5000.00 ECU_ADDRESS 0xC000C104 /end MEASUREMENT
/begin MEASUREMENT InjCrv_tiPoI2BasRgn_mp01 "Grundwert der Zeit komponente Ansteuerbeginn PoI2 im Regenerationsbetrieb" SWORD InjTime_us 1 100 -13107.20 5000.00 ECU_ADDRESS 0xC000C106 /end MEASUREMENT
/begin MEASUREMENT InjCrv_tiPoI2EnvCorRgn00 "Umgebungsbedingungsabhängige Korrektur Zeit für Nacheinspritzung 2 im Regenerationsbetrieb" SWORD InjTime_us 1 100 -13107.20 5000.00 ECU_ADDRESS 0xD0000F86 /end MEASUREMENT
/begin MEASUREMENT InjCrv_tiPoI2EnvCorRgn01 "Umgebungsbedingungsabhängige Korrektur Zeit für Nacheinspritzung 2 im Regenerationsbetrieb" SWORD InjTime_us 1 100 -13107.20 5000.00 ECU_ADDRESS 0xD0000F88 /end MEASUREMENT
/begin MEASUREMENT InjCrv_tiPoI2ETSCorRgn_mp00 "Gewichtete Zeit korrekturen abhängig von der Motortemperatur für die PoI2 im Regenerationsbetrieb" SWORD InjTime_us 1 100 -13107.20 5000.00 ECU_ADDRESS 0xC000C0F0 /end MEASUREMENT
/begin MEASUREMENT InjCrv_tiPoI2ETSCorRgn_mp01 "Gewichtete Zeit korrekturen abhängig von der Motortemperatur für die PoI2 im Regenerationsbetrieb" SWORD InjTime_us 1 100 -13107.20 5000.00 ECU_ADDRESS 0xC000C0F2 /end MEASUREMENT
/begin MEASUREMENT InjCrv_tiPoI2Rgn00 "Grundwert der Zeit komponente Ansteuerbeginn PoI2 im Regenerationsbetrieb" SWORD InjTime_us 1 100 -13107.20 5000.00 ECU_ADDRESS 0xD0000F8C /end MEASUREMENT
/begin MEASUREMENT InjCrv_tiPoI2Rgn01 "Grundwert der Zeit komponente Ansteuerbeginn PoI2 im Regenerationsbetrieb" SWORD InjTime_us 1 100 -13107.20 5000.00 ECU_ADDRESS 0xD0000F8E /end MEASUREMENT
/begin MEASUREMENT InjCrv_trqFBC00 "FBC Moment" SWORD Trq 1 100 -3276.800 3276.700 ECU_ADDRESS 0xD0000F90 /end MEASUREMENT
/begin MEASUREMENT InjCrv_trqFBC01 "FBC Moment" SWORD Trq 1 100 -3276.800 3276.700 ECU_ADDRESS 0xD0000F92 /end MEASUREMENT
/begin MEASUREMENT InjCrv_trqFBC02 "FBC Moment" SWORD Trq 1 100 -3276.800 3276.700 ECU_ADDRESS 0xD0000F94 /end MEASUREMENT
/begin MEASUREMENT InjCrv_trqFBC03 "FBC Moment" SWORD Trq 1 100 -3276.800 3276.700 ECU_ADDRESS 0xD0000F96 /end MEASUREMENT
/begin MEASUREMENT InjCrv_trqFBC04 "FBC Moment" SWORD Trq 1 100 -3276.800 3276.700 ECU_ADDRESS 0xD0000F98 /end MEASUREMENT
/begin MEASUREMENT InjCrv_trqFBC05 "FBC Moment" SWORD Trq 1 100 -3276.800 3276.700 ECU_ADDRESS 0xD0000F9A /end MEASUREMENT
/begin MEASUREMENT InjSys_qHCEmi00 "" SWORD InjMass 1 100 -327.6800 327.6700 ECU_ADDRESS 0xD0000FBE /end MEASUREMENT
/begin MEASUREMENT InjSys_qHCEmi01 "" SWORD InjMass 1 100 -327.6800 327.6700 ECU_ADDRESS 0xD0000FC0 /end MEASUREMENT
/begin MEASUREMENT InjSys_qHCEmi02 "" SWORD InjMass 1 100 -327.6800 327.6700 ECU_ADDRESS 0xD0000FC2 /end MEASUREMENT
/begin MEASUREMENT InjSys_qHCEmi03 "" SWORD InjMass 1 100 -327.6800 327.6700 ECU_ADDRESS 0xD0000FC4 /end MEASUREMENT
/begin MEASUREMENT InjSys_qHCEmi04 "" SWORD InjMass 1 100 -327.6800 327.6700 ECU_ADDRESS 0xD0000FC6 /end MEASUREMENT
/begin MEASUREMENT InjSys_qHCEmi05 "" SWORD InjMass 1 100 -327.6800 327.6700 ECU_ADDRESS 0xD0000FC8 /end MEASUREMENT
/begin MEASUREMENT InjSys_qInrCmb00 "Im Motor verbrannte Einspritzmenge" SWORD InjMass 1 100 -327.6800 327.6700 ECU_ADDRESS 0xD0000FCA /end MEASUREMENT
/begin MEASUREMENT InjSys_qInrCmb01 "Im Motor verbrannte Einspritzmenge" SWORD InjMass 1 100 -327.6800 327.6700 ECU_ADDRESS 0xD0000FCC /end MEASUREMENT
/begin MEASUREMENT InjSys_qInrCmb02 "Im Motor verbrannte Einspritzmenge" SWORD InjMass 1 100 -327.6800 327.6700 ECU_ADDRESS 0xD0000FCE /end MEASUREMENT
/begin MEASUREMENT InjSys_qInrCmb03 "Im Motor verbrannte Einspritzmenge" SWORD InjMass 1 100 -327.6800 327.6700 ECU_ADDRESS 0xD0000FD0 /end MEASUREMENT
/begin MEASUREMENT InjSys_qInrCmb04 "Im Motor verbrannte Einspritzmenge" SWORD InjMass 1 100 -327.6800 327.6700 ECU_ADDRESS 0xD0000FD2 /end MEASUREMENT
/begin MEASUREMENT InjSys_qInrCmb05 "Im Motor verbrannte Einspritzmenge" SWORD InjMass 1 100 -327.6800 327.6700 ECU_ADDRESS 0xD0000FD4 /end MEASUREMENT
/begin MEASUREMENT InjSys_qNoTrqPoI1_mp00 "" SWORD InjMass 1 100 -327.6800 327.6700 ECU_ADDRESS 0xC000C108 /end MEASUREMENT
/begin MEASUREMENT InjSys_qNoTrqPoI1_mp01 "" SWORD InjMass 1 100 -327.6800 327.6700 ECU_ADDRESS 0xC000C10A /end MEASUREMENT
/begin MEASUREMENT InjSys_qNoTrqPoI1_mp02 "" SWORD InjMass 1 100 -327.6800 327.6700 ECU_ADDRESS 0xC000C10C /end MEASUREMENT
/begin MEASUREMENT InjSys_qNoTrqPoI1_mp03 "" SWORD InjMass 1 100 -327.6800 327.6700 ECU_ADDRESS 0xC000C10E /end MEASUREMENT
/begin MEASUREMENT InjSys_qNoTrqPoI1_mp04 "" SWORD InjMass 1 100 -327.6800 327.6700 ECU_ADDRESS 0xC000C110 /end MEASUREMENT
/begin MEASUREMENT InjSys_qNoTrqPoI1_mp05 "" SWORD InjMass 1 100 -327.6800 327.6700 ECU_ADDRESS 0xC000C112 /end MEASUREMENT
/begin MEASUREMENT InjSys_qNoTrqPoI2_mp00 "" SWORD InjMass 1 100 -327.6800 327.6700 ECU_ADDRESS 0xC000C114 /end MEASUREMENT
/begin MEASUREMENT InjSys_qNoTrqPoI2_mp01 "" SWORD InjMass 1 100 -327.6800 327.6700 ECU_ADDRESS 0xC000C116 /end MEASUREMENT
/begin MEASUREMENT InjSys_qNoTrqPoI2_mp02 "" SWORD InjMass 1 100 -327.6800 327.6700 ECU_ADDRESS 0xC000C118 /end MEASUREMENT
/begin MEASUREMENT InjSys_qNoTrqPoI2_mp03 "" SWORD InjMass 1 100 -327.6800 327.6700 ECU_ADDRESS 0xC000C11A /end MEASUREMENT
/begin MEASUREMENT InjSys_qNoTrqPoI2_mp04 "" SWORD InjMass 1 100 -327.6800 327.6700 ECU_ADDRESS 0xC000C11C /end MEASUREMENT
/begin MEASUREMENT InjSys_qNoTrqPoI2_mp05 "" SWORD InjMass 1 100 -327.6800 327.6700 ECU_ADDRESS 0xC000C11E /end MEASUREMENT
/begin MEASUREMENT InjSys_qOutrCmb00 "Ausserhalb des Motors umgesetzte Einspritzmenge" SWORD InjMass 1 100 -327.6800 327.6700 ECU_ADDRESS 0xD0000FD6 /end MEASUREMENT
/begin MEASUREMENT InjSys_qOutrCmb01 "Ausserhalb des Motors umgesetzte Einspritzmenge" SWORD InjMass 1 100 -327.6800 327.6700 ECU_ADDRESS 0xD0000FD8 /end MEASUREMENT
/begin MEASUREMENT InjSys_qOutrCmb02 "Ausserhalb des Motors umgesetzte Einspritzmenge" SWORD InjMass 1 100 -327.6800 327.6700 ECU_ADDRESS 0xD0000FDA /end MEASUREMENT
/begin MEASUREMENT InjSys_qOutrCmb03 "Ausserhalb des Motors umgesetzte Einspritzmenge" SWORD InjMass 1 100 -327.6800 327.6700 ECU_ADDRESS 0xD0000FDC /end MEASUREMENT
/begin MEASUREMENT InjSys_qOutrCmb04 "Ausserhalb des Motors umgesetzte Einspritzmenge" SWORD InjMass 1 100 -327.6800 327.6700 ECU_ADDRESS 0xD0000FDE /end MEASUREMENT
/begin MEASUREMENT InjSys_qOutrCmb05 "Ausserhalb des Motors umgesetzte Einspritzmenge" SWORD InjMass 1 100 -327.6800 327.6700 ECU_ADDRESS 0xD0000FE0 /end MEASUREMENT
/begin MEASUREMENT InjSys_qPoIHCEmi00 "" SWORD InjMass 1 100 -327.6800 327.6700 ECU_ADDRESS 0xD0000FE2 /end MEASUREMENT
/begin MEASUREMENT InjSys_qPoIHCEmi01 "" SWORD InjMass 1 100 -327.6800 327.6700 ECU_ADDRESS 0xD0000FE4 /end MEASUREMENT
/begin MEASUREMENT InjSys_qPoIHCEmi02 "" SWORD InjMass 1 100 -327.6800 327.6700 ECU_ADDRESS 0xD0000FE6 /end MEASUREMENT
/begin MEASUREMENT InjSys_qPoIHCEmi03 "" SWORD InjMass 1 100 -327.6800 327.6700 ECU_ADDRESS 0xD0000FE8 /end MEASUREMENT
/begin MEASUREMENT InjSys_qPoIHCEmi04 "" SWORD InjMass 1 100 -327.6800 327.6700 ECU_ADDRESS 0xD0000FEA /end MEASUREMENT
/begin MEASUREMENT InjSys_qPoIHCEmi05 "" SWORD InjMass 1 100 -327.6800 327.6700 ECU_ADDRESS 0xD0000FEC /end MEASUREMENT
/begin MEASUREMENT InjVlv_facAddBalRls00 "Ergebnis aus Freigabekennfeld zur Aufrechnung der Mengenkorrektur als Array (zylinderspezifisch)" SWORD Fact 1 100 -4.000000 3.999878 ECU_ADDRESS 0xD0001002 /end MEASUREMENT
/begin MEASUREMENT InjVlv_facAddBalRls01 "Ergebnis aus Freigabekennfeld zur Aufrechnung der Mengenkorrektur als Array (zylinderspezifisch)" SWORD Fact 1 100 -4.000000 3.999878 ECU_ADDRESS 0xD0001004 /end MEASUREMENT
/begin MEASUREMENT InjVlv_facAddBalRls02 "Ergebnis aus Freigabekennfeld zur Aufrechnung der Mengenkorrektur als Array (zylinderspezifisch)" SWORD Fact 1 100 -4.000000 3.999878 ECU_ADDRESS 0xD0001006 /end MEASUREMENT
/begin MEASUREMENT InjVlv_facAddBalRls03 "Ergebnis aus Freigabekennfeld zur Aufrechnung der Mengenkorrektur als Array (zylinderspezifisch)" SWORD Fact 1 100 -4.000000 3.999878 ECU_ADDRESS 0xD0001008 /end MEASUREMENT
/begin MEASUREMENT InjVlv_facAddBalRls04 "Ergebnis aus Freigabekennfeld zur Aufrechnung der Mengenkorrektur als Array (zylinderspezifisch)" SWORD Fact 1 100 -4.000000 3.999878 ECU_ADDRESS 0xD000100A /end MEASUREMENT
/begin MEASUREMENT InjVlv_facAddBalRls05 "Ergebnis aus Freigabekennfeld zur Aufrechnung der Mengenkorrektur als Array (zylinderspezifisch)" SWORD Fact 1 100 -4.000000 3.999878 ECU_ADDRESS 0xD000100C /end MEASUREMENT
/begin MEASUREMENT InjVlv_PsIcStIniDiag00 "Status der Initialisierung des common rail Endstufenbausteins" UWORD OneToOne 1 100 0.00 65535.00 ECU_ADDRESS 0xD00015E0 /end MEASUREMENT
/begin MEASUREMENT InjVlv_PsIcStIniTrans00 "Status der Initialisierung des Common Rail Endstufenbaustein-Treibers" ULONG OneToOne 1 100 0.00 4294967295.00 ECU_ADDRESS 0xD0003234 /end MEASUREMENT
/begin MEASUREMENT InjVlv_rZFCETCoeffDif_mp00 "Bewertungsfaktoren für Ansteuerdauerkorrektur durch Nullmengenkalibrierung" SWORD Prc 1 100 -400.0000 399.9878 ECU_ADDRESS 0xC000C148 /end MEASUREMENT
/begin MEASUREMENT InjVlv_rZFCETCoeffDif_mp01 "Bewertungsfaktoren für Ansteuerdauerkorrektur durch Nullmengenkalibrierung" SWORD Prc 1 100 -400.0000 399.9878 ECU_ADDRESS 0xC000C14A /end MEASUREMENT
/begin MEASUREMENT InjVlv_rZFCETCoeffDif_mp02 "Bewertungsfaktoren für Ansteuerdauerkorrektur durch Nullmengenkalibrierung" SWORD Prc 1 100 -400.0000 399.9878 ECU_ADDRESS 0xC000C14C /end MEASUREMENT
/begin MEASUREMENT InjVlv_rZFCETPoI1CoeffDif_mp00 "" SWORD Prc 1 100 -400.0000 399.9878 ECU_ADDRESS 0xC000C14E /end MEASUREMENT
/begin MEASUREMENT InjVlv_rZFCETPoI1CoeffDif_mp01 "" SWORD Prc 1 100 -400.0000 399.9878 ECU_ADDRESS 0xC000C150 /end MEASUREMENT
/begin MEASUREMENT InjVlv_rZFCETPoI1CoeffDif_mp02 "" SWORD Prc 1 100 -400.0000 399.9878 ECU_ADDRESS 0xC000C152 /end MEASUREMENT
/begin MEASUREMENT InjVlv_rZFCETPoI2CoeffDif_mp00 "" SWORD Prc 1 100 -400.0000 399.9878 ECU_ADDRESS 0xC000C154 /end MEASUREMENT
/begin MEASUREMENT InjVlv_rZFCETPoI2CoeffDif_mp01 "" SWORD Prc 1 100 -400.0000 399.9878 ECU_ADDRESS 0xC000C156 /end MEASUREMENT
/begin MEASUREMENT InjVlv_rZFCETPoI2CoeffDif_mp02 "" SWORD Prc 1 100 -400.0000 399.9878 ECU_ADDRESS 0xC000C158 /end MEASUREMENT
/begin MEASUREMENT InjVlv_stInjRls00 "status der freigegebenen Einspritzungen" UBYTE OneToOne 1 100 0.00 255.0 ECU_ADDRESS 0xD0001F2E /end MEASUREMENT
/begin MEASUREMENT InjVlv_stInjRls01 "status der freigegebenen Einspritzungen" UBYTE OneToOne 1 100 0.00 255.0 ECU_ADDRESS 0xD0001F2F /end MEASUREMENT
/begin MEASUREMENT InjVlv_stInjRls02 "status der freigegebenen Einspritzungen" UBYTE OneToOne 1 100 0.00 255.0 ECU_ADDRESS 0xD0001F30 /end MEASUREMENT
/begin MEASUREMENT InjVlv_stInjRls03 "status der freigegebenen Einspritzungen" UBYTE OneToOne 1 100 0.00 255.0 ECU_ADDRESS 0xD0001F31 /end MEASUREMENT
/begin MEASUREMENT InjVlv_stInjRls04 "status der freigegebenen Einspritzungen" UBYTE OneToOne 1 100 0.00 255.0 ECU_ADDRESS 0xD0001F32 /end MEASUREMENT
/begin MEASUREMENT InjVlv_stInjRls05 "status der freigegebenen Einspritzungen" UBYTE OneToOne 1 100 0.00 255.0 ECU_ADDRESS 0xD0001F33 /end MEASUREMENT
/begin MEASUREMENT InjVlv_stPsIcChipVer_mp00 "hardware chip ID des common rail endstufen Bausteins" UBYTE OneToOne 1 100 0.00 255.0 ECU_ADDRESS 0xC000C120 /end MEASUREMENT
/begin MEASUREMENT InjVlv_stPsIcDiaBnk1_mp00 "Diagnose Information Bank 1 des Common Rail Endstufenbausteins" UBYTE OneToOne 1 100 0.00 255.0 ECU_ADDRESS 0xC000C128 /end MEASUREMENT
/begin MEASUREMENT InjVlv_stPsIcDiaBnk2_mp00 "Diagnose Information Bank 2 des Common Rail Endstufenbausteins" UBYTE OneToOne 1 100 0.00 255.0 ECU_ADDRESS 0xC000C129 /end MEASUREMENT
/begin MEASUREMENT InjVlv_stPsIcIni_mp00 "Status der Initialisierung des common rail Endstufenbausteins" ULONG OneToOne 1 100 0.00 4294967295.00 ECU_ADDRESS 0xC000C124 /end MEASUREMENT
/begin MEASUREMENT InjVlv_stPsIcNumBnkPcP_mp00 "Input PCP Bank Nummer im Fehlerfall des Bausteintreibers" ULONG OneToOne 1 100 0.00 4294967295.00 ECU_ADDRESS 0xC000C12C /end MEASUREMENT
/begin MEASUREMENT InjVlv_stPsIcNumBnk_mp00 "Input SW Bank Nummer im Fehlerfall des Bausteintreibers" ULONG OneToOne 1 100 0.00 4294967295.00 ECU_ADDRESS 0xC000C130 /end MEASUREMENT
/begin MEASUREMENT InjVlv_stPsIcNumChipPcP_mp00 "Input PCP chip Nummer im Fehlerfall des Bausteintreibers" ULONG OneToOne 1 100 0.00 4294967295.00 ECU_ADDRESS 0xC000C134 /end MEASUREMENT
/begin MEASUREMENT InjVlv_stPsIcNumChip_mp00 "Input SW chip Nummer im Fehlerfall des Bausteintreibers" ULONG OneToOne 1 100 0.00 4294967295.00 ECU_ADDRESS 0xC000C138 /end MEASUREMENT
/begin MEASUREMENT InjVlv_stPsIcStBufDatEx_mp00 "Status des Bausteintreiber Datenpuffers beim Schreiben" ULONG OneToOne 1 100 0.00 4294967295.00 ECU_ADDRESS 0xC000C13C /end MEASUREMENT
/begin MEASUREMENT InjVlv_stPsIcStBufTraInj_mp00 "Status des Bausteintreiber Datenpuffers beim Eintragen" ULONG OneToOne 1 100 0.00 4294967295.00 ECU_ADDRESS 0xC000C140 /end MEASUREMENT
/begin MEASUREMENT InjVlv_stPsIcTra_mp00 "Status des Common Rail Endstufenbaustein-Treibers, Fehler-Sammler" ULONG OneToOne 1 100 0.00 4294967295.00 ECU_ADDRESS 0xC000C144 /end MEASUREMENT
/begin MEASUREMENT InjVlv_tiPiI1ZFCETCor_mp00 "Ansteuerdauerkorrektur der ZFC für Voreinspritzung 1 und jeden Zylinder" SWORD InjTime_us 1 100 -13107.20 5000.00 ECU_ADDRESS 0xC000C15A /end MEASUREMENT
/begin MEASUREMENT InjVlv_tiPiI1ZFCETCor_mp01 "Ansteuerdauerkorrektur der ZFC für Voreinspritzung 1 und jeden Zylinder" SWORD InjTime_us 1 100 -13107.20 5000.00 ECU_ADDRESS 0xC000C15C /end MEASUREMENT
/begin MEASUREMENT InjVlv_tiPiI1ZFCETCor_mp02 "Ansteuerdauerkorrektur der ZFC für Voreinspritzung 1 und jeden Zylinder" SWORD InjTime_us 1 100 -13107.20 5000.00 ECU_ADDRESS 0xC000C15E /end MEASUREMENT
/begin MEASUREMENT InjVlv_tiPiI1ZFCETCor_mp03 "Ansteuerdauerkorrektur der ZFC für Voreinspritzung 1 und jeden Zylinder" SWORD InjTime_us 1 100 -13107.20 5000.00 ECU_ADDRESS 0xC000C160 /end MEASUREMENT
/begin MEASUREMENT InjVlv_tiPiI1ZFCETCor_mp04 "Ansteuerdauerkorrektur der ZFC für Voreinspritzung 1 und jeden Zylinder" SWORD InjTime_us 1 100 -13107.20 5000.00 ECU_ADDRESS 0xC000C162 /end MEASUREMENT
/begin MEASUREMENT InjVlv_tiPiI1ZFCETCor_mp05 "Ansteuerdauerkorrektur der ZFC für Voreinspritzung 1 und jeden Zylinder" SWORD InjTime_us 1 100 -13107.20 5000.00 ECU_ADDRESS 0xC000C164 /end MEASUREMENT
/begin MEASUREMENT InjVlv_tiPiI2ZFCETCor_mp00 "Ansteuerdauerkorrektur der ZFC für Voreinspritzung 2 und jeden Zylinder" SWORD InjTime_us 1 100 -13107.20 5000.00 ECU_ADDRESS 0xC000C166 /end MEASUREMENT
/begin MEASUREMENT InjVlv_tiPiI2ZFCETCor_mp01 "Ansteuerdauerkorrektur der ZFC für Voreinspritzung 2 und jeden Zylinder" SWORD InjTime_us 1 100 -13107.20 5000.00 ECU_ADDRESS 0xC000C168 /end MEASUREMENT
/begin MEASUREMENT InjVlv_tiPiI2ZFCETCor_mp02 "Ansteuerdauerkorrektur der ZFC für Voreinspritzung 2 und jeden Zylinder" SWORD InjTime_us 1 100 -13107.20 5000.00 ECU_ADDRESS 0xC000C16A /end MEASUREMENT
/begin MEASUREMENT InjVlv_tiPiI2ZFCETCor_mp03 "Ansteuerdauerkorrektur der ZFC für Voreinspritzung 2 und jeden Zylinder" SWORD InjTime_us 1 100 -13107.20 5000.00 ECU_ADDRESS 0xC000C16C /end MEASUREMENT
/begin MEASUREMENT InjVlv_tiPiI2ZFCETCor_mp04 "Ansteuerdauerkorrektur der ZFC für Voreinspritzung 2 und jeden Zylinder" SWORD InjTime_us 1 100 -13107.20 5000.00 ECU_ADDRESS 0xC000C16E /end MEASUREMENT
/begin MEASUREMENT InjVlv_tiPiI2ZFCETCor_mp05 "Ansteuerdauerkorrektur der ZFC für Voreinspritzung 2 und jeden Zylinder" SWORD InjTime_us 1 100 -13107.20 5000.00 ECU_ADDRESS 0xC000C170 /end MEASUREMENT
/begin MEASUREMENT InjVlv_tiPiI3ZFCETCor_mp00 "Ansteuerdauerkorrektur der ZFC für Voreinspritzung 3 und jeden Zylinder" SWORD InjTime_us 1 100 -13107.20 5000.00 ECU_ADDRESS 0xC000C172 /end MEASUREMENT
/begin MEASUREMENT InjVlv_tiPiI3ZFCETCor_mp01 "Ansteuerdauerkorrektur der ZFC für Voreinspritzung 3 und jeden Zylinder" SWORD InjTime_us 1 100 -13107.20 5000.00 ECU_ADDRESS 0xC000C174 /end MEASUREMENT
/begin MEASUREMENT InjVlv_tiPiI3ZFCETCor_mp02 "Ansteuerdauerkorrektur der ZFC für Voreinspritzung 3 und jeden Zylinder" SWORD InjTime_us 1 100 -13107.20 5000.00 ECU_ADDRESS 0xC000C176 /end MEASUREMENT
/begin MEASUREMENT InjVlv_tiPiI3ZFCETCor_mp03 "Ansteuerdauerkorrektur der ZFC für Voreinspritzung 3 und jeden Zylinder" SWORD InjTime_us 1 100 -13107.20 5000.00 ECU_ADDRESS 0xC000C178 /end MEASUREMENT
/begin MEASUREMENT InjVlv_tiPiI3ZFCETCor_mp04 "Ansteuerdauerkorrektur der ZFC für Voreinspritzung 3 und jeden Zylinder" SWORD InjTime_us 1 100 -13107.20 5000.00 ECU_ADDRESS 0xC000C17A /end MEASUREMENT
/begin MEASUREMENT InjVlv_tiPiI3ZFCETCor_mp05 "Ansteuerdauerkorrektur der ZFC für Voreinspritzung 3 und jeden Zylinder" SWORD InjTime_us 1 100 -13107.20 5000.00 ECU_ADDRESS 0xC000C17C /end MEASUREMENT
/begin MEASUREMENT InjVlv_tiPoI1ZFCETCor_mp00 "" SWORD InjTime_us 1 100 -13107.20 5000.00 ECU_ADDRESS 0xC000C17E /end MEASUREMENT
/begin MEASUREMENT InjVlv_tiPoI1ZFCETCor_mp01 "" SWORD InjTime_us 1 100 -13107.20 5000.00 ECU_ADDRESS 0xC000C180 /end MEASUREMENT
/begin MEASUREMENT InjVlv_tiPoI1ZFCETCor_mp02 "" SWORD InjTime_us 1 100 -13107.20 5000.00 ECU_ADDRESS 0xC000C182 /end MEASUREMENT
/begin MEASUREMENT InjVlv_tiPoI1ZFCETCor_mp03 "" SWORD InjTime_us 1 100 -13107.20 5000.00 ECU_ADDRESS 0xC000C184 /end MEASUREMENT
/begin MEASUREMENT InjVlv_tiPoI1ZFCETCor_mp04 "" SWORD InjTime_us 1 100 -13107.20 5000.00 ECU_ADDRESS 0xC000C186 /end MEASUREMENT
/begin MEASUREMENT InjVlv_tiPoI1ZFCETCor_mp05 "" SWORD InjTime_us 1 100 -13107.20 5000.00 ECU_ADDRESS 0xC000C188 /end MEASUREMENT
/begin MEASUREMENT InjVlv_tiPoI2ZFCETCor_mp00 "" SWORD InjTime_us 1 100 -13107.20 5000.00 ECU_ADDRESS 0xC000C18A /end MEASUREMENT
/begin MEASUREMENT InjVlv_tiPoI2ZFCETCor_mp01 "" SWORD InjTime_us 1 100 -13107.20 5000.00 ECU_ADDRESS 0xC000C18C /end MEASUREMENT
/begin MEASUREMENT InjVlv_tiPoI2ZFCETCor_mp02 "" SWORD InjTime_us 1 100 -13107.20 5000.00 ECU_ADDRESS 0xC000C18E /end MEASUREMENT
/begin MEASUREMENT InjVlv_tiPoI2ZFCETCor_mp03 "" SWORD InjTime_us 1 100 -13107.20 5000.00 ECU_ADDRESS 0xC000C190 /end MEASUREMENT
/begin MEASUREMENT InjVlv_tiPoI2ZFCETCor_mp04 "" SWORD InjTime_us 1 100 -13107.20 5000.00 ECU_ADDRESS 0xC000C192 /end MEASUREMENT
/begin MEASUREMENT InjVlv_tiPoI2ZFCETCor_mp05 "" SWORD InjTime_us 1 100 -13107.20 5000.00 ECU_ADDRESS 0xC000C194 /end MEASUREMENT
/begin MEASUREMENT InjVlv_volMI1CorCyc00 "zylinderspezifisches Korrekturvolumen aus Mengenausgleichsregelung und Injektor-Abgleichmenge für MI1" SWORD InjQntInj 1 100 -327.6800 327.6700 ECU_ADDRESS 0xD000102C /end MEASUREMENT
/begin MEASUREMENT InjVlv_volMI1CorCyc01 "zylinderspezifisches Korrekturvolumen aus Mengenausgleichsregelung und Injektor-Abgleichmenge für MI1" SWORD InjQntInj 1 100 -327.6800 327.6700 ECU_ADDRESS 0xD000102E /end MEASUREMENT
/begin MEASUREMENT InjVlv_volMI1CorCyc02 "zylinderspezifisches Korrekturvolumen aus Mengenausgleichsregelung und Injektor-Abgleichmenge für MI1" SWORD InjQntInj 1 100 -327.6800 327.6700 ECU_ADDRESS 0xD0001030 /end MEASUREMENT
/begin MEASUREMENT InjVlv_volMI1CorCyc03 "zylinderspezifisches Korrekturvolumen aus Mengenausgleichsregelung und Injektor-Abgleichmenge für MI1" SWORD InjQntInj 1 100 -327.6800 327.6700 ECU_ADDRESS 0xD0001032 /end MEASUREMENT
/begin MEASUREMENT InjVlv_volMI1CorCyc04 "zylinderspezifisches Korrekturvolumen aus Mengenausgleichsregelung und Injektor-Abgleichmenge für MI1" SWORD InjQntInj 1 100 -327.6800 327.6700 ECU_ADDRESS 0xD0001034 /end MEASUREMENT
/begin MEASUREMENT InjVlv_volMI1CorCyc05 "zylinderspezifisches Korrekturvolumen aus Mengenausgleichsregelung und Injektor-Abgleichmenge für MI1" SWORD InjQntInj 1 100 -327.6800 327.6700 ECU_ADDRESS 0xD0001036 /end MEASUREMENT
/begin MEASUREMENT InjVlv_volPiI1CorCyc00 "zylinderspezifisches Korrekturvolumen aus Mengenausgleichsregelung und Injektor-Abgleichmenge für PiI1" SWORD InjQntInj 1 100 -327.6800 327.6700 ECU_ADDRESS 0xD0001038 /end MEASUREMENT
/begin MEASUREMENT InjVlv_volPiI1CorCyc01 "zylinderspezifisches Korrekturvolumen aus Mengenausgleichsregelung und Injektor-Abgleichmenge für PiI1" SWORD InjQntInj 1 100 -327.6800 327.6700 ECU_ADDRESS 0xD000103A /end MEASUREMENT
/begin MEASUREMENT InjVlv_volPiI1CorCyc02 "zylinderspezifisches Korrekturvolumen aus Mengenausgleichsregelung und Injektor-Abgleichmenge für PiI1" SWORD InjQntInj 1 100 -327.6800 327.6700 ECU_ADDRESS 0xD000103C /end MEASUREMENT
/begin MEASUREMENT InjVlv_volPiI1CorCyc03 "zylinderspezifisches Korrekturvolumen aus Mengenausgleichsregelung und Injektor-Abgleichmenge für PiI1" SWORD InjQntInj 1 100 -327.6800 327.6700 ECU_ADDRESS 0xD000103E /end MEASUREMENT
/begin MEASUREMENT InjVlv_volPiI1CorCyc04 "zylinderspezifisches Korrekturvolumen aus Mengenausgleichsregelung und Injektor-Abgleichmenge für PiI1" SWORD InjQntInj 1 100 -327.6800 327.6700 ECU_ADDRESS 0xD0001040 /end MEASUREMENT
/begin MEASUREMENT InjVlv_volPiI1CorCyc05 "zylinderspezifisches Korrekturvolumen aus Mengenausgleichsregelung und Injektor-Abgleichmenge für PiI1" SWORD InjQntInj 1 100 -327.6800 327.6700 ECU_ADDRESS 0xD0001042 /end MEASUREMENT
/begin MEASUREMENT InjVlv_volPiI2CorCyc00 "zylinderspezifisches Korrekturvolumen aus Mengenausgleichsregelung und Injektor-Abgleichmenge für PiI2" SWORD InjQntInj 1 100 -327.6800 327.6700 ECU_ADDRESS 0xD0001044 /end MEASUREMENT
/begin MEASUREMENT InjVlv_volPiI2CorCyc01 "zylinderspezifisches Korrekturvolumen aus Mengenausgleichsregelung und Injektor-Abgleichmenge für PiI2" SWORD InjQntInj 1 100 -327.6800 327.6700 ECU_ADDRESS 0xD0001046 /end MEASUREMENT
/begin MEASUREMENT InjVlv_volPiI2CorCyc02 "zylinderspezifisches Korrekturvolumen aus Mengenausgleichsregelung und Injektor-Abgleichmenge für PiI2" SWORD InjQntInj 1 100 -327.6800 327.6700 ECU_ADDRESS 0xD0001048 /end MEASUREMENT
/begin MEASUREMENT InjVlv_volPiI2CorCyc03 "zylinderspezifisches Korrekturvolumen aus Mengenausgleichsregelung und Injektor-Abgleichmenge für PiI2" SWORD InjQntInj 1 100 -327.6800 327.6700 ECU_ADDRESS 0xD000104A /end MEASUREMENT
/begin MEASUREMENT InjVlv_volPiI2CorCyc04 "zylinderspezifisches Korrekturvolumen aus Mengenausgleichsregelung und Injektor-Abgleichmenge für PiI2" SWORD InjQntInj 1 100 -327.6800 327.6700 ECU_ADDRESS 0xD000104C /end MEASUREMENT
/begin MEASUREMENT InjVlv_volPiI2CorCyc05 "zylinderspezifisches Korrekturvolumen aus Mengenausgleichsregelung und Injektor-Abgleichmenge für PiI2" SWORD InjQntInj 1 100 -327.6800 327.6700 ECU_ADDRESS 0xD000104E /end MEASUREMENT
/begin MEASUREMENT InjVlv_volPoI2CorCyc00 "Zylinderspezifisches Korrekturvolumen aus Mengenausgleichsregelung und Injektor-Abgleichmenge für PoI2" SWORD InjQntInj 1 100 -327.6800 327.6700 ECU_ADDRESS 0xD0001050 /end MEASUREMENT
/begin MEASUREMENT InjVlv_volPoI2CorCyc01 "Zylinderspezifisches Korrekturvolumen aus Mengenausgleichsregelung und Injektor-Abgleichmenge für PoI2" SWORD InjQntInj 1 100 -327.6800 327.6700 ECU_ADDRESS 0xD0001052 /end MEASUREMENT
/begin MEASUREMENT InjVlv_volPoI2CorCyc02 "Zylinderspezifisches Korrekturvolumen aus Mengenausgleichsregelung und Injektor-Abgleichmenge für PoI2" SWORD InjQntInj 1 100 -327.6800 327.6700 ECU_ADDRESS 0xD0001054 /end MEASUREMENT
/begin MEASUREMENT InjVlv_volPoI2CorCyc03 "Zylinderspezifisches Korrekturvolumen aus Mengenausgleichsregelung und Injektor-Abgleichmenge für PoI2" SWORD InjQntInj 1 100 -327.6800 327.6700 ECU_ADDRESS 0xD0001056 /end MEASUREMENT
/begin MEASUREMENT InjVlv_volPoI2CorCyc04 "Zylinderspezifisches Korrekturvolumen aus Mengenausgleichsregelung und Injektor-Abgleichmenge für PoI2" SWORD InjQntInj 1 100 -327.6800 327.6700 ECU_ADDRESS 0xD0001058 /end MEASUREMENT
/begin MEASUREMENT InjVlv_volPoI2CorCyc05 "Zylinderspezifisches Korrekturvolumen aus Mengenausgleichsregelung und Injektor-Abgleichmenge für PoI2" SWORD InjQntInj 1 100 -327.6800 327.6700 ECU_ADDRESS 0xD000105A /end MEASUREMENT
/begin MEASUREMENT ISC_st00 "Statusinformation des ISC und seiner Clients" ULONG OneToOne 1 100 0.00 4294967295.00 ECU_ADDRESS 0xD0002CEC /end MEASUREMENT
/begin MEASUREMENT ISC_st01 "Statusinformation des ISC und seiner Clients" ULONG OneToOne 1 100 0.00 4294967295.00 ECU_ADDRESS 0xD0002CF0 /end MEASUREMENT
/begin MEASUREMENT ISC_st02 "Statusinformation des ISC und seiner Clients" ULONG OneToOne 1 100 0.00 4294967295.00 ECU_ADDRESS 0xD0002CF4 /end MEASUREMENT
/begin MEASUREMENT ISC_st03 "Statusinformation des ISC und seiner Clients" ULONG OneToOne 1 100 0.00 4294967295.00 ECU_ADDRESS 0xD0002CF8 /end MEASUREMENT
/begin MEASUREMENT ISC_st04 "Statusinformation des ISC und seiner Clients" ULONG OneToOne 1 100 0.00 4294967295.00 ECU_ADDRESS 0xD0002CFC /end MEASUREMENT
/begin MEASUREMENT ISC_st05 "Statusinformation des ISC und seiner Clients" ULONG OneToOne 1 100 0.00 4294967295.00 ECU_ADDRESS 0xD0002D00 /end MEASUREMENT
/begin MEASUREMENT IVActr_ch00 "Ladung beim piezo Aktor-Ladevorgang" SWORD Charge_PA 1 100 -32768.00 32767.00 FORMAT "%8.2" ECU_ADDRESS 0xD0000BA8 /end MEASUREMENT
/begin MEASUREMENT IVActr_ch01 "Ladung beim piezo Aktor-Ladevorgang" SWORD Charge_PA 1 100 -32768.00 32767.00 FORMAT "%8.2" ECU_ADDRESS 0xD0000BAA /end MEASUREMENT
/begin MEASUREMENT IVActr_ch02 "Ladung beim piezo Aktor-Ladevorgang" SWORD Charge_PA 1 100 -32768.00 32767.00 FORMAT "%8.2" ECU_ADDRESS 0xD0000BAC /end MEASUREMENT
/begin MEASUREMENT IVActr_ch03 "Ladung beim piezo Aktor-Ladevorgang" SWORD Charge_PA 1 100 -32768.00 32767.00 FORMAT "%8.2" ECU_ADDRESS 0xD0000BAE /end MEASUREMENT
/begin MEASUREMENT IVActr_ch04 "Ladung beim piezo Aktor-Ladevorgang" SWORD Charge_PA 1 100 -32768.00 32767.00 FORMAT "%8.2" ECU_ADDRESS 0xD0000BB0 /end MEASUREMENT
/begin MEASUREMENT IVActr_ch05 "Ladung beim piezo Aktor-Ladevorgang" SWORD Charge_PA 1 100 -32768.00 32767.00 FORMAT "%8.2" ECU_ADDRESS 0xD0000BB2 /end MEASUREMENT
/begin MEASUREMENT IVActr_ctIntrGetMeas00 "Anzahl Interrups des gemessenen Einspritztyps zwischen Start und Auswertung der Aktormessung" UBYTE OneToOne 1 100 0.00 255.0 ECU_ADDRESS 0xD0001E7D /end MEASUREMENT
/begin MEASUREMENT IVActr_ctIntrGetMeas01 "Anzahl Interrups des gemessenen Einspritztyps zwischen Start und Auswertung der Aktormessung" UBYTE OneToOne 1 100 0.00 255.0 ECU_ADDRESS 0xD0001E7E /end MEASUREMENT
/begin MEASUREMENT IVActr_ctIntrGetMeas02 "Anzahl Interrups des gemessenen Einspritztyps zwischen Start und Auswertung der Aktormessung" UBYTE OneToOne 1 100 0.00 255.0 ECU_ADDRESS 0xD0001E7F /end MEASUREMENT
/begin MEASUREMENT IVActr_ctIntrGetMeas03 "Anzahl Interrups des gemessenen Einspritztyps zwischen Start und Auswertung der Aktormessung" UBYTE OneToOne 1 100 0.00 255.0 ECU_ADDRESS 0xD0001E80 /end MEASUREMENT
/begin MEASUREMENT IVActr_ctIntrGetMeas04 "Anzahl Interrups des gemessenen Einspritztyps zwischen Start und Auswertung der Aktormessung" UBYTE OneToOne 1 100 0.00 255.0 ECU_ADDRESS 0xD0001E81 /end MEASUREMENT
/begin MEASUREMENT IVActr_ctIntrGetMeas05 "Anzahl Interrups des gemessenen Einspritztyps zwischen Start und Auswertung der Aktormessung" UBYTE OneToOne 1 100 0.00 255.0 ECU_ADDRESS 0xD0001E82 /end MEASUREMENT
/begin MEASUREMENT IVActr_facWActrDvtUnCor_mp00 "unkorrigierter Faktor der Aktorenergieabweichung" SWORD Fact1 1 100 -256.0000 255.9922 ECU_ADDRESS 0xC000C196 /end MEASUREMENT
/begin MEASUREMENT IVActr_facWActrDvtUnCor_mp01 "unkorrigierter Faktor der Aktorenergieabweichung" SWORD Fact1 1 100 -256.0000 255.9922 ECU_ADDRESS 0xC000C198 /end MEASUREMENT
/begin MEASUREMENT IVActr_facWActrDvtUnCor_mp02 "unkorrigierter Faktor der Aktorenergieabweichung" SWORD Fact1 1 100 -256.0000 255.9922 ECU_ADDRESS 0xC000C19A /end MEASUREMENT
/begin MEASUREMENT IVActr_facWActrDvtUnCor_mp03 "unkorrigierter Faktor der Aktorenergieabweichung" SWORD Fact1 1 100 -256.0000 255.9922 ECU_ADDRESS 0xC000C19C /end MEASUREMENT
/begin MEASUREMENT IVActr_facWActrDvtUnCor_mp04 "unkorrigierter Faktor der Aktorenergieabweichung" SWORD Fact1 1 100 -256.0000 255.9922 ECU_ADDRESS 0xC000C19E /end MEASUREMENT
/begin MEASUREMENT IVActr_facWActrDvtUnCor_mp05 "unkorrigierter Faktor der Aktorenergieabweichung" SWORD Fact1 1 100 -256.0000 255.9922 ECU_ADDRESS 0xC000C1A0 /end MEASUREMENT
/begin MEASUREMENT IVActr_pRailLnk00 "gepaarten Raildruck der gemessenen Einspritzung" SWORD Pres_Rail 1 100 -3276.800 2000.000 ECU_ADDRESS 0xD0000BB6 /end MEASUREMENT
/begin MEASUREMENT IVActr_pRailLnk01 "gepaarten Raildruck der gemessenen Einspritzung" SWORD Pres_Rail 1 100 -3276.800 2000.000 ECU_ADDRESS 0xD0000BB8 /end MEASUREMENT
/begin MEASUREMENT IVActr_pRailLnk02 "gepaarten Raildruck der gemessenen Einspritzung" SWORD Pres_Rail 1 100 -3276.800 2000.000 ECU_ADDRESS 0xD0000BBA /end MEASUREMENT
/begin MEASUREMENT IVActr_pRailLnk03 "gepaarten Raildruck der gemessenen Einspritzung" SWORD Pres_Rail 1 100 -3276.800 2000.000 ECU_ADDRESS 0xD0000BBC /end MEASUREMENT
/begin MEASUREMENT IVActr_pRailLnk04 "gepaarten Raildruck der gemessenen Einspritzung" SWORD Pres_Rail 1 100 -3276.800 2000.000 ECU_ADDRESS 0xD0000BBE /end MEASUREMENT
/begin MEASUREMENT IVActr_pRailLnk05 "gepaarten Raildruck der gemessenen Einspritzung" SWORD Pres_Rail 1 100 -3276.800 2000.000 ECU_ADDRESS 0xD0000BC0 /end MEASUREMENT
/begin MEASUREMENT IVActr_stActrEnrg00 "Status der Aktorenergieberechnung" UWORD OneToOne 1 100 0.00 65535.00 ECU_ADDRESS 0xD00015C8 /end MEASUREMENT
/begin MEASUREMENT IVActr_stActrEnrg01 "Status der Aktorenergieberechnung" UWORD OneToOne 1 100 0.00 65535.00 ECU_ADDRESS 0xD00015CA /end MEASUREMENT
/begin MEASUREMENT IVActr_stActrEnrg02 "Status der Aktorenergieberechnung" UWORD OneToOne 1 100 0.00 65535.00 ECU_ADDRESS 0xD00015CC /end MEASUREMENT
/begin MEASUREMENT IVActr_stActrEnrg03 "Status der Aktorenergieberechnung" UWORD OneToOne 1 100 0.00 65535.00 ECU_ADDRESS 0xD00015CE /end MEASUREMENT
/begin MEASUREMENT IVActr_stActrEnrg04 "Status der Aktorenergieberechnung" UWORD OneToOne 1 100 0.00 65535.00 ECU_ADDRESS 0xD00015D0 /end MEASUREMENT
/begin MEASUREMENT IVActr_stActrEnrg05 "Status der Aktorenergieberechnung" UWORD OneToOne 1 100 0.00 65535.00 ECU_ADDRESS 0xD00015D2 /end MEASUREMENT
/begin MEASUREMENT IVActr_stCh00 "Status von IVActr_ch" UBYTE OneToOne 1 100 0.00 255.0 ECU_ADDRESS 0xD0001E83 /end MEASUREMENT
/begin MEASUREMENT IVActr_stCh01 "Status von IVActr_ch" UBYTE OneToOne 1 100 0.00 255.0 ECU_ADDRESS 0xD0001E84 /end MEASUREMENT
/begin MEASUREMENT IVActr_stCh02 "Status von IVActr_ch" UBYTE OneToOne 1 100 0.00 255.0 ECU_ADDRESS 0xD0001E85 /end MEASUREMENT
/begin MEASUREMENT IVActr_stCh03 "Status von IVActr_ch" UBYTE OneToOne 1 100 0.00 255.0 ECU_ADDRESS 0xD0001E86 /end MEASUREMENT
/begin MEASUREMENT IVActr_stCh04 "Status von IVActr_ch" UBYTE OneToOne 1 100 0.00 255.0 ECU_ADDRESS 0xD0001E87 /end MEASUREMENT
/begin MEASUREMENT IVActr_stCh05 "Status von IVActr_ch" UBYTE OneToOne 1 100 0.00 255.0 ECU_ADDRESS 0xD0001E88 /end MEASUREMENT
/begin MEASUREMENT IVActr_stGetMeas00 "Status der Aktormessung, Einspritzungsmodus" UBYTE OneToOne 1 100 0.00 255.0 ECU_ADDRESS 0xD0001E8A /end MEASUREMENT
/begin MEASUREMENT IVActr_stGetMeas01 "Status der Aktormessung, Einspritzungsmodus" UBYTE OneToOne 1 100 0.00 255.0 ECU_ADDRESS 0xD0001E8B /end MEASUREMENT
/begin MEASUREMENT IVActr_stGetMeas02 "Status der Aktormessung, Einspritzungsmodus" UBYTE OneToOne 1 100 0.00 255.0 ECU_ADDRESS 0xD0001E8C /end MEASUREMENT
/begin MEASUREMENT IVActr_stGetMeas03 "Status der Aktormessung, Einspritzungsmodus" UBYTE OneToOne 1 100 0.00 255.0 ECU_ADDRESS 0xD0001E8D /end MEASUREMENT
/begin MEASUREMENT IVActr_stGetMeas04 "Status der Aktormessung, Einspritzungsmodus" UBYTE OneToOne 1 100 0.00 255.0 ECU_ADDRESS 0xD0001E8E /end MEASUREMENT
/begin MEASUREMENT IVActr_stGetMeas05 "Status der Aktormessung, Einspritzungsmodus" UBYTE OneToOne 1 100 0.00 255.0 ECU_ADDRESS 0xD0001E8F /end MEASUREMENT
/begin MEASUREMENT IVActr_stTiDisCh00 "Status der Aktor-Entladezeit" UBYTE OneToOne 1 100 0.00 255.0 ECU_ADDRESS 0xD0001E93 /end MEASUREMENT
/begin MEASUREMENT IVActr_stTiDisCh01 "Status der Aktor-Entladezeit" UBYTE OneToOne 1 100 0.00 255.0 ECU_ADDRESS 0xD0001E94 /end MEASUREMENT
/begin MEASUREMENT IVActr_stTiDisCh02 "Status der Aktor-Entladezeit" UBYTE OneToOne 1 100 0.00 255.0 ECU_ADDRESS 0xD0001E95 /end MEASUREMENT
/begin MEASUREMENT IVActr_stTiDisCh03 "Status der Aktor-Entladezeit" UBYTE OneToOne 1 100 0.00 255.0 ECU_ADDRESS 0xD0001E96 /end MEASUREMENT
/begin MEASUREMENT IVActr_stTiDisCh04 "Status der Aktor-Entladezeit" UBYTE OneToOne 1 100 0.00 255.0 ECU_ADDRESS 0xD0001E97 /end MEASUREMENT
/begin MEASUREMENT IVActr_stTiDisCh05 "Status der Aktor-Entladezeit" UBYTE OneToOne 1 100 0.00 255.0 ECU_ADDRESS 0xD0001E98 /end MEASUREMENT
/begin MEASUREMENT IVActr_stTiETMeas00 "Status der gemessenen Ansteuerdauer" UBYTE OneToOne 1 100 0.00 255.0 ECU_ADDRESS 0xD0001E99 /end MEASUREMENT
/begin MEASUREMENT IVActr_stTiETMeas01 "Status der gemessenen Ansteuerdauer" UBYTE OneToOne 1 100 0.00 255.0 ECU_ADDRESS 0xD0001E9A /end MEASUREMENT
/begin MEASUREMENT IVActr_stTiETMeas02 "Status der gemessenen Ansteuerdauer" UBYTE OneToOne 1 100 0.00 255.0 ECU_ADDRESS 0xD0001E9B /end MEASUREMENT
/begin MEASUREMENT IVActr_stTiETMeas03 "Status der gemessenen Ansteuerdauer" UBYTE OneToOne 1 100 0.00 255.0 ECU_ADDRESS 0xD0001E9C /end MEASUREMENT
/begin MEASUREMENT IVActr_stTiETMeas04 "Status der gemessenen Ansteuerdauer" UBYTE OneToOne 1 100 0.00 255.0 ECU_ADDRESS 0xD0001E9D /end MEASUREMENT
/begin MEASUREMENT IVActr_stTiETMeas05 "Status der gemessenen Ansteuerdauer" UBYTE OneToOne 1 100 0.00 255.0 ECU_ADDRESS 0xD0001E9E /end MEASUREMENT
/begin MEASUREMENT IVActr_stUChrgUp00 "Status der Aktorspannung nach dem Laden" UBYTE OneToOne 1 100 0.00 255.0 ECU_ADDRESS 0xD0001E9F /end MEASUREMENT
/begin MEASUREMENT IVActr_stUChrgUp01 "Status der Aktorspannung nach dem Laden" UBYTE OneToOne 1 100 0.00 255.0 ECU_ADDRESS 0xD0001EA0 /end MEASUREMENT
/begin MEASUREMENT IVActr_stUChrgUp02 "Status der Aktorspannung nach dem Laden" UBYTE OneToOne 1 100 0.00 255.0 ECU_ADDRESS 0xD0001EA1 /end MEASUREMENT
/begin MEASUREMENT IVActr_stUChrgUp03 "Status der Aktorspannung nach dem Laden" UBYTE OneToOne 1 100 0.00 255.0 ECU_ADDRESS 0xD0001EA2 /end MEASUREMENT
/begin MEASUREMENT IVActr_stUChrgUp04 "Status der Aktorspannung nach dem Laden" UBYTE OneToOne 1 100 0.00 255.0 ECU_ADDRESS 0xD0001EA3 /end MEASUREMENT
/begin MEASUREMENT IVActr_stUChrgUp05 "Status der Aktorspannung nach dem Laden" UBYTE OneToOne 1 100 0.00 255.0 ECU_ADDRESS 0xD0001EA4 /end MEASUREMENT
/begin MEASUREMENT IVActr_stUDisChStop00 "Status der Aktorspannung nach dem Entladen" UBYTE OneToOne 1 100 0.00 255.0 ECU_ADDRESS 0xD0001EA5 /end MEASUREMENT
/begin MEASUREMENT IVActr_stUDisChStop01 "Status der Aktorspannung nach dem Entladen" UBYTE OneToOne 1 100 0.00 255.0 ECU_ADDRESS 0xD0001EA6 /end MEASUREMENT
/begin MEASUREMENT IVActr_stUDisChStop02 "Status der Aktorspannung nach dem Entladen" UBYTE OneToOne 1 100 0.00 255.0 ECU_ADDRESS 0xD0001EA7 /end MEASUREMENT
/begin MEASUREMENT IVActr_stUDisChStop03 "Status der Aktorspannung nach dem Entladen" UBYTE OneToOne 1 100 0.00 255.0 ECU_ADDRESS 0xD0001EA8 /end MEASUREMENT
/begin MEASUREMENT IVActr_stUDisChStop04 "Status der Aktorspannung nach dem Entladen" UBYTE OneToOne 1 100 0.00 255.0 ECU_ADDRESS 0xD0001EA9 /end MEASUREMENT
/begin MEASUREMENT IVActr_stUDisChStop05 "Status der Aktorspannung nach dem Entladen" UBYTE OneToOne 1 100 0.00 255.0 ECU_ADDRESS 0xD0001EAA /end MEASUREMENT
/begin MEASUREMENT IVActr_stUTunChk00 "" UBYTE OneToOne 1 100 0.00 255.0 ECU_ADDRESS 0xD0001EAB /end MEASUREMENT
/begin MEASUREMENT IVActr_stUTunChk01 "" UBYTE OneToOne 1 100 0.00 255.0 ECU_ADDRESS 0xD0001EAC /end MEASUREMENT
/begin MEASUREMENT IVActr_stUTunChk02 "" UBYTE OneToOne 1 100 0.00 255.0 ECU_ADDRESS 0xD0001EAD /end MEASUREMENT
/begin MEASUREMENT IVActr_stUTunChk03 "" UBYTE OneToOne 1 100 0.00 255.0 ECU_ADDRESS 0xD0001EAE /end MEASUREMENT
/begin MEASUREMENT IVActr_stUTunChk04 "" UBYTE OneToOne 1 100 0.00 255.0 ECU_ADDRESS 0xD0001EAF /end MEASUREMENT
/begin MEASUREMENT IVActr_stUTunChk05 "" UBYTE OneToOne 1 100 0.00 255.0 ECU_ADDRESS 0xD0001EB0 /end MEASUREMENT
/begin MEASUREMENT IVActr_stUUp00 "Status der Aktorspannung Up-Niveau" UBYTE OneToOne 1 100 0.00 255.0 ECU_ADDRESS 0xD0001EB1 /end MEASUREMENT
/begin MEASUREMENT IVActr_stUUp01 "Status der Aktorspannung Up-Niveau" UBYTE OneToOne 1 100 0.00 255.0 ECU_ADDRESS 0xD0001EB2 /end MEASUREMENT
/begin MEASUREMENT IVActr_stUUp02 "Status der Aktorspannung Up-Niveau" UBYTE OneToOne 1 100 0.00 255.0 ECU_ADDRESS 0xD0001EB3 /end MEASUREMENT
/begin MEASUREMENT IVActr_stUUp03 "Status der Aktorspannung Up-Niveau" UBYTE OneToOne 1 100 0.00 255.0 ECU_ADDRESS 0xD0001EB4 /end MEASUREMENT
/begin MEASUREMENT IVActr_stUUp04 "Status der Aktorspannung Up-Niveau" UBYTE OneToOne 1 100 0.00 255.0 ECU_ADDRESS 0xD0001EB5 /end MEASUREMENT
/begin MEASUREMENT IVActr_stUUp05 "Status der Aktorspannung Up-Niveau" UBYTE OneToOne 1 100 0.00 255.0 ECU_ADDRESS 0xD0001EB6 /end MEASUREMENT
/begin MEASUREMENT IVActr_tiActrMeasCurr00 "Zylinderspezifischer Zeitstempel der letzen Aktormessung, aktualisiert in 10ms." ULONG Time_PzoMeas 1 100 0.00 234505214.307 FORMAT "%13.3" ECU_ADDRESS 0xD0003174 /end MEASUREMENT
/begin MEASUREMENT IVActr_tiActrMeasCurr01 "Zylinderspezifischer Zeitstempel der letzen Aktormessung, aktualisiert in 10ms." ULONG Time_PzoMeas 1 100 0.00 234505214.307 FORMAT "%13.3" ECU_ADDRESS 0xD0003178 /end MEASUREMENT
/begin MEASUREMENT IVActr_tiActrMeasCurr02 "Zylinderspezifischer Zeitstempel der letzen Aktormessung, aktualisiert in 10ms." ULONG Time_PzoMeas 1 100 0.00 234505214.307 FORMAT "%13.3" ECU_ADDRESS 0xD000317C /end MEASUREMENT
/begin MEASUREMENT IVActr_tiActrMeasCurr03 "Zylinderspezifischer Zeitstempel der letzen Aktormessung, aktualisiert in 10ms." ULONG Time_PzoMeas 1 100 0.00 234505214.307 FORMAT "%13.3" ECU_ADDRESS 0xD0003180 /end MEASUREMENT
/begin MEASUREMENT IVActr_tiActrMeasCurr04 "Zylinderspezifischer Zeitstempel der letzen Aktormessung, aktualisiert in 10ms." ULONG Time_PzoMeas 1 100 0.00 234505214.307 FORMAT "%13.3" ECU_ADDRESS 0xD0003184 /end MEASUREMENT
/begin MEASUREMENT IVActr_tiActrMeasCurr05 "Zylinderspezifischer Zeitstempel der letzen Aktormessung, aktualisiert in 10ms." ULONG Time_PzoMeas 1 100 0.00 234505214.307 FORMAT "%13.3" ECU_ADDRESS 0xD0003188 /end MEASUREMENT
/begin MEASUREMENT IVActr_tiChrgLnk00 "gepaarte Soll-Ladezeit" SWORD InjTime_us 1 100 -13107.20 5000.00 ECU_ADDRESS 0xD0000BC4 /end MEASUREMENT
/begin MEASUREMENT IVActr_tiChrgLnk01 "gepaarte Soll-Ladezeit" SWORD InjTime_us 1 100 -13107.20 5000.00 ECU_ADDRESS 0xD0000BC6 /end MEASUREMENT
/begin MEASUREMENT IVActr_tiChrgLnk02 "gepaarte Soll-Ladezeit" SWORD InjTime_us 1 100 -13107.20 5000.00 ECU_ADDRESS 0xD0000BC8 /end MEASUREMENT
/begin MEASUREMENT IVActr_tiChrgLnk03 "gepaarte Soll-Ladezeit" SWORD InjTime_us 1 100 -13107.20 5000.00 ECU_ADDRESS 0xD0000BCA /end MEASUREMENT
/begin MEASUREMENT IVActr_tiChrgLnk04 "gepaarte Soll-Ladezeit" SWORD InjTime_us 1 100 -13107.20 5000.00 ECU_ADDRESS 0xD0000BCC /end MEASUREMENT
/begin MEASUREMENT IVActr_tiChrgLnk05 "gepaarte Soll-Ladezeit" SWORD InjTime_us 1 100 -13107.20 5000.00 ECU_ADDRESS 0xD0000BCE /end MEASUREMENT
/begin MEASUREMENT IVActr_tiDiffActrInteg_mp00 "Zeitraum zwischen Integratorabgleich und Messung des aktuellen Zylinders" ULONG Time_PzoMeas 1 100 0.00 234505214.307 FORMAT "%13.3" ECU_ADDRESS 0xC000C1A4 /end MEASUREMENT
/begin MEASUREMENT IVActr_tiDiffActrInteg_mp01 "Zeitraum zwischen Integratorabgleich und Messung des aktuellen Zylinders" ULONG Time_PzoMeas 1 100 0.00 234505214.307 FORMAT "%13.3" ECU_ADDRESS 0xC000C1A8 /end MEASUREMENT
/begin MEASUREMENT IVActr_tiDiffActrInteg_mp02 "Zeitraum zwischen Integratorabgleich und Messung des aktuellen Zylinders" ULONG Time_PzoMeas 1 100 0.00 234505214.307 FORMAT "%13.3" ECU_ADDRESS 0xC000C1AC /end MEASUREMENT
/begin MEASUREMENT IVActr_tiDiffActrInteg_mp03 "Zeitraum zwischen Integratorabgleich und Messung des aktuellen Zylinders" ULONG Time_PzoMeas 1 100 0.00 234505214.307 FORMAT "%13.3" ECU_ADDRESS 0xC000C1B0 /end MEASUREMENT
/begin MEASUREMENT IVActr_tiDiffActrInteg_mp04 "Zeitraum zwischen Integratorabgleich und Messung des aktuellen Zylinders" ULONG Time_PzoMeas 1 100 0.00 234505214.307 FORMAT "%13.3" ECU_ADDRESS 0xC000C1B4 /end MEASUREMENT
/begin MEASUREMENT IVActr_tiDiffActrInteg_mp05 "Zeitraum zwischen Integratorabgleich und Messung des aktuellen Zylinders" ULONG Time_PzoMeas 1 100 0.00 234505214.307 FORMAT "%13.3" ECU_ADDRESS 0xC000C1B8 /end MEASUREMENT
/begin MEASUREMENT IVActr_tiDisCh00 "Aktor-Entladezeit" SWORD InjTime_us 1 100 -13107.20 5000.00 ECU_ADDRESS 0xD0000BDC /end MEASUREMENT
/begin MEASUREMENT IVActr_tiDisCh01 "Aktor-Entladezeit" SWORD InjTime_us 1 100 -13107.20 5000.00 ECU_ADDRESS 0xD0000BDE /end MEASUREMENT
/begin MEASUREMENT IVActr_tiDisCh02 "Aktor-Entladezeit" SWORD InjTime_us 1 100 -13107.20 5000.00 ECU_ADDRESS 0xD0000BE0 /end MEASUREMENT
/begin MEASUREMENT IVActr_tiDisCh03 "Aktor-Entladezeit" SWORD InjTime_us 1 100 -13107.20 5000.00 ECU_ADDRESS 0xD0000BE2 /end MEASUREMENT
/begin MEASUREMENT IVActr_tiDisCh04 "Aktor-Entladezeit" SWORD InjTime_us 1 100 -13107.20 5000.00 ECU_ADDRESS 0xD0000BE4 /end MEASUREMENT
/begin MEASUREMENT IVActr_tiDisCh05 "Aktor-Entladezeit" SWORD InjTime_us 1 100 -13107.20 5000.00 ECU_ADDRESS 0xD0000BE6 /end MEASUREMENT
/begin MEASUREMENT IVActr_tiDisChLnk00 "gepaarte Soll-Entladezeit" SWORD InjTime_us 1 100 -13107.20 5000.00 ECU_ADDRESS 0xD0000BD0 /end MEASUREMENT
/begin MEASUREMENT IVActr_tiDisChLnk01 "gepaarte Soll-Entladezeit" SWORD InjTime_us 1 100 -13107.20 5000.00 ECU_ADDRESS 0xD0000BD2 /end MEASUREMENT
/begin MEASUREMENT IVActr_tiDisChLnk02 "gepaarte Soll-Entladezeit" SWORD InjTime_us 1 100 -13107.20 5000.00 ECU_ADDRESS 0xD0000BD4 /end MEASUREMENT
/begin MEASUREMENT IVActr_tiDisChLnk03 "gepaarte Soll-Entladezeit" SWORD InjTime_us 1 100 -13107.20 5000.00 ECU_ADDRESS 0xD0000BD6 /end MEASUREMENT
/begin MEASUREMENT IVActr_tiDisChLnk04 "gepaarte Soll-Entladezeit" SWORD InjTime_us 1 100 -13107.20 5000.00 ECU_ADDRESS 0xD0000BD8 /end MEASUREMENT
/begin MEASUREMENT IVActr_tiDisChLnk05 "gepaarte Soll-Entladezeit" SWORD InjTime_us 1 100 -13107.20 5000.00 ECU_ADDRESS 0xD0000BDA /end MEASUREMENT
/begin MEASUREMENT IVActr_tiEnrgCalc00 "Zeitstempel der Aktorenergieberechnung" ULONG Time_PzoMeas 1 100 0.00 234505214.307 FORMAT "%13.3" ECU_ADDRESS 0xD000318C /end MEASUREMENT
/begin MEASUREMENT IVActr_tiEnrgCalc01 "Zeitstempel der Aktorenergieberechnung" ULONG Time_PzoMeas 1 100 0.00 234505214.307 FORMAT "%13.3" ECU_ADDRESS 0xD0003190 /end MEASUREMENT
/begin MEASUREMENT IVActr_tiEnrgCalc02 "Zeitstempel der Aktorenergieberechnung" ULONG Time_PzoMeas 1 100 0.00 234505214.307 FORMAT "%13.3" ECU_ADDRESS 0xD0003194 /end MEASUREMENT
/begin MEASUREMENT IVActr_tiEnrgCalc03 "Zeitstempel der Aktorenergieberechnung" ULONG Time_PzoMeas 1 100 0.00 234505214.307 FORMAT "%13.3" ECU_ADDRESS 0xD0003198 /end MEASUREMENT
/begin MEASUREMENT IVActr_tiEnrgCalc04 "Zeitstempel der Aktorenergieberechnung" ULONG Time_PzoMeas 1 100 0.00 234505214.307 FORMAT "%13.3" ECU_ADDRESS 0xD000319C /end MEASUREMENT
/begin MEASUREMENT IVActr_tiEnrgCalc05 "Zeitstempel der Aktorenergieberechnung" ULONG Time_PzoMeas 1 100 0.00 234505214.307 FORMAT "%13.3" ECU_ADDRESS 0xD00031A0 /end MEASUREMENT
/begin MEASUREMENT IVActr_tiETMeas00 "Gemessene Ansteuerdauer" SWORD InjTime_us 1 100 -13107.20 5000.00 ECU_ADDRESS 0xD0000BE8 /end MEASUREMENT
/begin MEASUREMENT IVActr_tiETMeas01 "Gemessene Ansteuerdauer" SWORD InjTime_us 1 100 -13107.20 5000.00 ECU_ADDRESS 0xD0000BEA /end MEASUREMENT
/begin MEASUREMENT IVActr_tiETMeas02 "Gemessene Ansteuerdauer" SWORD InjTime_us 1 100 -13107.20 5000.00 ECU_ADDRESS 0xD0000BEC /end MEASUREMENT
/begin MEASUREMENT IVActr_tiETMeas03 "Gemessene Ansteuerdauer" SWORD InjTime_us 1 100 -13107.20 5000.00 ECU_ADDRESS 0xD0000BEE /end MEASUREMENT
/begin MEASUREMENT IVActr_tiETMeas04 "Gemessene Ansteuerdauer" SWORD InjTime_us 1 100 -13107.20 5000.00 ECU_ADDRESS 0xD0000BF0 /end MEASUREMENT
/begin MEASUREMENT IVActr_tiETMeas05 "Gemessene Ansteuerdauer" SWORD InjTime_us 1 100 -13107.20 5000.00 ECU_ADDRESS 0xD0000BF2 /end MEASUREMENT
/begin MEASUREMENT IVActr_uChrgUp00 "Aktorspannung nach dem Laden" SWORD Vltg_PA 1 100 -327.6800 327.6700 ECU_ADDRESS 0xD0000BF4 /end MEASUREMENT
/begin MEASUREMENT IVActr_uChrgUp01 "Aktorspannung nach dem Laden" SWORD Vltg_PA 1 100 -327.6800 327.6700 ECU_ADDRESS 0xD0000BF6 /end MEASUREMENT
/begin MEASUREMENT IVActr_uChrgUp02 "Aktorspannung nach dem Laden" SWORD Vltg_PA 1 100 -327.6800 327.6700 ECU_ADDRESS 0xD0000BF8 /end MEASUREMENT
/begin MEASUREMENT IVActr_uChrgUp03 "Aktorspannung nach dem Laden" SWORD Vltg_PA 1 100 -327.6800 327.6700 ECU_ADDRESS 0xD0000BFA /end MEASUREMENT
/begin MEASUREMENT IVActr_uChrgUp04 "Aktorspannung nach dem Laden" SWORD Vltg_PA 1 100 -327.6800 327.6700 ECU_ADDRESS 0xD0000BFC /end MEASUREMENT
/begin MEASUREMENT IVActr_uChrgUp05 "Aktorspannung nach dem Laden" SWORD Vltg_PA 1 100 -327.6800 327.6700 ECU_ADDRESS 0xD0000BFE /end MEASUREMENT
/begin MEASUREMENT IVActr_uDisChStop00 "Aktorspannung nach dem Entladen" SWORD Vltg_PA 1 100 -327.6800 327.6700 ECU_ADDRESS 0xD0000C00 /end MEASUREMENT
/begin MEASUREMENT IVActr_uDisChStop01 "Aktorspannung nach dem Entladen" SWORD Vltg_PA 1 100 -327.6800 327.6700 ECU_ADDRESS 0xD0000C02 /end MEASUREMENT
/begin MEASUREMENT IVActr_uDisChStop02 "Aktorspannung nach dem Entladen" SWORD Vltg_PA 1 100 -327.6800 327.6700 ECU_ADDRESS 0xD0000C04 /end MEASUREMENT
/begin MEASUREMENT IVActr_uDisChStop03 "Aktorspannung nach dem Entladen" SWORD Vltg_PA 1 100 -327.6800 327.6700 ECU_ADDRESS 0xD0000C06 /end MEASUREMENT
/begin MEASUREMENT IVActr_uDisChStop04 "Aktorspannung nach dem Entladen" SWORD Vltg_PA 1 100 -327.6800 327.6700 ECU_ADDRESS 0xD0000C08 /end MEASUREMENT
/begin MEASUREMENT IVActr_uDisChStop05 "Aktorspannung nach dem Entladen" SWORD Vltg_PA 1 100 -327.6800 327.6700 ECU_ADDRESS 0xD0000C0A /end MEASUREMENT
/begin MEASUREMENT IVActr_uTunChk00 "" SWORD Vltg_PA 1 100 -327.6800 327.6700 ECU_ADDRESS 0xD0000C0C /end MEASUREMENT
/begin MEASUREMENT IVActr_uTunChk01 "" SWORD Vltg_PA 1 100 -327.6800 327.6700 ECU_ADDRESS 0xD0000C0E /end MEASUREMENT
/begin MEASUREMENT IVActr_uTunChk02 "" SWORD Vltg_PA 1 100 -327.6800 327.6700 ECU_ADDRESS 0xD0000C10 /end MEASUREMENT
/begin MEASUREMENT IVActr_uTunChk03 "" SWORD Vltg_PA 1 100 -327.6800 327.6700 ECU_ADDRESS 0xD0000C12 /end MEASUREMENT
/begin MEASUREMENT IVActr_uTunChk04 "" SWORD Vltg_PA 1 100 -327.6800 327.6700 ECU_ADDRESS 0xD0000C14 /end MEASUREMENT
/begin MEASUREMENT IVActr_uTunChk05 "" SWORD Vltg_PA 1 100 -327.6800 327.6700 ECU_ADDRESS 0xD0000C16 /end MEASUREMENT
/begin MEASUREMENT IVActr_uUp00 "Aktorspannung Up-Niveau" SWORD Vltg_PA 1 100 -327.6800 327.6700 ECU_ADDRESS 0xD0000C24 /end MEASUREMENT
/begin MEASUREMENT IVActr_uUp01 "Aktorspannung Up-Niveau" SWORD Vltg_PA 1 100 -327.6800 327.6700 ECU_ADDRESS 0xD0000C26 /end MEASUREMENT
/begin MEASUREMENT IVActr_uUp02 "Aktorspannung Up-Niveau" SWORD Vltg_PA 1 100 -327.6800 327.6700 ECU_ADDRESS 0xD0000C28 /end MEASUREMENT
/begin MEASUREMENT IVActr_uUp03 "Aktorspannung Up-Niveau" SWORD Vltg_PA 1 100 -327.6800 327.6700 ECU_ADDRESS 0xD0000C2A /end MEASUREMENT
/begin MEASUREMENT IVActr_uUp04 "Aktorspannung Up-Niveau" SWORD Vltg_PA 1 100 -327.6800 327.6700 ECU_ADDRESS 0xD0000C2C /end MEASUREMENT
/begin MEASUREMENT IVActr_uUp05 "Aktorspannung Up-Niveau" SWORD Vltg_PA 1 100 -327.6800 327.6700 ECU_ADDRESS 0xD0000C2E /end MEASUREMENT
/begin MEASUREMENT IVActr_uUpLnk00 "gepaarte Aktor-Sollspannung Up-Niveau" SWORD Vltg_PA 1 100 -327.6800 327.6700 ECU_ADDRESS 0xD0000C18 /end MEASUREMENT
/begin MEASUREMENT IVActr_uUpLnk01 "gepaarte Aktor-Sollspannung Up-Niveau" SWORD Vltg_PA 1 100 -327.6800 327.6700 ECU_ADDRESS 0xD0000C1A /end MEASUREMENT
/begin MEASUREMENT IVActr_uUpLnk02 "gepaarte Aktor-Sollspannung Up-Niveau" SWORD Vltg_PA 1 100 -327.6800 327.6700 ECU_ADDRESS 0xD0000C1C /end MEASUREMENT
/begin MEASUREMENT IVActr_uUpLnk03 "gepaarte Aktor-Sollspannung Up-Niveau" SWORD Vltg_PA 1 100 -327.6800 327.6700 ECU_ADDRESS 0xD0000C1E /end MEASUREMENT
/begin MEASUREMENT IVActr_uUpLnk04 "gepaarte Aktor-Sollspannung Up-Niveau" SWORD Vltg_PA 1 100 -327.6800 327.6700 ECU_ADDRESS 0xD0000C20 /end MEASUREMENT
/begin MEASUREMENT IVActr_uUpLnk05 "gepaarte Aktor-Sollspannung Up-Niveau" SWORD Vltg_PA 1 100 -327.6800 327.6700 ECU_ADDRESS 0xD0000C22 /end MEASUREMENT
/begin MEASUREMENT IVActr_wActrDiff_mp00 "Energie des Lade- Entladeenergiezyklus des Aktors" SWORD W_PA 1 100 -327.6800 327.6700 FORMAT "%8.4" ECU_ADDRESS 0xC000C1BC /end MEASUREMENT
/begin MEASUREMENT IVActr_wActrDiff_mp01 "Energie des Lade- Entladeenergiezyklus des Aktors" SWORD W_PA 1 100 -327.6800 327.6700 FORMAT "%8.4" ECU_ADDRESS 0xC000C1BE /end MEASUREMENT
/begin MEASUREMENT IVActr_wActrDiff_mp02 "Energie des Lade- Entladeenergiezyklus des Aktors" SWORD W_PA 1 100 -327.6800 327.6700 FORMAT "%8.4" ECU_ADDRESS 0xC000C1C0 /end MEASUREMENT
/begin MEASUREMENT IVActr_wActrDiff_mp03 "Energie des Lade- Entladeenergiezyklus des Aktors" SWORD W_PA 1 100 -327.6800 327.6700 FORMAT "%8.4" ECU_ADDRESS 0xC000C1C2 /end MEASUREMENT
/begin MEASUREMENT IVActr_wActrDiff_mp04 "Energie des Lade- Entladeenergiezyklus des Aktors" SWORD W_PA 1 100 -327.6800 327.6700 FORMAT "%8.4" ECU_ADDRESS 0xC000C1C4 /end MEASUREMENT
/begin MEASUREMENT IVActr_wActrDiff_mp05 "Energie des Lade- Entladeenergiezyklus des Aktors" SWORD W_PA 1 100 -327.6800 327.6700 FORMAT "%8.4" ECU_ADDRESS 0xC000C1C6 /end MEASUREMENT
/begin MEASUREMENT IVActr_wActrNomCor_mp00 "Temperaturkorrigierter nominaler Aktorenergieverbrauch" SWORD W_PA 1 100 -327.6800 327.6700 FORMAT "%8.4" ECU_ADDRESS 0xC000C1C8 /end MEASUREMENT
/begin MEASUREMENT IVActr_wActrNomCor_mp01 "Temperaturkorrigierter nominaler Aktorenergieverbrauch" SWORD W_PA 1 100 -327.6800 327.6700 FORMAT "%8.4" ECU_ADDRESS 0xC000C1CA /end MEASUREMENT
/begin MEASUREMENT IVActr_wActrNomCor_mp02 "Temperaturkorrigierter nominaler Aktorenergieverbrauch" SWORD W_PA 1 100 -327.6800 327.6700 FORMAT "%8.4" ECU_ADDRESS 0xC000C1CC /end MEASUREMENT
/begin MEASUREMENT IVActr_wActrNomCor_mp03 "Temperaturkorrigierter nominaler Aktorenergieverbrauch" SWORD W_PA 1 100 -327.6800 327.6700 FORMAT "%8.4" ECU_ADDRESS 0xC000C1CE /end MEASUREMENT
/begin MEASUREMENT IVActr_wActrNomCor_mp04 "Temperaturkorrigierter nominaler Aktorenergieverbrauch" SWORD W_PA 1 100 -327.6800 327.6700 FORMAT "%8.4" ECU_ADDRESS 0xC000C1D0 /end MEASUREMENT
/begin MEASUREMENT IVActr_wActrNomCor_mp05 "Temperaturkorrigierter nominaler Aktorenergieverbrauch" SWORD W_PA 1 100 -327.6800 327.6700 FORMAT "%8.4" ECU_ADDRESS 0xC000C1D2 /end MEASUREMENT
/begin MEASUREMENT IVActr_wActrNom_mp00 "Nominaler Aktorenergieverbrauch" SWORD W_PA 1 100 -327.6800 327.6700 FORMAT "%8.4" ECU_ADDRESS 0xC000C1D4 /end MEASUREMENT
/begin MEASUREMENT IVActr_wActrNom_mp01 "Nominaler Aktorenergieverbrauch" SWORD W_PA 1 100 -327.6800 327.6700 FORMAT "%8.4" ECU_ADDRESS 0xC000C1D6 /end MEASUREMENT
/begin MEASUREMENT IVActr_wActrNom_mp02 "Nominaler Aktorenergieverbrauch" SWORD W_PA 1 100 -327.6800 327.6700 FORMAT "%8.4" ECU_ADDRESS 0xC000C1D8 /end MEASUREMENT
/begin MEASUREMENT IVActr_wActrNom_mp03 "Nominaler Aktorenergieverbrauch" SWORD W_PA 1 100 -327.6800 327.6700 FORMAT "%8.4" ECU_ADDRESS 0xC000C1DA /end MEASUREMENT
/begin MEASUREMENT IVActr_wActrNom_mp04 "Nominaler Aktorenergieverbrauch" SWORD W_PA 1 100 -327.6800 327.6700 FORMAT "%8.4" ECU_ADDRESS 0xC000C1DC /end MEASUREMENT
/begin MEASUREMENT IVActr_wActrNom_mp05 "Nominaler Aktorenergieverbrauch" SWORD W_PA 1 100 -327.6800 327.6700 FORMAT "%8.4" ECU_ADDRESS 0xC000C1DE /end MEASUREMENT
/begin MEASUREMENT IVActr_wChActrRaw_mp00 "Rohwert der Aktorladeenergie" SWORD W_PA 1 100 -327.6800 327.6700 FORMAT "%8.4" ECU_ADDRESS 0xC000C1E0 /end MEASUREMENT
/begin MEASUREMENT IVActr_wChActrRaw_mp01 "Rohwert der Aktorladeenergie" SWORD W_PA 1 100 -327.6800 327.6700 FORMAT "%8.4" ECU_ADDRESS 0xC000C1E2 /end MEASUREMENT
/begin MEASUREMENT IVActr_wChActrRaw_mp02 "Rohwert der Aktorladeenergie" SWORD W_PA 1 100 -327.6800 327.6700 FORMAT "%8.4" ECU_ADDRESS 0xC000C1E4 /end MEASUREMENT
/begin MEASUREMENT IVActr_wChActrRaw_mp03 "Rohwert der Aktorladeenergie" SWORD W_PA 1 100 -327.6800 327.6700 FORMAT "%8.4" ECU_ADDRESS 0xC000C1E6 /end MEASUREMENT
/begin MEASUREMENT IVActr_wChActrRaw_mp04 "Rohwert der Aktorladeenergie" SWORD W_PA 1 100 -327.6800 327.6700 FORMAT "%8.4" ECU_ADDRESS 0xC000C1E8 /end MEASUREMENT
/begin MEASUREMENT IVActr_wChActrRaw_mp05 "Rohwert der Aktorladeenergie" SWORD W_PA 1 100 -327.6800 327.6700 FORMAT "%8.4" ECU_ADDRESS 0xC000C1EA /end MEASUREMENT
/begin MEASUREMENT IVActr_wDisChActrRaw_mp00 "Rohwert der Aktorentladeenergie" SWORD W_PA 1 100 -327.6800 327.6700 FORMAT "%8.4" ECU_ADDRESS 0xC000C1EC /end MEASUREMENT
/begin MEASUREMENT IVActr_wDisChActrRaw_mp01 "Rohwert der Aktorentladeenergie" SWORD W_PA 1 100 -327.6800 327.6700 FORMAT "%8.4" ECU_ADDRESS 0xC000C1EE /end MEASUREMENT
/begin MEASUREMENT IVActr_wDisChActrRaw_mp02 "Rohwert der Aktorentladeenergie" SWORD W_PA 1 100 -327.6800 327.6700 FORMAT "%8.4" ECU_ADDRESS 0xC000C1F0 /end MEASUREMENT
/begin MEASUREMENT IVActr_wDisChActrRaw_mp03 "Rohwert der Aktorentladeenergie" SWORD W_PA 1 100 -327.6800 327.6700 FORMAT "%8.4" ECU_ADDRESS 0xC000C1F2 /end MEASUREMENT
/begin MEASUREMENT IVActr_wDisChActrRaw_mp04 "Rohwert der Aktorentladeenergie" SWORD W_PA 1 100 -327.6800 327.6700 FORMAT "%8.4" ECU_ADDRESS 0xC000C1F4 /end MEASUREMENT
/begin MEASUREMENT IVActr_wDisChActrRaw_mp05 "Rohwert der Aktorentladeenergie" SWORD W_PA 1 100 -327.6800 327.6700 FORMAT "%8.4" ECU_ADDRESS 0xC000C1F6 /end MEASUREMENT
/begin MEASUREMENT IVAdj_clsIVA00 "InjektorSpannungsAbgeich-Klasse des Piezo-Aktors" UBYTE OneToOne 1 100 0.00 255.0 ECU_ADDRESS 0xD0001EB7 /end MEASUREMENT
/begin MEASUREMENT IVAdj_clsIVA01 "InjektorSpannungsAbgeich-Klasse des Piezo-Aktors" UBYTE OneToOne 1 100 0.00 255.0 ECU_ADDRESS 0xD0001EB8 /end MEASUREMENT
/begin MEASUREMENT IVAdj_clsIVA02 "InjektorSpannungsAbgeich-Klasse des Piezo-Aktors" UBYTE OneToOne 1 100 0.00 255.0 ECU_ADDRESS 0xD0001EB9 /end MEASUREMENT
/begin MEASUREMENT IVAdj_clsIVA03 "InjektorSpannungsAbgeich-Klasse des Piezo-Aktors" UBYTE OneToOne 1 100 0.00 255.0 ECU_ADDRESS 0xD0001EBA /end MEASUREMENT
/begin MEASUREMENT IVAdj_clsIVA04 "InjektorSpannungsAbgeich-Klasse des Piezo-Aktors" UBYTE OneToOne 1 100 0.00 255.0 ECU_ADDRESS 0xD0001EBB /end MEASUREMENT
/begin MEASUREMENT IVAdj_clsIVA05 "InjektorSpannungsAbgeich-Klasse des Piezo-Aktors" UBYTE OneToOne 1 100 0.00 255.0 ECU_ADDRESS 0xD0001EBC /end MEASUREMENT
/begin MEASUREMENT IVAdj_ctNVCEna_mp00 "Wert des NVC-Freigabezählers" UWORD OneToOne 1 100 0.00 65535.00 ECU_ADDRESS 0xC000C1F8 /end MEASUREMENT
/begin MEASUREMENT IVAdj_ctNVCEna_mp01 "Wert des NVC-Freigabezählers" UWORD OneToOne 1 100 0.00 65535.00 ECU_ADDRESS 0xC000C1FA /end MEASUREMENT
/begin MEASUREMENT IVAdj_ctNVCEna_mp02 "Wert des NVC-Freigabezählers" UWORD OneToOne 1 100 0.00 65535.00 ECU_ADDRESS 0xC000C1FC /end MEASUREMENT
/begin MEASUREMENT IVAdj_ctNVCEna_mp03 "Wert des NVC-Freigabezählers" UWORD OneToOne 1 100 0.00 65535.00 ECU_ADDRESS 0xC000C1FE /end MEASUREMENT
/begin MEASUREMENT IVAdj_ctNVCEna_mp04 "Wert des NVC-Freigabezählers" UWORD OneToOne 1 100 0.00 65535.00 ECU_ADDRESS 0xC000C200 /end MEASUREMENT
/begin MEASUREMENT IVAdj_ctNVCEna_mp05 "Wert des NVC-Freigabezählers" UWORD OneToOne 1 100 0.00 65535.00 ECU_ADDRESS 0xC000C202 /end MEASUREMENT
/begin MEASUREMENT IVAdj_facNVC00 "NVC Korrekturfaktor" SWORD Fact 1 100 -4.000000 3.999878 ECU_ADDRESS 0xD0000C30 /end MEASUREMENT
/begin MEASUREMENT IVAdj_facNVC01 "NVC Korrekturfaktor" SWORD Fact 1 100 -4.000000 3.999878 ECU_ADDRESS 0xD0000C32 /end MEASUREMENT
/begin MEASUREMENT IVAdj_facNVC02 "NVC Korrekturfaktor" SWORD Fact 1 100 -4.000000 3.999878 ECU_ADDRESS 0xD0000C34 /end MEASUREMENT
/begin MEASUREMENT IVAdj_facNVC03 "NVC Korrekturfaktor" SWORD Fact 1 100 -4.000000 3.999878 ECU_ADDRESS 0xD0000C36 /end MEASUREMENT
/begin MEASUREMENT IVAdj_facNVC04 "NVC Korrekturfaktor" SWORD Fact 1 100 -4.000000 3.999878 ECU_ADDRESS 0xD0000C38 /end MEASUREMENT
/begin MEASUREMENT IVAdj_facNVC05 "NVC Korrekturfaktor" SWORD Fact 1 100 -4.000000 3.999878 ECU_ADDRESS 0xD0000C3A /end MEASUREMENT
/begin MEASUREMENT IVAdj_facNVCEepWrI_mp00 "Im EEPROM gespeicherter Wert des NVC-I-Reglers" SWORD Fact 1 100 -4.000000 3.999878 ECU_ADDRESS 0xC000C204 /end MEASUREMENT
/begin MEASUREMENT IVAdj_facNVCEepWrI_mp01 "Im EEPROM gespeicherter Wert des NVC-I-Reglers" SWORD Fact 1 100 -4.000000 3.999878 ECU_ADDRESS 0xC000C206 /end MEASUREMENT
/begin MEASUREMENT IVAdj_facNVCEepWrI_mp02 "Im EEPROM gespeicherter Wert des NVC-I-Reglers" SWORD Fact 1 100 -4.000000 3.999878 ECU_ADDRESS 0xC000C208 /end MEASUREMENT
/begin MEASUREMENT IVAdj_facNVCEepWrI_mp03 "Im EEPROM gespeicherter Wert des NVC-I-Reglers" SWORD Fact 1 100 -4.000000 3.999878 ECU_ADDRESS 0xC000C20A /end MEASUREMENT
/begin MEASUREMENT IVAdj_facNVCEepWrI_mp04 "Im EEPROM gespeicherter Wert des NVC-I-Reglers" SWORD Fact 1 100 -4.000000 3.999878 ECU_ADDRESS 0xC000C20C /end MEASUREMENT
/begin MEASUREMENT IVAdj_facNVCEepWrI_mp05 "Im EEPROM gespeicherter Wert des NVC-I-Reglers" SWORD Fact 1 100 -4.000000 3.999878 ECU_ADDRESS 0xC000C20E /end MEASUREMENT
/begin MEASUREMENT IVAdj_facNVCInitI_mp00 "Initialisierungswert des NVC-I-Reglers" SWORD Fact 1 100 -4.000000 3.999878 ECU_ADDRESS 0xC000C210 /end MEASUREMENT
/begin MEASUREMENT IVAdj_facNVCInitI_mp01 "Initialisierungswert des NVC-I-Reglers" SWORD Fact 1 100 -4.000000 3.999878 ECU_ADDRESS 0xC000C212 /end MEASUREMENT
/begin MEASUREMENT IVAdj_facNVCInitI_mp02 "Initialisierungswert des NVC-I-Reglers" SWORD Fact 1 100 -4.000000 3.999878 ECU_ADDRESS 0xC000C214 /end MEASUREMENT
/begin MEASUREMENT IVAdj_facNVCInitI_mp03 "Initialisierungswert des NVC-I-Reglers" SWORD Fact 1 100 -4.000000 3.999878 ECU_ADDRESS 0xC000C216 /end MEASUREMENT
/begin MEASUREMENT IVAdj_facNVCInitI_mp04 "Initialisierungswert des NVC-I-Reglers" SWORD Fact 1 100 -4.000000 3.999878 ECU_ADDRESS 0xC000C218 /end MEASUREMENT
/begin MEASUREMENT IVAdj_facNVCInitI_mp05 "Initialisierungswert des NVC-I-Reglers" SWORD Fact 1 100 -4.000000 3.999878 ECU_ADDRESS 0xC000C21A /end MEASUREMENT
/begin MEASUREMENT IVAdj_stIVAErr00 "ISA Fehlerstatus" UBYTE OneToOne 1 100 0.00 255.0 ECU_ADDRESS 0xD0001EBD /end MEASUREMENT
/begin MEASUREMENT IVAdj_stIVAErr01 "ISA Fehlerstatus" UBYTE OneToOne 1 100 0.00 255.0 ECU_ADDRESS 0xD0001EBE /end MEASUREMENT
/begin MEASUREMENT IVAdj_stIVAErr02 "ISA Fehlerstatus" UBYTE OneToOne 1 100 0.00 255.0 ECU_ADDRESS 0xD0001EBF /end MEASUREMENT
/begin MEASUREMENT IVAdj_stIVAErr03 "ISA Fehlerstatus" UBYTE OneToOne 1 100 0.00 255.0 ECU_ADDRESS 0xD0001EC0 /end MEASUREMENT
/begin MEASUREMENT IVAdj_tiNVCGovCalc00 "Systemzeit der letzten NVC Berechnung" ULONG Time_PzoMeas 1 100 0.00 234505214.307 FORMAT "%13.3" ECU_ADDRESS 0xD00031A4 /end MEASUREMENT
/begin MEASUREMENT IVAdj_tiNVCGovCalc01 "Systemzeit der letzten NVC Berechnung" ULONG Time_PzoMeas 1 100 0.00 234505214.307 FORMAT "%13.3" ECU_ADDRESS 0xD00031A8 /end MEASUREMENT
/begin MEASUREMENT IVAdj_tiNVCGovCalc02 "Systemzeit der letzten NVC Berechnung" ULONG Time_PzoMeas 1 100 0.00 234505214.307 FORMAT "%13.3" ECU_ADDRESS 0xD00031AC /end MEASUREMENT
/begin MEASUREMENT IVAdj_tiNVCGovCalc03 "Systemzeit der letzten NVC Berechnung" ULONG Time_PzoMeas 1 100 0.00 234505214.307 FORMAT "%13.3" ECU_ADDRESS 0xD00031B0 /end MEASUREMENT
/begin MEASUREMENT IVAdj_tiNVCGovCalc04 "Systemzeit der letzten NVC Berechnung" ULONG Time_PzoMeas 1 100 0.00 234505214.307 FORMAT "%13.3" ECU_ADDRESS 0xD00031B4 /end MEASUREMENT
/begin MEASUREMENT IVAdj_tiNVCGovCalc05 "Systemzeit der letzten NVC Berechnung" ULONG Time_PzoMeas 1 100 0.00 234505214.307 FORMAT "%13.3" ECU_ADDRESS 0xD00031B8 /end MEASUREMENT
/begin MEASUREMENT IVAdj_uDiffNVCInPI_mp00 "NVC-Reglereingangswert" SWORD Vltg_PA 1 100 -327.6800 327.6700 ECU_ADDRESS 0xC000C21C /end MEASUREMENT
/begin MEASUREMENT IVAdj_uDiffNVCInPI_mp01 "NVC-Reglereingangswert" SWORD Vltg_PA 1 100 -327.6800 327.6700 ECU_ADDRESS 0xC000C21E /end MEASUREMENT
/begin MEASUREMENT IVAdj_uDiffNVCInPI_mp02 "NVC-Reglereingangswert" SWORD Vltg_PA 1 100 -327.6800 327.6700 ECU_ADDRESS 0xC000C220 /end MEASUREMENT
/begin MEASUREMENT IVAdj_uDiffNVCInPI_mp03 "NVC-Reglereingangswert" SWORD Vltg_PA 1 100 -327.6800 327.6700 ECU_ADDRESS 0xC000C222 /end MEASUREMENT
/begin MEASUREMENT IVAdj_uDiffNVCInPI_mp04 "NVC-Reglereingangswert" SWORD Vltg_PA 1 100 -327.6800 327.6700 ECU_ADDRESS 0xC000C224 /end MEASUREMENT
/begin MEASUREMENT IVAdj_uDiffNVCInPI_mp05 "NVC-Reglereingangswert" SWORD Vltg_PA 1 100 -327.6800 327.6700 ECU_ADDRESS 0xC000C226 /end MEASUREMENT
/begin MEASUREMENT IVAdj_uDiffNVCSet_mp00 "aktueller Wert aus der Spannungsdifferenzreferenzkurve" SWORD Vltg_PA 1 100 -327.6800 327.6700 ECU_ADDRESS 0xC000C228 /end MEASUREMENT
/begin MEASUREMENT IVAdj_uDiffNVCSet_mp01 "aktueller Wert aus der Spannungsdifferenzreferenzkurve" SWORD Vltg_PA 1 100 -327.6800 327.6700 ECU_ADDRESS 0xC000C22A /end MEASUREMENT
/begin MEASUREMENT IVAdj_uDiffNVCSet_mp02 "aktueller Wert aus der Spannungsdifferenzreferenzkurve" SWORD Vltg_PA 1 100 -327.6800 327.6700 ECU_ADDRESS 0xC000C22C /end MEASUREMENT
/begin MEASUREMENT IVAdj_uDiffNVCSet_mp03 "aktueller Wert aus der Spannungsdifferenzreferenzkurve" SWORD Vltg_PA 1 100 -327.6800 327.6700 ECU_ADDRESS 0xC000C22E /end MEASUREMENT
/begin MEASUREMENT IVAdj_uDiffNVCSet_mp04 "aktueller Wert aus der Spannungsdifferenzreferenzkurve" SWORD Vltg_PA 1 100 -327.6800 327.6700 ECU_ADDRESS 0xC000C230 /end MEASUREMENT
/begin MEASUREMENT IVAdj_uDiffNVCSet_mp05 "aktueller Wert aus der Spannungsdifferenzreferenzkurve" SWORD Vltg_PA 1 100 -327.6800 327.6700 ECU_ADDRESS 0xC000C232 /end MEASUREMENT
/begin MEASUREMENT IVAdj_uDiffNVC_mp00 "Istwert der NVC-Regelgröße (Differenz aus Aktorladesspannung und Aktorspannung)" SWORD Vltg_PA 1 100 -327.6800 327.6700 ECU_ADDRESS 0xC000C234 /end MEASUREMENT
/begin MEASUREMENT IVAdj_uDiffNVC_mp01 "Istwert der NVC-Regelgröße (Differenz aus Aktorladesspannung und Aktorspannung)" SWORD Vltg_PA 1 100 -327.6800 327.6700 ECU_ADDRESS 0xC000C236 /end MEASUREMENT
/begin MEASUREMENT IVAdj_uDiffNVC_mp02 "Istwert der NVC-Regelgröße (Differenz aus Aktorladesspannung und Aktorspannung)" SWORD Vltg_PA 1 100 -327.6800 327.6700 ECU_ADDRESS 0xC000C238 /end MEASUREMENT
/begin MEASUREMENT IVAdj_uDiffNVC_mp03 "Istwert der NVC-Regelgröße (Differenz aus Aktorladesspannung und Aktorspannung)" SWORD Vltg_PA 1 100 -327.6800 327.6700 ECU_ADDRESS 0xC000C23A /end MEASUREMENT
/begin MEASUREMENT IVAdj_uDiffNVC_mp04 "Istwert der NVC-Regelgröße (Differenz aus Aktorladesspannung und Aktorspannung)" SWORD Vltg_PA 1 100 -327.6800 327.6700 ECU_ADDRESS 0xC000C23C /end MEASUREMENT
/begin MEASUREMENT IVAdj_uDiffNVC_mp05 "Istwert der NVC-Regelgröße (Differenz aus Aktorladesspannung und Aktorspannung)" SWORD Vltg_PA 1 100 -327.6800 327.6700 ECU_ADDRESS 0xC000C23E /end MEASUREMENT
/begin MEASUREMENT IVAdj_valDestPtr_mp00 "Wert des Ziel-Pointers (gelesener EEPROM-Wert) (Funktionsparameter von IVAdj_NVCGovInit)" UWORD OneToOne 1 100 0.00 65535.00 ECU_ADDRESS 0xC000C240 /end MEASUREMENT
/begin MEASUREMENT IVAdj_valDestPtr_mp01 "Wert des Ziel-Pointers (gelesener EEPROM-Wert) (Funktionsparameter von IVAdj_NVCGovInit)" UWORD OneToOne 1 100 0.00 65535.00 ECU_ADDRESS 0xC000C242 /end MEASUREMENT
/begin MEASUREMENT IVAdj_valDestPtr_mp02 "Wert des Ziel-Pointers (gelesener EEPROM-Wert) (Funktionsparameter von IVAdj_NVCGovInit)" UWORD OneToOne 1 100 0.00 65535.00 ECU_ADDRESS 0xC000C244 /end MEASUREMENT
/begin MEASUREMENT IVAdj_valDestPtr_mp03 "Wert des Ziel-Pointers (gelesener EEPROM-Wert) (Funktionsparameter von IVAdj_NVCGovInit)" UWORD OneToOne 1 100 0.00 65535.00 ECU_ADDRESS 0xC000C246 /end MEASUREMENT
/begin MEASUREMENT IVAdj_valDestPtr_mp04 "Wert des Ziel-Pointers (gelesener EEPROM-Wert) (Funktionsparameter von IVAdj_NVCGovInit)" UWORD OneToOne 1 100 0.00 65535.00 ECU_ADDRESS 0xC000C248 /end MEASUREMENT
/begin MEASUREMENT IVAdj_valDestPtr_mp05 "Wert des Ziel-Pointers (gelesener EEPROM-Wert) (Funktionsparameter von IVAdj_NVCGovInit)" UWORD OneToOne 1 100 0.00 65535.00 ECU_ADDRESS 0xC000C24A /end MEASUREMENT
/begin MEASUREMENT IVCtl_iChrg00 "Ladestrom-Grenze" SWORD Curr 1 100 0.00 20000.00 FORMAT "%8.2" ECU_ADDRESS 0xD0000C3E /end MEASUREMENT
/begin MEASUREMENT IVCtl_iChrg01 "Ladestrom-Grenze" SWORD Curr 1 100 0.00 20000.00 FORMAT "%8.2" ECU_ADDRESS 0xD0000C40 /end MEASUREMENT
/begin MEASUREMENT IVCtl_iChrg02 "Ladestrom-Grenze" SWORD Curr 1 100 0.00 20000.00 FORMAT "%8.2" ECU_ADDRESS 0xD0000C42 /end MEASUREMENT
/begin MEASUREMENT IVCtl_iChrg03 "Ladestrom-Grenze" SWORD Curr 1 100 0.00 20000.00 FORMAT "%8.2" ECU_ADDRESS 0xD0000C44 /end MEASUREMENT
/begin MEASUREMENT IVCtl_iChrg04 "Ladestrom-Grenze" SWORD Curr 1 100 0.00 20000.00 FORMAT "%8.2" ECU_ADDRESS 0xD0000C46 /end MEASUREMENT
/begin MEASUREMENT IVCtl_iChrg05 "Ladestrom-Grenze" SWORD Curr 1 100 0.00 20000.00 FORMAT "%8.2" ECU_ADDRESS 0xD0000C48 /end MEASUREMENT
/begin MEASUREMENT IVCtl_iCorPI00 "Ausgang des Entladezeitreglers" SWORD Curr 1 100 -10000.00 10000.00 FORMAT "%8.2" ECU_ADDRESS 0xD0000C4A /end MEASUREMENT
/begin MEASUREMENT IVCtl_iCorPI01 "Ausgang des Entladezeitreglers" SWORD Curr 1 100 -10000.00 10000.00 FORMAT "%8.2" ECU_ADDRESS 0xD0000C4C /end MEASUREMENT
/begin MEASUREMENT IVCtl_iCorPI02 "Ausgang des Entladezeitreglers" SWORD Curr 1 100 -10000.00 10000.00 FORMAT "%8.2" ECU_ADDRESS 0xD0000C4E /end MEASUREMENT
/begin MEASUREMENT IVCtl_iCorPI03 "Ausgang des Entladezeitreglers" SWORD Curr 1 100 -10000.00 10000.00 FORMAT "%8.2" ECU_ADDRESS 0xD0000C50 /end MEASUREMENT
/begin MEASUREMENT IVCtl_iCorPI04 "Ausgang des Entladezeitreglers" SWORD Curr 1 100 -10000.00 10000.00 FORMAT "%8.2" ECU_ADDRESS 0xD0000C52 /end MEASUREMENT
/begin MEASUREMENT IVCtl_iCorPI05 "Ausgang des Entladezeitreglers" SWORD Curr 1 100 -10000.00 10000.00 FORMAT "%8.2" ECU_ADDRESS 0xD0000C54 /end MEASUREMENT
/begin MEASUREMENT IVCtl_iCorPIUnLim_mp00 "Unbegrenzter Reglerausgang des PI-Reglers der Entladezeitregelung" SWORD Curr 1 100 -32768.00 32767.00 FORMAT "%8.2" ECU_ADDRESS 0xC000C24C /end MEASUREMENT
/begin MEASUREMENT IVCtl_iCorPIUnLim_mp01 "Unbegrenzter Reglerausgang des PI-Reglers der Entladezeitregelung" SWORD Curr 1 100 -32768.00 32767.00 FORMAT "%8.2" ECU_ADDRESS 0xC000C24E /end MEASUREMENT
/begin MEASUREMENT IVCtl_iCorPIUnLim_mp02 "Unbegrenzter Reglerausgang des PI-Reglers der Entladezeitregelung" SWORD Curr 1 100 -32768.00 32767.00 FORMAT "%8.2" ECU_ADDRESS 0xC000C250 /end MEASUREMENT
/begin MEASUREMENT IVCtl_iCorPIUnLim_mp03 "Unbegrenzter Reglerausgang des PI-Reglers der Entladezeitregelung" SWORD Curr 1 100 -32768.00 32767.00 FORMAT "%8.2" ECU_ADDRESS 0xC000C252 /end MEASUREMENT
/begin MEASUREMENT IVCtl_iCorPIUnLim_mp04 "Unbegrenzter Reglerausgang des PI-Reglers der Entladezeitregelung" SWORD Curr 1 100 -32768.00 32767.00 FORMAT "%8.2" ECU_ADDRESS 0xC000C254 /end MEASUREMENT
/begin MEASUREMENT IVCtl_iCorPIUnLim_mp05 "Unbegrenzter Reglerausgang des PI-Reglers der Entladezeitregelung" SWORD Curr 1 100 -32768.00 32767.00 FORMAT "%8.2" ECU_ADDRESS 0xC000C256 /end MEASUREMENT
/begin MEASUREMENT IVCtl_iDisCh00 "Entladestrom" SWORD Curr 1 100 -30000.00 30000.00 FORMAT "%8.2" ECU_ADDRESS 0xD0000C56 /end MEASUREMENT
/begin MEASUREMENT IVCtl_iDisCh01 "Entladestrom" SWORD Curr 1 100 -30000.00 30000.00 FORMAT "%8.2" ECU_ADDRESS 0xD0000C58 /end MEASUREMENT
/begin MEASUREMENT IVCtl_iDisCh02 "Entladestrom" SWORD Curr 1 100 -30000.00 30000.00 FORMAT "%8.2" ECU_ADDRESS 0xD0000C5A /end MEASUREMENT
/begin MEASUREMENT IVCtl_iDisCh03 "Entladestrom" SWORD Curr 1 100 -30000.00 30000.00 FORMAT "%8.2" ECU_ADDRESS 0xD0000C5C /end MEASUREMENT
/begin MEASUREMENT IVCtl_iDisCh04 "Entladestrom" SWORD Curr 1 100 -30000.00 30000.00 FORMAT "%8.2" ECU_ADDRESS 0xD0000C5E /end MEASUREMENT
/begin MEASUREMENT IVCtl_iDisCh05 "Entladestrom" SWORD Curr 1 100 -30000.00 30000.00 FORMAT "%8.2" ECU_ADDRESS 0xD0000C60 /end MEASUREMENT
/begin MEASUREMENT IVCtl_iDisChUnCor_mp00 "Unkorrigierter Entladestrom" SWORD Curr 1 100 -30000.00 30000.00 FORMAT "%8.2" ECU_ADDRESS 0xC000C258 /end MEASUREMENT
/begin MEASUREMENT IVCtl_iDisChUnCor_mp01 "Unkorrigierter Entladestrom" SWORD Curr 1 100 -30000.00 30000.00 FORMAT "%8.2" ECU_ADDRESS 0xC000C25A /end MEASUREMENT
/begin MEASUREMENT IVCtl_iDisChUnCor_mp02 "Unkorrigierter Entladestrom" SWORD Curr 1 100 -30000.00 30000.00 FORMAT "%8.2" ECU_ADDRESS 0xC000C25C /end MEASUREMENT
/begin MEASUREMENT IVCtl_iDisChUnCor_mp03 "Unkorrigierter Entladestrom" SWORD Curr 1 100 -30000.00 30000.00 FORMAT "%8.2" ECU_ADDRESS 0xC000C25E /end MEASUREMENT
/begin MEASUREMENT IVCtl_iDisChUnCor_mp04 "Unkorrigierter Entladestrom" SWORD Curr 1 100 -30000.00 30000.00 FORMAT "%8.2" ECU_ADDRESS 0xC000C260 /end MEASUREMENT
/begin MEASUREMENT IVCtl_iDisChUnCor_mp05 "Unkorrigierter Entladestrom" SWORD Curr 1 100 -30000.00 30000.00 FORMAT "%8.2" ECU_ADDRESS 0xC000C262 /end MEASUREMENT
/begin MEASUREMENT IVCtl_stOBDErr00 "OBD Fehlerstatus der Up-Spannung" UBYTE OneToOne 1 100 0.00 255.0 ECU_ADDRESS 0xD0001EC2 /end MEASUREMENT
/begin MEASUREMENT IVCtl_stOBDErr01 "OBD Fehlerstatus der Up-Spannung" UBYTE OneToOne 1 100 0.00 255.0 ECU_ADDRESS 0xD0001EC3 /end MEASUREMENT
/begin MEASUREMENT IVCtl_tiDiff00 "Eingang des Entladezeitreglers" SWORD InjTime_us 1 100 -13107.20 5000.00 ECU_ADDRESS 0xD0000C66 /end MEASUREMENT
/begin MEASUREMENT IVCtl_tiDiff01 "Eingang des Entladezeitreglers" SWORD InjTime_us 1 100 -13107.20 5000.00 ECU_ADDRESS 0xD0000C68 /end MEASUREMENT
/begin MEASUREMENT IVCtl_tiDiff02 "Eingang des Entladezeitreglers" SWORD InjTime_us 1 100 -13107.20 5000.00 ECU_ADDRESS 0xD0000C6A /end MEASUREMENT
/begin MEASUREMENT IVCtl_tiDiff03 "Eingang des Entladezeitreglers" SWORD InjTime_us 1 100 -13107.20 5000.00 ECU_ADDRESS 0xD0000C6C /end MEASUREMENT
/begin MEASUREMENT IVCtl_tiDiff04 "Eingang des Entladezeitreglers" SWORD InjTime_us 1 100 -13107.20 5000.00 ECU_ADDRESS 0xD0000C6E /end MEASUREMENT
/begin MEASUREMENT IVCtl_tiDiff05 "Eingang des Entladezeitreglers" SWORD InjTime_us 1 100 -13107.20 5000.00 ECU_ADDRESS 0xD0000C70 /end MEASUREMENT
/begin MEASUREMENT IVCtl_tiTGovCalc00 "Zeitstempel: Letzte Berechnung des Entladezeitreglers" ULONG Time_PzoMeas 1 100 0.00 234505214.307 FORMAT "%13.3" ECU_ADDRESS 0xD00031BC /end MEASUREMENT
/begin MEASUREMENT IVCtl_tiTGovCalc01 "Zeitstempel: Letzte Berechnung des Entladezeitreglers" ULONG Time_PzoMeas 1 100 0.00 234505214.307 FORMAT "%13.3" ECU_ADDRESS 0xD00031C0 /end MEASUREMENT
/begin MEASUREMENT IVCtl_tiTGovCalc02 "Zeitstempel: Letzte Berechnung des Entladezeitreglers" ULONG Time_PzoMeas 1 100 0.00 234505214.307 FORMAT "%13.3" ECU_ADDRESS 0xD00031C4 /end MEASUREMENT
/begin MEASUREMENT IVCtl_tiTGovCalc03 "Zeitstempel: Letzte Berechnung des Entladezeitreglers" ULONG Time_PzoMeas 1 100 0.00 234505214.307 FORMAT "%13.3" ECU_ADDRESS 0xD00031C8 /end MEASUREMENT
/begin MEASUREMENT IVCtl_tiTGovCalc04 "Zeitstempel: Letzte Berechnung des Entladezeitreglers" ULONG Time_PzoMeas 1 100 0.00 234505214.307 FORMAT "%13.3" ECU_ADDRESS 0xD00031CC /end MEASUREMENT
/begin MEASUREMENT IVCtl_tiTGovCalc05 "Zeitstempel: Letzte Berechnung des Entladezeitreglers" ULONG Time_PzoMeas 1 100 0.00 234505214.307 FORMAT "%13.3" ECU_ADDRESS 0xD00031D0 /end MEASUREMENT
/begin MEASUREMENT IVCtl_tiVltgGovCalc00 "Zeitstempel: Letzte Berechnung des Spannungsreglers" ULONG Time_PzoMeas 1 100 0.00 234505214.307 FORMAT "%13.3" ECU_ADDRESS 0xD00031D4 /end MEASUREMENT
/begin MEASUREMENT IVCtl_tiVltgGovCalc01 "Zeitstempel: Letzte Berechnung des Spannungsreglers" ULONG Time_PzoMeas 1 100 0.00 234505214.307 FORMAT "%13.3" ECU_ADDRESS 0xD00031D8 /end MEASUREMENT
/begin MEASUREMENT IVCtl_tiVltgGovCalc02 "Zeitstempel: Letzte Berechnung des Spannungsreglers" ULONG Time_PzoMeas 1 100 0.00 234505214.307 FORMAT "%13.3" ECU_ADDRESS 0xD00031DC /end MEASUREMENT
/begin MEASUREMENT IVCtl_tiVltgGovCalc03 "Zeitstempel: Letzte Berechnung des Spannungsreglers" ULONG Time_PzoMeas 1 100 0.00 234505214.307 FORMAT "%13.3" ECU_ADDRESS 0xD00031E0 /end MEASUREMENT
/begin COMPU_METHOD AngleCrS "" RAT_FUNC "%6.3" "deg CrS" COEFFS 0 45.5111111111 0 0 0 1 /end COMPU_METHOD
/begin COMPU_METHOD Charge_PA "" RAT_FUNC "%6.2" "uC" COEFFS 0 1 0 0 0 1 /end COMPU_METHOD
/begin COMPU_METHOD Curr "" RAT_FUNC "%6.2" "mA" COEFFS 0 1 0 0 0 1 /end COMPU_METHOD
/begin COMPU_METHOD Def_dez_ub_q1 "" RAT_FUNC "%3.1" "-" COEFFS 0 1 0 0 0 1 /end COMPU_METHOD
/begin COMPU_METHOD Def_dez_ul_q1 "" RAT_FUNC "%7.3" "-" COEFFS 0 1 0 0 0 1 /end COMPU_METHOD
/begin COMPU_METHOD Def_i_ub_q0p125 "" RAT_FUNC "%6.3" "A" COEFFS 0 8 0 0 0 1 /end COMPU_METHOD
/begin COMPU_METHOD Def_st_ub_q1 "" RAT_FUNC "%3.1" "-" COEFFS 0 1 0 0 0 1 /end COMPU_METHOD
/begin COMPU_METHOD Def_u_ub_q0p1 "" RAT_FUNC "%5.3" "V" COEFFS 0 10 0 0 0 1 /end COMPU_METHOD
/begin COMPU_METHOD Fact "" RAT_FUNC "%6.5" "-" COEFFS 0 8192 0 0 0 1 /end COMPU_METHOD
/begin COMPU_METHOD Fact1 "" RAT_FUNC "%6.4" "-" COEFFS 0 128 0 0 0 1 /end COMPU_METHOD
/begin COMPU_METHOD FBC_BPfac "" RAT_FUNC "%6.4" "-" COEFFS 0 546.116666666667 0 0 0 1 /end COMPU_METHOD
/begin COMPU_METHOD FBC_Dxs_s16 "" RAT_FUNC "%7.6" "%" COEFFS 0 41943.04 0 0 0 1 /end COMPU_METHOD
/begin COMPU_METHOD InjMass "" RAT_FUNC "%5.2" "mg/hub" COEFFS 0 100 0 0 0 1 /end COMPU_METHOD
/begin COMPU_METHOD InjMassInj "" RAT_FUNC "%5.2" "mg/inj" COEFFS 0 100 0 0 0 1 /end COMPU_METHOD
/begin COMPU_METHOD InjQntInj "" RAT_FUNC "%5.2" "mm^3/inj" COEFFS 0 100 0 0 0 1 /end COMPU_METHOD
/begin COMPU_METHOD InjTime_us "" RAT_FUNC "%5.1" "us" COEFFS 0 2.5 0 0 0 1 /end COMPU_METHOD
/begin COMPU_METHOD OneToOne "" RAT_FUNC "%6.0" "-" COEFFS 0 1 0 0 0 1 /end COMPU_METHOD
/begin COMPU_METHOD Per_Ratio "" RAT_FUNC "%6.4" "-" COEFFS 0 256 0 0 0 1 /end COMPU_METHOD
/begin COMPU_METHOD PHYSRNGCHK_SY_Compu "" TAB_VERB "%6.3" "" COMPU_TAB_REF PHYSRNGCHK_SY_Compu /end COMPU_METHOD
/begin COMPU_VTAB PHYSRNGCHK_SY_Compu "" TAB_VERB 2 0 "PHYSRNGCHK_DISBL" 1 "PHYSRNGCHK_ENA" /end COMPU_VTAB
/begin COMPU_METHOD PosMCKd "" RAT_FUNC "%8.7" "%/AgCA" COEFFS 0 144000.000000035 0 0 0 1 /end COMPU_METHOD
/begin COMPU_METHOD PosMCKd_4 "" RAT_FUNC "%7.6" "%/AgCA" COEFFS 0 36000.0000000088 0 0 0 1 /end COMPU_METHOD
/begin COMPU_METHOD PosMCKi "" RAT_FUNC "%6.5" "%/(AgCA*s)" COEFFS 0 4718.59200000115 0 0 0 1 /end COMPU_METHOD
/begin COMPU_METHOD PosMCKi_2 "" RAT_FUNC "%6.5" "%/(AgCA*s)" COEFFS 0 2359.29600000058 0 0 0 1 /end COMPU_METHOD
/begin COMPU_METHOD PosMCKp "" RAT_FUNC "%7.6" "%/AgCA" COEFFS 0 72000.0000000176 0 0 0 1 /end COMPU_METHOD
/begin COMPU_METHOD PosMCKp_32 "" RAT_FUNC "%6.5" "%/AgCA" COEFFS 0 2250.00000000055 0 0 0 1 /end COMPU_METHOD
/begin COMPU_METHOD POSTDRV_SOFTRST_SY_Compu "" TAB_VERB "%6.3" "" COMPU_TAB_REF POSTDRV_SOFTRST_SY_Compu /end COMPU_METHOD
/begin COMPU_VTAB POSTDRV_SOFTRST_SY_Compu "" TAB_VERB 2 0 "False" 0 "True" /end COMPU_VTAB
/begin COMPU_METHOD POSTDRV_T15RST_SY_Compu "" TAB_VERB "%6.3" "" COMPU_TAB_REF POSTDRV_T15RST_SY_Compu /end COMPU_METHOD
/begin COMPU_VTAB POSTDRV_T15RST_SY_Compu "" TAB_VERB 2 0 "False" 1 "True" /end COMPU_VTAB
/begin COMPU_METHOD Prc "" RAT_FUNC "%6.4" "%" COEFFS 0 81.92 0 0 0 1 /end COMPU_METHOD
/begin COMPU_METHOD PreshPa_FnReso "" RAT_FUNC "%6.3" "hPa" COEFFS 0 10 0 0 0 1 /end COMPU_METHOD
/begin COMPU_METHOD Pres_Rail "" RAT_FUNC "%5.1" "bar" COEFFS 0 10.000000 0 0 0 1 /end COMPU_METHOD
/begin COMPU_METHOD Pres_SI "" RAT_FUNC "%6.0" "Pa" COEFFS 0 0.01 0 0 0 1 /end COMPU_METHOD
/begin COMPU_METHOD PSC_Fact "" RAT_FUNC "%7.6" "-" COEFFS 0 32767 0 0 0 1 /end COMPU_METHOD
/begin COMPU_METHOD PSP_ATSINTVMOD_SY_Compu "" TAB_VERB "%6.3" "" COMPU_TAB_REF PSP_ATSINTVMOD_SY_Compu /end COMPU_METHOD
/begin COMPU_VTAB PSP_ATSINTVMOD_SY_Compu "" TAB_VERB 2 0 "False" 1 "True" /end COMPU_VTAB
/begin COMPU_METHOD Pwr_kW "" RAT_FUNC "%6.4" "kW" COEFFS 0 100 0 0 0 1 /end COMPU_METHOD
/begin COMPU_METHOD RatAshMass "" RAT_FUNC "%8.7" "-" COEFFS 0 100000 0 0 0 1 /end COMPU_METHOD
/begin COMPU_METHOD RatCOMass "" RAT_FUNC "%9.8" "-" COEFFS 0 1000000 0 0 0 1 /end COMPU_METHOD
/begin COMPU_METHOD RatSotMass "" RAT_FUNC "%8.7" "-" COEFFS 0 100000 0 0 0 1 /end COMPU_METHOD
/begin COMPU_METHOD RatSOxMass "" RAT_FUNC "%11.10" "-" COEFFS 0 100000000 0 0 0 1 /end COMPU_METHOD
/begin COMPU_METHOD RatVolCocn_Fl "" RAT_FUNC "%6.2" "mol/m^3" COEFFS 0 1 0 0 0 1 /end COMPU_METHOD
/begin COMPU_METHOD Rmp "" RAT_FUNC "%6.4" "1/s" COEFFS 0 65.536 0 0 0 1 /end COMPU_METHOD
/begin COMPU_METHOD SHTR_ATSINTVMOD_SY_Compu "" TAB_VERB "%6.3" "" COMPU_TAB_REF SHTR_ATSINTVMOD_SY_Compu /end COMPU_METHOD
/begin COMPU_VTAB SHTR_ATSINTVMOD_SY_Compu "" TAB_VERB 2 0 "False" 1 "True" /end COMPU_VTAB
/begin COMPU_METHOD Signals_OneToOne "" RAT_FUNC "%6.2" "" COEFFS 0 1 0 0 0 1 /end COMPU_METHOD
/begin COMPU_METHOD SOxMassPerTime "" RAT_FUNC "%7.6" "mg/s" COEFFS 0 10000 0 0 0 1 /end COMPU_METHOD
/begin COMPU_METHOD SpecHeat "" RAT_FUNC "%6.2" "J/Kg/K" COEFFS 0 0.5 0 0 0 1 /end COMPU_METHOD
/begin COMPU_METHOD SpecHeatFine "" RAT_FUNC "%6.3" "J/Kg/K" COEFFS 0 5 0 0 0 1 /end COMPU_METHOD
/begin COMPU_METHOD SqrVltg_s "" RAT_FUNC "%6.3" "V^2s" COEFFS 0 10 0 0 0 1 /end COMPU_METHOD
/begin COMPU_METHOD stroke_pml "" RAT_FUNC "%6.3" "1/ml" COEFFS 0 10 0 0 0 1 /end COMPU_METHOD
/begin COMPU_METHOD Time_PzoMeas "" RAT_FUNC "%6.4" "ms" COEFFS 0 18.3150183150183 0 0 0 1 /end COMPU_METHOD
/begin COMPU_METHOD Trq "" RAT_FUNC "%5.1" "Nm" COEFFS 0 10 0 0 0 1 /end COMPU_METHOD
/begin COMPU_METHOD Vltg_PA "" RAT_FUNC "%4.2" "V" COEFFS 0 100 0 0 0 1 /end COMPU_METHOD
/begin COMPU_METHOD W_PA "" RAT_FUNC "%6.4" "mWs" COEFFS 0 100 0 0 0 1 /end COMPU_METHOD
/end MODULE
/end PROJECT

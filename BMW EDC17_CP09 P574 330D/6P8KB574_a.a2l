ASAP2_VERSION 1 4
/begin PROJECT P_574 "EDC17_CP09"
/begin HEADER "" VERSION "V8KB" PROJECT_NO P_574 /end HEADER
/begin MODULE DIM ""
/begin MOD_COMMON "" BYTE_ORDER MSB_LAST ALIGNMENT_BYTE 1 ALIGNMENT_WORD 2 ALIGNMENT_LONG 4 ALIGNMENT_FLOAT32_IEEE 4 /end MOD_COMMON
/begin CHARACTERISTIC AccPed_trqDes_Bypass.Vector "Bypass Label (verwendet von ASCET), nicht editieren!/Bypass Table Vector Element (verwendet von ASCET), nicht editieren!" VALUE 0x80020A10 Val_Wu8 255.0 OneToOne 0.00 255.0 /end CHARACTERISTIC
/begin CHARACTERISTIC AccPed_trqDes_Bypass.Channel "Bypass Label (verwendet von ASCET), nicht editieren!/Bypass Table Channel Element(verwendet von ASCET), nicht editieren!" VALUE 0x80020A11 Val_Wu8 255.0 OneToOne 0.00 255.0 /end CHARACTERISTIC
/begin CHARACTERISTIC AccPed_trqLead_Bypass.Vector "Bypass Label (verwendet von ASCET), nicht editieren!/Bypass Table Vector Element (verwendet von ASCET), nicht editieren!" VALUE 0x80020A12 Val_Wu8 255.0 OneToOne 0.00 255.0 /end CHARACTERISTIC
/begin CHARACTERISTIC AccPed_trqLead_Bypass.Channel "Bypass Label (verwendet von ASCET), nicht editieren!/Bypass Table Channel Element(verwendet von ASCET), nicht editieren!" VALUE 0x80020A13 Val_Wu8 255.0 OneToOne 0.00 255.0 /end CHARACTERISTIC
/begin CHARACTERISTIC AGSDem_nSetPHi_Bypass.Vector "/Bypass Table Vector Element (verwendet von ASCET), nicht editieren!" VALUE 0x80020A14 Val_Wu8 255.0 OneToOne 0.00 255.0 /end CHARACTERISTIC
/begin CHARACTERISTIC AGSDem_nSetPHi_Bypass.Channel "/Bypass Table Channel Element(verwendet von ASCET), nicht editieren!" VALUE 0x80020A15 Val_Wu8 255.0 OneToOne 0.00 255.0 /end CHARACTERISTIC
/begin CHARACTERISTIC AGSDem_nSetPLo_Bypass.Vector "/Bypass Table Vector Element (verwendet von ASCET), nicht editieren!" VALUE 0x80020A16 Val_Wu8 255.0 OneToOne 0.00 255.0 /end CHARACTERISTIC
/begin CHARACTERISTIC AGSDem_nSetPLo_Bypass.Channel "/Bypass Table Channel Element(verwendet von ASCET), nicht editieren!" VALUE 0x80020A17 Val_Wu8 255.0 OneToOne 0.00 255.0 /end CHARACTERISTIC
/begin CHARACTERISTIC AirCtl_mDesBas_Bypass.Vector "Bypass Label (verwendet von ASCET), nicht editieren!/Bypass Table Vector Element (verwendet von ASCET), nicht editieren!" VALUE 0x80020A18 Val_Wu8 255.0 OneToOne 0.00 255.0 /end CHARACTERISTIC
/begin CHARACTERISTIC AirCtl_mDesBas_Bypass.Channel "Bypass Label (verwendet von ASCET), nicht editieren!/Bypass Table Channel Element(verwendet von ASCET), nicht editieren!" VALUE 0x80020A19 Val_Wu8 255.0 OneToOne 0.00 255.0 /end CHARACTERISTIC
/begin CHARACTERISTIC AirCtl_mDesVal_Bypass.Vector "Bypass Label (verwendet von ASCET), nicht editieren!/Bypass Table Vector Element (verwendet von ASCET), nicht editieren!" VALUE 0x80020A1A Val_Wu8 255.0 OneToOne 0.00 255.0 /end CHARACTERISTIC
/begin CHARACTERISTIC AirCtl_mDesVal_Bypass.Channel "Bypass Label (verwendet von ASCET), nicht editieren!/Bypass Table Channel Element(verwendet von ASCET), nicht editieren!" VALUE 0x80020A1B Val_Wu8 255.0 OneToOne 0.00 255.0 /end CHARACTERISTIC
/begin CHARACTERISTIC AirCtl_rCtlVal_Bypass.Vector "Bypass Label (verwendet von ASCET), nicht editieren!/Bypass Table Vector Element (verwendet von ASCET), nicht editieren!" VALUE 0x80020A1C Val_Wu8 255.0 OneToOne 0.00 255.0 /end CHARACTERISTIC
/begin CHARACTERISTIC AirCtl_rCtlVal_Bypass.Channel "Bypass Label (verwendet von ASCET), nicht editieren!/Bypass Table Channel Element(verwendet von ASCET), nicht editieren!" VALUE 0x80020A1D Val_Wu8 255.0 OneToOne 0.00 255.0 /end CHARACTERISTIC
/begin CHARACTERISTIC AirCtl_rGovEGR_Bypass.Vector "Bypass Label (verwendet von ASCET), nicht editieren!/Bypass Table Vector Element (verwendet von ASCET), nicht editieren!" VALUE 0x80020A1E Val_Wu8 255.0 OneToOne 0.00 255.0 /end CHARACTERISTIC
/begin CHARACTERISTIC AirCtl_rGovEGR_Bypass.Channel "Bypass Label (verwendet von ASCET), nicht editieren!/Bypass Table Channel Element(verwendet von ASCET), nicht editieren!" VALUE 0x80020A1F Val_Wu8 255.0 OneToOne 0.00 255.0 /end CHARACTERISTIC
/begin CHARACTERISTIC AirCtl_rGovOut_mp_Bypass.Vector "Bypass Label (verwendet von ASCET), nicht editieren!/Bypass Table Vector Element (verwendet von ASCET), nicht editieren!" VALUE 0x80020A20 Val_Wu8 255.0 OneToOne 0.00 255.0 /end CHARACTERISTIC
/begin CHARACTERISTIC AirCtl_rGovOut_mp_Bypass.Channel "Bypass Label (verwendet von ASCET), nicht editieren!/Bypass Table Channel Element(verwendet von ASCET), nicht editieren!" VALUE 0x80020A21 Val_Wu8 255.0 OneToOne 0.00 255.0 /end CHARACTERISTIC
/begin CHARACTERISTIC AirCtl_rGovTVA_Bypass.Vector "Bypass Label (verwendet von ASCET), nicht editieren!/Bypass Table Vector Element (verwendet von ASCET), nicht editieren!" VALUE 0x80020A22 Val_Wu8 255.0 OneToOne 0.00 255.0 /end CHARACTERISTIC
/begin CHARACTERISTIC AirCtl_rGovTVA_Bypass.Channel "Bypass Label (verwendet von ASCET), nicht editieren!/Bypass Table Channel Element(verwendet von ASCET), nicht editieren!" VALUE 0x80020A23 Val_Wu8 255.0 OneToOne 0.00 255.0 /end CHARACTERISTIC
/begin CHARACTERISTIC Air_RmpSlpTCACDs.Pos_C "/" VALUE 0x80037ACC Kw_Ws32 3276798.99750 RmpTemp 1.00097656250 3276799.99847 FORMAT "%13.5" EXTENDED_LIMITS -3276800.00000 3276799.99847 /end CHARACTERISTIC
/begin CHARACTERISTIC Air_RmpSlpTCACDs.Neg_C "/" VALUE 0x80037AD0 Kw_Ws32 3276798.99750 RmpTemp 1.00097656250 3276799.99847 FORMAT "%13.5" EXTENDED_LIMITS -3276800.00000 3276799.99847 /end CHARACTERISTIC
/begin CHARACTERISTIC Air_SRCTCACDs.uMin_C "/" VALUE 0x80037A84 Kw_Ws16 5200.000 Volt 0.00 5200.000 EXTENDED_LIMITS -6553.600 6553.400 /end CHARACTERISTIC
/begin CHARACTERISTIC Air_SRCTCACDs.uMax_C "/" VALUE 0x80037A86 Kw_Ws16 5200.000 Volt 0.00 5200.000 EXTENDED_LIMITS -6553.600 6553.400 /end CHARACTERISTIC
/begin CHARACTERISTIC Air_swtSensPresTCACDs_C "Schalter zur Anzeige von dem Vorhandensein oder Nichtvorhandensein des Sensors" VALUE 0x80037AD4 Val_Wu8 1.000 OneToOne 0.00 1.000 EXTENDED_LIMITS 0.00 255.0 /end CHARACTERISTIC
/begin CHARACTERISTIC Air_swtSigTCACDs_C "Schalter zur Auswahl der Signalquelle" VALUE 0x80037A88 Val_Wu8 255.0 OneToOne 0.00 255.0 /end CHARACTERISTIC
/begin CHARACTERISTIC Air_tDflOffsTCACDs_C "Der zur Berechnung des Modellwerts zu addierenden Offsetwert" VALUE 0x80037AE0 Kw_Ws16 250.0000 Temp_Cels -50.14000 199.8600 EXTENDED_LIMITS -3549.940 3003.560 /end CHARACTERISTIC
/begin CHARACTERISTIC Air_tiLPFiltPT1TCACDs_C "Zeitkonstante für PT1-Filter" VALUE 0x80037AD8 Val_Ws32 4294.9672940 TimeDelay_s 0.000002000000001 4294.9672960 FORMAT "%12.7" /end CHARACTERISTIC
/begin CHARACTERISTIC Air_TransStgTCACDs.Dfl_C "/" VALUE 0x80037ADC Kw_Ws16 250.0000 Temp_Cels -50.14000 199.8600 EXTENDED_LIMITS -3549.940 3003.560 /end CHARACTERISTIC
/begin CHARACTERISTIC Air_TransStgTCACDs.stSensId_C "/" VALUE 0x80037ADE Kw_Wu8 255.0 OneToOne 0.00 255.0 /end CHARACTERISTIC
/begin CHARACTERISTIC Air_tTransfTCACDs_CUR "Kennlinie zur Umwandlung der Eingangsspannung in die Temperatur" CURVE 0x80037A8A Cur_Xs16Ws16 250.0000 Temp_Cels -50.04000 199.9600 EXTENDED_LIMITS -3549.940 3003.560
 /begin AXIS_DESCR STD_AXIS Air_uRawTCACDs Volt 16 0.00 5200.000 EXTENDED_LIMITS -6553.600 6553.400 DEPOSIT ABSOLUTE /end AXIS_DESCR
/end CHARACTERISTIC
/begin CHARACTERISTIC APP_r_Bypass.Vector "Bypass Label (verwendet von ASCET), nicht editieren!/Bypass Table Vector Element (verwendet von ASCET), nicht editieren!" VALUE 0x80020A24 Val_Wu8 255.0 OneToOne 0.00 255.0 /end CHARACTERISTIC
/begin CHARACTERISTIC APP_r_Bypass.Channel "Bypass Label (verwendet von ASCET), nicht editieren!/Bypass Table Channel Element(verwendet von ASCET), nicht editieren!" VALUE 0x80020A25 Val_Wu8 255.0 OneToOne 0.00 255.0 /end CHARACTERISTIC
/begin CHARACTERISTIC ASDdc_trq_Bypass.Vector "Bypass Label (verwendet von ASCET), nicht editieren!/Bypass Table Vector Element (verwendet von ASCET), nicht editieren!" VALUE 0x80020A26 Val_Wu8 255.0 OneToOne 0.00 255.0 /end CHARACTERISTIC
/begin CHARACTERISTIC ASDdc_trq_Bypass.Channel "Bypass Label (verwendet von ASCET), nicht editieren!/Bypass Table Channel Element(verwendet von ASCET), nicht editieren!" VALUE 0x80020A27 Val_Wu8 255.0 OneToOne 0.00 255.0 /end CHARACTERISTIC
/begin CHARACTERISTIC ASDrf_trqInrSet_Bypass.Vector "Bypass Label (verwendet von ASCET), nicht editieren!/Bypass Table Vector Element (verwendet von ASCET), nicht editieren!" VALUE 0x80020A28 Val_Wu8 255.0 OneToOne 0.00 255.0 /end CHARACTERISTIC
/begin CHARACTERISTIC ASDrf_trqInrSet_Bypass.Channel "Bypass Label (verwendet von ASCET), nicht editieren!/Bypass Table Channel Element(verwendet von ASCET), nicht editieren!" VALUE 0x80020A29 Val_Wu8 255.0 OneToOne 0.00 255.0 /end CHARACTERISTIC
/begin CHARACTERISTIC ASMod_arEffEGRLPCor_Bypass.Vector "/Bypass Table Vector Element (verwendet von ASCET), nicht editieren!" VALUE 0x80020A2A Val_Wu8 255.0 OneToOne 0.00 255.0 /end CHARACTERISTIC
/begin CHARACTERISTIC ASMod_arEffEGRLPCor_Bypass.Channel "/Bypass Table Channel Element(verwendet von ASCET), nicht editieren!" VALUE 0x80020A2B Val_Wu8 255.0 OneToOne 0.00 255.0 /end CHARACTERISTIC
/begin CHARACTERISTIC ASMod_dmAshEG_Bypass.Vector "Bypass Label (verwendet von ASCET), nicht editieren!/Bypass Table Vector Element (verwendet von ASCET), nicht editieren!" VALUE 0x80020A2C Val_Wu8 255.0 OneToOne 0.00 255.0 /end CHARACTERISTIC
/begin CHARACTERISTIC ASMod_dmAshEG_Bypass.Channel "Bypass Label (verwendet von ASCET), nicht editieren!/Bypass Table Channel Element(verwendet von ASCET), nicht editieren!" VALUE 0x80020A2D Val_Wu8 255.0 OneToOne 0.00 255.0 /end CHARACTERISTIC
/begin CHARACTERISTIC ASMod_dmCmprUs_r32_Bypass.Vector "Bypass Label (verwendet von ASCET), nicht editieren!/Bypass Table Vector Element (verwendet von ASCET), nicht editieren!" VALUE 0x80020A2E Val_Wu8 255.0 OneToOne 0.00 255.0 /end CHARACTERISTIC
/begin CHARACTERISTIC ASMod_dmCmprUs_r32_Bypass.Channel "Bypass Label (verwendet von ASCET), nicht editieren!/Bypass Table Channel Element(verwendet von ASCET), nicht editieren!" VALUE 0x80020A2F Val_Wu8 255.0 OneToOne 0.00 255.0 /end CHARACTERISTIC
/begin CHARACTERISTIC ASMod_dmEGFld_0_Bypass.Vector "Bypass Label (verwendet von ASCET), nicht editieren!/Bypass Table Vector Element (verwendet von ASCET), nicht editieren!" VALUE 0x80020A30 Val_Wu8 255.0 OneToOne 0.00 255.0 /end CHARACTERISTIC
/begin CHARACTERISTIC ASMod_dmEGFld_0_Bypass.Channel "Bypass Label (verwendet von ASCET), nicht editieren!/Bypass Table Channel Element(verwendet von ASCET), nicht editieren!" VALUE 0x80020A31 Val_Wu8 255.0 OneToOne 0.00 255.0 /end CHARACTERISTIC
/begin CHARACTERISTIC ASMod_dmEGFld_1_Bypass.Vector "Bypass Label (verwendet von ASCET), nicht editieren!/Bypass Table Vector Element (verwendet von ASCET), nicht editieren!" VALUE 0x80020A32 Val_Wu8 255.0 OneToOne 0.00 255.0 /end CHARACTERISTIC
/begin CHARACTERISTIC ASMod_dmEGFld_1_Bypass.Channel "Bypass Label (verwendet von ASCET), nicht editieren!/Bypass Table Channel Element(verwendet von ASCET), nicht editieren!" VALUE 0x80020A33 Val_Wu8 255.0 OneToOne 0.00 255.0 /end CHARACTERISTIC
/begin CHARACTERISTIC ASMod_dmEGFld_2_Bypass.Vector "Bypass Label (verwendet von ASCET), nicht editieren!/Bypass Table Vector Element (verwendet von ASCET), nicht editieren!" VALUE 0x80020A34 Val_Wu8 255.0 OneToOne 0.00 255.0 /end CHARACTERISTIC
/begin CHARACTERISTIC ASMod_dmEGFld_2_Bypass.Channel "Bypass Label (verwendet von ASCET), nicht editieren!/Bypass Table Channel Element(verwendet von ASCET), nicht editieren!" VALUE 0x80020A35 Val_Wu8 255.0 OneToOne 0.00 255.0 /end CHARACTERISTIC
/begin CHARACTERISTIC ASMod_dmEGFld_3_Bypass.Vector "Bypass Label (verwendet von ASCET), nicht editieren!/Bypass Table Vector Element (verwendet von ASCET), nicht editieren!" VALUE 0x80020A36 Val_Wu8 255.0 OneToOne 0.00 255.0 /end CHARACTERISTIC
/begin CHARACTERISTIC ASMod_dmEGFld_3_Bypass.Channel "Bypass Label (verwendet von ASCET), nicht editieren!/Bypass Table Channel Element(verwendet von ASCET), nicht editieren!" VALUE 0x80020A37 Val_Wu8 255.0 OneToOne 0.00 255.0 /end CHARACTERISTIC
/begin CHARACTERISTIC ASMod_dmEGFld_4_Bypass.Vector "Bypass Label (verwendet von ASCET), nicht editieren!/Bypass Table Vector Element (verwendet von ASCET), nicht editieren!" VALUE 0x80020A38 Val_Wu8 255.0 OneToOne 0.00 255.0 /end CHARACTERISTIC
/begin CHARACTERISTIC ASMod_dmEGFld_4_Bypass.Channel "Bypass Label (verwendet von ASCET), nicht editieren!/Bypass Table Channel Element(verwendet von ASCET), nicht editieren!" VALUE 0x80020A39 Val_Wu8 255.0 OneToOne 0.00 255.0 /end CHARACTERISTIC
/begin CHARACTERISTIC ASMod_dmEGFld_5_Bypass.Vector "Bypass Label (verwendet von ASCET), nicht editieren!/Bypass Table Vector Element (verwendet von ASCET), nicht editieren!" VALUE 0x80020A3A Val_Wu8 255.0 OneToOne 0.00 255.0 /end CHARACTERISTIC
/begin CHARACTERISTIC ASMod_dmEGFld_5_Bypass.Channel "Bypass Label (verwendet von ASCET), nicht editieren!/Bypass Table Channel Element(verwendet von ASCET), nicht editieren!" VALUE 0x80020A3B Val_Wu8 255.0 OneToOne 0.00 255.0 /end CHARACTERISTIC
/begin CHARACTERISTIC ASMod_dmEGFld_6_Bypass.Vector "Bypass Label (verwendet von ASCET), nicht editieren!/Bypass Table Vector Element (verwendet von ASCET), nicht editieren!" VALUE 0x80020A3C Val_Wu8 255.0 OneToOne 0.00 255.0 /end CHARACTERISTIC
/begin CHARACTERISTIC ASMod_dmEGFld_6_Bypass.Channel "Bypass Label (verwendet von ASCET), nicht editieren!/Bypass Table Channel Element(verwendet von ASCET), nicht editieren!" VALUE 0x80020A3D Val_Wu8 255.0 OneToOne 0.00 255.0 /end CHARACTERISTIC
/begin CHARACTERISTIC ASMod_dmEGRDs_Bypass.Vector "Bypass Label (verwendet von ASCET), nicht editieren!/Bypass Table Vector Element (verwendet von ASCET), nicht editieren!" VALUE 0x80020A3E Val_Wu8 255.0 OneToOne 0.00 255.0 /end CHARACTERISTIC
/begin CHARACTERISTIC ASMod_dmEGRDs_Bypass.Channel "Bypass Label (verwendet von ASCET), nicht editieren!/Bypass Table Channel Element(verwendet von ASCET), nicht editieren!" VALUE 0x80020A3F Val_Wu8 255.0 OneToOne 0.00 255.0 /end CHARACTERISTIC
/begin CHARACTERISTIC ASMod_dmEGRLPDs_r32_Bypass.Vector "Bypass Label (verwendet von ASCET), nicht editieren!/Bypass Table Vector Element (verwendet von ASCET), nicht editieren!" VALUE 0x80020A40 Val_Wu8 255.0 OneToOne 0.00 255.0 /end CHARACTERISTIC
/begin CHARACTERISTIC ASMod_dmEGRLPDs_r32_Bypass.Channel "Bypass Label (verwendet von ASCET), nicht editieren!/Bypass Table Channel Element(verwendet von ASCET), nicht editieren!" VALUE 0x80020A41 Val_Wu8 255.0 OneToOne 0.00 255.0 /end CHARACTERISTIC
/begin CHARACTERISTIC ASMod_dmExhMnfDs_Bypass.Vector "Bypass Label (verwendet von ASCET), nicht editieren!/Bypass Table Vector Element (verwendet von ASCET), nicht editieren!" VALUE 0x80020A42 Val_Wu8 255.0 OneToOne 0.00 255.0 /end CHARACTERISTIC
/begin CHARACTERISTIC ASMod_dmExhMnfDs_Bypass.Channel "Bypass Label (verwendet von ASCET), nicht editieren!/Bypass Table Channel Element(verwendet von ASCET), nicht editieren!" VALUE 0x80020A43 Val_Wu8 255.0 OneToOne 0.00 255.0 /end CHARACTERISTIC
/begin CHARACTERISTIC ASMod_dmExhMnfUs_Bypass.Vector "Bypass Label (verwendet von ASCET), nicht editieren!/Bypass Table Vector Element (verwendet von ASCET), nicht editieren!" VALUE 0x80020A44 Val_Wu8 255.0 OneToOne 0.00 255.0 /end CHARACTERISTIC
/begin CHARACTERISTIC ASMod_dmExhMnfUs_Bypass.Channel "Bypass Label (verwendet von ASCET), nicht editieren!/Bypass Table Channel Element(verwendet von ASCET), nicht editieren!" VALUE 0x80020A45 Val_Wu8 255.0 OneToOne 0.00 255.0 /end CHARACTERISTIC
/begin CHARACTERISTIC ASMod_dmIndAirRef_Bypass.Vector "Bypass Label (verwendet von ASCET), nicht editieren!/Bypass Table Vector Element (verwendet von ASCET), nicht editieren!" VALUE 0x80020A46 Val_Wu8 255.0 OneToOne 0.00 255.0 /end CHARACTERISTIC
/begin CHARACTERISTIC ASMod_dmIndAirRef_Bypass.Channel "Bypass Label (verwendet von ASCET), nicht editieren!/Bypass Table Channel Element(verwendet von ASCET), nicht editieren!" VALUE 0x80020A47 Val_Wu8 255.0 OneToOne 0.00 255.0 /end CHARACTERISTIC
/begin CHARACTERISTIC ASMod_dmIntMnfDs_Bypass.Vector "Bypass Label (verwendet von ASCET), nicht editieren!/Bypass Table Vector Element (verwendet von ASCET), nicht editieren!" VALUE 0x80020A48 Val_Wu8 255.0 OneToOne 0.00 255.0 /end CHARACTERISTIC
/begin CHARACTERISTIC ASMod_dmIntMnfDs_Bypass.Channel "Bypass Label (verwendet von ASCET), nicht editieren!/Bypass Table Channel Element(verwendet von ASCET), nicht editieren!" VALUE 0x80020A49 Val_Wu8 255.0 OneToOne 0.00 255.0 /end CHARACTERISTIC
/begin CHARACTERISTIC ASMod_dmIntMnfUs_r32_Bypass.Vector "Bypass : Gasmassenstrom vor Einlasskruemmer/Bypass Table Vector Element (verwendet von ASCET), nicht editieren!" VALUE 0x80020A4A Val_Wu8 255.0 OneToOne 0.00 255.0 /end CHARACTERISTIC
/begin CHARACTERISTIC ASMod_dmIntMnfUs_r32_Bypass.Channel "Bypass : Gasmassenstrom vor Einlasskruemmer/Bypass Table Channel Element(verwendet von ASCET), nicht editieren!" VALUE 0x80020A4B Val_Wu8 255.0 OneToOne 0.00 255.0 /end CHARACTERISTIC
/begin CHARACTERISTIC ASMod_dmNOxEG_Bypass.Vector "Bypass Label (verwendet von ASCET), nicht editieren!/Bypass Table Vector Element (verwendet von ASCET), nicht editieren!" VALUE 0x80020A4C Val_Wu8 255.0 OneToOne 0.00 255.0 /end CHARACTERISTIC
/begin CHARACTERISTIC ASMod_dmNOxEG_Bypass.Channel "Bypass Label (verwendet von ASCET), nicht editieren!/Bypass Table Channel Element(verwendet von ASCET), nicht editieren!" VALUE 0x80020A4D Val_Wu8 255.0 OneToOne 0.00 255.0 /end CHARACTERISTIC
/begin CHARACTERISTIC ASMod_dmO2IntMnfDs_Bypass.Vector "Bypass Label (verwendet von ASCET), nicht editieren!/Bypass Table Vector Element (verwendet von ASCET), nicht editieren!" VALUE 0x80020A4E Val_Wu8 255.0 OneToOne 0.00 255.0 /end CHARACTERISTIC
/begin CHARACTERISTIC ASMod_dmO2IntMnfDs_Bypass.Channel "Bypass Label (verwendet von ASCET), nicht editieren!/Bypass Table Channel Element(verwendet von ASCET), nicht editieren!" VALUE 0x80020A4F Val_Wu8 255.0 OneToOne 0.00 255.0 /end CHARACTERISTIC
/begin CHARACTERISTIC ASMod_dmOilCons_Bypass.Vector "Bypass Label (verwendet von ASCET), nicht editieren!/Bypass Table Vector Element (verwendet von ASCET), nicht editieren!" VALUE 0x80020A50 Val_Wu8 255.0 OneToOne 0.00 255.0 /end CHARACTERISTIC
/begin CHARACTERISTIC ASMod_dmOilCons_Bypass.Channel "Bypass Label (verwendet von ASCET), nicht editieren!/Bypass Table Channel Element(verwendet von ASCET), nicht editieren!" VALUE 0x80020A51 Val_Wu8 255.0 OneToOne 0.00 255.0 /end CHARACTERISTIC
/begin CHARACTERISTIC ASMod_dmSotEG_Bypass.Vector "Bypass Label (verwendet von ASCET), nicht editieren!/Bypass Table Vector Element (verwendet von ASCET), nicht editieren!" VALUE 0x80020A52 Val_Wu8 255.0 OneToOne 0.00 255.0 /end CHARACTERISTIC
/begin CHARACTERISTIC ASMod_dmSotEG_Bypass.Channel "Bypass Label (verwendet von ASCET), nicht editieren!/Bypass Table Channel Element(verwendet von ASCET), nicht editieren!" VALUE 0x80020A53 Val_Wu8 255.0 OneToOne 0.00 255.0 /end CHARACTERISTIC
/begin CHARACTERISTIC ASMod_dvolIntMnfDsRef_Bypass.Vector "Bypass Label (verwendet von ASCET), nicht editieren!/Bypass Table Vector Element (verwendet von ASCET), nicht editieren!" VALUE 0x80020A54 Val_Wu8 255.0 OneToOne 0.00 255.0 /end CHARACTERISTIC
/begin CHARACTERISTIC ASMod_dvolIntMnfDsRef_Bypass.Channel "Bypass Label (verwendet von ASCET), nicht editieren!/Bypass Table Channel Element(verwendet von ASCET), nicht editieren!" VALUE 0x80020A55 Val_Wu8 255.0 OneToOne 0.00 255.0 /end CHARACTERISTIC
/begin CHARACTERISTIC ASMod_dvolPFltEG_Bypass.Vector "Bypass Label (verwendet von ASCET), nicht editieren!/Bypass Table Vector Element (verwendet von ASCET), nicht editieren!" VALUE 0x80020A56 Val_Wu8 255.0 OneToOne 0.00 255.0 /end CHARACTERISTIC
/begin CHARACTERISTIC ASMod_dvolPFltEG_Bypass.Channel "Bypass Label (verwendet von ASCET), nicht editieren!/Bypass Table Channel Element(verwendet von ASCET), nicht editieren!" VALUE 0x80020A57 Val_Wu8 255.0 OneToOne 0.00 255.0 /end CHARACTERISTIC
/begin CHARACTERISTIC ASMod_facVolEff_Bypass.Vector "Bypass Label (verwendet von ASCET), nicht editieren!/Bypass Table Vector Element (verwendet von ASCET), nicht editieren!" VALUE 0x80020A58 Val_Wu8 255.0 OneToOne 0.00 255.0 /end CHARACTERISTIC
/begin CHARACTERISTIC ASMod_facVolEff_Bypass.Channel "Bypass Label (verwendet von ASCET), nicht editieren!/Bypass Table Channel Element(verwendet von ASCET), nicht editieren!" VALUE 0x80020A59 Val_Wu8 255.0 OneToOne 0.00 255.0 /end CHARACTERISTIC
/begin CHARACTERISTIC ASMod_mAirPerCylCor_Bypass.Vector "Bypass Label (verwendet von ASCET), nicht editieren!/Bypass Table Vector Element (verwendet von ASCET), nicht editieren!" VALUE 0x80020A5A Val_Wu8 255.0 OneToOne 0.00 255.0 /end CHARACTERISTIC
/begin CHARACTERISTIC ASMod_mAirPerCylCor_Bypass.Channel "Bypass Label (verwendet von ASCET), nicht editieren!/Bypass Table Channel Element(verwendet von ASCET), nicht editieren!" VALUE 0x80020A5B Val_Wu8 255.0 OneToOne 0.00 255.0 /end CHARACTERISTIC
/begin CHARACTERISTIC ASMod_mIndVol_r32_Bypass.Vector "Bypass Label (verwendet von ASCET), nicht editieren!/Bypass Table Vector Element (verwendet von ASCET), nicht editieren!" VALUE 0x80020A5C Val_Wu8 255.0 OneToOne 0.00 255.0 /end CHARACTERISTIC
/begin CHARACTERISTIC ASMod_mIndVol_r32_Bypass.Channel "Bypass Label (verwendet von ASCET), nicht editieren!/Bypass Table Channel Element(verwendet von ASCET), nicht editieren!" VALUE 0x80020A5D Val_Wu8 255.0 OneToOne 0.00 255.0 /end CHARACTERISTIC
/begin CHARACTERISTIC ASMod_pCmprUs_r32_Bypass.Vector "Bypass Label (verwendet von ASCET), nicht editieren!/Bypass Table Vector Element (verwendet von ASCET), nicht editieren!" VALUE 0x80020A5E Val_Wu8 255.0 OneToOne 0.00 255.0 /end CHARACTERISTIC
/begin CHARACTERISTIC ASMod_pCmprUs_r32_Bypass.Channel "Bypass Label (verwendet von ASCET), nicht editieren!/Bypass Table Channel Element(verwendet von ASCET), nicht editieren!" VALUE 0x80020A5F Val_Wu8 255.0 OneToOne 0.00 255.0 /end CHARACTERISTIC
/begin CHARACTERISTIC ASMod_pEGFld_0_Bypass.Vector "Bypass Label (verwendet von ASCET), nicht editieren!/Bypass Table Vector Element (verwendet von ASCET), nicht editieren!" VALUE 0x80020A60 Val_Wu8 255.0 OneToOne 0.00 255.0 /end CHARACTERISTIC
/begin CHARACTERISTIC ASMod_pEGFld_0_Bypass.Channel "Bypass Label (verwendet von ASCET), nicht editieren!/Bypass Table Channel Element(verwendet von ASCET), nicht editieren!" VALUE 0x80020A61 Val_Wu8 255.0 OneToOne 0.00 255.0 /end CHARACTERISTIC
/begin CHARACTERISTIC ASMod_pEGFld_1_Bypass.Vector "Bypass Label (verwendet von ASCET), nicht editieren!/Bypass Table Vector Element (verwendet von ASCET), nicht editieren!" VALUE 0x80020A62 Val_Wu8 255.0 OneToOne 0.00 255.0 /end CHARACTERISTIC
/begin CHARACTERISTIC ASMod_pEGFld_1_Bypass.Channel "Bypass Label (verwendet von ASCET), nicht editieren!/Bypass Table Channel Element(verwendet von ASCET), nicht editieren!" VALUE 0x80020A63 Val_Wu8 255.0 OneToOne 0.00 255.0 /end CHARACTERISTIC
/begin CHARACTERISTIC ASMod_pEGFld_2_Bypass.Vector "Bypass Label (verwendet von ASCET), nicht editieren!/Bypass Table Vector Element (verwendet von ASCET), nicht editieren!" VALUE 0x80020A64 Val_Wu8 255.0 OneToOne 0.00 255.0 /end CHARACTERISTIC
/begin CHARACTERISTIC ASMod_pEGFld_2_Bypass.Channel "Bypass Label (verwendet von ASCET), nicht editieren!/Bypass Table Channel Element(verwendet von ASCET), nicht editieren!" VALUE 0x80020A65 Val_Wu8 255.0 OneToOne 0.00 255.0 /end CHARACTERISTIC
/begin CHARACTERISTIC ASMod_pEGFld_3_Bypass.Vector "Bypass Label (verwendet von ASCET), nicht editieren!/Bypass Table Vector Element (verwendet von ASCET), nicht editieren!" VALUE 0x80020A66 Val_Wu8 255.0 OneToOne 0.00 255.0 /end CHARACTERISTIC
/begin CHARACTERISTIC ASMod_pEGFld_3_Bypass.Channel "Bypass Label (verwendet von ASCET), nicht editieren!/Bypass Table Channel Element(verwendet von ASCET), nicht editieren!" VALUE 0x80020A67 Val_Wu8 255.0 OneToOne 0.00 255.0 /end CHARACTERISTIC
/begin CHARACTERISTIC ASMod_pEGFld_4_Bypass.Vector "Bypass Label (verwendet von ASCET), nicht editieren!/Bypass Table Vector Element (verwendet von ASCET), nicht editieren!" VALUE 0x80020A68 Val_Wu8 255.0 OneToOne 0.00 255.0 /end CHARACTERISTIC
/begin CHARACTERISTIC ASMod_pEGFld_4_Bypass.Channel "Bypass Label (verwendet von ASCET), nicht editieren!/Bypass Table Channel Element(verwendet von ASCET), nicht editieren!" VALUE 0x80020A69 Val_Wu8 255.0 OneToOne 0.00 255.0 /end CHARACTERISTIC
/begin CHARACTERISTIC ASMod_pEGFld_5_Bypass.Vector "Bypass Label (verwendet von ASCET), nicht editieren!/Bypass Table Vector Element (verwendet von ASCET), nicht editieren!" VALUE 0x80020A6A Val_Wu8 255.0 OneToOne 0.00 255.0 /end CHARACTERISTIC
/begin CHARACTERISTIC ASMod_pEGFld_5_Bypass.Channel "Bypass Label (verwendet von ASCET), nicht editieren!/Bypass Table Channel Element(verwendet von ASCET), nicht editieren!" VALUE 0x80020A6B Val_Wu8 255.0 OneToOne 0.00 255.0 /end CHARACTERISTIC
/begin CHARACTERISTIC ASMod_pEGFld_6_Bypass.Vector "Bypass Label (verwendet von ASCET), nicht editieren!/Bypass Table Vector Element (verwendet von ASCET), nicht editieren!" VALUE 0x80020A6C Val_Wu8 255.0 OneToOne 0.00 255.0 /end CHARACTERISTIC
/begin CHARACTERISTIC ASMod_pEGFld_6_Bypass.Channel "Bypass Label (verwendet von ASCET), nicht editieren!/Bypass Table Channel Element(verwendet von ASCET), nicht editieren!" VALUE 0x80020A6D Val_Wu8 255.0 OneToOne 0.00 255.0 /end CHARACTERISTIC
/begin CHARACTERISTIC ASMod_pEGFld_7_Bypass.Vector "Bypass Label (verwendet von ASCET), nicht editieren!/Bypass Table Vector Element (verwendet von ASCET), nicht editieren!" VALUE 0x80020A6E Val_Wu8 255.0 OneToOne 0.00 255.0 /end CHARACTERISTIC
/begin CHARACTERISTIC ASMod_pEGFld_7_Bypass.Channel "Bypass Label (verwendet von ASCET), nicht editieren!/Bypass Table Channel Element(verwendet von ASCET), nicht editieren!" VALUE 0x80020A6F Val_Wu8 255.0 OneToOne 0.00 255.0 /end CHARACTERISTIC
/begin CHARACTERISTIC ASMod_pEGRLPDs_r32_Bypass.Vector "/Bypass Table Vector Element (verwendet von ASCET), nicht editieren!" VALUE 0x80020A70 Val_Wu8 255.0 OneToOne 0.00 255.0 /end CHARACTERISTIC
/begin CHARACTERISTIC ASMod_pEGRLPDs_r32_Bypass.Channel "/Bypass Table Channel Element(verwendet von ASCET), nicht editieren!" VALUE 0x80020A71 Val_Wu8 255.0 OneToOne 0.00 255.0 /end CHARACTERISTIC
/begin CHARACTERISTIC ASMod_pIndVol_r32_Bypass.Vector "Bypass Label (verwendet von ASCET), nicht editieren!/Bypass Table Vector Element (verwendet von ASCET), nicht editieren!" VALUE 0x80020A72 Val_Wu8 255.0 OneToOne 0.00 255.0 /end CHARACTERISTIC
/begin CHARACTERISTIC ASMod_pIndVol_r32_Bypass.Channel "Bypass Label (verwendet von ASCET), nicht editieren!/Bypass Table Channel Element(verwendet von ASCET), nicht editieren!" VALUE 0x80020A73 Val_Wu8 255.0 OneToOne 0.00 255.0 /end CHARACTERISTIC
/begin CHARACTERISTIC ASMod_rEGR_Bypass.Vector "Bypass Label (verwendet von ASCET), nicht editieren!/Bypass Table Vector Element (verwendet von ASCET), nicht editieren!" VALUE 0x80020A74 Val_Wu8 255.0 OneToOne 0.00 255.0 /end CHARACTERISTIC
/begin CHARACTERISTIC ASMod_rEGR_Bypass.Channel "Bypass Label (verwendet von ASCET), nicht editieren!/Bypass Table Channel Element(verwendet von ASCET), nicht editieren!" VALUE 0x80020A75 Val_Wu8 255.0 OneToOne 0.00 255.0 /end CHARACTERISTIC
/begin CHARACTERISTIC ASMod_rLamRecEGSensSim_Bypass.Vector "Bypass Label (verwendet von ASCET), nicht editieren!/Bypass Table Vector Element (verwendet von ASCET), nicht editieren!" VALUE 0x80020A76 Val_Wu8 255.0 OneToOne 0.00 255.0 /end CHARACTERISTIC
/begin CHARACTERISTIC ASMod_rLamRecEGSensSim_Bypass.Channel "Bypass Label (verwendet von ASCET), nicht editieren!/Bypass Table Channel Element(verwendet von ASCET), nicht editieren!" VALUE 0x80020A77 Val_Wu8 255.0 OneToOne 0.00 255.0 /end CHARACTERISTIC
/begin CHARACTERISTIC ASMod_rLamRecEG_Bypass.Vector "Bypass Label (verwendet von ASCET), nicht editieren!/Bypass Table Vector Element (verwendet von ASCET), nicht editieren!" VALUE 0x80020A78 Val_Wu8 255.0 OneToOne 0.00 255.0 /end CHARACTERISTIC
/begin CHARACTERISTIC ASMod_rLamRecEG_Bypass.Channel "Bypass Label (verwendet von ASCET), nicht editieren!/Bypass Table Channel Element(verwendet von ASCET), nicht editieren!" VALUE 0x80020A79 Val_Wu8 255.0 OneToOne 0.00 255.0 /end CHARACTERISTIC
/begin CHARACTERISTIC ASMod_rLamRecExhMnfDs_Bypass.Vector "Bypass Label (verwendet von ASCET), nicht editieren!/Bypass Table Vector Element (verwendet von ASCET), nicht editieren!" VALUE 0x80020A7A Val_Wu8 255.0 OneToOne 0.00 255.0 /end CHARACTERISTIC
/begin CHARACTERISTIC ASMod_rLamRecExhMnfDs_Bypass.Channel "Bypass Label (verwendet von ASCET), nicht editieren!/Bypass Table Channel Element(verwendet von ASCET), nicht editieren!" VALUE 0x80020A7B Val_Wu8 255.0 OneToOne 0.00 255.0 /end CHARACTERISTIC
/begin CHARACTERISTIC ASMod_rNOxEG_Bypass.Vector "Bypass Label (verwendet von ASCET), nicht editieren!/Bypass Table Vector Element (verwendet von ASCET), nicht editieren!" VALUE 0x80020A7C Val_Wu8 255.0 OneToOne 0.00 255.0 /end CHARACTERISTIC
/begin CHARACTERISTIC ASMod_rNOxEG_Bypass.Channel "Bypass Label (verwendet von ASCET), nicht editieren!/Bypass Table Channel Element(verwendet von ASCET), nicht editieren!" VALUE 0x80020A7D Val_Wu8 255.0 OneToOne 0.00 255.0 /end CHARACTERISTIC
/begin CHARACTERISTIC ASMod_rO2EGFld_0_Bypass.Vector "Bypass Label (verwendet von ASCET), nicht editieren!/Bypass Table Vector Element (verwendet von ASCET), nicht editieren!" VALUE 0x80020A7E Val_Wu8 255.0 OneToOne 0.00 255.0 /end CHARACTERISTIC
/begin CHARACTERISTIC ASMod_rO2EGFld_0_Bypass.Channel "Bypass Label (verwendet von ASCET), nicht editieren!/Bypass Table Channel Element(verwendet von ASCET), nicht editieren!" VALUE 0x80020A7F Val_Wu8 255.0 OneToOne 0.00 255.0 /end CHARACTERISTIC
/begin CHARACTERISTIC ASMod_rO2EGFld_1_Bypass.Vector "Bypass Label (verwendet von ASCET), nicht editieren!/Bypass Table Vector Element (verwendet von ASCET), nicht editieren!" VALUE 0x80020A80 Val_Wu8 255.0 OneToOne 0.00 255.0 /end CHARACTERISTIC
/begin CHARACTERISTIC ASMod_rO2EGFld_1_Bypass.Channel "Bypass Label (verwendet von ASCET), nicht editieren!/Bypass Table Channel Element(verwendet von ASCET), nicht editieren!" VALUE 0x80020A81 Val_Wu8 255.0 OneToOne 0.00 255.0 /end CHARACTERISTIC
/begin CHARACTERISTIC ASMod_rO2EGFld_2_Bypass.Vector "Bypass Label (verwendet von ASCET), nicht editieren!/Bypass Table Vector Element (verwendet von ASCET), nicht editieren!" VALUE 0x80020A82 Val_Wu8 255.0 OneToOne 0.00 255.0 /end CHARACTERISTIC
/begin CHARACTERISTIC ASMod_rO2EGFld_2_Bypass.Channel "Bypass Label (verwendet von ASCET), nicht editieren!/Bypass Table Channel Element(verwendet von ASCET), nicht editieren!" VALUE 0x80020A83 Val_Wu8 255.0 OneToOne 0.00 255.0 /end CHARACTERISTIC
/begin CHARACTERISTIC ASMod_rO2EGFld_3_Bypass.Vector "Bypass Label (verwendet von ASCET), nicht editieren!/Bypass Table Vector Element (verwendet von ASCET), nicht editieren!" VALUE 0x80020A84 Val_Wu8 255.0 OneToOne 0.00 255.0 /end CHARACTERISTIC
/begin CHARACTERISTIC ASMod_rO2EGFld_3_Bypass.Channel "Bypass Label (verwendet von ASCET), nicht editieren!/Bypass Table Channel Element(verwendet von ASCET), nicht editieren!" VALUE 0x80020A85 Val_Wu8 255.0 OneToOne 0.00 255.0 /end CHARACTERISTIC
/begin CHARACTERISTIC ASMod_rO2EGFld_4_Bypass.Vector "Bypass Label (verwendet von ASCET), nicht editieren!/Bypass Table Vector Element (verwendet von ASCET), nicht editieren!" VALUE 0x80020A86 Val_Wu8 255.0 OneToOne 0.00 255.0 /end CHARACTERISTIC
/begin CHARACTERISTIC ASMod_rO2EGFld_4_Bypass.Channel "Bypass Label (verwendet von ASCET), nicht editieren!/Bypass Table Channel Element(verwendet von ASCET), nicht editieren!" VALUE 0x80020A87 Val_Wu8 255.0 OneToOne 0.00 255.0 /end CHARACTERISTIC
/begin CHARACTERISTIC ASMod_rO2EGFld_5_Bypass.Vector "Bypass Label (verwendet von ASCET), nicht editieren!/Bypass Table Vector Element (verwendet von ASCET), nicht editieren!" VALUE 0x80020A88 Val_Wu8 255.0 OneToOne 0.00 255.0 /end CHARACTERISTIC
/begin CHARACTERISTIC ASMod_rO2EGFld_5_Bypass.Channel "Bypass Label (verwendet von ASCET), nicht editieren!/Bypass Table Channel Element(verwendet von ASCET), nicht editieren!" VALUE 0x80020A89 Val_Wu8 255.0 OneToOne 0.00 255.0 /end CHARACTERISTIC
/begin CHARACTERISTIC ASMod_rO2EGFld_6_Bypass.Vector "Bypass Label (verwendet von ASCET), nicht editieren!/Bypass Table Vector Element (verwendet von ASCET), nicht editieren!" VALUE 0x80020A8A Val_Wu8 255.0 OneToOne 0.00 255.0 /end CHARACTERISTIC
/begin CHARACTERISTIC ASMod_rO2EGFld_6_Bypass.Channel "Bypass Label (verwendet von ASCET), nicht editieren!/Bypass Table Channel Element(verwendet von ASCET), nicht editieren!" VALUE 0x80020A8B Val_Wu8 255.0 OneToOne 0.00 255.0 /end CHARACTERISTIC
/begin CHARACTERISTIC ASMod_rO2ExhMnfUs_Bypass.Vector "Bypass Label (verwendet von ASCET), nicht editieren!/Bypass Table Vector Element (verwendet von ASCET), nicht editieren!" VALUE 0x80020A8C Val_Wu8 255.0 OneToOne 0.00 255.0 /end CHARACTERISTIC
/begin CHARACTERISTIC ASMod_rO2ExhMnfUs_Bypass.Channel "Bypass Label (verwendet von ASCET), nicht editieren!/Bypass Table Channel Element(verwendet von ASCET), nicht editieren!" VALUE 0x80020A8D Val_Wu8 255.0 OneToOne 0.00 255.0 /end CHARACTERISTIC
/begin CHARACTERISTIC ASMod_rRelPosECB_Bypass.Vector "Bypass Label (verwendet von ASCET), nicht editieren!/Bypass Table Vector Element (verwendet von ASCET), nicht editieren!" VALUE 0x80020A8E Val_Wu8 255.0 OneToOne 0.00 255.0 /end CHARACTERISTIC
/begin CHARACTERISTIC ASMod_rRelPosECB_Bypass.Channel "Bypass Label (verwendet von ASCET), nicht editieren!/Bypass Table Channel Element(verwendet von ASCET), nicht editieren!" VALUE 0x80020A8F Val_Wu8 255.0 OneToOne 0.00 255.0 /end CHARACTERISTIC
/begin CHARACTERISTIC ASMod_rRelPosTVA_Bypass.Vector "Bypass Label (verwendet von ASCET), nicht editieren!/Bypass Table Vector Element (verwendet von ASCET), nicht editieren!" VALUE 0x80020A90 Val_Wu8 255.0 OneToOne 0.00 255.0 /end CHARACTERISTIC
/begin CHARACTERISTIC ASMod_rRelPosTVA_Bypass.Channel "Bypass Label (verwendet von ASCET), nicht editieren!/Bypass Table Channel Element(verwendet von ASCET), nicht editieren!" VALUE 0x80020A91 Val_Wu8 255.0 OneToOne 0.00 255.0 /end CHARACTERISTIC
/begin CHARACTERISTIC ASMod_rRelPosVSA_Bypass.Vector "Bypass Label (verwendet von ASCET), nicht editieren!/Bypass Table Vector Element (verwendet von ASCET), nicht editieren!" VALUE 0x80020A92 Val_Wu8 255.0 OneToOne 0.00 255.0 /end CHARACTERISTIC
/begin CHARACTERISTIC ASMod_rRelPosVSA_Bypass.Channel "Bypass Label (verwendet von ASCET), nicht editieren!/Bypass Table Channel Element(verwendet von ASCET), nicht editieren!" VALUE 0x80020A93 Val_Wu8 255.0 OneToOne 0.00 255.0 /end CHARACTERISTIC
/begin CHARACTERISTIC ASMod_tCmprUs_r32_Bypass.Vector "Bypass Label (verwendet von ASCET), nicht editieren!/Bypass Table Vector Element (verwendet von ASCET), nicht editieren!" VALUE 0x80020A94 Val_Wu8 255.0 OneToOne 0.00 255.0 /end CHARACTERISTIC
/begin CHARACTERISTIC ASMod_tCmprUs_r32_Bypass.Channel "Bypass Label (verwendet von ASCET), nicht editieren!/Bypass Table Channel Element(verwendet von ASCET), nicht editieren!" VALUE 0x80020A95 Val_Wu8 255.0 OneToOne 0.00 255.0 /end CHARACTERISTIC
/begin CHARACTERISTIC ASMod_tEGFld_0_Bypass.Vector "Bypass Label (verwendet von ASCET), nicht editieren!/Bypass Table Vector Element (verwendet von ASCET), nicht editieren!" VALUE 0x80020A96 Val_Wu8 255.0 OneToOne 0.00 255.0 /end CHARACTERISTIC
/begin CHARACTERISTIC ASMod_tEGFld_0_Bypass.Channel "Bypass Label (verwendet von ASCET), nicht editieren!/Bypass Table Channel Element(verwendet von ASCET), nicht editieren!" VALUE 0x80020A97 Val_Wu8 255.0 OneToOne 0.00 255.0 /end CHARACTERISTIC
/begin CHARACTERISTIC ASMod_tEGFld_10_Bypass.Vector "Bypass Label (verwendet von ASCET), nicht editieren!/Bypass Table Vector Element (verwendet von ASCET), nicht editieren!" VALUE 0x80020A98 Val_Wu8 255.0 OneToOne 0.00 255.0 /end CHARACTERISTIC
/begin CHARACTERISTIC ASMod_tEGFld_10_Bypass.Channel "Bypass Label (verwendet von ASCET), nicht editieren!/Bypass Table Channel Element(verwendet von ASCET), nicht editieren!" VALUE 0x80020A99 Val_Wu8 255.0 OneToOne 0.00 255.0 /end CHARACTERISTIC
/begin CHARACTERISTIC ASMod_tEGFld_11_Bypass.Vector "Bypass Label (verwendet von ASCET), nicht editieren!/Bypass Table Vector Element (verwendet von ASCET), nicht editieren!" VALUE 0x80020A9A Val_Wu8 255.0 OneToOne 0.00 255.0 /end CHARACTERISTIC
/begin CHARACTERISTIC ASMod_tEGFld_11_Bypass.Channel "Bypass Label (verwendet von ASCET), nicht editieren!/Bypass Table Channel Element(verwendet von ASCET), nicht editieren!" VALUE 0x80020A9B Val_Wu8 255.0 OneToOne 0.00 255.0 /end CHARACTERISTIC
/begin CHARACTERISTIC ASMod_tEGFld_12_Bypass.Vector "Bypass Label (verwendet von ASCET), nicht editieren!/Bypass Table Vector Element (verwendet von ASCET), nicht editieren!" VALUE 0x80020A9C Val_Wu8 255.0 OneToOne 0.00 255.0 /end CHARACTERISTIC
/begin CHARACTERISTIC ASMod_tEGFld_12_Bypass.Channel "Bypass Label (verwendet von ASCET), nicht editieren!/Bypass Table Channel Element(verwendet von ASCET), nicht editieren!" VALUE 0x80020A9D Val_Wu8 255.0 OneToOne 0.00 255.0 /end CHARACTERISTIC
/begin CHARACTERISTIC ASMod_tEGFld_13_Bypass.Vector "Bypass Label (verwendet von ASCET), nicht editieren!/Bypass Table Vector Element (verwendet von ASCET), nicht editieren!" VALUE 0x80020A9E Val_Wu8 255.0 OneToOne 0.00 255.0 /end CHARACTERISTIC
/begin CHARACTERISTIC ASMod_tEGFld_13_Bypass.Channel "Bypass Label (verwendet von ASCET), nicht editieren!/Bypass Table Channel Element(verwendet von ASCET), nicht editieren!" VALUE 0x80020A9F Val_Wu8 255.0 OneToOne 0.00 255.0 /end CHARACTERISTIC
/begin CHARACTERISTIC ASMod_tEGFld_1_Bypass.Vector "Bypass Label (verwendet von ASCET), nicht editieren!/Bypass Table Vector Element (verwendet von ASCET), nicht editieren!" VALUE 0x80020AA0 Val_Wu8 255.0 OneToOne 0.00 255.0 /end CHARACTERISTIC
/begin CHARACTERISTIC ASMod_tEGFld_1_Bypass.Channel "Bypass Label (verwendet von ASCET), nicht editieren!/Bypass Table Channel Element(verwendet von ASCET), nicht editieren!" VALUE 0x80020AA1 Val_Wu8 255.0 OneToOne 0.00 255.0 /end CHARACTERISTIC
/begin CHARACTERISTIC ASMod_tEGFld_2_Bypass.Vector "Bypass Label (verwendet von ASCET), nicht editieren!/Bypass Table Vector Element (verwendet von ASCET), nicht editieren!" VALUE 0x80020AA2 Val_Wu8 255.0 OneToOne 0.00 255.0 /end CHARACTERISTIC
/begin CHARACTERISTIC ASMod_tEGFld_2_Bypass.Channel "Bypass Label (verwendet von ASCET), nicht editieren!/Bypass Table Channel Element(verwendet von ASCET), nicht editieren!" VALUE 0x80020AA3 Val_Wu8 255.0 OneToOne 0.00 255.0 /end CHARACTERISTIC
/begin CHARACTERISTIC ASMod_tEGFld_3_Bypass.Vector "Bypass Label (verwendet von ASCET), nicht editieren!/Bypass Table Vector Element (verwendet von ASCET), nicht editieren!" VALUE 0x80020AA4 Val_Wu8 255.0 OneToOne 0.00 255.0 /end CHARACTERISTIC
/begin CHARACTERISTIC ASMod_tEGFld_3_Bypass.Channel "Bypass Label (verwendet von ASCET), nicht editieren!/Bypass Table Channel Element(verwendet von ASCET), nicht editieren!" VALUE 0x80020AA5 Val_Wu8 255.0 OneToOne 0.00 255.0 /end CHARACTERISTIC
/begin CHARACTERISTIC ASMod_tEGFld_4_Bypass.Vector "Bypass Label (verwendet von ASCET), nicht editieren!/Bypass Table Vector Element (verwendet von ASCET), nicht editieren!" VALUE 0x80020AA6 Val_Wu8 255.0 OneToOne 0.00 255.0 /end CHARACTERISTIC
/begin CHARACTERISTIC ASMod_tEGFld_4_Bypass.Channel "Bypass Label (verwendet von ASCET), nicht editieren!/Bypass Table Channel Element(verwendet von ASCET), nicht editieren!" VALUE 0x80020AA7 Val_Wu8 255.0 OneToOne 0.00 255.0 /end CHARACTERISTIC
/begin CHARACTERISTIC ASMod_tEGFld_5_Bypass.Vector "Bypass Label (verwendet von ASCET), nicht editieren!/Bypass Table Vector Element (verwendet von ASCET), nicht editieren!" VALUE 0x80020AA8 Val_Wu8 255.0 OneToOne 0.00 255.0 /end CHARACTERISTIC
/begin CHARACTERISTIC ASMod_tEGFld_5_Bypass.Channel "Bypass Label (verwendet von ASCET), nicht editieren!/Bypass Table Channel Element(verwendet von ASCET), nicht editieren!" VALUE 0x80020AA9 Val_Wu8 255.0 OneToOne 0.00 255.0 /end CHARACTERISTIC
/begin CHARACTERISTIC ASMod_tEGFld_6_Bypass.Vector "Bypass Label (verwendet von ASCET), nicht editieren!/Bypass Table Vector Element (verwendet von ASCET), nicht editieren!" VALUE 0x80020AAA Val_Wu8 255.0 OneToOne 0.00 255.0 /end CHARACTERISTIC
/begin CHARACTERISTIC ASMod_tEGFld_6_Bypass.Channel "Bypass Label (verwendet von ASCET), nicht editieren!/Bypass Table Channel Element(verwendet von ASCET), nicht editieren!" VALUE 0x80020AAB Val_Wu8 255.0 OneToOne 0.00 255.0 /end CHARACTERISTIC
/begin CHARACTERISTIC ASMod_tEGFld_7_Bypass.Vector "Bypass Label (verwendet von ASCET), nicht editieren!/Bypass Table Vector Element (verwendet von ASCET), nicht editieren!" VALUE 0x80020AAC Val_Wu8 255.0 OneToOne 0.00 255.0 /end CHARACTERISTIC
/begin CHARACTERISTIC ASMod_tEGFld_7_Bypass.Channel "Bypass Label (verwendet von ASCET), nicht editieren!/Bypass Table Channel Element(verwendet von ASCET), nicht editieren!" VALUE 0x80020AAD Val_Wu8 255.0 OneToOne 0.00 255.0 /end CHARACTERISTIC
/begin CHARACTERISTIC ASMod_tEGFld_8_Bypass.Vector "Bypass Label (verwendet von ASCET), nicht editieren!/Bypass Table Vector Element (verwendet von ASCET), nicht editieren!" VALUE 0x80020AAE Val_Wu8 255.0 OneToOne 0.00 255.0 /end CHARACTERISTIC
/begin CHARACTERISTIC ASMod_tEGFld_8_Bypass.Channel "Bypass Label (verwendet von ASCET), nicht editieren!/Bypass Table Channel Element(verwendet von ASCET), nicht editieren!" VALUE 0x80020AAF Val_Wu8 255.0 OneToOne 0.00 255.0 /end CHARACTERISTIC
/begin CHARACTERISTIC ASMod_tEGFld_9_Bypass.Vector "Bypass Label (verwendet von ASCET), nicht editieren!/Bypass Table Vector Element (verwendet von ASCET), nicht editieren!" VALUE 0x80020AB0 Val_Wu8 255.0 OneToOne 0.00 255.0 /end CHARACTERISTIC
/begin CHARACTERISTIC ASMod_tEGFld_9_Bypass.Channel "Bypass Label (verwendet von ASCET), nicht editieren!/Bypass Table Channel Element(verwendet von ASCET), nicht editieren!" VALUE 0x80020AB1 Val_Wu8 255.0 OneToOne 0.00 255.0 /end CHARACTERISTIC
/begin CHARACTERISTIC ASMod_tEGRDs_Bypass.Vector "Bypass Label (verwendet von ASCET), nicht editieren!/Bypass Table Vector Element (verwendet von ASCET), nicht editieren!" VALUE 0x80020AB2 Val_Wu8 255.0 OneToOne 0.00 255.0 /end CHARACTERISTIC
/begin CHARACTERISTIC ASMod_tEGRDs_Bypass.Channel "Bypass Label (verwendet von ASCET), nicht editieren!/Bypass Table Channel Element(verwendet von ASCET), nicht editieren!" VALUE 0x80020AB3 Val_Wu8 255.0 OneToOne 0.00 255.0 /end CHARACTERISTIC
/begin CHARACTERISTIC ASMod_tEGRLPDs_r32_Bypass.Vector "/Bypass Table Vector Element (verwendet von ASCET), nicht editieren!" VALUE 0x80020AB4 Val_Wu8 255.0 OneToOne 0.00 255.0 /end CHARACTERISTIC
/begin CHARACTERISTIC ASMod_tEGRLPDs_r32_Bypass.Channel "/Bypass Table Channel Element(verwendet von ASCET), nicht editieren!" VALUE 0x80020AB5 Val_Wu8 255.0 OneToOne 0.00 255.0 /end CHARACTERISTIC
/begin CHARACTERISTIC ASMod_tExhMnfDs_Bypass.Vector "Bypass Label (verwendet von ASCET), nicht editieren!/Bypass Table Vector Element (verwendet von ASCET), nicht editieren!" VALUE 0x80020AB6 Val_Wu8 255.0 OneToOne 0.00 255.0 /end CHARACTERISTIC
/begin CHARACTERISTIC ASMod_tExhMnfDs_Bypass.Channel "Bypass Label (verwendet von ASCET), nicht editieren!/Bypass Table Channel Element(verwendet von ASCET), nicht editieren!" VALUE 0x80020AB7 Val_Wu8 255.0 OneToOne 0.00 255.0 /end CHARACTERISTIC
/begin CHARACTERISTIC ASMod_tExhMnfUs_Bypass.Vector "Bypass Label (verwendet von ASCET), nicht editieren!/Bypass Table Vector Element (verwendet von ASCET), nicht editieren!" VALUE 0x80020AB8 Val_Wu8 255.0 OneToOne 0.00 255.0 /end CHARACTERISTIC
/begin CHARACTERISTIC ASMod_tExhMnfUs_Bypass.Channel "Bypass Label (verwendet von ASCET), nicht editieren!/Bypass Table Channel Element(verwendet von ASCET), nicht editieren!" VALUE 0x80020AB9 Val_Wu8 255.0 OneToOne 0.00 255.0 /end CHARACTERISTIC
/begin CHARACTERISTIC ASMod_tIntMnfDsRef_Bypass.Vector "Bypass Label (verwendet von ASCET), nicht editieren!/Bypass Table Vector Element (verwendet von ASCET), nicht editieren!" VALUE 0x80020ABA Val_Wu8 255.0 OneToOne 0.00 255.0 /end CHARACTERISTIC
/begin CHARACTERISTIC ASMod_tIntMnfDsRef_Bypass.Channel "Bypass Label (verwendet von ASCET), nicht editieren!/Bypass Table Channel Element(verwendet von ASCET), nicht editieren!" VALUE 0x80020ABB Val_Wu8 255.0 OneToOne 0.00 255.0 /end CHARACTERISTIC
/begin CHARACTERISTIC ASMod_tIntMnfDs_Bypass.Vector "Bypass Label (verwendet von ASCET), nicht editieren!/Bypass Table Vector Element (verwendet von ASCET), nicht editieren!" VALUE 0x80020ABC Val_Wu8 255.0 OneToOne 0.00 255.0 /end CHARACTERISTIC
/begin CHARACTERISTIC ASMod_tIntMnfDs_Bypass.Channel "Bypass Label (verwendet von ASCET), nicht editieren!/Bypass Table Channel Element(verwendet von ASCET), nicht editieren!" VALUE 0x80020ABD Val_Wu8 255.0 OneToOne 0.00 255.0 /end CHARACTERISTIC
/begin CHARACTERISTIC ASMod_tIntMnfUs_Bypass.Vector "Bypass Label (verwendet von ASCET), nicht editieren!/Bypass Table Vector Element (verwendet von ASCET), nicht editieren!" VALUE 0x80020ABE Val_Wu8 255.0 OneToOne 0.00 255.0 /end CHARACTERISTIC
/begin CHARACTERISTIC ASMod_tIntMnfUs_Bypass.Channel "Bypass Label (verwendet von ASCET), nicht editieren!/Bypass Table Channel Element(verwendet von ASCET), nicht editieren!" VALUE 0x80020ABF Val_Wu8 255.0 OneToOne 0.00 255.0 /end CHARACTERISTIC
/begin CHARACTERISTIC ASMod_tPFltSurfSim_Bypass.Vector "Bypass Label (verwendet von ASCET), nicht editieren!/Bypass Table Vector Element (verwendet von ASCET), nicht editieren!" VALUE 0x80020AC0 Val_Wu8 255.0 OneToOne 0.00 255.0 /end CHARACTERISTIC
/begin CHARACTERISTIC ASMod_tPFltSurfSim_Bypass.Channel "Bypass Label (verwendet von ASCET), nicht editieren!/Bypass Table Channel Element(verwendet von ASCET), nicht editieren!" VALUE 0x80020AC1 Val_Wu8 255.0 OneToOne 0.00 255.0 /end CHARACTERISTIC
/begin CHARACTERISTIC ASMod_tWallFld_0_Bypass.Vector "Bypass Label (verwendet von ASCET), nicht editieren!/Bypass Table Vector Element (verwendet von ASCET), nicht editieren!" VALUE 0x80020AC2 Val_Wu8 255.0 OneToOne 0.00 255.0 /end CHARACTERISTIC
/begin CHARACTERISTIC ASMod_tWallFld_0_Bypass.Channel "Bypass Label (verwendet von ASCET), nicht editieren!/Bypass Table Channel Element(verwendet von ASCET), nicht editieren!" VALUE 0x80020AC3 Val_Wu8 255.0 OneToOne 0.00 255.0 /end CHARACTERISTIC
/begin CHARACTERISTIC ASMod_tWallFld_1_Bypass.Vector "Bypass Label (verwendet von ASCET), nicht editieren!/Bypass Table Vector Element (verwendet von ASCET), nicht editieren!" VALUE 0x80020AC4 Val_Wu8 255.0 OneToOne 0.00 255.0 /end CHARACTERISTIC
/begin CHARACTERISTIC ASMod_tWallFld_1_Bypass.Channel "Bypass Label (verwendet von ASCET), nicht editieren!/Bypass Table Channel Element(verwendet von ASCET), nicht editieren!" VALUE 0x80020AC5 Val_Wu8 255.0 OneToOne 0.00 255.0 /end CHARACTERISTIC
/begin CHARACTERISTIC ASMod_tWallFld_2_Bypass.Vector "Bypass Label (verwendet von ASCET), nicht editieren!/Bypass Table Vector Element (verwendet von ASCET), nicht editieren!" VALUE 0x80020AC6 Val_Wu8 255.0 OneToOne 0.00 255.0 /end CHARACTERISTIC
/begin CHARACTERISTIC ASMod_tWallFld_2_Bypass.Channel "Bypass Label (verwendet von ASCET), nicht editieren!/Bypass Table Channel Element(verwendet von ASCET), nicht editieren!" VALUE 0x80020AC7 Val_Wu8 255.0 OneToOne 0.00 255.0 /end CHARACTERISTIC
/begin CHARACTERISTIC ASMod_tWallFld_3_Bypass.Vector "Bypass Label (verwendet von ASCET), nicht editieren!/Bypass Table Vector Element (verwendet von ASCET), nicht editieren!" VALUE 0x80020AC8 Val_Wu8 255.0 OneToOne 0.00 255.0 /end CHARACTERISTIC
/begin CHARACTERISTIC ASMod_tWallFld_3_Bypass.Channel "Bypass Label (verwendet von ASCET), nicht editieren!/Bypass Table Channel Element(verwendet von ASCET), nicht editieren!" VALUE 0x80020AC9 Val_Wu8 255.0 OneToOne 0.00 255.0 /end CHARACTERISTIC
/begin CHARACTERISTIC ASMod_tWallFld_4_Bypass.Vector "Bypass Label (verwendet von ASCET), nicht editieren!/Bypass Table Vector Element (verwendet von ASCET), nicht editieren!" VALUE 0x80020ACA Val_Wu8 255.0 OneToOne 0.00 255.0 /end CHARACTERISTIC
/begin CHARACTERISTIC ASMod_tWallFld_4_Bypass.Channel "Bypass Label (verwendet von ASCET), nicht editieren!/Bypass Table Channel Element(verwendet von ASCET), nicht editieren!" VALUE 0x80020ACB Val_Wu8 255.0 OneToOne 0.00 255.0 /end CHARACTERISTIC
/begin CHARACTERISTIC ASMod_tWallFld_5_Bypass.Vector "Bypass Label (verwendet von ASCET), nicht editieren!/Bypass Table Vector Element (verwendet von ASCET), nicht editieren!" VALUE 0x80020ACC Val_Wu8 255.0 OneToOne 0.00 255.0 /end CHARACTERISTIC
/begin CHARACTERISTIC ASMod_tWallFld_5_Bypass.Channel "Bypass Label (verwendet von ASCET), nicht editieren!/Bypass Table Channel Element(verwendet von ASCET), nicht editieren!" VALUE 0x80020ACD Val_Wu8 255.0 OneToOne 0.00 255.0 /end CHARACTERISTIC
/begin CHARACTERISTIC ASMod_tWallFld_6_Bypass.Vector "Bypass Label (verwendet von ASCET), nicht editieren!/Bypass Table Vector Element (verwendet von ASCET), nicht editieren!" VALUE 0x80020ACE Val_Wu8 255.0 OneToOne 0.00 255.0 /end CHARACTERISTIC
/begin CHARACTERISTIC ASMod_tWallFld_6_Bypass.Channel "Bypass Label (verwendet von ASCET), nicht editieren!/Bypass Table Channel Element(verwendet von ASCET), nicht editieren!" VALUE 0x80020ACF Val_Wu8 255.0 OneToOne 0.00 255.0 /end CHARACTERISTIC
/begin CHARACTERISTIC BypEtk_SegStimuli_C "Aktivieren des segment-synchronen Raster beim ETK-Bypass (0: nicht aktiv; andere Werte: aktiviert)" VALUE 0x80037A78 Val_Wu32 4294967295.00 OneToOne 0.00 4294967295.00 /end CHARACTERISTIC
/begin CHARACTERISTIC BypEtk_stAscet_C "Aktivieren des ETK-Bypass (0: nicht aktiv; 1: start ETK-Bypass, wenn der Wert zuvor 0 war; 2: sofortiger Start des ETK-Bypass)" VALUE 0x80037A7C Val_Wu8 255.0 OneToOne 0.00 255.0 /end CHARACTERISTIC
/begin CHARACTERISTIC BypEtk_TStimuli_C "Aktivieren des t-synchronen beim ETK-Bypass (0: nicht aktiv; andere Werte: aktiviert)" VALUE 0x80037A80 Val_Wu32 4294967295.00 OneToOne 0.00 4294967295.00 /end CHARACTERISTIC
/begin CHARACTERISTIC Calwup_swtWakeupEnaCpl_C "Freigabe (Komplement) des Calibration Wake-Up mit 90 nur bei Applikations-Steuergeräten" VALUE 0x80037BEE Val_Wu8 255.0 OneToOne 0.00 255.0 /end CHARACTERISTIC
/begin CHARACTERISTIC Calwup_swtWakeupEna_C "Freigabe des Calibration Wake-Up mit 165 nur bei Applikations-Steuergeräten" VALUE 0x80037BEF Val_Wu8 255.0 OneToOne 0.00 255.0 /end CHARACTERISTIC
/begin CHARACTERISTIC CnvLead_qCurr_Bypass.Vector "Bypass Label (verwendet von ASCET), nicht editieren!/Bypass Table Vector Element (verwendet von ASCET), nicht editieren!" VALUE 0x80020AD0 Val_Wu8 255.0 OneToOne 0.00 255.0 /end CHARACTERISTIC
/begin CHARACTERISTIC CnvLead_qCurr_Bypass.Channel "Bypass Label (verwendet von ASCET), nicht editieren!/Bypass Table Channel Element(verwendet von ASCET), nicht editieren!" VALUE 0x80020AD1 Val_Wu8 255.0 OneToOne 0.00 255.0 /end CHARACTERISTIC
/begin CHARACTERISTIC CnvLead_qRaw_Bypass.Vector "Bypass Label (verwendet von ASCET), nicht editieren!/Bypass Table Vector Element (verwendet von ASCET), nicht editieren!" VALUE 0x80020AD2 Val_Wu8 255.0 OneToOne 0.00 255.0 /end CHARACTERISTIC
/begin CHARACTERISTIC CnvLead_qRaw_Bypass.Channel "Bypass Label (verwendet von ASCET), nicht editieren!/Bypass Table Channel Element(verwendet von ASCET), nicht editieren!" VALUE 0x80020AD3 Val_Wu8 255.0 OneToOne 0.00 255.0 /end CHARACTERISTIC
/begin CHARACTERISTIC CnvSet_etaCurr_Bypass.Vector "Bypass Label (verwendet von ASCET), nicht editieren!/Bypass Table Vector Element (verwendet von ASCET), nicht editieren!" VALUE 0x80020AD4 Val_Wu8 255.0 OneToOne 0.00 255.0 /end CHARACTERISTIC
/begin CHARACTERISTIC CnvSet_etaCurr_Bypass.Channel "Bypass Label (verwendet von ASCET), nicht editieren!/Bypass Table Channel Element(verwendet von ASCET), nicht editieren!" VALUE 0x80020AD5 Val_Wu8 255.0 OneToOne 0.00 255.0 /end CHARACTERISTIC
/begin CHARACTERISTIC CnvSet_qMI_Bypass.Vector "Bypass Label (verwendet von ASCET), nicht editieren!/Bypass Table Vector Element (verwendet von ASCET), nicht editieren!" VALUE 0x80020AD6 Val_Wu8 255.0 OneToOne 0.00 255.0 /end CHARACTERISTIC
/begin CHARACTERISTIC CnvSet_qMI_Bypass.Channel "Bypass Label (verwendet von ASCET), nicht editieren!/Bypass Table Channel Element(verwendet von ASCET), nicht editieren!" VALUE 0x80020AD7 Val_Wu8 255.0 OneToOne 0.00 255.0 /end CHARACTERISTIC
/begin CHARACTERISTIC CnvSet_qPiI1_Bypass.Vector "Bypass Label (verwendet von ASCET), nicht editieren!/Bypass Table Vector Element (verwendet von ASCET), nicht editieren!" VALUE 0x80020AD8 Val_Wu8 255.0 OneToOne 0.00 255.0 /end CHARACTERISTIC
/begin CHARACTERISTIC CnvSet_qPiI1_Bypass.Channel "Bypass Label (verwendet von ASCET), nicht editieren!/Bypass Table Channel Element(verwendet von ASCET), nicht editieren!" VALUE 0x80020AD9 Val_Wu8 255.0 OneToOne 0.00 255.0 /end CHARACTERISTIC
/begin CHARACTERISTIC CnvSet_qPiI2_Bypass.Vector "Bypass Label (verwendet von ASCET), nicht editieren!/Bypass Table Vector Element (verwendet von ASCET), nicht editieren!" VALUE 0x80020ADA Val_Wu8 255.0 OneToOne 0.00 255.0 /end CHARACTERISTIC
/begin CHARACTERISTIC CnvSet_qPiI2_Bypass.Channel "Bypass Label (verwendet von ASCET), nicht editieren!/Bypass Table Channel Element(verwendet von ASCET), nicht editieren!" VALUE 0x80020ADB Val_Wu8 255.0 OneToOne 0.00 255.0 /end CHARACTERISTIC
/begin CHARACTERISTIC CnvSet_qPiI3_Bypass.Vector "Bypass Label (verwendet von ASCET), nicht editieren!/Bypass Table Vector Element (verwendet von ASCET), nicht editieren!" VALUE 0x80020ADC Val_Wu8 255.0 OneToOne 0.00 255.0 /end CHARACTERISTIC
/begin CHARACTERISTIC CnvSet_qPiI3_Bypass.Channel "Bypass Label (verwendet von ASCET), nicht editieren!/Bypass Table Channel Element(verwendet von ASCET), nicht editieren!" VALUE 0x80020ADD Val_Wu8 255.0 OneToOne 0.00 255.0 /end CHARACTERISTIC
/begin CHARACTERISTIC CnvSet_qPoI1_Bypass.Vector "Bypass Label (verwendet von ASCET), nicht editieren!/Bypass Table Vector Element (verwendet von ASCET), nicht editieren!" VALUE 0x80020ADE Val_Wu8 255.0 OneToOne 0.00 255.0 /end CHARACTERISTIC
/begin CHARACTERISTIC CnvSet_qPoI1_Bypass.Channel "Bypass Label (verwendet von ASCET), nicht editieren!/Bypass Table Channel Element(verwendet von ASCET), nicht editieren!" VALUE 0x80020ADF Val_Wu8 255.0 OneToOne 0.00 255.0 /end CHARACTERISTIC
/begin CHARACTERISTIC CnvSet_qPoI2_Bypass.Vector "Bypass Label (verwendet von ASCET), nicht editieren!/Bypass Table Vector Element (verwendet von ASCET), nicht editieren!" VALUE 0x80020AE0 Val_Wu8 255.0 OneToOne 0.00 255.0 /end CHARACTERISTIC
/begin CHARACTERISTIC CnvSet_qPoI2_Bypass.Channel "Bypass Label (verwendet von ASCET), nicht editieren!/Bypass Table Channel Element(verwendet von ASCET), nicht editieren!" VALUE 0x80020AE1 Val_Wu8 255.0 OneToOne 0.00 255.0 /end CHARACTERISTIC
/begin CHARACTERISTIC CnvSet_qSet_Bypass.Vector "Bypass Label (verwendet von ASCET), nicht editieren!/Bypass Table Vector Element (verwendet von ASCET), nicht editieren!" VALUE 0x80020AE2 Val_Wu8 255.0 OneToOne 0.00 255.0 /end CHARACTERISTIC
/begin CHARACTERISTIC CnvSet_qSet_Bypass.Channel "Bypass Label (verwendet von ASCET), nicht editieren!/Bypass Table Channel Element(verwendet von ASCET), nicht editieren!" VALUE 0x80020AE3 Val_Wu8 255.0 OneToOne 0.00 255.0 /end CHARACTERISTIC
/begin CHARACTERISTIC CnvSet_qStrt_Bypass.Vector "Bypass Label (verwendet von ASCET), nicht editieren!/Bypass Table Vector Element (verwendet von ASCET), nicht editieren!" VALUE 0x80020AE4 Val_Wu8 255.0 OneToOne 0.00 255.0 /end CHARACTERISTIC
/begin CHARACTERISTIC CnvSet_qStrt_Bypass.Channel "Bypass Label (verwendet von ASCET), nicht editieren!/Bypass Table Channel Element(verwendet von ASCET), nicht editieren!" VALUE 0x80020AE5 Val_Wu8 255.0 OneToOne 0.00 255.0 /end CHARACTERISTIC
/begin CHARACTERISTIC CoEOM_facRmpVal_Bypass.Vector "Bypass Label (verwendet von ASCET), nicht editieren!/Bypass Table Vector Element (verwendet von ASCET), nicht editieren!" VALUE 0x80020AE6 Val_Wu8 255.0 OneToOne 0.00 255.0 /end CHARACTERISTIC
/begin CHARACTERISTIC CoEOM_facRmpVal_Bypass.Channel "Bypass Label (verwendet von ASCET), nicht editieren!/Bypass Table Channel Element(verwendet von ASCET), nicht editieren!" VALUE 0x80020AE7 Val_Wu8 255.0 OneToOne 0.00 255.0 /end CHARACTERISTIC
/begin CHARACTERISTIC CoEOM_stOpModeDes_Bypass.Vector "Bypass Label (verwendet von ASCET), nicht editieren!/Bypass Table Vector Element (verwendet von ASCET), nicht editieren!" VALUE 0x80020AE8 Val_Wu8 255.0 OneToOne 0.00 255.0 /end CHARACTERISTIC
/begin CHARACTERISTIC CoEOM_stOpModeDes_Bypass.Channel "Bypass Label (verwendet von ASCET), nicht editieren!/Bypass Table Channel Element(verwendet von ASCET), nicht editieren!" VALUE 0x80020AE9 Val_Wu8 255.0 OneToOne 0.00 255.0 /end CHARACTERISTIC
/begin CHARACTERISTIC CoEOM_tiOpModeChngTSync_Bypass.Vector "Bypass Label (verwendet von ASCET), nicht editieren!/Bypass Table Vector Element (verwendet von ASCET), nicht editieren!" VALUE 0x80020AEA Val_Wu8 255.0 OneToOne 0.00 255.0 /end CHARACTERISTIC
/begin CHARACTERISTIC CoEOM_tiOpModeChngTSync_Bypass.Channel "Bypass Label (verwendet von ASCET), nicht editieren!/Bypass Table Channel Element(verwendet von ASCET), nicht editieren!" VALUE 0x80020AEB Val_Wu8 255.0 OneToOne 0.00 255.0 /end CHARACTERISTIC
/begin CHARACTERISTIC CoETS_trqInrCurrFast_Bypass.Vector "Bypass Label (verwendet von ASCET), nicht editieren!/Bypass Table Vector Element (verwendet von ASCET), nicht editieren!" VALUE 0x80020AEC Val_Wu8 255.0 OneToOne 0.00 255.0 /end CHARACTERISTIC
/begin CHARACTERISTIC CoETS_trqInrCurrFast_Bypass.Channel "Bypass Label (verwendet von ASCET), nicht editieren!/Bypass Table Channel Element(verwendet von ASCET), nicht editieren!" VALUE 0x80020AED Val_Wu8 255.0 OneToOne 0.00 255.0 /end CHARACTERISTIC
/begin CHARACTERISTIC CoETS_trqInrLeadFast_Bypass.Vector "Bypass Label (verwendet von ASCET), nicht editieren!/Bypass Table Vector Element (verwendet von ASCET), nicht editieren!" VALUE 0x80020AEE Val_Wu8 255.0 OneToOne 0.00 255.0 /end CHARACTERISTIC
/begin CHARACTERISTIC CoETS_trqInrLeadFast_Bypass.Channel "Bypass Label (verwendet von ASCET), nicht editieren!/Bypass Table Channel Element(verwendet von ASCET), nicht editieren!" VALUE 0x80020AEF Val_Wu8 255.0 OneToOne 0.00 255.0 /end CHARACTERISTIC
/begin CHARACTERISTIC CoETS_trqInrSetSlow_Bypass.Vector "Bypass Label (verwendet von ASCET), nicht editieren!/Bypass Table Vector Element (verwendet von ASCET), nicht editieren!" VALUE 0x80020AF0 Val_Wu8 255.0 OneToOne 0.00 255.0 /end CHARACTERISTIC
/begin CHARACTERISTIC CoETS_trqInrSetSlow_Bypass.Channel "Bypass Label (verwendet von ASCET), nicht editieren!/Bypass Table Channel Element(verwendet von ASCET), nicht editieren!" VALUE 0x80020AF1 Val_Wu8 255.0 OneToOne 0.00 255.0 /end CHARACTERISTIC
/begin CHARACTERISTIC CoPT_trqDesCompEng_Bypass.Vector "Bypass Label (verwendet von ASCET), nicht editieren!/Bypass Table Vector Element (verwendet von ASCET), nicht editieren!" VALUE 0x80020AF2 Val_Wu8 255.0 OneToOne 0.00 255.0 /end CHARACTERISTIC
/begin CHARACTERISTIC CoPT_trqDesCompEng_Bypass.Channel "Bypass Label (verwendet von ASCET), nicht editieren!/Bypass Table Channel Element(verwendet von ASCET), nicht editieren!" VALUE 0x80020AF3 Val_Wu8 255.0 OneToOne 0.00 255.0 /end CHARACTERISTIC
/begin CHARACTERISTIC CoVMD_trqCrCtl_Bypass.Vector "Bypass Label (verwendet von ASCET), nicht editieren!/Bypass Table Vector Element (verwendet von ASCET), nicht editieren!" VALUE 0x80020AF4 Val_Wu8 255.0 OneToOne 0.00 255.0 /end CHARACTERISTIC
/begin CHARACTERISTIC CoVMD_trqCrCtl_Bypass.Channel "Bypass Label (verwendet von ASCET), nicht editieren!/Bypass Table Channel Element(verwendet von ASCET), nicht editieren!" VALUE 0x80020AF5 Val_Wu8 255.0 OneToOne 0.00 255.0 /end CHARACTERISTIC
/begin CHARACTERISTIC DiaDem_nSetPHi_Bypass.Vector "Bypass Label (verwendet von ASCET), nicht editieren!/Bypass Table Vector Element (verwendet von ASCET), nicht editieren!" VALUE 0x80020AF6 Val_Wu8 255.0 OneToOne 0.00 255.0 /end CHARACTERISTIC
/begin CHARACTERISTIC DiaDem_nSetPHi_Bypass.Channel "Bypass Label (verwendet von ASCET), nicht editieren!/Bypass Table Channel Element(verwendet von ASCET), nicht editieren!" VALUE 0x80020AF7 Val_Wu8 255.0 OneToOne 0.00 255.0 /end CHARACTERISTIC
/begin CHARACTERISTIC DiaDem_nSetPLo_Bypass.Vector "Bypass Label (verwendet von ASCET), nicht editieren!/Bypass Table Vector Element (verwendet von ASCET), nicht editieren!" VALUE 0x80020AF8 Val_Wu8 255.0 OneToOne 0.00 255.0 /end CHARACTERISTIC
/begin CHARACTERISTIC DiaDem_nSetPLo_Bypass.Channel "Bypass Label (verwendet von ASCET), nicht editieren!/Bypass Table Channel Element(verwendet von ASCET), nicht editieren!" VALUE 0x80020AF9 Val_Wu8 255.0 OneToOne 0.00 255.0 /end CHARACTERISTIC
/begin CHARACTERISTIC DiaDem_trqReq_Bypass.Vector "Bypass Label (verwendet von ASCET), nicht editieren!/Bypass Table Vector Element (verwendet von ASCET), nicht editieren!" VALUE 0x80020AFA Val_Wu8 255.0 OneToOne 0.00 255.0 /end CHARACTERISTIC
/begin CHARACTERISTIC DiaDem_trqReq_Bypass.Channel "Bypass Label (verwendet von ASCET), nicht editieren!/Bypass Table Channel Element(verwendet von ASCET), nicht editieren!" VALUE 0x80020AFB Val_Wu8 255.0 OneToOne 0.00 255.0 /end CHARACTERISTIC
/begin CHARACTERISTIC DStgy_dmNH3CurrAdd_mp_Bypass.Vector "Bypass Label (verwendet von ASCET), nicht editieren!/Bypass Table Vector Element (verwendet von ASCET), nicht editieren!" VALUE 0x80020AFC Val_Wu8 255.0 OneToOne 0.00 255.0 /end CHARACTERISTIC
/begin CHARACTERISTIC DStgy_dmNH3CurrAdd_mp_Bypass.Channel "Bypass Label (verwendet von ASCET), nicht editieren!/Bypass Table Channel Element(verwendet von ASCET), nicht editieren!" VALUE 0x80020AFD Val_Wu8 255.0 OneToOne 0.00 255.0 /end CHARACTERISTIC
/begin CHARACTERISTIC DStgy_dmNH3Curr_Bypass.Vector "Bypass Label (verwendet von ASCET), nicht editieren!/Bypass Table Vector Element (verwendet von ASCET), nicht editieren!" VALUE 0x80020AFE Val_Wu8 255.0 OneToOne 0.00 255.0 /end CHARACTERISTIC
/begin CHARACTERISTIC DStgy_dmNH3Curr_Bypass.Channel "Bypass Label (verwendet von ASCET), nicht editieren!/Bypass Table Channel Element(verwendet von ASCET), nicht editieren!" VALUE 0x80020AFF Val_Wu8 255.0 OneToOne 0.00 255.0 /end CHARACTERISTIC
/begin CHARACTERISTIC DStgy_dmRdcAgDesAdd_mp_Bypass.Vector "/Bypass Table Vector Element (verwendet von ASCET), nicht editieren!" VALUE 0x80020B00 Val_Wu8 255.0 OneToOne 0.00 255.0 /end CHARACTERISTIC
/begin CHARACTERISTIC DStgy_dmRdcAgDesAdd_mp_Bypass.Channel "/Bypass Table Channel Element(verwendet von ASCET), nicht editieren!" VALUE 0x80020B01 Val_Wu8 255.0 OneToOne 0.00 255.0 /end CHARACTERISTIC
/begin CHARACTERISTIC DStgy_dmRdcAgDes_Bypass.Vector "/Bypass Table Vector Element (verwendet von ASCET), nicht editieren!" VALUE 0x80020B02 Val_Wu8 255.0 OneToOne 0.00 255.0 /end CHARACTERISTIC
/begin CHARACTERISTIC DStgy_dmRdcAgDes_Bypass.Channel "/Bypass Table Channel Element(verwendet von ASCET), nicht editieren!" VALUE 0x80020B03 Val_Wu8 255.0 OneToOne 0.00 255.0 /end CHARACTERISTIC
/begin CHARACTERISTIC EGRVlvLP_rEGR_Bypass.Vector "/Bypass Table Vector Element (verwendet von ASCET), nicht editieren!" VALUE 0x80020B04 Val_Wu8 255.0 OneToOne 0.00 255.0 /end CHARACTERISTIC
/begin CHARACTERISTIC EGRVlvLP_rEGR_Bypass.Channel "/Bypass Table Channel Element(verwendet von ASCET), nicht editieren!" VALUE 0x80020B05 Val_Wu8 255.0 OneToOne 0.00 255.0 /end CHARACTERISTIC
/begin CHARACTERISTIC EGRVlvLP_rPs_Bypass.Vector "/Bypass Table Vector Element (verwendet von ASCET), nicht editieren!" VALUE 0x80020B06 Val_Wu8 255.0 OneToOne 0.00 255.0 /end CHARACTERISTIC
/begin CHARACTERISTIC EGRVlvLP_rPs_Bypass.Channel "/Bypass Table Channel Element(verwendet von ASCET), nicht editieren!" VALUE 0x80020B07 Val_Wu8 255.0 OneToOne 0.00 255.0 /end CHARACTERISTIC
/begin CHARACTERISTIC EGRVlvLP_r_Bypass.Vector "Bypass Label (verwendet von ASCET), nicht editieren!/Bypass Table Vector Element (verwendet von ASCET), nicht editieren!" VALUE 0x80020B08 Val_Wu8 255.0 OneToOne 0.00 255.0 /end CHARACTERISTIC
/begin CHARACTERISTIC EGRVlvLP_r_Bypass.Channel "Bypass Label (verwendet von ASCET), nicht editieren!/Bypass Table Channel Element(verwendet von ASCET), nicht editieren!" VALUE 0x80020B09 Val_Wu8 255.0 OneToOne 0.00 255.0 /end CHARACTERISTIC
/begin CHARACTERISTIC EGRVlv_rEGR_Bypass.Vector "Bypass Label (verwendet von ASCET), nicht editieren!/Bypass Table Vector Element (verwendet von ASCET), nicht editieren!" VALUE 0x80020B0A Val_Wu8 255.0 OneToOne 0.00 255.0 /end CHARACTERISTIC
/begin CHARACTERISTIC EGRVlv_rEGR_Bypass.Channel "Bypass Label (verwendet von ASCET), nicht editieren!/Bypass Table Channel Element(verwendet von ASCET), nicht editieren!" VALUE 0x80020B0B Val_Wu8 255.0 OneToOne 0.00 255.0 /end CHARACTERISTIC
/begin CHARACTERISTIC EGRVlv_rPs_Bypass.Vector "/Bypass Table Vector Element (verwendet von ASCET), nicht editieren!" VALUE 0x80020B0C Val_Wu8 255.0 OneToOne 0.00 255.0 /end CHARACTERISTIC
/begin CHARACTERISTIC EGRVlv_rPs_Bypass.Channel "/Bypass Table Channel Element(verwendet von ASCET), nicht editieren!" VALUE 0x80020B0D Val_Wu8 255.0 OneToOne 0.00 255.0 /end CHARACTERISTIC
/begin CHARACTERISTIC EGRVlv_r_Bypass.Vector "Bypass Label (verwendet von ASCET), nicht editieren!/Bypass Table Vector Element (verwendet von ASCET), nicht editieren!" VALUE 0x80020B0E Val_Wu8 255.0 OneToOne 0.00 255.0 /end CHARACTERISTIC
/begin CHARACTERISTIC EGRVlv_r_Bypass.Channel "Bypass Label (verwendet von ASCET), nicht editieren!/Bypass Table Channel Element(verwendet von ASCET), nicht editieren!" VALUE 0x80020B0F Val_Wu8 255.0 OneToOne 0.00 255.0 /end CHARACTERISTIC
/begin CHARACTERISTIC EngDem_trqInrLimLead_Bypass.Vector "Bypass Label (verwendet von ASCET), nicht editieren!/Bypass Table Vector Element (verwendet von ASCET), nicht editieren!" VALUE 0x80020B10 Val_Wu8 255.0 OneToOne 0.00 255.0 /end CHARACTERISTIC
/begin CHARACTERISTIC EngDem_trqInrLimLead_Bypass.Channel "Bypass Label (verwendet von ASCET), nicht editieren!/Bypass Table Channel Element(verwendet von ASCET), nicht editieren!" VALUE 0x80020B11 Val_Wu8 255.0 OneToOne 0.00 255.0 /end CHARACTERISTIC
/begin CHARACTERISTIC EngDem_trqInrLim_Bypass.Vector "Bypass Label (verwendet von ASCET), nicht editieren!/Bypass Table Vector Element (verwendet von ASCET), nicht editieren!" VALUE 0x80020B12 Val_Wu8 255.0 OneToOne 0.00 255.0 /end CHARACTERISTIC
/begin CHARACTERISTIC EngDem_trqInrLim_Bypass.Channel "Bypass Label (verwendet von ASCET), nicht editieren!/Bypass Table Channel Element(verwendet von ASCET), nicht editieren!" VALUE 0x80020B13 Val_Wu8 255.0 OneToOne 0.00 255.0 /end CHARACTERISTIC
/begin CHARACTERISTIC EngPrt_trqLimMech_Bypass.Vector "Bypass Label (verwendet von ASCET), nicht editieren!/Bypass Table Vector Element (verwendet von ASCET), nicht editieren!" VALUE 0x80020B14 Val_Wu8 255.0 OneToOne 0.00 255.0 /end CHARACTERISTIC
/begin CHARACTERISTIC EngPrt_trqLimMech_Bypass.Channel "Bypass Label (verwendet von ASCET), nicht editieren!/Bypass Table Channel Element(verwendet von ASCET), nicht editieren!" VALUE 0x80020B15 Val_Wu8 255.0 OneToOne 0.00 255.0 /end CHARACTERISTIC
/begin CHARACTERISTIC EngPrt_trqLimOvhtPrv_Bypass.Vector "Bypass Label (verwendet von ASCET), nicht editieren!/Bypass Table Vector Element (verwendet von ASCET), nicht editieren!" VALUE 0x80020B16 Val_Wu8 255.0 OneToOne 0.00 255.0 /end CHARACTERISTIC
/begin CHARACTERISTIC EngPrt_trqLimOvhtPrv_Bypass.Channel "Bypass Label (verwendet von ASCET), nicht editieren!/Bypass Table Channel Element(verwendet von ASCET), nicht editieren!" VALUE 0x80020B17 Val_Wu8 255.0 OneToOne 0.00 255.0 /end CHARACTERISTIC
/begin CHARACTERISTIC EngPrt_trqLim_Bypass.Vector "Bypass Label (verwendet von ASCET), nicht editieren!/Bypass Table Vector Element (verwendet von ASCET), nicht editieren!" VALUE 0x80020B18 Val_Wu8 255.0 OneToOne 0.00 255.0 /end CHARACTERISTIC
/begin CHARACTERISTIC EngPrt_trqLim_Bypass.Channel "Bypass Label (verwendet von ASCET), nicht editieren!/Bypass Table Channel Element(verwendet von ASCET), nicht editieren!" VALUE 0x80020B19 Val_Wu8 255.0 OneToOne 0.00 255.0 /end CHARACTERISTIC
/begin CHARACTERISTIC EngReq_trqInrLimSmk_Bypass.Vector "Bypass Label (verwendet von ASCET), nicht editieren!/Bypass Table Vector Element (verwendet von ASCET), nicht editieren!" VALUE 0x80020B1A Val_Wu8 255.0 OneToOne 0.00 255.0 /end CHARACTERISTIC
/begin CHARACTERISTIC EngReq_trqInrLimSmk_Bypass.Channel "Bypass Label (verwendet von ASCET), nicht editieren!/Bypass Table Channel Element(verwendet von ASCET), nicht editieren!" VALUE 0x80020B1B Val_Wu8 255.0 OneToOne 0.00 255.0 /end CHARACTERISTIC
/begin CHARACTERISTIC FBC_q_Bypass.Vector "Bypass Label (verwendet von ASCET), nicht editieren!/Bypass Table Vector Element (verwendet von ASCET), nicht editieren!" VALUE 0x80020B1C Val_Wu8 255.0 OneToOne 0.00 255.0 /end CHARACTERISTIC
/begin CHARACTERISTIC FBC_q_Bypass.Channel "Bypass Label (verwendet von ASCET), nicht editieren!/Bypass Table Channel Element(verwendet von ASCET), nicht editieren!" VALUE 0x80020B1D Val_Wu8 255.0 OneToOne 0.00 255.0 /end CHARACTERISTIC
/begin CHARACTERISTIC FMA_qAirCtlCor_Bypass.Vector "Bypass Label (verwendet von ASCET), nicht editieren!/Bypass Table Vector Element (verwendet von ASCET), nicht editieren!" VALUE 0x80020B1E Val_Wu8 255.0 OneToOne 0.00 255.0 /end CHARACTERISTIC
/begin CHARACTERISTIC FMA_qAirCtlCor_Bypass.Channel "Bypass Label (verwendet von ASCET), nicht editieren!/Bypass Table Channel Element(verwendet von ASCET), nicht editieren!" VALUE 0x80020B1F Val_Wu8 255.0 OneToOne 0.00 255.0 /end CHARACTERISTIC
/begin CHARACTERISTIC FMA_qCor_Bypass.Vector "Bypass Label (verwendet von ASCET), nicht editieren!/Bypass Table Vector Element (verwendet von ASCET), nicht editieren!" VALUE 0x80020B20 Val_Wu8 255.0 OneToOne 0.00 255.0 /end CHARACTERISTIC
/begin CHARACTERISTIC FMA_qCor_Bypass.Channel "Bypass Label (verwendet von ASCET), nicht editieren!/Bypass Table Channel Element(verwendet von ASCET), nicht editieren!" VALUE 0x80020B21 Val_Wu8 255.0 OneToOne 0.00 255.0 /end CHARACTERISTIC
/begin CHARACTERISTIC FMA_trqAirCtlCor_Bypass.Vector "Bypass Label (verwendet von ASCET), nicht editieren!/Bypass Table Vector Element (verwendet von ASCET), nicht editieren!" VALUE 0x80020B22 Val_Wu8 255.0 OneToOne 0.00 255.0 /end CHARACTERISTIC
/begin CHARACTERISTIC FMA_trqAirCtlCor_Bypass.Channel "Bypass Label (verwendet von ASCET), nicht editieren!/Bypass Table Channel Element(verwendet von ASCET), nicht editieren!" VALUE 0x80020B23 Val_Wu8 255.0 OneToOne 0.00 255.0 /end CHARACTERISTIC
/begin CHARACTERISTIC GSHDem_nSetPHi_Bypass.Vector "Bypass Label (verwendet von ASCET), nicht editieren!/Bypass Table Vector Element (verwendet von ASCET), nicht editieren!" VALUE 0x80020B24 Val_Wu8 255.0 OneToOne 0.00 255.0 /end CHARACTERISTIC
/begin CHARACTERISTIC GSHDem_nSetPHi_Bypass.Channel "Bypass Label (verwendet von ASCET), nicht editieren!/Bypass Table Channel Element(verwendet von ASCET), nicht editieren!" VALUE 0x80020B25 Val_Wu8 255.0 OneToOne 0.00 255.0 /end CHARACTERISTIC
/begin CHARACTERISTIC GSHDem_nSetPLo_Bypass.Vector "Bypass Label (verwendet von ASCET), nicht editieren!/Bypass Table Vector Element (verwendet von ASCET), nicht editieren!" VALUE 0x80020B26 Val_Wu8 255.0 OneToOne 0.00 255.0 /end CHARACTERISTIC
/begin CHARACTERISTIC GSHDem_nSetPLo_Bypass.Channel "Bypass Label (verwendet von ASCET), nicht editieren!/Bypass Table Channel Element(verwendet von ASCET), nicht editieren!" VALUE 0x80020B27 Val_Wu8 255.0 OneToOne 0.00 255.0 /end CHARACTERISTIC
/begin CHARACTERISTIC HLSDem_nSetPHi_Bypass.Vector "Bypass Label (verwendet von ASCET), nicht editieren!/Bypass Table Vector Element (verwendet von ASCET), nicht editieren!" VALUE 0x80020B28 Val_Wu8 255.0 OneToOne 0.00 255.0 /end CHARACTERISTIC
/begin CHARACTERISTIC HLSDem_nSetPHi_Bypass.Channel "Bypass Label (verwendet von ASCET), nicht editieren!/Bypass Table Channel Element(verwendet von ASCET), nicht editieren!" VALUE 0x80020B29 Val_Wu8 255.0 OneToOne 0.00 255.0 /end CHARACTERISTIC
/begin CHARACTERISTIC HLSDem_nSetPLoTrm_Bypass.Vector "Bypass Label (verwendet von ASCET), nicht editieren!/Bypass Table Vector Element (verwendet von ASCET), nicht editieren!" VALUE 0x80020B2A Val_Wu8 255.0 OneToOne 0.00 255.0 /end CHARACTERISTIC
/begin CHARACTERISTIC HLSDem_nSetPLoTrm_Bypass.Channel "Bypass Label (verwendet von ASCET), nicht editieren!/Bypass Table Channel Element(verwendet von ASCET), nicht editieren!" VALUE 0x80020B2B Val_Wu8 255.0 OneToOne 0.00 255.0 /end CHARACTERISTIC
/begin CHARACTERISTIC HLSDem_nSetPLo_Bypass.Vector "Bypass Label (verwendet von ASCET), nicht editieren!/Bypass Table Vector Element (verwendet von ASCET), nicht editieren!" VALUE 0x80020B2C Val_Wu8 255.0 OneToOne 0.00 255.0 /end CHARACTERISTIC
/begin CHARACTERISTIC HLSDem_nSetPLo_Bypass.Channel "Bypass Label (verwendet von ASCET), nicht editieren!/Bypass Table Channel Element(verwendet von ASCET), nicht editieren!" VALUE 0x80020B2D Val_Wu8 255.0 OneToOne 0.00 255.0 /end CHARACTERISTIC
/begin CHARACTERISTIC HLSDem_trqReqStrt_Bypass.Vector "Bypass Label (verwendet von ASCET), nicht editieren!/Bypass Table Vector Element (verwendet von ASCET), nicht editieren!" VALUE 0x80020B2E Val_Wu8 255.0 OneToOne 0.00 255.0 /end CHARACTERISTIC
/begin CHARACTERISTIC HLSDem_trqReqStrt_Bypass.Channel "Bypass Label (verwendet von ASCET), nicht editieren!/Bypass Table Channel Element(verwendet von ASCET), nicht editieren!" VALUE 0x80020B2F Val_Wu8 255.0 OneToOne 0.00 255.0 /end CHARACTERISTIC
/begin CHARACTERISTIC HLSDem_trqReq_Bypass.Vector "Bypass Label (verwendet von ASCET), nicht editieren!/Bypass Table Vector Element (verwendet von ASCET), nicht editieren!" VALUE 0x80020B30 Val_Wu8 255.0 OneToOne 0.00 255.0 /end CHARACTERISTIC
/begin CHARACTERISTIC HLSDem_trqReq_Bypass.Channel "Bypass Label (verwendet von ASCET), nicht editieren!/Bypass Table Channel Element(verwendet von ASCET), nicht editieren!" VALUE 0x80020B31 Val_Wu8 255.0 OneToOne 0.00 255.0 /end CHARACTERISTIC
/begin CHARACTERISTIC InjCrv_facMI1SOERmpVal_mp_Bypass.Vector "Bypass Label (verwendet von ASCET), nicht editieren!/Bypass Table Vector Element (verwendet von ASCET), nicht editieren!" VALUE 0x80020B32 Val_Wu8 255.0 OneToOne 0.00 255.0 /end CHARACTERISTIC
/begin CHARACTERISTIC InjCrv_facMI1SOERmpVal_mp_Bypass.Channel "Bypass Label (verwendet von ASCET), nicht editieren!/Bypass Table Channel Element(verwendet von ASCET), nicht editieren!" VALUE 0x80020B33 Val_Wu8 255.0 OneToOne 0.00 255.0 /end CHARACTERISTIC
/begin CHARACTERISTIC InjCrv_facPiI1QntRmpVal_mp_Bypass.Vector "Bypass Label (verwendet von ASCET), nicht editieren!/Bypass Table Vector Element (verwendet von ASCET), nicht editieren!" VALUE 0x80020B34 Val_Wu8 255.0 OneToOne 0.00 255.0 /end CHARACTERISTIC
/begin CHARACTERISTIC InjCrv_facPiI1QntRmpVal_mp_Bypass.Channel "Bypass Label (verwendet von ASCET), nicht editieren!/Bypass Table Channel Element(verwendet von ASCET), nicht editieren!" VALUE 0x80020B35 Val_Wu8 255.0 OneToOne 0.00 255.0 /end CHARACTERISTIC
/begin CHARACTERISTIC InjCrv_facPiI1SOERmpVal_mp_Bypass.Vector "Bypass Label (verwendet von ASCET), nicht editieren!/Bypass Table Vector Element (verwendet von ASCET), nicht editieren!" VALUE 0x80020B36 Val_Wu8 255.0 OneToOne 0.00 255.0 /end CHARACTERISTIC
/begin CHARACTERISTIC InjCrv_facPiI1SOERmpVal_mp_Bypass.Channel "Bypass Label (verwendet von ASCET), nicht editieren!/Bypass Table Channel Element(verwendet von ASCET), nicht editieren!" VALUE 0x80020B37 Val_Wu8 255.0 OneToOne 0.00 255.0 /end CHARACTERISTIC
/begin CHARACTERISTIC InjCrv_facPoI1QntRmpVal_mp_Bypass.Vector "Bypass Label (verwendet von ASCET), nicht editieren!/Bypass Table Vector Element (verwendet von ASCET), nicht editieren!" VALUE 0x80020B38 Val_Wu8 255.0 OneToOne 0.00 255.0 /end CHARACTERISTIC
/begin CHARACTERISTIC InjCrv_facPoI1QntRmpVal_mp_Bypass.Channel "Bypass Label (verwendet von ASCET), nicht editieren!/Bypass Table Channel Element(verwendet von ASCET), nicht editieren!" VALUE 0x80020B39 Val_Wu8 255.0 OneToOne 0.00 255.0 /end CHARACTERISTIC
/begin CHARACTERISTIC InjCrv_facPoI1SOERmpVal_mp_Bypass.Vector "Bypass Label (verwendet von ASCET), nicht editieren!/Bypass Table Vector Element (verwendet von ASCET), nicht editieren!" VALUE 0x80020B3A Val_Wu8 255.0 OneToOne 0.00 255.0 /end CHARACTERISTIC
/begin CHARACTERISTIC InjCrv_facPoI1SOERmpVal_mp_Bypass.Channel "Bypass Label (verwendet von ASCET), nicht editieren!/Bypass Table Channel Element(verwendet von ASCET), nicht editieren!" VALUE 0x80020B3B Val_Wu8 255.0 OneToOne 0.00 255.0 /end CHARACTERISTIC
/begin CHARACTERISTIC InjCrv_facPoI2AngRmpVal_mp_Bypass.Vector "Bypass Label (verwendet von ASCET), nicht editieren!/Bypass Table Vector Element (verwendet von ASCET), nicht editieren!" VALUE 0x80020B3C Val_Wu8 255.0 OneToOne 0.00 255.0 /end CHARACTERISTIC
/begin CHARACTERISTIC InjCrv_facPoI2AngRmpVal_mp_Bypass.Channel "Bypass Label (verwendet von ASCET), nicht editieren!/Bypass Table Channel Element(verwendet von ASCET), nicht editieren!" VALUE 0x80020B3D Val_Wu8 255.0 OneToOne 0.00 255.0 /end CHARACTERISTIC
/begin CHARACTERISTIC InjCrv_facPoI2QntRmpVal_mp_Bypass.Vector "Bypass Label (verwendet von ASCET), nicht editieren!/Bypass Table Vector Element (verwendet von ASCET), nicht editieren!" VALUE 0x80020B3E Val_Wu8 255.0 OneToOne 0.00 255.0 /end CHARACTERISTIC
/begin CHARACTERISTIC InjCrv_facPoI2QntRmpVal_mp_Bypass.Channel "Bypass Label (verwendet von ASCET), nicht editieren!/Bypass Table Channel Element(verwendet von ASCET), nicht editieren!" VALUE 0x80020B3F Val_Wu8 255.0 OneToOne 0.00 255.0 /end CHARACTERISTIC
/begin CHARACTERISTIC InjCrv_facPoI2TiRmpVal_mp_Bypass.Vector "Bypass Label (verwendet von ASCET), nicht editieren!/Bypass Table Vector Element (verwendet von ASCET), nicht editieren!" VALUE 0x80020B40 Val_Wu8 255.0 OneToOne 0.00 255.0 /end CHARACTERISTIC
/begin CHARACTERISTIC InjCrv_facPoI2TiRmpVal_mp_Bypass.Channel "Bypass Label (verwendet von ASCET), nicht editieren!/Bypass Table Channel Element(verwendet von ASCET), nicht editieren!" VALUE 0x80020B41 Val_Wu8 255.0 OneToOne 0.00 255.0 /end CHARACTERISTIC
/begin CHARACTERISTIC InjCrv_phiMI1DesAdd_mp_Bypass.Vector "Bypass Label (verwendet von ASCET), nicht editieren!/Bypass Table Vector Element (verwendet von ASCET), nicht editieren!" VALUE 0x80020B42 Val_Wu8 255.0 OneToOne 0.00 255.0 /end CHARACTERISTIC
/begin CHARACTERISTIC InjCrv_phiMI1DesAdd_mp_Bypass.Channel "Bypass Label (verwendet von ASCET), nicht editieren!/Bypass Table Channel Element(verwendet von ASCET), nicht editieren!" VALUE 0x80020B43 Val_Wu8 255.0 OneToOne 0.00 255.0 /end CHARACTERISTIC
/begin CHARACTERISTIC InjCrv_phiMI1Des_Bypass.Vector "Bypass Label (verwendet von ASCET), nicht editieren!/Bypass Table Vector Element (verwendet von ASCET), nicht editieren!" VALUE 0x80020B44 Val_Wu8 255.0 OneToOne 0.00 255.0 /end CHARACTERISTIC
/begin CHARACTERISTIC InjCrv_phiMI1Des_Bypass.Channel "Bypass Label (verwendet von ASCET), nicht editieren!/Bypass Table Channel Element(verwendet von ASCET), nicht editieren!" VALUE 0x80020B45 Val_Wu8 255.0 OneToOne 0.00 255.0 /end CHARACTERISTIC
/begin CHARACTERISTIC InjCrv_phiMI1RgnAdd_mp_Bypass.Vector "Bypass Label (verwendet von ASCET), nicht editieren!/Bypass Table Vector Element (verwendet von ASCET), nicht editieren!" VALUE 0x80020B46 Val_Wu8 255.0 OneToOne 0.00 255.0 /end CHARACTERISTIC
/begin CHARACTERISTIC InjCrv_phiMI1RgnAdd_mp_Bypass.Channel "Bypass Label (verwendet von ASCET), nicht editieren!/Bypass Table Channel Element(verwendet von ASCET), nicht editieren!" VALUE 0x80020B47 Val_Wu8 255.0 OneToOne 0.00 255.0 /end CHARACTERISTIC
/begin CHARACTERISTIC InjCrv_phiMI1Rgn_Bypass.Vector "Bypass Label (verwendet von ASCET), nicht editieren!/Bypass Table Vector Element (verwendet von ASCET), nicht editieren!" VALUE 0x80020B48 Val_Wu8 255.0 OneToOne 0.00 255.0 /end CHARACTERISTIC
/begin CHARACTERISTIC InjCrv_phiMI1Rgn_Bypass.Channel "Bypass Label (verwendet von ASCET), nicht editieren!/Bypass Table Channel Element(verwendet von ASCET), nicht editieren!" VALUE 0x80020B49 Val_Wu8 255.0 OneToOne 0.00 255.0 /end CHARACTERISTIC
/begin CHARACTERISTIC InjCrv_phiPiI1DesAdd_mp_Bypass.Vector "Bypass Label (verwendet von ASCET), nicht editieren!/Bypass Table Vector Element (verwendet von ASCET), nicht editieren!" VALUE 0x80020B4A Val_Wu8 255.0 OneToOne 0.00 255.0 /end CHARACTERISTIC
/begin CHARACTERISTIC InjCrv_phiPiI1DesAdd_mp_Bypass.Channel "Bypass Label (verwendet von ASCET), nicht editieren!/Bypass Table Channel Element(verwendet von ASCET), nicht editieren!" VALUE 0x80020B4B Val_Wu8 255.0 OneToOne 0.00 255.0 /end CHARACTERISTIC
/begin CHARACTERISTIC InjCrv_phiPiI1Des_Bypass.Vector "Bypass Label (verwendet von ASCET), nicht editieren!/Bypass Table Vector Element (verwendet von ASCET), nicht editieren!" VALUE 0x80020B4C Val_Wu8 255.0 OneToOne 0.00 255.0 /end CHARACTERISTIC
/begin CHARACTERISTIC InjCrv_phiPiI1Des_Bypass.Channel "Bypass Label (verwendet von ASCET), nicht editieren!/Bypass Table Channel Element(verwendet von ASCET), nicht editieren!" VALUE 0x80020B4D Val_Wu8 255.0 OneToOne 0.00 255.0 /end CHARACTERISTIC
/begin CHARACTERISTIC InjCrv_phiPiI2DesAdd_mp_Bypass.Vector "Bypass Label (verwendet von ASCET), nicht editieren!/Bypass Table Vector Element (verwendet von ASCET), nicht editieren!" VALUE 0x80020B4E Val_Wu8 255.0 OneToOne 0.00 255.0 /end CHARACTERISTIC
/begin CHARACTERISTIC InjCrv_phiPiI2DesAdd_mp_Bypass.Channel "Bypass Label (verwendet von ASCET), nicht editieren!/Bypass Table Channel Element(verwendet von ASCET), nicht editieren!" VALUE 0x80020B4F Val_Wu8 255.0 OneToOne 0.00 255.0 /end CHARACTERISTIC
/begin CHARACTERISTIC InjCrv_phiPiI2Des_Bypass.Vector "Bypass Label (verwendet von ASCET), nicht editieren!/Bypass Table Vector Element (verwendet von ASCET), nicht editieren!" VALUE 0x80020B50 Val_Wu8 255.0 OneToOne 0.00 255.0 /end CHARACTERISTIC
/begin CHARACTERISTIC InjCrv_phiPiI2Des_Bypass.Channel "Bypass Label (verwendet von ASCET), nicht editieren!/Bypass Table Channel Element(verwendet von ASCET), nicht editieren!" VALUE 0x80020B51 Val_Wu8 255.0 OneToOne 0.00 255.0 /end CHARACTERISTIC
/begin CHARACTERISTIC InjCrv_phiPiI3DesAdd_mp_Bypass.Vector "Bypass Label (verwendet von ASCET), nicht editieren!/Bypass Table Vector Element (verwendet von ASCET), nicht editieren!" VALUE 0x80020B52 Val_Wu8 255.0 OneToOne 0.00 255.0 /end CHARACTERISTIC
/begin CHARACTERISTIC InjCrv_phiPiI3DesAdd_mp_Bypass.Channel "Bypass Label (verwendet von ASCET), nicht editieren!/Bypass Table Channel Element(verwendet von ASCET), nicht editieren!" VALUE 0x80020B53 Val_Wu8 255.0 OneToOne 0.00 255.0 /end CHARACTERISTIC
/begin CHARACTERISTIC InjCrv_phiPiI3Des_Bypass.Vector "Bypass Label (verwendet von ASCET), nicht editieren!/Bypass Table Vector Element (verwendet von ASCET), nicht editieren!" VALUE 0x80020B54 Val_Wu8 255.0 OneToOne 0.00 255.0 /end CHARACTERISTIC
/begin CHARACTERISTIC InjCrv_phiPiI3Des_Bypass.Channel "Bypass Label (verwendet von ASCET), nicht editieren!/Bypass Table Channel Element(verwendet von ASCET), nicht editieren!" VALUE 0x80020B55 Val_Wu8 255.0 OneToOne 0.00 255.0 /end CHARACTERISTIC
/begin CHARACTERISTIC InjCrv_phiPoI1DesAdd_mp_Bypass.Vector "Bypass Label (verwendet von ASCET), nicht editieren!/Bypass Table Vector Element (verwendet von ASCET), nicht editieren!" VALUE 0x80020B56 Val_Wu8 255.0 OneToOne 0.00 255.0 /end CHARACTERISTIC
/begin CHARACTERISTIC InjCrv_phiPoI1DesAdd_mp_Bypass.Channel "Bypass Label (verwendet von ASCET), nicht editieren!/Bypass Table Channel Element(verwendet von ASCET), nicht editieren!" VALUE 0x80020B57 Val_Wu8 255.0 OneToOne 0.00 255.0 /end CHARACTERISTIC
/begin CHARACTERISTIC InjCrv_phiPoI1Des_Bypass.Vector "Bypass Label (verwendet von ASCET), nicht editieren!/Bypass Table Vector Element (verwendet von ASCET), nicht editieren!" VALUE 0x80020B58 Val_Wu8 255.0 OneToOne 0.00 255.0 /end CHARACTERISTIC
/begin CHARACTERISTIC InjCrv_phiPoI1Des_Bypass.Channel "Bypass Label (verwendet von ASCET), nicht editieren!/Bypass Table Channel Element(verwendet von ASCET), nicht editieren!" VALUE 0x80020B59 Val_Wu8 255.0 OneToOne 0.00 255.0 /end CHARACTERISTIC
/begin CHARACTERISTIC InjCrv_phiPoI2DesAdd_mp_Bypass.Vector "Bypass Label (verwendet von ASCET), nicht editieren!/Bypass Table Vector Element (verwendet von ASCET), nicht editieren!" VALUE 0x80020B5A Val_Wu8 255.0 OneToOne 0.00 255.0 /end CHARACTERISTIC
/begin CHARACTERISTIC InjCrv_phiPoI2DesAdd_mp_Bypass.Channel "Bypass Label (verwendet von ASCET), nicht editieren!/Bypass Table Channel Element(verwendet von ASCET), nicht editieren!" VALUE 0x80020B5B Val_Wu8 255.0 OneToOne 0.00 255.0 /end CHARACTERISTIC
/begin CHARACTERISTIC InjCrv_phiPoI2Des_Bypass.Vector "Bypass Label (verwendet von ASCET), nicht editieren!/Bypass Table Vector Element (verwendet von ASCET), nicht editieren!" VALUE 0x80020B5C Val_Wu8 255.0 OneToOne 0.00 255.0 /end CHARACTERISTIC
/begin CHARACTERISTIC InjCrv_phiPoI2Des_Bypass.Channel "Bypass Label (verwendet von ASCET), nicht editieren!/Bypass Table Channel Element(verwendet von ASCET), nicht editieren!" VALUE 0x80020B5D Val_Wu8 255.0 OneToOne 0.00 255.0 /end CHARACTERISTIC
/begin CHARACTERISTIC InjCrv_phiPoI2RgnAdd_mp_Bypass.Vector "Bypass : Additiver Bypasseingriff fuer Winkel der Nacheinspritzung 2 im Regenerationsbetrieb/Bypass Table Vector Element (verwendet von ASCET), nicht editieren!" VALUE 0x80020B5E Val_Wu8 255.0 OneToOne 0.00 255.0 /end CHARACTERISTIC
/begin CHARACTERISTIC InjCrv_phiPoI2RgnAdd_mp_Bypass.Channel "Bypass : Additiver Bypasseingriff fuer Winkel der Nacheinspritzung 2 im Regenerationsbetrieb/Bypass Table Channel Element(verwendet von ASCET), nicht editieren!" VALUE 0x80020B5F Val_Wu8 255.0 OneToOne 0.00 255.0 /end CHARACTERISTIC
/begin CHARACTERISTIC InjCrv_phiPoI2Rgn_Bypass.Vector "Bypass : Grundwert der Winkelkomponente Ansteuerbeginn PoI2 im Regenerationsbetrieb/Bypass Table Vector Element (verwendet von ASCET), nicht editieren!" VALUE 0x80020B60 Val_Wu8 255.0 OneToOne 0.00 255.0 /end CHARACTERISTIC
/begin CHARACTERISTIC InjCrv_phiPoI2Rgn_Bypass.Channel "Bypass : Grundwert der Winkelkomponente Ansteuerbeginn PoI2 im Regenerationsbetrieb/Bypass Table Channel Element(verwendet von ASCET), nicht editieren!" VALUE 0x80020B61 Val_Wu8 255.0 OneToOne 0.00 255.0 /end CHARACTERISTIC
/begin CHARACTERISTIC InjCrv_qMI1DesAdd_mp_Bypass.Vector "Bypass Label (verwendet von ASCET), nicht editieren!/Bypass Table Vector Element (verwendet von ASCET), nicht editieren!" VALUE 0x80020B62 Val_Wu8 255.0 OneToOne 0.00 255.0 /end CHARACTERISTIC
/begin CHARACTERISTIC InjCrv_qMI1DesAdd_mp_Bypass.Channel "Bypass Label (verwendet von ASCET), nicht editieren!/Bypass Table Channel Element(verwendet von ASCET), nicht editieren!" VALUE 0x80020B63 Val_Wu8 255.0 OneToOne 0.00 255.0 /end CHARACTERISTIC
/begin CHARACTERISTIC InjCrv_qMI1Des_Bypass.Vector "Bypass Label (verwendet von ASCET), nicht editieren!/Bypass Table Vector Element (verwendet von ASCET), nicht editieren!" VALUE 0x80020B64 Val_Wu8 255.0 OneToOne 0.00 255.0 /end CHARACTERISTIC
/begin CHARACTERISTIC InjCrv_qMI1Des_Bypass.Channel "Bypass Label (verwendet von ASCET), nicht editieren!/Bypass Table Channel Element(verwendet von ASCET), nicht editieren!" VALUE 0x80020B65 Val_Wu8 255.0 OneToOne 0.00 255.0 /end CHARACTERISTIC
/begin CHARACTERISTIC InjCrv_qPiI1DesAdd_mp_Bypass.Vector "Bypass Label (verwendet von ASCET), nicht editieren!/Bypass Table Vector Element (verwendet von ASCET), nicht editieren!" VALUE 0x80020B66 Val_Wu8 255.0 OneToOne 0.00 255.0 /end CHARACTERISTIC
/begin CHARACTERISTIC InjCrv_qPiI1DesAdd_mp_Bypass.Channel "Bypass Label (verwendet von ASCET), nicht editieren!/Bypass Table Channel Element(verwendet von ASCET), nicht editieren!" VALUE 0x80020B67 Val_Wu8 255.0 OneToOne 0.00 255.0 /end CHARACTERISTIC
/begin CHARACTERISTIC InjCrv_qPiI1Des_Bypass.Vector "Bypass Label (verwendet von ASCET), nicht editieren!/Bypass Table Vector Element (verwendet von ASCET), nicht editieren!" VALUE 0x80020B68 Val_Wu8 255.0 OneToOne 0.00 255.0 /end CHARACTERISTIC
/begin CHARACTERISTIC InjCrv_qPiI1Des_Bypass.Channel "Bypass Label (verwendet von ASCET), nicht editieren!/Bypass Table Channel Element(verwendet von ASCET), nicht editieren!" VALUE 0x80020B69 Val_Wu8 255.0 OneToOne 0.00 255.0 /end CHARACTERISTIC
/begin CHARACTERISTIC InjCrv_qPiI1RgnAdd_mp_Bypass.Vector "Bypass Label (verwendet von ASCET), nicht editieren!/Bypass Table Vector Element (verwendet von ASCET), nicht editieren!" VALUE 0x80020B6A Val_Wu8 255.0 OneToOne 0.00 255.0 /end CHARACTERISTIC
/begin CHARACTERISTIC InjCrv_qPiI1RgnAdd_mp_Bypass.Channel "Bypass Label (verwendet von ASCET), nicht editieren!/Bypass Table Channel Element(verwendet von ASCET), nicht editieren!" VALUE 0x80020B6B Val_Wu8 255.0 OneToOne 0.00 255.0 /end CHARACTERISTIC
/begin CHARACTERISTIC InjCrv_qPiI1Rgn_Bypass.Vector "Bypass Label (verwendet von ASCET), nicht editieren!/Bypass Table Vector Element (verwendet von ASCET), nicht editieren!" VALUE 0x80020B6C Val_Wu8 255.0 OneToOne 0.00 255.0 /end CHARACTERISTIC
/begin CHARACTERISTIC InjCrv_qPiI1Rgn_Bypass.Channel "Bypass Label (verwendet von ASCET), nicht editieren!/Bypass Table Channel Element(verwendet von ASCET), nicht editieren!" VALUE 0x80020B6D Val_Wu8 255.0 OneToOne 0.00 255.0 /end CHARACTERISTIC
/begin CHARACTERISTIC InjCrv_qPiI2DesAdd_mp_Bypass.Vector "Bypass Label (verwendet von ASCET), nicht editieren!/Bypass Table Vector Element (verwendet von ASCET), nicht editieren!" VALUE 0x80020B6E Val_Wu8 255.0 OneToOne 0.00 255.0 /end CHARACTERISTIC
/begin CHARACTERISTIC InjCrv_qPiI2DesAdd_mp_Bypass.Channel "Bypass Label (verwendet von ASCET), nicht editieren!/Bypass Table Channel Element(verwendet von ASCET), nicht editieren!" VALUE 0x80020B6F Val_Wu8 255.0 OneToOne 0.00 255.0 /end CHARACTERISTIC
/begin CHARACTERISTIC InjCrv_qPiI2Des_Bypass.Vector "Bypass Label (verwendet von ASCET), nicht editieren!/Bypass Table Vector Element (verwendet von ASCET), nicht editieren!" VALUE 0x80020B70 Val_Wu8 255.0 OneToOne 0.00 255.0 /end CHARACTERISTIC
/begin CHARACTERISTIC InjCrv_qPiI2Des_Bypass.Channel "Bypass Label (verwendet von ASCET), nicht editieren!/Bypass Table Channel Element(verwendet von ASCET), nicht editieren!" VALUE 0x80020B71 Val_Wu8 255.0 OneToOne 0.00 255.0 /end CHARACTERISTIC
/begin CHARACTERISTIC InjCrv_qPiI2RgnAdd_mp_Bypass.Vector "Bypass Label (verwendet von ASCET), nicht editieren!/Bypass Table Vector Element (verwendet von ASCET), nicht editieren!" VALUE 0x80020B72 Val_Wu8 255.0 OneToOne 0.00 255.0 /end CHARACTERISTIC
/begin CHARACTERISTIC InjCrv_qPiI2RgnAdd_mp_Bypass.Channel "Bypass Label (verwendet von ASCET), nicht editieren!/Bypass Table Channel Element(verwendet von ASCET), nicht editieren!" VALUE 0x80020B73 Val_Wu8 255.0 OneToOne 0.00 255.0 /end CHARACTERISTIC
/begin CHARACTERISTIC InjCrv_qPiI2Rgn_Bypass.Vector "Bypass Label (verwendet von ASCET), nicht editieren!/Bypass Table Vector Element (verwendet von ASCET), nicht editieren!" VALUE 0x80020B74 Val_Wu8 255.0 OneToOne 0.00 255.0 /end CHARACTERISTIC
/begin CHARACTERISTIC InjCrv_qPiI2Rgn_Bypass.Channel "Bypass Label (verwendet von ASCET), nicht editieren!/Bypass Table Channel Element(verwendet von ASCET), nicht editieren!" VALUE 0x80020B75 Val_Wu8 255.0 OneToOne 0.00 255.0 /end CHARACTERISTIC
/begin CHARACTERISTIC InjCrv_qPiI3DesAdd_mp_Bypass.Vector "Bypass Label (verwendet von ASCET), nicht editieren!/Bypass Table Vector Element (verwendet von ASCET), nicht editieren!" VALUE 0x80020B76 Val_Wu8 255.0 OneToOne 0.00 255.0 /end CHARACTERISTIC
/begin CHARACTERISTIC InjCrv_qPiI3DesAdd_mp_Bypass.Channel "Bypass Label (verwendet von ASCET), nicht editieren!/Bypass Table Channel Element(verwendet von ASCET), nicht editieren!" VALUE 0x80020B77 Val_Wu8 255.0 OneToOne 0.00 255.0 /end CHARACTERISTIC
/begin CHARACTERISTIC InjCrv_qPiI3Des_Bypass.Vector "Bypass Label (verwendet von ASCET), nicht editieren!/Bypass Table Vector Element (verwendet von ASCET), nicht editieren!" VALUE 0x80020B78 Val_Wu8 255.0 OneToOne 0.00 255.0 /end CHARACTERISTIC
/begin CHARACTERISTIC InjCrv_qPiI3Des_Bypass.Channel "Bypass Label (verwendet von ASCET), nicht editieren!/Bypass Table Channel Element(verwendet von ASCET), nicht editieren!" VALUE 0x80020B79 Val_Wu8 255.0 OneToOne 0.00 255.0 /end CHARACTERISTIC
/begin CHARACTERISTIC InjCrv_qPoI1DesAdd_mp_Bypass.Vector "Bypass Label (verwendet von ASCET), nicht editieren!/Bypass Table Vector Element (verwendet von ASCET), nicht editieren!" VALUE 0x80020B7A Val_Wu8 255.0 OneToOne 0.00 255.0 /end CHARACTERISTIC
/begin CHARACTERISTIC InjCrv_qPoI1DesAdd_mp_Bypass.Channel "Bypass Label (verwendet von ASCET), nicht editieren!/Bypass Table Channel Element(verwendet von ASCET), nicht editieren!" VALUE 0x80020B7B Val_Wu8 255.0 OneToOne 0.00 255.0 /end CHARACTERISTIC
/begin CHARACTERISTIC InjCrv_qPoI1Des_Bypass.Vector "Bypass Label (verwendet von ASCET), nicht editieren!/Bypass Table Vector Element (verwendet von ASCET), nicht editieren!" VALUE 0x80020B7C Val_Wu8 255.0 OneToOne 0.00 255.0 /end CHARACTERISTIC
/begin CHARACTERISTIC InjCrv_qPoI1Des_Bypass.Channel "Bypass Label (verwendet von ASCET), nicht editieren!/Bypass Table Channel Element(verwendet von ASCET), nicht editieren!" VALUE 0x80020B7D Val_Wu8 255.0 OneToOne 0.00 255.0 /end CHARACTERISTIC
/begin CHARACTERISTIC InjCrv_qPoI1RgnAdd_mp_Bypass.Vector "Bypass Label (verwendet von ASCET), nicht editieren!/Bypass Table Vector Element (verwendet von ASCET), nicht editieren!" VALUE 0x80020B7E Val_Wu8 255.0 OneToOne 0.00 255.0 /end CHARACTERISTIC
/begin CHARACTERISTIC InjCrv_qPoI1RgnAdd_mp_Bypass.Channel "Bypass Label (verwendet von ASCET), nicht editieren!/Bypass Table Channel Element(verwendet von ASCET), nicht editieren!" VALUE 0x80020B7F Val_Wu8 255.0 OneToOne 0.00 255.0 /end CHARACTERISTIC
/begin CHARACTERISTIC InjCrv_qPoI1Rgn_Bypass.Vector "Bypass Label (verwendet von ASCET), nicht editieren!/Bypass Table Vector Element (verwendet von ASCET), nicht editieren!" VALUE 0x80020B80 Val_Wu8 255.0 OneToOne 0.00 255.0 /end CHARACTERISTIC
/begin CHARACTERISTIC InjCrv_qPoI1Rgn_Bypass.Channel "Bypass Label (verwendet von ASCET), nicht editieren!/Bypass Table Channel Element(verwendet von ASCET), nicht editieren!" VALUE 0x80020B81 Val_Wu8 255.0 OneToOne 0.00 255.0 /end CHARACTERISTIC
/begin CHARACTERISTIC InjCrv_qPoI2DesAdd_mp_Bypass.Vector "Bypass Label (verwendet von ASCET), nicht editieren!/Bypass Table Vector Element (verwendet von ASCET), nicht editieren!" VALUE 0x80020B82 Val_Wu8 255.0 OneToOne 0.00 255.0 /end CHARACTERISTIC
/begin CHARACTERISTIC InjCrv_qPoI2DesAdd_mp_Bypass.Channel "Bypass Label (verwendet von ASCET), nicht editieren!/Bypass Table Channel Element(verwendet von ASCET), nicht editieren!" VALUE 0x80020B83 Val_Wu8 255.0 OneToOne 0.00 255.0 /end CHARACTERISTIC
/begin CHARACTERISTIC InjCrv_qPoI2Des_Bypass.Vector "Bypass Label (verwendet von ASCET), nicht editieren!/Bypass Table Vector Element (verwendet von ASCET), nicht editieren!" VALUE 0x80020B84 Val_Wu8 255.0 OneToOne 0.00 255.0 /end CHARACTERISTIC
/begin CHARACTERISTIC InjCrv_qPoI2Des_Bypass.Channel "Bypass Label (verwendet von ASCET), nicht editieren!/Bypass Table Channel Element(verwendet von ASCET), nicht editieren!" VALUE 0x80020B85 Val_Wu8 255.0 OneToOne 0.00 255.0 /end CHARACTERISTIC
/begin CHARACTERISTIC InjCrv_qPoI2EffAdd_mp_Bypass.Vector "Bypass Label (verwendet von ASCET), nicht editieren!/Bypass Table Vector Element (verwendet von ASCET), nicht editieren!" VALUE 0x80020B86 Val_Wu8 255.0 OneToOne 0.00 255.0 /end CHARACTERISTIC
/begin CHARACTERISTIC InjCrv_qPoI2EffAdd_mp_Bypass.Channel "Bypass Label (verwendet von ASCET), nicht editieren!/Bypass Table Channel Element(verwendet von ASCET), nicht editieren!" VALUE 0x80020B87 Val_Wu8 255.0 OneToOne 0.00 255.0 /end CHARACTERISTIC
/begin CHARACTERISTIC InjCrv_qPoI2Eff_Bypass.Vector "Bypass Label (verwendet von ASCET), nicht editieren!/Bypass Table Vector Element (verwendet von ASCET), nicht editieren!" VALUE 0x80020B88 Val_Wu8 255.0 OneToOne 0.00 255.0 /end CHARACTERISTIC
/begin CHARACTERISTIC InjCrv_qPoI2Eff_Bypass.Channel "Bypass Label (verwendet von ASCET), nicht editieren!/Bypass Table Channel Element(verwendet von ASCET), nicht editieren!" VALUE 0x80020B89 Val_Wu8 255.0 OneToOne 0.00 255.0 /end CHARACTERISTIC
/begin CHARACTERISTIC InjCrv_qPoI2RgnAdd_mp_Bypass.Vector "Bypass : Additiver Bypasseingriff fuer Menge der Nacheinspritzung 2 im Regenerationsbtrieb/Bypass Table Vector Element (verwendet von ASCET), nicht editieren!" VALUE 0x80020B8A Val_Wu8 255.0 OneToOne 0.00 255.0 /end CHARACTERISTIC
/begin CHARACTERISTIC InjCrv_qPoI2RgnAdd_mp_Bypass.Channel "Bypass : Additiver Bypasseingriff fuer Menge der Nacheinspritzung 2 im Regenerationsbtrieb/Bypass Table Channel Element(verwendet von ASCET), nicht editieren!" VALUE 0x80020B8B Val_Wu8 255.0 OneToOne 0.00 255.0 /end CHARACTERISTIC
/begin CHARACTERISTIC InjCrv_qPoI2Rgn_Bypass.Vector "Bypass : Grundwert Einspritzmenge PoI2 im Regenerationsbetrieb/Bypass Table Vector Element (verwendet von ASCET), nicht editieren!" VALUE 0x80020B8C Val_Wu8 255.0 OneToOne 0.00 255.0 /end CHARACTERISTIC
/begin CHARACTERISTIC InjCrv_qPoI2Rgn_Bypass.Channel "Bypass : Grundwert Einspritzmenge PoI2 im Regenerationsbetrieb/Bypass Table Channel Element(verwendet von ASCET), nicht editieren!" VALUE 0x80020B8D Val_Wu8 255.0 OneToOne 0.00 255.0 /end CHARACTERISTIC
/begin CHARACTERISTIC InjCrv_stInjCharSetVal_Bypass.Vector "Bypass Label (verwendet von ASCET), nicht editieren!/Bypass Table Vector Element (verwendet von ASCET), nicht editieren!" VALUE 0x80020B8E Val_Wu8 255.0 OneToOne 0.00 255.0 /end CHARACTERISTIC
/begin CHARACTERISTIC InjCrv_stInjCharSetVal_Bypass.Channel "Bypass Label (verwendet von ASCET), nicht editieren!/Bypass Table Channel Element(verwendet von ASCET), nicht editieren!" VALUE 0x80020B8F Val_Wu8 255.0 OneToOne 0.00 255.0 /end CHARACTERISTIC
/begin CHARACTERISTIC InjCrv_tiPiI1DesAdd_mp_Bypass.Vector "Bypass Label (verwendet von ASCET), nicht editieren!/Bypass Table Vector Element (verwendet von ASCET), nicht editieren!" VALUE 0x80020B90 Val_Wu8 255.0 OneToOne 0.00 255.0 /end CHARACTERISTIC
/begin CHARACTERISTIC InjCrv_tiPiI1DesAdd_mp_Bypass.Channel "Bypass Label (verwendet von ASCET), nicht editieren!/Bypass Table Channel Element(verwendet von ASCET), nicht editieren!" VALUE 0x80020B91 Val_Wu8 255.0 OneToOne 0.00 255.0 /end CHARACTERISTIC
/begin CHARACTERISTIC InjCrv_tiPiI1Des_Bypass.Vector "Bypass Label (verwendet von ASCET), nicht editieren!/Bypass Table Vector Element (verwendet von ASCET), nicht editieren!" VALUE 0x80020B92 Val_Wu8 255.0 OneToOne 0.00 255.0 /end CHARACTERISTIC
/begin CHARACTERISTIC InjCrv_tiPiI1Des_Bypass.Channel "Bypass Label (verwendet von ASCET), nicht editieren!/Bypass Table Channel Element(verwendet von ASCET), nicht editieren!" VALUE 0x80020B93 Val_Wu8 255.0 OneToOne 0.00 255.0 /end CHARACTERISTIC
/begin CHARACTERISTIC InjCrv_tiPiI1RgnAdd_mp_Bypass.Vector "Bypass Label (verwendet von ASCET), nicht editieren!/Bypass Table Vector Element (verwendet von ASCET), nicht editieren!" VALUE 0x80020B94 Val_Wu8 255.0 OneToOne 0.00 255.0 /end CHARACTERISTIC
/begin CHARACTERISTIC InjCrv_tiPiI1RgnAdd_mp_Bypass.Channel "Bypass Label (verwendet von ASCET), nicht editieren!/Bypass Table Channel Element(verwendet von ASCET), nicht editieren!" VALUE 0x80020B95 Val_Wu8 255.0 OneToOne 0.00 255.0 /end CHARACTERISTIC
/begin CHARACTERISTIC InjCrv_tiPiI1Rgn_Bypass.Vector "Bypass Label (verwendet von ASCET), nicht editieren!/Bypass Table Vector Element (verwendet von ASCET), nicht editieren!" VALUE 0x80020B96 Val_Wu8 255.0 OneToOne 0.00 255.0 /end CHARACTERISTIC
/begin CHARACTERISTIC InjCrv_tiPiI1Rgn_Bypass.Channel "Bypass Label (verwendet von ASCET), nicht editieren!/Bypass Table Channel Element(verwendet von ASCET), nicht editieren!" VALUE 0x80020B97 Val_Wu8 255.0 OneToOne 0.00 255.0 /end CHARACTERISTIC
/begin CHARACTERISTIC InjCrv_tiPiI2DesAdd_mp_Bypass.Vector "Bypass Label (verwendet von ASCET), nicht editieren!/Bypass Table Vector Element (verwendet von ASCET), nicht editieren!" VALUE 0x80020B98 Val_Wu8 255.0 OneToOne 0.00 255.0 /end CHARACTERISTIC
/begin CHARACTERISTIC InjCrv_tiPiI2DesAdd_mp_Bypass.Channel "Bypass Label (verwendet von ASCET), nicht editieren!/Bypass Table Channel Element(verwendet von ASCET), nicht editieren!" VALUE 0x80020B99 Val_Wu8 255.0 OneToOne 0.00 255.0 /end CHARACTERISTIC
/begin CHARACTERISTIC InjCrv_tiPiI2Des_Bypass.Vector "Bypass Label (verwendet von ASCET), nicht editieren!/Bypass Table Vector Element (verwendet von ASCET), nicht editieren!" VALUE 0x80020B9A Val_Wu8 255.0 OneToOne 0.00 255.0 /end CHARACTERISTIC
/begin CHARACTERISTIC InjCrv_tiPiI2Des_Bypass.Channel "Bypass Label (verwendet von ASCET), nicht editieren!/Bypass Table Channel Element(verwendet von ASCET), nicht editieren!" VALUE 0x80020B9B Val_Wu8 255.0 OneToOne 0.00 255.0 /end CHARACTERISTIC
/begin CHARACTERISTIC InjCrv_tiPiI2RgnAdd_mp_Bypass.Vector "Bypass Label (verwendet von ASCET), nicht editieren!/Bypass Table Vector Element (verwendet von ASCET), nicht editieren!" VALUE 0x80020B9C Val_Wu8 255.0 OneToOne 0.00 255.0 /end CHARACTERISTIC
/begin CHARACTERISTIC InjCrv_tiPiI2RgnAdd_mp_Bypass.Channel "Bypass Label (verwendet von ASCET), nicht editieren!/Bypass Table Channel Element(verwendet von ASCET), nicht editieren!" VALUE 0x80020B9D Val_Wu8 255.0 OneToOne 0.00 255.0 /end CHARACTERISTIC
/begin CHARACTERISTIC InjCrv_tiPiI2Rgn_Bypass.Vector "Bypass Label (verwendet von ASCET), nicht editieren!/Bypass Table Vector Element (verwendet von ASCET), nicht editieren!" VALUE 0x80020B9E Val_Wu8 255.0 OneToOne 0.00 255.0 /end CHARACTERISTIC
/begin CHARACTERISTIC InjCrv_tiPiI2Rgn_Bypass.Channel "Bypass Label (verwendet von ASCET), nicht editieren!/Bypass Table Channel Element(verwendet von ASCET), nicht editieren!" VALUE 0x80020B9F Val_Wu8 255.0 OneToOne 0.00 255.0 /end CHARACTERISTIC
/begin CHARACTERISTIC InjCrv_tiPoI2DesAdd_mp_Bypass.Vector "Bypass Label (verwendet von ASCET), nicht editieren!/Bypass Table Vector Element (verwendet von ASCET), nicht editieren!" VALUE 0x80020BA0 Val_Wu8 255.0 OneToOne 0.00 255.0 /end CHARACTERISTIC
/begin CHARACTERISTIC InjCrv_tiPoI2DesAdd_mp_Bypass.Channel "Bypass Label (verwendet von ASCET), nicht editieren!/Bypass Table Channel Element(verwendet von ASCET), nicht editieren!" VALUE 0x80020BA1 Val_Wu8 255.0 OneToOne 0.00 255.0 /end CHARACTERISTIC
/begin CHARACTERISTIC InjCrv_tiPoI2Des_Bypass.Vector "Bypass Label (verwendet von ASCET), nicht editieren!/Bypass Table Vector Element (verwendet von ASCET), nicht editieren!" VALUE 0x80020BA2 Val_Wu8 255.0 OneToOne 0.00 255.0 /end CHARACTERISTIC
/begin CHARACTERISTIC InjCrv_tiPoI2Des_Bypass.Channel "Bypass Label (verwendet von ASCET), nicht editieren!/Bypass Table Channel Element(verwendet von ASCET), nicht editieren!" VALUE 0x80020BA3 Val_Wu8 255.0 OneToOne 0.00 255.0 /end CHARACTERISTIC
/begin CHARACTERISTIC InjCtl_qCurrAdd_mp_Bypass.Vector "Bypass Label (verwendet von ASCET), nicht editieren!/Bypass Table Vector Element (verwendet von ASCET), nicht editieren!" VALUE 0x80020BA4 Val_Wu8 255.0 OneToOne 0.00 255.0 /end CHARACTERISTIC
/begin CHARACTERISTIC InjCtl_qCurrAdd_mp_Bypass.Channel "Bypass Label (verwendet von ASCET), nicht editieren!/Bypass Table Channel Element(verwendet von ASCET), nicht editieren!" VALUE 0x80020BA5 Val_Wu8 255.0 OneToOne 0.00 255.0 /end CHARACTERISTIC
/begin CHARACTERISTIC InjCtl_qCurr_Bypass.Vector "Bypass Label (verwendet von ASCET), nicht editieren!/Bypass Table Vector Element (verwendet von ASCET), nicht editieren!" VALUE 0x80020BA6 Val_Wu8 255.0 OneToOne 0.00 255.0 /end CHARACTERISTIC
/begin CHARACTERISTIC InjCtl_qCurr_Bypass.Channel "Bypass Label (verwendet von ASCET), nicht editieren!/Bypass Table Channel Element(verwendet von ASCET), nicht editieren!" VALUE 0x80020BA7 Val_Wu8 255.0 OneToOne 0.00 255.0 /end CHARACTERISTIC
/begin CHARACTERISTIC InjCtl_qRawAdd_mp_Bypass.Vector "Bypass Label (verwendet von ASCET), nicht editieren!/Bypass Table Vector Element (verwendet von ASCET), nicht editieren!" VALUE 0x80020BA8 Val_Wu8 255.0 OneToOne 0.00 255.0 /end CHARACTERISTIC
/begin CHARACTERISTIC InjCtl_qRawAdd_mp_Bypass.Channel "Bypass Label (verwendet von ASCET), nicht editieren!/Bypass Table Channel Element(verwendet von ASCET), nicht editieren!" VALUE 0x80020BA9 Val_Wu8 255.0 OneToOne 0.00 255.0 /end CHARACTERISTIC
/begin CHARACTERISTIC InjCtl_qRaw_Bypass.Vector "Bypass Label (verwendet von ASCET), nicht editieren!/Bypass Table Vector Element (verwendet von ASCET), nicht editieren!" VALUE 0x80020BAA Val_Wu8 255.0 OneToOne 0.00 255.0 /end CHARACTERISTIC
/begin CHARACTERISTIC InjCtl_qRaw_Bypass.Channel "Bypass Label (verwendet von ASCET), nicht editieren!/Bypass Table Channel Element(verwendet von ASCET), nicht editieren!" VALUE 0x80020BAB Val_Wu8 255.0 OneToOne 0.00 255.0 /end CHARACTERISTIC
/begin CHARACTERISTIC InjCtl_qSetUnBalAdd_mp_Bypass.Vector "Bypass Label (verwendet von ASCET), nicht editieren!/Bypass Table Vector Element (verwendet von ASCET), nicht editieren!" VALUE 0x80020BAC Val_Wu8 255.0 OneToOne 0.00 255.0 /end CHARACTERISTIC
/begin CHARACTERISTIC InjCtl_qSetUnBalAdd_mp_Bypass.Channel "Bypass Label (verwendet von ASCET), nicht editieren!/Bypass Table Channel Element(verwendet von ASCET), nicht editieren!" VALUE 0x80020BAD Val_Wu8 255.0 OneToOne 0.00 255.0 /end CHARACTERISTIC
/begin CHARACTERISTIC InjCtl_qSetUnBal_Bypass.Vector "Bypass Label (verwendet von ASCET), nicht editieren!/Bypass Table Vector Element (verwendet von ASCET), nicht editieren!" VALUE 0x80020BAE Val_Wu8 255.0 OneToOne 0.00 255.0 /end CHARACTERISTIC
/begin CHARACTERISTIC InjCtl_qSetUnBal_Bypass.Channel "Bypass Label (verwendet von ASCET), nicht editieren!/Bypass Table Channel Element(verwendet von ASCET), nicht editieren!" VALUE 0x80020BAF Val_Wu8 255.0 OneToOne 0.00 255.0 /end CHARACTERISTIC
/begin CHARACTERISTIC InjVlv_tiMI1ET_mp_Bypass.Vector "Bypass Label (verwendet von ASCET), nicht editieren!/Bypass Table Vector Element (verwendet von ASCET), nicht editieren!" VALUE 0x80020BB0 Val_Wu8 255.0 OneToOne 0.00 255.0 /end CHARACTERISTIC
/begin CHARACTERISTIC InjVlv_tiMI1ET_mp_Bypass.Channel "Bypass Label (verwendet von ASCET), nicht editieren!/Bypass Table Channel Element(verwendet von ASCET), nicht editieren!" VALUE 0x80020BB1 Val_Wu8 255.0 OneToOne 0.00 255.0 /end CHARACTERISTIC
/begin CHARACTERISTIC InjVlv_tiPiI1ET_mp_Bypass.Vector "Bypass Label (verwendet von ASCET), nicht editieren!/Bypass Table Vector Element (verwendet von ASCET), nicht editieren!" VALUE 0x80020BB2 Val_Wu8 255.0 OneToOne 0.00 255.0 /end CHARACTERISTIC
/begin CHARACTERISTIC InjVlv_tiPiI1ET_mp_Bypass.Channel "Bypass Label (verwendet von ASCET), nicht editieren!/Bypass Table Channel Element(verwendet von ASCET), nicht editieren!" VALUE 0x80020BB3 Val_Wu8 255.0 OneToOne 0.00 255.0 /end CHARACTERISTIC
/begin CHARACTERISTIC InjVlv_tiPoI1ET_mp_Bypass.Vector "Bypass Label (verwendet von ASCET), nicht editieren!/Bypass Table Vector Element (verwendet von ASCET), nicht editieren!" VALUE 0x80020BB4 Val_Wu8 255.0 OneToOne 0.00 255.0 /end CHARACTERISTIC
/begin CHARACTERISTIC InjVlv_tiPoI1ET_mp_Bypass.Channel "Bypass Label (verwendet von ASCET), nicht editieren!/Bypass Table Channel Element(verwendet von ASCET), nicht editieren!" VALUE 0x80020BB5 Val_Wu8 255.0 OneToOne 0.00 255.0 /end CHARACTERISTIC
/begin CHARACTERISTIC InjVlv_tiPoI2ET_mp_Bypass.Vector "Bypass Label (verwendet von ASCET), nicht editieren!/Bypass Table Vector Element (verwendet von ASCET), nicht editieren!" VALUE 0x80020BB6 Val_Wu8 255.0 OneToOne 0.00 255.0 /end CHARACTERISTIC
/begin CHARACTERISTIC InjVlv_tiPoI2ET_mp_Bypass.Channel "Bypass Label (verwendet von ASCET), nicht editieren!/Bypass Table Channel Element(verwendet von ASCET), nicht editieren!" VALUE 0x80020BB7 Val_Wu8 255.0 OneToOne 0.00 255.0 /end CHARACTERISTIC
/begin CHARACTERISTIC ISC_nSetPHi_Bypass.Vector "/Bypass Table Vector Element (verwendet von ASCET), nicht editieren!" VALUE 0x80020BB8 Val_Wu8 255.0 OneToOne 0.00 255.0 /end CHARACTERISTIC
/begin CHARACTERISTIC ISC_nSetPHi_Bypass.Channel "/Bypass Table Channel Element(verwendet von ASCET), nicht editieren!" VALUE 0x80020BB9 Val_Wu8 255.0 OneToOne 0.00 255.0 /end CHARACTERISTIC
/begin CHARACTERISTIC ISC_nSetPLoPLnd_Bypass.Vector "/Bypass Table Vector Element (verwendet von ASCET), nicht editieren!" VALUE 0x80020BBA Val_Wu8 255.0 OneToOne 0.00 255.0 /end CHARACTERISTIC
/begin CHARACTERISTIC ISC_nSetPLoPLnd_Bypass.Channel "/Bypass Table Channel Element(verwendet von ASCET), nicht editieren!" VALUE 0x80020BBB Val_Wu8 255.0 OneToOne 0.00 255.0 /end CHARACTERISTIC
/begin CHARACTERISTIC ISC_nSetPLo_Bypass.Vector "/Bypass Table Vector Element (verwendet von ASCET), nicht editieren!" VALUE 0x80020BBC Val_Wu8 255.0 OneToOne 0.00 255.0 /end CHARACTERISTIC
/begin CHARACTERISTIC ISC_nSetPLo_Bypass.Channel "/Bypass Table Channel Element(verwendet von ASCET), nicht editieren!" VALUE 0x80020BBD Val_Wu8 255.0 OneToOne 0.00 255.0 /end CHARACTERISTIC
/begin CHARACTERISTIC ISC_numCurrFunc_Bypass.Vector "/Bypass Table Vector Element (verwendet von ASCET), nicht editieren!" VALUE 0x80020BBE Val_Wu8 255.0 OneToOne 0.00 255.0 /end CHARACTERISTIC
/begin CHARACTERISTIC ISC_numCurrFunc_Bypass.Channel "/Bypass Table Channel Element(verwendet von ASCET), nicht editieren!" VALUE 0x80020BBF Val_Wu8 255.0 OneToOne 0.00 255.0 /end CHARACTERISTIC
/begin CHARACTERISTIC ISC_tiPT1TrqFlt_Bypass.Vector "/Bypass Table Vector Element (verwendet von ASCET), nicht editieren!" VALUE 0x80020BC0 Val_Wu8 255.0 OneToOne 0.00 255.0 /end CHARACTERISTIC
/begin CHARACTERISTIC ISC_tiPT1TrqFlt_Bypass.Channel "/Bypass Table Channel Element(verwendet von ASCET), nicht editieren!" VALUE 0x80020BC1 Val_Wu8 255.0 OneToOne 0.00 255.0 /end CHARACTERISTIC
/begin CHARACTERISTIC ISC_trqFlt_Bypass.Vector "/Bypass Table Vector Element (verwendet von ASCET), nicht editieren!" VALUE 0x80020BC2 Val_Wu8 255.0 OneToOne 0.00 255.0 /end CHARACTERISTIC
/begin CHARACTERISTIC ISC_trqFlt_Bypass.Channel "/Bypass Table Channel Element(verwendet von ASCET), nicht editieren!" VALUE 0x80020BC3 Val_Wu8 255.0 OneToOne 0.00 255.0 /end CHARACTERISTIC
/begin CHARACTERISTIC ISC_trqLoLimMax_Bypass.Vector "/Bypass Table Vector Element (verwendet von ASCET), nicht editieren!" VALUE 0x80020BC4 Val_Wu8 255.0 OneToOne 0.00 255.0 /end CHARACTERISTIC
/begin CHARACTERISTIC ISC_trqLoLimMax_Bypass.Channel "/Bypass Table Channel Element(verwendet von ASCET), nicht editieren!" VALUE 0x80020BC5 Val_Wu8 255.0 OneToOne 0.00 255.0 /end CHARACTERISTIC
/begin CHARACTERISTIC ISC_trqLoLimMin_Bypass.Vector "/Bypass Table Vector Element (verwendet von ASCET), nicht editieren!" VALUE 0x80020BC6 Val_Wu8 255.0 OneToOne 0.00 255.0 /end CHARACTERISTIC
/begin CHARACTERISTIC ISC_trqLoLimMin_Bypass.Channel "/Bypass Table Channel Element(verwendet von ASCET), nicht editieren!" VALUE 0x80020BC7 Val_Wu8 255.0 OneToOne 0.00 255.0 /end CHARACTERISTIC
/begin CHARACTERISTIC ISC_trqLoLtd_Bypass.Vector "/Bypass Table Vector Element (verwendet von ASCET), nicht editieren!" VALUE 0x80020BC8 Val_Wu8 255.0 OneToOne 0.00 255.0 /end CHARACTERISTIC
/begin CHARACTERISTIC ISC_trqLoLtd_Bypass.Channel "/Bypass Table Channel Element(verwendet von ASCET), nicht editieren!" VALUE 0x80020BC9 Val_Wu8 255.0 OneToOne 0.00 255.0 /end CHARACTERISTIC
/begin CHARACTERISTIC ISC_trqLossFlt_Bypass.Vector "/Bypass Table Vector Element (verwendet von ASCET), nicht editieren!" VALUE 0x80020BCA Val_Wu8 255.0 OneToOne 0.00 255.0 /end CHARACTERISTIC
/begin CHARACTERISTIC ISC_trqLossFlt_Bypass.Channel "/Bypass Table Channel Element(verwendet von ASCET), nicht editieren!" VALUE 0x80020BCB Val_Wu8 255.0 OneToOne 0.00 255.0 /end CHARACTERISTIC
/begin CHARACTERISTIC ISC_trqPreCtlEff_Bypass.Vector "/Bypass Table Vector Element (verwendet von ASCET), nicht editieren!" VALUE 0x80020BCC Val_Wu8 255.0 OneToOne 0.00 255.0 /end CHARACTERISTIC
/begin CHARACTERISTIC ISC_trqPreCtlEff_Bypass.Channel "/Bypass Table Channel Element(verwendet von ASCET), nicht editieren!" VALUE 0x80020BCD Val_Wu8 255.0 OneToOne 0.00 255.0 /end CHARACTERISTIC
/begin CHARACTERISTIC ISC_trqPreCtl_Bypass.Vector "/Bypass Table Vector Element (verwendet von ASCET), nicht editieren!" VALUE 0x80020BCE Val_Wu8 255.0 OneToOne 0.00 255.0 /end CHARACTERISTIC
/begin CHARACTERISTIC ISC_trqPreCtl_Bypass.Channel "/Bypass Table Channel Element(verwendet von ASCET), nicht editieren!" VALUE 0x80020BCF Val_Wu8 255.0 OneToOne 0.00 255.0 /end CHARACTERISTIC
/begin CHARACTERISTIC ISC_trqReq_Bypass.Vector "/Bypass Table Vector Element (verwendet von ASCET), nicht editieren!" VALUE 0x80020BD0 Val_Wu8 255.0 OneToOne 0.00 255.0 /end CHARACTERISTIC
/begin CHARACTERISTIC ISC_trqReq_Bypass.Channel "/Bypass Table Channel Element(verwendet von ASCET), nicht editieren!" VALUE 0x80020BD1 Val_Wu8 255.0 OneToOne 0.00 255.0 /end CHARACTERISTIC
/begin CHARACTERISTIC ISC_trq_Bypass.Vector "/Bypass Table Vector Element (verwendet von ASCET), nicht editieren!" VALUE 0x80020BD2 Val_Wu8 255.0 OneToOne 0.00 255.0 /end CHARACTERISTIC
/begin CHARACTERISTIC ISC_trq_Bypass.Channel "/Bypass Table Channel Element(verwendet von ASCET), nicht editieren!" VALUE 0x80020BD3 Val_Wu8 255.0 OneToOne 0.00 255.0 /end CHARACTERISTIC
/begin CHARACTERISTIC LSU_dcycHtStrt_0_mp2_Bypass.Vector "Bypass Label (verwendet von ASCET), nicht editieren!/Bypass Table Vector Element (verwendet von ASCET), nicht editieren!" VALUE 0x80020BD4 Val_Wu8 255.0 OneToOne 0.00 255.0 /end CHARACTERISTIC
/begin CHARACTERISTIC LSU_dcycHtStrt_0_mp2_Bypass.Channel "Bypass Label (verwendet von ASCET), nicht editieren!/Bypass Table Channel Element(verwendet von ASCET), nicht editieren!" VALUE 0x80020BD5 Val_Wu8 255.0 OneToOne 0.00 255.0 /end CHARACTERISTIC
/begin CHARACTERISTIC LSU_dcycHtStrt_1_mp2_Bypass.Vector "Bypass Label (verwendet von ASCET), nicht editieren!/Bypass Table Vector Element (verwendet von ASCET), nicht editieren!" VALUE 0x80020BD6 Val_Wu8 255.0 OneToOne 0.00 255.0 /end CHARACTERISTIC
/begin CHARACTERISTIC LSU_dcycHtStrt_1_mp2_Bypass.Channel "Bypass Label (verwendet von ASCET), nicht editieren!/Bypass Table Channel Element(verwendet von ASCET), nicht editieren!" VALUE 0x80020BD7 Val_Wu8 255.0 OneToOne 0.00 255.0 /end CHARACTERISTIC
/begin CHARACTERISTIC LSU_dcycHtStrt_2_mp2_Bypass.Vector "Bypass Label (verwendet von ASCET), nicht editieren!/Bypass Table Vector Element (verwendet von ASCET), nicht editieren!" VALUE 0x80020BD8 Val_Wu8 255.0 OneToOne 0.00 255.0 /end CHARACTERISTIC
/begin CHARACTERISTIC LSU_dcycHtStrt_2_mp2_Bypass.Channel "Bypass Label (verwendet von ASCET), nicht editieren!/Bypass Table Channel Element(verwendet von ASCET), nicht editieren!" VALUE 0x80020BD9 Val_Wu8 255.0 OneToOne 0.00 255.0 /end CHARACTERISTIC
/begin CHARACTERISTIC LSU_dcycHtStrt_3_mp2_Bypass.Vector "Bypass Label (verwendet von ASCET), nicht editieren!/Bypass Table Vector Element (verwendet von ASCET), nicht editieren!" VALUE 0x80020BDA Val_Wu8 255.0 OneToOne 0.00 255.0 /end CHARACTERISTIC
/begin CHARACTERISTIC LSU_dcycHtStrt_3_mp2_Bypass.Channel "Bypass Label (verwendet von ASCET), nicht editieren!/Bypass Table Channel Element(verwendet von ASCET), nicht editieren!" VALUE 0x80020BDB Val_Wu8 255.0 OneToOne 0.00 255.0 /end CHARACTERISTIC
/begin CHARACTERISTIC LSU_rO2PresComp_0_mp2_Bypass.Vector "Bypass Label (verwendet von ASCET), nicht editieren!/Bypass Table Vector Element (verwendet von ASCET), nicht editieren!" VALUE 0x80020BDC Val_Wu8 255.0 OneToOne 0.00 255.0 /end CHARACTERISTIC
/begin CHARACTERISTIC LSU_rO2PresComp_0_mp2_Bypass.Channel "Bypass Label (verwendet von ASCET), nicht editieren!/Bypass Table Channel Element(verwendet von ASCET), nicht editieren!" VALUE 0x80020BDD Val_Wu8 255.0 OneToOne 0.00 255.0 /end CHARACTERISTIC
/begin CHARACTERISTIC LSU_rO2PresComp_1_mp2_Bypass.Vector "Bypass Label (verwendet von ASCET), nicht editieren!/Bypass Table Vector Element (verwendet von ASCET), nicht editieren!" VALUE 0x80020BDE Val_Wu8 255.0 OneToOne 0.00 255.0 /end CHARACTERISTIC
/begin CHARACTERISTIC LSU_rO2PresComp_1_mp2_Bypass.Channel "Bypass Label (verwendet von ASCET), nicht editieren!/Bypass Table Channel Element(verwendet von ASCET), nicht editieren!" VALUE 0x80020BDF Val_Wu8 255.0 OneToOne 0.00 255.0 /end CHARACTERISTIC
/begin CHARACTERISTIC LSU_rO2PresComp_2_mp2_Bypass.Vector "Bypass Label (verwendet von ASCET), nicht editieren!/Bypass Table Vector Element (verwendet von ASCET), nicht editieren!" VALUE 0x80020BE0 Val_Wu8 255.0 OneToOne 0.00 255.0 /end CHARACTERISTIC
/begin CHARACTERISTIC LSU_rO2PresComp_2_mp2_Bypass.Channel "Bypass Label (verwendet von ASCET), nicht editieren!/Bypass Table Channel Element(verwendet von ASCET), nicht editieren!" VALUE 0x80020BE1 Val_Wu8 255.0 OneToOne 0.00 255.0 /end CHARACTERISTIC
/begin CHARACTERISTIC LSU_rO2PresComp_3_mp2_Bypass.Vector "Bypass Label (verwendet von ASCET), nicht editieren!/Bypass Table Vector Element (verwendet von ASCET), nicht editieren!" VALUE 0x80020BE2 Val_Wu8 255.0 OneToOne 0.00 255.0 /end CHARACTERISTIC
/begin CHARACTERISTIC LSU_rO2PresComp_3_mp2_Bypass.Channel "Bypass Label (verwendet von ASCET), nicht editieren!/Bypass Table Channel Element(verwendet von ASCET), nicht editieren!" VALUE 0x80020BE3 Val_Wu8 255.0 OneToOne 0.00 255.0 /end CHARACTERISTIC
/begin CHARACTERISTIC LSU_rO2Raw_0_mp2_Bypass.Vector "Bypass Label (verwendet von ASCET), nicht editieren!/Bypass Table Vector Element (verwendet von ASCET), nicht editieren!" VALUE 0x80020BE4 Val_Wu8 255.0 OneToOne 0.00 255.0 /end CHARACTERISTIC
/begin CHARACTERISTIC LSU_rO2Raw_0_mp2_Bypass.Channel "Bypass Label (verwendet von ASCET), nicht editieren!/Bypass Table Channel Element(verwendet von ASCET), nicht editieren!" VALUE 0x80020BE5 Val_Wu8 255.0 OneToOne 0.00 255.0 /end CHARACTERISTIC
/begin CHARACTERISTIC LSU_rO2Raw_1_mp2_Bypass.Vector "Bypass Label (verwendet von ASCET), nicht editieren!/Bypass Table Vector Element (verwendet von ASCET), nicht editieren!" VALUE 0x80020BE6 Val_Wu8 255.0 OneToOne 0.00 255.0 /end CHARACTERISTIC
/begin CHARACTERISTIC LSU_rO2Raw_1_mp2_Bypass.Channel "Bypass Label (verwendet von ASCET), nicht editieren!/Bypass Table Channel Element(verwendet von ASCET), nicht editieren!" VALUE 0x80020BE7 Val_Wu8 255.0 OneToOne 0.00 255.0 /end CHARACTERISTIC
/begin CHARACTERISTIC LSU_rO2Raw_2_mp2_Bypass.Vector "Bypass Label (verwendet von ASCET), nicht editieren!/Bypass Table Vector Element (verwendet von ASCET), nicht editieren!" VALUE 0x80020BE8 Val_Wu8 255.0 OneToOne 0.00 255.0 /end CHARACTERISTIC
/begin CHARACTERISTIC LSU_rO2Raw_2_mp2_Bypass.Channel "Bypass Label (verwendet von ASCET), nicht editieren!/Bypass Table Channel Element(verwendet von ASCET), nicht editieren!" VALUE 0x80020BE9 Val_Wu8 255.0 OneToOne 0.00 255.0 /end CHARACTERISTIC
/begin CHARACTERISTIC LSU_rO2Raw_3_mp2_Bypass.Vector "Bypass Label (verwendet von ASCET), nicht editieren!/Bypass Table Vector Element (verwendet von ASCET), nicht editieren!" VALUE 0x80020BEA Val_Wu8 255.0 OneToOne 0.00 255.0 /end CHARACTERISTIC
/begin CHARACTERISTIC LSU_rO2Raw_3_mp2_Bypass.Channel "Bypass Label (verwendet von ASCET), nicht editieren!/Bypass Table Channel Element(verwendet von ASCET), nicht editieren!" VALUE 0x80020BEB Val_Wu8 255.0 OneToOne 0.00 255.0 /end CHARACTERISTIC
/begin CHARACTERISTIC LSU_stO2IntValid_0_mp2_Bypass.Vector "Bypass Label (verwendet von ASCET), nicht editieren!/Bypass Table Vector Element (verwendet von ASCET), nicht editieren!" VALUE 0x80020BEC Val_Wu8 255.0 OneToOne 0.00 255.0 /end CHARACTERISTIC
/begin CHARACTERISTIC LSU_stO2IntValid_0_mp2_Bypass.Channel "Bypass Label (verwendet von ASCET), nicht editieren!/Bypass Table Channel Element(verwendet von ASCET), nicht editieren!" VALUE 0x80020BED Val_Wu8 255.0 OneToOne 0.00 255.0 /end CHARACTERISTIC
/begin CHARACTERISTIC LSU_stO2IntValid_1_mp2_Bypass.Vector "Bypass Label (verwendet von ASCET), nicht editieren!/Bypass Table Vector Element (verwendet von ASCET), nicht editieren!" VALUE 0x80020BEE Val_Wu8 255.0 OneToOne 0.00 255.0 /end CHARACTERISTIC
/begin CHARACTERISTIC LSU_stO2IntValid_1_mp2_Bypass.Channel "Bypass Label (verwendet von ASCET), nicht editieren!/Bypass Table Channel Element(verwendet von ASCET), nicht editieren!" VALUE 0x80020BEF Val_Wu8 255.0 OneToOne 0.00 255.0 /end CHARACTERISTIC
/begin CHARACTERISTIC LSU_stO2IntValid_2_mp2_Bypass.Vector "Bypass Label (verwendet von ASCET), nicht editieren!/Bypass Table Vector Element (verwendet von ASCET), nicht editieren!" VALUE 0x80020BF0 Val_Wu8 255.0 OneToOne 0.00 255.0 /end CHARACTERISTIC
/begin CHARACTERISTIC LSU_stO2IntValid_2_mp2_Bypass.Channel "Bypass Label (verwendet von ASCET), nicht editieren!/Bypass Table Channel Element(verwendet von ASCET), nicht editieren!" VALUE 0x80020BF1 Val_Wu8 255.0 OneToOne 0.00 255.0 /end CHARACTERISTIC
/begin CHARACTERISTIC LSU_stO2IntValid_3_mp2_Bypass.Vector "Bypass Label (verwendet von ASCET), nicht editieren!/Bypass Table Vector Element (verwendet von ASCET), nicht editieren!" VALUE 0x80020BF2 Val_Wu8 255.0 OneToOne 0.00 255.0 /end CHARACTERISTIC
/begin CHARACTERISTIC LSU_stO2IntValid_3_mp2_Bypass.Channel "Bypass Label (verwendet von ASCET), nicht editieren!/Bypass Table Channel Element(verwendet von ASCET), nicht editieren!" VALUE 0x80020BF3 Val_Wu8 255.0 OneToOne 0.00 255.0 /end CHARACTERISTIC
/begin CHARACTERISTIC LSU_tRi_0_mp2_Bypass.Vector "Bypass Label (verwendet von ASCET), nicht editieren!/Bypass Table Vector Element (verwendet von ASCET), nicht editieren!" VALUE 0x80020BF4 Val_Wu8 255.0 OneToOne 0.00 255.0 /end CHARACTERISTIC
/begin CHARACTERISTIC LSU_tRi_0_mp2_Bypass.Channel "Bypass Label (verwendet von ASCET), nicht editieren!/Bypass Table Channel Element(verwendet von ASCET), nicht editieren!" VALUE 0x80020BF5 Val_Wu8 255.0 OneToOne 0.00 255.0 /end CHARACTERISTIC
/begin CHARACTERISTIC LSU_tRi_1_mp2_Bypass.Vector "Bypass Label (verwendet von ASCET), nicht editieren!/Bypass Table Vector Element (verwendet von ASCET), nicht editieren!" VALUE 0x80020BF6 Val_Wu8 255.0 OneToOne 0.00 255.0 /end CHARACTERISTIC
/begin CHARACTERISTIC LSU_tRi_1_mp2_Bypass.Channel "Bypass Label (verwendet von ASCET), nicht editieren!/Bypass Table Channel Element(verwendet von ASCET), nicht editieren!" VALUE 0x80020BF7 Val_Wu8 255.0 OneToOne 0.00 255.0 /end CHARACTERISTIC
/begin CHARACTERISTIC LSU_tRi_2_mp2_Bypass.Vector "Bypass Label (verwendet von ASCET), nicht editieren!/Bypass Table Vector Element (verwendet von ASCET), nicht editieren!" VALUE 0x80020BF8 Val_Wu8 255.0 OneToOne 0.00 255.0 /end CHARACTERISTIC
/begin CHARACTERISTIC LSU_tRi_2_mp2_Bypass.Channel "Bypass Label (verwendet von ASCET), nicht editieren!/Bypass Table Channel Element(verwendet von ASCET), nicht editieren!" VALUE 0x80020BF9 Val_Wu8 255.0 OneToOne 0.00 255.0 /end CHARACTERISTIC
/begin CHARACTERISTIC LSU_tRi_3_mp2_Bypass.Vector "Bypass Label (verwendet von ASCET), nicht editieren!/Bypass Table Vector Element (verwendet von ASCET), nicht editieren!" VALUE 0x80020BFA Val_Wu8 255.0 OneToOne 0.00 255.0 /end CHARACTERISTIC
/begin CHARACTERISTIC LSU_tRi_3_mp2_Bypass.Channel "Bypass Label (verwendet von ASCET), nicht editieren!/Bypass Table Channel Element(verwendet von ASCET), nicht editieren!" VALUE 0x80020BFB Val_Wu8 255.0 OneToOne 0.00 255.0 /end CHARACTERISTIC
/begin CHARACTERISTIC MeUn_dvolSet_Bypass.Vector "Bypass Label (verwendet von ASCET), nicht editieren!/Bypass Table Vector Element (verwendet von ASCET), nicht editieren!" VALUE 0x80020BFC Val_Wu8 255.0 OneToOne 0.00 255.0 /end CHARACTERISTIC
/begin CHARACTERISTIC MeUn_dvolSet_Bypass.Channel "Bypass Label (verwendet von ASCET), nicht editieren!/Bypass Table Channel Element(verwendet von ASCET), nicht editieren!" VALUE 0x80020BFD Val_Wu8 255.0 OneToOne 0.00 255.0 /end CHARACTERISTIC
/begin CHARACTERISTIC MeUn_iSet_Bypass.Vector "Bypass Label (verwendet von ASCET), nicht editieren!/Bypass Table Vector Element (verwendet von ASCET), nicht editieren!" VALUE 0x80020BFE Val_Wu8 255.0 OneToOne 0.00 255.0 /end CHARACTERISTIC
/begin CHARACTERISTIC MeUn_iSet_Bypass.Channel "Bypass Label (verwendet von ASCET), nicht editieren!/Bypass Table Channel Element(verwendet von ASCET), nicht editieren!" VALUE 0x80020BFF Val_Wu8 255.0 OneToOne 0.00 255.0 /end CHARACTERISTIC
/begin CHARACTERISTIC PCR_pDesVal_Bypass.Vector "Bypass Label (verwendet von ASCET), nicht editieren!/Bypass Table Vector Element (verwendet von ASCET), nicht editieren!" VALUE 0x80020C00 Val_Wu8 255.0 OneToOne 0.00 255.0 /end CHARACTERISTIC
/begin CHARACTERISTIC PCR_pDesVal_Bypass.Channel "Bypass Label (verwendet von ASCET), nicht editieren!/Bypass Table Channel Element(verwendet von ASCET), nicht editieren!" VALUE 0x80020C01 Val_Wu8 255.0 OneToOne 0.00 255.0 /end CHARACTERISTIC
/begin CHARACTERISTIC PCR_qCtlVal_Bypass.Vector "Bypass Label (verwendet von ASCET), nicht editieren!/Bypass Table Vector Element (verwendet von ASCET), nicht editieren!" VALUE 0x80020C02 Val_Wu8 255.0 OneToOne 0.00 255.0 /end CHARACTERISTIC
/begin CHARACTERISTIC PCR_qCtlVal_Bypass.Channel "Bypass Label (verwendet von ASCET), nicht editieren!/Bypass Table Channel Element(verwendet von ASCET), nicht editieren!" VALUE 0x80020C03 Val_Wu8 255.0 OneToOne 0.00 255.0 /end CHARACTERISTIC
/begin CHARACTERISTIC PCR_rCtlVal_Bypass.Vector "Bypass Label (verwendet von ASCET), nicht editieren!/Bypass Table Vector Element (verwendet von ASCET), nicht editieren!" VALUE 0x80020C04 Val_Wu8 255.0 OneToOne 0.00 255.0 /end CHARACTERISTIC
/begin CHARACTERISTIC PCR_rCtlVal_Bypass.Channel "Bypass Label (verwendet von ASCET), nicht editieren!/Bypass Table Channel Element(verwendet von ASCET), nicht editieren!" VALUE 0x80020C05 Val_Wu8 255.0 OneToOne 0.00 255.0 /end CHARACTERISTIC
/begin CHARACTERISTIC PCR_rGovOutUnLim_Bypass.Vector "Bypass Label (verwendet von ASCET), nicht editieren!/Bypass Table Vector Element (verwendet von ASCET), nicht editieren!" VALUE 0x80020C06 Val_Wu8 255.0 OneToOne 0.00 255.0 /end CHARACTERISTIC
/begin CHARACTERISTIC PCR_rGovOutUnLim_Bypass.Channel "Bypass Label (verwendet von ASCET), nicht editieren!/Bypass Table Channel Element(verwendet von ASCET), nicht editieren!" VALUE 0x80020C07 Val_Wu8 255.0 OneToOne 0.00 255.0 /end CHARACTERISTIC
/begin CHARACTERISTIC PCR_rGov_Bypass.Vector "Bypass Label (verwendet von ASCET), nicht editieren!/Bypass Table Vector Element (verwendet von ASCET), nicht editieren!" VALUE 0x80020C08 Val_Wu8 255.0 OneToOne 0.00 255.0 /end CHARACTERISTIC
/begin CHARACTERISTIC PCR_rGov_Bypass.Channel "Bypass Label (verwendet von ASCET), nicht editieren!/Bypass Table Channel Element(verwendet von ASCET), nicht editieren!" VALUE 0x80020C09 Val_Wu8 255.0 OneToOne 0.00 255.0 /end CHARACTERISTIC
/begin CHARACTERISTIC PCR_stARW_Bypass.Vector "/Bypass Table Vector Element (verwendet von ASCET), nicht editieren!" VALUE 0x80020C0A Val_Wu8 255.0 OneToOne 0.00 255.0 /end CHARACTERISTIC
/begin CHARACTERISTIC PCR_stARW_Bypass.Channel "/Bypass Table Channel Element(verwendet von ASCET), nicht editieren!" VALUE 0x80020C0B Val_Wu8 255.0 OneToOne 0.00 255.0 /end CHARACTERISTIC
/begin CHARACTERISTIC PCV_iSetBefAdd_mp_Bypass.Vector "Bypass Label (verwendet von ASCET), nicht editieren!/Bypass Table Vector Element (verwendet von ASCET), nicht editieren!" VALUE 0x80020C0C Val_Wu8 255.0 OneToOne 0.00 255.0 /end CHARACTERISTIC
/begin CHARACTERISTIC PCV_iSetBefAdd_mp_Bypass.Channel "Bypass Label (verwendet von ASCET), nicht editieren!/Bypass Table Channel Element(verwendet von ASCET), nicht editieren!" VALUE 0x80020C0D Val_Wu8 255.0 OneToOne 0.00 255.0 /end CHARACTERISTIC
/begin CHARACTERISTIC PCV_iSet_Bypass.Vector "Bypass Label (verwendet von ASCET), nicht editieren!/Bypass Table Vector Element (verwendet von ASCET), nicht editieren!" VALUE 0x80020C0E Val_Wu8 255.0 OneToOne 0.00 255.0 /end CHARACTERISTIC
/begin CHARACTERISTIC PCV_iSet_Bypass.Channel "Bypass Label (verwendet von ASCET), nicht editieren!/Bypass Table Channel Element(verwendet von ASCET), nicht editieren!" VALUE 0x80020C0F Val_Wu8 255.0 OneToOne 0.00 255.0 /end CHARACTERISTIC
/begin CHARACTERISTIC PCV_pSet_Bypass.Vector "Bypass Label (verwendet von ASCET), nicht editieren!/Bypass Table Vector Element (verwendet von ASCET), nicht editieren!" VALUE 0x80020C10 Val_Wu8 255.0 OneToOne 0.00 255.0 /end CHARACTERISTIC
/begin CHARACTERISTIC PCV_pSet_Bypass.Channel "Bypass Label (verwendet von ASCET), nicht editieren!/Bypass Table Channel Element(verwendet von ASCET), nicht editieren!" VALUE 0x80020C11 Val_Wu8 255.0 OneToOne 0.00 255.0 /end CHARACTERISTIC
/begin CHARACTERISTIC PFltLd_mSot_Bypass.Vector "Bypass Label (verwendet von ASCET), nicht editieren!/Bypass Table Vector Element (verwendet von ASCET), nicht editieren!" VALUE 0x80020C12 Val_Wu8 255.0 OneToOne 0.00 255.0 /end CHARACTERISTIC
/begin CHARACTERISTIC PFltLd_mSot_Bypass.Channel "Bypass Label (verwendet von ASCET), nicht editieren!/Bypass Table Channel Element(verwendet von ASCET), nicht editieren!" VALUE 0x80020C13 Val_Wu8 255.0 OneToOne 0.00 255.0 /end CHARACTERISTIC
/begin CHARACTERISTIC PFltLd_resFlw_Bypass.Vector "Bypass Label (verwendet von ASCET), nicht editieren!/Bypass Table Vector Element (verwendet von ASCET), nicht editieren!" VALUE 0x80020C14 Val_Wu8 255.0 OneToOne 0.00 255.0 /end CHARACTERISTIC
/begin CHARACTERISTIC PFltLd_resFlw_Bypass.Channel "Bypass Label (verwendet von ASCET), nicht editieren!/Bypass Table Channel Element(verwendet von ASCET), nicht editieren!" VALUE 0x80020C15 Val_Wu8 255.0 OneToOne 0.00 255.0 /end CHARACTERISTIC
/begin CHARACTERISTIC PFltPOp_stEngPOp_Bypass.Vector "Bypass Label (verwendet von ASCET), nicht editieren!/Bypass Table Vector Element (verwendet von ASCET), nicht editieren!" VALUE 0x80020C16 Val_Wu8 255.0 OneToOne 0.00 255.0 /end CHARACTERISTIC
/begin CHARACTERISTIC PFltPOp_stEngPOp_Bypass.Channel "Bypass Label (verwendet von ASCET), nicht editieren!/Bypass Table Channel Element(verwendet von ASCET), nicht editieren!" VALUE 0x80020C17 Val_Wu8 255.0 OneToOne 0.00 255.0 /end CHARACTERISTIC
/begin CHARACTERISTIC PFltRgn_numRgn_Bypass.Vector "Bypass Label (verwendet von ASCET), nicht editieren!/Bypass Table Vector Element (verwendet von ASCET), nicht editieren!" VALUE 0x80020C18 Val_Wu8 255.0 OneToOne 0.00 255.0 /end CHARACTERISTIC
/begin CHARACTERISTIC PFltRgn_numRgn_Bypass.Channel "Bypass Label (verwendet von ASCET), nicht editieren!/Bypass Table Channel Element(verwendet von ASCET), nicht editieren!" VALUE 0x80020C19 Val_Wu8 255.0 OneToOne 0.00 255.0 /end CHARACTERISTIC
/begin CHARACTERISTIC PFlt_tInrDes_Bypass.Vector "Bypass Label (verwendet von ASCET), nicht editieren!/Bypass Table Vector Element (verwendet von ASCET), nicht editieren!" VALUE 0x80020C1A Val_Wu8 255.0 OneToOne 0.00 255.0 /end CHARACTERISTIC
/begin CHARACTERISTIC PFlt_tInrDes_Bypass.Channel "Bypass Label (verwendet von ASCET), nicht editieren!/Bypass Table Channel Element(verwendet von ASCET), nicht editieren!" VALUE 0x80020C1B Val_Wu8 255.0 OneToOne 0.00 255.0 /end CHARACTERISTIC
/begin CHARACTERISTIC PFlt_tOutrDes_Bypass.Vector "Bypass Label (verwendet von ASCET), nicht editieren!/Bypass Table Vector Element (verwendet von ASCET), nicht editieren!" VALUE 0x80020C1C Val_Wu8 255.0 OneToOne 0.00 255.0 /end CHARACTERISTIC
/begin CHARACTERISTIC PFlt_tOutrDes_Bypass.Channel "Bypass Label (verwendet von ASCET), nicht editieren!/Bypass Table Channel Element(verwendet von ASCET), nicht editieren!" VALUE 0x80020C1D Val_Wu8 255.0 OneToOne 0.00 255.0 /end CHARACTERISTIC
/begin CHARACTERISTIC PthLead_trqInrCurr_Bypass.Vector "Bypass Label (verwendet von ASCET), nicht editieren!/Bypass Table Vector Element (verwendet von ASCET), nicht editieren!" VALUE 0x80020C1E Val_Wu8 255.0 OneToOne 0.00 255.0 /end CHARACTERISTIC
/begin CHARACTERISTIC PthLead_trqInrCurr_Bypass.Channel "Bypass Label (verwendet von ASCET), nicht editieren!/Bypass Table Channel Element(verwendet von ASCET), nicht editieren!" VALUE 0x80020C1F Val_Wu8 255.0 OneToOne 0.00 255.0 /end CHARACTERISTIC
/begin CHARACTERISTIC PthLead_trqInrLead_Bypass.Vector "Bypass Label (verwendet von ASCET), nicht editieren!/Bypass Table Vector Element (verwendet von ASCET), nicht editieren!" VALUE 0x80020C20 Val_Wu8 255.0 OneToOne 0.00 255.0 /end CHARACTERISTIC
/begin CHARACTERISTIC PthLead_trqInrLead_Bypass.Channel "Bypass Label (verwendet von ASCET), nicht editieren!/Bypass Table Channel Element(verwendet von ASCET), nicht editieren!" VALUE 0x80020C21 Val_Wu8 255.0 OneToOne 0.00 255.0 /end CHARACTERISTIC
/begin CHARACTERISTIC PthSet_trqInrSet_Bypass.Vector "Bypass Label (verwendet von ASCET), nicht editieren!/Bypass Table Vector Element (verwendet von ASCET), nicht editieren!" VALUE 0x80020C22 Val_Wu8 255.0 OneToOne 0.00 255.0 /end CHARACTERISTIC
/begin CHARACTERISTIC PthSet_trqInrSet_Bypass.Channel "Bypass Label (verwendet von ASCET), nicht editieren!/Bypass Table Channel Element(verwendet von ASCET), nicht editieren!" VALUE 0x80020C23 Val_Wu8 255.0 OneToOne 0.00 255.0 /end CHARACTERISTIC
/begin CHARACTERISTIC Rail_facSetPointRmpVal_mp_Bypass.Vector "Bypass Label (verwendet von ASCET), nicht editieren!/Bypass Table Vector Element (verwendet von ASCET), nicht editieren!" VALUE 0x80020C24 Val_Wu8 255.0 OneToOne 0.00 255.0 /end CHARACTERISTIC
/begin CHARACTERISTIC Rail_facSetPointRmpVal_mp_Bypass.Channel "Bypass Label (verwendet von ASCET), nicht editieren!/Bypass Table Channel Element(verwendet von ASCET), nicht editieren!" VALUE 0x80020C25 Val_Wu8 255.0 OneToOne 0.00 255.0 /end CHARACTERISTIC
/begin CHARACTERISTIC Rail_pSetPointRgn_Bypass.Vector "Bypass Label (verwendet von ASCET), nicht editieren!/Bypass Table Vector Element (verwendet von ASCET), nicht editieren!" VALUE 0x80020C26 Val_Wu8 255.0 OneToOne 0.00 255.0 /end CHARACTERISTIC
/begin CHARACTERISTIC Rail_pSetPointRgn_Bypass.Channel "Bypass Label (verwendet von ASCET), nicht editieren!/Bypass Table Channel Element(verwendet von ASCET), nicht editieren!" VALUE 0x80020C27 Val_Wu8 255.0 OneToOne 0.00 255.0 /end CHARACTERISTIC
/begin CHARACTERISTIC Rail_pSetPoint_Bypass.Vector "Bypass Label (verwendet von ASCET), nicht editieren!/Bypass Table Vector Element (verwendet von ASCET), nicht editieren!" VALUE 0x80020C28 Val_Wu8 255.0 OneToOne 0.00 255.0 /end CHARACTERISTIC
/begin CHARACTERISTIC Rail_pSetPoint_Bypass.Channel "Bypass Label (verwendet von ASCET), nicht editieren!/Bypass Table Channel Element(verwendet von ASCET), nicht editieren!" VALUE 0x80020C29 Val_Wu8 255.0 OneToOne 0.00 255.0 /end CHARACTERISTIC
/begin CHARACTERISTIC RngMod_trqFrc_Bypass.Vector "Bypass Label (verwendet von ASCET), nicht editieren!/Bypass Table Vector Element (verwendet von ASCET), nicht editieren!" VALUE 0x80020C2A Val_Wu8 255.0 OneToOne 0.00 255.0 /end CHARACTERISTIC
/begin CHARACTERISTIC RngMod_trqFrc_Bypass.Channel "Bypass Label (verwendet von ASCET), nicht editieren!/Bypass Table Channel Element(verwendet von ASCET), nicht editieren!" VALUE 0x80020C2B Val_Wu8 255.0 OneToOne 0.00 255.0 /end CHARACTERISTIC
/begin CHARACTERISTIC SCRAd_facQtyAdapAdd_mp_Bypass.Vector "Bypass Label (verwendet von ASCET), nicht editieren!/Bypass Table Vector Element (verwendet von ASCET), nicht editieren!" VALUE 0x80020C2C Val_Wu8 255.0 OneToOne 0.00 255.0 /end CHARACTERISTIC
/begin CHARACTERISTIC SCRAd_facQtyAdapAdd_mp_Bypass.Channel "Bypass Label (verwendet von ASCET), nicht editieren!/Bypass Table Channel Element(verwendet von ASCET), nicht editieren!" VALUE 0x80020C2D Val_Wu8 255.0 OneToOne 0.00 255.0 /end CHARACTERISTIC
/begin CHARACTERISTIC SCRAd_facQtyAdap_Bypass.Vector "Bypass Label (verwendet von ASCET), nicht editieren!/Bypass Table Vector Element (verwendet von ASCET), nicht editieren!" VALUE 0x80020C2E Val_Wu8 255.0 OneToOne 0.00 255.0 /end CHARACTERISTIC
/begin CHARACTERISTIC SCRAd_facQtyAdap_Bypass.Channel "Bypass Label (verwendet von ASCET), nicht editieren!/Bypass Table Channel Element(verwendet von ASCET), nicht editieren!" VALUE 0x80020C2F Val_Wu8 255.0 OneToOne 0.00 255.0 /end CHARACTERISTIC
/begin CHARACTERISTIC SCRAd_mNH3LdAdapAdd_mp_Bypass.Vector "Bypass Label (verwendet von ASCET), nicht editieren!/Bypass Table Vector Element (verwendet von ASCET), nicht editieren!" VALUE 0x80020C30 Val_Wu8 255.0 OneToOne 0.00 255.0 /end CHARACTERISTIC
/begin CHARACTERISTIC SCRAd_mNH3LdAdapAdd_mp_Bypass.Channel "Bypass Label (verwendet von ASCET), nicht editieren!/Bypass Table Channel Element(verwendet von ASCET), nicht editieren!" VALUE 0x80020C31 Val_Wu8 255.0 OneToOne 0.00 255.0 /end CHARACTERISTIC
/begin CHARACTERISTIC SCRAd_mNH3LdAdap_Bypass.Vector "Bypass Label (verwendet von ASCET), nicht editieren!/Bypass Table Vector Element (verwendet von ASCET), nicht editieren!" VALUE 0x80020C32 Val_Wu8 255.0 OneToOne 0.00 255.0 /end CHARACTERISTIC
/begin CHARACTERISTIC SCRAd_mNH3LdAdap_Bypass.Channel "Bypass Label (verwendet von ASCET), nicht editieren!/Bypass Table Channel Element(verwendet von ASCET), nicht editieren!" VALUE 0x80020C33 Val_Wu8 255.0 OneToOne 0.00 255.0 /end CHARACTERISTIC
/begin CHARACTERISTIC SCRAd_mNH3LdRstAdd_mp_Bypass.Vector "Bypass Label (verwendet von ASCET), nicht editieren!/Bypass Table Vector Element (verwendet von ASCET), nicht editieren!" VALUE 0x80020C34 Val_Wu8 255.0 OneToOne 0.00 255.0 /end CHARACTERISTIC
/begin CHARACTERISTIC SCRAd_mNH3LdRstAdd_mp_Bypass.Channel "Bypass Label (verwendet von ASCET), nicht editieren!/Bypass Table Channel Element(verwendet von ASCET), nicht editieren!" VALUE 0x80020C35 Val_Wu8 255.0 OneToOne 0.00 255.0 /end CHARACTERISTIC
/begin CHARACTERISTIC SCRAd_mNH3LdRst_Bypass.Vector "Bypass Label (verwendet von ASCET), nicht editieren!/Bypass Table Vector Element (verwendet von ASCET), nicht editieren!" VALUE 0x80020C36 Val_Wu8 255.0 OneToOne 0.00 255.0 /end CHARACTERISTIC
/begin CHARACTERISTIC SCRAd_mNH3LdRst_Bypass.Channel "Bypass Label (verwendet von ASCET), nicht editieren!/Bypass Table Channel Element(verwendet von ASCET), nicht editieren!" VALUE 0x80020C37 Val_Wu8 255.0 OneToOne 0.00 255.0 /end CHARACTERISTIC
/begin CHARACTERISTIC SCRAd_stAdapReq_Bypass.Vector "Bypass Label (verwendet von ASCET), nicht editieren!/Bypass Table Vector Element (verwendet von ASCET), nicht editieren!" VALUE 0x80020C38 Val_Wu8 255.0 OneToOne 0.00 255.0 /end CHARACTERISTIC
/begin CHARACTERISTIC SCRAd_stAdapReq_Bypass.Channel "Bypass Label (verwendet von ASCET), nicht editieren!/Bypass Table Channel Element(verwendet von ASCET), nicht editieren!" VALUE 0x80020C39 Val_Wu8 255.0 OneToOne 0.00 255.0 /end CHARACTERISTIC
/begin CHARACTERISTIC SCRAd_stAdapRstReq_Bypass.Vector "Bypass Label (verwendet von ASCET), nicht editieren!/Bypass Table Vector Element (verwendet von ASCET), nicht editieren!" VALUE 0x80020C3A Val_Wu8 255.0 OneToOne 0.00 255.0 /end CHARACTERISTIC
/begin CHARACTERISTIC SCRAd_stAdapRstReq_Bypass.Channel "Bypass Label (verwendet von ASCET), nicht editieren!/Bypass Table Channel Element(verwendet von ASCET), nicht editieren!" VALUE 0x80020C3B Val_Wu8 255.0 OneToOne 0.00 255.0 /end CHARACTERISTIC
/begin CHARACTERISTIC SCRAd_stSlip_Bypass.Vector "Bypass Label (verwendet von ASCET), nicht editieren!/Bypass Table Vector Element (verwendet von ASCET), nicht editieren!" VALUE 0x80020C3C Val_Wu8 255.0 OneToOne 0.00 255.0 /end CHARACTERISTIC
/begin CHARACTERISTIC SCRAd_stSlip_Bypass.Channel "Bypass Label (verwendet von ASCET), nicht editieren!/Bypass Table Channel Element(verwendet von ASCET), nicht editieren!" VALUE 0x80020C3D Val_Wu8 255.0 OneToOne 0.00 255.0 /end CHARACTERISTIC
/begin CHARACTERISTIC SCRFFC_dmNH3CnvAdd_mp_Bypass.Vector "Bypass Label (verwendet von ASCET), nicht editieren!/Bypass Table Vector Element (verwendet von ASCET), nicht editieren!" VALUE 0x80020C3E Val_Wu8 255.0 OneToOne 0.00 255.0 /end CHARACTERISTIC
/begin CHARACTERISTIC SCRFFC_dmNH3CnvAdd_mp_Bypass.Channel "Bypass Label (verwendet von ASCET), nicht editieren!/Bypass Table Channel Element(verwendet von ASCET), nicht editieren!" VALUE 0x80020C3F Val_Wu8 255.0 OneToOne 0.00 255.0 /end CHARACTERISTIC
/begin CHARACTERISTIC SCRFFC_dmNH3Cnv_Bypass.Vector "Bypass Label (verwendet von ASCET), nicht editieren!/Bypass Table Vector Element (verwendet von ASCET), nicht editieren!" VALUE 0x80020C40 Val_Wu8 255.0 OneToOne 0.00 255.0 /end CHARACTERISTIC
/begin CHARACTERISTIC SCRFFC_dmNH3Cnv_Bypass.Channel "Bypass Label (verwendet von ASCET), nicht editieren!/Bypass Table Channel Element(verwendet von ASCET), nicht editieren!" VALUE 0x80020C41 Val_Wu8 255.0 OneToOne 0.00 255.0 /end CHARACTERISTIC
/begin CHARACTERISTIC SCRLdG_mNH3LdNomAdd_mp_Bypass.Vector "Bypass Label (verwendet von ASCET), nicht editieren!/Bypass Table Vector Element (verwendet von ASCET), nicht editieren!" VALUE 0x80020C42 Val_Wu8 255.0 OneToOne 0.00 255.0 /end CHARACTERISTIC
/begin CHARACTERISTIC SCRLdG_mNH3LdNomAdd_mp_Bypass.Channel "Bypass Label (verwendet von ASCET), nicht editieren!/Bypass Table Channel Element(verwendet von ASCET), nicht editieren!" VALUE 0x80020C43 Val_Wu8 255.0 OneToOne 0.00 255.0 /end CHARACTERISTIC
/begin CHARACTERISTIC SCRLdG_mNH3LdNom_Bypass.Vector "Bypass Label (verwendet von ASCET), nicht editieren!/Bypass Table Vector Element (verwendet von ASCET), nicht editieren!" VALUE 0x80020C44 Val_Wu8 255.0 OneToOne 0.00 255.0 /end CHARACTERISTIC
/begin CHARACTERISTIC SCRLdG_mNH3LdNom_Bypass.Channel "Bypass Label (verwendet von ASCET), nicht editieren!/Bypass Table Channel Element(verwendet von ASCET), nicht editieren!" VALUE 0x80020C45 Val_Wu8 255.0 OneToOne 0.00 255.0 /end CHARACTERISTIC
/begin CHARACTERISTIC SCRMod_etaEstAdd_mp_Bypass.Vector "/Bypass Table Vector Element (verwendet von ASCET), nicht editieren!" VALUE 0x80020C46 Val_Wu8 255.0 OneToOne 0.00 255.0 /end CHARACTERISTIC
/begin CHARACTERISTIC SCRMod_etaEstAdd_mp_Bypass.Channel "/Bypass Table Channel Element(verwendet von ASCET), nicht editieren!" VALUE 0x80020C47 Val_Wu8 255.0 OneToOne 0.00 255.0 /end CHARACTERISTIC
/begin CHARACTERISTIC SCRMod_etaEst_Bypass.Vector "/Bypass Table Vector Element (verwendet von ASCET), nicht editieren!" VALUE 0x80020C48 Val_Wu8 255.0 OneToOne 0.00 255.0 /end CHARACTERISTIC
/begin CHARACTERISTIC SCRMod_etaEst_Bypass.Channel "/Bypass Table Channel Element(verwendet von ASCET), nicht editieren!" VALUE 0x80020C49 Val_Wu8 255.0 OneToOne 0.00 255.0 /end CHARACTERISTIC
/begin CHARACTERISTIC SCRMod_mEstNH3LdAdd_mp_Bypass.Vector "/Bypass Table Vector Element (verwendet von ASCET), nicht editieren!" VALUE 0x80020C4A Val_Wu8 255.0 OneToOne 0.00 255.0 /end CHARACTERISTIC
/begin CHARACTERISTIC SCRMod_mEstNH3LdAdd_mp_Bypass.Channel "/Bypass Table Channel Element(verwendet von ASCET), nicht editieren!" VALUE 0x80020C4B Val_Wu8 255.0 OneToOne 0.00 255.0 /end CHARACTERISTIC
/begin CHARACTERISTIC SCRMod_mEstNH3Ld_Bypass.Vector "/Bypass Table Vector Element (verwendet von ASCET), nicht editieren!" VALUE 0x80020C4C Val_Wu8 255.0 OneToOne 0.00 255.0 /end CHARACTERISTIC
/begin CHARACTERISTIC SCRMod_mEstNH3Ld_Bypass.Channel "/Bypass Table Channel Element(verwendet von ASCET), nicht editieren!" VALUE 0x80020C4D Val_Wu8 255.0 OneToOne 0.00 255.0 /end CHARACTERISTIC
/begin CHARACTERISTIC SpdGov_nSetPHi_Elm1_mp2_Bypass.Vector "Bypass Label (verwendet von ASCET), nicht editieren!/Bypass Table Vector Element (verwendet von ASCET), nicht editieren!" VALUE 0x80020C4E Val_Wu8 255.0 OneToOne 0.00 255.0 /end CHARACTERISTIC
/begin CHARACTERISTIC SpdGov_nSetPHi_Elm1_mp2_Bypass.Channel "Bypass Label (verwendet von ASCET), nicht editieren!/Bypass Table Channel Element(verwendet von ASCET), nicht editieren!" VALUE 0x80020C4F Val_Wu8 255.0 OneToOne 0.00 255.0 /end CHARACTERISTIC
/begin CHARACTERISTIC SpdGov_nSetPHi_Elm2_mp2_Bypass.Vector "Bypass Label (verwendet von ASCET), nicht editieren!/Bypass Table Vector Element (verwendet von ASCET), nicht editieren!" VALUE 0x80020C50 Val_Wu8 255.0 OneToOne 0.00 255.0 /end CHARACTERISTIC
/begin CHARACTERISTIC SpdGov_nSetPHi_Elm2_mp2_Bypass.Channel "Bypass Label (verwendet von ASCET), nicht editieren!/Bypass Table Channel Element(verwendet von ASCET), nicht editieren!" VALUE 0x80020C51 Val_Wu8 255.0 OneToOne 0.00 255.0 /end CHARACTERISTIC
/begin CHARACTERISTIC SpdGov_nSetPLo_Elm1_mp2_Bypass.Vector "Bypass Label (verwendet von ASCET), nicht editieren!/Bypass Table Vector Element (verwendet von ASCET), nicht editieren!" VALUE 0x80020C52 Val_Wu8 255.0 OneToOne 0.00 255.0 /end CHARACTERISTIC
/begin CHARACTERISTIC SpdGov_nSetPLo_Elm1_mp2_Bypass.Channel "Bypass Label (verwendet von ASCET), nicht editieren!/Bypass Table Channel Element(verwendet von ASCET), nicht editieren!" VALUE 0x80020C53 Val_Wu8 255.0 OneToOne 0.00 255.0 /end CHARACTERISTIC
/begin CHARACTERISTIC SpdGov_nSetPLo_Elm2_mp2_Bypass.Vector "Bypass Label (verwendet von ASCET), nicht editieren!/Bypass Table Vector Element (verwendet von ASCET), nicht editieren!" VALUE 0x80020C54 Val_Wu8 255.0 OneToOne 0.00 255.0 /end CHARACTERISTIC
/begin CHARACTERISTIC SpdGov_nSetPLo_Elm2_mp2_Bypass.Channel "Bypass Label (verwendet von ASCET), nicht editieren!/Bypass Table Channel Element(verwendet von ASCET), nicht editieren!" VALUE 0x80020C55 Val_Wu8 255.0 OneToOne 0.00 255.0 /end CHARACTERISTIC
/begin CHARACTERISTIC SpdGov_st_Bypass.Vector "Bypass Label (verwendet von ASCET), nicht editieren!/Bypass Table Vector Element (verwendet von ASCET), nicht editieren!" VALUE 0x80020C56 Val_Wu8 255.0 OneToOne 0.00 255.0 /end CHARACTERISTIC
/begin CHARACTERISTIC SpdGov_st_Bypass.Channel "Bypass Label (verwendet von ASCET), nicht editieren!/Bypass Table Channel Element(verwendet von ASCET), nicht editieren!" VALUE 0x80020C57 Val_Wu8 255.0 OneToOne 0.00 255.0 /end CHARACTERISTIC
/begin CHARACTERISTIC SpdGov_trqFlt_Bypass.Vector "Bypass Label (verwendet von ASCET), nicht editieren!/Bypass Table Vector Element (verwendet von ASCET), nicht editieren!" VALUE 0x80020C58 Val_Wu8 255.0 OneToOne 0.00 255.0 /end CHARACTERISTIC
/begin CHARACTERISTIC SpdGov_trqFlt_Bypass.Channel "Bypass Label (verwendet von ASCET), nicht editieren!/Bypass Table Channel Element(verwendet von ASCET), nicht editieren!" VALUE 0x80020C59 Val_Wu8 255.0 OneToOne 0.00 255.0 /end CHARACTERISTIC
/begin CHARACTERISTIC SpdGov_trqInrLimSet_Bypass.Vector "/Bypass Table Vector Element (verwendet von ASCET), nicht editieren!" VALUE 0x80020C5A Val_Wu8 255.0 OneToOne 0.00 255.0 /end CHARACTERISTIC
/begin CHARACTERISTIC SpdGov_trqInrLimSet_Bypass.Channel "/Bypass Table Channel Element(verwendet von ASCET), nicht editieren!" VALUE 0x80020C5B Val_Wu8 255.0 OneToOne 0.00 255.0 /end CHARACTERISTIC
/begin CHARACTERISTIC SpdGov_trqLead_Bypass.Vector "Bypass Label (verwendet von ASCET), nicht editieren!/Bypass Table Vector Element (verwendet von ASCET), nicht editieren!" VALUE 0x80020C5C Val_Wu8 255.0 OneToOne 0.00 255.0 /end CHARACTERISTIC
/begin CHARACTERISTIC SpdGov_trqLead_Bypass.Channel "Bypass Label (verwendet von ASCET), nicht editieren!/Bypass Table Channel Element(verwendet von ASCET), nicht editieren!" VALUE 0x80020C5D Val_Wu8 255.0 OneToOne 0.00 255.0 /end CHARACTERISTIC
/begin CHARACTERISTIC SpdGov_trqSet_Bypass.Vector "Bypass Label (verwendet von ASCET), nicht editieren!/Bypass Table Vector Element (verwendet von ASCET), nicht editieren!" VALUE 0x80020C5E Val_Wu8 255.0 OneToOne 0.00 255.0 /end CHARACTERISTIC
/begin CHARACTERISTIC SpdGov_trqSet_Bypass.Channel "Bypass Label (verwendet von ASCET), nicht editieren!/Bypass Table Channel Element(verwendet von ASCET), nicht editieren!" VALUE 0x80020C5F Val_Wu8 255.0 OneToOne 0.00 255.0 /end CHARACTERISTIC
/begin CHARACTERISTIC ThrVlv_r_Bypass.Vector "Bypass Label (verwendet von ASCET), nicht editieren!/Bypass Table Vector Element (verwendet von ASCET), nicht editieren!" VALUE 0x80020C60 Val_Wu8 255.0 OneToOne 0.00 255.0 /end CHARACTERISTIC
/begin CHARACTERISTIC ThrVlv_r_Bypass.Channel "Bypass Label (verwendet von ASCET), nicht editieren!/Bypass Table Channel Element(verwendet von ASCET), nicht editieren!" VALUE 0x80020C61 Val_Wu8 255.0 OneToOne 0.00 255.0 /end CHARACTERISTIC
/begin CHARACTERISTIC TrbCh_rPs_Bypass.Vector "Bypass Label (verwendet von ASCET), nicht editieren!/Bypass Table Vector Element (verwendet von ASCET), nicht editieren!" VALUE 0x80020C62 Val_Wu8 255.0 OneToOne 0.00 255.0 /end CHARACTERISTIC
/begin CHARACTERISTIC TrbCh_rPs_Bypass.Channel "Bypass Label (verwendet von ASCET), nicht editieren!/Bypass Table Channel Element(verwendet von ASCET), nicht editieren!" VALUE 0x80020C63 Val_Wu8 255.0 OneToOne 0.00 255.0 /end CHARACTERISTIC
/begin CHARACTERISTIC UDC_dmRdcAgActAdd_mp_Bypass.Vector "/Bypass Table Vector Element (verwendet von ASCET), nicht editieren!" VALUE 0x80020C64 Val_Wu8 255.0 OneToOne 0.00 255.0 /end CHARACTERISTIC
/begin CHARACTERISTIC UDC_dmRdcAgActAdd_mp_Bypass.Channel "/Bypass Table Channel Element(verwendet von ASCET), nicht editieren!" VALUE 0x80020C65 Val_Wu8 255.0 OneToOne 0.00 255.0 /end CHARACTERISTIC
/begin CHARACTERISTIC UDC_dmRdcAgAct_Bypass.Vector "/Bypass Table Vector Element (verwendet von ASCET), nicht editieren!" VALUE 0x80020C66 Val_Wu8 255.0 OneToOne 0.00 255.0 /end CHARACTERISTIC
/begin CHARACTERISTIC UDC_dmRdcAgAct_Bypass.Channel "/Bypass Table Channel Element(verwendet von ASCET), nicht editieren!" VALUE 0x80020C67 Val_Wu8 255.0 OneToOne 0.00 255.0 /end CHARACTERISTIC
/begin CHARACTERISTIC VehMot_stPrpCrCtl_Bypass.Vector "Bypass Label (verwendet von ASCET), nicht editieren!/Bypass Table Vector Element (verwendet von ASCET), nicht editieren!" VALUE 0x80020C68 Val_Wu8 255.0 OneToOne 0.00 255.0 /end CHARACTERISTIC
/begin CHARACTERISTIC VehMot_stPrpCrCtl_Bypass.Channel "Bypass Label (verwendet von ASCET), nicht editieren!/Bypass Table Channel Element(verwendet von ASCET), nicht editieren!" VALUE 0x80020C69 Val_Wu8 255.0 OneToOne 0.00 255.0 /end CHARACTERISTIC
/begin CHARACTERISTIC VMD_rVirtAPP_Bypass.Vector "Bypass Label (verwendet von ASCET), nicht editieren!/Bypass Table Vector Element (verwendet von ASCET), nicht editieren!" VALUE 0x80020C6A Val_Wu8 255.0 OneToOne 0.00 255.0 /end CHARACTERISTIC
/begin CHARACTERISTIC VMD_rVirtAPP_Bypass.Channel "Bypass Label (verwendet von ASCET), nicht editieren!/Bypass Table Channel Element(verwendet von ASCET), nicht editieren!" VALUE 0x80020C6B Val_Wu8 255.0 OneToOne 0.00 255.0 /end CHARACTERISTIC
/begin CHARACTERISTIC VMD_trqDes_Bypass.Vector "Bypass Label (verwendet von ASCET), nicht editieren!/Bypass Table Vector Element (verwendet von ASCET), nicht editieren!" VALUE 0x80020C6C Val_Wu8 255.0 OneToOne 0.00 255.0 /end CHARACTERISTIC
/begin CHARACTERISTIC VMD_trqDes_Bypass.Channel "Bypass Label (verwendet von ASCET), nicht editieren!/Bypass Table Channel Element(verwendet von ASCET), nicht editieren!" VALUE 0x80020C6D Val_Wu8 255.0 OneToOne 0.00 255.0 /end CHARACTERISTIC
/begin CHARACTERISTIC VSwCtl_rCtlValNrm_mp_Bypass.Vector "/Bypass Table Vector Element (verwendet von ASCET), nicht editieren!" VALUE 0x80020C6E Val_Wu8 255.0 OneToOne 0.00 255.0 /end CHARACTERISTIC
/begin CHARACTERISTIC VSwCtl_rCtlValNrm_mp_Bypass.Channel "/Bypass Table Channel Element(verwendet von ASCET), nicht editieren!" VALUE 0x80020C6F Val_Wu8 255.0 OneToOne 0.00 255.0 /end CHARACTERISTIC
/begin CHARACTERISTIC VSwVlv_rPs_Bypass.Vector "/Bypass Table Vector Element (verwendet von ASCET), nicht editieren!" VALUE 0x80020C70 Val_Wu8 255.0 OneToOne 0.00 255.0 /end CHARACTERISTIC
/begin CHARACTERISTIC VSwVlv_rPs_Bypass.Channel "/Bypass Table Channel Element(verwendet von ASCET), nicht editieren!" VALUE 0x80020C71 Val_Wu8 255.0 OneToOne 0.00 255.0 /end CHARACTERISTIC
/begin CHARACTERISTIC VSwVlv_rVSw_Bypass.Vector "/Bypass Table Vector Element (verwendet von ASCET), nicht editieren!" VALUE 0x80020C72 Val_Wu8 255.0 OneToOne 0.00 255.0 /end CHARACTERISTIC
/begin CHARACTERISTIC VSwVlv_rVSw_Bypass.Channel "/Bypass Table Channel Element(verwendet von ASCET), nicht editieren!" VALUE 0x80020C73 Val_Wu8 255.0 OneToOne 0.00 255.0 /end CHARACTERISTIC
/begin CHARACTERISTIC VSwVlv_r_Bypass.Vector "Bypass Label (verwendet von ASCET), nicht editieren!/Bypass Table Vector Element (verwendet von ASCET), nicht editieren!" VALUE 0x80020C74 Val_Wu8 255.0 OneToOne 0.00 255.0 /end CHARACTERISTIC
/begin CHARACTERISTIC VSwVlv_r_Bypass.Channel "Bypass Label (verwendet von ASCET), nicht editieren!/Bypass Table Channel Element(verwendet von ASCET), nicht editieren!" VALUE 0x80020C75 Val_Wu8 255.0 OneToOne 0.00 255.0 /end CHARACTERISTIC
/begin MEASUREMENT Air_dtTCACDs "Änderungsrate der geladenen Lufttemperatur" SWORD TempCels_100ms 1 100 -32768.00 32767.00 FORMAT "%8.2" ECU_ADDRESS 0xD000062E /end MEASUREMENT
/begin MEASUREMENT Air_tCACDs "Temperatur nach dem Ladeluftkühler" SWORD Temp_Cels 1 100 -3549.940 3003.560 ECU_ADDRESS 0xD0000640 /end MEASUREMENT
/begin MEASUREMENT Air_tSensTCACDs "Erfasster Wert der Lufttemperatur nach dem Ladeluftkühler" SWORD Temp_Cels 1 100 -3549.940 3003.560 ECU_ADDRESS 0xD0000648 /end MEASUREMENT
/begin MEASUREMENT Air_uRawTCACDs "Der aus ADC für CACDsT erfasste Rohspannungswert" SWORD Volt 1 100 -6553.600 6553.400 ECU_ADDRESS 0xD000064C /end MEASUREMENT
/begin MEASUREMENT Byp_stEcuGlobal "Bypass-Status (Bit0: CAN Bypass aktiv, Bit1: CAN Bypass wartet, Bit2: ETK Bypass aktiv, Bit3: ETK Bypass wartet, Bit4: Internal Bypass aktiv, Bit5: Internal Bypass wartet)" UBYTE OneToOne 1 100 0.00 255.0 ECU_ADDRESS 0xC0006378 /end MEASUREMENT
/begin MEASUREMENT DStgy_dmNH3CurrBefAdd_mp "Automatisch generierter Messpunkt vor einem Bypasseingriff" SLONG SCR_Dm005 1 100 -107374182.400 107374182.350 FORMAT "%13.3" ECU_ADDRESS 0xC0008E38 /end MEASUREMENT
/begin MEASUREMENT DStgy_dmNH3CurrBefByp_mp "Automatisch generierter Messpunkt vor einem Bypasseingriff" SLONG SCR_Dm005 1 100 -107374182.400 107374182.350 FORMAT "%13.3" ECU_ADDRESS 0xC0008E3C /end MEASUREMENT
/begin MEASUREMENT DStgy_dmRdcAgDesBefAdd_mp "" SWORD SCR_Dm01 1 100 -3276.800 3276.700 FORMAT "%8.3" ECU_ADDRESS 0xC0009AEA /end MEASUREMENT
/begin MEASUREMENT DStgy_dmRdcAgDesBefRepl_mp "" SWORD SCR_Dm01 1 100 -3276.800 3276.700 FORMAT "%8.3" ECU_ADDRESS 0xC0009AEC /end MEASUREMENT
/begin MEASUREMENT LSU_dcycHtStrt_0_mp1 "Automatisch generierter Messpunkt vor einem Bypasseingriff" SWORD DtyCyc 1 100 -327.6800 327.6700 ECU_ADDRESS 0xC0009AEE /end MEASUREMENT
/begin MEASUREMENT LSU_dcycHtStrt_0_mp2 "Automatisch generierter Messpunkt nach einem Bypasseingriff" SWORD DtyCyc 1 100 -327.6800 327.6700 ECU_ADDRESS 0xC0009AF0 /end MEASUREMENT
/begin MEASUREMENT LSU_dcycHtStrt_1_mp1 "Automatisch generierter Messpunkt vor einem Bypasseingriff" SWORD DtyCyc 1 100 -327.6800 327.6700 ECU_ADDRESS 0xC0009AF2 /end MEASUREMENT
/begin MEASUREMENT LSU_dcycHtStrt_1_mp2 "Automatisch generierter Messpunkt nach einem Bypasseingriff" SWORD DtyCyc 1 100 -327.6800 327.6700 ECU_ADDRESS 0xC0009AF4 /end MEASUREMENT
/begin MEASUREMENT LSU_dcycHtStrt_2_mp1 "Automatisch generierter Messpunkt vor einem Bypasseingriff" SWORD DtyCyc 1 100 -327.6800 327.6700 ECU_ADDRESS 0xC0009AF6 /end MEASUREMENT
/begin MEASUREMENT LSU_dcycHtStrt_2_mp2 "Automatisch generierter Messpunkt nach einem Bypasseingriff" SWORD DtyCyc 1 100 -327.6800 327.6700 ECU_ADDRESS 0xC0009AF8 /end MEASUREMENT
/begin MEASUREMENT LSU_dcycHtStrt_3_mp1 "Automatisch generierter Messpunkt vor einem Bypasseingriff" SWORD DtyCyc 1 100 -327.6800 327.6700 ECU_ADDRESS 0xC0009AFA /end MEASUREMENT
/begin MEASUREMENT LSU_dcycHtStrt_3_mp2 "Automatisch generierter Messpunkt nach einem Bypasseingriff" SWORD DtyCyc 1 100 -327.6800 327.6700 ECU_ADDRESS 0xC0009AFC /end MEASUREMENT
/begin MEASUREMENT LSU_rO2PresComp_0_mp1 "Automatisch generierter Messpunkt vor einem Bypasseingriff" SWORD O2 1 100 -0.3276800 0.3276700 ECU_ADDRESS 0xC0009AFE /end MEASUREMENT
/begin MEASUREMENT LSU_rO2PresComp_0_mp2 "Automatisch generierter Messpunkt nach einem Bypasseingriff" SWORD O2 1 100 -0.3276800 0.3276700 ECU_ADDRESS 0xC0009B00 /end MEASUREMENT
/begin MEASUREMENT LSU_rO2PresComp_1_mp1 "Automatisch generierter Messpunkt vor einem Bypasseingriff" SWORD O2 1 100 -0.3276800 0.3276700 ECU_ADDRESS 0xC0009B02 /end MEASUREMENT
/begin MEASUREMENT LSU_rO2PresComp_1_mp2 "Automatisch generierter Messpunkt nach einem Bypasseingriff" SWORD O2 1 100 -0.3276800 0.3276700 ECU_ADDRESS 0xC0009B04 /end MEASUREMENT
/begin MEASUREMENT LSU_rO2PresComp_2_mp1 "Automatisch generierter Messpunkt vor einem Bypasseingriff" SWORD O2 1 100 -0.3276800 0.3276700 ECU_ADDRESS 0xC0009B06 /end MEASUREMENT
/begin MEASUREMENT LSU_rO2PresComp_2_mp2 "Automatisch generierter Messpunkt nach einem Bypasseingriff" SWORD O2 1 100 -0.3276800 0.3276700 ECU_ADDRESS 0xC0009B08 /end MEASUREMENT
/begin MEASUREMENT LSU_rO2PresComp_3_mp1 "Automatisch generierter Messpunkt vor einem Bypasseingriff" SWORD O2 1 100 -0.3276800 0.3276700 ECU_ADDRESS 0xC0009B0A /end MEASUREMENT
/begin MEASUREMENT LSU_rO2PresComp_3_mp2 "Automatisch generierter Messpunkt nach einem Bypasseingriff" SWORD O2 1 100 -0.3276800 0.3276700 ECU_ADDRESS 0xC0009B0C /end MEASUREMENT
/begin MEASUREMENT LSU_rO2Raw_0_mp1 "Automatisch generierter Messpunkt vor einem Bypasseingriff" SWORD O2 1 100 -0.3276800 0.3276700 ECU_ADDRESS 0xC0009B0E /end MEASUREMENT
/begin MEASUREMENT LSU_rO2Raw_0_mp2 "Automatisch generierter Messpunkt nach einem Bypasseingriff" SWORD O2 1 100 -0.3276800 0.3276700 ECU_ADDRESS 0xC0009B10 /end MEASUREMENT
/begin MEASUREMENT LSU_rO2Raw_1_mp1 "Automatisch generierter Messpunkt vor einem Bypasseingriff" SWORD O2 1 100 -0.3276800 0.3276700 ECU_ADDRESS 0xC0009B12 /end MEASUREMENT
/begin MEASUREMENT LSU_rO2Raw_1_mp2 "Automatisch generierter Messpunkt nach einem Bypasseingriff" SWORD O2 1 100 -0.3276800 0.3276700 ECU_ADDRESS 0xC0009B14 /end MEASUREMENT
/begin MEASUREMENT LSU_rO2Raw_2_mp1 "Automatisch generierter Messpunkt vor einem Bypasseingriff" SWORD O2 1 100 -0.3276800 0.3276700 ECU_ADDRESS 0xC0009B16 /end MEASUREMENT
/begin MEASUREMENT LSU_rO2Raw_2_mp2 "Automatisch generierter Messpunkt nach einem Bypasseingriff" SWORD O2 1 100 -0.3276800 0.3276700 ECU_ADDRESS 0xC0009B18 /end MEASUREMENT
/begin MEASUREMENT LSU_rO2Raw_3_mp1 "Automatisch generierter Messpunkt vor einem Bypasseingriff" SWORD O2 1 100 -0.3276800 0.3276700 ECU_ADDRESS 0xC0009B1A /end MEASUREMENT
/begin MEASUREMENT LSU_rO2Raw_3_mp2 "Automatisch generierter Messpunkt nach einem Bypasseingriff" SWORD O2 1 100 -0.3276800 0.3276700 ECU_ADDRESS 0xC0009B1C /end MEASUREMENT
/begin MEASUREMENT LSU_stO2IntValid_0_mp1 "Automatisch generierter Messpunkt vor einem Bypasseingriff" UBYTE OneToOne 1 100 0.00 255.0 ECU_ADDRESS 0xC000B0B1 /end MEASUREMENT
/begin MEASUREMENT LSU_stO2IntValid_0_mp2 "Automatisch generierter Messpunkt nach einem Bypasseingriff" UBYTE OneToOne 1 100 0.00 255.0 ECU_ADDRESS 0xC000B0B2 /end MEASUREMENT
/begin MEASUREMENT LSU_stO2IntValid_1_mp1 "Automatisch generierter Messpunkt vor einem Bypasseingriff" UBYTE OneToOne 1 100 0.00 255.0 ECU_ADDRESS 0xC000B0B3 /end MEASUREMENT
/begin MEASUREMENT LSU_stO2IntValid_1_mp2 "Automatisch generierter Messpunkt nach einem Bypasseingriff" UBYTE OneToOne 1 100 0.00 255.0 ECU_ADDRESS 0xC000B0B4 /end MEASUREMENT
/begin MEASUREMENT LSU_stO2IntValid_2_mp1 "Automatisch generierter Messpunkt vor einem Bypasseingriff" UBYTE OneToOne 1 100 0.00 255.0 ECU_ADDRESS 0xC000B0B5 /end MEASUREMENT
/begin MEASUREMENT LSU_stO2IntValid_2_mp2 "Automatisch generierter Messpunkt nach einem Bypasseingriff" UBYTE OneToOne 1 100 0.00 255.0 ECU_ADDRESS 0xC000B0B6 /end MEASUREMENT
/begin MEASUREMENT LSU_stO2IntValid_3_mp1 "Automatisch generierter Messpunkt vor einem Bypasseingriff" UBYTE OneToOne 1 100 0.00 255.0 ECU_ADDRESS 0xC000B0B7 /end MEASUREMENT
/begin MEASUREMENT LSU_stO2IntValid_3_mp2 "Automatisch generierter Messpunkt nach einem Bypasseingriff" UBYTE OneToOne 1 100 0.00 255.0 ECU_ADDRESS 0xC000B0B8 /end MEASUREMENT
/begin MEASUREMENT LSU_tRi_0_mp1 "Automatisch generierter Messpunkt vor einem Bypasseingriff" SWORD Temp_Cels 1 100 -3549.940 3003.560 ECU_ADDRESS 0xC0009B1E /end MEASUREMENT
/begin MEASUREMENT LSU_tRi_0_mp2 "Automatisch generierter Messpunkt nach einem Bypasseingriff" SWORD Temp_Cels 1 100 -3549.940 3003.560 ECU_ADDRESS 0xC0009B20 /end MEASUREMENT
/begin MEASUREMENT LSU_tRi_1_mp1 "Automatisch generierter Messpunkt vor einem Bypasseingriff" SWORD Temp_Cels 1 100 -3549.940 3003.560 ECU_ADDRESS 0xC0009B22 /end MEASUREMENT
/begin MEASUREMENT LSU_tRi_1_mp2 "Automatisch generierter Messpunkt nach einem Bypasseingriff" SWORD Temp_Cels 1 100 -3549.940 3003.560 ECU_ADDRESS 0xC0009B24 /end MEASUREMENT
/begin MEASUREMENT LSU_tRi_2_mp1 "Automatisch generierter Messpunkt vor einem Bypasseingriff" SWORD Temp_Cels 1 100 -3549.940 3003.560 ECU_ADDRESS 0xC0009B26 /end MEASUREMENT
/begin MEASUREMENT LSU_tRi_2_mp2 "Automatisch generierter Messpunkt nach einem Bypasseingriff" SWORD Temp_Cels 1 100 -3549.940 3003.560 ECU_ADDRESS 0xC0009B28 /end MEASUREMENT
/begin MEASUREMENT LSU_tRi_3_mp1 "Automatisch generierter Messpunkt vor einem Bypasseingriff" SWORD Temp_Cels 1 100 -3549.940 3003.560 ECU_ADDRESS 0xC0009B2A /end MEASUREMENT
/begin MEASUREMENT LSU_tRi_3_mp2 "Automatisch generierter Messpunkt nach einem Bypasseingriff" SWORD Temp_Cels 1 100 -3549.940 3003.560 ECU_ADDRESS 0xC0009B2C /end MEASUREMENT
/begin MEASUREMENT PCV_iSetBefAdd_mp "Automatisch generierter Messpunkt vor einem Bypasseingriff" SWORD Curr 1 100 -32768.00 32767.00 FORMAT "%8.2" ECU_ADDRESS 0xC0009B2E /end MEASUREMENT
/begin MEASUREMENT PCV_iSetBefRepl_mp "Automatisch generierter Messpunkt vor einem Bypasseingriff" SWORD Curr 1 100 -32768.00 32767.00 FORMAT "%8.2" ECU_ADDRESS 0xC0009B30 /end MEASUREMENT
/begin MEASUREMENT SCRAd_facQtyAdapBefAdd_mp "Automatisch generierter Messpunkt vor einem Bypasseingriff" SWORD SCR_Fact1000 1 100 -32.76800 32.76700 FORMAT "%8.5" ECU_ADDRESS 0xC0009B32 /end MEASUREMENT
/begin MEASUREMENT SCRAd_facQtyAdapBefByp_mp "Automatisch generierter Messpunkt vor einem Bypasseingriff" SWORD SCR_Fact1000 1 100 -32.76800 32.76700 FORMAT "%8.5" ECU_ADDRESS 0xC0009B34 /end MEASUREMENT
/begin MEASUREMENT SCRAd_mNH3LdAdapBefAdd_mp "Automatisch generierter Messpunkt vor einem Bypasseingriff" SWORD SCR_Mass1000 1 100 -32.76800 32.76700 FORMAT "%8.5" ECU_ADDRESS 0xC0009B36 /end MEASUREMENT
/begin MEASUREMENT SCRAd_mNH3LdAdapBefByp_mp "Automatisch generierter Messpunkt vor einem Bypasseingriff" SWORD SCR_Mass1000 1 100 -32.76800 32.76700 FORMAT "%8.5" ECU_ADDRESS 0xC0009B38 /end MEASUREMENT
/begin MEASUREMENT SCRAd_mNH3LdRstBefAdd_mp "Automatisch generierter Messpunkt vor einem Bypasseingriff" SWORD SCR_Mass1000 1 100 -32.76800 32.76700 FORMAT "%8.5" ECU_ADDRESS 0xC0009B3A /end MEASUREMENT
/begin MEASUREMENT SCRAd_mNH3LdRstBefByp_mp "Automatisch generierter Messpunkt vor einem Bypasseingriff" SWORD SCR_Mass1000 1 100 -32.76800 32.76700 FORMAT "%8.5" ECU_ADDRESS 0xC0009B3C /end MEASUREMENT
/begin MEASUREMENT SCRAd_stAdapReqBefByp_mp "Automatisch generierter Messpunkt vor einem Bypasseingriff" UBYTE SCRAd_Compu_Switch_1 1 100 0.00 1.00000000000 FORMAT "%13.11" ECU_ADDRESS 0xC000B0B9 /end MEASUREMENT
/begin MEASUREMENT SCRAd_stAdapRstReqBefByp_mp "Automatisch generierter Messpunkt vor einem Bypasseingriff" UBYTE SCRAd_Compu_Switch_2 1 100 0.00 1.00000000000 FORMAT "%13.11" ECU_ADDRESS 0xC000B0BA /end MEASUREMENT
/begin MEASUREMENT SCRAd_stSlipBefByp_mp "Automatisch generierter Messpunkt vor einem Bypasseingriff" UBYTE OneToOne 1 100 0.00 255.0 ECU_ADDRESS 0xC000B0BB /end MEASUREMENT
/begin MEASUREMENT SCRFFC_dmNH3CnvBefAdd_mp "Automatisch generierter Messpunkt vor einem Bypasseingriff" SWORD SCR_dmNH3_mg_p_s 1 100 -1638.400 1638.350 FORMAT "%8.3" ECU_ADDRESS 0xC0009B3E /end MEASUREMENT
/begin MEASUREMENT SCRFFC_dmNH3CnvBefByp_mp "Automatisch generierter Messpunkt vor einem Bypasseingriff" SWORD SCR_dmNH3_mg_p_s 1 100 -1638.400 1638.350 FORMAT "%8.3" ECU_ADDRESS 0xC0009B40 /end MEASUREMENT
/begin MEASUREMENT SCRLdG_mNH3LdNomBefAdd_mp "Automatisch generierter Messpunkt vor einem Bypasseingriff" SWORD SCR_Mass1000 1 100 -32.76800 32.76700 FORMAT "%8.5" ECU_ADDRESS 0xC0009B42 /end MEASUREMENT
/begin MEASUREMENT SCRLdG_mNH3LdNomBefByp_mp "Automatisch generierter Messpunkt vor einem Bypasseingriff" SWORD SCR_Mass1000 1 100 -32.76800 32.76700 FORMAT "%8.5" ECU_ADDRESS 0xC0009B44 /end MEASUREMENT
/begin MEASUREMENT SCRMod_etaEstBefAdd_mp "" SWORD SCR_Fact1000 1 100 -32.76800 32.76700 FORMAT "%8.5" ECU_ADDRESS 0xC0009B46 /end MEASUREMENT
/begin MEASUREMENT SCRMod_etaEstBefRepl_mp "" SWORD SCR_Fact1000 1 100 -32.76800 32.76700 FORMAT "%8.5" ECU_ADDRESS 0xC0009B48 /end MEASUREMENT
/begin MEASUREMENT SCRMod_mEstNH3LdBefAdd_mp "" SWORD SCR_Fact1000 1 100 -32.76800 32.76700 FORMAT "%8.5" ECU_ADDRESS 0xC0009B4A /end MEASUREMENT
/begin MEASUREMENT SCRMod_mEstNH3LdBefRepl_mp "" SWORD SCR_Fact1000 1 100 -32.76800 32.76700 FORMAT "%8.5" ECU_ADDRESS 0xC0009B4C /end MEASUREMENT
/begin MEASUREMENT SpdGov_nSetPHi_Elm1_mp2 "Automatisch generierter Messpunkt nach einem Bypasseingriff" SWORD EngN 1 100 -16384.00 16383.50 ECU_ADDRESS 0xC0009B4E /end MEASUREMENT
/begin MEASUREMENT SpdGov_nSetPHi_Elm2_mp2 "Automatisch generierter Messpunkt nach einem Bypasseingriff" SWORD EngN 1 100 -16384.00 16383.50 ECU_ADDRESS 0xC0009B50 /end MEASUREMENT
/begin MEASUREMENT SpdGov_nSetPLo_Elm1_mp2 "Automatisch generierter Messpunkt nach einem Bypasseingriff" SWORD EngN 1 100 -16384.00 16383.50 ECU_ADDRESS 0xC0009B52 /end MEASUREMENT
/begin MEASUREMENT SpdGov_nSetPLo_Elm2_mp2 "Automatisch generierter Messpunkt nach einem Bypasseingriff" SWORD EngN 1 100 -16384.00 16383.50 ECU_ADDRESS 0xC0009B54 /end MEASUREMENT
/begin MEASUREMENT UDC_dmRdcAgActBefAdd_mp "" SWORD SCR_Dm01 1 100 -3276.800 3276.700 FORMAT "%8.3" ECU_ADDRESS 0xC0009B56 /end MEASUREMENT
/begin MEASUREMENT UDC_dmRdcAgActBefRepl_mp "" SWORD SCR_Dm01 1 100 -3276.800 3276.700 FORMAT "%8.3" ECU_ADDRESS 0xC0009B58 /end MEASUREMENT
/begin FUNCTION BypDrv ""
 /begin DEF_CHARACTERISTIC AccPed_trqDes_Bypass.Vector AccPed_trqDes_Bypass.Channel AccPed_trqLead_Bypass.Vector AccPed_trqLead_Bypass.Channel AGSDem_nSetPHi_Bypass.Vector AGSDem_nSetPHi_Bypass.Channel AGSDem_nSetPLo_Bypass.Vector AGSDem_nSetPLo_Bypass.Channel AirCtl_mDesBas_Bypass.Vector AirCtl_mDesBas_Bypass.Channel AirCtl_mDesVal_Bypass.Vector AirCtl_mDesVal_Bypass.Channel AirCtl_rCtlVal_Bypass.Vector AirCtl_rCtlVal_Bypass.Channel AirCtl_rGovEGR_Bypass.Vector AirCtl_rGovEGR_Bypass.Channel AirCtl_rGovOut_mp_Bypass.Vector AirCtl_rGovOut_mp_Bypass.Channel AirCtl_rGovTVA_Bypass.Vector AirCtl_rGovTVA_Bypass.Channel APP_r_Bypass.Vector APP_r_Bypass.Channel ASDdc_trq_Bypass.Vector ASDdc_trq_Bypass.Channel ASDrf_trqInrSet_Bypass.Vector ASDrf_trqInrSet_Bypass.Channel ASMod_arEffEGRLPCor_Bypass.Vector ASMod_arEffEGRLPCor_Bypass.Channel ASMod_dmAshEG_Bypass.Vector ASMod_dmAshEG_Bypass.Channel ASMod_dmCmprUs_r32_Bypass.Vector ASMod_dmCmprUs_r32_Bypass.Channel ASMod_dmEGFld_0_Bypass.Vector ASMod_dmEGFld_0_Bypass.Channel ASMod_dmEGFld_1_Bypass.Vector ASMod_dmEGFld_1_Bypass.Channel ASMod_dmEGFld_2_Bypass.Vector ASMod_dmEGFld_2_Bypass.Channel ASMod_dmEGFld_3_Bypass.Vector ASMod_dmEGFld_3_Bypass.Channel ASMod_dmEGFld_4_Bypass.Vector ASMod_dmEGFld_4_Bypass.Channel ASMod_dmEGFld_5_Bypass.Vector ASMod_dmEGFld_5_Bypass.Channel ASMod_dmEGFld_6_Bypass.Vector ASMod_dmEGFld_6_Bypass.Channel ASMod_dmEGRDs_Bypass.Vector ASMod_dmEGRDs_Bypass.Channel ASMod_dmEGRLPDs_r32_Bypass.Vector ASMod_dmEGRLPDs_r32_Bypass.Channel ASMod_dmExhMnfDs_Bypass.Vector ASMod_dmExhMnfDs_Bypass.Channel ASMod_dmExhMnfUs_Bypass.Vector ASMod_dmExhMnfUs_Bypass.Channel ASMod_dmIndAirRef_Bypass.Vector ASMod_dmIndAirRef_Bypass.Channel ASMod_dmIntMnfDs_Bypass.Vector ASMod_dmIntMnfDs_Bypass.Channel ASMod_dmIntMnfUs_r32_Bypass.Vector ASMod_dmIntMnfUs_r32_Bypass.Channel ASMod_dmNOxEG_Bypass.Vector ASMod_dmNOxEG_Bypass.Channel ASMod_dmO2IntMnfDs_Bypass.Vector ASMod_dmO2IntMnfDs_Bypass.Channel ASMod_dmOilCons_Bypass.Vector ASMod_dmOilCons_Bypass.Channel ASMod_dmSotEG_Bypass.Vector ASMod_dmSotEG_Bypass.Channel ASMod_dvolIntMnfDsRef_Bypass.Vector ASMod_dvolIntMnfDsRef_Bypass.Channel ASMod_dvolPFltEG_Bypass.Vector ASMod_dvolPFltEG_Bypass.Channel ASMod_facVolEff_Bypass.Vector ASMod_facVolEff_Bypass.Channel ASMod_mAirPerCylCor_Bypass.Vector ASMod_mAirPerCylCor_Bypass.Channel ASMod_mIndVol_r32_Bypass.Vector ASMod_mIndVol_r32_Bypass.Channel ASMod_pCmprUs_r32_Bypass.Vector ASMod_pCmprUs_r32_Bypass.Channel ASMod_pEGFld_0_Bypass.Vector ASMod_pEGFld_0_Bypass.Channel ASMod_pEGFld_1_Bypass.Vector ASMod_pEGFld_1_Bypass.Channel ASMod_pEGFld_2_Bypass.Vector ASMod_pEGFld_2_Bypass.Channel ASMod_pEGFld_3_Bypass.Vector ASMod_pEGFld_3_Bypass.Channel ASMod_pEGFld_4_Bypass.Vector ASMod_pEGFld_4_Bypass.Channel ASMod_pEGFld_5_Bypass.Vector ASMod_pEGFld_5_Bypass.Channel ASMod_pEGFld_6_Bypass.Vector ASMod_pEGFld_6_Bypass.Channel ASMod_pEGFld_7_Bypass.Vector ASMod_pEGFld_7_Bypass.Channel ASMod_pEGRLPDs_r32_Bypass.Vector ASMod_pEGRLPDs_r32_Bypass.Channel ASMod_pIndVol_r32_Bypass.Vector ASMod_pIndVol_r32_Bypass.Channel ASMod_rEGR_Bypass.Vector ASMod_rEGR_Bypass.Channel ASMod_rLamRecEGSensSim_Bypass.Vector ASMod_rLamRecEGSensSim_Bypass.Channel ASMod_rLamRecEG_Bypass.Vector ASMod_rLamRecEG_Bypass.Channel ASMod_rLamRecExhMnfDs_Bypass.Vector ASMod_rLamRecExhMnfDs_Bypass.Channel ASMod_rNOxEG_Bypass.Vector ASMod_rNOxEG_Bypass.Channel ASMod_rO2EGFld_0_Bypass.Vector ASMod_rO2EGFld_0_Bypass.Channel ASMod_rO2EGFld_1_Bypass.Vector ASMod_rO2EGFld_1_Bypass.Channel ASMod_rO2EGFld_2_Bypass.Vector ASMod_rO2EGFld_2_Bypass.Channel ASMod_rO2EGFld_3_Bypass.Vector ASMod_rO2EGFld_3_Bypass.Channel ASMod_rO2EGFld_4_Bypass.Vector ASMod_rO2EGFld_4_Bypass.Channel ASMod_rO2EGFld_5_Bypass.Vector ASMod_rO2EGFld_5_Bypass.Channel ASMod_rO2EGFld_6_Bypass.Vector ASMod_rO2EGFld_6_Bypass.Channel ASMod_rO2ExhMnfUs_Bypass.Vector ASMod_rO2ExhMnfUs_Bypass.Channel ASMod_rRelPosECB_Bypass.Vector ASMod_rRelPosECB_Bypass.Channel ASMod_rRelPosTVA_Bypass.Vector ASMod_rRelPosTVA_Bypass.Channel ASMod_rRelPosVSA_Bypass.Vector ASMod_rRelPosVSA_Bypass.Channel ASMod_tCmprUs_r32_Bypass.Vector ASMod_tCmprUs_r32_Bypass.Channel ASMod_tEGFld_0_Bypass.Vector ASMod_tEGFld_0_Bypass.Channel ASMod_tEGFld_10_Bypass.Vector ASMod_tEGFld_10_Bypass.Channel ASMod_tEGFld_11_Bypass.Vector ASMod_tEGFld_11_Bypass.Channel ASMod_tEGFld_12_Bypass.Vector ASMod_tEGFld_12_Bypass.Channel ASMod_tEGFld_13_Bypass.Vector ASMod_tEGFld_13_Bypass.Channel ASMod_tEGFld_1_Bypass.Vector ASMod_tEGFld_1_Bypass.Channel ASMod_tEGFld_2_Bypass.Vector ASMod_tEGFld_2_Bypass.Channel ASMod_tEGFld_3_Bypass.Vector ASMod_tEGFld_3_Bypass.Channel ASMod_tEGFld_4_Bypass.Vector ASMod_tEGFld_4_Bypass.Channel ASMod_tEGFld_5_Bypass.Vector ASMod_tEGFld_5_Bypass.Channel ASMod_tEGFld_6_Bypass.Vector ASMod_tEGFld_6_Bypass.Channel ASMod_tEGFld_7_Bypass.Vector ASMod_tEGFld_7_Bypass.Channel ASMod_tEGFld_8_Bypass.Vector ASMod_tEGFld_8_Bypass.Channel ASMod_tEGFld_9_Bypass.Vector ASMod_tEGFld_9_Bypass.Channel ASMod_tEGRDs_Bypass.Vector ASMod_tEGRDs_Bypass.Channel ASMod_tEGRLPDs_r32_Bypass.Vector ASMod_tEGRLPDs_r32_Bypass.Channel ASMod_tExhMnfDs_Bypass.Vector ASMod_tExhMnfDs_Bypass.Channel ASMod_tExhMnfUs_Bypass.Vector ASMod_tExhMnfUs_Bypass.Channel ASMod_tIntMnfDsRef_Bypass.Vector ASMod_tIntMnfDsRef_Bypass.Channel ASMod_tIntMnfDs_Bypass.Vector ASMod_tIntMnfDs_Bypass.Channel ASMod_tIntMnfUs_Bypass.Vector ASMod_tIntMnfUs_Bypass.Channel ASMod_tPFltSurfSim_Bypass.Vector ASMod_tPFltSurfSim_Bypass.Channel ASMod_tWallFld_0_Bypass.Vector ASMod_tWallFld_0_Bypass.Channel ASMod_tWallFld_1_Bypass.Vector ASMod_tWallFld_1_Bypass.Channel ASMod_tWallFld_2_Bypass.Vector ASMod_tWallFld_2_Bypass.Channel ASMod_tWallFld_3_Bypass.Vector ASMod_tWallFld_3_Bypass.Channel ASMod_tWallFld_4_Bypass.Vector ASMod_tWallFld_4_Bypass.Channel ASMod_tWallFld_5_Bypass.Vector ASMod_tWallFld_5_Bypass.Channel ASMod_tWallFld_6_Bypass.Vector ASMod_tWallFld_6_Bypass.Channel CnvLead_qCurr_Bypass.Vector CnvLead_qCurr_Bypass.Channel CnvLead_qRaw_Bypass.Vector CnvLead_qRaw_Bypass.Channel CnvSet_etaCurr_Bypass.Vector CnvSet_etaCurr_Bypass.Channel CnvSet_qMI_Bypass.Vector CnvSet_qMI_Bypass.Channel CnvSet_qPiI1_Bypass.Vector CnvSet_qPiI1_Bypass.Channel CnvSet_qPiI2_Bypass.Vector CnvSet_qPiI2_Bypass.Channel CnvSet_qPiI3_Bypass.Vector CnvSet_qPiI3_Bypass.Channel CnvSet_qPoI1_Bypass.Vector CnvSet_qPoI1_Bypass.Channel CnvSet_qPoI2_Bypass.Vector CnvSet_qPoI2_Bypass.Channel CnvSet_qSet_Bypass.Vector CnvSet_qSet_Bypass.Channel CnvSet_qStrt_Bypass.Vector CnvSet_qStrt_Bypass.Channel CoEOM_facRmpVal_Bypass.Vector CoEOM_facRmpVal_Bypass.Channel CoEOM_stOpModeDes_Bypass.Vector CoEOM_stOpModeDes_Bypass.Channel CoEOM_tiOpModeChngTSync_Bypass.Vector CoEOM_tiOpModeChngTSync_Bypass.Channel CoETS_trqInrCurrFast_Bypass.Vector CoETS_trqInrCurrFast_Bypass.Channel CoETS_trqInrLeadFast_Bypass.Vector CoETS_trqInrLeadFast_Bypass.Channel CoETS_trqInrSetSlow_Bypass.Vector CoETS_trqInrSetSlow_Bypass.Channel CoPT_trqDesCompEng_Bypass.Vector CoPT_trqDesCompEng_Bypass.Channel CoVMD_trqCrCtl_Bypass.Vector CoVMD_trqCrCtl_Bypass.Channel DiaDem_nSetPHi_Bypass.Vector DiaDem_nSetPHi_Bypass.Channel DiaDem_nSetPLo_Bypass.Vector DiaDem_nSetPLo_Bypass.Channel DiaDem_trqReq_Bypass.Vector DiaDem_trqReq_Bypass.Channel DStgy_dmNH3CurrAdd_mp_Bypass.Vector DStgy_dmNH3CurrAdd_mp_Bypass.Channel DStgy_dmNH3Curr_Bypass.Vector DStgy_dmNH3Curr_Bypass.Channel DStgy_dmRdcAgDesAdd_mp_Bypass.Vector DStgy_dmRdcAgDesAdd_mp_Bypass.Channel DStgy_dmRdcAgDes_Bypass.Vector DStgy_dmRdcAgDes_Bypass.Channel EGRVlvLP_rEGR_Bypass.Vector EGRVlvLP_rEGR_Bypass.Channel EGRVlvLP_rPs_Bypass.Vector EGRVlvLP_rPs_Bypass.Channel EGRVlvLP_r_Bypass.Vector EGRVlvLP_r_Bypass.Channel EGRVlv_rEGR_Bypass.Vector EGRVlv_rEGR_Bypass.Channel EGRVlv_rPs_Bypass.Vector EGRVlv_rPs_Bypass.Channel EGRVlv_r_Bypass.Vector EGRVlv_r_Bypass.Channel EngDem_trqInrLimLead_Bypass.Vector EngDem_trqInrLimLead_Bypass.Channel EngDem_trqInrLim_Bypass.Vector EngDem_trqInrLim_Bypass.Channel EngPrt_trqLimMech_Bypass.Vector EngPrt_trqLimMech_Bypass.Channel EngPrt_trqLimOvhtPrv_Bypass.Vector EngPrt_trqLimOvhtPrv_Bypass.Channel EngPrt_trqLim_Bypass.Vector EngPrt_trqLim_Bypass.Channel EngReq_trqInrLimSmk_Bypass.Vector EngReq_trqInrLimSmk_Bypass.Channel FBC_q_Bypass.Vector FBC_q_Bypass.Channel FMA_qAirCtlCor_Bypass.Vector FMA_qAirCtlCor_Bypass.Channel FMA_qCor_Bypass.Vector FMA_qCor_Bypass.Channel FMA_trqAirCtlCor_Bypass.Vector FMA_trqAirCtlCor_Bypass.Channel GSHDem_nSetPHi_Bypass.Vector GSHDem_nSetPHi_Bypass.Channel GSHDem_nSetPLo_Bypass.Vector GSHDem_nSetPLo_Bypass.Channel HLSDem_nSetPHi_Bypass.Vector HLSDem_nSetPHi_Bypass.Channel HLSDem_nSetPLoTrm_Bypass.Vector HLSDem_nSetPLoTrm_Bypass.Channel HLSDem_nSetPLo_Bypass.Vector HLSDem_nSetPLo_Bypass.Channel HLSDem_trqReqStrt_Bypass.Vector HLSDem_trqReqStrt_Bypass.Channel HLSDem_trqReq_Bypass.Vector HLSDem_trqReq_Bypass.Channel InjCrv_facMI1SOERmpVal_mp_Bypass.Vector InjCrv_facMI1SOERmpVal_mp_Bypass.Channel InjCrv_facPiI1QntRmpVal_mp_Bypass.Vector InjCrv_facPiI1QntRmpVal_mp_Bypass.Channel InjCrv_facPiI1SOERmpVal_mp_Bypass.Vector InjCrv_facPiI1SOERmpVal_mp_Bypass.Channel InjCrv_facPoI1QntRmpVal_mp_Bypass.Vector InjCrv_facPoI1QntRmpVal_mp_Bypass.Channel InjCrv_facPoI1SOERmpVal_mp_Bypass.Vector InjCrv_facPoI1SOERmpVal_mp_Bypass.Channel InjCrv_facPoI2AngRmpVal_mp_Bypass.Vector InjCrv_facPoI2AngRmpVal_mp_Bypass.Channel InjCrv_facPoI2QntRmpVal_mp_Bypass.Vector InjCrv_facPoI2QntRmpVal_mp_Bypass.Channel InjCrv_facPoI2TiRmpVal_mp_Bypass.Vector InjCrv_facPoI2TiRmpVal_mp_Bypass.Channel InjCrv_phiMI1DesAdd_mp_Bypass.Vector InjCrv_phiMI1DesAdd_mp_Bypass.Channel InjCrv_phiMI1Des_Bypass.Vector InjCrv_phiMI1Des_Bypass.Channel InjCrv_phiMI1RgnAdd_mp_Bypass.Vector InjCrv_phiMI1RgnAdd_mp_Bypass.Channel InjCrv_phiMI1Rgn_Bypass.Vector InjCrv_phiMI1Rgn_Bypass.Channel InjCrv_phiPiI1DesAdd_mp_Bypass.Vector InjCrv_phiPiI1DesAdd_mp_Bypass.Channel InjCrv_phiPiI1Des_Bypass.Vector InjCrv_phiPiI1Des_Bypass.Channel InjCrv_phiPiI2DesAdd_mp_Bypass.Vector InjCrv_phiPiI2DesAdd_mp_Bypass.Channel InjCrv_phiPiI2Des_Bypass.Vector InjCrv_phiPiI2Des_Bypass.Channel InjCrv_phiPiI3DesAdd_mp_Bypass.Vector InjCrv_phiPiI3DesAdd_mp_Bypass.Channel InjCrv_phiPiI3Des_Bypass.Vector InjCrv_phiPiI3Des_Bypass.Channel InjCrv_phiPoI1DesAdd_mp_Bypass.Vector InjCrv_phiPoI1DesAdd_mp_Bypass.Channel InjCrv_phiPoI1Des_Bypass.Vector InjCrv_phiPoI1Des_Bypass.Channel InjCrv_phiPoI2DesAdd_mp_Bypass.Vector InjCrv_phiPoI2DesAdd_mp_Bypass.Channel InjCrv_phiPoI2Des_Bypass.Vector InjCrv_phiPoI2Des_Bypass.Channel InjCrv_phiPoI2RgnAdd_mp_Bypass.Vector InjCrv_phiPoI2RgnAdd_mp_Bypass.Channel InjCrv_phiPoI2Rgn_Bypass.Vector InjCrv_phiPoI2Rgn_Bypass.Channel InjCrv_qMI1DesAdd_mp_Bypass.Vector InjCrv_qMI1DesAdd_mp_Bypass.Channel InjCrv_qMI1Des_Bypass.Vector InjCrv_qMI1Des_Bypass.Channel InjCrv_qPiI1DesAdd_mp_Bypass.Vector InjCrv_qPiI1DesAdd_mp_Bypass.Channel InjCrv_qPiI1Des_Bypass.Vector InjCrv_qPiI1Des_Bypass.Channel InjCrv_qPiI1RgnAdd_mp_Bypass.Vector InjCrv_qPiI1RgnAdd_mp_Bypass.Channel InjCrv_qPiI1Rgn_Bypass.Vector InjCrv_qPiI1Rgn_Bypass.Channel InjCrv_qPiI2DesAdd_mp_Bypass.Vector InjCrv_qPiI2DesAdd_mp_Bypass.Channel InjCrv_qPiI2Des_Bypass.Vector InjCrv_qPiI2Des_Bypass.Channel InjCrv_qPiI2RgnAdd_mp_Bypass.Vector InjCrv_qPiI2RgnAdd_mp_Bypass.Channel InjCrv_qPiI2Rgn_Bypass.Vector InjCrv_qPiI2Rgn_Bypass.Channel InjCrv_qPiI3DesAdd_mp_Bypass.Vector InjCrv_qPiI3DesAdd_mp_Bypass.Channel InjCrv_qPiI3Des_Bypass.Vector InjCrv_qPiI3Des_Bypass.Channel InjCrv_qPoI1DesAdd_mp_Bypass.Vector InjCrv_qPoI1DesAdd_mp_Bypass.Channel InjCrv_qPoI1Des_Bypass.Vector InjCrv_qPoI1Des_Bypass.Channel InjCrv_qPoI1RgnAdd_mp_Bypass.Vector InjCrv_qPoI1RgnAdd_mp_Bypass.Channel InjCrv_qPoI1Rgn_Bypass.Vector InjCrv_qPoI1Rgn_Bypass.Channel InjCrv_qPoI2DesAdd_mp_Bypass.Vector InjCrv_qPoI2DesAdd_mp_Bypass.Channel InjCrv_qPoI2Des_Bypass.Vector InjCrv_qPoI2Des_Bypass.Channel InjCrv_qPoI2EffAdd_mp_Bypass.Vector InjCrv_qPoI2EffAdd_mp_Bypass.Channel InjCrv_qPoI2Eff_Bypass.Vector InjCrv_qPoI2Eff_Bypass.Channel InjCrv_qPoI2RgnAdd_mp_Bypass.Vector InjCrv_qPoI2RgnAdd_mp_Bypass.Channel InjCrv_qPoI2Rgn_Bypass.Vector InjCrv_qPoI2Rgn_Bypass.Channel InjCrv_stInjCharSetVal_Bypass.Vector InjCrv_stInjCharSetVal_Bypass.Channel InjCrv_tiPiI1DesAdd_mp_Bypass.Vector InjCrv_tiPiI1DesAdd_mp_Bypass.Channel InjCrv_tiPiI1Des_Bypass.Vector InjCrv_tiPiI1Des_Bypass.Channel InjCrv_tiPiI1RgnAdd_mp_Bypass.Vector InjCrv_tiPiI1RgnAdd_mp_Bypass.Channel InjCrv_tiPiI1Rgn_Bypass.Vector InjCrv_tiPiI1Rgn_Bypass.Channel InjCrv_tiPiI2DesAdd_mp_Bypass.Vector InjCrv_tiPiI2DesAdd_mp_Bypass.Channel InjCrv_tiPiI2Des_Bypass.Vector InjCrv_tiPiI2Des_Bypass.Channel InjCrv_tiPiI2RgnAdd_mp_Bypass.Vector InjCrv_tiPiI2RgnAdd_mp_Bypass.Channel InjCrv_tiPiI2Rgn_Bypass.Vector InjCrv_tiPiI2Rgn_Bypass.Channel InjCrv_tiPoI2DesAdd_mp_Bypass.Vector InjCrv_tiPoI2DesAdd_mp_Bypass.Channel InjCrv_tiPoI2Des_Bypass.Vector InjCrv_tiPoI2Des_Bypass.Channel InjCtl_qCurrAdd_mp_Bypass.Vector InjCtl_qCurrAdd_mp_Bypass.Channel InjCtl_qCurr_Bypass.Vector InjCtl_qCurr_Bypass.Channel InjCtl_qRawAdd_mp_Bypass.Vector InjCtl_qRawAdd_mp_Bypass.Channel InjCtl_qRaw_Bypass.Vector InjCtl_qRaw_Bypass.Channel InjCtl_qSetUnBalAdd_mp_Bypass.Vector InjCtl_qSetUnBalAdd_mp_Bypass.Channel InjCtl_qSetUnBal_Bypass.Vector InjCtl_qSetUnBal_Bypass.Channel InjVlv_tiMI1ET_mp_Bypass.Vector InjVlv_tiMI1ET_mp_Bypass.Channel InjVlv_tiPiI1ET_mp_Bypass.Vector InjVlv_tiPiI1ET_mp_Bypass.Channel InjVlv_tiPoI1ET_mp_Bypass.Vector InjVlv_tiPoI1ET_mp_Bypass.Channel InjVlv_tiPoI2ET_mp_Bypass.Vector InjVlv_tiPoI2ET_mp_Bypass.Channel ISC_nSetPHi_Bypass.Vector ISC_nSetPHi_Bypass.Channel ISC_nSetPLoPLnd_Bypass.Vector ISC_nSetPLoPLnd_Bypass.Channel ISC_nSetPLo_Bypass.Vector ISC_nSetPLo_Bypass.Channel ISC_numCurrFunc_Bypass.Vector ISC_numCurrFunc_Bypass.Channel ISC_tiPT1TrqFlt_Bypass.Vector ISC_tiPT1TrqFlt_Bypass.Channel ISC_trqFlt_Bypass.Vector ISC_trqFlt_Bypass.Channel ISC_trqLoLimMax_Bypass.Vector ISC_trqLoLimMax_Bypass.Channel ISC_trqLoLimMin_Bypass.Vector ISC_trqLoLimMin_Bypass.Channel ISC_trqLoLtd_Bypass.Vector ISC_trqLoLtd_Bypass.Channel ISC_trqLossFlt_Bypass.Vector ISC_trqLossFlt_Bypass.Channel ISC_trqPreCtlEff_Bypass.Vector ISC_trqPreCtlEff_Bypass.Channel ISC_trqPreCtl_Bypass.Vector ISC_trqPreCtl_Bypass.Channel ISC_trqReq_Bypass.Vector ISC_trqReq_Bypass.Channel ISC_trq_Bypass.Vector ISC_trq_Bypass.Channel LSU_dcycHtStrt_0_mp2_Bypass.Vector LSU_dcycHtStrt_0_mp2_Bypass.Channel LSU_dcycHtStrt_1_mp2_Bypass.Vector LSU_dcycHtStrt_1_mp2_Bypass.Channel LSU_dcycHtStrt_2_mp2_Bypass.Vector LSU_dcycHtStrt_2_mp2_Bypass.Channel LSU_dcycHtStrt_3_mp2_Bypass.Vector LSU_dcycHtStrt_3_mp2_Bypass.Channel LSU_rO2PresComp_0_mp2_Bypass.Vector LSU_rO2PresComp_0_mp2_Bypass.Channel LSU_rO2PresComp_1_mp2_Bypass.Vector LSU_rO2PresComp_1_mp2_Bypass.Channel LSU_rO2PresComp_2_mp2_Bypass.Vector LSU_rO2PresComp_2_mp2_Bypass.Channel LSU_rO2PresComp_3_mp2_Bypass.Vector LSU_rO2PresComp_3_mp2_Bypass.Channel LSU_rO2Raw_0_mp2_Bypass.Vector LSU_rO2Raw_0_mp2_Bypass.Channel LSU_rO2Raw_1_mp2_Bypass.Vector LSU_rO2Raw_1_mp2_Bypass.Channel LSU_rO2Raw_2_mp2_Bypass.Vector LSU_rO2Raw_2_mp2_Bypass.Channel LSU_rO2Raw_3_mp2_Bypass.Vector LSU_rO2Raw_3_mp2_Bypass.Channel LSU_stO2IntValid_0_mp2_Bypass.Vector LSU_stO2IntValid_0_mp2_Bypass.Channel LSU_stO2IntValid_1_mp2_Bypass.Vector LSU_stO2IntValid_1_mp2_Bypass.Channel LSU_stO2IntValid_2_mp2_Bypass.Vector LSU_stO2IntValid_2_mp2_Bypass.Channel LSU_stO2IntValid_3_mp2_Bypass.Vector LSU_stO2IntValid_3_mp2_Bypass.Channel LSU_tRi_0_mp2_Bypass.Vector LSU_tRi_0_mp2_Bypass.Channel LSU_tRi_1_mp2_Bypass.Vector LSU_tRi_1_mp2_Bypass.Channel LSU_tRi_2_mp2_Bypass.Vector LSU_tRi_2_mp2_Bypass.Channel LSU_tRi_3_mp2_Bypass.Vector LSU_tRi_3_mp2_Bypass.Channel MeUn_dvolSet_Bypass.Vector MeUn_dvolSet_Bypass.Channel MeUn_iSet_Bypass.Vector MeUn_iSet_Bypass.Channel PCR_pDesVal_Bypass.Vector PCR_pDesVal_Bypass.Channel PCR_qCtlVal_Bypass.Vector PCR_qCtlVal_Bypass.Channel PCR_rCtlVal_Bypass.Vector PCR_rCtlVal_Bypass.Channel PCR_rGovOutUnLim_Bypass.Vector PCR_rGovOutUnLim_Bypass.Channel PCR_rGov_Bypass.Vector PCR_rGov_Bypass.Channel PCR_stARW_Bypass.Vector PCR_stARW_Bypass.Channel PCV_iSetBefAdd_mp_Bypass.Vector PCV_iSetBefAdd_mp_Bypass.Channel PCV_iSet_Bypass.Vector PCV_iSet_Bypass.Channel PCV_pSet_Bypass.Vector PCV_pSet_Bypass.Channel PFltLd_mSot_Bypass.Vector PFltLd_mSot_Bypass.Channel PFltLd_resFlw_Bypass.Vector PFltLd_resFlw_Bypass.Channel PFltPOp_stEngPOp_Bypass.Vector PFltPOp_stEngPOp_Bypass.Channel PFltRgn_numRgn_Bypass.Vector PFltRgn_numRgn_Bypass.Channel PFlt_tInrDes_Bypass.Vector PFlt_tInrDes_Bypass.Channel PFlt_tOutrDes_Bypass.Vector PFlt_tOutrDes_Bypass.Channel PthLead_trqInrCurr_Bypass.Vector PthLead_trqInrCurr_Bypass.Channel PthLead_trqInrLead_Bypass.Vector PthLead_trqInrLead_Bypass.Channel PthSet_trqInrSet_Bypass.Vector PthSet_trqInrSet_Bypass.Channel Rail_facSetPointRmpVal_mp_Bypass.Vector Rail_facSetPointRmpVal_mp_Bypass.Channel Rail_pSetPointRgn_Bypass.Vector Rail_pSetPointRgn_Bypass.Channel Rail_pSetPoint_Bypass.Vector Rail_pSetPoint_Bypass.Channel RngMod_trqFrc_Bypass.Vector RngMod_trqFrc_Bypass.Channel SCRAd_facQtyAdapAdd_mp_Bypass.Vector SCRAd_facQtyAdapAdd_mp_Bypass.Channel SCRAd_facQtyAdap_Bypass.Vector SCRAd_facQtyAdap_Bypass.Channel SCRAd_mNH3LdAdapAdd_mp_Bypass.Vector SCRAd_mNH3LdAdapAdd_mp_Bypass.Channel SCRAd_mNH3LdAdap_Bypass.Vector SCRAd_mNH3LdAdap_Bypass.Channel SCRAd_mNH3LdRstAdd_mp_Bypass.Vector SCRAd_mNH3LdRstAdd_mp_Bypass.Channel SCRAd_mNH3LdRst_Bypass.Vector SCRAd_mNH3LdRst_Bypass.Channel SCRAd_stAdapReq_Bypass.Vector SCRAd_stAdapReq_Bypass.Channel SCRAd_stAdapRstReq_Bypass.Vector SCRAd_stAdapRstReq_Bypass.Channel SCRAd_stSlip_Bypass.Vector SCRAd_stSlip_Bypass.Channel SCRFFC_dmNH3CnvAdd_mp_Bypass.Vector SCRFFC_dmNH3CnvAdd_mp_Bypass.Channel SCRFFC_dmNH3Cnv_Bypass.Vector SCRFFC_dmNH3Cnv_Bypass.Channel SCRLdG_mNH3LdNomAdd_mp_Bypass.Vector SCRLdG_mNH3LdNomAdd_mp_Bypass.Channel SCRLdG_mNH3LdNom_Bypass.Vector SCRLdG_mNH3LdNom_Bypass.Channel SCRMod_etaEstAdd_mp_Bypass.Vector SCRMod_etaEstAdd_mp_Bypass.Channel SCRMod_etaEst_Bypass.Vector SCRMod_etaEst_Bypass.Channel SCRMod_mEstNH3LdAdd_mp_Bypass.Vector SCRMod_mEstNH3LdAdd_mp_Bypass.Channel SCRMod_mEstNH3Ld_Bypass.Vector SCRMod_mEstNH3Ld_Bypass.Channel SpdGov_nSetPHi_Elm1_mp2_Bypass.Vector SpdGov_nSetPHi_Elm1_mp2_Bypass.Channel SpdGov_nSetPHi_Elm2_mp2_Bypass.Vector SpdGov_nSetPHi_Elm2_mp2_Bypass.Channel SpdGov_nSetPLo_Elm1_mp2_Bypass.Vector SpdGov_nSetPLo_Elm1_mp2_Bypass.Channel SpdGov_nSetPLo_Elm2_mp2_Bypass.Vector SpdGov_nSetPLo_Elm2_mp2_Bypass.Channel SpdGov_st_Bypass.Vector SpdGov_st_Bypass.Channel SpdGov_trqFlt_Bypass.Vector SpdGov_trqFlt_Bypass.Channel SpdGov_trqInrLimSet_Bypass.Vector SpdGov_trqInrLimSet_Bypass.Channel SpdGov_trqLead_Bypass.Vector SpdGov_trqLead_Bypass.Channel SpdGov_trqSet_Bypass.Vector SpdGov_trqSet_Bypass.Channel ThrVlv_r_Bypass.Vector ThrVlv_r_Bypass.Channel TrbCh_rPs_Bypass.Vector TrbCh_rPs_Bypass.Channel UDC_dmRdcAgActAdd_mp_Bypass.Vector UDC_dmRdcAgActAdd_mp_Bypass.Channel UDC_dmRdcAgAct_Bypass.Vector UDC_dmRdcAgAct_Bypass.Channel VehMot_stPrpCrCtl_Bypass.Vector VehMot_stPrpCrCtl_Bypass.Channel VMD_rVirtAPP_Bypass.Vector VMD_rVirtAPP_Bypass.Channel VMD_trqDes_Bypass.Vector VMD_trqDes_Bypass.Channel VSwCtl_rCtlValNrm_mp_Bypass.Vector VSwCtl_rCtlValNrm_mp_Bypass.Channel VSwVlv_rPs_Bypass.Vector VSwVlv_rPs_Bypass.Channel VSwVlv_rVSw_Bypass.Vector VSwVlv_rVSw_Bypass.Channel VSwVlv_r_Bypass.Vector VSwVlv_r_Bypass.Channel /end DEF_CHARACTERISTIC
 /begin OUT_MEASUREMENT Byp_stEcuGlobal DStgy_dmNH3CurrBefAdd_mp DStgy_dmNH3CurrBefByp_mp DStgy_dmRdcAgDesBefAdd_mp DStgy_dmRdcAgDesBefRepl_mp LSU_dcycHtStrt_0_mp1 LSU_dcycHtStrt_0_mp2 LSU_dcycHtStrt_1_mp1 LSU_dcycHtStrt_1_mp2 LSU_dcycHtStrt_2_mp1 LSU_dcycHtStrt_2_mp2 LSU_dcycHtStrt_3_mp1 LSU_dcycHtStrt_3_mp2 LSU_rO2PresComp_0_mp1 LSU_rO2PresComp_0_mp2 LSU_rO2PresComp_1_mp1 LSU_rO2PresComp_1_mp2 LSU_rO2PresComp_2_mp1 LSU_rO2PresComp_2_mp2 LSU_rO2PresComp_3_mp1 LSU_rO2PresComp_3_mp2 LSU_rO2Raw_0_mp1 LSU_rO2Raw_0_mp2 LSU_rO2Raw_1_mp1 LSU_rO2Raw_1_mp2 LSU_rO2Raw_2_mp1 LSU_rO2Raw_2_mp2 LSU_rO2Raw_3_mp1 LSU_rO2Raw_3_mp2 LSU_stO2IntValid_0_mp1 LSU_stO2IntValid_0_mp2 LSU_stO2IntValid_1_mp1 LSU_stO2IntValid_1_mp2 LSU_stO2IntValid_2_mp1 LSU_stO2IntValid_2_mp2 LSU_stO2IntValid_3_mp1 LSU_stO2IntValid_3_mp2 LSU_tRi_0_mp1 LSU_tRi_0_mp2 LSU_tRi_1_mp1 LSU_tRi_1_mp2 LSU_tRi_2_mp1 LSU_tRi_2_mp2 LSU_tRi_3_mp1 LSU_tRi_3_mp2 PCV_iSetBefAdd_mp PCV_iSetBefRepl_mp SCRAd_facQtyAdapBefAdd_mp SCRAd_facQtyAdapBefByp_mp SCRAd_mNH3LdAdapBefAdd_mp SCRAd_mNH3LdAdapBefByp_mp SCRAd_mNH3LdRstBefAdd_mp SCRAd_mNH3LdRstBefByp_mp SCRAd_stAdapReqBefByp_mp SCRAd_stAdapRstReqBefByp_mp SCRAd_stSlipBefByp_mp SCRFFC_dmNH3CnvBefAdd_mp SCRFFC_dmNH3CnvBefByp_mp SCRLdG_mNH3LdNomBefAdd_mp SCRLdG_mNH3LdNomBefByp_mp SCRMod_etaEstBefAdd_mp SCRMod_etaEstBefRepl_mp SCRMod_mEstNH3LdBefAdd_mp SCRMod_mEstNH3LdBefRepl_mp SpdGov_nSetPHi_Elm1_mp2 SpdGov_nSetPHi_Elm2_mp2 SpdGov_nSetPLo_Elm1_mp2 SpdGov_nSetPLo_Elm2_mp2 UDC_dmRdcAgActBefAdd_mp UDC_dmRdcAgActBefRepl_mp /end OUT_MEASUREMENT
/end FUNCTION
/begin FUNCTION BypEtk "" /begin DEF_CHARACTERISTIC BypEtk_SegStimuli_C BypEtk_stAscet_C BypEtk_TStimuli_C /end DEF_CHARACTERISTIC /end FUNCTION
/begin FUNCTION BypInt "" /end FUNCTION
/begin FUNCTION CACDsT_DD ""
 /begin DEF_CHARACTERISTIC Air_SRCTCACDs.uMin_C Air_SRCTCACDs.uMax_C Air_swtSigTCACDs_C Air_tTransfTCACDs_CUR /end DEF_CHARACTERISTIC
 /begin OUT_MEASUREMENT Air_tSensTCACDs Air_uRawTCACDs /end OUT_MEASUREMENT
/end FUNCTION
/begin FUNCTION CACDsT_VD ""
 /begin DEF_CHARACTERISTIC Air_RmpSlpTCACDs.Pos_C Air_RmpSlpTCACDs.Neg_C Air_swtSensPresTCACDs_C Air_tiLPFiltPT1TCACDs_C Air_TransStgTCACDs.Dfl_C Air_TransStgTCACDs.stSensId_C /end DEF_CHARACTERISTIC
 /begin OUT_MEASUREMENT Air_dtTCACDs Air_tCACDs /end OUT_MEASUREMENT
/end FUNCTION
/begin FUNCTION CACDsT_VDVar "" /begin DEF_CHARACTERISTIC Air_tDflOffsTCACDs_C /end DEF_CHARACTERISTIC /begin IN_MEASUREMENT EnvT_t /end IN_MEASUREMENT /end FUNCTION
/begin FUNCTION CalWup "" /begin DEF_CHARACTERISTIC Calwup_swtWakeupEnaCpl_C Calwup_swtWakeupEna_C /end DEF_CHARACTERISTIC /end FUNCTION
/begin FUNCTION Can "" /end FUNCTION
/begin FUNCTION CBBasic "" /end FUNCTION
/begin FUNCTION CBBMW "" /end FUNCTION
/begin FUNCTION CBDC "" /end FUNCTION
/begin FUNCTION CBEeebd "" /end FUNCTION
/begin FUNCTION CBEeepdd "" /end FUNCTION
/begin FUNCTION CBEepHal "" /end FUNCTION
/begin FUNCTION CBFlash "" /end FUNCTION
/begin FUNCTION CBFPrt "" /end FUNCTION
/begin FUNCTION CBMain "" /end FUNCTION
/begin FUNCTION CBOS "" /end FUNCTION
/begin FUNCTION CBReprog "" /end FUNCTION
/begin FUNCTION CBS "" /begin SUB_FUNCTION PCBS /end SUB_FUNCTION /end FUNCTION
/begin COMPU_METHOD AirMass "" RAT_FUNC "%6.4" "g" COEFFS 0 100 0 0 0 1 /end COMPU_METHOD
/begin COMPU_METHOD Curr "" RAT_FUNC "%6.2" "mA" COEFFS 0 1 0 0 0 1 /end COMPU_METHOD
/begin COMPU_METHOD DtyCyc "" RAT_FUNC "%5.2" "%" COEFFS 0 100 0 0 0 1 /end COMPU_METHOD
/begin COMPU_METHOD EngN "" RAT_FUNC "%5.1" "rpm" COEFFS 0 2 0 0 0 1 /end COMPU_METHOD
/begin COMPU_METHOD O2 "" RAT_FUNC "%6.5" "-" COEFFS 0 100000 0 0 0 1 /end COMPU_METHOD
/begin COMPU_METHOD OneToOne "" RAT_FUNC "%6.0" "-" COEFFS 0 1 0 0 0 1 /end COMPU_METHOD
/begin COMPU_METHOD RmpTemp "" RAT_FUNC "%6.4" "K/s" COEFFS 0 655.36 0 0 0 1 /end COMPU_METHOD
/begin COMPU_METHOD SCRAd_Compu_Switch_1 "" TAB_VERB "%6.3" "" COMPU_TAB_REF SCRAd_Compu_Switch_1 /end COMPU_METHOD
/begin COMPU_VTAB SCRAd_Compu_Switch_1 "" TAB_VERB 2 0 "GESPERRT" 1 "FS ERHÖHEN" /end COMPU_VTAB
/begin COMPU_METHOD SCRAd_Compu_Switch_2 "" TAB_VERB "%6.3" "" COMPU_TAB_REF SCRAd_Compu_Switch_2 /end COMPU_METHOD
/begin COMPU_VTAB SCRAd_Compu_Switch_2 "" TAB_VERB 2 0 "GESPERRT" 1 "FREIGEGEBEN" /end COMPU_VTAB
/begin COMPU_METHOD SCR_Dm005 "" RAT_FUNC "%6.4" "mg/s" COEFFS 0 20 0 0 0 1 /end COMPU_METHOD
/begin COMPU_METHOD SCR_Dm01 "" RAT_FUNC "%6.3" "mg/s" COEFFS 0 10 0 0 0 1 /end COMPU_METHOD
/begin COMPU_METHOD SCR_dmNH3_mg_p_s "" RAT_FUNC "%6.4" "mg/s" COEFFS 0 20 0 0 0 1 /end COMPU_METHOD
/begin COMPU_METHOD SCR_Fact1000 "" RAT_FUNC "%6.5" "" COEFFS 0 1000 0 0 0 1 /end COMPU_METHOD
/begin COMPU_METHOD SCR_Mass1000 "" RAT_FUNC "%6.5" "g" COEFFS 0 1000 0 0 0 1 /end COMPU_METHOD
/begin COMPU_METHOD TempCels_100ms "" RAT_FUNC "%6.2" "deg C/s" COEFFS 0 1 0 0 0 1 /end COMPU_METHOD
/begin COMPU_METHOD Temp_Cels "" RAT_FUNC "%5.1" "deg C" COEFFS 0 10 2731.4 0 0 1 /end COMPU_METHOD
/begin COMPU_METHOD TimeDelay_s "" RAT_FUNC "%12.4" "s" COEFFS 0 0 1 0 0.00023283064365387 0 /end COMPU_METHOD
/begin COMPU_METHOD Volt "" RAT_FUNC "%6.1" "mV" COEFFS 0 5 0 0 0 1 /end COMPU_METHOD
/begin RECORD_LAYOUT Cur_Xs16Ws16 NO_AXIS_PTS_X 1 SWORD AXIS_PTS_X 2 SWORD INDEX_INCR DIRECT FNC_VALUES 3 SWORD COLUMN_DIR DIRECT /end RECORD_LAYOUT
/begin RECORD_LAYOUT Kw_Ws16 FNC_VALUES 1 SWORD COLUMN_DIR DIRECT /end RECORD_LAYOUT
/begin RECORD_LAYOUT Kw_Ws32 FNC_VALUES 1 SLONG COLUMN_DIR DIRECT /end RECORD_LAYOUT
/begin RECORD_LAYOUT Kw_Wu8 FNC_VALUES 1 UBYTE COLUMN_DIR DIRECT /end RECORD_LAYOUT
/begin RECORD_LAYOUT Val_Ws32 FNC_VALUES 1 SLONG COLUMN_DIR DIRECT /end RECORD_LAYOUT
/begin RECORD_LAYOUT Val_Wu32 FNC_VALUES 1 ULONG COLUMN_DIR DIRECT /end RECORD_LAYOUT
/begin RECORD_LAYOUT Val_Wu8 FNC_VALUES 1 UBYTE COLUMN_DIR DIRECT /end RECORD_LAYOUT
/end MODULE
/end PROJECT

ASAP2_VERSION 1 4
/begin PROJECT P_574 "EDC17_CP09"
/begin HEADER "" VERSION "V8KB" PROJECT_NO P_574 /end HEADER
/begin MODULE DIM ""
/begin MOD_COMMON "" BYTE_ORDER MSB_LAST ALIGNMENT_BYTE 1 ALIGNMENT_WORD 2 ALIGNMENT_LONG 4 ALIGNMENT_FLOAT32_IEEE 4 /end MOD_COMMON
/begin CHARACTERISTIC Exh_d2rInitNoCat2Ds_C "Initialisierungswert für den PT1-Filter" VALUE 0x8004E370 Kw_Ws16 5.000000 O2 0.00 5.000000 EXTENDED_LIMITS -0.3276800 0.3276700 /end CHARACTERISTIC
/begin CHARACTERISTIC Exh_d2rInitNSCDs_C "Initialisierungswert für den PT1-Filter" VALUE 0x8004E7EC Kw_Ws16 5.000000 O2 0.00 5.000000 EXTENDED_LIMITS -0.3276800 0.3276700 /end CHARACTERISTIC
/begin CHARACTERISTIC Exh_dmAirIKiNoCat2Ds_C "Für Signal im Fenster (I-Regler)" VALUE 0x8004E374 Val_Ws32 99.9998301268 Ki 0.00 99.9998301268 FORMAT "%13.9" EXTENDED_LIMITS -1000000.00000 999999.999534 /end CHARACTERISTIC
/begin CHARACTERISTIC Exh_dmAirIKiNSCDs_C "Für Signal im Fenster (I-Regler)" VALUE 0x8004E7F0 Val_Ws32 99.9998301268 Ki 0.00 99.9998301268 FORMAT "%13.9" EXTENDED_LIMITS -1000000.00000 999999.999534 /end CHARACTERISTIC
/begin CHARACTERISTIC Exh_EvalMaxValNoCat2Ds_C "Maximaler Sauerstoffwert" VALUE 0x8004E378 Kw_Ws16 1.000000 O2 0.00 1.000000 EXTENDED_LIMITS -0.3276800 0.3276700 /end CHARACTERISTIC
/begin CHARACTERISTIC Exh_EvalMaxValNSCDs_C "Max. Sauerstoffwert" VALUE 0x8004E7F4 Kw_Ws16 1.000000 O2 0.00 1.000000 EXTENDED_LIMITS -0.3276800 0.3276700 /end CHARACTERISTIC
/begin CHARACTERISTIC Exh_EvalMinValNoCat2Ds_C "Min. Sauerstoffwert-Anpassungsstrom" VALUE 0x8004E37A Kw_Ws16 1.000000 O2 0.00 1.000000 EXTENDED_LIMITS -0.3276800 0.3276700 /end CHARACTERISTIC
/begin CHARACTERISTIC Exh_EvalMinValNSCDs_C "Min. Sauerstoffwert-Anpassungsstrom" VALUE 0x8004E7F6 Kw_Ws16 1.000000 O2 0.00 1.000000 EXTENDED_LIMITS -0.3276800 0.3276700 /end CHARACTERISTIC
/begin CHARACTERISTIC Exh_facMolMsNoCat2Ds_CUR "Kennlinie zur Berechnung des binären Lambda-Wertes" CURVE 0x8004E45C Cur_Xs16Ws16 100.0000 Molmass 0.00 100.0000 FORMAT "%8.4" EXTENDED_LIMITS -327.6800 327.6700
 /begin AXIS_DESCR STD_AXIS Exh_rLamLinNoCat2Ds lambda 16 -32.76800 32.76700 DEPOSIT ABSOLUTE /end AXIS_DESCR
/end CHARACTERISTIC
/begin CHARACTERISTIC Exh_facMolMsNOxNoCat2Ds_C "NOx-Molarmasse" VALUE 0x8004E49E Kw_Ws16 200.0000 Molmass -100.0000 100.0000 FORMAT "%8.4" EXTENDED_LIMITS -327.6800 327.6700 /end CHARACTERISTIC
/begin CHARACTERISTIC Exh_facMolMsNOxNSCDs_C "NOx-Molarmasse" VALUE 0x8004E8D8 Kw_Ws16 200.0000 Molmass -100.0000 100.0000 FORMAT "%8.4" EXTENDED_LIMITS -327.6800 327.6700 /end CHARACTERISTIC
/begin CHARACTERISTIC Exh_facMolMsNSCDs_CUR "Kennlinie zur Berechnung des binären Lambda-Wertes" CURVE 0x8004E8DA Cur_Xs16Ws16 100.0000 Molmass 0.00 100.0000 FORMAT "%8.4" EXTENDED_LIMITS -327.6800 327.6700
 /begin AXIS_DESCR STD_AXIS Exh_rLamLinNSCDs lambda 16 -32.76800 32.76700 DEPOSIT ABSOLUTE /end AXIS_DESCR
/end CHARACTERISTIC
/begin CHARACTERISTIC Exh_facNOxOfsAvrgNoCat2Ds_C "Mittelwert des NOx-Offsets" VALUE 0x8004E4A0 Val_Ws16 10000.00 Fact 0.00 10000.00 EXTENDED_LIMITS -4.000000 3.999878 /end CHARACTERISTIC
/begin CHARACTERISTIC Exh_facNOxOfsAvrgNSCDs_C "Mittelwert des NOx-Offsets" VALUE 0x8004E91C Val_Ws16 10000.00 Fact 0.00 10000.00 EXTENDED_LIMITS -4.000000 3.999878 /end CHARACTERISTIC
/begin CHARACTERISTIC Exh_facO2LeanNoCat2Ds_CUR "Kennlinie zur Berechnung des druckkompensierten O2-Wertes für den mageren Zustand" CURVE 0x8004E37C Cur_Xs16Ws16 31.34998 Fact 0.6500244 32.00000 EXTENDED_LIMITS -4.000000 3.999878
 /begin AXIS_DESCR STD_AXIS Exh_pEGFldNoCat2Ds_mp Pres_hPa 16 1.000000 3500.00000 EXTENDED_LIMITS -32768.00 32767.00 DEPOSIT ABSOLUTE /end AXIS_DESCR
/end CHARACTERISTIC
/begin CHARACTERISTIC Exh_facO2LeanNSCDs_CUR "Kennlinie zur Berechnung des druckkompensierten O2-Wertes für den mageren Zustand" CURVE 0x8004E7F8 Cur_Xs16Ws16 31.34998 Fact 0.6500244 32.00000 EXTENDED_LIMITS -4.000000 3.999878
 /begin AXIS_DESCR STD_AXIS Exh_pEGFldNSCDs_mp Pres_hPa 16 -32768.00 3500.00 EXTENDED_LIMITS -32768.00 32767.00 DEPOSIT ABSOLUTE /end AXIS_DESCR
/end CHARACTERISTIC
/begin CHARACTERISTIC Exh_facO2RichNoCat2Ds_CUR "Kennlinie zur Berechnung des druckkompensierten O2-Wertes für den fetten Zustand" CURVE 0x8004E3BE Cur_Xs16Ws16 150.0000 Fact -50.00000 100.0000 EXTENDED_LIMITS -4.000000 3.999878
 /begin AXIS_DESCR STD_AXIS Exh_pEGFldNoCat2Ds_mp Pres_hPa 16 -250.0000 3500.000 EXTENDED_LIMITS -32768.00 32767.00 DEPOSIT ABSOLUTE /end AXIS_DESCR
/end CHARACTERISTIC
/begin CHARACTERISTIC Exh_facO2RichNSCDs_CUR "Kennlinie zur Berechnung des druckkompensierten O2-Wertes für den fetten Zustand" CURVE 0x8004E83A Cur_Xs16Ws16 150.0000 Fact -50.00000 100.0000 EXTENDED_LIMITS -4.000000 3.999878
 /begin AXIS_DESCR STD_AXIS Exh_pEGFldNSCDs_mp Pres_hPa 16 -32768.00 3500.00 EXTENDED_LIMITS -32768.00 32767.00 DEPOSIT ABSOLUTE /end AXIS_DESCR
/end CHARACTERISTIC
/begin CHARACTERISTIC Exh_HtrDebNoCat2Ds.tiHiLo_C "Struktur für Entprellparameter der erreichten Sollheiztemperatur des NOx-Sensors/" VALUE 0x8004E08C Kw_Ws16 5000.000 TimeDeb 0.00 5000.000 EXTENDED_LIMITS -327680.0 327670.0 /end CHARACTERISTIC
/begin CHARACTERISTIC Exh_HtrDebNoCat2Ds.tiLoHi_C "Struktur für Entprellparameter der erreichten Sollheiztemperatur des NOx-Sensors/" VALUE 0x8004E08E Kw_Ws16 5000.000 TimeDeb 0.00 5000.000 EXTENDED_LIMITS -327680.0 327670.0 /end CHARACTERISTIC
/begin CHARACTERISTIC Exh_HtrDebNSCDs.tiHiLo_C "Struktur für Entprellparameter der erreichten Sollheizertemperatur des NOx-Sensors/" VALUE 0x8004E508 Kw_Ws16 5000.000 TimeDeb 0.00 5000.000 EXTENDED_LIMITS -327680.0 327670.0 /end CHARACTERISTIC
/begin CHARACTERISTIC Exh_HtrDebNSCDs.tiLoHi_C "Struktur für Entprellparameter der erreichten Sollheizertemperatur des NOx-Sensors/" VALUE 0x8004E50A Kw_Ws16 5000.000 TimeDeb 0.00 5000.000 EXTENDED_LIMITS -327680.0 327670.0 /end CHARACTERISTIC
/begin CHARACTERISTIC Exh_HtrDiaNoCat2DsDeb.tiHiLo_C "Struktur zur Entprellung der Heizerdiagnose-Freigabebedingung/" VALUE 0x8004E4A2 Kw_Ws16 10000.00 TimeDeb 0.00 10000.00 EXTENDED_LIMITS -327680.0 327670.0 /end CHARACTERISTIC
/begin CHARACTERISTIC Exh_HtrDiaNoCat2DsDeb.tiLoHi_C "Struktur zur Entprellung der Heizerdiagnose-Freigabebedingung/" VALUE 0x8004E4A4 Kw_Ws16 10000.00 TimeDeb 0.00 10000.00 EXTENDED_LIMITS -327680.0 327670.0 /end CHARACTERISTIC
/begin CHARACTERISTIC Exh_HtrDiaNSCDsDeb.tiHiLo_C "Struktur zur Entprellung der Heizerdiagnose-Freigabebedingung/" VALUE 0x8004E91E Kw_Ws16 10000.00 TimeDeb 0.00 10000.00 EXTENDED_LIMITS -327680.0 327670.0 /end CHARACTERISTIC
/begin CHARACTERISTIC Exh_HtrDiaNSCDsDeb.tiLoHi_C "Struktur zur Entprellung der Heizerdiagnose-Freigabebedingung/" VALUE 0x8004E920 Kw_Ws16 10000.00 TimeDeb 0.00 10000.00 EXTENDED_LIMITS -327680.0 327670.0 /end CHARACTERISTIC
/begin CHARACTERISTIC Exh_idxDewDetNoCat2Ds_C "Kalibrierungsparameter zum Auswählen des Arrayelements" VALUE 0x8004E4A6 Val_Wu8 100.0 OneToOne 0.00 100.0 EXTENDED_LIMITS 0.00 255.0 /end CHARACTERISTIC
/begin CHARACTERISTIC Exh_idxDewDetNSCDs_C "Kalibrierungsparameter zum Auswählen des Arrayelements" VALUE 0x8004E922 Val_Wu8 100.0 OneToOne 0.00 100.0 EXTENDED_LIMITS 0.00 255.0 /end CHARACTERISTIC
/begin CHARACTERISTIC Exh_idxEGFldNoCat2Ds_C "Parameter zum Auswählen der Elemente des Abgasmassenstromarrays" VALUE 0x8004E4A7 Kw_Wu8 100.0 OneToOne 0.00 100.0 EXTENDED_LIMITS 0.00 255.0 /end CHARACTERISTIC
/begin CHARACTERISTIC Exh_idxEGFldNSCDs_C "Kalibrierungsparameter zum Auswählen des Parameters des Abgasmassenstroms" VALUE 0x8004E923 Val_Wu8 100.0 OneToOne 0.00 100.0 EXTENDED_LIMITS 0.00 255.0 /end CHARACTERISTIC
/begin CHARACTERISTIC Exh_IKiNgvNoCat2Ds_C "Für negative Großsignale (I-Regler)" VALUE 0x8004E400 Val_Ws32 99.9998301268 Ki 0.00 99.9998301268 FORMAT "%13.9" EXTENDED_LIMITS -1000000.00000 999999.999534 /end CHARACTERISTIC
/begin CHARACTERISTIC Exh_IKiNgvNSCDs_C "Für negative Großsignale (I-Regler)" VALUE 0x8004E87C Val_Ws32 99.9998301268 Ki 0.00 99.9998301268 FORMAT "%13.9" EXTENDED_LIMITS -1000000.00000 999999.999534 /end CHARACTERISTIC
/begin CHARACTERISTIC Exh_IKiPsvNoCat2Ds_C "Für positive Großsignale (I-Regler)" VALUE 0x8004E404 Val_Ws32 99.9998301268 Ki 0.00 99.9998301268 FORMAT "%13.9" EXTENDED_LIMITS -1000000.00000 999999.999534 /end CHARACTERISTIC
/begin CHARACTERISTIC Exh_IKiPsvNSCDs_C "Für positive Großsignale (I-Regler)" VALUE 0x8004E880 Val_Ws32 99.9998301268 Ki 0.00 99.9998301268 FORMAT "%13.9" EXTENDED_LIMITS -1000000.00000 999999.999534 /end CHARACTERISTIC
/begin CHARACTERISTIC Exh_LamDebNoCat2Ds.tiHiLo_C "Struktur für Entprellparameter zur Entprellung der vom NOx-Regler empfangenen Lambda-Signale/" VALUE 0x8004E090 Kw_Ws16 5000.000 TimeDeb 0.00 5000.000 EXTENDED_LIMITS -327680.0 327670.0 /end CHARACTERISTIC
/begin CHARACTERISTIC Exh_LamDebNoCat2Ds.tiLoHi_C "Struktur für Entprellparameter zur Entprellung der vom NOx-Regler empfangenen Lambda-Signale/" VALUE 0x8004E092 Kw_Ws16 5000.000 TimeDeb 0.00 5000.000 EXTENDED_LIMITS -327680.0 327670.0 /end CHARACTERISTIC
/begin CHARACTERISTIC Exh_LamDebNSCDs.tiHiLo_C "Struktur für Entprellparameter zur Entprellung der vom NOx-Regler empfangenen Lambda-Signale/" VALUE 0x8004E50C Kw_Ws16 5000.000 TimeDeb 0.00 5000.000 EXTENDED_LIMITS -327680.0 327670.0 /end CHARACTERISTIC
/begin CHARACTERISTIC Exh_LamDebNSCDs.tiLoHi_C "Struktur für Entprellparameter zur Entprellung der vom NOx-Regler empfangenen Lambda-Signale/" VALUE 0x8004E50E Kw_Ws16 5000.000 TimeDeb 0.00 5000.000 EXTENDED_LIMITS -327680.0 327670.0 /end CHARACTERISTIC
/begin CHARACTERISTIC Exh_mAirAdapActvNoCat2Ds_C "Min. integrierter Luftmassenstrom" VALUE 0x8004E408 Kw_Ws16 500.0000 AirMass_2 0.00 500.0000 FORMAT "%8.4" EXTENDED_LIMITS -3276.800 3276.700 /end CHARACTERISTIC
/begin CHARACTERISTIC Exh_mAirAdapActvNSCDs_C "Min. integrierter Luftmassenstrom" VALUE 0x8004E884 Kw_Ws16 500.0000 AirMass_2 0.00 500.0000 FORMAT "%8.4" EXTENDED_LIMITS -3276.800 3276.700 /end CHARACTERISTIC
/begin CHARACTERISTIC Exh_mAirMaxCmpChkNoCat2Ds_C "Obere Luftmassengrenze für Differenzprüfung" VALUE 0x8004E4E0 Val_Ws16 10100.00 AirMassPerCyl -100.0000 10000.00 EXTENDED_LIMITS -3276.800 3276.700 /end CHARACTERISTIC
/begin CHARACTERISTIC Exh_mAirMaxCmpChkNSCDs_C "Obere Luftmassenschwelle für Differenzprüfung" VALUE 0x8004E95C Val_Ws16 10100.00 AirMassPerCyl -100.0000 10000.00 EXTENDED_LIMITS -3276.800 3276.700 /end CHARACTERISTIC
/begin CHARACTERISTIC Exh_mAirMinCmpChkNoCat2Ds_C "Untere Luftmassengrenze für Differenzprüfung" VALUE 0x8004E4E2 Val_Ws16 1000.000 AirMassPerCyl 0.00 1000.000 EXTENDED_LIMITS -3276.800 3276.700 /end CHARACTERISTIC
/begin CHARACTERISTIC Exh_mAirMinCmpChkNSCDs_C "Untere Luftmassenschwelle für Differenzprüfung" VALUE 0x8004E95E Val_Ws16 1000.000 AirMassPerCyl 0.00 1000.000 EXTENDED_LIMITS -3276.800 3276.700 /end CHARACTERISTIC
/begin CHARACTERISTIC Exh_mNOxOfsTstLimNoCat2Ds_C "Schwelle der NOx-Massengrenze im NSC-Speicher, oberhalb derer kein Offset-Test durchgeführt wird" VALUE 0x8004E4A8 Val_Ws32 10000.0000000 M_NOxLd 0.00 10000.0000000 FORMAT "%13.7" EXTENDED_LIMITS -21474.8364800 21474.8364700 /end CHARACTERISTIC
/begin CHARACTERISTIC Exh_mNOxOfsTstLimNSCDs_C "Schwelle der NOx-Massengrenze im NSC-Speicher, oberhalb derer kein Offset-Test durchgeführt wird" VALUE 0x8004E924 Val_Ws32 10000.0000000 M_NOxLd 0.00 10000.0000000 FORMAT "%13.7" EXTENDED_LIMITS -21474.8364800 21474.8364700 /end CHARACTERISTIC
/begin CHARACTERISTIC Exh_nMaxCmpChkNoCat2Ds_C "Obere Drehzahlschwelle für Differenzprüfung" VALUE 0x8004E4E4 Val_Ws16 10100.00 EngN -100.0000 10000.00 EXTENDED_LIMITS -16384.00 16383.50 /end CHARACTERISTIC
/begin CHARACTERISTIC Exh_nMaxCmpChkNSCDs_C "Obere Drehzahlschwelle für Differenzprüfung" VALUE 0x8004E960 Val_Ws16 10100.00 EngN -100.0000 10000.00 EXTENDED_LIMITS -16384.00 16383.50 /end CHARACTERISTIC
/begin CHARACTERISTIC Exh_nMaxNoCat2Ds_C "Obere Drehzahlschwelle für Freigabe des Offset-Tests" VALUE 0x8004E4AC Val_Ws16 5000.000 EngN 0.00 5000.000 EXTENDED_LIMITS -16384.00 16383.50 /end CHARACTERISTIC
/begin CHARACTERISTIC Exh_nMaxNSCDs_C "Obere Drehzahlschwelle für Freigabe des Offset-Tests" VALUE 0x8004E928 Val_Ws16 5000.000 EngN 0.00 5000.000 EXTENDED_LIMITS -16384.00 16383.50 /end CHARACTERISTIC
/begin CHARACTERISTIC Exh_nMaxR2LTstNoCat2Ds_C "Obere Drehzahlschwelle für die Plausibilitätsprüfung der NOX-Gültigkeit während der Umstellung der Betriebsart von fett auf mager." VALUE 0x8004E4E6 Val_Ws16 10100.00 EngN -100.0000 10000.00 EXTENDED_LIMITS -16384.00 16383.50 /end CHARACTERISTIC
/begin CHARACTERISTIC Exh_nMaxR2LTstNSCDs_C "Obere Drehzahlschwelle für die Plausibilitätsprüfung von NOx-Gültigkeitszustand während der Umstellung der Betriebsart von fett auf mager" VALUE 0x8004E962 Val_Ws16 10100.00 EngN -100.0000 10000.00 EXTENDED_LIMITS -16384.00 16383.50 /end CHARACTERISTIC
/begin CHARACTERISTIC Exh_nMinCmpChkNoCat2Ds_C "Untere Drehzahlschwelle für Differenzprüfung" VALUE 0x8004E4E8 Val_Ws16 9999.000 EngN 1.000000 10000.00 EXTENDED_LIMITS -16384.00 16383.50 /end CHARACTERISTIC
/begin CHARACTERISTIC Exh_nMinCmpChkNSCDs_C "Untere Drehzahlschwelle für Differenzprüfung" VALUE 0x8004E964 Val_Ws16 9999.000 EngN 1.000000 10000.00 EXTENDED_LIMITS -16384.00 16383.50 /end CHARACTERISTIC
/begin CHARACTERISTIC Exh_nMinNoCat2Ds_C "Untere Drehzahlschwelle für Freigabe des Offset-Tests" VALUE 0x8004E4AE Val_Ws16 500.0000 EngN 0.00 500.0000 EXTENDED_LIMITS -16384.00 16383.50 /end CHARACTERISTIC
/begin CHARACTERISTIC Exh_nMinNSCDs_C "Untere Drehzahlschwelle für Freigabe des Offset-Tests" VALUE 0x8004E92A Val_Ws16 500.0000 EngN 0.00 500.0000 EXTENDED_LIMITS -16384.00 16383.50 /end CHARACTERISTIC
/begin CHARACTERISTIC Exh_NOxNoCat2DsDeb.tiHiLo_C "Struktur zur Entprellung der Gültigkeit des NOx-Signals/" VALUE 0x8004E4B0 Kw_Ws16 10000.00 TimeDeb 0.00 10000.00 EXTENDED_LIMITS -327680.0 327670.0 /end CHARACTERISTIC
/begin CHARACTERISTIC Exh_NOxNoCat2DsDeb.tiLoHi_C "Struktur zur Entprellung der Gültigkeit des NOx-Signals/" VALUE 0x8004E4B2 Kw_Ws16 10000.00 TimeDeb 0.00 10000.00 EXTENDED_LIMITS -327680.0 327670.0 /end CHARACTERISTIC
/begin CHARACTERISTIC Exh_NOxNSCDsDeb.tiHiLo_C "Struktur zur Entprellung der Gültigkeit des NOx-Signals/" VALUE 0x8004E92C Kw_Ws16 10000.00 TimeDeb 0.00 10000.00 EXTENDED_LIMITS -327680.0 327670.0 /end CHARACTERISTIC
/begin CHARACTERISTIC Exh_NOxNSCDsDeb.tiLoHi_C "Struktur zur Entprellung der Gültigkeit des NOx-Signals/" VALUE 0x8004E92E Kw_Ws16 10000.00 TimeDeb 0.00 10000.00 EXTENDED_LIMITS -327680.0 327670.0 /end CHARACTERISTIC
/begin CHARACTERISTIC Exh_numSensCmpChkNoCat2Ds_CA "Sensorpaare für Vergleichsprüfung" VAL_BLK 0x8004E4EA ValA_Wu8 255.0 OneToOne 0.00 255.0 READ_ONLY NUMBER 1 /end CHARACTERISTIC
/begin CHARACTERISTIC Exh_numSensCmpChkNSCDs_CA "Sensorpaare für Vergleichsprüfung" VAL_BLK 0x8004E966 ValA_Wu8 255.0 OneToOne 0.00 255.0 READ_ONLY NUMBER 1 /end CHARACTERISTIC
/begin CHARACTERISTIC Exh_pEGFldNoCat2Ds_C "Schalter zum Auswählen des Elements für Abgasgegendruck" VALUE 0x8004E40A Val_Wu8 10.00 OneToOne 0.00 10.00 EXTENDED_LIMITS 0.00 255.0 /end CHARACTERISTIC
/begin CHARACTERISTIC Exh_pEGFldNSCDs_C "Schalter zum Auswählen des Elements für Abgasgegendruck" VALUE 0x8004E886 Val_Wu8 10.00 OneToOne 0.00 10.00 EXTENDED_LIMITS 0.00 255.0 /end CHARACTERISTIC
/begin CHARACTERISTIC Exh_qMaxCmpChkNoCat2Ds_C "Obere Mengenschwelle für Differenzprüfung" VALUE 0x8004E4EC Val_Ws16 100.0000 InjMass 0.00 100.0000 EXTENDED_LIMITS -327.6800 327.6700 /end CHARACTERISTIC
/begin CHARACTERISTIC Exh_qMaxCmpChkNSCDs_C "Obere Mengenschwelle für Differenzprüfung" VALUE 0x8004E968 Val_Ws16 100.0000 InjMass 0.00 100.0000 EXTENDED_LIMITS -327.6800 327.6700 /end CHARACTERISTIC
/begin CHARACTERISTIC Exh_qMinCmpChkNoCat2Ds_C "Untere Mengenschwelle für Differenzprüfung" VALUE 0x8004E4EE Val_Ws16 1000.000 InjMass 0.00 1000.000 EXTENDED_LIMITS -327.6800 327.6700 /end CHARACTERISTIC
/begin CHARACTERISTIC Exh_qMinCmpChkNSCDs_C "Untere Mengenschwelle für Differenzprüfung" VALUE 0x8004E96A Val_Ws16 1000.000 InjMass 0.00 1000.000 EXTENDED_LIMITS -327.6800 327.6700 /end CHARACTERISTIC
/begin CHARACTERISTIC Exh_rEGRMaxCmpChkNoCat2Ds_C "Obere Grenze der AGR-Position" VALUE 0x8004E4F0 Val_Ws16 700.0000 Prc -200.0000 500.0000 EXTENDED_LIMITS -400.0000 399.9878 /end CHARACTERISTIC
/begin CHARACTERISTIC Exh_rEGRMaxCmpChkNSCDs_C "Obere Grenze der AGR-Position" VALUE 0x8004E96C Val_Ws16 700.0000 Prc -200.0000 500.0000 EXTENDED_LIMITS -400.0000 399.9878 /end CHARACTERISTIC
/begin CHARACTERISTIC Exh_rEGRMinCmpChkNoCat2Ds_C "Untere Grenze der AGR-Position" VALUE 0x8004E4F2 Val_Ws16 200.0000 Prc -100.0000 100.0000 EXTENDED_LIMITS -400.0000 399.9878 /end CHARACTERISTIC
/begin CHARACTERISTIC Exh_rEGRMinCmpChkNSCDs_C "Untere Grenze der AGR-Position" VALUE 0x8004E96E Val_Ws16 200.0000 Prc -100.0000 100.0000 EXTENDED_LIMITS -400.0000 399.9878 /end CHARACTERISTIC
/begin CHARACTERISTIC Exh_rLamBinNoCat2Ds_CUR "Kennlinie zur Berechnung des binären Lambda-Wertes" CURVE 0x8004E094 Cur_Xs16Ws16 31.35000 lambda 0.6500000 32.00000 EXTENDED_LIMITS -32.76800 32.76700
 /begin AXIS_DESCR STD_AXIS Com_uLamBinCat2Ds Volt 16 -6553.600 6553.400 DEPOSIT ABSOLUTE /end AXIS_DESCR
/end CHARACTERISTIC
/begin CHARACTERISTIC Exh_rLamBinNSCDs_CUR "Kennlinie zur Berechnung des binären Lambda-Wertes" CURVE 0x8004E510 Cur_Xs16Ws16 31.35000 lambda 0.6500000 32.00000 EXTENDED_LIMITS -32.76800 32.76700
 /begin AXIS_DESCR STD_AXIS Com_uLamBinDs Volt 16 -6553.600 6553.400 DEPOSIT ABSOLUTE /end AXIS_DESCR
/end CHARACTERISTIC
/begin CHARACTERISTIC Exh_rLamLeanLimNoCat2Ds_C "Spannungs-Schwellengrenze, oberhalb derer Lambda als mager klassifiziert wird" VALUE 0x8004E0D6 Val_Ws16 31.80000 lambda 0.2000000 32.00000 EXTENDED_LIMITS -32.76800 32.76700 /end CHARACTERISTIC
/begin CHARACTERISTIC Exh_rLamLeanLimNSCDs_C "Spannungs-Schwellengrenze, oberhalb derer Lambda als mager klassifiziert wird" VALUE 0x8004E552 Val_Ws16 31.80000 lambda 0.2000000 32.00000 EXTENDED_LIMITS -32.76800 32.76700 /end CHARACTERISTIC
/begin CHARACTERISTIC Exh_rLamLinMaxNoCat2Ds_C "Max. linearer Lambda-Wert" VALUE 0x8004E4D0 Val_Ws16 15100.00 lambdaRec -100.0000 15000.00 FORMAT "%8.2" EXTENDED_LIMITS -3.276800 3.276700 /end CHARACTERISTIC
/begin CHARACTERISTIC Exh_rLamLinMaxNSCDs_C "Max. linearer Lambda-Wert" VALUE 0x8004E94C Val_Ws16 15100.00 lambdaRec -100.0000 15000.00 FORMAT "%8.2" EXTENDED_LIMITS -3.276800 3.276700 /end CHARACTERISTIC
/begin CHARACTERISTIC Exh_rLamLinMinNoCat2Ds_C "Min. linearer Lambda-Wert" VALUE 0x8004E4D2 Val_Ws16 0.1010000 lambdaRec -0.001000000 0.1000000 FORMAT "%9.7" EXTENDED_LIMITS -3.276800 3.276700 /end CHARACTERISTIC
/begin CHARACTERISTIC Exh_rLamLinMinNSCDs_C "Min. linearer Lambda-Wert" VALUE 0x8004E94E Val_Ws16 0.1010000 lambdaRec -0.001000000 0.1000000 FORMAT "%9.7" EXTENDED_LIMITS -3.276800 3.276700 /end CHARACTERISTIC
/begin CHARACTERISTIC Exh_rLamOfsTstLimNoCat2Ds_C "Schwelle der Lambda-Offset-Grenze, oberhalb derer kein Offset-Test durchgeführt wird" VALUE 0x8004E4B4 Val_Ws16 10000.00 lambda 0.00 10000.00 EXTENDED_LIMITS -32.76800 32.76700 /end CHARACTERISTIC
/begin CHARACTERISTIC Exh_rLamOfsTstLimNSCDs_C "Schwelle der Lambda-Offset-Grenze, oberhalb derer kein Offset-Test durchgeführt wird" VALUE 0x8004E930 Val_Ws16 10000.00 lambda 0.00 10000.00 EXTENDED_LIMITS -32.76800 32.76700 /end CHARACTERISTIC
/begin CHARACTERISTIC Exh_rLamRecNoCat2Ds_CUR "Kennlinie zur Berechnung von O2 zum Lambda-Kehrwert für den fetten Zustand" CURVE 0x8004E40C Cur_Xs16Ws16 31.35000 lambdaRec 0.6500000 32.00000 FORMAT "%8.5" EXTENDED_LIMITS -3.276800 3.276700
 /begin AXIS_DESCR STD_AXIS Exh_rO2AdapNoCat2Ds O2 16 -0.3276800 0.3276700 DEPOSIT ABSOLUTE /end AXIS_DESCR
/end CHARACTERISTIC
/begin CHARACTERISTIC Exh_rLamRecNSCDs_CUR "Kennlinie zur Berechnung von O2 zum Lambda-Kehrwert für fetten Zustand" CURVE 0x8004E888 Cur_Xs16Ws16 31.35000 lambdaRec 0.6500000 32.00000 FORMAT "%8.5" EXTENDED_LIMITS -3.276800 3.276700
 /begin AXIS_DESCR STD_AXIS Exh_rO2AdapNSCDs O2 16 -0.3276800 0.3276700 DEPOSIT ABSOLUTE /end AXIS_DESCR
/end CHARACTERISTIC
/begin CHARACTERISTIC Exh_rMaxDiffNoCat2Ds_CA "Max. Differenz zwischen den ausgewählten Sensoren für Vergleichsprüfung" VAL_BLK 0x8004E4F4 ValA_Ws16 0.6553500 O2 -0.3276800 0.3276700 READ_ONLY NUMBER 1 /end CHARACTERISTIC
/begin CHARACTERISTIC Exh_rMaxDiffNSCDs_CA "Max. Differenz zwischen den ausgewählten Sensoren für Vergleichsprüfung" VAL_BLK 0x8004E970 ValA_Ws16 0.6553500 O2 -0.3276800 0.3276700 READ_ONLY NUMBER 1 /end CHARACTERISTIC
/begin CHARACTERISTIC Exh_rNOxMaxNoCat2Ds_C "Max. NOx-Wert" VALUE 0x8004E4F6 Val_Ws16 65535.00 OneToOne -32768.00 32767.00 /end CHARACTERISTIC
/begin CHARACTERISTIC Exh_rNOxMaxNSCDs_C "Max. NOx-Wert" VALUE 0x8004E972 Val_Ws16 65535.00 OneToOne -32768.00 32767.00 /end CHARACTERISTIC
/begin CHARACTERISTIC Exh_rNOxMinNoCat2Ds_C "Min. NOx-Wert" VALUE 0x8004E4F8 Val_Ws16 65535.00 OneToOne -32768.00 32767.00 /end CHARACTERISTIC
/begin CHARACTERISTIC Exh_rNOxMinNSCDs_C "Min. NOx-Wert" VALUE 0x8004E974 Val_Ws16 65535.00 OneToOne -32768.00 32767.00 /end CHARACTERISTIC
/begin CHARACTERISTIC Exh_rNOxOfsdiffMinNoCat2Ds_C "Min. Differenz NOx-Offset-Wert" VALUE 0x8004E4B6 Val_Ws16 10000.00 nox 0.00 10000.00 FORMAT "%8.2" EXTENDED_LIMITS -32768.00 32767.00 /end CHARACTERISTIC
/begin CHARACTERISTIC Exh_rNOxOfsdiffMinNSCDs_C "Min. Differenz NOx-Offset-Wert" VALUE 0x8004E932 Val_Ws16 10000.00 nox 0.00 10000.00 FORMAT "%8.2" EXTENDED_LIMITS -32768.00 32767.00 /end CHARACTERISTIC
/begin CHARACTERISTIC Exh_rNOxOfsMaxNoCat2Ds_C "Schwelle der NOx-Konzentrationsgrenze, unterhalb derer keine Auswertung des NOx-Offset-Wertes durchgeführt wird" VALUE 0x8004E4B8 Val_Ws16 10000.00 nox 0.00 10000.00 FORMAT "%8.2" EXTENDED_LIMITS -32768.00 32767.00 /end CHARACTERISTIC
/begin CHARACTERISTIC Exh_rNOxOfsMaxNSCDs_C "Schwelle der NOx-Konzentrationsgrenze, unterhalb derer keine Auswertung des NOx-Offsetwerts durchgeführt wird" VALUE 0x8004E934 Val_Ws16 10000.00 nox 0.00 10000.00 FORMAT "%8.2" EXTENDED_LIMITS -32768.00 32767.00 /end CHARACTERISTIC
/begin CHARACTERISTIC Exh_rNOxOfsMaxVarNoCat2Ds_C "Schwelle der NOx-Offset-Streuung, oberhalb derer der NOx-Offset-Wert ungültig ist" VALUE 0x8004E4BA Val_Ws16 10000.00 nox 0.00 10000.00 FORMAT "%8.2" EXTENDED_LIMITS -32768.00 32767.00 /end CHARACTERISTIC
/begin CHARACTERISTIC Exh_rNOxOfsMaxVarNSCDs_C "Schwelle der NOx-Offset-Streuung, oberhalb derer der NOx-Offset-Wert ungültig ist" VALUE 0x8004E936 Val_Ws16 10000.00 nox 0.00 10000.00 FORMAT "%8.2" EXTENDED_LIMITS -32768.00 32767.00 /end CHARACTERISTIC
/begin CHARACTERISTIC Exh_rNOxOfsMinNoCat2Ds_C "Min. NOx-Offset-Wert" VALUE 0x8004E4BC Val_Ws16 10000.00 nox 0.00 10000.00 FORMAT "%8.2" EXTENDED_LIMITS -32768.00 32767.00 /end CHARACTERISTIC
/begin CHARACTERISTIC Exh_rNOxOfsMinNSCDs_C "Min. NOx-Offset-Wert" VALUE 0x8004E938 Val_Ws16 10000.00 nox 0.00 10000.00 FORMAT "%8.2" EXTENDED_LIMITS -32768.00 32767.00 /end CHARACTERISTIC
/begin CHARACTERISTIC Exh_rNOxPresCompLeanNoCat2Ds_MAP "Kennfeld, um druckkompensiertes NOx-Signal zu empfangen" MAP 0x8004E128 Map_Xs16Ys16Ws16 3850.000 nox -350.0000 3500.000 FORMAT "%8.3" EXTENDED_LIMITS -32768.00 32767.00
 /begin AXIS_DESCR STD_AXIS Exh_rNOxFltNoCat2Ds_mp nox 16 0.00 6000.000 FORMAT "%8.3" EXTENDED_LIMITS -32768.00 32767.00 DEPOSIT ABSOLUTE /end AXIS_DESCR
 /begin AXIS_DESCR STD_AXIS Exh_pEGFld1NoCat2Ds_mp Pres_hPa 16 -6000.000 3500.000 EXTENDED_LIMITS -32768.00 32767.00 DEPOSIT ABSOLUTE /end AXIS_DESCR
/end CHARACTERISTIC
/begin CHARACTERISTIC Exh_rNOxPresCompLeanNSCDs_MAP "Kennfeld, um druckkompensiertes NOx-Signal zu empfangen" MAP 0x8004E5A4 Map_Xs16Ys16Ws16 65535.00 nox -32768.00 32767.00 FORMAT "%8.2"
 /begin AXIS_DESCR STD_AXIS Exh_rNOxFltNSCDs_mp nox 16 0.00 6000.000 FORMAT "%8.3" EXTENDED_LIMITS -32768.00 32767.00 DEPOSIT ABSOLUTE /end AXIS_DESCR
 /begin AXIS_DESCR STD_AXIS Exh_pEGFld1NSCDs_mp Pres_hPa 16 -6000.000 3500.000 EXTENDED_LIMITS -32768.00 32767.00 DEPOSIT ABSOLUTE /end AXIS_DESCR
/end CHARACTERISTIC
/begin CHARACTERISTIC Exh_rO2LinMaxNoCat2Ds_C "Max. O2-Wert im Schubbetrieb" VALUE 0x8004E4D4 Val_Ws16 5100.000 O2 -100.0000 5000.000 EXTENDED_LIMITS -0.3276800 0.3276700 /end CHARACTERISTIC
/begin CHARACTERISTIC Exh_rO2LinMaxNSCDs_C "Max. O2-Wert im Schubbetrieb" VALUE 0x8004E950 Val_Ws16 5100.000 O2 -100.0000 5000.000 EXTENDED_LIMITS -0.3276800 0.3276700 /end CHARACTERISTIC
/begin CHARACTERISTIC Exh_rO2LinMinNoCat2Ds_C "Min. O2-Wert im Schubbetrieb" VALUE 0x8004E4D6 Val_Ws16 1010.000 O2 -10.00000 1000.000 EXTENDED_LIMITS -0.3276800 0.3276700 /end CHARACTERISTIC
/begin CHARACTERISTIC Exh_rO2LinMinNSCDs_C "Min. O2-Wert im Schubbetrieb" VALUE 0x8004E952 Val_Ws16 1010.000 O2 -10.00000 1000.000 EXTENDED_LIMITS -0.3276800 0.3276700 /end CHARACTERISTIC
/begin CHARACTERISTIC Exh_rO2LinNoCat2Ds_CUR "Kennlinie zur Berechnung des Lambda-Kehrwerts zum O2-Wert" CURVE 0x8004E0D8 Cur_Xs16Ws16 32.65000 O2 -0.6500000 32.00000 EXTENDED_LIMITS -0.3276800 0.3276700
 /begin AXIS_DESCR STD_AXIS Exh_rLamLinRecNoCat2Ds_mp lambdaRec 16 -3.276800 3.276700 FORMAT "%8.6" DEPOSIT ABSOLUTE /end AXIS_DESCR
/end CHARACTERISTIC
/begin CHARACTERISTIC Exh_rO2LinNSCDs_CUR "Kennlinie zur Berechnung des Lambda-Kehrwerts zum O2-Wert" CURVE 0x8004E554 Cur_Xs16Ws16 32.65000 O2 -0.6500000 32.00000 EXTENDED_LIMITS -0.3276800 0.3276700
 /begin AXIS_DESCR STD_AXIS Exh_rLamLinRecNSCDs_mp lambdaRec 16 -3.276800 3.276700 FORMAT "%8.6" DEPOSIT ABSOLUTE /end AXIS_DESCR
/end CHARACTERISTIC
/begin CHARACTERISTIC Exh_rO2MaxVarNoCat2Ds_C "Toleranzbandbreite zur Erkennung des eingeschwungenen O2-Zustands" VALUE 0x8004E4FA Val_Ws16 110.0000 O2 -10.00000 100.0000 EXTENDED_LIMITS -0.3276800 0.3276700 /end CHARACTERISTIC
/begin CHARACTERISTIC Exh_rO2MaxVarNSCDs_C "Toleranzbandbreite zur Erkennung des eingeschwungenen O2-Zustands" VALUE 0x8004E976 Val_Ws16 110.0000 O2 -10.00000 100.0000 EXTENDED_LIMITS -0.3276800 0.3276700 /end CHARACTERISTIC
/begin CHARACTERISTIC Exh_rPIDWinNgvNoCat2Ds_C "Negative Fenstergrenze" VALUE 0x8004E44E Val_Ws16 100.0000 DtyCyc -100.0000 0.00 EXTENDED_LIMITS -327.6800 327.6700 /end CHARACTERISTIC
/begin CHARACTERISTIC Exh_rPIDWinNgvNSCDs_C "Negative Fenstergrenze" VALUE 0x8004E8CA Val_Ws16 655.3500 DtyCyc -327.6800 327.6700 /end CHARACTERISTIC
/begin CHARACTERISTIC Exh_rPIDWinPsvNoCat2Ds_C "Positive Fenstergrenze" VALUE 0x8004E450 Val_Ws16 100.0000 DtyCyc 0.00 100.0000 EXTENDED_LIMITS -327.6800 327.6700 /end CHARACTERISTIC
/begin CHARACTERISTIC Exh_rPIDWinPsvNSCDs_C "Positive Fenstergrenze" VALUE 0x8004E8CC Val_Ws16 100.0000 DtyCyc 0.00 100.0000 EXTENDED_LIMITS -327.6800 327.6700 /end CHARACTERISTIC
/begin CHARACTERISTIC Exh_stMskCmpChkO2NoCat2Ds_C "Maske zur Auswahl der Anforderungsaktivierung des Motorbetriebsart-Koordinators" VALUE 0x8004E4FC Val_Wu32 10000.0000000 OneToOne 0.00 10000.0000000 EXTENDED_LIMITS 0.00 4294967295.00 /end CHARACTERISTIC
/begin CHARACTERISTIC Exh_stMskCmpChkO2NSCDs_C "Maske zur Auswahl der Anforderungsaktivierung des Motorbetriebsart-Koordinators" VALUE 0x8004E978 Val_Wu32 10000.0000000 OneToOne 0.00 10000.0000000 EXTENDED_LIMITS 0.00 4294967295.00 /end CHARACTERISTIC
/begin CHARACTERISTIC Exh_swtAdapActvNoCat2Ds_C "Anpassungsschalterkalibrierung konstant" VALUE 0x8004E452 Kw_Wu8 5.000 OneToOne 0.00 5.000 EXTENDED_LIMITS 0.00 255.0 /end CHARACTERISTIC
/begin CHARACTERISTIC Exh_swtAdapActvNSCDs_C "Anpassungsschalterkalibrierung konstant" VALUE 0x8004E8CE Kw_Wu8 5.000 OneToOne 0.00 5.000 EXTENDED_LIMITS 0.00 255.0 /end CHARACTERISTIC
/begin CHARACTERISTIC Exh_swtNoCat2Ds_C "Applikationsschalter zur Auswahl der NOx-Funktionalität" VALUE 0x8004E11A Val_Wu8 5.000 OneToOne 0.00 5.000 EXTENDED_LIMITS 0.00 255.0 /end CHARACTERISTIC
/begin CHARACTERISTIC Exh_swtNOxOfsCorrEnaNoCat2Ds_C "NOx-Offset-Freigabeschalter" VALUE 0x8004E4BE Kw_Wu8 10.00 OneToOne 0.00 10.00 EXTENDED_LIMITS 0.00 255.0 /end CHARACTERISTIC
/begin CHARACTERISTIC Exh_swtNOxOfsCorrEnaNSCDs_C "NOx-Offset-Freigabeschalter" VALUE 0x8004E93A Kw_Wu8 10.00 OneToOne 0.00 10.00 EXTENDED_LIMITS 0.00 255.0 /end CHARACTERISTIC
/begin CHARACTERISTIC Exh_swtNSCDs_C "Applikationsschalter zur Auswahl der NOx-Funktionalität" VALUE 0x8004E596 Val_Wu8 5.000 OneToOne 0.00 5.000 EXTENDED_LIMITS 0.00 255.0 /end CHARACTERISTIC
/begin CHARACTERISTIC Exh_tiAdapFltInitNoCat2Ds_C "Zeitkonstante für Initialisierug des Anpassungsfilters" VALUE 0x8004E454 Kw_Ws16 3.9999695423 TimeDelay_s 0.99999238556 4.9999619278 FORMAT "%12.10" EXTENDED_LIMITS 0.13107600012 4294.9672960 /end CHARACTERISTIC
/begin CHARACTERISTIC Exh_tiAdapFltInitNSCDs_C "Zeitkonstante für Initialisierug des Anpassungsfilters" VALUE 0x8004E8D0 Kw_Ws16 3.9999695423 TimeDelay_s 0.99999238556 4.9999619278 FORMAT "%12.10" EXTENDED_LIMITS 0.13107600012 4294.9672960 /end CHARACTERISTIC
/begin CHARACTERISTIC Exh_tiAdapFltNoCat2Ds_C "Zeitkonstante für Auswertungsfilter" VALUE 0x8004E456 Kw_Ws16 9.0115863930 TimeDelay_s 0.99999238556 10.011578779 FORMAT "%12.9" EXTENDED_LIMITS 0.13107600012 4294.9672960 /end CHARACTERISTIC
/begin CHARACTERISTIC Exh_tiAdapFltNSCDs_C "Zeitkonstante für Auswertungsfilter" VALUE 0x8004E8D2 Kw_Ws16 9.0115863930 TimeDelay_s 0.99999238556 10.011578779 FORMAT "%12.9" EXTENDED_LIMITS 0.13107600012 4294.9672960 /end CHARACTERISTIC
/begin CHARACTERISTIC Exh_tiAvrgNOxOfsTstNoCat2Ds_C "Min. Zeitdauer, in der der NOx-Offset-Wert gemittelt werden muss" VALUE 0x8004E4C0 Val_Wu16 10000.00 Time_s 0.00 10000.00 EXTENDED_LIMITS 0.00 655.3500 /end CHARACTERISTIC
/begin CHARACTERISTIC Exh_tiAvrgNOxOfsTstNSCDs_C "Min. Zeitdauer, in der der NOx-Offset-Wert gemittelt werden muss" VALUE 0x8004E93C Val_Wu16 10000.00 Time_s 0.00 10000.00 EXTENDED_LIMITS 0.00 655.3500 /end CHARACTERISTIC
/begin CHARACTERISTIC Exh_tiDelOvrRunNoCat2Ds_C "Entprellzeit für positive Flanke des Schubstatus" VALUE 0x8004E4D8 Val_Wu16 15000.00 TimeDeb 0.00 15000.00 EXTENDED_LIMITS 0.00 655350.0 /end CHARACTERISTIC
/begin CHARACTERISTIC Exh_tiDelOvrRunNSCDs_C "Entprellzeit für positive Flanke des Schubstatus" VALUE 0x8004E954 Val_Wu16 15000.00 TimeDeb 0.00 15000.00 EXTENDED_LIMITS 0.00 655350.0 /end CHARACTERISTIC
/begin CHARACTERISTIC Exh_tiDlyCmpChkO2NoCat2Ds_C "Min. Zeitdauer, in der die Motorbetriebsart-Koordinatoranforderung inaktiv ist, um die Differenzprüfung freizugeben" VALUE 0x8004E500 Val_Wu16 1000.000 Time_s 0.00 1000.000 EXTENDED_LIMITS 0.00 655.3500 /end CHARACTERISTIC
/begin CHARACTERISTIC Exh_tiDlyCmpChkO2NSCDs_C "Min. Zeitdauer, in der die Motorbetriebsart-Koordinatoranforderung inaktiv ist, um die Differenzprüfung freizugeben" VALUE 0x8004E97C Val_Wu16 1000.000 Time_s 0.00 1000.000 EXTENDED_LIMITS 0.00 655.3500 /end CHARACTERISTIC
/begin CHARACTERISTIC Exh_tiEvalFltNoCat2Ds_C "Zeitkonstante für Auswertungsfilter" VALUE 0x8004E458 Kw_Ws16 3.9999695423 TimeDelay_s 0.99999238556 4.9999619278 FORMAT "%12.10" EXTENDED_LIMITS 0.13107600012 4294.9672960 /end CHARACTERISTIC
/begin CHARACTERISTIC Exh_tiEvalFltNSCDs_C "Zeitkonstante für Auswertungsfilter" VALUE 0x8004E8D4 Kw_Ws16 3.9999695423 TimeDelay_s 0.99999238556 4.9999619278 FORMAT "%12.10" EXTENDED_LIMITS 0.13107600012 4294.9672960 /end CHARACTERISTIC
/begin CHARACTERISTIC Exh_tiEvalInitFltNoCat2Ds_C "Zeitkonstante für Initialisierung des Auswertungsfilters" VALUE 0x8004E45A Kw_Ws16 3.9999695423 TimeDelay_s 0.99999238556 4.9999619278 FORMAT "%12.10" EXTENDED_LIMITS 0.13107600012 4294.9672960 /end CHARACTERISTIC
/begin CHARACTERISTIC Exh_tiEvalInitFltNSCDs_C "Zeitkonstante für Initialisierung des Auswertungsfilters" VALUE 0x8004E8D6 Kw_Ws16 3.9999695423 TimeDelay_s 0.99999238556 4.9999619278 FORMAT "%12.10" EXTENDED_LIMITS 0.13107600012 4294.9672960 /end CHARACTERISTIC
/begin CHARACTERISTIC Exh_tiHtgSensMaxNoCat2Ds_C "Aufheizzeit des NOx-Sensors" VALUE 0x8004E4C2 Kw_Wu16 9990.000 Time_ms 10.00000 10000.00 EXTENDED_LIMITS 0.00 655350.0 /end CHARACTERISTIC
/begin CHARACTERISTIC Exh_tiHtgSensMaxNSCDs_C "Aufheizzeit des NOx-Sensors" VALUE 0x8004E93E Kw_Wu16 9990.000 Time_ms 10.00000 10000.00 EXTENDED_LIMITS 0.00 655350.0 /end CHARACTERISTIC
/begin CHARACTERISTIC Exh_tiLamLeanNoCat2DsDeb.tiHiLo_C "Struktur für Entprellparameter des Lambda-Magerzustands des NOx-Sensors/" VALUE 0x8004E11C Kw_Ws16 5000.000 TimeDeb 0.00 5000.000 EXTENDED_LIMITS -327680.0 327670.0 /end CHARACTERISTIC
/begin CHARACTERISTIC Exh_tiLamLeanNoCat2DsDeb.tiLoHi_C "Struktur für Entprellparameter des Lambda-Magerzustands des NOx-Sensors/" VALUE 0x8004E11E Kw_Ws16 5000.000 TimeDeb 0.00 5000.000 EXTENDED_LIMITS -327680.0 327670.0 /end CHARACTERISTIC
/begin CHARACTERISTIC Exh_tiLamLeanNSCDsDeb.tiHiLo_C "Struktur für Entprellparameter des Lambda-Magerzustands des NOx-Sensors/" VALUE 0x8004E598 Kw_Ws16 5000.000 TimeDeb 0.00 5000.000 EXTENDED_LIMITS -327680.0 327670.0 /end CHARACTERISTIC
/begin CHARACTERISTIC Exh_tiLamLeanNSCDsDeb.tiLoHi_C "Struktur für Entprellparameter des Lambda-Magerzustands des NOx-Sensors/" VALUE 0x8004E59A Kw_Ws16 5000.000 TimeDeb 0.00 5000.000 EXTENDED_LIMITS -327680.0 327670.0 /end CHARACTERISTIC
/begin CHARACTERISTIC Exh_tiLoHiOfsDebNoCat2Ds_C "Kalibrierungsparameter für Offset-Entprellung von niedrig zu hoch" VALUE 0x8004E4C4 Val_Ws16 10000.00 TimeDeb 0.00 10000.00 EXTENDED_LIMITS -327680.0 327670.0 /end CHARACTERISTIC
/begin CHARACTERISTIC Exh_tiLoHiOfsDebNSCDs_C "Kalibrierungsparameter für Offset-Entprellung von niedrig zu hoch" VALUE 0x8004E940 Val_Ws16 10000.00 TimeDeb 0.00 10000.00 EXTENDED_LIMITS -327680.0 327670.0 /end CHARACTERISTIC
/begin CHARACTERISTIC Exh_tiNOxDlyNoCat2Ds_C "Max. Kalibrierungsverzögerung für die NOx-Statusaktualisierung, wenn der Taupunkt erreicht ist" VALUE 0x8004E4C6 Kw_Ws16 200.0000 Time_sec_1 0.00 200.0000 FORMAT "%8.4" EXTENDED_LIMITS -3276.800 3276.700 /end CHARACTERISTIC
/begin CHARACTERISTIC Exh_tiNOxDlyNSCDs_C "Min. Dauer der NOx-Statusaktualisierung" VALUE 0x8004E942 Kw_Ws16 200.0000 Time_s 0.00 200.0000 EXTENDED_LIMITS -327.6800 327.6700 /end CHARACTERISTIC
/begin CHARACTERISTIC Exh_tiNOxR2LTstMaxNoCat2Ds_C "Max. Zeitdauer, in der das NOx-Signal nach einer Umstellung der Betriebsart von fett auf mager gültig sein sollte" VALUE 0x8004E502 Val_Wu16 5000.000 Time_s 0.00 5000.000 EXTENDED_LIMITS 0.00 655.3500 /end CHARACTERISTIC
/begin CHARACTERISTIC Exh_tiNOxR2LTstMaxNSCDs_C "Max. Zeitdauer, in der das NOx-Signal nach einer Umstellung der Betriebsart von fett auf mager gültig sein sollte" VALUE 0x8004E97E Val_Wu16 5000.000 Time_s 0.00 5000.000 EXTENDED_LIMITS 0.00 655.3500 /end CHARACTERISTIC
/begin CHARACTERISTIC Exh_tiO2EvalNoCat2Ds_C "Dauer der Erkennung des O2-Dauerbetriebzustands" VALUE 0x8004E504 Val_Wu16 99.00000 Time_s 1.000000 100.0000 EXTENDED_LIMITS 0.00 655.3500 /end CHARACTERISTIC
/begin CHARACTERISTIC Exh_tiO2EvalNSCDs_C "Dauer der Erkennung des O2-Dauerbetriebzustands" VALUE 0x8004E980 Val_Wu16 99.00000 Time_s 1.000000 100.0000 EXTENDED_LIMITS 0.00 655.3500 /end CHARACTERISTIC
/begin CHARACTERISTIC Exh_tiPT1NoCat2Ds_C "PT1-Filterzeitkonstante für lineares Lambda-Signal" VALUE 0x8004E120 Val_Ws32 42948.672968 TimeDelay_s 0.99999238556 42949.672960 FORMAT "%12.6" EXTENDED_LIMITS 0.000002000000001 4294.9672960 /end CHARACTERISTIC
/begin CHARACTERISTIC Exh_tiPT1NSCDs_C "PT1-Filterzeitkonstante für lineares Lambda-Signal" VALUE 0x8004E59C Val_Ws32 42948.672968 TimeDelay_s 0.99999238556 42949.672960 FORMAT "%12.6" EXTENDED_LIMITS 0.000002000000001 4294.9672960 /end CHARACTERISTIC
/begin CHARACTERISTIC Exh_tiPT1rNOxNoCat2Ds_C "PT1-Filterzeitkonstante für NOx-Sensor" VALUE 0x8004E36C Val_Ws32 42948.672968 TimeDelay_s 0.99999238556 42949.672960 FORMAT "%12.6" EXTENDED_LIMITS 0.000002000000001 4294.9672960 /end CHARACTERISTIC
/begin CHARACTERISTIC Exh_tiPT1rNOxNSCDs_C "PT1-Filterzeitkonstante für NOx-Sensor" VALUE 0x8004E7E8 Val_Ws32 42948.672968 TimeDelay_s 0.99999238556 42949.672960 FORMAT "%12.6" EXTENDED_LIMITS 0.000002000000001 4294.9672960 /end CHARACTERISTIC
/begin CHARACTERISTIC Exh_tMaxNoCat2Ds_C "Schwelle für min. Abgastemperatur zur Freigabe der Heizerdiagnose" VALUE 0x8004E4C8 Kw_Ws16 10000.00 Temp_Cels -0.04000000 9999.960 EXTENDED_LIMITS -3549.940 3003.560 /end CHARACTERISTIC
/begin CHARACTERISTIC Exh_tMaxNSCDs_C "Schwelle für max. Abgastemperatur zur Freigabe der Heizerdiagnose" VALUE 0x8004E944 Kw_Ws16 6553.500 Temp_Cels -3549.940 3003.560 /end CHARACTERISTIC
/begin CHARACTERISTIC Exh_tMinNoCat2Ds_C "Schwelle für min. Abgastemperatur zur Freigabe der Heizerdiagnose" VALUE 0x8004E4CA Kw_Ws16 10000.00 Temp_Cels -0.04000000 9999.960 EXTENDED_LIMITS -3549.940 3003.560 /end CHARACTERISTIC
/begin CHARACTERISTIC Exh_tMinNSCDs_C "Schwelle für min. Abgastemperatur zur Freigabe der Heizerdiagnose" VALUE 0x8004E946 Kw_Ws16 10000.00 Temp_Cels -0.04000000 9999.960 EXTENDED_LIMITS -3549.940 3003.560 /end CHARACTERISTIC
/begin CHARACTERISTIC Exh_uBattMaxNoCat2Ds_C "Max. Batteriespannung" VALUE 0x8004E4CC Kw_Ws16 10000.00 Volt_Batt 0.00 10000.00 EXTENDED_LIMITS -655360.0 655340.0 /end CHARACTERISTIC
/begin CHARACTERISTIC Exh_uBattMaxNSCDs_C "Max. Batteriespannung" VALUE 0x8004E948 Kw_Ws16 10000.00 Volt_Batt 0.00 10000.00 EXTENDED_LIMITS -655360.0 655340.0 /end CHARACTERISTIC
/begin CHARACTERISTIC Exh_uBattMinNoCat2Ds_C "Min. Batteriespannung" VALUE 0x8004E4CE Kw_Ws16 1000.000 Volt_Batt 0.00 1000.000 EXTENDED_LIMITS -655360.0 655340.0 /end CHARACTERISTIC
/begin CHARACTERISTIC Exh_uBattMinNSCDs_C "Min. Batteriespannung" VALUE 0x8004E94A Kw_Ws16 1000.000 Volt_Batt 0.00 1000.000 EXTENDED_LIMITS -655360.0 655340.0 /end CHARACTERISTIC
/begin CHARACTERISTIC Exh_uLamBinMaxNoCat2Ds_C "Max. binärer Lambda-Wert" VALUE 0x8004E4DA Val_Ws16 15100.00 Volt -100.0000 15000.00 EXTENDED_LIMITS -6553.600 6553.400 /end CHARACTERISTIC
/begin CHARACTERISTIC Exh_uLamBinMaxNSCDs_C "Max. binärer Lambda-Wert" VALUE 0x8004E956 Val_Ws16 15100.00 Volt -100.0000 15000.00 EXTENDED_LIMITS -6553.600 6553.400 /end CHARACTERISTIC
/begin CHARACTERISTIC Exh_uLamBinMinNoCat2Ds_C "Min. Spannungsgrenze für das binäre Lambda-Signal" VALUE 0x8004E4DC Val_Ws16 1000.000 Volt 0.00 1000.000 EXTENDED_LIMITS -6553.600 6553.400 /end CHARACTERISTIC
/begin CHARACTERISTIC Exh_uLamBinMinNSCDs_C "Min. binärer Lambda-Wert" VALUE 0x8004E958 Val_Ws16 1000.000 Volt 0.00 1000.000 EXTENDED_LIMITS -6553.600 6553.400 /end CHARACTERISTIC
/begin CHARACTERISTIC Exh_uLamLeanLimNoCat2Ds_C "Spannungs-Schwellengrenze, unterhalb derer Lambda als mager klassifiziert wird" VALUE 0x8004E124 Val_Ws16 1400.000 Volt -200.0000 1200.000 EXTENDED_LIMITS -6553.600 6553.400 /end CHARACTERISTIC
/begin CHARACTERISTIC Exh_uLamLeanLimNSCDs_C "Spannungs-Schwellengrenze, unterhalb derer Lambda als mager klassifiziert wird" VALUE 0x8004E5A0 Val_Ws16 1400.000 Volt -200.0000 1200.000 EXTENDED_LIMITS -6553.600 6553.400 /end CHARACTERISTIC
/begin CHARACTERISTIC KF_DFHRF "Für Berechnung Reibungsfaktor DFH" MAP 0x80064E5C MapTKF_UW_SW_UW 99.99847 Def_f_uw_b100 0.00 99.99847
 /begin AXIS_DESCR STD_AXIS Dfh_nekpfilt Def_n_sw_q1p0 10 -32768. 32767. FORMAT "%5.0" DEPOSIT ABSOLUTE /end AXIS_DESCR
 /begin AXIS_DESCR STD_AXIS Dfh_pinfk Def_lst_uw_q0p1 10 0.00 6553.5 FORMAT "%6.1" DEPOSIT ABSOLUTE /end AXIS_DESCR
/end CHARACTERISTIC
/begin CHARACTERISTIC KF_DFHRFK "Für Skalierfaktor Reibungsfaktor DFH" MAP 0x80064F4E MapTKF_SW_SW_UW 99.99847 Def_f_uw_b100 0.00 99.99847
 /begin AXIS_DESCR STD_AXIS Nkw Def_n_sw_q1p0 10 -32768. 32767. FORMAT "%5.0" DEPOSIT ABSOLUTE /end AXIS_DESCR
 /begin AXIS_DESCR STD_AXIS Mk_soll_omar Def_me_sw_q0p01 10 -327.6800 327.6700 FORMAT "%8.4" DEPOSIT ABSOLUTE /end AXIS_DESCR
/end CHARACTERISTIC
/begin CHARACTERISTIC KF_DFHRFMAX "Für Berechnung max Reibungsfaktor DFH" MAP 0x80065040 MapTKF_UW_SW_UW 99.99847 Def_f_uw_b100 0.00 99.99847
 /begin AXIS_DESCR STD_AXIS Dfh_nekpfilt Def_n_sw_q1p0 10 -32768. 32767. FORMAT "%5.0" DEPOSIT ABSOLUTE /end AXIS_DESCR
 /begin AXIS_DESCR STD_AXIS Dfh_pinfk Def_lst_uw_q0p1 10 0.00 6553.5 FORMAT "%6.1" DEPOSIT ABSOLUTE /end AXIS_DESCR
/end CHARACTERISTIC
/begin CHARACTERISTIC KF_DFHRFMAXK "Für Skalierfaktor max Reibungsfaktor DFH" MAP 0x80065132 MapTKF_SW_SW_UW 99.99847 Def_f_uw_b100 0.00 99.99847
 /begin AXIS_DESCR STD_AXIS Nkw Def_n_sw_q1p0 8 -32768. 32767. FORMAT "%5.0" DEPOSIT ABSOLUTE /end AXIS_DESCR
 /begin AXIS_DESCR STD_AXIS Mk_soll_omar Def_me_sw_q0p01 8 -327.6800 327.6700 FORMAT "%8.4" DEPOSIT ABSOLUTE /end AXIS_DESCR
/end CHARACTERISTIC
/begin CHARACTERISTIC KF_DFHTHRES "Für Korrektur DFH-Eingangswert-Check" MAP 0x800651D4 MapTKF_SW_SW_UW 6553.5 Def_lst_uw_q0p1 0.00 6553.5 FORMAT "%6.1"
 /begin AXIS_DESCR STD_AXIS Nkw Def_n_sw_q1p0 6 -32768. 32767. FORMAT "%5.0" DEPOSIT ABSOLUTE /end AXIS_DESCR
 /begin AXIS_DESCR STD_AXIS Mk_soll_omar Def_me_sw_q0p01 6 -327.6800 327.6700 FORMAT "%8.4" DEPOSIT ABSOLUTE /end AXIS_DESCR
/end CHARACTERISTIC
/begin CHARACTERISTIC KF_DFHUDELTA "Kennfeld für Batteriespannung in Statemachine DFH" MAP 0x80065236 MapTKF_SW_UW_UW 6553.500 Def_u_uw_q0p1 0.00 6553.500 FORMAT "%8.3"
 /begin AXIS_DESCR STD_AXIS Ub Def_u_uw_q0p0942 6 0.00 6173.4 FORMAT "%6.1" DEPOSIT ABSOLUTE /end AXIS_DESCR
 /begin AXIS_DESCR STD_AXIS Tkst Def_t_sw_q0p01 6 -327.680 327.670 FORMAT "%7.3" DEPOSIT ABSOLUTE /end AXIS_DESCR
/end CHARACTERISTIC
/begin CHARACTERISTIC KF_NDRBAS "Basis Niederdruck-Regelung" MAP 0x80065298 MapTKF_SW_SW_UW 65.53500 Def_p_uw_q0p001 0.00 65.53500 FORMAT "%8.5"
 /begin AXIS_DESCR STD_AXIS Nkw Def_n_sw_q1p0 8 -32768. 32767. FORMAT "%5.0" DEPOSIT ABSOLUTE /end AXIS_DESCR
 /begin AXIS_DESCR STD_AXIS Mk_soll_omar Def_me_sw_q0p01 8 -327.6800 327.6700 FORMAT "%8.4" DEPOSIT ABSOLUTE /end AXIS_DESCR
/end CHARACTERISTIC
/begin CHARACTERISTIC KF_NDRPEKPMAX "Kennfeld für Diagnose Teil1 NDRM" MAP 0x8006533A MapTKF_SW_UW_UW 6553.5 Def_lst_uw_q0p1 0.00 6553.5 FORMAT "%6.1"
 /begin AXIS_DESCR STD_AXIS Phdp Def_p_uw_q0p001 4 0.00 65.53500 FORMAT "%8.5" DEPOSIT ABSOLUTE /end AXIS_DESCR
 /begin AXIS_DESCR STD_AXIS Tkst Def_t_sw_q0p01 2 -327.680 327.670 FORMAT "%7.3" DEPOSIT ABSOLUTE /end AXIS_DESCR
/end CHARACTERISTIC
/begin CHARACTERISTIC KF_NDRPEKPMAXDFHON "Kennfeld für Diagnose Teil1 NDRM" MAP 0x80065358 MapTKF_SW_UW_UW 6553.5 Def_lst_uw_q0p1 0.00 6553.5 FORMAT "%6.1"
 /begin AXIS_DESCR STD_AXIS Phdp Def_p_uw_q0p001 4 0.00 65.53500 FORMAT "%8.5" DEPOSIT ABSOLUTE /end AXIS_DESCR
 /begin AXIS_DESCR STD_AXIS Tkst Def_t_sw_q0p01 2 -327.680 327.670 FORMAT "%7.3" DEPOSIT ABSOLUTE /end AXIS_DESCR
/end CHARACTERISTIC
/begin CHARACTERISTIC KL_NDRDELTAMAX "Kennlinie für maximales Delta von gelernter und aktueller Leistung DFH" CURVE 0x80065376 CurTKL_SW_VV_SW 655.350 Def_lst_sw_q0p01 -327.680 327.670 FORMAT "%7.3"
 /begin AXIS_DESCR STD_AXIS Tkst Def_t_sw_q0p01 6 -327.680 327.670 FORMAT "%7.3" DEPOSIT ABSOLUTE /end AXIS_DESCR
/end CHARACTERISTIC
/begin CHARACTERISTIC KL_NDRDT1 "Kennlinie zur Berechnung der Konstante des DT1-Gliedes" CURVE 0x80065390 CurTKL_SW_VV_UW 655.35000 Def_rf_uw_q0p01 0.00 655.35000 FORMAT "%9.5"
 /begin AXIS_DESCR STD_AXIS Ndr_delta Def_p_sw_q0p001 8 -32.76800 32.76700 FORMAT "%8.5" DEPOSIT ABSOLUTE /end AXIS_DESCR
/end CHARACTERISTIC
/begin CHARACTERISTIC KL_NDRINT "Faktor für den Integrator-Anteil Niederdruckregelung" CURVE 0x800653B2 CurTKL_SW_VV_UW 655.35000 Def_rf_uw_q0p01 0.00 655.35000 FORMAT "%9.5"
 /begin AXIS_DESCR STD_AXIS Ndr_delta Def_p_sw_q0p001 6 -32.76800 32.76700 FORMAT "%8.5" DEPOSIT ABSOLUTE /end AXIS_DESCR
/end CHARACTERISTIC
/begin CHARACTERISTIC KL_NDRPROP "Faktor für den Proportionalanteil Niederdruck-Regelung" CURVE 0x800653CC CurTKL_SW_VV_UW 655.35000 Def_rf_uw_q0p01 0.00 655.35000 FORMAT "%9.5"
 /begin AXIS_DESCR STD_AXIS Ndr_delta Def_p_sw_q0p001 6 -32.76800 32.76700 FORMAT "%8.5" DEPOSIT ABSOLUTE /end AXIS_DESCR
/end CHARACTERISTIC
/begin CHARACTERISTIC KL_NDRTKST "Kennlinie zur Berücksichtigung der Kraftstofftemperatur für Sollwertberechnung des Drucks im Nierderdruckkreislauf" CURVE 0x800653E6 CurTKL_SW_VV_UW 2.5500000 Def_rf_uw_q0p0001 0.00 2.5500000 EXTENDED_LIMITS 0.00 6.5535000
 /begin AXIS_DESCR STD_AXIS Tkst Def_t_sw_q0p01 8 -327.680 327.670 FORMAT "%7.3" DEPOSIT ABSOLUTE /end AXIS_DESCR
/end CHARACTERISTIC
/begin CHARACTERISTIC KL_NDR_A_ABS "Kennlinie zur Berücksichtigung der abs. Querbeschleunigung für Sollwertberechnung des Drucks im Nierderdruckkreislauf" CURVE 0x80065408 CurTKL_SW_VV_UW 2.5500000 Def_rf_uw_q0p0001 0.00 2.5500000 EXTENDED_LIMITS 0.00 6.5535000
 /begin AXIS_DESCR STD_AXIS A_quer_abs Def_a_sw_b64 8 -64.0000 63.9980 FORMAT "%7.4" DEPOSIT ABSOLUTE /end AXIS_DESCR
/end CHARACTERISTIC
/begin CHARACTERISTIC K_CW_OZ_2 "Codeword OZ - 2" VALUE 0x800654D2 Val_Wu16 65535. Def_dez_uw_q1 0.00 65535. FORMAT "%5.0" /end CHARACTERISTIC
/begin CHARACTERISTIC K_DFHCHECK "Konstante zur Überprüfung von Dfh_def" VALUE 0x8006542A Val_Wu8 255. Def_f_ub_q1 0.00 255. FORMAT "%3.0" /end CHARACTERISTIC
/begin CHARACTERISTIC K_DFHCNTMAX "Max Zahl für die Lernfunktion Dieselfilter-Heitzung" VALUE 0x8006542C Val_Wu16 65535. Def_dez_uw_q1 0.00 65535. FORMAT "%5.0" /end CHARACTERISTIC
/begin CHARACTERISTIC K_DFHDANZMAX "Max Anzahl DFH an für Diagnose" VALUE 0x8006542E Val_Wu16 65535. Def_dez_uw_q1 0.00 65535. FORMAT "%5.0" /end CHARACTERISTIC
/begin CHARACTERISTIC K_DFHINIT "Power Initialwert (nach Flashen) für die Lernfunktion Dieselfilter-Heitzung" VALUE 0x80065430 Val_Wu16 6553.5 Def_lst_uw_q0p1 0.00 6553.5 FORMAT "%6.1" /end CHARACTERISTIC
/begin CHARACTERISTIC K_DFHKFDP "Filterkonstant für delta Druck DFH" VALUE 0x80065432 Val_Wu16 99.99847 Def_f_uw_b100 0.00 99.99847 /end CHARACTERISTIC
/begin CHARACTERISTIC K_DFHKFPEKP "Filterkonstant für Pumpenleistung DFH" VALUE 0x80065434 Val_Wu16 99.99847 Def_f_uw_b100 0.00 99.99847 /end CHARACTERISTIC
/begin CHARACTERISTIC K_DFHKFPW "Filterkonstante für Kraftstoffpumpenleistung-Berechnung" VALUE 0x80065436 Val_Wu16 99.99847 Def_f_uw_b100 0.00 99.99847 /end CHARACTERISTIC
/begin CHARACTERISTIC K_DFHLERNCNTMIN "minimaler Zählerstand Lernfunktion DFH" VALUE 0x80065438 Val_Wu8 255. Def_dez_ub_q1 0.00 255. FORMAT "%3.0" /end CHARACTERISTIC
/begin CHARACTERISTIC K_DFHLLVERZ "Verzögerung für die Lernfunktion Dieselfilter-Heitzung" VALUE 0x8006543A Val_Wu16 1310.70 Def_td_uw_q0p02 0.00 1310.70 FORMAT "%7.2" /end CHARACTERISTIC
/begin CHARACTERISTIC K_DFHLRHEAT "Konstante für Statemachine DFH" VALUE 0x8006543C Val_Wu8 25.5 Def_td_ub_q0p1 0.00 25.5 FORMAT "%4.1" /end CHARACTERISTIC
/begin CHARACTERISTIC K_DFHLTMIN "Mindest Kraftstoff-Temperatur für die Lernfunktion Dieselfilter-Heitzung" VALUE 0x8006543E Val_Ws16 655.350 Def_t_sw_q0p01 -327.680 327.670 FORMAT "%7.3" /end CHARACTERISTIC
/begin CHARACTERISTIC K_DFHLTRIG "Umschaltzeit auf den max. Vorförderdruck NDR während des Lernens" VALUE 0x80065440 Val_Wu16 1310.70 Def_td_uw_q0p02 0.00 1310.70 FORMAT "%7.2" /end CHARACTERISTIC
/begin CHARACTERISTIC K_DFHLVERZ "Verzögerung für das Zählen Lernfunktion Dieselfilter-Heitzung" VALUE 0x80065442 Val_Wu16 1310.70 Def_td_uw_q0p02 0.00 1310.70 FORMAT "%7.2" /end CHARACTERISTIC
/begin CHARACTERISTIC K_DFHMAXANZ "Max Heufigkeit Einschaltung DFH" VALUE 0x80065444 Val_Wu16 65535. Def_dez_uw_q1 0.00 65535. FORMAT "%5.0" /end CHARACTERISTIC
/begin CHARACTERISTIC K_DFHMINKM "Mindest Kilometerstand für die Lernfunktion Dieselfilter-Heitzung" VALUE 0x80065448 Val_Wu32 4294967295. Def_dez_ul_q1 0.00 4294967295. FORMAT "%7.0" /end CHARACTERISTIC
/begin CHARACTERISTIC K_DFHMKD "Delta für Stabilitätskontrolle Mk_soll_omar" VALUE 0x8006544C Val_Ws16 655.3500 Def_me_sw_q0p01 -327.6800 327.6700 FORMAT "%8.4" /end CHARACTERISTIC
/begin CHARACTERISTIC K_DFHNKWD "Delta für Stabilitätskontrolle Nkw" VALUE 0x8006544E Val_Ws16 65535. Def_n_sw_q1p0 -32768. 32767. FORMAT "%5.0" /end CHARACTERISTIC
/begin CHARACTERISTIC K_DFHNMAXDIAG "MAximale Drehzahl für Statemachine DFH Diagnose" VALUE 0x80065450 Val_Ws16 65535. Def_n_sw_q1p0 -32768. 32767. FORMAT "%5.0" /end CHARACTERISTIC
/begin CHARACTERISTIC K_DFHNOFFO "Drehzahl-Offset nach oben für die Lernfunktion Dieselfilter-Heitzung" VALUE 0x80065452 Val_Ws16 65535. Def_n_sw_q1p0 -32768. 32767. FORMAT "%5.0" /end CHARACTERISTIC
/begin CHARACTERISTIC K_DFHNOFFU "Drehzahl-Offset nach unten für die Lernfunktion Dieselfilter-Heitzung" VALUE 0x80065454 Val_Ws16 65535. Def_n_sw_q1p0 -32768. 32767. FORMAT "%5.0" /end CHARACTERISTIC
/begin CHARACTERISTIC K_DFHQMAX "Maximale Einspritzmenge für Lernfunktion Dieselfilterheitzung" VALUE 0x80065456 Val_Ws16 655.3500 Def_me_sw_q0p01 -327.6800 327.6700 FORMAT "%8.4" /end CHARACTERISTIC
/begin CHARACTERISTIC K_DFHSTATECNTMAX "maximaler counter für Statemachine DFH" VALUE 0x80065458 Val_Wu16 65535. Def_f_uw_q1 0.00 65535. FORMAT "%5.0" /end CHARACTERISTIC
/begin CHARACTERISTIC K_DFHSW "Switch für Eingang DFH" VALUE 0x8006545A Val_Wu8 255. Def_dez_ub_q1 0.00 255. FORMAT "%3.0" /end CHARACTERISTIC
/begin CHARACTERISTIC K_DFHTCHECK "Konstante für Statemachine DFH" VALUE 0x8006545C Val_Wu16 65535. Def_f_uw_q1 0.00 65535. FORMAT "%5.0" /end CHARACTERISTIC
/begin CHARACTERISTIC K_DFHTKSTF "Ersatzwert Tkst im Fehlerfall" VALUE 0x8006545E Val_Ws16 655.350 Def_t_sw_q0p01 -327.680 327.670 FORMAT "%7.3" /end CHARACTERISTIC
/begin CHARACTERISTIC K_DFHTMAXOFFL "Max Kraftstofftemperatur fürs Ausschalten der Dieselfilter-Heitzung (untere Schwelle)" VALUE 0x80065460 Val_Ws16 655.350 Def_t_sw_q0p01 -327.680 327.670 FORMAT "%7.3" /end CHARACTERISTIC
/begin CHARACTERISTIC K_DFHTMAXOFFR "Max Kraftstofftemperatur fürs Ausschalten der Dieselfilter-Heitzung (obere Schwelle)" VALUE 0x80065462 Val_Ws16 655.350 Def_t_sw_q0p01 -327.680 327.670 FORMAT "%7.3" /end CHARACTERISTIC
/begin CHARACTERISTIC K_DFHTMAXONL "Maxt Kraftstofftemperatur fürs Einschalten der Dieselfilter-Heitzung (unterer Hysteresewert)" VALUE 0x80065464 Val_Ws16 655.350 Def_t_sw_q0p01 -327.680 327.670 FORMAT "%7.3" /end CHARACTERISTIC
/begin CHARACTERISTIC K_DFHTMAXONR "Maxt Kraftstofftemperatur fürs Einschalten der Dieselfilter-Heitzung (oberer Hysteresewert)" VALUE 0x80065466 Val_Ws16 655.350 Def_t_sw_q0p01 -327.680 327.670 FORMAT "%7.3" /end CHARACTERISTIC
/begin CHARACTERISTIC K_DFHTONMAX "Max Einschaltzeit DFH" VALUE 0x80065468 Val_Wu16 1310.70 Def_td_uw_q0p02 0.00 1310.70 FORMAT "%7.2" /end CHARACTERISTIC
/begin CHARACTERISTIC K_DFHTWAIT "Konstante Zeit für TimerRetrigger in der Statemachine DFH" VALUE 0x8006546A Val_Wu16 1310.70 Def_td_uw_q0p02 0.00 1310.70 FORMAT "%7.2" /end CHARACTERISTIC
/begin CHARACTERISTIC K_DFHUB "Spannungswelle fürs Ein/Ausschalten der Dieselfilter-Heitzung" VALUE 0x8006546C Val_Wu16 6173.4 Def_u_uw_q0p0942 0.00 6173.4 FORMAT "%6.1" /end CHARACTERISTIC
/begin CHARACTERISTIC K_DFHVERST "Verzögerung für Stabilitätskontrolle Nkw und Mk_soll_omar für die CBS Berechnung" VALUE 0x8006546E Val_Wu16 1310.70 Def_td_uw_q0p02 0.00 1310.70 FORMAT "%7.2" /end CHARACTERISTIC
/begin CHARACTERISTIC K_DFHVERZOFF "Verzögerung für das Ausschalten der Dieselfilter-Heitzung" VALUE 0x80065470 Val_Wu16 1310.70 Def_td_uw_q0p02 0.00 1310.70 FORMAT "%7.2" /end CHARACTERISTIC
/begin CHARACTERISTIC K_DFHVERZON "Verzögerung für das Einschalten der Dieselfilter-Heitzung" VALUE 0x80065472 Val_Wu16 1310.70 Def_td_uw_q0p02 0.00 1310.70 FORMAT "%7.2" /end CHARACTERISTIC
/begin CHARACTERISTIC K_DFHVERZUB "Konstante zur Verögerung des Reset der DFH bei Batteriespannungseinbruch" VALUE 0x80065474 Val_Wu16 1310.70 Def_td_uw_q0p02 0.00 1310.70 FORMAT "%7.2" /end CHARACTERISTIC
/begin CHARACTERISTIC K_DFHVOLTANKMIN "Minimale Tankfüllung für Dieselfilterheizung" VALUE 0x80065476 Val_Wu8 25.5 Def_vol_ub_q0p1 0.00 25.5 FORMAT "%4.1" /end CHARACTERISTIC
/begin CHARACTERISTIC K_FSPNEKPFILTMIN "Minimale Drehzahl EKP (gefiltert)" VALUE 0x80065478 Val_Ws16 65535. Def_n_sw_q1p0 -32768. 32767. FORMAT "%5.0" /end CHARACTERISTIC
/begin CHARACTERISTIC K_FSPTKSTMIN "Minimale Kraftstofftemperatur für Diagnose Teil 2" VALUE 0x8006547A Val_Ws16 655.350 Def_t_sw_q0p01 -327.680 327.670 FORMAT "%7.3" /end CHARACTERISTIC
/begin CHARACTERISTIC K_FSPTMOTMIN "Minimale Motortemperatur zur Diagnose Dfh (Statemachine)" VALUE 0x8006547C Val_Ws16 655.350 Def_t_sw_q0p01 -327.680 327.670 FORMAT "%7.3" /end CHARACTERISTIC
/begin CHARACTERISTIC K_FSPUBMIN "Minimale Batteriespannung für Diagnose 2" VALUE 0x8006547E Val_Wu8 25.50 Def_u_ub_q0p1 0.00 25.50 FORMAT "%5.2" /end CHARACTERISTIC
/begin CHARACTERISTIC K_FSPUEKPMIN "Minimale Spannung EKP" VALUE 0x8006547F Val_Wu8 25.50 Def_u_ub_q0p1 0.00 25.50 FORMAT "%5.2" /end CHARACTERISTIC
/begin CHARACTERISTIC K_FSPVERZON "Verzögerung für das aktivieren der Diagnose Teil 2 (Ndr_out)" VALUE 0x80065480 Val_Wu16 1310.70 Def_td_uw_q0p02 0.00 1310.70 FORMAT "%7.2" /end CHARACTERISTIC
/begin CHARACTERISTIC K_MINDIVDT1 "Konstante für Division in der DT1 - Vorsteuerung" VALUE 0x80065482 Val_Wu8 1.7891 Def_f_ub_b2 0.20313 1.9922 EXTENDED_LIMITS 0.00 1.9922 /end CHARACTERISTIC
/begin CHARACTERISTIC K_MSAAAMASKE "s" VALUE 0x80064E04 Val_Wu16 65535. Def_dez_uw_q1 0.00 65535. FORMAT "%5.0" /end CHARACTERISTIC
/begin CHARACTERISTIC K_MSAAVMASKE "s" VALUE 0x80064E08 Val_Wu32 4294967295. Def_dez_ul_q1 0.00 4294967295. FORMAT "%7.0" /end CHARACTERISTIC
/begin CHARACTERISTIC K_MSAAVRSM "Maske für die Belegung des AV-Ringspeicher" VALUE 0x80064E0C Val_Wu32 4294967295. Def_dez_ul_q1 0.00 4294967295. FORMAT "%7.0" /end CHARACTERISTIC
/begin CHARACTERISTIC K_MSAAVSW "Maske für Abschaltung AVs über Diagnose MSA" VALUE 0x80064E10 Val_Wu32 4294967295. Def_dez_ul_q1 0.00 4294967295. FORMAT "%7.0" /end CHARACTERISTIC
/begin CHARACTERISTIC K_MSABRAV "Bremsenunterdruck Schwelle für AV" VALUE 0x80064E14 Val_Wu16 65535. Def_p_uw_q1 0.00 65535. FORMAT "%6.0" /end CHARACTERISTIC
/begin CHARACTERISTIC K_MSABSMASKE "Maske für die aktivierung der Funktionsabschalter" VALUE 0x80064E38 Val_Wu32 4294967295. Def_dez_ul_q1 0.00 4294967295. FORMAT "%7.0" /end CHARACTERISTIC
/begin CHARACTERISTIC K_MSACCMASKE "Maske für die CC-Meldung nach Funktionsabschalter" VALUE 0x80064E3C Val_Wu32 4294967295. Def_dez_ul_q1 0.00 4294967295. FORMAT "%7.0" /end CHARACTERISTIC
/begin CHARACTERISTIC K_MSADPFREG "Kontrolle auf Regeneration Dieselpartikelfilter" VALUE 0x80064E18 Val_Wu32 4294967295. Def_dez_ul_q1 0.00 4294967295. FORMAT "%7.0" /end CHARACTERISTIC
/begin CHARACTERISTIC K_MSADVKS "Geschwindigkeitsdelta für die Erkennung Kraftschluss" VALUE 0x80064E40 Val_Wu16 65535. Def_v_uw_q1p0 0.00 65535. FORMAT "%5.0" /end CHARACTERISTIC
/begin CHARACTERISTIC K_MSAEVMASKE "s" VALUE 0x80064E48 Val_Wu16 65535. Def_dez_uw_q1 0.00 65535. FORMAT "%5.0" /end CHARACTERISTIC
/begin CHARACTERISTIC K_MSAFAKF "Konstante Aktivkohlefilterschwelle für MSA" VALUE 0x80064E1C Val_Ws16 199.9969 Def_f_sw_b100 -100.0000 99.99695 FORMAT "%8.4" /end CHARACTERISTIC
/begin CHARACTERISTIC K_MSALENK "Lenkunggeschwindigkeit Schwelle für AV" VALUE 0x80064E1E Val_Ws16 6553.50 Def_wdk_sw_q0p1 -3276.80 3276.70 FORMAT "%7.2" /end CHARACTERISTIC
/begin CHARACTERISTIC K_MSAMANTD "Konstante Verzögerungsszeit für MSA-Start nach Motor aus" VALUE 0x80064E4A Val_Wu16 655.350 Def_td_uw_q0p01 0.00 655.350 FORMAT "%7.3" /end CHARACTERISTIC
/begin CHARACTERISTIC K_MSAMINMLZ "Min. MSA-Motorlauf-Zeit für MSA-Stopp" VALUE 0x80064E20 Val_Wu8 25.5 Def_td_ub_q0p1 0.00 25.5 FORMAT "%4.1" /end CHARACTERISTIC
/begin CHARACTERISTIC K_MSANKS "Drehzahlschwelle für dei Kraftschlusserkennung" VALUE 0x80064E42 Val_Ws16 65535. Def_n_sw_q1p0 -32768. 32767. FORMAT "%5.0" /end CHARACTERISTIC
/begin CHARACTERISTIC K_MSANKWMAX "Drehzahlschwelle für AV" VALUE 0x80064E22 Val_Ws16 65535. Def_n_sw_q1p0 -32768. 32767. FORMAT "%5.0" /end CHARACTERISTIC
/begin CHARACTERISTIC K_MSANST "Drehzahlschwelle über der, der Startvorgang auch ohne EAs weiter läuft" VALUE 0x80064E44 Val_Ws16 65535. Def_n_sw_q1p0 -32768. 32767. FORMAT "%5.0" /end CHARACTERISTIC
/begin CHARACTERISTIC K_MSANSTTOV "Drehzahlschwelle für Startabbruch bei Versatz zwischen SW- und HW-Signal" VALUE 0x80064E4C Val_Ws16 65535. Def_n_sw_q1p0 -32768. 32767. FORMAT "%5.0" /end CHARACTERISTIC
/begin CHARACTERISTIC K_MSAPBREMSU "Konstante Bremsunterdruckschwelle für MSA" VALUE 0x80064E4E Val_Wu16 65535. Def_p_uw_q1 0.00 65535. FORMAT "%6.0" /end CHARACTERISTIC
/begin CHARACTERISTIC K_MSAPWGA "Konstante PWG-Schwelle für MSA-Stopp" VALUE 0x80064E24 Val_Ws16 1599.98 Def_wdk_sw_q0p0244 -800.000 799.976 FORMAT "%7.3" /end CHARACTERISTIC
/begin CHARACTERISTIC K_MSAPWGE "Konstante PWG-Schwelle für MSA-Start" VALUE 0x80064E50 Val_Ws16 1599.98 Def_wdk_sw_q0p0244 -800.000 799.976 FORMAT "%7.3" /end CHARACTERISTIC
/begin CHARACTERISTIC K_MSASTTO "Timeout für den Startversuch" VALUE 0x80064E52 Val_Wu16 655.350 Def_td_uw_q0p01 0.00 655.350 FORMAT "%7.3" /end CHARACTERISTIC
/begin CHARACTERISTIC K_MSASTTOV "Timeout für den Startversuch bei Versatz zwischen SW- und HW-Signal" VALUE 0x80064E54 Val_Wu16 655.350 Def_td_uw_q0p01 0.00 655.350 FORMAT "%7.3" /end CHARACTERISTIC
/begin CHARACTERISTIC K_MSATANK "Tankschwelle für AV" VALUE 0x80064E26 Val_Wu16 6553.500 Def_vol_uw_q0p1 0.00 6553.500 FORMAT "%8.3" /end CHARACTERISTIC
/begin CHARACTERISTIC K_MSATKAT "Konstante Katalysatortemperaturschwelle für MSA" VALUE 0x80064E28 Val_Ws16 6553.5 Def_t_sw_q0p1 -3276.8 3276.7 FORMAT "%6.1" /end CHARACTERISTIC
/begin CHARACTERISTIC K_MSATMOT "Konstante Motortemperaturschwelle für MSA" VALUE 0x80064E2A Val_Ws16 655.350 Def_t_sw_q0p01 -327.680 327.670 FORMAT "%7.3" /end CHARACTERISTIC
/begin CHARACTERISTIC K_MSATUMGO "Höchste Umgebungstemperatur (AV)" VALUE 0x80064E2C Val_Ws16 6553.5 Def_t_sw_q0p1 -3276.8 3276.7 FORMAT "%6.1" /end CHARACTERISTIC
/begin CHARACTERISTIC K_MSATUMGU "Mindest Umgebungstemperatur (AV)" VALUE 0x80064E2E Val_Ws16 6553.5 Def_t_sw_q0p1 -3276.8 3276.7 FORMAT "%6.1" /end CHARACTERISTIC
/begin CHARACTERISTIC K_MSAVA "Konstante für Erkennung Fahrzeug steht" VALUE 0x80064E30 Val_Wu16 65535. Def_v_uw_q1p0 0.00 65535. FORMAT "%5.0" /end CHARACTERISTIC
/begin CHARACTERISTIC K_MSAVE "Konstante für Erkennung Fahrzeug rollt" VALUE 0x80064E56 Val_Wu16 65535. Def_v_uw_q1p0 0.00 65535. FORMAT "%5.0" /end CHARACTERISTIC
/begin CHARACTERISTIC K_MSAVERLENK "Verlängerung Lenkgeschwindigkeit-AV" VALUE 0x80064E32 Val_Wu8 25.5 Def_td_ub_q0p1 0.00 25.5 FORMAT "%4.1" /end CHARACTERISTIC
/begin CHARACTERISTIC K_MSAVFTMH "Mindestgeschwindigkeit für Rücksetzung Motorhaube- und Fahrertür-AV" VALUE 0x80064E34 Val_Wu16 65535. Def_v_uw_q1p0 0.00 65535. FORMAT "%5.0" /end CHARACTERISTIC
/begin CHARACTERISTIC K_MSAVOK "Konstante Mindestgeschwindigkeit für MSA" VALUE 0x80064E36 Val_Wu16 65535. Def_v_uw_q1p0 0.00 65535. FORMAT "%5.0" /end CHARACTERISTIC
/begin CHARACTERISTIC K_NDRDELTAMAXDFHON "Maximal zulaessiger Unterschied zwischen Dfh_pinfk und Dfh_lernpw" VALUE 0x80065484 Val_Ws16 655.350 Def_lst_sw_q0p01 -327.680 327.670 FORMAT "%7.3" /end CHARACTERISTIC
/begin CHARACTERISTIC K_NDRDIAGVERZ "Verzögerung für das aktivieren der Diagnose Teil 1" VALUE 0x80065486 Val_Wu16 1310.70 Def_td_uw_q0p02 0.00 1310.70 FORMAT "%7.2" /end CHARACTERISTIC
/begin CHARACTERISTIC K_NDRDT1MAX "Max Wert für den DT1-Ausgang" VALUE 0x80065488 Val_Ws16 655.35000 Def_rf_sw_q0p01 -327.68000 327.67000 FORMAT "%9.5" /end CHARACTERISTIC
/begin CHARACTERISTIC K_NDRDT1MIN "Min Wert für den DT1-Ausgang" VALUE 0x8006548A Val_Ws16 655.35000 Def_rf_sw_q0p01 -327.68000 327.67000 FORMAT "%9.5" /end CHARACTERISTIC
/begin CHARACTERISTIC K_NDRDT1T "Zeitkonstante des DT1 Regelgliedes" VALUE 0x8006548C Val_Wu16 655.35000 Def_rf_uw_q0p01 0.00 655.35000 FORMAT "%9.5" /end CHARACTERISTIC
/begin CHARACTERISTIC K_NDRFMASK_1 "Maske 1 für Fehlerkontrolle Anschaltung NDR" VALUE 0x8006548E Val_Wu16 65535. Def_dez_uw_q1 0.00 65535. FORMAT "%5.0" /end CHARACTERISTIC
/begin CHARACTERISTIC K_NDRFMASK_2 "Maske 2 für Fehlerkontrolle Anschaltung NDR" VALUE 0x80065490 Val_Wu16 65535. Def_dez_uw_q1 0.00 65535. FORMAT "%5.0" /end CHARACTERISTIC
/begin CHARACTERISTIC K_NDRFMCC_1 "Maske 1 Fehlerkontrolle NDR für CC-Meldung" VALUE 0x80065492 Val_Wu16 65535. Def_dez_uw_q1 0.00 65535. FORMAT "%5.0" /end CHARACTERISTIC
/begin CHARACTERISTIC K_NDRFMCC_2 "Maske 2 Fehlerkontrolle NDR für CC-Meldung" VALUE 0x80065494 Val_Wu16 65535. Def_dez_uw_q1 0.00 65535. FORMAT "%5.0" /end CHARACTERISTIC
/begin CHARACTERISTIC K_NDRINTINI "Initialisierungswert des Integrators in der Niederdruckregelung" VALUE 0x80065496 Val_Ws16 655.35000 Def_rf_sw_q0p01 -327.68000 327.67000 FORMAT "%9.5" /end CHARACTERISTIC
/begin CHARACTERISTIC K_NDRMAX "Obere Begrenzung Ausgang Niederdruck-Regelung" VALUE 0x80065498 Val_Ws16 655.35000 Def_rf_sw_q0p01 -327.68000 327.67000 FORMAT "%9.5" /end CHARACTERISTIC
/begin CHARACTERISTIC K_NDRMIN "Untere Begrenzung Ausgang Niederdruck-Regelung" VALUE 0x8006549A Val_Ws16 655.35000 Def_rf_sw_q0p01 -327.68000 327.67000 FORMAT "%9.5" /end CHARACTERISTIC
/begin CHARACTERISTIC K_NDRMNRA "Max negative Regelabweichung für Fehler NDR" VALUE 0x8006549C Val_Ws16 65.53500 Def_p_sw_q0p001 -32.76800 32.76700 FORMAT "%8.5" /end CHARACTERISTIC
/begin CHARACTERISTIC K_NDRMNRADFHON "Max negative Regelabweichung für Fehler NDR DFH on" VALUE 0x8006549E Val_Ws16 65.53500 Def_p_sw_q0p001 -32.76800 32.76700 FORMAT "%8.5" /end CHARACTERISTIC
/begin CHARACTERISTIC K_NDRMPRA "Max positive Regelabweichung für Fehler NDR" VALUE 0x800654A0 Val_Ws16 65.53500 Def_p_sw_q0p001 -32.76800 32.76700 FORMAT "%8.5" /end CHARACTERISTIC
/begin CHARACTERISTIC K_NDRMPRADFHON "Max positive Regelabweichung für Fehler NDR DFH on" VALUE 0x800654A2 Val_Ws16 65.53500 Def_p_sw_q0p001 -32.76800 32.76700 FORMAT "%8.5" /end CHARACTERISTIC
/begin CHARACTERISTIC K_NDRNMIN "Mindestdrehzahl für die Regelung" VALUE 0x800654A4 Val_Ws16 65535. Def_n_sw_q1p0 -32768. 32767. FORMAT "%5.0" /end CHARACTERISTIC
/begin CHARACTERISTIC K_NDROFF "Zum Abschalten NDR" VALUE 0x800654A6 Val_Wu8 255. Def_dez_ub_q1 0.00 255. FORMAT "%3.0" /end CHARACTERISTIC
/begin CHARACTERISTIC K_NDROUTDEF "Applizierbarer Wert für Ndr_out falls DFH über B_ndroff abgeschaltet wird" VALUE 0x800654A8 Val_Wu16 655.35000 Def_rf_uw_q0p01 0.00 655.35000 FORMAT "%9.5" /end CHARACTERISTIC
/begin CHARACTERISTIC K_NDROUTMIN "Konstante für Diagnose Teil 2 (Ndr_out)" VALUE 0x800654AA Val_Ws16 655.35000 Def_rf_sw_q0p01 -327.68000 327.67000 FORMAT "%9.5" /end CHARACTERISTIC
/begin CHARACTERISTIC K_NDRPHDPMAX "Max Sollwert NDR in der DFH-Lernphase" VALUE 0x800654AC Val_Wu16 65.53500 Def_p_uw_q0p001 0.00 65.53500 FORMAT "%8.5" /end CHARACTERISTIC
/begin CHARACTERISTIC K_NDRPSOLLMAX "Maximaler Wert für den Solldruck" VALUE 0x800654AE Val_Wu16 65.53500 Def_p_uw_q0p001 0.00 65.53500 FORMAT "%8.5" /end CHARACTERISTIC
/begin CHARACTERISTIC K_NDRREGDIAGTON "Verzögerungszeit ab B_startende für Regelung und Diagnose" VALUE 0x800654B0 Val_Wu16 1310.70 Def_td_uw_q0p02 0.00 1310.70 FORMAT "%7.2" /end CHARACTERISTIC
/begin CHARACTERISTIC K_NDRSTARTOUT "Applizierbarer Wert für Ndr_out während des Starts" VALUE 0x800654B2 Val_Wu16 655.35000 Def_rf_uw_q0p01 0.00 655.35000 FORMAT "%9.5" /end CHARACTERISTIC
/begin CHARACTERISTIC K_NGMAXLERN "Obere Signalgrenze fürs Nullgangposition-Lernen" VALUE 0x800654BC Val_Wu16 655.350 Def_tv_uw_q0p01 0.00 655.350 FORMAT "%7.3" /end CHARACTERISTIC
/begin CHARACTERISTIC K_NGMINLERN "Untere Signalgrenze fürs Nullgangposition-Lernen" VALUE 0x800654BE Val_Wu16 655.350 Def_tv_uw_q0p01 0.00 655.350 FORMAT "%7.3" /end CHARACTERISTIC
/begin CHARACTERISTIC K_NGOFFMAX "Offset nach oben für den Nullgangbereich" VALUE 0x800654C0 Val_Wu16 655.350 Def_tv_uw_q0p01 0.00 655.350 FORMAT "%7.3" /end CHARACTERISTIC
/begin CHARACTERISTIC K_NGOFFMAXERW "Offset nach oben für den erweiterten Nullgangbereich" VALUE 0x800654C2 Val_Wu16 655.350 Def_tv_uw_q0p01 0.00 655.350 FORMAT "%7.3" /end CHARACTERISTIC
/begin CHARACTERISTIC K_NGOFFMIN "Offset nach unten für den Nullgangbereich" VALUE 0x800654C4 Val_Wu16 655.350 Def_tv_uw_q0p01 0.00 655.350 FORMAT "%7.3" /end CHARACTERISTIC
/begin CHARACTERISTIC K_NGOFFMINERW "Offset nach unten für den erweiterten Nullgangbereich" VALUE 0x800654C6 Val_Wu16 655.350 Def_tv_uw_q0p01 0.00 655.350 FORMAT "%7.3" /end CHARACTERISTIC
/begin CHARACTERISTIC K_NGSP "Min Spannung fürs Nullgangposition-Lernen" VALUE 0x800654C8 Val_Wu16 6173.4 Def_u_uw_q0p0942 0.00 6173.4 FORMAT "%6.1" /end CHARACTERISTIC
/begin CHARACTERISTIC K_NGSTABIL "Delta für die Stabilitätskontrolle Signal beim Lernen" VALUE 0x800654CA Val_Wu16 655.350 Def_tv_uw_q0p01 0.00 655.350 FORMAT "%7.3" /end CHARACTERISTIC
/begin CHARACTERISTIC K_NGTK "Intevall für die Stabilitätskontrolle" VALUE 0x800654CC Val_Wu16 655.350 Def_td10ms_uw_b655p35 0.00 655.350 FORMAT "%7.3" /end CHARACTERISTIC
/begin CHARACTERISTIC K_NGTSTL "Zeit über die, der Sensorwert stabil bleiben muss" VALUE 0x800654CE Val_Wu16 655.350 Def_td10ms_uw_b655p35 0.00 655.350 FORMAT "%7.3" /end CHARACTERISTIC
/begin CHARACTERISTIC MoFMode_ctDebPoI1Err1_C "Fehlerzählerschwelle 1" VALUE 0x80021414 Val_Wu8 255.0 OneToOne 0.00 255.0 /end CHARACTERISTIC
/begin CHARACTERISTIC MoFMode_ctDebPoI1Err2_C "Fehlerzählerschwelle 2" VALUE 0x80021415 Val_Wu8 255.0 OneToOne 0.00 255.0 /end CHARACTERISTIC
/begin CHARACTERISTIC MoFMode_ctDebPoI2Err1_C "Fehlerzählerschwelle 1" VALUE 0x80021416 Val_Wu8 255.0 OneToOne 0.00 255.0 /end CHARACTERISTIC
/begin CHARACTERISTIC MoFMode_ctDebPoI2Err2_C "Fehlerzählerschwelle 2" VALUE 0x80021417 Val_Wu8 255.0 OneToOne 0.00 255.0 /end CHARACTERISTIC
/begin CHARACTERISTIC MoFMode_ctDiag1PoI1_C "Fehlerzählerschwelle 1" VALUE 0x8004E086 Val_Wu8 255.0 OneToOne 0.00 255.0 /end CHARACTERISTIC
/begin CHARACTERISTIC MoFMode_ctDiag1PoI2_C "Fehlerzählerschwelle 1" VALUE 0x8004E087 Val_Wu8 255.0 OneToOne 0.00 255.0 /end CHARACTERISTIC
/begin CHARACTERISTIC MoFMode_ctDiag2PoI1_C "Fehlerzählerschwelle 2" VALUE 0x8004E088 Val_Wu8 255.0 OneToOne 0.00 255.0 /end CHARACTERISTIC
/begin CHARACTERISTIC MoFMode_ctDiag2PoI2_C "Fehlerzählerschwelle 2" VALUE 0x8004E089 Val_Wu8 255.0 OneToOne 0.00 255.0 /end CHARACTERISTIC
/begin CHARACTERISTIC MoFMode_ctRst_C "Anzahl der Resets vor Anforderung der Einspritzmengenbegrenzung (EMB)" VALUE 0x80021418 Val_Wu8 255.0 OneToOne 0.00 255.0 /end CHARACTERISTIC
/begin CHARACTERISTIC MoFMode_dFacPoI1MaxNeg_CUR "" CURVE 0x8002141A Cur_Xs16Ws16 257.0000 Mo_fac_q0p00392 -128.5020 128.4980 FORMAT "%8.4"
 /begin AXIS_DESCR STD_AXIS MoFESpd_nEng Mo_n_rpm_q40p0 2 0.00 10200. FORMAT "%5.0" DEPOSIT ABSOLUTE /end AXIS_DESCR
/end CHARACTERISTIC
/begin CHARACTERISTIC MoFMode_dFacPoI1MaxPos_CUR "" CURVE 0x80021424 Cur_Xs16Ws16 257.0000 Mo_fac_q0p00392 -128.5020 128.4980 FORMAT "%8.4"
 /begin AXIS_DESCR STD_AXIS MoFESpd_nEng Mo_n_rpm_q40p0 2 0.00 10200. FORMAT "%5.0" DEPOSIT ABSOLUTE /end AXIS_DESCR
/end CHARACTERISTIC
/begin CHARACTERISTIC MoFMode_dFacPoI2MaxNeg_CUR "" CURVE 0x8002142E Cur_Xs16Ws16 257.0000 Mo_fac_q0p00392 -128.5020 128.4980 FORMAT "%8.4"
 /begin AXIS_DESCR STD_AXIS MoFESpd_nEng Mo_n_rpm_q40p0 2 0.00 10200. FORMAT "%5.0" DEPOSIT ABSOLUTE /end AXIS_DESCR
/end CHARACTERISTIC
/begin CHARACTERISTIC MoFMode_dFacPoI2MaxPos_CUR "" CURVE 0x80021438 Cur_Xs16Ws16 257.0000 Mo_fac_q0p00392 -128.5020 128.4980 FORMAT "%8.4"
 /begin AXIS_DESCR STD_AXIS MoFESpd_nEng Mo_n_rpm_q40p0 2 0.00 10200. FORMAT "%5.0" DEPOSIT ABSOLUTE /end AXIS_DESCR
/end CHARACTERISTIC
/begin CHARACTERISTIC MoFMode_fac1PoI1Eff_MAP "Momentenwirkungsgradfaktor 1 der PoI1 in der Funktionsüberwachung" MAP 0x80021442 Map_Xs16Ys16Ws16 257.0000 Mo_fac_q0p00392 -128.5020 128.4980 FORMAT "%8.4"
 /begin AXIS_DESCR STD_AXIS MoFESpd_nEng Mo_n_rpm_q40p0 2 0.00 10200. FORMAT "%5.0" DEPOSIT ABSOLUTE /end AXIS_DESCR
 /begin AXIS_DESCR STD_AXIS MoFInjDat_phiPoI1 Mo_phi_degCrS_q0p02197 2 -720.0439 720.0220 FORMAT "%8.4" DEPOSIT ABSOLUTE /end AXIS_DESCR
/end CHARACTERISTIC
/begin CHARACTERISTIC MoFMode_fac1PoI2Eff_MAP "Momentenwirkungsgradfaktor 1 der PoI2 in der Funktionsüberwachung" MAP 0x80021456 Map_Xs16Ys16Ws16 257.0000 Mo_fac_q0p00392 -128.5020 128.4980 FORMAT "%8.4"
 /begin AXIS_DESCR STD_AXIS MoFESpd_nEng Mo_n_rpm_q40p0 2 0.00 10200. FORMAT "%5.0" DEPOSIT ABSOLUTE /end AXIS_DESCR
 /begin AXIS_DESCR STD_AXIS MoFInjDat_phiPoI2 Mo_phi_degCrS_q0p02197 2 -720.0439 720.0220 FORMAT "%8.4" DEPOSIT ABSOLUTE /end AXIS_DESCR
/end CHARACTERISTIC
/begin CHARACTERISTIC MoFMode_fac2PoI1Eff_CUR "Momentenwirkungsgradfaktor 2 der PoI1 in der Funktionsüberwachung" CURVE 0x8002146A Cur_Xs16Ws16 257.0000 Mo_fac_q0p00392 -128.5020 128.4980 FORMAT "%8.4"
 /begin AXIS_DESCR STD_AXIS MoFQntCor_qPoI1 Mo_q_mg_q0p01 2 -327.6800 327.6700 FORMAT "%8.4" DEPOSIT ABSOLUTE /end AXIS_DESCR
/end CHARACTERISTIC
/begin CHARACTERISTIC MoFMode_fac2PoI2Eff_CUR "Momentenwirkungsgradfaktor 2 der PoI2 in der Funktionsüberwachung" CURVE 0x80021474 Cur_Xs16Ws16 257.0000 Mo_fac_q0p00392 -128.5020 128.4980 FORMAT "%8.4"
 /begin AXIS_DESCR STD_AXIS MoFQntCor_qPoI2 Mo_q_mg_q0p01 2 -327.6800 327.6700 FORMAT "%8.4" DEPOSIT ABSOLUTE /end AXIS_DESCR
/end CHARACTERISTIC
/begin CHARACTERISTIC MoFMode_fac3PoI1Eff_MAP "Momentenwirkungsgradfaktor 3 der PoI1 in der Funktionsüberwachung" MAP 0x8002147E Map_Xs16Ys16Ws16 257.0000 Mo_fac_q0p00392 -128.5020 128.4980 FORMAT "%8.4"
 /begin AXIS_DESCR STD_AXIS MoFQntCor_qMI1 Mo_q_mg_q0p01 2 -327.6800 327.6700 FORMAT "%8.4" DEPOSIT ABSOLUTE /end AXIS_DESCR
 /begin AXIS_DESCR STD_AXIS MoFInjDat_tiMI1PoI1 Mo_ti_us_q0p4 2 -13107.20 13106.80 FORMAT "%8.2" DEPOSIT ABSOLUTE /end AXIS_DESCR
/end CHARACTERISTIC
/begin CHARACTERISTIC MoFMode_fac3PoI2Eff_MAP "Momentenwirkungsgradfaktor 3 der PoI2 in der Funktionsüberwachung" MAP 0x80021492 Map_Xs16Ys16Ws16 257.0000 Mo_fac_q0p00392 -128.5020 128.4980 FORMAT "%8.4"
 /begin AXIS_DESCR STD_AXIS MoFQntCor_qMI1 Mo_q_mg_q0p01 2 -327.6800 327.6700 FORMAT "%8.4" DEPOSIT ABSOLUTE /end AXIS_DESCR
 /begin AXIS_DESCR STD_AXIS MoFInjDat_tiMI1PoI2 Mo_ti_us_q0p4 2 -13107.20 13106.80 FORMAT "%8.2" DEPOSIT ABSOLUTE /end AXIS_DESCR
/end CHARACTERISTIC
/begin CHARACTERISTIC MoFMode_fac4PoI1Eff_CUR "Momentenwirkungsgradfaktor 4 der PoI1 in der Funktionsüberwachung" CURVE 0x800214A6 Cur_Xs16Ws16 257.0000 Mo_fac_q0p00392 -128.5020 128.4980 FORMAT "%8.4"
 /begin AXIS_DESCR STD_AXIS MoFInjDat_p Mo_p_bar_q8p0000 2 0.00 2000.000 EXTENDED_LIMITS 0.00 2040.000 DEPOSIT ABSOLUTE /end AXIS_DESCR
/end CHARACTERISTIC
/begin CHARACTERISTIC MoFMode_fac4PoI2Eff_CUR "Momentenwirkungsgradfaktor 4 der PoI2 in der Funktionsüberwachung" CURVE 0x800214B0 Cur_Xs16Ws16 257.0000 Mo_fac_q0p00392 -128.5020 128.4980 FORMAT "%8.4"
 /begin AXIS_DESCR STD_AXIS MoFInjDat_p Mo_p_bar_q8p0000 2 0.00 2000.000 EXTENDED_LIMITS 0.00 2040.000 DEPOSIT ABSOLUTE /end AXIS_DESCR
/end CHARACTERISTIC
/begin CHARACTERISTIC MoFMode_nEngMax1_C "" VALUE 0x800214BA Val_Wu8 10200. Mo_n_rpm_q40p0 0.00 10200. FORMAT "%5.0" /end CHARACTERISTIC
/begin CHARACTERISTIC MoFMode_nEngMax2_C "" VALUE 0x800214BB Val_Wu8 10200. Mo_n_rpm_q40p0 0.00 10200. FORMAT "%5.0" /end CHARACTERISTIC
/begin CHARACTERISTIC MoFMode_nEngMin1_C "" VALUE 0x800214BC Val_Wu8 10200. Mo_n_rpm_q40p0 0.00 10200. FORMAT "%5.0" /end CHARACTERISTIC
/begin CHARACTERISTIC MoFMode_nEngMin2_C "" VALUE 0x800214BD Val_Wu8 10200. Mo_n_rpm_q40p0 0.00 10200. FORMAT "%5.0" /end CHARACTERISTIC
/begin CHARACTERISTIC MoFMode_qPoI1Thresh_C "Untere Schwelle der Nacheinspritzungsmenge" VALUE 0x800214BE Val_Ws16 655.3500 Mo_q_mg_q0p01 -327.6800 327.6700 FORMAT "%8.4" /end CHARACTERISTIC
/begin CHARACTERISTIC MoFMode_qPoI2Thresh_C "Untere Schwelle der Nacheinspritzungsmenge" VALUE 0x800214C0 Val_Ws16 655.3500 Mo_q_mg_q0p01 -327.6800 327.6700 FORMAT "%8.4" /end CHARACTERISTIC
/begin CHARACTERISTIC MoFMode_stOpModeMsk1_C "" VALUE 0x800214C4 Val_Wu32 4294967295.00 OneToOne 0.00 4294967295.00 /end CHARACTERISTIC
/begin CHARACTERISTIC MoFMode_stOpModeMsk2_C "" VALUE 0x800214C8 Val_Wu32 4294967295.00 OneToOne 0.00 4294967295.00 /end CHARACTERISTIC
/begin CHARACTERISTIC MoFMode_swtPoI1Eff_C "" VALUE 0x800214CC Val_Wu8 255.0 OneToOne 0.00 255.0 /end CHARACTERISTIC
/begin CHARACTERISTIC MoFMode_swtPoI2Eff_C "Auswahl des Wirkungsgrades der Nacheinspritzung 2 (PoI2)" VALUE 0x800214CD Val_Wu8 255.0 OneToOne 0.00 255.0 /end CHARACTERISTIC
/begin CHARACTERISTIC MoFMode_trqInrSetMax1_C "" VALUE 0x800214CE Val_Ws16 6553.500 Mo_trq_nm_q0p1 -3276.800 3276.700 FORMAT "%8.3" /end CHARACTERISTIC
/begin CHARACTERISTIC MoFMode_trqInrSetMax2_C "" VALUE 0x800214D0 Val_Ws16 6553.500 Mo_trq_nm_q0p1 -3276.800 3276.700 FORMAT "%8.3" /end CHARACTERISTIC
/begin CHARACTERISTIC MoFMode_trqInrSetMin1_C "" VALUE 0x800214D2 Val_Ws16 6553.500 Mo_trq_nm_q0p1 -3276.800 3276.700 FORMAT "%8.3" /end CHARACTERISTIC
/begin CHARACTERISTIC MoFMode_trqInrSetMin2_C "" VALUE 0x800214D4 Val_Ws16 6553.500 Mo_trq_nm_q0p1 -3276.800 3276.700 FORMAT "%8.3" /end CHARACTERISTIC
/begin CHARACTERISTIC MoFOvR_ctDebASDdc_C "Verzögerung für ASD in der Überwachung" VALUE 0x800214D8 Val_Wu16 65535.00 OneToOne 0.00 65535.00 /end CHARACTERISTIC
/begin CHARACTERISTIC MoFOvR_ctDebETDef_C "Defektentprellzählerstand der Einspritzzeitenplausibilisierung" VALUE 0x800214DA Val_Wu16 65535.00 OneToOne 0.00 65535.00 /end CHARACTERISTIC
/begin CHARACTERISTIC MoFOvR_ctRst_C "Anzahl der Resets vor Anforderung der Einspritzmengenbegrenzung (EMB)" VALUE 0x800214DC Val_Wu8 255.0 OneToOne 0.00 255.0 /end CHARACTERISTIC
/begin CHARACTERISTIC MoFOvR_nEngOff_C "Kurbelwellendrehzahlgrenze zur Erkennung auf Motorzustand ""aus"" unterhalb der die Schubüberwachung inaktive ist" VALUE 0x800214DD Val_Wu8 6000. Mo_n_rpm_q40p0 0.00 6000. FORMAT "%5.0" EXTENDED_LIMITS 0.00 10200. /end CHARACTERISTIC
/begin CHARACTERISTIC MoFOvR_nSpdGovLim_C "Kurbelwellendrehzahlgrenze oberhalb der die Schubüberwachung aufgrund Leerlaufreglerfreigabe aktive ist" VALUE 0x800214DE Val_Wu8 6000. Mo_n_rpm_q40p0 0.00 6000. FORMAT "%5.0" EXTENDED_LIMITS 0.00 10200. /end CHARACTERISTIC
/begin CHARACTERISTIC MoFOvR_nStrtEnd_C "Kurbelwellendrehzahlgrenze zur Erkennung auf Motorzustand ""an"" oberhalb der die Schubüberwachung aktive ist" VALUE 0x800214DF Val_Wu8 6000. Mo_n_rpm_q40p0 0.00 6000. FORMAT "%5.0" EXTENDED_LIMITS 0.00 10200. /end CHARACTERISTIC
/begin CHARACTERISTIC MoFOvR_tiACCBrkRmp_C "Bremssignalverzögerungszeit zur Berücksichtigung der ACC-Abschaltrampe in der Schubüberwachung" VALUE 0x800214E0 Val_Wu16 655350.0 Mo_ti10ms_ms_q10p0 0.00 655350.0 FORMAT "%8.1" /end CHARACTERISTIC
/begin CHARACTERISTIC MoFOvR_tiAPPFlt_C "Verzögerungszeit des Fahrerwunsches aufgrund von Fahrpedalfilter und Führungsformer in der Schubüberwachung" VALUE 0x800214E2 Val_Wu16 655350.0 Mo_ti10ms_ms_q10p0 0.00 655350.0 FORMAT "%8.1" /end CHARACTERISTIC
/begin CHARACTERISTIC MoFOvR_tiCrCtlBrkRmp_C "Bremssignalverzögerungszeit zur Berücksichtigung der FGR-Abschaltrampe in der Schubüberwachung" VALUE 0x800214E4 Val_Wu16 655350.0 Mo_ti10ms_ms_q10p0 0.00 655350.0 FORMAT "%8.1" /end CHARACTERISTIC
/begin CHARACTERISTIC MoFOvR_tiEngSpdRlsBrkRmp_C "Bremssignalentprellzeit zur Freigabe der Schubüberwachung" VALUE 0x800214E6 Val_Wu16 655350.0 Mo_ti10ms_ms_q10p0 0.00 655350.0 FORMAT "%8.1" /end CHARACTERISTIC
/begin CHARACTERISTIC MoFOvR_tiLimET_CUR "Zulässige Ansteuerdauern zur Plausibilisierung mit tatsächlicher Ansteuerdauer" CURVE 0x800214E8 Cur_Xs16Ws16 6000.000 Mo_ti_us_q0p4 0.00 6000.000 FORMAT "%8.3" EXTENDED_LIMITS -13107.20 13106.80
 /begin AXIS_DESCR STD_AXIS MoFESpd_nEng Mo_n_rpm_q40p0 4 0.00 10200. FORMAT "%5.0" DEPOSIT ABSOLUTE /end AXIS_DESCR
/end CHARACTERISTIC
/begin CHARACTERISTIC MoFQntCor_ctDebErr_C "Fehlerentprellzählerendstand in MoFQntCor in der Funktionsüberwachung" VALUE 0x800214FA Val_Wu8 255.0 OneToOne 0.00 255.0 /end CHARACTERISTIC
/begin CHARACTERISTIC MoFQntCor_ctRst_C "Anzahl der Resets vor der Anforderung der Einspritzmengenbegrenzung (EMB)" VALUE 0x800214FB Val_Wu8 255.0 OneToOne 0.00 255.0 /end CHARACTERISTIC
/begin CHARACTERISTIC MoFQntCor_facFTSWCor_MAP "Kraftstofftemperatureinfluß Wellenkorrektur in der Funktionsüberwachung" MAP 0x800214FC Map_Xs16Ys16Ws16 511.9922 Mo_fac_q0p0078125 -256.0000 255.9922 FORMAT "%8.4"
 /begin AXIS_DESCR STD_AXIS MoFInjDat_p Mo_p_bar_q8p0000 16 0.00 2000.000 EXTENDED_LIMITS 0.00 2040.000 DEPOSIT ABSOLUTE /end AXIS_DESCR
 /begin AXIS_DESCR STD_AXIS MoFInjDat_tCor Mo_t_DegC_q0p8o48 8 -26262.40 26165.60 FORMAT "%8.2" DEPOSIT ABSOLUTE /end AXIS_DESCR
/end CHARACTERISTIC
/begin CHARACTERISTIC MoFQntCor_facPiI2WvCor_C "Faktor Einfluß PiI2 Wellenkorrektur in der Funktionsüberwachung" VALUE 0x80021630 Val_Wu8 1.992 Mo_fac_q0p0078125 0.00 1.992 FORMAT "%5.3" /end CHARACTERISTIC
/begin CHARACTERISTIC MoFQntCor_facPoI1WvCor_C "" VALUE 0x80021631 Val_Wu8 1.992 Mo_fac_q0p0078125 0.00 1.992 FORMAT "%5.3" /end CHARACTERISTIC
/begin CHARACTERISTIC MoFQntCor_facWvCor1_MAP "Faktor 1 Einfluß Wellenkorrektur in der Funktionsüberwachung" MAP 0x80021632 Map_Xs16Ys16Ws16 511.9922 Mo_fac_q0p0078125 -256.0000 255.9922 FORMAT "%8.4"
 /begin AXIS_DESCR STD_AXIS MoFQntCor_qMI1 Mo_q_mg_q0p01 8 -327.6800 327.6700 FORMAT "%8.4" DEPOSIT ABSOLUTE /end AXIS_DESCR
 /begin AXIS_DESCR STD_AXIS MoFInjDat_p Mo_p_bar_q8p0000 8 0.00 2000.000 EXTENDED_LIMITS 0.00 2040.000 DEPOSIT ABSOLUTE /end AXIS_DESCR
/end CHARACTERISTIC
/begin CHARACTERISTIC MoFQntCor_facWvCor2_MAP "Faktor 2 Einfluß Wellenkorrektur in der Funktionsüberwachung" MAP 0x800216D6 Map_Xs16Ys16Ws16 511.9922 Mo_fac_q0p0078125 -256.0000 255.9922 FORMAT "%8.4"
 /begin AXIS_DESCR STD_AXIS MoFQntCor_qPoI2 Mo_q_mg_q0p01 8 -327.6800 327.6700 FORMAT "%8.4" DEPOSIT ABSOLUTE /end AXIS_DESCR
 /begin AXIS_DESCR STD_AXIS MoFInjDat_p Mo_p_bar_q8p0000 8 0.00 2000.000 EXTENDED_LIMITS 0.00 2040.000 DEPOSIT ABSOLUTE /end AXIS_DESCR
/end CHARACTERISTIC
/begin CHARACTERISTIC MoFQntCor_qMI1DeltaMax_C "Maximal zulässige Abweichung Wellenkorrekturmenge MI1 in der Funktionsüberwachung" VALUE 0x8002177A Val_Ws16 655.3500 Mo_q_mg_q0p01 -327.6800 327.6700 FORMAT "%8.4" /end CHARACTERISTIC
/begin CHARACTERISTIC MoFQntCor_qPiI1DeltaMax_C "Maximal zulässige Abweichung Wellenkorrekturmenge PiI1 in der Funktionsüberwachung" VALUE 0x8002177C Val_Ws16 655.3500 Mo_q_mg_q0p01 -327.6800 327.6700 FORMAT "%8.4" /end CHARACTERISTIC
/begin CHARACTERISTIC MoFQntCor_qPoI1DeltaMax_C "" VALUE 0x8002177E Val_Ws16 655.3500 Mo_q_mg_q0p01 -327.6800 327.6700 FORMAT "%8.4" /end CHARACTERISTIC
/begin CHARACTERISTIC MoFQntCor_qPoI2DeltaMax_C "Maximal zulässige Abweichung Wellenkorrekturmenge PoI2 in der Funktionsüberwachung" VALUE 0x80021780 Val_Ws16 655.3500 Mo_q_mg_q0p01 -327.6800 327.6700 FORMAT "%8.4" /end CHARACTERISTIC
/begin CHARACTERISTIC MoFQntCor_qWvCor1_MAP "Wellenkorrekturmenge 1 in der Funktionsüberwachung" MAP 0x80021782 Map_Xs16Ys16Ws16 655.3500 Mo_q_mg_q0p01 -327.6800 327.6700 FORMAT "%8.4"
 /begin AXIS_DESCR STD_AXIS MoFQntCor_tiPiI1MI1Cor_mp Mo_ti_us_q0p4 16 -13107.20 13106.80 FORMAT "%8.2" DEPOSIT ABSOLUTE /end AXIS_DESCR
 /begin AXIS_DESCR STD_AXIS MoFQntCor_qPiI1 Mo_q_mg_q0p01 16 -327.6800 327.6700 FORMAT "%8.4" DEPOSIT ABSOLUTE /end AXIS_DESCR
/end CHARACTERISTIC
/begin CHARACTERISTIC MoFQntCor_qWvCor2_MAP "Wellenkorrekturmenge 2 in der Funktionsüberwachung" MAP 0x800219C6 Map_Xs16Ys16Ws16 655.3500 Mo_q_mg_q0p01 -327.6800 327.6700 FORMAT "%8.4"
 /begin AXIS_DESCR STD_AXIS MoFQntCor_tiMI1PoI2Cor_mp Mo_ti_us_q0p4 16 -13107.20 13106.80 FORMAT "%8.2" DEPOSIT ABSOLUTE /end AXIS_DESCR
 /begin AXIS_DESCR STD_AXIS MoFQntCor_rQMI1_mp Mo_fac_q0p04 16 0.00 10.20 FORMAT "%5.2" DEPOSIT ABSOLUTE /end AXIS_DESCR
/end CHARACTERISTIC
/begin CHARACTERISTIC MoFQntCor_qWvCorMax_C "Maximal zulässige Wellenkorrekturmenge in der Funktionsüberwachung" VALUE 0x80021C0A Val_Ws16 655.3500 Mo_q_mg_q0p01 -327.6800 327.6700 FORMAT "%8.4" /end CHARACTERISTIC
/begin CHARACTERISTIC MoFQntCor_qWvCorMin_C "Minimal zulässige Wellenkorrekturmenge in der Funktionsüberwachung" VALUE 0x80021C0C Val_Ws16 655.3500 Mo_q_mg_q0p01 -327.6800 327.6700 FORMAT "%8.4" /end CHARACTERISTIC
/begin CHARACTERISTIC MoFQntCor_qWvCorNorm_CUR "Normierungswellenkorrekturmenge in der Funktionsüberwachung" CURVE 0x80021C0E Cur_Xs16Ws16 655.3500 Mo_q_mg_q0p01 -327.6800 327.6700 FORMAT "%8.4"
 /begin AXIS_DESCR STD_AXIS MoFInjDat_p Mo_p_bar_q8p0000 14 0.00 2000.000 EXTENDED_LIMITS 0.00 2040.000 DEPOSIT ABSOLUTE /end AXIS_DESCR
/end CHARACTERISTIC
/begin CHARACTERISTIC MoFQntCor_tiDiffHyd_MAP "Hydraulische Zeitdifferenz in der Funktionsüberwachung" MAP 0x80021C48 Map_Xs16Ys16Ws16 26214.00 Mo_ti_us_q0p4 -13107.20 13106.80 FORMAT "%8.2"
 /begin AXIS_DESCR STD_AXIS MoFInjDat_p Mo_p_bar_q8p0000 10 0.00 2000.000 EXTENDED_LIMITS 0.00 2040.000 DEPOSIT ABSOLUTE /end AXIS_DESCR
 /begin AXIS_DESCR STD_AXIS MoFQntCor_qPoI2 Mo_q_mg_q0p01 16 -327.6800 327.6700 FORMAT "%8.4" DEPOSIT ABSOLUTE /end AXIS_DESCR
/end CHARACTERISTIC
/begin CHARACTERISTIC MoFRailP_ctDebErr_C "Schwellwert- Fehlerzähler im MoFRailP während des Funktionsüberwachung" VALUE 0x80021DC0 Val_Wu8 2550. Mo_ti10ms_ms_q10p0 0.00 2550. FORMAT "%5.0" /end CHARACTERISTIC
/begin CHARACTERISTIC MoFRailP_ctDebGradMax_C "Entprellzählerschwelle zur Erkennung eines Raildruckgradientenfehlers" VALUE 0x80021DC1 Val_Wu8 2550. Mo_ti10ms_ms_q10p0 0.00 2550. FORMAT "%5.0" /end CHARACTERISTIC
/begin CHARACTERISTIC MoFRailP_ctRst_C "Anzahl der zulässigen Rücksetzungen im Fall eines Fehlers im Rail- Drucküberwachung" VALUE 0x80021DC2 Val_Wu8 255.0 OneToOne 0.00 255.0 /end CHARACTERISTIC
/begin CHARACTERISTIC MoFRailP_pDefMax_C "Die obere Schwelle für den Rail- Druck, falls im Level 2 ein SRC- Fehler erkannt wird" VALUE 0x80021DC3 Val_Wu8 2000.000 Mo_p_bar_q8p0000 0.00 2000.000 EXTENDED_LIMITS 0.00 2040.000 /end CHARACTERISTIC
/begin CHARACTERISTIC MoFRailP_pDefMin_C "Die niedrigere Schwelle für den Rail- Druck, falls im Level 2 ein SRC- Fehler erkannt wird" VALUE 0x80021DC4 Val_Wu8 2000.000 Mo_p_bar_q8p0000 0.00 2000.000 EXTENDED_LIMITS 0.00 2040.000 /end CHARACTERISTIC
/begin CHARACTERISTIC MoFSpdG_ctDKGTurnOffDelay_C "Maxmimalwert für Zähler des DKG Drehzahleingriffs" VALUE 0x80021DC6 Val_Wu8 255.0 OneToOne 0.00 255.0 /end CHARACTERISTIC
/begin CHARACTERISTIC MoFSpdG_ctGSHRmp_C "Zeitzähler der maximal zulässigen Rampenzeit aufgrund der Drehzahlsollwertumschaltung im Drehzahlregler" VALUE 0x80021DC7 Val_Wu8 255.0 OneToOne 0.00 255.0 /end CHARACTERISTIC
/begin CHARACTERISTIC MoFSpdG_ctNDemMax_C "Zeitzähler für maximal plausible Eingriffszeit des Schaltdrehzahlreglers" VALUE 0x80021DC8 Val_Wu8 255.0 OneToOne 0.00 255.0 /end CHARACTERISTIC
/begin CHARACTERISTIC MoFSpdG_rTrqMax_MAP "maximales zulässiges Moment des Schaltdrehzahlreglers" MAP 0x80021DC9 Map_Xu8Yu8Wu8 99.61 Mo_r_prc_q0p39 0.00 99.61 FORMAT "%5.2"
 /begin AXIS_DESCR STD_AXIS MoFESpd_nEng Mo_n_rpm_q40p0 6 0.00 10200. FORMAT "%5.0" DEPOSIT ABSOLUTE /end AXIS_DESCR
 /begin AXIS_DESCR STD_AXIS MoFTEng_tEng Mo_t_DegC_q0p8o48 6 -48.00 156.0 FORMAT "%5.1" DEPOSIT ABSOLUTE /end AXIS_DESCR
/end CHARACTERISTIC
/begin CHARACTERISTIC MoFSpdG_rTrqPtd_MAP "zulässiges Moment des Drehzahlreglers" MAP 0x80021DFB Map_Xu8Yu8Wu8 99.61 Mo_r_prc_q0p39 0.00 99.61 FORMAT "%5.2"
 /begin AXIS_DESCR STD_AXIS MoFESpd_nEng Mo_n_rpm_q40p0 6 0.00 10200. FORMAT "%5.0" DEPOSIT ABSOLUTE /end AXIS_DESCR
 /begin AXIS_DESCR STD_AXIS MoFTEng_tEng Mo_t_DegC_q0p8o48 6 -48.00 156.0 FORMAT "%5.1" DEPOSIT ABSOLUTE /end AXIS_DESCR
/end CHARACTERISTIC
/begin CHARACTERISTIC MoFSpdG_stAGSDemStActive_C "Freigabebedingung für AGS Eingriff" VALUE 0x80021E2D Val_Wu8 255.0 OneToOne 0.00 255.0 /end CHARACTERISTIC
/begin CHARACTERISTIC MoFSpdG_stSpdGDem_C "Überwachungfunktion des Schaltdrehzahlregler aktiv" VALUE 0x80021E2E Val_Wu8 255.0 OneToOne 0.00 255.0 /end CHARACTERISTIC
/begin CHARACTERISTIC MoFTEng_nEngOff_C "Drehzahlschwelle zur Motor-AUS Erkennung in der Funktionsüberwachung" VALUE 0x80021E30 Val_Wu8 10200. Mo_n_rpm_q40p0 0.00 10200. FORMAT "%5.0" /end CHARACTERISTIC
/begin CHARACTERISTIC MoFTEng_nStrtEnd_C "Startabwurfdrehzahl in der Funktionsüberwachung" VALUE 0x80021E31 Val_Wu8 10200. Mo_n_rpm_q40p0 0.00 10200. FORMAT "%5.0" /end CHARACTERISTIC
/begin CHARACTERISTIC MoFTEng_tiMinTempIni_CUR "Initialisierung für Motorlaufzeit aus der Motortemperatur in der Funktionsüberwachung" CURVE 0x80021E32 Cur_Xu8Wu8 1306. Mo_ti40ms_s_q5p12 0.00 1306. FORMAT "%5.0"
 /begin AXIS_DESCR STD_AXIS MoFTEng_tEng Mo_t_DegC_q0p8o48 8 -48.00 156.0 FORMAT "%5.1" DEPOSIT ABSOLUTE /end AXIS_DESCR
/end CHARACTERISTIC
/begin CHARACTERISTIC MoFTEng_tiMinTempMax_C "Maximalwert der Motorlaufzeit" VALUE 0x80021E43 Val_Wu8 1306. Mo_ti40ms_s_q5p12 0.00 1306. FORMAT "%5.0" /end CHARACTERISTIC
/begin CHARACTERISTIC MoFTEng_tiMinTempMin_C "Begrenzungswert beim hinunterzählen des Zeitzählers MoFTEng_tiMinTemp" VALUE 0x80021E44 Val_Wu8 1306. Mo_ti40ms_s_q5p12 0.00 1306. FORMAT "%5.0" /end CHARACTERISTIC
/begin CHARACTERISTIC MoFTEng_tMin_CUR "Motortemperaturmodell in der Funktionsüberwachung" CURVE 0x80021E45 Cur_Xu8Wu8 204.0 Mo_t_DegC_q0p8o48 -48.00 156.0 FORMAT "%5.1"
 /begin AXIS_DESCR STD_AXIS MoFTEng_tiMinTemp_mp Mo_ti40ms_s_q5p12 8 0.00 1306. FORMAT "%5.0" DEPOSIT ABSOLUTE /end AXIS_DESCR
/end CHARACTERISTIC
/begin CHARACTERISTIC MoFTra_swtTraType_C "Getriebeauswahlschalter" VALUE 0x80021E56 Val_Wu8 255.0 OneToOne 0.00 255.0 /end CHARACTERISTIC
/begin CHARACTERISTIC MoFTrqCmp_ctDeb_C "Entprellwert für Fehlerzähler des Momentenvergleichs nachdem eine Einspritzmengenbegrenzung angefordert wird" VALUE 0x80021E58 Val_Wu8 255.0 OneToOne 0.00 255.0 /end CHARACTERISTIC
/begin CHARACTERISTIC MoFTrqCmp_ctRst_C "Anzahl Resets vor der Anforderung der Einspritzmengenbegrenzung (EMB)" VALUE 0x80021E59 Val_Wu8 255.0 OneToOne 0.00 255.0 /end CHARACTERISTIC
/begin CHARACTERISTIC MoFTrqIdc_facAdjSrvDfl_C "Standardwert des Mengenkorrekturfaktors aus Diagnoseabgleich" VALUE 0x80021E5A Val_Ws16 7.999878 Mo_fac_q0p000122 -4.000000 3.999878 FORMAT "%8.6" /end CHARACTERISTIC
/begin CHARACTERISTIC MoFTrqIdc_facAdjSrvMax_C "Obergrenze des Mengenkorrekturfaktor aus Diagnoseabgleich" VALUE 0x80021E5C Val_Ws16 7.999878 Mo_fac_q0p000122 -4.000000 3.999878 FORMAT "%8.6" /end CHARACTERISTIC
/begin CHARACTERISTIC MoFTrqIdc_facAdjSrvMin_C "Untergrenze des Mengenkorrekturfaktor aus Diagnoseabgleich" VALUE 0x80021E5E Val_Ws16 7.999878 Mo_fac_q0p000122 -4.000000 3.999878 FORMAT "%8.6" /end CHARACTERISTIC
/begin CHARACTERISTIC MoFTrqIdc_facEtaCorMax_C "Obere Begrenzung für Wirkungsgradkorrekturfaktor in der Funktionsüberwachung" VALUE 0x80021E60 Val_Ws16 257.0000 Mo_fac_q0p00392 -128.5020 128.4980 FORMAT "%8.4" /end CHARACTERISTIC
/begin CHARACTERISTIC MoFTrqIdc_facEtaCorMin_C "Untere Begrenzung für Wirkungsgradkorrekturfaktor in der Funktionsüberwachung" VALUE 0x80021E62 Val_Ws16 257.0000 Mo_fac_q0p00392 -128.5020 128.4980 FORMAT "%8.4" /end CHARACTERISTIC
/begin CHARACTERISTIC MoFTrqIdc_q2trq2_MAP "Kennfeld relatives Motormoment für erweiterte Motorbetriebsart der Funktionsüberwachung" MAP 0x80021E64 Map_Xs16Ys16Ws16 25599.61 Mo_r_prc_q0p39 -12800.00 12799.61 FORMAT "%8.2"
 /begin AXIS_DESCR STD_AXIS MoFESpd_nEng Mo_n_rpm_q40p0 2 0.00 10200. FORMAT "%5.0" DEPOSIT ABSOLUTE /end AXIS_DESCR
 /begin AXIS_DESCR STD_AXIS MoFMode_qSetUnBal Mo_q_mg_q0p01 2 -327.6800 327.6700 FORMAT "%8.4" DEPOSIT ABSOLUTE /end AXIS_DESCR
/end CHARACTERISTIC
/begin CHARACTERISTIC MoFTrqIdc_q2trq3_MAP "Kennfeld relatives Motormoment für erweiterte Motorbetriebsart 2stufige Aufladung der Funktionsüberwachung" MAP 0x80021E78 Map_Xs16Ys16Ws16 25599.61 Mo_r_prc_q0p39 -12800.00 12799.61 FORMAT "%8.2"
 /begin AXIS_DESCR STD_AXIS MoFESpd_nEng Mo_n_rpm_q40p0 16 0.00 10200. FORMAT "%5.0" DEPOSIT ABSOLUTE /end AXIS_DESCR
 /begin AXIS_DESCR STD_AXIS MoFMode_qSetUnBal Mo_q_mg_q0p01 16 -327.6800 327.6700 FORMAT "%8.4" DEPOSIT ABSOLUTE /end AXIS_DESCR
/end CHARACTERISTIC
/begin CHARACTERISTIC MoFTrqIdc_q2trq_MAP "Kennfeld relatives Motormoment der Funktionsüberwachung" MAP 0x800220BC Map_Xs16Ys16Ws16 25599.61 Mo_r_prc_q0p39 -12800.00 12799.61 FORMAT "%8.2"
 /begin AXIS_DESCR STD_AXIS MoFESpd_nEng Mo_n_rpm_q40p0 16 0.00 10200. FORMAT "%5.0" DEPOSIT ABSOLUTE /end AXIS_DESCR
 /begin AXIS_DESCR STD_AXIS MoFMode_qSetUnBal Mo_q_mg_q0p01 16 -327.6800 327.6700 FORMAT "%8.4" DEPOSIT ABSOLUTE /end AXIS_DESCR
/end CHARACTERISTIC
/begin CHARACTERISTIC MoFTrqIdc_qAdjQntMax_C "Obergrenze für Mengenabgleichskorrekturmenge" VALUE 0x80022300 Val_Ws16 655.3500 Mo_q_mg_q0p01 -327.6800 327.6700 FORMAT "%8.4" /end CHARACTERISTIC
/begin CHARACTERISTIC MoFTrqIdc_qAdjQntMin_C "Untergrenze für Mengenabgleichskorrekturmenge" VALUE 0x80022302 Val_Ws16 655.3500 Mo_q_mg_q0p01 -327.6800 327.6700 FORMAT "%8.4" /end CHARACTERISTIC
/begin CHARACTERISTIC MoFTrqIdc_qDriftMax_C "Obergrenze für Driftkorrekurmenge" VALUE 0x80022304 Val_Ws16 655.3500 Mo_q_mg_q0p01 -327.6800 327.6700 FORMAT "%8.4" /end CHARACTERISTIC
/begin CHARACTERISTIC MoFTrqIdc_qDriftMin_C "lower limit for drift kompensation" VALUE 0x80022306 Val_Ws16 655.3500 Mo_q_mg_q0p01 -327.6800 327.6700 FORMAT "%8.4" /end CHARACTERISTIC
/begin CHARACTERISTIC Mo_trqIdcMax_C "Maximale innere Motormoment der Steuergeräteüberwachung." VALUE 0x80022308 Val_Ws16 6553.500 Mo_trq_nm_q0p1 -3276.800 3276.700 FORMAT "%8.3" /end CHARACTERISTIC
/begin CHARACTERISTIC MRly_ctErlyOpng_C "Schwelle zur Erkennung des frühen Öffnens" VALUE 0x8004DE8C Val_Wu8 255.0 OneToOne 0.00 255.0 /end CHARACTERISTIC
/begin CHARACTERISTIC MRly_tiBattVltgFlt_C "Filterzeitkonstante" VALUE 0x8004DE90 Val_Ws32 4294.9672940 TimeDelay_s 0.000002000000001 4294.9672960 FORMAT "%12.7" /end CHARACTERISTIC
/begin CHARACTERISTIC MRly_tiStkRlyDiaDel_C "Zeit, die MRly-Diagnose durchzuführen" VALUE 0x8004DE94 Val_Ws16 3000.000 Time_ms 0.00 3000.000 EXTENDED_LIMITS -327680.0 327670.0 /end CHARACTERISTIC
/begin CHARACTERISTIC MRly_uStblThr_C "Batteriespannungsschwelle zur Erkennung des Schließens des Hauptrelais" VALUE 0x8004DE96 Val_Ws16 30000.00 Volt_Batt 0.00 30000.00 EXTENDED_LIMITS -655360.0 655340.0 /end CHARACTERISTIC
/begin CHARACTERISTIC MRly_uStkRlyBattThr_C "Batteriespannungsschwelle zur Erkennung des klebenden Hauptrelais" VALUE 0x8004DE98 Val_Ws16 30000.00 Volt_Batt 0.00 30000.00 EXTENDED_LIMITS -655360.0 655340.0 /end CHARACTERISTIC
/begin CHARACTERISTIC OilPLmp_ABSBackDeb.tiHiLo_C "/" VALUE 0x8004E990 Kw_Ws16 5000.000 TimeDeb 0.00 5000.000 EXTENDED_LIMITS -327680.0 327670.0 /end CHARACTERISTIC
/begin CHARACTERISTIC OilPLmp_ABSBackDeb.tiLoHi_C "/" VALUE 0x8004E992 Kw_Ws16 5000.000 TimeDeb 0.00 5000.000 EXTENDED_LIMITS -327680.0 327670.0 /end CHARACTERISTIC
/begin CHARACTERISTIC OilPLmp_ABSForDeb.tiHiLo_C "/" VALUE 0x8004E994 Kw_Ws16 5000.000 TimeDeb 0.00 5000.000 EXTENDED_LIMITS -327680.0 327670.0 /end CHARACTERISTIC
/begin CHARACTERISTIC OilPLmp_ABSForDeb.tiLoHi_C "/" VALUE 0x8004E996 Kw_Ws16 5000.000 TimeDeb 0.00 5000.000 EXTENDED_LIMITS -327680.0 327670.0 /end CHARACTERISTIC
/begin CHARACTERISTIC OilPLmp_aMinBack_C "" VALUE 0x8004E998 Val_Ws16 65.53500 Acc -32.76800 32.76700 FORMAT "%8.5" /end CHARACTERISTIC
/begin CHARACTERISTIC OilPLmp_aMinFor_C "" VALUE 0x8004E99A Val_Ws16 65.53500 Acc -32.76800 32.76700 FORMAT "%8.5" /end CHARACTERISTIC
/begin CHARACTERISTIC OilPLmp_nStrt_C "" VALUE 0x8004E99C Val_Ws16 9980.000 EngN 20.00000 10000.00 EXTENDED_LIMITS -16384.00 16383.50 /end CHARACTERISTIC
/begin CHARACTERISTIC OilPLmp_nZero_C "" VALUE 0x8004E99E Val_Ws16 9980.000 EngN 20.00000 10000.00 EXTENDED_LIMITS -16384.00 16383.50 /end CHARACTERISTIC
/begin CHARACTERISTIC OilPLmp_stPSwmpDeb.tiHiLo_C "/" VALUE 0x8004E9A0 Kw_Ws16 5000.000 TimeDeb 0.00 5000.000 EXTENDED_LIMITS -327680.0 327670.0 /end CHARACTERISTIC
/begin CHARACTERISTIC OilPLmp_stPSwmpDeb.tiLoHi_C "/" VALUE 0x8004E9A2 Kw_Ws16 5000.000 TimeDeb 0.00 5000.000 EXTENDED_LIMITS -327680.0 327670.0 /end CHARACTERISTIC
/begin CHARACTERISTIC OilPLmp_tiInactvBack_C "" VALUE 0x8004E9A4 Val_Ws16 12000.00 Time_ms 0.00 12000.00 EXTENDED_LIMITS -327680.0 327670.0 /end CHARACTERISTIC
/begin CHARACTERISTIC OilPLmp_tiInactvFor_C "" VALUE 0x8004E9A6 Val_Ws16 12000.00 Time_ms 0.00 12000.00 EXTENDED_LIMITS -327680.0 327670.0 /end CHARACTERISTIC
/begin CHARACTERISTIC OilPLmp_tiInactvStrt_C "" VALUE 0x8004E9A8 Val_Ws16 15000.00 Time_ms 0.00 15000.00 EXTENDED_LIMITS -327680.0 327670.0 /end CHARACTERISTIC
/begin CHARACTERISTIC OilPLmp_vMinBack_C "" VALUE 0x8004E9AA Val_Ws16 200.0000 Vel 0.00 200.0000 EXTENDED_LIMITS -327.6800 327.6700 /end CHARACTERISTIC
/begin CHARACTERISTIC OilPLmp_vMinFor_C "" VALUE 0x8004E9AC Val_Ws16 200.0000 Vel 0.00 200.0000 EXTENDED_LIMITS -327.6800 327.6700 /end CHARACTERISTIC
/begin CHARACTERISTIC Oil_ctIniDlyLvl_C "" VALUE 0x8004E984 Val_Wu16 65535.00 OneToOne 0.00 65535.00 /end CHARACTERISTIC
/begin CHARACTERISTIC Oil_ctLoTimeLvl_C "" VALUE 0x8004E986 Val_Wu8 255.0 OneToOne 0.00 255.0 /end CHARACTERISTIC
/begin CHARACTERISTIC Oil_ctTOutErrLvl_C "" VALUE 0x8004E987 Val_Wu8 255.0 OneToOne 0.00 255.0 /end CHARACTERISTIC
/begin CHARACTERISTIC Oil_SRCPSwmp.uMin_C "/" VALUE 0x8004E9AE Kw_Ws16 750.0000 Volt 0.00 750.0000 EXTENDED_LIMITS -6553.600 6553.400 /end CHARACTERISTIC
/begin CHARACTERISTIC Oil_SRCPSwmp.uMax_C "/" VALUE 0x8004E9B0 Kw_Ws16 800.0000 Volt 2500.000 3300.000 EXTENDED_LIMITS -6553.600 6553.400 /end CHARACTERISTIC
/begin CHARACTERISTIC Oil_stDflPSwmp_C "" VALUE 0x8004EA18 Val_Wu8 1.000 OneToOne 0.00 1.000 EXTENDED_LIMITS 0.00 255.0 /end CHARACTERISTIC
/begin CHARACTERISTIC Oil_stTransfPSwmp_CUR "" CURVE 0x8004E9B2 Cur_Xs16Ws16 1.000000 OneToOne 0.00 1.000000 EXTENDED_LIMITS -32768.00 32767.00
 /begin AXIS_DESCR STD_AXIS Oil_uRawPSwmp Volt 25 0.00 5000.000 EXTENDED_LIMITS -6553.600 6553.400 DEPOSIT ABSOLUTE /end AXIS_DESCR
/end CHARACTERISTIC
/begin CHARACTERISTIC Oil_swtSensVar_C "" VALUE 0x8004EA1A Val_Wu8 255.0 OneToOne 0.00 255.0 /end CHARACTERISTIC
/begin CHARACTERISTIC Oil_tiBtwRegRd_C "" VALUE 0x8004EA1C Val_Ws16 1980.000 Time_ms 20.00000 2000.000 EXTENDED_LIMITS -327680.0 327670.0 /end CHARACTERISTIC
/begin CHARACTERISTIC Oil_tiLoTimeMaxLvl_C "" VALUE 0x8004E988 Val_Wu16 6553.500 Period_ms 0.00 6553.500 FORMAT "%8.3" /end CHARACTERISTIC
/begin CHARACTERISTIC Oil_tiLoTimeMinLvl_C "" VALUE 0x8004E98A Val_Wu16 6553.500 Period_ms 0.00 6553.500 FORMAT "%8.3" /end CHARACTERISTIC
/begin CHARACTERISTIC Oil_tiTOutLvl_C "" VALUE 0x8004E98C Val_Wu32 429496729.500 Period_ms 0.00 429496729.500 FORMAT "%13.3" /end CHARACTERISTIC
/begin CHARACTERISTIC S_DFHCCF "Switch für Aktivierung CC-Meldung beim Filterheizung-Fehler" VALUE 0x800654B4 Val_Wu8 255. Def_dez_ub_q1 0.00 255. FORMAT "%3.0" /end CHARACTERISTIC
/begin CHARACTERISTIC S_DFHDIAG2UNPLAUS "Schalter zur Auswahl der Bedingung für Unplausibel-Fehler" VALUE 0x800654B5 Val_Wu8 255. Def_dez_ub_q1 0.00 255. FORMAT "%3.0" /end CHARACTERISTIC
/begin CHARACTERISTIC S_DFHMINKM "Parameter zum totapplizieren von DFHMINKM" VALUE 0x800654B6 Val_Wu8 255. Def_dez_ub_q1 0.00 255. FORMAT "%3.0" /end CHARACTERISTIC
/begin CHARACTERISTIC S_DFHSTATE "Schalter zur Deaktivierung der Statemachine DIeselfilterheizung" VALUE 0x800654B7 Val_Wu8 255. Def_dez_ub_q1 0.00 255. FORMAT "%3.0" /end CHARACTERISTIC
/begin CHARACTERISTIC S_KLMSAEA "Schalter Klima EA abschalten" VALUE 0x80064E58 Val_Wu8 255. Def_dez_ub_q1 0.00 255. FORMAT "%3.0" /end CHARACTERISTIC
/begin CHARACTERISTIC S_KUPMSAEV "Schalter Kupplungsendlagesignal deaktivieren" VALUE 0x80064E59 Val_Wu8 255. Def_dez_ub_q1 0.00 255. FORMAT "%3.0" /end CHARACTERISTIC
/begin CHARACTERISTIC S_MSABS "Schalter für MSA Betriebsstrategie" VALUE 0x80064E46 Val_Wu8 255. Def_dez_ub_q1 0.00 255. FORMAT "%3.0" /end CHARACTERISTIC
/begin CHARACTERISTIC S_MSAEASNG "Freigabe Sperr-Funktion beim Gang-Rausnehmen" VALUE 0x80064E5A Val_Wu8 255. Def_dez_ub_q1 0.00 255. FORMAT "%3.0" /end CHARACTERISTIC
/begin CHARACTERISTIC S_NDRPABS "Schalter für absoluter Solldruck NDR" VALUE 0x800654B8 Val_Wu8 255. Def_dez_ub_q1 0.00 255. FORMAT "%3.0" /end CHARACTERISTIC
/begin CHARACTERISTIC S_NGANG "Codeword Nullgangsensor" VALUE 0x800654D0 Val_Wu8 255. Def_dez_ub_q1 0.00 255. FORMAT "%3.0" /end CHARACTERISTIC
/begin CHARACTERISTIC S_PMMSAEA "Schalter PM EA abschalten" VALUE 0x80064E5B Val_Wu8 255. Def_dez_ub_q1 0.00 255. FORMAT "%3.0" /end CHARACTERISTIC
/begin MEASUREMENT Dfh_anz "Anzahl DFH an" UWORD Def_dez_uw_q1 1 100 0.00 65535. FORMAT "%5.0" ECU_ADDRESS 0xC000A57A /end MEASUREMENT
/begin MEASUREMENT Dfh_danz "Anzahl DFH an für Diagnose" UWORD Def_dez_uw_q1 1 100 0.00 65535. FORMAT "%5.0" ECU_ADDRESS 0xC000A57C /end MEASUREMENT
/begin MEASUREMENT Dfh_def "Zähler für Statemachine DFH" UBYTE Def_f_ub_q1 1 100 0.00 255. FORMAT "%3.0" ECU_ADDRESS 0xC000B39E /end MEASUREMENT
/begin MEASUREMENT Dfh_deltap "Delta Druck vor Filter - nach Filter" UWORD Def_p_uw_q0p001 1 100 0.00 65.53500 FORMAT "%8.5" ECU_ADDRESS 0xC000A57E /end MEASUREMENT
/begin MEASUREMENT Dfh_deltapf "Delta Druck vor Filter - nach Filter -- filtriert" UWORD Def_p_uw_q0p001 1 100 0.00 65.53500 FORMAT "%8.5" ECU_ADDRESS 0xC000A580 /end MEASUREMENT
/begin MEASUREMENT Dfh_initumin "Initialer Spannungswert für Statemachine Check Spannung" UWORD Def_u_uw_q0p1 1 100 0.00 6553.500 FORMAT "%8.3" ECU_ADDRESS 0xC000A582 /end MEASUREMENT
/begin MEASUREMENT Dfh_lerncnt "Zähler für die Lernfunktion Dieselfilter-Heitzung" UWORD Def_dez_uw_q1 1 100 0.00 65535. FORMAT "%5.0" ECU_ADDRESS 0xC000A584 /end MEASUREMENT
/begin MEASUREMENT Dfh_lernpw "Gelernte Power für Dieselfilter-Heitzung" UWORD Def_lst_uw_q0p1 1 100 0.00 6553.5 FORMAT "%6.1" ECU_ADDRESS 0xC000A586 /end MEASUREMENT
/begin MEASUREMENT Dfh_mkold "Mk_soll_omar Vergleichwert für die Stabilitätskontrolle" SWORD Def_me_sw_q0p01 1 100 -327.6800 327.6700 FORMAT "%8.4" ECU_ADDRESS 0xC000A588 /end MEASUREMENT
/begin MEASUREMENT Dfh_nkwold "Nkw Vergleichwert für die Stabilitätskontrolle" SWORD Def_n_sw_q1p0 1 100 -32768. 32767. FORMAT "%5.0" ECU_ADDRESS 0xC000A58A /end MEASUREMENT
/begin MEASUREMENT Dfh_ok "Zähler für Statemachine DFH" UBYTE Def_f_ub_q1 1 100 0.00 255. FORMAT "%3.0" ECU_ADDRESS 0xC000B39F /end MEASUREMENT
/begin MEASUREMENT Dfh_pekpf "Leistung EKP (U*I) filtriert" UWORD Def_lst_uw_q0p1 1 100 0.00 6553.5 FORMAT "%6.1" ECU_ADDRESS 0xC000A58C /end MEASUREMENT
/begin MEASUREMENT Dfh_pin "Eingangswert für DPF" UWORD Def_lst_uw_q0p1 1 100 0.00 6553.5 FORMAT "%6.1" ECU_ADDRESS 0xC000A58E /end MEASUREMENT
/begin MEASUREMENT Dfh_pinf "Eingangswert für DPF filtriert" UWORD Def_lst_uw_q0p1 1 100 0.00 6553.5 FORMAT "%6.1" ECU_ADDRESS 0xC000A590 /end MEASUREMENT
/begin MEASUREMENT Dfh_pinfk "Eingangswert für DPF filtriert und kontrolliert" UWORD Def_lst_uw_q0p1 1 100 0.00 6553.5 FORMAT "%6.1" ECU_ADDRESS 0xC000A592 /end MEASUREMENT
/begin MEASUREMENT Dfh_rf "Reibungsfaktor Dieselfilterheizung" UWORD Def_f_uw_b100 1 100 0.00 99.99847 ECU_ADDRESS 0xC000A594 /end MEASUREMENT
/begin MEASUREMENT Dfh_rfcbs "Reibungsfaktor Dieselfilterheizung für CBS Ausgabe" UWORD Def_f_uw_b100 1 100 0.00 99.99847 ECU_ADDRESS 0xC000A596 /end MEASUREMENT
/begin MEASUREMENT Dfh_rfmax "Max Reibungsfaktor Dieselfilterheizung" UWORD Def_f_uw_b100 1 100 0.00 99.99847 ECU_ADDRESS 0xC000A598 /end MEASUREMENT
/begin MEASUREMENT Dfh_thres "Korrektur für DFH-Eingangswert-Check" UWORD Def_lst_uw_q0p1 1 100 0.00 6553.5 FORMAT "%6.1" ECU_ADDRESS 0xC000A59A /end MEASUREMENT
/begin MEASUREMENT Dfh_tkst "Kraftstoff temperatur für DFH" SWORD Def_t_sw_q0p01 1 100 -327.680 327.670 FORMAT "%7.3" ECU_ADDRESS 0xC000A59C /end MEASUREMENT
/begin MEASUREMENT Dfh_umin "minimale Spannung" UWORD Def_u_uw_q0p1 1 100 0.00 6553.500 FORMAT "%8.3" ECU_ADDRESS 0xC000A59E /end MEASUREMENT
/begin MEASUREMENT Exh_d2rO2EvalNoCat2Ds_mp "Maximal der Absolutwerte der Auswertungsfilterausgänge" SWORD O2 1 100 -0.3276800 0.3276700 ECU_ADDRESS 0xC000A5C2 /end MEASUREMENT
/begin MEASUREMENT Exh_d2rO2EvalNSCDs_mp "Max. Absolutwerte der Auswertungsfilterausgänge" SWORD O2 1 100 -0.3276800 0.3276700 ECU_ADDRESS 0xC000A5E8 /end MEASUREMENT
/begin MEASUREMENT Exh_d2rO2FltNNoCat2Ds_mp "Ausgang der negativen Auswertungsfilter" SWORD O2 1 100 -0.3276800 0.3276700 ECU_ADDRESS 0xC000A5C4 /end MEASUREMENT
/begin MEASUREMENT Exh_d2rO2FltNNSCDs_mp "Ausgang der negativen Filterauswertung" SWORD O2 1 100 -0.3276800 0.3276700 ECU_ADDRESS 0xC000A5EA /end MEASUREMENT
/begin MEASUREMENT Exh_d2rO2FltPNoCat2Ds_mp "Ausgang der positiven Auswertungsfilter" SWORD O2 1 100 -0.3276800 0.3276700 ECU_ADDRESS 0xC000A5C6 /end MEASUREMENT
/begin MEASUREMENT Exh_d2rO2FltPNSCDs_mp "Ausgang der positiven Filterauswertung" SWORD O2 1 100 -0.3276800 0.3276700 ECU_ADDRESS 0xC000A5EC /end MEASUREMENT
/begin MEASUREMENT Exh_d2rO2NoCat2Ds_mp "Input zum Auswertungsfilter des Nach-NOx-Sensors" SWORD O2 1 100 -0.3276800 0.3276700 ECU_ADDRESS 0xC000A5C8 /end MEASUREMENT
/begin MEASUREMENT Exh_d2rO2NSCDs_mp "Input zu Auswertungsfilter des Nach-NOx-Sensors" SWORD O2 1 100 -0.3276800 0.3276700 ECU_ADDRESS 0xC000A5EE /end MEASUREMENT
/begin MEASUREMENT Exh_dmNOxEGNoCat2Ds_mp "Strom der Einheitsmasse des NOx nach dem NSC in g/s" SWORD NOxFlwEG 1 100 -819.2000 819.1750 FORMAT "%8.4" ECU_ADDRESS 0xC000A5D6 /end MEASUREMENT
/begin MEASUREMENT Exh_dmNOxNoCat2Ds "NOx-Massenstrom" SLONG NOxMassFlw 1 100 -2147483.64800 2147483.64700 FORMAT "%13.5" ECU_ADDRESS 0xD0002ED4 /end MEASUREMENT
/begin MEASUREMENT Exh_dmNOxNSCDs "NOx-Massenstrom nach NOx-Speicherkatalysator" SLONG NOxMassFlw 1 100 -2147483.64800 2147483.64700 FORMAT "%13.5" ECU_ADDRESS 0xD0002ED0 /end MEASUREMENT
/begin MEASUREMENT Exh_drO2AdapNoCat2Ds "Anpassungsergebnis des Nach-NOx-Sensors" SWORD O2 1 100 -0.3276800 0.3276700 ECU_ADDRESS 0xD00009FE /end MEASUREMENT
/begin MEASUREMENT Exh_drO2AdapNSCDs "Anpassungsergebnis des Nach-NOx-Sensors" SWORD O2 1 100 -0.3276800 0.3276700 ECU_ADDRESS 0xD00009FC /end MEASUREMENT
/begin MEASUREMENT Exh_drO2FltNoCat2Ds_mp "Ausgang des Anpassungsfilters" SWORD O2 1 100 -0.3276800 0.3276700 ECU_ADDRESS 0xC000A5CA /end MEASUREMENT
/begin MEASUREMENT Exh_drO2FltNSCDs_mp "Ausgang des Anpassungsfilters" SWORD O2 1 100 -0.3276800 0.3276700 ECU_ADDRESS 0xC000A5F0 /end MEASUREMENT
/begin MEASUREMENT Exh_facMolMsEGNoCat2Ds_mp "Abgas-Molarmasse nach Sekundärkatalysator." SWORD Molmass 1 100 -327.6800 327.6700 FORMAT "%8.4" ECU_ADDRESS 0xC000A5D8 /end MEASUREMENT
/begin MEASUREMENT Exh_facMolMsEGNSCDs_mp "Abgas-Molarmasse nach Hauptkatalysator" SWORD Molmass 1 100 -327.6800 327.6700 FORMAT "%8.4" ECU_ADDRESS 0xC000A5FC /end MEASUREMENT
/begin MEASUREMENT Exh_facO2CorNoCat2Ds_mp "O2-Korrekturfaktor für den NOx-Sensor" SWORD Fact 1 100 -4.000000 3.999878 ECU_ADDRESS 0xC000A5CC /end MEASUREMENT
/begin MEASUREMENT Exh_facO2CorNSCDs_mp "O2-Korrekturfaktor für den NOx-Sensor" SWORD Fact 1 100 -4.000000 3.999878 ECU_ADDRESS 0xC000A5F2 /end MEASUREMENT
/begin MEASUREMENT Exh_facPresCompO2NoCat2Ds_mp "Druckkompensationsfaktor" SWORD Fact 1 100 -4.000000 3.999878 ECU_ADDRESS 0xC000A5CE /end MEASUREMENT
/begin MEASUREMENT Exh_facPresCompO2NSCDs_mp "Druckkompensationsfaktor" SWORD Fact 1 100 -4.000000 3.999878 ECU_ADDRESS 0xC000A5F4 /end MEASUREMENT
/begin MEASUREMENT Exh_mAirAftOvrRunNoCat2Ds "Min. integrierter Luftmassenstrom" SWORD AirMass_2 1 100 -3276.800 3276.700 FORMAT "%8.3" ECU_ADDRESS 0xD0000A02 /end MEASUREMENT
/begin MEASUREMENT Exh_mAirAftOvrRunNSCDs "Min. integrierter Luftmassenstrom" SWORD AirMass_2 1 100 -3276.800 3276.700 FORMAT "%8.3" ECU_ADDRESS 0xD0000A00 /end MEASUREMENT
/begin MEASUREMENT Exh_pEGFld1NoCat2Ds_mp "Abgasgegendruck" SWORD Pres_hPa 1 100 -32768.00 3500.00 ECU_ADDRESS 0xC000A5BE /end MEASUREMENT
/begin MEASUREMENT Exh_pEGFld1NSCDs_mp "Abgasgegendruck" SWORD Pres_hPa 1 100 -32768.00 3500.00 ECU_ADDRESS 0xC000A5E4 /end MEASUREMENT
/begin MEASUREMENT Exh_pEGFldNoCat2Ds_mp "Abgasgegendruck" SWORD Pres_hPa 1 100 -32768.00 3500.00 ECU_ADDRESS 0xC000A5D0 /end MEASUREMENT
/begin MEASUREMENT Exh_pEGFldNSCDs_mp "Abgasgegendruck" SWORD Pres_hPa 1 100 -32768.00 3500.00 ECU_ADDRESS 0xC000A5F6 /end MEASUREMENT
/begin MEASUREMENT Exh_rAbsdiffNOxOfsNoCat2Ds_mp "Absolute Differenz zwischen dem aktuellen Offset-Korrekturwert und dem alten Wert" SWORD nox 1 100 -32768.00 32767.00 FORMAT "%8.2" ECU_ADDRESS 0xC000A5DA /end MEASUREMENT
/begin MEASUREMENT Exh_rAbsdiffNOxOfsNSCDs_mp "Absolute Differenz zwischen dem aktuellen Offset-Korrekturwert und dem alten Wert" SWORD nox 1 100 -32768.00 32767.00 FORMAT "%8.2" ECU_ADDRESS 0xC000A5FE /end MEASUREMENT
/begin MEASUREMENT Exh_rLamAdapNoCat2Ds "Angepasster Lambda-Wert des Nach-NOx-Sensors" SWORD lambda 1 100 -32.76800 32.76700 ECU_ADDRESS 0xD0000A44 /end MEASUREMENT
/begin MEASUREMENT Exh_rLamAdapNSCDs "Angepasster Lambda-Wert des Nach-NOx-Sensors" SWORD lambda 1 100 -32.76800 32.76700 ECU_ADDRESS 0xD0000A42 /end MEASUREMENT
/begin MEASUREMENT Exh_rLamBinNoCat2Ds "Binäres Lambda-Signal des Abgases nach Sekundärkatalysator" SWORD lambda 1 100 -32.76800 32.76700 ECU_ADDRESS 0xD0000A48 /end MEASUREMENT
/begin MEASUREMENT Exh_rLamBinNSCDs "Binäres Lambda-Signal des Abgases nach Hauptkatalysator" SWORD lambda 1 100 -32.76800 32.76700 ECU_ADDRESS 0xD0000A46 /end MEASUREMENT
/begin MEASUREMENT Exh_rLamLinNoCat2Ds "Lineares Lambda-Signal des Abgases nach Sekundärkatalysator" SWORD lambda 1 100 -32.76800 32.76700 ECU_ADDRESS 0xD0000A4C /end MEASUREMENT
/begin MEASUREMENT Exh_rLamLinNSCDs "des linearen Lambda signals" SWORD lambda 1 100 -32.76800 32.76700 ECU_ADDRESS 0xD0000A4A /end MEASUREMENT
/begin MEASUREMENT Exh_rLamLinRecNoCat2Ds_mp "Kehrwert des linearen Lambda-Signals" SWORD lambdaRec 1 100 -3.276800 3.276700 FORMAT "%8.6" ECU_ADDRESS 0xC000A5BC /end MEASUREMENT
/begin MEASUREMENT Exh_rLamLinRecNSCDs_mp "Kehrwert des linearen Lambda-Signals" SWORD lambdaRec 1 100 -3.276800 3.276700 FORMAT "%8.6" ECU_ADDRESS 0xC000A5E2 /end MEASUREMENT
/begin MEASUREMENT Exh_rLamRecNoCat2Ds_mp "Lambda-Kehrwert nach Anpassung" SWORD lambdaRec 1 100 -3.276800 3.276700 FORMAT "%8.6" ECU_ADDRESS 0xC000A5D2 /end MEASUREMENT
/begin MEASUREMENT Exh_rLamRecNSCDs_mp "Lambda-Kehrwert nach Anpassung" SWORD lambdaRec 1 100 -3.276800 3.276700 FORMAT "%8.6" ECU_ADDRESS 0xC000A5F8 /end MEASUREMENT
/begin MEASUREMENT Exh_rNOxFltNoCat2Ds_mp "Gefiltertes NOx-Signal" SWORD nox 1 100 -32768.00 32767.00 FORMAT "%8.2" ECU_ADDRESS 0xC000A5C0 /end MEASUREMENT
/begin MEASUREMENT Exh_rNOxFltNSCDs_mp "Gefiltertes NOx-Signal" SWORD nox 1 100 -32768.00 32767.00 FORMAT "%8.2" ECU_ADDRESS 0xC000A5E6 /end MEASUREMENT
/begin MEASUREMENT Exh_rNOxNoCat2Ds "" SWORD nox 1 100 -32768.00 32767.00 FORMAT "%8.2" ECU_ADDRESS 0xD0000A50 /end MEASUREMENT
/begin MEASUREMENT Exh_rNOxNSCDs "NOx Ratio nach NOx Speicherkat" SWORD nox 1 100 -32768.00 32767.00 FORMAT "%8.2" ECU_ADDRESS 0xD0000A4E /end MEASUREMENT
/begin MEASUREMENT Exh_rNOxOfsAvrgNoCat2Ds "Durchschnittliches NOx-Offset-Signal" SWORD nox 1 100 -32768.00 32767.00 FORMAT "%8.2" ECU_ADDRESS 0xD0000A54 /end MEASUREMENT
/begin MEASUREMENT Exh_rNOxOfsAvrgNSCDs "Durchschnittliches NOx-Offset-Signal" SWORD nox 1 100 -32768.00 32767.00 FORMAT "%8.2" ECU_ADDRESS 0xD0000A52 /end MEASUREMENT
/begin MEASUREMENT Exh_rNOxOfsMaxNoCat2Ds_mp "Maximalwert des NOx-Offsets während des Offset-Lernens" SWORD nox 1 100 -32768.00 32767.00 FORMAT "%8.2" ECU_ADDRESS 0xC000A5DC /end MEASUREMENT
/begin MEASUREMENT Exh_rNOxOfsMaxNSCDs_mp "Maximalwert des NOx-Offsets während des Offset-Lernens" SWORD nox 1 100 -32768.00 32767.00 FORMAT "%8.2" ECU_ADDRESS 0xC000A600 /end MEASUREMENT
/begin MEASUREMENT Exh_rNOxOfsMinNoCat2Ds_mp "Minimalwert des NOx-Offsets während des Offset-Lernens" SWORD nox 1 100 -32768.00 32767.00 FORMAT "%8.2" ECU_ADDRESS 0xC000A5DE /end MEASUREMENT
/begin MEASUREMENT Exh_rNOxOfsMinNSCDs_mp "Minimalwert des NOx-Offsets während des Offset-Lernens" SWORD nox 1 100 -32768.00 32767.00 FORMAT "%8.2" ECU_ADDRESS 0xC000A602 /end MEASUREMENT
/begin MEASUREMENT Exh_rNOxOfsNoCat2Ds "NOx-Offset-Signal" SWORD nox 1 100 -32768.00 32767.00 FORMAT "%8.2" ECU_ADDRESS 0xD0000A58 /end MEASUREMENT
/begin MEASUREMENT Exh_rNOxOfsNSCDs "NOx-Offset-Signal" SWORD nox 1 100 -32768.00 32767.00 FORMAT "%8.2" ECU_ADDRESS 0xD0000A56 /end MEASUREMENT
/begin MEASUREMENT Exh_rNOxPresCompNoCat2Ds "Druckkompensiertes NOx-Signal" SWORD nox 1 100 -32768.00 32767.00 FORMAT "%8.2" ECU_ADDRESS 0xD0000A5C /end MEASUREMENT
/begin MEASUREMENT Exh_rNOxPresCompNSCDs "Druckkompensiertes NOx-Signal" SWORD nox 1 100 -32768.00 32767.00 FORMAT "%8.2" ECU_ADDRESS 0xD0000A5A /end MEASUREMENT
/begin MEASUREMENT Exh_rO2AdapNoCat2Ds "Angepasste Sauerstoffkonzentration" SWORD O2 1 100 -0.3276800 0.3276700 ECU_ADDRESS 0xD0000A60 /end MEASUREMENT
/begin MEASUREMENT Exh_rO2AdapNSCDs "Angepasste Sauerstoffkonzentration" SWORD O2 1 100 -0.3276800 0.3276700 ECU_ADDRESS 0xD0000A5E /end MEASUREMENT
/begin MEASUREMENT Exh_rO2CalcNoCat2Ds_mp "Aktuelle O2-Konzentration aus Luftmasse und Einspritzmenge" SWORD O2 1 100 -0.3276800 0.3276700 ECU_ADDRESS 0xC000A5E0 /end MEASUREMENT
/begin MEASUREMENT Exh_rO2CalcNSCDs_mp "Aktuelle O2-Konzentration aus Luftmasse und Einspritzmenge" SWORD O2 1 100 -0.3276800 0.3276700 ECU_ADDRESS 0xC000A604 /end MEASUREMENT
/begin MEASUREMENT Exh_rO2DvtNoCat2Ds_mp "Abweichung der druckkompensierten Sauerstoffkonzentration von der Sauerstoffkonzentration in der Frischluft" SWORD O2 1 100 -0.3276800 0.3276700 ECU_ADDRESS 0xC000A5D4 /end MEASUREMENT
/begin MEASUREMENT Exh_rO2DvtNSCDs_mp "Abweichung der druckkompensierten Sauerstoffkonzentration von der Sauerstoffkonzentration in der Frischluft" SWORD O2 1 100 -0.3276800 0.3276700 ECU_ADDRESS 0xC000A5FA /end MEASUREMENT
/begin MEASUREMENT Exh_rO2LinNoCat2Ds "O2-Konzentration im Abgas nach Sekundärkatalysator" SWORD O2 1 100 -0.3276800 0.3276700 ECU_ADDRESS 0xD0000A64 /end MEASUREMENT
/begin MEASUREMENT Exh_rO2LinNSCDs "O2-Konzentration im Abgas nach Hauptkatalysator" SWORD O2 1 100 -0.3276800 0.3276700 ECU_ADDRESS 0xD0000A62 /end MEASUREMENT
/begin MEASUREMENT Exh_rO2NoCat2Ds "Array zur Speicherung der O2-Werte aus Lambda- und NOx-Sensoren" SWORD O2 1 100 -0.3276800 0.3276700 ARRAY_SIZE 2 ECU_ADDRESS 0xD0000A6E /end MEASUREMENT
/begin MEASUREMENT Exh_rO2NOxNoCat2Ds "Array zur Speicherung der O2-Werte aus NOx-Sensoren (ausschließlich)" SWORD O2 1 100 -0.3276800 0.3276700 ARRAY_SIZE 1 ECU_ADDRESS 0xD0000A68 /end MEASUREMENT
/begin MEASUREMENT Exh_rO2NOxNSCDs "Array zur Speicherung der O2-Werte aus NOx-Sensoren (ausschließlich)" SWORD O2 1 100 -0.3276800 0.3276700 ARRAY_SIZE 1 ECU_ADDRESS 0xD0000A66 /end MEASUREMENT
/begin MEASUREMENT Exh_rO2NSCDs "Array zur Speicherung der O2-Werte aus Lambda- und NOx-Sensoren" SWORD O2 1 100 -0.3276800 0.3276700 ARRAY_SIZE 2 ECU_ADDRESS 0xD0000A6A /end MEASUREMENT
/begin MEASUREMENT Exh_rO2PresCompNoCat2Ds "Druckkompensierter O2-Wert" SWORD O2 1 100 -0.3276800 0.3276700 ECU_ADDRESS 0xD0000A74 /end MEASUREMENT
/begin MEASUREMENT Exh_rO2PresCompNSCDs "Druckkompensierter O2-Wert" SWORD O2 1 100 -0.3276800 0.3276700 ECU_ADDRESS 0xD0000A72 /end MEASUREMENT
/begin MEASUREMENT Exh_stAdapActvNoCat2Ds_mp "Aktiver Anpassungsstatus für das Nach-O2-Signal" UBYTE OneToOne 1 100 0.00 255.0 ECU_ADDRESS 0xC000B3AA /end MEASUREMENT
/begin MEASUREMENT Exh_stAdapActvNSCDs_mp "Aktiver Anpassungsstatus für das O2-Signal nach Hauptkatalysator" UBYTE OneToOne 1 100 0.00 255.0 ECU_ADDRESS 0xC000B3B6 /end MEASUREMENT
/begin MEASUREMENT Exh_stAdapNoCat2Ds "Anpassungsstatus zur Freigabe des Anpassungsprozesses" UBYTE OneToOne 1 100 0.00 255.0 ECU_ADDRESS 0xD0001E12 /end MEASUREMENT
/begin MEASUREMENT Exh_stAdapNSCDs "Anpassungsstatus zur Freigabe des Anpassungsprozesses" UBYTE OneToOne 1 100 0.00 255.0 ECU_ADDRESS 0xD0001E11 /end MEASUREMENT
/begin MEASUREMENT Exh_stChngNoCat2Ds_mp "Erlernte Anpassung im aktuellen Fahrzyklus-Zustand" UBYTE OneToOne 1 100 0.00 255.0 ECU_ADDRESS 0xC000B3A8 /end MEASUREMENT
/begin MEASUREMENT Exh_stChngNSCDs_mp "Erlernte Anpassung im aktuellen Fahrzyklus-Zustand" UBYTE OneToOne 1 100 0.00 255.0 ECU_ADDRESS 0xC000B3B4 /end MEASUREMENT
/begin MEASUREMENT Exh_stCmpChkEnaNoCat2Ds_mp "Status der NOx-Sensor-Plausibilität mit anderen Sensoren" UBYTE OneToOne 1 100 0.00 255.0 ECU_ADDRESS 0xC000B3AC /end MEASUREMENT
/begin MEASUREMENT Exh_stCmpChkEnaNSCDs_mp "Status der NOx-Sensor-Plausibilität mit anderen Sensoren" UBYTE OneToOne 1 100 0.00 255.0 ECU_ADDRESS 0xC000B3B8 /end MEASUREMENT
/begin MEASUREMENT Exh_stDebHtrSetPNoCat2Ds "Entprellter Status, der anzeigt, dass der Nach-NOx-Sensor die Sollheizertemperatur erreicht hat." UBYTE OneToOne 1 100 0.00 255.0 ECU_ADDRESS 0xD0001E15 /end MEASUREMENT
/begin MEASUREMENT Exh_stDebHtrSetPNSCDs "Entprellter Status, der anzeigt, dass der Nach-NOx-Sensor die Heizersolltemperatur erreicht hat" UBYTE OneToOne 1 100 0.00 255.0 ECU_ADDRESS 0xD0001E14 /end MEASUREMENT
/begin MEASUREMENT Exh_stDebLamVldNoCat2Ds_mp "Entprellter Gültigkeitsstatus von über CAN empfangenen Lambda-Signalen" UBYTE OneToOne 1 100 0.00 255.0 ECU_ADDRESS 0xC000B3A6 /end MEASUREMENT
/begin MEASUREMENT Exh_stDebLamVldNSCDs_mp "Entprellter Gültigkeitsstatus von über CAN empfangenen Lambda-Signalen" UBYTE OneToOne 1 100 0.00 255.0 ECU_ADDRESS 0xC000B3B2 /end MEASUREMENT
/begin MEASUREMENT Exh_stHldNoCat2Ds_mp "Status der vorhandenen Störung in O2" UBYTE OneToOne 1 100 0.00 255.0 ECU_ADDRESS 0xC000B3A9 /end MEASUREMENT
/begin MEASUREMENT Exh_stHldNSCDs_mp "Status der vorhandenen Störung in O2" UBYTE OneToOne 1 100 0.00 255.0 ECU_ADDRESS 0xC000B3B5 /end MEASUREMENT
/begin MEASUREMENT Exh_stHtrTONoCat2Ds_mp "Heizer-Timeout-Status" UBYTE OneToOne 1 100 0.00 255.0 ECU_ADDRESS 0xC000B3AB /end MEASUREMENT
/begin MEASUREMENT Exh_stHtrTONSCDs_mp "Heizer-Timeout-Status" UBYTE OneToOne 1 100 0.00 255.0 ECU_ADDRESS 0xC000B3B7 /end MEASUREMENT
/begin MEASUREMENT Exh_stLamLeanNoCat2Ds "Lambdasignal aus NOx-Sensor nach dem NOx-Speicherkatalysator" UBYTE OneToOne 1 100 0.00 255.0 ECU_ADDRESS 0xD0001E17 /end MEASUREMENT
/begin MEASUREMENT Exh_stLamLeanNSCDs "Lambdasignal aus NOx-Sensor nach dem NOx-Speicherkatalysator" UBYTE OneToOne 1 100 0.00 255.0 ECU_ADDRESS 0xD0001E16 /end MEASUREMENT
/begin MEASUREMENT Exh_stLamVldComNoCat2Ds_mp "Logisches UND von Com-Botschaften, die den Gültigkeitsstatus von Lambda-Signalen angeben" UBYTE OneToOne 1 100 0.00 255.0 ECU_ADDRESS 0xC000B3A7 /end MEASUREMENT
/begin MEASUREMENT Exh_stLamVldComNSCDs_mp "Logisches UND von Com-Botschaften, die den Gültigkeitsstatus von Lambda-Signalen angeben" UBYTE OneToOne 1 100 0.00 255.0 ECU_ADDRESS 0xC000B3B3 /end MEASUREMENT
/begin MEASUREMENT Exh_stLamVldNoCat2Ds "Status, der anzeigt, dass sowohl binäre als auch lineare Lambda-Werte des Nach-NOx-Sensors gültig sind" UBYTE OneToOne 1 100 0.00 255.0 ECU_ADDRESS 0xD0001E19 /end MEASUREMENT
/begin MEASUREMENT Exh_stLamVldNSCDs "" UBYTE OneToOne 1 100 0.00 255.0 ECU_ADDRESS 0xD0001E18 /end MEASUREMENT
/begin MEASUREMENT Exh_stMaxTExcR2LNoCat2Ds_mp "Status der max. Zeitüberschreitung für NOx-Signale, um den Gültigkeitsstatus nach einem Übergang von fett auf mager zu erreichen" UBYTE OneToOne 1 100 0.00 255.0 ECU_ADDRESS 0xC000B3AD /end MEASUREMENT
/begin MEASUREMENT Exh_stMaxTExcR2LNSCDs_mp "Status der max. Zeitüberschreitung für NOx-Signale, um den Gültigkeitsstatus nach einem Übergang von fett auf mager zu erreichen" UBYTE OneToOne 1 100 0.00 255.0 ECU_ADDRESS 0xC000B3B9 /end MEASUREMENT
/begin MEASUREMENT Exh_stNOxHtrDiaEnaNoCat2Ds "Status der Heizerdiagnose des Nach-NOx-Sensors" UBYTE OneToOne 1 100 0.00 255.0 ECU_ADDRESS 0xD0001E1B /end MEASUREMENT
/begin MEASUREMENT Exh_stNOxHtrDiaEnaNSCDs "Status der Nach-NOx-Sensors-Heizerdiagnose" UBYTE OneToOne 1 100 0.00 255.0 ECU_ADDRESS 0xD0001E1A /end MEASUREMENT
/begin MEASUREMENT Exh_stNOxNoCat2Ds "Status des NOx-Signals des Sekundär-NOx-Nachsensors" UBYTE OneToOne 1 100 0.00 255.0 ECU_ADDRESS 0xD0001E1D /end MEASUREMENT
/begin MEASUREMENT Exh_stNOxNSCDs "NOx-Statussignal nach NOx-Speicherkatalysator" UBYTE OneToOne 1 100 0.00 255.0 ECU_ADDRESS 0xD0001E1C /end MEASUREMENT
/begin MEASUREMENT Exh_stNOxOfsCorrEnaNoCat2Ds "Status der Offset-Korrekur des NOx-Signals" UBYTE OneToOne 1 100 0.00 255.0 ECU_ADDRESS 0xD0001E1F /end MEASUREMENT
/begin MEASUREMENT Exh_stNOxOfsCorrEnaNSCDs "Status der NOx-Signals-Offset-Korrekur" UBYTE OneToOne 1 100 0.00 255.0 ECU_ADDRESS 0xD0001E1E /end MEASUREMENT
/begin MEASUREMENT Exh_stNOxOfsTstActvNoCat2Ds "Status Offset-Test aktiv" UBYTE OneToOne 1 100 0.00 255.0 ECU_ADDRESS 0xD0001E21 /end MEASUREMENT
/begin MEASUREMENT Exh_stNOxOfsTstActvNSCDs "Status Offset-Test aktiv" UBYTE OneToOne 1 100 0.00 255.0 ECU_ADDRESS 0xD0001E20 /end MEASUREMENT
/begin MEASUREMENT Exh_stNOxREdgNoCat2Ds_mp "Status der steigenden Flanke von NOx" UBYTE OneToOne 1 100 0.00 255.0 ECU_ADDRESS 0xC000B3AE /end MEASUREMENT
/begin MEASUREMENT Exh_stNOxREdgNSCDs_mp "Status der steigenden Flanke von NOx" UBYTE OneToOne 1 100 0.00 255.0 ECU_ADDRESS 0xC000B3BA /end MEASUREMENT
/begin MEASUREMENT Exh_stNOxSensDiaEnaNoCat2Ds "Diagnosestatus des Nach-NOx-Sensors" UBYTE OneToOne 1 100 0.00 255.0 ECU_ADDRESS 0xD0001E23 /end MEASUREMENT
/begin MEASUREMENT Exh_stNOxSensDiaEnaNSCDs "Diagnosestatus des Nach-NOx-Sensors" UBYTE OneToOne 1 100 0.00 255.0 ECU_ADDRESS 0xD0001E22 /end MEASUREMENT
/begin MEASUREMENT Exh_stNOxSensRdyNoCat2Ds "Status, der anzeigt, dass der Nach-NOx-Sensor bereit ist und die Sensorwerte gültig sind." UBYTE OneToOne 1 100 0.00 255.0 ECU_ADDRESS 0xD0001E25 /end MEASUREMENT
/begin MEASUREMENT Exh_stNOxSensRdyNSCDs "Status, der anzeigt, dass der Nach-NOx-Sensor bereit ist und die Sensorwerte gültig sind" UBYTE OneToOne 1 100 0.00 255.0 ECU_ADDRESS 0xD0001E24 /end MEASUREMENT
/begin MEASUREMENT Exh_stO2NoCat2Ds "Array zur Speicherung des Gültigkeitsstatus der Lambda- und NOx-Sensoren" UBYTE OneToOne 1 100 0.00 255.0 ARRAY_SIZE 2 ECU_ADDRESS 0xD0001E2A /end MEASUREMENT
/begin MEASUREMENT Exh_stO2NOxNoCat2Ds "Array zur Speicherung des Gültigkeitsstatus der NOx-Sensoren (ausschließlich)" UBYTE OneToOne 1 100 0.00 255.0 ARRAY_SIZE 1 ECU_ADDRESS 0xD0001E27 /end MEASUREMENT
/begin MEASUREMENT Exh_stO2NOxNSCDs "Array zur Speicherung des Gültigkeitsstatus der NOx-Sensoren (ausschließlich)" UBYTE OneToOne 1 100 0.00 255.0 ARRAY_SIZE 1 ECU_ADDRESS 0xD0001E26 /end MEASUREMENT
/begin MEASUREMENT Exh_stO2NSCDs "Array zur Speicherung des Gültigkeitsstatus der Lambda- und NOx-Sensoren" UBYTE OneToOne 1 100 0.00 255.0 ARRAY_SIZE 2 ECU_ADDRESS 0xD0001E28 /end MEASUREMENT
/begin MEASUREMENT Exh_stOpModCmpChkNoCat2Ds_mp "Status, der anzeigt, dass der Motor im Arbeitsbereich ist" UBYTE OneToOne 1 100 0.00 255.0 ECU_ADDRESS 0xC000B3AF /end MEASUREMENT
/begin MEASUREMENT Exh_stOpModCmpChkNSCDs_mp "Status, der anzeigt, dass der Motor im Arbeitsbereich ist" UBYTE OneToOne 1 100 0.00 255.0 ECU_ADDRESS 0xC000B3BB /end MEASUREMENT
/begin MEASUREMENT Exh_stR2LTstActvNoCat2Ds_mp "Plausibilitätstest-Status des NOx-Signals während eines Übergangs von fett auf mager" UBYTE OneToOne 1 100 0.00 255.0 ECU_ADDRESS 0xC000B3B0 /end MEASUREMENT
/begin MEASUREMENT Exh_stR2LTstActvNSCDs_mp "Plausibilitätstest-Status des NOx-Signals während eines Übergangs von fett auf mager" UBYTE OneToOne 1 100 0.00 255.0 ECU_ADDRESS 0xC000B3BC /end MEASUREMENT
/begin MEASUREMENT Exh_stStyCondNoCat2Ds_mp "Status, der den stabilen Motorzustand anzeigt." UBYTE OneToOne 1 100 0.00 255.0 ECU_ADDRESS 0xC000B3B1 /end MEASUREMENT
/begin MEASUREMENT Exh_stStyCondNSCDs_mp "Status, der den Dauerbetriebs-Motorzustand anzeigt" UBYTE OneToOne 1 100 0.00 255.0 ECU_ADDRESS 0xC000B3BD /end MEASUREMENT
/begin MEASUREMENT Exh_swtAdapNoCat2Ds "Anpassung des Reglerausgangs zur Freigabe des O2-Anpassungsprozesses" UBYTE OneToOne 1 100 0.00 255.0 ECU_ADDRESS 0xD0001E30 /end MEASUREMENT
/begin MEASUREMENT Exh_swtAdapNSCDs "Anpassung des Reglerausgangs zur Freigabe des O2-Anpassungsprozesses" UBYTE OneToOne 1 100 0.00 255.0 ECU_ADDRESS 0xD0001E2F /end MEASUREMENT
/begin MEASUREMENT Exh_swtNoCat2Ds "Schalter zur Auswahl der NOx-Funktionalität" UBYTE OneToOne 1 100 0.00 255.0 ECU_ADDRESS 0xD0001E32 /end MEASUREMENT
/begin MEASUREMENT Exh_swtNSCDs "Schalter zur Auswahl der NOx-Funktionalität" UBYTE OneToOne 1 100 0.00 255.0 ECU_ADDRESS 0xD0001E31 /end MEASUREMENT
/begin MEASUREMENT MoFMode_ctDebPoI1Err "Entprellzähler Fehler aus MoFMode der Funktionsüberwachung" UBYTE OneToOne 1 100 0.00 255.0 ECU_ADDRESS 0xD000692E /end MEASUREMENT
/begin MEASUREMENT MoFMode_ctDebPoI2Err "Entprellzähler Fehler aus MoFMode der Funktionsüberwachung" UBYTE OneToOne 1 100 0.00 255.0 ECU_ADDRESS 0xD000692F /end MEASUREMENT
/begin MEASUREMENT MoFMode_ctDiagPoI1 "Zähler zur Diagnose für PoI1 von MoFMode" UBYTE OneToOne 1 100 0.00 255.0 ECU_ADDRESS 0xD0001FD9 /end MEASUREMENT
/begin MEASUREMENT MoFMode_ctDiagPoI2 "Zähler zur Diagnose für PoI2 von MoFMode" UBYTE OneToOne 1 100 0.00 255.0 ECU_ADDRESS 0xD0001FDA /end MEASUREMENT
/begin MEASUREMENT MoFMode_fac1PoI1Eff_mp "Messpunkt des Momentenwirkungsgradfaktors 1 der PoI1 in der Funktionsüberwachung" UBYTE Mo_fac_q0p00392 1 100 0.00 1.000 FORMAT "%5.3" ECU_ADDRESS 0xC000B37B /end MEASUREMENT
/begin MEASUREMENT MoFMode_fac1PoI2Eff_mp "Messpunkt des Momentenwirkungsgradfaktors 1 der PoI2 in der Funktionsüberwachung" UBYTE Mo_fac_q0p00392 1 100 0.00 1.000 FORMAT "%5.3" ECU_ADDRESS 0xC000B37C /end MEASUREMENT
/begin MEASUREMENT MoFMode_fac2PoI1Eff_mp "Messpunkt des Momentenwirkungsgradfaktors 2 der PoI1 in der Funktionsüberwachung" UBYTE Mo_fac_q0p00392 1 100 0.00 1.000 FORMAT "%5.3" ECU_ADDRESS 0xC000B37D /end MEASUREMENT
/begin MEASUREMENT MoFMode_fac2PoI2Eff_mp "Messpunkt des Momentenwirkungsgradfaktors 2 der PoI2 in der Funktionsüberwachung" UBYTE Mo_fac_q0p00392 1 100 0.00 1.000 FORMAT "%5.3" ECU_ADDRESS 0xC000B37E /end MEASUREMENT
/begin MEASUREMENT MoFMode_fac3PoI1Eff_mp "Messpunkt des Momentenwirkungsgradfaktors 3 der PoI1 in der Funktionsüberwachung" UBYTE Mo_fac_q0p00392 1 100 0.00 1.000 FORMAT "%5.3" ECU_ADDRESS 0xC000B37F /end MEASUREMENT
/begin MEASUREMENT MoFMode_fac3PoI2Eff_mp "Messpunkt des Momentenwirkungsgradfaktors 3 der PoI2 in der Funktionsüberwachung" UBYTE Mo_fac_q0p00392 1 100 0.00 1.000 FORMAT "%5.3" ECU_ADDRESS 0xC000B380 /end MEASUREMENT
/begin MEASUREMENT MoFMode_fac4PoI1Eff_mp "Messpunkt des Momentenwirkungsgradfaktors 4 der PoI1 in der Funktionsüberwachung" UBYTE Mo_fac_q0p00392 1 100 0.00 1.000 FORMAT "%5.3" ECU_ADDRESS 0xC000B381 /end MEASUREMENT
/begin MEASUREMENT MoFMode_fac4PoI2Eff_mp "Messpunkt des Momentenwirkungsgradfaktors 4 der PoI2 in der Funktionsüberwachung" UBYTE Mo_fac_q0p00392 1 100 0.00 1.000 FORMAT "%5.3" ECU_ADDRESS 0xC000B382 /end MEASUREMENT
/begin MEASUREMENT MoFMode_facPoI1EffRaw_mp "" UBYTE Mo_fac_q0p00392 1 100 0.00 1.000 FORMAT "%5.3" ECU_ADDRESS 0xC000B383 /end MEASUREMENT
/begin MEASUREMENT MoFMode_facPoI1Eff_mp "Gesamtmomentenwirkungsgradfaktor der PoI1 in der Funktionsüberwachung" UBYTE Mo_fac_q0p00392 1 100 0.00 1.000 FORMAT "%5.3" ECU_ADDRESS 0xC000B384 /end MEASUREMENT
/begin MEASUREMENT MoFMode_facPoI2EffRaw_mp "Gesamtmomentenwirkungsgradfaktor der PoI2 in der Funktionsüberwachung" UBYTE Mo_fac_q0p00392 1 100 0.00 1.000 FORMAT "%5.3" ECU_ADDRESS 0xC000B385 /end MEASUREMENT
/begin MEASUREMENT MoFMode_facPoI2Eff_mp "Gesamtmomentenwirkungsgradfaktor der PoI2 in der Funktionsüberwachung" UBYTE Mo_fac_q0p00392 1 100 0.00 1.000 FORMAT "%5.3" ECU_ADDRESS 0xC000B386 /end MEASUREMENT
/begin MEASUREMENT MoFMode_qPoI1Eff_mp "Effektive Einspritzmenge von PoI1" SWORD Mo_q_mg_q0p01 1 100 -327.6800 327.6700 FORMAT "%8.4" ECU_ADDRESS 0xC000A532 /end MEASUREMENT
/begin MEASUREMENT MoFMode_qSetUnBal "Virtuelle Gesamteinspritzmenge der Funktionsüberwachung" SWORD Mo_q_mg_q0p01 1 100 -327.6800 327.6700 FORMAT "%8.4" ECU_ADDRESS 0xD0006930 /end MEASUREMENT
/begin MEASUREMENT MoFMode_qSumPiIMIPoI2_mp "Summe der momentenrelevanten Einspritzmengen" SWORD Mo_q_mg_q0p01 1 100 -327.6800 327.6700 FORMAT "%8.4" ECU_ADDRESS 0xC000A534 /end MEASUREMENT
/begin MEASUREMENT MoFMode_qSumPiIMI_mp "Kraftstoffmengensumme aus PiIx und MI1 in der Funktionsüberwachung" SWORD Mo_q_mg_q0p01 1 100 -327.6800 327.6700 FORMAT "%8.4" ECU_ADDRESS 0xC000A536 /end MEASUREMENT
/begin MEASUREMENT MoFMode_st "Bitcodierter Status der Betriebsartenüberwachung in der Funktionsüberwachung" UBYTE OneToOne 1 100 0.00 255.0 ECU_ADDRESS 0xD0006932 /end MEASUREMENT
/begin MEASUREMENT MoFMode_stCmp1_mp "" UBYTE OneToOne 1 100 0.00 255.0 ECU_ADDRESS 0xC000B387 /end MEASUREMENT
/begin MEASUREMENT MoFMode_stCmp2_mp "" UBYTE OneToOne 1 100 0.00 255.0 ECU_ADDRESS 0xC000B388 /end MEASUREMENT
/begin MEASUREMENT MoFMode_stErrEOM_mp "" UBYTE OneToOne 1 100 0.00 255.0 ECU_ADDRESS 0xC000B389 /end MEASUREMENT
/begin MEASUREMENT MoFMode_stIrvErr1PoI1 "Irreversibles Fehlerbit bei unplausibler Effizienz der PoI1 für die Diagnose" UBYTE OneToOne 1 100 0.00 255.0 ECU_ADDRESS 0xD0006B95 /end MEASUREMENT
/begin MEASUREMENT MoFMode_stIrvErr1PoI2 "Irreversibles Fehlerbit bei unplausibler Effizienz der PoI2 für die Diagnose" UBYTE OneToOne 1 100 0.00 255.0 ECU_ADDRESS 0xD0006B96 /end MEASUREMENT
/begin MEASUREMENT MoFMode_stIrvErr2PoI1 "Irreversibles Fehlerbit im Falle einer fehlgeschlagenen Abschaltung der PoI1 für die Diagnose" UBYTE OneToOne 1 100 0.00 255.0 ECU_ADDRESS 0xD0006B97 /end MEASUREMENT
/begin MEASUREMENT MoFMode_stIrvErr2PoI2 "Irreversibles Fehlerbit im Falle einer fehlgeschlagenen Abschaltung der PoI2 für die Diagnose" UBYTE OneToOne 1 100 0.00 255.0 ECU_ADDRESS 0xD0006B98 /end MEASUREMENT
/begin MEASUREMENT MoFMode_stOpModeMsg "Botschaft von Funktionsüberwachung an Betriebsartenkoordinator (CoEOM)" UWORD OneToOne 1 100 0.00 65535.00 ECU_ADDRESS 0xD0001602 /end MEASUREMENT
/begin MEASUREMENT MoFOvR_ctDebACCBrk "Entprellzähler der Schubüberwachung von ACCBrk" UWORD OneToOne 1 100 0.00 65535.00 ECU_ADDRESS 0xD0006934 /end MEASUREMENT
/begin MEASUREMENT MoFOvR_ctDebAPP "Entprellzähler des Fahrpedals in der Schubüberwachung" UWORD OneToOne 1 100 0.00 65535.00 ECU_ADDRESS 0xD0006936 /end MEASUREMENT
/begin MEASUREMENT MoFOvR_ctDebASDdc "Entprellzähler des Ruckeldämpfers in der Schubüberwachung" UWORD OneToOne 1 100 0.00 65535.00 ECU_ADDRESS 0xD0006938 /end MEASUREMENT
/begin MEASUREMENT MoFOvR_ctDebASDdcL1 "Entprellzähler in der Schubüberwachung von ASDdcL1" UWORD OneToOne 1 100 0.00 65535.00 ECU_ADDRESS 0xD000693A /end MEASUREMENT
/begin MEASUREMENT MoFOvR_ctDebBrk "Entprellzähler der Bremse in der Schubüberwachung" UWORD OneToOne 1 100 0.00 65535.00 ECU_ADDRESS 0xD000693C /end MEASUREMENT
/begin MEASUREMENT MoFOvR_ctDebET "Entprellzähler der Schubüberwachung" UWORD OneToOne 1 100 0.00 65535.00 ECU_ADDRESS 0xD0006942 /end MEASUREMENT
/begin MEASUREMENT MoFOvR_ctDiag "Zähler für Setzen des Testflags in der Diagnose" UBYTE OneToOne 1 100 0.00 255.0 ECU_ADDRESS 0xD0001FDB /end MEASUREMENT
/begin MEASUREMENT MoFOvR_ctEngSpd "Zähler der Motordrehzahl in der Schubüberwachung" UWORD OneToOne 1 100 0.00 65535.00 ECU_ADDRESS 0xD000693E /end MEASUREMENT
/begin MEASUREMENT MoFOvR_stActvMsg "Status über aktive Schubüberwachung" UBYTE OneToOne 1 100 0.00 255.0 ECU_ADDRESS 0xD00025CC /end MEASUREMENT
/begin MEASUREMENT MoFOvR_stIrvErr "Information ""EMB Anforderung"" für die Diagnose" UBYTE OneToOne 1 100 0.00 1.000 BIT_MASK 0x1 ECU_ADDRESS 0xD0006B99 /end MEASUREMENT
/begin MEASUREMENT MoFOvR_stRls "Status aller Freigabe Bits für die Schubüberwachung" UWORD OneToOne 1 100 0.00 65535.00 ECU_ADDRESS 0xD0006944 /end MEASUREMENT
/begin MEASUREMENT MoFOvR_stTst "Kennung für Freigabebedingung der Fehlerprüfung für die Diagnose" UBYTE OneToOne 1 100 0.00 255.0 ECU_ADDRESS 0xD0001FDC /end MEASUREMENT
/begin MEASUREMENT MoFOvR_tiLimET_mp "Zulässige Ansteuerdauer der Schubüberwachung" SWORD Mo_ti_us_q0p4 1 100 -13107.20 13106.80 FORMAT "%8.2" ECU_ADDRESS 0xC000A538 /end MEASUREMENT
/begin MEASUREMENT MoFQntCor_ctDebErr "Fehlerentprellzähler in MoFQntCor in der Funktionsüberwachung" UBYTE OneToOne 1 100 0.00 255.0 ECU_ADDRESS 0xD0006946 /end MEASUREMENT
/begin MEASUREMENT MoFQntCor_ctDiag "Zähler für Setzen des Testflags in der Diagnose" UBYTE OneToOne 1 100 0.00 255.0 ECU_ADDRESS 0xD0001FDD /end MEASUREMENT
/begin MEASUREMENT MoFQntCor_facWvPoI2PoI1_mp "" SWORD Mo_fac_q0p0078125 1 100 -256.0000 255.9922 FORMAT "%8.4" ECU_ADDRESS 0xC000A53A /end MEASUREMENT
/begin MEASUREMENT MoFQntCor_qMI1 "Korrigierte MI1 Menge in der Funktionsüberwachung" SWORD Mo_q_mg_q0p01 1 100 -327.6800 327.6700 FORMAT "%8.4" ECU_ADDRESS 0xD0006948 /end MEASUREMENT
/begin MEASUREMENT MoFQntCor_qPiI1 "Korrigierte PiI1 Menge in der Funktionsüberwachung" SWORD Mo_q_mg_q0p01 1 100 -327.6800 327.6700 FORMAT "%8.4" ECU_ADDRESS 0xD000694A /end MEASUREMENT
/begin MEASUREMENT MoFQntCor_qPiI1WvCor_mp "Wellenkorrekturmenge PiI1 in der Funktionsüberwachung" SWORD Mo_q_mg_q0p01 1 100 -327.6800 327.6700 FORMAT "%8.4" ECU_ADDRESS 0xC000A53C /end MEASUREMENT
/begin MEASUREMENT MoFQntCor_qPoI1 "Einspritzmenge PoI1 der Funktionsüberwachung" SWORD Mo_q_mg_q0p01 1 100 -327.6800 327.6700 FORMAT "%8.4" ECU_ADDRESS 0xD000694C /end MEASUREMENT
/begin MEASUREMENT MoFQntCor_qPoI1WvCor_mp "" SWORD Mo_q_mg_q0p01 1 100 -327.6800 327.6700 FORMAT "%8.4" ECU_ADDRESS 0xC000A53E /end MEASUREMENT
/begin MEASUREMENT MoFQntCor_qPoI2 "Korrigierte PoI2 Menge in der Funktionsüberwachung" SWORD Mo_q_mg_q0p01 1 100 -327.6800 327.6700 FORMAT "%8.4" ECU_ADDRESS 0xD000694E /end MEASUREMENT
/begin MEASUREMENT MoFQntCor_qPoI2WvCor_mp "Wellenkorrekturmenge PoI2 in der Funktionsüberwachung" SWORD Mo_q_mg_q0p01 1 100 -327.6800 327.6700 FORMAT "%8.4" ECU_ADDRESS 0xC000A540 /end MEASUREMENT
/begin MEASUREMENT MoFQntCor_qWvCor2_mp "Wellenkorrekturmenge 2 in der Funktionsüberwachung" SWORD Mo_q_mg_q0p01 1 100 -327.6800 327.6700 FORMAT "%8.4" ECU_ADDRESS 0xC000A542 /end MEASUREMENT
/begin MEASUREMENT MoFQntCor_qWvCorMI1PiI1_mp "Wellenkorrekturmenge MI1 aufgrund PiI1 in der Funktionsüberwachung" SWORD Mo_q_mg_q0p01 1 100 -327.6800 327.6700 FORMAT "%8.4" ECU_ADDRESS 0xC000A544 /end MEASUREMENT
/begin MEASUREMENT MoFQntCor_qWvCorMI1PiI2_mp "Wellenkorrekturmenge MI1 aufgrund PiI2 in der Funktionsüberwachung" SWORD Mo_q_mg_q0p01 1 100 -327.6800 327.6700 FORMAT "%8.4" ECU_ADDRESS 0xC000A546 /end MEASUREMENT
/begin MEASUREMENT MoFQntCor_qWvCorMI1_mp "Wellenkorrekturmenge MI1 in der Funktionsüberwachung" SWORD Mo_q_mg_q0p01 1 100 -327.6800 327.6700 FORMAT "%8.4" ECU_ADDRESS 0xC000A548 /end MEASUREMENT
/begin MEASUREMENT MoFQntCor_qWvCorPiI1PiI2_mp "Wellenkorrekturmenge PiI1 aufgrund PiI2 in der Funktionsüberwachung" SWORD Mo_q_mg_q0p01 1 100 -327.6800 327.6700 FORMAT "%8.4" ECU_ADDRESS 0xC000A54A /end MEASUREMENT
/begin MEASUREMENT MoFQntCor_qWvPoI2PoI1_mp "" SWORD Mo_q_mg_q0p01 1 100 -327.6800 327.6700 FORMAT "%8.4" ECU_ADDRESS 0xC000A54C /end MEASUREMENT
/begin MEASUREMENT MoFQntCor_rQMI1_mp "Mengenverhältnis MI1 in der Funktionsüberwachung" UBYTE Mo_fac_q0p04 1 100 0.00 10.20 FORMAT "%5.2" ECU_ADDRESS 0xC000B38A /end MEASUREMENT
/begin MEASUREMENT MoFQntCor_rQPoI2_mp "" UBYTE Mo_fac_q0p04 1 100 0.00 10.20 FORMAT "%5.2" ECU_ADDRESS 0xC000B38B /end MEASUREMENT
/begin MEASUREMENT MoFQntCor_stInj "Kennung für Freigabebedingung der Fehlerprüfung für die Diagnose" UBYTE OneToOne 1 100 0.00 255.0 ECU_ADDRESS 0xD0001FDE /end MEASUREMENT
/begin MEASUREMENT MoFQntCor_stIrvErr "Irreversibles Fehlerbit bei unplausiblen Wellenkorrekturanteilen für die Diagnose" UBYTE OneToOne 1 100 0.00 255.0 ECU_ADDRESS 0xD0006B9A /end MEASUREMENT
/begin MEASUREMENT MoFQntCor_stMI1ErrAct_mp "Aktueller Fehler Mengenbilanz MI1 in der Funktionsüberwachung" UBYTE OneToOne 1 100 0.00 255.0 ECU_ADDRESS 0xC000B38C /end MEASUREMENT
/begin MEASUREMENT MoFQntCor_stPiI1ErrAct_mp "Aktueller Fehler Mengenbilanz PiI1 in der Funktionsüberwachung" UBYTE OneToOne 1 100 0.00 255.0 ECU_ADDRESS 0xC000B38D /end MEASUREMENT
/begin MEASUREMENT MoFQntCor_stPoI1ErrAct_mp "" UBYTE OneToOne 1 100 0.00 255.0 ECU_ADDRESS 0xC000B38E /end MEASUREMENT
/begin MEASUREMENT MoFQntCor_stPoI2ErrAct_mp "Aktueller Fehler Mengenbilanz PoI2 in der Funktionsüberwachung" UBYTE OneToOne 1 100 0.00 255.0 ECU_ADDRESS 0xC000B38F /end MEASUREMENT
/begin MEASUREMENT MoFQntCor_tiMI1PoI2Cor_mp "Korrigierter Zeitabstand MI1 zu PoI2 in der Funktionsüberwachung" SWORD Mo_ti_us_q0p4 1 100 -13107.20 13106.80 FORMAT "%8.2" ECU_ADDRESS 0xC000A54E /end MEASUREMENT
/begin MEASUREMENT MoFQntCor_tiPiI1MI1Cor_mp "Korrigierter Zeitabstand PiI1 zu MI1 in der Funktionsüberwachung" SWORD Mo_ti_us_q0p4 1 100 -13107.20 13106.80 FORMAT "%8.2" ECU_ADDRESS 0xC000A550 /end MEASUREMENT
/begin MEASUREMENT MoFQntCor_tiPiI2Hyd_mp "Hydraulische Korrekturzeit PiI2 in der Funktionsüberwachung" SWORD Mo_ti_us_q0p4 1 100 -13107.20 13106.80 FORMAT "%8.2" ECU_ADDRESS 0xC000A552 /end MEASUREMENT
/begin MEASUREMENT MoFQntCor_tiPoI2PoI1Cor_mp "" SWORD Mo_ti_us_q0p4 1 100 -13107.20 13106.80 FORMAT "%8.2" ECU_ADDRESS 0xC000A554 /end MEASUREMENT
/begin MEASUREMENT MoFRailP_ctDebErr "Entprellgröße für den SRC- Fehler im Rail- Drucküberwachung" UBYTE Mo_ti10ms_ms_q10p0 1 100 0.00 2550. FORMAT "%5.0" ECU_ADDRESS 0xD0006950 /end MEASUREMENT
/begin MEASUREMENT MoFRailP_ctDebGradMax "Entprellzähler der Gradientenüberwachung des Railsdrucks" UBYTE Mo_ti10ms_ms_q10p0 1 100 0.00 2550. FORMAT "%5.0" ECU_ADDRESS 0xD0006951 /end MEASUREMENT
/begin MEASUREMENT MoFRailP_ctDiag "Zähler für Setzen des Testflags in der Diagnose" UBYTE Mo_ti10ms_ms_q10p0 1 100 0.00 2550. FORMAT "%5.0" ECU_ADDRESS 0xD0001FDF /end MEASUREMENT
/begin MEASUREMENT MoFRailP_p "Raildruck der Funktionsüberwachung" UBYTE Mo_p_bar_q8p0000 1 100 0.00 2000.000 ECU_ADDRESS 0xD0006952 /end MEASUREMENT
/begin MEASUREMENT MoFRailP_stGradErr "Status der Raildruckgradientenüberwachung in der Funktionsüberwachung" UBYTE OneToOne 1 100 0.00 255.0 ECU_ADDRESS 0xD0006953 /end MEASUREMENT
/begin MEASUREMENT MoFRailP_stIrvErr "Nicht umkehrbares Fehlerbit für Rail- Drucküberwachung" UBYTE OneToOne 1 100 0.00 255.0 ECU_ADDRESS 0xD0006B9B /end MEASUREMENT
/begin MEASUREMENT MoFSpdG_ctDel "Aktueller Zeitzählerstand zur Berücksichtigung der Drehzahl-Sollwertumschaltung via Rampe im Drehzahlregler" UBYTE OneToOne 1 100 0.00 255.0 ECU_ADDRESS 0xD0006954 /end MEASUREMENT
/begin MEASUREMENT MoFSpdG_ctDKGTurnOffDelay "Zähler für DKG Drehzahleingriff" UBYTE OneToOne 1 100 0.00 255.0 ECU_ADDRESS 0xD0006955 /end MEASUREMENT
/begin MEASUREMENT MoFSpdG_ctNDem "Zeitzähler der aktuellen Eingriffszeit des Schaltdrehzahlreglers" UBYTE OneToOne 1 100 0.00 255.0 ECU_ADDRESS 0xD0006956 /end MEASUREMENT
/begin MEASUREMENT MoFSpdG_rTrq "Moment des Drehzahlreglers in der Ebene 2" UBYTE Mo_r_prc_q0p39 1 100 0.00 99.61 FORMAT "%5.2" ECU_ADDRESS 0xD0006959 /end MEASUREMENT
/begin MEASUREMENT MoFSpdG_stDem "Status allgemeiner Drehzahlanforderungen" UBYTE OneToOne 1 100 0.00 255.0 ECU_ADDRESS 0xD000695A /end MEASUREMENT
/begin MEASUREMENT MoFSpdG_stDKGActiv_mp "aktueller Status des Doppelkupplungsgetriebeeingriffs" UBYTE OneToOne 1 100 0.00 255.0 ECU_ADDRESS 0xC000B390 /end MEASUREMENT
/begin MEASUREMENT MoFSpdG_stFF "Aktivierungs-Bedingung für den Zeitzähler der absolut gültigen GSH-Eingriffs-Zeit" UBYTE OneToOne 1 100 0.00 255.0 ECU_ADDRESS 0xD0006957 /end MEASUREMENT
/begin MEASUREMENT MoFSpdG_stGSHActv "Status der Aktivierung des GSH-Eingriffs" UBYTE OneToOne 1 100 0.00 255.0 ECU_ADDRESS 0xD0006958 /end MEASUREMENT
/begin MEASUREMENT MoFSpdG_trq_mp "Moment des Drehzahlreglers in der Ebene 2" SWORD Mo_trq_nm_q0p1 1 100 -3276.800 3276.700 FORMAT "%8.3" ECU_ADDRESS 0xC000A556 /end MEASUREMENT
/begin MEASUREMENT MoFTEng_tEng "Motortemperatur in der Ebene 2" UBYTE Mo_t_DegC_q0p8o48 1 100 -48.00 156.0 FORMAT "%5.1" ECU_ADDRESS 0xD000695E /end MEASUREMENT
/begin MEASUREMENT MoFTEng_tiAftStrt "Zeit nach Start in der Funktionsüberwachung" UWORD Mo_ti40ms_ms_q40p0 1 100 0.00 2621400. FORMAT "%8.0" ECU_ADDRESS 0xD0006960 /end MEASUREMENT
/begin MEASUREMENT MoFTEng_tiMinTemp "Zeitzähler für minimale Motortemperatur eines laufenden Motors" UWORD Mo_ti20ms_s_q0p02 1 100 0.00 1310.700 FORMAT "%8.3" ECU_ADDRESS 0xD000695C /end MEASUREMENT
/begin MEASUREMENT MoFTEng_tiMinTemp_mp "Messung des Zählers der minimalen Temperature eines laufenden Motors" UBYTE Mo_ti40ms_s_q5p12 1 100 0.00 1306. FORMAT "%5.0" ECU_ADDRESS 0xC000B391 /end MEASUREMENT
/begin MEASUREMENT MoFTra_stDem "Status der Zulässigkeit des Getriebeeingriffs in der Funktionsüberwachung" UBYTE OneToOne 1 100 0.00 255.0 ECU_ADDRESS 0xD0006962 /end MEASUREMENT
/begin MEASUREMENT MoFTra_stIrvErr "Irreversibles Fehlerbit in der Überwachung der Getriebeeingriffe" UBYTE OneToOne 1 100 0.00 1.000 BIT_MASK 0x1 ECU_ADDRESS 0xD0006B9C /end MEASUREMENT
/begin MEASUREMENT MoFTra_trqDem "Zulässiges Moment des Getriebeeingriffs in der Funktionsüberwachung" SWORD Mo_trq_nm_q0p1 1 100 -3276.800 3276.700 FORMAT "%8.3" ECU_ADDRESS 0xD0006964 /end MEASUREMENT
/begin MEASUREMENT MoFTra_trqGbxFrc "Momentenanforderung Getriebeverluste" SWORD Mo_trq_nm_q0p1 1 100 -3276.800 3276.700 FORMAT "%8.3" ECU_ADDRESS 0xD0006966 /end MEASUREMENT
/begin MEASUREMENT MoFTrqAct_st "Statusgröße Istmoment in der Funktionsüberwachung" UBYTE OneToOne 1 100 0.00 255.0 ECU_ADDRESS 0xD0006969 /end MEASUREMENT
/begin MEASUREMENT MoFTrqCmp_ctDeb "Fehlerentprellzähler des Momentenvergleichs zur Auslösung der Einspritzmengenbegrenzung (EMB)" UBYTE OneToOne 1 100 0.00 255.0 ECU_ADDRESS 0xD0006968 /end MEASUREMENT
/begin MEASUREMENT MoFTrqCmp_ctDiag "Zähler für Setzen des Testflags in der Diagnose" UBYTE OneToOne 1 100 0.00 255.0 ECU_ADDRESS 0xD0001FE0 /end MEASUREMENT
/begin MEASUREMENT MoFTrqCmp_stIrvErr "Information ""EMB Anforderung"" für die Diagnose" UBYTE OneToOne 1 100 0.00 255.0 ECU_ADDRESS 0xD0006B85 /end MEASUREMENT
/begin MEASUREMENT MoFTrqCmp_stTst "Kennung für Freigabebedingung der Fehlerprüfung für die Diagnose" UBYTE OneToOne 1 100 0.00 255.0 ECU_ADDRESS 0xD0001FE1 /end MEASUREMENT
/begin MEASUREMENT MoFTrqIdc_facAdjSrvCpl_mp "Mengenkorrekturfaktorkomplementärwert aus Diagnoseabgleich" SWORD Mo_fac_q0p000122 1 100 -4.000000 3.999878 FORMAT "%8.6" ECU_ADDRESS 0xC000A558 /end MEASUREMENT
/begin MEASUREMENT MoFTrqIdc_facAdjSrv_mp "Mengenkorrekturfaktor aus Diagnoseabgleich" SWORD Mo_fac_q0p000122 1 100 -4.000000 3.999878 FORMAT "%8.6" ECU_ADDRESS 0xC000A55A /end MEASUREMENT
/begin MEASUREMENT MoFTrqIdc_facEtaCor_mp "begrenzter und gemittelter Wirkungsgradkorrekturfaktor in der Funktionsüberwachung" SWORD Mo_fac_q0p00392 1 100 -128.5020 128.4980 FORMAT "%8.4" ECU_ADDRESS 0xC000A55C /end MEASUREMENT
/begin MEASUREMENT MoFTrqIdc_qSetUnBal_mp "Virtuelle Gesamteinspritzmenge der Funktionsüberwachung nach Mengenkorrekturen" SWORD Mo_q_mg_q0p01 1 100 -327.6800 327.6700 FORMAT "%8.4" ECU_ADDRESS 0xC000A55E /end MEASUREMENT
/begin MEASUREMENT MoFTrqIdc_rQ2Trq_mp "Relatives Motormoment vor Multiplikation mit Wirkungsgradkorrekturfaktor in der Funktionsüberwachung" UBYTE Mo_r_prc_q0p39 1 100 0.00 99.61 FORMAT "%5.2" ECU_ADDRESS 0xC000B392 /end MEASUREMENT
/begin MEASUREMENT MoFTrqIdc_rTrq "aktuelles relatives indiziertes Motormoment der Funktionsüberwachung" UBYTE Mo_r_prc_q0p39 1 100 0.00 99.61 FORMAT "%5.2" ECU_ADDRESS 0xD000696A /end MEASUREMENT
/begin MEASUREMENT MoFTrqIdc_trqIdc_mp "aktuelles absolutes indiziertes Motormoment der Funktionsüberwachung" SWORD Mo_trq_nm_q0p1 1 100 -3276.800 3276.700 FORMAT "%8.3" ECU_ADDRESS 0xC000A560 /end MEASUREMENT
/begin MEASUREMENT MoFVSS_v "Fahrzeuggeschwindigkeit für die Funktionsüberwachung" SWORD Mo_v_kmh_q0p01 1 100 -327.6800 327.6700 FORMAT "%8.4" ECU_ADDRESS 0xD000696C /end MEASUREMENT
/begin MEASUREMENT Mo_bCplChk "Fehler beim Komplement Check" UBYTE OneToOne 1 100 0.00 1.000 BIT_MASK 0x1 ECU_ADDRESS 0xD0006974 /end MEASUREMENT
/begin MEASUREMENT Mo_bICOL1 "Einspritzmengenbegrenzungs-Anforderung aus Ebene 1" UBYTE OneToOne 1 100 0.00 1.000 BIT_MASK 0x2 ECU_ADDRESS 0xD0006975 /end MEASUREMENT
/begin MEASUREMENT Mo_bICOL2 "Einspritzmengenbegrenzungs-Anforderung aus Ebene 2" UBYTE OneToOne 1 100 0.00 1.000 BIT_MASK 0x1 ECU_ADDRESS 0xD0006975 /end MEASUREMENT
/begin MEASUREMENT Mo_bLimpHom "Anforderung einer limp-home Funktion vom Homogen-Betrieb" UBYTE OneToOne 1 100 0.00 1.000 BIT_MASK 0x10 ECU_ADDRESS 0xD0006975 /end MEASUREMENT
/begin MEASUREMENT Mo_bLowVltg "Niedrige Spannung bemerkt" UBYTE OneToOne 1 100 0.00 1.000 BIT_MASK 0x4 ECU_ADDRESS 0xD0006975 /end MEASUREMENT
/begin MEASUREMENT Mo_bRamErr "RAM Fehler im zyklischen Test aufgetreten" UBYTE OneToOne 1 100 0.00 1.000 BIT_MASK 0x2 ECU_ADDRESS 0xD0006974 /end MEASUREMENT
/begin MEASUREMENT Mo_bRomErr "ROM Fehler im zyklischen Test aufgetreten" UBYTE OneToOne 1 100 0.00 1.000 BIT_MASK 0x4 ECU_ADDRESS 0xD0006974 /end MEASUREMENT
/begin MEASUREMENT Mo_ctRst "Reset Zähler für den Pre-ICO Reset" UBYTE OneToOne 1 100 0.00 255.0 ECU_ADDRESS 0xC000D7D6 /end MEASUREMENT
/begin MEASUREMENT Mo_stCplChk "Komplementprüfung fehlgeschlagen" ULONG OneToOne 1 100 0.00 4294967295.00 ECU_ADDRESS 0xD0006970 /end MEASUREMENT
/begin MEASUREMENT Mo_stICOMsg "Einspritzmengenbegrenzungs-Anforderung der Steuergeräte Überwachung" UBYTE OneToOne 1 100 0.00 255.0 ECU_ADDRESS 0xD0001FE2 /end MEASUREMENT
/begin MEASUREMENT Mo_stIrvErrReacMsg "Status ob EMB oder irrev. CAN-Fehler vorliegt (Info an Ebene 1 zum Heilen des Fehlers im Falle von T15-aus/an durch Power-On Reset)" UBYTE OneToOne 1 100 0.00 255.0 ECU_ADDRESS 0xD0001FE3 /end MEASUREMENT
/begin MEASUREMENT Mo_stMoC "Status Bit für Anfrage einer Fehlerreaktion der Funktionsrechner Überwachung" UBYTE OneToOne 1 100 0.00 255.0 ECU_ADDRESS 0xD0006974 /end MEASUREMENT
/begin MEASUREMENT Mo_stMoF "Status Bit für Anfrage einer Fehlerreaktion der Funktions-Überwachung" UBYTE OneToOne 1 100 0.00 255.0 ECU_ADDRESS 0xD0006975 /end MEASUREMENT
/begin MEASUREMENT MRly_ctErlyOpng_mp "Status des Hauptrelais" UBYTE OneToOne 1 100 0.00 255.0 ECU_ADDRESS 0xC000B393 /end MEASUREMENT
/begin MEASUREMENT MRly_st "Anforderung zum Ein- / Ausschalten des Hauptrelais" UBYTE OneToOne 1 100 0.00 255.0 ECU_ADDRESS 0xD00025CB /end MEASUREMENT
/begin MEASUREMENT MRly_stAct "Status des Hauptrelais" UBYTE OneToOne 1 100 0.00 255.0 ECU_ADDRESS 0xD0001FB8 /end MEASUREMENT
/begin MEASUREMENT MRly_stStkRlytst_mp "Statusinformation über den Test, der das ""klebende"" Hauptrelais überprüft" UBYTE OneToOne 1 100 0.00 255.0 ECU_ADDRESS 0xC000B394 /end MEASUREMENT
/begin MEASUREMENT MRly_stStkRly_mp "klemmendes Hauptrelais" UBYTE OneToOne 1 100 0.00 255.0 ECU_ADDRESS 0xC000B395 /end MEASUREMENT
/begin MEASUREMENT MRly_uBattFlt_mp "Status des Hauptrelais" SWORD Volt_Batt 1 100 -655360.0 655340.0 ECU_ADDRESS 0xC000A562 /end MEASUREMENT
/begin MEASUREMENT Msastz "Zähler aller Startversuche" UWORD Def_dez_uw_q1 1 100 0.00 65535. FORMAT "%5.0" ECU_ADDRESS 0xC000A56A /end MEASUREMENT
/begin MEASUREMENT Msastzmsa "Zähler der MSA-Startversuche" UWORD Def_dez_uw_q1 1 100 0.00 65535. FORMAT "%5.0" ECU_ADDRESS 0xC000A56C /end MEASUREMENT
/begin MEASUREMENT Msa_arravrs "AV Ringspeicher-Array" UBYTE Def_dez_ub_q1 1 100 0.00 255. FORMAT "%3.0" ARRAY_SIZE 60 ECU_ADDRESS 0xC000C3E8 /end MEASUREMENT
/begin MEASUREMENT Msa_avrs "Abschaltverhinderer für den Ringspeicher" UBYTE Def_dez_ub_q1 1 100 0.00 255. FORMAT "%3.0" ECU_ADDRESS 0xC000B396 /end MEASUREMENT
/begin MEASUREMENT Msa_indexrs "Ringspeicher-Index" UBYTE Def_dez_ub_q1 1 100 0.00 255. FORMAT "%3.0" ECU_ADDRESS 0xC000B397 /end MEASUREMENT
/begin MEASUREMENT Msa_vstart "Merker Geschwindigkeit am Startbeginn" UWORD Def_v_uw_q1p0 1 100 0.00 65535. FORMAT "%5.0" ECU_ADDRESS 0xC000A56E /end MEASUREMENT
/begin MEASUREMENT Ndr_delta "Delta Sollwert-Istwert Niederdruck" SWORD Def_p_sw_q0p001 1 100 -32.76800 32.76700 FORMAT "%8.5" ECU_ADDRESS 0xC000A5A0 /end MEASUREMENT
/begin MEASUREMENT Ndr_fsp_1 "Fehlerbits FI_NDR_1" UWORD Def_dez_uw_q1 1 100 0.00 65535. FORMAT "%5.0" ECU_ADDRESS 0xC000A5A2 /end MEASUREMENT
/begin MEASUREMENT Ndr_fsp_2 "Fehlerbits FI_NDR_2" UWORD Def_dez_uw_q1 1 100 0.00 65535. FORMAT "%5.0" ECU_ADDRESS 0xC000A5A4 /end MEASUREMENT
/begin MEASUREMENT Ndr_int "Niederdruck-Regelung Integral-Anteil" SWORD Def_rf_sw_q0p01 1 100 -327.68000 327.67000 FORMAT "%9.5" ECU_ADDRESS 0xC000A5A6 /end MEASUREMENT
/begin MEASUREMENT Ndr_out "Output Niederdruck-Regelung" UWORD Def_rf_uw_q0p01 1 100 0.00 655.35000 FORMAT "%9.5" ECU_ADDRESS 0xC000A5A8 /end MEASUREMENT
/begin MEASUREMENT Ndr_outnb "Output Niederdruck-Regelung nicht begrenzt" UWORD Def_rf_uw_q0p01 1 100 0.00 655.35000 FORMAT "%9.5" ECU_ADDRESS 0xC000A5AA /end MEASUREMENT
/begin MEASUREMENT Ndr_prop "Niederdruck-Regelung Proportional-Anteil" SWORD Def_rf_sw_q0p01 1 100 -327.68000 327.67000 FORMAT "%9.5" ECU_ADDRESS 0xC000A5AC /end MEASUREMENT
/begin MEASUREMENT Ndr_propvor "Zur Kontrolle des differentiellen und proportionalen Anteils der Regelung" SWORD Def_rf_sw_q0p01 1 100 -327.68000 327.67000 FORMAT "%9.5" ECU_ADDRESS 0xC000A5AE /end MEASUREMENT
/begin MEASUREMENT Ndr_soll "Sollwert Niederdruck" UWORD Def_p_uw_q0p001 1 100 0.00 65.53500 FORMAT "%8.5" ECU_ADDRESS 0xC000A5B0 /end MEASUREMENT
/begin MEASUREMENT Ndr_tkstaquerbeg "Begrenzer für die Werte aus den Kennlinien KL_TKST und KL_A_QUER_ABS" UWORD Def_rf_uw_q0p0001 1 100 0.00 2.5500000 ECU_ADDRESS 0xC000A5B2 /end MEASUREMENT
/begin MEASUREMENT Ndr_vor "Niederdruck-Regelung Vorkontrolle-Anteil" SWORD Def_rf_sw_q0p01 1 100 -327.68000 327.67000 FORMAT "%9.5" ECU_ADDRESS 0xC000A5B4 /end MEASUREMENT
/begin MEASUREMENT Num_dfhstrg "Zähler für die case-Bedingung in der DFH" UBYTE Def_f_ub_q1 1 100 0.00 2.0 ECU_ADDRESS 0xC000B3A0 /end MEASUREMENT
/begin MEASUREMENT OilPLmp_st "Digitalausgang zum Öllampensteller nach der Diagnose" UBYTE OneToOne 1 100 0.00 255.0 ECU_ADDRESS 0xD0001FE7 /end MEASUREMENT
/begin MEASUREMENT OilPLmp_stABSBackDeb_mp "" UBYTE OneToOne 1 100 0.00 255.0 ECU_ADDRESS 0xC000B3BE /end MEASUREMENT
/begin MEASUREMENT OilPLmp_stABSBackTrans_mp "" UBYTE OneToOne 1 100 0.00 255.0 ECU_ADDRESS 0xC000B3BF /end MEASUREMENT
/begin MEASUREMENT OilPLmp_stABSBack_mp "" UBYTE OneToOne 1 100 0.00 255.0 ECU_ADDRESS 0xC000B3C0 /end MEASUREMENT
/begin MEASUREMENT OilPLmp_stABSForDeb_mp "" UBYTE OneToOne 1 100 0.00 255.0 ECU_ADDRESS 0xC000B3C1 /end MEASUREMENT
/begin MEASUREMENT OilPLmp_stABSForTrans_mp "" UBYTE OneToOne 1 100 0.00 255.0 ECU_ADDRESS 0xC000B3C2 /end MEASUREMENT
/begin MEASUREMENT OilPLmp_stABSFor_mp "" UBYTE OneToOne 1 100 0.00 255.0 ECU_ADDRESS 0xC000B3C3 /end MEASUREMENT
/begin MEASUREMENT OilPLmp_stInactive_mp "" UBYTE OneToOne 1 100 0.00 255.0 ECU_ADDRESS 0xC000B3C4 /end MEASUREMENT
/begin MEASUREMENT OilPLmp_stnEngTrans_mp "" UBYTE OneToOne 1 100 0.00 255.0 ECU_ADDRESS 0xC000B3C5 /end MEASUREMENT
/begin MEASUREMENT OilPLmp_stOilPLmp_mp "" UBYTE OneToOne 1 100 0.00 255.0 ECU_ADDRESS 0xC000B3C6 /end MEASUREMENT
/begin MEASUREMENT OilPLmp_stShOff_mp "" UBYTE OneToOne 1 100 0.00 255.0 ECU_ADDRESS 0xC000B3C7 /end MEASUREMENT
/begin MEASUREMENT Oil_ctNplErrLvl "" UBYTE OneToOne 1 100 0.00 255.0 ECU_ADDRESS 0xD0001FE8 /end MEASUREMENT
/begin MEASUREMENT Oil_ctStrtDlyLvl "" UBYTE OneToOne 1 100 0.00 255.0 ECU_ADDRESS 0xD0001FE9 /end MEASUREMENT
/begin MEASUREMENT Oil_ctTOutLvl "" UWORD OneToOne 1 100 0.00 65535.00 ECU_ADDRESS 0xD0001604 /end MEASUREMENT
/begin MEASUREMENT Oil_rRawOilLvl "" UBYTE OneToOne 1 100 0.00 255.0 ECU_ADDRESS 0xD0001FEA /end MEASUREMENT
/begin MEASUREMENT Oil_rRawOilQl "" UWORD OneToOne 1 100 0.00 65535.00 ECU_ADDRESS 0xD0001606 /end MEASUREMENT
/begin MEASUREMENT Oil_rRawOilT "" UBYTE OneToOne 1 100 0.00 255.0 ECU_ADDRESS 0xD0001FEB /end MEASUREMENT
/begin MEASUREMENT Oil_stComErr "Status Fehler Kommunikation" UBYTE OneToOne 1 100 0.00 255.0 ECU_ADDRESS 0xD0001FEC /end MEASUREMENT
/begin MEASUREMENT Oil_stErrLvl "" UBYTE OneToOne 1 100 0.00 255.0 ECU_ADDRESS 0xD0001FED /end MEASUREMENT
/begin MEASUREMENT Oil_stLoTimeLvl "" UBYTE OneToOne 1 100 0.00 255.0 ECU_ADDRESS 0xD0001FEE /end MEASUREMENT
/begin MEASUREMENT Oil_stPSwmp "Status des Öldrucks" UBYTE OneToOne 1 100 0.00 255.0 ECU_ADDRESS 0xD0001FEF /end MEASUREMENT
/begin MEASUREMENT Oil_stRegSens "" UBYTE OneToOne 1 100 0.00 255.0 ECU_ADDRESS 0xD0001FF0 /end MEASUREMENT
/begin MEASUREMENT Oil_stSensPSwmp "" UBYTE OneToOne 1 100 0.00 255.0 ECU_ADDRESS 0xD0001FF1 /end MEASUREMENT
/begin MEASUREMENT Oil_stValidLvl "" UBYTE OneToOne 1 100 0.00 255.0 ECU_ADDRESS 0xD0001FF2 /end MEASUREMENT
/begin MEASUREMENT Oil_swtSensVar "" UBYTE OneToOne 1 100 0.00 255.0 ECU_ADDRESS 0xD0001FF3 /end MEASUREMENT
/begin MEASUREMENT Oil_tiHiRawLvl "" ULONG Period_ms 1 100 0.00 429496729.500 FORMAT "%13.3" ECU_ADDRESS 0xD0003248 /end MEASUREMENT
/begin MEASUREMENT Oil_tiLoLvl "" UWORD Period_ms 1 100 0.00 6553.500 FORMAT "%8.3" ECU_ADDRESS 0xD0001608 /end MEASUREMENT
/begin MEASUREMENT Oil_tiLoRawLvl "" ULONG Period_ms 1 100 0.00 429496729.500 FORMAT "%13.3" ECU_ADDRESS 0xD000324C /end MEASUREMENT
/begin MEASUREMENT Oil_uRawPSwmp "" SWORD Volt 1 100 -6553.600 6553.400 ECU_ADDRESS 0xD0001108 /end MEASUREMENT
/begin MEASUREMENT OS_cnt1000msTask "Raster-Zähler für diese Task" UWORD OneToOne 1 100 0.00 65535.00 ECU_ADDRESS 0xD00061EA /end MEASUREMENT
/begin MEASUREMENT OS_cnt100msTask "Raster-Zähler für diese Task" UWORD OneToOne 1 100 0.00 65535.00 ECU_ADDRESS 0xD00061E6 /end MEASUREMENT
/begin MEASUREMENT OS_cnt10msTask "Raster-Zähler für diese Task" UWORD OneToOne 1 100 0.00 65535.00 ECU_ADDRESS 0xD00061E2 /end MEASUREMENT
/begin MEASUREMENT OS_cnt1msTask "Raster-Zähler für diese Task" UWORD OneToOne 1 100 0.00 65535.00 ECU_ADDRESS 0xD00061DC /end MEASUREMENT
/begin MEASUREMENT OS_cnt200msTask "Raster-Zähler für diese Task" UWORD OneToOne 1 100 0.00 65535.00 ECU_ADDRESS 0xD00061E8 /end MEASUREMENT
/begin MEASUREMENT OS_cnt20msTask "Raster-Zähler für diese Task" UWORD OneToOne 1 100 0.00 65535.00 ECU_ADDRESS 0xD00061E4 /end MEASUREMENT
/begin MEASUREMENT OS_cnt2msTask "Raster-Zähler für diese Task" UWORD OneToOne 1 100 0.00 65535.00 ECU_ADDRESS 0xD00061DE /end MEASUREMENT
/begin MEASUREMENT OS_cnt5msTask "Raster-Zähler für diese Task" UWORD OneToOne 1 100 0.00 65535.00 ECU_ADDRESS 0xD00061E0 /end MEASUREMENT
/begin MEASUREMENT OS_cntBgTask "Raster-Zähler für diese Task" UWORD OneToOne 1 100 0.00 65535.00 ECU_ADDRESS 0xD00061DA /end MEASUREMENT
/begin MEASUREMENT OS_cntDsmClearTask "Raster-Zähler für diese Task" UWORD OneToOne 1 100 0.00 65535.00 ECU_ADDRESS 0xD00061EC /end MEASUREMENT
/begin MEASUREMENT OS_cntEngReStrtTask "Raster-Zähler für diese Task" UWORD OneToOne 1 100 0.00 65535.00 ECU_ADDRESS 0xD00061F0 /end MEASUREMENT
/begin MEASUREMENT OS_cntEpmNoSyncTask "Raster-Zähler für diese Task" UWORD OneToOne 1 100 0.00 65535.00 ECU_ADDRESS 0xD00061FC /end MEASUREMENT
/begin MEASUREMENT OS_cntIniEndTask "Raster-Zähler für diese Task" UWORD OneToOne 1 100 0.00 65535.00 ECU_ADDRESS 0xD00061D8 /end MEASUREMENT
/begin MEASUREMENT OS_cntIniTask "Raster-Zähler für diese Task" UWORD OneToOne 1 100 0.00 65535.00 ECU_ADDRESS 0xD00061D6 /end MEASUREMENT
/begin MEASUREMENT OS_cntMoTask "Raster-Zähler für diese Task" UWORD OneToOne 1 100 0.00 65535.00 ECU_ADDRESS 0xD00061FE /end MEASUREMENT
/begin MEASUREMENT OS_cntSyncDummyTask "Raster-Zähler für diese Task" UWORD OneToOne 1 100 0.00 65535.00 ECU_ADDRESS 0xD00061FA /end MEASUREMENT
/begin MEASUREMENT OS_cntSyncFirstTask "Raster-Zähler für diese Task" UWORD OneToOne 1 100 0.00 65535.00 ECU_ADDRESS 0xD00061F2 /end MEASUREMENT
/begin MEASUREMENT OS_cntSyncIni "Raster-Zähler für diese Task" UWORD OneToOne 1 100 0.00 65535.00 ECU_ADDRESS 0xD00061EE /end MEASUREMENT
/begin MEASUREMENT OS_cntSyncPostTask "Raster-Zähler für diese Task" UWORD OneToOne 1 100 0.00 65535.00 ECU_ADDRESS 0xD00061F6 /end MEASUREMENT
/begin MEASUREMENT OS_cntSyncPreTask "Raster-Zähler für diese Task" UWORD OneToOne 1 100 0.00 65535.00 ECU_ADDRESS 0xD00061F4 /end MEASUREMENT
/begin MEASUREMENT OS_cntSyncSchedTask "Raster-Zähler für diese Task" UWORD OneToOne 1 100 0.00 65535.00 ECU_ADDRESS 0xD00061F8 /end MEASUREMENT
/begin MEASUREMENT OS_ErrCtr_accessResource_u8 "Fehler im Zusammenhang mit ERCOSEK-Resourcen, jedoch werden ERCOSEK-Resourcen in MEDC17 nicht verwendet." UBYTE OneToOne 1 100 0.00 255.0 ECU_ADDRESS 0xC0006384 /end MEASUREMENT
/begin MEASUREMENT OS_ErrCtr_callevel_u8 "Kann vorkommen, wenn eine ERCOSEK-Funktion von einer ISR illegal aufgerufen wird." UBYTE OneToOne 1 100 0.00 255.0 ECU_ADDRESS 0xC0006385 /end MEASUREMENT
/begin MEASUREMENT OS_ErrCtr_deadline_u8 "Kann in der MEDC17 nicht vorkommen, da eine andere Deadlineüberwachung aus der Systemsteuerung verwendet wird." UBYTE OneToOne 1 100 0.00 255.0 ECU_ADDRESS 0xC000638C /end MEASUREMENT
/begin MEASUREMENT OS_ErrCtr_default_u8 "Ein unbekannter Fehler im OS ist aufgetreten." UBYTE OneToOne 1 100 0.00 255.0 ECU_ADDRESS 0xC000638B /end MEASUREMENT
/begin MEASUREMENT OS_ErrCtr_generalError_u8 "Nach Aussage ETAS kann dieser Fehlerkode nicht auftreten." UBYTE OneToOne 1 100 0.00 255.0 ECU_ADDRESS 0xC000638A /end MEASUREMENT
/begin MEASUREMENT OS_ErrCtr_idValue_u8 "Alaram ID oder Wert für einen Zyklus/Delay für einen Alarm ist falsch." UBYTE OneToOne 1 100 0.00 255.0 ECU_ADDRESS 0xC0006386 /end MEASUREMENT
/begin MEASUREMENT OS_ErrCtr_limit_u8 "Passiert z.B. dann in ActivateTask, wenn eine noch laufende Task wieder gestartet wird." UBYTE OneToOne 1 100 0.00 255.0 ECU_ADDRESS 0xC0006387 /end MEASUREMENT
/begin MEASUREMENT OS_ErrCtr_noFuncState_u8 "Kann z.B. in CancelAlarm passieren, wenn der Alarm nicht aktiv war oder eine aktiver Alarm nochmal gestartet wird." UBYTE OneToOne 1 100 0.00 255.0 ECU_ADDRESS 0xC0006388 /end MEASUREMENT
/begin MEASUREMENT OS_ErrCtr_stackcnt_u8 "Der User- oder Ercosek-Stack hat einen Über- oder Unterlauf." UBYTE OneToOne 1 100 0.00 255.0 ECU_ADDRESS 0xC000638D /end MEASUREMENT
/begin MEASUREMENT OS_ErrCtr_stackstat_u8 "Detail-Info, wenn ein Stacküberlauf/Unterlauf passiert." UBYTE OneToOne 1 100 0.00 255.0 ECU_ADDRESS 0xC000638E /end MEASUREMENT
/begin MEASUREMENT OS_ErrCtr_sum_u8 "Summe aller möglichen Fehlerzähler. Kann zum Erkennen, ob überhaupt ein Fehler vorliegt, verwendet werden." UBYTE OneToOne 1 100 0.00 255.0 ECU_ADDRESS 0xC000638F /end MEASUREMENT
/begin MEASUREMENT OS_ErrCtr_timetable_u8 "Kann z.B. passieren, wenn eine nicht vorhandene Timetable oder eine schon aktive Timetable aktiviert wird." UBYTE OneToOne 1 100 0.00 255.0 ECU_ADDRESS 0xC0006389 /end MEASUREMENT
/begin MEASUREMENT Oz_tempakt "Ausgabe Öltemperatur für den Tester" SWORD Def_t_sw_q0p1 1 100 -3276.8 3276.7 FORMAT "%6.1" ECU_ADDRESS 0xC000A606 /end MEASUREMENT
/begin MEASUREMENT Pekp "Leistung EKP (U*I)" UWORD Def_lst_uw_q0p1 1 100 0.00 6553.5 FORMAT "%6.1" ECU_ADDRESS 0xC000A5B6 /end MEASUREMENT
/begin MEASUREMENT Stmsa "Status MSA und Funktionsabschalter" ULONG Def_dez_ul_q1 1 100 0.00 4294967295. FORMAT "%7.0" ECU_ADDRESS 0xC0009128 /end MEASUREMENT
/begin MEASUREMENT Stmsaaa "Status MSA Auschaltaufforderer" ULONG Def_dez_ul_q1 1 100 0.00 4294967295. FORMAT "%7.0" ECU_ADDRESS 0xC000912C /end MEASUREMENT
/begin MEASUREMENT Stmsaav "Status MSA aktiv und bereit und Abschaltverhinderer" ULONG Def_dez_ul_q1 1 100 0.00 4294967295. FORMAT "%7.0" ECU_ADDRESS 0xC0009130 /end MEASUREMENT
/begin MEASUREMENT Stmsaea "Status MSA Einschaltaufforderer" ULONG Def_dez_ul_q1 1 100 0.00 4294967295. FORMAT "%7.0" ECU_ADDRESS 0xC0009134 /end MEASUREMENT
/begin MEASUREMENT Stmsaev "Status MSA Einschaltverhinderer" ULONG Def_dez_ul_q1 1 100 0.00 4294967295. FORMAT "%7.0" ECU_ADDRESS 0xC0009138 /end MEASUREMENT
/begin MEASUREMENT St_dfh0 "Statuswort" UBYTE Def_st_ub_q1 1 100 0.00 255. FORMAT "%3.0" ECU_ADDRESS 0xC000B3A1 /end MEASUREMENT
/begin MEASUREMENT St_dfh1 "Statuswort" UBYTE Def_st_ub_q1 1 100 0.00 255. FORMAT "%3.0" ECU_ADDRESS 0xC000B3A2 /end MEASUREMENT
/begin MEASUREMENT St_dfh2 "Statuswort" UBYTE Def_st_ub_q1 1 100 0.00 255. FORMAT "%3.0" ECU_ADDRESS 0xC000B3A3 /end MEASUREMENT
/begin MEASUREMENT St_msaa "Statuswort" UBYTE Def_st_ub_q1 1 100 0.00 255. FORMAT "%3.0" ECU_ADDRESS 0xC000B39A /end MEASUREMENT
/begin MEASUREMENT St_msaaa "Statuswort" UBYTE Def_st_ub_q1 1 100 0.00 255. FORMAT "%3.0" ECU_ADDRESS 0xC000B398 /end MEASUREMENT
/begin MEASUREMENT St_msaaad "Statuswort" UWORD Def_st_uw_q1 1 100 0.00 65535. FORMAT "%5.0" ECU_ADDRESS 0xC000A564 /end MEASUREMENT
/begin MEASUREMENT St_msaanz "Statuswort" UWORD Def_st_uw_q1 1 100 0.00 65535. FORMAT "%5.0" ECU_ADDRESS 0xC000A570 /end MEASUREMENT
/begin MEASUREMENT St_msaav "Statuswort" UBYTE Def_st_ub_q1 1 100 0.00 255. FORMAT "%3.0" ECU_ADDRESS 0xC000B399 /end MEASUREMENT
/begin MEASUREMENT St_msaavd "Hier könnte Ihr Langbezeichner stehen" ULONG Def_dez_ul_q1 1 100 0.00 4294967295. FORMAT "%7.0" ECU_ADDRESS 0xC0009120 /end MEASUREMENT
/begin MEASUREMENT St_msaavd1 "Statuswort" UWORD Def_st_uw_q1 1 100 0.00 65535. FORMAT "%5.0" ECU_ADDRESS 0xC000A566 /end MEASUREMENT
/begin MEASUREMENT St_msaavd2 "Statuswort" UWORD Def_st_uw_q1 1 100 0.00 65535. FORMAT "%5.0" ECU_ADDRESS 0xC000A568 /end MEASUREMENT
/begin MEASUREMENT St_msaavf "AVs über Diagnose filtriert" ULONG Def_dez_ul_q1 1 100 0.00 4294967295. FORMAT "%7.0" ECU_ADDRESS 0xC0009124 /end MEASUREMENT
/begin MEASUREMENT St_msabs "Statuswort" UBYTE Def_st_ub_q1 1 100 0.00 255. FORMAT "%3.0" ECU_ADDRESS 0xC000B39B /end MEASUREMENT
/begin MEASUREMENT St_msabsd "Statuswort" UWORD Def_st_uw_q1 1 100 0.00 65535. FORMAT "%5.0" ECU_ADDRESS 0xC000A572 /end MEASUREMENT
/begin MEASUREMENT St_msabsd_2 "Statuswort" UWORD Def_st_uw_q1 1 100 0.00 65535. FORMAT "%5.0" ECU_ADDRESS 0xC000A574 /end MEASUREMENT
/begin MEASUREMENT St_msaea "Statuswort" UBYTE Def_st_ub_q1 1 100 0.00 255. FORMAT "%3.0" ECU_ADDRESS 0xC000B39C /end MEASUREMENT
/begin MEASUREMENT St_msaead "Statuswort" UWORD Def_st_uw_q1 1 100 0.00 65535. FORMAT "%5.0" ECU_ADDRESS 0xC000A576 /end MEASUREMENT
/begin MEASUREMENT St_msaev "Statuswort" UBYTE Def_st_ub_q1 1 100 0.00 255. FORMAT "%3.0" ECU_ADDRESS 0xC000B39D /end MEASUREMENT
/begin MEASUREMENT St_msaevd "Statuswort" UWORD Def_st_uw_q1 1 100 0.00 65535. FORMAT "%5.0" ECU_ADDRESS 0xC000A578 /end MEASUREMENT
/begin MEASUREMENT St_ngang "Status Nullgangerkennung" UBYTE Def_dez_ub_q1 1 100 0.00 255. FORMAT "%3.0" ECU_ADDRESS 0xC000B3A4 /end MEASUREMENT
/begin MEASUREMENT St_ngang0 "Statuswort" UBYTE Def_st_ub_q1 1 100 0.00 255. FORMAT "%3.0" ECU_ADDRESS 0xC000B3A5 /end MEASUREMENT
/begin MEASUREMENT St_ozbg0 "Statuswort" UBYTE Def_st_ub_q1 1 100 0.00 255. FORMAT "%3.0" ECU_ADDRESS 0xC000B3C8 /end MEASUREMENT
/begin MEASUREMENT Toel "Ausgabewert Motoröltemperatur für LoCAN" SWORD Def_t_sw_q0p1 1 100 -3276.8 3276.7 FORMAT "%6.1" ECU_ADDRESS 0xC000A608 /end MEASUREMENT
/begin MEASUREMENT Tvneutral "Nullgang-Position" UWORD Def_tv_uw_q0p01 1 100 0.00 655.350 FORMAT "%7.3" ECU_ADDRESS 0xC000A5B8 /end MEASUREMENT
/begin MEASUREMENT Tvngangalt "Nullgangsensor alte Position für die Signal-Stabilitätskontrolle" UWORD Def_tv_uw_q0p01 1 100 0.00 655.350 FORMAT "%7.3" ECU_ADDRESS 0xC000A5BA /end MEASUREMENT
/begin FUNCTION MoFMode_Co ""
 /begin DEF_CHARACTERISTIC MoFMode_ctDebPoI1Err1_C MoFMode_ctDebPoI1Err2_C MoFMode_ctDebPoI2Err1_C MoFMode_ctDebPoI2Err2_C MoFMode_ctDiag1PoI1_C MoFMode_ctDiag1PoI2_C MoFMode_ctDiag2PoI1_C MoFMode_ctDiag2PoI2_C MoFMode_ctRst_C MoFMode_dFacPoI1MaxNeg_CUR MoFMode_dFacPoI1MaxPos_CUR MoFMode_dFacPoI2MaxNeg_CUR MoFMode_dFacPoI2MaxPos_CUR MoFMode_fac1PoI1Eff_MAP MoFMode_fac1PoI2Eff_MAP MoFMode_fac2PoI1Eff_CUR MoFMode_fac2PoI2Eff_CUR MoFMode_fac3PoI1Eff_MAP MoFMode_fac3PoI2Eff_MAP MoFMode_fac4PoI1Eff_CUR MoFMode_fac4PoI2Eff_CUR MoFMode_nEngMax1_C MoFMode_nEngMax2_C MoFMode_nEngMin1_C MoFMode_nEngMin2_C MoFMode_qPoI1Thresh_C MoFMode_qPoI2Thresh_C MoFMode_stOpModeMsk1_C MoFMode_stOpModeMsk2_C MoFMode_swtPoI1Eff_C MoFMode_swtPoI2Eff_C MoFMode_trqInrSetMax1_C MoFMode_trqInrSetMax2_C MoFMode_trqInrSetMin1_C MoFMode_trqInrSetMin2_C /end DEF_CHARACTERISTIC
 /begin IN_MEASUREMENT CoEOM_stOpModeAct CoEOM_stTransActv MoFCoOfs_rTrqPtdOfs MoFESpd_nEng MoFInjDat_facPoI1EffSet MoFInjDat_facPoI2EffSet MoFInjDat_p MoFInjDat_phiPoI1 MoFInjDat_phiPoI2 MoFInjDat_tiMI1PoI1 MoFInjDat_tiMI1PoI2 MoFInjQnt_qPiI2Cor MoFInjQnt_qPiI3Cor MoFQntCor_qMI1 MoFQntCor_qPiI1 MoFQntCor_qPoI1 MoFQntCor_qPoI2 Mo_ctRst Mo_stCplChk Mo_stICOMsg Mo_stMoC Mo_stMoF PthSet_trqInrSet /end IN_MEASUREMENT
 /begin OUT_MEASUREMENT MoFMode_qSetUnBal MoFMode_st MoFMode_stOpModeMsg /end OUT_MEASUREMENT
 /begin LOC_MEASUREMENT MoFMode_ctDebPoI1Err MoFMode_ctDebPoI2Err MoFMode_ctDiagPoI1 MoFMode_ctDiagPoI2 MoFMode_fac1PoI1Eff_mp MoFMode_fac1PoI2Eff_mp MoFMode_fac2PoI1Eff_mp MoFMode_fac2PoI2Eff_mp MoFMode_fac3PoI1Eff_mp MoFMode_fac3PoI2Eff_mp MoFMode_fac4PoI1Eff_mp MoFMode_fac4PoI2Eff_mp MoFMode_facPoI1EffRaw_mp MoFMode_facPoI1Eff_mp MoFMode_facPoI2EffRaw_mp MoFMode_facPoI2Eff_mp MoFMode_qPoI1Eff_mp MoFMode_qSumPiIMIPoI2_mp MoFMode_qSumPiIMI_mp MoFMode_stCmp1_mp MoFMode_stCmp2_mp MoFMode_stErrEOM_mp MoFMode_stIrvErr1PoI1 MoFMode_stIrvErr1PoI2 MoFMode_stIrvErr2PoI1 MoFMode_stIrvErr2PoI2 /end LOC_MEASUREMENT
/end FUNCTION
/begin FUNCTION MoFOvR_Co ""
 /begin DEF_CHARACTERISTIC MoFOvR_ctDebASDdc_C MoFOvR_ctDebETDef_C MoFOvR_ctRst_C MoFOvR_nEngOff_C MoFOvR_nSpdGovLim_C MoFOvR_nStrtEnd_C MoFOvR_tiACCBrkRmp_C MoFOvR_tiAPPFlt_C MoFOvR_tiCrCtlBrkRmp_C MoFOvR_tiEngSpdRlsBrkRmp_C MoFOvR_tiLimET_CUR /end DEF_CHARACTERISTIC
 /begin IN_MEASUREMENT ACCI_stInActv APP_r Brk_st Com_bRecACC CrCtl_stReq MoExe_ctCyc MoFBrk_st MoFClth_st MoFCoVeh_rTrqComp MoFDCS_stDem MoFDrDem_rAPP MoFESpd_nEng MoFETC_stTst MoFInjDat_tiTDCAvrg MoFSpdG_stDem MoFTra_stDem Mo_ctRst Mo_stCplChk Mo_stICOMsg Mo_stMoC Mo_stMoF PthSet_trqSetASDdc SpdGov_trqSet /end IN_MEASUREMENT
 /begin OUT_MEASUREMENT MoFOvR_ctDebET MoFOvR_stActvMsg MoFOvR_stRls /end OUT_MEASUREMENT
 /begin LOC_MEASUREMENT MoFOvR_ctDebACCBrk MoFOvR_ctDebAPP MoFOvR_ctDebASDdc MoFOvR_ctDebASDdcL1 MoFOvR_ctDebBrk MoFOvR_ctDiag MoFOvR_ctEngSpd MoFOvR_stIrvErr MoFOvR_stTst MoFOvR_tiLimET_mp /end LOC_MEASUREMENT
/end FUNCTION
/begin FUNCTION MoFQntCor_Co ""
 /begin DEF_CHARACTERISTIC MoFQntCor_ctDebErr_C MoFQntCor_ctRst_C MoFQntCor_facFTSWCor_MAP MoFQntCor_facPiI2WvCor_C MoFQntCor_facPoI1WvCor_C MoFQntCor_facWvCor1_MAP MoFQntCor_facWvCor2_MAP MoFQntCor_qMI1DeltaMax_C MoFQntCor_qPiI1DeltaMax_C MoFQntCor_qPoI1DeltaMax_C MoFQntCor_qPoI2DeltaMax_C MoFQntCor_qWvCor1_MAP MoFQntCor_qWvCor2_MAP MoFQntCor_qWvCorMax_C MoFQntCor_qWvCorMin_C MoFQntCor_qWvCorNorm_CUR MoFQntCor_tiDiffHyd_MAP /end DEF_CHARACTERISTIC
 /begin IN_MEASUREMENT MoFInjDat_p MoFInjDat_qMI1WvCor MoFInjDat_qPiI1WvCor MoFInjDat_qPoI1WvCor MoFInjDat_qPoI2WvCor MoFInjDat_tCor MoFInjDat_tiMI1PoI2 MoFInjDat_tiPiI1MI1 MoFInjDat_tiPiI2MI1 MoFInjDat_tiPiI2PiI1 MoFInjDat_tiPoI2PoI1 MoFInjQnt_qMI1Cor MoFInjQnt_qPiI1Cor MoFInjQnt_qPiI2Cor MoFInjQnt_qPoI1Cor MoFInjQnt_qPoI2Cor Mo_ctRst Mo_stCplChk Mo_stICOMsg Mo_stMoC Mo_stMoF /end IN_MEASUREMENT
 /begin OUT_MEASUREMENT MoFQntCor_ctDebErr MoFQntCor_qMI1 MoFQntCor_qPiI1 MoFQntCor_qPoI1 MoFQntCor_qPoI2 /end OUT_MEASUREMENT
 /begin LOC_MEASUREMENT MoFQntCor_ctDiag MoFQntCor_facWvPoI2PoI1_mp MoFQntCor_qPiI1WvCor_mp MoFQntCor_qPoI1WvCor_mp MoFQntCor_qPoI2WvCor_mp MoFQntCor_qWvCor2_mp MoFQntCor_qWvCorMI1PiI1_mp MoFQntCor_qWvCorMI1PiI2_mp MoFQntCor_qWvCorMI1_mp MoFQntCor_qWvCorPiI1PiI2_mp MoFQntCor_qWvPoI2PoI1_mp MoFQntCor_rQMI1_mp MoFQntCor_rQPoI2_mp MoFQntCor_stInj MoFQntCor_stIrvErr MoFQntCor_stMI1ErrAct_mp MoFQntCor_stPiI1ErrAct_mp MoFQntCor_stPoI1ErrAct_mp MoFQntCor_stPoI2ErrAct_mp MoFQntCor_tiMI1PoI2Cor_mp MoFQntCor_tiPiI1MI1Cor_mp MoFQntCor_tiPiI2Hyd_mp MoFQntCor_tiPoI2PoI1Cor_mp /end LOC_MEASUREMENT
/end FUNCTION
/begin FUNCTION MoFRailP_Co ""
 /begin DEF_CHARACTERISTIC MoFRailP_ctDebErr_C MoFRailP_ctDebGradMax_C MoFRailP_ctRst_C MoFRailP_pDefMax_C MoFRailP_pDefMin_C /end DEF_CHARACTERISTIC
 /begin IN_MEASUREMENT MoFInjDat_stPressSRC Mo_stCplChk Mo_stICOMsg Mo_stMoC Mo_stMoF RailP_pFlt RailP_stGrad Rail_pSetPoint /end IN_MEASUREMENT
 /begin OUT_MEASUREMENT MoFRailP_p MoFRailP_stGradErr /end OUT_MEASUREMENT
 /begin LOC_MEASUREMENT MoFRailP_ctDebErr MoFRailP_ctDebGradMax MoFRailP_ctDiag MoFRailP_stIrvErr /end LOC_MEASUREMENT
/end FUNCTION
/begin FUNCTION MoFSpdG_Co ""
 /begin DEF_CHARACTERISTIC MoFSpdG_ctDKGTurnOffDelay_C MoFSpdG_ctGSHRmp_C MoFSpdG_ctNDemMax_C MoFSpdG_rTrqMax_MAP MoFSpdG_rTrqPtd_MAP MoFSpdG_stAGSDemStActive_C MoFSpdG_stSpdGDem_C /end DEF_CHARACTERISTIC
 /begin REF_CHARACTERISTIC Mo_trqIdcMax_C /end REF_CHARACTERISTIC
 /begin IN_MEASUREMENT MoFBrk_st MoFClth_st MoFDrDem_trqOvrRun MoFESpd_nEng MoFInjDat_trqSpdG MoFTEng_tEng MoFTra_stDem Mo_stCplChk Mo_stMoC /end IN_MEASUREMENT
 /begin OUT_MEASUREMENT MoFSpdG_rTrq MoFSpdG_stDem /end OUT_MEASUREMENT
 /begin LOC_MEASUREMENT MoFSpdG_ctDel MoFSpdG_ctDKGTurnOffDelay MoFSpdG_ctNDem MoFSpdG_stDKGActiv_mp MoFSpdG_stFF MoFSpdG_stGSHActv MoFSpdG_trq_mp /end LOC_MEASUREMENT
/end FUNCTION
/begin FUNCTION MoFSrv_Lib "" /end FUNCTION
/begin FUNCTION MoFTEng_Co ""
 /begin DEF_CHARACTERISTIC MoFTEng_nEngOff_C MoFTEng_nStrtEnd_C MoFTEng_tiMinTempIni_CUR MoFTEng_tiMinTempMax_C MoFTEng_tiMinTempMin_C MoFTEng_tMin_CUR /end DEF_CHARACTERISTIC
 /begin IN_MEASUREMENT EngDa_tEng MoFESpd_nEng MoFTrqAct_st Mo_stCplChk Mo_stMoC /end IN_MEASUREMENT
 /begin OUT_MEASUREMENT MoFTEng_tEng MoFTEng_tiAftStrt /end OUT_MEASUREMENT
 /begin LOC_MEASUREMENT MoFTEng_tiMinTemp MoFTEng_tiMinTemp_mp /end LOC_MEASUREMENT
/end FUNCTION
/begin FUNCTION MoFTra_Co "" /begin DEF_CHARACTERISTIC MoFTra_swtTraType_C /end DEF_CHARACTERISTIC /begin REF_CHARACTERISTIC MoFSpdG_stSpdGDem_C /end REF_CHARACTERISTIC
 /begin IN_MEASUREMENT Com_stTrqGbxDes Com_trqGbxFrc Gbx_trqTIIDes Mo_stCplChk Mo_stMoC /end IN_MEASUREMENT
 /begin OUT_MEASUREMENT MoFTra_stDem MoFTra_stIrvErr MoFTra_trqDem MoFTra_trqGbxFrc /end OUT_MEASUREMENT
/end FUNCTION
/begin FUNCTION MoFTrqCmp_Co "" /begin DEF_CHARACTERISTIC MoFTrqCmp_ctDeb_C MoFTrqCmp_ctRst_C /end DEF_CHARACTERISTIC
 /begin IN_MEASUREMENT MoFCoOfs_rTrqPtdOfs MoFETC_stTst MoFOvR_stRls MoFTrqIdc_rTrq Mo_ctRst Mo_stCplChk Mo_stICOMsg Mo_stMoC Mo_stMoF /end IN_MEASUREMENT
 /begin OUT_MEASUREMENT MoFTrqCmp_ctDeb MoFTrqCmp_stIrvErr /end OUT_MEASUREMENT
 /begin LOC_MEASUREMENT MoFTrqCmp_ctDiag MoFTrqCmp_stTst /end LOC_MEASUREMENT
/end FUNCTION
/begin FUNCTION MoFTrqIdc_Co ""
 /begin DEF_CHARACTERISTIC MoFTrqIdc_facAdjSrvDfl_C MoFTrqIdc_facAdjSrvMax_C MoFTrqIdc_facAdjSrvMin_C MoFTrqIdc_facEtaCorMax_C MoFTrqIdc_facEtaCorMin_C MoFTrqIdc_q2trq2_MAP MoFTrqIdc_q2trq3_MAP MoFTrqIdc_q2trq_MAP MoFTrqIdc_qAdjQntMax_C MoFTrqIdc_qAdjQntMin_C MoFTrqIdc_qDriftMax_C MoFTrqIdc_qDriftMin_C /end DEF_CHARACTERISTIC
 /begin REF_CHARACTERISTIC Mo_trqIdcMax_C /end REF_CHARACTERISTIC
 /begin IN_MEASUREMENT MoFESpd_nEng MoFInjDat_facEtaCor MoFInjDat_facEtaCorNxt MoFInjDat_qAdjQnt MoFInjDat_qDriftLim2 MoFMode_qSetUnBal MoFMode_st Mo_stCplChk Mo_stMoC /end IN_MEASUREMENT
 /begin OUT_MEASUREMENT MoFTrqAct_st MoFTrqIdc_rTrq /end OUT_MEASUREMENT
 /begin LOC_MEASUREMENT MoFTrqIdc_facAdjSrvCpl_mp MoFTrqIdc_facAdjSrv_mp MoFTrqIdc_facEtaCor_mp MoFTrqIdc_qSetUnBal_mp MoFTrqIdc_rQ2Trq_mp MoFTrqIdc_trqIdc_mp /end LOC_MEASUREMENT
/end FUNCTION
/begin FUNCTION MoFVSS_Co "" /begin IN_MEASUREMENT Mo_stMoC VehV_v /end IN_MEASUREMENT /begin OUT_MEASUREMENT MoFVSS_v /end OUT_MEASUREMENT /end FUNCTION
/begin FUNCTION Mo_Glbl "" /begin DEF_CHARACTERISTIC Mo_trqIdcMax_C /end DEF_CHARACTERISTIC
 /begin OUT_MEASUREMENT Mo_ctRst Mo_stCplChk Mo_stICOMsg Mo_stIrvErrReacMsg Mo_stMoC Mo_stMoF /end OUT_MEASUREMENT
 /begin LOC_MEASUREMENT Mo_bCplChk Mo_bICOL1 Mo_bICOL2 Mo_bLimpHom Mo_bLowVltg Mo_bRamErr Mo_bRomErr /end LOC_MEASUREMENT
/end FUNCTION
/begin FUNCTION MRly_ShOff "" /end FUNCTION
/begin FUNCTION MRly_VD ""
 /begin DEF_CHARACTERISTIC MRly_ctErlyOpng_C MRly_tiBattVltgFlt_C MRly_tiStkRlyDiaDel_C MRly_uStblThr_C MRly_uStkRlyBattThr_C /end DEF_CHARACTERISTIC
 /begin IN_MEASUREMENT BattU_u /end IN_MEASUREMENT
 /begin OUT_MEASUREMENT MRly_st MRly_stAct /end OUT_MEASUREMENT
 /begin LOC_MEASUREMENT MRly_ctErlyOpng_mp MRly_stStkRlytst_mp MRly_stStkRly_mp MRly_uBattFlt_mp /end LOC_MEASUREMENT
/end FUNCTION
/begin FUNCTION msaa ""
 /begin DEF_CHARACTERISTIC K_MSAAAMASKE K_MSAAVMASKE K_MSAAVRSM K_MSAAVSW K_MSABRAV K_MSADPFREG K_MSAFAKF K_MSALENK K_MSAMINMLZ K_MSANKWMAX K_MSAPWGA K_MSATANK K_MSATKAT K_MSATMOT K_MSATUMGO K_MSATUMGU K_MSAVA K_MSAVERLENK K_MSAVFTMH K_MSAVOK /end DEF_CHARACTERISTIC
 /begin OUT_MEASUREMENT Msa_arravrs Msa_avrs Msa_indexrs St_msaaa St_msaaad St_msaav St_msaavd St_msaavd1 St_msaavd2 St_msaavf /end OUT_MEASUREMENT
/end FUNCTION
/begin FUNCTION msabs ""
 /begin DEF_CHARACTERISTIC K_MSABSMASKE K_MSACCMASKE K_MSADVKS K_MSANKS K_MSANST S_MSABS /end DEF_CHARACTERISTIC
 /begin OUT_MEASUREMENT Msastz Msastzmsa Msa_vstart Stmsa Stmsaaa Stmsaav Stmsaea Stmsaev St_msaa St_msaanz St_msabs St_msabsd St_msabsd_2 /end OUT_MEASUREMENT
/end FUNCTION
/begin FUNCTION msae ""
 /begin DEF_CHARACTERISTIC K_MSAEVMASKE K_MSAMANTD K_MSANSTTOV K_MSAPBREMSU K_MSAPWGE K_MSASTTO K_MSASTTOV K_MSAVE S_KLMSAEA S_KUPMSAEV S_MSAEASNG S_PMMSAEA /end DEF_CHARACTERISTIC
 /begin OUT_MEASUREMENT St_msaea St_msaead St_msaev St_msaevd /end OUT_MEASUREMENT
/end FUNCTION
/begin FUNCTION Msc "" /end FUNCTION
/begin FUNCTION ndrm ""
 /begin DEF_CHARACTERISTIC KF_DFHRF KF_DFHRFK KF_DFHRFMAX KF_DFHRFMAXK KF_DFHTHRES KF_DFHUDELTA KF_NDRBAS KF_NDRPEKPMAX KF_NDRPEKPMAXDFHON KL_NDRDELTAMAX KL_NDRDT1 KL_NDRINT KL_NDRPROP KL_NDRTKST KL_NDR_A_ABS K_DFHCHECK K_DFHCNTMAX K_DFHDANZMAX K_DFHINIT K_DFHKFDP K_DFHKFPEKP K_DFHKFPW K_DFHLERNCNTMIN K_DFHLLVERZ K_DFHLRHEAT K_DFHLTMIN K_DFHLTRIG K_DFHLVERZ K_DFHMAXANZ K_DFHMINKM K_DFHMKD K_DFHNKWD K_DFHNMAXDIAG K_DFHNOFFO K_DFHNOFFU K_DFHQMAX K_DFHSTATECNTMAX K_DFHSW K_DFHTCHECK K_DFHTKSTF K_DFHTMAXOFFL K_DFHTMAXOFFR K_DFHTMAXONL K_DFHTMAXONR K_DFHTONMAX K_DFHTWAIT K_DFHUB K_DFHVERST K_DFHVERZOFF K_DFHVERZON K_DFHVERZUB K_DFHVOLTANKMIN K_FSPNEKPFILTMIN K_FSPTKSTMIN K_FSPTMOTMIN K_FSPUBMIN K_FSPUEKPMIN K_FSPVERZON K_MINDIVDT1 K_NDRDELTAMAXDFHON K_NDRDIAGVERZ K_NDRDT1MAX K_NDRDT1MIN K_NDRDT1T K_NDRFMASK_1 K_NDRFMASK_2 K_NDRFMCC_1 K_NDRFMCC_2 K_NDRINTINI K_NDRMAX K_NDRMIN K_NDRMNRA K_NDRMNRADFHON K_NDRMPRA K_NDRMPRADFHON K_NDRNMIN K_NDROFF K_NDROUTDEF K_NDROUTMIN K_NDRPHDPMAX K_NDRPSOLLMAX K_NDRREGDIAGTON K_NDRSTARTOUT S_DFHCCF S_DFHDIAG2UNPLAUS S_DFHMINKM S_DFHSTATE S_NDRPABS /end DEF_CHARACTERISTIC
 /begin IN_MEASUREMENT A_quer_abs Dfh_nekpfilt Mk_soll_omar Nkw Phdp Tkst Ub /end IN_MEASUREMENT
 /begin OUT_MEASUREMENT Dfh_anz Dfh_danz Dfh_def Dfh_deltap Dfh_deltapf Dfh_initumin Dfh_lerncnt Dfh_lernpw Dfh_mkold Dfh_nkwold Dfh_ok Dfh_pekpf Dfh_pin Dfh_pinf Dfh_pinfk Dfh_rf Dfh_rfcbs Dfh_rfmax Dfh_thres Dfh_tkst Dfh_umin Ndr_delta Ndr_fsp_1 Ndr_fsp_2 Ndr_int Ndr_out Ndr_outnb Ndr_prop Ndr_propvor Ndr_soll Ndr_tkstaquerbeg Ndr_vor Num_dfhstrg Pekp St_dfh0 St_dfh1 St_dfh2 /end OUT_MEASUREMENT
/end FUNCTION
/begin FUNCTION ngang ""
 /begin DEF_CHARACTERISTIC K_NGMAXLERN K_NGMINLERN K_NGOFFMAX K_NGOFFMAXERW K_NGOFFMIN K_NGOFFMINERW K_NGSP K_NGSTABIL K_NGTK K_NGTSTL S_NGANG /end DEF_CHARACTERISTIC
 /begin OUT_MEASUREMENT St_ngang St_ngang0 Tvneutral Tvngangalt /end OUT_MEASUREMENT
/end FUNCTION
/begin FUNCTION NmNC "" /end FUNCTION
/begin FUNCTION NoCat2Ds_DDLamAcq ""
 /begin DEF_CHARACTERISTIC Exh_HtrDebNoCat2Ds.tiHiLo_C Exh_HtrDebNoCat2Ds.tiLoHi_C Exh_LamDebNoCat2Ds.tiHiLo_C Exh_LamDebNoCat2Ds.tiLoHi_C Exh_rLamBinNoCat2Ds_CUR Exh_rLamLeanLimNoCat2Ds_C Exh_rO2LinNoCat2Ds_CUR Exh_swtNoCat2Ds_C Exh_tiLamLeanNoCat2DsDeb.tiHiLo_C Exh_tiLamLeanNoCat2DsDeb.tiLoHi_C Exh_tiPT1NoCat2Ds_C Exh_uLamLeanLimNoCat2Ds_C /end DEF_CHARACTERISTIC
 /begin IN_MEASUREMENT Com_rLamLinRecCat2Ds Com_stHtrSetPCat2Ds Com_stLamBinVldCat2Ds Com_stLamLinRecVldCat2Ds Com_uLamBinCat2Ds /end IN_MEASUREMENT
 /begin OUT_MEASUREMENT Exh_rLamBinNoCat2Ds Exh_rLamLinNoCat2Ds Exh_rO2LinNoCat2Ds Exh_stDebHtrSetPNoCat2Ds Exh_stLamLeanNoCat2Ds Exh_stLamVldNoCat2Ds Exh_stNOxSensRdyNoCat2Ds Exh_swtNoCat2Ds /end OUT_MEASUREMENT
 /begin LOC_MEASUREMENT Exh_rLamLinRecNoCat2Ds_mp Exh_stDebLamVldNoCat2Ds_mp Exh_stLamVldComNoCat2Ds_mp /end LOC_MEASUREMENT
/end FUNCTION
/begin FUNCTION NoCat2Ds_DDNOxAcq "" /begin DEF_CHARACTERISTIC Exh_rNOxPresCompLeanNoCat2Ds_MAP Exh_tiPT1rNOxNoCat2Ds_C /end DEF_CHARACTERISTIC /begin REF_CHARACTERISTIC Exh_pEGFldNoCat2Ds_C /end REF_CHARACTERISTIC
 /begin IN_MEASUREMENT ASMod_pEGFld Com_rNOxCat2Ds Exh_stLamLeanNoCat2Ds Exh_swtNoCat2Ds /end IN_MEASUREMENT
 /begin OUT_MEASUREMENT Exh_rNOxPresCompNoCat2Ds /end OUT_MEASUREMENT
 /begin LOC_MEASUREMENT Exh_pEGFld1NoCat2Ds_mp Exh_rNOxFltNoCat2Ds_mp /end LOC_MEASUREMENT
/end FUNCTION
/begin FUNCTION NoCat2Ds_VDAdap ""
 /begin DEF_CHARACTERISTIC Exh_d2rInitNoCat2Ds_C Exh_dmAirIKiNoCat2Ds_C Exh_EvalMaxValNoCat2Ds_C Exh_EvalMinValNoCat2Ds_C Exh_facO2LeanNoCat2Ds_CUR Exh_facO2RichNoCat2Ds_CUR Exh_IKiNgvNoCat2Ds_C Exh_IKiPsvNoCat2Ds_C Exh_mAirAdapActvNoCat2Ds_C Exh_pEGFldNoCat2Ds_C Exh_rLamRecNoCat2Ds_CUR Exh_rPIDWinNgvNoCat2Ds_C Exh_rPIDWinPsvNoCat2Ds_C Exh_swtAdapActvNoCat2Ds_C Exh_tiAdapFltInitNoCat2Ds_C Exh_tiAdapFltNoCat2Ds_C Exh_tiEvalFltNoCat2Ds_C Exh_tiEvalInitFltNoCat2Ds_C /end DEF_CHARACTERISTIC
 /begin REF_CHARACTERISTIC Exh_rLamLeanLimNoCat2Ds_C /end REF_CHARACTERISTIC
 /begin IN_MEASUREMENT AFS_dm ASMod_pEGFld CoEng_st Exh_rLamLinNoCat2Ds Exh_rO2LinNoCat2Ds Exh_stNOxSensRdyNoCat2Ds Exh_swtNoCat2Ds PthSet_stOvrRunCoord /end IN_MEASUREMENT
 /begin OUT_MEASUREMENT Exh_drO2AdapNoCat2Ds Exh_mAirAftOvrRunNoCat2Ds Exh_rLamAdapNoCat2Ds Exh_rO2AdapNoCat2Ds Exh_rO2PresCompNoCat2Ds Exh_stAdapNoCat2Ds Exh_swtAdapNoCat2Ds /end OUT_MEASUREMENT
 /begin LOC_MEASUREMENT Exh_d2rO2EvalNoCat2Ds_mp Exh_d2rO2FltNNoCat2Ds_mp Exh_d2rO2FltPNoCat2Ds_mp Exh_d2rO2NoCat2Ds_mp Exh_drO2FltNoCat2Ds_mp Exh_facO2CorNoCat2Ds_mp Exh_facPresCompO2NoCat2Ds_mp Exh_pEGFldNoCat2Ds_mp Exh_rLamRecNoCat2Ds_mp Exh_rO2DvtNoCat2Ds_mp Exh_stAdapActvNoCat2Ds_mp Exh_stChngNoCat2Ds_mp Exh_stHldNoCat2Ds_mp /end LOC_MEASUREMENT
/end FUNCTION
/begin FUNCTION NoCat2Ds_VDHtrCtl ""
 /begin DEF_CHARACTERISTIC Exh_facMolMsNoCat2Ds_CUR Exh_facMolMsNOxNoCat2Ds_C Exh_facNOxOfsAvrgNoCat2Ds_C Exh_HtrDiaNoCat2DsDeb.tiHiLo_C Exh_HtrDiaNoCat2DsDeb.tiLoHi_C Exh_idxDewDetNoCat2Ds_C Exh_idxEGFldNoCat2Ds_C Exh_mNOxOfsTstLimNoCat2Ds_C Exh_nMaxNoCat2Ds_C Exh_nMinNoCat2Ds_C Exh_NOxNoCat2DsDeb.tiHiLo_C Exh_NOxNoCat2DsDeb.tiLoHi_C Exh_rLamOfsTstLimNoCat2Ds_C Exh_rNOxOfsdiffMinNoCat2Ds_C Exh_rNOxOfsMaxNoCat2Ds_C Exh_rNOxOfsMaxVarNoCat2Ds_C Exh_rNOxOfsMinNoCat2Ds_C Exh_swtNOxOfsCorrEnaNoCat2Ds_C Exh_tiAvrgNOxOfsTstNoCat2Ds_C Exh_tiHtgSensMaxNoCat2Ds_C Exh_tiLoHiOfsDebNoCat2Ds_C Exh_tiNOxDlyNoCat2Ds_C Exh_tMaxNoCat2Ds_C Exh_tMinNoCat2Ds_C Exh_uBattMaxNoCat2Ds_C Exh_uBattMinNoCat2Ds_C /end DEF_CHARACTERISTIC
 /begin REF_CHARACTERISTIC Exh_mAirAdapActvNoCat2Ds_C /end REF_CHARACTERISTIC
 /begin IN_MEASUREMENT ASMod_dmEGFld BattU_u Com_stHtrSetPCat2Ds Com_stNOxVldCat2Ds DewDet_stHtgLSU Epm_nEng Exh_mAirAftOvrRunNoCat2Ds Exh_rLamLinNoCat2Ds Exh_rNOxPresCompNoCat2Ds Exh_stLamLeanNoCat2Ds Exh_stNOxSensDiaEnaNoCat2Ds Exh_swtNoCat2Ds Exh_tNoCat2Ds NSCLd_mNOxFld PthSet_stOvrRunCoord T15_st /end IN_MEASUREMENT
 /begin OUT_MEASUREMENT Exh_dmNOxNoCat2Ds Exh_rNOxNoCat2Ds Exh_rNOxOfsAvrgNoCat2Ds Exh_stNOxHtrDiaEnaNoCat2Ds Exh_stNOxNoCat2Ds /end OUT_MEASUREMENT
 /begin LOC_MEASUREMENT Exh_dmNOxEGNoCat2Ds_mp Exh_facMolMsEGNoCat2Ds_mp Exh_rAbsdiffNOxOfsNoCat2Ds_mp Exh_rNOxOfsMaxNoCat2Ds_mp Exh_rNOxOfsMinNoCat2Ds_mp Exh_rNOxOfsNoCat2Ds Exh_stHtrTONoCat2Ds_mp Exh_stNOxOfsCorrEnaNoCat2Ds Exh_stNOxOfsTstActvNoCat2Ds /end LOC_MEASUREMENT
/end FUNCTION
/begin FUNCTION NoCat2Ds_VDLamDia ""
 /begin DEF_CHARACTERISTIC Exh_rLamLinMaxNoCat2Ds_C Exh_rLamLinMinNoCat2Ds_C Exh_rO2LinMaxNoCat2Ds_C Exh_rO2LinMinNoCat2Ds_C Exh_tiDelOvrRunNoCat2Ds_C Exh_uLamBinMaxNoCat2Ds_C Exh_uLamBinMinNoCat2Ds_C /end DEF_CHARACTERISTIC
 /begin IN_MEASUREMENT Com_rLamLinRecCat2Ds Com_stLamBinVldCat2Ds Com_stLamLinRecVldCat2Ds Com_uLamBinCat2Ds Exh_rO2LinNoCat2Ds Exh_stNOxSensDiaEnaNoCat2Ds Exh_swtNoCat2Ds PthSet_stOvrRunCoord /end IN_MEASUREMENT
/end FUNCTION
/begin FUNCTION NoCat2Ds_VDNOxDia ""
 /begin DEF_CHARACTERISTIC Exh_mAirMaxCmpChkNoCat2Ds_C Exh_mAirMinCmpChkNoCat2Ds_C Exh_nMaxCmpChkNoCat2Ds_C Exh_nMaxR2LTstNoCat2Ds_C Exh_nMinCmpChkNoCat2Ds_C Exh_numSensCmpChkNoCat2Ds_CA Exh_qMaxCmpChkNoCat2Ds_C Exh_qMinCmpChkNoCat2Ds_C Exh_rEGRMaxCmpChkNoCat2Ds_C Exh_rEGRMinCmpChkNoCat2Ds_C Exh_rMaxDiffNoCat2Ds_CA Exh_rNOxMaxNoCat2Ds_C Exh_rNOxMinNoCat2Ds_C Exh_rO2MaxVarNoCat2Ds_C Exh_stMskCmpChkO2NoCat2Ds_C Exh_tiDlyCmpChkO2NoCat2Ds_C Exh_tiNOxR2LTstMaxNoCat2Ds_C Exh_tiO2EvalNoCat2Ds_C /end DEF_CHARACTERISTIC
 /begin REF_CHARACTERISTIC Exh_uBattMinNoCat2Ds_C /end REF_CHARACTERISTIC
 /begin IN_MEASUREMENT AFS_mAirPerCyl BattU_u CoEOM_stOpModeAct Com_rNOxCat2Ds Com_stNOxVldCat2Ds Com_stOpCirHtrCat2Ds Com_stOpCirLamBinCat2Ds Com_stOpCirLamLinCat2Ds Com_stOpCirNOxCat2Ds Com_stShCirHtrCat2Ds Com_stShCirLamBinCat2Ds Com_stShCirLamLinCat2Ds Com_stShCirNOxCat2Ds EGRVlv_r Epm_ctCyl Epm_nEng Exh_rO2PresCompNoCat2Ds Exh_stLamLeanNoCat2Ds Exh_stLamVldNoCat2Ds Exh_stNOxHtrDiaEnaNoCat2Ds Exh_stNOxNoCat2Ds Exh_swtNoCat2Ds InjSys_qInrCmb InjSys_stCtlQnt LSU_rO2PresComp LSU_stO2IntValid /end IN_MEASUREMENT
 /begin OUT_MEASUREMENT Exh_rO2NoCat2Ds Exh_rO2NOxNoCat2Ds Exh_stNOxSensDiaEnaNoCat2Ds Exh_stO2NoCat2Ds Exh_stO2NOxNoCat2Ds /end OUT_MEASUREMENT
 /begin LOC_MEASUREMENT Exh_rO2CalcNoCat2Ds_mp Exh_stCmpChkEnaNoCat2Ds_mp Exh_stMaxTExcR2LNoCat2Ds_mp Exh_stNOxREdgNoCat2Ds_mp Exh_stOpModCmpChkNoCat2Ds_mp Exh_stR2LTstActvNoCat2Ds_mp Exh_stStyCondNoCat2Ds_mp /end LOC_MEASUREMENT
/end FUNCTION
/begin FUNCTION NoMCatDs_DDLamAcq ""
 /begin DEF_CHARACTERISTIC Exh_HtrDebNSCDs.tiHiLo_C Exh_HtrDebNSCDs.tiLoHi_C Exh_LamDebNSCDs.tiHiLo_C Exh_LamDebNSCDs.tiLoHi_C Exh_rLamBinNSCDs_CUR Exh_rLamLeanLimNSCDs_C Exh_rO2LinNSCDs_CUR Exh_swtNSCDs_C Exh_tiLamLeanNSCDsDeb.tiHiLo_C Exh_tiLamLeanNSCDsDeb.tiLoHi_C Exh_tiPT1NSCDs_C Exh_uLamLeanLimNSCDs_C /end DEF_CHARACTERISTIC
 /begin IN_MEASUREMENT Com_rLamLinRecDs Com_stHtrSetPDs Com_stLamBinVldDs Com_stLamLinRecVldDs Com_uLamBinDs /end IN_MEASUREMENT
 /begin OUT_MEASUREMENT Exh_rLamBinNSCDs Exh_rLamLinNSCDs Exh_rO2LinNSCDs Exh_stDebHtrSetPNSCDs Exh_stLamLeanNSCDs Exh_stLamVldNSCDs Exh_stNOxSensRdyNSCDs Exh_swtNSCDs /end OUT_MEASUREMENT
 /begin LOC_MEASUREMENT Exh_rLamLinRecNSCDs_mp Exh_stDebLamVldNSCDs_mp Exh_stLamVldComNSCDs_mp /end LOC_MEASUREMENT
/end FUNCTION
/begin FUNCTION NoMCatDs_DDNOxAcq "" /begin DEF_CHARACTERISTIC Exh_rNOxPresCompLeanNSCDs_MAP Exh_tiPT1rNOxNSCDs_C /end DEF_CHARACTERISTIC /begin REF_CHARACTERISTIC Exh_pEGFldNSCDs_C /end REF_CHARACTERISTIC /begin IN_MEASUREMENT ASMod_pEGFld Com_rNOxDs Exh_stLamLeanNSCDs Exh_swtNSCDs /end IN_MEASUREMENT /begin OUT_MEASUREMENT Exh_rNOxPresCompNSCDs /end OUT_MEASUREMENT /begin LOC_MEASUREMENT Exh_pEGFld1NSCDs_mp Exh_rNOxFltNSCDs_mp /end LOC_MEASUREMENT /end FUNCTION
/begin FUNCTION NoMCatDs_VDAdap ""
 /begin DEF_CHARACTERISTIC Exh_d2rInitNSCDs_C Exh_dmAirIKiNSCDs_C Exh_EvalMaxValNSCDs_C Exh_EvalMinValNSCDs_C Exh_facO2LeanNSCDs_CUR Exh_facO2RichNSCDs_CUR Exh_IKiNgvNSCDs_C Exh_IKiPsvNSCDs_C Exh_mAirAdapActvNSCDs_C Exh_pEGFldNSCDs_C Exh_rLamRecNSCDs_CUR Exh_rPIDWinNgvNSCDs_C Exh_rPIDWinPsvNSCDs_C Exh_swtAdapActvNSCDs_C Exh_tiAdapFltInitNSCDs_C Exh_tiAdapFltNSCDs_C Exh_tiEvalFltNSCDs_C Exh_tiEvalInitFltNSCDs_C /end DEF_CHARACTERISTIC
 /begin REF_CHARACTERISTIC Exh_rLamLeanLimNSCDs_C /end REF_CHARACTERISTIC
 /begin IN_MEASUREMENT AFS_dm ASMod_pEGFld CoEng_st Exh_rLamLinNSCDs Exh_rO2LinNSCDs Exh_stNOxSensRdyNSCDs Exh_swtNSCDs PthSet_stOvrRunCoord /end IN_MEASUREMENT
 /begin OUT_MEASUREMENT Exh_mAirAftOvrRunNSCDs Exh_stAdapNSCDs /end OUT_MEASUREMENT
 /begin LOC_MEASUREMENT Exh_d2rO2EvalNSCDs_mp Exh_d2rO2FltNNSCDs_mp Exh_d2rO2FltPNSCDs_mp Exh_d2rO2NSCDs_mp Exh_drO2AdapNSCDs Exh_drO2FltNSCDs_mp Exh_facO2CorNSCDs_mp Exh_facPresCompO2NSCDs_mp Exh_pEGFldNSCDs_mp Exh_rLamAdapNSCDs Exh_rLamRecNSCDs_mp Exh_rO2AdapNSCDs Exh_rO2DvtNSCDs_mp Exh_rO2PresCompNSCDs Exh_stAdapActvNSCDs_mp Exh_stChngNSCDs_mp Exh_stHldNSCDs_mp Exh_swtAdapNSCDs /end LOC_MEASUREMENT
/end FUNCTION
/begin FUNCTION NoMCatDs_VDHtrCtl ""
 /begin DEF_CHARACTERISTIC Exh_facMolMsNOxNSCDs_C Exh_facMolMsNSCDs_CUR Exh_facNOxOfsAvrgNSCDs_C Exh_HtrDiaNSCDsDeb.tiHiLo_C Exh_HtrDiaNSCDsDeb.tiLoHi_C Exh_idxDewDetNSCDs_C Exh_idxEGFldNSCDs_C Exh_mNOxOfsTstLimNSCDs_C Exh_nMaxNSCDs_C Exh_nMinNSCDs_C Exh_NOxNSCDsDeb.tiHiLo_C Exh_NOxNSCDsDeb.tiLoHi_C Exh_rLamOfsTstLimNSCDs_C Exh_rNOxOfsdiffMinNSCDs_C Exh_rNOxOfsMaxNSCDs_C Exh_rNOxOfsMaxVarNSCDs_C Exh_rNOxOfsMinNSCDs_C Exh_swtNOxOfsCorrEnaNSCDs_C Exh_tiAvrgNOxOfsTstNSCDs_C Exh_tiHtgSensMaxNSCDs_C Exh_tiLoHiOfsDebNSCDs_C Exh_tiNOxDlyNSCDs_C Exh_tMaxNSCDs_C Exh_tMinNSCDs_C Exh_uBattMaxNSCDs_C Exh_uBattMinNSCDs_C /end DEF_CHARACTERISTIC
 /begin REF_CHARACTERISTIC Exh_mAirAdapActvNSCDs_C /end REF_CHARACTERISTIC
 /begin IN_MEASUREMENT ASMod_dmEGFld BattU_u Com_stNOxVldDs DewDet_stHtgLSU Epm_nEng Exh_mAirAftOvrRunNSCDs Exh_rLamLinNSCDs Exh_rNOxPresCompNSCDs Exh_stLamLeanNSCDs Exh_stNOxSensDiaEnaNSCDs Exh_swtNSCDs Exh_tNSCDs NSCLd_mNOxFld PthSet_stOvrRunCoord T15_st /end IN_MEASUREMENT
 /begin OUT_MEASUREMENT Exh_dmNOxNSCDs Exh_rNOxNSCDs Exh_rNOxOfsNSCDs Exh_stNOxHtrDiaEnaNSCDs Exh_stNOxNSCDs /end OUT_MEASUREMENT
 /begin LOC_MEASUREMENT Exh_facMolMsEGNSCDs_mp Exh_rAbsdiffNOxOfsNSCDs_mp Exh_rNOxOfsAvrgNSCDs Exh_rNOxOfsMaxNSCDs_mp Exh_rNOxOfsMinNSCDs_mp Exh_stHtrTONSCDs_mp Exh_stNOxOfsCorrEnaNSCDs Exh_stNOxOfsTstActvNSCDs /end LOC_MEASUREMENT
/end FUNCTION
/begin FUNCTION NoMCatDs_VDLamDia ""
 /begin DEF_CHARACTERISTIC Exh_rLamLinMaxNSCDs_C Exh_rLamLinMinNSCDs_C Exh_rO2LinMaxNSCDs_C Exh_rO2LinMinNSCDs_C Exh_tiDelOvrRunNSCDs_C Exh_uLamBinMaxNSCDs_C Exh_uLamBinMinNSCDs_C /end DEF_CHARACTERISTIC
 /begin IN_MEASUREMENT Com_rLamLinRecDs Com_stLamBinVldDs Com_stLamLinRecVldDs Com_uLamBinDs Exh_rO2LinNSCDs Exh_stNOxSensDiaEnaNSCDs Exh_swtNSCDs PthSet_stOvrRunCoord /end IN_MEASUREMENT
/end FUNCTION
/begin FUNCTION NoMCatDs_VDNOxDia ""
 /begin DEF_CHARACTERISTIC Exh_mAirMaxCmpChkNSCDs_C Exh_mAirMinCmpChkNSCDs_C Exh_nMaxCmpChkNSCDs_C Exh_nMaxR2LTstNSCDs_C Exh_nMinCmpChkNSCDs_C Exh_numSensCmpChkNSCDs_CA Exh_qMaxCmpChkNSCDs_C Exh_qMinCmpChkNSCDs_C Exh_rEGRMaxCmpChkNSCDs_C Exh_rEGRMinCmpChkNSCDs_C Exh_rMaxDiffNSCDs_CA Exh_rNOxMaxNSCDs_C Exh_rNOxMinNSCDs_C Exh_rO2MaxVarNSCDs_C Exh_stMskCmpChkO2NSCDs_C Exh_tiDlyCmpChkO2NSCDs_C Exh_tiNOxR2LTstMaxNSCDs_C Exh_tiO2EvalNSCDs_C /end DEF_CHARACTERISTIC
 /begin REF_CHARACTERISTIC Exh_uBattMinNSCDs_C /end REF_CHARACTERISTIC
 /begin IN_MEASUREMENT AFS_mAirPerCyl BattU_u CoEOM_stOpModeAct Com_rNOxDs Com_stNOxVldDs Com_stOpCirHtrDs Com_stOpCirLamBinDs Com_stOpCirLamLinDs Com_stOpCirNOxDs Com_stShCirHtrDs Com_stShCirLamBinDs Com_stShCirLamLinDs Com_stShCirNOxDs EGRVlv_r Epm_ctCyl Epm_nEng Exh_stLamLeanNSCDs Exh_stNOxHtrDiaEnaNSCDs Exh_stNOxNSCDs Exh_swtNSCDs InjSys_qInrCmb InjSys_stCtlQnt LSU_rO2PresComp LSU_stO2IntValid /end IN_MEASUREMENT
 /begin OUT_MEASUREMENT Exh_rO2NOxNSCDs Exh_rO2NSCDs Exh_stNOxSensDiaEnaNSCDs Exh_stO2NOxNSCDs Exh_stO2NSCDs /end OUT_MEASUREMENT
 /begin LOC_MEASUREMENT Exh_rO2CalcNSCDs_mp Exh_stCmpChkEnaNSCDs_mp Exh_stMaxTExcR2LNSCDs_mp Exh_stNOxREdgNSCDs_mp Exh_stOpModCmpChkNSCDs_mp Exh_stR2LTstActvNSCDs_mp Exh_stStyCondNSCDs_mp /end LOC_MEASUREMENT
/end FUNCTION
/begin FUNCTION NOxCat "" /begin SUB_FUNCTION SCRCtl /end SUB_FUNCTION /end FUNCTION
/begin FUNCTION OilLvl_DD "" /begin LOC_MEASUREMENT Oil_tiHiRawLvl Oil_tiLoRawLvl /end LOC_MEASUREMENT /end FUNCTION
/begin FUNCTION OilLvl_VD ""
 /begin DEF_CHARACTERISTIC Oil_ctIniDlyLvl_C Oil_ctLoTimeLvl_C Oil_ctTOutErrLvl_C Oil_tiLoTimeMaxLvl_C Oil_tiLoTimeMinLvl_C Oil_tiTOutLvl_C /end DEF_CHARACTERISTIC
 /begin IN_MEASUREMENT HESrv_stMSid Oil_swtSensVar T15_st /end IN_MEASUREMENT
 /begin OUT_MEASUREMENT Oil_ctNplErrLvl Oil_ctStrtDlyLvl Oil_ctTOutLvl Oil_stErrLvl Oil_stLoTimeLvl Oil_stValidLvl Oil_tiLoLvl /end OUT_MEASUREMENT
/end FUNCTION
/begin FUNCTION OilP "" /begin IN_MEASUREMENT Epm_nEng /end IN_MEASUREMENT /begin SUB_FUNCTION OilP_DD OilP_VD /end SUB_FUNCTION /end FUNCTION
/begin FUNCTION OilPLmp_DD "" /begin IN_MEASUREMENT CoEng_st Epm_nEng Oil_stPSwmp VehV_a VehV_v /end IN_MEASUREMENT /begin OUT_MEASUREMENT OilPLmp_st /end OUT_MEASUREMENT /end FUNCTION
/begin FUNCTION OilPLmp_VD ""
 /begin DEF_CHARACTERISTIC OilPLmp_ABSBackDeb.tiHiLo_C OilPLmp_ABSBackDeb.tiLoHi_C OilPLmp_ABSForDeb.tiHiLo_C OilPLmp_ABSForDeb.tiLoHi_C OilPLmp_aMinBack_C OilPLmp_aMinFor_C OilPLmp_nStrt_C OilPLmp_nZero_C OilPLmp_stPSwmpDeb.tiHiLo_C OilPLmp_stPSwmpDeb.tiLoHi_C OilPLmp_tiInactvBack_C OilPLmp_tiInactvFor_C OilPLmp_tiInactvStrt_C OilPLmp_vMinBack_C OilPLmp_vMinFor_C /end DEF_CHARACTERISTIC
 /begin IN_MEASUREMENT CoEng_st Com_v Epm_nEng VehV_a VehV_v /end IN_MEASUREMENT
 /begin LOC_MEASUREMENT OilPLmp_stABSBackDeb_mp OilPLmp_stABSBackTrans_mp OilPLmp_stABSBack_mp OilPLmp_stABSForDeb_mp OilPLmp_stABSForTrans_mp OilPLmp_stABSFor_mp OilPLmp_stInactive_mp OilPLmp_stnEngTrans_mp OilPLmp_stOilPLmp_mp OilPLmp_stShOff_mp /end LOC_MEASUREMENT
/end FUNCTION
/begin FUNCTION OilP_DD ""
 /begin DEF_CHARACTERISTIC Oil_SRCPSwmp.uMin_C Oil_SRCPSwmp.uMax_C Oil_stTransfPSwmp_CUR /end DEF_CHARACTERISTIC
 /begin OUT_MEASUREMENT Oil_stSensPSwmp Oil_uRawPSwmp /end OUT_MEASUREMENT
/end FUNCTION
/begin FUNCTION OilP_VD "" /begin DEF_CHARACTERISTIC Oil_stDflPSwmp_C /end DEF_CHARACTERISTIC /begin IN_MEASUREMENT Oil_stSensPSwmp /end IN_MEASUREMENT /begin OUT_MEASUREMENT Oil_stPSwmp /end OUT_MEASUREMENT /end FUNCTION
/begin FUNCTION Oil_DD "" /begin DEF_CHARACTERISTIC Oil_swtSensVar_C Oil_tiBtwRegRd_C /end DEF_CHARACTERISTIC
 /begin OUT_MEASUREMENT Oil_rRawOilLvl Oil_rRawOilQl Oil_rRawOilT Oil_stComErr Oil_stRegSens Oil_swtSensVar /end OUT_MEASUREMENT
/end FUNCTION
/begin FUNCTION OS_Kernel ""
 /begin LOC_MEASUREMENT OS_cnt1000msTask OS_cnt100msTask OS_cnt10msTask OS_cnt1msTask OS_cnt200msTask OS_cnt20msTask OS_cnt2msTask OS_cnt5msTask OS_cntBgTask OS_cntDsmClearTask OS_cntEngReStrtTask OS_cntEpmNoSyncTask OS_cntIniEndTask OS_cntIniTask OS_cntMoTask OS_cntSyncDummyTask OS_cntSyncFirstTask OS_cntSyncIni OS_cntSyncPostTask OS_cntSyncPreTask OS_cntSyncSchedTask /end LOC_MEASUREMENT
/end FUNCTION
/begin FUNCTION OS_Shell ""
 /begin LOC_MEASUREMENT OS_ErrCtr_accessResource_u8 OS_ErrCtr_callevel_u8 OS_ErrCtr_deadline_u8 OS_ErrCtr_default_u8 OS_ErrCtr_generalError_u8 OS_ErrCtr_idValue_u8 OS_ErrCtr_limit_u8 OS_ErrCtr_noFuncState_u8 OS_ErrCtr_stackcnt_u8 OS_ErrCtr_stackstat_u8 OS_ErrCtr_sum_u8 OS_ErrCtr_timetable_u8 /end LOC_MEASUREMENT
/end FUNCTION
/begin FUNCTION ozbg "" /begin DEF_CHARACTERISTIC K_CW_OZ_2 /end DEF_CHARACTERISTIC /begin OUT_MEASUREMENT Oz_tempakt St_ozbg0 Toel /end OUT_MEASUREMENT /end FUNCTION
/begin COMPU_METHOD Acc "" RAT_FUNC "%6.5" "m/s^2" COEFFS 0 1000 0 0 0 1 /end COMPU_METHOD
/begin COMPU_METHOD AirMassPerCyl "" RAT_FUNC "%5.1" "mg/Hub" COEFFS 0 10 0 0 0 1 /end COMPU_METHOD
/begin COMPU_METHOD AirMass_2 "" RAT_FUNC "%6.3" "g" COEFFS 0 10 0 0 0 1 /end COMPU_METHOD
/begin COMPU_METHOD COEOM_AIRCTLTRQNUMMAP_SY_Compu "" TAB_NOINTP "%6.3" "" COMPU_TAB_REF COEOM_AIRCTLTRQNUMMAP_SY_Compu /end COMPU_METHOD
/begin COMPU_TAB COEOM_AIRCTLTRQNUMMAP_SY_Compu "" TAB_NOINTP 8 0 0 1 1 2 2 3 3 4 4 5 5 6 6 7 7 /end COMPU_TAB
/begin COMPU_METHOD Def_a_sw_b64 "" RAT_FUNC "%7.5" "m/s²" COEFFS 0 512 0 0 0 1 /end COMPU_METHOD
/begin COMPU_METHOD Def_dez_ub_q1 "" RAT_FUNC "%3.1" "-" COEFFS 0 1 0 0 0 1 /end COMPU_METHOD
/begin COMPU_METHOD Def_dez_ul_q1 "" RAT_FUNC "%7.3" "-" COEFFS 0 1 0 0 0 1 /end COMPU_METHOD
/begin COMPU_METHOD Def_dez_uw_q1 "" RAT_FUNC "%5.2" "-" COEFFS 0 1 0 0 0 1 /end COMPU_METHOD
/begin COMPU_METHOD Def_f_sw_b100 "" RAT_FUNC "%8.5" "-" COEFFS 0 327.68 0 0 0 1 /end COMPU_METHOD
/begin COMPU_METHOD Def_f_ub_b2 "" RAT_FUNC "%6.4" "-" COEFFS 0 128 0 0 0 1 /end COMPU_METHOD
/begin COMPU_METHOD Def_f_ub_q1 "" RAT_FUNC "%3.1" "-" COEFFS 0 1 0 0 0 1 /end COMPU_METHOD
/begin COMPU_METHOD Def_f_uw_b100 "" RAT_FUNC "%8.5" "%" COEFFS 0 655.36 0 0 0 1 /end COMPU_METHOD
/begin COMPU_METHOD Def_f_uw_q1 "" RAT_FUNC "%5.2" "-" COEFFS 0 1 0 0 0 1 /end COMPU_METHOD
/begin COMPU_METHOD Def_lst_sw_q0p01 "" RAT_FUNC "%7.5" "W" COEFFS 0 100 0 0 0 1 /end COMPU_METHOD
/begin COMPU_METHOD Def_lst_uw_q0p1 "" RAT_FUNC "%6.3" "W" COEFFS 0 10 0 0 0 1 /end COMPU_METHOD
/begin COMPU_METHOD Def_me_sw_q0p01 "" RAT_FUNC "%8.5" "mg/cyc" COEFFS 0 100 0 0 0 1 /end COMPU_METHOD
/begin COMPU_METHOD Def_n_sw_q1p0 "" RAT_FUNC "%5.2" "Upm" COEFFS 0 1 0 0 0 1 /end COMPU_METHOD
/begin COMPU_METHOD Def_p_sw_q0p001 "" RAT_FUNC "%8.6" "Bar" COEFFS 0 1000 0 0 0 1 /end COMPU_METHOD
/begin COMPU_METHOD Def_p_uw_q0p001 "" RAT_FUNC "%8.6" "Bar" COEFFS 0 1000 0 0 0 1 /end COMPU_METHOD
/begin COMPU_METHOD Def_p_uw_q1 "" RAT_FUNC "%6.2" "hPa" COEFFS 0 1 0 0 0 1 /end COMPU_METHOD
/begin COMPU_METHOD Def_rf_sw_q0p01 "" RAT_FUNC "%9.6" "%" COEFFS 0 100 0 0 0 1 /end COMPU_METHOD
/begin COMPU_METHOD Def_rf_uw_q0p0001 "" RAT_FUNC "%9.7" "-" COEFFS 0 10000 0 0 0 1 /end COMPU_METHOD
/begin COMPU_METHOD Def_rf_uw_q0p01 "" RAT_FUNC "%9.6" "%" COEFFS 0 100 0 0 0 1 /end COMPU_METHOD
/begin COMPU_METHOD Def_st_ub_q1 "" RAT_FUNC "%3.1" "-" COEFFS 0 1 0 0 0 1 /end COMPU_METHOD
/begin COMPU_METHOD Def_st_uw_q1 "" RAT_FUNC "%5.2" "-" COEFFS 0 1 0 0 0 1 /end COMPU_METHOD
/begin COMPU_METHOD Def_td10ms_uw_b655p35 "" RAT_FUNC "%7.5" "s" COEFFS 0 100 0 0 0 1 /end COMPU_METHOD
/begin COMPU_METHOD Def_td_ub_q0p1 "" RAT_FUNC "%4.2" "s" COEFFS 0 10 0 0 0 1 /end COMPU_METHOD
/begin COMPU_METHOD Def_td_uw_q0p01 "" RAT_FUNC "%7.5" "s" COEFFS 0 100 0 0 0 1 /end COMPU_METHOD
/begin COMPU_METHOD Def_td_uw_q0p02 "" RAT_FUNC "%7.4" "s" COEFFS 0 50 0 0 0 1 /end COMPU_METHOD
/begin COMPU_METHOD Def_tv_uw_q0p01 "" RAT_FUNC "%7.5" "%" COEFFS 0 100 0 0 0 1 /end COMPU_METHOD
/begin COMPU_METHOD Def_t_sw_q0p01 "" RAT_FUNC "%7.5" "°C" COEFFS 0 100 0 0 0 1 /end COMPU_METHOD
/begin COMPU_METHOD Def_t_sw_q0p1 "" RAT_FUNC "%6.3" "°C" COEFFS 0 10 0 0 0 1 /end COMPU_METHOD
/begin COMPU_METHOD Def_u_ub_q0p1 "" RAT_FUNC "%5.3" "V" COEFFS 0 10 0 0 0 1 /end COMPU_METHOD
/begin COMPU_METHOD Def_u_uw_q0p0942 "" RAT_FUNC "%6.3" "V" COEFFS 0 10.6157112526539 0 0 0 1 /end COMPU_METHOD
/begin COMPU_METHOD Def_u_uw_q0p1 "" RAT_FUNC "%8.4" "V" COEFFS 0 10 0 0 0 1 /end COMPU_METHOD
/begin COMPU_METHOD Def_vol_ub_q0p1 "" RAT_FUNC "%4.2" "l" COEFFS 0 10 0 0 0 1 /end COMPU_METHOD
/begin COMPU_METHOD Def_vol_uw_q0p1 "" RAT_FUNC "%8.4" "l" COEFFS 0 10 0 0 0 1 /end COMPU_METHOD
/begin COMPU_METHOD Def_v_uw_q1p0 "" RAT_FUNC "%5.2" "km/h" COEFFS 0 1 0 0 0 1 /end COMPU_METHOD
/begin COMPU_METHOD Def_wdk_sw_q0p0244 "" RAT_FUNC "%7.4" "%" COEFFS 0 40.96 0 0 0 1 /end COMPU_METHOD
/begin COMPU_METHOD Def_wdk_sw_q0p1 "" RAT_FUNC "%7.4" "-" COEFFS 0 10 0 0 0 1 /end COMPU_METHOD
/begin COMPU_METHOD DtyCyc "" RAT_FUNC "%5.2" "%" COEFFS 0 100 0 0 0 1 /end COMPU_METHOD
/begin COMPU_METHOD EngN "" RAT_FUNC "%5.1" "rpm" COEFFS 0 2 0 0 0 1 /end COMPU_METHOD
/begin COMPU_METHOD Fact "" RAT_FUNC "%6.5" "-" COEFFS 0 8192 0 0 0 1 /end COMPU_METHOD
/begin COMPU_METHOD InjMass "" RAT_FUNC "%5.2" "mg/hub" COEFFS 0 100 0 0 0 1 /end COMPU_METHOD
/begin COMPU_METHOD Ki "" RAT_FUNC "%6.5" "1/s" COEFFS 0 2147.483648 0 0 0 1 /end COMPU_METHOD
/begin COMPU_METHOD lambda "" RAT_FUNC "%4.3" "-" COEFFS 0 1000 0 0 0 1 /end COMPU_METHOD
/begin COMPU_METHOD lambdaRec "" RAT_FUNC "%7.6" "-" COEFFS 0 10000 0 0 0 1 /end COMPU_METHOD
/begin COMPU_METHOD Molmass "" RAT_FUNC "%6.4" "Gram/mol" COEFFS 0 100 0 0 0 1 /end COMPU_METHOD
/begin COMPU_METHOD Mo_fac_q0p000122 "" RAT_FUNC "%6.5" "1/1" COEFFS 0 8192 0 0 0 1 /end COMPU_METHOD
/begin COMPU_METHOD Mo_fac_q0p00392 "" RAT_FUNC "%6.4" "1/1" COEFFS 0 255 0 0 0 1 /end COMPU_METHOD
/begin COMPU_METHOD Mo_fac_q0p0078125 "" RAT_FUNC "%6.4" "1/1" COEFFS 0 128 0 0 0 1 /end COMPU_METHOD
/begin COMPU_METHOD Mo_fac_q0p04 "" RAT_FUNC "%6.4" "1/1" COEFFS 0 25 0 0 0 1 /end COMPU_METHOD
/begin COMPU_METHOD Mo_n_rpm_q40p0 "" RAT_FUNC "%6.1" "rpm" COEFFS 0 1 0 0 0 40 /end COMPU_METHOD
/begin COMPU_METHOD Mo_phi_degCrS_q0p02197 "" RAT_FUNC "%6.4" "deg CrS" COEFFS 0 16383 0 0 0 360 /end COMPU_METHOD
/begin COMPU_METHOD Mo_p_bar_q8p0000 "" RAT_FUNC "%4.3" "bar" COEFFS 0 1000.000000 0 0 0 8000 /end COMPU_METHOD
/begin COMPU_METHOD Mo_q_mg_q0p01 "" RAT_FUNC "%6.4" "mg" COEFFS 0 100 0 0 0 1 /end COMPU_METHOD
/begin COMPU_METHOD Mo_r_prc_q0p39 "" RAT_FUNC "%6.3" "%" COEFFS 0 256 0 0 0 100 /end COMPU_METHOD
/begin COMPU_METHOD Mo_ti10ms_ms_q10p0 "" RAT_FUNC "%6.1" "ms" COEFFS 0 1 0 0 0 10 /end COMPU_METHOD
/begin COMPU_METHOD Mo_ti20ms_s_q0p02 "" RAT_FUNC "%6.4" "s" COEFFS 0 1 0 0 0 0.02 /end COMPU_METHOD
/begin COMPU_METHOD Mo_ti40ms_ms_q40p0 "" RAT_FUNC "%6.1" "ms" COEFFS 0 1 0 0 0 40 /end COMPU_METHOD
/begin COMPU_METHOD Mo_ti40ms_s_q5p12 "" RAT_FUNC "%6.2" "s" COEFFS 0 1000 0 0 0 5120 /end COMPU_METHOD
/begin COMPU_METHOD Mo_ti_us_q0p4 "" RAT_FUNC "%6.3" "us" COEFFS 0 1000 0 0 0 400 /end COMPU_METHOD
/begin COMPU_METHOD Mo_trq_nm_q0p1 "" RAT_FUNC "%6.3" "Nm" COEFFS 0 10 0 0 0 1 /end COMPU_METHOD
/begin COMPU_METHOD Mo_t_DegC_q0p8o48 "" RAT_FUNC "%6.2" "deg C" COEFFS 0 5 240 0 0 4 /end COMPU_METHOD
/begin COMPU_METHOD Mo_v_kmh_q0p01 "" RAT_FUNC "%6.4" "km/h" COEFFS 0 100 0 0 0 1 /end COMPU_METHOD
/begin COMPU_METHOD M_NOxLd "" RAT_FUNC "%8.7" "g" COEFFS 0 100000 0 0 0 1 /end COMPU_METHOD
/begin COMPU_METHOD nox "" RAT_FUNC "%6.2" "ppm" COEFFS 0 1 0 0 0 1 /end COMPU_METHOD
/begin COMPU_METHOD NOxFlwEG "" RAT_FUNC "%6.4" "Gram/s" COEFFS 0 40 0 0 0 1 /end COMPU_METHOD
/begin COMPU_METHOD NOxMassFlw "" RAT_FUNC "%6.5" "Gram/s" COEFFS 0 1000 0 0 0 1 /end COMPU_METHOD
/begin COMPU_METHOD O2 "" RAT_FUNC "%6.5" "-" COEFFS 0 100000 0 0 0 1 /end COMPU_METHOD
/begin COMPU_METHOD OneToOne "" RAT_FUNC "%6.0" "-" COEFFS 0 1 0 0 0 1 /end COMPU_METHOD
/begin COMPU_METHOD Period_ms "" RAT_FUNC "%6.3" "ms" COEFFS 0 10 0 0 0 1 /end COMPU_METHOD
/begin COMPU_METHOD Prc "" RAT_FUNC "%6.4" "%" COEFFS 0 81.92 0 0 0 1 /end COMPU_METHOD
/begin COMPU_METHOD Pres_hPa "" RAT_FUNC "%5.1" "hPa" COEFFS 0 1 0 0 0 1 /end COMPU_METHOD
/begin COMPU_METHOD Temp_Cels "" RAT_FUNC "%5.1" "deg C" COEFFS 0 10 2731.4 0 0 1 /end COMPU_METHOD
/begin COMPU_METHOD TimeDeb "" RAT_FUNC "%5.0" "ms" COEFFS 0 0.1 0 0 0 1 /end COMPU_METHOD
/begin COMPU_METHOD TimeDelay_s "" RAT_FUNC "%12.4" "s" COEFFS 0 0 1 0 0.00023283064365387 0 /end COMPU_METHOD
/begin COMPU_METHOD Time_ms "" RAT_FUNC "%5.0" "ms" COEFFS 0 0.1 0 0 0 1 /end COMPU_METHOD
/begin COMPU_METHOD Time_s "" RAT_FUNC "%5.2" "s" COEFFS 0 100 0 0 0 1 /end COMPU_METHOD
/begin COMPU_METHOD Time_sec_1 "" RAT_FUNC "%6.3" "s" COEFFS 0 10 0 0 0 1 /end COMPU_METHOD
/begin COMPU_METHOD Vel "" RAT_FUNC "%5.2" "km/h" COEFFS 0 100 0 0 0 1 /end COMPU_METHOD
/begin COMPU_METHOD Volt "" RAT_FUNC "%6.1" "mV" COEFFS 0 5 0 0 0 1 /end COMPU_METHOD
/begin COMPU_METHOD Volt_Batt "" RAT_FUNC "%5.0" "mV" COEFFS 0 0.05 0 0 0 1 /end COMPU_METHOD
/begin RECORD_LAYOUT CurTKL_SW_VV_SW NO_AXIS_PTS_X 1 UBYTE RESERVED 2 BYTE AXIS_PTS_X 3 SWORD INDEX_INCR DIRECT FNC_VALUES 4 SWORD COLUMN_DIR DIRECT /end RECORD_LAYOUT
/begin RECORD_LAYOUT CurTKL_SW_VV_UW NO_AXIS_PTS_X 1 UBYTE RESERVED 2 BYTE AXIS_PTS_X 3 SWORD INDEX_INCR DIRECT FNC_VALUES 4 UWORD COLUMN_DIR DIRECT /end RECORD_LAYOUT
/begin RECORD_LAYOUT Cur_Xs16Ws16 NO_AXIS_PTS_X 1 SWORD AXIS_PTS_X 2 SWORD INDEX_INCR DIRECT FNC_VALUES 3 SWORD COLUMN_DIR DIRECT /end RECORD_LAYOUT
/begin RECORD_LAYOUT Cur_Xu8Wu8 NO_AXIS_PTS_X 1 UBYTE AXIS_PTS_X 2 UBYTE INDEX_INCR DIRECT FNC_VALUES 3 UBYTE COLUMN_DIR DIRECT /end RECORD_LAYOUT
/begin RECORD_LAYOUT Kw_Ws16 FNC_VALUES 1 SWORD COLUMN_DIR DIRECT /end RECORD_LAYOUT
/begin RECORD_LAYOUT Kw_Wu16 FNC_VALUES 1 UWORD COLUMN_DIR DIRECT /end RECORD_LAYOUT
/begin RECORD_LAYOUT Kw_Wu8 FNC_VALUES 1 UBYTE COLUMN_DIR DIRECT /end RECORD_LAYOUT
/begin RECORD_LAYOUT MapTKF_SW_SW_UW NO_AXIS_PTS_X 1 UBYTE NO_AXIS_PTS_Y 2 UBYTE AXIS_PTS_X 3 SWORD INDEX_INCR DIRECT AXIS_PTS_Y 4 SWORD INDEX_INCR DIRECT FNC_VALUES 5 UWORD COLUMN_DIR DIRECT /end RECORD_LAYOUT
/begin RECORD_LAYOUT MapTKF_SW_UW_UW NO_AXIS_PTS_X 1 UBYTE NO_AXIS_PTS_Y 2 UBYTE AXIS_PTS_X 3 UWORD INDEX_INCR DIRECT AXIS_PTS_Y 4 SWORD INDEX_INCR DIRECT FNC_VALUES 5 UWORD COLUMN_DIR DIRECT /end RECORD_LAYOUT
/begin RECORD_LAYOUT MapTKF_UW_SW_UW NO_AXIS_PTS_X 1 UBYTE NO_AXIS_PTS_Y 2 UBYTE AXIS_PTS_X 3 SWORD INDEX_INCR DIRECT AXIS_PTS_Y 4 UWORD INDEX_INCR DIRECT FNC_VALUES 5 UWORD COLUMN_DIR DIRECT /end RECORD_LAYOUT
/begin RECORD_LAYOUT Map_Xs16Ys16Ws16 NO_AXIS_PTS_X 1 SWORD NO_AXIS_PTS_Y 2 SWORD AXIS_PTS_X 3 SWORD INDEX_INCR DIRECT AXIS_PTS_Y 4 SWORD INDEX_INCR DIRECT FNC_VALUES 5 SWORD COLUMN_DIR DIRECT /end RECORD_LAYOUT
/begin RECORD_LAYOUT Map_Xu8Yu8Wu8 NO_AXIS_PTS_X 1 UBYTE NO_AXIS_PTS_Y 2 UBYTE AXIS_PTS_X 3 UBYTE INDEX_INCR DIRECT AXIS_PTS_Y 4 UBYTE INDEX_INCR DIRECT FNC_VALUES 5 UBYTE COLUMN_DIR DIRECT /end RECORD_LAYOUT
/begin RECORD_LAYOUT ValA_Ws16 FNC_VALUES 1 SWORD COLUMN_DIR DIRECT /end RECORD_LAYOUT
/begin RECORD_LAYOUT ValA_Wu8 FNC_VALUES 1 UBYTE COLUMN_DIR DIRECT /end RECORD_LAYOUT
/begin RECORD_LAYOUT Val_Ws16 FNC_VALUES 1 SWORD COLUMN_DIR DIRECT /end RECORD_LAYOUT
/begin RECORD_LAYOUT Val_Ws32 FNC_VALUES 1 SLONG COLUMN_DIR DIRECT /end RECORD_LAYOUT
/begin RECORD_LAYOUT Val_Wu16 FNC_VALUES 1 UWORD COLUMN_DIR DIRECT /end RECORD_LAYOUT
/begin RECORD_LAYOUT Val_Wu32 FNC_VALUES 1 ULONG COLUMN_DIR DIRECT /end RECORD_LAYOUT
/begin RECORD_LAYOUT Val_Wu8 FNC_VALUES 1 UBYTE COLUMN_DIR DIRECT /end RECORD_LAYOUT
/end MODULE
/end PROJECT

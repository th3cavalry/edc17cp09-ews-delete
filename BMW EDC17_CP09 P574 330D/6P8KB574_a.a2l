ASAP2_VERSION 1 4
/begin PROJECT P_574 "EDC17_CP09"
/begin HEADER "" VERSION "V8KB" PROJECT_NO P_574 /end HEADER
/begin MODULE DIM ""
/begin MOD_COMMON "" BYTE_ORDER MSB_LAST ALIGNMENT_BYTE 1 ALIGNMENT_WORD 2 ALIGNMENT_LONG 4 ALIGNMENT_FLOAT32_IEEE 4 /end MOD_COMMON
/begin CHARACTERISTIC DFC_CtlMsk.DFC_Unused_C "DFC/intern benötigter Parameter für nicht existierende Fehlerprüfung DFC_Unused" VALUE 0x80022CE4 Val_Wu16 65535.00 DFES_OneToOne 0.00 65535.00 READ_ONLY /end CHARACTERISTIC
/begin CHARACTERISTIC DFC_CtlMsk.DFC_ACCIPlausDrvAst_C "DFC/Verhaltens Kontroll Maske für Prüfung DFC_ACCIPlausDrvAst" VALUE 0x80022CE6 Val_Wu16 65535.00 DFES_OneToOne 0.00 65535.00 /end CHARACTERISTIC
/begin CHARACTERISTIC DFC_CtlMsk.DFC_ACCIPlausTrqDes_C "DFC/Verhaltens Kontroll Maske für Prüfung DFC_ACCIPlausTrqDes" VALUE 0x80022CE8 Val_Wu16 65535.00 DFES_OneToOne 0.00 65535.00 /end CHARACTERISTIC
/begin CHARACTERISTIC DFC_CtlMsk.DFC_AirCtlGovDvtEOMMax_C "DFC/Verhaltens Kontroll Maske für Prüfung DFC_AirCtlGovDvtEOMMax" VALUE 0x80022CEA Val_Wu16 65535.00 DFES_OneToOne 0.00 65535.00 /end CHARACTERISTIC
/begin CHARACTERISTIC DFC_CtlMsk.DFC_AirCtlGovDvtEOMMin_C "DFC/Verhaltens Kontroll Maske für Prüfung DFC_AirCtlGovDvtEOMMin" VALUE 0x80022CEC Val_Wu16 65535.00 DFES_OneToOne 0.00 65535.00 /end CHARACTERISTIC
/begin CHARACTERISTIC DFC_CtlMsk.DFC_AirCtlGovDvtMax_C "DFC/Verhaltens Kontroll Maske für Prüfung DFC_AirCtlGovDvtMax" VALUE 0x80022CEE Val_Wu16 65535.00 DFES_OneToOne 0.00 65535.00 /end CHARACTERISTIC
/begin CHARACTERISTIC DFC_CtlMsk.DFC_AirCtlGovDvtMin_C "DFC/Verhaltens Kontroll Maske für Prüfung DFC_AirCtlGovDvtMin" VALUE 0x80022CF0 Val_Wu16 65535.00 DFES_OneToOne 0.00 65535.00 /end CHARACTERISTIC
/begin CHARACTERISTIC DFC_CtlMsk.DFC_AirCtlGovLPDvtMax_C "DFC/Verhaltens Kontroll Maske für Prüfung DFC_AirCtlGovLPDvtMax" VALUE 0x80022CF2 Val_Wu16 65535.00 DFES_OneToOne 0.00 65535.00 /end CHARACTERISTIC
/begin CHARACTERISTIC DFC_CtlMsk.DFC_AirCtlGovLPDvtMin_C "DFC/Verhaltens Kontroll Maske für Prüfung DFC_AirCtlGovLPDvtMin" VALUE 0x80022CF4 Val_Wu16 65535.00 DFES_OneToOne 0.00 65535.00 /end CHARACTERISTIC
/begin CHARACTERISTIC DFC_CtlMsk.DFC_AltIOComErr_C "DFC/Verhaltens Kontroll Maske für Prüfung DFC_AltIOComErr" VALUE 0x80022CF6 Val_Wu16 65535.00 DFES_OneToOne 0.00 65535.00 /end CHARACTERISTIC
/begin CHARACTERISTIC DFC_CtlMsk.DFC_AltIOComNpl_C "DFC/Verhaltens Kontroll Maske für Prüfung DFC_AltIOComNpl" VALUE 0x80022CF8 Val_Wu16 65535.00 DFES_OneToOne 0.00 65535.00 /end CHARACTERISTIC
/begin CHARACTERISTIC DFC_CtlMsk.DFC_BusDiagBusOffFlexRay_C "DFC/" VALUE 0x80022CFA Val_Wu16 65535.00 DFES_OneToOne 0.00 65535.00 /end CHARACTERISTIC
/begin CHARACTERISTIC DFC_CtlMsk.DFC_BusDiagBusOffNodeA_C "DFC/Verhaltens Kontroll Maske für Prüfung DFC_BusDiagBusOffNodeA" VALUE 0x80022CFC Val_Wu16 65535.00 DFES_OneToOne 0.00 65535.00 /end CHARACTERISTIC
/begin CHARACTERISTIC DFC_CtlMsk.DFC_BusDiagBusOffNodeB_C "DFC/Verhaltens Kontroll Maske für Prüfung DFC_BusDiagBusOffNodeB" VALUE 0x80022CFE Val_Wu16 65535.00 DFES_OneToOne 0.00 65535.00 /end CHARACTERISTIC
/begin CHARACTERISTIC DFC_CtlMsk.DFC_BusDiagBusOffNodeC_C "DFC/Verhaltens Kontroll Maske für Prüfung DFC_BusDiagBusOffNodeC" VALUE 0x80022D00 Val_Wu16 65535.00 DFES_OneToOne 0.00 65535.00 /end CHARACTERISTIC
/begin CHARACTERISTIC DFC_CtlMsk.DFC_BusDiagHwFlexRay_C "DFC/" VALUE 0x80022D02 Val_Wu16 65535.00 DFES_OneToOne 0.00 65535.00 /end CHARACTERISTIC
/begin CHARACTERISTIC DFC_CtlMsk.DFC_Cj945SpiCom1_C "DFC/Verhaltens Kontroll Maske für Prüfung DFC_Cj945SpiCom1" VALUE 0x80022D04 Val_Wu16 65535.00 DFES_OneToOne 0.00 65535.00 /end CHARACTERISTIC
/begin CHARACTERISTIC DFC_CtlMsk.DFC_ComACDemandSig_FA_C "DFC/Verhaltens Kontroll Maske für Prüfung DFC_ComACDemandSig_FA" VALUE 0x80022D06 Val_Wu16 65535.00 DFES_OneToOne 0.00 65535.00 /end CHARACTERISTIC
/begin CHARACTERISTIC DFC_CtlMsk.DFC_ComACDemandTo_FA_C "DFC/Verhaltens Kontroll Maske für Prüfung DFC_ComACDemandTo_FA" VALUE 0x80022D08 Val_Wu16 65535.00 DFES_OneToOne 0.00 65535.00 /end CHARACTERISTIC
/begin CHARACTERISTIC DFC_CtlMsk.DFC_ComATempSig_FA_C "DFC/Verhaltens Kontroll Maske für Prüfung DFC_ComATempSig_FA" VALUE 0x80022D0A Val_Wu16 65535.00 DFES_OneToOne 0.00 65535.00 /end CHARACTERISTIC
/begin CHARACTERISTIC DFC_CtlMsk.DFC_ComATempTo_FA_C "DFC/Verhaltens Kontroll Maske für Prüfung DFC_ComATempTo_FA" VALUE 0x80022D0C Val_Wu16 65535.00 DFES_OneToOne 0.00 65535.00 /end CHARACTERISTIC
/begin CHARACTERISTIC DFC_CtlMsk.DFC_ComATempTo_FX_C "DFC/Verhaltens Kontroll Maske für Prüfung DFC_ComATempTo_FX" VALUE 0x80022D0E Val_Wu16 65535.00 DFES_OneToOne 0.00 65535.00 /end CHARACTERISTIC
/begin CHARACTERISTIC DFC_CtlMsk.DFC_ComBrkTrqSumChk_FX_C "DFC/Verhaltens Kontroll Maske für Prüfung DFC_ComBrkTrqSumChk_FX" VALUE 0x80022D10 Val_Wu16 65535.00 DFES_OneToOne 0.00 65535.00 /end CHARACTERISTIC
/begin CHARACTERISTIC DFC_CtlMsk.DFC_ComBrkTrqSumCtr_FX_C "DFC/Verhaltens Kontroll Maske für Prüfung DFC_ComBrkTrqSumCtr_FX" VALUE 0x80022D12 Val_Wu16 65535.00 DFES_OneToOne 0.00 65535.00 /end CHARACTERISTIC
/begin CHARACTERISTIC DFC_CtlMsk.DFC_ComBrkTrqSumTo_FX_C "DFC/Verhaltens Kontroll Maske für Prüfung DFC_ComBrkTrqSumTo_FX" VALUE 0x80022D14 Val_Wu16 65535.00 DFES_OneToOne 0.00 65535.00 /end CHARACTERISTIC
/begin CHARACTERISTIC DFC_CtlMsk.DFC_ComBtnDrvDynChk_FX_C "DFC/Verhaltens Kontroll Maske für Prüfung DFC_ComBtnDrvDynChk_FX" VALUE 0x80022D16 Val_Wu16 65535.00 DFES_OneToOne 0.00 65535.00 /end CHARACTERISTIC
/begin CHARACTERISTIC DFC_CtlMsk.DFC_ComBtnDrvDynCtr_FX_C "DFC/Verhaltens Kontroll Maske für Prüfung DFC_ComBtnDrvDynCtr_FX" VALUE 0x80022D18 Val_Wu16 65535.00 DFES_OneToOne 0.00 65535.00 /end CHARACTERISTIC
/begin CHARACTERISTIC DFC_CtlMsk.DFC_ComBtnDrvDynTo_FX_C "DFC/Verhaltens Kontroll Maske für Prüfung DFC_ComBtnDrvDynTo_FX" VALUE 0x80022D1A Val_Wu16 65535.00 DFES_OneToOne 0.00 65535.00 /end CHARACTERISTIC
/begin CHARACTERISTIC DFC_CtlMsk.DFC_ComButtonMSASig_C "DFC/Verhaltens Kontroll Maske für Prüfung DFC_ComButtonMSASig" VALUE 0x80022D1C Val_Wu16 65535.00 DFES_OneToOne 0.00 65535.00 /end CHARACTERISTIC
/begin CHARACTERISTIC DFC_CtlMsk.DFC_ComButtonMSATo_C "DFC/Verhaltens Kontroll Maske für Prüfung DFC_ComButtonMSATo" VALUE 0x80022D1E Val_Wu16 65535.00 DFES_OneToOne 0.00 65535.00 /end CHARACTERISTIC
/begin CHARACTERISTIC DFC_CtlMsk.DFC_ComCodierungPwrmngSig_C "DFC/Verhaltens Kontroll Maske für Prüfung DFC_ComCodierungPwrmngSig" VALUE 0x80022D20 Val_Wu16 65535.00 DFES_OneToOne 0.00 65535.00 /end CHARACTERISTIC
/begin CHARACTERISTIC DFC_CtlMsk.DFC_ComCodierungPwrmngSig_FA_C "DFC/Verhaltens Kontroll Maske für Prüfung DFC_ComCodierungPwrmngSig_FA" VALUE 0x80022D22 Val_Wu16 65535.00 DFES_OneToOne 0.00 65535.00 /end CHARACTERISTIC
/begin CHARACTERISTIC DFC_CtlMsk.DFC_ComCrCtlLvrChk_C "DFC/Verhaltens Kontroll Maske für Prüfung DFC_ComCrCtlLvrChk" VALUE 0x80022D24 Val_Wu16 65535.00 DFES_OneToOne 0.00 65535.00 /end CHARACTERISTIC
/begin CHARACTERISTIC DFC_CtlMsk.DFC_ComCrCtlLvrCtr_C "DFC/Verhaltens Kontroll Maske für Prüfung DFC_ComCrCtlLvrCtr" VALUE 0x80022D26 Val_Wu16 65535.00 DFES_OneToOne 0.00 65535.00 /end CHARACTERISTIC
/begin CHARACTERISTIC DFC_CtlMsk.DFC_ComCrCtlLvrSig_C "DFC/Verhaltens Kontroll Maske für Prüfung DFC_ComCrCtlLvrSig" VALUE 0x80022D28 Val_Wu16 65535.00 DFES_OneToOne 0.00 65535.00 /end CHARACTERISTIC
/begin CHARACTERISTIC DFC_CtlMsk.DFC_ComCrCtlLvrTo_C "DFC/Verhaltens Kontroll Maske für Prüfung DFC_ComCrCtlLvrTo" VALUE 0x80022D2A Val_Wu16 65535.00 DFES_OneToOne 0.00 65535.00 /end CHARACTERISTIC
/begin CHARACTERISTIC DFC_CtlMsk.DFC_ComCtrCrshSwoEkpSig_FA_C "DFC/Verhaltens Kontroll Maske für Prüfung DFC_ComCtrCrshSwoEkpSig_FA" VALUE 0x80022D2C Val_Wu16 65535.00 DFES_OneToOne 0.00 65535.00 /end CHARACTERISTIC
/begin CHARACTERISTIC DFC_CtlMsk.DFC_ComCtrCrshSwoEkpTo_FA_C "DFC/Verhaltens Kontroll Maske für Prüfung DFC_ComCtrCrshSwoEkpTo_FA" VALUE 0x80022D2E Val_Wu16 65535.00 DFES_OneToOne 0.00 65535.00 /end CHARACTERISTIC
/begin CHARACTERISTIC DFC_CtlMsk.DFC_ComCtrSecInt_C "DFC/Verhaltens Kontroll Maske für Prüfung DFC_ComCtrSecInt" VALUE 0x80022D30 Val_Wu16 65535.00 DFES_OneToOne 0.00 65535.00 /end CHARACTERISTIC
/begin CHARACTERISTIC DFC_CtlMsk.DFC_ComDiaOBDGbxSig_A_C "DFC/Verhaltens Kontroll Maske für Prüfung DFC_ComDiaOBDGbxSig_A" VALUE 0x80022D32 Val_Wu16 65535.00 DFES_OneToOne 0.00 65535.00 /end CHARACTERISTIC
/begin CHARACTERISTIC DFC_CtlMsk.DFC_ComDiaOBDGbxTo_A_C "DFC/Verhaltens Kontroll Maske für Prüfung DFC_ComDiaOBDGbxTo_A" VALUE 0x80022D34 Val_Wu16 65535.00 DFES_OneToOne 0.00 65535.00 /end CHARACTERISTIC
/begin CHARACTERISTIC DFC_CtlMsk.DFC_ComFahrzeugtypSig_C "DFC/Verhaltens Kontroll Maske für Prüfung DFC_ComFahrzeugtypSig" VALUE 0x80022D36 Val_Wu16 65535.00 DFES_OneToOne 0.00 65535.00 /end CHARACTERISTIC
/begin CHARACTERISTIC DFC_CtlMsk.DFC_ComFahrzeugtypSig_FA_C "DFC/Verhaltens Kontroll Maske für Prüfung DFC_ComFahrzeugtypSig_FA" VALUE 0x80022D38 Val_Wu16 65535.00 DFES_OneToOne 0.00 65535.00 /end CHARACTERISTIC
/begin CHARACTERISTIC DFC_CtlMsk.DFC_ComFllupGpwsupSig_FA_C "DFC/Verhaltens Kontroll Maske für Prüfung DFC_ComFllupGpwsupSig_FA" VALUE 0x80022D3A Val_Wu16 65535.00 DFES_OneToOne 0.00 65535.00 /end CHARACTERISTIC
/begin CHARACTERISTIC DFC_CtlMsk.DFC_ComFllupGpwsupTo_FA_C "DFC/Verhaltens Kontroll Maske für Prüfung DFC_ComFllupGpwsupTo_FA" VALUE 0x80022D3C Val_Wu16 65535.00 DFES_OneToOne 0.00 65535.00 /end CHARACTERISTIC
/begin CHARACTERISTIC DFC_CtlMsk.DFC_ComGbxDataChk_A_C "DFC/Verhaltens Kontroll Maske für Prüfung DFC_ComGbxDataChk_A" VALUE 0x80022D3E Val_Wu16 65535.00 DFES_OneToOne 0.00 65535.00 /end CHARACTERISTIC
/begin CHARACTERISTIC DFC_CtlMsk.DFC_ComGbxDataChk_FA_C "DFC/Verhaltens Kontroll Maske für Prüfung DFC_ComGbxDataChk_FA" VALUE 0x80022D40 Val_Wu16 65535.00 DFES_OneToOne 0.00 65535.00 /end CHARACTERISTIC
/begin CHARACTERISTIC DFC_CtlMsk.DFC_ComGbxDataCtr_A_C "DFC/Verhaltens Kontroll Maske für Prüfung DFC_ComGbxDataCtr_A" VALUE 0x80022D42 Val_Wu16 65535.00 DFES_OneToOne 0.00 65535.00 /end CHARACTERISTIC
/begin CHARACTERISTIC DFC_CtlMsk.DFC_ComGbxDataCtr_FA_C "DFC/Verhaltens Kontroll Maske für Prüfung DFC_ComGbxDataCtr_FA" VALUE 0x80022D44 Val_Wu16 65535.00 DFES_OneToOne 0.00 65535.00 /end CHARACTERISTIC
/begin CHARACTERISTIC DFC_CtlMsk.DFC_ComGbxDataSig_A_C "DFC/Verhaltens Kontroll Maske für Prüfung DFC_ComGbxDataSig_A" VALUE 0x80022D46 Val_Wu16 65535.00 DFES_OneToOne 0.00 65535.00 /end CHARACTERISTIC
/begin CHARACTERISTIC DFC_CtlMsk.DFC_ComGbxDataSig_FA_C "DFC/Verhaltens Kontroll Maske für Prüfung DFC_ComGbxDataSig_FA" VALUE 0x80022D48 Val_Wu16 65535.00 DFES_OneToOne 0.00 65535.00 /end CHARACTERISTIC
/begin CHARACTERISTIC DFC_CtlMsk.DFC_ComGbxDataTo_A_C "DFC/Verhaltens Kontroll Maske für Prüfung DFC_ComGbxDataTo_A" VALUE 0x80022D4A Val_Wu16 65535.00 DFES_OneToOne 0.00 65535.00 /end CHARACTERISTIC
/begin CHARACTERISTIC DFC_CtlMsk.DFC_ComGbxDataTo_FA_C "DFC/Verhaltens Kontroll Maske für Prüfung DFC_ComGbxDataTo_FA" VALUE 0x80022D4C Val_Wu16 65535.00 DFES_OneToOne 0.00 65535.00 /end CHARACTERISTIC
/begin CHARACTERISTIC DFC_CtlMsk.DFC_ComKlemmenChk_FA_C "DFC/Verhaltens Kontroll Maske für Prüfung DFC_ComKlemmenChk_FA" VALUE 0x80022D4E Val_Wu16 65535.00 DFES_OneToOne 0.00 65535.00 /end CHARACTERISTIC
/begin CHARACTERISTIC DFC_CtlMsk.DFC_ComKlemmenCtr_FA_C "DFC/Verhaltens Kontroll Maske für Prüfung DFC_ComKlemmenCtr_FA" VALUE 0x80022D50 Val_Wu16 65535.00 DFES_OneToOne 0.00 65535.00 /end CHARACTERISTIC
/begin CHARACTERISTIC DFC_CtlMsk.DFC_ComKlemmenSig_FA_C "DFC/Verhaltens Kontroll Maske für Prüfung DFC_ComKlemmenSig_FA" VALUE 0x80022D52 Val_Wu16 65535.00 DFES_OneToOne 0.00 65535.00 /end CHARACTERISTIC
/begin CHARACTERISTIC DFC_CtlMsk.DFC_ComKlemmenTo_FA_C "DFC/Verhaltens Kontroll Maske für Prüfung DFC_ComKlemmenTo_FA" VALUE 0x80022D54 Val_Wu16 65535.00 DFES_OneToOne 0.00 65535.00 /end CHARACTERISTIC
/begin CHARACTERISTIC DFC_CtlMsk.DFC_ComLenkradwinkelSig_C "DFC/Verhaltens Kontroll Maske für Prüfung DFC_ComLenkradwinkelSig" VALUE 0x80022D56 Val_Wu16 65535.00 DFES_OneToOne 0.00 65535.00 /end CHARACTERISTIC
/begin CHARACTERISTIC DFC_CtlMsk.DFC_ComLenkradwinkelTo_C "DFC/Verhaltens Kontroll Maske für Prüfung DFC_ComLenkradwinkelTo" VALUE 0x80022D58 Val_Wu16 65535.00 DFES_OneToOne 0.00 65535.00 /end CHARACTERISTIC
/begin CHARACTERISTIC DFC_CtlMsk.DFC_ComMileageRangeSig_FA_C "DFC/Verhaltens Kontroll Maske für Prüfung DFC_ComMileageRangeSig_FA" VALUE 0x80022D5A Val_Wu16 65535.00 DFES_OneToOne 0.00 65535.00 /end CHARACTERISTIC
/begin CHARACTERISTIC DFC_CtlMsk.DFC_ComMileageRangeTo_FA_C "DFC/Verhaltens Kontroll Maske für Prüfung DFC_ComMileageRangeTo_FA" VALUE 0x80022D5C Val_Wu16 65535.00 DFES_OneToOne 0.00 65535.00 /end CHARACTERISTIC
/begin CHARACTERISTIC DFC_CtlMsk.DFC_ComPspSig_C "DFC/Verhaltens Kontroll Maske für Prüfung DFC_ComPspSig" VALUE 0x80022D5E Val_Wu16 65535.00 DFES_OneToOne 0.00 65535.00 /end CHARACTERISTIC
/begin CHARACTERISTIC DFC_CtlMsk.DFC_ComPspTo_C "DFC/Verhaltens Kontroll Maske für Prüfung DFC_ComPspTo" VALUE 0x80022D60 Val_Wu16 65535.00 DFES_OneToOne 0.00 65535.00 /end CHARACTERISTIC
/begin CHARACTERISTIC DFC_CtlMsk.DFC_ComRelTimeSig_FA_C "DFC/Verhaltens Kontroll Maske für Prüfung DFC_ComRelTimeSig_FA" VALUE 0x80022D62 Val_Wu16 65535.00 DFES_OneToOne 0.00 65535.00 /end CHARACTERISTIC
/begin CHARACTERISTIC DFC_CtlMsk.DFC_ComRelTimeTo_FA_C "DFC/Verhaltens Kontroll Maske für Prüfung DFC_ComRelTimeTo_FA" VALUE 0x80022D64 Val_Wu16 65535.00 DFES_OneToOne 0.00 65535.00 /end CHARACTERISTIC
/begin CHARACTERISTIC DFC_CtlMsk.DFC_ComRequestEMFChk_C "DFC/Verhaltens Kontroll Maske für Prüfung DFC_ComRequestEMFChk" VALUE 0x80022D66 Val_Wu16 65535.00 DFES_OneToOne 0.00 65535.00 /end CHARACTERISTIC
/begin CHARACTERISTIC DFC_CtlMsk.DFC_ComRequestEMFCtr_C "DFC/Verhaltens Kontroll Maske für Prüfung DFC_ComRequestEMFCtr" VALUE 0x80022D68 Val_Wu16 65535.00 DFES_OneToOne 0.00 65535.00 /end CHARACTERISTIC
/begin CHARACTERISTIC DFC_CtlMsk.DFC_ComRequestEMFSig_C "DFC/Verhaltens Kontroll Maske für Prüfung DFC_ComRequestEMFSig" VALUE 0x80022D6A Val_Wu16 65535.00 DFES_OneToOne 0.00 65535.00 /end CHARACTERISTIC
/begin CHARACTERISTIC DFC_CtlMsk.DFC_ComRequestEMFTo_C "DFC/Verhaltens Kontroll Maske für Prüfung DFC_ComRequestEMFTo" VALUE 0x80022D6C Val_Wu16 65535.00 DFES_OneToOne 0.00 65535.00 /end CHARACTERISTIC
/begin CHARACTERISTIC DFC_CtlMsk.DFC_ComRpmWhlChk_FX_C "DFC/Verhaltens Kontroll Maske für Prüfung DFC_ComRpmWhlChk_FX" VALUE 0x80022D6E Val_Wu16 65535.00 DFES_OneToOne 0.00 65535.00 /end CHARACTERISTIC
/begin CHARACTERISTIC DFC_CtlMsk.DFC_ComRpmWhlCtr_FX_C "DFC/Verhaltens Kontroll Maske für Prüfung DFC_ComRpmWhlCtr_FX" VALUE 0x80022D70 Val_Wu16 65535.00 DFES_OneToOne 0.00 65535.00 /end CHARACTERISTIC
/begin CHARACTERISTIC DFC_CtlMsk.DFC_ComRpmWhlTo_FX_C "DFC/Verhaltens Kontroll Maske für Prüfung DFC_ComRpmWhlTo_FX" VALUE 0x80022D72 Val_Wu16 65535.00 DFES_OneToOne 0.00 65535.00 /end CHARACTERISTIC
/begin CHARACTERISTIC DFC_CtlMsk.DFC_ComSecCtrRelSig_FA_C "DFC/Verhaltens Kontroll Maske für Prüfung DFC_ComSecCtrRelSig_FA" VALUE 0x80022D74 Val_Wu16 65535.00 DFES_OneToOne 0.00 65535.00 /end CHARACTERISTIC
/begin CHARACTERISTIC DFC_CtlMsk.DFC_ComSecCtrRelTo_FA_C "DFC/Verhaltens Kontroll Maske für Prüfung DFC_ComSecCtrRelTo_FA" VALUE 0x80022D76 Val_Wu16 65535.00 DFES_OneToOne 0.00 65535.00 /end CHARACTERISTIC
/begin CHARACTERISTIC DFC_CtlMsk.DFC_ComSensNOxGndSig_C "DFC/Verhaltens Kontroll Maske für Prüfung DFC_ComSensNOxGndSig" VALUE 0x80022D78 Val_Wu16 65535.00 DFES_OneToOne 0.00 65535.00 /end CHARACTERISTIC
/begin CHARACTERISTIC DFC_CtlMsk.DFC_ComSensNOxGndTo_C "DFC/Verhaltens Kontroll Maske für Prüfung DFC_ComSensNOxGndTo" VALUE 0x80022D7A Val_Wu16 65535.00 DFES_OneToOne 0.00 65535.00 /end CHARACTERISTIC
/begin CHARACTERISTIC DFC_CtlMsk.DFC_ComSensNOxMode_C "DFC/Verhaltens Kontroll Maske für Prüfung DFC_ComSensNOxMode" VALUE 0x80022D7C Val_Wu16 65535.00 DFES_OneToOne 0.00 65535.00 /end CHARACTERISTIC
/begin CHARACTERISTIC DFC_CtlMsk.DFC_ComSensNOxUbattSig_C "DFC/Verhaltens Kontroll Maske für Prüfung DFC_ComSensNOxUbattSig" VALUE 0x80022D7E Val_Wu16 65535.00 DFES_OneToOne 0.00 65535.00 /end CHARACTERISTIC
/begin CHARACTERISTIC DFC_CtlMsk.DFC_ComSensNOxUbattTo_C "DFC/Verhaltens Kontroll Maske für Prüfung DFC_ComSensNOxUbattTo" VALUE 0x80022D80 Val_Wu16 65535.00 DFES_OneToOne 0.00 65535.00 /end CHARACTERISTIC
/begin CHARACTERISTIC DFC_CtlMsk.DFC_ComShiftPaddleTo_FX_C "DFC/Verhaltens Kontroll Maske für Prüfung DFC_ComShiftPaddleTo_FX" VALUE 0x80022D82 Val_Wu16 65535.00 DFES_OneToOne 0.00 65535.00 /end CHARACTERISTIC
/begin CHARACTERISTIC DFC_CtlMsk.DFC_ComShutOffPSPSig_C "DFC/Verhaltens Kontroll Maske für Prüfung DFC_ComShutOffPSPSig" VALUE 0x80022D84 Val_Wu16 65535.00 DFES_OneToOne 0.00 65535.00 /end CHARACTERISTIC
/begin CHARACTERISTIC DFC_CtlMsk.DFC_ComShutOffPSPTo_C "DFC/Verhaltens Kontroll Maske für Prüfung DFC_ComShutOffPSPTo" VALUE 0x80022D86 Val_Wu16 65535.00 DFES_OneToOne 0.00 65535.00 /end CHARACTERISTIC
/begin CHARACTERISTIC DFC_CtlMsk.DFC_ComSlrdiGlbFZMTo_FA_C "DFC/Verhaltens Kontroll Maske für Prüfung DFC_ComSlrdiGlbFZMTo_FA" VALUE 0x80022D88 Val_Wu16 65535.00 DFES_OneToOne 0.00 65535.00 /end CHARACTERISTIC
/begin CHARACTERISTIC DFC_CtlMsk.DFC_ComSlrdiGlbFZMTo_FX_C "DFC/Verhaltens Kontroll Maske für Prüfung DFC_ComSlrdiGlbFZMTo_FX" VALUE 0x80022D8A Val_Wu16 65535.00 DFES_OneToOne 0.00 65535.00 /end CHARACTERISTIC
/begin CHARACTERISTIC DFC_CtlMsk.DFC_ComSpeedVehicleChk_FX_C "DFC/Verhaltens Kontroll Maske für Prüfung DFC_ComSpeedVehicleChk_FX" VALUE 0x80022D8C Val_Wu16 65535.00 DFES_OneToOne 0.00 65535.00 /end CHARACTERISTIC
/begin CHARACTERISTIC DFC_CtlMsk.DFC_ComSpeedVehicleCtr_FX_C "DFC/Verhaltens Kontroll Maske für Prüfung DFC_ComSpeedVehicleCtr_FX" VALUE 0x80022D8E Val_Wu16 65535.00 DFES_OneToOne 0.00 65535.00 /end CHARACTERISTIC
/begin CHARACTERISTIC DFC_CtlMsk.DFC_ComSpeedVehicleTo_FX_C "DFC/Verhaltens Kontroll Maske für Prüfung DFC_ComSpeedVehicleTo_FX" VALUE 0x80022D90 Val_Wu16 65535.00 DFES_OneToOne 0.00 65535.00 /end CHARACTERISTIC
/begin CHARACTERISTIC DFC_CtlMsk.DFC_ComStConintDSCChk_FX_C "DFC/Verhaltens Kontroll Maske für Prüfung DFC_ComStConintDSCChk_FX" VALUE 0x80022D92 Val_Wu16 65535.00 DFES_OneToOne 0.00 65535.00 /end CHARACTERISTIC
/begin CHARACTERISTIC DFC_CtlMsk.DFC_ComStConintDSCCtr_FX_C "DFC/Verhaltens Kontroll Maske für Prüfung DFC_ComStConintDSCCtr_FX" VALUE 0x80022D94 Val_Wu16 65535.00 DFES_OneToOne 0.00 65535.00 /end CHARACTERISTIC
/begin CHARACTERISTIC DFC_CtlMsk.DFC_ComStConintDSCTo_FX_C "DFC/Verhaltens Kontroll Maske für Prüfung DFC_ComStConintDSCTo_FX" VALUE 0x80022D96 Val_Wu16 65535.00 DFES_OneToOne 0.00 65535.00 /end CHARACTERISTIC
/begin CHARACTERISTIC DFC_CtlMsk.DFC_ComStatACFrontSig_FA_C "DFC/Verhaltens Kontroll Maske für Prüfung DFC_ComStatACFrontSig_FA" VALUE 0x80022D98 Val_Wu16 65535.00 DFES_OneToOne 0.00 65535.00 /end CHARACTERISTIC
/begin CHARACTERISTIC DFC_CtlMsk.DFC_ComStatACFrontTo_FA_C "DFC/Verhaltens Kontroll Maske für Prüfung DFC_ComStatACFrontTo_FA" VALUE 0x80022D9A Val_Wu16 65535.00 DFES_OneToOne 0.00 65535.00 /end CHARACTERISTIC
/begin CHARACTERISTIC DFC_CtlMsk.DFC_ComStatEkpSig_A_C "DFC/Verhaltens Kontroll Maske für Prüfung DFC_ComStatEkpSig_A" VALUE 0x80022D9C Val_Wu16 65535.00 DFES_OneToOne 0.00 65535.00 /end CHARACTERISTIC
/begin CHARACTERISTIC DFC_CtlMsk.DFC_ComStatEkpTo_A_C "DFC/Verhaltens Kontroll Maske für Prüfung DFC_ComStatEkpTo_A" VALUE 0x80022D9E Val_Wu16 65535.00 DFES_OneToOne 0.00 65535.00 /end CHARACTERISTIC
/begin CHARACTERISTIC DFC_CtlMsk.DFC_ComStatGearRevSig_FA_C "DFC/Verhaltens Kontroll Maske für Prüfung DFC_ComStatGearRevSig_FA" VALUE 0x80022DA0 Val_Wu16 65535.00 DFES_OneToOne 0.00 65535.00 /end CHARACTERISTIC
/begin CHARACTERISTIC DFC_CtlMsk.DFC_ComStatGearRevTo_FA_C "DFC/Verhaltens Kontroll Maske für Prüfung DFC_ComStatGearRevTo_FA" VALUE 0x80022DA2 Val_Wu16 65535.00 DFES_OneToOne 0.00 65535.00 /end CHARACTERISTIC
/begin CHARACTERISTIC DFC_CtlMsk.DFC_ComStatZVKlappenSig_FA_C "DFC/Verhaltens Kontroll Maske für Prüfung DFC_ComStatZVKlappenSig_FA" VALUE 0x80022DA4 Val_Wu16 65535.00 DFES_OneToOne 0.00 65535.00 /end CHARACTERISTIC
/begin CHARACTERISTIC DFC_CtlMsk.DFC_ComStatZVKlappenTo_FA_C "DFC/Verhaltens Kontroll Maske für Prüfung DFC_ComStatZVKlappenTo_FA" VALUE 0x80022DA6 Val_Wu16 65535.00 DFES_OneToOne 0.00 65535.00 /end CHARACTERISTIC
/begin CHARACTERISTIC DFC_CtlMsk.DFC_ComStateARSCtr_C "DFC/Verhaltens Kontroll Maske für Prüfung DFC_ComStateARSCtr" VALUE 0x80022DA8 Val_Wu16 65535.00 DFES_OneToOne 0.00 65535.00 /end CHARACTERISTIC
/begin CHARACTERISTIC DFC_CtlMsk.DFC_ComStateARSSig_C "DFC/Verhaltens Kontroll Maske für Prüfung DFC_ComStateARSSig" VALUE 0x80022DAA Val_Wu16 65535.00 DFES_OneToOne 0.00 65535.00 /end CHARACTERISTIC
/begin CHARACTERISTIC DFC_CtlMsk.DFC_ComStateARSTo_C "DFC/Verhaltens Kontroll Maske für Prüfung DFC_ComStateARSTo" VALUE 0x80022DAC Val_Wu16 65535.00 DFES_OneToOne 0.00 65535.00 /end CHARACTERISTIC
/begin CHARACTERISTIC DFC_CtlMsk.DFC_ComStateDscSig_C "DFC/Verhaltens Kontroll Maske für Prüfung DFC_ComStateDscSig" VALUE 0x80022DAE Val_Wu16 65535.00 DFES_OneToOne 0.00 65535.00 /end CHARACTERISTIC
/begin CHARACTERISTIC DFC_CtlMsk.DFC_ComStateDscTo_C "DFC/Verhaltens Kontroll Maske für Prüfung DFC_ComStateDscTo" VALUE 0x80022DB0 Val_Wu16 65535.00 DFES_OneToOne 0.00 65535.00 /end CHARACTERISTIC
/begin CHARACTERISTIC DFC_CtlMsk.DFC_ComStateSeatSig_C "DFC/Verhaltens Kontroll Maske für Prüfung DFC_ComStateSeatSig" VALUE 0x80022DB2 Val_Wu16 65535.00 DFES_OneToOne 0.00 65535.00 /end CHARACTERISTIC
/begin CHARACTERISTIC DFC_CtlMsk.DFC_ComStateSeatSig_FA_C "DFC/Verhaltens Kontroll Maske für Prüfung DFC_ComStateSeatSig_FA" VALUE 0x80022DB4 Val_Wu16 65535.00 DFES_OneToOne 0.00 65535.00 /end CHARACTERISTIC
/begin CHARACTERISTIC DFC_CtlMsk.DFC_ComStateSeatTo_C "DFC/Verhaltens Kontroll Maske für Prüfung DFC_ComStateSeatTo" VALUE 0x80022DB6 Val_Wu16 65535.00 DFES_OneToOne 0.00 65535.00 /end CHARACTERISTIC
/begin CHARACTERISTIC DFC_CtlMsk.DFC_ComStateSeatTo_FA_C "DFC/Verhaltens Kontroll Maske für Prüfung DFC_ComStateSeatTo_FA" VALUE 0x80022DB8 Val_Wu16 65535.00 DFES_OneToOne 0.00 65535.00 /end CHARACTERISTIC
/begin CHARACTERISTIC DFC_CtlMsk.DFC_ComStatusEGSSig_A_C "DFC/Verhaltens Kontroll Maske für Prüfung DFC_ComStatusEGSSig_A" VALUE 0x80022DBA Val_Wu16 65535.00 DFES_OneToOne 0.00 65535.00 /end CHARACTERISTIC
/begin CHARACTERISTIC DFC_CtlMsk.DFC_ComStatusEGSSig_FA_C "DFC/Verhaltens Kontroll Maske für Prüfung DFC_ComStatusEGSSig_FA" VALUE 0x80022DBC Val_Wu16 65535.00 DFES_OneToOne 0.00 65535.00 /end CHARACTERISTIC
/begin CHARACTERISTIC DFC_CtlMsk.DFC_ComStatusEGSTo_A_C "DFC/Verhaltens Kontroll Maske für Prüfung DFC_ComStatusEGSTo_A" VALUE 0x80022DBE Val_Wu16 65535.00 DFES_OneToOne 0.00 65535.00 /end CHARACTERISTIC
/begin CHARACTERISTIC DFC_CtlMsk.DFC_ComStatusEGSTo_FA_C "DFC/Verhaltens Kontroll Maske für Prüfung DFC_ComStatusEGSTo_FA" VALUE 0x80022DC0 Val_Wu16 65535.00 DFES_OneToOne 0.00 65535.00 /end CHARACTERISTIC
/begin CHARACTERISTIC DFC_CtlMsk.DFC_ComStatusEMFChk_C "DFC/Verhaltens Kontroll Maske für Prüfung DFC_ComStatusEMFChk" VALUE 0x80022DC2 Val_Wu16 65535.00 DFES_OneToOne 0.00 65535.00 /end CHARACTERISTIC
/begin CHARACTERISTIC DFC_CtlMsk.DFC_ComStatusEMFCtr_C "DFC/Verhaltens Kontroll Maske für Prüfung DFC_ComStatusEMFCtr" VALUE 0x80022DC4 Val_Wu16 65535.00 DFES_OneToOne 0.00 65535.00 /end CHARACTERISTIC
/begin CHARACTERISTIC DFC_CtlMsk.DFC_ComStatusEMFSig_C "DFC/Verhaltens Kontroll Maske für Prüfung DFC_ComStatusEMFSig" VALUE 0x80022DC6 Val_Wu16 65535.00 DFES_OneToOne 0.00 65535.00 /end CHARACTERISTIC
/begin CHARACTERISTIC DFC_CtlMsk.DFC_ComStatusEMFTo_C "DFC/Verhaltens Kontroll Maske für Prüfung DFC_ComStatusEMFTo" VALUE 0x80022DC8 Val_Wu16 65535.00 DFES_OneToOne 0.00 65535.00 /end CHARACTERISTIC
/begin CHARACTERISTIC DFC_CtlMsk.DFC_ComStatusRGangSig_C "DFC/Verhaltens Kontroll Maske für Prüfung DFC_ComStatusRGangSig" VALUE 0x80022DCA Val_Wu16 65535.00 DFES_OneToOne 0.00 65535.00 /end CHARACTERISTIC
/begin CHARACTERISTIC DFC_CtlMsk.DFC_ComStatusRGangTo_C "DFC/Verhaltens Kontroll Maske für Prüfung DFC_ComStatusRGangTo" VALUE 0x80022DCC Val_Wu16 65535.00 DFES_OneToOne 0.00 65535.00 /end CHARACTERISTIC
/begin CHARACTERISTIC DFC_CtlMsk.DFC_ComSteeringAngleChk_FX_C "DFC/Verhaltens Kontroll Maske für Prüfung DFC_ComSteeringAngleChk_FX" VALUE 0x80022DCE Val_Wu16 65535.00 DFES_OneToOne 0.00 65535.00 /end CHARACTERISTIC
/begin CHARACTERISTIC DFC_CtlMsk.DFC_ComSteeringAngleCtr_FX_C "DFC/Verhaltens Kontroll Maske für Prüfung DFC_ComSteeringAngleCtr_FX" VALUE 0x80022DD0 Val_Wu16 65535.00 DFES_OneToOne 0.00 65535.00 /end CHARACTERISTIC
/begin CHARACTERISTIC DFC_CtlMsk.DFC_ComSteeringAngleTo_FX_C "DFC/Verhaltens Kontroll Maske für Prüfung DFC_ComSteeringAngleTo_FX" VALUE 0x80022DD2 Val_Wu16 65535.00 DFES_OneToOne 0.00 65535.00 /end CHARACTERISTIC
/begin CHARACTERISTIC DFC_CtlMsk.DFC_ComTerminalChk_C "DFC/Verhaltens Kontroll Maske für Prüfung DFC_ComTerminalChk" VALUE 0x80022DD4 Val_Wu16 65535.00 DFES_OneToOne 0.00 65535.00 /end CHARACTERISTIC
/begin CHARACTERISTIC DFC_CtlMsk.DFC_ComTerminalCtr_C "DFC/Verhaltens Kontroll Maske für Prüfung DFC_ComTerminalCtr" VALUE 0x80022DD6 Val_Wu16 65535.00 DFES_OneToOne 0.00 65535.00 /end CHARACTERISTIC
/begin CHARACTERISTIC DFC_CtlMsk.DFC_ComTerminalSig_C "DFC/Verhaltens Kontroll Maske für Prüfung DFC_ComTerminalSig" VALUE 0x80022DD8 Val_Wu16 65535.00 DFES_OneToOne 0.00 65535.00 /end CHARACTERISTIC
/begin CHARACTERISTIC DFC_CtlMsk.DFC_ComTerminalTo_C "DFC/Verhaltens Kontroll Maske für Prüfung DFC_ComTerminalTo" VALUE 0x80022DDA Val_Wu16 65535.00 DFES_OneToOne 0.00 65535.00 /end CHARACTERISTIC
/begin CHARACTERISTIC DFC_CtlMsk.DFC_ComTimeDateSig_FA_C "DFC/Verhaltens Kontroll Maske für Prüfung DFC_ComTimeDateSig_FA" VALUE 0x80022DDC Val_Wu16 65535.00 DFES_OneToOne 0.00 65535.00 /end CHARACTERISTIC
/begin CHARACTERISTIC DFC_CtlMsk.DFC_ComTimeDateTo_FA_C "DFC/Verhaltens Kontroll Maske für Prüfung DFC_ComTimeDateTo_FA" VALUE 0x80022DDE Val_Wu16 65535.00 DFES_OneToOne 0.00 65535.00 /end CHARACTERISTIC
/begin CHARACTERISTIC DFC_CtlMsk.DFC_ComTrailerSig_C "DFC/Verhaltens Kontroll Maske für Prüfung DFC_ComTrailerSig" VALUE 0x80022DE0 Val_Wu16 65535.00 DFES_OneToOne 0.00 65535.00 /end CHARACTERISTIC
/begin CHARACTERISTIC DFC_CtlMsk.DFC_ComTrailerSig_FA_C "DFC/Verhaltens Kontroll Maske für Prüfung DFC_ComTrailerSig_FA" VALUE 0x80022DE2 Val_Wu16 65535.00 DFES_OneToOne 0.00 65535.00 /end CHARACTERISTIC
/begin CHARACTERISTIC DFC_CtlMsk.DFC_ComTrailerTo_C "DFC/Verhaltens Kontroll Maske für Prüfung DFC_ComTrailerTo" VALUE 0x80022DE4 Val_Wu16 65535.00 DFES_OneToOne 0.00 65535.00 /end CHARACTERISTIC
/begin CHARACTERISTIC DFC_CtlMsk.DFC_ComTrailerTo_FA_C "DFC/Verhaltens Kontroll Maske für Prüfung DFC_ComTrailerTo_FA" VALUE 0x80022DE6 Val_Wu16 65535.00 DFES_OneToOne 0.00 65535.00 /end CHARACTERISTIC
/begin CHARACTERISTIC DFC_CtlMsk.DFC_ComTrqDemCrshDrDyChk_FX_C "DFC/Verhaltens Kontroll Maske für Prüfung DFC_ComTrqDemCrshDrDyChk_FX" VALUE 0x80022DE8 Val_Wu16 65535.00 DFES_OneToOne 0.00 65535.00 /end CHARACTERISTIC
/begin CHARACTERISTIC DFC_CtlMsk.DFC_ComTrqDemCrshDrDyCtr_FX_C "DFC/Verhaltens Kontroll Maske für Prüfung DFC_ComTrqDemCrshDrDyCtr_FX" VALUE 0x80022DEA Val_Wu16 65535.00 DFES_OneToOne 0.00 65535.00 /end CHARACTERISTIC
/begin CHARACTERISTIC DFC_CtlMsk.DFC_ComTrqDemCrshDrDyTo_FX_C "DFC/Verhaltens Kontroll Maske für Prüfung DFC_ComTrqDemCrshDrDyTo_FX" VALUE 0x80022DEC Val_Wu16 65535.00 DFES_OneToOne 0.00 65535.00 /end CHARACTERISTIC
/begin CHARACTERISTIC DFC_CtlMsk.DFC_ComTrqDemandDesSig_C "DFC/Verhaltens Kontroll Maske für Prüfung DFC_ComTrqDemandDesSig" VALUE 0x80022DEE Val_Wu16 65535.00 DFES_OneToOne 0.00 65535.00 /end CHARACTERISTIC
/begin CHARACTERISTIC DFC_CtlMsk.DFC_ComTrqDemandDesTo_C "DFC/Verhaltens Kontroll Maske für Prüfung DFC_ComTrqDemandDesTo" VALUE 0x80022DF0 Val_Wu16 65535.00 DFES_OneToOne 0.00 65535.00 /end CHARACTERISTIC
/begin CHARACTERISTIC DFC_CtlMsk.DFC_ComTrqDemandDscChk_C "DFC/Verhaltens Kontroll Maske für Prüfung DFC_ComTrqDemandDscChk" VALUE 0x80022DF2 Val_Wu16 65535.00 DFES_OneToOne 0.00 65535.00 /end CHARACTERISTIC
/begin CHARACTERISTIC DFC_CtlMsk.DFC_ComTrqDemandDscCtr_C "DFC/Verhaltens Kontroll Maske für Prüfung DFC_ComTrqDemandDscCtr" VALUE 0x80022DF4 Val_Wu16 65535.00 DFES_OneToOne 0.00 65535.00 /end CHARACTERISTIC
/begin CHARACTERISTIC DFC_CtlMsk.DFC_ComTrqDemandDscSig_C "DFC/Verhaltens Kontroll Maske für Prüfung DFC_ComTrqDemandDscSig" VALUE 0x80022DF6 Val_Wu16 65535.00 DFES_OneToOne 0.00 65535.00 /end CHARACTERISTIC
/begin CHARACTERISTIC DFC_CtlMsk.DFC_ComTrqDemandDscTo_C "DFC/Verhaltens Kontroll Maske für Prüfung DFC_ComTrqDemandDscTo" VALUE 0x80022DF8 Val_Wu16 65535.00 DFES_OneToOne 0.00 65535.00 /end CHARACTERISTIC
/begin CHARACTERISTIC DFC_CtlMsk.DFC_ComTrqDemandGbxChk_A_C "DFC/Verhaltens Kontroll Maske für Prüfung DFC_ComTrqDemandGbxChk_A" VALUE 0x80022DFA Val_Wu16 65535.00 DFES_OneToOne 0.00 65535.00 /end CHARACTERISTIC
/begin CHARACTERISTIC DFC_CtlMsk.DFC_ComTrqDemandGbxChk_FA_C "DFC/Verhaltens Kontroll Maske für Prüfung DFC_ComTrqDemandGbxChk_FA" VALUE 0x80022DFC Val_Wu16 65535.00 DFES_OneToOne 0.00 65535.00 /end CHARACTERISTIC
/begin CHARACTERISTIC DFC_CtlMsk.DFC_ComTrqDemandGbxCtr_A_C "DFC/Verhaltens Kontroll Maske für Prüfung DFC_ComTrqDemandGbxCtr_A" VALUE 0x80022DFE Val_Wu16 65535.00 DFES_OneToOne 0.00 65535.00 /end CHARACTERISTIC
/begin CHARACTERISTIC DFC_CtlMsk.DFC_ComTrqDemandGbxCtr_FA_C "DFC/Verhaltens Kontroll Maske für Prüfung DFC_ComTrqDemandGbxCtr_FA" VALUE 0x80022E00 Val_Wu16 65535.00 DFES_OneToOne 0.00 65535.00 /end CHARACTERISTIC
/begin CHARACTERISTIC DFC_CtlMsk.DFC_ComTrqDemandGbxSig_A_C "DFC/Verhaltens Kontroll Maske für Prüfung DFC_ComTrqDemandGbxSig_A" VALUE 0x80022E02 Val_Wu16 65535.00 DFES_OneToOne 0.00 65535.00 /end CHARACTERISTIC
/begin CHARACTERISTIC DFC_CtlMsk.DFC_ComTrqDemandGbxSig_FA_C "DFC/Verhaltens Kontroll Maske für Prüfung DFC_ComTrqDemandGbxSig_FA" VALUE 0x80022E04 Val_Wu16 65535.00 DFES_OneToOne 0.00 65535.00 /end CHARACTERISTIC
/begin CHARACTERISTIC DFC_CtlMsk.DFC_ComTrqDemandGbxTo_A_C "DFC/Verhaltens Kontroll Maske für Prüfung DFC_ComTrqDemandGbxTo_A" VALUE 0x80022E06 Val_Wu16 65535.00 DFES_OneToOne 0.00 65535.00 /end CHARACTERISTIC
/begin CHARACTERISTIC DFC_CtlMsk.DFC_ComTrqDemandGbxTo_FA_C "DFC/Verhaltens Kontroll Maske für Prüfung DFC_ComTrqDemandGbxTo_FA" VALUE 0x80022E08 Val_Wu16 65535.00 DFES_OneToOne 0.00 65535.00 /end CHARACTERISTIC
/begin CHARACTERISTIC DFC_CtlMsk.DFC_ComTrqWhlDemChk_C "DFC/Verhaltens Kontroll Maske für Prüfung DFC_ComTrqWhlDemChk" VALUE 0x80022E0A Val_Wu16 65535.00 DFES_OneToOne 0.00 65535.00 /end CHARACTERISTIC
/begin CHARACTERISTIC DFC_CtlMsk.DFC_ComTrqWhlDemCtr_C "DFC/Verhaltens Kontroll Maske für Prüfung DFC_ComTrqWhlDemCtr" VALUE 0x80022E0C Val_Wu16 65535.00 DFES_OneToOne 0.00 65535.00 /end CHARACTERISTIC
/begin CHARACTERISTIC DFC_CtlMsk.DFC_ComTrqWhlDemFASChk_FX_C "DFC/Verhaltens Kontroll Maske für Prüfung DFC_ComTrqWhlDemFASChk_FX" VALUE 0x80022E0E Val_Wu16 65535.00 DFES_OneToOne 0.00 65535.00 /end CHARACTERISTIC
/begin CHARACTERISTIC DFC_CtlMsk.DFC_ComTrqWhlDemFASCtr_FX_C "DFC/Verhaltens Kontroll Maske für Prüfung DFC_ComTrqWhlDemFASCtr_FX" VALUE 0x80022E10 Val_Wu16 65535.00 DFES_OneToOne 0.00 65535.00 /end CHARACTERISTIC
/begin CHARACTERISTIC DFC_CtlMsk.DFC_ComTrqWhlDemFASTo_FX_C "DFC/Verhaltens Kontroll Maske für Prüfung DFC_ComTrqWhlDemFASTo_FX" VALUE 0x80022E12 Val_Wu16 65535.00 DFES_OneToOne 0.00 65535.00 /end CHARACTERISTIC
/begin CHARACTERISTIC DFC_CtlMsk.DFC_ComTrqWhlDemSig_C "DFC/Verhaltens Kontroll Maske für Prüfung DFC_ComTrqWhlDemSig" VALUE 0x80022E14 Val_Wu16 65535.00 DFES_OneToOne 0.00 65535.00 /end CHARACTERISTIC
/begin CHARACTERISTIC DFC_CtlMsk.DFC_ComTrqWhlDemTo_C "DFC/Verhaltens Kontroll Maske für Prüfung DFC_ComTrqWhlDemTo" VALUE 0x80022E16 Val_Wu16 65535.00 DFES_OneToOne 0.00 65535.00 /end CHARACTERISTIC
/begin CHARACTERISTIC DFC_CtlMsk.DFC_ComVelocityChk_FA_C "DFC/Verhaltens Kontroll Maske für Prüfung DFC_ComVelocityChk_FA" VALUE 0x80022E18 Val_Wu16 65535.00 DFES_OneToOne 0.00 65535.00 /end CHARACTERISTIC
/begin CHARACTERISTIC DFC_CtlMsk.DFC_ComVelocityCtr_FA_C "DFC/Verhaltens Kontroll Maske für Prüfung DFC_ComVelocityCtr_FA" VALUE 0x80022E1A Val_Wu16 65535.00 DFES_OneToOne 0.00 65535.00 /end CHARACTERISTIC
/begin CHARACTERISTIC DFC_CtlMsk.DFC_ComVelocitySig_C "DFC/Verhaltens Kontroll Maske für Prüfung DFC_ComVelocitySig" VALUE 0x80022E1C Val_Wu16 65535.00 DFES_OneToOne 0.00 65535.00 /end CHARACTERISTIC
/begin CHARACTERISTIC DFC_CtlMsk.DFC_ComVelocitySig_FA_C "DFC/Verhaltens Kontroll Maske für Prüfung DFC_ComVelocitySig_FA" VALUE 0x80022E1E Val_Wu16 65535.00 DFES_OneToOne 0.00 65535.00 /end CHARACTERISTIC
/begin CHARACTERISTIC DFC_CtlMsk.DFC_ComVelocityTo_C "DFC/Verhaltens Kontroll Maske für Prüfung DFC_ComVelocityTo" VALUE 0x80022E20 Val_Wu16 65535.00 DFES_OneToOne 0.00 65535.00 /end CHARACTERISTIC
/begin CHARACTERISTIC DFC_CtlMsk.DFC_ComVelocityTo_FA_C "DFC/Verhaltens Kontroll Maske für Prüfung DFC_ComVelocityTo_FA" VALUE 0x80022E22 Val_Wu16 65535.00 DFES_OneToOne 0.00 65535.00 /end CHARACTERISTIC
/begin CHARACTERISTIC DFC_CtlMsk.DFC_ComVerbraucherTo_C "DFC/Verhaltens Kontroll Maske für Prüfung DFC_ComVerbraucherTo" VALUE 0x80022E24 Val_Wu16 65535.00 DFES_OneToOne 0.00 65535.00 /end CHARACTERISTIC
/begin CHARACTERISTIC DFC_CtlMsk.DFC_ComWMomPTStabChk_FX_C "DFC/Verhaltens Kontroll Maske für Prüfung DFC_ComWMomPTStabChk_FX" VALUE 0x80022E26 Val_Wu16 65535.00 DFES_OneToOne 0.00 65535.00 /end CHARACTERISTIC
/begin CHARACTERISTIC DFC_CtlMsk.DFC_ComWMomPTStabCtr_FX_C "DFC/Verhaltens Kontroll Maske für Prüfung DFC_ComWMomPTStabCtr_FX" VALUE 0x80022E28 Val_Wu16 65535.00 DFES_OneToOne 0.00 65535.00 /end CHARACTERISTIC
/begin CHARACTERISTIC DFC_CtlMsk.DFC_ComWMomPTStabTo_FX_C "DFC/Verhaltens Kontroll Maske für Prüfung DFC_ComWMomPTStabTo_FX" VALUE 0x80022E2A Val_Wu16 65535.00 DFES_OneToOne 0.00 65535.00 /end CHARACTERISTIC
/begin CHARACTERISTIC DFC_CtlMsk.DFC_ComWheelSpeedSig_C "DFC/Verhaltens Kontroll Maske für Prüfung DFC_ComWheelSpeedSig" VALUE 0x80022E2C Val_Wu16 65535.00 DFES_OneToOne 0.00 65535.00 /end CHARACTERISTIC
/begin CHARACTERISTIC DFC_CtlMsk.DFC_ComWheelSpeedTo_C "DFC/Verhaltens Kontroll Maske für Prüfung DFC_ComWheelSpeedTo" VALUE 0x80022E2E Val_Wu16 65535.00 DFES_OneToOne 0.00 65535.00 /end CHARACTERISTIC
/begin CHARACTERISTIC DFC_CtlMsk.DFC_ComZvKlappenSig_C "DFC/Verhaltens Kontroll Maske für Prüfung DFC_ComZvKlappenSig" VALUE 0x80022E30 Val_Wu16 65535.00 DFES_OneToOne 0.00 65535.00 /end CHARACTERISTIC
/begin CHARACTERISTIC DFC_CtlMsk.DFC_ComZvKlappenTo_C "DFC/Verhaltens Kontroll Maske für Prüfung DFC_ComZvKlappenTo" VALUE 0x80022E32 Val_Wu16 65535.00 DFES_OneToOne 0.00 65535.00 /end CHARACTERISTIC
/begin CHARACTERISTIC DFC_CtlMsk.DFC_ComaDirectChk_FX_C "DFC/Verhaltens Kontroll Maske für Prüfung DFC_ComaDirectChk_FX" VALUE 0x80022E34 Val_Wu16 65535.00 DFES_OneToOne 0.00 65535.00 /end CHARACTERISTIC
/begin CHARACTERISTIC DFC_CtlMsk.DFC_ComaDirectCtr_FX_C "DFC/Verhaltens Kontroll Maske für Prüfung DFC_ComaDirectCtr_FX" VALUE 0x80022E36 Val_Wu16 65535.00 DFES_OneToOne 0.00 65535.00 /end CHARACTERISTIC
/begin CHARACTERISTIC DFC_CtlMsk.DFC_ComaDirectTo_FX_C "DFC/Verhaltens Kontroll Maske für Prüfung DFC_ComaDirectTo_FX" VALUE 0x80022E38 Val_Wu16 65535.00 DFES_OneToOne 0.00 65535.00 /end CHARACTERISTIC
/begin CHARACTERISTIC DFC_CtlMsk.DFC_ComaSideChk_FX_C "DFC/Verhaltens Kontroll Maske für Prüfung DFC_ComaSideChk_FX" VALUE 0x80022E3A Val_Wu16 65535.00 DFES_OneToOne 0.00 65535.00 /end CHARACTERISTIC
/begin CHARACTERISTIC DFC_CtlMsk.DFC_ComaSideCtr_FX_C "DFC/Verhaltens Kontroll Maske für Prüfung DFC_ComaSideCtr_FX" VALUE 0x80022E3C Val_Wu16 65535.00 DFES_OneToOne 0.00 65535.00 /end CHARACTERISTIC
/begin CHARACTERISTIC DFC_CtlMsk.DFC_ComaSideTo_FX_C "DFC/Verhaltens Kontroll Maske für Prüfung DFC_ComaSideTo_FX" VALUE 0x80022E3E Val_Wu16 65535.00 DFES_OneToOne 0.00 65535.00 /end CHARACTERISTIC
/begin CHARACTERISTIC DFC_CtlMsk.DFC_Cy320SpiCom_C "DFC/Verhaltens Kontroll Maske für Prüfung DFC_Cy320SpiCom" VALUE 0x80022E40 Val_Wu16 65535.00 DFES_OneToOne 0.00 65535.00 /end CHARACTERISTIC
/begin CHARACTERISTIC DFC_CtlMsk.DFC_ETCtlDvtInrMax_C "DFC/Verhaltens Kontroll Maske für Prüfung DFC_ETCtlDvtInrMax" VALUE 0x80022E42 Val_Wu16 65535.00 DFES_OneToOne 0.00 65535.00 /end CHARACTERISTIC
/begin CHARACTERISTIC DFC_CtlMsk.DFC_ETCtlDvtInrMin_C "DFC/Verhaltens Kontroll Maske für Prüfung DFC_ETCtlDvtInrMin" VALUE 0x80022E44 Val_Wu16 65535.00 DFES_OneToOne 0.00 65535.00 /end CHARACTERISTIC
/begin CHARACTERISTIC DFC_CtlMsk.DFC_ETCtlDvtOutrMax_C "DFC/Verhaltens Kontroll Maske für Prüfung DFC_ETCtlDvtOutrMax" VALUE 0x80022E46 Val_Wu16 65535.00 DFES_OneToOne 0.00 65535.00 /end CHARACTERISTIC
/begin CHARACTERISTIC DFC_CtlMsk.DFC_ETCtlDvtOutrMin_C "DFC/Verhaltens Kontroll Maske für Prüfung DFC_ETCtlDvtOutrMin" VALUE 0x80022E48 Val_Wu16 65535.00 DFES_OneToOne 0.00 65535.00 /end CHARACTERISTIC
/begin CHARACTERISTIC DFC_CtlMsk.DFC_FBCqDvtMax_C "DFC/Verhaltens Kontroll Maske für Prüfung DFC_FBCqDvtMax" VALUE 0x80022E4A Val_Wu16 65535.00 DFES_OneToOne 0.00 65535.00 /end CHARACTERISTIC
/begin CHARACTERISTIC DFC_CtlMsk.DFC_FBCqDvtMin_C "DFC/Verhaltens Kontroll Maske für Prüfung DFC_FBCqDvtMin" VALUE 0x80022E4C Val_Wu16 65535.00 DFES_OneToOne 0.00 65535.00 /end CHARACTERISTIC
/begin CHARACTERISTIC DFC_CtlMsk.DFC_Fan4WinErr1_C "DFC/Verhaltens Kontroll Maske für Prüfung DFC_Fan4WinErr1" VALUE 0x80022E4E Val_Wu16 65535.00 DFES_OneToOne 0.00 65535.00 /end CHARACTERISTIC
/begin CHARACTERISTIC DFC_CtlMsk.DFC_Fan4WinErr2_C "DFC/Verhaltens Kontroll Maske für Prüfung DFC_Fan4WinErr2" VALUE 0x80022E50 Val_Wu16 65535.00 DFES_OneToOne 0.00 65535.00 /end CHARACTERISTIC
/begin CHARACTERISTIC DFC_CtlMsk.DFC_Fan4WinErr3_C "DFC/Verhaltens Kontroll Maske für Prüfung DFC_Fan4WinErr3" VALUE 0x80022E52 Val_Wu16 65535.00 DFES_OneToOne 0.00 65535.00 /end CHARACTERISTIC
/begin CHARACTERISTIC DFC_CtlMsk.DFC_Fan4WinErr4_C "DFC/Verhaltens Kontroll Maske für Prüfung DFC_Fan4WinErr4" VALUE 0x80022E54 Val_Wu16 65535.00 DFES_OneToOne 0.00 65535.00 /end CHARACTERISTIC
/begin CHARACTERISTIC DFC_CtlMsk.DFC_FanSCG_C "DFC/Verhaltens Kontroll Maske für Prüfung DFC_FanSCG" VALUE 0x80022E56 Val_Wu16 65535.00 DFES_OneToOne 0.00 65535.00 /end CHARACTERISTIC
/begin CHARACTERISTIC DFC_CtlMsk.DFC_FlFCBS_C "DFC/Verhaltens Kontroll Maske für Prüfung DFC_FlFCBS" VALUE 0x80022E58 Val_Wu16 65535.00 DFES_OneToOne 0.00 65535.00 /end CHARACTERISTIC
/begin CHARACTERISTIC DFC_CtlMsk.DFC_GlwEcuConfigErr_C "DFC/Verhaltens Kontroll Maske für Prüfung DFC_GlwEcuConfigErr" VALUE 0x80022E5A Val_Wu16 65535.00 DFES_OneToOne 0.00 65535.00 /end CHARACTERISTIC
/begin CHARACTERISTIC DFC_CtlMsk.DFC_GlwEcuEepErr_C "DFC/Verhaltens Kontroll Maske für Prüfung DFC_GlwEcuEepErr" VALUE 0x80022E5C Val_Wu16 65535.00 DFES_OneToOne 0.00 65535.00 /end CHARACTERISTIC
/begin CHARACTERISTIC DFC_CtlMsk.DFC_GlwEcuFrmErr_C "DFC/Verhaltens Kontroll Maske für Prüfung DFC_GlwEcuFrmErr" VALUE 0x80022E5E Val_Wu16 65535.00 DFES_OneToOne 0.00 65535.00 /end CHARACTERISTIC
/begin CHARACTERISTIC DFC_CtlMsk.DFC_GlwEcuGPCMFaultInfo_C "DFC/Verhaltens Kontroll Maske für Prüfung DFC_GlwEcuGPCMFaultInfo" VALUE 0x80022E60 Val_Wu16 65535.00 DFES_OneToOne 0.00 65535.00 /end CHARACTERISTIC
/begin CHARACTERISTIC DFC_CtlMsk.DFC_GlwEcuGPCMInfo_C "DFC/Verhaltens Kontroll Maske für Prüfung DFC_GlwEcuGPCMInfo" VALUE 0x80022E62 Val_Wu16 65535.00 DFES_OneToOne 0.00 65535.00 /end CHARACTERISTIC
/begin CHARACTERISTIC DFC_CtlMsk.DFC_GlwEcuGk1HSS_C "DFC/Verhaltens Kontroll Maske für Prüfung DFC_GlwEcuGk1HSS" VALUE 0x80022E64 Val_Wu16 65535.00 DFES_OneToOne 0.00 65535.00 /end CHARACTERISTIC
/begin CHARACTERISTIC DFC_CtlMsk.DFC_GlwEcuGk1OL_C "DFC/Verhaltens Kontroll Maske für Prüfung DFC_GlwEcuGk1OL" VALUE 0x80022E66 Val_Wu16 65535.00 DFES_OneToOne 0.00 65535.00 /end CHARACTERISTIC
/begin CHARACTERISTIC DFC_CtlMsk.DFC_GlwEcuGk1SC_C "DFC/Verhaltens Kontroll Maske für Prüfung DFC_GlwEcuGk1SC" VALUE 0x80022E68 Val_Wu16 65535.00 DFES_OneToOne 0.00 65535.00 /end CHARACTERISTIC
/begin CHARACTERISTIC DFC_CtlMsk.DFC_GlwEcuGk1Wdst_C "DFC/Verhaltens Kontroll Maske für Prüfung DFC_GlwEcuGk1Wdst" VALUE 0x80022E6A Val_Wu16 65535.00 DFES_OneToOne 0.00 65535.00 /end CHARACTERISTIC
/begin CHARACTERISTIC DFC_CtlMsk.DFC_GlwEcuGk2HSS_C "DFC/Verhaltens Kontroll Maske für Prüfung DFC_GlwEcuGk2HSS" VALUE 0x80022E6C Val_Wu16 65535.00 DFES_OneToOne 0.00 65535.00 /end CHARACTERISTIC
/begin CHARACTERISTIC DFC_CtlMsk.DFC_GlwEcuGk2OL_C "DFC/Verhaltens Kontroll Maske für Prüfung DFC_GlwEcuGk2OL" VALUE 0x80022E6E Val_Wu16 65535.00 DFES_OneToOne 0.00 65535.00 /end CHARACTERISTIC
/begin CHARACTERISTIC DFC_CtlMsk.DFC_GlwEcuGk2SC_C "DFC/Verhaltens Kontroll Maske für Prüfung DFC_GlwEcuGk2SC" VALUE 0x80022E70 Val_Wu16 65535.00 DFES_OneToOne 0.00 65535.00 /end CHARACTERISTIC
/begin CHARACTERISTIC DFC_CtlMsk.DFC_GlwEcuGk2Wdst_C "DFC/Verhaltens Kontroll Maske für Prüfung DFC_GlwEcuGk2Wdst" VALUE 0x80022E72 Val_Wu16 65535.00 DFES_OneToOne 0.00 65535.00 /end CHARACTERISTIC
/begin CHARACTERISTIC DFC_CtlMsk.DFC_GlwEcuGk3HSS_C "DFC/Verhaltens Kontroll Maske für Prüfung DFC_GlwEcuGk3HSS" VALUE 0x80022E74 Val_Wu16 65535.00 DFES_OneToOne 0.00 65535.00 /end CHARACTERISTIC
/begin CHARACTERISTIC DFC_CtlMsk.DFC_GlwEcuGk3OL_C "DFC/Verhaltens Kontroll Maske für Prüfung DFC_GlwEcuGk3OL" VALUE 0x80022E76 Val_Wu16 65535.00 DFES_OneToOne 0.00 65535.00 /end CHARACTERISTIC
/begin CHARACTERISTIC DFC_CtlMsk.DFC_GlwEcuGk3SC_C "DFC/Verhaltens Kontroll Maske für Prüfung DFC_GlwEcuGk3SC" VALUE 0x80022E78 Val_Wu16 65535.00 DFES_OneToOne 0.00 65535.00 /end CHARACTERISTIC
/begin CHARACTERISTIC DFC_CtlMsk.DFC_GlwEcuGk3Wdst_C "DFC/Verhaltens Kontroll Maske für Prüfung DFC_GlwEcuGk3Wdst" VALUE 0x80022E7A Val_Wu16 65535.00 DFES_OneToOne 0.00 65535.00 /end CHARACTERISTIC
/begin CHARACTERISTIC DFC_CtlMsk.DFC_GlwEcuGk4HSS_C "DFC/Verhaltens Kontroll Maske für Prüfung DFC_GlwEcuGk4HSS" VALUE 0x80022E7C Val_Wu16 65535.00 DFES_OneToOne 0.00 65535.00 /end CHARACTERISTIC
/begin CHARACTERISTIC DFC_CtlMsk.DFC_GlwEcuGk4OL_C "DFC/Verhaltens Kontroll Maske für Prüfung DFC_GlwEcuGk4OL" VALUE 0x80022E7E Val_Wu16 65535.00 DFES_OneToOne 0.00 65535.00 /end CHARACTERISTIC
/begin CHARACTERISTIC DFC_CtlMsk.DFC_GlwEcuGk4SC_C "DFC/Verhaltens Kontroll Maske für Prüfung DFC_GlwEcuGk4SC" VALUE 0x80022E80 Val_Wu16 65535.00 DFES_OneToOne 0.00 65535.00 /end CHARACTERISTIC
/begin CHARACTERISTIC DFC_CtlMsk.DFC_GlwEcuGk4Wdst_C "DFC/Verhaltens Kontroll Maske für Prüfung DFC_GlwEcuGk4Wdst" VALUE 0x80022E82 Val_Wu16 65535.00 DFES_OneToOne 0.00 65535.00 /end CHARACTERISTIC
/begin CHARACTERISTIC DFC_CtlMsk.DFC_GlwEcuGk5HSS_C "DFC/Verhaltens Kontroll Maske für Prüfung DFC_GlwEcuGk5HSS" VALUE 0x80022E84 Val_Wu16 65535.00 DFES_OneToOne 0.00 65535.00 /end CHARACTERISTIC
/begin CHARACTERISTIC DFC_CtlMsk.DFC_GlwEcuGk5OL_C "DFC/Verhaltens Kontroll Maske für Prüfung DFC_GlwEcuGk5OL" VALUE 0x80022E86 Val_Wu16 65535.00 DFES_OneToOne 0.00 65535.00 /end CHARACTERISTIC
/begin CHARACTERISTIC DFC_CtlMsk.DFC_GlwEcuGk5SC_C "DFC/Verhaltens Kontroll Maske für Prüfung DFC_GlwEcuGk5SC" VALUE 0x80022E88 Val_Wu16 65535.00 DFES_OneToOne 0.00 65535.00 /end CHARACTERISTIC
/begin CHARACTERISTIC DFC_CtlMsk.DFC_GlwEcuGk5Wdst_C "DFC/Verhaltens Kontroll Maske für Prüfung DFC_GlwEcuGk5Wdst" VALUE 0x80022E8A Val_Wu16 65535.00 DFES_OneToOne 0.00 65535.00 /end CHARACTERISTIC
/begin CHARACTERISTIC DFC_CtlMsk.DFC_GlwEcuGk6HSS_C "DFC/Verhaltens Kontroll Maske für Prüfung DFC_GlwEcuGk6HSS" VALUE 0x80022E8C Val_Wu16 65535.00 DFES_OneToOne 0.00 65535.00 /end CHARACTERISTIC
/begin CHARACTERISTIC DFC_CtlMsk.DFC_GlwEcuGk6OL_C "DFC/Verhaltens Kontroll Maske für Prüfung DFC_GlwEcuGk6OL" VALUE 0x80022E8E Val_Wu16 65535.00 DFES_OneToOne 0.00 65535.00 /end CHARACTERISTIC
/begin CHARACTERISTIC DFC_CtlMsk.DFC_GlwEcuGk6SC_C "DFC/Verhaltens Kontroll Maske für Prüfung DFC_GlwEcuGk6SC" VALUE 0x80022E90 Val_Wu16 65535.00 DFES_OneToOne 0.00 65535.00 /end CHARACTERISTIC
/begin CHARACTERISTIC DFC_CtlMsk.DFC_GlwEcuGk6Wdst_C "DFC/Verhaltens Kontroll Maske für Prüfung DFC_GlwEcuGk6Wdst" VALUE 0x80022E92 Val_Wu16 65535.00 DFES_OneToOne 0.00 65535.00 /end CHARACTERISTIC
/begin CHARACTERISTIC DFC_CtlMsk.DFC_GlwEcuGndErr_C "DFC/Verhaltens Kontroll Maske für Prüfung DFC_GlwEcuGndErr" VALUE 0x80022E94 Val_Wu16 65535.00 DFES_OneToOne 0.00 65535.00 /end CHARACTERISTIC
/begin CHARACTERISTIC DFC_CtlMsk.DFC_GlwEcuIntErr_C "DFC/Verhaltens Kontroll Maske für Prüfung DFC_GlwEcuIntErr" VALUE 0x80022E96 Val_Wu16 65535.00 DFES_OneToOne 0.00 65535.00 /end CHARACTERISTIC
/begin CHARACTERISTIC DFC_CtlMsk.DFC_GlwEcuMsgTimeout_C "DFC/Verhaltens Kontroll Maske für Prüfung DFC_GlwEcuMsgTimeout" VALUE 0x80022E98 Val_Wu16 65535.00 DFES_OneToOne 0.00 65535.00 /end CHARACTERISTIC
/begin CHARACTERISTIC DFC_CtlMsk.DFC_GlwEcuT30Err_C "DFC/Verhaltens Kontroll Maske für Prüfung DFC_GlwEcuT30Err" VALUE 0x80022E9A Val_Wu16 65535.00 DFES_OneToOne 0.00 65535.00 /end CHARACTERISTIC
/begin CHARACTERISTIC DFC_CtlMsk.DFC_GlwEcuTempErr_C "DFC/Verhaltens Kontroll Maske für Prüfung DFC_GlwEcuTempErr" VALUE 0x80022E9C Val_Wu16 65535.00 DFES_OneToOne 0.00 65535.00 /end CHARACTERISTIC
/begin CHARACTERISTIC DFC_CtlMsk.DFC_GlwEcuUdiffT30_C "DFC/Verhaltens Kontroll Maske für Prüfung DFC_GlwEcuUdiffT30" VALUE 0x80022E9E Val_Wu16 65535.00 DFES_OneToOne 0.00 65535.00 /end CHARACTERISTIC
/begin CHARACTERISTIC DFC_CtlMsk.DFC_IBSComErr_C "DFC/Verhaltens Kontroll Maske für Prüfung DFC_IBSComErr" VALUE 0x80022EA0 Val_Wu16 65535.00 DFES_OneToOne 0.00 65535.00 /end CHARACTERISTIC
/begin CHARACTERISTIC DFC_CtlMsk.DFC_LubSRCOilFldtCrit_C "DFC/Verhaltens Kontroll Maske für Prüfung DFC_LubSRCOilFldtCrit" VALUE 0x80022EA2 Val_Wu16 65535.00 DFES_OneToOne 0.00 65535.00 /end CHARACTERISTIC
/begin CHARACTERISTIC DFC_CtlMsk.DFC_LubSRCOilFldtCritDflMin_C "DFC/Verhaltens Kontroll Maske für Prüfung DFC_LubSRCOilFldtCritDflMin" VALUE 0x80022EA4 Val_Wu16 65535.00 DFES_OneToOne 0.00 65535.00 /end CHARACTERISTIC
/begin CHARACTERISTIC DFC_CtlMsk.DFC_LubSRCOilLvlCritMax_C "DFC/Verhaltens Kontroll Maske für Prüfung DFC_LubSRCOilLvlCritMax" VALUE 0x80022EA6 Val_Wu16 65535.00 DFES_OneToOne 0.00 65535.00 /end CHARACTERISTIC
/begin CHARACTERISTIC DFC_CtlMsk.DFC_LubSRCOilLvlCritMin_C "DFC/Verhaltens Kontroll Maske für Prüfung DFC_LubSRCOilLvlCritMin" VALUE 0x80022EA8 Val_Wu16 65535.00 DFES_OneToOne 0.00 65535.00 /end CHARACTERISTIC
/begin CHARACTERISTIC DFC_CtlMsk.DFC_LubSRCTot_C "DFC/Verhaltens Kontroll Maske für Prüfung DFC_LubSRCTot" VALUE 0x80022EAA Val_Wu16 65535.00 DFES_OneToOne 0.00 65535.00 /end CHARACTERISTIC
/begin CHARACTERISTIC DFC_CtlMsk.DFC_MonUMaxSupply1_C "DFC/Verhaltens Kontroll Maske für Prüfung DFC_MonUMaxSupply1" VALUE 0x80022EAC Val_Wu16 65535.00 DFES_OneToOne 0.00 65535.00 /end CHARACTERISTIC
/begin CHARACTERISTIC DFC_CtlMsk.DFC_MonUMinSupply1_C "DFC/Verhaltens Kontroll Maske für Prüfung DFC_MonUMinSupply1" VALUE 0x80022EAE Val_Wu16 65535.00 DFES_OneToOne 0.00 65535.00 /end CHARACTERISTIC
/begin CHARACTERISTIC DFC_CtlMsk.DFC_OilComNpl_C "DFC/Verhaltens Kontroll Maske für Prüfung DFC_OilComNpl" VALUE 0x80022EB0 Val_Wu16 65535.00 DFES_OneToOne 0.00 65535.00 /end CHARACTERISTIC
/begin CHARACTERISTIC DFC_CtlMsk.DFC_PCBS_C "DFC/Verhaltens Kontroll Maske für Prüfung DFC_PCBS" VALUE 0x80022EB2 Val_Wu16 65535.00 DFES_OneToOne 0.00 65535.00 /end CHARACTERISTIC
/begin CHARACTERISTIC DFC_CtlMsk.DFC_PCBSPFltChg_C "DFC/Verhaltens Kontroll Maske für Prüfung DFC_PCBSPFltChg" VALUE 0x80022EB4 Val_Wu16 65535.00 DFES_OneToOne 0.00 65535.00 /end CHARACTERISTIC
/begin CHARACTERISTIC DFC_CtlMsk.DFC_PCRGovDvtLPMax_C "DFC/Verhaltens Kontroll Maske für Prüfung DFC_PCRGovDvtLPMax" VALUE 0x80022EB6 Val_Wu16 65535.00 DFES_OneToOne 0.00 65535.00 /end CHARACTERISTIC
/begin CHARACTERISTIC DFC_CtlMsk.DFC_PCRGovDvtLPMin_C "DFC/Verhaltens Kontroll Maske für Prüfung DFC_PCRGovDvtLPMin" VALUE 0x80022EB8 Val_Wu16 65535.00 DFES_OneToOne 0.00 65535.00 /end CHARACTERISTIC
/begin CHARACTERISTIC DFC_CtlMsk.DFC_PCRGovDvtMax_C "DFC/Verhaltens Kontroll Maske für Prüfung DFC_PCRGovDvtMax" VALUE 0x80022EBA Val_Wu16 65535.00 DFES_OneToOne 0.00 65535.00 /end CHARACTERISTIC
/begin CHARACTERISTIC DFC_CtlMsk.DFC_PCRGovDvtMin_C "DFC/Verhaltens Kontroll Maske für Prüfung DFC_PCRGovDvtMin" VALUE 0x80022EBC Val_Wu16 65535.00 DFES_OneToOne 0.00 65535.00 /end CHARACTERISTIC
/begin CHARACTERISTIC DFC_CtlMsk.DFC_PFltAPSPlausMAX_C "DFC/Verhaltens Kontroll Maske für Prüfung DFC_PFltAPSPlausMAX" VALUE 0x80022EBE Val_Wu16 65535.00 DFES_OneToOne 0.00 65535.00 /end CHARACTERISTIC
/begin CHARACTERISTIC DFC_CtlMsk.DFC_PFltAPSPlausMIN_C "DFC/Verhaltens Kontroll Maske für Prüfung DFC_PFltAPSPlausMIN" VALUE 0x80022EC0 Val_Wu16 65535.00 DFES_OneToOne 0.00 65535.00 /end CHARACTERISTIC
/begin CHARACTERISTIC DFC_CtlMsk.DFC_PFltBPSPlausMAX_C "DFC/Verhaltens Kontroll Maske für Prüfung DFC_PFltBPSPlausMAX" VALUE 0x80022EC2 Val_Wu16 65535.00 DFES_OneToOne 0.00 65535.00 /end CHARACTERISTIC
/begin CHARACTERISTIC DFC_CtlMsk.DFC_PFltBPSPlausMIN_C "DFC/Verhaltens Kontroll Maske für Prüfung DFC_PFltBPSPlausMIN" VALUE 0x80022EC4 Val_Wu16 65535.00 DFES_OneToOne 0.00 65535.00 /end CHARACTERISTIC
/begin CHARACTERISTIC DFC_CtlMsk.DFC_PFltOvldInhRgn_C "DFC/Verhaltens Kontroll Maske für Prüfung DFC_PFltOvldInhRgn" VALUE 0x80022EC6 Val_Wu16 65535.00 DFES_OneToOne 0.00 65535.00 /end CHARACTERISTIC
/begin CHARACTERISTIC DFC_CtlMsk.DFC_PFltOvldTrqLim_C "DFC/Verhaltens Kontroll Maske für Prüfung DFC_PFltOvldTrqLim" VALUE 0x80022EC8 Val_Wu16 65535.00 DFES_OneToOne 0.00 65535.00 /end CHARACTERISTIC
/begin CHARACTERISTIC DFC_CtlMsk.DFC_PFltPresPlausMAX_C "DFC/Verhaltens Kontroll Maske für Prüfung DFC_PFltPresPlausMAX" VALUE 0x80022ECA Val_Wu16 65535.00 DFES_OneToOne 0.00 65535.00 /end CHARACTERISTIC
/begin CHARACTERISTIC DFC_CtlMsk.DFC_PFltPresPlausMIN_C "DFC/Verhaltens Kontroll Maske für Prüfung DFC_PFltPresPlausMIN" VALUE 0x80022ECC Val_Wu16 65535.00 DFES_OneToOne 0.00 65535.00 /end CHARACTERISTIC
/begin CHARACTERISTIC DFC_CtlMsk.DFC_PFltTraRpmRdc_C "DFC/Verhaltens Kontroll Maske für Prüfung DFC_PFltTraRpmRdc" VALUE 0x80022ECE Val_Wu16 65535.00 DFES_OneToOne 0.00 65535.00 /end CHARACTERISTIC
/begin CHARACTERISTIC DFC_CtlMsk.DFC_PFlt_tOxiPreMax_C "DFC/Verhaltens Kontroll Maske für Prüfung DFC_PFlt_tOxiPreMax" VALUE 0x80022ED0 Val_Wu16 65535.00 DFES_OneToOne 0.00 65535.00 /end CHARACTERISTIC
/begin CHARACTERISTIC DFC_CtlMsk.DFC_PFlt_tOxiPreMaxRgn_C "DFC/Verhaltens Kontroll Maske für Prüfung DFC_PFlt_tOxiPreMaxRgn" VALUE 0x80022ED2 Val_Wu16 65535.00 DFES_OneToOne 0.00 65535.00 /end CHARACTERISTIC
/begin CHARACTERISTIC DFC_CtlMsk.DFC_PFlt_tOxiPreNpl_C "DFC/Verhaltens Kontroll Maske für Prüfung DFC_PFlt_tOxiPreNpl" VALUE 0x80022ED4 Val_Wu16 65535.00 DFES_OneToOne 0.00 65535.00 /end CHARACTERISTIC
/begin CHARACTERISTIC DFC_CtlMsk.DFC_PFlt_tPreMax_C "DFC/Verhaltens Kontroll Maske für Prüfung DFC_PFlt_tPreMax" VALUE 0x80022ED6 Val_Wu16 65535.00 DFES_OneToOne 0.00 65535.00 /end CHARACTERISTIC
/begin CHARACTERISTIC DFC_CtlMsk.DFC_PFlt_tPreMaxRgn_C "DFC/Verhaltens Kontroll Maske für Prüfung DFC_PFlt_tPreMaxRgn" VALUE 0x80022ED8 Val_Wu16 65535.00 DFES_OneToOne 0.00 65535.00 /end CHARACTERISTIC
/begin CHARACTERISTIC DFC_CtlMsk.DFC_PFlt_tPreNpl_C "DFC/Verhaltens Kontroll Maske für Prüfung DFC_PFlt_tPreNpl" VALUE 0x80022EDA Val_Wu16 65535.00 DFES_OneToOne 0.00 65535.00 /end CHARACTERISTIC
/begin CHARACTERISTIC DFC_CtlMsk.DFC_PFltmSotDiffMAX_C "DFC/Verhaltens Kontroll Maske für Prüfung DFC_PFltmSotDiffMAX" VALUE 0x80022EDC Val_Wu16 65535.00 DFES_OneToOne 0.00 65535.00 /end CHARACTERISTIC
/begin CHARACTERISTIC DFC_CtlMsk.DFC_PFltmSotDiffMIN_C "DFC/Verhaltens Kontroll Maske für Prüfung DFC_PFltmSotDiffMIN" VALUE 0x80022EDE Val_Wu16 65535.00 DFES_OneToOne 0.00 65535.00 /end CHARACTERISTIC
/begin CHARACTERISTIC DFC_CtlMsk.DFC_PFltmSotDiffSIG_C "DFC/Verhaltens Kontroll Maske für Prüfung DFC_PFltmSotDiffSIG" VALUE 0x80022EE0 Val_Wu16 65535.00 DFES_OneToOne 0.00 65535.00 /end CHARACTERISTIC
/begin CHARACTERISTIC DFC_CtlMsk.DFC_PIntkVUsEnvPPls_C "DFC/Verhaltens Kontroll Maske für Prüfung DFC_PIntkVUsEnvPPls" VALUE 0x80022EE2 Val_Wu16 65535.00 DFES_OneToOne 0.00 65535.00 /end CHARACTERISTIC
/begin CHARACTERISTIC DFC_CtlMsk.DFC_PresPlausDblDef_C "DFC/Verhaltens Kontroll Maske für Prüfung DFC_PresPlausDblDef" VALUE 0x80022EE4 Val_Wu16 65535.00 DFES_OneToOne 0.00 65535.00 /end CHARACTERISTIC
/begin CHARACTERISTIC DFC_CtlMsk.DFC_RailCPC1_C "DFC/Verhaltens Kontroll Maske für Prüfung DFC_RailCPC1" VALUE 0x80022EE6 Val_Wu16 65535.00 DFES_OneToOne 0.00 65535.00 /end CHARACTERISTIC
/begin CHARACTERISTIC DFC_CtlMsk.DFC_RailCPC3_C "DFC/Verhaltens Kontroll Maske für Prüfung DFC_RailCPC3" VALUE 0x80022EE8 Val_Wu16 65535.00 DFES_OneToOne 0.00 65535.00 /end CHARACTERISTIC
/begin CHARACTERISTIC DFC_CtlMsk.DFC_RailCPC4_C "DFC/Verhaltens Kontroll Maske für Prüfung DFC_RailCPC4" VALUE 0x80022EEA Val_Wu16 65535.00 DFES_OneToOne 0.00 65535.00 /end CHARACTERISTIC
/begin CHARACTERISTIC DFC_CtlMsk.DFC_RailMeUn0_C "DFC/Verhaltens Kontroll Maske für Prüfung DFC_RailMeUn0" VALUE 0x80022EEC Val_Wu16 65535.00 DFES_OneToOne 0.00 65535.00 /end CHARACTERISTIC
/begin CHARACTERISTIC DFC_CtlMsk.DFC_RailMeUn1_C "DFC/Verhaltens Kontroll Maske für Prüfung DFC_RailMeUn1" VALUE 0x80022EEE Val_Wu16 65535.00 DFES_OneToOne 0.00 65535.00 /end CHARACTERISTIC
/begin CHARACTERISTIC DFC_CtlMsk.DFC_RailMeUn2_C "DFC/Verhaltens Kontroll Maske für Prüfung DFC_RailMeUn2" VALUE 0x80022EF0 Val_Wu16 65535.00 DFES_OneToOne 0.00 65535.00 /end CHARACTERISTIC
/begin CHARACTERISTIC DFC_CtlMsk.DFC_RailMeUn22_C "DFC/Verhaltens Kontroll Maske für Prüfung DFC_RailMeUn22" VALUE 0x80022EF2 Val_Wu16 65535.00 DFES_OneToOne 0.00 65535.00 /end CHARACTERISTIC
/begin CHARACTERISTIC DFC_CtlMsk.DFC_RailMeUn3_C "DFC/Verhaltens Kontroll Maske für Prüfung DFC_RailMeUn3" VALUE 0x80022EF4 Val_Wu16 65535.00 DFES_OneToOne 0.00 65535.00 /end CHARACTERISTIC
/begin CHARACTERISTIC DFC_CtlMsk.DFC_RailMeUn4_C "DFC/Verhaltens Kontroll Maske für Prüfung DFC_RailMeUn4" VALUE 0x80022EF6 Val_Wu16 65535.00 DFES_OneToOne 0.00 65535.00 /end CHARACTERISTIC
/begin CHARACTERISTIC DFC_CtlMsk.DFC_RailMeUn42_C "DFC/Verhaltens Kontroll Maske für Prüfung DFC_RailMeUn42" VALUE 0x80022EF8 Val_Wu16 65535.00 DFES_OneToOne 0.00 65535.00 /end CHARACTERISTIC
/begin CHARACTERISTIC DFC_CtlMsk.DFC_RailMeUn5_C "DFC/Verhaltens Kontroll Maske für Prüfung DFC_RailMeUn5" VALUE 0x80022EFA Val_Wu16 65535.00 DFES_OneToOne 0.00 65535.00 /end CHARACTERISTIC
/begin CHARACTERISTIC DFC_CtlMsk.DFC_RailPCV0_C "DFC/Verhaltens Kontroll Maske für Prüfung DFC_RailPCV0" VALUE 0x80022EFC Val_Wu16 65535.00 DFES_OneToOne 0.00 65535.00 /end CHARACTERISTIC
/begin CHARACTERISTIC DFC_CtlMsk.DFC_RailPCV1_C "DFC/Verhaltens Kontroll Maske für Prüfung DFC_RailPCV1" VALUE 0x80022EFE Val_Wu16 65535.00 DFES_OneToOne 0.00 65535.00 /end CHARACTERISTIC
/begin CHARACTERISTIC DFC_CtlMsk.DFC_RailPCV2_C "DFC/Verhaltens Kontroll Maske für Prüfung DFC_RailPCV2" VALUE 0x80022F00 Val_Wu16 65535.00 DFES_OneToOne 0.00 65535.00 /end CHARACTERISTIC
/begin CHARACTERISTIC DFC_CtlMsk.DFC_RailPCV22_C "DFC/Verhaltens Kontroll Maske für Prüfung DFC_RailPCV22" VALUE 0x80022F02 Val_Wu16 65535.00 DFES_OneToOne 0.00 65535.00 /end CHARACTERISTIC
/begin CHARACTERISTIC DFC_CtlMsk.DFC_RailPCV3_C "DFC/Verhaltens Kontroll Maske für Prüfung DFC_RailPCV3" VALUE 0x80022F04 Val_Wu16 65535.00 DFES_OneToOne 0.00 65535.00 /end CHARACTERISTIC
/begin CHARACTERISTIC DFC_CtlMsk.DFC_RailPCV4_C "DFC/Verhaltens Kontroll Maske für Prüfung DFC_RailPCV4" VALUE 0x80022F06 Val_Wu16 65535.00 DFES_OneToOne 0.00 65535.00 /end CHARACTERISTIC
/begin CHARACTERISTIC DFC_CtlMsk.DFC_RailPCV42_C "DFC/Verhaltens Kontroll Maske für Prüfung DFC_RailPCV42" VALUE 0x80022F08 Val_Wu16 65535.00 DFES_OneToOne 0.00 65535.00 /end CHARACTERISTIC
/begin CHARACTERISTIC DFC_CtlMsk.DFC_RailPMonStrt_C "DFC/Verhaltens Kontroll Maske für Prüfung DFC_RailPMonStrt" VALUE 0x80022F0A Val_Wu16 65535.00 DFES_OneToOne 0.00 65535.00 /end CHARACTERISTIC
/begin CHARACTERISTIC DFC_CtlMsk.DFC_SSpMon1_C "DFC/Verhaltens Kontroll Maske für Prüfung DFC_SSpMon1" VALUE 0x80022F0C Val_Wu16 65535.00 DFES_OneToOne 0.00 65535.00 /end CHARACTERISTIC
/begin CHARACTERISTIC DFC_CtlMsk.DFC_SSpMon2_C "DFC/Verhaltens Kontroll Maske für Prüfung DFC_SSpMon2" VALUE 0x80022F0E Val_Wu16 65535.00 DFES_OneToOne 0.00 65535.00 /end CHARACTERISTIC
/begin CHARACTERISTIC DFC_CtlMsk.DFC_SSpMon3_C "DFC/Verhaltens Kontroll Maske für Prüfung DFC_SSpMon3" VALUE 0x80022F10 Val_Wu16 65535.00 DFES_OneToOne 0.00 65535.00 /end CHARACTERISTIC
/begin CHARACTERISTIC DFC_CtlMsk.DFC_ThrVlv4WinErr1_C "DFC/Verhaltens Kontroll Maske für Prüfung DFC_ThrVlv4WinErr1" VALUE 0x80022F12 Val_Wu16 65535.00 DFES_OneToOne 0.00 65535.00 /end CHARACTERISTIC
/begin CHARACTERISTIC DFC_CtlMsk.DFC_ThrVlv4WinErr2_C "DFC/Verhaltens Kontroll Maske für Prüfung DFC_ThrVlv4WinErr2" VALUE 0x80022F14 Val_Wu16 65535.00 DFES_OneToOne 0.00 65535.00 /end CHARACTERISTIC
/begin CHARACTERISTIC DFC_CtlMsk.DFC_ThrVlv4WinErr3_C "DFC/Verhaltens Kontroll Maske für Prüfung DFC_ThrVlv4WinErr3" VALUE 0x80022F16 Val_Wu16 65535.00 DFES_OneToOne 0.00 65535.00 /end CHARACTERISTIC
/begin CHARACTERISTIC DFC_CtlMsk.DFC_ThrVlv4WinErr4_C "DFC/Verhaltens Kontroll Maske für Prüfung DFC_ThrVlv4WinErr4" VALUE 0x80022F18 Val_Wu16 65535.00 DFES_OneToOne 0.00 65535.00 /end CHARACTERISTIC
/begin CHARACTERISTIC DFC_CtlMsk.DFC_ThrVlvSCG_C "DFC/Verhaltens Kontroll Maske für Prüfung DFC_ThrVlvSCG" VALUE 0x80022F1A Val_Wu16 65535.00 DFES_OneToOne 0.00 65535.00 /end CHARACTERISTIC
/begin CHARACTERISTIC DFC_CtlMsk.DFC_Tle6232Spi1_C "DFC/Verhaltens Kontroll Maske für Prüfung DFC_Tle6232Spi1" VALUE 0x80022F1C Val_Wu16 65535.00 DFES_OneToOne 0.00 65535.00 /end CHARACTERISTIC
/begin CHARACTERISTIC DFC_CtlMsk.DFC_TrbCh4WinErr1_C "DFC/Verhaltens Kontroll Maske für Prüfung DFC_TrbCh4WinErr1" VALUE 0x80022F1E Val_Wu16 65535.00 DFES_OneToOne 0.00 65535.00 /end CHARACTERISTIC
/begin CHARACTERISTIC DFC_CtlMsk.DFC_TrbCh4WinErr2_C "DFC/Verhaltens Kontroll Maske für Prüfung DFC_TrbCh4WinErr2" VALUE 0x80022F20 Val_Wu16 65535.00 DFES_OneToOne 0.00 65535.00 /end CHARACTERISTIC
/begin CHARACTERISTIC DFC_CtlMsk.DFC_TrbCh4WinErr3_C "DFC/Verhaltens Kontroll Maske für Prüfung DFC_TrbCh4WinErr3" VALUE 0x80022F22 Val_Wu16 65535.00 DFES_OneToOne 0.00 65535.00 /end CHARACTERISTIC
/begin CHARACTERISTIC DFC_CtlMsk.DFC_TrbCh4WinErr4_C "DFC/Verhaltens Kontroll Maske für Prüfung DFC_TrbCh4WinErr4" VALUE 0x80022F24 Val_Wu16 65535.00 DFES_OneToOne 0.00 65535.00 /end CHARACTERISTIC
/begin CHARACTERISTIC DFC_CtlMsk.DFC_TrbChSCG_C "DFC/Verhaltens Kontroll Maske für Prüfung DFC_TrbChSCG" VALUE 0x80022F26 Val_Wu16 65535.00 DFES_OneToOne 0.00 65535.00 /end CHARACTERISTIC
/begin CHARACTERISTIC DFC_CtlMsk.DFC_TrbChSRCMax_C "DFC/Verhaltens Kontroll Maske für Prüfung DFC_TrbChSRCMax" VALUE 0x80022F28 Val_Wu16 65535.00 DFES_OneToOne 0.00 65535.00 /end CHARACTERISTIC
/begin CHARACTERISTIC DFC_CtlMsk.DFC_TrbChSRCMin_C "DFC/Verhaltens Kontroll Maske für Prüfung DFC_TrbChSRCMin" VALUE 0x80022F2A Val_Wu16 65535.00 DFES_OneToOne 0.00 65535.00 /end CHARACTERISTIC
/begin CHARACTERISTIC DFC_CtlMsk.DFC_WaHtEl4WinErr1_C "DFC/Verhaltens Kontroll Maske für Prüfung DFC_WaHtEl4WinErr1" VALUE 0x80022F2C Val_Wu16 65535.00 DFES_OneToOne 0.00 65535.00 /end CHARACTERISTIC
/begin CHARACTERISTIC DFC_CtlMsk.DFC_WaHtEl4WinErr2_C "DFC/Verhaltens Kontroll Maske für Prüfung DFC_WaHtEl4WinErr2" VALUE 0x80022F2E Val_Wu16 65535.00 DFES_OneToOne 0.00 65535.00 /end CHARACTERISTIC
/begin CHARACTERISTIC DFC_CtlMsk.DFC_WaHtEl4WinErr3_C "DFC/Verhaltens Kontroll Maske für Prüfung DFC_WaHtEl4WinErr3" VALUE 0x80022F30 Val_Wu16 65535.00 DFES_OneToOne 0.00 65535.00 /end CHARACTERISTIC
/begin CHARACTERISTIC DFC_CtlMsk.DFC_WaHtEl4WinErr4_C "DFC/Verhaltens Kontroll Maske für Prüfung DFC_WaHtEl4WinErr4" VALUE 0x80022F32 Val_Wu16 65535.00 DFES_OneToOne 0.00 65535.00 /end CHARACTERISTIC
/begin CHARACTERISTIC DFC_CtlMsk.DFC_WaHtElSCG_C "DFC/Verhaltens Kontroll Maske für Prüfung DFC_WaHtElSCG" VALUE 0x80022F34 Val_Wu16 65535.00 DFES_OneToOne 0.00 65535.00 /end CHARACTERISTIC
/begin CHARACTERISTIC DFC_CtlMsk.DFC_ETClbETFltMax_0_C "DFC/Verhaltens Kontroll Maske für Prüfung DFC_ETClbETFltMax_0" VALUE 0x80022F36 Val_Wu16 65535.00 DFES_OneToOne 0.00 65535.00 /end CHARACTERISTIC
/begin CHARACTERISTIC DFC_CtlMsk.DFC_ETClbETFltMax_1_C "DFC/Verhaltens Kontroll Maske für Prüfung DFC_ETClbETFltMax_1" VALUE 0x80022F38 Val_Wu16 65535.00 DFES_OneToOne 0.00 65535.00 /end CHARACTERISTIC
/begin CHARACTERISTIC DFC_CtlMsk.DFC_ETClbETFltMax_2_C "DFC/Verhaltens Kontroll Maske für Prüfung DFC_ETClbETFltMax_2" VALUE 0x80022F3A Val_Wu16 65535.00 DFES_OneToOne 0.00 65535.00 /end CHARACTERISTIC
/begin CHARACTERISTIC DFC_CtlMsk.DFC_ETClbETFltMax_3_C "DFC/Verhaltens Kontroll Maske für Prüfung DFC_ETClbETFltMax_3" VALUE 0x80022F3C Val_Wu16 65535.00 DFES_OneToOne 0.00 65535.00 /end CHARACTERISTIC
/begin CHARACTERISTIC DFC_CtlMsk.DFC_ETClbETFltMax_4_C "DFC/Verhaltens Kontroll Maske für Prüfung DFC_ETClbETFltMax_4" VALUE 0x80022F3E Val_Wu16 65535.00 DFES_OneToOne 0.00 65535.00 /end CHARACTERISTIC
/begin CHARACTERISTIC DFC_CtlMsk.DFC_ETClbETFltMax_5_C "DFC/Verhaltens Kontroll Maske für Prüfung DFC_ETClbETFltMax_5" VALUE 0x80022F40 Val_Wu16 65535.00 DFES_OneToOne 0.00 65535.00 /end CHARACTERISTIC
/begin CHARACTERISTIC DFC_CtlMsk.DFC_ETClbETFltMin_0_C "DFC/Verhaltens Kontroll Maske für Prüfung DFC_ETClbETFltMin_0" VALUE 0x80022F42 Val_Wu16 65535.00 DFES_OneToOne 0.00 65535.00 /end CHARACTERISTIC
/begin CHARACTERISTIC DFC_CtlMsk.DFC_ETClbETFltMin_1_C "DFC/Verhaltens Kontroll Maske für Prüfung DFC_ETClbETFltMin_1" VALUE 0x80022F44 Val_Wu16 65535.00 DFES_OneToOne 0.00 65535.00 /end CHARACTERISTIC
/begin CHARACTERISTIC DFC_CtlMsk.DFC_ETClbETFltMin_2_C "DFC/Verhaltens Kontroll Maske für Prüfung DFC_ETClbETFltMin_2" VALUE 0x80022F46 Val_Wu16 65535.00 DFES_OneToOne 0.00 65535.00 /end CHARACTERISTIC
/begin CHARACTERISTIC DFC_CtlMsk.DFC_ETClbETFltMin_3_C "DFC/Verhaltens Kontroll Maske für Prüfung DFC_ETClbETFltMin_3" VALUE 0x80022F48 Val_Wu16 65535.00 DFES_OneToOne 0.00 65535.00 /end CHARACTERISTIC
/begin CHARACTERISTIC DFC_CtlMsk.DFC_ETClbETFltMin_4_C "DFC/Verhaltens Kontroll Maske für Prüfung DFC_ETClbETFltMin_4" VALUE 0x80022F4A Val_Wu16 65535.00 DFES_OneToOne 0.00 65535.00 /end CHARACTERISTIC
/begin CHARACTERISTIC DFC_CtlMsk.DFC_ETClbETFltMin_5_C "DFC/Verhaltens Kontroll Maske für Prüfung DFC_ETClbETFltMin_5" VALUE 0x80022F4C Val_Wu16 65535.00 DFES_OneToOne 0.00 65535.00 /end CHARACTERISTIC
/begin CHARACTERISTIC DFC_CtlMsk.DFC_InjCrvInjLimChrgBal_C "DFC/Verhaltens Kontroll Maske für Prüfung DFC_InjCrvInjLimChrgBal" VALUE 0x80022F4E Val_Wu16 65535.00 DFES_OneToOne 0.00 65535.00 /end CHARACTERISTIC
/begin CHARACTERISTIC DFC_CtlMsk.DFC_InjCrvInjLimQntBal_C "DFC/Verhaltens Kontroll Maske für Prüfung DFC_InjCrvInjLimQntBal" VALUE 0x80022F50 Val_Wu16 65535.00 DFES_OneToOne 0.00 65535.00 /end CHARACTERISTIC
/begin CHARACTERISTIC DFC_CtlMsk.DFC_InjCrvInjLimSys_C "DFC/Verhaltens Kontroll Maske für Prüfung DFC_InjCrvInjLimSys" VALUE 0x80022F52 Val_Wu16 65535.00 DFES_OneToOne 0.00 65535.00 /end CHARACTERISTIC
/begin CHARACTERISTIC DFC_CtlMsk.DFC_InjCrvNumInjRtmLim_C "DFC/Verhaltens Kontroll Maske für Prüfung DFC_InjCrvNumInjRtmLim" VALUE 0x80022F54 Val_Wu16 65535.00 DFES_OneToOne 0.00 65535.00 /end CHARACTERISTIC
/begin CHARACTERISTIC DFC_CtlMsk.DFC_LSUHtCoupSig_C "DFC/Verhaltens Kontroll Maske für Prüfung DFC_LSUHtCoupSig" VALUE 0x80022F56 Val_Wu16 65535.00 DFES_OneToOne 0.00 65535.00 /end CHARACTERISTIC
/begin CHARACTERISTIC DFC_CtlMsk.DFC_AFS_SSpShOffOL_C "DFC/Verhaltens Kontroll Maske für Prüfung DFC_AFS_SSpShOffOL" VALUE 0x80022F58 Val_Wu16 65535.00 DFES_OneToOne 0.00 65535.00 /end CHARACTERISTIC
/begin CHARACTERISTIC DFC_CtlMsk.DFC_AFS_SSpShOffOvrTemp_C "DFC/Verhaltens Kontroll Maske für Prüfung DFC_AFS_SSpShOffOvrTemp" VALUE 0x80022F5A Val_Wu16 65535.00 DFES_OneToOne 0.00 65535.00 /end CHARACTERISTIC
/begin CHARACTERISTIC DFC_CtlMsk.DFC_AFS_SSpShOffSCB_C "DFC/Verhaltens Kontroll Maske für Prüfung DFC_AFS_SSpShOffSCB" VALUE 0x80022F5C Val_Wu16 65535.00 DFES_OneToOne 0.00 65535.00 /end CHARACTERISTIC
/begin CHARACTERISTIC DFC_CtlMsk.DFC_AFS_SSpShOffSCG_C "DFC/Verhaltens Kontroll Maske für Prüfung DFC_AFS_SSpShOffSCG" VALUE 0x80022F5E Val_Wu16 65535.00 DFES_OneToOne 0.00 65535.00 /end CHARACTERISTIC
/begin CHARACTERISTIC DFC_CtlMsk.DFC_AirCCmprOL_C "DFC/Verhaltens Kontroll Maske für Prüfung DFC_AirCCmprOL" VALUE 0x80022F60 Val_Wu16 65535.00 DFES_OneToOne 0.00 65535.00 /end CHARACTERISTIC
/begin CHARACTERISTIC DFC_CtlMsk.DFC_AirCCmprOvrTemp_C "DFC/Verhaltens Kontroll Maske für Prüfung DFC_AirCCmprOvrTemp" VALUE 0x80022F62 Val_Wu16 65535.00 DFES_OneToOne 0.00 65535.00 /end CHARACTERISTIC
/begin CHARACTERISTIC DFC_CtlMsk.DFC_AirCCmprSCB_C "DFC/Verhaltens Kontroll Maske für Prüfung DFC_AirCCmprSCB" VALUE 0x80022F64 Val_Wu16 65535.00 DFES_OneToOne 0.00 65535.00 /end CHARACTERISTIC
/begin CHARACTERISTIC DFC_CtlMsk.DFC_AirCCmprSCG_C "DFC/Verhaltens Kontroll Maske für Prüfung DFC_AirCCmprSCG" VALUE 0x80022F66 Val_Wu16 65535.00 DFES_OneToOne 0.00 65535.00 /end CHARACTERISTIC
/begin CHARACTERISTIC DFC_CtlMsk.DFC_CByVlvOL_C "DFC/Verhaltens Kontroll Maske für Prüfung DFC_CByVlvOL" VALUE 0x80022F68 Val_Wu16 65535.00 DFES_OneToOne 0.00 65535.00 /end CHARACTERISTIC
/begin CHARACTERISTIC DFC_CtlMsk.DFC_CByVlvOvrTemp_C "DFC/Verhaltens Kontroll Maske für Prüfung DFC_CByVlvOvrTemp" VALUE 0x80022F6A Val_Wu16 65535.00 DFES_OneToOne 0.00 65535.00 /end CHARACTERISTIC
/begin CHARACTERISTIC DFC_CtlMsk.DFC_CByVlvSCB_C "DFC/Verhaltens Kontroll Maske für Prüfung DFC_CByVlvSCB" VALUE 0x80022F6C Val_Wu16 65535.00 DFES_OneToOne 0.00 65535.00 /end CHARACTERISTIC
/begin CHARACTERISTIC DFC_CtlMsk.DFC_CByVlvSCG_C "DFC/Verhaltens Kontroll Maske für Prüfung DFC_CByVlvSCG" VALUE 0x80022F6E Val_Wu16 65535.00 DFES_OneToOne 0.00 65535.00 /end CHARACTERISTIC
/begin CHARACTERISTIC DFC_CtlMsk.DFC_CThmstOL_C "DFC/Verhaltens Kontroll Maske für Prüfung DFC_CThmstOL" VALUE 0x80022F70 Val_Wu16 65535.00 DFES_OneToOne 0.00 65535.00 /end CHARACTERISTIC
/begin CHARACTERISTIC DFC_CtlMsk.DFC_CThmstOvrTemp_C "DFC/Verhaltens Kontroll Maske für Prüfung DFC_CThmstOvrTemp" VALUE 0x80022F72 Val_Wu16 65535.00 DFES_OneToOne 0.00 65535.00 /end CHARACTERISTIC
/begin CHARACTERISTIC DFC_CtlMsk.DFC_CThmstSCB_C "DFC/Verhaltens Kontroll Maske für Prüfung DFC_CThmstSCB" VALUE 0x80022F74 Val_Wu16 65535.00 DFES_OneToOne 0.00 65535.00 /end CHARACTERISTIC
/begin CHARACTERISTIC DFC_CtlMsk.DFC_CThmstSCG_C "DFC/Verhaltens Kontroll Maske für Prüfung DFC_CThmstSCG" VALUE 0x80022F76 Val_Wu16 65535.00 DFES_OneToOne 0.00 65535.00 /end CHARACTERISTIC
/begin CHARACTERISTIC DFC_CtlMsk.DFC_DSMDummy_C "DFC/Verhaltens Kontroll Maske für Prüfung DFC_DSMDummy" VALUE 0x80022F78 Val_Wu16 65535.00 DFES_OneToOne 0.00 65535.00 /end CHARACTERISTIC
/begin CHARACTERISTIC DFC_CtlMsk.DFC_EBxFanOL_C "DFC/Verhaltens Kontroll Maske für Prüfung DFC_EBxFanOL" VALUE 0x80022F7A Val_Wu16 65535.00 DFES_OneToOne 0.00 65535.00 /end CHARACTERISTIC
/begin CHARACTERISTIC DFC_CtlMsk.DFC_EBxFanOvrTemp_C "DFC/Verhaltens Kontroll Maske für Prüfung DFC_EBxFanOvrTemp" VALUE 0x80022F7C Val_Wu16 65535.00 DFES_OneToOne 0.00 65535.00 /end CHARACTERISTIC
/begin CHARACTERISTIC DFC_CtlMsk.DFC_EBxFanSCB_C "DFC/Verhaltens Kontroll Maske für Prüfung DFC_EBxFanSCB" VALUE 0x80022F7E Val_Wu16 65535.00 DFES_OneToOne 0.00 65535.00 /end CHARACTERISTIC
/begin CHARACTERISTIC DFC_CtlMsk.DFC_EBxFanSCG_C "DFC/Verhaltens Kontroll Maske für Prüfung DFC_EBxFanSCG" VALUE 0x80022F80 Val_Wu16 65535.00 DFES_OneToOne 0.00 65535.00 /end CHARACTERISTIC
/begin CHARACTERISTIC DFC_CtlMsk.DFC_ECBVlvOL_C "DFC/Verhaltens Kontroll Maske für Prüfung DFC_ECBVlvOL" VALUE 0x80022F82 Val_Wu16 65535.00 DFES_OneToOne 0.00 65535.00 /end CHARACTERISTIC
/begin CHARACTERISTIC DFC_CtlMsk.DFC_ECBVlvOvrTemp_C "DFC/Verhaltens Kontroll Maske für Prüfung DFC_ECBVlvOvrTemp" VALUE 0x80022F84 Val_Wu16 65535.00 DFES_OneToOne 0.00 65535.00 /end CHARACTERISTIC
/begin CHARACTERISTIC DFC_CtlMsk.DFC_ECBVlvSCB_C "DFC/Verhaltens Kontroll Maske für Prüfung DFC_ECBVlvSCB" VALUE 0x80022F86 Val_Wu16 65535.00 DFES_OneToOne 0.00 65535.00 /end CHARACTERISTIC
/begin CHARACTERISTIC DFC_CtlMsk.DFC_ECBVlvSCG_C "DFC/Verhaltens Kontroll Maske für Prüfung DFC_ECBVlvSCG" VALUE 0x80022F88 Val_Wu16 65535.00 DFES_OneToOne 0.00 65535.00 /end CHARACTERISTIC
/begin CHARACTERISTIC DFC_CtlMsk.DFC_EMDmpOL_0_C "DFC/Verhaltens Kontroll Maske für Prüfung DFC_EMDmpOL_0" VALUE 0x80022F8A Val_Wu16 65535.00 DFES_OneToOne 0.00 65535.00 /end CHARACTERISTIC
/begin CHARACTERISTIC DFC_CtlMsk.DFC_EMDmpOL_1_C "DFC/Verhaltens Kontroll Maske für Prüfung DFC_EMDmpOL_1" VALUE 0x80022F8C Val_Wu16 65535.00 DFES_OneToOne 0.00 65535.00 /end CHARACTERISTIC
/begin CHARACTERISTIC DFC_CtlMsk.DFC_EMDmpOvrTemp_0_C "DFC/Verhaltens Kontroll Maske für Prüfung DFC_EMDmpOvrTemp_0" VALUE 0x80022F8E Val_Wu16 65535.00 DFES_OneToOne 0.00 65535.00 /end CHARACTERISTIC
/begin CHARACTERISTIC DFC_CtlMsk.DFC_EMDmpOvrTemp_1_C "DFC/Verhaltens Kontroll Maske für Prüfung DFC_EMDmpOvrTemp_1" VALUE 0x80022F90 Val_Wu16 65535.00 DFES_OneToOne 0.00 65535.00 /end CHARACTERISTIC
/begin CHARACTERISTIC DFC_CtlMsk.DFC_EMDmpSCB_0_C "DFC/Verhaltens Kontroll Maske für Prüfung DFC_EMDmpSCB_0" VALUE 0x80022F92 Val_Wu16 65535.00 DFES_OneToOne 0.00 65535.00 /end CHARACTERISTIC
/begin CHARACTERISTIC DFC_CtlMsk.DFC_EMDmpSCB_1_C "DFC/Verhaltens Kontroll Maske für Prüfung DFC_EMDmpSCB_1" VALUE 0x80022F94 Val_Wu16 65535.00 DFES_OneToOne 0.00 65535.00 /end CHARACTERISTIC
/begin CHARACTERISTIC DFC_CtlMsk.DFC_EMDmpSCG_0_C "DFC/Verhaltens Kontroll Maske für Prüfung DFC_EMDmpSCG_0" VALUE 0x80022F96 Val_Wu16 65535.00 DFES_OneToOne 0.00 65535.00 /end CHARACTERISTIC
/begin CHARACTERISTIC DFC_CtlMsk.DFC_EMDmpSCG_1_C "DFC/Verhaltens Kontroll Maske für Prüfung DFC_EMDmpSCG_1" VALUE 0x80022F98 Val_Wu16 65535.00 DFES_OneToOne 0.00 65535.00 /end CHARACTERISTIC
/begin CHARACTERISTIC DFC_CtlMsk.DFC_EngStAOL_C "DFC/Verhaltens Kontroll Maske für Prüfung DFC_EngStAOL" VALUE 0x80022F9A Val_Wu16 65535.00 DFES_OneToOne 0.00 65535.00 /end CHARACTERISTIC
/begin CHARACTERISTIC DFC_CtlMsk.DFC_EngStAOvrTemp_C "DFC/Verhaltens Kontroll Maske für Prüfung DFC_EngStAOvrTemp" VALUE 0x80022F9C Val_Wu16 65535.00 DFES_OneToOne 0.00 65535.00 /end CHARACTERISTIC
/begin CHARACTERISTIC DFC_CtlMsk.DFC_EngStASCB_C "DFC/Verhaltens Kontroll Maske für Prüfung DFC_EngStASCB" VALUE 0x80022F9E Val_Wu16 65535.00 DFES_OneToOne 0.00 65535.00 /end CHARACTERISTIC
/begin CHARACTERISTIC DFC_CtlMsk.DFC_EngStASCG_C "DFC/Verhaltens Kontroll Maske für Prüfung DFC_EngStASCG" VALUE 0x80022FA0 Val_Wu16 65535.00 DFES_OneToOne 0.00 65535.00 /end CHARACTERISTIC
/begin CHARACTERISTIC DFC_CtlMsk.DFC_FanOL_C "DFC/Verhaltens Kontroll Maske für Prüfung DFC_FanOL" VALUE 0x80022FA2 Val_Wu16 65535.00 DFES_OneToOne 0.00 65535.00 /end CHARACTERISTIC
/begin CHARACTERISTIC DFC_CtlMsk.DFC_FanOvrTemp_C "DFC/Verhaltens Kontroll Maske für Prüfung DFC_FanOvrTemp" VALUE 0x80022FA4 Val_Wu16 65535.00 DFES_OneToOne 0.00 65535.00 /end CHARACTERISTIC
/begin CHARACTERISTIC DFC_CtlMsk.DFC_FanSCB_C "DFC/Verhaltens Kontroll Maske für Prüfung DFC_FanSCB" VALUE 0x80022FA6 Val_Wu16 65535.00 DFES_OneToOne 0.00 65535.00 /end CHARACTERISTIC
/begin CHARACTERISTIC DFC_CtlMsk.DFC_FlFltHtOL_C "DFC/Verhaltens Kontroll Maske für Prüfung DFC_FlFltHtOL" VALUE 0x80022FA8 Val_Wu16 65535.00 DFES_OneToOne 0.00 65535.00 /end CHARACTERISTIC
/begin CHARACTERISTIC DFC_CtlMsk.DFC_FlFltHtOvrTemp_C "DFC/Verhaltens Kontroll Maske für Prüfung DFC_FlFltHtOvrTemp" VALUE 0x80022FAA Val_Wu16 65535.00 DFES_OneToOne 0.00 65535.00 /end CHARACTERISTIC
/begin CHARACTERISTIC DFC_CtlMsk.DFC_FlFltHtSCB_C "DFC/Verhaltens Kontroll Maske für Prüfung DFC_FlFltHtSCB" VALUE 0x80022FAC Val_Wu16 65535.00 DFES_OneToOne 0.00 65535.00 /end CHARACTERISTIC
/begin CHARACTERISTIC DFC_CtlMsk.DFC_FlFltHtSCG_C "DFC/Verhaltens Kontroll Maske für Prüfung DFC_FlFltHtSCG" VALUE 0x80022FAE Val_Wu16 65535.00 DFES_OneToOne 0.00 65535.00 /end CHARACTERISTIC
/begin CHARACTERISTIC DFC_CtlMsk.DFC_LSUHtrMax_C "DFC/Verhaltens Kontroll Maske für Prüfung DFC_LSUHtrMax" VALUE 0x80022FB0 Val_Wu16 65535.00 DFES_OneToOne 0.00 65535.00 /end CHARACTERISTIC
/begin CHARACTERISTIC DFC_CtlMsk.DFC_LSUHtrMin_C "DFC/Verhaltens Kontroll Maske für Prüfung DFC_LSUHtrMin" VALUE 0x80022FB2 Val_Wu16 65535.00 DFES_OneToOne 0.00 65535.00 /end CHARACTERISTIC
/begin CHARACTERISTIC DFC_CtlMsk.DFC_LSUHtrNpl_C "DFC/Verhaltens Kontroll Maske für Prüfung DFC_LSUHtrNpl" VALUE 0x80022FB4 Val_Wu16 65535.00 DFES_OneToOne 0.00 65535.00 /end CHARACTERISTIC
/begin CHARACTERISTIC DFC_CtlMsk.DFC_LSUHtrSig_C "DFC/Verhaltens Kontroll Maske für Prüfung DFC_LSUHtrSig" VALUE 0x80022FB6 Val_Wu16 65535.00 DFES_OneToOne 0.00 65535.00 /end CHARACTERISTIC
/begin CHARACTERISTIC DFC_CtlMsk.DFC_LSUtExcMax_C "DFC/Verhaltens Kontroll Maske für Prüfung DFC_LSUtExcMax" VALUE 0x80022FB8 Val_Wu16 65535.00 DFES_OneToOne 0.00 65535.00 /end CHARACTERISTIC
/begin CHARACTERISTIC DFC_CtlMsk.DFC_LSUtExcMin_C "DFC/Verhaltens Kontroll Maske für Prüfung DFC_LSUtExcMin" VALUE 0x80022FBA Val_Wu16 65535.00 DFES_OneToOne 0.00 65535.00 /end CHARACTERISTIC
/begin CHARACTERISTIC DFC_CtlMsk.DFC_MeUnOL_C "DFC/Verhaltens Kontroll Maske für Prüfung DFC_MeUnOL" VALUE 0x80022FBC Val_Wu16 65535.00 DFES_OneToOne 0.00 65535.00 /end CHARACTERISTIC
/begin CHARACTERISTIC DFC_CtlMsk.DFC_MeUnSCB_C "DFC/Verhaltens Kontroll Maske für Prüfung DFC_MeUnSCB" VALUE 0x80022FBE Val_Wu16 65535.00 DFES_OneToOne 0.00 65535.00 /end CHARACTERISTIC
/begin CHARACTERISTIC DFC_CtlMsk.DFC_MeUnSRCMax_C "DFC/Verhaltens Kontroll Maske für Prüfung DFC_MeUnSRCMax" VALUE 0x80022FC0 Val_Wu16 65535.00 DFES_OneToOne 0.00 65535.00 /end CHARACTERISTIC
/begin CHARACTERISTIC DFC_CtlMsk.DFC_MeUnSRCMin_C "DFC/Verhaltens Kontroll Maske für Prüfung DFC_MeUnSRCMin" VALUE 0x80022FC2 Val_Wu16 65535.00 DFES_OneToOne 0.00 65535.00 /end CHARACTERISTIC
/begin CHARACTERISTIC DFC_CtlMsk.DFC_PCVOL_C "DFC/Verhaltens Kontroll Maske für Prüfung DFC_PCVOL" VALUE 0x80022FC4 Val_Wu16 65535.00 DFES_OneToOne 0.00 65535.00 /end CHARACTERISTIC
/begin CHARACTERISTIC DFC_CtlMsk.DFC_PCVSCB_C "DFC/Verhaltens Kontroll Maske für Prüfung DFC_PCVSCB" VALUE 0x80022FC6 Val_Wu16 65535.00 DFES_OneToOne 0.00 65535.00 /end CHARACTERISTIC
/begin CHARACTERISTIC DFC_CtlMsk.DFC_PCVSRCMax_C "DFC/Verhaltens Kontroll Maske für Prüfung DFC_PCVSRCMax" VALUE 0x80022FC8 Val_Wu16 65535.00 DFES_OneToOne 0.00 65535.00 /end CHARACTERISTIC
/begin CHARACTERISTIC DFC_CtlMsk.DFC_PCVSRCMin_C "DFC/Verhaltens Kontroll Maske für Prüfung DFC_PCVSRCMin" VALUE 0x80022FCA Val_Wu16 65535.00 DFES_OneToOne 0.00 65535.00 /end CHARACTERISTIC
/begin CHARACTERISTIC DFC_CtlMsk.DFC_RailPSRCMax_C "DFC/Verhaltens Kontroll Maske für Prüfung DFC_RailPSRCMax" VALUE 0x80022FCC Val_Wu16 65535.00 DFES_OneToOne 0.00 65535.00 /end CHARACTERISTIC
/begin CHARACTERISTIC DFC_CtlMsk.DFC_RailPSRCMin_C "DFC/Verhaltens Kontroll Maske für Prüfung DFC_RailPSRCMin" VALUE 0x80022FCE Val_Wu16 65535.00 DFES_OneToOne 0.00 65535.00 /end CHARACTERISTIC
/begin CHARACTERISTIC DFC_CtlMsk.DFC_ShtrOL_C "DFC/Verhaltens Kontroll Maske für Prüfung DFC_ShtrOL" VALUE 0x80022FD0 Val_Wu16 65535.00 DFES_OneToOne 0.00 65535.00 /end CHARACTERISTIC
/begin CHARACTERISTIC DFC_CtlMsk.DFC_ShtrOvrTemp_C "DFC/Verhaltens Kontroll Maske für Prüfung DFC_ShtrOvrTemp" VALUE 0x80022FD2 Val_Wu16 65535.00 DFES_OneToOne 0.00 65535.00 /end CHARACTERISTIC
/begin CHARACTERISTIC DFC_CtlMsk.DFC_ShtrSCB_C "DFC/Verhaltens Kontroll Maske für Prüfung DFC_ShtrSCB" VALUE 0x80022FD4 Val_Wu16 65535.00 DFES_OneToOne 0.00 65535.00 /end CHARACTERISTIC
/begin CHARACTERISTIC DFC_CtlMsk.DFC_ShtrSCG_C "DFC/Verhaltens Kontroll Maske für Prüfung DFC_ShtrSCG" VALUE 0x80022FD6 Val_Wu16 65535.00 DFES_OneToOne 0.00 65535.00 /end CHARACTERISTIC
/begin CHARACTERISTIC DFC_CtlMsk.DFC_StrtOL_C "DFC/Verhaltens Kontroll Maske für Prüfung DFC_StrtOL" VALUE 0x80022FD8 Val_Wu16 65535.00 DFES_OneToOne 0.00 65535.00 /end CHARACTERISTIC
/begin CHARACTERISTIC DFC_CtlMsk.DFC_StrtOvrTemp_C "DFC/Verhaltens Kontroll Maske für Prüfung DFC_StrtOvrTemp" VALUE 0x80022FDA Val_Wu16 65535.00 DFES_OneToOne 0.00 65535.00 /end CHARACTERISTIC
/begin CHARACTERISTIC DFC_CtlMsk.DFC_StrtSCB_C "DFC/Verhaltens Kontroll Maske für Prüfung DFC_StrtSCB" VALUE 0x80022FDC Val_Wu16 65535.00 DFES_OneToOne 0.00 65535.00 /end CHARACTERISTIC
/begin CHARACTERISTIC DFC_CtlMsk.DFC_StrtSCG_C "DFC/Verhaltens Kontroll Maske für Prüfung DFC_StrtSCG" VALUE 0x80022FDE Val_Wu16 65535.00 DFES_OneToOne 0.00 65535.00 /end CHARACTERISTIC
/begin CHARACTERISTIC DFC_CtlMsk.DFC_ThrVlvOL_C "DFC/Verhaltens Kontroll Maske für Prüfung DFC_ThrVlvOL" VALUE 0x80022FE0 Val_Wu16 65535.00 DFES_OneToOne 0.00 65535.00 /end CHARACTERISTIC
/begin CHARACTERISTIC DFC_CtlMsk.DFC_ThrVlvOvrTemp_C "DFC/Verhaltens Kontroll Maske für Prüfung DFC_ThrVlvOvrTemp" VALUE 0x80022FE2 Val_Wu16 65535.00 DFES_OneToOne 0.00 65535.00 /end CHARACTERISTIC
/begin CHARACTERISTIC DFC_CtlMsk.DFC_ThrVlvSCB_C "DFC/Verhaltens Kontroll Maske für Prüfung DFC_ThrVlvSCB" VALUE 0x80022FE4 Val_Wu16 65535.00 DFES_OneToOne 0.00 65535.00 /end CHARACTERISTIC
/begin CHARACTERISTIC DFC_CtlMsk.DFC_TrbChOL_C "DFC/Verhaltens Kontroll Maske für Prüfung DFC_TrbChOL" VALUE 0x80022FE6 Val_Wu16 65535.00 DFES_OneToOne 0.00 65535.00 /end CHARACTERISTIC
/begin CHARACTERISTIC DFC_CtlMsk.DFC_TrbChOvrTemp_C "DFC/Verhaltens Kontroll Maske für Prüfung DFC_TrbChOvrTemp" VALUE 0x80022FE8 Val_Wu16 65535.00 DFES_OneToOne 0.00 65535.00 /end CHARACTERISTIC
/begin CHARACTERISTIC DFC_CtlMsk.DFC_TrbChSCB_C "DFC/Verhaltens Kontroll Maske für Prüfung DFC_TrbChSCB" VALUE 0x80022FEA Val_Wu16 65535.00 DFES_OneToOne 0.00 65535.00 /end CHARACTERISTIC
/begin CHARACTERISTIC DFC_CtlMsk.DFC_UDosVlvOL_C "DFC/Verhaltens Kontroll Maske für Prüfung DFC_UDosVlvOL" VALUE 0x80022FEC Val_Wu16 65535.00 DFES_OneToOne 0.00 65535.00 /end CHARACTERISTIC
/begin CHARACTERISTIC DFC_CtlMsk.DFC_UDosVlvOvrTemp_C "DFC/Verhaltens Kontroll Maske für Prüfung DFC_UDosVlvOvrTemp" VALUE 0x80022FEE Val_Wu16 65535.00 DFES_OneToOne 0.00 65535.00 /end CHARACTERISTIC
/begin CHARACTERISTIC DFC_CtlMsk.DFC_UDosVlvSCB_C "DFC/Verhaltens Kontroll Maske für Prüfung DFC_UDosVlvSCB" VALUE 0x80022FF0 Val_Wu16 65535.00 DFES_OneToOne 0.00 65535.00 /end CHARACTERISTIC
/begin CHARACTERISTIC DFC_CtlMsk.DFC_UDosVlvSCG_C "DFC/Verhaltens Kontroll Maske für Prüfung DFC_UDosVlvSCG" VALUE 0x80022FF2 Val_Wu16 65535.00 DFES_OneToOne 0.00 65535.00 /end CHARACTERISTIC
/begin CHARACTERISTIC DFC_CtlMsk.DFC_UPmpMotOL_C "DFC/Verhaltens Kontroll Maske für Prüfung DFC_UPmpMotOL" VALUE 0x80022FF4 Val_Wu16 65535.00 DFES_OneToOne 0.00 65535.00 /end CHARACTERISTIC
/begin CHARACTERISTIC DFC_CtlMsk.DFC_UPmpMotOvrTemp_C "DFC/Verhaltens Kontroll Maske für Prüfung DFC_UPmpMotOvrTemp" VALUE 0x80022FF6 Val_Wu16 65535.00 DFES_OneToOne 0.00 65535.00 /end CHARACTERISTIC
/begin CHARACTERISTIC DFC_CtlMsk.DFC_UPmpMotSCB_C "DFC/Verhaltens Kontroll Maske für Prüfung DFC_UPmpMotSCB" VALUE 0x80022FF8 Val_Wu16 65535.00 DFES_OneToOne 0.00 65535.00 /end CHARACTERISTIC
/begin CHARACTERISTIC DFC_CtlMsk.DFC_UPmpMotSCG_C "DFC/Verhaltens Kontroll Maske für Prüfung DFC_UPmpMotSCG" VALUE 0x80022FFA Val_Wu16 65535.00 DFES_OneToOne 0.00 65535.00 /end CHARACTERISTIC
/begin CHARACTERISTIC DFC_CtlMsk.DFC_WaHtElOL_C "DFC/Verhaltens Kontroll Maske für Prüfung DFC_WaHtElOL" VALUE 0x80022FFC Val_Wu16 65535.00 DFES_OneToOne 0.00 65535.00 /end CHARACTERISTIC
/begin CHARACTERISTIC DFC_CtlMsk.DFC_WaHtElOvrTemp_C "DFC/Verhaltens Kontroll Maske für Prüfung DFC_WaHtElOvrTemp" VALUE 0x80022FFE Val_Wu16 65535.00 DFES_OneToOne 0.00 65535.00 /end CHARACTERISTIC
/begin CHARACTERISTIC DFC_CtlMsk.DFC_WaHtElSCB_C "DFC/Verhaltens Kontroll Maske für Prüfung DFC_WaHtElSCB" VALUE 0x80023000 Val_Wu16 65535.00 DFES_OneToOne 0.00 65535.00 /end CHARACTERISTIC
/begin CHARACTERISTIC DFC_CtlMsk.DFC_IVActrUChSRCMax_C "DFC/Verhaltens Kontroll Maske für Prüfung DFC_IVActrUChSRCMax" VALUE 0x80023002 Val_Wu16 65535.00 DFES_OneToOne 0.00 65535.00 /end CHARACTERISTIC
/begin CHARACTERISTIC DFC_CtlMsk.DFC_IVActrUChSRCMin_C "DFC/Verhaltens Kontroll Maske für Prüfung DFC_IVActrUChSRCMin" VALUE 0x80023004 Val_Wu16 65535.00 DFES_OneToOne 0.00 65535.00 /end CHARACTERISTIC
/begin CHARACTERISTIC DFC_CtlMsk.DFC_IVActrVltgSRCMax_C "DFC/Verhaltens Kontroll Maske für Prüfung DFC_IVActrVltgSRCMax" VALUE 0x80023006 Val_Wu16 65535.00 DFES_OneToOne 0.00 65535.00 /end CHARACTERISTIC
/begin CHARACTERISTIC DFC_CtlMsk.DFC_IVActrVltgSRCMin_C "DFC/Verhaltens Kontroll Maske für Prüfung DFC_IVActrVltgSRCMin" VALUE 0x80023008 Val_Wu16 65535.00 DFES_OneToOne 0.00 65535.00 /end CHARACTERISTIC
/begin CHARACTERISTIC DFC_CtlMsk.DFC_IVDiaTunDet_C "DFC/Verhaltens Kontroll Maske für Prüfung DFC_IVDiaTunDet" VALUE 0x8002300A Val_Wu16 65535.00 DFES_OneToOne 0.00 65535.00 /end CHARACTERISTIC
/begin CHARACTERISTIC DFC_CtlMsk.DFC_IVPSplyStopDCDC_C "DFC/Verhaltens Kontroll Maske für Prüfung DFC_IVPSplyStopDCDC" VALUE 0x8002300C Val_Wu16 65535.00 DFES_OneToOne 0.00 65535.00 /end CHARACTERISTIC
/begin CHARACTERISTIC DFC_CtlMsk.DFC_IVPSplyVltgSRCMax_C "DFC/Verhaltens Kontroll Maske für Prüfung DFC_IVPSplyVltgSRCMax" VALUE 0x8002300E Val_Wu16 65535.00 DFES_OneToOne 0.00 65535.00 /end CHARACTERISTIC
/begin CHARACTERISTIC DFC_CtlMsk.DFC_IVPSplyVltgSRCMin_C "DFC/Verhaltens Kontroll Maske für Prüfung DFC_IVPSplyVltgSRCMin" VALUE 0x80023010 Val_Wu16 65535.00 DFES_OneToOne 0.00 65535.00 /end CHARACTERISTIC
/begin CHARACTERISTIC DFC_CtlMsk.DFC_SCREtaErr_C "DFC/Verhaltens Kontroll Maske für Prüfung DFC_SCREtaErr" VALUE 0x80023012 Val_Wu16 65535.00 DFES_OneToOne 0.00 65535.00 /end CHARACTERISTIC
/begin CHARACTERISTIC DFC_CtlMsk.DFC_SCREtaErr1_C "DFC/Verhaltens Kontroll Maske für Prüfung DFC_SCREtaErr1" VALUE 0x80023014 Val_Wu16 65535.00 DFES_OneToOne 0.00 65535.00 /end CHARACTERISTIC
/begin CHARACTERISTIC DFC_CtlMsk.DFC_SCREtaErr2_C "DFC/Verhaltens Kontroll Maske für Prüfung DFC_SCREtaErr2" VALUE 0x80023016 Val_Wu16 65535.00 DFES_OneToOne 0.00 65535.00 /end CHARACTERISTIC
/begin CHARACTERISTIC DFC_CtlMsk.DFC_SCRMonMetCtlPresErr_C "DFC/Verhaltens Kontroll Maske für Prüfung DFC_SCRMonMetCtlPresErr" VALUE 0x80023018 Val_Wu16 65535.00 DFES_OneToOne 0.00 65535.00 /end CHARACTERISTIC
/begin CHARACTERISTIC DFC_CtlMsk.DFC_SCRMonPresBuildUpErr_C "DFC/Verhaltens Kontroll Maske für Prüfung DFC_SCRMonPresBuildUpErr" VALUE 0x8002301A Val_Wu16 65535.00 DFES_OneToOne 0.00 65535.00 /end CHARACTERISTIC
/begin CHARACTERISTIC DFC_CtlMsk.DFC_SCRMonPresRdcErr_C "DFC/Verhaltens Kontroll Maske für Prüfung DFC_SCRMonPresRdcErr" VALUE 0x8002301C Val_Wu16 65535.00 DFES_OneToOne 0.00 65535.00 /end CHARACTERISTIC
/begin CHARACTERISTIC DFC_CtlMsk.DFC_AFSOffsDrftMax_C "DFC/Verhaltens Kontroll Maske für Prüfung DFC_AFSOffsDrftMax" VALUE 0x8002301E Val_Wu16 65535.00 DFES_OneToOne 0.00 65535.00 /end CHARACTERISTIC
/begin CHARACTERISTIC DFC_CtlMsk.DFC_AFSOffsDrftMin_C "DFC/Verhaltens Kontroll Maske für Prüfung DFC_AFSOffsDrftMin" VALUE 0x80023020 Val_Wu16 65535.00 DFES_OneToOne 0.00 65535.00 /end CHARACTERISTIC
/begin CHARACTERISTIC DFC_CtlMsk.DFC_AFSSRCCorMax_C "DFC/Verhaltens Kontroll Maske für Prüfung DFC_AFSSRCCorMax" VALUE 0x80023022 Val_Wu16 65535.00 DFES_OneToOne 0.00 65535.00 /end CHARACTERISTIC
/begin CHARACTERISTIC DFC_CtlMsk.DFC_AFSSRCCorMin_C "DFC/Verhaltens Kontroll Maske für Prüfung DFC_AFSSRCCorMin" VALUE 0x80023024 Val_Wu16 65535.00 DFES_OneToOne 0.00 65535.00 /end CHARACTERISTIC
/begin CHARACTERISTIC DFC_CtlMsk.DFC_AFSSRCRawMax_C "DFC/Verhaltens Kontroll Maske für Prüfung DFC_AFSSRCRawMax" VALUE 0x80023026 Val_Wu16 65535.00 DFES_OneToOne 0.00 65535.00 /end CHARACTERISTIC
/begin CHARACTERISTIC DFC_CtlMsk.DFC_AFSSRCRawMin_C "DFC/Verhaltens Kontroll Maske für Prüfung DFC_AFSSRCRawMin" VALUE 0x80023028 Val_Wu16 65535.00 DFES_OneToOne 0.00 65535.00 /end CHARACTERISTIC
/begin CHARACTERISTIC DFC_CtlMsk.DFC_AFSSetyDrftMax_C "DFC/Verhaltens Kontroll Maske für Prüfung DFC_AFSSetyDrftMax" VALUE 0x8002302A Val_Wu16 65535.00 DFES_OneToOne 0.00 65535.00 /end CHARACTERISTIC
/begin CHARACTERISTIC DFC_CtlMsk.DFC_AFSSetyDrftMin_C "DFC/Verhaltens Kontroll Maske für Prüfung DFC_AFSSetyDrftMin" VALUE 0x8002302C Val_Wu16 65535.00 DFES_OneToOne 0.00 65535.00 /end CHARACTERISTIC
/begin CHARACTERISTIC DFC_CtlMsk.DFC_AirCSwtNpl_C "DFC/Verhaltens Kontroll Maske für Prüfung DFC_AirCSwtNpl" VALUE 0x8002302E Val_Wu16 65535.00 DFES_OneToOne 0.00 65535.00 /end CHARACTERISTIC
/begin CHARACTERISTIC DFC_CtlMsk.DFC_AirCSwtSig_C "DFC/Verhaltens Kontroll Maske für Prüfung DFC_AirCSwtSig" VALUE 0x80023030 Val_Wu16 65535.00 DFES_OneToOne 0.00 65535.00 /end CHARACTERISTIC
/begin CHARACTERISTIC DFC_CtlMsk.DFC_BattUSRCMax_C "DFC/Verhaltens Kontroll Maske für Prüfung DFC_BattUSRCMax" VALUE 0x80023032 Val_Wu16 65535.00 DFES_OneToOne 0.00 65535.00 /end CHARACTERISTIC
/begin CHARACTERISTIC DFC_CtlMsk.DFC_BattUSRCMin_C "DFC/Verhaltens Kontroll Maske für Prüfung DFC_BattUSRCMin" VALUE 0x80023034 Val_Wu16 65535.00 DFES_OneToOne 0.00 65535.00 /end CHARACTERISTIC
/begin CHARACTERISTIC DFC_CtlMsk.DFC_BrkNpl_C "DFC/Verhaltens Kontroll Maske für Prüfung DFC_BrkNpl" VALUE 0x80023036 Val_Wu16 65535.00 DFES_OneToOne 0.00 65535.00 /end CHARACTERISTIC
/begin CHARACTERISTIC DFC_CtlMsk.DFC_BrkPSRCMax_C "DFC/Verhaltens Kontroll Maske für Prüfung DFC_BrkPSRCMax" VALUE 0x80023038 Val_Wu16 65535.00 DFES_OneToOne 0.00 65535.00 /end CHARACTERISTIC
/begin CHARACTERISTIC DFC_CtlMsk.DFC_BrkPSRCMin_C "DFC/Verhaltens Kontroll Maske für Prüfung DFC_BrkPSRCMin" VALUE 0x8002303A Val_Wu16 65535.00 DFES_OneToOne 0.00 65535.00 /end CHARACTERISTIC
/begin CHARACTERISTIC DFC_CtlMsk.DFC_CEngDsTSRCMax_C "DFC/Verhaltens Kontroll Maske für Prüfung DFC_CEngDsTSRCMax" VALUE 0x8002303C Val_Wu16 65535.00 DFES_OneToOne 0.00 65535.00 /end CHARACTERISTIC
/begin CHARACTERISTIC DFC_CtlMsk.DFC_CEngDsTSRCMin_C "DFC/Verhaltens Kontroll Maske für Prüfung DFC_CEngDsTSRCMin" VALUE 0x8002303E Val_Wu16 65535.00 DFES_OneToOne 0.00 65535.00 /end CHARACTERISTIC
/begin CHARACTERISTIC DFC_CtlMsk.DFC_CrCUIDet_C "DFC/Verhaltens Kontroll Maske für Prüfung DFC_CrCUIDet" VALUE 0x80023040 Val_Wu16 65535.00 DFES_OneToOne 0.00 65535.00 /end CHARACTERISTIC
/begin CHARACTERISTIC DFC_CtlMsk.DFC_ECBVlvSRCMax_C "DFC/Verhaltens Kontroll Maske für Prüfung DFC_ECBVlvSRCMax" VALUE 0x80023042 Val_Wu16 65535.00 DFES_OneToOne 0.00 65535.00 /end CHARACTERISTIC
/begin CHARACTERISTIC DFC_CtlMsk.DFC_ECBVlvSRCMin_C "DFC/Verhaltens Kontroll Maske für Prüfung DFC_ECBVlvSRCMin" VALUE 0x80023044 Val_Wu16 65535.00 DFES_OneToOne 0.00 65535.00 /end CHARACTERISTIC
/begin CHARACTERISTIC DFC_CtlMsk.DFC_ECUOvrTemp_C "DFC/Verhaltens Kontroll Maske für Prüfung DFC_ECUOvrTemp" VALUE 0x80023046 Val_Wu16 65535.00 DFES_OneToOne 0.00 65535.00 /end CHARACTERISTIC
/begin CHARACTERISTIC DFC_CtlMsk.DFC_EGRVlvGovDvtMax_C "DFC/Verhaltens Kontroll Maske für Prüfung DFC_EGRVlvGovDvtMax" VALUE 0x80023048 Val_Wu16 65535.00 DFES_OneToOne 0.00 65535.00 /end CHARACTERISTIC
/begin CHARACTERISTIC DFC_CtlMsk.DFC_EGRVlvGovDvtMin_C "DFC/Verhaltens Kontroll Maske für Prüfung DFC_EGRVlvGovDvtMin" VALUE 0x8002304A Val_Wu16 65535.00 DFES_OneToOne 0.00 65535.00 /end CHARACTERISTIC
/begin CHARACTERISTIC DFC_CtlMsk.DFC_EGRVlvHBrgOpnLd_C "DFC/Verhaltens Kontroll Maske für Prüfung DFC_EGRVlvHBrgOpnLd" VALUE 0x8002304C Val_Wu16 65535.00 DFES_OneToOne 0.00 65535.00 /end CHARACTERISTIC
/begin CHARACTERISTIC DFC_CtlMsk.DFC_EGRVlvHBrgOvrCurr_C "DFC/Verhaltens Kontroll Maske für Prüfung DFC_EGRVlvHBrgOvrCurr" VALUE 0x8002304E Val_Wu16 65535.00 DFES_OneToOne 0.00 65535.00 /end CHARACTERISTIC
/begin CHARACTERISTIC DFC_CtlMsk.DFC_EGRVlvHBrgOvrTemp_C "DFC/Verhaltens Kontroll Maske für Prüfung DFC_EGRVlvHBrgOvrTemp" VALUE 0x80023050 Val_Wu16 65535.00 DFES_OneToOne 0.00 65535.00 /end CHARACTERISTIC
/begin CHARACTERISTIC DFC_CtlMsk.DFC_EGRVlvHBrgShCirBatt1_C "DFC/Verhaltens Kontroll Maske für Prüfung DFC_EGRVlvHBrgShCirBatt1" VALUE 0x80023052 Val_Wu16 65535.00 DFES_OneToOne 0.00 65535.00 /end CHARACTERISTIC
/begin CHARACTERISTIC DFC_CtlMsk.DFC_EGRVlvHBrgShCirBatt2_C "DFC/Verhaltens Kontroll Maske für Prüfung DFC_EGRVlvHBrgShCirBatt2" VALUE 0x80023054 Val_Wu16 65535.00 DFES_OneToOne 0.00 65535.00 /end CHARACTERISTIC
/begin CHARACTERISTIC DFC_CtlMsk.DFC_EGRVlvHBrgShCirGnd1_C "DFC/Verhaltens Kontroll Maske für Prüfung DFC_EGRVlvHBrgShCirGnd1" VALUE 0x80023056 Val_Wu16 65535.00 DFES_OneToOne 0.00 65535.00 /end CHARACTERISTIC
/begin CHARACTERISTIC DFC_CtlMsk.DFC_EGRVlvHBrgShCirGnd2_C "DFC/Verhaltens Kontroll Maske für Prüfung DFC_EGRVlvHBrgShCirGnd2" VALUE 0x80023058 Val_Wu16 65535.00 DFES_OneToOne 0.00 65535.00 /end CHARACTERISTIC
/begin CHARACTERISTIC DFC_CtlMsk.DFC_EGRVlvHBrgShCirOvrLd_C "DFC/Verhaltens Kontroll Maske für Prüfung DFC_EGRVlvHBrgShCirOvrLd" VALUE 0x8002305A Val_Wu16 65535.00 DFES_OneToOne 0.00 65535.00 /end CHARACTERISTIC
/begin CHARACTERISTIC DFC_CtlMsk.DFC_EGRVlvHBrgTempOvrCurr_C "DFC/Verhaltens Kontroll Maske für Prüfung DFC_EGRVlvHBrgTempOvrCurr" VALUE 0x8002305C Val_Wu16 65535.00 DFES_OneToOne 0.00 65535.00 /end CHARACTERISTIC
/begin CHARACTERISTIC DFC_CtlMsk.DFC_EGRVlvHBrgUndrVltg_C "DFC/Verhaltens Kontroll Maske für Prüfung DFC_EGRVlvHBrgUndrVltg" VALUE 0x8002305E Val_Wu16 65535.00 DFES_OneToOne 0.00 65535.00 /end CHARACTERISTIC
/begin CHARACTERISTIC DFC_CtlMsk.DFC_EGRVlvLPGovDvtMax_C "DFC/Verhaltens Kontroll Maske für Prüfung DFC_EGRVlvLPGovDvtMax" VALUE 0x80023060 Val_Wu16 65535.00 DFES_OneToOne 0.00 65535.00 /end CHARACTERISTIC
/begin CHARACTERISTIC DFC_CtlMsk.DFC_EGRVlvLPGovDvtMin_C "DFC/Verhaltens Kontroll Maske für Prüfung DFC_EGRVlvLPGovDvtMin" VALUE 0x80023062 Val_Wu16 65535.00 DFES_OneToOne 0.00 65535.00 /end CHARACTERISTIC
/begin CHARACTERISTIC DFC_CtlMsk.DFC_EGRVlvLPHBrgOpnLd_C "DFC/Verhaltens Kontroll Maske für Prüfung DFC_EGRVlvLPHBrgOpnLd" VALUE 0x80023064 Val_Wu16 65535.00 DFES_OneToOne 0.00 65535.00 /end CHARACTERISTIC
/begin CHARACTERISTIC DFC_CtlMsk.DFC_EGRVlvLPHBrgOvrCurr_C "DFC/Verhaltens Kontroll Maske für Prüfung DFC_EGRVlvLPHBrgOvrCurr" VALUE 0x80023066 Val_Wu16 65535.00 DFES_OneToOne 0.00 65535.00 /end CHARACTERISTIC
/begin CHARACTERISTIC DFC_CtlMsk.DFC_EGRVlvLPHBrgOvrTemp_C "DFC/Verhaltens Kontroll Maske für Prüfung DFC_EGRVlvLPHBrgOvrTemp" VALUE 0x80023068 Val_Wu16 65535.00 DFES_OneToOne 0.00 65535.00 /end CHARACTERISTIC
/begin CHARACTERISTIC DFC_CtlMsk.DFC_EGRVlvLPHBrgShCirBatt1_C "DFC/Verhaltens Kontroll Maske für Prüfung DFC_EGRVlvLPHBrgShCirBatt1" VALUE 0x8002306A Val_Wu16 65535.00 DFES_OneToOne 0.00 65535.00 /end CHARACTERISTIC
/begin CHARACTERISTIC DFC_CtlMsk.DFC_EGRVlvLPHBrgShCirBatt2_C "DFC/Verhaltens Kontroll Maske für Prüfung DFC_EGRVlvLPHBrgShCirBatt2" VALUE 0x8002306C Val_Wu16 65535.00 DFES_OneToOne 0.00 65535.00 /end CHARACTERISTIC
/begin CHARACTERISTIC DFC_CtlMsk.DFC_EGRVlvLPHBrgShCirGnd1_C "DFC/Verhaltens Kontroll Maske für Prüfung DFC_EGRVlvLPHBrgShCirGnd1" VALUE 0x8002306E Val_Wu16 65535.00 DFES_OneToOne 0.00 65535.00 /end CHARACTERISTIC
/begin CHARACTERISTIC DFC_CtlMsk.DFC_EGRVlvLPHBrgShCirGnd2_C "DFC/Verhaltens Kontroll Maske für Prüfung DFC_EGRVlvLPHBrgShCirGnd2" VALUE 0x80023070 Val_Wu16 65535.00 DFES_OneToOne 0.00 65535.00 /end CHARACTERISTIC
/begin CHARACTERISTIC DFC_CtlMsk.DFC_EGRVlvLPHBrgShCirOvrLd_C "DFC/Verhaltens Kontroll Maske für Prüfung DFC_EGRVlvLPHBrgShCirOvrLd" VALUE 0x80023072 Val_Wu16 65535.00 DFES_OneToOne 0.00 65535.00 /end CHARACTERISTIC
/begin CHARACTERISTIC DFC_CtlMsk.DFC_EGRVlvLPHBrgTempOvrCurr_C "DFC/Verhaltens Kontroll Maske für Prüfung DFC_EGRVlvLPHBrgTempOvrCurr" VALUE 0x80023074 Val_Wu16 65535.00 DFES_OneToOne 0.00 65535.00 /end CHARACTERISTIC
/begin CHARACTERISTIC DFC_CtlMsk.DFC_EGRVlvLPHBrgUndrVltg_C "DFC/Verhaltens Kontroll Maske für Prüfung DFC_EGRVlvLPHBrgUndrVltg" VALUE 0x80023076 Val_Wu16 65535.00 DFES_OneToOne 0.00 65535.00 /end CHARACTERISTIC
/begin CHARACTERISTIC DFC_CtlMsk.DFC_EGRVlvLPOL_C "DFC/Verhaltens Kontroll Maske für Prüfung DFC_EGRVlvLPOL" VALUE 0x80023078 Val_Wu16 65535.00 DFES_OneToOne 0.00 65535.00 /end CHARACTERISTIC
/begin CHARACTERISTIC DFC_CtlMsk.DFC_EGRVlvLPSCB_C "DFC/Verhaltens Kontroll Maske für Prüfung DFC_EGRVlvLPSCB" VALUE 0x8002307A Val_Wu16 65535.00 DFES_OneToOne 0.00 65535.00 /end CHARACTERISTIC
/begin CHARACTERISTIC DFC_CtlMsk.DFC_EGRVlvLPSCG_C "DFC/Verhaltens Kontroll Maske für Prüfung DFC_EGRVlvLPSCG" VALUE 0x8002307C Val_Wu16 65535.00 DFES_OneToOne 0.00 65535.00 /end CHARACTERISTIC
/begin CHARACTERISTIC DFC_CtlMsk.DFC_EGRVlvLPSRCMax_C "DFC/Verhaltens Kontroll Maske für Prüfung DFC_EGRVlvLPSRCMax" VALUE 0x8002307E Val_Wu16 65535.00 DFES_OneToOne 0.00 65535.00 /end CHARACTERISTIC
/begin CHARACTERISTIC DFC_CtlMsk.DFC_EGRVlvLPSRCMin_C "DFC/Verhaltens Kontroll Maske für Prüfung DFC_EGRVlvLPSRCMin" VALUE 0x80023080 Val_Wu16 65535.00 DFES_OneToOne 0.00 65535.00 /end CHARACTERISTIC
/begin CHARACTERISTIC DFC_CtlMsk.DFC_EGRVlvOL_C "DFC/Verhaltens Kontroll Maske für Prüfung DFC_EGRVlvOL" VALUE 0x80023082 Val_Wu16 65535.00 DFES_OneToOne 0.00 65535.00 /end CHARACTERISTIC
/begin CHARACTERISTIC DFC_CtlMsk.DFC_EGRVlvSCB_C "DFC/Verhaltens Kontroll Maske für Prüfung DFC_EGRVlvSCB" VALUE 0x80023084 Val_Wu16 65535.00 DFES_OneToOne 0.00 65535.00 /end CHARACTERISTIC
/begin CHARACTERISTIC DFC_CtlMsk.DFC_EGRVlvSCG_C "DFC/Verhaltens Kontroll Maske für Prüfung DFC_EGRVlvSCG" VALUE 0x80023086 Val_Wu16 65535.00 DFES_OneToOne 0.00 65535.00 /end CHARACTERISTIC
/begin CHARACTERISTIC DFC_CtlMsk.DFC_EGRVlvSRCMax_C "DFC/Verhaltens Kontroll Maske für Prüfung DFC_EGRVlvSRCMax" VALUE 0x80023088 Val_Wu16 65535.00 DFES_OneToOne 0.00 65535.00 /end CHARACTERISTIC
/begin CHARACTERISTIC DFC_CtlMsk.DFC_EGRVlvSRCMin_C "DFC/Verhaltens Kontroll Maske für Prüfung DFC_EGRVlvSRCMin" VALUE 0x8002308A Val_Wu16 65535.00 DFES_OneToOne 0.00 65535.00 /end CHARACTERISTIC
/begin CHARACTERISTIC DFC_CtlMsk.DFC_EngPrtOvrSpd_C "DFC/Verhaltens Kontroll Maske für Prüfung DFC_EngPrtOvrSpd" VALUE 0x8002308C Val_Wu16 65535.00 DFES_OneToOne 0.00 65535.00 /end CHARACTERISTIC
/begin CHARACTERISTIC DFC_CtlMsk.DFC_EngSpdOL_C "DFC/Verhaltens Kontroll Maske für Prüfung DFC_EngSpdOL" VALUE 0x8002308E Val_Wu16 65535.00 DFES_OneToOne 0.00 65535.00 /end CHARACTERISTIC
/begin CHARACTERISTIC DFC_CtlMsk.DFC_EngSpdSCB_C "DFC/Verhaltens Kontroll Maske für Prüfung DFC_EngSpdSCB" VALUE 0x80023090 Val_Wu16 65535.00 DFES_OneToOne 0.00 65535.00 /end CHARACTERISTIC
/begin CHARACTERISTIC DFC_CtlMsk.DFC_EngSpdSCG_C "DFC/Verhaltens Kontroll Maske für Prüfung DFC_EngSpdSCG" VALUE 0x80023092 Val_Wu16 65535.00 DFES_OneToOne 0.00 65535.00 /end CHARACTERISTIC
/begin CHARACTERISTIC DFC_CtlMsk.DFC_EnhSRCMaxPPFltDiff_C "DFC/Verhaltens Kontroll Maske für Prüfung DFC_EnhSRCMaxPPFltDiff" VALUE 0x80023094 Val_Wu16 65535.00 DFES_OneToOne 0.00 65535.00 /end CHARACTERISTIC
/begin CHARACTERISTIC DFC_CtlMsk.DFC_EnhSRCMaxT1ExhTMon_C "DFC/Verhaltens Kontroll Maske für Prüfung DFC_EnhSRCMaxT1ExhTMon" VALUE 0x80023096 Val_Wu16 65535.00 DFES_OneToOne 0.00 65535.00 /end CHARACTERISTIC
/begin CHARACTERISTIC DFC_CtlMsk.DFC_EnhSRCMaxT2ExhTMon_C "DFC/Verhaltens Kontroll Maske für Prüfung DFC_EnhSRCMaxT2ExhTMon" VALUE 0x80023098 Val_Wu16 65535.00 DFES_OneToOne 0.00 65535.00 /end CHARACTERISTIC
/begin CHARACTERISTIC DFC_CtlMsk.DFC_EnhSRCMaxT3ExhTMon_C "DFC/Verhaltens Kontroll Maske für Prüfung DFC_EnhSRCMaxT3ExhTMon" VALUE 0x8002309A Val_Wu16 65535.00 DFES_OneToOne 0.00 65535.00 /end CHARACTERISTIC
/begin CHARACTERISTIC DFC_CtlMsk.DFC_EnhSRCMinPPFltDiff_C "DFC/Verhaltens Kontroll Maske für Prüfung DFC_EnhSRCMinPPFltDiff" VALUE 0x8002309C Val_Wu16 65535.00 DFES_OneToOne 0.00 65535.00 /end CHARACTERISTIC
/begin CHARACTERISTIC DFC_CtlMsk.DFC_EnhSRCMinT1ExhTMon_C "DFC/Verhaltens Kontroll Maske für Prüfung DFC_EnhSRCMinT1ExhTMon" VALUE 0x8002309E Val_Wu16 65535.00 DFES_OneToOne 0.00 65535.00 /end CHARACTERISTIC
/begin CHARACTERISTIC DFC_CtlMsk.DFC_EnhSRCMinT2ExhTMon_C "DFC/Verhaltens Kontroll Maske für Prüfung DFC_EnhSRCMinT2ExhTMon" VALUE 0x800230A0 Val_Wu16 65535.00 DFES_OneToOne 0.00 65535.00 /end CHARACTERISTIC
/begin CHARACTERISTIC DFC_CtlMsk.DFC_EnhSRCMinT3ExhTMon_C "DFC/Verhaltens Kontroll Maske für Prüfung DFC_EnhSRCMinT3ExhTMon" VALUE 0x800230A2 Val_Wu16 65535.00 DFES_OneToOne 0.00 65535.00 /end CHARACTERISTIC
/begin CHARACTERISTIC DFC_CtlMsk.DFC_EnvPSRCMax_C "DFC/Verhaltens Kontroll Maske für Prüfung DFC_EnvPSRCMax" VALUE 0x800230A4 Val_Wu16 65535.00 DFES_OneToOne 0.00 65535.00 /end CHARACTERISTIC
/begin CHARACTERISTIC DFC_CtlMsk.DFC_EnvPSRCMin_C "DFC/Verhaltens Kontroll Maske für Prüfung DFC_EnvPSRCMin" VALUE 0x800230A6 Val_Wu16 65535.00 DFES_OneToOne 0.00 65535.00 /end CHARACTERISTIC
/begin CHARACTERISTIC DFC_CtlMsk.DFC_ExhTMonPlaus_C "DFC/Verhaltens Kontroll Maske für Prüfung DFC_ExhTMonPlaus" VALUE 0x800230A8 Val_Wu16 65535.00 DFES_OneToOne 0.00 65535.00 /end CHARACTERISTIC
/begin CHARACTERISTIC DFC_CtlMsk.DFC_ExhTMonPlausPos1_C "DFC/Verhaltens Kontroll Maske für Prüfung DFC_ExhTMonPlausPos1" VALUE 0x800230AA Val_Wu16 65535.00 DFES_OneToOne 0.00 65535.00 /end CHARACTERISTIC
/begin CHARACTERISTIC DFC_CtlMsk.DFC_ExhTMonPlausPos2_C "DFC/Verhaltens Kontroll Maske für Prüfung DFC_ExhTMonPlausPos2" VALUE 0x800230AC Val_Wu16 65535.00 DFES_OneToOne 0.00 65535.00 /end CHARACTERISTIC
/begin CHARACTERISTIC DFC_CtlMsk.DFC_ExhTMonPlausPos3_C "DFC/Verhaltens Kontroll Maske für Prüfung DFC_ExhTMonPlausPos3" VALUE 0x800230AE Val_Wu16 65535.00 DFES_OneToOne 0.00 65535.00 /end CHARACTERISTIC
/begin CHARACTERISTIC DFC_CtlMsk.DFC_ExhTMonT1Plaus_C "DFC/Verhaltens Kontroll Maske für Prüfung DFC_ExhTMonT1Plaus" VALUE 0x800230B0 Val_Wu16 65535.00 DFES_OneToOne 0.00 65535.00 /end CHARACTERISTIC
/begin CHARACTERISTIC DFC_CtlMsk.DFC_ExhTMonT2Plaus_C "DFC/Verhaltens Kontroll Maske für Prüfung DFC_ExhTMonT2Plaus" VALUE 0x800230B2 Val_Wu16 65535.00 DFES_OneToOne 0.00 65535.00 /end CHARACTERISTIC
/begin CHARACTERISTIC DFC_CtlMsk.DFC_ExhTMonT3Plaus_C "DFC/Verhaltens Kontroll Maske für Prüfung DFC_ExhTMonT3Plaus" VALUE 0x800230B4 Val_Wu16 65535.00 DFES_OneToOne 0.00 65535.00 /end CHARACTERISTIC
/begin CHARACTERISTIC DFC_CtlMsk.DFC_FlFltDsPSRCMax_C "DFC/Verhaltens Kontroll Maske für Prüfung DFC_FlFltDsPSRCMax" VALUE 0x800230B6 Val_Wu16 65535.00 DFES_OneToOne 0.00 65535.00 /end CHARACTERISTIC
/begin CHARACTERISTIC DFC_CtlMsk.DFC_FlFltDsPSRCMin_C "DFC/Verhaltens Kontroll Maske für Prüfung DFC_FlFltDsPSRCMin" VALUE 0x800230B8 Val_Wu16 65535.00 DFES_OneToOne 0.00 65535.00 /end CHARACTERISTIC
/begin CHARACTERISTIC DFC_CtlMsk.DFC_FlFltSig_C "DFC/Verhaltens Kontroll Maske für Prüfung DFC_FlFltSig" VALUE 0x800230BA Val_Wu16 65535.00 DFES_OneToOne 0.00 65535.00 /end CHARACTERISTIC
/begin CHARACTERISTIC DFC_CtlMsk.DFC_FlFltUsPSRCMax_C "DFC/Verhaltens Kontroll Maske für Prüfung DFC_FlFltUsPSRCMax" VALUE 0x800230BC Val_Wu16 65535.00 DFES_OneToOne 0.00 65535.00 /end CHARACTERISTIC
/begin CHARACTERISTIC DFC_CtlMsk.DFC_FlFltUsPSRCMin_C "DFC/Verhaltens Kontroll Maske für Prüfung DFC_FlFltUsPSRCMin" VALUE 0x800230BE Val_Wu16 65535.00 DFES_OneToOne 0.00 65535.00 /end CHARACTERISTIC
/begin CHARACTERISTIC DFC_CtlMsk.DFC_FuelTSRCMax_C "DFC/Verhaltens Kontroll Maske für Prüfung DFC_FuelTSRCMax" VALUE 0x800230C0 Val_Wu16 65535.00 DFES_OneToOne 0.00 65535.00 /end CHARACTERISTIC
/begin CHARACTERISTIC DFC_CtlMsk.DFC_FuelTSRCMin_C "DFC/Verhaltens Kontroll Maske für Prüfung DFC_FuelTSRCMin" VALUE 0x800230C2 Val_Wu16 65535.00 DFES_OneToOne 0.00 65535.00 /end CHARACTERISTIC
/begin CHARACTERISTIC DFC_CtlMsk.DFC_GbxNPosPPerSRCMax_C "DFC/Verhaltens Kontroll Maske für Prüfung DFC_GbxNPosPPerSRCMax" VALUE 0x800230C4 Val_Wu16 65535.00 DFES_OneToOne 0.00 65535.00 /end CHARACTERISTIC
/begin CHARACTERISTIC DFC_CtlMsk.DFC_GbxNPosPPerSRCMin_C "DFC/Verhaltens Kontroll Maske für Prüfung DFC_GbxNPosPPerSRCMin" VALUE 0x800230C6 Val_Wu16 65535.00 DFES_OneToOne 0.00 65535.00 /end CHARACTERISTIC
/begin CHARACTERISTIC DFC_CtlMsk.DFC_GbxNPosPdcycSRCMax_C "DFC/Verhaltens Kontroll Maske für Prüfung DFC_GbxNPosPdcycSRCMax" VALUE 0x800230C8 Val_Wu16 65535.00 DFES_OneToOne 0.00 65535.00 /end CHARACTERISTIC
/begin CHARACTERISTIC DFC_CtlMsk.DFC_GbxNPosPdcycSRCMin_C "DFC/Verhaltens Kontroll Maske für Prüfung DFC_GbxNPosPdcycSRCMin" VALUE 0x800230CA Val_Wu16 65535.00 DFES_OneToOne 0.00 65535.00 /end CHARACTERISTIC
/begin CHARACTERISTIC DFC_CtlMsk.DFC_InjVlvPresMin_C "DFC/Verhaltens Kontroll Maske für Prüfung DFC_InjVlvPresMin" VALUE 0x800230CC Val_Wu16 65535.00 DFES_OneToOne 0.00 65535.00 /end CHARACTERISTIC
/begin CHARACTERISTIC DFC_CtlMsk.DFC_LSUCircNernstSig_C "DFC/Verhaltens Kontroll Maske für Prüfung DFC_LSUCircNernstSig" VALUE 0x800230CE Val_Wu16 65535.00 DFES_OneToOne 0.00 65535.00 /end CHARACTERISTIC
/begin CHARACTERISTIC DFC_CtlMsk.DFC_LSUCircPmpCurSig_C "DFC/Verhaltens Kontroll Maske für Prüfung DFC_LSUCircPmpCurSig" VALUE 0x800230D0 Val_Wu16 65535.00 DFES_OneToOne 0.00 65535.00 /end CHARACTERISTIC
/begin CHARACTERISTIC DFC_CtlMsk.DFC_LSUCircVirtGndSig_C "DFC/Verhaltens Kontroll Maske für Prüfung DFC_LSUCircVirtGndSig" VALUE 0x800230D2 Val_Wu16 65535.00 DFES_OneToOne 0.00 65535.00 /end CHARACTERISTIC
/begin CHARACTERISTIC DFC_CtlMsk.DFC_LSUO2Max_C "DFC/Verhaltens Kontroll Maske für Prüfung DFC_LSUO2Max" VALUE 0x800230D4 Val_Wu16 65535.00 DFES_OneToOne 0.00 65535.00 /end CHARACTERISTIC
/begin CHARACTERISTIC DFC_CtlMsk.DFC_LSUO2Min_C "DFC/Verhaltens Kontroll Maske für Prüfung DFC_LSUO2Min" VALUE 0x800230D6 Val_Wu16 65535.00 DFES_OneToOne 0.00 65535.00 /end CHARACTERISTIC
/begin CHARACTERISTIC DFC_CtlMsk.DFC_LSUSPIBattLowMin_C "DFC/Verhaltens Kontroll Maske für Prüfung DFC_LSUSPIBattLowMin" VALUE 0x800230D8 Val_Wu16 65535.00 DFES_OneToOne 0.00 65535.00 /end CHARACTERISTIC
/begin CHARACTERISTIC DFC_CtlMsk.DFC_LSUWireSCB_C "DFC/Verhaltens Kontroll Maske für Prüfung DFC_LSUWireSCB" VALUE 0x800230DA Val_Wu16 65535.00 DFES_OneToOne 0.00 65535.00 /end CHARACTERISTIC
/begin CHARACTERISTIC DFC_CtlMsk.DFC_LSUWireSCG_C "DFC/Verhaltens Kontroll Maske für Prüfung DFC_LSUWireSCG" VALUE 0x800230DC Val_Wu16 65535.00 DFES_OneToOne 0.00 65535.00 /end CHARACTERISTIC
/begin CHARACTERISTIC DFC_CtlMsk.DFC_MeUnSCG_C "DFC/Verhaltens Kontroll Maske für Prüfung DFC_MeUnSCG" VALUE 0x800230DE Val_Wu16 65535.00 DFES_OneToOne 0.00 65535.00 /end CHARACTERISTIC
/begin CHARACTERISTIC DFC_CtlMsk.DFC_NSCDsCmpChk_C "DFC/Verhaltens Kontroll Maske für Prüfung DFC_NSCDsCmpChk" VALUE 0x800230E0 Val_Wu16 65535.00 DFES_OneToOne 0.00 65535.00 /end CHARACTERISTIC
/begin CHARACTERISTIC DFC_CtlMsk.DFC_NSCDsLamBinSRCMax_C "DFC/Verhaltens Kontroll Maske für Prüfung DFC_NSCDsLamBinSRCMax" VALUE 0x800230E2 Val_Wu16 65535.00 DFES_OneToOne 0.00 65535.00 /end CHARACTERISTIC
/begin CHARACTERISTIC DFC_CtlMsk.DFC_NSCDsLamBinSRCMin_C "DFC/Verhaltens Kontroll Maske für Prüfung DFC_NSCDsLamBinSRCMin" VALUE 0x800230E4 Val_Wu16 65535.00 DFES_OneToOne 0.00 65535.00 /end CHARACTERISTIC
/begin CHARACTERISTIC DFC_CtlMsk.DFC_NSCDsLamLinSRCMax_C "DFC/Verhaltens Kontroll Maske für Prüfung DFC_NSCDsLamLinSRCMax" VALUE 0x800230E6 Val_Wu16 65535.00 DFES_OneToOne 0.00 65535.00 /end CHARACTERISTIC
/begin CHARACTERISTIC DFC_CtlMsk.DFC_NSCDsLamLinSRCMin_C "DFC/Verhaltens Kontroll Maske für Prüfung DFC_NSCDsLamLinSRCMin" VALUE 0x800230E8 Val_Wu16 65535.00 DFES_OneToOne 0.00 65535.00 /end CHARACTERISTIC
/begin CHARACTERISTIC DFC_CtlMsk.DFC_NSCDsLamPlausMax_C "DFC/Verhaltens Kontroll Maske für Prüfung DFC_NSCDsLamPlausMax" VALUE 0x800230EA Val_Wu16 65535.00 DFES_OneToOne 0.00 65535.00 /end CHARACTERISTIC
/begin CHARACTERISTIC DFC_CtlMsk.DFC_NSCDsLamPlausMin_C "DFC/Verhaltens Kontroll Maske für Prüfung DFC_NSCDsLamPlausMin" VALUE 0x800230EC Val_Wu16 65535.00 DFES_OneToOne 0.00 65535.00 /end CHARACTERISTIC
/begin CHARACTERISTIC DFC_CtlMsk.DFC_NSCDsNOxSRCMax_C "DFC/Verhaltens Kontroll Maske für Prüfung DFC_NSCDsNOxSRCMax" VALUE 0x800230EE Val_Wu16 65535.00 DFES_OneToOne 0.00 65535.00 /end CHARACTERISTIC
/begin CHARACTERISTIC DFC_CtlMsk.DFC_NSCDsNOxSRCMin_C "DFC/Verhaltens Kontroll Maske für Prüfung DFC_NSCDsNOxSRCMin" VALUE 0x800230F0 Val_Wu16 65535.00 DFES_OneToOne 0.00 65535.00 /end CHARACTERISTIC
/begin CHARACTERISTIC DFC_CtlMsk.DFC_NSCDsOpCir_C "DFC/Verhaltens Kontroll Maske für Prüfung DFC_NSCDsOpCir" VALUE 0x800230F2 Val_Wu16 65535.00 DFES_OneToOne 0.00 65535.00 /end CHARACTERISTIC
/begin CHARACTERISTIC DFC_CtlMsk.DFC_NSCDsShCir_C "DFC/Verhaltens Kontroll Maske für Prüfung DFC_NSCDsShCir" VALUE 0x800230F4 Val_Wu16 65535.00 DFES_OneToOne 0.00 65535.00 /end CHARACTERISTIC
/begin CHARACTERISTIC DFC_CtlMsk.DFC_NoCat2DsCmpChk_C "DFC/Verhaltens Kontroll Maske für Prüfung DFC_NoCat2DsCmpChk" VALUE 0x800230F6 Val_Wu16 65535.00 DFES_OneToOne 0.00 65535.00 /end CHARACTERISTIC
/begin CHARACTERISTIC DFC_CtlMsk.DFC_NoCat2DsLamBinSRCMax_C "DFC/Verhaltens Kontroll Maske für Prüfung DFC_NoCat2DsLamBinSRCMax" VALUE 0x800230F8 Val_Wu16 65535.00 DFES_OneToOne 0.00 65535.00 /end CHARACTERISTIC
/begin CHARACTERISTIC DFC_CtlMsk.DFC_NoCat2DsLamBinSRCMin_C "DFC/Verhaltens Kontroll Maske für Prüfung DFC_NoCat2DsLamBinSRCMin" VALUE 0x800230FA Val_Wu16 65535.00 DFES_OneToOne 0.00 65535.00 /end CHARACTERISTIC
/begin CHARACTERISTIC DFC_CtlMsk.DFC_NoCat2DsLamLinSRCMax_C "DFC/Verhaltens Kontroll Maske für Prüfung DFC_NoCat2DsLamLinSRCMax" VALUE 0x800230FC Val_Wu16 65535.00 DFES_OneToOne 0.00 65535.00 /end CHARACTERISTIC
/begin CHARACTERISTIC DFC_CtlMsk.DFC_NoCat2DsLamLinSRCMin_C "DFC/Verhaltens Kontroll Maske für Prüfung DFC_NoCat2DsLamLinSRCMin" VALUE 0x800230FE Val_Wu16 65535.00 DFES_OneToOne 0.00 65535.00 /end CHARACTERISTIC
/begin CHARACTERISTIC DFC_CtlMsk.DFC_NoCat2DsLamPlausMax_C "DFC/Verhaltens Kontroll Maske für Prüfung DFC_NoCat2DsLamPlausMax" VALUE 0x80023100 Val_Wu16 65535.00 DFES_OneToOne 0.00 65535.00 /end CHARACTERISTIC
/begin CHARACTERISTIC DFC_CtlMsk.DFC_NoCat2DsLamPlausMin_C "DFC/Verhaltens Kontroll Maske für Prüfung DFC_NoCat2DsLamPlausMin" VALUE 0x80023102 Val_Wu16 65535.00 DFES_OneToOne 0.00 65535.00 /end CHARACTERISTIC
/begin CHARACTERISTIC DFC_CtlMsk.DFC_NoCat2DsNOxSRCMax_C "DFC/Verhaltens Kontroll Maske für Prüfung DFC_NoCat2DsNOxSRCMax" VALUE 0x80023104 Val_Wu16 65535.00 DFES_OneToOne 0.00 65535.00 /end CHARACTERISTIC
/begin CHARACTERISTIC DFC_CtlMsk.DFC_NoCat2DsNOxSRCMin_C "DFC/Verhaltens Kontroll Maske für Prüfung DFC_NoCat2DsNOxSRCMin" VALUE 0x80023106 Val_Wu16 65535.00 DFES_OneToOne 0.00 65535.00 /end CHARACTERISTIC
/begin CHARACTERISTIC DFC_CtlMsk.DFC_NoCat2DsOpCir_C "DFC/Verhaltens Kontroll Maske für Prüfung DFC_NoCat2DsOpCir" VALUE 0x80023108 Val_Wu16 65535.00 DFES_OneToOne 0.00 65535.00 /end CHARACTERISTIC
/begin CHARACTERISTIC DFC_CtlMsk.DFC_NoCat2DsShCir_C "DFC/Verhaltens Kontroll Maske für Prüfung DFC_NoCat2DsShCir" VALUE 0x8002310A Val_Wu16 65535.00 DFES_OneToOne 0.00 65535.00 /end CHARACTERISTIC
/begin CHARACTERISTIC DFC_CtlMsk.DFC_NplDynPPFltDiff_C "DFC/Verhaltens Kontroll Maske für Prüfung DFC_NplDynPPFltDiff" VALUE 0x8002310C Val_Wu16 65535.00 DFES_OneToOne 0.00 65535.00 /end CHARACTERISTIC
/begin CHARACTERISTIC DFC_CtlMsk.DFC_NplHsChngPPFltDiff_C "DFC/Verhaltens Kontroll Maske für Prüfung DFC_NplHsChngPPFltDiff" VALUE 0x8002310E Val_Wu16 65535.00 DFES_OneToOne 0.00 65535.00 /end CHARACTERISTIC
/begin CHARACTERISTIC DFC_CtlMsk.DFC_NplHsLnPPFltDiff_C "DFC/Verhaltens Kontroll Maske für Prüfung DFC_NplHsLnPPFltDiff" VALUE 0x80023110 Val_Wu16 65535.00 DFES_OneToOne 0.00 65535.00 /end CHARACTERISTIC
/begin CHARACTERISTIC DFC_CtlMsk.DFC_NplTOxiCatUs_C "DFC/Verhaltens Kontroll Maske für Prüfung DFC_NplTOxiCatUs" VALUE 0x80023112 Val_Wu16 65535.00 DFES_OneToOne 0.00 65535.00 /end CHARACTERISTIC
/begin CHARACTERISTIC DFC_CtlMsk.DFC_NplTPFltUs_C "DFC/Verhaltens Kontroll Maske für Prüfung DFC_NplTPFltUs" VALUE 0x80023114 Val_Wu16 65535.00 DFES_OneToOne 0.00 65535.00 /end CHARACTERISTIC
/begin CHARACTERISTIC DFC_CtlMsk.DFC_NplTTrbnUs_C "DFC/Verhaltens Kontroll Maske für Prüfung DFC_NplTTrbnUs" VALUE 0x80023116 Val_Wu16 65535.00 DFES_OneToOne 0.00 65535.00 /end CHARACTERISTIC
/begin CHARACTERISTIC DFC_CtlMsk.DFC_OilPSwmpSRCMax_C "DFC/Verhaltens Kontroll Maske für Prüfung DFC_OilPSwmpSRCMax" VALUE 0x80023118 Val_Wu16 65535.00 DFES_OneToOne 0.00 65535.00 /end CHARACTERISTIC
/begin CHARACTERISTIC DFC_CtlMsk.DFC_OilPSwmpSRCMin_C "DFC/Verhaltens Kontroll Maske für Prüfung DFC_OilPSwmpSRCMin" VALUE 0x8002311A Val_Wu16 65535.00 DFES_OneToOne 0.00 65535.00 /end CHARACTERISTIC
/begin CHARACTERISTIC DFC_CtlMsk.DFC_PCVSCG_C "DFC/Verhaltens Kontroll Maske für Prüfung DFC_PCVSCG" VALUE 0x8002311C Val_Wu16 65535.00 DFES_OneToOne 0.00 65535.00 /end CHARACTERISTIC
/begin CHARACTERISTIC DFC_CtlMsk.DFC_PFltCharPDiffMin_C "DFC/Verhaltens Kontroll Maske für Prüfung DFC_PFltCharPDiffMin" VALUE 0x8002311E Val_Wu16 65535.00 DFES_OneToOne 0.00 65535.00 /end CHARACTERISTIC
/begin CHARACTERISTIC DFC_CtlMsk.DFC_PFltDstrMin_C "DFC/Verhaltens Kontroll Maske für Prüfung DFC_PFltDstrMin" VALUE 0x80023120 Val_Wu16 65535.00 DFES_OneToOne 0.00 65535.00 /end CHARACTERISTIC
/begin CHARACTERISTIC DFC_CtlMsk.DFC_PFltEngPrt_C "DFC/Verhaltens Kontroll Maske für Prüfung DFC_PFltEngPrt" VALUE 0x80023122 Val_Wu16 65535.00 DFES_OneToOne 0.00 65535.00 /end CHARACTERISTIC
/begin CHARACTERISTIC DFC_CtlMsk.DFC_PFltRgnPerm_C "DFC/Verhaltens Kontroll Maske für Prüfung DFC_PFltRgnPerm" VALUE 0x80023124 Val_Wu16 65535.00 DFES_OneToOne 0.00 65535.00 /end CHARACTERISTIC
/begin CHARACTERISTIC DFC_CtlMsk.DFC_PFltSRCMaxFlwRstn_C "DFC/Verhaltens Kontroll Maske für Prüfung DFC_PFltSRCMaxFlwRstn" VALUE 0x80023126 Val_Wu16 65535.00 DFES_OneToOne 0.00 65535.00 /end CHARACTERISTIC
/begin CHARACTERISTIC DFC_CtlMsk.DFC_PFltSRCMinFlwRstn_C "DFC/Verhaltens Kontroll Maske für Prüfung DFC_PFltSRCMinFlwRstn" VALUE 0x80023128 Val_Wu16 65535.00 DFES_OneToOne 0.00 65535.00 /end CHARACTERISTIC
/begin CHARACTERISTIC DFC_CtlMsk.DFC_PFltSotMsDvtMax_C "DFC/Verhaltens Kontroll Maske für Prüfung DFC_PFltSotMsDvtMax" VALUE 0x8002312A Val_Wu16 65535.00 DFES_OneToOne 0.00 65535.00 /end CHARACTERISTIC
/begin CHARACTERISTIC DFC_CtlMsk.DFC_PFltSotMsDvtMin_C "DFC/Verhaltens Kontroll Maske für Prüfung DFC_PFltSotMsDvtMin" VALUE 0x8002312C Val_Wu16 65535.00 DFES_OneToOne 0.00 65535.00 /end CHARACTERISTIC
/begin CHARACTERISTIC DFC_CtlMsk.DFC_PFltSotMsMax_C "DFC/Verhaltens Kontroll Maske für Prüfung DFC_PFltSotMsMax" VALUE 0x8002312E Val_Wu16 65535.00 DFES_OneToOne 0.00 65535.00 /end CHARACTERISTIC
/begin CHARACTERISTIC DFC_CtlMsk.DFC_PIntkVUsSRCMax_C "DFC/Verhaltens Kontroll Maske für Prüfung DFC_PIntkVUsSRCMax" VALUE 0x80023130 Val_Wu16 65535.00 DFES_OneToOne 0.00 65535.00 /end CHARACTERISTIC
/begin CHARACTERISTIC DFC_CtlMsk.DFC_PIntkVUsSRCMin_C "DFC/Verhaltens Kontroll Maske für Prüfung DFC_PIntkVUsSRCMin" VALUE 0x80023132 Val_Wu16 65535.00 DFES_OneToOne 0.00 65535.00 /end CHARACTERISTIC
/begin CHARACTERISTIC DFC_CtlMsk.DFC_SRCHighAPP1_C "DFC/Verhaltens Kontroll Maske für Prüfung DFC_SRCHighAPP1" VALUE 0x80023134 Val_Wu16 65535.00 DFES_OneToOne 0.00 65535.00 /end CHARACTERISTIC
/begin CHARACTERISTIC DFC_CtlMsk.DFC_SRCHighAPP2_C "DFC/Verhaltens Kontroll Maske für Prüfung DFC_SRCHighAPP2" VALUE 0x80023136 Val_Wu16 65535.00 DFES_OneToOne 0.00 65535.00 /end CHARACTERISTIC
/begin CHARACTERISTIC DFC_CtlMsk.DFC_SRCLowAPP1_C "DFC/Verhaltens Kontroll Maske für Prüfung DFC_SRCLowAPP1" VALUE 0x80023138 Val_Wu16 65535.00 DFES_OneToOne 0.00 65535.00 /end CHARACTERISTIC
/begin CHARACTERISTIC DFC_CtlMsk.DFC_SRCLowAPP2_C "DFC/Verhaltens Kontroll Maske für Prüfung DFC_SRCLowAPP2" VALUE 0x8002313A Val_Wu16 65535.00 DFES_OneToOne 0.00 65535.00 /end CHARACTERISTIC
/begin CHARACTERISTIC DFC_CtlMsk.DFC_SRCMaxPPFltDiff_C "DFC/Verhaltens Kontroll Maske für Prüfung DFC_SRCMaxPPFltDiff" VALUE 0x8002313C Val_Wu16 65535.00 DFES_OneToOne 0.00 65535.00 /end CHARACTERISTIC
/begin CHARACTERISTIC DFC_CtlMsk.DFC_SRCMaxPPFltUs_C "DFC/Verhaltens Kontroll Maske für Prüfung DFC_SRCMaxPPFltUs" VALUE 0x8002313E Val_Wu16 65535.00 DFES_OneToOne 0.00 65535.00 /end CHARACTERISTIC
/begin CHARACTERISTIC DFC_CtlMsk.DFC_SRCMaxTECU_C "DFC/Verhaltens Kontroll Maske für Prüfung DFC_SRCMaxTECU" VALUE 0x80023140 Val_Wu16 65535.00 DFES_OneToOne 0.00 65535.00 /end CHARACTERISTIC
/begin CHARACTERISTIC DFC_CtlMsk.DFC_SRCMaxTOxiCatUs_C "DFC/Verhaltens Kontroll Maske für Prüfung DFC_SRCMaxTOxiCatUs" VALUE 0x80023142 Val_Wu16 65535.00 DFES_OneToOne 0.00 65535.00 /end CHARACTERISTIC
/begin CHARACTERISTIC DFC_CtlMsk.DFC_SRCMaxTPFltUs_C "DFC/Verhaltens Kontroll Maske für Prüfung DFC_SRCMaxTPFltUs" VALUE 0x80023144 Val_Wu16 65535.00 DFES_OneToOne 0.00 65535.00 /end CHARACTERISTIC
/begin CHARACTERISTIC DFC_CtlMsk.DFC_SRCMaxTTrbnUs_C "DFC/Verhaltens Kontroll Maske für Prüfung DFC_SRCMaxTTrbnUs" VALUE 0x80023146 Val_Wu16 65535.00 DFES_OneToOne 0.00 65535.00 /end CHARACTERISTIC
/begin CHARACTERISTIC DFC_CtlMsk.DFC_SRCMaxUCatUsT_C "DFC/Verhaltens Kontroll Maske für Prüfung DFC_SRCMaxUCatUsT" VALUE 0x80023148 Val_Wu16 65535.00 DFES_OneToOne 0.00 65535.00 /end CHARACTERISTIC
/begin CHARACTERISTIC DFC_CtlMsk.DFC_SRCMaxUPmpP_C "DFC/Verhaltens Kontroll Maske für Prüfung DFC_SRCMaxUPmpP" VALUE 0x8002314A Val_Wu16 65535.00 DFES_OneToOne 0.00 65535.00 /end CHARACTERISTIC
/begin CHARACTERISTIC DFC_CtlMsk.DFC_SRCMinPPFltDiff_C "DFC/Verhaltens Kontroll Maske für Prüfung DFC_SRCMinPPFltDiff" VALUE 0x8002314C Val_Wu16 65535.00 DFES_OneToOne 0.00 65535.00 /end CHARACTERISTIC
/begin CHARACTERISTIC DFC_CtlMsk.DFC_SRCMinPPFltUs_C "DFC/Verhaltens Kontroll Maske für Prüfung DFC_SRCMinPPFltUs" VALUE 0x8002314E Val_Wu16 65535.00 DFES_OneToOne 0.00 65535.00 /end CHARACTERISTIC
/begin CHARACTERISTIC DFC_CtlMsk.DFC_SRCMinTECU_C "DFC/Verhaltens Kontroll Maske für Prüfung DFC_SRCMinTECU" VALUE 0x80023150 Val_Wu16 65535.00 DFES_OneToOne 0.00 65535.00 /end CHARACTERISTIC
/begin CHARACTERISTIC DFC_CtlMsk.DFC_SRCMinTOxiCatUs_C "DFC/Verhaltens Kontroll Maske für Prüfung DFC_SRCMinTOxiCatUs" VALUE 0x80023152 Val_Wu16 65535.00 DFES_OneToOne 0.00 65535.00 /end CHARACTERISTIC
/begin CHARACTERISTIC DFC_CtlMsk.DFC_SRCMinTPFltUs_C "DFC/Verhaltens Kontroll Maske für Prüfung DFC_SRCMinTPFltUs" VALUE 0x80023154 Val_Wu16 65535.00 DFES_OneToOne 0.00 65535.00 /end CHARACTERISTIC
/begin CHARACTERISTIC DFC_CtlMsk.DFC_SRCMinTTrbnUs_C "DFC/Verhaltens Kontroll Maske für Prüfung DFC_SRCMinTTrbnUs" VALUE 0x80023156 Val_Wu16 65535.00 DFES_OneToOne 0.00 65535.00 /end CHARACTERISTIC
/begin CHARACTERISTIC DFC_CtlMsk.DFC_SRCMinUCatUsT_C "DFC/Verhaltens Kontroll Maske für Prüfung DFC_SRCMinUCatUsT" VALUE 0x80023158 Val_Wu16 65535.00 DFES_OneToOne 0.00 65535.00 /end CHARACTERISTIC
/begin CHARACTERISTIC DFC_CtlMsk.DFC_SRCMinUPmpP_C "DFC/Verhaltens Kontroll Maske für Prüfung DFC_SRCMinUPmpP" VALUE 0x8002315A Val_Wu16 65535.00 DFES_OneToOne 0.00 65535.00 /end CHARACTERISTIC
/begin CHARACTERISTIC DFC_CtlMsk.DFC_SigUCatUsT_C "DFC/Verhaltens Kontroll Maske für Prüfung DFC_SigUCatUsT" VALUE 0x8002315C Val_Wu16 65535.00 DFES_OneToOne 0.00 65535.00 /end CHARACTERISTIC
/begin CHARACTERISTIC DFC_CtlMsk.DFC_SigUPmpP_C "DFC/Verhaltens Kontroll Maske für Prüfung DFC_SigUPmpP" VALUE 0x8002315E Val_Wu16 65535.00 DFES_OneToOne 0.00 65535.00 /end CHARACTERISTIC
/begin CHARACTERISTIC DFC_CtlMsk.DFC_SyncAPP_C "DFC/Verhaltens Kontroll Maske für Prüfung DFC_SyncAPP" VALUE 0x80023160 Val_Wu16 65535.00 DFES_OneToOne 0.00 65535.00 /end CHARACTERISTIC
/begin CHARACTERISTIC DFC_CtlMsk.DFC_T15Npl_C "DFC/Verhaltens Kontroll Maske für Prüfung DFC_T15Npl" VALUE 0x80023162 Val_Wu16 65535.00 DFES_OneToOne 0.00 65535.00 /end CHARACTERISTIC
/begin CHARACTERISTIC DFC_CtlMsk.DFC_TAFSDtyCycHi_C "DFC/Verhaltens Kontroll Maske für Prüfung DFC_TAFSDtyCycHi" VALUE 0x80023164 Val_Wu16 65535.00 DFES_OneToOne 0.00 65535.00 /end CHARACTERISTIC
/begin CHARACTERISTIC DFC_CtlMsk.DFC_TAFSDtyCycLo_C "DFC/Verhaltens Kontroll Maske für Prüfung DFC_TAFSDtyCycLo" VALUE 0x80023166 Val_Wu16 65535.00 DFES_OneToOne 0.00 65535.00 /end CHARACTERISTIC
/begin CHARACTERISTIC DFC_CtlMsk.DFC_TAFSPerHi_C "DFC/Verhaltens Kontroll Maske für Prüfung DFC_TAFSPerHi" VALUE 0x80023168 Val_Wu16 65535.00 DFES_OneToOne 0.00 65535.00 /end CHARACTERISTIC
/begin CHARACTERISTIC DFC_CtlMsk.DFC_TAFSPerLo_C "DFC/Verhaltens Kontroll Maske für Prüfung DFC_TAFSPerLo" VALUE 0x8002316A Val_Wu16 65535.00 DFES_OneToOne 0.00 65535.00 /end CHARACTERISTIC
/begin MEASUREMENT DFC_ctLDF_mp "Anzahl defekter Fehlerprüfungen, LDF (last debouced error flag) gesetzt" UWORD OneToOne 1 100 0.00 65535.00 ECU_ADDRESS 0xC0009C2A /end MEASUREMENT
/begin MEASUREMENT DFC_st.DFC_EGRVlvLPShTDrft "DFC/Status der Fehlerprüfung DFC_EGRVlvLPShTDrft" UWORD DFC_OneToOne 1 100 0.00 65535.00 ECU_ADDRESS 0xD0008B9A /end MEASUREMENT
/begin MEASUREMENT DFC_st.DFC_EGRVlvLgTDrft "DFC/Status der Fehlerprüfung DFC_EGRVlvLgTDrft" UWORD DFC_OneToOne 1 100 0.00 65535.00 ECU_ADDRESS 0xD0008B9C /end MEASUREMENT
/begin MEASUREMENT DFC_st.DFC_EGRVlvOfsLrnJamVlv "DFC/Status der Fehlerprüfung DFC_EGRVlvOfsLrnJamVlv" UWORD DFC_OneToOne 1 100 0.00 65535.00 ECU_ADDRESS 0xD0008B9E /end MEASUREMENT
/begin MEASUREMENT DFC_st.DFC_EGRVlvShTDrft "DFC/Status der Fehlerprüfung DFC_EGRVlvShTDrft" UWORD DFC_OneToOne 1 100 0.00 65535.00 ECU_ADDRESS 0xD0008BA0 /end MEASUREMENT
/begin MEASUREMENT DFC_st.DFC_EngICO "DFC/Status der Fehlerprüfung DFC_EngICO" UWORD DFC_OneToOne 1 100 0.00 65535.00 ECU_ADDRESS 0xD0008BA2 /end MEASUREMENT
/begin MEASUREMENT DFC_st.DFC_EpmCaSI1ErrSig "DFC/Status der Fehlerprüfung DFC_EpmCaSI1ErrSig" UWORD DFC_OneToOne 1 100 0.00 65535.00 ECU_ADDRESS 0xD0008BA4 /end MEASUREMENT
/begin MEASUREMENT DFC_st.DFC_EpmCaSI1NoSig "DFC/Status der Fehlerprüfung DFC_EpmCaSI1NoSig" UWORD DFC_OneToOne 1 100 0.00 65535.00 ECU_ADDRESS 0xD0008BA6 /end MEASUREMENT
/begin MEASUREMENT DFC_st.DFC_EpmCaSI1OfsErr "DFC/Status der Fehlerprüfung DFC_EpmCaSI1OfsErr" UWORD DFC_OneToOne 1 100 0.00 65535.00 ECU_ADDRESS 0xD0008BA8 /end MEASUREMENT
/begin MEASUREMENT DFC_st.DFC_EpmCrSErrSig "DFC/Status der Fehlerprüfung DFC_EpmCrSErrSig" UWORD DFC_OneToOne 1 100 0.00 65535.00 ECU_ADDRESS 0xD0008BAA /end MEASUREMENT
/begin MEASUREMENT DFC_st.DFC_EpmCrSNoSig "DFC/Status der Fehlerprüfung DFC_EpmCrSNoSig" UWORD DFC_OneToOne 1 100 0.00 65535.00 ECU_ADDRESS 0xD0008BAC /end MEASUREMENT
/begin MEASUREMENT DFC_st.DFC_IVPlausComprTst "DFC/Status der Fehlerprüfung DFC_IVPlausComprTst" UWORD DFC_OneToOne 1 100 0.00 65535.00 ECU_ADDRESS 0xD0008BAE /end MEASUREMENT
/begin MEASUREMENT DFC_st.DFC_IVPlausRunUpTst "DFC/Status der Fehlerprüfung DFC_IVPlausRunUpTst" UWORD DFC_OneToOne 1 100 0.00 65535.00 ECU_ADDRESS 0xD0008BB0 /end MEASUREMENT
/begin MEASUREMENT DFC_st.DFC_InjCrvShOffTst "DFC/Status der Fehlerprüfung DFC_InjCrvShOffTst" UWORD DFC_OneToOne 1 100 0.00 65535.00 ECU_ADDRESS 0xD0008BB2 /end MEASUREMENT
/begin MEASUREMENT DFC_st.DFC_LayerEnSavModProd "DFC/Status der Fehlerprüfung DFC_LayerEnSavModProd" UWORD DFC_OneToOne 1 100 0.00 65535.00 ECU_ADDRESS 0xD0008BB4 /end MEASUREMENT
/begin MEASUREMENT DFC_st.DFC_LayerEnSavModRep "DFC/Status der Fehlerprüfung DFC_LayerEnSavModRep" UWORD DFC_OneToOne 1 100 0.00 65535.00 ECU_ADDRESS 0xD0008BB6 /end MEASUREMENT
/begin MEASUREMENT DFC_st.DFC_LayerEnSavModShip "DFC/Status der Fehlerprüfung DFC_LayerEnSavModShip" UWORD DFC_OneToOne 1 100 0.00 65535.00 ECU_ADDRESS 0xD0008BB8 /end MEASUREMENT
/begin MEASUREMENT DFC_st.DFC_MRlyErlyOpng "DFC/Status der Fehlerprüfung DFC_MRlyErlyOpng" UWORD DFC_OneToOne 1 100 0.00 65535.00 ECU_ADDRESS 0xD0008BBA /end MEASUREMENT
/begin MEASUREMENT DFC_st.DFC_MRlyStk "DFC/Status der Fehlerprüfung DFC_MRlyStk" UWORD DFC_OneToOne 1 100 0.00 65535.00 ECU_ADDRESS 0xD0008BBC /end MEASUREMENT
/begin MEASUREMENT DFC_st.DFC_MeUnActrTst "DFC/Status der Fehlerprüfung DFC_MeUnActrTst" UWORD DFC_OneToOne 1 100 0.00 65535.00 ECU_ADDRESS 0xD0008BBE /end MEASUREMENT
/begin MEASUREMENT DFC_st.DFC_MoCADCCmp "DFC/Status der Fehlerprüfung DFC_MoCADCCmp" UWORD DFC_OneToOne 1 100 0.00 65535.00 ECU_ADDRESS 0xD0008BC0 /end MEASUREMENT
/begin MEASUREMENT DFC_st.DFC_MoCADCTst "DFC/Status der Fehlerprüfung DFC_MoCADCTst" UWORD DFC_OneToOne 1 100 0.00 65535.00 ECU_ADDRESS 0xD0008BC2 /end MEASUREMENT
/begin MEASUREMENT DFC_st.DFC_MoCADCVltgRatio "DFC/Status der Fehlerprüfung DFC_MoCADCVltgRatio" UWORD DFC_OneToOne 1 100 0.00 65535.00 ECU_ADDRESS 0xD0008BC4 /end MEASUREMENT
/begin MEASUREMENT DFC_st.DFC_MoCComErrCnt "DFC/Status der Fehlerprüfung DFC_MoCComErrCnt" UWORD DFC_OneToOne 1 100 0.00 65535.00 ECU_ADDRESS 0xD0008BC6 /end MEASUREMENT
/begin MEASUREMENT DFC_st.DFC_MoCComSPI "DFC/Status der Fehlerprüfung DFC_MoCComSPI" UWORD DFC_OneToOne 1 100 0.00 65535.00 ECU_ADDRESS 0xD0008BC8 /end MEASUREMENT
/begin MEASUREMENT DFC_st.DFC_MoCROMErrXPg "DFC/Status der Fehlerprüfung DFC_MoCROMErrXPg" UWORD DFC_OneToOne 1 100 0.00 65535.00 ECU_ADDRESS 0xD0008BCA /end MEASUREMENT
/begin MEASUREMENT DFC_st.DFC_MoCSOPHwNoRdy "DFC/Status der Fehlerprüfung DFC_MoCSOPHwNoRdy" UWORD DFC_OneToOne 1 100 0.00 65535.00 ECU_ADDRESS 0xD0008BCC /end MEASUREMENT
/begin MEASUREMENT DFC_st.DFC_MoCSOPLoLi "DFC/Status der Fehlerprüfung DFC_MoCSOPLoLi" UWORD DFC_OneToOne 1 100 0.00 65535.00 ECU_ADDRESS 0xD0008BCE /end MEASUREMENT
/begin MEASUREMENT DFC_st.DFC_MoCSOPMM "DFC/Status der Fehlerprüfung DFC_MoCSOPMM" UWORD DFC_OneToOne 1 100 0.00 65535.00 ECU_ADDRESS 0xD0008BD0 /end MEASUREMENT
/begin MEASUREMENT DFC_st.DFC_MoCSOPTimeOut "DFC/Status der Fehlerprüfung DFC_MoCSOPTimeOut" UWORD DFC_OneToOne 1 100 0.00 65535.00 ECU_ADDRESS 0xD0008BD2 /end MEASUREMENT
/begin MEASUREMENT DFC_st.DFC_MoCSOPUpLi "DFC/Status der Fehlerprüfung DFC_MoCSOPUpLi" UWORD DFC_OneToOne 1 100 0.00 65535.00 ECU_ADDRESS 0xD0008BD4 /end MEASUREMENT
/begin MEASUREMENT DFC_st.DFC_MoFAPP "DFC/Status der Fehlerprüfung DFC_MoFAPP" UWORD DFC_OneToOne 1 100 0.00 65535.00 ECU_ADDRESS 0xD0008BD6 /end MEASUREMENT
/begin MEASUREMENT DFC_st.DFC_MoFESpd "DFC/Status der Fehlerprüfung DFC_MoFESpd" UWORD DFC_OneToOne 1 100 0.00 65535.00 ECU_ADDRESS 0xD0008BD8 /end MEASUREMENT
/begin MEASUREMENT DFC_st.DFC_MoFInjDatPhi "DFC/Status der Fehlerprüfung DFC_MoFInjDatPhi" UWORD DFC_OneToOne 1 100 0.00 65535.00 ECU_ADDRESS 0xD0008BDA /end MEASUREMENT
/begin MEASUREMENT DFC_st.DFC_MoFInjDatQnt "DFC/Status der Fehlerprüfung DFC_MoFInjDatQnt" UWORD DFC_OneToOne 1 100 0.00 65535.00 ECU_ADDRESS 0xD0008BDC /end MEASUREMENT
/begin MEASUREMENT DFC_st.DFC_MoFInjQnt "DFC/Status der Fehlerprüfung DFC_MoFInjQnt" UWORD DFC_OneToOne 1 100 0.00 65535.00 ECU_ADDRESS 0xD0008BDE /end MEASUREMENT
/begin MEASUREMENT DFC_st.DFC_MoFMode1PoI1 "DFC/Status der Fehlerprüfung DFC_MoFMode1PoI1" UWORD DFC_OneToOne 1 100 0.00 65535.00 ECU_ADDRESS 0xD0008BE0 /end MEASUREMENT
/begin MEASUREMENT DFC_st.DFC_MoFMode1PoI2 "DFC/Status der Fehlerprüfung DFC_MoFMode1PoI2" UWORD DFC_OneToOne 1 100 0.00 65535.00 ECU_ADDRESS 0xD0008BE2 /end MEASUREMENT
/begin MEASUREMENT DFC_st.DFC_MoFMode2PoI1 "DFC/Status der Fehlerprüfung DFC_MoFMode2PoI1" UWORD DFC_OneToOne 1 100 0.00 65535.00 ECU_ADDRESS 0xD0008BE4 /end MEASUREMENT
/begin MEASUREMENT DFC_st.DFC_MoFMode2PoI2 "DFC/Status der Fehlerprüfung DFC_MoFMode2PoI2" UWORD DFC_OneToOne 1 100 0.00 65535.00 ECU_ADDRESS 0xD0008BE6 /end MEASUREMENT
/begin MEASUREMENT DFC_st.DFC_MoFOvR "DFC/Status der Fehlerprüfung DFC_MoFOvR" UWORD DFC_OneToOne 1 100 0.00 65535.00 ECU_ADDRESS 0xD0008BE8 /end MEASUREMENT
/begin MEASUREMENT DFC_st.DFC_MoFQntCor "DFC/Status der Fehlerprüfung DFC_MoFQntCor" UWORD DFC_OneToOne 1 100 0.00 65535.00 ECU_ADDRESS 0xD0008BEA /end MEASUREMENT
/begin MEASUREMENT DFC_st.DFC_MoFRailP "DFC/Status der Fehlerprüfung DFC_MoFRailP" UWORD DFC_OneToOne 1 100 0.00 65535.00 ECU_ADDRESS 0xD0008BEC /end MEASUREMENT
/begin MEASUREMENT DFC_st.DFC_MoFTrqCmp "DFC/Status der Fehlerprüfung DFC_MoFTrqCmp" UWORD DFC_OneToOne 1 100 0.00 65535.00 ECU_ADDRESS 0xD0008BEE /end MEASUREMENT
/begin MEASUREMENT DFC_st.DFC_NSCDsHtrSetP "DFC/Status der Fehlerprüfung DFC_NSCDsHtrSetP" UWORD DFC_OneToOne 1 100 0.00 65535.00 ECU_ADDRESS 0xD0008BF0 /end MEASUREMENT
/begin MEASUREMENT DFC_st.DFC_NoCat2DsHtrSetP "DFC/Status der Fehlerprüfung DFC_NoCat2DsHtrSetP" UWORD DFC_OneToOne 1 100 0.00 65535.00 ECU_ADDRESS 0xD0008BF2 /end MEASUREMENT
/begin MEASUREMENT DFC_st.DFC_PCVActrTst "DFC/Status der Fehlerprüfung DFC_PCVActrTst" UWORD DFC_OneToOne 1 100 0.00 65535.00 ECU_ADDRESS 0xD0008BF4 /end MEASUREMENT
/begin MEASUREMENT DFC_st.DFC_PhyModNonMonMapNpl "DFC/Status der Fehlerprüfung DFC_PhyModNonMonMapNpl" UWORD DFC_OneToOne 1 100 0.00 65535.00 ECU_ADDRESS 0xD0008BF6 /end MEASUREMENT
/begin MEASUREMENT DFC_st.DFC_RailHpTst "DFC/Status der Fehlerprüfung DFC_RailHpTst" UWORD DFC_OneToOne 1 100 0.00 65535.00 ECU_ADDRESS 0xD0008BF8 /end MEASUREMENT
/begin MEASUREMENT DFC_st.DFC_RailPOfsTstMax "DFC/Status der Fehlerprüfung DFC_RailPOfsTstMax" UWORD DFC_OneToOne 1 100 0.00 65535.00 ECU_ADDRESS 0xD0008BFA /end MEASUREMENT
/begin MEASUREMENT DFC_st.DFC_RailPOfsTstMin "DFC/Status der Fehlerprüfung DFC_RailPOfsTstMin" UWORD DFC_OneToOne 1 100 0.00 65535.00 ECU_ADDRESS 0xD0008BFC /end MEASUREMENT
/begin MEASUREMENT DFC_st.DFC_SIA_E1max "DFC/Status der Fehlerprüfung DFC_SIA_E1max" UWORD DFC_OneToOne 1 100 0.00 65535.00 ECU_ADDRESS 0xD0008BFE /end MEASUREMENT
/begin MEASUREMENT DFC_st.DFC_SIA_E1min "DFC/Status der Fehlerprüfung DFC_SIA_E1min" UWORD DFC_OneToOne 1 100 0.00 65535.00 ECU_ADDRESS 0xD0008C00 /end MEASUREMENT
/begin MEASUREMENT DFC_st.DFC_SIA_E1npl "DFC/Status der Fehlerprüfung DFC_SIA_E1npl" UWORD DFC_OneToOne 1 100 0.00 65535.00 ECU_ADDRESS 0xD0008C02 /end MEASUREMENT
/begin MEASUREMENT DFC_st.DFC_SIA_E1sig "DFC/Status der Fehlerprüfung DFC_SIA_E1sig" UWORD DFC_OneToOne 1 100 0.00 65535.00 ECU_ADDRESS 0xD0008C04 /end MEASUREMENT
/begin MEASUREMENT DFC_st.DFC_SIA_E2max "DFC/Status der Fehlerprüfung DFC_SIA_E2max" UWORD DFC_OneToOne 1 100 0.00 65535.00 ECU_ADDRESS 0xD0008C06 /end MEASUREMENT
/begin MEASUREMENT DFC_st.DFC_SIA_E2min "DFC/Status der Fehlerprüfung DFC_SIA_E2min" UWORD DFC_OneToOne 1 100 0.00 65535.00 ECU_ADDRESS 0xD0008C08 /end MEASUREMENT
/begin MEASUREMENT DFC_st.DFC_SIA_E2npl "DFC/Status der Fehlerprüfung DFC_SIA_E2npl" UWORD DFC_OneToOne 1 100 0.00 65535.00 ECU_ADDRESS 0xD0008C0A /end MEASUREMENT
/begin MEASUREMENT DFC_st.DFC_SIA_E2sig "DFC/Status der Fehlerprüfung DFC_SIA_E2sig" UWORD DFC_OneToOne 1 100 0.00 65535.00 ECU_ADDRESS 0xD0008C0C /end MEASUREMENT
/begin MEASUREMENT DFC_st.DFC_SIA_E3max "DFC/Status der Fehlerprüfung DFC_SIA_E3max" UWORD DFC_OneToOne 1 100 0.00 65535.00 ECU_ADDRESS 0xD0008C0E /end MEASUREMENT
/begin MEASUREMENT DFC_st.DFC_SIA_E3min "DFC/Status der Fehlerprüfung DFC_SIA_E3min" UWORD DFC_OneToOne 1 100 0.00 65535.00 ECU_ADDRESS 0xD0008C10 /end MEASUREMENT
/begin MEASUREMENT DFC_st.DFC_SIA_E3npl "DFC/Status der Fehlerprüfung DFC_SIA_E3npl" UWORD DFC_OneToOne 1 100 0.00 65535.00 ECU_ADDRESS 0xD0008C12 /end MEASUREMENT
/begin MEASUREMENT DFC_st.DFC_SIA_E3sig "DFC/Status der Fehlerprüfung DFC_SIA_E3sig" UWORD DFC_OneToOne 1 100 0.00 65535.00 ECU_ADDRESS 0xD0008C14 /end MEASUREMENT
/begin MEASUREMENT DFC_st.DFC_SIA_E4max "DFC/Status der Fehlerprüfung DFC_SIA_E4max" UWORD DFC_OneToOne 1 100 0.00 65535.00 ECU_ADDRESS 0xD0008C16 /end MEASUREMENT
/begin MEASUREMENT DFC_st.DFC_SIA_E4min "DFC/Status der Fehlerprüfung DFC_SIA_E4min" UWORD DFC_OneToOne 1 100 0.00 65535.00 ECU_ADDRESS 0xD0008C18 /end MEASUREMENT
/begin MEASUREMENT DFC_st.DFC_SIA_E4npl "DFC/Status der Fehlerprüfung DFC_SIA_E4npl" UWORD DFC_OneToOne 1 100 0.00 65535.00 ECU_ADDRESS 0xD0008C1A /end MEASUREMENT
/begin MEASUREMENT DFC_st.DFC_SIA_E4sig "DFC/Status der Fehlerprüfung DFC_SIA_E4sig" UWORD DFC_OneToOne 1 100 0.00 65535.00 ECU_ADDRESS 0xD0008C1C /end MEASUREMENT
/begin MEASUREMENT DFC_st.DFC_SWReset_0 "DFC/Status der Fehlerprüfung DFC_SWReset_0" UWORD DFC_OneToOne 1 100 0.00 65535.00 ECU_ADDRESS 0xD0008C1E /end MEASUREMENT
/begin MEASUREMENT DFC_st.DFC_SWReset_1 "DFC/Status der Fehlerprüfung DFC_SWReset_1" UWORD DFC_OneToOne 1 100 0.00 65535.00 ECU_ADDRESS 0xD0008C20 /end MEASUREMENT
/begin MEASUREMENT DFC_st.DFC_SWReset_2 "DFC/Status der Fehlerprüfung DFC_SWReset_2" UWORD DFC_OneToOne 1 100 0.00 65535.00 ECU_ADDRESS 0xD0008C22 /end MEASUREMENT
/begin MEASUREMENT DFC_st.DFC_ShtrAKKMax "DFC/Status der Fehlerprüfung DFC_ShtrAKKMax" UWORD DFC_OneToOne 1 100 0.00 65535.00 ECU_ADDRESS 0xD0008C24 /end MEASUREMENT
/begin MEASUREMENT DFC_st.DFC_ShtrAKKMin "DFC/Status der Fehlerprüfung DFC_ShtrAKKMin" UWORD DFC_OneToOne 1 100 0.00 65535.00 ECU_ADDRESS 0xD0008C26 /end MEASUREMENT
/begin MEASUREMENT DFC_st.DFC_ShtrAKKNpl "DFC/Status der Fehlerprüfung DFC_ShtrAKKNpl" UWORD DFC_OneToOne 1 100 0.00 65535.00 ECU_ADDRESS 0xD0008C28 /end MEASUREMENT
/begin MEASUREMENT DFC_st.DFC_ShtrPKKMax "DFC/Status der Fehlerprüfung DFC_ShtrPKKMax" UWORD DFC_OneToOne 1 100 0.00 65535.00 ECU_ADDRESS 0xD0008C2A /end MEASUREMENT
/begin MEASUREMENT DFC_st.DFC_StopCntTmr "DFC/Status der Fehlerprüfung DFC_StopCntTmr" UWORD DFC_OneToOne 1 100 0.00 65535.00 ECU_ADDRESS 0xD0008C2C /end MEASUREMENT
/begin MEASUREMENT DFC_st.DFC_ThrVlvMon "DFC/Status der Fehlerprüfung DFC_ThrVlvMon" UWORD DFC_OneToOne 1 100 0.00 65535.00 ECU_ADDRESS 0xD0008C2E /end MEASUREMENT
/begin MEASUREMENT DFC_st.DFC_VSwVlvJamVlv "DFC/Status der Fehlerprüfung DFC_VSwVlvJamVlv" UWORD DFC_OneToOne 1 100 0.00 65535.00 ECU_ADDRESS 0xD0008C30 /end MEASUREMENT
/begin MEASUREMENT DFC_st.DFC_VSwVlvLgTDrft "DFC/Status der Fehlerprüfung DFC_VSwVlvLgTDrft" UWORD DFC_OneToOne 1 100 0.00 65535.00 ECU_ADDRESS 0xD0008C32 /end MEASUREMENT
/begin MEASUREMENT DFC_st.DFC_VSwVlvOfsLrnJamVlv "DFC/Status der Fehlerprüfung DFC_VSwVlvOfsLrnJamVlv" UWORD DFC_OneToOne 1 100 0.00 65535.00 ECU_ADDRESS 0xD0008C34 /end MEASUREMENT
/begin MEASUREMENT DFC_st.DFC_VSwVlvOfsNeutr "DFC/Status der Fehlerprüfung DFC_VSwVlvOfsNeutr" UWORD DFC_OneToOne 1 100 0.00 65535.00 ECU_ADDRESS 0xD0008C36 /end MEASUREMENT
/begin MEASUREMENT DFC_st.DFC_VSwVlvShTDrft "DFC/Status der Fehlerprüfung DFC_VSwVlvShTDrft" UWORD DFC_OneToOne 1 100 0.00 65535.00 ECU_ADDRESS 0xD0008C38 /end MEASUREMENT
/begin MEASUREMENT DFC_st.DFC_VSwVlvSpgDef "DFC/Status der Fehlerprüfung DFC_VSwVlvSpgDef" UWORD DFC_OneToOne 1 100 0.00 65535.00 ECU_ADDRESS 0xD0008C3A /end MEASUREMENT
/begin MEASUREMENT DFC_stClctFault_mp "gesammelte Fehlerzustände aller Fehlerpruefungen" UWORD DFC_OneToOne 1 100 0.00 65535.00 ARRAY_SIZE 61 ECU_ADDRESS 0xC000B980 /end MEASUREMENT
/begin MEASUREMENT DFC_stClctTst_mp "gesammelte getestet Infomationen aller Fehlerpruefungen" UWORD DFC_OneToOne 1 100 0.00 65535.00 ARRAY_SIZE 61 ECU_ADDRESS 0xC000B9FA /end MEASUREMENT
/begin MEASUREMENT DSQ_st.DSQ_AFS "DSQ/Status der Signal Qualität DSQ_AFS" UBYTE DFC_OneToOne 1 100 0.00 255.0 ECU_ADDRESS 0xD0003C20 /end MEASUREMENT
/begin MEASUREMENT DSQ_st.DSQ_AFS_SSpShOffActr "DSQ/Status der Signal Qualität DSQ_AFS_SSpShOffActr" UBYTE DFC_OneToOne 1 100 0.00 255.0 ECU_ADDRESS 0xD0003C21 /end MEASUREMENT
/begin MEASUREMENT DSQ_st.DSQ_AirCCmprActr "DSQ/Status der Signal Qualität DSQ_AirCCmprActr" UBYTE DFC_OneToOne 1 100 0.00 255.0 ECU_ADDRESS 0xD0003C22 /end MEASUREMENT
/begin MEASUREMENT DSQ_st.DSQ_BattU "DSQ/Status der Signal Qualität DSQ_BattU" UBYTE DFC_OneToOne 1 100 0.00 255.0 ECU_ADDRESS 0xD0003C23 /end MEASUREMENT
/begin MEASUREMENT DSQ_st.DSQ_BrkP "DSQ/Status der Signal Qualität DSQ_BrkP" UBYTE DFC_OneToOne 1 100 0.00 255.0 ECU_ADDRESS 0xD0003C24 /end MEASUREMENT
/begin MEASUREMENT DSQ_st.DSQ_CByVlvActr "DSQ/Status der Signal Qualität DSQ_CByVlvActr" UBYTE DFC_OneToOne 1 100 0.00 255.0 ECU_ADDRESS 0xD0003C25 /end MEASUREMENT
/begin MEASUREMENT DSQ_st.DSQ_CEngDsT "DSQ/Status der Signal Qualität DSQ_CEngDsT" UBYTE DFC_OneToOne 1 100 0.00 255.0 ECU_ADDRESS 0xD0003C26 /end MEASUREMENT
/begin MEASUREMENT DSQ_st.DSQ_CThmstActr "DSQ/Status der Signal Qualität DSQ_CThmstActr" UBYTE DFC_OneToOne 1 100 0.00 255.0 ECU_ADDRESS 0xD0003C27 /end MEASUREMENT
/begin MEASUREMENT DSQ_st.DSQ_Com_aDirect "DSQ/Status der Signal Qualität DSQ_Com_aDirect" UBYTE DFC_OneToOne 1 100 0.00 255.0 ECU_ADDRESS 0xD0003C28 /end MEASUREMENT
/begin MEASUREMENT DSQ_st.DSQ_Com_aSide "DSQ/Status der Signal Qualität DSQ_Com_aSide" UBYTE DFC_OneToOne 1 100 0.00 255.0 ECU_ADDRESS 0xD0003C29 /end MEASUREMENT
/begin MEASUREMENT DSQ_st.DSQ_Com_ctrDay "DSQ/Status der Signal Qualität DSQ_Com_ctrDay" UBYTE DFC_OneToOne 1 100 0.00 255.0 ECU_ADDRESS 0xD0003C2A /end MEASUREMENT
/begin MEASUREMENT DSQ_st.DSQ_Com_ctrSec "DSQ/Status der Signal Qualität DSQ_Com_ctrSec" UBYTE DFC_OneToOne 1 100 0.00 255.0 ECU_ADDRESS 0xD0003C2B /end MEASUREMENT
/begin MEASUREMENT DSQ_st.DSQ_Com_ctrSecAbs "DSQ/Status der Signal Qualität DSQ_Com_ctrSecAbs" UBYTE DFC_OneToOne 1 100 0.00 255.0 ECU_ADDRESS 0xD0003C2C /end MEASUREMENT
/begin MEASUREMENT DSQ_st.DSQ_Com_dDay "DSQ/Status der Signal Qualität DSQ_Com_dDay" UBYTE DFC_OneToOne 1 100 0.00 255.0 ECU_ADDRESS 0xD0003C2D /end MEASUREMENT
/begin MEASUREMENT DSQ_st.DSQ_Com_dMonth "DSQ/Status der Signal Qualität DSQ_Com_dMonth" UBYTE DFC_OneToOne 1 100 0.00 255.0 ECU_ADDRESS 0xD0003C2E /end MEASUREMENT
/begin MEASUREMENT DSQ_st.DSQ_Com_dYear "DSQ/Status der Signal Qualität DSQ_Com_dYear" UBYTE DFC_OneToOne 1 100 0.00 255.0 ECU_ADDRESS 0xD0003C2F /end MEASUREMENT
/begin MEASUREMENT DSQ_st.DSQ_Com_dphiStWhlAg "DSQ/Status der Signal Qualität DSQ_Com_dphiStWhlAg" UBYTE DFC_OneToOne 1 100 0.00 255.0 ECU_ADDRESS 0xD0003C30 /end MEASUREMENT
/begin MEASUREMENT DSQ_st.DSQ_Com_dvolPspDes "DSQ/Status der Signal Qualität DSQ_Com_dvolPspDes" UBYTE DFC_OneToOne 1 100 0.00 255.0 ECU_ADDRESS 0xD0003C31 /end MEASUREMENT
/begin MEASUREMENT DSQ_st.DSQ_Com_iHiLimCurr "DSQ/Status der Signal Qualität DSQ_Com_iHiLimCurr" UBYTE DFC_OneToOne 1 100 0.00 255.0 ECU_ADDRESS 0xD0003C32 /end MEASUREMENT
/begin MEASUREMENT DSQ_st.DSQ_Com_iLoLimCurr "DSQ/Status der Signal Qualität DSQ_Com_iLoLimCurr" UBYTE DFC_OneToOne 1 100 0.00 255.0 ECU_ADDRESS 0xD0003C33 /end MEASUREMENT
/begin MEASUREMENT DSQ_st.DSQ_Com_iPsp "DSQ/Status der Signal Qualität DSQ_Com_iPsp" UBYTE DFC_OneToOne 1 100 0.00 255.0 ECU_ADDRESS 0xD0003C34 /end MEASUREMENT
/begin MEASUREMENT DSQ_st.DSQ_Com_iZrLimCurr "DSQ/Status der Signal Qualität DSQ_Com_iZrLimCurr" UBYTE DFC_OneToOne 1 100 0.00 255.0 ECU_ADDRESS 0xD0003C35 /end MEASUREMENT
/begin MEASUREMENT DSQ_st.DSQ_Com_idParkConsumer "DSQ/Status der Signal Qualität DSQ_Com_idParkConsumer" UBYTE DFC_OneToOne 1 100 0.00 255.0 ECU_ADDRESS 0xD0003C36 /end MEASUREMENT
/begin MEASUREMENT DSQ_st.DSQ_Com_idVerbraucher "DSQ/Status der Signal Qualität DSQ_Com_idVerbraucher" UBYTE DFC_OneToOne 1 100 0.00 255.0 ECU_ADDRESS 0xD0003C37 /end MEASUREMENT
/begin MEASUREMENT DSQ_st.DSQ_Com_lFlTnkQntLow "DSQ/Status der Signal Qualität DSQ_Com_lFlTnkQntLow" UBYTE DFC_OneToOne 1 100 0.00 255.0 ECU_ADDRESS 0xD0003C38 /end MEASUREMENT
/begin MEASUREMENT DSQ_st.DSQ_Com_lSum "DSQ/Status der Signal Qualität DSQ_Com_lSum" UBYTE DFC_OneToOne 1 100 0.00 255.0 ECU_ADDRESS 0xD0003C39 /end MEASUREMENT
/begin MEASUREMENT DSQ_st.DSQ_Com_nDKG "DSQ/Status der Signal Qualität DSQ_Com_nDKG" UBYTE DFC_OneToOne 1 100 0.00 255.0 ECU_ADDRESS 0xD0003C3A /end MEASUREMENT
/begin MEASUREMENT DSQ_st.DSQ_Com_nGbxOut "DSQ/Status der Signal Qualität DSQ_Com_nGbxOut" UBYTE DFC_OneToOne 1 100 0.00 255.0 ECU_ADDRESS 0xD0003C3B /end MEASUREMENT
/begin MEASUREMENT DSQ_st.DSQ_Com_nPsp "DSQ/Status der Signal Qualität DSQ_Com_nPsp" UBYTE DFC_OneToOne 1 100 0.00 255.0 ECU_ADDRESS 0xD0003C3C /end MEASUREMENT
/begin MEASUREMENT DSQ_st.DSQ_Com_nRqIdlg "DSQ/Status der Signal Qualität DSQ_Com_nRqIdlg" UBYTE DFC_OneToOne 1 100 0.00 255.0 ECU_ADDRESS 0xD0003C3D /end MEASUREMENT
/begin MEASUREMENT DSQ_st.DSQ_Com_nTSC "DSQ/Status der Signal Qualität DSQ_Com_nTSC" UBYTE DFC_OneToOne 1 100 0.00 255.0 ECU_ADDRESS 0xD0003C3E /end MEASUREMENT
/begin MEASUREMENT DSQ_st.DSQ_Com_nWhl "" UBYTE DFC_OneToOne 1 100 0.00 255.0 ECU_ADDRESS 0xD0003C3F /end MEASUREMENT
/begin MEASUREMENT DSQ_st.DSQ_Com_nWhlFL "DSQ/Status der Signal Qualität DSQ_Com_nWhlFL" UBYTE DFC_OneToOne 1 100 0.00 255.0 ECU_ADDRESS 0xD0003C40 /end MEASUREMENT
/begin MEASUREMENT DSQ_st.DSQ_Com_nWhlFR "DSQ/Status der Signal Qualität DSQ_Com_nWhlFR" UBYTE DFC_OneToOne 1 100 0.00 255.0 ECU_ADDRESS 0xD0003C41 /end MEASUREMENT
/begin MEASUREMENT DSQ_st.DSQ_Com_nWhlRL "DSQ/Status der Signal Qualität DSQ_Com_nWhlRL" UBYTE DFC_OneToOne 1 100 0.00 255.0 ECU_ADDRESS 0xD0003C42 /end MEASUREMENT
/begin MEASUREMENT DSQ_st.DSQ_Com_nWhlRR "DSQ/Status der Signal Qualität DSQ_Com_nWhlRR" UBYTE DFC_OneToOne 1 100 0.00 255.0 ECU_ADDRESS 0xD0003C43 /end MEASUREMENT
/begin MEASUREMENT DSQ_st.DSQ_Com_pBrkSys "DSQ/Status der Signal Qualität DSQ_Com_pBrkSys" UBYTE DFC_OneToOne 1 100 0.00 255.0 ECU_ADDRESS 0xD0003C44 /end MEASUREMENT
/begin MEASUREMENT DSQ_st.DSQ_Com_phiStWhlAg "DSQ/Status der Signal Qualität DSQ_Com_phiStWhlAg" UBYTE DFC_OneToOne 1 100 0.00 255.0 ECU_ADDRESS 0xD0003C45 /end MEASUREMENT
/begin MEASUREMENT DSQ_st.DSQ_Com_rACFanDem "DSQ/Status der Signal Qualität DSQ_Com_rACFanDem" UBYTE DFC_OneToOne 1 100 0.00 255.0 ECU_ADDRESS 0xD0003C46 /end MEASUREMENT
/begin MEASUREMENT DSQ_st.DSQ_Com_rHtFlowReq "DSQ/Status der Signal Qualität DSQ_Com_rHtFlowReq" UBYTE DFC_OneToOne 1 100 0.00 255.0 ECU_ADDRESS 0xD0003C47 /end MEASUREMENT
/begin MEASUREMENT DSQ_st.DSQ_Com_rLamLinRecGndRaw "DSQ/Status der Signal Qualität DSQ_Com_rLamLinRecGndRaw" UBYTE DFC_OneToOne 1 100 0.00 255.0 ECU_ADDRESS 0xD0003C48 /end MEASUREMENT
/begin MEASUREMENT DSQ_st.DSQ_Com_rLamLinRecUbattRaw "DSQ/Status der Signal Qualität DSQ_Com_rLamLinRecUbattRaw" UBYTE DFC_OneToOne 1 100 0.00 255.0 ECU_ADDRESS 0xD0003C49 /end MEASUREMENT
/begin MEASUREMENT DSQ_st.DSQ_Com_rNOxCat2DsGndRaw "DSQ/Status der Signal Qualität DSQ_Com_rNOxCat2DsGndRaw" UBYTE DFC_OneToOne 1 100 0.00 255.0 ECU_ADDRESS 0xD0003C4A /end MEASUREMENT
/begin MEASUREMENT DSQ_st.DSQ_Com_rNOxCat2DsUbattRaw "DSQ/Status der Signal Qualität DSQ_Com_rNOxCat2DsUbattRaw" UBYTE DFC_OneToOne 1 100 0.00 255.0 ECU_ADDRESS 0xD0003C4B /end MEASUREMENT
/begin MEASUREMENT DSQ_st.DSQ_Com_rPspSetPoint "DSQ/Status der Signal Qualität DSQ_Com_rPspSetPoint" UBYTE DFC_OneToOne 1 100 0.00 255.0 ECU_ADDRESS 0xD0003C4C /end MEASUREMENT
/begin MEASUREMENT DSQ_st.DSQ_Com_rPwrSpCons "DSQ/Status der Signal Qualität DSQ_Com_rPwrSpCons" UBYTE DFC_OneToOne 1 100 0.00 255.0 ECU_ADDRESS 0xD0003C4D /end MEASUREMENT
/begin MEASUREMENT DSQ_st.DSQ_Com_rTrq "DSQ/Status der Signal Qualität DSQ_Com_rTrq" UBYTE DFC_OneToOne 1 100 0.00 255.0 ECU_ADDRESS 0xD0003C4E /end MEASUREMENT
/begin MEASUREMENT DSQ_st.DSQ_Com_stAC "DSQ/Status der Signal Qualität DSQ_Com_stAC" UBYTE DFC_OneToOne 1 100 0.00 255.0 ECU_ADDRESS 0xD0003C4F /end MEASUREMENT
/begin MEASUREMENT DSQ_st.DSQ_Com_stACEFan "DSQ/Status der Signal Qualität DSQ_Com_stACEFan" UBYTE DFC_OneToOne 1 100 0.00 255.0 ECU_ADDRESS 0xD0003C50 /end MEASUREMENT
/begin MEASUREMENT DSQ_st.DSQ_Com_stARS "DSQ/Status der Signal Qualität DSQ_Com_stARS" UBYTE DFC_OneToOne 1 100 0.00 255.0 ECU_ADDRESS 0xD0003C51 /end MEASUREMENT
/begin MEASUREMENT DSQ_st.DSQ_Com_stAcpd "DSQ/Status der Signal Qualität DSQ_Com_stAcpd" UBYTE DFC_OneToOne 1 100 0.00 255.0 ECU_ADDRESS 0xD0003C52 /end MEASUREMENT
/begin MEASUREMENT DSQ_st.DSQ_Com_stBattClass "DSQ/Status der Signal Qualität DSQ_Com_stBattClass" UBYTE DFC_OneToOne 1 100 0.00 255.0 ECU_ADDRESS 0xD0003C53 /end MEASUREMENT
/begin MEASUREMENT DSQ_st.DSQ_Com_stBonnet "DSQ/Status der Signal Qualität DSQ_Com_stBonnet" UBYTE DFC_OneToOne 1 100 0.00 255.0 ECU_ADDRESS 0xD0003C54 /end MEASUREMENT
/begin MEASUREMENT DSQ_st.DSQ_Com_stBrkTrqDVCHQl "DSQ/Status der Signal Qualität DSQ_Com_stBrkTrqDVCHQl" UBYTE DFC_OneToOne 1 100 0.00 255.0 ECU_ADDRESS 0xD0003C55 /end MEASUREMENT
/begin MEASUREMENT DSQ_st.DSQ_Com_stButtonMSA "DSQ/Status der Signal Qualität DSQ_Com_stButtonMSA" UBYTE DFC_OneToOne 1 100 0.00 255.0 ECU_ADDRESS 0xD0003C56 /end MEASUREMENT
/begin MEASUREMENT DSQ_st.DSQ_Com_stCat2DsGndRaw "DSQ/Status der Signal Qualität DSQ_Com_stCat2DsGndRaw" UBYTE DFC_OneToOne 1 100 0.00 255.0 ECU_ADDRESS 0xD0003C57 /end MEASUREMENT
/begin MEASUREMENT DSQ_st.DSQ_Com_stCat2DsUbattRaw "DSQ/Status der Signal Qualität DSQ_Com_stCat2DsUbattRaw" UBYTE DFC_OneToOne 1 100 0.00 255.0 ECU_ADDRESS 0xD0003C58 /end MEASUREMENT
/begin MEASUREMENT DSQ_st.DSQ_Com_stClCtr "DSQ/Status der Signal Qualität DSQ_Com_stClCtr" UBYTE DFC_OneToOne 1 100 0.00 255.0 ECU_ADDRESS 0xD0003C59 /end MEASUREMENT
/begin MEASUREMENT DSQ_st.DSQ_Com_stClassPwr "DSQ/Status der Signal Qualität DSQ_Com_stClassPwr" UBYTE DFC_OneToOne 1 100 0.00 255.0 ECU_ADDRESS 0xD0003C5A /end MEASUREMENT
/begin MEASUREMENT DSQ_st.DSQ_Com_stClth "DSQ/Status der Signal Qualität DSQ_Com_stClth" UBYTE DFC_OneToOne 1 100 0.00 255.0 ECU_ADDRESS 0xD0003C5B /end MEASUREMENT
/begin MEASUREMENT DSQ_st.DSQ_Com_stClthOpen "DSQ/Status der Signal Qualität DSQ_Com_stClthOpen" UBYTE DFC_OneToOne 1 100 0.00 255.0 ECU_ADDRESS 0xD0003C5C /end MEASUREMENT
/begin MEASUREMENT DSQ_st.DSQ_Com_stClthRaw "DSQ/Status der Signal Qualität DSQ_Com_stClthRaw" UBYTE DFC_OneToOne 1 100 0.00 255.0 ECU_ADDRESS 0xD0003C5D /end MEASUREMENT
/begin MEASUREMENT DSQ_st.DSQ_Com_stCrCtlKombi "DSQ/Status der Signal Qualität DSQ_Com_stCrCtlKombi" UBYTE DFC_OneToOne 1 100 0.00 255.0 ECU_ADDRESS 0xD0003C5E /end MEASUREMENT
/begin MEASUREMENT DSQ_st.DSQ_Com_stCrCtlLvr "DSQ/Status der Signal Qualität DSQ_Com_stCrCtlLvr" UBYTE DFC_OneToOne 1 100 0.00 255.0 ECU_ADDRESS 0xD0003C5F /end MEASUREMENT
/begin MEASUREMENT DSQ_st.DSQ_Com_stDSC "DSQ/Status der Signal Qualität DSQ_Com_stDSC" UBYTE DFC_OneToOne 1 100 0.00 255.0 ECU_ADDRESS 0xD0003C60 /end MEASUREMENT
/begin MEASUREMENT DSQ_st.DSQ_Com_stDecellDSC "DSQ/Status der Signal Qualität DSQ_Com_stDecellDSC" UBYTE DFC_OneToOne 1 100 0.00 255.0 ECU_ADDRESS 0xD0003C61 /end MEASUREMENT
/begin MEASUREMENT DSQ_st.DSQ_Com_stDiagPsp "DSQ/Status der Signal Qualität DSQ_Com_stDiagPsp" UBYTE DFC_OneToOne 1 100 0.00 255.0 ECU_ADDRESS 0xD0003C62 /end MEASUREMENT
/begin MEASUREMENT DSQ_st.DSQ_Com_stDoorDriver "DSQ/Status der Signal Qualität DSQ_Com_stDoorDriver" UBYTE DFC_OneToOne 1 100 0.00 255.0 ECU_ADDRESS 0xD0003C63 /end MEASUREMENT
/begin MEASUREMENT DSQ_st.DSQ_Com_stDrWghSeat "DSQ/Status der Signal Qualität DSQ_Com_stDrWghSeat" UBYTE DFC_OneToOne 1 100 0.00 255.0 ECU_ADDRESS 0xD0003C64 /end MEASUREMENT
/begin MEASUREMENT DSQ_st.DSQ_Com_stDrvAssist "DSQ/Status der Signal Qualität DSQ_Com_stDrvAssist" UBYTE DFC_OneToOne 1 100 0.00 255.0 ECU_ADDRESS 0xD0003C65 /end MEASUREMENT
/begin MEASUREMENT DSQ_st.DSQ_Com_stDrvDyn "DSQ/Status der Signal Qualität DSQ_Com_stDrvDyn" UBYTE DFC_OneToOne 1 100 0.00 255.0 ECU_ADDRESS 0xD0003C66 /end MEASUREMENT
/begin MEASUREMENT DSQ_st.DSQ_Com_stDrvPrgQl "DSQ/Status der Signal Qualität DSQ_Com_stDrvPrgQl" UBYTE DFC_OneToOne 1 100 0.00 255.0 ECU_ADDRESS 0xD0003C67 /end MEASUREMENT
/begin MEASUREMENT DSQ_st.DSQ_Com_stDynDisp "DSQ/Status der Signal Qualität DSQ_Com_stDynDisp" UBYTE DFC_OneToOne 1 100 0.00 255.0 ECU_ADDRESS 0xD0003C68 /end MEASUREMENT
/begin MEASUREMENT DSQ_st.DSQ_Com_stEngStop "DSQ/Status der Signal Qualität DSQ_Com_stEngStop" UBYTE DFC_OneToOne 1 100 0.00 255.0 ECU_ADDRESS 0xD0003C69 /end MEASUREMENT
/begin MEASUREMENT DSQ_st.DSQ_Com_stErrAFS "DSQ/Status der Signal Qualität DSQ_Com_stErrAFS" UBYTE DFC_OneToOne 1 100 0.00 255.0 ECU_ADDRESS 0xD0003C6A /end MEASUREMENT
/begin MEASUREMENT DSQ_st.DSQ_Com_stErrStrg "DSQ/Status der Signal Qualität DSQ_Com_stErrStrg" UBYTE DFC_OneToOne 1 100 0.00 255.0 ECU_ADDRESS 0xD0003C6B /end MEASUREMENT
/begin MEASUREMENT DSQ_st.DSQ_Com_stFlTnkQntRes "DSQ/Status der Signal Qualität DSQ_Com_stFlTnkQntRes" UBYTE DFC_OneToOne 1 100 0.00 255.0 ECU_ADDRESS 0xD0003C6C /end MEASUREMENT
/begin MEASUREMENT DSQ_st.DSQ_Com_stFolDyn "DSQ/Status der Signal Qualität DSQ_Com_stFolDyn" UBYTE DFC_OneToOne 1 100 0.00 255.0 ECU_ADDRESS 0xD0003C6D /end MEASUREMENT
/begin MEASUREMENT DSQ_st.DSQ_Com_stGbxOBD "DSQ/Status der Signal Qualität DSQ_Com_stGbxOBD" UBYTE DFC_OneToOne 1 100 0.00 255.0 ECU_ADDRESS 0xD0003C6E /end MEASUREMENT
/begin MEASUREMENT DSQ_st.DSQ_Com_stGear "DSQ/Status der Signal Qualität DSQ_Com_stGear" UBYTE DFC_OneToOne 1 100 0.00 255.0 ECU_ADDRESS 0xD0003C6F /end MEASUREMENT
/begin MEASUREMENT DSQ_st.DSQ_Com_stGearBck "DSQ/Status der Signal Qualität DSQ_Com_stGearBck" UBYTE DFC_OneToOne 1 100 0.00 255.0 ECU_ADDRESS 0xD0003C70 /end MEASUREMENT
/begin MEASUREMENT DSQ_st.DSQ_Com_stHDC "DSQ/Status der Signal Qualität DSQ_Com_stHDC" UBYTE DFC_OneToOne 1 100 0.00 255.0 ECU_ADDRESS 0xD0003C71 /end MEASUREMENT
/begin MEASUREMENT DSQ_st.DSQ_Com_stKeyVld "DSQ/Status der Signal Qualität DSQ_Com_stKeyVld" UBYTE DFC_OneToOne 1 100 0.00 255.0 ECU_ADDRESS 0xD0003C72 /end MEASUREMENT
/begin MEASUREMENT DSQ_st.DSQ_Com_stLckGbxDemQl "DSQ/Status der Signal Qualität DSQ_Com_stLckGbxDemQl" UBYTE DFC_OneToOne 1 100 0.00 255.0 ECU_ADDRESS 0xD0003C73 /end MEASUREMENT
/begin MEASUREMENT DSQ_st.DSQ_Com_stLmpPrkBrk "DSQ/Status der Signal Qualität DSQ_Com_stLmpPrkBrk" UBYTE DFC_OneToOne 1 100 0.00 255.0 ECU_ADDRESS 0xD0003C74 /end MEASUREMENT
/begin MEASUREMENT DSQ_st.DSQ_Com_stMSALmp "DSQ/Status der Signal Qualität DSQ_Com_stMSALmp" UBYTE DFC_OneToOne 1 100 0.00 255.0 ECU_ADDRESS 0xD0003C75 /end MEASUREMENT
/begin MEASUREMENT DSQ_st.DSQ_Com_stModDKG "DSQ/Status der Signal Qualität DSQ_Com_stModDKG" UBYTE DFC_OneToOne 1 100 0.00 255.0 ECU_ADDRESS 0xD0003C76 /end MEASUREMENT
/begin MEASUREMENT DSQ_st.DSQ_Com_stNOxErrGndRaw "DSQ/Status der Signal Qualität DSQ_Com_stNOxErrGndRaw" UBYTE DFC_OneToOne 1 100 0.00 255.0 ECU_ADDRESS 0xD0003C77 /end MEASUREMENT
/begin MEASUREMENT DSQ_st.DSQ_Com_stNOxErrUbattRaw "DSQ/Status der Signal Qualität DSQ_Com_stNOxErrUbattRaw" UBYTE DFC_OneToOne 1 100 0.00 255.0 ECU_ADDRESS 0xD0003C78 /end MEASUREMENT
/begin MEASUREMENT DSQ_st.DSQ_Com_stPBrComf "DSQ/Status der Signal Qualität DSQ_Com_stPBrComf" UBYTE DFC_OneToOne 1 100 0.00 255.0 ECU_ADDRESS 0xD0003C79 /end MEASUREMENT
/begin MEASUREMENT DSQ_st.DSQ_Com_stPBrHold "DSQ/Status der Signal Qualität DSQ_Com_stPBrHold" UBYTE DFC_OneToOne 1 100 0.00 255.0 ECU_ADDRESS 0xD0003C7A /end MEASUREMENT
/begin MEASUREMENT DSQ_st.DSQ_Com_stPBrHyd "DSQ/Status der Signal Qualität DSQ_Com_stPBrHyd" UBYTE DFC_OneToOne 1 100 0.00 255.0 ECU_ADDRESS 0xD0003C7B /end MEASUREMENT
/begin MEASUREMENT DSQ_st.DSQ_Com_stPBrkSysQl "DSQ/Status der Signal Qualität DSQ_Com_stPBrkSysQl" UBYTE DFC_OneToOne 1 100 0.00 255.0 ECU_ADDRESS 0xD0003C7C /end MEASUREMENT
/begin MEASUREMENT DSQ_st.DSQ_Com_stPHtr "DSQ/Status der Signal Qualität DSQ_Com_stPHtr" UBYTE DFC_OneToOne 1 100 0.00 255.0 ECU_ADDRESS 0xD0003C7D /end MEASUREMENT
/begin MEASUREMENT DSQ_st.DSQ_Com_stParkConsumer "DSQ/Status der Signal Qualität DSQ_Com_stParkConsumer" UBYTE DFC_OneToOne 1 100 0.00 255.0 ECU_ADDRESS 0xD0003C7E /end MEASUREMENT
/begin MEASUREMENT DSQ_st.DSQ_Com_stPsp "DSQ/Status der Signal Qualität DSQ_Com_stPsp" UBYTE DFC_OneToOne 1 100 0.00 255.0 ECU_ADDRESS 0xD0003C7F /end MEASUREMENT
/begin MEASUREMENT DSQ_st.DSQ_Com_stPspCntr "DSQ/Status der Signal Qualität DSQ_Com_stPspCntr" UBYTE DFC_OneToOne 1 100 0.00 255.0 ECU_ADDRESS 0xD0003C80 /end MEASUREMENT
/begin MEASUREMENT DSQ_st.DSQ_Com_stRaceStrt "DSQ/Status der Signal Qualität DSQ_Com_stRaceStrt" UBYTE DFC_OneToOne 1 100 0.00 255.0 ECU_ADDRESS 0xD0003C81 /end MEASUREMENT
/begin MEASUREMENT DSQ_st.DSQ_Com_stReqMSA "DSQ/Status der Signal Qualität DSQ_Com_stReqMSA" UBYTE DFC_OneToOne 1 100 0.00 255.0 ECU_ADDRESS 0xD0003C82 /end MEASUREMENT
/begin MEASUREMENT DSQ_st.DSQ_Com_stRevGear "DSQ/Status der Signal Qualität DSQ_Com_stRevGear" UBYTE DFC_OneToOne 1 100 0.00 255.0 ECU_ADDRESS 0xD0003C83 /end MEASUREMENT
/begin MEASUREMENT DSQ_st.DSQ_Com_stSTEQl "DSQ/Status der Signal Qualität DSQ_Com_stSTEQl" UBYTE DFC_OneToOne 1 100 0.00 255.0 ECU_ADDRESS 0xD0003C84 /end MEASUREMENT
/begin MEASUREMENT DSQ_st.DSQ_Com_stSeason "DSQ/Status der Signal Qualität DSQ_Com_stSeason" UBYTE DFC_OneToOne 1 100 0.00 255.0 ECU_ADDRESS 0xD0003C85 /end MEASUREMENT
/begin MEASUREMENT DSQ_st.DSQ_Com_stShftIdctrDemRglX "DSQ/Status der Signal Qualität DSQ_Com_stShftIdctrDemRglX" UBYTE DFC_OneToOne 1 100 0.00 255.0 ECU_ADDRESS 0xD0003C86 /end MEASUREMENT
/begin MEASUREMENT DSQ_st.DSQ_Com_stShiftPdl "DSQ/Status der Signal Qualität DSQ_Com_stShiftPdl" UBYTE DFC_OneToOne 1 100 0.00 255.0 ECU_ADDRESS 0xD0003C87 /end MEASUREMENT
/begin MEASUREMENT DSQ_st.DSQ_Com_stShutOffPSP "DSQ/Status der Signal Qualität DSQ_Com_stShutOffPSP" UBYTE DFC_OneToOne 1 100 0.00 255.0 ECU_ADDRESS 0xD0003C88 /end MEASUREMENT
/begin MEASUREMENT DSQ_st.DSQ_Com_stSleepBus "DSQ/Status der Signal Qualität DSQ_Com_stSleepBus" UBYTE DFC_OneToOne 1 100 0.00 255.0 ECU_ADDRESS 0xD0003C89 /end MEASUREMENT
/begin MEASUREMENT DSQ_st.DSQ_Com_stSleepConst "DSQ/Status der Signal Qualität DSQ_Com_stSleepConst" UBYTE DFC_OneToOne 1 100 0.00 255.0 ECU_ADDRESS 0xD0003C8A /end MEASUREMENT
/begin MEASUREMENT DSQ_st.DSQ_Com_stSleepDest "DSQ/Status der Signal Qualität DSQ_Com_stSleepDest" UBYTE DFC_OneToOne 1 100 0.00 255.0 ECU_ADDRESS 0xD0003C8B /end MEASUREMENT
/begin MEASUREMENT DSQ_st.DSQ_Com_stSleepRdy "DSQ/Status der Signal Qualität DSQ_Com_stSleepRdy" UBYTE DFC_OneToOne 1 100 0.00 255.0 ECU_ADDRESS 0xD0003C8C /end MEASUREMENT
/begin MEASUREMENT DSQ_st.DSQ_Com_stStrg "DSQ/Status der Signal Qualität DSQ_Com_stStrg" UBYTE DFC_OneToOne 1 100 0.00 255.0 ECU_ADDRESS 0xD0003C8D /end MEASUREMENT
/begin MEASUREMENT DSQ_st.DSQ_Com_stStrtClth "DSQ/Status der Signal Qualität DSQ_Com_stStrtClth" UBYTE DFC_OneToOne 1 100 0.00 255.0 ECU_ADDRESS 0xD0003C8E /end MEASUREMENT
/begin MEASUREMENT DSQ_st.DSQ_Com_stStrtLck "DSQ/Status der Signal Qualität DSQ_Com_stStrtLck" UBYTE DFC_OneToOne 1 100 0.00 255.0 ECU_ADDRESS 0xD0003C8F /end MEASUREMENT
/begin MEASUREMENT DSQ_st.DSQ_Com_stT15 "DSQ/Status der Signal Qualität DSQ_Com_stT15" UBYTE DFC_OneToOne 1 100 0.00 255.0 ECU_ADDRESS 0xD0003C90 /end MEASUREMENT
/begin MEASUREMENT DSQ_st.DSQ_Com_stT15Hw "DSQ/Status der Signal Qualität DSQ_Com_stT15Hw" UBYTE DFC_OneToOne 1 100 0.00 255.0 ECU_ADDRESS 0xD0003C91 /end MEASUREMENT
/begin MEASUREMENT DSQ_st.DSQ_Com_stT50 "DSQ/Status der Signal Qualität DSQ_Com_stT50" UBYTE DFC_OneToOne 1 100 0.00 255.0 ECU_ADDRESS 0xD0003C92 /end MEASUREMENT
/begin MEASUREMENT DSQ_st.DSQ_Com_stTRadio "DSQ/Status der Signal Qualität DSQ_Com_stTRadio" UBYTE DFC_OneToOne 1 100 0.00 255.0 ECU_ADDRESS 0xD0003C93 /end MEASUREMENT
/begin MEASUREMENT DSQ_st.DSQ_Com_stTSC "DSQ/Status der Signal Qualität DSQ_Com_stTSC" UBYTE DFC_OneToOne 1 100 0.00 255.0 ECU_ADDRESS 0xD0003C94 /end MEASUREMENT
/begin MEASUREMENT DSQ_st.DSQ_Com_stTerminal "DSQ/Status der Signal Qualität DSQ_Com_stTerminal" UBYTE DFC_OneToOne 1 100 0.00 255.0 ECU_ADDRESS 0xD0003C95 /end MEASUREMENT
/begin MEASUREMENT DSQ_st.DSQ_Com_stTrailer "DSQ/Status der Signal Qualität DSQ_Com_stTrailer" UBYTE DFC_OneToOne 1 100 0.00 255.0 ECU_ADDRESS 0xD0003C96 /end MEASUREMENT
/begin MEASUREMENT DSQ_st.DSQ_Com_stTrqAFS "DSQ/Status der Signal Qualität DSQ_Com_stTrqAFS" UBYTE DFC_OneToOne 1 100 0.00 255.0 ECU_ADDRESS 0xD0003C97 /end MEASUREMENT
/begin MEASUREMENT DSQ_st.DSQ_Com_stTrqDSCDes "DSQ/Status der Signal Qualität DSQ_Com_stTrqDSCDes" UBYTE DFC_OneToOne 1 100 0.00 255.0 ECU_ADDRESS 0xD0003C98 /end MEASUREMENT
/begin MEASUREMENT DSQ_st.DSQ_Com_stTrqFil "DSQ/Status der Signal Qualität DSQ_Com_stTrqFil" UBYTE DFC_OneToOne 1 100 0.00 255.0 ECU_ADDRESS 0xD0003C99 /end MEASUREMENT
/begin MEASUREMENT DSQ_st.DSQ_Com_stTrqGbxDes "DSQ/Status der Signal Qualität DSQ_Com_stTrqGbxDes" UBYTE DFC_OneToOne 1 100 0.00 255.0 ECU_ADDRESS 0xD0003C9A /end MEASUREMENT
/begin MEASUREMENT DSQ_st.DSQ_Com_stTrqGbxLim "DSQ/Status der Signal Qualität DSQ_Com_stTrqGbxLim" UBYTE DFC_OneToOne 1 100 0.00 255.0 ECU_ADDRESS 0xD0003C9B /end MEASUREMENT
/begin MEASUREMENT DSQ_st.DSQ_Com_stTrqStbDesQl "DSQ/Status der Signal Qualität DSQ_Com_stTrqStbDesQl" UBYTE DFC_OneToOne 1 100 0.00 255.0 ECU_ADDRESS 0xD0003C9C /end MEASUREMENT
/begin MEASUREMENT DSQ_st.DSQ_Com_stTrqStrg "DSQ/Status der Signal Qualität DSQ_Com_stTrqStrg" UBYTE DFC_OneToOne 1 100 0.00 255.0 ECU_ADDRESS 0xD0003C9D /end MEASUREMENT
/begin MEASUREMENT DSQ_st.DSQ_Com_stTrqWhl "DSQ/Status der Signal Qualität DSQ_Com_stTrqWhl" UBYTE DFC_OneToOne 1 100 0.00 255.0 ECU_ADDRESS 0xD0003C9E /end MEASUREMENT
/begin MEASUREMENT DSQ_st.DSQ_Com_stTrqWhlDemFASQl "DSQ/Status der Signal Qualität DSQ_Com_stTrqWhlDemFASQl" UBYTE DFC_OneToOne 1 100 0.00 255.0 ECU_ADDRESS 0xD0003C9F /end MEASUREMENT
/begin MEASUREMENT DSQ_st.DSQ_Com_stTrqWhlDesQl "DSQ/Status der Signal Qualität DSQ_Com_stTrqWhlDesQl" UBYTE DFC_OneToOne 1 100 0.00 255.0 ECU_ADDRESS 0xD0003CA0 /end MEASUREMENT
/begin MEASUREMENT DSQ_st.DSQ_Com_stTypBody "DSQ/Status der Signal Qualität DSQ_Com_stTypBody" UBYTE DFC_OneToOne 1 100 0.00 255.0 ECU_ADDRESS 0xD0003CA1 /end MEASUREMENT
/begin MEASUREMENT DSQ_st.DSQ_Com_stUnVel "DSQ/Status der Signal Qualität DSQ_Com_stUnVel" UBYTE DFC_OneToOne 1 100 0.00 255.0 ECU_ADDRESS 0xD0003CA2 /end MEASUREMENT
/begin MEASUREMENT DSQ_st.DSQ_Com_stVehCond "DSQ/Status der Signal Qualität DSQ_Com_stVehCond" UBYTE DFC_OneToOne 1 100 0.00 255.0 ECU_ADDRESS 0xD0003CA3 /end MEASUREMENT
/begin MEASUREMENT DSQ_st.DSQ_Com_stVehDrvCond "DSQ/Status der Signal Qualität DSQ_Com_stVehDrvCond" UBYTE DFC_OneToOne 1 100 0.00 255.0 ECU_ADDRESS 0xD0003CA4 /end MEASUREMENT
/begin MEASUREMENT DSQ_st.DSQ_Com_stVerbraucher "DSQ/Status der Signal Qualität DSQ_Com_stVerbraucher" UBYTE DFC_OneToOne 1 100 0.00 255.0 ECU_ADDRESS 0xD0003CA5 /end MEASUREMENT
/begin MEASUREMENT DSQ_st.DSQ_Com_stphiStWhlAg "DSQ/Status der Signal Qualität DSQ_Com_stphiStWhlAg" UBYTE DFC_OneToOne 1 100 0.00 255.0 ECU_ADDRESS 0xD0003CA6 /end MEASUREMENT
/begin MEASUREMENT DSQ_st.DSQ_Com_swtAC "DSQ/Status der Signal Qualität DSQ_Com_swtAC" UBYTE DFC_OneToOne 1 100 0.00 255.0 ECU_ADDRESS 0xD0003CA7 /end MEASUREMENT
/begin MEASUREMENT DSQ_st.DSQ_Com_swtDrBltb "DSQ/Status der Signal Qualität DSQ_Com_swtDrBltb" UBYTE DFC_OneToOne 1 100 0.00 255.0 ECU_ADDRESS 0xD0003CA8 /end MEASUREMENT
/begin MEASUREMENT DSQ_st.DSQ_Com_tEnvT "DSQ/Status der Signal Qualität DSQ_Com_tEnvT" UBYTE DFC_OneToOne 1 100 0.00 255.0 ECU_ADDRESS 0xD0003CA9 /end MEASUREMENT
/begin MEASUREMENT DSQ_st.DSQ_Com_tGbxOil "DSQ/Status der Signal Qualität DSQ_Com_tGbxOil" UBYTE DFC_OneToOne 1 100 0.00 255.0 ECU_ADDRESS 0xD0003CAA /end MEASUREMENT
/begin MEASUREMENT DSQ_st.DSQ_Com_tiPostRunPwrSpl "DSQ/Status der Signal Qualität DSQ_Com_tiPostRunPwrSpl" UBYTE DFC_OneToOne 1 100 0.00 255.0 ECU_ADDRESS 0xD0003CAB /end MEASUREMENT
/begin MEASUREMENT DSQ_st.DSQ_Com_trqAC "DSQ/Status der Signal Qualität DSQ_Com_trqAC" UBYTE DFC_OneToOne 1 100 0.00 255.0 ECU_ADDRESS 0xD0003CAC /end MEASUREMENT
/begin MEASUREMENT DSQ_st.DSQ_Com_trqAFS "DSQ/Status der Signal Qualität DSQ_Com_trqAFS" UBYTE DFC_OneToOne 1 100 0.00 255.0 ECU_ADDRESS 0xD0003CAD /end MEASUREMENT
/begin MEASUREMENT DSQ_st.DSQ_Com_trqAFSDes "DSQ/Status der Signal Qualität DSQ_Com_trqAFSDes" UBYTE DFC_OneToOne 1 100 0.00 255.0 ECU_ADDRESS 0xD0003CAE /end MEASUREMENT
/begin MEASUREMENT DSQ_st.DSQ_Com_trqARSCur "DSQ/Status der Signal Qualität DSQ_Com_trqARSCur" UBYTE DFC_OneToOne 1 100 0.00 255.0 ECU_ADDRESS 0xD0003CAF /end MEASUREMENT
/begin MEASUREMENT DSQ_st.DSQ_Com_trqARSDes "DSQ/Status der Signal Qualität DSQ_Com_trqARSDes" UBYTE DFC_OneToOne 1 100 0.00 255.0 ECU_ADDRESS 0xD0003CB0 /end MEASUREMENT
/begin MEASUREMENT DSQ_st.DSQ_Com_trqAdjrDKG "DSQ/Status der Signal Qualität DSQ_Com_trqAdjrDKG" UBYTE DFC_OneToOne 1 100 0.00 255.0 ECU_ADDRESS 0xD0003CB1 /end MEASUREMENT
/begin MEASUREMENT DSQ_st.DSQ_Com_trqBrkDVCH "DSQ/Status der Signal Qualität DSQ_Com_trqBrkDVCH" UBYTE DFC_OneToOne 1 100 0.00 255.0 ECU_ADDRESS 0xD0003CB2 /end MEASUREMENT
/begin MEASUREMENT DSQ_st.DSQ_Com_trqClthDKG "DSQ/Status der Signal Qualität DSQ_Com_trqClthDKG" UBYTE DFC_OneToOne 1 100 0.00 255.0 ECU_ADDRESS 0xD0003CB3 /end MEASUREMENT
/begin MEASUREMENT DSQ_st.DSQ_Com_trqDSCDes "DSQ/Status der Signal Qualität DSQ_Com_trqDSCDes" UBYTE DFC_OneToOne 1 100 0.00 255.0 ECU_ADDRESS 0xD0003CB4 /end MEASUREMENT
/begin MEASUREMENT DSQ_st.DSQ_Com_trqDVCHRise "DSQ/Status der Signal Qualität DSQ_Com_trqDVCHRise" UBYTE DFC_OneToOne 1 100 0.00 255.0 ECU_ADDRESS 0xD0003CB5 /end MEASUREMENT
/begin MEASUREMENT DSQ_st.DSQ_Com_trqGbxDes "DSQ/Status der Signal Qualität DSQ_Com_trqGbxDes" UBYTE DFC_OneToOne 1 100 0.00 255.0 ECU_ADDRESS 0xD0003CB6 /end MEASUREMENT
/begin MEASUREMENT DSQ_st.DSQ_Com_trqGbxFrc "DSQ/Status der Signal Qualität DSQ_Com_trqGbxFrc" UBYTE DFC_OneToOne 1 100 0.00 255.0 ECU_ADDRESS 0xD0003CB7 /end MEASUREMENT
/begin MEASUREMENT DSQ_st.DSQ_Com_trqGbxMax "DSQ/Status der Signal Qualität DSQ_Com_trqGbxMax" UBYTE DFC_OneToOne 1 100 0.00 255.0 ECU_ADDRESS 0xD0003CB8 /end MEASUREMENT
/begin MEASUREMENT DSQ_st.DSQ_Com_trqGbxMaxRaw "DSQ/Status der Signal Qualität DSQ_Com_trqGbxMaxRaw" UBYTE DFC_OneToOne 1 100 0.00 255.0 ECU_ADDRESS 0xD0003CB9 /end MEASUREMENT
/begin MEASUREMENT DSQ_st.DSQ_Com_trqStbDes "DSQ/Status der Signal Qualität DSQ_Com_trqStbDes" UBYTE DFC_OneToOne 1 100 0.00 255.0 ECU_ADDRESS 0xD0003CBA /end MEASUREMENT
/begin MEASUREMENT DSQ_st.DSQ_Com_trqStrg "DSQ/Status der Signal Qualität DSQ_Com_trqStrg" UBYTE DFC_OneToOne 1 100 0.00 255.0 ECU_ADDRESS 0xD0003CBB /end MEASUREMENT
/begin MEASUREMENT DSQ_st.DSQ_Com_trqStrgDes "DSQ/Status der Signal Qualität DSQ_Com_trqStrgDes" UBYTE DFC_OneToOne 1 100 0.00 255.0 ECU_ADDRESS 0xD0003CBC /end MEASUREMENT
/begin MEASUREMENT DSQ_st.DSQ_Com_trqTarDKG "DSQ/Status der Signal Qualität DSQ_Com_trqTarDKG" UBYTE DFC_OneToOne 1 100 0.00 255.0 ECU_ADDRESS 0xD0003CBD /end MEASUREMENT
/begin MEASUREMENT DSQ_st.DSQ_Com_trqTarDrvDyn "DSQ/Status der Signal Qualität DSQ_Com_trqTarDrvDyn" UBYTE DFC_OneToOne 1 100 0.00 255.0 ECU_ADDRESS 0xD0003CBE /end MEASUREMENT
/begin MEASUREMENT DSQ_st.DSQ_Com_trqTarDrvDynDes "DSQ/Status der Signal Qualität DSQ_Com_trqTarDrvDynDes" UBYTE DFC_OneToOne 1 100 0.00 255.0 ECU_ADDRESS 0xD0003CBF /end MEASUREMENT
/begin MEASUREMENT DSQ_st.DSQ_Com_trqTarDrvDynMax "DSQ/Status der Signal Qualität DSQ_Com_trqTarDrvDynMax" UBYTE DFC_OneToOne 1 100 0.00 255.0 ECU_ADDRESS 0xD0003CC0 /end MEASUREMENT
/begin MEASUREMENT DSQ_st.DSQ_Com_trqWhlDes "DSQ/Status der Signal Qualität DSQ_Com_trqWhlDes" UBYTE DFC_OneToOne 1 100 0.00 255.0 ECU_ADDRESS 0xD0003CC1 /end MEASUREMENT
/begin MEASUREMENT DSQ_st.DSQ_Com_uLamBinGndRaw "DSQ/Status der Signal Qualität DSQ_Com_uLamBinGndRaw" UBYTE DFC_OneToOne 1 100 0.00 255.0 ECU_ADDRESS 0xD0003CC2 /end MEASUREMENT
/begin MEASUREMENT DSQ_st.DSQ_Com_uLamBinUbattRaw "DSQ/Status der Signal Qualität DSQ_Com_uLamBinUbattRaw" UBYTE DFC_OneToOne 1 100 0.00 255.0 ECU_ADDRESS 0xD0003CC3 /end MEASUREMENT
/begin MEASUREMENT DSQ_st.DSQ_Com_uPsp "DSQ/Status der Signal Qualität DSQ_Com_uPsp" UBYTE DFC_OneToOne 1 100 0.00 255.0 ECU_ADDRESS 0xD0003CC4 /end MEASUREMENT
/begin MEASUREMENT DSQ_st.DSQ_Com_uT30Psp "DSQ/Status der Signal Qualität DSQ_Com_uT30Psp" UBYTE DFC_OneToOne 1 100 0.00 255.0 ECU_ADDRESS 0xD0003CC5 /end MEASUREMENT
/begin MEASUREMENT DSQ_st.DSQ_Com_v "DSQ/Status der Signal Qualität DSQ_Com_v" UBYTE DFC_OneToOne 1 100 0.00 255.0 ECU_ADDRESS 0xD0003CC6 /end MEASUREMENT
/begin MEASUREMENT DSQ_st.DSQ_Com_vBd "DSQ/Status der Signal Qualität DSQ_Com_vBd" UBYTE DFC_OneToOne 1 100 0.00 255.0 ECU_ADDRESS 0xD0003CC7 /end MEASUREMENT
/begin MEASUREMENT DSQ_st.DSQ_Com_vDspl "DSQ/Status der Signal Qualität DSQ_Com_vDspl" UBYTE DFC_OneToOne 1 100 0.00 255.0 ECU_ADDRESS 0xD0003CC8 /end MEASUREMENT
/begin MEASUREMENT DSQ_st.DSQ_Com_vVeh "DSQ/Status der Signal Qualität DSQ_Com_vVeh" UBYTE DFC_OneToOne 1 100 0.00 255.0 ECU_ADDRESS 0xD0003CC9 /end MEASUREMENT
/begin MEASUREMENT DSQ_st.DSQ_Com_volFlTnkQnt "DSQ/Status der Signal Qualität DSQ_Com_volFlTnkQnt" UBYTE DFC_OneToOne 1 100 0.00 255.0 ECU_ADDRESS 0xD0003CCA /end MEASUREMENT
/begin MEASUREMENT DSQ_st.DSQ_Com_volFlTnkQntLH "DSQ/Status der Signal Qualität DSQ_Com_volFlTnkQntLH" UBYTE DFC_OneToOne 1 100 0.00 255.0 ECU_ADDRESS 0xD0003CCB /end MEASUREMENT
/begin MEASUREMENT DSQ_st.DSQ_Com_volFlTnkQntRH "DSQ/Status der Signal Qualität DSQ_Com_volFlTnkQntRH" UBYTE DFC_OneToOne 1 100 0.00 255.0 ECU_ADDRESS 0xD0003CCC /end MEASUREMENT
/begin MEASUREMENT DSQ_st.DSQ_DSMInhibitAlways "DSQ/Status der Signal Qualität DSQ_DSMInhibitAlways" UBYTE DFC_OneToOne 1 100 0.00 255.0 ECU_ADDRESS 0xD0003CCD /end MEASUREMENT
/begin MEASUREMENT DSQ_st.DSQ_EBxFan "DSQ/Status der Signal Qualität DSQ_EBxFan" UBYTE DFC_OneToOne 1 100 0.00 255.0 ECU_ADDRESS 0xD0003CCE /end MEASUREMENT
/begin MEASUREMENT DSQ_st.DSQ_ECBVlvActr "DSQ/Status der Signal Qualität DSQ_ECBVlvActr" UBYTE DFC_OneToOne 1 100 0.00 255.0 ECU_ADDRESS 0xD0003CCF /end MEASUREMENT
/begin MEASUREMENT DSQ_st.DSQ_ECBVlvSens "DSQ/Status der Signal Qualität DSQ_ECBVlvSens" UBYTE DFC_OneToOne 1 100 0.00 255.0 ECU_ADDRESS 0xD0003CD0 /end MEASUREMENT
/begin MEASUREMENT DSQ_st.DSQ_EGRVlvActr "DSQ/Status der Signal Qualität DSQ_EGRVlvActr" UBYTE DFC_OneToOne 1 100 0.00 255.0 ECU_ADDRESS 0xD0003CD1 /end MEASUREMENT
/begin MEASUREMENT DSQ_st.DSQ_EGRVlvLPActr "DSQ/Status der Signal Qualität DSQ_EGRVlvLPActr" UBYTE DFC_OneToOne 1 100 0.00 255.0 ECU_ADDRESS 0xD0003CD2 /end MEASUREMENT
/begin MEASUREMENT DSQ_st.DSQ_EGRVlvLPSens "DSQ/Status der Signal Qualität DSQ_EGRVlvLPSens" UBYTE DFC_OneToOne 1 100 0.00 255.0 ECU_ADDRESS 0xD0003CD3 /end MEASUREMENT
/begin MEASUREMENT DSQ_st.DSQ_EGRVlvSens "DSQ/Status der Signal Qualität DSQ_EGRVlvSens" UBYTE DFC_OneToOne 1 100 0.00 255.0 ECU_ADDRESS 0xD0003CD4 /end MEASUREMENT
/begin MEASUREMENT DSQ_st.DSQ_EMDmp_0 "DSQ/Status der Signal Qualität DSQ_EMDmp_0" UBYTE DFC_OneToOne 1 100 0.00 255.0 ECU_ADDRESS 0xD0003CD5 /end MEASUREMENT
/begin MEASUREMENT DSQ_st.DSQ_EMDmp_1 "DSQ/Status der Signal Qualität DSQ_EMDmp_1" UBYTE DFC_OneToOne 1 100 0.00 255.0 ECU_ADDRESS 0xD0003CD6 /end MEASUREMENT
/begin MEASUREMENT DSQ_st.DSQ_EngPrtFWOsc "DSQ/Status der Signal Qualität DSQ_EngPrtFWOsc" UBYTE DFC_OneToOne 1 100 0.00 255.0 ECU_ADDRESS 0xD0003CD7 /end MEASUREMENT
/begin MEASUREMENT DSQ_st.DSQ_EngStAActr "DSQ/Status der Signal Qualität DSQ_EngStAActr" UBYTE DFC_OneToOne 1 100 0.00 255.0 ECU_ADDRESS 0xD0003CD8 /end MEASUREMENT
/begin MEASUREMENT DSQ_st.DSQ_EnvP "DSQ/Status der Signal Qualität DSQ_EnvP" UBYTE DFC_OneToOne 1 100 0.00 255.0 ECU_ADDRESS 0xD0003CD9 /end MEASUREMENT
/begin MEASUREMENT DSQ_st.DSQ_EnvT "DSQ/Status der Signal Qualität DSQ_EnvT" UBYTE DFC_OneToOne 1 100 0.00 255.0 ECU_ADDRESS 0xD0003CDA /end MEASUREMENT
/begin MEASUREMENT DSQ_st.DSQ_ErrLmpActrMIL "DSQ/Status der Signal Qualität DSQ_ErrLmpActrMIL" UBYTE DFC_OneToOne 1 100 0.00 255.0 ECU_ADDRESS 0xD0003CDB /end MEASUREMENT
/begin MEASUREMENT DSQ_st.DSQ_ErrLmpActrSVS "DSQ/Status der Signal Qualität DSQ_ErrLmpActrSVS" UBYTE DFC_OneToOne 1 100 0.00 255.0 ECU_ADDRESS 0xD0003CDC /end MEASUREMENT
/begin MEASUREMENT DSQ_st.DSQ_FanActr "DSQ/Status der Signal Qualität DSQ_FanActr" UBYTE DFC_OneToOne 1 100 0.00 255.0 ECU_ADDRESS 0xD0003CDD /end MEASUREMENT
/begin MEASUREMENT DSQ_st.DSQ_FlFltDsP "DSQ/Status der Signal Qualität DSQ_FlFltDsP" UBYTE DFC_OneToOne 1 100 0.00 255.0 ECU_ADDRESS 0xD0003CDE /end MEASUREMENT
/begin MEASUREMENT DSQ_st.DSQ_FlFltHtActr "DSQ/Status der Signal Qualität DSQ_FlFltHtActr" UBYTE DFC_OneToOne 1 100 0.00 255.0 ECU_ADDRESS 0xD0003CDF /end MEASUREMENT
/begin MEASUREMENT DSQ_st.DSQ_FlFltUsP "DSQ/Status der Signal Qualität DSQ_FlFltUsP" UBYTE DFC_OneToOne 1 100 0.00 255.0 ECU_ADDRESS 0xD0003CE0 /end MEASUREMENT
/begin MEASUREMENT DSQ_st.DSQ_FuelLvl_vol "DSQ/Status der Signal Qualität DSQ_FuelLvl_vol" UBYTE DFC_OneToOne 1 100 0.00 255.0 ECU_ADDRESS 0xD0003CE1 /end MEASUREMENT
/begin MEASUREMENT DSQ_st.DSQ_FuelT "DSQ/Status der Signal Qualität DSQ_FuelT" UBYTE DFC_OneToOne 1 100 0.00 255.0 ECU_ADDRESS 0xD0003CE2 /end MEASUREMENT
/begin MEASUREMENT DSQ_st.DSQ_GbxNPosPls "DSQ/Status der Signal Qualität DSQ_GbxNPosPls" UBYTE DFC_OneToOne 1 100 0.00 255.0 ECU_ADDRESS 0xD0003CE3 /end MEASUREMENT
/begin MEASUREMENT DSQ_st.DSQ_IVDiast "DSQ/Status der Signal Qualität DSQ_IVDiast" UBYTE DFC_OneToOne 1 100 0.00 255.0 ECU_ADDRESS 0xD0003CE4 /end MEASUREMENT
/begin MEASUREMENT DSQ_st.DSQ_InjVlvInjCo "DSQ/Status der Signal Qualität DSQ_InjVlvInjCo" UBYTE DFC_OneToOne 1 100 0.00 255.0 ECU_ADDRESS 0xD0003CE5 /end MEASUREMENT
/begin MEASUREMENT DSQ_st.DSQ_InjVlvPresMin "DSQ/Status der Signal Qualität DSQ_InjVlvPresMin" UBYTE DFC_OneToOne 1 100 0.00 255.0 ECU_ADDRESS 0xD0003CE6 /end MEASUREMENT
/begin MEASUREMENT DSQ_st.DSQ_LAYER2EDCMSAStp "DSQ/Status der Signal Qualität DSQ_LAYER2EDCMSAStp" UBYTE DFC_OneToOne 1 100 0.00 255.0 ECU_ADDRESS 0xD0003CE7 /end MEASUREMENT
/begin MEASUREMENT DSQ_st.DSQ_LSUO2 "DSQ/Status der Signal Qualität DSQ_LSUO2" UBYTE DFC_OneToOne 1 100 0.00 255.0 ECU_ADDRESS 0xD0003CE8 /end MEASUREMENT
/begin MEASUREMENT DSQ_st.DSQ_Layer_rCtrPwrSpCos "DSQ/Status der Signal Qualität DSQ_Layer_rCtrPwrSpCos" UBYTE DFC_OneToOne 1 100 0.00 255.0 ECU_ADDRESS 0xD0003CE9 /end MEASUREMENT
/begin MEASUREMENT DSQ_st.DSQ_MRly "DSQ/Status der Signal Qualität DSQ_MRly" UBYTE DFC_OneToOne 1 100 0.00 255.0 ECU_ADDRESS 0xD0003CEA /end MEASUREMENT
/begin MEASUREMENT DSQ_st.DSQ_MeUnActr "DSQ/Status der Signal Qualität DSQ_MeUnActr" UBYTE DFC_OneToOne 1 100 0.00 255.0 ECU_ADDRESS 0xD0003CEB /end MEASUREMENT
/begin MEASUREMENT DSQ_st.DSQ_NSCDsRLamO2 "DSQ/Status der Signal Qualität DSQ_NSCDsRLamO2" UBYTE DFC_OneToOne 1 100 0.00 255.0 ECU_ADDRESS 0xD0003CEC /end MEASUREMENT
/begin MEASUREMENT DSQ_st.DSQ_NoCat2DsO2Val "DSQ/Status der Signal Qualität DSQ_NoCat2DsO2Val" UBYTE DFC_OneToOne 1 100 0.00 255.0 ECU_ADDRESS 0xD0003CED /end MEASUREMENT
/begin MEASUREMENT DSQ_st.DSQ_O2ValNSCDs "DSQ/Status der Signal Qualität DSQ_O2ValNSCDs" UBYTE DFC_OneToOne 1 100 0.00 255.0 ECU_ADDRESS 0xD0003CEE /end MEASUREMENT
/begin MEASUREMENT DSQ_st.DSQ_O2ValNoCat2Ds "DSQ/Status der Signal Qualität DSQ_O2ValNoCat2Ds" UBYTE DFC_OneToOne 1 100 0.00 255.0 ECU_ADDRESS 0xD0003CEF /end MEASUREMENT
/begin MEASUREMENT DSQ_st.DSQ_OilPSwmp "DSQ/Status der Signal Qualität DSQ_OilPSwmp" UBYTE DFC_OneToOne 1 100 0.00 255.0 ECU_ADDRESS 0xD0003CF0 /end MEASUREMENT
/begin MEASUREMENT DSQ_st.DSQ_PCVActr "DSQ/Status der Signal Qualität DSQ_PCVActr" UBYTE DFC_OneToOne 1 100 0.00 255.0 ECU_ADDRESS 0xD0003CF1 /end MEASUREMENT
/begin MEASUREMENT DSQ_st.DSQ_PIntkVUs "DSQ/Status der Signal Qualität DSQ_PIntkVUs" UBYTE DFC_OneToOne 1 100 0.00 255.0 ECU_ADDRESS 0xD0003CF2 /end MEASUREMENT
/begin MEASUREMENT DSQ_st.DSQ_PPFltDiff "DSQ/Status der Signal Qualität DSQ_PPFltDiff" UBYTE DFC_OneToOne 1 100 0.00 255.0 ECU_ADDRESS 0xD0003CF3 /end MEASUREMENT
/begin MEASUREMENT DSQ_st.DSQ_PPFltUs "DSQ/Status der Signal Qualität DSQ_PPFltUs" UBYTE DFC_OneToOne 1 100 0.00 255.0 ECU_ADDRESS 0xD0003CF4 /end MEASUREMENT
/begin MEASUREMENT DSQ_st.DSQ_RailShutOffDblCtl "DSQ/Status der Signal Qualität DSQ_RailShutOffDblCtl" UBYTE DFC_OneToOne 1 100 0.00 255.0 ECU_ADDRESS 0xD0003CF5 /end MEASUREMENT
/begin MEASUREMENT DSQ_st.DSQ_RailShutOffMeUnCtl "DSQ/Status der Signal Qualität DSQ_RailShutOffMeUnCtl" UBYTE DFC_OneToOne 1 100 0.00 255.0 ECU_ADDRESS 0xD0003CF6 /end MEASUREMENT
/begin MEASUREMENT DSQ_st.DSQ_SOPTstInjShOff "DSQ/Status der Signal Qualität DSQ_SOPTstInjShOff" UBYTE DFC_OneToOne 1 100 0.00 255.0 ECU_ADDRESS 0xD0003CF7 /end MEASUREMENT
/begin MEASUREMENT DSQ_st.DSQ_ShtrActr "DSQ/Status der Signal Qualität DSQ_ShtrActr" UBYTE DFC_OneToOne 1 100 0.00 255.0 ECU_ADDRESS 0xD0003CF8 /end MEASUREMENT
/begin MEASUREMENT DSQ_st.DSQ_StrtActr "DSQ/Status der Signal Qualität DSQ_StrtActr" UBYTE DFC_OneToOne 1 100 0.00 255.0 ECU_ADDRESS 0xD0003CF9 /end MEASUREMENT
/begin MEASUREMENT DSQ_st.DSQ_TAFS "DSQ/Status der Signal Qualität DSQ_TAFS" UBYTE DFC_OneToOne 1 100 0.00 255.0 ECU_ADDRESS 0xD0003CFA /end MEASUREMENT
/begin MEASUREMENT DSQ_st.DSQ_TCACDs "DSQ/Status der Signal Qualität DSQ_TCACDs" UBYTE DFC_OneToOne 1 100 0.00 255.0 ECU_ADDRESS 0xD0003CFB /end MEASUREMENT
/begin MEASUREMENT DSQ_st.DSQ_TECU "DSQ/Status der Signal Qualität DSQ_TECU" UBYTE DFC_OneToOne 1 100 0.00 255.0 ECU_ADDRESS 0xD0003CFC /end MEASUREMENT
/begin MEASUREMENT DSQ_st.DSQ_TOxiCatUs "DSQ/Status der Signal Qualität DSQ_TOxiCatUs" UBYTE DFC_OneToOne 1 100 0.00 255.0 ECU_ADDRESS 0xD0003CFD /end MEASUREMENT
/begin MEASUREMENT DSQ_st.DSQ_TPFltUs "DSQ/Status der Signal Qualität DSQ_TPFltUs" UBYTE DFC_OneToOne 1 100 0.00 255.0 ECU_ADDRESS 0xD0003CFE /end MEASUREMENT
/begin MEASUREMENT DSQ_st.DSQ_TTrbnUs "DSQ/Status der Signal Qualität DSQ_TTrbnUs" UBYTE DFC_OneToOne 1 100 0.00 255.0 ECU_ADDRESS 0xD0003CFF /end MEASUREMENT
/begin MEASUREMENT DSQ_st.DSQ_ThrVlvActr "DSQ/Status der Signal Qualität DSQ_ThrVlvActr" UBYTE DFC_OneToOne 1 100 0.00 255.0 ECU_ADDRESS 0xD0003D00 /end MEASUREMENT
/begin MEASUREMENT DSQ_st.DSQ_ThrVlvSens "DSQ/Status der Signal Qualität DSQ_ThrVlvSens" UBYTE DFC_OneToOne 1 100 0.00 255.0 ECU_ADDRESS 0xD0003D01 /end MEASUREMENT
/begin MEASUREMENT DSQ_st.DSQ_TrbChActr "DSQ/Status der Signal Qualität DSQ_TrbChActr" UBYTE DFC_OneToOne 1 100 0.00 255.0 ECU_ADDRESS 0xD0003D02 /end MEASUREMENT
/begin MEASUREMENT DSQ_st.DSQ_TrbChLPActr "DSQ/Status der Signal Qualität DSQ_TrbChLPActr" UBYTE DFC_OneToOne 1 100 0.00 255.0 ECU_ADDRESS 0xD0003D03 /end MEASUREMENT
/begin MEASUREMENT DSQ_st.DSQ_TrbChSens "DSQ/Status der Signal Qualität DSQ_TrbChSens" UBYTE DFC_OneToOne 1 100 0.00 255.0 ECU_ADDRESS 0xD0003D04 /end MEASUREMENT
/begin MEASUREMENT DSQ_st.DSQ_TrbnDsRLamO2 "DSQ/Status der Signal Qualität DSQ_TrbnDsRLamO2" UBYTE DFC_OneToOne 1 100 0.00 255.0 ECU_ADDRESS 0xD0003D05 /end MEASUREMENT
/begin MEASUREMENT DSQ_st.DSQ_UCatUsT "DSQ/Status der Signal Qualität DSQ_UCatUsT" UBYTE DFC_OneToOne 1 100 0.00 255.0 ECU_ADDRESS 0xD0003D06 /end MEASUREMENT
/begin MEASUREMENT DSQ_st.DSQ_UDosVlvActr "DSQ/Status der Signal Qualität DSQ_UDosVlvActr" UBYTE DFC_OneToOne 1 100 0.00 255.0 ECU_ADDRESS 0xD0003D07 /end MEASUREMENT
/begin MEASUREMENT DSQ_st.DSQ_UHtrPL "DSQ/Status der Signal Qualität DSQ_UHtrPL" UBYTE DFC_OneToOne 1 100 0.00 255.0 ECU_ADDRESS 0xD0003D08 /end MEASUREMENT
/begin MEASUREMENT DSQ_st.DSQ_UHtrPLDia "DSQ/Status der Signal Qualität DSQ_UHtrPLDia" UBYTE DFC_OneToOne 1 100 0.00 255.0 ECU_ADDRESS 0xD0003D09 /end MEASUREMENT
/begin MEASUREMENT DSQ_st.DSQ_UHtrTnk "DSQ/Status der Signal Qualität DSQ_UHtrTnk" UBYTE DFC_OneToOne 1 100 0.00 255.0 ECU_ADDRESS 0xD0003D0A /end MEASUREMENT
/begin MEASUREMENT DSQ_st.DSQ_UHtrTnkDia "DSQ/Status der Signal Qualität DSQ_UHtrTnkDia" UBYTE DFC_OneToOne 1 100 0.00 255.0 ECU_ADDRESS 0xD0003D0B /end MEASUREMENT
/begin MEASUREMENT DSQ_st.DSQ_UPmpMotActr "DSQ/Status der Signal Qualität DSQ_UPmpMotActr" UBYTE DFC_OneToOne 1 100 0.00 255.0 ECU_ADDRESS 0xD0003D0C /end MEASUREMENT
/begin MEASUREMENT DSQ_st.DSQ_UPmpP "DSQ/Status der Signal Qualität DSQ_UPmpP" UBYTE DFC_OneToOne 1 100 0.00 255.0 ECU_ADDRESS 0xD0003D0D /end MEASUREMENT
/begin MEASUREMENT DSQ_st.DSQ_URevVlv "DSQ/Status der Signal Qualität DSQ_URevVlv" UBYTE DFC_OneToOne 1 100 0.00 255.0 ECU_ADDRESS 0xD0003D0E /end MEASUREMENT
/begin MEASUREMENT DSQ_st.DSQ_UTnkLvl "DSQ/Status der Signal Qualität DSQ_UTnkLvl" UBYTE DFC_OneToOne 1 100 0.00 255.0 ECU_ADDRESS 0xD0003D0F /end MEASUREMENT
/begin MEASUREMENT DSQ_st.DSQ_UTnkT "DSQ/Status der Signal Qualität DSQ_UTnkT" UBYTE DFC_OneToOne 1 100 0.00 255.0 ECU_ADDRESS 0xD0003D10 /end MEASUREMENT
/begin MEASUREMENT DSQ_st.DSQ_VSwVlvActr "DSQ/Status der Signal Qualität DSQ_VSwVlvActr" UBYTE DFC_OneToOne 1 100 0.00 255.0 ECU_ADDRESS 0xD0003D11 /end MEASUREMENT
/begin MEASUREMENT DSQ_st.DSQ_VSwVlvSens "DSQ/Status der Signal Qualität DSQ_VSwVlvSens" UBYTE DFC_OneToOne 1 100 0.00 255.0 ECU_ADDRESS 0xD0003D12 /end MEASUREMENT
/begin MEASUREMENT DSQ_st.DSQ_WaHtElActr "DSQ/Status der Signal Qualität DSQ_WaHtElActr" UBYTE DFC_OneToOne 1 100 0.00 255.0 ECU_ADDRESS 0xD0003D13 /end MEASUREMENT
/begin MEASUREMENT DSQ_st.DSQ_stAPP "DSQ/Status der Signal Qualität DSQ_stAPP" UBYTE DFC_OneToOne 1 100 0.00 255.0 ECU_ADDRESS 0xD0003D14 /end MEASUREMENT
/begin MEASUREMENT DSQ_st.DSQ_stAPP1 "DSQ/Status der Signal Qualität DSQ_stAPP1" UBYTE DFC_OneToOne 1 100 0.00 255.0 ECU_ADDRESS 0xD0003D15 /end MEASUREMENT
/begin MEASUREMENT DSQ_st.DSQ_stAPP2 "DSQ/Status der Signal Qualität DSQ_stAPP2" UBYTE DFC_OneToOne 1 100 0.00 255.0 ECU_ADDRESS 0xD0003D16 /end MEASUREMENT
/begin MEASUREMENT DSQ_st.DSQ_stLSUSrvTstDem "DSQ/Status der Signal Qualität DSQ_stLSUSrvTstDem" UBYTE DFC_OneToOne 1 100 0.00 255.0 ECU_ADDRESS 0xD0003D17 /end MEASUREMENT
/begin MEASUREMENT DSQ_st.DSQ_stSrvOpLSUAdap "DSQ/Status der Signal Qualität DSQ_stSrvOpLSUAdap" UBYTE DFC_OneToOne 1 100 0.00 255.0 ECU_ADDRESS 0xD0003D18 /end MEASUREMENT
/begin MEASUREMENT DSQ_stClct_mp "gesammelte Zustände aller Signalqualitäten, bei Signalqualität DSM_QUAL_ALL_OK (0) ist das Bit gelöscht" UWORD DFC_OneToOne 1 100 0.00 65535.00 ARRAY_SIZE 16 ECU_ADDRESS 0xC000BA74 /end MEASUREMENT
/begin FUNCTION DFC ""
 /begin DEF_CHARACTERISTIC DFC_CtlMsk.DFC_Unused_C DFC_CtlMsk.DFC_ACCIPlausDrvAst_C DFC_CtlMsk.DFC_ACCIPlausTrqDes_C DFC_CtlMsk.DFC_AirCtlGovDvtEOMMax_C DFC_CtlMsk.DFC_AirCtlGovDvtEOMMin_C DFC_CtlMsk.DFC_AirCtlGovDvtMax_C DFC_CtlMsk.DFC_AirCtlGovDvtMin_C DFC_CtlMsk.DFC_AirCtlGovLPDvtMax_C DFC_CtlMsk.DFC_AirCtlGovLPDvtMin_C DFC_CtlMsk.DFC_AltIOComErr_C DFC_CtlMsk.DFC_AltIOComNpl_C DFC_CtlMsk.DFC_BusDiagBusOffFlexRay_C DFC_CtlMsk.DFC_BusDiagBusOffNodeA_C DFC_CtlMsk.DFC_BusDiagBusOffNodeB_C DFC_CtlMsk.DFC_BusDiagBusOffNodeC_C DFC_CtlMsk.DFC_BusDiagHwFlexRay_C DFC_CtlMsk.DFC_Cj945SpiCom1_C DFC_CtlMsk.DFC_ComACDemandSig_FA_C DFC_CtlMsk.DFC_ComACDemandTo_FA_C DFC_CtlMsk.DFC_ComATempSig_FA_C DFC_CtlMsk.DFC_ComATempTo_FA_C DFC_CtlMsk.DFC_ComATempTo_FX_C DFC_CtlMsk.DFC_ComBrkTrqSumChk_FX_C DFC_CtlMsk.DFC_ComBrkTrqSumCtr_FX_C DFC_CtlMsk.DFC_ComBrkTrqSumTo_FX_C DFC_CtlMsk.DFC_ComBtnDrvDynChk_FX_C DFC_CtlMsk.DFC_ComBtnDrvDynCtr_FX_C DFC_CtlMsk.DFC_ComBtnDrvDynTo_FX_C DFC_CtlMsk.DFC_ComButtonMSASig_C DFC_CtlMsk.DFC_ComButtonMSATo_C DFC_CtlMsk.DFC_ComCodierungPwrmngSig_C DFC_CtlMsk.DFC_ComCodierungPwrmngSig_FA_C DFC_CtlMsk.DFC_ComCrCtlLvrChk_C DFC_CtlMsk.DFC_ComCrCtlLvrCtr_C DFC_CtlMsk.DFC_ComCrCtlLvrSig_C DFC_CtlMsk.DFC_ComCrCtlLvrTo_C DFC_CtlMsk.DFC_ComCtrCrshSwoEkpSig_FA_C DFC_CtlMsk.DFC_ComCtrCrshSwoEkpTo_FA_C DFC_CtlMsk.DFC_ComCtrSecInt_C DFC_CtlMsk.DFC_ComDiaOBDGbxSig_A_C DFC_CtlMsk.DFC_ComDiaOBDGbxTo_A_C DFC_CtlMsk.DFC_ComFahrzeugtypSig_C DFC_CtlMsk.DFC_ComFahrzeugtypSig_FA_C DFC_CtlMsk.DFC_ComFllupGpwsupSig_FA_C DFC_CtlMsk.DFC_ComFllupGpwsupTo_FA_C DFC_CtlMsk.DFC_ComGbxDataChk_A_C DFC_CtlMsk.DFC_ComGbxDataChk_FA_C DFC_CtlMsk.DFC_ComGbxDataCtr_A_C DFC_CtlMsk.DFC_ComGbxDataCtr_FA_C DFC_CtlMsk.DFC_ComGbxDataSig_A_C DFC_CtlMsk.DFC_ComGbxDataSig_FA_C DFC_CtlMsk.DFC_ComGbxDataTo_A_C DFC_CtlMsk.DFC_ComGbxDataTo_FA_C DFC_CtlMsk.DFC_ComKlemmenChk_FA_C DFC_CtlMsk.DFC_ComKlemmenCtr_FA_C DFC_CtlMsk.DFC_ComKlemmenSig_FA_C DFC_CtlMsk.DFC_ComKlemmenTo_FA_C DFC_CtlMsk.DFC_ComLenkradwinkelSig_C DFC_CtlMsk.DFC_ComLenkradwinkelTo_C DFC_CtlMsk.DFC_ComMileageRangeSig_FA_C DFC_CtlMsk.DFC_ComMileageRangeTo_FA_C DFC_CtlMsk.DFC_ComPspSig_C DFC_CtlMsk.DFC_ComPspTo_C DFC_CtlMsk.DFC_ComRelTimeSig_FA_C DFC_CtlMsk.DFC_ComRelTimeTo_FA_C DFC_CtlMsk.DFC_ComRequestEMFChk_C DFC_CtlMsk.DFC_ComRequestEMFCtr_C DFC_CtlMsk.DFC_ComRequestEMFSig_C DFC_CtlMsk.DFC_ComRequestEMFTo_C DFC_CtlMsk.DFC_ComRpmWhlChk_FX_C DFC_CtlMsk.DFC_ComRpmWhlCtr_FX_C DFC_CtlMsk.DFC_ComRpmWhlTo_FX_C DFC_CtlMsk.DFC_ComSecCtrRelSig_FA_C DFC_CtlMsk.DFC_ComSecCtrRelTo_FA_C DFC_CtlMsk.DFC_ComSensNOxGndSig_C DFC_CtlMsk.DFC_ComSensNOxGndTo_C DFC_CtlMsk.DFC_ComSensNOxMode_C DFC_CtlMsk.DFC_ComSensNOxUbattSig_C DFC_CtlMsk.DFC_ComSensNOxUbattTo_C DFC_CtlMsk.DFC_ComShiftPaddleTo_FX_C DFC_CtlMsk.DFC_ComShutOffPSPSig_C DFC_CtlMsk.DFC_ComShutOffPSPTo_C DFC_CtlMsk.DFC_ComSlrdiGlbFZMTo_FA_C DFC_CtlMsk.DFC_ComSlrdiGlbFZMTo_FX_C DFC_CtlMsk.DFC_ComSpeedVehicleChk_FX_C DFC_CtlMsk.DFC_ComSpeedVehicleCtr_FX_C DFC_CtlMsk.DFC_ComSpeedVehicleTo_FX_C DFC_CtlMsk.DFC_ComStConintDSCChk_FX_C DFC_CtlMsk.DFC_ComStConintDSCCtr_FX_C DFC_CtlMsk.DFC_ComStConintDSCTo_FX_C DFC_CtlMsk.DFC_ComStatACFrontSig_FA_C DFC_CtlMsk.DFC_ComStatACFrontTo_FA_C DFC_CtlMsk.DFC_ComStatEkpSig_A_C DFC_CtlMsk.DFC_ComStatEkpTo_A_C DFC_CtlMsk.DFC_ComStatGearRevSig_FA_C DFC_CtlMsk.DFC_ComStatGearRevTo_FA_C DFC_CtlMsk.DFC_ComStatZVKlappenSig_FA_C DFC_CtlMsk.DFC_ComStatZVKlappenTo_FA_C DFC_CtlMsk.DFC_ComStateARSCtr_C DFC_CtlMsk.DFC_ComStateARSSig_C DFC_CtlMsk.DFC_ComStateARSTo_C DFC_CtlMsk.DFC_ComStateDscSig_C DFC_CtlMsk.DFC_ComStateDscTo_C DFC_CtlMsk.DFC_ComStateSeatSig_C DFC_CtlMsk.DFC_ComStateSeatSig_FA_C DFC_CtlMsk.DFC_ComStateSeatTo_C DFC_CtlMsk.DFC_ComStateSeatTo_FA_C DFC_CtlMsk.DFC_ComStatusEGSSig_A_C DFC_CtlMsk.DFC_ComStatusEGSSig_FA_C DFC_CtlMsk.DFC_ComStatusEGSTo_A_C DFC_CtlMsk.DFC_ComStatusEGSTo_FA_C DFC_CtlMsk.DFC_ComStatusEMFChk_C DFC_CtlMsk.DFC_ComStatusEMFCtr_C DFC_CtlMsk.DFC_ComStatusEMFSig_C DFC_CtlMsk.DFC_ComStatusEMFTo_C DFC_CtlMsk.DFC_ComStatusRGangSig_C DFC_CtlMsk.DFC_ComStatusRGangTo_C DFC_CtlMsk.DFC_ComSteeringAngleChk_FX_C DFC_CtlMsk.DFC_ComSteeringAngleCtr_FX_C DFC_CtlMsk.DFC_ComSteeringAngleTo_FX_C DFC_CtlMsk.DFC_ComTerminalChk_C DFC_CtlMsk.DFC_ComTerminalCtr_C DFC_CtlMsk.DFC_ComTerminalSig_C DFC_CtlMsk.DFC_ComTerminalTo_C DFC_CtlMsk.DFC_ComTimeDateSig_FA_C DFC_CtlMsk.DFC_ComTimeDateTo_FA_C DFC_CtlMsk.DFC_ComTrailerSig_C DFC_CtlMsk.DFC_ComTrailerSig_FA_C DFC_CtlMsk.DFC_ComTrailerTo_C DFC_CtlMsk.DFC_ComTrailerTo_FA_C DFC_CtlMsk.DFC_ComTrqDemCrshDrDyChk_FX_C DFC_CtlMsk.DFC_ComTrqDemCrshDrDyCtr_FX_C DFC_CtlMsk.DFC_ComTrqDemCrshDrDyTo_FX_C DFC_CtlMsk.DFC_ComTrqDemandDesSig_C DFC_CtlMsk.DFC_ComTrqDemandDesTo_C DFC_CtlMsk.DFC_ComTrqDemandDscChk_C DFC_CtlMsk.DFC_ComTrqDemandDscCtr_C DFC_CtlMsk.DFC_ComTrqDemandDscSig_C DFC_CtlMsk.DFC_ComTrqDemandDscTo_C DFC_CtlMsk.DFC_ComTrqDemandGbxChk_A_C DFC_CtlMsk.DFC_ComTrqDemandGbxChk_FA_C DFC_CtlMsk.DFC_ComTrqDemandGbxCtr_A_C DFC_CtlMsk.DFC_ComTrqDemandGbxCtr_FA_C DFC_CtlMsk.DFC_ComTrqDemandGbxSig_A_C DFC_CtlMsk.DFC_ComTrqDemandGbxSig_FA_C DFC_CtlMsk.DFC_ComTrqDemandGbxTo_A_C DFC_CtlMsk.DFC_ComTrqDemandGbxTo_FA_C DFC_CtlMsk.DFC_ComTrqWhlDemChk_C DFC_CtlMsk.DFC_ComTrqWhlDemCtr_C DFC_CtlMsk.DFC_ComTrqWhlDemFASChk_FX_C DFC_CtlMsk.DFC_ComTrqWhlDemFASCtr_FX_C DFC_CtlMsk.DFC_ComTrqWhlDemFASTo_FX_C DFC_CtlMsk.DFC_ComTrqWhlDemSig_C DFC_CtlMsk.DFC_ComTrqWhlDemTo_C DFC_CtlMsk.DFC_ComVelocityChk_FA_C DFC_CtlMsk.DFC_ComVelocityCtr_FA_C DFC_CtlMsk.DFC_ComVelocitySig_C DFC_CtlMsk.DFC_ComVelocitySig_FA_C DFC_CtlMsk.DFC_ComVelocityTo_C DFC_CtlMsk.DFC_ComVelocityTo_FA_C DFC_CtlMsk.DFC_ComVerbraucherTo_C DFC_CtlMsk.DFC_ComWMomPTStabChk_FX_C DFC_CtlMsk.DFC_ComWMomPTStabCtr_FX_C DFC_CtlMsk.DFC_ComWMomPTStabTo_FX_C DFC_CtlMsk.DFC_ComWheelSpeedSig_C DFC_CtlMsk.DFC_ComWheelSpeedTo_C DFC_CtlMsk.DFC_ComZvKlappenSig_C DFC_CtlMsk.DFC_ComZvKlappenTo_C DFC_CtlMsk.DFC_ComaDirectChk_FX_C DFC_CtlMsk.DFC_ComaDirectCtr_FX_C DFC_CtlMsk.DFC_ComaDirectTo_FX_C DFC_CtlMsk.DFC_ComaSideChk_FX_C DFC_CtlMsk.DFC_ComaSideCtr_FX_C DFC_CtlMsk.DFC_ComaSideTo_FX_C DFC_CtlMsk.DFC_Cy320SpiCom_C DFC_CtlMsk.DFC_ETCtlDvtInrMax_C DFC_CtlMsk.DFC_ETCtlDvtInrMin_C DFC_CtlMsk.DFC_ETCtlDvtOutrMax_C DFC_CtlMsk.DFC_ETCtlDvtOutrMin_C DFC_CtlMsk.DFC_FBCqDvtMax_C DFC_CtlMsk.DFC_FBCqDvtMin_C DFC_CtlMsk.DFC_Fan4WinErr1_C DFC_CtlMsk.DFC_Fan4WinErr2_C DFC_CtlMsk.DFC_Fan4WinErr3_C DFC_CtlMsk.DFC_Fan4WinErr4_C DFC_CtlMsk.DFC_FanSCG_C DFC_CtlMsk.DFC_FlFCBS_C DFC_CtlMsk.DFC_GlwEcuConfigErr_C DFC_CtlMsk.DFC_GlwEcuEepErr_C DFC_CtlMsk.DFC_GlwEcuFrmErr_C DFC_CtlMsk.DFC_GlwEcuGPCMFaultInfo_C DFC_CtlMsk.DFC_GlwEcuGPCMInfo_C DFC_CtlMsk.DFC_GlwEcuGk1HSS_C DFC_CtlMsk.DFC_GlwEcuGk1OL_C DFC_CtlMsk.DFC_GlwEcuGk1SC_C DFC_CtlMsk.DFC_GlwEcuGk1Wdst_C DFC_CtlMsk.DFC_GlwEcuGk2HSS_C DFC_CtlMsk.DFC_GlwEcuGk2OL_C DFC_CtlMsk.DFC_GlwEcuGk2SC_C DFC_CtlMsk.DFC_GlwEcuGk2Wdst_C DFC_CtlMsk.DFC_GlwEcuGk3HSS_C DFC_CtlMsk.DFC_GlwEcuGk3OL_C DFC_CtlMsk.DFC_GlwEcuGk3SC_C DFC_CtlMsk.DFC_GlwEcuGk3Wdst_C DFC_CtlMsk.DFC_GlwEcuGk4HSS_C DFC_CtlMsk.DFC_GlwEcuGk4OL_C DFC_CtlMsk.DFC_GlwEcuGk4SC_C DFC_CtlMsk.DFC_GlwEcuGk4Wdst_C DFC_CtlMsk.DFC_GlwEcuGk5HSS_C DFC_CtlMsk.DFC_GlwEcuGk5OL_C DFC_CtlMsk.DFC_GlwEcuGk5SC_C DFC_CtlMsk.DFC_GlwEcuGk5Wdst_C DFC_CtlMsk.DFC_GlwEcuGk6HSS_C DFC_CtlMsk.DFC_GlwEcuGk6OL_C DFC_CtlMsk.DFC_GlwEcuGk6SC_C DFC_CtlMsk.DFC_GlwEcuGk6Wdst_C DFC_CtlMsk.DFC_GlwEcuGndErr_C DFC_CtlMsk.DFC_GlwEcuIntErr_C DFC_CtlMsk.DFC_GlwEcuMsgTimeout_C DFC_CtlMsk.DFC_GlwEcuT30Err_C DFC_CtlMsk.DFC_GlwEcuTempErr_C DFC_CtlMsk.DFC_GlwEcuUdiffT30_C DFC_CtlMsk.DFC_IBSComErr_C DFC_CtlMsk.DFC_LubSRCOilFldtCrit_C DFC_CtlMsk.DFC_LubSRCOilFldtCritDflMin_C DFC_CtlMsk.DFC_LubSRCOilLvlCritMax_C DFC_CtlMsk.DFC_LubSRCOilLvlCritMin_C DFC_CtlMsk.DFC_LubSRCTot_C DFC_CtlMsk.DFC_MonUMaxSupply1_C DFC_CtlMsk.DFC_MonUMinSupply1_C DFC_CtlMsk.DFC_OilComNpl_C DFC_CtlMsk.DFC_PCBS_C DFC_CtlMsk.DFC_PCBSPFltChg_C DFC_CtlMsk.DFC_PCRGovDvtLPMax_C DFC_CtlMsk.DFC_PCRGovDvtLPMin_C DFC_CtlMsk.DFC_PCRGovDvtMax_C DFC_CtlMsk.DFC_PCRGovDvtMin_C DFC_CtlMsk.DFC_PFltAPSPlausMAX_C DFC_CtlMsk.DFC_PFltAPSPlausMIN_C DFC_CtlMsk.DFC_PFltBPSPlausMAX_C DFC_CtlMsk.DFC_PFltBPSPlausMIN_C DFC_CtlMsk.DFC_PFltOvldInhRgn_C DFC_CtlMsk.DFC_PFltOvldTrqLim_C DFC_CtlMsk.DFC_PFltPresPlausMAX_C DFC_CtlMsk.DFC_PFltPresPlausMIN_C DFC_CtlMsk.DFC_PFltTraRpmRdc_C DFC_CtlMsk.DFC_PFlt_tOxiPreMax_C DFC_CtlMsk.DFC_PFlt_tOxiPreMaxRgn_C DFC_CtlMsk.DFC_PFlt_tOxiPreNpl_C DFC_CtlMsk.DFC_PFlt_tPreMax_C DFC_CtlMsk.DFC_PFlt_tPreMaxRgn_C DFC_CtlMsk.DFC_PFlt_tPreNpl_C DFC_CtlMsk.DFC_PFltmSotDiffMAX_C DFC_CtlMsk.DFC_PFltmSotDiffMIN_C DFC_CtlMsk.DFC_PFltmSotDiffSIG_C DFC_CtlMsk.DFC_PIntkVUsEnvPPls_C DFC_CtlMsk.DFC_PresPlausDblDef_C DFC_CtlMsk.DFC_RailCPC1_C DFC_CtlMsk.DFC_RailCPC3_C DFC_CtlMsk.DFC_RailCPC4_C DFC_CtlMsk.DFC_RailMeUn0_C DFC_CtlMsk.DFC_RailMeUn1_C DFC_CtlMsk.DFC_RailMeUn2_C DFC_CtlMsk.DFC_RailMeUn22_C DFC_CtlMsk.DFC_RailMeUn3_C DFC_CtlMsk.DFC_RailMeUn4_C DFC_CtlMsk.DFC_RailMeUn42_C DFC_CtlMsk.DFC_RailMeUn5_C DFC_CtlMsk.DFC_RailPCV0_C DFC_CtlMsk.DFC_RailPCV1_C DFC_CtlMsk.DFC_RailPCV2_C DFC_CtlMsk.DFC_RailPCV22_C DFC_CtlMsk.DFC_RailPCV3_C DFC_CtlMsk.DFC_RailPCV4_C DFC_CtlMsk.DFC_RailPCV42_C DFC_CtlMsk.DFC_RailPMonStrt_C DFC_CtlMsk.DFC_SSpMon1_C DFC_CtlMsk.DFC_SSpMon2_C DFC_CtlMsk.DFC_SSpMon3_C DFC_CtlMsk.DFC_ThrVlv4WinErr1_C DFC_CtlMsk.DFC_ThrVlv4WinErr2_C DFC_CtlMsk.DFC_ThrVlv4WinErr3_C DFC_CtlMsk.DFC_ThrVlv4WinErr4_C DFC_CtlMsk.DFC_ThrVlvSCG_C DFC_CtlMsk.DFC_Tle6232Spi1_C DFC_CtlMsk.DFC_TrbCh4WinErr1_C DFC_CtlMsk.DFC_TrbCh4WinErr2_C DFC_CtlMsk.DFC_TrbCh4WinErr3_C DFC_CtlMsk.DFC_TrbCh4WinErr4_C DFC_CtlMsk.DFC_TrbChSCG_C DFC_CtlMsk.DFC_TrbChSRCMax_C DFC_CtlMsk.DFC_TrbChSRCMin_C DFC_CtlMsk.DFC_WaHtEl4WinErr1_C DFC_CtlMsk.DFC_WaHtEl4WinErr2_C DFC_CtlMsk.DFC_WaHtEl4WinErr3_C DFC_CtlMsk.DFC_WaHtEl4WinErr4_C DFC_CtlMsk.DFC_WaHtElSCG_C DFC_CtlMsk.DFC_ETClbETFltMax_0_C DFC_CtlMsk.DFC_ETClbETFltMax_1_C DFC_CtlMsk.DFC_ETClbETFltMax_2_C DFC_CtlMsk.DFC_ETClbETFltMax_3_C DFC_CtlMsk.DFC_ETClbETFltMax_4_C DFC_CtlMsk.DFC_ETClbETFltMax_5_C DFC_CtlMsk.DFC_ETClbETFltMin_0_C DFC_CtlMsk.DFC_ETClbETFltMin_1_C DFC_CtlMsk.DFC_ETClbETFltMin_2_C DFC_CtlMsk.DFC_ETClbETFltMin_3_C DFC_CtlMsk.DFC_ETClbETFltMin_4_C DFC_CtlMsk.DFC_ETClbETFltMin_5_C DFC_CtlMsk.DFC_InjCrvInjLimChrgBal_C DFC_CtlMsk.DFC_InjCrvInjLimQntBal_C DFC_CtlMsk.DFC_InjCrvInjLimSys_C DFC_CtlMsk.DFC_InjCrvNumInjRtmLim_C DFC_CtlMsk.DFC_LSUHtCoupSig_C DFC_CtlMsk.DFC_AFS_SSpShOffOL_C DFC_CtlMsk.DFC_AFS_SSpShOffOvrTemp_C DFC_CtlMsk.DFC_AFS_SSpShOffSCB_C DFC_CtlMsk.DFC_AFS_SSpShOffSCG_C DFC_CtlMsk.DFC_AirCCmprOL_C DFC_CtlMsk.DFC_AirCCmprOvrTemp_C DFC_CtlMsk.DFC_AirCCmprSCB_C DFC_CtlMsk.DFC_AirCCmprSCG_C DFC_CtlMsk.DFC_CByVlvOL_C DFC_CtlMsk.DFC_CByVlvOvrTemp_C DFC_CtlMsk.DFC_CByVlvSCB_C DFC_CtlMsk.DFC_CByVlvSCG_C DFC_CtlMsk.DFC_CThmstOL_C DFC_CtlMsk.DFC_CThmstOvrTemp_C DFC_CtlMsk.DFC_CThmstSCB_C DFC_CtlMsk.DFC_CThmstSCG_C DFC_CtlMsk.DFC_DSMDummy_C DFC_CtlMsk.DFC_EBxFanOL_C DFC_CtlMsk.DFC_EBxFanOvrTemp_C DFC_CtlMsk.DFC_EBxFanSCB_C DFC_CtlMsk.DFC_EBxFanSCG_C DFC_CtlMsk.DFC_ECBVlvOL_C DFC_CtlMsk.DFC_ECBVlvOvrTemp_C DFC_CtlMsk.DFC_ECBVlvSCB_C DFC_CtlMsk.DFC_ECBVlvSCG_C DFC_CtlMsk.DFC_EMDmpOL_0_C DFC_CtlMsk.DFC_EMDmpOL_1_C DFC_CtlMsk.DFC_EMDmpOvrTemp_0_C DFC_CtlMsk.DFC_EMDmpOvrTemp_1_C DFC_CtlMsk.DFC_EMDmpSCB_0_C DFC_CtlMsk.DFC_EMDmpSCB_1_C DFC_CtlMsk.DFC_EMDmpSCG_0_C DFC_CtlMsk.DFC_EMDmpSCG_1_C DFC_CtlMsk.DFC_EngStAOL_C DFC_CtlMsk.DFC_EngStAOvrTemp_C DFC_CtlMsk.DFC_EngStASCB_C DFC_CtlMsk.DFC_EngStASCG_C DFC_CtlMsk.DFC_FanOL_C DFC_CtlMsk.DFC_FanOvrTemp_C DFC_CtlMsk.DFC_FanSCB_C DFC_CtlMsk.DFC_FlFltHtOL_C DFC_CtlMsk.DFC_FlFltHtOvrTemp_C DFC_CtlMsk.DFC_FlFltHtSCB_C DFC_CtlMsk.DFC_FlFltHtSCG_C DFC_CtlMsk.DFC_LSUHtrMax_C DFC_CtlMsk.DFC_LSUHtrMin_C DFC_CtlMsk.DFC_LSUHtrNpl_C DFC_CtlMsk.DFC_LSUHtrSig_C DFC_CtlMsk.DFC_LSUtExcMax_C DFC_CtlMsk.DFC_LSUtExcMin_C DFC_CtlMsk.DFC_MeUnOL_C DFC_CtlMsk.DFC_MeUnSCB_C DFC_CtlMsk.DFC_MeUnSRCMax_C DFC_CtlMsk.DFC_MeUnSRCMin_C DFC_CtlMsk.DFC_PCVOL_C DFC_CtlMsk.DFC_PCVSCB_C DFC_CtlMsk.DFC_PCVSRCMax_C DFC_CtlMsk.DFC_PCVSRCMin_C DFC_CtlMsk.DFC_RailPSRCMax_C DFC_CtlMsk.DFC_RailPSRCMin_C DFC_CtlMsk.DFC_ShtrOL_C DFC_CtlMsk.DFC_ShtrOvrTemp_C DFC_CtlMsk.DFC_ShtrSCB_C DFC_CtlMsk.DFC_ShtrSCG_C DFC_CtlMsk.DFC_StrtOL_C DFC_CtlMsk.DFC_StrtOvrTemp_C DFC_CtlMsk.DFC_StrtSCB_C DFC_CtlMsk.DFC_StrtSCG_C DFC_CtlMsk.DFC_ThrVlvOL_C DFC_CtlMsk.DFC_ThrVlvOvrTemp_C DFC_CtlMsk.DFC_ThrVlvSCB_C DFC_CtlMsk.DFC_TrbChOL_C DFC_CtlMsk.DFC_TrbChOvrTemp_C DFC_CtlMsk.DFC_TrbChSCB_C DFC_CtlMsk.DFC_UDosVlvOL_C DFC_CtlMsk.DFC_UDosVlvOvrTemp_C DFC_CtlMsk.DFC_UDosVlvSCB_C DFC_CtlMsk.DFC_UDosVlvSCG_C DFC_CtlMsk.DFC_UPmpMotOL_C DFC_CtlMsk.DFC_UPmpMotOvrTemp_C DFC_CtlMsk.DFC_UPmpMotSCB_C DFC_CtlMsk.DFC_UPmpMotSCG_C DFC_CtlMsk.DFC_WaHtElOL_C DFC_CtlMsk.DFC_WaHtElOvrTemp_C DFC_CtlMsk.DFC_WaHtElSCB_C DFC_CtlMsk.DFC_IVActrUChSRCMax_C DFC_CtlMsk.DFC_IVActrUChSRCMin_C DFC_CtlMsk.DFC_IVActrVltgSRCMax_C DFC_CtlMsk.DFC_IVActrVltgSRCMin_C DFC_CtlMsk.DFC_IVDiaTunDet_C DFC_CtlMsk.DFC_IVPSplyStopDCDC_C DFC_CtlMsk.DFC_IVPSplyVltgSRCMax_C DFC_CtlMsk.DFC_IVPSplyVltgSRCMin_C DFC_CtlMsk.DFC_SCREtaErr_C DFC_CtlMsk.DFC_SCREtaErr1_C DFC_CtlMsk.DFC_SCREtaErr2_C DFC_CtlMsk.DFC_SCRMonMetCtlPresErr_C DFC_CtlMsk.DFC_SCRMonPresBuildUpErr_C DFC_CtlMsk.DFC_SCRMonPresRdcErr_C DFC_CtlMsk.DFC_AFSOffsDrftMax_C DFC_CtlMsk.DFC_AFSOffsDrftMin_C DFC_CtlMsk.DFC_AFSSRCCorMax_C DFC_CtlMsk.DFC_AFSSRCCorMin_C DFC_CtlMsk.DFC_AFSSRCRawMax_C DFC_CtlMsk.DFC_AFSSRCRawMin_C DFC_CtlMsk.DFC_AFSSetyDrftMax_C DFC_CtlMsk.DFC_AFSSetyDrftMin_C DFC_CtlMsk.DFC_AirCSwtNpl_C DFC_CtlMsk.DFC_AirCSwtSig_C DFC_CtlMsk.DFC_BattUSRCMax_C DFC_CtlMsk.DFC_BattUSRCMin_C DFC_CtlMsk.DFC_BrkNpl_C DFC_CtlMsk.DFC_BrkPSRCMax_C DFC_CtlMsk.DFC_BrkPSRCMin_C DFC_CtlMsk.DFC_CEngDsTSRCMax_C DFC_CtlMsk.DFC_CEngDsTSRCMin_C DFC_CtlMsk.DFC_CrCUIDet_C DFC_CtlMsk.DFC_ECBVlvSRCMax_C DFC_CtlMsk.DFC_ECBVlvSRCMin_C DFC_CtlMsk.DFC_ECUOvrTemp_C DFC_CtlMsk.DFC_EGRVlvGovDvtMax_C DFC_CtlMsk.DFC_EGRVlvGovDvtMin_C DFC_CtlMsk.DFC_EGRVlvHBrgOpnLd_C DFC_CtlMsk.DFC_EGRVlvHBrgOvrCurr_C DFC_CtlMsk.DFC_EGRVlvHBrgOvrTemp_C DFC_CtlMsk.DFC_EGRVlvHBrgShCirBatt1_C DFC_CtlMsk.DFC_EGRVlvHBrgShCirBatt2_C DFC_CtlMsk.DFC_EGRVlvHBrgShCirGnd1_C DFC_CtlMsk.DFC_EGRVlvHBrgShCirGnd2_C DFC_CtlMsk.DFC_EGRVlvHBrgShCirOvrLd_C DFC_CtlMsk.DFC_EGRVlvHBrgTempOvrCurr_C DFC_CtlMsk.DFC_EGRVlvHBrgUndrVltg_C DFC_CtlMsk.DFC_EGRVlvLPGovDvtMax_C DFC_CtlMsk.DFC_EGRVlvLPGovDvtMin_C DFC_CtlMsk.DFC_EGRVlvLPHBrgOpnLd_C DFC_CtlMsk.DFC_EGRVlvLPHBrgOvrCurr_C DFC_CtlMsk.DFC_EGRVlvLPHBrgOvrTemp_C DFC_CtlMsk.DFC_EGRVlvLPHBrgShCirBatt1_C DFC_CtlMsk.DFC_EGRVlvLPHBrgShCirBatt2_C DFC_CtlMsk.DFC_EGRVlvLPHBrgShCirGnd1_C DFC_CtlMsk.DFC_EGRVlvLPHBrgShCirGnd2_C DFC_CtlMsk.DFC_EGRVlvLPHBrgShCirOvrLd_C DFC_CtlMsk.DFC_EGRVlvLPHBrgTempOvrCurr_C DFC_CtlMsk.DFC_EGRVlvLPHBrgUndrVltg_C DFC_CtlMsk.DFC_EGRVlvLPOL_C DFC_CtlMsk.DFC_EGRVlvLPSCB_C DFC_CtlMsk.DFC_EGRVlvLPSCG_C DFC_CtlMsk.DFC_EGRVlvLPSRCMax_C DFC_CtlMsk.DFC_EGRVlvLPSRCMin_C DFC_CtlMsk.DFC_EGRVlvOL_C DFC_CtlMsk.DFC_EGRVlvSCB_C DFC_CtlMsk.DFC_EGRVlvSCG_C DFC_CtlMsk.DFC_EGRVlvSRCMax_C DFC_CtlMsk.DFC_EGRVlvSRCMin_C DFC_CtlMsk.DFC_EngPrtOvrSpd_C DFC_CtlMsk.DFC_EngSpdOL_C DFC_CtlMsk.DFC_EngSpdSCB_C DFC_CtlMsk.DFC_EngSpdSCG_C DFC_CtlMsk.DFC_EnhSRCMaxPPFltDiff_C DFC_CtlMsk.DFC_EnhSRCMaxT1ExhTMon_C DFC_CtlMsk.DFC_EnhSRCMaxT2ExhTMon_C DFC_CtlMsk.DFC_EnhSRCMaxT3ExhTMon_C DFC_CtlMsk.DFC_EnhSRCMinPPFltDiff_C DFC_CtlMsk.DFC_EnhSRCMinT1ExhTMon_C DFC_CtlMsk.DFC_EnhSRCMinT2ExhTMon_C DFC_CtlMsk.DFC_EnhSRCMinT3ExhTMon_C DFC_CtlMsk.DFC_EnvPSRCMax_C DFC_CtlMsk.DFC_EnvPSRCMin_C DFC_CtlMsk.DFC_ExhTMonPlaus_C DFC_CtlMsk.DFC_ExhTMonPlausPos1_C DFC_CtlMsk.DFC_ExhTMonPlausPos2_C DFC_CtlMsk.DFC_ExhTMonPlausPos3_C DFC_CtlMsk.DFC_ExhTMonT1Plaus_C DFC_CtlMsk.DFC_ExhTMonT2Plaus_C DFC_CtlMsk.DFC_ExhTMonT3Plaus_C DFC_CtlMsk.DFC_FlFltDsPSRCMax_C DFC_CtlMsk.DFC_FlFltDsPSRCMin_C DFC_CtlMsk.DFC_FlFltSig_C DFC_CtlMsk.DFC_FlFltUsPSRCMax_C DFC_CtlMsk.DFC_FlFltUsPSRCMin_C DFC_CtlMsk.DFC_FuelTSRCMax_C DFC_CtlMsk.DFC_FuelTSRCMin_C DFC_CtlMsk.DFC_GbxNPosPPerSRCMax_C DFC_CtlMsk.DFC_GbxNPosPPerSRCMin_C DFC_CtlMsk.DFC_GbxNPosPdcycSRCMax_C DFC_CtlMsk.DFC_GbxNPosPdcycSRCMin_C DFC_CtlMsk.DFC_InjVlvPresMin_C DFC_CtlMsk.DFC_LSUCircNernstSig_C DFC_CtlMsk.DFC_LSUCircPmpCurSig_C DFC_CtlMsk.DFC_LSUCircVirtGndSig_C DFC_CtlMsk.DFC_LSUO2Max_C DFC_CtlMsk.DFC_LSUO2Min_C DFC_CtlMsk.DFC_LSUSPIBattLowMin_C DFC_CtlMsk.DFC_LSUWireSCB_C DFC_CtlMsk.DFC_LSUWireSCG_C DFC_CtlMsk.DFC_MeUnSCG_C DFC_CtlMsk.DFC_NSCDsCmpChk_C DFC_CtlMsk.DFC_NSCDsLamBinSRCMax_C DFC_CtlMsk.DFC_NSCDsLamBinSRCMin_C DFC_CtlMsk.DFC_NSCDsLamLinSRCMax_C DFC_CtlMsk.DFC_NSCDsLamLinSRCMin_C DFC_CtlMsk.DFC_NSCDsLamPlausMax_C DFC_CtlMsk.DFC_NSCDsLamPlausMin_C DFC_CtlMsk.DFC_NSCDsNOxSRCMax_C DFC_CtlMsk.DFC_NSCDsNOxSRCMin_C DFC_CtlMsk.DFC_NSCDsOpCir_C DFC_CtlMsk.DFC_NSCDsShCir_C DFC_CtlMsk.DFC_NoCat2DsCmpChk_C DFC_CtlMsk.DFC_NoCat2DsLamBinSRCMax_C DFC_CtlMsk.DFC_NoCat2DsLamBinSRCMin_C DFC_CtlMsk.DFC_NoCat2DsLamLinSRCMax_C DFC_CtlMsk.DFC_NoCat2DsLamLinSRCMin_C DFC_CtlMsk.DFC_NoCat2DsLamPlausMax_C DFC_CtlMsk.DFC_NoCat2DsLamPlausMin_C DFC_CtlMsk.DFC_NoCat2DsNOxSRCMax_C DFC_CtlMsk.DFC_NoCat2DsNOxSRCMin_C DFC_CtlMsk.DFC_NoCat2DsOpCir_C DFC_CtlMsk.DFC_NoCat2DsShCir_C DFC_CtlMsk.DFC_NplDynPPFltDiff_C DFC_CtlMsk.DFC_NplHsChngPPFltDiff_C DFC_CtlMsk.DFC_NplHsLnPPFltDiff_C DFC_CtlMsk.DFC_NplTOxiCatUs_C DFC_CtlMsk.DFC_NplTPFltUs_C DFC_CtlMsk.DFC_NplTTrbnUs_C DFC_CtlMsk.DFC_OilPSwmpSRCMax_C DFC_CtlMsk.DFC_OilPSwmpSRCMin_C DFC_CtlMsk.DFC_PCVSCG_C DFC_CtlMsk.DFC_PFltCharPDiffMin_C DFC_CtlMsk.DFC_PFltDstrMin_C DFC_CtlMsk.DFC_PFltEngPrt_C DFC_CtlMsk.DFC_PFltRgnPerm_C DFC_CtlMsk.DFC_PFltSRCMaxFlwRstn_C DFC_CtlMsk.DFC_PFltSRCMinFlwRstn_C DFC_CtlMsk.DFC_PFltSotMsDvtMax_C DFC_CtlMsk.DFC_PFltSotMsDvtMin_C DFC_CtlMsk.DFC_PFltSotMsMax_C DFC_CtlMsk.DFC_PIntkVUsSRCMax_C DFC_CtlMsk.DFC_PIntkVUsSRCMin_C DFC_CtlMsk.DFC_SRCHighAPP1_C DFC_CtlMsk.DFC_SRCHighAPP2_C DFC_CtlMsk.DFC_SRCLowAPP1_C DFC_CtlMsk.DFC_SRCLowAPP2_C DFC_CtlMsk.DFC_SRCMaxPPFltDiff_C DFC_CtlMsk.DFC_SRCMaxPPFltUs_C DFC_CtlMsk.DFC_SRCMaxTECU_C DFC_CtlMsk.DFC_SRCMaxTOxiCatUs_C DFC_CtlMsk.DFC_SRCMaxTPFltUs_C DFC_CtlMsk.DFC_SRCMaxTTrbnUs_C DFC_CtlMsk.DFC_SRCMaxUCatUsT_C DFC_CtlMsk.DFC_SRCMaxUPmpP_C DFC_CtlMsk.DFC_SRCMinPPFltDiff_C DFC_CtlMsk.DFC_SRCMinPPFltUs_C DFC_CtlMsk.DFC_SRCMinTECU_C DFC_CtlMsk.DFC_SRCMinTOxiCatUs_C DFC_CtlMsk.DFC_SRCMinTPFltUs_C DFC_CtlMsk.DFC_SRCMinTTrbnUs_C DFC_CtlMsk.DFC_SRCMinUCatUsT_C DFC_CtlMsk.DFC_SRCMinUPmpP_C DFC_CtlMsk.DFC_SigUCatUsT_C DFC_CtlMsk.DFC_SigUPmpP_C DFC_CtlMsk.DFC_SyncAPP_C DFC_CtlMsk.DFC_T15Npl_C DFC_CtlMsk.DFC_TAFSDtyCycHi_C DFC_CtlMsk.DFC_TAFSDtyCycLo_C DFC_CtlMsk.DFC_TAFSPerHi_C DFC_CtlMsk.DFC_TAFSPerLo_C /end DEF_CHARACTERISTIC
 /begin OUT_MEASUREMENT DFC_st.DFC_EGRVlvLPShTDrft DFC_st.DFC_EGRVlvLgTDrft DFC_st.DFC_EGRVlvOfsLrnJamVlv DFC_st.DFC_EGRVlvShTDrft DFC_st.DFC_EngICO DFC_st.DFC_EpmCaSI1ErrSig DFC_st.DFC_EpmCaSI1NoSig DFC_st.DFC_EpmCaSI1OfsErr DFC_st.DFC_EpmCrSErrSig DFC_st.DFC_EpmCrSNoSig DFC_st.DFC_IVPlausComprTst DFC_st.DFC_IVPlausRunUpTst DFC_st.DFC_InjCrvShOffTst DFC_st.DFC_LayerEnSavModProd DFC_st.DFC_LayerEnSavModRep DFC_st.DFC_LayerEnSavModShip DFC_st.DFC_MRlyErlyOpng DFC_st.DFC_MRlyStk DFC_st.DFC_MeUnActrTst DFC_st.DFC_MoCADCCmp DFC_st.DFC_MoCADCTst DFC_st.DFC_MoCADCVltgRatio DFC_st.DFC_MoCComErrCnt DFC_st.DFC_MoCComSPI DFC_st.DFC_MoCROMErrXPg DFC_st.DFC_MoCSOPHwNoRdy DFC_st.DFC_MoCSOPLoLi DFC_st.DFC_MoCSOPMM DFC_st.DFC_MoCSOPTimeOut DFC_st.DFC_MoCSOPUpLi DFC_st.DFC_MoFAPP DFC_st.DFC_MoFESpd DFC_st.DFC_MoFInjDatPhi DFC_st.DFC_MoFInjDatQnt DFC_st.DFC_MoFInjQnt DFC_st.DFC_MoFMode1PoI1 DFC_st.DFC_MoFMode1PoI2 DFC_st.DFC_MoFMode2PoI1 DFC_st.DFC_MoFMode2PoI2 DFC_st.DFC_MoFOvR DFC_st.DFC_MoFQntCor DFC_st.DFC_MoFRailP DFC_st.DFC_MoFTrqCmp DFC_st.DFC_NSCDsHtrSetP DFC_st.DFC_NoCat2DsHtrSetP DFC_st.DFC_PCVActrTst DFC_st.DFC_PhyModNonMonMapNpl DFC_st.DFC_RailHpTst DFC_st.DFC_RailPOfsTstMax DFC_st.DFC_RailPOfsTstMin DFC_st.DFC_SIA_E1max DFC_st.DFC_SIA_E1min DFC_st.DFC_SIA_E1npl DFC_st.DFC_SIA_E1sig DFC_st.DFC_SIA_E2max DFC_st.DFC_SIA_E2min DFC_st.DFC_SIA_E2npl DFC_st.DFC_SIA_E2sig DFC_st.DFC_SIA_E3max DFC_st.DFC_SIA_E3min DFC_st.DFC_SIA_E3npl DFC_st.DFC_SIA_E3sig DFC_st.DFC_SIA_E4max DFC_st.DFC_SIA_E4min DFC_st.DFC_SIA_E4npl DFC_st.DFC_SIA_E4sig DFC_st.DFC_SWReset_0 DFC_st.DFC_SWReset_1 DFC_st.DFC_SWReset_2 DFC_st.DFC_ShtrAKKMax DFC_st.DFC_ShtrAKKMin DFC_st.DFC_ShtrAKKNpl DFC_st.DFC_ShtrPKKMax DFC_st.DFC_StopCntTmr DFC_st.DFC_ThrVlvMon DFC_st.DFC_VSwVlvJamVlv DFC_st.DFC_VSwVlvLgTDrft DFC_st.DFC_VSwVlvOfsLrnJamVlv DFC_st.DFC_VSwVlvOfsNeutr DFC_st.DFC_VSwVlvShTDrft DFC_st.DFC_VSwVlvSpgDef DSQ_st.DSQ_AFS DSQ_st.DSQ_AFS_SSpShOffActr DSQ_st.DSQ_AirCCmprActr DSQ_st.DSQ_BattU DSQ_st.DSQ_BrkP DSQ_st.DSQ_CByVlvActr DSQ_st.DSQ_CEngDsT DSQ_st.DSQ_CThmstActr DSQ_st.DSQ_Com_aDirect DSQ_st.DSQ_Com_aSide DSQ_st.DSQ_Com_ctrDay DSQ_st.DSQ_Com_ctrSec DSQ_st.DSQ_Com_ctrSecAbs DSQ_st.DSQ_Com_dDay DSQ_st.DSQ_Com_dMonth DSQ_st.DSQ_Com_dYear DSQ_st.DSQ_Com_dphiStWhlAg DSQ_st.DSQ_Com_dvolPspDes DSQ_st.DSQ_Com_iHiLimCurr DSQ_st.DSQ_Com_iLoLimCurr DSQ_st.DSQ_Com_iPsp DSQ_st.DSQ_Com_iZrLimCurr DSQ_st.DSQ_Com_idParkConsumer DSQ_st.DSQ_Com_idVerbraucher DSQ_st.DSQ_Com_lFlTnkQntLow DSQ_st.DSQ_Com_lSum DSQ_st.DSQ_Com_nDKG DSQ_st.DSQ_Com_nGbxOut DSQ_st.DSQ_Com_nPsp DSQ_st.DSQ_Com_nRqIdlg DSQ_st.DSQ_Com_nTSC DSQ_st.DSQ_Com_nWhl DSQ_st.DSQ_Com_nWhlFL DSQ_st.DSQ_Com_nWhlFR DSQ_st.DSQ_Com_nWhlRL DSQ_st.DSQ_Com_nWhlRR DSQ_st.DSQ_Com_pBrkSys DSQ_st.DSQ_Com_phiStWhlAg DSQ_st.DSQ_Com_rACFanDem DSQ_st.DSQ_Com_rHtFlowReq DSQ_st.DSQ_Com_rLamLinRecGndRaw DSQ_st.DSQ_Com_rLamLinRecUbattRaw DSQ_st.DSQ_Com_rNOxCat2DsGndRaw DSQ_st.DSQ_Com_rNOxCat2DsUbattRaw DSQ_st.DSQ_Com_rPspSetPoint DSQ_st.DSQ_Com_rPwrSpCons DSQ_st.DSQ_Com_rTrq DSQ_st.DSQ_Com_stAC DSQ_st.DSQ_Com_stACEFan DSQ_st.DSQ_Com_stARS DSQ_st.DSQ_Com_stAcpd DSQ_st.DSQ_Com_stBattClass DSQ_st.DSQ_Com_stBonnet DSQ_st.DSQ_Com_stBrkTrqDVCHQl DSQ_st.DSQ_Com_stButtonMSA DSQ_st.DSQ_Com_stCat2DsGndRaw DSQ_st.DSQ_Com_stCat2DsUbattRaw DSQ_st.DSQ_Com_stClCtr DSQ_st.DSQ_Com_stClassPwr DSQ_st.DSQ_Com_stClth DSQ_st.DSQ_Com_stClthOpen DSQ_st.DSQ_Com_stClthRaw DSQ_st.DSQ_Com_stCrCtlKombi DSQ_st.DSQ_Com_stCrCtlLvr DSQ_st.DSQ_Com_stDSC DSQ_st.DSQ_Com_stDecellDSC DSQ_st.DSQ_Com_stDiagPsp DSQ_st.DSQ_Com_stDoorDriver DSQ_st.DSQ_Com_stDrWghSeat DSQ_st.DSQ_Com_stDrvAssist DSQ_st.DSQ_Com_stDrvDyn DSQ_st.DSQ_Com_stDrvPrgQl DSQ_st.DSQ_Com_stDynDisp DSQ_st.DSQ_Com_stEngStop DSQ_st.DSQ_Com_stErrAFS DSQ_st.DSQ_Com_stErrStrg DSQ_st.DSQ_Com_stFlTnkQntRes DSQ_st.DSQ_Com_stFolDyn DSQ_st.DSQ_Com_stGbxOBD DSQ_st.DSQ_Com_stGear DSQ_st.DSQ_Com_stGearBck DSQ_st.DSQ_Com_stHDC DSQ_st.DSQ_Com_stKeyVld DSQ_st.DSQ_Com_stLckGbxDemQl DSQ_st.DSQ_Com_stLmpPrkBrk DSQ_st.DSQ_Com_stMSALmp DSQ_st.DSQ_Com_stModDKG DSQ_st.DSQ_Com_stNOxErrGndRaw DSQ_st.DSQ_Com_stNOxErrUbattRaw DSQ_st.DSQ_Com_stPBrComf DSQ_st.DSQ_Com_stPBrHold DSQ_st.DSQ_Com_stPBrHyd DSQ_st.DSQ_Com_stPBrkSysQl DSQ_st.DSQ_Com_stPHtr DSQ_st.DSQ_Com_stParkConsumer DSQ_st.DSQ_Com_stPsp DSQ_st.DSQ_Com_stPspCntr DSQ_st.DSQ_Com_stRaceStrt DSQ_st.DSQ_Com_stReqMSA DSQ_st.DSQ_Com_stRevGear DSQ_st.DSQ_Com_stSTEQl DSQ_st.DSQ_Com_stSeason DSQ_st.DSQ_Com_stShftIdctrDemRglX DSQ_st.DSQ_Com_stShiftPdl DSQ_st.DSQ_Com_stShutOffPSP DSQ_st.DSQ_Com_stSleepBus DSQ_st.DSQ_Com_stSleepConst DSQ_st.DSQ_Com_stSleepDest DSQ_st.DSQ_Com_stSleepRdy DSQ_st.DSQ_Com_stStrg DSQ_st.DSQ_Com_stStrtClth DSQ_st.DSQ_Com_stStrtLck DSQ_st.DSQ_Com_stT15 DSQ_st.DSQ_Com_stT15Hw DSQ_st.DSQ_Com_stT50 DSQ_st.DSQ_Com_stTRadio DSQ_st.DSQ_Com_stTSC DSQ_st.DSQ_Com_stTerminal DSQ_st.DSQ_Com_stTrailer DSQ_st.DSQ_Com_stTrqAFS DSQ_st.DSQ_Com_stTrqDSCDes DSQ_st.DSQ_Com_stTrqFil DSQ_st.DSQ_Com_stTrqGbxDes DSQ_st.DSQ_Com_stTrqGbxLim DSQ_st.DSQ_Com_stTrqStbDesQl DSQ_st.DSQ_Com_stTrqStrg DSQ_st.DSQ_Com_stTrqWhl DSQ_st.DSQ_Com_stTrqWhlDemFASQl DSQ_st.DSQ_Com_stTrqWhlDesQl DSQ_st.DSQ_Com_stTypBody DSQ_st.DSQ_Com_stUnVel DSQ_st.DSQ_Com_stVehCond DSQ_st.DSQ_Com_stVehDrvCond DSQ_st.DSQ_Com_stVerbraucher DSQ_st.DSQ_Com_stphiStWhlAg DSQ_st.DSQ_Com_swtAC DSQ_st.DSQ_Com_swtDrBltb DSQ_st.DSQ_Com_tEnvT DSQ_st.DSQ_Com_tGbxOil DSQ_st.DSQ_Com_tiPostRunPwrSpl DSQ_st.DSQ_Com_trqAC DSQ_st.DSQ_Com_trqAFS DSQ_st.DSQ_Com_trqAFSDes DSQ_st.DSQ_Com_trqARSCur DSQ_st.DSQ_Com_trqARSDes DSQ_st.DSQ_Com_trqAdjrDKG DSQ_st.DSQ_Com_trqBrkDVCH DSQ_st.DSQ_Com_trqClthDKG DSQ_st.DSQ_Com_trqDSCDes DSQ_st.DSQ_Com_trqDVCHRise DSQ_st.DSQ_Com_trqGbxDes DSQ_st.DSQ_Com_trqGbxFrc DSQ_st.DSQ_Com_trqGbxMax DSQ_st.DSQ_Com_trqGbxMaxRaw DSQ_st.DSQ_Com_trqStbDes DSQ_st.DSQ_Com_trqStrg DSQ_st.DSQ_Com_trqStrgDes DSQ_st.DSQ_Com_trqTarDKG DSQ_st.DSQ_Com_trqTarDrvDyn DSQ_st.DSQ_Com_trqTarDrvDynDes DSQ_st.DSQ_Com_trqTarDrvDynMax DSQ_st.DSQ_Com_trqWhlDes DSQ_st.DSQ_Com_uLamBinGndRaw DSQ_st.DSQ_Com_uLamBinUbattRaw DSQ_st.DSQ_Com_uPsp DSQ_st.DSQ_Com_uT30Psp DSQ_st.DSQ_Com_v DSQ_st.DSQ_Com_vBd DSQ_st.DSQ_Com_vDspl DSQ_st.DSQ_Com_vVeh DSQ_st.DSQ_Com_volFlTnkQnt DSQ_st.DSQ_Com_volFlTnkQntLH DSQ_st.DSQ_Com_volFlTnkQntRH DSQ_st.DSQ_DSMInhibitAlways DSQ_st.DSQ_EBxFan DSQ_st.DSQ_ECBVlvActr DSQ_st.DSQ_ECBVlvSens DSQ_st.DSQ_EGRVlvActr DSQ_st.DSQ_EGRVlvLPActr DSQ_st.DSQ_EGRVlvLPSens DSQ_st.DSQ_EGRVlvSens DSQ_st.DSQ_EMDmp_0 DSQ_st.DSQ_EMDmp_1 DSQ_st.DSQ_EngPrtFWOsc DSQ_st.DSQ_EngStAActr DSQ_st.DSQ_EnvP DSQ_st.DSQ_EnvT DSQ_st.DSQ_ErrLmpActrMIL DSQ_st.DSQ_ErrLmpActrSVS DSQ_st.DSQ_FanActr DSQ_st.DSQ_FlFltDsP DSQ_st.DSQ_FlFltHtActr DSQ_st.DSQ_FlFltUsP DSQ_st.DSQ_FuelLvl_vol DSQ_st.DSQ_FuelT DSQ_st.DSQ_GbxNPosPls DSQ_st.DSQ_IVDiast DSQ_st.DSQ_InjVlvInjCo DSQ_st.DSQ_InjVlvPresMin DSQ_st.DSQ_LAYER2EDCMSAStp DSQ_st.DSQ_LSUO2 DSQ_st.DSQ_Layer_rCtrPwrSpCos DSQ_st.DSQ_MRly DSQ_st.DSQ_MeUnActr DSQ_st.DSQ_NSCDsRLamO2 DSQ_st.DSQ_NoCat2DsO2Val DSQ_st.DSQ_O2ValNSCDs DSQ_st.DSQ_O2ValNoCat2Ds DSQ_st.DSQ_OilPSwmp DSQ_st.DSQ_PCVActr DSQ_st.DSQ_PIntkVUs DSQ_st.DSQ_PPFltDiff DSQ_st.DSQ_PPFltUs DSQ_st.DSQ_RailShutOffDblCtl DSQ_st.DSQ_RailShutOffMeUnCtl DSQ_st.DSQ_SOPTstInjShOff DSQ_st.DSQ_ShtrActr DSQ_st.DSQ_StrtActr DSQ_st.DSQ_TAFS DSQ_st.DSQ_TCACDs DSQ_st.DSQ_TECU DSQ_st.DSQ_TOxiCatUs DSQ_st.DSQ_TPFltUs DSQ_st.DSQ_TTrbnUs DSQ_st.DSQ_ThrVlvActr DSQ_st.DSQ_ThrVlvSens DSQ_st.DSQ_TrbChActr DSQ_st.DSQ_TrbChLPActr DSQ_st.DSQ_TrbChSens DSQ_st.DSQ_TrbnDsRLamO2 DSQ_st.DSQ_UCatUsT DSQ_st.DSQ_UDosVlvActr DSQ_st.DSQ_UHtrPL DSQ_st.DSQ_UHtrPLDia DSQ_st.DSQ_UHtrTnk DSQ_st.DSQ_UHtrTnkDia DSQ_st.DSQ_UPmpMotActr DSQ_st.DSQ_UPmpP DSQ_st.DSQ_URevVlv DSQ_st.DSQ_UTnkLvl DSQ_st.DSQ_UTnkT DSQ_st.DSQ_VSwVlvActr DSQ_st.DSQ_VSwVlvSens DSQ_st.DSQ_WaHtElActr DSQ_st.DSQ_stAPP DSQ_st.DSQ_stAPP1 DSQ_st.DSQ_stAPP2 DSQ_st.DSQ_stLSUSrvTstDem DSQ_st.DSQ_stSrvOpLSUAdap /end OUT_MEASUREMENT
 /begin LOC_MEASUREMENT DFC_ctLDF_mp DFC_stClctFault_mp DFC_stClctTst_mp DSQ_stClct_mp /end LOC_MEASUREMENT
/end FUNCTION
/begin COMPU_METHOD DFC_OneToOne "" RAT_FUNC "%6.0" "-" COEFFS 0 1 0 0 0 1 /end COMPU_METHOD
/begin COMPU_METHOD DFES_OneToOne "" RAT_FUNC "%6.0" "-" COEFFS 0 1 0 0 0 1 /end COMPU_METHOD
/begin COMPU_METHOD OneToOne "" RAT_FUNC "%6.0" "-" COEFFS 0 1 0 0 0 1 /end COMPU_METHOD
/begin RECORD_LAYOUT Val_Wu16 FNC_VALUES 1 UWORD COLUMN_DIR DIRECT /end RECORD_LAYOUT
/end MODULE
/end PROJECT

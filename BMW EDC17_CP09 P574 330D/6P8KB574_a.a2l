ASAP2_VERSION 1 4
/begin PROJECT P_574 "EDC17_CP09"
/begin HEADER "" VERSION "V8KB" PROJECT_NO P_574 /end HEADER
/begin MODULE DIM ""
/begin MOD_COMMON "" BYTE_ORDER MSB_LAST ALIGNMENT_BYTE 1 ALIGNMENT_WORD 2 ALIGNMENT_LONG 4 ALIGNMENT_FLOAT32_IEEE 4 /end MOD_COMMON
/begin CHARACTERISTIC DINH_FId.DFC_NSCDsLamPlausMax_CA "DINH/Zugeordnete FId für Verriegelungsquelle DFC_NSCDsLamPlausMax" VAL_BLK 0x80024A16 ValA_Wu16 688. DINH_FIdVerb 0.00 688. FORMAT "%2.0" NUMBER 2 /end CHARACTERISTIC
/begin CHARACTERISTIC DINH_FId.DFC_NSCDsLamPlausMin_CA "DINH/Zugeordnete FId für Verriegelungsquelle DFC_NSCDsLamPlausMin" VAL_BLK 0x80024A1A ValA_Wu16 688. DINH_FIdVerb 0.00 688. FORMAT "%2.0" NUMBER 2 /end CHARACTERISTIC
/begin CHARACTERISTIC DINH_FId.DFC_NSCDsNOxSRCMax_CA "DINH/Zugeordnete FId für Verriegelungsquelle DFC_NSCDsNOxSRCMax" VAL_BLK 0x80024A1E ValA_Wu16 688. DINH_FIdVerb 0.00 688. FORMAT "%2.0" NUMBER 2 /end CHARACTERISTIC
/begin CHARACTERISTIC DINH_FId.DFC_NSCDsNOxSRCMin_CA "DINH/Zugeordnete FId für Verriegelungsquelle DFC_NSCDsNOxSRCMin" VAL_BLK 0x80024A22 ValA_Wu16 688. DINH_FIdVerb 0.00 688. FORMAT "%2.0" NUMBER 2 /end CHARACTERISTIC
/begin CHARACTERISTIC DINH_FId.DFC_NSCDsOpCir_CA "DINH/Zugeordnete FId für Verriegelungsquelle DFC_NSCDsOpCir" VAL_BLK 0x80024A26 ValA_Wu16 688. DINH_FIdVerb 0.00 688. FORMAT "%2.0" NUMBER 6 /end CHARACTERISTIC
/begin CHARACTERISTIC DINH_FId.DFC_NSCDsShCir_CA "DINH/Zugeordnete FId für Verriegelungsquelle DFC_NSCDsShCir" VAL_BLK 0x80024A32 ValA_Wu16 688. DINH_FIdVerb 0.00 688. FORMAT "%2.0" NUMBER 6 /end CHARACTERISTIC
/begin CHARACTERISTIC DINH_FId.DFC_NoCat2DsCmpChk_CA "DINH/Zugeordnete FId für Verriegelungsquelle DFC_NoCat2DsCmpChk" VAL_BLK 0x80024A3E ValA_Wu16 688. DINH_FIdVerb 0.00 688. FORMAT "%2.0" NUMBER 2 /end CHARACTERISTIC
/begin CHARACTERISTIC DINH_FId.DFC_NoCat2DsLamBinSRCMax_CA "DINH/Zugeordnete FId für Verriegelungsquelle DFC_NoCat2DsLamBinSRCMax" VAL_BLK 0x80024A42 ValA_Wu16 688. DINH_FIdVerb 0.00 688. FORMAT "%2.0" NUMBER 2 /end CHARACTERISTIC
/begin CHARACTERISTIC DINH_FId.DFC_NoCat2DsLamBinSRCMin_CA "DINH/Zugeordnete FId für Verriegelungsquelle DFC_NoCat2DsLamBinSRCMin" VAL_BLK 0x80024A46 ValA_Wu16 688. DINH_FIdVerb 0.00 688. FORMAT "%2.0" NUMBER 2 /end CHARACTERISTIC
/begin CHARACTERISTIC DINH_FId.DFC_NoCat2DsLamLinSRCMax_CA "DINH/Zugeordnete FId für Verriegelungsquelle DFC_NoCat2DsLamLinSRCMax" VAL_BLK 0x80024A4A ValA_Wu16 688. DINH_FIdVerb 0.00 688. FORMAT "%2.0" NUMBER 2 /end CHARACTERISTIC
/begin CHARACTERISTIC DINH_FId.DFC_NoCat2DsLamLinSRCMin_CA "DINH/Zugeordnete FId für Verriegelungsquelle DFC_NoCat2DsLamLinSRCMin" VAL_BLK 0x80024A4E ValA_Wu16 688. DINH_FIdVerb 0.00 688. FORMAT "%2.0" NUMBER 2 /end CHARACTERISTIC
/begin CHARACTERISTIC DINH_FId.DFC_NoCat2DsLamPlausMax_CA "DINH/Zugeordnete FId für Verriegelungsquelle DFC_NoCat2DsLamPlausMax" VAL_BLK 0x80024A52 ValA_Wu16 688. DINH_FIdVerb 0.00 688. FORMAT "%2.0" NUMBER 2 /end CHARACTERISTIC
/begin CHARACTERISTIC DINH_FId.DFC_NoCat2DsLamPlausMin_CA "DINH/Zugeordnete FId für Verriegelungsquelle DFC_NoCat2DsLamPlausMin" VAL_BLK 0x80024A56 ValA_Wu16 688. DINH_FIdVerb 0.00 688. FORMAT "%2.0" NUMBER 2 /end CHARACTERISTIC
/begin CHARACTERISTIC DINH_FId.DFC_NoCat2DsNOxSRCMax_CA "DINH/Zugeordnete FId für Verriegelungsquelle DFC_NoCat2DsNOxSRCMax" VAL_BLK 0x80024A5A ValA_Wu16 688. DINH_FIdVerb 0.00 688. FORMAT "%2.0" NUMBER 2 /end CHARACTERISTIC
/begin CHARACTERISTIC DINH_FId.DFC_NoCat2DsNOxSRCMin_CA "DINH/Zugeordnete FId für Verriegelungsquelle DFC_NoCat2DsNOxSRCMin" VAL_BLK 0x80024A5E ValA_Wu16 688. DINH_FIdVerb 0.00 688. FORMAT "%2.0" NUMBER 2 /end CHARACTERISTIC
/begin CHARACTERISTIC DINH_FId.DFC_NoCat2DsOpCir_CA "DINH/Zugeordnete FId für Verriegelungsquelle DFC_NoCat2DsOpCir" VAL_BLK 0x80024A62 ValA_Wu16 688. DINH_FIdVerb 0.00 688. FORMAT "%2.0" NUMBER 6 /end CHARACTERISTIC
/begin CHARACTERISTIC DINH_FId.DFC_NoCat2DsShCir_CA "DINH/Zugeordnete FId für Verriegelungsquelle DFC_NoCat2DsShCir" VAL_BLK 0x80024A6E ValA_Wu16 688. DINH_FIdVerb 0.00 688. FORMAT "%2.0" NUMBER 6 /end CHARACTERISTIC
/begin CHARACTERISTIC DINH_FId.DFC_NplDynPPFltDiff_CA "DINH/Zugeordnete FId für Verriegelungsquelle DFC_NplDynPPFltDiff" VAL_BLK 0x80024A7A ValA_Wu16 688. DINH_FIdVerb 0.00 688. FORMAT "%2.0" NUMBER 9 /end CHARACTERISTIC
/begin CHARACTERISTIC DINH_FId.DFC_NplHsChngPPFltDiff_CA "DINH/Zugeordnete FId für Verriegelungsquelle DFC_NplHsChngPPFltDiff" VAL_BLK 0x80024A8C ValA_Wu16 688. DINH_FIdVerb 0.00 688. FORMAT "%2.0" NUMBER 7 /end CHARACTERISTIC
/begin CHARACTERISTIC DINH_FId.DFC_NplHsLnPPFltDiff_CA "DINH/Zugeordnete FId für Verriegelungsquelle DFC_NplHsLnPPFltDiff" VAL_BLK 0x80024A9A ValA_Wu16 688. DINH_FIdVerb 0.00 688. FORMAT "%2.0" NUMBER 12 /end CHARACTERISTIC
/begin CHARACTERISTIC DINH_FId.DFC_NplTOxiCatUs_CA "DINH/Zugeordnete FId für Verriegelungsquelle DFC_NplTOxiCatUs" VAL_BLK 0x80024AB2 ValA_Wu16 688. DINH_FIdVerb 0.00 688. FORMAT "%2.0" NUMBER 10 /end CHARACTERISTIC
/begin CHARACTERISTIC DINH_FId.DFC_NplTPFltUs_CA "DINH/Zugeordnete FId für Verriegelungsquelle DFC_NplTPFltUs" VAL_BLK 0x80024AC6 ValA_Wu16 688. DINH_FIdVerb 0.00 688. FORMAT "%2.0" NUMBER 9 /end CHARACTERISTIC
/begin CHARACTERISTIC DINH_FId.DFC_NplTTrbnUs_CA "DINH/Zugeordnete FId für Verriegelungsquelle DFC_NplTTrbnUs" VAL_BLK 0x80024AD8 ValA_Wu16 688. DINH_FIdVerb 0.00 688. FORMAT "%2.0" NUMBER 4 /end CHARACTERISTIC
/begin CHARACTERISTIC DINH_FId.DFC_OilPSwmpSRCMax_CA "DINH/Zugeordnete FId für Verriegelungsquelle DFC_OilPSwmpSRCMax" VAL_BLK 0x80024AE0 ValA_Wu16 688. DINH_FIdVerb 0.00 688. FORMAT "%2.0" NUMBER 3 /end CHARACTERISTIC
/begin CHARACTERISTIC DINH_FId.DFC_OilPSwmpSRCMin_CA "DINH/Zugeordnete FId für Verriegelungsquelle DFC_OilPSwmpSRCMin" VAL_BLK 0x80024AE6 ValA_Wu16 688. DINH_FIdVerb 0.00 688. FORMAT "%2.0" NUMBER 3 /end CHARACTERISTIC
/begin CHARACTERISTIC DINH_FId.DFC_PCVSCG_CA "DINH/Zugeordnete FId für Verriegelungsquelle DFC_PCVSCG" VAL_BLK 0x80024AEC ValA_Wu16 688. DINH_FIdVerb 0.00 688. FORMAT "%2.0" NUMBER 9 /end CHARACTERISTIC
/begin CHARACTERISTIC DINH_FId.DFC_PFltCharPDiffMin_CA "DINH/Zugeordnete FId für Verriegelungsquelle DFC_PFltCharPDiffMin" VAL_BLK 0x80024AFE ValA_Wu16 688. DINH_FIdVerb 0.00 688. FORMAT "%2.0" NUMBER 7 /end CHARACTERISTIC
/begin CHARACTERISTIC DINH_FId.DFC_PFltDstrMin_CA "DINH/Zugeordnete FId für Verriegelungsquelle DFC_PFltDstrMin" VAL_BLK 0x80024B0C ValA_Wu16 688. DINH_FIdVerb 0.00 688. FORMAT "%2.0" NUMBER 7 /end CHARACTERISTIC
/begin CHARACTERISTIC DINH_FId.DFC_PFltEngPrt_CA "DINH/Zugeordnete FId für Verriegelungsquelle DFC_PFltEngPrt" VAL_BLK 0x80024B1A ValA_Wu16 688. DINH_FIdVerb 0.00 688. FORMAT "%2.0" NUMBER 7 /end CHARACTERISTIC
/begin CHARACTERISTIC DINH_FId.DFC_PFltRgnPerm_CA "DINH/Zugeordnete FId für Verriegelungsquelle DFC_PFltRgnPerm" VAL_BLK 0x80024B28 ValA_Wu16 688. DINH_FIdVerb 0.00 688. FORMAT "%2.0" NUMBER 7 /end CHARACTERISTIC
/begin CHARACTERISTIC DINH_FId.DFC_PFltSRCMaxFlwRstn_CA "DINH/Zugeordnete FId für Verriegelungsquelle DFC_PFltSRCMaxFlwRstn" VAL_BLK 0x80024B36 ValA_Wu16 688. DINH_FIdVerb 0.00 688. FORMAT "%2.0" NUMBER 8 /end CHARACTERISTIC
/begin CHARACTERISTIC DINH_FId.DFC_PFltSRCMinFlwRstn_CA "DINH/Zugeordnete FId für Verriegelungsquelle DFC_PFltSRCMinFlwRstn" VAL_BLK 0x80024B46 ValA_Wu16 688. DINH_FIdVerb 0.00 688. FORMAT "%2.0" NUMBER 8 /end CHARACTERISTIC
/begin CHARACTERISTIC DINH_FId.DFC_PFltSotMsDvtMax_CA "DINH/Zugeordnete FId für Verriegelungsquelle DFC_PFltSotMsDvtMax" VAL_BLK 0x80024B56 ValA_Wu16 688. DINH_FIdVerb 0.00 688. FORMAT "%2.0" NUMBER 7 /end CHARACTERISTIC
/begin CHARACTERISTIC DINH_FId.DFC_PFltSotMsDvtMin_CA "DINH/Zugeordnete FId für Verriegelungsquelle DFC_PFltSotMsDvtMin" VAL_BLK 0x80024B64 ValA_Wu16 688. DINH_FIdVerb 0.00 688. FORMAT "%2.0" NUMBER 7 /end CHARACTERISTIC
/begin CHARACTERISTIC DINH_FId.DFC_PFltSotMsMax_CA "DINH/Zugeordnete FId für Verriegelungsquelle DFC_PFltSotMsMax" VAL_BLK 0x80024B72 ValA_Wu16 688. DINH_FIdVerb 0.00 688. FORMAT "%2.0" NUMBER 7 /end CHARACTERISTIC
/begin CHARACTERISTIC DINH_FId.DFC_PIntkVUsSRCMax_CA "DINH/Zugeordnete FId für Verriegelungsquelle DFC_PIntkVUsSRCMax" VAL_BLK 0x80024B80 ValA_Wu16 688. DINH_FIdVerb 0.00 688. FORMAT "%2.0" NUMBER 4 /end CHARACTERISTIC
/begin CHARACTERISTIC DINH_FId.DFC_PIntkVUsSRCMin_CA "DINH/Zugeordnete FId für Verriegelungsquelle DFC_PIntkVUsSRCMin" VAL_BLK 0x80024B88 ValA_Wu16 688. DINH_FIdVerb 0.00 688. FORMAT "%2.0" NUMBER 4 /end CHARACTERISTIC
/begin CHARACTERISTIC DINH_FId.DFC_SRCHighAPP1_CA "DINH/Zugeordnete FId für Verriegelungsquelle DFC_SRCHighAPP1" VAL_BLK 0x80024B90 ValA_Wu16 688. DINH_FIdVerb 0.00 688. FORMAT "%2.0" NUMBER 8 /end CHARACTERISTIC
/begin CHARACTERISTIC DINH_FId.DFC_SRCHighAPP2_CA "DINH/Zugeordnete FId für Verriegelungsquelle DFC_SRCHighAPP2" VAL_BLK 0x80024BA0 ValA_Wu16 688. DINH_FIdVerb 0.00 688. FORMAT "%2.0" NUMBER 8 /end CHARACTERISTIC
/begin CHARACTERISTIC DINH_FId.DFC_SRCLowAPP1_CA "DINH/Zugeordnete FId für Verriegelungsquelle DFC_SRCLowAPP1" VAL_BLK 0x80024BB0 ValA_Wu16 688. DINH_FIdVerb 0.00 688. FORMAT "%2.0" NUMBER 7 /end CHARACTERISTIC
/begin CHARACTERISTIC DINH_FId.DFC_SRCLowAPP2_CA "DINH/Zugeordnete FId für Verriegelungsquelle DFC_SRCLowAPP2" VAL_BLK 0x80024BBE ValA_Wu16 688. DINH_FIdVerb 0.00 688. FORMAT "%2.0" NUMBER 7 /end CHARACTERISTIC
/begin CHARACTERISTIC DINH_FId.DFC_SRCMaxPPFltDiff_CA "DINH/Zugeordnete FId für Verriegelungsquelle DFC_SRCMaxPPFltDiff" VAL_BLK 0x80024BCC ValA_Wu16 688. DINH_FIdVerb 0.00 688. FORMAT "%2.0" NUMBER 14 /end CHARACTERISTIC
/begin CHARACTERISTIC DINH_FId.DFC_SRCMaxPPFltUs_CA "DINH/Zugeordnete FId für Verriegelungsquelle DFC_SRCMaxPPFltUs" VAL_BLK 0x80024BE8 ValA_Wu16 688. DINH_FIdVerb 0.00 688. FORMAT "%2.0" NUMBER 14 /end CHARACTERISTIC
/begin CHARACTERISTIC DINH_FId.DFC_SRCMaxTECU_CA "DINH/Zugeordnete FId für Verriegelungsquelle DFC_SRCMaxTECU" VAL_BLK 0x80024C04 ValA_Wu16 688. DINH_FIdVerb 0.00 688. FORMAT "%2.0" NUMBER 9 /end CHARACTERISTIC
/begin CHARACTERISTIC DINH_FId.DFC_SRCMaxTOxiCatUs_CA "DINH/Zugeordnete FId für Verriegelungsquelle DFC_SRCMaxTOxiCatUs" VAL_BLK 0x80024C16 ValA_Wu16 688. DINH_FIdVerb 0.00 688. FORMAT "%2.0" NUMBER 12 /end CHARACTERISTIC
/begin CHARACTERISTIC DINH_FId.DFC_SRCMaxTPFltUs_CA "DINH/Zugeordnete FId für Verriegelungsquelle DFC_SRCMaxTPFltUs" VAL_BLK 0x80024C2E ValA_Wu16 688. DINH_FIdVerb 0.00 688. FORMAT "%2.0" NUMBER 18 /end CHARACTERISTIC
/begin CHARACTERISTIC DINH_FId.DFC_SRCMaxTTrbnUs_CA "DINH/Zugeordnete FId für Verriegelungsquelle DFC_SRCMaxTTrbnUs" VAL_BLK 0x80024C52 ValA_Wu16 688. DINH_FIdVerb 0.00 688. FORMAT "%2.0" NUMBER 6 /end CHARACTERISTIC
/begin CHARACTERISTIC DINH_FId.DFC_SRCMaxUCatUsT_CA "DINH/Zugeordnete FId für Verriegelungsquelle DFC_SRCMaxUCatUsT" VAL_BLK 0x80024C5E ValA_Wu16 688. DINH_FIdVerb 0.00 688. FORMAT "%2.0" NUMBER 5 /end CHARACTERISTIC
/begin CHARACTERISTIC DINH_FId.DFC_SRCMaxUPmpP_CA "DINH/Zugeordnete FId für Verriegelungsquelle DFC_SRCMaxUPmpP" VAL_BLK 0x80024C68 ValA_Wu16 688. DINH_FIdVerb 0.00 688. FORMAT "%2.0" NUMBER 4 /end CHARACTERISTIC
/begin CHARACTERISTIC DINH_FId.DFC_SRCMinPPFltDiff_CA "DINH/Zugeordnete FId für Verriegelungsquelle DFC_SRCMinPPFltDiff" VAL_BLK 0x80024C70 ValA_Wu16 688. DINH_FIdVerb 0.00 688. FORMAT "%2.0" NUMBER 14 /end CHARACTERISTIC
/begin CHARACTERISTIC DINH_FId.DFC_SRCMinPPFltUs_CA "DINH/Zugeordnete FId für Verriegelungsquelle DFC_SRCMinPPFltUs" VAL_BLK 0x80024C8C ValA_Wu16 688. DINH_FIdVerb 0.00 688. FORMAT "%2.0" NUMBER 13 /end CHARACTERISTIC
/begin CHARACTERISTIC DINH_FId.DFC_SRCMinTECU_CA "DINH/Zugeordnete FId für Verriegelungsquelle DFC_SRCMinTECU" VAL_BLK 0x80024CA6 ValA_Wu16 688. DINH_FIdVerb 0.00 688. FORMAT "%2.0" NUMBER 9 /end CHARACTERISTIC
/begin CHARACTERISTIC DINH_FId.DFC_SRCMinTOxiCatUs_CA "DINH/Zugeordnete FId für Verriegelungsquelle DFC_SRCMinTOxiCatUs" VAL_BLK 0x80024CB8 ValA_Wu16 688. DINH_FIdVerb 0.00 688. FORMAT "%2.0" NUMBER 12 /end CHARACTERISTIC
/begin CHARACTERISTIC DINH_FId.DFC_SRCMinTPFltUs_CA "DINH/Zugeordnete FId für Verriegelungsquelle DFC_SRCMinTPFltUs" VAL_BLK 0x80024CD0 ValA_Wu16 688. DINH_FIdVerb 0.00 688. FORMAT "%2.0" NUMBER 19 /end CHARACTERISTIC
/begin CHARACTERISTIC DINH_FId.DFC_SRCMinTTrbnUs_CA "DINH/Zugeordnete FId für Verriegelungsquelle DFC_SRCMinTTrbnUs" VAL_BLK 0x80024CF6 ValA_Wu16 688. DINH_FIdVerb 0.00 688. FORMAT "%2.0" NUMBER 6 /end CHARACTERISTIC
/begin CHARACTERISTIC DINH_FId.DFC_SRCMinUCatUsT_CA "DINH/Zugeordnete FId für Verriegelungsquelle DFC_SRCMinUCatUsT" VAL_BLK 0x80024D02 ValA_Wu16 688. DINH_FIdVerb 0.00 688. FORMAT "%2.0" NUMBER 5 /end CHARACTERISTIC
/begin CHARACTERISTIC DINH_FId.DFC_SRCMinUPmpP_CA "DINH/Zugeordnete FId für Verriegelungsquelle DFC_SRCMinUPmpP" VAL_BLK 0x80024D0C ValA_Wu16 688. DINH_FIdVerb 0.00 688. FORMAT "%2.0" NUMBER 4 /end CHARACTERISTIC
/begin CHARACTERISTIC DINH_FId.DFC_SigUCatUsT_CA "DINH/Zugeordnete FId für Verriegelungsquelle DFC_SigUCatUsT" VAL_BLK 0x80024D14 ValA_Wu16 688. DINH_FIdVerb 0.00 688. FORMAT "%2.0" NUMBER 5 /end CHARACTERISTIC
/begin CHARACTERISTIC DINH_FId.DFC_SigUPmpP_CA "DINH/Zugeordnete FId für Verriegelungsquelle DFC_SigUPmpP" VAL_BLK 0x80024D1E ValA_Wu16 688. DINH_FIdVerb 0.00 688. FORMAT "%2.0" NUMBER 4 /end CHARACTERISTIC
/begin CHARACTERISTIC DINH_FId.DFC_SyncAPP_CA "DINH/Zugeordnete FId für Verriegelungsquelle DFC_SyncAPP" VAL_BLK 0x80024D26 ValA_Wu16 688. DINH_FIdVerb 0.00 688. FORMAT "%2.0" NUMBER 7 /end CHARACTERISTIC
/begin CHARACTERISTIC DINH_FId.DFC_T15Npl_CA "DINH/Zugeordnete FId für Verriegelungsquelle DFC_T15Npl" VAL_BLK 0x80024D34 ValA_Wu16 688. DINH_FIdVerb 0.00 688. FORMAT "%2.0" NUMBER 2 /end CHARACTERISTIC
/begin CHARACTERISTIC DINH_FId.DFC_TAFSDtyCycHi_CA "DINH/Zugeordnete FId für Verriegelungsquelle DFC_TAFSDtyCycHi" VAL_BLK 0x80024D38 ValA_Wu16 688. DINH_FIdVerb 0.00 688. FORMAT "%2.0" NUMBER 5 /end CHARACTERISTIC
/begin CHARACTERISTIC DINH_FId.DFC_TAFSDtyCycLo_CA "DINH/Zugeordnete FId für Verriegelungsquelle DFC_TAFSDtyCycLo" VAL_BLK 0x80024D42 ValA_Wu16 688. DINH_FIdVerb 0.00 688. FORMAT "%2.0" NUMBER 5 /end CHARACTERISTIC
/begin CHARACTERISTIC DINH_FId.DFC_TAFSPerHi_CA "DINH/Zugeordnete FId für Verriegelungsquelle DFC_TAFSPerHi" VAL_BLK 0x80024D4C ValA_Wu16 688. DINH_FIdVerb 0.00 688. FORMAT "%2.0" NUMBER 5 /end CHARACTERISTIC
/begin CHARACTERISTIC DINH_FId.DFC_TAFSPerLo_CA "DINH/Zugeordnete FId für Verriegelungsquelle DFC_TAFSPerLo" VAL_BLK 0x80024D56 ValA_Wu16 688. DINH_FIdVerb 0.00 688. FORMAT "%2.0" NUMBER 5 /end CHARACTERISTIC
/begin CHARACTERISTIC DINH_FId.DFC_TCACDsSRCMax_CA "DINH/Zugeordnete FId für Verriegelungsquelle DFC_TCACDsSRCMax" VAL_BLK 0x80024D60 ValA_Wu16 688. DINH_FIdVerb 0.00 688. FORMAT "%2.0" NUMBER 11 /end CHARACTERISTIC
/begin CHARACTERISTIC DINH_FId.DFC_TCACDsSRCMin_CA "DINH/Zugeordnete FId für Verriegelungsquelle DFC_TCACDsSRCMin" VAL_BLK 0x80024D76 ValA_Wu16 688. DINH_FIdVerb 0.00 688. FORMAT "%2.0" NUMBER 11 /end CHARACTERISTIC
/begin CHARACTERISTIC DINH_FId.DFC_ThrVlvSRCMax_CA "DINH/Zugeordnete FId für Verriegelungsquelle DFC_ThrVlvSRCMax" VAL_BLK 0x80024D8C ValA_Wu16 688. DINH_FIdVerb 0.00 688. FORMAT "%2.0" NUMBER 8 /end CHARACTERISTIC
/begin CHARACTERISTIC DINH_FId.DFC_ThrVlvSRCMin_CA "DINH/Zugeordnete FId für Verriegelungsquelle DFC_ThrVlvSRCMin" VAL_BLK 0x80024D9C ValA_Wu16 688. DINH_FIdVerb 0.00 688. FORMAT "%2.0" NUMBER 8 /end CHARACTERISTIC
/begin CHARACTERISTIC DINH_FId.DFC_TrbChLPOL_CA "DINH/Zugeordnete FId für Verriegelungsquelle DFC_TrbChLPOL" VAL_BLK 0x80024DAC ValA_Wu16 688. DINH_FIdVerb 0.00 688. FORMAT "%2.0" NUMBER 2 /end CHARACTERISTIC
/begin CHARACTERISTIC DINH_FId.DFC_TrbChLPSCB_CA "DINH/Zugeordnete FId für Verriegelungsquelle DFC_TrbChLPSCB" VAL_BLK 0x80024DB0 ValA_Wu16 688. DINH_FIdVerb 0.00 688. FORMAT "%2.0" NUMBER 2 /end CHARACTERISTIC
/begin CHARACTERISTIC DINH_FId.DFC_TrbChLPSCG_CA "DINH/Zugeordnete FId für Verriegelungsquelle DFC_TrbChLPSCG" VAL_BLK 0x80024DB4 ValA_Wu16 688. DINH_FIdVerb 0.00 688. FORMAT "%2.0" NUMBER 2 /end CHARACTERISTIC
/begin CHARACTERISTIC DINH_FId.DFC_UHtrPLOL_CA "DINH/Zugeordnete FId für Verriegelungsquelle DFC_UHtrPLOL" VAL_BLK 0x80024DB8 ValA_Wu16 688. DINH_FIdVerb 0.00 688. FORMAT "%2.0" NUMBER 3 /end CHARACTERISTIC
/begin CHARACTERISTIC DINH_FId.DFC_UHtrPLSCB_CA "DINH/Zugeordnete FId für Verriegelungsquelle DFC_UHtrPLSCB" VAL_BLK 0x80024DBE ValA_Wu16 688. DINH_FIdVerb 0.00 688. FORMAT "%2.0" NUMBER 3 /end CHARACTERISTIC
/begin CHARACTERISTIC DINH_FId.DFC_UHtrPLSCG_CA "DINH/Zugeordnete FId für Verriegelungsquelle DFC_UHtrPLSCG" VAL_BLK 0x80024DC4 ValA_Wu16 688. DINH_FIdVerb 0.00 688. FORMAT "%2.0" NUMBER 3 /end CHARACTERISTIC
/begin CHARACTERISTIC DINH_FId.DFC_UHtrPLSRCMaxDia_CA "DINH/Zugeordnete FId für Verriegelungsquelle DFC_UHtrPLSRCMaxDia" VAL_BLK 0x80024DCA ValA_Wu16 688. DINH_FIdVerb 0.00 688. FORMAT "%2.0" NUMBER 4 /end CHARACTERISTIC
/begin CHARACTERISTIC DINH_FId.DFC_UHtrPLSRCMinDia_CA "DINH/Zugeordnete FId für Verriegelungsquelle DFC_UHtrPLSRCMinDia" VAL_BLK 0x80024DD2 ValA_Wu16 688. DINH_FIdVerb 0.00 688. FORMAT "%2.0" NUMBER 4 /end CHARACTERISTIC
/begin CHARACTERISTIC DINH_FId.DFC_UHtrTnkOL_CA "DINH/Zugeordnete FId für Verriegelungsquelle DFC_UHtrTnkOL" VAL_BLK 0x80024DDA ValA_Wu16 688. DINH_FIdVerb 0.00 688. FORMAT "%2.0" NUMBER 3 /end CHARACTERISTIC
/begin CHARACTERISTIC DINH_FId.DFC_UHtrTnkSCB_CA "DINH/Zugeordnete FId für Verriegelungsquelle DFC_UHtrTnkSCB" VAL_BLK 0x80024DE0 ValA_Wu16 688. DINH_FIdVerb 0.00 688. FORMAT "%2.0" NUMBER 3 /end CHARACTERISTIC
/begin CHARACTERISTIC DINH_FId.DFC_UHtrTnkSCG_CA "DINH/Zugeordnete FId für Verriegelungsquelle DFC_UHtrTnkSCG" VAL_BLK 0x80024DE6 ValA_Wu16 688. DINH_FIdVerb 0.00 688. FORMAT "%2.0" NUMBER 3 /end CHARACTERISTIC
/begin CHARACTERISTIC DINH_FId.DFC_UHtrTnkSRCMaxDia_CA "DINH/Zugeordnete FId für Verriegelungsquelle DFC_UHtrTnkSRCMaxDia" VAL_BLK 0x80024DEC ValA_Wu16 688. DINH_FIdVerb 0.00 688. FORMAT "%2.0" NUMBER 4 /end CHARACTERISTIC
/begin CHARACTERISTIC DINH_FId.DFC_UHtrTnkSRCMinDia_CA "DINH/Zugeordnete FId für Verriegelungsquelle DFC_UHtrTnkSRCMinDia" VAL_BLK 0x80024DF4 ValA_Wu16 688. DINH_FIdVerb 0.00 688. FORMAT "%2.0" NUMBER 4 /end CHARACTERISTIC
/begin CHARACTERISTIC DINH_FId.DFC_URevVlvOL_CA "DINH/Zugeordnete FId für Verriegelungsquelle DFC_URevVlvOL" VAL_BLK 0x80024DFC ValA_Wu16 688. DINH_FIdVerb 0.00 688. FORMAT "%2.0" NUMBER 6 /end CHARACTERISTIC
/begin CHARACTERISTIC DINH_FId.DFC_URevVlvSCB_CA "DINH/Zugeordnete FId für Verriegelungsquelle DFC_URevVlvSCB" VAL_BLK 0x80024E08 ValA_Wu16 688. DINH_FIdVerb 0.00 688. FORMAT "%2.0" NUMBER 6 /end CHARACTERISTIC
/begin CHARACTERISTIC DINH_FId.DFC_URevVlvSCG_CA "DINH/Zugeordnete FId für Verriegelungsquelle DFC_URevVlvSCG" VAL_BLK 0x80024E14 ValA_Wu16 688. DINH_FIdVerb 0.00 688. FORMAT "%2.0" NUMBER 10 /end CHARACTERISTIC
/begin CHARACTERISTIC DINH_FId.DFC_UTnkTSRCMax_CA "DINH/Zugeordnete FId für Verriegelungsquelle DFC_UTnkTSRCMax" VAL_BLK 0x80024E28 ValA_Wu16 688. DINH_FIdVerb 0.00 688. FORMAT "%2.0" NUMBER 4 /end CHARACTERISTIC
/begin CHARACTERISTIC DINH_FId.DFC_UTnkTSRCMin_CA "DINH/Zugeordnete FId für Verriegelungsquelle DFC_UTnkTSRCMin" VAL_BLK 0x80024E30 ValA_Wu16 688. DINH_FIdVerb 0.00 688. FORMAT "%2.0" NUMBER 4 /end CHARACTERISTIC
/begin CHARACTERISTIC DINH_FId.DFC_UTnkTSig_CA "DINH/Zugeordnete FId für Verriegelungsquelle DFC_UTnkTSig" VAL_BLK 0x80024E38 ValA_Wu16 688. DINH_FIdVerb 0.00 688. FORMAT "%2.0" NUMBER 4 /end CHARACTERISTIC
/begin CHARACTERISTIC DINH_FId.DFC_VSwVlvGovDvtMax_CA "DINH/Zugeordnete FId für Verriegelungsquelle DFC_VSwVlvGovDvtMax" VAL_BLK 0x80024E40 ValA_Wu16 688. DINH_FIdVerb 0.00 688. FORMAT "%2.0" NUMBER 2 /end CHARACTERISTIC
/begin CHARACTERISTIC DINH_FId.DFC_VSwVlvGovDvtMin_CA "DINH/Zugeordnete FId für Verriegelungsquelle DFC_VSwVlvGovDvtMin" VAL_BLK 0x80024E44 ValA_Wu16 688. DINH_FIdVerb 0.00 688. FORMAT "%2.0" NUMBER 2 /end CHARACTERISTIC
/begin CHARACTERISTIC DINH_FId.DFC_VSwVlvHBrgOpnLd_CA "DINH/Zugeordnete FId für Verriegelungsquelle DFC_VSwVlvHBrgOpnLd" VAL_BLK 0x80024E48 ValA_Wu16 688. DINH_FIdVerb 0.00 688. FORMAT "%2.0" NUMBER 2 /end CHARACTERISTIC
/begin CHARACTERISTIC DINH_FId.DFC_VSwVlvHBrgOvrCurr_CA "DINH/Zugeordnete FId für Verriegelungsquelle DFC_VSwVlvHBrgOvrCurr" VAL_BLK 0x80024E4C ValA_Wu16 688. DINH_FIdVerb 0.00 688. FORMAT "%2.0" NUMBER 2 /end CHARACTERISTIC
/begin CHARACTERISTIC DINH_FId.DFC_VSwVlvHBrgOvrTemp_CA "DINH/Zugeordnete FId für Verriegelungsquelle DFC_VSwVlvHBrgOvrTemp" VAL_BLK 0x80024E50 ValA_Wu16 688. DINH_FIdVerb 0.00 688. FORMAT "%2.0" NUMBER 2 /end CHARACTERISTIC
/begin CHARACTERISTIC DINH_FId.DFC_VSwVlvHBrgShCirBatt1_CA "DINH/Zugeordnete FId für Verriegelungsquelle DFC_VSwVlvHBrgShCirBatt1" VAL_BLK 0x80024E54 ValA_Wu16 688. DINH_FIdVerb 0.00 688. FORMAT "%2.0" NUMBER 2 /end CHARACTERISTIC
/begin CHARACTERISTIC DINH_FId.DFC_VSwVlvHBrgShCirBatt2_CA "DINH/Zugeordnete FId für Verriegelungsquelle DFC_VSwVlvHBrgShCirBatt2" VAL_BLK 0x80024E58 ValA_Wu16 688. DINH_FIdVerb 0.00 688. FORMAT "%2.0" NUMBER 2 /end CHARACTERISTIC
/begin CHARACTERISTIC DINH_FId.DFC_VSwVlvHBrgShCirGnd1_CA "DINH/Zugeordnete FId für Verriegelungsquelle DFC_VSwVlvHBrgShCirGnd1" VAL_BLK 0x80024E5C ValA_Wu16 688. DINH_FIdVerb 0.00 688. FORMAT "%2.0" NUMBER 2 /end CHARACTERISTIC
/begin CHARACTERISTIC DINH_FId.DFC_VSwVlvHBrgShCirGnd2_CA "DINH/Zugeordnete FId für Verriegelungsquelle DFC_VSwVlvHBrgShCirGnd2" VAL_BLK 0x80024E60 ValA_Wu16 688. DINH_FIdVerb 0.00 688. FORMAT "%2.0" NUMBER 2 /end CHARACTERISTIC
/begin CHARACTERISTIC DINH_FId.DFC_VSwVlvHBrgShCirOvrLd_CA "DINH/Zugeordnete FId für Verriegelungsquelle DFC_VSwVlvHBrgShCirOvrLd" VAL_BLK 0x80024E64 ValA_Wu16 688. DINH_FIdVerb 0.00 688. FORMAT "%2.0" NUMBER 2 /end CHARACTERISTIC
/begin CHARACTERISTIC DINH_FId.DFC_VSwVlvHBrgTempOvrCurr_CA "DINH/Zugeordnete FId für Verriegelungsquelle DFC_VSwVlvHBrgTempOvrCurr" VAL_BLK 0x80024E68 ValA_Wu16 688. DINH_FIdVerb 0.00 688. FORMAT "%2.0" NUMBER 2 /end CHARACTERISTIC
/begin CHARACTERISTIC DINH_FId.DFC_VSwVlvHBrgUndrVltg_CA "DINH/Zugeordnete FId für Verriegelungsquelle DFC_VSwVlvHBrgUndrVltg" VAL_BLK 0x80024E6C ValA_Wu16 688. DINH_FIdVerb 0.00 688. FORMAT "%2.0" NUMBER 2 /end CHARACTERISTIC
/begin CHARACTERISTIC DINH_FId.DFC_VSwVlvOL_CA "DINH/Zugeordnete FId für Verriegelungsquelle DFC_VSwVlvOL" VAL_BLK 0x80024E70 ValA_Wu16 688. DINH_FIdVerb 0.00 688. FORMAT "%2.0" NUMBER 8 /end CHARACTERISTIC
/begin CHARACTERISTIC DINH_FId.DFC_VSwVlvSCB_CA "DINH/Zugeordnete FId für Verriegelungsquelle DFC_VSwVlvSCB" VAL_BLK 0x80024E80 ValA_Wu16 688. DINH_FIdVerb 0.00 688. FORMAT "%2.0" NUMBER 8 /end CHARACTERISTIC
/begin CHARACTERISTIC DINH_FId.DFC_VSwVlvSCG_CA "DINH/Zugeordnete FId für Verriegelungsquelle DFC_VSwVlvSCG" VAL_BLK 0x80024E90 ValA_Wu16 688. DINH_FIdVerb 0.00 688. FORMAT "%2.0" NUMBER 8 /end CHARACTERISTIC
/begin CHARACTERISTIC DINH_FId.DFC_VSwVlvSRCMax_CA "DINH/Zugeordnete FId für Verriegelungsquelle DFC_VSwVlvSRCMax" VAL_BLK 0x80024EA0 ValA_Wu16 688. DINH_FIdVerb 0.00 688. FORMAT "%2.0" NUMBER 7 /end CHARACTERISTIC
/begin CHARACTERISTIC DINH_FId.DFC_VSwVlvSRCMin_CA "DINH/Zugeordnete FId für Verriegelungsquelle DFC_VSwVlvSRCMin" VAL_BLK 0x80024EAE ValA_Wu16 688. DINH_FIdVerb 0.00 688. FORMAT "%2.0" NUMBER 7 /end CHARACTERISTIC
/begin CHARACTERISTIC DINH_FId.DFC_ClthNpl_CA "DINH/Zugeordnete FId für Verriegelungsquelle DFC_ClthNpl" VAL_BLK 0x80024EBC ValA_Wu16 688. DINH_FIdVerb 0.00 688. FORMAT "%2.0" NUMBER 22 /end CHARACTERISTIC
/begin CHARACTERISTIC DINH_FId.DFC_ETClbETMax_0_CA "DINH/Zugeordnete FId für Verriegelungsquelle DFC_ETClbETMax_0" VAL_BLK 0x80024EE8 ValA_Wu16 688. DINH_FIdVerb 0.00 688. FORMAT "%2.0" NUMBER 2 /end CHARACTERISTIC
/begin CHARACTERISTIC DINH_FId.DFC_ETClbETMax_1_CA "DINH/Zugeordnete FId für Verriegelungsquelle DFC_ETClbETMax_1" VAL_BLK 0x80024EEC ValA_Wu16 688. DINH_FIdVerb 0.00 688. FORMAT "%2.0" NUMBER 2 /end CHARACTERISTIC
/begin CHARACTERISTIC DINH_FId.DFC_ETClbETMax_2_CA "DINH/Zugeordnete FId für Verriegelungsquelle DFC_ETClbETMax_2" VAL_BLK 0x80024EF0 ValA_Wu16 688. DINH_FIdVerb 0.00 688. FORMAT "%2.0" NUMBER 2 /end CHARACTERISTIC
/begin CHARACTERISTIC DINH_FId.DFC_ETClbETMax_3_CA "DINH/Zugeordnete FId für Verriegelungsquelle DFC_ETClbETMax_3" VAL_BLK 0x80024EF4 ValA_Wu16 688. DINH_FIdVerb 0.00 688. FORMAT "%2.0" NUMBER 2 /end CHARACTERISTIC
/begin CHARACTERISTIC DINH_FId.DFC_ETClbETMax_4_CA "DINH/Zugeordnete FId für Verriegelungsquelle DFC_ETClbETMax_4" VAL_BLK 0x80024EF8 ValA_Wu16 688. DINH_FIdVerb 0.00 688. FORMAT "%2.0" NUMBER 2 /end CHARACTERISTIC
/begin CHARACTERISTIC DINH_FId.DFC_ETClbETMax_5_CA "DINH/Zugeordnete FId für Verriegelungsquelle DFC_ETClbETMax_5" VAL_BLK 0x80024EFC ValA_Wu16 688. DINH_FIdVerb 0.00 688. FORMAT "%2.0" NUMBER 2 /end CHARACTERISTIC
/begin CHARACTERISTIC DINH_FId.DFC_ETClbETMin_0_CA "DINH/Zugeordnete FId für Verriegelungsquelle DFC_ETClbETMin_0" VAL_BLK 0x80024F00 ValA_Wu16 688. DINH_FIdVerb 0.00 688. FORMAT "%2.0" NUMBER 2 /end CHARACTERISTIC
/begin CHARACTERISTIC DINH_FId.DFC_ETClbETMin_1_CA "DINH/Zugeordnete FId für Verriegelungsquelle DFC_ETClbETMin_1" VAL_BLK 0x80024F04 ValA_Wu16 688. DINH_FIdVerb 0.00 688. FORMAT "%2.0" NUMBER 2 /end CHARACTERISTIC
/begin CHARACTERISTIC DINH_FId.DFC_ETClbETMin_2_CA "DINH/Zugeordnete FId für Verriegelungsquelle DFC_ETClbETMin_2" VAL_BLK 0x80024F08 ValA_Wu16 688. DINH_FIdVerb 0.00 688. FORMAT "%2.0" NUMBER 2 /end CHARACTERISTIC
/begin CHARACTERISTIC DINH_FId.DFC_ETClbETMin_3_CA "DINH/Zugeordnete FId für Verriegelungsquelle DFC_ETClbETMin_3" VAL_BLK 0x80024F0C ValA_Wu16 688. DINH_FIdVerb 0.00 688. FORMAT "%2.0" NUMBER 2 /end CHARACTERISTIC
/begin CHARACTERISTIC DINH_FId.DFC_ETClbETMin_4_CA "DINH/Zugeordnete FId für Verriegelungsquelle DFC_ETClbETMin_4" VAL_BLK 0x80024F10 ValA_Wu16 688. DINH_FIdVerb 0.00 688. FORMAT "%2.0" NUMBER 2 /end CHARACTERISTIC
/begin CHARACTERISTIC DINH_FId.DFC_ETClbETMin_5_CA "DINH/Zugeordnete FId für Verriegelungsquelle DFC_ETClbETMin_5" VAL_BLK 0x80024F14 ValA_Wu16 688. DINH_FIdVerb 0.00 688. FORMAT "%2.0" NUMBER 2 /end CHARACTERISTIC
/begin CHARACTERISTIC DINH_FId.DFC_IVActrEnrgMax_0_CA "DINH/Zugeordnete FId für Verriegelungsquelle DFC_IVActrEnrgMax_0" VAL_BLK 0x80024F18 ValA_Wu16 688. DINH_FIdVerb 0.00 688. FORMAT "%2.0" NUMBER 2 /end CHARACTERISTIC
/begin CHARACTERISTIC DINH_FId.DFC_IVActrEnrgMax_1_CA "DINH/Zugeordnete FId für Verriegelungsquelle DFC_IVActrEnrgMax_1" VAL_BLK 0x80024F1C ValA_Wu16 688. DINH_FIdVerb 0.00 688. FORMAT "%2.0" NUMBER 2 /end CHARACTERISTIC
/begin CHARACTERISTIC DINH_FId.DFC_IVActrEnrgMax_2_CA "DINH/Zugeordnete FId für Verriegelungsquelle DFC_IVActrEnrgMax_2" VAL_BLK 0x80024F20 ValA_Wu16 688. DINH_FIdVerb 0.00 688. FORMAT "%2.0" NUMBER 2 /end CHARACTERISTIC
/begin CHARACTERISTIC DINH_FId.DFC_IVActrEnrgMax_3_CA "DINH/Zugeordnete FId für Verriegelungsquelle DFC_IVActrEnrgMax_3" VAL_BLK 0x80024F24 ValA_Wu16 688. DINH_FIdVerb 0.00 688. FORMAT "%2.0" NUMBER 2 /end CHARACTERISTIC
/begin CHARACTERISTIC DINH_FId.DFC_IVActrEnrgMax_4_CA "DINH/Zugeordnete FId für Verriegelungsquelle DFC_IVActrEnrgMax_4" VAL_BLK 0x80024F28 ValA_Wu16 688. DINH_FIdVerb 0.00 688. FORMAT "%2.0" NUMBER 2 /end CHARACTERISTIC
/begin CHARACTERISTIC DINH_FId.DFC_IVActrEnrgMax_5_CA "DINH/Zugeordnete FId für Verriegelungsquelle DFC_IVActrEnrgMax_5" VAL_BLK 0x80024F2C ValA_Wu16 688. DINH_FIdVerb 0.00 688. FORMAT "%2.0" NUMBER 2 /end CHARACTERISTIC
/begin CHARACTERISTIC DINH_FId.DFC_IVActrEnrgMax_6_CA "DINH/Zugeordnete FId für Verriegelungsquelle DFC_IVActrEnrgMax_6" VAL_BLK 0x80024F30 ValA_Wu16 688. DINH_FIdVerb 0.00 688. FORMAT "%2.0" NUMBER 2 /end CHARACTERISTIC
/begin CHARACTERISTIC DINH_FId.DFC_IVActrEnrgMax_7_CA "DINH/Zugeordnete FId für Verriegelungsquelle DFC_IVActrEnrgMax_7" VAL_BLK 0x80024F34 ValA_Wu16 688. DINH_FIdVerb 0.00 688. FORMAT "%2.0" NUMBER 2 /end CHARACTERISTIC
/begin CHARACTERISTIC DINH_FId.DFC_IVActrEnrgMin_0_CA "DINH/Zugeordnete FId für Verriegelungsquelle DFC_IVActrEnrgMin_0" VAL_BLK 0x80024F38 ValA_Wu16 688. DINH_FIdVerb 0.00 688. FORMAT "%2.0" NUMBER 2 /end CHARACTERISTIC
/begin CHARACTERISTIC DINH_FId.DFC_IVActrEnrgMin_1_CA "DINH/Zugeordnete FId für Verriegelungsquelle DFC_IVActrEnrgMin_1" VAL_BLK 0x80024F3C ValA_Wu16 688. DINH_FIdVerb 0.00 688. FORMAT "%2.0" NUMBER 2 /end CHARACTERISTIC
/begin CHARACTERISTIC DINH_FId.DFC_IVActrEnrgMin_2_CA "DINH/Zugeordnete FId für Verriegelungsquelle DFC_IVActrEnrgMin_2" VAL_BLK 0x80024F40 ValA_Wu16 688. DINH_FIdVerb 0.00 688. FORMAT "%2.0" NUMBER 2 /end CHARACTERISTIC
/begin CHARACTERISTIC DINH_FId.DFC_IVActrEnrgMin_3_CA "DINH/Zugeordnete FId für Verriegelungsquelle DFC_IVActrEnrgMin_3" VAL_BLK 0x80024F44 ValA_Wu16 688. DINH_FIdVerb 0.00 688. FORMAT "%2.0" NUMBER 2 /end CHARACTERISTIC
/begin CHARACTERISTIC DINH_FId.DFC_IVActrEnrgMin_4_CA "DINH/Zugeordnete FId für Verriegelungsquelle DFC_IVActrEnrgMin_4" VAL_BLK 0x80024F48 ValA_Wu16 688. DINH_FIdVerb 0.00 688. FORMAT "%2.0" NUMBER 2 /end CHARACTERISTIC
/begin CHARACTERISTIC DINH_FId.DFC_IVActrEnrgMin_5_CA "DINH/Zugeordnete FId für Verriegelungsquelle DFC_IVActrEnrgMin_5" VAL_BLK 0x80024F4C ValA_Wu16 688. DINH_FIdVerb 0.00 688. FORMAT "%2.0" NUMBER 2 /end CHARACTERISTIC
/begin CHARACTERISTIC DINH_FId.DFC_IVActrEnrgMin_6_CA "DINH/Zugeordnete FId für Verriegelungsquelle DFC_IVActrEnrgMin_6" VAL_BLK 0x80024F50 ValA_Wu16 688. DINH_FIdVerb 0.00 688. FORMAT "%2.0" NUMBER 2 /end CHARACTERISTIC
/begin CHARACTERISTIC DINH_FId.DFC_IVActrEnrgMin_7_CA "DINH/Zugeordnete FId für Verriegelungsquelle DFC_IVActrEnrgMin_7" VAL_BLK 0x80024F54 ValA_Wu16 688. DINH_FIdVerb 0.00 688. FORMAT "%2.0" NUMBER 2 /end CHARACTERISTIC
/begin CHARACTERISTIC DINH_FId.DFC_IVActrEnrgPlaus_0_CA "DINH/Zugeordnete FId für Verriegelungsquelle DFC_IVActrEnrgPlaus_0" VAL_BLK 0x80024F58 ValA_Wu16 688. DINH_FIdVerb 0.00 688. FORMAT "%2.0" NUMBER 2 /end CHARACTERISTIC
/begin CHARACTERISTIC DINH_FId.DFC_IVActrEnrgPlaus_1_CA "DINH/Zugeordnete FId für Verriegelungsquelle DFC_IVActrEnrgPlaus_1" VAL_BLK 0x80024F5C ValA_Wu16 688. DINH_FIdVerb 0.00 688. FORMAT "%2.0" NUMBER 2 /end CHARACTERISTIC
/begin CHARACTERISTIC DINH_FId.DFC_IVActrEnrgPlaus_2_CA "DINH/Zugeordnete FId für Verriegelungsquelle DFC_IVActrEnrgPlaus_2" VAL_BLK 0x80024F60 ValA_Wu16 688. DINH_FIdVerb 0.00 688. FORMAT "%2.0" NUMBER 2 /end CHARACTERISTIC
/begin CHARACTERISTIC DINH_FId.DFC_IVActrEnrgPlaus_3_CA "DINH/Zugeordnete FId für Verriegelungsquelle DFC_IVActrEnrgPlaus_3" VAL_BLK 0x80024F64 ValA_Wu16 688. DINH_FIdVerb 0.00 688. FORMAT "%2.0" NUMBER 2 /end CHARACTERISTIC
/begin CHARACTERISTIC DINH_FId.DFC_IVActrEnrgPlaus_4_CA "DINH/Zugeordnete FId für Verriegelungsquelle DFC_IVActrEnrgPlaus_4" VAL_BLK 0x80024F68 ValA_Wu16 688. DINH_FIdVerb 0.00 688. FORMAT "%2.0" NUMBER 2 /end CHARACTERISTIC
/begin CHARACTERISTIC DINH_FId.DFC_IVActrEnrgPlaus_5_CA "DINH/Zugeordnete FId für Verriegelungsquelle DFC_IVActrEnrgPlaus_5" VAL_BLK 0x80024F6C ValA_Wu16 688. DINH_FIdVerb 0.00 688. FORMAT "%2.0" NUMBER 2 /end CHARACTERISTIC
/begin CHARACTERISTIC DINH_FId.DFC_IVActrEnrgPlaus_6_CA "DINH/Zugeordnete FId für Verriegelungsquelle DFC_IVActrEnrgPlaus_6" VAL_BLK 0x80024F70 ValA_Wu16 688. DINH_FIdVerb 0.00 688. FORMAT "%2.0" NUMBER 2 /end CHARACTERISTIC
/begin CHARACTERISTIC DINH_FId.DFC_IVActrEnrgPlaus_7_CA "DINH/Zugeordnete FId für Verriegelungsquelle DFC_IVActrEnrgPlaus_7" VAL_BLK 0x80024F74 ValA_Wu16 688. DINH_FIdVerb 0.00 688. FORMAT "%2.0" NUMBER 2 /end CHARACTERISTIC
/begin CHARACTERISTIC DINH_FId.DFC_IVCtlTiDiff_0_CA "DINH/Zugeordnete FId für Verriegelungsquelle DFC_IVCtlTiDiff_0" VAL_BLK 0x80024F78 ValA_Wu16 688. DINH_FIdVerb 0.00 688. FORMAT "%2.0" NUMBER 2 /end CHARACTERISTIC
/begin CHARACTERISTIC DINH_FId.DFC_IVCtlTiDiff_1_CA "DINH/Zugeordnete FId für Verriegelungsquelle DFC_IVCtlTiDiff_1" VAL_BLK 0x80024F7C ValA_Wu16 688. DINH_FIdVerb 0.00 688. FORMAT "%2.0" NUMBER 2 /end CHARACTERISTIC
/begin CHARACTERISTIC DINH_FId.DFC_IVCtlTiDiff_2_CA "DINH/Zugeordnete FId für Verriegelungsquelle DFC_IVCtlTiDiff_2" VAL_BLK 0x80024F80 ValA_Wu16 688. DINH_FIdVerb 0.00 688. FORMAT "%2.0" NUMBER 2 /end CHARACTERISTIC
/begin CHARACTERISTIC DINH_FId.DFC_IVCtlTiDiff_3_CA "DINH/Zugeordnete FId für Verriegelungsquelle DFC_IVCtlTiDiff_3" VAL_BLK 0x80024F84 ValA_Wu16 688. DINH_FIdVerb 0.00 688. FORMAT "%2.0" NUMBER 2 /end CHARACTERISTIC
/begin CHARACTERISTIC DINH_FId.DFC_IVCtlTiDiff_4_CA "DINH/Zugeordnete FId für Verriegelungsquelle DFC_IVCtlTiDiff_4" VAL_BLK 0x80024F88 ValA_Wu16 688. DINH_FIdVerb 0.00 688. FORMAT "%2.0" NUMBER 2 /end CHARACTERISTIC
/begin CHARACTERISTIC DINH_FId.DFC_IVCtlTiDiff_5_CA "DINH/Zugeordnete FId für Verriegelungsquelle DFC_IVCtlTiDiff_5" VAL_BLK 0x80024F8C ValA_Wu16 688. DINH_FIdVerb 0.00 688. FORMAT "%2.0" NUMBER 2 /end CHARACTERISTIC
/begin CHARACTERISTIC DINH_FId.DFC_IVCtlUDiffUp_0_CA "DINH/Zugeordnete FId für Verriegelungsquelle DFC_IVCtlUDiffUp_0" VAL_BLK 0x80024F90 ValA_Wu16 688. DINH_FIdVerb 0.00 688. FORMAT "%2.0" NUMBER 2 /end CHARACTERISTIC
/begin CHARACTERISTIC DINH_FId.DFC_IVCtlUDiffUp_1_CA "DINH/Zugeordnete FId für Verriegelungsquelle DFC_IVCtlUDiffUp_1" VAL_BLK 0x80024F94 ValA_Wu16 688. DINH_FIdVerb 0.00 688. FORMAT "%2.0" NUMBER 2 /end CHARACTERISTIC
/begin CHARACTERISTIC DINH_FId.DFC_IVCtlUDiffUp_2_CA "DINH/Zugeordnete FId für Verriegelungsquelle DFC_IVCtlUDiffUp_2" VAL_BLK 0x80024F98 ValA_Wu16 688. DINH_FIdVerb 0.00 688. FORMAT "%2.0" NUMBER 2 /end CHARACTERISTIC
/begin CHARACTERISTIC DINH_FId.DFC_IVCtlUDiffUp_3_CA "DINH/Zugeordnete FId für Verriegelungsquelle DFC_IVCtlUDiffUp_3" VAL_BLK 0x80024F9C ValA_Wu16 688. DINH_FIdVerb 0.00 688. FORMAT "%2.0" NUMBER 2 /end CHARACTERISTIC
/begin CHARACTERISTIC DINH_FId.DFC_IVCtlUDiffUp_4_CA "DINH/Zugeordnete FId für Verriegelungsquelle DFC_IVCtlUDiffUp_4" VAL_BLK 0x80024FA0 ValA_Wu16 688. DINH_FIdVerb 0.00 688. FORMAT "%2.0" NUMBER 2 /end CHARACTERISTIC
/begin CHARACTERISTIC DINH_FId.DFC_IVCtlUDiffUp_5_CA "DINH/Zugeordnete FId für Verriegelungsquelle DFC_IVCtlUDiffUp_5" VAL_BLK 0x80024FA4 ValA_Wu16 688. DINH_FIdVerb 0.00 688. FORMAT "%2.0" NUMBER 2 /end CHARACTERISTIC
/begin CHARACTERISTIC DINH_FId.DFC_IVCtlUUp_0_CA "DINH/Zugeordnete FId für Verriegelungsquelle DFC_IVCtlUUp_0" VAL_BLK 0x80024FA8 ValA_Wu16 688. DINH_FIdVerb 0.00 688. FORMAT "%2.0" NUMBER 2 /end CHARACTERISTIC
/begin CHARACTERISTIC DINH_FId.DFC_IVCtlUUp_1_CA "DINH/Zugeordnete FId für Verriegelungsquelle DFC_IVCtlUUp_1" VAL_BLK 0x80024FAC ValA_Wu16 688. DINH_FIdVerb 0.00 688. FORMAT "%2.0" NUMBER 2 /end CHARACTERISTIC
/begin CHARACTERISTIC DINH_FId.DFC_IVCtlUUp_2_CA "DINH/Zugeordnete FId für Verriegelungsquelle DFC_IVCtlUUp_2" VAL_BLK 0x80024FB0 ValA_Wu16 688. DINH_FIdVerb 0.00 688. FORMAT "%2.0" NUMBER 2 /end CHARACTERISTIC
/begin CHARACTERISTIC DINH_FId.DFC_IVCtlUUp_3_CA "DINH/Zugeordnete FId für Verriegelungsquelle DFC_IVCtlUUp_3" VAL_BLK 0x80024FB4 ValA_Wu16 688. DINH_FIdVerb 0.00 688. FORMAT "%2.0" NUMBER 2 /end CHARACTERISTIC
/begin CHARACTERISTIC DINH_FId.DFC_IVCtlUUp_4_CA "DINH/Zugeordnete FId für Verriegelungsquelle DFC_IVCtlUUp_4" VAL_BLK 0x80024FB8 ValA_Wu16 688. DINH_FIdVerb 0.00 688. FORMAT "%2.0" NUMBER 2 /end CHARACTERISTIC
/begin CHARACTERISTIC DINH_FId.DFC_IVCtlUUp_5_CA "DINH/Zugeordnete FId für Verriegelungsquelle DFC_IVCtlUUp_5" VAL_BLK 0x80024FBC ValA_Wu16 688. DINH_FIdVerb 0.00 688. FORMAT "%2.0" NUMBER 2 /end CHARACTERISTIC
/begin CHARACTERISTIC DINH_FId.DFC_IVDiaBnkShCir_0_CA "DINH/Zugeordnete FId für Verriegelungsquelle DFC_IVDiaBnkShCir_0" VAL_BLK 0x80024FC0 ValA_Wu16 688. DINH_FIdVerb 0.00 688. FORMAT "%2.0" NUMBER 7 /end CHARACTERISTIC
/begin CHARACTERISTIC DINH_FId.DFC_IVDiaBnkShCir_1_CA "DINH/Zugeordnete FId für Verriegelungsquelle DFC_IVDiaBnkShCir_1" VAL_BLK 0x80024FCE ValA_Wu16 688. DINH_FIdVerb 0.00 688. FORMAT "%2.0" NUMBER 7 /end CHARACTERISTIC
/begin CHARACTERISTIC DINH_FId.DFC_IVDiaBnkShCirChSwt_0_CA "DINH/Fehlerdiagnose für Kurzschluss" VAL_BLK 0x80024FDC ValA_Wu16 688. DINH_FIdVerb 0.00 688. FORMAT "%2.0" NUMBER 5 /end CHARACTERISTIC
/begin CHARACTERISTIC DINH_FId.DFC_IVDiaBnkShCirChSwt_1_CA "DINH/Fehlerdiagnose für Kurzschluss" VAL_BLK 0x80024FE6 ValA_Wu16 688. DINH_FIdVerb 0.00 688. FORMAT "%2.0" NUMBER 5 /end CHARACTERISTIC
/begin CHARACTERISTIC DINH_FId.DFC_IVDiaChp_0_CA "DINH/Zugeordnete FId für Verriegelungsquelle DFC_IVDiaChp_0" VAL_BLK 0x80024FF0 ValA_Wu16 688. DINH_FIdVerb 0.00 688. FORMAT "%2.0" NUMBER 7 /end CHARACTERISTIC
/begin CHARACTERISTIC DINH_FId.DFC_IVDiaChp_1_CA "DINH/Zugeordnete FId für Verriegelungsquelle DFC_IVDiaChp_1" VAL_BLK 0x80024FFE ValA_Wu16 688. DINH_FIdVerb 0.00 688. FORMAT "%2.0" NUMBER 7 /end CHARACTERISTIC
/begin CHARACTERISTIC DINH_FId.DFC_IVDiaCylNoCls_0_CA "DINH/Fehlerdiagnose für den Fehlerpfad Injektor 0: nicht klassifizierbarer Fehler" VAL_BLK 0x8002500C ValA_Wu16 688. DINH_FIdVerb 0.00 688. FORMAT "%2.0" NUMBER 5 /end CHARACTERISTIC
/begin CHARACTERISTIC DINH_FId.DFC_IVDiaCylNoCls_1_CA "DINH/Fehlerdiagnose für den Fehlerpfad Injektor 1: nicht klassifizierbarer Fehler" VAL_BLK 0x80025016 ValA_Wu16 688. DINH_FIdVerb 0.00 688. FORMAT "%2.0" NUMBER 5 /end CHARACTERISTIC
/begin CHARACTERISTIC DINH_FId.DFC_IVDiaCylNoCls_2_CA "DINH/Fehlerdiagnose für den Fehlerpfad Injektor 2: nicht klassifizierbarer Fehler" VAL_BLK 0x80025020 ValA_Wu16 688. DINH_FIdVerb 0.00 688. FORMAT "%2.0" NUMBER 5 /end CHARACTERISTIC
/begin CHARACTERISTIC DINH_FId.DFC_IVDiaCylNoCls_3_CA "DINH/Fehlerdiagnose für den Fehlerpfad Injektor 3: nicht klassifizierbarer Fehler" VAL_BLK 0x8002502A ValA_Wu16 688. DINH_FIdVerb 0.00 688. FORMAT "%2.0" NUMBER 5 /end CHARACTERISTIC
/begin CHARACTERISTIC DINH_FId.DFC_IVDiaCylNoCls_4_CA "DINH/Fehlerdiagnose für den Fehlerpfad Injektor 4: nicht klassifizierbarer Fehler" VAL_BLK 0x80025034 ValA_Wu16 688. DINH_FIdVerb 0.00 688. FORMAT "%2.0" NUMBER 5 /end CHARACTERISTIC
/begin CHARACTERISTIC DINH_FId.DFC_IVDiaCylNoCls_5_CA "DINH/Fehlerdiagnose für den Fehlerpfad Injektor 5: nicht klassifizierbarer Fehler" VAL_BLK 0x8002503E ValA_Wu16 688. DINH_FIdVerb 0.00 688. FORMAT "%2.0" NUMBER 5 /end CHARACTERISTIC
/begin CHARACTERISTIC DINH_FId.DFC_IVDiaCylNoLd_0_CA "DINH/Zugeordnete FId für Verriegelungsquelle DFC_IVDiaCylNoLd_0" VAL_BLK 0x80025048 ValA_Wu16 688. DINH_FIdVerb 0.00 688. FORMAT "%2.0" NUMBER 6 /end CHARACTERISTIC
/begin CHARACTERISTIC DINH_FId.DFC_IVDiaCylNoLd_1_CA "DINH/Zugeordnete FId für Verriegelungsquelle DFC_IVDiaCylNoLd_1" VAL_BLK 0x80025054 ValA_Wu16 688. DINH_FIdVerb 0.00 688. FORMAT "%2.0" NUMBER 6 /end CHARACTERISTIC
/begin CHARACTERISTIC DINH_FId.DFC_IVDiaCylNoLd_2_CA "DINH/Zugeordnete FId für Verriegelungsquelle DFC_IVDiaCylNoLd_2" VAL_BLK 0x80025060 ValA_Wu16 688. DINH_FIdVerb 0.00 688. FORMAT "%2.0" NUMBER 6 /end CHARACTERISTIC
/begin CHARACTERISTIC DINH_FId.DFC_IVDiaCylNoLd_3_CA "DINH/Zugeordnete FId für Verriegelungsquelle DFC_IVDiaCylNoLd_3" VAL_BLK 0x8002506C ValA_Wu16 688. DINH_FIdVerb 0.00 688. FORMAT "%2.0" NUMBER 6 /end CHARACTERISTIC
/begin CHARACTERISTIC DINH_FId.DFC_IVDiaCylNoLd_4_CA "DINH/Zugeordnete FId für Verriegelungsquelle DFC_IVDiaCylNoLd_4" VAL_BLK 0x80025078 ValA_Wu16 688. DINH_FIdVerb 0.00 688. FORMAT "%2.0" NUMBER 6 /end CHARACTERISTIC
/begin CHARACTERISTIC DINH_FId.DFC_IVDiaCylNoLd_5_CA "DINH/Zugeordnete FId für Verriegelungsquelle DFC_IVDiaCylNoLd_5" VAL_BLK 0x80025084 ValA_Wu16 688. DINH_FIdVerb 0.00 688. FORMAT "%2.0" NUMBER 6 /end CHARACTERISTIC
/begin CHARACTERISTIC DINH_FId.DFC_IVDiaCylShCir_0_CA "DINH/Zugeordnete FId für Verriegelungsquelle DFC_IVDiaCylShCir_0" VAL_BLK 0x80025090 ValA_Wu16 688. DINH_FIdVerb 0.00 688. FORMAT "%2.0" NUMBER 7 /end CHARACTERISTIC
/begin CHARACTERISTIC DINH_FId.DFC_IVDiaCylShCir_1_CA "DINH/Zugeordnete FId für Verriegelungsquelle DFC_IVDiaCylShCir_1" VAL_BLK 0x8002509E ValA_Wu16 688. DINH_FIdVerb 0.00 688. FORMAT "%2.0" NUMBER 7 /end CHARACTERISTIC
/begin CHARACTERISTIC DINH_FId.DFC_IVDiaCylShCir_2_CA "DINH/Zugeordnete FId für Verriegelungsquelle DFC_IVDiaCylShCir_2" VAL_BLK 0x800250AC ValA_Wu16 688. DINH_FIdVerb 0.00 688. FORMAT "%2.0" NUMBER 7 /end CHARACTERISTIC
/begin CHARACTERISTIC DINH_FId.DFC_IVDiaCylShCir_3_CA "DINH/Zugeordnete FId für Verriegelungsquelle DFC_IVDiaCylShCir_3" VAL_BLK 0x800250BA ValA_Wu16 688. DINH_FIdVerb 0.00 688. FORMAT "%2.0" NUMBER 7 /end CHARACTERISTIC
/begin CHARACTERISTIC DINH_FId.DFC_IVDiaCylShCir_4_CA "DINH/Zugeordnete FId für Verriegelungsquelle DFC_IVDiaCylShCir_4" VAL_BLK 0x800250C8 ValA_Wu16 688. DINH_FIdVerb 0.00 688. FORMAT "%2.0" NUMBER 7 /end CHARACTERISTIC
/begin CHARACTERISTIC DINH_FId.DFC_IVDiaCylShCir_5_CA "DINH/Zugeordnete FId für Verriegelungsquelle DFC_IVDiaCylShCir_5" VAL_BLK 0x800250D6 ValA_Wu16 688. DINH_FIdVerb 0.00 688. FORMAT "%2.0" NUMBER 7 /end CHARACTERISTIC
/begin CHARACTERISTIC DINH_FId.DFC_IVDiaCylShCirHSLS_0_CA "DINH/Zugeordnete FId für Verriegelungsquelle DFC_IVDiaCylShCirHSLS_0" VAL_BLK 0x800250E4 ValA_Wu16 688. DINH_FIdVerb 0.00 688. FORMAT "%2.0" NUMBER 7 /end CHARACTERISTIC
/begin CHARACTERISTIC DINH_FId.DFC_IVDiaCylShCirHSLS_1_CA "DINH/Zugeordnete FId für Verriegelungsquelle DFC_IVDiaCylShCirHSLS_1" VAL_BLK 0x800250F2 ValA_Wu16 688. DINH_FIdVerb 0.00 688. FORMAT "%2.0" NUMBER 7 /end CHARACTERISTIC
/begin CHARACTERISTIC DINH_FId.DFC_IVDiaCylShCirHSLS_2_CA "DINH/Zugeordnete FId für Verriegelungsquelle DFC_IVDiaCylShCirHSLS_2" VAL_BLK 0x80025100 ValA_Wu16 688. DINH_FIdVerb 0.00 688. FORMAT "%2.0" NUMBER 7 /end CHARACTERISTIC
/begin CHARACTERISTIC DINH_FId.DFC_IVDiaCylShCirHSLS_3_CA "DINH/Zugeordnete FId für Verriegelungsquelle DFC_IVDiaCylShCirHSLS_3" VAL_BLK 0x8002510E ValA_Wu16 688. DINH_FIdVerb 0.00 688. FORMAT "%2.0" NUMBER 7 /end CHARACTERISTIC
/begin CHARACTERISTIC DINH_FId.DFC_IVDiaCylShCirHSLS_4_CA "DINH/Zugeordnete FId für Verriegelungsquelle DFC_IVDiaCylShCirHSLS_4" VAL_BLK 0x8002511C ValA_Wu16 688. DINH_FIdVerb 0.00 688. FORMAT "%2.0" NUMBER 7 /end CHARACTERISTIC
/begin CHARACTERISTIC DINH_FId.DFC_IVDiaCylShCirHSLS_5_CA "DINH/Zugeordnete FId für Verriegelungsquelle DFC_IVDiaCylShCirHSLS_5" VAL_BLK 0x8002512A ValA_Wu16 688. DINH_FIdVerb 0.00 688. FORMAT "%2.0" NUMBER 7 /end CHARACTERISTIC
/begin CHARACTERISTIC DINH_FId.DFC_IVDiaCylShCirMeas_0_CA "DINH/Zugeordnete FId für Verriegelungsquelle DFC_IVDiaCylShCirMeas_0" VAL_BLK 0x80025138 ValA_Wu16 688. DINH_FIdVerb 0.00 688. FORMAT "%2.0" NUMBER 5 /end CHARACTERISTIC
/begin CHARACTERISTIC DINH_FId.DFC_IVDiaCylShCirMeas_1_CA "DINH/Zugeordnete FId für Verriegelungsquelle DFC_IVDiaCylShCirMeas_1" VAL_BLK 0x80025142 ValA_Wu16 688. DINH_FIdVerb 0.00 688. FORMAT "%2.0" NUMBER 5 /end CHARACTERISTIC
/begin CHARACTERISTIC DINH_FId.DFC_IVDiaCylShCirMeas_2_CA "DINH/Zugeordnete FId für Verriegelungsquelle DFC_IVDiaCylShCirMeas_2" VAL_BLK 0x8002514C ValA_Wu16 688. DINH_FIdVerb 0.00 688. FORMAT "%2.0" NUMBER 5 /end CHARACTERISTIC
/begin CHARACTERISTIC DINH_FId.DFC_IVDiaCylShCirMeas_3_CA "DINH/Zugeordnete FId für Verriegelungsquelle DFC_IVDiaCylShCirMeas_3" VAL_BLK 0x80025156 ValA_Wu16 688. DINH_FIdVerb 0.00 688. FORMAT "%2.0" NUMBER 5 /end CHARACTERISTIC
/begin CHARACTERISTIC DINH_FId.DFC_IVDiaCylShCirMeas_4_CA "DINH/Zugeordnete FId für Verriegelungsquelle DFC_IVDiaCylShCirMeas_4" VAL_BLK 0x80025160 ValA_Wu16 688. DINH_FIdVerb 0.00 688. FORMAT "%2.0" NUMBER 5 /end CHARACTERISTIC
/begin CHARACTERISTIC DINH_FId.DFC_IVDiaCylShCirMeas_5_CA "DINH/Zugeordnete FId für Verriegelungsquelle DFC_IVDiaCylShCirMeas_5" VAL_BLK 0x8002516A ValA_Wu16 688. DINH_FIdVerb 0.00 688. FORMAT "%2.0" NUMBER 5 /end CHARACTERISTIC
/begin CHARACTERISTIC DINH_FId.DFC_LSUDynChk_CA "DINH/Zugeordnete FId für Verriegelungsquelle DFC_LSUDynChk" VAL_BLK 0x80025174 ValA_Wu16 688. DINH_FIdVerb 0.00 688. FORMAT "%2.0" NUMBER 6 /end CHARACTERISTIC
/begin CHARACTERISTIC DINH_FId.DFC_LSUO2ClbMax_CA "DINH/Zugeordnete FId für Verriegelungsquelle DFC_LSUO2ClbMax" VAL_BLK 0x80025180 ValA_Wu16 688. DINH_FIdVerb 0.00 688. FORMAT "%2.0" NUMBER 11 /end CHARACTERISTIC
/begin CHARACTERISTIC DINH_FId.DFC_LSUO2ClbMin_CA "DINH/Zugeordnete FId für Verriegelungsquelle DFC_LSUO2ClbMin" VAL_BLK 0x80025196 ValA_Wu16 688. DINH_FIdVerb 0.00 688. FORMAT "%2.0" NUMBER 11 /end CHARACTERISTIC
/begin CHARACTERISTIC DINH_FId.DFC_LSUO2PlausMaxFLd_CA "DINH/Zugeordnete FId für Verriegelungsquelle DFC_LSUO2PlausMaxFLd" VAL_BLK 0x800251AC ValA_Wu16 688. DINH_FIdVerb 0.00 688. FORMAT "%2.0" NUMBER 6 /end CHARACTERISTIC
/begin CHARACTERISTIC DINH_FId.DFC_LSUO2PlausMaxOvrRun_CA "DINH/Zugeordnete FId für Verriegelungsquelle DFC_LSUO2PlausMaxOvrRun" VAL_BLK 0x800251B8 ValA_Wu16 688. DINH_FIdVerb 0.00 688. FORMAT "%2.0" NUMBER 6 /end CHARACTERISTIC
/begin CHARACTERISTIC DINH_FId.DFC_LSUO2PlausMaxPartLd_CA "DINH/Zugeordnete FId für Verriegelungsquelle DFC_LSUO2PlausMaxPartLd" VAL_BLK 0x800251C4 ValA_Wu16 688. DINH_FIdVerb 0.00 688. FORMAT "%2.0" NUMBER 6 /end CHARACTERISTIC
/begin CHARACTERISTIC DINH_FId.DFC_LSUO2PlausMinFLd_CA "DINH/Zugeordnete FId für Verriegelungsquelle DFC_LSUO2PlausMinFLd" VAL_BLK 0x800251D0 ValA_Wu16 688. DINH_FIdVerb 0.00 688. FORMAT "%2.0" NUMBER 6 /end CHARACTERISTIC
/begin CHARACTERISTIC DINH_FId.DFC_LSUO2PlausMinOvrRun_CA "DINH/Zugeordnete FId für Verriegelungsquelle DFC_LSUO2PlausMinOvrRun" VAL_BLK 0x800251DC ValA_Wu16 688. DINH_FIdVerb 0.00 688. FORMAT "%2.0" NUMBER 6 /end CHARACTERISTIC
/begin CHARACTERISTIC DINH_FId.DFC_LSUO2PlausMinPartLd_CA "DINH/Zugeordnete FId für Verriegelungsquelle DFC_LSUO2PlausMinPartLd" VAL_BLK 0x800251E8 ValA_Wu16 688. DINH_FIdVerb 0.00 688. FORMAT "%2.0" NUMBER 6 /end CHARACTERISTIC
/begin CHARACTERISTIC DINH_FId.DFC_LSURiClbMax_CA "DINH/Zugeordnete FId für Verriegelungsquelle DFC_LSURiClbMax" VAL_BLK 0x800251F4 ValA_Wu16 688. DINH_FIdVerb 0.00 688. FORMAT "%2.0" NUMBER 13 /end CHARACTERISTIC
/begin CHARACTERISTIC DINH_FId.DFC_LSURiClbMin_CA "DINH/Zugeordnete FId für Verriegelungsquelle DFC_LSURiClbMin" VAL_BLK 0x8002520E ValA_Wu16 688. DINH_FIdVerb 0.00 688. FORMAT "%2.0" NUMBER 13 /end CHARACTERISTIC
/begin CHARACTERISTIC DINH_FId.DFC_LSUWireIPSig_CA "DINH/Zugeordnete FId für Verriegelungsquelle DFC_LSUWireIPSig" VAL_BLK 0x80025228 ValA_Wu16 688. DINH_FIdVerb 0.00 688. FORMAT "%2.0" NUMBER 11 /end CHARACTERISTIC
/begin CHARACTERISTIC DINH_FId.DFC_Layer_BSDMax_CA "DINH/Zugeordnete FId für Verriegelungsquelle DFC_Layer_BSDMax" VAL_BLK 0x8002523E ValA_Wu16 688. DINH_FIdVerb 0.00 688. FORMAT "%2.0" NUMBER 2 /end CHARACTERISTIC
/begin CHARACTERISTIC DINH_FId.DFC_Layer_BSDMin_CA "DINH/Zugeordnete FId für Verriegelungsquelle DFC_Layer_BSDMin" VAL_BLK 0x80025242 ValA_Wu16 688. DINH_FIdVerb 0.00 688. FORMAT "%2.0" NUMBER 2 /end CHARACTERISTIC
/begin CHARACTERISTIC DINH_FId.DFC_Layer_BSDNpl_CA "DINH/Zugeordnete FId für Verriegelungsquelle DFC_Layer_BSDNpl" VAL_BLK 0x80025246 ValA_Wu16 688. DINH_FIdVerb 0.00 688. FORMAT "%2.0" NUMBER 2 /end CHARACTERISTIC
/begin CHARACTERISTIC DINH_FId.DFC_Layer_BSDSig_CA "DINH/Zugeordnete FId für Verriegelungsquelle DFC_Layer_BSDSig" VAL_BLK 0x8002524A ValA_Wu16 688. DINH_FIdVerb 0.00 688. FORMAT "%2.0" NUMBER 2 /end CHARACTERISTIC
/begin CHARACTERISTIC DINH_FId.DFC_Layer_FltMngTstMax_CA "DINH/Zugeordnete FId für Verriegelungsquelle DFC_Layer_FltMngTstMax" VAL_BLK 0x8002524E ValA_Wu16 688. DINH_FIdVerb 0.00 688. FORMAT "%2.0" NUMBER 2 /end CHARACTERISTIC
/begin CHARACTERISTIC DINH_FId.DFC_Layer_FltMngTstMin_CA "DINH/Zugeordnete FId für Verriegelungsquelle DFC_Layer_FltMngTstMin" VAL_BLK 0x80025252 ValA_Wu16 688. DINH_FIdVerb 0.00 688. FORMAT "%2.0" NUMBER 2 /end CHARACTERISTIC
/begin CHARACTERISTIC DINH_FId.DFC_Layer_FltMngTstNpl_CA "DINH/Zugeordnete FId für Verriegelungsquelle DFC_Layer_FltMngTstNpl" VAL_BLK 0x80025256 ValA_Wu16 688. DINH_FIdVerb 0.00 688. FORMAT "%2.0" NUMBER 2 /end CHARACTERISTIC
/begin CHARACTERISTIC DINH_FId.DFC_Layer_FltMngTstSig_CA "DINH/Zugeordnete FId für Verriegelungsquelle DFC_Layer_FltMngTstSig" VAL_BLK 0x8002525A ValA_Wu16 688. DINH_FIdVerb 0.00 688. FORMAT "%2.0" NUMBER 2 /end CHARACTERISTIC
/begin CHARACTERISTIC DINH_FId.DFC_Layer_GENELBMax_CA "DINH/Zugeordnete FId für Verriegelungsquelle DFC_Layer_GENELBMax" VAL_BLK 0x8002525E ValA_Wu16 688. DINH_FIdVerb 0.00 688. FORMAT "%2.0" NUMBER 2 /end CHARACTERISTIC
/begin CHARACTERISTIC DINH_FId.DFC_Layer_GENELBMin_CA "DINH/Zugeordnete FId für Verriegelungsquelle DFC_Layer_GENELBMin" VAL_BLK 0x80025262 ValA_Wu16 688. DINH_FIdVerb 0.00 688. FORMAT "%2.0" NUMBER 2 /end CHARACTERISTIC
/begin CHARACTERISTIC DINH_FId.DFC_Layer_GENELBNpl_CA "DINH/Zugeordnete FId für Verriegelungsquelle DFC_Layer_GENELBNpl" VAL_BLK 0x80025266 ValA_Wu16 688. DINH_FIdVerb 0.00 688. FORMAT "%2.0" NUMBER 2 /end CHARACTERISTIC
/begin CHARACTERISTIC DINH_FId.DFC_Layer_GENELBSig_CA "DINH/Zugeordnete FId für Verriegelungsquelle DFC_Layer_GENELBSig" VAL_BLK 0x8002526A ValA_Wu16 688. DINH_FIdVerb 0.00 688. FORMAT "%2.0" NUMBER 2 /end CHARACTERISTIC
/begin CHARACTERISTIC DINH_FId.DFC_Layer_GENELMax_CA "DINH/Zugeordnete FId für Verriegelungsquelle DFC_Layer_GENELMax" VAL_BLK 0x8002526E ValA_Wu16 688. DINH_FIdVerb 0.00 688. FORMAT "%2.0" NUMBER 2 /end CHARACTERISTIC
/begin CHARACTERISTIC DINH_FId.DFC_Layer_GENELMin_CA "DINH/Zugeordnete FId für Verriegelungsquelle DFC_Layer_GENELMin" VAL_BLK 0x80025272 ValA_Wu16 688. DINH_FIdVerb 0.00 688. FORMAT "%2.0" NUMBER 2 /end CHARACTERISTIC
/begin CHARACTERISTIC DINH_FId.DFC_Layer_GENELNpl_CA "DINH/Zugeordnete FId für Verriegelungsquelle DFC_Layer_GENELNpl" VAL_BLK 0x80025276 ValA_Wu16 688. DINH_FIdVerb 0.00 688. FORMAT "%2.0" NUMBER 2 /end CHARACTERISTIC
/begin CHARACTERISTIC DINH_FId.DFC_Layer_GENELSig_CA "DINH/Zugeordnete FId für Verriegelungsquelle DFC_Layer_GENELSig" VAL_BLK 0x8002527A ValA_Wu16 688. DINH_FIdVerb 0.00 688. FORMAT "%2.0" NUMBER 2 /end CHARACTERISTIC
/begin CHARACTERISTIC DINH_FId.DFC_Layer_GENHTBMax_CA "DINH/Zugeordnete FId für Verriegelungsquelle DFC_Layer_GENHTBMax" VAL_BLK 0x8002527E ValA_Wu16 688. DINH_FIdVerb 0.00 688. FORMAT "%2.0" NUMBER 2 /end CHARACTERISTIC
/begin CHARACTERISTIC DINH_FId.DFC_Layer_GENHTBMin_CA "DINH/Zugeordnete FId für Verriegelungsquelle DFC_Layer_GENHTBMin" VAL_BLK 0x80025282 ValA_Wu16 688. DINH_FIdVerb 0.00 688. FORMAT "%2.0" NUMBER 2 /end CHARACTERISTIC
/begin CHARACTERISTIC DINH_FId.DFC_Layer_GENHTBNpl_CA "DINH/Zugeordnete FId für Verriegelungsquelle DFC_Layer_GENHTBNpl" VAL_BLK 0x80025286 ValA_Wu16 688. DINH_FIdVerb 0.00 688. FORMAT "%2.0" NUMBER 2 /end CHARACTERISTIC
/begin CHARACTERISTIC DINH_FId.DFC_Layer_GENHTBSig_CA "DINH/Zugeordnete FId für Verriegelungsquelle DFC_Layer_GENHTBSig" VAL_BLK 0x8002528A ValA_Wu16 688. DINH_FIdVerb 0.00 688. FORMAT "%2.0" NUMBER 2 /end CHARACTERISTIC
/begin CHARACTERISTIC DINH_FId.DFC_Layer_GENHTMax_CA "DINH/Zugeordnete FId für Verriegelungsquelle DFC_Layer_GENHTMax" VAL_BLK 0x8002528E ValA_Wu16 688. DINH_FIdVerb 0.00 688. FORMAT "%2.0" NUMBER 2 /end CHARACTERISTIC
/begin CHARACTERISTIC DINH_FId.DFC_Layer_GENHTMin_CA "DINH/Zugeordnete FId für Verriegelungsquelle DFC_Layer_GENHTMin" VAL_BLK 0x80025292 ValA_Wu16 688. DINH_FIdVerb 0.00 688. FORMAT "%2.0" NUMBER 2 /end CHARACTERISTIC
/begin CHARACTERISTIC DINH_FId.DFC_Layer_GENHTNpl_CA "DINH/Zugeordnete FId für Verriegelungsquelle DFC_Layer_GENHTNpl" VAL_BLK 0x80025296 ValA_Wu16 688. DINH_FIdVerb 0.00 688. FORMAT "%2.0" NUMBER 2 /end CHARACTERISTIC
/begin CHARACTERISTIC DINH_FId.DFC_Layer_GENHTSig_CA "DINH/Zugeordnete FId für Verriegelungsquelle DFC_Layer_GENHTSig" VAL_BLK 0x8002529A ValA_Wu16 688. DINH_FIdVerb 0.00 688. FORMAT "%2.0" NUMBER 2 /end CHARACTERISTIC
/begin CHARACTERISTIC DINH_FId.DFC_Layer_GENKOMMMax_CA "DINH/Zugeordnete FId für Verriegelungsquelle DFC_Layer_GENKOMMMax" VAL_BLK 0x8002529E ValA_Wu16 688. DINH_FIdVerb 0.00 688. FORMAT "%2.0" NUMBER 2 /end CHARACTERISTIC
/begin CHARACTERISTIC DINH_FId.DFC_Layer_GENKOMMMin_CA "DINH/Zugeordnete FId für Verriegelungsquelle DFC_Layer_GENKOMMMin" VAL_BLK 0x800252A2 ValA_Wu16 688. DINH_FIdVerb 0.00 688. FORMAT "%2.0" NUMBER 2 /end CHARACTERISTIC
/begin CHARACTERISTIC DINH_FId.DFC_Layer_GENKOMMNpl_CA "DINH/Zugeordnete FId für Verriegelungsquelle DFC_Layer_GENKOMMNpl" VAL_BLK 0x800252A6 ValA_Wu16 688. DINH_FIdVerb 0.00 688. FORMAT "%2.0" NUMBER 2 /end CHARACTERISTIC
/begin CHARACTERISTIC DINH_FId.DFC_Layer_GENKOMMSig_CA "DINH/Zugeordnete FId für Verriegelungsquelle DFC_Layer_GENKOMMSig" VAL_BLK 0x800252AA ValA_Wu16 688. DINH_FIdVerb 0.00 688. FORMAT "%2.0" NUMBER 2 /end CHARACTERISTIC
/begin CHARACTERISTIC DINH_FId.DFC_Layer_GENMECHMax_CA "DINH/Zugeordnete FId für Verriegelungsquelle DFC_Layer_GENMECHMax" VAL_BLK 0x800252AE ValA_Wu16 688. DINH_FIdVerb 0.00 688. FORMAT "%2.0" NUMBER 2 /end CHARACTERISTIC
/begin CHARACTERISTIC DINH_FId.DFC_Layer_GENMECHMin_CA "DINH/Zugeordnete FId für Verriegelungsquelle DFC_Layer_GENMECHMin" VAL_BLK 0x800252B2 ValA_Wu16 688. DINH_FIdVerb 0.00 688. FORMAT "%2.0" NUMBER 2 /end CHARACTERISTIC
/begin CHARACTERISTIC DINH_FId.DFC_Layer_GENMECHNpl_CA "DINH/Zugeordnete FId für Verriegelungsquelle DFC_Layer_GENMECHNpl" VAL_BLK 0x800252B6 ValA_Wu16 688. DINH_FIdVerb 0.00 688. FORMAT "%2.0" NUMBER 2 /end CHARACTERISTIC
/begin CHARACTERISTIC DINH_FId.DFC_Layer_GENMECHSig_CA "DINH/Zugeordnete FId für Verriegelungsquelle DFC_Layer_GENMECHSig" VAL_BLK 0x800252BA ValA_Wu16 688. DINH_FIdVerb 0.00 688. FORMAT "%2.0" NUMBER 2 /end CHARACTERISTIC
/begin CHARACTERISTIC DINH_FId.DFC_Layer_GENMax_CA "DINH/Zugeordnete FId für Verriegelungsquelle DFC_Layer_GENMax" VAL_BLK 0x800252BE ValA_Wu16 688. DINH_FIdVerb 0.00 688. FORMAT "%2.0" NUMBER 2 /end CHARACTERISTIC
/begin CHARACTERISTIC DINH_FId.DFC_Layer_GENMin_CA "DINH/Zugeordnete FId für Verriegelungsquelle DFC_Layer_GENMin" VAL_BLK 0x800252C2 ValA_Wu16 688. DINH_FIdVerb 0.00 688. FORMAT "%2.0" NUMBER 2 /end CHARACTERISTIC
/begin CHARACTERISTIC DINH_FId.DFC_Layer_GENNpl_CA "DINH/Zugeordnete FId für Verriegelungsquelle DFC_Layer_GENNpl" VAL_BLK 0x800252C6 ValA_Wu16 688. DINH_FIdVerb 0.00 688. FORMAT "%2.0" NUMBER 2 /end CHARACTERISTIC
/begin CHARACTERISTIC DINH_FId.DFC_Layer_GENREGUPLMax_CA "DINH/Zugeordnete FId für Verriegelungsquelle DFC_Layer_GENREGUPLMax" VAL_BLK 0x800252CA ValA_Wu16 688. DINH_FIdVerb 0.00 688. FORMAT "%2.0" NUMBER 2 /end CHARACTERISTIC
/begin CHARACTERISTIC DINH_FId.DFC_Layer_GENREGUPLMin_CA "DINH/Zugeordnete FId für Verriegelungsquelle DFC_Layer_GENREGUPLMin" VAL_BLK 0x800252CE ValA_Wu16 688. DINH_FIdVerb 0.00 688. FORMAT "%2.0" NUMBER 2 /end CHARACTERISTIC
/begin CHARACTERISTIC DINH_FId.DFC_Layer_GENREGUPLNpl_CA "DINH/Zugeordnete FId für Verriegelungsquelle DFC_Layer_GENREGUPLNpl" VAL_BLK 0x800252D2 ValA_Wu16 688. DINH_FIdVerb 0.00 688. FORMAT "%2.0" NUMBER 2 /end CHARACTERISTIC
/begin CHARACTERISTIC DINH_FId.DFC_Layer_GENREGUPLSig_CA "DINH/Zugeordnete FId für Verriegelungsquelle DFC_Layer_GENREGUPLSig" VAL_BLK 0x800252D6 ValA_Wu16 688. DINH_FIdVerb 0.00 688. FORMAT "%2.0" NUMBER 2 /end CHARACTERISTIC
/begin CHARACTERISTIC DINH_FId.DFC_Layer_GENSig_CA "DINH/Zugeordnete FId für Verriegelungsquelle DFC_Layer_GENSig" VAL_BLK 0x800252DA ValA_Wu16 688. DINH_FIdVerb 0.00 688. FORMAT "%2.0" NUMBER 2 /end CHARACTERISTIC
/begin CHARACTERISTIC DINH_FId.DFC_Layer_GENUPLMax_CA "DINH/Zugeordnete FId für Verriegelungsquelle DFC_Layer_GENUPLMax" VAL_BLK 0x800252DE ValA_Wu16 688. DINH_FIdVerb 0.00 688. FORMAT "%2.0" NUMBER 2 /end CHARACTERISTIC
/begin CHARACTERISTIC DINH_FId.DFC_Layer_GENUPLMin_CA "DINH/Zugeordnete FId für Verriegelungsquelle DFC_Layer_GENUPLMin" VAL_BLK 0x800252E2 ValA_Wu16 688. DINH_FIdVerb 0.00 688. FORMAT "%2.0" NUMBER 2 /end CHARACTERISTIC
/begin CHARACTERISTIC DINH_FId.DFC_Layer_GENUPLNpl_CA "DINH/Zugeordnete FId für Verriegelungsquelle DFC_Layer_GENUPLNpl" VAL_BLK 0x800252E6 ValA_Wu16 688. DINH_FIdVerb 0.00 688. FORMAT "%2.0" NUMBER 2 /end CHARACTERISTIC
/begin CHARACTERISTIC DINH_FId.DFC_Layer_GENUPLSig_CA "DINH/Zugeordnete FId für Verriegelungsquelle DFC_Layer_GENUPLSig" VAL_BLK 0x800252EA ValA_Wu16 688. DINH_FIdVerb 0.00 688. FORMAT "%2.0" NUMBER 2 /end CHARACTERISTIC
/begin CHARACTERISTIC DINH_FId.DFC_Layer_IBS1Max_CA "DINH/Zugeordnete FId für Verriegelungsquelle DFC_Layer_IBS1Max" VAL_BLK 0x800252EE ValA_Wu16 688. DINH_FIdVerb 0.00 688. FORMAT "%2.0" NUMBER 2 /end CHARACTERISTIC
/begin CHARACTERISTIC DINH_FId.DFC_Layer_IBS1Min_CA "DINH/Zugeordnete FId für Verriegelungsquelle DFC_Layer_IBS1Min" VAL_BLK 0x800252F2 ValA_Wu16 688. DINH_FIdVerb 0.00 688. FORMAT "%2.0" NUMBER 2 /end CHARACTERISTIC
/begin CHARACTERISTIC DINH_FId.DFC_Layer_IBS1Npl_CA "DINH/Zugeordnete FId für Verriegelungsquelle DFC_Layer_IBS1Npl" VAL_BLK 0x800252F6 ValA_Wu16 688. DINH_FIdVerb 0.00 688. FORMAT "%2.0" NUMBER 2 /end CHARACTERISTIC
/begin CHARACTERISTIC DINH_FId.DFC_Layer_IBS1Sig_CA "DINH/Zugeordnete FId für Verriegelungsquelle DFC_Layer_IBS1Sig" VAL_BLK 0x800252FA ValA_Wu16 688. DINH_FIdVerb 0.00 688. FORMAT "%2.0" NUMBER 2 /end CHARACTERISTIC
/begin CHARACTERISTIC DINH_FId.DFC_Layer_IBS2Max_CA "DINH/Zugeordnete FId für Verriegelungsquelle DFC_Layer_IBS2Max" VAL_BLK 0x800252FE ValA_Wu16 688. DINH_FIdVerb 0.00 688. FORMAT "%2.0" NUMBER 2 /end CHARACTERISTIC
/begin CHARACTERISTIC DINH_FId.DFC_Layer_IBS2Min_CA "DINH/Zugeordnete FId für Verriegelungsquelle DFC_Layer_IBS2Min" VAL_BLK 0x80025302 ValA_Wu16 688. DINH_FIdVerb 0.00 688. FORMAT "%2.0" NUMBER 2 /end CHARACTERISTIC
/begin CHARACTERISTIC DINH_FId.DFC_Layer_IBS2Npl_CA "DINH/Zugeordnete FId für Verriegelungsquelle DFC_Layer_IBS2Npl" VAL_BLK 0x80025306 ValA_Wu16 688. DINH_FIdVerb 0.00 688. FORMAT "%2.0" NUMBER 2 /end CHARACTERISTIC
/begin CHARACTERISTIC DINH_FId.DFC_Layer_IBS2Sig_CA "DINH/Zugeordnete FId für Verriegelungsquelle DFC_Layer_IBS2Sig" VAL_BLK 0x8002530A ValA_Wu16 688. DINH_FIdVerb 0.00 688. FORMAT "%2.0" NUMBER 2 /end CHARACTERISTIC
/begin CHARACTERISTIC DINH_FId.DFC_Layer_IBS3Max_CA "DINH/Zugeordnete FId für Verriegelungsquelle DFC_Layer_IBS3Max" VAL_BLK 0x8002530E ValA_Wu16 688. DINH_FIdVerb 0.00 688. FORMAT "%2.0" NUMBER 2 /end CHARACTERISTIC
/begin CHARACTERISTIC DINH_FId.DFC_Layer_IBS3Min_CA "DINH/Zugeordnete FId für Verriegelungsquelle DFC_Layer_IBS3Min" VAL_BLK 0x80025312 ValA_Wu16 688. DINH_FIdVerb 0.00 688. FORMAT "%2.0" NUMBER 2 /end CHARACTERISTIC
/begin CHARACTERISTIC DINH_FId.DFC_Layer_IBS3Npl_CA "DINH/Zugeordnete FId für Verriegelungsquelle DFC_Layer_IBS3Npl" VAL_BLK 0x80025316 ValA_Wu16 688. DINH_FIdVerb 0.00 688. FORMAT "%2.0" NUMBER 2 /end CHARACTERISTIC
/begin CHARACTERISTIC DINH_FId.DFC_Layer_IBS3Sig_CA "DINH/Zugeordnete FId für Verriegelungsquelle DFC_Layer_IBS3Sig" VAL_BLK 0x8002531A ValA_Wu16 688. DINH_FIdVerb 0.00 688. FORMAT "%2.0" NUMBER 2 /end CHARACTERISTIC
/begin CHARACTERISTIC DINH_FId.DFC_Layer_MANDETEKMax_CA "DINH/Zugeordnete FId für Verriegelungsquelle DFC_Layer_MANDETEKMax" VAL_BLK 0x8002531E ValA_Wu16 688. DINH_FIdVerb 0.00 688. FORMAT "%2.0" NUMBER 2 /end CHARACTERISTIC
/begin CHARACTERISTIC DINH_FId.DFC_Layer_MANDETEKMin_CA "DINH/Zugeordnete FId für Verriegelungsquelle DFC_Layer_MANDETEKMin" VAL_BLK 0x80025322 ValA_Wu16 688. DINH_FIdVerb 0.00 688. FORMAT "%2.0" NUMBER 2 /end CHARACTERISTIC
/begin CHARACTERISTIC DINH_FId.DFC_Layer_MANDETEKNpl_CA "DINH/Zugeordnete FId für Verriegelungsquelle DFC_Layer_MANDETEKNpl" VAL_BLK 0x80025326 ValA_Wu16 688. DINH_FIdVerb 0.00 688. FORMAT "%2.0" NUMBER 2 /end CHARACTERISTIC
/begin CHARACTERISTIC DINH_FId.DFC_Layer_MANDETEKSig_CA "DINH/Zugeordnete FId für Verriegelungsquelle DFC_Layer_MANDETEKSig" VAL_BLK 0x8002532A ValA_Wu16 688. DINH_FIdVerb 0.00 688. FORMAT "%2.0" NUMBER 2 /end CHARACTERISTIC
/begin CHARACTERISTIC DINH_FId.DFC_Layer_NDR1Max_CA "DINH/Zugeordnete FId für Verriegelungsquelle DFC_Layer_NDR1Max" VAL_BLK 0x8002532E ValA_Wu16 688. DINH_FIdVerb 0.00 688. FORMAT "%2.0" NUMBER 2 /end CHARACTERISTIC
/begin CHARACTERISTIC DINH_FId.DFC_Layer_NDR1Min_CA "DINH/Zugeordnete FId für Verriegelungsquelle DFC_Layer_NDR1Min" VAL_BLK 0x80025332 ValA_Wu16 688. DINH_FIdVerb 0.00 688. FORMAT "%2.0" NUMBER 2 /end CHARACTERISTIC
/begin CHARACTERISTIC DINH_FId.DFC_Layer_NDR1Npl_CA "DINH/Zugeordnete FId für Verriegelungsquelle DFC_Layer_NDR1Npl" VAL_BLK 0x80025336 ValA_Wu16 688. DINH_FIdVerb 0.00 688. FORMAT "%2.0" NUMBER 2 /end CHARACTERISTIC
/begin CHARACTERISTIC DINH_FId.DFC_Layer_NDR1Sig_CA "DINH/Zugeordnete FId für Verriegelungsquelle DFC_Layer_NDR1Sig" VAL_BLK 0x8002533A ValA_Wu16 688. DINH_FIdVerb 0.00 688. FORMAT "%2.0" NUMBER 2 /end CHARACTERISTIC
/begin CHARACTERISTIC DINH_FId.DFC_Layer_NDR2Max_CA "DINH/Zugeordnete FId für Verriegelungsquelle DFC_Layer_NDR2Max" VAL_BLK 0x8002533E ValA_Wu16 688. DINH_FIdVerb 0.00 688. FORMAT "%2.0" NUMBER 2 /end CHARACTERISTIC
/begin CHARACTERISTIC DINH_FId.DFC_Layer_NDR2Min_CA "DINH/Zugeordnete FId für Verriegelungsquelle DFC_Layer_NDR2Min" VAL_BLK 0x80025342 ValA_Wu16 688. DINH_FIdVerb 0.00 688. FORMAT "%2.0" NUMBER 2 /end CHARACTERISTIC
/begin CHARACTERISTIC DINH_FId.DFC_Layer_NDR2Npl_CA "DINH/Zugeordnete FId für Verriegelungsquelle DFC_Layer_NDR2Npl" VAL_BLK 0x80025346 ValA_Wu16 688. DINH_FIdVerb 0.00 688. FORMAT "%2.0" NUMBER 2 /end CHARACTERISTIC
/begin CHARACTERISTIC DINH_FId.DFC_Layer_NDR2Sig_CA "DINH/Zugeordnete FId für Verriegelungsquelle DFC_Layer_NDR2Sig" VAL_BLK 0x8002534A ValA_Wu16 688. DINH_FIdVerb 0.00 688. FORMAT "%2.0" NUMBER 2 /end CHARACTERISTIC
/begin CHARACTERISTIC DINH_FId.DFC_Layer_NGLERNMax_CA "DINH/Zugeordnete FId für Verriegelungsquelle DFC_Layer_NGLERNMax" VAL_BLK 0x8002534E ValA_Wu16 688. DINH_FIdVerb 0.00 688. FORMAT "%2.0" NUMBER 2 /end CHARACTERISTIC
/begin CHARACTERISTIC DINH_FId.DFC_Layer_NGLERNMin_CA "DINH/Zugeordnete FId für Verriegelungsquelle DFC_Layer_NGLERNMin" VAL_BLK 0x80025352 ValA_Wu16 688. DINH_FIdVerb 0.00 688. FORMAT "%2.0" NUMBER 2 /end CHARACTERISTIC
/begin CHARACTERISTIC DINH_FId.DFC_Layer_NGLERNNpl_CA "DINH/Zugeordnete FId für Verriegelungsquelle DFC_Layer_NGLERNNpl" VAL_BLK 0x80025356 ValA_Wu16 688. DINH_FIdVerb 0.00 688. FORMAT "%2.0" NUMBER 2 /end CHARACTERISTIC
/begin CHARACTERISTIC DINH_FId.DFC_Layer_NGLERNSig_CA "DINH/Zugeordnete FId für Verriegelungsquelle DFC_Layer_NGLERNSig" VAL_BLK 0x8002535A ValA_Wu16 688. DINH_FIdVerb 0.00 688. FORMAT "%2.0" NUMBER 2 /end CHARACTERISTIC
/begin CHARACTERISTIC DINH_FId.DFC_Layer_PMBATTMax_CA "DINH/Zugeordnete FId für Verriegelungsquelle DFC_Layer_PMBATTMax" VAL_BLK 0x8002535E ValA_Wu16 688. DINH_FIdVerb 0.00 688. FORMAT "%2.0" NUMBER 2 /end CHARACTERISTIC
/begin CHARACTERISTIC DINH_FId.DFC_Layer_PMBATTMin_CA "DINH/Zugeordnete FId für Verriegelungsquelle DFC_Layer_PMBATTMin" VAL_BLK 0x80025362 ValA_Wu16 688. DINH_FIdVerb 0.00 688. FORMAT "%2.0" NUMBER 2 /end CHARACTERISTIC
/begin CHARACTERISTIC DINH_FId.DFC_Layer_PMBATTNpl_CA "DINH/Zugeordnete FId für Verriegelungsquelle DFC_Layer_PMBATTNpl" VAL_BLK 0x80025366 ValA_Wu16 688. DINH_FIdVerb 0.00 688. FORMAT "%2.0" NUMBER 2 /end CHARACTERISTIC
/begin CHARACTERISTIC DINH_FId.DFC_Layer_PMBATTSig_CA "DINH/Zugeordnete FId für Verriegelungsquelle DFC_Layer_PMBATTSig" VAL_BLK 0x8002536A ValA_Wu16 688. DINH_FIdVerb 0.00 688. FORMAT "%2.0" NUMBER 2 /end CHARACTERISTIC
/begin CHARACTERISTIC DINH_FId.DFC_Layer_PMBNMax_CA "DINH/Zugeordnete FId für Verriegelungsquelle DFC_Layer_PMBNMax" VAL_BLK 0x8002536E ValA_Wu16 688. DINH_FIdVerb 0.00 688. FORMAT "%2.0" NUMBER 2 /end CHARACTERISTIC
/begin CHARACTERISTIC DINH_FId.DFC_Layer_PMBNMin_CA "DINH/Zugeordnete FId für Verriegelungsquelle DFC_Layer_PMBNMin" VAL_BLK 0x80025372 ValA_Wu16 688. DINH_FIdVerb 0.00 688. FORMAT "%2.0" NUMBER 2 /end CHARACTERISTIC
/begin CHARACTERISTIC DINH_FId.DFC_Layer_PMBNNpl_CA "DINH/Zugeordnete FId für Verriegelungsquelle DFC_Layer_PMBNNpl" VAL_BLK 0x80025376 ValA_Wu16 688. DINH_FIdVerb 0.00 688. FORMAT "%2.0" NUMBER 2 /end CHARACTERISTIC
/begin CHARACTERISTIC DINH_FId.DFC_Layer_PMBNSig_CA "DINH/Zugeordnete FId für Verriegelungsquelle DFC_Layer_PMBNSig" VAL_BLK 0x8002537A ValA_Wu16 688. DINH_FIdVerb 0.00 688. FORMAT "%2.0" NUMBER 2 /end CHARACTERISTIC
/begin CHARACTERISTIC DINH_FId.DFC_Layer_PMRUHVERLMax_CA "DINH/Zugeordnete FId für Verriegelungsquelle DFC_Layer_PMRUHVERLMax" VAL_BLK 0x8002537E ValA_Wu16 688. DINH_FIdVerb 0.00 688. FORMAT "%2.0" NUMBER 2 /end CHARACTERISTIC
/begin CHARACTERISTIC DINH_FId.DFC_Layer_PMRUHVERLMin_CA "DINH/Zugeordnete FId für Verriegelungsquelle DFC_Layer_PMRUHVERLMin" VAL_BLK 0x80025382 ValA_Wu16 688. DINH_FIdVerb 0.00 688. FORMAT "%2.0" NUMBER 2 /end CHARACTERISTIC
/begin CHARACTERISTIC DINH_FId.DFC_Layer_PMRUHVERLNpl_CA "DINH/Zugeordnete FId für Verriegelungsquelle DFC_Layer_PMRUHVERLNpl" VAL_BLK 0x80025386 ValA_Wu16 688. DINH_FIdVerb 0.00 688. FORMAT "%2.0" NUMBER 2 /end CHARACTERISTIC
/begin CHARACTERISTIC DINH_FId.DFC_Layer_PMRUHVERLSig_CA "DINH/Zugeordnete FId für Verriegelungsquelle DFC_Layer_PMRUHVERLSig" VAL_BLK 0x8002538A ValA_Wu16 688. DINH_FIdVerb 0.00 688. FORMAT "%2.0" NUMBER 2 /end CHARACTERISTIC
/begin CHARACTERISTIC DINH_FId.DFC_Layer_QLTMax_CA "DINH/Zugeordnete FId für Verriegelungsquelle DFC_Layer_QLTMax" VAL_BLK 0x8002538E ValA_Wu16 688. DINH_FIdVerb 0.00 688. FORMAT "%2.0" NUMBER 2 /end CHARACTERISTIC
/begin CHARACTERISTIC DINH_FId.DFC_Layer_QLTMin_CA "DINH/Zugeordnete FId für Verriegelungsquelle DFC_Layer_QLTMin" VAL_BLK 0x80025392 ValA_Wu16 688. DINH_FIdVerb 0.00 688. FORMAT "%2.0" NUMBER 2 /end CHARACTERISTIC
/begin CHARACTERISTIC DINH_FId.DFC_Layer_QLTNpl_CA "DINH/Zugeordnete FId für Verriegelungsquelle DFC_Layer_QLTNpl" VAL_BLK 0x80025396 ValA_Wu16 688. DINH_FIdVerb 0.00 688. FORMAT "%2.0" NUMBER 2 /end CHARACTERISTIC
/begin CHARACTERISTIC DINH_FId.DFC_Layer_QLTSig_CA "DINH/Zugeordnete FId für Verriegelungsquelle DFC_Layer_QLTSig" VAL_BLK 0x8002539A ValA_Wu16 688. DINH_FIdVerb 0.00 688. FORMAT "%2.0" NUMBER 2 /end CHARACTERISTIC
/begin CHARACTERISTIC DINH_FId.DFC_Layer_TOENSMax_CA "DINH/Zugeordnete FId für Verriegelungsquelle DFC_Layer_TOENSMax" VAL_BLK 0x8002539E ValA_Wu16 688. DINH_FIdVerb 0.00 688. FORMAT "%2.0" NUMBER 2 /end CHARACTERISTIC
/begin CHARACTERISTIC DINH_FId.DFC_Layer_TOENSMin_CA "DINH/Zugeordnete FId für Verriegelungsquelle DFC_Layer_TOENSMin" VAL_BLK 0x800253A2 ValA_Wu16 688. DINH_FIdVerb 0.00 688. FORMAT "%2.0" NUMBER 2 /end CHARACTERISTIC
/begin CHARACTERISTIC DINH_FId.DFC_Layer_TOENSNpl_CA "DINH/Zugeordnete FId für Verriegelungsquelle DFC_Layer_TOENSNpl" VAL_BLK 0x800253A6 ValA_Wu16 688. DINH_FIdVerb 0.00 688. FORMAT "%2.0" NUMBER 2 /end CHARACTERISTIC
/begin CHARACTERISTIC DINH_FId.DFC_Layer_TOENSSig_CA "DINH/Zugeordnete FId für Verriegelungsquelle DFC_Layer_TOENSSig" VAL_BLK 0x800253AA ValA_Wu16 688. DINH_FIdVerb 0.00 688. FORMAT "%2.0" NUMBER 2 /end CHARACTERISTIC
/begin CHARACTERISTIC DINH_FId.DFC_MonLimCurr_CA "DINH/Zugeordnete FId für Verriegelungsquelle DFC_MonLimCurr" VAL_BLK 0x800253AE ValA_Wu16 688. DINH_FIdVerb 0.00 688. FORMAT "%2.0" NUMBER 2 /end CHARACTERISTIC
/begin CHARACTERISTIC DINH_FId.DFC_MonLimLead_CA "DINH/Zugeordnete FId für Verriegelungsquelle DFC_MonLimLead" VAL_BLK 0x800253B2 ValA_Wu16 688. DINH_FIdVerb 0.00 688. FORMAT "%2.0" NUMBER 2 /end CHARACTERISTIC
/begin CHARACTERISTIC DINH_FId.DFC_MonLimSet_CA "DINH/Zugeordnete FId für Verriegelungsquelle DFC_MonLimSet" VAL_BLK 0x800253B6 ValA_Wu16 688. DINH_FIdVerb 0.00 688. FORMAT "%2.0" NUMBER 2 /end CHARACTERISTIC
/begin CHARACTERISTIC DINH_FId.DFC_NSCDsNOxOfsMax_CA "DINH/Zugeordnete FId für Verriegelungsquelle DFC_NSCDsNOxOfsMax" VAL_BLK 0x800253BA ValA_Wu16 688. DINH_FIdVerb 0.00 688. FORMAT "%2.0" NUMBER 2 /end CHARACTERISTIC
/begin CHARACTERISTIC DINH_FId.DFC_NSCDsNOxOfsMin_CA "DINH/Zugeordnete FId für Verriegelungsquelle DFC_NSCDsNOxOfsMin" VAL_BLK 0x800253BE ValA_Wu16 688. DINH_FIdVerb 0.00 688. FORMAT "%2.0" NUMBER 2 /end CHARACTERISTIC
/begin CHARACTERISTIC DINH_FId.DFC_NSCDsNOxPlausMin_CA "DINH/Zugeordnete FId für Verriegelungsquelle DFC_NSCDsNOxPlausMin" VAL_BLK 0x800253C2 ValA_Wu16 688. DINH_FIdVerb 0.00 688. FORMAT "%2.0" NUMBER 3 /end CHARACTERISTIC
/begin CHARACTERISTIC DINH_FId.DFC_NoCat2DsNOxOfsMax_CA "DINH/Zugeordnete FId für Verriegelungsquelle DFC_NoCat2DsNOxOfsMax" VAL_BLK 0x800253C8 ValA_Wu16 688. DINH_FIdVerb 0.00 688. FORMAT "%2.0" NUMBER 2 /end CHARACTERISTIC
/begin CHARACTERISTIC DINH_FId.DFC_NoCat2DsNOxOfsMin_CA "DINH/Zugeordnete FId für Verriegelungsquelle DFC_NoCat2DsNOxOfsMin" VAL_BLK 0x800253CC ValA_Wu16 688. DINH_FIdVerb 0.00 688. FORMAT "%2.0" NUMBER 2 /end CHARACTERISTIC
/begin CHARACTERISTIC DINH_FId.DFC_NoCat2DsNOxPlausMin_CA "DINH/Zugeordnete FId für Verriegelungsquelle DFC_NoCat2DsNOxPlausMin" VAL_BLK 0x800253D0 ValA_Wu16 688. DINH_FIdVerb 0.00 688. FORMAT "%2.0" NUMBER 3 /end CHARACTERISTIC
/begin CHARACTERISTIC DINH_FId.DFC_PCVNoStrt_CA "DINH/Zugeordnete FId für Verriegelungsquelle DFC_PCVNoStrt" VAL_BLK 0x800253D6 ValA_Wu16 688. DINH_FIdVerb 0.00 688. FORMAT "%2.0" NUMBER 2 /end CHARACTERISTIC
/begin CHARACTERISTIC DINH_FId.DFC_RailPGradMon_CA "DINH/Zugeordnete FId für Verriegelungsquelle DFC_RailPGradMon" VAL_BLK 0x800253DA ValA_Wu16 688. DINH_FIdVerb 0.00 688. FORMAT "%2.0" NUMBER 2 /end CHARACTERISTIC
/begin CHARACTERISTIC DINH_FId.DFC_SCRPODPresBuildUp_CA "DINH/Zugeordnete FId für Verriegelungsquelle DFC_SCRPODPresBuildUp" VAL_BLK 0x800253DE ValA_Wu16 688. DINH_FIdVerb 0.00 688. FORMAT "%2.0" NUMBER 2 /end CHARACTERISTIC
/begin CHARACTERISTIC DINH_FId.DFC_AFSDrftIdlAdjVal_CA "DINH/Zugeordnete FId für Verriegelungsquelle DFC_AFSDrftIdlAdjVal" VAL_BLK 0x800253E2 ValA_Wu16 688. DINH_FIdVerb 0.00 688. FORMAT "%2.0" NUMBER 6 /end CHARACTERISTIC
/begin CHARACTERISTIC DINH_FId.DFC_AFSDrftLdAdjVal_CA "DINH/Zugeordnete FId für Verriegelungsquelle DFC_AFSDrftLdAdjVal" VAL_BLK 0x800253EE ValA_Wu16 688. DINH_FIdVerb 0.00 688. FORMAT "%2.0" NUMBER 6 /end CHARACTERISTIC
/begin CHARACTERISTIC DINH_FId.DFC_AdcIADC0Cal_CA "DINH/Zugeordnete FId für Verriegelungsquelle DFC_AdcIADC0Cal" VAL_BLK 0x800253FA ValA_Wu16 688. DINH_FIdVerb 0.00 688. FORMAT "%2.0" NUMBER 3 /end CHARACTERISTIC
/begin CHARACTERISTIC DINH_FId.DFC_AdcIADC0Conv_CA "DINH/Zugeordnete FId für Verriegelungsquelle DFC_AdcIADC0Conv" VAL_BLK 0x80025400 ValA_Wu16 688. DINH_FIdVerb 0.00 688. FORMAT "%2.0" NUMBER 3 /end CHARACTERISTIC
/begin CHARACTERISTIC DINH_FId.DFC_AdcIADC1Cal_CA "DINH/Zugeordnete FId für Verriegelungsquelle DFC_AdcIADC1Cal" VAL_BLK 0x80025406 ValA_Wu16 688. DINH_FIdVerb 0.00 688. FORMAT "%2.0" NUMBER 3 /end CHARACTERISTIC
/begin CHARACTERISTIC DINH_FId.DFC_AdcIADC1Conv_CA "DINH/Zugeordnete FId für Verriegelungsquelle DFC_AdcIADC1Conv" VAL_BLK 0x8002540C ValA_Wu16 688. DINH_FIdVerb 0.00 688. FORMAT "%2.0" NUMBER 3 /end CHARACTERISTIC
/begin CHARACTERISTIC DINH_FId.DFC_CmbChbMisfireMax_0_CA "DINH/Zugeordnete FId für Verriegelungsquelle DFC_CmbChbMisfireMax_0" VAL_BLK 0x80025412 ValA_Wu16 688. DINH_FIdVerb 0.00 688. FORMAT "%2.0" NUMBER 2 /end CHARACTERISTIC
/begin CHARACTERISTIC DINH_FId.DFC_CmbChbMisfireMax_1_CA "DINH/Zugeordnete FId für Verriegelungsquelle DFC_CmbChbMisfireMax_1" VAL_BLK 0x80025416 ValA_Wu16 688. DINH_FIdVerb 0.00 688. FORMAT "%2.0" NUMBER 2 /end CHARACTERISTIC
/begin CHARACTERISTIC DINH_FId.DFC_CmbChbMisfireMax_2_CA "DINH/Zugeordnete FId für Verriegelungsquelle DFC_CmbChbMisfireMax_2" VAL_BLK 0x8002541A ValA_Wu16 688. DINH_FIdVerb 0.00 688. FORMAT "%2.0" NUMBER 2 /end CHARACTERISTIC
/begin CHARACTERISTIC DINH_FId.DFC_CmbChbMisfireMax_3_CA "DINH/Zugeordnete FId für Verriegelungsquelle DFC_CmbChbMisfireMax_3" VAL_BLK 0x8002541E ValA_Wu16 688. DINH_FIdVerb 0.00 688. FORMAT "%2.0" NUMBER 2 /end CHARACTERISTIC
/begin CHARACTERISTIC DINH_FId.DFC_CmbChbMisfireMax_4_CA "DINH/Zugeordnete FId für Verriegelungsquelle DFC_CmbChbMisfireMax_4" VAL_BLK 0x80025422 ValA_Wu16 688. DINH_FIdVerb 0.00 688. FORMAT "%2.0" NUMBER 2 /end CHARACTERISTIC
/begin CHARACTERISTIC DINH_FId.DFC_CmbChbMisfireMax_5_CA "DINH/Zugeordnete FId für Verriegelungsquelle DFC_CmbChbMisfireMax_5" VAL_BLK 0x80025426 ValA_Wu16 688. DINH_FIdVerb 0.00 688. FORMAT "%2.0" NUMBER 2 /end CHARACTERISTIC
/begin CHARACTERISTIC DINH_FId.DFC_CmbChbMisfireMul_CA "DINH/Zugeordnete FId für Verriegelungsquelle DFC_CmbChbMisfireMul" VAL_BLK 0x8002542A ValA_Wu16 688. DINH_FIdVerb 0.00 688. FORMAT "%2.0" NUMBER 2 /end CHARACTERISTIC
/begin CHARACTERISTIC DINH_FId.DFC_EGRVlvLPOfsNeutr_CA "DINH/" VAL_BLK 0x8002542E ValA_Wu16 688. DINH_FIdVerb 0.00 688. FORMAT "%2.0" NUMBER 2 /end CHARACTERISTIC
/begin CHARACTERISTIC DINH_FId.DFC_EGRVlvOfsNeutr_CA "DINH/Zugeordnete FId für Verriegelungsquelle DFC_EGRVlvOfsNeutr" VAL_BLK 0x80025432 ValA_Wu16 688. DINH_FIdVerb 0.00 688. FORMAT "%2.0" NUMBER 2 /end CHARACTERISTIC
/begin CHARACTERISTIC DINH_FId.DFC_FMAErrModMax_CA "DINH/Zugeordnete FId für Verriegelungsquelle DFC_FMAErrModMax" VAL_BLK 0x80025436 ValA_Wu16 688. DINH_FIdVerb 0.00 688. FORMAT "%2.0" NUMBER 2 /end CHARACTERISTIC
/begin CHARACTERISTIC DINH_FId.DFC_FMAErrModMin_CA "DINH/Zugeordnete FId für Verriegelungsquelle DFC_FMAErrModMin" VAL_BLK 0x8002543A ValA_Wu16 688. DINH_FIdVerb 0.00 688. FORMAT "%2.0" NUMBER 2 /end CHARACTERISTIC
/begin CHARACTERISTIC DINH_FId.DFC_FlSysTnkLo_CA "DINH/Zugeordnete FId für Verriegelungsquelle DFC_FlSysTnkLo" VAL_BLK 0x8002543E ValA_Wu16 688. DINH_FIdVerb 0.00 688. FORMAT "%2.0" NUMBER 2 /end CHARACTERISTIC
/begin CHARACTERISTIC DINH_FId.DFC_GbxNPosPlaus_CA "DINH/Zugeordnete FId für Verriegelungsquelle DFC_GbxNPosPlaus" VAL_BLK 0x80025442 ValA_Wu16 688. DINH_FIdVerb 0.00 688. FORMAT "%2.0" NUMBER 2 /end CHARACTERISTIC
/begin CHARACTERISTIC DINH_FId.DFC_I14229_ROETst_Appl_CA "DINH/" VAL_BLK 0x80025446 ValA_Wu16 688. DINH_FIdVerb 0.00 688. FORMAT "%2.0" NUMBER 2 /end CHARACTERISTIC
/begin CHARACTERISTIC DINH_FId.DFC_I14229_ROETst_Netw_CA "DINH/" VAL_BLK 0x8002544A ValA_Wu16 688. DINH_FIdVerb 0.00 688. FORMAT "%2.0" NUMBER 2 /end CHARACTERISTIC
/begin CHARACTERISTIC DINH_FId.DFC_I14229_ROE_BufFull_CA "DINH/" VAL_BLK 0x8002544E ValA_Wu16 688. DINH_FIdVerb 0.00 688. FORMAT "%2.0" NUMBER 2 /end CHARACTERISTIC
/begin CHARACTERISTIC DINH_FId.DFC_IVAdjDiaIVAdj_CA "DINH/Zugeordnete FId für Verriegelungsquelle DFC_IVAdjDiaIVAdj" VAL_BLK 0x80025452 ValA_Wu16 688. DINH_FIdVerb 0.00 688. FORMAT "%2.0" NUMBER 2 /end CHARACTERISTIC
/begin CHARACTERISTIC DINH_FId.DFC_IVAdjIVA_0_CA "DINH/Zugeordnete FId für Verriegelungsquelle DFC_IVAdjIVA_0" VAL_BLK 0x80025456 ValA_Wu16 688. DINH_FIdVerb 0.00 688. FORMAT "%2.0" NUMBER 2 /end CHARACTERISTIC
/begin CHARACTERISTIC DINH_FId.DFC_IVAdjIVA_1_CA "DINH/Zugeordnete FId für Verriegelungsquelle DFC_IVAdjIVA_1" VAL_BLK 0x8002545A ValA_Wu16 688. DINH_FIdVerb 0.00 688. FORMAT "%2.0" NUMBER 2 /end CHARACTERISTIC
/begin CHARACTERISTIC DINH_FId.DFC_IVAdjIVA_2_CA "DINH/Zugeordnete FId für Verriegelungsquelle DFC_IVAdjIVA_2" VAL_BLK 0x8002545E ValA_Wu16 688. DINH_FIdVerb 0.00 688. FORMAT "%2.0" NUMBER 2 /end CHARACTERISTIC
/begin CHARACTERISTIC DINH_FId.DFC_IVAdjIVA_3_CA "DINH/Zugeordnete FId für Verriegelungsquelle DFC_IVAdjIVA_3" VAL_BLK 0x80025462 ValA_Wu16 688. DINH_FIdVerb 0.00 688. FORMAT "%2.0" NUMBER 2 /end CHARACTERISTIC
/begin CHARACTERISTIC DINH_FId.DFC_IVAdjIVA_4_CA "DINH/Zugeordnete FId für Verriegelungsquelle DFC_IVAdjIVA_4" VAL_BLK 0x80025466 ValA_Wu16 688. DINH_FIdVerb 0.00 688. FORMAT "%2.0" NUMBER 2 /end CHARACTERISTIC
/begin CHARACTERISTIC DINH_FId.DFC_IVAdjIVA_5_CA "DINH/Zugeordnete FId für Verriegelungsquelle DFC_IVAdjIVA_5" VAL_BLK 0x8002546A ValA_Wu16 688. DINH_FIdVerb 0.00 688. FORMAT "%2.0" NUMBER 2 /end CHARACTERISTIC
/begin CHARACTERISTIC DINH_FId.DFC_IVPSplyDCDCOff_0_CA "DINH/Zugeordnete FId für Verriegelungsquelle DFC_IVPSplyDCDCOff_0" VAL_BLK 0x8002546E ValA_Wu16 688. DINH_FIdVerb 0.00 688. FORMAT "%2.0" NUMBER 3 /end CHARACTERISTIC
/begin CHARACTERISTIC DINH_FId.DFC_IVPSplyDCDCOff_1_CA "DINH/Zugeordnete FId für Verriegelungsquelle DFC_IVPSplyDCDCOff_1" VAL_BLK 0x80025474 ValA_Wu16 688. DINH_FIdVerb 0.00 688. FORMAT "%2.0" NUMBER 3 /end CHARACTERISTIC
/begin CHARACTERISTIC DINH_FId.DFC_IVPSplyDCDCOff_2_CA "DINH/Zugeordnete FId für Verriegelungsquelle DFC_IVPSplyDCDCOff_2" VAL_BLK 0x8002547A ValA_Wu16 688. DINH_FIdVerb 0.00 688. FORMAT "%2.0" NUMBER 3 /end CHARACTERISTIC
/begin CHARACTERISTIC DINH_FId.DFC_IVPSplyDCDCOff_3_CA "DINH/Zugeordnete FId für Verriegelungsquelle DFC_IVPSplyDCDCOff_3" VAL_BLK 0x80025480 ValA_Wu16 688. DINH_FIdVerb 0.00 688. FORMAT "%2.0" NUMBER 3 /end CHARACTERISTIC
/begin CHARACTERISTIC DINH_FId.DFC_InjCtlAdjQntEEPCS_CA "DINH/Zugeordnete FId für Verriegelungsquelle DFC_InjCtlAdjQntEEPCS" VAL_BLK 0x80025486 ValA_Wu16 688. DINH_FIdVerb 0.00 688. FORMAT "%2.0" NUMBER 2 /end CHARACTERISTIC
/begin CHARACTERISTIC DINH_FId.DFC_LSUSPISig_CA "DINH/Zugeordnete FId für Verriegelungsquelle DFC_LSUSPISig" VAL_BLK 0x8002548A ValA_Wu16 688. DINH_FIdVerb 0.00 688. FORMAT "%2.0" NUMBER 20 /end CHARACTERISTIC
/begin CHARACTERISTIC DINH_FId.DFC_Layer_Dummy_CA "DINH/Zugeordnete FId für Verriegelungsquelle DFC_Layer_Dummy" VAL_BLK 0x800254B2 ValA_Wu16 688. DINH_FIdVerb 0.00 688. FORMAT "%2.0" NUMBER 2 /end CHARACTERISTIC
/begin CHARACTERISTIC DINH_FId.DFC_NplEnvPSensPPFltDiff_CA "DINH/Zugeordnete FId für Verriegelungsquelle DFC_NplEnvPSensPPFltDiff" VAL_BLK 0x800254B6 ValA_Wu16 688. DINH_FIdVerb 0.00 688. FORMAT "%2.0" NUMBER 10 /end CHARACTERISTIC
/begin CHARACTERISTIC DINH_FId.DFC_NplPresSensPPFltDiff_CA "DINH/Zugeordnete FId für Verriegelungsquelle DFC_NplPresSensPPFltDiff" VAL_BLK 0x800254CA ValA_Wu16 688. DINH_FIdVerb 0.00 688. FORMAT "%2.0" NUMBER 13 /end CHARACTERISTIC
/begin CHARACTERISTIC DINH_FId.DFC_OilLvlPlaus_CA "DINH/Zugeordnete FId für Verriegelungsquelle DFC_OilLvlPlaus" VAL_BLK 0x800254E4 ValA_Wu16 688. DINH_FIdVerb 0.00 688. FORMAT "%2.0" NUMBER 2 /end CHARACTERISTIC
/begin CHARACTERISTIC DINH_FId.DFC_OilTOutLvl_CA "DINH/Zugeordnete FId für Verriegelungsquelle DFC_OilTOutLvl" VAL_BLK 0x800254E8 ValA_Wu16 688. DINH_FIdVerb 0.00 688. FORMAT "%2.0" NUMBER 2 /end CHARACTERISTIC
/begin CHARACTERISTIC DINH_FId.DFC_PCVfacAdaptMax_CA "DINH/Zugeordnete FId für Verriegelungsquelle DFC_PCVfacAdaptMax" VAL_BLK 0x800254EC ValA_Wu16 688. DINH_FIdVerb 0.00 688. FORMAT "%2.0" NUMBER 2 /end CHARACTERISTIC
/begin CHARACTERISTIC DINH_FId.DFC_PCVfacAdaptMin_CA "DINH/Zugeordnete FId für Verriegelungsquelle DFC_PCVfacAdaptMin" VAL_BLK 0x800254F0 ValA_Wu16 688. DINH_FIdVerb 0.00 688. FORMAT "%2.0" NUMBER 2 /end CHARACTERISTIC
/begin CHARACTERISTIC DINH_FId.DFC_SensFrzPPFltUs_CA "DINH/Zugeordnete FId für Verriegelungsquelle DFC_SensFrzPPFltUs" VAL_BLK 0x800254F4 ValA_Wu16 688. DINH_FIdVerb 0.00 688. FORMAT "%2.0" NUMBER 2 /end CHARACTERISTIC
/begin CHARACTERISTIC DINH_FId.DFC_SensMonUTnkLvl_CA "DINH/Zugeordnete FId für Verriegelungsquelle DFC_SensMonUTnkLvl" VAL_BLK 0x800254F8 ValA_Wu16 688. DINH_FIdVerb 0.00 688. FORMAT "%2.0" NUMBER 4 /end CHARACTERISTIC
/begin CHARACTERISTIC DINH_FId.DFC_T15Sig_CA "DINH/Zugeordnete FId für Verriegelungsquelle DFC_T15Sig" VAL_BLK 0x80025500 ValA_Wu16 688. DINH_FIdVerb 0.00 688. FORMAT "%2.0" NUMBER 2 /end CHARACTERISTIC
/begin CHARACTERISTIC DINH_FId.DFC_AirCtlRmpTOut_CA "DINH/Zugeordnete FId für Verriegelungsquelle DFC_AirCtlRmpTOut" VAL_BLK 0x80025504 ValA_Wu16 688. DINH_FIdVerb 0.00 688. FORMAT "%2.0" NUMBER 2 /end CHARACTERISTIC
/begin CHARACTERISTIC DINH_FId.DFC_BrkPPlaus_CA "DINH/Zugeordnete FId für Verriegelungsquelle DFC_BrkPPlaus" VAL_BLK 0x80025508 ValA_Wu16 688. DINH_FIdVerb 0.00 688. FORMAT "%2.0" NUMBER 2 /end CHARACTERISTIC
/begin CHARACTERISTIC DINH_FId.DFC_CEngDsTDynTst_CA "DINH/Zugeordnete FId für Verriegelungsquelle DFC_CEngDsTDynTst" VAL_BLK 0x8002550C ValA_Wu16 688. DINH_FIdVerb 0.00 688. FORMAT "%2.0" NUMBER 2 /end CHARACTERISTIC
/begin CHARACTERISTIC DINH_FId.DFC_EEPEraseErr_CA "DINH/Zugeordnete FId für Verriegelungsquelle DFC_EEPEraseErr" VAL_BLK 0x80025510 ValA_Wu16 688. DINH_FIdVerb 0.00 688. FORMAT "%2.0" NUMBER 3 /end CHARACTERISTIC
/begin CHARACTERISTIC DINH_FId.DFC_EEPRdErr_CA "DINH/Zugeordnete FId für Verriegelungsquelle DFC_EEPRdErr" VAL_BLK 0x80025516 ValA_Wu16 688. DINH_FIdVerb 0.00 688. FORMAT "%2.0" NUMBER 3 /end CHARACTERISTIC
/begin CHARACTERISTIC DINH_FId.DFC_EEPWrErr_CA "DINH/Zugeordnete FId für Verriegelungsquelle DFC_EEPWrErr" VAL_BLK 0x8002551C ValA_Wu16 688. DINH_FIdVerb 0.00 688. FORMAT "%2.0" NUMBER 3 /end CHARACTERISTIC
/begin CHARACTERISTIC DINH_FId.DFC_EGRVlvJamVlvClsd_CA "DINH/Zugeordnete FId für Verriegelungsquelle DFC_EGRVlvJamVlvClsd" VAL_BLK 0x80025522 ValA_Wu16 688. DINH_FIdVerb 0.00 688. FORMAT "%2.0" NUMBER 3 /end CHARACTERISTIC
/begin CHARACTERISTIC DINH_FId.DFC_EGRVlvJamVlvOpn_CA "DINH/Zugeordnete FId für Verriegelungsquelle DFC_EGRVlvJamVlvOpn" VAL_BLK 0x80025528 ValA_Wu16 688. DINH_FIdVerb 0.00 688. FORMAT "%2.0" NUMBER 3 /end CHARACTERISTIC
/begin CHARACTERISTIC DINH_FId.DFC_EGRVlvLPJamVlvClsd_CA "DINH/Zugeordnete FId für Verriegelungsquelle DFC_EGRVlvLPJamVlvClsd" VAL_BLK 0x8002552E ValA_Wu16 688. DINH_FIdVerb 0.00 688. FORMAT "%2.0" NUMBER 3 /end CHARACTERISTIC
/begin CHARACTERISTIC DINH_FId.DFC_EGRVlvLPJamVlvOpn_CA "DINH/Zugeordnete FId für Verriegelungsquelle DFC_EGRVlvLPJamVlvOpn" VAL_BLK 0x80025534 ValA_Wu16 688. DINH_FIdVerb 0.00 688. FORMAT "%2.0" NUMBER 3 /end CHARACTERISTIC
/begin CHARACTERISTIC DINH_FId.DFC_EGRVlvLPLgTDrft_CA "DINH/Zugeordnete FId für Verriegelungsquelle DFC_EGRVlvLPLgTDrft" VAL_BLK 0x8002553A ValA_Wu16 688. DINH_FIdVerb 0.00 688. FORMAT "%2.0" NUMBER 3 /end CHARACTERISTIC
/begin CHARACTERISTIC DINH_FId.DFC_EGRVlvLPOfsLrnJamVlv_CA "DINH/Zugeordnete FId für Verriegelungsquelle DFC_EGRVlvLPOfsLrnJamVlv" VAL_BLK 0x80025540 ValA_Wu16 688. DINH_FIdVerb 0.00 688. FORMAT "%2.0" NUMBER 3 /end CHARACTERISTIC
/begin CHARACTERISTIC DINH_FId.DFC_EGRVlvLPShTDrft_CA "DINH/Zugeordnete FId für Verriegelungsquelle DFC_EGRVlvLPShTDrft" VAL_BLK 0x80025546 ValA_Wu16 688. DINH_FIdVerb 0.00 688. FORMAT "%2.0" NUMBER 3 /end CHARACTERISTIC
/begin CHARACTERISTIC DINH_FId.DFC_EGRVlvLgTDrft_CA "DINH/Zugeordnete FId für Verriegelungsquelle DFC_EGRVlvLgTDrft" VAL_BLK 0x8002554C ValA_Wu16 688. DINH_FIdVerb 0.00 688. FORMAT "%2.0" NUMBER 3 /end CHARACTERISTIC
/begin CHARACTERISTIC DINH_FId.DFC_EGRVlvOfsLrnJamVlv_CA "DINH/Zugeordnete FId für Verriegelungsquelle DFC_EGRVlvOfsLrnJamVlv" VAL_BLK 0x80025552 ValA_Wu16 688. DINH_FIdVerb 0.00 688. FORMAT "%2.0" NUMBER 3 /end CHARACTERISTIC
/begin CHARACTERISTIC DINH_FId.DFC_EGRVlvShTDrft_CA "DINH/Zugeordnete FId für Verriegelungsquelle DFC_EGRVlvShTDrft" VAL_BLK 0x80025558 ValA_Wu16 688. DINH_FIdVerb 0.00 688. FORMAT "%2.0" NUMBER 3 /end CHARACTERISTIC
/begin CHARACTERISTIC DINH_FId.DFC_EngICO_CA "DINH/Zugeordnete FId für Verriegelungsquelle DFC_EngICO" VAL_BLK 0x8002555E ValA_Wu16 688. DINH_FIdVerb 0.00 688. FORMAT "%2.0" NUMBER 3 /end CHARACTERISTIC
/begin CHARACTERISTIC DINH_FId.DFC_EpmCaSI1ErrSig_CA "DINH/Zugeordnete FId für Verriegelungsquelle DFC_EpmCaSI1ErrSig" VAL_BLK 0x80025564 ValA_Wu16 688. DINH_FIdVerb 0.00 688. FORMAT "%2.0" NUMBER 7 /end CHARACTERISTIC
/begin CHARACTERISTIC DINH_FId.DFC_EpmCaSI1NoSig_CA "DINH/Zugeordnete FId für Verriegelungsquelle DFC_EpmCaSI1NoSig" VAL_BLK 0x80025572 ValA_Wu16 688. DINH_FIdVerb 0.00 688. FORMAT "%2.0" NUMBER 9 /end CHARACTERISTIC
/begin CHARACTERISTIC DINH_FId.DFC_EpmCaSI1OfsErr_CA "DINH/Zugeordnete FId für Verriegelungsquelle DFC_EpmCaSI1OfsErr" VAL_BLK 0x80025584 ValA_Wu16 688. DINH_FIdVerb 0.00 688. FORMAT "%2.0" NUMBER 5 /end CHARACTERISTIC
/begin CHARACTERISTIC DINH_FId.DFC_EpmCrSErrSig_CA "DINH/Zugeordnete FId für Verriegelungsquelle DFC_EpmCrSErrSig" VAL_BLK 0x8002558E ValA_Wu16 688. DINH_FIdVerb 0.00 688. FORMAT "%2.0" NUMBER 22 /end CHARACTERISTIC
/begin CHARACTERISTIC DINH_FId.DFC_EpmCrSNoSig_CA "DINH/Zugeordnete FId für Verriegelungsquelle DFC_EpmCrSNoSig" VAL_BLK 0x800255BA ValA_Wu16 688. DINH_FIdVerb 0.00 688. FORMAT "%2.0" NUMBER 24 /end CHARACTERISTIC
/begin CHARACTERISTIC DINH_FId.DFC_IVPlausComprTst_CA "DINH/Zugeordnete FId für Verriegelungsquelle DFC_IVPlausComprTst" VAL_BLK 0x800255EA ValA_Wu16 688. DINH_FIdVerb 0.00 688. FORMAT "%2.0" NUMBER 2 /end CHARACTERISTIC
/begin CHARACTERISTIC DINH_FId.DFC_IVPlausRunUpTst_CA "DINH/Zugeordnete FId für Verriegelungsquelle DFC_IVPlausRunUpTst" VAL_BLK 0x800255EE ValA_Wu16 688. DINH_FIdVerb 0.00 688. FORMAT "%2.0" NUMBER 9 /end CHARACTERISTIC
/begin CHARACTERISTIC DINH_FId.DFC_InjCrvShOffTst_CA "DINH/Zugeordnete FId für Verriegelungsquelle DFC_InjCrvShOffTst" VAL_BLK 0x80025600 ValA_Wu16 688. DINH_FIdVerb 0.00 688. FORMAT "%2.0" NUMBER 2 /end CHARACTERISTIC
/begin CHARACTERISTIC DINH_FId.DFC_LayerEnSavModProd_CA "DINH/Zugeordnete FId für Verriegelungsquelle DFC_LayerEnSavModProd" VAL_BLK 0x80025604 ValA_Wu16 688. DINH_FIdVerb 0.00 688. FORMAT "%2.0" NUMBER 3 /end CHARACTERISTIC
/begin CHARACTERISTIC DINH_FId.DFC_LayerEnSavModRep_CA "DINH/Zugeordnete FId für Verriegelungsquelle DFC_LayerEnSavModRep" VAL_BLK 0x8002560A ValA_Wu16 688. DINH_FIdVerb 0.00 688. FORMAT "%2.0" NUMBER 3 /end CHARACTERISTIC
/begin CHARACTERISTIC DINH_FId.DFC_LayerEnSavModShip_CA "DINH/Zugeordnete FId für Verriegelungsquelle DFC_LayerEnSavModShip" VAL_BLK 0x80025610 ValA_Wu16 688. DINH_FIdVerb 0.00 688. FORMAT "%2.0" NUMBER 3 /end CHARACTERISTIC
/begin CHARACTERISTIC DINH_FId.DFC_MRlyErlyOpng_CA "DINH/Zugeordnete FId für Verriegelungsquelle DFC_MRlyErlyOpng" VAL_BLK 0x80025616 ValA_Wu16 688. DINH_FIdVerb 0.00 688. FORMAT "%2.0" NUMBER 2 /end CHARACTERISTIC
/begin CHARACTERISTIC DINH_FId.DFC_MRlyStk_CA "DINH/Zugeordnete FId für Verriegelungsquelle DFC_MRlyStk" VAL_BLK 0x8002561A ValA_Wu16 688. DINH_FIdVerb 0.00 688. FORMAT "%2.0" NUMBER 2 /end CHARACTERISTIC
/begin CHARACTERISTIC DINH_FId.DFC_MeUnActrTst_CA "DINH/Zugeordnete FId für Verriegelungsquelle DFC_MeUnActrTst" VAL_BLK 0x8002561E ValA_Wu16 688. DINH_FIdVerb 0.00 688. FORMAT "%2.0" NUMBER 2 /end CHARACTERISTIC
/begin CHARACTERISTIC DINH_FId.DFC_MoCADCCmp_CA "DINH/Zugeordnete FId für Verriegelungsquelle DFC_MoCADCCmp" VAL_BLK 0x80025622 ValA_Wu16 688. DINH_FIdVerb 0.00 688. FORMAT "%2.0" NUMBER 2 /end CHARACTERISTIC
/begin CHARACTERISTIC DINH_FId.DFC_MoCADCTst_CA "DINH/Zugeordnete FId für Verriegelungsquelle DFC_MoCADCTst" VAL_BLK 0x80025626 ValA_Wu16 688. DINH_FIdVerb 0.00 688. FORMAT "%2.0" NUMBER 2 /end CHARACTERISTIC
/begin CHARACTERISTIC DINH_FId.DFC_MoCADCVltgRatio_CA "DINH/Zugeordnete FId für Verriegelungsquelle DFC_MoCADCVltgRatio" VAL_BLK 0x8002562A ValA_Wu16 688. DINH_FIdVerb 0.00 688. FORMAT "%2.0" NUMBER 2 /end CHARACTERISTIC
/begin CHARACTERISTIC DINH_FId.DFC_MoCComErrCnt_CA "DINH/Zugeordnete FId für Verriegelungsquelle DFC_MoCComErrCnt" VAL_BLK 0x8002562E ValA_Wu16 688. DINH_FIdVerb 0.00 688. FORMAT "%2.0" NUMBER 2 /end CHARACTERISTIC
/begin CHARACTERISTIC DINH_FId.DFC_MoCComSPI_CA "DINH/Zugeordnete FId für Verriegelungsquelle DFC_MoCComSPI" VAL_BLK 0x80025632 ValA_Wu16 688. DINH_FIdVerb 0.00 688. FORMAT "%2.0" NUMBER 2 /end CHARACTERISTIC
/begin CHARACTERISTIC DINH_FId.DFC_MoCROMErrXPg_CA "DINH/Zugeordnete FId für Verriegelungsquelle DFC_MoCROMErrXPg" VAL_BLK 0x80025636 ValA_Wu16 688. DINH_FIdVerb 0.00 688. FORMAT "%2.0" NUMBER 2 /end CHARACTERISTIC
/begin CHARACTERISTIC DINH_FId.DFC_MoCSOPHwNoRdy_CA "DINH/Zugeordnete FId für Verriegelungsquelle DFC_MoCSOPHwNoRdy" VAL_BLK 0x8002563A ValA_Wu16 688. DINH_FIdVerb 0.00 688. FORMAT "%2.0" NUMBER 3 /end CHARACTERISTIC
/begin CHARACTERISTIC DINH_FId.DFC_MoCSOPLoLi_CA "DINH/Zugeordnete FId für Verriegelungsquelle DFC_MoCSOPLoLi" VAL_BLK 0x80025640 ValA_Wu16 688. DINH_FIdVerb 0.00 688. FORMAT "%2.0" NUMBER 4 /end CHARACTERISTIC
/begin CHARACTERISTIC DINH_FId.DFC_MoCSOPMM_CA "DINH/Zugeordnete FId für Verriegelungsquelle DFC_MoCSOPMM" VAL_BLK 0x80025648 ValA_Wu16 688. DINH_FIdVerb 0.00 688. FORMAT "%2.0" NUMBER 4 /end CHARACTERISTIC
/begin CHARACTERISTIC DINH_FId.DFC_MoCSOPTimeOut_CA "DINH/Zugeordnete FId für Verriegelungsquelle DFC_MoCSOPTimeOut" VAL_BLK 0x80025650 ValA_Wu16 688. DINH_FIdVerb 0.00 688. FORMAT "%2.0" NUMBER 4 /end CHARACTERISTIC
/begin CHARACTERISTIC DINH_FId.DFC_MoCSOPUpLi_CA "DINH/Zugeordnete FId für Verriegelungsquelle DFC_MoCSOPUpLi" VAL_BLK 0x80025658 ValA_Wu16 688. DINH_FIdVerb 0.00 688. FORMAT "%2.0" NUMBER 4 /end CHARACTERISTIC
/begin CHARACTERISTIC DINH_FId.DFC_MoFAPP_CA "DINH/Zugeordnete FId für Verriegelungsquelle DFC_MoFAPP" VAL_BLK 0x80025660 ValA_Wu16 688. DINH_FIdVerb 0.00 688. FORMAT "%2.0" NUMBER 2 /end CHARACTERISTIC
/begin CHARACTERISTIC DINH_FId.DFC_MoFESpd_CA "DINH/Zugeordnete FId für Verriegelungsquelle DFC_MoFESpd" VAL_BLK 0x80025664 ValA_Wu16 688. DINH_FIdVerb 0.00 688. FORMAT "%2.0" NUMBER 2 /end CHARACTERISTIC
/begin CHARACTERISTIC DINH_FId.DFC_MoFInjDatPhi_CA "DINH/Zugeordnete FId für Verriegelungsquelle DFC_MoFInjDatPhi" VAL_BLK 0x80025668 ValA_Wu16 688. DINH_FIdVerb 0.00 688. FORMAT "%2.0" NUMBER 2 /end CHARACTERISTIC
/begin CHARACTERISTIC DINH_FId.DFC_MoFInjDatQnt_CA "DINH/Zugeordnete FId für Verriegelungsquelle DFC_MoFInjDatQnt" VAL_BLK 0x8002566C ValA_Wu16 688. DINH_FIdVerb 0.00 688. FORMAT "%2.0" NUMBER 2 /end CHARACTERISTIC
/begin CHARACTERISTIC DINH_FId.DFC_MoFInjQnt_CA "DINH/Zugeordnete FId für Verriegelungsquelle DFC_MoFInjQnt" VAL_BLK 0x80025670 ValA_Wu16 688. DINH_FIdVerb 0.00 688. FORMAT "%2.0" NUMBER 2 /end CHARACTERISTIC
/begin CHARACTERISTIC DINH_FId.DFC_MoFMode1PoI1_CA "DINH/Zugeordnete FId für Verriegelungsquelle DFC_MoFMode1PoI1" VAL_BLK 0x80025674 ValA_Wu16 688. DINH_FIdVerb 0.00 688. FORMAT "%2.0" NUMBER 2 /end CHARACTERISTIC
/begin CHARACTERISTIC DINH_FId.DFC_MoFMode1PoI2_CA "DINH/Zugeordnete FId für Verriegelungsquelle DFC_MoFMode1PoI2" VAL_BLK 0x80025678 ValA_Wu16 688. DINH_FIdVerb 0.00 688. FORMAT "%2.0" NUMBER 2 /end CHARACTERISTIC
/begin CHARACTERISTIC DINH_FId.DFC_MoFMode2PoI1_CA "DINH/Zugeordnete FId für Verriegelungsquelle DFC_MoFMode2PoI1" VAL_BLK 0x8002567C ValA_Wu16 688. DINH_FIdVerb 0.00 688. FORMAT "%2.0" NUMBER 2 /end CHARACTERISTIC
/begin CHARACTERISTIC DINH_FId.DFC_MoFMode2PoI2_CA "DINH/Zugeordnete FId für Verriegelungsquelle DFC_MoFMode2PoI2" VAL_BLK 0x80025680 ValA_Wu16 688. DINH_FIdVerb 0.00 688. FORMAT "%2.0" NUMBER 2 /end CHARACTERISTIC
/begin CHARACTERISTIC DINH_FId.DFC_MoFOvR_CA "DINH/Zugeordnete FId für Verriegelungsquelle DFC_MoFOvR" VAL_BLK 0x80025684 ValA_Wu16 688. DINH_FIdVerb 0.00 688. FORMAT "%2.0" NUMBER 2 /end CHARACTERISTIC
/begin CHARACTERISTIC DINH_FId.DFC_MoFQntCor_CA "DINH/Zugeordnete FId für Verriegelungsquelle DFC_MoFQntCor" VAL_BLK 0x80025688 ValA_Wu16 688. DINH_FIdVerb 0.00 688. FORMAT "%2.0" NUMBER 2 /end CHARACTERISTIC
/begin CHARACTERISTIC DINH_FId.DFC_MoFRailP_CA "DINH/Zugeordnete FId für Verriegelungsquelle DFC_MoFRailP" VAL_BLK 0x8002568C ValA_Wu16 688. DINH_FIdVerb 0.00 688. FORMAT "%2.0" NUMBER 2 /end CHARACTERISTIC
/begin CHARACTERISTIC DINH_FId.DFC_MoFTrqCmp_CA "DINH/Zugeordnete FId für Verriegelungsquelle DFC_MoFTrqCmp" VAL_BLK 0x80025690 ValA_Wu16 688. DINH_FIdVerb 0.00 688. FORMAT "%2.0" NUMBER 2 /end CHARACTERISTIC
/begin CHARACTERISTIC DINH_FId.DFC_NSCDsHtrSetP_CA "DINH/Zugeordnete FId für Verriegelungsquelle DFC_NSCDsHtrSetP" VAL_BLK 0x80025694 ValA_Wu16 688. DINH_FIdVerb 0.00 688. FORMAT "%2.0" NUMBER 3 /end CHARACTERISTIC
/begin CHARACTERISTIC DINH_FId.DFC_NoCat2DsHtrSetP_CA "DINH/Zugeordnete FId für Verriegelungsquelle DFC_NoCat2DsHtrSetP" VAL_BLK 0x8002569A ValA_Wu16 688. DINH_FIdVerb 0.00 688. FORMAT "%2.0" NUMBER 3 /end CHARACTERISTIC
/begin CHARACTERISTIC DINH_FId.DFC_PCVActrTst_CA "DINH/Zugeordnete FId für Verriegelungsquelle DFC_PCVActrTst" VAL_BLK 0x800256A0 ValA_Wu16 688. DINH_FIdVerb 0.00 688. FORMAT "%2.0" NUMBER 2 /end CHARACTERISTIC
/begin CHARACTERISTIC DINH_FId.DFC_PhyModNonMonMapNpl_CA "DINH/Zugeordnete FId für Verriegelungsquelle DFC_PhyModNonMonMapNpl" VAL_BLK 0x800256A4 ValA_Wu16 688. DINH_FIdVerb 0.00 688. FORMAT "%2.0" NUMBER 2 /end CHARACTERISTIC
/begin CHARACTERISTIC DINH_FId.DFC_RailHpTst_CA "DINH/Zugeordnete FId für Verriegelungsquelle DFC_RailHpTst" VAL_BLK 0x800256A8 ValA_Wu16 688. DINH_FIdVerb 0.00 688. FORMAT "%2.0" NUMBER 10 /end CHARACTERISTIC
/begin CHARACTERISTIC DINH_FId.DFC_RailPOfsTstMax_CA "DINH/Zugeordnete FId für Verriegelungsquelle DFC_RailPOfsTstMax" VAL_BLK 0x800256BC ValA_Wu16 688. DINH_FIdVerb 0.00 688. FORMAT "%2.0" NUMBER 11 /end CHARACTERISTIC
/begin CHARACTERISTIC DINH_FId.DFC_RailPOfsTstMin_CA "DINH/Zugeordnete FId für Verriegelungsquelle DFC_RailPOfsTstMin" VAL_BLK 0x800256D2 ValA_Wu16 688. DINH_FIdVerb 0.00 688. FORMAT "%2.0" NUMBER 11 /end CHARACTERISTIC
/begin CHARACTERISTIC DINH_FId.DFC_SIA_E1max_CA "DINH/Zugeordnete FId für Verriegelungsquelle DFC_SIA_E1max" VAL_BLK 0x800256E8 ValA_Wu16 688. DINH_FIdVerb 0.00 688. FORMAT "%2.0" NUMBER 2 /end CHARACTERISTIC
/begin CHARACTERISTIC DINH_FId.DFC_SIA_E1min_CA "DINH/Zugeordnete FId für Verriegelungsquelle DFC_SIA_E1min" VAL_BLK 0x800256EC ValA_Wu16 688. DINH_FIdVerb 0.00 688. FORMAT "%2.0" NUMBER 2 /end CHARACTERISTIC
/begin CHARACTERISTIC DINH_FId.DFC_SIA_E1npl_CA "DINH/Zugeordnete FId für Verriegelungsquelle DFC_SIA_E1npl" VAL_BLK 0x800256F0 ValA_Wu16 688. DINH_FIdVerb 0.00 688. FORMAT "%2.0" NUMBER 2 /end CHARACTERISTIC
/begin CHARACTERISTIC DINH_FId.DFC_SIA_E1sig_CA "DINH/Zugeordnete FId für Verriegelungsquelle DFC_SIA_E1sig" VAL_BLK 0x800256F4 ValA_Wu16 688. DINH_FIdVerb 0.00 688. FORMAT "%2.0" NUMBER 2 /end CHARACTERISTIC
/begin CHARACTERISTIC DINH_FId.DFC_SIA_E2max_CA "DINH/Zugeordnete FId für Verriegelungsquelle DFC_SIA_E2max" VAL_BLK 0x800256F8 ValA_Wu16 688. DINH_FIdVerb 0.00 688. FORMAT "%2.0" NUMBER 2 /end CHARACTERISTIC
/begin CHARACTERISTIC DINH_FId.DFC_SIA_E2min_CA "DINH/Zugeordnete FId für Verriegelungsquelle DFC_SIA_E2min" VAL_BLK 0x800256FC ValA_Wu16 688. DINH_FIdVerb 0.00 688. FORMAT "%2.0" NUMBER 2 /end CHARACTERISTIC
/begin CHARACTERISTIC DINH_FId.DFC_SIA_E2npl_CA "DINH/Zugeordnete FId für Verriegelungsquelle DFC_SIA_E2npl" VAL_BLK 0x80025700 ValA_Wu16 688. DINH_FIdVerb 0.00 688. FORMAT "%2.0" NUMBER 2 /end CHARACTERISTIC
/begin CHARACTERISTIC DINH_FId.DFC_SIA_E2sig_CA "DINH/Zugeordnete FId für Verriegelungsquelle DFC_SIA_E2sig" VAL_BLK 0x80025704 ValA_Wu16 688. DINH_FIdVerb 0.00 688. FORMAT "%2.0" NUMBER 2 /end CHARACTERISTIC
/begin CHARACTERISTIC DINH_FId.DFC_SIA_E3max_CA "DINH/Zugeordnete FId für Verriegelungsquelle DFC_SIA_E3max" VAL_BLK 0x80025708 ValA_Wu16 688. DINH_FIdVerb 0.00 688. FORMAT "%2.0" NUMBER 2 /end CHARACTERISTIC
/begin CHARACTERISTIC DINH_FId.DFC_SIA_E3min_CA "DINH/Zugeordnete FId für Verriegelungsquelle DFC_SIA_E3min" VAL_BLK 0x8002570C ValA_Wu16 688. DINH_FIdVerb 0.00 688. FORMAT "%2.0" NUMBER 2 /end CHARACTERISTIC
/begin CHARACTERISTIC DINH_FId.DFC_SIA_E3npl_CA "DINH/Zugeordnete FId für Verriegelungsquelle DFC_SIA_E3npl" VAL_BLK 0x80025710 ValA_Wu16 688. DINH_FIdVerb 0.00 688. FORMAT "%2.0" NUMBER 2 /end CHARACTERISTIC
/begin CHARACTERISTIC DINH_FId.DFC_SIA_E3sig_CA "DINH/Zugeordnete FId für Verriegelungsquelle DFC_SIA_E3sig" VAL_BLK 0x80025714 ValA_Wu16 688. DINH_FIdVerb 0.00 688. FORMAT "%2.0" NUMBER 2 /end CHARACTERISTIC
/begin CHARACTERISTIC DINH_FId.DFC_SIA_E4max_CA "DINH/Zugeordnete FId für Verriegelungsquelle DFC_SIA_E4max" VAL_BLK 0x80025718 ValA_Wu16 688. DINH_FIdVerb 0.00 688. FORMAT "%2.0" NUMBER 2 /end CHARACTERISTIC
/begin CHARACTERISTIC DINH_FId.DFC_SIA_E4min_CA "DINH/Zugeordnete FId für Verriegelungsquelle DFC_SIA_E4min" VAL_BLK 0x8002571C ValA_Wu16 688. DINH_FIdVerb 0.00 688. FORMAT "%2.0" NUMBER 2 /end CHARACTERISTIC
/begin CHARACTERISTIC DINH_FId.DFC_SIA_E4npl_CA "DINH/Zugeordnete FId für Verriegelungsquelle DFC_SIA_E4npl" VAL_BLK 0x80025720 ValA_Wu16 688. DINH_FIdVerb 0.00 688. FORMAT "%2.0" NUMBER 2 /end CHARACTERISTIC
/begin CHARACTERISTIC DINH_FId.DFC_SIA_E4sig_CA "DINH/Zugeordnete FId für Verriegelungsquelle DFC_SIA_E4sig" VAL_BLK 0x80025724 ValA_Wu16 688. DINH_FIdVerb 0.00 688. FORMAT "%2.0" NUMBER 2 /end CHARACTERISTIC
/begin CHARACTERISTIC DINH_FId.DFC_SWReset_0_CA "DINH/Zugeordnete FId für Verriegelungsquelle DFC_SWReset_0" VAL_BLK 0x80025728 ValA_Wu16 688. DINH_FIdVerb 0.00 688. FORMAT "%2.0" NUMBER 2 /end CHARACTERISTIC
/begin CHARACTERISTIC DINH_FId.DFC_SWReset_1_CA "DINH/Zugeordnete FId für Verriegelungsquelle DFC_SWReset_1" VAL_BLK 0x8002572C ValA_Wu16 688. DINH_FIdVerb 0.00 688. FORMAT "%2.0" NUMBER 2 /end CHARACTERISTIC
/begin CHARACTERISTIC DINH_FId.DFC_SWReset_2_CA "DINH/Zugeordnete FId für Verriegelungsquelle DFC_SWReset_2" VAL_BLK 0x80025730 ValA_Wu16 688. DINH_FIdVerb 0.00 688. FORMAT "%2.0" NUMBER 2 /end CHARACTERISTIC
/begin CHARACTERISTIC DINH_FId.DFC_ShtrAKKMax_CA "DINH/Zugeordnete FId für Verriegelungsquelle DFC_ShtrAKKMax" VAL_BLK 0x80025734 ValA_Wu16 688. DINH_FIdVerb 0.00 688. FORMAT "%2.0" NUMBER 2 /end CHARACTERISTIC
/begin CHARACTERISTIC DINH_FId.DFC_ShtrAKKMin_CA "DINH/Zugeordnete FId für Verriegelungsquelle DFC_ShtrAKKMin" VAL_BLK 0x80025738 ValA_Wu16 688. DINH_FIdVerb 0.00 688. FORMAT "%2.0" NUMBER 2 /end CHARACTERISTIC
/begin CHARACTERISTIC DINH_FId.DFC_ShtrAKKNpl_CA "DINH/Zugeordnete FId für Verriegelungsquelle DFC_ShtrAKKNpl" VAL_BLK 0x8002573C ValA_Wu16 688. DINH_FIdVerb 0.00 688. FORMAT "%2.0" NUMBER 2 /end CHARACTERISTIC
/begin CHARACTERISTIC DINH_FId.DFC_ShtrPKKMax_CA "DINH/Zugeordnete FId für Verriegelungsquelle DFC_ShtrPKKMax" VAL_BLK 0x80025740 ValA_Wu16 688. DINH_FIdVerb 0.00 688. FORMAT "%2.0" NUMBER 2 /end CHARACTERISTIC
/begin CHARACTERISTIC DINH_FId.DFC_StopCntTmr_CA "DINH/Zugeordnete FId für Verriegelungsquelle DFC_StopCntTmr" VAL_BLK 0x80025744 ValA_Wu16 688. DINH_FIdVerb 0.00 688. FORMAT "%2.0" NUMBER 2 /end CHARACTERISTIC
/begin CHARACTERISTIC DINH_FId.DFC_ThrVlvMon_CA "DINH/Zugeordnete FId für Verriegelungsquelle DFC_ThrVlvMon" VAL_BLK 0x80025748 ValA_Wu16 688. DINH_FIdVerb 0.00 688. FORMAT "%2.0" NUMBER 2 /end CHARACTERISTIC
/begin CHARACTERISTIC DINH_FId.DFC_VSwVlvJamVlv_CA "DINH/Zugeordnete FId für Verriegelungsquelle DFC_VSwVlvJamVlv" VAL_BLK 0x8002574C ValA_Wu16 688. DINH_FIdVerb 0.00 688. FORMAT "%2.0" NUMBER 3 /end CHARACTERISTIC
/begin CHARACTERISTIC DINH_FId.DFC_VSwVlvLgTDrft_CA "DINH/Zugeordnete FId für Verriegelungsquelle DFC_VSwVlvLgTDrft" VAL_BLK 0x80025752 ValA_Wu16 688. DINH_FIdVerb 0.00 688. FORMAT "%2.0" NUMBER 3 /end CHARACTERISTIC
/begin CHARACTERISTIC DINH_FId.DFC_VSwVlvOfsLrnJamVlv_CA "DINH/Zugeordnete FId für Verriegelungsquelle DFC_VSwVlvOfsLrnJamVlv" VAL_BLK 0x80025758 ValA_Wu16 688. DINH_FIdVerb 0.00 688. FORMAT "%2.0" NUMBER 3 /end CHARACTERISTIC
/begin CHARACTERISTIC DINH_FId.DFC_VSwVlvOfsNeutr_CA "DINH/Zugeordnete FId für Verriegelungsquelle DFC_VSwVlvOfsNeutr" VAL_BLK 0x8002575E ValA_Wu16 688. DINH_FIdVerb 0.00 688. FORMAT "%2.0" NUMBER 2 /end CHARACTERISTIC
/begin CHARACTERISTIC DINH_FId.DFC_VSwVlvShTDrft_CA "DINH/Zugeordnete FId für Verriegelungsquelle DFC_VSwVlvShTDrft" VAL_BLK 0x80025762 ValA_Wu16 688. DINH_FIdVerb 0.00 688. FORMAT "%2.0" NUMBER 3 /end CHARACTERISTIC
/begin CHARACTERISTIC DINH_FId.DFC_VSwVlvSpgDef_CA "DINH/Zugeordnete FId für Verriegelungsquelle DFC_VSwVlvSpgDef" VAL_BLK 0x80025768 ValA_Wu16 688. DINH_FIdVerb 0.00 688. FORMAT "%2.0" NUMBER 2 /end CHARACTERISTIC
/begin CHARACTERISTIC DINH_FId.DSQ_AFS_SSpShOffActr_CA "DINH/Zugeordnete FId für Verriegelungsquelle DSQ_AFS_SSpShOffActr" VAL_BLK 0x8002576C ValA_Wu16 688. DINH_FIdVerb 0.00 688. FORMAT "%2.0" NUMBER 3 /end CHARACTERISTIC
/begin CHARACTERISTIC DINH_FId.DSQ_AirCCmprActr_CA "DINH/Zugeordnete FId für Verriegelungsquelle DSQ_AirCCmprActr" VAL_BLK 0x80025772 ValA_Wu16 688. DINH_FIdVerb 0.00 688. FORMAT "%2.0" NUMBER 2 /end CHARACTERISTIC
/begin CHARACTERISTIC DINH_FId.DSQ_CEngDsT_CA "DINH/Zugeordnete FId für Verriegelungsquelle DSQ_CEngDsT" VAL_BLK 0x80025776 ValA_Wu16 688. DINH_FIdVerb 0.00 688. FORMAT "%2.0" NUMBER 2 /end CHARACTERISTIC
/begin CHARACTERISTIC DINH_FId.DSQ_CThmstActr_CA "DINH/Zugeordnete FId für Verriegelungsquelle DSQ_CThmstActr" VAL_BLK 0x8002577A ValA_Wu16 688. DINH_FIdVerb 0.00 688. FORMAT "%2.0" NUMBER 2 /end CHARACTERISTIC
/begin CHARACTERISTIC DINH_FId.DSQ_Com_aDirect_CA "DINH/Zugeordnete FId für Verriegelungsquelle DSQ_Com_aDirect" VAL_BLK 0x8002577E ValA_Wu16 688. DINH_FIdVerb 0.00 688. FORMAT "%2.0" NUMBER 2 /end CHARACTERISTIC
/begin CHARACTERISTIC DINH_FId.DSQ_Com_aSide_CA "DINH/Zugeordnete FId für Verriegelungsquelle DSQ_Com_aSide" VAL_BLK 0x80025782 ValA_Wu16 688. DINH_FIdVerb 0.00 688. FORMAT "%2.0" NUMBER 2 /end CHARACTERISTIC
/begin CHARACTERISTIC DINH_FId.DSQ_Com_ctrDay_CA "DINH/Zugeordnete FId für Verriegelungsquelle DSQ_Com_ctrDay" VAL_BLK 0x80025786 ValA_Wu16 688. DINH_FIdVerb 0.00 688. FORMAT "%2.0" NUMBER 2 /end CHARACTERISTIC
/begin CHARACTERISTIC DINH_FId.DSQ_Com_ctrSec_CA "DINH/Zugeordnete FId für Verriegelungsquelle DSQ_Com_ctrSec" VAL_BLK 0x8002578A ValA_Wu16 688. DINH_FIdVerb 0.00 688. FORMAT "%2.0" NUMBER 2 /end CHARACTERISTIC
/begin CHARACTERISTIC DINH_FId.DSQ_Com_ctrSecAbs_CA "DINH/Zugeordnete FId für Verriegelungsquelle DSQ_Com_ctrSecAbs" VAL_BLK 0x8002578E ValA_Wu16 688. DINH_FIdVerb 0.00 688. FORMAT "%2.0" NUMBER 3 /end CHARACTERISTIC
/begin CHARACTERISTIC DINH_FId.DSQ_Com_dDay_CA "DINH/Zugeordnete FId für Verriegelungsquelle DSQ_Com_dDay" VAL_BLK 0x80025794 ValA_Wu16 688. DINH_FIdVerb 0.00 688. FORMAT "%2.0" NUMBER 2 /end CHARACTERISTIC
/begin CHARACTERISTIC DINH_FId.DSQ_Com_dMonth_CA "DINH/Zugeordnete FId für Verriegelungsquelle DSQ_Com_dMonth" VAL_BLK 0x80025798 ValA_Wu16 688. DINH_FIdVerb 0.00 688. FORMAT "%2.0" NUMBER 2 /end CHARACTERISTIC
/begin CHARACTERISTIC DINH_FId.DSQ_Com_dYear_CA "DINH/Zugeordnete FId für Verriegelungsquelle DSQ_Com_dYear" VAL_BLK 0x8002579C ValA_Wu16 688. DINH_FIdVerb 0.00 688. FORMAT "%2.0" NUMBER 2 /end CHARACTERISTIC
/begin CHARACTERISTIC DINH_FId.DSQ_Com_dphiStWhlAg_CA "DINH/Zugeordnete FId für Verriegelungsquelle DSQ_Com_dphiStWhlAg" VAL_BLK 0x800257A0 ValA_Wu16 688. DINH_FIdVerb 0.00 688. FORMAT "%2.0" NUMBER 2 /end CHARACTERISTIC
/begin CHARACTERISTIC DINH_FId.DSQ_Com_dvolPspDes_CA "DINH/Zugeordnete FId für Verriegelungsquelle DSQ_Com_dvolPspDes" VAL_BLK 0x800257A4 ValA_Wu16 688. DINH_FIdVerb 0.00 688. FORMAT "%2.0" NUMBER 2 /end CHARACTERISTIC
/begin CHARACTERISTIC DINH_FId.DSQ_Com_iHiLimCurr_CA "DINH/Zugeordnete FId für Verriegelungsquelle DSQ_Com_iHiLimCurr" VAL_BLK 0x800257A8 ValA_Wu16 688. DINH_FIdVerb 0.00 688. FORMAT "%2.0" NUMBER 3 /end CHARACTERISTIC
/begin CHARACTERISTIC DINH_FId.DSQ_Com_iLoLimCurr_CA "DINH/Zugeordnete FId für Verriegelungsquelle DSQ_Com_iLoLimCurr" VAL_BLK 0x800257AE ValA_Wu16 688. DINH_FIdVerb 0.00 688. FORMAT "%2.0" NUMBER 3 /end CHARACTERISTIC
/begin CHARACTERISTIC DINH_FId.DSQ_Com_iPsp_CA "DINH/Zugeordnete FId für Verriegelungsquelle DSQ_Com_iPsp" VAL_BLK 0x800257B4 ValA_Wu16 688. DINH_FIdVerb 0.00 688. FORMAT "%2.0" NUMBER 2 /end CHARACTERISTIC
/begin CHARACTERISTIC DINH_FId.DSQ_Com_iZrLimCurr_CA "DINH/Zugeordnete FId für Verriegelungsquelle DSQ_Com_iZrLimCurr" VAL_BLK 0x800257B8 ValA_Wu16 688. DINH_FIdVerb 0.00 688. FORMAT "%2.0" NUMBER 3 /end CHARACTERISTIC
/begin CHARACTERISTIC DINH_FId.DSQ_Com_idParkConsumer_CA "DINH/Zugeordnete FId für Verriegelungsquelle DSQ_Com_idParkConsumer" VAL_BLK 0x800257BE ValA_Wu16 688. DINH_FIdVerb 0.00 688. FORMAT "%2.0" NUMBER 2 /end CHARACTERISTIC
/begin CHARACTERISTIC DINH_FId.DSQ_Com_idVerbraucher_CA "DINH/Zugeordnete FId für Verriegelungsquelle DSQ_Com_idVerbraucher" VAL_BLK 0x800257C2 ValA_Wu16 688. DINH_FIdVerb 0.00 688. FORMAT "%2.0" NUMBER 3 /end CHARACTERISTIC
/begin CHARACTERISTIC DINH_FId.DSQ_Com_lFlTnkQntLow_CA "DINH/Zugeordnete FId für Verriegelungsquelle DSQ_Com_lFlTnkQntLow" VAL_BLK 0x800257C8 ValA_Wu16 688. DINH_FIdVerb 0.00 688. FORMAT "%2.0" NUMBER 2 /end CHARACTERISTIC
/begin CHARACTERISTIC DINH_FId.DSQ_Com_lSum_CA "DINH/Zugeordnete FId für Verriegelungsquelle DSQ_Com_lSum" VAL_BLK 0x800257CC ValA_Wu16 688. DINH_FIdVerb 0.00 688. FORMAT "%2.0" NUMBER 3 /end CHARACTERISTIC
/begin CHARACTERISTIC DINH_FId.DSQ_Com_nDKG_CA "DINH/Zugeordnete FId für Verriegelungsquelle DSQ_Com_nDKG" VAL_BLK 0x800257D2 ValA_Wu16 688. DINH_FIdVerb 0.00 688. FORMAT "%2.0" NUMBER 2 /end CHARACTERISTIC
/begin CHARACTERISTIC DINH_FId.DSQ_Com_nGbxOut_CA "DINH/Zugeordnete FId für Verriegelungsquelle DSQ_Com_nGbxOut" VAL_BLK 0x800257D6 ValA_Wu16 688. DINH_FIdVerb 0.00 688. FORMAT "%2.0" NUMBER 2 /end CHARACTERISTIC
/begin CHARACTERISTIC DINH_FId.DSQ_Com_nPsp_CA "DINH/Zugeordnete FId für Verriegelungsquelle DSQ_Com_nPsp" VAL_BLK 0x800257DA ValA_Wu16 688. DINH_FIdVerb 0.00 688. FORMAT "%2.0" NUMBER 2 /end CHARACTERISTIC
/begin CHARACTERISTIC DINH_FId.DSQ_Com_nRqIdlg_CA "DINH/Zugeordnete FId für Verriegelungsquelle DSQ_Com_nRqIdlg" VAL_BLK 0x800257DE ValA_Wu16 688. DINH_FIdVerb 0.00 688. FORMAT "%2.0" NUMBER 2 /end CHARACTERISTIC
/begin CHARACTERISTIC DINH_FId.DSQ_Com_nTSC_CA "DINH/Zugeordnete FId für Verriegelungsquelle DSQ_Com_nTSC" VAL_BLK 0x800257E2 ValA_Wu16 688. DINH_FIdVerb 0.00 688. FORMAT "%2.0" NUMBER 5 /end CHARACTERISTIC
/begin CHARACTERISTIC DINH_FId.DSQ_Com_nWhl_CA "DINH/" VAL_BLK 0x800257EC ValA_Wu16 688. DINH_FIdVerb 0.00 688. FORMAT "%2.0" NUMBER 2 /end CHARACTERISTIC
/begin CHARACTERISTIC DINH_FId.DSQ_Com_nWhlFL_CA "DINH/Zugeordnete FId für Verriegelungsquelle DSQ_Com_nWhlFL" VAL_BLK 0x800257F0 ValA_Wu16 688. DINH_FIdVerb 0.00 688. FORMAT "%2.0" NUMBER 2 /end CHARACTERISTIC
/begin CHARACTERISTIC DINH_FId.DSQ_Com_nWhlFR_CA "DINH/Zugeordnete FId für Verriegelungsquelle DSQ_Com_nWhlFR" VAL_BLK 0x800257F4 ValA_Wu16 688. DINH_FIdVerb 0.00 688. FORMAT "%2.0" NUMBER 2 /end CHARACTERISTIC
/begin CHARACTERISTIC DINH_FId.DSQ_Com_nWhlRL_CA "DINH/Zugeordnete FId für Verriegelungsquelle DSQ_Com_nWhlRL" VAL_BLK 0x800257F8 ValA_Wu16 688. DINH_FIdVerb 0.00 688. FORMAT "%2.0" NUMBER 2 /end CHARACTERISTIC
/begin CHARACTERISTIC DINH_FId.DSQ_Com_nWhlRR_CA "DINH/Zugeordnete FId für Verriegelungsquelle DSQ_Com_nWhlRR" VAL_BLK 0x800257FC ValA_Wu16 688. DINH_FIdVerb 0.00 688. FORMAT "%2.0" NUMBER 2 /end CHARACTERISTIC
/begin CHARACTERISTIC DINH_FId.DSQ_Com_pBrkSys_CA "DINH/Zugeordnete FId für Verriegelungsquelle DSQ_Com_pBrkSys" VAL_BLK 0x80025800 ValA_Wu16 688. DINH_FIdVerb 0.00 688. FORMAT "%2.0" NUMBER 2 /end CHARACTERISTIC
/begin CHARACTERISTIC DINH_FId.DSQ_Com_phiStWhlAg_CA "DINH/Zugeordnete FId für Verriegelungsquelle DSQ_Com_phiStWhlAg" VAL_BLK 0x80025804 ValA_Wu16 688. DINH_FIdVerb 0.00 688. FORMAT "%2.0" NUMBER 2 /end CHARACTERISTIC
/begin CHARACTERISTIC DINH_FId.DSQ_Com_rACFanDem_CA "DINH/Zugeordnete FId für Verriegelungsquelle DSQ_Com_rACFanDem" VAL_BLK 0x80025808 ValA_Wu16 688. DINH_FIdVerb 0.00 688. FORMAT "%2.0" NUMBER 3 /end CHARACTERISTIC
/begin CHARACTERISTIC DINH_FId.DSQ_Com_rHtFlowReq_CA "DINH/Zugeordnete FId für Verriegelungsquelle DSQ_Com_rHtFlowReq" VAL_BLK 0x8002580E ValA_Wu16 688. DINH_FIdVerb 0.00 688. FORMAT "%2.0" NUMBER 2 /end CHARACTERISTIC
/begin CHARACTERISTIC DINH_FId.DSQ_Com_rLamLinRecGndRaw_CA "DINH/Zugeordnete FId für Verriegelungsquelle DSQ_Com_rLamLinRecGndRaw" VAL_BLK 0x80025812 ValA_Wu16 688. DINH_FIdVerb 0.00 688. FORMAT "%2.0" NUMBER 2 /end CHARACTERISTIC
/begin CHARACTERISTIC DINH_FId.DSQ_Com_rLamLinRecUbattRaw_CA "DINH/Zugeordnete FId für Verriegelungsquelle DSQ_Com_rLamLinRecUbattRaw" VAL_BLK 0x80025816 ValA_Wu16 688. DINH_FIdVerb 0.00 688. FORMAT "%2.0" NUMBER 2 /end CHARACTERISTIC
/begin CHARACTERISTIC DINH_FId.DSQ_Com_rNOxCat2DsGndRaw_CA "DINH/Zugeordnete FId für Verriegelungsquelle DSQ_Com_rNOxCat2DsGndRaw" VAL_BLK 0x8002581A ValA_Wu16 688. DINH_FIdVerb 0.00 688. FORMAT "%2.0" NUMBER 2 /end CHARACTERISTIC
/begin CHARACTERISTIC DINH_FId.DSQ_Com_rNOxCat2DsUbattRaw_CA "DINH/Zugeordnete FId für Verriegelungsquelle DSQ_Com_rNOxCat2DsUbattRaw" VAL_BLK 0x8002581E ValA_Wu16 688. DINH_FIdVerb 0.00 688. FORMAT "%2.0" NUMBER 2 /end CHARACTERISTIC
/begin CHARACTERISTIC DINH_FId.DSQ_Com_rPspSetPoint_CA "DINH/Zugeordnete FId für Verriegelungsquelle DSQ_Com_rPspSetPoint" VAL_BLK 0x80025822 ValA_Wu16 688. DINH_FIdVerb 0.00 688. FORMAT "%2.0" NUMBER 2 /end CHARACTERISTIC
/begin CHARACTERISTIC DINH_FId.DSQ_Com_rPwrSpCons_CA "DINH/Zugeordnete FId für Verriegelungsquelle DSQ_Com_rPwrSpCons" VAL_BLK 0x80025826 ValA_Wu16 688. DINH_FIdVerb 0.00 688. FORMAT "%2.0" NUMBER 2 /end CHARACTERISTIC
/begin CHARACTERISTIC DINH_FId.DSQ_Com_rTrq_CA "DINH/Zugeordnete FId für Verriegelungsquelle DSQ_Com_rTrq" VAL_BLK 0x8002582A ValA_Wu16 688. DINH_FIdVerb 0.00 688. FORMAT "%2.0" NUMBER 4 /end CHARACTERISTIC
/begin CHARACTERISTIC DINH_FId.DSQ_Com_stAC_CA "DINH/Zugeordnete FId für Verriegelungsquelle DSQ_Com_stAC" VAL_BLK 0x80025832 ValA_Wu16 688. DINH_FIdVerb 0.00 688. FORMAT "%2.0" NUMBER 2 /end CHARACTERISTIC
/begin CHARACTERISTIC DINH_FId.DSQ_Com_stACEFan_CA "DINH/Zugeordnete FId für Verriegelungsquelle DSQ_Com_stACEFan" VAL_BLK 0x80025836 ValA_Wu16 688. DINH_FIdVerb 0.00 688. FORMAT "%2.0" NUMBER 2 /end CHARACTERISTIC
/begin CHARACTERISTIC DINH_FId.DSQ_Com_stARS_CA "DINH/Zugeordnete FId für Verriegelungsquelle DSQ_Com_stARS" VAL_BLK 0x8002583A ValA_Wu16 688. DINH_FIdVerb 0.00 688. FORMAT "%2.0" NUMBER 2 /end CHARACTERISTIC
/begin CHARACTERISTIC DINH_FId.DSQ_Com_stAcpd_CA "DINH/Zugeordnete FId für Verriegelungsquelle DSQ_Com_stAcpd" VAL_BLK 0x8002583E ValA_Wu16 688. DINH_FIdVerb 0.00 688. FORMAT "%2.0" NUMBER 2 /end CHARACTERISTIC
/begin CHARACTERISTIC DINH_FId.DSQ_Com_stBattClass_CA "DINH/Zugeordnete FId für Verriegelungsquelle DSQ_Com_stBattClass" VAL_BLK 0x80025842 ValA_Wu16 688. DINH_FIdVerb 0.00 688. FORMAT "%2.0" NUMBER 3 /end CHARACTERISTIC
/begin CHARACTERISTIC DINH_FId.DSQ_Com_stBonnet_CA "DINH/Zugeordnete FId für Verriegelungsquelle DSQ_Com_stBonnet" VAL_BLK 0x80025848 ValA_Wu16 688. DINH_FIdVerb 0.00 688. FORMAT "%2.0" NUMBER 2 /end CHARACTERISTIC
/begin CHARACTERISTIC DINH_FId.DSQ_Com_stBrkTrqDVCHQl_CA "DINH/Zugeordnete FId für Verriegelungsquelle DSQ_Com_stBrkTrqDVCHQl" VAL_BLK 0x8002584C ValA_Wu16 688. DINH_FIdVerb 0.00 688. FORMAT "%2.0" NUMBER 3 /end CHARACTERISTIC
/begin CHARACTERISTIC DINH_FId.DSQ_Com_stButtonMSA_CA "DINH/Zugeordnete FId für Verriegelungsquelle DSQ_Com_stButtonMSA" VAL_BLK 0x80025852 ValA_Wu16 688. DINH_FIdVerb 0.00 688. FORMAT "%2.0" NUMBER 3 /end CHARACTERISTIC
/begin CHARACTERISTIC DINH_FId.DSQ_Com_stCat2DsGndRaw_CA "DINH/Zugeordnete FId für Verriegelungsquelle DSQ_Com_stCat2DsGndRaw" VAL_BLK 0x80025858 ValA_Wu16 688. DINH_FIdVerb 0.00 688. FORMAT "%2.0" NUMBER 2 /end CHARACTERISTIC
/begin CHARACTERISTIC DINH_FId.DSQ_Com_stCat2DsUbattRaw_CA "DINH/Zugeordnete FId für Verriegelungsquelle DSQ_Com_stCat2DsUbattRaw" VAL_BLK 0x8002585C ValA_Wu16 688. DINH_FIdVerb 0.00 688. FORMAT "%2.0" NUMBER 2 /end CHARACTERISTIC
/begin CHARACTERISTIC DINH_FId.DSQ_Com_stClCtr_CA "DINH/Zugeordnete FId für Verriegelungsquelle DSQ_Com_stClCtr" VAL_BLK 0x80025860 ValA_Wu16 688. DINH_FIdVerb 0.00 688. FORMAT "%2.0" NUMBER 3 /end CHARACTERISTIC
/begin CHARACTERISTIC DINH_FId.DSQ_Com_stClassPwr_CA "DINH/Zugeordnete FId für Verriegelungsquelle DSQ_Com_stClassPwr" VAL_BLK 0x80025866 ValA_Wu16 688. DINH_FIdVerb 0.00 688. FORMAT "%2.0" NUMBER 2 /end CHARACTERISTIC
/begin CHARACTERISTIC DINH_FId.DSQ_Com_stClth_CA "DINH/Zugeordnete FId für Verriegelungsquelle DSQ_Com_stClth" VAL_BLK 0x8002586A ValA_Wu16 688. DINH_FIdVerb 0.00 688. FORMAT "%2.0" NUMBER 5 /end CHARACTERISTIC
/begin CHARACTERISTIC DINH_FId.DSQ_Com_stClthOpen_CA "DINH/Zugeordnete FId für Verriegelungsquelle DSQ_Com_stClthOpen" VAL_BLK 0x80025874 ValA_Wu16 688. DINH_FIdVerb 0.00 688. FORMAT "%2.0" NUMBER 3 /end CHARACTERISTIC
/begin CHARACTERISTIC DINH_FId.DSQ_Com_stClthRaw_CA "DINH/Zugeordnete FId für Verriegelungsquelle DSQ_Com_stClthRaw" VAL_BLK 0x8002587A ValA_Wu16 688. DINH_FIdVerb 0.00 688. FORMAT "%2.0" NUMBER 3 /end CHARACTERISTIC
/begin CHARACTERISTIC DINH_FId.DSQ_Com_stCrCtlKombi_CA "DINH/Zugeordnete FId für Verriegelungsquelle DSQ_Com_stCrCtlKombi" VAL_BLK 0x80025880 ValA_Wu16 688. DINH_FIdVerb 0.00 688. FORMAT "%2.0" NUMBER 3 /end CHARACTERISTIC
/begin CHARACTERISTIC DINH_FId.DSQ_Com_stCrCtlLvr_CA "DINH/Zugeordnete FId für Verriegelungsquelle DSQ_Com_stCrCtlLvr" VAL_BLK 0x80025886 ValA_Wu16 688. DINH_FIdVerb 0.00 688. FORMAT "%2.0" NUMBER 3 /end CHARACTERISTIC
/begin CHARACTERISTIC DINH_FId.DSQ_Com_stDSC_CA "DINH/Zugeordnete FId für Verriegelungsquelle DSQ_Com_stDSC" VAL_BLK 0x8002588C ValA_Wu16 688. DINH_FIdVerb 0.00 688. FORMAT "%2.0" NUMBER 4 /end CHARACTERISTIC
/begin CHARACTERISTIC DINH_FId.DSQ_Com_stDecellDSC_CA "DINH/Zugeordnete FId für Verriegelungsquelle DSQ_Com_stDecellDSC" VAL_BLK 0x80025894 ValA_Wu16 688. DINH_FIdVerb 0.00 688. FORMAT "%2.0" NUMBER 2 /end CHARACTERISTIC
/begin CHARACTERISTIC DINH_FId.DSQ_Com_stDiagPsp_CA "DINH/Zugeordnete FId für Verriegelungsquelle DSQ_Com_stDiagPsp" VAL_BLK 0x80025898 ValA_Wu16 688. DINH_FIdVerb 0.00 688. FORMAT "%2.0" NUMBER 2 /end CHARACTERISTIC
/begin CHARACTERISTIC DINH_FId.DSQ_Com_stDoorDriver_CA "DINH/Zugeordnete FId für Verriegelungsquelle DSQ_Com_stDoorDriver" VAL_BLK 0x8002589C ValA_Wu16 688. DINH_FIdVerb 0.00 688. FORMAT "%2.0" NUMBER 2 /end CHARACTERISTIC
/begin CHARACTERISTIC DINH_FId.DSQ_Com_stDrWghSeat_CA "DINH/Zugeordnete FId für Verriegelungsquelle DSQ_Com_stDrWghSeat" VAL_BLK 0x800258A0 ValA_Wu16 688. DINH_FIdVerb 0.00 688. FORMAT "%2.0" NUMBER 3 /end CHARACTERISTIC
/begin CHARACTERISTIC DINH_FId.DSQ_Com_stDrvAssist_CA "DINH/Zugeordnete FId für Verriegelungsquelle DSQ_Com_stDrvAssist" VAL_BLK 0x800258A6 ValA_Wu16 688. DINH_FIdVerb 0.00 688. FORMAT "%2.0" NUMBER 2 /end CHARACTERISTIC
/begin CHARACTERISTIC DINH_FId.DSQ_Com_stDrvDyn_CA "DINH/Zugeordnete FId für Verriegelungsquelle DSQ_Com_stDrvDyn" VAL_BLK 0x800258AA ValA_Wu16 688. DINH_FIdVerb 0.00 688. FORMAT "%2.0" NUMBER 2 /end CHARACTERISTIC
/begin CHARACTERISTIC DINH_FId.DSQ_Com_stDrvPrgQl_CA "DINH/Zugeordnete FId für Verriegelungsquelle DSQ_Com_stDrvPrgQl" VAL_BLK 0x800258AE ValA_Wu16 688. DINH_FIdVerb 0.00 688. FORMAT "%2.0" NUMBER 2 /end CHARACTERISTIC
/begin CHARACTERISTIC DINH_FId.DSQ_Com_stDynDisp_CA "DINH/Zugeordnete FId für Verriegelungsquelle DSQ_Com_stDynDisp" VAL_BLK 0x800258B2 ValA_Wu16 688. DINH_FIdVerb 0.00 688. FORMAT "%2.0" NUMBER 2 /end CHARACTERISTIC
/begin CHARACTERISTIC DINH_FId.DSQ_Com_stEngStop_CA "DINH/Zugeordnete FId für Verriegelungsquelle DSQ_Com_stEngStop" VAL_BLK 0x800258B6 ValA_Wu16 688. DINH_FIdVerb 0.00 688. FORMAT "%2.0" NUMBER 3 /end CHARACTERISTIC
/begin CHARACTERISTIC DINH_FId.DSQ_Com_stErrAFS_CA "DINH/Zugeordnete FId für Verriegelungsquelle DSQ_Com_stErrAFS" VAL_BLK 0x800258BC ValA_Wu16 688. DINH_FIdVerb 0.00 688. FORMAT "%2.0" NUMBER 2 /end CHARACTERISTIC
/begin CHARACTERISTIC DINH_FId.DSQ_Com_stErrStrg_CA "DINH/Zugeordnete FId für Verriegelungsquelle DSQ_Com_stErrStrg" VAL_BLK 0x800258C0 ValA_Wu16 688. DINH_FIdVerb 0.00 688. FORMAT "%2.0" NUMBER 2 /end CHARACTERISTIC
/begin CHARACTERISTIC DINH_FId.DSQ_Com_stFlTnkQntRes_CA "DINH/Zugeordnete FId für Verriegelungsquelle DSQ_Com_stFlTnkQntRes" VAL_BLK 0x800258C4 ValA_Wu16 688. DINH_FIdVerb 0.00 688. FORMAT "%2.0" NUMBER 2 /end CHARACTERISTIC
/begin CHARACTERISTIC DINH_FId.DSQ_Com_stFolDyn_CA "DINH/Zugeordnete FId für Verriegelungsquelle DSQ_Com_stFolDyn" VAL_BLK 0x800258C8 ValA_Wu16 688. DINH_FIdVerb 0.00 688. FORMAT "%2.0" NUMBER 2 /end CHARACTERISTIC
/begin CHARACTERISTIC DINH_FId.DSQ_Com_stGbxOBD_CA "DINH/Zugeordnete FId für Verriegelungsquelle DSQ_Com_stGbxOBD" VAL_BLK 0x800258CC ValA_Wu16 688. DINH_FIdVerb 0.00 688. FORMAT "%2.0" NUMBER 2 /end CHARACTERISTIC
/begin CHARACTERISTIC DINH_FId.DSQ_Com_stGear_CA "DINH/Zugeordnete FId für Verriegelungsquelle DSQ_Com_stGear" VAL_BLK 0x800258D0 ValA_Wu16 688. DINH_FIdVerb 0.00 688. FORMAT "%2.0" NUMBER 9 /end CHARACTERISTIC
/begin CHARACTERISTIC DINH_FId.DSQ_Com_stGearBck_CA "DINH/Zugeordnete FId für Verriegelungsquelle DSQ_Com_stGearBck" VAL_BLK 0x800258E2 ValA_Wu16 688. DINH_FIdVerb 0.00 688. FORMAT "%2.0" NUMBER 3 /end CHARACTERISTIC
/begin CHARACTERISTIC DINH_FId.DSQ_Com_stHDC_CA "DINH/Zugeordnete FId für Verriegelungsquelle DSQ_Com_stHDC" VAL_BLK 0x800258E8 ValA_Wu16 688. DINH_FIdVerb 0.00 688. FORMAT "%2.0" NUMBER 2 /end CHARACTERISTIC
/begin CHARACTERISTIC DINH_FId.DSQ_Com_stKeyVld_CA "DINH/Zugeordnete FId für Verriegelungsquelle DSQ_Com_stKeyVld" VAL_BLK 0x800258EC ValA_Wu16 688. DINH_FIdVerb 0.00 688. FORMAT "%2.0" NUMBER 2 /end CHARACTERISTIC
/begin CHARACTERISTIC DINH_FId.DSQ_Com_stLckGbxDemQl_CA "DINH/Zugeordnete FId für Verriegelungsquelle DSQ_Com_stLckGbxDemQl" VAL_BLK 0x800258F0 ValA_Wu16 688. DINH_FIdVerb 0.00 688. FORMAT "%2.0" NUMBER 2 /end CHARACTERISTIC
/begin CHARACTERISTIC DINH_FId.DSQ_Com_stLmpPrkBrk_CA "DINH/Zugeordnete FId für Verriegelungsquelle DSQ_Com_stLmpPrkBrk" VAL_BLK 0x800258F4 ValA_Wu16 688. DINH_FIdVerb 0.00 688. FORMAT "%2.0" NUMBER 3 /end CHARACTERISTIC
/begin CHARACTERISTIC DINH_FId.DSQ_Com_stMSALmp_CA "DINH/Zugeordnete FId für Verriegelungsquelle DSQ_Com_stMSALmp" VAL_BLK 0x800258FA ValA_Wu16 688. DINH_FIdVerb 0.00 688. FORMAT "%2.0" NUMBER 3 /end CHARACTERISTIC
/begin CHARACTERISTIC DINH_FId.DSQ_Com_stModDKG_CA "DINH/Zugeordnete FId für Verriegelungsquelle DSQ_Com_stModDKG" VAL_BLK 0x80025900 ValA_Wu16 688. DINH_FIdVerb 0.00 688. FORMAT "%2.0" NUMBER 2 /end CHARACTERISTIC
/begin CHARACTERISTIC DINH_FId.DSQ_Com_stNOxErrGndRaw_CA "DINH/Zugeordnete FId für Verriegelungsquelle DSQ_Com_stNOxErrGndRaw" VAL_BLK 0x80025904 ValA_Wu16 688. DINH_FIdVerb 0.00 688. FORMAT "%2.0" NUMBER 2 /end CHARACTERISTIC
/begin CHARACTERISTIC DINH_FId.DSQ_Com_stNOxErrUbattRaw_CA "DINH/Zugeordnete FId für Verriegelungsquelle DSQ_Com_stNOxErrUbattRaw" VAL_BLK 0x80025908 ValA_Wu16 688. DINH_FIdVerb 0.00 688. FORMAT "%2.0" NUMBER 2 /end CHARACTERISTIC
/begin CHARACTERISTIC DINH_FId.DSQ_Com_stPBrComf_CA "DINH/Zugeordnete FId für Verriegelungsquelle DSQ_Com_stPBrComf" VAL_BLK 0x8002590C ValA_Wu16 688. DINH_FIdVerb 0.00 688. FORMAT "%2.0" NUMBER 3 /end CHARACTERISTIC
/begin CHARACTERISTIC DINH_FId.DSQ_Com_stPBrHold_CA "DINH/Zugeordnete FId für Verriegelungsquelle DSQ_Com_stPBrHold" VAL_BLK 0x80025912 ValA_Wu16 688. DINH_FIdVerb 0.00 688. FORMAT "%2.0" NUMBER 4 /end CHARACTERISTIC
/begin CHARACTERISTIC DINH_FId.DSQ_Com_stPBrHyd_CA "DINH/Zugeordnete FId für Verriegelungsquelle DSQ_Com_stPBrHyd" VAL_BLK 0x8002591A ValA_Wu16 688. DINH_FIdVerb 0.00 688. FORMAT "%2.0" NUMBER 3 /end CHARACTERISTIC
/begin CHARACTERISTIC DINH_FId.DSQ_Com_stPBrkSysQl_CA "DINH/Zugeordnete FId für Verriegelungsquelle DSQ_Com_stPBrkSysQl" VAL_BLK 0x80025920 ValA_Wu16 688. DINH_FIdVerb 0.00 688. FORMAT "%2.0" NUMBER 2 /end CHARACTERISTIC
/begin CHARACTERISTIC DINH_FId.DSQ_Com_stPHtr_CA "DINH/Zugeordnete FId für Verriegelungsquelle DSQ_Com_stPHtr" VAL_BLK 0x80025924 ValA_Wu16 688. DINH_FIdVerb 0.00 688. FORMAT "%2.0" NUMBER 2 /end CHARACTERISTIC
/begin CHARACTERISTIC DINH_FId.DSQ_Com_stParkConsumer_CA "DINH/Zugeordnete FId für Verriegelungsquelle DSQ_Com_stParkConsumer" VAL_BLK 0x80025928 ValA_Wu16 688. DINH_FIdVerb 0.00 688. FORMAT "%2.0" NUMBER 2 /end CHARACTERISTIC
/begin CHARACTERISTIC DINH_FId.DSQ_Com_stPsp_CA "DINH/Zugeordnete FId für Verriegelungsquelle DSQ_Com_stPsp" VAL_BLK 0x8002592C ValA_Wu16 688. DINH_FIdVerb 0.00 688. FORMAT "%2.0" NUMBER 2 /end CHARACTERISTIC
/begin CHARACTERISTIC DINH_FId.DSQ_Com_stPspCntr_CA "DINH/Zugeordnete FId für Verriegelungsquelle DSQ_Com_stPspCntr" VAL_BLK 0x80025930 ValA_Wu16 688. DINH_FIdVerb 0.00 688. FORMAT "%2.0" NUMBER 2 /end CHARACTERISTIC
/begin CHARACTERISTIC DINH_FId.DSQ_Com_stRaceStrt_CA "DINH/Zugeordnete FId für Verriegelungsquelle DSQ_Com_stRaceStrt" VAL_BLK 0x80025934 ValA_Wu16 688. DINH_FIdVerb 0.00 688. FORMAT "%2.0" NUMBER 2 /end CHARACTERISTIC
/begin CHARACTERISTIC DINH_FId.DSQ_Com_stReqMSA_CA "DINH/Zugeordnete FId für Verriegelungsquelle DSQ_Com_stReqMSA" VAL_BLK 0x80025938 ValA_Wu16 688. DINH_FIdVerb 0.00 688. FORMAT "%2.0" NUMBER 2 /end CHARACTERISTIC
/begin CHARACTERISTIC DINH_FId.DSQ_Com_stRevGear_CA "DINH/Zugeordnete FId für Verriegelungsquelle DSQ_Com_stRevGear" VAL_BLK 0x8002593C ValA_Wu16 688. DINH_FIdVerb 0.00 688. FORMAT "%2.0" NUMBER 2 /end CHARACTERISTIC
/begin CHARACTERISTIC DINH_FId.DSQ_Com_stSTEQl_CA "DINH/Zugeordnete FId für Verriegelungsquelle DSQ_Com_stSTEQl" VAL_BLK 0x80025940 ValA_Wu16 688. DINH_FIdVerb 0.00 688. FORMAT "%2.0" NUMBER 2 /end CHARACTERISTIC
/begin CHARACTERISTIC DINH_FId.DSQ_Com_stSeason_CA "DINH/Zugeordnete FId für Verriegelungsquelle DSQ_Com_stSeason" VAL_BLK 0x80025944 ValA_Wu16 688. DINH_FIdVerb 0.00 688. FORMAT "%2.0" NUMBER 2 /end CHARACTERISTIC
/begin CHARACTERISTIC DINH_FId.DSQ_Com_stShftIdctrDemRglX_CA "DINH/Zugeordnete FId für Verriegelungsquelle DSQ_Com_stShftIdctrDemRglX" VAL_BLK 0x80025948 ValA_Wu16 688. DINH_FIdVerb 0.00 688. FORMAT "%2.0" NUMBER 2 /end CHARACTERISTIC
/begin CHARACTERISTIC DINH_FId.DSQ_Com_stShiftPdl_CA "DINH/Zugeordnete FId für Verriegelungsquelle DSQ_Com_stShiftPdl" VAL_BLK 0x8002594C ValA_Wu16 688. DINH_FIdVerb 0.00 688. FORMAT "%2.0" NUMBER 2 /end CHARACTERISTIC
/begin CHARACTERISTIC DINH_FId.DSQ_Com_stShutOffPSP_CA "DINH/Zugeordnete FId für Verriegelungsquelle DSQ_Com_stShutOffPSP" VAL_BLK 0x80025950 ValA_Wu16 688. DINH_FIdVerb 0.00 688. FORMAT "%2.0" NUMBER 2 /end CHARACTERISTIC
/begin CHARACTERISTIC DINH_FId.DSQ_Com_stSleepBus_CA "DINH/Zugeordnete FId für Verriegelungsquelle DSQ_Com_stSleepBus" VAL_BLK 0x80025954 ValA_Wu16 688. DINH_FIdVerb 0.00 688. FORMAT "%2.0" NUMBER 2 /end CHARACTERISTIC
/begin CHARACTERISTIC DINH_FId.DSQ_Com_stSleepConst_CA "DINH/Zugeordnete FId für Verriegelungsquelle DSQ_Com_stSleepConst" VAL_BLK 0x80025958 ValA_Wu16 688. DINH_FIdVerb 0.00 688. FORMAT "%2.0" NUMBER 2 /end CHARACTERISTIC
/begin CHARACTERISTIC DINH_FId.DSQ_Com_stSleepDest_CA "DINH/Zugeordnete FId für Verriegelungsquelle DSQ_Com_stSleepDest" VAL_BLK 0x8002595C ValA_Wu16 688. DINH_FIdVerb 0.00 688. FORMAT "%2.0" NUMBER 2 /end CHARACTERISTIC
/begin CHARACTERISTIC DINH_FId.DSQ_Com_stSleepRdy_CA "DINH/Zugeordnete FId für Verriegelungsquelle DSQ_Com_stSleepRdy" VAL_BLK 0x80025960 ValA_Wu16 688. DINH_FIdVerb 0.00 688. FORMAT "%2.0" NUMBER 2 /end CHARACTERISTIC
/begin CHARACTERISTIC DINH_FId.DSQ_Com_stStrg_CA "DINH/Zugeordnete FId für Verriegelungsquelle DSQ_Com_stStrg" VAL_BLK 0x80025964 ValA_Wu16 688. DINH_FIdVerb 0.00 688. FORMAT "%2.0" NUMBER 2 /end CHARACTERISTIC
/begin CHARACTERISTIC DINH_FId.DSQ_Com_stStrtClth_CA "DINH/Zugeordnete FId für Verriegelungsquelle DSQ_Com_stStrtClth" VAL_BLK 0x80025968 ValA_Wu16 688. DINH_FIdVerb 0.00 688. FORMAT "%2.0" NUMBER 2 /end CHARACTERISTIC
/begin CHARACTERISTIC DINH_FId.DSQ_Com_stStrtLck_CA "DINH/Zugeordnete FId für Verriegelungsquelle DSQ_Com_stStrtLck" VAL_BLK 0x8002596C ValA_Wu16 688. DINH_FIdVerb 0.00 688. FORMAT "%2.0" NUMBER 2 /end CHARACTERISTIC
/begin CHARACTERISTIC DINH_FId.DSQ_Com_stT15_CA "DINH/Zugeordnete FId für Verriegelungsquelle DSQ_Com_stT15" VAL_BLK 0x80025970 ValA_Wu16 688. DINH_FIdVerb 0.00 688. FORMAT "%2.0" NUMBER 3 /end CHARACTERISTIC
/begin CHARACTERISTIC DINH_FId.DSQ_Com_stT15Hw_CA "DINH/Zugeordnete FId für Verriegelungsquelle DSQ_Com_stT15Hw" VAL_BLK 0x80025976 ValA_Wu16 688. DINH_FIdVerb 0.00 688. FORMAT "%2.0" NUMBER 2 /end CHARACTERISTIC
/begin CHARACTERISTIC DINH_FId.DSQ_Com_stT50_CA "DINH/Zugeordnete FId für Verriegelungsquelle DSQ_Com_stT50" VAL_BLK 0x8002597A ValA_Wu16 688. DINH_FIdVerb 0.00 688. FORMAT "%2.0" NUMBER 3 /end CHARACTERISTIC
/begin CHARACTERISTIC DINH_FId.DSQ_Com_stTRadio_CA "DINH/Zugeordnete FId für Verriegelungsquelle DSQ_Com_stTRadio" VAL_BLK 0x80025980 ValA_Wu16 688. DINH_FIdVerb 0.00 688. FORMAT "%2.0" NUMBER 3 /end CHARACTERISTIC
/begin CHARACTERISTIC DINH_FId.DSQ_Com_stTSC_CA "DINH/Zugeordnete FId für Verriegelungsquelle DSQ_Com_stTSC" VAL_BLK 0x80025986 ValA_Wu16 688. DINH_FIdVerb 0.00 688. FORMAT "%2.0" NUMBER 3 /end CHARACTERISTIC
/begin CHARACTERISTIC DINH_FId.DSQ_Com_stTerminal_CA "DINH/Zugeordnete FId für Verriegelungsquelle DSQ_Com_stTerminal" VAL_BLK 0x8002598C ValA_Wu16 688. DINH_FIdVerb 0.00 688. FORMAT "%2.0" NUMBER 3 /end CHARACTERISTIC
/begin CHARACTERISTIC DINH_FId.DSQ_Com_stTrailer_CA "DINH/Zugeordnete FId für Verriegelungsquelle DSQ_Com_stTrailer" VAL_BLK 0x80025992 ValA_Wu16 688. DINH_FIdVerb 0.00 688. FORMAT "%2.0" NUMBER 6 /end CHARACTERISTIC
/begin CHARACTERISTIC DINH_FId.DSQ_Com_stTrqAFS_CA "DINH/Zugeordnete FId für Verriegelungsquelle DSQ_Com_stTrqAFS" VAL_BLK 0x8002599E ValA_Wu16 688. DINH_FIdVerb 0.00 688. FORMAT "%2.0" NUMBER 2 /end CHARACTERISTIC
/begin CHARACTERISTIC DINH_FId.DSQ_Com_stTrqDSCDes_CA "DINH/Zugeordnete FId für Verriegelungsquelle DSQ_Com_stTrqDSCDes" VAL_BLK 0x800259A2 ValA_Wu16 688. DINH_FIdVerb 0.00 688. FORMAT "%2.0" NUMBER 4 /end CHARACTERISTIC
/begin CHARACTERISTIC DINH_FId.DSQ_Com_stTrqFil_CA "DINH/Zugeordnete FId für Verriegelungsquelle DSQ_Com_stTrqFil" VAL_BLK 0x800259AA ValA_Wu16 688. DINH_FIdVerb 0.00 688. FORMAT "%2.0" NUMBER 2 /end CHARACTERISTIC
/begin CHARACTERISTIC DINH_FId.DSQ_Com_stTrqGbxDes_CA "DINH/Zugeordnete FId für Verriegelungsquelle DSQ_Com_stTrqGbxDes" VAL_BLK 0x800259AE ValA_Wu16 688. DINH_FIdVerb 0.00 688. FORMAT "%2.0" NUMBER 6 /end CHARACTERISTIC
/begin CHARACTERISTIC DINH_FId.DSQ_Com_stTrqGbxLim_CA "DINH/Zugeordnete FId für Verriegelungsquelle DSQ_Com_stTrqGbxLim" VAL_BLK 0x800259BA ValA_Wu16 688. DINH_FIdVerb 0.00 688. FORMAT "%2.0" NUMBER 2 /end CHARACTERISTIC
/begin CHARACTERISTIC DINH_FId.DSQ_Com_stTrqStbDesQl_CA "DINH/Zugeordnete FId für Verriegelungsquelle DSQ_Com_stTrqStbDesQl" VAL_BLK 0x800259BE ValA_Wu16 688. DINH_FIdVerb 0.00 688. FORMAT "%2.0" NUMBER 2 /end CHARACTERISTIC
/begin CHARACTERISTIC DINH_FId.DSQ_Com_stTrqStrg_CA "DINH/Zugeordnete FId für Verriegelungsquelle DSQ_Com_stTrqStrg" VAL_BLK 0x800259C2 ValA_Wu16 688. DINH_FIdVerb 0.00 688. FORMAT "%2.0" NUMBER 2 /end CHARACTERISTIC
/begin CHARACTERISTIC DINH_FId.DSQ_Com_stTrqWhl_CA "DINH/Zugeordnete FId für Verriegelungsquelle DSQ_Com_stTrqWhl" VAL_BLK 0x800259C6 ValA_Wu16 688. DINH_FIdVerb 0.00 688. FORMAT "%2.0" NUMBER 2 /end CHARACTERISTIC
/begin CHARACTERISTIC DINH_FId.DSQ_Com_stTrqWhlDemFASQl_CA "DINH/Zugeordnete FId für Verriegelungsquelle DSQ_Com_stTrqWhlDemFASQl" VAL_BLK 0x800259CA ValA_Wu16 688. DINH_FIdVerb 0.00 688. FORMAT "%2.0" NUMBER 2 /end CHARACTERISTIC
/begin CHARACTERISTIC DINH_FId.DSQ_Com_stTrqWhlDesQl_CA "DINH/Zugeordnete FId für Verriegelungsquelle DSQ_Com_stTrqWhlDesQl" VAL_BLK 0x800259CE ValA_Wu16 688. DINH_FIdVerb 0.00 688. FORMAT "%2.0" NUMBER 2 /end CHARACTERISTIC
/begin CHARACTERISTIC DINH_FId.DSQ_Com_stTypBody_CA "DINH/Zugeordnete FId für Verriegelungsquelle DSQ_Com_stTypBody" VAL_BLK 0x800259D2 ValA_Wu16 688. DINH_FIdVerb 0.00 688. FORMAT "%2.0" NUMBER 2 /end CHARACTERISTIC
/begin CHARACTERISTIC DINH_FId.DSQ_Com_stUnVel_CA "DINH/Zugeordnete FId für Verriegelungsquelle DSQ_Com_stUnVel" VAL_BLK 0x800259D6 ValA_Wu16 688. DINH_FIdVerb 0.00 688. FORMAT "%2.0" NUMBER 3 /end CHARACTERISTIC
/begin CHARACTERISTIC DINH_FId.DSQ_Com_stVehCond_CA "DINH/Zugeordnete FId für Verriegelungsquelle DSQ_Com_stVehCond" VAL_BLK 0x800259DC ValA_Wu16 688. DINH_FIdVerb 0.00 688. FORMAT "%2.0" NUMBER 2 /end CHARACTERISTIC
/begin CHARACTERISTIC DINH_FId.DSQ_Com_stVehDrvCond_CA "DINH/Zugeordnete FId für Verriegelungsquelle DSQ_Com_stVehDrvCond" VAL_BLK 0x800259E0 ValA_Wu16 688. DINH_FIdVerb 0.00 688. FORMAT "%2.0" NUMBER 3 /end CHARACTERISTIC
/begin CHARACTERISTIC DINH_FId.DSQ_Com_stVerbraucher_CA "DINH/Zugeordnete FId für Verriegelungsquelle DSQ_Com_stVerbraucher" VAL_BLK 0x800259E6 ValA_Wu16 688. DINH_FIdVerb 0.00 688. FORMAT "%2.0" NUMBER 3 /end CHARACTERISTIC
/begin CHARACTERISTIC DINH_FId.DSQ_Com_stphiStWhlAg_CA "DINH/Zugeordnete FId für Verriegelungsquelle DSQ_Com_stphiStWhlAg" VAL_BLK 0x800259EC ValA_Wu16 688. DINH_FIdVerb 0.00 688. FORMAT "%2.0" NUMBER 2 /end CHARACTERISTIC
/begin CHARACTERISTIC DINH_FId.DSQ_Com_swtAC_CA "DINH/Zugeordnete FId für Verriegelungsquelle DSQ_Com_swtAC" VAL_BLK 0x800259F0 ValA_Wu16 688. DINH_FIdVerb 0.00 688. FORMAT "%2.0" NUMBER 2 /end CHARACTERISTIC
/begin CHARACTERISTIC DINH_FId.DSQ_Com_swtDrBltb_CA "DINH/Zugeordnete FId für Verriegelungsquelle DSQ_Com_swtDrBltb" VAL_BLK 0x800259F4 ValA_Wu16 688. DINH_FIdVerb 0.00 688. FORMAT "%2.0" NUMBER 3 /end CHARACTERISTIC
/begin CHARACTERISTIC DINH_FId.DSQ_Com_tEnvT_CA "DINH/Zugeordnete FId für Verriegelungsquelle DSQ_Com_tEnvT" VAL_BLK 0x800259FA ValA_Wu16 688. DINH_FIdVerb 0.00 688. FORMAT "%2.0" NUMBER 2 /end CHARACTERISTIC
/begin CHARACTERISTIC DINH_FId.DSQ_Com_tGbxOil_CA "DINH/Zugeordnete FId für Verriegelungsquelle DSQ_Com_tGbxOil" VAL_BLK 0x800259FE ValA_Wu16 688. DINH_FIdVerb 0.00 688. FORMAT "%2.0" NUMBER 3 /end CHARACTERISTIC
/begin CHARACTERISTIC DINH_FId.DSQ_Com_tiPostRunPwrSpl_CA "DINH/Zugeordnete FId für Verriegelungsquelle DSQ_Com_tiPostRunPwrSpl" VAL_BLK 0x80025A04 ValA_Wu16 688. DINH_FIdVerb 0.00 688. FORMAT "%2.0" NUMBER 2 /end CHARACTERISTIC
/begin CHARACTERISTIC DINH_FId.DSQ_Com_trqAC_CA "DINH/Zugeordnete FId für Verriegelungsquelle DSQ_Com_trqAC" VAL_BLK 0x80025A08 ValA_Wu16 688. DINH_FIdVerb 0.00 688. FORMAT "%2.0" NUMBER 2 /end CHARACTERISTIC
/begin CHARACTERISTIC DINH_FId.DSQ_Com_trqAFS_CA "DINH/Zugeordnete FId für Verriegelungsquelle DSQ_Com_trqAFS" VAL_BLK 0x80025A0C ValA_Wu16 688. DINH_FIdVerb 0.00 688. FORMAT "%2.0" NUMBER 2 /end CHARACTERISTIC
/begin CHARACTERISTIC DINH_FId.DSQ_Com_trqAFSDes_CA "DINH/Zugeordnete FId für Verriegelungsquelle DSQ_Com_trqAFSDes" VAL_BLK 0x80025A10 ValA_Wu16 688. DINH_FIdVerb 0.00 688. FORMAT "%2.0" NUMBER 2 /end CHARACTERISTIC
/begin CHARACTERISTIC DINH_FId.DSQ_Com_trqARSCur_CA "DINH/Zugeordnete FId für Verriegelungsquelle DSQ_Com_trqARSCur" VAL_BLK 0x80025A14 ValA_Wu16 688. DINH_FIdVerb 0.00 688. FORMAT "%2.0" NUMBER 2 /end CHARACTERISTIC
/begin CHARACTERISTIC DINH_FId.DSQ_Com_trqARSDes_CA "DINH/Zugeordnete FId für Verriegelungsquelle DSQ_Com_trqARSDes" VAL_BLK 0x80025A18 ValA_Wu16 688. DINH_FIdVerb 0.00 688. FORMAT "%2.0" NUMBER 2 /end CHARACTERISTIC
/begin CHARACTERISTIC DINH_FId.DSQ_Com_trqAdjrDKG_CA "DINH/Zugeordnete FId für Verriegelungsquelle DSQ_Com_trqAdjrDKG" VAL_BLK 0x80025A1C ValA_Wu16 688. DINH_FIdVerb 0.00 688. FORMAT "%2.0" NUMBER 2 /end CHARACTERISTIC
/begin CHARACTERISTIC DINH_FId.DSQ_Com_trqBrkDVCH_CA "DINH/Zugeordnete FId für Verriegelungsquelle DSQ_Com_trqBrkDVCH" VAL_BLK 0x80025A20 ValA_Wu16 688. DINH_FIdVerb 0.00 688. FORMAT "%2.0" NUMBER 3 /end CHARACTERISTIC
/begin CHARACTERISTIC DINH_FId.DSQ_Com_trqClthDKG_CA "DINH/Zugeordnete FId für Verriegelungsquelle DSQ_Com_trqClthDKG" VAL_BLK 0x80025A26 ValA_Wu16 688. DINH_FIdVerb 0.00 688. FORMAT "%2.0" NUMBER 2 /end CHARACTERISTIC
/begin CHARACTERISTIC DINH_FId.DSQ_Com_trqDSCDes_CA "DINH/Zugeordnete FId für Verriegelungsquelle DSQ_Com_trqDSCDes" VAL_BLK 0x80025A2A ValA_Wu16 688. DINH_FIdVerb 0.00 688. FORMAT "%2.0" NUMBER 5 /end CHARACTERISTIC
/begin CHARACTERISTIC DINH_FId.DSQ_Com_trqDVCHRise_CA "DINH/Zugeordnete FId für Verriegelungsquelle DSQ_Com_trqDVCHRise" VAL_BLK 0x80025A34 ValA_Wu16 688. DINH_FIdVerb 0.00 688. FORMAT "%2.0" NUMBER 2 /end CHARACTERISTIC
/begin CHARACTERISTIC DINH_FId.DSQ_Com_trqGbxDes_CA "DINH/Zugeordnete FId für Verriegelungsquelle DSQ_Com_trqGbxDes" VAL_BLK 0x80025A38 ValA_Wu16 688. DINH_FIdVerb 0.00 688. FORMAT "%2.0" NUMBER 8 /end CHARACTERISTIC
/begin CHARACTERISTIC DINH_FId.DSQ_Com_trqGbxFrc_CA "DINH/Zugeordnete FId für Verriegelungsquelle DSQ_Com_trqGbxFrc" VAL_BLK 0x80025A48 ValA_Wu16 688. DINH_FIdVerb 0.00 688. FORMAT "%2.0" NUMBER 3 /end CHARACTERISTIC
/begin CHARACTERISTIC DINH_FId.DSQ_Com_trqGbxMax_CA "DINH/Zugeordnete FId für Verriegelungsquelle DSQ_Com_trqGbxMax" VAL_BLK 0x80025A4E ValA_Wu16 688. DINH_FIdVerb 0.00 688. FORMAT "%2.0" NUMBER 3 /end CHARACTERISTIC
/begin CHARACTERISTIC DINH_FId.DSQ_Com_trqGbxMaxRaw_CA "DINH/Zugeordnete FId für Verriegelungsquelle DSQ_Com_trqGbxMaxRaw" VAL_BLK 0x80025A54 ValA_Wu16 688. DINH_FIdVerb 0.00 688. FORMAT "%2.0" NUMBER 2 /end CHARACTERISTIC
/begin CHARACTERISTIC DINH_FId.DSQ_Com_trqStbDes_CA "DINH/Zugeordnete FId für Verriegelungsquelle DSQ_Com_trqStbDes" VAL_BLK 0x80025A58 ValA_Wu16 688. DINH_FIdVerb 0.00 688. FORMAT "%2.0" NUMBER 2 /end CHARACTERISTIC
/begin CHARACTERISTIC DINH_FId.DSQ_Com_trqStrg_CA "DINH/Zugeordnete FId für Verriegelungsquelle DSQ_Com_trqStrg" VAL_BLK 0x80025A5C ValA_Wu16 688. DINH_FIdVerb 0.00 688. FORMAT "%2.0" NUMBER 2 /end CHARACTERISTIC
/begin CHARACTERISTIC DINH_FId.DSQ_Com_trqStrgDes_CA "DINH/Zugeordnete FId für Verriegelungsquelle DSQ_Com_trqStrgDes" VAL_BLK 0x80025A60 ValA_Wu16 688. DINH_FIdVerb 0.00 688. FORMAT "%2.0" NUMBER 2 /end CHARACTERISTIC
/begin CHARACTERISTIC DINH_FId.DSQ_Com_trqTarDKG_CA "DINH/Zugeordnete FId für Verriegelungsquelle DSQ_Com_trqTarDKG" VAL_BLK 0x80025A64 ValA_Wu16 688. DINH_FIdVerb 0.00 688. FORMAT "%2.0" NUMBER 2 /end CHARACTERISTIC
/begin CHARACTERISTIC DINH_FId.DSQ_Com_trqTarDrvDyn_CA "DINH/Zugeordnete FId für Verriegelungsquelle DSQ_Com_trqTarDrvDyn" VAL_BLK 0x80025A68 ValA_Wu16 688. DINH_FIdVerb 0.00 688. FORMAT "%2.0" NUMBER 2 /end CHARACTERISTIC
/begin CHARACTERISTIC DINH_FId.DSQ_Com_trqTarDrvDynDes_CA "DINH/Zugeordnete FId für Verriegelungsquelle DSQ_Com_trqTarDrvDynDes" VAL_BLK 0x80025A6C ValA_Wu16 688. DINH_FIdVerb 0.00 688. FORMAT "%2.0" NUMBER 2 /end CHARACTERISTIC
/begin CHARACTERISTIC DINH_FId.DSQ_Com_trqTarDrvDynMax_CA "DINH/Zugeordnete FId für Verriegelungsquelle DSQ_Com_trqTarDrvDynMax" VAL_BLK 0x80025A70 ValA_Wu16 688. DINH_FIdVerb 0.00 688. FORMAT "%2.0" NUMBER 2 /end CHARACTERISTIC
/begin CHARACTERISTIC DINH_FId.DSQ_Com_trqWhlDes_CA "DINH/Zugeordnete FId für Verriegelungsquelle DSQ_Com_trqWhlDes" VAL_BLK 0x80025A74 ValA_Wu16 688. DINH_FIdVerb 0.00 688. FORMAT "%2.0" NUMBER 3 /end CHARACTERISTIC
/begin CHARACTERISTIC DINH_FId.DSQ_Com_uLamBinGndRaw_CA "DINH/Zugeordnete FId für Verriegelungsquelle DSQ_Com_uLamBinGndRaw" VAL_BLK 0x80025A7A ValA_Wu16 688. DINH_FIdVerb 0.00 688. FORMAT "%2.0" NUMBER 2 /end CHARACTERISTIC
/begin CHARACTERISTIC DINH_FId.DSQ_Com_uLamBinUbattRaw_CA "DINH/Zugeordnete FId für Verriegelungsquelle DSQ_Com_uLamBinUbattRaw" VAL_BLK 0x80025A7E ValA_Wu16 688. DINH_FIdVerb 0.00 688. FORMAT "%2.0" NUMBER 2 /end CHARACTERISTIC
/begin CHARACTERISTIC DINH_FId.DSQ_Com_uPsp_CA "DINH/Zugeordnete FId für Verriegelungsquelle DSQ_Com_uPsp" VAL_BLK 0x80025A82 ValA_Wu16 688. DINH_FIdVerb 0.00 688. FORMAT "%2.0" NUMBER 2 /end CHARACTERISTIC
/begin CHARACTERISTIC DINH_FId.DSQ_Com_uT30Psp_CA "DINH/Zugeordnete FId für Verriegelungsquelle DSQ_Com_uT30Psp" VAL_BLK 0x80025A86 ValA_Wu16 688. DINH_FIdVerb 0.00 688. FORMAT "%2.0" NUMBER 2 /end CHARACTERISTIC
/begin CHARACTERISTIC DINH_FId.DSQ_Com_v_CA "DINH/Zugeordnete FId für Verriegelungsquelle DSQ_Com_v" VAL_BLK 0x80025A8A ValA_Wu16 688. DINH_FIdVerb 0.00 688. FORMAT "%2.0" NUMBER 17 /end CHARACTERISTIC
/begin CHARACTERISTIC DINH_FId.DSQ_Com_vBd_CA "DINH/Zugeordnete FId für Verriegelungsquelle DSQ_Com_vBd" VAL_BLK 0x80025AAC ValA_Wu16 688. DINH_FIdVerb 0.00 688. FORMAT "%2.0" NUMBER 5 /end CHARACTERISTIC
/begin CHARACTERISTIC DINH_FId.DSQ_Com_vDspl_CA "DINH/Zugeordnete FId für Verriegelungsquelle DSQ_Com_vDspl" VAL_BLK 0x80025AB6 ValA_Wu16 688. DINH_FIdVerb 0.00 688. FORMAT "%2.0" NUMBER 3 /end CHARACTERISTIC
/begin CHARACTERISTIC DINH_FId.DSQ_Com_vVeh_CA "DINH/Zugeordnete FId für Verriegelungsquelle DSQ_Com_vVeh" VAL_BLK 0x80025ABC ValA_Wu16 688. DINH_FIdVerb 0.00 688. FORMAT "%2.0" NUMBER 3 /end CHARACTERISTIC
/begin CHARACTERISTIC DINH_FId.DSQ_Com_volFlTnkQnt_CA "DINH/Zugeordnete FId für Verriegelungsquelle DSQ_Com_volFlTnkQnt" VAL_BLK 0x80025AC2 ValA_Wu16 688. DINH_FIdVerb 0.00 688. FORMAT "%2.0" NUMBER 2 /end CHARACTERISTIC
/begin CHARACTERISTIC DINH_FId.DSQ_Com_volFlTnkQntLH_CA "DINH/Zugeordnete FId für Verriegelungsquelle DSQ_Com_volFlTnkQntLH" VAL_BLK 0x80025AC6 ValA_Wu16 688. DINH_FIdVerb 0.00 688. FORMAT "%2.0" NUMBER 2 /end CHARACTERISTIC
/begin CHARACTERISTIC DINH_FId.DSQ_Com_volFlTnkQntRH_CA "DINH/Zugeordnete FId für Verriegelungsquelle DSQ_Com_volFlTnkQntRH" VAL_BLK 0x80025ACA ValA_Wu16 688. DINH_FIdVerb 0.00 688. FORMAT "%2.0" NUMBER 2 /end CHARACTERISTIC
/begin CHARACTERISTIC DINH_FId.DSQ_DSMInhibitAlways_CA "DINH/Zugeordnete FId für Verriegelungsquelle DSQ_DSMInhibitAlways" VAL_BLK 0x80025ACE ValA_Wu16 688. DINH_FIdVerb 0.00 688. FORMAT "%2.0" NUMBER 6 /end CHARACTERISTIC
/begin CHARACTERISTIC DINH_FId.DSQ_EBxFan_CA "DINH/Zugeordnete FId für Verriegelungsquelle DSQ_EBxFan" VAL_BLK 0x80025ADA ValA_Wu16 688. DINH_FIdVerb 0.00 688. FORMAT "%2.0" NUMBER 2 /end CHARACTERISTIC
/begin CHARACTERISTIC DINH_FId.DSQ_EGRVlvActr_CA "DINH/Zugeordnete FId für Verriegelungsquelle DSQ_EGRVlvActr" VAL_BLK 0x80025ADE ValA_Wu16 688. DINH_FIdVerb 0.00 688. FORMAT "%2.0" NUMBER 3 /end CHARACTERISTIC
/begin CHARACTERISTIC DINH_FId.DSQ_EGRVlvLPActr_CA "DINH/Zugeordnete FId für Verriegelungsquelle DSQ_EGRVlvLPActr" VAL_BLK 0x80025AE4 ValA_Wu16 688. DINH_FIdVerb 0.00 688. FORMAT "%2.0" NUMBER 3 /end CHARACTERISTIC
/begin CHARACTERISTIC DINH_FId.DSQ_EGRVlvLPSens_CA "DINH/Zugeordnete FId für Verriegelungsquelle DSQ_EGRVlvLPSens" VAL_BLK 0x80025AEA ValA_Wu16 688. DINH_FIdVerb 0.00 688. FORMAT "%2.0" NUMBER 2 /end CHARACTERISTIC
/begin CHARACTERISTIC DINH_FId.DSQ_EMDmp_0_CA "DINH/Zugeordnete FId für Verriegelungsquelle DSQ_EMDmp_0" VAL_BLK 0x80025AEE ValA_Wu16 688. DINH_FIdVerb 0.00 688. FORMAT "%2.0" NUMBER 2 /end CHARACTERISTIC
/begin CHARACTERISTIC DINH_FId.DSQ_EMDmp_1_CA "DINH/Zugeordnete FId für Verriegelungsquelle DSQ_EMDmp_1" VAL_BLK 0x80025AF2 ValA_Wu16 688. DINH_FIdVerb 0.00 688. FORMAT "%2.0" NUMBER 2 /end CHARACTERISTIC
/begin CHARACTERISTIC DINH_FId.DSQ_EngPrtFWOsc_CA "DINH/Zugeordnete FId für Verriegelungsquelle DSQ_EngPrtFWOsc" VAL_BLK 0x80025AF6 ValA_Wu16 688. DINH_FIdVerb 0.00 688. FORMAT "%2.0" NUMBER 5 /end CHARACTERISTIC
/begin CHARACTERISTIC DINH_FId.DSQ_EngStAActr_CA "DINH/Zugeordnete FId für Verriegelungsquelle DSQ_EngStAActr" VAL_BLK 0x80025B00 ValA_Wu16 688. DINH_FIdVerb 0.00 688. FORMAT "%2.0" NUMBER 2 /end CHARACTERISTIC
/begin CHARACTERISTIC DINH_FId.DSQ_EnvP_CA "DINH/Zugeordnete FId für Verriegelungsquelle DSQ_EnvP" VAL_BLK 0x80025B04 ValA_Wu16 688. DINH_FIdVerb 0.00 688. FORMAT "%2.0" NUMBER 3 /end CHARACTERISTIC
/begin CHARACTERISTIC DINH_FId.DSQ_EnvT_CA "DINH/Zugeordnete FId für Verriegelungsquelle DSQ_EnvT" VAL_BLK 0x80025B0A ValA_Wu16 688. DINH_FIdVerb 0.00 688. FORMAT "%2.0" NUMBER 1 /end CHARACTERISTIC
/begin CHARACTERISTIC DINH_FId.DSQ_ErrLmpActrMIL_CA "DINH/Zugeordnete FId für Verriegelungsquelle DSQ_ErrLmpActrMIL" VAL_BLK 0x80025B0C ValA_Wu16 688. DINH_FIdVerb 0.00 688. FORMAT "%2.0" NUMBER 2 /end CHARACTERISTIC
/begin CHARACTERISTIC DINH_FId.DSQ_ErrLmpActrSVS_CA "DINH/Zugeordnete FId für Verriegelungsquelle DSQ_ErrLmpActrSVS" VAL_BLK 0x80025B10 ValA_Wu16 688. DINH_FIdVerb 0.00 688. FORMAT "%2.0" NUMBER 2 /end CHARACTERISTIC
/begin CHARACTERISTIC DINH_FId.DSQ_FlFltDsP_CA "DINH/Zugeordnete FId für Verriegelungsquelle DSQ_FlFltDsP" VAL_BLK 0x80025B14 ValA_Wu16 688. DINH_FIdVerb 0.00 688. FORMAT "%2.0" NUMBER 2 /end CHARACTERISTIC
/begin CHARACTERISTIC DINH_FId.DSQ_FlFltHtActr_CA "DINH/Zugeordnete FId für Verriegelungsquelle DSQ_FlFltHtActr" VAL_BLK 0x80025B18 ValA_Wu16 688. DINH_FIdVerb 0.00 688. FORMAT "%2.0" NUMBER 2 /end CHARACTERISTIC
/begin CHARACTERISTIC DINH_FId.DSQ_FlFltUsP_CA "DINH/Zugeordnete FId für Verriegelungsquelle DSQ_FlFltUsP" VAL_BLK 0x80025B1C ValA_Wu16 688. DINH_FIdVerb 0.00 688. FORMAT "%2.0" NUMBER 2 /end CHARACTERISTIC
/begin CHARACTERISTIC DINH_FId.DSQ_FuelLvl_vol_CA "DINH/Zugeordnete FId für Verriegelungsquelle DSQ_FuelLvl_vol" VAL_BLK 0x80025B20 ValA_Wu16 688. DINH_FIdVerb 0.00 688. FORMAT "%2.0" NUMBER 2 /end CHARACTERISTIC
/begin CHARACTERISTIC DINH_FId.DSQ_GbxNPosPls_CA "DINH/Zugeordnete FId für Verriegelungsquelle DSQ_GbxNPosPls" VAL_BLK 0x80025B24 ValA_Wu16 688. DINH_FIdVerb 0.00 688. FORMAT "%2.0" NUMBER 2 /end CHARACTERISTIC
/begin CHARACTERISTIC DINH_FId.DSQ_IVDiast_CA "DINH/Zugeordnete FId für Verriegelungsquelle DSQ_IVDiast" VAL_BLK 0x80025B28 ValA_Wu16 688. DINH_FIdVerb 0.00 688. FORMAT "%2.0" NUMBER 3 /end CHARACTERISTIC
/begin CHARACTERISTIC DINH_FId.DSQ_InjVlvInjCo_CA "DINH/Zugeordnete FId für Verriegelungsquelle DSQ_InjVlvInjCo" VAL_BLK 0x80025B2E ValA_Wu16 688. DINH_FIdVerb 0.00 688. FORMAT "%2.0" NUMBER 10 /end CHARACTERISTIC
/begin CHARACTERISTIC DINH_FId.DSQ_InjVlvPresMin_CA "DINH/Zugeordnete FId für Verriegelungsquelle DSQ_InjVlvPresMin" VAL_BLK 0x80025B42 ValA_Wu16 688. DINH_FIdVerb 0.00 688. FORMAT "%2.0" NUMBER 2 /end CHARACTERISTIC
/begin CHARACTERISTIC DINH_FId.DSQ_LSUO2_CA "DINH/Zugeordnete FId für Verriegelungsquelle DSQ_LSUO2" VAL_BLK 0x80025B46 ValA_Wu16 688. DINH_FIdVerb 0.00 688. FORMAT "%2.0" NUMBER 1 /end CHARACTERISTIC
/begin CHARACTERISTIC DINH_FId.DSQ_Layer_rCtrPwrSpCos_CA "DINH/Zugeordnete FId für Verriegelungsquelle DSQ_Layer_rCtrPwrSpCos" VAL_BLK 0x80025B48 ValA_Wu16 688. DINH_FIdVerb 0.00 688. FORMAT "%2.0" NUMBER 2 /end CHARACTERISTIC
/begin CHARACTERISTIC DINH_FId.DSQ_MRly_CA "DINH/Zugeordnete FId für Verriegelungsquelle DSQ_MRly" VAL_BLK 0x80025B4C ValA_Wu16 688. DINH_FIdVerb 0.00 688. FORMAT "%2.0" NUMBER 2 /end CHARACTERISTIC
/begin CHARACTERISTIC DINH_FId.DSQ_NoCat2DsO2Val_CA "DINH/Zugeordnete FId für Verriegelungsquelle DSQ_NoCat2DsO2Val" VAL_BLK 0x80025B50 ValA_Wu16 688. DINH_FIdVerb 0.00 688. FORMAT "%2.0" NUMBER 2 /end CHARACTERISTIC
/begin CHARACTERISTIC DINH_FId.DSQ_O2ValNSCDs_CA "DINH/Zugeordnete FId für Verriegelungsquelle DSQ_O2ValNSCDs" VAL_BLK 0x80025B54 ValA_Wu16 688. DINH_FIdVerb 0.00 688. FORMAT "%2.0" NUMBER 2 /end CHARACTERISTIC
/begin CHARACTERISTIC DINH_FId.DSQ_O2ValNoCat2Ds_CA "DINH/Zugeordnete FId für Verriegelungsquelle DSQ_O2ValNoCat2Ds" VAL_BLK 0x80025B58 ValA_Wu16 688. DINH_FIdVerb 0.00 688. FORMAT "%2.0" NUMBER 2 /end CHARACTERISTIC
/begin CHARACTERISTIC DINH_FId.DSQ_PIntkVUs_CA "DINH/Zugeordnete FId für Verriegelungsquelle DSQ_PIntkVUs" VAL_BLK 0x80025B5C ValA_Wu16 688. DINH_FIdVerb 0.00 688. FORMAT "%2.0" NUMBER 3 /end CHARACTERISTIC
/begin CHARACTERISTIC DINH_FId.DSQ_PPFltUs_CA "DINH/Zugeordnete FId für Verriegelungsquelle DSQ_PPFltUs" VAL_BLK 0x80025B62 ValA_Wu16 688. DINH_FIdVerb 0.00 688. FORMAT "%2.0" NUMBER 1 /end CHARACTERISTIC
/begin CHARACTERISTIC DINH_FId.DSQ_RailShutOffDblCtl_CA "DINH/Zugeordnete FId für Verriegelungsquelle DSQ_RailShutOffDblCtl" VAL_BLK 0x80025B64 ValA_Wu16 688. DINH_FIdVerb 0.00 688. FORMAT "%2.0" NUMBER 3 /end CHARACTERISTIC
/begin CHARACTERISTIC DINH_FId.DSQ_RailShutOffMeUnCtl_CA "DINH/Zugeordnete FId für Verriegelungsquelle DSQ_RailShutOffMeUnCtl" VAL_BLK 0x80025B6A ValA_Wu16 688. DINH_FIdVerb 0.00 688. FORMAT "%2.0" NUMBER 2 /end CHARACTERISTIC
/begin CHARACTERISTIC DINH_FId.DSQ_StrtActr_CA "DINH/Zugeordnete FId für Verriegelungsquelle DSQ_StrtActr" VAL_BLK 0x80025B6E ValA_Wu16 688. DINH_FIdVerb 0.00 688. FORMAT "%2.0" NUMBER 2 /end CHARACTERISTIC
/begin CHARACTERISTIC DINH_FId.DSQ_TAFS_CA "DINH/Zugeordnete FId für Verriegelungsquelle DSQ_TAFS" VAL_BLK 0x80025B72 ValA_Wu16 688. DINH_FIdVerb 0.00 688. FORMAT "%2.0" NUMBER 1 /end CHARACTERISTIC
/begin CHARACTERISTIC DINH_FId.DSQ_TCACDs_CA "DINH/Zugeordnete FId für Verriegelungsquelle DSQ_TCACDs" VAL_BLK 0x80025B74 ValA_Wu16 688. DINH_FIdVerb 0.00 688. FORMAT "%2.0" NUMBER 2 /end CHARACTERISTIC
/begin CHARACTERISTIC DINH_FId.DSQ_TTrbnUs_CA "DINH/Zugeordnete FId für Verriegelungsquelle DSQ_TTrbnUs" VAL_BLK 0x80025B78 ValA_Wu16 688. DINH_FIdVerb 0.00 688. FORMAT "%2.0" NUMBER 2 /end CHARACTERISTIC
/begin CHARACTERISTIC DINH_FId.DSQ_ThrVlvActr_CA "DINH/Zugeordnete FId für Verriegelungsquelle DSQ_ThrVlvActr" VAL_BLK 0x80025B7C ValA_Wu16 688. DINH_FIdVerb 0.00 688. FORMAT "%2.0" NUMBER 5 /end CHARACTERISTIC
/begin CHARACTERISTIC DINH_FId.DSQ_TrbChActr_CA "DINH/Zugeordnete FId für Verriegelungsquelle DSQ_TrbChActr" VAL_BLK 0x80025B86 ValA_Wu16 688. DINH_FIdVerb 0.00 688. FORMAT "%2.0" NUMBER 3 /end CHARACTERISTIC
/begin CHARACTERISTIC DINH_FId.DSQ_TrbnDsRLamO2_CA "DINH/Zugeordnete FId für Verriegelungsquelle DSQ_TrbnDsRLamO2" VAL_BLK 0x80025B8C ValA_Wu16 688. DINH_FIdVerb 0.00 688. FORMAT "%2.0" NUMBER 1 /end CHARACTERISTIC
/begin CHARACTERISTIC DINH_FId.DSQ_UCatUsT_CA "DINH/Zugeordnete FId für Verriegelungsquelle DSQ_UCatUsT" VAL_BLK 0x80025B8E ValA_Wu16 688. DINH_FIdVerb 0.00 688. FORMAT "%2.0" NUMBER 2 /end CHARACTERISTIC
/begin CHARACTERISTIC DINH_FId.DSQ_UDosVlvActr_CA "DINH/Zugeordnete FId für Verriegelungsquelle DSQ_UDosVlvActr" VAL_BLK 0x80025B92 ValA_Wu16 688. DINH_FIdVerb 0.00 688. FORMAT "%2.0" NUMBER 2 /end CHARACTERISTIC
/begin CHARACTERISTIC DINH_FId.DSQ_UHtrPL_CA "DINH/Zugeordnete FId für Verriegelungsquelle DSQ_UHtrPL" VAL_BLK 0x80025B96 ValA_Wu16 688. DINH_FIdVerb 0.00 688. FORMAT "%2.0" NUMBER 2 /end CHARACTERISTIC
/begin CHARACTERISTIC DINH_FId.DSQ_UHtrPLDia_CA "DINH/Zugeordnete FId für Verriegelungsquelle DSQ_UHtrPLDia" VAL_BLK 0x80025B9A ValA_Wu16 688. DINH_FIdVerb 0.00 688. FORMAT "%2.0" NUMBER 2 /end CHARACTERISTIC
/begin CHARACTERISTIC DINH_FId.DSQ_UHtrTnk_CA "DINH/Zugeordnete FId für Verriegelungsquelle DSQ_UHtrTnk" VAL_BLK 0x80025B9E ValA_Wu16 688. DINH_FIdVerb 0.00 688. FORMAT "%2.0" NUMBER 2 /end CHARACTERISTIC
/begin CHARACTERISTIC DINH_FId.DSQ_UHtrTnkDia_CA "DINH/Zugeordnete FId für Verriegelungsquelle DSQ_UHtrTnkDia" VAL_BLK 0x80025BA2 ValA_Wu16 688. DINH_FIdVerb 0.00 688. FORMAT "%2.0" NUMBER 2 /end CHARACTERISTIC
/begin CHARACTERISTIC DINH_FId.DSQ_UPmpMotActr_CA "DINH/Zugeordnete FId für Verriegelungsquelle DSQ_UPmpMotActr" VAL_BLK 0x80025BA6 ValA_Wu16 688. DINH_FIdVerb 0.00 688. FORMAT "%2.0" NUMBER 2 /end CHARACTERISTIC
/begin CHARACTERISTIC DINH_FId.DSQ_UPmpP_CA "DINH/Zugeordnete FId für Verriegelungsquelle DSQ_UPmpP" VAL_BLK 0x80025BAA ValA_Wu16 688. DINH_FIdVerb 0.00 688. FORMAT "%2.0" NUMBER 3 /end CHARACTERISTIC
/begin CHARACTERISTIC DINH_FId.DSQ_URevVlv_CA "DINH/Zugeordnete FId für Verriegelungsquelle DSQ_URevVlv" VAL_BLK 0x80025BB0 ValA_Wu16 688. DINH_FIdVerb 0.00 688. FORMAT "%2.0" NUMBER 2 /end CHARACTERISTIC
/begin CHARACTERISTIC DINH_FId.DSQ_UTnkLvl_CA "DINH/Zugeordnete FId für Verriegelungsquelle DSQ_UTnkLvl" VAL_BLK 0x80025BB4 ValA_Wu16 688. DINH_FIdVerb 0.00 688. FORMAT "%2.0" NUMBER 2 /end CHARACTERISTIC
/begin CHARACTERISTIC DINH_FId.DSQ_UTnkT_CA "DINH/Zugeordnete FId für Verriegelungsquelle DSQ_UTnkT" VAL_BLK 0x80025BB8 ValA_Wu16 688. DINH_FIdVerb 0.00 688. FORMAT "%2.0" NUMBER 2 /end CHARACTERISTIC
/begin CHARACTERISTIC DINH_FId.DSQ_VSwVlvActr_CA "DINH/Zugeordnete FId für Verriegelungsquelle DSQ_VSwVlvActr" VAL_BLK 0x80025BBC ValA_Wu16 688. DINH_FIdVerb 0.00 688. FORMAT "%2.0" NUMBER 2 /end CHARACTERISTIC
/begin CHARACTERISTIC DINH_FId.DSQ_stAPP_CA "DINH/Zugeordnete FId für Verriegelungsquelle DSQ_stAPP" VAL_BLK 0x80025BC0 ValA_Wu16 688. DINH_FIdVerb 0.00 688. FORMAT "%2.0" NUMBER 6 /end CHARACTERISTIC
/begin CHARACTERISTIC DINH_FId.DSQ_stAPP1_CA "DINH/Zugeordnete FId für Verriegelungsquelle DSQ_stAPP1" VAL_BLK 0x80025BCC ValA_Wu16 688. DINH_FIdVerb 0.00 688. FORMAT "%2.0" NUMBER 6 /end CHARACTERISTIC
/begin CHARACTERISTIC DINH_FId.DSQ_stAPP2_CA "DINH/Zugeordnete FId für Verriegelungsquelle DSQ_stAPP2" VAL_BLK 0x80025BD8 ValA_Wu16 688. DINH_FIdVerb 0.00 688. FORMAT "%2.0" NUMBER 7 /end CHARACTERISTIC
/begin CHARACTERISTIC DINH_FId.DSQ_stLSUSrvTstDem_CA "DINH/Zugeordnete FId für Verriegelungsquelle DSQ_stLSUSrvTstDem" VAL_BLK 0x80025BE6 ValA_Wu16 688. DINH_FIdVerb 0.00 688. FORMAT "%2.0" NUMBER 1 /end CHARACTERISTIC
/begin CHARACTERISTIC DINH_FId.DSQ_stSrvOpLSUAdap_CA "DINH/Zugeordnete FId für Verriegelungsquelle DSQ_stSrvOpLSUAdap" VAL_BLK 0x80025BE8 ValA_Wu16 688. DINH_FIdVerb 0.00 688. FORMAT "%2.0" NUMBER 1 /end CHARACTERISTIC
/begin CHARACTERISTIC DINH_Lim.DFC_ACCIPlausDrvAst_CA "DINH/Zugeordnete Verriegelungslimits für Verriegelungsquelle DFC_ACCIPlausDrvAst" VAL_BLK 0x80026DDA ValA_Wu16 8192.00000000 DINH_LimDFCVerb 12079.0000000 20271.0000000 FORMAT "%13.7" NUMBER 3 /end CHARACTERISTIC
/begin CHARACTERISTIC DINH_Lim.DFC_ACCIPlausTrqDes_CA "DINH/Zugeordnete Verriegelungslimits für Verriegelungsquelle DFC_ACCIPlausTrqDes" VAL_BLK 0x80026DE0 ValA_Wu16 8192.00000000 DINH_LimDFCVerb 12079.0000000 20271.0000000 FORMAT "%13.7" NUMBER 3 /end CHARACTERISTIC
/begin CHARACTERISTIC DINH_Lim.DFC_AirCtlGovDvtEOMMax_CA "DINH/Zugeordnete Verriegelungslimits für Verriegelungsquelle DFC_AirCtlGovDvtEOMMax" VAL_BLK 0x80026DE6 ValA_Wu16 8192.00000000 DINH_LimDFCVerb 12079.0000000 20271.0000000 FORMAT "%13.7" NUMBER 2 /end CHARACTERISTIC
/begin CHARACTERISTIC DINH_Lim.DFC_AirCtlGovDvtEOMMin_CA "DINH/Zugeordnete Verriegelungslimits für Verriegelungsquelle DFC_AirCtlGovDvtEOMMin" VAL_BLK 0x80026DEA ValA_Wu16 8192.00000000 DINH_LimDFCVerb 12079.0000000 20271.0000000 FORMAT "%13.7" NUMBER 2 /end CHARACTERISTIC
/begin CHARACTERISTIC DINH_Lim.DFC_AirCtlGovDvtMax_CA "DINH/Zugeordnete Verriegelungslimits für Verriegelungsquelle DFC_AirCtlGovDvtMax" VAL_BLK 0x80026DEE ValA_Wu16 8192.00000000 DINH_LimDFCVerb 12079.0000000 20271.0000000 FORMAT "%13.7" NUMBER 7 /end CHARACTERISTIC
/begin CHARACTERISTIC DINH_Lim.DFC_AirCtlGovDvtMin_CA "DINH/Zugeordnete Verriegelungslimits für Verriegelungsquelle DFC_AirCtlGovDvtMin" VAL_BLK 0x80026DFC ValA_Wu16 8192.00000000 DINH_LimDFCVerb 12079.0000000 20271.0000000 FORMAT "%13.7" NUMBER 3 /end CHARACTERISTIC
/begin CHARACTERISTIC DINH_Lim.DFC_AirCtlGovLPDvtMax_CA "DINH/Zugeordnete Verriegelungslimits für Verriegelungsquelle DFC_AirCtlGovLPDvtMax" VAL_BLK 0x80026E02 ValA_Wu16 8192.00000000 DINH_LimDFCVerb 12079.0000000 20271.0000000 FORMAT "%13.7" NUMBER 3 /end CHARACTERISTIC
/begin CHARACTERISTIC DINH_Lim.DFC_AirCtlGovLPDvtMin_CA "DINH/Zugeordnete Verriegelungslimits für Verriegelungsquelle DFC_AirCtlGovLPDvtMin" VAL_BLK 0x80026E08 ValA_Wu16 8192.00000000 DINH_LimDFCVerb 12079.0000000 20271.0000000 FORMAT "%13.7" NUMBER 3 /end CHARACTERISTIC
/begin CHARACTERISTIC DINH_Lim.DFC_AltIOComErr_CA "DINH/Zugeordnete Verriegelungslimits für Verriegelungsquelle DFC_AltIOComErr" VAL_BLK 0x80026E0E ValA_Wu16 8192.00000000 DINH_LimDFCVerb 12079.0000000 20271.0000000 FORMAT "%13.7" NUMBER 2 /end CHARACTERISTIC
/begin CHARACTERISTIC DINH_Lim.DFC_AltIOComNpl_CA "DINH/Zugeordnete Verriegelungslimits für Verriegelungsquelle DFC_AltIOComNpl" VAL_BLK 0x80026E12 ValA_Wu16 8192.00000000 DINH_LimDFCVerb 12079.0000000 20271.0000000 FORMAT "%13.7" NUMBER 2 /end CHARACTERISTIC
/begin CHARACTERISTIC DINH_Lim.DFC_BusDiagBusOffFlexRay_CA "DINH/" VAL_BLK 0x80026E16 ValA_Wu16 8192.00000000 DINH_LimDFCVerb 12079.0000000 20271.0000000 FORMAT "%13.7" NUMBER 2 /end CHARACTERISTIC
/begin CHARACTERISTIC DINH_Lim.DFC_BusDiagBusOffNodeA_CA "DINH/Zugeordnete Verriegelungslimits für Verriegelungsquelle DFC_BusDiagBusOffNodeA" VAL_BLK 0x80026E1A ValA_Wu16 8192.00000000 DINH_LimDFCVerb 12079.0000000 20271.0000000 FORMAT "%13.7" NUMBER 6 /end CHARACTERISTIC
/begin CHARACTERISTIC DINH_Lim.DFC_BusDiagBusOffNodeB_CA "DINH/Zugeordnete Verriegelungslimits für Verriegelungsquelle DFC_BusDiagBusOffNodeB" VAL_BLK 0x80026E26 ValA_Wu16 8192.00000000 DINH_LimDFCVerb 12079.0000000 20271.0000000 FORMAT "%13.7" NUMBER 4 /end CHARACTERISTIC
/begin CHARACTERISTIC DINH_Lim.DFC_BusDiagBusOffNodeC_CA "DINH/Zugeordnete Verriegelungslimits für Verriegelungsquelle DFC_BusDiagBusOffNodeC" VAL_BLK 0x80026E2E ValA_Wu16 8192.00000000 DINH_LimDFCVerb 12079.0000000 20271.0000000 FORMAT "%13.7" NUMBER 2 /end CHARACTERISTIC
/begin CHARACTERISTIC DINH_Lim.DFC_BusDiagHwFlexRay_CA "DINH/" VAL_BLK 0x80026E32 ValA_Wu16 8192.00000000 DINH_LimDFCVerb 12079.0000000 20271.0000000 FORMAT "%13.7" NUMBER 2 /end CHARACTERISTIC
/begin CHARACTERISTIC DINH_Lim.DFC_Cj945SpiCom1_CA "DINH/Zugeordnete Verriegelungslimits für Verriegelungsquelle DFC_Cj945SpiCom1" VAL_BLK 0x80026E36 ValA_Wu16 8192.00000000 DINH_LimDFCVerb 12079.0000000 20271.0000000 FORMAT "%13.7" NUMBER 3 /end CHARACTERISTIC
/begin CHARACTERISTIC DINH_Lim.DFC_ComACDemandSig_FA_CA "DINH/Zugeordnete Verriegelungslimits für Verriegelungsquelle DFC_ComACDemandSig_FA" VAL_BLK 0x80026E3C ValA_Wu16 8192.00000000 DINH_LimDFCVerb 12079.0000000 20271.0000000 FORMAT "%13.7" NUMBER 2 /end CHARACTERISTIC
/begin CHARACTERISTIC DINH_Lim.DFC_ComACDemandTo_FA_CA "DINH/Zugeordnete Verriegelungslimits für Verriegelungsquelle DFC_ComACDemandTo_FA" VAL_BLK 0x80026E40 ValA_Wu16 8192.00000000 DINH_LimDFCVerb 12079.0000000 20271.0000000 FORMAT "%13.7" NUMBER 2 /end CHARACTERISTIC
/begin CHARACTERISTIC DINH_Lim.DFC_ComATempSig_FA_CA "DINH/Zugeordnete Verriegelungslimits für Verriegelungsquelle DFC_ComATempSig_FA" VAL_BLK 0x80026E44 ValA_Wu16 8192.00000000 DINH_LimDFCVerb 12079.0000000 20271.0000000 FORMAT "%13.7" NUMBER 2 /end CHARACTERISTIC
/begin CHARACTERISTIC DINH_Lim.DFC_ComATempTo_FA_CA "DINH/Zugeordnete Verriegelungslimits für Verriegelungsquelle DFC_ComATempTo_FA" VAL_BLK 0x80026E48 ValA_Wu16 8192.00000000 DINH_LimDFCVerb 12079.0000000 20271.0000000 FORMAT "%13.7" NUMBER 2 /end CHARACTERISTIC
/begin CHARACTERISTIC DINH_Lim.DFC_ComATempTo_FX_CA "DINH/Zugeordnete Verriegelungslimits für Verriegelungsquelle DFC_ComATempTo_FX" VAL_BLK 0x80026E4C ValA_Wu16 8192.00000000 DINH_LimDFCVerb 12079.0000000 20271.0000000 FORMAT "%13.7" NUMBER 2 /end CHARACTERISTIC
/begin CHARACTERISTIC DINH_Lim.DFC_ComBrkTrqSumChk_FX_CA "DINH/Zugeordnete Verriegelungslimits für Verriegelungsquelle DFC_ComBrkTrqSumChk_FX" VAL_BLK 0x80026E50 ValA_Wu16 8192.00000000 DINH_LimDFCVerb 12079.0000000 20271.0000000 FORMAT "%13.7" NUMBER 2 /end CHARACTERISTIC
/begin CHARACTERISTIC DINH_Lim.DFC_ComBrkTrqSumCtr_FX_CA "DINH/Zugeordnete Verriegelungslimits für Verriegelungsquelle DFC_ComBrkTrqSumCtr_FX" VAL_BLK 0x80026E54 ValA_Wu16 8192.00000000 DINH_LimDFCVerb 12079.0000000 20271.0000000 FORMAT "%13.7" NUMBER 2 /end CHARACTERISTIC
/begin CHARACTERISTIC DINH_Lim.DFC_ComBrkTrqSumTo_FX_CA "DINH/Zugeordnete Verriegelungslimits für Verriegelungsquelle DFC_ComBrkTrqSumTo_FX" VAL_BLK 0x80026E58 ValA_Wu16 8192.00000000 DINH_LimDFCVerb 12079.0000000 20271.0000000 FORMAT "%13.7" NUMBER 2 /end CHARACTERISTIC
/begin CHARACTERISTIC DINH_Lim.DFC_ComBtnDrvDynChk_FX_CA "DINH/Zugeordnete Verriegelungslimits für Verriegelungsquelle DFC_ComBtnDrvDynChk_FX" VAL_BLK 0x80026E5C ValA_Wu16 8192.00000000 DINH_LimDFCVerb 12079.0000000 20271.0000000 FORMAT "%13.7" NUMBER 2 /end CHARACTERISTIC
/begin CHARACTERISTIC DINH_Lim.DFC_ComBtnDrvDynCtr_FX_CA "DINH/Zugeordnete Verriegelungslimits für Verriegelungsquelle DFC_ComBtnDrvDynCtr_FX" VAL_BLK 0x80026E60 ValA_Wu16 8192.00000000 DINH_LimDFCVerb 12079.0000000 20271.0000000 FORMAT "%13.7" NUMBER 2 /end CHARACTERISTIC
/begin CHARACTERISTIC DINH_Lim.DFC_ComBtnDrvDynTo_FX_CA "DINH/Zugeordnete Verriegelungslimits für Verriegelungsquelle DFC_ComBtnDrvDynTo_FX" VAL_BLK 0x80026E64 ValA_Wu16 8192.00000000 DINH_LimDFCVerb 12079.0000000 20271.0000000 FORMAT "%13.7" NUMBER 2 /end CHARACTERISTIC
/begin CHARACTERISTIC DINH_Lim.DFC_ComButtonMSASig_CA "DINH/Zugeordnete Verriegelungslimits für Verriegelungsquelle DFC_ComButtonMSASig" VAL_BLK 0x80026E68 ValA_Wu16 8192.00000000 DINH_LimDFCVerb 12079.0000000 20271.0000000 FORMAT "%13.7" NUMBER 2 /end CHARACTERISTIC
/begin CHARACTERISTIC DINH_Lim.DFC_ComButtonMSATo_CA "DINH/Zugeordnete Verriegelungslimits für Verriegelungsquelle DFC_ComButtonMSATo" VAL_BLK 0x80026E6C ValA_Wu16 8192.00000000 DINH_LimDFCVerb 12079.0000000 20271.0000000 FORMAT "%13.7" NUMBER 2 /end CHARACTERISTIC
/begin CHARACTERISTIC DINH_Lim.DFC_ComCodierungPwrmngSig_CA "DINH/Zugeordnete Verriegelungslimits für Verriegelungsquelle DFC_ComCodierungPwrmngSig" VAL_BLK 0x80026E70 ValA_Wu16 8192.00000000 DINH_LimDFCVerb 12079.0000000 20271.0000000 FORMAT "%13.7" NUMBER 2 /end CHARACTERISTIC
/begin CHARACTERISTIC DINH_Lim.DFC_ComCodierungPwrmngSig_FA_CA "DINH/Zugeordnete Verriegelungslimits für Verriegelungsquelle DFC_ComCodierungPwrmngSig_FA" VAL_BLK 0x80026E74 ValA_Wu16 8192.00000000 DINH_LimDFCVerb 12079.0000000 20271.0000000 FORMAT "%13.7" NUMBER 2 /end CHARACTERISTIC
/begin CHARACTERISTIC DINH_Lim.DFC_ComCrCtlLvrChk_CA "DINH/Zugeordnete Verriegelungslimits für Verriegelungsquelle DFC_ComCrCtlLvrChk" VAL_BLK 0x80026E78 ValA_Wu16 8192.00000000 DINH_LimDFCVerb 12079.0000000 20271.0000000 FORMAT "%13.7" NUMBER 2 /end CHARACTERISTIC
/begin CHARACTERISTIC DINH_Lim.DFC_ComCrCtlLvrCtr_CA "DINH/Zugeordnete Verriegelungslimits für Verriegelungsquelle DFC_ComCrCtlLvrCtr" VAL_BLK 0x80026E7C ValA_Wu16 8192.00000000 DINH_LimDFCVerb 12079.0000000 20271.0000000 FORMAT "%13.7" NUMBER 2 /end CHARACTERISTIC
/begin CHARACTERISTIC DINH_Lim.DFC_ComCrCtlLvrSig_CA "DINH/Zugeordnete Verriegelungslimits für Verriegelungsquelle DFC_ComCrCtlLvrSig" VAL_BLK 0x80026E80 ValA_Wu16 8192.00000000 DINH_LimDFCVerb 12079.0000000 20271.0000000 FORMAT "%13.7" NUMBER 2 /end CHARACTERISTIC
/begin CHARACTERISTIC DINH_Lim.DFC_ComCrCtlLvrTo_CA "DINH/Zugeordnete Verriegelungslimits für Verriegelungsquelle DFC_ComCrCtlLvrTo" VAL_BLK 0x80026E84 ValA_Wu16 8192.00000000 DINH_LimDFCVerb 12079.0000000 20271.0000000 FORMAT "%13.7" NUMBER 2 /end CHARACTERISTIC
/begin CHARACTERISTIC DINH_Lim.DFC_ComCtrCrshSwoEkpSig_FA_CA "DINH/Zugeordnete Verriegelungslimits für Verriegelungsquelle DFC_ComCtrCrshSwoEkpSig_FA" VAL_BLK 0x80026E88 ValA_Wu16 8192.00000000 DINH_LimDFCVerb 12079.0000000 20271.0000000 FORMAT "%13.7" NUMBER 2 /end CHARACTERISTIC
/begin CHARACTERISTIC DINH_Lim.DFC_ComCtrCrshSwoEkpTo_FA_CA "DINH/Zugeordnete Verriegelungslimits für Verriegelungsquelle DFC_ComCtrCrshSwoEkpTo_FA" VAL_BLK 0x80026E8C ValA_Wu16 8192.00000000 DINH_LimDFCVerb 12079.0000000 20271.0000000 FORMAT "%13.7" NUMBER 2 /end CHARACTERISTIC
/begin CHARACTERISTIC DINH_Lim.DFC_ComCtrSecInt_CA "DINH/Zugeordnete Verriegelungslimits für Verriegelungsquelle DFC_ComCtrSecInt" VAL_BLK 0x80026E90 ValA_Wu16 8192.00000000 DINH_LimDFCVerb 12079.0000000 20271.0000000 FORMAT "%13.7" NUMBER 2 /end CHARACTERISTIC
/begin CHARACTERISTIC DINH_Lim.DFC_ComDiaOBDGbxSig_A_CA "DINH/Zugeordnete Verriegelungslimits für Verriegelungsquelle DFC_ComDiaOBDGbxSig_A" VAL_BLK 0x80026E94 ValA_Wu16 8192.00000000 DINH_LimDFCVerb 12079.0000000 20271.0000000 FORMAT "%13.7" NUMBER 2 /end CHARACTERISTIC
/begin CHARACTERISTIC DINH_Lim.DFC_ComDiaOBDGbxTo_A_CA "DINH/Zugeordnete Verriegelungslimits für Verriegelungsquelle DFC_ComDiaOBDGbxTo_A" VAL_BLK 0x80026E98 ValA_Wu16 8192.00000000 DINH_LimDFCVerb 12079.0000000 20271.0000000 FORMAT "%13.7" NUMBER 2 /end CHARACTERISTIC
/begin CHARACTERISTIC DINH_Lim.DFC_ComFahrzeugtypSig_CA "DINH/Zugeordnete Verriegelungslimits für Verriegelungsquelle DFC_ComFahrzeugtypSig" VAL_BLK 0x80026E9C ValA_Wu16 8192.00000000 DINH_LimDFCVerb 12079.0000000 20271.0000000 FORMAT "%13.7" NUMBER 2 /end CHARACTERISTIC
/begin CHARACTERISTIC DINH_Lim.DFC_ComFahrzeugtypSig_FA_CA "DINH/Zugeordnete Verriegelungslimits für Verriegelungsquelle DFC_ComFahrzeugtypSig_FA" VAL_BLK 0x80026EA0 ValA_Wu16 8192.00000000 DINH_LimDFCVerb 12079.0000000 20271.0000000 FORMAT "%13.7" NUMBER 2 /end CHARACTERISTIC
/begin CHARACTERISTIC DINH_Lim.DFC_ComFllupGpwsupSig_FA_CA "DINH/Zugeordnete Verriegelungslimits für Verriegelungsquelle DFC_ComFllupGpwsupSig_FA" VAL_BLK 0x80026EA4 ValA_Wu16 8192.00000000 DINH_LimDFCVerb 12079.0000000 20271.0000000 FORMAT "%13.7" NUMBER 2 /end CHARACTERISTIC
/begin CHARACTERISTIC DINH_Lim.DFC_ComFllupGpwsupTo_FA_CA "DINH/Zugeordnete Verriegelungslimits für Verriegelungsquelle DFC_ComFllupGpwsupTo_FA" VAL_BLK 0x80026EA8 ValA_Wu16 8192.00000000 DINH_LimDFCVerb 12079.0000000 20271.0000000 FORMAT "%13.7" NUMBER 2 /end CHARACTERISTIC
/begin CHARACTERISTIC DINH_Lim.DFC_ComGbxDataChk_A_CA "DINH/Zugeordnete Verriegelungslimits für Verriegelungsquelle DFC_ComGbxDataChk_A" VAL_BLK 0x80026EAC ValA_Wu16 8192.00000000 DINH_LimDFCVerb 12079.0000000 20271.0000000 FORMAT "%13.7" NUMBER 2 /end CHARACTERISTIC
/begin CHARACTERISTIC DINH_Lim.DFC_ComGbxDataChk_FA_CA "DINH/Zugeordnete Verriegelungslimits für Verriegelungsquelle DFC_ComGbxDataChk_FA" VAL_BLK 0x80026EB0 ValA_Wu16 8192.00000000 DINH_LimDFCVerb 12079.0000000 20271.0000000 FORMAT "%13.7" NUMBER 2 /end CHARACTERISTIC
/begin CHARACTERISTIC DINH_Lim.DFC_ComGbxDataCtr_A_CA "DINH/Zugeordnete Verriegelungslimits für Verriegelungsquelle DFC_ComGbxDataCtr_A" VAL_BLK 0x80026EB4 ValA_Wu16 8192.00000000 DINH_LimDFCVerb 12079.0000000 20271.0000000 FORMAT "%13.7" NUMBER 2 /end CHARACTERISTIC
/begin CHARACTERISTIC DINH_Lim.DFC_ComGbxDataCtr_FA_CA "DINH/Zugeordnete Verriegelungslimits für Verriegelungsquelle DFC_ComGbxDataCtr_FA" VAL_BLK 0x80026EB8 ValA_Wu16 8192.00000000 DINH_LimDFCVerb 12079.0000000 20271.0000000 FORMAT "%13.7" NUMBER 2 /end CHARACTERISTIC
/begin CHARACTERISTIC DINH_Lim.DFC_ComGbxDataSig_A_CA "DINH/Zugeordnete Verriegelungslimits für Verriegelungsquelle DFC_ComGbxDataSig_A" VAL_BLK 0x80026EBC ValA_Wu16 8192.00000000 DINH_LimDFCVerb 12079.0000000 20271.0000000 FORMAT "%13.7" NUMBER 2 /end CHARACTERISTIC
/begin CHARACTERISTIC DINH_Lim.DFC_ComGbxDataSig_FA_CA "DINH/Zugeordnete Verriegelungslimits für Verriegelungsquelle DFC_ComGbxDataSig_FA" VAL_BLK 0x80026EC0 ValA_Wu16 8192.00000000 DINH_LimDFCVerb 12079.0000000 20271.0000000 FORMAT "%13.7" NUMBER 2 /end CHARACTERISTIC
/begin CHARACTERISTIC DINH_Lim.DFC_ComGbxDataTo_A_CA "DINH/Zugeordnete Verriegelungslimits für Verriegelungsquelle DFC_ComGbxDataTo_A" VAL_BLK 0x80026EC4 ValA_Wu16 8192.00000000 DINH_LimDFCVerb 12079.0000000 20271.0000000 FORMAT "%13.7" NUMBER 2 /end CHARACTERISTIC
/begin CHARACTERISTIC DINH_Lim.DFC_ComGbxDataTo_FA_CA "DINH/Zugeordnete Verriegelungslimits für Verriegelungsquelle DFC_ComGbxDataTo_FA" VAL_BLK 0x80026EC8 ValA_Wu16 8192.00000000 DINH_LimDFCVerb 12079.0000000 20271.0000000 FORMAT "%13.7" NUMBER 2 /end CHARACTERISTIC
/begin FUNCTION DINH ""
 /begin DEF_CHARACTERISTIC DINH_FId.DFC_NSCDsLamPlausMax_CA DINH_FId.DFC_NSCDsLamPlausMin_CA DINH_FId.DFC_NSCDsNOxSRCMax_CA DINH_FId.DFC_NSCDsNOxSRCMin_CA DINH_FId.DFC_NSCDsOpCir_CA DINH_FId.DFC_NSCDsShCir_CA DINH_FId.DFC_NoCat2DsCmpChk_CA DINH_FId.DFC_NoCat2DsLamBinSRCMax_CA DINH_FId.DFC_NoCat2DsLamBinSRCMin_CA DINH_FId.DFC_NoCat2DsLamLinSRCMax_CA DINH_FId.DFC_NoCat2DsLamLinSRCMin_CA DINH_FId.DFC_NoCat2DsLamPlausMax_CA DINH_FId.DFC_NoCat2DsLamPlausMin_CA DINH_FId.DFC_NoCat2DsNOxSRCMax_CA DINH_FId.DFC_NoCat2DsNOxSRCMin_CA DINH_FId.DFC_NoCat2DsOpCir_CA DINH_FId.DFC_NoCat2DsShCir_CA DINH_FId.DFC_NplDynPPFltDiff_CA DINH_FId.DFC_NplHsChngPPFltDiff_CA DINH_FId.DFC_NplHsLnPPFltDiff_CA DINH_FId.DFC_NplTOxiCatUs_CA DINH_FId.DFC_NplTPFltUs_CA DINH_FId.DFC_NplTTrbnUs_CA DINH_FId.DFC_OilPSwmpSRCMax_CA DINH_FId.DFC_OilPSwmpSRCMin_CA DINH_FId.DFC_PCVSCG_CA DINH_FId.DFC_PFltCharPDiffMin_CA DINH_FId.DFC_PFltDstrMin_CA DINH_FId.DFC_PFltEngPrt_CA DINH_FId.DFC_PFltRgnPerm_CA DINH_FId.DFC_PFltSRCMaxFlwRstn_CA DINH_FId.DFC_PFltSRCMinFlwRstn_CA DINH_FId.DFC_PFltSotMsDvtMax_CA DINH_FId.DFC_PFltSotMsDvtMin_CA DINH_FId.DFC_PFltSotMsMax_CA DINH_FId.DFC_PIntkVUsSRCMax_CA DINH_FId.DFC_PIntkVUsSRCMin_CA DINH_FId.DFC_SRCHighAPP1_CA DINH_FId.DFC_SRCHighAPP2_CA DINH_FId.DFC_SRCLowAPP1_CA DINH_FId.DFC_SRCLowAPP2_CA DINH_FId.DFC_SRCMaxPPFltDiff_CA DINH_FId.DFC_SRCMaxPPFltUs_CA DINH_FId.DFC_SRCMaxTECU_CA DINH_FId.DFC_SRCMaxTOxiCatUs_CA DINH_FId.DFC_SRCMaxTPFltUs_CA DINH_FId.DFC_SRCMaxTTrbnUs_CA DINH_FId.DFC_SRCMaxUCatUsT_CA DINH_FId.DFC_SRCMaxUPmpP_CA DINH_FId.DFC_SRCMinPPFltDiff_CA DINH_FId.DFC_SRCMinPPFltUs_CA DINH_FId.DFC_SRCMinTECU_CA DINH_FId.DFC_SRCMinTOxiCatUs_CA DINH_FId.DFC_SRCMinTPFltUs_CA DINH_FId.DFC_SRCMinTTrbnUs_CA DINH_FId.DFC_SRCMinUCatUsT_CA DINH_FId.DFC_SRCMinUPmpP_CA DINH_FId.DFC_SigUCatUsT_CA DINH_FId.DFC_SigUPmpP_CA DINH_FId.DFC_SyncAPP_CA DINH_FId.DFC_T15Npl_CA DINH_FId.DFC_TAFSDtyCycHi_CA DINH_FId.DFC_TAFSDtyCycLo_CA DINH_FId.DFC_TAFSPerHi_CA DINH_FId.DFC_TAFSPerLo_CA DINH_FId.DFC_TCACDsSRCMax_CA DINH_FId.DFC_TCACDsSRCMin_CA DINH_FId.DFC_ThrVlvSRCMax_CA DINH_FId.DFC_ThrVlvSRCMin_CA DINH_FId.DFC_TrbChLPOL_CA DINH_FId.DFC_TrbChLPSCB_CA DINH_FId.DFC_TrbChLPSCG_CA DINH_FId.DFC_UHtrPLOL_CA DINH_FId.DFC_UHtrPLSCB_CA DINH_FId.DFC_UHtrPLSCG_CA DINH_FId.DFC_UHtrPLSRCMaxDia_CA DINH_FId.DFC_UHtrPLSRCMinDia_CA DINH_FId.DFC_UHtrTnkOL_CA DINH_FId.DFC_UHtrTnkSCB_CA DINH_FId.DFC_UHtrTnkSCG_CA DINH_FId.DFC_UHtrTnkSRCMaxDia_CA DINH_FId.DFC_UHtrTnkSRCMinDia_CA DINH_FId.DFC_URevVlvOL_CA DINH_FId.DFC_URevVlvSCB_CA DINH_FId.DFC_URevVlvSCG_CA DINH_FId.DFC_UTnkTSRCMax_CA DINH_FId.DFC_UTnkTSRCMin_CA DINH_FId.DFC_UTnkTSig_CA DINH_FId.DFC_VSwVlvGovDvtMax_CA DINH_FId.DFC_VSwVlvGovDvtMin_CA DINH_FId.DFC_VSwVlvHBrgOpnLd_CA DINH_FId.DFC_VSwVlvHBrgOvrCurr_CA DINH_FId.DFC_VSwVlvHBrgOvrTemp_CA DINH_FId.DFC_VSwVlvHBrgShCirBatt1_CA DINH_FId.DFC_VSwVlvHBrgShCirBatt2_CA DINH_FId.DFC_VSwVlvHBrgShCirGnd1_CA DINH_FId.DFC_VSwVlvHBrgShCirGnd2_CA DINH_FId.DFC_VSwVlvHBrgShCirOvrLd_CA DINH_FId.DFC_VSwVlvHBrgTempOvrCurr_CA DINH_FId.DFC_VSwVlvHBrgUndrVltg_CA DINH_FId.DFC_VSwVlvOL_CA DINH_FId.DFC_VSwVlvSCB_CA DINH_FId.DFC_VSwVlvSCG_CA DINH_FId.DFC_VSwVlvSRCMax_CA DINH_FId.DFC_VSwVlvSRCMin_CA DINH_FId.DFC_ClthNpl_CA DINH_FId.DFC_ETClbETMax_0_CA DINH_FId.DFC_ETClbETMax_1_CA DINH_FId.DFC_ETClbETMax_2_CA DINH_FId.DFC_ETClbETMax_3_CA DINH_FId.DFC_ETClbETMax_4_CA DINH_FId.DFC_ETClbETMax_5_CA DINH_FId.DFC_ETClbETMin_0_CA DINH_FId.DFC_ETClbETMin_1_CA DINH_FId.DFC_ETClbETMin_2_CA DINH_FId.DFC_ETClbETMin_3_CA DINH_FId.DFC_ETClbETMin_4_CA DINH_FId.DFC_ETClbETMin_5_CA DINH_FId.DFC_IVActrEnrgMax_0_CA DINH_FId.DFC_IVActrEnrgMax_1_CA DINH_FId.DFC_IVActrEnrgMax_2_CA DINH_FId.DFC_IVActrEnrgMax_3_CA DINH_FId.DFC_IVActrEnrgMax_4_CA DINH_FId.DFC_IVActrEnrgMax_5_CA DINH_FId.DFC_IVActrEnrgMax_6_CA DINH_FId.DFC_IVActrEnrgMax_7_CA DINH_FId.DFC_IVActrEnrgMin_0_CA DINH_FId.DFC_IVActrEnrgMin_1_CA DINH_FId.DFC_IVActrEnrgMin_2_CA DINH_FId.DFC_IVActrEnrgMin_3_CA DINH_FId.DFC_IVActrEnrgMin_4_CA DINH_FId.DFC_IVActrEnrgMin_5_CA DINH_FId.DFC_IVActrEnrgMin_6_CA DINH_FId.DFC_IVActrEnrgMin_7_CA DINH_FId.DFC_IVActrEnrgPlaus_0_CA DINH_FId.DFC_IVActrEnrgPlaus_1_CA DINH_FId.DFC_IVActrEnrgPlaus_2_CA DINH_FId.DFC_IVActrEnrgPlaus_3_CA DINH_FId.DFC_IVActrEnrgPlaus_4_CA DINH_FId.DFC_IVActrEnrgPlaus_5_CA DINH_FId.DFC_IVActrEnrgPlaus_6_CA DINH_FId.DFC_IVActrEnrgPlaus_7_CA DINH_FId.DFC_IVCtlTiDiff_0_CA DINH_FId.DFC_IVCtlTiDiff_1_CA DINH_FId.DFC_IVCtlTiDiff_2_CA DINH_FId.DFC_IVCtlTiDiff_3_CA DINH_FId.DFC_IVCtlTiDiff_4_CA DINH_FId.DFC_IVCtlTiDiff_5_CA DINH_FId.DFC_IVCtlUDiffUp_0_CA DINH_FId.DFC_IVCtlUDiffUp_1_CA DINH_FId.DFC_IVCtlUDiffUp_2_CA DINH_FId.DFC_IVCtlUDiffUp_3_CA DINH_FId.DFC_IVCtlUDiffUp_4_CA DINH_FId.DFC_IVCtlUDiffUp_5_CA DINH_FId.DFC_IVCtlUUp_0_CA DINH_FId.DFC_IVCtlUUp_1_CA DINH_FId.DFC_IVCtlUUp_2_CA DINH_FId.DFC_IVCtlUUp_3_CA DINH_FId.DFC_IVCtlUUp_4_CA DINH_FId.DFC_IVCtlUUp_5_CA DINH_FId.DFC_IVDiaBnkShCir_0_CA DINH_FId.DFC_IVDiaBnkShCir_1_CA DINH_FId.DFC_IVDiaBnkShCirChSwt_0_CA DINH_FId.DFC_IVDiaBnkShCirChSwt_1_CA DINH_FId.DFC_IVDiaChp_0_CA DINH_FId.DFC_IVDiaChp_1_CA DINH_FId.DFC_IVDiaCylNoCls_0_CA DINH_FId.DFC_IVDiaCylNoCls_1_CA DINH_FId.DFC_IVDiaCylNoCls_2_CA DINH_FId.DFC_IVDiaCylNoCls_3_CA DINH_FId.DFC_IVDiaCylNoCls_4_CA DINH_FId.DFC_IVDiaCylNoCls_5_CA DINH_FId.DFC_IVDiaCylNoLd_0_CA DINH_FId.DFC_IVDiaCylNoLd_1_CA DINH_FId.DFC_IVDiaCylNoLd_2_CA DINH_FId.DFC_IVDiaCylNoLd_3_CA DINH_FId.DFC_IVDiaCylNoLd_4_CA DINH_FId.DFC_IVDiaCylNoLd_5_CA DINH_FId.DFC_IVDiaCylShCir_0_CA DINH_FId.DFC_IVDiaCylShCir_1_CA DINH_FId.DFC_IVDiaCylShCir_2_CA DINH_FId.DFC_IVDiaCylShCir_3_CA DINH_FId.DFC_IVDiaCylShCir_4_CA DINH_FId.DFC_IVDiaCylShCir_5_CA DINH_FId.DFC_IVDiaCylShCirHSLS_0_CA DINH_FId.DFC_IVDiaCylShCirHSLS_1_CA DINH_FId.DFC_IVDiaCylShCirHSLS_2_CA DINH_FId.DFC_IVDiaCylShCirHSLS_3_CA DINH_FId.DFC_IVDiaCylShCirHSLS_4_CA DINH_FId.DFC_IVDiaCylShCirHSLS_5_CA DINH_FId.DFC_IVDiaCylShCirMeas_0_CA DINH_FId.DFC_IVDiaCylShCirMeas_1_CA DINH_FId.DFC_IVDiaCylShCirMeas_2_CA DINH_FId.DFC_IVDiaCylShCirMeas_3_CA DINH_FId.DFC_IVDiaCylShCirMeas_4_CA DINH_FId.DFC_IVDiaCylShCirMeas_5_CA DINH_FId.DFC_LSUDynChk_CA DINH_FId.DFC_LSUO2ClbMax_CA DINH_FId.DFC_LSUO2ClbMin_CA DINH_FId.DFC_LSUO2PlausMaxFLd_CA DINH_FId.DFC_LSUO2PlausMaxOvrRun_CA DINH_FId.DFC_LSUO2PlausMaxPartLd_CA DINH_FId.DFC_LSUO2PlausMinFLd_CA DINH_FId.DFC_LSUO2PlausMinOvrRun_CA DINH_FId.DFC_LSUO2PlausMinPartLd_CA DINH_FId.DFC_LSURiClbMax_CA DINH_FId.DFC_LSURiClbMin_CA DINH_FId.DFC_LSUWireIPSig_CA DINH_FId.DFC_Layer_BSDMax_CA DINH_FId.DFC_Layer_BSDMin_CA DINH_FId.DFC_Layer_BSDNpl_CA DINH_FId.DFC_Layer_BSDSig_CA DINH_FId.DFC_Layer_FltMngTstMax_CA DINH_FId.DFC_Layer_FltMngTstMin_CA DINH_FId.DFC_Layer_FltMngTstNpl_CA DINH_FId.DFC_Layer_FltMngTstSig_CA DINH_FId.DFC_Layer_GENELBMax_CA DINH_FId.DFC_Layer_GENELBMin_CA DINH_FId.DFC_Layer_GENELBNpl_CA DINH_FId.DFC_Layer_GENELBSig_CA DINH_FId.DFC_Layer_GENELMax_CA DINH_FId.DFC_Layer_GENELMin_CA DINH_FId.DFC_Layer_GENELNpl_CA DINH_FId.DFC_Layer_GENELSig_CA DINH_FId.DFC_Layer_GENHTBMax_CA DINH_FId.DFC_Layer_GENHTBMin_CA DINH_FId.DFC_Layer_GENHTBNpl_CA DINH_FId.DFC_Layer_GENHTBSig_CA DINH_FId.DFC_Layer_GENHTMax_CA DINH_FId.DFC_Layer_GENHTMin_CA DINH_FId.DFC_Layer_GENHTNpl_CA DINH_FId.DFC_Layer_GENHTSig_CA DINH_FId.DFC_Layer_GENKOMMMax_CA DINH_FId.DFC_Layer_GENKOMMMin_CA DINH_FId.DFC_Layer_GENKOMMNpl_CA DINH_FId.DFC_Layer_GENKOMMSig_CA DINH_FId.DFC_Layer_GENMECHMax_CA DINH_FId.DFC_Layer_GENMECHMin_CA DINH_FId.DFC_Layer_GENMECHNpl_CA DINH_FId.DFC_Layer_GENMECHSig_CA DINH_FId.DFC_Layer_GENMax_CA DINH_FId.DFC_Layer_GENMin_CA DINH_FId.DFC_Layer_GENNpl_CA DINH_FId.DFC_Layer_GENREGUPLMax_CA DINH_FId.DFC_Layer_GENREGUPLMin_CA DINH_FId.DFC_Layer_GENREGUPLNpl_CA DINH_FId.DFC_Layer_GENREGUPLSig_CA DINH_FId.DFC_Layer_GENSig_CA DINH_FId.DFC_Layer_GENUPLMax_CA DINH_FId.DFC_Layer_GENUPLMin_CA DINH_FId.DFC_Layer_GENUPLNpl_CA DINH_FId.DFC_Layer_GENUPLSig_CA DINH_FId.DFC_Layer_IBS1Max_CA DINH_FId.DFC_Layer_IBS1Min_CA DINH_FId.DFC_Layer_IBS1Npl_CA DINH_FId.DFC_Layer_IBS1Sig_CA DINH_FId.DFC_Layer_IBS2Max_CA DINH_FId.DFC_Layer_IBS2Min_CA DINH_FId.DFC_Layer_IBS2Npl_CA DINH_FId.DFC_Layer_IBS2Sig_CA DINH_FId.DFC_Layer_IBS3Max_CA DINH_FId.DFC_Layer_IBS3Min_CA DINH_FId.DFC_Layer_IBS3Npl_CA DINH_FId.DFC_Layer_IBS3Sig_CA DINH_FId.DFC_Layer_MANDETEKMax_CA DINH_FId.DFC_Layer_MANDETEKMin_CA DINH_FId.DFC_Layer_MANDETEKNpl_CA DINH_FId.DFC_Layer_MANDETEKSig_CA DINH_FId.DFC_Layer_NDR1Max_CA DINH_FId.DFC_Layer_NDR1Min_CA DINH_FId.DFC_Layer_NDR1Npl_CA DINH_FId.DFC_Layer_NDR1Sig_CA DINH_FId.DFC_Layer_NDR2Max_CA DINH_FId.DFC_Layer_NDR2Min_CA DINH_FId.DFC_Layer_NDR2Npl_CA DINH_FId.DFC_Layer_NDR2Sig_CA DINH_FId.DFC_Layer_NGLERNMax_CA DINH_FId.DFC_Layer_NGLERNMin_CA DINH_FId.DFC_Layer_NGLERNNpl_CA DINH_FId.DFC_Layer_NGLERNSig_CA DINH_FId.DFC_Layer_PMBATTMax_CA DINH_FId.DFC_Layer_PMBATTMin_CA DINH_FId.DFC_Layer_PMBATTNpl_CA DINH_FId.DFC_Layer_PMBATTSig_CA DINH_FId.DFC_Layer_PMBNMax_CA DINH_FId.DFC_Layer_PMBNMin_CA DINH_FId.DFC_Layer_PMBNNpl_CA DINH_FId.DFC_Layer_PMBNSig_CA DINH_FId.DFC_Layer_PMRUHVERLMax_CA DINH_FId.DFC_Layer_PMRUHVERLMin_CA DINH_FId.DFC_Layer_PMRUHVERLNpl_CA DINH_FId.DFC_Layer_PMRUHVERLSig_CA DINH_FId.DFC_Layer_QLTMax_CA DINH_FId.DFC_Layer_QLTMin_CA DINH_FId.DFC_Layer_QLTNpl_CA DINH_FId.DFC_Layer_QLTSig_CA DINH_FId.DFC_Layer_TOENSMax_CA DINH_FId.DFC_Layer_TOENSMin_CA DINH_FId.DFC_Layer_TOENSNpl_CA DINH_FId.DFC_Layer_TOENSSig_CA DINH_FId.DFC_MonLimCurr_CA DINH_FId.DFC_MonLimLead_CA DINH_FId.DFC_MonLimSet_CA DINH_FId.DFC_NSCDsNOxOfsMax_CA DINH_FId.DFC_NSCDsNOxOfsMin_CA DINH_FId.DFC_NSCDsNOxPlausMin_CA DINH_FId.DFC_NoCat2DsNOxOfsMax_CA DINH_FId.DFC_NoCat2DsNOxOfsMin_CA DINH_FId.DFC_NoCat2DsNOxPlausMin_CA DINH_FId.DFC_PCVNoStrt_CA DINH_FId.DFC_RailPGradMon_CA DINH_FId.DFC_SCRPODPresBuildUp_CA DINH_FId.DFC_AFSDrftIdlAdjVal_CA DINH_FId.DFC_AFSDrftLdAdjVal_CA DINH_FId.DFC_AdcIADC0Cal_CA DINH_FId.DFC_AdcIADC0Conv_CA DINH_FId.DFC_AdcIADC1Cal_CA DINH_FId.DFC_AdcIADC1Conv_CA DINH_FId.DFC_CmbChbMisfireMax_0_CA DINH_FId.DFC_CmbChbMisfireMax_1_CA DINH_FId.DFC_CmbChbMisfireMax_2_CA DINH_FId.DFC_CmbChbMisfireMax_3_CA DINH_FId.DFC_CmbChbMisfireMax_4_CA DINH_FId.DFC_CmbChbMisfireMax_5_CA DINH_FId.DFC_CmbChbMisfireMul_CA DINH_FId.DFC_EGRVlvLPOfsNeutr_CA DINH_FId.DFC_EGRVlvOfsNeutr_CA DINH_FId.DFC_FMAErrModMax_CA DINH_FId.DFC_FMAErrModMin_CA DINH_FId.DFC_FlSysTnkLo_CA DINH_FId.DFC_GbxNPosPlaus_CA DINH_FId.DFC_I14229_ROETst_Appl_CA DINH_FId.DFC_I14229_ROETst_Netw_CA DINH_FId.DFC_I14229_ROE_BufFull_CA DINH_FId.DFC_IVAdjDiaIVAdj_CA DINH_FId.DFC_IVAdjIVA_0_CA DINH_FId.DFC_IVAdjIVA_1_CA DINH_FId.DFC_IVAdjIVA_2_CA DINH_FId.DFC_IVAdjIVA_3_CA DINH_FId.DFC_IVAdjIVA_4_CA DINH_FId.DFC_IVAdjIVA_5_CA DINH_FId.DFC_IVPSplyDCDCOff_0_CA DINH_FId.DFC_IVPSplyDCDCOff_1_CA DINH_FId.DFC_IVPSplyDCDCOff_2_CA DINH_FId.DFC_IVPSplyDCDCOff_3_CA DINH_FId.DFC_InjCtlAdjQntEEPCS_CA DINH_FId.DFC_LSUSPISig_CA DINH_FId.DFC_Layer_Dummy_CA DINH_FId.DFC_NplEnvPSensPPFltDiff_CA DINH_FId.DFC_NplPresSensPPFltDiff_CA DINH_FId.DFC_OilLvlPlaus_CA DINH_FId.DFC_OilTOutLvl_CA DINH_FId.DFC_PCVfacAdaptMax_CA DINH_FId.DFC_PCVfacAdaptMin_CA DINH_FId.DFC_SensFrzPPFltUs_CA DINH_FId.DFC_SensMonUTnkLvl_CA DINH_FId.DFC_T15Sig_CA DINH_FId.DFC_AirCtlRmpTOut_CA DINH_FId.DFC_BrkPPlaus_CA DINH_FId.DFC_CEngDsTDynTst_CA DINH_FId.DFC_EEPEraseErr_CA DINH_FId.DFC_EEPRdErr_CA DINH_FId.DFC_EEPWrErr_CA DINH_FId.DFC_EGRVlvJamVlvClsd_CA DINH_FId.DFC_EGRVlvJamVlvOpn_CA DINH_FId.DFC_EGRVlvLPJamVlvClsd_CA DINH_FId.DFC_EGRVlvLPJamVlvOpn_CA DINH_FId.DFC_EGRVlvLPLgTDrft_CA DINH_FId.DFC_EGRVlvLPOfsLrnJamVlv_CA DINH_FId.DFC_EGRVlvLPShTDrft_CA DINH_FId.DFC_EGRVlvLgTDrft_CA DINH_FId.DFC_EGRVlvOfsLrnJamVlv_CA DINH_FId.DFC_EGRVlvShTDrft_CA DINH_FId.DFC_EngICO_CA DINH_FId.DFC_EpmCaSI1ErrSig_CA DINH_FId.DFC_EpmCaSI1NoSig_CA DINH_FId.DFC_EpmCaSI1OfsErr_CA DINH_FId.DFC_EpmCrSErrSig_CA DINH_FId.DFC_EpmCrSNoSig_CA DINH_FId.DFC_IVPlausComprTst_CA DINH_FId.DFC_IVPlausRunUpTst_CA DINH_FId.DFC_InjCrvShOffTst_CA DINH_FId.DFC_LayerEnSavModProd_CA DINH_FId.DFC_LayerEnSavModRep_CA DINH_FId.DFC_LayerEnSavModShip_CA DINH_FId.DFC_MRlyErlyOpng_CA DINH_FId.DFC_MRlyStk_CA DINH_FId.DFC_MeUnActrTst_CA DINH_FId.DFC_MoCADCCmp_CA DINH_FId.DFC_MoCADCTst_CA DINH_FId.DFC_MoCADCVltgRatio_CA DINH_FId.DFC_MoCComErrCnt_CA DINH_FId.DFC_MoCComSPI_CA DINH_FId.DFC_MoCROMErrXPg_CA DINH_FId.DFC_MoCSOPHwNoRdy_CA DINH_FId.DFC_MoCSOPLoLi_CA DINH_FId.DFC_MoCSOPMM_CA DINH_FId.DFC_MoCSOPTimeOut_CA DINH_FId.DFC_MoCSOPUpLi_CA DINH_FId.DFC_MoFAPP_CA DINH_FId.DFC_MoFESpd_CA DINH_FId.DFC_MoFInjDatPhi_CA DINH_FId.DFC_MoFInjDatQnt_CA DINH_FId.DFC_MoFInjQnt_CA DINH_FId.DFC_MoFMode1PoI1_CA DINH_FId.DFC_MoFMode1PoI2_CA DINH_FId.DFC_MoFMode2PoI1_CA DINH_FId.DFC_MoFMode2PoI2_CA DINH_FId.DFC_MoFOvR_CA DINH_FId.DFC_MoFQntCor_CA DINH_FId.DFC_MoFRailP_CA DINH_FId.DFC_MoFTrqCmp_CA DINH_FId.DFC_NSCDsHtrSetP_CA DINH_FId.DFC_NoCat2DsHtrSetP_CA DINH_FId.DFC_PCVActrTst_CA DINH_FId.DFC_PhyModNonMonMapNpl_CA DINH_FId.DFC_RailHpTst_CA DINH_FId.DFC_RailPOfsTstMax_CA DINH_FId.DFC_RailPOfsTstMin_CA DINH_FId.DFC_SIA_E1max_CA DINH_FId.DFC_SIA_E1min_CA DINH_FId.DFC_SIA_E1npl_CA DINH_FId.DFC_SIA_E1sig_CA DINH_FId.DFC_SIA_E2max_CA DINH_FId.DFC_SIA_E2min_CA DINH_FId.DFC_SIA_E2npl_CA DINH_FId.DFC_SIA_E2sig_CA DINH_FId.DFC_SIA_E3max_CA DINH_FId.DFC_SIA_E3min_CA DINH_FId.DFC_SIA_E3npl_CA DINH_FId.DFC_SIA_E3sig_CA DINH_FId.DFC_SIA_E4max_CA DINH_FId.DFC_SIA_E4min_CA DINH_FId.DFC_SIA_E4npl_CA DINH_FId.DFC_SIA_E4sig_CA DINH_FId.DFC_SWReset_0_CA DINH_FId.DFC_SWReset_1_CA DINH_FId.DFC_SWReset_2_CA DINH_FId.DFC_ShtrAKKMax_CA DINH_FId.DFC_ShtrAKKMin_CA DINH_FId.DFC_ShtrAKKNpl_CA DINH_FId.DFC_ShtrPKKMax_CA DINH_FId.DFC_StopCntTmr_CA DINH_FId.DFC_ThrVlvMon_CA DINH_FId.DFC_VSwVlvJamVlv_CA DINH_FId.DFC_VSwVlvLgTDrft_CA DINH_FId.DFC_VSwVlvOfsLrnJamVlv_CA DINH_FId.DFC_VSwVlvOfsNeutr_CA DINH_FId.DFC_VSwVlvShTDrft_CA DINH_FId.DFC_VSwVlvSpgDef_CA DINH_FId.DSQ_AFS_SSpShOffActr_CA DINH_FId.DSQ_AirCCmprActr_CA DINH_FId.DSQ_CEngDsT_CA DINH_FId.DSQ_CThmstActr_CA DINH_FId.DSQ_Com_aDirect_CA DINH_FId.DSQ_Com_aSide_CA DINH_FId.DSQ_Com_ctrDay_CA DINH_FId.DSQ_Com_ctrSec_CA DINH_FId.DSQ_Com_ctrSecAbs_CA DINH_FId.DSQ_Com_dDay_CA DINH_FId.DSQ_Com_dMonth_CA DINH_FId.DSQ_Com_dYear_CA DINH_FId.DSQ_Com_dphiStWhlAg_CA DINH_FId.DSQ_Com_dvolPspDes_CA DINH_FId.DSQ_Com_iHiLimCurr_CA DINH_FId.DSQ_Com_iLoLimCurr_CA DINH_FId.DSQ_Com_iPsp_CA DINH_FId.DSQ_Com_iZrLimCurr_CA DINH_FId.DSQ_Com_idParkConsumer_CA DINH_FId.DSQ_Com_idVerbraucher_CA DINH_FId.DSQ_Com_lFlTnkQntLow_CA DINH_FId.DSQ_Com_lSum_CA DINH_FId.DSQ_Com_nDKG_CA DINH_FId.DSQ_Com_nGbxOut_CA DINH_FId.DSQ_Com_nPsp_CA DINH_FId.DSQ_Com_nRqIdlg_CA DINH_FId.DSQ_Com_nTSC_CA DINH_FId.DSQ_Com_nWhl_CA DINH_FId.DSQ_Com_nWhlFL_CA DINH_FId.DSQ_Com_nWhlFR_CA DINH_FId.DSQ_Com_nWhlRL_CA DINH_FId.DSQ_Com_nWhlRR_CA DINH_FId.DSQ_Com_pBrkSys_CA DINH_FId.DSQ_Com_phiStWhlAg_CA DINH_FId.DSQ_Com_rACFanDem_CA DINH_FId.DSQ_Com_rHtFlowReq_CA DINH_FId.DSQ_Com_rLamLinRecGndRaw_CA DINH_FId.DSQ_Com_rLamLinRecUbattRaw_CA DINH_FId.DSQ_Com_rNOxCat2DsGndRaw_CA DINH_FId.DSQ_Com_rNOxCat2DsUbattRaw_CA DINH_FId.DSQ_Com_rPspSetPoint_CA DINH_FId.DSQ_Com_rPwrSpCons_CA DINH_FId.DSQ_Com_rTrq_CA DINH_FId.DSQ_Com_stAC_CA DINH_FId.DSQ_Com_stACEFan_CA DINH_FId.DSQ_Com_stARS_CA DINH_FId.DSQ_Com_stAcpd_CA DINH_FId.DSQ_Com_stBattClass_CA DINH_FId.DSQ_Com_stBonnet_CA DINH_FId.DSQ_Com_stBrkTrqDVCHQl_CA DINH_FId.DSQ_Com_stButtonMSA_CA DINH_FId.DSQ_Com_stCat2DsGndRaw_CA DINH_FId.DSQ_Com_stCat2DsUbattRaw_CA DINH_FId.DSQ_Com_stClCtr_CA DINH_FId.DSQ_Com_stClassPwr_CA DINH_FId.DSQ_Com_stClth_CA DINH_FId.DSQ_Com_stClthOpen_CA DINH_FId.DSQ_Com_stClthRaw_CA DINH_FId.DSQ_Com_stCrCtlKombi_CA DINH_FId.DSQ_Com_stCrCtlLvr_CA DINH_FId.DSQ_Com_stDSC_CA DINH_FId.DSQ_Com_stDecellDSC_CA DINH_FId.DSQ_Com_stDiagPsp_CA DINH_FId.DSQ_Com_stDoorDriver_CA DINH_FId.DSQ_Com_stDrWghSeat_CA DINH_FId.DSQ_Com_stDrvAssist_CA DINH_FId.DSQ_Com_stDrvDyn_CA DINH_FId.DSQ_Com_stDrvPrgQl_CA DINH_FId.DSQ_Com_stDynDisp_CA DINH_FId.DSQ_Com_stEngStop_CA DINH_FId.DSQ_Com_stErrAFS_CA DINH_FId.DSQ_Com_stErrStrg_CA DINH_FId.DSQ_Com_stFlTnkQntRes_CA DINH_FId.DSQ_Com_stFolDyn_CA DINH_FId.DSQ_Com_stGbxOBD_CA DINH_FId.DSQ_Com_stGear_CA DINH_FId.DSQ_Com_stGearBck_CA DINH_FId.DSQ_Com_stHDC_CA DINH_FId.DSQ_Com_stKeyVld_CA DINH_FId.DSQ_Com_stLckGbxDemQl_CA DINH_FId.DSQ_Com_stLmpPrkBrk_CA DINH_FId.DSQ_Com_stMSALmp_CA DINH_FId.DSQ_Com_stModDKG_CA DINH_FId.DSQ_Com_stNOxErrGndRaw_CA DINH_FId.DSQ_Com_stNOxErrUbattRaw_CA DINH_FId.DSQ_Com_stPBrComf_CA DINH_FId.DSQ_Com_stPBrHold_CA DINH_FId.DSQ_Com_stPBrHyd_CA DINH_FId.DSQ_Com_stPBrkSysQl_CA DINH_FId.DSQ_Com_stPHtr_CA DINH_FId.DSQ_Com_stParkConsumer_CA DINH_FId.DSQ_Com_stPsp_CA DINH_FId.DSQ_Com_stPspCntr_CA DINH_FId.DSQ_Com_stRaceStrt_CA DINH_FId.DSQ_Com_stReqMSA_CA DINH_FId.DSQ_Com_stRevGear_CA DINH_FId.DSQ_Com_stSTEQl_CA DINH_FId.DSQ_Com_stSeason_CA DINH_FId.DSQ_Com_stShftIdctrDemRglX_CA DINH_FId.DSQ_Com_stShiftPdl_CA DINH_FId.DSQ_Com_stShutOffPSP_CA DINH_FId.DSQ_Com_stSleepBus_CA DINH_FId.DSQ_Com_stSleepConst_CA DINH_FId.DSQ_Com_stSleepDest_CA DINH_FId.DSQ_Com_stSleepRdy_CA DINH_FId.DSQ_Com_stStrg_CA DINH_FId.DSQ_Com_stStrtClth_CA DINH_FId.DSQ_Com_stStrtLck_CA DINH_FId.DSQ_Com_stT15_CA DINH_FId.DSQ_Com_stT15Hw_CA DINH_FId.DSQ_Com_stT50_CA DINH_FId.DSQ_Com_stTRadio_CA DINH_FId.DSQ_Com_stTSC_CA DINH_FId.DSQ_Com_stTerminal_CA DINH_FId.DSQ_Com_stTrailer_CA DINH_FId.DSQ_Com_stTrqAFS_CA DINH_FId.DSQ_Com_stTrqDSCDes_CA DINH_FId.DSQ_Com_stTrqFil_CA DINH_FId.DSQ_Com_stTrqGbxDes_CA DINH_FId.DSQ_Com_stTrqGbxLim_CA DINH_FId.DSQ_Com_stTrqStbDesQl_CA DINH_FId.DSQ_Com_stTrqStrg_CA DINH_FId.DSQ_Com_stTrqWhl_CA DINH_FId.DSQ_Com_stTrqWhlDemFASQl_CA DINH_FId.DSQ_Com_stTrqWhlDesQl_CA DINH_FId.DSQ_Com_stTypBody_CA DINH_FId.DSQ_Com_stUnVel_CA DINH_FId.DSQ_Com_stVehCond_CA DINH_FId.DSQ_Com_stVehDrvCond_CA DINH_FId.DSQ_Com_stVerbraucher_CA DINH_FId.DSQ_Com_stphiStWhlAg_CA DINH_FId.DSQ_Com_swtAC_CA DINH_FId.DSQ_Com_swtDrBltb_CA DINH_FId.DSQ_Com_tEnvT_CA DINH_FId.DSQ_Com_tGbxOil_CA DINH_FId.DSQ_Com_tiPostRunPwrSpl_CA DINH_FId.DSQ_Com_trqAC_CA DINH_FId.DSQ_Com_trqAFS_CA DINH_FId.DSQ_Com_trqAFSDes_CA DINH_FId.DSQ_Com_trqARSCur_CA DINH_FId.DSQ_Com_trqARSDes_CA DINH_FId.DSQ_Com_trqAdjrDKG_CA DINH_FId.DSQ_Com_trqBrkDVCH_CA DINH_FId.DSQ_Com_trqClthDKG_CA DINH_FId.DSQ_Com_trqDSCDes_CA DINH_FId.DSQ_Com_trqDVCHRise_CA DINH_FId.DSQ_Com_trqGbxDes_CA DINH_FId.DSQ_Com_trqGbxFrc_CA DINH_FId.DSQ_Com_trqGbxMax_CA DINH_FId.DSQ_Com_trqGbxMaxRaw_CA DINH_FId.DSQ_Com_trqStbDes_CA DINH_FId.DSQ_Com_trqStrg_CA DINH_FId.DSQ_Com_trqStrgDes_CA DINH_FId.DSQ_Com_trqTarDKG_CA DINH_FId.DSQ_Com_trqTarDrvDyn_CA DINH_FId.DSQ_Com_trqTarDrvDynDes_CA DINH_FId.DSQ_Com_trqTarDrvDynMax_CA DINH_FId.DSQ_Com_trqWhlDes_CA DINH_FId.DSQ_Com_uLamBinGndRaw_CA DINH_FId.DSQ_Com_uLamBinUbattRaw_CA DINH_FId.DSQ_Com_uPsp_CA DINH_FId.DSQ_Com_uT30Psp_CA DINH_FId.DSQ_Com_v_CA DINH_FId.DSQ_Com_vBd_CA DINH_FId.DSQ_Com_vDspl_CA DINH_FId.DSQ_Com_vVeh_CA DINH_FId.DSQ_Com_volFlTnkQnt_CA DINH_FId.DSQ_Com_volFlTnkQntLH_CA DINH_FId.DSQ_Com_volFlTnkQntRH_CA DINH_FId.DSQ_DSMInhibitAlways_CA DINH_FId.DSQ_EBxFan_CA DINH_FId.DSQ_EGRVlvActr_CA DINH_FId.DSQ_EGRVlvLPActr_CA DINH_FId.DSQ_EGRVlvLPSens_CA DINH_FId.DSQ_EMDmp_0_CA DINH_FId.DSQ_EMDmp_1_CA DINH_FId.DSQ_EngPrtFWOsc_CA DINH_FId.DSQ_EngStAActr_CA DINH_FId.DSQ_EnvP_CA DINH_FId.DSQ_EnvT_CA DINH_FId.DSQ_ErrLmpActrMIL_CA DINH_FId.DSQ_ErrLmpActrSVS_CA DINH_FId.DSQ_FlFltDsP_CA DINH_FId.DSQ_FlFltHtActr_CA DINH_FId.DSQ_FlFltUsP_CA DINH_FId.DSQ_FuelLvl_vol_CA DINH_FId.DSQ_GbxNPosPls_CA DINH_FId.DSQ_IVDiast_CA DINH_FId.DSQ_InjVlvInjCo_CA DINH_FId.DSQ_InjVlvPresMin_CA DINH_FId.DSQ_LSUO2_CA DINH_FId.DSQ_Layer_rCtrPwrSpCos_CA DINH_FId.DSQ_MRly_CA DINH_FId.DSQ_NoCat2DsO2Val_CA DINH_FId.DSQ_O2ValNSCDs_CA DINH_FId.DSQ_O2ValNoCat2Ds_CA DINH_FId.DSQ_PIntkVUs_CA DINH_FId.DSQ_PPFltUs_CA DINH_FId.DSQ_RailShutOffDblCtl_CA DINH_FId.DSQ_RailShutOffMeUnCtl_CA DINH_FId.DSQ_StrtActr_CA DINH_FId.DSQ_TAFS_CA DINH_FId.DSQ_TCACDs_CA DINH_FId.DSQ_TTrbnUs_CA DINH_FId.DSQ_ThrVlvActr_CA DINH_FId.DSQ_TrbChActr_CA DINH_FId.DSQ_TrbnDsRLamO2_CA DINH_FId.DSQ_UCatUsT_CA DINH_FId.DSQ_UDosVlvActr_CA DINH_FId.DSQ_UHtrPL_CA DINH_FId.DSQ_UHtrPLDia_CA DINH_FId.DSQ_UHtrTnk_CA DINH_FId.DSQ_UHtrTnkDia_CA DINH_FId.DSQ_UPmpMotActr_CA DINH_FId.DSQ_UPmpP_CA DINH_FId.DSQ_URevVlv_CA DINH_FId.DSQ_UTnkLvl_CA DINH_FId.DSQ_UTnkT_CA DINH_FId.DSQ_VSwVlvActr_CA DINH_FId.DSQ_stAPP_CA DINH_FId.DSQ_stAPP1_CA DINH_FId.DSQ_stAPP2_CA DINH_FId.DSQ_stLSUSrvTstDem_CA DINH_FId.DSQ_stSrvOpLSUAdap_CA DINH_Lim.DFC_ACCIPlausDrvAst_CA DINH_Lim.DFC_ACCIPlausTrqDes_CA DINH_Lim.DFC_AirCtlGovDvtEOMMax_CA DINH_Lim.DFC_AirCtlGovDvtEOMMin_CA DINH_Lim.DFC_AirCtlGovDvtMax_CA DINH_Lim.DFC_AirCtlGovDvtMin_CA DINH_Lim.DFC_AirCtlGovLPDvtMax_CA DINH_Lim.DFC_AirCtlGovLPDvtMin_CA DINH_Lim.DFC_AltIOComErr_CA DINH_Lim.DFC_AltIOComNpl_CA DINH_Lim.DFC_BusDiagBusOffFlexRay_CA DINH_Lim.DFC_BusDiagBusOffNodeA_CA DINH_Lim.DFC_BusDiagBusOffNodeB_CA DINH_Lim.DFC_BusDiagBusOffNodeC_CA DINH_Lim.DFC_BusDiagHwFlexRay_CA DINH_Lim.DFC_Cj945SpiCom1_CA DINH_Lim.DFC_ComACDemandSig_FA_CA DINH_Lim.DFC_ComACDemandTo_FA_CA DINH_Lim.DFC_ComATempSig_FA_CA DINH_Lim.DFC_ComATempTo_FA_CA DINH_Lim.DFC_ComATempTo_FX_CA DINH_Lim.DFC_ComBrkTrqSumChk_FX_CA DINH_Lim.DFC_ComBrkTrqSumCtr_FX_CA DINH_Lim.DFC_ComBrkTrqSumTo_FX_CA DINH_Lim.DFC_ComBtnDrvDynChk_FX_CA DINH_Lim.DFC_ComBtnDrvDynCtr_FX_CA DINH_Lim.DFC_ComBtnDrvDynTo_FX_CA DINH_Lim.DFC_ComButtonMSASig_CA DINH_Lim.DFC_ComButtonMSATo_CA DINH_Lim.DFC_ComCodierungPwrmngSig_CA DINH_Lim.DFC_ComCodierungPwrmngSig_FA_CA DINH_Lim.DFC_ComCrCtlLvrChk_CA DINH_Lim.DFC_ComCrCtlLvrCtr_CA DINH_Lim.DFC_ComCrCtlLvrSig_CA DINH_Lim.DFC_ComCrCtlLvrTo_CA DINH_Lim.DFC_ComCtrCrshSwoEkpSig_FA_CA DINH_Lim.DFC_ComCtrCrshSwoEkpTo_FA_CA DINH_Lim.DFC_ComCtrSecInt_CA DINH_Lim.DFC_ComDiaOBDGbxSig_A_CA DINH_Lim.DFC_ComDiaOBDGbxTo_A_CA DINH_Lim.DFC_ComFahrzeugtypSig_CA DINH_Lim.DFC_ComFahrzeugtypSig_FA_CA DINH_Lim.DFC_ComFllupGpwsupSig_FA_CA DINH_Lim.DFC_ComFllupGpwsupTo_FA_CA DINH_Lim.DFC_ComGbxDataChk_A_CA DINH_Lim.DFC_ComGbxDataChk_FA_CA DINH_Lim.DFC_ComGbxDataCtr_A_CA DINH_Lim.DFC_ComGbxDataCtr_FA_CA DINH_Lim.DFC_ComGbxDataSig_A_CA DINH_Lim.DFC_ComGbxDataSig_FA_CA DINH_Lim.DFC_ComGbxDataTo_A_CA DINH_Lim.DFC_ComGbxDataTo_FA_CA /end DEF_CHARACTERISTIC
/end FUNCTION
/begin COMPU_METHOD DINH_FIdVerb "" TAB_VERB "%2.1" "-" COMPU_TAB_REF DINH_FIdVerb /end COMPU_METHOD
/begin COMPU_VTAB DINH_FIdVerb "" TAB_VERB 689 0 "FId_Unused" 1 "FId_InhibitAlways" 2 "FId_CoordALS" 3 "FId_CoordFBC" 4 "FId_CoordTAA" 5 "FId_CoordZFC" 6 "FId_IVPlausRunUpTstActv" 7 "FId_RailHpTstActv" 8 "FId_ACCIRevErr" 9 "FId_ACCRevErr" 10 "FId_ACCtlTEngErr" 11 "FId_ACCtlTGearbxErr" 12 "FId_ACCtlVehVErr" 13 "FId_ACCtl_AC" 14 "FId_ACCtl_Fan" 15 "FId_ACCtlstTrailer" 16 "FId_AFS" 17 "FId_AFSActrTst" 18 "FId_AFSDrftMaxLim" 19 "FId_AFSFrzAirMs" 20 "FId_AFSPlOffsDrft" 21 "FId_AFSPlSetyDrft" 22 "FId_AFSSRC" 23 "FId_AFSSysErr" 24 "FId_AFSTPer" 25 "FId_AFStCond" 26 "FId_AFStEnv" 27 "FId_AGSDem_SelectParameter" 28 "FId_APP1FinalDef" 29 "FId_APP1ProvDef" 30 "FId_APP1SRCHigh" 31 "FId_APP1SigPath" 32 "FId_APP2FinalDef" 33 "FId_APP2ProvDef" 34 "FId_APP2SRCHigh" 35 "FId_APP2SigPath" 36 "FId_APPBrkDef" 37 "FId_APPBrkTrq" 38 "FId_APPNTP" 39 "FId_APPSyncChk" 40 "FId_APPSyncDef" 41 "FId_APPSyncProvDef" 42 "FId_APPSyncSigProv" 43 "FId_APPVel" 44 "FId_APProvDef" 45 "FId_ASDdc" 46 "FId_ASDrfLAD2" 47 "FId_ASModAFS" 48 "FId_ASModAFSTCmpr" 49 "FId_ASModEGRVlvLrn" 50 "FId_ASModOxiC" 51 "FId_ASModPipe" 52 "FId_ASModPipeSlw" 53 "FId_ASModPresCalc" 54 "FId_ASModPresEnv" 55 "FId_ASModStrt" 56 "FId_ASModSwtOffEng" 57 "FId_ASModSwtOffExhMnfLP" 58 "FId_ASModSwtOffIndVol" 59 "FId_ASModT20" 60 "FId_ASModTrbn" 61 "FId_AccPedNMaxLim" 62 "FId_AccPedNMinLim" 63 "FId_AccPedTrqLim" 64 "FId_AdapNSCDs" 65 "FId_AdcIADC0" 66 "FId_AdcIADC1" 67 "FId_AftRun" 68 "FId_AirCSwt" 69 "FId_AirCtl" 70 "FId_AirCtlACCorr" 71 "FId_AirCtlBrk" 72 "FId_AirCtlBstPresCor" 73 "FId_AirCtlCmpntActv" 74 "FId_AirCtlCorAltEOM" 75 "FId_AirCtlDyn" 76 "FId_AirCtlEGR" 77 "FId_AirCtlEGRPreCtl" 78 "FId_AirCtlGear" 79 "FId_AirCtlGovDvt" 80 "FId_AirCtlGovLPDvt" 81 "FId_AirCtlInvEGRMod" 82 "FId_AirCtlLP" 83 "FId_AirCtlLPACCor" 84 "FId_AirCtlLPBstPresCor" 85 "FId_AirCtlLPCmpntActv" 86 "FId_AirCtlLPGear" 87 "FId_AirCtlLPPFltEGRRed" 88 "FId_AirCtlLPStrgCor" 89 "FId_AirCtlLPVehVCor" 90 "FId_AirCtlPFltEGRRed" 91 "FId_AirCtlStrg" 92 "FId_AirCtlTVA" 93 "FId_AirCtlTVACtl" 94 "FId_AirCtlmDesVehCorr" 95 "FId_AirSysTst" 96 "FId_BattUFrzVal" 97 "FId_BattUReplVal" 98 "FId_BattUSRC" 99 "FId_BrkP" 100 "FId_BrkPFrzVal" 101 "FId_BrkPReplVal" 102 "FId_BrkPSens" 103 "FId_BusDiag_stFadeOut" 104 "FId_CEngDsTDynTst" 105 "FId_CEngDsTFrzVal" 106 "FId_CEngDsTModel" 107 "FId_CEngDsTRdClnt" 108 "FId_CEngDsTRplVal" 109 "FId_CEngDsTSS" 110 "FId_Clth" 111 "FId_ClthCAN" 112 "FId_CmbChb" 113 "FId_CoEngNrml2Strt" 114 "FId_CoEngPthClsEGR" 115 "FId_CoEngPthClsThr" 116 "FId_CoEngPthCylOff" 117 "FId_CoEngPthETZr" 118 "FId_CoEngPthFlQnt" 119 "FId_CoEngPthInjVlvOff" 120 "FId_CoEngPthLpSysOff" 121 "FId_CoEngPthRPMin" 122 "FId_CoEngPthTrqZr" 123 "FId_CoEngSoftShOff" 124 "FId_CoEngStop" 125 "FId_CoSCR_CAN" 126 "FId_CoTS_SwtOff" 127 "FId_CoVMDComErr" 128 "FId_CoVMvBd" 129 "FId_CoVehPrpLimErr" 130 "FId_ComAPP" 131 "FId_ComBrkDef" 132 "FId_ComClth" 133 "FId_ComCoEng" 134 "FId_ComCtrSecInt" 135 "FId_ComCtrSecIntTo" 136 "FId_ComDKGIntv" 137 "FId_ComDscAck1" 138 "FId_ComDscAck2" 139 "FId_ComDscAck3" 140 "FId_ComDscTrqIntv" 141 "FId_ComEngDem" 142 "FId_ComGbxAck1" 143 "FId_ComGbxAck2" 144 "FId_ComGbxAck3" 145 "FId_ComGbxTrqIntv" 146 "FId_ComInjDu1" 147 "FId_ComInjDu2" 148 "FId_ComInjVlv" 149 "FId_ComMSA" 150 "FId_ComNDynDispOff" 151 "FId_ComNGbxOut" 152 "FId_ComPCBSPFlt" 153 "FId_ComRCtrPwrSpCos" 154 "FId_ComRpmRduc" 155 "FId_ComSLck" 156 "FId_ComStBrkPedal" 157 "FId_ComStDDEQl" 158 "FId_ComStDrvDirDes" 159 "FId_ComStEnrgPwrMnmt" 160 "FId_ComStGbxModDemFAS" 161 "FId_ComStGrip" 162 "FId_ComStLPCOff" 163 "FId_ComStLckGbxDemQl" 164 "FId_ComStRTrqPTQl" 165 "FId_ComStShiftPdl" 166 "FId_ComStShutOffPSP" 167 "FId_ComStTerminal" 168 "FId_ComStTrq" 169 "FId_ComStTrqGbxQl" 170 "FId_ComStTrqWhlStbQl" 171 "FId_ComStVehDrvCond" 172 "FId_ComStnEngQl" 173 "FId_ComStrtLck" 174 "FId_ComTEng" 175 "FId_ComTOilEng" 176 "FId_ComThrVlv" 177 "FId_ComTrqCootd" 178 "FId_ComTrqWhl" 179 "FId_ComTrqWhlDes" 180 "FId_ComUBatt" 181 "FId_ComVolTotFlCons" 182 "FId_ComnEng" 183 "FId_ComnGbxOut" 184 "FId_ComnSetPLo" 185 "FId_ComnTSC" 186 "FId_CompEnv" 187 "FId_ComrTrq" 188 "FId_ComrTrqPT" 189 "FId_ComrVirtAPP" 190 "FId_ComrWaterVlv" 191 "FId_ComrtrqDifftl" 192 "FId_ComstGear" 193 "FId_ComvVeh" 194 "FId_ConvLdNTrbnCan" 195 "FId_ConvLdOilTemp" 196 "FId_ConvLdTrqLdCan" 197 "FId_ConvLdVel" 198 "FId_CrCUILvr" 199 "FId_CrCtlCan" 200 "FId_CrCtlCanAT" 201 "FId_CrCtlEcu" 202 "FId_Cy100Dev1" 203 "FId_Cy100Dev2" 204 "FId_DCSRmpShOff" 205 "FId_DCSShOff" 206 "FId_DIOnumChip1Cj945" 207 "FId_DIUMPRGenDenom1" 208 "FId_DIUMPRGenDenom2" 209 "FId_DIUMPRGenDenom3" 210 "FId_DIUMPRIgn" 211 "FId_DSMIVAdjNVCEna" 212 "FId_DSMWarmUpCycle" 213 "FId_DStgyMon" 214 "FId_DevLibActrPrt" 215 "FId_DewDetHtgDel" 216 "FId_DewDetstSrvTstDem" 217 "FId_DiaDem_SelectParameter" 218 "FId_DynChkPPFltDiff" 219 "FId_ECBVlvFrzVal" 220 "FId_ECBVlvReplVal" 221 "FId_ECBVlvSS" 222 "FId_EGRClg" 223 "FId_EGRVlvFrzVal" 224 "FId_EGRVlvGovOn" 225 "FId_EGRVlvJamVlv" 226 "FId_EGRVlvLPFrzVal" 227 "FId_EGRVlvLPGovOn" 228 "FId_EGRVlvLPJamVlv" 229 "FId_EGRVlvLPOfsLrnInhib" 230 "FId_EGRVlvLPReplVal" 231 "FId_EGRVlvLPSSpMon" 232 "FId_EGRVlvOfsLrnInhib" 233 "FId_EGRVlvReplVal" 234 "FId_EGRVlvSSpMon" 235 "FId_EGSysMaxTOxiPre" 236 "FId_EGSysMaxTOxiPreRgn" 237 "FId_EGSysMaxTPre" 238 "FId_EGSysMaxTPreRgn" 239 "FId_EMCtl" 240 "FId_ETClbCorActv" 241 "FId_ETCtlAirCtl" 242 "FId_ETCtlInr" 243 "FId_ETCtlOutr" 244 "FId_Empt" 245 "FId_EngDaClntTemp" 246 "FId_EngDemPFltErr" 247 "FId_EngDemPFltOvldErr" 248 "FId_EngDemTrqLimErr" 249 "FId_EngDemTrqLimErr1" 250 "FId_EngDemTrqLimErr2" 251 "FId_EngDemTrqLimErr3" 252 "FId_EngDemTrqLimErr4" 253 "FId_EngPrtEnvP" 254 "FId_EngPrtFWOscInactv" 255 "FId_EngPrtNLimErr" 256 "FId_EngPrtT31" 257 "FId_EngPrtstTrailer" 258 "FId_EnhSRCPPFltDiff" 259 "FId_EnhSRCT1ExhTMon" 260 "FId_EnhSRCT2ExhTMon" 261 "FId_EnhSRCT3ExhTMon" 262 "FId_EnvPFrzVal" 263 "FId_EnvPModel" 264 "FId_EnvPNplPPFltDiff" 265 "FId_EnvPRplVal" 266 "FId_EnvPSS" 267 "FId_EnvTCANFrzVal" 268 "FId_EnvTCANRplVal" 269 "FId_EnvTModel" 270 "FId_EnvTSS" 271 "FId_EpmBCr" 272 "FId_EpmCaSAdapCaSI1" 273 "FId_EpmCaSDiag" 274 "FId_EpmCaSOfsDiagCaSI1" 275 "FId_EpmCaSOfsErrCaSI1" 276 "FId_EpmCaSSegCor" 277 "FId_EpmCrSDiag" 278 "FId_EpmCrSDiagVeh" 279 "FId_EpmOpMode_InjLock" 280 "FId_EpmRRSFaultCheck" 281 "FId_EpmRRSRdCheck" 282 "FId_ExhTMonCondPlaus" 283 "FId_ExhTMonPlausTemp" 284 "FId_FBC" 285 "FId_FBCMonI" 286 "FId_FMALamO2Valid" 287 "FId_FMASwtOff1" 288 "FId_FMASwtOff3" 289 "FId_FanCtl" 290 "FId_FanCtl2" 291 "FId_FanCtlCor" 292 "FId_FanCtlCor2" 293 "FId_FanCtlnEFan" 294 "FId_FanCtlstTrailer" 295 "FId_FanTraOil" 296 "FId_FlFCBSDef" 297 "FId_FlFltDsPFrzVal" 298 "FId_FlFltDsPReplVal" 299 "FId_FlFltUsPFrzVal" 300 "FId_FlFltUsPReplVal" 301 "FId_FlSysDens" 302 "FId_FlSysTnkLoEEP" 303 "FId_FlSysTnkLoInfo" 304 "FId_FrzPrtTrqDfftl" 305 "FId_FrzValAbsUPmpP" 306 "FId_FrzValCANAbsUPmpP" 307 "FId_FrzValCANUCatUsT" 308 "FId_FrzValPPFltDiff" 309 "FId_FrzValPPFltUs" 310 "FId_FrzValTOxiCatUs" 311 "FId_FrzValTPFltUs" 312 "FId_FrzValTTrbnUs" 313 "FId_FrzValUCatUsT" 314 "FId_FrzValUTnkLvl" 315 "FId_FuelTCTS" 316 "FId_FuelTFlSys" 317 "FId_FuelTFrzVal" 318 "FId_FuelTReplVal" 319 "FId_GSHDem_SelectParameter" 320 "FId_GbxNPosPWM" 321 "FId_GlbDaLSumvXPtd" 322 "FId_GlwCtl1" 323 "FId_GlwCtlDrWghSeat" 324 "FId_GlwCtlTRadio" 325 "FId_GlwEcuGPCMFaultInfoTstLck" 326 "FId_GlwEcuGPCMInfoTstLck" 327 "FId_HLSDemDeclGradLim" 328 "FId_HLSDemSetPLoDrvAwy" 329 "FId_HLSDemUndrBrk" 330 "FId_HLSDemtrqConv" 331 "FId_HsLnChkPPFltDiff" 332 "FId_I14229Appl_RC" 333 "FId_ISCnTrbnMod" 334 "FId_ISCtrqConv" 335 "FId_ISCvBd" 336 "FId_IVDiaTst" 337 "FId_IVPSplyDCDCOff" 338 "FId_IVPlausComprTst" 339 "FId_IVPlausRunUpTst" 340 "FId_InhibitNever" 341 "FId_InjCrvCoErr" 342 "FId_InjCrvCylOffs" 343 "FId_InjCrvDisblPoI1" 344 "FId_InjCrvDisblPoI2" 345 "FId_InjCrvPiI1VehCor" 346 "FId_InjCrvPiI2VehCor" 347 "FId_InjCrvPoIOvrLim" 348 "FId_InjCrvShOffTst" 349 "FId_InjUnStrtPlsBlk" 350 "FId_InjVlvBnk0ShutOff" 351 "FId_InjVlvBnk1ShutOff" 352 "FId_InjVlvBnk2ShutOff" 353 "FId_InjVlvBnk3ShutOff" 354 "FId_InjVlvCyl0ShutOff" 355 "FId_InjVlvCyl1ShutOff" 356 "FId_InjVlvCyl2ShutOff" 357 "FId_InjVlvCyl3ShutOff" 358 "FId_InjVlvCyl4ShutOff" 359 "FId_InjVlvCyl5ShutOff" 360 "FId_InjVlvCyl6ShutOff" 361 "FId_InjVlvCyl7ShutOff" 362 "FId_InjVlvPrep" 363 "FId_InjVlvPresMin" 364 "FId_InjVlvPresMinRun" 365 "FId_InjVlvPresMinStrt" 366 "FId_LSUAdap0" 367 "FId_LSUClbSched" 368 "FId_LSUCmpChk0" 369 "FId_LSUCtl0" 370 "FId_LSUDewRls0" 371 "FId_LSUDynChk0" 372 "FId_LSUHtCoup0" 373 "FId_LSUHtrPS0" 374 "FId_LSUIPOpnLdTst0" 375 "FId_LSUIsolChk0" 376 "FId_LSULoBatt0" 377 "FId_LSUMon0" 378 "FId_LSUO20" 379 "FId_LSUO2Clb0" 380 "FId_LSUO2SRC0" 381 "FId_LSUPlausChk0" 382 "FId_LSURi0" 383 "FId_LSURiClb0" 384 "FId_LSUShCir0" 385 "FId_LSUUNVGOpnLdTst0" 386 "FId_LSUlsu0" 387 "FId_Layer_ACFZGL11" 388 "FId_Layer_ACFZGQ11" 389 "FId_Layer_AQUERABS11" 390 "FId_Layer_ATEMPRELATIVZEIT" 391 "FId_Layer_BATTCLASS" 392 "FId_Layer_BEDIENUNG_MSA" 393 "FId_Layer_CANErr" 394 "FId_Layer_CODIERUNG_PM" 395 "FId_Layer_CRASHABSCHALTUNG" 396 "FId_Layer_DIENSTE_19" 397 "FId_Layer_FAHRZEUGTYP" 398 "FId_Layer_FltHtg" 399 "FId_Layer_FltMng_Sig1" 400 "FId_Layer_FltMng_Sig2" 401 "FId_Layer_GESCHWINDIGKEIT" 402 "FId_Layer_GETRIEBEDATEN" 403 "FId_Layer_GETRIEBEDATEN_2" 404 "FId_Layer_KILOMETERSTAND" 405 "FId_Layer_KLEMMENSTATUS" 406 "FId_Layer_LENKRADWINKEL" 407 "FId_Layer_LPC" 408 "FId_Layer_MANDETEK" 409 "FId_Layer_MSACANErr" 410 "FId_Layer_MSAVAdapt" 411 "FId_Layer_MSAVDiag" 412 "FId_Layer_STANDVERBRAUCHER" 413 "FId_Layer_STATDSC" 414 "FId_Layer_STATESEAT" 415 "FId_Layer_STATGANGRUECKWAERTS" 416 "FId_Layer_STATZVKLAPPEN" 417 "FId_Layer_STAT_ANHAENGER" 418 "FId_Layer_STAT_EKP" 419 "FId_Layer_UHRZEIT_DATUM" 420 "FId_Layer_ULCP" 421 "FId_Layer_VCAN11" 422 "FId_Layer_VERBRAUCHER" 423 "FId_Layer_WAERMESTROMKLIMA" 424 "FId_LubmOil" 425 "FId_MeUnActrTst" 426 "FId_MeUnFrzI" 427 "FId_MeUnRot" 428 "FId_MetCtl" 429 "FId_NSCDsAdapEep" 430 "FId_NSCDsCmpChk" 431 "FId_NSCDsNOx" 432 "FId_NSCDsOvrRunPlaus" 433 "FId_NSCDsRdy" 434 "FId_NSCDsSensDia" 435 "FId_NSCDsTO" 436 "FId_NoCat2DsAdap" 437 "FId_NoCat2DsAdapEep" 438 "FId_NoCat2DsCmpChk" 439 "FId_NoCat2DsNOx" 440 "FId_NoCat2DsOvrRunPlaus" 441 "FId_NoCat2DsRdy" 442 "FId_NoCat2DsSensDia" 443 "FId_NoCat2DsTO" 444 "FId_NoPresCtl" 445 "FId_NplPresSensPPFltDiff" 446 "FId_NplTOxiCatUs" 447 "FId_NplTPFltUs" 448 "FId_OilPLmpVOff" 449 "FId_OilPSwmpRplVal" 450 "FId_PCBSDef" 451 "FId_PCBSPFltDef" 452 "FId_PCR" 453 "FId_PCRCByVlvOff" 454 "FId_PCRClthActv" 455 "FId_PCRCmpntActv" 456 "FId_PCRCmpntActvLP" 457 "FId_PCRExtnLimActr" 458 "FId_PCRGovDvt" 459 "FId_PCRGovDvtLP" 460 "FId_PCRLP" 461 "FId_PCROfsRls" 462 "FId_PCRPFltPresCor" 463 "FId_PCRT20" 464 "FId_PCRTrbCh" 465 "FId_PCVActrTst" 466 "FId_PCVFrzI" 467 "FId_PCVNoStrt" 468 "FId_PCVPwrStgTst" 469 "FId_PFltAirSysFail" 470 "FId_PFltChar" 471 "FId_PFltComLSum" 472 "FId_PFltDstr" 473 "FId_PFltEngPrtRgnMon" 474 "FId_PFltLckRgnErr" 475 "FId_PFltLckRgnFl" 476 "FId_PFltLckRgnOilDil" 477 "FId_PFltLdAshCor" 478 "FId_PFltLdAshCorErr" 479 "FId_PFltLdIniAftSuc" 480 "FId_PFltLdNOxEng" 481 "FId_PFltLdO2Aprx" 482 "FId_PFltLdSimRgnThr" 483 "FId_PFltOvldHealInhRn" 484 "FId_PFltOvldHealTrqLm" 485 "FId_PFltPOpBrk" 486 "FId_PFltPOpClth" 487 "FId_PFltPOpGearDet" 488 "FId_PFltPOpSpdVeh" 489 "FId_PFltPOpTempAir" 490 "FId_PFltPOpTempClnt" 491 "FId_PFltPOpVltgBatt" 492 "FId_PFltPoI1Fail" 493 "FId_PFltPoI2Fail" 494 "FId_PFltPresPlausProj" 495 "FId_PFltRgnChngPar" 496 "FId_PFltRgnNoSucDet" 497 "FId_PFltRgnNumErrLck" 498 "FId_PFltRgnNumPFltErr" 499 "FId_PFltRgnSuc" 500 "FId_PFltSimOn" 501 "FId_PFltSysErr2Can" 502 "FId_PFltSysFail" 503 "FId_PFltTOxiPreDiff" 504 "FId_PFltTPreDiff" 505 "FId_PIntkVUsEnvPPls" 506 "FId_PIntkVUsFrzVal" 507 "FId_PIntkVUsRplVal" 508 "FId_PTCltDKG" 509 "FId_PTGripDebPtd" 510 "FId_PTTrqRatCANPtd" 511 "FId_PhyModPCRCorr" 512 "FId_PlausTTrbnUs" 513 "FId_PresBuildUp" 514 "FId_PresCtl" 515 "FId_PresRdc" 516 "FId_PresSensFrzPPFltUs" 517 "FId_QWCCTSDef" 518 "FId_QWCFTSDef" 519 "FId_QWCOff" 520 "FId_RadShtCTS" 521 "FId_RadShtConsum" 522 "FId_RadShtEGS" 523 "FId_RadShtEnvT" 524 "FId_RadShtstTrailer" 525 "FId_RailCPCtlMeUnMode" 526 "FId_RailCPCtlPCVMode" 527 "FId_RailCtlMode" 528 "FId_RailFuelTErr" 529 "FId_RailHpTst" 530 "FId_RailMeUn0Blk" 531 "FId_RailMeUn0Rls" 532 "FId_RailMeUn1Blk" 533 "FId_RailMeUn1Rls" 534 "FId_RailMeUn22Blk" 535 "FId_RailMeUn22Rls" 536 "FId_RailMeUn2Blk" 537 "FId_RailMeUn2Rls" 538 "FId_RailMeUn3Blk" 539 "FId_RailMeUn3Rls" 540 "FId_RailMeUn42Blk" 541 "FId_RailMeUn42Rls" 542 "FId_RailMeUn4Blk" 543 "FId_RailMeUn4Rls" 544 "FId_RailMeUn5Blk" 545 "FId_RailMeUn5Rls" 546 "FId_RailMeUnClsdShutOff" 547 "FId_RailMeUnCtlMode" 548 "FId_RailMeUnCtlUpLim" 549 "FId_RailPCV0Blk" 550 "FId_RailPCV0Rls" 551 "FId_RailPCV1Blk" 552 "FId_RailPCV1Rls" 553 "FId_RailPCV22Blk" 554 "FId_RailPCV22Rls" 555 "FId_RailPCV2Blk" 556 "FId_RailPCV2Rls" 557 "FId_RailPCV3Blk" 558 "FId_RailPCV3Rls" 559 "FId_RailPCV42Blk" 560 "FId_RailPCV42Rls" 561 "FId_RailPCV4Blk" 562 "FId_RailPCV4Rls" 563 "FId_RailPCVCtlMode" 564 "FId_RailPCVCtlUpLim" 565 "FId_RailPFrzVal" 566 "FId_RailPMonStrt" 567 "FId_RailPSS" 568 "FId_RailPSubsVal" 569 "FId_RailSetPointLim" 570 "FId_RailSetPointRed" 571 "FId_RailSetPointVehCor" 572 "FId_ReFl" 573 "FId_ReplValTPFltUs" 574 "FId_RplValAbsUPmpP" 575 "FId_RplValCANAbsUPmpP" 576 "FId_RplValCANUCatUsT" 577 "FId_RplValPPFltDiff" 578 "FId_RplValPPFltUs" 579 "FId_RplValTOxiCatUs" 580 "FId_RplValTTrbnUs" 581 "FId_RplValUCatUsT" 582 "FId_RplValUTnkLvl" 583 "FId_SCRChkNOxEff" 584 "FId_SCRPODPresBuildUp" 585 "FId_SRCFlwRstn" 586 "FId_SSMonFlFltDsP" 587 "FId_SSMonFlFltUsP" 588 "FId_SSPIntkVUs" 589 "FId_SSTOxiCatUs" 590 "FId_SSTPFltUs" 591 "FId_SSUCatUsT" 592 "FId_SSUPmpP" 593 "FId_SSUTnkT" 594 "FId_SensAdapTPFltUs" 595 "FId_StAPmpEna" 596 "FId_StBy" 597 "FId_SubsValPrtTrqDfftl" 598 "FId_SubsValRatTrqDfftl" 599 "FId_T15" 600 "FId_T50Sig" 601 "FId_TAA" 602 "FId_TAFSFrzVal" 603 "FId_TAFSReplVal" 604 "FId_TAFSSRC" 605 "FId_TCACDsCANFrzVal" 606 "FId_TCACDsCANRplVal" 607 "FId_TCACDsFrzVal" 608 "FId_TCACDsModel" 609 "FId_TCACDsRplVal" 610 "FId_TCACDsSS" 611 "FId_TCPrtChrgPmpCtl" 612 "FId_TCPrtChrgPmpGov" 613 "FId_TCPrtChrgPmpHLSDem" 614 "FId_TCPrt_ChrgPmpDet" 615 "FId_TCPrtnSetTSC" 616 "FId_TCSRmpShOff" 617 "FId_TCSShOff" 618 "FId_TECUFrzVal" 619 "FId_TECURplVal" 620 "FId_TOxiCatUs" 621 "FId_TempSensFrzPPFltUs" 622 "FId_TempWait" 623 "FId_ThrVlvFrzVal" 624 "FId_ThrVlvMon" 625 "FId_ThrVlvRplVal" 626 "FId_ThrVlvSS" 627 "FId_TraAddAirCANPtd" 628 "FId_TraAddClntCANPtd" 629 "FId_TraDrvAway" 630 "FId_TraDrvAwayInactiv" 631 "FId_TraGearInfoDet" 632 "FId_TraGearInfoInfoCan" 633 "FId_TraGearInfoLevPos" 634 "FId_TraGearInfoLoRng" 635 "FId_TraGearInfoRTra" 636 "FId_TraGearInfoRevGear" 637 "FId_TraNmin" 638 "FId_TraOilTemp" 639 "FId_TraPrtGearCANPtd" 640 "FId_TraRtnIntfcASTIntv" 641 "FId_TraRtnIntfcIdlSetP" 642 "FId_TraSlip" 643 "FId_TraSpaCAN" 644 "FId_TraSpaEngSpd" 645 "FId_TraSpaVehV" 646 "FId_TraTrqLimErr" 647 "FId_TraTrqLos" 648 "FId_TraTrqRedLmpHmeDec" 649 "FId_TraTrqRedLmpHmeInc" 650 "FId_TraTrqRedPlausDecIntv" 651 "FId_TraTrqRedPlausIncIntv" 652 "FId_TrbChPWMIn" 653 "FId_UHCMonUHtrPL" 654 "FId_UHCMonUHtrTnk" 655 "FId_UHtrPLFrzValDia" 656 "FId_UHtrPLRplValDia" 657 "FId_UHtrPLSSDia" 658 "FId_UHtrTnkFrzValDia" 659 "FId_UHtrTnkRplValDia" 660 "FId_UHtrTnkSSDia" 661 "FId_UTnkLvlSensTst" 662 "FId_UTnkTFrzVal" 663 "FId_UTnkTFrzValCAN" 664 "FId_UTnkTRplVal" 665 "FId_UTnkTRplValCAN" 666 "FId_VMDTrqWhl" 667 "FId_VSwCtl" 668 "FId_VSwCtlVehCorr" 669 "FId_VSwVlvFrzVal" 670 "FId_VSwVlvGovOn" 671 "FId_VSwVlvJamVlv" 672 "FId_VSwVlvOfsLrnInhib" 673 "FId_VSwVlvRplVal" 674 "FId_VSwVlvSS" 675 "FId_VSwVlvSpgDiagInhib" 676 "FId_VehVReplVal" 677 "FId_Vtln" 678 "FId_ZFCClbActv" 679 "FId_ZFCCldCmbCham" 680 "FId_stAVSCoESLSU" 681 "Fid_ComnTSC" 682 "Fid_CustDiag_DiaDem_AT" 683 "Fid_CustDiag_DiaDem_MT" 684 "Fid_HLSDemHDC" 685 "Fid_IVActrTempRplVal" 686 "Fid_StSysStrtTipGbxDat" 687 "Fid_TraCanNeutral" 688 "Fid_WaHtShOffErr" DEFAULT_VALUE "---" /end COMPU_VTAB
/begin COMPU_METHOD DINH_LimDFCVerb "" TAB_VERB "%6.3" "-" COMPU_TAB_REF DINH_LimDFCVerb /end COMPU_METHOD
/begin COMPU_VTAB DINH_LimDFCVerb "" TAB_VERB 19 12079 "Def0_Deb0" 12083 "Def25_Deb0" 12087 "Def50_Deb0" 12091 "Def75_Deb0" 12094 "Def100_Deb0" 12111 "NotTested" 13111 "Def50_Deb25" 13115 "Def75_Deb25" 13118 "Def100_Deb25" 14135 "Def50_Deb50" 14139 "Def75_Deb50" 14142 "Def100_Deb50" 15159 "Def50_Deb75" 15163 "Def75_Deb75" 15166 "Def100_Deb75" 15927 "Def50_Deb100" 15931 "Def75_Deb100" 15934 "Def100_Deb100" 20271 "Tested" /end COMPU_VTAB
/begin RECORD_LAYOUT ValA_Wu16 FNC_VALUES 1 UWORD COLUMN_DIR DIRECT /end RECORD_LAYOUT
/end MODULE
/end PROJECT

ASAP2_VERSION 1 4
/begin PROJECT P_574 "EDC17_CP09"
/begin HEADER "" VERSION "V8KB" PROJECT_NO P_574 /end HEADER
/begin MODULE DIM ""
/begin MOD_COMMON "" BYTE_ORDER MSB_LAST ALIGNMENT_BYTE 1 ALIGNMENT_WORD 2 ALIGNMENT_LONG 4 ALIGNMENT_FLOAT32_IEEE 4 /end MOD_COMMON
/begin CHARACTERISTIC InjCrv_ctATSPoI2Sel_C "Selektionsparameter für Arrayelement Ansauglufttemperatur (EngDa_tFld) für die Nacheinspritzung 2" VALUE 0x8004A98C Val_Wu8 3.00000000000 AirTempFldSel 0.00 3.00000000000 FORMAT "%13.11" /end CHARACTERISTIC
/begin CHARACTERISTIC InjCrv_facPoI1APSQCor_CUR "atmosphärendruckabhängige Mengenkorrekturkennlinie für PoI1" CURVE 0x80048ECA Cur_Xs16Ws16 1.000000 Fact 0.00 1.000000 EXTENDED_LIMITS -4.000000 3.999878
 /begin AXIS_DESCR STD_AXIS EnvP_p Pres_hPa 6 0.00 3500.000 EXTENDED_LIMITS -32768.00 32767.00 DEPOSIT ABSOLUTE /end AXIS_DESCR
/end CHARACTERISTIC
/begin CHARACTERISTIC InjCrv_facPoI1Eff0Rgn_GMAP "" MAP 0x80048EF6 MapG_Ws16 1.000000 Fact 0.00 1.000000 EXTENDED_LIMITS -4.000000 3.999878
 /begin AXIS_DESCR COM_AXIS Epm_nEng EngN 16 0.00 10000.00 EXTENDED_LIMITS -16384.00 16383.50 AXIS_PTS_REF InjCrv_facPoI1EffRgnX_AXIS /end AXIS_DESCR
 /begin AXIS_DESCR COM_AXIS InjCtl_qSetUnBal InjMass 16 0.00 327.6700 EXTENDED_LIMITS -327.6800 327.6700 AXIS_PTS_REF InjCrv_facPoI1EffRgnY_AXIS /end AXIS_DESCR
/end CHARACTERISTIC
/begin CHARACTERISTIC InjCrv_facPoI1Eff1Rgn_GMAP "" MAP 0x800490F6 MapG_Ws16 1.000000 Fact 0.00 1.000000 EXTENDED_LIMITS -4.000000 3.999878
 /begin AXIS_DESCR COM_AXIS Epm_nEng EngN 16 0.00 10000.00 EXTENDED_LIMITS -16384.00 16383.50 AXIS_PTS_REF InjCrv_facPoI1EffRgnX_AXIS /end AXIS_DESCR
 /begin AXIS_DESCR COM_AXIS InjCtl_qSetUnBal InjMass 16 0.00 327.6700 EXTENDED_LIMITS -327.6800 327.6700 AXIS_PTS_REF InjCrv_facPoI1EffRgnY_AXIS /end AXIS_DESCR
/end CHARACTERISTIC
/begin AXIS_PTS InjCrv_facPoI1EffRgnX_AXIS "" 0x800492F6 Epm_nEng Axis_Xs16 10000.00 EngN 16 0.00 10000.00 FORMAT "%8.2" EXTENDED_LIMITS -16384.00 16383.50 DEPOSIT ABSOLUTE /end AXIS_PTS
/begin AXIS_PTS InjCrv_facPoI1EffRgnY_AXIS "" 0x80049318 InjCtl_qSetUnBal Axis_Xs16 327.6700 InjMass 16 0.00 327.6700 FORMAT "%8.4" EXTENDED_LIMITS -327.6800 327.6700 DEPOSIT ABSOLUTE /end AXIS_PTS
/begin CHARACTERISTIC InjCrv_facPoI1EffRgn_CUR "" CURVE 0x8004933A Cur_Xs16Ws16 1.000000 Fact 0.00 1.000000 EXTENDED_LIMITS -4.000000 3.999878
 /begin AXIS_DESCR STD_AXIS InjCrv_qPoI1Des_mp InjMass 12 0.00 10.00000 EXTENDED_LIMITS -327.6800 327.6700 DEPOSIT ABSOLUTE /end AXIS_DESCR
/end CHARACTERISTIC
/begin CHARACTERISTIC InjCrv_facPoI1ETSQCor_CUR "motortemperaturabhängige Mengenkorrekturkennlinie für PoI1" CURVE 0x80048EE4 Cur_Xs16Ws16 1.000000 Fact 0.00 1.000000 EXTENDED_LIMITS -4.000000 3.999878
 /begin AXIS_DESCR STD_AXIS InjSys_tEng Temp_Cels 1 -50.14000 199.8600 EXTENDED_LIMITS -3549.940 3003.560 DEPOSIT ABSOLUTE /end AXIS_DESCR
/end CHARACTERISTIC
/begin CHARACTERISTIC InjCrv_facPoI1ETStiCor_CUR "" CURVE 0x80048EEA Cur_Xs16Ws16 1.000000 Fact 0.00 1.000000 EXTENDED_LIMITS -4.000000 3.999878
 /begin AXIS_DESCR STD_AXIS InjSys_tEng Temp_Cels 1 -50.14000 199.8600 EXTENDED_LIMITS -3549.940 3003.560 DEPOSIT ABSOLUTE /end AXIS_DESCR
/end CHARACTERISTIC
/begin CHARACTERISTIC InjCrv_facPoI1QntRmp0Val_GCUR "Faktorisierungskennlinie für die Menge der PoI1" CURVE 0x80049BF4 CurG_Ws16 3.999939 CoEOMSwt_S16 -2.000000 1.999939 FORMAT "%8.6"
 /begin AXIS_DESCR COM_AXIS CoEOM_facRmpVal CoEOMSwt_S16 10 -2.000000 1.999939 FORMAT "%8.6" AXIS_PTS_REF InjCrv_facPoI1QntRmpValX_AXIS /end AXIS_DESCR
/end CHARACTERISTIC
/begin CHARACTERISTIC InjCrv_facPoI1QntRmp1Val_GCUR "Faktorisierungskennlinie für die Menge der PoI1" CURVE 0x80049C08 CurG_Ws16 3.999939 CoEOMSwt_S16 -2.000000 1.999939 FORMAT "%8.6"
 /begin AXIS_DESCR COM_AXIS CoEOM_facRmpVal CoEOMSwt_S16 10 -2.000000 1.999939 FORMAT "%8.6" AXIS_PTS_REF InjCrv_facPoI1QntRmpValX_AXIS /end AXIS_DESCR
/end CHARACTERISTIC
/begin AXIS_PTS InjCrv_facPoI1QntRmpValX_AXIS "Gruppenkennlinien-Achse für die Gewichtung des Mengen-Faktors der PoI1" 0x80049C1C CoEOM_facRmpVal Axis_Xs16 3.999939 CoEOMSwt_S16 10 -2.000000 1.999939 FORMAT "%8.6" DEPOSIT ABSOLUTE /end AXIS_PTS
/begin CHARACTERISTIC InjCrv_facPoI1SOERmp0Val_GCUR "Faktorisierungskennlinie für den Einspritzbeginn der PoI1" CURVE 0x80049C32 CurG_Ws16 3.999939 CoEOMSwt_S16 -2.000000 1.999939 FORMAT "%8.6"
 /begin AXIS_DESCR COM_AXIS CoEOM_facRmpVal CoEOMSwt_S16 10 -2.000000 1.999939 FORMAT "%8.6" AXIS_PTS_REF InjCrv_facPoI1SOERmpValX_AXIS /end AXIS_DESCR
/end CHARACTERISTIC
/begin CHARACTERISTIC InjCrv_facPoI1SOERmp1Val_GCUR "Faktorisierungskennlinie für den Einspritzbeginn der PoI1" CURVE 0x80049C46 CurG_Ws16 3.999939 CoEOMSwt_S16 -2.000000 1.999939 FORMAT "%8.6"
 /begin AXIS_DESCR COM_AXIS CoEOM_facRmpVal CoEOMSwt_S16 10 -2.000000 1.999939 FORMAT "%8.6" AXIS_PTS_REF InjCrv_facPoI1SOERmpValX_AXIS /end AXIS_DESCR
/end CHARACTERISTIC
/begin AXIS_PTS InjCrv_facPoI1SOERmpValX_AXIS "Gruppenkennlinien-Achse für die Gewichtung des Einspritzbeginn-Faktors der PoI1" 0x80049C5A CoEOM_facRmpVal Axis_Xs16 3.999939 CoEOMSwt_S16 10 -2.000000 1.999939 FORMAT "%8.6" DEPOSIT ABSOLUTE /end AXIS_PTS
/begin CHARACTERISTIC InjCrv_facPoI2AngRmp0Val_GCUR "Faktorisierungskennlinie für den Einspritzbeginn der PoI2, Winkelkomponente" CURVE 0x8004BB5C CurG_Ws16 3.999939 CoEOMSwt_S16 -2.000000 1.999939 FORMAT "%8.6"
 /begin AXIS_DESCR COM_AXIS CoEOM_facRmpVal CoEOMSwt_S16 10 -2.000000 1.999939 FORMAT "%8.6" AXIS_PTS_REF InjCrv_facPoI2AngRmpValX_AXIS /end AXIS_DESCR
/end CHARACTERISTIC
/begin CHARACTERISTIC InjCrv_facPoI2AngRmp1Val_GCUR "Faktorisierungskennlinie für den Einspritzbeginn der PoI2, Winkelkomponente" CURVE 0x8004BB70 CurG_Ws16 3.999939 CoEOMSwt_S16 -2.000000 1.999939 FORMAT "%8.6"
 /begin AXIS_DESCR COM_AXIS CoEOM_facRmpVal CoEOMSwt_S16 10 -2.000000 1.999939 FORMAT "%8.6" AXIS_PTS_REF InjCrv_facPoI2AngRmpValX_AXIS /end AXIS_DESCR
/end CHARACTERISTIC
/begin AXIS_PTS InjCrv_facPoI2AngRmpValX_AXIS "Gruppenkennlinien-Achse für die Gewichtung des Einspritzbeginn-Faktors der PoI2, Winkelkomponente" 0x8004BB84 CoEOM_facRmpVal Axis_Xs16 3.999939 CoEOMSwt_S16 10 -2.000000 1.999939 FORMAT "%8.6" DEPOSIT ABSOLUTE /end AXIS_PTS
/begin CHARACTERISTIC InjCrv_facPoI2APSQCor0Rgn_GCUR "atmosphärendruckabhängige Mengenkorrekturkennlinie der PoI2 für die Regenerationsstufe 1" CURVE 0x8004AAFE CurG_Ws16 1.000000 Fact 0.00 1.000000 EXTENDED_LIMITS -4.000000 3.999878
 /begin AXIS_DESCR COM_AXIS EnvP_p Pres_hPa 10 0.00 3500.000 EXTENDED_LIMITS -32768.00 32767.00 AXIS_PTS_REF InjCrv_facPoI2APSQCorRgn_AXIS /end AXIS_DESCR
/end CHARACTERISTIC
/begin CHARACTERISTIC InjCrv_facPoI2APSQCor1Rgn_GCUR "atmosphärendruckabhängige Mengenkorrekturkennlinie der PoI2 für die Regenerationsstufe 2" CURVE 0x8004AB12 CurG_Ws16 1.000000 Fact 0.00 1.000000 EXTENDED_LIMITS -4.000000 3.999878
 /begin AXIS_DESCR COM_AXIS EnvP_p Pres_hPa 10 0.00 3500.000 EXTENDED_LIMITS -32768.00 32767.00 AXIS_PTS_REF InjCrv_facPoI2APSQCorRgn_AXIS /end AXIS_DESCR
/end CHARACTERISTIC
/begin AXIS_PTS InjCrv_facPoI2APSQCorRgn_AXIS "gemeinsame Stützstellen für atmosphärendruckabhängige Mengenkorrekturkennlinien der PoI2 für die Regeneration" 0x8004AB26 EnvP_p Axis_Xs16 3500.000 Pres_hPa 10 0.00 3500.000 FORMAT "%8.3" EXTENDED_LIMITS -32768.00 32767.00 DEPOSIT ABSOLUTE /end AXIS_PTS
/begin CHARACTERISTIC InjCrv_facPoI2APSQCorStrt_CUR "Atmosphärendruckabhängige Mengenkorrekturkennlinie für Nacheinspritzung 2 im Startzustand." CURVE 0x8004A98E Cur_Xs16Ws16 1.000000 Fact 0.00 1.000000 EXTENDED_LIMITS -4.000000 3.999878
 /begin AXIS_DESCR STD_AXIS EnvP_p Pres_hPa 6 0.00 3500.000 EXTENDED_LIMITS -32768.00 32767.00 DEPOSIT ABSOLUTE /end AXIS_DESCR
/end CHARACTERISTIC
/begin CHARACTERISTIC InjCrv_facPoI2APSQCor_CUR "Luftdruckabhängige Mengenkorrekturkennlinie für Nacheinspritzung 2" CURVE 0x8004A9A8 Cur_Xs16Ws16 1.000000 Fact 0.00 1.000000 EXTENDED_LIMITS -4.000000 3.999878
 /begin AXIS_DESCR STD_AXIS EnvP_p Pres_hPa 8 0.00 3500.000 EXTENDED_LIMITS -32768.00 32767.00 DEPOSIT ABSOLUTE /end AXIS_DESCR
/end CHARACTERISTIC
/begin CHARACTERISTIC InjCrv_facPoI2APSSOECor0Rgn_GCUR "atmosphärendruckabhängige Ansteuerbeginnkorrekturkennlinie für PoI2 für die Regenerationsstufe 1" CURVE 0x8004AB3C CurG_Ws16 1.000000 Fact 0.00 1.000000 EXTENDED_LIMITS -4.000000 3.999878
 /begin AXIS_DESCR COM_AXIS EnvP_p Pres_hPa 10 0.00 3500.000 EXTENDED_LIMITS -32768.00 32767.00 AXIS_PTS_REF InjCrv_facPoI2APSSOECorRgn_AXIS /end AXIS_DESCR
/end CHARACTERISTIC
/begin CHARACTERISTIC InjCrv_facPoI2APSSOECor1Rgn_GCUR "atmosphärendruckabhängige Ansteuerbeginnkorrekturkennlinie für PoI2 für die Regenerationsstufe 2" CURVE 0x8004AB50 CurG_Ws16 1.000000 Fact 0.00 1.000000 EXTENDED_LIMITS -4.000000 3.999878
 /begin AXIS_DESCR COM_AXIS EnvP_p Pres_hPa 10 0.00 3500.000 EXTENDED_LIMITS -32768.00 32767.00 AXIS_PTS_REF InjCrv_facPoI2APSSOECorRgn_AXIS /end AXIS_DESCR
/end CHARACTERISTIC
/begin AXIS_PTS InjCrv_facPoI2APSSOECorRgn_AXIS "gemeinsame Stützstellen für atmosphärendruckabhängige Ansteuerbeginnkorrekturkennlinien für die PoI2 für die Regeneration" 0x8004AB64 EnvP_p Axis_Xs16 3500.000 Pres_hPa 10 0.00 3500.000 FORMAT "%8.3" EXTENDED_LIMITS -32768.00 32767.00 DEPOSIT ABSOLUTE /end AXIS_PTS
/begin CHARACTERISTIC InjCrv_facPoI2APSSOECor_CUR "Luftdruckabhängige Ansteuerbeginnkorrekturkennlinie für Nacheinspritzung 2" CURVE 0x8004A9CA Cur_Xs16Ws16 1.000000 Fact 0.00 1.000000 EXTENDED_LIMITS -4.000000 3.999878
 /begin AXIS_DESCR STD_AXIS EnvP_p Pres_hPa 8 0.00 3500.000 EXTENDED_LIMITS -32768.00 32767.00 DEPOSIT ABSOLUTE /end AXIS_DESCR
/end CHARACTERISTIC
/begin CHARACTERISTIC InjCrv_facPoI2APSTICor0Rgn_GCUR "atmosphärendruckabhängige Ansteuerbeginn zeit korrekturkennlinie für PoI2 für die Regenerationsstufe 1" CURVE 0x8004AB7A CurG_Ws16 1.000000 Fact 0.00 1.000000 EXTENDED_LIMITS -4.000000 3.999878
 /begin AXIS_DESCR COM_AXIS EnvP_p Pres_hPa 10 0.00 3500.000 EXTENDED_LIMITS -32768.00 32767.00 AXIS_PTS_REF InjCrv_facPoI2APSTICorRgn_AXIS /end AXIS_DESCR
/end CHARACTERISTIC
/begin CHARACTERISTIC InjCrv_facPoI2APSTICor1Rgn_GCUR "atmosphärendruckabhängige Ansteuerbeginn zeit korrekturkennlinie für PoI2 für die Regenerationsstufe 2" CURVE 0x8004AB8E CurG_Ws16 1.000000 Fact 0.00 1.000000 EXTENDED_LIMITS -4.000000 3.999878
 /begin AXIS_DESCR COM_AXIS EnvP_p Pres_hPa 10 0.00 3500.000 EXTENDED_LIMITS -32768.00 32767.00 AXIS_PTS_REF InjCrv_facPoI2APSTICorRgn_AXIS /end AXIS_DESCR
/end CHARACTERISTIC
/begin AXIS_PTS InjCrv_facPoI2APSTICorRgn_AXIS "" 0x8004ABA2 EnvP_p Axis_Xs16 3500.000 Pres_hPa 10 0.00 3500.000 FORMAT "%8.3" EXTENDED_LIMITS -32768.00 32767.00 DEPOSIT ABSOLUTE /end AXIS_PTS
/begin CHARACTERISTIC InjCrv_facPoI2ATSQCor0Rgn_GCUR "umgebungstemperaturabhängige Mengenkorrekturkennlinie für die PoI2 für die Regenerationsstufe 1" CURVE 0x8004ABB8 CurG_Ws16 1.000000 Fact 0.00 1.000000 EXTENDED_LIMITS -4.000000 3.999878
 /begin AXIS_DESCR COM_AXIS InjSys_tAirRgn Temp_Cels 6 -50.14000 199.8600 EXTENDED_LIMITS -3549.940 3003.560 AXIS_PTS_REF InjCrv_facPoI2ATSQCorRgn_AXIS /end AXIS_DESCR
/end CHARACTERISTIC
/begin CHARACTERISTIC InjCrv_facPoI2ATSQCor1Rgn_GCUR "umgebungstemperaturabhängige Mengenkorrekturkennlinie für die PoI2 für die Regenerationsstufe 2" CURVE 0x8004ABC4 CurG_Ws16 1.000000 Fact 0.00 1.000000 EXTENDED_LIMITS -4.000000 3.999878
 /begin AXIS_DESCR COM_AXIS InjSys_tAirRgn Temp_Cels 6 -50.14000 199.8600 EXTENDED_LIMITS -3549.940 3003.560 AXIS_PTS_REF InjCrv_facPoI2ATSQCorRgn_AXIS /end AXIS_DESCR
/end CHARACTERISTIC
/begin AXIS_PTS InjCrv_facPoI2ATSQCorRgn_AXIS "gemeinsame Stützstellen für umgebungstemperaturabhängige Mengenkorrekturkennlinien für die PoI2 für die Regeneration" 0x8004ABD0 InjSys_tAirRgn Axis_Xs16 250.0000 Temp_Cels 6 -50.14000 199.8600 FORMAT "%8.4" EXTENDED_LIMITS -3549.940 3003.560 DEPOSIT ABSOLUTE /end AXIS_PTS
/begin CHARACTERISTIC InjCrv_facPoI2ATSQCorStrt_CUR "Ansauglufttemperaturabhängige Mengenkorrekturkennlinie für Nacheinspritzung 2 im Startzustand." CURVE 0x8004A9EC Cur_Xs16Ws16 1.000000 Fact 0.00 1.000000 EXTENDED_LIMITS -4.000000 3.999878
 /begin AXIS_DESCR STD_AXIS InjCrv_tAirPoI2 Temp_Cels 6 -50.14000 199.8600 EXTENDED_LIMITS -3549.940 3003.560 DEPOSIT ABSOLUTE /end AXIS_DESCR
/end CHARACTERISTIC
/begin CHARACTERISTIC InjCrv_facPoI2ATSQCor_CUR "ansauglufttemperaturabhängige Mengenkorrekturkennlinie für Nacheinspritzung 2" CURVE 0x8004AA06 Cur_Xs16Ws16 1.000000 Fact 0.00 1.000000 EXTENDED_LIMITS -4.000000 3.999878
 /begin AXIS_DESCR STD_AXIS InjCrv_tAirPoI2 Temp_Cels 8 -50.14000 199.8600 EXTENDED_LIMITS -3549.940 3003.560 DEPOSIT ABSOLUTE /end AXIS_DESCR
/end CHARACTERISTIC
/begin CHARACTERISTIC InjCrv_facPoI2ATSSOECor0Rgn_GCUR "luftdruckabhängige Ansteuerbeginnkorrekturkennlinie für PoI2 für die Regenerationsstufe 1" CURVE 0x8004ABDE CurG_Ws16 1.000000 Fact 0.00 1.000000 EXTENDED_LIMITS -4.000000 3.999878
 /begin AXIS_DESCR COM_AXIS InjSys_tAirRgn Temp_Cels 6 -50.14000 199.8600 EXTENDED_LIMITS -3549.940 3003.560 AXIS_PTS_REF InjCrv_facPoI2ATSSOECorRgn_AXIS /end AXIS_DESCR
/end CHARACTERISTIC
/begin CHARACTERISTIC InjCrv_facPoI2ATSSOECor1Rgn_GCUR "luftdruckabhängige Ansteuerbeginnkorrekturkennlinie für PoI2 für die Regenerationsstufe 2" CURVE 0x8004ABEA CurG_Ws16 1.000000 Fact 0.00 1.000000 EXTENDED_LIMITS -4.000000 3.999878
 /begin AXIS_DESCR COM_AXIS InjSys_tAirRgn Temp_Cels 6 -50.14000 199.8600 EXTENDED_LIMITS -3549.940 3003.560 AXIS_PTS_REF InjCrv_facPoI2ATSSOECorRgn_AXIS /end AXIS_DESCR
/end CHARACTERISTIC
/begin AXIS_PTS InjCrv_facPoI2ATSSOECorRgn_AXIS "gemeinsame Stützstellen für ansaugluftdruckabhängigen Ansteuerbeginnkorrekturkennlinien für die PoI2 für die Regeneration" 0x8004ABF6 InjSys_tAirRgn Axis_Xs16 250.0000 Temp_Cels 6 -50.14000 199.8600 FORMAT "%8.4" EXTENDED_LIMITS -3549.940 3003.560 DEPOSIT ABSOLUTE /end AXIS_PTS
/begin CHARACTERISTIC InjCrv_facPoI2ATSSOECor_CUR "ansauglufttemperaturabhängige Ansteuerbeginnkorrekturkennlinie für Nacheinspritzung 2" CURVE 0x8004AA28 Cur_Xs16Ws16 1.000000 Fact 0.00 1.000000 EXTENDED_LIMITS -4.000000 3.999878
 /begin AXIS_DESCR STD_AXIS InjCrv_tAirPoI2 Temp_Cels 8 -50.14000 199.8600 EXTENDED_LIMITS -3549.940 3003.560 DEPOSIT ABSOLUTE /end AXIS_DESCR
/end CHARACTERISTIC
/begin CHARACTERISTIC InjCrv_facPoI2Eff0Rgn_GMAP "" MAP 0x8004AE2E MapG_Ws16 1.000000 Fact 0.00 1.000000 EXTENDED_LIMITS -4.000000 3.999878
 /begin AXIS_DESCR COM_AXIS Epm_nEng EngN 16 0.00 10000.00 EXTENDED_LIMITS -16384.00 16383.50 AXIS_PTS_REF InjCrv_facPoI2EffRgnX_AXIS /end AXIS_DESCR
 /begin AXIS_DESCR COM_AXIS InjCtl_qSetUnBal InjMass 16 0.00 327.6700 EXTENDED_LIMITS -327.6800 327.6700 AXIS_PTS_REF InjCrv_facPoI2EffRgnY_AXIS /end AXIS_DESCR
/end CHARACTERISTIC
/begin CHARACTERISTIC InjCrv_facPoI2Eff1Rgn_GMAP "" MAP 0x8004B02E MapG_Ws16 1.000000 Fact 0.00 1.000000 EXTENDED_LIMITS -4.000000 3.999878
 /begin AXIS_DESCR COM_AXIS Epm_nEng EngN 16 0.00 10000.00 EXTENDED_LIMITS -16384.00 16383.50 AXIS_PTS_REF InjCrv_facPoI2EffRgnX_AXIS /end AXIS_DESCR
 /begin AXIS_DESCR COM_AXIS InjCtl_qSetUnBal InjMass 16 0.00 327.6700 EXTENDED_LIMITS -327.6800 327.6700 AXIS_PTS_REF InjCrv_facPoI2EffRgnY_AXIS /end AXIS_DESCR
/end CHARACTERISTIC
/begin AXIS_PTS InjCrv_facPoI2EffRgnX_AXIS "" 0x8004B22E Epm_nEng Axis_Xs16 10000.00 EngN 16 0.00 10000.00 FORMAT "%8.2" EXTENDED_LIMITS -16384.00 16383.50 DEPOSIT ABSOLUTE /end AXIS_PTS
/begin AXIS_PTS InjCrv_facPoI2EffRgnY_AXIS "" 0x8004B250 InjCtl_qSetUnBal Axis_Xs16 327.6700 InjMass 16 0.00 327.6700 FORMAT "%8.4" EXTENDED_LIMITS -327.6800 327.6700 DEPOSIT ABSOLUTE /end AXIS_PTS
/begin CHARACTERISTIC InjCrv_facPoI2EffRgn_CUR "Faktor für den drehmomentbildenden Anteil der PoI2 im Regenerationsbetrieb" CURVE 0x8004B272 Cur_Xs16Ws16 1.000000 Fact 0.00 1.000000 EXTENDED_LIMITS -4.000000 3.999878
 /begin AXIS_DESCR STD_AXIS InjCrv_qPoI2Des_mp InjMass 12 0.00 10.00000 EXTENDED_LIMITS -327.6800 327.6700 DEPOSIT ABSOLUTE /end AXIS_DESCR
/end CHARACTERISTIC
/begin CHARACTERISTIC InjCrv_facPoI2Eff_MAP "Faktor für Drehmoment bildenden Anteil der Einspritzmenge PoI2" MAP 0x80049D1C Map_Xs16Ys16Ws16 1.000000 Fact 0.00 1.000000 EXTENDED_LIMITS -4.000000 3.999878
 /begin AXIS_DESCR STD_AXIS Epm_nEng EngN 8 0.00 10000.00 EXTENDED_LIMITS -16384.00 16383.50 DEPOSIT ABSOLUTE /end AXIS_DESCR
 /begin AXIS_DESCR STD_AXIS InjCtl_qSetUnBal InjMass 8 0.00 327.6700 EXTENDED_LIMITS -327.6800 327.6700 DEPOSIT ABSOLUTE /end AXIS_DESCR
/end CHARACTERISTIC
/begin CHARACTERISTIC InjCrv_facPoI2ETSQCor0Rgn_GCUR "motortemperaturabhängige Mengenkorrekturkennlinie für die PoI2 für die Regenerationsstufe 1" CURVE 0x8004AC04 CurG_Ws16 1.000000 Fact 0.00 1.000000 EXTENDED_LIMITS -4.000000 3.999878
 /begin AXIS_DESCR COM_AXIS InjSys_tEngRgn Temp_Cels 10 -50.14000 199.8600 EXTENDED_LIMITS -3549.940 3003.560 AXIS_PTS_REF InjCrv_facPoI2ETSQCorRgn_AXIS /end AXIS_DESCR
/end CHARACTERISTIC
/begin CHARACTERISTIC InjCrv_facPoI2ETSQCor1Rgn_GCUR "motortemperaturabhängige Mengenkorrekturkennlinie für die PoI2 für die Regenerationsstufe 2" CURVE 0x8004AC18 CurG_Ws16 1.000000 Fact 0.00 1.000000 EXTENDED_LIMITS -4.000000 3.999878
 /begin AXIS_DESCR COM_AXIS InjSys_tEngRgn Temp_Cels 10 -50.14000 199.8600 EXTENDED_LIMITS -3549.940 3003.560 AXIS_PTS_REF InjCrv_facPoI2ETSQCorRgn_AXIS /end AXIS_DESCR
/end CHARACTERISTIC
/begin AXIS_PTS InjCrv_facPoI2ETSQCorRgn_AXIS "gemeinsame Stützstellen für motortemperaturabhängie Ansteuerbeginnkorrekturkennlinien für die PoI2 für die Regeneration" 0x8004AC2C InjSys_tEngRgn Axis_Xs16 250.0000 Temp_Cels 10 -50.14000 199.8600 FORMAT "%8.4" EXTENDED_LIMITS -3549.940 3003.560 DEPOSIT ABSOLUTE /end AXIS_PTS
/begin CHARACTERISTIC InjCrv_facPoI2ETSQCorStrt_CUR "Motortemperaturabhängige Mengenkorrekturkennlinie für Nacheinspritzung 2 im Startzustand." CURVE 0x8004AA4A Cur_Xs16Ws16 1.000000 Fact 0.00 1.000000 EXTENDED_LIMITS -4.000000 3.999878
 /begin AXIS_DESCR STD_AXIS InjSys_tEng Temp_Cels 8 -50.14000 199.8600 EXTENDED_LIMITS -3549.940 3003.560 DEPOSIT ABSOLUTE /end AXIS_DESCR
/end CHARACTERISTIC
/begin CHARACTERISTIC InjCrv_facPoI2ETSQCor_CUR "motortemperaturabhängige Mengenkorrekturkennlinie für Nacheinspritzung 2" CURVE 0x8004AA6C Cur_Xs16Ws16 1.000000 Fact 0.00 1.000000 EXTENDED_LIMITS -4.000000 3.999878
 /begin AXIS_DESCR STD_AXIS InjSys_tEng Temp_Cels 8 -50.14000 199.8600 EXTENDED_LIMITS -3549.940 3003.560 DEPOSIT ABSOLUTE /end AXIS_DESCR
/end CHARACTERISTIC
/begin CHARACTERISTIC InjCrv_facPoI2ETSSOECor0Rgn_GCUR "motortemperaturabhängige Ansteuerbeginnkorrekturkennlinie für die PoI2 für die Regenerationsstufe 1" CURVE 0x8004AC42 CurG_Ws16 1.000000 Fact 0.00 1.000000 EXTENDED_LIMITS -4.000000 3.999878
 /begin AXIS_DESCR COM_AXIS InjSys_tEngRgn Temp_Cels 10 -50.14000 199.8600 EXTENDED_LIMITS -3549.940 3003.560 AXIS_PTS_REF InjCrv_facPoI2ETSSOECorRgn_AXIS /end AXIS_DESCR
/end CHARACTERISTIC
/begin CHARACTERISTIC InjCrv_facPoI2ETSSOECor1Rgn_GCUR "motortemperaturabhängige Ansteuerbeginnkorrekturkennlinie für die PoI2 für die Regenerationsstufe 2" CURVE 0x8004AC56 CurG_Ws16 1.000000 Fact 0.00 1.000000 EXTENDED_LIMITS -4.000000 3.999878
 /begin AXIS_DESCR COM_AXIS InjSys_tEngRgn Temp_Cels 10 -50.14000 199.8600 EXTENDED_LIMITS -3549.940 3003.560 AXIS_PTS_REF InjCrv_facPoI2ETSSOECorRgn_AXIS /end AXIS_DESCR
/end CHARACTERISTIC
/begin AXIS_PTS InjCrv_facPoI2ETSSOECorRgn_AXIS "gemeinsame Stützstellen für motortemperaturabhängige Ansteuerbeginnkorrekturkennlinien für die PoI2 für die Regeneration" 0x8004AC6A InjSys_tEngRgn Axis_Xs16 250.0000 Temp_Cels 10 -50.14000 199.8600 FORMAT "%8.4" EXTENDED_LIMITS -3549.940 3003.560 DEPOSIT ABSOLUTE /end AXIS_PTS
/begin CHARACTERISTIC InjCrv_facPoI2ETSSOECorStrt_CUR "Motortemperaturabhängige Ansteuerbeginnkorrekturkennlinie für Nacheinspritzung 2 im Startzustand." CURVE 0x8004AA8E Cur_Xs16Ws16 1.000000 Fact 0.00 1.000000 EXTENDED_LIMITS -4.000000 3.999878
 /begin AXIS_DESCR STD_AXIS InjSys_tEng Temp_Cels 6 -50.14000 199.8600 EXTENDED_LIMITS -3549.940 3003.560 DEPOSIT ABSOLUTE /end AXIS_DESCR
/end CHARACTERISTIC
/begin CHARACTERISTIC InjCrv_facPoI2ETSSOECor_CUR "motortemperaturabhängige Ansteuerbeginnkorrekturkennlinie für PoI2" CURVE 0x8004AAA8 Cur_Xs16Ws16 1.000000 Fact 0.00 1.000000 EXTENDED_LIMITS -4.000000 3.999878
 /begin AXIS_DESCR STD_AXIS InjSys_tEng Temp_Cels 8 -50.14000 199.8600 EXTENDED_LIMITS -3549.940 3003.560 DEPOSIT ABSOLUTE /end AXIS_DESCR
/end CHARACTERISTIC
/begin CHARACTERISTIC InjCrv_facPoI2ETSTICor0Rgn_GCUR "motortemperaturabhängige Ansteuerbeginn zeit korrekturkennlinie für die PoI2 für die Regenerationsstufe 1" CURVE 0x8004AC80 CurG_Ws16 1.000000 Fact 0.00 1.000000 EXTENDED_LIMITS -4.000000 3.999878
 /begin AXIS_DESCR COM_AXIS InjSys_tEng Temp_Cels 10 -50.14000 199.8600 EXTENDED_LIMITS -3549.940 3003.560 AXIS_PTS_REF InjCrv_facPoI2ETSTICorRgn_AXIS /end AXIS_DESCR
/end CHARACTERISTIC
/begin CHARACTERISTIC InjCrv_facPoI2ETSTICor1Rgn_GCUR "motortemperaturabhängige Ansteuerbeginn zeit korrekturkennlinie für die PoI2 für die Regenerationsstufe 2" CURVE 0x8004AC94 CurG_Ws16 1.000000 Fact 0.00 1.000000 EXTENDED_LIMITS -4.000000 3.999878
 /begin AXIS_DESCR COM_AXIS InjSys_tEng Temp_Cels 10 -50.14000 199.8600 EXTENDED_LIMITS -3549.940 3003.560 AXIS_PTS_REF InjCrv_facPoI2ETSTICorRgn_AXIS /end AXIS_DESCR
/end CHARACTERISTIC
/begin AXIS_PTS InjCrv_facPoI2ETSTICorRgn_AXIS "" 0x8004ACA8 InjSys_tEng Axis_Xs16 250.0000 Temp_Cels 10 -50.14000 199.8600 FORMAT "%8.4" EXTENDED_LIMITS -3549.940 3003.560 DEPOSIT ABSOLUTE /end AXIS_PTS
/begin CHARACTERISTIC InjCrv_facPoI2QntMin_CUR "Kennlinie zum Abschalten der PoI2 in Abhängigkeit vom Raildruck" CURVE 0x80049DC0 Cur_Xs16Ws16 1.000000 Fact1 0.00 1.000000 EXTENDED_LIMITS -256.0000 255.9922
 /begin AXIS_DESCR STD_AXIS RailP_pFlt Pres_Rail 8 0.00 2000.000 EXTENDED_LIMITS -3276.800 3276.700 DEPOSIT ABSOLUTE /end AXIS_DESCR
/end CHARACTERISTIC
/begin CHARACTERISTIC InjCrv_facPoI2QntRmp0Val_GCUR "Faktorisierungskennlinie für den Menge der PoI2" CURVE 0x8004BB9A CurG_Ws16 3.999939 CoEOMSwt_S16 -2.000000 1.999939 FORMAT "%8.6"
 /begin AXIS_DESCR COM_AXIS CoEOM_facRmpVal CoEOMSwt_S16 10 -2.000000 1.999939 FORMAT "%8.6" AXIS_PTS_REF InjCrv_facPoI2QntRmpValX_AXIS /end AXIS_DESCR
/end CHARACTERISTIC
/begin CHARACTERISTIC InjCrv_facPoI2QntRmp1Val_GCUR "Faktorisierungskennlinie für den Menge der PoI2" CURVE 0x8004BBAE CurG_Ws16 3.999939 CoEOMSwt_S16 -2.000000 1.999939 FORMAT "%8.6"
 /begin AXIS_DESCR COM_AXIS CoEOM_facRmpVal CoEOMSwt_S16 10 -2.000000 1.999939 FORMAT "%8.6" AXIS_PTS_REF InjCrv_facPoI2QntRmpValX_AXIS /end AXIS_DESCR
/end CHARACTERISTIC
/begin AXIS_PTS InjCrv_facPoI2QntRmpValX_AXIS "Gruppenkennlinien-Achse für die Gewichtung des Mengen-Faktors der PoI2" 0x8004BBC2 CoEOM_facRmpVal Axis_Xs16 3.999939 CoEOMSwt_S16 10 -2.000000 1.999939 FORMAT "%8.6" DEPOSIT ABSOLUTE /end AXIS_PTS
/begin CHARACTERISTIC InjCrv_facPoI2SOEtiRmpVal_CUR "Kennlinie zur Anpassung der Rampensteigung von EGT_facRmpVal für den Ansteuerbeginn zeit der PoI2" CURVE 0x8004BBD8 Cur_Xs16Ws16 3.999939 EGTSwt_S16 -2.000000 1.999939 FORMAT "%8.6"
 /begin AXIS_DESCR STD_AXIS CoEOM_facRmpVal CoEOMSwt_S16 2 -2.000000 1.999939 FORMAT "%8.6" DEPOSIT ABSOLUTE /end AXIS_DESCR
/end CHARACTERISTIC
/begin CHARACTERISTIC InjCrv_facPoI2TiRmp0Val_GCUR "Faktorisierungskennlinie für den Einspritzbeginn der PoI2, Zeitkomponente" CURVE 0x8004BBE2 CurG_Ws16 3.999939 CoEOMSwt_S16 -2.000000 1.999939 FORMAT "%8.6"
 /begin AXIS_DESCR COM_AXIS CoEOM_facRmpVal CoEOMSwt_S16 10 -2.000000 1.999939 FORMAT "%8.6" AXIS_PTS_REF InjCrv_facPoI2TiRmpValX_AXIS /end AXIS_DESCR
/end CHARACTERISTIC
/begin CHARACTERISTIC InjCrv_facPoI2TiRmp1Val_GCUR "Faktorisierungskennlinie für den Einspritzbeginn der PoI2, Zeitkomponente" CURVE 0x8004BBF6 CurG_Ws16 3.999939 CoEOMSwt_S16 -2.000000 1.999939 FORMAT "%8.6"
 /begin AXIS_DESCR COM_AXIS CoEOM_facRmpVal CoEOMSwt_S16 10 -2.000000 1.999939 FORMAT "%8.6" AXIS_PTS_REF InjCrv_facPoI2TiRmpValX_AXIS /end AXIS_DESCR
/end CHARACTERISTIC
/begin AXIS_PTS InjCrv_facPoI2TiRmpValX_AXIS "Gruppenkennlinien-Achse für die Gewichtung des Einspritzbeginn-Faktors der PoI2, Zeitkomponente" 0x8004BC0A CoEOM_facRmpVal Axis_Xs16 3.999939 CoEOMSwt_S16 10 -2.000000 1.999939 FORMAT "%8.6" DEPOSIT ABSOLUTE /end AXIS_PTS
/begin CHARACTERISTIC InjCrv_facPOpPoI2ETSCorStrt_CUR "Motortemperaturabhängige Freigabekorrekturkennlinie für Nacheinspritzung 2 im Startzustand." CURVE 0x8004AACA Cur_Xs16Ws16 1.000000 Fact 0.00 1.000000 EXTENDED_LIMITS -4.000000 3.999878
 /begin AXIS_DESCR STD_AXIS InjSys_tEng Temp_Cels 6 -50.14000 199.8600 EXTENDED_LIMITS -3549.940 3003.560 DEPOSIT ABSOLUTE /end AXIS_DESCR
/end CHARACTERISTIC
/begin CHARACTERISTIC InjCrv_facPOpPoI2ETSCor_CUR "motortemperaturabhängige Freigabekorrekturkennlinie für PoI2" CURVE 0x8004AAE4 Cur_Xs16Ws16 1.000000 Fact 0.00 1.000000 EXTENDED_LIMITS -4.000000 3.999878
 /begin AXIS_DESCR STD_AXIS InjSys_tEng Temp_Cels 6 -50.14000 199.8600 EXTENDED_LIMITS -3549.940 3003.560 DEPOSIT ABSOLUTE /end AXIS_DESCR
/end CHARACTERISTIC
/begin CHARACTERISTIC InjCrv_nMaxShOffTst_C "maximal zulässige Drehzahl für zylinderselektiven Einspritzabschalttest" VALUE 0x8004C20E Val_Ws16 10000.00 EngN 0.00 10000.00 EXTENDED_LIMITS -16384.00 16383.50 /end CHARACTERISTIC
/begin CHARACTERISTIC InjCrv_phiPoI2APSCor0Rgn_GMAP "Basiswinkelkorrekturkennfeld abhängig von dem Umgebungsluftdruck für die PoI2 für die Regenerationsstufe 1" MAP 0x8004A3CC MapG_Ws16 39.99023 AngleCrS -39.99023 0.00 EXTENDED_LIMITS -720.0000 719.9780
 /begin AXIS_DESCR COM_AXIS Epm_nEng EngN 2 0.00 10000.00 EXTENDED_LIMITS -16384.00 16383.50 AXIS_PTS_REF InjCrv_phiPoI2APSCorRgnX_AXIS /end AXIS_DESCR
 /begin AXIS_DESCR COM_AXIS InjCtl_qSetUnBal InjMass 2 0.00 327.6700 EXTENDED_LIMITS -327.6800 327.6700 AXIS_PTS_REF InjCrv_phiPoI2APSCorRgnY_AXIS /end AXIS_DESCR
/end CHARACTERISTIC
/begin CHARACTERISTIC InjCrv_phiPoI2APSCor1Rgn_GMAP "Basiswinkelkorrekturkennfeld abhängig von dem Umgebungsluftdruck für die PoI2 für die Regenerationsstufe 2" MAP 0x8004A3D4 MapG_Ws16 39.99023 AngleCrS -39.99023 0.00 EXTENDED_LIMITS -720.0000 719.9780
 /begin AXIS_DESCR COM_AXIS Epm_nEng EngN 2 0.00 10000.00 EXTENDED_LIMITS -16384.00 16383.50 AXIS_PTS_REF InjCrv_phiPoI2APSCorRgnX_AXIS /end AXIS_DESCR
 /begin AXIS_DESCR COM_AXIS InjCtl_qSetUnBal InjMass 2 0.00 327.6700 EXTENDED_LIMITS -327.6800 327.6700 AXIS_PTS_REF InjCrv_phiPoI2APSCorRgnY_AXIS /end AXIS_DESCR
/end CHARACTERISTIC
/begin AXIS_PTS InjCrv_phiPoI2APSCorRgnX_AXIS "Stützstellenverteilung für die Gruppenkennfelder InjCrv_phiPoI2APSSOECor%Rgn_GMAP" 0x8004A3DC Epm_nEng Axis_Xs16 10000.00 EngN 2 0.00 10000.00 FORMAT "%8.2" EXTENDED_LIMITS -16384.00 16383.50 DEPOSIT ABSOLUTE /end AXIS_PTS
/begin AXIS_PTS InjCrv_phiPoI2APSCorRgnY_AXIS "Stützstellenverteilung für die Gruppenkennfelder InjCrv_phiPoI2APSSOECor%Rgn_GMAP" 0x8004A3E2 InjCtl_qSetUnBal Axis_Xs16 327.6700 InjMass 2 0.00 327.6700 FORMAT "%8.4" EXTENDED_LIMITS -327.6800 327.6700 DEPOSIT ABSOLUTE /end AXIS_PTS
/begin CHARACTERISTIC InjCrv_phiPoI2ATSCor0Rgn_GMAP "Basiswinkelkorrekturkennfeld abhängig von der Ansauglufttemperatur für die PoI2 für die Regenerationsstufe 1" MAP 0x8004A3E8 MapG_Ws16 39.99023 AngleCrS -39.99023 0.00 EXTENDED_LIMITS -720.0000 719.9780
 /begin AXIS_DESCR COM_AXIS Epm_nEng EngN 2 0.00 10000.00 EXTENDED_LIMITS -16384.00 16383.50 AXIS_PTS_REF InjCrv_phiPoI2ATSCorRgnX_AXIS /end AXIS_DESCR
 /begin AXIS_DESCR COM_AXIS InjCtl_qSetUnBal InjMass 2 0.00 327.6700 EXTENDED_LIMITS -327.6800 327.6700 AXIS_PTS_REF InjCrv_phiPoI2ATSCorRgnY_AXIS /end AXIS_DESCR
/end CHARACTERISTIC
/begin CHARACTERISTIC InjCrv_phiPoI2ATSCor1Rgn_GMAP "Basiswinkelkorrekturkennfeld abhängig von der Ansauglufttemperatur für die PoI2 für die Regenerationsstufe 2" MAP 0x8004A3F0 MapG_Ws16 39.99023 AngleCrS -39.99023 0.00 EXTENDED_LIMITS -720.0000 719.9780
 /begin AXIS_DESCR COM_AXIS Epm_nEng EngN 2 0.00 10000.00 EXTENDED_LIMITS -16384.00 16383.50 AXIS_PTS_REF InjCrv_phiPoI2ATSCorRgnX_AXIS /end AXIS_DESCR
 /begin AXIS_DESCR COM_AXIS InjCtl_qSetUnBal InjMass 2 0.00 327.6700 EXTENDED_LIMITS -327.6800 327.6700 AXIS_PTS_REF InjCrv_phiPoI2ATSCorRgnY_AXIS /end AXIS_DESCR
/end CHARACTERISTIC
/begin AXIS_PTS InjCrv_phiPoI2ATSCorRgnX_AXIS "Stützstellenverteilung für die Gruppenkennfelder InjCrv_phiPoI2ATSCor%Rgn_GMAP" 0x8004A3F8 Epm_nEng Axis_Xs16 10000.00 EngN 2 0.00 10000.00 FORMAT "%8.2" EXTENDED_LIMITS -16384.00 16383.50 DEPOSIT ABSOLUTE /end AXIS_PTS
/begin AXIS_PTS InjCrv_phiPoI2ATSCorRgnY_AXIS "Stützstellenverteilung für die Gruppenkennfelder InjCrv_phiPoI2ATSCor%Rgn_GMAP" 0x8004A3FE InjCtl_qSetUnBal Axis_Xs16 327.6700 InjMass 2 0.00 327.6700 FORMAT "%8.4" EXTENDED_LIMITS -327.6800 327.6700 DEPOSIT ABSOLUTE /end AXIS_PTS
/begin CHARACTERISTIC InjCrv_phiPoI2Bas0Rgn_GMAP "Gruppenkennfeld für den Basiswinkel des Ansteuerbeginns für die PoI2 für die Regenerationsstufe 1" MAP 0x8004B2A4 MapG_Ws16 39.99023 AngleCrS -39.99023 0.00 EXTENDED_LIMITS -720.0000 719.9780
 /begin AXIS_DESCR COM_AXIS Epm_nEng EngN 2 0.00 10000.00 EXTENDED_LIMITS -16384.00 16383.50 AXIS_PTS_REF InjCrv_phiPoI2BasRgnX_AXIS /end AXIS_DESCR
 /begin AXIS_DESCR COM_AXIS InjCtl_qSetUnBal InjMass 2 0.00 327.6700 EXTENDED_LIMITS -327.6800 327.6700 AXIS_PTS_REF InjCrv_phiPoI2BasRgnY_AXIS /end AXIS_DESCR
/end CHARACTERISTIC
/begin CHARACTERISTIC InjCrv_phiPoI2Bas1Rgn_GMAP "Gruppenkennfeld für den Basiswinkel des Ansteuerbeginns für die PoI2 für die Regenerationsstufe 2" MAP 0x8004B2AC MapG_Ws16 39.99023 AngleCrS -39.99023 0.00 EXTENDED_LIMITS -720.0000 719.9780
 /begin AXIS_DESCR COM_AXIS Epm_nEng EngN 2 0.00 10000.00 EXTENDED_LIMITS -16384.00 16383.50 AXIS_PTS_REF InjCrv_phiPoI2BasRgnX_AXIS /end AXIS_DESCR
 /begin AXIS_DESCR COM_AXIS InjCtl_qSetUnBal InjMass 2 0.00 327.6700 EXTENDED_LIMITS -327.6800 327.6700 AXIS_PTS_REF InjCrv_phiPoI2BasRgnY_AXIS /end AXIS_DESCR
/end CHARACTERISTIC
/begin AXIS_PTS InjCrv_phiPoI2BasRgnX_AXIS "Stützstellenverteilung für die Gruppenkennfelder InjCrv_phiPoI2Bas%Rgn_GMAP" 0x8004B2B4 Epm_nEng Axis_Xs16 10000.00 EngN 2 0.00 10000.00 FORMAT "%8.2" EXTENDED_LIMITS -16384.00 16383.50 DEPOSIT ABSOLUTE /end AXIS_PTS
/begin AXIS_PTS InjCrv_phiPoI2BasRgnY_AXIS "Stützstellenverteilung für die Gruppenkennfelder InjCrv_phiPoI2Bas%Rgn_GMAP" 0x8004B2BA InjCtl_qSetUnBal Axis_Xs16 327.6700 InjMass 2 0.00 327.6700 FORMAT "%8.4" EXTENDED_LIMITS -327.6800 327.6700 DEPOSIT ABSOLUTE /end AXIS_PTS
/begin CHARACTERISTIC InjCrv_phiPoI2Des_C "Fernsteuerwert des Ansteuerbeginns (Winkelkomponente) der PoI2" VALUE 0x80049DE2 Val_Ws16 39.99023 AngleCrS -39.99023 0.00 EXTENDED_LIMITS -720.0000 719.9780 /end CHARACTERISTIC
/begin CHARACTERISTIC InjCrv_phiPoI2ETSCor0Rgn_GMAP "Basiswinkelkorrekturkennfeld abhängig von der Motortemperatur für die PoI2 für die Regenerationsstufe 1" MAP 0x8004A404 MapG_Ws16 39.99023 AngleCrS -39.99023 0.00 EXTENDED_LIMITS -720.0000 719.9780
 /begin AXIS_DESCR COM_AXIS Epm_nEng EngN 2 0.00 10000.00 EXTENDED_LIMITS -16384.00 16383.50 AXIS_PTS_REF InjCrv_phiPoI2ETSCorRgnX_AXIS /end AXIS_DESCR
 /begin AXIS_DESCR COM_AXIS InjCtl_qSetUnBal InjMass 2 0.00 327.6700 EXTENDED_LIMITS -327.6800 327.6700 AXIS_PTS_REF InjCrv_phiPoI2ETSCorRgnY_AXIS /end AXIS_DESCR
/end CHARACTERISTIC
/begin CHARACTERISTIC InjCrv_phiPoI2ETSCor1Rgn_GMAP "Basiswinkelkorrekturkennfeld abhängig von der Motortemperatur für die PoI2 für die Regenerationsstufe 2" MAP 0x8004A40C MapG_Ws16 39.99023 AngleCrS -39.99023 0.00 EXTENDED_LIMITS -720.0000 719.9780
 /begin AXIS_DESCR COM_AXIS Epm_nEng EngN 2 0.00 10000.00 EXTENDED_LIMITS -16384.00 16383.50 AXIS_PTS_REF InjCrv_phiPoI2ETSCorRgnX_AXIS /end AXIS_DESCR
 /begin AXIS_DESCR COM_AXIS InjCtl_qSetUnBal InjMass 2 0.00 327.6700 EXTENDED_LIMITS -327.6800 327.6700 AXIS_PTS_REF InjCrv_phiPoI2ETSCorRgnY_AXIS /end AXIS_DESCR
/end CHARACTERISTIC
/begin AXIS_PTS InjCrv_phiPoI2ETSCorRgnX_AXIS "Stützstellenverteilung für die Gruppenkennfelder InjCrv_phiPoI2ETSSOECor%Rgn_GMAP" 0x8004A414 Epm_nEng Axis_Xs16 10000.00 EngN 2 0.00 10000.00 FORMAT "%8.2" EXTENDED_LIMITS -16384.00 16383.50 DEPOSIT ABSOLUTE /end AXIS_PTS
/begin AXIS_PTS InjCrv_phiPoI2ETSCorRgnY_AXIS "Stützstellenverteilung für die Gruppenkennfelder InjCrv_phiPoI2ETSSOECor%Rgn_GMAP" 0x8004A41A InjCtl_qSetUnBal Axis_Xs16 327.6700 InjMass 2 0.00 327.6700 FORMAT "%8.4" EXTENDED_LIMITS -327.6800 327.6700 DEPOSIT ABSOLUTE /end AXIS_PTS
/begin CHARACTERISTIC InjCrv_phiPoI2HysOilDil_C "Hysterese des spätesten Ansteuerbeginns der PoI2 bei Vorliegen einer Abschaltanforderung aufgrund Ölverdünnung" VALUE 0x8004BE68 Val_Ws16 19.99512 AngleCrS 0.00 19.99512 EXTENDED_LIMITS -720.0000 719.9780 /end CHARACTERISTIC
/begin CHARACTERISTIC InjCrv_phiPoI2MaxRgn_MAP "Kennlinie für Grenzwert der Winkelkomponente Ansteuerbeginn PoI2 im Regenerationsbetrieb" MAP 0x8004B2C0 Map_Xs16Ys16Ws16 39.99023 AngleCrS -39.99023 0.00 EXTENDED_LIMITS -720.0000 719.9780
 /begin AXIS_DESCR STD_AXIS Epm_nEng EngN 2 0.00 10000.00 EXTENDED_LIMITS -16384.00 16383.50 DEPOSIT ABSOLUTE /end AXIS_DESCR
 /begin AXIS_DESCR STD_AXIS InjCtl_qSetUnBal InjMass 2 0.00 327.6700 EXTENDED_LIMITS -327.6800 327.6700 DEPOSIT ABSOLUTE /end AXIS_DESCR
/end CHARACTERISTIC
/begin CHARACTERISTIC InjCrv_phiPoI2MinOilDil_CUR "Kennlinie für den spätesten Ansteuerbeginn der PoI2 bei Vorliegen einer Abschaltanforderung aufgrund Ölverdünnung" CURVE 0x8004BE6A Cur_Xs16Ws16 759.9683 AngleCrS -39.99023 719.9780 EXTENDED_LIMITS -720.0000 719.9780
 /begin AXIS_DESCR STD_AXIS InjCrv_qPoI2Des_mp InjMass 6 0.00 10.00000 EXTENDED_LIMITS -327.6800 327.6700 DEPOSIT ABSOLUTE /end AXIS_DESCR
/end CHARACTERISTIC
/begin CHARACTERISTIC InjCrv_phiPoI2Min_C "minimaler Ansteuerbeginn PoI2 relativ zum oberen Totpunkt" VALUE 0x80049DE4 Val_Ws16 39.99023 AngleCrS -39.99023 0.00 EXTENDED_LIMITS -720.0000 719.9780 /end CHARACTERISTIC
/begin CHARACTERISTIC InjCrv_phiPoI2ReplNrm_MAP "Ersatzwert für den SOE-Winkel der PoI2, wenn der Normalbetrieb in Zeitapplikation dargestellt ist." MAP 0x8004BC20 Map_Xs16Ys16Ws16 39.99023 AngleCrS -39.99023 0.00 EXTENDED_LIMITS -720.0000 719.9780
 /begin AXIS_DESCR STD_AXIS Epm_nEng EngN 16 0.00 10000.00 EXTENDED_LIMITS -16384.00 16383.50 DEPOSIT ABSOLUTE /end AXIS_DESCR
 /begin AXIS_DESCR STD_AXIS InjCtl_qSetUnBal InjMass 16 0.00 327.6700 EXTENDED_LIMITS -327.6800 327.6700 DEPOSIT ABSOLUTE /end AXIS_DESCR
/end CHARACTERISTIC
/begin CHARACTERISTIC InjCrv_POpPoI1Bas_MAP "Grundwert Freigabe PoI1" MAP 0x80049C70 Map_Xs16Ys16Ws16 100.0000 OneToOne 0.00 100.0000 EXTENDED_LIMITS -32768.00 32767.00
 /begin AXIS_DESCR STD_AXIS Epm_nEng EngN 2 0.00 10000.00 EXTENDED_LIMITS -16384.00 16383.50 DEPOSIT ABSOLUTE /end AXIS_DESCR
 /begin AXIS_DESCR STD_AXIS InjCtl_qSetUnBal InjMass 2 0.00 327.6700 EXTENDED_LIMITS -327.6800 327.6700 DEPOSIT ABSOLUTE /end AXIS_DESCR
/end CHARACTERISTIC
/begin CHARACTERISTIC InjCrv_POpPoI1ETSCor_CUR "motortemperaturabhängige Freigabekorrekturkennlinie für PoI1" CURVE 0x80048EF0 Cur_Xs16Ws16 100.0000 OneToOne 0.00 100.0000 EXTENDED_LIMITS -32768.00 32767.00
 /begin AXIS_DESCR STD_AXIS InjSys_tEng Temp_Cels 1 -50.14000 199.8600 EXTENDED_LIMITS -3549.940 3003.560 DEPOSIT ABSOLUTE /end AXIS_DESCR
/end CHARACTERISTIC
/begin CHARACTERISTIC InjCrv_POpPoI1High_C "obere Hystereseschwelle des Grundwertes Freigabe PoI1" VALUE 0x80049C84 Val_Ws16 100.0000 OneToOne 0.00 100.0000 EXTENDED_LIMITS -32768.00 32767.00 /end CHARACTERISTIC
/begin CHARACTERISTIC InjCrv_POpPoI1Low_C "Untere Hystereseschwelle des Grundwertes Freigabe PoI1" VALUE 0x80049C86 Val_Ws16 100.0000 OneToOne 0.00 100.0000 EXTENDED_LIMITS -32768.00 32767.00 /end CHARACTERISTIC
/begin CHARACTERISTIC InjCrv_POpPoI1RgnHigh_C "Obere Hystereseschwelle des Grundwertes Freigabe PoI1 im Regenerationsbetrieb" VALUE 0x80049C88 Val_Ws16 100.0000 OneToOne 0.00 100.0000 EXTENDED_LIMITS -32768.00 32767.00 /end CHARACTERISTIC
/begin CHARACTERISTIC InjCrv_POpPoI1RgnLow_C "Untere Hystereseschwelle des Grundwertes Freigabe PoI1 im Regenerationsbetrieb" VALUE 0x80049C8A Val_Ws16 100.0000 OneToOne 0.00 100.0000 EXTENDED_LIMITS -32768.00 32767.00 /end CHARACTERISTIC
/begin CHARACTERISTIC InjCrv_POpPoI1Rgn_MAP "Grundwert Freigabe PoI1 im Regenerationsbetrieb" MAP 0x80049C8C Map_Xs16Ys16Ws16 100.0000 OneToOne 0.00 100.0000 EXTENDED_LIMITS -32768.00 32767.00
 /begin AXIS_DESCR STD_AXIS Epm_nEng EngN 6 0.00 10000.00 EXTENDED_LIMITS -16384.00 16383.50 DEPOSIT ABSOLUTE /end AXIS_DESCR
 /begin AXIS_DESCR STD_AXIS InjCtl_qSetUnBal InjMass 6 0.00 327.6700 EXTENDED_LIMITS -327.6800 327.6700 DEPOSIT ABSOLUTE /end AXIS_DESCR
/end CHARACTERISTIC
/begin CHARACTERISTIC InjCrv_POpPoI2BasStrt_MAP "Basis MAP für PoI2 Freigabe basierend auf dem Betriebspunkt während des Motorstarts" MAP 0x8004BFCC Map_Xs16Ys16Ws16 100.0000 OneToOne 0.00 100.0000 EXTENDED_LIMITS -32768.00 32767.00
 /begin AXIS_DESCR STD_AXIS Epm_nEng EngN 8 0.00 10000.00 EXTENDED_LIMITS -16384.00 16383.50 DEPOSIT ABSOLUTE /end AXIS_DESCR
 /begin AXIS_DESCR STD_AXIS InjCtl_qSetUnBal InjMass 8 0.00 327.6700 EXTENDED_LIMITS -327.6800 327.6700 DEPOSIT ABSOLUTE /end AXIS_DESCR
/end CHARACTERISTIC
/begin CHARACTERISTIC InjCrv_POpPoI2Bas_MAP "Basiskennfeld für die betriebspunktabhängige Freigabe der PoI2" MAP 0x8004BE84 Map_Xs16Ys16Ws16 100.0000 OneToOne 0.00 100.0000 EXTENDED_LIMITS -32768.00 32767.00
 /begin AXIS_DESCR STD_AXIS Epm_nEng EngN 2 0.00 10000.00 EXTENDED_LIMITS -16384.00 16383.50 DEPOSIT ABSOLUTE /end AXIS_DESCR
 /begin AXIS_DESCR STD_AXIS InjCtl_qSetUnBal InjMass 2 0.00 327.6700 EXTENDED_LIMITS -327.6800 327.6700 DEPOSIT ABSOLUTE /end AXIS_DESCR
/end CHARACTERISTIC
/begin CHARACTERISTIC InjCrv_POpPoI2ETSCorStrt_MAP "Motortemperaturabhängiges Freigabekorrekturkennfeld für PoI2 im Startzustand." MAP 0x8004A03C Map_Xs16Ys16Ws16 100.0000 OneToOne 0.00 100.0000 EXTENDED_LIMITS -32768.00 32767.00
 /begin AXIS_DESCR STD_AXIS Epm_nEng EngN 2 0.00 10000.00 EXTENDED_LIMITS -16384.00 16383.50 DEPOSIT ABSOLUTE /end AXIS_DESCR
 /begin AXIS_DESCR STD_AXIS InjCtl_qSetUnBal InjMass 2 0.00 100.0000 EXTENDED_LIMITS -327.6800 327.6700 DEPOSIT ABSOLUTE /end AXIS_DESCR
/end CHARACTERISTIC
/begin CHARACTERISTIC InjCrv_POpPoI2ETSCor_MAP "Motortemperaturabhängiges Freigabekorrekturkennfeld für PoI2" MAP 0x8004A050 Map_Xs16Ys16Ws16 100.0000 OneToOne 0.00 100.0000 EXTENDED_LIMITS -32768.00 32767.00
 /begin AXIS_DESCR STD_AXIS Epm_nEng EngN 2 0.00 10000.00 EXTENDED_LIMITS -16384.00 16383.50 DEPOSIT ABSOLUTE /end AXIS_DESCR
 /begin AXIS_DESCR STD_AXIS InjCtl_qSetUnBal InjMass 2 0.00 327.6700 EXTENDED_LIMITS -327.6800 327.6700 DEPOSIT ABSOLUTE /end AXIS_DESCR
/end CHARACTERISTIC
/begin CHARACTERISTIC InjCrv_POpPoI2HighStrt_C "Feigabe PoI2 über Betriebspunkt, obere Hystereseschwelle im Startzustand" VALUE 0x8004C070 Val_Ws16 100.0000 OneToOne 0.00 100.0000 EXTENDED_LIMITS -32768.00 32767.00 /end CHARACTERISTIC
/begin CHARACTERISTIC InjCrv_POpPoI2High_C "Freigabe PoI2 über Betriebspunkt, obere Hystereseschwelle" VALUE 0x8004BE98 Val_Ws16 100.0000 OneToOne 0.00 100.0000 EXTENDED_LIMITS -32768.00 32767.00 /end CHARACTERISTIC
/begin CHARACTERISTIC InjCrv_POpPoI2LowStrt_C "Freigabe PoI2 über Betriebspunkt, untere Hystereseschwelle im Startzustand" VALUE 0x8004C072 Val_Ws16 100.0000 OneToOne 0.00 100.0000 EXTENDED_LIMITS -32768.00 32767.00 /end CHARACTERISTIC
/begin CHARACTERISTIC InjCrv_POpPoI2Low_C "Freigabe PoI2 über Betriebspunkt, untere Hystereseschwelle" VALUE 0x8004BE9A Val_Ws16 100.0000 OneToOne 0.00 100.0000 EXTENDED_LIMITS -32768.00 32767.00 /end CHARACTERISTIC
/begin CHARACTERISTIC InjCrv_POpPoI2RgnHigh_C "Obere Hystereseschwelle des Grundwertes Freigabe PoI2 im Regenerationsbetrieb" VALUE 0x8004BE9C Val_Ws16 100.0000 OneToOne 0.00 100.0000 EXTENDED_LIMITS -32768.00 32767.00 /end CHARACTERISTIC
/begin CHARACTERISTIC InjCrv_POpPoI2RgnLow_C "Untere Hystereseschwelle des Grundwertes Freigabe PoI2 im Regenerationsbetrieb" VALUE 0x8004BE9E Val_Ws16 100.0000 OneToOne 0.00 100.0000 EXTENDED_LIMITS -32768.00 32767.00 /end CHARACTERISTIC
/begin CHARACTERISTIC InjCrv_POpPoI2Rgn_MAP "Grundwert Freigabe PoI2 im Regenerationsbetrieb" MAP 0x8004BEA0 Map_Xs16Ys16Ws16 100.0000 OneToOne 0.00 100.0000 EXTENDED_LIMITS -32768.00 32767.00
 /begin AXIS_DESCR STD_AXIS Epm_nEng EngN 2 0.00 10000.00 EXTENDED_LIMITS -16384.00 16383.50 DEPOSIT ABSOLUTE /end AXIS_DESCR
 /begin AXIS_DESCR STD_AXIS InjCtl_qSetUnBal InjMass 2 0.00 327.6700 EXTENDED_LIMITS -327.6800 327.6700 DEPOSIT ABSOLUTE /end AXIS_DESCR
/end CHARACTERISTIC
/begin CHARACTERISTIC InjCrv_qMin_CUR "Kennlinie für die Berechnung der Minimalmenge einer Einspritzung" CURVE 0x8004C1CC Cur_Xs16Ws16 327.6700 InjMass 0.00 327.6700 EXTENDED_LIMITS -327.6800 327.6700
 /begin AXIS_DESCR STD_AXIS RailP_pFlt Pres_Rail 16 0.00 2000.000 EXTENDED_LIMITS -3276.800 3276.700 DEPOSIT ABSOLUTE /end AXIS_DESCR
/end CHARACTERISTIC
/begin CHARACTERISTIC InjCrv_qPoI1APSCor_MAP "atmosphärendruckabhängiges Mengenkorrekturkennfeld für PoI1" MAP 0x80048E8E Map_Xs16Ys16Ws16 10.00000 InjMass 0.00 10.00000 EXTENDED_LIMITS -327.6800 327.6700
 /begin AXIS_DESCR STD_AXIS Epm_nEng EngN 2 0.00 10000.00 EXTENDED_LIMITS -16384.00 16383.50 DEPOSIT ABSOLUTE /end AXIS_DESCR
 /begin AXIS_DESCR STD_AXIS InjCtl_qSetUnBal InjMass 2 0.00 327.6700 EXTENDED_LIMITS -327.6800 327.6700 DEPOSIT ABSOLUTE /end AXIS_DESCR
/end CHARACTERISTIC
/begin CHARACTERISTIC InjCrv_qPoI1Bas0Rgn_GMAP "Kennfeld für Basiswert für die Mengenkorrektur der PoI1 für die Regenerationsstufe 1" MAP 0x8004936C MapG_Ws16 10.00000 InjMass 0.00 10.00000 EXTENDED_LIMITS -327.6800 327.6700
 /begin AXIS_DESCR COM_AXIS Epm_nEng EngN 16 0.00 10000.00 EXTENDED_LIMITS -16384.00 16383.50 AXIS_PTS_REF InjCrv_qPoI1BasRgnX_AXIS /end AXIS_DESCR
 /begin AXIS_DESCR COM_AXIS InjCtl_qSetUnBal InjMass 16 0.00 327.6700 EXTENDED_LIMITS -327.6800 327.6700 AXIS_PTS_REF InjCrv_qPoI1BasRgnY_AXIS /end AXIS_DESCR
/end CHARACTERISTIC
/begin CHARACTERISTIC InjCrv_qPoI1Bas1Rgn_GMAP "Kennfeld für Basiswert für die Mengenkorrektur der PoI1 für die Regenerationsstufe 2" MAP 0x8004956C MapG_Ws16 10.00000 InjMass 0.00 10.00000 EXTENDED_LIMITS -327.6800 327.6700
 /begin AXIS_DESCR COM_AXIS Epm_nEng EngN 16 0.00 10000.00 EXTENDED_LIMITS -16384.00 16383.50 AXIS_PTS_REF InjCrv_qPoI1BasRgnX_AXIS /end AXIS_DESCR
 /begin AXIS_DESCR COM_AXIS InjCtl_qSetUnBal InjMass 16 0.00 327.6700 EXTENDED_LIMITS -327.6800 327.6700 AXIS_PTS_REF InjCrv_qPoI1BasRgnY_AXIS /end AXIS_DESCR
/end CHARACTERISTIC
/begin AXIS_PTS InjCrv_qPoI1BasRgnX_AXIS "Stützstellenverteilung für die Gruppenkennfelder InjCrv_qPoI1Bas%Rgn_GMAP" 0x8004976C Epm_nEng Axis_Xs16 10000.00 EngN 16 0.00 10000.00 FORMAT "%8.2" EXTENDED_LIMITS -16384.00 16383.50 DEPOSIT ABSOLUTE /end AXIS_PTS
/begin AXIS_PTS InjCrv_qPoI1BasRgnY_AXIS "Stützstellenverteilung für die Gruppenkennfelder InjCrv_qPoI1Bas%Rgn_GMAP" 0x8004978E InjCtl_qSetUnBal Axis_Xs16 327.6700 InjMass 16 0.00 327.6700 FORMAT "%8.4" EXTENDED_LIMITS -327.6800 327.6700 DEPOSIT ABSOLUTE /end AXIS_PTS
/begin CHARACTERISTIC InjCrv_qPoI1ETSCor_MAP "motortemperaturabhängiges Mengenkorrekturkennfeld für PoI1" MAP 0x80048EA2 Map_Xs16Ys16Ws16 10.00000 InjMass 0.00 10.00000 EXTENDED_LIMITS -327.6800 327.6700
 /begin AXIS_DESCR STD_AXIS Epm_nEng EngN 2 0.00 10000.00 EXTENDED_LIMITS -16384.00 16383.50 DEPOSIT ABSOLUTE /end AXIS_DESCR
 /begin AXIS_DESCR STD_AXIS InjCtl_qSetUnBal InjMass 2 0.00 327.6700 EXTENDED_LIMITS -327.6800 327.6700 DEPOSIT ABSOLUTE /end AXIS_DESCR
/end CHARACTERISTIC
/begin CHARACTERISTIC InjCrv_qPoI2APSCor0Rgn_GMAP "Basismengenkorrekturkennfelder abhängig von dem Druck für die PoI2 für die Regenerationsstufe 1" MAP 0x8004A420 MapG_Ws16 10.00000 InjMass 0.00 10.00000 EXTENDED_LIMITS -327.6800 327.6700
 /begin AXIS_DESCR COM_AXIS Epm_nEng EngN 10 0.00 10000.00 EXTENDED_LIMITS -16384.00 16383.50 AXIS_PTS_REF InjCrv_qPoI2APSCorRgnX_AXIS /end AXIS_DESCR
 /begin AXIS_DESCR COM_AXIS InjCtl_qSetUnBal InjMass 10 0.00 327.6700 EXTENDED_LIMITS -327.6800 327.6700 AXIS_PTS_REF InjCrv_qPoI2APSCorRgnY_AXIS /end AXIS_DESCR
/end CHARACTERISTIC
/begin CHARACTERISTIC InjCrv_qPoI2APSCor1Rgn_GMAP "Basismengenkorrekturkennfelder abhängig von dem Druck für die PoI2 für die Regenerationsstufe 2" MAP 0x8004A4E8 MapG_Ws16 10.00000 InjMass 0.00 10.00000 EXTENDED_LIMITS -327.6800 327.6700
 /begin AXIS_DESCR COM_AXIS Epm_nEng EngN 10 0.00 10000.00 EXTENDED_LIMITS -16384.00 16383.50 AXIS_PTS_REF InjCrv_qPoI2APSCorRgnX_AXIS /end AXIS_DESCR
 /begin AXIS_DESCR COM_AXIS InjCtl_qSetUnBal InjMass 10 0.00 327.6700 EXTENDED_LIMITS -327.6800 327.6700 AXIS_PTS_REF InjCrv_qPoI2APSCorRgnY_AXIS /end AXIS_DESCR
/end CHARACTERISTIC
/begin AXIS_PTS InjCrv_qPoI2APSCorRgnX_AXIS "Stützstellenverteilung für die Gruppenkennfelder InjCrv_qPoI2APSCor%Rgn_GMAP" 0x8004A5B0 Epm_nEng Axis_Xs16 10000.00 EngN 10 0.00 10000.00 FORMAT "%8.2" EXTENDED_LIMITS -16384.00 16383.50 DEPOSIT ABSOLUTE /end AXIS_PTS
/begin AXIS_PTS InjCrv_qPoI2APSCorRgnY_AXIS "Stützstellenverteilung für die Gruppenkennfelder InjCrv_qPoI2APSCor%Rgn_GMAP" 0x8004A5C6 InjCtl_qSetUnBal Axis_Xs16 327.6700 InjMass 10 0.00 327.6700 FORMAT "%8.4" EXTENDED_LIMITS -327.6800 327.6700 DEPOSIT ABSOLUTE /end AXIS_PTS
/begin CHARACTERISTIC InjCrv_qPoI2APSCorStrt_MAP "Atmosphärendruckabhängiges Mengenkorrekturkennfeld für PoI2 im Startzustand." MAP 0x8004A064 Map_Xs16Ys16Ws16 10.00000 InjMass 0.00 10.00000 EXTENDED_LIMITS -327.6800 327.6700
 /begin AXIS_DESCR STD_AXIS Epm_nEng EngN 12 0.00 10000.00 EXTENDED_LIMITS -16384.00 16383.50 DEPOSIT ABSOLUTE /end AXIS_DESCR
 /begin AXIS_DESCR STD_AXIS InjCtl_qSetUnBal InjMass 9 0.00 327.6700 EXTENDED_LIMITS -327.6800 327.6700 DEPOSIT ABSOLUTE /end AXIS_DESCR
/end CHARACTERISTIC
/begin CHARACTERISTIC InjCrv_qPoI2APSCor_MAP "Luftdruckabhängiges Mengenkorrekturkennfeld für PoI2" MAP 0x8004A16A Map_Xs16Ys16Ws16 10.00000 InjMass 0.00 10.00000 EXTENDED_LIMITS -327.6800 327.6700
 /begin AXIS_DESCR STD_AXIS Epm_nEng EngN 6 0.00 10000.00 EXTENDED_LIMITS -16384.00 16383.50 DEPOSIT ABSOLUTE /end AXIS_DESCR
 /begin AXIS_DESCR STD_AXIS InjCtl_qSetUnBal InjMass 6 0.00 327.6700 EXTENDED_LIMITS -327.6800 327.6700 DEPOSIT ABSOLUTE /end AXIS_DESCR
/end CHARACTERISTIC
/begin CHARACTERISTIC InjCrv_qPoI2ATSCor0Rgn_GMAP "Basismengenkorrekturkennfeld abhängig von der Lufttemperatur für die PoI2 für die Regenerationsstufe 1" MAP 0x8004A5DC MapG_Ws16 10.00000 InjMass 0.00 10.00000 EXTENDED_LIMITS -327.6800 327.6700
 /begin AXIS_DESCR COM_AXIS Epm_nEng EngN 10 0.00 10000.00 EXTENDED_LIMITS -16384.00 16383.50 AXIS_PTS_REF InjCrv_qPoI2ATSCorRgnX_AXIS /end AXIS_DESCR
 /begin AXIS_DESCR COM_AXIS InjCtl_qSetUnBal InjMass 10 0.00 327.6700 EXTENDED_LIMITS -327.6800 327.6700 AXIS_PTS_REF InjCrv_qPoI2ATSCorRgnY_AXIS /end AXIS_DESCR
/end CHARACTERISTIC
/begin CHARACTERISTIC InjCrv_qPoI2ATSCor1Rgn_GMAP "Basismengenkorrekturkennfeld abhängig von der Lufttemperatur für die PoI2 für die Regenerationsstufe 2" MAP 0x8004A6A4 MapG_Ws16 10.00000 InjMass 0.00 10.00000 EXTENDED_LIMITS -327.6800 327.6700
 /begin AXIS_DESCR COM_AXIS Epm_nEng EngN 10 0.00 10000.00 EXTENDED_LIMITS -16384.00 16383.50 AXIS_PTS_REF InjCrv_qPoI2ATSCorRgnX_AXIS /end AXIS_DESCR
 /begin AXIS_DESCR COM_AXIS InjCtl_qSetUnBal InjMass 10 0.00 327.6700 EXTENDED_LIMITS -327.6800 327.6700 AXIS_PTS_REF InjCrv_qPoI2ATSCorRgnY_AXIS /end AXIS_DESCR
/end CHARACTERISTIC
/begin AXIS_PTS InjCrv_qPoI2ATSCorRgnX_AXIS "Stützstellenverteilung für die Gruppenkennfelder InjCrv_qPoI2ATSCor%Rgn_GMAP" 0x8004A76C Epm_nEng Axis_Xs16 10000.00 EngN 10 0.00 10000.00 FORMAT "%8.2" EXTENDED_LIMITS -16384.00 16383.50 DEPOSIT ABSOLUTE /end AXIS_PTS
/begin AXIS_PTS InjCrv_qPoI2ATSCorRgnY_AXIS "Stützstellenverteilung für die Gruppenkennfelder InjCrv_qPoI2ATSCor%Rgn_GMAP" 0x8004A782 InjCtl_qSetUnBal Axis_Xs16 327.6700 InjMass 10 0.00 327.6700 FORMAT "%8.4" EXTENDED_LIMITS -327.6800 327.6700 DEPOSIT ABSOLUTE /end AXIS_PTS
/begin CHARACTERISTIC InjCrv_qPoI2ATSCorStrt_MAP "Ansauglufttemperaturabhängiges Mengenkorrekturkennfeld für PoI2 im Startzustand." MAP 0x8004A1CE Map_Xs16Ys16Ws16 10.00000 InjMass 0.00 10.00000 EXTENDED_LIMITS -327.6800 327.6700
 /begin AXIS_DESCR STD_AXIS Epm_nEng EngN 2 0.00 10000.00 EXTENDED_LIMITS -16384.00 16383.50 DEPOSIT ABSOLUTE /end AXIS_DESCR
 /begin AXIS_DESCR STD_AXIS InjCtl_qSetUnBal InjMass 2 0.00 327.6700 EXTENDED_LIMITS -327.6800 327.6700 DEPOSIT ABSOLUTE /end AXIS_DESCR
/end CHARACTERISTIC
/begin CHARACTERISTIC InjCrv_qPoI2ATSCor_MAP "ansauglufttemperaturabhängiges Mengenkorrekturkennfeld für PoI2" MAP 0x8004A1E2 Map_Xs16Ys16Ws16 10.00000 InjMass 0.00 10.00000 EXTENDED_LIMITS -327.6800 327.6700
 /begin AXIS_DESCR STD_AXIS Epm_nEng EngN 12 0.00 10000.00 EXTENDED_LIMITS -16384.00 16383.50 DEPOSIT ABSOLUTE /end AXIS_DESCR
 /begin AXIS_DESCR STD_AXIS InjCtl_qSetUnBal InjMass 9 0.00 327.6700 EXTENDED_LIMITS -327.6800 327.6700 DEPOSIT ABSOLUTE /end AXIS_DESCR
/end CHARACTERISTIC
/begin CHARACTERISTIC InjCrv_qPoI2Bas0Rgn_GMAP "Kennfeld für Basiswert für die Mengenkorrektur der PoI2 für die Regenerationsstufe 1" MAP 0x8004B2D4 MapG_Ws16 10.00000 InjMass 0.00 10.00000 EXTENDED_LIMITS -327.6800 327.6700
 /begin AXIS_DESCR COM_AXIS Epm_nEng EngN 16 0.00 10000.00 EXTENDED_LIMITS -16384.00 16383.50 AXIS_PTS_REF InjCrv_qPoI2BasRgnX_AXIS /end AXIS_DESCR
 /begin AXIS_DESCR COM_AXIS InjCtl_qSetUnBal InjMass 16 0.00 327.6700 EXTENDED_LIMITS -327.6800 327.6700 AXIS_PTS_REF InjCrv_qPoI2BasRgnY_AXIS /end AXIS_DESCR
/end CHARACTERISTIC
/begin CHARACTERISTIC InjCrv_qPoI2Bas1Rgn_GMAP "Kennfeld für Basiswert für die Mengenkorrektur der PoI2 für die Regenerationsstufe 2" MAP 0x8004B4D4 MapG_Ws16 10.00000 InjMass 0.00 10.00000 EXTENDED_LIMITS -327.6800 327.6700
 /begin AXIS_DESCR COM_AXIS Epm_nEng EngN 16 0.00 10000.00 EXTENDED_LIMITS -16384.00 16383.50 AXIS_PTS_REF InjCrv_qPoI2BasRgnX_AXIS /end AXIS_DESCR
 /begin AXIS_DESCR COM_AXIS InjCtl_qSetUnBal InjMass 16 0.00 327.6700 EXTENDED_LIMITS -327.6800 327.6700 AXIS_PTS_REF InjCrv_qPoI2BasRgnY_AXIS /end AXIS_DESCR
/end CHARACTERISTIC
/begin AXIS_PTS InjCrv_qPoI2BasRgnX_AXIS "Stützstellenverteilung für die Gruppenkennfelder InjCrv_qPoI2Bas%Rgn_GMAP" 0x8004B6D4 Epm_nEng Axis_Xs16 10000.00 EngN 16 0.00 10000.00 FORMAT "%8.2" EXTENDED_LIMITS -16384.00 16383.50 DEPOSIT ABSOLUTE /end AXIS_PTS
/begin AXIS_PTS InjCrv_qPoI2BasRgnY_AXIS "Stützstellenverteilung für die Gruppenkennfelder InjCrv_qPoI2Bas%Rgn_GMAP" 0x8004B6F6 InjCtl_qSetUnBal Axis_Xs16 327.6700 InjMass 16 0.00 327.6700 FORMAT "%8.4" EXTENDED_LIMITS -327.6800 327.6700 DEPOSIT ABSOLUTE /end AXIS_PTS
/begin CHARACTERISTIC InjCrv_qPoI2BasStrt_MAP "Einspritzmenge PoI2 Basis-MAP während Motorstart" MAP 0x8004C074 Map_Xs16Ys16Ws16 327.6700 InjMass 0.00 327.6700 EXTENDED_LIMITS -327.6800 327.6700
 /begin AXIS_DESCR STD_AXIS Epm_nEng EngN 8 0.00 10000.00 EXTENDED_LIMITS -16384.00 16383.50 DEPOSIT ABSOLUTE /end AXIS_DESCR
 /begin AXIS_DESCR STD_AXIS InjCtl_qSetUnBal InjMass 8 0.00 327.6700 EXTENDED_LIMITS -327.6800 327.6700 DEPOSIT ABSOLUTE /end AXIS_DESCR
/end CHARACTERISTIC
/begin CHARACTERISTIC InjCrv_qPoI2Bas_MAP "Einspritzmenge PoI2 Grundwert" MAP 0x80049DE6 Map_Xs16Ys16Ws16 10.00000 InjMass 0.00 10.00000 EXTENDED_LIMITS -327.6800 327.6700
 /begin AXIS_DESCR STD_AXIS Epm_nEng EngN 16 0.00 10000.00 EXTENDED_LIMITS -16384.00 16383.50 DEPOSIT ABSOLUTE /end AXIS_DESCR
 /begin AXIS_DESCR STD_AXIS InjCtl_qSetUnBal InjMass 16 0.00 327.6700 EXTENDED_LIMITS -327.6800 327.6700 DEPOSIT ABSOLUTE /end AXIS_DESCR
/end CHARACTERISTIC
/begin CHARACTERISTIC InjCrv_qPoI2Des_C "Fernsteuerwert der Gesamtmenge der PoI2" VALUE 0x8004A02A Val_Ws16 100.0000 InjMass 0.00 100.0000 EXTENDED_LIMITS -327.6800 327.6700 /end CHARACTERISTIC
/begin CHARACTERISTIC InjCrv_qPoI2Eff_C "Fernsteuerwert der Moment bildenden Menge der PoI2" VALUE 0x8004A02C Val_Ws16 10.00000 InjMass 0.00 10.00000 EXTENDED_LIMITS -327.6800 327.6700 /end CHARACTERISTIC
/begin CHARACTERISTIC InjCrv_qPoI2ETSCor0Rgn_GMAP "Basismengenkorrekturkennfeld abhängig von der Motortemperatur für die PoI2 für die Regenerationsstufe 1" MAP 0x8004A798 MapG_Ws16 10.00000 InjMass 0.00 10.00000 EXTENDED_LIMITS -327.6800 327.6700
 /begin AXIS_DESCR COM_AXIS Epm_nEng EngN 2 0.00 10000.00 EXTENDED_LIMITS -16384.00 16383.50 AXIS_PTS_REF InjCrv_qPoI2ETSCorRgnX_AXIS /end AXIS_DESCR
 /begin AXIS_DESCR COM_AXIS InjCtl_qSetUnBal InjMass 2 0.00 327.6700 EXTENDED_LIMITS -327.6800 327.6700 AXIS_PTS_REF InjCrv_qPoI2ETSCorRgnY_AXIS /end AXIS_DESCR
/end CHARACTERISTIC
/begin CHARACTERISTIC InjCrv_qPoI2ETSCor1Rgn_GMAP "Basismengenkorrekturkennfeld abhängig von der Motortemperatur für die PoI2 für die Regenerationsstufe 2" MAP 0x8004A7A0 MapG_Ws16 10.00000 InjMass 0.00 10.00000 EXTENDED_LIMITS -327.6800 327.6700
 /begin AXIS_DESCR COM_AXIS Epm_nEng EngN 2 0.00 10000.00 EXTENDED_LIMITS -16384.00 16383.50 AXIS_PTS_REF InjCrv_qPoI2ETSCorRgnX_AXIS /end AXIS_DESCR
 /begin AXIS_DESCR COM_AXIS InjCtl_qSetUnBal InjMass 2 0.00 327.6700 EXTENDED_LIMITS -327.6800 327.6700 AXIS_PTS_REF InjCrv_qPoI2ETSCorRgnY_AXIS /end AXIS_DESCR
/end CHARACTERISTIC
/begin AXIS_PTS InjCrv_qPoI2ETSCorRgnX_AXIS "Stützstellenverteilung für die Gruppenkennfelder InjCrv_qPoI2ETSCor%Rgn_GMAP" 0x8004A7A8 Epm_nEng Axis_Xs16 10000.00 EngN 2 0.00 10000.00 FORMAT "%8.2" EXTENDED_LIMITS -16384.00 16383.50 DEPOSIT ABSOLUTE /end AXIS_PTS
/begin AXIS_PTS InjCrv_qPoI2ETSCorRgnY_AXIS "Stützstellenverteilung für die Gruppenkennfelder InjCrv_qPoI2ETSCor%Rgn_GMAP" 0x8004A7AE InjCtl_qSetUnBal Axis_Xs16 327.6700 InjMass 2 0.00 327.6700 FORMAT "%8.4" EXTENDED_LIMITS -327.6800 327.6700 DEPOSIT ABSOLUTE /end AXIS_PTS
/begin CHARACTERISTIC InjCrv_qPoI2ETSCorStrt_MAP "Motortemperaturabhängiges Mengenkorrekturkennfeld für PoI2 im Startzustand." MAP 0x8004A2E8 Map_Xs16Ys16Ws16 10.00000 InjMass 0.00 10.00000 EXTENDED_LIMITS -327.6800 327.6700
 /begin AXIS_DESCR STD_AXIS Epm_nEng EngN 7 0.00 10000.00 EXTENDED_LIMITS -16384.00 16383.50 DEPOSIT ABSOLUTE /end AXIS_DESCR
 /begin AXIS_DESCR STD_AXIS InjCtl_qSetUnBal InjMass 6 0.00 327.6700 EXTENDED_LIMITS -327.6800 327.6700 DEPOSIT ABSOLUTE /end AXIS_DESCR
/end CHARACTERISTIC
/begin CHARACTERISTIC InjCrv_qPoI2ETSCor_MAP "motortemperaturabhängiges Mengenkorrekturkennfeld für PoI2" MAP 0x8004A35A Map_Xs16Ys16Ws16 10.00000 InjMass 0.00 10.00000 EXTENDED_LIMITS -327.6800 327.6700
 /begin AXIS_DESCR STD_AXIS Epm_nEng EngN 7 0.00 10000.00 EXTENDED_LIMITS -16384.00 16383.50 DEPOSIT ABSOLUTE /end AXIS_DESCR
 /begin AXIS_DESCR STD_AXIS InjCtl_qSetUnBal InjMass 6 0.00 327.6700 EXTENDED_LIMITS -327.6800 327.6700 DEPOSIT ABSOLUTE /end AXIS_DESCR
/end CHARACTERISTIC
/begin CHARACTERISTIC InjCrv_qPoI2SetLim_C "Threshold injection quantity" VALUE 0x8004A02E Val_Ws16 327.6700 InjMassInj 0.00 327.6700 EXTENDED_LIMITS -327.6800 327.6700 /end CHARACTERISTIC
/begin CHARACTERISTIC InjCrv_qPoIOvrMax_C "" VALUE 0x8004C1BC Val_Ws32 21474836.4700 InjMassTot 0.00 21474836.4700 FORMAT "%13.4" EXTENDED_LIMITS -21474836.4800 21474836.4700 /end CHARACTERISTIC
/begin CHARACTERISTIC InjCrv_stPoI1AddRlsMsk_C "Sperrmaske für den Normalbetrieb der PoI1" VALUE 0x80049CF0 Val_Wu32 4294967295.00 OneToOne 0.00 4294967295.00 /end CHARACTERISTIC
/begin CHARACTERISTIC InjCrv_stPoI1OvrRunRgnMsk_C "Maske zur Selektion der Regenerationsstufen, bei denen die PoI1 im Schub zeitlich begrenzt wird" VALUE 0x80049CF4 Val_Wu32 2147483647.00 OneToOne 0.00 2147483647.00 EXTENDED_LIMITS 0.00 4294967295.00 /end CHARACTERISTIC
/begin CHARACTERISTIC InjCrv_stPoI1RgnMsk_CA "Bitmaske für die Freigabe der einzelnen Regenerationsstufen" VAL_BLK 0x80049CF8 ValA_Wu32 4294967295.00 OneToOne 0.00 4294967295.00 NUMBER 2 /end CHARACTERISTIC
/begin CHARACTERISTIC InjCrv_stPoI1RgnRlsMsk_C "Freigabemaske für den Regenerationsbetrieb der PoI1" VALUE 0x80049D00 Val_Wu32 4294967295.00 OneToOne 0.00 4294967295.00 /end CHARACTERISTIC
/begin CHARACTERISTIC InjCrv_stPoI1RmpSel_CA "Matrix für die Faktorisierungskennlinien der Umschaltrampe für PoI1" MAP 0x80049D04 Map_Xu8Yu8Wu8 1.00000000000 INJCRV_RMP_VERB 1.00000000000 2.00000000000 FORMAT "%13.11" EXTENDED_LIMITS 1.00000000000 7.00000000000
 /begin AXIS_DESCR STD_AXIS InjCrv_stActValPoI1_mp INJCRV_MSK_VERB 3 0.00 7.00000000000 FORMAT "%13.11" DEPOSIT ABSOLUTE /end AXIS_DESCR
 /begin AXIS_DESCR STD_AXIS InjCrv_stDesValPoI1_mp INJCRV_MSK_VERB 3 0.00 7.00000000000 FORMAT "%13.11" DEPOSIT ABSOLUTE /end AXIS_DESCR
/end CHARACTERISTIC
/begin CHARACTERISTIC InjCrv_stPoI2AddRlsMsk_C "Sperrmaske für den Normalbetrieb der PoI2" VALUE 0x8004BEB4 Val_Wu32 4294967295.00 OneToOne 0.00 4294967295.00 /end CHARACTERISTIC
/begin CHARACTERISTIC InjCrv_stPoI2AgAbsTDCMsk_C "Maske zum Vergleich mit dem Regenerationsstatus zur Umschaltung des Ansteuerbeginns absolut zum TDC" VALUE 0x8004A038 Val_Wu32 4294967295.00 OneToOne 0.00 4294967295.00 /end CHARACTERISTIC
/begin CHARACTERISTIC InjCrv_stPoI2RgnMsk_CA "Bitmaske für die Freigabe der einzelnen Regenerationsstufen" VAL_BLK 0x8004BEB8 ValA_Wu32 4294967295.00 OneToOne 0.00 4294967295.00 NUMBER 2 /end CHARACTERISTIC
/begin CHARACTERISTIC InjCrv_stPoI2RgnRlsMsk_C "Freigabemaske für den Regenerationsbetrieb der PoI2" VALUE 0x8004BEC0 Val_Wu32 4294967295.00 OneToOne 0.00 4294967295.00 /end CHARACTERISTIC
/begin CHARACTERISTIC InjCrv_stPoI2RmpSel_CA "Matrix für die Faktorisierungskennlinien der Umschaltrampe für PoI2" MAP 0x8004BEC4 Map_Xu8Yu8Wu8 1.00000000000 INJCRV_RMP_VERB 1.00000000000 2.00000000000 FORMAT "%13.11" EXTENDED_LIMITS 1.00000000000 7.00000000000
 /begin AXIS_DESCR STD_AXIS InjCrv_stActValPoI2_mp INJCRV_MSK_VERB 3 0.00 7.00000000000 FORMAT "%13.11" DEPOSIT ABSOLUTE /end AXIS_DESCR
 /begin AXIS_DESCR STD_AXIS InjCrv_stDesValPoI2_mp INJCRV_MSK_VERB 3 0.00 7.00000000000 FORMAT "%13.11" DEPOSIT ABSOLUTE /end AXIS_DESCR
/end CHARACTERISTIC
/begin CHARACTERISTIC InjCrv_swtNoChkRefShOffTst_C "Schalter für die Abschaltung diverser, überwachter Betriebsbedingungen" VALUE 0x8004C210 Val_Wu8 3.000 OneToOne 0.00 3.000 EXTENDED_LIMITS 0.00 255.0 /end CHARACTERISTIC
/begin CHARACTERISTIC InjCrv_swtPhiPoI2Des_C "Schalter des Fernsteuerwerts des Ansteuerbeginns (Winkelkomponente) der PoI2" VALUE 0x8004A030 Val_Wu8 1.000 OneToOne 0.00 1.000 EXTENDED_LIMITS 0.00 255.0 /end CHARACTERISTIC
/begin CHARACTERISTIC InjCrv_swtPoI2SOEReplNrm_C "Schalter zum Aktivieren des Ersatzwertes bei aktiver Rampe und Zeitaplikation im Normalbetrieb" VALUE 0x8004BE64 Val_Wu8 255.0 OneToOne 0.00 255.0 /end CHARACTERISTIC
/begin CHARACTERISTIC InjCrv_swtPoIOvrLimActive_C "" VALUE 0x8004C1C0 Val_Wu8 1.000 OneToOne 0.00 1.000 EXTENDED_LIMITS 0.00 255.0 /end CHARACTERISTIC
/begin CHARACTERISTIC InjCrv_swtQntPoI2Des_C "Schalter des Fernsteuerwerts der Gesamtmenge der PoI2" VALUE 0x8004A031 Val_Wu8 1.000 OneToOne 0.00 1.000 EXTENDED_LIMITS 0.00 255.0 /end CHARACTERISTIC
/begin CHARACTERISTIC InjCrv_swtQntPoI2Eff_C "Schalter des Fernsteuerwerts der Moment bildenden Menge der PoI2" VALUE 0x8004A032 Val_Wu8 1.000 OneToOne 0.00 1.000 EXTENDED_LIMITS 0.00 255.0 /end CHARACTERISTIC
/begin CHARACTERISTIC InjCrv_swtShOffTst_C "Schalter für die Freigabe des zylinderselektiven Einspritzabschalttests" VALUE 0x8004C211 Val_Wu8 1.000 OneToOne 0.00 1.000 EXTENDED_LIMITS 0.00 255.0 /end CHARACTERISTIC
/begin CHARACTERISTIC InjCrv_swtTiPoI2Des_C "Schalter des Fernsteuerwerts des Ansteuerbeginns (Zeitkomponente) der PoI2" VALUE 0x8004A033 Val_Wu8 1.000 OneToOne 0.00 1.000 EXTENDED_LIMITS 0.00 255.0 /end CHARACTERISTIC
/begin CHARACTERISTIC InjCrv_tiPoI1Bas0Rgn_GMAP "" MAP 0x800497B0 MapG_Ws16 5000.00 InjTime_us 0.00 5000.00 EXTENDED_LIMITS -13107.20 13106.80
 /begin AXIS_DESCR COM_AXIS Epm_nEng EngN 16 0.00 10000.00 EXTENDED_LIMITS -16384.00 16383.50 AXIS_PTS_REF InjCrv_tiPoI1BasRgnX_AXIS /end AXIS_DESCR
 /begin AXIS_DESCR COM_AXIS InjCtl_qSetUnBal InjMass 16 0.00 327.6700 EXTENDED_LIMITS -327.6800 327.6700 AXIS_PTS_REF InjCrv_tiPoI1BasRgnY_AXIS /end AXIS_DESCR
/end CHARACTERISTIC
/begin CHARACTERISTIC InjCrv_tiPoI1Bas1Rgn_GMAP "" MAP 0x800499B0 MapG_Ws16 5000.00 InjTime_us 0.00 5000.00 EXTENDED_LIMITS -13107.20 13106.80
 /begin AXIS_DESCR COM_AXIS Epm_nEng EngN 16 0.00 10000.00 EXTENDED_LIMITS -16384.00 16383.50 AXIS_PTS_REF InjCrv_tiPoI1BasRgnX_AXIS /end AXIS_DESCR
 /begin AXIS_DESCR COM_AXIS InjCtl_qSetUnBal InjMass 16 0.00 327.6700 EXTENDED_LIMITS -327.6800 327.6700 AXIS_PTS_REF InjCrv_tiPoI1BasRgnY_AXIS /end AXIS_DESCR
/end CHARACTERISTIC
/begin AXIS_PTS InjCrv_tiPoI1BasRgnX_AXIS "" 0x80049BB0 Epm_nEng Axis_Xs16 10000.00 EngN 16 0.00 10000.00 FORMAT "%8.2" EXTENDED_LIMITS -16384.00 16383.50 DEPOSIT ABSOLUTE /end AXIS_PTS
/begin AXIS_PTS InjCrv_tiPoI1BasRgnY_AXIS "" 0x80049BD2 InjCtl_qSetUnBal Axis_Xs16 327.6700 InjMass 16 0.00 327.6700 FORMAT "%8.4" EXTENDED_LIMITS -327.6800 327.6700 DEPOSIT ABSOLUTE /end AXIS_PTS
/begin CHARACTERISTIC InjCrv_tiPoI1ETSCor_MAP "" MAP 0x80048EB6 Map_Xs16Ys16Ws16 5000.00 InjTime_us 0.00 5000.00 EXTENDED_LIMITS -13107.20 13106.80
 /begin AXIS_DESCR STD_AXIS Epm_nEng EngN 2 0.00 10000.00 EXTENDED_LIMITS -16384.00 16383.50 DEPOSIT ABSOLUTE /end AXIS_DESCR
 /begin AXIS_DESCR STD_AXIS InjCtl_qSetUnBal InjMass 2 0.00 327.6700 EXTENDED_LIMITS -327.6800 327.6700 DEPOSIT ABSOLUTE /end AXIS_DESCR
/end CHARACTERISTIC
/begin CHARACTERISTIC InjCrv_tiPoI1OvrRunRgnDeb_C "Entprellzeit für die Reaktivierung der PoI1 bei Rückkehr aus dem Schub" VALUE 0x80049D16 Val_Ws16 327.6700 Time_s 0.00 327.6700 EXTENDED_LIMITS -327.6800 327.6700 /end CHARACTERISTIC
/begin CHARACTERISTIC InjCrv_tiPoI1OvrRunRgnMax_C "Maximalzeit der PoI1 im Schub" VALUE 0x80049D18 Val_Ws32 21474836.4700 Time_s 0.00 21474836.4700 EXTENDED_LIMITS -21474836.4800 21474836.4700 /end CHARACTERISTIC
/begin CHARACTERISTIC InjCrv_tiPoI2APSCor0Rgn_GMAP "Ansteuerbeginn zeit korrekturkennfeld abhängig von dem Umgebungsluftdruck für die PoI2 für die Regenerationsstufe 1" MAP 0x8004A7B4 MapG_Ws16 18107.20 InjTime_us -13107.20 5000.00 EXTENDED_LIMITS -13107.20 13106.80
 /begin AXIS_DESCR COM_AXIS Epm_nEng EngN 10 0.00 10000.00 EXTENDED_LIMITS -16384.00 16383.50 AXIS_PTS_REF InjCrv_tiPoI2APSCorRgnX_AXIS /end AXIS_DESCR
 /begin AXIS_DESCR COM_AXIS InjCtl_qSetUnBal InjMass 10 0.00 327.6700 EXTENDED_LIMITS -327.6800 327.6700 AXIS_PTS_REF InjCrv_tiPoI2APSCorRgnY_AXIS /end AXIS_DESCR
/end CHARACTERISTIC
/begin CHARACTERISTIC InjCrv_tiPoI2APSCor1Rgn_GMAP "Ansteuerbeginn zeit korrekturkennfeld abhängig von dem Umgebungsluftdruck für die PoI2 für die Regenerationsstufe 2" MAP 0x8004A87C MapG_Ws16 18107.20 InjTime_us -13107.20 5000.00 EXTENDED_LIMITS -13107.20 13106.80
 /begin AXIS_DESCR COM_AXIS Epm_nEng EngN 10 0.00 10000.00 EXTENDED_LIMITS -16384.00 16383.50 AXIS_PTS_REF InjCrv_tiPoI2APSCorRgnX_AXIS /end AXIS_DESCR
 /begin AXIS_DESCR COM_AXIS InjCtl_qSetUnBal InjMass 10 0.00 327.6700 EXTENDED_LIMITS -327.6800 327.6700 AXIS_PTS_REF InjCrv_tiPoI2APSCorRgnY_AXIS /end AXIS_DESCR
/end CHARACTERISTIC
/begin AXIS_PTS InjCrv_tiPoI2APSCorRgnX_AXIS "" 0x8004A944 Epm_nEng Axis_Xs16 10000.00 EngN 10 0.00 10000.00 FORMAT "%8.2" EXTENDED_LIMITS -16384.00 16383.50 DEPOSIT ABSOLUTE /end AXIS_PTS
/begin AXIS_PTS InjCrv_tiPoI2APSCorRgnY_AXIS "" 0x8004A95A InjCtl_qSetUnBal Axis_Xs16 327.6700 InjMass 10 0.00 327.6700 FORMAT "%8.4" EXTENDED_LIMITS -327.6800 327.6700 DEPOSIT ABSOLUTE /end AXIS_PTS
/begin CHARACTERISTIC InjCrv_tiPoI2APSCor_MAP "Luftdruckabhängiger Korrekturgrundwert für die Zeitkomponente des Ansteuerbeginns der PoI2" MAP 0x8004ACBE Map_Xs16Ys16Ws16 18000.00 InjTime_us -13000.00 5000.00 EXTENDED_LIMITS -13107.20 13106.80
 /begin AXIS_DESCR STD_AXIS Epm_nEng EngN 16 0.00 10000.00 EXTENDED_LIMITS -16384.00 16383.50 DEPOSIT ABSOLUTE /end AXIS_DESCR
 /begin AXIS_DESCR STD_AXIS InjCtl_qSetUnBal InjMass 8 0.00 327.6700 EXTENDED_LIMITS -327.6800 327.6700 DEPOSIT ABSOLUTE /end AXIS_DESCR
/end CHARACTERISTIC
/begin CHARACTERISTIC InjCrv_tiPoI2ATSCor_MAP "Ansauglufttemperaturabhängiger Korrekturgrundwert für die Zeitkomponente des Ansteuerbeginns der PoI2" MAP 0x8004ADF2 Map_Xs16Ys16Ws16 18000.00 InjTime_us -13000.00 5000.00 EXTENDED_LIMITS -13107.20 13106.80
 /begin AXIS_DESCR STD_AXIS Epm_nEng EngN 2 0.00 10000.00 EXTENDED_LIMITS -16384.00 16383.50 DEPOSIT ABSOLUTE /end AXIS_DESCR
 /begin AXIS_DESCR STD_AXIS InjCtl_qSetUnBal InjMass 2 0.00 327.6700 EXTENDED_LIMITS -327.6800 327.6700 DEPOSIT ABSOLUTE /end AXIS_DESCR
/end CHARACTERISTIC
/begin CHARACTERISTIC InjCrv_tiPoI2Bas0Rgn_GMAP "Gruppenkennfeld für den Zeit des Ansteuerbeginns für die PoI2 für die Regenerationsstufe 1" MAP 0x8004B718 MapG_Ws16 18000.00 InjTime_us -13000.00 5000.00 EXTENDED_LIMITS -13107.20 13106.80
 /begin AXIS_DESCR COM_AXIS Epm_nEng EngN 16 0.00 10000.00 EXTENDED_LIMITS -16384.00 16383.50 AXIS_PTS_REF InjCrv_tiPoI2BasRgnX_AXIS /end AXIS_DESCR
 /begin AXIS_DESCR COM_AXIS InjCtl_qSetUnBal InjMass 16 0.00 327.6700 EXTENDED_LIMITS -327.6800 327.6700 AXIS_PTS_REF InjCrv_tiPoI2BasRgnY_AXIS /end AXIS_DESCR
/end CHARACTERISTIC
/begin CHARACTERISTIC InjCrv_tiPoI2Bas1Rgn_GMAP "Gruppenkennfeld für den Zeit des Ansteuerbeginns für die PoI2 für die Regenerationsstufe 2" MAP 0x8004B918 MapG_Ws16 18000.00 InjTime_us -13000.00 5000.00 EXTENDED_LIMITS -13107.20 13106.80
 /begin AXIS_DESCR COM_AXIS Epm_nEng EngN 16 0.00 10000.00 EXTENDED_LIMITS -16384.00 16383.50 AXIS_PTS_REF InjCrv_tiPoI2BasRgnX_AXIS /end AXIS_DESCR
 /begin AXIS_DESCR COM_AXIS InjCtl_qSetUnBal InjMass 16 0.00 327.6700 EXTENDED_LIMITS -327.6800 327.6700 AXIS_PTS_REF InjCrv_tiPoI2BasRgnY_AXIS /end AXIS_DESCR
/end CHARACTERISTIC
/begin AXIS_PTS InjCrv_tiPoI2BasRgnX_AXIS "" 0x8004BB18 Epm_nEng Axis_Xs16 10000.00 EngN 16 0.00 10000.00 FORMAT "%8.2" EXTENDED_LIMITS -16384.00 16383.50 DEPOSIT ABSOLUTE /end AXIS_PTS
/begin AXIS_PTS InjCrv_tiPoI2BasRgnY_AXIS "" 0x8004BB3A InjCtl_qSetUnBal Axis_Xs16 327.6700 InjMass 16 0.00 327.6700 FORMAT "%8.4" EXTENDED_LIMITS -327.6800 327.6700 DEPOSIT ABSOLUTE /end AXIS_PTS
/begin CHARACTERISTIC InjCrv_tiPoI2BasStrt_MAP "Motortemperaturabhängiger PoI2-Basiswert während Motorstart" MAP 0x8004C118 Map_Xs16Ys16Ws16 5000.0000 InjTime_us 0.00 5000.0000 EXTENDED_LIMITS -13107.20 13106.80
 /begin AXIS_DESCR STD_AXIS Epm_nEng EngN 8 0.00 10000.00 EXTENDED_LIMITS -16384.00 16383.50 DEPOSIT ABSOLUTE /end AXIS_DESCR
 /begin AXIS_DESCR STD_AXIS InjCtl_qSetUnBal InjMass 8 0.00 327.6700 EXTENDED_LIMITS -327.6800 327.6700 DEPOSIT ABSOLUTE /end AXIS_DESCR
/end CHARACTERISTIC
/begin CHARACTERISTIC InjCrv_tiPoI2Bas_MAP "Zeitkomponente Ansteuerbeginn Grundwert PoI2" MAP 0x8004BED8 Map_Xs16Ys16Ws16 18000.00 InjTime_us -13000.00 5000.00 EXTENDED_LIMITS -13107.20 13106.80
 /begin AXIS_DESCR STD_AXIS Epm_nEng EngN 10 0.00 10000.00 EXTENDED_LIMITS -16384.00 16383.50 DEPOSIT ABSOLUTE /end AXIS_DESCR
 /begin AXIS_DESCR STD_AXIS InjCtl_qSetUnBal InjMass 10 0.00 327.6700 EXTENDED_LIMITS -327.6800 327.6700 DEPOSIT ABSOLUTE /end AXIS_DESCR
/end CHARACTERISTIC
/begin CHARACTERISTIC InjCrv_tiPoI2Des_C "Fernsteuerwert des Ansteuerbeginns (Zeitkomponente) der PoI2" VALUE 0x8004A034 Val_Ws16 15000.00 InjTime_us -10000.00 5000.00 EXTENDED_LIMITS -13107.20 13106.80 /end CHARACTERISTIC
/begin CHARACTERISTIC InjCrv_tiPoI2ETSCor0Rgn_GMAP "Ansteuerbeginn zeit korrekturkennfeld abhängig von der Motortemperatur für die PoI2 für die Regenerationsstufe 1" MAP 0x8004A970 MapG_Ws16 18107.20 InjTime_us -13107.20 5000.00 EXTENDED_LIMITS -13107.20 13106.80
 /begin AXIS_DESCR COM_AXIS Epm_nEng EngN 2 0.00 10000.00 EXTENDED_LIMITS -16384.00 16383.50 AXIS_PTS_REF InjCrv_tiPoI2ETSCorRgnX_AXIS /end AXIS_DESCR
 /begin AXIS_DESCR COM_AXIS InjCtl_qSetUnBal InjMass 2 0.00 327.6700 EXTENDED_LIMITS -327.6800 327.6700 AXIS_PTS_REF InjCrv_tiPoI2ETSCorRgnY_AXIS /end AXIS_DESCR
/end CHARACTERISTIC
/begin CHARACTERISTIC InjCrv_tiPoI2ETSCor1Rgn_GMAP "Ansteuerbeginn zeit korrekturkennfeld abhängig von der Motortemperatur für die PoI2 für die Regenerationsstufe 2" MAP 0x8004A978 MapG_Ws16 18107.20 InjTime_us -13107.20 5000.00 EXTENDED_LIMITS -13107.20 13106.80
 /begin AXIS_DESCR COM_AXIS Epm_nEng EngN 2 0.00 10000.00 EXTENDED_LIMITS -16384.00 16383.50 AXIS_PTS_REF InjCrv_tiPoI2ETSCorRgnX_AXIS /end AXIS_DESCR
 /begin AXIS_DESCR COM_AXIS InjCtl_qSetUnBal InjMass 2 0.00 327.6700 EXTENDED_LIMITS -327.6800 327.6700 AXIS_PTS_REF InjCrv_tiPoI2ETSCorRgnY_AXIS /end AXIS_DESCR
/end CHARACTERISTIC
/begin AXIS_PTS InjCrv_tiPoI2ETSCorRgnX_AXIS "" 0x8004A980 Epm_nEng Axis_Xs16 10000.00 EngN 2 0.00 10000.00 FORMAT "%8.2" EXTENDED_LIMITS -16384.00 16383.50 DEPOSIT ABSOLUTE /end AXIS_PTS
/begin AXIS_PTS InjCrv_tiPoI2ETSCorRgnY_AXIS "" 0x8004A986 InjCtl_qSetUnBal Axis_Xs16 327.6700 InjMass 2 0.00 327.6700 FORMAT "%8.4" EXTENDED_LIMITS -327.6800 327.6700 DEPOSIT ABSOLUTE /end AXIS_PTS
/begin CHARACTERISTIC InjCrv_tiPoI2ETSCorStrt_MAP "Motortemperaturabhängiges Korrekturgrundwertekennfeld für die Zeitkomponente des Ansteuerbeginns der PoI2 im Startzustand." MAP 0x8004AE06 Map_Xs16Ys16Ws16 18000.00 InjTime_us -13000.00 5000.00 EXTENDED_LIMITS -13107.20 13106.80
 /begin AXIS_DESCR STD_AXIS Epm_nEng EngN 2 0.00 10000.00 EXTENDED_LIMITS -16384.00 16383.50 DEPOSIT ABSOLUTE /end AXIS_DESCR
 /begin AXIS_DESCR STD_AXIS InjCtl_qSetUnBal InjMass 2 0.00 327.6700 EXTENDED_LIMITS -327.6800 327.6700 DEPOSIT ABSOLUTE /end AXIS_DESCR
/end CHARACTERISTIC
/begin CHARACTERISTIC InjCrv_tiPoI2ETSCor_MAP "motortemperaturabhängiges Korrekturgrundwertekennfeld für die Zeitkomponente des Ansteuerbeginns der PoI2" MAP 0x8004AE1A Map_Xs16Ys16Ws16 18000.00 InjTime_us -13000.00 5000.00 EXTENDED_LIMITS -13107.20 13106.80
 /begin AXIS_DESCR STD_AXIS Epm_nEng EngN 2 0.00 10000.00 EXTENDED_LIMITS -16384.00 16383.50 DEPOSIT ABSOLUTE /end AXIS_DESCR
 /begin AXIS_DESCR STD_AXIS InjCtl_qSetUnBal InjMass 2 0.00 327.6700 EXTENDED_LIMITS -327.6800 327.6700 DEPOSIT ABSOLUTE /end AXIS_DESCR
/end CHARACTERISTIC
/begin CHARACTERISTIC InjCrv_tiPoI2Min_C "physikalisch bedingter minimaler Ansteuerbeginn PoI2" VALUE 0x8004A036 Val_Ws16 18000.00 InjTime_us -13000.00 5000.00 EXTENDED_LIMITS -13107.20 13106.80 /end CHARACTERISTIC
/begin CHARACTERISTIC InjCrv_tiPoIOvrLimMax_C "" VALUE 0x8004C1C4 Val_Ws32 21474836470.0 Time_ms 0.00 21474836470.0 EXTENDED_LIMITS -21474836480.0 21474836470.0 /end CHARACTERISTIC
/begin CHARACTERISTIC InjCrv_tOxiPoILimMax_C "" VALUE 0x8004C1C8 Val_Ws16 950.0000 Temp_Cels -50.04000 899.9600 EXTENDED_LIMITS -3549.940 3003.560 /end CHARACTERISTIC
/begin CHARACTERISTIC InjCrv_tPFltUsPoILimMax_C "" VALUE 0x8004C1CA Val_Ws16 950.0000 Temp_Cels -50.04000 899.9600 EXTENDED_LIMITS -3549.940 3003.560 /end CHARACTERISTIC
/begin CHARACTERISTIC InjCtl_dAdjQntCSMax_C "" VALUE 0x8004D514 Kw_Wu8 255.0 OneToOne 0.00 255.0 /end CHARACTERISTIC
/begin CHARACTERISTIC InjCtl_dAdjQntCSMin_C "" VALUE 0x8004D515 Kw_Wu8 255.0 OneToOne 0.00 255.0 /end CHARACTERISTIC
/begin CHARACTERISTIC InjCtl_facAdjSrvMax_C "Maximalwert für Serviceabgleichfaktor" VALUE 0x8004D516 Kw_Ws16 3.000000 Fact 0.00 3.000000 EXTENDED_LIMITS -4.000000 3.999878 /end CHARACTERISTIC
/begin CHARACTERISTIC InjCtl_facAdjSrvMin_C "Minimalwert für Serviceabgleichfaktor" VALUE 0x8004D518 Kw_Ws16 3.000000 Fact 0.00 3.000000 EXTENDED_LIMITS -4.000000 3.999878 /end CHARACTERISTIC
/begin CHARACTERISTIC InjCtl_InjQntDT1.T1_C "Filterkonstanten für Menge/" VALUE 0x8004D51C Kw_Ws32 4294.9672940 TimeDelay_s 0.000002000000001 4294.9672960 FORMAT "%12.7" /end CHARACTERISTIC
/begin CHARACTERISTIC InjCtl_InjQntDT1.Kd_C "Filterkonstanten für Menge/" VALUE 0x8004D520 Kw_Ws32 65535.9999847 Kd -32768.0000000 32767.9999847 FORMAT "%13.7" /end CHARACTERISTIC
/begin CHARACTERISTIC InjCtl_qAdjQntMax_C "Maximalwert für Mengenabgleich" VALUE 0x8004D524 Kw_Ws16 327.6700 InjMassCyc 0.00 327.6700 EXTENDED_LIMITS -327.6800 327.6700 /end CHARACTERISTIC
/begin CHARACTERISTIC InjCtl_qAdjQntMin_C "Minimalwert für Mengenabgleich" VALUE 0x8004D526 Kw_Ws16 327.6700 InjMassCyc 0.00 327.6700 EXTENDED_LIMITS -327.6800 327.6700 /end CHARACTERISTIC
/begin CHARACTERISTIC InjCtl_qAdjQnt_MAP "Neutralkennfeld für Mengenabgleich" MAP 0x8004D528 Kf_Xs16_Ys16_Ws16 327.6700 InjMassCyc 0.00 327.6700 EXTENDED_LIMITS -327.6800 327.6700
 /begin AXIS_DESCR STD_AXIS Epm_nEng EngN 8 0.00 6000.000 EXTENDED_LIMITS -16384.00 16383.50 DEPOSIT ABSOLUTE /end AXIS_DESCR
 /begin AXIS_DESCR STD_AXIS InjCtl_qSetUnCor_mp InjMassCyc 6 0.00 327.6700 EXTENDED_LIMITS -327.6800 327.6700 DEPOSIT ABSOLUTE /end AXIS_DESCR
/end CHARACTERISTIC
/begin CHARACTERISTIC InjCtl_qLimSoftShOff_CUR "limitation value in case of soft shutoff" CURVE 0x8004D5A8 Kl_Xs16_Ws16 327.6700 InjMassCyc 0.00 327.6700 EXTENDED_LIMITS -327.6800 327.6700
 /begin AXIS_DESCR STD_AXIS Epm_nEng EngN 6 0.00 6000.000 EXTENDED_LIMITS -16384.00 16383.50 DEPOSIT ABSOLUTE /end AXIS_DESCR
/end CHARACTERISTIC
/begin CHARACTERISTIC InjCtl_swtDiffQntIn_C "Auswahl der Eingangsmenge" VALUE 0x8004D5C2 Val_Wu8 1.000 OneToOne 0.00 1.000 EXTENDED_LIMITS 0.00 255.0 /end CHARACTERISTIC
/begin CHARACTERISTIC InjCtl_tiInjQntPT1_C "Zeitkonstante des PT1-Filters der Menge" VALUE 0x8004D5C4 Val_Ws32 4294.9672940 TimeDelay_s 0.000002000000001 4294.9672960 FORMAT "%12.7" /end CHARACTERISTIC
/begin CHARACTERISTIC InjSys_ctAirTempRgnSel_C "Index zur Auswahl der Ansauglufttemperatur für das Einspritzsystem im Regenerationbetrieb" VALUE 0x8004C212 Val_Wu8 3.00000000000 AirTempFldSel 0.00 3.00000000000 FORMAT "%13.11" /end CHARACTERISTIC
/begin CHARACTERISTIC InjSys_ctAirTempSel_C "Index zur Auswahl der Ansauglufttemperatur für das Einspritzsystem" VALUE 0x8004C213 Val_Wu8 3.00000000000 AirTempFldSel 0.00 3.00000000000 FORMAT "%13.11" /end CHARACTERISTIC
/begin CHARACTERISTIC InjSys_ctEngTempRgnSelPiIRls_C "" VALUE 0x8004C214 Val_Wu8 3.00000000000 EngTempFldSel 0.00 3.00000000000 FORMAT "%13.11" /end CHARACTERISTIC
/begin CHARACTERISTIC InjSys_ctEngTempRgnSel_C "Index zur Auswahl der Motortemperatur für das Einspritzsystem im Regenerationbetrieb" VALUE 0x8004C215 Val_Wu8 3.00000000000 EngTempFldSel 0.00 3.00000000000 FORMAT "%13.11" /end CHARACTERISTIC
/begin CHARACTERISTIC InjSys_ctEngTempSelPiIRls_C "" VALUE 0x8004C216 Val_Wu8 3.00000000000 EngTempFldSel 0.00 3.00000000000 FORMAT "%13.11" /end CHARACTERISTIC
/begin CHARACTERISTIC InjSys_ctEngTempSel_C "Index zur Auswahl der Motortemperatur für das Einspritzsystem" VALUE 0x8004C217 Val_Wu8 3.00000000000 EngTempFldSel 0.00 3.00000000000 FORMAT "%13.11" /end CHARACTERISTIC
/begin CHARACTERISTIC InjSys_facEngTempHCCor_CUR "" CURVE 0x8004C218 Kl_Xs16_Ws16 100.0000 Fact 0.00 100.0000 EXTENDED_LIMITS -4.000000 3.999878
 /begin AXIS_DESCR STD_AXIS CEngDsT_t Temp_Cels 8 -3549.940 3003.560 DEPOSIT ABSOLUTE /end AXIS_DESCR
/end CHARACTERISTIC
/begin CHARACTERISTIC InjSys_facMIHCRgn_MAP "" MAP 0x8004C23A Kf_Xs16_Ys16_Ws16 100.0000 Fact 0.00 100.0000 EXTENDED_LIMITS -4.000000 3.999878
 /begin AXIS_DESCR STD_AXIS Epm_nEng EngN 8 0.00 6000.000 EXTENDED_LIMITS -16384.00 16383.50 DEPOSIT ABSOLUTE /end AXIS_DESCR
 /begin AXIS_DESCR STD_AXIS InjCtl_qSetUnBal InjMass 8 0.00 327.6700 EXTENDED_LIMITS -327.6800 327.6700 DEPOSIT ABSOLUTE /end AXIS_DESCR
/end CHARACTERISTIC
/begin CHARACTERISTIC InjSys_facMIHC_MAP "" MAP 0x8004C2DE Kf_Xs16_Ys16_Ws16 100.0000 Fact 0.00 100.0000 EXTENDED_LIMITS -4.000000 3.999878
 /begin AXIS_DESCR STD_AXIS Epm_nEng EngN 8 -16384.00 16383.50 DEPOSIT ABSOLUTE /end AXIS_DESCR
 /begin AXIS_DESCR STD_AXIS InjCtl_qSetUnBal InjMass 8 0.00 327.6700 EXTENDED_LIMITS -327.6800 327.6700 DEPOSIT ABSOLUTE /end AXIS_DESCR
/end CHARACTERISTIC
/begin CHARACTERISTIC InjSys_facPoI1HtHCPoI2_CUR "" CURVE 0x8004C382 Kl_Xs16_Ws16 100.0000 Fact 0.00 100.0000 EXTENDED_LIMITS -4.000000 3.999878
 /begin AXIS_DESCR STD_AXIS ASMod_qDiffPoI2Ref InjMass 10 0.00 100.0000 EXTENDED_LIMITS -327.6800 327.6700 DEPOSIT ABSOLUTE /end AXIS_DESCR
/end CHARACTERISTIC
/begin CHARACTERISTIC InjSys_facPoI1HtHC_MAP "" MAP 0x8004C3AC Kf_Xs16_Ys16_Ws16 100.0000 Fact 0.00 100.0000 EXTENDED_LIMITS -4.000000 3.999878
 /begin AXIS_DESCR STD_AXIS Epm_nEng EngN 10 0.00 6000.000 EXTENDED_LIMITS -16384.00 16383.50 DEPOSIT ABSOLUTE /end AXIS_DESCR
 /begin AXIS_DESCR STD_AXIS InjCtl_qSetUnBal InjMass 10 0.00 327.6700 EXTENDED_LIMITS -327.6800 327.6700 DEPOSIT ABSOLUTE /end AXIS_DESCR
/end CHARACTERISTIC
/begin CHARACTERISTIC InjSys_facPoI2HtHCPoI1_CUR "" CURVE 0x8004C4A0 Kl_Xs16_Ws16 100.0000 Fact 0.00 100.0000 EXTENDED_LIMITS -4.000000 3.999878
 /begin AXIS_DESCR STD_AXIS ASMod_qDiffPoI1Ref InjMass 10 0.00 100.0000 EXTENDED_LIMITS -327.6800 327.6700 DEPOSIT ABSOLUTE /end AXIS_DESCR
/end CHARACTERISTIC
/begin CHARACTERISTIC InjSys_facPoI2HtHC_MAP "" MAP 0x8004C4CA Kf_Xs16_Ys16_Ws16 100.0000 Fact 0.00 100.0000 EXTENDED_LIMITS -4.000000 3.999878
 /begin AXIS_DESCR STD_AXIS Epm_nEng EngN 10 0.00 6000.000 EXTENDED_LIMITS -16384.00 16383.50 DEPOSIT ABSOLUTE /end AXIS_DESCR
 /begin AXIS_DESCR STD_AXIS InjCtl_qSetUnBal InjMass 10 0.00 327.6700 EXTENDED_LIMITS -327.6800 327.6700 DEPOSIT ABSOLUTE /end AXIS_DESCR
/end CHARACTERISTIC
/begin CHARACTERISTIC InjSys_stMskCoEOMHC_C "" VALUE 0x8004C5C0 Val_Wu32 4294967295.00 OneToOne 0.00 4294967295.00 /end CHARACTERISTIC
/begin CHARACTERISTIC InjSys_swtPoI1EffInrCmb_C "Schalter Aktivierung Addition Menge InjCrv_qPoi1Eff zu InjSys_qInrCmb" VALUE 0x8004C5C4 Val_Wu8 1.000 OneToOne 0.00 1.000 EXTENDED_LIMITS 0.00 255.0 /end CHARACTERISTIC
/begin CHARACTERISTIC InjUn_ctSyncStrtPls_C "Synchronisation des Entprellzählers für Plausibilitätsstart" VALUE 0x8004C5C8 Val_Wu16 65535.00 OneToOne 0.00 65535.00 /end CHARACTERISTIC
/begin CHARACTERISTIC InjUn_nStrtLim_C "Drehzahlschwelle für Druckaufbau beim Start" VALUE 0x8004C5CA Val_Ws16 5000.000 EngN 0.00 5000.000 EXTENDED_LIMITS -16384.00 16383.50 /end CHARACTERISTIC
/begin CHARACTERISTIC InjUn_stShOffStrt_C "Schalter zur Festlegung, welche reversiblen Abschaltbedingungen überprüft werden." VALUE 0x8004C5CC Val_Wu32 4294967295.00 OneToOne 0.00 4294967295.00 /end CHARACTERISTIC
/begin CHARACTERISTIC InjUn_swtStrtPls_C "Schalter zum Deaktivieren des Plausibilitätsstarts" VALUE 0x8004C5D0 Val_Wu8 7.000 OneToOne 0.00 7.000 EXTENDED_LIMITS 0.00 255.0 /end CHARACTERISTIC
/begin CHARACTERISTIC InjUn_tiRailStrtPls_C "Entprellzeit für den Druckaufbau für Plausibilitätsstart" VALUE 0x8004C5D2 Val_Ws16 387680.0 Time_ms -327680.0 60000.00 EXTENDED_LIMITS -327680.0 327670.0 /end CHARACTERISTIC
/begin CHARACTERISTIC InjUn_tiShOffStrtPls_C "Entprellzeit für eine Abschaltanforderung für den Plausibilitätsstart" VALUE 0x8004C5D4 Val_Ws16 387680.0 Time_ms -327680.0 60000.00 EXTENDED_LIMITS -327680.0 327670.0 /end CHARACTERISTIC
/begin CHARACTERISTIC InjUn_tiSpdStrtPls_C "Entprellzeit für die Motordrehzahlerkennung für Plausibilitätsstart" VALUE 0x8004C5D6 Val_Ws16 387680.0 Time_ms -327680.0 60000.00 EXTENDED_LIMITS -327680.0 327670.0 /end CHARACTERISTIC
/begin CHARACTERISTIC InjVlv_facAddBalRls_MAP "Freigabekennfeld zur Aufrechnung der Mengenkorrektur" MAP 0x8004C5D8 Map_Xs16Ys16Ws16 1.000000 Fact 0.00 1.000000 EXTENDED_LIMITS -4.000000 3.999878
 /begin AXIS_DESCR STD_AXIS RailP_pFlt Pres_Rail 3 0.00 2000.000 EXTENDED_LIMITS -3276.800 3276.700 DEPOSIT ABSOLUTE /end AXIS_DESCR
 /begin AXIS_DESCR STD_AXIS InjCtl_qSetUnBal InjMass 2 0.00 327.6700 EXTENDED_LIMITS -327.6800 327.6700 DEPOSIT ABSOLUTE /end AXIS_DESCR
/end CHARACTERISTIC
/begin CHARACTERISTIC InjVlv_facBalMax_C "Maximaler Korrekturfaktor für FBC-Eingriff" VALUE 0x8004C5F2 Val_Ws16 3.999878 Fact 0.00 3.999878 EXTENDED_LIMITS -4.000000 3.999878 /end CHARACTERISTIC
/begin CHARACTERISTIC InjVlv_nETMaxLim_C "maximale Drehzahl für die Begrenzung der Ansteuerdauer MI" VALUE 0x8004C5F6 Val_Ws16 10000.00 EngN 0.00 10000.00 EXTENDED_LIMITS -16384.00 16383.50 /end CHARACTERISTIC
/begin CHARACTERISTIC InjVlv_numBnkTDC_CA "Banknummer des Injektors (=x-1 für MVxy im Brunnerplan)" VAL_BLK 0x8004CCC0 ValA_Wu8 4.000 OneToOne 0.00 4.000 EXTENDED_LIMITS 0.00 255.0 NUMBER 6 /end CHARACTERISTIC
/begin CHARACTERISTIC InjVlv_numECUTDC_CA "Steuergerät, auf dem der Zylinder liegt (=0 für einzel-SG oder Master)" VAL_BLK 0x8004CCC6 ValA_Wu8 4.000 OneToOne 0.00 4.000 EXTENDED_LIMITS 0.00 255.0 NUMBER 6 /end CHARACTERISTIC
/begin CHARACTERISTIC InjVlv_numInjChrgBalRC_C "Vorgabewert für die Begrenzung der Anzahl der Einspritzungen durch die Ladungsbilanz" VALUE 0x8004C60E Val_Wu8 255.0 OneToOne 0.00 255.0 /end CHARACTERISTIC
/begin CHARACTERISTIC InjVlv_numInjChrgBal_CUR "Kennlinie für max. Anzahl an Einspritzungen aufgrund Ladungsbilanz Bufferkondensators" CURVE 0x8004C610 Cur_Xs16Ws16 8.000000 OneToOne 0.00 8.000000 EXTENDED_LIMITS -32768.00 32767.00
 /begin AXIS_DESCR STD_AXIS InjVlv_numInjChrgBalRaw_mp NumInjChrgBalRaw 10 -327.6800 327.6700 FORMAT "%8.4" DEPOSIT ABSOLUTE /end AXIS_DESCR
/end CHARACTERISTIC
/begin CHARACTERISTIC InjVlv_numInjDesRC_C "Vorgabewert für die geforderte Anzahl der Einspritzungen für die ladungsbilanzabhängige Abschaltung von Einspritzungen" VALUE 0x8004C63A Val_Wu8 255.0 OneToOne 0.00 255.0 /end CHARACTERISTIC
/begin CHARACTERISTIC InjVlv_numPrep_C "Anzahl der Ansteuerungen pro Aktor für die Injektorvorbereitung" VALUE 0x8004CCDE Val_Wu8 3.000 OneToOne 0.00 3.000 EXTENDED_LIMITS 0.00 255.0 /end CHARACTERISTIC
/begin CHARACTERISTIC InjVlv_numPsTDC_CA "Zuordnung zwischen Zylindernummer und Endstufennummer (=y-1 für MVxy im Brunnerplan)" VAL_BLK 0x8004CCCC ValA_Wu8 4.000 OneToOne 0.00 4.000 EXTENDED_LIMITS 0.00 255.0 NUMBER 6 /end CHARACTERISTIC
/begin CHARACTERISTIC InjVlv_pMin_C "Injektorabhängige Druckschwelle zur Freigabe/Sperrung der Einspritzung" VALUE 0x8004CD2E Val_Ws16 2000.000 Pres_Rail 0.00 2000.000 EXTENDED_LIMITS -3276.800 3276.700 /end CHARACTERISTIC
/begin CHARACTERISTIC InjVlv_pMin_CUR "Kühlmitteltemperaturabhängige Druckschwelle zur Freigabe der Einspritzungen" CURVE 0x8004CD30 Cur_Xs16Ws16 2000.000 Pres_Rail 0.00 2000.000 EXTENDED_LIMITS -3276.800 3276.700
 /begin AXIS_DESCR STD_AXIS EngDa_tEng Temp_Cels 8 -50.14000 199.8600 EXTENDED_LIMITS -3549.940 3003.560 DEPOSIT ABSOLUTE /end AXIS_DESCR
/end CHARACTERISTIC
/begin CHARACTERISTIC InjVlv_pPrepMax_C "Obere Raildruckschwelle der Injektorvorbereitung" VALUE 0x8004CCE0 Val_Ws16 2000.0000 Pres_Rail 0.00 2000.0000 EXTENDED_LIMITS -3276.8000 3276.7000 /end CHARACTERISTIC
/begin CHARACTERISTIC InjVlv_pwrDCDCMax_CUR "Kennlinie für max. zulässige Ausgangsleistung eines DCDC-Wandlers" CURVE 0x8004C63C Cur_Xs16Ws16 150000.0 Pwr_PA 0.00 150000.0 FORMAT "%8.1" EXTENDED_LIMITS -163840.0 163835.0
 /begin AXIS_DESCR STD_AXIS BattU_u Volt_Batt 10 -655360.0 655340.0 DEPOSIT ABSOLUTE /end AXIS_DESCR
/end CHARACTERISTIC
/begin CHARACTERISTIC InjVlv_pwrDCDCOvrLdMax_CUR "Kurve für max. zulässige Ausgangsleistung eines DCDC-Wandlers im Überlastbetrieb" CURVE 0x8004C666 Cur_Xs16Ws16 150000.0 Pwr_PA 0.00 150000.0 FORMAT "%8.1" EXTENDED_LIMITS -163840.0 163835.0
 /begin AXIS_DESCR STD_AXIS BattU_u Volt_Batt 10 -655360.0 655340.0 DEPOSIT ABSOLUTE /end AXIS_DESCR
/end CHARACTERISTIC
/begin CHARACTERISTIC InjVlv_PZOSW_C "Software Version" VALUE 0x8004CDF8 Val_Wu32 4294967295.00 OneToOne 0.00 4294967295.00 READ_ONLY /end CHARACTERISTIC
/begin CHARACTERISTIC InjVlv_qPoI1Min_C "Minimale Menge für die Nacheinspritzung 1" VALUE 0x8004CCDC Val_Ws16 327.6700 InjMass 0.00 327.6700 EXTENDED_LIMITS -327.6800 327.6700 /end CHARACTERISTIC
/begin CHARACTERISTIC InjVlv_rChrgBalInjHys_C "Hystereseschwelle für max. Anzahl an Einspritzungen über Ladungsbilanz des Buffer-Kondensators" VALUE 0x8004C690 Val_Ws16 100.0000 Prc 0.00 100.0000 EXTENDED_LIMITS -400.0000 399.9878 /end CHARACTERISTIC
/begin CHARACTERISTIC InjVlv_rGlobDynTimePrio_MAP "" MAP 0x8004CD52 Map_Xs16Ys16Ws16 100.0000 Prc 0.00 100.0000 EXTENDED_LIMITS -400.0000 399.9878
 /begin AXIS_DESCR STD_AXIS Epm_nEng EngN 8 20.00000 10000.00 EXTENDED_LIMITS -16384.00 16383.50 DEPOSIT ABSOLUTE /end AXIS_DESCR
 /begin AXIS_DESCR STD_AXIS InjCtl_qSetUnBal InjMass 8 0.00 327.6700 EXTENDED_LIMITS -327.6800 327.6700 DEPOSIT ABSOLUTE /end AXIS_DESCR
/end CHARACTERISTIC
/begin CHARACTERISTIC InjVlv_rOvrLdRlx_C "Vehältnis von Überlast zu Erhohlungsbetrieb (Auflösung ist 0,1, der Wert muß 10 mal größer sein als der erwartete Faktor)" VALUE 0x8004C692 Val_Wu8 24.90 FACT_Rlx 0.1000 25.00 FORMAT "%5.2" EXTENDED_LIMITS 0.00 25.50 /end CHARACTERISTIC
/begin CHARACTERISTIC InjVlv_stInjCharComp_C "Status der Kompensation der freigegebenen Einspritzungen" VALUE 0x8004CCD4 Val_Wu8 255.0 OneToOne 0.00 255.0 /end CHARACTERISTIC
/begin CHARACTERISTIC InjVlv_stInjCoRC_C "Zustand: Remotewert für den Ansteuerkoordinator" VALUE 0x8004CCD2 Val_Wu8 255.0 OneToOne 0.00 255.0 /end CHARACTERISTIC
/begin CHARACTERISTIC InjVlv_stInjRls_CA "status der freigegebenen Einspritzungen" VAL_BLK 0x8004CCD5 ValA_Wu8 255.0 OneToOne 0.00 255.0 NUMBER 6 /end CHARACTERISTIC
/begin CHARACTERISTIC InjVlv_stPrepRC_C "Remotewert für InjVlv_stPrep" VALUE 0x8004CCE2 Val_Wu8 255.0 OneToOne 0.00 255.0 /end CHARACTERISTIC
/begin CHARACTERISTIC InjVlv_stZFCETPoICorActv_C "" VALUE 0x8004C5F4 Val_Wu8 255.0 OneToOne 0.00 255.0 /end CHARACTERISTIC
/begin CHARACTERISTIC InjVlv_swtAgTi2AgMode_C "Schalter zum Umschalten zwischen MIAP und konstanter Extrapolation zur Ansteuerbeginnberechnung" VALUE 0x8004CDFC Val_Wu8 1.00000000000 InjVlv_AgTi2AgMode 0.00 1.00000000000 FORMAT "%13.11" /end CHARACTERISTIC
/begin CHARACTERISTIC InjVlv_swtEnaAgDiff_C "Ein-/Ausschalter zur Berechnung des Differenzwinkels (1: ein, 0: aus)" VALUE 0x8004CDFD Val_Wu8 1.000 OneToOne 0.00 1.000 EXTENDED_LIMITS 0.00 255.0 /end CHARACTERISTIC
/begin CHARACTERISTIC InjVlv_swtInjCoRC_C "Schalter: Zustand des Ansteuerkoordinators wird per Remote gestellt" VALUE 0x8004CCD3 Val_Wu8 1.000 OneToOne 0.00 1.000 EXTENDED_LIMITS 0.00 255.0 /end CHARACTERISTIC
/begin CHARACTERISTIC InjVlv_swtInputETMAP_C "Auswahl der Eingangsgrössen zur Darstellung von InjVlv_tiET_MAP auf dem Applikationstool." VALUE 0x8004C6A4 Val_Wu8 15.00 OneToOne 0.00 15.00 EXTENDED_LIMITS 0.00 255.0 /end CHARACTERISTIC
/begin CHARACTERISTIC InjVlv_swtNumInjRC_C "Schalter zur Aktivierung der Vorgabewerte der Anzahl von Einspritzungen" VALUE 0x8004C693 Val_Wu8 255.0 OneToOne 0.00 255.0 /end CHARACTERISTIC
/begin CHARACTERISTIC InjVlv_swtPrepRC_C "Schalter: Remotewert für InjVlv_stPrep aktivieren" VALUE 0x8004CCE3 Val_Wu8 1.000 OneToOne 0.00 1.000 EXTENDED_LIMITS 0.00 255.0 /end CHARACTERISTIC
/begin CHARACTERISTIC InjVlv_swtTiMI1ET_C "Schalter des Fernsteuerwerts der Ansteuerdauer MI" VALUE 0x8004C5F8 Val_Wu8 1.000 OneToOne 0.00 1.000 EXTENDED_LIMITS 0.00 255.0 /end CHARACTERISTIC
/begin CHARACTERISTIC InjVlv_swtTiPiI1ET_C "Schalter des Fernsteuerwerts der Ansteuerdauer PiI1" VALUE 0x8004C5FE Val_Wu8 1.000 OneToOne 0.00 1.000 EXTENDED_LIMITS 0.00 255.0 /end CHARACTERISTIC
/begin CHARACTERISTIC InjVlv_swtTiPiI2ET_C "Schalter des Fernsteuerwerts der Ansteuerdauer PiI2" VALUE 0x8004C602 Val_Wu8 1.000 OneToOne 0.00 1.000 EXTENDED_LIMITS 0.00 255.0 /end CHARACTERISTIC
/begin CHARACTERISTIC InjVlv_swtTiPoI1ET_C "Schalter des Fernsteuerwerts der Ansteuerdauer PoI1" VALUE 0x8004C606 Val_Wu8 1.000 OneToOne 0.00 1.000 EXTENDED_LIMITS 0.00 255.0 /end CHARACTERISTIC
/begin CHARACTERISTIC InjVlv_swtTiPoI2ET_C "Schalter des Fernsteuerwerts der Ansteuerdauer PoI2" VALUE 0x8004C60A Val_Wu8 1.000 OneToOne 0.00 1.000 EXTENDED_LIMITS 0.00 255.0 /end CHARACTERISTIC
/begin CHARACTERISTIC InjVlv_tiChrgPrep_CUR "Kennlinie: spannungsabhängige Ladezeit der Injektorvorbereitung" CURVE 0x8004CCE4 Cur_Xs16Ws16 4920.0000 InjTime_us 80.00000 5000.0000 EXTENDED_LIMITS -13107.20 13106.80
 /begin AXIS_DESCR STD_AXIS IVActr_tActr Temp_Cels 4 -3549.940 3003.560 DEPOSIT ABSOLUTE /end AXIS_DESCR
/end CHARACTERISTIC
/begin CHARACTERISTIC InjVlv_tiDisChPrep_CUR "Kennlinie: spannungsabhängige Entladezeit der Injektorvorbereitung" CURVE 0x8004CCF6 Cur_Xs16Ws16 4920.0000 InjTime_us 80.00000 5000.0000 EXTENDED_LIMITS -13107.20 13106.80
 /begin AXIS_DESCR STD_AXIS IVActr_tActr Temp_Cels 4 -3549.940 3003.560 DEPOSIT ABSOLUTE /end AXIS_DESCR
/end CHARACTERISTIC
/begin CHARACTERISTIC InjVlv_tiETMax_C "maximale Ansteuerdauer MI" VALUE 0x8004C5FA Val_Ws16 18107.20 InjTime_us -13107.20 5000.00 EXTENDED_LIMITS -13107.20 13106.80 /end CHARACTERISTIC
/begin CHARACTERISTIC InjVlv_tiETMinLow_C "Minimale Ansteuerdauer" VALUE 0x8004CDFE Val_Ws16 18107.20 InjTime_us -13107.20 5000.00 EXTENDED_LIMITS -13107.20 13106.80 /end CHARACTERISTIC
/begin CHARACTERISTIC InjVlv_tiETPrep_CUR "Kennlinie: temperaturabhängige Ansteuerdauer der Injektorvorbereitung" CURVE 0x8004CD08 Cur_Xs16Ws16 4900.000 InjTime_us 100.0000 5000.000 EXTENDED_LIMITS -13107.20 13106.80
 /begin AXIS_DESCR STD_AXIS IVActr_tActr Temp_Cels 4 -3549.940 3003.560 DEPOSIT ABSOLUTE /end AXIS_DESCR
/end CHARACTERISTIC
/begin CHARACTERISTIC InjVlv_tiET_MAP "Kennfeld zur Umrechnung von Einspritzmengen in Ansteuerdauer. Gilt für alle Einspritzungen." MAP 0x8004C6A6 Map_Xs16Ys16Ws16 5000.000 InjTime_us 0.00 5000.000 EXTENDED_LIMITS -13107.20 13106.80
 /begin AXIS_DESCR STD_AXIS InjVlv_pInET_mp Pres_Rail 18 0.00 2000.000 EXTENDED_LIMITS -3276.800 3276.700 DEPOSIT ABSOLUTE /end AXIS_DESCR
 /begin AXIS_DESCR STD_AXIS InjVlv_volInET_mp InjQntInj 40 0.00 327.6700 EXTENDED_LIMITS -327.6800 327.6700 DEPOSIT ABSOLUTE /end AXIS_DESCR
/end CHARACTERISTIC
/begin CHARACTERISTIC InjVlv_tiMI1ET_C "Fernsteuerwert der Ansteuerdauer MI" VALUE 0x8004C5FC Val_Ws16 18107.20 InjTime_us -13107.20 5000.00 EXTENDED_LIMITS -13107.20 13106.80 /end CHARACTERISTIC
/begin CHARACTERISTIC InjVlv_tiOvrLdMax_C "maximal erlaubte Überlastzeit" VALUE 0x8004C694 Val_Wu16 3599.000 Time_Second 1.000000 3600.000 FORMAT "%8.3" EXTENDED_LIMITS 0.00 65535.00 /end CHARACTERISTIC
/begin CHARACTERISTIC InjVlv_tiPause_C "physikalische bedingte Mindestzeit zwischen 2 Einspritzungen" VALUE 0x8004CE00 Val_Ws16 18107.20 InjTime_us -13107.20 5000.00 EXTENDED_LIMITS -13107.20 13106.80 /end CHARACTERISTIC
/begin CHARACTERISTIC InjVlv_tiPiI1ET_C "Fernsteuerwert der Ansteuerdauer PiI1" VALUE 0x8004C600 Val_Ws16 18107.20 InjTime_us -13107.20 5000.00 EXTENDED_LIMITS -13107.20 13106.80 /end CHARACTERISTIC
/begin CHARACTERISTIC InjVlv_tiPiI2ET_C "Fernsteuerwert der Ansteuerdauer PiI2" VALUE 0x8004C604 Val_Ws16 18107.20 InjTime_us -13107.20 5000.00 EXTENDED_LIMITS -13107.20 13106.80 /end CHARACTERISTIC
/begin CHARACTERISTIC InjVlv_tiPoI1ET_C "Fernsteuerwert der Ansteuerdauer PoI1" VALUE 0x8004C608 Val_Ws16 18107.20 InjTime_us -13107.20 5000.00 EXTENDED_LIMITS -13107.20 13106.80 /end CHARACTERISTIC
/begin CHARACTERISTIC InjVlv_tiPoI2ET_C "Fernsteuerwert der Ansteuerdauer PoI2" VALUE 0x8004C60C Val_Ws16 18107.20 InjTime_us -13107.20 5000.00 EXTENDED_LIMITS -13107.20 13106.80 /end CHARACTERISTIC
/begin CHARACTERISTIC InjVlv_tiWaitActv_C "minimale Wartezeit bis zur Freigabe der Überlastfunktion (seit dem ersten Aufruf der Funktion)" VALUE 0x8004C696 Val_Ws16 65535.00 Time_Second 0.00 65535.00 FORMAT "%8.2" EXTENDED_LIMITS -32768.00 32767.00 /end CHARACTERISTIC
/begin CHARACTERISTIC InjVlv_tiWup2On_C "Zeit zwischen dynamischem Interrupt und Bestromungsbeginn" VALUE 0x8004CCBE Val_Ws16 4900.000 InjTime_us 100.0000 5000.000 EXTENDED_LIMITS -13107.20 13106.80 /end CHARACTERISTIC
/begin CHARACTERISTIC InjVlv_tPrepMax_C "Obere Temperaturschwelle der Injektorvorbereitung" VALUE 0x8004CD1A Val_Ws16 100.0000 Temp_Cels -50.04000 49.96000 EXTENDED_LIMITS -3549.940 3003.560 /end CHARACTERISTIC
/begin CHARACTERISTIC InjVlv_uUpPrep_CUR "Kennlinie: temperaturabhängige Sollspannung der Injektorvorbereitung" CURVE 0x8004CD1C Cur_Xs16Ws16 130.0000 Vltg_PA 80.00000 210.0000 EXTENDED_LIMITS -327.6800 327.6700
 /begin AXIS_DESCR STD_AXIS IVActr_tActr Temp_Cels 4 -3549.940 3003.560 DEPOSIT ABSOLUTE /end AXIS_DESCR
/end CHARACTERISTIC
/begin CHARACTERISTIC InjVlv_wInj_CUR "Kennlinie für Energieverbrauch einer Piezo-Aktor-Ansteuerung" CURVE 0x8004C698 Cur_Xs16Ws16 100.0000 W_PA 0.00 100.0000 FORMAT "%8.4" EXTENDED_LIMITS -327.6800 327.6700
 /begin AXIS_DESCR STD_AXIS InjVlv_uSetUpAvrg_mp Vltg_PA 2 -327.6800 327.6700 DEPOSIT ABSOLUTE /end AXIS_DESCR
/end CHARACTERISTIC
/begin CHARACTERISTIC InjVlv_xOvrLdRlxThresh_C "maximale Schwelle um wieder die Freigabe des Überlastbetriebes zu erlauben, nachdem der Integrator 100% erreicht hat und im Erhohlungsbetrieb ist" VALUE 0x8004C6A2 Val_Ws16 100.0000 Prc 0.00 100.0000 EXTENDED_LIMITS -400.0000 399.9878 /end CHARACTERISTIC
/begin MEASUREMENT InjCrv_facPoI1APSQCor "Atmosphärendruckabhängiger Mengenkorrekturfaktor für PoI1" SWORD Fact 1 100 -4.000000 3.999878 ECU_ADDRESS 0xD0000DB8 /end MEASUREMENT
/begin MEASUREMENT InjCrv_facPoI1EffRgn "" SWORD Fact 1 100 -4.000000 3.999878 ARRAY_SIZE 2 ECU_ADDRESS 0xD0000DC0 /end MEASUREMENT
/begin MEASUREMENT InjCrv_facPoI1ETSQCor "Motortemperaturabhängiger Mengenkorrekturfaktor für PoI1" SWORD Fact 1 100 -4.000000 3.999878 ECU_ADDRESS 0xD0000DBC /end MEASUREMENT
/begin MEASUREMENT InjCrv_facPoI1ETStiCor "" SWORD Fact 1 100 -4.000000 3.999878 ECU_ADDRESS 0xD0000DBE /end MEASUREMENT
/begin MEASUREMENT InjCrv_facPoI1QntRmpVal_mp "Interpolationsfaktor für die Funktion InjCrv_PoI1RgnSwtQ" SWORD CoEOMSwt_S16 1 100 -2.000000 1.999939 FORMAT "%8.6" ECU_ADDRESS 0xC000A1D2 /end MEASUREMENT
/begin MEASUREMENT InjCrv_facPoI1SOERmpVal_mp "Interpolationsfaktor für die Funktion InjCrv_PoI1RgnSWtSOE" SWORD CoEOMSwt_S16 1 100 -2.000000 1.999939 FORMAT "%8.6" ECU_ADDRESS 0xC000A1D4 /end MEASUREMENT
/begin MEASUREMENT InjCrv_facPoI2AngRmpVal_mp "Interpolationsfaktor für die Funktion InjCrv_PoI2RgnSwtSOE (Winkelkomponent)" SWORD CoEOMSwt_S16 1 100 -2.000000 1.999939 FORMAT "%8.6" ECU_ADDRESS 0xC000A22C /end MEASUREMENT
/begin MEASUREMENT InjCrv_facPoI2APSQCor "Luftdruckabhängiger Mengenkorrekturfaktor für PoI2" SWORD Fact 1 100 -4.000000 3.999878 ECU_ADDRESS 0xD0000DC6 /end MEASUREMENT
/begin MEASUREMENT InjCrv_facPoI2APSQCorRgn "atmosphärendruckabhängiger Korrekturfaktor für die PoI2 im Regenerationsbetrieb" SWORD Fact 1 100 -4.000000 3.999878 ARRAY_SIZE 2 ECU_ADDRESS 0xD0000DC8 /end MEASUREMENT
/begin MEASUREMENT InjCrv_facPoI2APSQCorStrt "Atmosphärendruckabhängiger Mengenkorrekturfaktor für Nacheinspritzung 2 im Startzustand." SWORD Fact 1 100 -4.000000 3.999878 ECU_ADDRESS 0xD0000DCC /end MEASUREMENT
/begin MEASUREMENT InjCrv_facPoI2APSSOECor "Luftdruckabhängiger Ansteuerbeginnkorrekturfaktor für PoI2" SWORD Fact 1 100 -4.000000 3.999878 ECU_ADDRESS 0xD0000DCE /end MEASUREMENT
/begin MEASUREMENT InjCrv_facPoI2APSSOECorRgn "atmosphärendruckabhängiger Winkelkorrekturfaktoren für PoI2 im Regenerationsbetrieb" SWORD Fact 1 100 -4.000000 3.999878 ARRAY_SIZE 2 ECU_ADDRESS 0xD0000DD0 /end MEASUREMENT
/begin MEASUREMENT InjCrv_facPoI2APSTICorRgn "atmosphärendruckabhängiger Ansteuerbeginn zeit korrektur faktoren für PoI2 im Regenerationsbetrieb" SWORD Fact 1 100 -4.000000 3.999878 ARRAY_SIZE 2 ECU_ADDRESS 0xD0000DD4 /end MEASUREMENT
/begin MEASUREMENT InjCrv_facPoI2ATSQCor "ansauglufttemperaturabhängiger Mengenkorrekturfaktor für PoI2" SWORD Fact 1 100 -4.000000 3.999878 ECU_ADDRESS 0xD0000DD8 /end MEASUREMENT
/begin MEASUREMENT InjCrv_facPoI2ATSQCorRgn "ansauglufttemperaturabhängiger Mengenkorrekturfaktor für den Regenerationsbetrieb für die PoI2" SWORD Fact 1 100 -4.000000 3.999878 ARRAY_SIZE 2 ECU_ADDRESS 0xD0000DDA /end MEASUREMENT
/begin MEASUREMENT InjCrv_facPoI2ATSQCorStrt "Ansauglufttemperaturabhängiger Mengenkorrekturfaktor für Nacheinspritzung 2." SWORD Fact 1 100 -4.000000 3.999878 ECU_ADDRESS 0xD0000DDE /end MEASUREMENT
/begin MEASUREMENT InjCrv_facPoI2ATSSOECor "ansauglufttemperaturabhängiger Ansteuerbeginnkorrekturfaktor für PoI2" SWORD Fact 1 100 -4.000000 3.999878 ECU_ADDRESS 0xD0000DE0 /end MEASUREMENT
/begin MEASUREMENT InjCrv_facPoI2ATSSOECorRgn "Ansauglufttemperaturabhängige Winkelkorrekturfaktoren für PoI2 im Regenerationsbetrieb" SWORD Fact 1 100 -4.000000 3.999878 ARRAY_SIZE 2 ECU_ADDRESS 0xD0000DE2 /end MEASUREMENT
/begin MEASUREMENT InjCrv_facPoI2EffRgn "Faktor für den drehmomentbildenden Anteil der Einspritzmenge PoI2 im Regenerationsmodus" SWORD Fact 1 100 -4.000000 3.999878 ARRAY_SIZE 2 ECU_ADDRESS 0xD0000DFA /end MEASUREMENT
/begin MEASUREMENT InjCrv_facPoI2EffSet "Faktor für den drehmomentbildenden Anteil der Einspritzmenge PoI2 (Sollwert)" SWORD Fact 1 100 -4.000000 3.999878 ECU_ADDRESS 0xD0000DFE /end MEASUREMENT
/begin MEASUREMENT InjCrv_facPoI2Eff_mp "Faktor für Drehmoment bildenden Anteil der Einspritzmenge PoI2" SWORD Fact 1 100 -4.000000 3.999878 ECU_ADDRESS 0xC000A1DC /end MEASUREMENT
/begin MEASUREMENT InjCrv_facPoI2ETSQCor "motortemperaturabhängiger Mengenkorrekturfaktor für PoI2" SWORD Fact 1 100 -4.000000 3.999878 ECU_ADDRESS 0xD0000DE6 /end MEASUREMENT
/begin MEASUREMENT InjCrv_facPoI2ETSQCorRgn "motortemperaturabhängiger Mengenkorrekturfaktor für den Regenerationsbetrieb für die PoI2" SWORD Fact 1 100 -4.000000 3.999878 ARRAY_SIZE 2 ECU_ADDRESS 0xD0000DE8 /end MEASUREMENT
/begin MEASUREMENT InjCrv_facPoI2ETSQCorStrt "Motortemperaturabhängiger Mengenkorrekturfaktor für Nacheinspritzung 2 im Startzustand." SWORD Fact 1 100 -4.000000 3.999878 ECU_ADDRESS 0xD0000DEC /end MEASUREMENT
/begin MEASUREMENT InjCrv_facPoI2ETSSOECor "motortemperaturabhängiger Ansteuerbeginnkorrekturfaktor für PoI2" SWORD Fact 1 100 -4.000000 3.999878 ECU_ADDRESS 0xD0000DEE /end MEASUREMENT
/begin MEASUREMENT InjCrv_facPoI2ETSSOECorRgn "motortemperaturabhängiger Ansteuerbeginnkorrekturfaktor für den Regenerationsbetrieb für die PoI2" SWORD Fact 1 100 -4.000000 3.999878 ARRAY_SIZE 2 ECU_ADDRESS 0xD0000DF0 /end MEASUREMENT
/begin MEASUREMENT InjCrv_facPoI2ETSSOECorStrt "Motortemperaturabhängiger Ansteuerbeginnkorrekturfaktor für Nacheinspritzung 2 im Startzustand." SWORD Fact 1 100 -4.000000 3.999878 ECU_ADDRESS 0xD0000DF4 /end MEASUREMENT
/begin MEASUREMENT InjCrv_facPoI2ETSTICorRgn "motortemperaturabhängiger Ansteuerbeginn zeit korrektur faktoren für PoI2 im Regenerationsbetrieb" SWORD Fact 1 100 -4.000000 3.999878 ARRAY_SIZE 2 ECU_ADDRESS 0xD0000DF6 /end MEASUREMENT
/begin MEASUREMENT InjCrv_facPoI2QntRmpVal_mp "Interpolationsfaktor für die Funktion InjCrv_PoI2RgnSwtQ" SWORD CoEOMSwt_S16 1 100 -2.000000 1.999939 FORMAT "%8.6" ECU_ADDRESS 0xC000A22E /end MEASUREMENT
/begin MEASUREMENT InjCrv_facPoI2SOEtiRmpVal_mp "Interpolationsfaktor für die Funktion InjCrv_PoI2RgnSwtSOE" SWORD CoEOMSwt_S16 1 100 -2.000000 1.999939 FORMAT "%8.6" ECU_ADDRESS 0xC000A234 /end MEASUREMENT
/begin MEASUREMENT InjCrv_facPoI2TiRmpVal_mp "Interpolationsfaktor für die Funktion InjCrv_PoI2RgnSwtSOE (Zeitkomponent)" SWORD CoEOMSwt_S16 1 100 -2.000000 1.999939 FORMAT "%8.6" ECU_ADDRESS 0xC000A230 /end MEASUREMENT
/begin MEASUREMENT InjCrv_facPOpPoI2ETSCor "Motortemperaturabhängiger Freigabekorrekturfaktor für PoI2" SWORD Fact 1 100 -4.000000 3.999878 ECU_ADDRESS 0xD0000D22 /end MEASUREMENT
/begin MEASUREMENT InjCrv_facPOpPoI2ETSCorStrt "Motortemperaturabhängiger Freigabekorrekturfaktor für Nacheinspritzung 2 im Startzustand." SWORD Fact 1 100 -4.000000 3.999878 ECU_ADDRESS 0xD0000D24 /end MEASUREMENT
/begin MEASUREMENT InjCrv_numPoI1RgnStg_mp "Anzahl der eingestellten Regenerationsstufen für die PoI1" UBYTE OneToOne 1 100 0.00 255.0 ECU_ADDRESS 0xC000B24D /end MEASUREMENT
/begin MEASUREMENT InjCrv_numPoI2RgnStg_mp "Anzahl der eingestellten Regenerationsstufen für die PoI2" UBYTE OneToOne 1 100 0.00 255.0 ECU_ADDRESS 0xC000B252 /end MEASUREMENT
/begin MEASUREMENT InjCrv_phiPoI2AbsTot_mp "absoluter Ansteuerbeginn PoI2 aus Winkel- und Zeitkomponente" SWORD AngleCrS 1 100 -720.0000 719.9780 ECU_ADDRESS 0xC000A1DE /end MEASUREMENT
/begin MEASUREMENT InjCrv_phiPoI2Abs_mp "Sollwert, Winkelkomponente Ansteuerbeginn PoI2 relativ zum oberen Totpunkt" SWORD AngleCrS 1 100 -720.0000 719.9780 ECU_ADDRESS 0xC000A1E0 /end MEASUREMENT
/begin MEASUREMENT InjCrv_phiPoI2AddCor "kundenspezifischer Korrekturwinkel für PoI2" SWORD AngleCrS 1 100 -720.0000 719.9780 ECU_ADDRESS 0xD0000E52 /end MEASUREMENT
/begin MEASUREMENT InjCrv_phiPoI2APSCorRgn_mp "Gewichtete Winkelkorrekturen abhängig von dem Umgebungsluftdruck für die PoI2 im Regenerationsbetrieb" SWORD AngleCrS 1 100 -720.0000 719.9780 ARRAY_SIZE 2 ECU_ADDRESS 0xC000C0D4 /end MEASUREMENT
/begin MEASUREMENT InjCrv_phiPoI2APSCor_mp "Luftdruckabhängiger Korrekturgrundwert für die Winkelkomponente des Ansteuerbeginns der PoI2" SWORD AngleCrS 1 100 -720.0000 719.9780 ECU_ADDRESS 0xC000A21C /end MEASUREMENT
/begin MEASUREMENT InjCrv_phiPoI2ATSCorRgn_mp "Gewichtete Winkelkorrekturen abhängig von der Ansauglufttemperatur für die PoI2 im Regenerationsbetrieb" SWORD AngleCrS 1 100 -720.0000 719.9780 ARRAY_SIZE 2 ECU_ADDRESS 0xC000C0D8 /end MEASUREMENT
/begin MEASUREMENT InjCrv_phiPoI2ATSCor_mp "ansauglufttemperaturabhängiger Korrekturgrundwert für die Winkelkomponente des Ansteuerbeginns der PoI2" SWORD AngleCrS 1 100 -720.0000 719.9780 ECU_ADDRESS 0xC000A21E /end MEASUREMENT
/begin MEASUREMENT InjCrv_phiPoI2BasRgn_mp "Grundwert der Winkelkomponente Ansteuerbeginn PoI2 im Regenerationsbetrieb" SWORD AngleCrS 1 100 -720.0000 719.9780 ARRAY_SIZE 2 ECU_ADDRESS 0xC000C0F4 /end MEASUREMENT
/begin MEASUREMENT InjCrv_phiPoI2Bas_mp "Winkelkomponente Ansteuerbeginn PoI2 Grundwert" SWORD AngleCrS 1 100 -720.0000 719.9780 ECU_ADDRESS 0xC000A240 /end MEASUREMENT
/begin MEASUREMENT InjCrv_phiPoI2Byp_mp "Messpunkt für Bypass" SWORD AngleCrS 1 100 -720.0000 719.9780 ECU_ADDRESS 0xC000A1E2 /end MEASUREMENT
/begin MEASUREMENT InjCrv_phiPoI2Cor_mp "korrigierter Grundwert der Winkelkomponente Ansteuerbeginn PoI2" SWORD AngleCrS 1 100 -720.0000 719.9780 ECU_ADDRESS 0xC000A1E4 /end MEASUREMENT
/begin MEASUREMENT InjCrv_phiPoI2Des "gewünschter Bezugswinkel für Beginn der PoI2" SWORD AngleCrS 1 100 -720.0000 719.9780 ECU_ADDRESS 0xD0000E54 /end MEASUREMENT
/begin MEASUREMENT InjCrv_phiPoI2DesAdd_mp "Additiver Bypasseingriff für gewünschten Winkel der Nacheinspritzung 2" SWORD AngleCrS 1 100 -720.0000 719.9780 ECU_ADDRESS 0xC000A1E6 /end MEASUREMENT
/begin MEASUREMENT InjCrv_phiPoI2DesTot_mp "Gewünschter Gesamtwinkel für Beginn der PoI2 inklusive Zeitkomponente" SWORD AngleCrS 1 100 -720.0000 719.9780 ECU_ADDRESS 0xC000A236 /end MEASUREMENT
/begin MEASUREMENT InjCrv_phiPoI2EnvCor "Korrekturwinkel für PoI2" SWORD AngleCrS 1 100 -720.0000 719.9780 ECU_ADDRESS 0xD0000E56 /end MEASUREMENT
/begin MEASUREMENT InjCrv_phiPoI2EnvCorRgn "Umgebungsbedingungsabhängige Korrekturwinkel für Nacheinspritzung 2 im Regenerationsbetrieb" SWORD AngleCrS 1 100 -720.0000 719.9780 ARRAY_SIZE 2 ECU_ADDRESS 0xD0000E58 /end MEASUREMENT
/begin MEASUREMENT InjCrv_phiPoI2ETSCorRgn_mp "Gewichtete Winkelkorrekturen abhängig von der Motortemperatur für die PoI2 im Regenerationsbetrieb" SWORD AngleCrS 1 100 -720.0000 719.9780 ARRAY_SIZE 2 ECU_ADDRESS 0xC000C0DC /end MEASUREMENT
/begin MEASUREMENT InjCrv_phiPoI2ETSCor_mp "motortemperaturabhängiger Korrekturgrundwert für die Winkelkomponente des Ansteuerbeginns der PoI2" SWORD AngleCrS 1 100 -720.0000 719.9780 ECU_ADDRESS 0xC000A220 /end MEASUREMENT
/begin MEASUREMENT InjCrv_phiPoI2MaxRgn_mp "Grundgrenzwert der Winkelkomponente Ansteuerbeginn PoI2 im Regenerationsbetrieb" SWORD AngleCrS 1 100 -720.0000 719.9780 ECU_ADDRESS 0xC000A22A /end MEASUREMENT
/begin MEASUREMENT InjCrv_phiPoI2MinOilDil_mp "Spätester Ansteuerbeginn der PoI2 bei Vorliegen einer Abschaltanforderung aufgrund Ölverdünnung" SWORD AngleCrS 1 100 -720.0000 719.9780 ECU_ADDRESS 0xC000A238 /end MEASUREMENT
/begin MEASUREMENT InjCrv_phiPoI2NrmVal_mp "Eingangswert für den Normalwerteingang in der Funktion EGT_RgnSwtSE in der Funktion InjCrv_PoI2RgnSwtSOE" SWORD AngleCrS 1 100 -720.0000 719.9780 ECU_ADDRESS 0xC000A232 /end MEASUREMENT
/begin MEASUREMENT InjCrv_phiPoI2Rel_mp "Winkelkomponente Ansteuerbeginn PoI2 relativ zur Haupteinspritzung" SWORD AngleCrS 1 100 -720.0000 719.9780 ECU_ADDRESS 0xC000A1E8 /end MEASUREMENT
/begin MEASUREMENT InjCrv_phiPoI2Rgn "Grundwert der Winkelkomponente Ansteuerbeginn PoI2 im Regenerationsbetrieb" SWORD AngleCrS 1 100 -720.0000 719.9780 ARRAY_SIZE 2 ECU_ADDRESS 0xD0000E5C /end MEASUREMENT
/begin MEASUREMENT InjCrv_phiPoI2RgnAdd_mp "Additiver Bypasseingriff für Winkel der Nacheinspritzung 2 im Regenerationsbetrieb" SWORD AngleCrS 1 100 -720.0000 719.9780 ARRAY_SIZE 2 ECU_ADDRESS 0xC000C0F8 /end MEASUREMENT
/begin MEASUREMENT InjCrv_POpPoI1Bas_mp "Grundwert Freigabe PoI1" SWORD OneToOne 1 100 -32768.00 32767.00 ECU_ADDRESS 0xC000A1D6 /end MEASUREMENT
/begin MEASUREMENT InjCrv_POpPoI1EnvCor "Freigabekorrekturwert für PoI1" SWORD OneToOne 1 100 -32768.00 32767.00 ECU_ADDRESS 0xD0000CEA /end MEASUREMENT
/begin MEASUREMENT InjCrv_POpPoI1Rgn_mp "Basis Regenerationswert für die Freigabe von PoI1" SWORD OneToOne 1 100 -32768.00 32767.00 ECU_ADDRESS 0xC000A1D8 /end MEASUREMENT
/begin MEASUREMENT InjCrv_POpPoI1_mp "korrigierter Grundwert Freigabe PoI1" SWORD OneToOne 1 100 -32768.00 32767.00 ECU_ADDRESS 0xC000A1DA /end MEASUREMENT
/begin MEASUREMENT InjCrv_POpPoI2AddCor "kundenspezifischer Korrekturwert für Freigabe PoI2" SWORD OneToOne 1 100 -32768.00 32767.00 ECU_ADDRESS 0xD0000CEC /end MEASUREMENT
/begin MEASUREMENT InjCrv_POpPoI2BasStrt_mp "Grundwert für Freigabe PoI2 im Startzustand" SWORD OneToOne 1 100 -32768.00 32767.00 ECU_ADDRESS 0xC000A244 /end MEASUREMENT
/begin MEASUREMENT InjCrv_POpPoI2Bas_mp "Basiswert für die betriebspunktabhängige Freigabe der PoI2" SWORD OneToOne 1 100 -32768.00 32767.00 ECU_ADDRESS 0xC000A23A /end MEASUREMENT
/begin MEASUREMENT InjCrv_POpPoI2EnvCor "Korrekturwert für Freigabe PoI2" SWORD OneToOne 1 100 -32768.00 32767.00 ECU_ADDRESS 0xD0000CEE /end MEASUREMENT
/begin MEASUREMENT InjCrv_POpPoI2EnvCorStrt "Korrekturwert für Freigabe PoI2 im Startzustand" SWORD OneToOne 1 100 -32768.00 32767.00 ECU_ADDRESS 0xD0000CF0 /end MEASUREMENT
/begin MEASUREMENT InjCrv_POpPoI2Rgn_mp "Basis Regenerationswert für die Freigabe von PoI2" SWORD OneToOne 1 100 -32768.00 32767.00 ECU_ADDRESS 0xC000A23C /end MEASUREMENT
/begin MEASUREMENT InjCrv_POpPoI2_mp "Freigabe PoI2, korrigierter Grundwert" SWORD OneToOne 1 100 -32768.00 32767.00 ECU_ADDRESS 0xC000A23E /end MEASUREMENT
/begin MEASUREMENT InjCrv_qLamUnCor "" SWORD InjMass 1 100 -327.6800 327.6700 ECU_ADDRESS 0xD0000E60 /end MEASUREMENT
/begin MEASUREMENT InjCrv_qMI1MinPoI2_mp "Minimale Einspritzmenge der MI1 bei der PoI2 Berechnung" SWORD InjMass 1 100 -327.6800 327.6700 ECU_ADDRESS 0xC000A1EA /end MEASUREMENT
/begin MEASUREMENT InjCrv_qPiI1MinWv_mp "Minimalmenge der PiI1 mit Wellenkorrektur" SWORD InjMass 1 100 -327.6800 327.6700 ECU_ADDRESS 0xC000A24C /end MEASUREMENT
/begin MEASUREMENT InjCrv_qPoI1APSCor_mp "atmosphärendruckabhängige Korrekturmenge für PoI1" SWORD InjMass 1 100 -327.6800 327.6700 ECU_ADDRESS 0xC000A1CE /end MEASUREMENT
/begin MEASUREMENT InjCrv_qPoI1BasRgn_mp "Basiswert für die Mengenkorrektur der Nacheinspritzung 1 im Regenerationsbetrieb" SWORD InjMass 1 100 -327.6800 327.6700 ARRAY_SIZE 2 ECU_ADDRESS 0xC000C0B0 /end MEASUREMENT
/begin MEASUREMENT InjCrv_qPoI1EnvCor "umgebungsbedingungsabhängige Korrekturmenge für PoI1" SWORD InjMass 1 100 -327.6800 327.6700 ECU_ADDRESS 0xD0000EE6 /end MEASUREMENT
/begin MEASUREMENT InjCrv_qPoI1ETSCor_mp "motortemperaturabhängige Korrekturmenge für PoI1" SWORD InjMass 1 100 -327.6800 327.6700 ECU_ADDRESS 0xC000A1D0 /end MEASUREMENT
/begin MEASUREMENT InjCrv_qPoI1Rgn "Grundwert Einspritzmenge PoI1 im Regenerationsbetrieb" SWORD InjMass 1 100 -327.6800 327.6700 ARRAY_SIZE 2 ECU_ADDRESS 0xD0000EE8 /end MEASUREMENT
/begin MEASUREMENT InjCrv_qPoI1RgnAdd_mp "Additiver Bypasseingriff für Menge der Nacheinspritzung 1 im Regenerationsbetrieb" SWORD InjMass 1 100 -327.6800 327.6700 ARRAY_SIZE 2 ECU_ADDRESS 0xC000C0B4 /end MEASUREMENT
/begin MEASUREMENT InjCrv_qPoI2AddCor "kundenspezifische Korrekturmenge für PoI2" SWORD InjMass 1 100 -327.6800 327.6700 ECU_ADDRESS 0xD0000EEC /end MEASUREMENT
/begin MEASUREMENT InjCrv_qPoI2APSCorRgn_mp "Luftdruckbhängiger Basismengenkorrekturwert der PoI2 im Regenerationsbetrieb" SWORD InjMass 1 100 -327.6800 327.6700 ARRAY_SIZE 2 ECU_ADDRESS 0xC000C0E0 /end MEASUREMENT
/begin MEASUREMENT InjCrv_qPoI2APSCorStrt_mp "Atmosphärendruckabhängiges Mengenkorrektur für PoI2 im Startzustand." SWORD InjMass 1 100 -327.6800 327.6700 ECU_ADDRESS 0xC000A210 /end MEASUREMENT
/begin MEASUREMENT InjCrv_qPoI2APSCor_mp "Luftdruckabhängige Korrekturmenge für PoI2" SWORD InjMass 1 100 -327.6800 327.6700 ECU_ADDRESS 0xC000A212 /end MEASUREMENT
/begin MEASUREMENT InjCrv_qPoI2ATSCorRgn_mp "Lufttemperaturabhängiger Basismengenkorrekturwert der PoI2 im Regenerationsbetrieb" SWORD InjMass 1 100 -327.6800 327.6700 ARRAY_SIZE 2 ECU_ADDRESS 0xC000C0E4 /end MEASUREMENT
/begin MEASUREMENT InjCrv_qPoI2ATSCorStrt_mp "Ansauglufttemperaturabhängiges Mengenkorrektur für PoI2 im Startzustand." SWORD InjMass 1 100 -327.6800 327.6700 ECU_ADDRESS 0xC000A214 /end MEASUREMENT
/begin MEASUREMENT InjCrv_qPoI2ATSCor_mp "ansauglufttemperaturabhängige Korrekturmenge für PoI2" SWORD InjMass 1 100 -327.6800 327.6700 ECU_ADDRESS 0xC000A216 /end MEASUREMENT
/begin MEASUREMENT InjCrv_qPoI2BasRgn_mp "Einspritzmenge PoI2 Grundwert für den Regenerationsbetrieb" SWORD InjMass 1 100 -327.6800 327.6700 ARRAY_SIZE 2 ECU_ADDRESS 0xC000C0FC /end MEASUREMENT
/begin MEASUREMENT InjCrv_qPoI2BasStrt_mp "Einspritzmenge PoI2 Grundwert im Startzustand." SWORD InjMass 1 100 -327.6800 327.6700 ECU_ADDRESS 0xC000A246 /end MEASUREMENT
/begin MEASUREMENT InjCrv_qPoI2Bas_mp "Einspritzmenge PoI2 Grundwert" SWORD InjMass 1 100 -327.6800 327.6700 ECU_ADDRESS 0xC000A1EC /end MEASUREMENT
/begin MEASUREMENT InjCrv_qPoI2Cor_mp "korrigierter Grundwert der Einspritzmenge PoI2" SWORD InjMass 1 100 -327.6800 327.6700 ECU_ADDRESS 0xC000A1EE /end MEASUREMENT
/begin MEASUREMENT InjCrv_qPoI2Des "Sollmenge Nacheinspritzung 2" SWORD InjMass 1 100 -327.6800 327.6700 ARRAY_SIZE 6 ECU_ADDRESS 0xD0000EEE /end MEASUREMENT
/begin MEASUREMENT InjCrv_qPoI2DesAdd_mp "Additiver Bypasseingriff für gewünschte Menge der Nacheinspritzung 2" SWORD InjMass 1 100 -327.6800 327.6700 ARRAY_SIZE 6 ECU_ADDRESS 0xC000C0BC /end MEASUREMENT
/begin MEASUREMENT InjCrv_qPoI2DesByp_mp "Messpunkt für den Bypass" SWORD InjMass 1 100 -327.6800 327.6700 ECU_ADDRESS 0xC000A1F0 /end MEASUREMENT
/begin MEASUREMENT InjCrv_qPoI2Des_mp "Sollmenge Nacheinspritzung 2" SWORD InjMass 1 100 -327.6800 327.6700 ECU_ADDRESS 0xC000A1F2 /end MEASUREMENT
/begin MEASUREMENT InjCrv_qPoI2Eff "wirksame Einspritzmenge PoI2" SWORD InjMass 1 100 -327.6800 327.6700 ARRAY_SIZE 6 ECU_ADDRESS 0xD0000EFA /end MEASUREMENT
/begin MEASUREMENT InjCrv_qPoI2EffAdd_mp "Additiver Bypasseingriff für Effektivmenge der Nacheinspritzung 2" SWORD InjMass 1 100 -327.6800 327.6700 ARRAY_SIZE 6 ECU_ADDRESS 0xC000C0C8 /end MEASUREMENT
/begin MEASUREMENT InjCrv_qPoI2EffByp_mp "Messpunkt für den Bypass" SWORD InjMass 1 100 -327.6800 327.6700 ECU_ADDRESS 0xC000A1F4 /end MEASUREMENT
/begin MEASUREMENT InjCrv_qPoI2Eff_mp "Wirksame Menge der PoI2" SWORD InjMass 1 100 -327.6800 327.6700 ECU_ADDRESS 0xC000A1F6 /end MEASUREMENT
/begin MEASUREMENT InjCrv_qPoI2EnvCor "Korrekturmenge für PoI2" SWORD InjMass 1 100 -327.6800 327.6700 ECU_ADDRESS 0xD0000F06 /end MEASUREMENT
/begin MEASUREMENT InjCrv_qPoI2EnvCorRgn "Umgebungsbedingungsabhängige Korrekturmenge für Nacheinspritzung 2 im Regenerationsbetrieb" SWORD InjMass 1 100 -327.6800 327.6700 ARRAY_SIZE 2 ECU_ADDRESS 0xD0000F08 /end MEASUREMENT
/begin MEASUREMENT InjCrv_qPoI2EnvCorStrt "Korrekturmenge für PoI2 im Startzustand" SWORD InjMass 1 100 -327.6800 327.6700 ECU_ADDRESS 0xD0000F0C /end MEASUREMENT
/begin MEASUREMENT InjCrv_qPoI2ETSCorRgn_mp "Motortemperaturabhängiger Basismengenkorrekturwert der PoI2 im Regenerationsbetrieb" SWORD InjMass 1 100 -327.6800 327.6700 ARRAY_SIZE 2 ECU_ADDRESS 0xC000C0E8 /end MEASUREMENT
/begin MEASUREMENT InjCrv_qPoI2ETSCorStrt_mp "Motortemperaturabhängiges Mengenkorrektur für PoI2 im Startzustand." SWORD InjMass 1 100 -327.6800 327.6700 ECU_ADDRESS 0xC000A218 /end MEASUREMENT
/begin MEASUREMENT InjCrv_qPoI2ETSCor_mp "motortemperaturabhängige Korrekturmenge für PoI2" SWORD InjMass 1 100 -327.6800 327.6700 ECU_ADDRESS 0xC000A21A /end MEASUREMENT
/begin MEASUREMENT InjCrv_qPoI2Lim_mp "begrenzter Sollwert, Einspritzmenge PoI2" SWORD InjMass 1 100 -327.6800 327.6700 ECU_ADDRESS 0xC000A1F8 /end MEASUREMENT
/begin MEASUREMENT InjCrv_qPoI2Max_mp "Maximale PoI2-Menge (obere Einspritzmengengrenze)" SWORD InjMass 1 100 -327.6800 327.6700 ECU_ADDRESS 0xC000A1FA /end MEASUREMENT
/begin MEASUREMENT InjCrv_qPoI2Min_mp "minimale Einspritzmenge PoI2" SWORD InjMass 1 100 -327.6800 327.6700 ECU_ADDRESS 0xC000A1FC /end MEASUREMENT
/begin MEASUREMENT InjCrv_qPoI2Rgn "Grundwert Einspritzmenge PoI2 im Regenerationsbetrieb" SWORD InjMass 1 100 -327.6800 327.6700 ARRAY_SIZE 2 ECU_ADDRESS 0xD0000F0E /end MEASUREMENT
/begin MEASUREMENT InjCrv_qPoI2RgnAdd_mp "Additiver Bypasseingriff für Menge der Nacheinspritzung 2 im Regenerationsbtrieb" SWORD InjMass 1 100 -327.6800 327.6700 ARRAY_SIZE 2 ECU_ADDRESS 0xC000C100 /end MEASUREMENT
/begin MEASUREMENT InjCrv_qPoI2Set_mp "Sollwert Einspritzmenge PoI2" SWORD InjMass 1 100 -327.6800 327.6700 ECU_ADDRESS 0xC000A1FE /end MEASUREMENT
/begin MEASUREMENT InjCrv_qPoIOvrAct_mp "" SLONG InjMassTot 1 100 -21474836.4800 21474836.4700 FORMAT "%13.4" ECU_ADDRESS 0xC0008FA8 /end MEASUREMENT
/begin MEASUREMENT InjCrv_qPoIOvrTot_mp "" SLONG InjMassTot 1 100 -21474836.4800 21474836.4700 FORMAT "%13.4" ECU_ADDRESS 0xC0008FAC /end MEASUREMENT
/begin MEASUREMENT InjCrv_qPoIRem "" SWORD InjMass 1 100 -327.6800 327.6700 ARRAY_SIZE 6 ECU_ADDRESS 0xD0000F12 /end MEASUREMENT
/begin MEASUREMENT InjCrv_qPoI_mp "" SWORD InjMassInj 1 100 -327.6800 327.6700 ECU_ADDRESS 0xC000A24A /end MEASUREMENT
/begin MEASUREMENT InjCrv_stActValPoI1_mp "Aktueller Betriebsmodus der PoI1" UBYTE INJCRV_MSK_VERB 1 100 0.00 7.00000000000 FORMAT "%13.11" ECU_ADDRESS 0xC000B24E /end MEASUREMENT
/begin MEASUREMENT InjCrv_stActValPoI2_mp "Aktueller Betriebsmodus der PoI2" UBYTE INJCRV_MSK_VERB 1 100 0.00 7.00000000000 FORMAT "%13.11" ECU_ADDRESS 0xC000B253 /end MEASUREMENT
/begin MEASUREMENT InjCrv_stDesValPoI1_mp "Gewünschter Betriebsmodus der PoI1" UBYTE INJCRV_MSK_VERB 1 100 0.00 7.00000000000 FORMAT "%13.11" ECU_ADDRESS 0xC000B24F /end MEASUREMENT
/begin MEASUREMENT InjCrv_stDesValPoI2_mp "Gewünschter Betriebsmodus der PoI2" UBYTE INJCRV_MSK_VERB 1 100 0.00 7.00000000000 FORMAT "%13.11" ECU_ADDRESS 0xC000B254 /end MEASUREMENT
/begin MEASUREMENT InjCrv_stInjCharComp "Status der Mengenkompensation der abgeschalteten Einspritzungen" UBYTE OneToOne 1 100 0.00 255.0 ECU_ADDRESS 0xD0001F0B /end MEASUREMENT
/begin MEASUREMENT InjCrv_stInjCharShOffTst "Einspritzcharakteristik im Fall des Abschallttests" UBYTE OneToOne 1 100 0.00 255.0 ARRAY_SIZE 6 ECU_ADDRESS 0xD0001F0F /end MEASUREMENT
/begin MEASUREMENT InjCrv_stPoI1RlsDes_mp "Gewünschter Freigabestatus der PoI1" UBYTE OneToOne 1 100 0.00 255.0 ECU_ADDRESS 0xC000B250 /end MEASUREMENT
/begin MEASUREMENT InjCrv_stPoI1RmpSelTSync "zeitsynchrone Botschaft für die Auswahl der Faktorisirungskennlinie des Rampenfaktors der PoI1" UBYTE INJCRV_RMP_VERB 1 100 1.00000000000 7.00000000000 FORMAT "%13.11" ECU_ADDRESS 0xD0001F1F /end MEASUREMENT
/begin MEASUREMENT InjCrv_stPoI2 "Freigabestatus PoI2" UBYTE OneToOne 1 100 0.00 255.0 ECU_ADDRESS 0xD0001F20 /end MEASUREMENT
/begin MEASUREMENT InjCrv_stPoI2RlsDes_mp "Gewünschter Freigabestatus der PoI2" UBYTE OneToOne 1 100 0.00 255.0 ECU_ADDRESS 0xC000B255 /end MEASUREMENT
/begin MEASUREMENT InjCrv_stPoI2RmpSelTSync "zeitsynchrone Botschaft für die Auswahl der Faktorisirungskennlinie des Rampenfaktors der PoI2" UBYTE INJCRV_RMP_VERB 1 100 1.00000000000 7.00000000000 FORMAT "%13.11" ECU_ADDRESS 0xD0001F24 /end MEASUREMENT
/begin MEASUREMENT InjCrv_stPoIOvrLim "" UBYTE OneToOne 1 100 0.00 255.0 ECU_ADDRESS 0xD0001F25 /end MEASUREMENT
/begin MEASUREMENT InjCrv_stPoIOvrLimReset_mp "" UBYTE OneToOne 1 100 0.00 255.0 ECU_ADDRESS 0xC000B256 /end MEASUREMENT
/begin MEASUREMENT InjCrv_stPoIOvrRaw_mp "" UBYTE OneToOne 1 100 0.00 255.0 ECU_ADDRESS 0xC000B257 /end MEASUREMENT
/begin MEASUREMENT InjCrv_stRefShOffTst "Bitstatus für Abbruchgründe eines zylinderselektiven Einspritzabschalttests" UBYTE OneToOne 1 100 0.00 255.0 ECU_ADDRESS 0xD0001F26 /end MEASUREMENT
/begin MEASUREMENT InjCrv_stStMShOffTst "Zusstand des Zustandsautomaten für die zylinderselektive Abschaltung" UBYTE OneToOne 1 100 0.00 255.0 ECU_ADDRESS 0xD0001F27 /end MEASUREMENT
/begin MEASUREMENT InjCrv_stStMShOffTst_mp "status Zustandsautomaten des Abschalttests" UBYTE OneToOne 1 100 0.00 255.0 ECU_ADDRESS 0xC000B258 /end MEASUREMENT
/begin MEASUREMENT InjCrv_swtPoI2AgAbsTDC_mp "Status des Betriebsmodus Ansteuerbeginn PoI2 (entweder Winkel absolut zum TDC oder Winkel bzw. Zeit relativ zur MI)" UBYTE OneToOne 1 100 0.00 255.0 ECU_ADDRESS 0xC000B251 /end MEASUREMENT
/begin MEASUREMENT InjCrv_tAirPoI2 "Selektierte Ansauglufttemperatur für die PoI 2" SWORD Temp_Cels 1 100 -3549.940 3003.560 ECU_ADDRESS 0xD0000F2A /end MEASUREMENT
/begin MEASUREMENT InjCrv_tiPoI1BasRgn_mp "Kundenvspecifiz korrektur für Nacheinspritzung beim Regeneration" SWORD InjTime_us 1 100 -13107.20 5000.00 ARRAY_SIZE 2 ECU_ADDRESS 0xC000C0B8 /end MEASUREMENT
/begin MEASUREMENT InjCrv_tiPoI1EnvCor "" SWORD InjTime_us 1 100 -13107.20 5000.00 ECU_ADDRESS 0xD0000F78 /end MEASUREMENT
/begin MEASUREMENT InjCrv_tiPoI1OvrRunRgn_mp "Entprellzähler für die Deaktivierung der PoI1 im Schub" SLONG Time_ms 1 100 -21474836480.0 21474836470.0 ECU_ADDRESS 0xC0008FA4 /end MEASUREMENT
/begin MEASUREMENT InjCrv_tiPoI1Rgn "" SWORD InjTime_us 1 100 -13107.20 5000.00 ARRAY_SIZE 2 ECU_ADDRESS 0xD0000F7A /end MEASUREMENT
/begin MEASUREMENT InjCrv_tiPoI2AddCor "kundenspezifische Korrekturzeit für PoI2" SWORD InjTime_us 1 100 -13107.20 5000.00 ECU_ADDRESS 0xD0000F7E /end MEASUREMENT
/begin MEASUREMENT InjCrv_tiPoI2APSCorRgn_mp "Gewichtete Zeit korrekturen abhängig von dem Umgebungsluftdruck für die PoI2 im Regenerationsbetrieb" SWORD InjTime_us 1 100 -13107.20 5000.00 ARRAY_SIZE 2 ECU_ADDRESS 0xC000C0EC /end MEASUREMENT
/begin MEASUREMENT InjCrv_tiPoI2APSCor_mp "Luftdruckabhängiger Korrekturgrundwert für die Zeitkomponente des Ansteuerbeginns der PoI2" SWORD InjTime_us 1 100 -13107.20 5000.00 ECU_ADDRESS 0xC000A222 /end MEASUREMENT
/begin MEASUREMENT InjCrv_tiPoI2ATSCor_mp "ansauglufttemperaturabhängiger Korrekturgrundwert für die Zeitkomponente des Ansteuerbeginns der PoI2" SWORD InjTime_us 1 100 -13107.20 5000.00 ECU_ADDRESS 0xC000A224 /end MEASUREMENT
/begin MEASUREMENT InjCrv_tiPoI2BasRgn_mp "Grundwert der Zeit komponente Ansteuerbeginn PoI2 im Regenerationsbetrieb" SWORD InjTime_us 1 100 -13107.20 5000.00 ARRAY_SIZE 2 ECU_ADDRESS 0xC000C104 /end MEASUREMENT
/begin MEASUREMENT InjCrv_tiPoI2BasStrt_mp "Grundwert für Spritzabstand von PoI2 im Startzustand" SWORD InjTime_us 1 100 -13107.20 5000.00 ECU_ADDRESS 0xC000A248 /end MEASUREMENT
/begin MEASUREMENT InjCrv_tiPoI2Bas_mp "Zeitkomponente Ansteuerbeginn PoI2 Grundwert" SWORD InjTime_us 1 100 -13107.20 5000.00 ECU_ADDRESS 0xC000A242 /end MEASUREMENT
/begin MEASUREMENT InjCrv_tiPoI2Byp_mp "Messpunkt für den Bypass" SWORD InjTime_us 1 100 -13107.20 5000.00 ECU_ADDRESS 0xC000A200 /end MEASUREMENT
/begin MEASUREMENT InjCrv_tiPoI2Cor_mp "korrigierter Grundwert der Zeitkomponente Ansteuerbeginn PoI2" SWORD InjTime_us 1 100 -13107.20 5000.00 ECU_ADDRESS 0xC000A202 /end MEASUREMENT
/begin MEASUREMENT InjCrv_tiPoI2Des "gewünschte Bezugszeitkomponente für Beginn PoI2" SWORD InjTime_us 1 100 -13107.20 5000.00 ECU_ADDRESS 0xD0000F80 /end MEASUREMENT
/begin MEASUREMENT InjCrv_tiPoI2DesAdd_mp "Additiver Bypasseingriff für gewünschte Zeit der Nacheinspritzung 2" SWORD InjTime_us 1 100 -13107.20 5000.00 ECU_ADDRESS 0xC000A204 /end MEASUREMENT
/begin MEASUREMENT InjCrv_tiPoI2EnvCor "Korrekturzeit für PoI2" SWORD InjTime_us 1 100 -13107.20 5000.00 ECU_ADDRESS 0xD0000F84 /end MEASUREMENT
/begin MEASUREMENT InjCrv_tiPoI2EnvCorRgn "Umgebungsbedingungsabhängige Korrektur Zeit für Nacheinspritzung 2 im Regenerationsbetrieb" SWORD InjTime_us 1 100 -13107.20 5000.00 ARRAY_SIZE 2 ECU_ADDRESS 0xD0000F86 /end MEASUREMENT
/begin MEASUREMENT InjCrv_tiPoI2EnvCorStrt "Korrekturzeit für PoI2 im Startzustand" SWORD InjTime_us 1 100 -13107.20 5000.00 ECU_ADDRESS 0xD0000F8A /end MEASUREMENT
/begin MEASUREMENT InjCrv_tiPoI2ET "Geschätzte Ansteuerdauer der PoI2" SWORD InjTime_us 1 100 -13107.20 5000.00 ECU_ADDRESS 0xD0000F82 /end MEASUREMENT
/begin MEASUREMENT InjCrv_tiPoI2ETSCorRgn_mp "Gewichtete Zeit korrekturen abhängig von der Motortemperatur für die PoI2 im Regenerationsbetrieb" SWORD InjTime_us 1 100 -13107.20 5000.00 ARRAY_SIZE 2 ECU_ADDRESS 0xC000C0F0 /end MEASUREMENT
/begin MEASUREMENT InjCrv_tiPoI2ETSCorStrt_mp "Motortemperaturabhängiges Korrekturgrundwerte für die Zeitkomponente des Ansteuerbeginns der PoI2 im Startzustand" SWORD InjTime_us 1 100 -13107.20 5000.00 ECU_ADDRESS 0xC000A226 /end MEASUREMENT
/begin MEASUREMENT InjCrv_tiPoI2ETSCor_mp "motortemperaturabhängiger Korrekturgrundwert für die Zeitkomponente des Ansteuerbeginns der PoI2" SWORD InjTime_us 1 100 -13107.20 5000.00 ECU_ADDRESS 0xC000A228 /end MEASUREMENT
/begin MEASUREMENT InjCrv_tiPoI2Max_mp "maximaler Ansteuerbeginn PoI2 relativ zur Haupteinspritzung" SWORD InjTime_us 1 100 -13107.20 5000.00 ECU_ADDRESS 0xC000A206 /end MEASUREMENT
/begin MEASUREMENT InjCrv_tiPoI2RelTot_mp "Ansteuerbeginnabstand PoI2 aus Winkel- und Zeitkomponente" SWORD InjTime_us 1 100 -13107.20 5000.00 ECU_ADDRESS 0xC000A208 /end MEASUREMENT
/begin MEASUREMENT InjCrv_tiPoI2Rel_mp "Zeitkomponente Ansteuerbeginn PoI2 relativ zur Haupteinspritzung" SWORD InjTime_us 1 100 -13107.20 5000.00 ECU_ADDRESS 0xC000A20A /end MEASUREMENT
/begin MEASUREMENT InjCrv_tiPoI2Rgn "Grundwert der Zeit komponente Ansteuerbeginn PoI2 im Regenerationsbetrieb" SWORD InjTime_us 1 100 -13107.20 5000.00 ARRAY_SIZE 2 ECU_ADDRESS 0xD0000F8C /end MEASUREMENT
/begin MEASUREMENT InjCrv_tiPoI2ZFCET_mp "" SWORD InjTime_us 1 100 -13107.20 5000.00 ECU_ADDRESS 0xC000A20C /end MEASUREMENT
/begin MEASUREMENT InjCrv_volPoI2Cor "" SWORD InjQntInj 1 100 -327.6800 327.6700 ECU_ADDRESS 0xD0000FA2 /end MEASUREMENT
/begin MEASUREMENT InjCrv_volPoI2_mp "Begrenztes Einspritzvolumen PoI2" SWORD InjQntInj 1 100 -327.6800 327.6700 ECU_ADDRESS 0xC000A20E /end MEASUREMENT
/begin MEASUREMENT InjCtl_dAdjQntCS_mp "Checksumme der Mengenabgleichkennfeldwerte (im EEPROM abgelegt)" UBYTE OneToOne 1 100 0.00 255.0 ECU_ADDRESS 0xC000B259 /end MEASUREMENT
/begin MEASUREMENT InjCtl_dqLead "Mengengradient" SLONG InjMassSec 1 100 -21474836.4800 21474836.4700 FORMAT "%13.4" ECU_ADDRESS 0xD0002F1C /end MEASUREMENT
/begin MEASUREMENT InjCtl_facAdjSrvCmpl_mp "Serviceabgleichfaktor (nach Limitierung), Komplementärwert" SWORD Fact 1 100 -4.000000 3.999878 ECU_ADDRESS 0xC000A24E /end MEASUREMENT
/begin MEASUREMENT InjCtl_facAdjSrv_mp "Serviceabgleichfaktor (nach Limitierung)" SWORD Fact 1 100 -4.000000 3.999878 ECU_ADDRESS 0xC000A250 /end MEASUREMENT
/begin MEASUREMENT InjCtl_qAdjQnt "" SWORD InjMassCyc 1 100 -327.6800 327.6700 ECU_ADDRESS 0xD0000FA4 /end MEASUREMENT
/begin MEASUREMENT InjCtl_qAdjQntUnlim_mp "Mengenabgleichwert vor Begrenzung" SWORD InjMassCyc 1 100 -327.6800 327.6700 ECU_ADDRESS 0xC000A252 /end MEASUREMENT
/begin MEASUREMENT InjCtl_qCurr "Einspritzmenge aktueller Wert" SWORD InjMass 1 100 -327.6800 327.6700 ECU_ADDRESS 0xD0000FA6 /end MEASUREMENT
/begin MEASUREMENT InjCtl_qCurrAdd_mp "Additiver Bypasseingrif für Einspritzmenge aktueller Wert" SWORD InjMass 1 100 -327.6800 327.6700 ECU_ADDRESS 0xC000A25E /end MEASUREMENT
/begin MEASUREMENT InjCtl_qCurrB1 "Einspritzmenge aktueller Wert Bank 1" SWORD InjMass 1 100 -327.6800 327.6700 ECU_ADDRESS 0xD0000FA8 /end MEASUREMENT
/begin MEASUREMENT InjCtl_qCurrB2 "Einspritzmenge aktueller Wert Bank 2" SWORD InjMass 1 100 -327.6800 327.6700 ECU_ADDRESS 0xD0000FAA /end MEASUREMENT
/begin MEASUREMENT InjCtl_qCurrByp_mp "Messpunkt zum Lesen der aktuellen Einspritzmenge über ASCET vor dem Bypass" SWORD InjMass 1 100 -327.6800 327.6700 ECU_ADDRESS 0xC000A254 /end MEASUREMENT
/begin MEASUREMENT InjCtl_qLimSoftShOff_mp "soft shutoff limit" SWORD InjMassCyc 1 100 -327.6800 327.6700 ECU_ADDRESS 0xC000A256 /end MEASUREMENT
/begin MEASUREMENT InjCtl_qNrm "Einspritzmenge normalisierter Wert." SWORD InjMass 1 100 -327.6800 327.6700 ECU_ADDRESS 0xD0000FAE /end MEASUREMENT
/begin MEASUREMENT InjCtl_qRaw "Einspritzmenge Rohwert" SWORD InjMass 1 100 -327.6800 327.6700 ECU_ADDRESS 0xD0000FB0 /end MEASUREMENT
/begin MEASUREMENT InjCtl_qRawAdd_mp "Additiver Bypasseingriff für den Rohwert der Einspritzmenge" SWORD InjMass 1 100 -327.6800 327.6700 ECU_ADDRESS 0xC000A260 /end MEASUREMENT
/begin MEASUREMENT InjCtl_qRawB1 "Einspritzmenge Rohwert Bank 1" SWORD InjMass 1 100 -327.6800 327.6700 ECU_ADDRESS 0xD0000FB2 /end MEASUREMENT
/begin MEASUREMENT InjCtl_qRawB2 "Einspritzmenge Rohwert Bank 2" SWORD InjMass 1 100 -327.6800 327.6700 ECU_ADDRESS 0xD0000FB4 /end MEASUREMENT
/begin MEASUREMENT InjCtl_qRawByp_mp "Messpunkt zum Lesen des Rohwertes der Einspritzmenge über ASCET vor dem Bypass" SWORD InjMass 1 100 -327.6800 327.6700 ECU_ADDRESS 0xC000A258 /end MEASUREMENT
/begin MEASUREMENT InjCtl_qSetUnBal "Einspritzmenge Sollwert ohne Mengenausgleichsregelung" SWORD InjMass 1 100 -327.6800 327.6700 ECU_ADDRESS 0xD0000FB6 /end MEASUREMENT
/begin MEASUREMENT InjCtl_qSetUnBalAdd_mp "Additiver Bypasseingriff für den Sollwert der Einspritzmenge" SWORD InjMass 1 100 -327.6800 327.6700 ECU_ADDRESS 0xC000A262 /end MEASUREMENT
/begin MEASUREMENT InjCtl_qSetUnBalB1 "Einspritzmenge Sollwert ohne Mengenausgleichsregelung Bank 1" SWORD InjMass 1 100 -327.6800 327.6700 ECU_ADDRESS 0xD0000FB8 /end MEASUREMENT
/begin MEASUREMENT InjCtl_qSetUnBalB2 "Einspritzmenge Sollwert ohne Mengenausgleichsregelung Bank 2" SWORD InjMass 1 100 -327.6800 327.6700 ECU_ADDRESS 0xD0000FBA /end MEASUREMENT
/begin MEASUREMENT InjCtl_qSetUnBalByp_mp "Meßpunkt für Bypass" SWORD InjMass 1 100 -327.6800 327.6700 ECU_ADDRESS 0xC000A25A /end MEASUREMENT
/begin MEASUREMENT InjCtl_qSetUnCor_mp "Menge vor Eingriff von Mengenabgleich, Serviceabgleich, Mengendriftkompensation" SWORD InjMassCyc 1 100 -327.6800 327.6700 ECU_ADDRESS 0xC000A25C /end MEASUREMENT
/begin MEASUREMENT InjCtl_stAdjQnt_mp "Status vom Mengenabgleich" UBYTE OneToOne 1 100 0.00 255.0 ECU_ADDRESS 0xC000B25A /end MEASUREMENT
/begin MEASUREMENT InjSys_facMIHC_mp "" SWORD Fact 1 100 -4.000000 3.999878 ECU_ADDRESS 0xC000A264 /end MEASUREMENT
/begin MEASUREMENT InjSys_facPoI1HC_mp "" SWORD Fact 1 100 -4.000000 3.999878 ECU_ADDRESS 0xC000A266 /end MEASUREMENT
/begin MEASUREMENT InjSys_facPoI2HC_mp "" SWORD Fact 1 100 -4.000000 3.999878 ECU_ADDRESS 0xC000A268 /end MEASUREMENT
/begin MEASUREMENT InjSys_qBasHCEmi "" SWORD InjMass 1 100 -327.6800 327.6700 ECU_ADDRESS 0xD0000FBC /end MEASUREMENT
/begin MEASUREMENT InjSys_qHCEmi "" SWORD InjMass 1 100 -327.6800 327.6700 ARRAY_SIZE 6 ECU_ADDRESS 0xD0000FBE /end MEASUREMENT
/begin MEASUREMENT InjSys_qInrCmb "Im Motor verbrannte Einspritzmenge" SWORD InjMass 1 100 -327.6800 327.6700 ARRAY_SIZE 6 ECU_ADDRESS 0xD0000FCA /end MEASUREMENT
/begin MEASUREMENT InjSys_qMIHC_mp "" SWORD InjMass 1 100 -327.6800 327.6700 ECU_ADDRESS 0xC000A26A /end MEASUREMENT
/begin MEASUREMENT InjSys_qNoTrqPoI1_mp "" SWORD InjMass 1 100 -327.6800 327.6700 ARRAY_SIZE 6 ECU_ADDRESS 0xC000C108 /end MEASUREMENT
/begin MEASUREMENT InjSys_qNoTrqPoI2_mp "" SWORD InjMass 1 100 -327.6800 327.6700 ARRAY_SIZE 6 ECU_ADDRESS 0xC000C114 /end MEASUREMENT
/begin MEASUREMENT InjSys_qOutrCmb "Ausserhalb des Motors umgesetzte Einspritzmenge" SWORD InjMass 1 100 -327.6800 327.6700 ARRAY_SIZE 6 ECU_ADDRESS 0xD0000FD6 /end MEASUREMENT
/begin MEASUREMENT InjSys_qPoIHCEmi "" SWORD InjMass 1 100 -327.6800 327.6700 ARRAY_SIZE 6 ECU_ADDRESS 0xD0000FE2 /end MEASUREMENT
/begin MEASUREMENT InjSys_qTot "Gesamteinspritzmenge" SWORD InjMass 1 100 -327.6800 327.6700 ECU_ADDRESS 0xD0000FEE /end MEASUREMENT
/begin MEASUREMENT InjSys_stCtlQnt "Status der Kontrollmenge" UBYTE OneToOne 1 100 0.00 255.0 ECU_ADDRESS 0xD0001F2A /end MEASUREMENT
/begin MEASUREMENT InjSys_stLeadPar_mp "Ausgewählte Führungsgrösse für das Einspritzsystem" UBYTE SETPOINTCALC_TRQBASED_SY_Compu 1 100 0.00 1.00000000000 FORMAT "%13.11" ECU_ADDRESS 0xC000B25B /end MEASUREMENT
/begin MEASUREMENT InjSys_tAir "selektierte Ansauglufttemperatur für das Einspritzsystem" SWORD Temp_Cels 1 100 -3549.940 3003.560 ECU_ADDRESS 0xD0000FF2 /end MEASUREMENT
/begin MEASUREMENT InjSys_tAirRgn "selektierte Ansauglufttemperatur für das Einspritzsystem im Regenerationbetrieb" SWORD Temp_Cels 1 100 -3549.940 3003.560 ECU_ADDRESS 0xD0000FF4 /end MEASUREMENT
/begin MEASUREMENT InjSys_tEng "selektierte Motortemperatur für das Einspritzsystem" SWORD Temp_Cels 1 100 -3549.940 3003.560 ECU_ADDRESS 0xD0000FF6 /end MEASUREMENT
/begin MEASUREMENT InjSys_tEngPiIRls "" SWORD Temp_Cels 1 100 -3549.940 3003.560 ECU_ADDRESS 0xD0000FF8 /end MEASUREMENT
/begin MEASUREMENT InjSys_tEngRgn "selektierte Motortemperatur für das Einspritzsystem im Regenerationbetrieb" SWORD Temp_Cels 1 100 -3549.940 3003.560 ECU_ADDRESS 0xD0000FFA /end MEASUREMENT
/begin MEASUREMENT InjSys_tEngRgnPiIRls "" SWORD Temp_Cels 1 100 -3549.940 3003.560 ECU_ADDRESS 0xD0000FFC /end MEASUREMENT
/begin MEASUREMENT InjSys_trqLim "Drehmomentbegrenzung des Einspritzsystems" SWORD Trq 1 100 -3276.800 3276.700 ECU_ADDRESS 0xD0000FFE /end MEASUREMENT
/begin MEASUREMENT InjSys_trqLoss "Verlustmoment des Einspritzsystems" SWORD Trq 1 100 -3276.800 3276.700 ECU_ADDRESS 0xD0001000 /end MEASUREMENT
/begin MEASUREMENT InjUn_stStrt "Service-Information bei Motorstörungen." UBYTE OneToOne 1 100 0.00 255.0 ECU_ADDRESS 0xD0001F2B /end MEASUREMENT
/begin MEASUREMENT InjUn_stStrtCsBlk_mp "Gründ für Motorstörungen" UBYTE OneToOne 1 100 0.00 255.0 ECU_ADDRESS 0xC000B25C /end MEASUREMENT
/begin MEASUREMENT InjVlv_ctCylMI1_mp "Zylinder aktuell benutzt für 1. Haupteinspritzung" UBYTE OneToOne 1 100 0.00 255.0 ECU_ADDRESS 0xC000B262 /end MEASUREMENT
/begin MEASUREMENT InjVlv_ctCylPiI1_mp "Zylindernummer zugehörend zur Voreinspritzung 1" UBYTE OneToOne 1 100 0.00 255.0 ECU_ADDRESS 0xC000B263 /end MEASUREMENT
/begin MEASUREMENT InjVlv_ctCylPiI2_mp "Zylindernummer zugehörend zur Voreinspritzung 2" UBYTE OneToOne 1 100 0.00 255.0 ECU_ADDRESS 0xC000B264 /end MEASUREMENT
/begin MEASUREMENT InjVlv_ctCylPoI1_mp "Zylindernummer zugehörend zur Nacheinspritzung 1" UBYTE OneToOne 1 100 0.00 255.0 ECU_ADDRESS 0xC000B265 /end MEASUREMENT
/begin MEASUREMENT InjVlv_ctCylPoI2_mp "Zylindernummer zugehörend zur Nacheinspritzung 2" UBYTE OneToOne 1 100 0.00 255.0 ECU_ADDRESS 0xC000B266 /end MEASUREMENT
/begin MEASUREMENT InjVlv_ctMI1AgDiff_mp "Zähler für Winkelverletzungen bei Programmierung des Ansteuerbeginns der MI1" UWORD OneToOne 1 100 0.00 65535.00 ECU_ADDRESS 0xC000A2C2 /end MEASUREMENT
/begin MEASUREMENT InjVlv_ctPiI1AgDiff_mp "Zähler für Winkelverletzungen bei Programmierung des Ansteuerbeginns der PiI1" UWORD OneToOne 1 100 0.00 65535.00 ECU_ADDRESS 0xC000A2CA /end MEASUREMENT
/begin MEASUREMENT InjVlv_ctPiI2AgDiff_mp "Zähler für Winkelverletzungen bei Programmierung des Ansteuerbeginns der PiI2" UWORD OneToOne 1 100 0.00 65535.00 ECU_ADDRESS 0xC000A2CE /end MEASUREMENT
/begin MEASUREMENT InjVlv_facAddBalRls "Ergebnis aus Freigabekennfeld zur Aufrechnung der Mengenkorrektur als Array (zylinderspezifisch)" SWORD Fact 1 100 -4.000000 3.999878 ARRAY_SIZE 6 ECU_ADDRESS 0xD0001002 /end MEASUREMENT
/begin MEASUREMENT InjVlv_frqTDC_mp "Frequenz der TDC-Abfolge bei einer bestimmten Drehzahl" SLONG FrqTDC 1 100 -42949672.9600 42949672.9400 FORMAT "%13.4" ECU_ADDRESS 0xC0008FB0 /end MEASUREMENT
/begin MEASUREMENT InjVlv_numCylECU_mp "Anzahl Zylinder auf dem Steuergerät" SWORD OneToOne 1 100 -32768.00 32767.00 ECU_ADDRESS 0xC000A286 /end MEASUREMENT
/begin MEASUREMENT InjVlv_numInjChrgBalLim_mp "Anzahl der Einspritzungen limitiert durch die Ladungsbilanz" UBYTE OneToOne 1 100 0.00 255.0 ECU_ADDRESS 0xC000B25D /end MEASUREMENT
/begin MEASUREMENT InjVlv_numInjChrgBalRaw_mp "Maximale Anzahl an Einspritzungen aufgrund der Ladungsbilanz des Bufferkondensators (Rohwert)" SWORD NumInjChrgBalRaw 1 100 -327.6800 327.6700 FORMAT "%8.4" ECU_ADDRESS 0xC000A288 /end MEASUREMENT
/begin MEASUREMENT InjVlv_numInjChrgBal_mp "Maximale Anzahl an Einspritzungen aufgrund der Ladungsbilanz des Boosterkondensators" UBYTE OneToOne 1 100 0.00 255.0 ECU_ADDRESS 0xC000B25E /end MEASUREMENT
/begin MEASUREMENT InjVlv_numInjDes_mp "gewünschte Anzahl von Einspritzungen zur Ermittlung des Zustandes des InjVlv_ChrgBalInjLim (Normal, Überlast)" UBYTE OneToOne 1 100 0.00 255.0 ECU_ADDRESS 0xC000B25F /end MEASUREMENT
/begin MEASUREMENT InjVlv_numInjOvrLdRaw_mp "Rohwert der Begrenzung der maximal erlaubten Anzahl von Einspritzungen im Überlastbetrieb" SWORD NumInjChrgBalRaw 1 100 -327.6800 327.6700 FORMAT "%8.4" ECU_ADDRESS 0xC000A28A /end MEASUREMENT
/begin MEASUREMENT InjVlv_numInjOvrLd_mp "Begrenzungswert der maximal erlaubten Anzahl von Einspritzungen im Überlastbetrieb" UBYTE OneToOne 1 100 0.00 255.0 ECU_ADDRESS 0xC000B260 /end MEASUREMENT
/begin MEASUREMENT InjVlv_numPrepLeft_mp "Anzahl der verbleibenden Ansteuerungen der Injektorvorbereitung" UBYTE OneToOne 1 100 0.00 255.0 ECU_ADDRESS 0xC000B267 /end MEASUREMENT
/begin MEASUREMENT InjVlv_phiInjBegMI1_mp "" SWORD AngleCrS 1 100 -720.0000 719.9780 ECU_ADDRESS 0xC000A2C4 /end MEASUREMENT
/begin MEASUREMENT InjVlv_phiMI1Diff_mp "Winkeldifferenz zwischen dem gewünschten Ansteuerbeginn und dem systembed. frühesten Ansteuerbeginn der MI1" SWORD AngleCrS 1 100 -720.0000 719.9780 ECU_ADDRESS 0xC000A2C6 /end MEASUREMENT
/begin MEASUREMENT InjVlv_phiPiI1Diff_mp "Winkeldifferenz zwischen dem gewünschten Ansteuerbeginn und dem systembed. frühesten Ansteuerbeginn der PiI1" SWORD AngleCrS 1 100 -720.0000 719.9780 ECU_ADDRESS 0xC000A2CC /end MEASUREMENT
/begin MEASUREMENT InjVlv_phiPiI2Diff_mp "Winkeldifferenz zwischen dem gewünschten Ansteuerbeginn und dem systembed. frühesten Ansteuerbeginn der PiI2" SWORD AngleCrS 1 100 -720.0000 719.9780 ECU_ADDRESS 0xC000A2D0 /end MEASUREMENT
/begin MEASUREMENT InjVlv_pInET_mp "X-Eingang des Kennfeldes InjVlv_tiET_MAP auf dem Applikationswerkzeug" SWORD Pres_Rail 1 100 -3276.800 2000.000 ECU_ADDRESS 0xC000A29A /end MEASUREMENT
/begin MEASUREMENT InjVlv_PsIcStIniDiag "Status der Initialisierung des common rail Endstufenbausteins" UWORD OneToOne 1 100 0.00 65535.00 ARRAY_SIZE 1 ECU_ADDRESS 0xD00015E0 /end MEASUREMENT
/begin MEASUREMENT InjVlv_PsIcStIniTrans "Status der Initialisierung des Common Rail Endstufenbaustein-Treibers" ULONG OneToOne 1 100 0.00 4294967295.00 ARRAY_SIZE 1 ECU_ADDRESS 0xD0003234 /end MEASUREMENT
/begin MEASUREMENT InjVlv_pwrDCDCMax_mp "maximale Leistung des DC/DC-Wandlers" SWORD Pwr_PA 1 100 -163840.0 163835.0 FORMAT "%8.1" ECU_ADDRESS 0xC000A28C /end MEASUREMENT
/begin MEASUREMENT InjVlv_pwrDCDCOvrLdMax_mp "Max. zulässige Ausgangsleistung aller DCDC-Wandler des Steuergeräts im Überlasrbetrieb" SWORD Pwr_PA 1 100 -163840.0 163835.0 FORMAT "%8.1" ECU_ADDRESS 0xC000A28E /end MEASUREMENT
/begin MEASUREMENT InjVlv_pwrInjAvrg_mp "durchschnittliche Ansteuer-Verlustleistung bei einer Ansteuerung pro Zylinder und Arbeitshub" SWORD Pwr_PA 1 100 -163840.0 163835.0 FORMAT "%8.1" ECU_ADDRESS 0xC000A290 /end MEASUREMENT
/begin MEASUREMENT InjVlv_qMI1Bal_mp "Korrekturmenge Haupteinspritzung 1" SWORD InjMass 1 100 -327.6800 327.6700 ECU_ADDRESS 0xC000A26C /end MEASUREMENT
/begin MEASUREMENT InjVlv_qMI1Cor_mp "Korrigierte Menge der Haupteinspritzung 1" SWORD InjMass 1 100 -327.6800 327.6700 ECU_ADDRESS 0xC000A2A0 /end MEASUREMENT
/begin MEASUREMENT InjVlv_qPiI1Bal_mp "Korrekturmenge Voreinspritzung 1" SWORD InjMass 1 100 -327.6800 327.6700 ECU_ADDRESS 0xC000A26E /end MEASUREMENT
/begin MEASUREMENT InjVlv_qPiI1Cor_mp "Korrigierte Menge der Voreinspritzung 1" SWORD InjMass 1 100 -327.6800 327.6700 ECU_ADDRESS 0xC000A2A6 /end MEASUREMENT
/begin MEASUREMENT InjVlv_qPiI2Bal_mp "Korrekturmenge Voreinspritzung 2" SWORD InjMass 1 100 -327.6800 327.6700 ECU_ADDRESS 0xC000A270 /end MEASUREMENT
/begin MEASUREMENT InjVlv_qPiI2Cor_mp "Korrigierte Menge der Voreinspritzung 2" SWORD InjMass 1 100 -327.6800 327.6700 ECU_ADDRESS 0xC000A2AC /end MEASUREMENT
/begin MEASUREMENT InjVlv_qPiI3Bal_mp "Korrekturmenge Voreinspritzung 3" SWORD InjMass 1 100 -327.6800 327.6700 ECU_ADDRESS 0xC000A272 /end MEASUREMENT
/begin MEASUREMENT InjVlv_qPoI1BalEff_mp "" SWORD InjMass 1 100 -327.6800 327.6700 ECU_ADDRESS 0xC000A274 /end MEASUREMENT
/begin MEASUREMENT InjVlv_qPoI1Bal_mp "Korrekturmenge Nacheinspritzung 1" SWORD InjMass 1 100 -327.6800 327.6700 ECU_ADDRESS 0xC000A276 /end MEASUREMENT
/begin MEASUREMENT InjVlv_qPoI1Cor_mp "Korrigierte Menge der Nacheinspritzung 1" SWORD InjMass 1 100 -327.6800 327.6700 ECU_ADDRESS 0xC000A2B2 /end MEASUREMENT
/begin MEASUREMENT InjVlv_qPoI2BalEff_mp "Korrekturmenge für Nacheinspritzung 2, Moment bildender Teil" SWORD InjMass 1 100 -327.6800 327.6700 ECU_ADDRESS 0xC000A278 /end MEASUREMENT
/begin MEASUREMENT InjVlv_qPoI2Bal_mp "Korrekturmenge Nacheinspritzung 2" SWORD InjMass 1 100 -327.6800 327.6700 ECU_ADDRESS 0xC000A27A /end MEASUREMENT
/begin MEASUREMENT InjVlv_qPoI2Cor_mp "Korrigierte Menge der Nacheinspritzung 2" SWORD InjMass 1 100 -327.6800 327.6700 ECU_ADDRESS 0xC000A2B8 /end MEASUREMENT
/begin MEASUREMENT InjVlv_rGlobDynTimePrio_mp "" SWORD Prc 1 100 -400.0000 399.9878 ECU_ADDRESS 0xC000A2C8 /end MEASUREMENT
/begin MEASUREMENT InjVlv_stInjCharComp "status der Kompensation der freigegebenen Einspritzungen" UBYTE OneToOne 1 100 0.00 255.0 ECU_ADDRESS 0xD0001F2C /end MEASUREMENT
/begin MEASUREMENT InjVlv_stInjCo "Zustand des Ansteuerkoordinators" UBYTE OneToOne 1 100 0.00 255.0 ECU_ADDRESS 0xD0001F2D /end MEASUREMENT
/begin MEASUREMENT InjVlv_stInjCoRun_mp "Zustand: Bearbeitete Zustände von InjVlv_stInjCo" UWORD OneToOne 1 100 0.00 65535.00 ECU_ADDRESS 0xC000A29E /end MEASUREMENT
/begin MEASUREMENT InjVlv_stInjMI1_mp "Status der Haupteinspritzung-1-Programmierung" UBYTE OneToOne 1 100 0.00 255.0 ECU_ADDRESS 0xC000B26B /end MEASUREMENT
/begin MEASUREMENT InjVlv_stInjMI2_mp "Status der Haupteinspritzung-2-Programmierung" UBYTE OneToOne 1 100 0.00 255.0 ECU_ADDRESS 0xC000B26C /end MEASUREMENT
/begin MEASUREMENT InjVlv_stInjPiI1_mp "Status der Voreinspritzung-1-Programmierung" UBYTE OneToOne 1 100 0.00 255.0 ECU_ADDRESS 0xC000B26D /end MEASUREMENT
/begin MEASUREMENT InjVlv_stInjPiI2_mp "Status der Voreinspritzung-2-Programmierung" UBYTE OneToOne 1 100 0.00 255.0 ECU_ADDRESS 0xC000B26E /end MEASUREMENT
/begin MEASUREMENT InjVlv_stInjPiI3_mp "Status der Voreinspritzung-3-Programmierung" UBYTE OneToOne 1 100 0.00 255.0 ECU_ADDRESS 0xC000B26F /end MEASUREMENT
/begin MEASUREMENT InjVlv_stInjPoI1_mp "Status der Nacheinspritzung-1-Programmierung" UBYTE OneToOne 1 100 0.00 255.0 ECU_ADDRESS 0xC000B270 /end MEASUREMENT
/begin MEASUREMENT InjVlv_stInjPoI2_mp "Status der Nacheinspritzung-2-Programmierung" UBYTE OneToOne 1 100 0.00 255.0 ECU_ADDRESS 0xC000B271 /end MEASUREMENT
/begin MEASUREMENT InjVlv_stInjRls "status der freigegebenen Einspritzungen" UBYTE OneToOne 1 100 0.00 255.0 ARRAY_SIZE 6 ECU_ADDRESS 0xD0001F2E /end MEASUREMENT
/begin MEASUREMENT InjVlv_stInjZFC_mp "Status der ZFC Programmierung" UBYTE OneToOne 1 100 0.00 255.0 ECU_ADDRESS 0xC000B272 /end MEASUREMENT
/begin MEASUREMENT InjVlv_stOvrLdRls_mp "Freigabestatus des Überlastbetriebes" UBYTE OneToOne 1 100 0.00 255.0 ECU_ADDRESS 0xC000B261 /end MEASUREMENT
/begin MEASUREMENT InjVlv_stPrep "Zustand der Injektorvorbereitung" UBYTE OneToOne 1 100 0.00 255.0 ECU_ADDRESS 0xD0001F34 /end MEASUREMENT
/begin MEASUREMENT InjVlv_stPrepInjErr_mp "Aktorspezifischer Zustand: die Programmierung mindestens einer Ansteuerung war fehlerhaft" UBYTE OneToOne 1 100 0.00 255.0 ECU_ADDRESS 0xC000B268 /end MEASUREMENT
/begin MEASUREMENT InjVlv_stPrepInjOK_mp "Aktorspezifischer Zustand: die Programmierung mindestens einer Ansteuerung war in Ordnung" UBYTE OneToOne 1 100 0.00 255.0 ECU_ADDRESS 0xC000B269 /end MEASUREMENT
/begin MEASUREMENT InjVlv_stPrepPreCond_mp "Vorbedingungen für die Injektorvorbereitung" UBYTE OneToOne 1 100 0.00 255.0 ECU_ADDRESS 0xC000B26A /end MEASUREMENT
/begin MEASUREMENT InjVlv_stPsIcChipVer_mp "hardware chip ID des common rail endstufen Bausteins" UBYTE OneToOne 1 100 0.00 255.0 ARRAY_SIZE 1 ECU_ADDRESS 0xC000C120 /end MEASUREMENT
/begin MEASUREMENT InjVlv_stPsIcDiaBnk1_mp "Diagnose Information Bank 1 des Common Rail Endstufenbausteins" UBYTE OneToOne 1 100 0.00 255.0 ARRAY_SIZE 1 ECU_ADDRESS 0xC000C128 /end MEASUREMENT
/begin MEASUREMENT InjVlv_stPsIcDiaBnk2_mp "Diagnose Information Bank 2 des Common Rail Endstufenbausteins" UBYTE OneToOne 1 100 0.00 255.0 ARRAY_SIZE 1 ECU_ADDRESS 0xC000C129 /end MEASUREMENT
/begin MEASUREMENT InjVlv_stPsIcIni_mp "Status der Initialisierung des common rail Endstufenbausteins" ULONG OneToOne 1 100 0.00 4294967295.00 ARRAY_SIZE 1 ECU_ADDRESS 0xC000C124 /end MEASUREMENT
/begin MEASUREMENT InjVlv_stPsIcNumBnkPcP_mp "Input PCP Bank Nummer im Fehlerfall des Bausteintreibers" ULONG OneToOne 1 100 0.00 4294967295.00 ARRAY_SIZE 1 ECU_ADDRESS 0xC000C12C /end MEASUREMENT
/begin MEASUREMENT InjVlv_stPsIcNumBnk_mp "Input SW Bank Nummer im Fehlerfall des Bausteintreibers" ULONG OneToOne 1 100 0.00 4294967295.00 ARRAY_SIZE 1 ECU_ADDRESS 0xC000C130 /end MEASUREMENT
/begin MEASUREMENT InjVlv_stPsIcNumChipPcP_mp "Input PCP chip Nummer im Fehlerfall des Bausteintreibers" ULONG OneToOne 1 100 0.00 4294967295.00 ARRAY_SIZE 1 ECU_ADDRESS 0xC000C134 /end MEASUREMENT
/begin MEASUREMENT InjVlv_stPsIcNumChip_mp "Input SW chip Nummer im Fehlerfall des Bausteintreibers" ULONG OneToOne 1 100 0.00 4294967295.00 ARRAY_SIZE 1 ECU_ADDRESS 0xC000C138 /end MEASUREMENT
/begin MEASUREMENT InjVlv_stPsIcStBufDatEx_mp "Status des Bausteintreiber Datenpuffers beim Schreiben" ULONG OneToOne 1 100 0.00 4294967295.00 ARRAY_SIZE 1 ECU_ADDRESS 0xC000C13C /end MEASUREMENT
/begin MEASUREMENT InjVlv_stPsIcStBufTraInj_mp "Status des Bausteintreiber Datenpuffers beim Eintragen" ULONG OneToOne 1 100 0.00 4294967295.00 ARRAY_SIZE 1 ECU_ADDRESS 0xC000C140 /end MEASUREMENT
/begin MEASUREMENT InjVlv_stPsIcTra_mp "Status des Common Rail Endstufenbaustein-Treibers, Fehler-Sammler" ULONG OneToOne 1 100 0.00 4294967295.00 ARRAY_SIZE 1 ECU_ADDRESS 0xC000C144 /end MEASUREMENT
/begin MEASUREMENT InjVlv_stTCtlInj_mp "Status des Ansteuerdauersetzens des zeitgesteuerten Einspritztyps (immediate injection)" UBYTE OneToOne 1 100 0.00 255.0 ECU_ADDRESS 0xC000B273 /end MEASUREMENT
/begin MEASUREMENT InjVlv_tiChrgPrep "Ladezeit der Injektorvorbereitung" SWORD InjTime_us 1 100 -13107.20 5000.00 ECU_ADDRESS 0xD0001016 /end MEASUREMENT
/begin MEASUREMENT InjVlv_tiDisChPrep "Entladezeit der Injektorvorbereitung" SWORD InjTime_us 1 100 -13107.20 5000.00 ECU_ADDRESS 0xD0001018 /end MEASUREMENT
/begin MEASUREMENT InjVlv_tiETPrep_mp "Ansteuerdauer der Injektorvorbereitung" SWORD InjTime_us 1 100 -13107.20 5000.00 ECU_ADDRESS 0xC000A2C0 /end MEASUREMENT
/begin MEASUREMENT InjVlv_tiMI1ETUnLim "unbegrenzte Ansteuerdauer MI" SWORD InjTime_us 1 100 -13107.20 5000.00 ECU_ADDRESS 0xD000101C /end MEASUREMENT
/begin MEASUREMENT InjVlv_tiMI1ET_mp "Ansteuerdauer MI" SWORD InjTime_us 1 100 -13107.20 5000.00 ECU_ADDRESS 0xC000A27C /end MEASUREMENT
/begin MEASUREMENT InjVlv_tiPiI1ET_mp "Ansteuerdauer der Voreinspritzung 1" SWORD InjTime_us 1 100 -13107.20 5000.00 ECU_ADDRESS 0xC000A27E /end MEASUREMENT
/begin MEASUREMENT InjVlv_tiPiI2ET_mp "Ansteuerdauer PiI2" SWORD InjTime_us 1 100 -13107.20 5000.00 ECU_ADDRESS 0xC000A280 /end MEASUREMENT
/begin MEASUREMENT InjVlv_tiPoI1ET_mp "Ansteuerdauer PoI1" SWORD InjTime_us 1 100 -13107.20 5000.00 ECU_ADDRESS 0xC000A282 /end MEASUREMENT
/begin MEASUREMENT InjVlv_tiPoI2ET_mp "Ansteuerdauer PoI2" SWORD InjTime_us 1 100 -13107.20 5000.00 ECU_ADDRESS 0xC000A284 /end MEASUREMENT
/begin MEASUREMENT InjVlv_tiPse "feste oder gemessene Mindestzeit zwischen 2 Einspritzungen" SWORD InjTime_us 1 100 -13107.20 5000.00 ECU_ADDRESS 0xD000101E /end MEASUREMENT
/begin MEASUREMENT InjVlv_tiWaitAct_mp "aktuelle Wartezeit bis zur Freigabe des Überlastbetriebes (seit dem ersten Aufruf der Funktion)" SWORD Time_Second 1 100 -32768.00 32767.00 FORMAT "%8.2" ECU_ADDRESS 0xC000A292 /end MEASUREMENT
/begin MEASUREMENT InjVlv_tiZFCPiI1ETCor "ZFC Ansteuerdauerkorrektur für Voreinspritzung 1" SWORD InjTime_us 1 100 -13107.20 5000.00 ECU_ADDRESS 0xD0001020 /end MEASUREMENT
/begin MEASUREMENT InjVlv_tiZFCPiI2ETCor "korrigierte Ansteuerdauer PiI2" SWORD InjTime_us 1 100 -13107.20 5000.00 ECU_ADDRESS 0xD0001022 /end MEASUREMENT
/begin MEASUREMENT InjVlv_tiZFCPoI1ETCor "" SWORD InjTime_us 1 100 -13107.20 5000.00 ECU_ADDRESS 0xD0001026 /end MEASUREMENT
/begin MEASUREMENT InjVlv_tiZFCPoI2ETCor "" SWORD InjTime_us 1 100 -13107.20 5000.00 ECU_ADDRESS 0xD0001028 /end MEASUREMENT
/begin MEASUREMENT InjVlv_uSetUpAvrg_mp "Gemittelter Spannungssollwert" SWORD Vltg_PA 1 100 -327.6800 327.6700 ECU_ADDRESS 0xC000A294 /end MEASUREMENT
/begin MEASUREMENT InjVlv_uUpPrep "Sollspannung der Injektorvorbereitung" SWORD Vltg_PA 1 100 -327.6800 327.6700 ECU_ADDRESS 0xD000102A /end MEASUREMENT
/begin MEASUREMENT InjVlv_volInET_mp "Y-Eingang des Kennfeldes InjVlv_tiET_MAP auf dem Applikationswerkzeug" SWORD InjQntInj 1 100 -327.6800 327.6700 ECU_ADDRESS 0xC000A29C /end MEASUREMENT
/begin MEASUREMENT InjVlv_volMI1CorCyc "zylinderspezifisches Korrekturvolumen aus Mengenausgleichsregelung und Injektor-Abgleichmenge für MI1" SWORD InjQntInj 1 100 -327.6800 327.6700 ARRAY_SIZE 6 ECU_ADDRESS 0xD000102C /end MEASUREMENT
/begin MEASUREMENT InjVlv_volMI1Cor_mp "Korrigierte Menge der Haupteinspritzung 1" SWORD InjQntInj 1 100 -327.6800 327.6700 ECU_ADDRESS 0xC000A2A2 /end MEASUREMENT
/begin MEASUREMENT InjVlv_volMI1_mp "Einspritzvolumen der Haupteinspritzung 1 nach Mengenabgleich" SWORD InjQntInj 1 100 -327.6800 327.6700 ECU_ADDRESS 0xC000A2A4 /end MEASUREMENT
/begin MEASUREMENT InjVlv_volPiI1CorCyc "zylinderspezifisches Korrekturvolumen aus Mengenausgleichsregelung und Injektor-Abgleichmenge für PiI1" SWORD InjQntInj 1 100 -327.6800 327.6700 ARRAY_SIZE 6 ECU_ADDRESS 0xD0001038 /end MEASUREMENT
/begin MEASUREMENT InjVlv_volPiI1Cor_mp "Korrigiertes Volumen der Voreinspritzung 1" SWORD InjQntInj 1 100 -327.6800 327.6700 ECU_ADDRESS 0xC000A2A8 /end MEASUREMENT
/begin MEASUREMENT InjVlv_volPiI1_mp "Einspritzvolumen der Voreinspritzung 1 nach Mengenabgleich" SWORD InjQntInj 1 100 -327.6800 327.6700 ECU_ADDRESS 0xC000A2AA /end MEASUREMENT
/begin MEASUREMENT InjVlv_volPiI2CorCyc "zylinderspezifisches Korrekturvolumen aus Mengenausgleichsregelung und Injektor-Abgleichmenge für PiI2" SWORD InjQntInj 1 100 -327.6800 327.6700 ARRAY_SIZE 6 ECU_ADDRESS 0xD0001044 /end MEASUREMENT
/begin MEASUREMENT InjVlv_volPiI2Cor_mp "Korrigiertes Volumen der Voreinspritzung 2" SWORD InjQntInj 1 100 -327.6800 327.6700 ECU_ADDRESS 0xC000A2AE /end MEASUREMENT
/begin MEASUREMENT InjVlv_volPiI2_mp "Einspritzvolumen der Voreinspritzung 2 nach Mengenabgleich" SWORD InjQntInj 1 100 -327.6800 327.6700 ECU_ADDRESS 0xC000A2B0 /end MEASUREMENT
/begin MEASUREMENT InjVlv_volPoI1Cor_mp "Korrigiertes Volumen der Nacheinspritzung 1" SWORD InjQntInj 1 100 -327.6800 327.6700 ECU_ADDRESS 0xC000A2B4 /end MEASUREMENT
/begin MEASUREMENT InjVlv_volPoI1_mp "Einspritzvolumen der Nacheinspritzung 1 nach Mengenabgleich" SWORD InjQntInj 1 100 -327.6800 327.6700 ECU_ADDRESS 0xC000A2B6 /end MEASUREMENT
/begin MEASUREMENT InjVlv_volPoI2Cor2_mp "" SWORD InjQntInj 1 100 -327.6800 327.6700 ECU_ADDRESS 0xC000A2BA /end MEASUREMENT
/begin MEASUREMENT InjVlv_volPoI2CorCyc "Zylinderspezifisches Korrekturvolumen aus Mengenausgleichsregelung und Injektor-Abgleichmenge für PoI2" SWORD InjQntInj 1 100 -327.6800 327.6700 ARRAY_SIZE 6 ECU_ADDRESS 0xD0001050 /end MEASUREMENT
/begin MEASUREMENT InjVlv_volPoI2Cor_mp "Korrigiertes Volumen der Nacheinspritzung 2" SWORD InjQntInj 1 100 -327.6800 327.6700 ECU_ADDRESS 0xC000A2BC /end MEASUREMENT
/begin MEASUREMENT InjVlv_volPoI2_mp "Einspritzvolumen der Nacheinspritzung 2 nach Mengenabgleich" SWORD InjQntInj 1 100 -327.6800 327.6700 ECU_ADDRESS 0xC000A2BE /end MEASUREMENT
/begin MEASUREMENT InjVlv_wInjCorr_mp "Korrigierter, bufferseitiger Energieverbrauch einer Piezo-Aktor-Ansteuerung" SWORD W_PA 1 100 -327.6800 327.6700 FORMAT "%8.4" ECU_ADDRESS 0xC000A296 /end MEASUREMENT
/begin MEASUREMENT InjVlv_wInjNom_mp "Nominaler, bufferseitiger Energieverbrauch einer Piezo-Aktor-Ansteuerung" SWORD W_PA 1 100 -327.6800 327.6700 FORMAT "%8.4" ECU_ADDRESS 0xC000A298 /end MEASUREMENT
/begin MEASUREMENT InjVlv_xIntegOvrLd "Integrationswert zur Freigabe/Sperrung des Überlastbetriebes" SWORD FACT_percent 1 100 -100.0031 100.0000 FORMAT "%8.4" ECU_ADDRESS 0xD000105C /end MEASUREMENT
/begin MEASUREMENT InjVlv_xIntegOvrLdOff_mp "Integrationsfaktor für dasAbintegrieren im Erhohlungsbetrieb" SLONG OneToOne 1 100 -2147483648.00 2147483647.00 ECU_ADDRESS 0xC0008FB4 /end MEASUREMENT
/begin MEASUREMENT InjVlv_xIntegOvrLdOn_mp "Integrationsfaktor für das Aufintegrieren im Überlastbetrieb" SLONG OneToOne 1 100 -2147483648.00 2147483647.00 ECU_ADDRESS 0xC0008FB8 /end MEASUREMENT
/begin FUNCTION InjCrv_PoI1EnvCor ""
 /begin DEF_CHARACTERISTIC InjCrv_qPoI1APSCor_MAP InjCrv_qPoI1ETSCor_MAP InjCrv_tiPoI1ETSCor_MAP /end DEF_CHARACTERISTIC
 /begin IN_MEASUREMENT Epm_nEng InjCrv_facPoI1APSQCor InjCrv_facPoI1ETSQCor InjCrv_facPoI1ETStiCor InjCrv_stPoI1RgnTSync InjCtl_qSetUnBal /end IN_MEASUREMENT
 /begin OUT_MEASUREMENT InjCrv_qPoI1EnvCor InjCrv_tiPoI1EnvCor /end OUT_MEASUREMENT
 /begin LOC_MEASUREMENT InjCrv_qPoI1APSCor_mp InjCrv_qPoI1ETSCor_mp /end LOC_MEASUREMENT
/end FUNCTION
/begin FUNCTION InjCrv_PoI1EnvCorSlow ""
 /begin DEF_CHARACTERISTIC InjCrv_facPoI1APSQCor_CUR InjCrv_facPoI1ETSQCor_CUR InjCrv_facPoI1ETStiCor_CUR InjCrv_POpPoI1ETSCor_CUR /end DEF_CHARACTERISTIC
 /begin IN_MEASUREMENT EnvP_p InjSys_tEng /end IN_MEASUREMENT
 /begin OUT_MEASUREMENT InjCrv_facPoI1APSQCor InjCrv_facPoI1ETSQCor InjCrv_facPoI1ETStiCor InjCrv_POpPoI1EnvCor /end OUT_MEASUREMENT
/end FUNCTION
/begin FUNCTION InjCrv_PoI1Rgn ""
 /begin DEF_CHARACTERISTIC InjCrv_facPoI1Eff0Rgn_GMAP InjCrv_facPoI1Eff1Rgn_GMAP InjCrv_facPoI1EffRgnX_AXIS InjCrv_facPoI1EffRgnY_AXIS InjCrv_facPoI1EffRgn_CUR InjCrv_qPoI1Bas0Rgn_GMAP InjCrv_qPoI1Bas1Rgn_GMAP InjCrv_qPoI1BasRgnX_AXIS InjCrv_qPoI1BasRgnY_AXIS InjCrv_tiPoI1Bas0Rgn_GMAP InjCrv_tiPoI1Bas1Rgn_GMAP InjCrv_tiPoI1BasRgnX_AXIS InjCrv_tiPoI1BasRgnY_AXIS /end DEF_CHARACTERISTIC
 /begin IN_MEASUREMENT Epm_nEng ETCtl_qPoI1 ETCtl_tiPoI1Cor InjCrv_facPoI1AddCorRgn InjCrv_qPoI1Des InjCrv_qPoI1Des_mp InjCrv_stPoI1Rgn InjCtl_qSetUnBal /end IN_MEASUREMENT
 /begin OUT_MEASUREMENT InjCrv_facPoI1EffRgn InjCrv_qPoI1Rgn InjCrv_tiPoI1Rgn /end OUT_MEASUREMENT
 /begin LOC_MEASUREMENT InjCrv_numPoI1RgnStg_mp InjCrv_qPoI1BasRgn_mp InjCrv_qPoI1RgnAdd_mp InjCrv_tiPoI1BasRgn_mp /end LOC_MEASUREMENT
/end FUNCTION
/begin FUNCTION InjCrv_PoI1RgnLib ""
 /begin DEF_CHARACTERISTIC InjCrv_facPoI1QntRmp0Val_GCUR InjCrv_facPoI1QntRmp1Val_GCUR InjCrv_facPoI1QntRmpValX_AXIS InjCrv_facPoI1SOERmp0Val_GCUR InjCrv_facPoI1SOERmp1Val_GCUR InjCrv_facPoI1SOERmpValX_AXIS /end DEF_CHARACTERISTIC
 /begin IN_MEASUREMENT CoEOM_facRmpVal InjCrv_facPoI1EffRgn InjCrv_qPoI1Rgn InjCrv_stPoI1Rgn InjCrv_stPoI1RmpSel InjCrv_tiPoI1Rgn /end IN_MEASUREMENT
 /begin LOC_MEASUREMENT InjCrv_facPoI1QntRmpVal_mp InjCrv_facPoI1SOERmpVal_mp /end LOC_MEASUREMENT
/end FUNCTION
/begin FUNCTION InjCrv_PoI1Rls ""
 /begin DEF_CHARACTERISTIC InjCrv_POpPoI1Bas_MAP InjCrv_POpPoI1High_C InjCrv_POpPoI1Low_C InjCrv_POpPoI1RgnHigh_C InjCrv_POpPoI1RgnLow_C InjCrv_POpPoI1Rgn_MAP InjCrv_stPoI1AddRlsMsk_C InjCrv_stPoI1OvrRunRgnMsk_C InjCrv_stPoI1RgnMsk_CA InjCrv_stPoI1RgnRlsMsk_C InjCrv_stPoI1RmpSel_CA InjCrv_tiPoI1OvrRunRgnDeb_C InjCrv_tiPoI1OvrRunRgnMax_C /end DEF_CHARACTERISTIC
 /begin IN_MEASUREMENT CoEOM_facRmpVal Epm_nEng InjCtl_qSetUnBal PthSet_stOvrRun /end IN_MEASUREMENT
 /begin OUT_MEASUREMENT InjCrv_stPoI1RmpSelTSync /end OUT_MEASUREMENT
 /begin LOC_MEASUREMENT InjCrv_POpPoI1Bas_mp InjCrv_POpPoI1Rgn_mp InjCrv_POpPoI1_mp InjCrv_stActValPoI1_mp InjCrv_stDesValPoI1_mp InjCrv_stPoI1RlsDes_mp InjCrv_tiPoI1OvrRunRgn_mp /end LOC_MEASUREMENT
/end FUNCTION
/begin FUNCTION InjCrv_PoI2 ""
 /begin DEF_CHARACTERISTIC InjCrv_facPoI2Eff_MAP InjCrv_facPoI2QntMin_CUR InjCrv_phiPoI2Des_C InjCrv_phiPoI2Min_C InjCrv_qPoI2Bas_MAP InjCrv_qPoI2Des_C InjCrv_qPoI2Eff_C InjCrv_qPoI2SetLim_C InjCrv_swtPhiPoI2Des_C InjCrv_swtQntPoI2Des_C InjCrv_swtQntPoI2Eff_C InjCrv_swtTiPoI2Des_C InjCrv_tiPoI2Des_C InjCrv_tiPoI2Min_C /end DEF_CHARACTERISTIC
 /begin REF_CHARACTERISTIC InjCrv_stInjCharActVal_C InjCrv_stInjDstSel_C InjCrv_swtStInjCharActVal_C /end REF_CHARACTERISTIC
 /begin IN_MEASUREMENT CoEng_stShutOffPath Epm_ctCyl Epm_nEng InjCrv_phiMI1Des InjCrv_phiPoI2AddCor InjCrv_phiPoI2EnvCor InjCrv_qPiI1Des InjCrv_qPiI2Des InjCrv_qPiI3Des InjCrv_qPoI2AddCor InjCrv_qPoI2EnvCor InjCrv_stInjCharActVal InjCrv_stInjCharActValCyl InjCrv_stInjCharActValPrg InjCrv_stInjCharRlsPrgVal InjCrv_stInjCharSetVal InjCrv_stPoI2NrmMode InjCrv_stPoI2Rgn InjCrv_stPoIOvrLim InjCrv_tiMI1ET InjCrv_tiPoI2AddCor InjCrv_tiPoI2EnvCor InjCtl_qSetUnBal InjVlv_tiPse InjVlv_volPoI2CorCyc QWC_qPoI2 RailP_pFlt /end IN_MEASUREMENT
 /begin OUT_MEASUREMENT InjCrv_facPoI2EffSet InjCrv_phiPoI2Des InjCrv_qPoI2Des InjCrv_qPoI2Eff InjCrv_qPoIRem InjCrv_tiPoI2Des InjCrv_tiPoI2ET InjCrv_volPoI2Cor /end OUT_MEASUREMENT
 /begin LOC_MEASUREMENT InjCrv_facPoI2Eff_mp InjCrv_phiPoI2AbsTot_mp InjCrv_phiPoI2Abs_mp InjCrv_phiPoI2Byp_mp InjCrv_phiPoI2Cor_mp InjCrv_phiPoI2DesAdd_mp InjCrv_phiPoI2Rel_mp InjCrv_qLamUnCor InjCrv_qMI1MinPoI2_mp InjCrv_qPoI2Bas_mp InjCrv_qPoI2Cor_mp InjCrv_qPoI2DesAdd_mp InjCrv_qPoI2DesByp_mp InjCrv_qPoI2Des_mp InjCrv_qPoI2EffAdd_mp InjCrv_qPoI2EffByp_mp InjCrv_qPoI2Eff_mp InjCrv_qPoI2Lim_mp InjCrv_qPoI2Max_mp InjCrv_qPoI2Min_mp InjCrv_qPoI2Set_mp InjCrv_stPoI2 InjCrv_swtPoI2AgAbsTDC_mp InjCrv_tiPoI2Byp_mp InjCrv_tiPoI2Cor_mp InjCrv_tiPoI2DesAdd_mp InjCrv_tiPoI2Max_mp InjCrv_tiPoI2RelTot_mp InjCrv_tiPoI2Rel_mp InjCrv_tiPoI2ZFCET_mp InjCrv_volPoI2_mp /end LOC_MEASUREMENT
/end FUNCTION
/begin FUNCTION InjCrv_PoI2AddCor ""
 /begin OUT_MEASUREMENT InjCrv_phiPoI2AddCor InjCrv_POpPoI2AddCor InjCrv_qPoI2AddCor InjCrv_tiPoI2AddCor /end OUT_MEASUREMENT
/end FUNCTION
/begin FUNCTION InjCrv_PoI2AddCorRgnLib "" /end FUNCTION
/begin FUNCTION InjCrv_PoI2AgAbsTDC "" /begin DEF_CHARACTERISTIC InjCrv_stPoI2AgAbsTDCMsk_C /end DEF_CHARACTERISTIC /end FUNCTION
/begin FUNCTION InjCrv_PoI2EnvCor ""
 /begin DEF_CHARACTERISTIC InjCrv_POpPoI2ETSCorStrt_MAP InjCrv_POpPoI2ETSCor_MAP InjCrv_qPoI2APSCorStrt_MAP InjCrv_qPoI2APSCor_MAP InjCrv_qPoI2ATSCorStrt_MAP InjCrv_qPoI2ATSCor_MAP InjCrv_qPoI2ETSCorStrt_MAP InjCrv_qPoI2ETSCor_MAP /end DEF_CHARACTERISTIC
 /begin IN_MEASUREMENT CoEng_st Epm_nEng InjCrv_facPoI2APSQCorStrt InjCrv_facPoI2ATSQCor InjCrv_facPoI2ATSQCorStrt InjCrv_facPoI2ATSSOECor InjCrv_facPoI2ETSQCor InjCrv_facPoI2ETSQCorStrt InjCrv_facPoI2ETSSOECor InjCrv_facPoI2ETSSOECorStrt InjCrv_facPOpPoI2ETSCor InjCrv_facPOpPoI2ETSCorStrt InjCtl_qSetUnBal /end IN_MEASUREMENT
 /begin OUT_MEASUREMENT InjCrv_phiPoI2EnvCor InjCrv_POpPoI2EnvCorStrt InjCrv_qPoI2EnvCor InjCrv_qPoI2EnvCorStrt InjCrv_tiPoI2EnvCor InjCrv_tiPoI2EnvCorStrt /end OUT_MEASUREMENT
 /begin LOC_MEASUREMENT InjCrv_POpPoI2EnvCor InjCrv_qPoI2APSCorStrt_mp InjCrv_qPoI2APSCor_mp InjCrv_qPoI2ATSCorStrt_mp InjCrv_qPoI2ATSCor_mp InjCrv_qPoI2ETSCorStrt_mp InjCrv_qPoI2ETSCor_mp /end LOC_MEASUREMENT
/end FUNCTION
/begin FUNCTION InjCrv_PoI2EnvCorPhi ""
 /begin LOC_MEASUREMENT InjCrv_phiPoI2APSCor_mp InjCrv_phiPoI2ATSCor_mp InjCrv_phiPoI2ETSCor_mp /end LOC_MEASUREMENT
/end FUNCTION
/begin FUNCTION InjCrv_PoI2EnvCorRgn ""
 /begin DEF_CHARACTERISTIC InjCrv_phiPoI2APSCor0Rgn_GMAP InjCrv_phiPoI2APSCor1Rgn_GMAP InjCrv_phiPoI2APSCorRgnX_AXIS InjCrv_phiPoI2APSCorRgnY_AXIS InjCrv_phiPoI2ATSCor0Rgn_GMAP InjCrv_phiPoI2ATSCor1Rgn_GMAP InjCrv_phiPoI2ATSCorRgnX_AXIS InjCrv_phiPoI2ATSCorRgnY_AXIS InjCrv_phiPoI2ETSCor0Rgn_GMAP InjCrv_phiPoI2ETSCor1Rgn_GMAP InjCrv_phiPoI2ETSCorRgnX_AXIS InjCrv_phiPoI2ETSCorRgnY_AXIS InjCrv_qPoI2APSCor0Rgn_GMAP InjCrv_qPoI2APSCor1Rgn_GMAP InjCrv_qPoI2APSCorRgnX_AXIS InjCrv_qPoI2APSCorRgnY_AXIS InjCrv_qPoI2ATSCor0Rgn_GMAP InjCrv_qPoI2ATSCor1Rgn_GMAP InjCrv_qPoI2ATSCorRgnX_AXIS InjCrv_qPoI2ATSCorRgnY_AXIS InjCrv_qPoI2ETSCor0Rgn_GMAP InjCrv_qPoI2ETSCor1Rgn_GMAP InjCrv_qPoI2ETSCorRgnX_AXIS InjCrv_qPoI2ETSCorRgnY_AXIS InjCrv_tiPoI2APSCor0Rgn_GMAP InjCrv_tiPoI2APSCor1Rgn_GMAP InjCrv_tiPoI2APSCorRgnX_AXIS InjCrv_tiPoI2APSCorRgnY_AXIS InjCrv_tiPoI2ETSCor0Rgn_GMAP InjCrv_tiPoI2ETSCor1Rgn_GMAP InjCrv_tiPoI2ETSCorRgnX_AXIS InjCrv_tiPoI2ETSCorRgnY_AXIS /end DEF_CHARACTERISTIC
 /begin IN_MEASUREMENT Epm_nEng InjCrv_facPoI2APSQCorRgn InjCrv_facPoI2APSSOECorRgn InjCrv_facPoI2ATSQCorRgn InjCrv_facPoI2ATSSOECorRgn InjCrv_facPoI2ETSQCorRgn InjCrv_facPoI2ETSSOECorRgn InjCrv_stPoI2RgnTSync InjCtl_qSetUnBal /end IN_MEASUREMENT
 /begin OUT_MEASUREMENT InjCrv_phiPoI2EnvCorRgn InjCrv_qPoI2EnvCorRgn InjCrv_tiPoI2APSCorRgn_mp InjCrv_tiPoI2EnvCorRgn InjCrv_tiPoI2ETSCorRgn_mp /end OUT_MEASUREMENT
 /begin LOC_MEASUREMENT InjCrv_phiPoI2APSCorRgn_mp InjCrv_phiPoI2ATSCorRgn_mp InjCrv_phiPoI2ETSCorRgn_mp InjCrv_qPoI2APSCorRgn_mp InjCrv_qPoI2ATSCorRgn_mp InjCrv_qPoI2ETSCorRgn_mp /end LOC_MEASUREMENT
/end FUNCTION
/begin FUNCTION InjCrv_PoI2EnvCorSlow ""
 /begin DEF_CHARACTERISTIC InjCrv_ctATSPoI2Sel_C InjCrv_facPoI2APSQCorStrt_CUR InjCrv_facPoI2APSQCor_CUR InjCrv_facPoI2APSSOECor_CUR InjCrv_facPoI2ATSQCorStrt_CUR InjCrv_facPoI2ATSQCor_CUR InjCrv_facPoI2ATSSOECor_CUR InjCrv_facPoI2ETSQCorStrt_CUR InjCrv_facPoI2ETSQCor_CUR InjCrv_facPoI2ETSSOECorStrt_CUR InjCrv_facPoI2ETSSOECor_CUR InjCrv_facPOpPoI2ETSCorStrt_CUR InjCrv_facPOpPoI2ETSCor_CUR /end DEF_CHARACTERISTIC
 /begin IN_MEASUREMENT AirSys_tFld CACDsT_t CoEng_st EnvP_p InjSys_tEng /end IN_MEASUREMENT
 /begin OUT_MEASUREMENT InjCrv_facPoI2APSQCor InjCrv_facPoI2APSQCorStrt InjCrv_facPoI2APSSOECor InjCrv_facPoI2ATSQCor InjCrv_facPoI2ATSQCorStrt InjCrv_facPoI2ATSSOECor InjCrv_facPoI2ETSQCor InjCrv_facPoI2ETSQCorStrt InjCrv_facPoI2ETSSOECor InjCrv_facPoI2ETSSOECorStrt InjCrv_facPOpPoI2ETSCor InjCrv_facPOpPoI2ETSCorStrt InjCrv_tAirPoI2 /end OUT_MEASUREMENT
/end FUNCTION
/begin FUNCTION InjCrv_PoI2EnvCorSlowRgn ""
 /begin DEF_CHARACTERISTIC InjCrv_facPoI2APSQCor0Rgn_GCUR InjCrv_facPoI2APSQCor1Rgn_GCUR InjCrv_facPoI2APSQCorRgn_AXIS InjCrv_facPoI2APSSOECor0Rgn_GCUR InjCrv_facPoI2APSSOECor1Rgn_GCUR InjCrv_facPoI2APSSOECorRgn_AXIS InjCrv_facPoI2APSTICor0Rgn_GCUR InjCrv_facPoI2APSTICor1Rgn_GCUR InjCrv_facPoI2APSTICorRgn_AXIS InjCrv_facPoI2ATSQCor0Rgn_GCUR InjCrv_facPoI2ATSQCor1Rgn_GCUR InjCrv_facPoI2ATSQCorRgn_AXIS InjCrv_facPoI2ATSSOECor0Rgn_GCUR InjCrv_facPoI2ATSSOECor1Rgn_GCUR InjCrv_facPoI2ATSSOECorRgn_AXIS InjCrv_facPoI2ETSQCor0Rgn_GCUR InjCrv_facPoI2ETSQCor1Rgn_GCUR InjCrv_facPoI2ETSQCorRgn_AXIS InjCrv_facPoI2ETSSOECor0Rgn_GCUR InjCrv_facPoI2ETSSOECor1Rgn_GCUR InjCrv_facPoI2ETSSOECorRgn_AXIS InjCrv_facPoI2ETSTICor0Rgn_GCUR InjCrv_facPoI2ETSTICor1Rgn_GCUR InjCrv_facPoI2ETSTICorRgn_AXIS /end DEF_CHARACTERISTIC
 /begin IN_MEASUREMENT EnvP_p InjSys_tAirRgn InjSys_tEng InjSys_tEngRgn /end IN_MEASUREMENT
 /begin OUT_MEASUREMENT InjCrv_facPoI2APSQCorRgn InjCrv_facPoI2APSSOECorRgn InjCrv_facPoI2APSTICorRgn InjCrv_facPoI2ATSQCorRgn InjCrv_facPoI2ATSSOECorRgn InjCrv_facPoI2ETSQCorRgn InjCrv_facPoI2ETSSOECorRgn InjCrv_facPoI2ETSTICorRgn /end OUT_MEASUREMENT
/end FUNCTION
/begin FUNCTION InjCrv_PoI2EnvCorTi ""
 /begin DEF_CHARACTERISTIC InjCrv_tiPoI2APSCor_MAP InjCrv_tiPoI2ATSCor_MAP InjCrv_tiPoI2ETSCorStrt_MAP InjCrv_tiPoI2ETSCor_MAP /end DEF_CHARACTERISTIC
 /begin IN_MEASUREMENT Epm_nEng InjCtl_qSetUnBal /end IN_MEASUREMENT
 /begin LOC_MEASUREMENT InjCrv_tiPoI2APSCor_mp InjCrv_tiPoI2ATSCor_mp InjCrv_tiPoI2ETSCorStrt_mp InjCrv_tiPoI2ETSCor_mp /end LOC_MEASUREMENT
/end FUNCTION
/begin FUNCTION InjCrv_PoI2Rgn ""
 /begin DEF_CHARACTERISTIC InjCrv_facPoI2Eff0Rgn_GMAP InjCrv_facPoI2Eff1Rgn_GMAP InjCrv_facPoI2EffRgnX_AXIS InjCrv_facPoI2EffRgnY_AXIS InjCrv_facPoI2EffRgn_CUR InjCrv_phiPoI2Bas0Rgn_GMAP InjCrv_phiPoI2Bas1Rgn_GMAP InjCrv_phiPoI2BasRgnX_AXIS InjCrv_phiPoI2BasRgnY_AXIS InjCrv_phiPoI2MaxRgn_MAP InjCrv_qPoI2Bas0Rgn_GMAP InjCrv_qPoI2Bas1Rgn_GMAP InjCrv_qPoI2BasRgnX_AXIS InjCrv_qPoI2BasRgnY_AXIS InjCrv_tiPoI2Bas0Rgn_GMAP InjCrv_tiPoI2Bas1Rgn_GMAP InjCrv_tiPoI2BasRgnX_AXIS InjCrv_tiPoI2BasRgnY_AXIS /end DEF_CHARACTERISTIC
 /begin IN_MEASUREMENT Epm_ctCyl Epm_nEng InjCrv_phiPoI2Des InjCrv_phiPoI2EnvCorRgn InjCrv_qPoI2Des InjCrv_qPoI2Des_mp InjCrv_qPoI2EnvCorRgn InjCrv_stPoI2Rgn InjCtl_qSetUnBal /end IN_MEASUREMENT
 /begin OUT_MEASUREMENT InjCrv_facPoI2EffRgn InjCrv_phiPoI2Rgn InjCrv_qPoI2Rgn InjCrv_tiPoI2Rgn /end OUT_MEASUREMENT
 /begin LOC_MEASUREMENT InjCrv_numPoI2RgnStg_mp InjCrv_phiPoI2BasRgn_mp InjCrv_phiPoI2MaxRgn_mp InjCrv_phiPoI2RgnAdd_mp InjCrv_qPoI2BasRgn_mp InjCrv_qPoI2RgnAdd_mp InjCrv_tiPoI2BasRgn_mp /end LOC_MEASUREMENT
/end FUNCTION
/begin FUNCTION InjCrv_PoI2RgnLib ""
 /begin DEF_CHARACTERISTIC InjCrv_facPoI2AngRmp0Val_GCUR InjCrv_facPoI2AngRmp1Val_GCUR InjCrv_facPoI2AngRmpValX_AXIS InjCrv_facPoI2QntRmp0Val_GCUR InjCrv_facPoI2QntRmp1Val_GCUR InjCrv_facPoI2QntRmpValX_AXIS InjCrv_facPoI2SOEtiRmpVal_CUR InjCrv_facPoI2TiRmp0Val_GCUR InjCrv_facPoI2TiRmp1Val_GCUR InjCrv_facPoI2TiRmpValX_AXIS InjCrv_phiPoI2ReplNrm_MAP InjCrv_swtPoI2SOEReplNrm_C /end DEF_CHARACTERISTIC
 /begin IN_MEASUREMENT CoEOM_facRmpVal Epm_nEng InjCrv_facPoI2EffRgn InjCrv_phiPoI2Rgn InjCrv_qPoI2Rgn InjCrv_stPoI2Rgn InjCrv_stPoI2RmpSel InjCrv_tiPoI2Rgn InjCtl_qSetUnBal /end IN_MEASUREMENT
 /begin OUT_MEASUREMENT InjCrv_facPoI2SOEtiRmpVal_mp /end OUT_MEASUREMENT
 /begin LOC_MEASUREMENT InjCrv_facPoI2AngRmpVal_mp InjCrv_facPoI2QntRmpVal_mp InjCrv_facPoI2TiRmpVal_mp InjCrv_phiPoI2NrmVal_mp /end LOC_MEASUREMENT
/end FUNCTION
/begin FUNCTION InjCrv_PoI2Rls ""
 /begin DEF_CHARACTERISTIC InjCrv_phiPoI2HysOilDil_C InjCrv_phiPoI2MinOilDil_CUR InjCrv_POpPoI2Bas_MAP InjCrv_POpPoI2High_C InjCrv_POpPoI2Low_C InjCrv_POpPoI2RgnHigh_C InjCrv_POpPoI2RgnLow_C InjCrv_POpPoI2Rgn_MAP InjCrv_stPoI2AddRlsMsk_C InjCrv_stPoI2RgnMsk_CA InjCrv_stPoI2RgnRlsMsk_C InjCrv_stPoI2RmpSel_CA /end DEF_CHARACTERISTIC
 /begin IN_MEASUREMENT CoEOM_facRmpVal Epm_ctCyl Epm_nEng InjCrv_phiPoI2Des InjCrv_qPoI2Des InjCrv_qPoI2Des_mp InjCrv_tiPoI2Des InjCtl_qSetUnBal /end IN_MEASUREMENT
 /begin OUT_MEASUREMENT InjCrv_stPoI2RmpSelTSync /end OUT_MEASUREMENT
 /begin LOC_MEASUREMENT InjCrv_phiPoI2DesTot_mp InjCrv_phiPoI2MinOilDil_mp InjCrv_POpPoI2Bas_mp InjCrv_POpPoI2Rgn_mp InjCrv_POpPoI2_mp InjCrv_stActValPoI2_mp InjCrv_stDesValPoI2_mp InjCrv_stPoI2RlsDes_mp /end LOC_MEASUREMENT
/end FUNCTION
/begin FUNCTION InjCrv_PoI2SOEPhiBas "" /begin LOC_MEASUREMENT InjCrv_phiPoI2Bas_mp /end LOC_MEASUREMENT /end FUNCTION
/begin FUNCTION InjCrv_PoI2SOETiBas "" /begin DEF_CHARACTERISTIC InjCrv_tiPoI2Bas_MAP /end DEF_CHARACTERISTIC /begin IN_MEASUREMENT Epm_nEng InjCtl_qSetUnBal /end IN_MEASUREMENT /begin LOC_MEASUREMENT InjCrv_tiPoI2Bas_mp /end LOC_MEASUREMENT /end FUNCTION
/begin FUNCTION InjCrv_PoI2StrtLib ""
 /begin DEF_CHARACTERISTIC InjCrv_POpPoI2BasStrt_MAP InjCrv_POpPoI2HighStrt_C InjCrv_POpPoI2LowStrt_C InjCrv_qPoI2BasStrt_MAP InjCrv_tiPoI2BasStrt_MAP /end DEF_CHARACTERISTIC
 /begin IN_MEASUREMENT CoEng_st Epm_nEng InjCrv_POpPoI2EnvCorStrt InjCrv_qPoI2EnvCorStrt InjCrv_tiPoI2EnvCorStrt InjCtl_qSetUnBal /end IN_MEASUREMENT
 /begin LOC_MEASUREMENT InjCrv_POpPoI2BasStrt_mp InjCrv_qPoI2BasStrt_mp InjCrv_tiPoI2BasStrt_mp /end LOC_MEASUREMENT
/end FUNCTION
/begin FUNCTION InjCrv_PoIOvrLim ""
 /begin DEF_CHARACTERISTIC InjCrv_qPoIOvrMax_C InjCrv_swtPoIOvrLimActive_C InjCrv_tiPoIOvrLimMax_C InjCrv_tOxiPoILimMax_C InjCrv_tPFltUsPoILimMax_C /end DEF_CHARACTERISTIC
 /begin IN_MEASUREMENT Epm_ctCyl Epm_nEng Epm_numCyl Exh_tAdapTOxiCatUs Exh_tAdapTPFltUs InjCrv_qPoI1Des InjCrv_qPoI2Des InjCtl_qSetUnBal /end IN_MEASUREMENT
 /begin LOC_MEASUREMENT InjCrv_qPoIOvrAct_mp InjCrv_qPoIOvrTot_mp InjCrv_qPoI_mp InjCrv_stPoIOvrLim InjCrv_stPoIOvrLimReset_mp InjCrv_stPoIOvrRaw_mp /end LOC_MEASUREMENT
/end FUNCTION
/begin FUNCTION InjCrv_QntMinLib "" /begin DEF_CHARACTERISTIC InjCrv_qMin_CUR /end DEF_CHARACTERISTIC /begin IN_MEASUREMENT RailP_pFlt /end IN_MEASUREMENT /begin LOC_MEASUREMENT InjCrv_qPiI1MinWv_mp /end LOC_MEASUREMENT /end FUNCTION
/begin FUNCTION InjCrv_ShOffTst ""
 /begin DEF_CHARACTERISTIC InjCrv_nMaxShOffTst_C InjCrv_swtNoChkRefShOffTst_C InjCrv_swtShOffTst_C /end DEF_CHARACTERISTIC
 /begin IN_MEASUREMENT Brk_st Clth_st Epm_nEng PT_stTraType VehV_v /end IN_MEASUREMENT
 /begin OUT_MEASUREMENT InjCrv_stInjCharComp InjCrv_stInjCharShOffTst InjCrv_stStMShOffTst /end OUT_MEASUREMENT
 /begin LOC_MEASUREMENT InjCrv_stRefShOffTst InjCrv_stStMShOffTst_mp /end LOC_MEASUREMENT
/end FUNCTION
/begin FUNCTION Injctl_qCo ""
 /begin DEF_CHARACTERISTIC InjCtl_dAdjQntCSMax_C InjCtl_dAdjQntCSMin_C InjCtl_facAdjSrvMax_C InjCtl_facAdjSrvMin_C InjCtl_InjQntDT1.T1_C InjCtl_InjQntDT1.Kd_C InjCtl_qAdjQntMax_C InjCtl_qAdjQntMin_C InjCtl_qAdjQnt_MAP InjCtl_qLimSoftShOff_CUR InjCtl_swtDiffQntIn_C InjCtl_tiInjQntPT1_C /end DEF_CHARACTERISTIC
 /begin IN_MEASUREMENT ASMod_qCor CnvLead_qCurr CnvLead_qRaw CnvSet_qNrm CnvSet_qSet CnvSet_qStrt CoEng_st CoEng_stShOff CoEng_stShutOffPath Epm_nEng FMA_qCor FMO_qCor /end IN_MEASUREMENT
 /begin OUT_MEASUREMENT InjCtl_dqLead InjCtl_qAdjQnt InjCtl_qCurr InjCtl_qCurrAdd_mp InjCtl_qCurrB1 InjCtl_qCurrB2 InjCtl_qNrm InjCtl_qRaw InjCtl_qRawAdd_mp InjCtl_qRawB1 InjCtl_qRawB2 InjCtl_qSetUnBal InjCtl_qSetUnBalAdd_mp InjCtl_qSetUnBalB1 InjCtl_qSetUnBalB2 /end OUT_MEASUREMENT
 /begin LOC_MEASUREMENT InjCtl_dAdjQntCS_mp InjCtl_facAdjSrvCmpl_mp InjCtl_facAdjSrv_mp InjCtl_qAdjQntUnlim_mp InjCtl_qCurrByp_mp InjCtl_qLimSoftShOff_mp InjCtl_qRawByp_mp InjCtl_qSetUnBalByp_mp InjCtl_qSetUnCor_mp InjCtl_stAdjQnt_mp /end LOC_MEASUREMENT
/end FUNCTION
/begin FUNCTION InjDev_GlbDef "" /end FUNCTION
/begin FUNCTION InjSys_Co ""
 /begin DEF_CHARACTERISTIC InjSys_ctAirTempRgnSel_C InjSys_ctAirTempSel_C InjSys_ctEngTempRgnSelPiIRls_C InjSys_ctEngTempRgnSel_C InjSys_ctEngTempSelPiIRls_C InjSys_ctEngTempSel_C /end DEF_CHARACTERISTIC
 /begin IN_MEASUREMENT AirSys_tFld EngDa_tFld HPUn_trqLoss InjCtl_qCurr InjCtl_qRaw InjCtl_qSetUnBal PthLead_trqInrCurr PthLead_trqInrLead PthSet_trqInrSet Rail_trqLim /end IN_MEASUREMENT
 /begin OUT_MEASUREMENT InjSys_tAir InjSys_tAirRgn InjSys_tEng InjSys_tEngPiIRls InjSys_tEngRgn InjSys_tEngRgnPiIRls InjSys_trqLim InjSys_trqLoss /end OUT_MEASUREMENT
 /begin LOC_MEASUREMENT InjSys_stLeadPar_mp /end LOC_MEASUREMENT
/end FUNCTION
/begin FUNCTION InjSys_CtlQnt ""
 /begin DEF_CHARACTERISTIC InjSys_facEngTempHCCor_CUR InjSys_facMIHCRgn_MAP InjSys_facMIHC_MAP InjSys_facPoI1HtHCPoI2_CUR InjSys_facPoI1HtHC_MAP InjSys_facPoI2HtHCPoI1_CUR InjSys_facPoI2HtHC_MAP InjSys_stMskCoEOMHC_C InjSys_swtPoI1EffInrCmb_C /end DEF_CHARACTERISTIC
 /begin IN_MEASUREMENT ASMod_qDiffPoI1Ref ASMod_qDiffPoI2Ref CEngDsT_t CoEng_stShutOffPath CoEOM_stOpModeAct Epm_ctCyl Epm_nEng InjCrv_qMI1Des InjCrv_qPiI1Des InjCrv_qPiI2Des InjCrv_qPiI3Des InjCrv_qPoI1Des InjCrv_qPoI1Eff InjCrv_qPoI2Des InjCrv_qPoI2Eff InjCrv_stInjCharActVal InjCtl_qSetUnBal PthSet_stDisable /end IN_MEASUREMENT
 /begin OUT_MEASUREMENT InjSys_qBasHCEmi InjSys_qHCEmi InjSys_qInrCmb InjSys_qOutrCmb InjSys_qPoIHCEmi InjSys_qTot InjSys_stCtlQnt /end OUT_MEASUREMENT
 /begin LOC_MEASUREMENT InjSys_facMIHC_mp InjSys_facPoI1HC_mp InjSys_facPoI2HC_mp InjSys_qMIHC_mp InjSys_qNoTrqPoI1_mp InjSys_qNoTrqPoI2_mp /end LOC_MEASUREMENT
/end FUNCTION
/begin FUNCTION InjSys_GlbDef "" /end FUNCTION
/begin FUNCTION InjSys_Lib ""
 /begin IN_MEASUREMENT InjCrv_qPiI1Des InjCrv_qPiI2Des InjCrv_qPiI3Des InjCrv_qPoI1Des InjCrv_qPoI2Des InjCrv_qPoI2Eff InjCrv_stInjCharActValCyl InjSys_qInrCmb InjSys_qOutrCmb /end IN_MEASUREMENT
/end FUNCTION
/begin FUNCTION InjUn_MassCnv "" /begin IN_MEASUREMENT FlSys_rhoFlCnvFac FlSys_swtRhoFlCnv /end IN_MEASUREMENT /end FUNCTION
/begin FUNCTION InjUn_StrtTst ""
 /begin DEF_CHARACTERISTIC InjUn_ctSyncStrtPls_C InjUn_nStrtLim_C InjUn_stShOffStrt_C InjUn_swtStrtPls_C InjUn_tiRailStrtPls_C InjUn_tiShOffStrtPls_C InjUn_tiSpdStrtPls_C /end DEF_CHARACTERISTIC
 /begin IN_MEASUREMENT CoEng_st CoEng_stShutOffPath Epm_nEng Epm_stOpMode /end IN_MEASUREMENT
 /begin OUT_MEASUREMENT InjUn_stStrt /end OUT_MEASUREMENT
 /begin LOC_MEASUREMENT InjUn_stStrtCsBlk_mp /end LOC_MEASUREMENT
/end FUNCTION
/begin FUNCTION InjVlv_AddBal "" /begin DEF_CHARACTERISTIC InjVlv_facAddBalRls_MAP /end DEF_CHARACTERISTIC /begin IN_MEASUREMENT Epm_ctCyl InjCtl_qSetUnBal RailP_pFlt /end IN_MEASUREMENT /begin OUT_MEASUREMENT InjVlv_facAddBalRls /end OUT_MEASUREMENT /end FUNCTION
/begin FUNCTION InjVlv_AddBalLib "" /begin DEF_CHARACTERISTIC InjVlv_facBalMax_C /end DEF_CHARACTERISTIC
 /begin LOC_MEASUREMENT InjVlv_qMI1Bal_mp InjVlv_qPiI1Bal_mp InjVlv_qPiI2Bal_mp InjVlv_qPiI3Bal_mp InjVlv_qPoI1BalEff_mp InjVlv_qPoI1Bal_mp InjVlv_qPoI2BalEff_mp InjVlv_qPoI2Bal_mp /end LOC_MEASUREMENT
/end FUNCTION
/begin FUNCTION InjVlv_AddBalZFC "" /begin DEF_CHARACTERISTIC InjVlv_stZFCETPoICorActv_C /end DEF_CHARACTERISTIC /begin REF_CHARACTERISTIC InjVlv_stZFCETCorActv_C InjVlv_swtZFCCorOvrRunOn_C /end REF_CHARACTERISTIC
 /begin IN_MEASUREMENT InjVlv_rZFCETPoI1CoeffMsk InjVlv_rZFCETPoI2CoeffMsk MoFOvR_stActvMsg /end IN_MEASUREMENT
/end FUNCTION
/begin FUNCTION InjVlv_Auto "" /end FUNCTION
/begin FUNCTION InjVlv_CalcMI1ET ""
 /begin DEF_CHARACTERISTIC InjVlv_nETMaxLim_C InjVlv_swtTiMI1ET_C InjVlv_tiETMax_C InjVlv_tiMI1ET_C /end DEF_CHARACTERISTIC
 /begin REF_CHARACTERISTIC InjVlv_tiETMinLow_C /end REF_CHARACTERISTIC
 /begin IN_MEASUREMENT InjVlv_tiMI1CSCCor /end IN_MEASUREMENT
 /begin OUT_MEASUREMENT InjVlv_tiMI1ETUnLim /end OUT_MEASUREMENT
 /begin LOC_MEASUREMENT InjVlv_tiMI1ET_mp /end LOC_MEASUREMENT
/end FUNCTION
/begin FUNCTION InjVlv_CalcPiI1ET "" /begin DEF_CHARACTERISTIC InjVlv_swtTiPiI1ET_C InjVlv_tiPiI1ET_C /end DEF_CHARACTERISTIC /begin REF_CHARACTERISTIC InjVlv_tiETMinLow_C /end REF_CHARACTERISTIC /begin OUT_MEASUREMENT InjVlv_tiZFCPiI1ETCor /end OUT_MEASUREMENT /begin LOC_MEASUREMENT InjVlv_tiPiI1ET_mp /end LOC_MEASUREMENT /end FUNCTION
/begin FUNCTION InjVlv_CalcPiI2ET "" /begin DEF_CHARACTERISTIC InjVlv_swtTiPiI2ET_C InjVlv_tiPiI2ET_C /end DEF_CHARACTERISTIC /begin REF_CHARACTERISTIC InjVlv_tiETMinLow_C /end REF_CHARACTERISTIC /begin OUT_MEASUREMENT InjVlv_tiZFCPiI2ETCor /end OUT_MEASUREMENT /begin LOC_MEASUREMENT InjVlv_tiPiI2ET_mp /end LOC_MEASUREMENT /end FUNCTION
/begin FUNCTION InjVlv_CalcPiI3ET "" /end FUNCTION
/begin FUNCTION InjVlv_CalcPoI1ET "" /begin DEF_CHARACTERISTIC InjVlv_swtTiPoI1ET_C InjVlv_tiPoI1ET_C /end DEF_CHARACTERISTIC /begin REF_CHARACTERISTIC InjVlv_tiETMinLow_C /end REF_CHARACTERISTIC /begin OUT_MEASUREMENT InjVlv_tiZFCPoI1ETCor /end OUT_MEASUREMENT /begin LOC_MEASUREMENT InjVlv_tiPoI1ET_mp /end LOC_MEASUREMENT /end FUNCTION
/begin FUNCTION InjVlv_CalcPoI2ET "" /begin DEF_CHARACTERISTIC InjVlv_swtTiPoI2ET_C InjVlv_tiPoI2ET_C /end DEF_CHARACTERISTIC /begin REF_CHARACTERISTIC InjVlv_tiETMinLow_C /end REF_CHARACTERISTIC /begin OUT_MEASUREMENT InjVlv_tiZFCPoI2ETCor /end OUT_MEASUREMENT /begin LOC_MEASUREMENT InjVlv_tiPoI2ET_mp /end LOC_MEASUREMENT /end FUNCTION
/begin FUNCTION InjVlv_ChrgBalInjLim ""
 /begin DEF_CHARACTERISTIC InjVlv_numInjChrgBalRC_C InjVlv_numInjChrgBal_CUR InjVlv_numInjDesRC_C InjVlv_pwrDCDCMax_CUR InjVlv_pwrDCDCOvrLdMax_CUR InjVlv_rChrgBalInjHys_C InjVlv_rOvrLdRlx_C InjVlv_swtNumInjRC_C InjVlv_tiOvrLdMax_C InjVlv_tiWaitActv_C InjVlv_wInj_CUR InjVlv_xOvrLdRlxThresh_C /end DEF_CHARACTERISTIC
 /begin IN_MEASUREMENT BattU_u Epm_nEng IVActr_facWActrDvtAvrg IVCtl_uUp /end IN_MEASUREMENT
 /begin OUT_MEASUREMENT InjVlv_xIntegOvrLd /end OUT_MEASUREMENT
 /begin LOC_MEASUREMENT InjVlv_frqTDC_mp InjVlv_numCylECU_mp InjVlv_numInjChrgBalLim_mp InjVlv_numInjChrgBalRaw_mp InjVlv_numInjChrgBal_mp InjVlv_numInjDes_mp InjVlv_numInjOvrLdRaw_mp InjVlv_numInjOvrLd_mp InjVlv_pwrDCDCMax_mp InjVlv_pwrDCDCOvrLdMax_mp InjVlv_pwrInjAvrg_mp InjVlv_stOvrLdRls_mp InjVlv_tiWaitAct_mp InjVlv_uSetUpAvrg_mp InjVlv_wInjCorr_mp InjVlv_wInjNom_mp InjVlv_xIntegOvrLdOff_mp InjVlv_xIntegOvrLdOn_mp /end LOC_MEASUREMENT
/end FUNCTION
/begin FUNCTION InjVlv_EstET "" /begin REF_CHARACTERISTIC InjVlv_tiETMinLow_C /end REF_CHARACTERISTIC /begin IN_MEASUREMENT InjVlv_tiMI1CSCCor /end IN_MEASUREMENT /end FUNCTION
/begin FUNCTION InjVlv_GetBgn "" /end FUNCTION
/begin FUNCTION InjVlv_GetET "" /begin DEF_CHARACTERISTIC InjVlv_swtInputETMAP_C InjVlv_tiET_MAP /end DEF_CHARACTERISTIC /begin LOC_MEASUREMENT InjVlv_pInET_mp InjVlv_volInET_mp /end LOC_MEASUREMENT /end FUNCTION
/begin FUNCTION InjVlv_GetInfo "" /begin IN_MEASUREMENT Epm_numCyl /end IN_MEASUREMENT /end FUNCTION
/begin FUNCTION InjVlv_GetOvrInf "" /begin IN_MEASUREMENT Epm_numCyl /end IN_MEASUREMENT /end FUNCTION
/begin FUNCTION InjVlv_GlbDef "" /end FUNCTION
/begin FUNCTION InjVlv_HDIni "" /begin DEF_CHARACTERISTIC InjVlv_tiWup2On_C /end DEF_CHARACTERISTIC /begin REF_CHARACTERISTIC InjVlv_tiETMinLow_C /end REF_CHARACTERISTIC /end FUNCTION
/begin FUNCTION InjVlv_HDLib "" /begin DEF_CHARACTERISTIC InjVlv_numBnkTDC_CA InjVlv_numECUTDC_CA InjVlv_numPsTDC_CA /end DEF_CHARACTERISTIC /end FUNCTION
/begin FUNCTION InjVlv_InjCo "" /begin DEF_CHARACTERISTIC InjVlv_stInjCoRC_C InjVlv_swtInjCoRC_C /end DEF_CHARACTERISTIC
 /begin IN_MEASUREMENT InjVlv_stPrep IVDia_stTst IVDia_stTstActv IVPSIC_stIntegAdjStM IVPSply_stDCDCCo MoCSOP_stRdyMsg /end IN_MEASUREMENT
 /begin OUT_MEASUREMENT InjVlv_stInjCo /end OUT_MEASUREMENT
 /begin LOC_MEASUREMENT InjVlv_stInjCoRun_mp /end LOC_MEASUREMENT
/end FUNCTION
/begin FUNCTION InjVlv_InjRls "" /begin DEF_CHARACTERISTIC InjVlv_stInjCharComp_C InjVlv_stInjRls_CA /end DEF_CHARACTERISTIC
 /begin IN_MEASUREMENT Epm_ctCyl InjCrv_stInjCharComp InjCrv_stInjCharShOffTst InjCrv_stStMShOffTst MoCSOP_stActvMsg /end IN_MEASUREMENT
 /begin OUT_MEASUREMENT InjVlv_stInjCharComp InjVlv_stInjRls /end OUT_MEASUREMENT
/end FUNCTION
/begin FUNCTION InjVlv_MI1DynQntCor ""
 /begin LOC_MEASUREMENT InjVlv_ctCylMI1_mp InjVlv_qMI1Cor_mp InjVlv_volMI1Cor_mp InjVlv_volMI1_mp /end LOC_MEASUREMENT
/end FUNCTION
/begin FUNCTION InjVlv_MI2DynQntCor "" /end FUNCTION
/begin FUNCTION InjVlv_PiI1DynQntCor "" /begin IN_MEASUREMENT IVAdj_volPiI1QntAdj_mp /end IN_MEASUREMENT
 /begin LOC_MEASUREMENT InjVlv_ctCylPiI1_mp InjVlv_qPiI1Cor_mp InjVlv_volPiI1Cor_mp InjVlv_volPiI1_mp /end LOC_MEASUREMENT
/end FUNCTION
/begin FUNCTION InjVlv_PiI2DynQntCor ""
 /begin LOC_MEASUREMENT InjVlv_ctCylPiI2_mp InjVlv_qPiI2Cor_mp InjVlv_volPiI2Cor_mp InjVlv_volPiI2_mp /end LOC_MEASUREMENT
/end FUNCTION
/begin FUNCTION InjVlv_PiI3DynQntCor "" /end FUNCTION
/begin FUNCTION InjVlv_PoI1DynQntCor "" /begin DEF_CHARACTERISTIC InjVlv_qPoI1Min_C /end DEF_CHARACTERISTIC
 /begin LOC_MEASUREMENT InjVlv_ctCylPoI1_mp InjVlv_qPoI1Cor_mp InjVlv_volPoI1Cor_mp InjVlv_volPoI1_mp /end LOC_MEASUREMENT
/end FUNCTION
/begin FUNCTION InjVlv_PoI2DynQntCor "" /begin OUT_MEASUREMENT InjVlv_volPoI2CorCyc /end OUT_MEASUREMENT
 /begin LOC_MEASUREMENT InjVlv_ctCylPoI2_mp InjVlv_qPoI2Cor_mp InjVlv_volPoI2Cor2_mp InjVlv_volPoI2Cor_mp InjVlv_volPoI2_mp /end LOC_MEASUREMENT
/end FUNCTION
/begin FUNCTION InjVlv_Prep ""
 /begin DEF_CHARACTERISTIC InjVlv_numPrep_C InjVlv_pPrepMax_C InjVlv_stPrepRC_C InjVlv_swtPrepRC_C InjVlv_tiChrgPrep_CUR InjVlv_tiDisChPrep_CUR InjVlv_tiETPrep_CUR InjVlv_tPrepMax_C InjVlv_uUpPrep_CUR /end DEF_CHARACTERISTIC
 /begin REF_CHARACTERISTIC InjVlv_numBnkTDC_CA /end REF_CHARACTERISTIC
 /begin IN_MEASUREMENT InjVlv_stInjCo IVActr_tActr IVPSply_stBufErr RailP_pFlt /end IN_MEASUREMENT
 /begin OUT_MEASUREMENT InjVlv_stPrep InjVlv_tiChrgPrep InjVlv_tiDisChPrep InjVlv_uUpPrep /end OUT_MEASUREMENT
 /begin LOC_MEASUREMENT InjVlv_numPrepLeft_mp InjVlv_stPrepInjErr_mp InjVlv_stPrepInjOK_mp InjVlv_stPrepPreCond_mp InjVlv_tiETPrep_mp /end LOC_MEASUREMENT
/end FUNCTION
/begin FUNCTION InjVlv_PresMin "" /begin DEF_CHARACTERISTIC InjVlv_pMin_C InjVlv_pMin_CUR /end DEF_CHARACTERISTIC /begin IN_MEASUREMENT CoEng_st EngDa_tEng RailP_pFlt Rail_stCtlLoop /end IN_MEASUREMENT /end FUNCTION
/begin FUNCTION InjVlv_ProgETLib ""
 /begin LOC_MEASUREMENT InjVlv_stInjMI1_mp InjVlv_stInjMI2_mp InjVlv_stInjPiI1_mp InjVlv_stInjPiI2_mp InjVlv_stInjPiI3_mp InjVlv_stInjPoI1_mp InjVlv_stInjPoI2_mp /end LOC_MEASUREMENT
/end FUNCTION
/begin FUNCTION InjVlv_ProgETZFC "" /begin LOC_MEASUREMENT InjVlv_stInjZFC_mp /end LOC_MEASUREMENT /end FUNCTION
/begin FUNCTION InjVlv_ProgMI "" /begin DEF_CHARACTERISTIC InjVlv_rGlobDynTimePrio_MAP /end DEF_CHARACTERISTIC /begin IN_MEASUREMENT Epm_nEng InjCtl_qSetUnBal /end IN_MEASUREMENT
 /begin LOC_MEASUREMENT InjVlv_ctMI1AgDiff_mp InjVlv_phiInjBegMI1_mp InjVlv_phiMI1Diff_mp InjVlv_rGlobDynTimePrio_mp /end LOC_MEASUREMENT
/end FUNCTION
/begin FUNCTION InjVlv_ProgPiI "" /begin REF_CHARACTERISTIC InjVlv_swtEnaAgDiff_C /end REF_CHARACTERISTIC
 /begin IN_MEASUREMENT CoEng_stShutOffPath Epm_ctCyl Epm_nEng Epm_numCyl FBC_q FlSys_rhoFl InjCrv_phiPiI1Des InjCrv_phiPiI2Des InjCrv_phiPiI3Des InjCrv_qPiI1Des InjCrv_qPiI2Des InjCrv_qPiI3Des InjCrv_stInjCharActVal InjCrv_stInjCharActValPrg InjCrv_stInjCharRlsPrgVal InjCrv_tiPiI1Des InjCrv_tiPiI2Des InjCtl_qSetUnBal InjVlv_facAddBalRls InjVlv_volPiI1CorCyc InjVlv_volPiI2CorCyc QWC_facFTS QWC_st RailP_pFlt /end IN_MEASUREMENT
 /begin LOC_MEASUREMENT InjVlv_ctPiI1AgDiff_mp InjVlv_phiPiI1Diff_mp /end LOC_MEASUREMENT
/end FUNCTION
/begin FUNCTION InjVlv_ProgPiI2 "" /begin REF_CHARACTERISTIC InjVlv_swtEnaAgDiff_C /end REF_CHARACTERISTIC /begin IN_MEASUREMENT Epm_nEng /end IN_MEASUREMENT /begin LOC_MEASUREMENT InjVlv_ctPiI2AgDiff_mp InjVlv_phiPiI2Diff_mp /end LOC_MEASUREMENT /end FUNCTION
/begin FUNCTION InjVlv_ProgPiI3 "" /end FUNCTION
/begin FUNCTION InjVlv_ProgPoI1 "" /begin IN_MEASUREMENT InjCrv_qPoI2Des InjCrv_tiPoI1Des QWC_facFTS QWC_st /end IN_MEASUREMENT /end FUNCTION
/begin FUNCTION InjVlv_ProgPoI2 "" /end FUNCTION
/begin FUNCTION InjVlv_ProgZFC "" /end FUNCTION
/begin FUNCTION InjVlv_PsICLib "" /begin IN_MEASUREMENT Epm_numCyl /end IN_MEASUREMENT /end FUNCTION
/begin FUNCTION InjVlv_Sched ""
 /begin DEF_CHARACTERISTIC InjVlv_PZOSW_C InjVlv_swtAgTi2AgMode_C InjVlv_swtEnaAgDiff_C InjVlv_tiETMinLow_C /end DEF_CHARACTERISTIC
 /begin REF_CHARACTERISTIC IVDia_tiETTst_C /end REF_CHARACTERISTIC
 /begin IN_MEASUREMENT CoEng_stShutOffPath Epm_nEng Epm_numCyl FBC_qArr FlSys_rhoFl InjCrv_qMI1Des InjCrv_qPiI1Des InjCrv_qPiI2Des InjCrv_qPiI3Des InjCrv_qPoI1Des InjCrv_qPoI1Eff InjCrv_qPoI2Des InjCrv_qPoI2Eff InjCrv_stInjCharActVal InjCtl_qSetUnBal InjVlv_facAddBalRls InjVlv_stInjCo IVCtl_iChrg IVCtl_iDisCh IVCtl_tiChrg IVCtl_tiPseChrg IVCtl_tiPseDisCh IVDia_stTst QWC_facFTS QWC_qNorm QWC_st RailP_pFlt /end IN_MEASUREMENT
 /begin OUT_MEASUREMENT InjVlv_volMI1CorCyc InjVlv_volPiI1CorCyc InjVlv_volPiI2CorCyc /end OUT_MEASUREMENT
 /begin LOC_MEASUREMENT InjVlv_stTCtlInj_mp /end LOC_MEASUREMENT
/end FUNCTION
/begin FUNCTION InjVlv_SetBgn "" /end FUNCTION
/begin FUNCTION InjVlv_SetDur "" /end FUNCTION
/begin FUNCTION InjVlv_SetImmdInj "" /begin REF_CHARACTERISTIC InjVlv_numBnkTDC_CA InjVlv_numPsTDC_CA /end REF_CHARACTERISTIC /begin IN_MEASUREMENT Epm_numCyl /end IN_MEASUREMENT /end FUNCTION
/begin FUNCTION InjVlv_SetTiPse "" /begin DEF_CHARACTERISTIC InjVlv_tiPause_C /end DEF_CHARACTERISTIC /begin OUT_MEASUREMENT InjVlv_tiPse /end OUT_MEASUREMENT /end FUNCTION
/begin FUNCTION InjVlv_SetupInjProc "" /begin IN_MEASUREMENT Epm_numCyl /end IN_MEASUREMENT /end FUNCTION
/begin FUNCTION InjVlv_SPIIni "" /begin REF_CHARACTERISTIC InjVlv_numBnkTDC_CA /end REF_CHARACTERISTIC /begin OUT_MEASUREMENT InjVlv_PsIcStIniDiag InjVlv_PsIcStIniTrans /end OUT_MEASUREMENT /begin LOC_MEASUREMENT InjVlv_stPsIcChipVer_mp InjVlv_stPsIcIni_mp /end LOC_MEASUREMENT /end FUNCTION
/begin FUNCTION InjVlv_SPIInjDia ""
 /begin LOC_MEASUREMENT InjVlv_stPsIcDiaBnk1_mp InjVlv_stPsIcDiaBnk2_mp InjVlv_stPsIcNumBnkPcP_mp InjVlv_stPsIcNumBnk_mp InjVlv_stPsIcNumChipPcP_mp InjVlv_stPsIcNumChip_mp InjVlv_stPsIcStBufDatEx_mp InjVlv_stPsIcStBufTraInj_mp InjVlv_stPsIcTra_mp /end LOC_MEASUREMENT
/end FUNCTION
/begin FUNCTION InjVlv_SPILib "" /end FUNCTION
/begin FUNCTION InjVlv_SPIMemChk "" /end FUNCTION
/begin COMPU_METHOD AirTempFldSel "" TAB_VERB "%6.3" "" COMPU_TAB_REF AirTempFldSel /end COMPU_METHOD
/begin COMPU_VTAB AirTempFldSel "" TAB_VERB 4 0 "Air_tCACDs" 1 "Air_tAFS" 2 "EnvT_t" 3 "Air_tAFSCorr" /end COMPU_VTAB
/begin COMPU_METHOD AngleCrS "" RAT_FUNC "%6.3" "deg CrS" COEFFS 0 45.5111111111 0 0 0 1 /end COMPU_METHOD
/begin COMPU_METHOD CBYVLV_ATSINTVMOD_SY_Compu "" TAB_VERB "%6.3" "" COMPU_TAB_REF CBYVLV_ATSINTVMOD_SY_Compu /end COMPU_METHOD
/begin COMPU_VTAB CBYVLV_ATSINTVMOD_SY_Compu "" TAB_VERB 2 0 "False" 1 "True" /end COMPU_VTAB
/begin COMPU_METHOD CnvtCoeffCatAir "" RAT_FUNC "%6.4" "J/K/s/m^2" COEFFS 0 50 0 0 0 1 /end COMPU_METHOD
/begin COMPU_METHOD CoEOMSwt_S16 "" RAT_FUNC "%7.6" "-" COEFFS 0 16384 0 0 0 1 /end COMPU_METHOD
/begin COMPU_METHOD EGTSwt_S16 "" RAT_FUNC "%7.6" "-" COEFFS 0 16384 0 0 0 1 /end COMPU_METHOD
/begin COMPU_METHOD EngN "" RAT_FUNC "%5.1" "rpm" COEFFS 0 2 0 0 0 1 /end COMPU_METHOD
/begin COMPU_METHOD EngTempFldSel "" TAB_VERB "%6.3" "" COMPU_TAB_REF EngTempFldSel /end COMPU_METHOD
/begin COMPU_VTAB EngTempFldSel "" TAB_VERB 4 0 "Coolant_Temperature" 1 "Oil_Temperature" 2 "EngDa_tEng" 3 "Chamberwall_Temperature" /end COMPU_VTAB
/begin COMPU_METHOD Fact "" RAT_FUNC "%6.5" "-" COEFFS 0 8192 0 0 0 1 /end COMPU_METHOD
/begin COMPU_METHOD Fact1 "" RAT_FUNC "%6.4" "-" COEFFS 0 128 0 0 0 1 /end COMPU_METHOD
/begin COMPU_METHOD FACT_percent "" RAT_FUNC "%6.4" "%" COEFFS 0 327.67 0 0 0 1 /end COMPU_METHOD
/begin COMPU_METHOD FACT_Rlx "" RAT_FUNC "%6.3" "-" COEFFS 0 10 0 0 0 1 /end COMPU_METHOD
/begin COMPU_METHOD FrqTDC "" RAT_FUNC "%6.4" "1/s" COEFFS 0 50 0 0 0 1 /end COMPU_METHOD
/begin COMPU_METHOD INJCRV_MSK_VERB "" TAB_VERB "%6.3" "-" COMPU_TAB_REF INJCRV_MSK_VERB /end COMPU_METHOD
/begin COMPU_VTAB INJCRV_MSK_VERB "" TAB_VERB 8 0 "NRM" 1 "MSK0" 2 "MSK1" 3 "MSK2" 4 "MSK3" 5 "MSK4" 6 "MSK5" 7 "MSK6" /end COMPU_VTAB
/begin COMPU_METHOD INJCRV_RMP_VERB "" TAB_VERB "%6.3" "-" COMPU_TAB_REF INJCRV_RMP_VERB /end COMPU_METHOD
/begin COMPU_VTAB INJCRV_RMP_VERB "" TAB_VERB 7 1 "RMP1" 2 "RMP2" 3 "RMP3" 4 "RMP4" 5 "RMP5" 6 "RMP6" 7 "RMP7" /end COMPU_VTAB
/begin COMPU_METHOD InjMass "" RAT_FUNC "%5.2" "mg/hub" COEFFS 0 100 0 0 0 1 /end COMPU_METHOD
/begin COMPU_METHOD InjMassCyc "" RAT_FUNC "%5.2" "mg/cyc" COEFFS 0 100 0 0 0 1 /end COMPU_METHOD
/begin COMPU_METHOD InjMassInj "" RAT_FUNC "%5.2" "mg/inj" COEFFS 0 100 0 0 0 1 /end COMPU_METHOD
/begin COMPU_METHOD InjMassSec "" RAT_FUNC "%6.4" "mg/hub/s" COEFFS 0 100 0 0 0 1 /end COMPU_METHOD
/begin COMPU_METHOD InjMassTot "" RAT_FUNC "%6.4" "mg" COEFFS 0 100 0 0 0 1 /end COMPU_METHOD
/begin COMPU_METHOD InjQntInj "" RAT_FUNC "%5.2" "mm^3/inj" COEFFS 0 100 0 0 0 1 /end COMPU_METHOD
/begin COMPU_METHOD InjTime_us "" RAT_FUNC "%5.1" "us" COEFFS 0 2.5 0 0 0 1 /end COMPU_METHOD
/begin COMPU_METHOD InjVlv_AgTi2AgMode "" TAB_VERB "%6.3" "-" COMPU_TAB_REF InjVlv_AgTi2AgMode /end COMPU_METHOD
/begin COMPU_VTAB InjVlv_AgTi2AgMode "" TAB_VERB 2 0 "EXTRAPOLATION" 1 "MIAP" /end COMPU_VTAB
/begin COMPU_METHOD Kd "" RAT_FUNC "%7.6" "1/1" COEFFS 0 65536 0 0 0 1 /end COMPU_METHOD
/begin COMPU_METHOD NumInjChrgBalRaw "" RAT_FUNC "%6.4" "-" COEFFS 0 100 0 0 0 1 /end COMPU_METHOD
/begin COMPU_METHOD OneToOne "" RAT_FUNC "%6.0" "-" COEFFS 0 1 0 0 0 1 /end COMPU_METHOD
/begin COMPU_METHOD Prc "" RAT_FUNC "%6.4" "%" COEFFS 0 81.92 0 0 0 1 /end COMPU_METHOD
/begin COMPU_METHOD Pres_hPa "" RAT_FUNC "%5.1" "hPa" COEFFS 0 1 0 0 0 1 /end COMPU_METHOD
/begin COMPU_METHOD Pres_Rail "" RAT_FUNC "%5.1" "bar" COEFFS 0 10.000000 0 0 0 1 /end COMPU_METHOD
/begin COMPU_METHOD Pwr_PA "" RAT_FUNC "%6.2" "mW" COEFFS 0 0.2 0 0 0 1 /end COMPU_METHOD
/begin COMPU_METHOD SETPOINTCALC_TRQBASED_SY_Compu "" TAB_VERB "%6.3" "" COMPU_TAB_REF SETPOINTCALC_TRQBASED_SY_Compu /end COMPU_METHOD
/begin COMPU_VTAB SETPOINTCALC_TRQBASED_SY_Compu "" TAB_VERB 2 0 "0" 1 "1" /end COMPU_VTAB
/begin COMPU_METHOD Temp_Cels "" RAT_FUNC "%5.1" "deg C" COEFFS 0 10 2731.4 0 0 1 /end COMPU_METHOD
/begin COMPU_METHOD TimeDelay_s "" RAT_FUNC "%12.4" "s" COEFFS 0 0 1 0 0.00023283064365387 0 /end COMPU_METHOD
/begin COMPU_METHOD Time_ms "" RAT_FUNC "%5.0" "ms" COEFFS 0 0.1 0 0 0 1 /end COMPU_METHOD
/begin COMPU_METHOD Time_s "" RAT_FUNC "%5.2" "s" COEFFS 0 100 0 0 0 1 /end COMPU_METHOD
/begin COMPU_METHOD Time_Second "" RAT_FUNC "%6.2" "s" COEFFS 0 1 0 0 0 1 /end COMPU_METHOD
/begin COMPU_METHOD Trq "" RAT_FUNC "%5.1" "Nm" COEFFS 0 10 0 0 0 1 /end COMPU_METHOD
/begin COMPU_METHOD Vltg_PA "" RAT_FUNC "%4.2" "V" COEFFS 0 100 0 0 0 1 /end COMPU_METHOD
/begin COMPU_METHOD Volt_Batt "" RAT_FUNC "%5.0" "mV" COEFFS 0 0.05 0 0 0 1 /end COMPU_METHOD
/begin COMPU_METHOD W_PA "" RAT_FUNC "%6.4" "mWs" COEFFS 0 100 0 0 0 1 /end COMPU_METHOD
/begin RECORD_LAYOUT Axis_Xs16 NO_AXIS_PTS_X 1 SWORD AXIS_PTS_X 2 SWORD INDEX_INCR DIRECT /end RECORD_LAYOUT
/begin RECORD_LAYOUT CurG_Ws16 FNC_VALUES 1 SWORD COLUMN_DIR DIRECT /end RECORD_LAYOUT
/begin RECORD_LAYOUT Cur_Xs16Ws16 NO_AXIS_PTS_X 1 SWORD AXIS_PTS_X 2 SWORD INDEX_INCR DIRECT FNC_VALUES 3 SWORD COLUMN_DIR DIRECT /end RECORD_LAYOUT
/begin RECORD_LAYOUT Kf_Xs16_Ys16_Ws16 NO_AXIS_PTS_X 1 SWORD NO_AXIS_PTS_Y 2 SWORD AXIS_PTS_X 3 SWORD INDEX_INCR DIRECT AXIS_PTS_Y 4 SWORD INDEX_INCR DIRECT FNC_VALUES 5 SWORD COLUMN_DIR DIRECT /end RECORD_LAYOUT
/begin RECORD_LAYOUT Kl_Xs16_Ws16 NO_AXIS_PTS_X 1 SWORD AXIS_PTS_X 2 SWORD INDEX_INCR DIRECT FNC_VALUES 3 SWORD COLUMN_DIR DIRECT /end RECORD_LAYOUT
/begin RECORD_LAYOUT Kw_Ws16 FNC_VALUES 1 SWORD COLUMN_DIR DIRECT /end RECORD_LAYOUT
/begin RECORD_LAYOUT Kw_Ws32 FNC_VALUES 1 SLONG COLUMN_DIR DIRECT /end RECORD_LAYOUT
/begin RECORD_LAYOUT Kw_Wu8 FNC_VALUES 1 UBYTE COLUMN_DIR DIRECT /end RECORD_LAYOUT
/begin RECORD_LAYOUT MapG_Ws16 FNC_VALUES 1 SWORD COLUMN_DIR DIRECT /end RECORD_LAYOUT
/begin RECORD_LAYOUT Map_Xs16Ys16Ws16 NO_AXIS_PTS_X 1 SWORD NO_AXIS_PTS_Y 2 SWORD AXIS_PTS_X 3 SWORD INDEX_INCR DIRECT AXIS_PTS_Y 4 SWORD INDEX_INCR DIRECT FNC_VALUES 5 SWORD COLUMN_DIR DIRECT /end RECORD_LAYOUT
/begin RECORD_LAYOUT Map_Xu8Yu8Wu8 NO_AXIS_PTS_X 1 UBYTE NO_AXIS_PTS_Y 2 UBYTE AXIS_PTS_X 3 UBYTE INDEX_INCR DIRECT AXIS_PTS_Y 4 UBYTE INDEX_INCR DIRECT FNC_VALUES 5 UBYTE COLUMN_DIR DIRECT /end RECORD_LAYOUT
/begin RECORD_LAYOUT ValA_Wu32 FNC_VALUES 1 ULONG COLUMN_DIR DIRECT /end RECORD_LAYOUT
/begin RECORD_LAYOUT ValA_Wu8 FNC_VALUES 1 UBYTE COLUMN_DIR DIRECT /end RECORD_LAYOUT
/begin RECORD_LAYOUT Val_Ws16 FNC_VALUES 1 SWORD COLUMN_DIR DIRECT /end RECORD_LAYOUT
/begin RECORD_LAYOUT Val_Ws32 FNC_VALUES 1 SLONG COLUMN_DIR DIRECT /end RECORD_LAYOUT
/begin RECORD_LAYOUT Val_Wu16 FNC_VALUES 1 UWORD COLUMN_DIR DIRECT /end RECORD_LAYOUT
/begin RECORD_LAYOUT Val_Wu32 FNC_VALUES 1 ULONG COLUMN_DIR DIRECT /end RECORD_LAYOUT
/begin RECORD_LAYOUT Val_Wu8 FNC_VALUES 1 UBYTE COLUMN_DIR DIRECT /end RECORD_LAYOUT
/end MODULE
/end PROJECT

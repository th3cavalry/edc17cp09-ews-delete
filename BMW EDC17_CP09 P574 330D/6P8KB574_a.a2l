ASAP2_VERSION 1 4
/begin PROJECT P_574 "EDC17_CP09"
/begin HEADER "" VERSION "V8KB" PROJECT_NO P_574 /end HEADER
/begin MODULE DIM ""
/begin MOD_COMMON "" BYTE_ORDER MSB_LAST ALIGNMENT_BYTE 1 ALIGNMENT_WORD 2 ALIGNMENT_LONG 4 ALIGNMENT_FLOAT32_IEEE 4 /end MOD_COMMON
/begin CHARACTERISTIC Com_swtaDirect_C "" VALUE 0x8004E036 Val_Wu8 1.000 OneToOne 0.00 1.000 EXTENDED_LIMITS 0.00 255.0 /end CHARACTERISTIC
/begin CHARACTERISTIC Com_swtaSide_C "" VALUE 0x8004E037 Val_Wu8 1.000 OneToOne 0.00 1.000 EXTENDED_LIMITS 0.00 255.0 /end CHARACTERISTIC
/begin CHARACTERISTIC Com_swtBOSRst2_C "" VALUE 0x8004E01C Val_Wu8 1.000 OneToOne 0.00 1.000 EXTENDED_LIMITS 0.00 255.0 /end CHARACTERISTIC
/begin CHARACTERISTIC Com_swtBOSRst_C "" VALUE 0x8004E01D Val_Wu8 1.000 OneToOne 0.00 1.000 EXTENDED_LIMITS 0.00 255.0 /end CHARACTERISTIC
/begin CHARACTERISTIC Com_swtBtnDrvDyn_FX_C "" VALUE 0x8004E038 Val_Wu8 1.000 OneToOne 0.00 1.000 EXTENDED_LIMITS 0.00 255.0 /end CHARACTERISTIC
/begin CHARACTERISTIC Com_swtCodierungPwrmng_FA_C "" VALUE 0x8004E02A Val_Wu8 255.0 OneToOne 0.00 255.0 /end CHARACTERISTIC
/begin CHARACTERISTIC Com_swtCtrCrshSwoEkp_A_C "" VALUE 0x8004E026 Val_Wu8 255.0 OneToOne 0.00 255.0 /end CHARACTERISTIC
/begin CHARACTERISTIC Com_swtCtrCrshSwoEkp_FA_C "" VALUE 0x8004E02B Val_Wu8 255.0 OneToOne 0.00 255.0 /end CHARACTERISTIC
/begin CHARACTERISTIC Com_swtDiensteID38_FA_C "" VALUE 0x8004E02C Val_Wu8 255.0 OneToOne 0.00 255.0 /end CHARACTERISTIC
/begin CHARACTERISTIC Com_swtDienste_FA_C "" VALUE 0x8004E02D Val_Wu8 255.0 OneToOne 0.00 255.0 /end CHARACTERISTIC
/begin CHARACTERISTIC Com_swtFahrzeugtyp_C "" VALUE 0x8004E01E Val_Wu8 1.000 OneToOne 0.00 1.000 EXTENDED_LIMITS 0.00 255.0 /end CHARACTERISTIC
/begin CHARACTERISTIC Com_swtFahrzeugtyp_FA_C "" VALUE 0x8004E02E Val_Wu8 255.0 OneToOne 0.00 255.0 /end CHARACTERISTIC
/begin CHARACTERISTIC Com_swtFllupGpwsup_FA_C "" VALUE 0x8004E02F Val_Wu8 255.0 OneToOne 0.00 255.0 /end CHARACTERISTIC
/begin CHARACTERISTIC Com_swtKlemmen_A_C "" VALUE 0x8004E027 Val_Wu8 255.0 OneToOne 0.00 255.0 /end CHARACTERISTIC
/begin CHARACTERISTIC Com_swtKlemmen_FA_C "" VALUE 0x8004E030 Val_Wu8 255.0 OneToOne 0.00 255.0 /end CHARACTERISTIC
/begin CHARACTERISTIC Com_swtParkConsumer_C "" VALUE 0x8004E01F Val_Wu8 1.000 OneToOne 0.00 1.000 EXTENDED_LIMITS 0.00 255.0 /end CHARACTERISTIC
/begin CHARACTERISTIC Com_swtReqEFan_C "" VALUE 0x8004E020 Val_Wu8 1.000 OneToOne 0.00 1.000 EXTENDED_LIMITS 0.00 255.0 /end CHARACTERISTIC
/begin CHARACTERISTIC Com_swtReqMSA_C "" VALUE 0x8004E021 Val_Wu8 1.000 OneToOne 0.00 1.000 EXTENDED_LIMITS 0.00 255.0 /end CHARACTERISTIC
/begin CHARACTERISTIC Com_swtRequestEMF_C "" VALUE 0x8004E022 Val_Wu8 1.000 OneToOne 0.00 1.000 EXTENDED_LIMITS 0.00 255.0 /end CHARACTERISTIC
/begin CHARACTERISTIC Com_swtShiftPaddle_FX_C "" VALUE 0x8004E039 Val_Wu8 1.000 OneToOne 0.00 1.000 EXTENDED_LIMITS 0.00 255.0 /end CHARACTERISTIC
/begin CHARACTERISTIC Com_swtSlrdiGlbFZM_FA_C "" VALUE 0x8004E031 Val_Wu8 255.0 OneToOne 0.00 255.0 /end CHARACTERISTIC
/begin CHARACTERISTIC Com_swtSpeedVehicle_FX_C "" VALUE 0x8004E03A Val_Wu8 1.000 OneToOne 0.00 1.000 EXTENDED_LIMITS 0.00 255.0 /end CHARACTERISTIC
/begin CHARACTERISTIC Com_swtStatEkp_A_C "" VALUE 0x8004E028 Val_Wu8 255.0 OneToOne 0.00 255.0 /end CHARACTERISTIC
/begin CHARACTERISTIC Com_swtStateSeat_FA_C "" VALUE 0x8004E032 Val_Wu8 255.0 OneToOne 0.00 255.0 /end CHARACTERISTIC
/begin CHARACTERISTIC Com_swtStatusEMF_C "" VALUE 0x8004E023 Val_Wu8 1.000 OneToOne 0.00 1.000 EXTENDED_LIMITS 0.00 255.0 /end CHARACTERISTIC
/begin CHARACTERISTIC Com_swtStatZVKlappen_FA_C "" VALUE 0x8004E033 Val_Wu8 255.0 OneToOne 0.00 255.0 /end CHARACTERISTIC
/begin CHARACTERISTIC Com_swtTrailer_FA_C "" VALUE 0x8004E034 Val_Wu8 255.0 OneToOne 0.00 255.0 /end CHARACTERISTIC
/begin CHARACTERISTIC Com_swtTrqDemCrshDrDy_FX_C "" VALUE 0x8004E03B Val_Wu8 1.000 OneToOne 0.00 1.000 EXTENDED_LIMITS 0.00 255.0 /end CHARACTERISTIC
/begin CHARACTERISTIC Com_swtVerbraucher_C "" VALUE 0x8004E024 Val_Wu8 1.000 OneToOne 0.00 1.000 EXTENDED_LIMITS 0.00 255.0 /end CHARACTERISTIC
/begin CHARACTERISTIC Lub_dmFlAddBas_MAP "Kennfeld für Kraftstoffmassenstrom ins Motoröl infolge Nacheinspritzung" MAP 0x8004DAD8 Kf_Xs16_Ys16_Ws16 400.0000 OilMFl_mgps_q0p1 0.00 400.0000 FORMAT "%8.4" EXTENDED_LIMITS -3276.800 3276.700
 /begin AXIS_DESCR STD_AXIS Epm_nEng EngN 2 0.00 10000.00 EXTENDED_LIMITS -16384.00 16383.50 DEPOSIT ABSOLUTE /end AXIS_DESCR
 /begin AXIS_DESCR STD_AXIS InjCtl_qSetUnBal InjMass 2 0.00 327.6700 EXTENDED_LIMITS -327.6800 327.6700 DEPOSIT ABSOLUTE /end AXIS_DESCR
/end CHARACTERISTIC
/begin CHARACTERISTIC Lub_dmFlEvpBas_MAP "Kennfeld für Basis-Kraftstoffmassenstrom aus dem Motoröl infolge Verflüchtigung" MAP 0x8004DAEC Kf_Xs16_Ys16_Ws16 75.00000 OilMFl_mgps_q0p1 0.00 75.00000 FORMAT "%8.5" EXTENDED_LIMITS -3276.800 3276.700
 /begin AXIS_DESCR STD_AXIS Epm_nEng EngN 2 0.00 10000.00 EXTENDED_LIMITS -16384.00 16383.50 DEPOSIT ABSOLUTE /end AXIS_DESCR
 /begin AXIS_DESCR STD_AXIS InjCtl_qSetUnBal InjMass 2 0.00 327.6700 EXTENDED_LIMITS -327.6800 327.6700 DEPOSIT ABSOLUTE /end AXIS_DESCR
/end CHARACTERISTIC
/begin CHARACTERISTIC Lub_dmFlOilRmvBas_MAP "Kennfeld für Basis-Gesamtölmassenstrom aus dem Motoröl" MAP 0x8004DB00 Kf_Xs16_Ys16_Ws16 75.00000 OilMFl_mgps_q0p1 0.00 75.00000 FORMAT "%8.5" EXTENDED_LIMITS -3276.800 3276.700
 /begin AXIS_DESCR STD_AXIS Epm_nEng EngN 2 0.00 10000.00 EXTENDED_LIMITS -16384.00 16383.50 DEPOSIT ABSOLUTE /end AXIS_DESCR
 /begin AXIS_DESCR STD_AXIS InjCtl_qSetUnBal InjMass 2 0.00 327.6700 EXTENDED_LIMITS -327.6800 327.6700 DEPOSIT ABSOLUTE /end AXIS_DESCR
/end CHARACTERISTIC
/begin CHARACTERISTIC Lub_facFlAddTempEng_CUR "Temperaturabhängige Kennlinie zur Korrektur des Kraftstoffmassenstroms ins Motoröl infolge Nacheinspritzung" CURVE 0x8004DB14 Cur_Xs16Ws16 1.000000 Fact_q0p001 0.00 1.000000 FORMAT "%8.6" EXTENDED_LIMITS -32.76800 32.76700
 /begin AXIS_DESCR STD_AXIS Lub_tEng_mp Temp_Cels 8 -0.04000000 3276.660 EXTENDED_LIMITS -3549.940 3003.560 DEPOSIT ABSOLUTE /end AXIS_DESCR
/end CHARACTERISTIC
/begin CHARACTERISTIC Lub_facFlEvpTemp_CUR "Temperaturabhängige Kennline zur Korrektur des Kraftstoffmassenstroms aus dem Motoröl infolge Verflüchtigung" CURVE 0x8004DB36 Cur_Xs16Ws16 1.000000 Fact_q0p001 0.00 1.000000 FORMAT "%8.6" EXTENDED_LIMITS -32.76800 32.76700
 /begin AXIS_DESCR STD_AXIS Lub_tOil Temp_Cels 8 -100.0400 499.9600 EXTENDED_LIMITS -3549.940 3003.560 DEPOSIT ABSOLUTE /end AXIS_DESCR
/end CHARACTERISTIC
/begin CHARACTERISTIC Lub_facFlOilRmvMs_CUR "Ölmassenabhängige Kennlinie zur Korrektur des Gesamtölmassenstroms aus dem Motoröl" CURVE 0x8004DB58 Cur_Xs16Ws16 1.000000 Fact_q0p001 0.00 1.000000 FORMAT "%8.6" EXTENDED_LIMITS -32.76800 32.76700
 /begin AXIS_DESCR STD_AXIS Lub_mTotCrvIn_mp OilMs_q10 8 0.00 10000.00 FORMAT "%8.2" EXTENDED_LIMITS -327680.0 327670.0 DEPOSIT ABSOLUTE /end AXIS_DESCR
/end CHARACTERISTIC
/begin CHARACTERISTIC Lub_facFlOilRmvTemp_CUR "Temperaturabhängige Kennlinie zur Korrektur des Gesamtölmassenstroms aus dem Motoröl" CURVE 0x8004DB7A Cur_Xs16Ws16 1.000000 Fact_q0p001 0.00 1.000000 FORMAT "%8.6" EXTENDED_LIMITS -32.76800 32.76700
 /begin AXIS_DESCR STD_AXIS Lub_tOil Temp_Cels 8 -0.04000000 3276.660 EXTENDED_LIMITS -3549.940 3003.560 DEPOSIT ABSOLUTE /end AXIS_DESCR
/end CHARACTERISTIC
/begin CHARACTERISTIC Lub_lOilChngEEPSubs_C "Ersatzwert für Wegstrecke seit dem letzten Ölwechsel" VALUE 0x8004DB9C Val_Ws32 70000000.0000 Length 0.00 70000000.0000 FORMAT "%13.4" EXTENDED_LIMITS -2147483648.00 2147483647.00 /end CHARACTERISTIC
/begin CHARACTERISTIC Lub_lOilChngLim_C "Maximale Wegstrecke seit dem letzten Ölwechsel" VALUE 0x8004DBA0 Val_Ws32 70000000.0000 Length 0.00 70000000.0000 FORMAT "%13.4" EXTENDED_LIMITS -2147483648.00 2147483647.00 /end CHARACTERISTIC
/begin CHARACTERISTIC Lub_mFlEEPSubs_C "Ersatzwert für Kraftstoffmenge enthalten im Motoröl" VALUE 0x8004DBA4 Val_Ws32 40000.0000000 OilMs_q0p1 0.00 40000.0000000 FORMAT "%13.7" EXTENDED_LIMITS -214748364.800 214748364.700 /end CHARACTERISTIC
/begin CHARACTERISTIC Lub_mLvl2Ms_MAP "Kennfeld zur Berechnung der Gesamtölmasse im Motor aus Ölstandssensorwert" MAP 0x8004DBA8 Kf_Xs16_Ys16_Ws16 32770.00 OilMs_q10 0.00 32770.00 FORMAT "%8.2" EXTENDED_LIMITS -327680.0 327670.0
 /begin AXIS_DESCR STD_AXIS Oil_lSwmp OneToOne 16 0.00 32767.00 EXTENDED_LIMITS -32768.00 32767.00 DEPOSIT ABSOLUTE /end AXIS_DESCR
 /begin AXIS_DESCR STD_AXIS Lub_tOilLvl_mp Temp_Cels 16 -100.0400 499.9600 EXTENDED_LIMITS -3549.940 3003.560 DEPOSIT ABSOLUTE /end AXIS_DESCR
/end CHARACTERISTIC
/begin CHARACTERISTIC Lub_mOilEngDflMax_C "Maximale Startölmasse" VALUE 0x8004DDEC Val_Ws32 40000.0000000 OilMs_q0p1 0.00 40000.0000000 FORMAT "%13.7" EXTENDED_LIMITS -214748364.800 214748364.700 /end CHARACTERISTIC
/begin CHARACTERISTIC Lub_mOilEngDflMin_C "Minimale Startölmasse" VALUE 0x8004DDF0 Val_Ws32 40000.0000000 OilMs_q0p1 0.00 40000.0000000 FORMAT "%13.7" EXTENDED_LIMITS -214748364.800 214748364.700 /end CHARACTERISTIC
/begin CHARACTERISTIC Lub_mOilEngSensVldMax_C "Maximale Ölmasse zur Validierung des Ölstandssensors" VALUE 0x8004DDF4 Val_Ws32 40000.0000000 OilMs_q0p1 0.00 40000.0000000 FORMAT "%13.7" EXTENDED_LIMITS -214748364.800 214748364.700 /end CHARACTERISTIC
/begin CHARACTERISTIC Lub_mOilEngSensVldMin_C "Minimale Ölmasse zur Validierung des Ölstandssensors" VALUE 0x8004DDF8 Val_Ws32 40000.0000000 OilMs_q0p1 0.00 40000.0000000 FORMAT "%13.7" EXTENDED_LIMITS -214748364.800 214748364.700 /end CHARACTERISTIC
/begin CHARACTERISTIC Lub_mOilRmvEEPSubs_C "Ersatzwert für reinen Ölverbrauch" VALUE 0x8004DDFC Val_Ws32 10000.0000000 OilMs_mg 0.00 10000.0000000 FORMAT "%13.7" EXTENDED_LIMITS -2147483648.00 2147483647.00 /end CHARACTERISTIC
/begin CHARACTERISTIC Lub_mskCritOilLvl_CA "Maske für Aktivierung der Ölverdünnungsberechnung" VAL_BLK 0x8004DE00 ValA_Wu32 4294967295.00 OneToOne 0.00 4294967295.00 NUMBER 2 /end CHARACTERISTIC
/begin CHARACTERISTIC Lub_mTotMaxCrit_C "Maximale kritische Ölmasse" VALUE 0x8004DE08 Val_Ws32 40000.0000000 OilMs_q0p1 0.00 40000.0000000 FORMAT "%13.7" EXTENDED_LIMITS -214748364.800 214748364.700 /end CHARACTERISTIC
/begin CHARACTERISTIC Lub_mTotMinCrit_C "Minimale kritische Ölmasse" VALUE 0x8004DE0C Val_Ws32 40000.0000000 OilMs_q0p1 0.00 40000.0000000 FORMAT "%13.7" EXTENDED_LIMITS -214748364.800 214748364.700 /end CHARACTERISTIC
/begin CHARACTERISTIC Lub_numTempEng_C "Auswahl der Motortemperatur aus Temperaturfeld" VALUE 0x8004DE10 Val_Wu8 16.00 OneToOne 0.00 16.00 EXTENDED_LIMITS 0.00 255.0 /end CHARACTERISTIC
/begin CHARACTERISTIC Lub_numTempOil_C "Auswahl der Öltemperatur aus Temperaturfeld" VALUE 0x8004DE11 Val_Wu8 16.00 OneToOne 0.00 16.00 EXTENDED_LIMITS 0.00 255.0 /end CHARACTERISTIC
/begin CHARACTERISTIC Lub_rFlOilCritFldt_C "Maximales Kraftstoff-Öl Verhältnis bei maximaler Gesamtölmasse" VALUE 0x8004DE12 Val_Ws16 100.0000 OilMsPrc_q0p01 0.00 100.0000 FORMAT "%8.4" EXTENDED_LIMITS -327.6800 327.6700 /end CHARACTERISTIC
/begin CHARACTERISTIC Lub_rFlOilDflMinCritFldt_C "Maximales Kraftstoff-Öl Verhältnis bei minimaler Gesamtölmasse" VALUE 0x8004DE14 Val_Ws16 100.0000 OilMsPrc_q0p01 0.00 100.0000 FORMAT "%8.4" EXTENDED_LIMITS -327.6800 327.6700 /end CHARACTERISTIC
/begin CHARACTERISTIC Lub_rhoFuel_C "Kraftstoffsdichte (Kg/M ** 3)" VALUE 0x8004DE18 Val_Ws32 429496729.500 RhoFuel -214748364.800 214748364.700 FORMAT "%13.3" /end CHARACTERISTIC
/begin CHARACTERISTIC Lub_swtOilSensVldMaxMnl_C "Manuelle Bedingung für Übernahme des Ölsensorwertes für maximale Gesamtölmasse" VALUE 0x8004DE1C Val_Wu8 1.000 OneToOne 0.00 1.000 EXTENDED_LIMITS 0.00 255.0 /end CHARACTERISTIC
/begin CHARACTERISTIC Lub_swtOilSensVldMinMnl_C "Manuelle Bedingung für Übernahme des Ölsensorwertes für minimale Gesamtölmasse" VALUE 0x8004DE1D Val_Wu8 1.000 OneToOne 0.00 1.000 EXTENDED_LIMITS 0.00 255.0 /end CHARACTERISTIC
/begin CHARACTERISTIC Lub_swtSrvVal_C "Serviceschalter zum Zurücksetzen der EEPROM Werte" VALUE 0x8004DE1E Val_Wu8 1.000 OneToOne 0.00 1.000 EXTENDED_LIMITS 0.00 255.0 /end CHARACTERISTIC
/begin CHARACTERISTIC Lub_tiMsOilSensVldDeb_C "Entprellzeit für Gültigkeitsbedingungen der Übernahme des Ölsensorwertes als Gesamtölmasse" VALUE 0x8004DE20 Val_Wu16 1000.000 Time_ms 0.00 1000.000 EXTENDED_LIMITS 0.00 655350.0 /end CHARACTERISTIC
/begin CHARACTERISTIC medc_datasetid "" ASCII 0x8004DE26 ValA_Wu8 255.0 OneToOne 0.00 255.0 NUMBER 99 /end CHARACTERISTIC
/begin CHARACTERISTIC MeUn_CrntCtlDT1.T1_C "Klasse für DT1-Stromreglerparameter/" VALUE 0x8004DEDC Kw_Ws32 4294.9672940 TimeDelay_s 0.000002000000001 4294.9672960 FORMAT "%12.7" /end CHARACTERISTIC
/begin CHARACTERISTIC MeUn_CrntCtlDT1.Kd_C "Klasse für DT1-Stromreglerparameter/" VALUE 0x8004DEE0 Kw_Ws32 65535.9999847 Kd -32768.0000000 32767.9999847 FORMAT "%13.7" /end CHARACTERISTIC
/begin CHARACTERISTIC MeUn_CrntCtlI.Ki_C "Klasse für Parameter I-Glied/" VALUE 0x8004DFB8 Kw_Ws32 244.140624943 Ki_curr2fact -122.070312500 122.070312443 FORMAT "%13.9" /end CHARACTERISTIC
/begin CHARACTERISTIC MeUn_CrntCtlI.KiPos_C "Klasse für Parameter I-Glied/" VALUE 0x8004DFBC Kw_Ws32 244.140624943 Ki_curr2fact -122.070312500 122.070312443 FORMAT "%13.9" /end CHARACTERISTIC
/begin CHARACTERISTIC MeUn_CrntCtlI.KiNeg_C "Klasse für Parameter I-Glied/" VALUE 0x8004DFC0 Kw_Ws32 244.140624943 Ki_curr2fact -122.070312500 122.070312443 FORMAT "%13.9" /end CHARACTERISTIC
/begin CHARACTERISTIC MeUn_CrntCtlI.WinPos_C "Klasse für Parameter I-Glied/" VALUE 0x8004DFC4 Kw_Ws32 4294967295.00 Curr -2147483648.00 2147483647.00 FORMAT "%13.2" /end CHARACTERISTIC
/begin CHARACTERISTIC MeUn_CrntCtlI.WinNeg_C "Klasse für Parameter I-Glied/" VALUE 0x8004DFC8 Kw_Ws32 4294967295.00 Curr -2147483648.00 2147483647.00 FORMAT "%13.2" /end CHARACTERISTIC
/begin CHARACTERISTIC MeUn_ctRot_C "maximale Anzahl Funktionsaufrufe der Rotation" VALUE 0x8004DFA0 Val_Wu8 10.00 OneToOne 0.00 10.00 EXTENDED_LIMITS 0.00 255.0 /end CHARACTERISTIC
/begin CHARACTERISTIC MeUn_facCrntCtlInit_CUR "Initialisierungsfaktor für I-Anteil des Stromreglers als Funktion der Systemtemperatur" CURVE 0x8004DFCC Cur_Xs16Ws16 2.000000 Fact 0.00 2.000000 EXTENDED_LIMITS -4.000000 3.999878
 /begin AXIS_DESCR STD_AXIS FuelT_tFlSys Temp_Cels 2 -50.14000 149.8600 EXTENDED_LIMITS -3549.940 3003.560 DEPOSIT ABSOLUTE /end AXIS_DESCR
/end CHARACTERISTIC
/begin CHARACTERISTIC MeUn_facCrntCtlMax_C "maximaler I-Anteil" VALUE 0x8004DFD6 Val_Ws16 1.000000 Fact 1.000000 2.000000 EXTENDED_LIMITS -4.000000 3.999878 /end CHARACTERISTIC
/begin CHARACTERISTIC MeUn_facCrntCtlMin_C "minimaler I-Anteil" VALUE 0x8004DFD8 Val_Ws16 0.5000000 Fact 0.5000000 1.000000 EXTENDED_LIMITS -4.000000 3.999878 /end CHARACTERISTIC
/begin CHARACTERISTIC MeUn_facRefActrTst_C "Erkennungsschwelle für den Stellertest der Zumesseinheit" VALUE 0x8004DE9C Val_Wu16 3.000000 Fact1 0.00 3.000000 EXTENDED_LIMITS 0.00 511.9922 /end CHARACTERISTIC
/begin CHARACTERISTIC MeUn_iCnvFlowRate_CUR "Kennlinie zur Umrechnung von Volumenstrom nach Strom" CURVE 0x8004DFDA Cur_Xs16Ws16 5000.000 Curr 0.00 5000.000 FORMAT "%8.3" EXTENDED_LIMITS -32768.00 32767.00
 /begin AXIS_DESCR STD_AXIS MeUn_dvolSet Qp_mm3_sec 10 -10000.00 50000.00 FORMAT "%8.2" EXTENDED_LIMITS -327680.0 327670.0 DEPOSIT ABSOLUTE /end AXIS_DESCR
/end CHARACTERISTIC
/begin CHARACTERISTIC MeUn_iLin_CUR "Analogeingang, Linearisierungskennlinie" CURVE 0x8004DEE4 Cur_Xs16Ws16 5000.000 Curr 0.00 5000.000 FORMAT "%8.3" EXTENDED_LIMITS -32768.00 32767.00
 /begin AXIS_DESCR STD_AXIS MeUn_uRaw_mp Volt 2 0.00 5200.000 EXTENDED_LIMITS -6553.600 6553.400 DEPOSIT ABSOLUTE /end AXIS_DESCR
/end CHARACTERISTIC
/begin CHARACTERISTIC MeUn_iMaxActrTst_CA "Obergrenze für den Strom der Zumesseinheit" VAL_BLK 0x8004DE9E ValA_Ws16 2000.000 Curr 0.00 2000.000 FORMAT "%8.3" EXTENDED_LIMITS -32768.00 32767.00 NUMBER 4 /end CHARACTERISTIC
/begin CHARACTERISTIC MeUn_iMinActrTst_CA "Untergrenze für den Strom der Zumesseinheit" VAL_BLK 0x8004DEA6 ValA_Ws16 2000.000 Curr 0.00 2000.000 FORMAT "%8.3" EXTENDED_LIMITS -32768.00 32767.00 NUMBER 4 /end CHARACTERISTIC
/begin CHARACTERISTIC MeUn_iSetMaxActrTst_C "Obergrenze des gewünschten Stroms für den Stellertest der Zumesseinheit" VALUE 0x8004DEAE Val_Ws16 2000.000 Curr 0.00 2000.000 FORMAT "%8.3" EXTENDED_LIMITS -32768.00 32767.00 /end CHARACTERISTIC
/begin CHARACTERISTIC MeUn_iSetMinActrTst_C "Untergrenze des gewünschten Stroms für den Stellertest der Zumesseinheit" VALUE 0x8004DEB0 Val_Ws16 2000.000 Curr 0.00 2000.000 FORMAT "%8.3" EXTENDED_LIMITS -32768.00 32767.00 /end CHARACTERISTIC
/begin CHARACTERISTIC MeUn_iSetMin_C "Sollstrom bei elektrischer Abschaltung der Zumesseinheit" VALUE 0x8004E004 Val_Ws16 65535.00 Curr -32768.00 32767.00 FORMAT "%8.2" /end CHARACTERISTIC
/begin CHARACTERISTIC MeUn_iSet_C "Fernsteuerwert des Sollstroms für die Zumesseinheit" VALUE 0x8004E006 Val_Ws16 5000.000 Curr 0.00 5000.000 FORMAT "%8.3" EXTENDED_LIMITS -32768.00 32767.00 /end CHARACTERISTIC
/begin CHARACTERISTIC MeUn_iWinActrTst_C "Toleranzfenster für den Strom der Zumesseinheit" VALUE 0x8004DEB2 Val_Ws16 1000.000 Curr 0.00 1000.000 FORMAT "%8.3" EXTENDED_LIMITS -32768.00 32767.00 /end CHARACTERISTIC
/begin CHARACTERISTIC MeUn_nDiffMaxActrTst_C "Maximale Abweichung von der Leerlaufsolldrehzahl für den Stellertest der Zumesseinheit" VALUE 0x8004DEB4 Val_Ws16 4000.000 EngN 0.00 4000.000 EXTENDED_LIMITS -16384.00 16383.50 /end CHARACTERISTIC
/begin CHARACTERISTIC MeUn_nDiffMax_C "maximale Differenz zwischen gefilterter Drehzahl für Kennlinie und aktueller Drehzahl um neuen Drehzahlwert zu übernehmen" VALUE 0x8004DEEE Val_Ws16 10000.00 EngN 0.00 10000.00 EXTENDED_LIMITS -16384.00 16383.50 /end CHARACTERISTIC
/begin CHARACTERISTIC MeUn_nSetActrTst_CA "Gewünschte Drehzahl für den Stellertest der Zumesseinheit" VAL_BLK 0x8004DEB6 ValA_Ws16 4000.000 EngN 0.00 4000.000 EXTENDED_LIMITS -16384.00 16383.50 NUMBER 4 /end CHARACTERISTIC
/begin CHARACTERISTIC MeUn_pActrPrt_C "Raildruckschwelle für die Freigabe der Stellerschutzfunktion" VALUE 0x8004E008 Val_Ws16 5276.800 Pres_Rail -3276.800 2000.000 EXTENDED_LIMITS -3276.800 3276.700 /end CHARACTERISTIC
/begin CHARACTERISTIC MeUn_pFlowOfFl_C "Raildruckschwelle zum Rückschalten auf Stellwertvorgabe der Hochdruckregelung" VALUE 0x8004E00A Val_Ws16 5276.800 Pres_Rail -3276.800 2000.000 EXTENDED_LIMITS -3276.800 3276.700 /end CHARACTERISTIC
/begin CHARACTERISTIC MeUn_pMinMeUn_C "Untergrenze des Raildrucks bei einem Fehler in der Kraftstoffzuführung" VALUE 0x8004DEBE Val_Ws16 2000.000 Pres_Rail 0.00 2000.000 EXTENDED_LIMITS -3276.800 3276.700 /end CHARACTERISTIC
/begin CHARACTERISTIC MeUn_pSetActrTst_CA "Gewünschter Druck für den Stellertest der Zumesseinheit" VAL_BLK 0x8004DEC0 ValA_Ws16 2000.000 Pres_Rail 0.00 2000.000 EXTENDED_LIMITS -3276.800 3276.700 NUMBER 4 /end CHARACTERISTIC
/begin CHARACTERISTIC MeUn_PwmOut.rMin_C "Klasse für Parameter Ausgangstastverhältnis/" VALUE 0x8004DEF0 Kw_Ws16 100.0000 DtyCyc 0.00 100.0000 EXTENDED_LIMITS -327.6800 327.6700 /end CHARACTERISTIC
/begin CHARACTERISTIC MeUn_PwmOut.rMax_C "Klasse für Parameter Ausgangstastverhältnis/" VALUE 0x8004DEF2 Kw_Ws16 100.0000 DtyCyc 0.00 100.0000 EXTENDED_LIMITS -327.6800 327.6700 /end CHARACTERISTIC
/begin CHARACTERISTIC MeUn_PwmOut.tiBtwTstSCB_C "Klasse für Parameter Ausgangstastverhältnis/" VALUE 0x8004DEF4 Kw_Ws16 1000.000 Time_ms 0.00 1000.000 EXTENDED_LIMITS -327680.0 327670.0 /end CHARACTERISTIC
/begin CHARACTERISTIC MeUn_PwmOut.tiBtwTstOT_C "Klasse für Parameter Ausgangstastverhältnis/" VALUE 0x8004DEF6 Kw_Ws16 327.6700 Time_s 0.00 327.6700 EXTENDED_LIMITS -327.6800 327.6700 /end CHARACTERISTIC
/begin CHARACTERISTIC MeUn_PwmOut.numTstMax_C "Klasse für Parameter Ausgangstastverhältnis/" VALUE 0x8004DEF8 Kw_Wu16 65535.00 OneToOne 0.00 65535.00 /end CHARACTERISTIC
/begin CHARACTERISTIC MeUn_PwmOut.swtBattCor_C "Klasse für Parameter Ausgangstastverhältnis/" VALUE 0x8004DEFA Kw_Wu8 1.000 OneToOne 0.00 1.000 EXTENDED_LIMITS 0.00 255.0 /end CHARACTERISTIC
/begin CHARACTERISTIC MeUn_PwmOut.swtPsInv_C "Klasse für Parameter Ausgangstastverhältnis/" VALUE 0x8004DEFB Kw_Wu8 255.0 OneToOne 0.00 255.0 /end CHARACTERISTIC
/begin CHARACTERISTIC MeUn_qDiffMaxActrTst_C "Maximale Mengenabweichung für den Stellertest der Zumesseinheit" VALUE 0x8004DEC8 Val_Ws16 80.00000 InjMassCyc 0.00 80.00000 EXTENDED_LIMITS -327.6800 327.6700 /end CHARACTERISTIC
/begin CHARACTERISTIC MeUn_rAccPedActrTst_C "Maximale Fahrpedalstellung für den Stellertest der Zumesseinheit" VALUE 0x8004DECA Val_Wu16 100.0000 Prc 0.00 100.0000 EXTENDED_LIMITS 0.00 799.9878 /end CHARACTERISTIC
/begin CHARACTERISTIC MeUn_resCoil_C "Widerstandswert der Spule für die Zumesseinheit" VALUE 0x8004DEFC Val_Ws16 5000.000 Resist_1 0.00 5000.000 FORMAT "%8.3" EXTENDED_LIMITS -32768.00 32767.00 /end CHARACTERISTIC
/begin CHARACTERISTIC MeUn_rLim_CUR "PWM Signalbegrenzung in Abhängigkeit der Temperatur" CURVE 0x8004DFA2 Cur_Xs16Ws16 655.3500 DtyCyc -327.6800 327.6700
 /begin AXIS_DESCR STD_AXIS FuelT_tFlSys Temp_Cels 2 -3549.940 3003.560 DEPOSIT ABSOLUTE /end AXIS_DESCR
/end CHARACTERISTIC
/begin CHARACTERISTIC MeUn_rMaxDty_C "Max-Wert, Ausgangstastverhältnis" VALUE 0x8004DEFE Val_Ws16 100.0000 DtyCyc 0.00 100.0000 EXTENDED_LIMITS -327.6800 327.6700 /end CHARACTERISTIC
/begin CHARACTERISTIC MeUn_rPerUn_C "Statuswort zur Spezifikation des Abschaltverhaltens der Endstufenfehlerdiagnose Zumesseinheit" VALUE 0x8004DF00 Val_Ws16 65535.00 OneToOne -32768.00 32767.00 /end CHARACTERISTIC
/begin CHARACTERISTIC MeUn_rPs_C "Fernsteuerwert des PWM-Signalausgangs der Zumesseinheit" VALUE 0x8004DF02 Val_Ws16 1.000000 DtyCyc 0.00 1.000000 EXTENDED_LIMITS -327.6800 327.6700 /end CHARACTERISTIC
/begin CHARACTERISTIC MeUn_rRotEnd_C "Endwert des Tastverhältnisses während der Rotation" VALUE 0x8004DFAC Val_Ws16 427.6800 DtyCyc -327.6800 100.0000 EXTENDED_LIMITS -327.6800 327.6700 /end CHARACTERISTIC
/begin CHARACTERISTIC MeUn_rRotStrt_C "Startwert des Tastverhältnisses während der Rotation" VALUE 0x8004DFAE Val_Ws16 427.6800 DtyCyc -327.6800 100.0000 EXTENDED_LIMITS -327.6800 327.6700 /end CHARACTERISTIC
/begin CHARACTERISTIC MeUn_rSetLin_CUR "Linearisierungskurve des Tastverhältnisses der Zumesseinheit" CURVE 0x8004DF04 Cur_Xs16Ws16 100.0000 DtyCyc 0.00 100.0000 EXTENDED_LIMITS -327.6800 327.6700
 /begin AXIS_DESCR STD_AXIS MeUn_rSet_mp DtyCyc 4 -327.6800 327.6700 DEPOSIT ABSOLUTE /end AXIS_DESCR
/end CHARACTERISTIC
/begin CHARACTERISTIC MeUn_SRC.uMin_C "Klasse für Vorgabewerte Analogeingang Signal Range Check/" VALUE 0x8004DF16 Kw_Ws16 5200.000 Volt 0.00 5200.000 EXTENDED_LIMITS -6553.600 6553.400 /end CHARACTERISTIC
/begin CHARACTERISTIC MeUn_SRC.uMax_C "Klasse für Vorgabewerte Analogeingang Signal Range Check/" VALUE 0x8004DF18 Kw_Ws16 5200.000 Volt 0.00 5200.000 EXTENDED_LIMITS -6553.600 6553.400 /end CHARACTERISTIC
/begin CHARACTERISTIC MeUn_stLvl_C "Invertierungsparameter der PWM Endstufe für die Zumesseinheit" VALUE 0x8004DF1A Val_Wu8 1.000 OneToOne 0.00 1.000 EXTENDED_LIMITS 0.00 255.0 /end CHARACTERISTIC
/begin CHARACTERISTIC MeUn_stPwrStgActv_C "Invertierungsparameter der PWM Endstufe" VALUE 0x8004DF1B Val_Wu8 255.0 OneToOne 0.00 255.0 /end CHARACTERISTIC
/begin CHARACTERISTIC MeUn_stPwrStgDia_C "Statuswort zur Spezifikation des Abschaltverhaltens der Endstufenfehlerdiagnose Zumesseinheit" VALUE 0x8004DF1C Val_Wu8 255.0 OneToOne 0.00 255.0 /end CHARACTERISTIC
/begin CHARACTERISTIC MeUn_stRotActv_C "Aktivierungsschalter der Rotation" VALUE 0x8004DFB0 Val_Wu8 1.000 OneToOne 0.00 1.000 EXTENDED_LIMITS 0.00 255.0 /end CHARACTERISTIC
/begin CHARACTERISTIC MeUn_swtISet_C "Schalter des Fernsteuerwerts des Sollstroms für die Zumesseinheit" VALUE 0x8004E00C Val_Wu8 1.000 OneToOne 0.00 1.000 EXTENDED_LIMITS 0.00 255.0 /end CHARACTERISTIC
/begin CHARACTERISTIC MeUn_swtRPs_C "Schalter des Fernsteuerwerts des PWM-Signalausgangs der Zumesseinheit" VALUE 0x8004DF1D Val_Wu8 1.000 OneToOne 0.00 1.000 EXTENDED_LIMITS 0.00 255.0 /end CHARACTERISTIC
/begin CHARACTERISTIC MeUn_swtZeroVolActrTst_C "Schalter zur Durchführung des Nullfürdertests" VALUE 0x8004DECC Val_Wu8 1.000 OneToOne 0.00 1.000 EXTENDED_LIMITS 0.00 255.0 /end CHARACTERISTIC
/begin CHARACTERISTIC MeUn_tClntMinActrTst_C "Minimale Motortemperatur für den Stellertest der Zumesseinheit" VALUE 0x8004DECE Val_Ws16 160.0000 Temp_Cels -40.04000 119.9600 EXTENDED_LIMITS -3549.940 3003.560 /end CHARACTERISTIC
/begin CHARACTERISTIC MeUn_tiActrTstMax_C "Maximale Testdauer für den Stellertest der Zumesseinheit" VALUE 0x8004DED0 Val_Wu32 600.000000000 Time_s 0.00 600.000000000 EXTENDED_LIMITS 0.00 42949672.9500 /end CHARACTERISTIC
/begin CHARACTERISTIC MeUn_tiCrntCtlInit_C "maximale Zeitdauer der Initialisierungsphase" VALUE 0x8004E00E Val_Ws16 327670.0 Time_ms 0.00 327670.0 EXTENDED_LIMITS -327680.0 327670.0 /end CHARACTERISTIC
/begin CHARACTERISTIC MeUn_tiDetActrTst_C "Zeitdauer für die Erkennung der Stromschwelle" VALUE 0x8004DED4 Val_Ws16 20000.00 Time_ms 0.00 20000.00 EXTENDED_LIMITS -327680.0 327670.0 /end CHARACTERISTIC
/begin CHARACTERISTIC MeUn_tiFlt1PT1_C "PT1 Filter Zeitkonstante für Strom-Istwert" VALUE 0x8004E010 Val_Ws32 4294.9672940 TimeDelay_s 0.000002000000001 4294.9672960 FORMAT "%12.7" /end CHARACTERISTIC
/begin CHARACTERISTIC MeUn_tiFlt2PT1_C "PT1 Filter Zeitkonstante für Strom-Sollwert" VALUE 0x8004E014 Val_Ws32 4294.9672940 TimeDelay_s 0.000002000000001 4294.9672960 FORMAT "%12.7" /end CHARACTERISTIC
/begin CHARACTERISTIC MeUn_tiFltPT1Init_C "PT1 Filter Zeitkonstante während Initialisierungsphase des Stromreglers" VALUE 0x8004E018 Val_Ws32 4294.9672940 TimeDelay_s 0.000002000000001 4294.9672960 FORMAT "%12.7" /end CHARACTERISTIC
/begin CHARACTERISTIC MeUn_tiPerUBattHi_C "Periodendauer der MeUn-PWM-Endstufe bei erhöhter Batteriespannung" VALUE 0x8004DF1E Val_Ws16 2.000000 Period 1.000000 3.000000 FORMAT "%8.6" EXTENDED_LIMITS -3276.800 3276.700 /end CHARACTERISTIC
/begin CHARACTERISTIC MeUn_tiPer_CUR "Kennlinie für Periodendauer der PWM-Endstufe" CURVE 0x8004DF20 Cur_Xs16Ws16 6.400000 Period 0.1000000 6.500000 FORMAT "%8.6" EXTENDED_LIMITS -3276.800 3276.700
 /begin AXIS_DESCR STD_AXIS MeUn_nDiffRef_mp EngN 30 -16384.00 16383.50 DEPOSIT ABSOLUTE /end AXIS_DESCR
/end CHARACTERISTIC
/begin CHARACTERISTIC MeUn_tiPh_C "Kennlinie für Periodendauer der PWM-Endstufe" VALUE 0x8004DF9A Val_Ws16 3276.700 Period 0.00 3276.700 FORMAT "%8.3" EXTENDED_LIMITS -3276.800 3276.700 /end CHARACTERISTIC
/begin CHARACTERISTIC MeUn_tiRmpDurActrTst_C "Rampenzeit für den gewünschten Strom für den Stellertest der Zumesseinheit" VALUE 0x8004DED6 Val_Ws16 30000.00 Time_ms 0.00 30000.00 EXTENDED_LIMITS -327680.0 327670.0 /end CHARACTERISTIC
/begin CHARACTERISTIC MeUn_tiRotDel_C "Bestromungszeit während der Rotation" VALUE 0x8004DFB2 Val_Wu16 65540.00 Time_ms 0.00 65540.00 EXTENDED_LIMITS 0.00 655350.0 /end CHARACTERISTIC
/begin CHARACTERISTIC MeUn_tiRotExt_C "Zeit zum Einfrieren der MeUn Stromreglers nach der Rotation" VALUE 0x8004DFB4 Val_Wu16 65540.00 Time_ms 0.00 65540.00 EXTENDED_LIMITS 0.00 655350.0 /end CHARACTERISTIC
/begin CHARACTERISTIC MeUn_tiRotWait_C "Pausenzeit während der Rotation" VALUE 0x8004DFB6 Val_Wu16 65540.00 Time_ms 0.00 65540.00 EXTENDED_LIMITS 0.00 655350.0 /end CHARACTERISTIC
/begin CHARACTERISTIC MeUn_tiWaitActrTst_C "Wartezeit für den Stellertest der Zumesseinheit" VALUE 0x8004DED8 Val_Ws16 500.0000 Time_s 0.00 500.0000 EXTENDED_LIMITS -327.6800 327.6700 /end CHARACTERISTIC
/begin CHARACTERISTIC MeUn_uBattHi_C "Oberer Spannungspegel, ab dem die Frequenz der MeUn auf einen anderen Wert umgeschaltet wird" VALUE 0x8004DF9C Val_Ws16 1015360. Volt_Batt -655360.0 360000.0 EXTENDED_LIMITS -655360.0 655340.0 /end CHARACTERISTIC
/begin CHARACTERISTIC MeUn_uBattLo_C "Unterer Spannungspegel, ab dem die Frequenz der MeUn auf den normalen Wert umgeschaltet wird" VALUE 0x8004DF9E Val_Ws16 1310700. Volt_Batt -655360.0 655340.0 /end CHARACTERISTIC
/begin CHARACTERISTIC MoCADC_ctDebCmp_C "Fehlerzählerendwert für Vergleich mit unabhängigem AD Wandler" VALUE 0x80020CE6 Val_Wu8 255.0 OneToOne 0.00 255.0 /end CHARACTERISTIC
/begin CHARACTERISTIC MoCADC_ctDebTst_C "Fehlerzählerendwert der Testspanunngs - Prüfung" VALUE 0x80020CE7 Val_Wu8 255.0 OneToOne 0.00 255.0 /end CHARACTERISTIC
/begin CHARACTERISTIC MoCADC_ctDebVltgRatio_C "Fehlerzählerendwert der Ratiometriekorrekturfakor Plausibilisierung" VALUE 0x80020CE8 Val_Wu8 255.0 OneToOne 0.00 255.0 /end CHARACTERISTIC
/begin CHARACTERISTIC MoCADC_ctDiagCmp_C "Zählerendwert für MoCADC_ctDiagCmp in der Diagnose" VALUE 0x80020CE9 Val_Wu8 255.0 OneToOne 0.00 255.0 /end CHARACTERISTIC
/begin CHARACTERISTIC MoCADC_ctRstCmp_C "Anzahl zulässiger Resets bei Fehler im Vergleich mit unabhängigem AD Wandler" VALUE 0x80020CEA Val_Wu8 255.0 OneToOne 0.00 255.0 /end CHARACTERISTIC
/begin CHARACTERISTIC MoCADC_ctRstTst_C "Anzahl zulässiger Resets bei Fehler in Testspanunngs - Prüfung" VALUE 0x80020CEB Val_Wu8 255.0 OneToOne 0.00 255.0 /end CHARACTERISTIC
/begin CHARACTERISTIC MoCADC_ctRstVltgRatio_C "Anzahl zulässiger Resets bei Fehler in Ratiometriekorrekturfakor Plausibilisierung" VALUE 0x80020CEC Val_Wu8 255.0 OneToOne 0.00 255.0 /end CHARACTERISTIC
/begin CHARACTERISTIC MoCADC_ctStyADC_C "Zählerendwert für Stationärerkennung für Vergleich mit unabhängigem AD Wandler" VALUE 0x80020CED Val_Wu8 255.0 OneToOne 0.00 255.0 /end CHARACTERISTIC
/begin CHARACTERISTIC MoCADC_facVltgRatioMax_C "Maximal zulässiger Wert für den Ratiometriekorrekturfaktor" VALUE 0x80020CEE Val_Wu16 63.99902 Mo_fac_q0p00098 0.00 63.99902 FORMAT "%8.5" /end CHARACTERISTIC
/begin CHARACTERISTIC MoCADC_facVltgRatioMin_C "Minimal zulässiger Wert für den Ratiometriekorrekturfaktor" VALUE 0x80020CF0 Val_Wu16 63.99902 Mo_fac_q0p00098 0.00 63.99902 FORMAT "%8.5" /end CHARACTERISTIC
/begin CHARACTERISTIC MoCADC_uMaxDiff_C "Maximal zulässige Differenz zwischen den Ergebnissen der beiden ADCs" VALUE 0x80020CF2 Val_Wu8 3287. Mo_u_mV_q12p89 0.00 3287. FORMAT "%5.0" /end CHARACTERISTIC
/begin CHARACTERISTIC MoCADC_uSty_C "Schwelle der Spannungsdifferenz für stationäre Ermittlung beim Vergleich der ADC Werte" VALUE 0x80020CF3 Val_Wu8 3287. Mo_u_mV_q12p89 0.00 3287. FORMAT "%5.0" /end CHARACTERISTIC
/begin CHARACTERISTIC MoCADC_uTstMax_C "Maximale Testspannung im ADC-Test" VALUE 0x80020CF4 Val_Ws16 319995.1 Mo_u_mV_q4p88 -160000.0 159995.1 FORMAT "%8.1" /end CHARACTERISTIC
/begin CHARACTERISTIC MoCADC_uTstMin_C "Minimale Testspannung im ADC-Test" VALUE 0x80020CF6 Val_Ws16 319995.1 Mo_u_mV_q4p88 -160000.0 159995.1 FORMAT "%8.1" /end CHARACTERISTIC
/begin CHARACTERISTIC MoCCom_ctDebErrCnt_C "Schwellwert des Zählers zum Anzeigen eines nicht plausiblen FR oder ÜM" VALUE 0x80020CF8 Val_Wu8 255.0 OneToOne 0.00 255.0 /end CHARACTERISTIC
/begin CHARACTERISTIC MoCCom_ctDebErrSPI_C "Schwellwert des Zählers zum Anzeigen eines SPI-Kommunikationsfehlers" VALUE 0x80020CF9 Val_Wu8 255.0 OneToOne 0.00 255.0 /end CHARACTERISTIC
/begin CHARACTERISTIC MoCCPU_IpoTst_CUR "Kennfeld zum Test der Interpolationsroutine im Befehlstest" CURVE 0x8002B588 Cur_Xs16Ws16 65535.00 OneToOne -32768.00 32767.00
 /begin AXIS_DESCR STD_AXIS MoCCPU_IpoIn OneToOne 20 -32768.00 32767.00 DEPOSIT ABSOLUTE /end AXIS_DESCR
/end CHARACTERISTIC
/begin CHARACTERISTIC MoCGPTA_numErr_C "Zählerendwert für die Entprellung eines SW-Resets" VALUE 0x80020CFA Val_Wu8 255.0 OneToOne 0.00 255.0 /end CHARACTERISTIC
/begin CHARACTERISTIC MoCGPTA_tiDvtMax_C "Grenzwert der Abweichung von der Zeitbasis des GPTA und der CPU" VALUE 0x80020CFC Val_Wu16 65535.00 Mo_ti_ms_q1p0 0.00 65535.00 FORMAT "%8.2" /end CHARACTERISTIC
/begin CHARACTERISTIC MoCMem_ctDebErrChkRAM_C "Fehlertoleranzschwelle für Doppelablage und zyklischen RAM-Test" VALUE 0x80020CFE Val_Wu8 255.0 OneToOne 0.00 255.0 /end CHARACTERISTIC
/begin CHARACTERISTIC MoCMem_ctDebErrChkROM_C "Fehlertoleranzschwelle für zyklischen ROM-Test" VALUE 0x80020CFF Val_Wu8 255.0 OneToOne 0.00 255.0 /end CHARACTERISTIC
/begin CHARACTERISTIC MoCMem_ctDebHealChkRAM_C "Toleranzschwelle für Heilungszähler bei Doppelablage und zyklischem RAM-Test" VALUE 0x80020D00 Val_Wu8 255.0 OneToOne 0.00 255.0 /end CHARACTERISTIC
/begin CHARACTERISTIC MoCMem_ctDebHealChkROM_C "Toleranzschwelle für Heilungszähler bei zyklischem ROM-Test" VALUE 0x80020D01 Val_Wu8 255.0 OneToOne 0.00 255.0 /end CHARACTERISTIC
/begin CHARACTERISTIC MoCPCP_numErr_C "Fehlertoleranzschwelle für CRC-Prüfsummenfehler im PCP-Code" VALUE 0x80020D02 Val_Wu8 255.0 OneToOne 0.00 255.0 /end CHARACTERISTIC
/begin CHARACTERISTIC MoCPCP_stEnaMFTst_CW "Aktivierung des Überwachungsfunktionstest für die PCP-Überwachung (PCP-Befehlstest)" VALUE 0x80020D03 Val_Wu8 255.0 OneToOne 0.00 255.0 /end CHARACTERISTIC
/begin CHARACTERISTIC MoCPCP_tiHeal_C "Toleranzschwelle für Heilungszähler bei CRC-Prüfsummenfehler im PCP-Code" VALUE 0x80020D04 Val_Wu8 10200. Mo_ti40ms_ms_q40p0 0.00 10200. FORMAT "%5.0" /end CHARACTERISTIC
/begin CHARACTERISTIC MoCRam_ChkRAMIFA9SyncTst_CW "Codewort zum Anfordern des Reaktionstests über die Anteile im ShutDown bzw. der Wiederholungsprüfung im SG-Hochlauf" VALUE 0x80020D06 Val_Wu8 255.0 OneToOne 0.00 255.0 /end CHARACTERISTIC
/begin CHARACTERISTIC MoCRam_ChkRAMIFA9Tst_CW "Codewort zum Anfordern des Reaktionstests über die Anteile im SG-Hochlauf" VALUE 0x80020D07 Val_Wu8 255.0 OneToOne 0.00 255.0 /end CHARACTERISTIC
/begin CHARACTERISTIC MoCRam_noRAMChkSD_CW "CW zur deaktivierung des kompletten RAM-Checks über Code" VALUE 0x80020D08 Val_Wu8 255.0 OneToOne 0.00 255.0 /end CHARACTERISTIC
/begin CHARACTERISTIC MoCRom_BgSwOffTst_CW "Codewort zum Anfordern des Reaktionstests im SG-Nachlauf" VALUE 0x80020D0A Val_Wu8 255.0 OneToOne 0.00 255.0 /end CHARACTERISTIC
/begin CHARACTERISTIC MoCRom_noROMChkIni_CW "CW zur deaktivierung des kompletten ROM-Checks in Ini" VALUE 0x80020D0B Val_Wu8 255.0 OneToOne 0.00 255.0 /end CHARACTERISTIC
/begin CHARACTERISTIC MoCRom_noROMCodeChkRst_CW "CW zur deaktivierung des kompletten ROM-Checks über Code" VALUE 0x80020D0C Val_Wu8 255.0 OneToOne 0.00 255.0 /end CHARACTERISTIC
/begin CHARACTERISTIC MoCRom_noROMDataChkRst_CW "CW zur Deaktivierung des kompletten ROM-Checks über Daten" VALUE 0x80020D0D Val_Wu8 255.0 OneToOne 0.00 255.0 /end CHARACTERISTIC
/begin CHARACTERISTIC MoCRom_RepExTst_CW "Codewort zum Anfordern des Reaktionstests im SG-Hochlauf" VALUE 0x80020D0E Val_Wu8 255.0 OneToOne 0.00 255.0 /end CHARACTERISTIC
/begin CHARACTERISTIC MoCSOP_ctDebHwNoRdy_C "Maximale Anzahl der Wiederholungen bis die Hardware bereit ist um den Abschaltpfadtest durchzuführen" VALUE 0x80020D10 Val_Wu8 255.0 OneToOne 0.00 255.0 /end CHARACTERISTIC
/begin CHARACTERISTIC MoCSOP_ctDebPSDia_C "Maximale Anzahl der Endstufentests" VALUE 0x80020D11 Val_Wu8 255.0 OneToOne 0.00 255.0 /end CHARACTERISTIC
/begin CHARACTERISTIC MoCSOP_ctDebSOPTst_C "Maximale Anzahl der Wiederholungen des Abschaltpfadtests (Zeitüberwachung des Abschaltpfadtests)" VALUE 0x80020D12 Val_Wu8 255.0 OneToOne 0.00 255.0 /end CHARACTERISTIC
/begin CHARACTERISTIC MoCSOP_nMinOVLth_C "Dreahzahlschwelle um die Aktivierung der Latchfunktion im CJ945 zu unterbinden" VALUE 0x80020D13 Val_Wu8 10200. Mo_n_rpm_q40p0 0.00 10200. FORMAT "%5.0" /end CHARACTERISTIC
/begin CHARACTERISTIC MoCSOP_stMMErrReac_CW "Codewort zur Aktivierung der Fehlerreaktion MM-Reset" VALUE 0x80020D14 Val_Wu8 255.0 OneToOne 0.00 255.0 /end CHARACTERISTIC
/begin CHARACTERISTIC MoCSOP_stSOPTstActv_CW "Status-Bits für Auswahl eines bestimmten Abschaltpfadtests" VALUE 0x80020D15 Val_Wu8 255.0 OneToOne 0.00 255.0 /end CHARACTERISTIC
/begin CHARACTERISTIC MoCSOP_stSWResetDem_CW "Status-Bit für Software-Reset Anforderung bei Abschaltpfadtest-Fehler" VALUE 0x80020D16 Val_Wu8 255.0 OneToOne 0.00 255.0 /end CHARACTERISTIC
/begin CHARACTERISTIC MoCSOP_swtPsvTst_C "Aktiviert die Ausführung des Abschaltpfadguttests (positiver Test). Der Test ist erfolgreich wenn eine Einspritzung abgesetzt werden kann." VALUE 0x80020D17 Val_Wu8 255.0 OneToOne 0.00 255.0 /end CHARACTERISTIC
/begin CHARACTERISTIC MoFAcs_nARSDia_C "" VALUE 0x80020D24 Val_Wu8 10200. Mo_n_rpm_q40p0 0.00 10200. FORMAT "%5.0" /end CHARACTERISTIC
/begin CHARACTERISTIC MoFAcs_rTrqARSDiaMax_C "" VALUE 0x80020D25 Val_Wu8 99.61 Mo_r_prc_q0p39 0.00 99.61 FORMAT "%5.2" /end CHARACTERISTIC
/begin CHARACTERISTIC MoFAcs_rTrqARSDiaOfs_C "" VALUE 0x80020D26 Val_Wu8 99.61 Mo_r_prc_q0p39 0.00 99.61 FORMAT "%5.2" /end CHARACTERISTIC
/begin CHARACTERISTIC MoFAcs_rTrqARSMax_CUR "" CURVE 0x80020D28 Cur_Xs16Ws16 25599.61 Mo_r_prc_q0p39 -12800.00 12799.61 FORMAT "%8.2"
 /begin AXIS_DESCR STD_AXIS MoFVSS_v Mo_v_kmh_q0p01 4 -327.6800 327.6700 FORMAT "%8.4" DEPOSIT ABSOLUTE /end AXIS_DESCR
/end CHARACTERISTIC
/begin CHARACTERISTIC MoFAcs_rTrqStaPmp_C "zulässiges Moment der Lenkhilfepumpe" VALUE 0x80020D3A Val_Wu8 99.61 Mo_r_prc_q0p39 0.00 99.61 FORMAT "%5.2" /end CHARACTERISTIC
/begin CHARACTERISTIC MoFAcs_swtTrqLos_C "" VALUE 0x80020D3B Val_Wu8 255.0 OneToOne 0.00 255.0 /end CHARACTERISTIC
/begin CHARACTERISTIC MoFAcs_trqACMax_C "" VALUE 0x80020D3C Val_Ws16 6553.500 Mo_trq_nm_q0p1 -3276.800 3276.700 FORMAT "%8.3" /end CHARACTERISTIC
/begin CHARACTERISTIC MoFAcs_trqAltMax_C "Begrenzungsmoment für die Lichtmaschinenmomentenkompensation im Monitoring" VALUE 0x80020D3E Val_Ws16 6553.500 Mo_trq_nm_q0p1 -3276.800 3276.700 FORMAT "%8.3" /end CHARACTERISTIC
/begin CHARACTERISTIC MoFAcs_trqLosTra_C "maximal zulässiges Getriebemoment für die Nebenaggregatskompensation" VALUE 0x80020D40 Val_Ws16 6553.500 Mo_trq_nm_q0p1 -3276.800 3276.700 FORMAT "%8.3" /end CHARACTERISTIC
/begin CHARACTERISTIC MoFAcs_vARSDia_C "" VALUE 0x80020D42 Val_Ws16 655.3500 Mo_v_kmh_q0p01 -327.6800 327.6700 FORMAT "%8.4" /end CHARACTERISTIC
/begin CHARACTERISTIC MoFAPP_ctDeb_C "Fehlerzeit bei zueinander unplausiblen Fahrpedalsignalen in der Überwachung" VALUE 0x80020D18 Val_Wu8 10200. Mo_ti40ms_ms_q40p0 0.00 10200. FORMAT "%5.0" /end CHARACTERISTIC
/begin CHARACTERISTIC MoFAPP_ctRst_C "Anzahl der Resets vor Anforderung der Einspritzmengenbegrenzung (EMB)" VALUE 0x80020D19 Val_Wu8 255.0 OneToOne 0.00 255.0 /end CHARACTERISTIC
/begin CHARACTERISTIC MoFAPP_uFL_C "Vollgas- Sollwert- Schwelle" VALUE 0x80020D1A Val_Wu8 4980. Mo_u_mV_q19p53 0.00 4980. FORMAT "%5.0" /end CHARACTERISTIC
/begin CHARACTERISTIC MoFAPP_uLoLim_C "Untere Spannungsschwelle für Fahrpedalplausibilisierung" VALUE 0x80020D1B Val_Wu8 4980. Mo_u_mV_q19p53 0.00 4980. FORMAT "%5.0" /end CHARACTERISTIC
/begin CHARACTERISTIC MoFAPP_uMaxDiffFL_C "Maximal zulässige Differenz zwischen den Fahrpedalsignalen oberhalb Volllastschwelle" VALUE 0x80020D1C Val_Wu8 4980. Mo_u_mV_q19p53 0.00 4980. FORMAT "%5.0" /end CHARACTERISTIC
/begin CHARACTERISTIC MoFAPP_uMaxDiffPL_C "Maximal zulässige Differenz zwischen den Fahrpedalsignalen unterhalb Volllastschwelle" VALUE 0x80020D1D Val_Wu8 4980. Mo_u_mV_q19p53 0.00 4980. FORMAT "%5.0" /end CHARACTERISTIC
/begin CHARACTERISTIC MoFASD_tiT1_C "PT1 Filterzeitkonstante in der Ruckeldämpferüberwachung" VALUE 0x80020D1E Val_Wu16 5080.0000000 Mo_tiRec40ms_ms_b10240 40.000000000 5120.0000000 FORMAT "%12.7" EXTENDED_LIMITS 0.15625238422 10240.000000 /end CHARACTERISTIC
/begin CHARACTERISTIC MoFASD_trqFltMax_C "Maximaler Stellbereich der gefilterten Ruckeldämpferstellgröße in der Überwachung" VALUE 0x80020D20 Val_Ws16 120.0000 Mo_trq_nm_q0p1 0.00 120.0000 FORMAT "%8.4" EXTENDED_LIMITS -3276.800 3276.700 /end CHARACTERISTIC
/begin CHARACTERISTIC MoFASD_trqMax_C "Maximaler Stellbereich der Ruckeldämpferstellgröße in der Überwachung" VALUE 0x80020D22 Val_Ws16 120.0000 Mo_trq_nm_q0p1 0.00 120.0000 FORMAT "%8.4" EXTENDED_LIMITS -3276.800 3276.700 /end CHARACTERISTIC
/begin CHARACTERISTIC MoFCCtl_ctShOffRmpDeb_C "Schwelle für die Fertigstellung der Abschaltrampe auf Level 1" VALUE 0x80020D44 Val_Wu8 2550. Mo_ti10ms_ms_q10p0 0.00 2550. FORMAT "%5.0" /end CHARACTERISTIC
/begin CHARACTERISTIC MoFClth_ctDeb_C "Entprellzählerschwelle zum Kupplungszustand" VALUE 0x80020D45 Val_Wu8 255.0 OneToOne 0.00 255.0 /end CHARACTERISTIC
/begin CHARACTERISTIC MoFCoEng_ctMaxInt_C "Applikationsparameter für die maximale Eingriffsdauer des LAD" VALUE 0x80020D46 Val_Wu8 255.0 OneToOne 0.00 255.0 /end CHARACTERISTIC
/begin CHARACTERISTIC MoFCoEng_rTrqLosAdapErr_C "Moment im Fehlerfall für die Verlustmomentenadaption" VALUE 0x80020D47 Val_Wu8 99.61 Mo_r_prc_q0p39 0.00 99.61 FORMAT "%5.2" /end CHARACTERISTIC
/begin CHARACTERISTIC MoFCoEng_rTrqLosAdapMax_C "Maximal zulässiges adaptiertes Moment" VALUE 0x80020D48 Val_Wu8 99.61 Mo_r_prc_q0p39 0.00 99.61 FORMAT "%5.2" /end CHARACTERISTIC
/begin CHARACTERISTIC MoFCoEng_rTrqLosOfs_C "Wert des Offsets für die LAD Verlustmomenten Berechnung" VALUE 0x80020D49 Val_Wu8 99.61 Mo_r_prc_q0p39 0.00 99.61 FORMAT "%5.2" /end CHARACTERISTIC
/begin CHARACTERISTIC MoFCoEng_rTrqLos_MAP "Kennfeld der Verlustmomente für LAD" MAP 0x80020D4A Map_Xu8Yu8Wu8 99.61 Mo_r_prc_q0p39 0.00 99.61 FORMAT "%5.2"
 /begin AXIS_DESCR STD_AXIS MoFESpd_nEng Mo_n_rpm_q40p0 8 0.00 10200. FORMAT "%5.0" DEPOSIT ABSOLUTE /end AXIS_DESCR
 /begin AXIS_DESCR STD_AXIS MoFTEng_tEng Mo_t_DegC_q0p8o48 8 -48.00 156.0 FORMAT "%5.1" DEPOSIT ABSOLUTE /end AXIS_DESCR
/end CHARACTERISTIC
/begin CHARACTERISTIC MoFCoEng_rTrqMaxDiffAdap_C "Maximale Abweichung der Differenz von Ebene1 und Ebene2 Wert für Plausibilisierung" VALUE 0x80020D9C Val_Wu8 99.61 Mo_r_prc_q0p39 0.00 99.61 FORMAT "%5.2" /end CHARACTERISTIC
/begin CHARACTERISTIC MoFCoEng_swtLosCalc_C "Schalter für Verlustmomenten-Berechnung aus MAP+Offset oder MAP+Offset+adapt.Verlustmoment" VALUE 0x80020D9D Val_Wu8 255.0 OneToOne 0.00 255.0 /end CHARACTERISTIC
/begin CHARACTERISTIC MoFCoEng_tiT1_C "PT1 Zeitkonstante für negative Momentensprünge des zulässigen Moments" VALUE 0x80020D9E Val_Wu8 5038.73 Mo_tiRec40ms_ms_b10240 81.2698 5120.00 FORMAT "%7.2" EXTENDED_LIMITS 40.1569 10240.0 /end CHARACTERISTIC
/begin CHARACTERISTIC MoFCoOfs_rTrqPtdOfs_MAP "Kennfeld Ebene 2 Offset" MAP 0x80020DA0 Map_Xu8Yu8Wu8 99.61 Mo_r_prc_q0p39 0.00 99.61 FORMAT "%5.2"
 /begin AXIS_DESCR STD_AXIS MoFCoOfs_rTrqPtd_mp Mo_r_prc_q0p39 8 0.00 99.61 FORMAT "%5.2" DEPOSIT ABSOLUTE /end AXIS_DESCR
 /begin AXIS_DESCR STD_AXIS MoFESpd_nEng Mo_n_rpm_q40p0 8 0.00 10200. FORMAT "%5.0" DEPOSIT ABSOLUTE /end AXIS_DESCR
/end CHARACTERISTIC
/begin CHARACTERISTIC MoFCoOfs_tiDel_C "Totzeit der Offsetberechnung in der Überwachung" VALUE 0x80020DF2 Val_Wu8 280.0 Mo_ti40ms_ms_q40p0 40.00 320.0 FORMAT "%5.1" EXTENDED_LIMITS 0.00 10200. /end CHARACTERISTIC
/begin CHARACTERISTIC MoFCoOfs_tiT1_C "Zeitkonstante PT1 Filter" VALUE 0x80020DF4 Val_Wu16 2008.0000000 Mo_tiRec40ms_ms_b10240 40.000000000 2048.0000000 FORMAT "%12.7" EXTENDED_LIMITS 0.15625238422 10240.000000 /end CHARACTERISTIC
/begin CHARACTERISTIC MoFCoVeh_facTrqComp_MAP "drehzahl- und fahrerwunschabhängiger Faktor für Verlustmomentkompensation" MAP 0x80020DF6 Map_Xs16Ys16Ws16 25599.61 Mo_r_prc_q0p39 -12800.00 12799.61 FORMAT "%8.2"
 /begin AXIS_DESCR STD_AXIS MoFESpd_nEng Mo_n_rpm_q40p0 6 0.00 10200. FORMAT "%5.0" DEPOSIT ABSOLUTE /end AXIS_DESCR
 /begin AXIS_DESCR STD_AXIS MoFCoVeh_trqVMD_mp Mo_trq_nm_q1p6 6 -52428.80 52427.20 FORMAT "%8.2" DEPOSIT ABSOLUTE /end AXIS_DESCR
/end CHARACTERISTIC
/begin CHARACTERISTIC MoFDrAs_ctDebACC_C "Zählwert für TurnOnDelay ACC" VALUE 0x80020E5A Val_Wu8 255.0 OneToOne 0.00 255.0 /end CHARACTERISTIC
/begin CHARACTERISTIC MoFDrAs_ctDebCCtl_C "Entprellzeit für betätigte Bremse in der Funktionsüberwachung" VALUE 0x80020E5B Val_Wu8 255.0 OneToOne 0.00 255.0 /end CHARACTERISTIC
/begin CHARACTERISTIC MoFDrAs_swtFGRACCPlaOff_C "" VALUE 0x80020E5C Val_Wu8 255.0 OneToOne 0.00 255.0 /end CHARACTERISTIC
/begin CHARACTERISTIC MoFDrAs_vACCMin_C "Vergleichswert Mindestgeschwindigkeit ACC" VALUE 0x80020E5E Val_Wu16 655.3500 Mo_v_kmh_q0p01 0.00 655.3500 FORMAT "%8.4" /end CHARACTERISTIC
/begin CHARACTERISTIC MoFDrAs_vCCtlMin_C "Vergleichswert Mindestgeschwindigkeit FGR" VALUE 0x80020E60 Val_Wu16 655.3500 Mo_v_kmh_q0p01 0.00 655.3500 FORMAT "%8.4" /end CHARACTERISTIC
/begin CHARACTERISTIC MoFDrDem_rThreshPrpMin_C "Rampenbeginn bei Verlustmomentberechnung" VALUE 0x80020E62 Val_Wu8 99.61 Mo_r_prc_q0p39 0.00 99.61 FORMAT "%5.2" /end CHARACTERISTIC
/begin CHARACTERISTIC MoFDrDem_rThreshPrp_C "Rampenende bei Verlustmomentberechnung" VALUE 0x80020E63 Val_Wu8 99.61 Mo_r_prc_q0p39 0.00 99.61 FORMAT "%5.2" /end CHARACTERISTIC
/begin CHARACTERISTIC MoFDrDem_rTrqEng_MAP "Fahrpedalkennfeld der Überwachungsfunktionen" MAP 0x80020E64 Map_Xu8Yu8Wu8 99.61 Mo_r_prc_q0p39 0.00 99.61 FORMAT "%5.2"
 /begin AXIS_DESCR STD_AXIS MoFESpd_nEng Mo_n_rpm_q40p0 8 0.00 10200. FORMAT "%5.0" DEPOSIT ABSOLUTE /end AXIS_DESCR
 /begin AXIS_DESCR STD_AXIS MoFDrDem_rAPP Mo_r_prc_q0p39 8 0.00 99.61 FORMAT "%5.2" DEPOSIT ABSOLUTE /end AXIS_DESCR
/end CHARACTERISTIC
/begin CHARACTERISTIC MoFDrDem_rTrqPTMax_C "maximale Triebstrangübersetzung" VALUE 0x80020EB6 Val_Wu16 655.3500 Mo_fac_q0p01 0.00 655.3500 FORMAT "%8.4" /end CHARACTERISTIC
/begin CHARACTERISTIC MoFDrDem_rTrqPTMin_C "minimale Triebstrangübersetzung" VALUE 0x80020EB8 Val_Wu16 655.3500 Mo_fac_q0p01 0.00 655.3500 FORMAT "%8.4" /end CHARACTERISTIC
/begin CHARACTERISTIC MoFDrDem_stTrqClth_C "" VALUE 0x80020EBA Val_Wu8 255.0 OneToOne 0.00 255.0 /end CHARACTERISTIC
/begin CHARACTERISTIC MoFDrDem_swtAcs_C "" VALUE 0x80020EBB Val_Wu8 255.0 OneToOne 0.00 255.0 /end CHARACTERISTIC
/begin CHARACTERISTIC MoFDrDem_trqSpd_MAP "" MAP 0x80020EBC Map_Xs16Ys16Ws16 6553.500 Mo_trq_nm_q0p1 -3276.800 3276.700 FORMAT "%8.3"
 /begin AXIS_DESCR STD_AXIS MoFESpd_nEng Mo_n_rpm_q40p0 12 0.00 10200. FORMAT "%5.0" DEPOSIT ABSOLUTE /end AXIS_DESCR
 /begin AXIS_DESCR STD_AXIS MoFDrDem_stTrqClth OneToOne 8 0.00 255.0 DEPOSIT ABSOLUTE /end AXIS_DESCR
/end CHARACTERISTIC
/begin CHARACTERISTIC MoFDrDem_uAPPMax_C "obere Spannungsgrenze für das Fahrpedalsignal in der Überwachung" VALUE 0x80020FA8 Val_Wu8 4980. Mo_u_mV_q19p53 0.00 4980. FORMAT "%5.0" /end CHARACTERISTIC
/begin CHARACTERISTIC MoFDrDem_uAPPMin_C "untere Spannungsgrenze für das Fahrpedalsignal in der Überwachung" VALUE 0x80020FA9 Val_Wu8 4980. Mo_u_mV_q19p53 0.00 4980. FORMAT "%5.0" /end CHARACTERISTIC
/begin CHARACTERISTIC MoFESpd_ctDeb_C "Fehlerzählerendwert für Motordrehzahlvergleich in der Funktionsüberwachung" VALUE 0x80020FAA Val_Wu8 255.0 OneToOne 0.00 255.0 /end CHARACTERISTIC
/begin CHARACTERISTIC MoFESpd_ctRst_C "Anzahl zulässiger Resets bei Fehler im Motordrehzahlvergleich" VALUE 0x80020FAB Val_Wu8 255.0 OneToOne 0.00 255.0 /end CHARACTERISTIC
/begin CHARACTERISTIC MoFESpd_nDiffMax_C "Erlaubte Differenz zwischen berechneten Drehzahlen in Ebene 1 und Ebene 2" VALUE 0x80020FAC Val_Ws16 2621400. Mo_n_rpm_q40p0 -1310720. 1310680. FORMAT "%8.0" /end CHARACTERISTIC
/begin CHARACTERISTIC MoFESpd_nMin_C "Minimale Drehzahl in der Motordrehzahl-Überwachung" VALUE 0x80020FAE Val_Wu8 10200. Mo_n_rpm_q40p0 0.00 10200. FORMAT "%5.0" /end CHARACTERISTIC
/begin CHARACTERISTIC MoFETC_ctTst_C "Maximaldauer des Motortests in der Funktionsüberwachung" VALUE 0x80020FB0 Val_Wu32 42949672.9500 Mo_ti_s_q0p01 0.00 42949672.9500 FORMAT "%13.4" /end CHARACTERISTIC
/begin CHARACTERISTIC MoFETC_swtInactvTO_C "Deaktivierungslabel für Timeoutüberprüfung" VALUE 0x80020FB4 Val_Wu8 255.0 OneToOne 0.00 255.0 /end CHARACTERISTIC
/begin CHARACTERISTIC MoFETC_TstCurRun_C "Test label zur Motortest-Simulation" VALUE 0x80020FB5 Val_Wu8 255.0 OneToOne 0.00 255.0 /end CHARACTERISTIC
/begin CHARACTERISTIC MoFExtInt_ctDebDCSMax_C "Maximalwert des Entprellzählers für die Verlängerung des MSR Eingriffs, bis der Eingriff aus Ebene 1 gerampt wird" VALUE 0x80020FB8 Val_Wu8 255.0 OneToOne 0.00 255.0 /end CHARACTERISTIC
/begin CHARACTERISTIC MoFExtInt_ctDebTSCMax_C "Maxwert des Entprellzählers für Verlängerung des Getriebeeingriffs, bis der Eingriff in der Ebene 1 ausgerampt worden ist" VALUE 0x80020FB9 Val_Wu8 255.0 OneToOne 0.00 255.0 /end CHARACTERISTIC
/begin CHARACTERISTIC MoFExtInt_st_C "Auswahl der Momentenebene der Eingangsmomente (indiziert/Kupplung)" VALUE 0x80020FBA Val_Wu8 255.0 OneToOne 0.00 255.0 /end CHARACTERISTIC
/begin CHARACTERISTIC MoFICO_ctDeb_C "Endwert für Entprellzähler der Fehlerreaktionsüberwachung" VALUE 0x80020FBC Val_Wu8 255.0 OneToOne 0.00 255.0 /end CHARACTERISTIC
/begin CHARACTERISTIC MoFICO_nCtOff_C "Maximal zulässige Motordrehzahl für Einspritzungen bei Einspritzmengenbegrenzung (EMB)" VALUE 0x80020FBD Val_Wu8 10200. Mo_n_rpm_q40p0 0.00 10200. FORMAT "%5.0" /end CHARACTERISTIC
/begin CHARACTERISTIC MoFInjDat_ctDebPhiErr_C "Fehlerzählerendwert Ansteuerbeginnwinkel der Ebene 1 unplausibel in der Funktionsüberwachung" VALUE 0x80020FBE Val_Wu8 255.0 OneToOne 0.00 255.0 /end CHARACTERISTIC
/begin CHARACTERISTIC MoFInjDat_ctDebQntErr_C "Fehlerzählerendwert Menge der Ebene 1 unplausibel in der Funktionsüberwachung" VALUE 0x80020FBF Val_Wu8 255.0 OneToOne 0.00 255.0 /end CHARACTERISTIC
/begin CHARACTERISTIC MoFInjDat_ctDiagPhi_C "Zählerendwert für MoFInjDat_ctDiagPhi in der Diagnose" VALUE 0x8004E03C Val_Wu8 255.0 OneToOne 0.00 255.0 /end CHARACTERISTIC
/begin CHARACTERISTIC MoFInjDat_ctDiagQnt_C "Zählerendwert für MoFInjDat_ctDiagQnt in der Diagnose" VALUE 0x8004E03D Val_Wu8 255.0 OneToOne 0.00 255.0 /end CHARACTERISTIC
/begin CHARACTERISTIC MoFInjDat_ctRst_C "Anzahl der Resets vor Anforderung der Einspritzmengenbegrenzung (EMB)" VALUE 0x80020FC0 Val_Wu8 255.0 OneToOne 0.00 255.0 /end CHARACTERISTIC
/begin CHARACTERISTIC MoFInjDat_facInjEff_MAP "Momentenwirksamkeits-Faktor-Kennfeld der Schubüberwachung" MAP 0x8004E03E Map_Xs16Ys16Ws16 7.999878 Mo_fac_q0p000122 -4.000000 3.999878 FORMAT "%8.6"
 /begin AXIS_DESCR STD_AXIS Epm_nEng EngN 6 -16384.00 16383.50 DEPOSIT ABSOLUTE /end AXIS_DESCR
 /begin AXIS_DESCR STD_AXIS MoFInjDat_phiInjAct_mp Mo_phi_degCrS_q0p02197 4 -720.0439 720.0220 FORMAT "%8.4" DEPOSIT ABSOLUTE /end AXIS_DESCR
/end CHARACTERISTIC
/begin CHARACTERISTIC MoFInjDat_nNumRevCs1Max_C "Maximaldrehzahl zur Mittelung über 1 Nockenwellenumdrehung" VALUE 0x80020FC1 Val_Wu8 10200. Mo_n_rpm_q40p0 0.00 10200. FORMAT "%5.0" /end CHARACTERISTIC
/begin CHARACTERISTIC MoFInjDat_nNumRevCs2Max_C "Maximaldrehzahl zur Mittelung über 2 Nockenwellenumdrehungen" VALUE 0x80020FC2 Val_Wu8 10200. Mo_n_rpm_q40p0 0.00 10200. FORMAT "%5.0" /end CHARACTERISTIC
/begin CHARACTERISTIC MoFInjDat_nNumRevCs2Min_C "Minimaldrehzahl zur Mittelung über 2 Nockenwellenumdrehungen" VALUE 0x80020FC3 Val_Wu8 10200. Mo_n_rpm_q40p0 0.00 10200. FORMAT "%5.0" /end CHARACTERISTIC
/begin CHARACTERISTIC MoFInjDat_nNumRevCs3Min_C "Minimaldrehzahl zur Mittelung über 3 Nockenwellenumdrehungen" VALUE 0x80020FC4 Val_Wu8 10200. Mo_n_rpm_q40p0 0.00 10200. FORMAT "%5.0" /end CHARACTERISTIC
/begin CHARACTERISTIC MoFInjDat_nThresAgPlaus_C "Schwelle der Motordrehzahl für den Injektion Winkel Glaubwürdigkeit Scheck" VALUE 0x80020FC6 Val_Ws16 32767.50 Mo_n_rpm_q0p5 -16384.00 16383.50 FORMAT "%8.2" /end CHARACTERISTIC
/begin CHARACTERISTIC MoFInjDat_nThreshQntErr_C "Drehzahl-Schwelle zur Plausibilisierung der Ebene 1- Menge in der Funktionsüberwachung" VALUE 0x80020FC8 Val_Wu8 10200. Mo_n_rpm_q40p0 0.00 10200. FORMAT "%5.0" /end CHARACTERISTIC
/begin CHARACTERISTIC MoFInjDat_numCyl_C "Zylinderanzahl in der Funktionsüberwachung" VALUE 0x80020FC9 Val_Wu8 255.0 OneToOne 0.00 255.0 /end CHARACTERISTIC
/begin CHARACTERISTIC MoFInjDat_phiMI1BkupMax_C "Maximal plausibler Ansteuerbeginnwinkel Haupteinspritzung 1 bei Notfahren Kurbelwelle" VALUE 0x80020FCA Val_Ws16 1440.066 Mo_phi_degCrS_q0p02197 -720.0439 720.0220 FORMAT "%8.4" /end CHARACTERISTIC
/begin CHARACTERISTIC MoFInjDat_phiMI1BkupMin_C "Minimal plausibler Ansteuerbeginnwinkel Haupteinspritzung 1 bei Notfahren Kurbelwelle" VALUE 0x80020FCC Val_Ws16 1440.066 Mo_phi_degCrS_q0p02197 -720.0439 720.0220 FORMAT "%8.4" /end CHARACTERISTIC
/begin CHARACTERISTIC MoFInjDat_phiMI1Max_C "Maximal plausibler Ansteuerbeginnwinkel MI1" VALUE 0x80020FCE Val_Ws16 1440.066 Mo_phi_degCrS_q0p02197 -720.0439 720.0220 FORMAT "%8.4" /end CHARACTERISTIC
/begin CHARACTERISTIC MoFInjDat_phiMI1Min_C "Minimal plausibler Ansteuerbeginnwinkel MI1" VALUE 0x80020FD0 Val_Ws16 1440.066 Mo_phi_degCrS_q0p02197 -720.0439 720.0220 FORMAT "%8.4" /end CHARACTERISTIC
/begin CHARACTERISTIC MoFInjDat_phiPiIBkupMax_C "Maximal plausibler Ansteuerbeginnwinkel Voreinspritzung 1 bei Notfahren Kurbelwelle" VALUE 0x80020FD2 Val_Ws16 1440.066 Mo_phi_degCrS_q0p02197 -720.0439 720.0220 FORMAT "%8.4" /end CHARACTERISTIC
/begin CHARACTERISTIC MoFInjDat_phiPiIBkupMin_C "Minimal plausibler Ansteuerbeginnwinkel Voreinspritzung 1 bei Notfahren Kurbelwelle" VALUE 0x80020FD4 Val_Ws16 1440.066 Mo_phi_degCrS_q0p02197 -720.0439 720.0220 FORMAT "%8.4" /end CHARACTERISTIC
/begin CHARACTERISTIC MoFInjDat_phiPiIMax_C "Maximal plausibler Ansteuerbeginnwinkel PiI" VALUE 0x80020FD6 Val_Ws16 1440.066 Mo_phi_degCrS_q0p02197 -720.0439 720.0220 FORMAT "%8.4" /end CHARACTERISTIC
/begin CHARACTERISTIC MoFInjDat_phiPiIMin_C "Minimal plausibler Ansteuerbeginnwinkel PiI" VALUE 0x80020FD8 Val_Ws16 1440.066 Mo_phi_degCrS_q0p02197 -720.0439 720.0220 FORMAT "%8.4" /end CHARACTERISTIC
/begin CHARACTERISTIC MoFInjDat_phiPoI1BkupMax_C "Maximal plausibler Ansteuerbeginnwinkel Nacheinspritzung 1 bei Notfahren Kurbelwelle" VALUE 0x80020FDA Val_Ws16 1440.066 Mo_phi_degCrS_q0p02197 -720.0439 720.0220 FORMAT "%8.4" /end CHARACTERISTIC
/begin CHARACTERISTIC MoFInjDat_phiPoI1BkupMin_C "Minimal plausibler Ansteuerbeginnwinkel Nacheinspritzung 1 bei Notfahren Kurbelwelle" VALUE 0x80020FDC Val_Ws16 1440.066 Mo_phi_degCrS_q0p02197 -720.0439 720.0220 FORMAT "%8.4" /end CHARACTERISTIC
/begin CHARACTERISTIC MoFInjDat_phiPoI1Max_C "Maximal plausibler Ansteuerbeginnwinkel PoI1" VALUE 0x80020FDE Val_Ws16 1440.066 Mo_phi_degCrS_q0p02197 -720.0439 720.0220 FORMAT "%8.4" /end CHARACTERISTIC
/begin CHARACTERISTIC MoFInjDat_phiPoI1Min_C "Minimal plausibler Ansteuerbeginnwinkel PoI1" VALUE 0x80020FE0 Val_Ws16 1440.066 Mo_phi_degCrS_q0p02197 -720.0439 720.0220 FORMAT "%8.4" /end CHARACTERISTIC
/begin CHARACTERISTIC MoFInjDat_phiPoI2BkupMax_C "Maximal plausibler Ansteuerbeginnwinkel Nacheinspritzung 2 bei Notfahren Kurbelwelle" VALUE 0x80020FE2 Val_Ws16 1440.066 Mo_phi_degCrS_q0p02197 -720.0439 720.0220 FORMAT "%8.4" /end CHARACTERISTIC
/begin CHARACTERISTIC MoFInjDat_phiPoI2BkupMin_C "Minimal plausibler Ansteuerbeginnwinkel Nacheinspritzung 2 bei Notfahren Kurbelwelle" VALUE 0x80020FE4 Val_Ws16 1440.066 Mo_phi_degCrS_q0p02197 -720.0439 720.0220 FORMAT "%8.4" /end CHARACTERISTIC
/begin CHARACTERISTIC MoFInjDat_phiPoI2Max_C "Maximal plausibler Ansteuerbeginnwinkel PoI2" VALUE 0x80020FE6 Val_Ws16 1440.066 Mo_phi_degCrS_q0p02197 -720.0439 720.0220 FORMAT "%8.4" /end CHARACTERISTIC
/begin CHARACTERISTIC MoFInjDat_phiPoI2Min_C "Minimal plausibler Ansteuerbeginnwinkel PoI2" VALUE 0x80020FE8 Val_Ws16 1440.066 Mo_phi_degCrS_q0p02197 -720.0439 720.0220 FORMAT "%8.4" /end CHARACTERISTIC
/begin CHARACTERISTIC MoFInjDat_pLin_CUR "Linearisierungskennlinie für Raildrucksensor in der Funktionsüberwachung" CURVE 0x80020FEA Cur_Xu8Wu8 2000.000 Mo_p_bar_q8p0000 0.00 2000.000 EXTENDED_LIMITS 0.00 2040.000
 /begin AXIS_DESCR STD_AXIS MoFInjDat_uRaw_mp Mo_u_mV_q19p53 2 0.00 4980. FORMAT "%5.0" DEPOSIT ABSOLUTE /end AXIS_DESCR
/end CHARACTERISTIC
/begin CHARACTERISTIC MoFInjDat_pThreshQntErr_C "Druck-Schwelle zur Plausibilisierung der Ebene 1- Menge in der Funktionsüberwachung" VALUE 0x80020FEF Val_Wu8 2000.000 Mo_p_bar_q8p0000 0.00 2000.000 EXTENDED_LIMITS 0.00 2040.000 /end CHARACTERISTIC
/begin CHARACTERISTIC MoFInjDat_qThreshQntErr_C "Mengen-Schwelle zur Plausibilisierung der Ebene 1- Menge in der Funktionsüberwachung" VALUE 0x80020FF0 Val_Ws16 655.3500 Mo_q_mg_q0p01 -327.6800 327.6700 FORMAT "%8.4" /end CHARACTERISTIC
/begin CHARACTERISTIC MoFInjDat_swtGradActv_C "Schalter, ob in Abhängigkeit von MoFRailP_stGradErr die Bildung des Summenwertes MoFInjDat_pSum duchgeführt werden soll" VALUE 0x80020FF2 Val_Wu8 255.0 OneToOne 0.00 255.0 /end CHARACTERISTIC
/begin CHARACTERISTIC MoFInjDat_uSRCMax_C "Obergrenze für Signal Range Check von MoFInjDat_uRaw_mp" VALUE 0x80020FF3 Val_Wu8 4980. Mo_u_mV_q19p53 0.00 4980. FORMAT "%5.0" /end CHARACTERISTIC
/begin CHARACTERISTIC MoFInjDat_uSRCMin_C "Untergrenze für Signal Range Check von MoFInjDat_uRaw_mp" VALUE 0x80020FF4 Val_Wu8 4980. Mo_u_mV_q19p53 0.00 4980. FORMAT "%5.0" /end CHARACTERISTIC
/begin CHARACTERISTIC MoFInjQnt_ctDebErr_C "Fehlerzählerschwellwert in MoFInjQnt in der Funktionsüberwachung" VALUE 0x80020FF6 Val_Wu8 255.0 OneToOne 0.00 255.0 /end CHARACTERISTIC
/begin CHARACTERISTIC MoFInjQnt_ctRst_C "Anzahl der Resets vor Anforderung der Einspritzmengenbegrenzung (EMB)" VALUE 0x80020FF7 Val_Wu8 255.0 OneToOne 0.00 255.0 /end CHARACTERISTIC
/begin CHARACTERISTIC MoFInjQnt_rhoFl_C "Kraftstoffdichte in der Funktionsüberwachung" VALUE 0x80020FF8 Val_Wu8 25.50 Mo_rho_mgpmm3_q0p1 0.00 25.50 FORMAT "%5.2" /end CHARACTERISTIC
/begin CHARACTERISTIC MoFInjQnt_stQntAdj_MAP "Statuskennfeld Injektormengenabgleich in der Funktionsüberwachung" MAP 0x80020FFA Map_Xs16Ys16Ws16 65535.00 OneToOne -32768.00 32767.00
 /begin AXIS_DESCR STD_AXIS MoFInjDat_p Mo_p_bar_q8p0000 7 0.00 2000.000 EXTENDED_LIMITS 0.00 2040.000 DEPOSIT ABSOLUTE /end AXIS_DESCR
 /begin AXIS_DESCR STD_AXIS MoFInjQnt_volMI1UnCor_mp Mo_vol_mm3_q0p01 8 -327.6800 327.6700 FORMAT "%8.4" DEPOSIT ABSOLUTE /end AXIS_DESCR
/end CHARACTERISTIC
/begin CHARACTERISTIC MoFInjQnt_tiPiIZFCETMax_CUR "" CURVE 0x8002108C Cur_Xs16Ws16 26214.00 Mo_ti_us_q0p4 -13107.20 13106.80 FORMAT "%8.2"
 /begin AXIS_DESCR STD_AXIS MoFInjDat_p Mo_p_bar_q8p0000 6 0.00 2000.000 EXTENDED_LIMITS 0.00 2040.000 DEPOSIT ABSOLUTE /end AXIS_DESCR
/end CHARACTERISTIC
/begin CHARACTERISTIC MoFInjQnt_tiPiIZFCETMin_CUR "" CURVE 0x800210A6 Cur_Xs16Ws16 26214.00 Mo_ti_us_q0p4 -13107.20 13106.80 FORMAT "%8.2"
 /begin AXIS_DESCR STD_AXIS MoFInjDat_p Mo_p_bar_q8p0000 6 0.00 2000.000 EXTENDED_LIMITS 0.00 2040.000 DEPOSIT ABSOLUTE /end AXIS_DESCR
/end CHARACTERISTIC
/begin CHARACTERISTIC MoFInjQnt_tiPoIZFCETMax_CUR "" CURVE 0x800210C0 Cur_Xs16Ws16 26214.00 Mo_ti_us_q0p4 -13107.20 13106.80 FORMAT "%8.2"
 /begin AXIS_DESCR STD_AXIS MoFInjDat_p Mo_p_bar_q8p0000 6 0.00 2000.000 EXTENDED_LIMITS 0.00 2040.000 DEPOSIT ABSOLUTE /end AXIS_DESCR
/end CHARACTERISTIC
/begin CHARACTERISTIC MoFInjQnt_tiPoIZFCETMin_CUR "" CURVE 0x800210DA Cur_Xs16Ws16 26214.00 Mo_ti_us_q0p4 -13107.20 13106.80 FORMAT "%8.2"
 /begin AXIS_DESCR STD_AXIS MoFInjDat_p Mo_p_bar_q8p0000 6 0.00 2000.000 EXTENDED_LIMITS 0.00 2040.000 DEPOSIT ABSOLUTE /end AXIS_DESCR
/end CHARACTERISTIC
/begin CHARACTERISTIC MoFInjQnt_volQntAdjLim_C "Symetrische Begrenzung der Abgleichmengen" VALUE 0x800210F4 Val_Ws16 655.3500 Mo_vol_mm3_q0p01 -327.6800 327.6700 FORMAT "%8.4" /end CHARACTERISTIC
/begin CHARACTERISTIC MoFInjQnt_vol_MAP "Einspritzvolumenkennfeld in der Funktionsüberwachung" MAP 0x800210F6 Map_Xs16Ys16Ws16 655.3500 Mo_vol_mm3_q0p01 -327.6800 327.6700 FORMAT "%8.4"
 /begin AXIS_DESCR STD_AXIS MoFInjDat_p Mo_p_bar_q8p0000 16 0.00 2000.000 EXTENDED_LIMITS 0.00 2040.000 DEPOSIT ABSOLUTE /end AXIS_DESCR
 /begin AXIS_DESCR STD_AXIS MoFInjDat_tiMI1 Mo_ti_us_q0p4 20 -13107.20 13106.80 FORMAT "%8.2" DEPOSIT ABSOLUTE /end AXIS_DESCR
/end CHARACTERISTIC
/begin CHARACTERISTIC MoFLos_rTrqEngLos_MAP "Kennfeld für das Motorverlustmoment der Überwachung" MAP 0x800213C2 Map_Xu8Yu8Wu8 99.61 Mo_r_prc_q0p39 0.00 99.61 FORMAT "%5.2"
 /begin AXIS_DESCR STD_AXIS MoFESpd_nEng Mo_n_rpm_q40p0 8 0.00 10200. FORMAT "%5.0" DEPOSIT ABSOLUTE /end AXIS_DESCR
 /begin AXIS_DESCR STD_AXIS MoFTEng_tEng Mo_t_DegC_q0p8o48 8 -48.00 156.0 FORMAT "%5.1" DEPOSIT ABSOLUTE /end AXIS_DESCR
/end CHARACTERISTIC
/begin CHARACTERISTIC PosMCDes_phiMCDes_C "" VALUE 0x8004DE24 Val_Ws16 1439.978 AngleCrS -720.0000 719.9780 /end CHARACTERISTIC
/begin MEASUREMENT ARS_trqDes "" SWORD Trq 1 100 -3276.800 3276.700 ECU_ADDRESS 0xD0000430 /end MEASUREMENT
/begin MEASUREMENT CoEng_stTst "" UBYTE OneToOne 1 100 0.00 255.0 ECU_ADDRESS 0xD0001C47 /end MEASUREMENT
/begin MEASUREMENT CoETS_bFltDemSet "Aktiviere/Deaktiviere ASDrf Filter" UBYTE OneToOne 1 100 0.00 255.0 ECU_ADDRESS 0xD0001C3E /end MEASUREMENT
/begin MEASUREMENT Com_aDirect_FX "" SLONG Acc 1 100 -2147483.64800 2147483.64700 FORMAT "%13.5" ECU_ADDRESS 0xD0002E34 /end MEASUREMENT
/begin MEASUREMENT Com_aSide_FX "" SLONG Acc 1 100 -2147483.64800 2147483.64700 FORMAT "%13.5" ECU_ADDRESS 0xD0002E38 /end MEASUREMENT
/begin MEASUREMENT Com_bRecARS "" UBYTE OneToOne 1 100 0.00 255.0 ECU_ADDRESS 0xD0001C68 /end MEASUREMENT
/begin MEASUREMENT Com_bRecCrCtlLvr "" UBYTE OneToOne 1 100 0.00 255.0 ECU_ADDRESS 0xD0001C69 /end MEASUREMENT
/begin MEASUREMENT Com_bRecMSA "" UBYTE OneToOne 1 100 0.00 255.0 ECU_ADDRESS 0xD0001C6B /end MEASUREMENT
/begin MEASUREMENT Com_ctCBSRstFlF "" UBYTE OneToOne 1 100 0.00 255.0 ECU_ADDRESS 0xD0001C6F /end MEASUREMENT
/begin MEASUREMENT Com_ctCBSRstOil "" UBYTE OneToOne 1 100 0.00 255.0 ECU_ADDRESS 0xD0001C70 /end MEASUREMENT
/begin MEASUREMENT Com_ctCBSRstPFlt "" UBYTE OneToOne 1 100 0.00 255.0 ECU_ADDRESS 0xD0001C71 /end MEASUREMENT
/begin MEASUREMENT Com_ctSleepNeg "" UBYTE OneToOne 1 100 0.00 255.0 ECU_ADDRESS 0xD0001C72 /end MEASUREMENT
/begin MEASUREMENT Com_daDirectCHK_FX "" UBYTE OneToOne 1 100 0.00 255.0 ECU_ADDRESS 0xD0001CBF /end MEASUREMENT
/begin MEASUREMENT Com_daDirectCTR_FX "" UWORD OneToOne 1 100 0.00 65535.00 ECU_ADDRESS 0xD0001576 /end MEASUREMENT
/begin MEASUREMENT Com_daSideCHK_FX "" UBYTE OneToOne 1 100 0.00 255.0 ECU_ADDRESS 0xD0001CC0 /end MEASUREMENT
/begin MEASUREMENT Com_daSideCTR_FX "" UWORD OneToOne 1 100 0.00 65535.00 ECU_ADDRESS 0xD0001578 /end MEASUREMENT
/begin MEASUREMENT Com_dBtnDrvDynCHK_FX "" UBYTE OneToOne 1 100 0.00 255.0 ECU_ADDRESS 0xD0001C7B /end MEASUREMENT
/begin MEASUREMENT Com_dBtnDrvDynCTR_FX "" UWORD OneToOne 1 100 0.00 65535.00 ECU_ADDRESS 0xD00014FC /end MEASUREMENT
/begin MEASUREMENT Com_dCrCtlLvrCHK "" UBYTE OneToOne 1 100 0.00 255.0 ECU_ADDRESS 0xD0001C7C /end MEASUREMENT
/begin MEASUREMENT Com_dCrCtlLvrCTR "" UWORD OneToOne 1 100 0.00 65535.00 ECU_ADDRESS 0xD00014FE /end MEASUREMENT
/begin MEASUREMENT Com_dIntrvTimeCBSRst2FlF "" UBYTE OneToOne 1 100 0.00 255.0 ECU_ADDRESS 0xD0001C8B /end MEASUREMENT
/begin MEASUREMENT Com_dIntrvTimeCBSRst2Oil "" UBYTE OneToOne 1 100 0.00 255.0 ECU_ADDRESS 0xD0001C8C /end MEASUREMENT
/begin MEASUREMENT Com_dIntrvTimeCBSRst2PFlt "" UBYTE OneToOne 1 100 0.00 255.0 ECU_ADDRESS 0xD0001C8D /end MEASUREMENT
/begin MEASUREMENT Com_dKlemmenCHK_FA "" UBYTE OneToOne 1 100 0.00 255.0 ECU_ADDRESS 0xD0001C8F /end MEASUREMENT
/begin MEASUREMENT Com_dKlemmenCTR_FA "" UWORD OneToOne 1 100 0.00 65535.00 ECU_ADDRESS 0xD0001520 /end MEASUREMENT
/begin MEASUREMENT Com_dMonthCBSRst2FlF "" UBYTE OneToOne 1 100 0.00 255.0 ECU_ADDRESS 0xD0001C92 /end MEASUREMENT
/begin MEASUREMENT Com_dMonthCBSRst2Oil "" UBYTE OneToOne 1 100 0.00 255.0 ECU_ADDRESS 0xD0001C93 /end MEASUREMENT
/begin MEASUREMENT Com_dMonthCBSRst2PFlt "" UBYTE OneToOne 1 100 0.00 255.0 ECU_ADDRESS 0xD0001C94 /end MEASUREMENT
/begin MEASUREMENT Com_dRequestEMFCHK "" UBYTE OneToOne 1 100 0.00 255.0 ECU_ADDRESS 0xD0001C96 /end MEASUREMENT
/begin MEASUREMENT Com_dRequestEMFCTR "" UWORD OneToOne 1 100 0.00 65535.00 ECU_ADDRESS 0xD0001522 /end MEASUREMENT
/begin MEASUREMENT Com_dRmnMlgCBSRstFlF "" SWORD OneToOne 1 100 -32768.00 32767.00 ECU_ADDRESS 0xD000075C /end MEASUREMENT
/begin MEASUREMENT Com_dRmnMlgCBSRstOil "" SWORD OneToOne 1 100 -32768.00 32767.00 ECU_ADDRESS 0xD000075E /end MEASUREMENT
/begin MEASUREMENT Com_dRmnMlgCBSRstPFlt "" SWORD OneToOne 1 100 -32768.00 32767.00 ECU_ADDRESS 0xD0000760 /end MEASUREMENT
/begin MEASUREMENT Com_dSpeedVehicleCHK_FX "" UBYTE OneToOne 1 100 0.00 255.0 ECU_ADDRESS 0xD0001C97 /end MEASUREMENT
/begin MEASUREMENT Com_dSpeedVehicleCTR_FX "" UWORD OneToOne 1 100 0.00 65535.00 ECU_ADDRESS 0xD0001524 /end MEASUREMENT
/begin MEASUREMENT Com_dstARSCTR "" UWORD OneToOne 1 100 0.00 65535.00 ECU_ADDRESS 0xD000157C /end MEASUREMENT
/begin MEASUREMENT Com_dStatusEMFCHK "" UBYTE OneToOne 1 100 0.00 255.0 ECU_ADDRESS 0xD0001C98 /end MEASUREMENT
/begin MEASUREMENT Com_dStatusEMFCTR "" UWORD OneToOne 1 100 0.00 65535.00 ECU_ADDRESS 0xD0001528 /end MEASUREMENT
/begin MEASUREMENT Com_dTerminalCHK "" UBYTE OneToOne 1 100 0.00 255.0 ECU_ADDRESS 0xD0001C9B /end MEASUREMENT
/begin MEASUREMENT Com_dTerminalCTR "" UWORD OneToOne 1 100 0.00 65535.00 ECU_ADDRESS 0xD000152E /end MEASUREMENT
/begin MEASUREMENT Com_dTrqDemDrvDynCHK_FX "" UBYTE OneToOne 1 100 0.00 255.0 ECU_ADDRESS 0xD0001CA6 /end MEASUREMENT
/begin MEASUREMENT Com_dTrqDemDrvDynCTR_FX "" UWORD OneToOne 1 100 0.00 65535.00 ECU_ADDRESS 0xD0001548 /end MEASUREMENT
/begin MEASUREMENT Com_dvolPspDes "" SWORD FlConsum_l_h 1 100 -327.6800 327.6700 FORMAT "%8.4" ECU_ADDRESS 0xD0000766 /end MEASUREMENT
/begin MEASUREMENT Com_dvolPspDes_A "" SWORD FlConsum_l_h 1 100 -327.6800 327.6700 FORMAT "%8.4" ECU_ADDRESS 0xD0000768 /end MEASUREMENT
/begin MEASUREMENT Com_dYearCBSRst2FlF "" UBYTE OneToOne 1 100 0.00 255.0 ECU_ADDRESS 0xD0001CBC /end MEASUREMENT
/begin MEASUREMENT Com_dYearCBSRst2Oil "" UBYTE OneToOne 1 100 0.00 255.0 ECU_ADDRESS 0xD0001CBD /end MEASUREMENT
/begin MEASUREMENT Com_dYearCBSRst2PFlt "" UBYTE OneToOne 1 100 0.00 255.0 ECU_ADDRESS 0xD0001CBE /end MEASUREMENT
/begin MEASUREMENT Com_idParkConsumer "" UWORD OneToOne 1 100 0.00 65535.00 ECU_ADDRESS 0xD0001584 /end MEASUREMENT
/begin MEASUREMENT Com_idVerbraucher "" UWORD OneToOne 1 100 0.00 65535.00 ECU_ADDRESS 0xD0001586 /end MEASUREMENT
/begin MEASUREMENT Com_iHiLimCurr "" SWORD Curr_10A_Step_A 1 100 -327680.0 327670.0 FORMAT "%8.1" ECU_ADDRESS 0xD000076C /end MEASUREMENT
/begin MEASUREMENT Com_iHiLimCurr_FA "" SWORD Curr_10A_Step_A 1 100 -327680.0 327670.0 FORMAT "%8.1" ECU_ADDRESS 0xD000076E /end MEASUREMENT
/begin MEASUREMENT Com_iLoLimCurr "" SWORD Curr_10A_Step_A 1 100 -327680.0 327670.0 FORMAT "%8.1" ECU_ADDRESS 0xD0000770 /end MEASUREMENT
/begin MEASUREMENT Com_iLoLimCurr_FA "" SWORD Curr_10A_Step_A 1 100 -327680.0 327670.0 FORMAT "%8.1" ECU_ADDRESS 0xD0000772 /end MEASUREMENT
/begin MEASUREMENT Com_iPsp "" SWORD UC_Curr 1 100 -3276.800 3276.700 FORMAT "%8.3" ECU_ADDRESS 0xD0000774 /end MEASUREMENT
/begin MEASUREMENT Com_iPsp_A "" SWORD UC_Curr 1 100 -3276.800 3276.700 FORMAT "%8.3" ECU_ADDRESS 0xD0000776 /end MEASUREMENT
/begin MEASUREMENT Com_iZrLimCurr "" SWORD Curr 1 100 -32768.00 32767.00 FORMAT "%8.2" ECU_ADDRESS 0xD0000778 /end MEASUREMENT
/begin MEASUREMENT Com_iZrLimCurr_FA "" SWORD Curr 1 100 -32768.00 32767.00 FORMAT "%8.2" ECU_ADDRESS 0xD000077A /end MEASUREMENT
/begin MEASUREMENT Com_lIntrvWayCBSRst2FlF "" SWORD OneToOne_km 1 100 -32768.00 32767.00 FORMAT "%8.2" ECU_ADDRESS 0xD000077E /end MEASUREMENT
/begin MEASUREMENT Com_lIntrvWayCBSRst2Oil "" SWORD OneToOne 1 100 -32768.00 32767.00 ECU_ADDRESS 0xD0000780 /end MEASUREMENT
/begin MEASUREMENT Com_lIntrvWayCBSRst2PFlt "" SWORD OneToOne_km 1 100 -32768.00 32767.00 FORMAT "%8.2" ECU_ADDRESS 0xD0000782 /end MEASUREMENT
/begin MEASUREMENT Com_nPsp "" SWORD OneToOne_rpm 1 100 -32768.00 32767.00 FORMAT "%8.2" ECU_ADDRESS 0xD000078C /end MEASUREMENT
/begin MEASUREMENT Com_nPsp_A "" SWORD OneToOne_rpm 1 100 -32768.00 32767.00 FORMAT "%8.2" ECU_ADDRESS 0xD000078E /end MEASUREMENT
/begin MEASUREMENT Com_numRqStgEFan_mp "" UBYTE OneToOne 1 100 0.00 255.0 ECU_ADDRESS 0xC000B367 /end MEASUREMENT
/begin MEASUREMENT Com_numSleepNegID0 "" UBYTE OneToOne 1 100 0.00 255.0 ECU_ADDRESS 0xD0001CC8 /end MEASUREMENT
/begin MEASUREMENT Com_numSleepNegID1 "" UBYTE OneToOne 1 100 0.00 255.0 ECU_ADDRESS 0xD0001CC9 /end MEASUREMENT
/begin MEASUREMENT Com_numSleepNegID2 "" UBYTE OneToOne 1 100 0.00 255.0 ECU_ADDRESS 0xD0001CCA /end MEASUREMENT
/begin MEASUREMENT Com_numSleepNegID3 "" UBYTE OneToOne 1 100 0.00 255.0 ECU_ADDRESS 0xD0001CCB /end MEASUREMENT
/begin MEASUREMENT Com_rAvlCBSRstFlF "" SWORD Prc 1 100 -400.0000 399.9878 ECU_ADDRESS 0xD00007C2 /end MEASUREMENT
/begin MEASUREMENT Com_rAvlCBSRstOil "" SWORD OneToOne 1 100 -32768.00 32767.00 ECU_ADDRESS 0xD00007C4 /end MEASUREMENT
/begin MEASUREMENT Com_rAvlCBSRstPFlt "" SWORD Prc 1 100 -400.0000 399.9878 ECU_ADDRESS 0xD00007C6 /end MEASUREMENT
/begin MEASUREMENT Com_rPspSetPoint "" SWORD Prc 1 100 -400.0000 399.9878 ECU_ADDRESS 0xD00007E4 /end MEASUREMENT
/begin MEASUREMENT Com_rPspSetPoint_A "" SWORD Prc 1 100 -400.0000 399.9878 ECU_ADDRESS 0xD00007E6 /end MEASUREMENT
/begin MEASUREMENT Com_stARS "" UBYTE OneToOne 1 100 0.00 255.0 ECU_ADDRESS 0xD0001CD1 /end MEASUREMENT
/begin MEASUREMENT Com_stBattClass "" UBYTE OneToOne 1 100 0.00 255.0 ECU_ADDRESS 0xD0001CD5 /end MEASUREMENT
/begin MEASUREMENT Com_stBattClass_FA "" UBYTE OneToOne 1 100 0.00 255.0 ECU_ADDRESS 0xD0001CD6 /end MEASUREMENT
/begin MEASUREMENT Com_stBonnet "" UBYTE OneToOne 1 100 0.00 255.0 ECU_ADDRESS 0xD0001CD7 /end MEASUREMENT
/begin MEASUREMENT Com_stBonnet_FA "" UBYTE OneToOne 1 100 0.00 255.0 ECU_ADDRESS 0xD0001CD8 /end MEASUREMENT
/begin MEASUREMENT Com_stButtonMSA "" UBYTE OneToOne 1 100 0.00 255.0 ECU_ADDRESS 0xD0001CDE /end MEASUREMENT
/begin MEASUREMENT Com_stClassPwr "" UBYTE OneToOne 1 100 0.00 255.0 ECU_ADDRESS 0xD0001CE7 /end MEASUREMENT
/begin MEASUREMENT Com_stClassPwr_FA "" UBYTE OneToOne 1 100 0.00 255.0 ECU_ADDRESS 0xD0001CE8 /end MEASUREMENT
/begin MEASUREMENT Com_stClthOpen "" UBYTE OneToOne 1 100 0.00 255.0 ECU_ADDRESS 0xD0001CEA /end MEASUREMENT
/begin MEASUREMENT Com_stClthOpen_FA "" UBYTE OneToOne 1 100 0.00 255.0 ECU_ADDRESS 0xD0001CEC /end MEASUREMENT
/begin MEASUREMENT Com_stCrCtlLvr "" UBYTE OneToOne 1 100 0.00 255.0 ECU_ADDRESS 0xD0001CF1 /end MEASUREMENT
/begin MEASUREMENT Com_stDiagPsp "" UBYTE OneToOne 1 100 0.00 255.0 ECU_ADDRESS 0xD0001CF9 /end MEASUREMENT
/begin MEASUREMENT Com_stDiagPsp_A "" UBYTE OneToOne 1 100 0.00 255.0 ECU_ADDRESS 0xD0001CFA /end MEASUREMENT
/begin MEASUREMENT Com_stDoorDriver "" UBYTE OneToOne 1 100 0.00 255.0 ECU_ADDRESS 0xD0001CFB /end MEASUREMENT
/begin MEASUREMENT Com_stDoorDriver_FA "" UBYTE OneToOne 1 100 0.00 255.0 ECU_ADDRESS 0xD0001CFC /end MEASUREMENT
/begin MEASUREMENT Com_stDrvDyn "" UBYTE OneToOne 1 100 0.00 255.0 ECU_ADDRESS 0xD0001D01 /end MEASUREMENT
/begin MEASUREMENT Com_stDrvDyn_FX "" UBYTE OneToOne 1 100 0.00 255.0 ECU_ADDRESS 0xD0001D03 /end MEASUREMENT
/begin MEASUREMENT Com_stDrvPrgQl "" UBYTE OneToOne 1 100 0.00 255.0 ECU_ADDRESS 0xD0001D04 /end MEASUREMENT
/begin MEASUREMENT Com_stDrvPrgQl_FX "" UBYTE OneToOne 1 100 0.00 255.0 ECU_ADDRESS 0xD0001D05 /end MEASUREMENT
/begin MEASUREMENT Com_stDrWghSeat "" UBYTE OneToOne 1 100 0.00 255.0 ECU_ADDRESS 0xD0001CFD /end MEASUREMENT
/begin MEASUREMENT Com_stDrWghSeat_FA "" UBYTE OneToOne 1 100 0.00 255.0 ECU_ADDRESS 0xD0001CFE /end MEASUREMENT
/begin MEASUREMENT Com_stEngStop "" UBYTE OneToOne 1 100 0.00 255.0 ECU_ADDRESS 0xD0001D0A /end MEASUREMENT
/begin MEASUREMENT Com_stEngStop_FA "" UBYTE OneToOne 1 100 0.00 255.0 ECU_ADDRESS 0xD0001D0B /end MEASUREMENT
/begin MEASUREMENT Com_stGearBck "" UBYTE OneToOne 1 100 0.00 255.0 ECU_ADDRESS 0xD0001D16 /end MEASUREMENT
/begin MEASUREMENT Com_stHDC "" UBYTE OneToOne 1 100 0.00 255.0 ECU_ADDRESS 0xD0001D1B /end MEASUREMENT
/begin MEASUREMENT Com_stKeyVld "" UBYTE OneToOne 1 100 0.00 255.0 ECU_ADDRESS 0xD0001D22 /end MEASUREMENT
/begin MEASUREMENT Com_stKeyVld_FA "" UBYTE OneToOne 1 100 0.00 255.0 ECU_ADDRESS 0xD0001D23 /end MEASUREMENT
/begin MEASUREMENT Com_stMSALmp "" UBYTE OneToOne 1 100 0.00 255.0 ECU_ADDRESS 0xD0001D2E /end MEASUREMENT
/begin MEASUREMENT Com_stParkConsumer "" UBYTE OneToOne 1 100 0.00 255.0 ECU_ADDRESS 0xD0001D4B /end MEASUREMENT
/begin MEASUREMENT Com_stPBrComf "" UBYTE OneToOne 1 100 0.00 255.0 ECU_ADDRESS 0xD0001D43 /end MEASUREMENT
/begin MEASUREMENT Com_stPBrHold "" UBYTE OneToOne 1 100 0.00 255.0 ECU_ADDRESS 0xD0001D44 /end MEASUREMENT
/begin MEASUREMENT Com_stPBrHyd "" UBYTE OneToOne 1 100 0.00 255.0 ECU_ADDRESS 0xD0001D45 /end MEASUREMENT
/begin MEASUREMENT Com_stPsp "" UBYTE OneToOne 1 100 0.00 255.0 ECU_ADDRESS 0xD0001D4C /end MEASUREMENT
/begin MEASUREMENT Com_stPspCntr "" UBYTE OneToOne 1 100 0.00 255.0 ECU_ADDRESS 0xD0001D4D /end MEASUREMENT
/begin MEASUREMENT Com_stPspCntr_A "" UBYTE OneToOne 1 100 0.00 255.0 ECU_ADDRESS 0xD0001D4E /end MEASUREMENT
/begin MEASUREMENT Com_stPsp_A "" UBYTE OneToOne 1 100 0.00 255.0 ECU_ADDRESS 0xD0001D4F /end MEASUREMENT
/begin MEASUREMENT Com_stReqMSA "" UBYTE OneToOne 1 100 0.00 255.0 ECU_ADDRESS 0xD0001D53 /end MEASUREMENT
/begin MEASUREMENT Com_stShiftPdl "" UBYTE OneToOne 1 100 0.00 255.0 ECU_ADDRESS 0xD0001D67 /end MEASUREMENT
/begin MEASUREMENT Com_stShiftPdl_FX "" UBYTE OneToOne 1 100 0.00 255.0 ECU_ADDRESS 0xD0001D68 /end MEASUREMENT
/begin MEASUREMENT Com_stShutOffPSP "" UBYTE OneToOne 1 100 0.00 255.0 ECU_ADDRESS 0xD0001D69 /end MEASUREMENT
/begin MEASUREMENT Com_stShutOffPSP_FA "" UBYTE OneToOne 1 100 0.00 255.0 ECU_ADDRESS 0xD0001D6A /end MEASUREMENT
/begin MEASUREMENT Com_stSleepAckTx "" UBYTE OneToOne 1 100 0.00 255.0 ECU_ADDRESS 0xD0001D6B /end MEASUREMENT
/begin MEASUREMENT Com_stSleepBus "" UBYTE OneToOne 1 100 0.00 255.0 ECU_ADDRESS 0xD0001D6C /end MEASUREMENT
/begin MEASUREMENT Com_stSleepBus_FA "" UBYTE OneToOne 1 100 0.00 255.0 ECU_ADDRESS 0xD0001D6D /end MEASUREMENT
/begin MEASUREMENT Com_stSleepBus_FX "" UBYTE OneToOne 1 100 0.00 255.0 ECU_ADDRESS 0xD0001D6E /end MEASUREMENT
/begin MEASUREMENT Com_stSleepConst "" UBYTE OneToOne 1 100 0.00 255.0 ECU_ADDRESS 0xD0001D6F /end MEASUREMENT
/begin MEASUREMENT Com_stSleepConst_FA "" UBYTE OneToOne 1 100 0.00 255.0 ECU_ADDRESS 0xD0001D70 /end MEASUREMENT
/begin MEASUREMENT Com_stSleepConst_FX "" UBYTE OneToOne 1 100 0.00 255.0 ECU_ADDRESS 0xD0001D71 /end MEASUREMENT
/begin MEASUREMENT Com_stSleepDest "" UBYTE OneToOne 1 100 0.00 255.0 ECU_ADDRESS 0xD0001D72 /end MEASUREMENT
/begin MEASUREMENT Com_stSleepDest_FA "" UBYTE OneToOne 1 100 0.00 255.0 ECU_ADDRESS 0xD0001D73 /end MEASUREMENT
/begin MEASUREMENT Com_stSleepDest_FX "" UBYTE OneToOne 1 100 0.00 255.0 ECU_ADDRESS 0xD0001D74 /end MEASUREMENT
/begin MEASUREMENT Com_stSleepRdy "" UBYTE OneToOne 1 100 0.00 255.0 ECU_ADDRESS 0xD0001D75 /end MEASUREMENT
/begin MEASUREMENT Com_stSleepRdyTx "" UBYTE OneToOne 1 100 0.00 255.0 ECU_ADDRESS 0xD0001D76 /end MEASUREMENT
/begin MEASUREMENT Com_stSleepRdy_FA "" UBYTE OneToOne 1 100 0.00 255.0 ECU_ADDRESS 0xD0001D77 /end MEASUREMENT
/begin MEASUREMENT Com_stSleepRdy_FX "" UBYTE OneToOne 1 100 0.00 255.0 ECU_ADDRESS 0xD0001D78 /end MEASUREMENT
/begin MEASUREMENT Com_stStgEFan "" UBYTE OneToOne 1 100 0.00 255.0 ECU_ADDRESS 0xD0001D79 /end MEASUREMENT
/begin MEASUREMENT Com_stT15 "" UBYTE OneToOne 1 100 0.00 255.0 ECU_ADDRESS 0xD0001D82 /end MEASUREMENT
/begin MEASUREMENT Com_stT15Hw "" UBYTE OneToOne 1 100 0.00 255.0 ECU_ADDRESS 0xD0001D83 /end MEASUREMENT
/begin MEASUREMENT Com_stT50 "" UBYTE OneToOne 1 100 0.00 255.0 ECU_ADDRESS 0xD0001D84 /end MEASUREMENT
/begin MEASUREMENT Com_stTerminal "" UBYTE OneToOne 1 100 0.00 255.0 ECU_ADDRESS 0xD0001D89 /end MEASUREMENT
/begin MEASUREMENT Com_stTerminal_FA "" UBYTE OneToOne 1 100 0.00 255.0 ECU_ADDRESS 0xD0001D8A /end MEASUREMENT
/begin MEASUREMENT Com_stTRadio "" UBYTE OneToOne 1 100 0.00 255.0 ECU_ADDRESS 0xD0001D85 /end MEASUREMENT
/begin MEASUREMENT Com_stTrailer "" UBYTE OneToOne 1 100 0.00 255.0 ECU_ADDRESS 0xD0001D8B /end MEASUREMENT
/begin MEASUREMENT Com_stTrailer_FA "" UBYTE OneToOne 1 100 0.00 255.0 ECU_ADDRESS 0xD0001D8C /end MEASUREMENT
/begin MEASUREMENT Com_stTypBody "" UBYTE OneToOne 1 100 0.00 255.0 ECU_ADDRESS 0xD0001DA2 /end MEASUREMENT
/begin MEASUREMENT Com_stUnCBSRstFlF "" UBYTE OneToOne 1 100 0.00 255.0 ECU_ADDRESS 0xD0001DA4 /end MEASUREMENT
/begin MEASUREMENT Com_stUnCBSRstOil "" UBYTE OneToOne 1 100 0.00 255.0 ECU_ADDRESS 0xD0001DA5 /end MEASUREMENT
/begin MEASUREMENT Com_stUnCBSRstPFlt "" UBYTE OneToOne 1 100 0.00 255.0 ECU_ADDRESS 0xD0001DA6 /end MEASUREMENT
/begin MEASUREMENT Com_stVehCond "" UBYTE OneToOne 1 100 0.00 255.0 ECU_ADDRESS 0xD0001DA8 /end MEASUREMENT
/begin MEASUREMENT Com_stVehCond_FA "" UBYTE OneToOne 1 100 0.00 255.0 ECU_ADDRESS 0xD0001DA9 /end MEASUREMENT
/begin MEASUREMENT Com_stVehDrvCond_FX "" UBYTE OneToOne 1 100 0.00 255.0 ECU_ADDRESS 0xD0001DAC /end MEASUREMENT
/begin MEASUREMENT Com_stVerbraucher "" UBYTE OneToOne 1 100 0.00 255.0 ECU_ADDRESS 0xD0001DAD /end MEASUREMENT
/begin MEASUREMENT Com_swtDrBltb "" UBYTE OneToOne 1 100 0.00 255.0 ECU_ADDRESS 0xD0001DB4 /end MEASUREMENT
/begin MEASUREMENT Com_swtDrBltb_FA "" UBYTE OneToOne 1 100 0.00 255.0 ECU_ADDRESS 0xD0001DB5 /end MEASUREMENT
/begin MEASUREMENT Com_tiPostRunPwrSpl "" UWORD Time_1s 1 100 0.00 65535.00 FORMAT "%8.2" ECU_ADDRESS 0xD0001590 /end MEASUREMENT
/begin MEASUREMENT Com_tiPostRunPwrSpl_FA "" UWORD Time_1s 1 100 0.00 65535.00 FORMAT "%8.2" ECU_ADDRESS 0xD0001592 /end MEASUREMENT
/begin MEASUREMENT Com_trqARSCur "" SWORD Trq 1 100 -3276.800 3276.700 ECU_ADDRESS 0xD0000814 /end MEASUREMENT
/begin MEASUREMENT Com_trqARSDes "" SWORD Trq 1 100 -3276.800 3276.700 ECU_ADDRESS 0xD0000816 /end MEASUREMENT
/begin MEASUREMENT Com_trqCltDKG "" SWORD Trq 1 100 -3276.800 3276.700 ECU_ADDRESS 0xD000081A /end MEASUREMENT
/begin MEASUREMENT Com_trqTarDrvDyn "" SWORD Trq 1 100 -3276.800 3276.700 ECU_ADDRESS 0xD0000846 /end MEASUREMENT
/begin MEASUREMENT Com_trqTarDrvDynDes "" SWORD Trq 1 100 -3276.800 3276.700 ECU_ADDRESS 0xD0000848 /end MEASUREMENT
/begin MEASUREMENT Com_trqTarDrvDynDes_FX "" SWORD Trq 1 100 -3276.800 3276.700 ECU_ADDRESS 0xD000084A /end MEASUREMENT
/begin MEASUREMENT Com_trqTarDrvDynMax "" SWORD Trq 1 100 -3276.800 3276.700 ECU_ADDRESS 0xD000084C /end MEASUREMENT
/begin MEASUREMENT Com_trqTarDrvDynMax_FX "" SWORD Trq 1 100 -3276.800 3276.700 ECU_ADDRESS 0xD000084E /end MEASUREMENT
/begin MEASUREMENT Com_trqTarDrvDyn_FX "" SWORD Trq 1 100 -3276.800 3276.700 ECU_ADDRESS 0xD0000850 /end MEASUREMENT
/begin MEASUREMENT Com_uPsp "" SWORD UC_Volt 1 100 -3276.800 3276.700 FORMAT "%8.3" ECU_ADDRESS 0xD000085E /end MEASUREMENT
/begin MEASUREMENT Com_uPsp_A "" SWORD UC_Volt 1 100 -3276.800 3276.700 FORMAT "%8.3" ECU_ADDRESS 0xD0000860 /end MEASUREMENT
/begin MEASUREMENT Com_uT30Psp "" SWORD UC_Volt 1 100 -3276.800 3276.700 FORMAT "%8.3" ECU_ADDRESS 0xD0000862 /end MEASUREMENT
/begin MEASUREMENT Com_uT30Psp_A "" SWORD UC_Volt 1 100 -3276.800 3276.700 FORMAT "%8.3" ECU_ADDRESS 0xD0000864 /end MEASUREMENT
/begin MEASUREMENT Com_v_FX "" SLONG Vel 1 100 -21474836.4800 21474836.4700 ECU_ADDRESS 0xD0002E90 /end MEASUREMENT
/begin MEASUREMENT Cpp_pCylAvrgAg1 "" SWORD CylPres 1 100 -327.6800 327.6700 FORMAT "%8.4" ECU_ADDRESS 0xD00008A6 /end MEASUREMENT
/begin MEASUREMENT Cpp_trqInrCorAvrg "" SWORD Trq 1 100 -3276.800 3276.700 ECU_ADDRESS 0xD00008A8 /end MEASUREMENT
/begin MEASUREMENT Dspl_bFlTnk "" UBYTE Dspl_bFlTnk_VERB 1 100 0.00 1.00000000000 FORMAT "%13.11" ECU_ADDRESS 0xD0001DD8 /end MEASUREMENT
/begin MEASUREMENT Dspl_volFlTnkQnt "" SWORD Vol 1 100 -327.6800 327.6700 FORMAT "%8.4" ECU_ADDRESS 0xD00008D2 /end MEASUREMENT
/begin MEASUREMENT GlwCtl_tiPreGlwRmn "" SWORD Time_ms 1 100 -327680.0 327670.0 ECU_ADDRESS 0xD0000B74 /end MEASUREMENT
/begin MEASUREMENT HESrv_stMSid "" UBYTE OneToOne 1 100 0.00 255.0 ECU_ADDRESS 0xD0001E71 /end MEASUREMENT
/begin MEASUREMENT InjCtl_qDriftLim2 "" SWORD InjMassCyc 1 100 -327.6800 327.6700 ECU_ADDRESS 0xD0000FAC /end MEASUREMENT
/begin MEASUREMENT InjVlv_rTrqInrLimMax "Maximum-Begrenzung für CSC Eingriff auf MI1" SWORD Prc_Fact100 1 100 -327.6800 327.6700 FORMAT "%8.4" ECU_ADDRESS 0xD000100E /end MEASUREMENT
/begin MEASUREMENT InjVlv_rTrqInrLimMin "Minimum-Begrenzung für CSC Eingriff auf MI1" SWORD Prc_Fact100 1 100 -327.6800 327.6700 FORMAT "%8.4" ECU_ADDRESS 0xD0001010 /end MEASUREMENT
/begin MEASUREMENT InjVlv_tiMI1CSCCor "CSC-Ansteuerdauerkorrektur für MI1" SWORD InjTime_us 1 100 -13107.20 5000.00 ECU_ADDRESS 0xD000101A /end MEASUREMENT
/begin MEASUREMENT InjVlv_tiZFCPiI3ETCor "korrigierte Ansteuerdauer PiI3" SWORD InjTime_us 1 100 -13107.20 5000.00 ECU_ADDRESS 0xD0001024 /end MEASUREMENT
/begin MEASUREMENT Lub_dmFlAddBas_mp "Basis-Kraftstoffmassenstrom ins Motoröl infolge Nacheinspritzung" SWORD OilMFl_mgps_q0p1 1 100 -3276.800 3276.700 FORMAT "%8.3" ECU_ADDRESS 0xC000A4AE /end MEASUREMENT
/begin MEASUREMENT Lub_dmFlAddCor_mp "Korrigierter Kraftstoffmassenstrom ins Motoröl infolge Nacheinspritzung" SWORD OilMFl_mgps_q0p1 1 100 -3276.800 3276.700 FORMAT "%8.3" ECU_ADDRESS 0xC000A4B0 /end MEASUREMENT
/begin MEASUREMENT Lub_dmFlAdd_mp "Kraftstoffmassenstrom ins Motoröl infolge Nacheinspritzung" SWORD OilMFl_mgps_q0p1 1 100 -3276.800 3276.700 FORMAT "%8.3" ECU_ADDRESS 0xC000A4B2 /end MEASUREMENT
/begin MEASUREMENT Lub_dmFlEvpBas_mp "Basis-Kraftstoffmassenstrom aus dem Motoröl infolge Verflüchtigung" SWORD OilMFl_mgps_q0p1 1 100 -3276.800 3276.700 FORMAT "%8.3" ECU_ADDRESS 0xC000A4B4 /end MEASUREMENT
/begin MEASUREMENT Lub_dmFlEvp_mp "Kraftstoffmassenstrom aus dem Motoröl infolge Verflüchtigung" SWORD OilMFl_mgps_q0p1 1 100 -3276.800 3276.700 FORMAT "%8.3" ECU_ADDRESS 0xC000A4B6 /end MEASUREMENT
/begin MEASUREMENT Lub_dmFlOilRmvBas_mp "Basis-Gesamtölmassenstrom aus dem Motoröl" SWORD OilMFl_mgps_q0p1 1 100 -3276.800 3276.700 FORMAT "%8.3" ECU_ADDRESS 0xC000A4B8 /end MEASUREMENT
/begin MEASUREMENT Lub_dmFlOilRmvTempCor_mp "Korrigierter Gesamtölmassenstrom aus dem Motoröl" SWORD OilMFl_mgps_q0p1 1 100 -3276.800 3276.700 FORMAT "%8.3" ECU_ADDRESS 0xC000A4BA /end MEASUREMENT
/begin MEASUREMENT Lub_dmFlOilRmv_mp "Gesamtölmassenstrom aus dem Motoröl" SWORD OilMFl_mgps_q0p1 1 100 -3276.800 3276.700 FORMAT "%8.3" ECU_ADDRESS 0xC000A4BC /end MEASUREMENT
/begin MEASUREMENT Lub_dmFlRmvTot_mp "Gesamtkraftstoffmassenstrom aus dem Motoröl" SWORD OilMFl_mgps_q0p1 1 100 -3276.800 3276.700 FORMAT "%8.3" ECU_ADDRESS 0xC000A4BE /end MEASUREMENT
/begin MEASUREMENT Lub_dmFlRmv_mp "Kraftstoffmassenstrom aus dem Motoröl" SWORD OilMFl_mgps_q0p1 1 100 -3276.800 3276.700 FORMAT "%8.3" ECU_ADDRESS 0xC000A4C0 /end MEASUREMENT
/begin MEASUREMENT Lub_dmFl_mp "Gesamtkraftstoffmassenstrom ins Motoröl" SWORD OilMFl_mgps_q0p1 1 100 -3276.800 3276.700 FORMAT "%8.3" ECU_ADDRESS 0xC000A4C2 /end MEASUREMENT
/begin MEASUREMENT Lub_dmOilRmv_mp "Reiner Ölmassenstrom aus dem Motoröl" SWORD OilMFl_mgps_q0p1 1 100 -3276.800 3276.700 FORMAT "%8.3" ECU_ADDRESS 0xC000A4C4 /end MEASUREMENT
/begin MEASUREMENT Lub_lOilChngEEP_mp "EEPROM Wert für Wegstrecke seit dem letzten Ölwechsel" SLONG Length 1 100 -2147483648.00 2147483647.00 FORMAT "%13.2" ECU_ADDRESS 0xC00090F4 /end MEASUREMENT
/begin MEASUREMENT Lub_mFl "Im Motoröl enthaltene Kraftstoffmenge" SLONG OilMs_q0p1 1 100 -214748364.800 214748364.700 FORMAT "%13.3" ECU_ADDRESS 0xD0002F2C /end MEASUREMENT
/begin MEASUREMENT Lub_mFlEEP_mp "EEPROM Wert für Kraftstoffmenge enthalten im Motoröl" SLONG OilMs_q0p1 1 100 -214748364.800 214748364.700 FORMAT "%13.3" ECU_ADDRESS 0xC00090F8 /end MEASUREMENT
/begin MEASUREMENT Lub_mFlInt_mp "" SLONG OilMs_mg 1 100 -2147483648.00 2147483647.00 FORMAT "%13.2" ECU_ADDRESS 0xC00090FC /end MEASUREMENT
/begin MEASUREMENT Lub_mOilDilEng "" SLONG OilMs_q0p1 1 100 -214748364.800 214748364.700 FORMAT "%13.3" ECU_ADDRESS 0xD0002F30 /end MEASUREMENT
/begin MEASUREMENT Lub_mOilEngSens_mp "Gesamtölmasse im Motor berechnet aus Ölstandssensorwert" SLONG OilMs_q0p1 1 100 -214748364.800 214748364.700 FORMAT "%13.3" ECU_ADDRESS 0xC0009100 /end MEASUREMENT
/begin MEASUREMENT Lub_mOilRmvEEP_mp "EEPROM Wert für reinen Ölverbrauch" SLONG OilMs_mg 1 100 -2147483648.00 2147483647.00 FORMAT "%13.2" ECU_ADDRESS 0xC0009104 /end MEASUREMENT
/begin MEASUREMENT Lub_mOilRmvInt_mp "" SLONG OilMs_mg 1 100 -2147483648.00 2147483647.00 FORMAT "%13.2" ECU_ADDRESS 0xC0009108 /end MEASUREMENT
/begin MEASUREMENT Lub_mOilRmv_mp "Reiner Ölverbrauch" SLONG OilMs_mg 1 100 -2147483648.00 2147483647.00 FORMAT "%13.2" ECU_ADDRESS 0xC000910C /end MEASUREMENT
/begin MEASUREMENT Lub_mTot "Gesamtölmasse im Motor" SLONG OilMs_q0p1 1 100 -214748364.800 214748364.700 FORMAT "%13.3" ECU_ADDRESS 0xD0002F34 /end MEASUREMENT
/begin MEASUREMENT Lub_mTotCrvIn_mp "Gesamtölmasse im Motor" SWORD OilMs_q10 1 100 -327680.0 327670.0 FORMAT "%8.1" ECU_ADDRESS 0xC000A4C6 /end MEASUREMENT
/begin MEASUREMENT Lub_mTotDflMax_mp "Gesamtölmasse im Motor bei maximaler Startölmasse" SLONG OilMs_q0p1 1 100 -214748364.800 214748364.700 FORMAT "%13.3" ECU_ADDRESS 0xC0009110 /end MEASUREMENT
/begin MEASUREMENT Lub_mTotDflMin_mp "Gesamtölmasse im Motor bei minimaler Startölmasse" SLONG OilMs_q0p1 1 100 -214748364.800 214748364.700 FORMAT "%13.3" ECU_ADDRESS 0xC0009114 /end MEASUREMENT
/begin MEASUREMENT Lub_rFlOil "Kraftstoff-Öl Verhältnis im Motor" SWORD OilMsPrc_q0p01 1 100 -327.6800 327.6700 FORMAT "%8.4" ECU_ADDRESS 0xD00010D0 /end MEASUREMENT
/begin MEASUREMENT Lub_rFlOilDflMax_mp "Kraftstoff-Öl Verhältnis bei maximaler Startölmasse" SWORD OilMsPrc_q0p01 1 100 -327.6800 327.6700 FORMAT "%8.4" ECU_ADDRESS 0xC000A4C8 /end MEASUREMENT
/begin MEASUREMENT Lub_rFlOilDflMin_mp "Kraftstoff-Öl Verhältnis bei minimaler Startölmasse" SWORD OilMsPrc_q0p01 1 100 -327.6800 327.6700 FORMAT "%8.4" ECU_ADDRESS 0xC000A4CA /end MEASUREMENT
/begin MEASUREMENT Lub_stMsOilSensVld_mp "Status der Ölmassenvalidierung des Ölstandssensors" UBYTE OneToOne 1 100 0.00 255.0 ECU_ADDRESS 0xC000B361 /end MEASUREMENT
/begin MEASUREMENT Lub_stOilChng_mp "Ölwechselstatus" UBYTE OneToOne 1 100 0.00 255.0 ECU_ADDRESS 0xC000B362 /end MEASUREMENT
/begin MEASUREMENT Lub_stOilEng "Status des Motoröls" UWORD OneToOne 1 100 0.00 65535.00 ECU_ADDRESS 0xD00015FA /end MEASUREMENT
/begin MEASUREMENT Lub_stOilLayer "" ULONG OneToOne 1 100 0.00 4294967295.00 ECU_ADDRESS 0xD000323C /end MEASUREMENT
/begin MEASUREMENT Lub_stOpMode_mp "Aktueller Betriebspunkt" UWORD OneToOne 1 100 0.00 65535.00 ECU_ADDRESS 0xC000A4CC /end MEASUREMENT
/begin MEASUREMENT Lub_tEng_mp "Temperatur des Motors" SWORD Temp_Cels 1 100 -3549.940 3003.560 ECU_ADDRESS 0xC000A4CE /end MEASUREMENT
/begin MEASUREMENT Lub_tOil "" SWORD Temp_Cels 1 100 -3549.940 3003.560 ECU_ADDRESS 0xD00010D2 /end MEASUREMENT
/begin MEASUREMENT Lub_tOilLvl_mp "Temperatur des Motoröls" SWORD Temp_Cels 1 100 -3549.940 3003.560 ECU_ADDRESS 0xC000A4D0 /end MEASUREMENT
/begin MEASUREMENT Lub_volOilDilEng "" UWORD Vol_Oil 1 100 0.00 655.3500 FORMAT "%8.4" ECU_ADDRESS 0xD00015FC /end MEASUREMENT
/begin MEASUREMENT MeUn_cntRepActrTst_mp "Zähler für die Wiederholung der Gradientenerkennung" UBYTE OneToOne 1 100 0.00 255.0 ECU_ADDRESS 0xC000B363 /end MEASUREMENT
/begin MEASUREMENT MeUn_cntSpdActrTst_mp "Drehzahlzähler für den Stellertest der Zumesseinheit" UBYTE OneToOne 1 100 0.00 255.0 ECU_ADDRESS 0xC000B364 /end MEASUREMENT
/begin MEASUREMENT MeUn_ctRot_mp "Anzahl Funktionsaufrufe der Rotation" UBYTE OneToOne 1 100 0.00 255.0 ECU_ADDRESS 0xC000B365 /end MEASUREMENT
/begin MEASUREMENT MeUn_dvolSet "Sollwert (Volumenstrom) von der Raildruckregelung" SWORD Qp_mm3_sec 1 100 -327680.0 327670.0 FORMAT "%8.1" ECU_ADDRESS 0xD00010D4 /end MEASUREMENT
/begin MEASUREMENT MeUn_facCrntCtlLim_mp "Zumesseinheits-Stromregelung I-Anteil" SWORD Fact 1 100 -4.000000 3.999878 ECU_ADDRESS 0xC000A4E8 /end MEASUREMENT
/begin MEASUREMENT MeUn_facRefActrTst "Erkennungsschwelle für den Stellertest der Zumesseinheit" UWORD Fact1 1 100 0.00 511.9922 ECU_ADDRESS 0xD00015FE /end MEASUREMENT
/begin MEASUREMENT MeUn_iActFlt_mp "Zumesseinheits-Stromregelung gefilterter Strom-Istwert" SWORD Curr 1 100 -32768.00 32767.00 FORMAT "%8.2" ECU_ADDRESS 0xC000A4EC /end MEASUREMENT
/begin MEASUREMENT MeUn_iActVal "Analogeingang Strom-Istwert" SWORD Curr 1 100 -32768.00 32767.00 FORMAT "%8.2" ECU_ADDRESS 0xD00010D6 /end MEASUREMENT
/begin MEASUREMENT MeUn_iDvt_mp "Zumesseinheits-Stromregelung Regelabweichung" SWORD Curr 1 100 -32768.00 32767.00 FORMAT "%8.2" ECU_ADDRESS 0xC000A4EA /end MEASUREMENT
/begin MEASUREMENT MeUn_iPCVAvrgLoActrTst_mp "Durchschnittlicher Strom des Druckregelventils während des Stellertests der Zumesseinheit" SWORD Curr 1 100 -32768.00 32767.00 FORMAT "%8.2" ECU_ADDRESS 0xC000A4D2 /end MEASUREMENT
/begin MEASUREMENT MeUn_iRefActrTst_mp "Erkannter Strom des Stellertests der Zumesseinheit" SWORD Curr 1 100 -32768.00 32767.00 FORMAT "%8.2" ARRAY_SIZE 3 ECU_ADDRESS 0xC000C368 /end MEASUREMENT
/begin MEASUREMENT MeUn_iResActrTst_mp "Durchschnittlicher Strom aus drei Referenzströmen der Zumesseinheit" SWORD Curr 1 100 -32768.00 32767.00 FORMAT "%8.2" ARRAY_SIZE 4 ECU_ADDRESS 0xC000C36E /end MEASUREMENT
/begin MEASUREMENT MeUn_iSet "Sollstrom für die Zumesseinheit" SWORD Curr 1 100 -32768.00 32767.00 FORMAT "%8.2" ECU_ADDRESS 0xD00010D8 /end MEASUREMENT
/begin MEASUREMENT MeUn_iSetActrTst "Gewünschter Sollstrom für den Stellertest der Zumesseinheit" SWORD Curr 1 100 -32768.00 32767.00 FORMAT "%8.2" ECU_ADDRESS 0xD00010DA /end MEASUREMENT
/begin MEASUREMENT MeUn_iSetFlt "Zumesseinheits-Stromregelung gefilterter Strom-Sollwert" SWORD Curr 1 100 -32768.00 32767.00 FORMAT "%8.2" ECU_ADDRESS 0xD00010DC /end MEASUREMENT
/begin MEASUREMENT MeUn_iSetMaxActrTst "Obergrenze des gewünschten Sollstroms für den Stellertest der Zumesseinheit" SWORD Curr 1 100 -32768.00 32767.00 FORMAT "%8.2" ECU_ADDRESS 0xD00010DE /end MEASUREMENT
/begin MEASUREMENT MeUn_iSetMinActrTst "Untergrenze des gewünschten Sollstroms für den Stellertest der Zumesseinheit" SWORD Curr 1 100 -32768.00 32767.00 FORMAT "%8.2" ECU_ADDRESS 0xD00010E0 /end MEASUREMENT
/begin MEASUREMENT MeUn_nActrTst "Drehzahl der Testphasen für den Stellertest der Zumesseinheit" SWORD EngN 1 100 -16384.00 16383.50 ARRAY_SIZE 4 ECU_ADDRESS 0xD00010E2 /end MEASUREMENT
/begin MEASUREMENT MeUn_nDiffRef_mp "gefilterte Drehzahl für Kennlinie" SWORD EngN 1 100 -16384.00 16383.50 ECU_ADDRESS 0xC000A4D8 /end MEASUREMENT
/begin MEASUREMENT MeUn_pActrTst "Gewünschter Solldruck für den Stellertest der Zumesseinheit" SWORD Pres_Rail 1 100 -3276.800 2000.000 ARRAY_SIZE 4 ECU_ADDRESS 0xD00010EA /end MEASUREMENT
/begin MEASUREMENT MeUn_pSetPntActrTst "Solldruck für den Stellertest der Zumesseinheit" SWORD Pres_Rail 1 100 -3276.800 2000.000 ECU_ADDRESS 0xD00010F2 /end MEASUREMENT
/begin MEASUREMENT MeUn_qAvrgActrTst_mp "Durchschnittliche Einspritzmenge während des Stellertests der Zumesseinheit" SWORD InjMassCyc 1 100 -327.6800 327.6700 ECU_ADDRESS 0xC000A4D4 /end MEASUREMENT
/begin MEASUREMENT MeUn_rPsPreRot_mp "Tastverhältnis des Stromreglers der MeUn vor Rotation" SWORD DtyCyc 1 100 -327.6800 327.6700 ECU_ADDRESS 0xC000A4DA /end MEASUREMENT
/begin MEASUREMENT MeUn_rPs_mp "PWM-Signalausgang der Zumesseinheit" SWORD DtyCyc 1 100 -327.6800 327.6700 ECU_ADDRESS 0xC000A4E4 /end MEASUREMENT
/begin MEASUREMENT MeUn_rSetDT1_mp "Sollwert Tastverhältnis mit DT1-Anteil" SWORD DtyCyc 1 100 -327.6800 327.6700 ECU_ADDRESS 0xC000A4DC /end MEASUREMENT
/begin MEASUREMENT MeUn_rSetLin_mp "linearisierter Sollwert der Zumesseinheit" SWORD DtyCyc 1 100 -327.6800 327.6700 ECU_ADDRESS 0xC000A4DE /end MEASUREMENT
/begin MEASUREMENT MeUn_rSet_mp "Sollwert Tastverhältnis für Zumesseinheit" SWORD DtyCyc 1 100 -327.6800 327.6700 ECU_ADDRESS 0xC000A4E0 /end MEASUREMENT
/begin MEASUREMENT MeUn_stActrCtl_mp "Zustand der Stellwertsteuerung für die Zumesseinheit" UBYTE OneToOne 1 100 0.00 255.0 ECU_ADDRESS 0xC000B366 /end MEASUREMENT
/begin MEASUREMENT MeUn_stActrTst "Ergebnis des Stellertests der Zumesseinheit" ULONG OneToOne 1 100 0.00 4294967295.00 ECU_ADDRESS 0xD0003240 /end MEASUREMENT
/begin MEASUREMENT MeUn_stEffectActrTst "Status: der die Auswirkung des Stellertests der Zumesseinheit auf den Sollstrom durch den Zumesstest anzeigt" UBYTE OneToOne 1 100 0.00 255.0 ECU_ADDRESS 0xD0001FB9 /end MEASUREMENT
/begin MEASUREMENT MeUn_stRefActrTst "Status: der die verletzte Bedingung für einen Abbruch des Stellertests der Zumesseinheit anzeigt" UWORD OneToOne 1 100 0.00 65535.00 ECU_ADDRESS 0xD0001600 /end MEASUREMENT
/begin MEASUREMENT MeUn_stResActrTst_mp "Ergebnisstatus des Test der Zumesseinheit" UBYTE OneToOne 1 100 0.00 255.0 ARRAY_SIZE 4 ECU_ADDRESS 0xC000C376 /end MEASUREMENT
/begin MEASUREMENT MeUn_stRot "Status der Funktion Ankerrotation der Zumesseinheit" UBYTE OneToOne 1 100 0.00 255.0 ECU_ADDRESS 0xD0001FBA /end MEASUREMENT
/begin MEASUREMENT MeUn_stStMActrTst "Zustandsautomat des Stellertests der Zumesseinheit" UBYTE OneToOne 1 100 0.00 255.0 ECU_ADDRESS 0xD0001FBB /end MEASUREMENT
/begin MEASUREMENT MeUn_stZeroVolTst "Ergebnis des Nullfürdertests" UBYTE OneToOne 1 100 0.00 255.0 ECU_ADDRESS 0xD0001FBC /end MEASUREMENT
/begin MEASUREMENT MeUn_swtTstParActrTst "Schalter für die Auswahl der Parameter vom Tester (0x01) oder aus dem Datensatz (0x00)." UBYTE OneToOne 1 100 0.00 255.0 ECU_ADDRESS 0xD0001FBD /end MEASUREMENT
/begin MEASUREMENT MeUn_tiEvalActrTst_mp "Abgelaufene Zeit für den Stellertest der Zumesseinheit" SLONG Time_ms 1 100 -21474836480.0 21474836470.0 ECU_ADDRESS 0xC0009118 /end MEASUREMENT
/begin MEASUREMENT MeUn_tiPer_mp "Periodendauer der PWM-Endstufe" SWORD Period 1 100 -3276.800 3276.700 FORMAT "%8.3" ECU_ADDRESS 0xC000A4E2 /end MEASUREMENT
/begin MEASUREMENT MeUn_tiRmpDurActrTst "Rampengradient des gewünschten Stroms für den Stellertest der Zumesseinheit" SWORD Time_ms 1 100 -327680.0 327670.0 ECU_ADDRESS 0xD00010F4 /end MEASUREMENT
/begin MEASUREMENT MeUn_tiWait_mp "Abgelaufene Zeit in einem bestimmten Zustand bevor ein Übergang auf den nächsten Zustand möglich ist" SWORD Time_ms 1 100 -327680.0 327670.0 ECU_ADDRESS 0xC000A4D6 /end MEASUREMENT
/begin MEASUREMENT MeUn_uRaw_mp "Analogeingang Spannungsrohwert" SWORD Volt 1 100 -6553.600 6553.400 ECU_ADDRESS 0xC000A4E6 /end MEASUREMENT
/begin MEASUREMENT MoCADC_ctDebCmp "Fehlerzähler für Vergleich mit unabhängigem AD Wandler" UBYTE OneToOne 1 100 0.00 255.0 ECU_ADDRESS 0xD0006894 /end MEASUREMENT
/begin MEASUREMENT MoCADC_ctDebTst "Fehlerzähler für Prüfung der Testspannung" UBYTE OneToOne 1 100 0.00 255.0 ECU_ADDRESS 0xD0006895 /end MEASUREMENT
/begin MEASUREMENT MoCADC_ctDebVltgRatio "Fehlerzähler der Ratiometriekorrekturfaktor- Plausibilisierung" UBYTE OneToOne 1 100 0.00 255.0 ECU_ADDRESS 0xD0006896 /end MEASUREMENT
/begin MEASUREMENT MoCADC_ctDiagCmp "Zähler für Setzen des Testflags in der Diagnose bei der ADC Vergleichsprüfung" UBYTE OneToOne 1 100 0.00 255.0 ECU_ADDRESS 0xD0001FBE /end MEASUREMENT
/begin MEASUREMENT MoCADC_ctDiagTst "Zähler für Setzen des Testflags in der Diagnose bei der Prüfung der Testspannung in der ADC Überwachung" UBYTE OneToOne 1 100 0.00 255.0 ECU_ADDRESS 0xD0001FBF /end MEASUREMENT
/begin MEASUREMENT MoCADC_ctDiagVltgRatio "Zähler für Setzen des Testflags in der Diagnose bei der Prüfung des Ratiometriekorekturfaktors in der ADC Überwachung" UBYTE OneToOne 1 100 0.00 255.0 ECU_ADDRESS 0xD0001FC0 /end MEASUREMENT
/begin MEASUREMENT MoCADC_ctStyADC1 "Zähler für Stationärerkennung des internen AD Wandlers" UBYTE OneToOne 1 100 0.00 255.0 ECU_ADDRESS 0xD0006897 /end MEASUREMENT
/begin MEASUREMENT MoCADC_ctStyADC2 "Zähler für Stationärerkennung des externen AD Wandlers" UBYTE OneToOne 1 100 0.00 255.0 ECU_ADDRESS 0xD0006898 /end MEASUREMENT
/begin MEASUREMENT MoCADC_facVltgRatio "Ratiometriekorrekturfaktor in der Funktionsüberwachung" UWORD Mo_fac_q0p00098 1 100 0.00 63.99902 FORMAT "%8.5" ECU_ADDRESS 0xD000689C /end MEASUREMENT
/begin MEASUREMENT MoCADC_st "Status Info der ADC Überwachung" UBYTE OneToOne 1 100 0.00 255.0 ECU_ADDRESS 0xD000689E /end MEASUREMENT
/begin MEASUREMENT MoCADC_stIrvErrCmp "Irreversibles Fehlerbit aus Vergleichsprüfung in der ADC Überwachung" UBYTE OneToOne 1 100 0.00 255.0 ECU_ADDRESS 0xD0006B8C /end MEASUREMENT
/begin MEASUREMENT MoCADC_stIrvErrTst "Irreversibles Fehlerbit aus Prüfung der Testspannung in der ADC Überwachung" UBYTE OneToOne 1 100 0.00 255.0 ECU_ADDRESS 0xD0006B8D /end MEASUREMENT
/begin MEASUREMENT MoCADC_stIrvErrVltgRatio "Irreversibles Fehlerbit aus Prüfung des Ratiometriekorekturfaktors in der ADC Überwachung" UBYTE OneToOne 1 100 0.00 255.0 ECU_ADDRESS 0xD0006B8E /end MEASUREMENT
/begin MEASUREMENT MoCADC_uADC1 "Spannung von Fahrpedalsignal 2 am internen ADC" UBYTE Mo_u_mV_q12p89 1 100 0.00 3287. FORMAT "%5.0" ECU_ADDRESS 0xD0006899 /end MEASUREMENT
/begin MEASUREMENT MoCADC_uADC2 "Spannung von Fahrpedalsignal 2 am externen ADC" UBYTE Mo_u_mV_q12p89 1 100 0.00 3287. FORMAT "%5.0" ECU_ADDRESS 0xD000689A /end MEASUREMENT
/begin MEASUREMENT MoCADC_uTst_mp "Spannung am ADC Testspannungs-Eingang" SWORD Mo_u_mV_q4p88 1 100 -160000.0 159995.1 FORMAT "%8.1" ECU_ADDRESS 0xC000A4EE /end MEASUREMENT
/begin MEASUREMENT MoCCom_bCPUNew "Neue Frage für Befehlstest empfangen" UBYTE OneToOne 1 100 0.00 1.000 BIT_MASK 0x1 ECU_ADDRESS 0xD00069A9 /end MEASUREMENT
/begin MEASUREMENT MoCCom_bErrCntErr "Permanenter Fehler in der Frage-Antwort-Kommunikation mit dem Überwachungsmodul" UBYTE OneToOne 1 100 0.00 1.000 BIT_MASK 0x8 ECU_ADDRESS 0xD00069A8 /end MEASUREMENT
/begin MEASUREMENT MoCCom_bErrCntNPl "Fehlerzähler des Überwachungsmoduls nicht plausibel" UBYTE OneToOne 1 100 0.00 1.000 BIT_MASK 0x1 ECU_ADDRESS 0xD00069A8 /end MEASUREMENT
/begin MEASUREMENT MoCCom_bPCPNew "Neue Frage für PCP Überwachung empfangen" UBYTE OneToOne 1 100 0.00 1.000 BIT_MASK 0x4 ECU_ADDRESS 0xD00069A9 /end MEASUREMENT
/begin MEASUREMENT MoCCom_bPFCNew "Neue Frage für Programmablaufkontrolle empfangen" UBYTE OneToOne 1 100 0.00 1.000 BIT_MASK 0x2 ECU_ADDRESS 0xD00069A9 /end MEASUREMENT
/begin MEASUREMENT MoCCom_bSpiErr "Permanenter Fehler in der SPI Kommunikation mit dem Überwachungsmodul" UBYTE OneToOne 1 100 0.00 1.000 BIT_MASK 0x80 ECU_ADDRESS 0xD00069A8 /end MEASUREMENT
/begin MEASUREMENT MoCCom_bSpiNPl "Fehlerzähler der SPI-Kommunikation nicht plausibel" UBYTE OneToOne 1 100 0.00 1.000 BIT_MASK 0x10 ECU_ADDRESS 0xD00069A8 /end MEASUREMENT
/begin MEASUREMENT MoCCom_ctDiagErrCnt "Fehlerzähler zum Anzeigen eines nicht plausiblen FR oder ÜM zum DSM" UBYTE OneToOne 1 100 0.00 255.0 ECU_ADDRESS 0xD0001FC1 /end MEASUREMENT
/begin MEASUREMENT MoCCom_ctDiagErrSPI "Fehlerzähler zum Anzeigen eines SPI-Kommunikationsfehlers zum DSM" UBYTE OneToOne 1 100 0.00 255.0 ECU_ADDRESS 0xD0001FC2 /end MEASUREMENT
/begin MEASUREMENT MoCCom_ctErrFC "Fehlerzähler im Funktionsrechner für Fehler vom Überwachungsmodul" UBYTE OneToOne 1 100 0.00 255.0 ECU_ADDRESS 0xD00069A1 /end MEASUREMENT
/begin MEASUREMENT MoCCom_ctErrMM "Fehlerzählerrückmeldung von Überwachungsmodul" UBYTE OneToOne 1 100 0.00 255.0 ECU_ADDRESS 0xD0006998 /end MEASUREMENT
/begin MEASUREMENT MoCCom_ctErrMMMsg "Info an Ebene 1: Fehlerzählerrückmeldung von Überwachungsmodul" UBYTE OneToOne 1 100 0.00 255.0 ECU_ADDRESS 0xD0001FC3 /end MEASUREMENT
/begin MEASUREMENT MoCCom_ctErrMMOld "Alte Fehlerzählerrückmeldung von Überwachungsmodul" UBYTE OneToOne 1 100 0.00 255.0 ECU_ADDRESS 0xD0006999 /end MEASUREMENT
/begin MEASUREMENT MoCCom_ctErrSPI "Fehlerzähler für SPI Übertragungen in Kommunikation mit Überwachungsmodul" UBYTE OneToOne 1 100 0.00 255.0 ECU_ADDRESS 0xD000699A /end MEASUREMENT
/begin MEASUREMENT MoCCom_ctSOPTstActv "Zähler für die Anzahl der Aufrufe an aktiven Abschaltpfad -Test" UBYTE OneToOne 1 100 0.00 255.0 ECU_ADDRESS 0xD00069A2 /end MEASUREMENT
/begin MEASUREMENT MoCCom_Query "Erweiterte Frage von Überwachungsmodul" ULONG OneToOne 1 100 0.00 4294967295.00 ECU_ADDRESS 0xD00069A4 /end MEASUREMENT
/begin MEASUREMENT MoCCom_Response "Antwort auf Frage vom Überwachungsmodul" ULONG OneToOne 1 100 0.00 4294967295.00 ECU_ADDRESS 0xD000699C /end MEASUREMENT
/begin MEASUREMENT MoCCom_st "Status Bitleiste für Kommunikation mit Überwachungsmodul" UBYTE OneToOne 1 100 0.00 255.0 ECU_ADDRESS 0xD00069A8 /end MEASUREMENT
/begin MEASUREMENT MoCCom_stQueryNew "Bitleiste für Info 'Neue Frage von Überwachungsmodul'" UBYTE OneToOne 1 100 0.00 255.0 ECU_ADDRESS 0xD00069A9 /end MEASUREMENT
/begin MEASUREMENT MoCCom_stWDAActvMsg "Info an Ebene 1: Watchdogabschaltung aktiv" UBYTE OneToOne 1 100 0.00 255.0 ECU_ADDRESS 0xD0001FC4 /end MEASUREMENT
/begin MEASUREMENT MoCCPU_ctSeq "Sequenzzähler für Befehlstest" UBYTE OneToOne 1 100 0.00 255.0 ECU_ADDRESS 0xD00069AA /end MEASUREMENT
/begin MEASUREMENT MoCCPU_IpoIn "Eingangswert für Interpolationsroutine im Befehlstest" SWORD OneToOne 1 100 -32768.00 32767.00 ECU_ADDRESS 0xD00069AC /end MEASUREMENT
/begin MEASUREMENT MoCCPU_PartResp "Teilantwort aus Befehlstest an das Überwachungsmodul" ULONG OneToOne 1 100 0.00 4294967295.00 ECU_ADDRESS 0xD00069B4 /end MEASUREMENT
/begin MEASUREMENT MoCCPU_Query "Übernahme einer neuen Frage aus der Frage-Antwort-Kommunikation für CPU Überwachung" UBYTE OneToOne 1 100 0.00 255.0 ECU_ADDRESS 0xD00069B8 /end MEASUREMENT
/begin MEASUREMENT MoCCPU_TempRes "Zwischenergebnis des Befehlstests" ULONG OneToOne 1 100 0.00 4294967295.00 ECU_ADDRESS 0xD00069B0 /end MEASUREMENT
/begin MEASUREMENT MoCMem_adCurrent "Aktueller Adresszeiger für den zyklischen ROM-check" ULONG OneToOne 1 100 0.00 4294967295.00 ECU_ADDRESS 0xD00068A0 /end MEASUREMENT
/begin MEASUREMENT MoCMem_adRamOffset "Aktueller Offset für den zyklischen RAM-check" ULONG OneToOne 1 100 0.00 4294967295.00 ECU_ADDRESS 0xD00068A4 /end MEASUREMENT
/begin MEASUREMENT MoCMem_ctDebErrChkRAM "Fehlerzähler für Doppelablagefehler und zykischen RAM-Test" UBYTE OneToOne 1 100 0.00 255.0 ECU_ADDRESS 0xD00068A8 /end MEASUREMENT
/begin MEASUREMENT MoCMem_ctDebErrChkROM "Fehlerzähler für zykischen ROM-Test" UBYTE OneToOne 1 100 0.00 255.0 ECU_ADDRESS 0xD00068A9 /end MEASUREMENT
/begin MEASUREMENT MoCMem_ctDebHealChkRAM "Heilungszähler für Doppelablagefehler und zykischen RAM-Test" UBYTE OneToOne 1 100 0.00 255.0 ECU_ADDRESS 0xD00068AA /end MEASUREMENT
/begin MEASUREMENT MoCMem_ctDebHealChkROM "Heilungszähler für zyklischen ROM-Test" UBYTE OneToOne 1 100 0.00 255.0 ECU_ADDRESS 0xD00068AB /end MEASUREMENT
/begin MEASUREMENT MoCMem_numCurrent "Aktuelle Prüfsumme für den zyklischen ROM-check" ULONG OneToOne 1 100 0.00 4294967295.00 ECU_ADDRESS 0xD00068AC /end MEASUREMENT
/begin MEASUREMENT MoCMem_st "Anforderung eines kompletten Speichertests in der Initialisierung; Status des kompletten ROM-Speichertests" UBYTE OneToOne 1 100 0.00 255.0 ECU_ADDRESS 0xC000D7CE /end MEASUREMENT
/begin MEASUREMENT MoCMem_stFunctionSwitch "Variable schaltet zwischen überwachtem ROM-Code und ROM-Daten-Bereich um" UBYTE OneToOne 1 100 0.00 255.0 ECU_ADDRESS 0xD00068B0 /end MEASUREMENT
/begin MEASUREMENT MoCMem_stTotMemChk "Anforderung für komplette RAM/ROM-Speichertests in der Initialisierung" UBYTE OneToOne 1 100 0.00 255.0 ECU_ADDRESS 0xC000D7CC /end MEASUREMENT
/begin MEASUREMENT MoCPCP_adCurrent "Aktueller Adresszeiger für die PCP-Code-Prüfung" ULONG OneToOne 1 100 0.00 4294967295.00 ECU_ADDRESS 0xD00068B4 /end MEASUREMENT
/begin MEASUREMENT MoCPCP_ctErr "Fehlerzähler für die CRC-Prüfsummenberechnung" UBYTE OneToOne 1 100 0.00 255.0 ECU_ADDRESS 0xD00068B8 /end MEASUREMENT
/begin MEASUREMENT MoCPCP_ctHeal "Heilungszähler für CRC-Prüfsummenfehler" UBYTE OneToOne 1 100 0.00 255.0 ECU_ADDRESS 0xD00068B9 /end MEASUREMENT
/begin MEASUREMENT MoCPCP_numCurrentCSum "Aktuelle Prüfsumme für die PCP-Code-Prüfung" ULONG OneToOne 1 100 0.00 4294967295.00 ECU_ADDRESS 0xD00068BC /end MEASUREMENT
/begin MEASUREMENT MoCPFC_Checksum "Temporäres Ergebnis der Checksummenberechnung für die Programmablaufkontrolle in der Überwachung" ULONG OneToOne 1 100 0.00 4294967295.00 ECU_ADDRESS 0xD00069D8 /end MEASUREMENT
/begin MEASUREMENT MoCPFC_Checkword "Modulspezifisches Prüfwort für die Programmablaufkontrolle" ULONG OneToOne 1 100 0.00 4294967295.00 ECU_ADDRESS 0xD00069DC /end MEASUREMENT
/begin MEASUREMENT MoCPFC_Counter "Modulaufrufzähler für die Programmablaufkontrolle in der Überwachung" UBYTE OneToOne 1 100 0.00 255.0 ECU_ADDRESS 0xD00069E0 /end MEASUREMENT
/begin MEASUREMENT MoCPFC_PartResp "Teilantwort von der Programmablaufkontrolle für das Überwachungsmodul" ULONG OneToOne 1 100 0.00 4294967295.00 ECU_ADDRESS 0xD00069E4 /end MEASUREMENT
/begin MEASUREMENT MoCRam_ctMain1RamChk "Diagnosezähler für die Zeit des RAM-Checks über die Bereiche in MAIN 1" ULONG Mo_ti_us_q1p0 1 100 0.00 4294967295.00 FORMAT "%13.2" ECU_ADDRESS 0xC000C4F0 /end MEASUREMENT
/begin MEASUREMENT MoCRam_ctMain2RamChk "Diagnosezähler für die Zeit des RAM-Checks über die Bereiche in MAIN 2 (excl. Protected-RAM-Umfang)" ULONG Mo_ti_us_q1p0 1 100 0.00 4294967295.00 FORMAT "%13.2" ECU_ADDRESS 0xC000C4F4 /end MEASUREMENT
/begin MEASUREMENT MoCRam_ctMainProtRam "Diagnosezähler für die Zeit des RAM-Checks über die Bereiche des Protected-RAM's" ULONG Mo_ti_us_q1p0 1 100 0.00 4294967295.00 FORMAT "%13.2" ECU_ADDRESS 0xC000C4F8 /end MEASUREMENT
/begin MEASUREMENT MoCRam_ctRepEx "Diagnosezähler für die Zeit des RAM-Checks über die Bereiche der Wiederholungsprüfung" ULONG Mo_ti_us_q1p0 1 100 0.00 4294967295.00 FORMAT "%13.2" ECU_ADDRESS 0xC000C4FC /end MEASUREMENT
/begin MEASUREMENT MoCRam_numAreasChecked "Diagnosegröße für die Anzahl der aktuell geprüften Bereiche" UBYTE OneToOne 1 100 0.00 255.0 ECU_ADDRESS 0xC000C4EC /end MEASUREMENT
/begin MEASUREMENT MoCRam_numReset "Diagnosegröße für ausgelöste Resets während des Hochlaufes" UBYTE OneToOne 1 100 0.00 255.0 ECU_ADDRESS 0xC000C4EB /end MEASUREMENT
/begin MEASUREMENT MoCRam_stEEPInit "Diagnosegröße für in der Init übergebenen Werte für MoCMem_st aus dem EEPROM" UBYTE OneToOne 1 100 0.00 255.0 ECU_ADDRESS 0xC000C504 /end MEASUREMENT
/begin MEASUREMENT MoCRam_stProtRAMCleared "Statusvariable für Zustand Protected-RAM" UBYTE OneToOne 1 100 0.00 255.0 ECU_ADDRESS 0xC000C4E8 /end MEASUREMENT
/begin MEASUREMENT MoCRam_stRepExRam "Statusvariable ob Wiederholungsprüfung durchgeführt wurde" UBYTE OneToOne 1 100 0.00 255.0 ECU_ADDRESS 0xC000C4E9 /end MEASUREMENT
/begin MEASUREMENT MoCRom_ctRepEx_mp "Diagnosezähler für die Zeit des ROM-Checks über die Bereiche der Wiederholungsprüfung" ULONG Mo_ti_us_q1p0 1 100 0.00 4294967295.00 FORMAT "%13.2" ECU_ADDRESS 0xC000911C /end MEASUREMENT
/begin MEASUREMENT MoCRom_ctSrvWdt "Zaehler fuer die Bedienung des WatchDogs" UBYTE OneToOne 1 100 0.00 255.0 ECU_ADDRESS 0xD00069E8 /end MEASUREMENT
/begin MEASUREMENT MoCRom_KeyCode "Variable zur Deaktivierung des kompletten ROM-Checks über Code" UBYTE OneToOne 1 100 0.00 255.0 ECU_ADDRESS 0xD00069E9 /end MEASUREMENT
/begin MEASUREMENT MoCRom_KeyData "Variable zur Deaktivierung des kompletten ROM-Checks über Daten" UBYTE OneToOne 1 100 0.00 255.0 ECU_ADDRESS 0xD00069EB /end MEASUREMENT
/begin MEASUREMENT MoCRom_numRomPageErr "Fehlerhafte ROM-Page für Einfachfehler im kompletten ROM-Check" UBYTE OneToOne 1 100 0.00 255.0 ECU_ADDRESS 0xC000C508 /end MEASUREMENT
/begin MEASUREMENT MoCRom_ptrTabIndexAct "Pointer fuer aktuell zu pruefende Page des kompletten ROM-Checks" UBYTE OneToOne 1 100 0.00 255.0 ECU_ADDRESS 0xC000C50A /end MEASUREMENT
/begin MEASUREMENT MoCSOP_ctDebHwNoRdy "Anzahl der Wiederholungen bis die Hardware bereit ist um den Abschaltpfadtest durchzuführen" UBYTE OneToOne 1 100 0.00 255.0 ECU_ADDRESS 0xD00069ED /end MEASUREMENT
/begin MEASUREMENT MoCSOP_ctDebPSDia "Anzahl Wiederholungen eines Endstufentests" UBYTE OneToOne 1 100 0.00 255.0 ECU_ADDRESS 0xD00069EE /end MEASUREMENT
/begin MEASUREMENT MoCSOP_ctDebSOPTst "Anzahl der Wiederholungen des Abschaltpfadtests (Realisierung einer Zeitüberwachung)" UBYTE OneToOne 1 100 0.00 255.0 ECU_ADDRESS 0xD00069EF /end MEASUREMENT
/begin MEASUREMENT MoCSOP_ctErrMM "Kopie des Fehlerzählers aus dem Überwachungsmodul im Funktionsrechner" UBYTE OneToOne 1 100 0.00 255.0 ECU_ADDRESS 0xD00069F7 /end MEASUREMENT
/begin MEASUREMENT MoCSOP_st "Status Variable des Abschaltpfad-Tests" UBYTE OneToOne 1 100 0.00 255.0 ECU_ADDRESS 0xD00069F0 /end MEASUREMENT
/begin MEASUREMENT MoCSOP_stAct "Statusvariable zur Synchronisierung von Abschaltpfadtest und Frage-/Antwort-Kommunikation" UBYTE OneToOne 1 100 0.00 255.0 ECU_ADDRESS 0xD00069F8 /end MEASUREMENT
/begin MEASUREMENT MoCSOP_stActMsg "Kopie von Statusvariable zur Synchronisierung von Abschaltpfadtest und Frage-/Antwort-Kommunikation" UBYTE OneToOne 1 100 0.00 255.0 ECU_ADDRESS 0xD0001FC5 /end MEASUREMENT
/begin MEASUREMENT MoCSOP_stActvMsg "Information für Ebene 1,2: Abschaltpfadtest ist aktiv oder WDA-Leitung ist aktiv (Einspritzungen abgeschalten)" UBYTE OneToOne 1 100 0.00 255.0 ECU_ADDRESS 0xD0001FC6 /end MEASUREMENT
/begin MEASUREMENT MoCSOP_stErr "Status der Kommunikation via SPI-Bus zum Überwachungsmodul" UBYTE OneToOne 1 100 0.00 255.0 ECU_ADDRESS 0xD00069FA /end MEASUREMENT
/begin MEASUREMENT MoCSOP_stLdRespTab "Statusvariable ""Antwortentabelle geladen""" UBYTE OneToOne 1 100 0.00 255.0 ECU_ADDRESS 0xD00069F4 /end MEASUREMENT
/begin MEASUREMENT MoCSOP_stOvl "Statusvariable des CJ945 Überspannung-Erkennungs-latch" UBYTE OneToOne 1 100 0.00 255.0 ECU_ADDRESS 0xD00069FB /end MEASUREMENT
/begin MEASUREMENT MoCSOP_stRdy "Status-Variable zur Synchronisation von Abschaltpfadtest und Frage-/Antwort-Kommunikation (Test ist abgeschlossen)" UBYTE OneToOne 1 100 0.00 255.0 ECU_ADDRESS 0xC000D7D0 /end MEASUREMENT
/begin MEASUREMENT MoCSOP_stRdyMsg "Informationen für Ebene 1, 2 zum Status der Synchronisation des Abschatpfadtests und der Frage-Antwort-Kommunikation" UBYTE OneToOne 1 100 0.00 255.0 ECU_ADDRESS 0xD0001FC7 /end MEASUREMENT
/begin MEASUREMENT MoExe_ctCyc "10 ms Zähler für die Generierung des Schedulings für die Überwachung" UBYTE OneToOne 1 100 0.00 255.0 ECU_ADDRESS 0xD00068C0 /end MEASUREMENT
/begin MEASUREMENT MoFACC_st "Statusinformationen für ACC-Betrieb" UBYTE OneToOne 1 100 0.00 255.0 ECU_ADDRESS 0xD00068C1 /end MEASUREMENT
/begin MEASUREMENT MoFAcs_rTrqAcs "relatives zulässiges Moment der Nebenaggregate" UBYTE Mo_r_prc_q0p39 1 100 0.00 99.61 FORMAT "%5.2" ECU_ADDRESS 0xD00068C2 /end MEASUREMENT
/begin MEASUREMENT MoFAcs_rTrqAC_mp "plausibles relatives Klimakompressorverlustmoment" UBYTE Mo_r_prc_q0p39 1 100 0.00 99.61 FORMAT "%5.2" ECU_ADDRESS 0xC000B368 /end MEASUREMENT
/begin MEASUREMENT MoFAcs_rTrqAlt_mp "relatives Moment der Generatormomentenkompensation in der Überwachung" UBYTE Mo_r_prc_q0p39 1 100 0.00 99.61 FORMAT "%5.2" ECU_ADDRESS 0xC000B369 /end MEASUREMENT
/begin MEASUREMENT MoFAcs_rTrqARSPlaus_mp "" UBYTE Mo_r_prc_q0p39 1 100 0.00 99.61 FORMAT "%5.2" ECU_ADDRESS 0xC000B36A /end MEASUREMENT
/begin MEASUREMENT MoFAcs_rTrqARS_mp "relatives Moment der ARS Momentenkompensation" UBYTE Mo_r_prc_q0p39 1 100 0.00 99.61 FORMAT "%5.2" ECU_ADDRESS 0xC000B36B /end MEASUREMENT
/begin MEASUREMENT MoFAcs_rTrqLos "zulässiges Moment der fahrzeugseitigen Verluste (relativ)" UBYTE Mo_r_prc_q0p39 1 100 0.00 99.61 FORMAT "%5.2" ECU_ADDRESS 0xD00068C3 /end MEASUREMENT
/begin MEASUREMENT MoFAcs_rTrqLosPT "zulässiges Moment der Triebstrangverluste (relativ)" UBYTE Mo_r_prc_q0p39 1 100 0.00 99.61 FORMAT "%5.2" ECU_ADDRESS 0xD00068C4 /end MEASUREMENT
/begin MEASUREMENT MoFAcs_trqAcs "zulässiges Moment der Nebenaggregate" SWORD Mo_trq_nm_q0p1 1 100 -3276.800 3276.700 FORMAT "%8.3" ECU_ADDRESS 0xD00068C6 /end MEASUREMENT
/begin MEASUREMENT MoFAcs_trqAcsMsg "zulässiges Moment der Nebenaggregate der Ebene 2 an Ebene 1" SWORD Mo_trq_nm_q0p1 1 100 -3276.800 3276.700 FORMAT "%8.3" ECU_ADDRESS 0xD00010F6 /end MEASUREMENT
/begin MEASUREMENT MoFAcs_trqLosPT_mp "zulässiges Moment der Triebstrangverluste" SWORD Mo_trq_nm_q0p1 1 100 -3276.800 3276.700 FORMAT "%8.3" ECU_ADDRESS 0xC000A4F0 /end MEASUREMENT
/begin MEASUREMENT MoFAcs_trqLos_mp "zulässiges Moment der fahrzeugseitigen Verluste" SWORD Mo_trq_nm_q0p1 1 100 -3276.800 3276.700 FORMAT "%8.3" ECU_ADDRESS 0xC000A4F2 /end MEASUREMENT
/begin MEASUREMENT MoFAPP_ctDeb "Fehlerzähler bei zueinander unplausiblen Fahrpedalsignalen in der Überwachung" UBYTE Mo_ti40ms_ms_q40p0 1 100 0.00 10200. FORMAT "%5.0" ECU_ADDRESS 0xD00068C8 /end MEASUREMENT
/begin MEASUREMENT MoFAPP_ctDiag "Zähler für Setzen des Testflags in der Diagnose" UBYTE OneToOne 1 100 0.00 255.0 ECU_ADDRESS 0xD0001FC8 /end MEASUREMENT
/begin MEASUREMENT MoFAPP_stDiff_mp "Unplausibilität bei Vergleich der beiden Fahrpedalsignale" UBYTE OneToOne 1 100 0.00 255.0 ECU_ADDRESS 0xC000B36C /end MEASUREMENT
/begin MEASUREMENT MoFAPP_stIrvErr "Irreversibles Fehlerbit bei der Fahrpedalüberwachung in der Funktionsüberwachung" UBYTE OneToOne 1 100 0.00 255.0 ECU_ADDRESS 0xD0006B8F /end MEASUREMENT
/begin MEASUREMENT MoFAPP_stLimpMsg "Info für Ebene 1: Fehlerreaktion aus Ebene 2 angefordert" UBYTE OneToOne 1 100 0.00 255.0 ECU_ADDRESS 0xD0001FC9 /end MEASUREMENT
/begin MEASUREMENT MoFAPP_stTst "Kennung für Freigabebedingung der Fehlerprüfung für die Diagnose" UBYTE OneToOne 1 100 0.00 255.0 ECU_ADDRESS 0xD0001FCA /end MEASUREMENT
/begin MEASUREMENT MoFAPP_u "Position des Fahrpedals für die Funktionsüberwachung" UBYTE Mo_u_mV_q19p53 1 100 0.00 4980. FORMAT "%5.0" ECU_ADDRESS 0xD00068C9 /end MEASUREMENT
/begin MEASUREMENT MoFAPP_uRaw1_mp "Aktueller Wert für Fahrpedalsignal 1" UBYTE Mo_u_mV_q19p53 1 100 0.00 4980. FORMAT "%5.0" ECU_ADDRESS 0xC000B36D /end MEASUREMENT
/begin MEASUREMENT MoFAPP_uRaw2_mp "Aktueller Wert für Fahrpedalsignal 2" UBYTE Mo_u_mV_q9p77 1 100 0.00 2490. FORMAT "%5.0" ECU_ADDRESS 0xC000B36E /end MEASUREMENT
/begin MEASUREMENT MoFASD_rTrq "Ruckeldämpferstellgröße in der Überwachung" UBYTE Mo_r_prc_q0p39 1 100 0.00 99.61 FORMAT "%5.2" ECU_ADDRESS 0xD00068D0 /end MEASUREMENT
/begin MEASUREMENT MoFASD_trqASD_mp "Begrenzung des Ruckeldämpfereingriffs auf einen maximalen Stellbereich" SWORD Mo_trq_nm_q0p1 1 100 -3276.800 3276.700 FORMAT "%8.3" ECU_ADDRESS 0xC000A4F4 /end MEASUREMENT
/begin MEASUREMENT MoFASD_trqFlt "PT1 Filtervariable in der Ruckeldämpferüberwachung" SLONG Mo_trq_nm_q0p00000152587890625 1 100 -3276.80000000 3276.79999847 FORMAT "%13.8" ECU_ADDRESS 0xD00068CC /end MEASUREMENT
/begin MEASUREMENT MoFBrk_st "Bremsenstatus der Überwachungsfunktionen" UBYTE OneToOne 1 100 0.00 255.0 ECU_ADDRESS 0xD00068D1 /end MEASUREMENT
/begin MEASUREMENT MoFCCtl_ctShOffRmpDeb "Entprellgröße für die Fertigstellung der Abschaltrampe auf Level 1" UBYTE Mo_ti10ms_ms_q10p0 1 100 0.00 2550. FORMAT "%5.0" ECU_ADDRESS 0xD00068D2 /end MEASUREMENT
/begin MEASUREMENT MoFCCtl_st "Statusinformationen für FGR-Betrieb" UBYTE OneToOne 1 100 0.00 255.0 ECU_ADDRESS 0xD00068D6 /end MEASUREMENT
/begin MEASUREMENT MoFCCtl_stButton "Anzeigen einer gültigen Flankenerkennung an einer Taste im gegenwärtigen Raster" UBYTE OneToOne 1 100 0.00 255.0 ECU_ADDRESS 0xD00068D3 /end MEASUREMENT
/begin MEASUREMENT MoFCCtl_stEdgDet "Aktueller Status des Fahrerwunsches für die Fahrergeschwindigkeit" UBYTE OneToOne 1 100 0.00 255.0 ECU_ADDRESS 0xD00068D4 /end MEASUREMENT
/begin MEASUREMENT MoFCCtl_stIrvErr "Irreversibler Fehlerstatus des Fehlers am Tempomatbedienfeld" UBYTE OneToOne 1 100 0.00 255.0 ECU_ADDRESS 0xD00068D5 /end MEASUREMENT
/begin MEASUREMENT MoFClth_ctDeb "Entprellzähler zum Kupplungszustand" UBYTE OneToOne 1 100 0.00 255.0 ECU_ADDRESS 0xD00068D7 /end MEASUREMENT
/begin MEASUREMENT MoFClth_st "Kupplungszustand" UBYTE OneToOne 1 100 0.00 255.0 ECU_ADDRESS 0xD00068D8 /end MEASUREMENT
/begin MEASUREMENT MoFCoEng_ctMaxInt "Zähler für die maximale Dauer des LAD-Eingriffs" UBYTE OneToOne 1 100 0.00 255.0 ECU_ADDRESS 0xD00068D9 /end MEASUREMENT
/begin MEASUREMENT MoFCoEng_rTrqDiffAdap_mp "Differenz der Verlustmomente aus Ebene1 und Ebene2" UBYTE Mo_r_prc_q0p39 1 100 0.00 99.61 FORMAT "%5.2" ECU_ADDRESS 0xC000B36F /end MEASUREMENT
/begin MEASUREMENT MoFCoEng_rTrqFlt "gefilterter Wert des relativen Moments" UWORD Mo_r_prc_q0p00152 1 100 0.00 99.99847 FORMAT "%8.5" ECU_ADDRESS 0xD00068E2 /end MEASUREMENT
/begin MEASUREMENT MoFCoEng_rTrqInrSet "Relatives zulässige innere Motormoment nach dem Führungsformer" UBYTE Mo_r_prc_q0p39 1 100 0.00 99.61 FORMAT "%5.2" ECU_ADDRESS 0xD00068E4 /end MEASUREMENT
/begin MEASUREMENT MoFCoEng_rTrqInr_mp "Relatives zulässiges innere Motormoment vor dem Führungsformer" UBYTE Mo_r_prc_q0p39 1 100 0.00 99.61 FORMAT "%5.2" ECU_ADDRESS 0xC000B370 /end MEASUREMENT
/begin MEASUREMENT MoFCoEng_rTrqLos "Berechnetes Verlustmoment bis zu welchem bei LAD-Eingriff geformt wird" UBYTE Mo_r_prc_q0p39 1 100 0.00 99.61 FORMAT "%5.2" ECU_ADDRESS 0xD00068DA /end MEASUREMENT
/begin MEASUREMENT MoFCoEng_rTrqLosAdap "Adaptieres und plausibilisiertes Verlustmoment" SWORD Mo_r_prc_q0p39 1 100 -12800.00 12799.61 FORMAT "%8.2" ECU_ADDRESS 0xD00068DC /end MEASUREMENT
/begin MEASUREMENT MoFCoEng_rTrqPT1Flt "PT1 Filtervariable" UWORD Mo_r_prc_q0p00152 1 100 0.00 99.99847 FORMAT "%8.5" ECU_ADDRESS 0xD00068DE /end MEASUREMENT
/begin MEASUREMENT MoFCoEng_rTrqPtd "Relatives zulässige innere Motormoment" UBYTE Mo_r_prc_q0p39 1 100 0.00 99.61 FORMAT "%5.2" ECU_ADDRESS 0xD00068E5 /end MEASUREMENT
/begin MEASUREMENT MoFCoEng_stIntActvTO "Status eines Timeouts der maximalen Dauer des LAD-Eingriffs" UBYTE OneToOne 1 100 0.00 255.0 ECU_ADDRESS 0xD00068E0 /end MEASUREMENT
/begin MEASUREMENT MoFCoEng_stTrqFlt "Status Aktivierung/Deaktivierung der Filterung des zulässigen Moments" UBYTE OneToOne 1 100 0.00 255.0 ECU_ADDRESS 0xD00068E6 /end MEASUREMENT
/begin MEASUREMENT MoFCoEng_trqInrSet_mp "Absolutes zulässige innere Motormoment nach Führungsformer vor Ruckeldämpfer" SWORD Mo_trq_nm_q0p1 1 100 -3276.800 3276.700 FORMAT "%8.3" ECU_ADDRESS 0xC000A4F6 /end MEASUREMENT
/begin MEASUREMENT MoFCoEng_trqInr_mp "Absolutes zulässige innere Motormoment ungefiltert" SWORD Mo_trq_nm_q0p1 1 100 -3276.800 3276.700 FORMAT "%8.3" ECU_ADDRESS 0xC000A4F8 /end MEASUREMENT
/begin MEASUREMENT MoFCoEng_trqLos_mp "Absolutes delta Motorverlustmoment" SWORD Mo_trq_nm_q0p1 1 100 -3276.800 3276.700 FORMAT "%8.3" ECU_ADDRESS 0xC000A4FA /end MEASUREMENT
/begin MEASUREMENT MoFCoEng_trqPtd_mp "Absolutes zulässige innere Motormoment" SWORD Mo_trq_nm_q0p1 1 100 -3276.800 3276.700 FORMAT "%8.3" ECU_ADDRESS 0xC000A4FC /end MEASUREMENT
/begin MEASUREMENT MoFCoOfs_ctIdxDel "Verzögerungszähler in der Überwachung" UBYTE OneToOne 1 100 0.00 255.0 ECU_ADDRESS 0xD00068E7 /end MEASUREMENT
/begin MEASUREMENT MoFCoOfs_rTrqPtdDel_mp "Zulässige Motormoment inklusive Totzeit für negative Momentensprünge vor Drehzahlregler- und Ruckeldämpfereingriff" UBYTE Mo_r_prc_q0p39 1 100 0.00 99.61 FORMAT "%5.2" ECU_ADDRESS 0xC000B371 /end MEASUREMENT
/begin MEASUREMENT MoFCoOfs_rTrqPtdFlt "Gefilteretes zulässiges inneres Motormoment" UWORD Mo_r_prc_q0p00152 1 100 0.00 99.99847 FORMAT "%8.5" ECU_ADDRESS 0xD00068E8 /end MEASUREMENT
/begin MEASUREMENT MoFCoOfs_rTrqPtdMsg "Ebene 1 Schnittstelle zulässiges inneres Motormoment" UBYTE Mo_r_prc_q0p39 1 100 0.00 99.61 FORMAT "%5.2" ECU_ADDRESS 0xD0001FCB /end MEASUREMENT
/begin MEASUREMENT MoFCoOfs_rTrqPtdOfs "Relatives zulässiges inneres Motormoment mit Offset der Ebene 2" UBYTE Mo_r_prc_q0p39 1 100 0.00 99.61 FORMAT "%5.2" ECU_ADDRESS 0xD00068EA /end MEASUREMENT
/begin MEASUREMENT MoFCoOfs_rTrqPtd_mp "Zulässiges inneres Motormoment" UBYTE Mo_r_prc_q0p39 1 100 0.00 99.61 FORMAT "%5.2" ECU_ADDRESS 0xC000B372 /end MEASUREMENT
/begin MEASUREMENT MoFCoOfs_trqPtdOfs_mp "Zulässige Motormoment inklusive Offset" SWORD Mo_trq_nm_q0p1 1 100 -3276.800 3276.700 FORMAT "%8.3" ECU_ADDRESS 0xC000A4FE /end MEASUREMENT
/begin MEASUREMENT MoFCoVeh_facTrqComp_mp "Faktor zur Verlustmomentkompensation" UBYTE Mo_r_prc_q0p39 1 100 0.00 99.61 FORMAT "%5.2" ECU_ADDRESS 0xC000B373 /end MEASUREMENT
/begin MEASUREMENT MoFCoVeh_rTrqComp "Moment der kompensierten Verluste (relativ)" UBYTE Mo_r_prc_q0p39 1 100 0.00 99.61 FORMAT "%5.2" ECU_ADDRESS 0xD00068EB /end MEASUREMENT
/begin MEASUREMENT MoFCoVeh_trqCompMsg "Moment der kompensierten Verluste zur Begrenzung in der Ebene 1" SWORD Mo_trq_nm_q0p1 1 100 -3276.800 3276.700 FORMAT "%8.3" ECU_ADDRESS 0xD00010F8 /end MEASUREMENT
/begin MEASUREMENT MoFCoVeh_trqPrpClth_mp "koordiniertes Fahrerwunschmoment auf Basis Kupplungsmoment" SWORD Mo_trq_nm_q0p1 1 100 -3276.800 3276.700 FORMAT "%8.3" ECU_ADDRESS 0xC000A500 /end MEASUREMENT
/begin MEASUREMENT MoFCoVeh_trqVehPtd "zulässiges Moment der Fahrzeugfunktionen" SWORD Mo_trq_nm_q0p1 1 100 -3276.800 3276.700 FORMAT "%8.3" ECU_ADDRESS 0xD00068EC /end MEASUREMENT
/begin MEASUREMENT MoFCoVeh_trqVehPtdMsg "zulässiges Moment der Fahrzeugfunktionen zur Begrenzung in der Ebene 1" SWORD Mo_trq_nm_q0p1 1 100 -3276.800 3276.700 FORMAT "%8.3" ECU_ADDRESS 0xD00010FA /end MEASUREMENT
/begin MEASUREMENT MoFCoVeh_trqVMD_mp "koordiniertes Fahrerwunschmoment auf Basis Radmoment" SWORD Mo_trq_nm_q1p6 1 100 -52428.80 52427.20 FORMAT "%8.2" ECU_ADDRESS 0xC000A502 /end MEASUREMENT
/begin MEASUREMENT MoFDCS_stDem "Statusinfo der MSR-Eingriffüberwachung" UBYTE OneToOne 1 100 0.00 255.0 ECU_ADDRESS 0xD00068EE /end MEASUREMENT
/begin MEASUREMENT MoFDCS_stIrvErr "Irreversibles Fehlerbit aus der MSR Eingriffsüberwachung" UBYTE OneToOne 1 100 0.00 1.000 BIT_MASK 0x1 ECU_ADDRESS 0xD0006B90 /end MEASUREMENT
/begin MEASUREMENT MoFDCS_trqDem "Angefordertes Motormoment von MSR-Steuerung" SWORD Mo_trq_nm_q0p1 1 100 -3276.800 3276.700 FORMAT "%8.3" ECU_ADDRESS 0xD00068F0 /end MEASUREMENT
/begin MEASUREMENT MoFDrAs_ctDebACC "TurnOnDelay-Zähler ACC" UBYTE OneToOne 1 100 0.00 255.0 ECU_ADDRESS 0xD00068F2 /end MEASUREMENT
/begin MEASUREMENT MoFDrAs_ctDebCCtl "TurnOnDelay-Zähler FGR" UBYTE OneToOne 1 100 0.00 255.0 ECU_ADDRESS 0xD00068F3 /end MEASUREMENT
/begin MEASUREMENT MoFDrAs_stACCDel_mp "TurnOnDelay ACC aktiv" UBYTE OneToOne 1 100 0.00 255.0 ECU_ADDRESS 0xC000B374 /end MEASUREMENT
/begin MEASUREMENT MoFDrAs_stACCPtdMsg "Message zur Ebene 1 ACC-Eingriff zulässig" UBYTE OneToOne 1 100 0.00 255.0 ECU_ADDRESS 0xD0001FCC /end MEASUREMENT
/begin MEASUREMENT MoFDrAs_stActv "Status Fahrgeschwindigkeitsregler aktiv" UBYTE OneToOne 1 100 0.00 255.0 ECU_ADDRESS 0xD00068F4 /end MEASUREMENT
/begin MEASUREMENT MoFDrAs_stCCtlDel_mp "TurnOnDelay FGR aktiv" UBYTE OneToOne 1 100 0.00 255.0 ECU_ADDRESS 0xC000B375 /end MEASUREMENT
/begin MEASUREMENT MoFDrAs_stCCtlPtd "FlipFlop-Zustand FGR-Eingriff zulässig" UBYTE OneToOne 1 100 0.00 255.0 ECU_ADDRESS 0xD00068F5 /end MEASUREMENT
/begin MEASUREMENT MoFDrAs_stCCtlPtdMsg "Message zur Ebene 1 FGR-Eingriff zulässig" UBYTE OneToOne 1 100 0.00 255.0 ECU_ADDRESS 0xD0001FCD /end MEASUREMENT
/begin MEASUREMENT MoFDrAs_stLogPtd_mp "Ergebnis XOR-Logik der ACC- und FGR-Zulässigkeiten" UBYTE OneToOne 1 100 0.00 255.0 ECU_ADDRESS 0xC000B376 /end MEASUREMENT
/begin MEASUREMENT MoFDrAs_stPtdMsg "Eingiff eines Fahrerassistenzsystemes zugelassen" UBYTE OneToOne 1 100 0.00 255.0 ECU_ADDRESS 0xD0001FCE /end MEASUREMENT
/begin MEASUREMENT MoFDrAs_stTrqPtd_mp "Momenten-Freigabe in der Zwischenebene basierend ausschließlich auf der Ebene 2 Information" UBYTE OneToOne 1 100 0.00 255.0 ECU_ADDRESS 0xC000B377 /end MEASUREMENT
/begin MEASUREMENT MoFDrAs_trqPtd "Zulässiges Radmoment der Fahrerassistenzsysteme" SWORD Mo_trq_nm_q1p6 1 100 -52428.80 52427.20 FORMAT "%8.2" ECU_ADDRESS 0xD00068F6 /end MEASUREMENT
/begin MEASUREMENT MoFDrAs_vMin_mp "Ermittelte Vergleichsgeschwindigkeit zu MoFVSS_v" UWORD Mo_v_kmh_q0p01 1 100 0.00 655.3500 FORMAT "%8.4" ECU_ADDRESS 0xC000A504 /end MEASUREMENT
/begin MEASUREMENT MoFDrDem_rAPP "Fahrpedalwert der Überwachungsfunktionen" UBYTE Mo_r_prc_q0p39 1 100 0.00 99.61 FORMAT "%5.2" ECU_ADDRESS 0xD00068F9 /end MEASUREMENT
/begin MEASUREMENT MoFDrDem_rTrqMin_mp "relative Gesamt-Verlustmomente" UWORD Mo_r_prc_q0p39 1 100 0.00 25599.61 FORMAT "%8.2" ECU_ADDRESS 0xC000A506 /end MEASUREMENT
/begin MEASUREMENT MoFDrDem_rTrqPT "Übersetzungsverhältnis des Triebstranges" UWORD Mo_fac_q0p01 1 100 0.00 655.3500 FORMAT "%8.4" ECU_ADDRESS 0xD00068FA /end MEASUREMENT
/begin MEASUREMENT MoFDrDem_stTrqClth "" UBYTE OneToOne 1 100 0.00 255.0 ECU_ADDRESS 0xD00068F8 /end MEASUREMENT
/begin MEASUREMENT MoFDrDem_trqEngMax_mp "" SWORD Mo_trq_nm_q0p1 1 100 -3276.800 3276.700 FORMAT "%8.3" ECU_ADDRESS 0xC000A508 /end MEASUREMENT
/begin MEASUREMENT MoFDrDem_trqEng_mp "Fahrerwunschmoment auf Basis Kurbelwelle" SWORD Mo_trq_nm_q0p1 1 100 -3276.800 3276.700 FORMAT "%8.3" ECU_ADDRESS 0xC000A50A /end MEASUREMENT
/begin MEASUREMENT MoFDrDem_trqMin "" SWORD Mo_trq_nm_q0p1 1 100 -3276.800 3276.700 FORMAT "%8.3" ECU_ADDRESS 0xD00068FC /end MEASUREMENT
/begin MEASUREMENT MoFDrDem_trqOvrRun "" SWORD Mo_trq_nm_q0p1 1 100 -3276.800 3276.700 FORMAT "%8.3" ECU_ADDRESS 0xD00068FE /end MEASUREMENT
/begin MEASUREMENT MoFDrDem_trqOvrRunMsg "" SWORD Mo_trq_nm_q0p1 1 100 -3276.800 3276.700 FORMAT "%8.3" ECU_ADDRESS 0xD00010FC /end MEASUREMENT
/begin MEASUREMENT MoFDrDem_trqPtd "zulässiges Fahrerwunschmoment auf Basis Radmoment" SWORD Mo_trq_nm_q1p6 1 100 -52428.80 52427.20 FORMAT "%8.2" ECU_ADDRESS 0xD0006900 /end MEASUREMENT
/begin MEASUREMENT MoFESpd_ctDeb "Fehlerzähler für Motordrehzahlvergleich in der Funktionsüberwachung" UBYTE OneToOne 1 100 0.00 255.0 ECU_ADDRESS 0xD000690C /end MEASUREMENT
/begin MEASUREMENT MoFESpd_ctDiag "Zähler für Setzen des Testflags in der Diagnose" UBYTE OneToOne 1 100 0.00 255.0 ECU_ADDRESS 0xD0001FCF /end MEASUREMENT
/begin MEASUREMENT MoFESpd_nEng "Motordrehzahl in der Funktionsüberwachung" UBYTE Mo_n_rpm_q40p0 1 100 0.00 10200. FORMAT "%5.0" ECU_ADDRESS 0xD000690D /end MEASUREMENT
/begin MEASUREMENT MoFESpd_nEngL2_mp "In Funktionsüberwachung berechnete Motordrehzahl" UBYTE Mo_n_rpm_q40p0 1 100 0.00 10200. FORMAT "%5.0" ECU_ADDRESS 0xC000B378 /end MEASUREMENT
/begin MEASUREMENT MoFESpd_phiGT1Last "Winkeluhr-Stand aus vorhergehendem Aufruf der Motordrehzahl-Überwachung" ULONG OneToOne 1 100 0.00 4294967295.00 ECU_ADDRESS 0xD0006904 /end MEASUREMENT
/begin MEASUREMENT MoFESpd_stIrvErr "Irreversibles Fehlerbit beim Drehzahlvergleich in der Motordrehzahl-Überwachung" UBYTE OneToOne 1 100 0.00 255.0 ECU_ADDRESS 0xD0006B91 /end MEASUREMENT
/begin MEASUREMENT MoFESpd_stSync "Synchronisationsstatus der Drehzahlüberwachung" UBYTE OneToOne 1 100 0.00 255.0 ECU_ADDRESS 0xD000690E /end MEASUREMENT
/begin MEASUREMENT MoFESpd_stSync1 "Kennung 1 für Synchronisation in der Funktionsüberwachung" UBYTE OneToOne 1 100 0.00 255.0 ECU_ADDRESS 0xD0006A44 /end MEASUREMENT
/begin MEASUREMENT MoFESpd_stSync2 "Kennung 2 für Synchronisation in der Funktionsüberwachung" UBYTE OneToOne 1 100 0.00 255.0 ECU_ADDRESS 0xD0006A45 /end MEASUREMENT
/begin MEASUREMENT MoFESpd_stTst "Kennung für Freigabebedingung der Fehlerprüfung für die Diagnose" UBYTE OneToOne 1 100 0.00 255.0 ECU_ADDRESS 0xD0001FD0 /end MEASUREMENT
/begin MEASUREMENT MoFESpd_tiLast "Systemzeit aus vorhergehendem Aufruf der Motordrehzahl-Überwachung" ULONG OneToOne 1 100 0.00 4294967295.00 ECU_ADDRESS 0xD0006908 /end MEASUREMENT
/begin MEASUREMENT MoFETC_ctTst "Dauer des aktuellen Motortests in der Funktionsüberwachung" ULONG Mo_ti_s_q0p01 1 100 0.00 42949672.9500 FORMAT "%13.4" ECU_ADDRESS 0xD0006910 /end MEASUREMENT
/begin MEASUREMENT MoFETC_stDiagTO "Timeout der Diagnosekommunikationsschnittstelle in DiagCom" UBYTE OneToOne 1 100 0.00 255.0 ECU_ADDRESS 0xD0006914 /end MEASUREMENT
/begin MEASUREMENT MoFETC_stTst "Plausibilisierter Motorteststatus der Funktionsüberwachung" UBYTE OneToOne 1 100 0.00 255.0 ECU_ADDRESS 0xD0006915 /end MEASUREMENT
/begin MEASUREMENT MoFETC_stTstMsg "Plausibilisierter Motorteststatus aus der Ebene 2 an die Ebene 1" UBYTE OneToOne 1 100 0.00 255.0 ECU_ADDRESS 0xD0001FD1 /end MEASUREMENT
/begin MEASUREMENT MoFExtInt_ctDebDCS "Entprellzähler für Verlängerung des MSR-Eingriffs, bis der Eingriff in der Ebene 1 ausgerampt worden ist." UBYTE OneToOne 1 100 0.00 255.0 ECU_ADDRESS 0xD000691A /end MEASUREMENT
/begin MEASUREMENT MoFExtInt_ctDebTSC "Entprellzähler für Verlängerung des Getriebeeingriffs, bis der Eingriff in der Ebene 1 ausgerampt worden ist." UBYTE OneToOne 1 100 0.00 255.0 ECU_ADDRESS 0xD000691B /end MEASUREMENT
/begin MEASUREMENT MoFExtInt_stDCSPtdMsg "Status der Zulässigkeit des MSR-Eingriffs aus der Ebene 2 an die Ebene 1" UBYTE OneToOne 1 100 0.00 255.0 ECU_ADDRESS 0xD0001FD2 /end MEASUREMENT
/begin MEASUREMENT MoFExtInt_stTSCPtdMsg "" UBYTE OneToOne 1 100 0.00 255.0 ECU_ADDRESS 0xD0001FD3 /end MEASUREMENT
/begin MEASUREMENT MoFExtInt_trqLos_mp "Messpunkt des Verlustmoments (Nebenaggregate- und Motorverluste)" SWORD Mo_trq_nm_q0p1 1 100 -3276.800 3276.700 FORMAT "%8.3" ECU_ADDRESS 0xC000A50C /end MEASUREMENT
/begin MEASUREMENT MoFExtInt_trqPtd "zulässiges Moment der externen Eingriffe in der Funktionsüberwachung" SWORD Mo_trq_nm_q0p1 1 100 -3276.800 3276.700 FORMAT "%8.3" ECU_ADDRESS 0xD000691C /end MEASUREMENT
/begin MEASUREMENT MoFExtInt_trqPtdDCS "Zulässiges Moment des externen Eingriffs in der Funktionsüberwachung" SWORD Mo_trq_nm_q0p1 1 100 -3276.800 3276.700 FORMAT "%8.3" ECU_ADDRESS 0xD0006916 /end MEASUREMENT
/begin MEASUREMENT MoFExtInt_trqPtdTSC "Zulässiges Moment des Getriebe-Eingriffs in der Funktionsüberwachung" SWORD Mo_trq_nm_q0p1 1 100 -3276.800 3276.700 FORMAT "%8.3" ECU_ADDRESS 0xD0006918 /end MEASUREMENT
/begin MEASUREMENT MoFICO_ctDeb "Entprellzähler der Fehlerreaktionsüberwachung" UBYTE OneToOne 1 100 0.00 255.0 ECU_ADDRESS 0xD000691E /end MEASUREMENT
/begin MEASUREMENT MoFICO_stProtRAM "Status der Prot RAM Initialisierung der Fehlerreaktions-Überwachung" UBYTE OneToOne 1 100 0.00 255.0 ECU_ADDRESS 0xC000D7D2 /end MEASUREMENT
/begin MEASUREMENT MoFInjDat_ctDebPhiErr "Fehlerzähler Ansteuerbeginnwinkel der Ebene 1 unplausibel in der Funktionsüberwachung" UBYTE OneToOne 1 100 0.00 255.0 ECU_ADDRESS 0xD0006AE8 /end MEASUREMENT
/begin MEASUREMENT MoFInjDat_ctDebQntErr "Fehlerzähler Menge der Ebene 1 unplausibel in der Funktionsüberwachung" UBYTE OneToOne 1 100 0.00 255.0 ECU_ADDRESS 0xD0006AE9 /end MEASUREMENT
/begin MEASUREMENT MoFInjDat_ctDiagPhi "Zähler für Setzen des Testflags bei der Prüfung der Ansteuerbeginnwinkeln in der Diagnose" UBYTE OneToOne 1 100 0.00 255.0 ECU_ADDRESS 0xD0001FD4 /end MEASUREMENT
/begin MEASUREMENT MoFInjDat_ctDiagQnt "Zähler für Setzen des Testflags bei der Prüfung der Einspritzmengen in der Diagnose" UBYTE OneToOne 1 100 0.00 255.0 ECU_ADDRESS 0xD0001FD5 /end MEASUREMENT
/begin MEASUREMENT MoFInjDat_ctProc "Modulaufrufzähler MoFInjDat_GetInj" UBYTE OneToOne 1 100 0.00 255.0 ECU_ADDRESS 0xD0006A5F /end MEASUREMENT
/begin MEASUREMENT MoFInjDat_facEtaCor "Gemittelter aktueller Wirkungsgradkorrekturfaktor in der Funktionsüberwachung" SWORD Mo_fac_q0p00392 1 100 -128.5020 128.4980 FORMAT "%8.4" ECU_ADDRESS 0xD0006AEA /end MEASUREMENT
/begin MEASUREMENT MoFInjDat_facEtaCorNxt "Gemittelter künftiger Wirkungsgradkorrekturfaktor in der Funktionsüberwachung" SWORD Mo_fac_q0p00392 1 100 -128.5020 128.4980 FORMAT "%8.4" ECU_ADDRESS 0xD0006AEC /end MEASUREMENT
/begin MEASUREMENT MoFInjDat_facEtaCorNxtSum "Summenwert künftiger Wirkungsgradkorrekturfaktor der Ebene 1" SLONG Mo_fac_q0p00392 1 100 -8421504.50196 8421504.49804 FORMAT "%13.5" ECU_ADDRESS 0xD0006A60 /end MEASUREMENT
/begin MEASUREMENT MoFInjDat_facEtaCorSum "Summenwert aktueller Wirkungsgradkorrekturfaktor der Ebene 1" SLONG Mo_fac_q0p00392 1 100 -8421504.50196 8421504.49804 FORMAT "%13.5" ECU_ADDRESS 0xD0006A64 /end MEASUREMENT
/begin MEASUREMENT MoFInjDat_facPoI1EffSet "Wirkungsgrad der PoI1 aus Ebene 1 gemittelt in Ebene 2" SWORD Mo_fac_q0p00392 1 100 -128.5020 128.4980 FORMAT "%8.4" ECU_ADDRESS 0xD0006AEE /end MEASUREMENT
/begin MEASUREMENT MoFInjDat_facPoI1EffSetSum "Summenwert Wirkungsgrad der PoI1 aus Ebene 1 zur Mittelung in Ebene 2" SLONG Mo_fac_q0p00392 1 100 -8421504.50196 8421504.49804 FORMAT "%13.5" ECU_ADDRESS 0xD0006A68 /end MEASUREMENT
/begin MEASUREMENT MoFInjDat_facPoI2EffSet "Wirkungsgrad der PoI2 aus Ebene 1 gemittelt in Ebene 2" SWORD Mo_fac_q0p00392 1 100 -128.5020 128.4980 FORMAT "%8.4" ECU_ADDRESS 0xD0006AF0 /end MEASUREMENT
/begin MEASUREMENT MoFInjDat_facPoI2EffSetSum "Summenwert Wirkungsgrad der PoI2 aus Ebene 1 zur Mittelung in Ebene 2" SLONG Mo_fac_q0p00392 1 100 -8421504.50196 8421504.49804 FORMAT "%13.5" ECU_ADDRESS 0xD0006A6C /end MEASUREMENT
/begin MEASUREMENT MoFInjDat_numCylActr_mp "Zylindernummer einspritzplatzspezifisch" UBYTE OneToOne 1 100 0.00 255.0 ARRAY_SIZE 10 ECU_ADDRESS 0xC000C37A /end MEASUREMENT
/begin MEASUREMENT MoFInjDat_numInjType_mp "Einspritztyp einspritzplatzspezifisch" UBYTE OneToOne 1 100 0.00 255.0 ARRAY_SIZE 10 ECU_ADDRESS 0xC000C384 /end MEASUREMENT
/begin MEASUREMENT MoFInjDat_numRevCsAct "Anzahl Nockenwellenumdrehungen zur Mittelwertberechnung in der Funktionsüberwachung" UBYTE OneToOne 1 100 0.00 255.0 ECU_ADDRESS 0xD0006A70 /end MEASUREMENT
/begin MEASUREMENT MoFInjDat_p "Raildruck der Funktionsüberwachung (redundant n-synchron berechnet)" UBYTE Mo_p_bar_q8p0000 1 100 0.00 2000.000 ECU_ADDRESS 0xD0006AF2 /end MEASUREMENT
/begin MEASUREMENT MoFInjDat_phiEOEMI1Sum "Summenwert EOE MI1 in der Funktionsüberwachung" SLONG Mo_phi_degCrS_q0p02197 1 100 -47188800.1758 47188800.1538 FORMAT "%13.4" ECU_ADDRESS 0xD0006A74 /end MEASUREMENT
/begin MEASUREMENT MoFInjDat_phiEOEPiI1Sum "Summenwert EOE PiI1 in der Funktionsüberwachung" SLONG Mo_phi_degCrS_q0p02197 1 100 -47188800.1758 47188800.1538 FORMAT "%13.4" ECU_ADDRESS 0xD0006A78 /end MEASUREMENT
/begin MEASUREMENT MoFInjDat_phiEOEPiI2Sum "Summenwert EOE PiI2 in der Funktionsüberwachung" SLONG Mo_phi_degCrS_q0p02197 1 100 -47188800.1758 47188800.1538 FORMAT "%13.4" ECU_ADDRESS 0xD0006A7C /end MEASUREMENT
/begin MEASUREMENT MoFInjDat_phiEOEPoI2Sum "" SLONG Mo_phi_degCrS_q0p02197 1 100 -47188800.1758 47188800.1538 FORMAT "%13.4" ECU_ADDRESS 0xD0006A80 /end MEASUREMENT
/begin MEASUREMENT MoFInjDat_phiInjAct_mp "Winkel der letzten zurückgelesenen Einspritzung" SWORD Mo_phi_degCrS_q0p02197 1 100 -720.0439 720.0220 FORMAT "%8.4" ECU_ADDRESS 0xC000A50E /end MEASUREMENT
/begin MEASUREMENT MoFInjDat_phiInjBegActr_mp "Ansteuerwinkel einspritzplatzspezifisch" SWORD Mo_phi_degCrS_q0p02197 1 100 -720.0439 720.0220 FORMAT "%8.4" ARRAY_SIZE 10 ECU_ADDRESS 0xC000C38E /end MEASUREMENT
/begin MEASUREMENT MoFInjDat_phiMI1 "Gemittelter Ansteuerbeginn MI1 in der Funktionsüberwachung" SWORD Mo_phi_degCrS_q0p02197 1 100 -720.0439 720.0220 FORMAT "%8.4" ECU_ADDRESS 0xD0006AF4 /end MEASUREMENT
/begin MEASUREMENT MoFInjDat_phiMI1Sum "Summenwert MI1 in der Funktionsüberwachung" SLONG Mo_phi_degCrS_q0p02197 1 100 -47188800.1758 47188800.1538 FORMAT "%13.4" ECU_ADDRESS 0xD0006A84 /end MEASUREMENT
/begin MEASUREMENT MoFInjDat_phiPiI1 "Gemittelter Ansteuerbeginn PiI1 in der Funktionsüberwachung" SWORD Mo_phi_degCrS_q0p02197 1 100 -720.0439 720.0220 FORMAT "%8.4" ECU_ADDRESS 0xD0006AF6 /end MEASUREMENT
/begin MEASUREMENT MoFInjDat_phiPiI1Sum "Summenwert PiI1 in der Funktionsüberwachung" SLONG Mo_phi_degCrS_q0p02197 1 100 -47188800.1758 47188800.1538 FORMAT "%13.4" ECU_ADDRESS 0xD0006A88 /end MEASUREMENT
/begin MEASUREMENT MoFInjDat_phiPiI2 "Gemittelter Ansteuerbeginn PiI2 in der Funktionsüberwachung" SWORD Mo_phi_degCrS_q0p02197 1 100 -720.0439 720.0220 FORMAT "%8.4" ECU_ADDRESS 0xD0006AF8 /end MEASUREMENT
/begin MEASUREMENT MoFInjDat_phiPiI2Sum "Summenwert PiI2 in der Funktionsüberwachung" SLONG Mo_phi_degCrS_q0p02197 1 100 -47188800.1758 47188800.1538 FORMAT "%13.4" ECU_ADDRESS 0xD0006A8C /end MEASUREMENT
/begin MEASUREMENT MoFInjDat_phiPiI3 "Gemittelter Ansteuerbeginn PiI3 in der Funktionsüberwachung" SWORD Mo_phi_degCrS_q0p02197 1 100 -720.0439 720.0220 FORMAT "%8.4" ECU_ADDRESS 0xD0006AFA /end MEASUREMENT
/begin MEASUREMENT MoFInjDat_phiPiI3Sum "Summenwert PiI3 in der Funktionsüberwachung" SLONG Mo_phi_degCrS_q0p02197 1 100 -47188800.1758 47188800.1538 FORMAT "%13.4" ECU_ADDRESS 0xD0006A90 /end MEASUREMENT
/begin MEASUREMENT MoFInjDat_phiPoI1 "Gemittelter Ansteuerbeginn PoI1 in der Funktionsüberwachung" SWORD Mo_phi_degCrS_q0p02197 1 100 -720.0439 720.0220 FORMAT "%8.4" ECU_ADDRESS 0xD0006AFC /end MEASUREMENT
/begin MEASUREMENT MoFInjDat_phiPoI1Sum "Summenwert PoI1 in der Funktionsüberwachung" SLONG Mo_phi_degCrS_q0p02197 1 100 -47188800.1758 47188800.1538 FORMAT "%13.4" ECU_ADDRESS 0xD0006A94 /end MEASUREMENT
/begin MEASUREMENT MoFInjDat_phiPoI2 "Gemittelter Ansteuerbeginn PoI2 in der Funktionsüberwachung" SWORD Mo_phi_degCrS_q0p02197 1 100 -720.0439 720.0220 FORMAT "%8.4" ECU_ADDRESS 0xD0006AFE /end MEASUREMENT
/begin MEASUREMENT MoFInjDat_phiPoI2Sum "Summenwert PoI2 in der Funktionsüberwachung" SLONG Mo_phi_degCrS_q0p02197 1 100 -47188800.1758 47188800.1538 FORMAT "%13.4" ECU_ADDRESS 0xD0006A98 /end MEASUREMENT
/begin MEASUREMENT MoFInjDat_pLinCurr_mp "linearisierter Wert für Raildruck in der Funktionsüberwachung" UBYTE Mo_p_bar_q8p0000 1 100 0.00 2000.000 ECU_ADDRESS 0xC000B379 /end MEASUREMENT
/begin MEASUREMENT MoFInjDat_pSum "Summenwert Raildruck der Funktionsüberwachung (redundant n-synchron berechnet)" UWORD Mo_p_bar_q8p0000 1 100 0.00 2000.000 FORMAT "%5.3" ECU_ADDRESS 0xD0006A9C /end MEASUREMENT
/begin MEASUREMENT MoFInjDat_qAdjQnt "gemittelte Abgleichemenge aus dem Diagnoseabgleich" SWORD Mo_q_mg_q0p01 1 100 -327.6800 327.6700 FORMAT "%8.4" ECU_ADDRESS 0xD0006B00 /end MEASUREMENT
/begin MEASUREMENT MoFInjDat_qAdjQntSum "Abgleichsmengensumme aus dem Diagnoseabgleich" SWORD Mo_q_mg_q0p01 1 100 -327.6800 327.6700 FORMAT "%8.4" ECU_ADDRESS 0xD0006A9E /end MEASUREMENT
/begin MEASUREMENT MoFInjDat_qDriftLim2 "gemittelte Driftabgleichsmenge aus dem Diagnoseabgleich" SWORD Mo_q_mg_q0p01 1 100 -327.6800 327.6700 FORMAT "%8.4" ECU_ADDRESS 0xD0006B02 /end MEASUREMENT
/begin MEASUREMENT MoFInjDat_qDriftLim2Sum "Driftabgleichsmengensumme aus dem Diagnoseabgleich" SWORD Mo_q_mg_q0p01 1 100 -327.6800 327.6700 FORMAT "%8.4" ECU_ADDRESS 0xD0006AA0 /end MEASUREMENT
/begin MEASUREMENT MoFInjDat_qMI1WvCor "Gemittelte Wellenkorrekturmenge MI1 in der Funktionsüberwachung" SWORD Mo_q_mg_q0p01 1 100 -327.6800 327.6700 FORMAT "%8.4" ECU_ADDRESS 0xD0006B04 /end MEASUREMENT
/begin MEASUREMENT MoFInjDat_qMI1WvCorSum "Summenwert Wellenkorrekturmenge MI1 der Ebene 1" SLONG Mo_q_mg_q0p01 1 100 -21474836.4800 21474836.4700 FORMAT "%13.4" ECU_ADDRESS 0xD0006AA4 /end MEASUREMENT
/begin MEASUREMENT MoFInjDat_qPiI1WvCor "Gemittelte Wellenkorrekturmenge PiI1 in der Funktionsüberwachung" SWORD Mo_q_mg_q0p01 1 100 -327.6800 327.6700 FORMAT "%8.4" ECU_ADDRESS 0xD0006B06 /end MEASUREMENT
/begin MEASUREMENT MoFInjDat_qPiI1WvCorSum "Summenwert Wellenkorrekturmenge PiI1 der Ebene 1" SLONG Mo_q_mg_q0p01 1 100 -21474836.4800 21474836.4700 FORMAT "%13.4" ECU_ADDRESS 0xD0006AA8 /end MEASUREMENT
/begin MEASUREMENT MoFInjDat_qPoI1WvCor "" SWORD Mo_q_mg_q0p01 1 100 -327.6800 327.6700 FORMAT "%8.4" ECU_ADDRESS 0xD0006B08 /end MEASUREMENT
/begin MEASUREMENT MoFInjDat_qPoI1WvCorSum "" SLONG Mo_q_mg_q0p01 1 100 -21474836.4800 21474836.4700 FORMAT "%13.4" ECU_ADDRESS 0xD0006AAC /end MEASUREMENT
/begin MEASUREMENT MoFInjDat_qPoI2WvCor "Gemittelte Wellenkorrekturmenge PoI2 in der Funktionsüberwachung" SWORD Mo_q_mg_q0p01 1 100 -327.6800 327.6700 FORMAT "%8.4" ECU_ADDRESS 0xD0006B0A /end MEASUREMENT
/begin MEASUREMENT MoFInjDat_qPoI2WvCorSum "Summenwert Wellenkorrekturmenge PoI2 der Ebene 1" SLONG Mo_q_mg_q0p01 1 100 -21474836.4800 21474836.4700 FORMAT "%13.4" ECU_ADDRESS 0xD0006AB0 /end MEASUREMENT
/begin MEASUREMENT MoFInjDat_stChkSum "Checksumme der Variablen in MoFInjDat_GetInj" ULONG OneToOne 1 100 0.00 4294967295.00 ECU_ADDRESS 0xD0006B0C /end MEASUREMENT
/begin MEASUREMENT MoFInjDat_stInjState "Statusinformation über laufende Einspritzungen" UBYTE OneToOne 1 100 0.00 255.0 ECU_ADDRESS 0xD0006B10 /end MEASUREMENT
/begin MEASUREMENT MoFInjDat_stIrvErrPhi "Irreversibles Fehlerbit bei unplausiblen Ansteuerbeginnwinkeln für die Diagnose" UBYTE OneToOne 1 100 0.00 255.0 ECU_ADDRESS 0xD0006B92 /end MEASUREMENT
/begin MEASUREMENT MoFInjDat_stIrvErrQnt "Irreversibles Fehlerbit bei unplausiblen Einspritzmengen für die Diagnose" UBYTE OneToOne 1 100 0.00 255.0 ECU_ADDRESS 0xD0006B93 /end MEASUREMENT
/begin MEASUREMENT MoFInjDat_stPressSRC "Status der Raildruckerfassung in MoFInjDat" UBYTE OneToOne 1 100 0.00 255.0 ECU_ADDRESS 0xD0006B11 /end MEASUREMENT
/begin MEASUREMENT MoFInjDat_stTstPhi "Status der Winkelplausibilisierung (für Diagnose)" UBYTE OneToOne 1 100 0.00 255.0 ECU_ADDRESS 0xD0001FD6 /end MEASUREMENT
/begin MEASUREMENT MoFInjDat_stTstQnt "Status der Mengenplausibilisierung (für Diagnose)" UBYTE OneToOne 1 100 0.00 255.0 ECU_ADDRESS 0xD0001FD7 /end MEASUREMENT
/begin MEASUREMENT MoFInjDat_tCor "Kraftstofftemperatur der Druckwellenkorrektur in der Funktionsüberwachung" SWORD Mo_t_DegC_q0p8o48 1 100 -26262.40 26165.60 FORMAT "%8.2" ECU_ADDRESS 0xD0006B12 /end MEASUREMENT
/begin MEASUREMENT MoFInjDat_tiInjAct_mp "Ansteuerdauer der letzten zurückgelesenen Einspritzung" SWORD Mo_ti_us_q0p4 1 100 -13107.20 13106.80 FORMAT "%8.2" ECU_ADDRESS 0xC000A510 /end MEASUREMENT
/begin MEASUREMENT MoFInjDat_tiInjDurActr_mp "Ansteuerdauern einspritzplatzspezifisch" SWORD Mo_ti_us_q0p4 1 100 -13107.20 13106.80 FORMAT "%8.2" ARRAY_SIZE 10 ECU_ADDRESS 0xC000C3A2 /end MEASUREMENT
/begin MEASUREMENT MoFInjDat_tiMI1 "Gemittelte Ansteuerdauer MI1 in der Funktionsüberwachung" SWORD Mo_ti_us_q0p4 1 100 -13107.20 13106.80 FORMAT "%8.2" ECU_ADDRESS 0xD0006B14 /end MEASUREMENT
/begin MEASUREMENT MoFInjDat_tiMI1PoI1 "Zeitabstand zwischen EOE MI1 und SOE PoI1" SWORD Mo_ti_us_q0p4 1 100 -13107.20 13106.80 FORMAT "%8.2" ECU_ADDRESS 0xD0006B16 /end MEASUREMENT
/begin MEASUREMENT MoFInjDat_tiMI1PoI2 "Zeitabstand zwischen EOE MI1 und SOE PoI2" SWORD Mo_ti_us_q0p4 1 100 -13107.20 13106.80 FORMAT "%8.2" ECU_ADDRESS 0xD0006B18 /end MEASUREMENT
/begin MEASUREMENT MoFInjDat_tiMI1Sum "Summenwert Ansteuerdauer MI1 in der Funktionsüberwachung" SLONG Mo_ti_us_q0p4 1 100 -858993459.200 858993458.800 FORMAT "%13.3" ECU_ADDRESS 0xD0006AB4 /end MEASUREMENT
/begin MEASUREMENT MoFInjDat_tiPiI1 "Gemittelte Ansteuerdauer PiI1 in der Funktionsüberwachung" SWORD Mo_ti_us_q0p4 1 100 -13107.20 13106.80 FORMAT "%8.2" ECU_ADDRESS 0xD0006B1A /end MEASUREMENT
/begin MEASUREMENT MoFInjDat_tiPiI1MI1 "Zeitabstand zwischen EOE PiI1 und SOE MI1" SWORD Mo_ti_us_q0p4 1 100 -13107.20 13106.80 FORMAT "%8.2" ECU_ADDRESS 0xD0006B1C /end MEASUREMENT
/begin MEASUREMENT MoFInjDat_tiPiI1Sum "Summenwert Ansteuerdauer PiI1 in der Funktionsüberwachung" SLONG Mo_ti_us_q0p4 1 100 -858993459.200 858993458.800 FORMAT "%13.3" ECU_ADDRESS 0xD0006AB8 /end MEASUREMENT
/begin MEASUREMENT MoFInjDat_tiPiI1ZFCETCor "Gemittelte Nullmengenkalibrieransteuerdauer Pi1 der Ebene 1" SWORD Mo_ti_us_q0p4 1 100 -13107.20 13106.80 FORMAT "%8.2" ECU_ADDRESS 0xD0006B1E /end MEASUREMENT
/begin MEASUREMENT MoFInjDat_tiPiI1ZFCETCorSum "Summenwert Nullmengenkalibrieransteuerdauer Pi1 der Ebene 1" SLONG Mo_ti_us_q0p4 1 100 -858993459.200 858993458.800 FORMAT "%13.3" ECU_ADDRESS 0xD0006ABC /end MEASUREMENT
/begin MEASUREMENT MoFInjDat_tiPiI2 "Gemittelte Ansteuerdauer PiI2 in der Funktionsüberwachung" SWORD Mo_ti_us_q0p4 1 100 -13107.20 13106.80 FORMAT "%8.2" ECU_ADDRESS 0xD0006B20 /end MEASUREMENT
/begin MEASUREMENT MoFInjDat_tiPiI2MI1 "Zeitabstand zwischen EOE PiI2 und SOE MI1" SWORD Mo_ti_us_q0p4 1 100 -13107.20 13106.80 FORMAT "%8.2" ECU_ADDRESS 0xD0006B22 /end MEASUREMENT
/begin MEASUREMENT MoFInjDat_tiPiI2PiI1 "Zeitabstand zwischen EOE PiI2 und SOE PiI1" SWORD Mo_ti_us_q0p4 1 100 -13107.20 13106.80 FORMAT "%8.2" ECU_ADDRESS 0xD0006B24 /end MEASUREMENT
/begin MEASUREMENT MoFInjDat_tiPiI2Sum "Summenwert Ansteuerdauer PiI2 in der Funktionsüberwachung" SLONG Mo_ti_us_q0p4 1 100 -858993459.200 858993458.800 FORMAT "%13.3" ECU_ADDRESS 0xD0006AC0 /end MEASUREMENT
/begin MEASUREMENT MoFInjDat_tiPiI2ZFCETCor "Gemittelte Nullmengenkalibrieransteuerdauer Pi2 der Ebene 1" SWORD Mo_ti_us_q0p4 1 100 -13107.20 13106.80 FORMAT "%8.2" ECU_ADDRESS 0xD0006B26 /end MEASUREMENT
/begin MEASUREMENT MoFInjDat_tiPiI2ZFCETCorSum "Summenwert Nullmengenkalibrieransteuerdauer Pi2 der Ebene 1" SLONG Mo_ti_us_q0p4 1 100 -858993459.200 858993458.800 FORMAT "%13.3" ECU_ADDRESS 0xD0006AC4 /end MEASUREMENT
/begin MEASUREMENT MoFInjDat_tiPiI3 "Gemittelte Ansteuerdauer PiI2 in der Funktionsüberwachung" SWORD Mo_ti_us_q0p4 1 100 -13107.20 13106.80 FORMAT "%8.2" ECU_ADDRESS 0xD0006B28 /end MEASUREMENT
/begin MEASUREMENT MoFInjDat_tiPiI3Sum "Summenwert Ansteuerdauer PiI3 in der Funktionsüberwachung" SLONG Mo_ti_us_q0p4 1 100 -858993459.200 858993458.800 FORMAT "%13.3" ECU_ADDRESS 0xD0006AC8 /end MEASUREMENT
/begin MEASUREMENT MoFInjDat_tiPiI3ZFCETCor "Gemittelte Nullmengenkalibrieransteuerdauer Pi3 der Ebene 1" SWORD Mo_ti_us_q0p4 1 100 -13107.20 13106.80 FORMAT "%8.2" ECU_ADDRESS 0xD0006B2A /end MEASUREMENT
/begin MEASUREMENT MoFInjDat_tiPiI3ZFCETCorSum "Summenwert Nullmengenkalibrieransteuerdauer Pi3 der Ebene 1" SLONG Mo_ti_us_q0p4 1 100 -858993459.200 858993458.800 FORMAT "%13.3" ECU_ADDRESS 0xD0006ACC /end MEASUREMENT
/begin MEASUREMENT MoFInjDat_tiPoI1 "Gemittelte Ansteuerdauer PoI1 in der Funktionsüberwachung" SWORD Mo_ti_us_q0p4 1 100 -13107.20 13106.80 FORMAT "%8.2" ECU_ADDRESS 0xD0006B2C /end MEASUREMENT
/begin MEASUREMENT MoFInjDat_tiPoI1Sum "Summenwert Ansteuerdauer PoI1 in der Funktionsüberwachung" SLONG Mo_ti_us_q0p4 1 100 -858993459.200 858993458.800 FORMAT "%13.3" ECU_ADDRESS 0xD0006AD0 /end MEASUREMENT
/begin MEASUREMENT MoFInjDat_tiPoI1ZFCETCor "" SWORD Mo_ti_us_q0p4 1 100 -13107.20 13106.80 FORMAT "%8.2" ECU_ADDRESS 0xD0006B2E /end MEASUREMENT
/begin MEASUREMENT MoFInjDat_tiPoI1ZFCETCorSum "" SLONG Mo_ti_us_q0p4 1 100 -858993459.200 858993458.800 FORMAT "%13.3" ECU_ADDRESS 0xD0006AD4 /end MEASUREMENT
/begin MEASUREMENT MoFInjDat_tiPoI2 "Gemittelte Ansteuerdauer PoI2 in der Funktionsüberwachung" SWORD Mo_ti_us_q0p4 1 100 -13107.20 13106.80 FORMAT "%8.2" ECU_ADDRESS 0xD0006B30 /end MEASUREMENT
/begin MEASUREMENT MoFInjDat_tiPoI2PoI1 "" SWORD Mo_ti_us_q0p4 1 100 -13107.20 13106.80 FORMAT "%8.2" ECU_ADDRESS 0xD0006B32 /end MEASUREMENT
/begin MEASUREMENT MoFInjDat_tiPoI2Sum "Summenwert Ansteuerdauer PoI2 in der Funktionsüberwachung" SLONG Mo_ti_us_q0p4 1 100 -858993459.200 858993458.800 FORMAT "%13.3" ECU_ADDRESS 0xD0006AD8 /end MEASUREMENT
/begin MEASUREMENT MoFInjDat_tiPoI2ZFCETCor "" SWORD Mo_ti_us_q0p4 1 100 -13107.20 13106.80 FORMAT "%8.2" ECU_ADDRESS 0xD0006B34 /end MEASUREMENT
/begin MEASUREMENT MoFInjDat_tiPoI2ZFCETCorSum "" SLONG Mo_ti_us_q0p4 1 100 -858993459.200 858993458.800 FORMAT "%13.3" ECU_ADDRESS 0xD0006ADC /end MEASUREMENT
/begin MEASUREMENT MoFInjDat_tiTDCAvrg "Mittelwert der durchschnittlichen momentenwirksamen Ansteuerdauer pro Zylinder" SWORD Mo_ti_us_q0p4 1 100 -13107.20 13106.80 FORMAT "%8.2" ECU_ADDRESS 0xD0006B36 /end MEASUREMENT
/begin MEASUREMENT MoFInjDat_tiTDCSumET_mp "Summe der momentenwirksamen Ansteuerdauer zylinderspezifisch" SWORD Mo_ti_us_q0p4 1 100 -13107.20 13106.80 FORMAT "%8.2" ARRAY_SIZE 6 ECU_ADDRESS 0xC000C3B6 /end MEASUREMENT
/begin MEASUREMENT MoFInjDat_trqASD "Gemitteltes Ruckeldämpfereingriffsmoment in der Funktionsüberwachung" SWORD Mo_trq_nm_q0p1 1 100 -3276.800 3276.700 FORMAT "%8.3" ECU_ADDRESS 0xD0006B38 /end MEASUREMENT
/begin MEASUREMENT MoFInjDat_trqASDSum "Summenwert Ruckeldämpfereingriffsmoment der Ebene 1" SLONG Mo_trq_nm_q0p1 1 100 -214748364.800 214748364.700 FORMAT "%13.3" ECU_ADDRESS 0xD0006AE0 /end MEASUREMENT
/begin MEASUREMENT MoFInjDat_trqSpdG "Gemitteltes Leerlaufreglereingriffsmoment in der Funktionsüberwachung" SWORD Mo_trq_nm_q0p1 1 100 -3276.800 3276.700 FORMAT "%8.3" ECU_ADDRESS 0xD0006B3A /end MEASUREMENT
/begin MEASUREMENT MoFInjDat_trqSpdGSum "Summenwert Leerlaufreglereingriffsmoment der Ebene 1" SLONG Mo_trq_nm_q0p1 1 100 -214748364.800 214748364.700 FORMAT "%13.3" ECU_ADDRESS 0xD0006AE4 /end MEASUREMENT
/begin MEASUREMENT MoFInjDat_uRaw_mp "Rohspannungswert des Raildrucksensor in der Funktionsüberwachung" UBYTE Mo_u_mV_q19p53 1 100 0.00 4980. FORMAT "%5.0" ECU_ADDRESS 0xC000B37A /end MEASUREMENT
/begin MEASUREMENT MoFInjQnt_ctDebErr "Entprellzähler Fehlerreaktion aus MoFInjQnt in der Funktionsüberwachung" UBYTE OneToOne 1 100 0.00 255.0 ECU_ADDRESS 0xD000691F /end MEASUREMENT
/begin MEASUREMENT MoFInjQnt_ctDiag "Zähler für Setzen des Testflags in der Diagnose" UBYTE OneToOne 1 100 0.00 255.0 ECU_ADDRESS 0xD0001FD8 /end MEASUREMENT
/begin MEASUREMENT MoFInjQnt_qMI1Cor "Einspritzmenge MI1 vor Korrektur der Funktionsüberwachung" SWORD Mo_q_mg_q0p01 1 100 -327.6800 327.6700 FORMAT "%8.4" ECU_ADDRESS 0xD0006920 /end MEASUREMENT
/begin MEASUREMENT MoFInjQnt_qPiI1Cor "Einspritzmenge PiI1 vor Korrektur der Funktionsüberwachung" SWORD Mo_q_mg_q0p01 1 100 -327.6800 327.6700 FORMAT "%8.4" ECU_ADDRESS 0xD0006922 /end MEASUREMENT
/begin MEASUREMENT MoFInjQnt_qPiI2Cor "Einspritzmenge PiI2 vor Korrektur in der Funktionsüberwachung" SWORD Mo_q_mg_q0p01 1 100 -327.6800 327.6700 FORMAT "%8.4" ECU_ADDRESS 0xD0006924 /end MEASUREMENT
/begin MEASUREMENT MoFInjQnt_qPiI3Cor "Einspritzmenge PiI3 vor Korrektur in der Funktionsüberwachung" SWORD Mo_q_mg_q0p01 1 100 -327.6800 327.6700 FORMAT "%8.4" ECU_ADDRESS 0xD0006926 /end MEASUREMENT
/begin MEASUREMENT MoFInjQnt_qPoI1Cor "Einspritzmenge PoI1 vor Korrektur der Funktionsüberwachung" SWORD Mo_q_mg_q0p01 1 100 -327.6800 327.6700 FORMAT "%8.4" ECU_ADDRESS 0xD0006928 /end MEASUREMENT
/begin MEASUREMENT MoFInjQnt_qPoI2Cor "Einspritzmenge PoI2 vor Korrektur der Funktionsüberwachung" SWORD Mo_q_mg_q0p01 1 100 -327.6800 327.6700 FORMAT "%8.4" ECU_ADDRESS 0xD000692A /end MEASUREMENT
/begin MEASUREMENT MoFInjQnt_stChk_mp "Status der Checksummenprüfung beim Auslesen der IMA-Werte aus EEPROM Spiegel" UBYTE OneToOne 1 100 0.00 255.0 ARRAY_SIZE 6 ECU_ADDRESS 0xC000C3C2 /begin ANNOTATION /end ANNOTATION /end MEASUREMENT
/begin MEASUREMENT MoFInjQnt_stIrvErr "Irreversibles Fehlerbit bei unplausiblen NMK Ansteuerdauern für die Diagnose" UBYTE OneToOne 1 100 0.00 255.0 ECU_ADDRESS 0xD0006B94 /end MEASUREMENT
/begin MEASUREMENT MoFInjQnt_tiPiIZFCETMax_mp "" SWORD Mo_ti_us_q0p4 1 100 -13107.20 13106.80 FORMAT "%8.2" ECU_ADDRESS 0xC000A512 /end MEASUREMENT
/begin MEASUREMENT MoFInjQnt_tiPiIZFCETMin_mp "" SWORD Mo_ti_us_q0p4 1 100 -13107.20 13106.80 FORMAT "%8.2" ECU_ADDRESS 0xC000A514 /end MEASUREMENT
/begin MEASUREMENT MoFInjQnt_tiPoIZFCETMax_mp "" SWORD Mo_ti_us_q0p4 1 100 -13107.20 13106.80 FORMAT "%8.2" ECU_ADDRESS 0xC000A516 /end MEASUREMENT
/begin MEASUREMENT MoFInjQnt_tiPoIZFCETMin_mp "" SWORD Mo_ti_us_q0p4 1 100 -13107.20 13106.80 FORMAT "%8.2" ECU_ADDRESS 0xC000A518 /end MEASUREMENT
/begin MEASUREMENT MoFInjQnt_volCor "Abgleichwerte Injektormengenabgleich im Zylindermittel in der Funktionsüberwachung" SWORD Mo_vol_mm3_q0p01 1 100 -327.6800 327.6700 FORMAT "%8.4" ARRAY_SIZE 8 ECU_ADDRESS 0xC000C3D8 /end MEASUREMENT
/begin MEASUREMENT MoFInjQnt_volMI1QntAdj_mp "Injektormengenabgleich Korrekturvolumen der MI1 in der Funktionsüberwachung" SWORD Mo_vol_mm3_q0p01 1 100 -327.6800 327.6700 FORMAT "%8.4" ECU_ADDRESS 0xC000A51A /end MEASUREMENT
/begin MEASUREMENT MoFInjQnt_volMI1UnCor_mp "Einspritzvolumen MI1 vor Injektormengenabgleich Korrektur in der Funktionsüberwachung" SWORD Mo_vol_mm3_q0p01 1 100 -327.6800 327.6700 FORMAT "%8.4" ECU_ADDRESS 0xC000A51C /end MEASUREMENT
/begin MEASUREMENT MoFInjQnt_volPiI1QntAdj_mp "Injektormengenabgleich Korrekturvolumen der PiI1 in der Funktionsüberwachung" SWORD Mo_vol_mm3_q0p01 1 100 -327.6800 327.6700 FORMAT "%8.4" ECU_ADDRESS 0xC000A51E /end MEASUREMENT
/begin MEASUREMENT MoFInjQnt_volPiI1UnCor_mp "Einspritzvolumen PiI1 vor Injektormengenabgleich Korrektur in der Funktionsüberwachung" SWORD Mo_vol_mm3_q0p01 1 100 -327.6800 327.6700 FORMAT "%8.4" ECU_ADDRESS 0xC000A520 /end MEASUREMENT
/begin MEASUREMENT MoFInjQnt_volPiI2QntAdj_mp "Injektormengenabgleich Korrekturvolumen der PiI2 in der Funktionsüberwachung" SWORD Mo_vol_mm3_q0p01 1 100 -327.6800 327.6700 FORMAT "%8.4" ECU_ADDRESS 0xC000A522 /end MEASUREMENT
/begin MEASUREMENT MoFInjQnt_volPiI2UnCor_mp "Einspritzvolumen PiI2 vor Injektormengenabgleich Korrektur in der Funktionsüberwachung" SWORD Mo_vol_mm3_q0p01 1 100 -327.6800 327.6700 FORMAT "%8.4" ECU_ADDRESS 0xC000A524 /end MEASUREMENT
/begin MEASUREMENT MoFInjQnt_volPiI3QntAdj_mp "Injektormengenabgleich Korrekturvolumen der PiI3 in der Funktionsüberwachung" SWORD Mo_vol_mm3_q0p01 1 100 -327.6800 327.6700 FORMAT "%8.4" ECU_ADDRESS 0xC000A526 /end MEASUREMENT
/begin MEASUREMENT MoFInjQnt_volPiI3UnCor_mp "Einspritzvolumen PiI3 vor Injektormengenabgleich Korrektur in der Funktionsüberwachung" SWORD Mo_vol_mm3_q0p01 1 100 -327.6800 327.6700 FORMAT "%8.4" ECU_ADDRESS 0xC000A528 /end MEASUREMENT
/begin MEASUREMENT MoFInjQnt_volPoI1QntAdj_mp "Injektormengenabgleich Korrekturvolumen der PoI1 in der Funktionsüberwachung" SWORD Mo_vol_mm3_q0p01 1 100 -327.6800 327.6700 FORMAT "%8.4" ECU_ADDRESS 0xC000A52A /end MEASUREMENT
/begin MEASUREMENT MoFInjQnt_volPoI1UnCor_mp "Einspritzvolumen PoI1 vor Injektormengenabgleich Korrektur in der Funktionsüberwachung" SWORD Mo_vol_mm3_q0p01 1 100 -327.6800 327.6700 FORMAT "%8.4" ECU_ADDRESS 0xC000A52C /end MEASUREMENT
/begin MEASUREMENT MoFInjQnt_volPoI2QntAdj_mp "Injektormengenabgleich Korrekturvolumen der PoI2 in der Funktionsüberwachung" SWORD Mo_vol_mm3_q0p01 1 100 -327.6800 327.6700 FORMAT "%8.4" ECU_ADDRESS 0xC000A52E /end MEASUREMENT
/begin MEASUREMENT MoFInjQnt_volPoI2UnCor_mp "Einspritzvolumen PoI2 vor Injektormengenabgleich Korrektur in der Funktionsüberwachung" SWORD Mo_vol_mm3_q0p01 1 100 -327.6800 327.6700 FORMAT "%8.4" ECU_ADDRESS 0xC000A530 /end MEASUREMENT
/begin MEASUREMENT MoFIn_st "Status der Eingangssignale aus Ebene 1 für die Überwachung" UBYTE OneToOne 1 100 0.00 255.0 ECU_ADDRESS 0xD000692C /end MEASUREMENT
/begin MEASUREMENT MoFLos_rTrq "Relatives Motorverlustmoment der Überwachung" UBYTE Mo_r_prc_q0p39 1 100 0.00 99.61 FORMAT "%5.2" ECU_ADDRESS 0xD000692D /end MEASUREMENT
/begin MEASUREMENT PosMCCtl_r "" SWORD Prc_Fact100 1 100 -327.6800 327.6700 FORMAT "%8.4" ARRAY_SIZE 6 ECU_ADDRESS 0xD0001250 /end MEASUREMENT
/begin MEASUREMENT PosMCDes_phiMCDes "" SWORD AngleCrS 1 100 -720.0000 719.9780 ECU_ADDRESS 0xD000125C /end MEASUREMENT
/begin MEASUREMENT T3Lim_qLim "" SWORD InjMass 1 100 -327.6800 327.6700 ECU_ADDRESS 0xD00013C0 /end MEASUREMENT
/begin MEASUREMENT TrqInrCtl_r "" SWORD Prc_Fact100 1 100 -327.6800 327.6700 FORMAT "%8.4" ARRAY_SIZE 6 ECU_ADDRESS 0xD0001436 /end MEASUREMENT
/begin FUNCTION Lub_CritOilLvl ""
 /begin DEF_CHARACTERISTIC Lub_dmFlAddBas_MAP Lub_dmFlEvpBas_MAP Lub_dmFlOilRmvBas_MAP Lub_facFlAddTempEng_CUR Lub_facFlEvpTemp_CUR Lub_facFlOilRmvMs_CUR Lub_facFlOilRmvTemp_CUR Lub_lOilChngEEPSubs_C Lub_lOilChngLim_C Lub_mFlEEPSubs_C Lub_mLvl2Ms_MAP Lub_mOilEngDflMax_C Lub_mOilEngDflMin_C Lub_mOilEngSensVldMax_C Lub_mOilEngSensVldMin_C Lub_mOilRmvEEPSubs_C Lub_mskCritOilLvl_CA Lub_mTotMaxCrit_C Lub_mTotMinCrit_C Lub_numTempEng_C Lub_numTempOil_C Lub_rFlOilCritFldt_C Lub_rFlOilDflMinCritFldt_C Lub_rhoFuel_C Lub_swtOilSensVldMaxMnl_C Lub_swtOilSensVldMinMnl_C Lub_swtSrvVal_C Lub_tiMsOilSensVldDeb_C /end DEF_CHARACTERISTIC
 /begin IN_MEASUREMENT CoEOM_stOpModeAct EngDa_tFld Epm_nEng GlbDa_lTotDst InjCtl_qSetUnBal Oil_lSwmp /end IN_MEASUREMENT
 /begin OUT_MEASUREMENT Lub_mFl Lub_mOilDilEng Lub_mTot Lub_rFlOil Lub_stOilEng Lub_stOilLayer Lub_tOil Lub_volOilDilEng /end OUT_MEASUREMENT
 /begin LOC_MEASUREMENT Lub_dmFlAddBas_mp Lub_dmFlAddCor_mp Lub_dmFlAdd_mp Lub_dmFlEvpBas_mp Lub_dmFlEvp_mp Lub_dmFlOilRmvBas_mp Lub_dmFlOilRmvTempCor_mp Lub_dmFlOilRmv_mp Lub_dmFlRmvTot_mp Lub_dmFlRmv_mp Lub_dmFl_mp Lub_dmOilRmv_mp Lub_lOilChngEEP_mp Lub_mFlEEP_mp Lub_mFlInt_mp Lub_mOilEngSens_mp Lub_mOilRmvEEP_mp Lub_mOilRmvInt_mp Lub_mOilRmv_mp Lub_mTotCrvIn_mp Lub_mTotDflMax_mp Lub_mTotDflMin_mp Lub_rFlOilDflMax_mp Lub_rFlOilDflMin_mp Lub_stMsOilSensVld_mp Lub_stOilChng_mp Lub_stOpMode_mp Lub_tEng_mp Lub_tOilLvl_mp /end LOC_MEASUREMENT
/end FUNCTION
/begin FUNCTION MEDCAdapt "" /begin DEF_CHARACTERISTIC PosMCDes_phiMCDes_C /end DEF_CHARACTERISTIC
 /begin OUT_MEASUREMENT ARS_trqDes CoEng_stTst CoETS_bFltDemSet Com_trqCltDKG Cpp_pCylAvrgAg1 Cpp_trqInrCorAvrg Dspl_bFlTnk Dspl_volFlTnkQnt GlwCtl_tiPreGlwRmn HESrv_stMSid InjCtl_qDriftLim2 InjVlv_rTrqInrLimMax InjVlv_rTrqInrLimMin InjVlv_tiMI1CSCCor InjVlv_tiZFCPiI3ETCor PosMCCtl_r PosMCDes_phiMCDes T3Lim_qLim TrqInrCtl_r /end OUT_MEASUREMENT
/end FUNCTION
/begin FUNCTION MEDCNC "" /begin SUB_FUNCTION Layer_Proc CustDiag /end SUB_FUNCTION /end FUNCTION
/begin FUNCTION medc_axispoints_core "" /end FUNCTION
/begin FUNCTION medc_axispoints_custom "" /end FUNCTION
/begin FUNCTION medc_axispoints_ds "" /end FUNCTION
/begin FUNCTION medc_axispoints_ds_gs "" /end FUNCTION
/begin FUNCTION medc_axispoints_prj "" /end FUNCTION
/begin FUNCTION medc_compu_core "" /end FUNCTION
/begin FUNCTION medc_compu_custom "" /end FUNCTION
/begin FUNCTION MEDC_Compu_DS "" /end FUNCTION
/begin FUNCTION MEDC_Compu_DS_GS "" /end FUNCTION
/begin FUNCTION medc_compu_prj "" /end FUNCTION
/begin FUNCTION MEDC_DatasetExt "" /begin DEF_CHARACTERISTIC medc_datasetid /end DEF_CHARACTERISTIC /end FUNCTION
/begin FUNCTION medc_fixconst_core "" /end FUNCTION
/begin FUNCTION medc_fixconst_custom "" /end FUNCTION
/begin FUNCTION MEDC_FixConst_DS "" /end FUNCTION
/begin FUNCTION MEDC_FixConst_DS_GS "" /end FUNCTION
/begin FUNCTION medc_fixconst_prj "" /end FUNCTION
/begin FUNCTION medc_models_core "" /end FUNCTION
/begin FUNCTION MEDC_Models_Custom "" /end FUNCTION
/begin FUNCTION medc_models_ds "" /end FUNCTION
/begin FUNCTION MEDC_Models_DS_GS "" /end FUNCTION
/begin FUNCTION medc_models_prj "" /end FUNCTION
/begin FUNCTION medc_switches_core "" /end FUNCTION
/begin FUNCTION medc_switches_custom "" /end FUNCTION
/begin FUNCTION medc_switches_ds "" /end FUNCTION
/begin FUNCTION medc_switches_ds_gs "" /end FUNCTION
/begin FUNCTION medc_switches_prj "" /end FUNCTION
/begin FUNCTION medc_varconst_core "" /end FUNCTION
/begin FUNCTION medc_varconst_custom "" /end FUNCTION
/begin FUNCTION MEDC_VarConst_DS "" /end FUNCTION
/begin FUNCTION MEDC_VarConst_DS_GS "" /end FUNCTION
/begin FUNCTION medc_varconst_prj "" /end FUNCTION
/begin FUNCTION MemLay "" /end FUNCTION
/begin FUNCTION MeUn_ActrTst ""
 /begin DEF_CHARACTERISTIC MeUn_facRefActrTst_C MeUn_iMaxActrTst_CA MeUn_iMinActrTst_CA MeUn_iSetMaxActrTst_C MeUn_iSetMinActrTst_C MeUn_iWinActrTst_C MeUn_nDiffMaxActrTst_C MeUn_nSetActrTst_CA MeUn_pMinMeUn_C MeUn_pSetActrTst_CA MeUn_qDiffMaxActrTst_C MeUn_rAccPedActrTst_C MeUn_swtZeroVolActrTst_C MeUn_tClntMinActrTst_C MeUn_tiActrTstMax_C MeUn_tiDetActrTst_C MeUn_tiRmpDurActrTst_C MeUn_tiWaitActrTst_C /end DEF_CHARACTERISTIC
 /begin IN_MEASUREMENT APP_rUnFlt Brk_st CEngDsT_t Epm_nEng HLSDem_nSetPLo InjCtl_qSetUnBal MeUn_iSet MeUn_iSetFlt PCV_iSetFlt PT_stTraType RailP_pFlt Rail_pSetPoint Rail_stCtlLoop VehV_v /end IN_MEASUREMENT
 /begin LOC_MEASUREMENT MeUn_cntRepActrTst_mp MeUn_cntSpdActrTst_mp MeUn_facRefActrTst MeUn_iPCVAvrgLoActrTst_mp MeUn_iRefActrTst_mp MeUn_iResActrTst_mp MeUn_iSetActrTst MeUn_iSetMaxActrTst MeUn_iSetMinActrTst MeUn_nActrTst MeUn_pActrTst MeUn_pSetPntActrTst MeUn_qAvrgActrTst_mp MeUn_stActrTst MeUn_stEffectActrTst MeUn_stRefActrTst MeUn_stResActrTst_mp MeUn_stStMActrTst MeUn_stZeroVolTst MeUn_swtTstParActrTst MeUn_tiEvalActrTst_mp MeUn_tiRmpDurActrTst MeUn_tiWait_mp /end LOC_MEASUREMENT
/end FUNCTION
/begin FUNCTION MeUn_DDCo ""
 /begin DEF_CHARACTERISTIC MeUn_CrntCtlDT1.T1_C MeUn_CrntCtlDT1.Kd_C MeUn_iLin_CUR MeUn_nDiffMax_C MeUn_PwmOut.rMin_C MeUn_PwmOut.rMax_C MeUn_PwmOut.tiBtwTstSCB_C MeUn_PwmOut.tiBtwTstOT_C MeUn_PwmOut.numTstMax_C MeUn_PwmOut.swtBattCor_C MeUn_PwmOut.swtPsInv_C MeUn_resCoil_C MeUn_rMaxDty_C MeUn_rPerUn_C MeUn_rPs_C MeUn_rSetLin_CUR MeUn_SRC.uMin_C MeUn_SRC.uMax_C MeUn_stLvl_C MeUn_stPwrStgActv_C MeUn_stPwrStgDia_C MeUn_swtRPs_C MeUn_tiPerUBattHi_C MeUn_tiPer_CUR MeUn_tiPh_C MeUn_uBattHi_C MeUn_uBattLo_C /end DEF_CHARACTERISTIC
 /begin IN_MEASUREMENT BattU_facCor BattU_u BattU_uRated DevLib_stPwrStgEnaCond Epm_nEng MeUn_stRot /end IN_MEASUREMENT
 /begin LOC_MEASUREMENT MeUn_iActVal MeUn_nDiffRef_mp MeUn_rPsPreRot_mp MeUn_rPs_mp MeUn_rSetDT1_mp MeUn_rSetLin_mp MeUn_rSet_mp MeUn_tiPer_mp MeUn_uRaw_mp /end LOC_MEASUREMENT
/end FUNCTION
/begin FUNCTION MeUn_Rot ""
 /begin DEF_CHARACTERISTIC MeUn_ctRot_C MeUn_rLim_CUR MeUn_rRotEnd_C MeUn_rRotStrt_C MeUn_stRotActv_C MeUn_tiRotDel_C MeUn_tiRotExt_C MeUn_tiRotWait_C /end DEF_CHARACTERISTIC
 /begin IN_MEASUREMENT CoEng_st Epm_nEng FuelT_tFlSys SyC_stSub /end IN_MEASUREMENT
 /begin OUT_MEASUREMENT MeUn_stRot /end OUT_MEASUREMENT
 /begin LOC_MEASUREMENT MeUn_ctRot_mp /end LOC_MEASUREMENT
/end FUNCTION
/begin FUNCTION MeUn_VDCo ""
 /begin DEF_CHARACTERISTIC MeUn_CrntCtlI.Ki_C MeUn_CrntCtlI.KiPos_C MeUn_CrntCtlI.KiNeg_C MeUn_CrntCtlI.WinPos_C MeUn_CrntCtlI.WinNeg_C MeUn_facCrntCtlInit_CUR MeUn_facCrntCtlMax_C MeUn_facCrntCtlMin_C MeUn_iCnvFlowRate_CUR MeUn_iSetMin_C MeUn_iSet_C MeUn_pActrPrt_C MeUn_pFlowOfFl_C MeUn_swtISet_C MeUn_tiCrntCtlInit_C MeUn_tiFlt1PT1_C MeUn_tiFlt2PT1_C MeUn_tiFltPT1Init_C /end DEF_CHARACTERISTIC
 /begin IN_MEASUREMENT DevLib_stMonActrPrt FuelT_tFlSys MeUn_stRot RailP_pFlt Rail_stCtlLoop /end IN_MEASUREMENT
 /begin OUT_MEASUREMENT MeUn_iSet MeUn_iSetFlt /end OUT_MEASUREMENT
 /begin LOC_MEASUREMENT MeUn_dvolSet MeUn_facCrntCtlLim_mp MeUn_iActFlt_mp MeUn_iDvt_mp MeUn_stActrCtl_mp /end LOC_MEASUREMENT
/end FUNCTION
/begin FUNCTION Misc "" /begin SUB_FUNCTION Misc_co Misc_swt Misc_flex Misc_fx Misc_fa Misc_a /end SUB_FUNCTION /end FUNCTION
/begin FUNCTION Misc_a ""
 /begin DEF_CHARACTERISTIC Com_swtCtrCrshSwoEkp_A_C Com_swtKlemmen_A_C Com_swtStatEkp_A_C /end DEF_CHARACTERISTIC
 /begin OUT_MEASUREMENT Com_dvolPspDes_A Com_iPsp_A Com_nPsp_A Com_rPspSetPoint_A Com_stDiagPsp_A Com_stPspCntr_A Com_stPsp_A Com_uPsp_A Com_uT30Psp_A /end OUT_MEASUREMENT
/end FUNCTION
/begin FUNCTION Misc_Can ""
 /begin DEF_CHARACTERISTIC Com_swtBOSRst2_C Com_swtBOSRst_C Com_swtFahrzeugtyp_C Com_swtParkConsumer_C Com_swtReqEFan_C Com_swtReqMSA_C Com_swtRequestEMF_C Com_swtStatusEMF_C Com_swtVerbraucher_C /end DEF_CHARACTERISTIC
 /begin LOC_MEASUREMENT Com_bRecARS Com_bRecCrCtlLvr Com_bRecMSA /end LOC_MEASUREMENT
/end FUNCTION
/begin FUNCTION Misc_co "" /begin IN_MEASUREMENT Com_stCBSRst /end IN_MEASUREMENT
 /begin OUT_MEASUREMENT Com_ctCBSRstFlF Com_ctCBSRstOil Com_ctCBSRstPFlt Com_dCrCtlLvrCHK Com_dCrCtlLvrCTR Com_dIntrvTimeCBSRst2FlF Com_dIntrvTimeCBSRst2Oil Com_dIntrvTimeCBSRst2PFlt Com_dMonthCBSRst2FlF Com_dMonthCBSRst2Oil Com_dMonthCBSRst2PFlt Com_dRequestEMFCHK Com_dRequestEMFCTR Com_dRmnMlgCBSRstFlF Com_dRmnMlgCBSRstOil Com_dRmnMlgCBSRstPFlt Com_dstARSCTR Com_dStatusEMFCHK Com_dStatusEMFCTR Com_dTerminalCHK Com_dTerminalCTR Com_dYearCBSRst2FlF Com_dYearCBSRst2Oil Com_dYearCBSRst2PFlt Com_idParkConsumer Com_idVerbraucher Com_iHiLimCurr Com_iLoLimCurr Com_iPsp Com_iZrLimCurr Com_lIntrvWayCBSRst2FlF Com_lIntrvWayCBSRst2Oil Com_lIntrvWayCBSRst2PFlt Com_nPsp Com_rAvlCBSRstFlF Com_rAvlCBSRstOil Com_rAvlCBSRstPFlt Com_rPspSetPoint Com_stARS Com_stBattClass Com_stBonnet Com_stButtonMSA Com_stClthOpen Com_stCrCtlLvr Com_stDiagPsp Com_stDoorDriver Com_stDrWghSeat Com_stGearBck Com_stHDC Com_stKeyVld Com_stMSALmp Com_stParkConsumer Com_stPBrComf Com_stPBrHold Com_stPBrHyd Com_stPsp Com_stReqMSA Com_stShutOffPSP Com_stStgEFan Com_stT15 Com_stT15Hw Com_stT50 Com_stTRadio Com_stTrailer Com_stTypBody Com_stUnCBSRstFlF Com_stUnCBSRstOil Com_stUnCBSRstPFlt Com_stVerbraucher Com_swtDrBltb Com_trqARSCur Com_trqARSDes Com_uPsp /end OUT_MEASUREMENT
 /begin LOC_MEASUREMENT Com_numRqStgEFan_mp /end LOC_MEASUREMENT
/end FUNCTION
/begin FUNCTION Misc_fa ""
 /begin DEF_CHARACTERISTIC Com_swtCodierungPwrmng_FA_C Com_swtCtrCrshSwoEkp_FA_C Com_swtDiensteID38_FA_C Com_swtDienste_FA_C Com_swtFahrzeugtyp_FA_C Com_swtFllupGpwsup_FA_C Com_swtKlemmen_FA_C Com_swtSlrdiGlbFZM_FA_C Com_swtStateSeat_FA_C Com_swtStatZVKlappen_FA_C Com_swtTrailer_FA_C /end DEF_CHARACTERISTIC
 /begin OUT_MEASUREMENT Com_dKlemmenCHK_FA Com_dKlemmenCTR_FA Com_iHiLimCurr_FA Com_iLoLimCurr_FA Com_iZrLimCurr_FA Com_stBattClass_FA Com_stBonnet_FA Com_stClassPwr_FA Com_stClthOpen_FA Com_stDoorDriver_FA Com_stDrWghSeat_FA Com_stEngStop_FA Com_stKeyVld_FA Com_stShutOffPSP_FA Com_stSleepBus_FA Com_stSleepConst_FA Com_stSleepDest_FA Com_stSleepRdy_FA Com_stTerminal_FA Com_stTrailer_FA Com_stVehCond_FA Com_swtDrBltb_FA Com_tiPostRunPwrSpl_FA /end OUT_MEASUREMENT
/end FUNCTION
/begin FUNCTION Misc_flex "" /begin IN_MEASUREMENT Com_trqTarDrvDynMax_FX Com_trqTarDrvDyn_FX /end IN_MEASUREMENT
 /begin OUT_MEASUREMENT Com_ctSleepNeg Com_dvolPspDes Com_numSleepNegID0 Com_numSleepNegID1 Com_numSleepNegID2 Com_numSleepNegID3 Com_stClassPwr Com_stDrvDyn Com_stDrvPrgQl Com_stEngStop Com_stPspCntr Com_stShiftPdl Com_stSleepAckTx Com_stSleepBus Com_stSleepConst Com_stSleepDest Com_stSleepRdy Com_stSleepRdyTx Com_stTerminal Com_stVehCond Com_tiPostRunPwrSpl Com_trqTarDrvDyn Com_trqTarDrvDynDes Com_trqTarDrvDynMax Com_uT30Psp /end OUT_MEASUREMENT
/end FUNCTION
/begin FUNCTION Misc_fx ""
 /begin DEF_CHARACTERISTIC Com_swtaDirect_C Com_swtaSide_C Com_swtBtnDrvDyn_FX_C Com_swtShiftPaddle_FX_C Com_swtSpeedVehicle_FX_C Com_swtTrqDemCrshDrDy_FX_C /end DEF_CHARACTERISTIC
 /begin OUT_MEASUREMENT Com_aDirect_FX Com_aSide_FX Com_daDirectCHK_FX Com_daDirectCTR_FX Com_daSideCHK_FX Com_daSideCTR_FX Com_dBtnDrvDynCHK_FX Com_dBtnDrvDynCTR_FX Com_dSpeedVehicleCHK_FX Com_dSpeedVehicleCTR_FX Com_dTrqDemDrvDynCHK_FX Com_dTrqDemDrvDynCTR_FX Com_stDrvDyn_FX Com_stDrvPrgQl_FX Com_stShiftPdl_FX Com_stSleepBus_FX Com_stSleepConst_FX Com_stSleepDest_FX Com_stSleepRdy_FX Com_stVehDrvCond_FX Com_trqTarDrvDynDes_FX Com_trqTarDrvDynMax_FX Com_trqTarDrvDyn_FX Com_v_FX /end OUT_MEASUREMENT
/end FUNCTION
/begin FUNCTION Misc_swt ""
 /begin IN_MEASUREMENT Com_aDirect Com_aDirect_FX Com_dvolPspDes Com_dvolPspDes_A Com_iHiLimCurr Com_iHiLimCurr_FA Com_iLoLimCurr Com_iLoLimCurr_FA Com_iPsp Com_iPsp_A Com_iZrLimCurr Com_iZrLimCurr_FA Com_nPsp Com_nPsp_A Com_rPspSetPoint Com_rPspSetPoint_A Com_stBattClass Com_stBattClass_FA Com_stClassPwr Com_stClassPwr_FA Com_stDiagPsp Com_stDiagPsp_A Com_stDrvDyn Com_stDrvDyn_FX Com_stDrvPrgQl Com_stDrvPrgQl_FX Com_stDrWghSeat Com_stDrWghSeat_FA Com_stEngStop Com_stEngStop_FA Com_stKeyVld Com_stKeyVld_FA Com_stPsp Com_stPspCntr Com_stPspCntr_A Com_stPsp_A Com_stShiftPdl Com_stShiftPdl_FX Com_stShutOffPSP Com_stShutOffPSP_FA Com_stSleepBus Com_stSleepBus_FA Com_stSleepBus_FX Com_stSleepConst Com_stSleepConst_FA Com_stSleepConst_FX Com_stSleepDest Com_stSleepDest_FA Com_stSleepDest_FX Com_stSleepRdy Com_stSleepRdy_FA Com_stSleepRdy_FX Com_stT15 Com_stT50 Com_stTerminal Com_stTerminal_FA Com_stTRadio Com_stTrailer Com_stTrailer_FA Com_stVehCond Com_stVehCond_FA Com_stVehDrvCond Com_stVehDrvCond_FX Com_swtDrBltb Com_swtDrBltb_FA Com_trqTarDrvDyn Com_trqTarDrvDynDes Com_trqTarDrvDynDes_FX Com_trqTarDrvDynMax Com_trqTarDrvDynMax_FX Com_trqTarDrvDyn_FX Com_uPsp Com_uPsp_A Com_uT30Psp Com_uT30Psp_A Com_v Com_v_FX /end IN_MEASUREMENT
/end FUNCTION
/begin FUNCTION Mli "" /end FUNCTION
/begin FUNCTION Mm "" /end FUNCTION
/begin FUNCTION Mmo "" /end FUNCTION
/begin FUNCTION MoCADC_Co ""
 /begin DEF_CHARACTERISTIC MoCADC_ctDebCmp_C MoCADC_ctDebTst_C MoCADC_ctDebVltgRatio_C MoCADC_ctDiagCmp_C MoCADC_ctRstCmp_C MoCADC_ctRstTst_C MoCADC_ctRstVltgRatio_C MoCADC_ctStyADC_C MoCADC_facVltgRatioMax_C MoCADC_facVltgRatioMin_C MoCADC_uMaxDiff_C MoCADC_uSty_C MoCADC_uTstMax_C MoCADC_uTstMin_C /end DEF_CHARACTERISTIC
 /begin IN_MEASUREMENT Mo_stCplChk Mo_stICOMsg Mo_stMoC Mo_stMoF /end IN_MEASUREMENT
 /begin OUT_MEASUREMENT MoCADC_facVltgRatio MoCADC_st MoCADC_stIrvErrCmp MoCADC_stIrvErrTst MoCADC_stIrvErrVltgRatio /end OUT_MEASUREMENT
 /begin LOC_MEASUREMENT MoCADC_ctDebCmp MoCADC_ctDebTst MoCADC_ctDebVltgRatio MoCADC_ctDiagCmp MoCADC_ctDiagTst MoCADC_ctDiagVltgRatio MoCADC_ctStyADC1 MoCADC_ctStyADC2 MoCADC_uADC1 MoCADC_uADC2 MoCADC_uTst_mp /end LOC_MEASUREMENT
/end FUNCTION
/begin FUNCTION MoCCom_Co "" /begin DEF_CHARACTERISTIC MoCCom_ctDebErrCnt_C MoCCom_ctDebErrSPI_C /end DEF_CHARACTERISTIC /begin REF_CHARACTERISTIC MoCSOP_ctDebSOPTst_C /end REF_CHARACTERISTIC
 /begin IN_MEASUREMENT MoCCPU_PartResp MoCMem_stTotMemChk MoCPFC_PartResp MoCSOP_stAct MoCSOP_stActMsg MoCSOP_stErr MoCSOP_stRdy Mo_stCplChk SyC_stSub /end IN_MEASUREMENT
 /begin OUT_MEASUREMENT MoCCom_ctErrFC MoCCom_ctErrMMMsg MoCCom_ctSOPTstActv MoCCom_Query MoCCom_st MoCCom_stQueryNew MoCCom_stWDAActvMsg /end OUT_MEASUREMENT
 /begin LOC_MEASUREMENT MoCCom_bCPUNew MoCCom_bErrCntErr MoCCom_bErrCntNPl MoCCom_bPCPNew MoCCom_bPFCNew MoCCom_bSpiErr MoCCom_bSpiNPl MoCCom_ctDiagErrCnt MoCCom_ctDiagErrSPI MoCCom_ctErrMM MoCCom_ctErrMMOld MoCCom_ctErrSPI MoCCom_Response /end LOC_MEASUREMENT
/end FUNCTION
/begin FUNCTION MoCCPU_Co "" /begin DEF_CHARACTERISTIC MoCCPU_IpoTst_CUR /end DEF_CHARACTERISTIC /begin IN_MEASUREMENT MoCCom_Query MoCCom_stQueryNew /end IN_MEASUREMENT /begin OUT_MEASUREMENT MoCCPU_PartResp MoCCPU_Query /end OUT_MEASUREMENT /begin LOC_MEASUREMENT MoCCPU_ctSeq MoCCPU_IpoIn MoCCPU_TempRes /end LOC_MEASUREMENT /end FUNCTION
/begin FUNCTION MoCGPTA_Co "" /begin DEF_CHARACTERISTIC MoCGPTA_numErr_C MoCGPTA_tiDvtMax_C /end DEF_CHARACTERISTIC /begin IN_MEASUREMENT Mo_stCplChk /end IN_MEASUREMENT /end FUNCTION
/begin FUNCTION MoCMem_Co ""
 /begin DEF_CHARACTERISTIC MoCMem_ctDebErrChkRAM_C MoCMem_ctDebErrChkROM_C MoCMem_ctDebHealChkRAM_C MoCMem_ctDebHealChkROM_C /end DEF_CHARACTERISTIC
 /begin IN_MEASUREMENT Mo_stCplChk Mo_stMoC /end IN_MEASUREMENT
 /begin OUT_MEASUREMENT MoCMem_st MoCMem_stTotMemChk /end OUT_MEASUREMENT
 /begin LOC_MEASUREMENT MoCMem_adCurrent MoCMem_adRamOffset MoCMem_ctDebErrChkRAM MoCMem_ctDebErrChkROM MoCMem_ctDebHealChkRAM MoCMem_ctDebHealChkROM MoCMem_numCurrent MoCMem_stFunctionSwitch /end LOC_MEASUREMENT
/end FUNCTION
/begin FUNCTION MoCPCP_Co "" /begin DEF_CHARACTERISTIC MoCPCP_numErr_C MoCPCP_stEnaMFTst_CW MoCPCP_tiHeal_C /end DEF_CHARACTERISTIC /begin IN_MEASUREMENT MoCCom_stQueryNew MoCMem_st Mo_stCplChk Mo_stMoC /end IN_MEASUREMENT
 /begin LOC_MEASUREMENT MoCPCP_adCurrent MoCPCP_ctErr MoCPCP_ctHeal MoCPCP_numCurrentCSum /end LOC_MEASUREMENT
/end FUNCTION
/begin FUNCTION MoCPFC_Co "" /begin IN_MEASUREMENT MoCCom_Query /end IN_MEASUREMENT /begin OUT_MEASUREMENT MoCPFC_PartResp /end OUT_MEASUREMENT /begin LOC_MEASUREMENT MoCPFC_Checksum MoCPFC_Checkword MoCPFC_Counter /end LOC_MEASUREMENT /end FUNCTION
/begin FUNCTION MoCRAM_Co ""
 /begin DEF_CHARACTERISTIC MoCRam_ChkRAMIFA9SyncTst_CW MoCRam_ChkRAMIFA9Tst_CW MoCRam_noRAMChkSD_CW /end DEF_CHARACTERISTIC
 /begin IN_MEASUREMENT MoCMem_st MoCRom_numRomPageErr MoCRom_ptrTabIndexAct /end IN_MEASUREMENT
 /begin OUT_MEASUREMENT MoCRam_stProtRAMCleared /end OUT_MEASUREMENT
 /begin LOC_MEASUREMENT MoCRam_ctMain1RamChk MoCRam_ctMain2RamChk MoCRam_ctMainProtRam MoCRam_ctRepEx MoCRam_numAreasChecked MoCRam_numReset MoCRam_stEEPInit MoCRam_stRepExRam /end LOC_MEASUREMENT
/end FUNCTION
/begin FUNCTION MoCROM_Co ""
 /begin DEF_CHARACTERISTIC MoCRom_BgSwOffTst_CW MoCRom_noROMChkIni_CW MoCRom_noROMCodeChkRst_CW MoCRom_noROMDataChkRst_CW MoCRom_RepExTst_CW /end DEF_CHARACTERISTIC
 /begin IN_MEASUREMENT MoCMem_st SyC_stSub /end IN_MEASUREMENT
 /begin OUT_MEASUREMENT MoCRom_numRomPageErr MoCRom_ptrTabIndexAct /end OUT_MEASUREMENT
 /begin LOC_MEASUREMENT MoCRom_ctRepEx_mp MoCRom_ctSrvWdt MoCRom_KeyCode MoCRom_KeyData /end LOC_MEASUREMENT
/end FUNCTION
/begin FUNCTION MoCSOP_Co ""
 /begin DEF_CHARACTERISTIC MoCSOP_ctDebHwNoRdy_C MoCSOP_ctDebPSDia_C MoCSOP_ctDebSOPTst_C MoCSOP_nMinOVLth_C MoCSOP_stMMErrReac_CW MoCSOP_stSOPTstActv_CW MoCSOP_stSWResetDem_CW MoCSOP_swtPsvTst_C /end DEF_CHARACTERISTIC
 /begin IN_MEASUREMENT MoCCom_ctErrFC MoCCom_ctSOPTstActv MoCCom_st MoCMem_st MoCMem_stTotMemChk MoFESpd_nEng Mo_stCplChk Mo_stMoF SyC_stSub /end IN_MEASUREMENT
 /begin OUT_MEASUREMENT MoCSOP_ctErrMM MoCSOP_stAct MoCSOP_stActMsg MoCSOP_stActvMsg MoCSOP_stErr MoCSOP_stOvl MoCSOP_stRdy MoCSOP_stRdyMsg /end OUT_MEASUREMENT
 /begin LOC_MEASUREMENT MoCSOP_ctDebHwNoRdy MoCSOP_ctDebPSDia MoCSOP_ctDebSOPTst MoCSOP_st MoCSOP_stLdRespTab /end LOC_MEASUREMENT
/end FUNCTION
/begin FUNCTION MoExe_Co "" /begin IN_MEASUREMENT SyC_stSub /end IN_MEASUREMENT /begin OUT_MEASUREMENT MoExe_ctCyc /end OUT_MEASUREMENT /end FUNCTION
/begin FUNCTION MoFACC_Co "" /begin IN_MEASUREMENT Mo_stCplChk Mo_stMoC /end IN_MEASUREMENT /begin OUT_MEASUREMENT MoFACC_st /end OUT_MEASUREMENT /end FUNCTION
/begin FUNCTION MoFAcs_Co ""
 /begin DEF_CHARACTERISTIC MoFAcs_nARSDia_C MoFAcs_rTrqARSDiaMax_C MoFAcs_rTrqARSDiaOfs_C MoFAcs_rTrqARSMax_CUR MoFAcs_rTrqStaPmp_C MoFAcs_swtTrqLos_C MoFAcs_trqACMax_C MoFAcs_trqAltMax_C MoFAcs_trqLosTra_C MoFAcs_vARSDia_C /end DEF_CHARACTERISTIC
 /begin REF_CHARACTERISTIC MoFTra_swtTraType_C Mo_trqIdcMax_C /end REF_CHARACTERISTIC
 /begin IN_MEASUREMENT AC_trqDes Alt_trqDes ARS_trqDes Com_trqTarDrvDynDes MoFESpd_nEng MoFVSS_v Mo_stCplChk Mo_stMoC Strg_trqDes /end IN_MEASUREMENT
 /begin OUT_MEASUREMENT MoFAcs_rTrqAcs MoFAcs_rTrqLos MoFAcs_rTrqLosPT MoFAcs_trqAcs MoFAcs_trqAcsMsg /end OUT_MEASUREMENT
 /begin LOC_MEASUREMENT MoFAcs_rTrqAC_mp MoFAcs_rTrqAlt_mp MoFAcs_rTrqARSPlaus_mp MoFAcs_rTrqARS_mp MoFAcs_trqLosPT_mp MoFAcs_trqLos_mp /end LOC_MEASUREMENT
/end FUNCTION
/begin FUNCTION MoFAPP_Co ""
 /begin DEF_CHARACTERISTIC MoFAPP_ctDeb_C MoFAPP_ctRst_C MoFAPP_uFL_C MoFAPP_uLoLim_C MoFAPP_uMaxDiffFL_C MoFAPP_uMaxDiffPL_C /end DEF_CHARACTERISTIC
 /begin IN_MEASUREMENT APP_stSigSrc MoCADC_st MoFETC_stTst MoFIn_st Mo_stCplChk Mo_stICOMsg Mo_stMoC Mo_stMoF /end IN_MEASUREMENT
 /begin OUT_MEASUREMENT MoFAPP_ctDeb MoFAPP_stIrvErr MoFAPP_stLimpMsg MoFAPP_u /end OUT_MEASUREMENT
 /begin LOC_MEASUREMENT MoFAPP_ctDiag MoFAPP_stDiff_mp MoFAPP_stTst MoFAPP_uRaw1_mp MoFAPP_uRaw2_mp /end LOC_MEASUREMENT
/end FUNCTION
/begin FUNCTION MoFASD_Co "" /begin DEF_CHARACTERISTIC MoFASD_tiT1_C MoFASD_trqFltMax_C MoFASD_trqMax_C /end DEF_CHARACTERISTIC /begin REF_CHARACTERISTIC Mo_trqIdcMax_C /end REF_CHARACTERISTIC /begin IN_MEASUREMENT MoFInjDat_trqASD Mo_stCplChk Mo_stMoC /end IN_MEASUREMENT /begin OUT_MEASUREMENT MoFASD_rTrq /end OUT_MEASUREMENT /begin LOC_MEASUREMENT MoFASD_trqASD_mp MoFASD_trqFlt /end LOC_MEASUREMENT /end FUNCTION
/begin FUNCTION MoFBrk_Co "" /begin IN_MEASUREMENT Mo_stCplChk Mo_stMoC /end IN_MEASUREMENT /begin OUT_MEASUREMENT MoFBrk_st /end OUT_MEASUREMENT /end FUNCTION
/begin FUNCTION MoFCCtl_Co "" /begin DEF_CHARACTERISTIC MoFCCtl_ctShOffRmpDeb_C /end DEF_CHARACTERISTIC /begin IN_MEASUREMENT CoVMD_swtCCSel Mo_stCplChk Mo_stMoC /end IN_MEASUREMENT /begin OUT_MEASUREMENT MoFCCtl_st /end OUT_MEASUREMENT
 /begin LOC_MEASUREMENT MoFCCtl_ctShOffRmpDeb MoFCCtl_stButton MoFCCtl_stEdgDet MoFCCtl_stIrvErr /end LOC_MEASUREMENT
/end FUNCTION
/begin FUNCTION MoFClth_Co "" /begin DEF_CHARACTERISTIC MoFClth_ctDeb_C /end DEF_CHARACTERISTIC /begin IN_MEASUREMENT Mo_stCplChk Mo_stMoC /end IN_MEASUREMENT /begin OUT_MEASUREMENT MoFClth_ctDeb MoFClth_st /end OUT_MEASUREMENT /end FUNCTION
/begin FUNCTION MoFCoEng_Co ""
 /begin DEF_CHARACTERISTIC MoFCoEng_ctMaxInt_C MoFCoEng_rTrqLosAdapErr_C MoFCoEng_rTrqLosAdapMax_C MoFCoEng_rTrqLosOfs_C MoFCoEng_rTrqLos_MAP MoFCoEng_rTrqMaxDiffAdap_C MoFCoEng_swtLosCalc_C MoFCoEng_tiT1_C /end DEF_CHARACTERISTIC
 /begin REF_CHARACTERISTIC Mo_trqIdcMax_C /end REF_CHARACTERISTIC
 /begin IN_MEASUREMENT MoFAcs_rTrqAcs MoFAcs_rTrqLos MoFAcs_trqAcs MoFCoVeh_rTrqComp MoFCoVeh_trqVehPtd MoFESpd_nEng MoFLos_rTrq MoFTEng_tEng MoFTrqIdc_rTrq Mo_stCplChk Mo_stMoC RngMod_stAdap RngMod_trqDiffAdap /end IN_MEASUREMENT
 /begin OUT_MEASUREMENT MoFCoEng_rTrqFlt MoFCoEng_rTrqInrSet MoFCoEng_rTrqPtd MoFCoEng_stTrqFlt /end OUT_MEASUREMENT
 /begin LOC_MEASUREMENT MoFCoEng_ctMaxInt MoFCoEng_rTrqDiffAdap_mp MoFCoEng_rTrqInr_mp MoFCoEng_rTrqLos MoFCoEng_rTrqLosAdap MoFCoEng_rTrqPT1Flt MoFCoEng_stIntActvTO MoFCoEng_trqInrSet_mp MoFCoEng_trqInr_mp MoFCoEng_trqLos_mp MoFCoEng_trqPtd_mp /end LOC_MEASUREMENT
/end FUNCTION
/begin FUNCTION MoFCoOfs_Co "" /begin DEF_CHARACTERISTIC MoFCoOfs_rTrqPtdOfs_MAP MoFCoOfs_tiDel_C MoFCoOfs_tiT1_C /end DEF_CHARACTERISTIC /begin REF_CHARACTERISTIC Mo_trqIdcMax_C /end REF_CHARACTERISTIC
 /begin IN_MEASUREMENT MoFASD_rTrq MoFCoEng_rTrqPtd MoFESpd_nEng MoFSpdG_rTrq Mo_stCplChk Mo_stMoC /end IN_MEASUREMENT
 /begin OUT_MEASUREMENT MoFCoOfs_ctIdxDel MoFCoOfs_rTrqPtdFlt MoFCoOfs_rTrqPtdMsg MoFCoOfs_rTrqPtdOfs /end OUT_MEASUREMENT
 /begin LOC_MEASUREMENT MoFCoOfs_rTrqPtdDel_mp MoFCoOfs_rTrqPtd_mp MoFCoOfs_trqPtdOfs_mp /end LOC_MEASUREMENT
/end FUNCTION
/begin FUNCTION MoFCoVeh_Co "" /begin DEF_CHARACTERISTIC MoFCoVeh_facTrqComp_MAP /end DEF_CHARACTERISTIC /begin REF_CHARACTERISTIC Mo_trqIdcMax_C /end REF_CHARACTERISTIC
 /begin IN_MEASUREMENT CoVeh_trqDesComp MoFAcs_rTrqLos MoFAcs_rTrqLosPT MoFDrAs_trqPtd MoFDrDem_rTrqPT MoFDrDem_trqPtd MoFESpd_nEng MoFExtInt_trqPtd Mo_stCplChk Mo_stMoC /end IN_MEASUREMENT
 /begin OUT_MEASUREMENT MoFCoVeh_rTrqComp MoFCoVeh_trqCompMsg MoFCoVeh_trqVehPtd MoFCoVeh_trqVehPtdMsg /end OUT_MEASUREMENT
 /begin LOC_MEASUREMENT MoFCoVeh_facTrqComp_mp MoFCoVeh_trqPrpClth_mp MoFCoVeh_trqVMD_mp /end LOC_MEASUREMENT
/end FUNCTION
/begin FUNCTION MoFDCS_Co "" /begin IN_MEASUREMENT Com_stTrqStbDesQl Com_trqStbDes Mo_stCplChk Mo_stMoC /end IN_MEASUREMENT /begin OUT_MEASUREMENT MoFDCS_stDem MoFDCS_stIrvErr MoFDCS_trqDem /end OUT_MEASUREMENT /end FUNCTION
/begin FUNCTION MoFDrAs_Co ""
 /begin DEF_CHARACTERISTIC MoFDrAs_ctDebACC_C MoFDrAs_ctDebCCtl_C MoFDrAs_swtFGRACCPlaOff_C MoFDrAs_vACCMin_C MoFDrAs_vCCtlMin_C /end DEF_CHARACTERISTIC
 /begin IN_MEASUREMENT ACCI_stInActv ACCI_trqDes CoVMD_trqCrCtl CrCtl_stPtd MoFACC_st MoFBrk_st MoFCCtl_st MoFVSS_v Mo_stCplChk Mo_stMoC VehMot_stPrpCrCtl /end IN_MEASUREMENT
 /begin OUT_MEASUREMENT MoFDrAs_ctDebACC MoFDrAs_ctDebCCtl MoFDrAs_stACCPtdMsg MoFDrAs_stActv MoFDrAs_stCCtlPtd MoFDrAs_stCCtlPtdMsg MoFDrAs_stPtdMsg MoFDrAs_trqPtd /end OUT_MEASUREMENT
 /begin LOC_MEASUREMENT MoFDrAs_stACCDel_mp MoFDrAs_stCCtlDel_mp MoFDrAs_stLogPtd_mp MoFDrAs_stTrqPtd_mp MoFDrAs_vMin_mp /end LOC_MEASUREMENT
/end FUNCTION
/begin FUNCTION MoFDrDem_Co ""
 /begin DEF_CHARACTERISTIC MoFDrDem_rThreshPrpMin_C MoFDrDem_rThreshPrp_C MoFDrDem_rTrqEng_MAP MoFDrDem_rTrqPTMax_C MoFDrDem_rTrqPTMin_C MoFDrDem_stTrqClth_C MoFDrDem_swtAcs_C MoFDrDem_trqSpd_MAP MoFDrDem_uAPPMax_C MoFDrDem_uAPPMin_C /end DEF_CHARACTERISTIC
 /begin REF_CHARACTERISTIC Mo_trqIdcMax_C /end REF_CHARACTERISTIC
 /begin IN_MEASUREMENT CodVar_stTrqClth CodVar_stTrqClthCpl MoFAcs_rTrqLos MoFAcs_trqAcs MoFAPP_u MoFESpd_nEng MoFLos_rTrq Mo_stCplChk Mo_stMoC PT_rTrq VehMot_rTrqDfftl /end IN_MEASUREMENT
 /begin OUT_MEASUREMENT MoFDrDem_rAPP MoFDrDem_rTrqPT MoFDrDem_trqMin MoFDrDem_trqOvrRun MoFDrDem_trqOvrRunMsg MoFDrDem_trqPtd /end OUT_MEASUREMENT
 /begin LOC_MEASUREMENT MoFDrDem_rTrqMin_mp MoFDrDem_stTrqClth MoFDrDem_trqEngMax_mp MoFDrDem_trqEng_mp /end LOC_MEASUREMENT
/end FUNCTION
/begin FUNCTION MoFESpd_Co ""
 /begin DEF_CHARACTERISTIC MoFESpd_ctDeb_C MoFESpd_ctRst_C MoFESpd_nDiffMax_C MoFESpd_nMin_C /end DEF_CHARACTERISTIC
 /begin IN_MEASUREMENT MoFETC_stTst Mo_ctRst Mo_stCplChk Mo_stICOMsg Mo_stMoC Mo_stMoF /end IN_MEASUREMENT
 /begin OUT_MEASUREMENT MoFESpd_ctDeb MoFESpd_nEng MoFESpd_stSync /end OUT_MEASUREMENT
 /begin LOC_MEASUREMENT MoFESpd_ctDiag MoFESpd_nEngL2_mp MoFESpd_phiGT1Last MoFESpd_stIrvErr MoFESpd_stSync1 MoFESpd_stSync2 MoFESpd_stTst MoFESpd_tiLast /end LOC_MEASUREMENT
/end FUNCTION
/begin FUNCTION MoFETC_Co "" /begin DEF_CHARACTERISTIC MoFETC_ctTst_C MoFETC_swtInactvTO_C MoFETC_TstCurRun_C /end DEF_CHARACTERISTIC
 /begin IN_MEASUREMENT Etc_ctCurRunTst MoFAPP_ctDeb MoFBrk_st MoFDrDem_rAPP MoFESpd_ctDeb MoFInjDat_ctDebPhiErr MoFInjDat_ctDebQntErr MoFInjDat_stChkSum MoFInjQnt_ctDebErr MoFOvR_ctDebET MoFVSS_v Mo_stMoC /end IN_MEASUREMENT
 /begin OUT_MEASUREMENT MoFETC_stTst MoFETC_stTstMsg /end OUT_MEASUREMENT
 /begin LOC_MEASUREMENT MoFETC_ctTst MoFETC_stDiagTO /end LOC_MEASUREMENT
/end FUNCTION
/begin FUNCTION MoFExtInt_Co ""
 /begin DEF_CHARACTERISTIC MoFExtInt_ctDebDCSMax_C MoFExtInt_ctDebTSCMax_C MoFExtInt_st_C /end DEF_CHARACTERISTIC
 /begin REF_CHARACTERISTIC Mo_trqIdcMax_C /end REF_CHARACTERISTIC
 /begin IN_MEASUREMENT MoFAcs_rTrqAcs MoFDCS_stDem MoFDCS_trqDem MoFLos_rTrq MoFTra_stDem MoFTra_trqDem Mo_stCplChk Mo_stMoC Tra_stTSCPtd VMSI_stDCSPtd /end IN_MEASUREMENT
 /begin OUT_MEASUREMENT MoFExtInt_ctDebDCS MoFExtInt_ctDebTSC MoFExtInt_stDCSPtdMsg MoFExtInt_stTSCPtdMsg MoFExtInt_trqPtd /end OUT_MEASUREMENT
 /begin LOC_MEASUREMENT MoFExtInt_trqLos_mp MoFExtInt_trqPtdDCS MoFExtInt_trqPtdTSC /end LOC_MEASUREMENT
/end FUNCTION
/begin FUNCTION MoFFrm_Co "" /end FUNCTION
/begin FUNCTION MoFICO_Co "" /begin DEF_CHARACTERISTIC MoFICO_ctDeb_C MoFICO_nCtOff_C /end DEF_CHARACTERISTIC
 /begin IN_MEASUREMENT MoFESpd_nEng MoFETC_stTst MoFInjDat_stInjState Mo_ctRst Mo_stCplChk Mo_stMoC Mo_stMoF SyC_stSub /end IN_MEASUREMENT
 /begin OUT_MEASUREMENT MoFICO_ctDeb /end OUT_MEASUREMENT
 /begin LOC_MEASUREMENT MoFICO_stProtRAM /end LOC_MEASUREMENT
/end FUNCTION
/begin FUNCTION MoFInjDat_GetInj ""
 /begin DEF_CHARACTERISTIC MoFInjDat_ctDebPhiErr_C MoFInjDat_ctDebQntErr_C MoFInjDat_ctDiagPhi_C MoFInjDat_ctDiagQnt_C MoFInjDat_ctRst_C MoFInjDat_facInjEff_MAP MoFInjDat_nNumRevCs1Max_C MoFInjDat_nNumRevCs2Max_C MoFInjDat_nNumRevCs2Min_C MoFInjDat_nNumRevCs3Min_C MoFInjDat_nThresAgPlaus_C MoFInjDat_nThreshQntErr_C MoFInjDat_numCyl_C MoFInjDat_phiMI1BkupMax_C MoFInjDat_phiMI1BkupMin_C MoFInjDat_phiMI1Max_C MoFInjDat_phiMI1Min_C MoFInjDat_phiPiIBkupMax_C MoFInjDat_phiPiIBkupMin_C MoFInjDat_phiPiIMax_C MoFInjDat_phiPiIMin_C MoFInjDat_phiPoI1BkupMax_C MoFInjDat_phiPoI1BkupMin_C MoFInjDat_phiPoI1Max_C MoFInjDat_phiPoI1Min_C MoFInjDat_phiPoI2BkupMax_C MoFInjDat_phiPoI2BkupMin_C MoFInjDat_phiPoI2Max_C MoFInjDat_phiPoI2Min_C MoFInjDat_pLin_CUR MoFInjDat_pThreshQntErr_C MoFInjDat_qThreshQntErr_C MoFInjDat_swtGradActv_C MoFInjDat_uSRCMax_C MoFInjDat_uSRCMin_C /end DEF_CHARACTERISTIC
 /begin IN_MEASUREMENT ASDdc_trq EpmCrS_stDiag Epm_ctCyl Epm_nEng Epm_stOpMode InjCrv_facPoI2EffSet InjCrv_stInjCharActVal InjCtl_qAdjQnt InjCtl_qDriftLim2 InjCtl_qSetUnBal InjVlv_tiZFCPiI1ETCor InjVlv_tiZFCPiI2ETCor InjVlv_tiZFCPoI1ETCor InjVlv_tiZFCPoI2ETCor MoCADC_facVltgRatio MoFESpd_nEng MoFESpd_stSync MoFETC_stTst MoFRailP_p MoFRailP_stGradErr Mo_ctRst Mo_stCplChk Mo_stICOMsg Mo_stMoC Mo_stMoF PhyMod_facEtaCor PhyMod_facEtaCorNxt QWC_qMI1 QWC_qPiI1 QWC_qPoI1 QWC_qPoI2 QWC_tCor SpdGov_trqSet /end IN_MEASUREMENT
 /begin OUT_MEASUREMENT MoFInjDat_ctDebPhiErr MoFInjDat_ctDebQntErr MoFInjDat_ctDiagPhi MoFInjDat_ctDiagQnt MoFInjDat_facEtaCor MoFInjDat_facEtaCorNxt MoFInjDat_facPoI1EffSet MoFInjDat_facPoI2EffSet MoFInjDat_p MoFInjDat_phiMI1 MoFInjDat_phiPiI1 MoFInjDat_phiPiI2 MoFInjDat_phiPiI3 MoFInjDat_phiPoI1 MoFInjDat_phiPoI2 MoFInjDat_qAdjQnt MoFInjDat_qDriftLim2 MoFInjDat_qMI1WvCor MoFInjDat_qPiI1WvCor MoFInjDat_qPoI1WvCor MoFInjDat_qPoI2WvCor MoFInjDat_stChkSum MoFInjDat_stInjState MoFInjDat_stPressSRC MoFInjDat_stTstPhi MoFInjDat_stTstQnt MoFInjDat_tCor MoFInjDat_tiMI1 MoFInjDat_tiMI1PoI1 MoFInjDat_tiMI1PoI2 MoFInjDat_tiPiI1 MoFInjDat_tiPiI1MI1 MoFInjDat_tiPiI1ZFCETCor MoFInjDat_tiPiI2 MoFInjDat_tiPiI2MI1 MoFInjDat_tiPiI2PiI1 MoFInjDat_tiPiI2ZFCETCor MoFInjDat_tiPiI3 MoFInjDat_tiPiI3ZFCETCor MoFInjDat_tiPoI1 MoFInjDat_tiPoI1ZFCETCor MoFInjDat_tiPoI2 MoFInjDat_tiPoI2PoI1 MoFInjDat_tiPoI2ZFCETCor MoFInjDat_tiTDCAvrg MoFInjDat_trqASD MoFInjDat_trqSpdG /end OUT_MEASUREMENT
 /begin LOC_MEASUREMENT MoFInjDat_ctProc MoFInjDat_facEtaCorNxtSum MoFInjDat_facEtaCorSum MoFInjDat_facPoI1EffSetSum MoFInjDat_facPoI2EffSetSum MoFInjDat_numCylActr_mp MoFInjDat_numInjType_mp MoFInjDat_numRevCsAct MoFInjDat_phiEOEMI1Sum MoFInjDat_phiEOEPiI1Sum MoFInjDat_phiEOEPiI2Sum MoFInjDat_phiEOEPoI2Sum MoFInjDat_phiInjAct_mp MoFInjDat_phiInjBegActr_mp MoFInjDat_phiMI1Sum MoFInjDat_phiPiI1Sum MoFInjDat_phiPiI2Sum MoFInjDat_phiPiI3Sum MoFInjDat_phiPoI1Sum MoFInjDat_phiPoI2Sum MoFInjDat_pLinCurr_mp MoFInjDat_pSum MoFInjDat_qAdjQntSum MoFInjDat_qDriftLim2Sum MoFInjDat_qMI1WvCorSum MoFInjDat_qPiI1WvCorSum MoFInjDat_qPoI1WvCorSum MoFInjDat_qPoI2WvCorSum MoFInjDat_stIrvErrPhi MoFInjDat_stIrvErrQnt MoFInjDat_tiInjAct_mp MoFInjDat_tiInjDurActr_mp MoFInjDat_tiMI1Sum MoFInjDat_tiPiI1Sum MoFInjDat_tiPiI1ZFCETCorSum MoFInjDat_tiPiI2Sum MoFInjDat_tiPiI2ZFCETCorSum MoFInjDat_tiPiI3Sum MoFInjDat_tiPiI3ZFCETCorSum MoFInjDat_tiPoI1Sum MoFInjDat_tiPoI1ZFCETCorSum MoFInjDat_tiPoI2Sum MoFInjDat_tiPoI2ZFCETCorSum MoFInjDat_tiTDCSumET_mp MoFInjDat_trqASDSum MoFInjDat_trqSpdGSum MoFInjDat_uRaw_mp /end LOC_MEASUREMENT
/end FUNCTION
/begin FUNCTION MoFInjQnt_Co ""
 /begin DEF_CHARACTERISTIC MoFInjQnt_ctDebErr_C MoFInjQnt_ctRst_C MoFInjQnt_rhoFl_C MoFInjQnt_stQntAdj_MAP MoFInjQnt_tiPiIZFCETMax_CUR MoFInjQnt_tiPiIZFCETMin_CUR MoFInjQnt_tiPoIZFCETMax_CUR MoFInjQnt_tiPoIZFCETMin_CUR MoFInjQnt_volQntAdjLim_C MoFInjQnt_vol_MAP /end DEF_CHARACTERISTIC
 /begin REF_CHARACTERISTIC MoFInjDat_numCyl_C /end REF_CHARACTERISTIC
 /begin IN_MEASUREMENT MoFETC_stTst MoFInjDat_p MoFInjDat_tiMI1 MoFInjDat_tiPiI1 MoFInjDat_tiPiI1ZFCETCor MoFInjDat_tiPiI2 MoFInjDat_tiPiI2ZFCETCor MoFInjDat_tiPiI3 MoFInjDat_tiPiI3ZFCETCor MoFInjDat_tiPoI2 Mo_ctRst Mo_stCplChk Mo_stICOMsg Mo_stMoC Mo_stMoF /end IN_MEASUREMENT
 /begin OUT_MEASUREMENT MoFInjQnt_ctDebErr MoFInjQnt_qMI1Cor MoFInjQnt_qPiI1Cor MoFInjQnt_qPiI2Cor MoFInjQnt_qPiI3Cor MoFInjQnt_qPoI1Cor MoFInjQnt_qPoI2Cor /end OUT_MEASUREMENT
 /begin LOC_MEASUREMENT MoFInjQnt_ctDiag MoFInjQnt_stChk_mp MoFInjQnt_stIrvErr MoFInjQnt_tiPiIZFCETMax_mp MoFInjQnt_tiPiIZFCETMin_mp MoFInjQnt_tiPoIZFCETMax_mp MoFInjQnt_tiPoIZFCETMin_mp MoFInjQnt_volCor MoFInjQnt_volMI1QntAdj_mp MoFInjQnt_volMI1UnCor_mp MoFInjQnt_volPiI1QntAdj_mp MoFInjQnt_volPiI1UnCor_mp MoFInjQnt_volPiI2QntAdj_mp MoFInjQnt_volPiI2UnCor_mp MoFInjQnt_volPiI3QntAdj_mp MoFInjQnt_volPiI3UnCor_mp MoFInjQnt_volPoI1QntAdj_mp MoFInjQnt_volPoI1UnCor_mp MoFInjQnt_volPoI2QntAdj_mp MoFInjQnt_volPoI2UnCor_mp /end LOC_MEASUREMENT
/end FUNCTION
/begin FUNCTION MoFIn_Co "" /begin IN_MEASUREMENT Mo_stCplChk Mo_stMoC /end IN_MEASUREMENT /begin OUT_MEASUREMENT MoFIn_st /end OUT_MEASUREMENT /end FUNCTION
/begin FUNCTION MoFLos_Co "" /begin DEF_CHARACTERISTIC MoFLos_rTrqEngLos_MAP /end DEF_CHARACTERISTIC /begin IN_MEASUREMENT MoFESpd_nEng MoFTEng_tEng Mo_stCplChk Mo_stMoC /end IN_MEASUREMENT /begin OUT_MEASUREMENT MoFLos_rTrq /end OUT_MEASUREMENT /end FUNCTION
/begin COMPU_METHOD Acc "" RAT_FUNC "%6.5" "m/s^2" COEFFS 0 1000 0 0 0 1 /end COMPU_METHOD
/begin COMPU_METHOD AngleCrS "" RAT_FUNC "%6.3" "deg CrS" COEFFS 0 45.5111111111 0 0 0 1 /end COMPU_METHOD
/begin COMPU_METHOD CoEOMSwt "" RAT_FUNC "%10.9" "-" COEFFS 0 16384000 0 0 0 1 /end COMPU_METHOD
/begin COMPU_METHOD COEOM_AIRCTLQNTNUMMAP_SY_Compu "" TAB_NOINTP "%6.3" "" COMPU_TAB_REF COEOM_AIRCTLQNTNUMMAP_SY_Compu /end COMPU_METHOD
/begin COMPU_TAB COEOM_AIRCTLQNTNUMMAP_SY_Compu "" TAB_NOINTP 8 0 0 1 1 2 2 3 3 4 4 5 5 6 6 7 7 /end COMPU_TAB
/begin COMPU_METHOD Curr "" RAT_FUNC "%6.2" "mA" COEFFS 0 1 0 0 0 1 /end COMPU_METHOD
/begin COMPU_METHOD Curr_10A_Step_A "" RAT_FUNC "%6.1" "A" COEFFS 0 1 0 0 0 10 /end COMPU_METHOD
/begin COMPU_METHOD CylPres "" RAT_FUNC "%6.4" "bar" COEFFS 0 100 0 0 0 1 /end COMPU_METHOD
/begin COMPU_METHOD Dspl_bFlTnk_VERB "" TAB_VERB "%6.3" "-" COMPU_TAB_REF Dspl_bFlTnk_VERB /end COMPU_METHOD
/begin COMPU_VTAB Dspl_bFlTnk_VERB "" TAB_VERB 2 0 "NOT_EMPTY" 1 "EMPTY" /end COMPU_VTAB
/begin COMPU_METHOD DtyCyc "" RAT_FUNC "%5.2" "%" COEFFS 0 100 0 0 0 1 /end COMPU_METHOD
/begin COMPU_METHOD EngN "" RAT_FUNC "%5.1" "rpm" COEFFS 0 2 0 0 0 1 /end COMPU_METHOD
/begin COMPU_METHOD Fact "" RAT_FUNC "%6.5" "-" COEFFS 0 8192 0 0 0 1 /end COMPU_METHOD
/begin COMPU_METHOD Fact1 "" RAT_FUNC "%6.4" "-" COEFFS 0 128 0 0 0 1 /end COMPU_METHOD
/begin COMPU_METHOD Fact_q0p001 "" RAT_FUNC "%6.5" "-" COEFFS 0 1000 0 0 0 1 /end COMPU_METHOD
/begin COMPU_METHOD FlConsum_l_h "" RAT_FUNC "%6.4" "l/h" COEFFS 0 100 0 0 0 1 /end COMPU_METHOD
/begin COMPU_METHOD InjMass "" RAT_FUNC "%5.2" "mg/hub" COEFFS 0 100 0 0 0 1 /end COMPU_METHOD
/begin COMPU_METHOD InjMassCyc "" RAT_FUNC "%5.2" "mg/cyc" COEFFS 0 100 0 0 0 1 /end COMPU_METHOD
/begin COMPU_METHOD InjTime_us "" RAT_FUNC "%5.1" "us" COEFFS 0 2.5 0 0 0 1 /end COMPU_METHOD
/begin COMPU_METHOD Kd "" RAT_FUNC "%7.6" "1/1" COEFFS 0 65536 0 0 0 1 /end COMPU_METHOD
/begin COMPU_METHOD Ki_curr2fact "" RAT_FUNC "%10.9" "1/mA*s" COEFFS 0 17592186.044416 0 0 0 1 /end COMPU_METHOD
/begin COMPU_METHOD Length "" RAT_FUNC "%6.2" "m" COEFFS 0 1 0 0 0 1 /end COMPU_METHOD
/begin COMPU_METHOD Mo_fac_q0p000122 "" RAT_FUNC "%6.5" "1/1" COEFFS 0 8192 0 0 0 1 /end COMPU_METHOD
/begin COMPU_METHOD Mo_fac_q0p00098 "" RAT_FUNC "%6.5" "1/1" COEFFS 0 1024 0 0 0 1 /end COMPU_METHOD
/begin COMPU_METHOD Mo_fac_q0p00392 "" RAT_FUNC "%6.4" "1/1" COEFFS 0 255 0 0 0 1 /end COMPU_METHOD
/begin COMPU_METHOD Mo_fac_q0p01 "" RAT_FUNC "%6.4" "1/1" COEFFS 0 100 0 0 0 1 /end COMPU_METHOD
/begin COMPU_METHOD Mo_n_rpm_q0p5 "" RAT_FUNC "%6.3" "rpm" COEFFS 0 2 0 0 0 1 /end COMPU_METHOD
/begin COMPU_METHOD Mo_n_rpm_q40p0 "" RAT_FUNC "%6.1" "rpm" COEFFS 0 1 0 0 0 40 /end COMPU_METHOD
/begin COMPU_METHOD Mo_phi_degCrS_q0p02197 "" RAT_FUNC "%6.4" "deg CrS" COEFFS 0 16383 0 0 0 360 /end COMPU_METHOD
/begin COMPU_METHOD Mo_p_bar_q8p0000 "" RAT_FUNC "%4.3" "bar" COEFFS 0 1000.000000 0 0 0 8000 /end COMPU_METHOD
/begin COMPU_METHOD Mo_q_mg_q0p01 "" RAT_FUNC "%6.4" "mg" COEFFS 0 100 0 0 0 1 /end COMPU_METHOD
/begin COMPU_METHOD Mo_rho_mgpmm3_q0p1 "" RAT_FUNC "%6.3" "mg/mm3" COEFFS 0 10 0 0 0 1 /end COMPU_METHOD
/begin COMPU_METHOD Mo_r_prc_q0p00152 "" RAT_FUNC "%6.4" "%" COEFFS 0 65536 0 0 0 100 /end COMPU_METHOD
/begin COMPU_METHOD Mo_r_prc_q0p39 "" RAT_FUNC "%6.3" "%" COEFFS 0 256 0 0 0 100 /end COMPU_METHOD
/begin COMPU_METHOD Mo_ti10ms_ms_q10p0 "" RAT_FUNC "%6.1" "ms" COEFFS 0 1 0 0 0 10 /end COMPU_METHOD
/begin COMPU_METHOD Mo_ti40ms_ms_q40p0 "" RAT_FUNC "%6.1" "ms" COEFFS 0 1 0 0 0 40 /end COMPU_METHOD
/begin COMPU_METHOD Mo_tiRec40ms_ms_b10240 "" RAT_FUNC "%6.1" "ms" COEFFS 0 0 10240 0 1 0 /end COMPU_METHOD
/begin COMPU_METHOD Mo_ti_ms_q1p0 "" RAT_FUNC "%6.2" "ms" COEFFS 0 1 0 0 0 1 /end COMPU_METHOD
/begin COMPU_METHOD Mo_ti_s_q0p01 "" RAT_FUNC "%6.4" "s" COEFFS 0 100 0 0 0 1 /end COMPU_METHOD
/begin COMPU_METHOD Mo_ti_us_q0p4 "" RAT_FUNC "%6.3" "us" COEFFS 0 1000 0 0 0 400 /end COMPU_METHOD
/begin COMPU_METHOD Mo_ti_us_q1p0 "" RAT_FUNC "%6.2" "us" COEFFS 0 1 0 0 0 1 /end COMPU_METHOD
/begin COMPU_METHOD Mo_trq_nm_q0p00000152587890625 "" RAT_FUNC "%8.7" "Nm" COEFFS 0 655360 0 0 0 1 /end COMPU_METHOD
/begin COMPU_METHOD Mo_trq_nm_q0p1 "" RAT_FUNC "%6.3" "Nm" COEFFS 0 10 0 0 0 1 /end COMPU_METHOD
/begin COMPU_METHOD Mo_trq_nm_q1p6 "" RAT_FUNC "%6.2" "Nm" COEFFS 0 10 0 0 0 16 /end COMPU_METHOD
/begin COMPU_METHOD Mo_t_DegC_q0p8o48 "" RAT_FUNC "%6.2" "deg C" COEFFS 0 5 240 0 0 4 /end COMPU_METHOD
/begin COMPU_METHOD Mo_u_mV_q12p89 "" RAT_FUNC "%6.1" "mV" COEFFS 0 256 0 0 0 3300 /end COMPU_METHOD
/begin COMPU_METHOD Mo_u_mV_q19p53 "" RAT_FUNC "%6.1" "mV" COEFFS 0 256 0 0 0 5000 /end COMPU_METHOD
/begin COMPU_METHOD Mo_u_mV_q4p88 "" RAT_FUNC "%6.2" "mV" COEFFS 0 1024 0 0 0 5000 /end COMPU_METHOD
/begin COMPU_METHOD Mo_u_mV_q9p77 "" RAT_FUNC "%6.2" "mV" COEFFS 0 256 0 0 0 2500 /end COMPU_METHOD
/begin COMPU_METHOD Mo_vol_mm3_q0p01 "" RAT_FUNC "%6.4" "mm3" COEFFS 0 100 0 0 0 1 /end COMPU_METHOD
/begin COMPU_METHOD Mo_v_kmh_q0p01 "" RAT_FUNC "%6.4" "km/h" COEFFS 0 100 0 0 0 1 /end COMPU_METHOD
/begin COMPU_METHOD OilMFl_mgps_q0p1 "" RAT_FUNC "%6.3" "mg/s" COEFFS 0 10 0 0 0 1 /end COMPU_METHOD
/begin COMPU_METHOD OilMsPrc_q0p01 "" RAT_FUNC "%6.4" "%" COEFFS 0 100 0 0 0 1 /end COMPU_METHOD
/begin COMPU_METHOD OilMs_mg "" RAT_FUNC "%6.2" "mg" COEFFS 0 1 0 0 0 1 /end COMPU_METHOD
/begin COMPU_METHOD OilMs_q0p1 "" RAT_FUNC "%6.3" "g" COEFFS 0 10 0 0 0 1 /end COMPU_METHOD
/begin COMPU_METHOD OilMs_q10 "" RAT_FUNC "%6.1" "g" COEFFS 0 0.1 0 0 0 1 /end COMPU_METHOD
/begin COMPU_METHOD OneToOne "" RAT_FUNC "%6.0" "-" COEFFS 0 1 0 0 0 1 /end COMPU_METHOD
/begin COMPU_METHOD OneToOne_km "" RAT_FUNC "%6.2" "km" COEFFS 0 1 0 0 0 1 /end COMPU_METHOD
/begin COMPU_METHOD OneToOne_rpm "" RAT_FUNC "%6.2" "rpm" COEFFS 0 1 0 0 0 1 /end COMPU_METHOD
/begin COMPU_METHOD Period "" RAT_FUNC "%6.3" "ms" COEFFS 0 10 0 0 0 1 /end COMPU_METHOD
/begin COMPU_METHOD Prc "" RAT_FUNC "%6.4" "%" COEFFS 0 81.92 0 0 0 1 /end COMPU_METHOD
/begin COMPU_METHOD Prc_Fact100 "" RAT_FUNC "%6.4" "%" COEFFS 0 100 0 0 0 1 /end COMPU_METHOD
/begin COMPU_METHOD Pres_Rail "" RAT_FUNC "%5.1" "bar" COEFFS 0 10.000000 0 0 0 1 /end COMPU_METHOD
/begin COMPU_METHOD Qp_mm3_sec "" RAT_FUNC "%6.1" "mm3/s" COEFFS 0 0.1 0 0 0 1 /end COMPU_METHOD
/begin COMPU_METHOD Resist_1 "" RAT_FUNC "%6.2" "mOhm" COEFFS 0 1 0 0 0 1 /end COMPU_METHOD
/begin COMPU_METHOD RhoFuel "" RAT_FUNC "%6.3" "kg/m^3" COEFFS 0 10 0 0 0 1 /end COMPU_METHOD
/begin COMPU_METHOD Temp_Cels "" RAT_FUNC "%5.1" "deg C" COEFFS 0 10 2731.4 0 0 1 /end COMPU_METHOD
/begin COMPU_METHOD TimeDelay_s "" RAT_FUNC "%12.4" "s" COEFFS 0 0 1 0 0.00023283064365387 0 /end COMPU_METHOD
/begin COMPU_METHOD Time_1s "" RAT_FUNC "%6.2" "s" COEFFS 0 1 0 0 0 1 /end COMPU_METHOD
/begin COMPU_METHOD Time_ms "" RAT_FUNC "%5.0" "ms" COEFFS 0 0.1 0 0 0 1 /end COMPU_METHOD
/begin COMPU_METHOD Time_s "" RAT_FUNC "%5.2" "s" COEFFS 0 100 0 0 0 1 /end COMPU_METHOD
/begin COMPU_METHOD Trq "" RAT_FUNC "%5.1" "Nm" COEFFS 0 10 0 0 0 1 /end COMPU_METHOD
/begin COMPU_METHOD UC_Curr "" RAT_FUNC "%6.3" "A" COEFFS 0 10 0 0 0 1 /end COMPU_METHOD
/begin COMPU_METHOD UC_Volt "" RAT_FUNC "%6.3" "V" COEFFS 0 10 0 0 0 1 /end COMPU_METHOD
/begin COMPU_METHOD Vel "" RAT_FUNC "%5.2" "km/h" COEFFS 0 100 0 0 0 1 /end COMPU_METHOD
/begin COMPU_METHOD Vol "" RAT_FUNC "%6.4" "l" COEFFS 0 100 0 0 0 1 /end COMPU_METHOD
/begin COMPU_METHOD Volt "" RAT_FUNC "%6.1" "mV" COEFFS 0 5 0 0 0 1 /end COMPU_METHOD
/begin COMPU_METHOD Volt_Batt "" RAT_FUNC "%5.0" "mV" COEFFS 0 0.05 0 0 0 1 /end COMPU_METHOD
/begin COMPU_METHOD Vol_Oil "" RAT_FUNC "%6.4" "l" COEFFS 0 100 0 0 0 1 /end COMPU_METHOD
/begin RECORD_LAYOUT Cur_Xs16Ws16 NO_AXIS_PTS_X 1 SWORD AXIS_PTS_X 2 SWORD INDEX_INCR DIRECT FNC_VALUES 3 SWORD COLUMN_DIR DIRECT /end RECORD_LAYOUT
/begin RECORD_LAYOUT Cur_Xu8Wu8 NO_AXIS_PTS_X 1 UBYTE AXIS_PTS_X 2 UBYTE INDEX_INCR DIRECT FNC_VALUES 3 UBYTE COLUMN_DIR DIRECT /end RECORD_LAYOUT
/begin RECORD_LAYOUT Kf_Xs16_Ys16_Ws16 NO_AXIS_PTS_X 1 SWORD NO_AXIS_PTS_Y 2 SWORD AXIS_PTS_X 3 SWORD INDEX_INCR DIRECT AXIS_PTS_Y 4 SWORD INDEX_INCR DIRECT FNC_VALUES 5 SWORD COLUMN_DIR DIRECT /end RECORD_LAYOUT
/begin RECORD_LAYOUT Kw_Ws16 FNC_VALUES 1 SWORD COLUMN_DIR DIRECT /end RECORD_LAYOUT
/begin RECORD_LAYOUT Kw_Ws32 FNC_VALUES 1 SLONG COLUMN_DIR DIRECT /end RECORD_LAYOUT
/begin RECORD_LAYOUT Kw_Wu16 FNC_VALUES 1 UWORD COLUMN_DIR DIRECT /end RECORD_LAYOUT
/begin RECORD_LAYOUT Kw_Wu8 FNC_VALUES 1 UBYTE COLUMN_DIR DIRECT /end RECORD_LAYOUT
/begin RECORD_LAYOUT Map_Xs16Ys16Ws16 NO_AXIS_PTS_X 1 SWORD NO_AXIS_PTS_Y 2 SWORD AXIS_PTS_X 3 SWORD INDEX_INCR DIRECT AXIS_PTS_Y 4 SWORD INDEX_INCR DIRECT FNC_VALUES 5 SWORD COLUMN_DIR DIRECT /end RECORD_LAYOUT
/begin RECORD_LAYOUT Map_Xu8Yu8Wu8 NO_AXIS_PTS_X 1 UBYTE NO_AXIS_PTS_Y 2 UBYTE AXIS_PTS_X 3 UBYTE INDEX_INCR DIRECT AXIS_PTS_Y 4 UBYTE INDEX_INCR DIRECT FNC_VALUES 5 UBYTE COLUMN_DIR DIRECT /end RECORD_LAYOUT
/begin RECORD_LAYOUT ValA_Ws16 FNC_VALUES 1 SWORD COLUMN_DIR DIRECT /end RECORD_LAYOUT
/begin RECORD_LAYOUT ValA_Wu32 FNC_VALUES 1 ULONG COLUMN_DIR DIRECT /end RECORD_LAYOUT
/begin RECORD_LAYOUT ValA_Wu8 FNC_VALUES 1 UBYTE COLUMN_DIR DIRECT /end RECORD_LAYOUT
/begin RECORD_LAYOUT Val_Ws16 FNC_VALUES 1 SWORD COLUMN_DIR DIRECT /end RECORD_LAYOUT
/begin RECORD_LAYOUT Val_Ws32 FNC_VALUES 1 SLONG COLUMN_DIR DIRECT /end RECORD_LAYOUT
/begin RECORD_LAYOUT Val_Wu16 FNC_VALUES 1 UWORD COLUMN_DIR DIRECT /end RECORD_LAYOUT
/begin RECORD_LAYOUT Val_Wu32 FNC_VALUES 1 ULONG COLUMN_DIR DIRECT /end RECORD_LAYOUT
/begin RECORD_LAYOUT Val_Wu8 FNC_VALUES 1 UBYTE COLUMN_DIR DIRECT /end RECORD_LAYOUT
/end MODULE
/end PROJECT

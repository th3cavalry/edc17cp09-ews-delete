ASAP2_VERSION 1 4
/begin PROJECT P_574 "EDC17_CP09"
/begin HEADER "" VERSION "V8KB" PROJECT_NO P_574 /end HEADER
/begin MODULE DIM ""
/begin MOD_COMMON "" BYTE_ORDER MSB_LAST ALIGNMENT_BYTE 1 ALIGNMENT_WORD 2 ALIGNMENT_LONG 4 ALIGNMENT_FLOAT32_IEEE 4 /end MOD_COMMON
/begin CHARACTERISTIC Com_ctTrqDemandAFSSelfRec_C "" VALUE 0x80060564 Val_Wu8 255.0 OneToOne 0.00 255.0 /end CHARACTERISTIC
/begin CHARACTERISTIC Com_ctTrqDemandSTESelfRec_C "" VALUE 0x80060565 Val_Wu8 255.0 OneToOne 0.00 255.0 /end CHARACTERISTIC
/begin CHARACTERISTIC Com_stDewPntNotRchd_C "" VALUE 0x8005FD42 Val_Wu8 255.0 OneToOne 0.00 255.0 /end CHARACTERISTIC
/begin CHARACTERISTIC Com_stDewPntRchd_C "" VALUE 0x8005FD43 Val_Wu8 255.0 OneToOne 0.00 255.0 /end CHARACTERISTIC
/begin CHARACTERISTIC Com_stMskTrqDemandAFSSig_C "" VALUE 0x80060566 Val_Wu16 65535.00 OneToOne 0.00 65535.00 /end CHARACTERISTIC
/begin CHARACTERISTIC Com_stMskTrqDemandSTESig_C "" VALUE 0x80060568 Val_Wu16 65535.00 OneToOne 0.00 65535.00 /end CHARACTERISTIC
/begin CHARACTERISTIC Com_swtSensNOxDewDet_C "" VALUE 0x8005FD3E Val_Wu8 255.0 OneToOne 0.00 255.0 /end CHARACTERISTIC
/begin CHARACTERISTIC Com_swtSensNOxGnd_C "" VALUE 0x8005FD3F Val_Wu8 1.000 OneToOne 0.00 1.000 EXTENDED_LIMITS 0.00 255.0 /end CHARACTERISTIC
/begin CHARACTERISTIC Com_swtSensNOxUbatt_C "" VALUE 0x8005FD40 Val_Wu8 1.000 OneToOne 0.00 1.000 EXTENDED_LIMITS 0.00 255.0 /end CHARACTERISTIC
/begin CHARACTERISTIC Com_swtSteeringAngle_FX_C "" VALUE 0x80060570 Val_Wu8 1.000 OneToOne 0.00 1.000 EXTENDED_LIMITS 0.00 255.0 /end CHARACTERISTIC
/begin CHARACTERISTIC Com_swtTrqDemandAFS_C "" VALUE 0x8006056A Val_Wu8 1.000 OneToOne 0.00 1.000 EXTENDED_LIMITS 0.00 255.0 /end CHARACTERISTIC
/begin CHARACTERISTIC Com_swtTrqDemandSTE_C "" VALUE 0x8006056B Val_Wu8 1.000 OneToOne 0.00 1.000 EXTENDED_LIMITS 0.00 255.0 /end CHARACTERISTIC
/begin CHARACTERISTIC Com_swtUbattCat2Ds_C "" VALUE 0x8005FD44 Val_Wu8 1.000 OneToOne 0.00 1.000 EXTENDED_LIMITS 0.00 255.0 /end CHARACTERISTIC
/begin CHARACTERISTIC Com_tiTrqDemandAFSSelfRec_C "" VALUE 0x8006056C Val_Ws16 327670.0 Time_ms 0.00 327670.0 EXTENDED_LIMITS -327680.0 327670.0 /end CHARACTERISTIC
/begin CHARACTERISTIC Com_tiTrqDemandSTESelfRec_C "" VALUE 0x8006056E Val_Ws16 327670.0 Time_ms 0.00 327670.0 EXTENDED_LIMITS -327680.0 327670.0 /end CHARACTERISTIC
/begin CHARACTERISTIC SCRMod_dmExhMnfDs_TC "Testlabel" VALUE 0x8005E218 Val_Ws16 1400.000 AirMassPerTime 0.00 1400.000 EXTENDED_LIMITS -3276.800 3276.700 /end CHARACTERISTIC
/begin CHARACTERISTIC SCRMod_etaCorEG_MAP "Wirkungsgrad SCR in Abhängigkeit von Temperatur und Abgasmassenstrom" MAP 0x8005E21A Map_Xs16Ys16Ws16 4.000000 SCR_Fact1000 0.00 4.000000 FORMAT "%8.6" EXTENDED_LIMITS -32.76800 32.76700
 /begin AXIS_DESCR STD_AXIS SCRMod_dmEG_mp AirMassPerTime 16 0.00 1400.000 EXTENDED_LIMITS -3276.800 3276.700 DEPOSIT ABSOLUTE /end AXIS_DESCR
 /begin AXIS_DESCR STD_AXIS SCRMod_tSCRBrick_mp Temp_Cels 16 -50.04000 999.9600 EXTENDED_LIMITS -3549.940 3003.560 DEPOSIT ABSOLUTE /end AXIS_DESCR
/end CHARACTERISTIC
/begin CHARACTERISTIC SCRMod_etaCorNO2_MAP "Einfluss des NO2 / NOx Verhältnises und der SCR Scheibentemperatur auf den Wirkungsgrad" MAP 0x8005E45E Map_Xs16Ys16Ws16 1.000000 SCR_Fact1000 0.00 1.000000 FORMAT "%8.6" EXTENDED_LIMITS -32.76800 32.76700
 /begin AXIS_DESCR STD_AXIS SCRMod_rNO2NOx_mp SCR_Fact1000 16 0.00 1.000000 FORMAT "%8.6" EXTENDED_LIMITS -32.76800 32.76700 DEPOSIT ABSOLUTE /end AXIS_DESCR
 /begin AXIS_DESCR STD_AXIS SCRMod_tSCRBrick_mp Temp_Cels 16 -3549.940 3003.560 DEPOSIT ABSOLUTE /end AXIS_DESCR
/end CHARACTERISTIC
/begin CHARACTERISTIC SCRMod_etaCorNOxUs_MAP "Wirkungsgrad Korrektur in Abhängigkeit von Temperatur und NOx Rohemissionen" MAP 0x8005E6A2 Map_Xs16Ys16Ws16 4.000000 SCR_Fact1000 0.00 4.000000 FORMAT "%8.6" EXTENDED_LIMITS -32.76800 32.76700
 /begin AXIS_DESCR STD_AXIS SCRFFC_rPPMNOxUs OneToOne 16 0.00 2500.000 EXTENDED_LIMITS -32768.00 32767.00 DEPOSIT ABSOLUTE /end AXIS_DESCR
 /begin AXIS_DESCR STD_AXIS SCRMod_tSCRBrick_mp Temp_Cels 16 -50.04000 999.9600 EXTENDED_LIMITS -3549.940 3003.560 DEPOSIT ABSOLUTE /end AXIS_DESCR
/end CHARACTERISTIC
/begin CHARACTERISTIC SCRMod_etaMax_C "Oberer Grenzwert für den SCR Wirkungsgrad" VALUE 0x8005E8E6 Val_Ws16 1.000000 SCR_Fact1000 0.00 1.000000 FORMAT "%8.6" EXTENDED_LIMITS -32.76800 32.76700 /end CHARACTERISTIC
/begin CHARACTERISTIC SCRMod_etaMin_C "Unterer Grenzwert für den SCR Wirkungsgrad" VALUE 0x8005E8E8 Val_Ws16 1.000000 SCR_Fact1000 0.00 1.000000 FORMAT "%8.6" EXTENDED_LIMITS -32.76800 32.76700 /end CHARACTERISTIC
/begin CHARACTERISTIC SCRMod_etaNO2Age_MAP "Einfluss des NO2 / NOx Verhältnises auf den Wirkungsgrad der gealterten SCR Scheibe" MAP 0x8005E8EA Map_Xs16Ys16Ws16 1.000000 SCR_Fact1000 0.00 1.000000 FORMAT "%8.6" EXTENDED_LIMITS -32.76800 32.76700
 /begin AXIS_DESCR STD_AXIS SCRMod_dmEG_mp AirMassPerTime 16 0.00 1400.000 EXTENDED_LIMITS -3276.800 3276.700 DEPOSIT ABSOLUTE /end AXIS_DESCR
 /begin AXIS_DESCR STD_AXIS SCRMod_tSCRBrick_mp Temp_Cels 16 -0.04000000 1399.960 EXTENDED_LIMITS -3549.940 3003.560 DEPOSIT ABSOLUTE /end AXIS_DESCR
/end CHARACTERISTIC
/begin CHARACTERISTIC SCRMod_etaNO2_MAP "Einfluss des NO2 / NOx Verhältnises auf den Wirkungsgrad der SCR Scheibe" MAP 0x8005EB2E Map_Xs16Ys16Ws16 1.000000 SCR_Fact1000 0.00 1.000000 FORMAT "%8.6" EXTENDED_LIMITS -32.76800 32.76700
 /begin AXIS_DESCR STD_AXIS SCRMod_dmEG_mp AirMassPerTime 16 0.00 1400.000 EXTENDED_LIMITS -3276.800 3276.700 DEPOSIT ABSOLUTE /end AXIS_DESCR
 /begin AXIS_DESCR STD_AXIS SCRMod_tSCRBrick_mp Temp_Cels 16 -50.04000 999.9600 EXTENDED_LIMITS -3549.940 3003.560 DEPOSIT ABSOLUTE /end AXIS_DESCR
/end CHARACTERISTIC
/begin CHARACTERISTIC SCRMod_etaNOAge_MAP "Einfluss des NO / NOx Verhältnises auf den Wirkungsgrad der gealterten SCR Scheibe" MAP 0x8005ED72 Map_Xs16Ys16Ws16 1.000000 SCR_Fact1000 0.00 1.000000 FORMAT "%8.6" EXTENDED_LIMITS -32.76800 32.76700
 /begin AXIS_DESCR STD_AXIS SCRMod_dmEG_mp AirMassPerTime 16 0.00 1400.000 EXTENDED_LIMITS -3276.800 3276.700 DEPOSIT ABSOLUTE /end AXIS_DESCR
 /begin AXIS_DESCR STD_AXIS SCRMod_tSCRBrick_mp Temp_Cels 16 -50.04000 999.9600 EXTENDED_LIMITS -3549.940 3003.560 DEPOSIT ABSOLUTE /end AXIS_DESCR
/end CHARACTERISTIC
/begin CHARACTERISTIC SCRMod_etaNONO2Age_MAP "Einfluss des gewichteten NO und NO2 zu NOx Verhältnises auf den Wirkungsgrad der gealterten SCR Scheibe" MAP 0x8005EFB6 Map_Xs16Ys16Ws16 1.000000 SCR_Fact1000 0.00 1.000000 FORMAT "%8.6" EXTENDED_LIMITS -32.76800 32.76700
 /begin AXIS_DESCR STD_AXIS SCRMod_dmEG_mp AirMassPerTime 16 0.00 1400.000 EXTENDED_LIMITS -3276.800 3276.700 DEPOSIT ABSOLUTE /end AXIS_DESCR
 /begin AXIS_DESCR STD_AXIS SCRMod_tSCRBrick_mp Temp_Cels 16 -50.04000 999.9600 EXTENDED_LIMITS -3549.940 3003.560 DEPOSIT ABSOLUTE /end AXIS_DESCR
/end CHARACTERISTIC
/begin CHARACTERISTIC SCRMod_etaNONO2_MAP "Einfluss des gewichteten NO und NO2 zu NOx Verhältnises auf den Wirkungsgrad der SCR Scheibe" MAP 0x8005F1FA Map_Xs16Ys16Ws16 1.000000 SCR_Fact1000 0.00 1.000000 FORMAT "%8.6" EXTENDED_LIMITS -32.76800 32.76700
 /begin AXIS_DESCR STD_AXIS SCRMod_dmEG_mp AirMassPerTime 16 0.00 1400.000 EXTENDED_LIMITS -3276.800 3276.700 DEPOSIT ABSOLUTE /end AXIS_DESCR
 /begin AXIS_DESCR STD_AXIS SCRMod_tSCRBrick_mp Temp_Cels 16 -50.04000 999.9600 EXTENDED_LIMITS -3549.940 3003.560 DEPOSIT ABSOLUTE /end AXIS_DESCR
/end CHARACTERISTIC
/begin CHARACTERISTIC SCRMod_etaNO_MAP "Einfluss des NO / NOx Verhältnises auf den Wirkungsgrad der SCR Scheibe" MAP 0x8005F43E Map_Xs16Ys16Ws16 1.000000 SCR_Fact1000 0.00 1.000000 FORMAT "%8.6" EXTENDED_LIMITS -32.76800 32.76700
 /begin AXIS_DESCR STD_AXIS SCRMod_dmEG_mp AirMassPerTime 16 0.00 1400.000 EXTENDED_LIMITS -3276.800 3276.700 DEPOSIT ABSOLUTE /end AXIS_DESCR
 /begin AXIS_DESCR STD_AXIS SCRMod_tSCRBrick_mp Temp_Cels 16 -50.04000 999.9600 EXTENDED_LIMITS -3549.940 3003.560 DEPOSIT ABSOLUTE /end AXIS_DESCR
/end CHARACTERISTIC
/begin CHARACTERISTIC SCRMod_etaSCRAge_CUR "Einfluss des SCR Alters auf seinen Wirkungsgrad" CURVE 0x8005F682 Cur_Xs16Ws16 1.000000 SCR_Fact1000 0.00 1.000000 FORMAT "%8.6" EXTENDED_LIMITS -32.76800 32.76700
 /begin AXIS_DESCR STD_AXIS SCRMod_facEffSCRAge SCR_Fact1000 16 0.00 1.000000 FORMAT "%8.6" EXTENDED_LIMITS -32.76800 32.76700 DEPOSIT ABSOLUTE /end AXIS_DESCR
/end CHARACTERISTIC
/begin CHARACTERISTIC SCRMod_etaTempNH3Ld_MAP "SCR Wirkungsgrad in Abhängigkeit von Temperatur und NH3 Füllstand" MAP 0x8005F6C4 Map_Xs16Ys16Ws16 1.000000 SCR_Fact1000 0.00 1.000000 FORMAT "%8.6" EXTENDED_LIMITS -32.76800 32.76700
 /begin AXIS_DESCR STD_AXIS SCRMod_mEstNH3Ld SCR_Mass1000 16 0.00 32.00000 FORMAT "%8.5" EXTENDED_LIMITS -32.76800 32.76700 DEPOSIT ABSOLUTE /end AXIS_DESCR
 /begin AXIS_DESCR STD_AXIS SCRMod_tSCRBrick_mp Temp_Cels 16 -50.04000 999.9600 EXTENDED_LIMITS -3549.940 3003.560 DEPOSIT ABSOLUTE /end AXIS_DESCR
/end CHARACTERISTIC
/begin CHARACTERISTIC SCRMod_facEffOxiAge_TC "Testlabel" VALUE 0x8005F908 Val_Ws16 1.000000 SCR_Fact1000 0.00 1.000000 FORMAT "%8.6" EXTENDED_LIMITS -32.76800 32.76700 /end CHARACTERISTIC
/begin CHARACTERISTIC SCRMod_facEffSCRAge_TC "Testlabel" VALUE 0x8005F90A Val_Ws16 1.000000 SCR_Fact1000 0.00 1.000000 FORMAT "%8.6" EXTENDED_LIMITS -32.76800 32.76700 /end CHARACTERISTIC
/begin CHARACTERISTIC SCRMod_facKiNH3Ld_C "Integraler Gewinn für NH3 Füllstand" VALUE 0x8005FC4E Val_Ws16 1.000000 SCR_Fact10000 0.00 1.000000 FORMAT "%8.6" EXTENDED_LIMITS -3.276800 3.276700 /end CHARACTERISTIC
/begin CHARACTERISTIC SCRMod_facReacRdcAg_CUR "Möglicher NOx Umsatzfaktor in Abhängigkeit der SCR Scheibentemperatur" CURVE 0x8005F90C Cur_Xs16Ws16 1.000000 SCR_Fact1000 0.00 1.000000 FORMAT "%8.6" EXTENDED_LIMITS -32.76800 32.76700
 /begin AXIS_DESCR STD_AXIS SCRMod_tSCRBrick_mp Temp_Cels 16 -50.04000 999.9600 EXTENDED_LIMITS -3549.940 3003.560 DEPOSIT ABSOLUTE /end AXIS_DESCR
/end CHARACTERISTIC
/begin CHARACTERISTIC SCRMod_facWgh1_C "Wichtungsfaktor für den SCR Scheibenwirkungsgrad" VALUE 0x8005F94E Val_Ws16 100.0000 SCR_Fact10 0.00 100.0000 FORMAT "%8.4" EXTENDED_LIMITS -3276.800 3276.700 /end CHARACTERISTIC
/begin CHARACTERISTIC SCRMod_facWgh2_C "Wichtungsfaktor für den SCR Scheibenwirkungsgrad" VALUE 0x8005F950 Val_Ws16 100.0000 SCR_Fact10 0.00 100.0000 FORMAT "%8.4" EXTENDED_LIMITS -3276.800 3276.700 /end CHARACTERISTIC
/begin CHARACTERISTIC SCRMod_facWgh3_C "Wichtungsfaktor für den SCR Scheibenwirkungsgrad" VALUE 0x8005F952 Val_Ws16 100.0000 SCR_Fact10 0.00 100.0000 FORMAT "%8.4" EXTENDED_LIMITS -3276.800 3276.700 /end CHARACTERISTIC
/begin CHARACTERISTIC SCRMod_facWgh4_C "Wichtungsfaktor für den SCR Scheibenwirkungsgrad" VALUE 0x8005F954 Val_Ws16 100.0000 SCR_Fact10 0.00 100.0000 FORMAT "%8.4" EXTENDED_LIMITS -3276.800 3276.700 /end CHARACTERISTIC
/begin CHARACTERISTIC SCRMod_facWgh5_C "Wichtungsfaktor für den SCR Scheibenwirkungsgrad" VALUE 0x8005F956 Val_Ws16 100.0000 SCR_Fact10 0.00 100.0000 FORMAT "%8.4" EXTENDED_LIMITS -3276.800 3276.700 /end CHARACTERISTIC
/begin CHARACTERISTIC SCRMod_facWgh6_C "Wichtungsfaktor für den SCR Scheibenwirkungsgrad" VALUE 0x8005F958 Val_Ws16 100.0000 SCR_Fact10 0.00 100.0000 FORMAT "%8.4" EXTENDED_LIMITS -3276.800 3276.700 /end CHARACTERISTIC
/begin CHARACTERISTIC SCRMod_mEstNH3Ld_TC "Testlabel" VALUE 0x8005F95A Val_Ws16 32.00000 SCR_Mass1000 0.00 32.00000 FORMAT "%8.5" EXTENDED_LIMITS -32.76800 32.76700 /end CHARACTERISTIC
/begin CHARACTERISTIC SCRMod_mIniNH3Ld_C "Initialisierungswert für NH3 Füllstand" VALUE 0x8005FC50 Val_Ws16 32.00000 SCR_Mass1000 0.00 32.00000 FORMAT "%8.5" EXTENDED_LIMITS -32.76800 32.76700 /end CHARACTERISTIC
/begin CHARACTERISTIC SCRMod_mMaxNH3Ld_C "Maximalwert NH3 Füllstand" VALUE 0x8005FC52 Val_Ws16 32.00000 SCR_Mass1000 0.00 32.00000 FORMAT "%8.5" EXTENDED_LIMITS -32.76800 32.76700 /end CHARACTERISTIC
/begin CHARACTERISTIC SCRMod_numMapSel_CUR "Tabellen Auswahlfaktor in Abhängigkeit des NO2 / NOx Verhältnises" CURVE 0x8005F95C Cur_Xs16Ws16 3.000000 SCR_Fact100 0.00 3.000000 FORMAT "%8.6" EXTENDED_LIMITS -327.6800 327.6700
 /begin AXIS_DESCR STD_AXIS SCRMod_rNO2NOx_mp SCR_Fact1000 5 0.00 1.000000 FORMAT "%8.6" EXTENDED_LIMITS -32.76800 32.76700 DEPOSIT ABSOLUTE /end AXIS_DESCR
/end CHARACTERISTIC
/begin CHARACTERISTIC SCRMod_rNO2NOxAge_MAP "NO2 / NOx Verhältnis im gealterten SCR in Abhängigkeit der Oxi-Kat. Temperatur und des Abgasmassenstroms" MAP 0x8005F972 Map_Xs16Ys16Ws16 1.000000 SCR_Fact1000 0.00 1.000000 FORMAT "%8.6" EXTENDED_LIMITS -32.76800 32.76700
 /begin AXIS_DESCR STD_AXIS SCRMod_tOxiCat_mp Temp_Cels 12 -3549.940 3003.560 DEPOSIT ABSOLUTE /end AXIS_DESCR
 /begin AXIS_DESCR STD_AXIS SCRMod_dmEG_mp AirMassPerTime 12 -3276.800 3276.700 DEPOSIT ABSOLUTE /end AXIS_DESCR
/end CHARACTERISTIC
/begin CHARACTERISTIC SCRMod_rNO2NOx_MAP "NO2 / NOx Verhältnis im SCR in Abhängigkeit der Oxi-Kat. Temperatur und des Abgasmassenstroms" MAP 0x8005FAC6 Map_Xs16Ys16Ws16 1.000000 SCR_Fact1000 0.00 1.000000 FORMAT "%8.6" EXTENDED_LIMITS -32.76800 32.76700
 /begin AXIS_DESCR STD_AXIS SCRMod_tOxiCat_mp Temp_Cels 12 -3549.940 3003.560 DEPOSIT ABSOLUTE /end AXIS_DESCR
 /begin AXIS_DESCR STD_AXIS SCRMod_dmEG_mp AirMassPerTime 12 -3276.800 3276.700 DEPOSIT ABSOLUTE /end AXIS_DESCR
/end CHARACTERISTIC
/begin CHARACTERISTIC SCRMod_rPPMNOxUs_TC "Testlabel" VALUE 0x8005FC1A Val_Ws16 2500.000 OneToOne 0.00 2500.000 EXTENDED_LIMITS -32768.00 32767.00 /end CHARACTERISTIC
/begin CHARACTERISTIC SCRMod_swt6BrickEna_C "Wahlschalter für 1 Scheiben oder 6 Scheiben Modell des SCR Katalysators" VALUE 0x8005FC1C Val_Ws16 1.00000000000 SCRMod_Compu_Switch_2 0.00 1.00000000000 FORMAT "%13.11" /end CHARACTERISTIC
/begin CHARACTERISTIC SCRMod_swtIniNH3Ld_C "Wahlschalter für Initialisierungswert des NH3 Integrators" VALUE 0x8005FC54 Val_Wu8 1.00000000000 SCRAd_Compu_Switch_3 0.00 1.00000000000 FORMAT "%13.11" /end CHARACTERISTIC
/begin CHARACTERISTIC SCRMod_swtNO2Sel_C "Wahlschalter für den NO2 / NOx Einfluss" VALUE 0x8005FC1E Val_Wu8 1.00000000000 SCRMod_Compu_Switch_1 0.00 1.00000000000 FORMAT "%13.11" /end CHARACTERISTIC
/begin CHARACTERISTIC SCRMod_swtSortEna_C "Wahlschalter für den Sortieralgorithmus" VALUE 0x8005FC1F Val_Wu8 1.00000000000 SCRMod_Compu_Switch_2 0.00 1.00000000000 FORMAT "%13.11" /end CHARACTERISTIC
/begin CHARACTERISTIC SCRMod_swtTestEna_C "Testlabel" VALUE 0x8005FC20 Val_Wu8 1.00000000000 SCRMod_Compu_Switch_2 0.00 1.00000000000 FORMAT "%13.11" /end CHARACTERISTIC
/begin CHARACTERISTIC SCRMod_tiDdTNOx_CUR "Laufzeit des NOx durch den SCR Katalysator" CURVE 0x8005FC22 Cur_Xs16Ws16 10.00000 SCR_Time100 0.00 10.00000 FORMAT "%8.5" EXTENDED_LIMITS -327.6800 327.6700
 /begin AXIS_DESCR STD_AXIS SCRMod_dmEG_mp AirMassPerTime 10 0.00 1400.000 EXTENDED_LIMITS -3276.800 3276.700 DEPOSIT ABSOLUTE /end AXIS_DESCR
/end CHARACTERISTIC
/begin CHARACTERISTIC SCRMod_tiRatNO2NOxFlt_C "Zeitkonstante für die Filterung des NO2 / NOx Verhältnises (upstream SCR-Cat)" VALUE 0x8005FC4C Val_Ws16 655.3500 SCR_Time100 -327.6800 327.6700 FORMAT "%8.4" /end CHARACTERISTIC
/begin CHARACTERISTIC SCRMon_lPresLineInrDiam_C "Innendurchmesser Druckleitung" VALUE 0x8005FC58 Val_Ws16 32.00000 SCR_Length1000_mm 0.00 32.00000 FORMAT "%8.5" EXTENDED_LIMITS -32.76800 32.76700 /end CHARACTERISTIC
/begin CHARACTERISTIC SCRMon_lPresLineLngth_C "Länge Druckleitung" VALUE 0x8005FC5A Val_Ws16 32000.00 SCR_Length_mm 0.00 32000.00 FORMAT "%8.2" EXTENDED_LIMITS -32768.00 32767.00 /end CHARACTERISTIC
/begin CHARACTERISTIC SCRMon_nEngOff_C "Drehzahlschwelle -> Motor aus" VALUE 0x8005FC5C Val_Ws16 16000.00 EngN 0.00 16000.00 EXTENDED_LIMITS -16384.00 16383.50 /end CHARACTERISTIC
/begin CHARACTERISTIC SCRMon_nEngOn_C "Drehzahlschwelle -> Motor an" VALUE 0x8005FC5E Val_Ws16 16000.00 EngN 0.00 16000.00 EXTENDED_LIMITS -16384.00 16383.50 /end CHARACTERISTIC
/begin CHARACTERISTIC SCRMon_numPresBuildUpErr_C "Schwelle für die Heilbarkeit von fehlgeschlagenen Druckaufbauversuchen" VALUE 0x8005FC60 Val_Wu8 30.00 OneToOne 0.00 30.00 EXTENDED_LIMITS 0.00 255.0 /end CHARACTERISTIC
/begin CHARACTERISTIC SCRMon_numRepPresBuildUp_C "Anzahl erlaubter EXIT_FCT_LOOPs" VALUE 0x8005FC61 Val_Wu8 30.00 OneToOne 0.00 30.00 EXTENDED_LIMITS 0.00 255.0 /end CHARACTERISTIC
/begin CHARACTERISTIC SCRMon_pMetCtlMax_C "Maximale Druckschwelle im Zustand Meteringcontrol" VALUE 0x8005FC62 Val_Ws16 3500.000 Pres_hPa 0.00 3500.000 EXTENDED_LIMITS -32768.00 32767.00 /end CHARACTERISTIC
/begin CHARACTERISTIC SCRMon_pMetCtlMin_C "Minimale Druckschwelle im Zustand Meteringcontrol" VALUE 0x8005FC64 Val_Ws16 3500.000 Pres_hPa 0.00 3500.000 EXTENDED_LIMITS -32768.00 32767.00 /end CHARACTERISTIC
/begin CHARACTERISTIC SCRMon_pPresBuildUpThres_C "Druckschwelle für einen erfolgreichen Druckaufbau" VALUE 0x8005FC66 Val_Ws16 3500.000 Pres_hPa 0.00 3500.000 EXTENDED_LIMITS -32768.00 32767.00 /end CHARACTERISTIC
/begin CHARACTERISTIC SCRMon_pPresRdcThres_C "Druckschwelle für einen erfolgreichen Druckabbau" VALUE 0x8005FC68 Val_Ws16 3500.000 Pres_hPa 0.00 3500.000 EXTENDED_LIMITS -32768.00 32767.00 /end CHARACTERISTIC
/begin CHARACTERISTIC SCRMon_rAftrunEmptMinLdSt_C "" VALUE 0x8005FC6A Val_Ws16 100.0000 DtyCyc 0.00 100.0000 EXTENDED_LIMITS -327.6800 327.6700 /end CHARACTERISTIC
/begin CHARACTERISTIC SCRMon_rFacEmpt_C "Korrekturfaktor Entleeren []" VALUE 0x8005FC6C Val_Ws16 3.000000 SCR_Fact10000 0.00 3.000000 FORMAT "%8.6" EXTENDED_LIMITS -3.276800 3.276700 /end CHARACTERISTIC
/begin CHARACTERISTIC SCRMon_rhoRdcAgnt_C "Dichte des Reduktionsmittels" VALUE 0x8005FC6E Val_Ws16 320.0000 SCR_Rho_g_p_ml 0.00 320.0000 FORMAT "%8.4" EXTENDED_LIMITS -327.6800 327.6700 /end CHARACTERISTIC
/begin CHARACTERISTIC SCRMon_rMaxAftrunEmpt_C "" VALUE 0x8005FC70 Val_Ws16 100.0000 DtyCyc 0.00 100.0000 EXTENDED_LIMITS -327.6800 327.6700 /end CHARACTERISTIC
/begin CHARACTERISTIC SCRMon_rMaxReFl_C "Obere Integratorschranke im Unterzustand REFILL" VALUE 0x8005FC72 Val_Ws16 100.0000 DtyCyc 0.00 100.0000 EXTENDED_LIMITS -327.6800 327.6700 /end CHARACTERISTIC
/begin CHARACTERISTIC SCRMon_rReFlMaxLdSt_C "Obere Befüllgrenze im Unterzustand REFILL" VALUE 0x8005FC74 Val_Ws16 100.0000 DtyCyc 0.00 100.0000 EXTENDED_LIMITS -327.6800 327.6700 /end CHARACTERISTIC
/begin CHARACTERISTIC SCRMon_rUDosVlv_CUR "Kennlinie" CURVE 0x8005FC76 Cur_Xs16Ws16 1.000000 SCR_Fact10000 0.00 1.000000 FORMAT "%8.6" EXTENDED_LIMITS -3.276800 3.276700
 /begin AXIS_DESCR STD_AXIS UDosVlv_rPs DtyCyc 4 -327.6800 327.6700 DEPOSIT ABSOLUTE /end AXIS_DESCR
/end CHARACTERISTIC
/begin CHARACTERISTIC SCRMon_rUPmpMot_CUR "Kennlinie" CURVE 0x8005FC88 Cur_Xs16Ws16 32.00000 SCR_DisFlow_kg_p_h 0.00 32.00000 FORMAT "%8.5" EXTENDED_LIMITS -32.76800 32.76700
 /begin AXIS_DESCR STD_AXIS UPmpMot_rPs DtyCyc 12 -327.6800 327.6700 DEPOSIT ABSOLUTE /end AXIS_DESCR
/end CHARACTERISTIC
/begin CHARACTERISTIC SCRMon_stEnfShOffEnbl_C "Aktivierung - Notaus" VALUE 0x8005FCBA Val_Wu8 1.000 OneToOne 0.00 1.000 EXTENDED_LIMITS 0.00 255.0 /end CHARACTERISTIC
/begin CHARACTERISTIC SCRMon_stUHC_C "Applikation - Powerstatus" VALUE 0x8005FCBB Val_Wu8 3.00000000000 SCRMon_UHC_St 0.00 3.00000000000 FORMAT "%13.11" /end CHARACTERISTIC
/begin CHARACTERISTIC SCRMon_swtDSMDis_C "Deaktivierung DSM" VALUE 0x8005FC56 Val_Wu8 1.000 OneToOne 0.00 1.000 EXTENDED_LIMITS 0.00 255.0 /end CHARACTERISTIC
/begin CHARACTERISTIC SCRMon_swtEngWaitDis_C "" VALUE 0x8005FCBC Val_Wu8 1.000 OneToOne 0.00 1.000 EXTENDED_LIMITS 0.00 255.0 /end CHARACTERISTIC
/begin CHARACTERISTIC SCRMon_tiAftrunTempWait_CUR "CatTemperatur -> Abkühlzeit" CURVE 0x8005FCBE Cur_Xs16Ws16 3000.000 SCR_Time10 0.00 3000.000 FORMAT "%8.3" EXTENDED_LIMITS -3276.800 3276.700
 /begin AXIS_DESCR STD_AXIS SCR_tUCatUsT Temp_Cels 16 -3549.940 3003.560 DEPOSIT ABSOLUTE /end AXIS_DESCR
/end CHARACTERISTIC
/begin CHARACTERISTIC SCRMon_tiTmrAftrunEmpt_C "" VALUE 0x8005FD00 Val_Wu32 320000000.000 Time_ms 0.00 320000000.000 EXTENDED_LIMITS 0.00 42949672950.0 /end CHARACTERISTIC
/begin CHARACTERISTIC SCRMon_tiTmrPresBuildUp_C "Timeout für Druckaufbau" VALUE 0x8005FD04 Val_Wu32 320000000.000 Time_ms 0.00 320000000.000 EXTENDED_LIMITS 0.00 42949672950.0 /end CHARACTERISTIC
/begin CHARACTERISTIC SCRMon_tiTmrPresRdc_C "Timeout für Druckabbau" VALUE 0x8005FD08 Val_Wu32 320000000.000 Time_ms 0.00 320000000.000 EXTENDED_LIMITS 0.00 42949672950.0 /end CHARACTERISTIC
/begin CHARACTERISTIC SCRMon_tiTmrStByCANDly_C "Delay im STANDBY - Sicherheitspuffer bis CAN-Werte vorhanden" VALUE 0x8005FD0C Val_Wu32 320000000.000 Time_ms 0.00 320000000.000 EXTENDED_LIMITS 0.00 42949672950.0 /end CHARACTERISTIC
/begin CHARACTERISTIC SCRMon_tiTmrVtln_C "Dauer der Entlüftung" VALUE 0x8005FD10 Val_Wu32 320000000.000 Time_ms 0.00 320000000.000 EXTENDED_LIMITS 0.00 42949672950.0 /end CHARACTERISTIC
/begin CHARACTERISTIC SCRMon_tUCatUstMin_C "Minimale Kattemperatur" VALUE 0x8005FD14 Val_Ws16 2100.000 Temp_Cels -100.0400 1999.960 EXTENDED_LIMITS -3549.940 3003.560 /end CHARACTERISTIC
/begin CHARACTERISTIC SCRMon_volSplyModule_C "Fördermodulvolumen" VALUE 0x8005FD16 Val_Ws16 3200.000 volAdd_ml 0.00 3200.000 FORMAT "%8.3" EXTENDED_LIMITS -3276.800 3276.700 /end CHARACTERISTIC
/begin CHARACTERISTIC SCRT_arCatSurfBrick_C "Manteloberfläche einer SCR Katalysatorscheibe" VALUE 0x8005FD18 Val_Ws16 1.000000 SCR_Area_m057m 0.00 1.000000 FORMAT "%8.6" EXTENDED_LIMITS -32.76800 32.76700 /end CHARACTERISTIC
/begin CHARACTERISTIC SCRT_cpBrick_C "Wärmekapazität einer SCR Katalysatorscheibe" VALUE 0x8005FD1A Val_Ws16 3000.000 SCR_cp_J_057kgK 0.00 3000.000 FORMAT "%8.3" EXTENDED_LIMITS -6553.600 6553.400 /end CHARACTERISTIC
/begin CHARACTERISTIC SCRT_cpEGBrick_C "Wärmekapazität des Abgases in einer Katalysatorscheibe" VALUE 0x8005FD1C Val_Ws16 3000.000 SCR_cp_J_057kgK 0.00 3000.000 FORMAT "%8.3" EXTENDED_LIMITS -6553.600 6553.400 /end CHARACTERISTIC
/begin CHARACTERISTIC SCRT_facWghUs_C "Wichtungsfaktor" VALUE 0x8005FD1E Val_Ws16 1.000000 Fact 0.00 1.000000 EXTENDED_LIMITS -4.000000 3.999878 /end CHARACTERISTIC
/begin CHARACTERISTIC SCRT_htcSCR_CUR "Wärmeübergangskoefizient Katalysator an Umgebung" CURVE 0x8005FD20 Cur_Xs16Ws16 3000.000 SCR_htc_W_057057mK 0.00 3000.000 FORMAT "%8.3" EXTENDED_LIMITS -3276.800 3276.700 /begin AXIS_DESCR STD_AXIS VehV_v Vel 4 -327.6800 327.6700 DEPOSIT ABSOLUTE /end AXIS_DESCR /end CHARACTERISTIC
/begin CHARACTERISTIC SCRT_mBrick_C "Masse einer SCR Katalysatorscheibe" VALUE 0x8005FD32 Val_Ws16 10.00000 SCR_Mass_057kg 0.00 10.00000 FORMAT "%8.5" EXTENDED_LIMITS -32.76800 32.76700 /end CHARACTERISTIC
/begin CHARACTERISTIC Shtr_ctDebAKKErrEntrMax_C "" VALUE 0x8005FD86 Kw_Wu16 255.0000 OneToOne 0.00 255.0000 EXTENDED_LIMITS 0.00 65535.00 /end CHARACTERISTIC
/begin CHARACTERISTIC Shtr_ctDebIncAKKErrEntr_C "" VALUE 0x8005FD88 Kw_Wu16 255.0000 OneToOne 0.00 255.0000 EXTENDED_LIMITS 0.00 65535.00 /end CHARACTERISTIC
/begin CHARACTERISTIC Shtr_ctDebIncPKKErrEntr_C "" VALUE 0x8005FD8A Kw_Wu16 255.0000 OneToOne 0.00 255.0000 EXTENDED_LIMITS 0.00 65535.00 /end CHARACTERISTIC
/begin CHARACTERISTIC Shtr_ctDebPKKErrEntrMax_C "" VALUE 0x8005FD8C Kw_Wu16 255.0000 OneToOne 0.00 255.0000 EXTENDED_LIMITS 0.00 65535.00 /end CHARACTERISTIC
/begin CHARACTERISTIC Shtr_ctPKKLrnThres_C "" VALUE 0x8005FD46 Kw_Wu8 255.0 OneToOne 0.00 255.0 /end CHARACTERISTIC
/begin CHARACTERISTIC Shtr_ctPwrStgOnMax_C "" VALUE 0x8005FD8E Kw_Wu16 65535.00 OneToOne 0.00 65535.00 /end CHARACTERISTIC
/begin CHARACTERISTIC Shtr_ctSysCntThres_C "" VALUE 0x8005FD82 Kw_Wu16 255.0000 OneToOne 0.00 255.0000 EXTENDED_LIMITS 0.00 65535.00 /end CHARACTERISTIC
/begin CHARACTERISTIC Shtr_Pwm.tiPer_C "Struktur, die Kalibrierungs- und Umsetzungsdatentypen für den Schiebersteller enthält/" VALUE 0x8005FD54 Kw_Ws16 9.900000 Period 0.1000000 10.00000 FORMAT "%8.5" EXTENDED_LIMITS -3276.800 3276.700 /end CHARACTERISTIC
/begin CHARACTERISTIC Shtr_Pwm.stLvl_C "Struktur, die Kalibrierungs- und Umsetzungsdatentypen für den Schiebersteller enthält/" VALUE 0x8005FD56 Kw_Wu8 1.000 OneToOne 0.00 1.000 EXTENDED_LIMITS 0.00 255.0 /end CHARACTERISTIC
/begin CHARACTERISTIC Shtr_Pwm.rMaxDty_C "Struktur, die Kalibrierungs- und Umsetzungsdatentypen für den Schiebersteller enthält/" VALUE 0x8005FD58 Kw_Ws16 100.0000 DtyCyc 0.00 100.0000 EXTENDED_LIMITS -327.6800 327.6700 /end CHARACTERISTIC
/begin CHARACTERISTIC Shtr_Pwm.rPerUn_C "Struktur, die Kalibrierungs- und Umsetzungsdatentypen für den Schiebersteller enthält/" VALUE 0x8005FD5A Kw_Ws16 3276.700 Period 0.00 3276.700 FORMAT "%8.3" EXTENDED_LIMITS -3276.800 3276.700 /end CHARACTERISTIC
/begin CHARACTERISTIC Shtr_Pwm.tiPh_C "Struktur, die Kalibrierungs- und Umsetzungsdatentypen für den Schiebersteller enthält/" VALUE 0x8005FD5C Kw_Ws16 65535.00 OneToOne -32768.00 32767.00 /end CHARACTERISTIC
/begin CHARACTERISTIC Shtr_PwmOut.rMin_C "Struktur, die Parameters zur PWM Ausgangsendstufen-Fehlerbehandlung für den Schiebersteller enthält/" VALUE 0x8005FD5E Kw_Ws16 100.0000 DtyCyc 0.00 100.0000 EXTENDED_LIMITS -327.6800 327.6700 /end CHARACTERISTIC
/begin CHARACTERISTIC Shtr_PwmOut.rMax_C "Struktur, die Parameters zur PWM Ausgangsendstufen-Fehlerbehandlung für den Schiebersteller enthält/" VALUE 0x8005FD60 Kw_Ws16 100.0000 DtyCyc 0.00 100.0000 EXTENDED_LIMITS -327.6800 327.6700 /end CHARACTERISTIC
/begin CHARACTERISTIC Shtr_PwmOut.tiBtwTstSCB_C "Struktur, die Parameters zur PWM Ausgangsendstufen-Fehlerbehandlung für den Schiebersteller enthält/" VALUE 0x8005FD62 Kw_Ws16 1000.000 Time_ms 0.00 1000.000 EXTENDED_LIMITS -327680.0 327670.0 /end CHARACTERISTIC
/begin CHARACTERISTIC Shtr_PwmOut.tiBtwTstOT_C "Struktur, die Parameters zur PWM Ausgangsendstufen-Fehlerbehandlung für den Schiebersteller enthält/" VALUE 0x8005FD64 Kw_Ws16 1000.000 Time_s 0.00 1000.000 EXTENDED_LIMITS -327.6800 327.6700 /end CHARACTERISTIC
/begin CHARACTERISTIC Shtr_PwmOut.numTstMax_C "Struktur, die Parameters zur PWM Ausgangsendstufen-Fehlerbehandlung für den Schiebersteller enthält/" VALUE 0x8005FD66 Kw_Wu16 65535.00 OneToOne 0.00 65535.00 /end CHARACTERISTIC
/begin CHARACTERISTIC Shtr_PwmOut.swtBattCor_C "Struktur, die Parameters zur PWM Ausgangsendstufen-Fehlerbehandlung für den Schiebersteller enthält/" VALUE 0x8005FD68 Kw_Wu8 1.000 OneToOne 0.00 1.000 EXTENDED_LIMITS 0.00 255.0 /end CHARACTERISTIC
/begin CHARACTERISTIC Shtr_PwmOut.swtPsInv_C "Struktur, die Parameters zur PWM Ausgangsendstufen-Fehlerbehandlung für den Schiebersteller enthält/" VALUE 0x8005FD69 Kw_Wu8 1.000 OneToOne 0.00 1.000 EXTENDED_LIMITS 0.00 255.0 /end CHARACTERISTIC
/begin CHARACTERISTIC Shtr_rOffOffTst_C "" VALUE 0x8005FD6E Kw_Ws16 100.0000 DtyCyc 0.00 100.0000 EXTENDED_LIMITS -327.6800 327.6700 /end CHARACTERISTIC
/begin CHARACTERISTIC Shtr_rOffOnTst_C "" VALUE 0x8005FD70 Kw_Ws16 100.0000 DtyCyc 0.00 100.0000 EXTENDED_LIMITS -327.6800 327.6700 /end CHARACTERISTIC
/begin CHARACTERISTIC Shtr_rOnOffTst_C "" VALUE 0x8005FD72 Kw_Ws16 100.0000 DtyCyc 0.00 100.0000 EXTENDED_LIMITS -327.6800 327.6700 /end CHARACTERISTIC
/begin CHARACTERISTIC Shtr_rOnOnTst_C "" VALUE 0x8005FD74 Kw_Ws16 100.0000 DtyCyc 0.00 100.0000 EXTENDED_LIMITS -327.6800 327.6700 /end CHARACTERISTIC
/begin CHARACTERISTIC Shtr_rOutDiag_C "" VALUE 0x8005FD76 Kw_Ws16 100.0000 DtyCyc 0.00 100.0000 EXTENDED_LIMITS -327.6800 327.6700 /end CHARACTERISTIC
/begin CHARACTERISTIC Shtr_rOutInit_C "" VALUE 0x8005FD78 Kw_Ws16 100.0000 DtyCyc 0.00 100.0000 EXTENDED_LIMITS -327.6800 327.6700 /end CHARACTERISTIC
/begin CHARACTERISTIC Shtr_rOutMan_C "" VALUE 0x8005FD7A Kw_Ws16 100.0000 DtyCyc 0.00 100.0000 EXTENDED_LIMITS -327.6800 327.6700 /end CHARACTERISTIC
/begin CHARACTERISTIC Shtr_rOutMax_C "" VALUE 0x8005FD90 Kw_Ws16 100.0000 DtyCyc 0.00 100.0000 EXTENDED_LIMITS -327.6800 327.6700 /end CHARACTERISTIC
/begin CHARACTERISTIC Shtr_rOutMin_C "" VALUE 0x8005FD92 Kw_Ws16 100.0000 DtyCyc 0.00 100.0000 EXTENDED_LIMITS -327.6800 327.6700 /end CHARACTERISTIC
/begin CHARACTERISTIC Shtr_rOutPKKLrn_C "" VALUE 0x8005FD7C Kw_Ws16 100.0000 DtyCyc 0.00 100.0000 EXTENDED_LIMITS -327.6800 327.6700 /end CHARACTERISTIC
/begin CHARACTERISTIC Shtr_rPsDisbl_C "Ausgangstastverhältniswert während die Schieberstellerendstufe gesperrt ist" VALUE 0x8005FD6A Val_Ws16 655.3500 DtyCyc -327.6800 327.6700 /end CHARACTERISTIC
/begin CHARACTERISTIC Shtr_stAKKErrRls_C "" VALUE 0x8005FD94 Kw_Wu8 255.0 OneToOne 0.00 255.0 /end CHARACTERISTIC
/begin CHARACTERISTIC Shtr_stManCtl_C "" VALUE 0x8005FD7E Kw_Wu8 1.000 OneToOne 0.00 1.000 EXTENDED_LIMITS 0.00 255.0 /end CHARACTERISTIC
/begin CHARACTERISTIC Shtr_stPKKActv_C "" VALUE 0x8005FD7F Kw_Wu8 1.000 OneToOne 0.00 1.000 EXTENDED_LIMITS 0.00 255.0 /end CHARACTERISTIC
/begin CHARACTERISTIC Shtr_stPsDisbl_C "Applikationsparameter zur Sperrung der Endstufe für den Schiebersteller unter bestimmten Batterie- und Motorbedingungen" VALUE 0x8005FD6C Val_Wu8 255.0 OneToOne 0.00 255.0 /end CHARACTERISTIC
/begin CHARACTERISTIC Shtr_stPwrStgDiag_C "" VALUE 0x8005FD96 Kw_Wu16 65535.00 OneToOne 0.00 65535.00 /end CHARACTERISTIC
/begin CHARACTERISTIC Shtr_tiAKKLrnThres_C "" VALUE 0x8005FD48 Kw_Wu16 25.00000 Time_s 0.00 25.00000 EXTENDED_LIMITS 0.00 655.3500 /end CHARACTERISTIC
/begin CHARACTERISTIC Shtr_tiAKKOkDeb_C "" VALUE 0x8005FD98 Kw_Wu16 25000.00 Time_ms 0.00 25000.00 EXTENDED_LIMITS 0.00 655350.0 /end CHARACTERISTIC
/begin CHARACTERISTIC Shtr_tiDebSelfDet_C "" VALUE 0x8005FD9A Kw_Wu16 65540.00 Time_ms 0.00 65540.00 EXTENDED_LIMITS 0.00 655350.0 /end CHARACTERISTIC
/begin CHARACTERISTIC Shtr_tiDiagDeb_C "" VALUE 0x8005FD9C Kw_Wu16 25000.00 Time_ms 0.00 25000.00 EXTENDED_LIMITS 0.00 655350.0 /end CHARACTERISTIC
/begin CHARACTERISTIC Shtr_tiPKKLrnThres_C "" VALUE 0x8005FD4A Kw_Wu16 25.00000 Time_s 0.00 25.00000 EXTENDED_LIMITS 0.00 655.3500 /end CHARACTERISTIC
/begin CHARACTERISTIC Shtr_tiPKKTimerMax_C "" VALUE 0x8005FD4C Kw_Wu16 25.00000 Time_s 0.00 25.00000 EXTENDED_LIMITS 0.00 655.3500 /end CHARACTERISTIC
/begin CHARACTERISTIC Shtr_tiPKKTimerMin_C "" VALUE 0x8005FD4E Kw_Wu16 25.00000 Time_s 0.00 25.00000 EXTENDED_LIMITS 0.00 655.3500 /end CHARACTERISTIC
/begin CHARACTERISTIC Shtr_tiSysDiagMax1_C "" VALUE 0x8005FD9E Kw_Wu16 25.50000 Time_s 0.00 25.50000 EXTENDED_LIMITS 0.00 655.3500 /end CHARACTERISTIC
/begin CHARACTERISTIC Shtr_tiSysDiagMax2_C "" VALUE 0x8005FDA0 Kw_Wu16 25.50000 Time_s 0.00 25.50000 EXTENDED_LIMITS 0.00 655.3500 /end CHARACTERISTIC
/begin CHARACTERISTIC Shtr_tiSysDiagMax3_C "" VALUE 0x8005FDA2 Kw_Wu16 25.50000 Time_s 0.00 25.50000 EXTENDED_LIMITS 0.00 655.3500 /end CHARACTERISTIC
/begin CHARACTERISTIC Shtr_tiSysDiagMax4_C "" VALUE 0x8005FDA4 Kw_Wu16 25.50000 Time_s 0.00 25.50000 EXTENDED_LIMITS 0.00 655.3500 /end CHARACTERISTIC
/begin CHARACTERISTIC Shtr_tiSysDiagMax5_C "" VALUE 0x8005FDA6 Kw_Wu16 25.50000 Time_s 0.00 25.50000 EXTENDED_LIMITS 0.00 655.3500 /end CHARACTERISTIC
/begin CHARACTERISTIC Shtr_tiSysDiagMax6_C "" VALUE 0x8005FDA8 Kw_Wu16 25.50000 Time_s 0.00 25.50000 EXTENDED_LIMITS 0.00 655.3500 /end CHARACTERISTIC
/begin CHARACTERISTIC Shtr_tiSysDiagMax_C "" VALUE 0x8005FDAA Kw_Wu16 25.50000 Time_s 0.00 25.50000 EXTENDED_LIMITS 0.00 655.3500 /end CHARACTERISTIC
/begin CHARACTERISTIC Shtr_tiSysDiagMin1_C "" VALUE 0x8005FDAC Kw_Wu16 25.50000 Time_s 0.00 25.50000 EXTENDED_LIMITS 0.00 655.3500 /end CHARACTERISTIC
/begin CHARACTERISTIC Shtr_tiSysDiagMin2_C "" VALUE 0x8005FDAE Kw_Wu16 25.50000 Time_s 0.00 25.50000 EXTENDED_LIMITS 0.00 655.3500 /end CHARACTERISTIC
/begin CHARACTERISTIC Shtr_tiSysDiagMin3_C "" VALUE 0x8005FDB0 Kw_Wu16 25.50000 Time_s 0.00 25.50000 EXTENDED_LIMITS 0.00 655.3500 /end CHARACTERISTIC
/begin CHARACTERISTIC Shtr_tiSysDiagMin4_C "" VALUE 0x8005FDB2 Kw_Wu16 25.50000 Time_s 0.00 25.50000 EXTENDED_LIMITS 0.00 655.3500 /end CHARACTERISTIC
/begin CHARACTERISTIC Shtr_tiSysDiagMin5_C "" VALUE 0x8005FDB4 Kw_Wu16 25.50000 Time_s 0.00 25.50000 EXTENDED_LIMITS 0.00 655.3500 /end CHARACTERISTIC
/begin CHARACTERISTIC Shtr_tiSysDiagMin6_C "" VALUE 0x8005FDB6 Kw_Wu16 25.50000 Time_s 0.00 25.50000 EXTENDED_LIMITS 0.00 655.3500 /end CHARACTERISTIC
/begin CHARACTERISTIC Shtr_tiSysRst_C "" VALUE 0x8005FD50 Kw_Wu16 655350.0 Time_ms 0.00 655350.0 /end CHARACTERISTIC
/begin CHARACTERISTIC Shtr_tiSysTstThres_C "" VALUE 0x8005FD84 Kw_Wu16 25.50000 Time_s 0.00 25.50000 EXTENDED_LIMITS 0.00 655.3500 /end CHARACTERISTIC
/begin CHARACTERISTIC Shtr_uBattMax_C "" VALUE 0x8005FD80 Kw_Ws16 6000.000 Volt_Batt 9000.000 15000.00 EXTENDED_LIMITS -655360.0 655340.0 /end CHARACTERISTIC
/begin CHARACTERISTIC Shtr_uBatt_C "" VALUE 0x8005FD52 Kw_Ws16 6000.000 Volt_Batt 9000.000 15000.00 EXTENDED_LIMITS -655360.0 655340.0 /end CHARACTERISTIC
/begin CHARACTERISTIC Signals_Mode1Pid_CA "Signals- Struktur für die Ablage von applizierbaren, linearen Umrechenformeln" VAL_BLK 0x8005FDC2 ValA_Wu8 255.0 OneToOne 0.00 255.0 NUMBER 32 /end CHARACTERISTIC
/begin CHARACTERISTIC Signals_Mode1SigNum_CA "Signals- Struktur für die Ablage von applizierbaren, linearen Umrechenformeln" VAL_BLK 0x8005FDE2 ValA_Wu16 702.000000000 Signals_IntSigNumVerb 0.00 702.000000000 FORMAT "%13.9" NUMBER 32 /end CHARACTERISTIC
/begin CHARACTERISTIC SmkLim_dSmkLim.Pos_C "/" VALUE 0x800665D8 Kw_Ws32 32767.9999847 RmpLmbd 0.00 32767.9999847 FORMAT "%13.7" EXTENDED_LIMITS -32768.0000000 32767.9999847 /end CHARACTERISTIC
/begin CHARACTERISTIC SmkLim_dSmkLim.Neg_C "/" VALUE 0x800665DC Kw_Ws32 32767.9999847 RmpLmbd 0.00 32767.9999847 FORMAT "%13.7" EXTENDED_LIMITS -32768.0000000 32767.9999847 /end CHARACTERISTIC
/begin CHARACTERISTIC SmkLim_facEnvPCorNeg_CUR "" CURVE 0x8005FE22 Kl_Xs16_Ws16 7.999878 Fact -4.000000 3.999878
 /begin AXIS_DESCR STD_AXIS EnvP_p Pres_hPa 6 0.00 3500.000 EXTENDED_LIMITS -32768.00 32767.00 DEPOSIT ABSOLUTE /end AXIS_DESCR
/end CHARACTERISTIC
/begin CHARACTERISTIC SmkLim_facEnvPCorPos_CUR "" CURVE 0x8005FE3C Kl_Xs16_Ws16 5.000000 Fact 0.00 5.000000 EXTENDED_LIMITS -4.000000 3.999878
 /begin AXIS_DESCR STD_AXIS EnvP_p Pres_hPa 6 0.00 3500.000 EXTENDED_LIMITS -32768.00 32767.00 DEPOSIT ABSOLUTE /end AXIS_DESCR
/end CHARACTERISTIC
/begin CHARACTERISTIC SmkLim_facLamAPSCorEOM1_CUR "" CURVE 0x800665E0 Kl_Xs16_Ws16 5.000000 Fact 0.00 5.000000 EXTENDED_LIMITS -4.000000 3.999878
 /begin AXIS_DESCR STD_AXIS EnvP_p Pres_hPa 8 0.00 3500.000 EXTENDED_LIMITS -32768.00 32767.00 DEPOSIT ABSOLUTE /end AXIS_DESCR
/end CHARACTERISTIC
/begin CHARACTERISTIC SmkLim_facLamAPSCorEOM2_CUR "" CURVE 0x80066602 Kl_Xs16_Ws16 5.000000 Fact 0.00 5.000000 EXTENDED_LIMITS -4.000000 3.999878
 /begin AXIS_DESCR STD_AXIS EnvP_p Pres_hPa 8 0.00 3500.000 EXTENDED_LIMITS -32768.00 32767.00 DEPOSIT ABSOLUTE /end AXIS_DESCR
/end CHARACTERISTIC
/begin CHARACTERISTIC SmkLim_facLamAPSCor_CUR "" CURVE 0x80066624 Kl_Xs16_Ws16 5.000000 Fact 0.00 5.000000 EXTENDED_LIMITS -4.000000 3.999878
 /begin AXIS_DESCR STD_AXIS EnvP_p Pres_hPa 8 0.00 3500.000 EXTENDED_LIMITS -32768.00 32767.00 DEPOSIT ABSOLUTE /end AXIS_DESCR
/end CHARACTERISTIC
/begin CHARACTERISTIC SmkLim_facLamATSCorEOM1_CUR "" CURVE 0x80066646 Kl_Xs16_Ws16 5.000000 Fact 0.00 5.000000 EXTENDED_LIMITS -4.000000 3.999878
 /begin AXIS_DESCR STD_AXIS Air_tAFS Temp_Cels 8 -50.04000 898.9600 EXTENDED_LIMITS -3549.940 3003.560 DEPOSIT ABSOLUTE /end AXIS_DESCR
/end CHARACTERISTIC
/begin CHARACTERISTIC SmkLim_facLamATSCorEOM2_CUR "" CURVE 0x80066668 Kl_Xs16_Ws16 5.000000 Fact 0.00 5.000000 EXTENDED_LIMITS -4.000000 3.999878
 /begin AXIS_DESCR STD_AXIS Air_tAFS Temp_Cels 8 -50.04000 898.9600 EXTENDED_LIMITS -3549.940 3003.560 DEPOSIT ABSOLUTE /end AXIS_DESCR
/end CHARACTERISTIC
/begin CHARACTERISTIC SmkLim_facLamATSCor_CUR "" CURVE 0x8006668A Kl_Xs16_Ws16 5.000000 Fact 0.00 5.000000 EXTENDED_LIMITS -4.000000 3.999878
 /begin AXIS_DESCR STD_AXIS Air_tAFS Temp_Cels 8 -50.04000 898.9600 EXTENDED_LIMITS -3549.940 3003.560 DEPOSIT ABSOLUTE /end AXIS_DESCR
/end CHARACTERISTIC
/begin CHARACTERISTIC SmkLim_facLamETSCor_CUR "" CURVE 0x800666AC Kl_Xs16_Ws16 5.000000 Fact 0.00 5.000000 EXTENDED_LIMITS -4.000000 3.999878
 /begin AXIS_DESCR STD_AXIS SmkLim_tSmkLim_mp Temp_Cels 8 -50.04000 898.9600 EXTENDED_LIMITS -3549.940 3003.560 DEPOSIT ABSOLUTE /end AXIS_DESCR
/end CHARACTERISTIC
/begin CHARACTERISTIC SmkLim_mAirPerCylMin_C "untere Begrenzung der Luftmasse" VALUE 0x800666CE Kw_Ws16 6553.500 AirMassPerCyl -3276.800 3276.700 /end CHARACTERISTIC
/begin CHARACTERISTIC SmkLim_mskOpMode_CA "" VAL_BLK 0x800666D0 ValA_Wu32 4294967295.00 OneToOne 0.00 4294967295.00 NUMBER 3 /end CHARACTERISTIC
/begin CHARACTERISTIC SmkLim_numRevEng_C "" VALUE 0x800666DC Kw_Wu16 65535.00 OneToOne 0.00 65535.00 /end CHARACTERISTIC
/begin CHARACTERISTIC SmkLim_numSmkLim_C "Index für Temperatur aus dem Motortemperaturfeld" VALUE 0x800666DE Kw_Wu8 2.00000000000 EngTempFldSel 0.00 2.00000000000 FORMAT "%13.11" EXTENDED_LIMITS 0.00 3.00000000000 /end CHARACTERISTIC
/begin CHARACTERISTIC SmkLim_pThresLam0EOM1_C "" VALUE 0x800666E0 Kw_Ws16 3500.000 Pres_hPa 0.00 3500.000 EXTENDED_LIMITS -32768.00 32767.00 /end CHARACTERISTIC
/begin CHARACTERISTIC SmkLim_pThresLam0EOM2_C "" VALUE 0x800666E2 Kw_Ws16 3500.000 Pres_hPa 0.00 3500.000 EXTENDED_LIMITS -32768.00 32767.00 /end CHARACTERISTIC
/begin CHARACTERISTIC SmkLim_pThresLam0Nrm_C "" VALUE 0x800666E4 Kw_Ws16 3500.000 Pres_hPa 0.00 3500.000 EXTENDED_LIMITS -32768.00 32767.00 /end CHARACTERISTIC
/begin CHARACTERISTIC SmkLim_pThresLam1EOM1_C "" VALUE 0x800666E6 Kw_Ws16 3500.000 Pres_hPa 0.00 3500.000 EXTENDED_LIMITS -32768.00 32767.00 /end CHARACTERISTIC
/begin CHARACTERISTIC SmkLim_pThresLam1EOM2_C "" VALUE 0x800666E8 Kw_Ws16 3500.000 Pres_hPa 0.00 3500.000 EXTENDED_LIMITS -32768.00 32767.00 /end CHARACTERISTIC
/begin CHARACTERISTIC SmkLim_pThresLam1Nrm_C "" VALUE 0x800666EA Kw_Ws16 3500.000 Pres_hPa 0.00 3500.000 EXTENDED_LIMITS -32768.00 32767.00 /end CHARACTERISTIC
/begin CHARACTERISTIC SmkLim_pThresLam2EOM1_C "" VALUE 0x800666EC Kw_Ws16 3500.000 Pres_hPa 0.00 3500.000 EXTENDED_LIMITS -32768.00 32767.00 /end CHARACTERISTIC
/begin CHARACTERISTIC SmkLim_pThresLam2EOM2_C "" VALUE 0x800666EE Kw_Ws16 3500.000 Pres_hPa 0.00 3500.000 EXTENDED_LIMITS -32768.00 32767.00 /end CHARACTERISTIC
/begin CHARACTERISTIC SmkLim_pThresLam2Nrm_C "" VALUE 0x800666F0 Kw_Ws16 3500.000 Pres_hPa 0.00 3500.000 EXTENDED_LIMITS -32768.00 32767.00 /end CHARACTERISTIC
/begin CHARACTERISTIC SmkLim_rLamAPSCorEOM1_MAP "" MAP 0x800666F2 Kf_Xs16_Ys16_Ws16 32.00000 lambda 0.00 32.00000 EXTENDED_LIMITS -32.76800 32.76700
 /begin AXIS_DESCR STD_AXIS Epm_nEng EngN 16 0.00 6000.000 EXTENDED_LIMITS -16384.00 16383.50 DEPOSIT ABSOLUTE /end AXIS_DESCR
 /begin AXIS_DESCR STD_AXIS SmkLim_mAirPerCyl AirMassPerCyl 16 0.00 2500.000 EXTENDED_LIMITS -3276.800 3276.700 DEPOSIT ABSOLUTE /end AXIS_DESCR
/end CHARACTERISTIC
/begin CHARACTERISTIC SmkLim_rLamAPSCorEOM2_MAP "" MAP 0x80066936 Kf_Xs16_Ys16_Ws16 32.00000 lambda 0.00 32.00000 EXTENDED_LIMITS -32.76800 32.76700
 /begin AXIS_DESCR STD_AXIS Epm_nEng EngN 16 0.00 6000.000 EXTENDED_LIMITS -16384.00 16383.50 DEPOSIT ABSOLUTE /end AXIS_DESCR
 /begin AXIS_DESCR STD_AXIS SmkLim_mAirPerCyl AirMassPerCyl 16 0.00 2500.000 EXTENDED_LIMITS -3276.800 3276.700 DEPOSIT ABSOLUTE /end AXIS_DESCR
/end CHARACTERISTIC
/begin CHARACTERISTIC SmkLim_rLamAPSCor_MAP "" MAP 0x80066B7A Kf_Xs16_Ys16_Ws16 32.00000 lambda 0.00 32.00000 EXTENDED_LIMITS -32.76800 32.76700
 /begin AXIS_DESCR STD_AXIS Epm_nEng EngN 16 0.00 6000.000 EXTENDED_LIMITS -16384.00 16383.50 DEPOSIT ABSOLUTE /end AXIS_DESCR
 /begin AXIS_DESCR STD_AXIS SmkLim_mAirPerCyl AirMassPerCyl 16 0.00 2500.000 EXTENDED_LIMITS -3276.800 3276.700 DEPOSIT ABSOLUTE /end AXIS_DESCR
/end CHARACTERISTIC
/begin CHARACTERISTIC SmkLim_rLamATSCorEOM1_MAP "" MAP 0x80066DBE Kf_Xs16_Ys16_Ws16 32.00000 lambda 0.00 32.00000 EXTENDED_LIMITS -32.76800 32.76700
 /begin AXIS_DESCR STD_AXIS Epm_nEng EngN 16 0.00 6000.000 EXTENDED_LIMITS -16384.00 16383.50 DEPOSIT ABSOLUTE /end AXIS_DESCR
 /begin AXIS_DESCR STD_AXIS SmkLim_mAirPerCyl AirMassPerCyl 16 0.00 2500.000 EXTENDED_LIMITS -3276.800 3276.700 DEPOSIT ABSOLUTE /end AXIS_DESCR
/end CHARACTERISTIC
/begin CHARACTERISTIC SmkLim_rLamATSCorEOM2_MAP "" MAP 0x80067002 Kf_Xs16_Ys16_Ws16 32.00000 lambda 0.00 32.00000 EXTENDED_LIMITS -32.76800 32.76700
 /begin AXIS_DESCR STD_AXIS Epm_nEng EngN 16 0.00 6000.000 EXTENDED_LIMITS -16384.00 16383.50 DEPOSIT ABSOLUTE /end AXIS_DESCR
 /begin AXIS_DESCR STD_AXIS SmkLim_mAirPerCyl AirMassPerCyl 16 0.00 2500.000 EXTENDED_LIMITS -3276.800 3276.700 DEPOSIT ABSOLUTE /end AXIS_DESCR
/end CHARACTERISTIC
/begin CHARACTERISTIC SmkLim_rLamATSCor_MAP "" MAP 0x80067246 Kf_Xs16_Ys16_Ws16 32.00000 lambda 0.00 32.00000 EXTENDED_LIMITS -32.76800 32.76700
 /begin AXIS_DESCR STD_AXIS Epm_nEng EngN 16 0.00 6000.000 EXTENDED_LIMITS -16384.00 16383.50 DEPOSIT ABSOLUTE /end AXIS_DESCR
 /begin AXIS_DESCR STD_AXIS SmkLim_mAirPerCyl AirMassPerCyl 16 0.00 2500.000 EXTENDED_LIMITS -3276.800 3276.700 DEPOSIT ABSOLUTE /end AXIS_DESCR
/end CHARACTERISTIC
/begin CHARACTERISTIC SmkLim_rLamETSCor_MAP "" MAP 0x8006748A Kf_Xs16_Ys16_Ws16 32.00000 lambda 0.00 32.00000 EXTENDED_LIMITS -32.76800 32.76700
 /begin AXIS_DESCR STD_AXIS Epm_nEng EngN 16 0.00 6000.000 EXTENDED_LIMITS -16384.00 16383.50 DEPOSIT ABSOLUTE /end AXIS_DESCR
 /begin AXIS_DESCR STD_AXIS SmkLim_mAirPerCyl AirMassPerCyl 16 0.00 2500.000 EXTENDED_LIMITS -3276.800 3276.700 DEPOSIT ABSOLUTE /end AXIS_DESCR
/end CHARACTERISTIC
/begin CHARACTERISTIC SmkLim_rLamFullLd_MAP "Kennfeld zur Ermittlung des Lambda-Werts der motortemperaturabhängigen Vollasterhöhung" MAP 0x800676CE Kf_Xs16_Ys16_Ws16 64.00000 lambda -32.00000 32.00000 EXTENDED_LIMITS -32.76800 32.76700
 /begin AXIS_DESCR STD_AXIS Epm_nEng EngN 16 0.00 6000.000 EXTENDED_LIMITS -16384.00 16383.50 DEPOSIT ABSOLUTE /end AXIS_DESCR
 /begin AXIS_DESCR STD_AXIS SmkLim_tSmkLim_mp Temp_Cels 16 -273.1400 429.9600 EXTENDED_LIMITS -3549.940 3003.560 DEPOSIT ABSOLUTE /end AXIS_DESCR
/end CHARACTERISTIC
/begin CHARACTERISTIC SmkLim_rLamMax_C "maximales Lambda für Rauchbegrenzung" VALUE 0x80067912 Kw_Ws16 3.200000 lambda 0.00 3.200000 EXTENDED_LIMITS -32.76800 32.76700 /end CHARACTERISTIC
/begin CHARACTERISTIC SmkLim_rLamMin_C "minimales Lambda für Rauchbegrenzung" VALUE 0x80067914 Kw_Ws16 3.200000 lambda 0.00 3.200000 EXTENDED_LIMITS -32.76800 32.76700 /end CHARACTERISTIC
/begin CHARACTERISTIC SmkLim_rLamSmk2EOM1_MAP "" MAP 0x80067916 Kf_Xs16_Ys16_Ws16 32.00000 lambda 0.00 32.00000 EXTENDED_LIMITS -32.76800 32.76700
 /begin AXIS_DESCR STD_AXIS Epm_nEng EngN 16 0.00 6000.000 EXTENDED_LIMITS -16384.00 16383.50 DEPOSIT ABSOLUTE /end AXIS_DESCR
 /begin AXIS_DESCR STD_AXIS SmkLim_mAirPerCyl AirMassPerCyl 16 0.00 2500.000 EXTENDED_LIMITS -3276.800 3276.700 DEPOSIT ABSOLUTE /end AXIS_DESCR
/end CHARACTERISTIC
/begin CHARACTERISTIC SmkLim_rLamSmk2EOM2_MAP "" MAP 0x80067B5A Kf_Xs16_Ys16_Ws16 32.00000 lambda 0.00 32.00000 EXTENDED_LIMITS -32.76800 32.76700
 /begin AXIS_DESCR STD_AXIS Epm_nEng EngN 16 0.00 6000.000 EXTENDED_LIMITS -16384.00 16383.50 DEPOSIT ABSOLUTE /end AXIS_DESCR
 /begin AXIS_DESCR STD_AXIS SmkLim_mAirPerCyl AirMassPerCyl 16 0.00 2500.000 EXTENDED_LIMITS -3276.800 3276.700 DEPOSIT ABSOLUTE /end AXIS_DESCR
/end CHARACTERISTIC
/begin CHARACTERISTIC SmkLim_rLamSmk2UpperGbxEOM1_MAP "" MAP 0x80067D9E Kf_Xs16_Ys16_Ws16 32.00000 lambda 0.00 32.00000 EXTENDED_LIMITS -32.76800 32.76700
 /begin AXIS_DESCR STD_AXIS Epm_nEng EngN 16 0.00 6000.000 EXTENDED_LIMITS -16384.00 16383.50 DEPOSIT ABSOLUTE /end AXIS_DESCR
 /begin AXIS_DESCR STD_AXIS SmkLim_mAirPerCyl AirMassPerCyl 16 0.00 2500.000 EXTENDED_LIMITS -3276.800 3276.700 DEPOSIT ABSOLUTE /end AXIS_DESCR
/end CHARACTERISTIC
/begin CHARACTERISTIC SmkLim_rLamSmk2UpperGbxEOM2_MAP "" MAP 0x80067FE2 Kf_Xs16_Ys16_Ws16 32.00000 lambda 0.00 32.00000 EXTENDED_LIMITS -32.76800 32.76700
 /begin AXIS_DESCR STD_AXIS Epm_nEng EngN 16 0.00 6000.000 EXTENDED_LIMITS -16384.00 16383.50 DEPOSIT ABSOLUTE /end AXIS_DESCR
 /begin AXIS_DESCR STD_AXIS SmkLim_mAirPerCyl AirMassPerCyl 16 0.00 2500.000 EXTENDED_LIMITS -3276.800 3276.700 DEPOSIT ABSOLUTE /end AXIS_DESCR
/end CHARACTERISTIC
/begin CHARACTERISTIC SmkLim_rLamSmk2UpperGbx_MAP "" MAP 0x80068226 Kf_Xs16_Ys16_Ws16 32.00000 lambda 0.00 32.00000 EXTENDED_LIMITS -32.76800 32.76700
 /begin AXIS_DESCR STD_AXIS Epm_nEng EngN 16 0.00 6000.000 EXTENDED_LIMITS -16384.00 16383.50 DEPOSIT ABSOLUTE /end AXIS_DESCR
 /begin AXIS_DESCR STD_AXIS SmkLim_mAirPerCyl AirMassPerCyl 16 0.00 2500.000 EXTENDED_LIMITS -3276.800 3276.700 DEPOSIT ABSOLUTE /end AXIS_DESCR
/end CHARACTERISTIC
/begin CHARACTERISTIC SmkLim_rLamSmk2_MAP "" MAP 0x8006846A Kf_Xs16_Ys16_Ws16 32.00000 lambda 0.00 32.00000 EXTENDED_LIMITS -32.76800 32.76700
 /begin AXIS_DESCR STD_AXIS Epm_nEng EngN 16 0.00 6000.000 EXTENDED_LIMITS -16384.00 16383.50 DEPOSIT ABSOLUTE /end AXIS_DESCR
 /begin AXIS_DESCR STD_AXIS SmkLim_mAirPerCyl AirMassPerCyl 16 0.00 2500.000 EXTENDED_LIMITS -3276.800 3276.700 DEPOSIT ABSOLUTE /end AXIS_DESCR
/end CHARACTERISTIC
/begin CHARACTERISTIC SmkLim_rLamSmkEOM1_MAP "" MAP 0x800686AE Kf_Xs16_Ys16_Ws16 32.00000 lambda 0.00 32.00000 EXTENDED_LIMITS -32.76800 32.76700
 /begin AXIS_DESCR STD_AXIS Epm_nEng EngN 16 0.00 6000.000 EXTENDED_LIMITS -16384.00 16383.50 DEPOSIT ABSOLUTE /end AXIS_DESCR
 /begin AXIS_DESCR STD_AXIS SmkLim_mAirPerCyl AirMassPerCyl 16 0.00 2500.000 EXTENDED_LIMITS -3276.800 3276.700 DEPOSIT ABSOLUTE /end AXIS_DESCR
/end CHARACTERISTIC
/begin CHARACTERISTIC SmkLim_rLamSmkEOM2_MAP "" MAP 0x800688F2 Kf_Xs16_Ys16_Ws16 32.00000 lambda 0.00 32.00000 EXTENDED_LIMITS -32.76800 32.76700
 /begin AXIS_DESCR STD_AXIS Epm_nEng EngN 16 0.00 6000.000 EXTENDED_LIMITS -16384.00 16383.50 DEPOSIT ABSOLUTE /end AXIS_DESCR
 /begin AXIS_DESCR STD_AXIS SmkLim_mAirPerCyl AirMassPerCyl 16 0.00 2500.000 EXTENDED_LIMITS -3276.800 3276.700 DEPOSIT ABSOLUTE /end AXIS_DESCR
/end CHARACTERISTIC
/begin CHARACTERISTIC SmkLim_rLamSmkMin_MAP "" MAP 0x80068B36 Kf_Xs16_Ys16_Ws16 32.00000 lambda 0.00 32.00000 EXTENDED_LIMITS -32.76800 32.76700
 /begin AXIS_DESCR STD_AXIS Epm_nEng EngN 16 0.00 6000.000 EXTENDED_LIMITS -16384.00 16383.50 DEPOSIT ABSOLUTE /end AXIS_DESCR
 /begin AXIS_DESCR STD_AXIS SmkLim_mAirPerCyl AirMassPerCyl 16 0.00 2500.000 EXTENDED_LIMITS -3276.800 3276.700 DEPOSIT ABSOLUTE /end AXIS_DESCR
/end CHARACTERISTIC
/begin CHARACTERISTIC SmkLim_rLamSmkUpperGbxEOM1_MAP "" MAP 0x80068D7A Kf_Xs16_Ys16_Ws16 32.00000 lambda 0.00 32.00000 EXTENDED_LIMITS -32.76800 32.76700
 /begin AXIS_DESCR STD_AXIS Epm_nEng EngN 16 0.00 6000.000 EXTENDED_LIMITS -16384.00 16383.50 DEPOSIT ABSOLUTE /end AXIS_DESCR
 /begin AXIS_DESCR STD_AXIS SmkLim_mAirPerCyl AirMassPerCyl 16 0.00 2500.000 EXTENDED_LIMITS -3276.800 3276.700 DEPOSIT ABSOLUTE /end AXIS_DESCR
/end CHARACTERISTIC
/begin CHARACTERISTIC SmkLim_rLamSmkUpperGbxEOM2_MAP "" MAP 0x80068FBE Kf_Xs16_Ys16_Ws16 32.00000 lambda 0.00 32.00000 EXTENDED_LIMITS -32.76800 32.76700
 /begin AXIS_DESCR STD_AXIS Epm_nEng EngN 16 0.00 6000.000 EXTENDED_LIMITS -16384.00 16383.50 DEPOSIT ABSOLUTE /end AXIS_DESCR
 /begin AXIS_DESCR STD_AXIS SmkLim_mAirPerCyl AirMassPerCyl 16 0.00 2500.000 EXTENDED_LIMITS -3276.800 3276.700 DEPOSIT ABSOLUTE /end AXIS_DESCR
/end CHARACTERISTIC
/begin CHARACTERISTIC SmkLim_rLamSmkUpperGbx_MAP "" MAP 0x80069202 Kf_Xs16_Ys16_Ws16 32.00000 lambda 0.00 32.00000 EXTENDED_LIMITS -32.76800 32.76700
 /begin AXIS_DESCR STD_AXIS Epm_nEng EngN 16 0.00 6000.000 EXTENDED_LIMITS -16384.00 16383.50 DEPOSIT ABSOLUTE /end AXIS_DESCR
 /begin AXIS_DESCR STD_AXIS SmkLim_mAirPerCyl AirMassPerCyl 16 0.00 2500.000 EXTENDED_LIMITS -3276.800 3276.700 DEPOSIT ABSOLUTE /end AXIS_DESCR
/end CHARACTERISTIC
/begin CHARACTERISTIC SmkLim_rLamSmk_MAP "Kennfeld zur Ermittlung des Lambda-Werts der Rauchbegrenzung" MAP 0x80069446 Kf_Xs16_Ys16_Ws16 32.00000 lambda 0.00 32.00000 EXTENDED_LIMITS -32.76800 32.76700
 /begin AXIS_DESCR STD_AXIS Epm_nEng EngN 16 0.00 6000.000 EXTENDED_LIMITS -16384.00 16383.50 DEPOSIT ABSOLUTE /end AXIS_DESCR
 /begin AXIS_DESCR STD_AXIS SmkLim_mAirPerCyl AirMassPerCyl 16 0.00 2500.000 EXTENDED_LIMITS -3276.800 3276.700 DEPOSIT ABSOLUTE /end AXIS_DESCR
/end CHARACTERISTIC
/begin CHARACTERISTIC SmkLim_stGearGroupSwitch_C "" VALUE 0x8006968A Val_Ws8 9.000 OneToOne 1.000 10.00 EXTENDED_LIMITS -128.0 127.0 /end CHARACTERISTIC
/begin CHARACTERISTIC SmkLim_swtAirMs_C "" VALUE 0x8005FE56 Kw_Wu8 1.000 OneToOne 0.00 1.000 EXTENDED_LIMITS 0.00 255.0 /end CHARACTERISTIC
/begin CHARACTERISTIC SmkLim_tiAFS_MAP "" MAP 0x8005FE58 Map_Xs16Ys16Ws16 1000.000 Time_ms 0.00 1000.000 EXTENDED_LIMITS -327680.0 327670.0
 /begin AXIS_DESCR STD_AXIS Epm_nEng EngN 6 0.00 10000.00 EXTENDED_LIMITS -16384.00 16383.50 DEPOSIT ABSOLUTE /end AXIS_DESCR
 /begin AXIS_DESCR STD_AXIS Air_pIntkVUs Pres_hPa 6 0.00 3500.000 EXTENDED_LIMITS -32768.00 32767.00 DEPOSIT ABSOLUTE /end AXIS_DESCR
/end CHARACTERISTIC
/begin CHARACTERISTIC SmkLim_tiPT1Neg_MAP "" MAP 0x8005FEBC Map_Xs16Ys16Ws16 1000.000 Time_ms 0.00 1000.000 EXTENDED_LIMITS -327680.0 327670.0
 /begin AXIS_DESCR STD_AXIS Epm_nEng EngN 6 0.00 10000.00 EXTENDED_LIMITS -16384.00 16383.50 DEPOSIT ABSOLUTE /end AXIS_DESCR
 /begin AXIS_DESCR STD_AXIS PCR_pGovDvt Pres_hPa 6 0.00 3500.000 EXTENDED_LIMITS -32768.00 32767.00 DEPOSIT ABSOLUTE /end AXIS_DESCR
/end CHARACTERISTIC
/begin CHARACTERISTIC SmkLim_tiPT1Pos_MAP "" MAP 0x8005FF20 Map_Xs16Ys16Ws16 1000.000 Time_ms 0.00 1000.000 EXTENDED_LIMITS -327680.0 327670.0
 /begin AXIS_DESCR STD_AXIS Epm_nEng EngN 6 0.00 10000.00 EXTENDED_LIMITS -16384.00 16383.50 DEPOSIT ABSOLUTE /end AXIS_DESCR
 /begin AXIS_DESCR STD_AXIS PCR_pGovDvt Pres_hPa 6 0.00 3500.000 EXTENDED_LIMITS -32768.00 32767.00 DEPOSIT ABSOLUTE /end AXIS_DESCR
/end CHARACTERISTIC
/begin CHARACTERISTIC SmkLim_trqThresInrDes0EOM1_C "" VALUE 0x8006968C Kw_Ws16 1500.000 Trq -500.0000 1000.000 EXTENDED_LIMITS -3276.800 3276.700 /end CHARACTERISTIC
/begin CHARACTERISTIC SmkLim_trqThresInrDes0EOM2_C "" VALUE 0x8006968E Kw_Ws16 1500.000 Trq -500.0000 1000.000 EXTENDED_LIMITS -3276.800 3276.700 /end CHARACTERISTIC
/begin CHARACTERISTIC SmkLim_trqThresInrDes0Nrm_C "" VALUE 0x80069690 Kw_Ws16 1500.000 Trq -500.0000 1000.000 EXTENDED_LIMITS -3276.800 3276.700 /end CHARACTERISTIC
/begin CHARACTERISTIC SmkLim_trqThresInrDes1EOM1_C "" VALUE 0x80069692 Kw_Ws16 1500.000 Trq -500.0000 1000.000 EXTENDED_LIMITS -3276.800 3276.700 /end CHARACTERISTIC
/begin CHARACTERISTIC SmkLim_trqThresInrDes1EOM2_C "" VALUE 0x80069694 Kw_Ws16 1500.000 Trq -500.0000 1000.000 EXTENDED_LIMITS -3276.800 3276.700 /end CHARACTERISTIC
/begin CHARACTERISTIC SmkLim_trqThresInrDes1Nrm_C "" VALUE 0x80069696 Kw_Ws16 1500.000 Trq -500.0000 1000.000 EXTENDED_LIMITS -3276.800 3276.700 /end CHARACTERISTIC
/begin CHARACTERISTIC SmkLim_trqThresInrDes2EOM1_C "" VALUE 0x80069698 Kw_Ws16 1500.000 Trq -500.0000 1000.000 EXTENDED_LIMITS -3276.800 3276.700 /end CHARACTERISTIC
/begin CHARACTERISTIC SmkLim_trqThresInrDes2EOM2_C "" VALUE 0x8006969A Kw_Ws16 1500.000 Trq -500.0000 1000.000 EXTENDED_LIMITS -3276.800 3276.700 /end CHARACTERISTIC
/begin CHARACTERISTIC SmkLim_trqThresInrDes2Nrm_C "" VALUE 0x8006969C Kw_Ws16 1500.000 Trq -500.0000 1000.000 EXTENDED_LIMITS -3276.800 3276.700 /end CHARACTERISTIC
/begin CHARACTERISTIC SmkLim_trqThresInrEOM1_C "" VALUE 0x8006969E Kw_Ws16 1500.000 Trq -500.0000 1000.000 EXTENDED_LIMITS -3276.800 3276.700 /end CHARACTERISTIC
/begin CHARACTERISTIC SmkLim_trqThresInrEOM2_C "" VALUE 0x800696A0 Kw_Ws16 1500.000 Trq -500.0000 1000.000 EXTENDED_LIMITS -3276.800 3276.700 /end CHARACTERISTIC
/begin CHARACTERISTIC SmkLim_trqThresInrNrm_C "" VALUE 0x800696A2 Kw_Ws16 1500.000 Trq -500.0000 1000.000 EXTENDED_LIMITS -3276.800 3276.700 /end CHARACTERISTIC
/begin CHARACTERISTIC SmkLim_tThresLamHighEOM1_C "" VALUE 0x800696A4 Kw_Ws16 250.0000 Temp_Cels -50.14000 199.8600 EXTENDED_LIMITS -3549.940 3003.560 /end CHARACTERISTIC
/begin CHARACTERISTIC SmkLim_tThresLamHighEOM2_C "" VALUE 0x800696A6 Kw_Ws16 250.0000 Temp_Cels -50.14000 199.8600 EXTENDED_LIMITS -3549.940 3003.560 /end CHARACTERISTIC
/begin CHARACTERISTIC SmkLim_tThresLamHighNrm_C "" VALUE 0x800696A8 Kw_Ws16 250.0000 Temp_Cels -50.14000 199.8600 EXTENDED_LIMITS -3549.940 3003.560 /end CHARACTERISTIC
/begin CHARACTERISTIC SmkLim_tThresLamLowEOM1_C "" VALUE 0x800696AA Kw_Ws16 250.0000 Temp_Cels -50.14000 199.8600 EXTENDED_LIMITS -3549.940 3003.560 /end CHARACTERISTIC
/begin CHARACTERISTIC SmkLim_tThresLamLowEOM2_C "" VALUE 0x800696AC Kw_Ws16 250.0000 Temp_Cels -50.14000 199.8600 EXTENDED_LIMITS -3549.940 3003.560 /end CHARACTERISTIC
/begin CHARACTERISTIC SmkLim_tThresLamLowNrm_C "" VALUE 0x800696AE Kw_Ws16 250.0000 Temp_Cels -50.14000 199.8600 EXTENDED_LIMITS -3549.940 3003.560 /end CHARACTERISTIC
/begin CHARACTERISTIC SpdGov_stMskMoLimFunc_C "Schalter (bitkodiert) zur Auswahl der zu begrenzenden Funktionen durch Ebene 2 (Bit1: HLSDem, Bit2: GSHDem, Bit3: WESDem, Bit4: DiaDem, Bit5: AGSDem)" VALUE 0x8005FF84 Val_Wu16 15.00000 OneToOne 0.00 15.00000 EXTENDED_LIMITS 0.00 65535.00 /end CHARACTERISTIC
/begin CHARACTERISTIC SpdGov_stMskMoLimTrq_C "Schalter (bitkodiert) zur Auswahl der zu begrenzenden Ausgangsdrehmomente (Bit0: SpdGov_trqSet, Bit1: SpdGov_trqLead, Bit2: SpdGov_trqFlt)" VALUE 0x8005FF86 Val_Wu16 15.00000 OneToOne 0.00 15.00000 EXTENDED_LIMITS 0.00 65535.00 /end CHARACTERISTIC
/begin CHARACTERISTIC SpdGov_stMskNegCurrTrqEna_C "Freigabe der Drehmomentaufschaltung für negative SpdGov Drehmomente auf den Raildruckpfad" VALUE 0x8005FF88 Val_Wu16 7.000000 OneToOne 0.00 7.000000 EXTENDED_LIMITS 0.00 65535.00 /end CHARACTERISTIC
/begin CHARACTERISTIC SpdGov_stMskNegLdTrqEna_C "Freigabe der Drehmomentaufschaltung für negative SpdGov Drehmomente auf den Luftpfad" VALUE 0x8005FF8A Val_Wu16 7.000000 OneToOne 0.00 7.000000 EXTENDED_LIMITS 0.00 65535.00 /end CHARACTERISTIC
/begin CHARACTERISTIC SSwtS_swtGlbTyp_C "Globaler Schaltertyp : 1 = Wert aus Eep, 2 = Wert aus Applikation" VALUE 0x8005FD34 Val_Wu8 1.000 OneToOne 1.000 2.000 EXTENDED_LIMITS 0.00 255.0 /end CHARACTERISTIC
/begin CHARACTERISTIC SSwtS_Val.ETClb_swtCorActvVal_C "Struktur von Werten für Software Schalter/Wert des Schalters ETClb_swtCorActvVal_C" VALUE 0x8005FD36 Val_Wu8 1.000 OneToOne 0.00 1.000 EXTENDED_LIMITS 0.00 255.0 /end CHARACTERISTIC
/begin CHARACTERISTIC SSwtS_Val.InjCrv_swtPiIDblCorMapVal_C "Struktur von Werten für Software Schalter/Wert des Schalters InjCrv_swtPiIDblCorMapVal_C" VALUE 0x8005FD37 Val_Wu8 1.000 OneToOne 0.00 1.000 EXTENDED_LIMITS 0.00 255.0 /end CHARACTERISTIC
/begin CHARACTERISTIC SSwtS_Val.PCV_swtCtlStateVal_C "Struktur von Werten für Software Schalter/Wert des Schalters PCV_swtCtlStateVal_C" VALUE 0x8005FD38 Val_Wu8 1.000 OneToOne 0.00 1.000 EXTENDED_LIMITS 0.00 255.0 /end CHARACTERISTIC
/begin CHARACTERISTIC SSwtS_Val.Rail_swtPreCtlVal_C "Struktur von Werten für Software Schalter/Wert des Schalters Rail_swtPreCtlVal_C" VALUE 0x8005FD39 Val_Wu8 1.000 OneToOne 0.00 1.000 EXTENDED_LIMITS 0.00 255.0 /end CHARACTERISTIC
/begin CHARACTERISTIC SSwtS_Val.Rail_swtWindUpVal_C "Struktur von Werten für Software Schalter/Wert des Schalters Rail_swtWindUpVal_C" VALUE 0x8005FD3A Val_Wu8 1.000 OneToOne 0.00 1.000 EXTENDED_LIMITS 0.00 255.0 /end CHARACTERISTIC
/begin CHARACTERISTIC SSwtS_Val.Rail_swtCtlSelVal_C "Struktur von Werten für Software Schalter/Wert des Schalters Rail_swtCtlSelVal_C" VALUE 0x8005FD3B Val_Wu8 1.000 OneToOne 0.00 1.000 EXTENDED_LIMITS 0.00 255.0 /end CHARACTERISTIC
/begin CHARACTERISTIC SSwtS_Val.Rail_swtPressVal_C "Struktur von Werten für Software Schalter/Wert des Schalters Rail_swtPressVal_C" VALUE 0x8005FD3C Val_Wu8 1.000 OneToOne 0.00 1.000 EXTENDED_LIMITS 0.00 255.0 /end CHARACTERISTIC
/begin CHARACTERISTIC SSwtS_Val.ZFC_swtClbActvVal_C "Struktur von Werten für Software Schalter/Wert des Schalters ZFC_swtClbActvVal_C" VALUE 0x8005FD3D Val_Wu8 1.000 OneToOne 0.00 1.000 EXTENDED_LIMITS 0.00 255.0 /end CHARACTERISTIC
/begin CHARACTERISTIC StAPmp_facdTrq_C "" VALUE 0x8005FF8C Val_Ws16 4.000000 Fact 0.00 4.000000 EXTENDED_LIMITS -4.000000 3.999878 /end CHARACTERISTIC
/begin CHARACTERISTIC StAPmp_facSTETrqDiff_C "" VALUE 0x8005FF8E Val_Ws16 7.999878 Fact -4.000000 3.999878 /end CHARACTERISTIC
/begin CHARACTERISTIC StAPmp_facTrqPhiSTE_MAP "" MAP 0x8005FF90 Map_Xs16Ys16Ws16 8.000000 Fact -4.000000 4.000000 EXTENDED_LIMITS -4.000000 3.999878
 /begin AXIS_DESCR STD_AXIS Com_dphiStWhlAg AngleVelStWhl 5 -1024.000 1023.969 FORMAT "%8.3" DEPOSIT ABSOLUTE /end AXIS_DESCR
 /begin AXIS_DESCR STD_AXIS Com_phiStWhlAg AngleStWhl 5 -200.0000 200.0000 FORMAT "%8.4" EXTENDED_LIMITS -1024.000 1023.969 DEPOSIT ABSOLUTE /end AXIS_DESCR
/end CHARACTERISTIC
/begin CHARACTERISTIC StAPmp_facTrqSTE_MAP "" MAP 0x8005FFDA Map_Xs16Ys16Ws16 4.000000 Fact 0.00 4.000000 EXTENDED_LIMITS -4.000000 3.999878
 /begin AXIS_DESCR STD_AXIS VehV_v Vel 5 0.00 300.0000 EXTENDED_LIMITS -327.6800 327.6700 DEPOSIT ABSOLUTE /end AXIS_DESCR
 /begin AXIS_DESCR STD_AXIS Epm_nEng EngN 5 0.00 10000.00 EXTENDED_LIMITS -16384.00 16383.50 DEPOSIT ABSOLUTE /end AXIS_DESCR
/end CHARACTERISTIC
/begin CHARACTERISTIC StAPmp_stDrvDynLvl_C "" VALUE 0x80060024 Val_Wu8 8.000 OneToOne 0.00 8.000 EXTENDED_LIMITS 0.00 255.0 /end CHARACTERISTIC
/begin CHARACTERISTIC StAPmp_swtActive_C "" VALUE 0x80060025 Val_Wu8 255.0 OneToOne 0.00 255.0 /end CHARACTERISTIC
/begin CHARACTERISTIC StAPmp_swtDflVal_C "" VALUE 0x80060026 Val_Wu8 255.0 OneToOne 0.00 255.0 /end CHARACTERISTIC
/begin CHARACTERISTIC StAPmp_trqDfl_C "" VALUE 0x80060028 Val_Ws16 1500.000 Trq -500.0000 1000.000 EXTENDED_LIMITS -3276.800 3276.700 /end CHARACTERISTIC
/begin CHARACTERISTIC StAPmp_trqSTEMax_C "" VALUE 0x8006002A Val_Ws16 1500.000 Trq -500.0000 1000.000 EXTENDED_LIMITS -3276.800 3276.700 /end CHARACTERISTIC
/begin CHARACTERISTIC StAPmp_trqSTEMin_C "" VALUE 0x8006002C Val_Ws16 1500.000 Trq -500.0000 1000.000 EXTENDED_LIMITS -3276.800 3276.700 /end CHARACTERISTIC
/begin CHARACTERISTIC Strt_DigOut.tiBtwTstSCB_C "Struktur, die Parameters zur Digitalausgangsendstufe-Fehlerbehandlung zur Ansteuerung des Starterrelais enthält/" VALUE 0x80060572 Kw_Ws16 1000.000 Time_ms 0.00 1000.000 EXTENDED_LIMITS -327680.0 327670.0 /end CHARACTERISTIC
/begin CHARACTERISTIC Strt_DigOut.tiBtwTstOT_C "Struktur, die Parameters zur Digitalausgangsendstufe-Fehlerbehandlung zur Ansteuerung des Starterrelais enthält/" VALUE 0x80060574 Kw_Ws16 1000.000 Time_s 0.00 1000.000 EXTENDED_LIMITS -327.6800 327.6700 /end CHARACTERISTIC
/begin CHARACTERISTIC Strt_DigOut.numTstMax_C "Struktur, die Parameters zur Digitalausgangsendstufe-Fehlerbehandlung zur Ansteuerung des Starterrelais enthält/" VALUE 0x80060576 Kw_Wu16 65535.00 OneToOne 0.00 65535.00 /end CHARACTERISTIC
/begin CHARACTERISTIC Strt_stPsDiaDisbl_C "Status der Endstufediagnose Aktivierung/Deaktivierung" VALUE 0x80060578 Val_Wu8 255.0 OneToOne 0.00 255.0 /end CHARACTERISTIC
/begin CHARACTERISTIC Strt_stPsDisbl_C "Status der Endstufe Aktivierung/Deaktivierung" VALUE 0x80060579 Val_Wu8 255.0 OneToOne 0.00 255.0 /end CHARACTERISTIC
/begin CHARACTERISTIC StSys_CldEng.dtrqInc_C "Parametersatz für kalten Motor/Momentenerhöhung für Start-Basis-Moment der Startrampe" VALUE 0x800603DC Val_Wu32 6553599.99847 RmpTrq 0.00 6553599.99847 /end CHARACTERISTIC
/begin CHARACTERISTIC StSys_CldEng.tiRmpLck_C "Parametersatz für kalten Motor/Wartezeit bis zu nächsten Momentenerhöhung" VALUE 0x800603E0 Val_Ws16 655350.0 Time_ms -327680.0 327670.0 /end CHARACTERISTIC
/begin CHARACTERISTIC StSys_CldEng.trqLim_C "Parametersatz für kalten Motor/Maximales Moment der Startrampe" VALUE 0x800603E2 Val_Ws16 3276.700 Trq 0.00 3276.700 EXTENDED_LIMITS -3276.800 3276.700 /end CHARACTERISTIC
/begin CHARACTERISTIC StSys_facAPSCor_CUR "atmospheric pressure correction factor" CURVE 0x8006002E Kl_Xs16_Ws16 4.000000 Fact 0.00 4.000000 EXTENDED_LIMITS -4.000000 3.999878
 /begin AXIS_DESCR STD_AXIS EnvP_p Pres_hPa 8 0.00 3500.000 EXTENDED_LIMITS -32768.00 32767.00 DEPOSIT ABSOLUTE /end AXIS_DESCR
/end CHARACTERISTIC
/begin CHARACTERISTIC StSys_HotEng.dtrqInc_C "Parametersatz für heißen Motor/Momentenerhöhung für Start-Basis-Moment der Startrampe" VALUE 0x800603E4 Val_Wu32 6553599.99847 RmpTrq 0.00 6553599.99847 /end CHARACTERISTIC
/begin CHARACTERISTIC StSys_HotEng.tiRmpLck_C "Parametersatz für heißen Motor/Wartezeit bis zu nächsten Momentenerhöhung" VALUE 0x800603E8 Val_Ws16 655350.0 Time_ms -327680.0 327670.0 /end CHARACTERISTIC
/begin CHARACTERISTIC StSys_HotEng.trqLim_C "Parametersatz für heißen Motor/Maximales Moment der Startrampe" VALUE 0x800603EA Val_Ws16 3276.700 Trq 0.00 3276.700 EXTENDED_LIMITS -3276.800 3276.700 /end CHARACTERISTIC
/begin CHARACTERISTIC StSys_n2MsWhlLoLim_C "untere kritische Drehzahlgrenze (ZMS-Resonanz)" VALUE 0x80060558 Val_Ws16 1000.000 EngN 0.00 1000.000 EXTENDED_LIMITS -16384.00 16383.50 /end CHARACTERISTIC
/begin CHARACTERISTIC StSys_n2MsWhlUpOfs_C "Offset for starting trq shutoff" VALUE 0x8006055A Val_Ws16 1000.000 EngN 0.00 1000.000 EXTENDED_LIMITS -16384.00 16383.50 /end CHARACTERISTIC
/begin CHARACTERISTIC StSys_nAdjMax_C "Abgleichende-Drehzahl" VALUE 0x80060242 Val_Ws16 32767.50 EngN -16384.00 16383.50 /end CHARACTERISTIC
/begin CHARACTERISTIC StSys_nFreezeTrqRmp_C "Rampenbegrenzungsdrehzahl" VALUE 0x800603EC Val_Ws16 32767.50 EngN -16384.00 16383.50 /end CHARACTERISTIC
/begin CHARACTERISTIC StSys_nReleaseTrqRmp_C "Rampenfreigabedrehzahl" VALUE 0x800603EE Val_Ws16 32767.50 EngN -16384.00 16383.50 /end CHARACTERISTIC
/begin CHARACTERISTIC StSys_nStrtCutOutMSA_MAP "" MAP 0x800600F6 Map_Xs16Ys16Ws16 6000.000 EngN 0.00 6000.000 EXTENDED_LIMITS -16384.00 16383.50
 /begin AXIS_DESCR STD_AXIS StSys_tStrt_mp Temp_Cels 8 -50.04000 149.9600 EXTENDED_LIMITS -3549.940 3003.560 DEPOSIT ABSOLUTE /end AXIS_DESCR
 /begin AXIS_DESCR STD_AXIS EnvP_p Pres_hPa 8 700.0000 3500.000 EXTENDED_LIMITS -32768.00 32767.00 DEPOSIT ABSOLUTE /end AXIS_DESCR
/end CHARACTERISTIC
/begin CHARACTERISTIC StSys_nStrtCutOut_MAP "Startabwurf-Drehzahl" MAP 0x8006019A Map_Xs16Ys16Ws16 6000.000 EngN 0.00 6000.000 EXTENDED_LIMITS -16384.00 16383.50
 /begin AXIS_DESCR STD_AXIS StSys_tStrt_mp Temp_Cels 8 -50.04000 149.9600 EXTENDED_LIMITS -3549.940 3003.560 DEPOSIT ABSOLUTE /end AXIS_DESCR
 /begin AXIS_DESCR STD_AXIS EnvP_p Pres_hPa 8 700.0000 3500.000 EXTENDED_LIMITS -32768.00 32767.00 DEPOSIT ABSOLUTE /end AXIS_DESCR
/end CHARACTERISTIC
/begin CHARACTERISTIC StSys_nStrtTipMaxMSA_MAP "" MAP 0x80060400 Kf_Xs16_Ys16_Ws16 6000.000 EngN 0.00 6000.000 EXTENDED_LIMITS -16384.00 16383.50
 /begin AXIS_DESCR STD_AXIS EngDa_tEng Temp_Cels 8 222.9600 422.9600 EXTENDED_LIMITS -3549.940 3003.560 DEPOSIT ABSOLUTE /end AXIS_DESCR
 /begin AXIS_DESCR STD_AXIS EnvP_p Pres_hPa 8 0.00 3500.000 EXTENDED_LIMITS -32768.00 32767.00 DEPOSIT ABSOLUTE /end AXIS_DESCR
/end CHARACTERISTIC
/begin CHARACTERISTIC StSys_nStrtTipMax_MAP "" MAP 0x800604A4 Kf_Xs16_Ys16_Ws16 6000.000 EngN 0.00 6000.000 EXTENDED_LIMITS -16384.00 16383.50
 /begin AXIS_DESCR STD_AXIS EngDa_tEng Temp_Cels 8 222.9600 422.9600 EXTENDED_LIMITS -3549.940 3003.560 DEPOSIT ABSOLUTE /end AXIS_DESCR
 /begin AXIS_DESCR STD_AXIS EnvP_p Pres_hPa 8 0.00 3500.000 EXTENDED_LIMITS -32768.00 32767.00 DEPOSIT ABSOLUTE /end AXIS_DESCR
/end CHARACTERISTIC
/begin CHARACTERISTIC StSys_nStrtTipProt_C "" VALUE 0x80060548 Kw_Ws16 6000.000 EngN 0.00 6000.000 EXTENDED_LIMITS -16384.00 16383.50 /end CHARACTERISTIC
/begin CHARACTERISTIC StSys_numStrtAddCor_C "Selection of used engine temperature (e.g. CTSCD_tClnt, etc.)" VALUE 0x80060050 Kw_Wu8 3.00000000000 EngTempFldSel 0.00 3.00000000000 FORMAT "%13.11" /end CHARACTERISTIC
/begin CHARACTERISTIC StSys_numStrtBas_C "Auswahlparameter für das Motortemperatur-Feld Eng_tFld" VALUE 0x80060244 Val_Wu8 3.00000000000 EngTempFldSel 0.00 3.00000000000 FORMAT "%13.11" /end CHARACTERISTIC
/begin CHARACTERISTIC StSys_numStrtRmp_C "Parameter um die gewünschte Motortemperatur aus dem Motortemperatur-Feld Eng_tFld zu selektieren" VALUE 0x800603F0 Val_Wu8 3.00000000000 EngTempFldSel 0.00 3.00000000000 FORMAT "%13.11" /end CHARACTERISTIC
/begin CHARACTERISTIC StSys_numStrt_C "Parameter um die Motortemperatur für den Startabwurf aus dem Motortemperatur-Feld Eng_tFld zu selektieren" VALUE 0x8006023E Val_Wu8 3.00000000000 EngTempFldSel 0.00 3.00000000000 FORMAT "%13.11" /end CHARACTERISTIC
/begin CHARACTERISTIC StSys_swtGlwLamp_C "" VALUE 0x8006054A Kw_Wu8 1.000 OneToOne 0.00 1.000 EXTENDED_LIMITS 0.00 255.0 /end CHARACTERISTIC
/begin CHARACTERISTIC StSys_swtShOffGearbxRec_C "" VALUE 0x8006054B Kw_Wu8 1.000 OneToOne 0.00 1.000 EXTENDED_LIMITS 0.00 255.0 /end CHARACTERISTIC
/begin CHARACTERISTIC StSys_swtShutOff_C "Label zum Aktivieren des Tipstart-Pfades (1: aktiviert, 0: deaktiviert)" VALUE 0x8006055C Val_Wu8 1.000 OneToOne 0.00 1.000 EXTENDED_LIMITS 0.00 255.0 /end CHARACTERISTIC
/begin CHARACTERISTIC StSys_swtStrtTipActv_C "" VALUE 0x8006054C Kw_Wu8 255.0 OneToOne 0.00 255.0 /end CHARACTERISTIC
/begin CHARACTERISTIC StSys_tClntHi_C "Temperaturschwelle Motor warm -> heiß" VALUE 0x800603F2 Val_Ws16 3053.700 Temp_Cels -50.14000 3003.560 EXTENDED_LIMITS -3549.940 3003.560 /end CHARACTERISTIC
/begin CHARACTERISTIC StSys_tClntLo_C "Temperaturschwelle Motor kalt -> warm" VALUE 0x800603F4 Val_Ws16 3053.700 Temp_Cels -50.14000 3003.560 EXTENDED_LIMITS -3549.940 3003.560 /end CHARACTERISTIC
/begin CHARACTERISTIC StSys_ti2MsWhlPrt_C "Verzögerungszeit Startmomentenabschaltung" VALUE 0x8006055E Val_Wu16 655350.0 Time_ms 0.00 655350.0 /end CHARACTERISTIC
/begin CHARACTERISTIC StSys_tiEngTempValid_C "Verzögerungszeit bis Motortemperatur gueltig" VALUE 0x800603F6 Val_Ws16 327670.0 Time_ms 0.00 327670.0 EXTENDED_LIMITS -327680.0 327670.0 /end CHARACTERISTIC
/begin CHARACTERISTIC StSys_tinFltPT1_C "time constant for the engine speed low pass filter" VALUE 0x80060560 Val_Ws32 4294.9672940 TimeDelay_s 0.000002000000001 4294.9672960 FORMAT "%12.7" /end CHARACTERISTIC
/begin CHARACTERISTIC StSys_tiStrtCutOut_C "Startabwurf-Sperrzeit" VALUE 0x80060240 Val_Ws16 327670.0 Time_ms 0.00 327670.0 EXTENDED_LIMITS -327680.0 327670.0 /end CHARACTERISTIC
/begin CHARACTERISTIC StSys_tiStrtLck_C "" VALUE 0x8006054E Kw_Wu16 655350.0 Time_ms 0.00 655350.0 /end CHARACTERISTIC
/begin CHARACTERISTIC StSys_tiStrtMax_C "" VALUE 0x80060550 Kw_Wu16 655350.0 Time_ms 0.00 655350.0 /end CHARACTERISTIC
/begin CHARACTERISTIC StSys_tiStrtTipMin_C "" VALUE 0x80060552 Kw_Wu16 655350.0 Time_ms 0.00 655350.0 /end CHARACTERISTIC
/begin CHARACTERISTIC StSys_tiStrtTipNoMonitor_C "" VALUE 0x80060554 Kw_Wu16 655350.0 Time_ms 0.00 655350.0 /end CHARACTERISTIC
/begin CHARACTERISTIC StSys_tiStrtTipProt_C "" VALUE 0x80060556 Kw_Wu16 655350.0 Time_ms 0.00 655350.0 /end CHARACTERISTIC
/begin CHARACTERISTIC StSys_trqAdjMax_C "maximales Moment fuer den Startabgleich" VALUE 0x80060246 Val_Ws16 6553.500 Trq -3276.800 3276.700 /end CHARACTERISTIC
/begin CHARACTERISTIC StSys_trqAdjVal_C "Abgleichwert fuer das Startmoment" VALUE 0x80060248 Val_Ws16 6553.500 Trq -3276.800 3276.700 /end CHARACTERISTIC
/begin CHARACTERISTIC StSys_trqStrtAPSCor_MAP "Base map for correction for starting torque" MAP 0x80060052 Kf_Xs16_Ys16_Ws16 240.0000 Trq -40.10000 199.9000 EXTENDED_LIMITS -3276.800 3276.700
 /begin AXIS_DESCR STD_AXIS Epm_nEng EngN 8 0.00 6000.000 EXTENDED_LIMITS -16384.00 16383.50 DEPOSIT ABSOLUTE /end AXIS_DESCR
 /begin AXIS_DESCR STD_AXIS StSys_tStrtCor_mp Temp_Cels 8 -3549.940 3003.560 DEPOSIT ABSOLUTE /end AXIS_DESCR
/end CHARACTERISTIC
/begin CHARACTERISTIC StSys_trqStrtBasMSA_MAP "" MAP 0x8006024A Map_Xs16Ys16Ws16 3276.700 Trq 0.00 3276.700 EXTENDED_LIMITS -3276.800 3276.700
 /begin AXIS_DESCR STD_AXIS Epm_nEng EngN 8 0.00 6000.000 EXTENDED_LIMITS -16384.00 16383.50 DEPOSIT ABSOLUTE /end AXIS_DESCR
 /begin AXIS_DESCR STD_AXIS StSys_tStrtBas_mp Temp_Cels 10 -50.14000 148.9600 EXTENDED_LIMITS -3549.940 3003.560 DEPOSIT ABSOLUTE /end AXIS_DESCR
/end CHARACTERISTIC
/begin CHARACTERISTIC StSys_trqStrtBas_MAP "Basismoment fuer den Start" MAP 0x80060312 Map_Xs16Ys16Ws16 3276.700 Trq 0.00 3276.700 EXTENDED_LIMITS -3276.800 3276.700
 /begin AXIS_DESCR STD_AXIS Epm_nEng EngN 8 0.00 6000.000 EXTENDED_LIMITS -16384.00 16383.50 DEPOSIT ABSOLUTE /end AXIS_DESCR
 /begin AXIS_DESCR STD_AXIS StSys_tStrtBas_mp Temp_Cels 10 -50.14000 149.8600 EXTENDED_LIMITS -3549.940 3003.560 DEPOSIT ABSOLUTE /end AXIS_DESCR
/end CHARACTERISTIC
/begin CHARACTERISTIC StSys_WrmEng.dtrqInc_C "Parametersatz für warmen Motor/Momentenerhöhung für Start-Basis-Moment der Startrampe" VALUE 0x800603F8 Val_Wu32 6553599.99847 RmpTrq 0.00 6553599.99847 /end CHARACTERISTIC
/begin CHARACTERISTIC StSys_WrmEng.tiRmpLck_C "Parametersatz für warmen Motor/Wartezeit bis zu nächsten Momentenerhöhung" VALUE 0x800603FC Val_Ws16 655350.0 Time_ms -327680.0 327670.0 /end CHARACTERISTIC
/begin CHARACTERISTIC StSys_WrmEng.trqLim_C "Parametersatz für warmen Motor/Maximales Moment der Startrampe" VALUE 0x800603FE Val_Ws16 3276.700 Trq 0.00 3276.700 EXTENDED_LIMITS -3276.800 3276.700 /end CHARACTERISTIC
/begin CHARACTERISTIC SyC_stTest_C "Steuerung des Testmodus der Systemsteuerung" VALUE 0x8006057A Val_Wu8 255.0 OneToOne 0.00 255.0 /end CHARACTERISTIC
/begin CHARACTERISTIC SyC_swtPreDrv_C "Schalter/Codewort für PreDrive-Steuerung" VALUE 0x80060580 Val_Wu8 255.0 OneToOne 0.00 255.0 /end CHARACTERISTIC
/begin CHARACTERISTIC SyC_swtTestEna_C "Schalter/Codewort zum Aktivieren eines Testmodus der Systemsteuerung" VALUE 0x8006057B Val_Wu8 255.0 OneToOne 0.00 255.0 /end CHARACTERISTIC
/begin CHARACTERISTIC SyC_tiDiaStopCnt_C "Diagnosezeit für Stop Counter" VALUE 0x80060586 Val_Wu8 128.0 SyC_Time_1s 0.00 128.0 FORMAT "%5.1" EXTENDED_LIMITS 0.00 255.0 /end CHARACTERISTIC
/begin CHARACTERISTIC SyC_tiPostDrvMax_C "Maximale Zeit im Zustand PostDrive bei Drehzahl gleich Null" VALUE 0x8006057C Val_Wu16 2697.000 SyC_Time_100ms 3.000000 2700.000 FORMAT "%8.3" EXTENDED_LIMITS 0.00 6553.500 /end CHARACTERISTIC
/begin CHARACTERISTIC SyC_tiPostDrvMin_C "Minimale Zeit im Zustand PostDrive bei Drehzahl gleich Null" VALUE 0x8006057E Val_Wu16 59.80000 SyC_Time_100ms 0.2000000 60.00000 FORMAT "%8.5" EXTENDED_LIMITS 0.00 6553.500 /end CHARACTERISTIC
/begin CHARACTERISTIC SyC_tiPreDrvMax_C "Maximale Zeit, um die PreDrive verlängert werden kann" VALUE 0x80060582 Val_Wu16 65534.00 SyC_Time_1s 1.000000 65535.00 FORMAT "%8.2" EXTENDED_LIMITS 0.00 65535.00 /end CHARACTERISTIC
/begin CHARACTERISTIC SyC_tiPreDrvMin_C "Timer für minimale Zeit zwischen Sleep Acknowledge und ECU Shutdown" VALUE 0x80060584 Val_Wu16 655350.0 Time_ms 0.00 655350.0 /end CHARACTERISTIC
/begin CHARACTERISTIC SyC_tiStopCntMax_C "Maximal erfassbare Steuergeräteauszeit" VALUE 0x80060588 Val_Wu16 544.0000 SyC_Time_2min 2.000000 546.0000 FORMAT "%8.4" EXTENDED_LIMITS 0.00 131070.0 /end CHARACTERISTIC
/begin CHARACTERISTIC T15_Deb.tiHiLo_C "/" VALUE 0x8006058A Kw_Ws16 655350.0 TimeDeb -327680.0 327670.0 /end CHARACTERISTIC
/begin CHARACTERISTIC T15_Deb.tiLoHi_C "/" VALUE 0x8006058C Kw_Ws16 655350.0 TimeDeb -327680.0 327670.0 /end CHARACTERISTIC
/begin CHARACTERISTIC T15_tiDebWakeUp_C "Maximale Zeitverzögerung zwischen pos.Flankedesentprellen WakeUp Signals und Klemme15 über CAN" VALUE 0x8006058E Val_Wu16 655.3500 Time_s 0.00 655.3500 /end CHARACTERISTIC
/begin CHARACTERISTIC T50_Deb.tiHiLo_C "T50 Entprellzeit/" VALUE 0x800696B0 Kw_Ws16 655350.0 TimeDeb -327680.0 327670.0 /end CHARACTERISTIC
/begin CHARACTERISTIC T50_Deb.tiLoHi_C "T50 Entprellzeit/" VALUE 0x800696B2 Kw_Ws16 655350.0 TimeDeb -327680.0 327670.0 /end CHARACTERISTIC
/begin CHARACTERISTIC T50_stDflVal_C "Vorgabewert Zustand T50" VALUE 0x800696B4 Val_Wu8 255.0 OneToOne 0.00 255.0 /end CHARACTERISTIC
/begin CHARACTERISTIC T50_swtSig_C "Signalschalter T50 (1=CAN 0=HW)" VALUE 0x800696B5 Val_Wu8 255.0 OneToOne 0.00 255.0 /end CHARACTERISTIC
/begin CHARACTERISTIC TAA_facDynMax_C "maximal zulässige Drehzahldynamik für Inkrementwinkel-Lernverfahren" VALUE 0x80060590 Val_Ws16 1.000000 Fact 0.00 1.000000 EXTENDED_LIMITS -4.000000 3.999878 /end CHARACTERISTIC
/begin CHARACTERISTIC TAA_facSinTab_CA "Filterkoeffizienten für Inkrementwinkel-Lernverfahren" VAL_BLK 0x80060592 ValA_Ws16 2.000000 FacTrigoFunc -1.000000 1.000000 FORMAT "%8.6" EXTENDED_LIMITS -8.000000 7.999756 NUMBER 30 /end CHARACTERISTIC
/begin CHARACTERISTIC TAA_nAdapMid_CA "Mittendrehzahlen der Lernbereiche für Inkrementwinkel-Lernverfahren" VAL_BLK 0x800605CE ValA_Ws16 6000.000 EngN 0.00 6000.000 EXTENDED_LIMITS -16384.00 16383.50 NUMBER 3 /end CHARACTERISTIC
/begin CHARACTERISTIC TAA_nAdapRng_CA "Breite der Lernbereiche für Inkrementwinkel-Lernverfahren" VAL_BLK 0x800605D4 ValA_Ws16 6000.000 EngN 0.00 6000.000 EXTENDED_LIMITS -16384.00 16383.50 NUMBER 3 /end CHARACTERISTIC
/begin CHARACTERISTIC TAA_nMax_C "maximale Drehzahl für Inkrementwinkel-Lernverfahren" VALUE 0x800605F4 Val_Wu16 10000.00 EngN 0.00 10000.00 EXTENDED_LIMITS 0.00 32767.50 /end CHARACTERISTIC
/begin CHARACTERISTIC TAA_nMin_C "minimale Drehzahl für Inkrementwinkel-Lernverfahren" VALUE 0x800605F6 Val_Wu16 10000.00 EngN 0.00 10000.00 EXTENDED_LIMITS 0.00 32767.50 /end CHARACTERISTIC
/begin CHARACTERISTIC TAA_numActv_CA "Anzahl auszuwertender Inkremente je Rechenraster im Inkrementwinkel-Lernverfahren" VAL_BLK 0x800605F8 ValA_Wu8 125.0 OneToOne 0.00 125.0 EXTENDED_LIMITS 0.00 255.0 NUMBER 8 /end CHARACTERISTIC
/begin CHARACTERISTIC TAA_numGapIpoInc_C "Anzahl Inkremente für Lückeninterpolation in Inkrementwinkel-Lernverfahren" VALUE 0x800605DA Val_Wu8 9.000 OneToOne 1.000 10.00 EXTENDED_LIMITS 0.00 255.0 /end CHARACTERISTIC
/begin CHARACTERISTIC TAA_numIncGap_CA "Lückenkonfiguration des Geberrads für Inkrementwinkel-Lernverfahren" VAL_BLK 0x80060600 ValA_Wu8 10.00 OneToOne 0.00 10.00 EXTENDED_LIMITS 0.00 255.0 NUMBER 2 /end CHARACTERISTIC
/begin CHARACTERISTIC TAA_numRevCor_C "Anzahl Kurbelwellenumdrehungen für Aktualisierung Korrekturwerte im Inkrementwinkel-Lernverfahren" VALUE 0x80060602 Val_Wu8 19.00 OneToOne 1.000 20.00 EXTENDED_LIMITS 0.00 255.0 /end CHARACTERISTIC
/begin CHARACTERISTIC TAA_numSinTab_C "Anzahl der Filterkoeffizienten in TAA_facSinTab_CA für Inkrementwinkel-Lernverfahren" VALUE 0x800605DB Val_Wu8 30.00 OneToOne 0.00 30.00 EXTENDED_LIMITS 0.00 255.0 /end CHARACTERISTIC
/begin CHARACTERISTIC TAA_phiDiffMaxFst_CA "Schwellwerte für Einschwingzustand der Drehzahlbereiche bei schnellem Lernen" VAL_BLK 0x800605DC ValA_Ws16 0.2499390 AgCrSHiReso 0.00 0.2499390 FORMAT "%9.7" EXTENDED_LIMITS -5.625000 5.624828 NUMBER 3 /end CHARACTERISTIC
/begin CHARACTERISTIC TAA_phiDiffMax_CA "Schwellwerte für Einschwingzustand der Drehzahlbereiche im Inkrementwinkel-Lernverfahren" VAL_BLK 0x800605E2 ValA_Ws16 0.2499390 AgCrSHiReso 0.00 0.2499390 FORMAT "%9.7" EXTENDED_LIMITS -5.625000 5.624828 NUMBER 3 /end CHARACTERISTIC
/begin CHARACTERISTIC TAA_rTrqMax_C "maximale Übersetzung des Antriebsstrangs für Aktivierung des Inkrementwinkel-Lernverfahrens" VALUE 0x80060604 Val_Wu16 100.0000 TransR 0.00 100.0000 EXTENDED_LIMITS 0.00 655.3500 /end CHARACTERISTIC
/begin CHARACTERISTIC TAA_stAdapMode_C "Berechnungsmodus für Korrektur der Inkrementwinkel" VALUE 0x80060606 Val_Wu8 4.000 OneToOne 0.00 4.000 EXTENDED_LIMITS 0.00 255.0 /end CHARACTERISTIC
/begin CHARACTERISTIC TAA_stEvalFin_C "letzter auszuführender Teilalgorithmus im Inkrementwinkel-Lernverfahren" VALUE 0x80060608 Val_Wu16 128.0000 OneToOne 0.00 128.0000 EXTENDED_LIMITS 0.00 65535.00 /end CHARACTERISTIC
/begin CHARACTERISTIC TAA_stExtp_C "Freigabe für Extrapolation der Inkrementwinkel-Korrekturwerte" VALUE 0x8006060A Val_Wu8 1.000 OneToOne 0.00 1.000 EXTENDED_LIMITS 0.00 255.0 /end CHARACTERISTIC
/begin CHARACTERISTIC TAA_stFstLrnMsk_C "erforderlicher Einschwingzustand der Korrekturwerte zur Deaktivierung des schnellen Lernens" VALUE 0x8006060B Val_Wu8 7.000 OneToOne 0.00 7.000 EXTENDED_LIMITS 0.00 255.0 /end CHARACTERISTIC
/begin CHARACTERISTIC TAA_stMainSpdRng_C "Hauptdrehzahlbereich für Inkrementwinkel-Lernverfahren" VALUE 0x800605E8 Val_Wu8 255.0 OneToOne 0.00 255.0 /end CHARACTERISTIC
/begin CHARACTERISTIC TAA_stReqRstVal_C "Löschanforderung für Adaptionswerte Inkrementwinkel-Lernen" VALUE 0x800605E9 Val_Wu8 1.000 OneToOne 0.00 1.000 EXTENDED_LIMITS 0.00 255.0 /end CHARACTERISTIC
/begin CHARACTERISTIC TAA_stTstMode_C "Freigabe Testmodus Inkrementwinkel-Lernverfahren" VALUE 0x8006060C Val_Wu8 31.00 OneToOne 0.00 31.00 EXTENDED_LIMITS 0.00 255.0 /end CHARACTERISTIC
/begin CHARACTERISTIC TAA_tiEnaDel_C "Wartezeit nach Schubübergang für Aktivierung Inkrementwinkel-Lernverfahren" VALUE 0x8006060E Val_Wu16 100.0000 Time_s 0.00 100.0000 EXTENDED_LIMITS 0.00 655.3500 /end CHARACTERISTIC
/begin CHARACTERISTIC TAA_tiIncDvtFltFst_C "Filterzeitkonstante für Inkrementwinkel-Abweichungen bei schnellem Lernen" VALUE 0x800605EC Val_Ws32 99.782961134 TimeDelay_s 0.099999238556 99.882960372 FORMAT "%12.8" EXTENDED_LIMITS 0.000002000000001 4294.9672960 /end CHARACTERISTIC
/begin CHARACTERISTIC TAA_tiIncDvtFlt_C "Filterzeitkonstante für Inkrementwinkel-Abweichungen" VALUE 0x800605F0 Val_Ws32 99.782961134 TimeDelay_s 0.099999238556 99.882960372 FORMAT "%12.8" EXTENDED_LIMITS 0.000002000000001 4294.9672960 /end CHARACTERISTIC
/begin CHARACTERISTIC TAA_vMin_C "minimale Fahrzeuggeschwindigkeit für Aktivierung Inkrementwinkel-Lernverfahren" VALUE 0x80060610 Val_Wu16 300.0000 Vel 0.00 300.0000 EXTENDED_LIMITS 0.00 655.3500 /end CHARACTERISTIC
/begin MEASUREMENT Com_bRecAFS "" UBYTE OneToOne 1 100 0.00 255.0 ECU_ADDRESS 0xD0001C67 /end MEASUREMENT
/begin MEASUREMENT Com_bRecSTE "" UBYTE OneToOne 1 100 0.00 255.0 ECU_ADDRESS 0xD0001C6C /end MEASUREMENT
/begin MEASUREMENT Com_dphiStWhlAg_FX "" SLONG AngleVelStWhl 1 100 -67108864.0000 67108863.9688 FORMAT "%13.4" ECU_ADDRESS 0xD0002E40 /end MEASUREMENT
/begin MEASUREMENT Com_dSteeringAngleCHK_FX "" UBYTE OneToOne 1 100 0.00 255.0 ECU_ADDRESS 0xD0001C9A /end MEASUREMENT
/begin MEASUREMENT Com_dSteeringAngleCTR_FX "" UWORD OneToOne 1 100 0.00 65535.00 ECU_ADDRESS 0xD000152C /end MEASUREMENT
/begin MEASUREMENT Com_dTrqDemandAFSCHK "" UBYTE OneToOne 1 100 0.00 255.0 ECU_ADDRESS 0xD0001CA7 /end MEASUREMENT
/begin MEASUREMENT Com_dTrqDemandAFSCTR "" UWORD OneToOne 1 100 0.00 65535.00 ECU_ADDRESS 0xD000154A /end MEASUREMENT
/begin MEASUREMENT Com_dTrqDemandSTECHK "" UBYTE OneToOne 1 100 0.00 255.0 ECU_ADDRESS 0xD0001CAD /end MEASUREMENT
/begin MEASUREMENT Com_dTrqDemandSTECTR "" UWORD OneToOne 1 100 0.00 65535.00 ECU_ADDRESS 0xD0001556 /end MEASUREMENT
/begin MEASUREMENT Com_phiStWhlAg_FX "" SLONG AngleStWhl 1 100 -67108864.0000 67108863.9688 FORMAT "%13.4" ECU_ADDRESS 0xD0002E50 /end MEASUREMENT
/begin MEASUREMENT Com_rLamLinRecCat2Ds "" SWORD lambdaRec 1 100 -3.276800 3.276700 FORMAT "%8.6" ECU_ADDRESS 0xD00007CC /end MEASUREMENT
/begin MEASUREMENT Com_rLamLinRecDs "" SWORD lambdaRec 1 100 -3.276800 3.276700 FORMAT "%8.6" ECU_ADDRESS 0xD00007CE /end MEASUREMENT
/begin MEASUREMENT Com_rLamLinRecGnd "" SWORD lambdaRec 1 100 -3.276800 3.276700 FORMAT "%8.6" ECU_ADDRESS 0xD00007D0 /end MEASUREMENT
/begin MEASUREMENT Com_rLamLinRecGndRaw "" SWORD lambdaRec 1 100 -3.276800 3.276700 FORMAT "%8.6" ECU_ADDRESS 0xD00007D2 /end MEASUREMENT
/begin MEASUREMENT Com_rLamLinRecUbatt "" SWORD lambdaRec 1 100 -3.276800 3.276700 FORMAT "%8.6" ECU_ADDRESS 0xD00007D4 /end MEASUREMENT
/begin MEASUREMENT Com_rLamLinRecUbattRaw "" SWORD lambdaRec 1 100 -3.276800 3.276700 FORMAT "%8.6" ECU_ADDRESS 0xD00007D6 /end MEASUREMENT
/begin MEASUREMENT Com_rNOxCat2Ds "" SWORD nox 1 100 -32768.00 32767.00 FORMAT "%8.2" ECU_ADDRESS 0xD00007D8 /end MEASUREMENT
/begin MEASUREMENT Com_rNOxCat2DsGnd "" SWORD nox 1 100 -32768.00 32767.00 FORMAT "%8.2" ECU_ADDRESS 0xD00007DA /end MEASUREMENT
/begin MEASUREMENT Com_rNOxCat2DsGndRaw "" SWORD nox 1 100 -32768.00 32767.00 FORMAT "%8.2" ECU_ADDRESS 0xD00007DC /end MEASUREMENT
/begin MEASUREMENT Com_rNOxCat2DsUbatt "" SWORD nox 1 100 -32768.00 32767.00 FORMAT "%8.2" ECU_ADDRESS 0xD00007DE /end MEASUREMENT
/begin MEASUREMENT Com_rNOxCat2DsUbattRaw "" SWORD nox 1 100 -32768.00 32767.00 FORMAT "%8.2" ECU_ADDRESS 0xD00007E0 /end MEASUREMENT
/begin MEASUREMENT Com_rNOxDs "" SWORD nox 1 100 -32768.00 32767.00 FORMAT "%8.2" ECU_ADDRESS 0xD00007E2 /end MEASUREMENT
/begin MEASUREMENT Com_stCat2DsGnd "" UBYTE OneToOne 1 100 0.00 255.0 ECU_ADDRESS 0xD0001CE1 /end MEASUREMENT
/begin MEASUREMENT Com_stCat2DsGndRaw "" UBYTE OneToOne 1 100 0.00 255.0 ECU_ADDRESS 0xD0001CE2 /end MEASUREMENT
/begin MEASUREMENT Com_stCat2DsUbatt "" UBYTE OneToOne 1 100 0.00 255.0 ECU_ADDRESS 0xD0001CE3 /end MEASUREMENT
/begin MEASUREMENT Com_stCat2DsUbattRaw "" UBYTE OneToOne 1 100 0.00 255.0 ECU_ADDRESS 0xD0001CE4 /end MEASUREMENT
/begin MEASUREMENT Com_stErrAFS "" UBYTE OneToOne 1 100 0.00 255.0 ECU_ADDRESS 0xD0001D0C /end MEASUREMENT
/begin MEASUREMENT Com_stErrStrg "" UBYTE OneToOne 1 100 0.00 255.0 ECU_ADDRESS 0xD0001D0D /end MEASUREMENT
/begin MEASUREMENT Com_stHtrSetPCat2Ds "" UBYTE OneToOne 1 100 0.00 255.0 ECU_ADDRESS 0xD0001D1E /end MEASUREMENT
/begin MEASUREMENT Com_stHtrSetPDs "" UBYTE OneToOne 1 100 0.00 255.0 ECU_ADDRESS 0xD0001D1F /end MEASUREMENT
/begin MEASUREMENT Com_stLamBinVldCat2Ds "" UBYTE OneToOne 1 100 0.00 255.0 ECU_ADDRESS 0xD0001D25 /end MEASUREMENT
/begin MEASUREMENT Com_stLamBinVldDs "" UBYTE OneToOne 1 100 0.00 255.0 ECU_ADDRESS 0xD0001D26 /end MEASUREMENT
/begin MEASUREMENT Com_stLamLinRecVldCat2Ds "" UBYTE OneToOne 1 100 0.00 255.0 ECU_ADDRESS 0xD0001D27 /end MEASUREMENT
/begin MEASUREMENT Com_stLamLinRecVldDs "" UBYTE OneToOne 1 100 0.00 255.0 ECU_ADDRESS 0xD0001D28 /end MEASUREMENT
/begin MEASUREMENT Com_stMux5Cat2Ds_mp "" UBYTE OneToOne 1 100 0.00 255.0 ECU_ADDRESS 0xC000B51E /end MEASUREMENT
/begin MEASUREMENT Com_stMux5Ds_mp "" UBYTE OneToOne 1 100 0.00 255.0 ECU_ADDRESS 0xC000B51F /end MEASUREMENT
/begin MEASUREMENT Com_stMux7Cat2Ds_mp "" UBYTE OneToOne 1 100 0.00 255.0 ECU_ADDRESS 0xC000B520 /end MEASUREMENT
/begin MEASUREMENT Com_stMux7Ds_mp "" UBYTE OneToOne 1 100 0.00 255.0 ECU_ADDRESS 0xC000B521 /end MEASUREMENT
/begin MEASUREMENT Com_stNOxErrGnd "" UBYTE OneToOne 1 100 0.00 255.0 ECU_ADDRESS 0xD0001D33 /end MEASUREMENT
/begin MEASUREMENT Com_stNOxErrGndRaw "" UBYTE OneToOne 1 100 0.00 255.0 ECU_ADDRESS 0xD0001D34 /end MEASUREMENT
/begin MEASUREMENT Com_stNOxErrUbatt "" UBYTE OneToOne 1 100 0.00 255.0 ECU_ADDRESS 0xD0001D35 /end MEASUREMENT
/begin MEASUREMENT Com_stNOxErrUbattRaw "" UBYTE OneToOne 1 100 0.00 255.0 ECU_ADDRESS 0xD0001D36 /end MEASUREMENT
/begin MEASUREMENT Com_stNOxVldCat2Ds "" UBYTE OneToOne 1 100 0.00 255.0 ECU_ADDRESS 0xD0001D37 /end MEASUREMENT
/begin MEASUREMENT Com_stNOxVldDs "" UBYTE OneToOne 1 100 0.00 255.0 ECU_ADDRESS 0xD0001D38 /end MEASUREMENT
/begin MEASUREMENT Com_stOpCirHtrCat2Ds "" UBYTE OneToOne 1 100 0.00 255.0 ECU_ADDRESS 0xD0001D3A /end MEASUREMENT
/begin MEASUREMENT Com_stOpCirHtrDs "" UBYTE OneToOne 1 100 0.00 255.0 ECU_ADDRESS 0xD0001D3B /end MEASUREMENT
/begin MEASUREMENT Com_stOpCirLamBinCat2Ds "" UBYTE OneToOne 1 100 0.00 255.0 ECU_ADDRESS 0xD0001D3C /end MEASUREMENT
/begin MEASUREMENT Com_stOpCirLamBinDs "" UBYTE OneToOne 1 100 0.00 255.0 ECU_ADDRESS 0xD0001D3D /end MEASUREMENT
/begin MEASUREMENT Com_stOpCirLamLinCat2Ds "" UBYTE OneToOne 1 100 0.00 255.0 ECU_ADDRESS 0xD0001D3E /end MEASUREMENT
/begin MEASUREMENT Com_stOpCirLamLinDs "" UBYTE OneToOne 1 100 0.00 255.0 ECU_ADDRESS 0xD0001D3F /end MEASUREMENT
/begin MEASUREMENT Com_stOpCirNOxCat2Ds "" UBYTE OneToOne 1 100 0.00 255.0 ECU_ADDRESS 0xD0001D40 /end MEASUREMENT
/begin MEASUREMENT Com_stOpCirNOxDs "" UBYTE OneToOne 1 100 0.00 255.0 ECU_ADDRESS 0xD0001D41 /end MEASUREMENT
/begin MEASUREMENT Com_stSensNOxDewDet "" UBYTE OneToOne 1 100 0.00 255.0 ECU_ADDRESS 0xD0001D5D /end MEASUREMENT
/begin MEASUREMENT Com_stShCirHtrCat2Ds "" UBYTE OneToOne 1 100 0.00 255.0 ECU_ADDRESS 0xD0001D5E /end MEASUREMENT
/begin MEASUREMENT Com_stShCirHtrDs "" UBYTE OneToOne 1 100 0.00 255.0 ECU_ADDRESS 0xD0001D5F /end MEASUREMENT
/begin MEASUREMENT Com_stShCirLamBinCat2Ds "" UBYTE OneToOne 1 100 0.00 255.0 ECU_ADDRESS 0xD0001D60 /end MEASUREMENT
/begin MEASUREMENT Com_stShCirLamBinDs "" UBYTE OneToOne 1 100 0.00 255.0 ECU_ADDRESS 0xD0001D61 /end MEASUREMENT
/begin MEASUREMENT Com_stShCirLamLinCat2Ds "" UBYTE OneToOne 1 100 0.00 255.0 ECU_ADDRESS 0xD0001D62 /end MEASUREMENT
/begin MEASUREMENT Com_stShCirLamLinDs "" UBYTE OneToOne 1 100 0.00 255.0 ECU_ADDRESS 0xD0001D63 /end MEASUREMENT
/begin MEASUREMENT Com_stShCirNOxCat2Ds "" UBYTE OneToOne 1 100 0.00 255.0 ECU_ADDRESS 0xD0001D64 /end MEASUREMENT
/begin MEASUREMENT Com_stShCirNOxDs "" UBYTE OneToOne 1 100 0.00 255.0 ECU_ADDRESS 0xD0001D65 /end MEASUREMENT
/begin MEASUREMENT Com_stSTEQl "" UBYTE OneToOne 1 100 0.00 255.0 ECU_ADDRESS 0xD0001D58 /end MEASUREMENT
/begin MEASUREMENT Com_stSTEQl_FX "" UBYTE OneToOne 1 100 0.00 255.0 ECU_ADDRESS 0xD0001D59 /end MEASUREMENT
/begin MEASUREMENT Com_stStrg "" UBYTE OneToOne 1 100 0.00 255.0 ECU_ADDRESS 0xD0001D7A /end MEASUREMENT
/begin MEASUREMENT Com_stTrqAFS "" UBYTE OneToOne 1 100 0.00 255.0 ECU_ADDRESS 0xD0001D8D /end MEASUREMENT
/begin MEASUREMENT Com_stTrqStrg "" UBYTE OneToOne 1 100 0.00 255.0 ECU_ADDRESS 0xD0001D9B /end MEASUREMENT
/begin MEASUREMENT Com_trqAFS "" SWORD Trq 1 100 -3276.800 3276.700 ECU_ADDRESS 0xD0000810 /end MEASUREMENT
/begin MEASUREMENT Com_trqAFSDes "" SWORD Trq 1 100 -3276.800 3276.700 ECU_ADDRESS 0xD0000812 /end MEASUREMENT
/begin MEASUREMENT Com_trqStrg "" SWORD Trq 1 100 -3276.800 3276.700 ECU_ADDRESS 0xD0000840 /end MEASUREMENT
/begin MEASUREMENT Com_trqStrgDes "" SWORD Trq 1 100 -3276.800 3276.700 ECU_ADDRESS 0xD0000842 /end MEASUREMENT
/begin MEASUREMENT Com_uLamBinCat2Ds "" SWORD Volt 1 100 -250.0000 1600.000 ECU_ADDRESS 0xD0000852 /end MEASUREMENT
/begin MEASUREMENT Com_uLamBinDs "" SWORD Volt 1 100 -250.0000 1600.000 ECU_ADDRESS 0xD0000854 /end MEASUREMENT
/begin MEASUREMENT Com_uLamBinGnd "" SWORD Volt 1 100 -250.0000 1600.000 ECU_ADDRESS 0xD0000856 /end MEASUREMENT
/begin MEASUREMENT Com_uLamBinGndRaw "" SWORD Volt 1 100 -250.0000 1600.000 ECU_ADDRESS 0xD0000858 /end MEASUREMENT
/begin MEASUREMENT Com_uLamBinUbatt "" SWORD Volt 1 100 -250.0000 1600.000 ECU_ADDRESS 0xD000085A /end MEASUREMENT
/begin MEASUREMENT Com_uLamBinUbattRaw "" SWORD Volt 1 100 -250.0000 1600.000 ECU_ADDRESS 0xD000085C /end MEASUREMENT
/begin MEASUREMENT e_sig_ews4_u32 "" ULONG OneToOne 1 100 0.00 4294967295.00 ARRAY_SIZE 2 ECU_ADDRESS 0xD00035F8 /end MEASUREMENT
/begin MEASUREMENT n_bar_sig_ews4_u32 "" ULONG OneToOne 1 100 0.00 4294967295.00 ARRAY_SIZE 50 ECU_ADDRESS 0xD0003600 /end MEASUREMENT
/begin MEASUREMENT n_sig_ews4_u32 "" ULONG OneToOne 1 100 0.00 4294967295.00 ARRAY_SIZE 49 ECU_ADDRESS 0xD00036C8 /end MEASUREMENT
/begin MEASUREMENT SCRMod_dmEG_mp "Abgasmassenstrom" SWORD AirMassPerTime 1 100 -3276.800 3276.700 ECU_ADDRESS 0xC000ACFA /end MEASUREMENT
/begin MEASUREMENT SCRMod_etaBrick1_mp "Wirkungsgrad der 1ten SCR-Kat-Scheibe" SWORD SCR_Fact1000 1 100 -32.76800 32.76700 FORMAT "%8.5" ECU_ADDRESS 0xC000ACFC /end MEASUREMENT
/begin MEASUREMENT SCRMod_etaBrick2_mp "Wirkungsgrad der 2ten SCR-Kat-Scheibe" SWORD SCR_Fact1000 1 100 -32.76800 32.76700 FORMAT "%8.5" ECU_ADDRESS 0xC000ACFE /end MEASUREMENT
/begin MEASUREMENT SCRMod_etaBrick3_mp "Wirkungsgrad der 3ten SCR-Kat-Scheibe" SWORD SCR_Fact1000 1 100 -32.76800 32.76700 FORMAT "%8.5" ECU_ADDRESS 0xC000AD00 /end MEASUREMENT
/begin MEASUREMENT SCRMod_etaBrick4_mp "Wirkungsgrad der 4ten SCR-Kat-Scheibe" SWORD SCR_Fact1000 1 100 -32.76800 32.76700 FORMAT "%8.5" ECU_ADDRESS 0xC000AD02 /end MEASUREMENT
/begin MEASUREMENT SCRMod_etaBrick5_mp "Wirkungsgrad der 5ten SCR-Kat-Scheibe" SWORD SCR_Fact1000 1 100 -32.76800 32.76700 FORMAT "%8.5" ECU_ADDRESS 0xC000AD04 /end MEASUREMENT
/begin MEASUREMENT SCRMod_etaBrick6_mp "Wirkungsgrad der 6ten SCR-Kat-Scheibe" SWORD SCR_Fact1000 1 100 -32.76800 32.76700 FORMAT "%8.5" ECU_ADDRESS 0xC000AD06 /end MEASUREMENT
/begin MEASUREMENT SCRMod_etaCalc_mp "Gesamteinfluß des NO2/NOx Verhältnisses auf den Wirkungsgrad der SCR-Kat-Scheiben" SWORD SCR_Fact1000 1 100 -32.76800 32.76700 FORMAT "%8.5" ECU_ADDRESS 0xC000AD08 /end MEASUREMENT
/begin MEASUREMENT SCRMod_etaCorEG_mp "Korrektur des SCRCat Wirkungsgrades entsprechend Temperatur und Abgasmassenstrom" SWORD SCR_Fact1000 1 100 -32.76800 32.76700 FORMAT "%8.5" ECU_ADDRESS 0xC000AD0A /end MEASUREMENT
/begin MEASUREMENT SCRMod_etaCorNO2_mp "Einfluß des NO2/NOx Verhältnisses und der Scheiben-Temperatur auf den SCR-Kat-Wirkungsgrad" SWORD SCR_Fact1000 1 100 -32.76800 32.76700 FORMAT "%8.5" ECU_ADDRESS 0xC000AD0C /end MEASUREMENT
/begin MEASUREMENT SCRMod_etaCorNOxUs_mp "Korrektur des SCR Kat Wirkungsgrades entsprechend der Temperatur und der NOx Rohemissionen" SWORD SCR_Fact1000 1 100 -32.76800 32.76700 FORMAT "%8.5" ECU_ADDRESS 0xC000AD0E /end MEASUREMENT
/begin MEASUREMENT SCRMod_etaEst "Berechneter NOx-Umsatz" SWORD SCR_Fact1000 1 100 -32.76800 32.76700 FORMAT "%8.5" ECU_ADDRESS 0xD0001330 /end MEASUREMENT
/begin MEASUREMENT SCRMod_etaEst1Brick_mp "Wirkungsgrad der 1ten Scheibe im SCR-Kat" SWORD SCR_Fact1000 1 100 -32.76800 32.76700 FORMAT "%8.5" ECU_ADDRESS 0xC000AD10 /end MEASUREMENT
/begin MEASUREMENT SCRMod_etaEst6Brick_mp "Wirkungsgrad der 6.ten Scheibe im SCR-Kat" SWORD SCR_Fact1000 1 100 -32.76800 32.76700 FORMAT "%8.5" ECU_ADDRESS 0xC000AD12 /end MEASUREMENT
/begin MEASUREMENT SCRMod_etaEstAdd_mp "Wirkungsgrad vor additivem Bypass" SWORD SCR_Fact1000 1 100 -32.76800 32.76700 FORMAT "%8.5" ECU_ADDRESS 0xC000AD14 /end MEASUREMENT
/begin MEASUREMENT SCRMod_etaEstByp_mp "Wirkungsgrads vor Bypass" SWORD SCR_Fact1000 1 100 -32.76800 32.76700 FORMAT "%8.5" ECU_ADDRESS 0xC000AD16 /end MEASUREMENT
/begin MEASUREMENT SCRMod_etaEst_mp "Erwarteter Wirkungsgrad des SCR-Kats" SWORD SCR_Fact1000 1 100 -32.76800 32.76700 FORMAT "%8.5" ECU_ADDRESS 0xC000AD18 /end MEASUREMENT
/begin MEASUREMENT SCRMod_etaNO2Age_mp "Einfluß des Verhältnisses NO2 zu NOx auf Temperatur der GEALTERTEN Scheiben" SWORD SCR_Fact1000 1 100 -32.76800 32.76700 FORMAT "%8.5" ECU_ADDRESS 0xC000AD1A /end MEASUREMENT
/begin MEASUREMENT SCRMod_etaNO2_mp "Einfluss des NO2 zu NOx Verhältnises auf die Temperatur der SCR Scheibe" SWORD SCR_Fact1000 1 100 -32.76800 32.76700 FORMAT "%8.5" ECU_ADDRESS 0xC000AD1C /end MEASUREMENT
/begin MEASUREMENT SCRMod_etaNOAge_mp "Einfluß des NO zu NOx Verhältnisses auf den Wirkungsgrad der GEALTERTEN SCR-Scheibe" SWORD SCR_Fact1000 1 100 -32.76800 32.76700 FORMAT "%8.5" ECU_ADDRESS 0xC000AD1E /end MEASUREMENT
/begin MEASUREMENT SCRMod_etaNONO2Age_mp "Einfluß des balancierten Verhältnisses (NO und NO2 zu NOx) auf den Wirkungsgrad der gealterten Scheibe (SCR-KAt)" SWORD SCR_Fact1000 1 100 -32.76800 32.76700 FORMAT "%8.5" ECU_ADDRESS 0xC000AD20 /end MEASUREMENT
/begin MEASUREMENT SCRMod_etaNONO2_mp "Einfluß des korrigierten Verhältnis des NO und NO2 Anteils gegenüber NOx des Wirkungsgrades der SCR Katalysator Scheibe" SWORD SCR_Fact1000 1 100 -32.76800 32.76700 FORMAT "%8.5" ECU_ADDRESS 0xC000AD22 /end MEASUREMENT
/begin MEASUREMENT SCRMod_etaNO_mp "Einfluß des NO/NOx Verhältnis auf den SCR-Kat's Scheiben Wirkungsgrad" SWORD SCR_Fact1000 1 100 -32.76800 32.76700 FORMAT "%8.5" ECU_ADDRESS 0xC000AD24 /end MEASUREMENT
/begin MEASUREMENT SCRMod_etaSCRRaw_mp "Interpolierter Einfluß des NO2/NOx Verhältnisses des Wirkungsgrades eines partiel GEALTERTEN SCR-Katalysators" SWORD SCR_Fact1000 1 100 -32.76800 32.76700 FORMAT "%8.5" ECU_ADDRESS 0xC000AD26 /end MEASUREMENT
/begin MEASUREMENT SCRMod_etaSort1_mp "Sortierter Scheibenwirkungsgrad an 1ter Position" SWORD SCR_Fact1000 1 100 -32.76800 32.76700 FORMAT "%8.5" ECU_ADDRESS 0xC000AD28 /end MEASUREMENT
/begin MEASUREMENT SCRMod_etaSort2_mp "Sortierter Scheibenwirkungsgrad an 2ter Position" SWORD SCR_Fact1000 1 100 -32.76800 32.76700 FORMAT "%8.5" ECU_ADDRESS 0xC000AD2A /end MEASUREMENT
/begin MEASUREMENT SCRMod_etaSort3_mp "Sortierter Scheibenwirkungsgrad an 3ter Position" SWORD SCR_Fact1000 1 100 -32.76800 32.76700 FORMAT "%8.5" ECU_ADDRESS 0xC000AD2C /end MEASUREMENT
/begin MEASUREMENT SCRMod_etaSort4_mp "Sortierter Scheibenwirkungsgrad an 4ter Position" SWORD SCR_Fact1000 1 100 -32.76800 32.76700 FORMAT "%8.5" ECU_ADDRESS 0xC000AD2E /end MEASUREMENT
/begin MEASUREMENT SCRMod_etaSort5_mp "Sortierter Scheibenwirkungsgrad an 5ter Position" SWORD SCR_Fact1000 1 100 -32.76800 32.76700 FORMAT "%8.5" ECU_ADDRESS 0xC000AD30 /end MEASUREMENT
/begin MEASUREMENT SCRMod_etaSort6_mp "Sortierter Scheibenwirkungsgrad an 6ter Position" SWORD SCR_Fact1000 1 100 -32.76800 32.76700 FORMAT "%8.5" ECU_ADDRESS 0xC000AD32 /end MEASUREMENT
/begin MEASUREMENT SCRMod_etaTempExhAge_mp "Interpolierte Einfluß des NO2/NOx Verhältnisses auf den Wirkungsgrad des GEALTERTEN SCR-Kats" SWORD SCR_Fact1000 1 100 -32.76800 32.76700 FORMAT "%8.5" ECU_ADDRESS 0xC000AD34 /end MEASUREMENT
/begin MEASUREMENT SCRMod_etaTempExh_mp "Interpolierte Einfluß des NO2/NOx Verhältnisses auf den Wirkungsgrad des SCR-Kats" SWORD SCR_Fact1000 1 100 -32.76800 32.76700 FORMAT "%8.5" ECU_ADDRESS 0xC000AD36 /end MEASUREMENT
/begin MEASUREMENT SCRMod_etaTempNH3Ld_mp "SCR-Cat Wirkungsrgrad antsprechend Temperatur und NH3-Ladung" SWORD SCR_Fact1000 1 100 -32.76800 32.76700 FORMAT "%8.5" ECU_ADDRESS 0xC000AD38 /end MEASUREMENT
/begin MEASUREMENT SCRMod_facReacRdcAg_mp "Mögliche NOx konvertierungsrate abhängig von SCRCAt's Scheiben Temperatur" SWORD SCR_Fact1000 1 100 -32.76800 32.76700 FORMAT "%8.5" ECU_ADDRESS 0xC000AD3A /end MEASUREMENT
/begin MEASUREMENT SCRMod_mEstNH3Ld "aktueller NH3-Speicherfüllstand" SWORD SCR_Mass1000 1 100 -32.76800 32.76700 FORMAT "%8.5" ECU_ADDRESS 0xD0001336 /end MEASUREMENT
/begin MEASUREMENT SCRMod_mEstNH3LdAdd_mp "Orginalwert des Kat Füllstands (vor additivem Bypass)" SWORD SCR_Mass1000 1 100 -32.76800 32.76700 FORMAT "%8.5" ECU_ADDRESS 0xC000AD56 /end MEASUREMENT
/begin MEASUREMENT SCRMod_mEstNH3LdByp_mp "Orignalwert des KAT Füllstands (vor Bypass)" SWORD SCR_Mass1000 1 100 -32.76800 32.76700 FORMAT "%8.5" ECU_ADDRESS 0xC000AD58 /end MEASUREMENT
/begin MEASUREMENT SCRMod_mEstNH3Ld_mp "Ammoniak gespeichert im SCR-Katalysator" SWORD SCR_Mass1000 1 100 -32.76800 32.76700 FORMAT "%8.5" ECU_ADDRESS 0xC000AD5A /end MEASUREMENT
/begin MEASUREMENT SCRMod_numMapSel_mp "Auswahlfaktor abhängig vom Verhältnis NO2/NOx" SWORD SCR_Fact100 1 100 -327.6800 327.6700 FORMAT "%8.4" ECU_ADDRESS 0xC000AD3C /end MEASUREMENT
/begin MEASUREMENT SCRMod_RatNO2NOxAge_mp "Verhältnis NO2 zu NOx im Upstsream des gealterten SCR Katalysatos" SWORD SCR_Fact1000 1 100 -32.76800 32.76700 FORMAT "%8.5" ECU_ADDRESS 0xC000AD3E /end MEASUREMENT
/begin MEASUREMENT SCRMod_RatNO2NOx_mp "Verhältnis NO2 zu NOx im SCR-Upstream" SWORD SCR_Fact1000 1 100 -32.76800 32.76700 FORMAT "%8.5" ECU_ADDRESS 0xC000AD40 /end MEASUREMENT
/begin MEASUREMENT SCRMod_rEstNOxDs "Berechnete NOx-Konzentration nach Katalysator" SWORD OneToOne 1 100 -32768.00 32767.00 ECU_ADDRESS 0xD0001338 /end MEASUREMENT
/begin MEASUREMENT SCRMod_rEstNOxWoDdTDs_mp "Verhältnis des berechneten NOx nach SCRCat ohne Verzögerung" SWORD OneToOne 1 100 -32768.00 32767.00 ECU_ADDRESS 0xC000AD42 /end MEASUREMENT
/begin MEASUREMENT SCRMod_rNO2NOx "Verhältnis NO2 zu NOx im SCR" SWORD SCR_Fact1000 1 100 -32.76800 32.76700 FORMAT "%8.5" ECU_ADDRESS 0xD000133A /end MEASUREMENT
/begin MEASUREMENT SCRMod_rNO2NOx_mp "Verhältnis NO2 zu NOx im SCR" SWORD SCR_Fact1000 1 100 -32.76800 32.76700 FORMAT "%8.5" ECU_ADDRESS 0xC000AD44 /end MEASUREMENT
/begin MEASUREMENT SCRMod_stEEPROMRead "Status des EEP Lesezugriffs in SCRMon" UBYTE OneToOne 1 100 0.00 255.0 ECU_ADDRESS 0xC000B517 /end MEASUREMENT
/begin MEASUREMENT SCRMod_stEEPROMWrite "Status des EEP Schreibzugriffs in SCRMon" UBYTE OneToOne 1 100 0.00 255.0 ECU_ADDRESS 0xC000B518 /end MEASUREMENT
/begin MEASUREMENT SCRMod_tAvrg_mp "Mittlere temperatur des SCRKatalysators" SWORD Temp_Cels 1 100 -3549.940 3003.560 ECU_ADDRESS 0xC000AD52 /end MEASUREMENT
/begin MEASUREMENT SCRMod_tOxiCat_mp "OxicatTemperatur" SWORD Temp_Cels 1 100 -3549.940 3003.560 ECU_ADDRESS 0xC000AD54 /end MEASUREMENT
/begin MEASUREMENT SCRMod_tSCRBrick1_mp "Temperatur SCRCat downstream 1-ter Brick" SWORD Temp_Cels 1 100 -3549.940 3003.560 ECU_ADDRESS 0xC000AD46 /end MEASUREMENT
/begin MEASUREMENT SCRMod_tSCRBrick2_mp "Temperatur SCRCat downstream 2-ter Brick" SWORD Temp_Cels 1 100 -3549.940 3003.560 ECU_ADDRESS 0xC000AD48 /end MEASUREMENT
/begin MEASUREMENT SCRMod_tSCRBrick3_mp "Temperatur SCRCat downstream 3-ter Brick" SWORD Temp_Cels 1 100 -3549.940 3003.560 ECU_ADDRESS 0xC000AD4A /end MEASUREMENT
/begin MEASUREMENT SCRMod_tSCRBrick4_mp "Temperatur SCRCat downstream 4-ter Brick" SWORD Temp_Cels 1 100 -3549.940 3003.560 ECU_ADDRESS 0xC000AD4C /end MEASUREMENT
/begin MEASUREMENT SCRMod_tSCRBrick5_mp "Temperatur SCRCat downstream 5-ter Brick" SWORD Temp_Cels 1 100 -3549.940 3003.560 ECU_ADDRESS 0xC000AD4E /end MEASUREMENT
/begin MEASUREMENT SCRMod_tSCRBrick_mp "Temperatur SCRCat downstream 5-ter Brick" SWORD Temp_Cels 1 100 -3549.940 3003.560 ECU_ADDRESS 0xC000AD50 /end MEASUREMENT
/begin MEASUREMENT SCRMon_facAftrunEmpt_mp "" SWORD DtyCyc 1 100 -327.6800 327.6700 ECU_ADDRESS 0xC000AD5C /end MEASUREMENT
/begin MEASUREMENT SCRMon_facReFl_mp "Intergratoreingang im Unterzustand REFILL" SWORD DtyCyc 1 100 -327.6800 327.6700 ECU_ADDRESS 0xC000AD5E /end MEASUREMENT
/begin MEASUREMENT SCRMon_numPresBuildUpErrCnt "Zähler für fehlgeschlagene Druckaufbauversuche" UWORD OneToOne 1 100 0.00 65535.00 ECU_ADDRESS 0xD0001640 /end MEASUREMENT
/begin MEASUREMENT SCRMon_numRepPresBuildup "Anzahl durchgeführter EXIT_FCT_LOOPs in PRESSUREBUILDUP" UBYTE OneToOne 1 100 0.00 255.0 ECU_ADDRESS 0xD0002097 /end MEASUREMENT
/begin MEASUREMENT SCRMon_rAftrunEmptCurrSt_mp "" SWORD DtyCyc 1 100 -327.6800 327.6700 ECU_ADDRESS 0xC000AD60 /end MEASUREMENT
/begin MEASUREMENT SCRMon_rHydFld "Array für hydraulische Füllstände" SWORD DtyCyc 1 100 -327.6800 327.6700 ARRAY_SIZE 3 ECU_ADDRESS 0xD000133C /end MEASUREMENT
/begin MEASUREMENT SCRMon_rReFlCurrSt_mp "aktueller Reduktionsmittel-Füllstand im Unterzustand REFILL" SWORD DtyCyc 1 100 -327.6800 327.6700 ECU_ADDRESS 0xC000AD62 /end MEASUREMENT
/begin MEASUREMENT SCRMon_rUDosVlv_mp "Dutycycle Dosierventil" SWORD SCR_Fact10000 1 100 -3.276800 3.276700 FORMAT "%8.6" ECU_ADDRESS 0xC000AD64 /end MEASUREMENT
/begin MEASUREMENT SCRMon_rUPmpMot_mp "Dutycycle Pumpenmotor" SWORD SCR_DisFlow_kg_p_h 1 100 -32.76800 32.76700 FORMAT "%8.5" ECU_ADDRESS 0xC000AD66 /end MEASUREMENT
/begin MEASUREMENT SCRMon_stAftrun "" UBYTE SCR_Stm_Flags 1 100 0.00 11.0000000000 FORMAT "%13.10" ECU_ADDRESS 0xD0002098 /end MEASUREMENT
/begin MEASUREMENT SCRMon_stAftrunEmpt "" UBYTE SCR_Stm_Flags 1 100 0.00 11.0000000000 FORMAT "%13.10" ECU_ADDRESS 0xD0002099 /end MEASUREMENT
/begin MEASUREMENT SCRMon_stAftrunTempWait "" UBYTE SCR_Stm_Flags 1 100 0.00 11.0000000000 FORMAT "%13.10" ECU_ADDRESS 0xD000209A /end MEASUREMENT
/begin MEASUREMENT SCRMon_stEEPROMRead_mp "Status des Lesezugriffs aufs EEPRAM in SCRMon" UBYTE OneToOne 1 100 0.00 255.0 ECU_ADDRESS 0xC000B519 /end MEASUREMENT
/begin MEASUREMENT SCRMon_stEEPROMWrite_mp "Zustand des Schreibzugriffs auf das EEPRAM im SCRMon" UBYTE OneToOne 1 100 0.00 255.0 ECU_ADDRESS 0xC000B51A /end MEASUREMENT
/begin MEASUREMENT SCRMon_stEnfShOff "Notaus" UBYTE OneToOne 1 100 0.00 255.0 ECU_ADDRESS 0xD000209B /end MEASUREMENT
/begin MEASUREMENT SCRMon_stEnfShOffWiEmpt "Notaus - Abschaltpfad mit Leersaugen" UBYTE OneToOne 1 100 0.00 255.0 ECU_ADDRESS 0xD000209C /end MEASUREMENT
/begin MEASUREMENT SCRMon_stEng "Motor An/Aus" UBYTE SCR_ENG_EPM_Flags 1 100 0.00 1.00000000000 FORMAT "%13.11" ECU_ADDRESS 0xD000209D /end MEASUREMENT
/begin MEASUREMENT SCRMon_stMetCtl "Statusbyte im Unterzustand METERINGCONTROL" UBYTE SCR_Stm_Flags 1 100 0.00 11.0000000000 FORMAT "%13.10" ECU_ADDRESS 0xD000209E /end MEASUREMENT
/begin MEASUREMENT SCRMon_stNoPresCtl "Statusbyte im Zustand NOPESSURECONTROL" UBYTE SCR_Stm_Flags 1 100 0.00 11.0000000000 FORMAT "%13.10" ECU_ADDRESS 0xD000209F /end MEASUREMENT
/begin MEASUREMENT SCRMon_stPresBuildUp "Statusbyte im Unterzustand PRESSUREBUILDUP" UBYTE SCR_Stm_Flags 1 100 0.00 11.0000000000 FORMAT "%13.10" ECU_ADDRESS 0xD00020A0 /end MEASUREMENT
/begin MEASUREMENT SCRMon_stPresCtl "Statusbyte im Zustand PRESSURECONTROL" UBYTE SCR_Stm_Flags 1 100 0.00 11.0000000000 FORMAT "%13.10" ECU_ADDRESS 0xD00020A1 /end MEASUREMENT
/begin MEASUREMENT SCRMon_stPresRdc "Statusbyte im Zustand PRESSUREREDUCTION" UBYTE SCR_Stm_Flags 1 100 0.00 11.0000000000 FORMAT "%13.10" ECU_ADDRESS 0xD00020A2 /end MEASUREMENT
/begin MEASUREMENT SCRMon_stReFl "Statusbyte im Unterzustand REFILL" UBYTE SCR_Stm_Flags 1 100 0.00 11.0000000000 FORMAT "%13.10" ECU_ADDRESS 0xD00020A3 /end MEASUREMENT
/begin MEASUREMENT SCRMon_stStBy "Statusvariable des Zustand STANBDY" UBYTE SCR_Stm_Flags 1 100 0.00 11.0000000000 FORMAT "%13.10" ECU_ADDRESS 0xD00020A4 /end MEASUREMENT
/begin MEASUREMENT SCRMon_stUHC "Powerstatus" UBYTE SCRMon_UHC_St 1 100 0.00 3.00000000000 FORMAT "%13.11" ECU_ADDRESS 0xD00020A5 /end MEASUREMENT
/begin MEASUREMENT SCRMon_stVtln "Statusbyte im Unterzustand VENTILATION" UBYTE SCR_Stm_Flags 1 100 0.00 11.0000000000 FORMAT "%13.10" ECU_ADDRESS 0xD00020A6 /end MEASUREMENT
/begin MEASUREMENT SCRMon_tiTmrAftrunTempWait_mp "" SWORD SCR_Time10 1 100 -3276.800 3276.700 FORMAT "%8.3" ECU_ADDRESS 0xC000AD68 /end MEASUREMENT
/begin MEASUREMENT SCRPOD_rDosVlvDyc "" SWORD OneToOne 1 100 -32768.00 32767.00 ECU_ADDRESS 0xD0001342 /end MEASUREMENT
/begin MEASUREMENT SCRPOD_stDiag "Status des Diagnose-Zustand aktiv oder inaktiv" UBYTE SCRPOD_st_CNV 1 100 0.00 1.00000000000 FORMAT "%13.11" ECU_ADDRESS 0xD00020A7 /end MEASUREMENT
/begin MEASUREMENT SCRPOD_stPresBuildUpErr_mp "Status der Druckaufbauüberwachung" UBYTE OneToOne 1 100 0.00 255.0 ECU_ADDRESS 0xC000B51B /end MEASUREMENT
/begin MEASUREMENT SCRPOD_stPresBuildUpTstd_mp "Status über die Ausführung der Druckaufbauüberwachung" UBYTE OneToOne 1 100 0.00 255.0 ECU_ADDRESS 0xC000B51C /end MEASUREMENT
/begin MEASUREMENT SCRPOD_tiDlyETC "" SWORD OneToOne 1 100 -32768.00 32767.00 ECU_ADDRESS 0xD0001344 /end MEASUREMENT
/begin MEASUREMENT SCRT_dhBrick_mp "Wärmeänderung einer Katalysatorscheibe" SWORD Pwr_q1 1 100 -32768.00 32767.00 FORMAT "%8.2" ECU_ADDRESS 0xC000AD6A /end MEASUREMENT
/begin MEASUREMENT SCRT_dhExchEnvBrick_mp "Wärmeverlust einer SCR Katalysatorscheibe" SWORD Pwr_q1 1 100 -32768.00 32767.00 FORMAT "%8.2" ECU_ADDRESS 0xC000AD6C /end MEASUREMENT
/begin MEASUREMENT SCRT_dhInBrick_mp "Wärmeeintrag in eine SCR Katalysatorscheibe" SWORD Pwr_q1 1 100 -32768.00 32767.00 FORMAT "%8.2" ECU_ADDRESS 0xC000AD6E /end MEASUREMENT
/begin MEASUREMENT SCRT_dmEG_mp "Abgasmassenstrom" SWORD AirMassPerTime 1 100 -3276.800 3276.700 ECU_ADDRESS 0xC000AD70 /end MEASUREMENT
/begin MEASUREMENT SCRT_dtBrick_mp "Temperaturänderung in einer Katalysatorscheibe" SWORD dt_TempKelv_p_s 1 100 -3276.800 3276.700 FORMAT "%8.3" ECU_ADDRESS 0xC000AD72 /end MEASUREMENT
/begin MEASUREMENT SCRT_htcSCR_mp "Wärmeübergangskoeffizient Katalysator an Umgebung" SWORD SCR_htc_W_057057mK 1 100 -3276.800 3276.700 FORMAT "%8.3" ECU_ADDRESS 0xC000AD74 /end MEASUREMENT
/begin MEASUREMENT SCRT_stERS_mp "Motorzustand" UBYTE OneToOne 1 100 0.00 255.0 ECU_ADDRESS 0xC000B51D /end MEASUREMENT
/begin MEASUREMENT SCRT_tAvrg_mp "Gewichtete mittlere Temperatur des SCR Katalysators" SWORD Temp_Cels 1 100 -3549.940 3003.560 ECU_ADDRESS 0xC000AD76 /end MEASUREMENT
/begin MEASUREMENT SCRT_tBrickDs_mp "Modellierte Temperatur nach einer SCR Katalysatorscheibe" SWORD Temp_Cels 1 100 -3549.940 3003.560 ECU_ADDRESS 0xC000AD78 /end MEASUREMENT
/begin MEASUREMENT SCRT_tFld "Temperaturfeld des SCR Katalysators" SWORD Temp_Cels 1 100 -3549.940 3003.560 ARRAY_SIZE 9 ECU_ADDRESS 0xD0001346 /end MEASUREMENT
/begin MEASUREMENT SCRT_tIniIntegBrick_mp "Initialisierungstemperatur nach dem SCR Katalysator" SWORD Temp_Cels 1 100 -3549.940 3003.560 ECU_ADDRESS 0xC000AD7A /end MEASUREMENT
/begin MEASUREMENT SCRT_tUCatDsT "Temperatur nach dem SCR Katalysator" SWORD Temp_Cels 1 100 -3549.940 3003.560 ECU_ADDRESS 0xD0001358 /end MEASUREMENT
/begin MEASUREMENT Shtr_ctDebAKKErrEntr_mp "" UWORD OneToOne 1 100 0.00 65535.00 ECU_ADDRESS 0xC000AD84 /end MEASUREMENT
/begin MEASUREMENT Shtr_ctDebAKKErrHeal_mp "" UWORD OneToOne 1 100 0.00 65535.00 ECU_ADDRESS 0xC000AD86 /end MEASUREMENT
/begin MEASUREMENT Shtr_ctDebPKKErrEntr_mp "" UWORD OneToOne 1 100 0.00 65535.00 ECU_ADDRESS 0xC000AD88 /end MEASUREMENT
/begin MEASUREMENT Shtr_ctDebPKKErrHeal_mp "" UWORD OneToOne 1 100 0.00 65535.00 ECU_ADDRESS 0xC000AD8A /end MEASUREMENT
/begin MEASUREMENT Shtr_ctPKKLrnCntr_mp "" UBYTE OneToOne 1 100 0.00 255.0 ECU_ADDRESS 0xC000B522 /end MEASUREMENT
/begin MEASUREMENT Shtr_ctSysCnt_mp "" UWORD OneToOne 1 100 0.00 65535.00 ECU_ADDRESS 0xC000AD92 /end MEASUREMENT
/begin MEASUREMENT Shtr_r "Schiebersteller Triebsübersetzung aus ASW" SWORD Prc 1 100 -400.0000 399.9878 ECU_ADDRESS 0xD0001376 /end MEASUREMENT
/begin MEASUREMENT Shtr_rActrOut "" UWORD DtyCyc 1 100 0.00 655.3500 ECU_ADDRESS 0xD0001378 /end MEASUREMENT
/begin MEASUREMENT Shtr_rOut "" SWORD DtyCyc 1 100 -327.6800 327.6700 ECU_ADDRESS 0xD000137A /end MEASUREMENT
/begin MEASUREMENT Shtr_rOutVal_mp "" SWORD DtyCyc 1 100 -327.6800 327.6700 ECU_ADDRESS 0xC000AD90 /end MEASUREMENT
/begin MEASUREMENT Shtr_rPs "Ausgangstastverhältnis des Schieberstellers an die Endstufe" SWORD DtyCyc 1 100 -327.6800 327.6700 ECU_ADDRESS 0xD000137C /end MEASUREMENT
/begin MEASUREMENT Shtr_stAKKActrPresent "" UBYTE OneToOne 1 100 0.00 255.0 ECU_ADDRESS 0xD00020AC /end MEASUREMENT
/begin MEASUREMENT Shtr_stAKKCtlVal "" UBYTE OneToOne 1 100 0.00 255.0 ECU_ADDRESS 0xD00020AD /end MEASUREMENT
/begin MEASUREMENT Shtr_stAKKDiagVld_mp "" UBYTE OneToOne 1 100 0.00 255.0 ECU_ADDRESS 0xC000B526 /end MEASUREMENT
/begin MEASUREMENT Shtr_stAKKEdg "" UBYTE OneToOne 1 100 0.00 255.0 ECU_ADDRESS 0xD00020AE /end MEASUREMENT
/begin MEASUREMENT Shtr_stAKKEdg_mp "" UBYTE OneToOne 1 100 0.00 255.0 ECU_ADDRESS 0xC000B527 /end MEASUREMENT
/begin MEASUREMENT Shtr_stAKKErrSym_mp "" UBYTE OneToOne 1 100 0.00 255.0 ECU_ADDRESS 0xC000B528 /end MEASUREMENT
/begin MEASUREMENT Shtr_stAKKExtTstStrt "" UBYTE OneToOne 1 100 0.00 255.0 ECU_ADDRESS 0xD00020AF /end MEASUREMENT
/begin MEASUREMENT Shtr_stAKKExtTst_mp "" UBYTE OneToOne 1 100 0.00 255.0 ECU_ADDRESS 0xC000B531 /end MEASUREMENT
/begin MEASUREMENT Shtr_stAKKfbOk "" UBYTE OneToOne 1 100 0.00 255.0 ECU_ADDRESS 0xD00020B4 /end MEASUREMENT
/begin MEASUREMENT Shtr_stAKKfbSSG "" UBYTE OneToOne 1 100 0.00 255.0 ECU_ADDRESS 0xD00020B5 /end MEASUREMENT
/begin MEASUREMENT Shtr_stAKKLrnCond "" UBYTE OneToOne 1 100 0.00 255.0 ECU_ADDRESS 0xD00020B0 /end MEASUREMENT
/begin MEASUREMENT Shtr_stAKKNoLdErr "" UBYTE OneToOne 1 100 0.00 255.0 ECU_ADDRESS 0xD00020B1 /end MEASUREMENT
/begin MEASUREMENT Shtr_stAKKOk "" UBYTE OneToOne 1 100 0.00 255.0 ECU_ADDRESS 0xD00020B2 /end MEASUREMENT
/begin MEASUREMENT Shtr_stAKKSSGFEdg_mp "" UBYTE OneToOne 1 100 0.00 255.0 ECU_ADDRESS 0xC000B529 /end MEASUREMENT
/begin MEASUREMENT Shtr_stAKKTOut "" UBYTE OneToOne 1 100 0.00 255.0 ECU_ADDRESS 0xD00020B3 /end MEASUREMENT
/begin MEASUREMENT Shtr_stDiag "" UBYTE OneToOne 1 100 0.00 255.0 ECU_ADDRESS 0xD00020B6 /end MEASUREMENT
/begin MEASUREMENT Shtr_stDiagEnd "" UBYTE OneToOne 1 100 0.00 255.0 ECU_ADDRESS 0xD00020B7 /end MEASUREMENT
/begin MEASUREMENT Shtr_stDiagErr "" UBYTE OneToOne 1 100 0.00 255.0 ECU_ADDRESS 0xD00020B8 /end MEASUREMENT
/begin MEASUREMENT Shtr_stEngStrtEnd_mp "" UBYTE OneToOne 1 100 0.00 255.0 ECU_ADDRESS 0xC000B52A /end MEASUREMENT
/begin MEASUREMENT Shtr_stExtCtlActv "" UBYTE OneToOne 1 100 0.00 255.0 ECU_ADDRESS 0xD00020B9 /end MEASUREMENT
/begin MEASUREMENT Shtr_stLrnLogic "" UBYTE OneToOne 1 100 0.00 255.0 ECU_ADDRESS 0xD00020BA /end MEASUREMENT
/begin MEASUREMENT Shtr_stPKKActrPresent "" UBYTE OneToOne 1 100 0.00 255.0 ECU_ADDRESS 0xD00020BB /end MEASUREMENT
/begin MEASUREMENT Shtr_stPKKCtlVal "" UBYTE OneToOne 1 100 0.00 255.0 ECU_ADDRESS 0xD00020BC /end MEASUREMENT
/begin MEASUREMENT Shtr_stPKKDiagVld_mp "" UBYTE OneToOne 1 100 0.00 255.0 ECU_ADDRESS 0xC000B52B /end MEASUREMENT
/begin MEASUREMENT Shtr_stPKKDiag_mp "" UBYTE OneToOne 1 100 0.00 255.0 ECU_ADDRESS 0xC000B52C /end MEASUREMENT
/begin MEASUREMENT Shtr_stPKKEdg "" UBYTE OneToOne 1 100 0.00 255.0 ECU_ADDRESS 0xD00020BD /end MEASUREMENT
/begin MEASUREMENT Shtr_stPKKEdg_mp "" UBYTE OneToOne 1 100 0.00 255.0 ECU_ADDRESS 0xC000B52D /end MEASUREMENT
/begin MEASUREMENT Shtr_stPKKErrSym_mp "" UBYTE OneToOne 1 100 0.00 255.0 ECU_ADDRESS 0xC000B52E /end MEASUREMENT
/begin MEASUREMENT Shtr_stPKKExtTstStrt "" UBYTE OneToOne 1 100 0.00 255.0 ECU_ADDRESS 0xD00020BE /end MEASUREMENT
/begin MEASUREMENT Shtr_stPKKExtTst_mp "" UBYTE OneToOne 1 100 0.00 255.0 ECU_ADDRESS 0xC000B532 /end MEASUREMENT
/begin MEASUREMENT Shtr_stPKKLrnBlk "" UBYTE OneToOne 1 100 0.00 255.0 ECU_ADDRESS 0xD00020BF /end MEASUREMENT
/begin MEASUREMENT Shtr_stPKKLrnBlkRst "" UBYTE OneToOne 1 100 0.00 255.0 ECU_ADDRESS 0xD00020C0 /end MEASUREMENT
/begin MEASUREMENT Shtr_stPKKLrnCond "" UBYTE OneToOne 1 100 0.00 255.0 ECU_ADDRESS 0xD00020C1 /end MEASUREMENT
/begin MEASUREMENT Shtr_stPKKNegRng_mp "" UBYTE OneToOne 1 100 0.00 255.0 ECU_ADDRESS 0xC000B523 /end MEASUREMENT
/begin MEASUREMENT Shtr_stPKKPosRng_mp "" UBYTE OneToOne 1 100 0.00 255.0 ECU_ADDRESS 0xC000B524 /end MEASUREMENT
/begin MEASUREMENT Shtr_stPSUseOk "" UBYTE OneToOne 1 100 0.00 255.0 ECU_ADDRESS 0xD00020C2 /end MEASUREMENT
/begin MEASUREMENT Shtr_stPwrStg_mp "" ULONG OneToOne 1 100 0.00 4294967295.00 ECU_ADDRESS 0xC00093A0 /end MEASUREMENT
/begin MEASUREMENT Shtr_stRes_mp "" UBYTE OneToOne 1 100 0.00 255.0 ECU_ADDRESS 0xC000B52F /end MEASUREMENT
/begin MEASUREMENT Shtr_stSysCtlVal "" UBYTE OneToOne 1 100 0.00 255.0 ECU_ADDRESS 0xD00020C3 /end MEASUREMENT
/begin MEASUREMENT Shtr_stSysfbVld_mp "" UBYTE OneToOne 1 100 0.00 255.0 ECU_ADDRESS 0xC000B530 /end MEASUREMENT
/begin MEASUREMENT Shtr_stSysRst "" UBYTE OneToOne 1 100 0.00 255.0 ECU_ADDRESS 0xD00020C4 /end MEASUREMENT
/begin MEASUREMENT Shtr_stSysRstActv_mp "" UBYTE OneToOne 1 100 0.00 255.0 ECU_ADDRESS 0xC000B525 /end MEASUREMENT
/begin MEASUREMENT Shtr_stSysState "" UWORD OneToOne 1 100 0.00 65535.00 ECU_ADDRESS 0xD0001642 /end MEASUREMENT
/begin MEASUREMENT Shtr_stSysTst "" UBYTE OneToOne 1 100 0.00 255.0 ECU_ADDRESS 0xD00020C5 /end MEASUREMENT
/begin MEASUREMENT Shtr_stSysTstEnd "" UBYTE OneToOne 1 100 0.00 255.0 ECU_ADDRESS 0xD00020C6 /end MEASUREMENT
/begin MEASUREMENT Shtr_stSysTstFE_mp "" UBYTE OneToOne 1 100 0.00 255.0 ECU_ADDRESS 0xC000B533 /end MEASUREMENT
/begin MEASUREMENT Shtr_stSysTstRE_mp "" UBYTE OneToOne 1 100 0.00 255.0 ECU_ADDRESS 0xC000B534 /end MEASUREMENT
/begin MEASUREMENT Shtr_stSysTstRslt "" UBYTE OneToOne 1 100 0.00 255.0 ECU_ADDRESS 0xD00020C7 /end MEASUREMENT
/begin MEASUREMENT Shtr_stSysTstStop_mp "" UBYTE OneToOne 1 100 0.00 255.0 ECU_ADDRESS 0xC000B535 /end MEASUREMENT
/begin MEASUREMENT Shtr_stSysTstStrt_mp "" UBYTE OneToOne 1 100 0.00 255.0 ECU_ADDRESS 0xC000B536 /end MEASUREMENT
/begin MEASUREMENT Shtr_stTotSysErr_mp "" UBYTE OneToOne 1 100 0.00 255.0 ECU_ADDRESS 0xC000B537 /end MEASUREMENT
/begin MEASUREMENT Shtr_tiAKKLrnTimer_mp "" UWORD Time_s 1 100 0.00 655.3500 ECU_ADDRESS 0xC000AD7C /end MEASUREMENT
/begin MEASUREMENT Shtr_tiPKKLrnTimer_mp "" UWORD Time_s 1 100 0.00 655.3500 ECU_ADDRESS 0xC000AD7E /end MEASUREMENT
/begin MEASUREMENT Shtr_tiPKKNegTimer_mp "" UWORD Time_s 1 100 0.00 655.3500 ECU_ADDRESS 0xC000AD80 /end MEASUREMENT
/begin MEASUREMENT Shtr_tiPKKPosTimer_mp "" UWORD Time_s 1 100 0.00 655.3500 ECU_ADDRESS 0xC000AD82 /end MEASUREMENT
/begin MEASUREMENT Shtr_tiSysDiagErr_mp "" UWORD Time_s 1 100 0.00 655.3500 ECU_ADDRESS 0xC000AD8C /end MEASUREMENT
/begin MEASUREMENT Shtr_tiSysDiag_mp "" UWORD Time_s 1 100 0.00 655.3500 ECU_ADDRESS 0xC000AD8E /end MEASUREMENT
/begin MEASUREMENT Shtr_tiSysTstTmr_mp "" UWORD Time_s 1 100 0.00 655.3500 ECU_ADDRESS 0xC000AD94 /end MEASUREMENT
/begin MEASUREMENT SmkLim_mAirMsCor_mp "" SWORD AirMassPerCyl 1 100 -3276.800 3276.700 ECU_ADDRESS 0xC000AD96 /end MEASUREMENT
/begin MEASUREMENT SmkLim_mAirPerCyl "Luftmasse für Rauchbegrenzung" SWORD AirMassPerCyl 1 100 -3276.800 3276.700 ECU_ADDRESS 0xD0001380 /end MEASUREMENT
/begin MEASUREMENT SmkLim_mAirPerCylLim_mp "begrenzte Luftmasse" SWORD AirMassPerCyl 1 100 -3276.800 3276.700 ECU_ADDRESS 0xC000ADAA /end MEASUREMENT
/begin MEASUREMENT SmkLim_qFullLdRgl "Korrekturmenge der Volllastregelung" SWORD InjMass 1 100 -327.6800 327.6700 ECU_ADDRESS 0xD0001382 /end MEASUREMENT
/begin MEASUREMENT SmkLim_qLimSmk "Begrenzungsmenge zur Rauchbegrenzung" SWORD InjMass 1 100 -327.6800 327.6700 ECU_ADDRESS 0xD0001384 /end MEASUREMENT
/begin MEASUREMENT SmkLim_qLimSmkBasNxt_mp "" SWORD InjMass 1 100 -327.6800 327.6700 ECU_ADDRESS 0xC000AD98 /end MEASUREMENT
/begin MEASUREMENT SmkLim_qLimSmkBasPrs_mp "" SWORD InjMass 1 100 -327.6800 327.6700 ECU_ADDRESS 0xC000AD9A /end MEASUREMENT
/begin MEASUREMENT SmkLim_qLimSmkNxt "" SWORD InjMass 1 100 -327.6800 327.6700 ECU_ADDRESS 0xD0001386 /end MEASUREMENT
/begin MEASUREMENT SmkLim_qLimSmkPrs "" SWORD InjMass 1 100 -327.6800 327.6700 ECU_ADDRESS 0xD0001388 /end MEASUREMENT
/begin MEASUREMENT SmkLim_rLamCorEOM1_mp "" SWORD lambda 1 100 -32.76800 32.76700 ECU_ADDRESS 0xC000AD9C /end MEASUREMENT
/begin MEASUREMENT SmkLim_rLamCorEOM2_mp "" SWORD lambda 1 100 -32.76800 32.76700 ECU_ADDRESS 0xC000AD9E /end MEASUREMENT
/begin MEASUREMENT SmkLim_rLamCorNrm_mp "" SWORD lambda 1 100 -32.76800 32.76700 ECU_ADDRESS 0xC000ADA0 /end MEASUREMENT
/begin MEASUREMENT SmkLim_rLamSet "Stellgröße für Lambda-Regler" SWORD lambda 1 100 -32.76800 32.76700 ECU_ADDRESS 0xD000138A /end MEASUREMENT
/begin MEASUREMENT SmkLim_rLamSetNxt "" SWORD lambda 1 100 -32.76800 32.76700 ECU_ADDRESS 0xD000138C /end MEASUREMENT
/begin MEASUREMENT SmkLim_rLamSetPrs "" SWORD lambda 1 100 -32.76800 32.76700 ECU_ADDRESS 0xD000138E /end MEASUREMENT
/begin MEASUREMENT SmkLim_rLamSmkEOM1_mp "" SWORD lambda 1 100 -32.76800 32.76700 ECU_ADDRESS 0xC000ADA2 /end MEASUREMENT
/begin MEASUREMENT SmkLim_rLamSmkEOM2_mp "" SWORD lambda 1 100 -32.76800 32.76700 ECU_ADDRESS 0xC000ADA4 /end MEASUREMENT
/begin MEASUREMENT SmkLim_rLamSmkMin_mp "" SWORD lambda 1 100 -32.76800 32.76700 ECU_ADDRESS 0xC000ADA6 /end MEASUREMENT
/begin MEASUREMENT SmkLim_rLamSmkNrmMode_mp "" SWORD lambda 1 100 -32.76800 32.76700 ECU_ADDRESS 0xC000ADA8 /end MEASUREMENT
/begin MEASUREMENT SmkLim_stGearGroup_mp "" UBYTE OneToOne 1 100 0.00 255.0 ECU_ADDRESS 0xC000B53F /end MEASUREMENT
/begin MEASUREMENT SmkLim_stLamSmkEOM1 "" UBYTE OneToOne 1 100 0.00 255.0 ECU_ADDRESS 0xD000256B /end MEASUREMENT
/begin MEASUREMENT SmkLim_stLamSmkEOM2 "" UBYTE OneToOne 1 100 0.00 255.0 ECU_ADDRESS 0xD000256C /end MEASUREMENT
/begin MEASUREMENT SmkLim_stLamSmkNrm "" UBYTE OneToOne 1 100 0.00 255.0 ECU_ADDRESS 0xD000256D /end MEASUREMENT
/begin MEASUREMENT SmkLim_stNxt "" UBYTE OneToOne 1 100 0.00 255.0 ECU_ADDRESS 0xD000256E /end MEASUREMENT
/begin MEASUREMENT SmkLim_stPrs "" UBYTE OneToOne 1 100 0.00 255.0 ECU_ADDRESS 0xD000256F /end MEASUREMENT
/begin MEASUREMENT SmkLim_stSmkLimEOM1_mp "" UBYTE OneToOne 1 100 0.00 255.0 ECU_ADDRESS 0xC000B540 /end MEASUREMENT
/begin MEASUREMENT SmkLim_stSmkLimEOM2_mp "" UBYTE OneToOne 1 100 0.00 255.0 ECU_ADDRESS 0xC000B541 /end MEASUREMENT
/begin MEASUREMENT SmkLim_stSmkLimNrm_mp "" UBYTE OneToOne 1 100 0.00 255.0 ECU_ADDRESS 0xC000B542 /end MEASUREMENT
/begin MEASUREMENT SmkLim_tiAirPerCyl_mp "" SLONG Time_ms 1 100 -21474836480.0 21474836470.0 ECU_ADDRESS 0xC00093A8 /end MEASUREMENT
/begin MEASUREMENT SmkLim_tSmkLim_mp "ausgewählte Temperatur aus dem Motortemperaturfeld" SWORD Temp_Cels 1 100 -3549.940 3003.560 ECU_ADDRESS 0xC000ADAC /end MEASUREMENT
/begin MEASUREMENT SpdGov_nSetPHi "Drehzahlarray für obere Solldrehzahlen" SWORD EngN 1 100 -16384.00 16383.50 ARRAY_SIZE 6 ECU_ADDRESS 0xD0001390 /end MEASUREMENT
/begin MEASUREMENT SpdGov_nSetPLo "Drehzahlarray für untere Solldrehzahlen" SWORD EngN 1 100 -16384.00 16383.50 ARRAY_SIZE 6 ECU_ADDRESS 0xD000139C /end MEASUREMENT
/begin MEASUREMENT SpdGov_st "Statusinformation des SpdGov" UWORD OneToOne 1 100 0.00 65535.00 ECU_ADDRESS 0xD000165A /end MEASUREMENT
/begin MEASUREMENT SpdGov_stMoLim_mp "Statusinformation, ob eine Drehmomentenbegrenzung durch Ebene 2 erfolgt (Bit0: SpdGov_trqSet, Bit1: SpdGov_trqLead, Bit2: SpdGov_trqFlt)" UWORD OneToOne 1 100 0.00 65535.00 ECU_ADDRESS 0xC000ADAE /end MEASUREMENT
/begin MEASUREMENT SpdGov_trqFlt "gefiltertes Solldrehmoment des SpdGov" SWORD Trq 1 100 -3276.800 3276.700 ECU_ADDRESS 0xD00013A8 /end MEASUREMENT
/begin MEASUREMENT SpdGov_trqInrLimSet "Solldrehmoment des SpdGov für die Begrenzung des Führungsformer (ASDrf) Eingangs" SWORD Trq 1 100 -3276.800 3276.700 ECU_ADDRESS 0xD00013AA /end MEASUREMENT
/begin MEASUREMENT SpdGov_trqLead "Solldrehmoment des SpdGov auf dem Luftpfad" SWORD Trq 1 100 -3276.800 3276.700 ECU_ADDRESS 0xD00013AC /end MEASUREMENT
/begin MEASUREMENT SpdGov_trqSet "Solldrehmoment des SpdGov auf dem Kraftstoffpfad" SWORD Trq 1 100 -3276.800 3276.700 ECU_ADDRESS 0xD00013AE /end MEASUREMENT
/begin MEASUREMENT StAPmp_dtrqDes_mp "" SWORD dTrq 1 100 -3276.800 3276.700 FORMAT "%8.3" ECU_ADDRESS 0xC000ADB0 /end MEASUREMENT
/begin MEASUREMENT StAPmp_facSTETrqRaw_mp "" SWORD Fact 1 100 -4.000000 3.999878 ECU_ADDRESS 0xC000ADB2 /end MEASUREMENT
/begin MEASUREMENT StAPmp_stSTEEna_mp "" UBYTE OneToOne 1 100 0.00 255.0 ECU_ADDRESS 0xC000B543 /end MEASUREMENT
/begin MEASUREMENT StAPmp_trqDiff_mp "" SWORD Trq 1 100 -3276.800 3276.700 ECU_ADDRESS 0xC000ADB4 /end MEASUREMENT
/begin MEASUREMENT StAPmp_trqSTE "" SWORD Trq 1 100 -3276.800 3276.700 ECU_ADDRESS 0xD00013B0 /end MEASUREMENT
/begin MEASUREMENT StAPmp_trqSTERaw_mp "" SWORD Trq 1 100 -3276.800 3276.700 ECU_ADDRESS 0xC000ADB6 /end MEASUREMENT
/begin MEASUREMENT Strg_trqDes "" SWORD Trq 1 100 -3276.800 3276.700 ECU_ADDRESS 0xD00013BC /end MEASUREMENT
/begin MEASUREMENT Strg_trqResv "" SWORD Trq 1 100 -3276.800 3276.700 ECU_ADDRESS 0xD00013BE /end MEASUREMENT
/begin MEASUREMENT Strt_st "Stellgröße der Ansteuerung des Starterrelais" UBYTE OneToOne 1 100 0.00 255.0 ECU_ADDRESS 0xD000257D /end MEASUREMENT
/begin MEASUREMENT Strt_stPs "Ausgang des Starters zur Endstufe" UBYTE OneToOne 1 100 0.00 255.0 ECU_ADDRESS 0xD000257E /end MEASUREMENT
/begin MEASUREMENT StSys_facAPSCor_mp "factor for starting torque correction value" SWORD Fact 1 100 -4.000000 3.999878 ECU_ADDRESS 0xC000ADB8 /end MEASUREMENT
/begin MEASUREMENT StSys_nEpmFlt_mp "engine speed after PT1 filter" SWORD EngN 1 100 -16384.00 16383.50 ECU_ADDRESS 0xC000ADD6 /end MEASUREMENT
/begin MEASUREMENT StSys_nStrtCutOutMSA_mp "Startabwurfsdrehzahl - abhängig von der Kühlmitteltemperatur und dem Luftdruck" SWORD EngN 1 100 -16384.00 16383.50 ECU_ADDRESS 0xC000ADC0 /end MEASUREMENT
/begin MEASUREMENT StSys_nStrtCutOut_mp "Startabwurfsdrehzahl - abhängig von der Kühlmitteltemperatur und dem Luftdruck" SWORD EngN 1 100 -16384.00 16383.50 ECU_ADDRESS 0xC000ADC2 /end MEASUREMENT
/begin MEASUREMENT StSys_nStrtTipMaxMSA_mp "" UWORD EngN 1 100 0.00 32767.50 ECU_ADDRESS 0xC000ADD2 /end MEASUREMENT
/begin MEASUREMENT StSys_nStrtTipMax_mp "" UWORD EngN 1 100 0.00 32767.50 ECU_ADDRESS 0xC000ADD4 /end MEASUREMENT
/begin MEASUREMENT StSys_nThresStrtCutOut "Startabwurfdrehzahl" SWORD EngN 1 100 -16384.00 16383.50 ECU_ADDRESS 0xD00013B2 /end MEASUREMENT
/begin MEASUREMENT StSys_st "Anlasserzustand" UBYTE OneToOne 1 100 0.00 255.0 ECU_ADDRESS 0xD0002570 /end MEASUREMENT
/begin MEASUREMENT StSys_stNewStrt "Statusanzeige bei Neustart während eines aktiven Fahrzyklus" UBYTE OneToOne 1 100 0.00 255.0 ECU_ADDRESS 0xD0002571 /end MEASUREMENT
/begin MEASUREMENT StSys_stRmpMon "Zustand der Startmomenterhoehung" UBYTE OneToOne 1 100 0.00 255.0 ECU_ADDRESS 0xD0002572 /end MEASUREMENT
/begin MEASUREMENT StSys_stStrt "Startzustand" UBYTE OneToOne 1 100 0.00 255.0 ECU_ADDRESS 0xD0002573 /end MEASUREMENT
/begin MEASUREMENT StSys_stStrtCutOutMon "Zustand des Startabwurfs" UBYTE OneToOne 1 100 0.00 255.0 ECU_ADDRESS 0xD0002574 /end MEASUREMENT
/begin MEASUREMENT StSys_stStrtTip "" UWORD OneToOne 1 100 0.00 65535.00 ECU_ADDRESS 0xD000165C /end MEASUREMENT
/begin MEASUREMENT StSys_stStrtTipOFF "" UBYTE OneToOne 1 100 0.00 255.0 ECU_ADDRESS 0xD0002575 /end MEASUREMENT
/begin MEASUREMENT StSys_stStrtTipON "" UBYTE OneToOne 1 100 0.00 255.0 ECU_ADDRESS 0xD0002576 /end MEASUREMENT
/begin MEASUREMENT StSys_stTrqShutOff "globales Interface fuer die Startmomentabschaltung" UBYTE OneToOne 1 100 0.00 255.0 ECU_ADDRESS 0xD0002577 /end MEASUREMENT
/begin MEASUREMENT StSys_stTrqShutOffCond_mp "bitcodierter Zustand der Abschaltbedingungen der Startmomentenabschaltung" UWORD OneToOne 1 100 0.00 65535.00 ECU_ADDRESS 0xC000ADD8 /end MEASUREMENT
/begin MEASUREMENT StSys_trqAddCor "zusaetzliches Korrekturmoment f. Startmoment" SWORD Trq 1 100 -3276.800 3276.700 ECU_ADDRESS 0xD00013B4 /end MEASUREMENT
/begin MEASUREMENT StSys_trqAdj_mp "Startmomentkorrektur" SWORD Trq 1 100 -3276.800 3276.700 ECU_ADDRESS 0xC000ADC6 /end MEASUREMENT
/begin MEASUREMENT StSys_trqBas "Startbasismoment" SWORD Trq 1 100 -3276.800 3276.700 ECU_ADDRESS 0xD00013B6 /end MEASUREMENT
/begin MEASUREMENT StSys_trqRmpState "Moment der Startrampe" SWORD Trq 1 100 -3276.800 3276.700 ECU_ADDRESS 0xD00013B8 /end MEASUREMENT
/begin MEASUREMENT StSys_trqSetAdjVal_mp "EEPROM Abgleichwert Startmoment-Korrektur" SWORD Trq 1 100 -3276.800 3276.700 ECU_ADDRESS 0xC000ADC8 /end MEASUREMENT
/begin MEASUREMENT StSys_trqStrt "inneres Moment Startwert" SWORD Trq 1 100 -3276.800 3276.700 ECU_ADDRESS 0xD00013BA /end MEASUREMENT
/begin MEASUREMENT StSys_trqStrtAPSCor_mp "starting torque correction" SWORD Trq 1 100 -3276.800 3276.700 ECU_ADDRESS 0xC000ADBA /end MEASUREMENT
/begin MEASUREMENT StSys_trqStrtAPS_mp "starting torque correction" SWORD Trq 1 100 -3276.800 3276.700 ECU_ADDRESS 0xC000ADBC /end MEASUREMENT
/begin MEASUREMENT StSys_trqStrtBasMSA_mp "Starter-moment" SWORD Trq 1 100 -3276.800 3276.700 ECU_ADDRESS 0xC000ADCA /end MEASUREMENT
/begin MEASUREMENT StSys_trqStrtBas_mp "Basismoment fuer Start" SWORD Trq 1 100 -3276.800 3276.700 ECU_ADDRESS 0xC000ADCC /end MEASUREMENT
/begin MEASUREMENT StSys_tStrtBas_mp "Aus dem Motortemperaturfeld Eng_tFld ausgewählte Temperatur" SWORD Temp_Cels 1 100 -3549.940 3003.560 ECU_ADDRESS 0xC000ADCE /end MEASUREMENT
/begin MEASUREMENT StSys_tStrtCor_mp "Aus dem Motortemperaturfeld Eng_tFld ausgewählte Temperatur" SWORD Temp_Cels 1 100 -3549.940 3003.560 ECU_ADDRESS 0xC000ADBE /end MEASUREMENT
/begin MEASUREMENT StSys_tStrtRmp_mp "Aus dem Motortemperaturfeld Eng_tFld ausgewählte Temperatur" SWORD Temp_Cels 1 100 -3549.940 3003.560 ECU_ADDRESS 0xC000ADD0 /end MEASUREMENT
/begin MEASUREMENT StSys_tStrt_mp "Aus dem Motortemperaturfeld Eng_tFld ausgewählte Temperatur für den Startabwurf" SWORD Temp_Cels 1 100 -3549.940 3003.560 ECU_ADDRESS 0xC000ADC4 /end MEASUREMENT
/begin MEASUREMENT SyC_ctDeadline1msErr "Anzahl der Zeitüberschreitungen der 1ms-Task" UBYTE OneToOne 1 100 0.00 255.0 ECU_ADDRESS 0xC00066A9 /end MEASUREMENT
/begin MEASUREMENT SyC_ctInit_mp "Anzahl der Steuergeräteinitialisierungen seit dem Einschalten des Steuergerätes" UBYTE OneToOne 1 100 0.00 255.0 ECU_ADDRESS 0xC000C52C /end MEASUREMENT
/begin MEASUREMENT SyC_ctIrrSwOff "Zähler zur Erkennung einer irregulären Abschaltung des Steuergeräts" UBYTE OneToOne 1 100 0.00 255.0 ECU_ADDRESS 0xD000257F /end MEASUREMENT
/begin MEASUREMENT SyC_ctSwtOnCan_mp "Zähler Einschalten durch CAN" UBYTE OneToOne 1 100 0.00 255.0 ECU_ADDRESS 0xC000B545 /end MEASUREMENT
/begin MEASUREMENT SyC_ctSwtOnEin_mp "Zähler Einschalten durch Klemme 15" UBYTE OneToOne 1 100 0.00 255.0 ECU_ADDRESS 0xC000B546 /end MEASUREMENT
/begin MEASUREMENT SyC_ctSwtOnStc_mp "Zähler Einschalten durch Stopcounter" UBYTE OneToOne 1 100 0.00 255.0 ECU_ADDRESS 0xC000B547 /end MEASUREMENT
/begin MEASUREMENT SyC_ctSwtOnWak_mp "Zähler Einschalten durch Wakeup Pin" UBYTE OneToOne 1 100 0.00 255.0 ECU_ADDRESS 0xC000B548 /end MEASUREMENT
/begin MEASUREMENT SyC_ctUnderVltg_mp "Anzahl der 5V Unterspannungsfälle seit dem Einschalten des Steuergerätes" UBYTE OneToOne 1 100 0.00 255.0 ECU_ADDRESS 0xC000C52D /end MEASUREMENT
/begin MEASUREMENT SyC_stMn "Aktueller System/ECU-Zustand" UBYTE ExeCon_State_01 1 100 0.00 3.00000000000 FORMAT "%13.11" ECU_ADDRESS 0xD0002580 /end MEASUREMENT
/begin MEASUREMENT SyC_stMnOld "Vorhergehender System/ECU-Zustand" UBYTE ExeCon_State_01 1 100 0.00 3.00000000000 FORMAT "%13.11" ECU_ADDRESS 0xD0002581 /end MEASUREMENT
/begin MEASUREMENT SyC_stPostDrv "Zustand der PostDrive-Steuerung" UBYTE SyC_PostDrv_State 1 100 0.00 7.00000000000 FORMAT "%13.11" ECU_ADDRESS 0xD0002582 /end MEASUREMENT
/begin MEASUREMENT SyC_stPostDrvFin_mp "PostDrive wurde seit letztem Einschalten regulär beendet" UBYTE OneToOne 1 100 0.00 255.0 ECU_ADDRESS 0xC000B544 /end MEASUREMENT
/begin MEASUREMENT SyC_stPreDrv "Zustand der PreDrive-Steuerung" UBYTE SyC_PreDrv_State 1 100 0.00 9.00000000000 FORMAT "%13.11" ECU_ADDRESS 0xD0002583 /end MEASUREMENT
/begin MEASUREMENT SyC_stStopCntXPostDrv_mp "Anforderung vom StopCounter zur Verlängerung des PostDrives" UBYTE OneToOne 1 100 0.00 255.0 ECU_ADDRESS 0xC000B54A /end MEASUREMENT
/begin MEASUREMENT SyC_stSub "Aktueller System/ECU-Unterzustand" UBYTE ExeCon_State_02 1 100 0.00 6.00000000000 FORMAT "%13.11" ECU_ADDRESS 0xD0001BC2 /end MEASUREMENT
/begin MEASUREMENT SyC_stSubOld "Vorhergehender System/ECU-Unterzustand" UBYTE ExeCon_State_02 1 100 0.00 6.00000000000 FORMAT "%13.11" ECU_ADDRESS 0xD0002584 /end MEASUREMENT
/begin MEASUREMENT SyC_stSwtOn_mp "Status Einschaltursache aktueller Wert" UBYTE OneToOne 1 100 0.00 255.0 ECU_ADDRESS 0xC000B549 /end MEASUREMENT
/begin MEASUREMENT SyC_stT15 "Zustand der Klemme 15 für die Systemsteuerung" UBYTE OneToOne 1 100 0.00 255.0 ECU_ADDRESS 0xD00025CD /end MEASUREMENT
/begin MEASUREMENT SyC_stVldTiEcuOff "Steuergeräteauszeit gültig" UBYTE OneToOne 1 100 0.00 255.0 ECU_ADDRESS 0xD0001BC3 /end MEASUREMENT
/begin MEASUREMENT SyC_tiBoot_mp "Zeit vom Einschalten des Steuergerätes bis zum Erreichen des Systemzustandes SYC_INI" ULONG OneToOne_us 1 100 0.00 4294967295.00 FORMAT "%13.2" ECU_ADDRESS 0xC00093AC /end MEASUREMENT
/begin MEASUREMENT SyC_tiDrv "Zeit seit Erreichen des Zustands SYC_DRIVE" ULONG Time_ms 1 100 0.00 42949672950.0 ECU_ADDRESS 0xD00035E0 /end MEASUREMENT
/begin MEASUREMENT SyC_tiEcuOff "Steuergeräteauszeit" SLONG SyC_Time_1s 1 100 -2147483648.00 2147483647.00 FORMAT "%13.2" ECU_ADDRESS 0xD0002CDC /end MEASUREMENT
/begin MEASUREMENT SyC_tiFrst10ms_mp "Zeit vom Einschalten des Steuergerätes bis zum ersten 10ms Raster" UWORD OneToOne_ms 1 100 0.00 65535.00 FORMAT "%8.2" ECU_ADDRESS 0xC000ADDA /end MEASUREMENT
/begin MEASUREMENT SyC_tiIniEnd_mp "Dauer des Systemzustandes SYC_INIEND" UWORD OneToOne_us 1 100 0.00 65535.00 FORMAT "%8.2" ECU_ADDRESS 0xC000ADDC /end MEASUREMENT
/begin MEASUREMENT SyC_tiIniSyn_mp "Dauer des Systemzustandes SYC_INISYN" UWORD OneToOne_us 1 100 0.00 65535.00 FORMAT "%8.2" ECU_ADDRESS 0xC000ADDE /end MEASUREMENT
/begin MEASUREMENT SyC_tiIni_mp "Dauer des Systemzustandes SYC_INI" ULONG OneToOne_us 1 100 0.00 4294967295.00 FORMAT "%13.2" ECU_ADDRESS 0xC00093B0 /end MEASUREMENT
/begin MEASUREMENT SyC_tiPostDrv "Zeit seit Erreichen des Zustands SYC_POSTDRIVE" ULONG Time_ms 1 100 0.00 42949672950.0 ECU_ADDRESS 0xD0002CE4 /end MEASUREMENT
/begin MEASUREMENT SyC_tiPreDrv "Zeit seit Erreichen des Zustands SYC_PREDRIVE" ULONG Time_ms 1 100 0.00 42949672950.0 ECU_ADDRESS 0xD0002CE8 /end MEASUREMENT
/begin MEASUREMENT SyC_tiPreDrvMin_mp "Timer für minimale Zeit zwischen Sleep Acknowledge und ECU Shutdown" UWORD Time_ms 1 100 0.00 655350.0 ECU_ADDRESS 0xC000ADE2 /end MEASUREMENT
/begin MEASUREMENT SyC_tiShutdown_mp "Dauer des Systemzustandes SYC_SHUTDOWN" UWORD OneToOne_ms 1 100 0.00 65535.00 FORMAT "%8.2" ECU_ADDRESS 0xC000ADE0 /end MEASUREMENT
/begin MEASUREMENT SyC_tiUnderVltg_mp "Dauer der letzten 5V Unterspannung" UBYTE OneToOne_ms 1 100 0.00 255.0 FORMAT "%5.1" ECU_ADDRESS 0xC000B54B /end MEASUREMENT
/begin MEASUREMENT T15_st "entprellter Wert der Klemme 15" UBYTE OneToOne 1 100 0.00 255.0 ECU_ADDRESS 0xD0002585 /end MEASUREMENT
/begin MEASUREMENT T15_stCondDeb_mp "Bedingungen (Bitleiste) für Auswertung T15_ st" UBYTE OneToOne 1 100 0.00 255.0 ECU_ADDRESS 0xC000B54C /end MEASUREMENT
/begin MEASUREMENT T15_stDebWakeUp "entprellter Wake Up Signaleingang" UBYTE OneToOne 1 100 0.00 255.0 ECU_ADDRESS 0xD0002586 /end MEASUREMENT
/begin MEASUREMENT T15_stLogic_mp "Staatsmaschine für T15 in der neu ""Anpassung wakeup Konzept""" UBYTE OneToOne 1 100 0.00 255.0 ECU_ADDRESS 0xC000B54D /end MEASUREMENT
/begin MEASUREMENT T15_stRaw "Rohwert Wert der Klemme 15 wakeup Signal" UBYTE OneToOne 1 100 0.00 255.0 ECU_ADDRESS 0xD0002587 /end MEASUREMENT
/begin MEASUREMENT T15_stWakeUp "Wake Up Zustand" UBYTE OneToOne 1 100 0.00 255.0 ECU_ADDRESS 0xD0002588 /end MEASUREMENT
/begin MEASUREMENT T50_st "Entprellter Statuswert der Klemme 50" UBYTE OneToOne 1 100 0.00 255.0 ECU_ADDRESS 0xD0002589 /end MEASUREMENT
/begin MEASUREMENT T50_stRaw "Unentprellter Wert des Eingangssignals für Klemme 50" UBYTE OneToOne 1 100 0.00 255.0 ECU_ADDRESS 0xD000258A /end MEASUREMENT
/begin MEASUREMENT TAA_ctAngDvt_mp "Inkrementnummer für Winkelkorrekturwert TAA_phiAngDvt_mp" UBYTE OneToOne 1 100 0.00 255.0 ECU_ADDRESS 0xC000B551 /end MEASUREMENT
/begin MEASUREMENT TAA_ctBufSect_mp "Abschnitt-Tabelle des Geberrads für Inkrementwinkel-Lernverfahren (nur für Testzwecke)" UBYTE OneToOne 1 100 0.00 255.0 ECU_ADDRESS 0xC000B54E /end MEASUREMENT
/begin MEASUREMENT TAA_ctLrnCycl "Anzahl der erfolgreichen Lern-Zyklen für die verschiedenen Drehzahlbereiche" UBYTE OneToOne 1 100 0.00 255.0 ARRAY_SIZE 3 ECU_ADDRESS 0xD0001BC4 /end MEASUREMENT
/begin MEASUREMENT TAA_facDyn_mp "dynamische Änderung der Inkrementperiodendauer pro Geberrad-Umdrehung" SWORD Fact 1 100 -4.000000 3.999878 ECU_ADDRESS 0xC000ADE4 /end MEASUREMENT
/begin MEASUREMENT TAA_facIpo_mp "Interpolationsfaktor für Inkrementwinkel-Korrekturwerte" SWORD Fact 1 100 -4.000000 3.999878 ECU_ADDRESS 0xC000ADEA /end MEASUREMENT
/begin MEASUREMENT TAA_nMinCalc_mp "minimale Drehzahl für Inkrementwinkel-Lernverfahren infolge interner Zahlendarstellung" SWORD EngN 1 100 -16384.00 16383.50 ECU_ADDRESS 0xC000ADEC /end MEASUREMENT
/begin MEASUREMENT TAA_numActv "Anzahl auszuwertender Inkremente im aktuellen Rechenraster" UBYTE OneToOne 1 100 0.00 255.0 ECU_ADDRESS 0xD000258B /end MEASUREMENT
/begin MEASUREMENT TAA_numIncBefGap_mp "Nummer des Inkrements vor erster Lücke des Geberrads" UBYTE OneToOne 1 100 0.00 255.0 ECU_ADDRESS 0xC000B552 /end MEASUREMENT
/begin MEASUREMENT TAA_numIncIR_mp "Inkrementzahl pro drehzahlsynchronem Interrupt" UBYTE OneToOne 1 100 0.00 255.0 ECU_ADDRESS 0xC000B553 /end MEASUREMENT
/begin MEASUREMENT TAA_phiAngDvt_mp "Winkelkorrektur für Inkrement TAA_ctAngDvt_mp" SBYTE AngleCrS 1 100 -2.813 2.791 ECU_ADDRESS 0xC000B554 /end MEASUREMENT
/begin MEASUREMENT TAA_phiIncDvt_mp "nichtinterpolierte Inkrementwinkel-Abweichungen (nur für Testzwecke)" SWORD AgCrSHiReso 1 100 -5.625000 5.624828 FORMAT "%8.6" ECU_ADDRESS 0xC000ADE6 /end MEASUREMENT
/begin MEASUREMENT TAA_stAdap "auszuführender Teilalgorithmus im Inkrementwinkel-Lernverfahren" UWORD OneToOne 1 100 0.00 65535.00 ECU_ADDRESS 0xD000165E /end MEASUREMENT
/begin MEASUREMENT TAA_stAdapMode_mp "Adaptionsmodus für Inkrementwinkel-Lernverfahren (kein / in / ausserhalb Hauptdrehzahlbereich)" UBYTE OneToOne 1 100 0.00 255.0 ECU_ADDRESS 0xC000B54F /end MEASUREMENT
/begin MEASUREMENT TAA_stAdapVal "Einschwingzustand Inkrementwinkel-Lernverfahren" UBYTE OneToOne 1 100 0.00 255.0 ECU_ADDRESS 0xC000637E /end MEASUREMENT
/begin MEASUREMENT TAA_stEnaCond_mp "Aktivierungsbedingung Inkrementwinkel-Lernverfahren (ohne Schubbedingung)" UBYTE OneToOne 1 100 0.00 255.0 ECU_ADDRESS 0xC000B555 /end MEASUREMENT
/begin MEASUREMENT TAA_stErr_mp "Konfigurationsfehler bei Inkrementwinkel-Lernverfahren" UBYTE OneToOne 1 100 0.00 255.0 ECU_ADDRESS 0xC000B556 /end MEASUREMENT
/begin MEASUREMENT TAA_stFin "zuletzt ausgeführter Teilalgorithmus Inkrementwinkel-Lernverfahren" UWORD OneToOne 1 100 0.00 65535.00 ECU_ADDRESS 0xD0001660 /end MEASUREMENT
/begin MEASUREMENT TAA_stIdxSync_mp "Inkrementwinkel-Lernverfahren ist synchron mit Winkelsystem" UBYTE OneToOne 1 100 0.00 255.0 ECU_ADDRESS 0xC000B557 /end MEASUREMENT
/begin MEASUREMENT TAA_stIpoMode_mp "aktueller Interpolationsmodus für Inkrementwinkel-Korrekturwerte" UBYTE OneToOne 1 100 0.00 255.0 ECU_ADDRESS 0xC000B558 /end MEASUREMENT
/begin MEASUREMENT TAA_stLrnMode "aktueller Lernmodus des Inkrementwinkel-Lernverfahrens" UBYTE OneToOne 1 100 0.00 255.0 ECU_ADDRESS 0xD000258C /end MEASUREMENT
/begin MEASUREMENT TAA_stRev2Fin_mp "Triggersignal: zwei Geberradumdrehungen abgeschlossen" UBYTE OneToOne 1 100 0.00 255.0 ECU_ADDRESS 0xC000B559 /end MEASUREMENT
/begin MEASUREMENT TAA_stRlsOvrRunCo_mp "Aktivierungsbedingung Inkrementwinkel-Lernverfahren erfüllt" UBYTE OneToOne 1 100 0.00 255.0 ECU_ADDRESS 0xC000B55A /end MEASUREMENT
/begin MEASUREMENT TAA_stSpdRngRdHi_mp "oberer Drehzahlbereich für Interpolation der Winkelkorrekturwerte" UBYTE OneToOne 1 100 0.00 255.0 ECU_ADDRESS 0xC000B55B /end MEASUREMENT
/begin MEASUREMENT TAA_stSpdRngRdLo_mp "unterer Drehzahlbereich für Interpolation der Winkelkorrekturwerte" UBYTE OneToOne 1 100 0.00 255.0 ECU_ADDRESS 0xC000B55C /end MEASUREMENT
/begin MEASUREMENT TAA_stSpdRngWr_mp "aktueller Drehzahlbereich für Inkrementwinkel-Lernverfahren" UBYTE OneToOne 1 100 0.00 255.0 ECU_ADDRESS 0xC000B550 /end MEASUREMENT
/begin MEASUREMENT TAA_tiIncAvrg_mp "mittlere Inkrementperiodendauer aus zwei Geberrad-Umdrehungen" SLONG TIncPerDurHiReso_us 1 100 -838860.800000 838860.799609 FORMAT "%13.6" ECU_ADDRESS 0xC00093B4 /end MEASUREMENT
/begin MEASUREMENT TAA_tiInc_mp "privater Inkrementperioden-Puffer im Inkrementwinkel-Lernverfahren (nur für Testzwecke)" SWORD TIncPerDur_us 1 100 -3276.800 3276.700 FORMAT "%8.3" ECU_ADDRESS 0xC000ADE8 /end MEASUREMENT
/begin FUNCTION SCRMod_Eff ""
 /begin DEF_CHARACTERISTIC SCRMod_dmExhMnfDs_TC SCRMod_etaCorEG_MAP SCRMod_etaCorNO2_MAP SCRMod_etaCorNOxUs_MAP SCRMod_etaMax_C SCRMod_etaMin_C SCRMod_etaNO2Age_MAP SCRMod_etaNO2_MAP SCRMod_etaNOAge_MAP SCRMod_etaNONO2Age_MAP SCRMod_etaNONO2_MAP SCRMod_etaNO_MAP SCRMod_etaSCRAge_CUR SCRMod_etaTempNH3Ld_MAP SCRMod_facEffOxiAge_TC SCRMod_facEffSCRAge_TC SCRMod_facReacRdcAg_CUR SCRMod_facWgh1_C SCRMod_facWgh2_C SCRMod_facWgh3_C SCRMod_facWgh4_C SCRMod_facWgh5_C SCRMod_facWgh6_C SCRMod_mEstNH3Ld_TC SCRMod_numMapSel_CUR SCRMod_rNO2NOxAge_MAP SCRMod_rNO2NOx_MAP SCRMod_rPPMNOxUs_TC SCRMod_swt6BrickEna_C SCRMod_swtNO2Sel_C SCRMod_swtSortEna_C SCRMod_swtTestEna_C SCRMod_tiDdTNOx_CUR SCRMod_tiRatNO2NOxFlt_C /end DEF_CHARACTERISTIC
 /begin REF_CHARACTERISTIC DStgy_numPosOxi_C DStgy_numPosSCRUs_C /end REF_CHARACTERISTIC
 /begin IN_MEASUREMENT ASMod_dmEGFld Exh_tFld SCRFFC_rPPMNOxUs SCRMod_facEffSCRAge SCRMod_mEstNH3Ld SCRT_tFld /end IN_MEASUREMENT
 /begin OUT_MEASUREMENT SCRMod_etaEst SCRMod_rEstNOxDs SCRMod_rNO2NOx SCRMod_tAvrg_mp SCRMod_tOxiCat_mp /end OUT_MEASUREMENT
 /begin LOC_MEASUREMENT SCRMod_dmEG_mp SCRMod_etaBrick1_mp SCRMod_etaBrick2_mp SCRMod_etaBrick3_mp SCRMod_etaBrick4_mp SCRMod_etaBrick5_mp SCRMod_etaBrick6_mp SCRMod_etaCalc_mp SCRMod_etaCorEG_mp SCRMod_etaCorNO2_mp SCRMod_etaCorNOxUs_mp SCRMod_etaEst1Brick_mp SCRMod_etaEst6Brick_mp SCRMod_etaEstAdd_mp SCRMod_etaEstByp_mp SCRMod_etaEst_mp SCRMod_etaNO2Age_mp SCRMod_etaNO2_mp SCRMod_etaNOAge_mp SCRMod_etaNONO2Age_mp SCRMod_etaNONO2_mp SCRMod_etaNO_mp SCRMod_etaSCRRaw_mp SCRMod_etaSort1_mp SCRMod_etaSort2_mp SCRMod_etaSort3_mp SCRMod_etaSort4_mp SCRMod_etaSort5_mp SCRMod_etaSort6_mp SCRMod_etaTempExhAge_mp SCRMod_etaTempExh_mp SCRMod_etaTempNH3Ld_mp SCRMod_facReacRdcAg_mp SCRMod_numMapSel_mp SCRMod_RatNO2NOxAge_mp SCRMod_RatNO2NOx_mp SCRMod_rEstNOxWoDdTDs_mp SCRMod_rNO2NOx_mp SCRMod_tSCRBrick1_mp SCRMod_tSCRBrick2_mp SCRMod_tSCRBrick3_mp SCRMod_tSCRBrick4_mp SCRMod_tSCRBrick5_mp SCRMod_tSCRBrick_mp /end LOC_MEASUREMENT
/end FUNCTION
/begin FUNCTION SCRMod_NH3Ld ""
 /begin DEF_CHARACTERISTIC SCRMod_facKiNH3Ld_C SCRMod_mIniNH3Ld_C SCRMod_mMaxNH3Ld_C SCRMod_swtIniNH3Ld_C /end DEF_CHARACTERISTIC
 /begin IN_MEASUREMENT SCRAd_mNH3LdAdap SCRAd_mNH3LdRst SCRAd_stAdapReq SCRAd_stAdapRstReq /end IN_MEASUREMENT
 /begin OUT_MEASUREMENT SCRMod_mEstNH3Ld SCRMod_stEEPROMWrite /end OUT_MEASUREMENT
 /begin LOC_MEASUREMENT SCRMod_mEstNH3LdAdd_mp SCRMod_mEstNH3LdByp_mp SCRMod_mEstNH3Ld_mp SCRMod_stEEPROMRead /end LOC_MEASUREMENT
/end FUNCTION
/begin FUNCTION SCRMod_WallFlm "" /end FUNCTION
/begin FUNCTION SCRMon "" /begin DEF_CHARACTERISTIC SCRMon_swtDSMDis_C /end DEF_CHARACTERISTIC /begin IN_MEASUREMENT CoSCR_st CoSCR_stSub /end IN_MEASUREMENT
 /begin OUT_MEASUREMENT SCRMon_stAftrun SCRMon_stAftrunEmpt SCRMon_stAftrunTempWait SCRMon_stMetCtl SCRMon_stNoPresCtl SCRMon_stPresBuildUp SCRMon_stPresCtl SCRMon_stPresRdc SCRMon_stReFl SCRMon_stStBy SCRMon_stVtln /end OUT_MEASUREMENT
 /begin SUB_FUNCTION SCRMon_Main /end SUB_FUNCTION
/end FUNCTION
/begin FUNCTION SCRMon_Main ""
 /begin DEF_CHARACTERISTIC SCRMon_lPresLineInrDiam_C SCRMon_lPresLineLngth_C SCRMon_nEngOff_C SCRMon_nEngOn_C SCRMon_numPresBuildUpErr_C SCRMon_numRepPresBuildUp_C SCRMon_pMetCtlMax_C SCRMon_pMetCtlMin_C SCRMon_pPresBuildUpThres_C SCRMon_pPresRdcThres_C SCRMon_rAftrunEmptMinLdSt_C SCRMon_rFacEmpt_C SCRMon_rhoRdcAgnt_C SCRMon_rMaxAftrunEmpt_C SCRMon_rMaxReFl_C SCRMon_rReFlMaxLdSt_C SCRMon_rUDosVlv_CUR SCRMon_rUPmpMot_CUR SCRMon_stEnfShOffEnbl_C SCRMon_stUHC_C SCRMon_swtEngWaitDis_C SCRMon_tiAftrunTempWait_CUR SCRMon_tiTmrAftrunEmpt_C SCRMon_tiTmrPresBuildUp_C SCRMon_tiTmrPresRdc_C SCRMon_tiTmrStByCANDly_C SCRMon_tiTmrVtln_C SCRMon_tUCatUstMin_C SCRMon_volSplyModule_C /end DEF_CHARACTERISTIC
 /begin IN_MEASUREMENT CoSCR_st CoSCR_stSub CoSCR_tiAftrunTempWait CoSCR_tiPresBuildUp CoSCR_tiPresRdc CoSCR_tiStBy CoSCR_tiVtln Epm_nEng SCR_pUPmpP SCR_tUCatUsT SyC_stT15 UDosVlv_rPs UHC_stCtl UHC_stTstRls UPmpMot_rPs /end IN_MEASUREMENT
 /begin OUT_MEASUREMENT SCRMon_numPresBuildUpErrCnt SCRMon_numRepPresBuildup SCRMon_rHydFld SCRMon_stEnfShOff SCRMon_stEnfShOffWiEmpt SCRMon_stEng SCRMon_stUHC /end OUT_MEASUREMENT
 /begin LOC_MEASUREMENT SCRMon_facAftrunEmpt_mp SCRMon_facReFl_mp SCRMon_rAftrunEmptCurrSt_mp SCRMon_rReFlCurrSt_mp SCRMon_rUDosVlv_mp SCRMon_rUPmpMot_mp SCRMon_stEEPROMRead_mp SCRMon_stEEPROMWrite_mp SCRMon_tiTmrAftrunTempWait_mp /end LOC_MEASUREMENT
/end FUNCTION
/begin FUNCTION SCRPOD "" /begin SUB_FUNCTION SCRPOD_ETC SCRPOD_PresBuildUp /end SUB_FUNCTION /end FUNCTION
/begin FUNCTION SCRPOD_ETC "" /begin IN_MEASUREMENT CoSCR_st UDosVlv_rDyc UDosVlv_tiPer UPmpMot_r /end IN_MEASUREMENT /begin OUT_MEASUREMENT SCRPOD_rDosVlvDyc SCRPOD_stDiag SCRPOD_tiDlyETC /end OUT_MEASUREMENT /end FUNCTION
/begin FUNCTION SCRPOD_PresBuildUp "" /begin IN_MEASUREMENT SCRMon_stPresBuildUp /end IN_MEASUREMENT /begin LOC_MEASUREMENT SCRPOD_stPresBuildUpErr_mp SCRPOD_stPresBuildUpTstd_mp /end LOC_MEASUREMENT /end FUNCTION
/begin FUNCTION SCRT "" /begin SUB_FUNCTION SCRT_CalcTemp /end SUB_FUNCTION /end FUNCTION
/begin FUNCTION SCRT_CalcTemp ""
 /begin DEF_CHARACTERISTIC SCRT_arCatSurfBrick_C SCRT_cpBrick_C SCRT_cpEGBrick_C SCRT_facWghUs_C SCRT_htcSCR_CUR SCRT_mBrick_C /end DEF_CHARACTERISTIC
 /begin IN_MEASUREMENT EnvT_t Epm_nEng SCR_tUCatUsT VehV_v /end IN_MEASUREMENT
 /begin OUT_MEASUREMENT SCRT_tFld SCRT_tUCatDsT /end OUT_MEASUREMENT
 /begin LOC_MEASUREMENT SCRT_dhBrick_mp SCRT_dhExchEnvBrick_mp SCRT_dhInBrick_mp SCRT_dmEG_mp SCRT_dtBrick_mp SCRT_htcSCR_mp SCRT_stERS_mp SCRT_tAvrg_mp SCRT_tBrickDs_mp SCRT_tIniIntegBrick_mp /end LOC_MEASUREMENT
/end FUNCTION
/begin FUNCTION SensNOx "" /begin SUB_FUNCTION SensNOx_Can SensNOx_co /end SUB_FUNCTION /end FUNCTION
/begin FUNCTION SensNOx_Can ""
 /begin DEF_CHARACTERISTIC Com_swtSensNOxDewDet_C Com_swtSensNOxGnd_C Com_swtSensNOxUbatt_C /end DEF_CHARACTERISTIC
/end FUNCTION
/begin FUNCTION SensNOx_co ""
 /begin DEF_CHARACTERISTIC Com_stDewPntNotRchd_C Com_stDewPntRchd_C Com_swtUbattCat2Ds_C /end DEF_CHARACTERISTIC
 /begin IN_MEASUREMENT DewDet_stHtgLSU /end IN_MEASUREMENT
 /begin OUT_MEASUREMENT Com_rLamLinRecCat2Ds Com_rLamLinRecDs Com_rLamLinRecGnd Com_rLamLinRecUbatt Com_rNOxCat2Ds Com_rNOxCat2DsGnd Com_rNOxCat2DsUbatt Com_rNOxDs Com_stCat2DsGnd Com_stCat2DsUbatt Com_stHtrSetPCat2Ds Com_stHtrSetPDs Com_stLamBinVldCat2Ds Com_stLamBinVldDs Com_stLamLinRecVldCat2Ds Com_stLamLinRecVldDs Com_stNOxErrGnd Com_stNOxErrUbatt Com_stNOxVldCat2Ds Com_stNOxVldDs Com_stOpCirHtrCat2Ds Com_stOpCirHtrDs Com_stOpCirLamBinCat2Ds Com_stOpCirLamBinDs Com_stOpCirLamLinCat2Ds Com_stOpCirLamLinDs Com_stOpCirNOxCat2Ds Com_stOpCirNOxDs Com_stSensNOxDewDet Com_stShCirHtrCat2Ds Com_stShCirHtrDs Com_stShCirLamBinCat2Ds Com_stShCirLamBinDs Com_stShCirLamLinCat2Ds Com_stShCirLamLinDs Com_stShCirNOxCat2Ds Com_stShCirNOxDs Com_uLamBinCat2Ds Com_uLamBinDs Com_uLamBinGnd Com_uLamBinUbatt /end OUT_MEASUREMENT
 /begin LOC_MEASUREMENT Com_rLamLinRecGndRaw Com_rLamLinRecUbattRaw Com_rNOxCat2DsGndRaw Com_rNOxCat2DsUbattRaw Com_stCat2DsGndRaw Com_stCat2DsUbattRaw Com_stMux5Cat2Ds_mp Com_stMux5Ds_mp Com_stMux7Cat2Ds_mp Com_stMux7Ds_mp Com_stNOxErrGndRaw Com_stNOxErrUbattRaw Com_uLamBinGndRaw Com_uLamBinUbattRaw /end LOC_MEASUREMENT
/end FUNCTION
/begin FUNCTION Shtr_ActrRec ""
 /begin DEF_CHARACTERISTIC Shtr_ctPKKLrnThres_C Shtr_tiAKKLrnThres_C Shtr_tiPKKLrnThres_C Shtr_tiPKKTimerMax_C Shtr_tiPKKTimerMin_C Shtr_tiSysRst_C Shtr_uBatt_C /end DEF_CHARACTERISTIC
 /begin IN_MEASUREMENT BattU_u Epm_nEng Shtr_stAKKfbOk Shtr_stAKKfbSSG Shtr_stAKKNoLdErr Shtr_stAKKOk Shtr_stPKKLrnBlkRst SyC_stSub T15_st /end IN_MEASUREMENT
 /begin OUT_MEASUREMENT Shtr_stAKKActrPresent Shtr_stAKKLrnCond Shtr_stAKKTOut Shtr_stLrnLogic Shtr_stPKKActrPresent Shtr_stPKKLrnBlk Shtr_stPKKLrnCond Shtr_stSysRst /end OUT_MEASUREMENT
 /begin LOC_MEASUREMENT Shtr_ctPKKLrnCntr_mp Shtr_stPKKNegRng_mp Shtr_stPKKPosRng_mp Shtr_stSysRstActv_mp Shtr_tiAKKLrnTimer_mp Shtr_tiPKKLrnTimer_mp Shtr_tiPKKNegTimer_mp Shtr_tiPKKPosTimer_mp /end LOC_MEASUREMENT
/end FUNCTION
/begin FUNCTION Shtr_DD ""
 /begin DEF_CHARACTERISTIC Shtr_Pwm.tiPer_C Shtr_Pwm.stLvl_C Shtr_Pwm.rMaxDty_C Shtr_Pwm.rPerUn_C Shtr_Pwm.tiPh_C Shtr_PwmOut.rMin_C Shtr_PwmOut.rMax_C Shtr_PwmOut.tiBtwTstSCB_C Shtr_PwmOut.tiBtwTstOT_C Shtr_PwmOut.numTstMax_C Shtr_PwmOut.swtBattCor_C Shtr_PwmOut.swtPsInv_C Shtr_rPsDisbl_C Shtr_stPsDisbl_C /end DEF_CHARACTERISTIC
 /begin IN_MEASUREMENT BattU_facCor DevLib_stPwrStgEnaCond Shtr_rActrOut Shtr_rOut Shtr_stExtCtlActv /end IN_MEASUREMENT
 /begin OUT_MEASUREMENT Shtr_r Shtr_rPs /end OUT_MEASUREMENT
/end FUNCTION
/begin FUNCTION Shtr_diag ""
 /begin DEF_CHARACTERISTIC Shtr_ctDebAKKErrEntrMax_C Shtr_ctDebIncAKKErrEntr_C Shtr_ctDebIncPKKErrEntr_C Shtr_ctDebPKKErrEntrMax_C Shtr_ctPwrStgOnMax_C Shtr_rOutMax_C Shtr_rOutMin_C Shtr_stAKKErrRls_C Shtr_stPwrStgDiag_C Shtr_tiAKKOkDeb_C Shtr_tiDebSelfDet_C Shtr_tiDiagDeb_C Shtr_tiSysDiagMax1_C Shtr_tiSysDiagMax2_C Shtr_tiSysDiagMax3_C Shtr_tiSysDiagMax4_C Shtr_tiSysDiagMax5_C Shtr_tiSysDiagMax6_C Shtr_tiSysDiagMax_C Shtr_tiSysDiagMin1_C Shtr_tiSysDiagMin2_C Shtr_tiSysDiagMin3_C Shtr_tiSysDiagMin4_C Shtr_tiSysDiagMin5_C Shtr_tiSysDiagMin6_C /end DEF_CHARACTERISTIC
 /begin REF_CHARACTERISTIC Shtr_uBatt_C /end REF_CHARACTERISTIC
 /begin IN_MEASUREMENT BattU_facCor BattU_u CoEng_st DevLib_stPwrStgEnaCond Shtr_rOut Shtr_stAKKActrPresent Shtr_stAKKCtlVal Shtr_stAKKLrnCond Shtr_stAKKTOut Shtr_stPKKActrPresent Shtr_stPKKCtlVal Shtr_stPKKLrnCond Shtr_stSysTst SyC_stSub /end IN_MEASUREMENT
 /begin OUT_MEASUREMENT Shtr_rActrOut Shtr_stAKKEdg Shtr_stAKKfbOk Shtr_stAKKfbSSG Shtr_stAKKNoLdErr Shtr_stAKKOk Shtr_stDiag Shtr_stDiagEnd Shtr_stDiagErr Shtr_stPKKEdg Shtr_stPKKLrnBlkRst Shtr_stPSUseOk /end OUT_MEASUREMENT
 /begin LOC_MEASUREMENT Shtr_ctDebAKKErrEntr_mp Shtr_ctDebAKKErrHeal_mp Shtr_ctDebPKKErrEntr_mp Shtr_ctDebPKKErrHeal_mp Shtr_stAKKDiagVld_mp Shtr_stAKKEdg_mp Shtr_stAKKErrSym_mp Shtr_stAKKSSGFEdg_mp Shtr_stEngStrtEnd_mp Shtr_stPKKDiagVld_mp Shtr_stPKKDiag_mp Shtr_stPKKEdg_mp Shtr_stPKKErrSym_mp Shtr_stPwrStg_mp Shtr_stRes_mp Shtr_stSysfbVld_mp Shtr_tiSysDiagErr_mp Shtr_tiSysDiag_mp /end LOC_MEASUREMENT
/end FUNCTION
/begin FUNCTION Shtr_PWMSelect ""
 /begin DEF_CHARACTERISTIC Shtr_rOffOffTst_C Shtr_rOffOnTst_C Shtr_rOnOffTst_C Shtr_rOnOnTst_C Shtr_rOutDiag_C Shtr_rOutInit_C Shtr_rOutMan_C Shtr_rOutPKKLrn_C Shtr_stManCtl_C Shtr_stPKKActv_C Shtr_uBattMax_C /end DEF_CHARACTERISTIC
 /begin IN_MEASUREMENT BattU_u Layer_stAKK Layer_stPKK Shtr_stAKKActrPresent Shtr_stDiag Shtr_stPKKActrPresent Shtr_stPKKLrnCond Shtr_stSysCtlVal Shtr_stSysTst SyC_stSub /end IN_MEASUREMENT
 /begin OUT_MEASUREMENT Shtr_rOut Shtr_stAKKCtlVal Shtr_stAKKExtTstStrt Shtr_stExtCtlActv Shtr_stPKKCtlVal Shtr_stPKKExtTstStrt /end OUT_MEASUREMENT
 /begin LOC_MEASUREMENT Shtr_rOutVal_mp Shtr_stAKKExtTst_mp Shtr_stPKKExtTst_mp /end LOC_MEASUREMENT
/end FUNCTION
/begin FUNCTION Shtr_State ""
 /begin IN_MEASUREMENT Shtr_stAKKActrPresent Shtr_stAKKExtTstStrt Shtr_stDiag Shtr_stDiagEnd Shtr_stLrnLogic Shtr_stPKKActrPresent Shtr_stPKKExtTstStrt Shtr_stSysTst Shtr_stSysTstEnd /end IN_MEASUREMENT
 /begin OUT_MEASUREMENT Shtr_stSysState /end OUT_MEASUREMENT
/end FUNCTION
/begin FUNCTION Shtr_SysTst "" /begin DEF_CHARACTERISTIC Shtr_ctSysCntThres_C Shtr_tiSysTstThres_C /end DEF_CHARACTERISTIC /begin REF_CHARACTERISTIC Shtr_uBatt_C /end REF_CHARACTERISTIC
 /begin IN_MEASUREMENT BattU_u Shtr_stAKKExtTstStrt Shtr_stDiagEnd Shtr_stDiagErr Shtr_stPKKExtTstStrt Shtr_stPKKLrnCond Shtr_stSysState SyC_stSub /end IN_MEASUREMENT
 /begin OUT_MEASUREMENT Shtr_stSysCtlVal Shtr_stSysTst Shtr_stSysTstEnd Shtr_stSysTstRslt /end OUT_MEASUREMENT
 /begin LOC_MEASUREMENT Shtr_ctSysCnt_mp Shtr_stSysTstFE_mp Shtr_stSysTstRE_mp Shtr_stSysTstStop_mp Shtr_stSysTstStrt_mp Shtr_stTotSysErr_mp Shtr_tiSysTstTmr_mp /end LOC_MEASUREMENT
/end FUNCTION
/begin FUNCTION SIA "" /begin SUB_FUNCTION Sia_CycSigChk /end SUB_FUNCTION /end FUNCTION
/begin FUNCTION Sia_Adapt "" /begin DEF_CHARACTERISTIC /end DEF_CHARACTERISTIC /begin IN_MEASUREMENT CoEng_st Com_stKeyVld SyC_stSub T15_st /end IN_MEASUREMENT /begin OUT_MEASUREMENT /end OUT_MEASUREMENT /end FUNCTION
/begin FUNCTION sia_comifc "" /begin DEF_CHARACTERISTIC /end DEF_CHARACTERISTIC /end FUNCTION
/begin FUNCTION Sia_Core "" /begin DEF_CHARACTERISTIC /end DEF_CHARACTERISTIC /begin IN_MEASUREMENT /end IN_MEASUREMENT /begin OUT_MEASUREMENT e_sig_ews4_u32 n_bar_sig_ews4_u32 n_sig_ews4_u32 /end OUT_MEASUREMENT /begin LOC_MEASUREMENT /end LOC_MEASUREMENT /end FUNCTION
/begin FUNCTION Sia_CycSigChk "" /begin DEF_CHARACTERISTIC /end DEF_CHARACTERISTIC /begin IN_MEASUREMENT Epm_nEng /end IN_MEASUREMENT /begin OUT_MEASUREMENT /end OUT_MEASUREMENT /end FUNCTION
/begin FUNCTION Sia_EmsIfc "" /begin OUT_MEASUREMENT /end OUT_MEASUREMENT /begin LOC_MEASUREMENT /end LOC_MEASUREMENT /end FUNCTION
/begin FUNCTION Signals "" /begin DEF_CHARACTERISTIC Signals_Mode1Pid_CA Signals_Mode1SigNum_CA /end DEF_CHARACTERISTIC /end FUNCTION
/begin FUNCTION SmkLim_AirMsSel ""
 /begin DEF_CHARACTERISTIC SmkLim_facEnvPCorNeg_CUR SmkLim_facEnvPCorPos_CUR SmkLim_swtAirMs_C SmkLim_tiAFS_MAP SmkLim_tiPT1Neg_MAP SmkLim_tiPT1Pos_MAP /end DEF_CHARACTERISTIC
 /begin IN_MEASUREMENT AFS_mAirPerCyl Air_pIntkVUs ASMod_mAirPerCylCor EnvP_p Epm_nEng PCR_pGovDvt /end IN_MEASUREMENT
 /begin OUT_MEASUREMENT SmkLim_mAirPerCyl /end OUT_MEASUREMENT
 /begin LOC_MEASUREMENT SmkLim_mAirMsCor_mp SmkLim_tiAirPerCyl_mp /end LOC_MEASUREMENT
/end FUNCTION
/begin FUNCTION smklim_fullldrgl "" /begin OUT_MEASUREMENT SmkLim_qFullLdRgl /end OUT_MEASUREMENT /end FUNCTION
/begin FUNCTION smklim_injmasslim ""
 /begin DEF_CHARACTERISTIC SmkLim_dSmkLim.Pos_C SmkLim_dSmkLim.Neg_C SmkLim_facLamAPSCorEOM1_CUR SmkLim_facLamAPSCorEOM2_CUR SmkLim_facLamAPSCor_CUR SmkLim_facLamATSCorEOM1_CUR SmkLim_facLamATSCorEOM2_CUR SmkLim_facLamATSCor_CUR SmkLim_facLamETSCor_CUR SmkLim_mAirPerCylMin_C SmkLim_mskOpMode_CA SmkLim_numRevEng_C SmkLim_numSmkLim_C SmkLim_pThresLam0EOM1_C SmkLim_pThresLam0EOM2_C SmkLim_pThresLam0Nrm_C SmkLim_pThresLam1EOM1_C SmkLim_pThresLam1EOM2_C SmkLim_pThresLam1Nrm_C SmkLim_pThresLam2EOM1_C SmkLim_pThresLam2EOM2_C SmkLim_pThresLam2Nrm_C SmkLim_rLamAPSCorEOM1_MAP SmkLim_rLamAPSCorEOM2_MAP SmkLim_rLamAPSCor_MAP SmkLim_rLamATSCorEOM1_MAP SmkLim_rLamATSCorEOM2_MAP SmkLim_rLamATSCor_MAP SmkLim_rLamETSCor_MAP SmkLim_rLamFullLd_MAP SmkLim_rLamMax_C SmkLim_rLamMin_C SmkLim_rLamSmk2EOM1_MAP SmkLim_rLamSmk2EOM2_MAP SmkLim_rLamSmk2UpperGbxEOM1_MAP SmkLim_rLamSmk2UpperGbxEOM2_MAP SmkLim_rLamSmk2UpperGbx_MAP SmkLim_rLamSmk2_MAP SmkLim_rLamSmkEOM1_MAP SmkLim_rLamSmkEOM2_MAP SmkLim_rLamSmkMin_MAP SmkLim_rLamSmkUpperGbxEOM1_MAP SmkLim_rLamSmkUpperGbxEOM2_MAP SmkLim_rLamSmkUpperGbx_MAP SmkLim_rLamSmk_MAP SmkLim_stGearGroupSwitch_C SmkLim_trqThresInrDes0EOM1_C SmkLim_trqThresInrDes0EOM2_C SmkLim_trqThresInrDes0Nrm_C SmkLim_trqThresInrDes1EOM1_C SmkLim_trqThresInrDes1EOM2_C SmkLim_trqThresInrDes1Nrm_C SmkLim_trqThresInrDes2EOM1_C SmkLim_trqThresInrDes2EOM2_C SmkLim_trqThresInrDes2Nrm_C SmkLim_trqThresInrEOM1_C SmkLim_trqThresInrEOM2_C SmkLim_trqThresInrNrm_C SmkLim_tThresLamHighEOM1_C SmkLim_tThresLamHighEOM2_C SmkLim_tThresLamHighNrm_C SmkLim_tThresLamLowEOM1_C SmkLim_tThresLamLowEOM2_C SmkLim_tThresLamLowNrm_C /end DEF_CHARACTERISTIC
 /begin IN_MEASUREMENT Air_tAFS CoETS_trqInrSetSlow EngDa_tEng EngDa_tFld EngPrt_trqPrtLim EnvP_p Epm_nEng SmkLim_mAirPerCyl SmkLim_qFullLdRgl Tra_numGear /end IN_MEASUREMENT
 /begin OUT_MEASUREMENT SmkLim_mAirPerCylLim_mp SmkLim_qLimSmk SmkLim_qLimSmkNxt SmkLim_qLimSmkPrs SmkLim_rLamSet SmkLim_rLamSetNxt SmkLim_stLamSmkEOM1 SmkLim_stLamSmkEOM2 SmkLim_stLamSmkNrm SmkLim_stNxt SmkLim_stPrs SmkLim_tSmkLim_mp /end OUT_MEASUREMENT
 /begin LOC_MEASUREMENT SmkLim_qLimSmkBasNxt_mp SmkLim_qLimSmkBasPrs_mp SmkLim_rLamCorEOM1_mp SmkLim_rLamCorEOM2_mp SmkLim_rLamCorNrm_mp SmkLim_rLamSetPrs SmkLim_rLamSmkEOM1_mp SmkLim_rLamSmkEOM2_mp SmkLim_rLamSmkMin_mp SmkLim_rLamSmkNrmMode_mp SmkLim_stGearGroup_mp SmkLim_stSmkLimEOM1_mp SmkLim_stSmkLimEOM2_mp SmkLim_stSmkLimNrm_mp /end LOC_MEASUREMENT
/end FUNCTION
/begin FUNCTION SpdGov_Global "" /end FUNCTION
/begin FUNCTION SpdGov_TrqCalc ""
 /begin DEF_CHARACTERISTIC SpdGov_stMskMoLimFunc_C SpdGov_stMskMoLimTrq_C SpdGov_stMskNegCurrTrqEna_C SpdGov_stMskNegLdTrqEna_C /end DEF_CHARACTERISTIC
 /begin IN_MEASUREMENT AGSDem_nSetPHi AGSDem_nSetPLo CoPT_trqDesCompEng DiaDem_nSetPHi DiaDem_nSetPLo EngTrqPtd_trqSpdG GSHDem_nSetPHi GSHDem_nSetPLo HLSDem_nSetPHi HLSDem_nSetPLo ISC_nSetPHi ISC_nSetPLo ISC_numCurrFunc ISC_trq ISC_trqFlt ISC_trqLoLimMin ISC_trqLoLtd /end IN_MEASUREMENT
 /begin OUT_MEASUREMENT SpdGov_nSetPHi SpdGov_nSetPLo SpdGov_st SpdGov_trqFlt SpdGov_trqInrLimSet SpdGov_trqLead SpdGov_trqSet /end OUT_MEASUREMENT
 /begin LOC_MEASUREMENT SpdGov_stMoLim_mp /end LOC_MEASUREMENT
/end FUNCTION
/begin FUNCTION Spi "" /end FUNCTION
/begin FUNCTION SrvB "" /end FUNCTION
/begin FUNCTION SrvF "" /end FUNCTION
/begin FUNCTION SrvX "" /end FUNCTION
/begin FUNCTION SSwtSAppl "" /end FUNCTION
/begin FUNCTION SSwtS_GetSwt "" /end FUNCTION
/begin FUNCTION SSwtS_SetSwt ""
 /begin DEF_CHARACTERISTIC SSwtS_swtGlbTyp_C SSwtS_Val.ETClb_swtCorActvVal_C SSwtS_Val.InjCrv_swtPiIDblCorMapVal_C SSwtS_Val.PCV_swtCtlStateVal_C SSwtS_Val.Rail_swtPreCtlVal_C SSwtS_Val.Rail_swtWindUpVal_C SSwtS_Val.Rail_swtCtlSelVal_C SSwtS_Val.Rail_swtPressVal_C SSwtS_Val.ZFC_swtClbActvVal_C /end DEF_CHARACTERISTIC
/end FUNCTION
/begin FUNCTION StAPmp_TrqLoad ""
 /begin DEF_CHARACTERISTIC StAPmp_facdTrq_C StAPmp_facSTETrqDiff_C StAPmp_facTrqPhiSTE_MAP StAPmp_facTrqSTE_MAP StAPmp_stDrvDynLvl_C StAPmp_swtActive_C StAPmp_swtDflVal_C StAPmp_trqDfl_C StAPmp_trqSTEMax_C StAPmp_trqSTEMin_C /end DEF_CHARACTERISTIC
 /begin IN_MEASUREMENT CoEng_st Com_dphiStWhlAg Com_phiStWhlAg Com_stDrvDyn Com_stDrvDynQl Com_trqTarDrvDyn Com_trqTarDrvDynDes Epm_nEng VehV_v /end IN_MEASUREMENT
 /begin OUT_MEASUREMENT StAPmp_trqSTE Strg_trqDes Strg_trqResv /end OUT_MEASUREMENT
 /begin LOC_MEASUREMENT StAPmp_dtrqDes_mp StAPmp_facSTETrqRaw_mp StAPmp_stSTEEna_mp StAPmp_trqDiff_mp StAPmp_trqSTERaw_mp /end LOC_MEASUREMENT
/end FUNCTION
/begin FUNCTION Stm58Bw016 "" /end FUNCTION
/begin FUNCTION StrgECU "" /begin SUB_FUNCTION StrgECU_co StrgECU_swt StrgECU_fx StrgECU_flex /end SUB_FUNCTION /end FUNCTION
/begin FUNCTION StrgECU_Can ""
 /begin DEF_CHARACTERISTIC Com_ctTrqDemandAFSSelfRec_C Com_ctTrqDemandSTESelfRec_C Com_stMskTrqDemandAFSSig_C Com_stMskTrqDemandSTESig_C Com_swtTrqDemandAFS_C Com_swtTrqDemandSTE_C Com_tiTrqDemandAFSSelfRec_C Com_tiTrqDemandSTESelfRec_C /end DEF_CHARACTERISTIC
 /begin OUT_MEASUREMENT Com_bRecAFS Com_bRecSTE /end OUT_MEASUREMENT
/end FUNCTION
/begin FUNCTION StrgECU_co ""
 /begin OUT_MEASUREMENT Com_dTrqDemandAFSCHK Com_dTrqDemandAFSCTR Com_dTrqDemandSTECHK Com_dTrqDemandSTECTR Com_stErrAFS Com_stErrStrg Com_stStrg Com_stTrqAFS Com_stTrqStrg Com_trqAFS Com_trqAFSDes Com_trqStrg Com_trqStrgDes /end OUT_MEASUREMENT
/end FUNCTION
/begin FUNCTION StrgECU_flex "" /begin OUT_MEASUREMENT Com_stSTEQl /end OUT_MEASUREMENT /end FUNCTION
/begin FUNCTION StrgECU_fx "" /begin DEF_CHARACTERISTIC Com_swtSteeringAngle_FX_C /end DEF_CHARACTERISTIC
 /begin OUT_MEASUREMENT Com_dphiStWhlAg_FX Com_dSteeringAngleCHK_FX Com_dSteeringAngleCTR_FX Com_phiStWhlAg_FX Com_stSTEQl_FX /end OUT_MEASUREMENT
/end FUNCTION
/begin FUNCTION StrgECU_swt ""
 /begin IN_MEASUREMENT Com_dphiStWhlAg Com_dphiStWhlAg_FX Com_phiStWhlAg Com_phiStWhlAg_FX Com_stSTEQl Com_stSTEQl_FX /end IN_MEASUREMENT
/end FUNCTION
/begin FUNCTION Strt_DD ""
 /begin DEF_CHARACTERISTIC Strt_DigOut.tiBtwTstSCB_C Strt_DigOut.tiBtwTstOT_C Strt_DigOut.numTstMax_C Strt_stPsDiaDisbl_C Strt_stPsDisbl_C /end DEF_CHARACTERISTIC
 /begin IN_MEASUREMENT DevLib_stPwrStgEnaCond /end IN_MEASUREMENT
 /begin OUT_MEASUREMENT Strt_st Strt_stPs /end OUT_MEASUREMENT
/end FUNCTION
/begin FUNCTION StSys_AddCor ""
 /begin DEF_CHARACTERISTIC StSys_facAPSCor_CUR StSys_numStrtAddCor_C StSys_trqStrtAPSCor_MAP /end DEF_CHARACTERISTIC
 /begin IN_MEASUREMENT EnvP_p Epm_nEng /end IN_MEASUREMENT
 /begin OUT_MEASUREMENT StSys_facAPSCor_mp StSys_trqAddCor StSys_trqStrtAPSCor_mp StSys_trqStrtAPS_mp StSys_tStrtCor_mp /end OUT_MEASUREMENT
/end FUNCTION
/begin FUNCTION StSys_Strt ""
 /begin DEF_CHARACTERISTIC StSys_nStrtCutOutMSA_MAP StSys_nStrtCutOut_MAP StSys_numStrt_C StSys_tiStrtCutOut_C /end DEF_CHARACTERISTIC
 /begin IN_MEASUREMENT CoEng_st Com_stMSAStart EngDa_tFld EnvP_p Epm_nEng /end IN_MEASUREMENT
 /begin OUT_MEASUREMENT StSys_nThresStrtCutOut StSys_stNewStrt StSys_stStrt StSys_stStrtCutOutMon /end OUT_MEASUREMENT
 /begin LOC_MEASUREMENT StSys_nStrtCutOutMSA_mp StSys_nStrtCutOut_mp StSys_tStrt_mp /end LOC_MEASUREMENT
/end FUNCTION
/begin FUNCTION StSys_StrtBas ""
 /begin DEF_CHARACTERISTIC StSys_nAdjMax_C StSys_numStrtBas_C StSys_trqAdjMax_C StSys_trqAdjVal_C StSys_trqStrtBasMSA_MAP StSys_trqStrtBas_MAP /end DEF_CHARACTERISTIC
 /begin IN_MEASUREMENT CoEng_st Com_stMSAStart EngDa_tFld Epm_nEng StSys_trqAddCor /end IN_MEASUREMENT
 /begin OUT_MEASUREMENT StSys_trqBas /end OUT_MEASUREMENT
 /begin LOC_MEASUREMENT StSys_trqAdj_mp StSys_trqSetAdjVal_mp StSys_trqStrtBasMSA_mp StSys_trqStrtBas_mp StSys_tStrtBas_mp /end LOC_MEASUREMENT
/end FUNCTION
/begin FUNCTION StSys_StrtCtl "" /begin IN_MEASUREMENT StSys_stStrtTip /end IN_MEASUREMENT /begin OUT_MEASUREMENT StSys_st /end OUT_MEASUREMENT /begin SUB_FUNCTION StSys_StrtCtl /end SUB_FUNCTION /end FUNCTION
/begin FUNCTION StSys_StrtRmp ""
 /begin DEF_CHARACTERISTIC StSys_CldEng.dtrqInc_C StSys_CldEng.tiRmpLck_C StSys_CldEng.trqLim_C StSys_HotEng.dtrqInc_C StSys_HotEng.tiRmpLck_C StSys_HotEng.trqLim_C StSys_nFreezeTrqRmp_C StSys_nReleaseTrqRmp_C StSys_numStrtRmp_C StSys_tClntHi_C StSys_tClntLo_C StSys_tiEngTempValid_C StSys_WrmEng.dtrqInc_C StSys_WrmEng.tiRmpLck_C StSys_WrmEng.trqLim_C /end DEF_CHARACTERISTIC
 /begin IN_MEASUREMENT CoEng_st EngDa_tFld Epm_nEng StSys_stTrqShutOff StSys_trqBas /end IN_MEASUREMENT
 /begin OUT_MEASUREMENT StSys_stRmpMon StSys_trqRmpState StSys_trqStrt /end OUT_MEASUREMENT
 /begin LOC_MEASUREMENT StSys_tStrtRmp_mp /end LOC_MEASUREMENT
/end FUNCTION
/begin FUNCTION StSys_StrtTip ""
 /begin DEF_CHARACTERISTIC StSys_nStrtTipMaxMSA_MAP StSys_nStrtTipMax_MAP StSys_nStrtTipProt_C StSys_swtGlwLamp_C StSys_swtShOffGearbxRec_C StSys_swtStrtTipActv_C StSys_tiStrtLck_C StSys_tiStrtMax_C StSys_tiStrtTipMin_C StSys_tiStrtTipNoMonitor_C StSys_tiStrtTipProt_C /end DEF_CHARACTERISTIC
 /begin IN_MEASUREMENT Com_stMSAStart EngDa_tEng EnvP_p Epm_nEng GlwCtl_stGlw GlwLmp_st PT_stTraType StSys_stStrt T15_st T50_st Tra_numGear /end IN_MEASUREMENT
 /begin OUT_MEASUREMENT StSys_stStrtTip StSys_stStrtTipOFF StSys_stStrtTipON /end OUT_MEASUREMENT
 /begin LOC_MEASUREMENT StSys_nStrtTipMaxMSA_mp StSys_nStrtTipMax_mp /end LOC_MEASUREMENT
/end FUNCTION
/begin FUNCTION StSys_TrqShutOff ""
 /begin DEF_CHARACTERISTIC StSys_n2MsWhlLoLim_C StSys_n2MsWhlUpOfs_C StSys_swtShutOff_C StSys_ti2MsWhlPrt_C StSys_tinFltPT1_C /end DEF_CHARACTERISTIC
 /begin OUT_MEASUREMENT StSys_stTrqShutOff /end OUT_MEASUREMENT
 /begin LOC_MEASUREMENT StSys_nEpmFlt_mp StSys_stTrqShutOffCond_mp /end LOC_MEASUREMENT
/end FUNCTION
/begin FUNCTION SyC_CalWakeup "" /begin IN_MEASUREMENT SyC_stMn SyC_stT15 /end IN_MEASUREMENT /end FUNCTION
/begin FUNCTION SyC_Deadline "" /begin LOC_MEASUREMENT SyC_ctDeadline1msErr /end LOC_MEASUREMENT /end FUNCTION
/begin FUNCTION SyC_Main "" /begin DEF_CHARACTERISTIC SyC_stTest_C SyC_swtTestEna_C /end DEF_CHARACTERISTIC
 /begin IN_MEASUREMENT MoCCom_stWDAActvMsg Mo_stIrvErrReacMsg SyC_stPostDrv SyC_stPreDrv T15_st /end IN_MEASUREMENT
 /begin OUT_MEASUREMENT SyC_ctIrrSwOff SyC_stMn SyC_stMnOld SyC_stSub SyC_stSubOld SyC_stT15 SyC_tiDrv SyC_tiPostDrv SyC_tiPreDrv /end OUT_MEASUREMENT
 /begin LOC_MEASUREMENT SyC_tiBoot_mp SyC_tiFrst10ms_mp SyC_tiIniEnd_mp SyC_tiIniSyn_mp SyC_tiIni_mp SyC_tiShutdown_mp /end LOC_MEASUREMENT
/end FUNCTION
/begin FUNCTION SyC_PostDrv "" /begin DEF_CHARACTERISTIC SyC_tiPostDrvMax_C SyC_tiPostDrvMin_C /end DEF_CHARACTERISTIC /begin IN_MEASUREMENT CustDiag_stPwrDwn Epm_nEng SyC_stSub /end IN_MEASUREMENT /begin OUT_MEASUREMENT SyC_stPostDrv /end OUT_MEASUREMENT /begin LOC_MEASUREMENT SyC_stPostDrvFin_mp /end LOC_MEASUREMENT /end FUNCTION
/begin FUNCTION SyC_PreDrv "" /begin DEF_CHARACTERISTIC SyC_swtPreDrv_C SyC_tiPreDrvMax_C SyC_tiPreDrvMin_C /end DEF_CHARACTERISTIC
 /begin IN_MEASUREMENT CustDiag_stPwrDwn MoCCom_ctErrMMMsg MRly_st MRly_stAct SyC_stSub SyC_stT15 T15_st T15_stWakeUp /end IN_MEASUREMENT
 /begin OUT_MEASUREMENT SyC_stPreDrv /end OUT_MEASUREMENT
 /begin LOC_MEASUREMENT SyC_ctSwtOnCan_mp SyC_ctSwtOnEin_mp SyC_ctSwtOnStc_mp SyC_ctSwtOnWak_mp SyC_stSwtOn_mp SyC_tiPreDrvMin_mp /end LOC_MEASUREMENT
/end FUNCTION
/begin FUNCTION SyC_Shutdown "" /end FUNCTION
/begin FUNCTION SyC_StopCnt "" /begin DEF_CHARACTERISTIC SyC_tiDiaStopCnt_C SyC_tiStopCntMax_C /end DEF_CHARACTERISTIC /begin IN_MEASUREMENT SyC_stSub /end IN_MEASUREMENT /begin OUT_MEASUREMENT SyC_stVldTiEcuOff SyC_tiEcuOff /end OUT_MEASUREMENT /begin LOC_MEASUREMENT SyC_stStopCntXPostDrv_mp /end LOC_MEASUREMENT /end FUNCTION
/begin FUNCTION SyC_UnderVltg "" /begin LOC_MEASUREMENT SyC_ctInit_mp SyC_ctUnderVltg_mp SyC_tiUnderVltg_mp /end LOC_MEASUREMENT /end FUNCTION
/begin FUNCTION T15_DD "" /begin DEF_CHARACTERISTIC T15_Deb.tiHiLo_C T15_Deb.tiLoHi_C /end DEF_CHARACTERISTIC /begin OUT_MEASUREMENT T15_stRaw /end OUT_MEASUREMENT /end FUNCTION
/begin FUNCTION T15_Rst "" /end FUNCTION
/begin FUNCTION T15_VD "" /begin DEF_CHARACTERISTIC T15_tiDebWakeUp_C /end DEF_CHARACTERISTIC /begin IN_MEASUREMENT Com_stT15 T15_stRaw /end IN_MEASUREMENT /begin OUT_MEASUREMENT T15_st T15_stWakeUp /end OUT_MEASUREMENT /begin LOC_MEASUREMENT T15_stCondDeb_mp T15_stDebWakeUp T15_stLogic_mp /end LOC_MEASUREMENT /end FUNCTION
/begin FUNCTION t15_vd_calwup "" /end FUNCTION
/begin FUNCTION t50_dd ""
 /begin DEF_CHARACTERISTIC T50_Deb.tiHiLo_C T50_Deb.tiLoHi_C T50_stDflVal_C T50_swtSig_C /end DEF_CHARACTERISTIC
 /begin IN_MEASUREMENT Com_stT50 /end IN_MEASUREMENT
 /begin LOC_MEASUREMENT T50_stRaw /end LOC_MEASUREMENT
/end FUNCTION
/begin FUNCTION t50_vd "" /begin OUT_MEASUREMENT T50_st /end OUT_MEASUREMENT /end FUNCTION
/begin FUNCTION TAA_Adap ""
 /begin DEF_CHARACTERISTIC TAA_facDynMax_C TAA_facSinTab_CA TAA_nAdapMid_CA TAA_nAdapRng_CA TAA_numGapIpoInc_C TAA_numSinTab_C TAA_phiDiffMaxFst_CA TAA_phiDiffMax_CA TAA_stMainSpdRng_C TAA_stReqRstVal_C TAA_tiIncDvtFltFst_C TAA_tiIncDvtFlt_C /end DEF_CHARACTERISTIC
 /begin REF_CHARACTERISTIC TAA_numIncGap_CA TAA_stAdapMode_C TAA_stTstMode_C /end REF_CHARACTERISTIC
 /begin IN_MEASUREMENT TAA_numActv TAA_stAdap TAA_stLrnMode /end IN_MEASUREMENT
 /begin OUT_MEASUREMENT TAA_ctLrnCycl TAA_stFin /end OUT_MEASUREMENT
 /begin LOC_MEASUREMENT TAA_ctBufSect_mp TAA_facDyn_mp TAA_phiIncDvt_mp TAA_stAdapMode_mp TAA_stAdapVal TAA_stSpdRngWr_mp TAA_tiIncAvrg_mp TAA_tiInc_mp /end LOC_MEASUREMENT
/end FUNCTION
/begin FUNCTION TAA_Axispoints "" /end FUNCTION
/begin FUNCTION TAA_Ctl ""
 /begin DEF_CHARACTERISTIC TAA_nMax_C TAA_nMin_C TAA_numActv_CA TAA_numIncGap_CA TAA_numRevCor_C TAA_rTrqMax_C TAA_stAdapMode_C TAA_stEvalFin_C TAA_stExtp_C TAA_stFstLrnMsk_C TAA_stTstMode_C TAA_tiEnaDel_C TAA_vMin_C /end DEF_CHARACTERISTIC
 /begin REF_CHARACTERISTIC EpmSeq_phiInt_CA Epm_phiGap2Zero_C Epm_phiTdc1_C /end REF_CHARACTERISTIC
 /begin IN_MEASUREMENT Brk_st Clth_st CoEng_st EpmSeq_numIncDiffInt EpmSeq_numInt EpmSyn_phiInt Epm_nEng Epm_numCyl Epm_phiDiffTDC Epm_stOpMode Epm_stSync PthSet_stOvrRunCoord PT_rTrq TAA_stFin VehV_v /end IN_MEASUREMENT
 /begin OUT_MEASUREMENT TAA_numActv TAA_stAdap TAA_stLrnMode /end OUT_MEASUREMENT
 /begin LOC_MEASUREMENT TAA_ctAngDvt_mp TAA_facIpo_mp TAA_nMinCalc_mp TAA_numIncBefGap_mp TAA_numIncIR_mp TAA_phiAngDvt_mp TAA_stEnaCond_mp TAA_stErr_mp TAA_stIdxSync_mp TAA_stIpoMode_mp TAA_stRev2Fin_mp TAA_stRlsOvrRunCo_mp TAA_stSpdRngRdHi_mp TAA_stSpdRngRdLo_mp /end LOC_MEASUREMENT
/end FUNCTION
/begin COMPU_METHOD AgCrSHiReso "" RAT_FUNC "%6.5" "deg CrS" COEFFS 0 5825.4222222208 0 0 0 1 /end COMPU_METHOD
/begin COMPU_METHOD AirMassPerCyl "" RAT_FUNC "%5.1" "mg/Hub" COEFFS 0 10 0 0 0 1 /end COMPU_METHOD
/begin COMPU_METHOD AirMassPerTime "" RAT_FUNC "%5.1" "Kg/h" COEFFS 0 10 0 0 0 1 /end COMPU_METHOD
/begin COMPU_METHOD AngleCrS "" RAT_FUNC "%6.3" "deg CrS" COEFFS 0 45.5111111111 0 0 0 1 /end COMPU_METHOD
/begin COMPU_METHOD AngleStWhl "" RAT_FUNC "%6.4" "deg StWhl" COEFFS 0 32 0 0 0 1 /end COMPU_METHOD
/begin COMPU_METHOD AngleVelStWhl "" RAT_FUNC "%6.4" "deg StWhl/s" COEFFS 0 32 0 0 0 1 /end COMPU_METHOD
/begin COMPU_METHOD COEOM_PCRCTLLPQNTNUMMAP_SY_Compu "" TAB_NOINTP "%6.3" "" COMPU_TAB_REF COEOM_PCRCTLLPQNTNUMMAP_SY_Compu /end COMPU_METHOD
/begin COMPU_TAB COEOM_PCRCTLLPQNTNUMMAP_SY_Compu "" TAB_NOINTP 8 0 0 1 1 2 2 3 3 4 4 5 5 6 6 7 7 /end COMPU_TAB
/begin COMPU_METHOD dTrq "" RAT_FUNC "%6.3" "Nm/s" COEFFS 0 10 0 0 0 1 /end COMPU_METHOD
/begin COMPU_METHOD DtyCyc "" RAT_FUNC "%5.2" "%" COEFFS 0 100 0 0 0 1 /end COMPU_METHOD
/begin COMPU_METHOD dt_TempKelv_p_s "" RAT_FUNC "%6.3" "K/s" COEFFS 0 10 0 0 0 1 /end COMPU_METHOD
/begin COMPU_METHOD EngN "" RAT_FUNC "%5.1" "rpm" COEFFS 0 2 0 0 0 1 /end COMPU_METHOD
/begin COMPU_METHOD EngTempFldSel "" TAB_VERB "%6.3" "" COMPU_TAB_REF EngTempFldSel /end COMPU_METHOD
/begin COMPU_VTAB EngTempFldSel "" TAB_VERB 4 0 "Coolant_Temperature" 1 "Oil_Temperature" 2 "EngDa_tEng" 3 "Chamberwall_Temperature" /end COMPU_VTAB
/begin COMPU_METHOD ExeCon_State_01 "" TAB_VERB "%6.3" "" COMPU_TAB_REF ExeCon_State_01 /end COMPU_METHOD
/begin COMPU_VTAB ExeCon_State_01 "" TAB_VERB 4 0 "SYC_BOOT" 1 "SYC_PROC_INIT" 2 "SYC_PROC_EXEC" 3 "SYC_SHUTDOWN" /end COMPU_VTAB
/begin COMPU_METHOD ExeCon_State_02 "" TAB_VERB "%6.3" "" COMPU_TAB_REF ExeCon_State_02 /end COMPU_METHOD
/begin COMPU_VTAB ExeCon_State_02 "" TAB_VERB 7 0 "SYC_INI" 1 "SYC_INISYN" 2 "SYC_INIEND" 3 "SYC_PREDRIVE" 4 "SYC_DRIVE" 5 "SYC_POSTDRIVE" 6 "SYC_POST_OS_EXIT" /end COMPU_VTAB
/begin COMPU_METHOD Fact "" RAT_FUNC "%6.5" "-" COEFFS 0 8192 0 0 0 1 /end COMPU_METHOD
/begin COMPU_METHOD FacTrigoFunc "" RAT_FUNC "%6.5" "-" COEFFS 0 4096 0 0 0 1 /end COMPU_METHOD
/begin COMPU_METHOD InjMass "" RAT_FUNC "%5.2" "mg/hub" COEFFS 0 100 0 0 0 1 /end COMPU_METHOD
/begin COMPU_METHOD lambda "" RAT_FUNC "%4.3" "-" COEFFS 0 1000 0 0 0 1 /end COMPU_METHOD
/begin COMPU_METHOD lambdaRec "" RAT_FUNC "%7.6" "-" COEFFS 0 10000 0 0 0 1 /end COMPU_METHOD
/begin COMPU_METHOD nox "" RAT_FUNC "%6.2" "ppm" COEFFS 0 1 0 0 0 1 /end COMPU_METHOD
/begin COMPU_METHOD OneToOne "" RAT_FUNC "%6.0" "-" COEFFS 0 1 0 0 0 1 /end COMPU_METHOD
/begin COMPU_METHOD OneToOne_ms "" RAT_FUNC "%6.2" "ms" COEFFS 0 1 0 0 0 1 /end COMPU_METHOD
/begin COMPU_METHOD OneToOne_us "" RAT_FUNC "%6.2" "us" COEFFS 0 1 0 0 0 1 /end COMPU_METHOD
/begin COMPU_METHOD Period "" RAT_FUNC "%6.3" "ms" COEFFS 0 10 0 0 0 1 /end COMPU_METHOD
/begin COMPU_METHOD Prc "" RAT_FUNC "%6.4" "%" COEFFS 0 81.92 0 0 0 1 /end COMPU_METHOD
/begin COMPU_METHOD Pres_hPa "" RAT_FUNC "%5.1" "hPa" COEFFS 0 1 0 0 0 1 /end COMPU_METHOD
/begin COMPU_METHOD Pwr_q1 "" RAT_FUNC "%6.2" "W" COEFFS 0 1 0 0 0 1 /end COMPU_METHOD
/begin COMPU_METHOD RmpLmbd "" RAT_FUNC "%7.6" "1/s" COEFFS 0 65536 0 0 0 1 /end COMPU_METHOD
/begin COMPU_METHOD RmpTrq "" RAT_FUNC "%6.4" "Nm/s" COEFFS 0 655.36 0 0 0 1 /end COMPU_METHOD
/begin COMPU_METHOD SCRAd_Compu_Switch_3 "" TAB_VERB "%6.3" "" COMPU_TAB_REF SCRAd_Compu_Switch_3 /end COMPU_METHOD
/begin COMPU_VTAB SCRAd_Compu_Switch_3 "" TAB_VERB 2 0 "INAKTIV" 1 "AKTIV" /end COMPU_VTAB
/begin COMPU_METHOD SCRMod_Compu_Switch_1 "" TAB_VERB "%6.3" "" COMPU_TAB_REF SCRMod_Compu_Switch_1 /end COMPU_METHOD
/begin COMPU_VTAB SCRMod_Compu_Switch_1 "" TAB_VERB 2 0 "simple model" 1 "efficiency calculation" /end COMPU_VTAB
/begin COMPU_METHOD SCRMod_Compu_Switch_2 "" TAB_VERB "%6.3" "" COMPU_TAB_REF SCRMod_Compu_Switch_2 /end COMPU_METHOD
/begin COMPU_VTAB SCRMod_Compu_Switch_2 "" TAB_VERB 2 0 "disabled" 1 "enabled" /end COMPU_VTAB
/begin COMPU_METHOD SCRMon_UHC_St "" TAB_VERB "%6.3" "" COMPU_TAB_REF SCRMon_UHC_St /end COMPU_METHOD
/begin COMPU_VTAB SCRMon_UHC_St "" TAB_VERB 4 0 "HEATER_LOCKED" 1 "NONE_POWER" 2 "REDUCED_POWER" 3 "FULL_POWER" /end COMPU_VTAB
/begin COMPU_METHOD SCRPOD_st_CNV "" TAB_VERB "%6.3" "" COMPU_TAB_REF SCRPOD_st_CNV /end COMPU_METHOD
/begin COMPU_VTAB SCRPOD_st_CNV "" TAB_VERB 2 0 "DIAG_INACTIVE" 1 "DIAG_ACTIVE" DEFAULT_VALUE "DIAG_INACTIVE" /end COMPU_VTAB
/begin COMPU_METHOD SCR_Area_m057m "" RAT_FUNC "%6.5" "m*m" COEFFS 0 1000 0 0 0 1 /end COMPU_METHOD
/begin COMPU_METHOD SCR_cp_J_057kgK "" RAT_FUNC "%6.3" "J/kgK" COEFFS 0 5 0 0 0 1 /end COMPU_METHOD
/begin COMPU_METHOD SCR_DisFlow_kg_p_h "" RAT_FUNC "%6.5" "Kg/h" COEFFS 0 1000 0 0 0 1 /end COMPU_METHOD
/begin COMPU_METHOD SCR_ENG_EPM_Flags "" TAB_VERB "%6.3" "" COMPU_TAB_REF SCR_ENG_EPM_Flags /end COMPU_METHOD
/begin COMPU_VTAB SCR_ENG_EPM_Flags "" TAB_VERB 2 1 "ON" 0 "OFF" /end COMPU_VTAB
/begin COMPU_METHOD SCR_Fact10 "" RAT_FUNC "%6.3" "" COEFFS 0 10 0 0 0 1 /end COMPU_METHOD
/begin COMPU_METHOD SCR_Fact100 "" RAT_FUNC "%6.4" "" COEFFS 0 100 0 0 0 1 /end COMPU_METHOD
/begin COMPU_METHOD SCR_Fact1000 "" RAT_FUNC "%6.5" "" COEFFS 0 1000 0 0 0 1 /end COMPU_METHOD
/begin COMPU_METHOD SCR_Fact10000 "" RAT_FUNC "%7.6" "" COEFFS 0 10000 0 0 0 1 /end COMPU_METHOD
/begin COMPU_METHOD SCR_htc_W_057057mK "" RAT_FUNC "%6.3" "W/(m*m*K)" COEFFS 0 10 0 0 0 1 /end COMPU_METHOD
/begin COMPU_METHOD SCR_Length1000_mm "" RAT_FUNC "%6.5" "mm" COEFFS 0 1000 0 0 0 1 /end COMPU_METHOD
/begin COMPU_METHOD SCR_Length_mm "" RAT_FUNC "%6.2" "mm" COEFFS 0 1 0 0 0 1 /end COMPU_METHOD
/begin COMPU_METHOD SCR_Mass1000 "" RAT_FUNC "%6.5" "g" COEFFS 0 1000 0 0 0 1 /end COMPU_METHOD
/begin COMPU_METHOD SCR_Mass_057kg "" RAT_FUNC "%6.5" "m*m" COEFFS 0 1000 0 0 0 1 /end COMPU_METHOD
/begin COMPU_METHOD SCR_Rho_g_p_ml "" RAT_FUNC "%6.4" "g_ml" COEFFS 0 100 0 0 0 1 /end COMPU_METHOD
/begin COMPU_METHOD SCR_Stm_Flags "" TAB_VERB "%6.3" "" COMPU_TAB_REF SCR_Stm_Flags /end COMPU_METHOD
/begin COMPU_VTAB SCR_Stm_Flags "" TAB_VERB 12 0 "NOTENTERED" 1 "ENTRY" 2 "RUNNING" 3 "EXIT_OK" 4 "EXIT_FCT_ERROR" 5 "EXIT_T15OFF" 6 "EXIT_T15ON" 7 "EXIT_DSM_ERROR" 8 "EXIT_FCT_LOOP" 9 "HEALED" 10 "ENF_SHUTOFF_WITH_EMPTYING" 11 "ENF_SHUTOFF" /end COMPU_VTAB
/begin COMPU_METHOD SCR_Time10 "" RAT_FUNC "%6.3" "s" COEFFS 0 10 0 0 0 1 /end COMPU_METHOD
/begin COMPU_METHOD SCR_Time100 "" RAT_FUNC "%6.4" "s" COEFFS 0 100 0 0 0 1 /end COMPU_METHOD
/begin COMPU_METHOD Signals_IntSigNumVerb "" TAB_VERB "%6.3" "" COMPU_TAB_REF Signals_IntSigNumVerb /end COMPU_METHOD
/begin COMPU_VTAB Signals_IntSigNumVerb "" TAB_VERB 703 0 "SIGNALS_Signals_Default" 1 "SIGNALS_ACCtl_stOut_1B" 2 "SIGNALS_AFS_dmSensCorr_mp_2B" 3 "SIGNALS_AFS_dm_2B" 4 "SIGNALS_AFS_facIdlAdjVal_mp_2B" 5 "SIGNALS_AFS_facLdAdjVal_mp_2B" 6 "SIGNALS_AFS_mAirPerCyl_1B" 7 "SIGNALS_AFS_mAirPerCyl_2B" 8 "SIGNALS_AFS_rNorm_mp_2B" 9 "SIGNALS_AFS_stRstLoDrftThres_mp_1B" 10 "SIGNALS_AFS_tiCor_mp_2B" 11 "SIGNALS_AFS_tiRaw_2B" 12 "SIGNALS_APP_rFlt_mp_1B" 13 "SIGNALS_APP_rFlt_mp_2B" 14 "SIGNALS_APP_r_2B" 15 "SIGNALS_APP_stSigSrc_1B" 16 "SIGNALS_APP_uRaw1_2B" 17 "SIGNALS_APP_uRaw2_2B" 18 "SIGNALS_ASDdc_stSelSt_mp_2B" 19 "SIGNALS_ASDdc_trq_2B" 20 "SIGNALS_ASDrf_stSelSt_mp_2B" 21 "SIGNALS_ASMod_dmIndAirRef_2B" 22 "SIGNALS_ASMod_dvolPFltEG_1B" 23 "SIGNALS_ASMod_dvolPFltEG_2B" 24 "SIGNALS_ASMod_mAirPerCylCor_2B" 25 "SIGNALS_ASMod_pPFltSimDs_1B" 26 "SIGNALS_ASMod_pPFltSimDs_2B" 27 "SIGNALS_Absch_korr_2B" 28 "SIGNALS_AccPed_trqDes_4B" 29 "SIGNALS_ActMod_trqClth_2B" 30 "SIGNALS_ActMod_trqInr_2B" 31 "SIGNALS_ActMod_trq_2B" 32 "SIGNALS_AirCtl_mDesBas_2B" 33 "SIGNALS_AirCtl_mDesVal_1B" 34 "SIGNALS_AirCtl_mDesVal_2B" 35 "SIGNALS_AirCtl_mGovDvt_2B" 36 "SIGNALS_AirCtl_rCtlVal_2B" 37 "SIGNALS_AirCtl_rGovDvtNrm_2B" 38 "SIGNALS_AirCtl_rPIDCtl_mp_2B" 39 "SIGNALS_AirCtl_stAirCtlBits_4B" 40 "SIGNALS_AirCtl_stMon_1B" 41 "SIGNALS_AirSys_dRED1_mp_2B" 42 "SIGNALS_AirSys_dRED2_mp_2B" 43 "SIGNALS_AirSys_mLBer1_mp_4B" 44 "SIGNALS_AirSys_mLBer2_mp_4B" 45 "SIGNALS_AirSys_mLHFM1_mp_4B" 46 "SIGNALS_AirSys_mLHFM2_mp_4B" 47 "SIGNALS_AirSys_mLM10_mp_4B" 48 "SIGNALS_AirSys_mLM11_mp_4B" 49 "SIGNALS_AirSys_mLM12_mp_4B" 50 "SIGNALS_AirSys_mLM13_mp_4B" 51 "SIGNALS_AirSys_mLM20_mp_4B" 52 "SIGNALS_AirSys_mLM21_mp_4B" 53 "SIGNALS_AirSys_mLM22_mp_4B" 54 "SIGNALS_AirSys_p21max1_mp_2B" 55 "SIGNALS_AirSys_p21max2_mp_2B" 56 "SIGNALS_AirSys_rDIFF1_mp_2B" 57 "SIGNALS_AirSys_rDIFF2_mp_2B" 58 "SIGNALS_AirSys_rLverh1_mp_2B" 59 "SIGNALS_AirSys_rLverh2_mp_2B" 60 "SIGNALS_AirSys_rRED11_mp_2B" 61 "SIGNALS_AirSys_rRED12_mp_2B" 62 "SIGNALS_AirSys_rRED13_mp_2B" 63 "SIGNALS_AirSys_rRED21_mp_2B" 64 "SIGNALS_AirSys_rRED22_mp_2B" 65 "SIGNALS_AirSys_ststateSysTst_mp_1B" 66 "SIGNALS_AirSys_stsubstateSysTst_mp_1B" 67 "SIGNALS_Air_pIntkVUs_1B" 68 "SIGNALS_Air_pIntkVUs_2B" 69 "SIGNALS_Air_rRawTAFS_2B" 70 "SIGNALS_Air_tAFS_2B" 71 "SIGNALS_Air_tCACDs_2B" 72 "SIGNALS_Air_tSensTAFS_1B" 73 "SIGNALS_Air_tSensTAFS_2B" 74 "SIGNALS_Air_uRawPIntkVUs_2B" 75 "SIGNALS_Air_uRawTCACDs_2B" 76 "SIGNALS_AltIO_rAltLoad_2B" 77 "SIGNALS_BattU_uSens_1B" 78 "SIGNALS_BattU_uSens_2B" 79 "SIGNALS_BattU_u_2B" 80 "SIGNALS_BrkP_pSens_2B" 81 "SIGNALS_BrkP_p_2B" 82 "SIGNALS_BrkP_uRaw_2B" 83 "SIGNALS_Brk_st_1B" 84 "SIGNALS_Bszsi_4B" 85 "SIGNALS_CByVlv_st_1B" 86 "SIGNALS_CEngDsT_t_2B" 87 "SIGNALS_CEngDsT_uRaw_2B" 88 "SIGNALS_Clth_st_1B" 89 "SIGNALS_CoEOM_stOpModeAct_4B" 90 "SIGNALS_CoETS_rTrq_2B" 91 "SIGNALS_CoETS_stCurrLimActive_2B" 92 "SIGNALS_CoETS_trqInrLim_2B" 93 "SIGNALS_CoETS_trqInrSetSlow_2B" 94 "SIGNALS_CoEng_stIRevShutOff_4B" 95 "SIGNALS_CoEng_stRevShutOff_4B" 96 "SIGNALS_CoEng_stShutOffPath_4B" 97 "SIGNALS_CoEng_stState_mp_1B" 98 "SIGNALS_CoEng_stTst_1B" 99 "SIGNALS_CoEng_st_1B" 100 "SIGNALS_CoPT_trqDes_2B" 101 "SIGNALS_Com_lSum_4B" 102 "SIGNALS_Com_lSum_8km_2B" 103 "SIGNALS_Com_nPsp_2B" 104 "SIGNALS_Com_rPspSetPoint_2B" 105 "SIGNALS_Com_stCrCtlLvr_1B" 106 "SIGNALS_Com_stLmpPrkBrk_1B" 107 "SIGNALS_Conv_nTrbn_2B" 108 "SIGNALS_CrCUI_stBtn_2B" 109 "SIGNALS_CrC_stKey_2B" 110 "SIGNALS_CrCtl_aReq_2B" 111 "SIGNALS_CrCtl_stShOffConRvActv_mp_4B" 112 "SIGNALS_CrCtl_stShOff_1B" 113 "SIGNALS_CrCtl_st_1B" 114 "SIGNALS_CrCtl_vDes_2B" 115 "SIGNALS_DFC_ctLDF_mp_2B" 116 "SIGNALS_DFES_ctDef_1B" 117 "SIGNALS_DFES_ctEntry_1B" 118 "SIGNALS_DFES_ctOBDPend_1B" 119 "SIGNALS_DFES_ctOBD_1B" 120 "SIGNALS_DSMAUX_ctWUC_1B" 121 "SIGNALS_DSMRdy_Why_CyclCmplComprCmpnt_mp_2B" 122 "SIGNALS_DSMRdy_Why_CyclCmplEGR_mp_2B" 123 "SIGNALS_DSMRdy_Why_CyclCmplFlSys_mp_2B" 124 "SIGNALS_DSMRdy_Why_RdyComprCmpnt_mp_2B" 125 "SIGNALS_DSMRdy_Why_RdyEGR_mp_2B" 126 "SIGNALS_DSMRdy_Why_RdyFlSys_mp_2B" 127 "SIGNALS_DSM_DisblMode_mp_2B" 128 "SIGNALS_DSM_stPostDrive_1B" 129 "SIGNALS_DSM_stRdyAB_1B" 130 "SIGNALS_DSM_stRdyCD_1B" 131 "SIGNALS_D_soc_2B" 132 "SIGNALS_Dffgen_1B" 133 "SIGNALS_Dfh_lerncnt_2B" 134 "SIGNALS_Dfh_lernpw_2B" 135 "SIGNALS_Dfh_pekpf_1B" 136 "SIGNALS_Dfh_pekpf_2B" 137 "SIGNALS_Dspl_volFlTnkQnt_2B" 138 "SIGNALS_ECBVlv_rAct_2B" 139 "SIGNALS_ECBVlv_rPs_2B" 140 "SIGNALS_EGRVlv_rAct_2B" 141 "SIGNALS_EGRVlv_rPs_1B" 142 "SIGNALS_EGRVlv_rPs_2B" 143 "SIGNALS_EGRVlv_r_2B" 144 "SIGNALS_EMDmp_rPs_0_2B" 145 "SIGNALS_ETClb_ctLrn_mp_0_2B" 146 "SIGNALS_ETClb_ctLrn_mp_1_2B" 147 "SIGNALS_ETClb_ctLrn_mp_2_2B" 148 "SIGNALS_ETClb_dtiETFlt0_mp_0_2B" 149 "SIGNALS_ETClb_dtiETFlt0_mp_1_2B" 150 "SIGNALS_ETClb_dtiETFlt0_mp_2_2B" 151 "SIGNALS_ETClb_dtiETFlt0_mp_3_2B" 152 "SIGNALS_ETClb_dtiETFlt0_mp_4_2B" 153 "SIGNALS_ETClb_dtiETFlt0_mp_5_2B" 154 "SIGNALS_ETClb_dtiETFlt1_mp_0_2B" 155 "SIGNALS_ETClb_dtiETFlt1_mp_1_2B" 156 "SIGNALS_ETClb_dtiETFlt1_mp_2_2B" 157 "SIGNALS_ETClb_dtiETFlt1_mp_3_2B" 158 "SIGNALS_ETClb_dtiETFlt1_mp_4_2B" 159 "SIGNALS_ETClb_dtiETFlt1_mp_5_2B" 160 "SIGNALS_ETClb_dtiETFlt2_mp_0_2B" 161 "SIGNALS_ETClb_dtiETFlt2_mp_1_2B" 162 "SIGNALS_ETClb_dtiETFlt2_mp_2_2B" 163 "SIGNALS_ETClb_dtiETFlt2_mp_3_2B" 164 "SIGNALS_ETClb_dtiETFlt2_mp_4_2B" 165 "SIGNALS_ETClb_dtiETFlt2_mp_5_2B" 166 "SIGNALS_ETClb_pRailSet_0_2B" 167 "SIGNALS_ETClb_pRailSet_1_2B" 168 "SIGNALS_ETClb_pRailSet_2_2B" 169 "SIGNALS_ETClb_stCor_1B" 170 "SIGNALS_ETClb_stRlsCylCor_mp_1B" 171 "SIGNALS_ETClb_tiETAvrg_0_2B" 172 "SIGNALS_ETClb_tiETAvrg_1_2B" 173 "SIGNALS_ETClb_tiETAvrg_2_2B" 174 "SIGNALS_ETClb_tiETMax_0_2B" 175 "SIGNALS_ETClb_tiETMax_1_2B" 176 "SIGNALS_ETClb_tiETMax_2_2B" 177 "SIGNALS_ETClb_tiETMin_0_2B" 178 "SIGNALS_ETClb_tiETMin_1_2B" 179 "SIGNALS_ETClb_tiETMin_2_2B" 180 "SIGNALS_EngDa_tEng_2B" 181 "SIGNALS_EngDa_tFld_0_2B" 182 "SIGNALS_EngDa_tFld_1_2B" 183 "SIGNALS_EngDa_tFld_2_2B" 184 "SIGNALS_EngDa_tFld_3_2B" 185 "SIGNALS_EngDa_tiEngOn_4B" 186 "SIGNALS_EngDem_trqLimErr_2B" 187 "SIGNALS_EngPrt_trqLim_2B" 188 "SIGNALS_EngReq_trqLim_2B" 189 "SIGNALS_EngTrqPtd_stLimDeb_mp_1B" 190 "SIGNALS_EngTrqPtd_stLimUnDeb_mp_1B" 191 "SIGNALS_EngTrqPtd_stPthLim_1B" 192 "SIGNALS_EngTrqPtd_trqASD_2B" 193 "SIGNALS_EngTrqPtd_trqLim_2B" 194 "SIGNALS_EngTrqPtd_trqSpdG_2B" 195 "SIGNALS_EnvP_p_1B" 196 "SIGNALS_EnvP_p_2B" 197 "SIGNALS_EnvP_uRaw_2B" 198 "SIGNALS_EnvT_t_1B" 199 "SIGNALS_EnvT_t_2B" 200 "SIGNALS_EpmCaS_phiOfsCorr_2B" 201 "SIGNALS_EpmHCrS_stSigMode_1B" 202 "SIGNALS_Epm_nEng_2B" 203 "SIGNALS_Epm_stOpMode_1B" 204 "SIGNALS_Epm_stSpd_1B" 205 "SIGNALS_Epm_stSync_1B" 206 "SIGNALS_ErrLmp_stMILReq_1B" 207 "SIGNALS_ErrLmp_stSVSReq_1B" 208 "SIGNALS_Exh_pAdapPPFltDiff_1B" 209 "SIGNALS_Exh_pAdapPPFltDiff_2B" 210 "SIGNALS_Exh_pAdapPPFltUs_1B" 211 "SIGNALS_Exh_pAdapPPFltUs_2B" 212 "SIGNALS_Exh_pDiffOfsValAct_mp_1B" 213 "SIGNALS_Exh_pDiffOfsValAct_mp_2B" 214 "SIGNALS_Exh_pFltPPFltDiff_1B" 215 "SIGNALS_Exh_pFltPPFltDiff_2B" 216 "SIGNALS_Exh_pFltPPFltUs_1B" 217 "SIGNALS_Exh_pFltPPFltUs_2B" 218 "SIGNALS_Exh_pPFltUs_1B" 219 "SIGNALS_Exh_pPFltUs_2B" 220 "SIGNALS_Exh_pRawAdapPPFltDiff_1B" 221 "SIGNALS_Exh_pRawAdapPPFltDiff_2B" 222 "SIGNALS_Exh_tOxiCatUs_1B" 223 "SIGNALS_Exh_tOxiCatUs_2B" 224 "SIGNALS_Exh_tPFltUs_1B" 225 "SIGNALS_Exh_tPFltUs_2B" 226 "SIGNALS_Exh_tSensTOxiCatUs_1B" 227 "SIGNALS_Exh_tSensTOxiCatUs_2B" 228 "SIGNALS_Exh_tSensTPFltUs_1B" 229 "SIGNALS_Exh_tSensTPFltUs_2B" 230 "SIGNALS_Exh_uRawPPFltUs_2B" 231 "SIGNALS_Exh_uRawTOxiCatUs_2B" 232 "SIGNALS_Exh_uRawTPFltUs_2B" 233 "SIGNALS_FBC_qDvtCylPhys_01_0_2B" 234 "SIGNALS_FBC_qDvtCylPhys_01_1_2B" 235 "SIGNALS_FBC_qDvtCylPhys_01_2_2B" 236 "SIGNALS_FBC_qDvtCylPhys_01_3_2B" 237 "SIGNALS_FBC_qDvtCylPhys_01_4_2B" 238 "SIGNALS_FBC_qDvtCylPhys_01_5_2B" 239 "SIGNALS_FBC_qDvtCyl_0_2B" 240 "SIGNALS_FBC_qDvtCyl_1_2B" 241 "SIGNALS_FBC_qDvtCyl_2_2B" 242 "SIGNALS_FBC_qDvtCyl_3_2B" 243 "SIGNALS_FBC_qDvtCyl_4_2B" 244 "SIGNALS_FBC_qDvtCyl_5_2B" 245 "SIGNALS_FMA_qMapRow0_mp_0_2B" 246 "SIGNALS_FMA_qMapRow0_mp_1_2B" 247 "SIGNALS_FMA_qMapRow0_mp_2_2B" 248 "SIGNALS_FMA_qMapRow0_mp_3_2B" 249 "SIGNALS_FMA_qMapRow0_mp_4_2B" 250 "SIGNALS_FMA_qMapRow0_mp_5_2B" 251 "SIGNALS_FMA_qMapRow0_mp_6_2B" 252 "SIGNALS_FMA_qMapRow0_mp_7_2B" 253 "SIGNALS_FMA_qMapRow1_mp_0_2B" 254 "SIGNALS_FMA_qMapRow1_mp_1_2B" 255 "SIGNALS_FMA_qMapRow1_mp_2_2B" 256 "SIGNALS_FMA_qMapRow1_mp_3_2B" 257 "SIGNALS_FMA_qMapRow1_mp_4_2B" 258 "SIGNALS_FMA_qMapRow1_mp_5_2B" 259 "SIGNALS_FMA_qMapRow1_mp_6_2B" 260 "SIGNALS_FMA_qMapRow1_mp_7_2B" 261 "SIGNALS_FMA_qMapRow2_mp_0_2B" 262 "SIGNALS_FMA_qMapRow2_mp_1_2B" 263 "SIGNALS_FMA_qMapRow2_mp_2_2B" 264 "SIGNALS_FMA_qMapRow2_mp_3_2B" 265 "SIGNALS_FMA_qMapRow2_mp_4_2B" 266 "SIGNALS_FMA_qMapRow2_mp_5_2B" 267 "SIGNALS_FMA_qMapRow2_mp_6_2B" 268 "SIGNALS_FMA_qMapRow2_mp_7_2B" 269 "SIGNALS_FMA_qMapRow3_mp_0_2B" 270 "SIGNALS_FMA_qMapRow3_mp_1_2B" 271 "SIGNALS_FMA_qMapRow3_mp_2_2B" 272 "SIGNALS_FMA_qMapRow3_mp_3_2B" 273 "SIGNALS_FMA_qMapRow3_mp_4_2B" 274 "SIGNALS_FMA_qMapRow3_mp_5_2B" 275 "SIGNALS_FMA_qMapRow3_mp_6_2B" 276 "SIGNALS_FMA_qMapRow3_mp_7_2B" 277 "SIGNALS_FMA_qMapRow4_mp_0_2B" 278 "SIGNALS_FMA_qMapRow4_mp_1_2B" 279 "SIGNALS_FMA_qMapRow4_mp_2_2B" 280 "SIGNALS_FMA_qMapRow4_mp_3_2B" 281 "SIGNALS_FMA_qMapRow4_mp_4_2B" 282 "SIGNALS_FMA_qMapRow4_mp_5_2B" 283 "SIGNALS_FMA_qMapRow4_mp_6_2B" 284 "SIGNALS_FMA_qMapRow4_mp_7_2B" 285 "SIGNALS_FMA_qMapRow5_mp_0_2B" 286 "SIGNALS_FMA_qMapRow5_mp_1_2B" 287 "SIGNALS_FMA_qMapRow5_mp_2_2B" 288 "SIGNALS_FMA_qMapRow5_mp_3_2B" 289 "SIGNALS_FMA_qMapRow5_mp_4_2B" 290 "SIGNALS_FMA_qMapRow5_mp_5_2B" 291 "SIGNALS_FMA_qMapRow5_mp_6_2B" 292 "SIGNALS_FMA_qMapRow5_mp_7_2B" 293 "SIGNALS_FMA_qMapRow6_mp_0_2B" 294 "SIGNALS_FMA_qMapRow6_mp_1_2B" 295 "SIGNALS_FMA_qMapRow6_mp_2_2B" 296 "SIGNALS_FMA_qMapRow6_mp_3_2B" 297 "SIGNALS_FMA_qMapRow6_mp_4_2B" 298 "SIGNALS_FMA_qMapRow6_mp_5_2B" 299 "SIGNALS_FMA_qMapRow6_mp_6_2B" 300 "SIGNALS_FMA_qMapRow6_mp_7_2B" 301 "SIGNALS_FMA_qMapRow7_mp_0_2B" 302 "SIGNALS_FMA_qMapRow7_mp_1_2B" 303 "SIGNALS_FMA_qMapRow7_mp_2_2B" 304 "SIGNALS_FMA_qMapRow7_mp_3_2B" 305 "SIGNALS_FMA_qMapRow7_mp_4_2B" 306 "SIGNALS_FMA_qMapRow7_mp_5_2B" 307 "SIGNALS_FMA_qMapRow7_mp_6_2B" 308 "SIGNALS_FMA_qMapRow7_mp_7_2B" 309 "SIGNALS_FMA_q_mp_2B" 310 "SIGNALS_FMA_stSwtOff_1B" 311 "SIGNALS_FMA_tiFuncOp_4B" 312 "SIGNALS_Fan_rPs_1B" 313 "SIGNALS_Fan_rPs_2B" 314 "SIGNALS_FlFltDsP_pSens_1B" 315 "SIGNALS_FlFltDsP_pSens_2B" 316 "SIGNALS_FlFltDsP_p_1B" 317 "SIGNALS_FlFltDsP_p_2B" 318 "SIGNALS_FlFltDsP_uRaw_1B" 319 "SIGNALS_FlFltDsP_uRaw_2B" 320 "SIGNALS_FlFltHt_stPs_1B" 321 "SIGNALS_FlFlt_stRaw_1B" 322 "SIGNALS_FuelLvl_vol_1B" 323 "SIGNALS_FuelLvl_vol_2B" 324 "SIGNALS_FuelT_t_1B" 325 "SIGNALS_FuelT_t_2B" 326 "SIGNALS_FuelT_uRaw_2B" 327 "SIGNALS_Gangi_1B" 328 "SIGNALS_Gbx_ctGbxNPosUnPls_1B" 329 "SIGNALS_Gbx_numGear_1B" 330 "SIGNALS_GlwCtl_stGlw_2B" 331 "SIGNALS_GlwEcu_lSum_mp_2B" 332 "SIGNALS_GlwEcu_pwrGlow_1B" 333 "SIGNALS_GlwEcu_pwrGlow_2B" 334 "SIGNALS_GlwEcu_stGPCMConfig_mp_1B" 335 "SIGNALS_GlwEcu_stGPCMDiag_1B" 336 "SIGNALS_GlwEcu_stGPType_mp_1B" 337 "SIGNALS_GlwEcu_stHSSOpen_1B" 338 "SIGNALS_GlwEcu_stHSSShort_1B" 339 "SIGNALS_GlwEcu_stHighresCold_1B" 340 "SIGNALS_GlwEcu_stHighresHot_1B" 341 "SIGNALS_GlwEcu_stLowresCold_1B" 342 "SIGNALS_GlwEcu_stLowresHot_1B" 343 "SIGNALS_GlwEcu_tGlwPlg_mp_1B" 344 "SIGNALS_GlwEcu_tGlwPlg_mp_2B" 345 "SIGNALS_GlwLmp_st_1B" 346 "SIGNALS_ISC_nSetPLo_0_2B" 347 "SIGNALS_ISC_nSetPLo_1_2B" 348 "SIGNALS_ISC_nSetPLo_2_2B" 349 "SIGNALS_ISC_nSetPLo_3_2B" 350 "SIGNALS_ISC_nSetPLo_4_2B" 351 "SIGNALS_ISC_nSetPLo_5_2B" 352 "SIGNALS_ISC_st_0_4B" 353 "SIGNALS_ISC_st_1_4B" 354 "SIGNALS_ISC_st_2_4B" 355 "SIGNALS_ISC_st_3_4B" 356 "SIGNALS_ISC_st_4_4B" 357 "SIGNALS_ISC_st_5_4B" 358 "SIGNALS_ISC_trq_2B" 359 "SIGNALS_IVActr_uCh_mp_2B" 360 "SIGNALS_IVActr_uUp_2B" 361 "SIGNALS_IVCtl_tiChrg_2B" 362 "SIGNALS_IVCtl_uUp_2B" 363 "SIGNALS_IVPlaus_nCyl_0_2B" 364 "SIGNALS_IVPlaus_nCyl_1_2B" 365 "SIGNALS_IVPlaus_nCyl_2_2B" 366 "SIGNALS_IVPlaus_nCyl_3_2B" 367 "SIGNALS_IVPlaus_nCyl_4_2B" 368 "SIGNALS_IVPlaus_nCyl_5_2B" 369 "SIGNALS_IVPlaus_nHiDwnRunUpTst_2B" 370 "SIGNALS_IVPlaus_nHiUpRunUpTst_2B" 371 "SIGNALS_IVPlaus_nLoDwnRunUpTst_2B" 372 "SIGNALS_IVPlaus_nLoUpRunUpTst_2B" 373 "SIGNALS_IVPlaus_qFBCCyl_0_2B" 374 "SIGNALS_IVPlaus_qFBCCyl_1_2B" 375 "SIGNALS_IVPlaus_qFBCCyl_2_2B" 376 "SIGNALS_IVPlaus_qFBCCyl_3_2B" 377 "SIGNALS_IVPlaus_qFBCCyl_4_2B" 378 "SIGNALS_IVPlaus_qFBCCyl_5_2B" 379 "SIGNALS_IVPlaus_stRefRunUpTst_2B" 380 "SIGNALS_IVPlaus_tiDwnRunUpTst_4B" 381 "SIGNALS_IVPlaus_tiUpRunUpTst_4B" 382 "SIGNALS_I_batt_2B" 383 "SIGNALS_I_gen_1B" 384 "SIGNALS_InjCrv_phiMI1Des_2B" 385 "SIGNALS_InjCrv_phiPiI1Des_2B" 386 "SIGNALS_InjCrv_phiPiI2Des_2B" 387 "SIGNALS_InjCrv_phiPoI1Des_2B" 388 "SIGNALS_InjCrv_phiPoI2Des_2B" 389 "SIGNALS_InjCrv_qPiI1Des_mp_2B" 390 "SIGNALS_InjCrv_qPiI2Des_mp_2B" 391 "SIGNALS_InjCrv_tiPiI1Des_2B" 392 "SIGNALS_InjCtl_qCurr_2B" 393 "SIGNALS_InjCtl_qRaw_2B" 394 "SIGNALS_InjCtl_qSetUnBal_1B" 395 "SIGNALS_InjCtl_qSetUnBal_2B" 396 "SIGNALS_InjUn_stStrt_1B" 397 "SIGNALS_InjVlv_tiMI1ET_mp_2B" 398 "SIGNALS_InjVlv_tiPiI1ET_mp_2B" 399 "SIGNALS_InjVlv_tiPiI2ET_mp_2B" 400 "SIGNALS_InjVlv_tiPoI1ET_mp_2B" 401 "SIGNALS_InjVlv_tiPoI2ET_mp_2B" 402 "SIGNALS_InjVlv_volMI1_mp_2B" 403 "SIGNALS_InjVlv_volPiI1_mp_2B" 404 "SIGNALS_LSU_rLam_1B" 405 "SIGNALS_LSU_rLam_2B" 406 "SIGNALS_LSU_rO2Adap_0_1B" 407 "SIGNALS_LSU_rO2Adap_0_2B" 408 "SIGNALS_LSU_rO2Raw_2B" 409 "SIGNALS_LSU_stAdap_1B" 410 "SIGNALS_LSU_stO2IntValid_1B" 411 "SIGNALS_Layer_stLPCOff_1B" 412 "SIGNALS_Md_gennm_2B" 413 "SIGNALS_MeUn_dvolSet_2B" 414 "SIGNALS_MeUn_iActFlt_mp_1B" 415 "SIGNALS_MeUn_iActFlt_mp_2B" 416 "SIGNALS_MeUn_iSet_1B" 417 "SIGNALS_MeUn_iSet_2B" 418 "SIGNALS_MeUn_rPs_mp_1B" 419 "SIGNALS_MeUn_rPs_mp_2B" 420 "SIGNALS_MeUn_stActrCtl_mp_1B" 421 "SIGNALS_MeUn_uRaw_mp_2B" 422 "SIGNALS_MoCADC_ctDebTst_1B" 423 "SIGNALS_MoCADC_facVltgRatio_2B" 424 "SIGNALS_MoCADC_st_1B" 425 "SIGNALS_MoCCom_Query_4B" 426 "SIGNALS_MoCCom_Response_4B" 427 "SIGNALS_MoCCom_ctErrFC_1B" 428 "SIGNALS_MoCCom_ctErrMM_1B" 429 "SIGNALS_MoCCom_ctErrSPI_1B" 430 "SIGNALS_MoCCom_ctSOPTstActv_1B" 431 "SIGNALS_MoCCom_st_1B" 432 "SIGNALS_MoCMem_st_1B" 433 "SIGNALS_MoCRom_numRomPageErr_1B" 434 "SIGNALS_MoCRom_ptrTabIndexAct_1B" 435 "SIGNALS_MoCSOP_stAct_1B" 436 "SIGNALS_MoCSOP_stActvMsg_1B" 437 "SIGNALS_MoCSOP_stErr_1B" 438 "SIGNALS_MoCSOP_stLdRespTab_1B" 439 "SIGNALS_MoCSOP_stRdyMsg_1B" 440 "SIGNALS_MoCSOP_stRdy_1B" 441 "SIGNALS_MoCSOP_st_1B" 442 "SIGNALS_MoFAPP_stTst_1B" 443 "SIGNALS_MoFAPP_u_1B" 444 "SIGNALS_MoFBrk_st_1B" 445 "SIGNALS_MoFCoEng_rTrqPtd_1B" 446 "SIGNALS_MoFCoOfs_rTrqPtdMsg_1B" 447 "SIGNALS_MoFCoOfs_rTrqPtdOfs_1B" 448 "SIGNALS_MoFCoVeh_trqVehPtd_2B" 449 "SIGNALS_MoFDrAs_trqPtd_2B" 450 "SIGNALS_MoFDrDem_rAPP_1B" 451 "SIGNALS_MoFDrDem_trqPtd_2B" 452 "SIGNALS_MoFESpd_nEng_1B" 453 "SIGNALS_MoFESpd_phiGT1Last_4B" 454 "SIGNALS_MoFESpd_stSync_1B" 455 "SIGNALS_MoFETC_stTst_1B" 456 "SIGNALS_MoFExtInt_trqPtd_2B" 457 "SIGNALS_MoFIn_st_1B" 458 "SIGNALS_MoFInjDat_ctDebQntErr_1B" 459 "SIGNALS_MoFInjDat_facPoI1EffSet_2B" 460 "SIGNALS_MoFInjDat_facPoI2EffSet_2B" 461 "SIGNALS_MoFInjDat_pLinCurr_mp_1B" 462 "SIGNALS_MoFInjDat_p_1B" 463 "SIGNALS_MoFInjDat_phiMI1_2B" 464 "SIGNALS_MoFInjDat_phiPiI1_2B" 465 "SIGNALS_MoFInjDat_phiPiI2_2B" 466 "SIGNALS_MoFInjDat_phiPoI1_2B" 467 "SIGNALS_MoFInjDat_phiPoI2_2B" 468 "SIGNALS_MoFInjDat_stInjState_1B" 469 "SIGNALS_MoFInjDat_stPressSRC_1B" 470 "SIGNALS_MoFInjDat_tiMI1PoI1_2B" 471 "SIGNALS_MoFInjDat_tiMI1PoI2_2B" 472 "SIGNALS_MoFInjDat_tiPiI1ZFCETCor_2B" 473 "SIGNALS_MoFInjDat_tiPiI2ZFCETCor_2B" 474 "SIGNALS_MoFInjDat_tiPiI3ZFCETCor_2B" 475 "SIGNALS_MoFInjDat_tiTDCAvrg_2B" 476 "SIGNALS_MoFInjDat_uRaw_mp_1B" 477 "SIGNALS_MoFInjQnt_qPoI1Cor_2B" 478 "SIGNALS_MoFInjQnt_qPoI2Cor_2B" 479 "SIGNALS_MoFMode_ctDebPoI1Err_1B" 480 "SIGNALS_MoFMode_ctDebPoI2Err_1B" 481 "SIGNALS_MoFMode_qSetUnBal_2B" 482 "SIGNALS_MoFMode_stOpModeMsg_2B" 483 "SIGNALS_MoFOvR_stRls_2B" 484 "SIGNALS_MoFQntCor_qMI1_2B" 485 "SIGNALS_MoFQntCor_stInj_1B" 486 "SIGNALS_MoFQntCor_stMI1ErrAct_mp_1B" 487 "SIGNALS_MoFQntCor_stPiI1ErrAct_mp_1B" 488 "SIGNALS_MoFQntCor_stPoI1ErrAct_mp_1B" 489 "SIGNALS_MoFQntCor_stPoI2ErrAct_mp_1B" 490 "SIGNALS_MoFRailP_ctDebErr_1B" 491 "SIGNALS_MoFRailP_ctDebGradMax_1B" 492 "SIGNALS_MoFRailP_p_1B" 493 "SIGNALS_MoFTrqIdc_facEtaCor_mp_2B" 494 "SIGNALS_MoFTrqIdc_rTrq_1B" 495 "SIGNALS_OBD_PID01_DSMRdy_xPId1_4B" 496 "SIGNALS_OBD_PID04_CoETS_rTrq_1B" 497 "SIGNALS_OBD_PID05_CEngDsT_tSens_1B" 498 "SIGNALS_OBD_PID0B_Air_pSensPIntkVUs_1B" 499 "SIGNALS_OBD_PID0C_Epm_nEngRaw_2B" 500 "SIGNALS_OBD_PID0D_VehV_v_1B" 501 "SIGNALS_OBD_PID0F_Air_tSensTCACDs_1B" 502 "SIGNALS_OBD_PID10_AFS_dmSens_2B" 503 "SIGNALS_OBD_PID11_ThrVlv_rSens_1B" 504 "SIGNALS_OBD_PID1C_I15031_PID1C_1B" 505 "SIGNALS_OBD_PID1D_I15031_PID1D_1B" 506 "SIGNALS_OBD_PID1F_CoEng_tiNormal_2B" 507 "SIGNALS_OBD_PID21_DSMDur_ctGlb_0_2B" 508 "SIGNALS_OBD_PID23_RailP_pLin_2B" 509 "SIGNALS_OBD_PID24_LSU_rLam_uO2Raw_AB_2B" 510 "SIGNALS_OBD_PID24_LSU_rLam_uO2Raw_CD_2B" 511 "SIGNALS_OBD_PID2C_EGRVlv_r_1B" 512 "SIGNALS_OBD_PID2D_AirCtl_rGovDvtNrm_1B" 513 "SIGNALS_OBD_PID30_DSMAUX_ctWUC_1B" 514 "SIGNALS_OBD_PID33_EnvP_pSens_1B" 515 "SIGNALS_OBD_PID3C_Exh_tSensTPFltUs_2B" 516 "SIGNALS_OBD_PID41_DSMRdy_xPId41_4B" 517 "SIGNALS_OBD_PID42_BattU_uSens_2B" 518 "SIGNALS_OBD_PID45_ThrVlv_rAct_1B" 519 "SIGNALS_OBD_PID46_EnvT_tSens_1B" 520 "SIGNALS_OBD_PID49_APP_rUnFlt_1B" 521 "SIGNALS_OBD_PID4A_APP_uRaw2_1B" 522 "SIGNALS_OBD_PID4C_ThrVlv_r_1B" 523 "SIGNALS_OBD_PID4F_I15031_PID4FA_1B" 524 "SIGNALS_OBD_PID4F_I15031_PID4FB_1B" 525 "SIGNALS_OBD_PID4F_I15031_PID4FC_1B" 526 "SIGNALS_OBD_PID4F_I15031_PID4FD_1B" 527 "SIGNALS_OilPLmp_st_2B" 528 "SIGNALS_Oil_tSwmp_2B" 529 "SIGNALS_Oz_kvbmw_4B" 530 "SIGNALS_Oz_kvbog_2B" 531 "SIGNALS_Oz_kvbsm_4B" 532 "SIGNALS_Oz_kvbsm_ul_4B" 533 "SIGNALS_Oz_lp_1B" 534 "SIGNALS_Oz_lv_1B" 535 "SIGNALS_Oz_nivkrzt_1B" 536 "SIGNALS_Oz_nivlangt_1B" 537 "SIGNALS_Oz_oelkm_2B" 538 "SIGNALS_Oz_orikor_1B" 539 "SIGNALS_PCBS_lDistanceOut_2B" 540 "SIGNALS_PCBS_lSumDPFChng_4B" 541 "SIGNALS_PCR_pDesBasLP_mp_2B" 542 "SIGNALS_PCR_pDesBas_mp_2B" 543 "SIGNALS_PCR_pDesValLP_2B" 544 "SIGNALS_PCR_pDesVal_1B" 545 "SIGNALS_PCR_pDesVal_2B" 546 "SIGNALS_PCR_pGovDvtLP_2B" 547 "SIGNALS_PCR_pGovDvt_2B" 548 "SIGNALS_PCR_rCtlVal_2B" 549 "SIGNALS_PCR_stMonLP_1B" 550 "SIGNALS_PCR_stMon_1B" 551 "SIGNALS_PCR_stNrmOpLP_mp_1B" 552 "SIGNALS_PCR_stNrmOp_mp_1B" 553 "SIGNALS_PCR_stPCRBitsLP_4B" 554 "SIGNALS_PCR_stPCRBits_4B" 555 "SIGNALS_PCR_stWrkSphLP_mp_1B" 556 "SIGNALS_PCR_stWrkSph_mp_1B" 557 "SIGNALS_PCV_facAdapt_1B" 558 "SIGNALS_PCV_facAdapt_2B" 559 "SIGNALS_PCV_iActFlt_mp_1B" 560 "SIGNALS_PCV_iActFlt_mp_2B" 561 "SIGNALS_PCV_iSet_1B" 562 "SIGNALS_PCV_iSet_2B" 563 "SIGNALS_PCV_pSet_2B" 564 "SIGNALS_PCV_rPs_1B" 565 "SIGNALS_PCV_rPs_2B" 566 "SIGNALS_PCV_stActrCtl_1B" 567 "SIGNALS_PCV_uRaw_mp_2B" 568 "SIGNALS_PFltLd_mAshOilEG_2B" 569 "SIGNALS_PFltLd_mSotSim_2B" 570 "SIGNALS_PFltLd_mSot_2B" 571 "SIGNALS_PFltLd_resFlwFlt_1B" 572 "SIGNALS_PFltLd_resFlwFlt_2B" 573 "SIGNALS_PFltRgn_dqFlAvrg_mp_1B" 574 "SIGNALS_PFltRgn_dqFlAvrg_mp_2B" 575 "SIGNALS_PFltRgn_lSnceRgn_4B" 576 "SIGNALS_PFltRgn_lSumRgnBck0_mp_4B" 577 "SIGNALS_PFltRgn_lSumRgnBck1_mp_4B" 578 "SIGNALS_PFltRgn_lSumRgnBck2_mp_4B" 579 "SIGNALS_PFltRgn_lSumRgnBck3_mp_4B" 580 "SIGNALS_PFltRgn_lSumRgnBck4_mp_4B" 581 "SIGNALS_PFltRgn_numRgn_1B" 582 "SIGNALS_PFltRgn_qFl_mp_2B" 583 "SIGNALS_PFltRgn_stIntr_2B" 584 "SIGNALS_PFltRgn_stLck_1B" 585 "SIGNALS_PFlt_ctRgnStep1_mp_1B" 586 "SIGNALS_PFlt_ctRgnStep2_mp_1B" 587 "SIGNALS_PFlt_ctRgnStep3_mp_1B" 588 "SIGNALS_PFlt_ctRgnStep4_mp_1B" 589 "SIGNALS_PFlt_ctRgnStep5_mp_1B" 590 "SIGNALS_PFlt_ctRgnStep6_mp_1B" 591 "SIGNALS_PFlt_ctRgnStep7_mp_1B" 592 "SIGNALS_PFlt_ctRgnStep8_mp_1B" 593 "SIGNALS_PFlt_lAvrgRgn_1B" 594 "SIGNALS_PFlt_lAvrgRgn_2B" 595 "SIGNALS_PFlt_pPreCorr_mp_2B" 596 "SIGNALS_PFlt_stPresPlaus_mp_1B" 597 "SIGNALS_PSP_dvolOut_1B" 598 "SIGNALS_PSP_dvolOut_2B" 599 "SIGNALS_PT_stTraType_1B" 600 "SIGNALS_Pbremsu_2B" 601 "SIGNALS_Pr_bn_soll_1B" 602 "SIGNALS_Ptc_pwr_1B" 603 "SIGNALS_PthSet_stActvMonLim_1B" 604 "SIGNALS_PthSet_trqInrSetNoMo_2B" 605 "SIGNALS_PthSet_trqInrSet_2B" 606 "SIGNALS_QWC_tiPiI1MI1_mp_2B" 607 "SIGNALS_RailP_pCurr_mp_2B" 608 "SIGNALS_RailP_pFlt_1B" 609 "SIGNALS_RailP_pFlt_2B" 610 "SIGNALS_RailP_pLin_2B" 611 "SIGNALS_RailP_stGrad_1B" 612 "SIGNALS_RailP_uRaw_2B" 613 "SIGNALS_Rail_dvolPreCtl_2B" 614 "SIGNALS_Rail_pDvt_2B" 615 "SIGNALS_Rail_pSetPoint_1B" 616 "SIGNALS_Rail_pSetPoint_2B" 617 "SIGNALS_Rail_stCPC_1B" 618 "SIGNALS_Rail_stCtlLoop_1B" 619 "SIGNALS_Rail_stDwn1HpTst_4B" 620 "SIGNALS_Rail_stDwn2HpTst_4B" 621 "SIGNALS_Rail_stDwn3HpTst_4B" 622 "SIGNALS_Rail_stDwnHpTst_0_1B" 623 "SIGNALS_Rail_stDwnHpTst_1_1B" 624 "SIGNALS_Rail_stDwnHpTst_2_1B" 625 "SIGNALS_Rail_stDwnHpTst_3_1B" 626 "SIGNALS_Rail_stDwnHpTst_4_1B" 627 "SIGNALS_Rail_stRefHpTst_2B" 628 "SIGNALS_Rail_stStMHpTst_1B" 629 "SIGNALS_Rail_stUpHpTst_0_1B" 630 "SIGNALS_Rail_stUpHpTst_1_1B" 631 "SIGNALS_Rail_stUpHpTst_2_1B" 632 "SIGNALS_Rail_stUpHpTst_3_1B" 633 "SIGNALS_Rail_stUpHpTst_4_1B" 634 "SIGNALS_Rail_tiDwnHpTst_0_4B" 635 "SIGNALS_Rail_tiDwnHpTst_1_4B" 636 "SIGNALS_Rail_tiDwnHpTst_2_4B" 637 "SIGNALS_Rail_tiDwnHpTst_3_4B" 638 "SIGNALS_Rail_tiDwnHpTst_4_4B" 639 "SIGNALS_Rail_tiDwnHpTst_5_4B" 640 "SIGNALS_Rail_tiDwnHpTst_6_4B" 641 "SIGNALS_Rail_tiUpHpTst_0_4B" 642 "SIGNALS_Rail_tiUpHpTst_1_4B" 643 "SIGNALS_Rail_tiUpHpTst_2_4B" 644 "SIGNALS_Rail_tiUpHpTst_3_4B" 645 "SIGNALS_Reset_Env_adLoc_mp_4B" 646 "SIGNALS_Reset_Env_xId_mp_2B" 647 "SIGNALS_Rf_2B" 648 "SIGNALS_RngMod_trqFrc_2B" 649 "SIGNALS_Shtr_rPs_1B" 650 "SIGNALS_Shtr_rPs_2B" 651 "SIGNALS_Shtr_r_2B" 652 "SIGNALS_SmkLim_qLimSmk_2B" 653 "SIGNALS_SpdGov_trqSet_2B" 654 "SIGNALS_St_dfh0_1B" 655 "SIGNALS_St_msaaa_1B" 656 "SIGNALS_St_msaaad_2B" 657 "SIGNALS_St_msaanz_2B" 658 "SIGNALS_St_msaav_1B" 659 "SIGNALS_St_msaavd1_2B" 660 "SIGNALS_St_msaavd2_2B" 661 "SIGNALS_St_msaavd_4B" 662 "SIGNALS_St_msaea_1B" 663 "SIGNALS_St_msaev_1B" 664 "SIGNALS_St_ngang_1B" 665 "SIGNALS_Stat_entl_1B" 666 "SIGNALS_Stat_sv_reg2_1B" 667 "SIGNALS_SyC_stSub_1B" 668 "SIGNALS_T15_st_1B" 669 "SIGNALS_T_batt_2B" 670 "SIGNALS_ThrVlv_rAct_2B" 671 "SIGNALS_ThrVlv_rPs_1B" 672 "SIGNALS_ThrVlv_rPs_2B" 673 "SIGNALS_Tn_abstell_2B" 674 "SIGNALS_Toel_2B" 675 "SIGNALS_Tra_numGear_1B" 676 "SIGNALS_TrbChLP_rPs_1B" 677 "SIGNALS_TrbChLP_rPs_2B" 678 "SIGNALS_TrbChLP_r_2B" 679 "SIGNALS_TrbCh_rPs_1B" 680 "SIGNALS_TrbCh_rPs_2B" 681 "SIGNALS_TrbCh_rRaw_2B" 682 "SIGNALS_TrbCh_r_2B" 683 "SIGNALS_TrbnDsRLam_rLamRec_2B" 684 "SIGNALS_Tw_2B" 685 "SIGNALS_Tw_agr_2B" 686 "SIGNALS_Tw_agrcntg_4B" 687 "SIGNALS_Tw_agrmax_2B" 688 "SIGNALS_Tw_noagr_2B" 689 "SIGNALS_Tw_noagrcntg_4B" 690 "SIGNALS_Tw_noagrmax_2B" 691 "SIGNALS_U_batt_2B" 692 "SIGNALS_U_bn_soll_1B" 693 "SIGNALS_U_gen_2B" 694 "SIGNALS_Uekp_1B" 695 "SIGNALS_VSwVlv_rAct_2B" 696 "SIGNALS_VSwVlv_rPs_1B" 697 "SIGNALS_VSwVlv_rPs_2B" 698 "SIGNALS_VehV_a_2B" 699 "SIGNALS_VehV_v_2B" 700 "SIGNALS_WaHtEl_rPs_1B" 701 "SIGNALS_WaHtEl_rPs_2B" 702 "SIGNALS_WaHt_stShutOff_mp_2B" /end COMPU_VTAB
/begin COMPU_METHOD SyC_PostDrv_State "" TAB_VERB "%6.3" "" COMPU_TAB_REF SyC_PostDrv_State /end COMPU_METHOD
/begin COMPU_VTAB SyC_PostDrv_State "" TAB_VERB 8 0 "SYC_POSTDRV_INACTV" 1 "SYC_POSTDRV_DSM_BGN" 2 "SYC_POSTDRV_EEP_BGN" 3 "SYC_POSTDRV_WAIT" 4 "SYC_POSTDRV_DSM_END" 5 "SYC_POSTDRV_EEP_END" 6 "SYC_POSTDRV_MIN_TIME" 7 "SYC_POSTDRV_DONE" /end COMPU_VTAB
/begin COMPU_METHOD SyC_PreDrv_State "" TAB_VERB "%6.3" "" COMPU_TAB_REF SyC_PreDrv_State /end COMPU_METHOD
/begin COMPU_VTAB SyC_PreDrv_State "" TAB_VERB 10 0 "SYC_PREDRV_INI_DRV" 1 "SYC_PREDRV_DONE" 2 "SYC_PREDRV_INI_SHDWN" 3 "SYC_PREDRV_PROLONG" 4 "SYC_PREDRV_NWM" 5 "SYC_PREDRV_EEP" 6 "SYC_PREDRV_DSM" 7 "SYC_PREDRV_MR" 8 "SYC_PREDRV_MOM" 9 "SYC_PREDRV_EXIT" /end COMPU_VTAB
/begin COMPU_METHOD SyC_Time_100ms "" RAT_FUNC "%6.3" "s" COEFFS 0 1000 0 0 0 100 /end COMPU_METHOD
/begin COMPU_METHOD SyC_Time_1s "" RAT_FUNC "%6.2" "s" COEFFS 0 1 0 0 0 1 /end COMPU_METHOD
/begin COMPU_METHOD SyC_Time_2min "" RAT_FUNC "%6.2" "min" COEFFS 0 1 0 0 0 2 /end COMPU_METHOD
/begin COMPU_METHOD Temp_Cels "" RAT_FUNC "%5.1" "deg C" COEFFS 0 10 2731.4 0 0 1 /end COMPU_METHOD
/begin COMPU_METHOD TimeDeb "" RAT_FUNC "%5.0" "ms" COEFFS 0 0.1 0 0 0 1 /end COMPU_METHOD
/begin COMPU_METHOD TimeDelay_s "" RAT_FUNC "%12.4" "s" COEFFS 0 0 1 0 0.00023283064365387 0 /end COMPU_METHOD
/begin COMPU_METHOD Time_ms "" RAT_FUNC "%5.0" "ms" COEFFS 0 0.1 0 0 0 1 /end COMPU_METHOD
/begin COMPU_METHOD Time_s "" RAT_FUNC "%5.2" "s" COEFFS 0 100 0 0 0 1 /end COMPU_METHOD
/begin COMPU_METHOD TIncPerDurHiReso_us "" RAT_FUNC "%6.5" "us" COEFFS 0 2560 0 0 0 1 /end COMPU_METHOD
/begin COMPU_METHOD TIncPerDur_us "" RAT_FUNC "%6.3" "us" COEFFS 0 10 0 0 0 1 /end COMPU_METHOD
/begin COMPU_METHOD TransR "" RAT_FUNC "%4.2" "-" COEFFS 0 100 0 0 0 1 /end COMPU_METHOD
/begin COMPU_METHOD Trq "" RAT_FUNC "%5.1" "Nm" COEFFS 0 10 0 0 0 1 /end COMPU_METHOD
/begin COMPU_METHOD Vel "" RAT_FUNC "%5.2" "km/h" COEFFS 0 100 0 0 0 1 /end COMPU_METHOD
/begin COMPU_METHOD volAdd_ml "" RAT_FUNC "%6.3" "ml" COEFFS 0 10 0 0 0 1 /end COMPU_METHOD
/begin COMPU_METHOD Volt "" RAT_FUNC "%6.1" "mV" COEFFS 0 5 0 0 0 1 /end COMPU_METHOD
/begin COMPU_METHOD Volt_Batt "" RAT_FUNC "%5.0" "mV" COEFFS 0 0.05 0 0 0 1 /end COMPU_METHOD
/begin RECORD_LAYOUT Cur_Xs16Ws16 NO_AXIS_PTS_X 1 SWORD AXIS_PTS_X 2 SWORD INDEX_INCR DIRECT FNC_VALUES 3 SWORD COLUMN_DIR DIRECT /end RECORD_LAYOUT
/begin RECORD_LAYOUT Kf_Xs16_Ys16_Ws16 NO_AXIS_PTS_X 1 SWORD NO_AXIS_PTS_Y 2 SWORD AXIS_PTS_X 3 SWORD INDEX_INCR DIRECT AXIS_PTS_Y 4 SWORD INDEX_INCR DIRECT FNC_VALUES 5 SWORD COLUMN_DIR DIRECT /end RECORD_LAYOUT
/begin RECORD_LAYOUT Kl_Xs16_Ws16 NO_AXIS_PTS_X 1 SWORD AXIS_PTS_X 2 SWORD INDEX_INCR DIRECT FNC_VALUES 3 SWORD COLUMN_DIR DIRECT /end RECORD_LAYOUT
/begin RECORD_LAYOUT Kw_Ws16 FNC_VALUES 1 SWORD COLUMN_DIR DIRECT /end RECORD_LAYOUT
/begin RECORD_LAYOUT Kw_Ws32 FNC_VALUES 1 SLONG COLUMN_DIR DIRECT /end RECORD_LAYOUT
/begin RECORD_LAYOUT Kw_Wu16 FNC_VALUES 1 UWORD COLUMN_DIR DIRECT /end RECORD_LAYOUT
/begin RECORD_LAYOUT Kw_Wu8 FNC_VALUES 1 UBYTE COLUMN_DIR DIRECT /end RECORD_LAYOUT
/begin RECORD_LAYOUT Map_Xs16Ys16Ws16 NO_AXIS_PTS_X 1 SWORD NO_AXIS_PTS_Y 2 SWORD AXIS_PTS_X 3 SWORD INDEX_INCR DIRECT AXIS_PTS_Y 4 SWORD INDEX_INCR DIRECT FNC_VALUES 5 SWORD COLUMN_DIR DIRECT /end RECORD_LAYOUT
/begin RECORD_LAYOUT ValA_Ws16 FNC_VALUES 1 SWORD COLUMN_DIR DIRECT /end RECORD_LAYOUT
/begin RECORD_LAYOUT ValA_Wu16 FNC_VALUES 1 UWORD COLUMN_DIR DIRECT /end RECORD_LAYOUT
/begin RECORD_LAYOUT ValA_Wu32 FNC_VALUES 1 ULONG COLUMN_DIR DIRECT /end RECORD_LAYOUT
/begin RECORD_LAYOUT ValA_Wu8 FNC_VALUES 1 UBYTE COLUMN_DIR DIRECT /end RECORD_LAYOUT
/begin RECORD_LAYOUT Val_Ws16 FNC_VALUES 1 SWORD COLUMN_DIR DIRECT /end RECORD_LAYOUT
/begin RECORD_LAYOUT Val_Ws32 FNC_VALUES 1 SLONG COLUMN_DIR DIRECT /end RECORD_LAYOUT
/begin RECORD_LAYOUT Val_Ws8 FNC_VALUES 1 SBYTE COLUMN_DIR DIRECT /end RECORD_LAYOUT
/begin RECORD_LAYOUT Val_Wu16 FNC_VALUES 1 UWORD COLUMN_DIR DIRECT /end RECORD_LAYOUT
/begin RECORD_LAYOUT Val_Wu32 FNC_VALUES 1 ULONG COLUMN_DIR DIRECT /end RECORD_LAYOUT
/begin RECORD_LAYOUT Val_Wu8 FNC_VALUES 1 UBYTE COLUMN_DIR DIRECT /end RECORD_LAYOUT
/end MODULE
/end PROJECT

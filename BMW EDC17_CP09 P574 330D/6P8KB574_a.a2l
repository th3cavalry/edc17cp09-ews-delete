ASAP2_VERSION 1 4
/begin PROJECT P_574 "EDC17_CP09"
/begin HEADER "" VERSION "V8KB" PROJECT_NO P_574 /end HEADER
/begin MODULE DIM ""
/begin MOD_COMMON "" BYTE_ORDER MSB_LAST ALIGNMENT_BYTE 1 ALIGNMENT_WORD 2 ALIGNMENT_LONG 4 ALIGNMENT_FLOAT32_IEEE 4 /end MOD_COMMON
/begin CHARACTERISTIC DDRC_DurDeb.PFlt_tiPFltTraRpmRdcDebOk_C "DDRC/Dauer der Heilungsentprellung für Prüfung DFC_PFltTraRpmRdc" VALUE 0x80022A18 Val_Wu16 655350.0 DDRCTime_ms 0.00 655350.0 /end CHARACTERISTIC
/begin CHARACTERISTIC DDRC_DurDeb.PFlt_tiPFltTraRpmRdcDebDef_C "DDRC/Dauer der Fehlerentprellung für Prüfung DFC_PFltTraRpmRdc" VALUE 0x80022A1A Val_Wu16 655350.0 DDRCTime_ms 0.00 655350.0 /end CHARACTERISTIC
/begin CHARACTERISTIC DDRC_DurDeb.Com_tiSlrdiGlbFZMTo_FADebOk_C "DDRC/Dauer der Heilungsentprellung für Prüfung DFC_ComSlrdiGlbFZMTo_FA" VALUE 0x80022A1C Val_Wu16 655350.0 DDRCTime_ms 0.00 655350.0 /end CHARACTERISTIC
/begin CHARACTERISTIC DDRC_DurDeb.Com_tiSlrdiGlbFZMTo_FADebDef_C "DDRC/Dauer der Fehlerentprellung für Prüfung DFC_ComSlrdiGlbFZMTo_FA" VALUE 0x80022A1E Val_Wu16 655350.0 DDRCTime_ms 0.00 655350.0 /end CHARACTERISTIC
/begin CHARACTERISTIC DDRC_DurDeb.Com_tiStatusRGangToDebOk_C "DDRC/Dauer der Heilungsentprellung für Prüfung DFC_ComStatusRGangTo" VALUE 0x80022A20 Val_Wu16 655350.0 DDRCTime_ms 0.00 655350.0 /end CHARACTERISTIC
/begin CHARACTERISTIC DDRC_DurDeb.Com_tiStatusRGangToDebDef_C "DDRC/Dauer der Fehlerentprellung für Prüfung DFC_ComStatusRGangTo" VALUE 0x80022A22 Val_Wu16 655350.0 DDRCTime_ms 0.00 655350.0 /end CHARACTERISTIC
/begin CHARACTERISTIC DDRC_DurDeb.Com_tiTrqDemandGbxSig_FADebOk_C "DDRC/Dauer der Heilungsentprellung für Prüfung DFC_ComTrqDemandGbxSig_FA" VALUE 0x80022A24 Val_Wu16 655350.0 DDRCTime_ms 0.00 655350.0 /end CHARACTERISTIC
/begin CHARACTERISTIC DDRC_DurDeb.Com_tiTrqDemandGbxSig_FADebDef_C "DDRC/Dauer der Fehlerentprellung für Prüfung DFC_ComTrqDemandGbxSig_FA" VALUE 0x80022A26 Val_Wu16 655350.0 DDRCTime_ms 0.00 655350.0 /end CHARACTERISTIC
/begin CHARACTERISTIC DDRC_DurDeb.ETCtl_tiDvtOutrMaxDebOk_C "DDRC/Dauer der Heilungsentprellung für Prüfung DFC_ETCtlDvtOutrMax" VALUE 0x80022A28 Val_Wu16 655350.0 DDRCTime_ms 0.00 655350.0 /end CHARACTERISTIC
/begin CHARACTERISTIC DDRC_DurDeb.ETCtl_tiDvtOutrMaxDebDef_C "DDRC/Dauer der Fehlerentprellung für Prüfung DFC_ETCtlDvtOutrMax" VALUE 0x80022A2A Val_Wu16 655350.0 DDRCTime_ms 0.00 655350.0 /end CHARACTERISTIC
/begin CHARACTERISTIC DDRC_DurDeb.Air_PlsPIntkVUsDebOk_C "DDRC/Dauer der Heilungsentprellung für Prüfung DFC_PIntkVUsEnvPPls" VALUE 0x80022A2C Val_Wu16 655350.0 DDRCTime_ms 0.00 655350.0 /end CHARACTERISTIC
/begin CHARACTERISTIC DDRC_DurDeb.Air_PlsPIntkVUsDebDef_C "DDRC/Dauer der Fehlerentprellung für Prüfung DFC_PIntkVUsEnvPPls" VALUE 0x80022A2E Val_Wu16 655350.0 DDRCTime_ms 0.00 655350.0 /end CHARACTERISTIC
/begin CHARACTERISTIC DDRC_DurDeb.Com_tiTrqDemandGbxChk_ADebOk_C "DDRC/Dauer der Heilungsentprellung für Prüfung DFC_ComTrqDemandGbxChk_A" VALUE 0x80022A30 Val_Wu16 655350.0 DDRCTime_ms 0.00 655350.0 /end CHARACTERISTIC
/begin CHARACTERISTIC DDRC_DurDeb.Com_tiTrqDemandGbxChk_ADebDef_C "DDRC/Dauer der Fehlerentprellung für Prüfung DFC_ComTrqDemandGbxChk_A" VALUE 0x80022A32 Val_Wu16 655350.0 DDRCTime_ms 0.00 655350.0 /end CHARACTERISTIC
/begin CHARACTERISTIC DDRC_DurDeb.FBC_tiDvtMinDebOk_C "DDRC/Dauer der Heilungsentprellung für Prüfung DFC_FBCqDvtMin" VALUE 0x80022A34 Val_Wu16 655350.0 DDRCTime_ms 0.00 655350.0 /end CHARACTERISTIC
/begin CHARACTERISTIC DDRC_DurDeb.FBC_tiDvtMinDebDef_C "DDRC/Dauer der Fehlerentprellung für Prüfung DFC_FBCqDvtMin" VALUE 0x80022A36 Val_Wu16 655350.0 DDRCTime_ms 0.00 655350.0 /end CHARACTERISTIC
/begin CHARACTERISTIC DDRC_DurDeb.Com_tiACDemandTo_FADebOk_C "DDRC/Dauer der Heilungsentprellung für Prüfung DFC_ComACDemandTo_FA" VALUE 0x80022A38 Val_Wu16 655350.0 DDRCTime_ms 0.00 655350.0 /end CHARACTERISTIC
/begin CHARACTERISTIC DDRC_DurDeb.Com_tiACDemandTo_FADebDef_C "DDRC/Dauer der Fehlerentprellung für Prüfung DFC_ComACDemandTo_FA" VALUE 0x80022A3A Val_Wu16 655350.0 DDRCTime_ms 0.00 655350.0 /end CHARACTERISTIC
/begin CHARACTERISTIC DDRC_DurDeb.PFlt_tiPFltBPSPlausMAXDebOk_C "DDRC/Dauer der Heilungsentprellung für Prüfung DFC_PFltBPSPlausMAX" VALUE 0x80022A3C Val_Wu16 655350.0 DDRCTime_ms 0.00 655350.0 /end CHARACTERISTIC
/begin CHARACTERISTIC DDRC_DurDeb.PFlt_tiPFltBPSPlausMAXDebDef_C "DDRC/Dauer der Fehlerentprellung für Prüfung DFC_PFltBPSPlausMAX" VALUE 0x80022A3E Val_Wu16 655350.0 DDRCTime_ms 0.00 655350.0 /end CHARACTERISTIC
/begin CHARACTERISTIC DDRC_DurDeb.Com_tiButtonMSASigDebOk_C "DDRC/Dauer der Heilungsentprellung für Prüfung DFC_ComButtonMSASig" VALUE 0x80022A40 Val_Wu16 655350.0 DDRCTime_ms 0.00 655350.0 /end CHARACTERISTIC
/begin CHARACTERISTIC DDRC_DurDeb.Com_tiButtonMSASigDebDef_C "DDRC/Dauer der Fehlerentprellung für Prüfung DFC_ComButtonMSASig" VALUE 0x80022A42 Val_Wu16 655350.0 DDRCTime_ms 0.00 655350.0 /end CHARACTERISTIC
/begin CHARACTERISTIC DDRC_DurDeb.GlwEcu_tiTempErrDebOk_C "DDRC/Dauer der Heilungsentprellung für Prüfung DFC_GlwEcuTempErr" VALUE 0x80022A44 Val_Wu16 655350.0 DDRCTime_ms 0.00 655350.0 /end CHARACTERISTIC
/begin CHARACTERISTIC DDRC_DurDeb.GlwEcu_tiTempErrDebDef_C "DDRC/Dauer der Fehlerentprellung für Prüfung DFC_GlwEcuTempErr" VALUE 0x80022A46 Val_Wu16 655350.0 DDRCTime_ms 0.00 655350.0 /end CHARACTERISTIC
/begin CHARACTERISTIC DDRC_DurDeb.Com_tiSteeringAngleCtr_FXDebOk_C "DDRC/Dauer der Heilungsentprellung für Prüfung DFC_ComSteeringAngleCtr_FX" VALUE 0x80022A48 Val_Wu16 655350.0 DDRCTime_ms 0.00 655350.0 /end CHARACTERISTIC
/begin CHARACTERISTIC DDRC_DurDeb.Com_tiSteeringAngleCtr_FXDebDef_C "DDRC/Dauer der Fehlerentprellung für Prüfung DFC_ComSteeringAngleCtr_FX" VALUE 0x80022A4A Val_Wu16 655350.0 DDRCTime_ms 0.00 655350.0 /end CHARACTERISTIC
/begin CHARACTERISTIC DDRC_DurDeb.Com_tiCodierungPwrmngSig_FADebOk_C "DDRC/Dauer der Heilungsentprellung für Prüfung DFC_ComCodierungPwrmngSig_FA" VALUE 0x80022A4C Val_Wu16 655350.0 DDRCTime_ms 0.00 655350.0 /end CHARACTERISTIC
/begin CHARACTERISTIC DDRC_DurDeb.Com_tiCodierungPwrmngSig_FADebDef_C "DDRC/Dauer der Fehlerentprellung für Prüfung DFC_ComCodierungPwrmngSig_FA" VALUE 0x80022A4E Val_Wu16 655350.0 DDRCTime_ms 0.00 655350.0 /end CHARACTERISTIC
/begin CHARACTERISTIC DDRC_DurDeb.WaHtEl_ti4WinErr4DebOk_C "DDRC/Dauer der Heilungsentprellung für Prüfung DFC_WaHtEl4WinErr4" VALUE 0x80022A50 Val_Wu16 655350.0 DDRCTime_ms 0.00 655350.0 /end CHARACTERISTIC
/begin CHARACTERISTIC DDRC_DurDeb.WaHtEl_ti4WinErr4DebDef_C "DDRC/Dauer der Fehlerentprellung für Prüfung DFC_WaHtEl4WinErr4" VALUE 0x80022A52 Val_Wu16 655350.0 DDRCTime_ms 0.00 655350.0 /end CHARACTERISTIC
/begin CHARACTERISTIC DDRC_DurDeb.Com_tiRequestEMFToDebOk_C "DDRC/Dauer der Heilungsentprellung für Prüfung DFC_ComRequestEMFTo" VALUE 0x80022A54 Val_Wu16 655350.0 DDRCTime_ms 0.00 655350.0 /end CHARACTERISTIC
/begin CHARACTERISTIC DDRC_DurDeb.Com_tiRequestEMFToDebDef_C "DDRC/Dauer der Fehlerentprellung für Prüfung DFC_ComRequestEMFTo" VALUE 0x80022A56 Val_Wu16 655350.0 DDRCTime_ms 0.00 655350.0 /end CHARACTERISTIC
/begin CHARACTERISTIC DDRC_DurDeb.Com_tiRelTimeTo_FADebOk_C "DDRC/Dauer der Heilungsentprellung für Prüfung DFC_ComRelTimeTo_FA" VALUE 0x80022A58 Val_Wu16 655350.0 DDRCTime_ms 0.00 655350.0 /end CHARACTERISTIC
/begin CHARACTERISTIC DDRC_DurDeb.Com_tiRelTimeTo_FADebDef_C "DDRC/Dauer der Fehlerentprellung für Prüfung DFC_ComRelTimeTo_FA" VALUE 0x80022A5A Val_Wu16 655350.0 DDRCTime_ms 0.00 655350.0 /end CHARACTERISTIC
/begin CHARACTERISTIC DDRC_DurDeb.Com_tiGbxDataTo_FADebOk_C "DDRC/Dauer der Heilungsentprellung für Prüfung DFC_ComGbxDataTo_FA" VALUE 0x80022A5C Val_Wu16 655350.0 DDRCTime_ms 0.00 655350.0 /end CHARACTERISTIC
/begin CHARACTERISTIC DDRC_DurDeb.Com_tiGbxDataTo_FADebDef_C "DDRC/Dauer der Fehlerentprellung für Prüfung DFC_ComGbxDataTo_FA" VALUE 0x80022A5E Val_Wu16 655350.0 DDRCTime_ms 0.00 655350.0 /end CHARACTERISTIC
/begin CHARACTERISTIC DDRC_DurDeb.Com_tiStatGearRevSig_FADebOk_C "DDRC/Dauer der Heilungsentprellung für Prüfung DFC_ComStatGearRevSig_FA" VALUE 0x80022A60 Val_Wu16 655350.0 DDRCTime_ms 0.00 655350.0 /end CHARACTERISTIC
/begin CHARACTERISTIC DDRC_DurDeb.Com_tiStatGearRevSig_FADebDef_C "DDRC/Dauer der Fehlerentprellung für Prüfung DFC_ComStatGearRevSig_FA" VALUE 0x80022A62 Val_Wu16 655350.0 DDRCTime_ms 0.00 655350.0 /end CHARACTERISTIC
/begin CHARACTERISTIC DDRC_DurDeb.Com_tiSpeedVehicleChk_FXDebOk_C "DDRC/Dauer der Heilungsentprellung für Prüfung DFC_ComSpeedVehicleChk_FX" VALUE 0x80022A64 Val_Wu16 655350.0 DDRCTime_ms 0.00 655350.0 /end CHARACTERISTIC
/begin CHARACTERISTIC DDRC_DurDeb.Com_tiSpeedVehicleChk_FXDebDef_C "DDRC/Dauer der Fehlerentprellung für Prüfung DFC_ComSpeedVehicleChk_FX" VALUE 0x80022A66 Val_Wu16 655350.0 DDRCTime_ms 0.00 655350.0 /end CHARACTERISTIC
/begin CHARACTERISTIC DDRC_DurDeb.Com_tiSecCtrRelSig_FADebOk_C "DDRC/Dauer der Heilungsentprellung für Prüfung DFC_ComSecCtrRelSig_FA" VALUE 0x80022A68 Val_Wu16 655350.0 DDRCTime_ms 0.00 655350.0 /end CHARACTERISTIC
/begin CHARACTERISTIC DDRC_DurDeb.Com_tiSecCtrRelSig_FADebDef_C "DDRC/Dauer der Fehlerentprellung für Prüfung DFC_ComSecCtrRelSig_FA" VALUE 0x80022A6A Val_Wu16 655350.0 DDRCTime_ms 0.00 655350.0 /end CHARACTERISTIC
/begin CHARACTERISTIC DDRC_DurDeb.Com_tiCrCtlLvrSigDebOk_C "DDRC/Dauer der Heilungsentprellung für Prüfung DFC_ComCrCtlLvrSig" VALUE 0x80022A6C Val_Wu16 655350.0 DDRCTime_ms 0.00 655350.0 /end CHARACTERISTIC
/begin CHARACTERISTIC DDRC_DurDeb.Com_tiCrCtlLvrSigDebDef_C "DDRC/Dauer der Fehlerentprellung für Prüfung DFC_ComCrCtlLvrSig" VALUE 0x80022A6E Val_Wu16 655350.0 DDRCTime_ms 0.00 655350.0 /end CHARACTERISTIC
/begin CHARACTERISTIC DDRC_DurDeb.Com_tiTrqWhlDemCtrDebOk_C "DDRC/Dauer der Heilungsentprellung für Prüfung DFC_ComTrqWhlDemCtr" VALUE 0x80022A70 Val_Wu16 655350.0 DDRCTime_ms 0.00 655350.0 /end CHARACTERISTIC
/begin CHARACTERISTIC DDRC_DurDeb.Com_tiTrqWhlDemCtrDebDef_C "DDRC/Dauer der Fehlerentprellung für Prüfung DFC_ComTrqWhlDemCtr" VALUE 0x80022A72 Val_Wu16 655350.0 DDRCTime_ms 0.00 655350.0 /end CHARACTERISTIC
/begin CHARACTERISTIC DDRC_DurDeb.Com_tiCtrCrshSwoEkpTo_FADebOk_C "DDRC/Dauer der Heilungsentprellung für Prüfung DFC_ComCtrCrshSwoEkpTo_FA" VALUE 0x80022A74 Val_Wu16 655350.0 DDRCTime_ms 0.00 655350.0 /end CHARACTERISTIC
/begin CHARACTERISTIC DDRC_DurDeb.Com_tiCtrCrshSwoEkpTo_FADebDef_C "DDRC/Dauer der Fehlerentprellung für Prüfung DFC_ComCtrCrshSwoEkpTo_FA" VALUE 0x80022A76 Val_Wu16 655350.0 DDRCTime_ms 0.00 655350.0 /end CHARACTERISTIC
/begin CHARACTERISTIC DDRC_DurDeb.CY320_tiSpiCommErrorDebOk_C "DDRC/Dauer der Heilungsentprellung für Prüfung DFC_Cy320SpiCom" VALUE 0x80022A78 Val_Wu16 655350.0 DDRCTime_ms 0.00 655350.0 /end CHARACTERISTIC
/begin CHARACTERISTIC DDRC_DurDeb.CY320_tiSpiCommErrorDebDef_C "DDRC/Dauer der Fehlerentprellung für Prüfung DFC_Cy320SpiCom" VALUE 0x80022A7A Val_Wu16 655350.0 DDRCTime_ms 0.00 655350.0 /end CHARACTERISTIC
/begin CHARACTERISTIC DDRC_DurDeb.Com_tiStatusEMFCtrDebOk_C "DDRC/Dauer der Heilungsentprellung für Prüfung DFC_ComStatusEMFCtr" VALUE 0x80022A7C Val_Wu16 655350.0 DDRCTime_ms 0.00 655350.0 /end CHARACTERISTIC
/begin CHARACTERISTIC DDRC_DurDeb.Com_tiStatusEMFCtrDebDef_C "DDRC/Dauer der Fehlerentprellung für Prüfung DFC_ComStatusEMFCtr" VALUE 0x80022A7E Val_Wu16 655350.0 DDRCTime_ms 0.00 655350.0 /end CHARACTERISTIC
/begin CHARACTERISTIC DDRC_DurDeb.Com_tiVelocityToDebOk_C "DDRC/Dauer der Heilungsentprellung für Prüfung DFC_ComVelocityTo" VALUE 0x80022A80 Val_Wu16 655350.0 DDRCTime_ms 0.00 655350.0 /end CHARACTERISTIC
/begin CHARACTERISTIC DDRC_DurDeb.Com_tiVelocityToDebDef_C "DDRC/Dauer der Fehlerentprellung für Prüfung DFC_ComVelocityTo" VALUE 0x80022A82 Val_Wu16 655350.0 DDRCTime_ms 0.00 655350.0 /end CHARACTERISTIC
/begin CHARACTERISTIC DDRC_DurDeb.Com_tiCtrSecIntToDebOk_C "DDRC/Dauer der Heilungsentprellung für Prüfung DFC_ComCtrSecInt" VALUE 0x80022A84 Val_Wu16 655350.0 DDRCTime_ms 0.00 655350.0 /end CHARACTERISTIC
/begin CHARACTERISTIC DDRC_DurDeb.Com_tiCtrSecIntToDebDef_C "DDRC/Dauer der Fehlerentprellung für Prüfung DFC_ComCtrSecInt" VALUE 0x80022A86 Val_Wu16 655350.0 DDRCTime_ms 0.00 655350.0 /end CHARACTERISTIC
/begin CHARACTERISTIC DDRC_DurDeb.PFlt_tiPreMaxDebOk_C "DDRC/Dauer der Heilungsentprellung für Prüfung DFC_PFlt_tPreMax" VALUE 0x80022A88 Val_Wu16 655350.0 DDRCTime_ms 0.00 655350.0 /end CHARACTERISTIC
/begin CHARACTERISTIC DDRC_DurDeb.PFlt_tiPreMaxDebDef_C "DDRC/Dauer der Fehlerentprellung für Prüfung DFC_PFlt_tPreMax" VALUE 0x80022A8A Val_Wu16 655350.0 DDRCTime_ms 0.00 655350.0 /end CHARACTERISTIC
/begin CHARACTERISTIC DDRC_DurDeb.Com_tiStatusEGSTo_ADebOk_C "DDRC/Dauer der Heilungsentprellung für Prüfung DFC_ComStatusEGSTo_A" VALUE 0x80022A8C Val_Wu16 655350.0 DDRCTime_ms 0.00 655350.0 /end CHARACTERISTIC
/begin CHARACTERISTIC DDRC_DurDeb.Com_tiStatusEGSTo_ADebDef_C "DDRC/Dauer der Fehlerentprellung für Prüfung DFC_ComStatusEGSTo_A" VALUE 0x80022A8E Val_Wu16 655350.0 DDRCTime_ms 0.00 655350.0 /end CHARACTERISTIC
/begin CHARACTERISTIC DDRC_DurDeb.PFlt_tiPFltPresPlausMINDebOk_C "DDRC/Dauer der Heilungsentprellung für Prüfung DFC_PFltPresPlausMIN" VALUE 0x80022A90 Val_Wu16 655350.0 DDRCTime_ms 0.00 655350.0 /end CHARACTERISTIC
/begin CHARACTERISTIC DDRC_DurDeb.PFlt_tiPFltPresPlausMINDebDef_C "DDRC/Dauer der Fehlerentprellung für Prüfung DFC_PFltPresPlausMIN" VALUE 0x80022A92 Val_Wu16 655350.0 DDRCTime_ms 0.00 655350.0 /end CHARACTERISTIC
/begin CHARACTERISTIC DDRC_DurDeb.AirCtl_tiGovDvtMaxDebOk_C "DDRC/Dauer der Heilungsentprellung für Prüfung DFC_AirCtlGovDvtMax" VALUE 0x80022A94 Val_Wu16 655350.0 DDRCTime_ms 0.00 655350.0 /end CHARACTERISTIC
/begin CHARACTERISTIC DDRC_DurDeb.AirCtl_tiGovDvtMaxDebDef_C "DDRC/Dauer der Fehlerentprellung für Prüfung DFC_AirCtlGovDvtMax" VALUE 0x80022A96 Val_Wu16 655350.0 DDRCTime_ms 0.00 655350.0 /end CHARACTERISTIC
/begin CHARACTERISTIC DDRC_DurDeb.Rail_tiPCV0DebOk_C "DDRC/Dauer der Heilungsentprellung für Prüfung DFC_RailPCV0" VALUE 0x80022A98 Val_Wu16 655350.0 DDRCTime_ms 0.00 655350.0 /end CHARACTERISTIC
/begin CHARACTERISTIC DDRC_DurDeb.Rail_tiPCV0DebDef_C "DDRC/Dauer der Fehlerentprellung für Prüfung DFC_RailPCV0" VALUE 0x80022A9A Val_Wu16 655350.0 DDRCTime_ms 0.00 655350.0 /end CHARACTERISTIC
/begin CHARACTERISTIC DDRC_DurDeb.ThrVlv_ti4WinErr4DebOk_C "DDRC/Dauer der Heilungsentprellung für Prüfung DFC_ThrVlv4WinErr4" VALUE 0x80022A9C Val_Wu16 655350.0 DDRCTime_ms 0.00 655350.0 /end CHARACTERISTIC
/begin CHARACTERISTIC DDRC_DurDeb.ThrVlv_ti4WinErr4DebDef_C "DDRC/Dauer der Fehlerentprellung für Prüfung DFC_ThrVlv4WinErr4" VALUE 0x80022A9E Val_Wu16 655350.0 DDRCTime_ms 0.00 655350.0 /end CHARACTERISTIC
/begin CHARACTERISTIC DDRC_DurDeb.Com_tiTrqDemandDesToDebOk_C "DDRC/Dauer der Heilungsentprellung für Prüfung DFC_ComTrqDemandDesTo" VALUE 0x80022AA0 Val_Wu16 655350.0 DDRCTime_ms 0.00 655350.0 /end CHARACTERISTIC
/begin CHARACTERISTIC DDRC_DurDeb.Com_tiTrqDemandDesToDebDef_C "DDRC/Dauer der Fehlerentprellung für Prüfung DFC_ComTrqDemandDesTo" VALUE 0x80022AA2 Val_Wu16 655350.0 DDRCTime_ms 0.00 655350.0 /end CHARACTERISTIC
/begin CHARACTERISTIC DDRC_DurDeb.Com_tiVelocitySigDebOk_C "DDRC/Dauer der Heilungsentprellung für Prüfung DFC_ComVelocitySig" VALUE 0x80022AA4 Val_Wu16 655350.0 DDRCTime_ms 0.00 655350.0 /end CHARACTERISTIC
/begin CHARACTERISTIC DDRC_DurDeb.Com_tiVelocitySigDebDef_C "DDRC/Dauer der Fehlerentprellung für Prüfung DFC_ComVelocitySig" VALUE 0x80022AA6 Val_Wu16 655350.0 DDRCTime_ms 0.00 655350.0 /end CHARACTERISTIC
/begin CHARACTERISTIC DDRC_DurDeb.Com_tiRequestEMFCtrDebOk_C "DDRC/Dauer der Heilungsentprellung für Prüfung DFC_ComRequestEMFCtr" VALUE 0x80022AA8 Val_Wu16 655350.0 DDRCTime_ms 0.00 655350.0 /end CHARACTERISTIC
/begin CHARACTERISTIC DDRC_DurDeb.Com_tiRequestEMFCtrDebDef_C "DDRC/Dauer der Fehlerentprellung für Prüfung DFC_ComRequestEMFCtr" VALUE 0x80022AAA Val_Wu16 655350.0 DDRCTime_ms 0.00 655350.0 /end CHARACTERISTIC
/begin CHARACTERISTIC DDRC_DurDeb.GlwEcu_tiGkSCDebOk_C "DDRC/Dauer der Heilungsentprellung für Prüfung DFC_GlwEcuGk6SC" VALUE 0x80022AAC Val_Wu16 655350.0 DDRCTime_ms 0.00 655350.0 /end CHARACTERISTIC
/begin CHARACTERISTIC DDRC_DurDeb.GlwEcu_tiGkSCDebDef_C "DDRC/Dauer der Fehlerentprellung für Prüfung DFC_GlwEcuGk6SC" VALUE 0x80022AAE Val_Wu16 655350.0 DDRCTime_ms 0.00 655350.0 /end CHARACTERISTIC
/begin CHARACTERISTIC DDRC_DurDeb.Com_tiBtnDrvDynCtr_FXDebOk_C "DDRC/Dauer der Heilungsentprellung für Prüfung DFC_ComBtnDrvDynCtr_FX" VALUE 0x80022AB0 Val_Wu16 655350.0 DDRCTime_ms 0.00 655350.0 /end CHARACTERISTIC
/begin CHARACTERISTIC DDRC_DurDeb.Com_tiBtnDrvDynCtr_FXDebDef_C "DDRC/Dauer der Fehlerentprellung für Prüfung DFC_ComBtnDrvDynCtr_FX" VALUE 0x80022AB2 Val_Wu16 655350.0 DDRCTime_ms 0.00 655350.0 /end CHARACTERISTIC
/begin CHARACTERISTIC DDRC_DurDeb.Com_tiTrqDemCrshDrDyTo_FXDebOk_C "DDRC/Dauer der Heilungsentprellung für Prüfung DFC_ComTrqDemCrshDrDyTo_FX" VALUE 0x80022AB4 Val_Wu16 655350.0 DDRCTime_ms 0.00 655350.0 /end CHARACTERISTIC
/begin CHARACTERISTIC DDRC_DurDeb.Com_tiTrqDemCrshDrDyTo_FXDebDef_C "DDRC/Dauer der Fehlerentprellung für Prüfung DFC_ComTrqDemCrshDrDyTo_FX" VALUE 0x80022AB6 Val_Wu16 655350.0 DDRCTime_ms 0.00 655350.0 /end CHARACTERISTIC
/begin CHARACTERISTIC DDRC_DurDeb.PFlt_tiOxiPreMaxRgnDebOk_C "DDRC/Dauer der Heilungsentprellung für Prüfung DFC_PFlt_tOxiPreMaxRgn" VALUE 0x80022AB8 Val_Wu16 655350.0 DDRCTime_ms 0.00 655350.0 /end CHARACTERISTIC
/begin CHARACTERISTIC DDRC_DurDeb.PFlt_tiOxiPreMaxRgnDebDef_C "DDRC/Dauer der Fehlerentprellung für Prüfung DFC_PFlt_tOxiPreMaxRgn" VALUE 0x80022ABA Val_Wu16 655350.0 DDRCTime_ms 0.00 655350.0 /end CHARACTERISTIC
/begin CHARACTERISTIC DDRC_DurDeb.TLE6232_tiSpiErrorDebOk_C "DDRC/Dauer der Heilungsentprellung für Prüfung DFC_Tle6232Spi1" VALUE 0x80022ABC Val_Wu16 655350.0 DDRCTime_ms 0.00 655350.0 /end CHARACTERISTIC
/begin CHARACTERISTIC DDRC_DurDeb.TLE6232_tiSpiErrorDebDef_C "DDRC/Dauer der Fehlerentprellung für Prüfung DFC_Tle6232Spi1" VALUE 0x80022ABE Val_Wu16 655350.0 DDRCTime_ms 0.00 655350.0 /end CHARACTERISTIC
/begin CHARACTERISTIC DDRC_DurDeb.Com_tiaBtnDrvDynTo_FXDebOk_C "DDRC/Dauer der Heilungsentprellung für Prüfung DFC_ComBtnDrvDynTo_FX" VALUE 0x80022AC0 Val_Wu16 655350.0 DDRCTime_ms 0.00 655350.0 /end CHARACTERISTIC
/begin CHARACTERISTIC DDRC_DurDeb.Com_tiaBtnDrvDynTo_FXDebDef_C "DDRC/Dauer der Fehlerentprellung für Prüfung DFC_ComBtnDrvDynTo_FX" VALUE 0x80022AC2 Val_Wu16 655350.0 DDRCTime_ms 0.00 655350.0 /end CHARACTERISTIC
/begin CHARACTERISTIC DDRC_DurDeb.Com_tiTrqDemCrshDrDyChk_FXDebOk_C "DDRC/Dauer der Heilungsentprellung für Prüfung DFC_ComTrqDemCrshDrDyChk_FX" VALUE 0x80022AC4 Val_Wu16 655350.0 DDRCTime_ms 0.00 655350.0 /end CHARACTERISTIC
/begin CHARACTERISTIC DDRC_DurDeb.Com_tiTrqDemCrshDrDyChk_FXDebDef_C "DDRC/Dauer der Fehlerentprellung für Prüfung DFC_ComTrqDemCrshDrDyChk_FX" VALUE 0x80022AC6 Val_Wu16 655350.0 DDRCTime_ms 0.00 655350.0 /end CHARACTERISTIC
/begin CHARACTERISTIC DDRC_DurDeb.Com_tiATempTo_FXDebOk_C "DDRC/Dauer der Heilungsentprellung für Prüfung DFC_ComATempTo_FX" VALUE 0x80022AC8 Val_Wu16 655350.0 DDRCTime_ms 0.00 655350.0 /end CHARACTERISTIC
/begin CHARACTERISTIC DDRC_DurDeb.Com_tiATempTo_FXDebDef_C "DDRC/Dauer der Fehlerentprellung für Prüfung DFC_ComATempTo_FX" VALUE 0x80022ACA Val_Wu16 655350.0 DDRCTime_ms 0.00 655350.0 /end CHARACTERISTIC
/begin CHARACTERISTIC DDRC_DurDeb.Com_tiTrqDemandGbxTo_ADebOk_C "DDRC/Dauer der Heilungsentprellung für Prüfung DFC_ComTrqDemandGbxTo_A" VALUE 0x80022ACC Val_Wu16 655350.0 DDRCTime_ms 0.00 655350.0 /end CHARACTERISTIC
/begin CHARACTERISTIC DDRC_DurDeb.Com_tiTrqDemandGbxTo_ADebDef_C "DDRC/Dauer der Fehlerentprellung für Prüfung DFC_ComTrqDemandGbxTo_A" VALUE 0x80022ACE Val_Wu16 655350.0 DDRCTime_ms 0.00 655350.0 /end CHARACTERISTIC
/begin CHARACTERISTIC DDRC_DurDeb.Com_tiTrqWhlDemFASChk_FXDebOk_C "DDRC/Dauer der Heilungsentprellung für Prüfung DFC_ComTrqWhlDemFASChk_FX" VALUE 0x80022AD0 Val_Wu16 655350.0 DDRCTime_ms 0.00 655350.0 /end CHARACTERISTIC
/begin CHARACTERISTIC DDRC_DurDeb.Com_tiTrqWhlDemFASChk_FXDebDef_C "DDRC/Dauer der Fehlerentprellung für Prüfung DFC_ComTrqWhlDemFASChk_FX" VALUE 0x80022AD2 Val_Wu16 655350.0 DDRCTime_ms 0.00 655350.0 /end CHARACTERISTIC
/begin CHARACTERISTIC DDRC_DurDeb.AirCtl_tiGovLPDvtMaxDebOk_C "DDRC/Dauer der Heilungsentprellung für Prüfung DFC_AirCtlGovLPDvtMax" VALUE 0x80022AD4 Val_Wu16 655350.0 DDRCTime_ms 0.00 655350.0 /end CHARACTERISTIC
/begin CHARACTERISTIC DDRC_DurDeb.AirCtl_tiGovLPDvtMaxDebDef_C "DDRC/Dauer der Fehlerentprellung für Prüfung DFC_AirCtlGovLPDvtMax" VALUE 0x80022AD6 Val_Wu16 655350.0 DDRCTime_ms 0.00 655350.0 /end CHARACTERISTIC
/begin CHARACTERISTIC DDRC_DurDeb.PCR_tiGovDvtMaxDebOk_C "DDRC/Dauer der Heilungsentprellung für Prüfung DFC_PCRGovDvtMax" VALUE 0x80022AD8 Val_Wu16 655350.0 DDRCTime_ms 0.00 655350.0 /end CHARACTERISTIC
/begin CHARACTERISTIC DDRC_DurDeb.PCR_tiGovDvtMaxDebDef_C "DDRC/Dauer der Fehlerentprellung für Prüfung DFC_PCRGovDvtMax" VALUE 0x80022ADA Val_Wu16 655350.0 DDRCTime_ms 0.00 655350.0 /end CHARACTERISTIC
/begin CHARACTERISTIC DDRC_DurDeb.Lub_tiOilFldtCritDebOk_C "DDRC/Dauer der Heilungsentprellung für Prüfung DFC_LubSRCOilFldtCrit" VALUE 0x80022ADC Val_Wu16 655350.0 DDRCTime_ms 0.00 655350.0 /end CHARACTERISTIC
/begin CHARACTERISTIC DDRC_DurDeb.Lub_tiOilFldtCritDebDef_C "DDRC/Dauer der Fehlerentprellung für Prüfung DFC_LubSRCOilFldtCrit" VALUE 0x80022ADE Val_Wu16 655350.0 DDRCTime_ms 0.00 655350.0 /end CHARACTERISTIC
/begin CHARACTERISTIC DDRC_DurDeb.PCR_tiGovDvtLPMinDebOk_C "DDRC/Dauer der Heilungsentprellung für Prüfung DFC_PCRGovDvtLPMin" VALUE 0x80022AE0 Val_Wu16 655350.0 DDRCTime_ms 0.00 655350.0 /end CHARACTERISTIC
/begin CHARACTERISTIC DDRC_DurDeb.PCR_tiGovDvtLPMinDebDef_C "DDRC/Dauer der Fehlerentprellung für Prüfung DFC_PCRGovDvtLPMin" VALUE 0x80022AE2 Val_Wu16 655350.0 DDRCTime_ms 0.00 655350.0 /end CHARACTERISTIC
/begin CHARACTERISTIC DDRC_DurDeb.GlwEcu_tiConfigErrDebOk_C "DDRC/Dauer der Heilungsentprellung für Prüfung DFC_GlwEcuConfigErr" VALUE 0x80022AE4 Val_Wu16 655350.0 DDRCTime_ms 0.00 655350.0 /end CHARACTERISTIC
/begin CHARACTERISTIC DDRC_DurDeb.GlwEcu_tiConfigErrDebDef_C "DDRC/Dauer der Fehlerentprellung für Prüfung DFC_GlwEcuConfigErr" VALUE 0x80022AE6 Val_Wu16 655350.0 DDRCTime_ms 0.00 655350.0 /end CHARACTERISTIC
/begin CHARACTERISTIC DDRC_DurDeb.ETCtl_tiDvtOutrMinDebOk_C "DDRC/Dauer der Heilungsentprellung für Prüfung DFC_ETCtlDvtOutrMin" VALUE 0x80022AE8 Val_Wu16 655350.0 DDRCTime_ms 0.00 655350.0 /end CHARACTERISTIC
/begin CHARACTERISTIC DDRC_DurDeb.ETCtl_tiDvtOutrMinDebDef_C "DDRC/Dauer der Fehlerentprellung für Prüfung DFC_ETCtlDvtOutrMin" VALUE 0x80022AEA Val_Wu16 655350.0 DDRCTime_ms 0.00 655350.0 /end CHARACTERISTIC
/begin CHARACTERISTIC DDRC_DurDeb.Com_tiGbxDataCtr_ADebOk_C "DDRC/Dauer der Heilungsentprellung für Prüfung DFC_ComGbxDataCtr_A" VALUE 0x80022AEC Val_Wu16 655350.0 DDRCTime_ms 0.00 655350.0 /end CHARACTERISTIC
/begin CHARACTERISTIC DDRC_DurDeb.Com_tiGbxDataCtr_ADebDef_C "DDRC/Dauer der Fehlerentprellung für Prüfung DFC_ComGbxDataCtr_A" VALUE 0x80022AEE Val_Wu16 655350.0 DDRCTime_ms 0.00 655350.0 /end CHARACTERISTIC
/begin CHARACTERISTIC DDRC_DurDeb.TrbCh_ti4WinErr1DebOk_C "DDRC/Dauer der Heilungsentprellung für Prüfung DFC_TrbCh4WinErr1" VALUE 0x80022AF0 Val_Wu16 655350.0 DDRCTime_ms 0.00 655350.0 /end CHARACTERISTIC
/begin CHARACTERISTIC DDRC_DurDeb.TrbCh_ti4WinErr1DebDef_C "DDRC/Dauer der Fehlerentprellung für Prüfung DFC_TrbCh4WinErr1" VALUE 0x80022AF2 Val_Wu16 655350.0 DDRCTime_ms 0.00 655350.0 /end CHARACTERISTIC
/begin CHARACTERISTIC DDRC_DurDeb.Com_tiCrCtlLvrToDebOk_C "DDRC/Dauer der Heilungsentprellung für Prüfung DFC_ComCrCtlLvrTo" VALUE 0x80022AF4 Val_Wu16 655350.0 DDRCTime_ms 0.00 655350.0 /end CHARACTERISTIC
/begin CHARACTERISTIC DDRC_DurDeb.Com_tiCrCtlLvrToDebDef_C "DDRC/Dauer der Fehlerentprellung für Prüfung DFC_ComCrCtlLvrTo" VALUE 0x80022AF6 Val_Wu16 655350.0 DDRCTime_ms 0.00 655350.0 /end CHARACTERISTIC
/begin CHARACTERISTIC DDRC_DurDeb.Com_tiTrailerSigDebOk_C "DDRC/Dauer der Heilungsentprellung für Prüfung DFC_ComTrailerSig" VALUE 0x80022AF8 Val_Wu16 655350.0 DDRCTime_ms 0.00 655350.0 /end CHARACTERISTIC
/begin CHARACTERISTIC DDRC_DurDeb.Com_tiTrailerSigDebDef_C "DDRC/Dauer der Fehlerentprellung für Prüfung DFC_ComTrailerSig" VALUE 0x80022AFA Val_Wu16 655350.0 DDRCTime_ms 0.00 655350.0 /end CHARACTERISTIC
/begin CHARACTERISTIC DDRC_DurDeb.Com_tiShutOffPSPSigDebOk_C "DDRC/Dauer der Heilungsentprellung für Prüfung DFC_ComShutOffPSPSig" VALUE 0x80022AFC Val_Wu16 655350.0 DDRCTime_ms 0.00 655350.0 /end CHARACTERISTIC
/begin CHARACTERISTIC DDRC_DurDeb.Com_tiShutOffPSPSigDebDef_C "DDRC/Dauer der Fehlerentprellung für Prüfung DFC_ComShutOffPSPSig" VALUE 0x80022AFE Val_Wu16 655350.0 DDRCTime_ms 0.00 655350.0 /end CHARACTERISTIC
/begin CHARACTERISTIC DDRC_DurDeb.Com_tiCrCtlLvrCtrDebOk_C "DDRC/Dauer der Heilungsentprellung für Prüfung DFC_ComCrCtlLvrCtr" VALUE 0x80022B00 Val_Wu16 655350.0 DDRCTime_ms 0.00 655350.0 /end CHARACTERISTIC
/begin CHARACTERISTIC DDRC_DurDeb.Com_tiCrCtlLvrCtrDebDef_C "DDRC/Dauer der Fehlerentprellung für Prüfung DFC_ComCrCtlLvrCtr" VALUE 0x80022B02 Val_Wu16 655350.0 DDRCTime_ms 0.00 655350.0 /end CHARACTERISTIC
/begin CHARACTERISTIC DDRC_DurDeb.PFlt_tiPFltAPSPlausMAXDebOk_C "DDRC/Dauer der Heilungsentprellung für Prüfung DFC_PFltAPSPlausMAX" VALUE 0x80022B04 Val_Wu16 655350.0 DDRCTime_ms 0.00 655350.0 /end CHARACTERISTIC
/begin CHARACTERISTIC DDRC_DurDeb.PFlt_tiPFltAPSPlausMAXDebDef_C "DDRC/Dauer der Fehlerentprellung für Prüfung DFC_PFltAPSPlausMAX" VALUE 0x80022B06 Val_Wu16 655350.0 DDRCTime_ms 0.00 655350.0 /end CHARACTERISTIC
/begin CHARACTERISTIC DDRC_DurDeb.MonUMaxSupply1DebOk_C "DDRC/Dauer der Heilungsentprellung für Prüfung DFC_MonUMaxSupply1" VALUE 0x80022B08 Val_Wu16 655350.0 DDRCTime_ms 0.00 655350.0 /end CHARACTERISTIC
/begin CHARACTERISTIC DDRC_DurDeb.MonUMaxSupply1DebDef_C "DDRC/Dauer der Fehlerentprellung für Prüfung DFC_MonUMaxSupply1" VALUE 0x80022B0A Val_Wu16 655350.0 DDRCTime_ms 0.00 655350.0 /end CHARACTERISTIC
/begin CHARACTERISTIC DDRC_DurDeb.Com_tiKlemmenChk_FADebOk_C "DDRC/Dauer der Heilungsentprellung für Prüfung DFC_ComKlemmenChk_FA" VALUE 0x80022B0C Val_Wu16 655350.0 DDRCTime_ms 0.00 655350.0 /end CHARACTERISTIC
/begin CHARACTERISTIC DDRC_DurDeb.Com_tiKlemmenChk_FADebDef_C "DDRC/Dauer der Fehlerentprellung für Prüfung DFC_ComKlemmenChk_FA" VALUE 0x80022B0E Val_Wu16 655350.0 DDRCTime_ms 0.00 655350.0 /end CHARACTERISTIC
/begin CHARACTERISTIC DDRC_DurDeb.Com_tiSteeringAngleTo_FXDebOk_C "DDRC/Dauer der Heilungsentprellung für Prüfung DFC_ComSteeringAngleTo_FX" VALUE 0x80022B10 Val_Wu16 655350.0 DDRCTime_ms 0.00 655350.0 /end CHARACTERISTIC
/begin CHARACTERISTIC DDRC_DurDeb.Com_tiSteeringAngleTo_FXDebDef_C "DDRC/Dauer der Fehlerentprellung für Prüfung DFC_ComSteeringAngleTo_FX" VALUE 0x80022B12 Val_Wu16 655350.0 DDRCTime_ms 0.00 655350.0 /end CHARACTERISTIC
/begin CHARACTERISTIC DDRC_DurDeb.Com_tiBrkTrqSumTo_FXDebOk_C "DDRC/Dauer der Heilungsentprellung für Prüfung DFC_ComBrkTrqSumTo_FX" VALUE 0x80022B14 Val_Wu16 655350.0 DDRCTime_ms 0.00 655350.0 /end CHARACTERISTIC
/begin CHARACTERISTIC DDRC_DurDeb.Com_tiBrkTrqSumTo_FXDebDef_C "DDRC/Dauer der Fehlerentprellung für Prüfung DFC_ComBrkTrqSumTo_FX" VALUE 0x80022B16 Val_Wu16 655350.0 DDRCTime_ms 0.00 655350.0 /end CHARACTERISTIC
/begin CHARACTERISTIC DDRC_DurDeb.Com_tiStatusEMFToDebOk_C "DDRC/Dauer der Heilungsentprellung für Prüfung DFC_ComStatusEMFTo" VALUE 0x80022B18 Val_Wu16 655350.0 DDRCTime_ms 0.00 655350.0 /end CHARACTERISTIC
/begin CHARACTERISTIC DDRC_DurDeb.Com_tiStatusEMFToDebDef_C "DDRC/Dauer der Fehlerentprellung für Prüfung DFC_ComStatusEMFTo" VALUE 0x80022B1A Val_Wu16 655350.0 DDRCTime_ms 0.00 655350.0 /end CHARACTERISTIC
/begin CHARACTERISTIC DDRC_DurDeb.PFlt_tiPreNplDebOk_C "DDRC/Dauer der Heilungsentprellung für Prüfung DFC_PFlt_tPreNpl" VALUE 0x80022B1C Val_Wu16 655350.0 DDRCTime_ms 0.00 655350.0 /end CHARACTERISTIC
/begin CHARACTERISTIC DDRC_DurDeb.PFlt_tiPreNplDebDef_C "DDRC/Dauer der Fehlerentprellung für Prüfung DFC_PFlt_tPreNpl" VALUE 0x80022B1E Val_Wu16 655350.0 DDRCTime_ms 0.00 655350.0 /end CHARACTERISTIC
/begin CHARACTERISTIC DDRC_DurDeb.Com_tiStatZVKlappenSig_FADebOk_C "DDRC/Dauer der Heilungsentprellung für Prüfung DFC_ComStatZVKlappenSig_FA" VALUE 0x80022B20 Val_Wu16 655350.0 DDRCTime_ms 0.00 655350.0 /end CHARACTERISTIC
/begin CHARACTERISTIC DDRC_DurDeb.Com_tiStatZVKlappenSig_FADebDef_C "DDRC/Dauer der Fehlerentprellung für Prüfung DFC_ComStatZVKlappenSig_FA" VALUE 0x80022B22 Val_Wu16 655350.0 DDRCTime_ms 0.00 655350.0 /end CHARACTERISTIC
/begin CHARACTERISTIC DDRC_DurDeb.Com_tiFahrzeugtypSigDebOk_C "DDRC/Dauer der Heilungsentprellung für Prüfung DFC_ComFahrzeugtypSig" VALUE 0x80022B24 Val_Wu16 655350.0 DDRCTime_ms 0.00 655350.0 /end CHARACTERISTIC
/begin CHARACTERISTIC DDRC_DurDeb.Com_tiFahrzeugtypSigDebDef_C "DDRC/Dauer der Fehlerentprellung für Prüfung DFC_ComFahrzeugtypSig" VALUE 0x80022B26 Val_Wu16 655350.0 DDRCTime_ms 0.00 655350.0 /end CHARACTERISTIC
/begin CHARACTERISTIC DDRC_DurDeb.Rail_tiMeUn5DebOk_C "DDRC/Dauer der Heilungsentprellung für Prüfung DFC_RailMeUn5" VALUE 0x80022B28 Val_Wu16 655350.0 DDRCTime_ms 0.00 655350.0 /end CHARACTERISTIC
/begin CHARACTERISTIC DDRC_DurDeb.Rail_tiMeUn5DebDef_C "DDRC/Dauer der Fehlerentprellung für Prüfung DFC_RailMeUn5" VALUE 0x80022B2A Val_Wu16 655350.0 DDRCTime_ms 0.00 655350.0 /end CHARACTERISTIC
/begin CHARACTERISTIC DDRC_DurDeb.AirCtl_tiGovLPDvtMinDebOk_C "DDRC/Dauer der Heilungsentprellung für Prüfung DFC_AirCtlGovLPDvtMin" VALUE 0x80022B2C Val_Wu16 655350.0 DDRCTime_ms 0.00 655350.0 /end CHARACTERISTIC
/begin CHARACTERISTIC DDRC_DurDeb.AirCtl_tiGovLPDvtMinDebDef_C "DDRC/Dauer der Fehlerentprellung für Prüfung DFC_AirCtlGovLPDvtMin" VALUE 0x80022B2E Val_Wu16 655350.0 DDRCTime_ms 0.00 655350.0 /end CHARACTERISTIC
/begin CHARACTERISTIC DDRC_DurDeb.Com_tiStatusRGangSigDebOk_C "DDRC/Dauer der Heilungsentprellung für Prüfung DFC_ComStatusRGangSig" VALUE 0x80022B30 Val_Wu16 655350.0 DDRCTime_ms 0.00 655350.0 /end CHARACTERISTIC
/begin CHARACTERISTIC DDRC_DurDeb.Com_tiStatusRGangSigDebDef_C "DDRC/Dauer der Fehlerentprellung für Prüfung DFC_ComStatusRGangSig" VALUE 0x80022B32 Val_Wu16 655350.0 DDRCTime_ms 0.00 655350.0 /end CHARACTERISTIC
/begin CHARACTERISTIC DDRC_DurDeb.PFlt_tiOxiPreNplDebOk_C "DDRC/Dauer der Heilungsentprellung für Prüfung DFC_PFlt_tOxiPreNpl" VALUE 0x80022B34 Val_Wu16 655350.0 DDRCTime_ms 0.00 655350.0 /end CHARACTERISTIC
/begin CHARACTERISTIC DDRC_DurDeb.PFlt_tiOxiPreNplDebDef_C "DDRC/Dauer der Fehlerentprellung für Prüfung DFC_PFlt_tOxiPreNpl" VALUE 0x80022B36 Val_Wu16 655350.0 DDRCTime_ms 0.00 655350.0 /end CHARACTERISTIC
/begin CHARACTERISTIC DDRC_DurDeb.Com_tiStateARSToDebOk_C "DDRC/Dauer der Heilungsentprellung für Prüfung DFC_ComStateARSTo" VALUE 0x80022B38 Val_Wu16 655350.0 DDRCTime_ms 0.00 655350.0 /end CHARACTERISTIC
/begin CHARACTERISTIC DDRC_DurDeb.Com_tiStateARSToDebDef_C "DDRC/Dauer der Fehlerentprellung für Prüfung DFC_ComStateARSTo" VALUE 0x80022B3A Val_Wu16 655350.0 DDRCTime_ms 0.00 655350.0 /end CHARACTERISTIC
/begin CHARACTERISTIC DDRC_DurDeb.Com_tiStateDscToDebOk_C "DDRC/Dauer der Heilungsentprellung für Prüfung DFC_ComStateDscTo" VALUE 0x80022B3C Val_Wu16 655350.0 DDRCTime_ms 0.00 655350.0 /end CHARACTERISTIC
/begin CHARACTERISTIC DDRC_DurDeb.Com_tiStateDscToDebDef_C "DDRC/Dauer der Fehlerentprellung für Prüfung DFC_ComStateDscTo" VALUE 0x80022B3E Val_Wu16 655350.0 DDRCTime_ms 0.00 655350.0 /end CHARACTERISTIC
/begin CHARACTERISTIC DDRC_DurDeb.Com_tiTerminalToDebOk_C "DDRC/Dauer der Heilungsentprellung für Prüfung DFC_ComTerminalTo" VALUE 0x80022B40 Val_Wu16 655350.0 DDRCTime_ms 0.00 655350.0 /end CHARACTERISTIC
/begin CHARACTERISTIC DDRC_DurDeb.Com_tiTerminalToDebDef_C "DDRC/Dauer der Fehlerentprellung für Prüfung DFC_ComTerminalTo" VALUE 0x80022B42 Val_Wu16 655350.0 DDRCTime_ms 0.00 655350.0 /end CHARACTERISTIC
/begin CHARACTERISTIC DDRC_DurDeb.Rail_tiPCV1DebOk_C "DDRC/Dauer der Heilungsentprellung für Prüfung DFC_RailPCV1" VALUE 0x80022B44 Val_Wu16 655350.0 DDRCTime_ms 0.00 655350.0 /end CHARACTERISTIC
/begin CHARACTERISTIC DDRC_DurDeb.Rail_tiPCV1DebDef_C "DDRC/Dauer der Fehlerentprellung für Prüfung DFC_RailPCV1" VALUE 0x80022B46 Val_Wu16 655350.0 DDRCTime_ms 0.00 655350.0 /end CHARACTERISTIC
/begin CHARACTERISTIC DDRC_DurDeb.Com_tiStateSeatSigDebOk_C "DDRC/Dauer der Heilungsentprellung für Prüfung DFC_ComStateSeatSig" VALUE 0x80022B48 Val_Wu16 655350.0 DDRCTime_ms 0.00 655350.0 /end CHARACTERISTIC
/begin CHARACTERISTIC DDRC_DurDeb.Com_tiStateSeatSigDebDef_C "DDRC/Dauer der Fehlerentprellung für Prüfung DFC_ComStateSeatSig" VALUE 0x80022B4A Val_Wu16 655350.0 DDRCTime_ms 0.00 655350.0 /end CHARACTERISTIC
/begin CHARACTERISTIC DDRC_DurDeb.Com_tiStConintDSCCtr_FXDebOk_C "DDRC/Dauer der Heilungsentprellung für Prüfung DFC_ComStConintDSCCtr_FX" VALUE 0x80022B4C Val_Wu16 655350.0 DDRCTime_ms 0.00 655350.0 /end CHARACTERISTIC
/begin CHARACTERISTIC DDRC_DurDeb.Com_tiStConintDSCCtr_FXDebDef_C "DDRC/Dauer der Fehlerentprellung für Prüfung DFC_ComStConintDSCCtr_FX" VALUE 0x80022B4E Val_Wu16 655350.0 DDRCTime_ms 0.00 655350.0 /end CHARACTERISTIC
/begin CHARACTERISTIC DDRC_DurDeb.Com_tiStateARSCtrDebOk_C "DDRC/Dauer der Heilungsentprellung für Prüfung DFC_ComStateARSCtr" VALUE 0x80022B50 Val_Wu16 655350.0 DDRCTime_ms 0.00 655350.0 /end CHARACTERISTIC
/begin CHARACTERISTIC DDRC_DurDeb.Com_tiStateARSCtrDebDef_C "DDRC/Dauer der Fehlerentprellung für Prüfung DFC_ComStateARSCtr" VALUE 0x80022B52 Val_Wu16 655350.0 DDRCTime_ms 0.00 655350.0 /end CHARACTERISTIC
/begin CHARACTERISTIC DDRC_DurDeb.Com_tiTrqDemandDscSigDebOk_C "DDRC/Dauer der Heilungsentprellung für Prüfung DFC_ComTrqDemandDscSig" VALUE 0x80022B54 Val_Wu16 655350.0 DDRCTime_ms 0.00 655350.0 /end CHARACTERISTIC
/begin CHARACTERISTIC DDRC_DurDeb.Com_tiTrqDemandDscSigDebDef_C "DDRC/Dauer der Fehlerentprellung für Prüfung DFC_ComTrqDemandDscSig" VALUE 0x80022B56 Val_Wu16 655350.0 DDRCTime_ms 0.00 655350.0 /end CHARACTERISTIC
/begin CHARACTERISTIC DDRC_DurDeb.Com_tiWheelSpeedSigDebOk_C "DDRC/Dauer der Heilungsentprellung für Prüfung DFC_ComWheelSpeedSig" VALUE 0x80022B58 Val_Wu16 655350.0 DDRCTime_ms 0.00 655350.0 /end CHARACTERISTIC
/begin CHARACTERISTIC DDRC_DurDeb.Com_tiWheelSpeedSigDebDef_C "DDRC/Dauer der Fehlerentprellung für Prüfung DFC_ComWheelSpeedSig" VALUE 0x80022B5A Val_Wu16 655350.0 DDRCTime_ms 0.00 655350.0 /end CHARACTERISTIC
/begin CHARACTERISTIC DDRC_DurDeb.Com_tiTrailerTo_FADebOk_C "DDRC/Dauer der Heilungsentprellung für Prüfung DFC_ComTrailerTo_FA" VALUE 0x80022B5C Val_Wu16 655350.0 DDRCTime_ms 0.00 655350.0 /end CHARACTERISTIC
/begin CHARACTERISTIC DDRC_DurDeb.Com_tiTrailerTo_FADebDef_C "DDRC/Dauer der Fehlerentprellung für Prüfung DFC_ComTrailerTo_FA" VALUE 0x80022B5E Val_Wu16 655350.0 DDRCTime_ms 0.00 655350.0 /end CHARACTERISTIC
/begin CHARACTERISTIC DDRC_DurDeb.Com_tiTrqWhlDemChkDebOk_C "DDRC/Dauer der Heilungsentprellung für Prüfung DFC_ComTrqWhlDemChk" VALUE 0x80022B60 Val_Wu16 655350.0 DDRCTime_ms 0.00 655350.0 /end CHARACTERISTIC
/begin CHARACTERISTIC DDRC_DurDeb.Com_tiTrqWhlDemChkDebDef_C "DDRC/Dauer der Fehlerentprellung für Prüfung DFC_ComTrqWhlDemChk" VALUE 0x80022B62 Val_Wu16 655350.0 DDRCTime_ms 0.00 655350.0 /end CHARACTERISTIC
/begin CHARACTERISTIC DDRC_DurDeb.WaHtEl_ti4WinErr2DebOk_C "DDRC/Dauer der Heilungsentprellung für Prüfung DFC_WaHtEl4WinErr2" VALUE 0x80022B64 Val_Wu16 655350.0 DDRCTime_ms 0.00 655350.0 /end CHARACTERISTIC
/begin CHARACTERISTIC DDRC_DurDeb.WaHtEl_ti4WinErr2DebDef_C "DDRC/Dauer der Fehlerentprellung für Prüfung DFC_WaHtEl4WinErr2" VALUE 0x80022B66 Val_Wu16 655350.0 DDRCTime_ms 0.00 655350.0 /end CHARACTERISTIC
/begin CHARACTERISTIC DDRC_DurDeb.FlFCBS_tiLThresDebOk_C "DDRC/Dauer der Heilungsentprellung für Prüfung DFC_FlFCBS" VALUE 0x80022B68 Val_Wu16 655350.0 DDRCTime_ms 0.00 655350.0 /end CHARACTERISTIC
/begin CHARACTERISTIC DDRC_DurDeb.FlFCBS_tiLThresDebDef_C "DDRC/Dauer der Fehlerentprellung für Prüfung DFC_FlFCBS" VALUE 0x80022B6A Val_Wu16 655350.0 DDRCTime_ms 0.00 655350.0 /end CHARACTERISTIC
/begin CHARACTERISTIC DDRC_DurDeb.GlwEcu_tiEepErrDebOk_C "DDRC/Dauer der Heilungsentprellung für Prüfung DFC_GlwEcuEepErr" VALUE 0x80022B6C Val_Wu16 655350.0 DDRCTime_ms 0.00 655350.0 /end CHARACTERISTIC
/begin CHARACTERISTIC DDRC_DurDeb.GlwEcu_tiEepErrDebDef_C "DDRC/Dauer der Fehlerentprellung für Prüfung DFC_GlwEcuEepErr" VALUE 0x80022B6E Val_Wu16 655350.0 DDRCTime_ms 0.00 655350.0 /end CHARACTERISTIC
/begin CHARACTERISTIC DDRC_DurDeb.Com_tiStatusEMFSigDebOk_C "DDRC/Dauer der Heilungsentprellung für Prüfung DFC_ComStatusEMFSig" VALUE 0x80022B70 Val_Wu16 655350.0 DDRCTime_ms 0.00 655350.0 /end CHARACTERISTIC
/begin CHARACTERISTIC DDRC_DurDeb.Com_tiStatusEMFSigDebDef_C "DDRC/Dauer der Fehlerentprellung für Prüfung DFC_ComStatusEMFSig" VALUE 0x80022B72 Val_Wu16 655350.0 DDRCTime_ms 0.00 655350.0 /end CHARACTERISTIC
/begin CHARACTERISTIC DDRC_DurDeb.CJ945_tiSpiCommErrorDebOk_C "DDRC/Dauer der Heilungsentprellung für Prüfung DFC_Cj945SpiCom1" VALUE 0x80022B74 Val_Wu16 655350.0 DDRCTime_ms 0.00 655350.0 /end CHARACTERISTIC
/begin CHARACTERISTIC DDRC_DurDeb.CJ945_tiSpiCommErrorDebDef_C "DDRC/Dauer der Fehlerentprellung für Prüfung DFC_Cj945SpiCom1" VALUE 0x80022B76 Val_Wu16 655350.0 DDRCTime_ms 0.00 655350.0 /end CHARACTERISTIC
/begin CHARACTERISTIC DDRC_DurDeb.Com_tiStatusEGSSig_ADebOk_C "DDRC/Dauer der Heilungsentprellung für Prüfung DFC_ComStatusEGSSig_A" VALUE 0x80022B78 Val_Wu16 655350.0 DDRCTime_ms 0.00 655350.0 /end CHARACTERISTIC
/begin CHARACTERISTIC DDRC_DurDeb.Com_tiStatusEGSSig_ADebDef_C "DDRC/Dauer der Fehlerentprellung für Prüfung DFC_ComStatusEGSSig_A" VALUE 0x80022B7A Val_Wu16 655350.0 DDRCTime_ms 0.00 655350.0 /end CHARACTERISTIC
/begin CHARACTERISTIC DDRC_DurDeb.TrbCh_ti4WinErr2DebOk_C "DDRC/Dauer der Heilungsentprellung für Prüfung DFC_TrbCh4WinErr2" VALUE 0x80022B7C Val_Wu16 655350.0 DDRCTime_ms 0.00 655350.0 /end CHARACTERISTIC
/begin CHARACTERISTIC DDRC_DurDeb.TrbCh_ti4WinErr2DebDef_C "DDRC/Dauer der Fehlerentprellung für Prüfung DFC_TrbCh4WinErr2" VALUE 0x80022B7E Val_Wu16 655350.0 DDRCTime_ms 0.00 655350.0 /end CHARACTERISTIC
/begin CHARACTERISTIC DDRC_DurDeb.Com_tiStatZVKlappenTo_FADebOk_C "DDRC/Dauer der Heilungsentprellung für Prüfung DFC_ComStatZVKlappenTo_FA" VALUE 0x80022B80 Val_Wu16 655350.0 DDRCTime_ms 0.00 655350.0 /end CHARACTERISTIC
/begin CHARACTERISTIC DDRC_DurDeb.Com_tiStatZVKlappenTo_FADebDef_C "DDRC/Dauer der Fehlerentprellung für Prüfung DFC_ComStatZVKlappenTo_FA" VALUE 0x80022B82 Val_Wu16 655350.0 DDRCTime_ms 0.00 655350.0 /end CHARACTERISTIC
/begin CHARACTERISTIC DDRC_DurDeb.Com_tiWMomPTStabChk_FXDebOk_C "DDRC/Dauer der Heilungsentprellung für Prüfung DFC_ComWMomPTStabChk_FX" VALUE 0x80022B84 Val_Wu16 655350.0 DDRCTime_ms 0.00 655350.0 /end CHARACTERISTIC
/begin CHARACTERISTIC DDRC_DurDeb.Com_tiWMomPTStabChk_FXDebDef_C "DDRC/Dauer der Fehlerentprellung für Prüfung DFC_ComWMomPTStabChk_FX" VALUE 0x80022B86 Val_Wu16 655350.0 DDRCTime_ms 0.00 655350.0 /end CHARACTERISTIC
/begin CHARACTERISTIC DDRC_DurDeb.Lub_tiOilLvlCritMaxDebOk_C "DDRC/Dauer der Heilungsentprellung für Prüfung DFC_LubSRCOilLvlCritMax" VALUE 0x80022B88 Val_Wu16 655350.0 DDRCTime_ms 0.00 655350.0 /end CHARACTERISTIC
/begin CHARACTERISTIC DDRC_DurDeb.Lub_tiOilLvlCritMaxDebDef_C "DDRC/Dauer der Fehlerentprellung für Prüfung DFC_LubSRCOilLvlCritMax" VALUE 0x80022B8A Val_Wu16 655350.0 DDRCTime_ms 0.00 655350.0 /end CHARACTERISTIC
/begin CHARACTERISTIC DDRC_DurDeb.Com_tiTrqDemandDscChkDebOk_C "DDRC/Dauer der Heilungsentprellung für Prüfung DFC_ComTrqDemandDscChk" VALUE 0x80022B8C Val_Wu16 655350.0 DDRCTime_ms 0.00 655350.0 /end CHARACTERISTIC
/begin CHARACTERISTIC DDRC_DurDeb.Com_tiTrqDemandDscChkDebDef_C "DDRC/Dauer der Fehlerentprellung für Prüfung DFC_ComTrqDemandDscChk" VALUE 0x80022B8E Val_Wu16 655350.0 DDRCTime_ms 0.00 655350.0 /end CHARACTERISTIC
/begin CHARACTERISTIC DDRC_DurDeb.Com_tiGbxDataCtr_FADebOk_C "DDRC/Dauer der Heilungsentprellung für Prüfung DFC_ComGbxDataCtr_FA" VALUE 0x80022B90 Val_Wu16 655350.0 DDRCTime_ms 0.00 655350.0 /end CHARACTERISTIC
/begin CHARACTERISTIC DDRC_DurDeb.Com_tiGbxDataCtr_FADebDef_C "DDRC/Dauer der Fehlerentprellung für Prüfung DFC_ComGbxDataCtr_FA" VALUE 0x80022B92 Val_Wu16 655350.0 DDRCTime_ms 0.00 655350.0 /end CHARACTERISTIC
/begin CHARACTERISTIC DDRC_DurDeb.Com_tiaSideCtr_FXDebOk_C "DDRC/Dauer der Heilungsentprellung für Prüfung DFC_ComaSideCtr_FX" VALUE 0x80022B94 Val_Wu16 655350.0 DDRCTime_ms 0.00 655350.0 /end CHARACTERISTIC
/begin CHARACTERISTIC DDRC_DurDeb.Com_tiaSideCtr_FXDebDef_C "DDRC/Dauer der Fehlerentprellung für Prüfung DFC_ComaSideCtr_FX" VALUE 0x80022B96 Val_Wu16 655350.0 DDRCTime_ms 0.00 655350.0 /end CHARACTERISTIC
/begin CHARACTERISTIC DDRC_DurDeb.Rail_tiCPC3DebOk_C "DDRC/Dauer der Heilungsentprellung für Prüfung DFC_RailCPC3" VALUE 0x80022B98 Val_Wu16 655350.0 DDRCTime_ms 0.00 655350.0 /end CHARACTERISTIC
/begin CHARACTERISTIC DDRC_DurDeb.Rail_tiCPC3DebDef_C "DDRC/Dauer der Fehlerentprellung für Prüfung DFC_RailCPC3" VALUE 0x80022B9A Val_Wu16 655350.0 DDRCTime_ms 0.00 655350.0 /end CHARACTERISTIC
/begin CHARACTERISTIC DDRC_DurDeb.SSpMon1DebOk_C "DDRC/Dauer der Heilungsentprellung für Prüfung DFC_SSpMon1" VALUE 0x80022B9C Val_Wu16 655350.0 DDRCTime_ms 0.00 655350.0 /end CHARACTERISTIC
/begin CHARACTERISTIC DDRC_DurDeb.SSpMon1DebDef_C "DDRC/Dauer der Fehlerentprellung für Prüfung DFC_SSpMon1" VALUE 0x80022B9E Val_Wu16 655350.0 DDRCTime_ms 0.00 655350.0 /end CHARACTERISTIC
/begin CHARACTERISTIC DDRC_DurDeb.PFlt_tiPFltOvldTrqLimDebOk_C "DDRC/Dauer der Heilungsentprellung für Prüfung DFC_PFltOvldTrqLim" VALUE 0x80022BA0 Val_Wu16 655350.0 DDRCTime_ms 0.00 655350.0 /end CHARACTERISTIC
/begin CHARACTERISTIC DDRC_DurDeb.PFlt_tiPFltOvldTrqLimDebDef_C "DDRC/Dauer der Fehlerentprellung für Prüfung DFC_PFltOvldTrqLim" VALUE 0x80022BA2 Val_Wu16 655350.0 DDRCTime_ms 0.00 655350.0 /end CHARACTERISTIC
/begin CHARACTERISTIC DDRC_DurDeb.MonUMinSupply1DebOk_C "DDRC/Dauer der Heilungsentprellung für Prüfung DFC_MonUMinSupply1" VALUE 0x80022BA4 Val_Wu16 655350.0 DDRCTime_ms 0.00 655350.0 /end CHARACTERISTIC
/begin CHARACTERISTIC DDRC_DurDeb.MonUMinSupply1DebDef_C "DDRC/Dauer der Fehlerentprellung für Prüfung DFC_MonUMinSupply1" VALUE 0x80022BA6 Val_Wu16 655350.0 DDRCTime_ms 0.00 655350.0 /end CHARACTERISTIC
/begin CHARACTERISTIC DDRC_DurDeb.Com_tiSteeringAngleChk_FXDebOk_C "DDRC/Dauer der Heilungsentprellung für Prüfung DFC_ComSteeringAngleChk_FX" VALUE 0x80022BA8 Val_Wu16 655350.0 DDRCTime_ms 0.00 655350.0 /end CHARACTERISTIC
/begin CHARACTERISTIC DDRC_DurDeb.Com_tiSteeringAngleChk_FXDebDef_C "DDRC/Dauer der Fehlerentprellung für Prüfung DFC_ComSteeringAngleChk_FX" VALUE 0x80022BAA Val_Wu16 655350.0 DDRCTime_ms 0.00 655350.0 /end CHARACTERISTIC
/begin CHARACTERISTIC DDRC_DurDeb.Com_tiGbxDataSig_ADebOk_C "DDRC/Dauer der Heilungsentprellung für Prüfung DFC_ComGbxDataSig_A" VALUE 0x80022BAC Val_Wu16 655350.0 DDRCTime_ms 0.00 655350.0 /end CHARACTERISTIC
/begin CHARACTERISTIC DDRC_DurDeb.Com_tiGbxDataSig_ADebDef_C "DDRC/Dauer der Fehlerentprellung für Prüfung DFC_ComGbxDataSig_A" VALUE 0x80022BAE Val_Wu16 655350.0 DDRCTime_ms 0.00 655350.0 /end CHARACTERISTIC
/begin CHARACTERISTIC DDRC_DurDeb.Com_tiStatusEGSTo_FADebOk_C "DDRC/Dauer der Heilungsentprellung für Prüfung DFC_ComStatusEGSTo_FA" VALUE 0x80022BB0 Val_Wu16 655350.0 DDRCTime_ms 0.00 655350.0 /end CHARACTERISTIC
/begin CHARACTERISTIC DDRC_DurDeb.Com_tiStatusEGSTo_FADebDef_C "DDRC/Dauer der Fehlerentprellung für Prüfung DFC_ComStatusEGSTo_FA" VALUE 0x80022BB2 Val_Wu16 655350.0 DDRCTime_ms 0.00 655350.0 /end CHARACTERISTIC
/begin CHARACTERISTIC DDRC_DurDeb.Com_tiShiftPaddleTo_FXDebOk_C "DDRC/Dauer der Heilungsentprellung für Prüfung DFC_ComShiftPaddleTo_FX" VALUE 0x80022BB4 Val_Wu16 655350.0 DDRCTime_ms 0.00 655350.0 /end CHARACTERISTIC
/begin CHARACTERISTIC DDRC_DurDeb.Com_tiShiftPaddleTo_FXDebDef_C "DDRC/Dauer der Fehlerentprellung für Prüfung DFC_ComShiftPaddleTo_FX" VALUE 0x80022BB6 Val_Wu16 655350.0 DDRCTime_ms 0.00 655350.0 /end CHARACTERISTIC
/begin CHARACTERISTIC DDRC_DurDeb.Fan_tiSCGDebOk_C "DDRC/Dauer der Heilungsentprellung für Prüfung DFC_FanSCG" VALUE 0x80022BB8 Val_Wu16 655350.0 DDRCTime_ms 0.00 655350.0 /end CHARACTERISTIC
/begin CHARACTERISTIC DDRC_DurDeb.Fan_tiSCGDebDef_C "DDRC/Dauer der Fehlerentprellung für Prüfung DFC_FanSCG" VALUE 0x80022BBA Val_Wu16 655350.0 DDRCTime_ms 0.00 655350.0 /end CHARACTERISTIC
/begin CHARACTERISTIC DDRC_DurDeb.Lub_tiOilFldtCritDflMinDebOk_C "DDRC/Dauer der Heilungsentprellung für Prüfung DFC_LubSRCTot" VALUE 0x80022BBC Val_Wu16 655350.0 DDRCTime_ms 0.00 655350.0 /end CHARACTERISTIC
/begin CHARACTERISTIC DDRC_DurDeb.Lub_tiOilFldtCritDflMinDebDef_C "DDRC/Dauer der Fehlerentprellung für Prüfung DFC_LubSRCTot" VALUE 0x80022BBE Val_Wu16 655350.0 DDRCTime_ms 0.00 655350.0 /end CHARACTERISTIC
/begin CHARACTERISTIC DDRC_DurDeb.GlwEcu_tiGkWdstDebOk_C "DDRC/Dauer der Heilungsentprellung für Prüfung DFC_GlwEcuGk6Wdst" VALUE 0x80022BC0 Val_Wu16 655350.0 DDRCTime_ms 0.00 655350.0 /end CHARACTERISTIC
/begin CHARACTERISTIC DDRC_DurDeb.GlwEcu_tiGkWdstDebDef_C "DDRC/Dauer der Fehlerentprellung für Prüfung DFC_GlwEcuGk6Wdst" VALUE 0x80022BC2 Val_Wu16 655350.0 DDRCTime_ms 0.00 655350.0 /end CHARACTERISTIC
/begin CHARACTERISTIC DDRC_DurDeb.TrbCh_ti4WinErr3DebOk_C "DDRC/Dauer der Heilungsentprellung für Prüfung DFC_TrbCh4WinErr3" VALUE 0x80022BC4 Val_Wu16 655350.0 DDRCTime_ms 0.00 655350.0 /end CHARACTERISTIC
/begin CHARACTERISTIC DDRC_DurDeb.TrbCh_ti4WinErr3DebDef_C "DDRC/Dauer der Fehlerentprellung für Prüfung DFC_TrbCh4WinErr3" VALUE 0x80022BC6 Val_Wu16 655350.0 DDRCTime_ms 0.00 655350.0 /end CHARACTERISTIC
/begin CHARACTERISTIC DDRC_DurDeb.Com_tiRpmWhlTo_FXDebOk_C "DDRC/Dauer der Heilungsentprellung für Prüfung DFC_ComRpmWhlTo_FX" VALUE 0x80022BC8 Val_Wu16 655350.0 DDRCTime_ms 0.00 655350.0 /end CHARACTERISTIC
/begin CHARACTERISTIC DDRC_DurDeb.Com_tiRpmWhlTo_FXDebDef_C "DDRC/Dauer der Fehlerentprellung für Prüfung DFC_ComRpmWhlTo_FX" VALUE 0x80022BCA Val_Wu16 655350.0 DDRCTime_ms 0.00 655350.0 /end CHARACTERISTIC
/begin CHARACTERISTIC DDRC_DurDeb.Com_tiWMomPTStabCtr_FXDebOk_C "DDRC/Dauer der Heilungsentprellung für Prüfung DFC_ComWMomPTStabCtr_FX" VALUE 0x80022BCC Val_Wu16 655350.0 DDRCTime_ms 0.00 655350.0 /end CHARACTERISTIC
/begin CHARACTERISTIC DDRC_DurDeb.Com_tiWMomPTStabCtr_FXDebDef_C "DDRC/Dauer der Fehlerentprellung für Prüfung DFC_ComWMomPTStabCtr_FX" VALUE 0x80022BCE Val_Wu16 655350.0 DDRCTime_ms 0.00 655350.0 /end CHARACTERISTIC
/begin CHARACTERISTIC DDRC_DurDeb.ThrVlv_ti4WinErr2DebOk_C "DDRC/Dauer der Heilungsentprellung für Prüfung DFC_ThrVlv4WinErr2" VALUE 0x80022BD0 Val_Wu16 655350.0 DDRCTime_ms 0.00 655350.0 /end CHARACTERISTIC
/begin CHARACTERISTIC DDRC_DurDeb.ThrVlv_ti4WinErr2DebDef_C "DDRC/Dauer der Fehlerentprellung für Prüfung DFC_ThrVlv4WinErr2" VALUE 0x80022BD2 Val_Wu16 655350.0 DDRCTime_ms 0.00 655350.0 /end CHARACTERISTIC
/begin CHARACTERISTIC DDRC_DurDeb.Com_tiTrqWhlDemToDebOk_C "DDRC/Dauer der Heilungsentprellung für Prüfung DFC_ComTrqWhlDemTo" VALUE 0x80022BD4 Val_Wu16 655350.0 DDRCTime_ms 0.00 655350.0 /end CHARACTERISTIC
/begin CHARACTERISTIC DDRC_DurDeb.Com_tiTrqWhlDemToDebDef_C "DDRC/Dauer der Fehlerentprellung für Prüfung DFC_ComTrqWhlDemTo" VALUE 0x80022BD6 Val_Wu16 655350.0 DDRCTime_ms 0.00 655350.0 /end CHARACTERISTIC
/begin CHARACTERISTIC DDRC_DurDeb.ACCI_tiPlausDebOk_C "DDRC/Dauer der Heilungsentprellung für Prüfung DFC_ACCIPlausTrqDes" VALUE 0x80022BD8 Val_Wu16 655350.0 DDRCTime_ms 0.00 655350.0 /end CHARACTERISTIC
/begin CHARACTERISTIC DDRC_DurDeb.ACCI_tiPlausDebDef_C "DDRC/Dauer der Fehlerentprellung für Prüfung DFC_ACCIPlausTrqDes" VALUE 0x80022BDA Val_Wu16 655350.0 DDRCTime_ms 0.00 655350.0 /end CHARACTERISTIC
/begin CHARACTERISTIC DDRC_DurDeb.ETCtl_tiDvtInrMaxDebOk_C "DDRC/Dauer der Heilungsentprellung für Prüfung DFC_ETCtlDvtInrMax" VALUE 0x80022BDC Val_Wu16 655350.0 DDRCTime_ms 0.00 655350.0 /end CHARACTERISTIC
/begin CHARACTERISTIC DDRC_DurDeb.ETCtl_tiDvtInrMaxDebDef_C "DDRC/Dauer der Fehlerentprellung für Prüfung DFC_ETCtlDvtInrMax" VALUE 0x80022BDE Val_Wu16 655350.0 DDRCTime_ms 0.00 655350.0 /end CHARACTERISTIC
/begin CHARACTERISTIC DDRC_DurDeb.BusDiag_tiBusOffNodeBDebOk_C "DDRC/Dauer der Heilungsentprellung für Prüfung DFC_BusDiagBusOffNodeB" VALUE 0x80022BE0 Val_Wu16 655350.0 DDRCTime_ms 0.00 655350.0 /end CHARACTERISTIC
/begin CHARACTERISTIC DDRC_DurDeb.BusDiag_tiBusOffNodeBDebDef_C "DDRC/Dauer der Fehlerentprellung für Prüfung DFC_BusDiagBusOffNodeB" VALUE 0x80022BE2 Val_Wu16 655350.0 DDRCTime_ms 0.00 655350.0 /end CHARACTERISTIC
/begin CHARACTERISTIC DDRC_DurDeb.Rail_tiMeUn42DebOk_C "DDRC/Dauer der Heilungsentprellung für Prüfung DFC_RailMeUn42" VALUE 0x80022BE4 Val_Wu16 655350.0 DDRCTime_ms 0.00 655350.0 /end CHARACTERISTIC
/begin CHARACTERISTIC DDRC_DurDeb.Rail_tiMeUn42DebDef_C "DDRC/Dauer der Fehlerentprellung für Prüfung DFC_RailMeUn42" VALUE 0x80022BE6 Val_Wu16 655350.0 DDRCTime_ms 0.00 655350.0 /end CHARACTERISTIC
/begin CHARACTERISTIC DDRC_DurDeb.Com_tiTrailerSig_FADebOk_C "DDRC/Dauer der Heilungsentprellung für Prüfung DFC_ComTrailerSig_FA" VALUE 0x80022BE8 Val_Wu16 655350.0 DDRCTime_ms 0.00 655350.0 /end CHARACTERISTIC
/begin CHARACTERISTIC DDRC_DurDeb.Com_tiTrailerSig_FADebDef_C "DDRC/Dauer der Fehlerentprellung für Prüfung DFC_ComTrailerSig_FA" VALUE 0x80022BEA Val_Wu16 655350.0 DDRCTime_ms 0.00 655350.0 /end CHARACTERISTIC
/begin CHARACTERISTIC DDRC_DurDeb.Com_tiButtonMSAToDebOk_C "DDRC/Dauer der Heilungsentprellung für Prüfung DFC_ComButtonMSATo" VALUE 0x80022BEC Val_Wu16 655350.0 DDRCTime_ms 0.00 655350.0 /end CHARACTERISTIC
/begin CHARACTERISTIC DDRC_DurDeb.Com_tiButtonMSAToDebDef_C "DDRC/Dauer der Fehlerentprellung für Prüfung DFC_ComButtonMSATo" VALUE 0x80022BEE Val_Wu16 655350.0 DDRCTime_ms 0.00 655350.0 /end CHARACTERISTIC
/begin CHARACTERISTIC DDRC_DurDeb.PFlt_tiPFltOvldInhRgnDebOk_C "DDRC/Dauer der Heilungsentprellung für Prüfung DFC_PFltOvldInhRgn" VALUE 0x80022BF0 Val_Wu16 655350.0 DDRCTime_ms 0.00 655350.0 /end CHARACTERISTIC
/begin CHARACTERISTIC DDRC_DurDeb.PFlt_tiPFltOvldInhRgnDebDef_C "DDRC/Dauer der Fehlerentprellung für Prüfung DFC_PFltOvldInhRgn" VALUE 0x80022BF2 Val_Wu16 655350.0 DDRCTime_ms 0.00 655350.0 /end CHARACTERISTIC
/begin CHARACTERISTIC DDRC_DurDeb.Lub_tiOilLvlCritMinDebOk_C "DDRC/Dauer der Heilungsentprellung für Prüfung DFC_LubSRCOilLvlCritMin" VALUE 0x80022BF4 Val_Wu16 655350.0 DDRCTime_ms 0.00 655350.0 /end CHARACTERISTIC
/begin CHARACTERISTIC DDRC_DurDeb.Lub_tiOilLvlCritMinDebDef_C "DDRC/Dauer der Fehlerentprellung für Prüfung DFC_LubSRCOilLvlCritMin" VALUE 0x80022BF6 Val_Wu16 655350.0 DDRCTime_ms 0.00 655350.0 /end CHARACTERISTIC
/begin CHARACTERISTIC DDRC_DurDeb.Com_tiATempSig_FADebOk_C "DDRC/Dauer der Heilungsentprellung für Prüfung DFC_ComATempSig_FA" VALUE 0x80022BF8 Val_Wu16 655350.0 DDRCTime_ms 0.00 655350.0 /end CHARACTERISTIC
/begin CHARACTERISTIC DDRC_DurDeb.Com_tiATempSig_FADebDef_C "DDRC/Dauer der Fehlerentprellung für Prüfung DFC_ComATempSig_FA" VALUE 0x80022BFA Val_Wu16 655350.0 DDRCTime_ms 0.00 655350.0 /end CHARACTERISTIC
/begin CHARACTERISTIC DDRC_DurDeb.ACCI_tiDrvAstDebOk_C "DDRC/Dauer der Heilungsentprellung für Prüfung DFC_ACCIPlausDrvAst" VALUE 0x80022BFC Val_Wu16 655350.0 DDRCTime_ms 0.00 655350.0 /end CHARACTERISTIC
/begin CHARACTERISTIC DDRC_DurDeb.ACCI_tiDrvAstDebDef_C "DDRC/Dauer der Fehlerentprellung für Prüfung DFC_ACCIPlausDrvAst" VALUE 0x80022BFE Val_Wu16 655350.0 DDRCTime_ms 0.00 655350.0 /end CHARACTERISTIC
/begin CHARACTERISTIC DDRC_DurDeb.Com_tiBtnDrvDynChk_FXDebOk_C "DDRC/Dauer der Heilungsentprellung für Prüfung DFC_ComBtnDrvDynChk_FX" VALUE 0x80022C00 Val_Wu16 655350.0 DDRCTime_ms 0.00 655350.0 /end CHARACTERISTIC
/begin CHARACTERISTIC DDRC_DurDeb.Com_tiBtnDrvDynChk_FXDebDef_C "DDRC/Dauer der Fehlerentprellung für Prüfung DFC_ComBtnDrvDynChk_FX" VALUE 0x80022C02 Val_Wu16 655350.0 DDRCTime_ms 0.00 655350.0 /end CHARACTERISTIC
/begin CHARACTERISTIC DDRC_DurDeb.PFlt_tiPresPlausDblDefDebOk_C "DDRC/Dauer der Heilungsentprellung für Prüfung DFC_PresPlausDblDef" VALUE 0x80022C04 Val_Wu16 655350.0 DDRCTime_ms 0.00 655350.0 /end CHARACTERISTIC
/begin CHARACTERISTIC DDRC_DurDeb.PFlt_tiPresPlausDblDefDebDef_C "DDRC/Dauer der Fehlerentprellung für Prüfung DFC_PresPlausDblDef" VALUE 0x80022C06 Val_Wu16 655350.0 DDRCTime_ms 0.00 655350.0 /end CHARACTERISTIC
/begin CHARACTERISTIC DDRC_DurDeb.Com_tiWMomPTStabTo_FXDebOk_C "DDRC/Dauer der Heilungsentprellung für Prüfung DFC_ComWMomPTStabTo_FX" VALUE 0x80022C08 Val_Wu16 655350.0 DDRCTime_ms 0.00 655350.0 /end CHARACTERISTIC
/begin CHARACTERISTIC DDRC_DurDeb.Com_tiWMomPTStabTo_FXDebDef_C "DDRC/Dauer der Fehlerentprellung für Prüfung DFC_ComWMomPTStabTo_FX" VALUE 0x80022C0A Val_Wu16 655350.0 DDRCTime_ms 0.00 655350.0 /end CHARACTERISTIC
/begin CHARACTERISTIC DDRC_DurDeb.GlwEcu_tiGkHSSDebOk_C "DDRC/Dauer der Heilungsentprellung für Prüfung DFC_GlwEcuGk6HSS" VALUE 0x80022C0C Val_Wu16 655350.0 DDRCTime_ms 0.00 655350.0 /end CHARACTERISTIC
/begin CHARACTERISTIC DDRC_DurDeb.GlwEcu_tiGkHSSDebDef_C "DDRC/Dauer der Fehlerentprellung für Prüfung DFC_GlwEcuGk6HSS" VALUE 0x80022C0E Val_Wu16 655350.0 DDRCTime_ms 0.00 655350.0 /end CHARACTERISTIC
/begin CHARACTERISTIC DDRC_DurDeb.Fan_ti4WinErr4DebOk_C "DDRC/Dauer der Heilungsentprellung für Prüfung DFC_Fan4WinErr4" VALUE 0x80022C10 Val_Wu16 655350.0 DDRCTime_ms 0.00 655350.0 /end CHARACTERISTIC
/begin CHARACTERISTIC DDRC_DurDeb.Fan_ti4WinErr4DebDef_C "DDRC/Dauer der Fehlerentprellung für Prüfung DFC_Fan4WinErr4" VALUE 0x80022C12 Val_Wu16 655350.0 DDRCTime_ms 0.00 655350.0 /end CHARACTERISTIC
/begin CHARACTERISTIC DDRC_DurDeb.Com_tiWheelSpeedToDebOk_C "DDRC/Dauer der Heilungsentprellung für Prüfung DFC_ComWheelSpeedTo" VALUE 0x80022C14 Val_Wu16 655350.0 DDRCTime_ms 0.00 655350.0 /end CHARACTERISTIC
/begin CHARACTERISTIC DDRC_DurDeb.Com_tiWheelSpeedToDebDef_C "DDRC/Dauer der Fehlerentprellung für Prüfung DFC_ComWheelSpeedTo" VALUE 0x80022C16 Val_Wu16 655350.0 DDRCTime_ms 0.00 655350.0 /end CHARACTERISTIC
/begin CHARACTERISTIC DDRC_DurDeb.AirCtl_tiGovDvtEOMMinDebOk_C "DDRC/Dauer der Heilungsentprellung für Prüfung DFC_AirCtlGovDvtEOMMin" VALUE 0x80022C18 Val_Wu16 655350.0 DDRCTime_ms 0.00 655350.0 /end CHARACTERISTIC
/begin CHARACTERISTIC DDRC_DurDeb.AirCtl_tiGovDvtEOMMinDebDef_C "DDRC/Dauer der Fehlerentprellung für Prüfung DFC_AirCtlGovDvtEOMMin" VALUE 0x80022C1A Val_Wu16 655350.0 DDRCTime_ms 0.00 655350.0 /end CHARACTERISTIC
/begin CHARACTERISTIC DDRC_DurDeb.Com_tiZvKlappenToDebOk_C "DDRC/Dauer der Heilungsentprellung für Prüfung DFC_ComZvKlappenTo" VALUE 0x80022C1C Val_Wu16 655350.0 DDRCTime_ms 0.00 655350.0 /end CHARACTERISTIC
/begin CHARACTERISTIC DDRC_DurDeb.Com_tiZvKlappenToDebDef_C "DDRC/Dauer der Fehlerentprellung für Prüfung DFC_ComZvKlappenTo" VALUE 0x80022C1E Val_Wu16 655350.0 DDRCTime_ms 0.00 655350.0 /end CHARACTERISTIC
/begin CHARACTERISTIC DDRC_DurDeb.Com_tiMileageRangeTo_FADebOk_C "DDRC/Dauer der Heilungsentprellung für Prüfung DFC_ComMileageRangeTo_FA" VALUE 0x80022C20 Val_Wu16 655350.0 DDRCTime_ms 0.00 655350.0 /end CHARACTERISTIC
/begin CHARACTERISTIC DDRC_DurDeb.Com_tiMileageRangeTo_FADebDef_C "DDRC/Dauer der Fehlerentprellung für Prüfung DFC_ComMileageRangeTo_FA" VALUE 0x80022C22 Val_Wu16 655350.0 DDRCTime_ms 0.00 655350.0 /end CHARACTERISTIC
/begin CHARACTERISTIC DDRC_DurDeb.Com_tiFllupGpwsupTo_FADebOk_C "DDRC/Dauer der Heilungsentprellung für Prüfung DFC_ComFllupGpwsupTo_FA" VALUE 0x80022C24 Val_Wu16 655350.0 DDRCTime_ms 0.00 655350.0 /end CHARACTERISTIC
/begin CHARACTERISTIC DDRC_DurDeb.Com_tiFllupGpwsupTo_FADebDef_C "DDRC/Dauer der Fehlerentprellung für Prüfung DFC_ComFllupGpwsupTo_FA" VALUE 0x80022C26 Val_Wu16 655350.0 DDRCTime_ms 0.00 655350.0 /end CHARACTERISTIC
/begin CHARACTERISTIC DDRC_DurDeb.Com_tiKlemmenTo_FADebOk_C "DDRC/Dauer der Heilungsentprellung für Prüfung DFC_ComKlemmenTo_FA" VALUE 0x80022C28 Val_Wu16 655350.0 DDRCTime_ms 0.00 655350.0 /end CHARACTERISTIC
/begin CHARACTERISTIC DDRC_DurDeb.Com_tiKlemmenTo_FADebDef_C "DDRC/Dauer der Fehlerentprellung für Prüfung DFC_ComKlemmenTo_FA" VALUE 0x80022C2A Val_Wu16 655350.0 DDRCTime_ms 0.00 655350.0 /end CHARACTERISTIC
/begin CHARACTERISTIC DDRC_DurDeb.SSpMon2DebOk_C "DDRC/Dauer der Heilungsentprellung für Prüfung DFC_SSpMon2" VALUE 0x80022C2C Val_Wu16 655350.0 DDRCTime_ms 0.00 655350.0 /end CHARACTERISTIC
/begin CHARACTERISTIC DDRC_DurDeb.SSpMon2DebDef_C "DDRC/Dauer der Fehlerentprellung für Prüfung DFC_SSpMon2" VALUE 0x80022C2E Val_Wu16 655350.0 DDRCTime_ms 0.00 655350.0 /end CHARACTERISTIC
/begin CHARACTERISTIC DDRC_DurDeb.Com_tiStatACFrontSig_FADebOk_C "DDRC/Dauer der Heilungsentprellung für Prüfung DFC_ComStatACFrontSig_FA" VALUE 0x80022C30 Val_Wu16 655350.0 DDRCTime_ms 0.00 655350.0 /end CHARACTERISTIC
/begin CHARACTERISTIC DDRC_DurDeb.Com_tiStatACFrontSig_FADebDef_C "DDRC/Dauer der Fehlerentprellung für Prüfung DFC_ComStatACFrontSig_FA" VALUE 0x80022C32 Val_Wu16 655350.0 DDRCTime_ms 0.00 655350.0 /end CHARACTERISTIC
/begin CHARACTERISTIC DDRC_DurDeb.Com_tiStatACFrontTo_FADebOk_C "DDRC/Dauer der Heilungsentprellung für Prüfung DFC_ComStatACFrontTo_FA" VALUE 0x80022C34 Val_Wu16 655350.0 DDRCTime_ms 0.00 655350.0 /end CHARACTERISTIC
/begin CHARACTERISTIC DDRC_DurDeb.Com_tiStatACFrontTo_FADebDef_C "DDRC/Dauer der Fehlerentprellung für Prüfung DFC_ComStatACFrontTo_FA" VALUE 0x80022C36 Val_Wu16 655350.0 DDRCTime_ms 0.00 655350.0 /end CHARACTERISTIC
/begin CHARACTERISTIC DDRC_DurDeb.WaHtEl_ti4WinErr1DebOk_C "DDRC/Dauer der Heilungsentprellung für Prüfung DFC_WaHtEl4WinErr1" VALUE 0x80022C38 Val_Wu16 655350.0 DDRCTime_ms 0.00 655350.0 /end CHARACTERISTIC
/begin CHARACTERISTIC DDRC_DurDeb.WaHtEl_ti4WinErr1DebDef_C "DDRC/Dauer der Fehlerentprellung für Prüfung DFC_WaHtEl4WinErr1" VALUE 0x80022C3A Val_Wu16 655350.0 DDRCTime_ms 0.00 655350.0 /end CHARACTERISTIC
/begin CHARACTERISTIC DDRC_DurDeb.Com_tiSensNOxUbattToDebOk_C "DDRC/Dauer der Heilungsentprellung für Prüfung DFC_ComSensNOxUbattTo" VALUE 0x80022C3C Val_Wu16 655350.0 DDRCTime_ms 0.00 655350.0 /end CHARACTERISTIC
/begin CHARACTERISTIC DDRC_DurDeb.Com_tiSensNOxUbattToDebDef_C "DDRC/Dauer der Fehlerentprellung für Prüfung DFC_ComSensNOxUbattTo" VALUE 0x80022C3E Val_Wu16 655350.0 DDRCTime_ms 0.00 655350.0 /end CHARACTERISTIC
/begin CHARACTERISTIC DDRC_DurDeb.GlwEcu_tiIntErrDebOk_C "DDRC/Dauer der Heilungsentprellung für Prüfung DFC_GlwEcuIntErr" VALUE 0x80022C40 Val_Wu16 655350.0 DDRCTime_ms 0.00 655350.0 /end CHARACTERISTIC
/begin CHARACTERISTIC DDRC_DurDeb.GlwEcu_tiIntErrDebDef_C "DDRC/Dauer der Fehlerentprellung für Prüfung DFC_GlwEcuIntErr" VALUE 0x80022C42 Val_Wu16 655350.0 DDRCTime_ms 0.00 655350.0 /end CHARACTERISTIC
/begin CHARACTERISTIC DDRC_DurDeb.Rail_tiMeUn3DebOk_C "DDRC/Dauer der Heilungsentprellung für Prüfung DFC_RailMeUn3" VALUE 0x80022C44 Val_Wu16 655350.0 DDRCTime_ms 0.00 655350.0 /end CHARACTERISTIC
/begin CHARACTERISTIC DDRC_DurDeb.Rail_tiMeUn3DebDef_C "DDRC/Dauer der Fehlerentprellung für Prüfung DFC_RailMeUn3" VALUE 0x80022C46 Val_Wu16 655350.0 DDRCTime_ms 0.00 655350.0 /end CHARACTERISTIC
/begin CHARACTERISTIC DDRC_DurDeb.Rail_tiPCV4DebOk_C "DDRC/Dauer der Heilungsentprellung für Prüfung DFC_RailPCV4" VALUE 0x80022C48 Val_Wu16 655350.0 DDRCTime_ms 0.00 655350.0 /end CHARACTERISTIC
/begin CHARACTERISTIC DDRC_DurDeb.Rail_tiPCV4DebDef_C "DDRC/Dauer der Fehlerentprellung für Prüfung DFC_RailPCV4" VALUE 0x80022C4A Val_Wu16 655350.0 DDRCTime_ms 0.00 655350.0 /end CHARACTERISTIC
/begin CHARACTERISTIC DDRC_DurDeb.ThrVlv_ti4WinErr1DebOk_C "DDRC/Dauer der Heilungsentprellung für Prüfung DFC_ThrVlv4WinErr1" VALUE 0x80022C4C Val_Wu16 655350.0 DDRCTime_ms 0.00 655350.0 /end CHARACTERISTIC
/begin CHARACTERISTIC DDRC_DurDeb.ThrVlv_ti4WinErr1DebDef_C "DDRC/Dauer der Fehlerentprellung für Prüfung DFC_ThrVlv4WinErr1" VALUE 0x80022C4E Val_Wu16 655350.0 DDRCTime_ms 0.00 655350.0 /end CHARACTERISTIC
/begin CHARACTERISTIC DDRC_DurDeb.Com_tiRpmWhlCtr_FXDebOk_C "DDRC/Dauer der Heilungsentprellung für Prüfung DFC_ComRpmWhlCtr_FX" VALUE 0x80022C50 Val_Wu16 655350.0 DDRCTime_ms 0.00 655350.0 /end CHARACTERISTIC
/begin CHARACTERISTIC DDRC_DurDeb.Com_tiRpmWhlCtr_FXDebDef_C "DDRC/Dauer der Fehlerentprellung für Prüfung DFC_ComRpmWhlCtr_FX" VALUE 0x80022C52 Val_Wu16 655350.0 DDRCTime_ms 0.00 655350.0 /end CHARACTERISTIC
/begin CHARACTERISTIC DDRC_DurDeb.SSpMon3DebOk_C "DDRC/Dauer der Heilungsentprellung für Prüfung DFC_SSpMon3" VALUE 0x80022C54 Val_Wu16 655350.0 DDRCTime_ms 0.00 655350.0 /end CHARACTERISTIC
/begin CHARACTERISTIC DDRC_DurDeb.SSpMon3DebDef_C "DDRC/Dauer der Fehlerentprellung für Prüfung DFC_SSpMon3" VALUE 0x80022C56 Val_Wu16 655350.0 DDRCTime_ms 0.00 655350.0 /end CHARACTERISTIC
/begin CHARACTERISTIC DDRC_DurDeb.Oil_tiComNplDebOk_C "DDRC/Dauer der Heilungsentprellung für Prüfung DFC_OilComNpl" VALUE 0x80022C58 Val_Wu16 655350.0 DDRCTime_ms 0.00 655350.0 /end CHARACTERISTIC
/begin CHARACTERISTIC DDRC_DurDeb.Oil_tiComNplDebDef_C "DDRC/Dauer der Fehlerentprellung für Prüfung DFC_OilComNpl" VALUE 0x80022C5A Val_Wu16 655350.0 DDRCTime_ms 0.00 655350.0 /end CHARACTERISTIC
/begin CHARACTERISTIC DDRC_DurDeb.Com_tiKlemmenSig_FADebOk_C "DDRC/Dauer der Heilungsentprellung für Prüfung DFC_ComKlemmenSig_FA" VALUE 0x80022C5C Val_Wu16 655350.0 DDRCTime_ms 0.00 655350.0 /end CHARACTERISTIC
/begin CHARACTERISTIC DDRC_DurDeb.Com_tiKlemmenSig_FADebDef_C "DDRC/Dauer der Fehlerentprellung für Prüfung DFC_ComKlemmenSig_FA" VALUE 0x80022C5E Val_Wu16 655350.0 DDRCTime_ms 0.00 655350.0 /end CHARACTERISTIC
/begin CHARACTERISTIC DDRC_DurDeb.Com_tiTrqWhlDemFASTo_FXDebOk_C "DDRC/Dauer der Heilungsentprellung für Prüfung DFC_ComTrqWhlDemFASTo_FX" VALUE 0x80022C60 Val_Wu16 655350.0 DDRCTime_ms 0.00 655350.0 /end CHARACTERISTIC
/begin CHARACTERISTIC DDRC_DurDeb.Com_tiTrqWhlDemFASTo_FXDebDef_C "DDRC/Dauer der Fehlerentprellung für Prüfung DFC_ComTrqWhlDemFASTo_FX" VALUE 0x80022C62 Val_Wu16 655350.0 DDRCTime_ms 0.00 655350.0 /end CHARACTERISTIC
/begin CHARACTERISTIC DDRC_DurDeb.GlwEcu_tiGPCMInfoDebOk_C "DDRC/Dauer der Heilungsentprellung für Prüfung DFC_GlwEcuGPCMInfo" VALUE 0x80022C64 Val_Wu16 655350.0 DDRCTime_ms 0.00 655350.0 /end CHARACTERISTIC
/begin CHARACTERISTIC DDRC_DurDeb.GlwEcu_tiGPCMInfoDebDef_C "DDRC/Dauer der Fehlerentprellung für Prüfung DFC_GlwEcuGPCMInfo" VALUE 0x80022C66 Val_Wu16 655350.0 DDRCTime_ms 0.00 655350.0 /end CHARACTERISTIC
/begin CHARACTERISTIC DDRC_DurDeb.TrbCh_ti4WinErr4DebOk_C "DDRC/Dauer der Heilungsentprellung für Prüfung DFC_TrbCh4WinErr4" VALUE 0x80022C68 Val_Wu16 655350.0 DDRCTime_ms 0.00 655350.0 /end CHARACTERISTIC
/begin CHARACTERISTIC DDRC_DurDeb.TrbCh_ti4WinErr4DebDef_C "DDRC/Dauer der Fehlerentprellung für Prüfung DFC_TrbCh4WinErr4" VALUE 0x80022C6A Val_Wu16 655350.0 DDRCTime_ms 0.00 655350.0 /end CHARACTERISTIC
/begin CHARACTERISTIC DDRC_DurDeb.Com_tiTrqWhlDemSigDebOk_C "DDRC/Dauer der Heilungsentprellung für Prüfung DFC_ComTrqWhlDemSig" VALUE 0x80022C6C Val_Wu16 655350.0 DDRCTime_ms 0.00 655350.0 /end CHARACTERISTIC
/begin CHARACTERISTIC DDRC_DurDeb.Com_tiTrqWhlDemSigDebDef_C "DDRC/Dauer der Fehlerentprellung für Prüfung DFC_ComTrqWhlDemSig" VALUE 0x80022C6E Val_Wu16 655350.0 DDRCTime_ms 0.00 655350.0 /end CHARACTERISTIC
/begin CHARACTERISTIC DDRC_DurDeb.TrbCh_tiSRCMinDebOk_C "DDRC/Dauer der Heilungsentprellung für Prüfung DFC_TrbChSRCMin" VALUE 0x80022C70 Val_Wu16 655350.0 DDRCTime_ms 0.00 655350.0 /end CHARACTERISTIC
/begin CHARACTERISTIC DDRC_DurDeb.TrbCh_tiSRCMinDebDef_C "DDRC/Dauer der Fehlerentprellung für Prüfung DFC_TrbChSRCMin" VALUE 0x80022C72 Val_Wu16 655350.0 DDRCTime_ms 0.00 655350.0 /end CHARACTERISTIC
/begin CHARACTERISTIC DDRC_DurDeb.Com_tiVelocitySig_FADebOk_C "DDRC/Dauer der Heilungsentprellung für Prüfung DFC_ComVelocitySig_FA" VALUE 0x80022C74 Val_Wu16 655350.0 DDRCTime_ms 0.00 655350.0 /end CHARACTERISTIC
/begin CHARACTERISTIC DDRC_DurDeb.Com_tiVelocitySig_FADebDef_C "DDRC/Dauer der Fehlerentprellung für Prüfung DFC_ComVelocitySig_FA" VALUE 0x80022C76 Val_Wu16 655350.0 DDRCTime_ms 0.00 655350.0 /end CHARACTERISTIC
/begin CHARACTERISTIC DDRC_DurDeb.Com_tiRequestEMFSigDebOk_C "DDRC/Dauer der Heilungsentprellung für Prüfung DFC_ComRequestEMFSig" VALUE 0x80022C78 Val_Wu16 655350.0 DDRCTime_ms 0.00 655350.0 /end CHARACTERISTIC
/begin CHARACTERISTIC DDRC_DurDeb.Com_tiRequestEMFSigDebDef_C "DDRC/Dauer der Fehlerentprellung für Prüfung DFC_ComRequestEMFSig" VALUE 0x80022C7A Val_Wu16 655350.0 DDRCTime_ms 0.00 655350.0 /end CHARACTERISTIC
/begin CHARACTERISTIC DDRC_DurDeb.Com_tiMileageRangeSig_FADebOk_C "DDRC/Dauer der Heilungsentprellung für Prüfung DFC_ComMileageRangeSig_FA" VALUE 0x80022C7C Val_Wu16 655350.0 DDRCTime_ms 0.00 655350.0 /end CHARACTERISTIC
/begin CHARACTERISTIC DDRC_DurDeb.Com_tiMileageRangeSig_FADebDef_C "DDRC/Dauer der Fehlerentprellung für Prüfung DFC_ComMileageRangeSig_FA" VALUE 0x80022C7E Val_Wu16 655350.0 DDRCTime_ms 0.00 655350.0 /end CHARACTERISTIC
/begin CHARACTERISTIC DDRC_DurDeb.Com_tiStatusEMFChkDebOk_C "DDRC/Dauer der Heilungsentprellung für Prüfung DFC_ComStatusEMFChk" VALUE 0x80022C80 Val_Wu16 655350.0 DDRCTime_ms 0.00 655350.0 /end CHARACTERISTIC
/begin CHARACTERISTIC DDRC_DurDeb.Com_tiStatusEMFChkDebDef_C "DDRC/Dauer der Fehlerentprellung für Prüfung DFC_ComStatusEMFChk" VALUE 0x80022C82 Val_Wu16 655350.0 DDRCTime_ms 0.00 655350.0 /end CHARACTERISTIC
/begin CHARACTERISTIC DDRC_DurDeb.Com_tiTrqDemandGbxCtr_FADebOk_C "DDRC/Dauer der Heilungsentprellung für Prüfung DFC_ComTrqDemandGbxCtr_FA" VALUE 0x80022C84 Val_Wu16 655350.0 DDRCTime_ms 0.00 655350.0 /end CHARACTERISTIC
/begin CHARACTERISTIC DDRC_DurDeb.Com_tiTrqDemandGbxCtr_FADebDef_C "DDRC/Dauer der Fehlerentprellung für Prüfung DFC_ComTrqDemandGbxCtr_FA" VALUE 0x80022C86 Val_Wu16 655350.0 DDRCTime_ms 0.00 655350.0 /end CHARACTERISTIC
/begin CHARACTERISTIC DDRC_DurDeb.AltIO_tiComErrDebOk_C "DDRC/Dauer der Heilungsentprellung für Prüfung DFC_AltIOComErr" VALUE 0x80022C88 Val_Wu16 655350.0 DDRCTime_ms 0.00 655350.0 /end CHARACTERISTIC
/begin CHARACTERISTIC DDRC_DurDeb.AltIO_tiComErrDebDef_C "DDRC/Dauer der Fehlerentprellung für Prüfung DFC_AltIOComErr" VALUE 0x80022C8A Val_Wu16 655350.0 DDRCTime_ms 0.00 655350.0 /end CHARACTERISTIC
/begin CHARACTERISTIC DDRC_DurDeb.Com_tiCodierungPwrmngSigDebOk_C "DDRC/Dauer der Heilungsentprellung für Prüfung DFC_ComCodierungPwrmngSig" VALUE 0x80022C8C Val_Wu16 655350.0 DDRCTime_ms 0.00 655350.0 /end CHARACTERISTIC
/begin CHARACTERISTIC DDRC_DurDeb.Com_tiCodierungPwrmngSigDebDef_C "DDRC/Dauer der Fehlerentprellung für Prüfung DFC_ComCodierungPwrmngSig" VALUE 0x80022C8E Val_Wu16 655350.0 DDRCTime_ms 0.00 655350.0 /end CHARACTERISTIC
/begin CHARACTERISTIC DDRC_DurDeb.Com_tiStateDscSigDebOk_C "DDRC/Dauer der Heilungsentprellung für Prüfung DFC_ComStateDscSig" VALUE 0x80022C90 Val_Wu16 655350.0 DDRCTime_ms 0.00 655350.0 /end CHARACTERISTIC
/begin CHARACTERISTIC DDRC_DurDeb.Com_tiStateDscSigDebDef_C "DDRC/Dauer der Fehlerentprellung für Prüfung DFC_ComStateDscSig" VALUE 0x80022C92 Val_Wu16 655350.0 DDRCTime_ms 0.00 655350.0 /end CHARACTERISTIC
/begin CHARACTERISTIC DDRC_DurDeb.Com_tiStateSeatTo_FADebOk_C "DDRC/Dauer der Heilungsentprellung für Prüfung DFC_ComStateSeatTo_FA" VALUE 0x80022C94 Val_Wu16 655350.0 DDRCTime_ms 0.00 655350.0 /end CHARACTERISTIC
/begin CHARACTERISTIC DDRC_DurDeb.Com_tiStateSeatTo_FADebDef_C "DDRC/Dauer der Fehlerentprellung für Prüfung DFC_ComStateSeatTo_FA" VALUE 0x80022C96 Val_Wu16 655350.0 DDRCTime_ms 0.00 655350.0 /end CHARACTERISTIC
/begin CHARACTERISTIC DDRC_DurDeb.Rail_tiCPC4DebOk_C "DDRC/Dauer der Heilungsentprellung für Prüfung DFC_RailCPC4" VALUE 0x80022C98 Val_Wu16 655350.0 DDRCTime_ms 0.00 655350.0 /end CHARACTERISTIC
/begin CHARACTERISTIC DDRC_DurDeb.Rail_tiCPC4DebDef_C "DDRC/Dauer der Fehlerentprellung für Prüfung DFC_RailCPC4" VALUE 0x80022C9A Val_Wu16 655350.0 DDRCTime_ms 0.00 655350.0 /end CHARACTERISTIC
/begin CHARACTERISTIC DDRC_DurDeb.Com_tiVelocityCtr_FADebOk_C "DDRC/Dauer der Heilungsentprellung für Prüfung DFC_ComVelocityCtr_FA" VALUE 0x80022C9C Val_Wu16 655350.0 DDRCTime_ms 0.00 655350.0 /end CHARACTERISTIC
/begin CHARACTERISTIC DDRC_DurDeb.Com_tiVelocityCtr_FADebDef_C "DDRC/Dauer der Fehlerentprellung für Prüfung DFC_ComVelocityCtr_FA" VALUE 0x80022C9E Val_Wu16 655350.0 DDRCTime_ms 0.00 655350.0 /end CHARACTERISTIC
/begin CHARACTERISTIC DDRC_DurDeb.Com_tiTimeDateTo_FADebOk_C "DDRC/Dauer der Heilungsentprellung für Prüfung DFC_ComTimeDateTo_FA" VALUE 0x80022CA0 Val_Wu16 655350.0 DDRCTime_ms 0.00 655350.0 /end CHARACTERISTIC
/begin CHARACTERISTIC DDRC_DurDeb.Com_tiTimeDateTo_FADebDef_C "DDRC/Dauer der Fehlerentprellung für Prüfung DFC_ComTimeDateTo_FA" VALUE 0x80022CA2 Val_Wu16 655350.0 DDRCTime_ms 0.00 655350.0 /end CHARACTERISTIC
/begin CHARACTERISTIC DDRC_DurDeb.Com_tiVerbraucherToDebOk_C "DDRC/Dauer der Heilungsentprellung für Prüfung DFC_ComVerbraucherTo" VALUE 0x80022CA4 Val_Wu16 655350.0 DDRCTime_ms 0.00 655350.0 /end CHARACTERISTIC
/begin CHARACTERISTIC DDRC_DurDeb.Com_tiVerbraucherToDebDef_C "DDRC/Dauer der Fehlerentprellung für Prüfung DFC_ComVerbraucherTo" VALUE 0x80022CA6 Val_Wu16 655350.0 DDRCTime_ms 0.00 655350.0 /end CHARACTERISTIC
/begin CHARACTERISTIC DDRC_DurDeb.Com_tiaDirectTo_FXDebOk_C "DDRC/Dauer der Heilungsentprellung für Prüfung DFC_ComaDirectTo_FX" VALUE 0x80022CA8 Val_Wu16 655350.0 DDRCTime_ms 0.00 655350.0 /end CHARACTERISTIC
/begin CHARACTERISTIC DDRC_DurDeb.Com_tiaDirectTo_FXDebDef_C "DDRC/Dauer der Fehlerentprellung für Prüfung DFC_ComaDirectTo_FX" VALUE 0x80022CAA Val_Wu16 655350.0 DDRCTime_ms 0.00 655350.0 /end CHARACTERISTIC
/begin CHARACTERISTIC DDRC_DurDeb.GlwEcu_tiMsgTimeoutDebOk_C "DDRC/Dauer der Heilungsentprellung für Prüfung DFC_GlwEcuMsgTimeout" VALUE 0x80022CAC Val_Wu16 655350.0 DDRCTime_ms 0.00 655350.0 /end CHARACTERISTIC
/begin CHARACTERISTIC DDRC_DurDeb.GlwEcu_tiMsgTimeoutDebDef_C "DDRC/Dauer der Fehlerentprellung für Prüfung DFC_GlwEcuMsgTimeout" VALUE 0x80022CAE Val_Wu16 655350.0 DDRCTime_ms 0.00 655350.0 /end CHARACTERISTIC
/begin CHARACTERISTIC DDRC_DurDeb.Com_tiTrqDemandGbxChk_FADebOk_C "DDRC/Dauer der Heilungsentprellung für Prüfung DFC_ComTrqDemandGbxChk_FA" VALUE 0x80022CB0 Val_Wu16 655350.0 DDRCTime_ms 0.00 655350.0 /end CHARACTERISTIC
/begin CHARACTERISTIC DDRC_DurDeb.Com_tiTrqDemandGbxChk_FADebDef_C "DDRC/Dauer der Fehlerentprellung für Prüfung DFC_ComTrqDemandGbxChk_FA" VALUE 0x80022CB2 Val_Wu16 655350.0 DDRCTime_ms 0.00 655350.0 /end CHARACTERISTIC
/begin CHARACTERISTIC DDRC_DurDeb.PCBS_tiCCLThresDebOk_C "DDRC/Dauer der Heilungsentprellung für Prüfung DFC_PCBSPFltChg" VALUE 0x80022CB4 Val_Wu16 655350.0 DDRCTime_ms 0.00 655350.0 /end CHARACTERISTIC
/begin CHARACTERISTIC DDRC_DurDeb.PCBS_tiCCLThresDebDef_C "DDRC/Dauer der Fehlerentprellung für Prüfung DFC_PCBSPFltChg" VALUE 0x80022CB6 Val_Wu16 655350.0 DDRCTime_ms 0.00 655350.0 /end CHARACTERISTIC
/begin CHARACTERISTIC DDRC_DurDeb.Com_tiComSensNOxModeDebOk_C "DDRC/Dauer der Heilungsentprellung für Prüfung DFC_ComSensNOxMode" VALUE 0x80022CB8 Val_Wu16 655350.0 DDRCTime_ms 0.00 655350.0 /end CHARACTERISTIC
/begin CHARACTERISTIC DDRC_DurDeb.Com_tiComSensNOxModeDebDef_C "DDRC/Dauer der Fehlerentprellung für Prüfung DFC_ComSensNOxMode" VALUE 0x80022CBA Val_Wu16 655350.0 DDRCTime_ms 0.00 655350.0 /end CHARACTERISTIC
/begin CHARACTERISTIC DDRC_DurDeb.PFlt_tiPFltPresPlausMAXDebOk_C "DDRC/Dauer der Heilungsentprellung für Prüfung DFC_PFltPresPlausMAX" VALUE 0x80022CBC Val_Wu16 655350.0 DDRCTime_ms 0.00 655350.0 /end CHARACTERISTIC
/begin CHARACTERISTIC DDRC_DurDeb.PFlt_tiPFltPresPlausMAXDebDef_C "DDRC/Dauer der Fehlerentprellung für Prüfung DFC_PFltPresPlausMAX" VALUE 0x80022CBE Val_Wu16 655350.0 DDRCTime_ms 0.00 655350.0 /end CHARACTERISTIC
/begin CHARACTERISTIC DDRC_DurDeb.Com_tiACDemandSig_FADebOk_C "DDRC/Dauer der Heilungsentprellung für Prüfung DFC_ComACDemandSig_FA" VALUE 0x80022CC0 Val_Wu16 655350.0 DDRCTime_ms 0.00 655350.0 /end CHARACTERISTIC
/begin CHARACTERISTIC DDRC_DurDeb.Com_tiACDemandSig_FADebDef_C "DDRC/Dauer der Fehlerentprellung für Prüfung DFC_ComACDemandSig_FA" VALUE 0x80022CC2 Val_Wu16 655350.0 DDRCTime_ms 0.00 655350.0 /end CHARACTERISTIC
/begin CHARACTERISTIC DDRC_DurDeb.Com_tiTerminalChkDebOk_C "DDRC/Dauer der Heilungsentprellung für Prüfung DFC_ComTerminalChk" VALUE 0x80022CC4 Val_Wu16 655350.0 DDRCTime_ms 0.00 655350.0 /end CHARACTERISTIC
/begin CHARACTERISTIC DDRC_DurDeb.Com_tiTerminalChkDebDef_C "DDRC/Dauer der Fehlerentprellung für Prüfung DFC_ComTerminalChk" VALUE 0x80022CC6 Val_Wu16 655350.0 DDRCTime_ms 0.00 655350.0 /end CHARACTERISTIC
/begin CHARACTERISTIC DDRC_DurDeb.ThrVlv_tiSCGDebOk_C "DDRC/Dauer der Heilungsentprellung für Prüfung DFC_ThrVlvSCG" VALUE 0x80022CC8 Val_Wu16 655350.0 DDRCTime_ms 0.00 655350.0 /end CHARACTERISTIC
/begin CHARACTERISTIC DDRC_DurDeb.ThrVlv_tiSCGDebDef_C "DDRC/Dauer der Fehlerentprellung für Prüfung DFC_ThrVlvSCG" VALUE 0x80022CCA Val_Wu16 655350.0 DDRCTime_ms 0.00 655350.0 /end CHARACTERISTIC
/begin CHARACTERISTIC DDRC_DurDeb.Rail_tiCPC1DebOk_C "DDRC/Dauer der Heilungsentprellung für Prüfung DFC_RailCPC1" VALUE 0x80022CCC Val_Wu16 655350.0 DDRCTime_ms 0.00 655350.0 /end CHARACTERISTIC
/begin CHARACTERISTIC DDRC_DurDeb.Rail_tiCPC1DebDef_C "DDRC/Dauer der Fehlerentprellung für Prüfung DFC_RailCPC1" VALUE 0x80022CCE Val_Wu16 655350.0 DDRCTime_ms 0.00 655350.0 /end CHARACTERISTIC
/begin CHARACTERISTIC DDRC_DurDeb.PFlt_tiPFltmSotDiffSIGDebOk_C "DDRC/Dauer der Heilungsentprellung für Prüfung DFC_PFltmSotDiffSIG" VALUE 0x80022CD0 Val_Wu16 655350.0 DDRCTime_ms 0.00 655350.0 /end CHARACTERISTIC
/begin CHARACTERISTIC DDRC_DurDeb.PFlt_tiPFltmSotDiffSIGDebDef_C "DDRC/Dauer der Fehlerentprellung für Prüfung DFC_PFltmSotDiffSIG" VALUE 0x80022CD2 Val_Wu16 655350.0 DDRCTime_ms 0.00 655350.0 /end CHARACTERISTIC
/begin CHARACTERISTIC DDRC_DurDeb.ETClb_numETFltMaxDebOk_C "DDRC/Dauer der Heilungsentprellung für Prüfung DFC_ETClbETFltMax" VALUE 0x80022CD4 Val_Wu16 65535.00 OneToOne 0.00 65535.00 /end CHARACTERISTIC
/begin CHARACTERISTIC DDRC_DurDeb.ETClb_numETFltMaxDebDef_C "DDRC/Dauer der Fehlerentprellung für Prüfung DFC_ETClbETFltMax" VALUE 0x80022CD6 Val_Wu16 65535.00 OneToOne 0.00 65535.00 /end CHARACTERISTIC
/begin CHARACTERISTIC DDRC_DurDeb.InjCrv_numInjLimDebOk_C "DDRC/Dauer der Heilungsentprellung für Prüfung DFC_InjCrvInjLimSys" VALUE 0x80022CD8 Val_Wu16 65535.00 OneToOne 0.00 65535.00 /end CHARACTERISTIC
/begin CHARACTERISTIC DDRC_DurDeb.InjCrv_numInjLimDebDef_C "DDRC/Dauer der Fehlerentprellung für Prüfung DFC_InjCrvInjLimSys" VALUE 0x80022CDA Val_Wu16 65535.00 OneToOne 0.00 65535.00 /end CHARACTERISTIC
/begin CHARACTERISTIC DDRC_DurDeb.ETClb_numETFltMinDebOk_C "DDRC/Dauer der Heilungsentprellung für Prüfung DFC_ETClbETFltMin" VALUE 0x80022CDC Val_Wu16 65535.00 OneToOne 0.00 65535.00 /end CHARACTERISTIC
/begin CHARACTERISTIC DDRC_DurDeb.ETClb_numETFltMinDebDef_C "DDRC/Dauer der Fehlerentprellung für Prüfung DFC_ETClbETFltMin" VALUE 0x80022CDE Val_Wu16 65535.00 OneToOne 0.00 65535.00 /end CHARACTERISTIC
/begin CHARACTERISTIC DDRC_DurDeb.LSU_numHtCoupSigDebOk_C "DDRC/Dauer der Heilungsentprellung für Prüfung DFC_LSUHtCoupSig" VALUE 0x80022CE0 Val_Wu16 65535.00 OneToOne 0.00 65535.00 /end CHARACTERISTIC
/begin CHARACTERISTIC DDRC_DurDeb.LSU_numHtCoupSigDebDef_C "DDRC/Dauer der Fehlerentprellung für Prüfung DFC_LSUHtCoupSig" VALUE 0x80022CE2 Val_Wu16 65535.00 OneToOne 0.00 65535.00 /end CHARACTERISTIC
/begin CHARACTERISTIC DDRC_RatDeb.TrbCh_tiOLUDRat_C "DDRC/Verhältnis Defekt / Heilungsentprellung für Prüfung DFC_TrbChOL" VALUE 0x80025D68 Val_Wu8 3.00000000000 DDRC_Ratio 1.00000000000 4.00000000000 FORMAT "%13.11" /end CHARACTERISTIC
/begin CHARACTERISTIC DDRC_RatDeb.ThrVlv_tiOLUDRat_C "DDRC/Verhältnis Defekt / Heilungsentprellung für Prüfung DFC_ThrVlvOL" VALUE 0x80025D69 Val_Wu8 3.00000000000 DDRC_Ratio 1.00000000000 4.00000000000 FORMAT "%13.11" /end CHARACTERISTIC
/begin CHARACTERISTIC DDRC_RatDeb.WaHtEl_tiSCBUDRat_C "DDRC/Verhältnis Defekt / Heilungsentprellung für Prüfung DFC_WaHtElSCB" VALUE 0x80025D6A Val_Wu8 3.00000000000 DDRC_Ratio 1.00000000000 4.00000000000 FORMAT "%13.11" /end CHARACTERISTIC
/begin CHARACTERISTIC DDRC_RatDeb.EBxFan_tiOvrTempUDRat_C "DDRC/Verhältnis Defekt / Heilungsentprellung für Prüfung DFC_EBxFanOvrTemp" VALUE 0x80025D6B Val_Wu8 3.00000000000 DDRC_Ratio 1.00000000000 4.00000000000 FORMAT "%13.11" /end CHARACTERISTIC
/begin CHARACTERISTIC DDRC_RatDeb.RailP_tiSRCMinUDRat_C "DDRC/Verhältnis Defekt / Heilungsentprellung für Prüfung DFC_RailPSRCMin" VALUE 0x80025D6C Val_Wu8 3.00000000000 DDRC_Ratio 1.00000000000 4.00000000000 FORMAT "%13.11" /end CHARACTERISTIC
/begin CHARACTERISTIC DDRC_RatDeb.Fan_tiOLUDRat_C "DDRC/Verhältnis Defekt / Heilungsentprellung für Prüfung DFC_FanOL" VALUE 0x80025D6D Val_Wu8 3.00000000000 DDRC_Ratio 1.00000000000 4.00000000000 FORMAT "%13.11" /end CHARACTERISTIC
/begin CHARACTERISTIC DDRC_RatDeb.ECBVlv_tiOvrTempUDRat_C "DDRC/Verhältnis Defekt / Heilungsentprellung für Prüfung DFC_ECBVlvOvrTemp" VALUE 0x80025D6E Val_Wu8 3.00000000000 DDRC_Ratio 1.00000000000 4.00000000000 FORMAT "%13.11" /end CHARACTERISTIC
/begin CHARACTERISTIC DDRC_RatDeb.EBxFan_tiSCGUDRat_C "DDRC/Verhältnis Defekt / Heilungsentprellung für Prüfung DFC_EBxFanSCG" VALUE 0x80025D6F Val_Wu8 3.00000000000 DDRC_Ratio 1.00000000000 4.00000000000 FORMAT "%13.11" /end CHARACTERISTIC
/begin CHARACTERISTIC DDRC_RatDeb.UPmpMot_tiOLUDRat_C "DDRC/Verhältnis Defekt / Heilungsentprellung für Prüfung DFC_UPmpMotOL" VALUE 0x80025D70 Val_Wu8 3.00000000000 DDRC_Ratio 1.00000000000 4.00000000000 FORMAT "%13.11" /end CHARACTERISTIC
/begin CHARACTERISTIC DDRC_RatDeb.AirC_tiCmprOLUDRat_C "DDRC/Verhältnis Defekt / Heilungsentprellung für Prüfung DFC_AirCCmprOL" VALUE 0x80025D71 Val_Wu8 3.00000000000 DDRC_Ratio 1.00000000000 4.00000000000 FORMAT "%13.11" /end CHARACTERISTIC
/begin CHARACTERISTIC DDRC_RatDeb.UDosVlv_tiOLUDRat_C "DDRC/Verhältnis Defekt / Heilungsentprellung für Prüfung DFC_UDosVlvOL" VALUE 0x80025D72 Val_Wu8 3.00000000000 DDRC_Ratio 1.00000000000 4.00000000000 FORMAT "%13.11" /end CHARACTERISTIC
/begin CHARACTERISTIC DDRC_RatDeb.ThrVlv_tiSCBUDRat_C "DDRC/Verhältnis Defekt / Heilungsentprellung für Prüfung DFC_ThrVlvSCB" VALUE 0x80025D73 Val_Wu8 3.00000000000 DDRC_Ratio 1.00000000000 4.00000000000 FORMAT "%13.11" /end CHARACTERISTIC
/begin CHARACTERISTIC DDRC_RatDeb.CThmst_tiOvrTempUDRat_C "DDRC/Verhältnis Defekt / Heilungsentprellung für Prüfung DFC_CThmstOvrTemp" VALUE 0x80025D74 Val_Wu8 3.00000000000 DDRC_Ratio 1.00000000000 4.00000000000 FORMAT "%13.11" /end CHARACTERISTIC
/begin CHARACTERISTIC DDRC_RatDeb.UDosVlv_tiSCGUDRat_C "DDRC/Verhältnis Defekt / Heilungsentprellung für Prüfung DFC_UDosVlvSCG" VALUE 0x80025D75 Val_Wu8 3.00000000000 DDRC_Ratio 1.00000000000 4.00000000000 FORMAT "%13.11" /end CHARACTERISTIC
/begin CHARACTERISTIC DDRC_RatDeb.Strt_tiSCBUDRat_C "DDRC/Verhältnis Defekt / Heilungsentprellung für Prüfung DFC_StrtSCB" VALUE 0x80025D76 Val_Wu8 3.00000000000 DDRC_Ratio 1.00000000000 4.00000000000 FORMAT "%13.11" /end CHARACTERISTIC
/begin CHARACTERISTIC DDRC_RatDeb.CByVlv_tiSCGUDRat_C "DDRC/Verhältnis Defekt / Heilungsentprellung für Prüfung DFC_CByVlvSCG" VALUE 0x80025D77 Val_Wu8 3.00000000000 DDRC_Ratio 1.00000000000 4.00000000000 FORMAT "%13.11" /end CHARACTERISTIC
/begin CHARACTERISTIC DDRC_RatDeb.TrbCh_tiOvrTempUDRat_C "DDRC/Verhältnis Defekt / Heilungsentprellung für Prüfung DFC_TrbChOvrTemp" VALUE 0x80025D78 Val_Wu8 3.00000000000 DDRC_Ratio 1.00000000000 4.00000000000 FORMAT "%13.11" /end CHARACTERISTIC
/begin CHARACTERISTIC DDRC_RatDeb.EBxFan_tiSCBUDRat_C "DDRC/Verhältnis Defekt / Heilungsentprellung für Prüfung DFC_EBxFanSCB" VALUE 0x80025D79 Val_Wu8 3.00000000000 DDRC_Ratio 1.00000000000 4.00000000000 FORMAT "%13.11" /end CHARACTERISTIC
/begin CHARACTERISTIC DDRC_RatDeb.Strt_tiOvrTempUDRat_C "DDRC/Verhältnis Defekt / Heilungsentprellung für Prüfung DFC_StrtOvrTemp" VALUE 0x80025D7A Val_Wu8 3.00000000000 DDRC_Ratio 1.00000000000 4.00000000000 FORMAT "%13.11" /end CHARACTERISTIC
/begin CHARACTERISTIC DDRC_RatDeb.ECBVlv_tiSCBUDRat_C "DDRC/Verhältnis Defekt / Heilungsentprellung für Prüfung DFC_ECBVlvSCB" VALUE 0x80025D7B Val_Wu8 3.00000000000 DDRC_Ratio 1.00000000000 4.00000000000 FORMAT "%13.11" /end CHARACTERISTIC
/begin CHARACTERISTIC DDRC_RatDeb.EngStA_tiOvrTempUDRat_C "DDRC/Verhältnis Defekt / Heilungsentprellung für Prüfung DFC_FlFltHtOvrTemp" VALUE 0x80025D7C Val_Wu8 3.00000000000 DDRC_Ratio 1.00000000000 4.00000000000 FORMAT "%13.11" /end CHARACTERISTIC
/begin CHARACTERISTIC DDRC_RatDeb.UPmpMot_tiSCGUDRat_C "DDRC/Verhältnis Defekt / Heilungsentprellung für Prüfung DFC_UPmpMotSCG" VALUE 0x80025D7D Val_Wu8 3.00000000000 DDRC_Ratio 1.00000000000 4.00000000000 FORMAT "%13.11" /end CHARACTERISTIC
/begin CHARACTERISTIC DDRC_RatDeb.WaHtEl_tiOvrTempUDRat_C "DDRC/Verhältnis Defekt / Heilungsentprellung für Prüfung DFC_WaHtElOvrTemp" VALUE 0x80025D7E Val_Wu8 3.00000000000 DDRC_Ratio 1.00000000000 4.00000000000 FORMAT "%13.11" /end CHARACTERISTIC
/begin CHARACTERISTIC DDRC_RatDeb.CByVlv_tiOLUDRat_C "DDRC/Verhältnis Defekt / Heilungsentprellung für Prüfung DFC_CByVlvOL" VALUE 0x80025D7F Val_Wu8 3.00000000000 DDRC_Ratio 1.00000000000 4.00000000000 FORMAT "%13.11" /end CHARACTERISTIC
/begin CHARACTERISTIC DDRC_RatDeb.UDosVlv_tiOvrTempUDRat_C "DDRC/Verhältnis Defekt / Heilungsentprellung für Prüfung DFC_UDosVlvOvrTemp" VALUE 0x80025D80 Val_Wu8 3.00000000000 DDRC_Ratio 1.00000000000 4.00000000000 FORMAT "%13.11" /end CHARACTERISTIC
/begin CHARACTERISTIC DDRC_RatDeb.CThmst_tiSCBUDRat_C "DDRC/Verhältnis Defekt / Heilungsentprellung für Prüfung DFC_CThmstSCB" VALUE 0x80025D81 Val_Wu8 3.00000000000 DDRC_Ratio 1.00000000000 4.00000000000 FORMAT "%13.11" /end CHARACTERISTIC
/begin CHARACTERISTIC DDRC_RatDeb.CThmst_tiOLUDRat_C "DDRC/Verhältnis Defekt / Heilungsentprellung für Prüfung DFC_CThmstOL" VALUE 0x80025D82 Val_Wu8 3.00000000000 DDRC_Ratio 1.00000000000 4.00000000000 FORMAT "%13.11" /end CHARACTERISTIC
/begin CHARACTERISTIC DDRC_RatDeb.PCV_tiOLUDRat_C "DDRC/Verhältnis Defekt / Heilungsentprellung für Prüfung DFC_PCVOL" VALUE 0x80025D83 Val_Wu8 3.00000000000 DDRC_Ratio 1.00000000000 4.00000000000 FORMAT "%13.11" /end CHARACTERISTIC
/begin CHARACTERISTIC DDRC_RatDeb.LSU_tiHtrMinUDRat_C "DDRC/Verhältnis Defekt / Heilungsentprellung für Prüfung DFC_LSUHtrMin" VALUE 0x80025D84 Val_Wu8 3.00000000000 DDRC_Ratio 1.00000000000 4.00000000000 FORMAT "%13.11" /end CHARACTERISTIC
/begin CHARACTERISTIC DDRC_RatDeb.Fan_tiSCBUDRat_C "DDRC/Verhältnis Defekt / Heilungsentprellung für Prüfung DFC_FanSCB" VALUE 0x80025D85 Val_Wu8 3.00000000000 DDRC_Ratio 1.00000000000 4.00000000000 FORMAT "%13.11" /end CHARACTERISTIC
/begin CHARACTERISTIC DDRC_RatDeb.ECBVlv_tiOLUDRat_C "DDRC/Verhältnis Defekt / Heilungsentprellung für Prüfung DFC_ECBVlvOL" VALUE 0x80025D86 Val_Wu8 3.00000000000 DDRC_Ratio 1.00000000000 4.00000000000 FORMAT "%13.11" /end CHARACTERISTIC
/begin CHARACTERISTIC DDRC_RatDeb.UPmpMot_tiSCBUDRat_C "DDRC/Verhältnis Defekt / Heilungsentprellung für Prüfung DFC_UPmpMotSCB" VALUE 0x80025D87 Val_Wu8 3.00000000000 DDRC_Ratio 1.00000000000 4.00000000000 FORMAT "%13.11" /end CHARACTERISTIC
/begin CHARACTERISTIC DDRC_RatDeb.ThrVlv_tiOvrTempUDRat_C "DDRC/Verhältnis Defekt / Heilungsentprellung für Prüfung DFC_ThrVlvOvrTemp" VALUE 0x80025D88 Val_Wu8 3.00000000000 DDRC_Ratio 1.00000000000 4.00000000000 FORMAT "%13.11" /end CHARACTERISTIC
/begin CHARACTERISTIC DDRC_RatDeb.FlFltHt_tiSCBUDRat_C "DDRC/Verhältnis Defekt / Heilungsentprellung für Prüfung DFC_FlFltHtSCB" VALUE 0x80025D89 Val_Wu8 3.00000000000 DDRC_Ratio 1.00000000000 4.00000000000 FORMAT "%13.11" /end CHARACTERISTIC
/begin CHARACTERISTIC DDRC_RatDeb.EBxFan_tiOLUDRat_C "DDRC/Verhältnis Defekt / Heilungsentprellung für Prüfung DFC_EBxFanOL" VALUE 0x80025D8A Val_Wu8 3.00000000000 DDRC_Ratio 1.00000000000 4.00000000000 FORMAT "%13.11" /end CHARACTERISTIC
/begin CHARACTERISTIC DDRC_RatDeb.LSU_titExcMinUDRat_C "DDRC/Verhältnis Defekt / Heilungsentprellung für Prüfung DFC_LSUtExcMin" VALUE 0x80025D8B Val_Wu8 3.00000000000 DDRC_Ratio 1.00000000000 4.00000000000 FORMAT "%13.11" /end CHARACTERISTIC
/begin CHARACTERISTIC DDRC_RatDeb.DSMTst_ExampleUDRat_C "DDRC/Verhältnis Defekt / Heilungsentprellung für Prüfung DFC_DSMDummy" VALUE 0x80025D8C Val_Wu8 3.00000000000 DDRC_Ratio 1.00000000000 4.00000000000 FORMAT "%13.11" /end CHARACTERISTIC
/begin CHARACTERISTIC DDRC_RatDeb.AirC_tiCmprSCBUDRat_C "DDRC/Verhältnis Defekt / Heilungsentprellung für Prüfung DFC_AirCCmprSCB" VALUE 0x80025D8D Val_Wu8 3.00000000000 DDRC_Ratio 1.00000000000 4.00000000000 FORMAT "%13.11" /end CHARACTERISTIC
/begin CHARACTERISTIC DDRC_RatDeb.EMDmp_tiSCBUDRat_C "DDRC/Verhältnis Defekt / Heilungsentprellung für Prüfung DFC_EMDmpSCB" VALUE 0x80025D8E Val_Wu8 3.00000000000 DDRC_Ratio 1.00000000000 4.00000000000 FORMAT "%13.11" /end CHARACTERISTIC
/begin CHARACTERISTIC DDRC_RatDeb.Shtr_tiOvrTempUDRat_C "DDRC/Verhältnis Defekt / Heilungsentprellung für Prüfung DFC_ShtrOvrTemp" VALUE 0x80025D8F Val_Wu8 3.00000000000 DDRC_Ratio 1.00000000000 4.00000000000 FORMAT "%13.11" /end CHARACTERISTIC
/begin CHARACTERISTIC DDRC_RatDeb.LSU_tiHtrSigUDRat_C "DDRC/Verhältnis Defekt / Heilungsentprellung für Prüfung DFC_LSUHtrSig" VALUE 0x80025D90 Val_Wu8 3.00000000000 DDRC_Ratio 1.00000000000 4.00000000000 FORMAT "%13.11" /end CHARACTERISTIC
/begin CHARACTERISTIC DDRC_RatDeb.WaHtEl_tiOLUDRat_C "DDRC/Verhältnis Defekt / Heilungsentprellung für Prüfung DFC_WaHtElOL" VALUE 0x80025D91 Val_Wu8 3.00000000000 DDRC_Ratio 1.00000000000 4.00000000000 FORMAT "%13.11" /end CHARACTERISTIC
/begin CHARACTERISTIC DDRC_RatDeb.MeUn_tiOLUDRat_C "DDRC/Verhältnis Defekt / Heilungsentprellung für Prüfung DFC_MeUnOL" VALUE 0x80025D92 Val_Wu8 3.00000000000 DDRC_Ratio 1.00000000000 4.00000000000 FORMAT "%13.11" /end CHARACTERISTIC
/begin CHARACTERISTIC DDRC_RatDeb.LSU_tiHtrNplUDRat_C "DDRC/Verhältnis Defekt / Heilungsentprellung für Prüfung DFC_LSUHtrNpl" VALUE 0x80025D93 Val_Wu8 3.00000000000 DDRC_Ratio 1.00000000000 4.00000000000 FORMAT "%13.11" /end CHARACTERISTIC
/begin CHARACTERISTIC DDRC_RatDeb.Strt_tiOLUDRat_C "DDRC/Verhältnis Defekt / Heilungsentprellung für Prüfung DFC_StrtOL" VALUE 0x80025D94 Val_Wu8 3.00000000000 DDRC_Ratio 1.00000000000 4.00000000000 FORMAT "%13.11" /end CHARACTERISTIC
/begin CHARACTERISTIC DDRC_RatDeb.PCV_tiSRCMinUDRat_C "DDRC/Verhältnis Defekt / Heilungsentprellung für Prüfung DFC_PCVSRCMin" VALUE 0x80025D95 Val_Wu8 3.00000000000 DDRC_Ratio 1.00000000000 4.00000000000 FORMAT "%13.11" /end CHARACTERISTIC
/begin CHARACTERISTIC DDRC_RatDeb.AirC_tiCmprOvrTempUDRat_C "DDRC/Verhältnis Defekt / Heilungsentprellung für Prüfung DFC_AirCCmprOvrTemp" VALUE 0x80025D96 Val_Wu8 3.00000000000 DDRC_Ratio 1.00000000000 4.00000000000 FORMAT "%13.11" /end CHARACTERISTIC
/begin CHARACTERISTIC DDRC_RatDeb.UPmpMot_tiOvrTempUDRat_C "DDRC/Verhältnis Defekt / Heilungsentprellung für Prüfung DFC_UPmpMotOvrTemp" VALUE 0x80025D97 Val_Wu8 3.00000000000 DDRC_Ratio 1.00000000000 4.00000000000 FORMAT "%13.11" /end CHARACTERISTIC
/begin CHARACTERISTIC DDRC_RatDeb.LSU_tiHtrMaxUDRat_C "DDRC/Verhältnis Defekt / Heilungsentprellung für Prüfung DFC_LSUHtrMax" VALUE 0x80025D98 Val_Wu8 3.00000000000 DDRC_Ratio 1.00000000000 4.00000000000 FORMAT "%13.11" /end CHARACTERISTIC
/begin CHARACTERISTIC DDRC_RatDeb.EngStA_tiSCGUDRat_C "DDRC/Verhältnis Defekt / Heilungsentprellung für Prüfung DFC_EngStASCG" VALUE 0x80025D99 Val_Wu8 3.00000000000 DDRC_Ratio 1.00000000000 4.00000000000 FORMAT "%13.11" /end CHARACTERISTIC
/begin CHARACTERISTIC DDRC_RatDeb.EngStA_tiSCBUDRat_C "DDRC/Verhältnis Defekt / Heilungsentprellung für Prüfung DFC_EngStASCB" VALUE 0x80025D9A Val_Wu8 3.00000000000 DDRC_Ratio 1.00000000000 4.00000000000 FORMAT "%13.11" /end CHARACTERISTIC
/begin CHARACTERISTIC DDRC_RatDeb.Shtr_tiSCGUDRat_C "DDRC/Verhältnis Defekt / Heilungsentprellung für Prüfung DFC_ShtrSCG" VALUE 0x80025D9B Val_Wu8 3.00000000000 DDRC_Ratio 1.00000000000 4.00000000000 FORMAT "%13.11" /end CHARACTERISTIC
/begin CHARACTERISTIC DDRC_RatDeb.EMDmp_tiOvrTempUDRat_C "DDRC/Verhältnis Defekt / Heilungsentprellung für Prüfung DFC_EMDmpOvrTemp" VALUE 0x80025D9C Val_Wu8 3.00000000000 DDRC_Ratio 1.00000000000 4.00000000000 FORMAT "%13.11" /end CHARACTERISTIC
/begin CHARACTERISTIC DDRC_RatDeb.MeUn_tiSCBUDRat_C "DDRC/Verhältnis Defekt / Heilungsentprellung für Prüfung DFC_MeUnSCB" VALUE 0x80025D9D Val_Wu8 3.00000000000 DDRC_Ratio 1.00000000000 4.00000000000 FORMAT "%13.11" /end CHARACTERISTIC
/begin CHARACTERISTIC DDRC_RatDeb.Strt_tiSCGUDRat_C "DDRC/Verhältnis Defekt / Heilungsentprellung für Prüfung DFC_StrtSCG" VALUE 0x80025D9E Val_Wu8 3.00000000000 DDRC_Ratio 1.00000000000 4.00000000000 FORMAT "%13.11" /end CHARACTERISTIC
/begin CHARACTERISTIC DDRC_RatDeb.EngStA_tiOLUDRat_C "DDRC/Verhältnis Defekt / Heilungsentprellung für Prüfung DFC_EngStAOL" VALUE 0x80025D9F Val_Wu8 3.00000000000 DDRC_Ratio 1.00000000000 4.00000000000 FORMAT "%13.11" /end CHARACTERISTIC
/begin CHARACTERISTIC DDRC_RatDeb.CByVlv_tiOvrTempUDRat_C "DDRC/Verhältnis Defekt / Heilungsentprellung für Prüfung DFC_CByVlvOvrTemp" VALUE 0x80025DA0 Val_Wu8 3.00000000000 DDRC_Ratio 1.00000000000 4.00000000000 FORMAT "%13.11" /end CHARACTERISTIC
/begin CHARACTERISTIC DDRC_RatDeb.LSU_titExcMaxUDRat_C "DDRC/Verhältnis Defekt / Heilungsentprellung für Prüfung DFC_LSUtExcMax" VALUE 0x80025DA1 Val_Wu8 3.00000000000 DDRC_Ratio 1.00000000000 4.00000000000 FORMAT "%13.11" /end CHARACTERISTIC
/begin CHARACTERISTIC DDRC_RatDeb.Shtr_tiOLUDRat_C "DDRC/Verhältnis Defekt / Heilungsentprellung für Prüfung DFC_ShtrOL" VALUE 0x80025DA2 Val_Wu8 3.00000000000 DDRC_Ratio 1.00000000000 4.00000000000 FORMAT "%13.11" /end CHARACTERISTIC
/begin CHARACTERISTIC DDRC_RatDeb.Shtr_tiSCBUDRat_C "DDRC/Verhältnis Defekt / Heilungsentprellung für Prüfung DFC_ShtrSCB" VALUE 0x80025DA3 Val_Wu8 3.00000000000 DDRC_Ratio 1.00000000000 4.00000000000 FORMAT "%13.11" /end CHARACTERISTIC
/begin CHARACTERISTIC DDRC_RatDeb.ECBVlv_tiSCGUDRat_C "DDRC/Verhältnis Defekt / Heilungsentprellung für Prüfung DFC_ECBVlvSCG" VALUE 0x80025DA4 Val_Wu8 3.00000000000 DDRC_Ratio 1.00000000000 4.00000000000 FORMAT "%13.11" /end CHARACTERISTIC
/begin CHARACTERISTIC DDRC_RatDeb.FlFltHt_tiSCGUDRat_C "DDRC/Verhältnis Defekt / Heilungsentprellung für Prüfung DFC_FlFltHtSCG" VALUE 0x80025DA5 Val_Wu8 3.00000000000 DDRC_Ratio 1.00000000000 4.00000000000 FORMAT "%13.11" /end CHARACTERISTIC
/begin CHARACTERISTIC DDRC_RatDeb.UDosVlv_tiSCBUDRat_C "DDRC/Verhältnis Defekt / Heilungsentprellung für Prüfung DFC_UDosVlvSCB" VALUE 0x80025DA6 Val_Wu8 3.00000000000 DDRC_Ratio 1.00000000000 4.00000000000 FORMAT "%13.11" /end CHARACTERISTIC
/begin CHARACTERISTIC DDRC_RatDeb.AFS_SSpShOff_tiOvrTempUDRat_C "DDRC/Verhältnis Defekt / Heilungsentprellung für Prüfung DFC_AFS_SSpShOffOvrTemp" VALUE 0x80025DA7 Val_Wu8 3.00000000000 DDRC_Ratio 1.00000000000 4.00000000000 FORMAT "%13.11" /end CHARACTERISTIC
/begin CHARACTERISTIC DDRC_RatDeb.MeUn_tiSRCMinUDRat_C "DDRC/Verhältnis Defekt / Heilungsentprellung für Prüfung DFC_MeUnSRCMin" VALUE 0x80025DA8 Val_Wu8 3.00000000000 DDRC_Ratio 1.00000000000 4.00000000000 FORMAT "%13.11" /end CHARACTERISTIC
/begin CHARACTERISTIC DDRC_RatDeb.FlFltHt_tiOLUDRat_C "DDRC/Verhältnis Defekt / Heilungsentprellung für Prüfung DFC_FlFltHtOL" VALUE 0x80025DA9 Val_Wu8 3.00000000000 DDRC_Ratio 1.00000000000 4.00000000000 FORMAT "%13.11" /end CHARACTERISTIC
/begin CHARACTERISTIC DDRC_RatDeb.Fan_tiOvrTempUDRat_C "DDRC/Verhältnis Defekt / Heilungsentprellung für Prüfung DFC_FanOvrTemp" VALUE 0x80025DAA Val_Wu8 3.00000000000 DDRC_Ratio 1.00000000000 4.00000000000 FORMAT "%13.11" /end CHARACTERISTIC
/begin CHARACTERISTIC DDRC_RatDeb.MeUn_tiSRCMaxUDRat_C "DDRC/Verhältnis Defekt / Heilungsentprellung für Prüfung DFC_MeUnSRCMax" VALUE 0x80025DAB Val_Wu8 3.00000000000 DDRC_Ratio 1.00000000000 4.00000000000 FORMAT "%13.11" /end CHARACTERISTIC
/begin CHARACTERISTIC DDRC_RatDeb.CThmst_tiSCGUDRat_C "DDRC/Verhältnis Defekt / Heilungsentprellung für Prüfung DFC_CThmstSCG" VALUE 0x80025DAC Val_Wu8 3.00000000000 DDRC_Ratio 1.00000000000 4.00000000000 FORMAT "%13.11" /end CHARACTERISTIC
/begin CHARACTERISTIC DDRC_RatDeb.PCV_tiSRCMaxUDRat_C "DDRC/Verhältnis Defekt / Heilungsentprellung für Prüfung DFC_PCVSRCMax" VALUE 0x80025DAD Val_Wu8 3.00000000000 DDRC_Ratio 1.00000000000 4.00000000000 FORMAT "%13.11" /end CHARACTERISTIC
/begin CHARACTERISTIC DDRC_RatDeb.PCV_tiSCBUDRat_C "DDRC/Verhältnis Defekt / Heilungsentprellung für Prüfung DFC_PCVSCB" VALUE 0x80025DAE Val_Wu8 3.00000000000 DDRC_Ratio 1.00000000000 4.00000000000 FORMAT "%13.11" /end CHARACTERISTIC
/begin CHARACTERISTIC DDRC_RatDeb.EMDmp_tiSCGUDRat_C "DDRC/Verhältnis Defekt / Heilungsentprellung für Prüfung DFC_EMDmpSCG" VALUE 0x80025DAF Val_Wu8 3.00000000000 DDRC_Ratio 1.00000000000 4.00000000000 FORMAT "%13.11" /end CHARACTERISTIC
/begin CHARACTERISTIC DDRC_RatDeb.AFS_SSpShOff_tiOLUDRat_C "DDRC/Verhältnis Defekt / Heilungsentprellung für Prüfung DFC_AFS_SSpShOffOL" VALUE 0x80025DB0 Val_Wu8 3.00000000000 DDRC_Ratio 1.00000000000 4.00000000000 FORMAT "%13.11" /end CHARACTERISTIC
/begin CHARACTERISTIC DDRC_RatDeb.AFS_SSpShOff_tiSCBUDRat_C "DDRC/Verhältnis Defekt / Heilungsentprellung für Prüfung DFC_AFS_SSpShOffSCB" VALUE 0x80025DB1 Val_Wu8 3.00000000000 DDRC_Ratio 1.00000000000 4.00000000000 FORMAT "%13.11" /end CHARACTERISTIC
/begin CHARACTERISTIC DDRC_RatDeb.AFS_SSpShOff_tiSCGUDRat_C "DDRC/Verhältnis Defekt / Heilungsentprellung für Prüfung DFC_AFS_SSpShOffSCG" VALUE 0x80025DB2 Val_Wu8 3.00000000000 DDRC_Ratio 1.00000000000 4.00000000000 FORMAT "%13.11" /end CHARACTERISTIC
/begin CHARACTERISTIC DDRC_RatDeb.EMDmp_tiOLUDRat_C "DDRC/Verhältnis Defekt / Heilungsentprellung für Prüfung DFC_EMDmpOL" VALUE 0x80025DB3 Val_Wu8 3.00000000000 DDRC_Ratio 1.00000000000 4.00000000000 FORMAT "%13.11" /end CHARACTERISTIC
/begin CHARACTERISTIC DDRC_RatDeb.CByVlv_tiSCBUDRat_C "DDRC/Verhältnis Defekt / Heilungsentprellung für Prüfung DFC_CByVlvSCB" VALUE 0x80025DB4 Val_Wu8 3.00000000000 DDRC_Ratio 1.00000000000 4.00000000000 FORMAT "%13.11" /end CHARACTERISTIC
/begin CHARACTERISTIC DDRC_RatDeb.AirC_tiCmprSCGUDRat_C "DDRC/Verhältnis Defekt / Heilungsentprellung für Prüfung DFC_AirCCmprSCG" VALUE 0x80025DB5 Val_Wu8 3.00000000000 DDRC_Ratio 1.00000000000 4.00000000000 FORMAT "%13.11" /end CHARACTERISTIC
/begin CHARACTERISTIC DDRC_RatDeb.TrbCh_tiSCBUDRat_C "DDRC/Verhältnis Defekt / Heilungsentprellung für Prüfung DFC_TrbChSCB" VALUE 0x80025DB6 Val_Wu8 3.00000000000 DDRC_Ratio 1.00000000000 4.00000000000 FORMAT "%13.11" /end CHARACTERISTIC
/begin CHARACTERISTIC DDRC_RatDeb.RailP_tiSRCMaxUDRat_C "DDRC/Verhältnis Defekt / Heilungsentprellung für Prüfung DFC_RailPSRCMax" VALUE 0x80025DB7 Val_Wu8 3.00000000000 DDRC_Ratio 1.00000000000 4.00000000000 FORMAT "%13.11" /end CHARACTERISTIC
/begin CHARACTERISTIC DDRC_RatDeb.SCRMon_numDFCPresRdcUDRat_C "DDRC/Verhältnis Defekt / Heilungsentprellung für Prüfung DFC_PresRdcMaxP" VALUE 0x80025DB8 Val_Wu8 3.00000000000 DDRC_Ratio 1.00000000000 4.00000000000 FORMAT "%13.11" /end CHARACTERISTIC
/begin CHARACTERISTIC DDRC_RatDeb.IVActr_numVltgSRCMaxUDRat_C "DDRC/Verhältnis Defekt / Heilungsentprellung für Prüfung DFC_IVActrVltgSRCMax" VALUE 0x80025DB9 Val_Wu8 3.00000000000 DDRC_Ratio 1.00000000000 4.00000000000 FORMAT "%13.11" /end CHARACTERISTIC
/begin CHARACTERISTIC DDRC_RatDeb.IVActr_numUChSRCMinUDRat_C "DDRC/Verhältnis Defekt / Heilungsentprellung für Prüfung DFC_IVActrUChSRCMin" VALUE 0x80025DBA Val_Wu8 3.00000000000 DDRC_Ratio 1.00000000000 4.00000000000 FORMAT "%13.11" /end CHARACTERISTIC
/begin CHARACTERISTIC DDRC_RatDeb.SCRMon_numDFCMetCtlUDRat_C "DDRC/Verhältnis Defekt / Heilungsentprellung für Prüfung DFC_SCRMonMetCtlPresErr" VALUE 0x80025DBB Val_Wu8 3.00000000000 DDRC_Ratio 1.00000000000 4.00000000000 FORMAT "%13.11" /end CHARACTERISTIC
/begin CHARACTERISTIC DDRC_RatDeb.IVPSply_numDCDCUDRat_C "DDRC/Verhältnis Defekt / Heilungsentprellung für Prüfung DFC_IVPSplyDCDC" VALUE 0x80025DBC Val_Wu8 3.00000000000 DDRC_Ratio 1.00000000000 4.00000000000 FORMAT "%13.11" /end CHARACTERISTIC
/begin CHARACTERISTIC DDRC_RatDeb.SCRMon_numDFCPresBuildUpUDRat_C "DDRC/Verhältnis Defekt / Heilungsentprellung für Prüfung DFC_SCRMonPresBuildUpErr" VALUE 0x80025DBD Val_Wu8 3.00000000000 DDRC_Ratio 1.00000000000 4.00000000000 FORMAT "%13.11" /end CHARACTERISTIC
/begin CHARACTERISTIC DDRC_RatDeb.SCRChk_numEtaErrUDRat_C "DDRC/Verhältnis Defekt / Heilungsentprellung für Prüfung DFC_SCREtaErr" VALUE 0x80025DBE Val_Wu8 3.00000000000 DDRC_Ratio 1.00000000000 4.00000000000 FORMAT "%13.11" /end CHARACTERISTIC
/begin CHARACTERISTIC DDRC_RatDeb.IVPSply_numVltgSRCMaxUDRat_C "DDRC/Verhältnis Defekt / Heilungsentprellung für Prüfung DFC_IVPSplyVltgSRCMax" VALUE 0x80025DBF Val_Wu8 3.00000000000 DDRC_Ratio 1.00000000000 4.00000000000 FORMAT "%13.11" /end CHARACTERISTIC
/begin CHARACTERISTIC DDRC_RatDeb.SCRChk_numEtaErr1UDRat_C "DDRC/Verhältnis Defekt / Heilungsentprellung für Prüfung DFC_SCREtaErr1" VALUE 0x80025DC0 Val_Wu8 3.00000000000 DDRC_Ratio 1.00000000000 4.00000000000 FORMAT "%13.11" /end CHARACTERISTIC
/begin CHARACTERISTIC DDRC_RatDeb.IVDia_numTunDetUDRat_C "DDRC/Verhältnis Defekt / Heilungsentprellung für Prüfung DFC_IVDiaTunDet" VALUE 0x80025DC1 Val_Wu8 3.00000000000 DDRC_Ratio 1.00000000000 4.00000000000 FORMAT "%13.11" /end CHARACTERISTIC
/begin CHARACTERISTIC DDRC_RatDeb.SCRChk_numEtaErr2UDRat_C "DDRC/Verhältnis Defekt / Heilungsentprellung für Prüfung DFC_SCREtaErr2" VALUE 0x80025DC2 Val_Wu8 3.00000000000 DDRC_Ratio 1.00000000000 4.00000000000 FORMAT "%13.11" /end CHARACTERISTIC
/begin CHARACTERISTIC DDRC_RatDeb.IVActr_numVltgSRCMinUDRat_C "DDRC/Verhältnis Defekt / Heilungsentprellung für Prüfung DFC_IVActrVltgSRCMin" VALUE 0x80025DC3 Val_Wu8 3.00000000000 DDRC_Ratio 1.00000000000 4.00000000000 FORMAT "%13.11" /end CHARACTERISTIC
/begin CHARACTERISTIC DDRC_RatDeb.IVActr_numUChSRCMaxUDRat_C "DDRC/Verhältnis Defekt / Heilungsentprellung für Prüfung DFC_IVActrUChSRCMax" VALUE 0x80025DC4 Val_Wu8 3.00000000000 DDRC_Ratio 1.00000000000 4.00000000000 FORMAT "%13.11" /end CHARACTERISTIC
/begin CHARACTERISTIC DDRC_RatDeb.IVPSply_numVltgSRCMinUDRat_C "DDRC/Verhältnis Defekt / Heilungsentprellung für Prüfung DFC_IVPSplyVltgSRCMin" VALUE 0x80025DC5 Val_Wu8 3.00000000000 DDRC_Ratio 1.00000000000 4.00000000000 FORMAT "%13.11" /end CHARACTERISTIC
/begin CHARACTERISTIC DDRC_RatDeb.Exh_tiPlausExhTMon1UDRat_C "DDRC/Verhältnis Defekt / Heilungsentprellung für Prüfung DFC_ExhTMonT1Plaus" VALUE 0x80025DC6 Val_Wu8 3.00000000000 DDRC_Ratio 1.00000000000 4.00000000000 FORMAT "%13.11" /end CHARACTERISTIC
/begin CHARACTERISTIC DDRC_RatDeb.Exh_tiMaxNSCDsUDRat_C "DDRC/Verhältnis Defekt / Heilungsentprellung für Prüfung DFC_NSCDsShCir" VALUE 0x80025DC7 Val_Wu8 3.00000000000 DDRC_Ratio 1.00000000000 4.00000000000 FORMAT "%13.11" /end CHARACTERISTIC
/begin CHARACTERISTIC DDRC_RatDeb.Air_tiDtyCycLoTAFSUDRat_C "DDRC/Verhältnis Defekt / Heilungsentprellung für Prüfung DFC_TAFSDtyCycLo" VALUE 0x80025DC8 Val_Wu8 3.00000000000 DDRC_Ratio 1.00000000000 4.00000000000 FORMAT "%13.11" /end CHARACTERISTIC
/begin CHARACTERISTIC DDRC_RatDeb.ECBVlv_tiSRCMaxUDRat_C "DDRC/Verhältnis Defekt / Heilungsentprellung für Prüfung DFC_ECBVlvSRCMax" VALUE 0x80025DC9 Val_Wu8 3.00000000000 DDRC_Ratio 1.00000000000 4.00000000000 FORMAT "%13.11" /end CHARACTERISTIC
/begin CHARACTERISTIC DDRC_RatDeb.Exh_tiLamPlausMinNoCat2DsUDRat_C "DDRC/Verhältnis Defekt / Heilungsentprellung für Prüfung DFC_NoCat2DsLamPlausMin" VALUE 0x80025DCA Val_Wu8 3.00000000000 DDRC_Ratio 1.00000000000 4.00000000000 FORMAT "%13.11" /end CHARACTERISTIC
/begin CHARACTERISTIC DDRC_RatDeb.VSwVlv_tiHBrgShCirGnd1UDRat_C "DDRC/Verhältnis Defekt / Heilungsentprellung für Prüfung DFC_VSwVlvHBrgShCirGnd1" VALUE 0x80025DCB Val_Wu8 3.00000000000 DDRC_Ratio 1.00000000000 4.00000000000 FORMAT "%13.11" /end CHARACTERISTIC
/begin CHARACTERISTIC DDRC_RatDeb.EGRVlv_tiSCGUDRat_C "DDRC/Verhältnis Defekt / Heilungsentprellung für Prüfung DFC_EGRVlvSCG" VALUE 0x80025DCC Val_Wu8 3.00000000000 DDRC_Ratio 1.00000000000 4.00000000000 FORMAT "%13.11" /end CHARACTERISTIC
/begin CHARACTERISTIC DDRC_RatDeb.FlFltDsP_tiMinUDRat_C "DDRC/Verhältnis Defekt / Heilungsentprellung für Prüfung DFC_FlFltDsPSRCMin" VALUE 0x80025DCD Val_Wu8 3.00000000000 DDRC_Ratio 1.00000000000 4.00000000000 FORMAT "%13.11" /end CHARACTERISTIC
/begin CHARACTERISTIC DDRC_RatDeb.InjVlv_tiPresMinUDRat_C "DDRC/Verhältnis Defekt / Heilungsentprellung für Prüfung DFC_InjVlvPresMin" VALUE 0x80025DCE Val_Wu8 3.00000000000 DDRC_Ratio 1.00000000000 4.00000000000 FORMAT "%13.11" /end CHARACTERISTIC
/begin CHARACTERISTIC DDRC_RatDeb.Exh_tiLamPlausMaxNSCDsUDRat_C "DDRC/Verhältnis Defekt / Heilungsentprellung für Prüfung DFC_NSCDsLamPlausMax" VALUE 0x80025DCF Val_Wu8 3.00000000000 DDRC_Ratio 1.00000000000 4.00000000000 FORMAT "%13.11" /end CHARACTERISTIC
/begin CHARACTERISTIC DDRC_RatDeb.Exh_tiNplDynPPFltDiffUDRat_C "DDRC/Verhältnis Defekt / Heilungsentprellung für Prüfung DFC_NplDynPPFltDiff" VALUE 0x80025DD0 Val_Wu8 3.00000000000 DDRC_Ratio 1.00000000000 4.00000000000 FORMAT "%13.11" /end CHARACTERISTIC
/begin CHARACTERISTIC DDRC_RatDeb.TECU_tiSRCMaxUDRat_C "DDRC/Verhältnis Defekt / Heilungsentprellung für Prüfung DFC_SRCMaxTECU" VALUE 0x80025DD1 Val_Wu8 3.00000000000 DDRC_Ratio 1.00000000000 4.00000000000 FORMAT "%13.11" /end CHARACTERISTIC
/begin CHARACTERISTIC DDRC_RatDeb.AFS_tiCorSRCMaxUDRat_C "DDRC/Verhältnis Defekt / Heilungsentprellung für Prüfung DFC_AFSSRCCorMax" VALUE 0x80025DD2 Val_Wu8 3.00000000000 DDRC_Ratio 1.00000000000 4.00000000000 FORMAT "%13.11" /end CHARACTERISTIC
/begin CHARACTERISTIC DDRC_RatDeb.Exh_tiExhTMon3PlausUDRat_C "DDRC/Verhältnis Defekt / Heilungsentprellung für Prüfung DFC_ExhTMonPlausPos3" VALUE 0x80025DD3 Val_Wu8 3.00000000000 DDRC_Ratio 1.00000000000 4.00000000000 FORMAT "%13.11" /end CHARACTERISTIC
/begin CHARACTERISTIC DDRC_RatDeb.Exh_tiLamPlausMinNSCDsUDRat_C "DDRC/Verhältnis Defekt / Heilungsentprellung für Prüfung DFC_NSCDsLamPlausMin" VALUE 0x80025DD4 Val_Wu8 3.00000000000 DDRC_Ratio 1.00000000000 4.00000000000 FORMAT "%13.11" /end CHARACTERISTIC
/begin CHARACTERISTIC DDRC_RatDeb.EGRVlvLP_tiHBrgShCirOvrLdUDRat_C "DDRC/Verhältnis Defekt / Heilungsentprellung für Prüfung DFC_EGRVlvLPHBrgShCirOvrLd" VALUE 0x80025DD5 Val_Wu8 3.00000000000 DDRC_Ratio 1.00000000000 4.00000000000 FORMAT "%13.11" /end CHARACTERISTIC
/begin CHARACTERISTIC DDRC_RatDeb.CrCUI_tiDetUDRat_C "DDRC/Verhältnis Defekt / Heilungsentprellung für Prüfung DFC_CrCUIDet" VALUE 0x80025DD6 Val_Wu8 3.00000000000 DDRC_Ratio 1.00000000000 4.00000000000 FORMAT "%13.11" /end CHARACTERISTIC
/begin CHARACTERISTIC DDRC_RatDeb.CEngDsT_tiMaxUDRat_C "DDRC/Verhältnis Defekt / Heilungsentprellung für Prüfung DFC_CEngDsTSRCMax" VALUE 0x80025DD7 Val_Wu8 3.00000000000 DDRC_Ratio 1.00000000000 4.00000000000 FORMAT "%13.11" /end CHARACTERISTIC
/begin CHARACTERISTIC DDRC_RatDeb.MeUn_tiSCGUDRat_C "DDRC/Verhältnis Defekt / Heilungsentprellung für Prüfung DFC_MeUnSCG" VALUE 0x80025DD8 Val_Wu8 3.00000000000 DDRC_Ratio 1.00000000000 4.00000000000 FORMAT "%13.11" /end CHARACTERISTIC
/begin CHARACTERISTIC DDRC_RatDeb.FlFltUsP_tiMinUDRat_C "DDRC/Verhältnis Defekt / Heilungsentprellung für Prüfung DFC_FlFltUsPSRCMin" VALUE 0x80025DD9 Val_Wu8 3.00000000000 DDRC_Ratio 1.00000000000 4.00000000000 FORMAT "%13.11" /end CHARACTERISTIC
/begin CHARACTERISTIC DDRC_RatDeb.EGRVlv_tiHBrgShCirOvrLdUDRat_C "DDRC/Verhältnis Defekt / Heilungsentprellung für Prüfung DFC_EGRVlvHBrgShCirOvrLd" VALUE 0x80025DDA Val_Wu8 3.00000000000 DDRC_Ratio 1.00000000000 4.00000000000 FORMAT "%13.11" /end CHARACTERISTIC
/begin CHARACTERISTIC DDRC_RatDeb.UHtrTnk_tiSCGUDRat_C "DDRC/Verhältnis Defekt / Heilungsentprellung für Prüfung DFC_UHtrTnkSCG" VALUE 0x80025DDB Val_Wu8 3.00000000000 DDRC_Ratio 1.00000000000 4.00000000000 FORMAT "%13.11" /end CHARACTERISTIC
/begin CHARACTERISTIC DDRC_RatDeb.Exh_tiSRCLamLinNSCDsUDRat_C "DDRC/Verhältnis Defekt / Heilungsentprellung für Prüfung DFC_NSCDsLamLinSRCMax" VALUE 0x80025DDC Val_Wu8 3.00000000000 DDRC_Ratio 1.00000000000 4.00000000000 FORMAT "%13.11" /end CHARACTERISTIC
/begin CHARACTERISTIC DDRC_RatDeb.EngPrt_tiOvrSpdUDRat_C "DDRC/Verhältnis Defekt / Heilungsentprellung für Prüfung DFC_EngPrtOvrSpd" VALUE 0x80025DDD Val_Wu8 3.00000000000 DDRC_Ratio 1.00000000000 4.00000000000 FORMAT "%13.11" /end CHARACTERISTIC
/begin CHARACTERISTIC DDRC_RatDeb.SCR_tiSRCMinUTnkTUDRat_C "DDRC/Verhältnis Defekt / Heilungsentprellung für Prüfung DFC_UTnkTSRCMin" VALUE 0x80025DDE Val_Wu8 3.00000000000 DDRC_Ratio 1.00000000000 4.00000000000 FORMAT "%13.11" /end CHARACTERISTIC
/begin CHARACTERISTIC DDRC_RatDeb.UHtrPL_tiSRCMinDiaUDRat_C "DDRC/Verhältnis Defekt / Heilungsentprellung für Prüfung DFC_UHtrPLSRCMinDia" VALUE 0x80025DDF Val_Wu8 3.00000000000 DDRC_Ratio 1.00000000000 4.00000000000 FORMAT "%13.11" /end CHARACTERISTIC
/begin CHARACTERISTIC DDRC_RatDeb.FlFlt_tiSigUDRat_C "DDRC/Verhältnis Defekt / Heilungsentprellung für Prüfung DFC_FlFltSig" VALUE 0x80025DE0 Val_Wu8 3.00000000000 DDRC_Ratio 1.00000000000 4.00000000000 FORMAT "%13.11" /end CHARACTERISTIC
/begin CHARACTERISTIC DDRC_RatDeb.FuelT_tiMaxUDRat_C "DDRC/Verhältnis Defekt / Heilungsentprellung für Prüfung DFC_FuelTSRCMax" VALUE 0x80025DE1 Val_Wu8 3.00000000000 DDRC_Ratio 1.00000000000 4.00000000000 FORMAT "%13.11" /end CHARACTERISTIC
/begin CHARACTERISTIC DDRC_RatDeb.SCR_tiSRCMinUCatUsTUDRat_C "DDRC/Verhältnis Defekt / Heilungsentprellung für Prüfung DFC_SRCMinUCatUsT" VALUE 0x80025DE2 Val_Wu8 3.00000000000 DDRC_Ratio 1.00000000000 4.00000000000 FORMAT "%13.11" /end CHARACTERISTIC
/begin CHARACTERISTIC DDRC_RatDeb.Exh_tiCmpChkNoCat2DsUDRat_C "DDRC/Verhältnis Defekt / Heilungsentprellung für Prüfung DFC_NoCat2DsCmpChk" VALUE 0x80025DE3 Val_Wu8 3.00000000000 DDRC_Ratio 1.00000000000 4.00000000000 FORMAT "%13.11" /end CHARACTERISTIC
/begin CHARACTERISTIC DDRC_RatDeb.BrkP_tiMinUDRat_C "DDRC/Verhältnis Defekt / Heilungsentprellung für Prüfung DFC_BrkPSRCMin" VALUE 0x80025DE4 Val_Wu8 3.00000000000 DDRC_Ratio 1.00000000000 4.00000000000 FORMAT "%13.11" /end CHARACTERISTIC
/begin CHARACTERISTIC DDRC_RatDeb.T15_tiNplUDRat_C "DDRC/Verhältnis Defekt / Heilungsentprellung für Prüfung DFC_T15Npl" VALUE 0x80025DE5 Val_Wu8 3.00000000000 DDRC_Ratio 1.00000000000 4.00000000000 FORMAT "%13.11" /end CHARACTERISTIC
/begin CHARACTERISTIC DDRC_RatDeb.EGRVlv_tiHBrgTempOvrCurrUDRat_C "DDRC/Verhältnis Defekt / Heilungsentprellung für Prüfung DFC_EGRVlvHBrgTempOvrCurr" VALUE 0x80025DE6 Val_Wu8 3.00000000000 DDRC_Ratio 1.00000000000 4.00000000000 FORMAT "%13.11" /end CHARACTERISTIC
/begin CHARACTERISTIC DDRC_RatDeb.UHtrTnk_tiSCBUDRat_C "DDRC/Verhältnis Defekt / Heilungsentprellung für Prüfung DFC_UHtrTnkSCB" VALUE 0x80025DE7 Val_Wu8 3.00000000000 DDRC_Ratio 1.00000000000 4.00000000000 FORMAT "%13.11" /end CHARACTERISTIC
/begin CHARACTERISTIC DDRC_RatDeb.Exh_tiSRCNOxNoCat2DsUDRat_C "DDRC/Verhältnis Defekt / Heilungsentprellung für Prüfung DFC_NoCat2DsNOxSRCMin" VALUE 0x80025DE8 Val_Wu8 3.00000000000 DDRC_Ratio 1.00000000000 4.00000000000 FORMAT "%13.11" /end CHARACTERISTIC
/begin CHARACTERISTIC DDRC_RatDeb.PFlt_tiDstrMinUDRat_C "DDRC/Verhältnis Defekt / Heilungsentprellung für Prüfung DFC_PFltDstrMin" VALUE 0x80025DE9 Val_Wu8 3.00000000000 DDRC_Ratio 1.00000000000 4.00000000000 FORMAT "%13.11" /end CHARACTERISTIC
/begin CHARACTERISTIC DDRC_RatDeb.AFS_tiOffsDrftMaxUDRat_C "DDRC/Verhältnis Defekt / Heilungsentprellung für Prüfung DFC_AFSOffsDrftMax" VALUE 0x80025DEA Val_Wu8 3.00000000000 DDRC_Ratio 1.00000000000 4.00000000000 FORMAT "%13.11" /end CHARACTERISTIC
/begin CHARACTERISTIC DDRC_RatDeb.PFlt_tiSRCMinFlwRstnUDRat_C "DDRC/Verhältnis Defekt / Heilungsentprellung für Prüfung DFC_PFltSRCMinFlwRstn" VALUE 0x80025DEB Val_Wu8 3.00000000000 DDRC_Ratio 1.00000000000 4.00000000000 FORMAT "%13.11" /end CHARACTERISTIC
/begin CHARACTERISTIC DDRC_RatDeb.Exh_tiSRCMinTTrbnUsUDRat_C "DDRC/Verhältnis Defekt / Heilungsentprellung für Prüfung DFC_SRCMinTTrbnUs" VALUE 0x80025DEC Val_Wu8 3.00000000000 DDRC_Ratio 1.00000000000 4.00000000000 FORMAT "%13.11" /end CHARACTERISTIC
/begin CHARACTERISTIC DDRC_RatDeb.EGRVlvLP_tiSCGUDRat_C "DDRC/Verhältnis Defekt / Heilungsentprellung für Prüfung DFC_EGRVlvLPSCG" VALUE 0x80025DED Val_Wu8 3.00000000000 DDRC_Ratio 1.00000000000 4.00000000000 FORMAT "%13.11" /end CHARACTERISTIC
/begin CHARACTERISTIC DDRC_RatDeb.AirC_tiSwtNplUDRat_C "DDRC/Verhältnis Defekt / Heilungsentprellung für Prüfung DFC_AirCSwtNpl" VALUE 0x80025DEE Val_Wu8 3.00000000000 DDRC_Ratio 1.00000000000 4.00000000000 FORMAT "%13.11" /end CHARACTERISTIC
/begin CHARACTERISTIC DDRC_RatDeb.EGRVlv_tiHBrgShCirBatt1UDRat_C "DDRC/Verhältnis Defekt / Heilungsentprellung für Prüfung DFC_EGRVlvHBrgShCirBatt1" VALUE 0x80025DEF Val_Wu8 3.00000000000 DDRC_Ratio 1.00000000000 4.00000000000 FORMAT "%13.11" /end CHARACTERISTIC
/begin CHARACTERISTIC DDRC_RatDeb.SCR_tiSRCMaxUPmpPUDRat_C "DDRC/Verhältnis Defekt / Heilungsentprellung für Prüfung DFC_SRCMaxUPmpP" VALUE 0x80025DF0 Val_Wu8 3.00000000000 DDRC_Ratio 1.00000000000 4.00000000000 FORMAT "%13.11" /end CHARACTERISTIC
/begin CHARACTERISTIC DDRC_RatDeb.URevVlv_tiSCBUDRat_C "DDRC/Verhältnis Defekt / Heilungsentprellung für Prüfung DFC_URevVlvSCB" VALUE 0x80025DF1 Val_Wu8 3.00000000000 DDRC_Ratio 1.00000000000 4.00000000000 FORMAT "%13.11" /end CHARACTERISTIC
/begin CHARACTERISTIC DDRC_RatDeb.Exh_tiSigNSCDsUDRat_C "DDRC/Verhältnis Defekt / Heilungsentprellung für Prüfung DFC_NSCDsOpCir" VALUE 0x80025DF2 Val_Wu8 3.00000000000 DDRC_Ratio 1.00000000000 4.00000000000 FORMAT "%13.11" /end CHARACTERISTIC
/begin CHARACTERISTIC DDRC_RatDeb.EGRVlvLP_tiHBrgUndrVltgUDRat_C "DDRC/Verhältnis Defekt / Heilungsentprellung für Prüfung DFC_EGRVlvLPHBrgUndrVltg" VALUE 0x80025DF3 Val_Wu8 3.00000000000 DDRC_Ratio 1.00000000000 4.00000000000 FORMAT "%13.11" /end CHARACTERISTIC
/begin CHARACTERISTIC DDRC_RatDeb.PFlt_tiEngPrtMaxUDRat_C "DDRC/Verhältnis Defekt / Heilungsentprellung für Prüfung DFC_PFltEngPrt" VALUE 0x80025DF4 Val_Wu8 3.00000000000 DDRC_Ratio 1.00000000000 4.00000000000 FORMAT "%13.11" /end CHARACTERISTIC
/begin CHARACTERISTIC DDRC_RatDeb.Exh_tiSigNoCat2DsUDRat_C "DDRC/Verhältnis Defekt / Heilungsentprellung für Prüfung DFC_NoCat2DsOpCir" VALUE 0x80025DF5 Val_Wu8 3.00000000000 DDRC_Ratio 1.00000000000 4.00000000000 FORMAT "%13.11" /end CHARACTERISTIC
/begin CHARACTERISTIC DDRC_RatDeb.FlFltUsP_tiMaxUDRat_C "DDRC/Verhältnis Defekt / Heilungsentprellung für Prüfung DFC_FlFltUsPSRCMax" VALUE 0x80025DF6 Val_Wu8 3.00000000000 DDRC_Ratio 1.00000000000 4.00000000000 FORMAT "%13.11" /end CHARACTERISTIC
/begin CHARACTERISTIC DDRC_RatDeb.VSwVlv_tiHBrgShCirOvrLdUDRat_C "DDRC/Verhältnis Defekt / Heilungsentprellung für Prüfung DFC_VSwVlvHBrgShCirOvrLd" VALUE 0x80025DF7 Val_Wu8 3.00000000000 DDRC_Ratio 1.00000000000 4.00000000000 FORMAT "%13.11" /end CHARACTERISTIC
/begin CHARACTERISTIC DDRC_RatDeb.SCR_tiSRCMaxUTnkTUDRat_C "DDRC/Verhältnis Defekt / Heilungsentprellung für Prüfung DFC_UTnkTSRCMax" VALUE 0x80025DF8 Val_Wu8 3.00000000000 DDRC_Ratio 1.00000000000 4.00000000000 FORMAT "%13.11" /end CHARACTERISTIC
/begin CHARACTERISTIC DDRC_RatDeb.GbxNPos_tiSRCPerMinUDRat_C "DDRC/Verhältnis Defekt / Heilungsentprellung für Prüfung DFC_GbxNPosPPerSRCMin" VALUE 0x80025DF9 Val_Wu8 3.00000000000 DDRC_Ratio 1.00000000000 4.00000000000 FORMAT "%13.11" /end CHARACTERISTIC
/begin CHARACTERISTIC DDRC_RatDeb.EGRVlvLP_tiGovDvtMaxUDRat_C "DDRC/Verhältnis Defekt / Heilungsentprellung für Prüfung DFC_EGRVlvLPGovDvtMax" VALUE 0x80025DFA Val_Wu8 3.00000000000 DDRC_Ratio 1.00000000000 4.00000000000 FORMAT "%13.11" /end CHARACTERISTIC
/begin CHARACTERISTIC DDRC_RatDeb.Exh_tiSRCLamBinNoCat2DsUDRat_C "DDRC/Verhältnis Defekt / Heilungsentprellung für Prüfung DFC_NoCat2DsLamBinSRCMin" VALUE 0x80025DFB Val_Wu8 3.00000000000 DDRC_Ratio 1.00000000000 4.00000000000 FORMAT "%13.11" /end CHARACTERISTIC
/begin CHARACTERISTIC DDRC_RatDeb.AFS_tiRawSRCMaxUDRat_C "DDRC/Verhältnis Defekt / Heilungsentprellung für Prüfung DFC_AFSSRCRawMax" VALUE 0x80025DFC Val_Wu8 3.00000000000 DDRC_Ratio 1.00000000000 4.00000000000 FORMAT "%13.11" /end CHARACTERISTIC
/begin CHARACTERISTIC DDRC_RatDeb.UHtrPL_tiSCGUDRat_C "DDRC/Verhältnis Defekt / Heilungsentprellung für Prüfung DFC_UHtrPLSCG" VALUE 0x80025DFD Val_Wu8 3.00000000000 DDRC_Ratio 1.00000000000 4.00000000000 FORMAT "%13.11" /end CHARACTERISTIC
/begin CHARACTERISTIC DDRC_RatDeb.UHtrPL_tiSCBUDRat_C "DDRC/Verhältnis Defekt / Heilungsentprellung für Prüfung DFC_UHtrPLSCB" VALUE 0x80025DFE Val_Wu8 3.00000000000 DDRC_Ratio 1.00000000000 4.00000000000 FORMAT "%13.11" /end CHARACTERISTIC
/begin CHARACTERISTIC DDRC_RatDeb.VSwVlv_tiHBrgShCirGnd2UDRat_C "DDRC/Verhältnis Defekt / Heilungsentprellung für Prüfung DFC_VSwVlvHBrgShCirGnd2" VALUE 0x80025DFF Val_Wu8 3.00000000000 DDRC_Ratio 1.00000000000 4.00000000000 FORMAT "%13.11" /end CHARACTERISTIC
/begin CHARACTERISTIC DDRC_RatDeb.URevVlv_tiSCGUDRat_C "DDRC/Verhältnis Defekt / Heilungsentprellung für Prüfung DFC_URevVlvSCG" VALUE 0x80025E00 Val_Wu8 3.00000000000 DDRC_Ratio 1.00000000000 4.00000000000 FORMAT "%13.11" /end CHARACTERISTIC
/begin CHARACTERISTIC DDRC_RatDeb.Exh_tiSRCNOxNSCDsUDRat_C "DDRC/Verhältnis Defekt / Heilungsentprellung für Prüfung DFC_NSCDsNOxSRCMin" VALUE 0x80025E01 Val_Wu8 3.00000000000 DDRC_Ratio 1.00000000000 4.00000000000 FORMAT "%13.11" /end CHARACTERISTIC
/begin CHARACTERISTIC DDRC_RatDeb.BattU_tiMaxUDRat_C "DDRC/Verhältnis Defekt / Heilungsentprellung für Prüfung DFC_BattUSRCMax" VALUE 0x80025E02 Val_Wu8 3.00000000000 DDRC_Ratio 1.00000000000 4.00000000000 FORMAT "%13.11" /end CHARACTERISTIC
/begin CHARACTERISTIC DDRC_RatDeb.Air_tiMinTCACDsUDRat_C "DDRC/Verhältnis Defekt / Heilungsentprellung für Prüfung DFC_TCACDsSRCMin" VALUE 0x80025E03 Val_Wu8 3.00000000000 DDRC_Ratio 1.00000000000 4.00000000000 FORMAT "%13.11" /end CHARACTERISTIC
/begin CHARACTERISTIC DDRC_RatDeb.EGRVlv_tiSCBUDRat_C "DDRC/Verhältnis Defekt / Heilungsentprellung für Prüfung DFC_EGRVlvSCB" VALUE 0x80025E04 Val_Wu8 3.00000000000 DDRC_Ratio 1.00000000000 4.00000000000 FORMAT "%13.11" /end CHARACTERISTIC
/begin CHARACTERISTIC DDRC_RatDeb.FuelT_tiMinUDRat_C "DDRC/Verhältnis Defekt / Heilungsentprellung für Prüfung DFC_FuelTSRCMin" VALUE 0x80025E05 Val_Wu8 3.00000000000 DDRC_Ratio 1.00000000000 4.00000000000 FORMAT "%13.11" /end CHARACTERISTIC
/begin CHARACTERISTIC DDRC_RatDeb.Oil_tiSRCMaxPSwmpUDRat_C "DDRC/Verhältnis Defekt / Heilungsentprellung für Prüfung DFC_OilPSwmpSRCMax" VALUE 0x80025E06 Val_Wu8 3.00000000000 DDRC_Ratio 1.00000000000 4.00000000000 FORMAT "%13.11" /end CHARACTERISTIC
/begin CHARACTERISTIC DDRC_RatDeb.EGRVlv_tiHBrgShCirGnd2UDRat_C "DDRC/Verhältnis Defekt / Heilungsentprellung für Prüfung DFC_EGRVlvHBrgShCirGnd2" VALUE 0x80025E07 Val_Wu8 3.00000000000 DDRC_Ratio 1.00000000000 4.00000000000 FORMAT "%13.11" /end CHARACTERISTIC
/begin CHARACTERISTIC DDRC_RatDeb.Exh_tiNplTTrbnUsUDRat_C "DDRC/Verhältnis Defekt / Heilungsentprellung für Prüfung DFC_NplTTrbnUs" VALUE 0x80025E08 Val_Wu8 3.00000000000 DDRC_Ratio 1.00000000000 4.00000000000 FORMAT "%13.11" /end CHARACTERISTIC
/begin CHARACTERISTIC DDRC_RatDeb.EGRVlvLP_tiHBrgShCirBatt2UDRat_C "DDRC/Verhältnis Defekt / Heilungsentprellung für Prüfung DFC_EGRVlvLPHBrgShCirBatt2" VALUE 0x80025E09 Val_Wu8 3.00000000000 DDRC_Ratio 1.00000000000 4.00000000000 FORMAT "%13.11" /end CHARACTERISTIC
/begin CHARACTERISTIC DDRC_RatDeb.Air_tiMaxTCACDsUDRat_C "DDRC/Verhältnis Defekt / Heilungsentprellung für Prüfung DFC_TCACDsSRCMax" VALUE 0x80025E0A Val_Wu8 3.00000000000 DDRC_Ratio 1.00000000000 4.00000000000 FORMAT "%13.11" /end CHARACTERISTIC
/begin CHARACTERISTIC DDRC_RatDeb.TrbChLP_tiSCGUDRat_C "DDRC/Verhältnis Defekt / Heilungsentprellung für Prüfung DFC_TrbChLPSCG" VALUE 0x80025E0B Val_Wu8 3.00000000000 DDRC_Ratio 1.00000000000 4.00000000000 FORMAT "%13.11" /end CHARACTERISTIC
/begin CHARACTERISTIC DDRC_RatDeb.LSU_tiO2MaxUDRat_C "DDRC/Verhältnis Defekt / Heilungsentprellung für Prüfung DFC_LSUO2Max" VALUE 0x80025E0C Val_Wu8 3.00000000000 DDRC_Ratio 1.00000000000 4.00000000000 FORMAT "%13.11" /end CHARACTERISTIC
/begin CHARACTERISTIC DDRC_RatDeb.Exh_tiNplTPFltUsUDRat_C "DDRC/Verhältnis Defekt / Heilungsentprellung für Prüfung DFC_NplTPFltUs" VALUE 0x80025E0D Val_Wu8 3.00000000000 DDRC_Ratio 1.00000000000 4.00000000000 FORMAT "%13.11" /end CHARACTERISTIC
/begin CHARACTERISTIC DDRC_RatDeb.LSU_tiOpnLdUDRat_C "DDRC/Verhältnis Defekt / Heilungsentprellung für Prüfung DFC_LSUCircVirtGndSig" VALUE 0x80025E0E Val_Wu8 3.00000000000 DDRC_Ratio 1.00000000000 4.00000000000 FORMAT "%13.11" /end CHARACTERISTIC
/begin CHARACTERISTIC DDRC_RatDeb.EGRVlvLP_tiSRCMinUDRat_C "DDRC/Verhältnis Defekt / Heilungsentprellung für Prüfung DFC_EGRVlvLPSRCMin" VALUE 0x80025E0F Val_Wu8 3.00000000000 DDRC_Ratio 1.00000000000 4.00000000000 FORMAT "%13.11" /end CHARACTERISTIC
/begin CHARACTERISTIC DDRC_RatDeb.TECU_tiOvrTempUDRat_C "DDRC/Verhältnis Defekt / Heilungsentprellung für Prüfung DFC_ECUOvrTemp" VALUE 0x80025E10 Val_Wu8 3.00000000000 DDRC_Ratio 1.00000000000 4.00000000000 FORMAT "%13.11" /end CHARACTERISTIC
/begin CHARACTERISTIC DDRC_RatDeb.AFS_tiSetyDrftMinUDRat_C "DDRC/Verhältnis Defekt / Heilungsentprellung für Prüfung DFC_AFSSetyDrftMin" VALUE 0x80025E11 Val_Wu8 3.00000000000 DDRC_Ratio 1.00000000000 4.00000000000 FORMAT "%13.11" /end CHARACTERISTIC
/begin CHARACTERISTIC DDRC_RatDeb.VSwVlv_tiGovDvtMinUDRat_C "DDRC/Verhältnis Defekt / Heilungsentprellung für Prüfung DFC_VSwVlvGovDvtMin" VALUE 0x80025E12 Val_Wu8 3.00000000000 DDRC_Ratio 1.00000000000 4.00000000000 FORMAT "%13.11" /end CHARACTERISTIC
/begin CHARACTERISTIC DDRC_RatDeb.CEngDsT_tiMinUDRat_C "DDRC/Verhältnis Defekt / Heilungsentprellung für Prüfung DFC_CEngDsTSRCMin" VALUE 0x80025E13 Val_Wu8 3.00000000000 DDRC_Ratio 1.00000000000 4.00000000000 FORMAT "%13.11" /end CHARACTERISTIC
/begin CHARACTERISTIC DDRC_RatDeb.SCR_tiSRCMinUPmpPUDRat_C "DDRC/Verhältnis Defekt / Heilungsentprellung für Prüfung DFC_SRCMinUPmpP" VALUE 0x80025E14 Val_Wu8 3.00000000000 DDRC_Ratio 1.00000000000 4.00000000000 FORMAT "%13.11" /end CHARACTERISTIC
/begin CHARACTERISTIC DDRC_RatDeb.EGRVlvLP_tiHBrgOvrCurrUDRat_C "DDRC/Verhältnis Defekt / Heilungsentprellung für Prüfung DFC_EGRVlvLPHBrgOvrCurr" VALUE 0x80025E15 Val_Wu8 3.00000000000 DDRC_Ratio 1.00000000000 4.00000000000 FORMAT "%13.11" /end CHARACTERISTIC
/begin CHARACTERISTIC DDRC_RatDeb.ThrVlv_tiSRCMaxUDRat_C "DDRC/Verhältnis Defekt / Heilungsentprellung für Prüfung DFC_ThrVlvSRCMax" VALUE 0x80025E16 Val_Wu8 3.00000000000 DDRC_Ratio 1.00000000000 4.00000000000 FORMAT "%13.11" /end CHARACTERISTIC
/begin CHARACTERISTIC DDRC_RatDeb.EnvP_tiMinUDRat_C "DDRC/Verhältnis Defekt / Heilungsentprellung für Prüfung DFC_EnvPSRCMin" VALUE 0x80025E17 Val_Wu8 3.00000000000 DDRC_Ratio 1.00000000000 4.00000000000 FORMAT "%13.11" /end CHARACTERISTIC
/begin CHARACTERISTIC DDRC_RatDeb.LSU_tiShCirUDRat_C "DDRC/Verhältnis Defekt / Heilungsentprellung für Prüfung DFC_LSUWireSCG" VALUE 0x80025E18 Val_Wu8 3.00000000000 DDRC_Ratio 1.00000000000 4.00000000000 FORMAT "%13.11" /end CHARACTERISTIC
/begin CHARACTERISTIC DDRC_RatDeb.EGRVlv_tiHBrgShCirBatt2UDRat_C "DDRC/Verhältnis Defekt / Heilungsentprellung für Prüfung DFC_EGRVlvHBrgShCirBatt2" VALUE 0x80025E19 Val_Wu8 3.00000000000 DDRC_Ratio 1.00000000000 4.00000000000 FORMAT "%13.11" /end CHARACTERISTIC
/begin CHARACTERISTIC DDRC_RatDeb.AFS_tiSetyDrftMaxUDRat_C "DDRC/Verhältnis Defekt / Heilungsentprellung für Prüfung DFC_AFSSetyDrftMax" VALUE 0x80025E1A Val_Wu8 3.00000000000 DDRC_Ratio 1.00000000000 4.00000000000 FORMAT "%13.11" /end CHARACTERISTIC
/begin CHARACTERISTIC DDRC_RatDeb.VSwVlv_tiHBrgOvrTempUDRat_C "DDRC/Verhältnis Defekt / Heilungsentprellung für Prüfung DFC_VSwVlvHBrgOvrTemp" VALUE 0x80025E1B Val_Wu8 3.00000000000 DDRC_Ratio 1.00000000000 4.00000000000 FORMAT "%13.11" /end CHARACTERISTIC
/begin CHARACTERISTIC DDRC_RatDeb.Exh_tiSRCMaxTPFltUsUDRat_C "DDRC/Verhältnis Defekt / Heilungsentprellung für Prüfung DFC_SRCMaxTPFltUs" VALUE 0x80025E1C Val_Wu8 3.00000000000 DDRC_Ratio 1.00000000000 4.00000000000 FORMAT "%13.11" /end CHARACTERISTIC
/begin CHARACTERISTIC DDRC_RatDeb.EGRVlvLP_tiSRCMaxUDRat_C "DDRC/Verhältnis Defekt / Heilungsentprellung für Prüfung DFC_EGRVlvLPSRCMax" VALUE 0x80025E1D Val_Wu8 3.00000000000 DDRC_Ratio 1.00000000000 4.00000000000 FORMAT "%13.11" /end CHARACTERISTIC
/begin CHARACTERISTIC DDRC_RatDeb.EGRVlv_tiHBrgOvrCurrUDRat_C "DDRC/Verhältnis Defekt / Heilungsentprellung für Prüfung DFC_EGRVlvHBrgOvrCurr" VALUE 0x80025E1E Val_Wu8 3.00000000000 DDRC_Ratio 1.00000000000 4.00000000000 FORMAT "%13.11" /end CHARACTERISTIC
/begin CHARACTERISTIC DDRC_RatDeb.EGRVlv_tiOLUDRat_C "DDRC/Verhältnis Defekt / Heilungsentprellung für Prüfung DFC_EGRVlvOL" VALUE 0x80025E1F Val_Wu8 3.00000000000 DDRC_Ratio 1.00000000000 4.00000000000 FORMAT "%13.11" /end CHARACTERISTIC
/begin CHARACTERISTIC DDRC_RatDeb.AFS_tiOffsDrftMinUDRat_C "DDRC/Verhältnis Defekt / Heilungsentprellung für Prüfung DFC_AFSOffsDrftMin" VALUE 0x80025E20 Val_Wu8 3.00000000000 DDRC_Ratio 1.00000000000 4.00000000000 FORMAT "%13.11" /end CHARACTERISTIC
/begin CHARACTERISTIC DDRC_RatDeb.UHtrTnk_tiSRCMaxDiaUDRat_C "DDRC/Verhältnis Defekt / Heilungsentprellung für Prüfung DFC_UHtrTnkSRCMaxDia" VALUE 0x80025E21 Val_Wu8 3.00000000000 DDRC_Ratio 1.00000000000 4.00000000000 FORMAT "%13.11" /end CHARACTERISTIC
/begin CHARACTERISTIC DDRC_RatDeb.PFlt_tiCharPDiffMinUDRat_C "DDRC/Verhältnis Defekt / Heilungsentprellung für Prüfung DFC_PFltCharPDiffMin" VALUE 0x80025E22 Val_Wu8 3.00000000000 DDRC_Ratio 1.00000000000 4.00000000000 FORMAT "%13.11" /end CHARACTERISTIC
/begin CHARACTERISTIC DDRC_RatDeb.Exh_tiHsLnPPFltDiffUDRat_C "DDRC/Verhältnis Defekt / Heilungsentprellung für Prüfung DFC_NplHsLnPPFltDiff" VALUE 0x80025E23 Val_Wu8 3.00000000000 DDRC_Ratio 1.00000000000 4.00000000000 FORMAT "%13.11" /end CHARACTERISTIC
/begin CHARACTERISTIC DDRC_RatDeb.Exh_tiExhTMon1PlausUDRat_C "DDRC/Verhältnis Defekt / Heilungsentprellung für Prüfung DFC_ExhTMonPlausPos1" VALUE 0x80025E24 Val_Wu8 3.00000000000 DDRC_Ratio 1.00000000000 4.00000000000 FORMAT "%13.11" /end CHARACTERISTIC
/begin CHARACTERISTIC DDRC_RatDeb.TrbChLP_tiOLUDRat_C "DDRC/Verhältnis Defekt / Heilungsentprellung für Prüfung DFC_TrbChLPOL" VALUE 0x80025E25 Val_Wu8 3.00000000000 DDRC_Ratio 1.00000000000 4.00000000000 FORMAT "%13.11" /end CHARACTERISTIC
/begin CHARACTERISTIC DDRC_RatDeb.UHtrTnk_tiOLUDRat_C "DDRC/Verhältnis Defekt / Heilungsentprellung für Prüfung DFC_UHtrTnkOL" VALUE 0x80025E26 Val_Wu8 3.00000000000 DDRC_Ratio 1.00000000000 4.00000000000 FORMAT "%13.11" /end CHARACTERISTIC
/begin CHARACTERISTIC DDRC_RatDeb.Exh_tiSRCMinTPFltUsUDRat_C "DDRC/Verhältnis Defekt / Heilungsentprellung für Prüfung DFC_SRCMinTPFltUs" VALUE 0x80025E27 Val_Wu8 3.00000000000 DDRC_Ratio 1.00000000000 4.00000000000 FORMAT "%13.11" /end CHARACTERISTIC
/begin CHARACTERISTIC DDRC_RatDeb.EGRVlv_tiGovDvtMinUDRat_C "DDRC/Verhältnis Defekt / Heilungsentprellung für Prüfung DFC_EGRVlvGovDvtMin" VALUE 0x80025E28 Val_Wu8 3.00000000000 DDRC_Ratio 1.00000000000 4.00000000000 FORMAT "%13.11" /end CHARACTERISTIC
/begin CHARACTERISTIC DDRC_RatDeb.LSU_tiSPIBattLowMinUDRat_C "DDRC/Verhältnis Defekt / Heilungsentprellung für Prüfung DFC_LSUSPIBattLowMin" VALUE 0x80025E29 Val_Wu8 3.00000000000 DDRC_Ratio 1.00000000000 4.00000000000 FORMAT "%13.11" /end CHARACTERISTIC
/begin CHARACTERISTIC DDRC_RatDeb.VSwVlv_tiHBrgOpnLdUDRat_C "DDRC/Verhältnis Defekt / Heilungsentprellung für Prüfung DFC_VSwVlvHBrgOpnLd" VALUE 0x80025E2A Val_Wu8 3.00000000000 DDRC_Ratio 1.00000000000 4.00000000000 FORMAT "%13.11" /end CHARACTERISTIC
/begin CHARACTERISTIC DDRC_RatDeb.VSwVlv_tiOLUDRat_C "DDRC/Verhältnis Defekt / Heilungsentprellung für Prüfung DFC_VSwVlvOL" VALUE 0x80025E2B Val_Wu8 3.00000000000 DDRC_Ratio 1.00000000000 4.00000000000 FORMAT "%13.11" /end CHARACTERISTIC
/begin CHARACTERISTIC DDRC_RatDeb.Exh_tiSRCMaxTTrbnUsUDRat_C "DDRC/Verhältnis Defekt / Heilungsentprellung für Prüfung DFC_SRCMaxTTrbnUs" VALUE 0x80025E2C Val_Wu8 3.00000000000 DDRC_Ratio 1.00000000000 4.00000000000 FORMAT "%13.11" /end CHARACTERISTIC
/begin CHARACTERISTIC DDRC_RatDeb.UHtrPL_tiSRCMaxDiaUDRat_C "DDRC/Verhältnis Defekt / Heilungsentprellung für Prüfung DFC_UHtrPLSRCMaxDia" VALUE 0x80025E2D Val_Wu8 3.00000000000 DDRC_Ratio 1.00000000000 4.00000000000 FORMAT "%13.11" /end CHARACTERISTIC
/begin CHARACTERISTIC DDRC_RatDeb.EGRVlvLP_tiOLUDRat_C "DDRC/Verhältnis Defekt / Heilungsentprellung für Prüfung DFC_EGRVlvLPOL" VALUE 0x80025E2E Val_Wu8 3.00000000000 DDRC_Ratio 1.00000000000 4.00000000000 FORMAT "%13.11" /end CHARACTERISTIC
/begin CHARACTERISTIC DDRC_RatDeb.Air_tiSRCMinPIntkVUsUDRat_C "DDRC/Verhältnis Defekt / Heilungsentprellung für Prüfung DFC_PIntkVUsSRCMin" VALUE 0x80025E2F Val_Wu8 3.00000000000 DDRC_Ratio 1.00000000000 4.00000000000 FORMAT "%13.11" /end CHARACTERISTIC
/begin CHARACTERISTIC DDRC_RatDeb.EGRVlvLP_tiHBrgShCirGnd1UDRat_C "DDRC/Verhältnis Defekt / Heilungsentprellung für Prüfung DFC_EGRVlvLPHBrgShCirGnd1" VALUE 0x80025E30 Val_Wu8 3.00000000000 DDRC_Ratio 1.00000000000 4.00000000000 FORMAT "%13.11" /end CHARACTERISTIC
/begin CHARACTERISTIC DDRC_RatDeb.TECU_tiSRCMinUDRat_C "DDRC/Verhältnis Defekt / Heilungsentprellung für Prüfung DFC_SRCMinTECU" VALUE 0x80025E31 Val_Wu8 3.00000000000 DDRC_Ratio 1.00000000000 4.00000000000 FORMAT "%13.11" /end CHARACTERISTIC
/begin CHARACTERISTIC DDRC_RatDeb.PFlt_tiSotMsMaxUDRat_C "DDRC/Verhältnis Defekt / Heilungsentprellung für Prüfung DFC_PFltSotMsMax" VALUE 0x80025E32 Val_Wu8 3.00000000000 DDRC_Ratio 1.00000000000 4.00000000000 FORMAT "%13.11" /end CHARACTERISTIC
/begin CHARACTERISTIC DDRC_RatDeb.VSwVlv_tiHBrgUndrVltgUDRat_C "DDRC/Verhältnis Defekt / Heilungsentprellung für Prüfung DFC_VSwVlvHBrgUndrVltg" VALUE 0x80025E33 Val_Wu8 3.00000000000 DDRC_Ratio 1.00000000000 4.00000000000 FORMAT "%13.11" /end CHARACTERISTIC
/begin CHARACTERISTIC DDRC_RatDeb.Exh_tiSRCMaxPPFltUsUDRat_C "DDRC/Verhältnis Defekt / Heilungsentprellung für Prüfung DFC_SRCMaxPPFltUs" VALUE 0x80025E34 Val_Wu8 3.00000000000 DDRC_Ratio 1.00000000000 4.00000000000 FORMAT "%13.11" /end CHARACTERISTIC
/begin CHARACTERISTIC DDRC_RatDeb.Exh_tiEMaxPPFltDiffUDRat_C "DDRC/Verhältnis Defekt / Heilungsentprellung für Prüfung DFC_EnhSRCMaxPPFltDiff" VALUE 0x80025E35 Val_Wu8 3.00000000000 DDRC_Ratio 1.00000000000 4.00000000000 FORMAT "%13.11" /end CHARACTERISTIC
/begin CHARACTERISTIC DDRC_RatDeb.EngSpd_tiSCGUDRat_C "DDRC/Verhältnis Defekt / Heilungsentprellung für Prüfung DFC_EngSpdSCG" VALUE 0x80025E36 Val_Wu8 3.00000000000 DDRC_Ratio 1.00000000000 4.00000000000 FORMAT "%13.11" /end CHARACTERISTIC
/begin CHARACTERISTIC DDRC_RatDeb.APP_PlaAPP12UDRat_C "DDRC/Verhältnis Defekt / Heilungsentprellung für Prüfung DFC_SyncAPP" VALUE 0x80025E37 Val_Wu8 3.00000000000 DDRC_Ratio 1.00000000000 4.00000000000 FORMAT "%13.11" /end CHARACTERISTIC
/begin CHARACTERISTIC DDRC_RatDeb.APP_tiSRCLowUDRat_C "DDRC/Verhältnis Defekt / Heilungsentprellung für Prüfung DFC_SRCLowAPP2" VALUE 0x80025E38 Val_Wu8 3.00000000000 DDRC_Ratio 1.00000000000 4.00000000000 FORMAT "%13.11" /end CHARACTERISTIC
/begin CHARACTERISTIC DDRC_RatDeb.EGRVlv_tiSRCMaxUDRat_C "DDRC/Verhältnis Defekt / Heilungsentprellung für Prüfung DFC_EGRVlvSRCMax" VALUE 0x80025E39 Val_Wu8 3.00000000000 DDRC_Ratio 1.00000000000 4.00000000000 FORMAT "%13.11" /end CHARACTERISTIC
/begin CHARACTERISTIC DDRC_RatDeb.EGRVlv_tiHBrgOpnLdUDRat_C "DDRC/Verhältnis Defekt / Heilungsentprellung für Prüfung DFC_EGRVlvHBrgOpnLd" VALUE 0x80025E3A Val_Wu8 3.00000000000 DDRC_Ratio 1.00000000000 4.00000000000 FORMAT "%13.11" /end CHARACTERISTIC
/begin CHARACTERISTIC DDRC_RatDeb.VSwVlv_tiSRCMinUDRat_C "DDRC/Verhältnis Defekt / Heilungsentprellung für Prüfung DFC_VSwVlvSRCMin" VALUE 0x80025E3B Val_Wu8 3.00000000000 DDRC_Ratio 1.00000000000 4.00000000000 FORMAT "%13.11" /end CHARACTERISTIC
/begin CHARACTERISTIC DDRC_RatDeb.Exh_tiEMinPPFltDiffUDRat_C "DDRC/Verhältnis Defekt / Heilungsentprellung für Prüfung DFC_EnhSRCMinPPFltDiff" VALUE 0x80025E3C Val_Wu8 3.00000000000 DDRC_Ratio 1.00000000000 4.00000000000 FORMAT "%13.11" /end CHARACTERISTIC
/begin CHARACTERISTIC DDRC_RatDeb.SCR_tiSigUPmpPUDRat_C "DDRC/Verhältnis Defekt / Heilungsentprellung für Prüfung DFC_SigUPmpP" VALUE 0x80025E3D Val_Wu8 3.00000000000 DDRC_Ratio 1.00000000000 4.00000000000 FORMAT "%13.11" /end CHARACTERISTIC
/begin CHARACTERISTIC DDRC_RatDeb.Air_tiPerHiTAFSUDRat_C "DDRC/Verhältnis Defekt / Heilungsentprellung für Prüfung DFC_TAFSPerHi" VALUE 0x80025E3E Val_Wu8 3.00000000000 DDRC_Ratio 1.00000000000 4.00000000000 FORMAT "%13.11" /end CHARACTERISTIC
/begin CHARACTERISTIC DDRC_RatDeb.EGRVlvLP_tiHBrgTempOvrCurrUDRat_C "DDRC/Verhältnis Defekt / Heilungsentprellung für Prüfung DFC_EGRVlvLPHBrgTempOvrCurr" VALUE 0x80025E3F Val_Wu8 3.00000000000 DDRC_Ratio 1.00000000000 4.00000000000 FORMAT "%13.11" /end CHARACTERISTIC
/begin CHARACTERISTIC DDRC_RatDeb.APP_tiSRCHighUDRat_C "DDRC/Verhältnis Defekt / Heilungsentprellung für Prüfung DFC_SRCHighAPP2" VALUE 0x80025E40 Val_Wu8 3.00000000000 DDRC_Ratio 1.00000000000 4.00000000000 FORMAT "%13.11" /end CHARACTERISTIC
/begin CHARACTERISTIC DDRC_RatDeb.Air_tiSRCMaxPIntkVUsUDRat_C "DDRC/Verhältnis Defekt / Heilungsentprellung für Prüfung DFC_PIntkVUsSRCMax" VALUE 0x80025E41 Val_Wu8 3.00000000000 DDRC_Ratio 1.00000000000 4.00000000000 FORMAT "%13.11" /end CHARACTERISTIC
/begin CHARACTERISTIC DDRC_RatDeb.Exh_tiSRCMinPPFltUsUDRat_C "DDRC/Verhältnis Defekt / Heilungsentprellung für Prüfung DFC_SRCMinPPFltUs" VALUE 0x80025E42 Val_Wu8 3.00000000000 DDRC_Ratio 1.00000000000 4.00000000000 FORMAT "%13.11" /end CHARACTERISTIC
/begin CHARACTERISTIC DDRC_RatDeb.Exh_tiPlausExhTMonUDRat_C "DDRC/Verhältnis Defekt / Heilungsentprellung für Prüfung DFC_ExhTMonPlaus" VALUE 0x80025E43 Val_Wu8 3.00000000000 DDRC_Ratio 1.00000000000 4.00000000000 FORMAT "%13.11" /end CHARACTERISTIC
/begin CHARACTERISTIC DDRC_RatDeb.Exh_tiLamPlausMaxNoCat2DsUDRat_C "DDRC/Verhältnis Defekt / Heilungsentprellung für Prüfung DFC_NoCat2DsLamPlausMax" VALUE 0x80025E44 Val_Wu8 3.00000000000 DDRC_Ratio 1.00000000000 4.00000000000 FORMAT "%13.11" /end CHARACTERISTIC
/begin CHARACTERISTIC DDRC_RatDeb.PFlt_tiNplHsChngPPFltDiffUDRat_C "DDRC/Verhältnis Defekt / Heilungsentprellung für Prüfung DFC_NplHsChngPPFltDiff" VALUE 0x80025E45 Val_Wu8 3.00000000000 DDRC_Ratio 1.00000000000 4.00000000000 FORMAT "%13.11" /end CHARACTERISTIC
/begin CHARACTERISTIC DDRC_RatDeb.EGRVlvLP_tiGovDvtMinUDRat_C "DDRC/Verhältnis Defekt / Heilungsentprellung für Prüfung DFC_EGRVlvLPGovDvtMin" VALUE 0x80025E46 Val_Wu8 3.00000000000 DDRC_Ratio 1.00000000000 4.00000000000 FORMAT "%13.11" /end CHARACTERISTIC
/begin CHARACTERISTIC DDRC_RatDeb.PFlt_tiSRCMaxFlwRstnUDRat_C "DDRC/Verhältnis Defekt / Heilungsentprellung für Prüfung DFC_PFltSRCMaxFlwRstn" VALUE 0x80025E47 Val_Wu8 3.00000000000 DDRC_Ratio 1.00000000000 4.00000000000 FORMAT "%13.11" /end CHARACTERISTIC
/begin CHARACTERISTIC DDRC_RatDeb.PFlt_tiRgnPermMaxUDRat_C "DDRC/Verhältnis Defekt / Heilungsentprellung für Prüfung DFC_PFltRgnPerm" VALUE 0x80025E48 Val_Wu8 3.00000000000 DDRC_Ratio 1.00000000000 4.00000000000 FORMAT "%13.11" /end CHARACTERISTIC
/begin CHARACTERISTIC DDRC_RatDeb.SCR_tiSigUCatUsTUDRat_C "DDRC/Verhältnis Defekt / Heilungsentprellung für Prüfung DFC_SigUCatUsT" VALUE 0x80025E49 Val_Wu8 3.00000000000 DDRC_Ratio 1.00000000000 4.00000000000 FORMAT "%13.11" /end CHARACTERISTIC
/begin CHARACTERISTIC DDRC_RatDeb.Exh_tiMaxExhTMonUDRat_C "DDRC/Verhältnis Defekt / Heilungsentprellung für Prüfung DFC_EnhSRCMaxT3ExhTMon" VALUE 0x80025E4A Val_Wu8 3.00000000000 DDRC_Ratio 1.00000000000 4.00000000000 FORMAT "%13.11" /end CHARACTERISTIC
/begin CHARACTERISTIC DDRC_RatDeb.URevVlv_tiOLUDRat_C "DDRC/Verhältnis Defekt / Heilungsentprellung für Prüfung DFC_URevVlvOL" VALUE 0x80025E4B Val_Wu8 3.00000000000 DDRC_Ratio 1.00000000000 4.00000000000 FORMAT "%13.11" /end CHARACTERISTIC
/begin CHARACTERISTIC DDRC_RatDeb.GbxNPos_tiSRCPerMaxUDRat_C "DDRC/Verhältnis Defekt / Heilungsentprellung für Prüfung DFC_GbxNPosPPerSRCMax" VALUE 0x80025E4C Val_Wu8 3.00000000000 DDRC_Ratio 1.00000000000 4.00000000000 FORMAT "%13.11" /end CHARACTERISTIC
/begin CHARACTERISTIC DDRC_RatDeb.LSU_tiCircPmpCurSigUDRat_C "DDRC/Verhältnis Defekt / Heilungsentprellung für Prüfung DFC_LSUCircPmpCurSig" VALUE 0x80025E4D Val_Wu8 3.00000000000 DDRC_Ratio 1.00000000000 4.00000000000 FORMAT "%13.11" /end CHARACTERISTIC
/begin CHARACTERISTIC DDRC_RatDeb.VSwVlv_tiSRCMaxUDRat_C "DDRC/Verhältnis Defekt / Heilungsentprellung für Prüfung DFC_VSwVlvSRCMax" VALUE 0x80025E4E Val_Wu8 3.00000000000 DDRC_Ratio 1.00000000000 4.00000000000 FORMAT "%13.11" /end CHARACTERISTIC
/begin CHARACTERISTIC DDRC_RatDeb.Exh_tiSRCLamBinNSCDsUDRat_C "DDRC/Verhältnis Defekt / Heilungsentprellung für Prüfung DFC_NSCDsLamBinSRCMin" VALUE 0x80025E4F Val_Wu8 3.00000000000 DDRC_Ratio 1.00000000000 4.00000000000 FORMAT "%13.11" /end CHARACTERISTIC
/begin CHARACTERISTIC DDRC_RatDeb.VSwVlv_tiSCBUDRat_C "DDRC/Verhältnis Defekt / Heilungsentprellung für Prüfung DFC_VSwVlvSCB" VALUE 0x80025E50 Val_Wu8 3.00000000000 DDRC_Ratio 1.00000000000 4.00000000000 FORMAT "%13.11" /end CHARACTERISTIC
/begin CHARACTERISTIC DDRC_RatDeb.EGRVlvLP_tiSCBUDRat_C "DDRC/Verhältnis Defekt / Heilungsentprellung für Prüfung DFC_EGRVlvLPSCB" VALUE 0x80025E51 Val_Wu8 3.00000000000 DDRC_Ratio 1.00000000000 4.00000000000 FORMAT "%13.11" /end CHARACTERISTIC
/begin CHARACTERISTIC DDRC_RatDeb.EngSpd_tiSCBUDRat_C "DDRC/Verhältnis Defekt / Heilungsentprellung für Prüfung DFC_EngSpdSCB" VALUE 0x80025E52 Val_Wu8 3.00000000000 DDRC_Ratio 1.00000000000 4.00000000000 FORMAT "%13.11" /end CHARACTERISTIC
/begin CHARACTERISTIC DDRC_RatDeb.Exh_tiMinExhTMonUDRat_C "DDRC/Verhältnis Defekt / Heilungsentprellung für Prüfung DFC_EnhSRCMinT3ExhTMon" VALUE 0x80025E53 Val_Wu8 3.00000000000 DDRC_Ratio 1.00000000000 4.00000000000 FORMAT "%13.11" /end CHARACTERISTIC
/begin CHARACTERISTIC DDRC_RatDeb.EGRVlvLP_tiHBrgShCirGnd2UDRat_C "DDRC/Verhältnis Defekt / Heilungsentprellung für Prüfung DFC_EGRVlvLPHBrgShCirGnd2" VALUE 0x80025E54 Val_Wu8 3.00000000000 DDRC_Ratio 1.00000000000 4.00000000000 FORMAT "%13.11" /end CHARACTERISTIC
/begin CHARACTERISTIC DDRC_RatDeb.BattU_tiMinUDRat_C "DDRC/Verhältnis Defekt / Heilungsentprellung für Prüfung DFC_BattUSRCMin" VALUE 0x80025E55 Val_Wu8 3.00000000000 DDRC_Ratio 1.00000000000 4.00000000000 FORMAT "%13.11" /end CHARACTERISTIC
/begin CHARACTERISTIC DDRC_RatDeb.VSwVlv_tiSCGUDRat_C "DDRC/Verhältnis Defekt / Heilungsentprellung für Prüfung DFC_VSwVlvSCG" VALUE 0x80025E56 Val_Wu8 3.00000000000 DDRC_Ratio 1.00000000000 4.00000000000 FORMAT "%13.11" /end CHARACTERISTIC
/begin CHARACTERISTIC DDRC_RatDeb.PCV_tiSCGUDRat_C "DDRC/Verhältnis Defekt / Heilungsentprellung für Prüfung DFC_PCVSCG" VALUE 0x80025E57 Val_Wu8 3.00000000000 DDRC_Ratio 1.00000000000 4.00000000000 FORMAT "%13.11" /end CHARACTERISTIC
/begin CHARACTERISTIC DDRC_RatDeb.Exh_tiSRCMaxPPFltDiffUDRat_C "DDRC/Verhältnis Defekt / Heilungsentprellung für Prüfung DFC_SRCMaxPPFltDiff" VALUE 0x80025E58 Val_Wu8 3.00000000000 DDRC_Ratio 1.00000000000 4.00000000000 FORMAT "%13.11" /end CHARACTERISTIC
/begin CHARACTERISTIC DDRC_RatDeb.Exh_tiPlausExhTMon3UDRat_C "DDRC/Verhältnis Defekt / Heilungsentprellung für Prüfung DFC_ExhTMonT3Plaus" VALUE 0x80025E59 Val_Wu8 3.00000000000 DDRC_Ratio 1.00000000000 4.00000000000 FORMAT "%13.11" /end CHARACTERISTIC
/begin CHARACTERISTIC DDRC_RatDeb.EnvP_tiMaxUDRat_C "DDRC/Verhältnis Defekt / Heilungsentprellung für Prüfung DFC_EnvPSRCMax" VALUE 0x80025E5A Val_Wu8 3.00000000000 DDRC_Ratio 1.00000000000 4.00000000000 FORMAT "%13.11" /end CHARACTERISTIC
/begin CHARACTERISTIC DDRC_RatDeb.Air_tiDtyCycHiTAFSUDRat_C "DDRC/Verhältnis Defekt / Heilungsentprellung für Prüfung DFC_TAFSDtyCycHi" VALUE 0x80025E5B Val_Wu8 3.00000000000 DDRC_Ratio 1.00000000000 4.00000000000 FORMAT "%13.11" /end CHARACTERISTIC
/begin CHARACTERISTIC DDRC_RatDeb.EGRVlvLP_tiHBrgShCirBatt1UDRat_C "DDRC/Verhältnis Defekt / Heilungsentprellung für Prüfung DFC_EGRVlvLPHBrgShCirBatt1" VALUE 0x80025E5C Val_Wu8 3.00000000000 DDRC_Ratio 1.00000000000 4.00000000000 FORMAT "%13.11" /end CHARACTERISTIC
/begin CHARACTERISTIC DDRC_RatDeb.Exh_tiExhTMon2PlausUDRat_C "DDRC/Verhältnis Defekt / Heilungsentprellung für Prüfung DFC_ExhTMonPlausPos2" VALUE 0x80025E5D Val_Wu8 3.00000000000 DDRC_Ratio 1.00000000000 4.00000000000 FORMAT "%13.11" /end CHARACTERISTIC
/begin CHARACTERISTIC DDRC_RatDeb.Exh_tiSRCLamLinNoCat2DsUDRat_C "DDRC/Verhältnis Defekt / Heilungsentprellung für Prüfung DFC_NoCat2DsLamLinSRCMax" VALUE 0x80025E5E Val_Wu8 3.00000000000 DDRC_Ratio 1.00000000000 4.00000000000 FORMAT "%13.11" /end CHARACTERISTIC
/begin CHARACTERISTIC DDRC_RatDeb.Exh_tiSRCMinTOxiCatUsUDRat_C "DDRC/Verhältnis Defekt / Heilungsentprellung für Prüfung DFC_SRCMinTOxiCatUs" VALUE 0x80025E5F Val_Wu8 3.00000000000 DDRC_Ratio 1.00000000000 4.00000000000 FORMAT "%13.11" /end CHARACTERISTIC
/begin CHARACTERISTIC DDRC_RatDeb.EGRVlvLP_tiHBrgOvrTempUDRat_C "DDRC/Verhältnis Defekt / Heilungsentprellung für Prüfung DFC_EGRVlvLPHBrgOvrTemp" VALUE 0x80025E60 Val_Wu8 3.00000000000 DDRC_Ratio 1.00000000000 4.00000000000 FORMAT "%13.11" /end CHARACTERISTIC
/begin CHARACTERISTIC DDRC_RatDeb.UHtrTnk_tiSRCMinDiaUDRat_C "DDRC/Verhältnis Defekt / Heilungsentprellung für Prüfung DFC_UHtrTnkSRCMinDia" VALUE 0x80025E61 Val_Wu8 3.00000000000 DDRC_Ratio 1.00000000000 4.00000000000 FORMAT "%13.11" /end CHARACTERISTIC
/begin CHARACTERISTIC DDRC_RatDeb.UHtrPL_tiOLUDRat_C "DDRC/Verhältnis Defekt / Heilungsentprellung für Prüfung DFC_UHtrPLOL" VALUE 0x80025E62 Val_Wu8 3.00000000000 DDRC_Ratio 1.00000000000 4.00000000000 FORMAT "%13.11" /end CHARACTERISTIC
/begin CHARACTERISTIC DDRC_RatDeb.EGRVlv_tiHBrgUndrVltgUDRat_C "DDRC/Verhältnis Defekt / Heilungsentprellung für Prüfung DFC_EGRVlvHBrgUndrVltg" VALUE 0x80025E63 Val_Wu8 3.00000000000 DDRC_Ratio 1.00000000000 4.00000000000 FORMAT "%13.11" /end CHARACTERISTIC
/begin CHARACTERISTIC DDRC_RatDeb.PFlt_tiSotMsDvtMaxUDRat_C "DDRC/Verhältnis Defekt / Heilungsentprellung für Prüfung DFC_PFltSotMsDvtMax" VALUE 0x80025E64 Val_Wu8 3.00000000000 DDRC_Ratio 1.00000000000 4.00000000000 FORMAT "%13.11" /end CHARACTERISTIC
/begin CHARACTERISTIC DDRC_RatDeb.Exh_tiSRCMaxTOxiCatUsUDRat_C "DDRC/Verhältnis Defekt / Heilungsentprellung für Prüfung DFC_SRCMaxTOxiCatUs" VALUE 0x80025E65 Val_Wu8 3.00000000000 DDRC_Ratio 1.00000000000 4.00000000000 FORMAT "%13.11" /end CHARACTERISTIC
/begin CHARACTERISTIC DDRC_RatDeb.VSwVlv_tiGovDvtMaxUDRat_C "DDRC/Verhältnis Defekt / Heilungsentprellung für Prüfung DFC_VSwVlvGovDvtMax" VALUE 0x80025E66 Val_Wu8 3.00000000000 DDRC_Ratio 1.00000000000 4.00000000000 FORMAT "%13.11" /end CHARACTERISTIC
/begin CHARACTERISTIC DDRC_RatDeb.FlFltDsP_tiMaxUDRat_C "DDRC/Verhältnis Defekt / Heilungsentprellung für Prüfung DFC_FlFltDsPSRCMax" VALUE 0x80025E67 Val_Wu8 3.00000000000 DDRC_Ratio 1.00000000000 4.00000000000 FORMAT "%13.11" /end CHARACTERISTIC
/begin CHARACTERISTIC DDRC_RatDeb.Brk_tiPlaUDRat_C "DDRC/Verhältnis Defekt / Heilungsentprellung für Prüfung DFC_BrkNpl" VALUE 0x80025E68 Val_Wu8 3.00000000000 DDRC_Ratio 1.00000000000 4.00000000000 FORMAT "%13.11" /end CHARACTERISTIC
/begin CHARACTERISTIC DDRC_RatDeb.GbxNPos_tiSRCdcycMinUDRat_C "DDRC/Verhältnis Defekt / Heilungsentprellung für Prüfung DFC_GbxNPosPdcycSRCMin" VALUE 0x80025E69 Val_Wu8 3.00000000000 DDRC_Ratio 1.00000000000 4.00000000000 FORMAT "%13.11" /end CHARACTERISTIC
/begin CHARACTERISTIC DDRC_RatDeb.Oil_tiSRCMinPSwmpUDRat_C "DDRC/Verhältnis Defekt / Heilungsentprellung für Prüfung DFC_OilPSwmpSRCMin" VALUE 0x80025E6A Val_Wu8 3.00000000000 DDRC_Ratio 1.00000000000 4.00000000000 FORMAT "%13.11" /end CHARACTERISTIC
/begin CHARACTERISTIC DDRC_RatDeb.TrbChLP_tiSCBUDRat_C "DDRC/Verhältnis Defekt / Heilungsentprellung für Prüfung DFC_TrbChLPSCB" VALUE 0x80025E6B Val_Wu8 3.00000000000 DDRC_Ratio 1.00000000000 4.00000000000 FORMAT "%13.11" /end CHARACTERISTIC
/begin CHARACTERISTIC DDRC_RatDeb.Exh_tiSRCMinPPFltDiffUDRat_C "DDRC/Verhältnis Defekt / Heilungsentprellung für Prüfung DFC_SRCMinPPFltDiff" VALUE 0x80025E6C Val_Wu8 3.00000000000 DDRC_Ratio 1.00000000000 4.00000000000 FORMAT "%13.11" /end CHARACTERISTIC
/begin CHARACTERISTIC DDRC_RatDeb.PFlt_tiSotMsDvtMinUDRat_C "DDRC/Verhältnis Defekt / Heilungsentprellung für Prüfung DFC_PFltSotMsDvtMin" VALUE 0x80025E6D Val_Wu8 3.00000000000 DDRC_Ratio 1.00000000000 4.00000000000 FORMAT "%13.11" /end CHARACTERISTIC
/begin CHARACTERISTIC DDRC_RatDeb.EGRVlvLP_tiHBrgOpnLdUDRat_C "DDRC/Verhältnis Defekt / Heilungsentprellung für Prüfung DFC_EGRVlvLPHBrgOpnLd" VALUE 0x80025E6E Val_Wu8 3.00000000000 DDRC_Ratio 1.00000000000 4.00000000000 FORMAT "%13.11" /end CHARACTERISTIC
/begin CHARACTERISTIC DDRC_RatDeb.Exh_tiCmpChkNSCDsUDRat_C "DDRC/Verhältnis Defekt / Heilungsentprellung für Prüfung DFC_NSCDsCmpChk" VALUE 0x80025E6F Val_Wu8 3.00000000000 DDRC_Ratio 1.00000000000 4.00000000000 FORMAT "%13.11" /end CHARACTERISTIC
/begin CHARACTERISTIC DDRC_RatDeb.EGRVlv_tiHBrgOvrTempUDRat_C "DDRC/Verhältnis Defekt / Heilungsentprellung für Prüfung DFC_EGRVlvHBrgOvrTemp" VALUE 0x80025E70 Val_Wu8 3.00000000000 DDRC_Ratio 1.00000000000 4.00000000000 FORMAT "%13.11" /end CHARACTERISTIC
/begin CHARACTERISTIC DDRC_RatDeb.EGRVlv_tiGovDvtMaxUDRat_C "DDRC/Verhältnis Defekt / Heilungsentprellung für Prüfung DFC_EGRVlvGovDvtMax" VALUE 0x80025E71 Val_Wu8 3.00000000000 DDRC_Ratio 1.00000000000 4.00000000000 FORMAT "%13.11" /end CHARACTERISTIC
/begin CHARACTERISTIC DDRC_RatDeb.Exh_tiPlausExhTMon2UDRat_C "DDRC/Verhältnis Defekt / Heilungsentprellung für Prüfung DFC_ExhTMonT2Plaus" VALUE 0x80025E72 Val_Wu8 3.00000000000 DDRC_Ratio 1.00000000000 4.00000000000 FORMAT "%13.11" /end CHARACTERISTIC
/begin CHARACTERISTIC DDRC_RatDeb.VSwVlv_tiHBrgShCirBatt2UDRat_C "DDRC/Verhältnis Defekt / Heilungsentprellung für Prüfung DFC_VSwVlvHBrgShCirBatt2" VALUE 0x80025E73 Val_Wu8 3.00000000000 DDRC_Ratio 1.00000000000 4.00000000000 FORMAT "%13.11" /end CHARACTERISTIC
/begin CHARACTERISTIC DDRC_RatDeb.SCR_tiSRCMaxUCatUsTUDRat_C "DDRC/Verhältnis Defekt / Heilungsentprellung für Prüfung DFC_SRCMaxUCatUsT" VALUE 0x80025E74 Val_Wu8 3.00000000000 DDRC_Ratio 1.00000000000 4.00000000000 FORMAT "%13.11" /end CHARACTERISTIC
/begin CHARACTERISTIC DDRC_RatDeb.AFS_tiRawSRCMinUDRat_C "DDRC/Verhältnis Defekt / Heilungsentprellung für Prüfung DFC_AFSSRCRawMin" VALUE 0x80025E75 Val_Wu8 3.00000000000 DDRC_Ratio 1.00000000000 4.00000000000 FORMAT "%13.11" /end CHARACTERISTIC
/begin CHARACTERISTIC DDRC_RatDeb.LSU_tiO2MinUDRat_C "DDRC/Verhältnis Defekt / Heilungsentprellung für Prüfung DFC_LSUO2Min" VALUE 0x80025E76 Val_Wu8 3.00000000000 DDRC_Ratio 1.00000000000 4.00000000000 FORMAT "%13.11" /end CHARACTERISTIC
/begin CHARACTERISTIC DDRC_RatDeb.ThrVlv_tiSRCMinUDRat_C "DDRC/Verhältnis Defekt / Heilungsentprellung für Prüfung DFC_ThrVlvSRCMin" VALUE 0x80025E77 Val_Wu8 3.00000000000 DDRC_Ratio 1.00000000000 4.00000000000 FORMAT "%13.11" /end CHARACTERISTIC
/begin CHARACTERISTIC DDRC_RatDeb.VSwVlv_tiHBrgTempOvrCurrUDRat_C "DDRC/Verhältnis Defekt / Heilungsentprellung für Prüfung DFC_VSwVlvHBrgTempOvrCurr" VALUE 0x80025E78 Val_Wu8 3.00000000000 DDRC_Ratio 1.00000000000 4.00000000000 FORMAT "%13.11" /end CHARACTERISTIC
/begin CHARACTERISTIC DDRC_RatDeb.Exh_tiNplTOxiUsUDRat_C "DDRC/Verhältnis Defekt / Heilungsentprellung für Prüfung DFC_NplTOxiCatUs" VALUE 0x80025E79 Val_Wu8 3.00000000000 DDRC_Ratio 1.00000000000 4.00000000000 FORMAT "%13.11" /end CHARACTERISTIC
/begin CHARACTERISTIC DDRC_RatDeb.EGRVlv_tiSRCMinUDRat_C "DDRC/Verhältnis Defekt / Heilungsentprellung für Prüfung DFC_EGRVlvSRCMin" VALUE 0x80025E7A Val_Wu8 3.00000000000 DDRC_Ratio 1.00000000000 4.00000000000 FORMAT "%13.11" /end CHARACTERISTIC
/begin CHARACTERISTIC DDRC_RatDeb.ECBVlv_tiSRCMinUDRat_C "DDRC/Verhältnis Defekt / Heilungsentprellung für Prüfung DFC_ECBVlvSRCMin" VALUE 0x80025E7B Val_Wu8 3.00000000000 DDRC_Ratio 1.00000000000 4.00000000000 FORMAT "%13.11" /end CHARACTERISTIC
/begin CHARACTERISTIC DDRC_RatDeb.EGRVlv_tiHBrgShCirGnd1UDRat_C "DDRC/Verhältnis Defekt / Heilungsentprellung für Prüfung DFC_EGRVlvHBrgShCirGnd1" VALUE 0x80025E7C Val_Wu8 3.00000000000 DDRC_Ratio 1.00000000000 4.00000000000 FORMAT "%13.11" /end CHARACTERISTIC
/begin CHARACTERISTIC DDRC_RatDeb.Air_tiPerLoTAFSUDRat_C "DDRC/Verhältnis Defekt / Heilungsentprellung für Prüfung DFC_TAFSPerLo" VALUE 0x80025E7D Val_Wu8 3.00000000000 DDRC_Ratio 1.00000000000 4.00000000000 FORMAT "%13.11" /end CHARACTERISTIC
/begin CHARACTERISTIC DDRC_RatDeb.EngSpd_tiOLUDRat_C "DDRC/Verhältnis Defekt / Heilungsentprellung für Prüfung DFC_EngSpdOL" VALUE 0x80025E7E Val_Wu8 3.00000000000 DDRC_Ratio 1.00000000000 4.00000000000 FORMAT "%13.11" /end CHARACTERISTIC
/begin CHARACTERISTIC DDRC_RatDeb.BrkP_tiMaxUDRat_C "DDRC/Verhältnis Defekt / Heilungsentprellung für Prüfung DFC_BrkPSRCMax" VALUE 0x80025E7F Val_Wu8 3.00000000000 DDRC_Ratio 1.00000000000 4.00000000000 FORMAT "%13.11" /end CHARACTERISTIC
/begin CHARACTERISTIC DDRC_RatDeb.AFS_tiCorSRCMinUDRat_C "DDRC/Verhältnis Defekt / Heilungsentprellung für Prüfung DFC_AFSSRCCorMin" VALUE 0x80025E80 Val_Wu8 3.00000000000 DDRC_Ratio 1.00000000000 4.00000000000 FORMAT "%13.11" /end CHARACTERISTIC
/begin CHARACTERISTIC DDRC_RatDeb.VSwVlv_tiHBrgOvrCurrUDRat_C "DDRC/Verhältnis Defekt / Heilungsentprellung für Prüfung DFC_VSwVlvHBrgOvrCurr" VALUE 0x80025E81 Val_Wu8 3.00000000000 DDRC_Ratio 1.00000000000 4.00000000000 FORMAT "%13.11" /end CHARACTERISTIC
/begin CHARACTERISTIC DDRC_RatDeb.AirC_tiSwtSigUDRat_C "DDRC/Verhältnis Defekt / Heilungsentprellung für Prüfung DFC_AirCSwtSig" VALUE 0x80025E82 Val_Wu8 3.00000000000 DDRC_Ratio 1.00000000000 4.00000000000 FORMAT "%13.11" /end CHARACTERISTIC
/begin CHARACTERISTIC DDRC_RatDeb.VSwVlv_tiHBrgShCirBatt1UDRat_C "DDRC/Verhältnis Defekt / Heilungsentprellung für Prüfung DFC_VSwVlvHBrgShCirBatt1" VALUE 0x80025E83 Val_Wu8 3.00000000000 DDRC_Ratio 1.00000000000 4.00000000000 FORMAT "%13.11" /end CHARACTERISTIC
/begin CHARACTERISTIC DDRC_RatDeb.SCR_tiSigUTnkTUDRat_C "DDRC/Verhältnis Defekt / Heilungsentprellung für Prüfung DFC_UTnkTSig" VALUE 0x80025E84 Val_Wu8 3.00000000000 DDRC_Ratio 1.00000000000 4.00000000000 FORMAT "%13.11" /end CHARACTERISTIC
/begin CHARACTERISTIC DDRC_RatDeb.GbxNPos_tiSRCdcycMaxUDRat_C "DDRC/Verhältnis Defekt / Heilungsentprellung für Prüfung DFC_GbxNPosPdcycSRCMax" VALUE 0x80025E85 Val_Wu8 3.00000000000 DDRC_Ratio 1.00000000000 4.00000000000 FORMAT "%13.11" /end CHARACTERISTIC
/begin CHARACTERISTIC DDRC_RatDeb.Exh_tiMaxNoCat2DsUDRat_C "DDRC/Verhältnis Defekt / Heilungsentprellung für Prüfung DFC_NoCat2DsShCir" VALUE 0x80025E86 Val_Wu8 3.00000000000 DDRC_Ratio 1.00000000000 4.00000000000 FORMAT "%13.11" /end CHARACTERISTIC
/begin CHARACTERISTIC DDRC_RatDeb.EngTrqPtd_ctMonLimLeadUDRat_C "DDRC/Verhältnis Defekt / Heilungsentprellung für Prüfung DFC_MonLimLead" VALUE 0x80025E87 Val_Wu8 3.00000000000 DDRC_Ratio 1.00000000000 4.00000000000 FORMAT "%13.11" /end CHARACTERISTIC
/begin CHARACTERISTIC DDRC_RatDeb.Layer_numFltMngTstUDRat_C "DDRC/Verhältnis Defekt / Heilungsentprellung für Prüfung DFC_Layer_FltMngTstNpl" VALUE 0x80025E88 Val_Wu8 3.00000000000 DDRC_Ratio 1.00000000000 4.00000000000 FORMAT "%13.11" /end CHARACTERISTIC
/begin CHARACTERISTIC DDRC_RatDeb.Layer_numGENREGUPLUDRat_C "DDRC/Verhältnis Defekt / Heilungsentprellung für Prüfung DFC_Layer_GENREGUPLNpl" VALUE 0x80025E89 Val_Wu8 3.00000000000 DDRC_Ratio 1.00000000000 4.00000000000 FORMAT "%13.11" /end CHARACTERISTIC
/begin CHARACTERISTIC DDRC_RatDeb.Layer_numGENUPLUDRat_C "DDRC/Verhältnis Defekt / Heilungsentprellung für Prüfung DFC_Layer_GENUPLNpl" VALUE 0x80025E8A Val_Wu8 3.00000000000 DDRC_Ratio 1.00000000000 4.00000000000 FORMAT "%13.11" /end CHARACTERISTIC
/begin CHARACTERISTIC DDRC_RatDeb.IVDia_numCylNoLdUDRat_C "DDRC/Verhältnis Defekt / Heilungsentprellung für Prüfung DFC_IVDiaCylNoLd" VALUE 0x80025E8B Val_Wu8 3.00000000000 DDRC_Ratio 1.00000000000 4.00000000000 FORMAT "%13.11" /end CHARACTERISTIC
/begin CHARACTERISTIC DDRC_RatDeb.LSU_numRiClbMinUDRat_C "DDRC/Verhältnis Defekt / Heilungsentprellung für Prüfung DFC_LSURiClbMin" VALUE 0x80025E8C Val_Wu8 3.00000000000 DDRC_Ratio 1.00000000000 4.00000000000 FORMAT "%13.11" /end CHARACTERISTIC
/begin CHARACTERISTIC DDRC_RatDeb.Exh_numNOxOfsNoCat2DsUDRat_C "DDRC/Verhältnis Defekt / Heilungsentprellung für Prüfung DFC_NoCat2DsNOxOfsMin" VALUE 0x80025E8D Val_Wu8 3.00000000000 DDRC_Ratio 1.00000000000 4.00000000000 FORMAT "%13.11" /end CHARACTERISTIC
/begin CHARACTERISTIC DDRC_RatDeb.Layer_numGENKOMMUDRat_C "DDRC/Verhältnis Defekt / Heilungsentprellung für Prüfung DFC_Layer_GENKOMMNpl" VALUE 0x80025E8E Val_Wu8 3.00000000000 DDRC_Ratio 1.00000000000 4.00000000000 FORMAT "%13.11" /end CHARACTERISTIC
/begin CHARACTERISTIC DDRC_RatDeb.PCV_numNoStrtUDRat_C "DDRC/Verhältnis Defekt / Heilungsentprellung für Prüfung DFC_PCVNoStrt" VALUE 0x80025E8F Val_Wu8 3.00000000000 DDRC_Ratio 1.00000000000 4.00000000000 FORMAT "%13.11" /end CHARACTERISTIC
/begin CHARACTERISTIC DDRC_RatDeb.ETClb_numETMaxUDRat_C "DDRC/Verhältnis Defekt / Heilungsentprellung für Prüfung DFC_ETClbETMax" VALUE 0x80025E90 Val_Wu8 3.00000000000 DDRC_Ratio 1.00000000000 4.00000000000 FORMAT "%13.11" /end CHARACTERISTIC
/begin CHARACTERISTIC DDRC_RatDeb.RailP_numdpDebUDRat_C "DDRC/Verhältnis Defekt / Heilungsentprellung für Prüfung DFC_RailPGradMon" VALUE 0x80025E91 Val_Wu8 3.00000000000 DDRC_Ratio 1.00000000000 4.00000000000 FORMAT "%13.11" /end CHARACTERISTIC
/begin CHARACTERISTIC DDRC_RatDeb.LSU_numRiClbMaxUDRat_C "DDRC/Verhältnis Defekt / Heilungsentprellung für Prüfung DFC_LSURiClbMax" VALUE 0x80025E92 Val_Wu8 3.00000000000 DDRC_Ratio 1.00000000000 4.00000000000 FORMAT "%13.11" /end CHARACTERISTIC
/begin CHARACTERISTIC DDRC_RatDeb.IVCtl_numUDiffUpOBDUDRat_C "DDRC/Verhältnis Defekt / Heilungsentprellung für Prüfung DFC_IVCtlUDiffUp" VALUE 0x80025E93 Val_Wu8 3.00000000000 DDRC_Ratio 1.00000000000 4.00000000000 FORMAT "%13.11" /end CHARACTERISTIC
/begin CHARACTERISTIC DDRC_RatDeb.Layer_numNGLERNUDRat_C "DDRC/Verhältnis Defekt / Heilungsentprellung für Prüfung DFC_Layer_NGLERNNpl" VALUE 0x80025E94 Val_Wu8 3.00000000000 DDRC_Ratio 1.00000000000 4.00000000000 FORMAT "%13.11" /end CHARACTERISTIC
/begin CHARACTERISTIC DDRC_RatDeb.Layer_numMANDETEKUDRat_C "DDRC/Verhältnis Defekt / Heilungsentprellung für Prüfung DFC_Layer_MANDETEKNpl" VALUE 0x80025E95 Val_Wu8 3.00000000000 DDRC_Ratio 1.00000000000 4.00000000000 FORMAT "%13.11" /end CHARACTERISTIC
/begin CHARACTERISTIC DDRC_RatDeb.Exh_numNOxR2LMinNSCDsUDRat_C "DDRC/Verhältnis Defekt / Heilungsentprellung für Prüfung DFC_NSCDsNOxPlausMin" VALUE 0x80025E96 Val_Wu8 3.00000000000 DDRC_Ratio 1.00000000000 4.00000000000 FORMAT "%13.11" /end CHARACTERISTIC
/begin CHARACTERISTIC DDRC_RatDeb.Layer_numBSDUDRat_C "DDRC/Verhältnis Defekt / Heilungsentprellung für Prüfung DFC_Layer_BSDNpl" VALUE 0x80025E97 Val_Wu8 3.00000000000 DDRC_Ratio 1.00000000000 4.00000000000 FORMAT "%13.11" /end CHARACTERISTIC
/begin CHARACTERISTIC DDRC_RatDeb.IVActr_numEnrgMinUDRat_C "DDRC/Verhältnis Defekt / Heilungsentprellung für Prüfung DFC_IVActrEnrgMin" VALUE 0x80025E98 Val_Wu8 3.00000000000 DDRC_Ratio 1.00000000000 4.00000000000 FORMAT "%13.11" /end CHARACTERISTIC
/begin CHARACTERISTIC DDRC_RatDeb.LSU_numO2ClbMinUDRat_C "DDRC/Verhältnis Defekt / Heilungsentprellung für Prüfung DFC_LSUO2ClbMin" VALUE 0x80025E99 Val_Wu8 3.00000000000 DDRC_Ratio 1.00000000000 4.00000000000 FORMAT "%13.11" /end CHARACTERISTIC
/begin CHARACTERISTIC DDRC_RatDeb.IVDia_numCylShCirUDRat_C "DDRC/Verhältnis Defekt / Heilungsentprellung für Prüfung DFC_IVDiaCylShCir" VALUE 0x80025E9A Val_Wu8 3.00000000000 DDRC_Ratio 1.00000000000 4.00000000000 FORMAT "%13.11" /end CHARACTERISTIC
/begin CHARACTERISTIC DDRC_RatDeb.IVDia_numBnkShCirUDRat_C "DDRC/Verhältnis Defekt / Heilungsentprellung für Prüfung DFC_IVDiaBnkShCir" VALUE 0x80025E9B Val_Wu8 3.00000000000 DDRC_Ratio 1.00000000000 4.00000000000 FORMAT "%13.11" /end CHARACTERISTIC
/begin CHARACTERISTIC DDRC_RatDeb.IVCtl_numTiDiffOBDUDRat_C "DDRC/Verhältnis Defekt / Heilungsentprellung für Prüfung DFC_IVCtlTiDiff" VALUE 0x80025E9C Val_Wu8 3.00000000000 DDRC_Ratio 1.00000000000 4.00000000000 FORMAT "%13.11" /end CHARACTERISTIC
/begin CHARACTERISTIC DDRC_RatDeb.LSU_numO2PlausMaxPartLdUDRat_C "DDRC/Verhältnis Defekt / Heilungsentprellung für Prüfung DFC_LSUO2PlausMaxPartLd" VALUE 0x80025E9D Val_Wu8 3.00000000000 DDRC_Ratio 1.00000000000 4.00000000000 FORMAT "%13.11" /end CHARACTERISTIC
/begin CHARACTERISTIC DDRC_RatDeb.IVDia_numCylNoClsUDRat_C "DDRC/Verhältnis Defekt / Heilungsentprellung für Prüfung DFC_IVDiaCylNoCls" VALUE 0x80025E9E Val_Wu8 3.00000000000 DDRC_Ratio 1.00000000000 4.00000000000 FORMAT "%13.11" /end CHARACTERISTIC
/begin CHARACTERISTIC DDRC_RatDeb.Layer_numGENELBUDRat_C "DDRC/Verhältnis Defekt / Heilungsentprellung für Prüfung DFC_Layer_GENELBNpl" VALUE 0x80025E9F Val_Wu8 3.00000000000 DDRC_Ratio 1.00000000000 4.00000000000 FORMAT "%13.11" /end CHARACTERISTIC
/begin CHARACTERISTIC DDRC_RatDeb.LSU_numO2PlausMaxOvrRunUDRat_C "DDRC/Verhältnis Defekt / Heilungsentprellung für Prüfung DFC_LSUO2PlausMaxOvrRun" VALUE 0x80025EA0 Val_Wu8 3.00000000000 DDRC_Ratio 1.00000000000 4.00000000000 FORMAT "%13.11" /end CHARACTERISTIC
/begin CHARACTERISTIC DDRC_RatDeb.SCRPOD_numPresBuildUpErrUDRat_C "DDRC/Verhältnis Defekt / Heilungsentprellung für Prüfung DFC_SCRPODPresBuildUp" VALUE 0x80025EA1 Val_Wu8 3.00000000000 DDRC_Ratio 1.00000000000 4.00000000000 FORMAT "%13.11" /end CHARACTERISTIC
/begin CHARACTERISTIC DDRC_RatDeb.Layer_numPMRUHVERLUDRat_C "DDRC/Verhältnis Defekt / Heilungsentprellung für Prüfung DFC_Layer_PMRUHVERLNpl" VALUE 0x80025EA2 Val_Wu8 3.00000000000 DDRC_Ratio 1.00000000000 4.00000000000 FORMAT "%13.11" /end CHARACTERISTIC
/begin CHARACTERISTIC DDRC_RatDeb.Layer_numQLTUDRat_C "DDRC/Verhältnis Defekt / Heilungsentprellung für Prüfung DFC_Layer_QLTNpl" VALUE 0x80025EA3 Val_Wu8 3.00000000000 DDRC_Ratio 1.00000000000 4.00000000000 FORMAT "%13.11" /end CHARACTERISTIC
/begin CHARACTERISTIC DDRC_RatDeb.Layer_numPMBNUDRat_C "DDRC/Verhältnis Defekt / Heilungsentprellung für Prüfung DFC_Layer_PMBNNpl" VALUE 0x80025EA4 Val_Wu8 3.00000000000 DDRC_Ratio 1.00000000000 4.00000000000 FORMAT "%13.11" /end CHARACTERISTIC
/begin CHARACTERISTIC DDRC_RatDeb.Layer_numGENUDRat_C "DDRC/Verhältnis Defekt / Heilungsentprellung für Prüfung DFC_Layer_GENNpl" VALUE 0x80025EA5 Val_Wu8 3.00000000000 DDRC_Ratio 1.00000000000 4.00000000000 FORMAT "%13.11" /end CHARACTERISTIC
/begin CHARACTERISTIC DDRC_RatDeb.IVDia_numBnkShCirChSwtUDRat_C "DDRC/Verhältnis Defekt / Heilungsentprellung für Prüfung DFC_IVDiaBnkShCirChSwt" VALUE 0x80025EA6 Val_Wu8 3.00000000000 DDRC_Ratio 1.00000000000 4.00000000000 FORMAT "%13.11" /end CHARACTERISTIC
/begin CHARACTERISTIC DDRC_RatDeb.Layer_numIBS3UDRat_C "DDRC/Verhältnis Defekt / Heilungsentprellung für Prüfung DFC_Layer_IBS3Npl" VALUE 0x80025EA7 Val_Wu8 3.00000000000 DDRC_Ratio 1.00000000000 4.00000000000 FORMAT "%13.11" /end CHARACTERISTIC
/begin CHARACTERISTIC DDRC_RatDeb.IVDia_numCylShCirMeasUDRat_C "DDRC/Verhältnis Defekt / Heilungsentprellung für Prüfung DFC_IVDiaCylShCirMeas" VALUE 0x80025EA8 Val_Wu8 3.00000000000 DDRC_Ratio 1.00000000000 4.00000000000 FORMAT "%13.11" /end CHARACTERISTIC
/begin CHARACTERISTIC DDRC_RatDeb.Layer_numGENHTBUDRat_C "DDRC/Verhältnis Defekt / Heilungsentprellung für Prüfung DFC_Layer_GENHTBNpl" VALUE 0x80025EA9 Val_Wu8 3.00000000000 DDRC_Ratio 1.00000000000 4.00000000000 FORMAT "%13.11" /end CHARACTERISTIC
/begin CHARACTERISTIC DDRC_RatDeb.EngTrqPtd_ctMonLimCurrUDRat_C "DDRC/Verhältnis Defekt / Heilungsentprellung für Prüfung DFC_MonLimCurr" VALUE 0x80025EAA Val_Wu8 3.00000000000 DDRC_Ratio 1.00000000000 4.00000000000 FORMAT "%13.11" /end CHARACTERISTIC
/begin CHARACTERISTIC DDRC_RatDeb.Layer_numIBS2UDRat_C "DDRC/Verhältnis Defekt / Heilungsentprellung für Prüfung DFC_Layer_IBS2Npl" VALUE 0x80025EAB Val_Wu8 3.00000000000 DDRC_Ratio 1.00000000000 4.00000000000 FORMAT "%13.11" /end CHARACTERISTIC
/begin CHARACTERISTIC DDRC_RatDeb.LSU_numO2ClbMaxUDRat_C "DDRC/Verhältnis Defekt / Heilungsentprellung für Prüfung DFC_LSUO2ClbMax" VALUE 0x80025EAC Val_Wu8 3.00000000000 DDRC_Ratio 1.00000000000 4.00000000000 FORMAT "%13.11" /end CHARACTERISTIC
/begin CHARACTERISTIC DDRC_RatDeb.IVActr_numEnrgNplUDRat_C "DDRC/Verhältnis Defekt / Heilungsentprellung für Prüfung DFC_IVActrEnrgPlaus" VALUE 0x80025EAD Val_Wu8 3.00000000000 DDRC_Ratio 1.00000000000 4.00000000000 FORMAT "%13.11" /end CHARACTERISTIC
/begin CHARACTERISTIC DDRC_RatDeb.LSU_numO2PlausMinPartLdUDRat_C "DDRC/Verhältnis Defekt / Heilungsentprellung für Prüfung DFC_LSUO2PlausMinPartLd" VALUE 0x80025EAE Val_Wu8 3.00000000000 DDRC_Ratio 1.00000000000 4.00000000000 FORMAT "%13.11" /end CHARACTERISTIC
/begin CHARACTERISTIC DDRC_RatDeb.Layer_numGENMECHUDRat_C "DDRC/Verhältnis Defekt / Heilungsentprellung für Prüfung DFC_Layer_GENMECHNpl" VALUE 0x80025EAF Val_Wu8 3.00000000000 DDRC_Ratio 1.00000000000 4.00000000000 FORMAT "%13.11" /end CHARACTERISTIC
/begin CHARACTERISTIC DDRC_RatDeb.Layer_numGENHTUDRat_C "DDRC/Verhältnis Defekt / Heilungsentprellung für Prüfung DFC_Layer_GENHTNpl" VALUE 0x80025EB0 Val_Wu8 3.00000000000 DDRC_Ratio 1.00000000000 4.00000000000 FORMAT "%13.11" /end CHARACTERISTIC
/begin CHARACTERISTIC DDRC_RatDeb.Layer_numIBS1UDRat_C "DDRC/Verhältnis Defekt / Heilungsentprellung für Prüfung DFC_Layer_IBS1Npl" VALUE 0x80025EB1 Val_Wu8 3.00000000000 DDRC_Ratio 1.00000000000 4.00000000000 FORMAT "%13.11" /end CHARACTERISTIC
/begin CHARACTERISTIC DDRC_RatDeb.Exh_numNOxR2LMinNoCat2DsUDRat_C "DDRC/Verhältnis Defekt / Heilungsentprellung für Prüfung DFC_NoCat2DsNOxPlausMin" VALUE 0x80025EB2 Val_Wu8 3.00000000000 DDRC_Ratio 1.00000000000 4.00000000000 FORMAT "%13.11" /end CHARACTERISTIC
/begin CHARACTERISTIC DDRC_RatDeb.LSU_numO2PlausMinFLdUDRat_C "DDRC/Verhältnis Defekt / Heilungsentprellung für Prüfung DFC_LSUO2PlausMinFLd" VALUE 0x80025EB3 Val_Wu8 3.00000000000 DDRC_Ratio 1.00000000000 4.00000000000 FORMAT "%13.11" /end CHARACTERISTIC
/begin CHARACTERISTIC DDRC_RatDeb.Layer_numTOENSUDRat_C "DDRC/Verhältnis Defekt / Heilungsentprellung für Prüfung DFC_Layer_TOENSNpl" VALUE 0x80025EB4 Val_Wu8 3.00000000000 DDRC_Ratio 1.00000000000 4.00000000000 FORMAT "%13.11" /end CHARACTERISTIC
/begin CHARACTERISTIC DDRC_RatDeb.IVActr_numEnrgMaxUDRat_C "DDRC/Verhältnis Defekt / Heilungsentprellung für Prüfung DFC_IVActrEnrgMax" VALUE 0x80025EB5 Val_Wu8 3.00000000000 DDRC_Ratio 1.00000000000 4.00000000000 FORMAT "%13.11" /end CHARACTERISTIC
/begin CHARACTERISTIC DDRC_RatDeb.ETClb_numETMinUDRat_C "DDRC/Verhältnis Defekt / Heilungsentprellung für Prüfung DFC_ETClbETMin" VALUE 0x80025EB6 Val_Wu8 3.00000000000 DDRC_Ratio 1.00000000000 4.00000000000 FORMAT "%13.11" /end CHARACTERISTIC
/begin CHARACTERISTIC DDRC_RatDeb.Clth_numPlaUDRat_C "DDRC/Verhältnis Defekt / Heilungsentprellung für Prüfung DFC_ClthNpl" VALUE 0x80025EB7 Val_Wu8 3.00000000000 DDRC_Ratio 1.00000000000 4.00000000000 FORMAT "%13.11" /end CHARACTERISTIC
/begin CHARACTERISTIC DDRC_RatDeb.Exh_numNOxOfsNSCDsUDRat_C "DDRC/Verhältnis Defekt / Heilungsentprellung für Prüfung DFC_NSCDsNOxOfsMin" VALUE 0x80025EB8 Val_Wu8 3.00000000000 DDRC_Ratio 1.00000000000 4.00000000000 FORMAT "%13.11" /end CHARACTERISTIC
/begin CHARACTERISTIC DDRC_RatDeb.Layer_numNDR1UDRat_C "DDRC/Verhältnis Defekt / Heilungsentprellung für Prüfung DFC_Layer_NDR1Npl" VALUE 0x80025EB9 Val_Wu8 3.00000000000 DDRC_Ratio 1.00000000000 4.00000000000 FORMAT "%13.11" /end CHARACTERISTIC
/begin CHARACTERISTIC DDRC_RatDeb.Layer_numPMBATTUDRat_C "DDRC/Verhältnis Defekt / Heilungsentprellung für Prüfung DFC_Layer_PMBATTNpl" VALUE 0x80025EBA Val_Wu8 3.00000000000 DDRC_Ratio 1.00000000000 4.00000000000 FORMAT "%13.11" /end CHARACTERISTIC
/begin CHARACTERISTIC DDRC_RatDeb.LSU_numDynChkMinUDRat_C "DDRC/Verhältnis Defekt / Heilungsentprellung für Prüfung DFC_LSUDynChk" VALUE 0x80025EBB Val_Wu8 3.00000000000 DDRC_Ratio 1.00000000000 4.00000000000 FORMAT "%13.11" /end CHARACTERISTIC
/begin CHARACTERISTIC DDRC_RatDeb.LSU_numO2PlausMaxFLdUDRat_C "DDRC/Verhältnis Defekt / Heilungsentprellung für Prüfung DFC_LSUO2PlausMaxFLd" VALUE 0x80025EBC Val_Wu8 3.00000000000 DDRC_Ratio 1.00000000000 4.00000000000 FORMAT "%13.11" /end CHARACTERISTIC
/begin CHARACTERISTIC DDRC_RatDeb.IVCtl_numUUpOBDUDRat_C "DDRC/Verhältnis Defekt / Heilungsentprellung für Prüfung DFC_IVCtlUUp" VALUE 0x80025EBD Val_Wu8 3.00000000000 DDRC_Ratio 1.00000000000 4.00000000000 FORMAT "%13.11" /end CHARACTERISTIC
/begin CHARACTERISTIC DDRC_RatDeb.Layer_numNDR2UDRat_C "DDRC/Verhältnis Defekt / Heilungsentprellung für Prüfung DFC_Layer_NDR2Npl" VALUE 0x80025EBE Val_Wu8 3.00000000000 DDRC_Ratio 1.00000000000 4.00000000000 FORMAT "%13.11" /end CHARACTERISTIC
/begin CHARACTERISTIC DDRC_RatDeb.LSU_numWireIPSigUDRat_C "DDRC/Verhältnis Defekt / Heilungsentprellung für Prüfung DFC_LSUWireIPSig" VALUE 0x80025EBF Val_Wu8 3.00000000000 DDRC_Ratio 1.00000000000 4.00000000000 FORMAT "%13.11" /end CHARACTERISTIC
/begin CHARACTERISTIC DDRC_RatDeb.IVDia_numCylShCirHSLSUDRat_C "DDRC/Verhältnis Defekt / Heilungsentprellung für Prüfung DFC_IVDiaCylShCirHSLS" VALUE 0x80025EC0 Val_Wu8 3.00000000000 DDRC_Ratio 1.00000000000 4.00000000000 FORMAT "%13.11" /end CHARACTERISTIC
/begin CHARACTERISTIC DDRC_RatDeb.Layer_numGENELUDRat_C "DDRC/Verhältnis Defekt / Heilungsentprellung für Prüfung DFC_Layer_GENELNpl" VALUE 0x80025EC1 Val_Wu8 3.00000000000 DDRC_Ratio 1.00000000000 4.00000000000 FORMAT "%13.11" /end CHARACTERISTIC
/begin CHARACTERISTIC DDRC_RatDeb.EngTrqPtd_ctMonLimSetUDRat_C "DDRC/Verhältnis Defekt / Heilungsentprellung für Prüfung DFC_MonLimSet" VALUE 0x80025EC2 Val_Wu8 3.00000000000 DDRC_Ratio 1.00000000000 4.00000000000 FORMAT "%13.11" /end CHARACTERISTIC
/begin CHARACTERISTIC DDRC_RatDeb.LSU_numO2PlausMinOvrRunUDRat_C "DDRC/Verhältnis Defekt / Heilungsentprellung für Prüfung DFC_LSUO2PlausMinOvrRun" VALUE 0x80025EC3 Val_Wu8 3.00000000000 DDRC_Ratio 1.00000000000 4.00000000000 FORMAT "%13.11" /end CHARACTERISTIC
/begin CHARACTERISTIC DDRC_RatDeb.IVDia_numChpUDRat_C "DDRC/Verhältnis Defekt / Heilungsentprellung für Prüfung DFC_IVDiaChp" VALUE 0x80025EC4 Val_Wu8 3.00000000000 DDRC_Ratio 1.00000000000 4.00000000000 FORMAT "%13.11" /end CHARACTERISTIC
/begin CHARACTERISTIC DevLib_nActrRls_C "Minimale Drehzahl für Stellerfreigabe" VALUE 0x80038ABC Val_Ws16 9980.000 EngN 20.00000 10000.00 EXTENDED_LIMITS -16384.00 16383.50 /end CHARACTERISTIC
/begin CHARACTERISTIC Devlib_PsDisbl.facLowHysLo_C "Struktur zur Hysteresenprüfung auf Batteriespannungskorrekturfaktor/Untere Grenze für Batteriespannung LOW - Hystereseprüfung" VALUE 0x80038AC0 Kw_Ws16 1.000000 Fact 0.00 1.000000 EXTENDED_LIMITS -4.000000 3.999878 /end CHARACTERISTIC
/begin CHARACTERISTIC Devlib_PsDisbl.facLowHysHi_C "Struktur zur Hysteresenprüfung auf Batteriespannungskorrekturfaktor/Obere Hysterese-Grenze für Batteriespannungkorrekturfaktor LOW" VALUE 0x80038AC2 Kw_Ws16 1.000000 Fact 0.00 1.000000 EXTENDED_LIMITS -4.000000 3.999878 /end CHARACTERISTIC
/begin CHARACTERISTIC Devlib_PsDisbl.facHighHysLo_C "Struktur zur Hysteresenprüfung auf Batteriespannungskorrekturfaktor/Untere Grenze für Batteriespannungkorrekturfaktor HIGH" VALUE 0x80038AC4 Kw_Ws16 2.999878 Fact 1.000000 3.999878 EXTENDED_LIMITS -4.000000 3.999878 /end CHARACTERISTIC
/begin CHARACTERISTIC Devlib_PsDisbl.facHighHysHi_C "Struktur zur Hysteresenprüfung auf Batteriespannungskorrekturfaktor/Obere Hysterese-Grenze für Batteriespannungkorrekturfaktor HIGH" VALUE 0x80038AC6 Kw_Ws16 2.999878 Fact 1.000000 3.999878 EXTENDED_LIMITS -4.000000 3.999878 /end CHARACTERISTIC
/begin CHARACTERISTIC Devlib_PwrStg.BattLoHysLo_C "Parameterstruktur, die Hysteresenprüfungsgrenzen zur Batteriespannungsprüfung enthält/Untere Grenze für Batteriespannung LOW - Hystereseprüfung" VALUE 0x80038AC8 Kw_Ws16 1310700. Volt_Batt -655360.0 655340.0 /end CHARACTERISTIC
/begin CHARACTERISTIC Devlib_PwrStg.BattLoHysHi_C "Parameterstruktur, die Hysteresenprüfungsgrenzen zur Batteriespannungsprüfung enthält/Obere Grenze für Batteriespannung LOW - Hystereseprüfung" VALUE 0x80038ACA Kw_Ws16 1310700. Volt_Batt -655360.0 655340.0 /end CHARACTERISTIC
/begin CHARACTERISTIC Devlib_PwrStg.BattHiHysLo_C "Parameterstruktur, die Hysteresenprüfungsgrenzen zur Batteriespannungsprüfung enthält/Untere Grenze für Batteriespannung HIGH - Hystereseprüfung" VALUE 0x80038ACC Kw_Ws16 1310700. Volt_Batt -655360.0 655340.0 /end CHARACTERISTIC
/begin CHARACTERISTIC Devlib_PwrStg.BattHiHysHi_C "Parameterstruktur, die Hysteresenprüfungsgrenzen zur Batteriespannungsprüfung enthält/Obere Grenze für Batteriespannung HIGH - Hystereseprüfung" VALUE 0x80038ACE Kw_Ws16 1310700. Volt_Batt -655360.0 655340.0 /end CHARACTERISTIC
/begin CHARACTERISTIC DevLib_tiActrPrt_C "Stellerschutzzeit" VALUE 0x80038ABE Val_Ws16 2000.000 Time_ms 0.00 2000.000 EXTENDED_LIMITS -327680.0 327670.0 /end CHARACTERISTIC
/begin CHARACTERISTIC DevLib_tiDlyT15_C "Zeit für Fehlerausblendung nach Klemme15 Ein (Abwarten der Init-Zeit anderer Steuergeräte)" VALUE 0x80038AD0 Kw_Wu16 655350.0 Time_ms 0.00 655350.0 /end CHARACTERISTIC
/begin MEASUREMENT DevLib_stMonActrPrt "Aktueller Status der Stellerschutzsteuerung" UBYTE OneToOne 1 100 0.00 255.0 ECU_ADDRESS 0xD0001DD3 /end MEASUREMENT
/begin MEASUREMENT DevLib_stPwrStgEnaCond "Status der verschiedenen Fahrzeug- und Motorbedingungen" UWORD OneToOne 1 100 0.00 65535.00 ECU_ADDRESS 0xD00015A6 /end MEASUREMENT
/begin FUNCTION DDRC ""
 /begin DEF_CHARACTERISTIC DDRC_DurDeb.PFlt_tiPFltTraRpmRdcDebOk_C DDRC_DurDeb.PFlt_tiPFltTraRpmRdcDebDef_C DDRC_DurDeb.Com_tiSlrdiGlbFZMTo_FADebOk_C DDRC_DurDeb.Com_tiSlrdiGlbFZMTo_FADebDef_C DDRC_DurDeb.Com_tiStatusRGangToDebOk_C DDRC_DurDeb.Com_tiStatusRGangToDebDef_C DDRC_DurDeb.Com_tiTrqDemandGbxSig_FADebOk_C DDRC_DurDeb.Com_tiTrqDemandGbxSig_FADebDef_C DDRC_DurDeb.ETCtl_tiDvtOutrMaxDebOk_C DDRC_DurDeb.ETCtl_tiDvtOutrMaxDebDef_C DDRC_DurDeb.Air_PlsPIntkVUsDebOk_C DDRC_DurDeb.Air_PlsPIntkVUsDebDef_C DDRC_DurDeb.Com_tiTrqDemandGbxChk_ADebOk_C DDRC_DurDeb.Com_tiTrqDemandGbxChk_ADebDef_C DDRC_DurDeb.FBC_tiDvtMinDebOk_C DDRC_DurDeb.FBC_tiDvtMinDebDef_C DDRC_DurDeb.Com_tiACDemandTo_FADebOk_C DDRC_DurDeb.Com_tiACDemandTo_FADebDef_C DDRC_DurDeb.PFlt_tiPFltBPSPlausMAXDebOk_C DDRC_DurDeb.PFlt_tiPFltBPSPlausMAXDebDef_C DDRC_DurDeb.Com_tiButtonMSASigDebOk_C DDRC_DurDeb.Com_tiButtonMSASigDebDef_C DDRC_DurDeb.GlwEcu_tiTempErrDebOk_C DDRC_DurDeb.GlwEcu_tiTempErrDebDef_C DDRC_DurDeb.Com_tiSteeringAngleCtr_FXDebOk_C DDRC_DurDeb.Com_tiSteeringAngleCtr_FXDebDef_C DDRC_DurDeb.Com_tiCodierungPwrmngSig_FADebOk_C DDRC_DurDeb.Com_tiCodierungPwrmngSig_FADebDef_C DDRC_DurDeb.WaHtEl_ti4WinErr4DebOk_C DDRC_DurDeb.WaHtEl_ti4WinErr4DebDef_C DDRC_DurDeb.Com_tiRequestEMFToDebOk_C DDRC_DurDeb.Com_tiRequestEMFToDebDef_C DDRC_DurDeb.Com_tiRelTimeTo_FADebOk_C DDRC_DurDeb.Com_tiRelTimeTo_FADebDef_C DDRC_DurDeb.Com_tiGbxDataTo_FADebOk_C DDRC_DurDeb.Com_tiGbxDataTo_FADebDef_C DDRC_DurDeb.Com_tiStatGearRevSig_FADebOk_C DDRC_DurDeb.Com_tiStatGearRevSig_FADebDef_C DDRC_DurDeb.Com_tiSpeedVehicleChk_FXDebOk_C DDRC_DurDeb.Com_tiSpeedVehicleChk_FXDebDef_C DDRC_DurDeb.Com_tiSecCtrRelSig_FADebOk_C DDRC_DurDeb.Com_tiSecCtrRelSig_FADebDef_C DDRC_DurDeb.Com_tiCrCtlLvrSigDebOk_C DDRC_DurDeb.Com_tiCrCtlLvrSigDebDef_C DDRC_DurDeb.Com_tiTrqWhlDemCtrDebOk_C DDRC_DurDeb.Com_tiTrqWhlDemCtrDebDef_C DDRC_DurDeb.Com_tiCtrCrshSwoEkpTo_FADebOk_C DDRC_DurDeb.Com_tiCtrCrshSwoEkpTo_FADebDef_C DDRC_DurDeb.CY320_tiSpiCommErrorDebOk_C DDRC_DurDeb.CY320_tiSpiCommErrorDebDef_C DDRC_DurDeb.Com_tiStatusEMFCtrDebOk_C DDRC_DurDeb.Com_tiStatusEMFCtrDebDef_C DDRC_DurDeb.Com_tiVelocityToDebOk_C DDRC_DurDeb.Com_tiVelocityToDebDef_C DDRC_DurDeb.Com_tiCtrSecIntToDebOk_C DDRC_DurDeb.Com_tiCtrSecIntToDebDef_C DDRC_DurDeb.PFlt_tiPreMaxDebOk_C DDRC_DurDeb.PFlt_tiPreMaxDebDef_C DDRC_DurDeb.Com_tiStatusEGSTo_ADebOk_C DDRC_DurDeb.Com_tiStatusEGSTo_ADebDef_C DDRC_DurDeb.PFlt_tiPFltPresPlausMINDebOk_C DDRC_DurDeb.PFlt_tiPFltPresPlausMINDebDef_C DDRC_DurDeb.AirCtl_tiGovDvtMaxDebOk_C DDRC_DurDeb.AirCtl_tiGovDvtMaxDebDef_C DDRC_DurDeb.Rail_tiPCV0DebOk_C DDRC_DurDeb.Rail_tiPCV0DebDef_C DDRC_DurDeb.ThrVlv_ti4WinErr4DebOk_C DDRC_DurDeb.ThrVlv_ti4WinErr4DebDef_C DDRC_DurDeb.Com_tiTrqDemandDesToDebOk_C DDRC_DurDeb.Com_tiTrqDemandDesToDebDef_C DDRC_DurDeb.Com_tiVelocitySigDebOk_C DDRC_DurDeb.Com_tiVelocitySigDebDef_C DDRC_DurDeb.Com_tiRequestEMFCtrDebOk_C DDRC_DurDeb.Com_tiRequestEMFCtrDebDef_C DDRC_DurDeb.GlwEcu_tiGkSCDebOk_C DDRC_DurDeb.GlwEcu_tiGkSCDebDef_C DDRC_DurDeb.Com_tiBtnDrvDynCtr_FXDebOk_C DDRC_DurDeb.Com_tiBtnDrvDynCtr_FXDebDef_C DDRC_DurDeb.Com_tiTrqDemCrshDrDyTo_FXDebOk_C DDRC_DurDeb.Com_tiTrqDemCrshDrDyTo_FXDebDef_C DDRC_DurDeb.PFlt_tiOxiPreMaxRgnDebOk_C DDRC_DurDeb.PFlt_tiOxiPreMaxRgnDebDef_C DDRC_DurDeb.TLE6232_tiSpiErrorDebOk_C DDRC_DurDeb.TLE6232_tiSpiErrorDebDef_C DDRC_DurDeb.Com_tiaBtnDrvDynTo_FXDebOk_C DDRC_DurDeb.Com_tiaBtnDrvDynTo_FXDebDef_C DDRC_DurDeb.Com_tiTrqDemCrshDrDyChk_FXDebOk_C DDRC_DurDeb.Com_tiTrqDemCrshDrDyChk_FXDebDef_C DDRC_DurDeb.Com_tiATempTo_FXDebOk_C DDRC_DurDeb.Com_tiATempTo_FXDebDef_C DDRC_DurDeb.Com_tiTrqDemandGbxTo_ADebOk_C DDRC_DurDeb.Com_tiTrqDemandGbxTo_ADebDef_C DDRC_DurDeb.Com_tiTrqWhlDemFASChk_FXDebOk_C DDRC_DurDeb.Com_tiTrqWhlDemFASChk_FXDebDef_C DDRC_DurDeb.AirCtl_tiGovLPDvtMaxDebOk_C DDRC_DurDeb.AirCtl_tiGovLPDvtMaxDebDef_C DDRC_DurDeb.PCR_tiGovDvtMaxDebOk_C DDRC_DurDeb.PCR_tiGovDvtMaxDebDef_C DDRC_DurDeb.Lub_tiOilFldtCritDebOk_C DDRC_DurDeb.Lub_tiOilFldtCritDebDef_C DDRC_DurDeb.PCR_tiGovDvtLPMinDebOk_C DDRC_DurDeb.PCR_tiGovDvtLPMinDebDef_C DDRC_DurDeb.GlwEcu_tiConfigErrDebOk_C DDRC_DurDeb.GlwEcu_tiConfigErrDebDef_C DDRC_DurDeb.ETCtl_tiDvtOutrMinDebOk_C DDRC_DurDeb.ETCtl_tiDvtOutrMinDebDef_C DDRC_DurDeb.Com_tiGbxDataCtr_ADebOk_C DDRC_DurDeb.Com_tiGbxDataCtr_ADebDef_C DDRC_DurDeb.TrbCh_ti4WinErr1DebOk_C DDRC_DurDeb.TrbCh_ti4WinErr1DebDef_C DDRC_DurDeb.Com_tiCrCtlLvrToDebOk_C DDRC_DurDeb.Com_tiCrCtlLvrToDebDef_C DDRC_DurDeb.Com_tiTrailerSigDebOk_C DDRC_DurDeb.Com_tiTrailerSigDebDef_C DDRC_DurDeb.Com_tiShutOffPSPSigDebOk_C DDRC_DurDeb.Com_tiShutOffPSPSigDebDef_C DDRC_DurDeb.Com_tiCrCtlLvrCtrDebOk_C DDRC_DurDeb.Com_tiCrCtlLvrCtrDebDef_C DDRC_DurDeb.PFlt_tiPFltAPSPlausMAXDebOk_C DDRC_DurDeb.PFlt_tiPFltAPSPlausMAXDebDef_C DDRC_DurDeb.MonUMaxSupply1DebOk_C DDRC_DurDeb.MonUMaxSupply1DebDef_C DDRC_DurDeb.Com_tiKlemmenChk_FADebOk_C DDRC_DurDeb.Com_tiKlemmenChk_FADebDef_C DDRC_DurDeb.Com_tiSteeringAngleTo_FXDebOk_C DDRC_DurDeb.Com_tiSteeringAngleTo_FXDebDef_C DDRC_DurDeb.Com_tiBrkTrqSumTo_FXDebOk_C DDRC_DurDeb.Com_tiBrkTrqSumTo_FXDebDef_C DDRC_DurDeb.Com_tiStatusEMFToDebOk_C DDRC_DurDeb.Com_tiStatusEMFToDebDef_C DDRC_DurDeb.PFlt_tiPreNplDebOk_C DDRC_DurDeb.PFlt_tiPreNplDebDef_C DDRC_DurDeb.Com_tiStatZVKlappenSig_FADebOk_C DDRC_DurDeb.Com_tiStatZVKlappenSig_FADebDef_C DDRC_DurDeb.Com_tiFahrzeugtypSigDebOk_C DDRC_DurDeb.Com_tiFahrzeugtypSigDebDef_C DDRC_DurDeb.Rail_tiMeUn5DebOk_C DDRC_DurDeb.Rail_tiMeUn5DebDef_C DDRC_DurDeb.AirCtl_tiGovLPDvtMinDebOk_C DDRC_DurDeb.AirCtl_tiGovLPDvtMinDebDef_C DDRC_DurDeb.Com_tiStatusRGangSigDebOk_C DDRC_DurDeb.Com_tiStatusRGangSigDebDef_C DDRC_DurDeb.PFlt_tiOxiPreNplDebOk_C DDRC_DurDeb.PFlt_tiOxiPreNplDebDef_C DDRC_DurDeb.Com_tiStateARSToDebOk_C DDRC_DurDeb.Com_tiStateARSToDebDef_C DDRC_DurDeb.Com_tiStateDscToDebOk_C DDRC_DurDeb.Com_tiStateDscToDebDef_C DDRC_DurDeb.Com_tiTerminalToDebOk_C DDRC_DurDeb.Com_tiTerminalToDebDef_C DDRC_DurDeb.Rail_tiPCV1DebOk_C DDRC_DurDeb.Rail_tiPCV1DebDef_C DDRC_DurDeb.Com_tiStateSeatSigDebOk_C DDRC_DurDeb.Com_tiStateSeatSigDebDef_C DDRC_DurDeb.Com_tiStConintDSCCtr_FXDebOk_C DDRC_DurDeb.Com_tiStConintDSCCtr_FXDebDef_C DDRC_DurDeb.Com_tiStateARSCtrDebOk_C DDRC_DurDeb.Com_tiStateARSCtrDebDef_C DDRC_DurDeb.Com_tiTrqDemandDscSigDebOk_C DDRC_DurDeb.Com_tiTrqDemandDscSigDebDef_C DDRC_DurDeb.Com_tiWheelSpeedSigDebOk_C DDRC_DurDeb.Com_tiWheelSpeedSigDebDef_C DDRC_DurDeb.Com_tiTrailerTo_FADebOk_C DDRC_DurDeb.Com_tiTrailerTo_FADebDef_C DDRC_DurDeb.Com_tiTrqWhlDemChkDebOk_C DDRC_DurDeb.Com_tiTrqWhlDemChkDebDef_C DDRC_DurDeb.WaHtEl_ti4WinErr2DebOk_C DDRC_DurDeb.WaHtEl_ti4WinErr2DebDef_C DDRC_DurDeb.FlFCBS_tiLThresDebOk_C DDRC_DurDeb.FlFCBS_tiLThresDebDef_C DDRC_DurDeb.GlwEcu_tiEepErrDebOk_C DDRC_DurDeb.GlwEcu_tiEepErrDebDef_C DDRC_DurDeb.Com_tiStatusEMFSigDebOk_C DDRC_DurDeb.Com_tiStatusEMFSigDebDef_C DDRC_DurDeb.CJ945_tiSpiCommErrorDebOk_C DDRC_DurDeb.CJ945_tiSpiCommErrorDebDef_C DDRC_DurDeb.Com_tiStatusEGSSig_ADebOk_C DDRC_DurDeb.Com_tiStatusEGSSig_ADebDef_C DDRC_DurDeb.TrbCh_ti4WinErr2DebOk_C DDRC_DurDeb.TrbCh_ti4WinErr2DebDef_C DDRC_DurDeb.Com_tiStatZVKlappenTo_FADebOk_C DDRC_DurDeb.Com_tiStatZVKlappenTo_FADebDef_C DDRC_DurDeb.Com_tiWMomPTStabChk_FXDebOk_C DDRC_DurDeb.Com_tiWMomPTStabChk_FXDebDef_C DDRC_DurDeb.Lub_tiOilLvlCritMaxDebOk_C DDRC_DurDeb.Lub_tiOilLvlCritMaxDebDef_C DDRC_DurDeb.Com_tiTrqDemandDscChkDebOk_C DDRC_DurDeb.Com_tiTrqDemandDscChkDebDef_C DDRC_DurDeb.Com_tiGbxDataCtr_FADebOk_C DDRC_DurDeb.Com_tiGbxDataCtr_FADebDef_C DDRC_DurDeb.Com_tiaSideCtr_FXDebOk_C DDRC_DurDeb.Com_tiaSideCtr_FXDebDef_C DDRC_DurDeb.Rail_tiCPC3DebOk_C DDRC_DurDeb.Rail_tiCPC3DebDef_C DDRC_DurDeb.SSpMon1DebOk_C DDRC_DurDeb.SSpMon1DebDef_C DDRC_DurDeb.PFlt_tiPFltOvldTrqLimDebOk_C DDRC_DurDeb.PFlt_tiPFltOvldTrqLimDebDef_C DDRC_DurDeb.MonUMinSupply1DebOk_C DDRC_DurDeb.MonUMinSupply1DebDef_C DDRC_DurDeb.Com_tiSteeringAngleChk_FXDebOk_C DDRC_DurDeb.Com_tiSteeringAngleChk_FXDebDef_C DDRC_DurDeb.Com_tiGbxDataSig_ADebOk_C DDRC_DurDeb.Com_tiGbxDataSig_ADebDef_C DDRC_DurDeb.Com_tiStatusEGSTo_FADebOk_C DDRC_DurDeb.Com_tiStatusEGSTo_FADebDef_C DDRC_DurDeb.Com_tiShiftPaddleTo_FXDebOk_C DDRC_DurDeb.Com_tiShiftPaddleTo_FXDebDef_C DDRC_DurDeb.Fan_tiSCGDebOk_C DDRC_DurDeb.Fan_tiSCGDebDef_C DDRC_DurDeb.Lub_tiOilFldtCritDflMinDebOk_C DDRC_DurDeb.Lub_tiOilFldtCritDflMinDebDef_C DDRC_DurDeb.GlwEcu_tiGkWdstDebOk_C DDRC_DurDeb.GlwEcu_tiGkWdstDebDef_C DDRC_DurDeb.TrbCh_ti4WinErr3DebOk_C DDRC_DurDeb.TrbCh_ti4WinErr3DebDef_C DDRC_DurDeb.Com_tiRpmWhlTo_FXDebOk_C DDRC_DurDeb.Com_tiRpmWhlTo_FXDebDef_C DDRC_DurDeb.Com_tiWMomPTStabCtr_FXDebOk_C DDRC_DurDeb.Com_tiWMomPTStabCtr_FXDebDef_C DDRC_DurDeb.ThrVlv_ti4WinErr2DebOk_C DDRC_DurDeb.ThrVlv_ti4WinErr2DebDef_C DDRC_DurDeb.Com_tiTrqWhlDemToDebOk_C DDRC_DurDeb.Com_tiTrqWhlDemToDebDef_C DDRC_DurDeb.ACCI_tiPlausDebOk_C DDRC_DurDeb.ACCI_tiPlausDebDef_C DDRC_DurDeb.ETCtl_tiDvtInrMaxDebOk_C DDRC_DurDeb.ETCtl_tiDvtInrMaxDebDef_C DDRC_DurDeb.BusDiag_tiBusOffNodeBDebOk_C DDRC_DurDeb.BusDiag_tiBusOffNodeBDebDef_C DDRC_DurDeb.Rail_tiMeUn42DebOk_C DDRC_DurDeb.Rail_tiMeUn42DebDef_C DDRC_DurDeb.Com_tiTrailerSig_FADebOk_C DDRC_DurDeb.Com_tiTrailerSig_FADebDef_C DDRC_DurDeb.Com_tiButtonMSAToDebOk_C DDRC_DurDeb.Com_tiButtonMSAToDebDef_C DDRC_DurDeb.PFlt_tiPFltOvldInhRgnDebOk_C DDRC_DurDeb.PFlt_tiPFltOvldInhRgnDebDef_C DDRC_DurDeb.Lub_tiOilLvlCritMinDebOk_C DDRC_DurDeb.Lub_tiOilLvlCritMinDebDef_C DDRC_DurDeb.Com_tiATempSig_FADebOk_C DDRC_DurDeb.Com_tiATempSig_FADebDef_C DDRC_DurDeb.ACCI_tiDrvAstDebOk_C DDRC_DurDeb.ACCI_tiDrvAstDebDef_C DDRC_DurDeb.Com_tiBtnDrvDynChk_FXDebOk_C DDRC_DurDeb.Com_tiBtnDrvDynChk_FXDebDef_C DDRC_DurDeb.PFlt_tiPresPlausDblDefDebOk_C DDRC_DurDeb.PFlt_tiPresPlausDblDefDebDef_C DDRC_DurDeb.Com_tiWMomPTStabTo_FXDebOk_C DDRC_DurDeb.Com_tiWMomPTStabTo_FXDebDef_C DDRC_DurDeb.GlwEcu_tiGkHSSDebOk_C DDRC_DurDeb.GlwEcu_tiGkHSSDebDef_C DDRC_DurDeb.Fan_ti4WinErr4DebOk_C DDRC_DurDeb.Fan_ti4WinErr4DebDef_C DDRC_DurDeb.Com_tiWheelSpeedToDebOk_C DDRC_DurDeb.Com_tiWheelSpeedToDebDef_C DDRC_DurDeb.AirCtl_tiGovDvtEOMMinDebOk_C DDRC_DurDeb.AirCtl_tiGovDvtEOMMinDebDef_C DDRC_DurDeb.Com_tiZvKlappenToDebOk_C DDRC_DurDeb.Com_tiZvKlappenToDebDef_C DDRC_DurDeb.Com_tiMileageRangeTo_FADebOk_C DDRC_DurDeb.Com_tiMileageRangeTo_FADebDef_C DDRC_DurDeb.Com_tiFllupGpwsupTo_FADebOk_C DDRC_DurDeb.Com_tiFllupGpwsupTo_FADebDef_C DDRC_DurDeb.Com_tiKlemmenTo_FADebOk_C DDRC_DurDeb.Com_tiKlemmenTo_FADebDef_C DDRC_DurDeb.SSpMon2DebOk_C DDRC_DurDeb.SSpMon2DebDef_C DDRC_DurDeb.Com_tiStatACFrontSig_FADebOk_C DDRC_DurDeb.Com_tiStatACFrontSig_FADebDef_C DDRC_DurDeb.Com_tiStatACFrontTo_FADebOk_C DDRC_DurDeb.Com_tiStatACFrontTo_FADebDef_C DDRC_DurDeb.WaHtEl_ti4WinErr1DebOk_C DDRC_DurDeb.WaHtEl_ti4WinErr1DebDef_C DDRC_DurDeb.Com_tiSensNOxUbattToDebOk_C DDRC_DurDeb.Com_tiSensNOxUbattToDebDef_C DDRC_DurDeb.GlwEcu_tiIntErrDebOk_C DDRC_DurDeb.GlwEcu_tiIntErrDebDef_C DDRC_DurDeb.Rail_tiMeUn3DebOk_C DDRC_DurDeb.Rail_tiMeUn3DebDef_C DDRC_DurDeb.Rail_tiPCV4DebOk_C DDRC_DurDeb.Rail_tiPCV4DebDef_C DDRC_DurDeb.ThrVlv_ti4WinErr1DebOk_C DDRC_DurDeb.ThrVlv_ti4WinErr1DebDef_C DDRC_DurDeb.Com_tiRpmWhlCtr_FXDebOk_C DDRC_DurDeb.Com_tiRpmWhlCtr_FXDebDef_C DDRC_DurDeb.SSpMon3DebOk_C DDRC_DurDeb.SSpMon3DebDef_C DDRC_DurDeb.Oil_tiComNplDebOk_C DDRC_DurDeb.Oil_tiComNplDebDef_C DDRC_DurDeb.Com_tiKlemmenSig_FADebOk_C DDRC_DurDeb.Com_tiKlemmenSig_FADebDef_C DDRC_DurDeb.Com_tiTrqWhlDemFASTo_FXDebOk_C DDRC_DurDeb.Com_tiTrqWhlDemFASTo_FXDebDef_C DDRC_DurDeb.GlwEcu_tiGPCMInfoDebOk_C DDRC_DurDeb.GlwEcu_tiGPCMInfoDebDef_C DDRC_DurDeb.TrbCh_ti4WinErr4DebOk_C DDRC_DurDeb.TrbCh_ti4WinErr4DebDef_C DDRC_DurDeb.Com_tiTrqWhlDemSigDebOk_C DDRC_DurDeb.Com_tiTrqWhlDemSigDebDef_C DDRC_DurDeb.TrbCh_tiSRCMinDebOk_C DDRC_DurDeb.TrbCh_tiSRCMinDebDef_C DDRC_DurDeb.Com_tiVelocitySig_FADebOk_C DDRC_DurDeb.Com_tiVelocitySig_FADebDef_C DDRC_DurDeb.Com_tiRequestEMFSigDebOk_C DDRC_DurDeb.Com_tiRequestEMFSigDebDef_C DDRC_DurDeb.Com_tiMileageRangeSig_FADebOk_C DDRC_DurDeb.Com_tiMileageRangeSig_FADebDef_C DDRC_DurDeb.Com_tiStatusEMFChkDebOk_C DDRC_DurDeb.Com_tiStatusEMFChkDebDef_C DDRC_DurDeb.Com_tiTrqDemandGbxCtr_FADebOk_C DDRC_DurDeb.Com_tiTrqDemandGbxCtr_FADebDef_C DDRC_DurDeb.AltIO_tiComErrDebOk_C DDRC_DurDeb.AltIO_tiComErrDebDef_C DDRC_DurDeb.Com_tiCodierungPwrmngSigDebOk_C DDRC_DurDeb.Com_tiCodierungPwrmngSigDebDef_C DDRC_DurDeb.Com_tiStateDscSigDebOk_C DDRC_DurDeb.Com_tiStateDscSigDebDef_C DDRC_DurDeb.Com_tiStateSeatTo_FADebOk_C DDRC_DurDeb.Com_tiStateSeatTo_FADebDef_C DDRC_DurDeb.Rail_tiCPC4DebOk_C DDRC_DurDeb.Rail_tiCPC4DebDef_C DDRC_DurDeb.Com_tiVelocityCtr_FADebOk_C DDRC_DurDeb.Com_tiVelocityCtr_FADebDef_C DDRC_DurDeb.Com_tiTimeDateTo_FADebOk_C DDRC_DurDeb.Com_tiTimeDateTo_FADebDef_C DDRC_DurDeb.Com_tiVerbraucherToDebOk_C DDRC_DurDeb.Com_tiVerbraucherToDebDef_C DDRC_DurDeb.Com_tiaDirectTo_FXDebOk_C DDRC_DurDeb.Com_tiaDirectTo_FXDebDef_C DDRC_DurDeb.GlwEcu_tiMsgTimeoutDebOk_C DDRC_DurDeb.GlwEcu_tiMsgTimeoutDebDef_C DDRC_DurDeb.Com_tiTrqDemandGbxChk_FADebOk_C DDRC_DurDeb.Com_tiTrqDemandGbxChk_FADebDef_C DDRC_DurDeb.PCBS_tiCCLThresDebOk_C DDRC_DurDeb.PCBS_tiCCLThresDebDef_C DDRC_DurDeb.Com_tiComSensNOxModeDebOk_C DDRC_DurDeb.Com_tiComSensNOxModeDebDef_C DDRC_DurDeb.PFlt_tiPFltPresPlausMAXDebOk_C DDRC_DurDeb.PFlt_tiPFltPresPlausMAXDebDef_C DDRC_DurDeb.Com_tiACDemandSig_FADebOk_C DDRC_DurDeb.Com_tiACDemandSig_FADebDef_C DDRC_DurDeb.Com_tiTerminalChkDebOk_C DDRC_DurDeb.Com_tiTerminalChkDebDef_C DDRC_DurDeb.ThrVlv_tiSCGDebOk_C DDRC_DurDeb.ThrVlv_tiSCGDebDef_C DDRC_DurDeb.Rail_tiCPC1DebOk_C DDRC_DurDeb.Rail_tiCPC1DebDef_C DDRC_DurDeb.PFlt_tiPFltmSotDiffSIGDebOk_C DDRC_DurDeb.PFlt_tiPFltmSotDiffSIGDebDef_C DDRC_DurDeb.ETClb_numETFltMaxDebOk_C DDRC_DurDeb.ETClb_numETFltMaxDebDef_C DDRC_DurDeb.InjCrv_numInjLimDebOk_C DDRC_DurDeb.InjCrv_numInjLimDebDef_C DDRC_DurDeb.ETClb_numETFltMinDebOk_C DDRC_DurDeb.ETClb_numETFltMinDebDef_C DDRC_DurDeb.LSU_numHtCoupSigDebOk_C DDRC_DurDeb.LSU_numHtCoupSigDebDef_C DDRC_RatDeb.TrbCh_tiOLUDRat_C DDRC_RatDeb.ThrVlv_tiOLUDRat_C DDRC_RatDeb.WaHtEl_tiSCBUDRat_C DDRC_RatDeb.EBxFan_tiOvrTempUDRat_C DDRC_RatDeb.RailP_tiSRCMinUDRat_C DDRC_RatDeb.Fan_tiOLUDRat_C DDRC_RatDeb.ECBVlv_tiOvrTempUDRat_C DDRC_RatDeb.EBxFan_tiSCGUDRat_C DDRC_RatDeb.UPmpMot_tiOLUDRat_C DDRC_RatDeb.AirC_tiCmprOLUDRat_C DDRC_RatDeb.UDosVlv_tiOLUDRat_C DDRC_RatDeb.ThrVlv_tiSCBUDRat_C DDRC_RatDeb.CThmst_tiOvrTempUDRat_C DDRC_RatDeb.UDosVlv_tiSCGUDRat_C DDRC_RatDeb.Strt_tiSCBUDRat_C DDRC_RatDeb.CByVlv_tiSCGUDRat_C DDRC_RatDeb.TrbCh_tiOvrTempUDRat_C DDRC_RatDeb.EBxFan_tiSCBUDRat_C DDRC_RatDeb.Strt_tiOvrTempUDRat_C DDRC_RatDeb.ECBVlv_tiSCBUDRat_C DDRC_RatDeb.EngStA_tiOvrTempUDRat_C DDRC_RatDeb.UPmpMot_tiSCGUDRat_C DDRC_RatDeb.WaHtEl_tiOvrTempUDRat_C DDRC_RatDeb.CByVlv_tiOLUDRat_C DDRC_RatDeb.UDosVlv_tiOvrTempUDRat_C DDRC_RatDeb.CThmst_tiSCBUDRat_C DDRC_RatDeb.CThmst_tiOLUDRat_C DDRC_RatDeb.PCV_tiOLUDRat_C DDRC_RatDeb.LSU_tiHtrMinUDRat_C DDRC_RatDeb.Fan_tiSCBUDRat_C DDRC_RatDeb.ECBVlv_tiOLUDRat_C DDRC_RatDeb.UPmpMot_tiSCBUDRat_C DDRC_RatDeb.ThrVlv_tiOvrTempUDRat_C DDRC_RatDeb.FlFltHt_tiSCBUDRat_C DDRC_RatDeb.EBxFan_tiOLUDRat_C DDRC_RatDeb.LSU_titExcMinUDRat_C DDRC_RatDeb.DSMTst_ExampleUDRat_C DDRC_RatDeb.AirC_tiCmprSCBUDRat_C DDRC_RatDeb.EMDmp_tiSCBUDRat_C DDRC_RatDeb.Shtr_tiOvrTempUDRat_C DDRC_RatDeb.LSU_tiHtrSigUDRat_C DDRC_RatDeb.WaHtEl_tiOLUDRat_C DDRC_RatDeb.MeUn_tiOLUDRat_C DDRC_RatDeb.LSU_tiHtrNplUDRat_C DDRC_RatDeb.Strt_tiOLUDRat_C DDRC_RatDeb.PCV_tiSRCMinUDRat_C DDRC_RatDeb.AirC_tiCmprOvrTempUDRat_C DDRC_RatDeb.UPmpMot_tiOvrTempUDRat_C DDRC_RatDeb.LSU_tiHtrMaxUDRat_C DDRC_RatDeb.EngStA_tiSCGUDRat_C DDRC_RatDeb.EngStA_tiSCBUDRat_C DDRC_RatDeb.Shtr_tiSCGUDRat_C DDRC_RatDeb.EMDmp_tiOvrTempUDRat_C DDRC_RatDeb.MeUn_tiSCBUDRat_C DDRC_RatDeb.Strt_tiSCGUDRat_C DDRC_RatDeb.EngStA_tiOLUDRat_C DDRC_RatDeb.CByVlv_tiOvrTempUDRat_C DDRC_RatDeb.LSU_titExcMaxUDRat_C DDRC_RatDeb.Shtr_tiOLUDRat_C DDRC_RatDeb.Shtr_tiSCBUDRat_C DDRC_RatDeb.ECBVlv_tiSCGUDRat_C DDRC_RatDeb.FlFltHt_tiSCGUDRat_C DDRC_RatDeb.UDosVlv_tiSCBUDRat_C DDRC_RatDeb.AFS_SSpShOff_tiOvrTempUDRat_C DDRC_RatDeb.MeUn_tiSRCMinUDRat_C DDRC_RatDeb.FlFltHt_tiOLUDRat_C DDRC_RatDeb.Fan_tiOvrTempUDRat_C DDRC_RatDeb.MeUn_tiSRCMaxUDRat_C DDRC_RatDeb.CThmst_tiSCGUDRat_C DDRC_RatDeb.PCV_tiSRCMaxUDRat_C DDRC_RatDeb.PCV_tiSCBUDRat_C DDRC_RatDeb.EMDmp_tiSCGUDRat_C DDRC_RatDeb.AFS_SSpShOff_tiOLUDRat_C DDRC_RatDeb.AFS_SSpShOff_tiSCBUDRat_C DDRC_RatDeb.AFS_SSpShOff_tiSCGUDRat_C DDRC_RatDeb.EMDmp_tiOLUDRat_C DDRC_RatDeb.CByVlv_tiSCBUDRat_C DDRC_RatDeb.AirC_tiCmprSCGUDRat_C DDRC_RatDeb.TrbCh_tiSCBUDRat_C DDRC_RatDeb.RailP_tiSRCMaxUDRat_C DDRC_RatDeb.SCRMon_numDFCPresRdcUDRat_C DDRC_RatDeb.IVActr_numVltgSRCMaxUDRat_C DDRC_RatDeb.IVActr_numUChSRCMinUDRat_C DDRC_RatDeb.SCRMon_numDFCMetCtlUDRat_C DDRC_RatDeb.IVPSply_numDCDCUDRat_C DDRC_RatDeb.SCRMon_numDFCPresBuildUpUDRat_C DDRC_RatDeb.SCRChk_numEtaErrUDRat_C DDRC_RatDeb.IVPSply_numVltgSRCMaxUDRat_C DDRC_RatDeb.SCRChk_numEtaErr1UDRat_C DDRC_RatDeb.IVDia_numTunDetUDRat_C DDRC_RatDeb.SCRChk_numEtaErr2UDRat_C DDRC_RatDeb.IVActr_numVltgSRCMinUDRat_C DDRC_RatDeb.IVActr_numUChSRCMaxUDRat_C DDRC_RatDeb.IVPSply_numVltgSRCMinUDRat_C DDRC_RatDeb.Exh_tiPlausExhTMon1UDRat_C DDRC_RatDeb.Exh_tiMaxNSCDsUDRat_C DDRC_RatDeb.Air_tiDtyCycLoTAFSUDRat_C DDRC_RatDeb.ECBVlv_tiSRCMaxUDRat_C DDRC_RatDeb.Exh_tiLamPlausMinNoCat2DsUDRat_C DDRC_RatDeb.VSwVlv_tiHBrgShCirGnd1UDRat_C DDRC_RatDeb.EGRVlv_tiSCGUDRat_C DDRC_RatDeb.FlFltDsP_tiMinUDRat_C DDRC_RatDeb.InjVlv_tiPresMinUDRat_C DDRC_RatDeb.Exh_tiLamPlausMaxNSCDsUDRat_C DDRC_RatDeb.Exh_tiNplDynPPFltDiffUDRat_C DDRC_RatDeb.TECU_tiSRCMaxUDRat_C DDRC_RatDeb.AFS_tiCorSRCMaxUDRat_C DDRC_RatDeb.Exh_tiExhTMon3PlausUDRat_C DDRC_RatDeb.Exh_tiLamPlausMinNSCDsUDRat_C DDRC_RatDeb.EGRVlvLP_tiHBrgShCirOvrLdUDRat_C DDRC_RatDeb.CrCUI_tiDetUDRat_C DDRC_RatDeb.CEngDsT_tiMaxUDRat_C DDRC_RatDeb.MeUn_tiSCGUDRat_C DDRC_RatDeb.FlFltUsP_tiMinUDRat_C DDRC_RatDeb.EGRVlv_tiHBrgShCirOvrLdUDRat_C DDRC_RatDeb.UHtrTnk_tiSCGUDRat_C DDRC_RatDeb.Exh_tiSRCLamLinNSCDsUDRat_C DDRC_RatDeb.EngPrt_tiOvrSpdUDRat_C DDRC_RatDeb.SCR_tiSRCMinUTnkTUDRat_C DDRC_RatDeb.UHtrPL_tiSRCMinDiaUDRat_C DDRC_RatDeb.FlFlt_tiSigUDRat_C DDRC_RatDeb.FuelT_tiMaxUDRat_C DDRC_RatDeb.SCR_tiSRCMinUCatUsTUDRat_C DDRC_RatDeb.Exh_tiCmpChkNoCat2DsUDRat_C DDRC_RatDeb.BrkP_tiMinUDRat_C DDRC_RatDeb.T15_tiNplUDRat_C DDRC_RatDeb.EGRVlv_tiHBrgTempOvrCurrUDRat_C DDRC_RatDeb.UHtrTnk_tiSCBUDRat_C DDRC_RatDeb.Exh_tiSRCNOxNoCat2DsUDRat_C DDRC_RatDeb.PFlt_tiDstrMinUDRat_C DDRC_RatDeb.AFS_tiOffsDrftMaxUDRat_C DDRC_RatDeb.PFlt_tiSRCMinFlwRstnUDRat_C DDRC_RatDeb.Exh_tiSRCMinTTrbnUsUDRat_C DDRC_RatDeb.EGRVlvLP_tiSCGUDRat_C DDRC_RatDeb.AirC_tiSwtNplUDRat_C DDRC_RatDeb.EGRVlv_tiHBrgShCirBatt1UDRat_C DDRC_RatDeb.SCR_tiSRCMaxUPmpPUDRat_C DDRC_RatDeb.URevVlv_tiSCBUDRat_C DDRC_RatDeb.Exh_tiSigNSCDsUDRat_C DDRC_RatDeb.EGRVlvLP_tiHBrgUndrVltgUDRat_C DDRC_RatDeb.PFlt_tiEngPrtMaxUDRat_C DDRC_RatDeb.Exh_tiSigNoCat2DsUDRat_C DDRC_RatDeb.FlFltUsP_tiMaxUDRat_C DDRC_RatDeb.VSwVlv_tiHBrgShCirOvrLdUDRat_C DDRC_RatDeb.SCR_tiSRCMaxUTnkTUDRat_C DDRC_RatDeb.GbxNPos_tiSRCPerMinUDRat_C DDRC_RatDeb.EGRVlvLP_tiGovDvtMaxUDRat_C DDRC_RatDeb.Exh_tiSRCLamBinNoCat2DsUDRat_C DDRC_RatDeb.AFS_tiRawSRCMaxUDRat_C DDRC_RatDeb.UHtrPL_tiSCGUDRat_C DDRC_RatDeb.UHtrPL_tiSCBUDRat_C DDRC_RatDeb.VSwVlv_tiHBrgShCirGnd2UDRat_C DDRC_RatDeb.URevVlv_tiSCGUDRat_C DDRC_RatDeb.Exh_tiSRCNOxNSCDsUDRat_C DDRC_RatDeb.BattU_tiMaxUDRat_C DDRC_RatDeb.Air_tiMinTCACDsUDRat_C DDRC_RatDeb.EGRVlv_tiSCBUDRat_C DDRC_RatDeb.FuelT_tiMinUDRat_C DDRC_RatDeb.Oil_tiSRCMaxPSwmpUDRat_C DDRC_RatDeb.EGRVlv_tiHBrgShCirGnd2UDRat_C DDRC_RatDeb.Exh_tiNplTTrbnUsUDRat_C DDRC_RatDeb.EGRVlvLP_tiHBrgShCirBatt2UDRat_C DDRC_RatDeb.Air_tiMaxTCACDsUDRat_C DDRC_RatDeb.TrbChLP_tiSCGUDRat_C DDRC_RatDeb.LSU_tiO2MaxUDRat_C DDRC_RatDeb.Exh_tiNplTPFltUsUDRat_C DDRC_RatDeb.LSU_tiOpnLdUDRat_C DDRC_RatDeb.EGRVlvLP_tiSRCMinUDRat_C DDRC_RatDeb.TECU_tiOvrTempUDRat_C DDRC_RatDeb.AFS_tiSetyDrftMinUDRat_C DDRC_RatDeb.VSwVlv_tiGovDvtMinUDRat_C DDRC_RatDeb.CEngDsT_tiMinUDRat_C DDRC_RatDeb.SCR_tiSRCMinUPmpPUDRat_C DDRC_RatDeb.EGRVlvLP_tiHBrgOvrCurrUDRat_C DDRC_RatDeb.ThrVlv_tiSRCMaxUDRat_C DDRC_RatDeb.EnvP_tiMinUDRat_C DDRC_RatDeb.LSU_tiShCirUDRat_C DDRC_RatDeb.EGRVlv_tiHBrgShCirBatt2UDRat_C DDRC_RatDeb.AFS_tiSetyDrftMaxUDRat_C DDRC_RatDeb.VSwVlv_tiHBrgOvrTempUDRat_C DDRC_RatDeb.Exh_tiSRCMaxTPFltUsUDRat_C DDRC_RatDeb.EGRVlvLP_tiSRCMaxUDRat_C DDRC_RatDeb.EGRVlv_tiHBrgOvrCurrUDRat_C DDRC_RatDeb.EGRVlv_tiOLUDRat_C DDRC_RatDeb.AFS_tiOffsDrftMinUDRat_C DDRC_RatDeb.UHtrTnk_tiSRCMaxDiaUDRat_C DDRC_RatDeb.PFlt_tiCharPDiffMinUDRat_C DDRC_RatDeb.Exh_tiHsLnPPFltDiffUDRat_C DDRC_RatDeb.Exh_tiExhTMon1PlausUDRat_C DDRC_RatDeb.TrbChLP_tiOLUDRat_C DDRC_RatDeb.UHtrTnk_tiOLUDRat_C DDRC_RatDeb.Exh_tiSRCMinTPFltUsUDRat_C DDRC_RatDeb.EGRVlv_tiGovDvtMinUDRat_C DDRC_RatDeb.LSU_tiSPIBattLowMinUDRat_C DDRC_RatDeb.VSwVlv_tiHBrgOpnLdUDRat_C DDRC_RatDeb.VSwVlv_tiOLUDRat_C DDRC_RatDeb.Exh_tiSRCMaxTTrbnUsUDRat_C DDRC_RatDeb.UHtrPL_tiSRCMaxDiaUDRat_C DDRC_RatDeb.EGRVlvLP_tiOLUDRat_C DDRC_RatDeb.Air_tiSRCMinPIntkVUsUDRat_C DDRC_RatDeb.EGRVlvLP_tiHBrgShCirGnd1UDRat_C DDRC_RatDeb.TECU_tiSRCMinUDRat_C DDRC_RatDeb.PFlt_tiSotMsMaxUDRat_C DDRC_RatDeb.VSwVlv_tiHBrgUndrVltgUDRat_C DDRC_RatDeb.Exh_tiSRCMaxPPFltUsUDRat_C DDRC_RatDeb.Exh_tiEMaxPPFltDiffUDRat_C DDRC_RatDeb.EngSpd_tiSCGUDRat_C DDRC_RatDeb.APP_PlaAPP12UDRat_C DDRC_RatDeb.APP_tiSRCLowUDRat_C DDRC_RatDeb.EGRVlv_tiSRCMaxUDRat_C DDRC_RatDeb.EGRVlv_tiHBrgOpnLdUDRat_C DDRC_RatDeb.VSwVlv_tiSRCMinUDRat_C DDRC_RatDeb.Exh_tiEMinPPFltDiffUDRat_C DDRC_RatDeb.SCR_tiSigUPmpPUDRat_C DDRC_RatDeb.Air_tiPerHiTAFSUDRat_C DDRC_RatDeb.EGRVlvLP_tiHBrgTempOvrCurrUDRat_C DDRC_RatDeb.APP_tiSRCHighUDRat_C DDRC_RatDeb.Air_tiSRCMaxPIntkVUsUDRat_C DDRC_RatDeb.Exh_tiSRCMinPPFltUsUDRat_C DDRC_RatDeb.Exh_tiPlausExhTMonUDRat_C DDRC_RatDeb.Exh_tiLamPlausMaxNoCat2DsUDRat_C DDRC_RatDeb.PFlt_tiNplHsChngPPFltDiffUDRat_C DDRC_RatDeb.EGRVlvLP_tiGovDvtMinUDRat_C DDRC_RatDeb.PFlt_tiSRCMaxFlwRstnUDRat_C DDRC_RatDeb.PFlt_tiRgnPermMaxUDRat_C DDRC_RatDeb.SCR_tiSigUCatUsTUDRat_C DDRC_RatDeb.Exh_tiMaxExhTMonUDRat_C DDRC_RatDeb.URevVlv_tiOLUDRat_C DDRC_RatDeb.GbxNPos_tiSRCPerMaxUDRat_C DDRC_RatDeb.LSU_tiCircPmpCurSigUDRat_C DDRC_RatDeb.VSwVlv_tiSRCMaxUDRat_C DDRC_RatDeb.Exh_tiSRCLamBinNSCDsUDRat_C DDRC_RatDeb.VSwVlv_tiSCBUDRat_C DDRC_RatDeb.EGRVlvLP_tiSCBUDRat_C DDRC_RatDeb.EngSpd_tiSCBUDRat_C DDRC_RatDeb.Exh_tiMinExhTMonUDRat_C DDRC_RatDeb.EGRVlvLP_tiHBrgShCirGnd2UDRat_C DDRC_RatDeb.BattU_tiMinUDRat_C DDRC_RatDeb.VSwVlv_tiSCGUDRat_C DDRC_RatDeb.PCV_tiSCGUDRat_C DDRC_RatDeb.Exh_tiSRCMaxPPFltDiffUDRat_C DDRC_RatDeb.Exh_tiPlausExhTMon3UDRat_C DDRC_RatDeb.EnvP_tiMaxUDRat_C DDRC_RatDeb.Air_tiDtyCycHiTAFSUDRat_C DDRC_RatDeb.EGRVlvLP_tiHBrgShCirBatt1UDRat_C DDRC_RatDeb.Exh_tiExhTMon2PlausUDRat_C DDRC_RatDeb.Exh_tiSRCLamLinNoCat2DsUDRat_C DDRC_RatDeb.Exh_tiSRCMinTOxiCatUsUDRat_C DDRC_RatDeb.EGRVlvLP_tiHBrgOvrTempUDRat_C DDRC_RatDeb.UHtrTnk_tiSRCMinDiaUDRat_C DDRC_RatDeb.UHtrPL_tiOLUDRat_C DDRC_RatDeb.EGRVlv_tiHBrgUndrVltgUDRat_C DDRC_RatDeb.PFlt_tiSotMsDvtMaxUDRat_C DDRC_RatDeb.Exh_tiSRCMaxTOxiCatUsUDRat_C DDRC_RatDeb.VSwVlv_tiGovDvtMaxUDRat_C DDRC_RatDeb.FlFltDsP_tiMaxUDRat_C DDRC_RatDeb.Brk_tiPlaUDRat_C DDRC_RatDeb.GbxNPos_tiSRCdcycMinUDRat_C DDRC_RatDeb.Oil_tiSRCMinPSwmpUDRat_C DDRC_RatDeb.TrbChLP_tiSCBUDRat_C DDRC_RatDeb.Exh_tiSRCMinPPFltDiffUDRat_C DDRC_RatDeb.PFlt_tiSotMsDvtMinUDRat_C DDRC_RatDeb.EGRVlvLP_tiHBrgOpnLdUDRat_C DDRC_RatDeb.Exh_tiCmpChkNSCDsUDRat_C DDRC_RatDeb.EGRVlv_tiHBrgOvrTempUDRat_C DDRC_RatDeb.EGRVlv_tiGovDvtMaxUDRat_C DDRC_RatDeb.Exh_tiPlausExhTMon2UDRat_C DDRC_RatDeb.VSwVlv_tiHBrgShCirBatt2UDRat_C DDRC_RatDeb.SCR_tiSRCMaxUCatUsTUDRat_C DDRC_RatDeb.AFS_tiRawSRCMinUDRat_C DDRC_RatDeb.LSU_tiO2MinUDRat_C DDRC_RatDeb.ThrVlv_tiSRCMinUDRat_C DDRC_RatDeb.VSwVlv_tiHBrgTempOvrCurrUDRat_C DDRC_RatDeb.Exh_tiNplTOxiUsUDRat_C DDRC_RatDeb.EGRVlv_tiSRCMinUDRat_C DDRC_RatDeb.ECBVlv_tiSRCMinUDRat_C DDRC_RatDeb.EGRVlv_tiHBrgShCirGnd1UDRat_C DDRC_RatDeb.Air_tiPerLoTAFSUDRat_C DDRC_RatDeb.EngSpd_tiOLUDRat_C DDRC_RatDeb.BrkP_tiMaxUDRat_C DDRC_RatDeb.AFS_tiCorSRCMinUDRat_C DDRC_RatDeb.VSwVlv_tiHBrgOvrCurrUDRat_C DDRC_RatDeb.AirC_tiSwtSigUDRat_C DDRC_RatDeb.VSwVlv_tiHBrgShCirBatt1UDRat_C DDRC_RatDeb.SCR_tiSigUTnkTUDRat_C DDRC_RatDeb.GbxNPos_tiSRCdcycMaxUDRat_C DDRC_RatDeb.Exh_tiMaxNoCat2DsUDRat_C DDRC_RatDeb.EngTrqPtd_ctMonLimLeadUDRat_C DDRC_RatDeb.Layer_numFltMngTstUDRat_C DDRC_RatDeb.Layer_numGENREGUPLUDRat_C DDRC_RatDeb.Layer_numGENUPLUDRat_C DDRC_RatDeb.IVDia_numCylNoLdUDRat_C DDRC_RatDeb.LSU_numRiClbMinUDRat_C DDRC_RatDeb.Exh_numNOxOfsNoCat2DsUDRat_C DDRC_RatDeb.Layer_numGENKOMMUDRat_C DDRC_RatDeb.PCV_numNoStrtUDRat_C DDRC_RatDeb.ETClb_numETMaxUDRat_C DDRC_RatDeb.RailP_numdpDebUDRat_C DDRC_RatDeb.LSU_numRiClbMaxUDRat_C DDRC_RatDeb.IVCtl_numUDiffUpOBDUDRat_C DDRC_RatDeb.Layer_numNGLERNUDRat_C DDRC_RatDeb.Layer_numMANDETEKUDRat_C DDRC_RatDeb.Exh_numNOxR2LMinNSCDsUDRat_C DDRC_RatDeb.Layer_numBSDUDRat_C DDRC_RatDeb.IVActr_numEnrgMinUDRat_C DDRC_RatDeb.LSU_numO2ClbMinUDRat_C DDRC_RatDeb.IVDia_numCylShCirUDRat_C DDRC_RatDeb.IVDia_numBnkShCirUDRat_C DDRC_RatDeb.IVCtl_numTiDiffOBDUDRat_C DDRC_RatDeb.LSU_numO2PlausMaxPartLdUDRat_C DDRC_RatDeb.IVDia_numCylNoClsUDRat_C DDRC_RatDeb.Layer_numGENELBUDRat_C DDRC_RatDeb.LSU_numO2PlausMaxOvrRunUDRat_C DDRC_RatDeb.SCRPOD_numPresBuildUpErrUDRat_C DDRC_RatDeb.Layer_numPMRUHVERLUDRat_C DDRC_RatDeb.Layer_numQLTUDRat_C DDRC_RatDeb.Layer_numPMBNUDRat_C DDRC_RatDeb.Layer_numGENUDRat_C DDRC_RatDeb.IVDia_numBnkShCirChSwtUDRat_C DDRC_RatDeb.Layer_numIBS3UDRat_C DDRC_RatDeb.IVDia_numCylShCirMeasUDRat_C DDRC_RatDeb.Layer_numGENHTBUDRat_C DDRC_RatDeb.EngTrqPtd_ctMonLimCurrUDRat_C DDRC_RatDeb.Layer_numIBS2UDRat_C DDRC_RatDeb.LSU_numO2ClbMaxUDRat_C DDRC_RatDeb.IVActr_numEnrgNplUDRat_C DDRC_RatDeb.LSU_numO2PlausMinPartLdUDRat_C DDRC_RatDeb.Layer_numGENMECHUDRat_C DDRC_RatDeb.Layer_numGENHTUDRat_C DDRC_RatDeb.Layer_numIBS1UDRat_C DDRC_RatDeb.Exh_numNOxR2LMinNoCat2DsUDRat_C DDRC_RatDeb.LSU_numO2PlausMinFLdUDRat_C DDRC_RatDeb.Layer_numTOENSUDRat_C DDRC_RatDeb.IVActr_numEnrgMaxUDRat_C DDRC_RatDeb.ETClb_numETMinUDRat_C DDRC_RatDeb.Clth_numPlaUDRat_C DDRC_RatDeb.Exh_numNOxOfsNSCDsUDRat_C DDRC_RatDeb.Layer_numNDR1UDRat_C DDRC_RatDeb.Layer_numPMBATTUDRat_C DDRC_RatDeb.LSU_numDynChkMinUDRat_C DDRC_RatDeb.LSU_numO2PlausMaxFLdUDRat_C DDRC_RatDeb.IVCtl_numUUpOBDUDRat_C DDRC_RatDeb.Layer_numNDR2UDRat_C DDRC_RatDeb.LSU_numWireIPSigUDRat_C DDRC_RatDeb.IVDia_numCylShCirHSLSUDRat_C DDRC_RatDeb.Layer_numGENELUDRat_C DDRC_RatDeb.EngTrqPtd_ctMonLimSetUDRat_C DDRC_RatDeb.LSU_numO2PlausMinOvrRunUDRat_C DDRC_RatDeb.IVDia_numChpUDRat_C /end DEF_CHARACTERISTIC
/end FUNCTION
/begin FUNCTION DevLib_4WinDia "" /end FUNCTION
/begin FUNCTION DevLib_ActrPrt "" /begin DEF_CHARACTERISTIC DevLib_nActrRls_C DevLib_tiActrPrt_C /end DEF_CHARACTERISTIC /begin IN_MEASUREMENT CoEng_st Epm_nEng GlwCtl_stGlw /end IN_MEASUREMENT /begin OUT_MEASUREMENT DevLib_stMonActrPrt /end OUT_MEASUREMENT /end FUNCTION
/begin FUNCTION DevLib_DiaCtlLine "" /end FUNCTION
/begin FUNCTION DevLib_DigOut "" /end FUNCTION
/begin FUNCTION DevLib_DigOutErrHndlr "" /end FUNCTION
/begin FUNCTION DevLib_HBrg "" /end FUNCTION
/begin FUNCTION DevLib_MacroDef "" /end FUNCTION
/begin FUNCTION DevLib_PhysRngChk "" /end FUNCTION
/begin FUNCTION DevLib_PwmOut "" /end FUNCTION
/begin FUNCTION DevLib_PWMOutErrHndlr "" /end FUNCTION
/begin FUNCTION DevLib_PwrStgState ""
 /begin DEF_CHARACTERISTIC Devlib_PsDisbl.facLowHysLo_C Devlib_PsDisbl.facLowHysHi_C Devlib_PsDisbl.facHighHysLo_C Devlib_PsDisbl.facHighHysHi_C Devlib_PwrStg.BattLoHysLo_C Devlib_PwrStg.BattLoHysHi_C Devlib_PwrStg.BattHiHysLo_C Devlib_PwrStg.BattHiHysHi_C DevLib_tiDlyT15_C /end DEF_CHARACTERISTIC
 /begin IN_MEASUREMENT BattU_facCor BattU_u SyC_stSub /end IN_MEASUREMENT
 /begin OUT_MEASUREMENT DevLib_stPwrStgEnaCond /end OUT_MEASUREMENT
/end FUNCTION
/begin FUNCTION DevLib_SRC "" /end FUNCTION
/begin FUNCTION DevLib_TransStage "" /end FUNCTION
/begin COMPU_METHOD DDRCTime_ms "" RAT_FUNC "%5.0" "ms" COEFFS 0 1 0 0 0 10 /end COMPU_METHOD
/begin COMPU_METHOD DDRC_Ratio "" TAB_VERB "%6.3" "-" COMPU_TAB_REF DDRC_Ratio /end COMPU_METHOD
/begin COMPU_VTAB DDRC_Ratio "" TAB_VERB 4 1 "Ratio1" 2 "Ratio2" 3 "Ratio3" 4 "Ratio4" /end COMPU_VTAB
/begin COMPU_METHOD EngN "" RAT_FUNC "%5.1" "rpm" COEFFS 0 2 0 0 0 1 /end COMPU_METHOD
/begin COMPU_METHOD Fact "" RAT_FUNC "%6.5" "-" COEFFS 0 8192 0 0 0 1 /end COMPU_METHOD
/begin COMPU_METHOD OneToOne "" RAT_FUNC "%6.0" "-" COEFFS 0 1 0 0 0 1 /end COMPU_METHOD
/begin COMPU_METHOD Time_ms "" RAT_FUNC "%5.0" "ms" COEFFS 0 0.1 0 0 0 1 /end COMPU_METHOD
/begin COMPU_METHOD Volt_Batt "" RAT_FUNC "%5.0" "mV" COEFFS 0 0.05 0 0 0 1 /end COMPU_METHOD
/begin RECORD_LAYOUT Kw_Ws16 FNC_VALUES 1 SWORD COLUMN_DIR DIRECT /end RECORD_LAYOUT
/begin RECORD_LAYOUT Kw_Wu16 FNC_VALUES 1 UWORD COLUMN_DIR DIRECT /end RECORD_LAYOUT
/begin RECORD_LAYOUT Val_Ws16 FNC_VALUES 1 SWORD COLUMN_DIR DIRECT /end RECORD_LAYOUT
/begin RECORD_LAYOUT Val_Wu16 FNC_VALUES 1 UWORD COLUMN_DIR DIRECT /end RECORD_LAYOUT
/begin RECORD_LAYOUT Val_Wu8 FNC_VALUES 1 UBYTE COLUMN_DIR DIRECT /end RECORD_LAYOUT
/end MODULE
/end PROJECT

ASAP2_VERSION 1 4
/begin PROJECT P_574 "EDC17_CP09"
/begin HEADER "" VERSION "V8KB" PROJECT_NO P_574 /end HEADER
/begin MODULE DIM ""
/begin MOD_COMMON "" BYTE_ORDER MSB_LAST ALIGNMENT_BYTE 1 ALIGNMENT_WORD 2 ALIGNMENT_LONG 4 ALIGNMENT_FLOAT32_IEEE 4 /end MOD_COMMON
/begin CHARACTERISTIC DFES_Cls.DFC_GlwEcuGk2SC_C "DFES/Fehlerklasse für Prüfung DFC_GlwEcuGk2SC" VALUE 0x80023534 Val_Wu8 29.00 DFES_OneToOne 0.00 29.00 EXTENDED_LIMITS 0.00 255.0 /end CHARACTERISTIC
/begin CHARACTERISTIC DFES_Cls.DFC_GlwEcuGk2Wdst_C "DFES/Fehlerklasse für Prüfung DFC_GlwEcuGk2Wdst" VALUE 0x80023535 Val_Wu8 29.00 DFES_OneToOne 0.00 29.00 EXTENDED_LIMITS 0.00 255.0 /end CHARACTERISTIC
/begin CHARACTERISTIC DFES_Cls.DFC_GlwEcuGk3HSS_C "DFES/Fehlerklasse für Prüfung DFC_GlwEcuGk3HSS" VALUE 0x80023536 Val_Wu8 29.00 DFES_OneToOne 0.00 29.00 EXTENDED_LIMITS 0.00 255.0 /end CHARACTERISTIC
/begin CHARACTERISTIC DFES_Cls.DFC_GlwEcuGk3OL_C "DFES/Fehlerklasse für Prüfung DFC_GlwEcuGk3OL" VALUE 0x80023537 Val_Wu8 29.00 DFES_OneToOne 0.00 29.00 EXTENDED_LIMITS 0.00 255.0 /end CHARACTERISTIC
/begin CHARACTERISTIC DFES_Cls.DFC_GlwEcuGk3SC_C "DFES/Fehlerklasse für Prüfung DFC_GlwEcuGk3SC" VALUE 0x80023538 Val_Wu8 29.00 DFES_OneToOne 0.00 29.00 EXTENDED_LIMITS 0.00 255.0 /end CHARACTERISTIC
/begin CHARACTERISTIC DFES_Cls.DFC_GlwEcuGk3Wdst_C "DFES/Fehlerklasse für Prüfung DFC_GlwEcuGk3Wdst" VALUE 0x80023539 Val_Wu8 29.00 DFES_OneToOne 0.00 29.00 EXTENDED_LIMITS 0.00 255.0 /end CHARACTERISTIC
/begin CHARACTERISTIC DFES_Cls.DFC_GlwEcuGk4HSS_C "DFES/Fehlerklasse für Prüfung DFC_GlwEcuGk4HSS" VALUE 0x8002353A Val_Wu8 29.00 DFES_OneToOne 0.00 29.00 EXTENDED_LIMITS 0.00 255.0 /end CHARACTERISTIC
/begin CHARACTERISTIC DFES_Cls.DFC_GlwEcuGk4OL_C "DFES/Fehlerklasse für Prüfung DFC_GlwEcuGk4OL" VALUE 0x8002353B Val_Wu8 29.00 DFES_OneToOne 0.00 29.00 EXTENDED_LIMITS 0.00 255.0 /end CHARACTERISTIC
/begin CHARACTERISTIC DFES_Cls.DFC_GlwEcuGk4SC_C "DFES/Fehlerklasse für Prüfung DFC_GlwEcuGk4SC" VALUE 0x8002353C Val_Wu8 29.00 DFES_OneToOne 0.00 29.00 EXTENDED_LIMITS 0.00 255.0 /end CHARACTERISTIC
/begin CHARACTERISTIC DFES_Cls.DFC_GlwEcuGk4Wdst_C "DFES/Fehlerklasse für Prüfung DFC_GlwEcuGk4Wdst" VALUE 0x8002353D Val_Wu8 29.00 DFES_OneToOne 0.00 29.00 EXTENDED_LIMITS 0.00 255.0 /end CHARACTERISTIC
/begin CHARACTERISTIC DFES_Cls.DFC_GlwEcuGk5HSS_C "DFES/Fehlerklasse für Prüfung DFC_GlwEcuGk5HSS" VALUE 0x8002353E Val_Wu8 29.00 DFES_OneToOne 0.00 29.00 EXTENDED_LIMITS 0.00 255.0 /end CHARACTERISTIC
/begin CHARACTERISTIC DFES_Cls.DFC_GlwEcuGk5OL_C "DFES/Fehlerklasse für Prüfung DFC_GlwEcuGk5OL" VALUE 0x8002353F Val_Wu8 29.00 DFES_OneToOne 0.00 29.00 EXTENDED_LIMITS 0.00 255.0 /end CHARACTERISTIC
/begin CHARACTERISTIC DFES_Cls.DFC_GlwEcuGk5SC_C "DFES/Fehlerklasse für Prüfung DFC_GlwEcuGk5SC" VALUE 0x80023540 Val_Wu8 29.00 DFES_OneToOne 0.00 29.00 EXTENDED_LIMITS 0.00 255.0 /end CHARACTERISTIC
/begin CHARACTERISTIC DFES_Cls.DFC_GlwEcuGk5Wdst_C "DFES/Fehlerklasse für Prüfung DFC_GlwEcuGk5Wdst" VALUE 0x80023541 Val_Wu8 29.00 DFES_OneToOne 0.00 29.00 EXTENDED_LIMITS 0.00 255.0 /end CHARACTERISTIC
/begin CHARACTERISTIC DFES_Cls.DFC_GlwEcuGk6HSS_C "DFES/Fehlerklasse für Prüfung DFC_GlwEcuGk6HSS" VALUE 0x80023542 Val_Wu8 29.00 DFES_OneToOne 0.00 29.00 EXTENDED_LIMITS 0.00 255.0 /end CHARACTERISTIC
/begin CHARACTERISTIC DFES_Cls.DFC_GlwEcuGk6OL_C "DFES/Fehlerklasse für Prüfung DFC_GlwEcuGk6OL" VALUE 0x80023543 Val_Wu8 29.00 DFES_OneToOne 0.00 29.00 EXTENDED_LIMITS 0.00 255.0 /end CHARACTERISTIC
/begin CHARACTERISTIC DFES_Cls.DFC_GlwEcuGk6SC_C "DFES/Fehlerklasse für Prüfung DFC_GlwEcuGk6SC" VALUE 0x80023544 Val_Wu8 29.00 DFES_OneToOne 0.00 29.00 EXTENDED_LIMITS 0.00 255.0 /end CHARACTERISTIC
/begin CHARACTERISTIC DFES_Cls.DFC_GlwEcuGk6Wdst_C "DFES/Fehlerklasse für Prüfung DFC_GlwEcuGk6Wdst" VALUE 0x80023545 Val_Wu8 29.00 DFES_OneToOne 0.00 29.00 EXTENDED_LIMITS 0.00 255.0 /end CHARACTERISTIC
/begin CHARACTERISTIC DFES_Cls.DFC_GlwEcuGndErr_C "DFES/Fehlerklasse für Prüfung DFC_GlwEcuGndErr" VALUE 0x80023546 Val_Wu8 29.00 DFES_OneToOne 0.00 29.00 EXTENDED_LIMITS 0.00 255.0 /end CHARACTERISTIC
/begin CHARACTERISTIC DFES_Cls.DFC_GlwEcuIntErr_C "DFES/Fehlerklasse für Prüfung DFC_GlwEcuIntErr" VALUE 0x80023547 Val_Wu8 29.00 DFES_OneToOne 0.00 29.00 EXTENDED_LIMITS 0.00 255.0 /end CHARACTERISTIC
/begin CHARACTERISTIC DFES_Cls.DFC_GlwEcuMsgTimeout_C "DFES/Fehlerklasse für Prüfung DFC_GlwEcuMsgTimeout" VALUE 0x80023548 Val_Wu8 29.00 DFES_OneToOne 0.00 29.00 EXTENDED_LIMITS 0.00 255.0 /end CHARACTERISTIC
/begin CHARACTERISTIC DFES_Cls.DFC_GlwEcuT30Err_C "DFES/Fehlerklasse für Prüfung DFC_GlwEcuT30Err" VALUE 0x80023549 Val_Wu8 29.00 DFES_OneToOne 0.00 29.00 EXTENDED_LIMITS 0.00 255.0 /end CHARACTERISTIC
/begin CHARACTERISTIC DFES_Cls.DFC_GlwEcuTempErr_C "DFES/Fehlerklasse für Prüfung DFC_GlwEcuTempErr" VALUE 0x8002354A Val_Wu8 29.00 DFES_OneToOne 0.00 29.00 EXTENDED_LIMITS 0.00 255.0 /end CHARACTERISTIC
/begin CHARACTERISTIC DFES_Cls.DFC_GlwEcuUdiffT30_C "DFES/Fehlerklasse für Prüfung DFC_GlwEcuUdiffT30" VALUE 0x8002354B Val_Wu8 29.00 DFES_OneToOne 0.00 29.00 EXTENDED_LIMITS 0.00 255.0 /end CHARACTERISTIC
/begin CHARACTERISTIC DFES_Cls.DFC_IBSComErr_C "DFES/Fehlerklasse für Prüfung DFC_IBSComErr" VALUE 0x8002354C Val_Wu8 29.00 DFES_OneToOne 0.00 29.00 EXTENDED_LIMITS 0.00 255.0 /end CHARACTERISTIC
/begin CHARACTERISTIC DFES_Cls.DFC_LubSRCOilFldtCrit_C "DFES/Fehlerklasse für Prüfung DFC_LubSRCOilFldtCrit" VALUE 0x8002354D Val_Wu8 29.00 DFES_OneToOne 0.00 29.00 EXTENDED_LIMITS 0.00 255.0 /end CHARACTERISTIC
/begin CHARACTERISTIC DFES_Cls.DFC_LubSRCOilFldtCritDflMin_C "DFES/Fehlerklasse für Prüfung DFC_LubSRCOilFldtCritDflMin" VALUE 0x8002354E Val_Wu8 29.00 DFES_OneToOne 0.00 29.00 EXTENDED_LIMITS 0.00 255.0 /end CHARACTERISTIC
/begin CHARACTERISTIC DFES_Cls.DFC_LubSRCOilLvlCritMax_C "DFES/Fehlerklasse für Prüfung DFC_LubSRCOilLvlCritMax" VALUE 0x8002354F Val_Wu8 29.00 DFES_OneToOne 0.00 29.00 EXTENDED_LIMITS 0.00 255.0 /end CHARACTERISTIC
/begin CHARACTERISTIC DFES_Cls.DFC_LubSRCOilLvlCritMin_C "DFES/Fehlerklasse für Prüfung DFC_LubSRCOilLvlCritMin" VALUE 0x80023550 Val_Wu8 29.00 DFES_OneToOne 0.00 29.00 EXTENDED_LIMITS 0.00 255.0 /end CHARACTERISTIC
/begin CHARACTERISTIC DFES_Cls.DFC_LubSRCTot_C "DFES/Fehlerklasse für Prüfung DFC_LubSRCTot" VALUE 0x80023551 Val_Wu8 29.00 DFES_OneToOne 0.00 29.00 EXTENDED_LIMITS 0.00 255.0 /end CHARACTERISTIC
/begin CHARACTERISTIC DFES_Cls.DFC_MonUMaxSupply1_C "DFES/Fehlerklasse für Prüfung DFC_MonUMaxSupply1" VALUE 0x80023552 Val_Wu8 29.00 DFES_OneToOne 0.00 29.00 EXTENDED_LIMITS 0.00 255.0 /end CHARACTERISTIC
/begin CHARACTERISTIC DFES_Cls.DFC_MonUMinSupply1_C "DFES/Fehlerklasse für Prüfung DFC_MonUMinSupply1" VALUE 0x80023553 Val_Wu8 29.00 DFES_OneToOne 0.00 29.00 EXTENDED_LIMITS 0.00 255.0 /end CHARACTERISTIC
/begin CHARACTERISTIC DFES_Cls.DFC_OilComNpl_C "DFES/Fehlerklasse für Prüfung DFC_OilComNpl" VALUE 0x80023554 Val_Wu8 29.00 DFES_OneToOne 0.00 29.00 EXTENDED_LIMITS 0.00 255.0 /end CHARACTERISTIC
/begin CHARACTERISTIC DFES_Cls.DFC_PCBS_C "DFES/Fehlerklasse für Prüfung DFC_PCBS" VALUE 0x80023555 Val_Wu8 29.00 DFES_OneToOne 0.00 29.00 EXTENDED_LIMITS 0.00 255.0 /end CHARACTERISTIC
/begin CHARACTERISTIC DFES_Cls.DFC_PCBSPFltChg_C "DFES/Fehlerklasse für Prüfung DFC_PCBSPFltChg" VALUE 0x80023556 Val_Wu8 29.00 DFES_OneToOne 0.00 29.00 EXTENDED_LIMITS 0.00 255.0 /end CHARACTERISTIC
/begin CHARACTERISTIC DFES_Cls.DFC_PCRGovDvtLPMax_C "DFES/Fehlerklasse für Prüfung DFC_PCRGovDvtLPMax" VALUE 0x80023557 Val_Wu8 29.00 DFES_OneToOne 0.00 29.00 EXTENDED_LIMITS 0.00 255.0 /end CHARACTERISTIC
/begin CHARACTERISTIC DFES_Cls.DFC_PCRGovDvtLPMin_C "DFES/Fehlerklasse für Prüfung DFC_PCRGovDvtLPMin" VALUE 0x80023558 Val_Wu8 29.00 DFES_OneToOne 0.00 29.00 EXTENDED_LIMITS 0.00 255.0 /end CHARACTERISTIC
/begin CHARACTERISTIC DFES_Cls.DFC_PCRGovDvtMax_C "DFES/Fehlerklasse für Prüfung DFC_PCRGovDvtMax" VALUE 0x80023559 Val_Wu8 29.00 DFES_OneToOne 0.00 29.00 EXTENDED_LIMITS 0.00 255.0 /end CHARACTERISTIC
/begin CHARACTERISTIC DFES_Cls.DFC_PCRGovDvtMin_C "DFES/Fehlerklasse für Prüfung DFC_PCRGovDvtMin" VALUE 0x8002355A Val_Wu8 29.00 DFES_OneToOne 0.00 29.00 EXTENDED_LIMITS 0.00 255.0 /end CHARACTERISTIC
/begin CHARACTERISTIC DFES_Cls.DFC_PFltAPSPlausMAX_C "DFES/Fehlerklasse für Prüfung DFC_PFltAPSPlausMAX" VALUE 0x8002355B Val_Wu8 29.00 DFES_OneToOne 0.00 29.00 EXTENDED_LIMITS 0.00 255.0 /end CHARACTERISTIC
/begin CHARACTERISTIC DFES_Cls.DFC_PFltAPSPlausMIN_C "DFES/Fehlerklasse für Prüfung DFC_PFltAPSPlausMIN" VALUE 0x8002355C Val_Wu8 29.00 DFES_OneToOne 0.00 29.00 EXTENDED_LIMITS 0.00 255.0 /end CHARACTERISTIC
/begin CHARACTERISTIC DFES_Cls.DFC_PFltBPSPlausMAX_C "DFES/Fehlerklasse für Prüfung DFC_PFltBPSPlausMAX" VALUE 0x8002355D Val_Wu8 29.00 DFES_OneToOne 0.00 29.00 EXTENDED_LIMITS 0.00 255.0 /end CHARACTERISTIC
/begin CHARACTERISTIC DFES_Cls.DFC_PFltBPSPlausMIN_C "DFES/Fehlerklasse für Prüfung DFC_PFltBPSPlausMIN" VALUE 0x8002355E Val_Wu8 29.00 DFES_OneToOne 0.00 29.00 EXTENDED_LIMITS 0.00 255.0 /end CHARACTERISTIC
/begin CHARACTERISTIC DFES_Cls.DFC_PFltOvldInhRgn_C "DFES/Fehlerklasse für Prüfung DFC_PFltOvldInhRgn" VALUE 0x8002355F Val_Wu8 29.00 DFES_OneToOne 0.00 29.00 EXTENDED_LIMITS 0.00 255.0 /end CHARACTERISTIC
/begin CHARACTERISTIC DFES_Cls.DFC_PFltOvldTrqLim_C "DFES/Fehlerklasse für Prüfung DFC_PFltOvldTrqLim" VALUE 0x80023560 Val_Wu8 29.00 DFES_OneToOne 0.00 29.00 EXTENDED_LIMITS 0.00 255.0 /end CHARACTERISTIC
/begin CHARACTERISTIC DFES_Cls.DFC_PFltPresPlausMAX_C "DFES/Fehlerklasse für Prüfung DFC_PFltPresPlausMAX" VALUE 0x80023561 Val_Wu8 29.00 DFES_OneToOne 0.00 29.00 EXTENDED_LIMITS 0.00 255.0 /end CHARACTERISTIC
/begin CHARACTERISTIC DFES_Cls.DFC_PFltPresPlausMIN_C "DFES/Fehlerklasse für Prüfung DFC_PFltPresPlausMIN" VALUE 0x80023562 Val_Wu8 29.00 DFES_OneToOne 0.00 29.00 EXTENDED_LIMITS 0.00 255.0 /end CHARACTERISTIC
/begin CHARACTERISTIC DFES_Cls.DFC_PFltTraRpmRdc_C "DFES/Fehlerklasse für Prüfung DFC_PFltTraRpmRdc" VALUE 0x80023563 Val_Wu8 29.00 DFES_OneToOne 0.00 29.00 EXTENDED_LIMITS 0.00 255.0 /end CHARACTERISTIC
/begin CHARACTERISTIC DFES_Cls.DFC_PFlt_tOxiPreMax_C "DFES/Fehlerklasse für Prüfung DFC_PFlt_tOxiPreMax" VALUE 0x80023564 Val_Wu8 29.00 DFES_OneToOne 0.00 29.00 EXTENDED_LIMITS 0.00 255.0 /end CHARACTERISTIC
/begin CHARACTERISTIC DFES_Cls.DFC_PFlt_tOxiPreMaxRgn_C "DFES/Fehlerklasse für Prüfung DFC_PFlt_tOxiPreMaxRgn" VALUE 0x80023565 Val_Wu8 29.00 DFES_OneToOne 0.00 29.00 EXTENDED_LIMITS 0.00 255.0 /end CHARACTERISTIC
/begin CHARACTERISTIC DFES_Cls.DFC_PFlt_tOxiPreNpl_C "DFES/Fehlerklasse für Prüfung DFC_PFlt_tOxiPreNpl" VALUE 0x80023566 Val_Wu8 29.00 DFES_OneToOne 0.00 29.00 EXTENDED_LIMITS 0.00 255.0 /end CHARACTERISTIC
/begin CHARACTERISTIC DFES_Cls.DFC_PFlt_tPreMax_C "DFES/Fehlerklasse für Prüfung DFC_PFlt_tPreMax" VALUE 0x80023567 Val_Wu8 29.00 DFES_OneToOne 0.00 29.00 EXTENDED_LIMITS 0.00 255.0 /end CHARACTERISTIC
/begin CHARACTERISTIC DFES_Cls.DFC_PFlt_tPreMaxRgn_C "DFES/Fehlerklasse für Prüfung DFC_PFlt_tPreMaxRgn" VALUE 0x80023568 Val_Wu8 29.00 DFES_OneToOne 0.00 29.00 EXTENDED_LIMITS 0.00 255.0 /end CHARACTERISTIC
/begin CHARACTERISTIC DFES_Cls.DFC_PFlt_tPreNpl_C "DFES/Fehlerklasse für Prüfung DFC_PFlt_tPreNpl" VALUE 0x80023569 Val_Wu8 29.00 DFES_OneToOne 0.00 29.00 EXTENDED_LIMITS 0.00 255.0 /end CHARACTERISTIC
/begin CHARACTERISTIC DFES_Cls.DFC_PFltmSotDiffMAX_C "DFES/Fehlerklasse für Prüfung DFC_PFltmSotDiffMAX" VALUE 0x8002356A Val_Wu8 29.00 DFES_OneToOne 0.00 29.00 EXTENDED_LIMITS 0.00 255.0 /end CHARACTERISTIC
/begin CHARACTERISTIC DFES_Cls.DFC_PFltmSotDiffMIN_C "DFES/Fehlerklasse für Prüfung DFC_PFltmSotDiffMIN" VALUE 0x8002356B Val_Wu8 29.00 DFES_OneToOne 0.00 29.00 EXTENDED_LIMITS 0.00 255.0 /end CHARACTERISTIC
/begin CHARACTERISTIC DFES_Cls.DFC_PFltmSotDiffSIG_C "DFES/Fehlerklasse für Prüfung DFC_PFltmSotDiffSIG" VALUE 0x8002356C Val_Wu8 29.00 DFES_OneToOne 0.00 29.00 EXTENDED_LIMITS 0.00 255.0 /end CHARACTERISTIC
/begin CHARACTERISTIC DFES_Cls.DFC_PIntkVUsEnvPPls_C "DFES/Fehlerklasse für Prüfung DFC_PIntkVUsEnvPPls" VALUE 0x8002356D Val_Wu8 29.00 DFES_OneToOne 0.00 29.00 EXTENDED_LIMITS 0.00 255.0 /end CHARACTERISTIC
/begin CHARACTERISTIC DFES_Cls.DFC_PresPlausDblDef_C "DFES/Fehlerklasse für Prüfung DFC_PresPlausDblDef" VALUE 0x8002356E Val_Wu8 29.00 DFES_OneToOne 0.00 29.00 EXTENDED_LIMITS 0.00 255.0 /end CHARACTERISTIC
/begin CHARACTERISTIC DFES_Cls.DFC_RailCPC1_C "DFES/Fehlerklasse für Prüfung DFC_RailCPC1" VALUE 0x8002356F Val_Wu8 29.00 DFES_OneToOne 0.00 29.00 EXTENDED_LIMITS 0.00 255.0 /end CHARACTERISTIC
/begin CHARACTERISTIC DFES_Cls.DFC_RailCPC3_C "DFES/Fehlerklasse für Prüfung DFC_RailCPC3" VALUE 0x80023570 Val_Wu8 29.00 DFES_OneToOne 0.00 29.00 EXTENDED_LIMITS 0.00 255.0 /end CHARACTERISTIC
/begin CHARACTERISTIC DFES_Cls.DFC_RailCPC4_C "DFES/Fehlerklasse für Prüfung DFC_RailCPC4" VALUE 0x80023571 Val_Wu8 29.00 DFES_OneToOne 0.00 29.00 EXTENDED_LIMITS 0.00 255.0 /end CHARACTERISTIC
/begin CHARACTERISTIC DFES_Cls.DFC_RailMeUn0_C "DFES/Fehlerklasse für Prüfung DFC_RailMeUn0" VALUE 0x80023572 Val_Wu8 29.00 DFES_OneToOne 0.00 29.00 EXTENDED_LIMITS 0.00 255.0 /end CHARACTERISTIC
/begin CHARACTERISTIC DFES_Cls.DFC_RailMeUn1_C "DFES/Fehlerklasse für Prüfung DFC_RailMeUn1" VALUE 0x80023573 Val_Wu8 29.00 DFES_OneToOne 0.00 29.00 EXTENDED_LIMITS 0.00 255.0 /end CHARACTERISTIC
/begin CHARACTERISTIC DFES_Cls.DFC_RailMeUn2_C "DFES/Fehlerklasse für Prüfung DFC_RailMeUn2" VALUE 0x80023574 Val_Wu8 29.00 DFES_OneToOne 0.00 29.00 EXTENDED_LIMITS 0.00 255.0 /end CHARACTERISTIC
/begin CHARACTERISTIC DFES_Cls.DFC_RailMeUn22_C "DFES/Fehlerklasse für Prüfung DFC_RailMeUn22" VALUE 0x80023575 Val_Wu8 29.00 DFES_OneToOne 0.00 29.00 EXTENDED_LIMITS 0.00 255.0 /end CHARACTERISTIC
/begin CHARACTERISTIC DFES_Cls.DFC_RailMeUn3_C "DFES/Fehlerklasse für Prüfung DFC_RailMeUn3" VALUE 0x80023576 Val_Wu8 29.00 DFES_OneToOne 0.00 29.00 EXTENDED_LIMITS 0.00 255.0 /end CHARACTERISTIC
/begin CHARACTERISTIC DFES_Cls.DFC_RailMeUn4_C "DFES/Fehlerklasse für Prüfung DFC_RailMeUn4" VALUE 0x80023577 Val_Wu8 29.00 DFES_OneToOne 0.00 29.00 EXTENDED_LIMITS 0.00 255.0 /end CHARACTERISTIC
/begin CHARACTERISTIC DFES_Cls.DFC_RailMeUn42_C "DFES/Fehlerklasse für Prüfung DFC_RailMeUn42" VALUE 0x80023578 Val_Wu8 29.00 DFES_OneToOne 0.00 29.00 EXTENDED_LIMITS 0.00 255.0 /end CHARACTERISTIC
/begin CHARACTERISTIC DFES_Cls.DFC_RailMeUn5_C "DFES/Fehlerklasse für Prüfung DFC_RailMeUn5" VALUE 0x80023579 Val_Wu8 29.00 DFES_OneToOne 0.00 29.00 EXTENDED_LIMITS 0.00 255.0 /end CHARACTERISTIC
/begin CHARACTERISTIC DFES_Cls.DFC_RailPCV0_C "DFES/Fehlerklasse für Prüfung DFC_RailPCV0" VALUE 0x8002357A Val_Wu8 29.00 DFES_OneToOne 0.00 29.00 EXTENDED_LIMITS 0.00 255.0 /end CHARACTERISTIC
/begin CHARACTERISTIC DFES_Cls.DFC_RailPCV1_C "DFES/Fehlerklasse für Prüfung DFC_RailPCV1" VALUE 0x8002357B Val_Wu8 29.00 DFES_OneToOne 0.00 29.00 EXTENDED_LIMITS 0.00 255.0 /end CHARACTERISTIC
/begin CHARACTERISTIC DFES_Cls.DFC_RailPCV2_C "DFES/Fehlerklasse für Prüfung DFC_RailPCV2" VALUE 0x8002357C Val_Wu8 29.00 DFES_OneToOne 0.00 29.00 EXTENDED_LIMITS 0.00 255.0 /end CHARACTERISTIC
/begin CHARACTERISTIC DFES_Cls.DFC_RailPCV22_C "DFES/Fehlerklasse für Prüfung DFC_RailPCV22" VALUE 0x8002357D Val_Wu8 29.00 DFES_OneToOne 0.00 29.00 EXTENDED_LIMITS 0.00 255.0 /end CHARACTERISTIC
/begin CHARACTERISTIC DFES_Cls.DFC_RailPCV3_C "DFES/Fehlerklasse für Prüfung DFC_RailPCV3" VALUE 0x8002357E Val_Wu8 29.00 DFES_OneToOne 0.00 29.00 EXTENDED_LIMITS 0.00 255.0 /end CHARACTERISTIC
/begin CHARACTERISTIC DFES_Cls.DFC_RailPCV4_C "DFES/Fehlerklasse für Prüfung DFC_RailPCV4" VALUE 0x8002357F Val_Wu8 29.00 DFES_OneToOne 0.00 29.00 EXTENDED_LIMITS 0.00 255.0 /end CHARACTERISTIC
/begin CHARACTERISTIC DFES_Cls.DFC_RailPCV42_C "DFES/Fehlerklasse für Prüfung DFC_RailPCV42" VALUE 0x80023580 Val_Wu8 29.00 DFES_OneToOne 0.00 29.00 EXTENDED_LIMITS 0.00 255.0 /end CHARACTERISTIC
/begin CHARACTERISTIC DFES_Cls.DFC_RailPMonStrt_C "DFES/Fehlerklasse für Prüfung DFC_RailPMonStrt" VALUE 0x80023581 Val_Wu8 29.00 DFES_OneToOne 0.00 29.00 EXTENDED_LIMITS 0.00 255.0 /end CHARACTERISTIC
/begin CHARACTERISTIC DFES_Cls.DFC_SSpMon1_C "DFES/Fehlerklasse für Prüfung DFC_SSpMon1" VALUE 0x80023582 Val_Wu8 29.00 DFES_OneToOne 0.00 29.00 EXTENDED_LIMITS 0.00 255.0 /end CHARACTERISTIC
/begin CHARACTERISTIC DFES_Cls.DFC_SSpMon2_C "DFES/Fehlerklasse für Prüfung DFC_SSpMon2" VALUE 0x80023583 Val_Wu8 29.00 DFES_OneToOne 0.00 29.00 EXTENDED_LIMITS 0.00 255.0 /end CHARACTERISTIC
/begin CHARACTERISTIC DFES_Cls.DFC_SSpMon3_C "DFES/Fehlerklasse für Prüfung DFC_SSpMon3" VALUE 0x80023584 Val_Wu8 29.00 DFES_OneToOne 0.00 29.00 EXTENDED_LIMITS 0.00 255.0 /end CHARACTERISTIC
/begin CHARACTERISTIC DFES_Cls.DFC_ThrVlv4WinErr1_C "DFES/Fehlerklasse für Prüfung DFC_ThrVlv4WinErr1" VALUE 0x80023585 Val_Wu8 29.00 DFES_OneToOne 0.00 29.00 EXTENDED_LIMITS 0.00 255.0 /end CHARACTERISTIC
/begin CHARACTERISTIC DFES_Cls.DFC_ThrVlv4WinErr2_C "DFES/Fehlerklasse für Prüfung DFC_ThrVlv4WinErr2" VALUE 0x80023586 Val_Wu8 29.00 DFES_OneToOne 0.00 29.00 EXTENDED_LIMITS 0.00 255.0 /end CHARACTERISTIC
/begin CHARACTERISTIC DFES_Cls.DFC_ThrVlv4WinErr3_C "DFES/Fehlerklasse für Prüfung DFC_ThrVlv4WinErr3" VALUE 0x80023587 Val_Wu8 29.00 DFES_OneToOne 0.00 29.00 EXTENDED_LIMITS 0.00 255.0 /end CHARACTERISTIC
/begin CHARACTERISTIC DFES_Cls.DFC_ThrVlv4WinErr4_C "DFES/Fehlerklasse für Prüfung DFC_ThrVlv4WinErr4" VALUE 0x80023588 Val_Wu8 29.00 DFES_OneToOne 0.00 29.00 EXTENDED_LIMITS 0.00 255.0 /end CHARACTERISTIC
/begin CHARACTERISTIC DFES_Cls.DFC_ThrVlvSCG_C "DFES/Fehlerklasse für Prüfung DFC_ThrVlvSCG" VALUE 0x80023589 Val_Wu8 29.00 DFES_OneToOne 0.00 29.00 EXTENDED_LIMITS 0.00 255.0 /end CHARACTERISTIC
/begin CHARACTERISTIC DFES_Cls.DFC_Tle6232Spi1_C "DFES/Fehlerklasse für Prüfung DFC_Tle6232Spi1" VALUE 0x8002358A Val_Wu8 29.00 DFES_OneToOne 0.00 29.00 EXTENDED_LIMITS 0.00 255.0 /end CHARACTERISTIC
/begin CHARACTERISTIC DFES_Cls.DFC_TrbCh4WinErr1_C "DFES/Fehlerklasse für Prüfung DFC_TrbCh4WinErr1" VALUE 0x8002358B Val_Wu8 29.00 DFES_OneToOne 0.00 29.00 EXTENDED_LIMITS 0.00 255.0 /end CHARACTERISTIC
/begin CHARACTERISTIC DFES_Cls.DFC_TrbCh4WinErr2_C "DFES/Fehlerklasse für Prüfung DFC_TrbCh4WinErr2" VALUE 0x8002358C Val_Wu8 29.00 DFES_OneToOne 0.00 29.00 EXTENDED_LIMITS 0.00 255.0 /end CHARACTERISTIC
/begin CHARACTERISTIC DFES_Cls.DFC_TrbCh4WinErr3_C "DFES/Fehlerklasse für Prüfung DFC_TrbCh4WinErr3" VALUE 0x8002358D Val_Wu8 29.00 DFES_OneToOne 0.00 29.00 EXTENDED_LIMITS 0.00 255.0 /end CHARACTERISTIC
/begin CHARACTERISTIC DFES_Cls.DFC_TrbCh4WinErr4_C "DFES/Fehlerklasse für Prüfung DFC_TrbCh4WinErr4" VALUE 0x8002358E Val_Wu8 29.00 DFES_OneToOne 0.00 29.00 EXTENDED_LIMITS 0.00 255.0 /end CHARACTERISTIC
/begin CHARACTERISTIC DFES_Cls.DFC_TrbChSCG_C "DFES/Fehlerklasse für Prüfung DFC_TrbChSCG" VALUE 0x8002358F Val_Wu8 29.00 DFES_OneToOne 0.00 29.00 EXTENDED_LIMITS 0.00 255.0 /end CHARACTERISTIC
/begin CHARACTERISTIC DFES_Cls.DFC_TrbChSRCMax_C "DFES/Fehlerklasse für Prüfung DFC_TrbChSRCMax" VALUE 0x80023590 Val_Wu8 29.00 DFES_OneToOne 0.00 29.00 EXTENDED_LIMITS 0.00 255.0 /end CHARACTERISTIC
/begin CHARACTERISTIC DFES_Cls.DFC_TrbChSRCMin_C "DFES/Fehlerklasse für Prüfung DFC_TrbChSRCMin" VALUE 0x80023591 Val_Wu8 29.00 DFES_OneToOne 0.00 29.00 EXTENDED_LIMITS 0.00 255.0 /end CHARACTERISTIC
/begin CHARACTERISTIC DFES_Cls.DFC_WaHtEl4WinErr1_C "DFES/Fehlerklasse für Prüfung DFC_WaHtEl4WinErr1" VALUE 0x80023592 Val_Wu8 29.00 DFES_OneToOne 0.00 29.00 EXTENDED_LIMITS 0.00 255.0 /end CHARACTERISTIC
/begin CHARACTERISTIC DFES_Cls.DFC_WaHtEl4WinErr2_C "DFES/Fehlerklasse für Prüfung DFC_WaHtEl4WinErr2" VALUE 0x80023593 Val_Wu8 29.00 DFES_OneToOne 0.00 29.00 EXTENDED_LIMITS 0.00 255.0 /end CHARACTERISTIC
/begin CHARACTERISTIC DFES_Cls.DFC_WaHtEl4WinErr3_C "DFES/Fehlerklasse für Prüfung DFC_WaHtEl4WinErr3" VALUE 0x80023594 Val_Wu8 29.00 DFES_OneToOne 0.00 29.00 EXTENDED_LIMITS 0.00 255.0 /end CHARACTERISTIC
/begin CHARACTERISTIC DFES_Cls.DFC_WaHtEl4WinErr4_C "DFES/Fehlerklasse für Prüfung DFC_WaHtEl4WinErr4" VALUE 0x80023595 Val_Wu8 29.00 DFES_OneToOne 0.00 29.00 EXTENDED_LIMITS 0.00 255.0 /end CHARACTERISTIC
/begin CHARACTERISTIC DFES_Cls.DFC_WaHtElSCG_C "DFES/Fehlerklasse für Prüfung DFC_WaHtElSCG" VALUE 0x80023596 Val_Wu8 29.00 DFES_OneToOne 0.00 29.00 EXTENDED_LIMITS 0.00 255.0 /end CHARACTERISTIC
/begin CHARACTERISTIC DFES_Cls.DFC_ETClbETFltMax_0_C "DFES/Fehlerklasse für Prüfung DFC_ETClbETFltMax_0" VALUE 0x80023597 Val_Wu8 29.00 DFES_OneToOne 0.00 29.00 EXTENDED_LIMITS 0.00 255.0 /end CHARACTERISTIC
/begin CHARACTERISTIC DFES_Cls.DFC_ETClbETFltMax_1_C "DFES/Fehlerklasse für Prüfung DFC_ETClbETFltMax_1" VALUE 0x80023598 Val_Wu8 29.00 DFES_OneToOne 0.00 29.00 EXTENDED_LIMITS 0.00 255.0 /end CHARACTERISTIC
/begin CHARACTERISTIC DFES_Cls.DFC_ETClbETFltMax_2_C "DFES/Fehlerklasse für Prüfung DFC_ETClbETFltMax_2" VALUE 0x80023599 Val_Wu8 29.00 DFES_OneToOne 0.00 29.00 EXTENDED_LIMITS 0.00 255.0 /end CHARACTERISTIC
/begin CHARACTERISTIC DFES_Cls.DFC_ETClbETFltMax_3_C "DFES/Fehlerklasse für Prüfung DFC_ETClbETFltMax_3" VALUE 0x8002359A Val_Wu8 29.00 DFES_OneToOne 0.00 29.00 EXTENDED_LIMITS 0.00 255.0 /end CHARACTERISTIC
/begin CHARACTERISTIC DFES_Cls.DFC_ETClbETFltMax_4_C "DFES/Fehlerklasse für Prüfung DFC_ETClbETFltMax_4" VALUE 0x8002359B Val_Wu8 29.00 DFES_OneToOne 0.00 29.00 EXTENDED_LIMITS 0.00 255.0 /end CHARACTERISTIC
/begin CHARACTERISTIC DFES_Cls.DFC_ETClbETFltMax_5_C "DFES/Fehlerklasse für Prüfung DFC_ETClbETFltMax_5" VALUE 0x8002359C Val_Wu8 29.00 DFES_OneToOne 0.00 29.00 EXTENDED_LIMITS 0.00 255.0 /end CHARACTERISTIC
/begin CHARACTERISTIC DFES_Cls.DFC_ETClbETFltMin_0_C "DFES/Fehlerklasse für Prüfung DFC_ETClbETFltMin_0" VALUE 0x8002359D Val_Wu8 29.00 DFES_OneToOne 0.00 29.00 EXTENDED_LIMITS 0.00 255.0 /end CHARACTERISTIC
/begin CHARACTERISTIC DFES_Cls.DFC_ETClbETFltMin_1_C "DFES/Fehlerklasse für Prüfung DFC_ETClbETFltMin_1" VALUE 0x8002359E Val_Wu8 29.00 DFES_OneToOne 0.00 29.00 EXTENDED_LIMITS 0.00 255.0 /end CHARACTERISTIC
/begin CHARACTERISTIC DFES_Cls.DFC_ETClbETFltMin_2_C "DFES/Fehlerklasse für Prüfung DFC_ETClbETFltMin_2" VALUE 0x8002359F Val_Wu8 29.00 DFES_OneToOne 0.00 29.00 EXTENDED_LIMITS 0.00 255.0 /end CHARACTERISTIC
/begin CHARACTERISTIC DFES_Cls.DFC_ETClbETFltMin_3_C "DFES/Fehlerklasse für Prüfung DFC_ETClbETFltMin_3" VALUE 0x800235A0 Val_Wu8 29.00 DFES_OneToOne 0.00 29.00 EXTENDED_LIMITS 0.00 255.0 /end CHARACTERISTIC
/begin CHARACTERISTIC DFES_Cls.DFC_ETClbETFltMin_4_C "DFES/Fehlerklasse für Prüfung DFC_ETClbETFltMin_4" VALUE 0x800235A1 Val_Wu8 29.00 DFES_OneToOne 0.00 29.00 EXTENDED_LIMITS 0.00 255.0 /end CHARACTERISTIC
/begin CHARACTERISTIC DFES_Cls.DFC_ETClbETFltMin_5_C "DFES/Fehlerklasse für Prüfung DFC_ETClbETFltMin_5" VALUE 0x800235A2 Val_Wu8 29.00 DFES_OneToOne 0.00 29.00 EXTENDED_LIMITS 0.00 255.0 /end CHARACTERISTIC
/begin CHARACTERISTIC DFES_Cls.DFC_InjCrvInjLimChrgBal_C "DFES/Fehlerklasse für Prüfung DFC_InjCrvInjLimChrgBal" VALUE 0x800235A3 Val_Wu8 29.00 DFES_OneToOne 0.00 29.00 EXTENDED_LIMITS 0.00 255.0 /end CHARACTERISTIC
/begin CHARACTERISTIC DFES_Cls.DFC_InjCrvInjLimQntBal_C "DFES/Fehlerklasse für Prüfung DFC_InjCrvInjLimQntBal" VALUE 0x800235A4 Val_Wu8 29.00 DFES_OneToOne 0.00 29.00 EXTENDED_LIMITS 0.00 255.0 /end CHARACTERISTIC
/begin CHARACTERISTIC DFES_Cls.DFC_InjCrvInjLimSys_C "DFES/Fehlerklasse für Prüfung DFC_InjCrvInjLimSys" VALUE 0x800235A5 Val_Wu8 29.00 DFES_OneToOne 0.00 29.00 EXTENDED_LIMITS 0.00 255.0 /end CHARACTERISTIC
/begin CHARACTERISTIC DFES_Cls.DFC_InjCrvNumInjRtmLim_C "DFES/Fehlerklasse für Prüfung DFC_InjCrvNumInjRtmLim" VALUE 0x800235A6 Val_Wu8 29.00 DFES_OneToOne 0.00 29.00 EXTENDED_LIMITS 0.00 255.0 /end CHARACTERISTIC
/begin CHARACTERISTIC DFES_Cls.DFC_LSUHtCoupSig_C "DFES/Fehlerklasse für Prüfung DFC_LSUHtCoupSig" VALUE 0x800235A7 Val_Wu8 29.00 DFES_OneToOne 0.00 29.00 EXTENDED_LIMITS 0.00 255.0 /end CHARACTERISTIC
/begin CHARACTERISTIC DFES_Cls.DFC_AFS_SSpShOffOL_C "DFES/Fehlerklasse für Prüfung DFC_AFS_SSpShOffOL" VALUE 0x800235A8 Val_Wu8 29.00 DFES_OneToOne 0.00 29.00 EXTENDED_LIMITS 0.00 255.0 /end CHARACTERISTIC
/begin CHARACTERISTIC DFES_Cls.DFC_AFS_SSpShOffOvrTemp_C "DFES/Fehlerklasse für Prüfung DFC_AFS_SSpShOffOvrTemp" VALUE 0x800235A9 Val_Wu8 29.00 DFES_OneToOne 0.00 29.00 EXTENDED_LIMITS 0.00 255.0 /end CHARACTERISTIC
/begin CHARACTERISTIC DFES_Cls.DFC_AFS_SSpShOffSCB_C "DFES/Fehlerklasse für Prüfung DFC_AFS_SSpShOffSCB" VALUE 0x800235AA Val_Wu8 29.00 DFES_OneToOne 0.00 29.00 EXTENDED_LIMITS 0.00 255.0 /end CHARACTERISTIC
/begin CHARACTERISTIC DFES_Cls.DFC_AFS_SSpShOffSCG_C "DFES/Fehlerklasse für Prüfung DFC_AFS_SSpShOffSCG" VALUE 0x800235AB Val_Wu8 29.00 DFES_OneToOne 0.00 29.00 EXTENDED_LIMITS 0.00 255.0 /end CHARACTERISTIC
/begin CHARACTERISTIC DFES_Cls.DFC_AirCCmprOL_C "DFES/Fehlerklasse für Prüfung DFC_AirCCmprOL" VALUE 0x800235AC Val_Wu8 29.00 DFES_OneToOne 0.00 29.00 EXTENDED_LIMITS 0.00 255.0 /end CHARACTERISTIC
/begin CHARACTERISTIC DFES_Cls.DFC_AirCCmprOvrTemp_C "DFES/Fehlerklasse für Prüfung DFC_AirCCmprOvrTemp" VALUE 0x800235AD Val_Wu8 29.00 DFES_OneToOne 0.00 29.00 EXTENDED_LIMITS 0.00 255.0 /end CHARACTERISTIC
/begin CHARACTERISTIC DFES_Cls.DFC_AirCCmprSCB_C "DFES/Fehlerklasse für Prüfung DFC_AirCCmprSCB" VALUE 0x800235AE Val_Wu8 29.00 DFES_OneToOne 0.00 29.00 EXTENDED_LIMITS 0.00 255.0 /end CHARACTERISTIC
/begin CHARACTERISTIC DFES_Cls.DFC_AirCCmprSCG_C "DFES/Fehlerklasse für Prüfung DFC_AirCCmprSCG" VALUE 0x800235AF Val_Wu8 29.00 DFES_OneToOne 0.00 29.00 EXTENDED_LIMITS 0.00 255.0 /end CHARACTERISTIC
/begin CHARACTERISTIC DFES_Cls.DFC_CByVlvOL_C "DFES/Fehlerklasse für Prüfung DFC_CByVlvOL" VALUE 0x800235B0 Val_Wu8 29.00 DFES_OneToOne 0.00 29.00 EXTENDED_LIMITS 0.00 255.0 /end CHARACTERISTIC
/begin CHARACTERISTIC DFES_Cls.DFC_CByVlvOvrTemp_C "DFES/Fehlerklasse für Prüfung DFC_CByVlvOvrTemp" VALUE 0x800235B1 Val_Wu8 29.00 DFES_OneToOne 0.00 29.00 EXTENDED_LIMITS 0.00 255.0 /end CHARACTERISTIC
/begin CHARACTERISTIC DFES_Cls.DFC_CByVlvSCB_C "DFES/Fehlerklasse für Prüfung DFC_CByVlvSCB" VALUE 0x800235B2 Val_Wu8 29.00 DFES_OneToOne 0.00 29.00 EXTENDED_LIMITS 0.00 255.0 /end CHARACTERISTIC
/begin CHARACTERISTIC DFES_Cls.DFC_CByVlvSCG_C "DFES/Fehlerklasse für Prüfung DFC_CByVlvSCG" VALUE 0x800235B3 Val_Wu8 29.00 DFES_OneToOne 0.00 29.00 EXTENDED_LIMITS 0.00 255.0 /end CHARACTERISTIC
/begin CHARACTERISTIC DFES_Cls.DFC_CThmstOL_C "DFES/Fehlerklasse für Prüfung DFC_CThmstOL" VALUE 0x800235B4 Val_Wu8 29.00 DFES_OneToOne 0.00 29.00 EXTENDED_LIMITS 0.00 255.0 /end CHARACTERISTIC
/begin CHARACTERISTIC DFES_Cls.DFC_CThmstOvrTemp_C "DFES/Fehlerklasse für Prüfung DFC_CThmstOvrTemp" VALUE 0x800235B5 Val_Wu8 29.00 DFES_OneToOne 0.00 29.00 EXTENDED_LIMITS 0.00 255.0 /end CHARACTERISTIC
/begin CHARACTERISTIC DFES_Cls.DFC_CThmstSCB_C "DFES/Fehlerklasse für Prüfung DFC_CThmstSCB" VALUE 0x800235B6 Val_Wu8 29.00 DFES_OneToOne 0.00 29.00 EXTENDED_LIMITS 0.00 255.0 /end CHARACTERISTIC
/begin CHARACTERISTIC DFES_Cls.DFC_CThmstSCG_C "DFES/Fehlerklasse für Prüfung DFC_CThmstSCG" VALUE 0x800235B7 Val_Wu8 29.00 DFES_OneToOne 0.00 29.00 EXTENDED_LIMITS 0.00 255.0 /end CHARACTERISTIC
/begin CHARACTERISTIC DFES_Cls.DFC_DSMDummy_C "DFES/Fehlerklasse für Prüfung DFC_DSMDummy" VALUE 0x800235B8 Val_Wu8 29.00 DFES_OneToOne 0.00 29.00 EXTENDED_LIMITS 0.00 255.0 /end CHARACTERISTIC
/begin CHARACTERISTIC DFES_Cls.DFC_EBxFanOL_C "DFES/Fehlerklasse für Prüfung DFC_EBxFanOL" VALUE 0x800235B9 Val_Wu8 29.00 DFES_OneToOne 0.00 29.00 EXTENDED_LIMITS 0.00 255.0 /end CHARACTERISTIC
/begin CHARACTERISTIC DFES_Cls.DFC_EBxFanOvrTemp_C "DFES/Fehlerklasse für Prüfung DFC_EBxFanOvrTemp" VALUE 0x800235BA Val_Wu8 29.00 DFES_OneToOne 0.00 29.00 EXTENDED_LIMITS 0.00 255.0 /end CHARACTERISTIC
/begin CHARACTERISTIC DFES_Cls.DFC_EBxFanSCB_C "DFES/Fehlerklasse für Prüfung DFC_EBxFanSCB" VALUE 0x800235BB Val_Wu8 29.00 DFES_OneToOne 0.00 29.00 EXTENDED_LIMITS 0.00 255.0 /end CHARACTERISTIC
/begin CHARACTERISTIC DFES_Cls.DFC_EBxFanSCG_C "DFES/Fehlerklasse für Prüfung DFC_EBxFanSCG" VALUE 0x800235BC Val_Wu8 29.00 DFES_OneToOne 0.00 29.00 EXTENDED_LIMITS 0.00 255.0 /end CHARACTERISTIC
/begin CHARACTERISTIC DFES_Cls.DFC_ECBVlvOL_C "DFES/Fehlerklasse für Prüfung DFC_ECBVlvOL" VALUE 0x800235BD Val_Wu8 29.00 DFES_OneToOne 0.00 29.00 EXTENDED_LIMITS 0.00 255.0 /end CHARACTERISTIC
/begin CHARACTERISTIC DFES_Cls.DFC_ECBVlvOvrTemp_C "DFES/Fehlerklasse für Prüfung DFC_ECBVlvOvrTemp" VALUE 0x800235BE Val_Wu8 29.00 DFES_OneToOne 0.00 29.00 EXTENDED_LIMITS 0.00 255.0 /end CHARACTERISTIC
/begin CHARACTERISTIC DFES_Cls.DFC_ECBVlvSCB_C "DFES/Fehlerklasse für Prüfung DFC_ECBVlvSCB" VALUE 0x800235BF Val_Wu8 29.00 DFES_OneToOne 0.00 29.00 EXTENDED_LIMITS 0.00 255.0 /end CHARACTERISTIC
/begin CHARACTERISTIC DFES_Cls.DFC_ECBVlvSCG_C "DFES/Fehlerklasse für Prüfung DFC_ECBVlvSCG" VALUE 0x800235C0 Val_Wu8 29.00 DFES_OneToOne 0.00 29.00 EXTENDED_LIMITS 0.00 255.0 /end CHARACTERISTIC
/begin CHARACTERISTIC DFES_Cls.DFC_EMDmpOL_0_C "DFES/Fehlerklasse für Prüfung DFC_EMDmpOL_0" VALUE 0x800235C1 Val_Wu8 29.00 DFES_OneToOne 0.00 29.00 EXTENDED_LIMITS 0.00 255.0 /end CHARACTERISTIC
/begin CHARACTERISTIC DFES_Cls.DFC_EMDmpOL_1_C "DFES/Fehlerklasse für Prüfung DFC_EMDmpOL_1" VALUE 0x800235C2 Val_Wu8 29.00 DFES_OneToOne 0.00 29.00 EXTENDED_LIMITS 0.00 255.0 /end CHARACTERISTIC
/begin CHARACTERISTIC DFES_Cls.DFC_EMDmpOvrTemp_0_C "DFES/Fehlerklasse für Prüfung DFC_EMDmpOvrTemp_0" VALUE 0x800235C3 Val_Wu8 29.00 DFES_OneToOne 0.00 29.00 EXTENDED_LIMITS 0.00 255.0 /end CHARACTERISTIC
/begin CHARACTERISTIC DFES_Cls.DFC_EMDmpOvrTemp_1_C "DFES/Fehlerklasse für Prüfung DFC_EMDmpOvrTemp_1" VALUE 0x800235C4 Val_Wu8 29.00 DFES_OneToOne 0.00 29.00 EXTENDED_LIMITS 0.00 255.0 /end CHARACTERISTIC
/begin CHARACTERISTIC DFES_Cls.DFC_EMDmpSCB_0_C "DFES/Fehlerklasse für Prüfung DFC_EMDmpSCB_0" VALUE 0x800235C5 Val_Wu8 29.00 DFES_OneToOne 0.00 29.00 EXTENDED_LIMITS 0.00 255.0 /end CHARACTERISTIC
/begin CHARACTERISTIC DFES_Cls.DFC_EMDmpSCB_1_C "DFES/Fehlerklasse für Prüfung DFC_EMDmpSCB_1" VALUE 0x800235C6 Val_Wu8 29.00 DFES_OneToOne 0.00 29.00 EXTENDED_LIMITS 0.00 255.0 /end CHARACTERISTIC
/begin CHARACTERISTIC DFES_Cls.DFC_EMDmpSCG_0_C "DFES/Fehlerklasse für Prüfung DFC_EMDmpSCG_0" VALUE 0x800235C7 Val_Wu8 29.00 DFES_OneToOne 0.00 29.00 EXTENDED_LIMITS 0.00 255.0 /end CHARACTERISTIC
/begin CHARACTERISTIC DFES_Cls.DFC_EMDmpSCG_1_C "DFES/Fehlerklasse für Prüfung DFC_EMDmpSCG_1" VALUE 0x800235C8 Val_Wu8 29.00 DFES_OneToOne 0.00 29.00 EXTENDED_LIMITS 0.00 255.0 /end CHARACTERISTIC
/begin CHARACTERISTIC DFES_Cls.DFC_EngStAOL_C "DFES/Fehlerklasse für Prüfung DFC_EngStAOL" VALUE 0x800235C9 Val_Wu8 29.00 DFES_OneToOne 0.00 29.00 EXTENDED_LIMITS 0.00 255.0 /end CHARACTERISTIC
/begin CHARACTERISTIC DFES_Cls.DFC_EngStAOvrTemp_C "DFES/Fehlerklasse für Prüfung DFC_EngStAOvrTemp" VALUE 0x800235CA Val_Wu8 29.00 DFES_OneToOne 0.00 29.00 EXTENDED_LIMITS 0.00 255.0 /end CHARACTERISTIC
/begin CHARACTERISTIC DFES_Cls.DFC_EngStASCB_C "DFES/Fehlerklasse für Prüfung DFC_EngStASCB" VALUE 0x800235CB Val_Wu8 29.00 DFES_OneToOne 0.00 29.00 EXTENDED_LIMITS 0.00 255.0 /end CHARACTERISTIC
/begin CHARACTERISTIC DFES_Cls.DFC_EngStASCG_C "DFES/Fehlerklasse für Prüfung DFC_EngStASCG" VALUE 0x800235CC Val_Wu8 29.00 DFES_OneToOne 0.00 29.00 EXTENDED_LIMITS 0.00 255.0 /end CHARACTERISTIC
/begin CHARACTERISTIC DFES_Cls.DFC_FanOL_C "DFES/Fehlerklasse für Prüfung DFC_FanOL" VALUE 0x800235CD Val_Wu8 29.00 DFES_OneToOne 0.00 29.00 EXTENDED_LIMITS 0.00 255.0 /end CHARACTERISTIC
/begin CHARACTERISTIC DFES_Cls.DFC_FanOvrTemp_C "DFES/Fehlerklasse für Prüfung DFC_FanOvrTemp" VALUE 0x800235CE Val_Wu8 29.00 DFES_OneToOne 0.00 29.00 EXTENDED_LIMITS 0.00 255.0 /end CHARACTERISTIC
/begin CHARACTERISTIC DFES_Cls.DFC_FanSCB_C "DFES/Fehlerklasse für Prüfung DFC_FanSCB" VALUE 0x800235CF Val_Wu8 29.00 DFES_OneToOne 0.00 29.00 EXTENDED_LIMITS 0.00 255.0 /end CHARACTERISTIC
/begin CHARACTERISTIC DFES_Cls.DFC_FlFltHtOL_C "DFES/Fehlerklasse für Prüfung DFC_FlFltHtOL" VALUE 0x800235D0 Val_Wu8 29.00 DFES_OneToOne 0.00 29.00 EXTENDED_LIMITS 0.00 255.0 /end CHARACTERISTIC
/begin CHARACTERISTIC DFES_Cls.DFC_FlFltHtOvrTemp_C "DFES/Fehlerklasse für Prüfung DFC_FlFltHtOvrTemp" VALUE 0x800235D1 Val_Wu8 29.00 DFES_OneToOne 0.00 29.00 EXTENDED_LIMITS 0.00 255.0 /end CHARACTERISTIC
/begin CHARACTERISTIC DFES_Cls.DFC_FlFltHtSCB_C "DFES/Fehlerklasse für Prüfung DFC_FlFltHtSCB" VALUE 0x800235D2 Val_Wu8 29.00 DFES_OneToOne 0.00 29.00 EXTENDED_LIMITS 0.00 255.0 /end CHARACTERISTIC
/begin CHARACTERISTIC DFES_Cls.DFC_FlFltHtSCG_C "DFES/Fehlerklasse für Prüfung DFC_FlFltHtSCG" VALUE 0x800235D3 Val_Wu8 29.00 DFES_OneToOne 0.00 29.00 EXTENDED_LIMITS 0.00 255.0 /end CHARACTERISTIC
/begin CHARACTERISTIC DFES_Cls.DFC_LSUHtrMax_C "DFES/Fehlerklasse für Prüfung DFC_LSUHtrMax" VALUE 0x800235D4 Val_Wu8 29.00 DFES_OneToOne 0.00 29.00 EXTENDED_LIMITS 0.00 255.0 /end CHARACTERISTIC
/begin CHARACTERISTIC DFES_Cls.DFC_LSUHtrMin_C "DFES/Fehlerklasse für Prüfung DFC_LSUHtrMin" VALUE 0x800235D5 Val_Wu8 29.00 DFES_OneToOne 0.00 29.00 EXTENDED_LIMITS 0.00 255.0 /end CHARACTERISTIC
/begin CHARACTERISTIC DFES_Cls.DFC_LSUHtrNpl_C "DFES/Fehlerklasse für Prüfung DFC_LSUHtrNpl" VALUE 0x800235D6 Val_Wu8 29.00 DFES_OneToOne 0.00 29.00 EXTENDED_LIMITS 0.00 255.0 /end CHARACTERISTIC
/begin CHARACTERISTIC DFES_Cls.DFC_LSUHtrSig_C "DFES/Fehlerklasse für Prüfung DFC_LSUHtrSig" VALUE 0x800235D7 Val_Wu8 29.00 DFES_OneToOne 0.00 29.00 EXTENDED_LIMITS 0.00 255.0 /end CHARACTERISTIC
/begin CHARACTERISTIC DFES_Cls.DFC_LSUtExcMax_C "DFES/Fehlerklasse für Prüfung DFC_LSUtExcMax" VALUE 0x800235D8 Val_Wu8 29.00 DFES_OneToOne 0.00 29.00 EXTENDED_LIMITS 0.00 255.0 /end CHARACTERISTIC
/begin CHARACTERISTIC DFES_Cls.DFC_LSUtExcMin_C "DFES/Fehlerklasse für Prüfung DFC_LSUtExcMin" VALUE 0x800235D9 Val_Wu8 29.00 DFES_OneToOne 0.00 29.00 EXTENDED_LIMITS 0.00 255.0 /end CHARACTERISTIC
/begin CHARACTERISTIC DFES_Cls.DFC_MeUnOL_C "DFES/Fehlerklasse für Prüfung DFC_MeUnOL" VALUE 0x800235DA Val_Wu8 29.00 DFES_OneToOne 0.00 29.00 EXTENDED_LIMITS 0.00 255.0 /end CHARACTERISTIC
/begin CHARACTERISTIC DFES_Cls.DFC_MeUnSCB_C "DFES/Fehlerklasse für Prüfung DFC_MeUnSCB" VALUE 0x800235DB Val_Wu8 29.00 DFES_OneToOne 0.00 29.00 EXTENDED_LIMITS 0.00 255.0 /end CHARACTERISTIC
/begin CHARACTERISTIC DFES_Cls.DFC_MeUnSRCMax_C "DFES/Fehlerklasse für Prüfung DFC_MeUnSRCMax" VALUE 0x800235DC Val_Wu8 29.00 DFES_OneToOne 0.00 29.00 EXTENDED_LIMITS 0.00 255.0 /end CHARACTERISTIC
/begin CHARACTERISTIC DFES_Cls.DFC_MeUnSRCMin_C "DFES/Fehlerklasse für Prüfung DFC_MeUnSRCMin" VALUE 0x800235DD Val_Wu8 29.00 DFES_OneToOne 0.00 29.00 EXTENDED_LIMITS 0.00 255.0 /end CHARACTERISTIC
/begin CHARACTERISTIC DFES_Cls.DFC_PCVOL_C "DFES/Fehlerklasse für Prüfung DFC_PCVOL" VALUE 0x800235DE Val_Wu8 29.00 DFES_OneToOne 0.00 29.00 EXTENDED_LIMITS 0.00 255.0 /end CHARACTERISTIC
/begin CHARACTERISTIC DFES_Cls.DFC_PCVSCB_C "DFES/Fehlerklasse für Prüfung DFC_PCVSCB" VALUE 0x800235DF Val_Wu8 29.00 DFES_OneToOne 0.00 29.00 EXTENDED_LIMITS 0.00 255.0 /end CHARACTERISTIC
/begin CHARACTERISTIC DFES_Cls.DFC_PCVSRCMax_C "DFES/Fehlerklasse für Prüfung DFC_PCVSRCMax" VALUE 0x800235E0 Val_Wu8 29.00 DFES_OneToOne 0.00 29.00 EXTENDED_LIMITS 0.00 255.0 /end CHARACTERISTIC
/begin CHARACTERISTIC DFES_Cls.DFC_PCVSRCMin_C "DFES/Fehlerklasse für Prüfung DFC_PCVSRCMin" VALUE 0x800235E1 Val_Wu8 29.00 DFES_OneToOne 0.00 29.00 EXTENDED_LIMITS 0.00 255.0 /end CHARACTERISTIC
/begin CHARACTERISTIC DFES_Cls.DFC_RailPSRCMax_C "DFES/Fehlerklasse für Prüfung DFC_RailPSRCMax" VALUE 0x800235E2 Val_Wu8 29.00 DFES_OneToOne 0.00 29.00 EXTENDED_LIMITS 0.00 255.0 /end CHARACTERISTIC
/begin CHARACTERISTIC DFES_Cls.DFC_RailPSRCMin_C "DFES/Fehlerklasse für Prüfung DFC_RailPSRCMin" VALUE 0x800235E3 Val_Wu8 29.00 DFES_OneToOne 0.00 29.00 EXTENDED_LIMITS 0.00 255.0 /end CHARACTERISTIC
/begin CHARACTERISTIC DFES_Cls.DFC_ShtrOL_C "DFES/Fehlerklasse für Prüfung DFC_ShtrOL" VALUE 0x800235E4 Val_Wu8 29.00 DFES_OneToOne 0.00 29.00 EXTENDED_LIMITS 0.00 255.0 /end CHARACTERISTIC
/begin CHARACTERISTIC DFES_Cls.DFC_ShtrOvrTemp_C "DFES/Fehlerklasse für Prüfung DFC_ShtrOvrTemp" VALUE 0x800235E5 Val_Wu8 29.00 DFES_OneToOne 0.00 29.00 EXTENDED_LIMITS 0.00 255.0 /end CHARACTERISTIC
/begin CHARACTERISTIC DFES_Cls.DFC_ShtrSCB_C "DFES/Fehlerklasse für Prüfung DFC_ShtrSCB" VALUE 0x800235E6 Val_Wu8 29.00 DFES_OneToOne 0.00 29.00 EXTENDED_LIMITS 0.00 255.0 /end CHARACTERISTIC
/begin CHARACTERISTIC DFES_Cls.DFC_ShtrSCG_C "DFES/Fehlerklasse für Prüfung DFC_ShtrSCG" VALUE 0x800235E7 Val_Wu8 29.00 DFES_OneToOne 0.00 29.00 EXTENDED_LIMITS 0.00 255.0 /end CHARACTERISTIC
/begin CHARACTERISTIC DFES_Cls.DFC_StrtOL_C "DFES/Fehlerklasse für Prüfung DFC_StrtOL" VALUE 0x800235E8 Val_Wu8 29.00 DFES_OneToOne 0.00 29.00 EXTENDED_LIMITS 0.00 255.0 /end CHARACTERISTIC
/begin CHARACTERISTIC DFES_Cls.DFC_StrtOvrTemp_C "DFES/Fehlerklasse für Prüfung DFC_StrtOvrTemp" VALUE 0x800235E9 Val_Wu8 29.00 DFES_OneToOne 0.00 29.00 EXTENDED_LIMITS 0.00 255.0 /end CHARACTERISTIC
/begin CHARACTERISTIC DFES_Cls.DFC_StrtSCB_C "DFES/Fehlerklasse für Prüfung DFC_StrtSCB" VALUE 0x800235EA Val_Wu8 29.00 DFES_OneToOne 0.00 29.00 EXTENDED_LIMITS 0.00 255.0 /end CHARACTERISTIC
/begin CHARACTERISTIC DFES_Cls.DFC_StrtSCG_C "DFES/Fehlerklasse für Prüfung DFC_StrtSCG" VALUE 0x800235EB Val_Wu8 29.00 DFES_OneToOne 0.00 29.00 EXTENDED_LIMITS 0.00 255.0 /end CHARACTERISTIC
/begin CHARACTERISTIC DFES_Cls.DFC_ThrVlvOL_C "DFES/Fehlerklasse für Prüfung DFC_ThrVlvOL" VALUE 0x800235EC Val_Wu8 29.00 DFES_OneToOne 0.00 29.00 EXTENDED_LIMITS 0.00 255.0 /end CHARACTERISTIC
/begin CHARACTERISTIC DFES_Cls.DFC_ThrVlvOvrTemp_C "DFES/Fehlerklasse für Prüfung DFC_ThrVlvOvrTemp" VALUE 0x800235ED Val_Wu8 29.00 DFES_OneToOne 0.00 29.00 EXTENDED_LIMITS 0.00 255.0 /end CHARACTERISTIC
/begin CHARACTERISTIC DFES_Cls.DFC_ThrVlvSCB_C "DFES/Fehlerklasse für Prüfung DFC_ThrVlvSCB" VALUE 0x800235EE Val_Wu8 29.00 DFES_OneToOne 0.00 29.00 EXTENDED_LIMITS 0.00 255.0 /end CHARACTERISTIC
/begin CHARACTERISTIC DFES_Cls.DFC_TrbChOL_C "DFES/Fehlerklasse für Prüfung DFC_TrbChOL" VALUE 0x800235EF Val_Wu8 29.00 DFES_OneToOne 0.00 29.00 EXTENDED_LIMITS 0.00 255.0 /end CHARACTERISTIC
/begin CHARACTERISTIC DFES_Cls.DFC_TrbChOvrTemp_C "DFES/Fehlerklasse für Prüfung DFC_TrbChOvrTemp" VALUE 0x800235F0 Val_Wu8 29.00 DFES_OneToOne 0.00 29.00 EXTENDED_LIMITS 0.00 255.0 /end CHARACTERISTIC
/begin CHARACTERISTIC DFES_Cls.DFC_TrbChSCB_C "DFES/Fehlerklasse für Prüfung DFC_TrbChSCB" VALUE 0x800235F1 Val_Wu8 29.00 DFES_OneToOne 0.00 29.00 EXTENDED_LIMITS 0.00 255.0 /end CHARACTERISTIC
/begin CHARACTERISTIC DFES_Cls.DFC_UDosVlvOL_C "DFES/Fehlerklasse für Prüfung DFC_UDosVlvOL" VALUE 0x800235F2 Val_Wu8 29.00 DFES_OneToOne 0.00 29.00 EXTENDED_LIMITS 0.00 255.0 /end CHARACTERISTIC
/begin CHARACTERISTIC DFES_Cls.DFC_UDosVlvOvrTemp_C "DFES/Fehlerklasse für Prüfung DFC_UDosVlvOvrTemp" VALUE 0x800235F3 Val_Wu8 29.00 DFES_OneToOne 0.00 29.00 EXTENDED_LIMITS 0.00 255.0 /end CHARACTERISTIC
/begin CHARACTERISTIC DFES_Cls.DFC_UDosVlvSCB_C "DFES/Fehlerklasse für Prüfung DFC_UDosVlvSCB" VALUE 0x800235F4 Val_Wu8 29.00 DFES_OneToOne 0.00 29.00 EXTENDED_LIMITS 0.00 255.0 /end CHARACTERISTIC
/begin CHARACTERISTIC DFES_Cls.DFC_UDosVlvSCG_C "DFES/Fehlerklasse für Prüfung DFC_UDosVlvSCG" VALUE 0x800235F5 Val_Wu8 29.00 DFES_OneToOne 0.00 29.00 EXTENDED_LIMITS 0.00 255.0 /end CHARACTERISTIC
/begin CHARACTERISTIC DFES_Cls.DFC_UPmpMotOL_C "DFES/Fehlerklasse für Prüfung DFC_UPmpMotOL" VALUE 0x800235F6 Val_Wu8 29.00 DFES_OneToOne 0.00 29.00 EXTENDED_LIMITS 0.00 255.0 /end CHARACTERISTIC
/begin CHARACTERISTIC DFES_Cls.DFC_UPmpMotOvrTemp_C "DFES/Fehlerklasse für Prüfung DFC_UPmpMotOvrTemp" VALUE 0x800235F7 Val_Wu8 29.00 DFES_OneToOne 0.00 29.00 EXTENDED_LIMITS 0.00 255.0 /end CHARACTERISTIC
/begin CHARACTERISTIC DFES_Cls.DFC_UPmpMotSCB_C "DFES/Fehlerklasse für Prüfung DFC_UPmpMotSCB" VALUE 0x800235F8 Val_Wu8 29.00 DFES_OneToOne 0.00 29.00 EXTENDED_LIMITS 0.00 255.0 /end CHARACTERISTIC
/begin CHARACTERISTIC DFES_Cls.DFC_UPmpMotSCG_C "DFES/Fehlerklasse für Prüfung DFC_UPmpMotSCG" VALUE 0x800235F9 Val_Wu8 29.00 DFES_OneToOne 0.00 29.00 EXTENDED_LIMITS 0.00 255.0 /end CHARACTERISTIC
/begin CHARACTERISTIC DFES_Cls.DFC_WaHtElOL_C "DFES/Fehlerklasse für Prüfung DFC_WaHtElOL" VALUE 0x800235FA Val_Wu8 29.00 DFES_OneToOne 0.00 29.00 EXTENDED_LIMITS 0.00 255.0 /end CHARACTERISTIC
/begin CHARACTERISTIC DFES_Cls.DFC_WaHtElOvrTemp_C "DFES/Fehlerklasse für Prüfung DFC_WaHtElOvrTemp" VALUE 0x800235FB Val_Wu8 29.00 DFES_OneToOne 0.00 29.00 EXTENDED_LIMITS 0.00 255.0 /end CHARACTERISTIC
/begin CHARACTERISTIC DFES_Cls.DFC_WaHtElSCB_C "DFES/Fehlerklasse für Prüfung DFC_WaHtElSCB" VALUE 0x800235FC Val_Wu8 29.00 DFES_OneToOne 0.00 29.00 EXTENDED_LIMITS 0.00 255.0 /end CHARACTERISTIC
/begin CHARACTERISTIC DFES_Cls.DFC_IVActrUChSRCMax_C "DFES/Fehlerklasse für Prüfung DFC_IVActrUChSRCMax" VALUE 0x800235FD Val_Wu8 29.00 DFES_OneToOne 0.00 29.00 EXTENDED_LIMITS 0.00 255.0 /end CHARACTERISTIC
/begin CHARACTERISTIC DFES_Cls.DFC_IVActrUChSRCMin_C "DFES/Fehlerklasse für Prüfung DFC_IVActrUChSRCMin" VALUE 0x800235FE Val_Wu8 29.00 DFES_OneToOne 0.00 29.00 EXTENDED_LIMITS 0.00 255.0 /end CHARACTERISTIC
/begin CHARACTERISTIC DFES_Cls.DFC_IVActrVltgSRCMax_C "DFES/Fehlerklasse für Prüfung DFC_IVActrVltgSRCMax" VALUE 0x800235FF Val_Wu8 29.00 DFES_OneToOne 0.00 29.00 EXTENDED_LIMITS 0.00 255.0 /end CHARACTERISTIC
/begin CHARACTERISTIC DFES_Cls.DFC_IVActrVltgSRCMin_C "DFES/Fehlerklasse für Prüfung DFC_IVActrVltgSRCMin" VALUE 0x80023600 Val_Wu8 29.00 DFES_OneToOne 0.00 29.00 EXTENDED_LIMITS 0.00 255.0 /end CHARACTERISTIC
/begin CHARACTERISTIC DFES_Cls.DFC_IVDiaTunDet_C "DFES/Fehlerklasse für Prüfung DFC_IVDiaTunDet" VALUE 0x80023601 Val_Wu8 29.00 DFES_OneToOne 0.00 29.00 EXTENDED_LIMITS 0.00 255.0 /end CHARACTERISTIC
/begin CHARACTERISTIC DFES_Cls.DFC_IVPSplyStopDCDC_C "DFES/Fehlerklasse für Prüfung DFC_IVPSplyStopDCDC" VALUE 0x80023602 Val_Wu8 29.00 DFES_OneToOne 0.00 29.00 EXTENDED_LIMITS 0.00 255.0 /end CHARACTERISTIC
/begin CHARACTERISTIC DFES_Cls.DFC_IVPSplyVltgSRCMax_C "DFES/Fehlerklasse für Prüfung DFC_IVPSplyVltgSRCMax" VALUE 0x80023603 Val_Wu8 29.00 DFES_OneToOne 0.00 29.00 EXTENDED_LIMITS 0.00 255.0 /end CHARACTERISTIC
/begin CHARACTERISTIC DFES_Cls.DFC_IVPSplyVltgSRCMin_C "DFES/Fehlerklasse für Prüfung DFC_IVPSplyVltgSRCMin" VALUE 0x80023604 Val_Wu8 29.00 DFES_OneToOne 0.00 29.00 EXTENDED_LIMITS 0.00 255.0 /end CHARACTERISTIC
/begin CHARACTERISTIC DFES_Cls.DFC_SCREtaErr_C "DFES/Fehlerklasse für Prüfung DFC_SCREtaErr" VALUE 0x80023605 Val_Wu8 29.00 DFES_OneToOne 0.00 29.00 EXTENDED_LIMITS 0.00 255.0 /end CHARACTERISTIC
/begin CHARACTERISTIC DFES_Cls.DFC_SCREtaErr1_C "DFES/Fehlerklasse für Prüfung DFC_SCREtaErr1" VALUE 0x80023606 Val_Wu8 29.00 DFES_OneToOne 0.00 29.00 EXTENDED_LIMITS 0.00 255.0 /end CHARACTERISTIC
/begin CHARACTERISTIC DFES_Cls.DFC_SCREtaErr2_C "DFES/Fehlerklasse für Prüfung DFC_SCREtaErr2" VALUE 0x80023607 Val_Wu8 29.00 DFES_OneToOne 0.00 29.00 EXTENDED_LIMITS 0.00 255.0 /end CHARACTERISTIC
/begin CHARACTERISTIC DFES_Cls.DFC_SCRMonMetCtlPresErr_C "DFES/Fehlerklasse für Prüfung DFC_SCRMonMetCtlPresErr" VALUE 0x80023608 Val_Wu8 29.00 DFES_OneToOne 0.00 29.00 EXTENDED_LIMITS 0.00 255.0 /end CHARACTERISTIC
/begin CHARACTERISTIC DFES_Cls.DFC_SCRMonPresBuildUpErr_C "DFES/Fehlerklasse für Prüfung DFC_SCRMonPresBuildUpErr" VALUE 0x80023609 Val_Wu8 29.00 DFES_OneToOne 0.00 29.00 EXTENDED_LIMITS 0.00 255.0 /end CHARACTERISTIC
/begin CHARACTERISTIC DFES_Cls.DFC_SCRMonPresRdcErr_C "DFES/Fehlerklasse für Prüfung DFC_SCRMonPresRdcErr" VALUE 0x8002360A Val_Wu8 29.00 DFES_OneToOne 0.00 29.00 EXTENDED_LIMITS 0.00 255.0 /end CHARACTERISTIC
/begin CHARACTERISTIC DFES_Cls.DFC_AFSOffsDrftMax_C "DFES/Fehlerklasse für Prüfung DFC_AFSOffsDrftMax" VALUE 0x8002360B Val_Wu8 29.00 DFES_OneToOne 0.00 29.00 EXTENDED_LIMITS 0.00 255.0 /end CHARACTERISTIC
/begin CHARACTERISTIC DFES_Cls.DFC_AFSOffsDrftMin_C "DFES/Fehlerklasse für Prüfung DFC_AFSOffsDrftMin" VALUE 0x8002360C Val_Wu8 29.00 DFES_OneToOne 0.00 29.00 EXTENDED_LIMITS 0.00 255.0 /end CHARACTERISTIC
/begin CHARACTERISTIC DFES_Cls.DFC_AFSSRCCorMax_C "DFES/Fehlerklasse für Prüfung DFC_AFSSRCCorMax" VALUE 0x8002360D Val_Wu8 29.00 DFES_OneToOne 0.00 29.00 EXTENDED_LIMITS 0.00 255.0 /end CHARACTERISTIC
/begin CHARACTERISTIC DFES_Cls.DFC_AFSSRCCorMin_C "DFES/Fehlerklasse für Prüfung DFC_AFSSRCCorMin" VALUE 0x8002360E Val_Wu8 29.00 DFES_OneToOne 0.00 29.00 EXTENDED_LIMITS 0.00 255.0 /end CHARACTERISTIC
/begin CHARACTERISTIC DFES_Cls.DFC_AFSSRCRawMax_C "DFES/Fehlerklasse für Prüfung DFC_AFSSRCRawMax" VALUE 0x8002360F Val_Wu8 29.00 DFES_OneToOne 0.00 29.00 EXTENDED_LIMITS 0.00 255.0 /end CHARACTERISTIC
/begin CHARACTERISTIC DFES_Cls.DFC_AFSSRCRawMin_C "DFES/Fehlerklasse für Prüfung DFC_AFSSRCRawMin" VALUE 0x80023610 Val_Wu8 29.00 DFES_OneToOne 0.00 29.00 EXTENDED_LIMITS 0.00 255.0 /end CHARACTERISTIC
/begin CHARACTERISTIC DFES_Cls.DFC_AFSSetyDrftMax_C "DFES/Fehlerklasse für Prüfung DFC_AFSSetyDrftMax" VALUE 0x80023611 Val_Wu8 29.00 DFES_OneToOne 0.00 29.00 EXTENDED_LIMITS 0.00 255.0 /end CHARACTERISTIC
/begin CHARACTERISTIC DFES_Cls.DFC_AFSSetyDrftMin_C "DFES/Fehlerklasse für Prüfung DFC_AFSSetyDrftMin" VALUE 0x80023612 Val_Wu8 29.00 DFES_OneToOne 0.00 29.00 EXTENDED_LIMITS 0.00 255.0 /end CHARACTERISTIC
/begin CHARACTERISTIC DFES_Cls.DFC_AirCSwtNpl_C "DFES/Fehlerklasse für Prüfung DFC_AirCSwtNpl" VALUE 0x80023613 Val_Wu8 29.00 DFES_OneToOne 0.00 29.00 EXTENDED_LIMITS 0.00 255.0 /end CHARACTERISTIC
/begin CHARACTERISTIC DFES_Cls.DFC_AirCSwtSig_C "DFES/Fehlerklasse für Prüfung DFC_AirCSwtSig" VALUE 0x80023614 Val_Wu8 29.00 DFES_OneToOne 0.00 29.00 EXTENDED_LIMITS 0.00 255.0 /end CHARACTERISTIC
/begin CHARACTERISTIC DFES_Cls.DFC_BattUSRCMax_C "DFES/Fehlerklasse für Prüfung DFC_BattUSRCMax" VALUE 0x80023615 Val_Wu8 29.00 DFES_OneToOne 0.00 29.00 EXTENDED_LIMITS 0.00 255.0 /end CHARACTERISTIC
/begin CHARACTERISTIC DFES_Cls.DFC_BattUSRCMin_C "DFES/Fehlerklasse für Prüfung DFC_BattUSRCMin" VALUE 0x80023616 Val_Wu8 29.00 DFES_OneToOne 0.00 29.00 EXTENDED_LIMITS 0.00 255.0 /end CHARACTERISTIC
/begin CHARACTERISTIC DFES_Cls.DFC_BrkNpl_C "DFES/Fehlerklasse für Prüfung DFC_BrkNpl" VALUE 0x80023617 Val_Wu8 29.00 DFES_OneToOne 0.00 29.00 EXTENDED_LIMITS 0.00 255.0 /end CHARACTERISTIC
/begin CHARACTERISTIC DFES_Cls.DFC_BrkPSRCMax_C "DFES/Fehlerklasse für Prüfung DFC_BrkPSRCMax" VALUE 0x80023618 Val_Wu8 29.00 DFES_OneToOne 0.00 29.00 EXTENDED_LIMITS 0.00 255.0 /end CHARACTERISTIC
/begin CHARACTERISTIC DFES_Cls.DFC_BrkPSRCMin_C "DFES/Fehlerklasse für Prüfung DFC_BrkPSRCMin" VALUE 0x80023619 Val_Wu8 29.00 DFES_OneToOne 0.00 29.00 EXTENDED_LIMITS 0.00 255.0 /end CHARACTERISTIC
/begin CHARACTERISTIC DFES_Cls.DFC_CEngDsTSRCMax_C "DFES/Fehlerklasse für Prüfung DFC_CEngDsTSRCMax" VALUE 0x8002361A Val_Wu8 29.00 DFES_OneToOne 0.00 29.00 EXTENDED_LIMITS 0.00 255.0 /end CHARACTERISTIC
/begin CHARACTERISTIC DFES_Cls.DFC_CEngDsTSRCMin_C "DFES/Fehlerklasse für Prüfung DFC_CEngDsTSRCMin" VALUE 0x8002361B Val_Wu8 29.00 DFES_OneToOne 0.00 29.00 EXTENDED_LIMITS 0.00 255.0 /end CHARACTERISTIC
/begin CHARACTERISTIC DFES_Cls.DFC_CrCUIDet_C "DFES/Fehlerklasse für Prüfung DFC_CrCUIDet" VALUE 0x8002361C Val_Wu8 29.00 DFES_OneToOne 0.00 29.00 EXTENDED_LIMITS 0.00 255.0 /end CHARACTERISTIC
/begin CHARACTERISTIC DFES_Cls.DFC_ECBVlvSRCMax_C "DFES/Fehlerklasse für Prüfung DFC_ECBVlvSRCMax" VALUE 0x8002361D Val_Wu8 29.00 DFES_OneToOne 0.00 29.00 EXTENDED_LIMITS 0.00 255.0 /end CHARACTERISTIC
/begin CHARACTERISTIC DFES_Cls.DFC_ECBVlvSRCMin_C "DFES/Fehlerklasse für Prüfung DFC_ECBVlvSRCMin" VALUE 0x8002361E Val_Wu8 29.00 DFES_OneToOne 0.00 29.00 EXTENDED_LIMITS 0.00 255.0 /end CHARACTERISTIC
/begin CHARACTERISTIC DFES_Cls.DFC_ECUOvrTemp_C "DFES/Fehlerklasse für Prüfung DFC_ECUOvrTemp" VALUE 0x8002361F Val_Wu8 29.00 DFES_OneToOne 0.00 29.00 EXTENDED_LIMITS 0.00 255.0 /end CHARACTERISTIC
/begin CHARACTERISTIC DFES_Cls.DFC_EGRVlvGovDvtMax_C "DFES/Fehlerklasse für Prüfung DFC_EGRVlvGovDvtMax" VALUE 0x80023620 Val_Wu8 29.00 DFES_OneToOne 0.00 29.00 EXTENDED_LIMITS 0.00 255.0 /end CHARACTERISTIC
/begin CHARACTERISTIC DFES_Cls.DFC_EGRVlvGovDvtMin_C "DFES/Fehlerklasse für Prüfung DFC_EGRVlvGovDvtMin" VALUE 0x80023621 Val_Wu8 29.00 DFES_OneToOne 0.00 29.00 EXTENDED_LIMITS 0.00 255.0 /end CHARACTERISTIC
/begin CHARACTERISTIC DFES_Cls.DFC_EGRVlvHBrgOpnLd_C "DFES/Fehlerklasse für Prüfung DFC_EGRVlvHBrgOpnLd" VALUE 0x80023622 Val_Wu8 29.00 DFES_OneToOne 0.00 29.00 EXTENDED_LIMITS 0.00 255.0 /end CHARACTERISTIC
/begin CHARACTERISTIC DFES_Cls.DFC_EGRVlvHBrgOvrCurr_C "DFES/Fehlerklasse für Prüfung DFC_EGRVlvHBrgOvrCurr" VALUE 0x80023623 Val_Wu8 29.00 DFES_OneToOne 0.00 29.00 EXTENDED_LIMITS 0.00 255.0 /end CHARACTERISTIC
/begin CHARACTERISTIC DFES_Cls.DFC_EGRVlvHBrgOvrTemp_C "DFES/Fehlerklasse für Prüfung DFC_EGRVlvHBrgOvrTemp" VALUE 0x80023624 Val_Wu8 29.00 DFES_OneToOne 0.00 29.00 EXTENDED_LIMITS 0.00 255.0 /end CHARACTERISTIC
/begin CHARACTERISTIC DFES_Cls.DFC_EGRVlvHBrgShCirBatt1_C "DFES/Fehlerklasse für Prüfung DFC_EGRVlvHBrgShCirBatt1" VALUE 0x80023625 Val_Wu8 29.00 DFES_OneToOne 0.00 29.00 EXTENDED_LIMITS 0.00 255.0 /end CHARACTERISTIC
/begin CHARACTERISTIC DFES_Cls.DFC_EGRVlvHBrgShCirBatt2_C "DFES/Fehlerklasse für Prüfung DFC_EGRVlvHBrgShCirBatt2" VALUE 0x80023626 Val_Wu8 29.00 DFES_OneToOne 0.00 29.00 EXTENDED_LIMITS 0.00 255.0 /end CHARACTERISTIC
/begin CHARACTERISTIC DFES_Cls.DFC_EGRVlvHBrgShCirGnd1_C "DFES/Fehlerklasse für Prüfung DFC_EGRVlvHBrgShCirGnd1" VALUE 0x80023627 Val_Wu8 29.00 DFES_OneToOne 0.00 29.00 EXTENDED_LIMITS 0.00 255.0 /end CHARACTERISTIC
/begin CHARACTERISTIC DFES_Cls.DFC_EGRVlvHBrgShCirGnd2_C "DFES/Fehlerklasse für Prüfung DFC_EGRVlvHBrgShCirGnd2" VALUE 0x80023628 Val_Wu8 29.00 DFES_OneToOne 0.00 29.00 EXTENDED_LIMITS 0.00 255.0 /end CHARACTERISTIC
/begin CHARACTERISTIC DFES_Cls.DFC_EGRVlvHBrgShCirOvrLd_C "DFES/Fehlerklasse für Prüfung DFC_EGRVlvHBrgShCirOvrLd" VALUE 0x80023629 Val_Wu8 29.00 DFES_OneToOne 0.00 29.00 EXTENDED_LIMITS 0.00 255.0 /end CHARACTERISTIC
/begin CHARACTERISTIC DFES_Cls.DFC_EGRVlvHBrgTempOvrCurr_C "DFES/Fehlerklasse für Prüfung DFC_EGRVlvHBrgTempOvrCurr" VALUE 0x8002362A Val_Wu8 29.00 DFES_OneToOne 0.00 29.00 EXTENDED_LIMITS 0.00 255.0 /end CHARACTERISTIC
/begin CHARACTERISTIC DFES_Cls.DFC_EGRVlvHBrgUndrVltg_C "DFES/Fehlerklasse für Prüfung DFC_EGRVlvHBrgUndrVltg" VALUE 0x8002362B Val_Wu8 29.00 DFES_OneToOne 0.00 29.00 EXTENDED_LIMITS 0.00 255.0 /end CHARACTERISTIC
/begin CHARACTERISTIC DFES_Cls.DFC_EGRVlvLPGovDvtMax_C "DFES/Fehlerklasse für Prüfung DFC_EGRVlvLPGovDvtMax" VALUE 0x8002362C Val_Wu8 29.00 DFES_OneToOne 0.00 29.00 EXTENDED_LIMITS 0.00 255.0 /end CHARACTERISTIC
/begin CHARACTERISTIC DFES_Cls.DFC_EGRVlvLPGovDvtMin_C "DFES/Fehlerklasse für Prüfung DFC_EGRVlvLPGovDvtMin" VALUE 0x8002362D Val_Wu8 29.00 DFES_OneToOne 0.00 29.00 EXTENDED_LIMITS 0.00 255.0 /end CHARACTERISTIC
/begin CHARACTERISTIC DFES_Cls.DFC_EGRVlvLPHBrgOpnLd_C "DFES/Fehlerklasse für Prüfung DFC_EGRVlvLPHBrgOpnLd" VALUE 0x8002362E Val_Wu8 29.00 DFES_OneToOne 0.00 29.00 EXTENDED_LIMITS 0.00 255.0 /end CHARACTERISTIC
/begin CHARACTERISTIC DFES_Cls.DFC_EGRVlvLPHBrgOvrCurr_C "DFES/Fehlerklasse für Prüfung DFC_EGRVlvLPHBrgOvrCurr" VALUE 0x8002362F Val_Wu8 29.00 DFES_OneToOne 0.00 29.00 EXTENDED_LIMITS 0.00 255.0 /end CHARACTERISTIC
/begin CHARACTERISTIC DFES_Cls.DFC_EGRVlvLPHBrgOvrTemp_C "DFES/Fehlerklasse für Prüfung DFC_EGRVlvLPHBrgOvrTemp" VALUE 0x80023630 Val_Wu8 29.00 DFES_OneToOne 0.00 29.00 EXTENDED_LIMITS 0.00 255.0 /end CHARACTERISTIC
/begin CHARACTERISTIC DFES_Cls.DFC_EGRVlvLPHBrgShCirBatt1_C "DFES/Fehlerklasse für Prüfung DFC_EGRVlvLPHBrgShCirBatt1" VALUE 0x80023631 Val_Wu8 29.00 DFES_OneToOne 0.00 29.00 EXTENDED_LIMITS 0.00 255.0 /end CHARACTERISTIC
/begin CHARACTERISTIC DFES_Cls.DFC_EGRVlvLPHBrgShCirBatt2_C "DFES/Fehlerklasse für Prüfung DFC_EGRVlvLPHBrgShCirBatt2" VALUE 0x80023632 Val_Wu8 29.00 DFES_OneToOne 0.00 29.00 EXTENDED_LIMITS 0.00 255.0 /end CHARACTERISTIC
/begin CHARACTERISTIC DFES_Cls.DFC_EGRVlvLPHBrgShCirGnd1_C "DFES/Fehlerklasse für Prüfung DFC_EGRVlvLPHBrgShCirGnd1" VALUE 0x80023633 Val_Wu8 29.00 DFES_OneToOne 0.00 29.00 EXTENDED_LIMITS 0.00 255.0 /end CHARACTERISTIC
/begin CHARACTERISTIC DFES_Cls.DFC_EGRVlvLPHBrgShCirGnd2_C "DFES/Fehlerklasse für Prüfung DFC_EGRVlvLPHBrgShCirGnd2" VALUE 0x80023634 Val_Wu8 29.00 DFES_OneToOne 0.00 29.00 EXTENDED_LIMITS 0.00 255.0 /end CHARACTERISTIC
/begin CHARACTERISTIC DFES_Cls.DFC_EGRVlvLPHBrgShCirOvrLd_C "DFES/Fehlerklasse für Prüfung DFC_EGRVlvLPHBrgShCirOvrLd" VALUE 0x80023635 Val_Wu8 29.00 DFES_OneToOne 0.00 29.00 EXTENDED_LIMITS 0.00 255.0 /end CHARACTERISTIC
/begin CHARACTERISTIC DFES_Cls.DFC_EGRVlvLPHBrgTempOvrCurr_C "DFES/Fehlerklasse für Prüfung DFC_EGRVlvLPHBrgTempOvrCurr" VALUE 0x80023636 Val_Wu8 29.00 DFES_OneToOne 0.00 29.00 EXTENDED_LIMITS 0.00 255.0 /end CHARACTERISTIC
/begin CHARACTERISTIC DFES_Cls.DFC_EGRVlvLPHBrgUndrVltg_C "DFES/Fehlerklasse für Prüfung DFC_EGRVlvLPHBrgUndrVltg" VALUE 0x80023637 Val_Wu8 29.00 DFES_OneToOne 0.00 29.00 EXTENDED_LIMITS 0.00 255.0 /end CHARACTERISTIC
/begin CHARACTERISTIC DFES_Cls.DFC_EGRVlvLPOL_C "DFES/Fehlerklasse für Prüfung DFC_EGRVlvLPOL" VALUE 0x80023638 Val_Wu8 29.00 DFES_OneToOne 0.00 29.00 EXTENDED_LIMITS 0.00 255.0 /end CHARACTERISTIC
/begin CHARACTERISTIC DFES_Cls.DFC_EGRVlvLPSCB_C "DFES/Fehlerklasse für Prüfung DFC_EGRVlvLPSCB" VALUE 0x80023639 Val_Wu8 29.00 DFES_OneToOne 0.00 29.00 EXTENDED_LIMITS 0.00 255.0 /end CHARACTERISTIC
/begin CHARACTERISTIC DFES_Cls.DFC_EGRVlvLPSCG_C "DFES/Fehlerklasse für Prüfung DFC_EGRVlvLPSCG" VALUE 0x8002363A Val_Wu8 29.00 DFES_OneToOne 0.00 29.00 EXTENDED_LIMITS 0.00 255.0 /end CHARACTERISTIC
/begin CHARACTERISTIC DFES_Cls.DFC_EGRVlvLPSRCMax_C "DFES/Fehlerklasse für Prüfung DFC_EGRVlvLPSRCMax" VALUE 0x8002363B Val_Wu8 29.00 DFES_OneToOne 0.00 29.00 EXTENDED_LIMITS 0.00 255.0 /end CHARACTERISTIC
/begin CHARACTERISTIC DFES_Cls.DFC_EGRVlvLPSRCMin_C "DFES/Fehlerklasse für Prüfung DFC_EGRVlvLPSRCMin" VALUE 0x8002363C Val_Wu8 29.00 DFES_OneToOne 0.00 29.00 EXTENDED_LIMITS 0.00 255.0 /end CHARACTERISTIC
/begin CHARACTERISTIC DFES_Cls.DFC_EGRVlvOL_C "DFES/Fehlerklasse für Prüfung DFC_EGRVlvOL" VALUE 0x8002363D Val_Wu8 29.00 DFES_OneToOne 0.00 29.00 EXTENDED_LIMITS 0.00 255.0 /end CHARACTERISTIC
/begin CHARACTERISTIC DFES_Cls.DFC_EGRVlvSCB_C "DFES/Fehlerklasse für Prüfung DFC_EGRVlvSCB" VALUE 0x8002363E Val_Wu8 29.00 DFES_OneToOne 0.00 29.00 EXTENDED_LIMITS 0.00 255.0 /end CHARACTERISTIC
/begin CHARACTERISTIC DFES_Cls.DFC_EGRVlvSCG_C "DFES/Fehlerklasse für Prüfung DFC_EGRVlvSCG" VALUE 0x8002363F Val_Wu8 29.00 DFES_OneToOne 0.00 29.00 EXTENDED_LIMITS 0.00 255.0 /end CHARACTERISTIC
/begin CHARACTERISTIC DFES_Cls.DFC_EGRVlvSRCMax_C "DFES/Fehlerklasse für Prüfung DFC_EGRVlvSRCMax" VALUE 0x80023640 Val_Wu8 29.00 DFES_OneToOne 0.00 29.00 EXTENDED_LIMITS 0.00 255.0 /end CHARACTERISTIC
/begin CHARACTERISTIC DFES_Cls.DFC_EGRVlvSRCMin_C "DFES/Fehlerklasse für Prüfung DFC_EGRVlvSRCMin" VALUE 0x80023641 Val_Wu8 29.00 DFES_OneToOne 0.00 29.00 EXTENDED_LIMITS 0.00 255.0 /end CHARACTERISTIC
/begin CHARACTERISTIC DFES_Cls.DFC_EngPrtOvrSpd_C "DFES/Fehlerklasse für Prüfung DFC_EngPrtOvrSpd" VALUE 0x80023642 Val_Wu8 29.00 DFES_OneToOne 0.00 29.00 EXTENDED_LIMITS 0.00 255.0 /end CHARACTERISTIC
/begin CHARACTERISTIC DFES_Cls.DFC_EngSpdOL_C "DFES/Fehlerklasse für Prüfung DFC_EngSpdOL" VALUE 0x80023643 Val_Wu8 29.00 DFES_OneToOne 0.00 29.00 EXTENDED_LIMITS 0.00 255.0 /end CHARACTERISTIC
/begin CHARACTERISTIC DFES_Cls.DFC_EngSpdSCB_C "DFES/Fehlerklasse für Prüfung DFC_EngSpdSCB" VALUE 0x80023644 Val_Wu8 29.00 DFES_OneToOne 0.00 29.00 EXTENDED_LIMITS 0.00 255.0 /end CHARACTERISTIC
/begin CHARACTERISTIC DFES_Cls.DFC_EngSpdSCG_C "DFES/Fehlerklasse für Prüfung DFC_EngSpdSCG" VALUE 0x80023645 Val_Wu8 29.00 DFES_OneToOne 0.00 29.00 EXTENDED_LIMITS 0.00 255.0 /end CHARACTERISTIC
/begin CHARACTERISTIC DFES_Cls.DFC_EnhSRCMaxPPFltDiff_C "DFES/Fehlerklasse für Prüfung DFC_EnhSRCMaxPPFltDiff" VALUE 0x80023646 Val_Wu8 29.00 DFES_OneToOne 0.00 29.00 EXTENDED_LIMITS 0.00 255.0 /end CHARACTERISTIC
/begin CHARACTERISTIC DFES_Cls.DFC_EnhSRCMaxT1ExhTMon_C "DFES/Fehlerklasse für Prüfung DFC_EnhSRCMaxT1ExhTMon" VALUE 0x80023647 Val_Wu8 29.00 DFES_OneToOne 0.00 29.00 EXTENDED_LIMITS 0.00 255.0 /end CHARACTERISTIC
/begin CHARACTERISTIC DFES_Cls.DFC_EnhSRCMaxT2ExhTMon_C "DFES/Fehlerklasse für Prüfung DFC_EnhSRCMaxT2ExhTMon" VALUE 0x80023648 Val_Wu8 29.00 DFES_OneToOne 0.00 29.00 EXTENDED_LIMITS 0.00 255.0 /end CHARACTERISTIC
/begin CHARACTERISTIC DFES_Cls.DFC_EnhSRCMaxT3ExhTMon_C "DFES/Fehlerklasse für Prüfung DFC_EnhSRCMaxT3ExhTMon" VALUE 0x80023649 Val_Wu8 29.00 DFES_OneToOne 0.00 29.00 EXTENDED_LIMITS 0.00 255.0 /end CHARACTERISTIC
/begin CHARACTERISTIC DFES_Cls.DFC_EnhSRCMinPPFltDiff_C "DFES/Fehlerklasse für Prüfung DFC_EnhSRCMinPPFltDiff" VALUE 0x8002364A Val_Wu8 29.00 DFES_OneToOne 0.00 29.00 EXTENDED_LIMITS 0.00 255.0 /end CHARACTERISTIC
/begin CHARACTERISTIC DFES_Cls.DFC_EnhSRCMinT1ExhTMon_C "DFES/Fehlerklasse für Prüfung DFC_EnhSRCMinT1ExhTMon" VALUE 0x8002364B Val_Wu8 29.00 DFES_OneToOne 0.00 29.00 EXTENDED_LIMITS 0.00 255.0 /end CHARACTERISTIC
/begin CHARACTERISTIC DFES_Cls.DFC_EnhSRCMinT2ExhTMon_C "DFES/Fehlerklasse für Prüfung DFC_EnhSRCMinT2ExhTMon" VALUE 0x8002364C Val_Wu8 29.00 DFES_OneToOne 0.00 29.00 EXTENDED_LIMITS 0.00 255.0 /end CHARACTERISTIC
/begin CHARACTERISTIC DFES_Cls.DFC_EnhSRCMinT3ExhTMon_C "DFES/Fehlerklasse für Prüfung DFC_EnhSRCMinT3ExhTMon" VALUE 0x8002364D Val_Wu8 29.00 DFES_OneToOne 0.00 29.00 EXTENDED_LIMITS 0.00 255.0 /end CHARACTERISTIC
/begin CHARACTERISTIC DFES_Cls.DFC_EnvPSRCMax_C "DFES/Fehlerklasse für Prüfung DFC_EnvPSRCMax" VALUE 0x8002364E Val_Wu8 29.00 DFES_OneToOne 0.00 29.00 EXTENDED_LIMITS 0.00 255.0 /end CHARACTERISTIC
/begin CHARACTERISTIC DFES_Cls.DFC_EnvPSRCMin_C "DFES/Fehlerklasse für Prüfung DFC_EnvPSRCMin" VALUE 0x8002364F Val_Wu8 29.00 DFES_OneToOne 0.00 29.00 EXTENDED_LIMITS 0.00 255.0 /end CHARACTERISTIC
/begin CHARACTERISTIC DFES_Cls.DFC_ExhTMonPlaus_C "DFES/Fehlerklasse für Prüfung DFC_ExhTMonPlaus" VALUE 0x80023650 Val_Wu8 29.00 DFES_OneToOne 0.00 29.00 EXTENDED_LIMITS 0.00 255.0 /end CHARACTERISTIC
/begin CHARACTERISTIC DFES_Cls.DFC_ExhTMonPlausPos1_C "DFES/Fehlerklasse für Prüfung DFC_ExhTMonPlausPos1" VALUE 0x80023651 Val_Wu8 29.00 DFES_OneToOne 0.00 29.00 EXTENDED_LIMITS 0.00 255.0 /end CHARACTERISTIC
/begin CHARACTERISTIC DFES_Cls.DFC_ExhTMonPlausPos2_C "DFES/Fehlerklasse für Prüfung DFC_ExhTMonPlausPos2" VALUE 0x80023652 Val_Wu8 29.00 DFES_OneToOne 0.00 29.00 EXTENDED_LIMITS 0.00 255.0 /end CHARACTERISTIC
/begin CHARACTERISTIC DFES_Cls.DFC_ExhTMonPlausPos3_C "DFES/Fehlerklasse für Prüfung DFC_ExhTMonPlausPos3" VALUE 0x80023653 Val_Wu8 29.00 DFES_OneToOne 0.00 29.00 EXTENDED_LIMITS 0.00 255.0 /end CHARACTERISTIC
/begin CHARACTERISTIC DFES_Cls.DFC_ExhTMonT1Plaus_C "DFES/Fehlerklasse für Prüfung DFC_ExhTMonT1Plaus" VALUE 0x80023654 Val_Wu8 29.00 DFES_OneToOne 0.00 29.00 EXTENDED_LIMITS 0.00 255.0 /end CHARACTERISTIC
/begin CHARACTERISTIC DFES_Cls.DFC_ExhTMonT2Plaus_C "DFES/Fehlerklasse für Prüfung DFC_ExhTMonT2Plaus" VALUE 0x80023655 Val_Wu8 29.00 DFES_OneToOne 0.00 29.00 EXTENDED_LIMITS 0.00 255.0 /end CHARACTERISTIC
/begin CHARACTERISTIC DFES_Cls.DFC_ExhTMonT3Plaus_C "DFES/Fehlerklasse für Prüfung DFC_ExhTMonT3Plaus" VALUE 0x80023656 Val_Wu8 29.00 DFES_OneToOne 0.00 29.00 EXTENDED_LIMITS 0.00 255.0 /end CHARACTERISTIC
/begin CHARACTERISTIC DFES_Cls.DFC_FlFltDsPSRCMax_C "DFES/Fehlerklasse für Prüfung DFC_FlFltDsPSRCMax" VALUE 0x80023657 Val_Wu8 29.00 DFES_OneToOne 0.00 29.00 EXTENDED_LIMITS 0.00 255.0 /end CHARACTERISTIC
/begin CHARACTERISTIC DFES_Cls.DFC_FlFltDsPSRCMin_C "DFES/Fehlerklasse für Prüfung DFC_FlFltDsPSRCMin" VALUE 0x80023658 Val_Wu8 29.00 DFES_OneToOne 0.00 29.00 EXTENDED_LIMITS 0.00 255.0 /end CHARACTERISTIC
/begin CHARACTERISTIC DFES_Cls.DFC_FlFltSig_C "DFES/Fehlerklasse für Prüfung DFC_FlFltSig" VALUE 0x80023659 Val_Wu8 29.00 DFES_OneToOne 0.00 29.00 EXTENDED_LIMITS 0.00 255.0 /end CHARACTERISTIC
/begin CHARACTERISTIC DFES_Cls.DFC_FlFltUsPSRCMax_C "DFES/Fehlerklasse für Prüfung DFC_FlFltUsPSRCMax" VALUE 0x8002365A Val_Wu8 29.00 DFES_OneToOne 0.00 29.00 EXTENDED_LIMITS 0.00 255.0 /end CHARACTERISTIC
/begin CHARACTERISTIC DFES_Cls.DFC_FlFltUsPSRCMin_C "DFES/Fehlerklasse für Prüfung DFC_FlFltUsPSRCMin" VALUE 0x8002365B Val_Wu8 29.00 DFES_OneToOne 0.00 29.00 EXTENDED_LIMITS 0.00 255.0 /end CHARACTERISTIC
/begin CHARACTERISTIC DFES_Cls.DFC_FuelTSRCMax_C "DFES/Fehlerklasse für Prüfung DFC_FuelTSRCMax" VALUE 0x8002365C Val_Wu8 29.00 DFES_OneToOne 0.00 29.00 EXTENDED_LIMITS 0.00 255.0 /end CHARACTERISTIC
/begin CHARACTERISTIC DFES_Cls.DFC_FuelTSRCMin_C "DFES/Fehlerklasse für Prüfung DFC_FuelTSRCMin" VALUE 0x8002365D Val_Wu8 29.00 DFES_OneToOne 0.00 29.00 EXTENDED_LIMITS 0.00 255.0 /end CHARACTERISTIC
/begin CHARACTERISTIC DFES_Cls.DFC_GbxNPosPPerSRCMax_C "DFES/Fehlerklasse für Prüfung DFC_GbxNPosPPerSRCMax" VALUE 0x8002365E Val_Wu8 29.00 DFES_OneToOne 0.00 29.00 EXTENDED_LIMITS 0.00 255.0 /end CHARACTERISTIC
/begin CHARACTERISTIC DFES_Cls.DFC_GbxNPosPPerSRCMin_C "DFES/Fehlerklasse für Prüfung DFC_GbxNPosPPerSRCMin" VALUE 0x8002365F Val_Wu8 29.00 DFES_OneToOne 0.00 29.00 EXTENDED_LIMITS 0.00 255.0 /end CHARACTERISTIC
/begin CHARACTERISTIC DFES_Cls.DFC_GbxNPosPdcycSRCMax_C "DFES/Fehlerklasse für Prüfung DFC_GbxNPosPdcycSRCMax" VALUE 0x80023660 Val_Wu8 29.00 DFES_OneToOne 0.00 29.00 EXTENDED_LIMITS 0.00 255.0 /end CHARACTERISTIC
/begin CHARACTERISTIC DFES_Cls.DFC_GbxNPosPdcycSRCMin_C "DFES/Fehlerklasse für Prüfung DFC_GbxNPosPdcycSRCMin" VALUE 0x80023661 Val_Wu8 29.00 DFES_OneToOne 0.00 29.00 EXTENDED_LIMITS 0.00 255.0 /end CHARACTERISTIC
/begin CHARACTERISTIC DFES_Cls.DFC_InjVlvPresMin_C "DFES/Fehlerklasse für Prüfung DFC_InjVlvPresMin" VALUE 0x80023662 Val_Wu8 29.00 DFES_OneToOne 0.00 29.00 EXTENDED_LIMITS 0.00 255.0 /end CHARACTERISTIC
/begin CHARACTERISTIC DFES_Cls.DFC_LSUCircNernstSig_C "DFES/Fehlerklasse für Prüfung DFC_LSUCircNernstSig" VALUE 0x80023663 Val_Wu8 29.00 DFES_OneToOne 0.00 29.00 EXTENDED_LIMITS 0.00 255.0 /end CHARACTERISTIC
/begin CHARACTERISTIC DFES_Cls.DFC_LSUCircPmpCurSig_C "DFES/Fehlerklasse für Prüfung DFC_LSUCircPmpCurSig" VALUE 0x80023664 Val_Wu8 29.00 DFES_OneToOne 0.00 29.00 EXTENDED_LIMITS 0.00 255.0 /end CHARACTERISTIC
/begin CHARACTERISTIC DFES_Cls.DFC_LSUCircVirtGndSig_C "DFES/Fehlerklasse für Prüfung DFC_LSUCircVirtGndSig" VALUE 0x80023665 Val_Wu8 29.00 DFES_OneToOne 0.00 29.00 EXTENDED_LIMITS 0.00 255.0 /end CHARACTERISTIC
/begin CHARACTERISTIC DFES_Cls.DFC_LSUO2Max_C "DFES/Fehlerklasse für Prüfung DFC_LSUO2Max" VALUE 0x80023666 Val_Wu8 29.00 DFES_OneToOne 0.00 29.00 EXTENDED_LIMITS 0.00 255.0 /end CHARACTERISTIC
/begin CHARACTERISTIC DFES_Cls.DFC_LSUO2Min_C "DFES/Fehlerklasse für Prüfung DFC_LSUO2Min" VALUE 0x80023667 Val_Wu8 29.00 DFES_OneToOne 0.00 29.00 EXTENDED_LIMITS 0.00 255.0 /end CHARACTERISTIC
/begin CHARACTERISTIC DFES_Cls.DFC_LSUSPIBattLowMin_C "DFES/Fehlerklasse für Prüfung DFC_LSUSPIBattLowMin" VALUE 0x80023668 Val_Wu8 29.00 DFES_OneToOne 0.00 29.00 EXTENDED_LIMITS 0.00 255.0 /end CHARACTERISTIC
/begin CHARACTERISTIC DFES_Cls.DFC_LSUWireSCB_C "DFES/Fehlerklasse für Prüfung DFC_LSUWireSCB" VALUE 0x80023669 Val_Wu8 29.00 DFES_OneToOne 0.00 29.00 EXTENDED_LIMITS 0.00 255.0 /end CHARACTERISTIC
/begin CHARACTERISTIC DFES_Cls.DFC_LSUWireSCG_C "DFES/Fehlerklasse für Prüfung DFC_LSUWireSCG" VALUE 0x8002366A Val_Wu8 29.00 DFES_OneToOne 0.00 29.00 EXTENDED_LIMITS 0.00 255.0 /end CHARACTERISTIC
/begin CHARACTERISTIC DFES_Cls.DFC_MeUnSCG_C "DFES/Fehlerklasse für Prüfung DFC_MeUnSCG" VALUE 0x8002366B Val_Wu8 29.00 DFES_OneToOne 0.00 29.00 EXTENDED_LIMITS 0.00 255.0 /end CHARACTERISTIC
/begin CHARACTERISTIC DFES_Cls.DFC_NSCDsCmpChk_C "DFES/Fehlerklasse für Prüfung DFC_NSCDsCmpChk" VALUE 0x8002366C Val_Wu8 29.00 DFES_OneToOne 0.00 29.00 EXTENDED_LIMITS 0.00 255.0 /end CHARACTERISTIC
/begin CHARACTERISTIC DFES_Cls.DFC_NSCDsLamBinSRCMax_C "DFES/Fehlerklasse für Prüfung DFC_NSCDsLamBinSRCMax" VALUE 0x8002366D Val_Wu8 29.00 DFES_OneToOne 0.00 29.00 EXTENDED_LIMITS 0.00 255.0 /end CHARACTERISTIC
/begin CHARACTERISTIC DFES_Cls.DFC_NSCDsLamBinSRCMin_C "DFES/Fehlerklasse für Prüfung DFC_NSCDsLamBinSRCMin" VALUE 0x8002366E Val_Wu8 29.00 DFES_OneToOne 0.00 29.00 EXTENDED_LIMITS 0.00 255.0 /end CHARACTERISTIC
/begin CHARACTERISTIC DFES_Cls.DFC_NSCDsLamLinSRCMax_C "DFES/Fehlerklasse für Prüfung DFC_NSCDsLamLinSRCMax" VALUE 0x8002366F Val_Wu8 29.00 DFES_OneToOne 0.00 29.00 EXTENDED_LIMITS 0.00 255.0 /end CHARACTERISTIC
/begin CHARACTERISTIC DFES_Cls.DFC_NSCDsLamLinSRCMin_C "DFES/Fehlerklasse für Prüfung DFC_NSCDsLamLinSRCMin" VALUE 0x80023670 Val_Wu8 29.00 DFES_OneToOne 0.00 29.00 EXTENDED_LIMITS 0.00 255.0 /end CHARACTERISTIC
/begin CHARACTERISTIC DFES_Cls.DFC_NSCDsLamPlausMax_C "DFES/Fehlerklasse für Prüfung DFC_NSCDsLamPlausMax" VALUE 0x80023671 Val_Wu8 29.00 DFES_OneToOne 0.00 29.00 EXTENDED_LIMITS 0.00 255.0 /end CHARACTERISTIC
/begin CHARACTERISTIC DFES_Cls.DFC_NSCDsLamPlausMin_C "DFES/Fehlerklasse für Prüfung DFC_NSCDsLamPlausMin" VALUE 0x80023672 Val_Wu8 29.00 DFES_OneToOne 0.00 29.00 EXTENDED_LIMITS 0.00 255.0 /end CHARACTERISTIC
/begin CHARACTERISTIC DFES_Cls.DFC_NSCDsNOxSRCMax_C "DFES/Fehlerklasse für Prüfung DFC_NSCDsNOxSRCMax" VALUE 0x80023673 Val_Wu8 29.00 DFES_OneToOne 0.00 29.00 EXTENDED_LIMITS 0.00 255.0 /end CHARACTERISTIC
/begin CHARACTERISTIC DFES_Cls.DFC_NSCDsNOxSRCMin_C "DFES/Fehlerklasse für Prüfung DFC_NSCDsNOxSRCMin" VALUE 0x80023674 Val_Wu8 29.00 DFES_OneToOne 0.00 29.00 EXTENDED_LIMITS 0.00 255.0 /end CHARACTERISTIC
/begin CHARACTERISTIC DFES_Cls.DFC_NSCDsOpCir_C "DFES/Fehlerklasse für Prüfung DFC_NSCDsOpCir" VALUE 0x80023675 Val_Wu8 29.00 DFES_OneToOne 0.00 29.00 EXTENDED_LIMITS 0.00 255.0 /end CHARACTERISTIC
/begin CHARACTERISTIC DFES_Cls.DFC_NSCDsShCir_C "DFES/Fehlerklasse für Prüfung DFC_NSCDsShCir" VALUE 0x80023676 Val_Wu8 29.00 DFES_OneToOne 0.00 29.00 EXTENDED_LIMITS 0.00 255.0 /end CHARACTERISTIC
/begin CHARACTERISTIC DFES_Cls.DFC_NoCat2DsCmpChk_C "DFES/Fehlerklasse für Prüfung DFC_NoCat2DsCmpChk" VALUE 0x80023677 Val_Wu8 29.00 DFES_OneToOne 0.00 29.00 EXTENDED_LIMITS 0.00 255.0 /end CHARACTERISTIC
/begin CHARACTERISTIC DFES_Cls.DFC_NoCat2DsLamBinSRCMax_C "DFES/Fehlerklasse für Prüfung DFC_NoCat2DsLamBinSRCMax" VALUE 0x80023678 Val_Wu8 29.00 DFES_OneToOne 0.00 29.00 EXTENDED_LIMITS 0.00 255.0 /end CHARACTERISTIC
/begin CHARACTERISTIC DFES_Cls.DFC_NoCat2DsLamBinSRCMin_C "DFES/Fehlerklasse für Prüfung DFC_NoCat2DsLamBinSRCMin" VALUE 0x80023679 Val_Wu8 29.00 DFES_OneToOne 0.00 29.00 EXTENDED_LIMITS 0.00 255.0 /end CHARACTERISTIC
/begin CHARACTERISTIC DFES_Cls.DFC_NoCat2DsLamLinSRCMax_C "DFES/Fehlerklasse für Prüfung DFC_NoCat2DsLamLinSRCMax" VALUE 0x8002367A Val_Wu8 29.00 DFES_OneToOne 0.00 29.00 EXTENDED_LIMITS 0.00 255.0 /end CHARACTERISTIC
/begin CHARACTERISTIC DFES_Cls.DFC_NoCat2DsLamLinSRCMin_C "DFES/Fehlerklasse für Prüfung DFC_NoCat2DsLamLinSRCMin" VALUE 0x8002367B Val_Wu8 29.00 DFES_OneToOne 0.00 29.00 EXTENDED_LIMITS 0.00 255.0 /end CHARACTERISTIC
/begin CHARACTERISTIC DFES_Cls.DFC_NoCat2DsLamPlausMax_C "DFES/Fehlerklasse für Prüfung DFC_NoCat2DsLamPlausMax" VALUE 0x8002367C Val_Wu8 29.00 DFES_OneToOne 0.00 29.00 EXTENDED_LIMITS 0.00 255.0 /end CHARACTERISTIC
/begin CHARACTERISTIC DFES_Cls.DFC_NoCat2DsLamPlausMin_C "DFES/Fehlerklasse für Prüfung DFC_NoCat2DsLamPlausMin" VALUE 0x8002367D Val_Wu8 29.00 DFES_OneToOne 0.00 29.00 EXTENDED_LIMITS 0.00 255.0 /end CHARACTERISTIC
/begin CHARACTERISTIC DFES_Cls.DFC_NoCat2DsNOxSRCMax_C "DFES/Fehlerklasse für Prüfung DFC_NoCat2DsNOxSRCMax" VALUE 0x8002367E Val_Wu8 29.00 DFES_OneToOne 0.00 29.00 EXTENDED_LIMITS 0.00 255.0 /end CHARACTERISTIC
/begin CHARACTERISTIC DFES_Cls.DFC_NoCat2DsNOxSRCMin_C "DFES/Fehlerklasse für Prüfung DFC_NoCat2DsNOxSRCMin" VALUE 0x8002367F Val_Wu8 29.00 DFES_OneToOne 0.00 29.00 EXTENDED_LIMITS 0.00 255.0 /end CHARACTERISTIC
/begin CHARACTERISTIC DFES_Cls.DFC_NoCat2DsOpCir_C "DFES/Fehlerklasse für Prüfung DFC_NoCat2DsOpCir" VALUE 0x80023680 Val_Wu8 29.00 DFES_OneToOne 0.00 29.00 EXTENDED_LIMITS 0.00 255.0 /end CHARACTERISTIC
/begin CHARACTERISTIC DFES_Cls.DFC_NoCat2DsShCir_C "DFES/Fehlerklasse für Prüfung DFC_NoCat2DsShCir" VALUE 0x80023681 Val_Wu8 29.00 DFES_OneToOne 0.00 29.00 EXTENDED_LIMITS 0.00 255.0 /end CHARACTERISTIC
/begin CHARACTERISTIC DFES_Cls.DFC_NplDynPPFltDiff_C "DFES/Fehlerklasse für Prüfung DFC_NplDynPPFltDiff" VALUE 0x80023682 Val_Wu8 29.00 DFES_OneToOne 0.00 29.00 EXTENDED_LIMITS 0.00 255.0 /end CHARACTERISTIC
/begin CHARACTERISTIC DFES_Cls.DFC_NplHsChngPPFltDiff_C "DFES/Fehlerklasse für Prüfung DFC_NplHsChngPPFltDiff" VALUE 0x80023683 Val_Wu8 29.00 DFES_OneToOne 0.00 29.00 EXTENDED_LIMITS 0.00 255.0 /end CHARACTERISTIC
/begin CHARACTERISTIC DFES_Cls.DFC_NplHsLnPPFltDiff_C "DFES/Fehlerklasse für Prüfung DFC_NplHsLnPPFltDiff" VALUE 0x80023684 Val_Wu8 29.00 DFES_OneToOne 0.00 29.00 EXTENDED_LIMITS 0.00 255.0 /end CHARACTERISTIC
/begin CHARACTERISTIC DFES_Cls.DFC_NplTOxiCatUs_C "DFES/Fehlerklasse für Prüfung DFC_NplTOxiCatUs" VALUE 0x80023685 Val_Wu8 29.00 DFES_OneToOne 0.00 29.00 EXTENDED_LIMITS 0.00 255.0 /end CHARACTERISTIC
/begin CHARACTERISTIC DFES_Cls.DFC_NplTPFltUs_C "DFES/Fehlerklasse für Prüfung DFC_NplTPFltUs" VALUE 0x80023686 Val_Wu8 29.00 DFES_OneToOne 0.00 29.00 EXTENDED_LIMITS 0.00 255.0 /end CHARACTERISTIC
/begin CHARACTERISTIC DFES_Cls.DFC_NplTTrbnUs_C "DFES/Fehlerklasse für Prüfung DFC_NplTTrbnUs" VALUE 0x80023687 Val_Wu8 29.00 DFES_OneToOne 0.00 29.00 EXTENDED_LIMITS 0.00 255.0 /end CHARACTERISTIC
/begin CHARACTERISTIC DFES_Cls.DFC_OilPSwmpSRCMax_C "DFES/Fehlerklasse für Prüfung DFC_OilPSwmpSRCMax" VALUE 0x80023688 Val_Wu8 29.00 DFES_OneToOne 0.00 29.00 EXTENDED_LIMITS 0.00 255.0 /end CHARACTERISTIC
/begin CHARACTERISTIC DFES_Cls.DFC_OilPSwmpSRCMin_C "DFES/Fehlerklasse für Prüfung DFC_OilPSwmpSRCMin" VALUE 0x80023689 Val_Wu8 29.00 DFES_OneToOne 0.00 29.00 EXTENDED_LIMITS 0.00 255.0 /end CHARACTERISTIC
/begin CHARACTERISTIC DFES_Cls.DFC_PCVSCG_C "DFES/Fehlerklasse für Prüfung DFC_PCVSCG" VALUE 0x8002368A Val_Wu8 29.00 DFES_OneToOne 0.00 29.00 EXTENDED_LIMITS 0.00 255.0 /end CHARACTERISTIC
/begin CHARACTERISTIC DFES_Cls.DFC_PFltCharPDiffMin_C "DFES/Fehlerklasse für Prüfung DFC_PFltCharPDiffMin" VALUE 0x8002368B Val_Wu8 29.00 DFES_OneToOne 0.00 29.00 EXTENDED_LIMITS 0.00 255.0 /end CHARACTERISTIC
/begin CHARACTERISTIC DFES_Cls.DFC_PFltDstrMin_C "DFES/Fehlerklasse für Prüfung DFC_PFltDstrMin" VALUE 0x8002368C Val_Wu8 29.00 DFES_OneToOne 0.00 29.00 EXTENDED_LIMITS 0.00 255.0 /end CHARACTERISTIC
/begin CHARACTERISTIC DFES_Cls.DFC_PFltEngPrt_C "DFES/Fehlerklasse für Prüfung DFC_PFltEngPrt" VALUE 0x8002368D Val_Wu8 29.00 DFES_OneToOne 0.00 29.00 EXTENDED_LIMITS 0.00 255.0 /end CHARACTERISTIC
/begin CHARACTERISTIC DFES_Cls.DFC_PFltRgnPerm_C "DFES/Fehlerklasse für Prüfung DFC_PFltRgnPerm" VALUE 0x8002368E Val_Wu8 29.00 DFES_OneToOne 0.00 29.00 EXTENDED_LIMITS 0.00 255.0 /end CHARACTERISTIC
/begin CHARACTERISTIC DFES_Cls.DFC_PFltSRCMaxFlwRstn_C "DFES/Fehlerklasse für Prüfung DFC_PFltSRCMaxFlwRstn" VALUE 0x8002368F Val_Wu8 29.00 DFES_OneToOne 0.00 29.00 EXTENDED_LIMITS 0.00 255.0 /end CHARACTERISTIC
/begin CHARACTERISTIC DFES_Cls.DFC_PFltSRCMinFlwRstn_C "DFES/Fehlerklasse für Prüfung DFC_PFltSRCMinFlwRstn" VALUE 0x80023690 Val_Wu8 29.00 DFES_OneToOne 0.00 29.00 EXTENDED_LIMITS 0.00 255.0 /end CHARACTERISTIC
/begin CHARACTERISTIC DFES_Cls.DFC_PFltSotMsDvtMax_C "DFES/Fehlerklasse für Prüfung DFC_PFltSotMsDvtMax" VALUE 0x80023691 Val_Wu8 29.00 DFES_OneToOne 0.00 29.00 EXTENDED_LIMITS 0.00 255.0 /end CHARACTERISTIC
/begin CHARACTERISTIC DFES_Cls.DFC_PFltSotMsDvtMin_C "DFES/Fehlerklasse für Prüfung DFC_PFltSotMsDvtMin" VALUE 0x80023692 Val_Wu8 29.00 DFES_OneToOne 0.00 29.00 EXTENDED_LIMITS 0.00 255.0 /end CHARACTERISTIC
/begin CHARACTERISTIC DFES_Cls.DFC_PFltSotMsMax_C "DFES/Fehlerklasse für Prüfung DFC_PFltSotMsMax" VALUE 0x80023693 Val_Wu8 29.00 DFES_OneToOne 0.00 29.00 EXTENDED_LIMITS 0.00 255.0 /end CHARACTERISTIC
/begin CHARACTERISTIC DFES_Cls.DFC_PIntkVUsSRCMax_C "DFES/Fehlerklasse für Prüfung DFC_PIntkVUsSRCMax" VALUE 0x80023694 Val_Wu8 29.00 DFES_OneToOne 0.00 29.00 EXTENDED_LIMITS 0.00 255.0 /end CHARACTERISTIC
/begin CHARACTERISTIC DFES_Cls.DFC_PIntkVUsSRCMin_C "DFES/Fehlerklasse für Prüfung DFC_PIntkVUsSRCMin" VALUE 0x80023695 Val_Wu8 29.00 DFES_OneToOne 0.00 29.00 EXTENDED_LIMITS 0.00 255.0 /end CHARACTERISTIC
/begin CHARACTERISTIC DFES_Cls.DFC_SRCHighAPP1_C "DFES/Fehlerklasse für Prüfung DFC_SRCHighAPP1" VALUE 0x80023696 Val_Wu8 29.00 DFES_OneToOne 0.00 29.00 EXTENDED_LIMITS 0.00 255.0 /end CHARACTERISTIC
/begin CHARACTERISTIC DFES_Cls.DFC_SRCHighAPP2_C "DFES/Fehlerklasse für Prüfung DFC_SRCHighAPP2" VALUE 0x80023697 Val_Wu8 29.00 DFES_OneToOne 0.00 29.00 EXTENDED_LIMITS 0.00 255.0 /end CHARACTERISTIC
/begin CHARACTERISTIC DFES_Cls.DFC_SRCLowAPP1_C "DFES/Fehlerklasse für Prüfung DFC_SRCLowAPP1" VALUE 0x80023698 Val_Wu8 29.00 DFES_OneToOne 0.00 29.00 EXTENDED_LIMITS 0.00 255.0 /end CHARACTERISTIC
/begin CHARACTERISTIC DFES_Cls.DFC_SRCLowAPP2_C "DFES/Fehlerklasse für Prüfung DFC_SRCLowAPP2" VALUE 0x80023699 Val_Wu8 29.00 DFES_OneToOne 0.00 29.00 EXTENDED_LIMITS 0.00 255.0 /end CHARACTERISTIC
/begin CHARACTERISTIC DFES_Cls.DFC_SRCMaxPPFltDiff_C "DFES/Fehlerklasse für Prüfung DFC_SRCMaxPPFltDiff" VALUE 0x8002369A Val_Wu8 29.00 DFES_OneToOne 0.00 29.00 EXTENDED_LIMITS 0.00 255.0 /end CHARACTERISTIC
/begin CHARACTERISTIC DFES_Cls.DFC_SRCMaxPPFltUs_C "DFES/Fehlerklasse für Prüfung DFC_SRCMaxPPFltUs" VALUE 0x8002369B Val_Wu8 29.00 DFES_OneToOne 0.00 29.00 EXTENDED_LIMITS 0.00 255.0 /end CHARACTERISTIC
/begin CHARACTERISTIC DFES_Cls.DFC_SRCMaxTECU_C "DFES/Fehlerklasse für Prüfung DFC_SRCMaxTECU" VALUE 0x8002369C Val_Wu8 29.00 DFES_OneToOne 0.00 29.00 EXTENDED_LIMITS 0.00 255.0 /end CHARACTERISTIC
/begin CHARACTERISTIC DFES_Cls.DFC_SRCMaxTOxiCatUs_C "DFES/Fehlerklasse für Prüfung DFC_SRCMaxTOxiCatUs" VALUE 0x8002369D Val_Wu8 29.00 DFES_OneToOne 0.00 29.00 EXTENDED_LIMITS 0.00 255.0 /end CHARACTERISTIC
/begin CHARACTERISTIC DFES_Cls.DFC_SRCMaxTPFltUs_C "DFES/Fehlerklasse für Prüfung DFC_SRCMaxTPFltUs" VALUE 0x8002369E Val_Wu8 29.00 DFES_OneToOne 0.00 29.00 EXTENDED_LIMITS 0.00 255.0 /end CHARACTERISTIC
/begin CHARACTERISTIC DFES_Cls.DFC_SRCMaxTTrbnUs_C "DFES/Fehlerklasse für Prüfung DFC_SRCMaxTTrbnUs" VALUE 0x8002369F Val_Wu8 29.00 DFES_OneToOne 0.00 29.00 EXTENDED_LIMITS 0.00 255.0 /end CHARACTERISTIC
/begin CHARACTERISTIC DFES_Cls.DFC_SRCMaxUCatUsT_C "DFES/Fehlerklasse für Prüfung DFC_SRCMaxUCatUsT" VALUE 0x800236A0 Val_Wu8 29.00 DFES_OneToOne 0.00 29.00 EXTENDED_LIMITS 0.00 255.0 /end CHARACTERISTIC
/begin CHARACTERISTIC DFES_Cls.DFC_SRCMaxUPmpP_C "DFES/Fehlerklasse für Prüfung DFC_SRCMaxUPmpP" VALUE 0x800236A1 Val_Wu8 29.00 DFES_OneToOne 0.00 29.00 EXTENDED_LIMITS 0.00 255.0 /end CHARACTERISTIC
/begin CHARACTERISTIC DFES_Cls.DFC_SRCMinPPFltDiff_C "DFES/Fehlerklasse für Prüfung DFC_SRCMinPPFltDiff" VALUE 0x800236A2 Val_Wu8 29.00 DFES_OneToOne 0.00 29.00 EXTENDED_LIMITS 0.00 255.0 /end CHARACTERISTIC
/begin CHARACTERISTIC DFES_Cls.DFC_SRCMinPPFltUs_C "DFES/Fehlerklasse für Prüfung DFC_SRCMinPPFltUs" VALUE 0x800236A3 Val_Wu8 29.00 DFES_OneToOne 0.00 29.00 EXTENDED_LIMITS 0.00 255.0 /end CHARACTERISTIC
/begin CHARACTERISTIC DFES_Cls.DFC_SRCMinTECU_C "DFES/Fehlerklasse für Prüfung DFC_SRCMinTECU" VALUE 0x800236A4 Val_Wu8 29.00 DFES_OneToOne 0.00 29.00 EXTENDED_LIMITS 0.00 255.0 /end CHARACTERISTIC
/begin CHARACTERISTIC DFES_Cls.DFC_SRCMinTOxiCatUs_C "DFES/Fehlerklasse für Prüfung DFC_SRCMinTOxiCatUs" VALUE 0x800236A5 Val_Wu8 29.00 DFES_OneToOne 0.00 29.00 EXTENDED_LIMITS 0.00 255.0 /end CHARACTERISTIC
/begin CHARACTERISTIC DFES_Cls.DFC_SRCMinTPFltUs_C "DFES/Fehlerklasse für Prüfung DFC_SRCMinTPFltUs" VALUE 0x800236A6 Val_Wu8 29.00 DFES_OneToOne 0.00 29.00 EXTENDED_LIMITS 0.00 255.0 /end CHARACTERISTIC
/begin CHARACTERISTIC DFES_Cls.DFC_SRCMinTTrbnUs_C "DFES/Fehlerklasse für Prüfung DFC_SRCMinTTrbnUs" VALUE 0x800236A7 Val_Wu8 29.00 DFES_OneToOne 0.00 29.00 EXTENDED_LIMITS 0.00 255.0 /end CHARACTERISTIC
/begin CHARACTERISTIC DFES_Cls.DFC_SRCMinUCatUsT_C "DFES/Fehlerklasse für Prüfung DFC_SRCMinUCatUsT" VALUE 0x800236A8 Val_Wu8 29.00 DFES_OneToOne 0.00 29.00 EXTENDED_LIMITS 0.00 255.0 /end CHARACTERISTIC
/begin CHARACTERISTIC DFES_Cls.DFC_SRCMinUPmpP_C "DFES/Fehlerklasse für Prüfung DFC_SRCMinUPmpP" VALUE 0x800236A9 Val_Wu8 29.00 DFES_OneToOne 0.00 29.00 EXTENDED_LIMITS 0.00 255.0 /end CHARACTERISTIC
/begin CHARACTERISTIC DFES_Cls.DFC_SigUCatUsT_C "DFES/Fehlerklasse für Prüfung DFC_SigUCatUsT" VALUE 0x800236AA Val_Wu8 29.00 DFES_OneToOne 0.00 29.00 EXTENDED_LIMITS 0.00 255.0 /end CHARACTERISTIC
/begin CHARACTERISTIC DFES_Cls.DFC_SigUPmpP_C "DFES/Fehlerklasse für Prüfung DFC_SigUPmpP" VALUE 0x800236AB Val_Wu8 29.00 DFES_OneToOne 0.00 29.00 EXTENDED_LIMITS 0.00 255.0 /end CHARACTERISTIC
/begin CHARACTERISTIC DFES_Cls.DFC_SyncAPP_C "DFES/Fehlerklasse für Prüfung DFC_SyncAPP" VALUE 0x800236AC Val_Wu8 29.00 DFES_OneToOne 0.00 29.00 EXTENDED_LIMITS 0.00 255.0 /end CHARACTERISTIC
/begin CHARACTERISTIC DFES_Cls.DFC_T15Npl_C "DFES/Fehlerklasse für Prüfung DFC_T15Npl" VALUE 0x800236AD Val_Wu8 29.00 DFES_OneToOne 0.00 29.00 EXTENDED_LIMITS 0.00 255.0 /end CHARACTERISTIC
/begin CHARACTERISTIC DFES_Cls.DFC_TAFSDtyCycHi_C "DFES/Fehlerklasse für Prüfung DFC_TAFSDtyCycHi" VALUE 0x800236AE Val_Wu8 29.00 DFES_OneToOne 0.00 29.00 EXTENDED_LIMITS 0.00 255.0 /end CHARACTERISTIC
/begin CHARACTERISTIC DFES_Cls.DFC_TAFSDtyCycLo_C "DFES/Fehlerklasse für Prüfung DFC_TAFSDtyCycLo" VALUE 0x800236AF Val_Wu8 29.00 DFES_OneToOne 0.00 29.00 EXTENDED_LIMITS 0.00 255.0 /end CHARACTERISTIC
/begin CHARACTERISTIC DFES_Cls.DFC_TAFSPerHi_C "DFES/Fehlerklasse für Prüfung DFC_TAFSPerHi" VALUE 0x800236B0 Val_Wu8 29.00 DFES_OneToOne 0.00 29.00 EXTENDED_LIMITS 0.00 255.0 /end CHARACTERISTIC
/begin CHARACTERISTIC DFES_Cls.DFC_TAFSPerLo_C "DFES/Fehlerklasse für Prüfung DFC_TAFSPerLo" VALUE 0x800236B1 Val_Wu8 29.00 DFES_OneToOne 0.00 29.00 EXTENDED_LIMITS 0.00 255.0 /end CHARACTERISTIC
/begin CHARACTERISTIC DFES_Cls.DFC_TCACDsSRCMax_C "DFES/Fehlerklasse für Prüfung DFC_TCACDsSRCMax" VALUE 0x800236B2 Val_Wu8 29.00 DFES_OneToOne 0.00 29.00 EXTENDED_LIMITS 0.00 255.0 /end CHARACTERISTIC
/begin CHARACTERISTIC DFES_Cls.DFC_TCACDsSRCMin_C "DFES/Fehlerklasse für Prüfung DFC_TCACDsSRCMin" VALUE 0x800236B3 Val_Wu8 29.00 DFES_OneToOne 0.00 29.00 EXTENDED_LIMITS 0.00 255.0 /end CHARACTERISTIC
/begin CHARACTERISTIC DFES_Cls.DFC_ThrVlvSRCMax_C "DFES/Fehlerklasse für Prüfung DFC_ThrVlvSRCMax" VALUE 0x800236B4 Val_Wu8 29.00 DFES_OneToOne 0.00 29.00 EXTENDED_LIMITS 0.00 255.0 /end CHARACTERISTIC
/begin CHARACTERISTIC DFES_Cls.DFC_ThrVlvSRCMin_C "DFES/Fehlerklasse für Prüfung DFC_ThrVlvSRCMin" VALUE 0x800236B5 Val_Wu8 29.00 DFES_OneToOne 0.00 29.00 EXTENDED_LIMITS 0.00 255.0 /end CHARACTERISTIC
/begin CHARACTERISTIC DFES_Cls.DFC_TrbChLPOL_C "DFES/Fehlerklasse für Prüfung DFC_TrbChLPOL" VALUE 0x800236B6 Val_Wu8 29.00 DFES_OneToOne 0.00 29.00 EXTENDED_LIMITS 0.00 255.0 /end CHARACTERISTIC
/begin CHARACTERISTIC DFES_Cls.DFC_TrbChLPSCB_C "DFES/Fehlerklasse für Prüfung DFC_TrbChLPSCB" VALUE 0x800236B7 Val_Wu8 29.00 DFES_OneToOne 0.00 29.00 EXTENDED_LIMITS 0.00 255.0 /end CHARACTERISTIC
/begin CHARACTERISTIC DFES_Cls.DFC_TrbChLPSCG_C "DFES/Fehlerklasse für Prüfung DFC_TrbChLPSCG" VALUE 0x800236B8 Val_Wu8 29.00 DFES_OneToOne 0.00 29.00 EXTENDED_LIMITS 0.00 255.0 /end CHARACTERISTIC
/begin CHARACTERISTIC DFES_Cls.DFC_UHtrPLOL_C "DFES/Fehlerklasse für Prüfung DFC_UHtrPLOL" VALUE 0x800236B9 Val_Wu8 29.00 DFES_OneToOne 0.00 29.00 EXTENDED_LIMITS 0.00 255.0 /end CHARACTERISTIC
/begin CHARACTERISTIC DFES_Cls.DFC_UHtrPLSCB_C "DFES/Fehlerklasse für Prüfung DFC_UHtrPLSCB" VALUE 0x800236BA Val_Wu8 29.00 DFES_OneToOne 0.00 29.00 EXTENDED_LIMITS 0.00 255.0 /end CHARACTERISTIC
/begin CHARACTERISTIC DFES_Cls.DFC_UHtrPLSCG_C "DFES/Fehlerklasse für Prüfung DFC_UHtrPLSCG" VALUE 0x800236BB Val_Wu8 29.00 DFES_OneToOne 0.00 29.00 EXTENDED_LIMITS 0.00 255.0 /end CHARACTERISTIC
/begin CHARACTERISTIC DFES_Cls.DFC_UHtrPLSRCMaxDia_C "DFES/Fehlerklasse für Prüfung DFC_UHtrPLSRCMaxDia" VALUE 0x800236BC Val_Wu8 29.00 DFES_OneToOne 0.00 29.00 EXTENDED_LIMITS 0.00 255.0 /end CHARACTERISTIC
/begin CHARACTERISTIC DFES_Cls.DFC_UHtrPLSRCMinDia_C "DFES/Fehlerklasse für Prüfung DFC_UHtrPLSRCMinDia" VALUE 0x800236BD Val_Wu8 29.00 DFES_OneToOne 0.00 29.00 EXTENDED_LIMITS 0.00 255.0 /end CHARACTERISTIC
/begin CHARACTERISTIC DFES_Cls.DFC_UHtrTnkOL_C "DFES/Fehlerklasse für Prüfung DFC_UHtrTnkOL" VALUE 0x800236BE Val_Wu8 29.00 DFES_OneToOne 0.00 29.00 EXTENDED_LIMITS 0.00 255.0 /end CHARACTERISTIC
/begin CHARACTERISTIC DFES_Cls.DFC_UHtrTnkSCB_C "DFES/Fehlerklasse für Prüfung DFC_UHtrTnkSCB" VALUE 0x800236BF Val_Wu8 29.00 DFES_OneToOne 0.00 29.00 EXTENDED_LIMITS 0.00 255.0 /end CHARACTERISTIC
/begin CHARACTERISTIC DFES_Cls.DFC_UHtrTnkSCG_C "DFES/Fehlerklasse für Prüfung DFC_UHtrTnkSCG" VALUE 0x800236C0 Val_Wu8 29.00 DFES_OneToOne 0.00 29.00 EXTENDED_LIMITS 0.00 255.0 /end CHARACTERISTIC
/begin CHARACTERISTIC DFES_Cls.DFC_UHtrTnkSRCMaxDia_C "DFES/Fehlerklasse für Prüfung DFC_UHtrTnkSRCMaxDia" VALUE 0x800236C1 Val_Wu8 29.00 DFES_OneToOne 0.00 29.00 EXTENDED_LIMITS 0.00 255.0 /end CHARACTERISTIC
/begin CHARACTERISTIC DFES_Cls.DFC_UHtrTnkSRCMinDia_C "DFES/Fehlerklasse für Prüfung DFC_UHtrTnkSRCMinDia" VALUE 0x800236C2 Val_Wu8 29.00 DFES_OneToOne 0.00 29.00 EXTENDED_LIMITS 0.00 255.0 /end CHARACTERISTIC
/begin CHARACTERISTIC DFES_Cls.DFC_URevVlvOL_C "DFES/Fehlerklasse für Prüfung DFC_URevVlvOL" VALUE 0x800236C3 Val_Wu8 29.00 DFES_OneToOne 0.00 29.00 EXTENDED_LIMITS 0.00 255.0 /end CHARACTERISTIC
/begin CHARACTERISTIC DFES_Cls.DFC_URevVlvSCB_C "DFES/Fehlerklasse für Prüfung DFC_URevVlvSCB" VALUE 0x800236C4 Val_Wu8 29.00 DFES_OneToOne 0.00 29.00 EXTENDED_LIMITS 0.00 255.0 /end CHARACTERISTIC
/begin CHARACTERISTIC DFES_Cls.DFC_URevVlvSCG_C "DFES/Fehlerklasse für Prüfung DFC_URevVlvSCG" VALUE 0x800236C5 Val_Wu8 29.00 DFES_OneToOne 0.00 29.00 EXTENDED_LIMITS 0.00 255.0 /end CHARACTERISTIC
/begin CHARACTERISTIC DFES_Cls.DFC_UTnkTSRCMax_C "DFES/Fehlerklasse für Prüfung DFC_UTnkTSRCMax" VALUE 0x800236C6 Val_Wu8 29.00 DFES_OneToOne 0.00 29.00 EXTENDED_LIMITS 0.00 255.0 /end CHARACTERISTIC
/begin CHARACTERISTIC DFES_Cls.DFC_UTnkTSRCMin_C "DFES/Fehlerklasse für Prüfung DFC_UTnkTSRCMin" VALUE 0x800236C7 Val_Wu8 29.00 DFES_OneToOne 0.00 29.00 EXTENDED_LIMITS 0.00 255.0 /end CHARACTERISTIC
/begin CHARACTERISTIC DFES_Cls.DFC_UTnkTSig_C "DFES/Fehlerklasse für Prüfung DFC_UTnkTSig" VALUE 0x800236C8 Val_Wu8 29.00 DFES_OneToOne 0.00 29.00 EXTENDED_LIMITS 0.00 255.0 /end CHARACTERISTIC
/begin CHARACTERISTIC DFES_Cls.DFC_VSwVlvGovDvtMax_C "DFES/Fehlerklasse für Prüfung DFC_VSwVlvGovDvtMax" VALUE 0x800236C9 Val_Wu8 29.00 DFES_OneToOne 0.00 29.00 EXTENDED_LIMITS 0.00 255.0 /end CHARACTERISTIC
/begin CHARACTERISTIC DFES_Cls.DFC_VSwVlvGovDvtMin_C "DFES/Fehlerklasse für Prüfung DFC_VSwVlvGovDvtMin" VALUE 0x800236CA Val_Wu8 29.00 DFES_OneToOne 0.00 29.00 EXTENDED_LIMITS 0.00 255.0 /end CHARACTERISTIC
/begin CHARACTERISTIC DFES_Cls.DFC_VSwVlvHBrgOpnLd_C "DFES/Fehlerklasse für Prüfung DFC_VSwVlvHBrgOpnLd" VALUE 0x800236CB Val_Wu8 29.00 DFES_OneToOne 0.00 29.00 EXTENDED_LIMITS 0.00 255.0 /end CHARACTERISTIC
/begin CHARACTERISTIC DFES_Cls.DFC_VSwVlvHBrgOvrCurr_C "DFES/Fehlerklasse für Prüfung DFC_VSwVlvHBrgOvrCurr" VALUE 0x800236CC Val_Wu8 29.00 DFES_OneToOne 0.00 29.00 EXTENDED_LIMITS 0.00 255.0 /end CHARACTERISTIC
/begin CHARACTERISTIC DFES_Cls.DFC_VSwVlvHBrgOvrTemp_C "DFES/Fehlerklasse für Prüfung DFC_VSwVlvHBrgOvrTemp" VALUE 0x800236CD Val_Wu8 29.00 DFES_OneToOne 0.00 29.00 EXTENDED_LIMITS 0.00 255.0 /end CHARACTERISTIC
/begin CHARACTERISTIC DFES_Cls.DFC_VSwVlvHBrgShCirBatt1_C "DFES/Fehlerklasse für Prüfung DFC_VSwVlvHBrgShCirBatt1" VALUE 0x800236CE Val_Wu8 29.00 DFES_OneToOne 0.00 29.00 EXTENDED_LIMITS 0.00 255.0 /end CHARACTERISTIC
/begin CHARACTERISTIC DFES_Cls.DFC_VSwVlvHBrgShCirBatt2_C "DFES/Fehlerklasse für Prüfung DFC_VSwVlvHBrgShCirBatt2" VALUE 0x800236CF Val_Wu8 29.00 DFES_OneToOne 0.00 29.00 EXTENDED_LIMITS 0.00 255.0 /end CHARACTERISTIC
/begin CHARACTERISTIC DFES_Cls.DFC_VSwVlvHBrgShCirGnd1_C "DFES/Fehlerklasse für Prüfung DFC_VSwVlvHBrgShCirGnd1" VALUE 0x800236D0 Val_Wu8 29.00 DFES_OneToOne 0.00 29.00 EXTENDED_LIMITS 0.00 255.0 /end CHARACTERISTIC
/begin CHARACTERISTIC DFES_Cls.DFC_VSwVlvHBrgShCirGnd2_C "DFES/Fehlerklasse für Prüfung DFC_VSwVlvHBrgShCirGnd2" VALUE 0x800236D1 Val_Wu8 29.00 DFES_OneToOne 0.00 29.00 EXTENDED_LIMITS 0.00 255.0 /end CHARACTERISTIC
/begin CHARACTERISTIC DFES_Cls.DFC_VSwVlvHBrgShCirOvrLd_C "DFES/Fehlerklasse für Prüfung DFC_VSwVlvHBrgShCirOvrLd" VALUE 0x800236D2 Val_Wu8 29.00 DFES_OneToOne 0.00 29.00 EXTENDED_LIMITS 0.00 255.0 /end CHARACTERISTIC
/begin CHARACTERISTIC DFES_Cls.DFC_VSwVlvHBrgTempOvrCurr_C "DFES/Fehlerklasse für Prüfung DFC_VSwVlvHBrgTempOvrCurr" VALUE 0x800236D3 Val_Wu8 29.00 DFES_OneToOne 0.00 29.00 EXTENDED_LIMITS 0.00 255.0 /end CHARACTERISTIC
/begin CHARACTERISTIC DFES_Cls.DFC_VSwVlvHBrgUndrVltg_C "DFES/Fehlerklasse für Prüfung DFC_VSwVlvHBrgUndrVltg" VALUE 0x800236D4 Val_Wu8 29.00 DFES_OneToOne 0.00 29.00 EXTENDED_LIMITS 0.00 255.0 /end CHARACTERISTIC
/begin CHARACTERISTIC DFES_Cls.DFC_VSwVlvOL_C "DFES/Fehlerklasse für Prüfung DFC_VSwVlvOL" VALUE 0x800236D5 Val_Wu8 29.00 DFES_OneToOne 0.00 29.00 EXTENDED_LIMITS 0.00 255.0 /end CHARACTERISTIC
/begin CHARACTERISTIC DFES_Cls.DFC_VSwVlvSCB_C "DFES/Fehlerklasse für Prüfung DFC_VSwVlvSCB" VALUE 0x800236D6 Val_Wu8 29.00 DFES_OneToOne 0.00 29.00 EXTENDED_LIMITS 0.00 255.0 /end CHARACTERISTIC
/begin CHARACTERISTIC DFES_Cls.DFC_VSwVlvSCG_C "DFES/Fehlerklasse für Prüfung DFC_VSwVlvSCG" VALUE 0x800236D7 Val_Wu8 29.00 DFES_OneToOne 0.00 29.00 EXTENDED_LIMITS 0.00 255.0 /end CHARACTERISTIC
/begin CHARACTERISTIC DFES_Cls.DFC_VSwVlvSRCMax_C "DFES/Fehlerklasse für Prüfung DFC_VSwVlvSRCMax" VALUE 0x800236D8 Val_Wu8 29.00 DFES_OneToOne 0.00 29.00 EXTENDED_LIMITS 0.00 255.0 /end CHARACTERISTIC
/begin CHARACTERISTIC DFES_Cls.DFC_VSwVlvSRCMin_C "DFES/Fehlerklasse für Prüfung DFC_VSwVlvSRCMin" VALUE 0x800236D9 Val_Wu8 29.00 DFES_OneToOne 0.00 29.00 EXTENDED_LIMITS 0.00 255.0 /end CHARACTERISTIC
/begin CHARACTERISTIC DFES_Cls.DFC_ClthNpl_C "DFES/Fehlerklasse für Prüfung DFC_ClthNpl" VALUE 0x800236DA Val_Wu8 29.00 DFES_OneToOne 0.00 29.00 EXTENDED_LIMITS 0.00 255.0 /end CHARACTERISTIC
/begin CHARACTERISTIC DFES_Cls.DFC_ETClbETMax_0_C "DFES/Fehlerklasse für Prüfung DFC_ETClbETMax_0" VALUE 0x800236DB Val_Wu8 29.00 DFES_OneToOne 0.00 29.00 EXTENDED_LIMITS 0.00 255.0 /end CHARACTERISTIC
/begin CHARACTERISTIC DFES_Cls.DFC_ETClbETMax_1_C "DFES/Fehlerklasse für Prüfung DFC_ETClbETMax_1" VALUE 0x800236DC Val_Wu8 29.00 DFES_OneToOne 0.00 29.00 EXTENDED_LIMITS 0.00 255.0 /end CHARACTERISTIC
/begin CHARACTERISTIC DFES_Cls.DFC_ETClbETMax_2_C "DFES/Fehlerklasse für Prüfung DFC_ETClbETMax_2" VALUE 0x800236DD Val_Wu8 29.00 DFES_OneToOne 0.00 29.00 EXTENDED_LIMITS 0.00 255.0 /end CHARACTERISTIC
/begin CHARACTERISTIC DFES_Cls.DFC_ETClbETMax_3_C "DFES/Fehlerklasse für Prüfung DFC_ETClbETMax_3" VALUE 0x800236DE Val_Wu8 29.00 DFES_OneToOne 0.00 29.00 EXTENDED_LIMITS 0.00 255.0 /end CHARACTERISTIC
/begin CHARACTERISTIC DFES_Cls.DFC_ETClbETMax_4_C "DFES/Fehlerklasse für Prüfung DFC_ETClbETMax_4" VALUE 0x800236DF Val_Wu8 29.00 DFES_OneToOne 0.00 29.00 EXTENDED_LIMITS 0.00 255.0 /end CHARACTERISTIC
/begin CHARACTERISTIC DFES_Cls.DFC_ETClbETMax_5_C "DFES/Fehlerklasse für Prüfung DFC_ETClbETMax_5" VALUE 0x800236E0 Val_Wu8 29.00 DFES_OneToOne 0.00 29.00 EXTENDED_LIMITS 0.00 255.0 /end CHARACTERISTIC
/begin CHARACTERISTIC DFES_Cls.DFC_ETClbETMin_0_C "DFES/Fehlerklasse für Prüfung DFC_ETClbETMin_0" VALUE 0x800236E1 Val_Wu8 29.00 DFES_OneToOne 0.00 29.00 EXTENDED_LIMITS 0.00 255.0 /end CHARACTERISTIC
/begin CHARACTERISTIC DFES_Cls.DFC_ETClbETMin_1_C "DFES/Fehlerklasse für Prüfung DFC_ETClbETMin_1" VALUE 0x800236E2 Val_Wu8 29.00 DFES_OneToOne 0.00 29.00 EXTENDED_LIMITS 0.00 255.0 /end CHARACTERISTIC
/begin CHARACTERISTIC DFES_Cls.DFC_ETClbETMin_2_C "DFES/Fehlerklasse für Prüfung DFC_ETClbETMin_2" VALUE 0x800236E3 Val_Wu8 29.00 DFES_OneToOne 0.00 29.00 EXTENDED_LIMITS 0.00 255.0 /end CHARACTERISTIC
/begin CHARACTERISTIC DFES_Cls.DFC_ETClbETMin_3_C "DFES/Fehlerklasse für Prüfung DFC_ETClbETMin_3" VALUE 0x800236E4 Val_Wu8 29.00 DFES_OneToOne 0.00 29.00 EXTENDED_LIMITS 0.00 255.0 /end CHARACTERISTIC
/begin CHARACTERISTIC DFES_Cls.DFC_ETClbETMin_4_C "DFES/Fehlerklasse für Prüfung DFC_ETClbETMin_4" VALUE 0x800236E5 Val_Wu8 29.00 DFES_OneToOne 0.00 29.00 EXTENDED_LIMITS 0.00 255.0 /end CHARACTERISTIC
/begin CHARACTERISTIC DFES_Cls.DFC_ETClbETMin_5_C "DFES/Fehlerklasse für Prüfung DFC_ETClbETMin_5" VALUE 0x800236E6 Val_Wu8 29.00 DFES_OneToOne 0.00 29.00 EXTENDED_LIMITS 0.00 255.0 /end CHARACTERISTIC
/begin CHARACTERISTIC DFES_Cls.DFC_IVActrEnrgMax_0_C "DFES/Fehlerklasse für Prüfung DFC_IVActrEnrgMax_0" VALUE 0x800236E7 Val_Wu8 29.00 DFES_OneToOne 0.00 29.00 EXTENDED_LIMITS 0.00 255.0 /end CHARACTERISTIC
/begin CHARACTERISTIC DFES_Cls.DFC_IVActrEnrgMax_1_C "DFES/Fehlerklasse für Prüfung DFC_IVActrEnrgMax_1" VALUE 0x800236E8 Val_Wu8 29.00 DFES_OneToOne 0.00 29.00 EXTENDED_LIMITS 0.00 255.0 /end CHARACTERISTIC
/begin CHARACTERISTIC DFES_Cls.DFC_IVActrEnrgMax_2_C "DFES/Fehlerklasse für Prüfung DFC_IVActrEnrgMax_2" VALUE 0x800236E9 Val_Wu8 29.00 DFES_OneToOne 0.00 29.00 EXTENDED_LIMITS 0.00 255.0 /end CHARACTERISTIC
/begin CHARACTERISTIC DFES_Cls.DFC_IVActrEnrgMax_3_C "DFES/Fehlerklasse für Prüfung DFC_IVActrEnrgMax_3" VALUE 0x800236EA Val_Wu8 29.00 DFES_OneToOne 0.00 29.00 EXTENDED_LIMITS 0.00 255.0 /end CHARACTERISTIC
/begin CHARACTERISTIC DFES_Cls.DFC_IVActrEnrgMax_4_C "DFES/Fehlerklasse für Prüfung DFC_IVActrEnrgMax_4" VALUE 0x800236EB Val_Wu8 29.00 DFES_OneToOne 0.00 29.00 EXTENDED_LIMITS 0.00 255.0 /end CHARACTERISTIC
/begin CHARACTERISTIC DFES_Cls.DFC_IVActrEnrgMax_5_C "DFES/Fehlerklasse für Prüfung DFC_IVActrEnrgMax_5" VALUE 0x800236EC Val_Wu8 29.00 DFES_OneToOne 0.00 29.00 EXTENDED_LIMITS 0.00 255.0 /end CHARACTERISTIC
/begin CHARACTERISTIC DFES_Cls.DFC_IVActrEnrgMax_6_C "DFES/Fehlerklasse für Prüfung DFC_IVActrEnrgMax_6" VALUE 0x800236ED Val_Wu8 29.00 DFES_OneToOne 0.00 29.00 EXTENDED_LIMITS 0.00 255.0 /end CHARACTERISTIC
/begin CHARACTERISTIC DFES_Cls.DFC_IVActrEnrgMax_7_C "DFES/Fehlerklasse für Prüfung DFC_IVActrEnrgMax_7" VALUE 0x800236EE Val_Wu8 29.00 DFES_OneToOne 0.00 29.00 EXTENDED_LIMITS 0.00 255.0 /end CHARACTERISTIC
/begin CHARACTERISTIC DFES_Cls.DFC_IVActrEnrgMin_0_C "DFES/Fehlerklasse für Prüfung DFC_IVActrEnrgMin_0" VALUE 0x800236EF Val_Wu8 29.00 DFES_OneToOne 0.00 29.00 EXTENDED_LIMITS 0.00 255.0 /end CHARACTERISTIC
/begin CHARACTERISTIC DFES_Cls.DFC_IVActrEnrgMin_1_C "DFES/Fehlerklasse für Prüfung DFC_IVActrEnrgMin_1" VALUE 0x800236F0 Val_Wu8 29.00 DFES_OneToOne 0.00 29.00 EXTENDED_LIMITS 0.00 255.0 /end CHARACTERISTIC
/begin CHARACTERISTIC DFES_Cls.DFC_IVActrEnrgMin_2_C "DFES/Fehlerklasse für Prüfung DFC_IVActrEnrgMin_2" VALUE 0x800236F1 Val_Wu8 29.00 DFES_OneToOne 0.00 29.00 EXTENDED_LIMITS 0.00 255.0 /end CHARACTERISTIC
/begin CHARACTERISTIC DFES_Cls.DFC_IVActrEnrgMin_3_C "DFES/Fehlerklasse für Prüfung DFC_IVActrEnrgMin_3" VALUE 0x800236F2 Val_Wu8 29.00 DFES_OneToOne 0.00 29.00 EXTENDED_LIMITS 0.00 255.0 /end CHARACTERISTIC
/begin CHARACTERISTIC DFES_Cls.DFC_IVActrEnrgMin_4_C "DFES/Fehlerklasse für Prüfung DFC_IVActrEnrgMin_4" VALUE 0x800236F3 Val_Wu8 29.00 DFES_OneToOne 0.00 29.00 EXTENDED_LIMITS 0.00 255.0 /end CHARACTERISTIC
/begin CHARACTERISTIC DFES_Cls.DFC_IVActrEnrgMin_5_C "DFES/Fehlerklasse für Prüfung DFC_IVActrEnrgMin_5" VALUE 0x800236F4 Val_Wu8 29.00 DFES_OneToOne 0.00 29.00 EXTENDED_LIMITS 0.00 255.0 /end CHARACTERISTIC
/begin CHARACTERISTIC DFES_Cls.DFC_IVActrEnrgMin_6_C "DFES/Fehlerklasse für Prüfung DFC_IVActrEnrgMin_6" VALUE 0x800236F5 Val_Wu8 29.00 DFES_OneToOne 0.00 29.00 EXTENDED_LIMITS 0.00 255.0 /end CHARACTERISTIC
/begin CHARACTERISTIC DFES_Cls.DFC_IVActrEnrgMin_7_C "DFES/Fehlerklasse für Prüfung DFC_IVActrEnrgMin_7" VALUE 0x800236F6 Val_Wu8 29.00 DFES_OneToOne 0.00 29.00 EXTENDED_LIMITS 0.00 255.0 /end CHARACTERISTIC
/begin CHARACTERISTIC DFES_Cls.DFC_IVActrEnrgPlaus_0_C "DFES/Fehlerklasse für Prüfung DFC_IVActrEnrgPlaus_0" VALUE 0x800236F7 Val_Wu8 29.00 DFES_OneToOne 0.00 29.00 EXTENDED_LIMITS 0.00 255.0 /end CHARACTERISTIC
/begin CHARACTERISTIC DFES_Cls.DFC_IVActrEnrgPlaus_1_C "DFES/Fehlerklasse für Prüfung DFC_IVActrEnrgPlaus_1" VALUE 0x800236F8 Val_Wu8 29.00 DFES_OneToOne 0.00 29.00 EXTENDED_LIMITS 0.00 255.0 /end CHARACTERISTIC
/begin CHARACTERISTIC DFES_Cls.DFC_IVActrEnrgPlaus_2_C "DFES/Fehlerklasse für Prüfung DFC_IVActrEnrgPlaus_2" VALUE 0x800236F9 Val_Wu8 29.00 DFES_OneToOne 0.00 29.00 EXTENDED_LIMITS 0.00 255.0 /end CHARACTERISTIC
/begin CHARACTERISTIC DFES_Cls.DFC_IVActrEnrgPlaus_3_C "DFES/Fehlerklasse für Prüfung DFC_IVActrEnrgPlaus_3" VALUE 0x800236FA Val_Wu8 29.00 DFES_OneToOne 0.00 29.00 EXTENDED_LIMITS 0.00 255.0 /end CHARACTERISTIC
/begin CHARACTERISTIC DFES_Cls.DFC_IVActrEnrgPlaus_4_C "DFES/Fehlerklasse für Prüfung DFC_IVActrEnrgPlaus_4" VALUE 0x800236FB Val_Wu8 29.00 DFES_OneToOne 0.00 29.00 EXTENDED_LIMITS 0.00 255.0 /end CHARACTERISTIC
/begin CHARACTERISTIC DFES_Cls.DFC_IVActrEnrgPlaus_5_C "DFES/Fehlerklasse für Prüfung DFC_IVActrEnrgPlaus_5" VALUE 0x800236FC Val_Wu8 29.00 DFES_OneToOne 0.00 29.00 EXTENDED_LIMITS 0.00 255.0 /end CHARACTERISTIC
/begin CHARACTERISTIC DFES_Cls.DFC_IVActrEnrgPlaus_6_C "DFES/Fehlerklasse für Prüfung DFC_IVActrEnrgPlaus_6" VALUE 0x800236FD Val_Wu8 29.00 DFES_OneToOne 0.00 29.00 EXTENDED_LIMITS 0.00 255.0 /end CHARACTERISTIC
/begin CHARACTERISTIC DFES_Cls.DFC_IVActrEnrgPlaus_7_C "DFES/Fehlerklasse für Prüfung DFC_IVActrEnrgPlaus_7" VALUE 0x800236FE Val_Wu8 29.00 DFES_OneToOne 0.00 29.00 EXTENDED_LIMITS 0.00 255.0 /end CHARACTERISTIC
/begin CHARACTERISTIC DFES_Cls.DFC_IVCtlTiDiff_0_C "DFES/Fehlerklasse für Prüfung DFC_IVCtlTiDiff_0" VALUE 0x800236FF Val_Wu8 29.00 DFES_OneToOne 0.00 29.00 EXTENDED_LIMITS 0.00 255.0 /end CHARACTERISTIC
/begin CHARACTERISTIC DFES_Cls.DFC_IVCtlTiDiff_1_C "DFES/Fehlerklasse für Prüfung DFC_IVCtlTiDiff_1" VALUE 0x80023700 Val_Wu8 29.00 DFES_OneToOne 0.00 29.00 EXTENDED_LIMITS 0.00 255.0 /end CHARACTERISTIC
/begin CHARACTERISTIC DFES_Cls.DFC_IVCtlTiDiff_2_C "DFES/Fehlerklasse für Prüfung DFC_IVCtlTiDiff_2" VALUE 0x80023701 Val_Wu8 29.00 DFES_OneToOne 0.00 29.00 EXTENDED_LIMITS 0.00 255.0 /end CHARACTERISTIC
/begin CHARACTERISTIC DFES_Cls.DFC_IVCtlTiDiff_3_C "DFES/Fehlerklasse für Prüfung DFC_IVCtlTiDiff_3" VALUE 0x80023702 Val_Wu8 29.00 DFES_OneToOne 0.00 29.00 EXTENDED_LIMITS 0.00 255.0 /end CHARACTERISTIC
/begin CHARACTERISTIC DFES_Cls.DFC_IVCtlTiDiff_4_C "DFES/Fehlerklasse für Prüfung DFC_IVCtlTiDiff_4" VALUE 0x80023703 Val_Wu8 29.00 DFES_OneToOne 0.00 29.00 EXTENDED_LIMITS 0.00 255.0 /end CHARACTERISTIC
/begin CHARACTERISTIC DFES_Cls.DFC_IVCtlTiDiff_5_C "DFES/Fehlerklasse für Prüfung DFC_IVCtlTiDiff_5" VALUE 0x80023704 Val_Wu8 29.00 DFES_OneToOne 0.00 29.00 EXTENDED_LIMITS 0.00 255.0 /end CHARACTERISTIC
/begin CHARACTERISTIC DFES_Cls.DFC_IVCtlUDiffUp_0_C "DFES/Fehlerklasse für Prüfung DFC_IVCtlUDiffUp_0" VALUE 0x80023705 Val_Wu8 29.00 DFES_OneToOne 0.00 29.00 EXTENDED_LIMITS 0.00 255.0 /end CHARACTERISTIC
/begin CHARACTERISTIC DFES_Cls.DFC_IVCtlUDiffUp_1_C "DFES/Fehlerklasse für Prüfung DFC_IVCtlUDiffUp_1" VALUE 0x80023706 Val_Wu8 29.00 DFES_OneToOne 0.00 29.00 EXTENDED_LIMITS 0.00 255.0 /end CHARACTERISTIC
/begin CHARACTERISTIC DFES_Cls.DFC_IVCtlUDiffUp_2_C "DFES/Fehlerklasse für Prüfung DFC_IVCtlUDiffUp_2" VALUE 0x80023707 Val_Wu8 29.00 DFES_OneToOne 0.00 29.00 EXTENDED_LIMITS 0.00 255.0 /end CHARACTERISTIC
/begin CHARACTERISTIC DFES_Cls.DFC_IVCtlUDiffUp_3_C "DFES/Fehlerklasse für Prüfung DFC_IVCtlUDiffUp_3" VALUE 0x80023708 Val_Wu8 29.00 DFES_OneToOne 0.00 29.00 EXTENDED_LIMITS 0.00 255.0 /end CHARACTERISTIC
/begin CHARACTERISTIC DFES_Cls.DFC_IVCtlUDiffUp_4_C "DFES/Fehlerklasse für Prüfung DFC_IVCtlUDiffUp_4" VALUE 0x80023709 Val_Wu8 29.00 DFES_OneToOne 0.00 29.00 EXTENDED_LIMITS 0.00 255.0 /end CHARACTERISTIC
/begin CHARACTERISTIC DFES_Cls.DFC_IVCtlUDiffUp_5_C "DFES/Fehlerklasse für Prüfung DFC_IVCtlUDiffUp_5" VALUE 0x8002370A Val_Wu8 29.00 DFES_OneToOne 0.00 29.00 EXTENDED_LIMITS 0.00 255.0 /end CHARACTERISTIC
/begin CHARACTERISTIC DFES_Cls.DFC_IVCtlUUp_0_C "DFES/Fehlerklasse für Prüfung DFC_IVCtlUUp_0" VALUE 0x8002370B Val_Wu8 29.00 DFES_OneToOne 0.00 29.00 EXTENDED_LIMITS 0.00 255.0 /end CHARACTERISTIC
/begin CHARACTERISTIC DFES_Cls.DFC_IVCtlUUp_1_C "DFES/Fehlerklasse für Prüfung DFC_IVCtlUUp_1" VALUE 0x8002370C Val_Wu8 29.00 DFES_OneToOne 0.00 29.00 EXTENDED_LIMITS 0.00 255.0 /end CHARACTERISTIC
/begin CHARACTERISTIC DFES_Cls.DFC_IVCtlUUp_2_C "DFES/Fehlerklasse für Prüfung DFC_IVCtlUUp_2" VALUE 0x8002370D Val_Wu8 29.00 DFES_OneToOne 0.00 29.00 EXTENDED_LIMITS 0.00 255.0 /end CHARACTERISTIC
/begin CHARACTERISTIC DFES_Cls.DFC_IVCtlUUp_3_C "DFES/Fehlerklasse für Prüfung DFC_IVCtlUUp_3" VALUE 0x8002370E Val_Wu8 29.00 DFES_OneToOne 0.00 29.00 EXTENDED_LIMITS 0.00 255.0 /end CHARACTERISTIC
/begin CHARACTERISTIC DFES_Cls.DFC_IVCtlUUp_4_C "DFES/Fehlerklasse für Prüfung DFC_IVCtlUUp_4" VALUE 0x8002370F Val_Wu8 29.00 DFES_OneToOne 0.00 29.00 EXTENDED_LIMITS 0.00 255.0 /end CHARACTERISTIC
/begin CHARACTERISTIC DFES_Cls.DFC_IVCtlUUp_5_C "DFES/Fehlerklasse für Prüfung DFC_IVCtlUUp_5" VALUE 0x80023710 Val_Wu8 29.00 DFES_OneToOne 0.00 29.00 EXTENDED_LIMITS 0.00 255.0 /end CHARACTERISTIC
/begin CHARACTERISTIC DFES_Cls.DFC_IVDiaBnkShCir_0_C "DFES/Fehlerklasse für Prüfung DFC_IVDiaBnkShCir_0" VALUE 0x80023711 Val_Wu8 29.00 DFES_OneToOne 0.00 29.00 EXTENDED_LIMITS 0.00 255.0 /end CHARACTERISTIC
/begin CHARACTERISTIC DFES_Cls.DFC_IVDiaBnkShCir_1_C "DFES/Fehlerklasse für Prüfung DFC_IVDiaBnkShCir_1" VALUE 0x80023712 Val_Wu8 29.00 DFES_OneToOne 0.00 29.00 EXTENDED_LIMITS 0.00 255.0 /end CHARACTERISTIC
/begin CHARACTERISTIC DFES_Cls.DFC_IVDiaBnkShCirChSwt_0_C "DFES/Fehlerklasse für Prüfung DFC_IVDiaBnkShCirChSwt_0" VALUE 0x80023713 Val_Wu8 29.00 DFES_OneToOne 0.00 29.00 EXTENDED_LIMITS 0.00 255.0 /end CHARACTERISTIC
/begin CHARACTERISTIC DFES_Cls.DFC_IVDiaBnkShCirChSwt_1_C "DFES/Fehlerklasse für Prüfung DFC_IVDiaBnkShCirChSwt_1" VALUE 0x80023714 Val_Wu8 29.00 DFES_OneToOne 0.00 29.00 EXTENDED_LIMITS 0.00 255.0 /end CHARACTERISTIC
/begin CHARACTERISTIC DFES_Cls.DFC_IVDiaChp_0_C "DFES/Fehlerklasse für Prüfung DFC_IVDiaChp_0" VALUE 0x80023715 Val_Wu8 29.00 DFES_OneToOne 0.00 29.00 EXTENDED_LIMITS 0.00 255.0 /end CHARACTERISTIC
/begin CHARACTERISTIC DFES_Cls.DFC_IVDiaChp_1_C "DFES/Fehlerklasse für Prüfung DFC_IVDiaChp_1" VALUE 0x80023716 Val_Wu8 29.00 DFES_OneToOne 0.00 29.00 EXTENDED_LIMITS 0.00 255.0 /end CHARACTERISTIC
/begin CHARACTERISTIC DFES_Cls.DFC_IVDiaCylNoCls_0_C "DFES/Fehlerklasse für Prüfung DFC_IVDiaCylNoCls_0" VALUE 0x80023717 Val_Wu8 29.00 DFES_OneToOne 0.00 29.00 EXTENDED_LIMITS 0.00 255.0 /end CHARACTERISTIC
/begin CHARACTERISTIC DFES_Cls.DFC_IVDiaCylNoCls_1_C "DFES/Fehlerklasse für Prüfung DFC_IVDiaCylNoCls_1" VALUE 0x80023718 Val_Wu8 29.00 DFES_OneToOne 0.00 29.00 EXTENDED_LIMITS 0.00 255.0 /end CHARACTERISTIC
/begin CHARACTERISTIC DFES_Cls.DFC_IVDiaCylNoCls_2_C "DFES/Fehlerklasse für Prüfung DFC_IVDiaCylNoCls_2" VALUE 0x80023719 Val_Wu8 29.00 DFES_OneToOne 0.00 29.00 EXTENDED_LIMITS 0.00 255.0 /end CHARACTERISTIC
/begin CHARACTERISTIC DFES_Cls.DFC_IVDiaCylNoCls_3_C "DFES/Fehlerklasse für Prüfung DFC_IVDiaCylNoCls_3" VALUE 0x8002371A Val_Wu8 29.00 DFES_OneToOne 0.00 29.00 EXTENDED_LIMITS 0.00 255.0 /end CHARACTERISTIC
/begin CHARACTERISTIC DFES_Cls.DFC_IVDiaCylNoCls_4_C "DFES/Fehlerklasse für Prüfung DFC_IVDiaCylNoCls_4" VALUE 0x8002371B Val_Wu8 29.00 DFES_OneToOne 0.00 29.00 EXTENDED_LIMITS 0.00 255.0 /end CHARACTERISTIC
/begin CHARACTERISTIC DFES_Cls.DFC_IVDiaCylNoCls_5_C "DFES/Fehlerklasse für Prüfung DFC_IVDiaCylNoCls_5" VALUE 0x8002371C Val_Wu8 29.00 DFES_OneToOne 0.00 29.00 EXTENDED_LIMITS 0.00 255.0 /end CHARACTERISTIC
/begin CHARACTERISTIC DFES_Cls.DFC_IVDiaCylNoLd_0_C "DFES/Fehlerklasse für Prüfung DFC_IVDiaCylNoLd_0" VALUE 0x8002371D Val_Wu8 29.00 DFES_OneToOne 0.00 29.00 EXTENDED_LIMITS 0.00 255.0 /end CHARACTERISTIC
/begin CHARACTERISTIC DFES_Cls.DFC_IVDiaCylNoLd_1_C "DFES/Fehlerklasse für Prüfung DFC_IVDiaCylNoLd_1" VALUE 0x8002371E Val_Wu8 29.00 DFES_OneToOne 0.00 29.00 EXTENDED_LIMITS 0.00 255.0 /end CHARACTERISTIC
/begin CHARACTERISTIC DFES_Cls.DFC_IVDiaCylNoLd_2_C "DFES/Fehlerklasse für Prüfung DFC_IVDiaCylNoLd_2" VALUE 0x8002371F Val_Wu8 29.00 DFES_OneToOne 0.00 29.00 EXTENDED_LIMITS 0.00 255.0 /end CHARACTERISTIC
/begin CHARACTERISTIC DFES_Cls.DFC_IVDiaCylNoLd_3_C "DFES/Fehlerklasse für Prüfung DFC_IVDiaCylNoLd_3" VALUE 0x80023720 Val_Wu8 29.00 DFES_OneToOne 0.00 29.00 EXTENDED_LIMITS 0.00 255.0 /end CHARACTERISTIC
/begin CHARACTERISTIC DFES_Cls.DFC_IVDiaCylNoLd_4_C "DFES/Fehlerklasse für Prüfung DFC_IVDiaCylNoLd_4" VALUE 0x80023721 Val_Wu8 29.00 DFES_OneToOne 0.00 29.00 EXTENDED_LIMITS 0.00 255.0 /end CHARACTERISTIC
/begin CHARACTERISTIC DFES_Cls.DFC_IVDiaCylNoLd_5_C "DFES/Fehlerklasse für Prüfung DFC_IVDiaCylNoLd_5" VALUE 0x80023722 Val_Wu8 29.00 DFES_OneToOne 0.00 29.00 EXTENDED_LIMITS 0.00 255.0 /end CHARACTERISTIC
/begin CHARACTERISTIC DFES_Cls.DFC_IVDiaCylShCir_0_C "DFES/Fehlerklasse für Prüfung DFC_IVDiaCylShCir_0" VALUE 0x80023723 Val_Wu8 29.00 DFES_OneToOne 0.00 29.00 EXTENDED_LIMITS 0.00 255.0 /end CHARACTERISTIC
/begin CHARACTERISTIC DFES_Cls.DFC_IVDiaCylShCir_1_C "DFES/Fehlerklasse für Prüfung DFC_IVDiaCylShCir_1" VALUE 0x80023724 Val_Wu8 29.00 DFES_OneToOne 0.00 29.00 EXTENDED_LIMITS 0.00 255.0 /end CHARACTERISTIC
/begin CHARACTERISTIC DFES_Cls.DFC_IVDiaCylShCir_2_C "DFES/Fehlerklasse für Prüfung DFC_IVDiaCylShCir_2" VALUE 0x80023725 Val_Wu8 29.00 DFES_OneToOne 0.00 29.00 EXTENDED_LIMITS 0.00 255.0 /end CHARACTERISTIC
/begin CHARACTERISTIC DFES_Cls.DFC_IVDiaCylShCir_3_C "DFES/Fehlerklasse für Prüfung DFC_IVDiaCylShCir_3" VALUE 0x80023726 Val_Wu8 29.00 DFES_OneToOne 0.00 29.00 EXTENDED_LIMITS 0.00 255.0 /end CHARACTERISTIC
/begin CHARACTERISTIC DFES_Cls.DFC_IVDiaCylShCir_4_C "DFES/Fehlerklasse für Prüfung DFC_IVDiaCylShCir_4" VALUE 0x80023727 Val_Wu8 29.00 DFES_OneToOne 0.00 29.00 EXTENDED_LIMITS 0.00 255.0 /end CHARACTERISTIC
/begin CHARACTERISTIC DFES_Cls.DFC_IVDiaCylShCir_5_C "DFES/Fehlerklasse für Prüfung DFC_IVDiaCylShCir_5" VALUE 0x80023728 Val_Wu8 29.00 DFES_OneToOne 0.00 29.00 EXTENDED_LIMITS 0.00 255.0 /end CHARACTERISTIC
/begin CHARACTERISTIC DFES_Cls.DFC_IVDiaCylShCirHSLS_0_C "DFES/Fehlerklasse für Prüfung DFC_IVDiaCylShCirHSLS_0" VALUE 0x80023729 Val_Wu8 29.00 DFES_OneToOne 0.00 29.00 EXTENDED_LIMITS 0.00 255.0 /end CHARACTERISTIC
/begin CHARACTERISTIC DFES_Cls.DFC_IVDiaCylShCirHSLS_1_C "DFES/Fehlerklasse für Prüfung DFC_IVDiaCylShCirHSLS_1" VALUE 0x8002372A Val_Wu8 29.00 DFES_OneToOne 0.00 29.00 EXTENDED_LIMITS 0.00 255.0 /end CHARACTERISTIC
/begin CHARACTERISTIC DFES_Cls.DFC_IVDiaCylShCirHSLS_2_C "DFES/Fehlerklasse für Prüfung DFC_IVDiaCylShCirHSLS_2" VALUE 0x8002372B Val_Wu8 29.00 DFES_OneToOne 0.00 29.00 EXTENDED_LIMITS 0.00 255.0 /end CHARACTERISTIC
/begin CHARACTERISTIC DFES_Cls.DFC_IVDiaCylShCirHSLS_3_C "DFES/Fehlerklasse für Prüfung DFC_IVDiaCylShCirHSLS_3" VALUE 0x8002372C Val_Wu8 29.00 DFES_OneToOne 0.00 29.00 EXTENDED_LIMITS 0.00 255.0 /end CHARACTERISTIC
/begin CHARACTERISTIC DFES_Cls.DFC_IVDiaCylShCirHSLS_4_C "DFES/Fehlerklasse für Prüfung DFC_IVDiaCylShCirHSLS_4" VALUE 0x8002372D Val_Wu8 29.00 DFES_OneToOne 0.00 29.00 EXTENDED_LIMITS 0.00 255.0 /end CHARACTERISTIC
/begin CHARACTERISTIC DFES_Cls.DFC_IVDiaCylShCirHSLS_5_C "DFES/Fehlerklasse für Prüfung DFC_IVDiaCylShCirHSLS_5" VALUE 0x8002372E Val_Wu8 29.00 DFES_OneToOne 0.00 29.00 EXTENDED_LIMITS 0.00 255.0 /end CHARACTERISTIC
/begin CHARACTERISTIC DFES_Cls.DFC_IVDiaCylShCirMeas_0_C "DFES/Fehlerklasse für Prüfung DFC_IVDiaCylShCirMeas_0" VALUE 0x8002372F Val_Wu8 29.00 DFES_OneToOne 0.00 29.00 EXTENDED_LIMITS 0.00 255.0 /end CHARACTERISTIC
/begin CHARACTERISTIC DFES_Cls.DFC_IVDiaCylShCirMeas_1_C "DFES/Fehlerklasse für Prüfung DFC_IVDiaCylShCirMeas_1" VALUE 0x80023730 Val_Wu8 29.00 DFES_OneToOne 0.00 29.00 EXTENDED_LIMITS 0.00 255.0 /end CHARACTERISTIC
/begin CHARACTERISTIC DFES_Cls.DFC_IVDiaCylShCirMeas_2_C "DFES/Fehlerklasse für Prüfung DFC_IVDiaCylShCirMeas_2" VALUE 0x80023731 Val_Wu8 29.00 DFES_OneToOne 0.00 29.00 EXTENDED_LIMITS 0.00 255.0 /end CHARACTERISTIC
/begin CHARACTERISTIC DFES_Cls.DFC_IVDiaCylShCirMeas_3_C "DFES/Fehlerklasse für Prüfung DFC_IVDiaCylShCirMeas_3" VALUE 0x80023732 Val_Wu8 29.00 DFES_OneToOne 0.00 29.00 EXTENDED_LIMITS 0.00 255.0 /end CHARACTERISTIC
/begin CHARACTERISTIC DFES_Cls.DFC_IVDiaCylShCirMeas_4_C "DFES/Fehlerklasse für Prüfung DFC_IVDiaCylShCirMeas_4" VALUE 0x80023733 Val_Wu8 29.00 DFES_OneToOne 0.00 29.00 EXTENDED_LIMITS 0.00 255.0 /end CHARACTERISTIC
/begin CHARACTERISTIC DFES_Cls.DFC_IVDiaCylShCirMeas_5_C "DFES/Fehlerklasse für Prüfung DFC_IVDiaCylShCirMeas_5" VALUE 0x80023734 Val_Wu8 29.00 DFES_OneToOne 0.00 29.00 EXTENDED_LIMITS 0.00 255.0 /end CHARACTERISTIC
/begin CHARACTERISTIC DFES_Cls.DFC_LSUDynChk_C "DFES/Fehlerklasse für Prüfung DFC_LSUDynChk" VALUE 0x80023735 Val_Wu8 29.00 DFES_OneToOne 0.00 29.00 EXTENDED_LIMITS 0.00 255.0 /end CHARACTERISTIC
/begin CHARACTERISTIC DFES_Cls.DFC_LSUO2ClbMax_C "DFES/Fehlerklasse für Prüfung DFC_LSUO2ClbMax" VALUE 0x80023736 Val_Wu8 29.00 DFES_OneToOne 0.00 29.00 EXTENDED_LIMITS 0.00 255.0 /end CHARACTERISTIC
/begin CHARACTERISTIC DFES_Cls.DFC_LSUO2ClbMin_C "DFES/Fehlerklasse für Prüfung DFC_LSUO2ClbMin" VALUE 0x80023737 Val_Wu8 29.00 DFES_OneToOne 0.00 29.00 EXTENDED_LIMITS 0.00 255.0 /end CHARACTERISTIC
/begin CHARACTERISTIC DFES_Cls.DFC_LSUO2PlausMaxFLd_C "DFES/Fehlerklasse für Prüfung DFC_LSUO2PlausMaxFLd" VALUE 0x80023738 Val_Wu8 29.00 DFES_OneToOne 0.00 29.00 EXTENDED_LIMITS 0.00 255.0 /end CHARACTERISTIC
/begin CHARACTERISTIC DFES_Cls.DFC_LSUO2PlausMaxOvrRun_C "DFES/Fehlerklasse für Prüfung DFC_LSUO2PlausMaxOvrRun" VALUE 0x80023739 Val_Wu8 29.00 DFES_OneToOne 0.00 29.00 EXTENDED_LIMITS 0.00 255.0 /end CHARACTERISTIC
/begin CHARACTERISTIC DFES_Cls.DFC_LSUO2PlausMaxPartLd_C "DFES/Fehlerklasse für Prüfung DFC_LSUO2PlausMaxPartLd" VALUE 0x8002373A Val_Wu8 29.00 DFES_OneToOne 0.00 29.00 EXTENDED_LIMITS 0.00 255.0 /end CHARACTERISTIC
/begin CHARACTERISTIC DFES_Cls.DFC_LSUO2PlausMinFLd_C "DFES/Fehlerklasse für Prüfung DFC_LSUO2PlausMinFLd" VALUE 0x8002373B Val_Wu8 29.00 DFES_OneToOne 0.00 29.00 EXTENDED_LIMITS 0.00 255.0 /end CHARACTERISTIC
/begin CHARACTERISTIC DFES_Cls.DFC_LSUO2PlausMinOvrRun_C "DFES/Fehlerklasse für Prüfung DFC_LSUO2PlausMinOvrRun" VALUE 0x8002373C Val_Wu8 29.00 DFES_OneToOne 0.00 29.00 EXTENDED_LIMITS 0.00 255.0 /end CHARACTERISTIC
/begin CHARACTERISTIC DFES_Cls.DFC_LSUO2PlausMinPartLd_C "DFES/Fehlerklasse für Prüfung DFC_LSUO2PlausMinPartLd" VALUE 0x8002373D Val_Wu8 29.00 DFES_OneToOne 0.00 29.00 EXTENDED_LIMITS 0.00 255.0 /end CHARACTERISTIC
/begin CHARACTERISTIC DFES_Cls.DFC_LSURiClbMax_C "DFES/Fehlerklasse für Prüfung DFC_LSURiClbMax" VALUE 0x8002373E Val_Wu8 29.00 DFES_OneToOne 0.00 29.00 EXTENDED_LIMITS 0.00 255.0 /end CHARACTERISTIC
/begin CHARACTERISTIC DFES_Cls.DFC_LSURiClbMin_C "DFES/Fehlerklasse für Prüfung DFC_LSURiClbMin" VALUE 0x8002373F Val_Wu8 29.00 DFES_OneToOne 0.00 29.00 EXTENDED_LIMITS 0.00 255.0 /end CHARACTERISTIC
/begin CHARACTERISTIC DFES_Cls.DFC_LSUWireIPSig_C "DFES/Fehlerklasse für Prüfung DFC_LSUWireIPSig" VALUE 0x80023740 Val_Wu8 29.00 DFES_OneToOne 0.00 29.00 EXTENDED_LIMITS 0.00 255.0 /end CHARACTERISTIC
/begin CHARACTERISTIC DFES_Cls.DFC_Layer_BSDMax_C "DFES/Fehlerklasse für Prüfung DFC_Layer_BSDMax" VALUE 0x80023741 Val_Wu8 29.00 DFES_OneToOne 0.00 29.00 EXTENDED_LIMITS 0.00 255.0 /end CHARACTERISTIC
/begin CHARACTERISTIC DFES_Cls.DFC_Layer_BSDMin_C "DFES/Fehlerklasse für Prüfung DFC_Layer_BSDMin" VALUE 0x80023742 Val_Wu8 29.00 DFES_OneToOne 0.00 29.00 EXTENDED_LIMITS 0.00 255.0 /end CHARACTERISTIC
/begin CHARACTERISTIC DFES_Cls.DFC_Layer_BSDNpl_C "DFES/Fehlerklasse für Prüfung DFC_Layer_BSDNpl" VALUE 0x80023743 Val_Wu8 29.00 DFES_OneToOne 0.00 29.00 EXTENDED_LIMITS 0.00 255.0 /end CHARACTERISTIC
/begin CHARACTERISTIC DFES_Cls.DFC_Layer_BSDSig_C "DFES/Fehlerklasse für Prüfung DFC_Layer_BSDSig" VALUE 0x80023744 Val_Wu8 29.00 DFES_OneToOne 0.00 29.00 EXTENDED_LIMITS 0.00 255.0 /end CHARACTERISTIC
/begin CHARACTERISTIC DFES_Cls.DFC_Layer_FltMngTstMax_C "DFES/Fehlerklasse für Prüfung DFC_Layer_FltMngTstMax" VALUE 0x80023745 Val_Wu8 29.00 DFES_OneToOne 0.00 29.00 EXTENDED_LIMITS 0.00 255.0 /end CHARACTERISTIC
/begin CHARACTERISTIC DFES_Cls.DFC_Layer_FltMngTstMin_C "DFES/Fehlerklasse für Prüfung DFC_Layer_FltMngTstMin" VALUE 0x80023746 Val_Wu8 29.00 DFES_OneToOne 0.00 29.00 EXTENDED_LIMITS 0.00 255.0 /end CHARACTERISTIC
/begin CHARACTERISTIC DFES_Cls.DFC_Layer_FltMngTstNpl_C "DFES/Fehlerklasse für Prüfung DFC_Layer_FltMngTstNpl" VALUE 0x80023747 Val_Wu8 29.00 DFES_OneToOne 0.00 29.00 EXTENDED_LIMITS 0.00 255.0 /end CHARACTERISTIC
/begin CHARACTERISTIC DFES_Cls.DFC_Layer_FltMngTstSig_C "DFES/Fehlerklasse für Prüfung DFC_Layer_FltMngTstSig" VALUE 0x80023748 Val_Wu8 29.00 DFES_OneToOne 0.00 29.00 EXTENDED_LIMITS 0.00 255.0 /end CHARACTERISTIC
/begin CHARACTERISTIC DFES_Cls.DFC_Layer_GENELBMax_C "DFES/Fehlerklasse für Prüfung DFC_Layer_GENELBMax" VALUE 0x80023749 Val_Wu8 29.00 DFES_OneToOne 0.00 29.00 EXTENDED_LIMITS 0.00 255.0 /end CHARACTERISTIC
/begin CHARACTERISTIC DFES_Cls.DFC_Layer_GENELBMin_C "DFES/Fehlerklasse für Prüfung DFC_Layer_GENELBMin" VALUE 0x8002374A Val_Wu8 29.00 DFES_OneToOne 0.00 29.00 EXTENDED_LIMITS 0.00 255.0 /end CHARACTERISTIC
/begin CHARACTERISTIC DFES_Cls.DFC_Layer_GENELBNpl_C "DFES/Fehlerklasse für Prüfung DFC_Layer_GENELBNpl" VALUE 0x8002374B Val_Wu8 29.00 DFES_OneToOne 0.00 29.00 EXTENDED_LIMITS 0.00 255.0 /end CHARACTERISTIC
/begin CHARACTERISTIC DFES_Cls.DFC_Layer_GENELBSig_C "DFES/Fehlerklasse für Prüfung DFC_Layer_GENELBSig" VALUE 0x8002374C Val_Wu8 29.00 DFES_OneToOne 0.00 29.00 EXTENDED_LIMITS 0.00 255.0 /end CHARACTERISTIC
/begin CHARACTERISTIC DFES_Cls.DFC_Layer_GENELMax_C "DFES/Fehlerklasse für Prüfung DFC_Layer_GENELMax" VALUE 0x8002374D Val_Wu8 29.00 DFES_OneToOne 0.00 29.00 EXTENDED_LIMITS 0.00 255.0 /end CHARACTERISTIC
/begin CHARACTERISTIC DFES_Cls.DFC_Layer_GENELMin_C "DFES/Fehlerklasse für Prüfung DFC_Layer_GENELMin" VALUE 0x8002374E Val_Wu8 29.00 DFES_OneToOne 0.00 29.00 EXTENDED_LIMITS 0.00 255.0 /end CHARACTERISTIC
/begin CHARACTERISTIC DFES_Cls.DFC_Layer_GENELNpl_C "DFES/Fehlerklasse für Prüfung DFC_Layer_GENELNpl" VALUE 0x8002374F Val_Wu8 29.00 DFES_OneToOne 0.00 29.00 EXTENDED_LIMITS 0.00 255.0 /end CHARACTERISTIC
/begin CHARACTERISTIC DFES_Cls.DFC_Layer_GENELSig_C "DFES/Fehlerklasse für Prüfung DFC_Layer_GENELSig" VALUE 0x80023750 Val_Wu8 29.00 DFES_OneToOne 0.00 29.00 EXTENDED_LIMITS 0.00 255.0 /end CHARACTERISTIC
/begin CHARACTERISTIC DFES_Cls.DFC_Layer_GENHTBMax_C "DFES/Fehlerklasse für Prüfung DFC_Layer_GENHTBMax" VALUE 0x80023751 Val_Wu8 29.00 DFES_OneToOne 0.00 29.00 EXTENDED_LIMITS 0.00 255.0 /end CHARACTERISTIC
/begin CHARACTERISTIC DFES_Cls.DFC_Layer_GENHTBMin_C "DFES/Fehlerklasse für Prüfung DFC_Layer_GENHTBMin" VALUE 0x80023752 Val_Wu8 29.00 DFES_OneToOne 0.00 29.00 EXTENDED_LIMITS 0.00 255.0 /end CHARACTERISTIC
/begin CHARACTERISTIC DFES_Cls.DFC_Layer_GENHTBNpl_C "DFES/Fehlerklasse für Prüfung DFC_Layer_GENHTBNpl" VALUE 0x80023753 Val_Wu8 29.00 DFES_OneToOne 0.00 29.00 EXTENDED_LIMITS 0.00 255.0 /end CHARACTERISTIC
/begin CHARACTERISTIC DFES_Cls.DFC_Layer_GENHTBSig_C "DFES/Fehlerklasse für Prüfung DFC_Layer_GENHTBSig" VALUE 0x80023754 Val_Wu8 29.00 DFES_OneToOne 0.00 29.00 EXTENDED_LIMITS 0.00 255.0 /end CHARACTERISTIC
/begin CHARACTERISTIC DFES_Cls.DFC_Layer_GENHTMax_C "DFES/Fehlerklasse für Prüfung DFC_Layer_GENHTMax" VALUE 0x80023755 Val_Wu8 29.00 DFES_OneToOne 0.00 29.00 EXTENDED_LIMITS 0.00 255.0 /end CHARACTERISTIC
/begin CHARACTERISTIC DFES_Cls.DFC_Layer_GENHTMin_C "DFES/Fehlerklasse für Prüfung DFC_Layer_GENHTMin" VALUE 0x80023756 Val_Wu8 29.00 DFES_OneToOne 0.00 29.00 EXTENDED_LIMITS 0.00 255.0 /end CHARACTERISTIC
/begin CHARACTERISTIC DFES_Cls.DFC_Layer_GENHTNpl_C "DFES/Fehlerklasse für Prüfung DFC_Layer_GENHTNpl" VALUE 0x80023757 Val_Wu8 29.00 DFES_OneToOne 0.00 29.00 EXTENDED_LIMITS 0.00 255.0 /end CHARACTERISTIC
/begin CHARACTERISTIC DFES_Cls.DFC_Layer_GENHTSig_C "DFES/Fehlerklasse für Prüfung DFC_Layer_GENHTSig" VALUE 0x80023758 Val_Wu8 29.00 DFES_OneToOne 0.00 29.00 EXTENDED_LIMITS 0.00 255.0 /end CHARACTERISTIC
/begin CHARACTERISTIC DFES_Cls.DFC_Layer_GENKOMMMax_C "DFES/Fehlerklasse für Prüfung DFC_Layer_GENKOMMMax" VALUE 0x80023759 Val_Wu8 29.00 DFES_OneToOne 0.00 29.00 EXTENDED_LIMITS 0.00 255.0 /end CHARACTERISTIC
/begin CHARACTERISTIC DFES_Cls.DFC_Layer_GENKOMMMin_C "DFES/Fehlerklasse für Prüfung DFC_Layer_GENKOMMMin" VALUE 0x8002375A Val_Wu8 29.00 DFES_OneToOne 0.00 29.00 EXTENDED_LIMITS 0.00 255.0 /end CHARACTERISTIC
/begin CHARACTERISTIC DFES_Cls.DFC_Layer_GENKOMMNpl_C "DFES/Fehlerklasse für Prüfung DFC_Layer_GENKOMMNpl" VALUE 0x8002375B Val_Wu8 29.00 DFES_OneToOne 0.00 29.00 EXTENDED_LIMITS 0.00 255.0 /end CHARACTERISTIC
/begin CHARACTERISTIC DFES_Cls.DFC_Layer_GENKOMMSig_C "DFES/Fehlerklasse für Prüfung DFC_Layer_GENKOMMSig" VALUE 0x8002375C Val_Wu8 29.00 DFES_OneToOne 0.00 29.00 EXTENDED_LIMITS 0.00 255.0 /end CHARACTERISTIC
/begin CHARACTERISTIC DFES_Cls.DFC_Layer_GENMECHMax_C "DFES/Fehlerklasse für Prüfung DFC_Layer_GENMECHMax" VALUE 0x8002375D Val_Wu8 29.00 DFES_OneToOne 0.00 29.00 EXTENDED_LIMITS 0.00 255.0 /end CHARACTERISTIC
/begin CHARACTERISTIC DFES_Cls.DFC_Layer_GENMECHMin_C "DFES/Fehlerklasse für Prüfung DFC_Layer_GENMECHMin" VALUE 0x8002375E Val_Wu8 29.00 DFES_OneToOne 0.00 29.00 EXTENDED_LIMITS 0.00 255.0 /end CHARACTERISTIC
/begin CHARACTERISTIC DFES_Cls.DFC_Layer_GENMECHNpl_C "DFES/Fehlerklasse für Prüfung DFC_Layer_GENMECHNpl" VALUE 0x8002375F Val_Wu8 29.00 DFES_OneToOne 0.00 29.00 EXTENDED_LIMITS 0.00 255.0 /end CHARACTERISTIC
/begin CHARACTERISTIC DFES_Cls.DFC_Layer_GENMECHSig_C "DFES/Fehlerklasse für Prüfung DFC_Layer_GENMECHSig" VALUE 0x80023760 Val_Wu8 29.00 DFES_OneToOne 0.00 29.00 EXTENDED_LIMITS 0.00 255.0 /end CHARACTERISTIC
/begin CHARACTERISTIC DFES_Cls.DFC_Layer_GENMax_C "DFES/Fehlerklasse für Prüfung DFC_Layer_GENMax" VALUE 0x80023761 Val_Wu8 29.00 DFES_OneToOne 0.00 29.00 EXTENDED_LIMITS 0.00 255.0 /end CHARACTERISTIC
/begin CHARACTERISTIC DFES_Cls.DFC_Layer_GENMin_C "DFES/Fehlerklasse für Prüfung DFC_Layer_GENMin" VALUE 0x80023762 Val_Wu8 29.00 DFES_OneToOne 0.00 29.00 EXTENDED_LIMITS 0.00 255.0 /end CHARACTERISTIC
/begin CHARACTERISTIC DFES_Cls.DFC_Layer_GENNpl_C "DFES/Fehlerklasse für Prüfung DFC_Layer_GENNpl" VALUE 0x80023763 Val_Wu8 29.00 DFES_OneToOne 0.00 29.00 EXTENDED_LIMITS 0.00 255.0 /end CHARACTERISTIC
/begin CHARACTERISTIC DFES_Cls.DFC_Layer_GENREGUPLMax_C "DFES/Fehlerklasse für Prüfung DFC_Layer_GENREGUPLMax" VALUE 0x80023764 Val_Wu8 29.00 DFES_OneToOne 0.00 29.00 EXTENDED_LIMITS 0.00 255.0 /end CHARACTERISTIC
/begin CHARACTERISTIC DFES_Cls.DFC_Layer_GENREGUPLMin_C "DFES/Fehlerklasse für Prüfung DFC_Layer_GENREGUPLMin" VALUE 0x80023765 Val_Wu8 29.00 DFES_OneToOne 0.00 29.00 EXTENDED_LIMITS 0.00 255.0 /end CHARACTERISTIC
/begin CHARACTERISTIC DFES_Cls.DFC_Layer_GENREGUPLNpl_C "DFES/Fehlerklasse für Prüfung DFC_Layer_GENREGUPLNpl" VALUE 0x80023766 Val_Wu8 29.00 DFES_OneToOne 0.00 29.00 EXTENDED_LIMITS 0.00 255.0 /end CHARACTERISTIC
/begin CHARACTERISTIC DFES_Cls.DFC_Layer_GENREGUPLSig_C "DFES/Fehlerklasse für Prüfung DFC_Layer_GENREGUPLSig" VALUE 0x80023767 Val_Wu8 29.00 DFES_OneToOne 0.00 29.00 EXTENDED_LIMITS 0.00 255.0 /end CHARACTERISTIC
/begin CHARACTERISTIC DFES_Cls.DFC_Layer_GENSig_C "DFES/Fehlerklasse für Prüfung DFC_Layer_GENSig" VALUE 0x80023768 Val_Wu8 29.00 DFES_OneToOne 0.00 29.00 EXTENDED_LIMITS 0.00 255.0 /end CHARACTERISTIC
/begin CHARACTERISTIC DFES_Cls.DFC_Layer_GENUPLMax_C "DFES/Fehlerklasse für Prüfung DFC_Layer_GENUPLMax" VALUE 0x80023769 Val_Wu8 29.00 DFES_OneToOne 0.00 29.00 EXTENDED_LIMITS 0.00 255.0 /end CHARACTERISTIC
/begin CHARACTERISTIC DFES_Cls.DFC_Layer_GENUPLMin_C "DFES/Fehlerklasse für Prüfung DFC_Layer_GENUPLMin" VALUE 0x8002376A Val_Wu8 29.00 DFES_OneToOne 0.00 29.00 EXTENDED_LIMITS 0.00 255.0 /end CHARACTERISTIC
/begin CHARACTERISTIC DFES_Cls.DFC_Layer_GENUPLNpl_C "DFES/Fehlerklasse für Prüfung DFC_Layer_GENUPLNpl" VALUE 0x8002376B Val_Wu8 29.00 DFES_OneToOne 0.00 29.00 EXTENDED_LIMITS 0.00 255.0 /end CHARACTERISTIC
/begin CHARACTERISTIC DFES_Cls.DFC_Layer_GENUPLSig_C "DFES/Fehlerklasse für Prüfung DFC_Layer_GENUPLSig" VALUE 0x8002376C Val_Wu8 29.00 DFES_OneToOne 0.00 29.00 EXTENDED_LIMITS 0.00 255.0 /end CHARACTERISTIC
/begin CHARACTERISTIC DFES_Cls.DFC_Layer_IBS1Max_C "DFES/Fehlerklasse für Prüfung DFC_Layer_IBS1Max" VALUE 0x8002376D Val_Wu8 29.00 DFES_OneToOne 0.00 29.00 EXTENDED_LIMITS 0.00 255.0 /end CHARACTERISTIC
/begin CHARACTERISTIC DFES_Cls.DFC_Layer_IBS1Min_C "DFES/Fehlerklasse für Prüfung DFC_Layer_IBS1Min" VALUE 0x8002376E Val_Wu8 29.00 DFES_OneToOne 0.00 29.00 EXTENDED_LIMITS 0.00 255.0 /end CHARACTERISTIC
/begin CHARACTERISTIC DFES_Cls.DFC_Layer_IBS1Npl_C "DFES/Fehlerklasse für Prüfung DFC_Layer_IBS1Npl" VALUE 0x8002376F Val_Wu8 29.00 DFES_OneToOne 0.00 29.00 EXTENDED_LIMITS 0.00 255.0 /end CHARACTERISTIC
/begin CHARACTERISTIC DFES_Cls.DFC_Layer_IBS1Sig_C "DFES/Fehlerklasse für Prüfung DFC_Layer_IBS1Sig" VALUE 0x80023770 Val_Wu8 29.00 DFES_OneToOne 0.00 29.00 EXTENDED_LIMITS 0.00 255.0 /end CHARACTERISTIC
/begin CHARACTERISTIC DFES_Cls.DFC_Layer_IBS2Max_C "DFES/Fehlerklasse für Prüfung DFC_Layer_IBS2Max" VALUE 0x80023771 Val_Wu8 29.00 DFES_OneToOne 0.00 29.00 EXTENDED_LIMITS 0.00 255.0 /end CHARACTERISTIC
/begin CHARACTERISTIC DFES_Cls.DFC_Layer_IBS2Min_C "DFES/Fehlerklasse für Prüfung DFC_Layer_IBS2Min" VALUE 0x80023772 Val_Wu8 29.00 DFES_OneToOne 0.00 29.00 EXTENDED_LIMITS 0.00 255.0 /end CHARACTERISTIC
/begin CHARACTERISTIC DFES_Cls.DFC_Layer_IBS2Npl_C "DFES/Fehlerklasse für Prüfung DFC_Layer_IBS2Npl" VALUE 0x80023773 Val_Wu8 29.00 DFES_OneToOne 0.00 29.00 EXTENDED_LIMITS 0.00 255.0 /end CHARACTERISTIC
/begin CHARACTERISTIC DFES_Cls.DFC_Layer_IBS2Sig_C "DFES/Fehlerklasse für Prüfung DFC_Layer_IBS2Sig" VALUE 0x80023774 Val_Wu8 29.00 DFES_OneToOne 0.00 29.00 EXTENDED_LIMITS 0.00 255.0 /end CHARACTERISTIC
/begin CHARACTERISTIC DFES_Cls.DFC_Layer_IBS3Max_C "DFES/Fehlerklasse für Prüfung DFC_Layer_IBS3Max" VALUE 0x80023775 Val_Wu8 29.00 DFES_OneToOne 0.00 29.00 EXTENDED_LIMITS 0.00 255.0 /end CHARACTERISTIC
/begin CHARACTERISTIC DFES_Cls.DFC_Layer_IBS3Min_C "DFES/Fehlerklasse für Prüfung DFC_Layer_IBS3Min" VALUE 0x80023776 Val_Wu8 29.00 DFES_OneToOne 0.00 29.00 EXTENDED_LIMITS 0.00 255.0 /end CHARACTERISTIC
/begin CHARACTERISTIC DFES_Cls.DFC_Layer_IBS3Npl_C "DFES/Fehlerklasse für Prüfung DFC_Layer_IBS3Npl" VALUE 0x80023777 Val_Wu8 29.00 DFES_OneToOne 0.00 29.00 EXTENDED_LIMITS 0.00 255.0 /end CHARACTERISTIC
/begin CHARACTERISTIC DFES_Cls.DFC_Layer_IBS3Sig_C "DFES/Fehlerklasse für Prüfung DFC_Layer_IBS3Sig" VALUE 0x80023778 Val_Wu8 29.00 DFES_OneToOne 0.00 29.00 EXTENDED_LIMITS 0.00 255.0 /end CHARACTERISTIC
/begin CHARACTERISTIC DFES_Cls.DFC_Layer_MANDETEKMax_C "DFES/Fehlerklasse für Prüfung DFC_Layer_MANDETEKMax" VALUE 0x80023779 Val_Wu8 29.00 DFES_OneToOne 0.00 29.00 EXTENDED_LIMITS 0.00 255.0 /end CHARACTERISTIC
/begin CHARACTERISTIC DFES_Cls.DFC_Layer_MANDETEKMin_C "DFES/Fehlerklasse für Prüfung DFC_Layer_MANDETEKMin" VALUE 0x8002377A Val_Wu8 29.00 DFES_OneToOne 0.00 29.00 EXTENDED_LIMITS 0.00 255.0 /end CHARACTERISTIC
/begin CHARACTERISTIC DFES_Cls.DFC_Layer_MANDETEKNpl_C "DFES/Fehlerklasse für Prüfung DFC_Layer_MANDETEKNpl" VALUE 0x8002377B Val_Wu8 29.00 DFES_OneToOne 0.00 29.00 EXTENDED_LIMITS 0.00 255.0 /end CHARACTERISTIC
/begin CHARACTERISTIC DFES_Cls.DFC_Layer_MANDETEKSig_C "DFES/Fehlerklasse für Prüfung DFC_Layer_MANDETEKSig" VALUE 0x8002377C Val_Wu8 29.00 DFES_OneToOne 0.00 29.00 EXTENDED_LIMITS 0.00 255.0 /end CHARACTERISTIC
/begin CHARACTERISTIC DFES_Cls.DFC_Layer_NDR1Max_C "DFES/Fehlerklasse für Prüfung DFC_Layer_NDR1Max" VALUE 0x8002377D Val_Wu8 29.00 DFES_OneToOne 0.00 29.00 EXTENDED_LIMITS 0.00 255.0 /end CHARACTERISTIC
/begin CHARACTERISTIC DFES_Cls.DFC_Layer_NDR1Min_C "DFES/Fehlerklasse für Prüfung DFC_Layer_NDR1Min" VALUE 0x8002377E Val_Wu8 29.00 DFES_OneToOne 0.00 29.00 EXTENDED_LIMITS 0.00 255.0 /end CHARACTERISTIC
/begin CHARACTERISTIC DFES_Cls.DFC_Layer_NDR1Npl_C "DFES/Fehlerklasse für Prüfung DFC_Layer_NDR1Npl" VALUE 0x8002377F Val_Wu8 29.00 DFES_OneToOne 0.00 29.00 EXTENDED_LIMITS 0.00 255.0 /end CHARACTERISTIC
/begin CHARACTERISTIC DFES_Cls.DFC_Layer_NDR1Sig_C "DFES/Fehlerklasse für Prüfung DFC_Layer_NDR1Sig" VALUE 0x80023780 Val_Wu8 29.00 DFES_OneToOne 0.00 29.00 EXTENDED_LIMITS 0.00 255.0 /end CHARACTERISTIC
/begin CHARACTERISTIC DFES_Cls.DFC_Layer_NDR2Max_C "DFES/Fehlerklasse für Prüfung DFC_Layer_NDR2Max" VALUE 0x80023781 Val_Wu8 29.00 DFES_OneToOne 0.00 29.00 EXTENDED_LIMITS 0.00 255.0 /end CHARACTERISTIC
/begin CHARACTERISTIC DFES_Cls.DFC_Layer_NDR2Min_C "DFES/Fehlerklasse für Prüfung DFC_Layer_NDR2Min" VALUE 0x80023782 Val_Wu8 29.00 DFES_OneToOne 0.00 29.00 EXTENDED_LIMITS 0.00 255.0 /end CHARACTERISTIC
/begin CHARACTERISTIC DFES_Cls.DFC_Layer_NDR2Npl_C "DFES/Fehlerklasse für Prüfung DFC_Layer_NDR2Npl" VALUE 0x80023783 Val_Wu8 29.00 DFES_OneToOne 0.00 29.00 EXTENDED_LIMITS 0.00 255.0 /end CHARACTERISTIC
/begin CHARACTERISTIC DFES_Cls.DFC_Layer_NDR2Sig_C "DFES/Fehlerklasse für Prüfung DFC_Layer_NDR2Sig" VALUE 0x80023784 Val_Wu8 29.00 DFES_OneToOne 0.00 29.00 EXTENDED_LIMITS 0.00 255.0 /end CHARACTERISTIC
/begin CHARACTERISTIC DFES_Cls.DFC_Layer_NGLERNMax_C "DFES/Fehlerklasse für Prüfung DFC_Layer_NGLERNMax" VALUE 0x80023785 Val_Wu8 29.00 DFES_OneToOne 0.00 29.00 EXTENDED_LIMITS 0.00 255.0 /end CHARACTERISTIC
/begin CHARACTERISTIC DFES_Cls.DFC_Layer_NGLERNMin_C "DFES/Fehlerklasse für Prüfung DFC_Layer_NGLERNMin" VALUE 0x80023786 Val_Wu8 29.00 DFES_OneToOne 0.00 29.00 EXTENDED_LIMITS 0.00 255.0 /end CHARACTERISTIC
/begin CHARACTERISTIC DFES_Cls.DFC_Layer_NGLERNNpl_C "DFES/Fehlerklasse für Prüfung DFC_Layer_NGLERNNpl" VALUE 0x80023787 Val_Wu8 29.00 DFES_OneToOne 0.00 29.00 EXTENDED_LIMITS 0.00 255.0 /end CHARACTERISTIC
/begin CHARACTERISTIC DFES_Cls.DFC_Layer_NGLERNSig_C "DFES/Fehlerklasse für Prüfung DFC_Layer_NGLERNSig" VALUE 0x80023788 Val_Wu8 29.00 DFES_OneToOne 0.00 29.00 EXTENDED_LIMITS 0.00 255.0 /end CHARACTERISTIC
/begin CHARACTERISTIC DFES_Cls.DFC_Layer_PMBATTMax_C "DFES/Fehlerklasse für Prüfung DFC_Layer_PMBATTMax" VALUE 0x80023789 Val_Wu8 29.00 DFES_OneToOne 0.00 29.00 EXTENDED_LIMITS 0.00 255.0 /end CHARACTERISTIC
/begin CHARACTERISTIC DFES_Cls.DFC_Layer_PMBATTMin_C "DFES/Fehlerklasse für Prüfung DFC_Layer_PMBATTMin" VALUE 0x8002378A Val_Wu8 29.00 DFES_OneToOne 0.00 29.00 EXTENDED_LIMITS 0.00 255.0 /end CHARACTERISTIC
/begin CHARACTERISTIC DFES_Cls.DFC_Layer_PMBATTNpl_C "DFES/Fehlerklasse für Prüfung DFC_Layer_PMBATTNpl" VALUE 0x8002378B Val_Wu8 29.00 DFES_OneToOne 0.00 29.00 EXTENDED_LIMITS 0.00 255.0 /end CHARACTERISTIC
/begin CHARACTERISTIC DFES_Cls.DFC_Layer_PMBATTSig_C "DFES/Fehlerklasse für Prüfung DFC_Layer_PMBATTSig" VALUE 0x8002378C Val_Wu8 29.00 DFES_OneToOne 0.00 29.00 EXTENDED_LIMITS 0.00 255.0 /end CHARACTERISTIC
/begin CHARACTERISTIC DFES_Cls.DFC_Layer_PMBNMax_C "DFES/Fehlerklasse für Prüfung DFC_Layer_PMBNMax" VALUE 0x8002378D Val_Wu8 29.00 DFES_OneToOne 0.00 29.00 EXTENDED_LIMITS 0.00 255.0 /end CHARACTERISTIC
/begin CHARACTERISTIC DFES_Cls.DFC_Layer_PMBNMin_C "DFES/Fehlerklasse für Prüfung DFC_Layer_PMBNMin" VALUE 0x8002378E Val_Wu8 29.00 DFES_OneToOne 0.00 29.00 EXTENDED_LIMITS 0.00 255.0 /end CHARACTERISTIC
/begin CHARACTERISTIC DFES_Cls.DFC_Layer_PMBNNpl_C "DFES/Fehlerklasse für Prüfung DFC_Layer_PMBNNpl" VALUE 0x8002378F Val_Wu8 29.00 DFES_OneToOne 0.00 29.00 EXTENDED_LIMITS 0.00 255.0 /end CHARACTERISTIC
/begin CHARACTERISTIC DFES_Cls.DFC_Layer_PMBNSig_C "DFES/Fehlerklasse für Prüfung DFC_Layer_PMBNSig" VALUE 0x80023790 Val_Wu8 29.00 DFES_OneToOne 0.00 29.00 EXTENDED_LIMITS 0.00 255.0 /end CHARACTERISTIC
/begin CHARACTERISTIC DFES_Cls.DFC_Layer_PMRUHVERLMax_C "DFES/Fehlerklasse für Prüfung DFC_Layer_PMRUHVERLMax" VALUE 0x80023791 Val_Wu8 29.00 DFES_OneToOne 0.00 29.00 EXTENDED_LIMITS 0.00 255.0 /end CHARACTERISTIC
/begin CHARACTERISTIC DFES_Cls.DFC_Layer_PMRUHVERLMin_C "DFES/Fehlerklasse für Prüfung DFC_Layer_PMRUHVERLMin" VALUE 0x80023792 Val_Wu8 29.00 DFES_OneToOne 0.00 29.00 EXTENDED_LIMITS 0.00 255.0 /end CHARACTERISTIC
/begin CHARACTERISTIC DFES_Cls.DFC_Layer_PMRUHVERLNpl_C "DFES/Fehlerklasse für Prüfung DFC_Layer_PMRUHVERLNpl" VALUE 0x80023793 Val_Wu8 29.00 DFES_OneToOne 0.00 29.00 EXTENDED_LIMITS 0.00 255.0 /end CHARACTERISTIC
/begin CHARACTERISTIC DFES_Cls.DFC_Layer_PMRUHVERLSig_C "DFES/Fehlerklasse für Prüfung DFC_Layer_PMRUHVERLSig" VALUE 0x80023794 Val_Wu8 29.00 DFES_OneToOne 0.00 29.00 EXTENDED_LIMITS 0.00 255.0 /end CHARACTERISTIC
/begin CHARACTERISTIC DFES_Cls.DFC_Layer_QLTMax_C "DFES/Fehlerklasse für Prüfung DFC_Layer_QLTMax" VALUE 0x80023795 Val_Wu8 29.00 DFES_OneToOne 0.00 29.00 EXTENDED_LIMITS 0.00 255.0 /end CHARACTERISTIC
/begin CHARACTERISTIC DFES_Cls.DFC_Layer_QLTMin_C "DFES/Fehlerklasse für Prüfung DFC_Layer_QLTMin" VALUE 0x80023796 Val_Wu8 29.00 DFES_OneToOne 0.00 29.00 EXTENDED_LIMITS 0.00 255.0 /end CHARACTERISTIC
/begin CHARACTERISTIC DFES_Cls.DFC_Layer_QLTNpl_C "DFES/Fehlerklasse für Prüfung DFC_Layer_QLTNpl" VALUE 0x80023797 Val_Wu8 29.00 DFES_OneToOne 0.00 29.00 EXTENDED_LIMITS 0.00 255.0 /end CHARACTERISTIC
/begin CHARACTERISTIC DFES_Cls.DFC_Layer_QLTSig_C "DFES/Fehlerklasse für Prüfung DFC_Layer_QLTSig" VALUE 0x80023798 Val_Wu8 29.00 DFES_OneToOne 0.00 29.00 EXTENDED_LIMITS 0.00 255.0 /end CHARACTERISTIC
/begin CHARACTERISTIC DFES_Cls.DFC_Layer_TOENSMax_C "DFES/Fehlerklasse für Prüfung DFC_Layer_TOENSMax" VALUE 0x80023799 Val_Wu8 29.00 DFES_OneToOne 0.00 29.00 EXTENDED_LIMITS 0.00 255.0 /end CHARACTERISTIC
/begin CHARACTERISTIC DFES_Cls.DFC_Layer_TOENSMin_C "DFES/Fehlerklasse für Prüfung DFC_Layer_TOENSMin" VALUE 0x8002379A Val_Wu8 29.00 DFES_OneToOne 0.00 29.00 EXTENDED_LIMITS 0.00 255.0 /end CHARACTERISTIC
/begin CHARACTERISTIC DFES_Cls.DFC_Layer_TOENSNpl_C "DFES/Fehlerklasse für Prüfung DFC_Layer_TOENSNpl" VALUE 0x8002379B Val_Wu8 29.00 DFES_OneToOne 0.00 29.00 EXTENDED_LIMITS 0.00 255.0 /end CHARACTERISTIC
/begin CHARACTERISTIC DFES_Cls.DFC_Layer_TOENSSig_C "DFES/Fehlerklasse für Prüfung DFC_Layer_TOENSSig" VALUE 0x8002379C Val_Wu8 29.00 DFES_OneToOne 0.00 29.00 EXTENDED_LIMITS 0.00 255.0 /end CHARACTERISTIC
/begin CHARACTERISTIC DFES_Cls.DFC_MonLimCurr_C "DFES/Fehlerklasse für Prüfung DFC_MonLimCurr" VALUE 0x8002379D Val_Wu8 29.00 DFES_OneToOne 0.00 29.00 EXTENDED_LIMITS 0.00 255.0 /end CHARACTERISTIC
/begin CHARACTERISTIC DFES_Cls.DFC_MonLimLead_C "DFES/Fehlerklasse für Prüfung DFC_MonLimLead" VALUE 0x8002379E Val_Wu8 29.00 DFES_OneToOne 0.00 29.00 EXTENDED_LIMITS 0.00 255.0 /end CHARACTERISTIC
/begin CHARACTERISTIC DFES_Cls.DFC_MonLimSet_C "DFES/Fehlerklasse für Prüfung DFC_MonLimSet" VALUE 0x8002379F Val_Wu8 29.00 DFES_OneToOne 0.00 29.00 EXTENDED_LIMITS 0.00 255.0 /end CHARACTERISTIC
/begin CHARACTERISTIC DFES_Cls.DFC_NSCDsNOxOfsMax_C "DFES/Fehlerklasse für Prüfung DFC_NSCDsNOxOfsMax" VALUE 0x800237A0 Val_Wu8 29.00 DFES_OneToOne 0.00 29.00 EXTENDED_LIMITS 0.00 255.0 /end CHARACTERISTIC
/begin CHARACTERISTIC DFES_Cls.DFC_NSCDsNOxOfsMin_C "DFES/Fehlerklasse für Prüfung DFC_NSCDsNOxOfsMin" VALUE 0x800237A1 Val_Wu8 29.00 DFES_OneToOne 0.00 29.00 EXTENDED_LIMITS 0.00 255.0 /end CHARACTERISTIC
/begin CHARACTERISTIC DFES_Cls.DFC_NSCDsNOxPlausMin_C "DFES/Fehlerklasse für Prüfung DFC_NSCDsNOxPlausMin" VALUE 0x800237A2 Val_Wu8 29.00 DFES_OneToOne 0.00 29.00 EXTENDED_LIMITS 0.00 255.0 /end CHARACTERISTIC
/begin CHARACTERISTIC DFES_Cls.DFC_NoCat2DsNOxOfsMax_C "DFES/Fehlerklasse für Prüfung DFC_NoCat2DsNOxOfsMax" VALUE 0x800237A3 Val_Wu8 29.00 DFES_OneToOne 0.00 29.00 EXTENDED_LIMITS 0.00 255.0 /end CHARACTERISTIC
/begin CHARACTERISTIC DFES_Cls.DFC_NoCat2DsNOxOfsMin_C "DFES/Fehlerklasse für Prüfung DFC_NoCat2DsNOxOfsMin" VALUE 0x800237A4 Val_Wu8 29.00 DFES_OneToOne 0.00 29.00 EXTENDED_LIMITS 0.00 255.0 /end CHARACTERISTIC
/begin CHARACTERISTIC DFES_Cls.DFC_NoCat2DsNOxPlausMin_C "DFES/Fehlerklasse für Prüfung DFC_NoCat2DsNOxPlausMin" VALUE 0x800237A5 Val_Wu8 29.00 DFES_OneToOne 0.00 29.00 EXTENDED_LIMITS 0.00 255.0 /end CHARACTERISTIC
/begin CHARACTERISTIC DFES_Cls.DFC_PCVNoStrt_C "DFES/Fehlerklasse für Prüfung DFC_PCVNoStrt" VALUE 0x800237A6 Val_Wu8 29.00 DFES_OneToOne 0.00 29.00 EXTENDED_LIMITS 0.00 255.0 /end CHARACTERISTIC
/begin CHARACTERISTIC DFES_Cls.DFC_RailPGradMon_C "DFES/Fehlerklasse für Prüfung DFC_RailPGradMon" VALUE 0x800237A7 Val_Wu8 29.00 DFES_OneToOne 0.00 29.00 EXTENDED_LIMITS 0.00 255.0 /end CHARACTERISTIC
/begin CHARACTERISTIC DFES_Cls.DFC_SCRPODPresBuildUp_C "DFES/Fehlerklasse für Prüfung DFC_SCRPODPresBuildUp" VALUE 0x800237A8 Val_Wu8 29.00 DFES_OneToOne 0.00 29.00 EXTENDED_LIMITS 0.00 255.0 /end CHARACTERISTIC
/begin CHARACTERISTIC DFES_Cls.DFC_AFSDrftIdlAdjVal_C "DFES/Fehlerklasse für Prüfung DFC_AFSDrftIdlAdjVal" VALUE 0x800237A9 Val_Wu8 29.00 DFES_OneToOne 0.00 29.00 EXTENDED_LIMITS 0.00 255.0 /end CHARACTERISTIC
/begin CHARACTERISTIC DFES_Cls.DFC_AFSDrftLdAdjVal_C "DFES/Fehlerklasse für Prüfung DFC_AFSDrftLdAdjVal" VALUE 0x800237AA Val_Wu8 29.00 DFES_OneToOne 0.00 29.00 EXTENDED_LIMITS 0.00 255.0 /end CHARACTERISTIC
/begin CHARACTERISTIC DFES_Cls.DFC_AdcIADC0Cal_C "DFES/Fehlerklasse für Prüfung DFC_AdcIADC0Cal" VALUE 0x800237AB Val_Wu8 29.00 DFES_OneToOne 0.00 29.00 EXTENDED_LIMITS 0.00 255.0 /end CHARACTERISTIC
/begin CHARACTERISTIC DFES_Cls.DFC_AdcIADC0Conv_C "DFES/Fehlerklasse für Prüfung DFC_AdcIADC0Conv" VALUE 0x800237AC Val_Wu8 29.00 DFES_OneToOne 0.00 29.00 EXTENDED_LIMITS 0.00 255.0 /end CHARACTERISTIC
/begin CHARACTERISTIC DFES_Cls.DFC_AdcIADC1Cal_C "DFES/Fehlerklasse für Prüfung DFC_AdcIADC1Cal" VALUE 0x800237AD Val_Wu8 29.00 DFES_OneToOne 0.00 29.00 EXTENDED_LIMITS 0.00 255.0 /end CHARACTERISTIC
/begin CHARACTERISTIC DFES_Cls.DFC_AdcIADC1Conv_C "DFES/Fehlerklasse für Prüfung DFC_AdcIADC1Conv" VALUE 0x800237AE Val_Wu8 29.00 DFES_OneToOne 0.00 29.00 EXTENDED_LIMITS 0.00 255.0 /end CHARACTERISTIC
/begin CHARACTERISTIC DFES_Cls.DFC_CmbChbMisfireMax_0_C "DFES/Fehlerklasse für Prüfung DFC_CmbChbMisfireMax_0" VALUE 0x800237AF Val_Wu8 29.00 DFES_OneToOne 0.00 29.00 EXTENDED_LIMITS 0.00 255.0 /end CHARACTERISTIC
/begin CHARACTERISTIC DFES_Cls.DFC_CmbChbMisfireMax_1_C "DFES/Fehlerklasse für Prüfung DFC_CmbChbMisfireMax_1" VALUE 0x800237B0 Val_Wu8 29.00 DFES_OneToOne 0.00 29.00 EXTENDED_LIMITS 0.00 255.0 /end CHARACTERISTIC
/begin CHARACTERISTIC DFES_Cls.DFC_CmbChbMisfireMax_2_C "DFES/Fehlerklasse für Prüfung DFC_CmbChbMisfireMax_2" VALUE 0x800237B1 Val_Wu8 29.00 DFES_OneToOne 0.00 29.00 EXTENDED_LIMITS 0.00 255.0 /end CHARACTERISTIC
/begin CHARACTERISTIC DFES_Cls.DFC_CmbChbMisfireMax_3_C "DFES/Fehlerklasse für Prüfung DFC_CmbChbMisfireMax_3" VALUE 0x800237B2 Val_Wu8 29.00 DFES_OneToOne 0.00 29.00 EXTENDED_LIMITS 0.00 255.0 /end CHARACTERISTIC
/begin CHARACTERISTIC DFES_Cls.DFC_CmbChbMisfireMax_4_C "DFES/Fehlerklasse für Prüfung DFC_CmbChbMisfireMax_4" VALUE 0x800237B3 Val_Wu8 29.00 DFES_OneToOne 0.00 29.00 EXTENDED_LIMITS 0.00 255.0 /end CHARACTERISTIC
/begin CHARACTERISTIC DFES_Cls.DFC_CmbChbMisfireMax_5_C "DFES/Fehlerklasse für Prüfung DFC_CmbChbMisfireMax_5" VALUE 0x800237B4 Val_Wu8 29.00 DFES_OneToOne 0.00 29.00 EXTENDED_LIMITS 0.00 255.0 /end CHARACTERISTIC
/begin CHARACTERISTIC DFES_Cls.DFC_CmbChbMisfireMul_C "DFES/Fehlerklasse für Prüfung DFC_CmbChbMisfireMul" VALUE 0x800237B5 Val_Wu8 29.00 DFES_OneToOne 0.00 29.00 EXTENDED_LIMITS 0.00 255.0 /end CHARACTERISTIC
/begin CHARACTERISTIC DFES_Cls.DFC_EGRVlvLPOfsNeutr_C "DFES/" VALUE 0x800237B6 Val_Wu8 29.00 DFES_OneToOne 0.00 29.00 EXTENDED_LIMITS 0.00 255.0 /end CHARACTERISTIC
/begin CHARACTERISTIC DFES_Cls.DFC_EGRVlvOfsNeutr_C "DFES/Fehlerklasse für Prüfung DFC_EGRVlvOfsNeutr" VALUE 0x800237B7 Val_Wu8 29.00 DFES_OneToOne 0.00 29.00 EXTENDED_LIMITS 0.00 255.0 /end CHARACTERISTIC
/begin CHARACTERISTIC DFES_Cls.DFC_FMAErrModMax_C "DFES/Fehlerklasse für Prüfung DFC_FMAErrModMax" VALUE 0x800237B8 Val_Wu8 29.00 DFES_OneToOne 0.00 29.00 EXTENDED_LIMITS 0.00 255.0 /end CHARACTERISTIC
/begin CHARACTERISTIC DFES_Cls.DFC_FMAErrModMin_C "DFES/Fehlerklasse für Prüfung DFC_FMAErrModMin" VALUE 0x800237B9 Val_Wu8 29.00 DFES_OneToOne 0.00 29.00 EXTENDED_LIMITS 0.00 255.0 /end CHARACTERISTIC
/begin CHARACTERISTIC DFES_Cls.DFC_FlSysTnkLo_C "DFES/Fehlerklasse für Prüfung DFC_FlSysTnkLo" VALUE 0x800237BA Val_Wu8 29.00 DFES_OneToOne 0.00 29.00 EXTENDED_LIMITS 0.00 255.0 /end CHARACTERISTIC
/begin CHARACTERISTIC DFES_Cls.DFC_GbxNPosPlaus_C "DFES/Fehlerklasse für Prüfung DFC_GbxNPosPlaus" VALUE 0x800237BB Val_Wu8 29.00 DFES_OneToOne 0.00 29.00 EXTENDED_LIMITS 0.00 255.0 /end CHARACTERISTIC
/begin CHARACTERISTIC DFES_Cls.DFC_I14229_ROETst_Appl_C "DFES/" VALUE 0x800237BC Val_Wu8 29.00 DFES_OneToOne 0.00 29.00 EXTENDED_LIMITS 0.00 255.0 /end CHARACTERISTIC
/begin CHARACTERISTIC DFES_Cls.DFC_I14229_ROETst_Netw_C "DFES/" VALUE 0x800237BD Val_Wu8 29.00 DFES_OneToOne 0.00 29.00 EXTENDED_LIMITS 0.00 255.0 /end CHARACTERISTIC
/begin CHARACTERISTIC DFES_Cls.DFC_I14229_ROE_BufFull_C "DFES/" VALUE 0x800237BE Val_Wu8 29.00 DFES_OneToOne 0.00 29.00 EXTENDED_LIMITS 0.00 255.0 /end CHARACTERISTIC
/begin CHARACTERISTIC DFES_Cls.DFC_IVAdjDiaIVAdj_C "DFES/Fehlerklasse für Prüfung DFC_IVAdjDiaIVAdj" VALUE 0x800237BF Val_Wu8 29.00 DFES_OneToOne 0.00 29.00 EXTENDED_LIMITS 0.00 255.0 /end CHARACTERISTIC
/begin CHARACTERISTIC DFES_Cls.DFC_IVAdjIVA_0_C "DFES/Fehlerklasse für Prüfung DFC_IVAdjIVA_0" VALUE 0x800237C0 Val_Wu8 29.00 DFES_OneToOne 0.00 29.00 EXTENDED_LIMITS 0.00 255.0 /end CHARACTERISTIC
/begin CHARACTERISTIC DFES_Cls.DFC_IVAdjIVA_1_C "DFES/Fehlerklasse für Prüfung DFC_IVAdjIVA_1" VALUE 0x800237C1 Val_Wu8 29.00 DFES_OneToOne 0.00 29.00 EXTENDED_LIMITS 0.00 255.0 /end CHARACTERISTIC
/begin CHARACTERISTIC DFES_Cls.DFC_IVAdjIVA_2_C "DFES/Fehlerklasse für Prüfung DFC_IVAdjIVA_2" VALUE 0x800237C2 Val_Wu8 29.00 DFES_OneToOne 0.00 29.00 EXTENDED_LIMITS 0.00 255.0 /end CHARACTERISTIC
/begin CHARACTERISTIC DFES_Cls.DFC_IVAdjIVA_3_C "DFES/Fehlerklasse für Prüfung DFC_IVAdjIVA_3" VALUE 0x800237C3 Val_Wu8 29.00 DFES_OneToOne 0.00 29.00 EXTENDED_LIMITS 0.00 255.0 /end CHARACTERISTIC
/begin CHARACTERISTIC DFES_Cls.DFC_IVAdjIVA_4_C "DFES/Fehlerklasse für Prüfung DFC_IVAdjIVA_4" VALUE 0x800237C4 Val_Wu8 29.00 DFES_OneToOne 0.00 29.00 EXTENDED_LIMITS 0.00 255.0 /end CHARACTERISTIC
/begin CHARACTERISTIC DFES_Cls.DFC_IVAdjIVA_5_C "DFES/Fehlerklasse für Prüfung DFC_IVAdjIVA_5" VALUE 0x800237C5 Val_Wu8 29.00 DFES_OneToOne 0.00 29.00 EXTENDED_LIMITS 0.00 255.0 /end CHARACTERISTIC
/begin CHARACTERISTIC DFES_Cls.DFC_IVPSplyDCDCOff_0_C "DFES/Fehlerklasse für Prüfung DFC_IVPSplyDCDCOff_0" VALUE 0x800237C6 Val_Wu8 29.00 DFES_OneToOne 0.00 29.00 EXTENDED_LIMITS 0.00 255.0 /end CHARACTERISTIC
/begin CHARACTERISTIC DFES_Cls.DFC_IVPSplyDCDCOff_1_C "DFES/Fehlerklasse für Prüfung DFC_IVPSplyDCDCOff_1" VALUE 0x800237C7 Val_Wu8 29.00 DFES_OneToOne 0.00 29.00 EXTENDED_LIMITS 0.00 255.0 /end CHARACTERISTIC
/begin CHARACTERISTIC DFES_Cls.DFC_IVPSplyDCDCOff_2_C "DFES/Fehlerklasse für Prüfung DFC_IVPSplyDCDCOff_2" VALUE 0x800237C8 Val_Wu8 29.00 DFES_OneToOne 0.00 29.00 EXTENDED_LIMITS 0.00 255.0 /end CHARACTERISTIC
/begin CHARACTERISTIC DFES_Cls.DFC_IVPSplyDCDCOff_3_C "DFES/Fehlerklasse für Prüfung DFC_IVPSplyDCDCOff_3" VALUE 0x800237C9 Val_Wu8 29.00 DFES_OneToOne 0.00 29.00 EXTENDED_LIMITS 0.00 255.0 /end CHARACTERISTIC
/begin CHARACTERISTIC DFES_Cls.DFC_InjCtlAdjQntEEPCS_C "DFES/Fehlerklasse für Prüfung DFC_InjCtlAdjQntEEPCS" VALUE 0x800237CA Val_Wu8 29.00 DFES_OneToOne 0.00 29.00 EXTENDED_LIMITS 0.00 255.0 /end CHARACTERISTIC
/begin CHARACTERISTIC DFES_Cls.DFC_LSUSPISig_C "DFES/Fehlerklasse für Prüfung DFC_LSUSPISig" VALUE 0x800237CB Val_Wu8 29.00 DFES_OneToOne 0.00 29.00 EXTENDED_LIMITS 0.00 255.0 /end CHARACTERISTIC
/begin CHARACTERISTIC DFES_Cls.DFC_Layer_Dummy_C "DFES/Fehlerklasse für Prüfung DFC_Layer_Dummy" VALUE 0x800237CC Val_Wu8 29.00 DFES_OneToOne 0.00 29.00 EXTENDED_LIMITS 0.00 255.0 /end CHARACTERISTIC
/begin CHARACTERISTIC DFES_Cls.DFC_NplEnvPSensPPFltDiff_C "DFES/Fehlerklasse für Prüfung DFC_NplEnvPSensPPFltDiff" VALUE 0x800237CD Val_Wu8 29.00 DFES_OneToOne 0.00 29.00 EXTENDED_LIMITS 0.00 255.0 /end CHARACTERISTIC
/begin CHARACTERISTIC DFES_Cls.DFC_NplPresSensPPFltDiff_C "DFES/Fehlerklasse für Prüfung DFC_NplPresSensPPFltDiff" VALUE 0x800237CE Val_Wu8 29.00 DFES_OneToOne 0.00 29.00 EXTENDED_LIMITS 0.00 255.0 /end CHARACTERISTIC
/begin CHARACTERISTIC DFES_Cls.DFC_OilLvlPlaus_C "DFES/Fehlerklasse für Prüfung DFC_OilLvlPlaus" VALUE 0x800237CF Val_Wu8 29.00 DFES_OneToOne 0.00 29.00 EXTENDED_LIMITS 0.00 255.0 /end CHARACTERISTIC
/begin CHARACTERISTIC DFES_Cls.DFC_OilTOutLvl_C "DFES/Fehlerklasse für Prüfung DFC_OilTOutLvl" VALUE 0x800237D0 Val_Wu8 29.00 DFES_OneToOne 0.00 29.00 EXTENDED_LIMITS 0.00 255.0 /end CHARACTERISTIC
/begin CHARACTERISTIC DFES_Cls.DFC_PCVfacAdaptMax_C "DFES/Fehlerklasse für Prüfung DFC_PCVfacAdaptMax" VALUE 0x800237D1 Val_Wu8 29.00 DFES_OneToOne 0.00 29.00 EXTENDED_LIMITS 0.00 255.0 /end CHARACTERISTIC
/begin CHARACTERISTIC DFES_Cls.DFC_PCVfacAdaptMin_C "DFES/Fehlerklasse für Prüfung DFC_PCVfacAdaptMin" VALUE 0x800237D2 Val_Wu8 29.00 DFES_OneToOne 0.00 29.00 EXTENDED_LIMITS 0.00 255.0 /end CHARACTERISTIC
/begin CHARACTERISTIC DFES_Cls.DFC_SensFrzPPFltUs_C "DFES/Fehlerklasse für Prüfung DFC_SensFrzPPFltUs" VALUE 0x800237D3 Val_Wu8 29.00 DFES_OneToOne 0.00 29.00 EXTENDED_LIMITS 0.00 255.0 /end CHARACTERISTIC
/begin CHARACTERISTIC DFES_Cls.DFC_SensMonUTnkLvl_C "DFES/Fehlerklasse für Prüfung DFC_SensMonUTnkLvl" VALUE 0x800237D4 Val_Wu8 29.00 DFES_OneToOne 0.00 29.00 EXTENDED_LIMITS 0.00 255.0 /end CHARACTERISTIC
/begin CHARACTERISTIC DFES_Cls.DFC_T15Sig_C "DFES/Fehlerklasse für Prüfung DFC_T15Sig" VALUE 0x800237D5 Val_Wu8 29.00 DFES_OneToOne 0.00 29.00 EXTENDED_LIMITS 0.00 255.0 /end CHARACTERISTIC
/begin CHARACTERISTIC DFES_Cls.DFC_AirCtlRmpTOut_C "DFES/Fehlerklasse für Prüfung DFC_AirCtlRmpTOut" VALUE 0x800237D6 Val_Wu8 29.00 DFES_OneToOne 0.00 29.00 EXTENDED_LIMITS 0.00 255.0 /end CHARACTERISTIC
/begin CHARACTERISTIC DFES_Cls.DFC_BrkPPlaus_C "DFES/Fehlerklasse für Prüfung DFC_BrkPPlaus" VALUE 0x800237D7 Val_Wu8 29.00 DFES_OneToOne 0.00 29.00 EXTENDED_LIMITS 0.00 255.0 /end CHARACTERISTIC
/begin CHARACTERISTIC DFES_Cls.DFC_CEngDsTDynTst_C "DFES/Fehlerklasse für Prüfung DFC_CEngDsTDynTst" VALUE 0x800237D8 Val_Wu8 29.00 DFES_OneToOne 0.00 29.00 EXTENDED_LIMITS 0.00 255.0 /end CHARACTERISTIC
/begin CHARACTERISTIC DFES_Cls.DFC_EEPEraseErr_C "DFES/Fehlerklasse für Prüfung DFC_EEPEraseErr" VALUE 0x800237D9 Val_Wu8 29.00 DFES_OneToOne 0.00 29.00 EXTENDED_LIMITS 0.00 255.0 /end CHARACTERISTIC
/begin CHARACTERISTIC DFES_Cls.DFC_EEPRdErr_C "DFES/Fehlerklasse für Prüfung DFC_EEPRdErr" VALUE 0x800237DA Val_Wu8 29.00 DFES_OneToOne 0.00 29.00 EXTENDED_LIMITS 0.00 255.0 /end CHARACTERISTIC
/begin CHARACTERISTIC DFES_Cls.DFC_EEPWrErr_C "DFES/Fehlerklasse für Prüfung DFC_EEPWrErr" VALUE 0x800237DB Val_Wu8 29.00 DFES_OneToOne 0.00 29.00 EXTENDED_LIMITS 0.00 255.0 /end CHARACTERISTIC
/begin CHARACTERISTIC DFES_Cls.DFC_EGRVlvJamVlvClsd_C "DFES/Fehlerklasse für Prüfung DFC_EGRVlvJamVlvClsd" VALUE 0x800237DC Val_Wu8 29.00 DFES_OneToOne 0.00 29.00 EXTENDED_LIMITS 0.00 255.0 /end CHARACTERISTIC
/begin CHARACTERISTIC DFES_Cls.DFC_EGRVlvJamVlvOpn_C "DFES/Fehlerklasse für Prüfung DFC_EGRVlvJamVlvOpn" VALUE 0x800237DD Val_Wu8 29.00 DFES_OneToOne 0.00 29.00 EXTENDED_LIMITS 0.00 255.0 /end CHARACTERISTIC
/begin CHARACTERISTIC DFES_Cls.DFC_EGRVlvLPJamVlvClsd_C "DFES/Fehlerklasse für Prüfung DFC_EGRVlvLPJamVlvClsd" VALUE 0x800237DE Val_Wu8 29.00 DFES_OneToOne 0.00 29.00 EXTENDED_LIMITS 0.00 255.0 /end CHARACTERISTIC
/begin CHARACTERISTIC DFES_Cls.DFC_EGRVlvLPJamVlvOpn_C "DFES/Fehlerklasse für Prüfung DFC_EGRVlvLPJamVlvOpn" VALUE 0x800237DF Val_Wu8 29.00 DFES_OneToOne 0.00 29.00 EXTENDED_LIMITS 0.00 255.0 /end CHARACTERISTIC
/begin CHARACTERISTIC DFES_Cls.DFC_EGRVlvLPLgTDrft_C "DFES/Fehlerklasse für Prüfung DFC_EGRVlvLPLgTDrft" VALUE 0x800237E0 Val_Wu8 29.00 DFES_OneToOne 0.00 29.00 EXTENDED_LIMITS 0.00 255.0 /end CHARACTERISTIC
/begin CHARACTERISTIC DFES_Cls.DFC_EGRVlvLPOfsLrnJamVlv_C "DFES/Fehlerklasse für Prüfung DFC_EGRVlvLPOfsLrnJamVlv" VALUE 0x800237E1 Val_Wu8 29.00 DFES_OneToOne 0.00 29.00 EXTENDED_LIMITS 0.00 255.0 /end CHARACTERISTIC
/begin CHARACTERISTIC DFES_Cls.DFC_EGRVlvLPShTDrft_C "DFES/Fehlerklasse für Prüfung DFC_EGRVlvLPShTDrft" VALUE 0x800237E2 Val_Wu8 29.00 DFES_OneToOne 0.00 29.00 EXTENDED_LIMITS 0.00 255.0 /end CHARACTERISTIC
/begin CHARACTERISTIC DFES_Cls.DFC_EGRVlvLgTDrft_C "DFES/Fehlerklasse für Prüfung DFC_EGRVlvLgTDrft" VALUE 0x800237E3 Val_Wu8 29.00 DFES_OneToOne 0.00 29.00 EXTENDED_LIMITS 0.00 255.0 /end CHARACTERISTIC
/begin CHARACTERISTIC DFES_Cls.DFC_EGRVlvOfsLrnJamVlv_C "DFES/Fehlerklasse für Prüfung DFC_EGRVlvOfsLrnJamVlv" VALUE 0x800237E4 Val_Wu8 29.00 DFES_OneToOne 0.00 29.00 EXTENDED_LIMITS 0.00 255.0 /end CHARACTERISTIC
/begin CHARACTERISTIC DFES_Cls.DFC_EGRVlvShTDrft_C "DFES/Fehlerklasse für Prüfung DFC_EGRVlvShTDrft" VALUE 0x800237E5 Val_Wu8 29.00 DFES_OneToOne 0.00 29.00 EXTENDED_LIMITS 0.00 255.0 /end CHARACTERISTIC
/begin CHARACTERISTIC DFES_Cls.DFC_EngICO_C "DFES/Fehlerklasse für Prüfung DFC_EngICO" VALUE 0x800237E6 Val_Wu8 29.00 DFES_OneToOne 0.00 29.00 EXTENDED_LIMITS 0.00 255.0 /end CHARACTERISTIC
/begin CHARACTERISTIC DFES_Cls.DFC_EpmCaSI1ErrSig_C "DFES/Fehlerklasse für Prüfung DFC_EpmCaSI1ErrSig" VALUE 0x800237E7 Val_Wu8 29.00 DFES_OneToOne 0.00 29.00 EXTENDED_LIMITS 0.00 255.0 /end CHARACTERISTIC
/begin CHARACTERISTIC DFES_Cls.DFC_EpmCaSI1NoSig_C "DFES/Fehlerklasse für Prüfung DFC_EpmCaSI1NoSig" VALUE 0x800237E8 Val_Wu8 29.00 DFES_OneToOne 0.00 29.00 EXTENDED_LIMITS 0.00 255.0 /end CHARACTERISTIC
/begin CHARACTERISTIC DFES_Cls.DFC_EpmCaSI1OfsErr_C "DFES/Fehlerklasse für Prüfung DFC_EpmCaSI1OfsErr" VALUE 0x800237E9 Val_Wu8 29.00 DFES_OneToOne 0.00 29.00 EXTENDED_LIMITS 0.00 255.0 /end CHARACTERISTIC
/begin CHARACTERISTIC DFES_Cls.DFC_EpmCrSErrSig_C "DFES/Fehlerklasse für Prüfung DFC_EpmCrSErrSig" VALUE 0x800237EA Val_Wu8 29.00 DFES_OneToOne 0.00 29.00 EXTENDED_LIMITS 0.00 255.0 /end CHARACTERISTIC
/begin CHARACTERISTIC DFES_Cls.DFC_EpmCrSNoSig_C "DFES/Fehlerklasse für Prüfung DFC_EpmCrSNoSig" VALUE 0x800237EB Val_Wu8 29.00 DFES_OneToOne 0.00 29.00 EXTENDED_LIMITS 0.00 255.0 /end CHARACTERISTIC
/begin CHARACTERISTIC DFES_Cls.DFC_IVPlausComprTst_C "DFES/Fehlerklasse für Prüfung DFC_IVPlausComprTst" VALUE 0x800237EC Val_Wu8 29.00 DFES_OneToOne 0.00 29.00 EXTENDED_LIMITS 0.00 255.0 /end CHARACTERISTIC
/begin CHARACTERISTIC DFES_Cls.DFC_IVPlausRunUpTst_C "DFES/Fehlerklasse für Prüfung DFC_IVPlausRunUpTst" VALUE 0x800237ED Val_Wu8 29.00 DFES_OneToOne 0.00 29.00 EXTENDED_LIMITS 0.00 255.0 /end CHARACTERISTIC
/begin CHARACTERISTIC DFES_Cls.DFC_InjCrvShOffTst_C "DFES/Fehlerklasse für Prüfung DFC_InjCrvShOffTst" VALUE 0x800237EE Val_Wu8 29.00 DFES_OneToOne 0.00 29.00 EXTENDED_LIMITS 0.00 255.0 /end CHARACTERISTIC
/begin CHARACTERISTIC DFES_Cls.DFC_LayerEnSavModProd_C "DFES/Fehlerklasse für Prüfung DFC_LayerEnSavModProd" VALUE 0x800237EF Val_Wu8 29.00 DFES_OneToOne 0.00 29.00 EXTENDED_LIMITS 0.00 255.0 /end CHARACTERISTIC
/begin CHARACTERISTIC DFES_Cls.DFC_LayerEnSavModRep_C "DFES/Fehlerklasse für Prüfung DFC_LayerEnSavModRep" VALUE 0x800237F0 Val_Wu8 29.00 DFES_OneToOne 0.00 29.00 EXTENDED_LIMITS 0.00 255.0 /end CHARACTERISTIC
/begin CHARACTERISTIC DFES_Cls.DFC_LayerEnSavModShip_C "DFES/Fehlerklasse für Prüfung DFC_LayerEnSavModShip" VALUE 0x800237F1 Val_Wu8 29.00 DFES_OneToOne 0.00 29.00 EXTENDED_LIMITS 0.00 255.0 /end CHARACTERISTIC
/begin CHARACTERISTIC DFES_Cls.DFC_MRlyErlyOpng_C "DFES/Fehlerklasse für Prüfung DFC_MRlyErlyOpng" VALUE 0x800237F2 Val_Wu8 29.00 DFES_OneToOne 0.00 29.00 EXTENDED_LIMITS 0.00 255.0 /end CHARACTERISTIC
/begin CHARACTERISTIC DFES_Cls.DFC_MRlyStk_C "DFES/Fehlerklasse für Prüfung DFC_MRlyStk" VALUE 0x800237F3 Val_Wu8 29.00 DFES_OneToOne 0.00 29.00 EXTENDED_LIMITS 0.00 255.0 /end CHARACTERISTIC
/begin CHARACTERISTIC DFES_Cls.DFC_MeUnActrTst_C "DFES/Fehlerklasse für Prüfung DFC_MeUnActrTst" VALUE 0x800237F4 Val_Wu8 29.00 DFES_OneToOne 0.00 29.00 EXTENDED_LIMITS 0.00 255.0 /end CHARACTERISTIC
/begin CHARACTERISTIC DFES_Cls.DFC_MoCADCCmp_C "DFES/Fehlerklasse für Prüfung DFC_MoCADCCmp" VALUE 0x800237F5 Val_Wu8 29.00 DFES_OneToOne 0.00 29.00 EXTENDED_LIMITS 0.00 255.0 /end CHARACTERISTIC
/begin CHARACTERISTIC DFES_Cls.DFC_MoCADCTst_C "DFES/Fehlerklasse für Prüfung DFC_MoCADCTst" VALUE 0x800237F6 Val_Wu8 29.00 DFES_OneToOne 0.00 29.00 EXTENDED_LIMITS 0.00 255.0 /end CHARACTERISTIC
/begin CHARACTERISTIC DFES_Cls.DFC_MoCADCVltgRatio_C "DFES/Fehlerklasse für Prüfung DFC_MoCADCVltgRatio" VALUE 0x800237F7 Val_Wu8 29.00 DFES_OneToOne 0.00 29.00 EXTENDED_LIMITS 0.00 255.0 /end CHARACTERISTIC
/begin CHARACTERISTIC DFES_Cls.DFC_MoCComErrCnt_C "DFES/Fehlerklasse für Prüfung DFC_MoCComErrCnt" VALUE 0x800237F8 Val_Wu8 29.00 DFES_OneToOne 0.00 29.00 EXTENDED_LIMITS 0.00 255.0 /end CHARACTERISTIC
/begin CHARACTERISTIC DFES_Cls.DFC_MoCComSPI_C "DFES/Fehlerklasse für Prüfung DFC_MoCComSPI" VALUE 0x800237F9 Val_Wu8 29.00 DFES_OneToOne 0.00 29.00 EXTENDED_LIMITS 0.00 255.0 /end CHARACTERISTIC
/begin CHARACTERISTIC DFES_Cls.DFC_MoCROMErrXPg_C "DFES/Fehlerklasse für Prüfung DFC_MoCROMErrXPg" VALUE 0x800237FA Val_Wu8 29.00 DFES_OneToOne 0.00 29.00 EXTENDED_LIMITS 0.00 255.0 /end CHARACTERISTIC
/begin CHARACTERISTIC DFES_Cls.DFC_MoCSOPHwNoRdy_C "DFES/Fehlerklasse für Prüfung DFC_MoCSOPHwNoRdy" VALUE 0x800237FB Val_Wu8 29.00 DFES_OneToOne 0.00 29.00 EXTENDED_LIMITS 0.00 255.0 /end CHARACTERISTIC
/begin CHARACTERISTIC DFES_Cls.DFC_MoCSOPLoLi_C "DFES/Fehlerklasse für Prüfung DFC_MoCSOPLoLi" VALUE 0x800237FC Val_Wu8 29.00 DFES_OneToOne 0.00 29.00 EXTENDED_LIMITS 0.00 255.0 /end CHARACTERISTIC
/begin CHARACTERISTIC DFES_Cls.DFC_MoCSOPMM_C "DFES/Fehlerklasse für Prüfung DFC_MoCSOPMM" VALUE 0x800237FD Val_Wu8 29.00 DFES_OneToOne 0.00 29.00 EXTENDED_LIMITS 0.00 255.0 /end CHARACTERISTIC
/begin CHARACTERISTIC DFES_Cls.DFC_MoCSOPTimeOut_C "DFES/Fehlerklasse für Prüfung DFC_MoCSOPTimeOut" VALUE 0x800237FE Val_Wu8 29.00 DFES_OneToOne 0.00 29.00 EXTENDED_LIMITS 0.00 255.0 /end CHARACTERISTIC
/begin CHARACTERISTIC DFES_Cls.DFC_MoCSOPUpLi_C "DFES/Fehlerklasse für Prüfung DFC_MoCSOPUpLi" VALUE 0x800237FF Val_Wu8 29.00 DFES_OneToOne 0.00 29.00 EXTENDED_LIMITS 0.00 255.0 /end CHARACTERISTIC
/begin CHARACTERISTIC DFES_Cls.DFC_MoFAPP_C "DFES/Fehlerklasse für Prüfung DFC_MoFAPP" VALUE 0x80023800 Val_Wu8 29.00 DFES_OneToOne 0.00 29.00 EXTENDED_LIMITS 0.00 255.0 /end CHARACTERISTIC
/begin CHARACTERISTIC DFES_Cls.DFC_MoFESpd_C "DFES/Fehlerklasse für Prüfung DFC_MoFESpd" VALUE 0x80023801 Val_Wu8 29.00 DFES_OneToOne 0.00 29.00 EXTENDED_LIMITS 0.00 255.0 /end CHARACTERISTIC
/begin CHARACTERISTIC DFES_Cls.DFC_MoFInjDatPhi_C "DFES/Fehlerklasse für Prüfung DFC_MoFInjDatPhi" VALUE 0x80023802 Val_Wu8 29.00 DFES_OneToOne 0.00 29.00 EXTENDED_LIMITS 0.00 255.0 /end CHARACTERISTIC
/begin CHARACTERISTIC DFES_Cls.DFC_MoFInjDatQnt_C "DFES/Fehlerklasse für Prüfung DFC_MoFInjDatQnt" VALUE 0x80023803 Val_Wu8 29.00 DFES_OneToOne 0.00 29.00 EXTENDED_LIMITS 0.00 255.0 /end CHARACTERISTIC
/begin CHARACTERISTIC DFES_Cls.DFC_MoFInjQnt_C "DFES/Fehlerklasse für Prüfung DFC_MoFInjQnt" VALUE 0x80023804 Val_Wu8 29.00 DFES_OneToOne 0.00 29.00 EXTENDED_LIMITS 0.00 255.0 /end CHARACTERISTIC
/begin CHARACTERISTIC DFES_Cls.DFC_MoFMode1PoI1_C "DFES/Fehlerklasse für Prüfung DFC_MoFMode1PoI1" VALUE 0x80023805 Val_Wu8 29.00 DFES_OneToOne 0.00 29.00 EXTENDED_LIMITS 0.00 255.0 /end CHARACTERISTIC
/begin CHARACTERISTIC DFES_Cls.DFC_MoFMode1PoI2_C "DFES/Fehlerklasse für Prüfung DFC_MoFMode1PoI2" VALUE 0x80023806 Val_Wu8 29.00 DFES_OneToOne 0.00 29.00 EXTENDED_LIMITS 0.00 255.0 /end CHARACTERISTIC
/begin CHARACTERISTIC DFES_Cls.DFC_MoFMode2PoI1_C "DFES/Fehlerklasse für Prüfung DFC_MoFMode2PoI1" VALUE 0x80023807 Val_Wu8 29.00 DFES_OneToOne 0.00 29.00 EXTENDED_LIMITS 0.00 255.0 /end CHARACTERISTIC
/begin CHARACTERISTIC DFES_Cls.DFC_MoFMode2PoI2_C "DFES/Fehlerklasse für Prüfung DFC_MoFMode2PoI2" VALUE 0x80023808 Val_Wu8 29.00 DFES_OneToOne 0.00 29.00 EXTENDED_LIMITS 0.00 255.0 /end CHARACTERISTIC
/begin CHARACTERISTIC DFES_Cls.DFC_MoFOvR_C "DFES/Fehlerklasse für Prüfung DFC_MoFOvR" VALUE 0x80023809 Val_Wu8 29.00 DFES_OneToOne 0.00 29.00 EXTENDED_LIMITS 0.00 255.0 /end CHARACTERISTIC
/begin CHARACTERISTIC DFES_Cls.DFC_MoFQntCor_C "DFES/Fehlerklasse für Prüfung DFC_MoFQntCor" VALUE 0x8002380A Val_Wu8 29.00 DFES_OneToOne 0.00 29.00 EXTENDED_LIMITS 0.00 255.0 /end CHARACTERISTIC
/begin CHARACTERISTIC DFES_Cls.DFC_MoFRailP_C "DFES/Fehlerklasse für Prüfung DFC_MoFRailP" VALUE 0x8002380B Val_Wu8 29.00 DFES_OneToOne 0.00 29.00 EXTENDED_LIMITS 0.00 255.0 /end CHARACTERISTIC
/begin CHARACTERISTIC DFES_Cls.DFC_MoFTrqCmp_C "DFES/Fehlerklasse für Prüfung DFC_MoFTrqCmp" VALUE 0x8002380C Val_Wu8 29.00 DFES_OneToOne 0.00 29.00 EXTENDED_LIMITS 0.00 255.0 /end CHARACTERISTIC
/begin CHARACTERISTIC DFES_Cls.DFC_NSCDsHtrSetP_C "DFES/Fehlerklasse für Prüfung DFC_NSCDsHtrSetP" VALUE 0x8002380D Val_Wu8 29.00 DFES_OneToOne 0.00 29.00 EXTENDED_LIMITS 0.00 255.0 /end CHARACTERISTIC
/begin CHARACTERISTIC DFES_Cls.DFC_NoCat2DsHtrSetP_C "DFES/Fehlerklasse für Prüfung DFC_NoCat2DsHtrSetP" VALUE 0x8002380E Val_Wu8 29.00 DFES_OneToOne 0.00 29.00 EXTENDED_LIMITS 0.00 255.0 /end CHARACTERISTIC
/begin CHARACTERISTIC DFES_Cls.DFC_PCVActrTst_C "DFES/Fehlerklasse für Prüfung DFC_PCVActrTst" VALUE 0x8002380F Val_Wu8 29.00 DFES_OneToOne 0.00 29.00 EXTENDED_LIMITS 0.00 255.0 /end CHARACTERISTIC
/begin CHARACTERISTIC DFES_Cls.DFC_PhyModNonMonMapNpl_C "DFES/Fehlerklasse für Prüfung DFC_PhyModNonMonMapNpl" VALUE 0x80023810 Val_Wu8 29.00 DFES_OneToOne 0.00 29.00 EXTENDED_LIMITS 0.00 255.0 /end CHARACTERISTIC
/begin CHARACTERISTIC DFES_Cls.DFC_RailHpTst_C "DFES/Fehlerklasse für Prüfung DFC_RailHpTst" VALUE 0x80023811 Val_Wu8 29.00 DFES_OneToOne 0.00 29.00 EXTENDED_LIMITS 0.00 255.0 /end CHARACTERISTIC
/begin CHARACTERISTIC DFES_Cls.DFC_RailPOfsTstMax_C "DFES/Fehlerklasse für Prüfung DFC_RailPOfsTstMax" VALUE 0x80023812 Val_Wu8 29.00 DFES_OneToOne 0.00 29.00 EXTENDED_LIMITS 0.00 255.0 /end CHARACTERISTIC
/begin CHARACTERISTIC DFES_Cls.DFC_RailPOfsTstMin_C "DFES/Fehlerklasse für Prüfung DFC_RailPOfsTstMin" VALUE 0x80023813 Val_Wu8 29.00 DFES_OneToOne 0.00 29.00 EXTENDED_LIMITS 0.00 255.0 /end CHARACTERISTIC
/begin CHARACTERISTIC DFES_Cls.DFC_SIA_E1max_C "DFES/Fehlerklasse für Prüfung DFC_SIA_E1max" VALUE 0x80023814 Val_Wu8 29.00 DFES_OneToOne 0.00 29.00 EXTENDED_LIMITS 0.00 255.0 /end CHARACTERISTIC
/begin CHARACTERISTIC DFES_Cls.DFC_SIA_E1min_C "DFES/Fehlerklasse für Prüfung DFC_SIA_E1min" VALUE 0x80023815 Val_Wu8 29.00 DFES_OneToOne 0.00 29.00 EXTENDED_LIMITS 0.00 255.0 /end CHARACTERISTIC
/begin CHARACTERISTIC DFES_Cls.DFC_SIA_E1npl_C "DFES/Fehlerklasse für Prüfung DFC_SIA_E1npl" VALUE 0x80023816 Val_Wu8 29.00 DFES_OneToOne 0.00 29.00 EXTENDED_LIMITS 0.00 255.0 /end CHARACTERISTIC
/begin CHARACTERISTIC DFES_Cls.DFC_SIA_E1sig_C "DFES/Fehlerklasse für Prüfung DFC_SIA_E1sig" VALUE 0x80023817 Val_Wu8 29.00 DFES_OneToOne 0.00 29.00 EXTENDED_LIMITS 0.00 255.0 /end CHARACTERISTIC
/begin CHARACTERISTIC DFES_Cls.DFC_SIA_E2max_C "DFES/Fehlerklasse für Prüfung DFC_SIA_E2max" VALUE 0x80023818 Val_Wu8 29.00 DFES_OneToOne 0.00 29.00 EXTENDED_LIMITS 0.00 255.0 /end CHARACTERISTIC
/begin CHARACTERISTIC DFES_Cls.DFC_SIA_E2min_C "DFES/Fehlerklasse für Prüfung DFC_SIA_E2min" VALUE 0x80023819 Val_Wu8 29.00 DFES_OneToOne 0.00 29.00 EXTENDED_LIMITS 0.00 255.0 /end CHARACTERISTIC
/begin CHARACTERISTIC DFES_Cls.DFC_SIA_E2npl_C "DFES/Fehlerklasse für Prüfung DFC_SIA_E2npl" VALUE 0x8002381A Val_Wu8 29.00 DFES_OneToOne 0.00 29.00 EXTENDED_LIMITS 0.00 255.0 /end CHARACTERISTIC
/begin CHARACTERISTIC DFES_Cls.DFC_SIA_E2sig_C "DFES/Fehlerklasse für Prüfung DFC_SIA_E2sig" VALUE 0x8002381B Val_Wu8 29.00 DFES_OneToOne 0.00 29.00 EXTENDED_LIMITS 0.00 255.0 /end CHARACTERISTIC
/begin CHARACTERISTIC DFES_Cls.DFC_SIA_E3max_C "DFES/Fehlerklasse für Prüfung DFC_SIA_E3max" VALUE 0x8002381C Val_Wu8 29.00 DFES_OneToOne 0.00 29.00 EXTENDED_LIMITS 0.00 255.0 /end CHARACTERISTIC
/begin CHARACTERISTIC DFES_Cls.DFC_SIA_E3min_C "DFES/Fehlerklasse für Prüfung DFC_SIA_E3min" VALUE 0x8002381D Val_Wu8 29.00 DFES_OneToOne 0.00 29.00 EXTENDED_LIMITS 0.00 255.0 /end CHARACTERISTIC
/begin CHARACTERISTIC DFES_Cls.DFC_SIA_E3npl_C "DFES/Fehlerklasse für Prüfung DFC_SIA_E3npl" VALUE 0x8002381E Val_Wu8 29.00 DFES_OneToOne 0.00 29.00 EXTENDED_LIMITS 0.00 255.0 /end CHARACTERISTIC
/begin CHARACTERISTIC DFES_Cls.DFC_SIA_E3sig_C "DFES/Fehlerklasse für Prüfung DFC_SIA_E3sig" VALUE 0x8002381F Val_Wu8 29.00 DFES_OneToOne 0.00 29.00 EXTENDED_LIMITS 0.00 255.0 /end CHARACTERISTIC
/begin CHARACTERISTIC DFES_Cls.DFC_SIA_E4max_C "DFES/Fehlerklasse für Prüfung DFC_SIA_E4max" VALUE 0x80023820 Val_Wu8 29.00 DFES_OneToOne 0.00 29.00 EXTENDED_LIMITS 0.00 255.0 /end CHARACTERISTIC
/begin CHARACTERISTIC DFES_Cls.DFC_SIA_E4min_C "DFES/Fehlerklasse für Prüfung DFC_SIA_E4min" VALUE 0x80023821 Val_Wu8 29.00 DFES_OneToOne 0.00 29.00 EXTENDED_LIMITS 0.00 255.0 /end CHARACTERISTIC
/begin CHARACTERISTIC DFES_Cls.DFC_SIA_E4npl_C "DFES/Fehlerklasse für Prüfung DFC_SIA_E4npl" VALUE 0x80023822 Val_Wu8 29.00 DFES_OneToOne 0.00 29.00 EXTENDED_LIMITS 0.00 255.0 /end CHARACTERISTIC
/begin CHARACTERISTIC DFES_Cls.DFC_SIA_E4sig_C "DFES/Fehlerklasse für Prüfung DFC_SIA_E4sig" VALUE 0x80023823 Val_Wu8 29.00 DFES_OneToOne 0.00 29.00 EXTENDED_LIMITS 0.00 255.0 /end CHARACTERISTIC
/begin CHARACTERISTIC DFES_Cls.DFC_SWReset_0_C "DFES/Fehlerklasse für Prüfung DFC_SWReset_0" VALUE 0x80023824 Val_Wu8 29.00 DFES_OneToOne 0.00 29.00 EXTENDED_LIMITS 0.00 255.0 /end CHARACTERISTIC
/begin CHARACTERISTIC DFES_Cls.DFC_SWReset_1_C "DFES/Fehlerklasse für Prüfung DFC_SWReset_1" VALUE 0x80023825 Val_Wu8 29.00 DFES_OneToOne 0.00 29.00 EXTENDED_LIMITS 0.00 255.0 /end CHARACTERISTIC
/begin CHARACTERISTIC DFES_Cls.DFC_SWReset_2_C "DFES/Fehlerklasse für Prüfung DFC_SWReset_2" VALUE 0x80023826 Val_Wu8 29.00 DFES_OneToOne 0.00 29.00 EXTENDED_LIMITS 0.00 255.0 /end CHARACTERISTIC
/begin CHARACTERISTIC DFES_Cls.DFC_ShtrAKKMax_C "DFES/Fehlerklasse für Prüfung DFC_ShtrAKKMax" VALUE 0x80023827 Val_Wu8 29.00 DFES_OneToOne 0.00 29.00 EXTENDED_LIMITS 0.00 255.0 /end CHARACTERISTIC
/begin CHARACTERISTIC DFES_Cls.DFC_ShtrAKKMin_C "DFES/Fehlerklasse für Prüfung DFC_ShtrAKKMin" VALUE 0x80023828 Val_Wu8 29.00 DFES_OneToOne 0.00 29.00 EXTENDED_LIMITS 0.00 255.0 /end CHARACTERISTIC
/begin CHARACTERISTIC DFES_Cls.DFC_ShtrAKKNpl_C "DFES/Fehlerklasse für Prüfung DFC_ShtrAKKNpl" VALUE 0x80023829 Val_Wu8 29.00 DFES_OneToOne 0.00 29.00 EXTENDED_LIMITS 0.00 255.0 /end CHARACTERISTIC
/begin CHARACTERISTIC DFES_Cls.DFC_ShtrPKKMax_C "DFES/Fehlerklasse für Prüfung DFC_ShtrPKKMax" VALUE 0x8002382A Val_Wu8 29.00 DFES_OneToOne 0.00 29.00 EXTENDED_LIMITS 0.00 255.0 /end CHARACTERISTIC
/begin CHARACTERISTIC DFES_Cls.DFC_StopCntTmr_C "DFES/Fehlerklasse für Prüfung DFC_StopCntTmr" VALUE 0x8002382B Val_Wu8 29.00 DFES_OneToOne 0.00 29.00 EXTENDED_LIMITS 0.00 255.0 /end CHARACTERISTIC
/begin CHARACTERISTIC DFES_Cls.DFC_ThrVlvMon_C "DFES/Fehlerklasse für Prüfung DFC_ThrVlvMon" VALUE 0x8002382C Val_Wu8 29.00 DFES_OneToOne 0.00 29.00 EXTENDED_LIMITS 0.00 255.0 /end CHARACTERISTIC
/begin CHARACTERISTIC DFES_Cls.DFC_VSwVlvJamVlv_C "DFES/Fehlerklasse für Prüfung DFC_VSwVlvJamVlv" VALUE 0x8002382D Val_Wu8 29.00 DFES_OneToOne 0.00 29.00 EXTENDED_LIMITS 0.00 255.0 /end CHARACTERISTIC
/begin CHARACTERISTIC DFES_Cls.DFC_VSwVlvLgTDrft_C "DFES/Fehlerklasse für Prüfung DFC_VSwVlvLgTDrft" VALUE 0x8002382E Val_Wu8 29.00 DFES_OneToOne 0.00 29.00 EXTENDED_LIMITS 0.00 255.0 /end CHARACTERISTIC
/begin CHARACTERISTIC DFES_Cls.DFC_VSwVlvOfsLrnJamVlv_C "DFES/Fehlerklasse für Prüfung DFC_VSwVlvOfsLrnJamVlv" VALUE 0x8002382F Val_Wu8 29.00 DFES_OneToOne 0.00 29.00 EXTENDED_LIMITS 0.00 255.0 /end CHARACTERISTIC
/begin CHARACTERISTIC DFES_Cls.DFC_VSwVlvOfsNeutr_C "DFES/Fehlerklasse für Prüfung DFC_VSwVlvOfsNeutr" VALUE 0x80023830 Val_Wu8 29.00 DFES_OneToOne 0.00 29.00 EXTENDED_LIMITS 0.00 255.0 /end CHARACTERISTIC
/begin CHARACTERISTIC DFES_Cls.DFC_VSwVlvShTDrft_C "DFES/Fehlerklasse für Prüfung DFC_VSwVlvShTDrft" VALUE 0x80023831 Val_Wu8 29.00 DFES_OneToOne 0.00 29.00 EXTENDED_LIMITS 0.00 255.0 /end CHARACTERISTIC
/begin CHARACTERISTIC DFES_Cls.DFC_VSwVlvSpgDef_C "DFES/Fehlerklasse für Prüfung DFC_VSwVlvSpgDef" VALUE 0x80023832 Val_Wu8 29.00 DFES_OneToOne 0.00 29.00 EXTENDED_LIMITS 0.00 255.0 /end CHARACTERISTIC
/begin CHARACTERISTIC DFES_DbLv.DFC_Unused_C "DFES/intern benötigter Parameter für nicht existierende Fehlerprüfung DFC_Unused" VALUE 0x8002994E Val_Wu8 15.00 DFES_OneToOne 0.00 15.00 EXTENDED_LIMITS 0.00 255.0 READ_ONLY /end CHARACTERISTIC
/begin CHARACTERISTIC DFES_DbLv.DFC_ACCIPlausDrvAst_C "DFES/Entprelllevel zur Erstellung eines DFES Eintrages für Prüfung DFC_ACCIPlausDrvAst" VALUE 0x8002994F Val_Wu8 15.00 DFES_OneToOne 0.00 15.00 EXTENDED_LIMITS 0.00 255.0 /end CHARACTERISTIC
/begin CHARACTERISTIC DFES_DbLv.DFC_ACCIPlausTrqDes_C "DFES/Entprelllevel zur Erstellung eines DFES Eintrages für Prüfung DFC_ACCIPlausTrqDes" VALUE 0x80029950 Val_Wu8 15.00 DFES_OneToOne 0.00 15.00 EXTENDED_LIMITS 0.00 255.0 /end CHARACTERISTIC
/begin CHARACTERISTIC DFES_DbLv.DFC_AirCtlGovDvtEOMMax_C "DFES/Entprelllevel zur Erstellung eines DFES Eintrages für Prüfung DFC_AirCtlGovDvtEOMMax" VALUE 0x80029951 Val_Wu8 15.00 DFES_OneToOne 0.00 15.00 EXTENDED_LIMITS 0.00 255.0 /end CHARACTERISTIC
/begin CHARACTERISTIC DFES_DbLv.DFC_AirCtlGovDvtEOMMin_C "DFES/Entprelllevel zur Erstellung eines DFES Eintrages für Prüfung DFC_AirCtlGovDvtEOMMin" VALUE 0x80029952 Val_Wu8 15.00 DFES_OneToOne 0.00 15.00 EXTENDED_LIMITS 0.00 255.0 /end CHARACTERISTIC
/begin CHARACTERISTIC DFES_DbLv.DFC_AirCtlGovDvtMax_C "DFES/Entprelllevel zur Erstellung eines DFES Eintrages für Prüfung DFC_AirCtlGovDvtMax" VALUE 0x80029953 Val_Wu8 15.00 DFES_OneToOne 0.00 15.00 EXTENDED_LIMITS 0.00 255.0 /end CHARACTERISTIC
/begin CHARACTERISTIC DFES_DbLv.DFC_AirCtlGovDvtMin_C "DFES/Entprelllevel zur Erstellung eines DFES Eintrages für Prüfung DFC_AirCtlGovDvtMin" VALUE 0x80029954 Val_Wu8 15.00 DFES_OneToOne 0.00 15.00 EXTENDED_LIMITS 0.00 255.0 /end CHARACTERISTIC
/begin CHARACTERISTIC DFES_DbLv.DFC_AirCtlGovLPDvtMax_C "DFES/Entprelllevel zur Erstellung eines DFES Eintrages für Prüfung DFC_AirCtlGovLPDvtMax" VALUE 0x80029955 Val_Wu8 15.00 DFES_OneToOne 0.00 15.00 EXTENDED_LIMITS 0.00 255.0 /end CHARACTERISTIC
/begin CHARACTERISTIC DFES_DbLv.DFC_AirCtlGovLPDvtMin_C "DFES/Entprelllevel zur Erstellung eines DFES Eintrages für Prüfung DFC_AirCtlGovLPDvtMin" VALUE 0x80029956 Val_Wu8 15.00 DFES_OneToOne 0.00 15.00 EXTENDED_LIMITS 0.00 255.0 /end CHARACTERISTIC
/begin CHARACTERISTIC DFES_DbLv.DFC_AltIOComErr_C "DFES/Entprelllevel zur Erstellung eines DFES Eintrages für Prüfung DFC_AltIOComErr" VALUE 0x80029957 Val_Wu8 15.00 DFES_OneToOne 0.00 15.00 EXTENDED_LIMITS 0.00 255.0 /end CHARACTERISTIC
/begin CHARACTERISTIC DFES_DbLv.DFC_AltIOComNpl_C "DFES/Entprelllevel zur Erstellung eines DFES Eintrages für Prüfung DFC_AltIOComNpl" VALUE 0x80029958 Val_Wu8 15.00 DFES_OneToOne 0.00 15.00 EXTENDED_LIMITS 0.00 255.0 /end CHARACTERISTIC
/begin CHARACTERISTIC DFES_DbLv.DFC_BusDiagBusOffFlexRay_C "DFES/" VALUE 0x80029959 Val_Wu8 15.00 DFES_OneToOne 0.00 15.00 EXTENDED_LIMITS 0.00 255.0 /end CHARACTERISTIC
/begin CHARACTERISTIC DFES_DbLv.DFC_BusDiagBusOffNodeA_C "DFES/Entprelllevel zur Erstellung eines DFES Eintrages für Prüfung DFC_BusDiagBusOffNodeA" VALUE 0x8002995A Val_Wu8 15.00 DFES_OneToOne 0.00 15.00 EXTENDED_LIMITS 0.00 255.0 /end CHARACTERISTIC
/begin CHARACTERISTIC DFES_DbLv.DFC_BusDiagBusOffNodeB_C "DFES/Entprelllevel zur Erstellung eines DFES Eintrages für Prüfung DFC_BusDiagBusOffNodeB" VALUE 0x8002995B Val_Wu8 15.00 DFES_OneToOne 0.00 15.00 EXTENDED_LIMITS 0.00 255.0 /end CHARACTERISTIC
/begin CHARACTERISTIC DFES_DbLv.DFC_BusDiagBusOffNodeC_C "DFES/Entprelllevel zur Erstellung eines DFES Eintrages für Prüfung DFC_BusDiagBusOffNodeC" VALUE 0x8002995C Val_Wu8 15.00 DFES_OneToOne 0.00 15.00 EXTENDED_LIMITS 0.00 255.0 /end CHARACTERISTIC
/begin CHARACTERISTIC DFES_DbLv.DFC_BusDiagHwFlexRay_C "DFES/" VALUE 0x8002995D Val_Wu8 15.00 DFES_OneToOne 0.00 15.00 EXTENDED_LIMITS 0.00 255.0 /end CHARACTERISTIC
/begin CHARACTERISTIC DFES_DbLv.DFC_Cj945SpiCom1_C "DFES/Entprelllevel zur Erstellung eines DFES Eintrages für Prüfung DFC_Cj945SpiCom1" VALUE 0x8002995E Val_Wu8 15.00 DFES_OneToOne 0.00 15.00 EXTENDED_LIMITS 0.00 255.0 /end CHARACTERISTIC
/begin CHARACTERISTIC DFES_DbLv.DFC_ComACDemandSig_FA_C "DFES/Entprelllevel zur Erstellung eines DFES Eintrages für Prüfung DFC_ComACDemandSig_FA" VALUE 0x8002995F Val_Wu8 15.00 DFES_OneToOne 0.00 15.00 EXTENDED_LIMITS 0.00 255.0 /end CHARACTERISTIC
/begin CHARACTERISTIC DFES_DbLv.DFC_ComACDemandTo_FA_C "DFES/Entprelllevel zur Erstellung eines DFES Eintrages für Prüfung DFC_ComACDemandTo_FA" VALUE 0x80029960 Val_Wu8 15.00 DFES_OneToOne 0.00 15.00 EXTENDED_LIMITS 0.00 255.0 /end CHARACTERISTIC
/begin CHARACTERISTIC DFES_DbLv.DFC_ComATempSig_FA_C "DFES/Entprelllevel zur Erstellung eines DFES Eintrages für Prüfung DFC_ComATempSig_FA" VALUE 0x80029961 Val_Wu8 15.00 DFES_OneToOne 0.00 15.00 EXTENDED_LIMITS 0.00 255.0 /end CHARACTERISTIC
/begin CHARACTERISTIC DFES_DbLv.DFC_ComATempTo_FA_C "DFES/Entprelllevel zur Erstellung eines DFES Eintrages für Prüfung DFC_ComATempTo_FA" VALUE 0x80029962 Val_Wu8 15.00 DFES_OneToOne 0.00 15.00 EXTENDED_LIMITS 0.00 255.0 /end CHARACTERISTIC
/begin CHARACTERISTIC DFES_DbLv.DFC_ComATempTo_FX_C "DFES/Entprelllevel zur Erstellung eines DFES Eintrages für Prüfung DFC_ComATempTo_FX" VALUE 0x80029963 Val_Wu8 15.00 DFES_OneToOne 0.00 15.00 EXTENDED_LIMITS 0.00 255.0 /end CHARACTERISTIC
/begin CHARACTERISTIC DFES_DbLv.DFC_ComBrkTrqSumChk_FX_C "DFES/Entprelllevel zur Erstellung eines DFES Eintrages für Prüfung DFC_ComBrkTrqSumChk_FX" VALUE 0x80029964 Val_Wu8 15.00 DFES_OneToOne 0.00 15.00 EXTENDED_LIMITS 0.00 255.0 /end CHARACTERISTIC
/begin CHARACTERISTIC DFES_DbLv.DFC_ComBrkTrqSumCtr_FX_C "DFES/Entprelllevel zur Erstellung eines DFES Eintrages für Prüfung DFC_ComBrkTrqSumCtr_FX" VALUE 0x80029965 Val_Wu8 15.00 DFES_OneToOne 0.00 15.00 EXTENDED_LIMITS 0.00 255.0 /end CHARACTERISTIC
/begin CHARACTERISTIC DFES_DbLv.DFC_ComBrkTrqSumTo_FX_C "DFES/Entprelllevel zur Erstellung eines DFES Eintrages für Prüfung DFC_ComBrkTrqSumTo_FX" VALUE 0x80029966 Val_Wu8 15.00 DFES_OneToOne 0.00 15.00 EXTENDED_LIMITS 0.00 255.0 /end CHARACTERISTIC
/begin CHARACTERISTIC DFES_DbLv.DFC_ComBtnDrvDynChk_FX_C "DFES/Entprelllevel zur Erstellung eines DFES Eintrages für Prüfung DFC_ComBtnDrvDynChk_FX" VALUE 0x80029967 Val_Wu8 15.00 DFES_OneToOne 0.00 15.00 EXTENDED_LIMITS 0.00 255.0 /end CHARACTERISTIC
/begin CHARACTERISTIC DFES_DbLv.DFC_ComBtnDrvDynCtr_FX_C "DFES/Entprelllevel zur Erstellung eines DFES Eintrages für Prüfung DFC_ComBtnDrvDynCtr_FX" VALUE 0x80029968 Val_Wu8 15.00 DFES_OneToOne 0.00 15.00 EXTENDED_LIMITS 0.00 255.0 /end CHARACTERISTIC
/begin CHARACTERISTIC DFES_DbLv.DFC_ComBtnDrvDynTo_FX_C "DFES/Entprelllevel zur Erstellung eines DFES Eintrages für Prüfung DFC_ComBtnDrvDynTo_FX" VALUE 0x80029969 Val_Wu8 15.00 DFES_OneToOne 0.00 15.00 EXTENDED_LIMITS 0.00 255.0 /end CHARACTERISTIC
/begin CHARACTERISTIC DFES_DbLv.DFC_ComButtonMSASig_C "DFES/Entprelllevel zur Erstellung eines DFES Eintrages für Prüfung DFC_ComButtonMSASig" VALUE 0x8002996A Val_Wu8 15.00 DFES_OneToOne 0.00 15.00 EXTENDED_LIMITS 0.00 255.0 /end CHARACTERISTIC
/begin CHARACTERISTIC DFES_DbLv.DFC_ComButtonMSATo_C "DFES/Entprelllevel zur Erstellung eines DFES Eintrages für Prüfung DFC_ComButtonMSATo" VALUE 0x8002996B Val_Wu8 15.00 DFES_OneToOne 0.00 15.00 EXTENDED_LIMITS 0.00 255.0 /end CHARACTERISTIC
/begin CHARACTERISTIC DFES_DbLv.DFC_ComCodierungPwrmngSig_C "DFES/Entprelllevel zur Erstellung eines DFES Eintrages für Prüfung DFC_ComCodierungPwrmngSig" VALUE 0x8002996C Val_Wu8 15.00 DFES_OneToOne 0.00 15.00 EXTENDED_LIMITS 0.00 255.0 /end CHARACTERISTIC
/begin CHARACTERISTIC DFES_DbLv.DFC_ComCodierungPwrmngSig_FA_C "DFES/Entprelllevel zur Erstellung eines DFES Eintrages für Prüfung DFC_ComCodierungPwrmngSig_FA" VALUE 0x8002996D Val_Wu8 15.00 DFES_OneToOne 0.00 15.00 EXTENDED_LIMITS 0.00 255.0 /end CHARACTERISTIC
/begin CHARACTERISTIC DFES_DbLv.DFC_ComCrCtlLvrChk_C "DFES/Entprelllevel zur Erstellung eines DFES Eintrages für Prüfung DFC_ComCrCtlLvrChk" VALUE 0x8002996E Val_Wu8 15.00 DFES_OneToOne 0.00 15.00 EXTENDED_LIMITS 0.00 255.0 /end CHARACTERISTIC
/begin CHARACTERISTIC DFES_DbLv.DFC_ComCrCtlLvrCtr_C "DFES/Entprelllevel zur Erstellung eines DFES Eintrages für Prüfung DFC_ComCrCtlLvrCtr" VALUE 0x8002996F Val_Wu8 15.00 DFES_OneToOne 0.00 15.00 EXTENDED_LIMITS 0.00 255.0 /end CHARACTERISTIC
/begin CHARACTERISTIC DFES_DbLv.DFC_ComCrCtlLvrSig_C "DFES/Entprelllevel zur Erstellung eines DFES Eintrages für Prüfung DFC_ComCrCtlLvrSig" VALUE 0x80029970 Val_Wu8 15.00 DFES_OneToOne 0.00 15.00 EXTENDED_LIMITS 0.00 255.0 /end CHARACTERISTIC
/begin CHARACTERISTIC DFES_DbLv.DFC_ComCrCtlLvrTo_C "DFES/Entprelllevel zur Erstellung eines DFES Eintrages für Prüfung DFC_ComCrCtlLvrTo" VALUE 0x80029971 Val_Wu8 15.00 DFES_OneToOne 0.00 15.00 EXTENDED_LIMITS 0.00 255.0 /end CHARACTERISTIC
/begin CHARACTERISTIC DFES_DbLv.DFC_ComCtrCrshSwoEkpSig_FA_C "DFES/Entprelllevel zur Erstellung eines DFES Eintrages für Prüfung DFC_ComCtrCrshSwoEkpSig_FA" VALUE 0x80029972 Val_Wu8 15.00 DFES_OneToOne 0.00 15.00 EXTENDED_LIMITS 0.00 255.0 /end CHARACTERISTIC
/begin CHARACTERISTIC DFES_DbLv.DFC_ComCtrCrshSwoEkpTo_FA_C "DFES/Entprelllevel zur Erstellung eines DFES Eintrages für Prüfung DFC_ComCtrCrshSwoEkpTo_FA" VALUE 0x80029973 Val_Wu8 15.00 DFES_OneToOne 0.00 15.00 EXTENDED_LIMITS 0.00 255.0 /end CHARACTERISTIC
/begin CHARACTERISTIC DFES_DbLv.DFC_ComCtrSecInt_C "DFES/Entprelllevel zur Erstellung eines DFES Eintrages für Prüfung DFC_ComCtrSecInt" VALUE 0x80029974 Val_Wu8 15.00 DFES_OneToOne 0.00 15.00 EXTENDED_LIMITS 0.00 255.0 /end CHARACTERISTIC
/begin CHARACTERISTIC DFES_DbLv.DFC_ComDiaOBDGbxSig_A_C "DFES/Entprelllevel zur Erstellung eines DFES Eintrages für Prüfung DFC_ComDiaOBDGbxSig_A" VALUE 0x80029975 Val_Wu8 15.00 DFES_OneToOne 0.00 15.00 EXTENDED_LIMITS 0.00 255.0 /end CHARACTERISTIC
/begin CHARACTERISTIC DFES_DbLv.DFC_ComDiaOBDGbxTo_A_C "DFES/Entprelllevel zur Erstellung eines DFES Eintrages für Prüfung DFC_ComDiaOBDGbxTo_A" VALUE 0x80029976 Val_Wu8 15.00 DFES_OneToOne 0.00 15.00 EXTENDED_LIMITS 0.00 255.0 /end CHARACTERISTIC
/begin CHARACTERISTIC DFES_DbLv.DFC_ComFahrzeugtypSig_C "DFES/Entprelllevel zur Erstellung eines DFES Eintrages für Prüfung DFC_ComFahrzeugtypSig" VALUE 0x80029977 Val_Wu8 15.00 DFES_OneToOne 0.00 15.00 EXTENDED_LIMITS 0.00 255.0 /end CHARACTERISTIC
/begin CHARACTERISTIC DFES_DbLv.DFC_ComFahrzeugtypSig_FA_C "DFES/Entprelllevel zur Erstellung eines DFES Eintrages für Prüfung DFC_ComFahrzeugtypSig_FA" VALUE 0x80029978 Val_Wu8 15.00 DFES_OneToOne 0.00 15.00 EXTENDED_LIMITS 0.00 255.0 /end CHARACTERISTIC
/begin CHARACTERISTIC DFES_DbLv.DFC_ComFllupGpwsupSig_FA_C "DFES/Entprelllevel zur Erstellung eines DFES Eintrages für Prüfung DFC_ComFllupGpwsupSig_FA" VALUE 0x80029979 Val_Wu8 15.00 DFES_OneToOne 0.00 15.00 EXTENDED_LIMITS 0.00 255.0 /end CHARACTERISTIC
/begin CHARACTERISTIC DFES_DbLv.DFC_ComFllupGpwsupTo_FA_C "DFES/Entprelllevel zur Erstellung eines DFES Eintrages für Prüfung DFC_ComFllupGpwsupTo_FA" VALUE 0x8002997A Val_Wu8 15.00 DFES_OneToOne 0.00 15.00 EXTENDED_LIMITS 0.00 255.0 /end CHARACTERISTIC
/begin CHARACTERISTIC DFES_DbLv.DFC_ComGbxDataChk_A_C "DFES/Entprelllevel zur Erstellung eines DFES Eintrages für Prüfung DFC_ComGbxDataChk_A" VALUE 0x8002997B Val_Wu8 15.00 DFES_OneToOne 0.00 15.00 EXTENDED_LIMITS 0.00 255.0 /end CHARACTERISTIC
/begin CHARACTERISTIC DFES_DbLv.DFC_ComGbxDataChk_FA_C "DFES/Entprelllevel zur Erstellung eines DFES Eintrages für Prüfung DFC_ComGbxDataChk_FA" VALUE 0x8002997C Val_Wu8 15.00 DFES_OneToOne 0.00 15.00 EXTENDED_LIMITS 0.00 255.0 /end CHARACTERISTIC
/begin CHARACTERISTIC DFES_DbLv.DFC_ComGbxDataCtr_A_C "DFES/Entprelllevel zur Erstellung eines DFES Eintrages für Prüfung DFC_ComGbxDataCtr_A" VALUE 0x8002997D Val_Wu8 15.00 DFES_OneToOne 0.00 15.00 EXTENDED_LIMITS 0.00 255.0 /end CHARACTERISTIC
/begin CHARACTERISTIC DFES_DbLv.DFC_ComGbxDataCtr_FA_C "DFES/Entprelllevel zur Erstellung eines DFES Eintrages für Prüfung DFC_ComGbxDataCtr_FA" VALUE 0x8002997E Val_Wu8 15.00 DFES_OneToOne 0.00 15.00 EXTENDED_LIMITS 0.00 255.0 /end CHARACTERISTIC
/begin CHARACTERISTIC DFES_DbLv.DFC_ComGbxDataSig_A_C "DFES/Entprelllevel zur Erstellung eines DFES Eintrages für Prüfung DFC_ComGbxDataSig_A" VALUE 0x8002997F Val_Wu8 15.00 DFES_OneToOne 0.00 15.00 EXTENDED_LIMITS 0.00 255.0 /end CHARACTERISTIC
/begin CHARACTERISTIC DFES_DbLv.DFC_ComGbxDataSig_FA_C "DFES/Entprelllevel zur Erstellung eines DFES Eintrages für Prüfung DFC_ComGbxDataSig_FA" VALUE 0x80029980 Val_Wu8 15.00 DFES_OneToOne 0.00 15.00 EXTENDED_LIMITS 0.00 255.0 /end CHARACTERISTIC
/begin CHARACTERISTIC DFES_DbLv.DFC_ComGbxDataTo_A_C "DFES/Entprelllevel zur Erstellung eines DFES Eintrages für Prüfung DFC_ComGbxDataTo_A" VALUE 0x80029981 Val_Wu8 15.00 DFES_OneToOne 0.00 15.00 EXTENDED_LIMITS 0.00 255.0 /end CHARACTERISTIC
/begin CHARACTERISTIC DFES_DbLv.DFC_ComGbxDataTo_FA_C "DFES/Entprelllevel zur Erstellung eines DFES Eintrages für Prüfung DFC_ComGbxDataTo_FA" VALUE 0x80029982 Val_Wu8 15.00 DFES_OneToOne 0.00 15.00 EXTENDED_LIMITS 0.00 255.0 /end CHARACTERISTIC
/begin CHARACTERISTIC DFES_DbLv.DFC_ComKlemmenChk_FA_C "DFES/Entprelllevel zur Erstellung eines DFES Eintrages für Prüfung DFC_ComKlemmenChk_FA" VALUE 0x80029983 Val_Wu8 15.00 DFES_OneToOne 0.00 15.00 EXTENDED_LIMITS 0.00 255.0 /end CHARACTERISTIC
/begin CHARACTERISTIC DFES_DbLv.DFC_ComKlemmenCtr_FA_C "DFES/Entprelllevel zur Erstellung eines DFES Eintrages für Prüfung DFC_ComKlemmenCtr_FA" VALUE 0x80029984 Val_Wu8 15.00 DFES_OneToOne 0.00 15.00 EXTENDED_LIMITS 0.00 255.0 /end CHARACTERISTIC
/begin CHARACTERISTIC DFES_DbLv.DFC_ComKlemmenSig_FA_C "DFES/Entprelllevel zur Erstellung eines DFES Eintrages für Prüfung DFC_ComKlemmenSig_FA" VALUE 0x80029985 Val_Wu8 15.00 DFES_OneToOne 0.00 15.00 EXTENDED_LIMITS 0.00 255.0 /end CHARACTERISTIC
/begin CHARACTERISTIC DFES_DbLv.DFC_ComKlemmenTo_FA_C "DFES/Entprelllevel zur Erstellung eines DFES Eintrages für Prüfung DFC_ComKlemmenTo_FA" VALUE 0x80029986 Val_Wu8 15.00 DFES_OneToOne 0.00 15.00 EXTENDED_LIMITS 0.00 255.0 /end CHARACTERISTIC
/begin CHARACTERISTIC DFES_DbLv.DFC_ComLenkradwinkelSig_C "DFES/Entprelllevel zur Erstellung eines DFES Eintrages für Prüfung DFC_ComLenkradwinkelSig" VALUE 0x80029987 Val_Wu8 15.00 DFES_OneToOne 0.00 15.00 EXTENDED_LIMITS 0.00 255.0 /end CHARACTERISTIC
/begin CHARACTERISTIC DFES_DbLv.DFC_ComLenkradwinkelTo_C "DFES/Entprelllevel zur Erstellung eines DFES Eintrages für Prüfung DFC_ComLenkradwinkelTo" VALUE 0x80029988 Val_Wu8 15.00 DFES_OneToOne 0.00 15.00 EXTENDED_LIMITS 0.00 255.0 /end CHARACTERISTIC
/begin CHARACTERISTIC DFES_DbLv.DFC_ComMileageRangeSig_FA_C "DFES/Entprelllevel zur Erstellung eines DFES Eintrages für Prüfung DFC_ComMileageRangeSig_FA" VALUE 0x80029989 Val_Wu8 15.00 DFES_OneToOne 0.00 15.00 EXTENDED_LIMITS 0.00 255.0 /end CHARACTERISTIC
/begin CHARACTERISTIC DFES_DbLv.DFC_ComMileageRangeTo_FA_C "DFES/Entprelllevel zur Erstellung eines DFES Eintrages für Prüfung DFC_ComMileageRangeTo_FA" VALUE 0x8002998A Val_Wu8 15.00 DFES_OneToOne 0.00 15.00 EXTENDED_LIMITS 0.00 255.0 /end CHARACTERISTIC
/begin CHARACTERISTIC DFES_DbLv.DFC_ComPspSig_C "DFES/Entprelllevel zur Erstellung eines DFES Eintrages für Prüfung DFC_ComPspSig" VALUE 0x8002998B Val_Wu8 15.00 DFES_OneToOne 0.00 15.00 EXTENDED_LIMITS 0.00 255.0 /end CHARACTERISTIC
/begin CHARACTERISTIC DFES_DbLv.DFC_ComPspTo_C "DFES/Entprelllevel zur Erstellung eines DFES Eintrages für Prüfung DFC_ComPspTo" VALUE 0x8002998C Val_Wu8 15.00 DFES_OneToOne 0.00 15.00 EXTENDED_LIMITS 0.00 255.0 /end CHARACTERISTIC
/begin CHARACTERISTIC DFES_DbLv.DFC_ComRelTimeSig_FA_C "DFES/Entprelllevel zur Erstellung eines DFES Eintrages für Prüfung DFC_ComRelTimeSig_FA" VALUE 0x8002998D Val_Wu8 15.00 DFES_OneToOne 0.00 15.00 EXTENDED_LIMITS 0.00 255.0 /end CHARACTERISTIC
/begin CHARACTERISTIC DFES_DbLv.DFC_ComRelTimeTo_FA_C "DFES/Entprelllevel zur Erstellung eines DFES Eintrages für Prüfung DFC_ComRelTimeTo_FA" VALUE 0x8002998E Val_Wu8 15.00 DFES_OneToOne 0.00 15.00 EXTENDED_LIMITS 0.00 255.0 /end CHARACTERISTIC
/begin CHARACTERISTIC DFES_DbLv.DFC_ComRequestEMFChk_C "DFES/Entprelllevel zur Erstellung eines DFES Eintrages für Prüfung DFC_ComRequestEMFChk" VALUE 0x8002998F Val_Wu8 15.00 DFES_OneToOne 0.00 15.00 EXTENDED_LIMITS 0.00 255.0 /end CHARACTERISTIC
/begin CHARACTERISTIC DFES_DbLv.DFC_ComRequestEMFCtr_C "DFES/Entprelllevel zur Erstellung eines DFES Eintrages für Prüfung DFC_ComRequestEMFCtr" VALUE 0x80029990 Val_Wu8 15.00 DFES_OneToOne 0.00 15.00 EXTENDED_LIMITS 0.00 255.0 /end CHARACTERISTIC
/begin CHARACTERISTIC DFES_DbLv.DFC_ComRequestEMFSig_C "DFES/Entprelllevel zur Erstellung eines DFES Eintrages für Prüfung DFC_ComRequestEMFSig" VALUE 0x80029991 Val_Wu8 15.00 DFES_OneToOne 0.00 15.00 EXTENDED_LIMITS 0.00 255.0 /end CHARACTERISTIC
/begin CHARACTERISTIC DFES_DbLv.DFC_ComRequestEMFTo_C "DFES/Entprelllevel zur Erstellung eines DFES Eintrages für Prüfung DFC_ComRequestEMFTo" VALUE 0x80029992 Val_Wu8 15.00 DFES_OneToOne 0.00 15.00 EXTENDED_LIMITS 0.00 255.0 /end CHARACTERISTIC
/begin CHARACTERISTIC DFES_DbLv.DFC_ComRpmWhlChk_FX_C "DFES/Entprelllevel zur Erstellung eines DFES Eintrages für Prüfung DFC_ComRpmWhlChk_FX" VALUE 0x80029993 Val_Wu8 15.00 DFES_OneToOne 0.00 15.00 EXTENDED_LIMITS 0.00 255.0 /end CHARACTERISTIC
/begin CHARACTERISTIC DFES_DbLv.DFC_ComRpmWhlCtr_FX_C "DFES/Entprelllevel zur Erstellung eines DFES Eintrages für Prüfung DFC_ComRpmWhlCtr_FX" VALUE 0x80029994 Val_Wu8 15.00 DFES_OneToOne 0.00 15.00 EXTENDED_LIMITS 0.00 255.0 /end CHARACTERISTIC
/begin FUNCTION DFES ""
 /begin DEF_CHARACTERISTIC DFES_Cls.DFC_GlwEcuGk2SC_C DFES_Cls.DFC_GlwEcuGk2Wdst_C DFES_Cls.DFC_GlwEcuGk3HSS_C DFES_Cls.DFC_GlwEcuGk3OL_C DFES_Cls.DFC_GlwEcuGk3SC_C DFES_Cls.DFC_GlwEcuGk3Wdst_C DFES_Cls.DFC_GlwEcuGk4HSS_C DFES_Cls.DFC_GlwEcuGk4OL_C DFES_Cls.DFC_GlwEcuGk4SC_C DFES_Cls.DFC_GlwEcuGk4Wdst_C DFES_Cls.DFC_GlwEcuGk5HSS_C DFES_Cls.DFC_GlwEcuGk5OL_C DFES_Cls.DFC_GlwEcuGk5SC_C DFES_Cls.DFC_GlwEcuGk5Wdst_C DFES_Cls.DFC_GlwEcuGk6HSS_C DFES_Cls.DFC_GlwEcuGk6OL_C DFES_Cls.DFC_GlwEcuGk6SC_C DFES_Cls.DFC_GlwEcuGk6Wdst_C DFES_Cls.DFC_GlwEcuGndErr_C DFES_Cls.DFC_GlwEcuIntErr_C DFES_Cls.DFC_GlwEcuMsgTimeout_C DFES_Cls.DFC_GlwEcuT30Err_C DFES_Cls.DFC_GlwEcuTempErr_C DFES_Cls.DFC_GlwEcuUdiffT30_C DFES_Cls.DFC_IBSComErr_C DFES_Cls.DFC_LubSRCOilFldtCrit_C DFES_Cls.DFC_LubSRCOilFldtCritDflMin_C DFES_Cls.DFC_LubSRCOilLvlCritMax_C DFES_Cls.DFC_LubSRCOilLvlCritMin_C DFES_Cls.DFC_LubSRCTot_C DFES_Cls.DFC_MonUMaxSupply1_C DFES_Cls.DFC_MonUMinSupply1_C DFES_Cls.DFC_OilComNpl_C DFES_Cls.DFC_PCBS_C DFES_Cls.DFC_PCBSPFltChg_C DFES_Cls.DFC_PCRGovDvtLPMax_C DFES_Cls.DFC_PCRGovDvtLPMin_C DFES_Cls.DFC_PCRGovDvtMax_C DFES_Cls.DFC_PCRGovDvtMin_C DFES_Cls.DFC_PFltAPSPlausMAX_C DFES_Cls.DFC_PFltAPSPlausMIN_C DFES_Cls.DFC_PFltBPSPlausMAX_C DFES_Cls.DFC_PFltBPSPlausMIN_C DFES_Cls.DFC_PFltOvldInhRgn_C DFES_Cls.DFC_PFltOvldTrqLim_C DFES_Cls.DFC_PFltPresPlausMAX_C DFES_Cls.DFC_PFltPresPlausMIN_C DFES_Cls.DFC_PFltTraRpmRdc_C DFES_Cls.DFC_PFlt_tOxiPreMax_C DFES_Cls.DFC_PFlt_tOxiPreMaxRgn_C DFES_Cls.DFC_PFlt_tOxiPreNpl_C DFES_Cls.DFC_PFlt_tPreMax_C DFES_Cls.DFC_PFlt_tPreMaxRgn_C DFES_Cls.DFC_PFlt_tPreNpl_C DFES_Cls.DFC_PFltmSotDiffMAX_C DFES_Cls.DFC_PFltmSotDiffMIN_C DFES_Cls.DFC_PFltmSotDiffSIG_C DFES_Cls.DFC_PIntkVUsEnvPPls_C DFES_Cls.DFC_PresPlausDblDef_C DFES_Cls.DFC_RailCPC1_C DFES_Cls.DFC_RailCPC3_C DFES_Cls.DFC_RailCPC4_C DFES_Cls.DFC_RailMeUn0_C DFES_Cls.DFC_RailMeUn1_C DFES_Cls.DFC_RailMeUn2_C DFES_Cls.DFC_RailMeUn22_C DFES_Cls.DFC_RailMeUn3_C DFES_Cls.DFC_RailMeUn4_C DFES_Cls.DFC_RailMeUn42_C DFES_Cls.DFC_RailMeUn5_C DFES_Cls.DFC_RailPCV0_C DFES_Cls.DFC_RailPCV1_C DFES_Cls.DFC_RailPCV2_C DFES_Cls.DFC_RailPCV22_C DFES_Cls.DFC_RailPCV3_C DFES_Cls.DFC_RailPCV4_C DFES_Cls.DFC_RailPCV42_C DFES_Cls.DFC_RailPMonStrt_C DFES_Cls.DFC_SSpMon1_C DFES_Cls.DFC_SSpMon2_C DFES_Cls.DFC_SSpMon3_C DFES_Cls.DFC_ThrVlv4WinErr1_C DFES_Cls.DFC_ThrVlv4WinErr2_C DFES_Cls.DFC_ThrVlv4WinErr3_C DFES_Cls.DFC_ThrVlv4WinErr4_C DFES_Cls.DFC_ThrVlvSCG_C DFES_Cls.DFC_Tle6232Spi1_C DFES_Cls.DFC_TrbCh4WinErr1_C DFES_Cls.DFC_TrbCh4WinErr2_C DFES_Cls.DFC_TrbCh4WinErr3_C DFES_Cls.DFC_TrbCh4WinErr4_C DFES_Cls.DFC_TrbChSCG_C DFES_Cls.DFC_TrbChSRCMax_C DFES_Cls.DFC_TrbChSRCMin_C DFES_Cls.DFC_WaHtEl4WinErr1_C DFES_Cls.DFC_WaHtEl4WinErr2_C DFES_Cls.DFC_WaHtEl4WinErr3_C DFES_Cls.DFC_WaHtEl4WinErr4_C DFES_Cls.DFC_WaHtElSCG_C DFES_Cls.DFC_ETClbETFltMax_0_C DFES_Cls.DFC_ETClbETFltMax_1_C DFES_Cls.DFC_ETClbETFltMax_2_C DFES_Cls.DFC_ETClbETFltMax_3_C DFES_Cls.DFC_ETClbETFltMax_4_C DFES_Cls.DFC_ETClbETFltMax_5_C DFES_Cls.DFC_ETClbETFltMin_0_C DFES_Cls.DFC_ETClbETFltMin_1_C DFES_Cls.DFC_ETClbETFltMin_2_C DFES_Cls.DFC_ETClbETFltMin_3_C DFES_Cls.DFC_ETClbETFltMin_4_C DFES_Cls.DFC_ETClbETFltMin_5_C DFES_Cls.DFC_InjCrvInjLimChrgBal_C DFES_Cls.DFC_InjCrvInjLimQntBal_C DFES_Cls.DFC_InjCrvInjLimSys_C DFES_Cls.DFC_InjCrvNumInjRtmLim_C DFES_Cls.DFC_LSUHtCoupSig_C DFES_Cls.DFC_AFS_SSpShOffOL_C DFES_Cls.DFC_AFS_SSpShOffOvrTemp_C DFES_Cls.DFC_AFS_SSpShOffSCB_C DFES_Cls.DFC_AFS_SSpShOffSCG_C DFES_Cls.DFC_AirCCmprOL_C DFES_Cls.DFC_AirCCmprOvrTemp_C DFES_Cls.DFC_AirCCmprSCB_C DFES_Cls.DFC_AirCCmprSCG_C DFES_Cls.DFC_CByVlvOL_C DFES_Cls.DFC_CByVlvOvrTemp_C DFES_Cls.DFC_CByVlvSCB_C DFES_Cls.DFC_CByVlvSCG_C DFES_Cls.DFC_CThmstOL_C DFES_Cls.DFC_CThmstOvrTemp_C DFES_Cls.DFC_CThmstSCB_C DFES_Cls.DFC_CThmstSCG_C DFES_Cls.DFC_DSMDummy_C DFES_Cls.DFC_EBxFanOL_C DFES_Cls.DFC_EBxFanOvrTemp_C DFES_Cls.DFC_EBxFanSCB_C DFES_Cls.DFC_EBxFanSCG_C DFES_Cls.DFC_ECBVlvOL_C DFES_Cls.DFC_ECBVlvOvrTemp_C DFES_Cls.DFC_ECBVlvSCB_C DFES_Cls.DFC_ECBVlvSCG_C DFES_Cls.DFC_EMDmpOL_0_C DFES_Cls.DFC_EMDmpOL_1_C DFES_Cls.DFC_EMDmpOvrTemp_0_C DFES_Cls.DFC_EMDmpOvrTemp_1_C DFES_Cls.DFC_EMDmpSCB_0_C DFES_Cls.DFC_EMDmpSCB_1_C DFES_Cls.DFC_EMDmpSCG_0_C DFES_Cls.DFC_EMDmpSCG_1_C DFES_Cls.DFC_EngStAOL_C DFES_Cls.DFC_EngStAOvrTemp_C DFES_Cls.DFC_EngStASCB_C DFES_Cls.DFC_EngStASCG_C DFES_Cls.DFC_FanOL_C DFES_Cls.DFC_FanOvrTemp_C DFES_Cls.DFC_FanSCB_C DFES_Cls.DFC_FlFltHtOL_C DFES_Cls.DFC_FlFltHtOvrTemp_C DFES_Cls.DFC_FlFltHtSCB_C DFES_Cls.DFC_FlFltHtSCG_C DFES_Cls.DFC_LSUHtrMax_C DFES_Cls.DFC_LSUHtrMin_C DFES_Cls.DFC_LSUHtrNpl_C DFES_Cls.DFC_LSUHtrSig_C DFES_Cls.DFC_LSUtExcMax_C DFES_Cls.DFC_LSUtExcMin_C DFES_Cls.DFC_MeUnOL_C DFES_Cls.DFC_MeUnSCB_C DFES_Cls.DFC_MeUnSRCMax_C DFES_Cls.DFC_MeUnSRCMin_C DFES_Cls.DFC_PCVOL_C DFES_Cls.DFC_PCVSCB_C DFES_Cls.DFC_PCVSRCMax_C DFES_Cls.DFC_PCVSRCMin_C DFES_Cls.DFC_RailPSRCMax_C DFES_Cls.DFC_RailPSRCMin_C DFES_Cls.DFC_ShtrOL_C DFES_Cls.DFC_ShtrOvrTemp_C DFES_Cls.DFC_ShtrSCB_C DFES_Cls.DFC_ShtrSCG_C DFES_Cls.DFC_StrtOL_C DFES_Cls.DFC_StrtOvrTemp_C DFES_Cls.DFC_StrtSCB_C DFES_Cls.DFC_StrtSCG_C DFES_Cls.DFC_ThrVlvOL_C DFES_Cls.DFC_ThrVlvOvrTemp_C DFES_Cls.DFC_ThrVlvSCB_C DFES_Cls.DFC_TrbChOL_C DFES_Cls.DFC_TrbChOvrTemp_C DFES_Cls.DFC_TrbChSCB_C DFES_Cls.DFC_UDosVlvOL_C DFES_Cls.DFC_UDosVlvOvrTemp_C DFES_Cls.DFC_UDosVlvSCB_C DFES_Cls.DFC_UDosVlvSCG_C DFES_Cls.DFC_UPmpMotOL_C DFES_Cls.DFC_UPmpMotOvrTemp_C DFES_Cls.DFC_UPmpMotSCB_C DFES_Cls.DFC_UPmpMotSCG_C DFES_Cls.DFC_WaHtElOL_C DFES_Cls.DFC_WaHtElOvrTemp_C DFES_Cls.DFC_WaHtElSCB_C DFES_Cls.DFC_IVActrUChSRCMax_C DFES_Cls.DFC_IVActrUChSRCMin_C DFES_Cls.DFC_IVActrVltgSRCMax_C DFES_Cls.DFC_IVActrVltgSRCMin_C DFES_Cls.DFC_IVDiaTunDet_C DFES_Cls.DFC_IVPSplyStopDCDC_C DFES_Cls.DFC_IVPSplyVltgSRCMax_C DFES_Cls.DFC_IVPSplyVltgSRCMin_C DFES_Cls.DFC_SCREtaErr_C DFES_Cls.DFC_SCREtaErr1_C DFES_Cls.DFC_SCREtaErr2_C DFES_Cls.DFC_SCRMonMetCtlPresErr_C DFES_Cls.DFC_SCRMonPresBuildUpErr_C DFES_Cls.DFC_SCRMonPresRdcErr_C DFES_Cls.DFC_AFSOffsDrftMax_C DFES_Cls.DFC_AFSOffsDrftMin_C DFES_Cls.DFC_AFSSRCCorMax_C DFES_Cls.DFC_AFSSRCCorMin_C DFES_Cls.DFC_AFSSRCRawMax_C DFES_Cls.DFC_AFSSRCRawMin_C DFES_Cls.DFC_AFSSetyDrftMax_C DFES_Cls.DFC_AFSSetyDrftMin_C DFES_Cls.DFC_AirCSwtNpl_C DFES_Cls.DFC_AirCSwtSig_C DFES_Cls.DFC_BattUSRCMax_C DFES_Cls.DFC_BattUSRCMin_C DFES_Cls.DFC_BrkNpl_C DFES_Cls.DFC_BrkPSRCMax_C DFES_Cls.DFC_BrkPSRCMin_C DFES_Cls.DFC_CEngDsTSRCMax_C DFES_Cls.DFC_CEngDsTSRCMin_C DFES_Cls.DFC_CrCUIDet_C DFES_Cls.DFC_ECBVlvSRCMax_C DFES_Cls.DFC_ECBVlvSRCMin_C DFES_Cls.DFC_ECUOvrTemp_C DFES_Cls.DFC_EGRVlvGovDvtMax_C DFES_Cls.DFC_EGRVlvGovDvtMin_C DFES_Cls.DFC_EGRVlvHBrgOpnLd_C DFES_Cls.DFC_EGRVlvHBrgOvrCurr_C DFES_Cls.DFC_EGRVlvHBrgOvrTemp_C DFES_Cls.DFC_EGRVlvHBrgShCirBatt1_C DFES_Cls.DFC_EGRVlvHBrgShCirBatt2_C DFES_Cls.DFC_EGRVlvHBrgShCirGnd1_C DFES_Cls.DFC_EGRVlvHBrgShCirGnd2_C DFES_Cls.DFC_EGRVlvHBrgShCirOvrLd_C DFES_Cls.DFC_EGRVlvHBrgTempOvrCurr_C DFES_Cls.DFC_EGRVlvHBrgUndrVltg_C DFES_Cls.DFC_EGRVlvLPGovDvtMax_C DFES_Cls.DFC_EGRVlvLPGovDvtMin_C DFES_Cls.DFC_EGRVlvLPHBrgOpnLd_C DFES_Cls.DFC_EGRVlvLPHBrgOvrCurr_C DFES_Cls.DFC_EGRVlvLPHBrgOvrTemp_C DFES_Cls.DFC_EGRVlvLPHBrgShCirBatt1_C DFES_Cls.DFC_EGRVlvLPHBrgShCirBatt2_C DFES_Cls.DFC_EGRVlvLPHBrgShCirGnd1_C DFES_Cls.DFC_EGRVlvLPHBrgShCirGnd2_C DFES_Cls.DFC_EGRVlvLPHBrgShCirOvrLd_C DFES_Cls.DFC_EGRVlvLPHBrgTempOvrCurr_C DFES_Cls.DFC_EGRVlvLPHBrgUndrVltg_C DFES_Cls.DFC_EGRVlvLPOL_C DFES_Cls.DFC_EGRVlvLPSCB_C DFES_Cls.DFC_EGRVlvLPSCG_C DFES_Cls.DFC_EGRVlvLPSRCMax_C DFES_Cls.DFC_EGRVlvLPSRCMin_C DFES_Cls.DFC_EGRVlvOL_C DFES_Cls.DFC_EGRVlvSCB_C DFES_Cls.DFC_EGRVlvSCG_C DFES_Cls.DFC_EGRVlvSRCMax_C DFES_Cls.DFC_EGRVlvSRCMin_C DFES_Cls.DFC_EngPrtOvrSpd_C DFES_Cls.DFC_EngSpdOL_C DFES_Cls.DFC_EngSpdSCB_C DFES_Cls.DFC_EngSpdSCG_C DFES_Cls.DFC_EnhSRCMaxPPFltDiff_C DFES_Cls.DFC_EnhSRCMaxT1ExhTMon_C DFES_Cls.DFC_EnhSRCMaxT2ExhTMon_C DFES_Cls.DFC_EnhSRCMaxT3ExhTMon_C DFES_Cls.DFC_EnhSRCMinPPFltDiff_C DFES_Cls.DFC_EnhSRCMinT1ExhTMon_C DFES_Cls.DFC_EnhSRCMinT2ExhTMon_C DFES_Cls.DFC_EnhSRCMinT3ExhTMon_C DFES_Cls.DFC_EnvPSRCMax_C DFES_Cls.DFC_EnvPSRCMin_C DFES_Cls.DFC_ExhTMonPlaus_C DFES_Cls.DFC_ExhTMonPlausPos1_C DFES_Cls.DFC_ExhTMonPlausPos2_C DFES_Cls.DFC_ExhTMonPlausPos3_C DFES_Cls.DFC_ExhTMonT1Plaus_C DFES_Cls.DFC_ExhTMonT2Plaus_C DFES_Cls.DFC_ExhTMonT3Plaus_C DFES_Cls.DFC_FlFltDsPSRCMax_C DFES_Cls.DFC_FlFltDsPSRCMin_C DFES_Cls.DFC_FlFltSig_C DFES_Cls.DFC_FlFltUsPSRCMax_C DFES_Cls.DFC_FlFltUsPSRCMin_C DFES_Cls.DFC_FuelTSRCMax_C DFES_Cls.DFC_FuelTSRCMin_C DFES_Cls.DFC_GbxNPosPPerSRCMax_C DFES_Cls.DFC_GbxNPosPPerSRCMin_C DFES_Cls.DFC_GbxNPosPdcycSRCMax_C DFES_Cls.DFC_GbxNPosPdcycSRCMin_C DFES_Cls.DFC_InjVlvPresMin_C DFES_Cls.DFC_LSUCircNernstSig_C DFES_Cls.DFC_LSUCircPmpCurSig_C DFES_Cls.DFC_LSUCircVirtGndSig_C DFES_Cls.DFC_LSUO2Max_C DFES_Cls.DFC_LSUO2Min_C DFES_Cls.DFC_LSUSPIBattLowMin_C DFES_Cls.DFC_LSUWireSCB_C DFES_Cls.DFC_LSUWireSCG_C DFES_Cls.DFC_MeUnSCG_C DFES_Cls.DFC_NSCDsCmpChk_C DFES_Cls.DFC_NSCDsLamBinSRCMax_C DFES_Cls.DFC_NSCDsLamBinSRCMin_C DFES_Cls.DFC_NSCDsLamLinSRCMax_C DFES_Cls.DFC_NSCDsLamLinSRCMin_C DFES_Cls.DFC_NSCDsLamPlausMax_C DFES_Cls.DFC_NSCDsLamPlausMin_C DFES_Cls.DFC_NSCDsNOxSRCMax_C DFES_Cls.DFC_NSCDsNOxSRCMin_C DFES_Cls.DFC_NSCDsOpCir_C DFES_Cls.DFC_NSCDsShCir_C DFES_Cls.DFC_NoCat2DsCmpChk_C DFES_Cls.DFC_NoCat2DsLamBinSRCMax_C DFES_Cls.DFC_NoCat2DsLamBinSRCMin_C DFES_Cls.DFC_NoCat2DsLamLinSRCMax_C DFES_Cls.DFC_NoCat2DsLamLinSRCMin_C DFES_Cls.DFC_NoCat2DsLamPlausMax_C DFES_Cls.DFC_NoCat2DsLamPlausMin_C DFES_Cls.DFC_NoCat2DsNOxSRCMax_C DFES_Cls.DFC_NoCat2DsNOxSRCMin_C DFES_Cls.DFC_NoCat2DsOpCir_C DFES_Cls.DFC_NoCat2DsShCir_C DFES_Cls.DFC_NplDynPPFltDiff_C DFES_Cls.DFC_NplHsChngPPFltDiff_C DFES_Cls.DFC_NplHsLnPPFltDiff_C DFES_Cls.DFC_NplTOxiCatUs_C DFES_Cls.DFC_NplTPFltUs_C DFES_Cls.DFC_NplTTrbnUs_C DFES_Cls.DFC_OilPSwmpSRCMax_C DFES_Cls.DFC_OilPSwmpSRCMin_C DFES_Cls.DFC_PCVSCG_C DFES_Cls.DFC_PFltCharPDiffMin_C DFES_Cls.DFC_PFltDstrMin_C DFES_Cls.DFC_PFltEngPrt_C DFES_Cls.DFC_PFltRgnPerm_C DFES_Cls.DFC_PFltSRCMaxFlwRstn_C DFES_Cls.DFC_PFltSRCMinFlwRstn_C DFES_Cls.DFC_PFltSotMsDvtMax_C DFES_Cls.DFC_PFltSotMsDvtMin_C DFES_Cls.DFC_PFltSotMsMax_C DFES_Cls.DFC_PIntkVUsSRCMax_C DFES_Cls.DFC_PIntkVUsSRCMin_C DFES_Cls.DFC_SRCHighAPP1_C DFES_Cls.DFC_SRCHighAPP2_C DFES_Cls.DFC_SRCLowAPP1_C DFES_Cls.DFC_SRCLowAPP2_C DFES_Cls.DFC_SRCMaxPPFltDiff_C DFES_Cls.DFC_SRCMaxPPFltUs_C DFES_Cls.DFC_SRCMaxTECU_C DFES_Cls.DFC_SRCMaxTOxiCatUs_C DFES_Cls.DFC_SRCMaxTPFltUs_C DFES_Cls.DFC_SRCMaxTTrbnUs_C DFES_Cls.DFC_SRCMaxUCatUsT_C DFES_Cls.DFC_SRCMaxUPmpP_C DFES_Cls.DFC_SRCMinPPFltDiff_C DFES_Cls.DFC_SRCMinPPFltUs_C DFES_Cls.DFC_SRCMinTECU_C DFES_Cls.DFC_SRCMinTOxiCatUs_C DFES_Cls.DFC_SRCMinTPFltUs_C DFES_Cls.DFC_SRCMinTTrbnUs_C DFES_Cls.DFC_SRCMinUCatUsT_C DFES_Cls.DFC_SRCMinUPmpP_C DFES_Cls.DFC_SigUCatUsT_C DFES_Cls.DFC_SigUPmpP_C DFES_Cls.DFC_SyncAPP_C DFES_Cls.DFC_T15Npl_C DFES_Cls.DFC_TAFSDtyCycHi_C DFES_Cls.DFC_TAFSDtyCycLo_C DFES_Cls.DFC_TAFSPerHi_C DFES_Cls.DFC_TAFSPerLo_C DFES_Cls.DFC_TCACDsSRCMax_C DFES_Cls.DFC_TCACDsSRCMin_C DFES_Cls.DFC_ThrVlvSRCMax_C DFES_Cls.DFC_ThrVlvSRCMin_C DFES_Cls.DFC_TrbChLPOL_C DFES_Cls.DFC_TrbChLPSCB_C DFES_Cls.DFC_TrbChLPSCG_C DFES_Cls.DFC_UHtrPLOL_C DFES_Cls.DFC_UHtrPLSCB_C DFES_Cls.DFC_UHtrPLSCG_C DFES_Cls.DFC_UHtrPLSRCMaxDia_C DFES_Cls.DFC_UHtrPLSRCMinDia_C DFES_Cls.DFC_UHtrTnkOL_C DFES_Cls.DFC_UHtrTnkSCB_C DFES_Cls.DFC_UHtrTnkSCG_C DFES_Cls.DFC_UHtrTnkSRCMaxDia_C DFES_Cls.DFC_UHtrTnkSRCMinDia_C DFES_Cls.DFC_URevVlvOL_C DFES_Cls.DFC_URevVlvSCB_C DFES_Cls.DFC_URevVlvSCG_C DFES_Cls.DFC_UTnkTSRCMax_C DFES_Cls.DFC_UTnkTSRCMin_C DFES_Cls.DFC_UTnkTSig_C DFES_Cls.DFC_VSwVlvGovDvtMax_C DFES_Cls.DFC_VSwVlvGovDvtMin_C DFES_Cls.DFC_VSwVlvHBrgOpnLd_C DFES_Cls.DFC_VSwVlvHBrgOvrCurr_C DFES_Cls.DFC_VSwVlvHBrgOvrTemp_C DFES_Cls.DFC_VSwVlvHBrgShCirBatt1_C DFES_Cls.DFC_VSwVlvHBrgShCirBatt2_C DFES_Cls.DFC_VSwVlvHBrgShCirGnd1_C DFES_Cls.DFC_VSwVlvHBrgShCirGnd2_C DFES_Cls.DFC_VSwVlvHBrgShCirOvrLd_C DFES_Cls.DFC_VSwVlvHBrgTempOvrCurr_C DFES_Cls.DFC_VSwVlvHBrgUndrVltg_C DFES_Cls.DFC_VSwVlvOL_C DFES_Cls.DFC_VSwVlvSCB_C DFES_Cls.DFC_VSwVlvSCG_C DFES_Cls.DFC_VSwVlvSRCMax_C DFES_Cls.DFC_VSwVlvSRCMin_C DFES_Cls.DFC_ClthNpl_C DFES_Cls.DFC_ETClbETMax_0_C DFES_Cls.DFC_ETClbETMax_1_C DFES_Cls.DFC_ETClbETMax_2_C DFES_Cls.DFC_ETClbETMax_3_C DFES_Cls.DFC_ETClbETMax_4_C DFES_Cls.DFC_ETClbETMax_5_C DFES_Cls.DFC_ETClbETMin_0_C DFES_Cls.DFC_ETClbETMin_1_C DFES_Cls.DFC_ETClbETMin_2_C DFES_Cls.DFC_ETClbETMin_3_C DFES_Cls.DFC_ETClbETMin_4_C DFES_Cls.DFC_ETClbETMin_5_C DFES_Cls.DFC_IVActrEnrgMax_0_C DFES_Cls.DFC_IVActrEnrgMax_1_C DFES_Cls.DFC_IVActrEnrgMax_2_C DFES_Cls.DFC_IVActrEnrgMax_3_C DFES_Cls.DFC_IVActrEnrgMax_4_C DFES_Cls.DFC_IVActrEnrgMax_5_C DFES_Cls.DFC_IVActrEnrgMax_6_C DFES_Cls.DFC_IVActrEnrgMax_7_C DFES_Cls.DFC_IVActrEnrgMin_0_C DFES_Cls.DFC_IVActrEnrgMin_1_C DFES_Cls.DFC_IVActrEnrgMin_2_C DFES_Cls.DFC_IVActrEnrgMin_3_C DFES_Cls.DFC_IVActrEnrgMin_4_C DFES_Cls.DFC_IVActrEnrgMin_5_C DFES_Cls.DFC_IVActrEnrgMin_6_C DFES_Cls.DFC_IVActrEnrgMin_7_C DFES_Cls.DFC_IVActrEnrgPlaus_0_C DFES_Cls.DFC_IVActrEnrgPlaus_1_C DFES_Cls.DFC_IVActrEnrgPlaus_2_C DFES_Cls.DFC_IVActrEnrgPlaus_3_C DFES_Cls.DFC_IVActrEnrgPlaus_4_C DFES_Cls.DFC_IVActrEnrgPlaus_5_C DFES_Cls.DFC_IVActrEnrgPlaus_6_C DFES_Cls.DFC_IVActrEnrgPlaus_7_C DFES_Cls.DFC_IVCtlTiDiff_0_C DFES_Cls.DFC_IVCtlTiDiff_1_C DFES_Cls.DFC_IVCtlTiDiff_2_C DFES_Cls.DFC_IVCtlTiDiff_3_C DFES_Cls.DFC_IVCtlTiDiff_4_C DFES_Cls.DFC_IVCtlTiDiff_5_C DFES_Cls.DFC_IVCtlUDiffUp_0_C DFES_Cls.DFC_IVCtlUDiffUp_1_C DFES_Cls.DFC_IVCtlUDiffUp_2_C DFES_Cls.DFC_IVCtlUDiffUp_3_C DFES_Cls.DFC_IVCtlUDiffUp_4_C DFES_Cls.DFC_IVCtlUDiffUp_5_C DFES_Cls.DFC_IVCtlUUp_0_C DFES_Cls.DFC_IVCtlUUp_1_C DFES_Cls.DFC_IVCtlUUp_2_C DFES_Cls.DFC_IVCtlUUp_3_C DFES_Cls.DFC_IVCtlUUp_4_C DFES_Cls.DFC_IVCtlUUp_5_C DFES_Cls.DFC_IVDiaBnkShCir_0_C DFES_Cls.DFC_IVDiaBnkShCir_1_C DFES_Cls.DFC_IVDiaBnkShCirChSwt_0_C DFES_Cls.DFC_IVDiaBnkShCirChSwt_1_C DFES_Cls.DFC_IVDiaChp_0_C DFES_Cls.DFC_IVDiaChp_1_C DFES_Cls.DFC_IVDiaCylNoCls_0_C DFES_Cls.DFC_IVDiaCylNoCls_1_C DFES_Cls.DFC_IVDiaCylNoCls_2_C DFES_Cls.DFC_IVDiaCylNoCls_3_C DFES_Cls.DFC_IVDiaCylNoCls_4_C DFES_Cls.DFC_IVDiaCylNoCls_5_C DFES_Cls.DFC_IVDiaCylNoLd_0_C DFES_Cls.DFC_IVDiaCylNoLd_1_C DFES_Cls.DFC_IVDiaCylNoLd_2_C DFES_Cls.DFC_IVDiaCylNoLd_3_C DFES_Cls.DFC_IVDiaCylNoLd_4_C DFES_Cls.DFC_IVDiaCylNoLd_5_C DFES_Cls.DFC_IVDiaCylShCir_0_C DFES_Cls.DFC_IVDiaCylShCir_1_C DFES_Cls.DFC_IVDiaCylShCir_2_C DFES_Cls.DFC_IVDiaCylShCir_3_C DFES_Cls.DFC_IVDiaCylShCir_4_C DFES_Cls.DFC_IVDiaCylShCir_5_C DFES_Cls.DFC_IVDiaCylShCirHSLS_0_C DFES_Cls.DFC_IVDiaCylShCirHSLS_1_C DFES_Cls.DFC_IVDiaCylShCirHSLS_2_C DFES_Cls.DFC_IVDiaCylShCirHSLS_3_C DFES_Cls.DFC_IVDiaCylShCirHSLS_4_C DFES_Cls.DFC_IVDiaCylShCirHSLS_5_C DFES_Cls.DFC_IVDiaCylShCirMeas_0_C DFES_Cls.DFC_IVDiaCylShCirMeas_1_C DFES_Cls.DFC_IVDiaCylShCirMeas_2_C DFES_Cls.DFC_IVDiaCylShCirMeas_3_C DFES_Cls.DFC_IVDiaCylShCirMeas_4_C DFES_Cls.DFC_IVDiaCylShCirMeas_5_C DFES_Cls.DFC_LSUDynChk_C DFES_Cls.DFC_LSUO2ClbMax_C DFES_Cls.DFC_LSUO2ClbMin_C DFES_Cls.DFC_LSUO2PlausMaxFLd_C DFES_Cls.DFC_LSUO2PlausMaxOvrRun_C DFES_Cls.DFC_LSUO2PlausMaxPartLd_C DFES_Cls.DFC_LSUO2PlausMinFLd_C DFES_Cls.DFC_LSUO2PlausMinOvrRun_C DFES_Cls.DFC_LSUO2PlausMinPartLd_C DFES_Cls.DFC_LSURiClbMax_C DFES_Cls.DFC_LSURiClbMin_C DFES_Cls.DFC_LSUWireIPSig_C DFES_Cls.DFC_Layer_BSDMax_C DFES_Cls.DFC_Layer_BSDMin_C DFES_Cls.DFC_Layer_BSDNpl_C DFES_Cls.DFC_Layer_BSDSig_C DFES_Cls.DFC_Layer_FltMngTstMax_C DFES_Cls.DFC_Layer_FltMngTstMin_C DFES_Cls.DFC_Layer_FltMngTstNpl_C DFES_Cls.DFC_Layer_FltMngTstSig_C DFES_Cls.DFC_Layer_GENELBMax_C DFES_Cls.DFC_Layer_GENELBMin_C DFES_Cls.DFC_Layer_GENELBNpl_C DFES_Cls.DFC_Layer_GENELBSig_C DFES_Cls.DFC_Layer_GENELMax_C DFES_Cls.DFC_Layer_GENELMin_C DFES_Cls.DFC_Layer_GENELNpl_C DFES_Cls.DFC_Layer_GENELSig_C DFES_Cls.DFC_Layer_GENHTBMax_C DFES_Cls.DFC_Layer_GENHTBMin_C DFES_Cls.DFC_Layer_GENHTBNpl_C DFES_Cls.DFC_Layer_GENHTBSig_C DFES_Cls.DFC_Layer_GENHTMax_C DFES_Cls.DFC_Layer_GENHTMin_C DFES_Cls.DFC_Layer_GENHTNpl_C DFES_Cls.DFC_Layer_GENHTSig_C DFES_Cls.DFC_Layer_GENKOMMMax_C DFES_Cls.DFC_Layer_GENKOMMMin_C DFES_Cls.DFC_Layer_GENKOMMNpl_C DFES_Cls.DFC_Layer_GENKOMMSig_C DFES_Cls.DFC_Layer_GENMECHMax_C DFES_Cls.DFC_Layer_GENMECHMin_C DFES_Cls.DFC_Layer_GENMECHNpl_C DFES_Cls.DFC_Layer_GENMECHSig_C DFES_Cls.DFC_Layer_GENMax_C DFES_Cls.DFC_Layer_GENMin_C DFES_Cls.DFC_Layer_GENNpl_C DFES_Cls.DFC_Layer_GENREGUPLMax_C DFES_Cls.DFC_Layer_GENREGUPLMin_C DFES_Cls.DFC_Layer_GENREGUPLNpl_C DFES_Cls.DFC_Layer_GENREGUPLSig_C DFES_Cls.DFC_Layer_GENSig_C DFES_Cls.DFC_Layer_GENUPLMax_C DFES_Cls.DFC_Layer_GENUPLMin_C DFES_Cls.DFC_Layer_GENUPLNpl_C DFES_Cls.DFC_Layer_GENUPLSig_C DFES_Cls.DFC_Layer_IBS1Max_C DFES_Cls.DFC_Layer_IBS1Min_C DFES_Cls.DFC_Layer_IBS1Npl_C DFES_Cls.DFC_Layer_IBS1Sig_C DFES_Cls.DFC_Layer_IBS2Max_C DFES_Cls.DFC_Layer_IBS2Min_C DFES_Cls.DFC_Layer_IBS2Npl_C DFES_Cls.DFC_Layer_IBS2Sig_C DFES_Cls.DFC_Layer_IBS3Max_C DFES_Cls.DFC_Layer_IBS3Min_C DFES_Cls.DFC_Layer_IBS3Npl_C DFES_Cls.DFC_Layer_IBS3Sig_C DFES_Cls.DFC_Layer_MANDETEKMax_C DFES_Cls.DFC_Layer_MANDETEKMin_C DFES_Cls.DFC_Layer_MANDETEKNpl_C DFES_Cls.DFC_Layer_MANDETEKSig_C DFES_Cls.DFC_Layer_NDR1Max_C DFES_Cls.DFC_Layer_NDR1Min_C DFES_Cls.DFC_Layer_NDR1Npl_C DFES_Cls.DFC_Layer_NDR1Sig_C DFES_Cls.DFC_Layer_NDR2Max_C DFES_Cls.DFC_Layer_NDR2Min_C DFES_Cls.DFC_Layer_NDR2Npl_C DFES_Cls.DFC_Layer_NDR2Sig_C DFES_Cls.DFC_Layer_NGLERNMax_C DFES_Cls.DFC_Layer_NGLERNMin_C DFES_Cls.DFC_Layer_NGLERNNpl_C DFES_Cls.DFC_Layer_NGLERNSig_C DFES_Cls.DFC_Layer_PMBATTMax_C DFES_Cls.DFC_Layer_PMBATTMin_C DFES_Cls.DFC_Layer_PMBATTNpl_C DFES_Cls.DFC_Layer_PMBATTSig_C DFES_Cls.DFC_Layer_PMBNMax_C DFES_Cls.DFC_Layer_PMBNMin_C DFES_Cls.DFC_Layer_PMBNNpl_C DFES_Cls.DFC_Layer_PMBNSig_C DFES_Cls.DFC_Layer_PMRUHVERLMax_C DFES_Cls.DFC_Layer_PMRUHVERLMin_C DFES_Cls.DFC_Layer_PMRUHVERLNpl_C DFES_Cls.DFC_Layer_PMRUHVERLSig_C DFES_Cls.DFC_Layer_QLTMax_C DFES_Cls.DFC_Layer_QLTMin_C DFES_Cls.DFC_Layer_QLTNpl_C DFES_Cls.DFC_Layer_QLTSig_C DFES_Cls.DFC_Layer_TOENSMax_C DFES_Cls.DFC_Layer_TOENSMin_C DFES_Cls.DFC_Layer_TOENSNpl_C DFES_Cls.DFC_Layer_TOENSSig_C DFES_Cls.DFC_MonLimCurr_C DFES_Cls.DFC_MonLimLead_C DFES_Cls.DFC_MonLimSet_C DFES_Cls.DFC_NSCDsNOxOfsMax_C DFES_Cls.DFC_NSCDsNOxOfsMin_C DFES_Cls.DFC_NSCDsNOxPlausMin_C DFES_Cls.DFC_NoCat2DsNOxOfsMax_C DFES_Cls.DFC_NoCat2DsNOxOfsMin_C DFES_Cls.DFC_NoCat2DsNOxPlausMin_C DFES_Cls.DFC_PCVNoStrt_C DFES_Cls.DFC_RailPGradMon_C DFES_Cls.DFC_SCRPODPresBuildUp_C DFES_Cls.DFC_AFSDrftIdlAdjVal_C DFES_Cls.DFC_AFSDrftLdAdjVal_C DFES_Cls.DFC_AdcIADC0Cal_C DFES_Cls.DFC_AdcIADC0Conv_C DFES_Cls.DFC_AdcIADC1Cal_C DFES_Cls.DFC_AdcIADC1Conv_C DFES_Cls.DFC_CmbChbMisfireMax_0_C DFES_Cls.DFC_CmbChbMisfireMax_1_C DFES_Cls.DFC_CmbChbMisfireMax_2_C DFES_Cls.DFC_CmbChbMisfireMax_3_C DFES_Cls.DFC_CmbChbMisfireMax_4_C DFES_Cls.DFC_CmbChbMisfireMax_5_C DFES_Cls.DFC_CmbChbMisfireMul_C DFES_Cls.DFC_EGRVlvLPOfsNeutr_C DFES_Cls.DFC_EGRVlvOfsNeutr_C DFES_Cls.DFC_FMAErrModMax_C DFES_Cls.DFC_FMAErrModMin_C DFES_Cls.DFC_FlSysTnkLo_C DFES_Cls.DFC_GbxNPosPlaus_C DFES_Cls.DFC_I14229_ROETst_Appl_C DFES_Cls.DFC_I14229_ROETst_Netw_C DFES_Cls.DFC_I14229_ROE_BufFull_C DFES_Cls.DFC_IVAdjDiaIVAdj_C DFES_Cls.DFC_IVAdjIVA_0_C DFES_Cls.DFC_IVAdjIVA_1_C DFES_Cls.DFC_IVAdjIVA_2_C DFES_Cls.DFC_IVAdjIVA_3_C DFES_Cls.DFC_IVAdjIVA_4_C DFES_Cls.DFC_IVAdjIVA_5_C DFES_Cls.DFC_IVPSplyDCDCOff_0_C DFES_Cls.DFC_IVPSplyDCDCOff_1_C DFES_Cls.DFC_IVPSplyDCDCOff_2_C DFES_Cls.DFC_IVPSplyDCDCOff_3_C DFES_Cls.DFC_InjCtlAdjQntEEPCS_C DFES_Cls.DFC_LSUSPISig_C DFES_Cls.DFC_Layer_Dummy_C DFES_Cls.DFC_NplEnvPSensPPFltDiff_C DFES_Cls.DFC_NplPresSensPPFltDiff_C DFES_Cls.DFC_OilLvlPlaus_C DFES_Cls.DFC_OilTOutLvl_C DFES_Cls.DFC_PCVfacAdaptMax_C DFES_Cls.DFC_PCVfacAdaptMin_C DFES_Cls.DFC_SensFrzPPFltUs_C DFES_Cls.DFC_SensMonUTnkLvl_C DFES_Cls.DFC_T15Sig_C DFES_Cls.DFC_AirCtlRmpTOut_C DFES_Cls.DFC_BrkPPlaus_C DFES_Cls.DFC_CEngDsTDynTst_C DFES_Cls.DFC_EEPEraseErr_C DFES_Cls.DFC_EEPRdErr_C DFES_Cls.DFC_EEPWrErr_C DFES_Cls.DFC_EGRVlvJamVlvClsd_C DFES_Cls.DFC_EGRVlvJamVlvOpn_C DFES_Cls.DFC_EGRVlvLPJamVlvClsd_C DFES_Cls.DFC_EGRVlvLPJamVlvOpn_C DFES_Cls.DFC_EGRVlvLPLgTDrft_C DFES_Cls.DFC_EGRVlvLPOfsLrnJamVlv_C DFES_Cls.DFC_EGRVlvLPShTDrft_C DFES_Cls.DFC_EGRVlvLgTDrft_C DFES_Cls.DFC_EGRVlvOfsLrnJamVlv_C DFES_Cls.DFC_EGRVlvShTDrft_C DFES_Cls.DFC_EngICO_C DFES_Cls.DFC_EpmCaSI1ErrSig_C DFES_Cls.DFC_EpmCaSI1NoSig_C DFES_Cls.DFC_EpmCaSI1OfsErr_C DFES_Cls.DFC_EpmCrSErrSig_C DFES_Cls.DFC_EpmCrSNoSig_C DFES_Cls.DFC_IVPlausComprTst_C DFES_Cls.DFC_IVPlausRunUpTst_C DFES_Cls.DFC_InjCrvShOffTst_C DFES_Cls.DFC_LayerEnSavModProd_C DFES_Cls.DFC_LayerEnSavModRep_C DFES_Cls.DFC_LayerEnSavModShip_C DFES_Cls.DFC_MRlyErlyOpng_C DFES_Cls.DFC_MRlyStk_C DFES_Cls.DFC_MeUnActrTst_C DFES_Cls.DFC_MoCADCCmp_C DFES_Cls.DFC_MoCADCTst_C DFES_Cls.DFC_MoCADCVltgRatio_C DFES_Cls.DFC_MoCComErrCnt_C DFES_Cls.DFC_MoCComSPI_C DFES_Cls.DFC_MoCROMErrXPg_C DFES_Cls.DFC_MoCSOPHwNoRdy_C DFES_Cls.DFC_MoCSOPLoLi_C DFES_Cls.DFC_MoCSOPMM_C DFES_Cls.DFC_MoCSOPTimeOut_C DFES_Cls.DFC_MoCSOPUpLi_C DFES_Cls.DFC_MoFAPP_C DFES_Cls.DFC_MoFESpd_C DFES_Cls.DFC_MoFInjDatPhi_C DFES_Cls.DFC_MoFInjDatQnt_C DFES_Cls.DFC_MoFInjQnt_C DFES_Cls.DFC_MoFMode1PoI1_C DFES_Cls.DFC_MoFMode1PoI2_C DFES_Cls.DFC_MoFMode2PoI1_C DFES_Cls.DFC_MoFMode2PoI2_C DFES_Cls.DFC_MoFOvR_C DFES_Cls.DFC_MoFQntCor_C DFES_Cls.DFC_MoFRailP_C DFES_Cls.DFC_MoFTrqCmp_C DFES_Cls.DFC_NSCDsHtrSetP_C DFES_Cls.DFC_NoCat2DsHtrSetP_C DFES_Cls.DFC_PCVActrTst_C DFES_Cls.DFC_PhyModNonMonMapNpl_C DFES_Cls.DFC_RailHpTst_C DFES_Cls.DFC_RailPOfsTstMax_C DFES_Cls.DFC_RailPOfsTstMin_C DFES_Cls.DFC_SIA_E1max_C DFES_Cls.DFC_SIA_E1min_C DFES_Cls.DFC_SIA_E1npl_C DFES_Cls.DFC_SIA_E1sig_C DFES_Cls.DFC_SIA_E2max_C DFES_Cls.DFC_SIA_E2min_C DFES_Cls.DFC_SIA_E2npl_C DFES_Cls.DFC_SIA_E2sig_C DFES_Cls.DFC_SIA_E3max_C DFES_Cls.DFC_SIA_E3min_C DFES_Cls.DFC_SIA_E3npl_C DFES_Cls.DFC_SIA_E3sig_C DFES_Cls.DFC_SIA_E4max_C DFES_Cls.DFC_SIA_E4min_C DFES_Cls.DFC_SIA_E4npl_C DFES_Cls.DFC_SIA_E4sig_C DFES_Cls.DFC_SWReset_0_C DFES_Cls.DFC_SWReset_1_C DFES_Cls.DFC_SWReset_2_C DFES_Cls.DFC_ShtrAKKMax_C DFES_Cls.DFC_ShtrAKKMin_C DFES_Cls.DFC_ShtrAKKNpl_C DFES_Cls.DFC_ShtrPKKMax_C DFES_Cls.DFC_StopCntTmr_C DFES_Cls.DFC_ThrVlvMon_C DFES_Cls.DFC_VSwVlvJamVlv_C DFES_Cls.DFC_VSwVlvLgTDrft_C DFES_Cls.DFC_VSwVlvOfsLrnJamVlv_C DFES_Cls.DFC_VSwVlvOfsNeutr_C DFES_Cls.DFC_VSwVlvShTDrft_C DFES_Cls.DFC_VSwVlvSpgDef_C DFES_DbLv.DFC_Unused_C DFES_DbLv.DFC_ACCIPlausDrvAst_C DFES_DbLv.DFC_ACCIPlausTrqDes_C DFES_DbLv.DFC_AirCtlGovDvtEOMMax_C DFES_DbLv.DFC_AirCtlGovDvtEOMMin_C DFES_DbLv.DFC_AirCtlGovDvtMax_C DFES_DbLv.DFC_AirCtlGovDvtMin_C DFES_DbLv.DFC_AirCtlGovLPDvtMax_C DFES_DbLv.DFC_AirCtlGovLPDvtMin_C DFES_DbLv.DFC_AltIOComErr_C DFES_DbLv.DFC_AltIOComNpl_C DFES_DbLv.DFC_BusDiagBusOffFlexRay_C DFES_DbLv.DFC_BusDiagBusOffNodeA_C DFES_DbLv.DFC_BusDiagBusOffNodeB_C DFES_DbLv.DFC_BusDiagBusOffNodeC_C DFES_DbLv.DFC_BusDiagHwFlexRay_C DFES_DbLv.DFC_Cj945SpiCom1_C DFES_DbLv.DFC_ComACDemandSig_FA_C DFES_DbLv.DFC_ComACDemandTo_FA_C DFES_DbLv.DFC_ComATempSig_FA_C DFES_DbLv.DFC_ComATempTo_FA_C DFES_DbLv.DFC_ComATempTo_FX_C DFES_DbLv.DFC_ComBrkTrqSumChk_FX_C DFES_DbLv.DFC_ComBrkTrqSumCtr_FX_C DFES_DbLv.DFC_ComBrkTrqSumTo_FX_C DFES_DbLv.DFC_ComBtnDrvDynChk_FX_C DFES_DbLv.DFC_ComBtnDrvDynCtr_FX_C DFES_DbLv.DFC_ComBtnDrvDynTo_FX_C DFES_DbLv.DFC_ComButtonMSASig_C DFES_DbLv.DFC_ComButtonMSATo_C DFES_DbLv.DFC_ComCodierungPwrmngSig_C DFES_DbLv.DFC_ComCodierungPwrmngSig_FA_C DFES_DbLv.DFC_ComCrCtlLvrChk_C DFES_DbLv.DFC_ComCrCtlLvrCtr_C DFES_DbLv.DFC_ComCrCtlLvrSig_C DFES_DbLv.DFC_ComCrCtlLvrTo_C DFES_DbLv.DFC_ComCtrCrshSwoEkpSig_FA_C DFES_DbLv.DFC_ComCtrCrshSwoEkpTo_FA_C DFES_DbLv.DFC_ComCtrSecInt_C DFES_DbLv.DFC_ComDiaOBDGbxSig_A_C DFES_DbLv.DFC_ComDiaOBDGbxTo_A_C DFES_DbLv.DFC_ComFahrzeugtypSig_C DFES_DbLv.DFC_ComFahrzeugtypSig_FA_C DFES_DbLv.DFC_ComFllupGpwsupSig_FA_C DFES_DbLv.DFC_ComFllupGpwsupTo_FA_C DFES_DbLv.DFC_ComGbxDataChk_A_C DFES_DbLv.DFC_ComGbxDataChk_FA_C DFES_DbLv.DFC_ComGbxDataCtr_A_C DFES_DbLv.DFC_ComGbxDataCtr_FA_C DFES_DbLv.DFC_ComGbxDataSig_A_C DFES_DbLv.DFC_ComGbxDataSig_FA_C DFES_DbLv.DFC_ComGbxDataTo_A_C DFES_DbLv.DFC_ComGbxDataTo_FA_C DFES_DbLv.DFC_ComKlemmenChk_FA_C DFES_DbLv.DFC_ComKlemmenCtr_FA_C DFES_DbLv.DFC_ComKlemmenSig_FA_C DFES_DbLv.DFC_ComKlemmenTo_FA_C DFES_DbLv.DFC_ComLenkradwinkelSig_C DFES_DbLv.DFC_ComLenkradwinkelTo_C DFES_DbLv.DFC_ComMileageRangeSig_FA_C DFES_DbLv.DFC_ComMileageRangeTo_FA_C DFES_DbLv.DFC_ComPspSig_C DFES_DbLv.DFC_ComPspTo_C DFES_DbLv.DFC_ComRelTimeSig_FA_C DFES_DbLv.DFC_ComRelTimeTo_FA_C DFES_DbLv.DFC_ComRequestEMFChk_C DFES_DbLv.DFC_ComRequestEMFCtr_C DFES_DbLv.DFC_ComRequestEMFSig_C DFES_DbLv.DFC_ComRequestEMFTo_C DFES_DbLv.DFC_ComRpmWhlChk_FX_C DFES_DbLv.DFC_ComRpmWhlCtr_FX_C /end DEF_CHARACTERISTIC
/end FUNCTION
/begin COMPU_METHOD DFES_OneToOne "" RAT_FUNC "%6.0" "-" COEFFS 0 1 0 0 0 1 /end COMPU_METHOD
/begin RECORD_LAYOUT Val_Wu8 FNC_VALUES 1 UBYTE COLUMN_DIR DIRECT /end RECORD_LAYOUT
/end MODULE
/end PROJECT

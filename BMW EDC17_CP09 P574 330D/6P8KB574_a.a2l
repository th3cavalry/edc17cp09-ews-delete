ASAP2_VERSION 1 4
/begin PROJECT P_574 "EDC17_CP09"
/begin HEADER "" VERSION "V8KB" PROJECT_NO P_574 /end HEADER
/begin MODULE DIM ""
/begin MOD_COMMON "" BYTE_ORDER MSB_LAST ALIGNMENT_BYTE 1 ALIGNMENT_WORD 2 ALIGNMENT_LONG 4 ALIGNMENT_FLOAT32_IEEE 4 /end MOD_COMMON
/begin CHARACTERISTIC DFES_Severity.DFC_GbxNPosPlaus_C "DFES/" VALUE 0x8002B510 Val_Wu8 255.0 OneToOne 0.00 255.0 /end CHARACTERISTIC
/begin CHARACTERISTIC DFES_Severity.DFC_I14229_ROETst_Appl_C "DFES/" VALUE 0x8002B511 Val_Wu8 255.0 OneToOne 0.00 255.0 /end CHARACTERISTIC
/begin CHARACTERISTIC DFES_Severity.DFC_I14229_ROETst_Netw_C "DFES/" VALUE 0x8002B512 Val_Wu8 255.0 OneToOne 0.00 255.0 /end CHARACTERISTIC
/begin CHARACTERISTIC DFES_Severity.DFC_I14229_ROE_BufFull_C "DFES/" VALUE 0x8002B513 Val_Wu8 255.0 OneToOne 0.00 255.0 /end CHARACTERISTIC
/begin CHARACTERISTIC DFES_Severity.DFC_IVAdjDiaIVAdj_C "DFES/Projektspezifische Applikationdaten (pro DSM Element) DFC_IVAdjDiaIVAdj" VALUE 0x8002B514 Val_Wu8 255.0 OneToOne 0.00 255.0 /end CHARACTERISTIC
/begin CHARACTERISTIC DFES_Severity.DFC_IVAdjIVA_0_C "DFES/Projektspezifische Applikationdaten (pro DSM Element) DFC_IVAdjIVA_0" VALUE 0x8002B515 Val_Wu8 255.0 OneToOne 0.00 255.0 /end CHARACTERISTIC
/begin CHARACTERISTIC DFES_Severity.DFC_IVAdjIVA_1_C "DFES/Projektspezifische Applikationdaten (pro DSM Element) DFC_IVAdjIVA_1" VALUE 0x8002B516 Val_Wu8 255.0 OneToOne 0.00 255.0 /end CHARACTERISTIC
/begin CHARACTERISTIC DFES_Severity.DFC_IVAdjIVA_2_C "DFES/Projektspezifische Applikationdaten (pro DSM Element) DFC_IVAdjIVA_2" VALUE 0x8002B517 Val_Wu8 255.0 OneToOne 0.00 255.0 /end CHARACTERISTIC
/begin CHARACTERISTIC DFES_Severity.DFC_IVAdjIVA_3_C "DFES/Projektspezifische Applikationdaten (pro DSM Element) DFC_IVAdjIVA_3" VALUE 0x8002B518 Val_Wu8 255.0 OneToOne 0.00 255.0 /end CHARACTERISTIC
/begin CHARACTERISTIC DFES_Severity.DFC_IVAdjIVA_4_C "DFES/Projektspezifische Applikationdaten (pro DSM Element) DFC_IVAdjIVA_4" VALUE 0x8002B519 Val_Wu8 255.0 OneToOne 0.00 255.0 /end CHARACTERISTIC
/begin CHARACTERISTIC DFES_Severity.DFC_IVAdjIVA_5_C "DFES/Projektspezifische Applikationdaten (pro DSM Element) DFC_IVAdjIVA_5" VALUE 0x8002B51A Val_Wu8 255.0 OneToOne 0.00 255.0 /end CHARACTERISTIC
/begin CHARACTERISTIC DFES_Severity.DFC_IVPSplyDCDCOff_0_C "DFES/Projektspezifische Applikationdaten (pro DSM Element) DFC_IVPSplyDCDCOff_0" VALUE 0x8002B51B Val_Wu8 255.0 OneToOne 0.00 255.0 /end CHARACTERISTIC
/begin CHARACTERISTIC DFES_Severity.DFC_IVPSplyDCDCOff_1_C "DFES/Projektspezifische Applikationdaten (pro DSM Element) DFC_IVPSplyDCDCOff_1" VALUE 0x8002B51C Val_Wu8 255.0 OneToOne 0.00 255.0 /end CHARACTERISTIC
/begin CHARACTERISTIC DFES_Severity.DFC_IVPSplyDCDCOff_2_C "DFES/Projektspezifische Applikationdaten (pro DSM Element) DFC_IVPSplyDCDCOff_2" VALUE 0x8002B51D Val_Wu8 255.0 OneToOne 0.00 255.0 /end CHARACTERISTIC
/begin CHARACTERISTIC DFES_Severity.DFC_IVPSplyDCDCOff_3_C "DFES/Projektspezifische Applikationdaten (pro DSM Element) DFC_IVPSplyDCDCOff_3" VALUE 0x8002B51E Val_Wu8 255.0 OneToOne 0.00 255.0 /end CHARACTERISTIC
/begin CHARACTERISTIC DFES_Severity.DFC_InjCtlAdjQntEEPCS_C "DFES/Projektspezifische Applikationdaten (pro DSM Element) DFC_InjCtlAdjQntEEPCS" VALUE 0x8002B51F Val_Wu8 255.0 OneToOne 0.00 255.0 /end CHARACTERISTIC
/begin CHARACTERISTIC DFES_Severity.DFC_LSUSPISig_C "DFES/Projektspezifische Applikationdaten (pro DSM Element) DFC_LSUSPISig" VALUE 0x8002B520 Val_Wu8 255.0 OneToOne 0.00 255.0 /end CHARACTERISTIC
/begin CHARACTERISTIC DFES_Severity.DFC_Layer_Dummy_C "DFES/Projektspezifische Applikationdaten (pro DSM Element) DFC_Layer_Dummy" VALUE 0x8002B521 Val_Wu8 255.0 OneToOne 0.00 255.0 /end CHARACTERISTIC
/begin CHARACTERISTIC DFES_Severity.DFC_NplEnvPSensPPFltDiff_C "DFES/Projektspezifische Applikationdaten (pro DSM Element) DFC_NplEnvPSensPPFltDiff" VALUE 0x8002B522 Val_Wu8 255.0 OneToOne 0.00 255.0 /end CHARACTERISTIC
/begin CHARACTERISTIC DFES_Severity.DFC_NplPresSensPPFltDiff_C "DFES/Projektspezifische Applikationdaten (pro DSM Element) DFC_NplPresSensPPFltDiff" VALUE 0x8002B523 Val_Wu8 255.0 OneToOne 0.00 255.0 /end CHARACTERISTIC
/begin CHARACTERISTIC DFES_Severity.DFC_OilLvlPlaus_C "DFES/Projektspezifische Applikationdaten (pro DSM Element) DFC_OilLvlPlaus" VALUE 0x8002B524 Val_Wu8 255.0 OneToOne 0.00 255.0 /end CHARACTERISTIC
/begin CHARACTERISTIC DFES_Severity.DFC_OilTOutLvl_C "DFES/Projektspezifische Applikationdaten (pro DSM Element) DFC_OilTOutLvl" VALUE 0x8002B525 Val_Wu8 255.0 OneToOne 0.00 255.0 /end CHARACTERISTIC
/begin CHARACTERISTIC DFES_Severity.DFC_PCVfacAdaptMax_C "DFES/Projektspezifische Applikationdaten (pro DSM Element) DFC_PCVfacAdaptMax" VALUE 0x8002B526 Val_Wu8 255.0 OneToOne 0.00 255.0 /end CHARACTERISTIC
/begin CHARACTERISTIC DFES_Severity.DFC_PCVfacAdaptMin_C "DFES/Projektspezifische Applikationdaten (pro DSM Element) DFC_PCVfacAdaptMin" VALUE 0x8002B527 Val_Wu8 255.0 OneToOne 0.00 255.0 /end CHARACTERISTIC
/begin CHARACTERISTIC DFES_Severity.DFC_SensFrzPPFltUs_C "DFES/Projektspezifische Applikationdaten (pro DSM Element) DFC_SensFrzPPFltUs" VALUE 0x8002B528 Val_Wu8 255.0 OneToOne 0.00 255.0 /end CHARACTERISTIC
/begin CHARACTERISTIC DFES_Severity.DFC_SensMonUTnkLvl_C "DFES/" VALUE 0x8002B529 Val_Wu8 255.0 OneToOne 0.00 255.0 /end CHARACTERISTIC
/begin CHARACTERISTIC DFES_Severity.DFC_T15Sig_C "DFES/Projektspezifische Applikationdaten (pro DSM Element) DFC_T15Sig" VALUE 0x8002B52A Val_Wu8 255.0 OneToOne 0.00 255.0 /end CHARACTERISTIC
/begin CHARACTERISTIC DFES_Severity.DFC_AirCtlRmpTOut_C "DFES/Projektspezifische Applikationdaten (pro DSM Element) DFC_AirCtlRmpTOut" VALUE 0x8002B52B Val_Wu8 255.0 OneToOne 0.00 255.0 /end CHARACTERISTIC
/begin CHARACTERISTIC DFES_Severity.DFC_BrkPPlaus_C "DFES/" VALUE 0x8002B52C Val_Wu8 255.0 OneToOne 0.00 255.0 /end CHARACTERISTIC
/begin CHARACTERISTIC DFES_Severity.DFC_CEngDsTDynTst_C "DFES/Projektspezifische Applikationdaten (pro DSM Element) DFC_CEngDsTDynTst" VALUE 0x8002B52D Val_Wu8 255.0 OneToOne 0.00 255.0 /end CHARACTERISTIC
/begin CHARACTERISTIC DFES_Severity.DFC_EEPEraseErr_C "DFES/Projektspezifische Applikationdaten (pro DSM Element) DFC_EEPEraseErr" VALUE 0x8002B52E Val_Wu8 255.0 OneToOne 0.00 255.0 /end CHARACTERISTIC
/begin CHARACTERISTIC DFES_Severity.DFC_EEPRdErr_C "DFES/Projektspezifische Applikationdaten (pro DSM Element) DFC_EEPRdErr" VALUE 0x8002B52F Val_Wu8 255.0 OneToOne 0.00 255.0 /end CHARACTERISTIC
/begin CHARACTERISTIC DFES_Severity.DFC_EEPWrErr_C "DFES/Projektspezifische Applikationdaten (pro DSM Element) DFC_EEPWrErr" VALUE 0x8002B530 Val_Wu8 255.0 OneToOne 0.00 255.0 /end CHARACTERISTIC
/begin CHARACTERISTIC DFES_Severity.DFC_EGRVlvJamVlvClsd_C "DFES/Projektspezifische Applikationdaten (pro DSM Element) DFC_EGRVlvJamVlvClsd" VALUE 0x8002B531 Val_Wu8 255.0 OneToOne 0.00 255.0 /end CHARACTERISTIC
/begin CHARACTERISTIC DFES_Severity.DFC_EGRVlvJamVlvOpn_C "DFES/Projektspezifische Applikationdaten (pro DSM Element) DFC_EGRVlvJamVlvOpn" VALUE 0x8002B532 Val_Wu8 255.0 OneToOne 0.00 255.0 /end CHARACTERISTIC
/begin CHARACTERISTIC DFES_Severity.DFC_EGRVlvLPJamVlvClsd_C "DFES/" VALUE 0x8002B533 Val_Wu8 255.0 OneToOne 0.00 255.0 /end CHARACTERISTIC
/begin CHARACTERISTIC DFES_Severity.DFC_EGRVlvLPJamVlvOpn_C "DFES/" VALUE 0x8002B534 Val_Wu8 255.0 OneToOne 0.00 255.0 /end CHARACTERISTIC
/begin CHARACTERISTIC DFES_Severity.DFC_EGRVlvLPLgTDrft_C "DFES/" VALUE 0x8002B535 Val_Wu8 255.0 OneToOne 0.00 255.0 /end CHARACTERISTIC
/begin CHARACTERISTIC DFES_Severity.DFC_EGRVlvLPOfsLrnJamVlv_C "DFES/" VALUE 0x8002B536 Val_Wu8 255.0 OneToOne 0.00 255.0 /end CHARACTERISTIC
/begin CHARACTERISTIC DFES_Severity.DFC_EGRVlvLPShTDrft_C "DFES/" VALUE 0x8002B537 Val_Wu8 255.0 OneToOne 0.00 255.0 /end CHARACTERISTIC
/begin CHARACTERISTIC DFES_Severity.DFC_EGRVlvLgTDrft_C "DFES/Projektspezifische Applikationdaten (pro DSM Element) DFC_EGRVlvLgTDrft" VALUE 0x8002B538 Val_Wu8 255.0 OneToOne 0.00 255.0 /end CHARACTERISTIC
/begin CHARACTERISTIC DFES_Severity.DFC_EGRVlvOfsLrnJamVlv_C "DFES/Projektspezifische Applikationdaten (pro DSM Element) DFC_EGRVlvOfsLrnJamVlv" VALUE 0x8002B539 Val_Wu8 255.0 OneToOne 0.00 255.0 /end CHARACTERISTIC
/begin CHARACTERISTIC DFES_Severity.DFC_EGRVlvShTDrft_C "DFES/Projektspezifische Applikationdaten (pro DSM Element) DFC_EGRVlvShTDrft" VALUE 0x8002B53A Val_Wu8 255.0 OneToOne 0.00 255.0 /end CHARACTERISTIC
/begin CHARACTERISTIC DFES_Severity.DFC_EngICO_C "DFES/Projektspezifische Applikationdaten (pro DSM Element) DFC_EngICO" VALUE 0x8002B53B Val_Wu8 255.0 OneToOne 0.00 255.0 /end CHARACTERISTIC
/begin CHARACTERISTIC DFES_Severity.DFC_EpmCaSI1ErrSig_C "DFES/Projektspezifische Applikationdaten (pro DSM Element) DFC_EpmCaSI1ErrSig" VALUE 0x8002B53C Val_Wu8 255.0 OneToOne 0.00 255.0 /end CHARACTERISTIC
/begin CHARACTERISTIC DFES_Severity.DFC_EpmCaSI1NoSig_C "DFES/Projektspezifische Applikationdaten (pro DSM Element) DFC_EpmCaSI1NoSig" VALUE 0x8002B53D Val_Wu8 255.0 OneToOne 0.00 255.0 /end CHARACTERISTIC
/begin CHARACTERISTIC DFES_Severity.DFC_EpmCaSI1OfsErr_C "DFES/Projektspezifische Applikationdaten (pro DSM Element) DFC_EpmCaSI1OfsErr" VALUE 0x8002B53E Val_Wu8 255.0 OneToOne 0.00 255.0 /end CHARACTERISTIC
/begin CHARACTERISTIC DFES_Severity.DFC_EpmCrSErrSig_C "DFES/Projektspezifische Applikationdaten (pro DSM Element) DFC_EpmCrSErrSig" VALUE 0x8002B53F Val_Wu8 255.0 OneToOne 0.00 255.0 /end CHARACTERISTIC
/begin CHARACTERISTIC DFES_Severity.DFC_EpmCrSNoSig_C "DFES/Projektspezifische Applikationdaten (pro DSM Element) DFC_EpmCrSNoSig" VALUE 0x8002B540 Val_Wu8 255.0 OneToOne 0.00 255.0 /end CHARACTERISTIC
/begin CHARACTERISTIC DFES_Severity.DFC_IVPlausComprTst_C "DFES/Projektspezifische Applikationdaten (pro DSM Element) DFC_IVPlausComprTst" VALUE 0x8002B541 Val_Wu8 255.0 OneToOne 0.00 255.0 /end CHARACTERISTIC
/begin CHARACTERISTIC DFES_Severity.DFC_IVPlausRunUpTst_C "DFES/Projektspezifische Applikationdaten (pro DSM Element) DFC_IVPlausRunUpTst" VALUE 0x8002B542 Val_Wu8 255.0 OneToOne 0.00 255.0 /end CHARACTERISTIC
/begin CHARACTERISTIC DFES_Severity.DFC_InjCrvShOffTst_C "DFES/Projektspezifische Applikationdaten (pro DSM Element) DFC_InjCrvShOffTst" VALUE 0x8002B543 Val_Wu8 255.0 OneToOne 0.00 255.0 /end CHARACTERISTIC
/begin CHARACTERISTIC DFES_Severity.DFC_LayerEnSavModProd_C "DFES/Projektspezifische Applikationdaten (pro DSM Element) DFC_LayerEnSavModProd" VALUE 0x8002B544 Val_Wu8 255.0 OneToOne 0.00 255.0 /end CHARACTERISTIC
/begin CHARACTERISTIC DFES_Severity.DFC_LayerEnSavModRep_C "DFES/Projektspezifische Applikationdaten (pro DSM Element) DFC_LayerEnSavModRep" VALUE 0x8002B545 Val_Wu8 255.0 OneToOne 0.00 255.0 /end CHARACTERISTIC
/begin CHARACTERISTIC DFES_Severity.DFC_LayerEnSavModShip_C "DFES/Projektspezifische Applikationdaten (pro DSM Element) DFC_LayerEnSavModShip" VALUE 0x8002B546 Val_Wu8 255.0 OneToOne 0.00 255.0 /end CHARACTERISTIC
/begin CHARACTERISTIC DFES_Severity.DFC_MRlyErlyOpng_C "DFES/Projektspezifische Applikationdaten (pro DSM Element) DFC_MRlyErlyOpng" VALUE 0x8002B547 Val_Wu8 255.0 OneToOne 0.00 255.0 /end CHARACTERISTIC
/begin CHARACTERISTIC DFES_Severity.DFC_MRlyStk_C "DFES/Projektspezifische Applikationdaten (pro DSM Element) DFC_MRlyStk" VALUE 0x8002B548 Val_Wu8 255.0 OneToOne 0.00 255.0 /end CHARACTERISTIC
/begin CHARACTERISTIC DFES_Severity.DFC_MeUnActrTst_C "DFES/Projektspezifische Applikationdaten (pro DSM Element) DFC_MeUnActrTst" VALUE 0x8002B549 Val_Wu8 255.0 OneToOne 0.00 255.0 /end CHARACTERISTIC
/begin CHARACTERISTIC DFES_Severity.DFC_MoCADCCmp_C "DFES/Projektspezifische Applikationdaten (pro DSM Element) DFC_MoCADCCmp" VALUE 0x8002B54A Val_Wu8 255.0 OneToOne 0.00 255.0 /end CHARACTERISTIC
/begin CHARACTERISTIC DFES_Severity.DFC_MoCADCTst_C "DFES/Projektspezifische Applikationdaten (pro DSM Element) DFC_MoCADCTst" VALUE 0x8002B54B Val_Wu8 255.0 OneToOne 0.00 255.0 /end CHARACTERISTIC
/begin CHARACTERISTIC DFES_Severity.DFC_MoCADCVltgRatio_C "DFES/Projektspezifische Applikationdaten (pro DSM Element) DFC_MoCADCVltgRatio" VALUE 0x8002B54C Val_Wu8 255.0 OneToOne 0.00 255.0 /end CHARACTERISTIC
/begin CHARACTERISTIC DFES_Severity.DFC_MoCComErrCnt_C "DFES/Projektspezifische Applikationdaten (pro DSM Element) DFC_MoCComErrCnt" VALUE 0x8002B54D Val_Wu8 255.0 OneToOne 0.00 255.0 /end CHARACTERISTIC
/begin CHARACTERISTIC DFES_Severity.DFC_MoCComSPI_C "DFES/Projektspezifische Applikationdaten (pro DSM Element) DFC_MoCComSPI" VALUE 0x8002B54E Val_Wu8 255.0 OneToOne 0.00 255.0 /end CHARACTERISTIC
/begin CHARACTERISTIC DFES_Severity.DFC_MoCROMErrXPg_C "DFES/Projektspezifische Applikationdaten (pro DSM Element) DFC_MoCROMErrXPg" VALUE 0x8002B54F Val_Wu8 255.0 OneToOne 0.00 255.0 /end CHARACTERISTIC
/begin CHARACTERISTIC DFES_Severity.DFC_MoCSOPHwNoRdy_C "DFES/Projektspezifische Applikationdaten (pro DSM Element) DFC_MoCSOPHwNoRdy" VALUE 0x8002B550 Val_Wu8 255.0 OneToOne 0.00 255.0 /end CHARACTERISTIC
/begin CHARACTERISTIC DFES_Severity.DFC_MoCSOPLoLi_C "DFES/Projektspezifische Applikationdaten (pro DSM Element) DFC_MoCSOPLoLi" VALUE 0x8002B551 Val_Wu8 255.0 OneToOne 0.00 255.0 /end CHARACTERISTIC
/begin CHARACTERISTIC DFES_Severity.DFC_MoCSOPMM_C "DFES/Projektspezifische Applikationdaten (pro DSM Element) DFC_MoCSOPMM" VALUE 0x8002B552 Val_Wu8 255.0 OneToOne 0.00 255.0 /end CHARACTERISTIC
/begin CHARACTERISTIC DFES_Severity.DFC_MoCSOPTimeOut_C "DFES/Projektspezifische Applikationdaten (pro DSM Element) DFC_MoCSOPTimeOut" VALUE 0x8002B553 Val_Wu8 255.0 OneToOne 0.00 255.0 /end CHARACTERISTIC
/begin CHARACTERISTIC DFES_Severity.DFC_MoCSOPUpLi_C "DFES/Projektspezifische Applikationdaten (pro DSM Element) DFC_MoCSOPUpLi" VALUE 0x8002B554 Val_Wu8 255.0 OneToOne 0.00 255.0 /end CHARACTERISTIC
/begin CHARACTERISTIC DFES_Severity.DFC_MoFAPP_C "DFES/Projektspezifische Applikationdaten (pro DSM Element) DFC_MoFAPP" VALUE 0x8002B555 Val_Wu8 255.0 OneToOne 0.00 255.0 /end CHARACTERISTIC
/begin CHARACTERISTIC DFES_Severity.DFC_MoFESpd_C "DFES/Projektspezifische Applikationdaten (pro DSM Element) DFC_MoFESpd" VALUE 0x8002B556 Val_Wu8 255.0 OneToOne 0.00 255.0 /end CHARACTERISTIC
/begin CHARACTERISTIC DFES_Severity.DFC_MoFInjDatPhi_C "DFES/Projektspezifische Applikationdaten (pro DSM Element) DFC_MoFInjDatPhi" VALUE 0x8002B557 Val_Wu8 255.0 OneToOne 0.00 255.0 /end CHARACTERISTIC
/begin CHARACTERISTIC DFES_Severity.DFC_MoFInjDatQnt_C "DFES/Projektspezifische Applikationdaten (pro DSM Element) DFC_MoFInjDatQnt" VALUE 0x8002B558 Val_Wu8 255.0 OneToOne 0.00 255.0 /end CHARACTERISTIC
/begin CHARACTERISTIC DFES_Severity.DFC_MoFInjQnt_C "DFES/Projektspezifische Applikationdaten (pro DSM Element) DFC_MoFInjQnt" VALUE 0x8002B559 Val_Wu8 255.0 OneToOne 0.00 255.0 /end CHARACTERISTIC
/begin CHARACTERISTIC DFES_Severity.DFC_MoFMode1PoI1_C "DFES/Projektspezifische Applikationdaten (pro DSM Element) DFC_MoFMode1PoI1" VALUE 0x8002B55A Val_Wu8 255.0 OneToOne 0.00 255.0 /end CHARACTERISTIC
/begin CHARACTERISTIC DFES_Severity.DFC_MoFMode1PoI2_C "DFES/Projektspezifische Applikationdaten (pro DSM Element) DFC_MoFMode1PoI2" VALUE 0x8002B55B Val_Wu8 255.0 OneToOne 0.00 255.0 /end CHARACTERISTIC
/begin CHARACTERISTIC DFES_Severity.DFC_MoFMode2PoI1_C "DFES/Projektspezifische Applikationdaten (pro DSM Element) DFC_MoFMode2PoI1" VALUE 0x8002B55C Val_Wu8 255.0 OneToOne 0.00 255.0 /end CHARACTERISTIC
/begin CHARACTERISTIC DFES_Severity.DFC_MoFMode2PoI2_C "DFES/Projektspezifische Applikationdaten (pro DSM Element) DFC_MoFMode2PoI2" VALUE 0x8002B55D Val_Wu8 255.0 OneToOne 0.00 255.0 /end CHARACTERISTIC
/begin CHARACTERISTIC DFES_Severity.DFC_MoFOvR_C "DFES/Projektspezifische Applikationdaten (pro DSM Element) DFC_MoFOvR" VALUE 0x8002B55E Val_Wu8 255.0 OneToOne 0.00 255.0 /end CHARACTERISTIC
/begin CHARACTERISTIC DFES_Severity.DFC_MoFQntCor_C "DFES/Projektspezifische Applikationdaten (pro DSM Element) DFC_MoFQntCor" VALUE 0x8002B55F Val_Wu8 255.0 OneToOne 0.00 255.0 /end CHARACTERISTIC
/begin CHARACTERISTIC DFES_Severity.DFC_MoFRailP_C "DFES/Projektspezifische Applikationdaten (pro DSM Element) DFC_MoFRailP" VALUE 0x8002B560 Val_Wu8 255.0 OneToOne 0.00 255.0 /end CHARACTERISTIC
/begin CHARACTERISTIC DFES_Severity.DFC_MoFTrqCmp_C "DFES/Projektspezifische Applikationdaten (pro DSM Element) DFC_MoFTrqCmp" VALUE 0x8002B561 Val_Wu8 255.0 OneToOne 0.00 255.0 /end CHARACTERISTIC
/begin CHARACTERISTIC DFES_Severity.DFC_NSCDsHtrSetP_C "DFES/" VALUE 0x8002B562 Val_Wu8 255.0 OneToOne 0.00 255.0 /end CHARACTERISTIC
/begin CHARACTERISTIC DFES_Severity.DFC_NoCat2DsHtrSetP_C "DFES/" VALUE 0x8002B563 Val_Wu8 255.0 OneToOne 0.00 255.0 /end CHARACTERISTIC
/begin CHARACTERISTIC DFES_Severity.DFC_PCVActrTst_C "DFES/Projektspezifische Applikationdaten (pro DSM Element) DFC_PCVActrTst" VALUE 0x8002B564 Val_Wu8 255.0 OneToOne 0.00 255.0 /end CHARACTERISTIC
/begin CHARACTERISTIC DFES_Severity.DFC_PhyModNonMonMapNpl_C "DFES/Projektspezifische Applikationdaten (pro DSM Element) DFC_PhyModNonMonMapNpl" VALUE 0x8002B565 Val_Wu8 255.0 OneToOne 0.00 255.0 /end CHARACTERISTIC
/begin CHARACTERISTIC DFES_Severity.DFC_RailHpTst_C "DFES/Projektspezifische Applikationdaten (pro DSM Element) DFC_RailHpTst" VALUE 0x8002B566 Val_Wu8 255.0 OneToOne 0.00 255.0 /end CHARACTERISTIC
/begin CHARACTERISTIC DFES_Severity.DFC_RailPOfsTstMax_C "DFES/Projektspezifische Applikationdaten (pro DSM Element) DFC_RailPOfsTstMax" VALUE 0x8002B567 Val_Wu8 255.0 OneToOne 0.00 255.0 /end CHARACTERISTIC
/begin CHARACTERISTIC DFES_Severity.DFC_RailPOfsTstMin_C "DFES/Projektspezifische Applikationdaten (pro DSM Element) DFC_RailPOfsTstMin" VALUE 0x8002B568 Val_Wu8 255.0 OneToOne 0.00 255.0 /end CHARACTERISTIC
/begin CHARACTERISTIC DFES_Severity.DFC_SIA_E1max_C "DFES/Projektspezifische Applikationdaten (pro DSM Element) DFC_SIA_E1max" VALUE 0x8002B569 Val_Wu8 255.0 OneToOne 0.00 255.0 /end CHARACTERISTIC
/begin CHARACTERISTIC DFES_Severity.DFC_SIA_E1min_C "DFES/Projektspezifische Applikationdaten (pro DSM Element) DFC_SIA_E1min" VALUE 0x8002B56A Val_Wu8 255.0 OneToOne 0.00 255.0 /end CHARACTERISTIC
/begin CHARACTERISTIC DFES_Severity.DFC_SIA_E1npl_C "DFES/Projektspezifische Applikationdaten (pro DSM Element) DFC_SIA_E1npl" VALUE 0x8002B56B Val_Wu8 255.0 OneToOne 0.00 255.0 /end CHARACTERISTIC
/begin CHARACTERISTIC DFES_Severity.DFC_SIA_E1sig_C "DFES/Projektspezifische Applikationdaten (pro DSM Element) DFC_SIA_E1sig" VALUE 0x8002B56C Val_Wu8 255.0 OneToOne 0.00 255.0 /end CHARACTERISTIC
/begin CHARACTERISTIC DFES_Severity.DFC_SIA_E2max_C "DFES/Projektspezifische Applikationdaten (pro DSM Element) DFC_SIA_E2max" VALUE 0x8002B56D Val_Wu8 255.0 OneToOne 0.00 255.0 /end CHARACTERISTIC
/begin CHARACTERISTIC DFES_Severity.DFC_SIA_E2min_C "DFES/Projektspezifische Applikationdaten (pro DSM Element) DFC_SIA_E2min" VALUE 0x8002B56E Val_Wu8 255.0 OneToOne 0.00 255.0 /end CHARACTERISTIC
/begin CHARACTERISTIC DFES_Severity.DFC_SIA_E2npl_C "DFES/Projektspezifische Applikationdaten (pro DSM Element) DFC_SIA_E2npl" VALUE 0x8002B56F Val_Wu8 255.0 OneToOne 0.00 255.0 /end CHARACTERISTIC
/begin CHARACTERISTIC DFES_Severity.DFC_SIA_E2sig_C "DFES/Projektspezifische Applikationdaten (pro DSM Element) DFC_SIA_E2sig" VALUE 0x8002B570 Val_Wu8 255.0 OneToOne 0.00 255.0 /end CHARACTERISTIC
/begin CHARACTERISTIC DFES_Severity.DFC_SIA_E3max_C "DFES/Projektspezifische Applikationdaten (pro DSM Element) DFC_SIA_E3max" VALUE 0x8002B571 Val_Wu8 255.0 OneToOne 0.00 255.0 /end CHARACTERISTIC
/begin CHARACTERISTIC DFES_Severity.DFC_SIA_E3min_C "DFES/Projektspezifische Applikationdaten (pro DSM Element) DFC_SIA_E3min" VALUE 0x8002B572 Val_Wu8 255.0 OneToOne 0.00 255.0 /end CHARACTERISTIC
/begin CHARACTERISTIC DFES_Severity.DFC_SIA_E3npl_C "DFES/Projektspezifische Applikationdaten (pro DSM Element) DFC_SIA_E3npl" VALUE 0x8002B573 Val_Wu8 255.0 OneToOne 0.00 255.0 /end CHARACTERISTIC
/begin CHARACTERISTIC DFES_Severity.DFC_SIA_E3sig_C "DFES/Projektspezifische Applikationdaten (pro DSM Element) DFC_SIA_E3sig" VALUE 0x8002B574 Val_Wu8 255.0 OneToOne 0.00 255.0 /end CHARACTERISTIC
/begin CHARACTERISTIC DFES_Severity.DFC_SIA_E4max_C "DFES/Projektspezifische Applikationdaten (pro DSM Element) DFC_SIA_E4max" VALUE 0x8002B575 Val_Wu8 255.0 OneToOne 0.00 255.0 /end CHARACTERISTIC
/begin CHARACTERISTIC DFES_Severity.DFC_SIA_E4min_C "DFES/Projektspezifische Applikationdaten (pro DSM Element) DFC_SIA_E4min" VALUE 0x8002B576 Val_Wu8 255.0 OneToOne 0.00 255.0 /end CHARACTERISTIC
/begin CHARACTERISTIC DFES_Severity.DFC_SIA_E4npl_C "DFES/Projektspezifische Applikationdaten (pro DSM Element) DFC_SIA_E4npl" VALUE 0x8002B577 Val_Wu8 255.0 OneToOne 0.00 255.0 /end CHARACTERISTIC
/begin CHARACTERISTIC DFES_Severity.DFC_SIA_E4sig_C "DFES/Projektspezifische Applikationdaten (pro DSM Element) DFC_SIA_E4sig" VALUE 0x8002B578 Val_Wu8 255.0 OneToOne 0.00 255.0 /end CHARACTERISTIC
/begin CHARACTERISTIC DFES_Severity.DFC_SWReset_0_C "DFES/Projektspezifische Applikationdaten (pro DSM Element) DFC_SWReset_0" VALUE 0x8002B579 Val_Wu8 255.0 OneToOne 0.00 255.0 /end CHARACTERISTIC
/begin CHARACTERISTIC DFES_Severity.DFC_SWReset_1_C "DFES/Projektspezifische Applikationdaten (pro DSM Element) DFC_SWReset_1" VALUE 0x8002B57A Val_Wu8 255.0 OneToOne 0.00 255.0 /end CHARACTERISTIC
/begin CHARACTERISTIC DFES_Severity.DFC_SWReset_2_C "DFES/Projektspezifische Applikationdaten (pro DSM Element) DFC_SWReset_2" VALUE 0x8002B57B Val_Wu8 255.0 OneToOne 0.00 255.0 /end CHARACTERISTIC
/begin CHARACTERISTIC DFES_Severity.DFC_ShtrAKKMax_C "DFES/Projektspezifische Applikationdaten (pro DSM Element) DFC_ShtrAKKMax" VALUE 0x8002B57C Val_Wu8 255.0 OneToOne 0.00 255.0 /end CHARACTERISTIC
/begin CHARACTERISTIC DFES_Severity.DFC_ShtrAKKMin_C "DFES/Projektspezifische Applikationdaten (pro DSM Element) DFC_ShtrAKKMin" VALUE 0x8002B57D Val_Wu8 255.0 OneToOne 0.00 255.0 /end CHARACTERISTIC
/begin CHARACTERISTIC DFES_Severity.DFC_ShtrAKKNpl_C "DFES/Projektspezifische Applikationdaten (pro DSM Element) DFC_ShtrAKKNpl" VALUE 0x8002B57E Val_Wu8 255.0 OneToOne 0.00 255.0 /end CHARACTERISTIC
/begin CHARACTERISTIC DFES_Severity.DFC_ShtrPKKMax_C "DFES/Projektspezifische Applikationdaten (pro DSM Element) DFC_ShtrPKKMax" VALUE 0x8002B57F Val_Wu8 255.0 OneToOne 0.00 255.0 /end CHARACTERISTIC
/begin CHARACTERISTIC DFES_Severity.DFC_StopCntTmr_C "DFES/Projektspezifische Applikationdaten (pro DSM Element) DFC_StopCntTmr" VALUE 0x8002B580 Val_Wu8 255.0 OneToOne 0.00 255.0 /end CHARACTERISTIC
/begin CHARACTERISTIC DFES_Severity.DFC_ThrVlvMon_C "DFES/Projektspezifische Applikationdaten (pro DSM Element) DFC_ThrVlvMon" VALUE 0x8002B581 Val_Wu8 255.0 OneToOne 0.00 255.0 /end CHARACTERISTIC
/begin CHARACTERISTIC DFES_Severity.DFC_VSwVlvJamVlv_C "DFES/Projektspezifische Applikationdaten (pro DSM Element) DFC_VSwVlvJamVlv" VALUE 0x8002B582 Val_Wu8 255.0 OneToOne 0.00 255.0 /end CHARACTERISTIC
/begin CHARACTERISTIC DFES_Severity.DFC_VSwVlvLgTDrft_C "DFES/Projektspezifische Applikationdaten (pro DSM Element) DFC_VSwVlvLgTDrft" VALUE 0x8002B583 Val_Wu8 255.0 OneToOne 0.00 255.0 /end CHARACTERISTIC
/begin CHARACTERISTIC DFES_Severity.DFC_VSwVlvOfsLrnJamVlv_C "DFES/Projektspezifische Applikationdaten (pro DSM Element) DFC_VSwVlvOfsLrnJamVlv" VALUE 0x8002B584 Val_Wu8 255.0 OneToOne 0.00 255.0 /end CHARACTERISTIC
/begin CHARACTERISTIC DFES_Severity.DFC_VSwVlvOfsNeutr_C "DFES/Projektspezifische Applikationdaten (pro DSM Element) DFC_VSwVlvOfsNeutr" VALUE 0x8002B585 Val_Wu8 255.0 OneToOne 0.00 255.0 /end CHARACTERISTIC
/begin CHARACTERISTIC DFES_Severity.DFC_VSwVlvShTDrft_C "DFES/Projektspezifische Applikationdaten (pro DSM Element) DFC_VSwVlvShTDrft" VALUE 0x8002B586 Val_Wu8 255.0 OneToOne 0.00 255.0 /end CHARACTERISTIC
/begin CHARACTERISTIC DFES_Severity.DFC_VSwVlvSpgDef_C "DFES/Projektspezifische Applikationdaten (pro DSM Element) DFC_VSwVlvSpgDef" VALUE 0x8002B587 Val_Wu8 255.0 OneToOne 0.00 255.0 /end CHARACTERISTIC
/begin CHARACTERISTIC DFES_ThresSimCond.t_C "Schwellwert für Similar Condition Erkennung/Kühlmitteltemperatur" VALUE 0x8002390C Val_Wu8 255.0 DFES_tPID05 -40.00 215.0 FORMAT "%5.1" /end CHARACTERISTIC
/begin CHARACTERISTIC DFES_ThresSimCond.r_C "Schwellwert für Similar Condition Erkennung/Last" VALUE 0x8002390D Val_Wu8 100.0 DFES_rPID04 0.00 100.0 FORMAT "%5.1" /end CHARACTERISTIC
/begin CHARACTERISTIC DFES_ThresSimCond.n_C "Schwellwert für Similar Condition Erkennung/Motordrehzahl" VALUE 0x8002390E Val_Wu16 16383.75 DFES_nPID0C 0.00 16383.75 FORMAT "%8.2" /end CHARACTERISTIC
/begin CHARACTERISTIC DFES_xAsgnExtdFrzFrSig_CA "Signalauswahl extended freeze frame" VAL_BLK 0x80023910 ValA_Wu16 702.000000000 Signals_IntSigNumVerb 0.00 702.000000000 FORMAT "%13.9" NUMBER 1 /end CHARACTERISTIC
/begin CHARACTERISTIC DFES_xAsgnFrzFrSig_CA "Signalauswahl freeze frame" VAL_BLK 0x80023912 ValA_Wu16 702.000000000 Signals_IntSigNumVerb 0.00 702.000000000 FORMAT "%13.9" NUMBER 11 /end CHARACTERISTIC
/begin CHARACTERISTIC DFES_xClsDltTrg_CA "Fehlerklassenparameter: Triggertyp OBD Löschzähler DLC" VAL_BLK 0x80023928 ValA_Wu8 6. DSMAUX_DTRGVerb 0.00 6. FORMAT "%2.0" NUMBER 30 /end CHARACTERISTIC
/begin CHARACTERISTIC DFES_xClsFaultTrg_CA "Fehlerklassenparameter: Triggertyp Fehlerzähler FLC" VAL_BLK 0x80023946 ValA_Wu8 6. DSMAUX_DTRGVerb 0.00 6. FORMAT "%2.0" NUMBER 30 /end CHARACTERISTIC
/begin CHARACTERISTIC DFES_xClsFltMIL_CA "Fehlerklassenparameter: MIL Ansteuerung" VAL_BLK 0x80023964 ValA_Wu8 8.00000000000 DFES_LampFlt 0.00 8.00000000000 FORMAT "%13.11" NUMBER 30 /end CHARACTERISTIC
/begin CHARACTERISTIC DFES_xClsFltSVS_CA "Fehlerklassenparameter: SVS-Anzeige Ansteuerung" VAL_BLK 0x80023982 ValA_Wu8 8.00000000000 DFES_LampFlt 0.00 8.00000000000 FORMAT "%13.11" NUMBER 30 /end CHARACTERISTIC
/begin CHARACTERISTIC DFES_xClsHealTrg_CA "Fehlerklassenparameter: Triggertyp Heilungszähler HLC" VAL_BLK 0x800239A0 ValA_Wu8 6. DSMAUX_DTRGVerb 0.00 6. FORMAT "%2.0" NUMBER 30 /end CHARACTERISTIC
/begin CHARACTERISTIC DFES_xClsPndDltTrg_CA "Fehlerklassenparameter: Triggertyp Löschzähler aus Zustand Pending DLC" VAL_BLK 0x800239BE ValA_Wu8 6. DSMAUX_DTRGVerb 0.00 6. FORMAT "%2.0" NUMBER 30 /end CHARACTERISTIC
/begin CHARACTERISTIC DFES_xClsPrio_CA "Fehlerklassenparameter: statische Priorität und Testersichtbarkeit" VAL_BLK 0x800239DC ValA_Wu8 228.000000000 DFES_TstVisAndPrio 4.00000000000 232.000000000 FORMAT "%13.9" NUMBER 30 /end CHARACTERISTIC
/begin CHARACTERISTIC DFES_xClsSvcDltTrg_CA "Fehlerklassenparameter: Triggertyp Löschzähler DLC" VAL_BLK 0x800239FA ValA_Wu8 6. DSMAUX_DTRGVerb 0.00 6. FORMAT "%2.0" NUMBER 30 /end CHARACTERISTIC
/begin CHARACTERISTIC DFES_xClsSVSFaultTrg_CA "Fehlerklassenparameter: Triggertyp SVS-Anzeige Fehlerzähler" VAL_BLK 0x80023A18 ValA_Wu8 6. DSMAUX_DTRGVerb 0.00 6. FORMAT "%2.0" NUMBER 30 /end CHARACTERISTIC
/begin CHARACTERISTIC DFES_xClsSVSHealTrg_CA "Fehlerklassenparameter: Triggertyp SVS-Anzeige Heilungszähler" VAL_BLK 0x80023A36 ValA_Wu8 6. DSMAUX_DTRGVerb 0.00 6. FORMAT "%2.0" NUMBER 30 /end CHARACTERISTIC
/begin CHARACTERISTIC DFES_xStPrio_CA "vom Eintragsstatus abhängiger Offset für die Prioritätbestimmung von Fehlerspeichereinträgen" VAL_BLK 0x80023A54 ValA_Wu8 255.0 OneToOne 0.00 255.0 READ_ONLY NUMBER 16 /end CHARACTERISTIC
/begin CHARACTERISTIC DiaDem_nOfsHiIdlSpd_C "" VALUE 0x80038D18 Val_Ws16 10000.00 EngN 0.00 10000.00 EXTENDED_LIMITS -16384.00 16383.50 /end CHARACTERISTIC
/begin CHARACTERISTIC DiaDem_nOfsLoIdlSpd_C "" VALUE 0x80038D1A Val_Ws16 10000.00 EngN 0.00 10000.00 EXTENDED_LIMITS -16384.00 16383.50 /end CHARACTERISTIC
/begin CHARACTERISTIC DiaDem_SetHiRmp.SlopePos_C "/Positive Rampenschrittweite" VALUE 0x80038D1C Val_Ws32 10000.0000000 RmpEngN 0.00 10000.0000000 FORMAT "%13.7" EXTENDED_LIMITS -16384000.0000 16383999.9924 /end CHARACTERISTIC
/begin CHARACTERISTIC DiaDem_SetHiRmp.SlopeNeg_C "/Negative Rampenschrittweite" VALUE 0x80038D20 Val_Ws32 10000.0000000 RmpEngN 0.00 10000.0000000 FORMAT "%13.7" EXTENDED_LIMITS -16384000.0000 16383999.9924 /end CHARACTERISTIC
/begin CHARACTERISTIC DiaDem_SetLoRmp.SlopePos_C "/Positive Rampenschrittweite" VALUE 0x80038D24 Val_Ws32 10000.0000000 RmpEngN 0.00 10000.0000000 FORMAT "%13.7" EXTENDED_LIMITS -16384000.0000 16383999.9924 /end CHARACTERISTIC
/begin CHARACTERISTIC DiaDem_SetLoRmp.SlopeNeg_C "/Negative Rampenschrittweite" VALUE 0x80038D28 Val_Ws32 10000.0000000 RmpEngN 0.00 10000.0000000 FORMAT "%13.7" EXTENDED_LIMITS -16384000.0000 16383999.9924 /end CHARACTERISTIC
/begin CHARACTERISTIC Diag_stOBDPtcol_C "Auswahl OBD Protokoll" VALUE 0x80038D2C Val_Wu8 3.00000000000 Diag_OBDPtcol_Val 0.00 3.00000000000 FORMAT "%13.11" /end CHARACTERISTIC
/begin CHARACTERISTIC Diff_rTrqDfftl_C "Ersatzwert für Differentialübersetzung" VALUE 0x80038D2E Kw_Ws16 655.3500 TransR -327.6800 327.6700 /end CHARACTERISTIC
/begin CHARACTERISTIC K_GENMSKKL61 "Hier könnte Ihr Langbezeichner stehen" VALUE 0x80063A54 Val_Wu16 65535. Def_st_uw_q1 0.00 65535. FORMAT "%5.0" /end CHARACTERISTIC
/begin CHARACTERISTIC K_GENPDTIME "Predrivetime für Ladekontrollampe KL61" VALUE 0x80063A56 Val_Wu16 6553.5 Def_td_uw_q0p1 0.00 6553.5 FORMAT "%6.1" /end CHARACTERISTIC
/begin CHARACTERISTIC K_GENREGVPLAUS "Hier könnte Ihr Langbezeichner stehen" VALUE 0x80063A58 Val_Wu8 255. Def_st_ub_q1 0.00 255. FORMAT "%3.0" /end CHARACTERISTIC
/begin CHARACTERISTIC K_GENSTATX "Hier könnte Ihr Langbezeichner stehen" VALUE 0x80063A59 Val_Wu8 29. Def_st_ub_q1 1.0 30. FORMAT "%3.0" EXTENDED_LIMITS 0.00 255. /end CHARACTERISTIC
/begin CHARACTERISTIC K_GENSTATY "Hier könnte Ihr Langbezeichner stehen" VALUE 0x80063A5A Val_Wu8 29. Def_st_ub_q1 1.0 30. FORMAT "%3.0" EXTENDED_LIMITS 0.00 255. /end CHARACTERISTIC
/begin CHARACTERISTIC K_GENSTATZ "Hier könnte Ihr Langbezeichner stehen" VALUE 0x80063A5B Val_Wu8 29. Def_st_ub_q1 1.0 30. FORMAT "%3.0" EXTENDED_LIMITS 0.00 255. /end CHARACTERISTIC
/begin CHARACTERISTIC K_GEN_DNMIN "Motordrehzahlschwelle für Auswertung der Generatorfehler" VALUE 0x80063A5C Val_Ws16 65535. Def_n_sw_q1p0 -32768. 32767. FORMAT "%5.0" /end CHARACTERISTIC
/begin CHARACTERISTIC K_MSKGENDFP "Bitmaske Generator Fehler-> DFP" VALUE 0x80063A5E Val_Wu8 255. Def_st_ub_q1 0.00 255. FORMAT "%3.0" /end CHARACTERISTIC
/begin CHARACTERISTIC K_MSKGENDIAG "Hier könnte Ihr Langbezeichner stehen" VALUE 0x80063A60 Val_Wu16 65535. Def_st_uw_q1 0.00 65535. FORMAT "%5.0" /end CHARACTERISTIC
/begin CHARACTERISTIC K_MSKGENKL61 "Bitmaske fuer Generatorfehler -> Ladekontrolle" VALUE 0x80063A62 Val_Wu8 255. Def_st_ub_q1 0.00 255. FORMAT "%3.0" /end CHARACTERISTIC
/begin CHARACTERISTIC K_MSKGENSTAT "Hier könnte Ihr Langbezeichner stehen" VALUE 0x80063A64 Val_Wu16 65535. Def_st_uw_q1 0.00 65535. FORMAT "%5.0" /end CHARACTERISTIC
/begin CHARACTERISTIC K_MSKIBSDFP "Bitmaske Generator Fehler-> DFP" VALUE 0x80063A7C Val_Wu8 255. Def_st_ub_q1 0.00 255. FORMAT "%3.0" /end CHARACTERISTIC
/begin CHARACTERISTIC K_MSKIBSDFP2 "" VALUE 0x80063A7D Val_Wu8 255. Def_st_ub_q1 0.00 255. FORMAT "%3.0" /end CHARACTERISTIC
/begin CHARACTERISTIC K_MSKIBSDIAG "Test AK disable Diagnose" VALUE 0x80063A7E Val_Wu8 255. Def_st_ub_q1 0.00 255. FORMAT "%3.0" /end CHARACTERISTIC
/begin CHARACTERISTIC K_MSKIBSERR "" VALUE 0x80063A7F Val_Wu8 255. ident 0.00 255. FORMAT "%3.0" /end CHARACTERISTIC
/begin CHARACTERISTIC K_MSKIBSERR2 "" VALUE 0x80063A80 Val_Wu8 255. ident 0.00 255. FORMAT "%3.0" /end CHARACTERISTIC
/begin CHARACTERISTIC K_PLAUSAUS "Zeitdauer Ausschaltentprellung Plausibilisierung Fehler" VALUE 0x80063A66 Val_Wu16 6553.5 Def_td_uw_q0p1 0.00 6553.5 FORMAT "%6.1" /end CHARACTERISTIC
/begin CHARACTERISTIC K_PLAUSEIN "Zeitdauer Einschaltentprellung Plausibilisierung Fehler" VALUE 0x80063A68 Val_Wu16 6553.5 Def_td_uw_q0p1 0.00 6553.5 FORMAT "%6.1" /end CHARACTERISTIC
/begin CHARACTERISTIC K_SNMBSDKL61 "Hier könnte Ihr Langbezeichner stehen" VALUE 0x80063A6A Val_Ws16 65535. Def_n_sw_q1p0 -32768. 32767. FORMAT "%5.0" /end CHARACTERISTIC
/begin CHARACTERISTIC K_TDGENERR "Hier könnte Ihr Langbezeichner stehen" VALUE 0x80063A6C Val_Wu16 6553.5 Def_td_uw_q0p1 0.00 6553.5 FORMAT "%6.1" /end CHARACTERISTIC
/begin CHARACTERISTIC K_TDGENFBSD "Hier könnte Ihr Langbezeichner stehen" VALUE 0x80063A6E Val_Wu16 6553.5 Def_td_uw_q0p1 0.00 6553.5 FORMAT "%6.1" /end CHARACTERISTIC
/begin CHARACTERISTIC K_TD_UGENDIAG "Entprellzeit Unterspannungsdiagnose Generator" VALUE 0x80063A70 Val_Wu16 6553.5 Def_td_uw_q0p1 0.00 6553.5 FORMAT "%6.1" /end CHARACTERISTIC
/begin CHARACTERISTIC K_UGENDIAG "Diagoseschwelle Generatorunterspannung" VALUE 0x80063A72 Val_Wu16 6173.4 Def_u_uw_q0p0942 0.00 6173.4 FORMAT "%6.1" /end CHARACTERISTIC
/begin CHARACTERISTIC K_UGOFFSET "Offset zur Schwelle Generatorunterspannungs Diagnose" VALUE 0x80063A74 Val_Wu16 6173.4 Def_u_uw_q0p0942 0.00 6173.4 FORMAT "%6.1" /end CHARACTERISTIC
/begin CHARACTERISTIC S_BSDKOORD "" VALUE 0x80063A81 Val_Wu8 1.0 Identity 0.00 1.0 EXTENDED_LIMITS 0.00 255. /end CHARACTERISTIC
/begin CHARACTERISTIC S_DGENSTAT "Hier könnte Ihr Langbezeichner stehen" VALUE 0x80063A76 Val_Wu8 1.0 Identity 0.00 1.0 EXTENDED_LIMITS 0.00 255. /end CHARACTERISTIC
/begin CHARACTERISTIC S_DGENSTATENA "Hier könnte Ihr Langbezeichner stehen" VALUE 0x80063A77 Val_Wu8 1.0 Identity 0.00 1.0 EXTENDED_LIMITS 0.00 255. /end CHARACTERISTIC
/begin CHARACTERISTIC S_ENUGDIAG "Freigabe Unterspannungsdiagnose Generator" VALUE 0x80063A78 Val_Wu8 1.0 Identity 0.00 1.0 EXTENDED_LIMITS 0.00 255. /end CHARACTERISTIC
/begin CHARACTERISTIC S_GENDIAGNEU "Hier könnte Ihr Langbezeichner stehen" VALUE 0x80063A79 Val_Wu8 1.0 Identity 0.00 1.0 EXTENDED_LIMITS 0.00 255. /end CHARACTERISTIC
/begin CHARACTERISTIC S_GENPLAUS "Hier könnte Ihr Langbezeichner stehen" VALUE 0x80063A7A Val_Wu8 1.0 Identity 0.00 1.0 EXTENDED_LIMITS 0.00 255. /end CHARACTERISTIC
/begin MEASUREMENT DiaDem_nSetPHi "obere Solldrehzahl des DiaDem" SWORD EngN 1 100 -16384.00 16383.50 ECU_ADDRESS 0xD00008C6 /end MEASUREMENT
/begin MEASUREMENT DiaDem_nSetPHi_mp "" SWORD EngN 1 100 -16384.00 16383.50 ECU_ADDRESS 0xC0009C78 /end MEASUREMENT
/begin MEASUREMENT DiaDem_nSetPLo "untere Solldrehzahl des DiaDem" SWORD EngN 1 100 -16384.00 16383.50 ECU_ADDRESS 0xD00008C8 /end MEASUREMENT
/begin MEASUREMENT DiaDem_nSetPLoInl1_mp "" SWORD EngN 1 100 -16384.00 16383.50 ECU_ADDRESS 0xC0009C7A /end MEASUREMENT
/begin MEASUREMENT DiaDem_nSetPLoInl2_mp "" SWORD EngN 1 100 -16384.00 16383.50 ECU_ADDRESS 0xC0009C7C /end MEASUREMENT
/begin MEASUREMENT DiaDem_nSetPLo_mp "" SWORD EngN 1 100 -16384.00 16383.50 ECU_ADDRESS 0xC0009C7E /end MEASUREMENT
/begin MEASUREMENT DiaDem_numActvInl_mp "" UBYTE OneToOne 1 100 0.00 255.0 ECU_ADDRESS 0xC000B12E /end MEASUREMENT
/begin MEASUREMENT DiaDem_numInl_mp "" UBYTE OneToOne 1 100 0.00 255.0 ECU_ADDRESS 0xC000B12F /end MEASUREMENT
/begin MEASUREMENT DiaDem_trqLimMax "maximales DiaDem Begrenzungsdrehmoment an den EISGov" SWORD Trq 1 100 -3276.800 3276.700 ECU_ADDRESS 0xD00008CA /end MEASUREMENT
/begin MEASUREMENT DiaDem_trqLimMax_mp "" SWORD Trq 1 100 -3276.800 3276.700 ECU_ADDRESS 0xC0009C80 /end MEASUREMENT
/begin MEASUREMENT DiaDem_trqLimMin "minimales DiaDem Begrenzungsdrehmoment an den EISGov" SWORD Trq 1 100 -3276.800 3276.700 ECU_ADDRESS 0xD00008CC /end MEASUREMENT
/begin MEASUREMENT DiaDem_trqLimMin_mp "" SWORD Trq 1 100 -3276.800 3276.700 ECU_ADDRESS 0xC0009C82 /end MEASUREMENT
/begin MEASUREMENT DiaDem_trqReq "Anforderung Initialisierungsdrehmoment an den EISGov (bezogen auf den Ausgang)" SWORD Trq 1 100 -3276.800 3276.700 ECU_ADDRESS 0xD00008CE /end MEASUREMENT
/begin MEASUREMENT DINH_stFId.FId_Unused "FId/intern benötigter Parameter für nicht existierenden Funktionsidentifier FId_Unused" UBYTE DFC_OneToOne 1 100 0.00 255.0 ECU_ADDRESS 0xD0003967 /end MEASUREMENT
/begin MEASUREMENT DINH_stFId.FId_InhibitAlways "FId/Status des Funktions Identifiers FId_InhibitAlways" UBYTE DFC_OneToOne 1 100 0.00 255.0 ECU_ADDRESS 0xD0003968 /end MEASUREMENT
/begin MEASUREMENT DINH_stFId.FId_CoordALS "FId/Status des Funktions Identifiers FId_CoordALS" UBYTE DFC_OneToOne 1 100 0.00 255.0 ECU_ADDRESS 0xD0003969 /end MEASUREMENT
/begin MEASUREMENT DINH_stFId.FId_CoordFBC "FId/Normal : FId zur Kommunikation zwischen Fuel quantity Balancing Control und DSM scheduler DSCHED (Overrun Coordinator). Die FId aktiviert Geberradadption im Schub." UBYTE DFC_OneToOne 1 100 0.00 255.0 ECU_ADDRESS 0xD000396A /end MEASUREMENT
/begin MEASUREMENT DINH_stFId.FId_CoordTAA "FId/Normal : FId zur Kommunikation zwischen TAA (Inkrementwinkel-Lernverfahren) und DSM scheduler (DSCHED). Die FId aktiviert die TAA im Schub." UBYTE DFC_OneToOne 1 100 0.00 255.0 ECU_ADDRESS 0xD000396B /end MEASUREMENT
/begin MEASUREMENT DINH_stFId.FId_CoordZFC "FId/Status des Funktions Identifiers FId_CoordZFC" UBYTE DFC_OneToOne 1 100 0.00 255.0 ECU_ADDRESS 0xD000396C /end MEASUREMENT
/begin MEASUREMENT DINH_stFId.FId_IVPlausRunUpTstActv "FId/Funktionsidentifier des Hochlauftest für den Diagnosescheduler des DSM" UBYTE DFC_OneToOne 1 100 0.00 255.0 ECU_ADDRESS 0xD000396D /end MEASUREMENT
/begin MEASUREMENT DINH_stFId.FId_RailHpTstActv "FId/Funktionsidentifier des Hochdrucktests für den Diagnosescheduler des DSM" UBYTE DFC_OneToOne 1 100 0.00 255.0 ECU_ADDRESS 0xD000396E /end MEASUREMENT
/begin MEASUREMENT DINH_stFId.FId_ACCIRevErr "" UBYTE DFC_OneToOne 1 100 0.00 255.0 ECU_ADDRESS 0xD000396F /end MEASUREMENT
/begin MEASUREMENT DINH_stFId.FId_ACCRevErr "" UBYTE DFC_OneToOne 1 100 0.00 255.0 ECU_ADDRESS 0xD0003970 /end MEASUREMENT
/begin MEASUREMENT DINH_stFId.FId_ACCtlTEngErr "FId/Status des Funktions Identifiers FId_ACCtlTEngErr" UBYTE DFC_OneToOne 1 100 0.00 255.0 ECU_ADDRESS 0xD0003971 /end MEASUREMENT
/begin MEASUREMENT DINH_stFId.FId_ACCtlTGearbxErr "FId/Status des Funktions Identifiers FId_ACCtlTGearbxErr" UBYTE DFC_OneToOne 1 100 0.00 255.0 ECU_ADDRESS 0xD0003972 /end MEASUREMENT
/begin MEASUREMENT DINH_stFId.FId_ACCtlVehVErr "FId/Status des Funktions Identifiers FId_ACCtlVehVErr" UBYTE DFC_OneToOne 1 100 0.00 255.0 ECU_ADDRESS 0xD0003973 /end MEASUREMENT
/begin MEASUREMENT DINH_stFId.FId_ACCtl_AC "FId/Status des Funktions Identifiers FId_ACCtl_AC" UBYTE DFC_OneToOne 1 100 0.00 255.0 ECU_ADDRESS 0xD0003974 /end MEASUREMENT
/begin MEASUREMENT DINH_stFId.FId_ACCtl_Fan "FId/Status des Funktions Identifiers FId_ACCtl_Fan" UBYTE DFC_OneToOne 1 100 0.00 255.0 ECU_ADDRESS 0xD0003975 /end MEASUREMENT
/begin MEASUREMENT DINH_stFId.FId_ACCtlstTrailer "" UBYTE DFC_OneToOne 1 100 0.00 255.0 ECU_ADDRESS 0xD0003976 /end MEASUREMENT
/begin MEASUREMENT DINH_stFId.FId_AFS "FId/Status des Funktions Identifiers FId_AFS" UBYTE DFC_OneToOne 1 100 0.00 255.0 ECU_ADDRESS 0xD0003977 /end MEASUREMENT
/begin MEASUREMENT DINH_stFId.FId_AFSActrTst "FId/Status des Funktions Identifiers FId_AFSActrTst" UBYTE DFC_OneToOne 1 100 0.00 255.0 ECU_ADDRESS 0xD0003978 /end MEASUREMENT
/begin MEASUREMENT DINH_stFId.FId_AFSDrftMaxLim "FId/Status des Funktions Identifiers FId_AFSDrftMaxLim" UBYTE DFC_OneToOne 1 100 0.00 255.0 ECU_ADDRESS 0xD0003979 /end MEASUREMENT
/begin MEASUREMENT DINH_stFId.FId_AFSFrzAirMs "FId/Status des Funktions Identifiers FId_AFSFrzAirMs" UBYTE DFC_OneToOne 1 100 0.00 255.0 ECU_ADDRESS 0xD000397A /end MEASUREMENT
/begin MEASUREMENT DINH_stFId.FId_AFSPlOffsDrft "FId/Status des Funktions Identifiers FId_AFSPlOffsDrft" UBYTE DFC_OneToOne 1 100 0.00 255.0 ECU_ADDRESS 0xD000397B /end MEASUREMENT
/begin MEASUREMENT DINH_stFId.FId_AFSPlSetyDrft "FId/Status des Funktions Identifiers FId_AFSPlSetyDrft" UBYTE DFC_OneToOne 1 100 0.00 255.0 ECU_ADDRESS 0xD000397C /end MEASUREMENT
/begin MEASUREMENT DINH_stFId.FId_AFSSRC "FId/Status des Funktions Identifiers FId_AFSSRC" UBYTE DFC_OneToOne 1 100 0.00 255.0 ECU_ADDRESS 0xD000397D /end MEASUREMENT
/begin MEASUREMENT DINH_stFId.FId_AFSSysErr "FId/Status des Funktions Identifiers FId_AFSSysErr" UBYTE DFC_OneToOne 1 100 0.00 255.0 ECU_ADDRESS 0xD000397E /end MEASUREMENT
/begin MEASUREMENT DINH_stFId.FId_AFSTPer "FId/Status des Funktions Identifiers FId_AFSTPer" UBYTE DFC_OneToOne 1 100 0.00 255.0 ECU_ADDRESS 0xD000397F /end MEASUREMENT
/begin MEASUREMENT DINH_stFId.FId_AFStCond "" UBYTE DFC_OneToOne 1 100 0.00 255.0 ECU_ADDRESS 0xD0003980 /end MEASUREMENT
/begin MEASUREMENT DINH_stFId.FId_AFStEnv "" UBYTE DFC_OneToOne 1 100 0.00 255.0 ECU_ADDRESS 0xD0003981 /end MEASUREMENT
/begin MEASUREMENT DINH_stFId.FId_AGSDem_SelectParameter "" UBYTE DFC_OneToOne 1 100 0.00 255.0 ECU_ADDRESS 0xD0003982 /end MEASUREMENT
/begin MEASUREMENT DINH_stFId.FId_APP1FinalDef "FId/Status des Funktions Identifiers FId_APP1FinalDef" UBYTE DFC_OneToOne 1 100 0.00 255.0 ECU_ADDRESS 0xD0003983 /end MEASUREMENT
/begin MEASUREMENT DINH_stFId.FId_APP1ProvDef "FId/Status des Funktions Identifiers FId_APP1ProvDef" UBYTE DFC_OneToOne 1 100 0.00 255.0 ECU_ADDRESS 0xD0003984 /end MEASUREMENT
/begin MEASUREMENT DINH_stFId.FId_APP1SRCHigh "FId/Status des Funktions Identifiers FId_APP1SRCHigh" UBYTE DFC_OneToOne 1 100 0.00 255.0 ECU_ADDRESS 0xD0003985 /end MEASUREMENT
/begin MEASUREMENT DINH_stFId.FId_APP1SigPath "FId/Status des Funktions Identifiers FId_APP1SigPath" UBYTE DFC_OneToOne 1 100 0.00 255.0 ECU_ADDRESS 0xD0003986 /end MEASUREMENT
/begin MEASUREMENT DINH_stFId.FId_APP2FinalDef "FId/Status des Funktions Identifiers FId_APP2FinalDef" UBYTE DFC_OneToOne 1 100 0.00 255.0 ECU_ADDRESS 0xD0003987 /end MEASUREMENT
/begin MEASUREMENT DINH_stFId.FId_APP2ProvDef "FId/Status des Funktions Identifiers FId_APP2ProvDef" UBYTE DFC_OneToOne 1 100 0.00 255.0 ECU_ADDRESS 0xD0003988 /end MEASUREMENT
/begin MEASUREMENT DINH_stFId.FId_APP2SRCHigh "FId/Status des Funktions Identifiers FId_APP2SRCHigh" UBYTE DFC_OneToOne 1 100 0.00 255.0 ECU_ADDRESS 0xD0003989 /end MEASUREMENT
/begin MEASUREMENT DINH_stFId.FId_APP2SigPath "FId/Status des Funktions Identifiers FId_APP2SigPath" UBYTE DFC_OneToOne 1 100 0.00 255.0 ECU_ADDRESS 0xD000398A /end MEASUREMENT
/begin MEASUREMENT DINH_stFId.FId_APPBrkDef "FId/Status des Funktions Identifiers FId_APPBrkDef" UBYTE DFC_OneToOne 1 100 0.00 255.0 ECU_ADDRESS 0xD000398B /end MEASUREMENT
/begin MEASUREMENT DINH_stFId.FId_APPBrkTrq "" UBYTE DFC_OneToOne 1 100 0.00 255.0 ECU_ADDRESS 0xD000398C /end MEASUREMENT
/begin MEASUREMENT DINH_stFId.FId_APPNTP "FId/Status des Funktions Identifiers FId_APPNTP" UBYTE DFC_OneToOne 1 100 0.00 255.0 ECU_ADDRESS 0xD000398D /end MEASUREMENT
/begin MEASUREMENT DINH_stFId.FId_APPSyncChk "FId/Status des Funktions Identifiers FId_APPSyncChk" UBYTE DFC_OneToOne 1 100 0.00 255.0 ECU_ADDRESS 0xD000398E /end MEASUREMENT
/begin MEASUREMENT DINH_stFId.FId_APPSyncDef "FId/Status des Funktions Identifiers FId_APPSyncDef" UBYTE DFC_OneToOne 1 100 0.00 255.0 ECU_ADDRESS 0xD000398F /end MEASUREMENT
/begin MEASUREMENT DINH_stFId.FId_APPSyncProvDef "FId/Status des Funktions Identifiers FId_APPSyncProvDef" UBYTE DFC_OneToOne 1 100 0.00 255.0 ECU_ADDRESS 0xD0003990 /end MEASUREMENT
/begin MEASUREMENT DINH_stFId.FId_APPSyncSigProv "FId/Status des Funktions Identifiers FId_APPSyncSigProv" UBYTE DFC_OneToOne 1 100 0.00 255.0 ECU_ADDRESS 0xD0003991 /end MEASUREMENT
/begin MEASUREMENT DINH_stFId.FId_APPVel "FId/Status des Funktions Identifiers FId_APPVel" UBYTE DFC_OneToOne 1 100 0.00 255.0 ECU_ADDRESS 0xD0003992 /end MEASUREMENT
/begin MEASUREMENT DINH_stFId.FId_APProvDef "FId/Status des Funktions Identifiers FId_APProvDef" UBYTE DFC_OneToOne 1 100 0.00 255.0 ECU_ADDRESS 0xD0003993 /end MEASUREMENT
/begin MEASUREMENT DINH_stFId.FId_ASDdc "FId/Substitute : FId zum Abschalten des Störungsreglers des Aktiven Ruckeldämpfers, wenn Fehler im Kurbelwellen Signal auftreten." UBYTE DFC_OneToOne 1 100 0.00 255.0 ECU_ADDRESS 0xD0003994 /end MEASUREMENT
/begin MEASUREMENT DINH_stFId.FId_ASDrfLAD2 "FId/Substitute : FId zum Abschalten des Lastschlagdämpfers im Betriebsmodus 2, wenn Fehler im Kurbelwellen Signal auftreten." UBYTE DFC_OneToOne 1 100 0.00 255.0 ECU_ADDRESS 0xD0003995 /end MEASUREMENT
/begin MEASUREMENT DINH_stFId.FId_ASModAFS "" UBYTE DFC_OneToOne 1 100 0.00 255.0 ECU_ADDRESS 0xD0003996 /end MEASUREMENT
/begin MEASUREMENT DINH_stFId.FId_ASModAFSTCmpr "" UBYTE DFC_OneToOne 1 100 0.00 255.0 ECU_ADDRESS 0xD0003997 /end MEASUREMENT
/begin MEASUREMENT DINH_stFId.FId_ASModEGRVlvLrn "" UBYTE DFC_OneToOne 1 100 0.00 255.0 ECU_ADDRESS 0xD0003998 /end MEASUREMENT
/begin MEASUREMENT DINH_stFId.FId_ASModOxiC "FId/Status des Funktions Identifiers FId_ASModOxiC" UBYTE DFC_OneToOne 1 100 0.00 255.0 ECU_ADDRESS 0xD0003999 /end MEASUREMENT
/begin MEASUREMENT DINH_stFId.FId_ASModPipe "FId/Status des Funktions Identifiers FId_ASModPipe" UBYTE DFC_OneToOne 1 100 0.00 255.0 ECU_ADDRESS 0xD000399A /end MEASUREMENT
/begin MEASUREMENT DINH_stFId.FId_ASModPipeSlw "FId/Status des Funktions Identifiers FId_ASModPipeSlw" UBYTE DFC_OneToOne 1 100 0.00 255.0 ECU_ADDRESS 0xD000399B /end MEASUREMENT
/begin MEASUREMENT DINH_stFId.FId_ASModPresCalc "FId/Status des Funktions Identifiers FId_ASModPresCalc" UBYTE DFC_OneToOne 1 100 0.00 255.0 ECU_ADDRESS 0xD000399C /end MEASUREMENT
/begin MEASUREMENT DINH_stFId.FId_ASModPresEnv "FId/Status des Funktions Identifiers FId_ASModPresEnv" UBYTE DFC_OneToOne 1 100 0.00 255.0 ECU_ADDRESS 0xD000399D /end MEASUREMENT
/begin MEASUREMENT DINH_stFId.FId_ASModStrt "FId/Status des Funktions Identifiers FId_ASModStrt" UBYTE DFC_OneToOne 1 100 0.00 255.0 ECU_ADDRESS 0xD000399E /end MEASUREMENT
/begin MEASUREMENT DINH_stFId.FId_ASModSwtOffEng "FId/Status des Funktions Identifiers FId_ASModSwtOffEng" UBYTE DFC_OneToOne 1 100 0.00 255.0 ECU_ADDRESS 0xD000399F /end MEASUREMENT
/begin MEASUREMENT DINH_stFId.FId_ASModSwtOffExhMnfLP "FId/Status des Funktions Identifiers FId_ASModSwtOffExhMnfLP" UBYTE DFC_OneToOne 1 100 0.00 255.0 ECU_ADDRESS 0xD00039A0 /end MEASUREMENT
/begin MEASUREMENT DINH_stFId.FId_ASModSwtOffIndVol "FId/Status des Funktions Identifiers FId_ASModSwtOffIndVol" UBYTE DFC_OneToOne 1 100 0.00 255.0 ECU_ADDRESS 0xD00039A1 /end MEASUREMENT
/begin MEASUREMENT DINH_stFId.FId_ASModT20 "" UBYTE DFC_OneToOne 1 100 0.00 255.0 ECU_ADDRESS 0xD00039A2 /end MEASUREMENT
/begin MEASUREMENT DINH_stFId.FId_ASModTrbn "FId/Status des Funktions Identifiers FId_ASModTrbn" UBYTE DFC_OneToOne 1 100 0.00 255.0 ECU_ADDRESS 0xD00039A3 /end MEASUREMENT
/begin MEASUREMENT DINH_stFId.FId_AccPedNMaxLim "FId/Status des Funktions Identifiers FId_AccPedNMaxLim" UBYTE DFC_OneToOne 1 100 0.00 255.0 ECU_ADDRESS 0xD00039A4 /end MEASUREMENT
/begin MEASUREMENT DINH_stFId.FId_AccPedNMinLim "FId/Status des Funktions Identifiers FId_AccPedNMinLim" UBYTE DFC_OneToOne 1 100 0.00 255.0 ECU_ADDRESS 0xD00039A5 /end MEASUREMENT
/begin MEASUREMENT DINH_stFId.FId_AccPedTrqLim "FId/Status des Funktions Identifiers FId_AccPedTrqLim" UBYTE DFC_OneToOne 1 100 0.00 255.0 ECU_ADDRESS 0xD00039A6 /end MEASUREMENT
/begin MEASUREMENT DINH_stFId.FId_AdapNSCDs "FId/Status des Funktions Identifiers FId_AdapNSCDs" UBYTE DFC_OneToOne 1 100 0.00 255.0 ECU_ADDRESS 0xD00039A7 /end MEASUREMENT
/begin MEASUREMENT DINH_stFId.FId_AdcIADC0 "FId/Status des Funktions Identifiers FId_AdcIADC0" UBYTE DFC_OneToOne 1 100 0.00 255.0 ECU_ADDRESS 0xD00039A8 /end MEASUREMENT
/begin MEASUREMENT DINH_stFId.FId_AdcIADC1 "FId/Status des Funktions Identifiers FId_AdcIADC1" UBYTE DFC_OneToOne 1 100 0.00 255.0 ECU_ADDRESS 0xD00039A9 /end MEASUREMENT
/begin MEASUREMENT DINH_stFId.FId_AftRun "" UBYTE DFC_OneToOne 1 100 0.00 255.0 ECU_ADDRESS 0xD00039AA /end MEASUREMENT
/begin MEASUREMENT DINH_stFId.FId_AirCSwt "FId/Status des Funktions Identifiers FId_AirCSwt" UBYTE DFC_OneToOne 1 100 0.00 255.0 ECU_ADDRESS 0xD00039AB /end MEASUREMENT
/begin MEASUREMENT DINH_stFId.FId_AirCtl "FId/Status des Funktions Identifiers FId_AirCtl" UBYTE DFC_OneToOne 1 100 0.00 255.0 ECU_ADDRESS 0xD00039AC /end MEASUREMENT
/begin MEASUREMENT DINH_stFId.FId_AirCtlACCorr "" UBYTE DFC_OneToOne 1 100 0.00 255.0 ECU_ADDRESS 0xD00039AD /end MEASUREMENT
/begin MEASUREMENT DINH_stFId.FId_AirCtlBrk "" UBYTE DFC_OneToOne 1 100 0.00 255.0 ECU_ADDRESS 0xD00039AE /end MEASUREMENT
/begin MEASUREMENT DINH_stFId.FId_AirCtlBstPresCor "FId/Status des Funktions Identifiers FId_AirCtlBstPresCor" UBYTE DFC_OneToOne 1 100 0.00 255.0 ECU_ADDRESS 0xD00039AF /end MEASUREMENT
/begin MEASUREMENT DINH_stFId.FId_AirCtlCmpntActv "FId/Status des Funktions Identifiers FId_AirCtlCmpntActv" UBYTE DFC_OneToOne 1 100 0.00 255.0 ECU_ADDRESS 0xD00039B0 /end MEASUREMENT
/begin MEASUREMENT DINH_stFId.FId_AirCtlCorAltEOM "" UBYTE DFC_OneToOne 1 100 0.00 255.0 ECU_ADDRESS 0xD00039B1 /end MEASUREMENT
/begin MEASUREMENT DINH_stFId.FId_AirCtlDyn "" UBYTE DFC_OneToOne 1 100 0.00 255.0 ECU_ADDRESS 0xD00039B2 /end MEASUREMENT
/begin MEASUREMENT DINH_stFId.FId_AirCtlEGR "FId/Status des Funktions Identifiers FId_AirCtlEGR" UBYTE DFC_OneToOne 1 100 0.00 255.0 ECU_ADDRESS 0xD00039B3 /end MEASUREMENT
/begin MEASUREMENT DINH_stFId.FId_AirCtlEGRPreCtl "" UBYTE DFC_OneToOne 1 100 0.00 255.0 ECU_ADDRESS 0xD00039B4 /end MEASUREMENT
/begin MEASUREMENT DINH_stFId.FId_AirCtlGear "FId/Status des Funktions Identifiers FId_AirCtlGear" UBYTE DFC_OneToOne 1 100 0.00 255.0 ECU_ADDRESS 0xD00039B5 /end MEASUREMENT
/begin MEASUREMENT DINH_stFId.FId_AirCtlGovDvt "FId/Status des Funktions Identifiers FId_AirCtlGovDvt" UBYTE DFC_OneToOne 1 100 0.00 255.0 ECU_ADDRESS 0xD00039B6 /end MEASUREMENT
/begin MEASUREMENT DINH_stFId.FId_AirCtlGovLPDvt "" UBYTE DFC_OneToOne 1 100 0.00 255.0 ECU_ADDRESS 0xD00039B7 /end MEASUREMENT
/begin MEASUREMENT DINH_stFId.FId_AirCtlInvEGRMod "" UBYTE DFC_OneToOne 1 100 0.00 255.0 ECU_ADDRESS 0xD00039B8 /end MEASUREMENT
/begin MEASUREMENT DINH_stFId.FId_AirCtlLP "" UBYTE DFC_OneToOne 1 100 0.00 255.0 ECU_ADDRESS 0xD00039B9 /end MEASUREMENT
/begin MEASUREMENT DINH_stFId.FId_AirCtlLPACCor "" UBYTE DFC_OneToOne 1 100 0.00 255.0 ECU_ADDRESS 0xD00039BA /end MEASUREMENT
/begin MEASUREMENT DINH_stFId.FId_AirCtlLPBstPresCor "" UBYTE DFC_OneToOne 1 100 0.00 255.0 ECU_ADDRESS 0xD00039BB /end MEASUREMENT
/begin MEASUREMENT DINH_stFId.FId_AirCtlLPCmpntActv "" UBYTE DFC_OneToOne 1 100 0.00 255.0 ECU_ADDRESS 0xD00039BC /end MEASUREMENT
/begin MEASUREMENT DINH_stFId.FId_AirCtlLPGear "" UBYTE DFC_OneToOne 1 100 0.00 255.0 ECU_ADDRESS 0xD00039BD /end MEASUREMENT
/begin MEASUREMENT DINH_stFId.FId_AirCtlLPPFltEGRRed "" UBYTE DFC_OneToOne 1 100 0.00 255.0 ECU_ADDRESS 0xD00039BE /end MEASUREMENT
/begin MEASUREMENT DINH_stFId.FId_AirCtlLPStrgCor "" UBYTE DFC_OneToOne 1 100 0.00 255.0 ECU_ADDRESS 0xD00039BF /end MEASUREMENT
/begin MEASUREMENT DINH_stFId.FId_AirCtlLPVehVCor "" UBYTE DFC_OneToOne 1 100 0.00 255.0 ECU_ADDRESS 0xD00039C0 /end MEASUREMENT
/begin MEASUREMENT DINH_stFId.FId_AirCtlPFltEGRRed "FId/Status des Funktions Identifiers FId_AirCtlPFltEGRRed" UBYTE DFC_OneToOne 1 100 0.00 255.0 ECU_ADDRESS 0xD00039C1 /end MEASUREMENT
/begin MEASUREMENT DINH_stFId.FId_AirCtlStrg "FId/Status des Funktions Identifiers FId_AirCtlStrg" UBYTE DFC_OneToOne 1 100 0.00 255.0 ECU_ADDRESS 0xD00039C2 /end MEASUREMENT
/begin MEASUREMENT DINH_stFId.FId_AirCtlTVA "FId/Status des Funktions Identifiers FId_AirCtlTVA" UBYTE DFC_OneToOne 1 100 0.00 255.0 ECU_ADDRESS 0xD00039C3 /end MEASUREMENT
/begin MEASUREMENT DINH_stFId.FId_AirCtlTVACtl "" UBYTE DFC_OneToOne 1 100 0.00 255.0 ECU_ADDRESS 0xD00039C4 /end MEASUREMENT
/begin MEASUREMENT DINH_stFId.FId_AirCtlmDesVehCorr "" UBYTE DFC_OneToOne 1 100 0.00 255.0 ECU_ADDRESS 0xD00039C5 /end MEASUREMENT
/begin MEASUREMENT DINH_stFId.FId_AirSysTst "" UBYTE DFC_OneToOne 1 100 0.00 255.0 ECU_ADDRESS 0xD00039C6 /end MEASUREMENT
/begin MEASUREMENT DINH_stFId.FId_BattUFrzVal "FId/Status des Funktions Identifiers FId_BattUFrzVal" UBYTE DFC_OneToOne 1 100 0.00 255.0 ECU_ADDRESS 0xD00039C7 /end MEASUREMENT
/begin MEASUREMENT DINH_stFId.FId_BattUReplVal "FId/Status des Funktions Identifiers FId_BattUReplVal" UBYTE DFC_OneToOne 1 100 0.00 255.0 ECU_ADDRESS 0xD00039C8 /end MEASUREMENT
/begin MEASUREMENT DINH_stFId.FId_BattUSRC "FId/Status des Funktions Identifiers FId_BattUSRC" UBYTE DFC_OneToOne 1 100 0.00 255.0 ECU_ADDRESS 0xD00039C9 /end MEASUREMENT
/begin MEASUREMENT DINH_stFId.FId_BrkP "" UBYTE DFC_OneToOne 1 100 0.00 255.0 ECU_ADDRESS 0xD00039CA /end MEASUREMENT
/begin MEASUREMENT DINH_stFId.FId_BrkPFrzVal "" UBYTE DFC_OneToOne 1 100 0.00 255.0 ECU_ADDRESS 0xD00039CB /end MEASUREMENT
/begin MEASUREMENT DINH_stFId.FId_BrkPReplVal "" UBYTE DFC_OneToOne 1 100 0.00 255.0 ECU_ADDRESS 0xD00039CC /end MEASUREMENT
/begin MEASUREMENT DINH_stFId.FId_BrkPSens "" UBYTE DFC_OneToOne 1 100 0.00 255.0 ECU_ADDRESS 0xD00039CD /end MEASUREMENT
/begin MEASUREMENT DINH_stFId.FId_BusDiag_stFadeOut "" UBYTE DFC_OneToOne 1 100 0.00 255.0 ECU_ADDRESS 0xD00039CE /end MEASUREMENT
/begin MEASUREMENT DINH_stFId.FId_CEngDsTDynTst "FId/Status des Funktions Identifiers FId_CEngDsTDynTst" UBYTE DFC_OneToOne 1 100 0.00 255.0 ECU_ADDRESS 0xD00039CF /end MEASUREMENT
/begin MEASUREMENT DINH_stFId.FId_CEngDsTFrzVal "FId/Status des Funktions Identifiers FId_CEngDsTFrzVal" UBYTE DFC_OneToOne 1 100 0.00 255.0 ECU_ADDRESS 0xD00039D0 /end MEASUREMENT
/begin MEASUREMENT DINH_stFId.FId_CEngDsTModel "FId/Status des Funktions Identifiers FId_CEngDsTModel" UBYTE DFC_OneToOne 1 100 0.00 255.0 ECU_ADDRESS 0xD00039D1 /end MEASUREMENT
/begin MEASUREMENT DINH_stFId.FId_CEngDsTRdClnt "FId/Status des Funktions Identifiers FId_CEngDsTRdClnt" UBYTE DFC_OneToOne 1 100 0.00 255.0 ECU_ADDRESS 0xD00039D2 /end MEASUREMENT
/begin MEASUREMENT DINH_stFId.FId_CEngDsTRplVal "FId/Status des Funktions Identifiers FId_CEngDsTRplVal" UBYTE DFC_OneToOne 1 100 0.00 255.0 ECU_ADDRESS 0xD00039D3 /end MEASUREMENT
/begin MEASUREMENT DINH_stFId.FId_CEngDsTSS "FId/Status des Funktions Identifiers FId_CEngDsTSS" UBYTE DFC_OneToOne 1 100 0.00 255.0 ECU_ADDRESS 0xD00039D4 /end MEASUREMENT
/begin MEASUREMENT DINH_stFId.FId_Clth "FId/Status des Funktions Identifiers FId_Clth" UBYTE DFC_OneToOne 1 100 0.00 255.0 ECU_ADDRESS 0xD00039D5 /end MEASUREMENT
/begin MEASUREMENT DINH_stFId.FId_ClthCAN "FId/Status des Funktions Identifiers FId_ClthCAN" UBYTE DFC_OneToOne 1 100 0.00 255.0 ECU_ADDRESS 0xD00039D6 /end MEASUREMENT
/begin MEASUREMENT DINH_stFId.FId_CmbChb "FId/Substitute : FId zum Abschalten der Aussetzererkennung, wenn Fehler im Kurbelwellen- Signal auftreten." UBYTE DFC_OneToOne 1 100 0.00 255.0 ECU_ADDRESS 0xD00039D7 /end MEASUREMENT
/begin MEASUREMENT DINH_stFId.FId_CoEngNrml2Strt "FId/Status des Funktions Identifiers FId_CoEngNrml2Strt" UBYTE DFC_OneToOne 1 100 0.00 255.0 ECU_ADDRESS 0xD00039D8 /end MEASUREMENT
/begin MEASUREMENT DINH_stFId.FId_CoEngPthClsEGR "FId/Status des Funktions Identifiers FId_CoEngPthClsEGR" UBYTE DFC_OneToOne 1 100 0.00 255.0 ECU_ADDRESS 0xD00039D9 /end MEASUREMENT
/begin MEASUREMENT DINH_stFId.FId_CoEngPthClsThr "FId/Status des Funktions Identifiers FId_CoEngPthClsThr" UBYTE DFC_OneToOne 1 100 0.00 255.0 ECU_ADDRESS 0xD00039DA /end MEASUREMENT
/begin MEASUREMENT DINH_stFId.FId_CoEngPthCylOff "FId/Status des Funktions Identifiers FId_CoEngPthCylOff" UBYTE DFC_OneToOne 1 100 0.00 255.0 ECU_ADDRESS 0xD00039DB /end MEASUREMENT
/begin MEASUREMENT DINH_stFId.FId_CoEngPthETZr "FId/Status des Funktions Identifiers FId_CoEngPthETZr" UBYTE DFC_OneToOne 1 100 0.00 255.0 ECU_ADDRESS 0xD00039DC /end MEASUREMENT
/begin MEASUREMENT DINH_stFId.FId_CoEngPthFlQnt "FId/Status des Funktions Identifiers FId_CoEngPthFlQnt" UBYTE DFC_OneToOne 1 100 0.00 255.0 ECU_ADDRESS 0xD00039DD /end MEASUREMENT
/begin MEASUREMENT DINH_stFId.FId_CoEngPthInjVlvOff "FId/Status des Funktions Identifiers FId_CoEngPthInjVlvOff" UBYTE DFC_OneToOne 1 100 0.00 255.0 ECU_ADDRESS 0xD00039DE /end MEASUREMENT
/begin MEASUREMENT DINH_stFId.FId_CoEngPthLpSysOff "FId/Status des Funktions Identifiers FId_CoEngPthLpSysOff" UBYTE DFC_OneToOne 1 100 0.00 255.0 ECU_ADDRESS 0xD00039DF /end MEASUREMENT
/begin MEASUREMENT DINH_stFId.FId_CoEngPthRPMin "FId/Status des Funktions Identifiers FId_CoEngPthRPMin" UBYTE DFC_OneToOne 1 100 0.00 255.0 ECU_ADDRESS 0xD00039E0 /end MEASUREMENT
/begin MEASUREMENT DINH_stFId.FId_CoEngPthTrqZr "FId/Status des Funktions Identifiers FId_CoEngPthTrqZr" UBYTE DFC_OneToOne 1 100 0.00 255.0 ECU_ADDRESS 0xD00039E1 /end MEASUREMENT
/begin MEASUREMENT DINH_stFId.FId_CoEngSoftShOff "FId/Status des Funktions Identifiers FId_CoEngSoftShOff" UBYTE DFC_OneToOne 1 100 0.00 255.0 ECU_ADDRESS 0xD00039E2 /end MEASUREMENT
/begin MEASUREMENT DINH_stFId.FId_CoEngStop "" UBYTE DFC_OneToOne 1 100 0.00 255.0 ECU_ADDRESS 0xD00039E3 /end MEASUREMENT
/begin MEASUREMENT DINH_stFId.FId_CoSCR_CAN "" UBYTE DFC_OneToOne 1 100 0.00 255.0 ECU_ADDRESS 0xD00039E4 /end MEASUREMENT
/begin MEASUREMENT DINH_stFId.FId_CoTS_SwtOff "FId/Status des Funktions Identifiers FId_CoTS_SwtOff" UBYTE DFC_OneToOne 1 100 0.00 255.0 ECU_ADDRESS 0xD00039E5 /end MEASUREMENT
/begin MEASUREMENT DINH_stFId.FId_CoVMDComErr "" UBYTE DFC_OneToOne 1 100 0.00 255.0 ECU_ADDRESS 0xD00039E6 /end MEASUREMENT
/begin MEASUREMENT DINH_stFId.FId_CoVMvBd "" UBYTE DFC_OneToOne 1 100 0.00 255.0 ECU_ADDRESS 0xD00039E7 /end MEASUREMENT
/begin MEASUREMENT DINH_stFId.FId_CoVehPrpLimErr "FId/Status des Funktions Identifiers FId_CoVehPrpLimErr" UBYTE DFC_OneToOne 1 100 0.00 255.0 ECU_ADDRESS 0xD00039E8 /end MEASUREMENT
/begin MEASUREMENT DINH_stFId.FId_ComAPP "FId/Status des Funktions Identifiers FId_ComAPP" UBYTE DFC_OneToOne 1 100 0.00 255.0 ECU_ADDRESS 0xD00039E9 /end MEASUREMENT
/begin MEASUREMENT DINH_stFId.FId_ComBrkDef "" UBYTE DFC_OneToOne 1 100 0.00 255.0 ECU_ADDRESS 0xD00039EA /end MEASUREMENT
/begin MEASUREMENT DINH_stFId.FId_ComClth "FId/Status des Funktions Identifiers FId_ComClth" UBYTE DFC_OneToOne 1 100 0.00 255.0 ECU_ADDRESS 0xD00039EB /end MEASUREMENT
/begin MEASUREMENT DINH_stFId.FId_ComCoEng "FId/Status des Funktions Identifiers FId_ComCoEng" UBYTE DFC_OneToOne 1 100 0.00 255.0 ECU_ADDRESS 0xD00039EC /end MEASUREMENT
/begin MEASUREMENT DINH_stFId.FId_ComCtrSecInt "" UBYTE DFC_OneToOne 1 100 0.00 255.0 ECU_ADDRESS 0xD00039ED /end MEASUREMENT
/begin MEASUREMENT DINH_stFId.FId_ComCtrSecIntTo "" UBYTE DFC_OneToOne 1 100 0.00 255.0 ECU_ADDRESS 0xD00039EE /end MEASUREMENT
/begin MEASUREMENT DINH_stFId.FId_ComDKGIntv "" UBYTE DFC_OneToOne 1 100 0.00 255.0 ECU_ADDRESS 0xD00039EF /end MEASUREMENT
/begin MEASUREMENT DINH_stFId.FId_ComDscAck1 "FId/Status des Funktions Identifiers FId_ComDscAck1" UBYTE DFC_OneToOne 1 100 0.00 255.0 ECU_ADDRESS 0xD00039F0 /end MEASUREMENT
/begin MEASUREMENT DINH_stFId.FId_ComDscAck2 "FId/Status des Funktions Identifiers FId_ComDscAck2" UBYTE DFC_OneToOne 1 100 0.00 255.0 ECU_ADDRESS 0xD00039F1 /end MEASUREMENT
/begin MEASUREMENT DINH_stFId.FId_ComDscAck3 "FId/Status des Funktions Identifiers FId_ComDscAck3" UBYTE DFC_OneToOne 1 100 0.00 255.0 ECU_ADDRESS 0xD00039F2 /end MEASUREMENT
/begin MEASUREMENT DINH_stFId.FId_ComDscTrqIntv "FId/Status des Funktions Identifiers FId_ComDscTrqIntv" UBYTE DFC_OneToOne 1 100 0.00 255.0 ECU_ADDRESS 0xD00039F3 /end MEASUREMENT
/begin MEASUREMENT DINH_stFId.FId_ComEngDem "FId/Status des Funktions Identifiers FId_ComEngDem" UBYTE DFC_OneToOne 1 100 0.00 255.0 ECU_ADDRESS 0xD00039F4 /end MEASUREMENT
/begin MEASUREMENT DINH_stFId.FId_ComGbxAck1 "FId/Status des Funktions Identifiers FId_ComGbxAck1" UBYTE DFC_OneToOne 1 100 0.00 255.0 ECU_ADDRESS 0xD00039F5 /end MEASUREMENT
/begin MEASUREMENT DINH_stFId.FId_ComGbxAck2 "FId/Status des Funktions Identifiers FId_ComGbxAck2" UBYTE DFC_OneToOne 1 100 0.00 255.0 ECU_ADDRESS 0xD00039F6 /end MEASUREMENT
/begin MEASUREMENT DINH_stFId.FId_ComGbxAck3 "FId/Status des Funktions Identifiers FId_ComGbxAck3" UBYTE DFC_OneToOne 1 100 0.00 255.0 ECU_ADDRESS 0xD00039F7 /end MEASUREMENT
/begin MEASUREMENT DINH_stFId.FId_ComGbxTrqIntv "FId/Status des Funktions Identifiers FId_ComGbxTrqIntv" UBYTE DFC_OneToOne 1 100 0.00 255.0 ECU_ADDRESS 0xD00039F8 /end MEASUREMENT
/begin MEASUREMENT DINH_stFId.FId_ComInjDu1 "FId/Status des Funktions Identifiers FId_ComInjDu1" UBYTE DFC_OneToOne 1 100 0.00 255.0 ECU_ADDRESS 0xD00039F9 /end MEASUREMENT
/begin MEASUREMENT DINH_stFId.FId_ComInjDu2 "FId/Status des Funktions Identifiers FId_ComInjDu2" UBYTE DFC_OneToOne 1 100 0.00 255.0 ECU_ADDRESS 0xD00039FA /end MEASUREMENT
/begin MEASUREMENT DINH_stFId.FId_ComInjVlv "FId/Status des Funktions Identifiers FId_ComInjVlv" UBYTE DFC_OneToOne 1 100 0.00 255.0 ECU_ADDRESS 0xD00039FB /end MEASUREMENT
/begin MEASUREMENT DINH_stFId.FId_ComMSA "FId/Status des Funktions Identifiers FId_ComMSA" UBYTE DFC_OneToOne 1 100 0.00 255.0 ECU_ADDRESS 0xD00039FC /end MEASUREMENT
/begin MEASUREMENT DINH_stFId.FId_ComNDynDispOff "" UBYTE DFC_OneToOne 1 100 0.00 255.0 ECU_ADDRESS 0xD00039FD /end MEASUREMENT
/begin MEASUREMENT DINH_stFId.FId_ComNGbxOut "" UBYTE DFC_OneToOne 1 100 0.00 255.0 ECU_ADDRESS 0xD00039FE /end MEASUREMENT
/begin MEASUREMENT DINH_stFId.FId_ComPCBSPFlt "" UBYTE DFC_OneToOne 1 100 0.00 255.0 ECU_ADDRESS 0xD00039FF /end MEASUREMENT
/begin MEASUREMENT DINH_stFId.FId_ComRCtrPwrSpCos "" UBYTE DFC_OneToOne 1 100 0.00 255.0 ECU_ADDRESS 0xD0003A00 /end MEASUREMENT
/begin MEASUREMENT DINH_stFId.FId_ComRpmRduc "" UBYTE DFC_OneToOne 1 100 0.00 255.0 ECU_ADDRESS 0xD0003A01 /end MEASUREMENT
/begin MEASUREMENT DINH_stFId.FId_ComSLck "" UBYTE DFC_OneToOne 1 100 0.00 255.0 ECU_ADDRESS 0xD0003A02 /end MEASUREMENT
/begin MEASUREMENT DINH_stFId.FId_ComStBrkPedal "FId/Status des Funktions Identifiers FId_ComStBrkPedal" UBYTE DFC_OneToOne 1 100 0.00 255.0 ECU_ADDRESS 0xD0003A03 /end MEASUREMENT
/begin MEASUREMENT DINH_stFId.FId_ComStDDEQl "" UBYTE DFC_OneToOne 1 100 0.00 255.0 ECU_ADDRESS 0xD0003A04 /end MEASUREMENT
/begin MEASUREMENT DINH_stFId.FId_ComStDrvDirDes "" UBYTE DFC_OneToOne 1 100 0.00 255.0 ECU_ADDRESS 0xD0003A05 /end MEASUREMENT
/begin MEASUREMENT DINH_stFId.FId_ComStEnrgPwrMnmt "" UBYTE DFC_OneToOne 1 100 0.00 255.0 ECU_ADDRESS 0xD0003A06 /end MEASUREMENT
/begin MEASUREMENT DINH_stFId.FId_ComStGbxModDemFAS "" UBYTE DFC_OneToOne 1 100 0.00 255.0 ECU_ADDRESS 0xD0003A07 /end MEASUREMENT
/begin MEASUREMENT DINH_stFId.FId_ComStGrip "" UBYTE DFC_OneToOne 1 100 0.00 255.0 ECU_ADDRESS 0xD0003A08 /end MEASUREMENT
/begin MEASUREMENT DINH_stFId.FId_ComStLPCOff "" UBYTE DFC_OneToOne 1 100 0.00 255.0 ECU_ADDRESS 0xD0003A09 /end MEASUREMENT
/begin MEASUREMENT DINH_stFId.FId_ComStLckGbxDemQl "" UBYTE DFC_OneToOne 1 100 0.00 255.0 ECU_ADDRESS 0xD0003A0A /end MEASUREMENT
/begin MEASUREMENT DINH_stFId.FId_ComStRTrqPTQl "" UBYTE DFC_OneToOne 1 100 0.00 255.0 ECU_ADDRESS 0xD0003A0B /end MEASUREMENT
/begin MEASUREMENT DINH_stFId.FId_ComStShiftPdl "" UBYTE DFC_OneToOne 1 100 0.00 255.0 ECU_ADDRESS 0xD0003A0C /end MEASUREMENT
/begin MEASUREMENT DINH_stFId.FId_ComStShutOffPSP "" UBYTE DFC_OneToOne 1 100 0.00 255.0 ECU_ADDRESS 0xD0003A0D /end MEASUREMENT
/begin MEASUREMENT DINH_stFId.FId_ComStTerminal "" UBYTE DFC_OneToOne 1 100 0.00 255.0 ECU_ADDRESS 0xD0003A0E /end MEASUREMENT
/begin MEASUREMENT DINH_stFId.FId_ComStTrq "FId/Status des Funktions Identifiers FId_ComStTrq" UBYTE DFC_OneToOne 1 100 0.00 255.0 ECU_ADDRESS 0xD0003A0F /end MEASUREMENT
/begin MEASUREMENT DINH_stFId.FId_ComStTrqGbxQl "" UBYTE DFC_OneToOne 1 100 0.00 255.0 ECU_ADDRESS 0xD0003A10 /end MEASUREMENT
/begin MEASUREMENT DINH_stFId.FId_ComStTrqWhlStbQl "" UBYTE DFC_OneToOne 1 100 0.00 255.0 ECU_ADDRESS 0xD0003A11 /end MEASUREMENT
/begin MEASUREMENT DINH_stFId.FId_ComStVehDrvCond "" UBYTE DFC_OneToOne 1 100 0.00 255.0 ECU_ADDRESS 0xD0003A12 /end MEASUREMENT
/begin MEASUREMENT DINH_stFId.FId_ComStnEngQl "" UBYTE DFC_OneToOne 1 100 0.00 255.0 ECU_ADDRESS 0xD0003A13 /end MEASUREMENT
/begin MEASUREMENT DINH_stFId.FId_ComStrtLck "" UBYTE DFC_OneToOne 1 100 0.00 255.0 ECU_ADDRESS 0xD0003A14 /end MEASUREMENT
/begin MEASUREMENT DINH_stFId.FId_ComTEng "" UBYTE DFC_OneToOne 1 100 0.00 255.0 ECU_ADDRESS 0xD0003A15 /end MEASUREMENT
/begin MEASUREMENT DINH_stFId.FId_ComTOilEng "" UBYTE DFC_OneToOne 1 100 0.00 255.0 ECU_ADDRESS 0xD0003A16 /end MEASUREMENT
/begin MEASUREMENT DINH_stFId.FId_ComThrVlv "" UBYTE DFC_OneToOne 1 100 0.00 255.0 ECU_ADDRESS 0xD0003A17 /end MEASUREMENT
/begin MEASUREMENT DINH_stFId.FId_ComTrqCootd "" UBYTE DFC_OneToOne 1 100 0.00 255.0 ECU_ADDRESS 0xD0003A18 /end MEASUREMENT
/begin MEASUREMENT DINH_stFId.FId_ComTrqWhl "" UBYTE DFC_OneToOne 1 100 0.00 255.0 ECU_ADDRESS 0xD0003A19 /end MEASUREMENT
/begin MEASUREMENT DINH_stFId.FId_ComTrqWhlDes "" UBYTE DFC_OneToOne 1 100 0.00 255.0 ECU_ADDRESS 0xD0003A1A /end MEASUREMENT
/begin MEASUREMENT DINH_stFId.FId_ComUBatt "" UBYTE DFC_OneToOne 1 100 0.00 255.0 ECU_ADDRESS 0xD0003A1B /end MEASUREMENT
/begin MEASUREMENT DINH_stFId.FId_ComVolTotFlCons "" UBYTE DFC_OneToOne 1 100 0.00 255.0 ECU_ADDRESS 0xD0003A1C /end MEASUREMENT
/begin MEASUREMENT DINH_stFId.FId_ComnEng "FId/Status des Funktions Identifiers FId_ComnEng" UBYTE DFC_OneToOne 1 100 0.00 255.0 ECU_ADDRESS 0xD0003A1D /end MEASUREMENT
/begin MEASUREMENT DINH_stFId.FId_ComnGbxOut "" UBYTE DFC_OneToOne 1 100 0.00 255.0 ECU_ADDRESS 0xD0003A1E /end MEASUREMENT
/begin MEASUREMENT DINH_stFId.FId_ComnSetPLo "FId/Status des Funktions Identifiers FId_ComnSetPLo" UBYTE DFC_OneToOne 1 100 0.00 255.0 ECU_ADDRESS 0xD0003A1F /end MEASUREMENT
/begin MEASUREMENT DINH_stFId.FId_ComnTSC "" UBYTE DFC_OneToOne 1 100 0.00 255.0 ECU_ADDRESS 0xD0003A20 /end MEASUREMENT
/begin MEASUREMENT DINH_stFId.FId_CompEnv "FId/Status des Funktions Identifiers FId_CompEnv" UBYTE DFC_OneToOne 1 100 0.00 255.0 ECU_ADDRESS 0xD0003A21 /end MEASUREMENT
/begin MEASUREMENT DINH_stFId.FId_ComrTrq "" UBYTE DFC_OneToOne 1 100 0.00 255.0 ECU_ADDRESS 0xD0003A22 /end MEASUREMENT
/begin MEASUREMENT DINH_stFId.FId_ComrTrqPT "" UBYTE DFC_OneToOne 1 100 0.00 255.0 ECU_ADDRESS 0xD0003A23 /end MEASUREMENT
/begin MEASUREMENT DINH_stFId.FId_ComrVirtAPP "" UBYTE DFC_OneToOne 1 100 0.00 255.0 ECU_ADDRESS 0xD0003A24 /end MEASUREMENT
/begin MEASUREMENT DINH_stFId.FId_ComrWaterVlv "FId/Status des Funktions Identifiers FId_ComrWaterVlv" UBYTE DFC_OneToOne 1 100 0.00 255.0 ECU_ADDRESS 0xD0003A25 /end MEASUREMENT
/begin MEASUREMENT DINH_stFId.FId_ComrtrqDifftl "" UBYTE DFC_OneToOne 1 100 0.00 255.0 ECU_ADDRESS 0xD0003A26 /end MEASUREMENT
/begin MEASUREMENT DINH_stFId.FId_ComstGear "" UBYTE DFC_OneToOne 1 100 0.00 255.0 ECU_ADDRESS 0xD0003A27 /end MEASUREMENT
/begin MEASUREMENT DINH_stFId.FId_ComvVeh "" UBYTE DFC_OneToOne 1 100 0.00 255.0 ECU_ADDRESS 0xD0003A28 /end MEASUREMENT
/begin MEASUREMENT DINH_stFId.FId_ConvLdNTrbnCan "FId/Status des Funktions Identifiers FId_ConvLdNTrbnCan" UBYTE DFC_OneToOne 1 100 0.00 255.0 ECU_ADDRESS 0xD0003A29 /end MEASUREMENT
/begin MEASUREMENT DINH_stFId.FId_ConvLdOilTemp "FId/Status des Funktions Identifiers FId_ConvLdOilTemp" UBYTE DFC_OneToOne 1 100 0.00 255.0 ECU_ADDRESS 0xD0003A2A /end MEASUREMENT
/begin MEASUREMENT DINH_stFId.FId_ConvLdTrqLdCan "FId/Status des Funktions Identifiers FId_ConvLdTrqLdCan" UBYTE DFC_OneToOne 1 100 0.00 255.0 ECU_ADDRESS 0xD0003A2B /end MEASUREMENT
/begin MEASUREMENT DINH_stFId.FId_ConvLdVel "FId/Status des Funktions Identifiers FId_ConvLdVel" UBYTE DFC_OneToOne 1 100 0.00 255.0 ECU_ADDRESS 0xD0003A2C /end MEASUREMENT
/begin MEASUREMENT DINH_stFId.FId_CrCUILvr "" UBYTE DFC_OneToOne 1 100 0.00 255.0 ECU_ADDRESS 0xD0003A2D /end MEASUREMENT
/begin MEASUREMENT DINH_stFId.FId_CrCtlCan "" UBYTE DFC_OneToOne 1 100 0.00 255.0 ECU_ADDRESS 0xD0003A2E /end MEASUREMENT
/begin MEASUREMENT DINH_stFId.FId_CrCtlCanAT "" UBYTE DFC_OneToOne 1 100 0.00 255.0 ECU_ADDRESS 0xD0003A2F /end MEASUREMENT
/begin MEASUREMENT DINH_stFId.FId_CrCtlEcu "" UBYTE DFC_OneToOne 1 100 0.00 255.0 ECU_ADDRESS 0xD0003A30 /end MEASUREMENT
/begin MEASUREMENT DINH_stFId.FId_Cy100Dev1 "FId/Status des Funktions Identifiers FId_Cy100Dev1" UBYTE DFC_OneToOne 1 100 0.00 255.0 ECU_ADDRESS 0xD0003A31 /end MEASUREMENT
/begin MEASUREMENT DINH_stFId.FId_Cy100Dev2 "FId/Status des Funktions Identifiers FId_Cy100Dev2" UBYTE DFC_OneToOne 1 100 0.00 255.0 ECU_ADDRESS 0xD0003A32 /end MEASUREMENT
/begin MEASUREMENT DINH_stFId.FId_DCSRmpShOff "FId/Status des Funktions Identifiers FId_DCSRmpShOff" UBYTE DFC_OneToOne 1 100 0.00 255.0 ECU_ADDRESS 0xD0003A33 /end MEASUREMENT
/begin MEASUREMENT DINH_stFId.FId_DCSShOff "FId/Status des Funktions Identifiers FId_DCSShOff" UBYTE DFC_OneToOne 1 100 0.00 255.0 ECU_ADDRESS 0xD0003A34 /end MEASUREMENT
/begin MEASUREMENT DINH_stFId.FId_DIOnumChip1Cj945 "FId/Status des Funktions Identifiers FId_DIOnumChip1Cj945" UBYTE DFC_OneToOne 1 100 0.00 255.0 ECU_ADDRESS 0xD0003A35 /end MEASUREMENT
/begin MEASUREMENT DINH_stFId.FId_DIUMPRGenDenom1 "FId/Ersatzreaktion:das Inkrementieren des general denominator ist gesperrt (in-use monitor performance ratio)" UBYTE DFC_OneToOne 1 100 0.00 255.0 ECU_ADDRESS 0xD0003A36 /end MEASUREMENT
/begin MEASUREMENT DINH_stFId.FId_DIUMPRGenDenom2 "FId/Ersatzreaktion:das Inkrementieren des general denominator ist gesperrt (in-use monitor performance ratio)" UBYTE DFC_OneToOne 1 100 0.00 255.0 ECU_ADDRESS 0xD0003A37 /end MEASUREMENT
/begin MEASUREMENT DINH_stFId.FId_DIUMPRGenDenom3 "FId/Ersatzreaktion:das Inkrementieren des general denominator ist gesperrt (in-use monitor performance ratio)" UBYTE DFC_OneToOne 1 100 0.00 255.0 ECU_ADDRESS 0xD0003A38 /end MEASUREMENT
/begin MEASUREMENT DINH_stFId.FId_DIUMPRIgn "FId/Ersatzreaktion:das Inkrementieren des ignition cycle counter ist gesperrt (in-use monitor performance ratio)" UBYTE DFC_OneToOne 1 100 0.00 255.0 ECU_ADDRESS 0xD0003A39 /end MEASUREMENT
/begin MEASUREMENT DINH_stFId.FId_DSMIVAdjNVCEna "FId/Zustand des Funktions Identifiers FId_DSMIVAdjNVCEna" UBYTE DFC_OneToOne 1 100 0.00 255.0 ECU_ADDRESS 0xD0003A3A /end MEASUREMENT
/begin MEASUREMENT DINH_stFId.FId_DSMWarmUpCycle "FId/Ersatzreaktion: die warm up cycle Erkennung ist verriegelt, aufgrund eines Fehlers bei der Erkennung der Kühlmitteltemperatur" UBYTE DFC_OneToOne 1 100 0.00 255.0 ECU_ADDRESS 0xD0003A3B /end MEASUREMENT
/begin MEASUREMENT DINH_stFId.FId_DStgyMon "FId/Status des Funktions Identifiers FId_DStgyMon" UBYTE DFC_OneToOne 1 100 0.00 255.0 ECU_ADDRESS 0xD0003A3C /end MEASUREMENT
/begin MEASUREMENT DINH_stFId.FId_DevLibActrPrt "FId/Status des Funktions Identifiers FId_DevLibActrPrt" UBYTE DFC_OneToOne 1 100 0.00 255.0 ECU_ADDRESS 0xD0003A3D /end MEASUREMENT
/begin MEASUREMENT DINH_stFId.FId_DewDetHtgDel "FId/Status des Funktions Identifiers FId_DewDetHtgDel" UBYTE DFC_OneToOne 1 100 0.00 255.0 ECU_ADDRESS 0xD0003A3E /end MEASUREMENT
/begin MEASUREMENT DINH_stFId.FId_DewDetstSrvTstDem "FId/Status des Funktions Identifiers FId_DewDetstSrvTstDem" UBYTE DFC_OneToOne 1 100 0.00 255.0 ECU_ADDRESS 0xD0003A3F /end MEASUREMENT
/begin MEASUREMENT DINH_stFId.FId_DiaDem_SelectParameter "FId/Ersatzreaktion: DiaDem wird verriegelt" UBYTE DFC_OneToOne 1 100 0.00 255.0 ECU_ADDRESS 0xD0003A40 /end MEASUREMENT
/begin MEASUREMENT DINH_stFId.FId_DynChkPPFltDiff "FId/Status des Funktions Identifiers FId_DynChkPPFltDiff" UBYTE DFC_OneToOne 1 100 0.00 255.0 ECU_ADDRESS 0xD0003A41 /end MEASUREMENT
/begin MEASUREMENT DINH_stFId.FId_ECBVlvFrzVal "FId/Status des Funktions Identifiers FId_ECBVlvFrzVal" UBYTE DFC_OneToOne 1 100 0.00 255.0 ECU_ADDRESS 0xD0003A42 /end MEASUREMENT
/begin MEASUREMENT DINH_stFId.FId_ECBVlvReplVal "FId/Status des Funktions Identifiers FId_ECBVlvReplVal" UBYTE DFC_OneToOne 1 100 0.00 255.0 ECU_ADDRESS 0xD0003A43 /end MEASUREMENT
/begin MEASUREMENT DINH_stFId.FId_ECBVlvSS "FId/Status des Funktions Identifiers FId_ECBVlvSS" UBYTE DFC_OneToOne 1 100 0.00 255.0 ECU_ADDRESS 0xD0003A44 /end MEASUREMENT
/begin MEASUREMENT DINH_stFId.FId_EGRClg "FId/Status des Funktions Identifiers FId_EGRClg" UBYTE DFC_OneToOne 1 100 0.00 255.0 ECU_ADDRESS 0xD0003A45 /end MEASUREMENT
/begin MEASUREMENT DINH_stFId.FId_EGRVlvFrzVal "FId/Status des Funktions Identifiers FId_EGRVlvFrzVal" UBYTE DFC_OneToOne 1 100 0.00 255.0 ECU_ADDRESS 0xD0003A46 /end MEASUREMENT
/begin MEASUREMENT DINH_stFId.FId_EGRVlvGovOn "FId/Status des Funktions Identifiers FId_EGRVlvGovOn" UBYTE DFC_OneToOne 1 100 0.00 255.0 ECU_ADDRESS 0xD0003A47 /end MEASUREMENT
/begin MEASUREMENT DINH_stFId.FId_EGRVlvJamVlv "" UBYTE DFC_OneToOne 1 100 0.00 255.0 ECU_ADDRESS 0xD0003A48 /end MEASUREMENT
/begin MEASUREMENT DINH_stFId.FId_EGRVlvLPFrzVal "FId/Status des Funktions Identifiers FId_EGRVlvLPFrzVal" UBYTE DFC_OneToOne 1 100 0.00 255.0 ECU_ADDRESS 0xD0003A49 /end MEASUREMENT
/begin MEASUREMENT DINH_stFId.FId_EGRVlvLPGovOn "FId/Status des Funktions Identifiers FId_EGRVlvLPGovOn" UBYTE DFC_OneToOne 1 100 0.00 255.0 ECU_ADDRESS 0xD0003A4A /end MEASUREMENT
/begin MEASUREMENT DINH_stFId.FId_EGRVlvLPJamVlv "" UBYTE DFC_OneToOne 1 100 0.00 255.0 ECU_ADDRESS 0xD0003A4B /end MEASUREMENT
/begin MEASUREMENT DINH_stFId.FId_EGRVlvLPOfsLrnInhib "FId/Status des Funktions Identifiers FId_EGRVlvLPOfsLrnInhib" UBYTE DFC_OneToOne 1 100 0.00 255.0 ECU_ADDRESS 0xD0003A4C /end MEASUREMENT
/begin MEASUREMENT DINH_stFId.FId_EGRVlvLPReplVal "FId/Status des Funktions Identifiers FId_EGRVlvLPReplVal" UBYTE DFC_OneToOne 1 100 0.00 255.0 ECU_ADDRESS 0xD0003A4D /end MEASUREMENT
/begin MEASUREMENT DINH_stFId.FId_EGRVlvLPSSpMon "FId/Status des Funktions Identifiers FId_EGRVlvLPSSpMon" UBYTE DFC_OneToOne 1 100 0.00 255.0 ECU_ADDRESS 0xD0003A4E /end MEASUREMENT
/begin MEASUREMENT DINH_stFId.FId_EGRVlvOfsLrnInhib "FId/Status des Funktions Identifiers FId_EGRVlvOfsLrnInhib" UBYTE DFC_OneToOne 1 100 0.00 255.0 ECU_ADDRESS 0xD0003A4F /end MEASUREMENT
/begin MEASUREMENT DINH_stFId.FId_EGRVlvReplVal "FId/Status des Funktions Identifiers FId_EGRVlvReplVal" UBYTE DFC_OneToOne 1 100 0.00 255.0 ECU_ADDRESS 0xD0003A50 /end MEASUREMENT
/begin MEASUREMENT DINH_stFId.FId_EGRVlvSSpMon "FId/Status des Funktions Identifiers FId_EGRVlvSSpMon" UBYTE DFC_OneToOne 1 100 0.00 255.0 ECU_ADDRESS 0xD0003A51 /end MEASUREMENT
/begin MEASUREMENT DINH_stFId.FId_EGSysMaxTOxiPre "" UBYTE DFC_OneToOne 1 100 0.00 255.0 ECU_ADDRESS 0xD0003A52 /end MEASUREMENT
/begin MEASUREMENT DINH_stFId.FId_EGSysMaxTOxiPreRgn "" UBYTE DFC_OneToOne 1 100 0.00 255.0 ECU_ADDRESS 0xD0003A53 /end MEASUREMENT
/begin MEASUREMENT DINH_stFId.FId_EGSysMaxTPre "" UBYTE DFC_OneToOne 1 100 0.00 255.0 ECU_ADDRESS 0xD0003A54 /end MEASUREMENT
/begin MEASUREMENT DINH_stFId.FId_EGSysMaxTPreRgn "" UBYTE DFC_OneToOne 1 100 0.00 255.0 ECU_ADDRESS 0xD0003A55 /end MEASUREMENT
/begin MEASUREMENT DINH_stFId.FId_EMCtl "FId/Status des Funktions Identifiers FId_EMCtl" UBYTE DFC_OneToOne 1 100 0.00 255.0 ECU_ADDRESS 0xD0003A56 /end MEASUREMENT
/begin MEASUREMENT DINH_stFId.FId_ETClbCorActv "FId/Status des Funktions Identifiers FId_ETClbCorActv" UBYTE DFC_OneToOne 1 100 0.00 255.0 ECU_ADDRESS 0xD0003A57 /end MEASUREMENT
/begin MEASUREMENT DINH_stFId.FId_ETCtlAirCtl "FId/Ersatzreaktion: die Luftmassensollwert wird auf Null gesetzt" UBYTE DFC_OneToOne 1 100 0.00 255.0 ECU_ADDRESS 0xD0003A58 /end MEASUREMENT
/begin MEASUREMENT DINH_stFId.FId_ETCtlInr "FId/Ersatzreaktion: der innere Regelkreis wird deaktiviert" UBYTE DFC_OneToOne 1 100 0.00 255.0 ECU_ADDRESS 0xD0003A59 /end MEASUREMENT
/begin MEASUREMENT DINH_stFId.FId_ETCtlOutr "FId/Ersatzreaktion: der äußere Regelkreis wird deaktiviert" UBYTE DFC_OneToOne 1 100 0.00 255.0 ECU_ADDRESS 0xD0003A5A /end MEASUREMENT
/begin MEASUREMENT DINH_stFId.FId_Empt "" UBYTE DFC_OneToOne 1 100 0.00 255.0 ECU_ADDRESS 0xD0003A5B /end MEASUREMENT
/begin MEASUREMENT DINH_stFId.FId_EngDaClntTemp "FId/Status des Funktions Identifiers FId_EngDaClntTemp" UBYTE DFC_OneToOne 1 100 0.00 255.0 ECU_ADDRESS 0xD0003A5C /end MEASUREMENT
/begin MEASUREMENT DINH_stFId.FId_EngDemPFltErr "FId/Status des Funktions Identifiers FId_EngDemPFltErr" UBYTE DFC_OneToOne 1 100 0.00 255.0 ECU_ADDRESS 0xD0003A5D /end MEASUREMENT
/begin MEASUREMENT DINH_stFId.FId_EngDemPFltOvldErr "" UBYTE DFC_OneToOne 1 100 0.00 255.0 ECU_ADDRESS 0xD0003A5E /end MEASUREMENT
/begin MEASUREMENT DINH_stFId.FId_EngDemTrqLimErr "FId/Status des Funktions Identifiers FId_EngDemTrqLimErr" UBYTE DFC_OneToOne 1 100 0.00 255.0 ECU_ADDRESS 0xD0003A5F /end MEASUREMENT
/begin MEASUREMENT DINH_stFId.FId_EngDemTrqLimErr1 "FId/Status des Funktions Identifiers FId_EngDemTrqLimErr1" UBYTE DFC_OneToOne 1 100 0.00 255.0 ECU_ADDRESS 0xD0003A60 /end MEASUREMENT
/begin MEASUREMENT DINH_stFId.FId_EngDemTrqLimErr2 "FId/Status des Funktions Identifiers FId_EngDemTrqLimErr2" UBYTE DFC_OneToOne 1 100 0.00 255.0 ECU_ADDRESS 0xD0003A61 /end MEASUREMENT
/begin MEASUREMENT DINH_stFId.FId_EngDemTrqLimErr3 "FId/Status des Funktions Identifiers FId_EngDemTrqLimErr3" UBYTE DFC_OneToOne 1 100 0.00 255.0 ECU_ADDRESS 0xD0003A62 /end MEASUREMENT
/begin MEASUREMENT DINH_stFId.FId_EngDemTrqLimErr4 "FId/Status des Funktions Identifiers FId_EngDemTrqLimErr4" UBYTE DFC_OneToOne 1 100 0.00 255.0 ECU_ADDRESS 0xD0003A63 /end MEASUREMENT
/begin MEASUREMENT DINH_stFId.FId_EngPrtEnvP "FId/Status des Funktions Identifiers FId_EngPrtEnvP" UBYTE DFC_OneToOne 1 100 0.00 255.0 ECU_ADDRESS 0xD0003A64 /end MEASUREMENT
/begin MEASUREMENT DINH_stFId.FId_EngPrtFWOscInactv "" UBYTE DFC_OneToOne 1 100 0.00 255.0 ECU_ADDRESS 0xD0003A65 /end MEASUREMENT
/begin MEASUREMENT DINH_stFId.FId_EngPrtNLimErr "FId/Status des Funktions Identifiers FId_EngPrtNLimErr" UBYTE DFC_OneToOne 1 100 0.00 255.0 ECU_ADDRESS 0xD0003A66 /end MEASUREMENT
/begin MEASUREMENT DINH_stFId.FId_EngPrtT31 "" UBYTE DFC_OneToOne 1 100 0.00 255.0 ECU_ADDRESS 0xD0003A67 /end MEASUREMENT
/begin MEASUREMENT DINH_stFId.FId_EngPrtstTrailer "" UBYTE DFC_OneToOne 1 100 0.00 255.0 ECU_ADDRESS 0xD0003A68 /end MEASUREMENT
/begin MEASUREMENT DINH_stFId.FId_EnhSRCPPFltDiff "FId/Status des Funktions Identifiers FId_EnhSRCPPFltDiff" UBYTE DFC_OneToOne 1 100 0.00 255.0 ECU_ADDRESS 0xD0003A69 /end MEASUREMENT
/begin MEASUREMENT DINH_stFId.FId_EnhSRCT1ExhTMon "FId/Status des Funktions Identifiers FId_EnhSRCT1ExhTMon" UBYTE DFC_OneToOne 1 100 0.00 255.0 ECU_ADDRESS 0xD0003A6A /end MEASUREMENT
/begin MEASUREMENT DINH_stFId.FId_EnhSRCT2ExhTMon "FId/Status des Funktions Identifiers FId_EnhSRCT2ExhTMon" UBYTE DFC_OneToOne 1 100 0.00 255.0 ECU_ADDRESS 0xD0003A6B /end MEASUREMENT
/begin MEASUREMENT DINH_stFId.FId_EnhSRCT3ExhTMon "FId/Status des Funktions Identifiers FId_EnhSRCT3ExhTMon" UBYTE DFC_OneToOne 1 100 0.00 255.0 ECU_ADDRESS 0xD0003A6C /end MEASUREMENT
/begin MEASUREMENT DINH_stFId.FId_EnvPFrzVal "FId/Status des Funktions Identifiers FId_EnvPFrzVal" UBYTE DFC_OneToOne 1 100 0.00 255.0 ECU_ADDRESS 0xD0003A6D /end MEASUREMENT
/begin MEASUREMENT DINH_stFId.FId_EnvPModel "FId/Status des Funktions Identifiers FId_EnvPModel" UBYTE DFC_OneToOne 1 100 0.00 255.0 ECU_ADDRESS 0xD0003A6E /end MEASUREMENT
/begin MEASUREMENT DINH_stFId.FId_EnvPNplPPFltDiff "FId/Status des Funktions Identifiers FId_EnvPNplPPFltDiff" UBYTE DFC_OneToOne 1 100 0.00 255.0 ECU_ADDRESS 0xD0003A6F /end MEASUREMENT
/begin MEASUREMENT DINH_stFId.FId_EnvPRplVal "FId/Status des Funktions Identifiers FId_EnvPRplVal" UBYTE DFC_OneToOne 1 100 0.00 255.0 ECU_ADDRESS 0xD0003A70 /end MEASUREMENT
/begin MEASUREMENT DINH_stFId.FId_EnvPSS "FId/Status des Funktions Identifiers FId_EnvPSS" UBYTE DFC_OneToOne 1 100 0.00 255.0 ECU_ADDRESS 0xD0003A71 /end MEASUREMENT
/begin MEASUREMENT DINH_stFId.FId_EnvTCANFrzVal "FId/Status des Funktions Identifiers FId_EnvTCANFrzVal" UBYTE DFC_OneToOne 1 100 0.00 255.0 ECU_ADDRESS 0xD0003A72 /end MEASUREMENT
/begin MEASUREMENT DINH_stFId.FId_EnvTCANRplVal "FId/Status des Funktions Identifiers FId_EnvTCANRplVal" UBYTE DFC_OneToOne 1 100 0.00 255.0 ECU_ADDRESS 0xD0003A73 /end MEASUREMENT
/begin MEASUREMENT DINH_stFId.FId_EnvTModel "FId/Status des Funktions Identifiers FId_EnvTModel" UBYTE DFC_OneToOne 1 100 0.00 255.0 ECU_ADDRESS 0xD0003A74 /end MEASUREMENT
/begin MEASUREMENT DINH_stFId.FId_EnvTSS "FId/Status des Funktions Identifiers FId_EnvTSS" UBYTE DFC_OneToOne 1 100 0.00 255.0 ECU_ADDRESS 0xD0003A75 /end MEASUREMENT
/begin MEASUREMENT DINH_stFId.FId_EpmBCr "FId/Ersatzfunktion: Notlauf ohne Kurbelwellensignal wird ausgeführt (z.B. Fehler in der Sensorversorgungsspannung)" UBYTE DFC_OneToOne 1 100 0.00 255.0 ECU_ADDRESS 0xD0003A76 /end MEASUREMENT
/begin MEASUREMENT DINH_stFId.FId_EpmCaSAdapCaSI1 "FId/Ersatzfunktion: Sperren der Nockenwellenadaption, bei Nockenwellenfehler, Fehler in der Sensorspannungsversorgung, KW-Störung" UBYTE DFC_OneToOne 1 100 0.00 255.0 ECU_ADDRESS 0xD0003A77 /end MEASUREMENT
/begin MEASUREMENT DINH_stFId.FId_EpmCaSDiag "FId/Ersatzreaktion: Sperren der Nockenwellendiagnose, bei Nockenversatzfehler und Versorgungsspannungsfehlr" UBYTE DFC_OneToOne 1 100 0.00 255.0 ECU_ADDRESS 0xD0003A78 /end MEASUREMENT
/begin MEASUREMENT DINH_stFId.FId_EpmCaSOfsDiagCaSI1 "FId/Ersatzreaktion: Sperren der Nockenwellenwinkelversatzdiagnose bei Nocken- und Kurbelwellenfehler" UBYTE DFC_OneToOne 1 100 0.00 255.0 ECU_ADDRESS 0xD0003A79 /end MEASUREMENT
/begin MEASUREMENT DINH_stFId.FId_EpmCaSOfsErrCaSI1 "FId/Ersatzreaktion: Winkelversatzfehler wird bei Heilung entprellt" UBYTE DFC_OneToOne 1 100 0.00 255.0 ECU_ADDRESS 0xD0003A7A /end MEASUREMENT
/begin MEASUREMENT DINH_stFId.FId_EpmCaSSegCor "FId/Ersatzreaktion: Sperren der Segmentlängenkorrektur bei Nockenwellenfehler und Versorgungsspannungsfehler" UBYTE DFC_OneToOne 1 100 0.00 255.0 ECU_ADDRESS 0xD0003A7B /end MEASUREMENT
/begin MEASUREMENT DINH_stFId.FId_EpmCrSDiag "FId/Ersatzreaktion: Sperren der Kurbelwellendiagnose bei Sensorversorgungsspannungsfehler" UBYTE DFC_OneToOne 1 100 0.00 255.0 ECU_ADDRESS 0xD0003A7C /end MEASUREMENT
/begin MEASUREMENT DINH_stFId.FId_EpmCrSDiagVeh "FId/Ersatzreaktion: Sperren der Funktion zur Vermeidung von KW-Fehlern beim Anrollen/Anschleppen bei Fahrgeschwindigkeitsfehler" UBYTE DFC_OneToOne 1 100 0.00 255.0 ECU_ADDRESS 0xD0003A7D /end MEASUREMENT
/begin MEASUREMENT DINH_stFId.FId_EpmOpMode_InjLock "FId/Ersatzreaktion: Sperren der Synchronisation (Einspritzung, Zündung) bei verdrehter Nockenwelle" UBYTE DFC_OneToOne 1 100 0.00 255.0 ECU_ADDRESS 0xD0003A7E /end MEASUREMENT
/begin MEASUREMENT DINH_stFId.FId_EpmRRSFaultCheck "FId/Ersatzreaktion: Sperren der Rückdreh-/Auslauferkennung bei KW-Fehler, UBatt-Fehler und VehV-Fehler" UBYTE DFC_OneToOne 1 100 0.00 255.0 ECU_ADDRESS 0xD0003A7F /end MEASUREMENT
/begin MEASUREMENT DINH_stFId.FId_EpmRRSRdCheck "" UBYTE DFC_OneToOne 1 100 0.00 255.0 ECU_ADDRESS 0xD0003A80 /end MEASUREMENT
/begin MEASUREMENT DINH_stFId.FId_ExhTMonCondPlaus "FId/Status des Funktions Identifiers FId_ExhTMonCondPlaus" UBYTE DFC_OneToOne 1 100 0.00 255.0 ECU_ADDRESS 0xD0003A81 /end MEASUREMENT
/begin MEASUREMENT DINH_stFId.FId_ExhTMonPlausTemp "FId/Status des Funktions Identifiers FId_ExhTMonPlausTemp" UBYTE DFC_OneToOne 1 100 0.00 255.0 ECU_ADDRESS 0xD0003A82 /end MEASUREMENT
/begin MEASUREMENT DINH_stFId.FId_FBC "FId/Substitute : FId zum Abschalten der Fuel quantity Balancing Control, wenn Fehler im Kurbelwellen Signal auftreten." UBYTE DFC_OneToOne 1 100 0.00 255.0 ECU_ADDRESS 0xD0003A83 /end MEASUREMENT
/begin MEASUREMENT DINH_stFId.FId_FBCMonI "" UBYTE DFC_OneToOne 1 100 0.00 255.0 ECU_ADDRESS 0xD0003A84 /end MEASUREMENT
/begin MEASUREMENT DINH_stFId.FId_FMALamO2Valid "FId/Status des Funktions Identifiers FId_FMALamO2Valid" UBYTE DFC_OneToOne 1 100 0.00 255.0 ECU_ADDRESS 0xD0003A85 /end MEASUREMENT
/begin MEASUREMENT DINH_stFId.FId_FMASwtOff1 "FId/Status des Funktions Identifiers FId_FMASwtOff1" UBYTE DFC_OneToOne 1 100 0.00 255.0 ECU_ADDRESS 0xD0003A86 /end MEASUREMENT
/begin MEASUREMENT DINH_stFId.FId_FMASwtOff3 "FId/Status des Funktions Identifiers FId_FMASwtOff3" UBYTE DFC_OneToOne 1 100 0.00 255.0 ECU_ADDRESS 0xD0003A87 /end MEASUREMENT
/begin MEASUREMENT DINH_stFId.FId_FanCtl "FId/Status des Funktions Identifiers FId_FanCtl" UBYTE DFC_OneToOne 1 100 0.00 255.0 ECU_ADDRESS 0xD0003A88 /end MEASUREMENT
/begin MEASUREMENT DINH_stFId.FId_FanCtl2 "FId/Status des Funktions Identifiers FId_FanCtl2" UBYTE DFC_OneToOne 1 100 0.00 255.0 ECU_ADDRESS 0xD0003A89 /end MEASUREMENT
/begin MEASUREMENT DINH_stFId.FId_FanCtlCor "FId/Status des Funktions Identifiers FId_FanCtlCor" UBYTE DFC_OneToOne 1 100 0.00 255.0 ECU_ADDRESS 0xD0003A8A /end MEASUREMENT
/begin MEASUREMENT DINH_stFId.FId_FanCtlCor2 "FId/Status des Funktions Identifiers FId_FanCtlCor2" UBYTE DFC_OneToOne 1 100 0.00 255.0 ECU_ADDRESS 0xD0003A8B /end MEASUREMENT
/begin MEASUREMENT DINH_stFId.FId_FanCtlnEFan "" UBYTE DFC_OneToOne 1 100 0.00 255.0 ECU_ADDRESS 0xD0003A8C /end MEASUREMENT
/begin MEASUREMENT DINH_stFId.FId_FanCtlstTrailer "" UBYTE DFC_OneToOne 1 100 0.00 255.0 ECU_ADDRESS 0xD0003A8D /end MEASUREMENT
/begin MEASUREMENT DINH_stFId.FId_FanTraOil "FId/Status des Funktions Identifiers FId_FanTraOil" UBYTE DFC_OneToOne 1 100 0.00 255.0 ECU_ADDRESS 0xD0003A8E /end MEASUREMENT
/begin MEASUREMENT DINH_stFId.FId_FlFCBSDef "" UBYTE DFC_OneToOne 1 100 0.00 255.0 ECU_ADDRESS 0xD0003A8F /end MEASUREMENT
/begin MEASUREMENT DINH_stFId.FId_FlFltDsPFrzVal "" UBYTE DFC_OneToOne 1 100 0.00 255.0 ECU_ADDRESS 0xD0003A90 /end MEASUREMENT
/begin MEASUREMENT DINH_stFId.FId_FlFltDsPReplVal "" UBYTE DFC_OneToOne 1 100 0.00 255.0 ECU_ADDRESS 0xD0003A91 /end MEASUREMENT
/begin MEASUREMENT DINH_stFId.FId_FlFltUsPFrzVal "" UBYTE DFC_OneToOne 1 100 0.00 255.0 ECU_ADDRESS 0xD0003A92 /end MEASUREMENT
/begin MEASUREMENT DINH_stFId.FId_FlFltUsPReplVal "" UBYTE DFC_OneToOne 1 100 0.00 255.0 ECU_ADDRESS 0xD0003A93 /end MEASUREMENT
/begin MEASUREMENT DINH_stFId.FId_FlSysDens "FId/Verriegelung der Kraftstofftemperaturerfassung" UBYTE DFC_OneToOne 1 100 0.00 255.0 ECU_ADDRESS 0xD0003A94 /end MEASUREMENT
/begin MEASUREMENT DINH_stFId.FId_FlSysTnkLoEEP "FId/Tankstand wird aufgrund von EEPROM-Fehler nicht erkannt" UBYTE DFC_OneToOne 1 100 0.00 255.0 ECU_ADDRESS 0xD0003A95 /end MEASUREMENT
/begin MEASUREMENT DINH_stFId.FId_FlSysTnkLoInfo "FId/Tankstand ist fehlerhaft oder nicht vorhanden" UBYTE DFC_OneToOne 1 100 0.00 255.0 ECU_ADDRESS 0xD0003A96 /end MEASUREMENT
/begin MEASUREMENT DINH_stFId.FId_FrzPrtTrqDfftl "FId/Status des Funktions Identifiers FId_FrzPrtTrqDfftl" UBYTE DFC_OneToOne 1 100 0.00 255.0 ECU_ADDRESS 0xD0003A97 /end MEASUREMENT
/begin MEASUREMENT DINH_stFId.FId_FrzValAbsUPmpP "" UBYTE DFC_OneToOne 1 100 0.00 255.0 ECU_ADDRESS 0xD0003A98 /end MEASUREMENT
/begin MEASUREMENT DINH_stFId.FId_FrzValCANAbsUPmpP "" UBYTE DFC_OneToOne 1 100 0.00 255.0 ECU_ADDRESS 0xD0003A99 /end MEASUREMENT
/begin MEASUREMENT DINH_stFId.FId_FrzValCANUCatUsT "FId/Status des Funktions Identifiers FId_FrzValCANUCatUsT" UBYTE DFC_OneToOne 1 100 0.00 255.0 ECU_ADDRESS 0xD0003A9A /end MEASUREMENT
/begin MEASUREMENT DINH_stFId.FId_FrzValPPFltDiff "FId/Status des Funktions Identifiers FId_FrzValPPFltDiff" UBYTE DFC_OneToOne 1 100 0.00 255.0 ECU_ADDRESS 0xD0003A9B /end MEASUREMENT
/begin MEASUREMENT DINH_stFId.FId_FrzValPPFltUs "FId/Status des Funktions Identifiers FId_FrzValPPFltUs" UBYTE DFC_OneToOne 1 100 0.00 255.0 ECU_ADDRESS 0xD0003A9C /end MEASUREMENT
/begin MEASUREMENT DINH_stFId.FId_FrzValTOxiCatUs "FId/Status des Funktions Identifiers FId_FrzValTOxiCatUs" UBYTE DFC_OneToOne 1 100 0.00 255.0 ECU_ADDRESS 0xD0003A9D /end MEASUREMENT
/begin MEASUREMENT DINH_stFId.FId_FrzValTPFltUs "FId/Status des Funktions Identifiers FId_FrzValTPFltUs" UBYTE DFC_OneToOne 1 100 0.00 255.0 ECU_ADDRESS 0xD0003A9E /end MEASUREMENT
/begin MEASUREMENT DINH_stFId.FId_FrzValTTrbnUs "FId/Status des Funktions Identifiers FId_FrzValTTrbnUs" UBYTE DFC_OneToOne 1 100 0.00 255.0 ECU_ADDRESS 0xD0003A9F /end MEASUREMENT
/begin MEASUREMENT DINH_stFId.FId_FrzValUCatUsT "FId/Status des Funktions Identifiers FId_FrzValUCatUsT" UBYTE DFC_OneToOne 1 100 0.00 255.0 ECU_ADDRESS 0xD0003AA0 /end MEASUREMENT
/begin MEASUREMENT DINH_stFId.FId_FrzValUTnkLvl "" UBYTE DFC_OneToOne 1 100 0.00 255.0 ECU_ADDRESS 0xD0003AA1 /end MEASUREMENT
/begin MEASUREMENT DINH_stFId.FId_FuelTCTS "FId/Status des Funktions Identifiers FId_FuelTCTS" UBYTE DFC_OneToOne 1 100 0.00 255.0 ECU_ADDRESS 0xD0003AA2 /end MEASUREMENT
/begin MEASUREMENT DINH_stFId.FId_FuelTFlSys "FId/Status des Funktions Identifiers FId_FuelTFlSys" UBYTE DFC_OneToOne 1 100 0.00 255.0 ECU_ADDRESS 0xD0003AA3 /end MEASUREMENT
/begin MEASUREMENT DINH_stFId.FId_FuelTFrzVal "FId/Status des Funktions Identifiers FId_FuelTFrzVal" UBYTE DFC_OneToOne 1 100 0.00 255.0 ECU_ADDRESS 0xD0003AA4 /end MEASUREMENT
/begin MEASUREMENT DINH_stFId.FId_FuelTReplVal "FId/Status des Funktions Identifiers FId_FuelTReplVal" UBYTE DFC_OneToOne 1 100 0.00 255.0 ECU_ADDRESS 0xD0003AA5 /end MEASUREMENT
/begin MEASUREMENT DINH_stFId.FId_GSHDem_SelectParameter "FId/Substitute : FId zum Abschalten des Gear-Shift-Harmonization Demand, wenn Fehler in folgenden Signalen auftreten: z. B. Nocken- oder Kurbelwelle, Fahrzeuggeschwindigkeit, Kühlmitteltemperatur, Bremse oder Kupplung." UBYTE DFC_OneToOne 1 100 0.00 255.0 ECU_ADDRESS 0xD0003AA6 /end MEASUREMENT
/begin MEASUREMENT DINH_stFId.FId_GbxNPosPWM "" UBYTE DFC_OneToOne 1 100 0.00 255.0 ECU_ADDRESS 0xD0003AA7 /end MEASUREMENT
/begin MEASUREMENT DINH_stFId.FId_GlbDaLSumvXPtd "FId/Status des Funktions Identifiers FId_GlbDaLSumvXPtd" UBYTE DFC_OneToOne 1 100 0.00 255.0 ECU_ADDRESS 0xD0003AA8 /end MEASUREMENT
/begin MEASUREMENT DINH_stFId.FId_GlwCtl1 "FId/Status des Funktions Identifiers FId_GlwCtl1" UBYTE DFC_OneToOne 1 100 0.00 255.0 ECU_ADDRESS 0xD0003AA9 /end MEASUREMENT
/begin MEASUREMENT DINH_stFId.FId_GlwCtlDrWghSeat "" UBYTE DFC_OneToOne 1 100 0.00 255.0 ECU_ADDRESS 0xD0003AAA /end MEASUREMENT
/begin MEASUREMENT DINH_stFId.FId_GlwCtlTRadio "" UBYTE DFC_OneToOne 1 100 0.00 255.0 ECU_ADDRESS 0xD0003AAB /end MEASUREMENT
/begin MEASUREMENT DINH_stFId.FId_GlwEcuGPCMFaultInfoTstLck "" UBYTE DFC_OneToOne 1 100 0.00 255.0 ECU_ADDRESS 0xD0003AAC /end MEASUREMENT
/begin MEASUREMENT DINH_stFId.FId_GlwEcuGPCMInfoTstLck "" UBYTE DFC_OneToOne 1 100 0.00 255.0 ECU_ADDRESS 0xD0003AAD /end MEASUREMENT
/begin MEASUREMENT DINH_stFId.FId_HLSDemDeclGradLim "" UBYTE DFC_OneToOne 1 100 0.00 255.0 ECU_ADDRESS 0xD0003AAE /end MEASUREMENT
/begin MEASUREMENT DINH_stFId.FId_HLSDemSetPLoDrvAwy "FId/Status des Funktions Identifiers FId_HLSDemSetPLoDrvAwy" UBYTE DFC_OneToOne 1 100 0.00 255.0 ECU_ADDRESS 0xD0003AAF /end MEASUREMENT
/begin MEASUREMENT DINH_stFId.FId_HLSDemUndrBrk "FId/Substitute : FId zum Abschalten der Zustandsbestimmung ""Unterbremsen"", wenn Fehler in folgenden Signalen auftreten: z. B. Fahrzeuggeschwindigkeit, Bremse oder Kupplung. In diesen Fällen wird der Parametersatz ""Unterbremsen"" nicht ausgewählt." UBYTE DFC_OneToOne 1 100 0.00 255.0 ECU_ADDRESS 0xD0003AB0 /end MEASUREMENT
/begin MEASUREMENT DINH_stFId.FId_HLSDemtrqConv "" UBYTE DFC_OneToOne 1 100 0.00 255.0 ECU_ADDRESS 0xD0003AB1 /end MEASUREMENT
/begin MEASUREMENT DINH_stFId.FId_HsLnChkPPFltDiff "FId/Status des Funktions Identifiers FId_HsLnChkPPFltDiff" UBYTE DFC_OneToOne 1 100 0.00 255.0 ECU_ADDRESS 0xD0003AB2 /end MEASUREMENT
/begin MEASUREMENT DINH_stFId.FId_I14229Appl_RC "" UBYTE DFC_OneToOne 1 100 0.00 255.0 ECU_ADDRESS 0xD0003AB3 /end MEASUREMENT
/begin MEASUREMENT DINH_stFId.FId_ISCnTrbnMod "" UBYTE DFC_OneToOne 1 100 0.00 255.0 ECU_ADDRESS 0xD0003AB4 /end MEASUREMENT
/begin MEASUREMENT DINH_stFId.FId_ISCtrqConv "" UBYTE DFC_OneToOne 1 100 0.00 255.0 ECU_ADDRESS 0xD0003AB5 /end MEASUREMENT
/begin MEASUREMENT DINH_stFId.FId_ISCvBd "" UBYTE DFC_OneToOne 1 100 0.00 255.0 ECU_ADDRESS 0xD0003AB6 /end MEASUREMENT
/begin MEASUREMENT DINH_stFId.FId_IVDiaTst "FId/Zustand des Funktions Identifiers FId_IVDiaTst" UBYTE DFC_OneToOne 1 100 0.00 255.0 ECU_ADDRESS 0xD0003AB7 /end MEASUREMENT
/begin MEASUREMENT DINH_stFId.FId_IVPSplyDCDCOff "FId/Status des Funktions Identifiers FId_IVPSplyDCDCOff" UBYTE DFC_OneToOne 1 100 0.00 255.0 ECU_ADDRESS 0xD0003AB8 /end MEASUREMENT
/begin MEASUREMENT DINH_stFId.FId_IVPlausComprTst "FId/Ersatzreaktion: eine Bedingung für den Ablauf des Kompressionstest ist nicht erfüllt und der Kompressionstest wird nicht ausgeführt" UBYTE DFC_OneToOne 1 100 0.00 255.0 ECU_ADDRESS 0xD0003AB9 /end MEASUREMENT
/begin MEASUREMENT DINH_stFId.FId_IVPlausRunUpTst "FId/Ersatzreaktion: eine Bedingung für den Ablauf des Hochlauftest ist nicht erfüllt und der Hochlauftest wird nicht ausgeführt" UBYTE DFC_OneToOne 1 100 0.00 255.0 ECU_ADDRESS 0xD0003ABA /end MEASUREMENT
/begin MEASUREMENT DINH_stFId.FId_InhibitNever "FId/Status des Funktions Identifiers FId_InhibitNever" UBYTE DFC_OneToOne 1 100 0.00 255.0 ECU_ADDRESS 0xD0003ABB /end MEASUREMENT
/begin MEASUREMENT DINH_stFId.FId_InjCrvCoErr "FId/Ersatzreaktion: Abschaltung der Voreinspritzungen" UBYTE DFC_OneToOne 1 100 0.00 255.0 ECU_ADDRESS 0xD0003ABC /end MEASUREMENT
/begin MEASUREMENT DINH_stFId.FId_InjCrvCylOffs "" UBYTE DFC_OneToOne 1 100 0.00 255.0 ECU_ADDRESS 0xD0003ABD /end MEASUREMENT
/begin MEASUREMENT DINH_stFId.FId_InjCrvDisblPoI1 "FId/Ersatzreaktion: Abschaltung der Nacheinspritzung 1" UBYTE DFC_OneToOne 1 100 0.00 255.0 ECU_ADDRESS 0xD0003ABE /end MEASUREMENT
/begin MEASUREMENT DINH_stFId.FId_InjCrvDisblPoI2 "FId/Ersatzreaktion: Abschaltung der Nacheinspritzung 2" UBYTE DFC_OneToOne 1 100 0.00 255.0 ECU_ADDRESS 0xD0003ABF /end MEASUREMENT
/begin MEASUREMENT DINH_stFId.FId_InjCrvPiI1VehCor "" UBYTE DFC_OneToOne 1 100 0.00 255.0 ECU_ADDRESS 0xD0003AC0 /end MEASUREMENT
/begin MEASUREMENT DINH_stFId.FId_InjCrvPiI2VehCor "" UBYTE DFC_OneToOne 1 100 0.00 255.0 ECU_ADDRESS 0xD0003AC1 /end MEASUREMENT
/begin MEASUREMENT DINH_stFId.FId_InjCrvPoIOvrLim "" UBYTE DFC_OneToOne 1 100 0.00 255.0 ECU_ADDRESS 0xD0003AC2 /end MEASUREMENT
/begin MEASUREMENT DINH_stFId.FId_InjCrvShOffTst "FId/Ersatzreaktion: der Abschalttest wird nicht ausgeführt" UBYTE DFC_OneToOne 1 100 0.00 255.0 ECU_ADDRESS 0xD0003AC3 /end MEASUREMENT
/begin MEASUREMENT DINH_stFId.FId_InjUnStrtPlsBlk "FId/Ersatzreaktion: Überwachung während des Motorstarts ist nicht aktiv" UBYTE DFC_OneToOne 1 100 0.00 255.0 ECU_ADDRESS 0xD0003AC4 /end MEASUREMENT
/begin MEASUREMENT DINH_stFId.FId_InjVlvBnk0ShutOff "FId/Ersatzreaktion: Abschaltung der Bank 0" UBYTE DFC_OneToOne 1 100 0.00 255.0 ECU_ADDRESS 0xD0003AC5 /end MEASUREMENT
/begin MEASUREMENT DINH_stFId.FId_InjVlvBnk1ShutOff "FId/Ersatzreaktion: Abschaltung der Bank 1" UBYTE DFC_OneToOne 1 100 0.00 255.0 ECU_ADDRESS 0xD0003AC6 /end MEASUREMENT
/begin MEASUREMENT DINH_stFId.FId_InjVlvBnk2ShutOff "FId/Ersatzreaktion: Abschaltung der Bank 2" UBYTE DFC_OneToOne 1 100 0.00 255.0 ECU_ADDRESS 0xD0003AC7 /end MEASUREMENT
/begin MEASUREMENT DINH_stFId.FId_InjVlvBnk3ShutOff "FId/Ersatzreaktion: Abschaltung der Bank 3" UBYTE DFC_OneToOne 1 100 0.00 255.0 ECU_ADDRESS 0xD0003AC8 /end MEASUREMENT
/begin MEASUREMENT DINH_stFId.FId_InjVlvCyl0ShutOff "FId/Ersatzreaktion: Abschalten von Zylinder 0" UBYTE DFC_OneToOne 1 100 0.00 255.0 ECU_ADDRESS 0xD0003AC9 /end MEASUREMENT
/begin MEASUREMENT DINH_stFId.FId_InjVlvCyl1ShutOff "FId/Ersatzreaktion: Abschalten von Zylinder 1" UBYTE DFC_OneToOne 1 100 0.00 255.0 ECU_ADDRESS 0xD0003ACA /end MEASUREMENT
/begin MEASUREMENT DINH_stFId.FId_InjVlvCyl2ShutOff "FId/Ersatzreaktion: Abschalten von Zylinder 2" UBYTE DFC_OneToOne 1 100 0.00 255.0 ECU_ADDRESS 0xD0003ACB /end MEASUREMENT
/begin MEASUREMENT DINH_stFId.FId_InjVlvCyl3ShutOff "FId/Ersatzreaktion: Abschalten von Zylinder 3" UBYTE DFC_OneToOne 1 100 0.00 255.0 ECU_ADDRESS 0xD0003ACC /end MEASUREMENT
/begin MEASUREMENT DINH_stFId.FId_InjVlvCyl4ShutOff "FId/Ersatzreaktion: Abschalten von Zylinder 4" UBYTE DFC_OneToOne 1 100 0.00 255.0 ECU_ADDRESS 0xD0003ACD /end MEASUREMENT
/begin MEASUREMENT DINH_stFId.FId_InjVlvCyl5ShutOff "FId/Ersatzreaktion: Abschalten von Zylinder 5" UBYTE DFC_OneToOne 1 100 0.00 255.0 ECU_ADDRESS 0xD0003ACE /end MEASUREMENT
/begin MEASUREMENT DINH_stFId.FId_InjVlvCyl6ShutOff "FId/Ersatzreaktion: Abschalten von Zylinder 6" UBYTE DFC_OneToOne 1 100 0.00 255.0 ECU_ADDRESS 0xD0003ACF /end MEASUREMENT
/begin MEASUREMENT DINH_stFId.FId_InjVlvCyl7ShutOff "FId/Ersatzreaktion: Abschalten von Zylinder 7" UBYTE DFC_OneToOne 1 100 0.00 255.0 ECU_ADDRESS 0xD0003AD0 /end MEASUREMENT
/begin MEASUREMENT DINH_stFId.FId_InjVlvPrep "FId/Zustand des Function Identifier FId_InjVlvPrep" UBYTE DFC_OneToOne 1 100 0.00 255.0 ECU_ADDRESS 0xD0003AD1 /end MEASUREMENT
/begin MEASUREMENT DINH_stFId.FId_InjVlvPresMin "FId/Verriegelung in Abhängigkeit des Raildrucks und des Raildruckreglers" UBYTE DFC_OneToOne 1 100 0.00 255.0 ECU_ADDRESS 0xD0003AD2 /end MEASUREMENT
/begin MEASUREMENT DINH_stFId.FId_InjVlvPresMinRun "FId/FId zum Abschalten der Raildrucküberprüfung auf Minimum beim laufenden Motor" UBYTE DFC_OneToOne 1 100 0.00 255.0 ECU_ADDRESS 0xD0003AD3 /end MEASUREMENT
/begin MEASUREMENT DINH_stFId.FId_InjVlvPresMinStrt "FId/Verriegelung bei Unterschreiten des Mindestraildrucks" UBYTE DFC_OneToOne 1 100 0.00 255.0 ECU_ADDRESS 0xD0003AD4 /end MEASUREMENT
/begin MEASUREMENT DINH_stFId.FId_LSUAdap0 "FId/Status des Funktions Identifiers FId_LSUAdap0" UBYTE DFC_OneToOne 1 100 0.00 255.0 ECU_ADDRESS 0xD0003AD5 /end MEASUREMENT
/begin MEASUREMENT DINH_stFId.FId_LSUClbSched "FId/Status des Funktions Identifiers FId_LSUClbSched" UBYTE DFC_OneToOne 1 100 0.00 255.0 ECU_ADDRESS 0xD0003AD6 /end MEASUREMENT
/begin MEASUREMENT DINH_stFId.FId_LSUCmpChk0 "FId/Status des Funktions Identifiers FId_LSUCmpChk0" UBYTE DFC_OneToOne 1 100 0.00 255.0 ECU_ADDRESS 0xD0003AD7 /end MEASUREMENT
/begin MEASUREMENT DINH_stFId.FId_LSUCtl0 "FId/Status des Funktions Identifiers FId_LSUCtl0" UBYTE DFC_OneToOne 1 100 0.00 255.0 ECU_ADDRESS 0xD0003AD8 /end MEASUREMENT
/begin MEASUREMENT DINH_stFId.FId_LSUDewRls0 "FId/Status des Funktions Identifiers FId_LSUDewRls0" UBYTE DFC_OneToOne 1 100 0.00 255.0 ECU_ADDRESS 0xD0003AD9 /end MEASUREMENT
/begin MEASUREMENT DINH_stFId.FId_LSUDynChk0 "FId/Status des Funktions Identifiers FId_LSUDynChk0" UBYTE DFC_OneToOne 1 100 0.00 255.0 ECU_ADDRESS 0xD0003ADA /end MEASUREMENT
/begin MEASUREMENT DINH_stFId.FId_LSUHtCoup0 "FId/Status des Funktions Identifiers FId_LSUHtCoup0" UBYTE DFC_OneToOne 1 100 0.00 255.0 ECU_ADDRESS 0xD0003ADB /end MEASUREMENT
/begin MEASUREMENT DINH_stFId.FId_LSUHtrPS0 "FId/Status des Funktions Identifiers FId_LSUHtrPS0" UBYTE DFC_OneToOne 1 100 0.00 255.0 ECU_ADDRESS 0xD0003ADC /end MEASUREMENT
/begin MEASUREMENT DINH_stFId.FId_LSUIPOpnLdTst0 "FId/Status des Funktions Identifiers FId_LSUIPOpnLdTst0" UBYTE DFC_OneToOne 1 100 0.00 255.0 ECU_ADDRESS 0xD0003ADD /end MEASUREMENT
/begin MEASUREMENT DINH_stFId.FId_LSUIsolChk0 "FId/Status des Funktions Identifiers FId_LSUIsolChk0" UBYTE DFC_OneToOne 1 100 0.00 255.0 ECU_ADDRESS 0xD0003ADE /end MEASUREMENT
/begin MEASUREMENT DINH_stFId.FId_LSULoBatt0 "FId/Status des Funktions Identifiers FId_LSULoBatt0" UBYTE DFC_OneToOne 1 100 0.00 255.0 ECU_ADDRESS 0xD0003ADF /end MEASUREMENT
/begin MEASUREMENT DINH_stFId.FId_LSUMon0 "FId/Status des Funktions Identifiers FId_LSUMon0" UBYTE DFC_OneToOne 1 100 0.00 255.0 ECU_ADDRESS 0xD0003AE0 /end MEASUREMENT
/begin MEASUREMENT DINH_stFId.FId_LSUO20 "FId/Status des Funktions Identifiers FId_LSUO20" UBYTE DFC_OneToOne 1 100 0.00 255.0 ECU_ADDRESS 0xD0003AE1 /end MEASUREMENT
/begin MEASUREMENT DINH_stFId.FId_LSUO2Clb0 "FId/Status des Funktions Identifiers FId_LSUO2Clb0" UBYTE DFC_OneToOne 1 100 0.00 255.0 ECU_ADDRESS 0xD0003AE2 /end MEASUREMENT
/begin MEASUREMENT DINH_stFId.FId_LSUO2SRC0 "FId/Status des Funktions Identifiers FId_LSUO2SRC0" UBYTE DFC_OneToOne 1 100 0.00 255.0 ECU_ADDRESS 0xD0003AE3 /end MEASUREMENT
/begin MEASUREMENT DINH_stFId.FId_LSUPlausChk0 "FId/Status des Funktions Identifiers FId_LSUPlausChk0" UBYTE DFC_OneToOne 1 100 0.00 255.0 ECU_ADDRESS 0xD0003AE4 /end MEASUREMENT
/begin MEASUREMENT DINH_stFId.FId_LSURi0 "FId/Status des Funktions Identifiers FId_LSURi0" UBYTE DFC_OneToOne 1 100 0.00 255.0 ECU_ADDRESS 0xD0003AE5 /end MEASUREMENT
/begin MEASUREMENT DINH_stFId.FId_LSURiClb0 "FId/Status des Funktions Identifiers FId_LSURiClb0" UBYTE DFC_OneToOne 1 100 0.00 255.0 ECU_ADDRESS 0xD0003AE6 /end MEASUREMENT
/begin MEASUREMENT DINH_stFId.FId_LSUShCir0 "FId/Status des Funktions Identifiers FId_LSUShCir0" UBYTE DFC_OneToOne 1 100 0.00 255.0 ECU_ADDRESS 0xD0003AE7 /end MEASUREMENT
/begin MEASUREMENT DINH_stFId.FId_LSUUNVGOpnLdTst0 "FId/Status des Funktions Identifiers FId_LSUUNVGOpnLdTst0" UBYTE DFC_OneToOne 1 100 0.00 255.0 ECU_ADDRESS 0xD0003AE8 /end MEASUREMENT
/begin MEASUREMENT DINH_stFId.FId_LSUlsu0 "FId/Status des Funktions Identifiers FId_LSUlsu0" UBYTE DFC_OneToOne 1 100 0.00 255.0 ECU_ADDRESS 0xD0003AE9 /end MEASUREMENT
/begin MEASUREMENT DINH_stFId.FId_Layer_ACFZGL11 "" UBYTE DFC_OneToOne 1 100 0.00 255.0 ECU_ADDRESS 0xD0003AEA /end MEASUREMENT
/begin MEASUREMENT DINH_stFId.FId_Layer_ACFZGQ11 "" UBYTE DFC_OneToOne 1 100 0.00 255.0 ECU_ADDRESS 0xD0003AEB /end MEASUREMENT
/begin MEASUREMENT DINH_stFId.FId_Layer_AQUERABS11 "" UBYTE DFC_OneToOne 1 100 0.00 255.0 ECU_ADDRESS 0xD0003AEC /end MEASUREMENT
/begin MEASUREMENT DINH_stFId.FId_Layer_ATEMPRELATIVZEIT "" UBYTE DFC_OneToOne 1 100 0.00 255.0 ECU_ADDRESS 0xD0003AED /end MEASUREMENT
/begin MEASUREMENT DINH_stFId.FId_Layer_BATTCLASS "" UBYTE DFC_OneToOne 1 100 0.00 255.0 ECU_ADDRESS 0xD0003AEE /end MEASUREMENT
/begin MEASUREMENT DINH_stFId.FId_Layer_BEDIENUNG_MSA "" UBYTE DFC_OneToOne 1 100 0.00 255.0 ECU_ADDRESS 0xD0003AEF /end MEASUREMENT
/begin MEASUREMENT DINH_stFId.FId_Layer_CANErr "" UBYTE DFC_OneToOne 1 100 0.00 255.0 ECU_ADDRESS 0xD0003AF0 /end MEASUREMENT
/begin MEASUREMENT DINH_stFId.FId_Layer_CODIERUNG_PM "" UBYTE DFC_OneToOne 1 100 0.00 255.0 ECU_ADDRESS 0xD0003AF1 /end MEASUREMENT
/begin MEASUREMENT DINH_stFId.FId_Layer_CRASHABSCHALTUNG "" UBYTE DFC_OneToOne 1 100 0.00 255.0 ECU_ADDRESS 0xD0003AF2 /end MEASUREMENT
/begin MEASUREMENT DINH_stFId.FId_Layer_DIENSTE_19 "" UBYTE DFC_OneToOne 1 100 0.00 255.0 ECU_ADDRESS 0xD0003AF3 /end MEASUREMENT
/begin MEASUREMENT DINH_stFId.FId_Layer_FAHRZEUGTYP "" UBYTE DFC_OneToOne 1 100 0.00 255.0 ECU_ADDRESS 0xD0003AF4 /end MEASUREMENT
/begin MEASUREMENT DINH_stFId.FId_Layer_FltHtg "" UBYTE DFC_OneToOne 1 100 0.00 255.0 ECU_ADDRESS 0xD0003AF5 /end MEASUREMENT
/begin MEASUREMENT DINH_stFId.FId_Layer_FltMng_Sig1 "" UBYTE DFC_OneToOne 1 100 0.00 255.0 ECU_ADDRESS 0xD0003AF6 /end MEASUREMENT
/begin MEASUREMENT DINH_stFId.FId_Layer_FltMng_Sig2 "" UBYTE DFC_OneToOne 1 100 0.00 255.0 ECU_ADDRESS 0xD0003AF7 /end MEASUREMENT
/begin MEASUREMENT DINH_stFId.FId_Layer_GESCHWINDIGKEIT "" UBYTE DFC_OneToOne 1 100 0.00 255.0 ECU_ADDRESS 0xD0003AF8 /end MEASUREMENT
/begin MEASUREMENT DINH_stFId.FId_Layer_GETRIEBEDATEN "" UBYTE DFC_OneToOne 1 100 0.00 255.0 ECU_ADDRESS 0xD0003AF9 /end MEASUREMENT
/begin MEASUREMENT DINH_stFId.FId_Layer_GETRIEBEDATEN_2 "" UBYTE DFC_OneToOne 1 100 0.00 255.0 ECU_ADDRESS 0xD0003AFA /end MEASUREMENT
/begin MEASUREMENT DINH_stFId.FId_Layer_KILOMETERSTAND "" UBYTE DFC_OneToOne 1 100 0.00 255.0 ECU_ADDRESS 0xD0003AFB /end MEASUREMENT
/begin MEASUREMENT DINH_stFId.FId_Layer_KLEMMENSTATUS "" UBYTE DFC_OneToOne 1 100 0.00 255.0 ECU_ADDRESS 0xD0003AFC /end MEASUREMENT
/begin MEASUREMENT DINH_stFId.FId_Layer_LENKRADWINKEL "" UBYTE DFC_OneToOne 1 100 0.00 255.0 ECU_ADDRESS 0xD0003AFD /end MEASUREMENT
/begin MEASUREMENT DINH_stFId.FId_Layer_LPC "" UBYTE DFC_OneToOne 1 100 0.00 255.0 ECU_ADDRESS 0xD0003AFE /end MEASUREMENT
/begin MEASUREMENT DINH_stFId.FId_Layer_MANDETEK "" UBYTE DFC_OneToOne 1 100 0.00 255.0 ECU_ADDRESS 0xD0003AFF /end MEASUREMENT
/begin MEASUREMENT DINH_stFId.FId_Layer_MSACANErr "" UBYTE DFC_OneToOne 1 100 0.00 255.0 ECU_ADDRESS 0xD0003B00 /end MEASUREMENT
/begin MEASUREMENT DINH_stFId.FId_Layer_MSAVAdapt "" UBYTE DFC_OneToOne 1 100 0.00 255.0 ECU_ADDRESS 0xD0003B01 /end MEASUREMENT
/begin MEASUREMENT DINH_stFId.FId_Layer_MSAVDiag "" UBYTE DFC_OneToOne 1 100 0.00 255.0 ECU_ADDRESS 0xD0003B02 /end MEASUREMENT
/begin MEASUREMENT DINH_stFId.FId_Layer_STANDVERBRAUCHER "" UBYTE DFC_OneToOne 1 100 0.00 255.0 ECU_ADDRESS 0xD0003B03 /end MEASUREMENT
/begin MEASUREMENT DINH_stFId.FId_Layer_STATDSC "" UBYTE DFC_OneToOne 1 100 0.00 255.0 ECU_ADDRESS 0xD0003B04 /end MEASUREMENT
/begin MEASUREMENT DINH_stFId.FId_Layer_STATESEAT "" UBYTE DFC_OneToOne 1 100 0.00 255.0 ECU_ADDRESS 0xD0003B05 /end MEASUREMENT
/begin MEASUREMENT DINH_stFId.FId_Layer_STATGANGRUECKWAERTS "" UBYTE DFC_OneToOne 1 100 0.00 255.0 ECU_ADDRESS 0xD0003B06 /end MEASUREMENT
/begin MEASUREMENT DINH_stFId.FId_Layer_STATZVKLAPPEN "" UBYTE DFC_OneToOne 1 100 0.00 255.0 ECU_ADDRESS 0xD0003B07 /end MEASUREMENT
/begin MEASUREMENT DINH_stFId.FId_Layer_STAT_ANHAENGER "" UBYTE DFC_OneToOne 1 100 0.00 255.0 ECU_ADDRESS 0xD0003B08 /end MEASUREMENT
/begin MEASUREMENT DINH_stFId.FId_Layer_STAT_EKP "" UBYTE DFC_OneToOne 1 100 0.00 255.0 ECU_ADDRESS 0xD0003B09 /end MEASUREMENT
/begin MEASUREMENT DINH_stFId.FId_Layer_UHRZEIT_DATUM "" UBYTE DFC_OneToOne 1 100 0.00 255.0 ECU_ADDRESS 0xD0003B0A /end MEASUREMENT
/begin MEASUREMENT DINH_stFId.FId_Layer_ULCP "" UBYTE DFC_OneToOne 1 100 0.00 255.0 ECU_ADDRESS 0xD0003B0B /end MEASUREMENT
/begin MEASUREMENT DINH_stFId.FId_Layer_VCAN11 "" UBYTE DFC_OneToOne 1 100 0.00 255.0 ECU_ADDRESS 0xD0003B0C /end MEASUREMENT
/begin MEASUREMENT DINH_stFId.FId_Layer_VERBRAUCHER "" UBYTE DFC_OneToOne 1 100 0.00 255.0 ECU_ADDRESS 0xD0003B0D /end MEASUREMENT
/begin MEASUREMENT DINH_stFId.FId_Layer_WAERMESTROMKLIMA "" UBYTE DFC_OneToOne 1 100 0.00 255.0 ECU_ADDRESS 0xD0003B0E /end MEASUREMENT
/begin MEASUREMENT DINH_stFId.FId_LubmOil "" UBYTE DFC_OneToOne 1 100 0.00 255.0 ECU_ADDRESS 0xD0003B0F /end MEASUREMENT
/begin MEASUREMENT DINH_stFId.FId_MeUnActrTst "FId/FID status zum verriegeln der MeUn Actuator Test Funktion" UBYTE DFC_OneToOne 1 100 0.00 255.0 ECU_ADDRESS 0xD0003B10 /end MEASUREMENT
/begin MEASUREMENT DINH_stFId.FId_MeUnFrzI "FId/FId Status zum Einfrieren des I Anteils des Stromreglers der MeUn" UBYTE DFC_OneToOne 1 100 0.00 255.0 ECU_ADDRESS 0xD0003B11 /end MEASUREMENT
/begin MEASUREMENT DINH_stFId.FId_MeUnRot "FId/Statud des FId zum verriegeln der MeUn Rotation" UBYTE DFC_OneToOne 1 100 0.00 255.0 ECU_ADDRESS 0xD0003B12 /end MEASUREMENT
/begin MEASUREMENT DINH_stFId.FId_MetCtl "" UBYTE DFC_OneToOne 1 100 0.00 255.0 ECU_ADDRESS 0xD0003B13 /end MEASUREMENT
/begin MEASUREMENT DINH_stFId.FId_NSCDsAdapEep "FId/Status des Funktions Identifiers FId_NSCDsAdapEep" UBYTE DFC_OneToOne 1 100 0.00 255.0 ECU_ADDRESS 0xD0003B14 /end MEASUREMENT
/begin MEASUREMENT DINH_stFId.FId_NSCDsCmpChk "FId/Status des Funktions Identifiers FId_NSCDsCmpChk" UBYTE DFC_OneToOne 1 100 0.00 255.0 ECU_ADDRESS 0xD0003B15 /end MEASUREMENT
/begin MEASUREMENT DINH_stFId.FId_NSCDsNOx "FId/Status des Funktions Identifiers FId_NSCDsNOx" UBYTE DFC_OneToOne 1 100 0.00 255.0 ECU_ADDRESS 0xD0003B16 /end MEASUREMENT
/begin MEASUREMENT DINH_stFId.FId_NSCDsOvrRunPlaus "FId/Status des Funktions Identifiers FId_NSCDsOvrRunPlaus" UBYTE DFC_OneToOne 1 100 0.00 255.0 ECU_ADDRESS 0xD0003B17 /end MEASUREMENT
/begin MEASUREMENT DINH_stFId.FId_NSCDsRdy "FId/Status des Funktions Identifiers FId_NSCDsRdy" UBYTE DFC_OneToOne 1 100 0.00 255.0 ECU_ADDRESS 0xD0003B18 /end MEASUREMENT
/begin MEASUREMENT DINH_stFId.FId_NSCDsSensDia "FId/Status des Funktions Identifiers FId_NSCDsSensDia" UBYTE DFC_OneToOne 1 100 0.00 255.0 ECU_ADDRESS 0xD0003B19 /end MEASUREMENT
/begin MEASUREMENT DINH_stFId.FId_NSCDsTO "FId/Status des Funktions Identifiers FId_NSCDsTO" UBYTE DFC_OneToOne 1 100 0.00 255.0 ECU_ADDRESS 0xD0003B1A /end MEASUREMENT
/begin MEASUREMENT DINH_stFId.FId_NoCat2DsAdap "FId/Status des Funktions Identifiers FId_NoCat2DsAdap" UBYTE DFC_OneToOne 1 100 0.00 255.0 ECU_ADDRESS 0xD0003B1B /end MEASUREMENT
/begin MEASUREMENT DINH_stFId.FId_NoCat2DsAdapEep "FId/Status des Funktions Identifiers FId_NoCat2DsAdapEep" UBYTE DFC_OneToOne 1 100 0.00 255.0 ECU_ADDRESS 0xD0003B1C /end MEASUREMENT
/begin MEASUREMENT DINH_stFId.FId_NoCat2DsCmpChk "FId/Status des Funktions Identifiers FId_NoCat2DsCmpChk" UBYTE DFC_OneToOne 1 100 0.00 255.0 ECU_ADDRESS 0xD0003B1D /end MEASUREMENT
/begin MEASUREMENT DINH_stFId.FId_NoCat2DsNOx "FId/Status des Funktions Identifiers FId_NoCat2DsNOx" UBYTE DFC_OneToOne 1 100 0.00 255.0 ECU_ADDRESS 0xD0003B1E /end MEASUREMENT
/begin MEASUREMENT DINH_stFId.FId_NoCat2DsOvrRunPlaus "FId/Status des Funktions Identifiers FId_NoCat2DsOvrRunPlaus" UBYTE DFC_OneToOne 1 100 0.00 255.0 ECU_ADDRESS 0xD0003B1F /end MEASUREMENT
/begin MEASUREMENT DINH_stFId.FId_NoCat2DsRdy "FId/Status des Funktions Identifiers FId_NoCat2DsRdy" UBYTE DFC_OneToOne 1 100 0.00 255.0 ECU_ADDRESS 0xD0003B20 /end MEASUREMENT
/begin MEASUREMENT DINH_stFId.FId_NoCat2DsSensDia "FId/Status des Funktions Identifiers FId_NoCat2DsSensDia" UBYTE DFC_OneToOne 1 100 0.00 255.0 ECU_ADDRESS 0xD0003B21 /end MEASUREMENT
/begin MEASUREMENT DINH_stFId.FId_NoCat2DsTO "FId/Status des Funktions Identifiers FId_NoCat2DsTO" UBYTE DFC_OneToOne 1 100 0.00 255.0 ECU_ADDRESS 0xD0003B22 /end MEASUREMENT
/begin MEASUREMENT DINH_stFId.FId_NoPresCtl "" UBYTE DFC_OneToOne 1 100 0.00 255.0 ECU_ADDRESS 0xD0003B23 /end MEASUREMENT
/begin MEASUREMENT DINH_stFId.FId_NplPresSensPPFltDiff "FId/Status des Funktions Identifiers FId_NplPresSensPPFltDiff" UBYTE DFC_OneToOne 1 100 0.00 255.0 ECU_ADDRESS 0xD0003B24 /end MEASUREMENT
/begin MEASUREMENT DINH_stFId.FId_NplTOxiCatUs "FId/Status des Funktions Identifiers FId_NplTOxiCatUs" UBYTE DFC_OneToOne 1 100 0.00 255.0 ECU_ADDRESS 0xD0003B25 /end MEASUREMENT
/begin MEASUREMENT DINH_stFId.FId_NplTPFltUs "FId/Status des Funktions Identifiers FId_NplTPFltUs" UBYTE DFC_OneToOne 1 100 0.00 255.0 ECU_ADDRESS 0xD0003B26 /end MEASUREMENT
/begin MEASUREMENT DINH_stFId.FId_OilPLmpVOff "" UBYTE DFC_OneToOne 1 100 0.00 255.0 ECU_ADDRESS 0xD0003B27 /end MEASUREMENT
/begin MEASUREMENT DINH_stFId.FId_OilPSwmpRplVal "" UBYTE DFC_OneToOne 1 100 0.00 255.0 ECU_ADDRESS 0xD0003B28 /end MEASUREMENT
/begin MEASUREMENT DINH_stFId.FId_PCBSDef "" UBYTE DFC_OneToOne 1 100 0.00 255.0 ECU_ADDRESS 0xD0003B29 /end MEASUREMENT
/begin MEASUREMENT DINH_stFId.FId_PCBSPFltDef "" UBYTE DFC_OneToOne 1 100 0.00 255.0 ECU_ADDRESS 0xD0003B2A /end MEASUREMENT
/begin MEASUREMENT DINH_stFId.FId_PCR "FId/Status des Funktions Identifiers FId_PCR" UBYTE DFC_OneToOne 1 100 0.00 255.0 ECU_ADDRESS 0xD0003B2B /end MEASUREMENT
/begin MEASUREMENT DINH_stFId.FId_PCRCByVlvOff "FId/Status des Funktions Identifiers FId_PCRCByVlvOff" UBYTE DFC_OneToOne 1 100 0.00 255.0 ECU_ADDRESS 0xD0003B2C /end MEASUREMENT
/begin MEASUREMENT DINH_stFId.FId_PCRClthActv "" UBYTE DFC_OneToOne 1 100 0.00 255.0 ECU_ADDRESS 0xD0003B2D /end MEASUREMENT
/begin MEASUREMENT DINH_stFId.FId_PCRCmpntActv "FId/Status des Funktions Identifiers FId_PCRCmpntActv" UBYTE DFC_OneToOne 1 100 0.00 255.0 ECU_ADDRESS 0xD0003B2E /end MEASUREMENT
/begin MEASUREMENT DINH_stFId.FId_PCRCmpntActvLP "FId/Status des Funktions Identifiers FId_PCRCmpntActvLP" UBYTE DFC_OneToOne 1 100 0.00 255.0 ECU_ADDRESS 0xD0003B2F /end MEASUREMENT
/begin MEASUREMENT DINH_stFId.FId_PCRExtnLimActr "FId/Status des Funktions Identifiers FId_PCRExtnLimActr" UBYTE DFC_OneToOne 1 100 0.00 255.0 ECU_ADDRESS 0xD0003B30 /end MEASUREMENT
/begin MEASUREMENT DINH_stFId.FId_PCRGovDvt "FId/Status des Funktions Identifiers FId_PCRGovDvt" UBYTE DFC_OneToOne 1 100 0.00 255.0 ECU_ADDRESS 0xD0003B31 /end MEASUREMENT
/begin MEASUREMENT DINH_stFId.FId_PCRGovDvtLP "FId/Status des Funktions Identifiers FId_PCRGovDvtLP" UBYTE DFC_OneToOne 1 100 0.00 255.0 ECU_ADDRESS 0xD0003B32 /end MEASUREMENT
/begin MEASUREMENT DINH_stFId.FId_PCRLP "FId/Status des Funktions Identifiers FId_PCRLP" UBYTE DFC_OneToOne 1 100 0.00 255.0 ECU_ADDRESS 0xD0003B33 /end MEASUREMENT
/begin MEASUREMENT DINH_stFId.FId_PCROfsRls "FId/Status des Funktions Identifiers FId_PCROfsRls" UBYTE DFC_OneToOne 1 100 0.00 255.0 ECU_ADDRESS 0xD0003B34 /end MEASUREMENT
/begin MEASUREMENT DINH_stFId.FId_PCRPFltPresCor "FId/Status des Funktions Identifiers FId_PCRPFltPresCor" UBYTE DFC_OneToOne 1 100 0.00 255.0 ECU_ADDRESS 0xD0003B35 /end MEASUREMENT
/begin MEASUREMENT DINH_stFId.FId_PCRT20 "" UBYTE DFC_OneToOne 1 100 0.00 255.0 ECU_ADDRESS 0xD0003B36 /end MEASUREMENT
/begin MEASUREMENT DINH_stFId.FId_PCRTrbCh "" UBYTE DFC_OneToOne 1 100 0.00 255.0 ECU_ADDRESS 0xD0003B37 /end MEASUREMENT
/begin MEASUREMENT DINH_stFId.FId_PCVActrTst "FId/Ersatzreaktion: der Druckregelventiltest wird nicht ausgeführt" UBYTE DFC_OneToOne 1 100 0.00 255.0 ECU_ADDRESS 0xD0003B38 /end MEASUREMENT
/begin MEASUREMENT DINH_stFId.FId_PCVFrzI "FId/Status des FId zum Verhindern des PCV Actuator Test" UBYTE DFC_OneToOne 1 100 0.00 255.0 ECU_ADDRESS 0xD0003B39 /end MEASUREMENT
/begin MEASUREMENT DINH_stFId.FId_PCVNoStrt "FId/Ersatzreaktion:detektiert misslungene Startversuche wegen fehlerhafter Komponenten außerhalb des Druckregelventils" UBYTE DFC_OneToOne 1 100 0.00 255.0 ECU_ADDRESS 0xD0003B3A /end MEASUREMENT
/begin MEASUREMENT DINH_stFId.FId_PCVPwrStgTst "FId/Status des FId_PCVPwrStgTst zum verriegeln des PCV Powerstage Test" UBYTE DFC_OneToOne 1 100 0.00 255.0 ECU_ADDRESS 0xD0003B3B /end MEASUREMENT
/begin MEASUREMENT DINH_stFId.FId_PFltAirSysFail "FId/Ersatzreaktion: Fehler des Luftsystems wird gemeldet" UBYTE DFC_OneToOne 1 100 0.00 255.0 ECU_ADDRESS 0xD0003B3C /end MEASUREMENT
/begin MEASUREMENT DINH_stFId.FId_PFltChar "FId/Ersatzreaktion:: die Überwachung der Partikelfilter-Charakteristik mit Hilfe des Differenzdrucks wird nicht durchgeführt" UBYTE DFC_OneToOne 1 100 0.00 255.0 ECU_ADDRESS 0xD0003B3D /end MEASUREMENT
/begin MEASUREMENT DINH_stFId.FId_PFltComLSum "" UBYTE DFC_OneToOne 1 100 0.00 255.0 ECU_ADDRESS 0xD0003B3E /end MEASUREMENT
/begin MEASUREMENT DINH_stFId.FId_PFltDstr "FId/Ersatzreaktion: Überwachung auf zerstörten Partikelfilter wird nicht durchgeführt" UBYTE DFC_OneToOne 1 100 0.00 255.0 ECU_ADDRESS 0xD0003B3F /end MEASUREMENT
/begin MEASUREMENT DINH_stFId.FId_PFltEngPrtRgnMon "" UBYTE DFC_OneToOne 1 100 0.00 255.0 ECU_ADDRESS 0xD0003B40 /end MEASUREMENT
/begin MEASUREMENT DINH_stFId.FId_PFltLckRgnErr "FId/Ersatzreaktion: ein applizierbares Ersatz-Array wird verwendet, um die Regenerationssperrzeit festzulegen." UBYTE DFC_OneToOne 1 100 0.00 255.0 ECU_ADDRESS 0xD0003B41 /end MEASUREMENT
/begin MEASUREMENT DINH_stFId.FId_PFltLckRgnFl "FId/Ersatzreaktion: die Unterbrechung einer Regeneration wird verhindert, da der Tankfüllstand zu niedrig ist" UBYTE DFC_OneToOne 1 100 0.00 255.0 ECU_ADDRESS 0xD0003B42 /end MEASUREMENT
/begin MEASUREMENT DINH_stFId.FId_PFltLckRgnOilDil "FId/Ersatzreaktion: die ölverdünnende Partikelfilter-Regenerationsstufen werden gesperrt" UBYTE DFC_OneToOne 1 100 0.00 255.0 ECU_ADDRESS 0xD0003B43 /end MEASUREMENT
/begin MEASUREMENT DINH_stFId.FId_PFltLdAshCor "FId/Status des Funktions Identifiers FId_PFltLdAshCor" UBYTE DFC_OneToOne 1 100 0.00 255.0 ECU_ADDRESS 0xD0003B44 /end MEASUREMENT
/begin MEASUREMENT DINH_stFId.FId_PFltLdAshCorErr "" UBYTE DFC_OneToOne 1 100 0.00 255.0 ECU_ADDRESS 0xD0003B45 /end MEASUREMENT
/begin MEASUREMENT DINH_stFId.FId_PFltLdIniAftSuc "" UBYTE DFC_OneToOne 1 100 0.00 255.0 ECU_ADDRESS 0xD0003B46 /end MEASUREMENT
/begin MEASUREMENT DINH_stFId.FId_PFltLdNOxEng "" UBYTE DFC_OneToOne 1 100 0.00 255.0 ECU_ADDRESS 0xD0003B47 /end MEASUREMENT
/begin MEASUREMENT DINH_stFId.FId_PFltLdO2Aprx "FId/Ersatzreaktion: Sauerstoffmassenstrom und Lambda werden approximiert" UBYTE DFC_OneToOne 1 100 0.00 255.0 ECU_ADDRESS 0xD0003B48 /end MEASUREMENT
/begin MEASUREMENT DINH_stFId.FId_PFltLdSimRgnThr "FId/Ersatzreaktion: die Integratoren der Rußmassensimulation werden nach einer erfolgreichen Regeneration mit dem Wert der Restrußmassenberechnung initialisiert" UBYTE DFC_OneToOne 1 100 0.00 255.0 ECU_ADDRESS 0xD0003B49 /end MEASUREMENT
/begin MEASUREMENT DINH_stFId.FId_PFltOvldHealInhRn "" UBYTE DFC_OneToOne 1 100 0.00 255.0 ECU_ADDRESS 0xD0003B4A /end MEASUREMENT
/begin MEASUREMENT DINH_stFId.FId_PFltOvldHealTrqLm "" UBYTE DFC_OneToOne 1 100 0.00 255.0 ECU_ADDRESS 0xD0003B4B /end MEASUREMENT
/begin MEASUREMENT DINH_stFId.FId_PFltPOpBrk "FId/Ersatzreaktion: die Verwendung des Bremsssignals bei der Bereichsüberprüfung wird unterbunden" UBYTE DFC_OneToOne 1 100 0.00 255.0 ECU_ADDRESS 0xD0003B4C /end MEASUREMENT
/begin MEASUREMENT DINH_stFId.FId_PFltPOpClth "FId/Ersatzreaktion: die Verwendung des Kupplungssignals bei der Bereichsüberprüfung wird unterbunden" UBYTE DFC_OneToOne 1 100 0.00 255.0 ECU_ADDRESS 0xD0003B4D /end MEASUREMENT
/begin MEASUREMENT DINH_stFId.FId_PFltPOpGearDet "FId/Ersatzreaktion: die Verwendung des Gangsignalss bei der Bereichsüberprüfung wird unterbunden" UBYTE DFC_OneToOne 1 100 0.00 255.0 ECU_ADDRESS 0xD0003B4E /end MEASUREMENT
/begin MEASUREMENT DINH_stFId.FId_PFltPOpSpdVeh "FId/Ersatzreaktion: die Verwendung der Fahrzeuggeschwindigkeit bei der Bereichsüberprüfung wird unterbunden" UBYTE DFC_OneToOne 1 100 0.00 255.0 ECU_ADDRESS 0xD0003B4F /end MEASUREMENT
/begin MEASUREMENT DINH_stFId.FId_PFltPOpTempAir "FId/Ersatzreaktion: die Verwendung der Ansauglufttemperatur bei der Bereichsüberprüfung wird unterbunden" UBYTE DFC_OneToOne 1 100 0.00 255.0 ECU_ADDRESS 0xD0003B50 /end MEASUREMENT
/begin MEASUREMENT DINH_stFId.FId_PFltPOpTempClnt "FId/Ersatzreaktion: die Verwendung der Kühlmitteltemperatur bei der Bereichsüberprüfung wird unterbunden" UBYTE DFC_OneToOne 1 100 0.00 255.0 ECU_ADDRESS 0xD0003B51 /end MEASUREMENT
/begin MEASUREMENT DINH_stFId.FId_PFltPOpVltgBatt "FId/Ersatzreaktion: die Verwendung der Batteriespannung bei der Bereichsüberprüfung wird unterbunden" UBYTE DFC_OneToOne 1 100 0.00 255.0 ECU_ADDRESS 0xD0003B52 /end MEASUREMENT
/begin MEASUREMENT DINH_stFId.FId_PFltPoI1Fail "FId/Ersatzreaktion: Systemfehler bzgl. der späten Nacheinspritzung wird gemeldet" UBYTE DFC_OneToOne 1 100 0.00 255.0 ECU_ADDRESS 0xD0003B53 /end MEASUREMENT
/begin MEASUREMENT DINH_stFId.FId_PFltPoI2Fail "FId/Ersatzreaktion: Systemfehler bzgl. der angelagerten Nacheinspritzung wird gemeldet" UBYTE DFC_OneToOne 1 100 0.00 255.0 ECU_ADDRESS 0xD0003B54 /end MEASUREMENT
/begin MEASUREMENT DINH_stFId.FId_PFltPresPlausProj "" UBYTE DFC_OneToOne 1 100 0.00 255.0 ECU_ADDRESS 0xD0003B55 /end MEASUREMENT
/begin MEASUREMENT DINH_stFId.FId_PFltRgnChngPar "FId/Ersatzreaktion: für die Berechnung von Kraftstoffverbrauch, Betriebsstunden und gefahrener Strecke seit der letzten erfolgreichen Regeneration wird auf einen Ersatz-Parametersatz von Maximalwerten umgeschaltet" UBYTE DFC_OneToOne 1 100 0.00 255.0 ECU_ADDRESS 0xD0003B56 /end MEASUREMENT
/begin MEASUREMENT DINH_stFId.FId_PFltRgnNoSucDet "" UBYTE DFC_OneToOne 1 100 0.00 255.0 ECU_ADDRESS 0xD0003B57 /end MEASUREMENT
/begin MEASUREMENT DINH_stFId.FId_PFltRgnNumErrLck "" UBYTE DFC_OneToOne 1 100 0.00 255.0 ECU_ADDRESS 0xD0003B58 /end MEASUREMENT
/begin MEASUREMENT DINH_stFId.FId_PFltRgnNumPFltErr "" UBYTE DFC_OneToOne 1 100 0.00 255.0 ECU_ADDRESS 0xD0003B59 /end MEASUREMENT
/begin MEASUREMENT DINH_stFId.FId_PFltRgnSuc "" UBYTE DFC_OneToOne 1 100 0.00 255.0 ECU_ADDRESS 0xD0003B5A /end MEASUREMENT
/begin MEASUREMENT DINH_stFId.FId_PFltSimOn "FId/Ersatzreaktion: die Rußbeladungsmessung wird deaktiviert und damit auf Rußbeladungssimulation umgeschaltet." UBYTE DFC_OneToOne 1 100 0.00 255.0 ECU_ADDRESS 0xD0003B5B /end MEASUREMENT
/begin MEASUREMENT DINH_stFId.FId_PFltSysErr2Can "" UBYTE DFC_OneToOne 1 100 0.00 255.0 ECU_ADDRESS 0xD0003B5C /end MEASUREMENT
/begin MEASUREMENT DINH_stFId.FId_PFltSysFail "FId/Ersatzreaktion: Allgemeiner Systemfehler wird gemeldet" UBYTE DFC_OneToOne 1 100 0.00 255.0 ECU_ADDRESS 0xD0003B5D /end MEASUREMENT
/begin MEASUREMENT DINH_stFId.FId_PFltTOxiPreDiff "" UBYTE DFC_OneToOne 1 100 0.00 255.0 ECU_ADDRESS 0xD0003B5E /end MEASUREMENT
/begin MEASUREMENT DINH_stFId.FId_PFltTPreDiff "" UBYTE DFC_OneToOne 1 100 0.00 255.0 ECU_ADDRESS 0xD0003B5F /end MEASUREMENT
/begin MEASUREMENT DINH_stFId.FId_PIntkVUsEnvPPls "FId/Status des Funktions Identifiers FId_PIntkVUsEnvPPls" UBYTE DFC_OneToOne 1 100 0.00 255.0 ECU_ADDRESS 0xD0003B60 /end MEASUREMENT
/begin MEASUREMENT DINH_stFId.FId_PIntkVUsFrzVal "FId/Status des Funktions Identifiers FId_PIntkVUsFrzVal" UBYTE DFC_OneToOne 1 100 0.00 255.0 ECU_ADDRESS 0xD0003B61 /end MEASUREMENT
/begin MEASUREMENT DINH_stFId.FId_PIntkVUsRplVal "FId/Status des Funktions Identifiers FId_PIntkVUsRplVal" UBYTE DFC_OneToOne 1 100 0.00 255.0 ECU_ADDRESS 0xD0003B62 /end MEASUREMENT
/begin MEASUREMENT DINH_stFId.FId_PTCltDKG "" UBYTE DFC_OneToOne 1 100 0.00 255.0 ECU_ADDRESS 0xD0003B63 /end MEASUREMENT
/begin MEASUREMENT DINH_stFId.FId_PTGripDebPtd "FId/Status des Funktions Identifiers FId_PTGripDebPtd" UBYTE DFC_OneToOne 1 100 0.00 255.0 ECU_ADDRESS 0xD0003B64 /end MEASUREMENT
/begin MEASUREMENT DINH_stFId.FId_PTTrqRatCANPtd "FId/Status des Funktions Identifiers FId_PTTrqRatCANPtd" UBYTE DFC_OneToOne 1 100 0.00 255.0 ECU_ADDRESS 0xD0003B65 /end MEASUREMENT
/begin MEASUREMENT DINH_stFId.FId_PhyModPCRCorr "" UBYTE DFC_OneToOne 1 100 0.00 255.0 ECU_ADDRESS 0xD0003B66 /end MEASUREMENT
/begin MEASUREMENT DINH_stFId.FId_PlausTTrbnUs "FId/Status des Funktions Identifiers FId_PlausTTrbnUs" UBYTE DFC_OneToOne 1 100 0.00 255.0 ECU_ADDRESS 0xD0003B67 /end MEASUREMENT
/begin MEASUREMENT DINH_stFId.FId_PresBuildUp "" UBYTE DFC_OneToOne 1 100 0.00 255.0 ECU_ADDRESS 0xD0003B68 /end MEASUREMENT
/begin MEASUREMENT DINH_stFId.FId_PresCtl "" UBYTE DFC_OneToOne 1 100 0.00 255.0 ECU_ADDRESS 0xD0003B69 /end MEASUREMENT
/begin MEASUREMENT DINH_stFId.FId_PresRdc "" UBYTE DFC_OneToOne 1 100 0.00 255.0 ECU_ADDRESS 0xD0003B6A /end MEASUREMENT
/begin MEASUREMENT DINH_stFId.FId_PresSensFrzPPFltUs "FId/Status des Funktions Identifiers FId_PresSensFrzPPFltUs" UBYTE DFC_OneToOne 1 100 0.00 255.0 ECU_ADDRESS 0xD0003B6B /end MEASUREMENT
/begin MEASUREMENT DINH_stFId.FId_QWCCTSDef "FId/Verriegelung bei Ausfall des Kühlmitteltemperatursensors" UBYTE DFC_OneToOne 1 100 0.00 255.0 ECU_ADDRESS 0xD0003B6C /end MEASUREMENT
/begin MEASUREMENT DINH_stFId.FId_QWCFTSDef "FId/Verriegelung bei Ausfall des Kraftstofftemperatursensors" UBYTE DFC_OneToOne 1 100 0.00 255.0 ECU_ADDRESS 0xD0003B6D /end MEASUREMENT
/begin MEASUREMENT DINH_stFId.FId_QWCOff "FId/Verriegelung der QWC, wenn nicht freigegeben" UBYTE DFC_OneToOne 1 100 0.00 255.0 ECU_ADDRESS 0xD0003B6E /end MEASUREMENT
/begin MEASUREMENT DINH_stFId.FId_RadShtCTS "FId/Status des Funktions Identifiers FId_RadShtCTS" UBYTE DFC_OneToOne 1 100 0.00 255.0 ECU_ADDRESS 0xD0003B6F /end MEASUREMENT
/begin MEASUREMENT DINH_stFId.FId_RadShtConsum "" UBYTE DFC_OneToOne 1 100 0.00 255.0 ECU_ADDRESS 0xD0003B70 /end MEASUREMENT
/begin MEASUREMENT DINH_stFId.FId_RadShtEGS "FId/Status des Funktions Identifiers FId_RadShtEGS" UBYTE DFC_OneToOne 1 100 0.00 255.0 ECU_ADDRESS 0xD0003B71 /end MEASUREMENT
/begin MEASUREMENT DINH_stFId.FId_RadShtEnvT "" UBYTE DFC_OneToOne 1 100 0.00 255.0 ECU_ADDRESS 0xD0003B72 /end MEASUREMENT
/begin MEASUREMENT DINH_stFId.FId_RadShtstTrailer "" UBYTE DFC_OneToOne 1 100 0.00 255.0 ECU_ADDRESS 0xD0003B73 /end MEASUREMENT
/begin MEASUREMENT DINH_stFId.FId_RailCPCtlMeUnMode "FId/Fid zur Aktivierung der Überwachung von der CPC-Umschaltung zur Regelung über MeUn" UBYTE DFC_OneToOne 1 100 0.00 255.0 ECU_ADDRESS 0xD0003B74 /end MEASUREMENT
/begin MEASUREMENT DINH_stFId.FId_RailCPCtlPCVMode "FId/Fid zur Aktivierung der Überwachung von der CPC-Umschaltung zur Regelung über PCV" UBYTE DFC_OneToOne 1 100 0.00 255.0 ECU_ADDRESS 0xD0003B75 /end MEASUREMENT
/begin MEASUREMENT DINH_stFId.FId_RailCtlMode "FId/allgemeine Funktionsverriegelung für die Druckregelung" UBYTE DFC_OneToOne 1 100 0.00 255.0 ECU_ADDRESS 0xD0003B76 /end MEASUREMENT
/begin MEASUREMENT DINH_stFId.FId_RailFuelTErr "FId/Status des Funktions Identifiers FId_RailFuelTErr" UBYTE DFC_OneToOne 1 100 0.00 255.0 ECU_ADDRESS 0xD0003B77 /end MEASUREMENT
/begin MEASUREMENT DINH_stFId.FId_RailHpTst "FId/Ersatzreaktion: der Hochdrucktest wird nicht ausgeführt" UBYTE DFC_OneToOne 1 100 0.00 255.0 ECU_ADDRESS 0xD0003B78 /end MEASUREMENT
/begin MEASUREMENT DINH_stFId.FId_RailMeUn0Blk "FId/Funktionsidentifizierer zur Verriegelung der Überwachung auf positive Regelabweichung" UBYTE DFC_OneToOne 1 100 0.00 255.0 ECU_ADDRESS 0xD0003B79 /end MEASUREMENT
/begin MEASUREMENT DINH_stFId.FId_RailMeUn0Rls "FId/Funktionsidentifizierer zur Freigabe der Überwachung auf positive Regelabweichung" UBYTE DFC_OneToOne 1 100 0.00 255.0 ECU_ADDRESS 0xD0003B7A /end MEASUREMENT
/begin MEASUREMENT DINH_stFId.FId_RailMeUn1Blk "FId/Fid zur Verriegelung der Überwachung auf positive Regelabweichung und Sollwert des Volumenstroms d. Zumesseinheit" UBYTE DFC_OneToOne 1 100 0.00 255.0 ECU_ADDRESS 0xD0003B7B /end MEASUREMENT
/begin MEASUREMENT DINH_stFId.FId_RailMeUn1Rls "FId/Fid zur Freigabe der Überwachung auf positive Regelabweichung und Sollwert des Volumenstroms d. Zumesseinheit" UBYTE DFC_OneToOne 1 100 0.00 255.0 ECU_ADDRESS 0xD0003B7C /end MEASUREMENT
/begin MEASUREMENT DINH_stFId.FId_RailMeUn22Blk "FId/Abschalten der Überwachung der negativen Raildruckabweichung mit MeUn (2.Stufe)" UBYTE DFC_OneToOne 1 100 0.00 255.0 ECU_ADDRESS 0xD0003B7D /end MEASUREMENT
/begin MEASUREMENT DINH_stFId.FId_RailMeUn22Rls "FId/Einschalten der Überwachung der negativen Raildruckabweichung mit MeUn (2.Stufe)" UBYTE DFC_OneToOne 1 100 0.00 255.0 ECU_ADDRESS 0xD0003B7E /end MEASUREMENT
/begin MEASUREMENT DINH_stFId.FId_RailMeUn2Blk "FId/Fehleridentifier zur Verriegelung der Überwachung auf negative Regelabweichung bei Nullförderung" UBYTE DFC_OneToOne 1 100 0.00 255.0 ECU_ADDRESS 0xD0003B7F /end MEASUREMENT
/begin MEASUREMENT DINH_stFId.FId_RailMeUn2Rls "FId/Fehleridentifier zur Freigabe der Überwachung auf negative Regelabweichung bei Nullförderung" UBYTE DFC_OneToOne 1 100 0.00 255.0 ECU_ADDRESS 0xD0003B80 /end MEASUREMENT
/begin MEASUREMENT DINH_stFId.FId_RailMeUn3Blk "FId/Fehleridentifier zur Verriegelung der Überwachung auf minimalen Raildruck" UBYTE DFC_OneToOne 1 100 0.00 255.0 ECU_ADDRESS 0xD0003B81 /end MEASUREMENT
/begin MEASUREMENT DINH_stFId.FId_RailMeUn3Rls "FId/Fehleridentifier zur Freigabe der Überwachung auf minimalen Raildruck" UBYTE DFC_OneToOne 1 100 0.00 255.0 ECU_ADDRESS 0xD0003B82 /end MEASUREMENT
/begin MEASUREMENT DINH_stFId.FId_RailMeUn42Blk "FId/Fehleridentifier zur Verriegelung der Überwachung auf maximalen Raildruck (zweite Stufe)" UBYTE DFC_OneToOne 1 100 0.00 255.0 ECU_ADDRESS 0xD0003B83 /end MEASUREMENT
/begin MEASUREMENT DINH_stFId.FId_RailMeUn42Rls "FId/Fehleridentifier zur Freigabe der Überwachung auf maximalen Raildruck (zweite Stufe)" UBYTE DFC_OneToOne 1 100 0.00 255.0 ECU_ADDRESS 0xD0003B84 /end MEASUREMENT
/begin MEASUREMENT DINH_stFId.FId_RailMeUn4Blk "FId/Fehleridentifier zur Verriegelung der Überwachung auf maximalen Raildruck" UBYTE DFC_OneToOne 1 100 0.00 255.0 ECU_ADDRESS 0xD0003B85 /end MEASUREMENT
/begin MEASUREMENT DINH_stFId.FId_RailMeUn4Rls "FId/Fehleridentifier zur Freigabe der Überwachung auf maximalen Raildruck" UBYTE DFC_OneToOne 1 100 0.00 255.0 ECU_ADDRESS 0xD0003B86 /end MEASUREMENT
/begin MEASUREMENT DINH_stFId.FId_RailMeUn5Blk "FId/FId zum Abschalten der Überwachung der positiven Raildruckabweichung" UBYTE DFC_OneToOne 1 100 0.00 255.0 ECU_ADDRESS 0xD0003B87 /end MEASUREMENT
/begin MEASUREMENT DINH_stFId.FId_RailMeUn5Rls "FId/FId zum Einschalten der Überwachung der positiven Raildruckabweichung" UBYTE DFC_OneToOne 1 100 0.00 255.0 ECU_ADDRESS 0xD0003B88 /end MEASUREMENT
/begin MEASUREMENT DINH_stFId.FId_RailMeUnClsdShutOff "FId/Fehlerverriegelung für das Schliessen der Zumesseinheit" UBYTE DFC_OneToOne 1 100 0.00 255.0 ECU_ADDRESS 0xD0003B89 /end MEASUREMENT
/begin MEASUREMENT DINH_stFId.FId_RailMeUnCtlMode "FId/Funktionsidentifizierer für die Druckregelung über Zumesseinheit" UBYTE DFC_OneToOne 1 100 0.00 255.0 ECU_ADDRESS 0xD0003B8A /end MEASUREMENT
/begin MEASUREMENT DINH_stFId.FId_RailMeUnCtlUpLim "FId/FId zur Umschaltung auf ein oberes festes Limit des Volumenflusses" UBYTE DFC_OneToOne 1 100 0.00 255.0 ECU_ADDRESS 0xD0003B8B /end MEASUREMENT
/begin MEASUREMENT DINH_stFId.FId_RailPCV0Blk "FId/Funktionsidentifizierer zur Verriegelung der Überwachung auf positive Regelabweichung" UBYTE DFC_OneToOne 1 100 0.00 255.0 ECU_ADDRESS 0xD0003B8C /end MEASUREMENT
/begin MEASUREMENT DINH_stFId.FId_RailPCV0Rls "FId/Fehleridentifier zur Freigabe der Überwachung auf positive Regelabweichung" UBYTE DFC_OneToOne 1 100 0.00 255.0 ECU_ADDRESS 0xD0003B8D /end MEASUREMENT
/begin MEASUREMENT DINH_stFId.FId_RailPCV1Blk "FId/Fehleridentifier zur Verriegelung der Überwachung auf positive Regelabweichung kombiniert mit Stellgröße des Druckregelventils" UBYTE DFC_OneToOne 1 100 0.00 255.0 ECU_ADDRESS 0xD0003B8E /end MEASUREMENT
/begin MEASUREMENT DINH_stFId.FId_RailPCV1Rls "FId/Fehleridentifier zur Freigabe der Überwachung auf positive Regelabweichung kombiniert mit Stellgröße des Druckregelventils" UBYTE DFC_OneToOne 1 100 0.00 255.0 ECU_ADDRESS 0xD0003B8F /end MEASUREMENT
/begin MEASUREMENT DINH_stFId.FId_RailPCV22Blk "FId/Fehleridentifier zur Verriegelung der Überwachung auf negative Regelabweichung kombiniert mit Stellgröße des Druckregelventils (zweite Stufe)" UBYTE DFC_OneToOne 1 100 0.00 255.0 ECU_ADDRESS 0xD0003B90 /end MEASUREMENT
/begin MEASUREMENT DINH_stFId.FId_RailPCV22Rls "FId/Fid zur Freigabe der Überwachung auf negative Regelabweichung kombiniert mit Stellgröße des Druckregelventils (zweite Stufe)" UBYTE DFC_OneToOne 1 100 0.00 255.0 ECU_ADDRESS 0xD0003B91 /end MEASUREMENT
/begin MEASUREMENT DINH_stFId.FId_RailPCV2Blk "FId/Fehleridentifier zur Verriegelung der Überwachung auf negative Regelabweichung kombiniert mit Stellgröße des Druckregelventils" UBYTE DFC_OneToOne 1 100 0.00 255.0 ECU_ADDRESS 0xD0003B92 /end MEASUREMENT
/begin MEASUREMENT DINH_stFId.FId_RailPCV2Rls "FId/Fid zur Freigabe der Überwachung auf negative Regelabweichung kombiniert mit Stellgröße des Druckregelventils" UBYTE DFC_OneToOne 1 100 0.00 255.0 ECU_ADDRESS 0xD0003B93 /end MEASUREMENT
/begin MEASUREMENT DINH_stFId.FId_RailPCV3Blk "FId/Funktionsidentifizierer zur Verriegelung der Überwachung auf minimalen Raildruck" UBYTE DFC_OneToOne 1 100 0.00 255.0 ECU_ADDRESS 0xD0003B94 /end MEASUREMENT
/begin MEASUREMENT DINH_stFId.FId_RailPCV3Rls "FId/Funktionsidentifizierer zur Freigabe der Überwachung auf minimalen Raildruck" UBYTE DFC_OneToOne 1 100 0.00 255.0 ECU_ADDRESS 0xD0003B95 /end MEASUREMENT
/begin MEASUREMENT DINH_stFId.FId_RailPCV42Blk "FId/Funktionsidentifizierer zur Verriegelung der Überwachung auf maximalen Raildruck (zweite Stufe)" UBYTE DFC_OneToOne 1 100 0.00 255.0 ECU_ADDRESS 0xD0003B96 /end MEASUREMENT
/begin MEASUREMENT DINH_stFId.FId_RailPCV42Rls "FId/Funktionsidentifizierer zur Freigabe der Überwachung auf maximalen Raildruck (zweite Stufe)" UBYTE DFC_OneToOne 1 100 0.00 255.0 ECU_ADDRESS 0xD0003B97 /end MEASUREMENT
/begin MEASUREMENT DINH_stFId.FId_RailPCV4Blk "FId/Funktionsidentifizierer zur Verriegelung der Überwachung auf maximalen Raildruck" UBYTE DFC_OneToOne 1 100 0.00 255.0 ECU_ADDRESS 0xD0003B98 /end MEASUREMENT
/begin MEASUREMENT DINH_stFId.FId_RailPCV4Rls "FId/Funktionsidentifizierer zur Freigabe der Überwachung auf maximalen Raildruck" UBYTE DFC_OneToOne 1 100 0.00 255.0 ECU_ADDRESS 0xD0003B99 /end MEASUREMENT
/begin MEASUREMENT DINH_stFId.FId_RailPCVCtlMode "FId/Funktionsidentifizierer für die Druckregelung über Druckregelventil" UBYTE DFC_OneToOne 1 100 0.00 255.0 ECU_ADDRESS 0xD0003B9A /end MEASUREMENT
/begin MEASUREMENT DINH_stFId.FId_RailPCVCtlUpLim "FId/FId zum Umschalten auf eine feste obere Raildruckgrenze" UBYTE DFC_OneToOne 1 100 0.00 255.0 ECU_ADDRESS 0xD0003B9B /end MEASUREMENT
/begin MEASUREMENT DINH_stFId.FId_RailPFrzVal "FId/FId zum Einfrieren des letzten gemessenen Raildruckwertes im Fehlerfall" UBYTE DFC_OneToOne 1 100 0.00 255.0 ECU_ADDRESS 0xD0003B9C /end MEASUREMENT
/begin MEASUREMENT Gensatzsum_akt "Hier könnte Ihr Langbezeichner stehen" UWORD Def_st_uw_q1 1 100 0.00 65535. FORMAT "%5.0" ECU_ADDRESS 0xC0009C2C /end MEASUREMENT
/begin MEASUREMENT Gensatzsum_eintrag "Hier könnte Ihr Langbezeichner stehen" UWORD Def_st_uw_q1 1 100 0.00 65535. FORMAT "%5.0" ECU_ADDRESS 0xC0009C2E /end MEASUREMENT
/begin MEASUREMENT Gen_arraycntx "Hier könnte Ihr Langbezeichner stehen" UBYTE Def_st_ub_q1 1 100 0.00 255. FORMAT "%3.0" ECU_ADDRESS 0xC000B101 /end MEASUREMENT
/begin MEASUREMENT Gen_arraycnty "Hier könnte Ihr Langbezeichner stehen" UBYTE Def_st_ub_q1 1 100 0.00 255. FORMAT "%3.0" ECU_ADDRESS 0xC000B102 /end MEASUREMENT
/begin MEASUREMENT Gen_arraycntz "Hier könnte Ihr Langbezeichner stehen" UBYTE Def_st_ub_q1 1 100 0.00 255. FORMAT "%3.0" ECU_ADDRESS 0xC000B103 /end MEASUREMENT
/begin MEASUREMENT Gen_arraycnt_nv "Hier könnte Ihr Langbezeichner stehen" UBYTE Def_st_ub_q1 1 100 0.00 29. FORMAT "%3.0" ECU_ADDRESS 0xC000B104 /end MEASUREMENT
/begin MEASUREMENT Gen_arrayerr_nv "Hier könnte Ihr Langbezeichner stehen" UBYTE Def_st_ub_q1 1 100 0.00 255. FORMAT "%3.0" ARRAY_SIZE 30 ECU_ADDRESS 0xC000BA94 /end MEASUREMENT
/begin MEASUREMENT Gen_arraygrenzerrnz "Hier könnte Ihr Langbezeichner stehen" UBYTE Def_st_ub_q1 1 100 0.00 255. FORMAT "%3.0" ECU_ADDRESS 0xC000B105 /end MEASUREMENT
/begin MEASUREMENT Gen_arraygrenzerrxy "Hier könnte Ihr Langbezeichner stehen" UBYTE Def_st_ub_q1 1 100 0.00 255. FORMAT "%3.0" ECU_ADDRESS 0xC000B106 /end MEASUREMENT
/begin MEASUREMENT Gen_arraygrenznerrn "Hier könnte Ihr Langbezeichner stehen" UBYTE Def_st_ub_q1 1 100 0.00 255. FORMAT "%3.0" ECU_ADDRESS 0xC000B107 /end MEASUREMENT
/begin MEASUREMENT Gen_arraygrenznz_sum "Hier könnte Ihr Langbezeichner stehen" UWORD Def_i_uw_q0p125 1 100 0.00 8191.875 FORMAT "%8.3" ECU_ADDRESS 0xC0009C30 /end MEASUREMENT
/begin MEASUREMENT Gen_arraygrenzn_sum "Hier könnte Ihr Langbezeichner stehen" UWORD Def_i_uw_q0p125 1 100 0.00 8191.875 FORMAT "%8.3" ECU_ADDRESS 0xC0009C32 /end MEASUREMENT
/begin MEASUREMENT Gen_arraygrenzxy_sum "Hier könnte Ihr Langbezeichner stehen" UWORD Def_i_uw_q0p125 1 100 0.00 8191.875 FORMAT "%8.3" ECU_ADDRESS 0xC0009C34 /end MEASUREMENT
/begin MEASUREMENT Gen_arrayierrg_nv "Hier könnte Ihr Langbezeichner stehen" UBYTE Def_i_ub_q0p125 1 100 0.00 31.875 ARRAY_SIZE 30 ECU_ADDRESS 0xC000BAB2 /end MEASUREMENT
/begin MEASUREMENT Gen_arrayuberrn "Hier könnte Ihr Langbezeichner stehen" UBYTE Def_st_ub_q1 1 100 0.00 255. FORMAT "%3.0" ECU_ADDRESS 0xC000B108 /end MEASUREMENT
/begin MEASUREMENT Gen_arrayuberrnz "Hier könnte Ihr Langbezeichner stehen" UBYTE Def_st_ub_q1 1 100 0.00 255. FORMAT "%3.0" ECU_ADDRESS 0xC000B109 /end MEASUREMENT
/begin MEASUREMENT Gen_arrayuberrxy "Hier könnte Ihr Langbezeichner stehen" UBYTE Def_st_ub_q1 1 100 0.00 255. FORMAT "%3.0" ECU_ADDRESS 0xC000B10A /end MEASUREMENT
/begin MEASUREMENT Gen_arrayubnz_sum "Hier könnte Ihr Langbezeichner stehen" UWORD Def_u_uw_q0p1 1 100 0.00 6553.500 FORMAT "%8.3" ECU_ADDRESS 0xC0009C36 /end MEASUREMENT
/begin MEASUREMENT Gen_arrayubn_sum "Hier könnte Ihr Langbezeichner stehen" UWORD Def_u_uw_q0p1 1 100 0.00 6553.500 FORMAT "%8.3" ECU_ADDRESS 0xC0009C38 /end MEASUREMENT
/begin MEASUREMENT Gen_arrayubxy_sum "Hier könnte Ihr Langbezeichner stehen" UWORD Def_u_uw_q0p1 1 100 0.00 6553.500 FORMAT "%8.3" ECU_ADDRESS 0xC0009C3A /end MEASUREMENT
/begin MEASUREMENT Gen_arrayub_nv "Hier könnte Ihr Langbezeichner stehen" UBYTE Def_u_ub_q0p1 1 100 0.00 25.50 FORMAT "%5.2" ARRAY_SIZE 30 ECU_ADDRESS 0xC000BAD0 /end MEASUREMENT
/begin MEASUREMENT Gen_arrayugenerrn "Hier könnte Ihr Langbezeichner stehen" UBYTE Def_st_ub_q1 1 100 0.00 255. FORMAT "%3.0" ECU_ADDRESS 0xC000B10B /end MEASUREMENT
/begin MEASUREMENT Gen_arrayugenerrnz "Hier könnte Ihr Langbezeichner stehen" UBYTE Def_st_ub_q1 1 100 0.00 255. FORMAT "%3.0" ECU_ADDRESS 0xC000B10C /end MEASUREMENT
/begin MEASUREMENT Gen_arrayugenerrxy "Hier könnte Ihr Langbezeichner stehen" UBYTE Def_st_ub_q1 1 100 0.00 255. FORMAT "%3.0" ECU_ADDRESS 0xC000B10D /end MEASUREMENT
/begin MEASUREMENT Gen_arrayugennz_sum "Hier könnte Ihr Langbezeichner stehen" UWORD Def_u_uw_q0p1 1 100 0.00 6553.500 FORMAT "%8.3" ECU_ADDRESS 0xC0009C3C /end MEASUREMENT
/begin MEASUREMENT Gen_arrayugenn_sum "Hier könnte Ihr Langbezeichner stehen" UWORD Def_u_uw_q0p1 1 100 0.00 6553.500 FORMAT "%8.3" ECU_ADDRESS 0xC0009C3E /end MEASUREMENT
/begin MEASUREMENT Gen_arrayugenxy_sum "Hier könnte Ihr Langbezeichner stehen" UWORD Def_u_uw_q0p1 1 100 0.00 6553.500 FORMAT "%8.3" ECU_ADDRESS 0xC0009C40 /end MEASUREMENT
/begin MEASUREMENT Gen_arrayugen_nv "Hier könnte Ihr Langbezeichner stehen" UBYTE Def_u_ub_q0p1 1 100 0.00 25.50 FORMAT "%5.2" ARRAY_SIZE 30 ECU_ADDRESS 0xC000BAEE /end MEASUREMENT
/begin MEASUREMENT Gen_count "Hier könnte Ihr Langbezeichner stehen" UBYTE Def_st_ub_q1 1 100 0.00 255. FORMAT "%3.0" ECU_ADDRESS 0xC000B10E /end MEASUREMENT
/begin MEASUREMENT Gen_count_1min "Hier könnte Ihr Langbezeichner stehen" UBYTE Def_st_ub_q1 1 100 0.00 255. FORMAT "%3.0" ECU_ADDRESS 0xC000B10F /end MEASUREMENT
/begin MEASUREMENT Gen_fbsak "BSD Uebertragungsfehler kodiert fuer FSPVDGEN" UBYTE Def_st_ub_q1 1 100 0.00 255. FORMAT "%3.0" ECU_ADDRESS 0xC000B110 /end MEASUREMENT
/begin MEASUREMENT Gen_ierrgrenz "Hier könnte Ihr Langbezeichner stehen" UWORD Def_i_uw_q0p125 1 100 0.00 8191.875 FORMAT "%8.3" ECU_ADDRESS 0xC0009C42 /end MEASUREMENT
/begin MEASUREMENT Gen_ierrgrenz_1min "Hier könnte Ihr Langbezeichner stehen" UWORD Def_i_uw_q0p125 1 100 0.00 8191.875 FORMAT "%8.3" ECU_ADDRESS 0xC0009C44 /end MEASUREMENT
/begin MEASUREMENT Gen_stat2_div "Divisor für Statistik2" UBYTE Def_st_ub_q1 1 100 0.00 255. FORMAT "%3.0" ECU_ADDRESS 0xC000B111 /end MEASUREMENT
/begin MEASUREMENT Gen_statroh "Generatorfehler kodiert fuer FSPVDGEN" UBYTE Def_st_ub_q1 1 100 0.00 255. FORMAT "%3.0" ECU_ADDRESS 0xC000B112 /end MEASUREMENT
/begin MEASUREMENT Gen_ub "Hier könnte Ihr Langbezeichner stehen" UWORD Def_u_uw_q0p0942 1 100 0.00 6173.4 FORMAT "%6.1" ECU_ADDRESS 0xC0009C46 /end MEASUREMENT
/begin MEASUREMENT Gen_ub_1min "Hier könnte Ihr Langbezeichner stehen" UWORD Def_u_uw_q0p0942 1 100 0.00 6173.4 FORMAT "%6.1" ECU_ADDRESS 0xC0009C48 /end MEASUREMENT
/begin MEASUREMENT Gen_ugen "Hier könnte Ihr Langbezeichner stehen" UWORD Def_u_uw_q0p1 1 100 0.00 6553.500 FORMAT "%8.3" ECU_ADDRESS 0xC0009C4A /end MEASUREMENT
/begin MEASUREMENT Gen_ugen_1min "Hier könnte Ihr Langbezeichner stehen" UWORD Def_u_uw_q0p1 1 100 0.00 6553.500 FORMAT "%8.3" ECU_ADDRESS 0xC0009C4C /end MEASUREMENT
/begin MEASUREMENT Ibs1_errstat "" UWORD Def_st_uw_q1 1 100 0.00 65535. FORMAT "%5.0" ECU_ADDRESS 0xC0009C84 /end MEASUREMENT
/begin MEASUREMENT Ibs2_errstat "" UWORD Def_st_uw_q1 1 100 0.00 65535. FORMAT "%5.0" ECU_ADDRESS 0xC0009C86 /end MEASUREMENT
/begin MEASUREMENT Ibs3_errstat "" UWORD Def_st_uw_q1 1 100 0.00 65535. FORMAT "%5.0" ECU_ADDRESS 0xC0009C88 /end MEASUREMENT
/begin MEASUREMENT Ibsderrs1 "Fehlerzähler IBS BSD Kommunikation" UBYTE Def_dez_ub_q1 1 100 0.00 255. FORMAT "%3.0" ECU_ADDRESS 0xC000B130 /end MEASUREMENT
/begin MEASUREMENT Ibsderrs2 "Fehlerzähler IBS EBSD Kommunikation" UWORD Def_dez_uw_q1 1 100 0.00 65535. FORMAT "%5.0" ECU_ADDRESS 0xC0009C8A /end MEASUREMENT
/begin MEASUREMENT Ibspreco2 "Vorteiler /10 fuer Ibsderrs2" UBYTE Def_dez_ub_q1 1 100 0.00 255. FORMAT "%3.0" ECU_ADDRESS 0xC000B131 /end MEASUREMENT
/begin MEASUREMENT St_dgen0 "Statuswort" UBYTE Def_st_ub_q1 1 100 0.00 255. FORMAT "%3.0" ECU_ADDRESS 0xC000B113 /end MEASUREMENT
/begin MEASUREMENT St_dgen1 "Statuswort" UBYTE Def_st_ub_q1 1 100 0.00 255. FORMAT "%3.0" ECU_ADDRESS 0xC000B114 /end MEASUREMENT
/begin MEASUREMENT St_dgenerrst_md1 "Statuswort Fehlerzuweisung zu Messdatensatz1" UWORD Def_st_uw_q1 1 100 0.00 65535. FORMAT "%5.0" ECU_ADDRESS 0xC0009C4E /end MEASUREMENT
/begin MEASUREMENT St_dgenerrst_md2 "" UWORD Def_st_uw_q1 1 100 0.00 65535. FORMAT "%5.0" ECU_ADDRESS 0xC0009C50 /end MEASUREMENT
/begin MEASUREMENT St_dgengrenz1 "Mittelwert der Erregerstrombegrenzung ueber applizierbare Zeit X (z.B. 10min)" UBYTE Def_i_ub_q0p125 1 100 0.00 31.875 ECU_ADDRESS 0xC000B115 /end MEASUREMENT
/begin MEASUREMENT St_dgengrenz1_md1 "Mittelwert der Erregerstrombegrenzung ueber applizierbare Zeit X (z.B. 10min) zu 1. Messdatensatz" UBYTE Def_i_ub_q0p125 1 100 0.00 31.875 ECU_ADDRESS 0xC000B116 /end MEASUREMENT
/begin MEASUREMENT St_dgengrenz1_md2 "" UBYTE Def_i_ub_q0p125 1 100 0.00 31.875 ECU_ADDRESS 0xC000B117 /end MEASUREMENT
/begin MEASUREMENT St_dgengrenz2 "Mittelwert der Erregerstrombegrenzung ueber applizierbare Zeit Y (z.B. 30min)" UBYTE Def_i_ub_q0p125 1 100 0.00 31.875 ECU_ADDRESS 0xC000B118 /end MEASUREMENT
/begin MEASUREMENT St_dgengrenz2_md1 "Mittelwert der Erregerstrombegrenzung ueber applizierbare Zeit Y (z.B. 30min) zu 1. Messdatensatz" UBYTE Def_i_ub_q0p125 1 100 0.00 31.875 ECU_ADDRESS 0xC000B119 /end MEASUREMENT
/begin MEASUREMENT St_dgengrenz2_md2 "" UBYTE Def_i_ub_q0p125 1 100 0.00 31.875 ECU_ADDRESS 0xC000B11A /end MEASUREMENT
/begin MEASUREMENT St_dgengrenzerr "Fehlerstati zur Erregerstrombegrenzung" UBYTE Def_st_ub_q1 1 100 0.00 255. FORMAT "%3.0" ECU_ADDRESS 0xC000B11B /end MEASUREMENT
/begin MEASUREMENT St_dgengrenzerr_md1 "Fehlerstati zur Erregerstrombegrenzung zu 1. Messdatensatz" UBYTE Def_st_ub_q1 1 100 0.00 255. FORMAT "%3.0" ECU_ADDRESS 0xC000B11C /end MEASUREMENT
/begin MEASUREMENT St_dgengrenzerr_md2 "" UBYTE Def_st_ub_q1 1 100 0.00 255. FORMAT "%3.0" ECU_ADDRESS 0xC000B11D /end MEASUREMENT
/begin MEASUREMENT St_dgengrenznz "Mittelwert der Erregerstrombegrenzung ueber applizierbare Zeit Z (z.B. 2min)" UBYTE Def_i_ub_q0p125 1 100 0.00 31.875 ECU_ADDRESS 0xC000B11E /end MEASUREMENT
/begin MEASUREMENT St_dgengrenznz_md1 "Mittelwert der Erregerstrombegrenzung ueber applizierbare Zeit Z (z.B. 2min) zu 1. Messdatensatz" UBYTE Def_i_ub_q0p125 1 100 0.00 31.875 ECU_ADDRESS 0xC000B11F /end MEASUREMENT
/begin MEASUREMENT St_dgengrenznz_md2 "" UBYTE Def_i_ub_q0p125 1 100 0.00 31.875 ECU_ADDRESS 0xC000B120 /end MEASUREMENT
/begin MEASUREMENT St_dgenub1 "Mittelwert der Batteriespannung ueber applizierbare Zeit X (z.B. 10min)" UWORD Def_u_uw_q0p1 1 100 0.00 6553.500 FORMAT "%8.3" ECU_ADDRESS 0xC0009C52 /end MEASUREMENT
/begin MEASUREMENT St_dgenub1_md1 "Mittelwert der Batteriespannung ueber applizierbare Zeit X (z.B. 10min) zu 1. Messdatensatz" UWORD Def_u_uw_q0p0942 1 100 0.00 6173.4 FORMAT "%6.1" ECU_ADDRESS 0xC0009C54 /end MEASUREMENT
/begin MEASUREMENT St_dgenub1_md2 "" UWORD Def_u_uw_q0p0942 1 100 0.00 6173.4 FORMAT "%6.1" ECU_ADDRESS 0xC0009C56 /end MEASUREMENT
/begin MEASUREMENT St_dgenub2 "Mittelwert der Batteriespannung ueber applizierbare Zeit Y (z.B. 30min)" UWORD Def_u_uw_q0p1 1 100 0.00 6553.500 FORMAT "%8.3" ECU_ADDRESS 0xC0009C58 /end MEASUREMENT
/begin MEASUREMENT St_dgenub2_md1 "Mittelwert der Batteriespannung ueber applizierbare Zeit Y (z.B. 30min) zu 1. Messdatensatz" UWORD Def_u_uw_q0p0942 1 100 0.00 6173.4 FORMAT "%6.1" ECU_ADDRESS 0xC0009C5A /end MEASUREMENT
/begin MEASUREMENT St_dgenub2_md2 "" UWORD Def_u_uw_q0p0942 1 100 0.00 6173.4 FORMAT "%6.1" ECU_ADDRESS 0xC0009C5C /end MEASUREMENT
/begin MEASUREMENT St_dgenuberr "Fehlerstati zur Batteriespannung" UBYTE Def_st_ub_q1 1 100 0.00 255. FORMAT "%3.0" ECU_ADDRESS 0xC000B121 /end MEASUREMENT
/begin MEASUREMENT St_dgenuberr_md1 "Fehlerstati zur Batteriespannung zu 1. Messdatensatz" UBYTE Def_st_ub_q1 1 100 0.00 255. FORMAT "%3.0" ECU_ADDRESS 0xC000B122 /end MEASUREMENT
/begin MEASUREMENT St_dgenuberr_md2 "" UBYTE Def_st_ub_q1 1 100 0.00 255. FORMAT "%3.0" ECU_ADDRESS 0xC000B123 /end MEASUREMENT
/begin MEASUREMENT St_dgenubnz "Mittelwert der Batteriespannung ueber applizierbare Zeit Z (z.B. 2min)" UWORD Def_u_uw_q0p1 1 100 0.00 6553.500 FORMAT "%8.3" ECU_ADDRESS 0xC0009C5E /end MEASUREMENT
/begin MEASUREMENT St_dgenubnz_md1 "Mittelwert der Batteriespannung ueber applizierbare Zeit Z (z.B. 2min) zu 1. Messdatensatz" UWORD Def_u_uw_q0p0942 1 100 0.00 6173.4 FORMAT "%6.1" ECU_ADDRESS 0xC0009C60 /end MEASUREMENT
/begin MEASUREMENT St_dgenubnz_md2 "" UWORD Def_u_uw_q0p0942 1 100 0.00 6173.4 FORMAT "%6.1" ECU_ADDRESS 0xC0009C62 /end MEASUREMENT
/begin MEASUREMENT St_dgenugen1 "Mittelwert der Generatorsollspannung ueber applizierbare Zeit X (z.B. 10min)" UWORD Def_u_uw_q0p1 1 100 0.00 6553.500 FORMAT "%8.3" ECU_ADDRESS 0xC0009C64 /end MEASUREMENT
/begin MEASUREMENT St_dgenugen1_md1 "Mittelwert der Generatorsollspannung ueber applizierbare Zeit X (z.B. 10min) zu 1. Messdatensatz" UWORD Def_u_uw_q0p1 1 100 0.00 6553.500 FORMAT "%8.3" ECU_ADDRESS 0xC0009C66 /end MEASUREMENT
/begin MEASUREMENT St_dgenugen1_md2 "" UWORD Def_u_uw_q0p1 1 100 0.00 6553.500 FORMAT "%8.3" ECU_ADDRESS 0xC0009C68 /end MEASUREMENT
/begin MEASUREMENT St_dgenugen2 "Mittelwert der Generatorsollspannung ueber applizierbare Zeit Y (z.B. 30min)" UWORD Def_u_uw_q0p1 1 100 0.00 6553.500 FORMAT "%8.3" ECU_ADDRESS 0xC0009C6A /end MEASUREMENT
/begin MEASUREMENT St_dgenugen2_md1 "Mittelwert der Generatorsollspannung ueber applizierbare Zeit Y (z.B. 30min) zu 1. Messdatensatz" UWORD Def_u_uw_q0p1 1 100 0.00 6553.500 FORMAT "%8.3" ECU_ADDRESS 0xC0009C6C /end MEASUREMENT
/begin MEASUREMENT St_dgenugen2_md2 "" UBYTE Def_u_ub_q0p1 1 100 0.00 25.50 FORMAT "%5.2" ECU_ADDRESS 0xC000B124 /end MEASUREMENT
/begin MEASUREMENT St_dgenugenerr "Fehlerstati zur Generatorsollspannung" UBYTE Def_st_ub_q1 1 100 0.00 255. FORMAT "%3.0" ECU_ADDRESS 0xC000B125 /end MEASUREMENT
/begin MEASUREMENT St_dgenugenerr_md1 "Fehlerstati zur Generatorsollspannung zu 1. Messdatensatz" UBYTE Def_st_ub_q1 1 100 0.00 255. FORMAT "%3.0" ECU_ADDRESS 0xC000B126 /end MEASUREMENT
/begin MEASUREMENT St_dgenugenerr_md2 "" UBYTE Def_st_ub_q1 1 100 0.00 255. FORMAT "%3.0" ECU_ADDRESS 0xC000B127 /end MEASUREMENT
/begin MEASUREMENT St_dgenugennz "Mittelwert der Generatorsollspannung ueber applizierbare Zeit Z (z.B. 2min)" UWORD Def_u_uw_q0p1 1 100 0.00 6553.500 FORMAT "%8.3" ECU_ADDRESS 0xC0009C6E /end MEASUREMENT
/begin MEASUREMENT St_dgenugennz_md1 "Mittelwert der Generatorsollspannung ueber applizierbare Zeit Z (z.B. 2min) zu 1. Messdatensatz" UWORD Def_u_uw_q0p1 1 100 0.00 6553.500 FORMAT "%8.3" ECU_ADDRESS 0xC0009C70 /end MEASUREMENT
/begin MEASUREMENT St_dgenugennz_md2 "" UWORD Def_u_uw_q0p1 1 100 0.00 6553.500 FORMAT "%8.3" ECU_ADDRESS 0xC0009C72 /end MEASUREMENT
/begin MEASUREMENT St_dgen_neu "Statuswort" UBYTE Def_st_ub_q1 1 100 0.00 255. FORMAT "%3.0" ECU_ADDRESS 0xC000B128 /end MEASUREMENT
/begin MEASUREMENT St_dgen_neu2 "Statuswort" UBYTE Def_st_ub_q1 1 100 0.00 255. FORMAT "%3.0" ECU_ADDRESS 0xC000B129 /end MEASUREMENT
/begin MEASUREMENT St_dgen_neu3 "Statuswort" UBYTE Def_st_ub_q1 1 100 0.00 255. FORMAT "%3.0" ECU_ADDRESS 0xC000B12A /end MEASUREMENT
/begin MEASUREMENT St_dgen_nv "Statuswort" UBYTE Def_st_ub_q1 1 100 0.00 255. FORMAT "%3.0" ECU_ADDRESS 0xC000B12B /end MEASUREMENT
/begin MEASUREMENT St_dibs0 "Statuswort" UBYTE Def_st_ub_q1 1 100 0.00 255. FORMAT "%3.0" ECU_ADDRESS 0xC000B132 /end MEASUREMENT
/begin MEASUREMENT St_dibs1 "Statuswort" UBYTE Def_st_ub_q1 1 100 0.00 255. FORMAT "%3.0" ECU_ADDRESS 0xC000B133 /end MEASUREMENT
/begin MEASUREMENT St_dibs2 "Statuswort" UBYTE Def_st_ub_q1 1 100 0.00 255. FORMAT "%3.0" ECU_ADDRESS 0xC000B134 /end MEASUREMENT
/begin MEASUREMENT St_gen "Generatorstatus" UBYTE Def_st_ub_q1 1 100 0.00 255. FORMAT "%3.0" ECU_ADDRESS 0xC000B12C /end MEASUREMENT
/begin MEASUREMENT St_genbsd "Hier könnte Ihr Langbezeichner stehen" UWORD Def_st_uw_q1 1 100 0.00 65535. FORMAT "%5.0" ECU_ADDRESS 0xC0009C74 /end MEASUREMENT
/begin MEASUREMENT St_gengen "Hier könnte Ihr Langbezeichner stehen" UWORD Def_st_uw_q1 1 100 0.00 65535. FORMAT "%5.0" ECU_ADDRESS 0xC0009C76 /end MEASUREMENT
/begin MEASUREMENT T_count_dibs1 "" UBYTE Def_i_ub_q1 1 100 0.00 255.00 ECU_ADDRESS 0xC000B135 /end MEASUREMENT
/begin MEASUREMENT T_count_dibs2 "" UBYTE Def_i_ub_q1 1 100 0.00 255.00 ECU_ADDRESS 0xC000B136 /end MEASUREMENT
/begin MEASUREMENT T_count_dibs3 "" UBYTE ident 1 100 0.00 255. FORMAT "%3.0" ECU_ADDRESS 0xC000B137 /end MEASUREMENT
/begin MEASUREMENT T_count_dibs4 "" UBYTE ident 1 100 0.00 255. FORMAT "%3.0" ECU_ADDRESS 0xC000B138 /end MEASUREMENT
/begin MEASUREMENT VehMot_rTrqDfftl "Differentialübersetzung" SWORD TransR 1 100 -327.6800 327.6700 ECU_ADDRESS 0xD00014C8 /end MEASUREMENT
/begin MEASUREMENT VehMot_trqPrtDfftl "Differentialschutzmoment" SLONG TrqPrpHigh 1 100 -214748364.800 214748364.700 ECU_ADDRESS 0xD000307C /end MEASUREMENT
/begin MEASUREMENT Z_gen_1min "Hier könnte Ihr Langbezeichner stehen" UBYTE Def_st_ub_q1 1 100 0.00 255. FORMAT "%3.0" ECU_ADDRESS 0xC000B12D /end MEASUREMENT
/begin FUNCTION DFES ""
 /begin DEF_CHARACTERISTIC DFES_Severity.DFC_GbxNPosPlaus_C DFES_Severity.DFC_I14229_ROETst_Appl_C DFES_Severity.DFC_I14229_ROETst_Netw_C DFES_Severity.DFC_I14229_ROE_BufFull_C DFES_Severity.DFC_IVAdjDiaIVAdj_C DFES_Severity.DFC_IVAdjIVA_0_C DFES_Severity.DFC_IVAdjIVA_1_C DFES_Severity.DFC_IVAdjIVA_2_C DFES_Severity.DFC_IVAdjIVA_3_C DFES_Severity.DFC_IVAdjIVA_4_C DFES_Severity.DFC_IVAdjIVA_5_C DFES_Severity.DFC_IVPSplyDCDCOff_0_C DFES_Severity.DFC_IVPSplyDCDCOff_1_C DFES_Severity.DFC_IVPSplyDCDCOff_2_C DFES_Severity.DFC_IVPSplyDCDCOff_3_C DFES_Severity.DFC_InjCtlAdjQntEEPCS_C DFES_Severity.DFC_LSUSPISig_C DFES_Severity.DFC_Layer_Dummy_C DFES_Severity.DFC_NplEnvPSensPPFltDiff_C DFES_Severity.DFC_NplPresSensPPFltDiff_C DFES_Severity.DFC_OilLvlPlaus_C DFES_Severity.DFC_OilTOutLvl_C DFES_Severity.DFC_PCVfacAdaptMax_C DFES_Severity.DFC_PCVfacAdaptMin_C DFES_Severity.DFC_SensFrzPPFltUs_C DFES_Severity.DFC_SensMonUTnkLvl_C DFES_Severity.DFC_T15Sig_C DFES_Severity.DFC_AirCtlRmpTOut_C DFES_Severity.DFC_BrkPPlaus_C DFES_Severity.DFC_CEngDsTDynTst_C DFES_Severity.DFC_EEPEraseErr_C DFES_Severity.DFC_EEPRdErr_C DFES_Severity.DFC_EEPWrErr_C DFES_Severity.DFC_EGRVlvJamVlvClsd_C DFES_Severity.DFC_EGRVlvJamVlvOpn_C DFES_Severity.DFC_EGRVlvLPJamVlvClsd_C DFES_Severity.DFC_EGRVlvLPJamVlvOpn_C DFES_Severity.DFC_EGRVlvLPLgTDrft_C DFES_Severity.DFC_EGRVlvLPOfsLrnJamVlv_C DFES_Severity.DFC_EGRVlvLPShTDrft_C DFES_Severity.DFC_EGRVlvLgTDrft_C DFES_Severity.DFC_EGRVlvOfsLrnJamVlv_C DFES_Severity.DFC_EGRVlvShTDrft_C DFES_Severity.DFC_EngICO_C DFES_Severity.DFC_EpmCaSI1ErrSig_C DFES_Severity.DFC_EpmCaSI1NoSig_C DFES_Severity.DFC_EpmCaSI1OfsErr_C DFES_Severity.DFC_EpmCrSErrSig_C DFES_Severity.DFC_EpmCrSNoSig_C DFES_Severity.DFC_IVPlausComprTst_C DFES_Severity.DFC_IVPlausRunUpTst_C DFES_Severity.DFC_InjCrvShOffTst_C DFES_Severity.DFC_LayerEnSavModProd_C DFES_Severity.DFC_LayerEnSavModRep_C DFES_Severity.DFC_LayerEnSavModShip_C DFES_Severity.DFC_MRlyErlyOpng_C DFES_Severity.DFC_MRlyStk_C DFES_Severity.DFC_MeUnActrTst_C DFES_Severity.DFC_MoCADCCmp_C DFES_Severity.DFC_MoCADCTst_C DFES_Severity.DFC_MoCADCVltgRatio_C DFES_Severity.DFC_MoCComErrCnt_C DFES_Severity.DFC_MoCComSPI_C DFES_Severity.DFC_MoCROMErrXPg_C DFES_Severity.DFC_MoCSOPHwNoRdy_C DFES_Severity.DFC_MoCSOPLoLi_C DFES_Severity.DFC_MoCSOPMM_C DFES_Severity.DFC_MoCSOPTimeOut_C DFES_Severity.DFC_MoCSOPUpLi_C DFES_Severity.DFC_MoFAPP_C DFES_Severity.DFC_MoFESpd_C DFES_Severity.DFC_MoFInjDatPhi_C DFES_Severity.DFC_MoFInjDatQnt_C DFES_Severity.DFC_MoFInjQnt_C DFES_Severity.DFC_MoFMode1PoI1_C DFES_Severity.DFC_MoFMode1PoI2_C DFES_Severity.DFC_MoFMode2PoI1_C DFES_Severity.DFC_MoFMode2PoI2_C DFES_Severity.DFC_MoFOvR_C DFES_Severity.DFC_MoFQntCor_C DFES_Severity.DFC_MoFRailP_C DFES_Severity.DFC_MoFTrqCmp_C DFES_Severity.DFC_NSCDsHtrSetP_C DFES_Severity.DFC_NoCat2DsHtrSetP_C DFES_Severity.DFC_PCVActrTst_C DFES_Severity.DFC_PhyModNonMonMapNpl_C DFES_Severity.DFC_RailHpTst_C DFES_Severity.DFC_RailPOfsTstMax_C DFES_Severity.DFC_RailPOfsTstMin_C DFES_Severity.DFC_SIA_E1max_C DFES_Severity.DFC_SIA_E1min_C DFES_Severity.DFC_SIA_E1npl_C DFES_Severity.DFC_SIA_E1sig_C DFES_Severity.DFC_SIA_E2max_C DFES_Severity.DFC_SIA_E2min_C DFES_Severity.DFC_SIA_E2npl_C DFES_Severity.DFC_SIA_E2sig_C DFES_Severity.DFC_SIA_E3max_C DFES_Severity.DFC_SIA_E3min_C DFES_Severity.DFC_SIA_E3npl_C DFES_Severity.DFC_SIA_E3sig_C DFES_Severity.DFC_SIA_E4max_C DFES_Severity.DFC_SIA_E4min_C DFES_Severity.DFC_SIA_E4npl_C DFES_Severity.DFC_SIA_E4sig_C DFES_Severity.DFC_SWReset_0_C DFES_Severity.DFC_SWReset_1_C DFES_Severity.DFC_SWReset_2_C DFES_Severity.DFC_ShtrAKKMax_C DFES_Severity.DFC_ShtrAKKMin_C DFES_Severity.DFC_ShtrAKKNpl_C DFES_Severity.DFC_ShtrPKKMax_C DFES_Severity.DFC_StopCntTmr_C DFES_Severity.DFC_ThrVlvMon_C DFES_Severity.DFC_VSwVlvJamVlv_C DFES_Severity.DFC_VSwVlvLgTDrft_C DFES_Severity.DFC_VSwVlvOfsLrnJamVlv_C DFES_Severity.DFC_VSwVlvOfsNeutr_C DFES_Severity.DFC_VSwVlvShTDrft_C DFES_Severity.DFC_VSwVlvSpgDef_C DFES_ThresSimCond.t_C DFES_ThresSimCond.r_C DFES_ThresSimCond.n_C DFES_xAsgnExtdFrzFrSig_CA DFES_xAsgnFrzFrSig_CA DFES_xClsDltTrg_CA DFES_xClsFaultTrg_CA DFES_xClsFltMIL_CA DFES_xClsFltSVS_CA DFES_xClsHealTrg_CA DFES_xClsPndDltTrg_CA DFES_xClsPrio_CA DFES_xClsSvcDltTrg_CA DFES_xClsSVSFaultTrg_CA DFES_xClsSVSHealTrg_CA DFES_xStPrio_CA /end DEF_CHARACTERISTIC
/end FUNCTION
/begin FUNCTION DFP "" /end FUNCTION
/begin FUNCTION dgen ""
 /begin DEF_CHARACTERISTIC K_GENMSKKL61 K_GENPDTIME K_GENREGVPLAUS K_GENSTATX K_GENSTATY K_GENSTATZ K_GEN_DNMIN K_MSKGENDFP K_MSKGENDIAG K_MSKGENKL61 K_MSKGENSTAT K_PLAUSAUS K_PLAUSEIN K_SNMBSDKL61 K_TDGENERR K_TDGENFBSD K_TD_UGENDIAG K_UGENDIAG K_UGOFFSET S_DGENSTAT S_DGENSTATENA S_ENUGDIAG S_GENDIAGNEU S_GENPLAUS /end DEF_CHARACTERISTIC
 /begin OUT_MEASUREMENT Gensatzsum_akt Gensatzsum_eintrag Gen_arraycntx Gen_arraycnty Gen_arraycntz Gen_arraycnt_nv Gen_arrayerr_nv Gen_arraygrenzerrnz Gen_arraygrenzerrxy Gen_arraygrenznerrn Gen_arraygrenznz_sum Gen_arraygrenzn_sum Gen_arraygrenzxy_sum Gen_arrayierrg_nv Gen_arrayuberrn Gen_arrayuberrnz Gen_arrayuberrxy Gen_arrayubnz_sum Gen_arrayubn_sum Gen_arrayubxy_sum Gen_arrayub_nv Gen_arrayugenerrn Gen_arrayugenerrnz Gen_arrayugenerrxy Gen_arrayugennz_sum Gen_arrayugenn_sum Gen_arrayugenxy_sum Gen_arrayugen_nv Gen_count Gen_count_1min Gen_fbsak Gen_ierrgrenz Gen_ierrgrenz_1min Gen_stat2_div Gen_statroh Gen_ub Gen_ub_1min Gen_ugen Gen_ugen_1min St_dgen0 St_dgen1 St_dgenerrst_md1 St_dgenerrst_md2 St_dgengrenz1 St_dgengrenz1_md1 St_dgengrenz1_md2 St_dgengrenz2 St_dgengrenz2_md1 St_dgengrenz2_md2 St_dgengrenzerr St_dgengrenzerr_md1 St_dgengrenzerr_md2 St_dgengrenznz St_dgengrenznz_md1 St_dgengrenznz_md2 St_dgenub1 St_dgenub1_md1 St_dgenub1_md2 St_dgenub2 St_dgenub2_md1 St_dgenub2_md2 St_dgenuberr St_dgenuberr_md1 St_dgenuberr_md2 St_dgenubnz St_dgenubnz_md1 St_dgenubnz_md2 St_dgenugen1 St_dgenugen1_md1 St_dgenugen1_md2 St_dgenugen2 St_dgenugen2_md1 St_dgenugen2_md2 St_dgenugenerr St_dgenugenerr_md1 St_dgenugenerr_md2 St_dgenugennz St_dgenugennz_md1 St_dgenugennz_md2 St_dgen_neu St_dgen_neu2 St_dgen_neu3 St_dgen_nv St_gen St_genbsd St_gengen Z_gen_1min /end OUT_MEASUREMENT
/end FUNCTION
/begin FUNCTION DiaDem_SelectParameter ""
 /begin DEF_CHARACTERISTIC DiaDem_nOfsHiIdlSpd_C DiaDem_nOfsLoIdlSpd_C DiaDem_SetHiRmp.SlopePos_C DiaDem_SetHiRmp.SlopeNeg_C DiaDem_SetLoRmp.SlopePos_C DiaDem_SetLoRmp.SlopeNeg_C /end DEF_CHARACTERISTIC
 /begin IN_MEASUREMENT HLSDem_nSetPHi HLSDem_nSetPLo HLSDem_trqLoLimMax HLSDem_trqLoLimMin ISC_st /end IN_MEASUREMENT
 /begin OUT_MEASUREMENT DiaDem_nSetPHi DiaDem_nSetPLo DiaDem_trqLimMax DiaDem_trqLimMin DiaDem_trqReq /end OUT_MEASUREMENT
 /begin LOC_MEASUREMENT DiaDem_nSetPHi_mp DiaDem_nSetPLoInl1_mp DiaDem_nSetPLoInl2_mp DiaDem_nSetPLo_mp DiaDem_numActvInl_mp DiaDem_numInl_mp DiaDem_trqLimMax_mp DiaDem_trqLimMin_mp /end LOC_MEASUREMENT
/end FUNCTION
/begin FUNCTION DiagAppl_Std "" /begin DEF_CHARACTERISTIC Diag_stOBDPtcol_C /end DEF_CHARACTERISTIC /end FUNCTION
/begin FUNCTION DiagComAppl_Std "" /end FUNCTION
/begin FUNCTION DiagCom_Distrib "" /end FUNCTION
/begin FUNCTION DiagNC "" /end FUNCTION
/begin FUNCTION Diag_Session "" /end FUNCTION
/begin FUNCTION Diag_Util "" /end FUNCTION
/begin FUNCTION dibs ""
 /begin DEF_CHARACTERISTIC K_MSKIBSDFP K_MSKIBSDFP2 K_MSKIBSDIAG K_MSKIBSERR K_MSKIBSERR2 S_BSDKOORD /end DEF_CHARACTERISTIC
 /begin OUT_MEASUREMENT Ibs1_errstat Ibs2_errstat Ibs3_errstat Ibsderrs1 Ibsderrs2 Ibspreco2 St_dibs0 St_dibs1 St_dibs2 T_count_dibs1 T_count_dibs2 T_count_dibs3 T_count_dibs4 /end OUT_MEASUREMENT
/end FUNCTION
/begin FUNCTION Diff_PlausPrtTrq "" /begin IN_MEASUREMENT DiffIO_stCfg DiffIO_trqPrtDfftl /end IN_MEASUREMENT /begin OUT_MEASUREMENT VehMot_trqPrtDfftl /end OUT_MEASUREMENT /end FUNCTION
/begin FUNCTION Diff_TrqRat "" /begin DEF_CHARACTERISTIC Diff_rTrqDfftl_C /end DEF_CHARACTERISTIC /begin OUT_MEASUREMENT VehMot_rTrqDfftl /end OUT_MEASUREMENT /end FUNCTION
/begin FUNCTION DINH ""
 /begin OUT_MEASUREMENT DINH_stFId.FId_Unused DINH_stFId.FId_InhibitAlways DINH_stFId.FId_CoordALS DINH_stFId.FId_CoordFBC DINH_stFId.FId_CoordTAA DINH_stFId.FId_CoordZFC DINH_stFId.FId_IVPlausRunUpTstActv DINH_stFId.FId_RailHpTstActv DINH_stFId.FId_ACCIRevErr DINH_stFId.FId_ACCRevErr DINH_stFId.FId_ACCtlTEngErr DINH_stFId.FId_ACCtlTGearbxErr DINH_stFId.FId_ACCtlVehVErr DINH_stFId.FId_ACCtl_AC DINH_stFId.FId_ACCtl_Fan DINH_stFId.FId_ACCtlstTrailer DINH_stFId.FId_AFS DINH_stFId.FId_AFSActrTst DINH_stFId.FId_AFSDrftMaxLim DINH_stFId.FId_AFSFrzAirMs DINH_stFId.FId_AFSPlOffsDrft DINH_stFId.FId_AFSPlSetyDrft DINH_stFId.FId_AFSSRC DINH_stFId.FId_AFSSysErr DINH_stFId.FId_AFSTPer DINH_stFId.FId_AFStCond DINH_stFId.FId_AFStEnv DINH_stFId.FId_AGSDem_SelectParameter DINH_stFId.FId_APP1FinalDef DINH_stFId.FId_APP1ProvDef DINH_stFId.FId_APP1SRCHigh DINH_stFId.FId_APP1SigPath DINH_stFId.FId_APP2FinalDef DINH_stFId.FId_APP2ProvDef DINH_stFId.FId_APP2SRCHigh DINH_stFId.FId_APP2SigPath DINH_stFId.FId_APPBrkDef DINH_stFId.FId_APPBrkTrq DINH_stFId.FId_APPNTP DINH_stFId.FId_APPSyncChk DINH_stFId.FId_APPSyncDef DINH_stFId.FId_APPSyncProvDef DINH_stFId.FId_APPSyncSigProv DINH_stFId.FId_APPVel DINH_stFId.FId_APProvDef DINH_stFId.FId_ASDdc DINH_stFId.FId_ASDrfLAD2 DINH_stFId.FId_ASModAFS DINH_stFId.FId_ASModAFSTCmpr DINH_stFId.FId_ASModEGRVlvLrn DINH_stFId.FId_ASModOxiC DINH_stFId.FId_ASModPipe DINH_stFId.FId_ASModPipeSlw DINH_stFId.FId_ASModPresCalc DINH_stFId.FId_ASModPresEnv DINH_stFId.FId_ASModStrt DINH_stFId.FId_ASModSwtOffEng DINH_stFId.FId_ASModSwtOffExhMnfLP DINH_stFId.FId_ASModSwtOffIndVol DINH_stFId.FId_ASModT20 DINH_stFId.FId_ASModTrbn DINH_stFId.FId_AccPedNMaxLim DINH_stFId.FId_AccPedNMinLim DINH_stFId.FId_AccPedTrqLim DINH_stFId.FId_AdapNSCDs DINH_stFId.FId_AdcIADC0 DINH_stFId.FId_AdcIADC1 DINH_stFId.FId_AftRun DINH_stFId.FId_AirCSwt DINH_stFId.FId_AirCtl DINH_stFId.FId_AirCtlACCorr DINH_stFId.FId_AirCtlBrk DINH_stFId.FId_AirCtlBstPresCor DINH_stFId.FId_AirCtlCmpntActv DINH_stFId.FId_AirCtlCorAltEOM DINH_stFId.FId_AirCtlDyn DINH_stFId.FId_AirCtlEGR DINH_stFId.FId_AirCtlEGRPreCtl DINH_stFId.FId_AirCtlGear DINH_stFId.FId_AirCtlGovDvt DINH_stFId.FId_AirCtlGovLPDvt DINH_stFId.FId_AirCtlInvEGRMod DINH_stFId.FId_AirCtlLP DINH_stFId.FId_AirCtlLPACCor DINH_stFId.FId_AirCtlLPBstPresCor DINH_stFId.FId_AirCtlLPCmpntActv DINH_stFId.FId_AirCtlLPGear DINH_stFId.FId_AirCtlLPPFltEGRRed DINH_stFId.FId_AirCtlLPStrgCor DINH_stFId.FId_AirCtlLPVehVCor DINH_stFId.FId_AirCtlPFltEGRRed DINH_stFId.FId_AirCtlStrg DINH_stFId.FId_AirCtlTVA DINH_stFId.FId_AirCtlTVACtl DINH_stFId.FId_AirCtlmDesVehCorr DINH_stFId.FId_AirSysTst DINH_stFId.FId_BattUFrzVal DINH_stFId.FId_BattUReplVal DINH_stFId.FId_BattUSRC DINH_stFId.FId_BrkP DINH_stFId.FId_BrkPFrzVal DINH_stFId.FId_BrkPReplVal DINH_stFId.FId_BrkPSens DINH_stFId.FId_BusDiag_stFadeOut DINH_stFId.FId_CEngDsTDynTst DINH_stFId.FId_CEngDsTFrzVal DINH_stFId.FId_CEngDsTModel DINH_stFId.FId_CEngDsTRdClnt DINH_stFId.FId_CEngDsTRplVal DINH_stFId.FId_CEngDsTSS DINH_stFId.FId_Clth DINH_stFId.FId_ClthCAN DINH_stFId.FId_CmbChb DINH_stFId.FId_CoEngNrml2Strt DINH_stFId.FId_CoEngPthClsEGR DINH_stFId.FId_CoEngPthClsThr DINH_stFId.FId_CoEngPthCylOff DINH_stFId.FId_CoEngPthETZr DINH_stFId.FId_CoEngPthFlQnt DINH_stFId.FId_CoEngPthInjVlvOff DINH_stFId.FId_CoEngPthLpSysOff DINH_stFId.FId_CoEngPthRPMin DINH_stFId.FId_CoEngPthTrqZr DINH_stFId.FId_CoEngSoftShOff DINH_stFId.FId_CoEngStop DINH_stFId.FId_CoSCR_CAN DINH_stFId.FId_CoTS_SwtOff DINH_stFId.FId_CoVMDComErr DINH_stFId.FId_CoVMvBd DINH_stFId.FId_CoVehPrpLimErr DINH_stFId.FId_ComAPP DINH_stFId.FId_ComBrkDef DINH_stFId.FId_ComClth DINH_stFId.FId_ComCoEng DINH_stFId.FId_ComCtrSecInt DINH_stFId.FId_ComCtrSecIntTo DINH_stFId.FId_ComDKGIntv DINH_stFId.FId_ComDscAck1 DINH_stFId.FId_ComDscAck2 DINH_stFId.FId_ComDscAck3 DINH_stFId.FId_ComDscTrqIntv DINH_stFId.FId_ComEngDem DINH_stFId.FId_ComGbxAck1 DINH_stFId.FId_ComGbxAck2 DINH_stFId.FId_ComGbxAck3 DINH_stFId.FId_ComGbxTrqIntv DINH_stFId.FId_ComInjDu1 DINH_stFId.FId_ComInjDu2 DINH_stFId.FId_ComInjVlv DINH_stFId.FId_ComMSA DINH_stFId.FId_ComNDynDispOff DINH_stFId.FId_ComNGbxOut DINH_stFId.FId_ComPCBSPFlt DINH_stFId.FId_ComRCtrPwrSpCos DINH_stFId.FId_ComRpmRduc DINH_stFId.FId_ComSLck DINH_stFId.FId_ComStBrkPedal DINH_stFId.FId_ComStDDEQl DINH_stFId.FId_ComStDrvDirDes DINH_stFId.FId_ComStEnrgPwrMnmt DINH_stFId.FId_ComStGbxModDemFAS DINH_stFId.FId_ComStGrip DINH_stFId.FId_ComStLPCOff DINH_stFId.FId_ComStLckGbxDemQl DINH_stFId.FId_ComStRTrqPTQl DINH_stFId.FId_ComStShiftPdl DINH_stFId.FId_ComStShutOffPSP DINH_stFId.FId_ComStTerminal DINH_stFId.FId_ComStTrq DINH_stFId.FId_ComStTrqGbxQl DINH_stFId.FId_ComStTrqWhlStbQl DINH_stFId.FId_ComStVehDrvCond DINH_stFId.FId_ComStnEngQl DINH_stFId.FId_ComStrtLck DINH_stFId.FId_ComTEng DINH_stFId.FId_ComTOilEng DINH_stFId.FId_ComThrVlv DINH_stFId.FId_ComTrqCootd DINH_stFId.FId_ComTrqWhl DINH_stFId.FId_ComTrqWhlDes DINH_stFId.FId_ComUBatt DINH_stFId.FId_ComVolTotFlCons DINH_stFId.FId_ComnEng DINH_stFId.FId_ComnGbxOut DINH_stFId.FId_ComnSetPLo DINH_stFId.FId_ComnTSC DINH_stFId.FId_CompEnv DINH_stFId.FId_ComrTrq DINH_stFId.FId_ComrTrqPT DINH_stFId.FId_ComrVirtAPP DINH_stFId.FId_ComrWaterVlv DINH_stFId.FId_ComrtrqDifftl DINH_stFId.FId_ComstGear DINH_stFId.FId_ComvVeh DINH_stFId.FId_ConvLdNTrbnCan DINH_stFId.FId_ConvLdOilTemp DINH_stFId.FId_ConvLdTrqLdCan DINH_stFId.FId_ConvLdVel DINH_stFId.FId_CrCUILvr DINH_stFId.FId_CrCtlCan DINH_stFId.FId_CrCtlCanAT DINH_stFId.FId_CrCtlEcu DINH_stFId.FId_Cy100Dev1 DINH_stFId.FId_Cy100Dev2 DINH_stFId.FId_DCSRmpShOff DINH_stFId.FId_DCSShOff DINH_stFId.FId_DIOnumChip1Cj945 DINH_stFId.FId_DIUMPRGenDenom1 DINH_stFId.FId_DIUMPRGenDenom2 DINH_stFId.FId_DIUMPRGenDenom3 DINH_stFId.FId_DIUMPRIgn DINH_stFId.FId_DSMIVAdjNVCEna DINH_stFId.FId_DSMWarmUpCycle DINH_stFId.FId_DStgyMon DINH_stFId.FId_DevLibActrPrt DINH_stFId.FId_DewDetHtgDel DINH_stFId.FId_DewDetstSrvTstDem DINH_stFId.FId_DiaDem_SelectParameter DINH_stFId.FId_DynChkPPFltDiff DINH_stFId.FId_ECBVlvFrzVal DINH_stFId.FId_ECBVlvReplVal DINH_stFId.FId_ECBVlvSS DINH_stFId.FId_EGRClg DINH_stFId.FId_EGRVlvFrzVal DINH_stFId.FId_EGRVlvGovOn DINH_stFId.FId_EGRVlvJamVlv DINH_stFId.FId_EGRVlvLPFrzVal DINH_stFId.FId_EGRVlvLPGovOn DINH_stFId.FId_EGRVlvLPJamVlv DINH_stFId.FId_EGRVlvLPOfsLrnInhib DINH_stFId.FId_EGRVlvLPReplVal DINH_stFId.FId_EGRVlvLPSSpMon DINH_stFId.FId_EGRVlvOfsLrnInhib DINH_stFId.FId_EGRVlvReplVal DINH_stFId.FId_EGRVlvSSpMon DINH_stFId.FId_EGSysMaxTOxiPre DINH_stFId.FId_EGSysMaxTOxiPreRgn DINH_stFId.FId_EGSysMaxTPre DINH_stFId.FId_EGSysMaxTPreRgn DINH_stFId.FId_EMCtl DINH_stFId.FId_ETClbCorActv DINH_stFId.FId_ETCtlAirCtl DINH_stFId.FId_ETCtlInr DINH_stFId.FId_ETCtlOutr DINH_stFId.FId_Empt DINH_stFId.FId_EngDaClntTemp DINH_stFId.FId_EngDemPFltErr DINH_stFId.FId_EngDemPFltOvldErr DINH_stFId.FId_EngDemTrqLimErr DINH_stFId.FId_EngDemTrqLimErr1 DINH_stFId.FId_EngDemTrqLimErr2 DINH_stFId.FId_EngDemTrqLimErr3 DINH_stFId.FId_EngDemTrqLimErr4 DINH_stFId.FId_EngPrtEnvP DINH_stFId.FId_EngPrtFWOscInactv DINH_stFId.FId_EngPrtNLimErr DINH_stFId.FId_EngPrtT31 DINH_stFId.FId_EngPrtstTrailer DINH_stFId.FId_EnhSRCPPFltDiff DINH_stFId.FId_EnhSRCT1ExhTMon DINH_stFId.FId_EnhSRCT2ExhTMon DINH_stFId.FId_EnhSRCT3ExhTMon DINH_stFId.FId_EnvPFrzVal DINH_stFId.FId_EnvPModel DINH_stFId.FId_EnvPNplPPFltDiff DINH_stFId.FId_EnvPRplVal DINH_stFId.FId_EnvPSS DINH_stFId.FId_EnvTCANFrzVal DINH_stFId.FId_EnvTCANRplVal DINH_stFId.FId_EnvTModel DINH_stFId.FId_EnvTSS DINH_stFId.FId_EpmBCr DINH_stFId.FId_EpmCaSAdapCaSI1 DINH_stFId.FId_EpmCaSDiag DINH_stFId.FId_EpmCaSOfsDiagCaSI1 DINH_stFId.FId_EpmCaSOfsErrCaSI1 DINH_stFId.FId_EpmCaSSegCor DINH_stFId.FId_EpmCrSDiag DINH_stFId.FId_EpmCrSDiagVeh DINH_stFId.FId_EpmOpMode_InjLock DINH_stFId.FId_EpmRRSFaultCheck DINH_stFId.FId_EpmRRSRdCheck DINH_stFId.FId_ExhTMonCondPlaus DINH_stFId.FId_ExhTMonPlausTemp DINH_stFId.FId_FBC DINH_stFId.FId_FBCMonI DINH_stFId.FId_FMALamO2Valid DINH_stFId.FId_FMASwtOff1 DINH_stFId.FId_FMASwtOff3 DINH_stFId.FId_FanCtl DINH_stFId.FId_FanCtl2 DINH_stFId.FId_FanCtlCor DINH_stFId.FId_FanCtlCor2 DINH_stFId.FId_FanCtlnEFan DINH_stFId.FId_FanCtlstTrailer DINH_stFId.FId_FanTraOil DINH_stFId.FId_FlFCBSDef DINH_stFId.FId_FlFltDsPFrzVal DINH_stFId.FId_FlFltDsPReplVal DINH_stFId.FId_FlFltUsPFrzVal DINH_stFId.FId_FlFltUsPReplVal DINH_stFId.FId_FlSysDens DINH_stFId.FId_FlSysTnkLoEEP DINH_stFId.FId_FlSysTnkLoInfo DINH_stFId.FId_FrzPrtTrqDfftl DINH_stFId.FId_FrzValAbsUPmpP DINH_stFId.FId_FrzValCANAbsUPmpP DINH_stFId.FId_FrzValCANUCatUsT DINH_stFId.FId_FrzValPPFltDiff DINH_stFId.FId_FrzValPPFltUs DINH_stFId.FId_FrzValTOxiCatUs DINH_stFId.FId_FrzValTPFltUs DINH_stFId.FId_FrzValTTrbnUs DINH_stFId.FId_FrzValUCatUsT DINH_stFId.FId_FrzValUTnkLvl DINH_stFId.FId_FuelTCTS DINH_stFId.FId_FuelTFlSys DINH_stFId.FId_FuelTFrzVal DINH_stFId.FId_FuelTReplVal DINH_stFId.FId_GSHDem_SelectParameter DINH_stFId.FId_GbxNPosPWM DINH_stFId.FId_GlbDaLSumvXPtd DINH_stFId.FId_GlwCtl1 DINH_stFId.FId_GlwCtlDrWghSeat DINH_stFId.FId_GlwCtlTRadio DINH_stFId.FId_GlwEcuGPCMFaultInfoTstLck DINH_stFId.FId_GlwEcuGPCMInfoTstLck DINH_stFId.FId_HLSDemDeclGradLim DINH_stFId.FId_HLSDemSetPLoDrvAwy DINH_stFId.FId_HLSDemUndrBrk DINH_stFId.FId_HLSDemtrqConv DINH_stFId.FId_HsLnChkPPFltDiff DINH_stFId.FId_I14229Appl_RC DINH_stFId.FId_ISCnTrbnMod DINH_stFId.FId_ISCtrqConv DINH_stFId.FId_ISCvBd DINH_stFId.FId_IVDiaTst DINH_stFId.FId_IVPSplyDCDCOff DINH_stFId.FId_IVPlausComprTst DINH_stFId.FId_IVPlausRunUpTst DINH_stFId.FId_InhibitNever DINH_stFId.FId_InjCrvCoErr DINH_stFId.FId_InjCrvCylOffs DINH_stFId.FId_InjCrvDisblPoI1 DINH_stFId.FId_InjCrvDisblPoI2 DINH_stFId.FId_InjCrvPiI1VehCor DINH_stFId.FId_InjCrvPiI2VehCor DINH_stFId.FId_InjCrvPoIOvrLim DINH_stFId.FId_InjCrvShOffTst DINH_stFId.FId_InjUnStrtPlsBlk DINH_stFId.FId_InjVlvBnk0ShutOff DINH_stFId.FId_InjVlvBnk1ShutOff DINH_stFId.FId_InjVlvBnk2ShutOff DINH_stFId.FId_InjVlvBnk3ShutOff DINH_stFId.FId_InjVlvCyl0ShutOff DINH_stFId.FId_InjVlvCyl1ShutOff DINH_stFId.FId_InjVlvCyl2ShutOff DINH_stFId.FId_InjVlvCyl3ShutOff DINH_stFId.FId_InjVlvCyl4ShutOff DINH_stFId.FId_InjVlvCyl5ShutOff DINH_stFId.FId_InjVlvCyl6ShutOff DINH_stFId.FId_InjVlvCyl7ShutOff DINH_stFId.FId_InjVlvPrep DINH_stFId.FId_InjVlvPresMin DINH_stFId.FId_InjVlvPresMinRun DINH_stFId.FId_InjVlvPresMinStrt DINH_stFId.FId_LSUAdap0 DINH_stFId.FId_LSUClbSched DINH_stFId.FId_LSUCmpChk0 DINH_stFId.FId_LSUCtl0 DINH_stFId.FId_LSUDewRls0 DINH_stFId.FId_LSUDynChk0 DINH_stFId.FId_LSUHtCoup0 DINH_stFId.FId_LSUHtrPS0 DINH_stFId.FId_LSUIPOpnLdTst0 DINH_stFId.FId_LSUIsolChk0 DINH_stFId.FId_LSULoBatt0 DINH_stFId.FId_LSUMon0 DINH_stFId.FId_LSUO20 DINH_stFId.FId_LSUO2Clb0 DINH_stFId.FId_LSUO2SRC0 DINH_stFId.FId_LSUPlausChk0 DINH_stFId.FId_LSURi0 DINH_stFId.FId_LSURiClb0 DINH_stFId.FId_LSUShCir0 DINH_stFId.FId_LSUUNVGOpnLdTst0 DINH_stFId.FId_LSUlsu0 DINH_stFId.FId_Layer_ACFZGL11 DINH_stFId.FId_Layer_ACFZGQ11 DINH_stFId.FId_Layer_AQUERABS11 DINH_stFId.FId_Layer_ATEMPRELATIVZEIT DINH_stFId.FId_Layer_BATTCLASS DINH_stFId.FId_Layer_BEDIENUNG_MSA DINH_stFId.FId_Layer_CANErr DINH_stFId.FId_Layer_CODIERUNG_PM DINH_stFId.FId_Layer_CRASHABSCHALTUNG DINH_stFId.FId_Layer_DIENSTE_19 DINH_stFId.FId_Layer_FAHRZEUGTYP DINH_stFId.FId_Layer_FltHtg DINH_stFId.FId_Layer_FltMng_Sig1 DINH_stFId.FId_Layer_FltMng_Sig2 DINH_stFId.FId_Layer_GESCHWINDIGKEIT DINH_stFId.FId_Layer_GETRIEBEDATEN DINH_stFId.FId_Layer_GETRIEBEDATEN_2 DINH_stFId.FId_Layer_KILOMETERSTAND DINH_stFId.FId_Layer_KLEMMENSTATUS DINH_stFId.FId_Layer_LENKRADWINKEL DINH_stFId.FId_Layer_LPC DINH_stFId.FId_Layer_MANDETEK DINH_stFId.FId_Layer_MSACANErr DINH_stFId.FId_Layer_MSAVAdapt DINH_stFId.FId_Layer_MSAVDiag DINH_stFId.FId_Layer_STANDVERBRAUCHER DINH_stFId.FId_Layer_STATDSC DINH_stFId.FId_Layer_STATESEAT DINH_stFId.FId_Layer_STATGANGRUECKWAERTS DINH_stFId.FId_Layer_STATZVKLAPPEN DINH_stFId.FId_Layer_STAT_ANHAENGER DINH_stFId.FId_Layer_STAT_EKP DINH_stFId.FId_Layer_UHRZEIT_DATUM DINH_stFId.FId_Layer_ULCP DINH_stFId.FId_Layer_VCAN11 DINH_stFId.FId_Layer_VERBRAUCHER DINH_stFId.FId_Layer_WAERMESTROMKLIMA DINH_stFId.FId_LubmOil DINH_stFId.FId_MeUnActrTst DINH_stFId.FId_MeUnFrzI DINH_stFId.FId_MeUnRot DINH_stFId.FId_MetCtl DINH_stFId.FId_NSCDsAdapEep DINH_stFId.FId_NSCDsCmpChk DINH_stFId.FId_NSCDsNOx DINH_stFId.FId_NSCDsOvrRunPlaus DINH_stFId.FId_NSCDsRdy DINH_stFId.FId_NSCDsSensDia DINH_stFId.FId_NSCDsTO DINH_stFId.FId_NoCat2DsAdap DINH_stFId.FId_NoCat2DsAdapEep DINH_stFId.FId_NoCat2DsCmpChk DINH_stFId.FId_NoCat2DsNOx DINH_stFId.FId_NoCat2DsOvrRunPlaus DINH_stFId.FId_NoCat2DsRdy DINH_stFId.FId_NoCat2DsSensDia DINH_stFId.FId_NoCat2DsTO DINH_stFId.FId_NoPresCtl DINH_stFId.FId_NplPresSensPPFltDiff DINH_stFId.FId_NplTOxiCatUs DINH_stFId.FId_NplTPFltUs DINH_stFId.FId_OilPLmpVOff DINH_stFId.FId_OilPSwmpRplVal DINH_stFId.FId_PCBSDef DINH_stFId.FId_PCBSPFltDef DINH_stFId.FId_PCR DINH_stFId.FId_PCRCByVlvOff DINH_stFId.FId_PCRClthActv DINH_stFId.FId_PCRCmpntActv DINH_stFId.FId_PCRCmpntActvLP DINH_stFId.FId_PCRExtnLimActr DINH_stFId.FId_PCRGovDvt DINH_stFId.FId_PCRGovDvtLP DINH_stFId.FId_PCRLP DINH_stFId.FId_PCROfsRls DINH_stFId.FId_PCRPFltPresCor DINH_stFId.FId_PCRT20 DINH_stFId.FId_PCRTrbCh DINH_stFId.FId_PCVActrTst DINH_stFId.FId_PCVFrzI DINH_stFId.FId_PCVNoStrt DINH_stFId.FId_PCVPwrStgTst DINH_stFId.FId_PFltAirSysFail DINH_stFId.FId_PFltChar DINH_stFId.FId_PFltComLSum DINH_stFId.FId_PFltDstr DINH_stFId.FId_PFltEngPrtRgnMon DINH_stFId.FId_PFltLckRgnErr DINH_stFId.FId_PFltLckRgnFl DINH_stFId.FId_PFltLckRgnOilDil DINH_stFId.FId_PFltLdAshCor DINH_stFId.FId_PFltLdAshCorErr DINH_stFId.FId_PFltLdIniAftSuc DINH_stFId.FId_PFltLdNOxEng DINH_stFId.FId_PFltLdO2Aprx DINH_stFId.FId_PFltLdSimRgnThr DINH_stFId.FId_PFltOvldHealInhRn DINH_stFId.FId_PFltOvldHealTrqLm DINH_stFId.FId_PFltPOpBrk DINH_stFId.FId_PFltPOpClth DINH_stFId.FId_PFltPOpGearDet DINH_stFId.FId_PFltPOpSpdVeh DINH_stFId.FId_PFltPOpTempAir DINH_stFId.FId_PFltPOpTempClnt DINH_stFId.FId_PFltPOpVltgBatt DINH_stFId.FId_PFltPoI1Fail DINH_stFId.FId_PFltPoI2Fail DINH_stFId.FId_PFltPresPlausProj DINH_stFId.FId_PFltRgnChngPar DINH_stFId.FId_PFltRgnNoSucDet DINH_stFId.FId_PFltRgnNumErrLck DINH_stFId.FId_PFltRgnNumPFltErr DINH_stFId.FId_PFltRgnSuc DINH_stFId.FId_PFltSimOn DINH_stFId.FId_PFltSysErr2Can DINH_stFId.FId_PFltSysFail DINH_stFId.FId_PFltTOxiPreDiff DINH_stFId.FId_PFltTPreDiff DINH_stFId.FId_PIntkVUsEnvPPls DINH_stFId.FId_PIntkVUsFrzVal DINH_stFId.FId_PIntkVUsRplVal DINH_stFId.FId_PTCltDKG DINH_stFId.FId_PTGripDebPtd DINH_stFId.FId_PTTrqRatCANPtd DINH_stFId.FId_PhyModPCRCorr DINH_stFId.FId_PlausTTrbnUs DINH_stFId.FId_PresBuildUp DINH_stFId.FId_PresCtl DINH_stFId.FId_PresRdc DINH_stFId.FId_PresSensFrzPPFltUs DINH_stFId.FId_QWCCTSDef DINH_stFId.FId_QWCFTSDef DINH_stFId.FId_QWCOff DINH_stFId.FId_RadShtCTS DINH_stFId.FId_RadShtConsum DINH_stFId.FId_RadShtEGS DINH_stFId.FId_RadShtEnvT DINH_stFId.FId_RadShtstTrailer DINH_stFId.FId_RailCPCtlMeUnMode DINH_stFId.FId_RailCPCtlPCVMode DINH_stFId.FId_RailCtlMode DINH_stFId.FId_RailFuelTErr DINH_stFId.FId_RailHpTst DINH_stFId.FId_RailMeUn0Blk DINH_stFId.FId_RailMeUn0Rls DINH_stFId.FId_RailMeUn1Blk DINH_stFId.FId_RailMeUn1Rls DINH_stFId.FId_RailMeUn22Blk DINH_stFId.FId_RailMeUn22Rls DINH_stFId.FId_RailMeUn2Blk DINH_stFId.FId_RailMeUn2Rls DINH_stFId.FId_RailMeUn3Blk DINH_stFId.FId_RailMeUn3Rls DINH_stFId.FId_RailMeUn42Blk DINH_stFId.FId_RailMeUn42Rls DINH_stFId.FId_RailMeUn4Blk DINH_stFId.FId_RailMeUn4Rls DINH_stFId.FId_RailMeUn5Blk DINH_stFId.FId_RailMeUn5Rls DINH_stFId.FId_RailMeUnClsdShutOff DINH_stFId.FId_RailMeUnCtlMode DINH_stFId.FId_RailMeUnCtlUpLim DINH_stFId.FId_RailPCV0Blk DINH_stFId.FId_RailPCV0Rls DINH_stFId.FId_RailPCV1Blk DINH_stFId.FId_RailPCV1Rls DINH_stFId.FId_RailPCV22Blk DINH_stFId.FId_RailPCV22Rls DINH_stFId.FId_RailPCV2Blk DINH_stFId.FId_RailPCV2Rls DINH_stFId.FId_RailPCV3Blk DINH_stFId.FId_RailPCV3Rls DINH_stFId.FId_RailPCV42Blk DINH_stFId.FId_RailPCV42Rls DINH_stFId.FId_RailPCV4Blk DINH_stFId.FId_RailPCV4Rls DINH_stFId.FId_RailPCVCtlMode DINH_stFId.FId_RailPCVCtlUpLim DINH_stFId.FId_RailPFrzVal /end OUT_MEASUREMENT
/end FUNCTION
/begin COMPU_METHOD AngleIndexCpp "" RAT_FUNC "%6.2" "AgCA" COEFFS 0 -1 180 0 0 1 /end COMPU_METHOD
/begin COMPU_METHOD Def_dez_ub_q1 "" RAT_FUNC "%3.1" "-" COEFFS 0 1 0 0 0 1 /end COMPU_METHOD
/begin COMPU_METHOD Def_dez_uw_q1 "" RAT_FUNC "%5.2" "-" COEFFS 0 1 0 0 0 1 /end COMPU_METHOD
/begin COMPU_METHOD Def_i_ub_q0p125 "" RAT_FUNC "%6.3" "A" COEFFS 0 8 0 0 0 1 /end COMPU_METHOD
/begin COMPU_METHOD Def_i_ub_q1 "" RAT_FUNC "%6.2" "" COEFFS 0 1 0 0 0 1 /end COMPU_METHOD
/begin COMPU_METHOD Def_i_uw_q0p125 "" RAT_FUNC "%8.4" "A" COEFFS 0 8 0 0 0 1 /end COMPU_METHOD
/begin COMPU_METHOD Def_n_sw_q1p0 "" RAT_FUNC "%5.2" "Upm" COEFFS 0 1 0 0 0 1 /end COMPU_METHOD
/begin COMPU_METHOD Def_st_ub_q1 "" RAT_FUNC "%3.1" "-" COEFFS 0 1 0 0 0 1 /end COMPU_METHOD
/begin COMPU_METHOD Def_st_uw_q1 "" RAT_FUNC "%5.2" "-" COEFFS 0 1 0 0 0 1 /end COMPU_METHOD
/begin COMPU_METHOD Def_td_uw_q0p1 "" RAT_FUNC "%6.3" "s" COEFFS 0 10 0 0 0 1 /end COMPU_METHOD
/begin COMPU_METHOD Def_u_ub_q0p1 "" RAT_FUNC "%5.3" "V" COEFFS 0 10 0 0 0 1 /end COMPU_METHOD
/begin COMPU_METHOD Def_u_uw_q0p0942 "" RAT_FUNC "%6.3" "V" COEFFS 0 10.6157112526539 0 0 0 1 /end COMPU_METHOD
/begin COMPU_METHOD Def_u_uw_q0p1 "" RAT_FUNC "%8.4" "V" COEFFS 0 10 0 0 0 1 /end COMPU_METHOD
/begin COMPU_METHOD DFC_OneToOne "" RAT_FUNC "%6.0" "-" COEFFS 0 1 0 0 0 1 /end COMPU_METHOD
/begin COMPU_METHOD DFES_LampFlt "" TAB_VERB "%6.3" "-" COMPU_TAB_REF DFES_LampFlt /end COMPU_METHOD
/begin COMPU_VTAB DFES_LampFlt "" TAB_VERB 6 0 "NO_Lamp_Activation" 1 "Continous_Lamp_Support" 2 "Blinking_Lamp_Support" 3 "Blinking_and_Continous_Lamp_Supp" 4 "Continuous_SVS_Support_LDF" 8 "Continuous_SVS_Support_LDF_FLC" /end COMPU_VTAB
/begin COMPU_METHOD DFES_nPID0C "" RAT_FUNC "%6.3" "rpm" COEFFS 0 4 0 0 0 1 /end COMPU_METHOD
/begin COMPU_METHOD DFES_rPID04 "" RAT_FUNC "%6.3" "%" COEFFS 0 2.55 0 0 0 1 /end COMPU_METHOD
/begin COMPU_METHOD DFES_tPID05 "" RAT_FUNC "%6.2" "deg C" COEFFS 0 1 40 0 0 1 /end COMPU_METHOD
/begin COMPU_METHOD DFES_TstVisAndPrio "" TAB_VERB "%6.3" "-" COMPU_TAB_REF DFES_TstVisAndPrio /end COMPU_METHOD
/begin COMPU_VTAB DFES_TstVisAndPrio "" TAB_VERB 8 4 "invisible_for_all_Testers" 32 "ServiceLow" 40 "ServiceHigh" 96 "OBDLow" 104 "OBDHigh" 168 "ServiceHigh_MaxPrio" 224 "ServiceHigh_OBDLow_MaxPrio" 232 "ServiceHigh_OBDHigh_MaxPrio" /end COMPU_VTAB
/begin COMPU_METHOD Diag_OBDPtcol_Val "" TAB_VERB "%6.3" "" COMPU_TAB_REF Diag_OBDPtcol_Val /end COMPU_METHOD
/begin COMPU_VTAB Diag_OBDPtcol_Val "" TAB_VERB 4 0 "INACTIVE" 1 "CAN_15765" 2 "KLINE_CARB_9141" 3 "KLINE_14230" /end COMPU_VTAB
/begin COMPU_METHOD DSMAUX_DTRGVerb "" TAB_VERB "%2.1" "-" COMPU_TAB_REF DSMAUX_DTRGVerb /end COMPU_METHOD
/begin COMPU_VTAB DSMAUX_DTRGVerb "" TAB_VERB 7 0 "DTRG_Time200ms" 1 "DTRG_SimilarCondHLC" 2 "DTRG_AlwaysTrue" 3 "DTRG_DrivingCycleFLC" 4 "DTRG_DrivingCycleHLC" 5 "DTRG_NoTrigger" 6 "DTRG_WarmUpCycle" DEFAULT_VALUE "---" /end COMPU_VTAB
/begin COMPU_METHOD EngN "" RAT_FUNC "%5.1" "rpm" COEFFS 0 2 0 0 0 1 /end COMPU_METHOD
/begin COMPU_METHOD ident "" RAT_FUNC "%3.1" "-" COEFFS 0 1 0 0 0 1 /end COMPU_METHOD
/begin COMPU_METHOD Identity "" RAT_FUNC "%3.1" "-" COEFFS 0 1 0 0 0 1 /end COMPU_METHOD
/begin COMPU_METHOD OneToOne "" RAT_FUNC "%6.0" "-" COEFFS 0 1 0 0 0 1 /end COMPU_METHOD
/begin COMPU_METHOD RmpEngN "" RAT_FUNC "%6.4" "rpm/s" COEFFS 0 131.072 0 0 0 1 /end COMPU_METHOD
/begin COMPU_METHOD Signals_IntSigNumVerb "" TAB_VERB "%6.3" "" COMPU_TAB_REF Signals_IntSigNumVerb /end COMPU_METHOD
/begin COMPU_VTAB Signals_IntSigNumVerb "" TAB_VERB 703 0 "SIGNALS_Signals_Default" 1 "SIGNALS_ACCtl_stOut_1B" 2 "SIGNALS_AFS_dmSensCorr_mp_2B" 3 "SIGNALS_AFS_dm_2B" 4 "SIGNALS_AFS_facIdlAdjVal_mp_2B" 5 "SIGNALS_AFS_facLdAdjVal_mp_2B" 6 "SIGNALS_AFS_mAirPerCyl_1B" 7 "SIGNALS_AFS_mAirPerCyl_2B" 8 "SIGNALS_AFS_rNorm_mp_2B" 9 "SIGNALS_AFS_stRstLoDrftThres_mp_1B" 10 "SIGNALS_AFS_tiCor_mp_2B" 11 "SIGNALS_AFS_tiRaw_2B" 12 "SIGNALS_APP_rFlt_mp_1B" 13 "SIGNALS_APP_rFlt_mp_2B" 14 "SIGNALS_APP_r_2B" 15 "SIGNALS_APP_stSigSrc_1B" 16 "SIGNALS_APP_uRaw1_2B" 17 "SIGNALS_APP_uRaw2_2B" 18 "SIGNALS_ASDdc_stSelSt_mp_2B" 19 "SIGNALS_ASDdc_trq_2B" 20 "SIGNALS_ASDrf_stSelSt_mp_2B" 21 "SIGNALS_ASMod_dmIndAirRef_2B" 22 "SIGNALS_ASMod_dvolPFltEG_1B" 23 "SIGNALS_ASMod_dvolPFltEG_2B" 24 "SIGNALS_ASMod_mAirPerCylCor_2B" 25 "SIGNALS_ASMod_pPFltSimDs_1B" 26 "SIGNALS_ASMod_pPFltSimDs_2B" 27 "SIGNALS_Absch_korr_2B" 28 "SIGNALS_AccPed_trqDes_4B" 29 "SIGNALS_ActMod_trqClth_2B" 30 "SIGNALS_ActMod_trqInr_2B" 31 "SIGNALS_ActMod_trq_2B" 32 "SIGNALS_AirCtl_mDesBas_2B" 33 "SIGNALS_AirCtl_mDesVal_1B" 34 "SIGNALS_AirCtl_mDesVal_2B" 35 "SIGNALS_AirCtl_mGovDvt_2B" 36 "SIGNALS_AirCtl_rCtlVal_2B" 37 "SIGNALS_AirCtl_rGovDvtNrm_2B" 38 "SIGNALS_AirCtl_rPIDCtl_mp_2B" 39 "SIGNALS_AirCtl_stAirCtlBits_4B" 40 "SIGNALS_AirCtl_stMon_1B" 41 "SIGNALS_AirSys_dRED1_mp_2B" 42 "SIGNALS_AirSys_dRED2_mp_2B" 43 "SIGNALS_AirSys_mLBer1_mp_4B" 44 "SIGNALS_AirSys_mLBer2_mp_4B" 45 "SIGNALS_AirSys_mLHFM1_mp_4B" 46 "SIGNALS_AirSys_mLHFM2_mp_4B" 47 "SIGNALS_AirSys_mLM10_mp_4B" 48 "SIGNALS_AirSys_mLM11_mp_4B" 49 "SIGNALS_AirSys_mLM12_mp_4B" 50 "SIGNALS_AirSys_mLM13_mp_4B" 51 "SIGNALS_AirSys_mLM20_mp_4B" 52 "SIGNALS_AirSys_mLM21_mp_4B" 53 "SIGNALS_AirSys_mLM22_mp_4B" 54 "SIGNALS_AirSys_p21max1_mp_2B" 55 "SIGNALS_AirSys_p21max2_mp_2B" 56 "SIGNALS_AirSys_rDIFF1_mp_2B" 57 "SIGNALS_AirSys_rDIFF2_mp_2B" 58 "SIGNALS_AirSys_rLverh1_mp_2B" 59 "SIGNALS_AirSys_rLverh2_mp_2B" 60 "SIGNALS_AirSys_rRED11_mp_2B" 61 "SIGNALS_AirSys_rRED12_mp_2B" 62 "SIGNALS_AirSys_rRED13_mp_2B" 63 "SIGNALS_AirSys_rRED21_mp_2B" 64 "SIGNALS_AirSys_rRED22_mp_2B" 65 "SIGNALS_AirSys_ststateSysTst_mp_1B" 66 "SIGNALS_AirSys_stsubstateSysTst_mp_1B" 67 "SIGNALS_Air_pIntkVUs_1B" 68 "SIGNALS_Air_pIntkVUs_2B" 69 "SIGNALS_Air_rRawTAFS_2B" 70 "SIGNALS_Air_tAFS_2B" 71 "SIGNALS_Air_tCACDs_2B" 72 "SIGNALS_Air_tSensTAFS_1B" 73 "SIGNALS_Air_tSensTAFS_2B" 74 "SIGNALS_Air_uRawPIntkVUs_2B" 75 "SIGNALS_Air_uRawTCACDs_2B" 76 "SIGNALS_AltIO_rAltLoad_2B" 77 "SIGNALS_BattU_uSens_1B" 78 "SIGNALS_BattU_uSens_2B" 79 "SIGNALS_BattU_u_2B" 80 "SIGNALS_BrkP_pSens_2B" 81 "SIGNALS_BrkP_p_2B" 82 "SIGNALS_BrkP_uRaw_2B" 83 "SIGNALS_Brk_st_1B" 84 "SIGNALS_Bszsi_4B" 85 "SIGNALS_CByVlv_st_1B" 86 "SIGNALS_CEngDsT_t_2B" 87 "SIGNALS_CEngDsT_uRaw_2B" 88 "SIGNALS_Clth_st_1B" 89 "SIGNALS_CoEOM_stOpModeAct_4B" 90 "SIGNALS_CoETS_rTrq_2B" 91 "SIGNALS_CoETS_stCurrLimActive_2B" 92 "SIGNALS_CoETS_trqInrLim_2B" 93 "SIGNALS_CoETS_trqInrSetSlow_2B" 94 "SIGNALS_CoEng_stIRevShutOff_4B" 95 "SIGNALS_CoEng_stRevShutOff_4B" 96 "SIGNALS_CoEng_stShutOffPath_4B" 97 "SIGNALS_CoEng_stState_mp_1B" 98 "SIGNALS_CoEng_stTst_1B" 99 "SIGNALS_CoEng_st_1B" 100 "SIGNALS_CoPT_trqDes_2B" 101 "SIGNALS_Com_lSum_4B" 102 "SIGNALS_Com_lSum_8km_2B" 103 "SIGNALS_Com_nPsp_2B" 104 "SIGNALS_Com_rPspSetPoint_2B" 105 "SIGNALS_Com_stCrCtlLvr_1B" 106 "SIGNALS_Com_stLmpPrkBrk_1B" 107 "SIGNALS_Conv_nTrbn_2B" 108 "SIGNALS_CrCUI_stBtn_2B" 109 "SIGNALS_CrC_stKey_2B" 110 "SIGNALS_CrCtl_aReq_2B" 111 "SIGNALS_CrCtl_stShOffConRvActv_mp_4B" 112 "SIGNALS_CrCtl_stShOff_1B" 113 "SIGNALS_CrCtl_st_1B" 114 "SIGNALS_CrCtl_vDes_2B" 115 "SIGNALS_DFC_ctLDF_mp_2B" 116 "SIGNALS_DFES_ctDef_1B" 117 "SIGNALS_DFES_ctEntry_1B" 118 "SIGNALS_DFES_ctOBDPend_1B" 119 "SIGNALS_DFES_ctOBD_1B" 120 "SIGNALS_DSMAUX_ctWUC_1B" 121 "SIGNALS_DSMRdy_Why_CyclCmplComprCmpnt_mp_2B" 122 "SIGNALS_DSMRdy_Why_CyclCmplEGR_mp_2B" 123 "SIGNALS_DSMRdy_Why_CyclCmplFlSys_mp_2B" 124 "SIGNALS_DSMRdy_Why_RdyComprCmpnt_mp_2B" 125 "SIGNALS_DSMRdy_Why_RdyEGR_mp_2B" 126 "SIGNALS_DSMRdy_Why_RdyFlSys_mp_2B" 127 "SIGNALS_DSM_DisblMode_mp_2B" 128 "SIGNALS_DSM_stPostDrive_1B" 129 "SIGNALS_DSM_stRdyAB_1B" 130 "SIGNALS_DSM_stRdyCD_1B" 131 "SIGNALS_D_soc_2B" 132 "SIGNALS_Dffgen_1B" 133 "SIGNALS_Dfh_lerncnt_2B" 134 "SIGNALS_Dfh_lernpw_2B" 135 "SIGNALS_Dfh_pekpf_1B" 136 "SIGNALS_Dfh_pekpf_2B" 137 "SIGNALS_Dspl_volFlTnkQnt_2B" 138 "SIGNALS_ECBVlv_rAct_2B" 139 "SIGNALS_ECBVlv_rPs_2B" 140 "SIGNALS_EGRVlv_rAct_2B" 141 "SIGNALS_EGRVlv_rPs_1B" 142 "SIGNALS_EGRVlv_rPs_2B" 143 "SIGNALS_EGRVlv_r_2B" 144 "SIGNALS_EMDmp_rPs_0_2B" 145 "SIGNALS_ETClb_ctLrn_mp_0_2B" 146 "SIGNALS_ETClb_ctLrn_mp_1_2B" 147 "SIGNALS_ETClb_ctLrn_mp_2_2B" 148 "SIGNALS_ETClb_dtiETFlt0_mp_0_2B" 149 "SIGNALS_ETClb_dtiETFlt0_mp_1_2B" 150 "SIGNALS_ETClb_dtiETFlt0_mp_2_2B" 151 "SIGNALS_ETClb_dtiETFlt0_mp_3_2B" 152 "SIGNALS_ETClb_dtiETFlt0_mp_4_2B" 153 "SIGNALS_ETClb_dtiETFlt0_mp_5_2B" 154 "SIGNALS_ETClb_dtiETFlt1_mp_0_2B" 155 "SIGNALS_ETClb_dtiETFlt1_mp_1_2B" 156 "SIGNALS_ETClb_dtiETFlt1_mp_2_2B" 157 "SIGNALS_ETClb_dtiETFlt1_mp_3_2B" 158 "SIGNALS_ETClb_dtiETFlt1_mp_4_2B" 159 "SIGNALS_ETClb_dtiETFlt1_mp_5_2B" 160 "SIGNALS_ETClb_dtiETFlt2_mp_0_2B" 161 "SIGNALS_ETClb_dtiETFlt2_mp_1_2B" 162 "SIGNALS_ETClb_dtiETFlt2_mp_2_2B" 163 "SIGNALS_ETClb_dtiETFlt2_mp_3_2B" 164 "SIGNALS_ETClb_dtiETFlt2_mp_4_2B" 165 "SIGNALS_ETClb_dtiETFlt2_mp_5_2B" 166 "SIGNALS_ETClb_pRailSet_0_2B" 167 "SIGNALS_ETClb_pRailSet_1_2B" 168 "SIGNALS_ETClb_pRailSet_2_2B" 169 "SIGNALS_ETClb_stCor_1B" 170 "SIGNALS_ETClb_stRlsCylCor_mp_1B" 171 "SIGNALS_ETClb_tiETAvrg_0_2B" 172 "SIGNALS_ETClb_tiETAvrg_1_2B" 173 "SIGNALS_ETClb_tiETAvrg_2_2B" 174 "SIGNALS_ETClb_tiETMax_0_2B" 175 "SIGNALS_ETClb_tiETMax_1_2B" 176 "SIGNALS_ETClb_tiETMax_2_2B" 177 "SIGNALS_ETClb_tiETMin_0_2B" 178 "SIGNALS_ETClb_tiETMin_1_2B" 179 "SIGNALS_ETClb_tiETMin_2_2B" 180 "SIGNALS_EngDa_tEng_2B" 181 "SIGNALS_EngDa_tFld_0_2B" 182 "SIGNALS_EngDa_tFld_1_2B" 183 "SIGNALS_EngDa_tFld_2_2B" 184 "SIGNALS_EngDa_tFld_3_2B" 185 "SIGNALS_EngDa_tiEngOn_4B" 186 "SIGNALS_EngDem_trqLimErr_2B" 187 "SIGNALS_EngPrt_trqLim_2B" 188 "SIGNALS_EngReq_trqLim_2B" 189 "SIGNALS_EngTrqPtd_stLimDeb_mp_1B" 190 "SIGNALS_EngTrqPtd_stLimUnDeb_mp_1B" 191 "SIGNALS_EngTrqPtd_stPthLim_1B" 192 "SIGNALS_EngTrqPtd_trqASD_2B" 193 "SIGNALS_EngTrqPtd_trqLim_2B" 194 "SIGNALS_EngTrqPtd_trqSpdG_2B" 195 "SIGNALS_EnvP_p_1B" 196 "SIGNALS_EnvP_p_2B" 197 "SIGNALS_EnvP_uRaw_2B" 198 "SIGNALS_EnvT_t_1B" 199 "SIGNALS_EnvT_t_2B" 200 "SIGNALS_EpmCaS_phiOfsCorr_2B" 201 "SIGNALS_EpmHCrS_stSigMode_1B" 202 "SIGNALS_Epm_nEng_2B" 203 "SIGNALS_Epm_stOpMode_1B" 204 "SIGNALS_Epm_stSpd_1B" 205 "SIGNALS_Epm_stSync_1B" 206 "SIGNALS_ErrLmp_stMILReq_1B" 207 "SIGNALS_ErrLmp_stSVSReq_1B" 208 "SIGNALS_Exh_pAdapPPFltDiff_1B" 209 "SIGNALS_Exh_pAdapPPFltDiff_2B" 210 "SIGNALS_Exh_pAdapPPFltUs_1B" 211 "SIGNALS_Exh_pAdapPPFltUs_2B" 212 "SIGNALS_Exh_pDiffOfsValAct_mp_1B" 213 "SIGNALS_Exh_pDiffOfsValAct_mp_2B" 214 "SIGNALS_Exh_pFltPPFltDiff_1B" 215 "SIGNALS_Exh_pFltPPFltDiff_2B" 216 "SIGNALS_Exh_pFltPPFltUs_1B" 217 "SIGNALS_Exh_pFltPPFltUs_2B" 218 "SIGNALS_Exh_pPFltUs_1B" 219 "SIGNALS_Exh_pPFltUs_2B" 220 "SIGNALS_Exh_pRawAdapPPFltDiff_1B" 221 "SIGNALS_Exh_pRawAdapPPFltDiff_2B" 222 "SIGNALS_Exh_tOxiCatUs_1B" 223 "SIGNALS_Exh_tOxiCatUs_2B" 224 "SIGNALS_Exh_tPFltUs_1B" 225 "SIGNALS_Exh_tPFltUs_2B" 226 "SIGNALS_Exh_tSensTOxiCatUs_1B" 227 "SIGNALS_Exh_tSensTOxiCatUs_2B" 228 "SIGNALS_Exh_tSensTPFltUs_1B" 229 "SIGNALS_Exh_tSensTPFltUs_2B" 230 "SIGNALS_Exh_uRawPPFltUs_2B" 231 "SIGNALS_Exh_uRawTOxiCatUs_2B" 232 "SIGNALS_Exh_uRawTPFltUs_2B" 233 "SIGNALS_FBC_qDvtCylPhys_01_0_2B" 234 "SIGNALS_FBC_qDvtCylPhys_01_1_2B" 235 "SIGNALS_FBC_qDvtCylPhys_01_2_2B" 236 "SIGNALS_FBC_qDvtCylPhys_01_3_2B" 237 "SIGNALS_FBC_qDvtCylPhys_01_4_2B" 238 "SIGNALS_FBC_qDvtCylPhys_01_5_2B" 239 "SIGNALS_FBC_qDvtCyl_0_2B" 240 "SIGNALS_FBC_qDvtCyl_1_2B" 241 "SIGNALS_FBC_qDvtCyl_2_2B" 242 "SIGNALS_FBC_qDvtCyl_3_2B" 243 "SIGNALS_FBC_qDvtCyl_4_2B" 244 "SIGNALS_FBC_qDvtCyl_5_2B" 245 "SIGNALS_FMA_qMapRow0_mp_0_2B" 246 "SIGNALS_FMA_qMapRow0_mp_1_2B" 247 "SIGNALS_FMA_qMapRow0_mp_2_2B" 248 "SIGNALS_FMA_qMapRow0_mp_3_2B" 249 "SIGNALS_FMA_qMapRow0_mp_4_2B" 250 "SIGNALS_FMA_qMapRow0_mp_5_2B" 251 "SIGNALS_FMA_qMapRow0_mp_6_2B" 252 "SIGNALS_FMA_qMapRow0_mp_7_2B" 253 "SIGNALS_FMA_qMapRow1_mp_0_2B" 254 "SIGNALS_FMA_qMapRow1_mp_1_2B" 255 "SIGNALS_FMA_qMapRow1_mp_2_2B" 256 "SIGNALS_FMA_qMapRow1_mp_3_2B" 257 "SIGNALS_FMA_qMapRow1_mp_4_2B" 258 "SIGNALS_FMA_qMapRow1_mp_5_2B" 259 "SIGNALS_FMA_qMapRow1_mp_6_2B" 260 "SIGNALS_FMA_qMapRow1_mp_7_2B" 261 "SIGNALS_FMA_qMapRow2_mp_0_2B" 262 "SIGNALS_FMA_qMapRow2_mp_1_2B" 263 "SIGNALS_FMA_qMapRow2_mp_2_2B" 264 "SIGNALS_FMA_qMapRow2_mp_3_2B" 265 "SIGNALS_FMA_qMapRow2_mp_4_2B" 266 "SIGNALS_FMA_qMapRow2_mp_5_2B" 267 "SIGNALS_FMA_qMapRow2_mp_6_2B" 268 "SIGNALS_FMA_qMapRow2_mp_7_2B" 269 "SIGNALS_FMA_qMapRow3_mp_0_2B" 270 "SIGNALS_FMA_qMapRow3_mp_1_2B" 271 "SIGNALS_FMA_qMapRow3_mp_2_2B" 272 "SIGNALS_FMA_qMapRow3_mp_3_2B" 273 "SIGNALS_FMA_qMapRow3_mp_4_2B" 274 "SIGNALS_FMA_qMapRow3_mp_5_2B" 275 "SIGNALS_FMA_qMapRow3_mp_6_2B" 276 "SIGNALS_FMA_qMapRow3_mp_7_2B" 277 "SIGNALS_FMA_qMapRow4_mp_0_2B" 278 "SIGNALS_FMA_qMapRow4_mp_1_2B" 279 "SIGNALS_FMA_qMapRow4_mp_2_2B" 280 "SIGNALS_FMA_qMapRow4_mp_3_2B" 281 "SIGNALS_FMA_qMapRow4_mp_4_2B" 282 "SIGNALS_FMA_qMapRow4_mp_5_2B" 283 "SIGNALS_FMA_qMapRow4_mp_6_2B" 284 "SIGNALS_FMA_qMapRow4_mp_7_2B" 285 "SIGNALS_FMA_qMapRow5_mp_0_2B" 286 "SIGNALS_FMA_qMapRow5_mp_1_2B" 287 "SIGNALS_FMA_qMapRow5_mp_2_2B" 288 "SIGNALS_FMA_qMapRow5_mp_3_2B" 289 "SIGNALS_FMA_qMapRow5_mp_4_2B" 290 "SIGNALS_FMA_qMapRow5_mp_5_2B" 291 "SIGNALS_FMA_qMapRow5_mp_6_2B" 292 "SIGNALS_FMA_qMapRow5_mp_7_2B" 293 "SIGNALS_FMA_qMapRow6_mp_0_2B" 294 "SIGNALS_FMA_qMapRow6_mp_1_2B" 295 "SIGNALS_FMA_qMapRow6_mp_2_2B" 296 "SIGNALS_FMA_qMapRow6_mp_3_2B" 297 "SIGNALS_FMA_qMapRow6_mp_4_2B" 298 "SIGNALS_FMA_qMapRow6_mp_5_2B" 299 "SIGNALS_FMA_qMapRow6_mp_6_2B" 300 "SIGNALS_FMA_qMapRow6_mp_7_2B" 301 "SIGNALS_FMA_qMapRow7_mp_0_2B" 302 "SIGNALS_FMA_qMapRow7_mp_1_2B" 303 "SIGNALS_FMA_qMapRow7_mp_2_2B" 304 "SIGNALS_FMA_qMapRow7_mp_3_2B" 305 "SIGNALS_FMA_qMapRow7_mp_4_2B" 306 "SIGNALS_FMA_qMapRow7_mp_5_2B" 307 "SIGNALS_FMA_qMapRow7_mp_6_2B" 308 "SIGNALS_FMA_qMapRow7_mp_7_2B" 309 "SIGNALS_FMA_q_mp_2B" 310 "SIGNALS_FMA_stSwtOff_1B" 311 "SIGNALS_FMA_tiFuncOp_4B" 312 "SIGNALS_Fan_rPs_1B" 313 "SIGNALS_Fan_rPs_2B" 314 "SIGNALS_FlFltDsP_pSens_1B" 315 "SIGNALS_FlFltDsP_pSens_2B" 316 "SIGNALS_FlFltDsP_p_1B" 317 "SIGNALS_FlFltDsP_p_2B" 318 "SIGNALS_FlFltDsP_uRaw_1B" 319 "SIGNALS_FlFltDsP_uRaw_2B" 320 "SIGNALS_FlFltHt_stPs_1B" 321 "SIGNALS_FlFlt_stRaw_1B" 322 "SIGNALS_FuelLvl_vol_1B" 323 "SIGNALS_FuelLvl_vol_2B" 324 "SIGNALS_FuelT_t_1B" 325 "SIGNALS_FuelT_t_2B" 326 "SIGNALS_FuelT_uRaw_2B" 327 "SIGNALS_Gangi_1B" 328 "SIGNALS_Gbx_ctGbxNPosUnPls_1B" 329 "SIGNALS_Gbx_numGear_1B" 330 "SIGNALS_GlwCtl_stGlw_2B" 331 "SIGNALS_GlwEcu_lSum_mp_2B" 332 "SIGNALS_GlwEcu_pwrGlow_1B" 333 "SIGNALS_GlwEcu_pwrGlow_2B" 334 "SIGNALS_GlwEcu_stGPCMConfig_mp_1B" 335 "SIGNALS_GlwEcu_stGPCMDiag_1B" 336 "SIGNALS_GlwEcu_stGPType_mp_1B" 337 "SIGNALS_GlwEcu_stHSSOpen_1B" 338 "SIGNALS_GlwEcu_stHSSShort_1B" 339 "SIGNALS_GlwEcu_stHighresCold_1B" 340 "SIGNALS_GlwEcu_stHighresHot_1B" 341 "SIGNALS_GlwEcu_stLowresCold_1B" 342 "SIGNALS_GlwEcu_stLowresHot_1B" 343 "SIGNALS_GlwEcu_tGlwPlg_mp_1B" 344 "SIGNALS_GlwEcu_tGlwPlg_mp_2B" 345 "SIGNALS_GlwLmp_st_1B" 346 "SIGNALS_ISC_nSetPLo_0_2B" 347 "SIGNALS_ISC_nSetPLo_1_2B" 348 "SIGNALS_ISC_nSetPLo_2_2B" 349 "SIGNALS_ISC_nSetPLo_3_2B" 350 "SIGNALS_ISC_nSetPLo_4_2B" 351 "SIGNALS_ISC_nSetPLo_5_2B" 352 "SIGNALS_ISC_st_0_4B" 353 "SIGNALS_ISC_st_1_4B" 354 "SIGNALS_ISC_st_2_4B" 355 "SIGNALS_ISC_st_3_4B" 356 "SIGNALS_ISC_st_4_4B" 357 "SIGNALS_ISC_st_5_4B" 358 "SIGNALS_ISC_trq_2B" 359 "SIGNALS_IVActr_uCh_mp_2B" 360 "SIGNALS_IVActr_uUp_2B" 361 "SIGNALS_IVCtl_tiChrg_2B" 362 "SIGNALS_IVCtl_uUp_2B" 363 "SIGNALS_IVPlaus_nCyl_0_2B" 364 "SIGNALS_IVPlaus_nCyl_1_2B" 365 "SIGNALS_IVPlaus_nCyl_2_2B" 366 "SIGNALS_IVPlaus_nCyl_3_2B" 367 "SIGNALS_IVPlaus_nCyl_4_2B" 368 "SIGNALS_IVPlaus_nCyl_5_2B" 369 "SIGNALS_IVPlaus_nHiDwnRunUpTst_2B" 370 "SIGNALS_IVPlaus_nHiUpRunUpTst_2B" 371 "SIGNALS_IVPlaus_nLoDwnRunUpTst_2B" 372 "SIGNALS_IVPlaus_nLoUpRunUpTst_2B" 373 "SIGNALS_IVPlaus_qFBCCyl_0_2B" 374 "SIGNALS_IVPlaus_qFBCCyl_1_2B" 375 "SIGNALS_IVPlaus_qFBCCyl_2_2B" 376 "SIGNALS_IVPlaus_qFBCCyl_3_2B" 377 "SIGNALS_IVPlaus_qFBCCyl_4_2B" 378 "SIGNALS_IVPlaus_qFBCCyl_5_2B" 379 "SIGNALS_IVPlaus_stRefRunUpTst_2B" 380 "SIGNALS_IVPlaus_tiDwnRunUpTst_4B" 381 "SIGNALS_IVPlaus_tiUpRunUpTst_4B" 382 "SIGNALS_I_batt_2B" 383 "SIGNALS_I_gen_1B" 384 "SIGNALS_InjCrv_phiMI1Des_2B" 385 "SIGNALS_InjCrv_phiPiI1Des_2B" 386 "SIGNALS_InjCrv_phiPiI2Des_2B" 387 "SIGNALS_InjCrv_phiPoI1Des_2B" 388 "SIGNALS_InjCrv_phiPoI2Des_2B" 389 "SIGNALS_InjCrv_qPiI1Des_mp_2B" 390 "SIGNALS_InjCrv_qPiI2Des_mp_2B" 391 "SIGNALS_InjCrv_tiPiI1Des_2B" 392 "SIGNALS_InjCtl_qCurr_2B" 393 "SIGNALS_InjCtl_qRaw_2B" 394 "SIGNALS_InjCtl_qSetUnBal_1B" 395 "SIGNALS_InjCtl_qSetUnBal_2B" 396 "SIGNALS_InjUn_stStrt_1B" 397 "SIGNALS_InjVlv_tiMI1ET_mp_2B" 398 "SIGNALS_InjVlv_tiPiI1ET_mp_2B" 399 "SIGNALS_InjVlv_tiPiI2ET_mp_2B" 400 "SIGNALS_InjVlv_tiPoI1ET_mp_2B" 401 "SIGNALS_InjVlv_tiPoI2ET_mp_2B" 402 "SIGNALS_InjVlv_volMI1_mp_2B" 403 "SIGNALS_InjVlv_volPiI1_mp_2B" 404 "SIGNALS_LSU_rLam_1B" 405 "SIGNALS_LSU_rLam_2B" 406 "SIGNALS_LSU_rO2Adap_0_1B" 407 "SIGNALS_LSU_rO2Adap_0_2B" 408 "SIGNALS_LSU_rO2Raw_2B" 409 "SIGNALS_LSU_stAdap_1B" 410 "SIGNALS_LSU_stO2IntValid_1B" 411 "SIGNALS_Layer_stLPCOff_1B" 412 "SIGNALS_Md_gennm_2B" 413 "SIGNALS_MeUn_dvolSet_2B" 414 "SIGNALS_MeUn_iActFlt_mp_1B" 415 "SIGNALS_MeUn_iActFlt_mp_2B" 416 "SIGNALS_MeUn_iSet_1B" 417 "SIGNALS_MeUn_iSet_2B" 418 "SIGNALS_MeUn_rPs_mp_1B" 419 "SIGNALS_MeUn_rPs_mp_2B" 420 "SIGNALS_MeUn_stActrCtl_mp_1B" 421 "SIGNALS_MeUn_uRaw_mp_2B" 422 "SIGNALS_MoCADC_ctDebTst_1B" 423 "SIGNALS_MoCADC_facVltgRatio_2B" 424 "SIGNALS_MoCADC_st_1B" 425 "SIGNALS_MoCCom_Query_4B" 426 "SIGNALS_MoCCom_Response_4B" 427 "SIGNALS_MoCCom_ctErrFC_1B" 428 "SIGNALS_MoCCom_ctErrMM_1B" 429 "SIGNALS_MoCCom_ctErrSPI_1B" 430 "SIGNALS_MoCCom_ctSOPTstActv_1B" 431 "SIGNALS_MoCCom_st_1B" 432 "SIGNALS_MoCMem_st_1B" 433 "SIGNALS_MoCRom_numRomPageErr_1B" 434 "SIGNALS_MoCRom_ptrTabIndexAct_1B" 435 "SIGNALS_MoCSOP_stAct_1B" 436 "SIGNALS_MoCSOP_stActvMsg_1B" 437 "SIGNALS_MoCSOP_stErr_1B" 438 "SIGNALS_MoCSOP_stLdRespTab_1B" 439 "SIGNALS_MoCSOP_stRdyMsg_1B" 440 "SIGNALS_MoCSOP_stRdy_1B" 441 "SIGNALS_MoCSOP_st_1B" 442 "SIGNALS_MoFAPP_stTst_1B" 443 "SIGNALS_MoFAPP_u_1B" 444 "SIGNALS_MoFBrk_st_1B" 445 "SIGNALS_MoFCoEng_rTrqPtd_1B" 446 "SIGNALS_MoFCoOfs_rTrqPtdMsg_1B" 447 "SIGNALS_MoFCoOfs_rTrqPtdOfs_1B" 448 "SIGNALS_MoFCoVeh_trqVehPtd_2B" 449 "SIGNALS_MoFDrAs_trqPtd_2B" 450 "SIGNALS_MoFDrDem_rAPP_1B" 451 "SIGNALS_MoFDrDem_trqPtd_2B" 452 "SIGNALS_MoFESpd_nEng_1B" 453 "SIGNALS_MoFESpd_phiGT1Last_4B" 454 "SIGNALS_MoFESpd_stSync_1B" 455 "SIGNALS_MoFETC_stTst_1B" 456 "SIGNALS_MoFExtInt_trqPtd_2B" 457 "SIGNALS_MoFIn_st_1B" 458 "SIGNALS_MoFInjDat_ctDebQntErr_1B" 459 "SIGNALS_MoFInjDat_facPoI1EffSet_2B" 460 "SIGNALS_MoFInjDat_facPoI2EffSet_2B" 461 "SIGNALS_MoFInjDat_pLinCurr_mp_1B" 462 "SIGNALS_MoFInjDat_p_1B" 463 "SIGNALS_MoFInjDat_phiMI1_2B" 464 "SIGNALS_MoFInjDat_phiPiI1_2B" 465 "SIGNALS_MoFInjDat_phiPiI2_2B" 466 "SIGNALS_MoFInjDat_phiPoI1_2B" 467 "SIGNALS_MoFInjDat_phiPoI2_2B" 468 "SIGNALS_MoFInjDat_stInjState_1B" 469 "SIGNALS_MoFInjDat_stPressSRC_1B" 470 "SIGNALS_MoFInjDat_tiMI1PoI1_2B" 471 "SIGNALS_MoFInjDat_tiMI1PoI2_2B" 472 "SIGNALS_MoFInjDat_tiPiI1ZFCETCor_2B" 473 "SIGNALS_MoFInjDat_tiPiI2ZFCETCor_2B" 474 "SIGNALS_MoFInjDat_tiPiI3ZFCETCor_2B" 475 "SIGNALS_MoFInjDat_tiTDCAvrg_2B" 476 "SIGNALS_MoFInjDat_uRaw_mp_1B" 477 "SIGNALS_MoFInjQnt_qPoI1Cor_2B" 478 "SIGNALS_MoFInjQnt_qPoI2Cor_2B" 479 "SIGNALS_MoFMode_ctDebPoI1Err_1B" 480 "SIGNALS_MoFMode_ctDebPoI2Err_1B" 481 "SIGNALS_MoFMode_qSetUnBal_2B" 482 "SIGNALS_MoFMode_stOpModeMsg_2B" 483 "SIGNALS_MoFOvR_stRls_2B" 484 "SIGNALS_MoFQntCor_qMI1_2B" 485 "SIGNALS_MoFQntCor_stInj_1B" 486 "SIGNALS_MoFQntCor_stMI1ErrAct_mp_1B" 487 "SIGNALS_MoFQntCor_stPiI1ErrAct_mp_1B" 488 "SIGNALS_MoFQntCor_stPoI1ErrAct_mp_1B" 489 "SIGNALS_MoFQntCor_stPoI2ErrAct_mp_1B" 490 "SIGNALS_MoFRailP_ctDebErr_1B" 491 "SIGNALS_MoFRailP_ctDebGradMax_1B" 492 "SIGNALS_MoFRailP_p_1B" 493 "SIGNALS_MoFTrqIdc_facEtaCor_mp_2B" 494 "SIGNALS_MoFTrqIdc_rTrq_1B" 495 "SIGNALS_OBD_PID01_DSMRdy_xPId1_4B" 496 "SIGNALS_OBD_PID04_CoETS_rTrq_1B" 497 "SIGNALS_OBD_PID05_CEngDsT_tSens_1B" 498 "SIGNALS_OBD_PID0B_Air_pSensPIntkVUs_1B" 499 "SIGNALS_OBD_PID0C_Epm_nEngRaw_2B" 500 "SIGNALS_OBD_PID0D_VehV_v_1B" 501 "SIGNALS_OBD_PID0F_Air_tSensTCACDs_1B" 502 "SIGNALS_OBD_PID10_AFS_dmSens_2B" 503 "SIGNALS_OBD_PID11_ThrVlv_rSens_1B" 504 "SIGNALS_OBD_PID1C_I15031_PID1C_1B" 505 "SIGNALS_OBD_PID1D_I15031_PID1D_1B" 506 "SIGNALS_OBD_PID1F_CoEng_tiNormal_2B" 507 "SIGNALS_OBD_PID21_DSMDur_ctGlb_0_2B" 508 "SIGNALS_OBD_PID23_RailP_pLin_2B" 509 "SIGNALS_OBD_PID24_LSU_rLam_uO2Raw_AB_2B" 510 "SIGNALS_OBD_PID24_LSU_rLam_uO2Raw_CD_2B" 511 "SIGNALS_OBD_PID2C_EGRVlv_r_1B" 512 "SIGNALS_OBD_PID2D_AirCtl_rGovDvtNrm_1B" 513 "SIGNALS_OBD_PID30_DSMAUX_ctWUC_1B" 514 "SIGNALS_OBD_PID33_EnvP_pSens_1B" 515 "SIGNALS_OBD_PID3C_Exh_tSensTPFltUs_2B" 516 "SIGNALS_OBD_PID41_DSMRdy_xPId41_4B" 517 "SIGNALS_OBD_PID42_BattU_uSens_2B" 518 "SIGNALS_OBD_PID45_ThrVlv_rAct_1B" 519 "SIGNALS_OBD_PID46_EnvT_tSens_1B" 520 "SIGNALS_OBD_PID49_APP_rUnFlt_1B" 521 "SIGNALS_OBD_PID4A_APP_uRaw2_1B" 522 "SIGNALS_OBD_PID4C_ThrVlv_r_1B" 523 "SIGNALS_OBD_PID4F_I15031_PID4FA_1B" 524 "SIGNALS_OBD_PID4F_I15031_PID4FB_1B" 525 "SIGNALS_OBD_PID4F_I15031_PID4FC_1B" 526 "SIGNALS_OBD_PID4F_I15031_PID4FD_1B" 527 "SIGNALS_OilPLmp_st_2B" 528 "SIGNALS_Oil_tSwmp_2B" 529 "SIGNALS_Oz_kvbmw_4B" 530 "SIGNALS_Oz_kvbog_2B" 531 "SIGNALS_Oz_kvbsm_4B" 532 "SIGNALS_Oz_kvbsm_ul_4B" 533 "SIGNALS_Oz_lp_1B" 534 "SIGNALS_Oz_lv_1B" 535 "SIGNALS_Oz_nivkrzt_1B" 536 "SIGNALS_Oz_nivlangt_1B" 537 "SIGNALS_Oz_oelkm_2B" 538 "SIGNALS_Oz_orikor_1B" 539 "SIGNALS_PCBS_lDistanceOut_2B" 540 "SIGNALS_PCBS_lSumDPFChng_4B" 541 "SIGNALS_PCR_pDesBasLP_mp_2B" 542 "SIGNALS_PCR_pDesBas_mp_2B" 543 "SIGNALS_PCR_pDesValLP_2B" 544 "SIGNALS_PCR_pDesVal_1B" 545 "SIGNALS_PCR_pDesVal_2B" 546 "SIGNALS_PCR_pGovDvtLP_2B" 547 "SIGNALS_PCR_pGovDvt_2B" 548 "SIGNALS_PCR_rCtlVal_2B" 549 "SIGNALS_PCR_stMonLP_1B" 550 "SIGNALS_PCR_stMon_1B" 551 "SIGNALS_PCR_stNrmOpLP_mp_1B" 552 "SIGNALS_PCR_stNrmOp_mp_1B" 553 "SIGNALS_PCR_stPCRBitsLP_4B" 554 "SIGNALS_PCR_stPCRBits_4B" 555 "SIGNALS_PCR_stWrkSphLP_mp_1B" 556 "SIGNALS_PCR_stWrkSph_mp_1B" 557 "SIGNALS_PCV_facAdapt_1B" 558 "SIGNALS_PCV_facAdapt_2B" 559 "SIGNALS_PCV_iActFlt_mp_1B" 560 "SIGNALS_PCV_iActFlt_mp_2B" 561 "SIGNALS_PCV_iSet_1B" 562 "SIGNALS_PCV_iSet_2B" 563 "SIGNALS_PCV_pSet_2B" 564 "SIGNALS_PCV_rPs_1B" 565 "SIGNALS_PCV_rPs_2B" 566 "SIGNALS_PCV_stActrCtl_1B" 567 "SIGNALS_PCV_uRaw_mp_2B" 568 "SIGNALS_PFltLd_mAshOilEG_2B" 569 "SIGNALS_PFltLd_mSotSim_2B" 570 "SIGNALS_PFltLd_mSot_2B" 571 "SIGNALS_PFltLd_resFlwFlt_1B" 572 "SIGNALS_PFltLd_resFlwFlt_2B" 573 "SIGNALS_PFltRgn_dqFlAvrg_mp_1B" 574 "SIGNALS_PFltRgn_dqFlAvrg_mp_2B" 575 "SIGNALS_PFltRgn_lSnceRgn_4B" 576 "SIGNALS_PFltRgn_lSumRgnBck0_mp_4B" 577 "SIGNALS_PFltRgn_lSumRgnBck1_mp_4B" 578 "SIGNALS_PFltRgn_lSumRgnBck2_mp_4B" 579 "SIGNALS_PFltRgn_lSumRgnBck3_mp_4B" 580 "SIGNALS_PFltRgn_lSumRgnBck4_mp_4B" 581 "SIGNALS_PFltRgn_numRgn_1B" 582 "SIGNALS_PFltRgn_qFl_mp_2B" 583 "SIGNALS_PFltRgn_stIntr_2B" 584 "SIGNALS_PFltRgn_stLck_1B" 585 "SIGNALS_PFlt_ctRgnStep1_mp_1B" 586 "SIGNALS_PFlt_ctRgnStep2_mp_1B" 587 "SIGNALS_PFlt_ctRgnStep3_mp_1B" 588 "SIGNALS_PFlt_ctRgnStep4_mp_1B" 589 "SIGNALS_PFlt_ctRgnStep5_mp_1B" 590 "SIGNALS_PFlt_ctRgnStep6_mp_1B" 591 "SIGNALS_PFlt_ctRgnStep7_mp_1B" 592 "SIGNALS_PFlt_ctRgnStep8_mp_1B" 593 "SIGNALS_PFlt_lAvrgRgn_1B" 594 "SIGNALS_PFlt_lAvrgRgn_2B" 595 "SIGNALS_PFlt_pPreCorr_mp_2B" 596 "SIGNALS_PFlt_stPresPlaus_mp_1B" 597 "SIGNALS_PSP_dvolOut_1B" 598 "SIGNALS_PSP_dvolOut_2B" 599 "SIGNALS_PT_stTraType_1B" 600 "SIGNALS_Pbremsu_2B" 601 "SIGNALS_Pr_bn_soll_1B" 602 "SIGNALS_Ptc_pwr_1B" 603 "SIGNALS_PthSet_stActvMonLim_1B" 604 "SIGNALS_PthSet_trqInrSetNoMo_2B" 605 "SIGNALS_PthSet_trqInrSet_2B" 606 "SIGNALS_QWC_tiPiI1MI1_mp_2B" 607 "SIGNALS_RailP_pCurr_mp_2B" 608 "SIGNALS_RailP_pFlt_1B" 609 "SIGNALS_RailP_pFlt_2B" 610 "SIGNALS_RailP_pLin_2B" 611 "SIGNALS_RailP_stGrad_1B" 612 "SIGNALS_RailP_uRaw_2B" 613 "SIGNALS_Rail_dvolPreCtl_2B" 614 "SIGNALS_Rail_pDvt_2B" 615 "SIGNALS_Rail_pSetPoint_1B" 616 "SIGNALS_Rail_pSetPoint_2B" 617 "SIGNALS_Rail_stCPC_1B" 618 "SIGNALS_Rail_stCtlLoop_1B" 619 "SIGNALS_Rail_stDwn1HpTst_4B" 620 "SIGNALS_Rail_stDwn2HpTst_4B" 621 "SIGNALS_Rail_stDwn3HpTst_4B" 622 "SIGNALS_Rail_stDwnHpTst_0_1B" 623 "SIGNALS_Rail_stDwnHpTst_1_1B" 624 "SIGNALS_Rail_stDwnHpTst_2_1B" 625 "SIGNALS_Rail_stDwnHpTst_3_1B" 626 "SIGNALS_Rail_stDwnHpTst_4_1B" 627 "SIGNALS_Rail_stRefHpTst_2B" 628 "SIGNALS_Rail_stStMHpTst_1B" 629 "SIGNALS_Rail_stUpHpTst_0_1B" 630 "SIGNALS_Rail_stUpHpTst_1_1B" 631 "SIGNALS_Rail_stUpHpTst_2_1B" 632 "SIGNALS_Rail_stUpHpTst_3_1B" 633 "SIGNALS_Rail_stUpHpTst_4_1B" 634 "SIGNALS_Rail_tiDwnHpTst_0_4B" 635 "SIGNALS_Rail_tiDwnHpTst_1_4B" 636 "SIGNALS_Rail_tiDwnHpTst_2_4B" 637 "SIGNALS_Rail_tiDwnHpTst_3_4B" 638 "SIGNALS_Rail_tiDwnHpTst_4_4B" 639 "SIGNALS_Rail_tiDwnHpTst_5_4B" 640 "SIGNALS_Rail_tiDwnHpTst_6_4B" 641 "SIGNALS_Rail_tiUpHpTst_0_4B" 642 "SIGNALS_Rail_tiUpHpTst_1_4B" 643 "SIGNALS_Rail_tiUpHpTst_2_4B" 644 "SIGNALS_Rail_tiUpHpTst_3_4B" 645 "SIGNALS_Reset_Env_adLoc_mp_4B" 646 "SIGNALS_Reset_Env_xId_mp_2B" 647 "SIGNALS_Rf_2B" 648 "SIGNALS_RngMod_trqFrc_2B" 649 "SIGNALS_Shtr_rPs_1B" 650 "SIGNALS_Shtr_rPs_2B" 651 "SIGNALS_Shtr_r_2B" 652 "SIGNALS_SmkLim_qLimSmk_2B" 653 "SIGNALS_SpdGov_trqSet_2B" 654 "SIGNALS_St_dfh0_1B" 655 "SIGNALS_St_msaaa_1B" 656 "SIGNALS_St_msaaad_2B" 657 "SIGNALS_St_msaanz_2B" 658 "SIGNALS_St_msaav_1B" 659 "SIGNALS_St_msaavd1_2B" 660 "SIGNALS_St_msaavd2_2B" 661 "SIGNALS_St_msaavd_4B" 662 "SIGNALS_St_msaea_1B" 663 "SIGNALS_St_msaev_1B" 664 "SIGNALS_St_ngang_1B" 665 "SIGNALS_Stat_entl_1B" 666 "SIGNALS_Stat_sv_reg2_1B" 667 "SIGNALS_SyC_stSub_1B" 668 "SIGNALS_T15_st_1B" 669 "SIGNALS_T_batt_2B" 670 "SIGNALS_ThrVlv_rAct_2B" 671 "SIGNALS_ThrVlv_rPs_1B" 672 "SIGNALS_ThrVlv_rPs_2B" 673 "SIGNALS_Tn_abstell_2B" 674 "SIGNALS_Toel_2B" 675 "SIGNALS_Tra_numGear_1B" 676 "SIGNALS_TrbChLP_rPs_1B" 677 "SIGNALS_TrbChLP_rPs_2B" 678 "SIGNALS_TrbChLP_r_2B" 679 "SIGNALS_TrbCh_rPs_1B" 680 "SIGNALS_TrbCh_rPs_2B" 681 "SIGNALS_TrbCh_rRaw_2B" 682 "SIGNALS_TrbCh_r_2B" 683 "SIGNALS_TrbnDsRLam_rLamRec_2B" 684 "SIGNALS_Tw_2B" 685 "SIGNALS_Tw_agr_2B" 686 "SIGNALS_Tw_agrcntg_4B" 687 "SIGNALS_Tw_agrmax_2B" 688 "SIGNALS_Tw_noagr_2B" 689 "SIGNALS_Tw_noagrcntg_4B" 690 "SIGNALS_Tw_noagrmax_2B" 691 "SIGNALS_U_batt_2B" 692 "SIGNALS_U_bn_soll_1B" 693 "SIGNALS_U_gen_2B" 694 "SIGNALS_Uekp_1B" 695 "SIGNALS_VSwVlv_rAct_2B" 696 "SIGNALS_VSwVlv_rPs_1B" 697 "SIGNALS_VSwVlv_rPs_2B" 698 "SIGNALS_VehV_a_2B" 699 "SIGNALS_VehV_v_2B" 700 "SIGNALS_WaHtEl_rPs_1B" 701 "SIGNALS_WaHtEl_rPs_2B" 702 "SIGNALS_WaHt_stShutOff_mp_2B" /end COMPU_VTAB
/begin COMPU_METHOD TransR "" RAT_FUNC "%4.2" "-" COEFFS 0 100 0 0 0 1 /end COMPU_METHOD
/begin COMPU_METHOD Trq "" RAT_FUNC "%5.1" "Nm" COEFFS 0 10 0 0 0 1 /end COMPU_METHOD
/begin COMPU_METHOD TrqPrpHigh "" RAT_FUNC "%5.1" "Nm" COEFFS 0 10 0 0 0 1 /end COMPU_METHOD
/begin RECORD_LAYOUT Kw_Ws16 FNC_VALUES 1 SWORD COLUMN_DIR DIRECT /end RECORD_LAYOUT
/begin RECORD_LAYOUT ValA_Wu16 FNC_VALUES 1 UWORD COLUMN_DIR DIRECT /end RECORD_LAYOUT
/begin RECORD_LAYOUT ValA_Wu8 FNC_VALUES 1 UBYTE COLUMN_DIR DIRECT /end RECORD_LAYOUT
/begin RECORD_LAYOUT Val_Ws16 FNC_VALUES 1 SWORD COLUMN_DIR DIRECT /end RECORD_LAYOUT
/begin RECORD_LAYOUT Val_Ws32 FNC_VALUES 1 SLONG COLUMN_DIR DIRECT /end RECORD_LAYOUT
/begin RECORD_LAYOUT Val_Wu16 FNC_VALUES 1 UWORD COLUMN_DIR DIRECT /end RECORD_LAYOUT
/begin RECORD_LAYOUT Val_Wu8 FNC_VALUES 1 UBYTE COLUMN_DIR DIRECT /end RECORD_LAYOUT
/end MODULE
/end PROJECT

ASAP2_VERSION 1 4
/begin PROJECT P_574 "EDC17_CP09"
/begin HEADER "" VERSION "V8KB" PROJECT_NO P_574 /end HEADER
/begin MODULE DIM ""
/begin MOD_COMMON "" BYTE_ORDER MSB_LAST ALIGNMENT_BYTE 1 ALIGNMENT_WORD 2 ALIGNMENT_LONG 4 ALIGNMENT_FLOAT32_IEEE 4 /end MOD_COMMON
/begin CHARACTERISTIC DFES_DTCO.DFC_NSCDsShCir_C "DFES/OBD spezifischer Fehlercode für Prüfung DFC_NSCDsShCir" VALUE 0x800295D4 Val_Wu16 65535.00 DFES_OneToOne 0.00 65535.00 /end CHARACTERISTIC
/begin CHARACTERISTIC DFES_DTCO.DFC_NoCat2DsCmpChk_C "DFES/OBD spezifischer Fehlercode für Prüfung DFC_NoCat2DsCmpChk" VALUE 0x800295D6 Val_Wu16 65535.00 DFES_OneToOne 0.00 65535.00 /end CHARACTERISTIC
/begin CHARACTERISTIC DFES_DTCO.DFC_NoCat2DsLamBinSRCMax_C "DFES/OBD spezifischer Fehlercode für Prüfung DFC_NoCat2DsLamBinSRCMax" VALUE 0x800295D8 Val_Wu16 65535.00 DFES_OneToOne 0.00 65535.00 /end CHARACTERISTIC
/begin CHARACTERISTIC DFES_DTCO.DFC_NoCat2DsLamBinSRCMin_C "DFES/OBD spezifischer Fehlercode für Prüfung DFC_NoCat2DsLamBinSRCMin" VALUE 0x800295DA Val_Wu16 65535.00 DFES_OneToOne 0.00 65535.00 /end CHARACTERISTIC
/begin CHARACTERISTIC DFES_DTCO.DFC_NoCat2DsLamLinSRCMax_C "DFES/OBD spezifischer Fehlercode für Prüfung DFC_NoCat2DsLamLinSRCMax" VALUE 0x800295DC Val_Wu16 65535.00 DFES_OneToOne 0.00 65535.00 /end CHARACTERISTIC
/begin CHARACTERISTIC DFES_DTCO.DFC_NoCat2DsLamLinSRCMin_C "DFES/OBD spezifischer Fehlercode für Prüfung DFC_NoCat2DsLamLinSRCMin" VALUE 0x800295DE Val_Wu16 65535.00 DFES_OneToOne 0.00 65535.00 /end CHARACTERISTIC
/begin CHARACTERISTIC DFES_DTCO.DFC_NoCat2DsLamPlausMax_C "DFES/OBD spezifischer Fehlercode für Prüfung DFC_NoCat2DsLamPlausMax" VALUE 0x800295E0 Val_Wu16 65535.00 DFES_OneToOne 0.00 65535.00 /end CHARACTERISTIC
/begin CHARACTERISTIC DFES_DTCO.DFC_NoCat2DsLamPlausMin_C "DFES/OBD spezifischer Fehlercode für Prüfung DFC_NoCat2DsLamPlausMin" VALUE 0x800295E2 Val_Wu16 65535.00 DFES_OneToOne 0.00 65535.00 /end CHARACTERISTIC
/begin CHARACTERISTIC DFES_DTCO.DFC_NoCat2DsNOxSRCMax_C "DFES/OBD spezifischer Fehlercode für Prüfung DFC_NoCat2DsNOxSRCMax" VALUE 0x800295E4 Val_Wu16 65535.00 DFES_OneToOne 0.00 65535.00 /end CHARACTERISTIC
/begin CHARACTERISTIC DFES_DTCO.DFC_NoCat2DsNOxSRCMin_C "DFES/OBD spezifischer Fehlercode für Prüfung DFC_NoCat2DsNOxSRCMin" VALUE 0x800295E6 Val_Wu16 65535.00 DFES_OneToOne 0.00 65535.00 /end CHARACTERISTIC
/begin CHARACTERISTIC DFES_DTCO.DFC_NoCat2DsOpCir_C "DFES/OBD spezifischer Fehlercode für Prüfung DFC_NoCat2DsOpCir" VALUE 0x800295E8 Val_Wu16 65535.00 DFES_OneToOne 0.00 65535.00 /end CHARACTERISTIC
/begin CHARACTERISTIC DFES_DTCO.DFC_NoCat2DsShCir_C "DFES/OBD spezifischer Fehlercode für Prüfung DFC_NoCat2DsShCir" VALUE 0x800295EA Val_Wu16 65535.00 DFES_OneToOne 0.00 65535.00 /end CHARACTERISTIC
/begin CHARACTERISTIC DFES_DTCO.DFC_NplDynPPFltDiff_C "DFES/OBD spezifischer Fehlercode für Prüfung DFC_NplDynPPFltDiff" VALUE 0x800295EC Val_Wu16 65535.00 DFES_OneToOne 0.00 65535.00 /end CHARACTERISTIC
/begin CHARACTERISTIC DFES_DTCO.DFC_NplHsChngPPFltDiff_C "DFES/OBD spezifischer Fehlercode für Prüfung DFC_NplHsChngPPFltDiff" VALUE 0x800295EE Val_Wu16 65535.00 DFES_OneToOne 0.00 65535.00 /end CHARACTERISTIC
/begin CHARACTERISTIC DFES_DTCO.DFC_NplHsLnPPFltDiff_C "DFES/OBD spezifischer Fehlercode für Prüfung DFC_NplHsLnPPFltDiff" VALUE 0x800295F0 Val_Wu16 65535.00 DFES_OneToOne 0.00 65535.00 /end CHARACTERISTIC
/begin CHARACTERISTIC DFES_DTCO.DFC_NplTOxiCatUs_C "DFES/OBD spezifischer Fehlercode für Prüfung DFC_NplTOxiCatUs" VALUE 0x800295F2 Val_Wu16 65535.00 DFES_OneToOne 0.00 65535.00 /end CHARACTERISTIC
/begin CHARACTERISTIC DFES_DTCO.DFC_NplTPFltUs_C "DFES/OBD spezifischer Fehlercode für Prüfung DFC_NplTPFltUs" VALUE 0x800295F4 Val_Wu16 65535.00 DFES_OneToOne 0.00 65535.00 /end CHARACTERISTIC
/begin CHARACTERISTIC DFES_DTCO.DFC_NplTTrbnUs_C "DFES/OBD spezifischer Fehlercode für Prüfung DFC_NplTTrbnUs" VALUE 0x800295F6 Val_Wu16 65535.00 DFES_OneToOne 0.00 65535.00 /end CHARACTERISTIC
/begin CHARACTERISTIC DFES_DTCO.DFC_OilPSwmpSRCMax_C "DFES/OBD spezifischer Fehlercode für Prüfung DFC_OilPSwmpSRCMax" VALUE 0x800295F8 Val_Wu16 65535.00 DFES_OneToOne 0.00 65535.00 /end CHARACTERISTIC
/begin CHARACTERISTIC DFES_DTCO.DFC_OilPSwmpSRCMin_C "DFES/OBD spezifischer Fehlercode für Prüfung DFC_OilPSwmpSRCMin" VALUE 0x800295FA Val_Wu16 65535.00 DFES_OneToOne 0.00 65535.00 /end CHARACTERISTIC
/begin CHARACTERISTIC DFES_DTCO.DFC_PCVSCG_C "DFES/OBD spezifischer Fehlercode für Prüfung DFC_PCVSCG" VALUE 0x800295FC Val_Wu16 65535.00 DFES_OneToOne 0.00 65535.00 /end CHARACTERISTIC
/begin CHARACTERISTIC DFES_DTCO.DFC_PFltCharPDiffMin_C "DFES/OBD spezifischer Fehlercode für Prüfung DFC_PFltCharPDiffMin" VALUE 0x800295FE Val_Wu16 65535.00 DFES_OneToOne 0.00 65535.00 /end CHARACTERISTIC
/begin CHARACTERISTIC DFES_DTCO.DFC_PFltDstrMin_C "DFES/OBD spezifischer Fehlercode für Prüfung DFC_PFltDstrMin" VALUE 0x80029600 Val_Wu16 65535.00 DFES_OneToOne 0.00 65535.00 /end CHARACTERISTIC
/begin CHARACTERISTIC DFES_DTCO.DFC_PFltEngPrt_C "DFES/OBD spezifischer Fehlercode für Prüfung DFC_PFltEngPrt" VALUE 0x80029602 Val_Wu16 65535.00 DFES_OneToOne 0.00 65535.00 /end CHARACTERISTIC
/begin CHARACTERISTIC DFES_DTCO.DFC_PFltRgnPerm_C "DFES/OBD spezifischer Fehlercode für Prüfung DFC_PFltRgnPerm" VALUE 0x80029604 Val_Wu16 65535.00 DFES_OneToOne 0.00 65535.00 /end CHARACTERISTIC
/begin CHARACTERISTIC DFES_DTCO.DFC_PFltSRCMaxFlwRstn_C "DFES/OBD spezifischer Fehlercode für Prüfung DFC_PFltSRCMaxFlwRstn" VALUE 0x80029606 Val_Wu16 65535.00 DFES_OneToOne 0.00 65535.00 /end CHARACTERISTIC
/begin CHARACTERISTIC DFES_DTCO.DFC_PFltSRCMinFlwRstn_C "DFES/OBD spezifischer Fehlercode für Prüfung DFC_PFltSRCMinFlwRstn" VALUE 0x80029608 Val_Wu16 65535.00 DFES_OneToOne 0.00 65535.00 /end CHARACTERISTIC
/begin CHARACTERISTIC DFES_DTCO.DFC_PFltSotMsDvtMax_C "DFES/OBD spezifischer Fehlercode für Prüfung DFC_PFltSotMsDvtMax" VALUE 0x8002960A Val_Wu16 65535.00 DFES_OneToOne 0.00 65535.00 /end CHARACTERISTIC
/begin CHARACTERISTIC DFES_DTCO.DFC_PFltSotMsDvtMin_C "DFES/OBD spezifischer Fehlercode für Prüfung DFC_PFltSotMsDvtMin" VALUE 0x8002960C Val_Wu16 65535.00 DFES_OneToOne 0.00 65535.00 /end CHARACTERISTIC
/begin CHARACTERISTIC DFES_DTCO.DFC_PFltSotMsMax_C "DFES/OBD spezifischer Fehlercode für Prüfung DFC_PFltSotMsMax" VALUE 0x8002960E Val_Wu16 65535.00 DFES_OneToOne 0.00 65535.00 /end CHARACTERISTIC
/begin CHARACTERISTIC DFES_DTCO.DFC_PIntkVUsSRCMax_C "DFES/OBD spezifischer Fehlercode für Prüfung DFC_PIntkVUsSRCMax" VALUE 0x80029610 Val_Wu16 65535.00 DFES_OneToOne 0.00 65535.00 /end CHARACTERISTIC
/begin CHARACTERISTIC DFES_DTCO.DFC_PIntkVUsSRCMin_C "DFES/OBD spezifischer Fehlercode für Prüfung DFC_PIntkVUsSRCMin" VALUE 0x80029612 Val_Wu16 65535.00 DFES_OneToOne 0.00 65535.00 /end CHARACTERISTIC
/begin CHARACTERISTIC DFES_DTCO.DFC_SRCHighAPP1_C "DFES/OBD spezifischer Fehlercode für Prüfung DFC_SRCHighAPP1" VALUE 0x80029614 Val_Wu16 65535.00 DFES_OneToOne 0.00 65535.00 /end CHARACTERISTIC
/begin CHARACTERISTIC DFES_DTCO.DFC_SRCHighAPP2_C "DFES/OBD spezifischer Fehlercode für Prüfung DFC_SRCHighAPP2" VALUE 0x80029616 Val_Wu16 65535.00 DFES_OneToOne 0.00 65535.00 /end CHARACTERISTIC
/begin CHARACTERISTIC DFES_DTCO.DFC_SRCLowAPP1_C "DFES/OBD spezifischer Fehlercode für Prüfung DFC_SRCLowAPP1" VALUE 0x80029618 Val_Wu16 65535.00 DFES_OneToOne 0.00 65535.00 /end CHARACTERISTIC
/begin CHARACTERISTIC DFES_DTCO.DFC_SRCLowAPP2_C "DFES/OBD spezifischer Fehlercode für Prüfung DFC_SRCLowAPP2" VALUE 0x8002961A Val_Wu16 65535.00 DFES_OneToOne 0.00 65535.00 /end CHARACTERISTIC
/begin CHARACTERISTIC DFES_DTCO.DFC_SRCMaxPPFltDiff_C "DFES/OBD spezifischer Fehlercode für Prüfung DFC_SRCMaxPPFltDiff" VALUE 0x8002961C Val_Wu16 65535.00 DFES_OneToOne 0.00 65535.00 /end CHARACTERISTIC
/begin CHARACTERISTIC DFES_DTCO.DFC_SRCMaxPPFltUs_C "DFES/OBD spezifischer Fehlercode für Prüfung DFC_SRCMaxPPFltUs" VALUE 0x8002961E Val_Wu16 65535.00 DFES_OneToOne 0.00 65535.00 /end CHARACTERISTIC
/begin CHARACTERISTIC DFES_DTCO.DFC_SRCMaxTECU_C "DFES/OBD spezifischer Fehlercode für Prüfung DFC_SRCMaxTECU" VALUE 0x80029620 Val_Wu16 65535.00 DFES_OneToOne 0.00 65535.00 /end CHARACTERISTIC
/begin CHARACTERISTIC DFES_DTCO.DFC_SRCMaxTOxiCatUs_C "DFES/OBD spezifischer Fehlercode für Prüfung DFC_SRCMaxTOxiCatUs" VALUE 0x80029622 Val_Wu16 65535.00 DFES_OneToOne 0.00 65535.00 /end CHARACTERISTIC
/begin CHARACTERISTIC DFES_DTCO.DFC_SRCMaxTPFltUs_C "DFES/OBD spezifischer Fehlercode für Prüfung DFC_SRCMaxTPFltUs" VALUE 0x80029624 Val_Wu16 65535.00 DFES_OneToOne 0.00 65535.00 /end CHARACTERISTIC
/begin CHARACTERISTIC DFES_DTCO.DFC_SRCMaxTTrbnUs_C "DFES/OBD spezifischer Fehlercode für Prüfung DFC_SRCMaxTTrbnUs" VALUE 0x80029626 Val_Wu16 65535.00 DFES_OneToOne 0.00 65535.00 /end CHARACTERISTIC
/begin CHARACTERISTIC DFES_DTCO.DFC_SRCMaxUCatUsT_C "DFES/OBD spezifischer Fehlercode für Prüfung DFC_SRCMaxUCatUsT" VALUE 0x80029628 Val_Wu16 65535.00 DFES_OneToOne 0.00 65535.00 /end CHARACTERISTIC
/begin CHARACTERISTIC DFES_DTCO.DFC_SRCMaxUPmpP_C "DFES/OBD spezifischer Fehlercode für Prüfung DFC_SRCMaxUPmpP" VALUE 0x8002962A Val_Wu16 65535.00 DFES_OneToOne 0.00 65535.00 /end CHARACTERISTIC
/begin CHARACTERISTIC DFES_DTCO.DFC_SRCMinPPFltDiff_C "DFES/OBD spezifischer Fehlercode für Prüfung DFC_SRCMinPPFltDiff" VALUE 0x8002962C Val_Wu16 65535.00 DFES_OneToOne 0.00 65535.00 /end CHARACTERISTIC
/begin CHARACTERISTIC DFES_DTCO.DFC_SRCMinPPFltUs_C "DFES/OBD spezifischer Fehlercode für Prüfung DFC_SRCMinPPFltUs" VALUE 0x8002962E Val_Wu16 65535.00 DFES_OneToOne 0.00 65535.00 /end CHARACTERISTIC
/begin CHARACTERISTIC DFES_DTCO.DFC_SRCMinTECU_C "DFES/OBD spezifischer Fehlercode für Prüfung DFC_SRCMinTECU" VALUE 0x80029630 Val_Wu16 65535.00 DFES_OneToOne 0.00 65535.00 /end CHARACTERISTIC
/begin CHARACTERISTIC DFES_DTCO.DFC_SRCMinTOxiCatUs_C "DFES/OBD spezifischer Fehlercode für Prüfung DFC_SRCMinTOxiCatUs" VALUE 0x80029632 Val_Wu16 65535.00 DFES_OneToOne 0.00 65535.00 /end CHARACTERISTIC
/begin CHARACTERISTIC DFES_DTCO.DFC_SRCMinTPFltUs_C "DFES/OBD spezifischer Fehlercode für Prüfung DFC_SRCMinTPFltUs" VALUE 0x80029634 Val_Wu16 65535.00 DFES_OneToOne 0.00 65535.00 /end CHARACTERISTIC
/begin CHARACTERISTIC DFES_DTCO.DFC_SRCMinTTrbnUs_C "DFES/OBD spezifischer Fehlercode für Prüfung DFC_SRCMinTTrbnUs" VALUE 0x80029636 Val_Wu16 65535.00 DFES_OneToOne 0.00 65535.00 /end CHARACTERISTIC
/begin CHARACTERISTIC DFES_DTCO.DFC_SRCMinUCatUsT_C "DFES/OBD spezifischer Fehlercode für Prüfung DFC_SRCMinUCatUsT" VALUE 0x80029638 Val_Wu16 65535.00 DFES_OneToOne 0.00 65535.00 /end CHARACTERISTIC
/begin CHARACTERISTIC DFES_DTCO.DFC_SRCMinUPmpP_C "DFES/OBD spezifischer Fehlercode für Prüfung DFC_SRCMinUPmpP" VALUE 0x8002963A Val_Wu16 65535.00 DFES_OneToOne 0.00 65535.00 /end CHARACTERISTIC
/begin CHARACTERISTIC DFES_DTCO.DFC_SigUCatUsT_C "DFES/OBD spezifischer Fehlercode für Prüfung DFC_SigUCatUsT" VALUE 0x8002963C Val_Wu16 65535.00 DFES_OneToOne 0.00 65535.00 /end CHARACTERISTIC
/begin CHARACTERISTIC DFES_DTCO.DFC_SigUPmpP_C "DFES/OBD spezifischer Fehlercode für Prüfung DFC_SigUPmpP" VALUE 0x8002963E Val_Wu16 65535.00 DFES_OneToOne 0.00 65535.00 /end CHARACTERISTIC
/begin CHARACTERISTIC DFES_DTCO.DFC_SyncAPP_C "DFES/OBD spezifischer Fehlercode für Prüfung DFC_SyncAPP" VALUE 0x80029640 Val_Wu16 65535.00 DFES_OneToOne 0.00 65535.00 /end CHARACTERISTIC
/begin CHARACTERISTIC DFES_DTCO.DFC_T15Npl_C "DFES/OBD spezifischer Fehlercode für Prüfung DFC_T15Npl" VALUE 0x80029642 Val_Wu16 65535.00 DFES_OneToOne 0.00 65535.00 /end CHARACTERISTIC
/begin CHARACTERISTIC DFES_DTCO.DFC_TAFSDtyCycHi_C "DFES/OBD spezifischer Fehlercode für Prüfung DFC_TAFSDtyCycHi" VALUE 0x80029644 Val_Wu16 65535.00 DFES_OneToOne 0.00 65535.00 /end CHARACTERISTIC
/begin CHARACTERISTIC DFES_DTCO.DFC_TAFSDtyCycLo_C "DFES/OBD spezifischer Fehlercode für Prüfung DFC_TAFSDtyCycLo" VALUE 0x80029646 Val_Wu16 65535.00 DFES_OneToOne 0.00 65535.00 /end CHARACTERISTIC
/begin CHARACTERISTIC DFES_DTCO.DFC_TAFSPerHi_C "DFES/OBD spezifischer Fehlercode für Prüfung DFC_TAFSPerHi" VALUE 0x80029648 Val_Wu16 65535.00 DFES_OneToOne 0.00 65535.00 /end CHARACTERISTIC
/begin CHARACTERISTIC DFES_DTCO.DFC_TAFSPerLo_C "DFES/OBD spezifischer Fehlercode für Prüfung DFC_TAFSPerLo" VALUE 0x8002964A Val_Wu16 65535.00 DFES_OneToOne 0.00 65535.00 /end CHARACTERISTIC
/begin CHARACTERISTIC DFES_DTCO.DFC_TCACDsSRCMax_C "DFES/OBD spezifischer Fehlercode für Prüfung DFC_TCACDsSRCMax" VALUE 0x8002964C Val_Wu16 65535.00 DFES_OneToOne 0.00 65535.00 /end CHARACTERISTIC
/begin CHARACTERISTIC DFES_DTCO.DFC_TCACDsSRCMin_C "DFES/OBD spezifischer Fehlercode für Prüfung DFC_TCACDsSRCMin" VALUE 0x8002964E Val_Wu16 65535.00 DFES_OneToOne 0.00 65535.00 /end CHARACTERISTIC
/begin CHARACTERISTIC DFES_DTCO.DFC_ThrVlvSRCMax_C "DFES/OBD spezifischer Fehlercode für Prüfung DFC_ThrVlvSRCMax" VALUE 0x80029650 Val_Wu16 65535.00 DFES_OneToOne 0.00 65535.00 /end CHARACTERISTIC
/begin CHARACTERISTIC DFES_DTCO.DFC_ThrVlvSRCMin_C "DFES/OBD spezifischer Fehlercode für Prüfung DFC_ThrVlvSRCMin" VALUE 0x80029652 Val_Wu16 65535.00 DFES_OneToOne 0.00 65535.00 /end CHARACTERISTIC
/begin CHARACTERISTIC DFES_DTCO.DFC_TrbChLPOL_C "DFES/OBD spezifischer Fehlercode für Prüfung DFC_TrbChLPOL" VALUE 0x80029654 Val_Wu16 65535.00 DFES_OneToOne 0.00 65535.00 /end CHARACTERISTIC
/begin CHARACTERISTIC DFES_DTCO.DFC_TrbChLPSCB_C "DFES/OBD spezifischer Fehlercode für Prüfung DFC_TrbChLPSCB" VALUE 0x80029656 Val_Wu16 65535.00 DFES_OneToOne 0.00 65535.00 /end CHARACTERISTIC
/begin CHARACTERISTIC DFES_DTCO.DFC_TrbChLPSCG_C "DFES/OBD spezifischer Fehlercode für Prüfung DFC_TrbChLPSCG" VALUE 0x80029658 Val_Wu16 65535.00 DFES_OneToOne 0.00 65535.00 /end CHARACTERISTIC
/begin CHARACTERISTIC DFES_DTCO.DFC_UHtrPLOL_C "DFES/OBD spezifischer Fehlercode für Prüfung DFC_UHtrPLOL" VALUE 0x8002965A Val_Wu16 65535.00 DFES_OneToOne 0.00 65535.00 /end CHARACTERISTIC
/begin CHARACTERISTIC DFES_DTCO.DFC_UHtrPLSCB_C "DFES/OBD spezifischer Fehlercode für Prüfung DFC_UHtrPLSCB" VALUE 0x8002965C Val_Wu16 65535.00 DFES_OneToOne 0.00 65535.00 /end CHARACTERISTIC
/begin CHARACTERISTIC DFES_DTCO.DFC_UHtrPLSCG_C "DFES/OBD spezifischer Fehlercode für Prüfung DFC_UHtrPLSCG" VALUE 0x8002965E Val_Wu16 65535.00 DFES_OneToOne 0.00 65535.00 /end CHARACTERISTIC
/begin CHARACTERISTIC DFES_DTCO.DFC_UHtrPLSRCMaxDia_C "DFES/OBD spezifischer Fehlercode für Prüfung DFC_UHtrPLSRCMaxDia" VALUE 0x80029660 Val_Wu16 65535.00 DFES_OneToOne 0.00 65535.00 /end CHARACTERISTIC
/begin CHARACTERISTIC DFES_DTCO.DFC_UHtrPLSRCMinDia_C "DFES/OBD spezifischer Fehlercode für Prüfung DFC_UHtrPLSRCMinDia" VALUE 0x80029662 Val_Wu16 65535.00 DFES_OneToOne 0.00 65535.00 /end CHARACTERISTIC
/begin CHARACTERISTIC DFES_DTCO.DFC_UHtrTnkOL_C "DFES/OBD spezifischer Fehlercode für Prüfung DFC_UHtrTnkOL" VALUE 0x80029664 Val_Wu16 65535.00 DFES_OneToOne 0.00 65535.00 /end CHARACTERISTIC
/begin CHARACTERISTIC DFES_DTCO.DFC_UHtrTnkSCB_C "DFES/OBD spezifischer Fehlercode für Prüfung DFC_UHtrTnkSCB" VALUE 0x80029666 Val_Wu16 65535.00 DFES_OneToOne 0.00 65535.00 /end CHARACTERISTIC
/begin CHARACTERISTIC DFES_DTCO.DFC_UHtrTnkSCG_C "DFES/OBD spezifischer Fehlercode für Prüfung DFC_UHtrTnkSCG" VALUE 0x80029668 Val_Wu16 65535.00 DFES_OneToOne 0.00 65535.00 /end CHARACTERISTIC
/begin CHARACTERISTIC DFES_DTCO.DFC_UHtrTnkSRCMaxDia_C "DFES/OBD spezifischer Fehlercode für Prüfung DFC_UHtrTnkSRCMaxDia" VALUE 0x8002966A Val_Wu16 65535.00 DFES_OneToOne 0.00 65535.00 /end CHARACTERISTIC
/begin CHARACTERISTIC DFES_DTCO.DFC_UHtrTnkSRCMinDia_C "DFES/OBD spezifischer Fehlercode für Prüfung DFC_UHtrTnkSRCMinDia" VALUE 0x8002966C Val_Wu16 65535.00 DFES_OneToOne 0.00 65535.00 /end CHARACTERISTIC
/begin CHARACTERISTIC DFES_DTCO.DFC_URevVlvOL_C "DFES/OBD spezifischer Fehlercode für Prüfung DFC_URevVlvOL" VALUE 0x8002966E Val_Wu16 65535.00 DFES_OneToOne 0.00 65535.00 /end CHARACTERISTIC
/begin CHARACTERISTIC DFES_DTCO.DFC_URevVlvSCB_C "DFES/OBD spezifischer Fehlercode für Prüfung DFC_URevVlvSCB" VALUE 0x80029670 Val_Wu16 65535.00 DFES_OneToOne 0.00 65535.00 /end CHARACTERISTIC
/begin CHARACTERISTIC DFES_DTCO.DFC_URevVlvSCG_C "DFES/OBD spezifischer Fehlercode für Prüfung DFC_URevVlvSCG" VALUE 0x80029672 Val_Wu16 65535.00 DFES_OneToOne 0.00 65535.00 /end CHARACTERISTIC
/begin CHARACTERISTIC DFES_DTCO.DFC_UTnkTSRCMax_C "DFES/OBD spezifischer Fehlercode für Prüfung DFC_UTnkTSRCMax" VALUE 0x80029674 Val_Wu16 65535.00 DFES_OneToOne 0.00 65535.00 /end CHARACTERISTIC
/begin CHARACTERISTIC DFES_DTCO.DFC_UTnkTSRCMin_C "DFES/OBD spezifischer Fehlercode für Prüfung DFC_UTnkTSRCMin" VALUE 0x80029676 Val_Wu16 65535.00 DFES_OneToOne 0.00 65535.00 /end CHARACTERISTIC
/begin CHARACTERISTIC DFES_DTCO.DFC_UTnkTSig_C "DFES/OBD spezifischer Fehlercode für Prüfung DFC_UTnkTSig" VALUE 0x80029678 Val_Wu16 65535.00 DFES_OneToOne 0.00 65535.00 /end CHARACTERISTIC
/begin CHARACTERISTIC DFES_DTCO.DFC_VSwVlvGovDvtMax_C "DFES/OBD spezifischer Fehlercode für Prüfung DFC_VSwVlvGovDvtMax" VALUE 0x8002967A Val_Wu16 65535.00 DFES_OneToOne 0.00 65535.00 /end CHARACTERISTIC
/begin CHARACTERISTIC DFES_DTCO.DFC_VSwVlvGovDvtMin_C "DFES/OBD spezifischer Fehlercode für Prüfung DFC_VSwVlvGovDvtMin" VALUE 0x8002967C Val_Wu16 65535.00 DFES_OneToOne 0.00 65535.00 /end CHARACTERISTIC
/begin CHARACTERISTIC DFES_DTCO.DFC_VSwVlvHBrgOpnLd_C "DFES/OBD spezifischer Fehlercode für Prüfung DFC_VSwVlvHBrgOpnLd" VALUE 0x8002967E Val_Wu16 65535.00 DFES_OneToOne 0.00 65535.00 /end CHARACTERISTIC
/begin CHARACTERISTIC DFES_DTCO.DFC_VSwVlvHBrgOvrCurr_C "DFES/OBD spezifischer Fehlercode für Prüfung DFC_VSwVlvHBrgOvrCurr" VALUE 0x80029680 Val_Wu16 65535.00 DFES_OneToOne 0.00 65535.00 /end CHARACTERISTIC
/begin CHARACTERISTIC DFES_DTCO.DFC_VSwVlvHBrgOvrTemp_C "DFES/OBD spezifischer Fehlercode für Prüfung DFC_VSwVlvHBrgOvrTemp" VALUE 0x80029682 Val_Wu16 65535.00 DFES_OneToOne 0.00 65535.00 /end CHARACTERISTIC
/begin CHARACTERISTIC DFES_DTCO.DFC_VSwVlvHBrgShCirBatt1_C "DFES/OBD spezifischer Fehlercode für Prüfung DFC_VSwVlvHBrgShCirBatt1" VALUE 0x80029684 Val_Wu16 65535.00 DFES_OneToOne 0.00 65535.00 /end CHARACTERISTIC
/begin CHARACTERISTIC DFES_DTCO.DFC_VSwVlvHBrgShCirBatt2_C "DFES/OBD spezifischer Fehlercode für Prüfung DFC_VSwVlvHBrgShCirBatt2" VALUE 0x80029686 Val_Wu16 65535.00 DFES_OneToOne 0.00 65535.00 /end CHARACTERISTIC
/begin CHARACTERISTIC DFES_DTCO.DFC_VSwVlvHBrgShCirGnd1_C "DFES/OBD spezifischer Fehlercode für Prüfung DFC_VSwVlvHBrgShCirGnd1" VALUE 0x80029688 Val_Wu16 65535.00 DFES_OneToOne 0.00 65535.00 /end CHARACTERISTIC
/begin CHARACTERISTIC DFES_DTCO.DFC_VSwVlvHBrgShCirGnd2_C "DFES/OBD spezifischer Fehlercode für Prüfung DFC_VSwVlvHBrgShCirGnd2" VALUE 0x8002968A Val_Wu16 65535.00 DFES_OneToOne 0.00 65535.00 /end CHARACTERISTIC
/begin CHARACTERISTIC DFES_DTCO.DFC_VSwVlvHBrgShCirOvrLd_C "DFES/OBD spezifischer Fehlercode für Prüfung DFC_VSwVlvHBrgShCirOvrLd" VALUE 0x8002968C Val_Wu16 65535.00 DFES_OneToOne 0.00 65535.00 /end CHARACTERISTIC
/begin CHARACTERISTIC DFES_DTCO.DFC_VSwVlvHBrgTempOvrCurr_C "DFES/OBD spezifischer Fehlercode für Prüfung DFC_VSwVlvHBrgTempOvrCurr" VALUE 0x8002968E Val_Wu16 65535.00 DFES_OneToOne 0.00 65535.00 /end CHARACTERISTIC
/begin CHARACTERISTIC DFES_DTCO.DFC_VSwVlvHBrgUndrVltg_C "DFES/OBD spezifischer Fehlercode für Prüfung DFC_VSwVlvHBrgUndrVltg" VALUE 0x80029690 Val_Wu16 65535.00 DFES_OneToOne 0.00 65535.00 /end CHARACTERISTIC
/begin CHARACTERISTIC DFES_DTCO.DFC_VSwVlvOL_C "DFES/OBD spezifischer Fehlercode für Prüfung DFC_VSwVlvOL" VALUE 0x80029692 Val_Wu16 65535.00 DFES_OneToOne 0.00 65535.00 /end CHARACTERISTIC
/begin CHARACTERISTIC DFES_DTCO.DFC_VSwVlvSCB_C "DFES/OBD spezifischer Fehlercode für Prüfung DFC_VSwVlvSCB" VALUE 0x80029694 Val_Wu16 65535.00 DFES_OneToOne 0.00 65535.00 /end CHARACTERISTIC
/begin CHARACTERISTIC DFES_DTCO.DFC_VSwVlvSCG_C "DFES/OBD spezifischer Fehlercode für Prüfung DFC_VSwVlvSCG" VALUE 0x80029696 Val_Wu16 65535.00 DFES_OneToOne 0.00 65535.00 /end CHARACTERISTIC
/begin CHARACTERISTIC DFES_DTCO.DFC_VSwVlvSRCMax_C "DFES/OBD spezifischer Fehlercode für Prüfung DFC_VSwVlvSRCMax" VALUE 0x80029698 Val_Wu16 65535.00 DFES_OneToOne 0.00 65535.00 /end CHARACTERISTIC
/begin CHARACTERISTIC DFES_DTCO.DFC_VSwVlvSRCMin_C "DFES/OBD spezifischer Fehlercode für Prüfung DFC_VSwVlvSRCMin" VALUE 0x8002969A Val_Wu16 65535.00 DFES_OneToOne 0.00 65535.00 /end CHARACTERISTIC
/begin CHARACTERISTIC DFES_DTCO.DFC_ClthNpl_C "DFES/OBD spezifischer Fehlercode für Prüfung DFC_ClthNpl" VALUE 0x8002969C Val_Wu16 65535.00 DFES_OneToOne 0.00 65535.00 /end CHARACTERISTIC
/begin CHARACTERISTIC DFES_DTCO.DFC_ETClbETMax_0_C "DFES/OBD spezifischer Fehlercode für Prüfung DFC_ETClbETMax_0" VALUE 0x8002969E Val_Wu16 65535.00 DFES_OneToOne 0.00 65535.00 /end CHARACTERISTIC
/begin CHARACTERISTIC DFES_DTCO.DFC_ETClbETMax_1_C "DFES/OBD spezifischer Fehlercode für Prüfung DFC_ETClbETMax_1" VALUE 0x800296A0 Val_Wu16 65535.00 DFES_OneToOne 0.00 65535.00 /end CHARACTERISTIC
/begin CHARACTERISTIC DFES_DTCO.DFC_ETClbETMax_2_C "DFES/OBD spezifischer Fehlercode für Prüfung DFC_ETClbETMax_2" VALUE 0x800296A2 Val_Wu16 65535.00 DFES_OneToOne 0.00 65535.00 /end CHARACTERISTIC
/begin CHARACTERISTIC DFES_DTCO.DFC_ETClbETMax_3_C "DFES/OBD spezifischer Fehlercode für Prüfung DFC_ETClbETMax_3" VALUE 0x800296A4 Val_Wu16 65535.00 DFES_OneToOne 0.00 65535.00 /end CHARACTERISTIC
/begin CHARACTERISTIC DFES_DTCO.DFC_ETClbETMax_4_C "DFES/OBD spezifischer Fehlercode für Prüfung DFC_ETClbETMax_4" VALUE 0x800296A6 Val_Wu16 65535.00 DFES_OneToOne 0.00 65535.00 /end CHARACTERISTIC
/begin CHARACTERISTIC DFES_DTCO.DFC_ETClbETMax_5_C "DFES/OBD spezifischer Fehlercode für Prüfung DFC_ETClbETMax_5" VALUE 0x800296A8 Val_Wu16 65535.00 DFES_OneToOne 0.00 65535.00 /end CHARACTERISTIC
/begin CHARACTERISTIC DFES_DTCO.DFC_ETClbETMin_0_C "DFES/OBD spezifischer Fehlercode für Prüfung DFC_ETClbETMin_0" VALUE 0x800296AA Val_Wu16 65535.00 DFES_OneToOne 0.00 65535.00 /end CHARACTERISTIC
/begin CHARACTERISTIC DFES_DTCO.DFC_ETClbETMin_1_C "DFES/OBD spezifischer Fehlercode für Prüfung DFC_ETClbETMin_1" VALUE 0x800296AC Val_Wu16 65535.00 DFES_OneToOne 0.00 65535.00 /end CHARACTERISTIC
/begin CHARACTERISTIC DFES_DTCO.DFC_ETClbETMin_2_C "DFES/OBD spezifischer Fehlercode für Prüfung DFC_ETClbETMin_2" VALUE 0x800296AE Val_Wu16 65535.00 DFES_OneToOne 0.00 65535.00 /end CHARACTERISTIC
/begin CHARACTERISTIC DFES_DTCO.DFC_ETClbETMin_3_C "DFES/OBD spezifischer Fehlercode für Prüfung DFC_ETClbETMin_3" VALUE 0x800296B0 Val_Wu16 65535.00 DFES_OneToOne 0.00 65535.00 /end CHARACTERISTIC
/begin CHARACTERISTIC DFES_DTCO.DFC_ETClbETMin_4_C "DFES/OBD spezifischer Fehlercode für Prüfung DFC_ETClbETMin_4" VALUE 0x800296B2 Val_Wu16 65535.00 DFES_OneToOne 0.00 65535.00 /end CHARACTERISTIC
/begin CHARACTERISTIC DFES_DTCO.DFC_ETClbETMin_5_C "DFES/OBD spezifischer Fehlercode für Prüfung DFC_ETClbETMin_5" VALUE 0x800296B4 Val_Wu16 65535.00 DFES_OneToOne 0.00 65535.00 /end CHARACTERISTIC
/begin CHARACTERISTIC DFES_DTCO.DFC_IVActrEnrgMax_0_C "DFES/OBD spezifischer Fehlercode für Prüfung DFC_IVActrEnrgMax_0" VALUE 0x800296B6 Val_Wu16 65535.00 DFES_OneToOne 0.00 65535.00 /end CHARACTERISTIC
/begin CHARACTERISTIC DFES_DTCO.DFC_IVActrEnrgMax_1_C "DFES/OBD spezifischer Fehlercode für Prüfung DFC_IVActrEnrgMax_1" VALUE 0x800296B8 Val_Wu16 65535.00 DFES_OneToOne 0.00 65535.00 /end CHARACTERISTIC
/begin CHARACTERISTIC DFES_DTCO.DFC_IVActrEnrgMax_2_C "DFES/OBD spezifischer Fehlercode für Prüfung DFC_IVActrEnrgMax_2" VALUE 0x800296BA Val_Wu16 65535.00 DFES_OneToOne 0.00 65535.00 /end CHARACTERISTIC
/begin CHARACTERISTIC DFES_DTCO.DFC_IVActrEnrgMax_3_C "DFES/OBD spezifischer Fehlercode für Prüfung DFC_IVActrEnrgMax_3" VALUE 0x800296BC Val_Wu16 65535.00 DFES_OneToOne 0.00 65535.00 /end CHARACTERISTIC
/begin CHARACTERISTIC DFES_DTCO.DFC_IVActrEnrgMax_4_C "DFES/OBD spezifischer Fehlercode für Prüfung DFC_IVActrEnrgMax_4" VALUE 0x800296BE Val_Wu16 65535.00 DFES_OneToOne 0.00 65535.00 /end CHARACTERISTIC
/begin CHARACTERISTIC DFES_DTCO.DFC_IVActrEnrgMax_5_C "DFES/OBD spezifischer Fehlercode für Prüfung DFC_IVActrEnrgMax_5" VALUE 0x800296C0 Val_Wu16 65535.00 DFES_OneToOne 0.00 65535.00 /end CHARACTERISTIC
/begin CHARACTERISTIC DFES_DTCO.DFC_IVActrEnrgMax_6_C "DFES/OBD spezifischer Fehlercode für Prüfung DFC_IVActrEnrgMax_6" VALUE 0x800296C2 Val_Wu16 65535.00 DFES_OneToOne 0.00 65535.00 /end CHARACTERISTIC
/begin CHARACTERISTIC DFES_DTCO.DFC_IVActrEnrgMax_7_C "DFES/OBD spezifischer Fehlercode für Prüfung DFC_IVActrEnrgMax_7" VALUE 0x800296C4 Val_Wu16 65535.00 DFES_OneToOne 0.00 65535.00 /end CHARACTERISTIC
/begin CHARACTERISTIC DFES_DTCO.DFC_IVActrEnrgMin_0_C "DFES/OBD spezifischer Fehlercode für Prüfung DFC_IVActrEnrgMin_0" VALUE 0x800296C6 Val_Wu16 65535.00 DFES_OneToOne 0.00 65535.00 /end CHARACTERISTIC
/begin CHARACTERISTIC DFES_DTCO.DFC_IVActrEnrgMin_1_C "DFES/OBD spezifischer Fehlercode für Prüfung DFC_IVActrEnrgMin_1" VALUE 0x800296C8 Val_Wu16 65535.00 DFES_OneToOne 0.00 65535.00 /end CHARACTERISTIC
/begin CHARACTERISTIC DFES_DTCO.DFC_IVActrEnrgMin_2_C "DFES/OBD spezifischer Fehlercode für Prüfung DFC_IVActrEnrgMin_2" VALUE 0x800296CA Val_Wu16 65535.00 DFES_OneToOne 0.00 65535.00 /end CHARACTERISTIC
/begin CHARACTERISTIC DFES_DTCO.DFC_IVActrEnrgMin_3_C "DFES/OBD spezifischer Fehlercode für Prüfung DFC_IVActrEnrgMin_3" VALUE 0x800296CC Val_Wu16 65535.00 DFES_OneToOne 0.00 65535.00 /end CHARACTERISTIC
/begin CHARACTERISTIC DFES_DTCO.DFC_IVActrEnrgMin_4_C "DFES/OBD spezifischer Fehlercode für Prüfung DFC_IVActrEnrgMin_4" VALUE 0x800296CE Val_Wu16 65535.00 DFES_OneToOne 0.00 65535.00 /end CHARACTERISTIC
/begin CHARACTERISTIC DFES_DTCO.DFC_IVActrEnrgMin_5_C "DFES/OBD spezifischer Fehlercode für Prüfung DFC_IVActrEnrgMin_5" VALUE 0x800296D0 Val_Wu16 65535.00 DFES_OneToOne 0.00 65535.00 /end CHARACTERISTIC
/begin CHARACTERISTIC DFES_DTCO.DFC_IVActrEnrgMin_6_C "DFES/OBD spezifischer Fehlercode für Prüfung DFC_IVActrEnrgMin_6" VALUE 0x800296D2 Val_Wu16 65535.00 DFES_OneToOne 0.00 65535.00 /end CHARACTERISTIC
/begin CHARACTERISTIC DFES_DTCO.DFC_IVActrEnrgMin_7_C "DFES/OBD spezifischer Fehlercode für Prüfung DFC_IVActrEnrgMin_7" VALUE 0x800296D4 Val_Wu16 65535.00 DFES_OneToOne 0.00 65535.00 /end CHARACTERISTIC
/begin CHARACTERISTIC DFES_DTCO.DFC_IVActrEnrgPlaus_0_C "DFES/OBD spezifischer Fehlercode für Prüfung DFC_IVActrEnrgPlaus_0" VALUE 0x800296D6 Val_Wu16 65535.00 DFES_OneToOne 0.00 65535.00 /end CHARACTERISTIC
/begin CHARACTERISTIC DFES_DTCO.DFC_IVActrEnrgPlaus_1_C "DFES/OBD spezifischer Fehlercode für Prüfung DFC_IVActrEnrgPlaus_1" VALUE 0x800296D8 Val_Wu16 65535.00 DFES_OneToOne 0.00 65535.00 /end CHARACTERISTIC
/begin CHARACTERISTIC DFES_DTCO.DFC_IVActrEnrgPlaus_2_C "DFES/OBD spezifischer Fehlercode für Prüfung DFC_IVActrEnrgPlaus_2" VALUE 0x800296DA Val_Wu16 65535.00 DFES_OneToOne 0.00 65535.00 /end CHARACTERISTIC
/begin CHARACTERISTIC DFES_DTCO.DFC_IVActrEnrgPlaus_3_C "DFES/OBD spezifischer Fehlercode für Prüfung DFC_IVActrEnrgPlaus_3" VALUE 0x800296DC Val_Wu16 65535.00 DFES_OneToOne 0.00 65535.00 /end CHARACTERISTIC
/begin CHARACTERISTIC DFES_DTCO.DFC_IVActrEnrgPlaus_4_C "DFES/OBD spezifischer Fehlercode für Prüfung DFC_IVActrEnrgPlaus_4" VALUE 0x800296DE Val_Wu16 65535.00 DFES_OneToOne 0.00 65535.00 /end CHARACTERISTIC
/begin CHARACTERISTIC DFES_DTCO.DFC_IVActrEnrgPlaus_5_C "DFES/OBD spezifischer Fehlercode für Prüfung DFC_IVActrEnrgPlaus_5" VALUE 0x800296E0 Val_Wu16 65535.00 DFES_OneToOne 0.00 65535.00 /end CHARACTERISTIC
/begin CHARACTERISTIC DFES_DTCO.DFC_IVActrEnrgPlaus_6_C "DFES/OBD spezifischer Fehlercode für Prüfung DFC_IVActrEnrgPlaus_6" VALUE 0x800296E2 Val_Wu16 65535.00 DFES_OneToOne 0.00 65535.00 /end CHARACTERISTIC
/begin CHARACTERISTIC DFES_DTCO.DFC_IVActrEnrgPlaus_7_C "DFES/OBD spezifischer Fehlercode für Prüfung DFC_IVActrEnrgPlaus_7" VALUE 0x800296E4 Val_Wu16 65535.00 DFES_OneToOne 0.00 65535.00 /end CHARACTERISTIC
/begin CHARACTERISTIC DFES_DTCO.DFC_IVCtlTiDiff_0_C "DFES/OBD spezifischer Fehlercode für Prüfung DFC_IVCtlTiDiff_0" VALUE 0x800296E6 Val_Wu16 65535.00 DFES_OneToOne 0.00 65535.00 /end CHARACTERISTIC
/begin CHARACTERISTIC DFES_DTCO.DFC_IVCtlTiDiff_1_C "DFES/OBD spezifischer Fehlercode für Prüfung DFC_IVCtlTiDiff_1" VALUE 0x800296E8 Val_Wu16 65535.00 DFES_OneToOne 0.00 65535.00 /end CHARACTERISTIC
/begin CHARACTERISTIC DFES_DTCO.DFC_IVCtlTiDiff_2_C "DFES/OBD spezifischer Fehlercode für Prüfung DFC_IVCtlTiDiff_2" VALUE 0x800296EA Val_Wu16 65535.00 DFES_OneToOne 0.00 65535.00 /end CHARACTERISTIC
/begin CHARACTERISTIC DFES_DTCO.DFC_IVCtlTiDiff_3_C "DFES/OBD spezifischer Fehlercode für Prüfung DFC_IVCtlTiDiff_3" VALUE 0x800296EC Val_Wu16 65535.00 DFES_OneToOne 0.00 65535.00 /end CHARACTERISTIC
/begin CHARACTERISTIC DFES_DTCO.DFC_IVCtlTiDiff_4_C "DFES/OBD spezifischer Fehlercode für Prüfung DFC_IVCtlTiDiff_4" VALUE 0x800296EE Val_Wu16 65535.00 DFES_OneToOne 0.00 65535.00 /end CHARACTERISTIC
/begin CHARACTERISTIC DFES_DTCO.DFC_IVCtlTiDiff_5_C "DFES/OBD spezifischer Fehlercode für Prüfung DFC_IVCtlTiDiff_5" VALUE 0x800296F0 Val_Wu16 65535.00 DFES_OneToOne 0.00 65535.00 /end CHARACTERISTIC
/begin CHARACTERISTIC DFES_DTCO.DFC_IVCtlUDiffUp_0_C "DFES/OBD spezifischer Fehlercode für Prüfung DFC_IVCtlUDiffUp_0" VALUE 0x800296F2 Val_Wu16 65535.00 DFES_OneToOne 0.00 65535.00 /end CHARACTERISTIC
/begin CHARACTERISTIC DFES_DTCO.DFC_IVCtlUDiffUp_1_C "DFES/OBD spezifischer Fehlercode für Prüfung DFC_IVCtlUDiffUp_1" VALUE 0x800296F4 Val_Wu16 65535.00 DFES_OneToOne 0.00 65535.00 /end CHARACTERISTIC
/begin CHARACTERISTIC DFES_DTCO.DFC_IVCtlUDiffUp_2_C "DFES/OBD spezifischer Fehlercode für Prüfung DFC_IVCtlUDiffUp_2" VALUE 0x800296F6 Val_Wu16 65535.00 DFES_OneToOne 0.00 65535.00 /end CHARACTERISTIC
/begin CHARACTERISTIC DFES_DTCO.DFC_IVCtlUDiffUp_3_C "DFES/OBD spezifischer Fehlercode für Prüfung DFC_IVCtlUDiffUp_3" VALUE 0x800296F8 Val_Wu16 65535.00 DFES_OneToOne 0.00 65535.00 /end CHARACTERISTIC
/begin CHARACTERISTIC DFES_DTCO.DFC_IVCtlUDiffUp_4_C "DFES/OBD spezifischer Fehlercode für Prüfung DFC_IVCtlUDiffUp_4" VALUE 0x800296FA Val_Wu16 65535.00 DFES_OneToOne 0.00 65535.00 /end CHARACTERISTIC
/begin CHARACTERISTIC DFES_DTCO.DFC_IVCtlUDiffUp_5_C "DFES/OBD spezifischer Fehlercode für Prüfung DFC_IVCtlUDiffUp_5" VALUE 0x800296FC Val_Wu16 65535.00 DFES_OneToOne 0.00 65535.00 /end CHARACTERISTIC
/begin CHARACTERISTIC DFES_DTCO.DFC_IVCtlUUp_0_C "DFES/OBD spezifischer Fehlercode für Prüfung DFC_IVCtlUUp_0" VALUE 0x800296FE Val_Wu16 65535.00 DFES_OneToOne 0.00 65535.00 /end CHARACTERISTIC
/begin CHARACTERISTIC DFES_DTCO.DFC_IVCtlUUp_1_C "DFES/OBD spezifischer Fehlercode für Prüfung DFC_IVCtlUUp_1" VALUE 0x80029700 Val_Wu16 65535.00 DFES_OneToOne 0.00 65535.00 /end CHARACTERISTIC
/begin CHARACTERISTIC DFES_DTCO.DFC_IVCtlUUp_2_C "DFES/OBD spezifischer Fehlercode für Prüfung DFC_IVCtlUUp_2" VALUE 0x80029702 Val_Wu16 65535.00 DFES_OneToOne 0.00 65535.00 /end CHARACTERISTIC
/begin CHARACTERISTIC DFES_DTCO.DFC_IVCtlUUp_3_C "DFES/OBD spezifischer Fehlercode für Prüfung DFC_IVCtlUUp_3" VALUE 0x80029704 Val_Wu16 65535.00 DFES_OneToOne 0.00 65535.00 /end CHARACTERISTIC
/begin CHARACTERISTIC DFES_DTCO.DFC_IVCtlUUp_4_C "DFES/OBD spezifischer Fehlercode für Prüfung DFC_IVCtlUUp_4" VALUE 0x80029706 Val_Wu16 65535.00 DFES_OneToOne 0.00 65535.00 /end CHARACTERISTIC
/begin CHARACTERISTIC DFES_DTCO.DFC_IVCtlUUp_5_C "DFES/OBD spezifischer Fehlercode für Prüfung DFC_IVCtlUUp_5" VALUE 0x80029708 Val_Wu16 65535.00 DFES_OneToOne 0.00 65535.00 /end CHARACTERISTIC
/begin CHARACTERISTIC DFES_DTCO.DFC_IVDiaBnkShCir_0_C "DFES/OBD spezifischer Fehlercode für Prüfung DFC_IVDiaBnkShCir_0" VALUE 0x8002970A Val_Wu16 65535.00 DFES_OneToOne 0.00 65535.00 /end CHARACTERISTIC
/begin CHARACTERISTIC DFES_DTCO.DFC_IVDiaBnkShCir_1_C "DFES/OBD spezifischer Fehlercode für Prüfung DFC_IVDiaBnkShCir_1" VALUE 0x8002970C Val_Wu16 65535.00 DFES_OneToOne 0.00 65535.00 /end CHARACTERISTIC
/begin CHARACTERISTIC DFES_DTCO.DFC_IVDiaBnkShCirChSwt_0_C "DFES/OBD spezifischer Fehlercode für Prüfung DFC_IVDiaBnkShCirChSwt_0" VALUE 0x8002970E Val_Wu16 65535.00 DFES_OneToOne 0.00 65535.00 /end CHARACTERISTIC
/begin CHARACTERISTIC DFES_DTCO.DFC_IVDiaBnkShCirChSwt_1_C "DFES/OBD spezifischer Fehlercode für Prüfung DFC_IVDiaBnkShCirChSwt_1" VALUE 0x80029710 Val_Wu16 65535.00 DFES_OneToOne 0.00 65535.00 /end CHARACTERISTIC
/begin CHARACTERISTIC DFES_DTCO.DFC_IVDiaChp_0_C "DFES/OBD spezifischer Fehlercode für Prüfung DFC_IVDiaChp_0" VALUE 0x80029712 Val_Wu16 65535.00 DFES_OneToOne 0.00 65535.00 /end CHARACTERISTIC
/begin CHARACTERISTIC DFES_DTCO.DFC_IVDiaChp_1_C "DFES/OBD spezifischer Fehlercode für Prüfung DFC_IVDiaChp_1" VALUE 0x80029714 Val_Wu16 65535.00 DFES_OneToOne 0.00 65535.00 /end CHARACTERISTIC
/begin CHARACTERISTIC DFES_DTCO.DFC_IVDiaCylNoCls_0_C "DFES/OBD spezifischer Fehlercode für Prüfung DFC_IVDiaCylNoCls_0" VALUE 0x80029716 Val_Wu16 65535.00 DFES_OneToOne 0.00 65535.00 /end CHARACTERISTIC
/begin CHARACTERISTIC DFES_DTCO.DFC_IVDiaCylNoCls_1_C "DFES/OBD spezifischer Fehlercode für Prüfung DFC_IVDiaCylNoCls_1" VALUE 0x80029718 Val_Wu16 65535.00 DFES_OneToOne 0.00 65535.00 /end CHARACTERISTIC
/begin CHARACTERISTIC DFES_DTCO.DFC_IVDiaCylNoCls_2_C "DFES/OBD spezifischer Fehlercode für Prüfung DFC_IVDiaCylNoCls_2" VALUE 0x8002971A Val_Wu16 65535.00 DFES_OneToOne 0.00 65535.00 /end CHARACTERISTIC
/begin CHARACTERISTIC DFES_DTCO.DFC_IVDiaCylNoCls_3_C "DFES/OBD spezifischer Fehlercode für Prüfung DFC_IVDiaCylNoCls_3" VALUE 0x8002971C Val_Wu16 65535.00 DFES_OneToOne 0.00 65535.00 /end CHARACTERISTIC
/begin CHARACTERISTIC DFES_DTCO.DFC_IVDiaCylNoCls_4_C "DFES/OBD spezifischer Fehlercode für Prüfung DFC_IVDiaCylNoCls_4" VALUE 0x8002971E Val_Wu16 65535.00 DFES_OneToOne 0.00 65535.00 /end CHARACTERISTIC
/begin CHARACTERISTIC DFES_DTCO.DFC_IVDiaCylNoCls_5_C "DFES/OBD spezifischer Fehlercode für Prüfung DFC_IVDiaCylNoCls_5" VALUE 0x80029720 Val_Wu16 65535.00 DFES_OneToOne 0.00 65535.00 /end CHARACTERISTIC
/begin CHARACTERISTIC DFES_DTCO.DFC_IVDiaCylNoLd_0_C "DFES/OBD spezifischer Fehlercode für Prüfung DFC_IVDiaCylNoLd_0" VALUE 0x80029722 Val_Wu16 65535.00 DFES_OneToOne 0.00 65535.00 /end CHARACTERISTIC
/begin CHARACTERISTIC DFES_DTCO.DFC_IVDiaCylNoLd_1_C "DFES/OBD spezifischer Fehlercode für Prüfung DFC_IVDiaCylNoLd_1" VALUE 0x80029724 Val_Wu16 65535.00 DFES_OneToOne 0.00 65535.00 /end CHARACTERISTIC
/begin CHARACTERISTIC DFES_DTCO.DFC_IVDiaCylNoLd_2_C "DFES/OBD spezifischer Fehlercode für Prüfung DFC_IVDiaCylNoLd_2" VALUE 0x80029726 Val_Wu16 65535.00 DFES_OneToOne 0.00 65535.00 /end CHARACTERISTIC
/begin CHARACTERISTIC DFES_DTCO.DFC_IVDiaCylNoLd_3_C "DFES/OBD spezifischer Fehlercode für Prüfung DFC_IVDiaCylNoLd_3" VALUE 0x80029728 Val_Wu16 65535.00 DFES_OneToOne 0.00 65535.00 /end CHARACTERISTIC
/begin CHARACTERISTIC DFES_DTCO.DFC_IVDiaCylNoLd_4_C "DFES/OBD spezifischer Fehlercode für Prüfung DFC_IVDiaCylNoLd_4" VALUE 0x8002972A Val_Wu16 65535.00 DFES_OneToOne 0.00 65535.00 /end CHARACTERISTIC
/begin CHARACTERISTIC DFES_DTCO.DFC_IVDiaCylNoLd_5_C "DFES/OBD spezifischer Fehlercode für Prüfung DFC_IVDiaCylNoLd_5" VALUE 0x8002972C Val_Wu16 65535.00 DFES_OneToOne 0.00 65535.00 /end CHARACTERISTIC
/begin CHARACTERISTIC DFES_DTCO.DFC_IVDiaCylShCir_0_C "DFES/OBD spezifischer Fehlercode für Prüfung DFC_IVDiaCylShCir_0" VALUE 0x8002972E Val_Wu16 65535.00 DFES_OneToOne 0.00 65535.00 /end CHARACTERISTIC
/begin CHARACTERISTIC DFES_DTCO.DFC_IVDiaCylShCir_1_C "DFES/OBD spezifischer Fehlercode für Prüfung DFC_IVDiaCylShCir_1" VALUE 0x80029730 Val_Wu16 65535.00 DFES_OneToOne 0.00 65535.00 /end CHARACTERISTIC
/begin CHARACTERISTIC DFES_DTCO.DFC_IVDiaCylShCir_2_C "DFES/OBD spezifischer Fehlercode für Prüfung DFC_IVDiaCylShCir_2" VALUE 0x80029732 Val_Wu16 65535.00 DFES_OneToOne 0.00 65535.00 /end CHARACTERISTIC
/begin CHARACTERISTIC DFES_DTCO.DFC_IVDiaCylShCir_3_C "DFES/OBD spezifischer Fehlercode für Prüfung DFC_IVDiaCylShCir_3" VALUE 0x80029734 Val_Wu16 65535.00 DFES_OneToOne 0.00 65535.00 /end CHARACTERISTIC
/begin CHARACTERISTIC DFES_DTCO.DFC_IVDiaCylShCir_4_C "DFES/OBD spezifischer Fehlercode für Prüfung DFC_IVDiaCylShCir_4" VALUE 0x80029736 Val_Wu16 65535.00 DFES_OneToOne 0.00 65535.00 /end CHARACTERISTIC
/begin CHARACTERISTIC DFES_DTCO.DFC_IVDiaCylShCir_5_C "DFES/OBD spezifischer Fehlercode für Prüfung DFC_IVDiaCylShCir_5" VALUE 0x80029738 Val_Wu16 65535.00 DFES_OneToOne 0.00 65535.00 /end CHARACTERISTIC
/begin CHARACTERISTIC DFES_DTCO.DFC_IVDiaCylShCirHSLS_0_C "DFES/OBD spezifischer Fehlercode für Prüfung DFC_IVDiaCylShCirHSLS_0" VALUE 0x8002973A Val_Wu16 65535.00 DFES_OneToOne 0.00 65535.00 /end CHARACTERISTIC
/begin CHARACTERISTIC DFES_DTCO.DFC_IVDiaCylShCirHSLS_1_C "DFES/OBD spezifischer Fehlercode für Prüfung DFC_IVDiaCylShCirHSLS_1" VALUE 0x8002973C Val_Wu16 65535.00 DFES_OneToOne 0.00 65535.00 /end CHARACTERISTIC
/begin CHARACTERISTIC DFES_DTCO.DFC_IVDiaCylShCirHSLS_2_C "DFES/OBD spezifischer Fehlercode für Prüfung DFC_IVDiaCylShCirHSLS_2" VALUE 0x8002973E Val_Wu16 65535.00 DFES_OneToOne 0.00 65535.00 /end CHARACTERISTIC
/begin CHARACTERISTIC DFES_DTCO.DFC_IVDiaCylShCirHSLS_3_C "DFES/OBD spezifischer Fehlercode für Prüfung DFC_IVDiaCylShCirHSLS_3" VALUE 0x80029740 Val_Wu16 65535.00 DFES_OneToOne 0.00 65535.00 /end CHARACTERISTIC
/begin CHARACTERISTIC DFES_DTCO.DFC_IVDiaCylShCirHSLS_4_C "DFES/OBD spezifischer Fehlercode für Prüfung DFC_IVDiaCylShCirHSLS_4" VALUE 0x80029742 Val_Wu16 65535.00 DFES_OneToOne 0.00 65535.00 /end CHARACTERISTIC
/begin CHARACTERISTIC DFES_DTCO.DFC_IVDiaCylShCirHSLS_5_C "DFES/OBD spezifischer Fehlercode für Prüfung DFC_IVDiaCylShCirHSLS_5" VALUE 0x80029744 Val_Wu16 65535.00 DFES_OneToOne 0.00 65535.00 /end CHARACTERISTIC
/begin CHARACTERISTIC DFES_DTCO.DFC_IVDiaCylShCirMeas_0_C "DFES/OBD spezifischer Fehlercode für Prüfung DFC_IVDiaCylShCirMeas_0" VALUE 0x80029746 Val_Wu16 65535.00 DFES_OneToOne 0.00 65535.00 /end CHARACTERISTIC
/begin CHARACTERISTIC DFES_DTCO.DFC_IVDiaCylShCirMeas_1_C "DFES/OBD spezifischer Fehlercode für Prüfung DFC_IVDiaCylShCirMeas_1" VALUE 0x80029748 Val_Wu16 65535.00 DFES_OneToOne 0.00 65535.00 /end CHARACTERISTIC
/begin CHARACTERISTIC DFES_DTCO.DFC_IVDiaCylShCirMeas_2_C "DFES/OBD spezifischer Fehlercode für Prüfung DFC_IVDiaCylShCirMeas_2" VALUE 0x8002974A Val_Wu16 65535.00 DFES_OneToOne 0.00 65535.00 /end CHARACTERISTIC
/begin CHARACTERISTIC DFES_DTCO.DFC_IVDiaCylShCirMeas_3_C "DFES/OBD spezifischer Fehlercode für Prüfung DFC_IVDiaCylShCirMeas_3" VALUE 0x8002974C Val_Wu16 65535.00 DFES_OneToOne 0.00 65535.00 /end CHARACTERISTIC
/begin CHARACTERISTIC DFES_DTCO.DFC_IVDiaCylShCirMeas_4_C "DFES/OBD spezifischer Fehlercode für Prüfung DFC_IVDiaCylShCirMeas_4" VALUE 0x8002974E Val_Wu16 65535.00 DFES_OneToOne 0.00 65535.00 /end CHARACTERISTIC
/begin CHARACTERISTIC DFES_DTCO.DFC_IVDiaCylShCirMeas_5_C "DFES/OBD spezifischer Fehlercode für Prüfung DFC_IVDiaCylShCirMeas_5" VALUE 0x80029750 Val_Wu16 65535.00 DFES_OneToOne 0.00 65535.00 /end CHARACTERISTIC
/begin CHARACTERISTIC DFES_DTCO.DFC_LSUDynChk_C "DFES/OBD spezifischer Fehlercode für Prüfung DFC_LSUDynChk" VALUE 0x80029752 Val_Wu16 65535.00 DFES_OneToOne 0.00 65535.00 /end CHARACTERISTIC
/begin CHARACTERISTIC DFES_DTCO.DFC_LSUO2ClbMax_C "DFES/OBD spezifischer Fehlercode für Prüfung DFC_LSUO2ClbMax" VALUE 0x80029754 Val_Wu16 65535.00 DFES_OneToOne 0.00 65535.00 /end CHARACTERISTIC
/begin CHARACTERISTIC DFES_DTCO.DFC_LSUO2ClbMin_C "DFES/OBD spezifischer Fehlercode für Prüfung DFC_LSUO2ClbMin" VALUE 0x80029756 Val_Wu16 65535.00 DFES_OneToOne 0.00 65535.00 /end CHARACTERISTIC
/begin CHARACTERISTIC DFES_DTCO.DFC_LSUO2PlausMaxFLd_C "DFES/OBD spezifischer Fehlercode für Prüfung DFC_LSUO2PlausMaxFLd" VALUE 0x80029758 Val_Wu16 65535.00 DFES_OneToOne 0.00 65535.00 /end CHARACTERISTIC
/begin CHARACTERISTIC DFES_DTCO.DFC_LSUO2PlausMaxOvrRun_C "DFES/OBD spezifischer Fehlercode für Prüfung DFC_LSUO2PlausMaxOvrRun" VALUE 0x8002975A Val_Wu16 65535.00 DFES_OneToOne 0.00 65535.00 /end CHARACTERISTIC
/begin CHARACTERISTIC DFES_DTCO.DFC_LSUO2PlausMaxPartLd_C "DFES/OBD spezifischer Fehlercode für Prüfung DFC_LSUO2PlausMaxPartLd" VALUE 0x8002975C Val_Wu16 65535.00 DFES_OneToOne 0.00 65535.00 /end CHARACTERISTIC
/begin CHARACTERISTIC DFES_DTCO.DFC_LSUO2PlausMinFLd_C "DFES/OBD spezifischer Fehlercode für Prüfung DFC_LSUO2PlausMinFLd" VALUE 0x8002975E Val_Wu16 65535.00 DFES_OneToOne 0.00 65535.00 /end CHARACTERISTIC
/begin CHARACTERISTIC DFES_DTCO.DFC_LSUO2PlausMinOvrRun_C "DFES/OBD spezifischer Fehlercode für Prüfung DFC_LSUO2PlausMinOvrRun" VALUE 0x80029760 Val_Wu16 65535.00 DFES_OneToOne 0.00 65535.00 /end CHARACTERISTIC
/begin CHARACTERISTIC DFES_DTCO.DFC_LSUO2PlausMinPartLd_C "DFES/OBD spezifischer Fehlercode für Prüfung DFC_LSUO2PlausMinPartLd" VALUE 0x80029762 Val_Wu16 65535.00 DFES_OneToOne 0.00 65535.00 /end CHARACTERISTIC
/begin CHARACTERISTIC DFES_DTCO.DFC_LSURiClbMax_C "DFES/OBD spezifischer Fehlercode für Prüfung DFC_LSURiClbMax" VALUE 0x80029764 Val_Wu16 65535.00 DFES_OneToOne 0.00 65535.00 /end CHARACTERISTIC
/begin CHARACTERISTIC DFES_DTCO.DFC_LSURiClbMin_C "DFES/OBD spezifischer Fehlercode für Prüfung DFC_LSURiClbMin" VALUE 0x80029766 Val_Wu16 65535.00 DFES_OneToOne 0.00 65535.00 /end CHARACTERISTIC
/begin CHARACTERISTIC DFES_DTCO.DFC_LSUWireIPSig_C "DFES/OBD spezifischer Fehlercode für Prüfung DFC_LSUWireIPSig" VALUE 0x80029768 Val_Wu16 65535.00 DFES_OneToOne 0.00 65535.00 /end CHARACTERISTIC
/begin CHARACTERISTIC DFES_DTCO.DFC_Layer_BSDMax_C "DFES/OBD spezifischer Fehlercode für Prüfung DFC_Layer_BSDMax" VALUE 0x8002976A Val_Wu16 65535.00 DFES_OneToOne 0.00 65535.00 /end CHARACTERISTIC
/begin CHARACTERISTIC DFES_DTCO.DFC_Layer_BSDMin_C "DFES/OBD spezifischer Fehlercode für Prüfung DFC_Layer_BSDMin" VALUE 0x8002976C Val_Wu16 65535.00 DFES_OneToOne 0.00 65535.00 /end CHARACTERISTIC
/begin CHARACTERISTIC DFES_DTCO.DFC_Layer_BSDNpl_C "DFES/OBD spezifischer Fehlercode für Prüfung DFC_Layer_BSDNpl" VALUE 0x8002976E Val_Wu16 65535.00 DFES_OneToOne 0.00 65535.00 /end CHARACTERISTIC
/begin CHARACTERISTIC DFES_DTCO.DFC_Layer_BSDSig_C "DFES/OBD spezifischer Fehlercode für Prüfung DFC_Layer_BSDSig" VALUE 0x80029770 Val_Wu16 65535.00 DFES_OneToOne 0.00 65535.00 /end CHARACTERISTIC
/begin CHARACTERISTIC DFES_DTCO.DFC_Layer_FltMngTstMax_C "DFES/OBD spezifischer Fehlercode für Prüfung DFC_Layer_FltMngTstMax" VALUE 0x80029772 Val_Wu16 65535.00 DFES_OneToOne 0.00 65535.00 /end CHARACTERISTIC
/begin CHARACTERISTIC DFES_DTCO.DFC_Layer_FltMngTstMin_C "DFES/OBD spezifischer Fehlercode für Prüfung DFC_Layer_FltMngTstMin" VALUE 0x80029774 Val_Wu16 65535.00 DFES_OneToOne 0.00 65535.00 /end CHARACTERISTIC
/begin CHARACTERISTIC DFES_DTCO.DFC_Layer_FltMngTstNpl_C "DFES/OBD spezifischer Fehlercode für Prüfung DFC_Layer_FltMngTstNpl" VALUE 0x80029776 Val_Wu16 65535.00 DFES_OneToOne 0.00 65535.00 /end CHARACTERISTIC
/begin CHARACTERISTIC DFES_DTCO.DFC_Layer_FltMngTstSig_C "DFES/OBD spezifischer Fehlercode für Prüfung DFC_Layer_FltMngTstSig" VALUE 0x80029778 Val_Wu16 65535.00 DFES_OneToOne 0.00 65535.00 /end CHARACTERISTIC
/begin CHARACTERISTIC DFES_DTCO.DFC_Layer_GENELBMax_C "DFES/OBD spezifischer Fehlercode für Prüfung DFC_Layer_GENELBMax" VALUE 0x8002977A Val_Wu16 65535.00 DFES_OneToOne 0.00 65535.00 /end CHARACTERISTIC
/begin CHARACTERISTIC DFES_DTCO.DFC_Layer_GENELBMin_C "DFES/OBD spezifischer Fehlercode für Prüfung DFC_Layer_GENELBMin" VALUE 0x8002977C Val_Wu16 65535.00 DFES_OneToOne 0.00 65535.00 /end CHARACTERISTIC
/begin CHARACTERISTIC DFES_DTCO.DFC_Layer_GENELBNpl_C "DFES/OBD spezifischer Fehlercode für Prüfung DFC_Layer_GENELBNpl" VALUE 0x8002977E Val_Wu16 65535.00 DFES_OneToOne 0.00 65535.00 /end CHARACTERISTIC
/begin CHARACTERISTIC DFES_DTCO.DFC_Layer_GENELBSig_C "DFES/OBD spezifischer Fehlercode für Prüfung DFC_Layer_GENELBSig" VALUE 0x80029780 Val_Wu16 65535.00 DFES_OneToOne 0.00 65535.00 /end CHARACTERISTIC
/begin CHARACTERISTIC DFES_DTCO.DFC_Layer_GENELMax_C "DFES/OBD spezifischer Fehlercode für Prüfung DFC_Layer_GENELMax" VALUE 0x80029782 Val_Wu16 65535.00 DFES_OneToOne 0.00 65535.00 /end CHARACTERISTIC
/begin CHARACTERISTIC DFES_DTCO.DFC_Layer_GENELMin_C "DFES/OBD spezifischer Fehlercode für Prüfung DFC_Layer_GENELMin" VALUE 0x80029784 Val_Wu16 65535.00 DFES_OneToOne 0.00 65535.00 /end CHARACTERISTIC
/begin CHARACTERISTIC DFES_DTCO.DFC_Layer_GENELNpl_C "DFES/OBD spezifischer Fehlercode für Prüfung DFC_Layer_GENELNpl" VALUE 0x80029786 Val_Wu16 65535.00 DFES_OneToOne 0.00 65535.00 /end CHARACTERISTIC
/begin CHARACTERISTIC DFES_DTCO.DFC_Layer_GENELSig_C "DFES/OBD spezifischer Fehlercode für Prüfung DFC_Layer_GENELSig" VALUE 0x80029788 Val_Wu16 65535.00 DFES_OneToOne 0.00 65535.00 /end CHARACTERISTIC
/begin CHARACTERISTIC DFES_DTCO.DFC_Layer_GENHTBMax_C "DFES/OBD spezifischer Fehlercode für Prüfung DFC_Layer_GENHTBMax" VALUE 0x8002978A Val_Wu16 65535.00 DFES_OneToOne 0.00 65535.00 /end CHARACTERISTIC
/begin CHARACTERISTIC DFES_DTCO.DFC_Layer_GENHTBMin_C "DFES/OBD spezifischer Fehlercode für Prüfung DFC_Layer_GENHTBMin" VALUE 0x8002978C Val_Wu16 65535.00 DFES_OneToOne 0.00 65535.00 /end CHARACTERISTIC
/begin CHARACTERISTIC DFES_DTCO.DFC_Layer_GENHTBNpl_C "DFES/OBD spezifischer Fehlercode für Prüfung DFC_Layer_GENHTBNpl" VALUE 0x8002978E Val_Wu16 65535.00 DFES_OneToOne 0.00 65535.00 /end CHARACTERISTIC
/begin CHARACTERISTIC DFES_DTCO.DFC_Layer_GENHTBSig_C "DFES/OBD spezifischer Fehlercode für Prüfung DFC_Layer_GENHTBSig" VALUE 0x80029790 Val_Wu16 65535.00 DFES_OneToOne 0.00 65535.00 /end CHARACTERISTIC
/begin CHARACTERISTIC DFES_DTCO.DFC_Layer_GENHTMax_C "DFES/OBD spezifischer Fehlercode für Prüfung DFC_Layer_GENHTMax" VALUE 0x80029792 Val_Wu16 65535.00 DFES_OneToOne 0.00 65535.00 /end CHARACTERISTIC
/begin CHARACTERISTIC DFES_DTCO.DFC_Layer_GENHTMin_C "DFES/OBD spezifischer Fehlercode für Prüfung DFC_Layer_GENHTMin" VALUE 0x80029794 Val_Wu16 65535.00 DFES_OneToOne 0.00 65535.00 /end CHARACTERISTIC
/begin CHARACTERISTIC DFES_DTCO.DFC_Layer_GENHTNpl_C "DFES/OBD spezifischer Fehlercode für Prüfung DFC_Layer_GENHTNpl" VALUE 0x80029796 Val_Wu16 65535.00 DFES_OneToOne 0.00 65535.00 /end CHARACTERISTIC
/begin CHARACTERISTIC DFES_DTCO.DFC_Layer_GENHTSig_C "DFES/OBD spezifischer Fehlercode für Prüfung DFC_Layer_GENHTSig" VALUE 0x80029798 Val_Wu16 65535.00 DFES_OneToOne 0.00 65535.00 /end CHARACTERISTIC
/begin CHARACTERISTIC DFES_DTCO.DFC_Layer_GENKOMMMax_C "DFES/OBD spezifischer Fehlercode für Prüfung DFC_Layer_GENKOMMMax" VALUE 0x8002979A Val_Wu16 65535.00 DFES_OneToOne 0.00 65535.00 /end CHARACTERISTIC
/begin CHARACTERISTIC DFES_DTCO.DFC_Layer_GENKOMMMin_C "DFES/OBD spezifischer Fehlercode für Prüfung DFC_Layer_GENKOMMMin" VALUE 0x8002979C Val_Wu16 65535.00 DFES_OneToOne 0.00 65535.00 /end CHARACTERISTIC
/begin CHARACTERISTIC DFES_DTCO.DFC_Layer_GENKOMMNpl_C "DFES/OBD spezifischer Fehlercode für Prüfung DFC_Layer_GENKOMMNpl" VALUE 0x8002979E Val_Wu16 65535.00 DFES_OneToOne 0.00 65535.00 /end CHARACTERISTIC
/begin CHARACTERISTIC DFES_DTCO.DFC_Layer_GENKOMMSig_C "DFES/OBD spezifischer Fehlercode für Prüfung DFC_Layer_GENKOMMSig" VALUE 0x800297A0 Val_Wu16 65535.00 DFES_OneToOne 0.00 65535.00 /end CHARACTERISTIC
/begin CHARACTERISTIC DFES_DTCO.DFC_Layer_GENMECHMax_C "DFES/OBD spezifischer Fehlercode für Prüfung DFC_Layer_GENMECHMax" VALUE 0x800297A2 Val_Wu16 65535.00 DFES_OneToOne 0.00 65535.00 /end CHARACTERISTIC
/begin CHARACTERISTIC DFES_DTCO.DFC_Layer_GENMECHMin_C "DFES/OBD spezifischer Fehlercode für Prüfung DFC_Layer_GENMECHMin" VALUE 0x800297A4 Val_Wu16 65535.00 DFES_OneToOne 0.00 65535.00 /end CHARACTERISTIC
/begin CHARACTERISTIC DFES_DTCO.DFC_Layer_GENMECHNpl_C "DFES/OBD spezifischer Fehlercode für Prüfung DFC_Layer_GENMECHNpl" VALUE 0x800297A6 Val_Wu16 65535.00 DFES_OneToOne 0.00 65535.00 /end CHARACTERISTIC
/begin CHARACTERISTIC DFES_DTCO.DFC_Layer_GENMECHSig_C "DFES/OBD spezifischer Fehlercode für Prüfung DFC_Layer_GENMECHSig" VALUE 0x800297A8 Val_Wu16 65535.00 DFES_OneToOne 0.00 65535.00 /end CHARACTERISTIC
/begin CHARACTERISTIC DFES_DTCO.DFC_Layer_GENMax_C "DFES/OBD spezifischer Fehlercode für Prüfung DFC_Layer_GENMax" VALUE 0x800297AA Val_Wu16 65535.00 DFES_OneToOne 0.00 65535.00 /end CHARACTERISTIC
/begin CHARACTERISTIC DFES_DTCO.DFC_Layer_GENMin_C "DFES/OBD spezifischer Fehlercode für Prüfung DFC_Layer_GENMin" VALUE 0x800297AC Val_Wu16 65535.00 DFES_OneToOne 0.00 65535.00 /end CHARACTERISTIC
/begin CHARACTERISTIC DFES_DTCO.DFC_Layer_GENNpl_C "DFES/OBD spezifischer Fehlercode für Prüfung DFC_Layer_GENNpl" VALUE 0x800297AE Val_Wu16 65535.00 DFES_OneToOne 0.00 65535.00 /end CHARACTERISTIC
/begin CHARACTERISTIC DFES_DTCO.DFC_Layer_GENREGUPLMax_C "DFES/OBD spezifischer Fehlercode für Prüfung DFC_Layer_GENREGUPLMax" VALUE 0x800297B0 Val_Wu16 65535.00 DFES_OneToOne 0.00 65535.00 /end CHARACTERISTIC
/begin CHARACTERISTIC DFES_DTCO.DFC_Layer_GENREGUPLMin_C "DFES/OBD spezifischer Fehlercode für Prüfung DFC_Layer_GENREGUPLMin" VALUE 0x800297B2 Val_Wu16 65535.00 DFES_OneToOne 0.00 65535.00 /end CHARACTERISTIC
/begin CHARACTERISTIC DFES_DTCO.DFC_Layer_GENREGUPLNpl_C "DFES/OBD spezifischer Fehlercode für Prüfung DFC_Layer_GENREGUPLNpl" VALUE 0x800297B4 Val_Wu16 65535.00 DFES_OneToOne 0.00 65535.00 /end CHARACTERISTIC
/begin CHARACTERISTIC DFES_DTCO.DFC_Layer_GENREGUPLSig_C "DFES/OBD spezifischer Fehlercode für Prüfung DFC_Layer_GENREGUPLSig" VALUE 0x800297B6 Val_Wu16 65535.00 DFES_OneToOne 0.00 65535.00 /end CHARACTERISTIC
/begin CHARACTERISTIC DFES_DTCO.DFC_Layer_GENSig_C "DFES/OBD spezifischer Fehlercode für Prüfung DFC_Layer_GENSig" VALUE 0x800297B8 Val_Wu16 65535.00 DFES_OneToOne 0.00 65535.00 /end CHARACTERISTIC
/begin CHARACTERISTIC DFES_DTCO.DFC_Layer_GENUPLMax_C "DFES/OBD spezifischer Fehlercode für Prüfung DFC_Layer_GENUPLMax" VALUE 0x800297BA Val_Wu16 65535.00 DFES_OneToOne 0.00 65535.00 /end CHARACTERISTIC
/begin CHARACTERISTIC DFES_DTCO.DFC_Layer_GENUPLMin_C "DFES/OBD spezifischer Fehlercode für Prüfung DFC_Layer_GENUPLMin" VALUE 0x800297BC Val_Wu16 65535.00 DFES_OneToOne 0.00 65535.00 /end CHARACTERISTIC
/begin CHARACTERISTIC DFES_DTCO.DFC_Layer_GENUPLNpl_C "DFES/OBD spezifischer Fehlercode für Prüfung DFC_Layer_GENUPLNpl" VALUE 0x800297BE Val_Wu16 65535.00 DFES_OneToOne 0.00 65535.00 /end CHARACTERISTIC
/begin CHARACTERISTIC DFES_DTCO.DFC_Layer_GENUPLSig_C "DFES/OBD spezifischer Fehlercode für Prüfung DFC_Layer_GENUPLSig" VALUE 0x800297C0 Val_Wu16 65535.00 DFES_OneToOne 0.00 65535.00 /end CHARACTERISTIC
/begin CHARACTERISTIC DFES_DTCO.DFC_Layer_IBS1Max_C "DFES/OBD spezifischer Fehlercode für Prüfung DFC_Layer_IBS1Max" VALUE 0x800297C2 Val_Wu16 65535.00 DFES_OneToOne 0.00 65535.00 /end CHARACTERISTIC
/begin CHARACTERISTIC DFES_DTCO.DFC_Layer_IBS1Min_C "DFES/OBD spezifischer Fehlercode für Prüfung DFC_Layer_IBS1Min" VALUE 0x800297C4 Val_Wu16 65535.00 DFES_OneToOne 0.00 65535.00 /end CHARACTERISTIC
/begin CHARACTERISTIC DFES_DTCO.DFC_Layer_IBS1Npl_C "DFES/OBD spezifischer Fehlercode für Prüfung DFC_Layer_IBS1Npl" VALUE 0x800297C6 Val_Wu16 65535.00 DFES_OneToOne 0.00 65535.00 /end CHARACTERISTIC
/begin CHARACTERISTIC DFES_DTCO.DFC_Layer_IBS1Sig_C "DFES/OBD spezifischer Fehlercode für Prüfung DFC_Layer_IBS1Sig" VALUE 0x800297C8 Val_Wu16 65535.00 DFES_OneToOne 0.00 65535.00 /end CHARACTERISTIC
/begin CHARACTERISTIC DFES_DTCO.DFC_Layer_IBS2Max_C "DFES/OBD spezifischer Fehlercode für Prüfung DFC_Layer_IBS2Max" VALUE 0x800297CA Val_Wu16 65535.00 DFES_OneToOne 0.00 65535.00 /end CHARACTERISTIC
/begin CHARACTERISTIC DFES_DTCO.DFC_Layer_IBS2Min_C "DFES/OBD spezifischer Fehlercode für Prüfung DFC_Layer_IBS2Min" VALUE 0x800297CC Val_Wu16 65535.00 DFES_OneToOne 0.00 65535.00 /end CHARACTERISTIC
/begin CHARACTERISTIC DFES_DTCO.DFC_Layer_IBS2Npl_C "DFES/OBD spezifischer Fehlercode für Prüfung DFC_Layer_IBS2Npl" VALUE 0x800297CE Val_Wu16 65535.00 DFES_OneToOne 0.00 65535.00 /end CHARACTERISTIC
/begin CHARACTERISTIC DFES_DTCO.DFC_Layer_IBS2Sig_C "DFES/OBD spezifischer Fehlercode für Prüfung DFC_Layer_IBS2Sig" VALUE 0x800297D0 Val_Wu16 65535.00 DFES_OneToOne 0.00 65535.00 /end CHARACTERISTIC
/begin CHARACTERISTIC DFES_DTCO.DFC_Layer_IBS3Max_C "DFES/OBD spezifischer Fehlercode für Prüfung DFC_Layer_IBS3Max" VALUE 0x800297D2 Val_Wu16 65535.00 DFES_OneToOne 0.00 65535.00 /end CHARACTERISTIC
/begin CHARACTERISTIC DFES_DTCO.DFC_Layer_IBS3Min_C "DFES/OBD spezifischer Fehlercode für Prüfung DFC_Layer_IBS3Min" VALUE 0x800297D4 Val_Wu16 65535.00 DFES_OneToOne 0.00 65535.00 /end CHARACTERISTIC
/begin CHARACTERISTIC DFES_DTCO.DFC_Layer_IBS3Npl_C "DFES/OBD spezifischer Fehlercode für Prüfung DFC_Layer_IBS3Npl" VALUE 0x800297D6 Val_Wu16 65535.00 DFES_OneToOne 0.00 65535.00 /end CHARACTERISTIC
/begin CHARACTERISTIC DFES_DTCO.DFC_Layer_IBS3Sig_C "DFES/OBD spezifischer Fehlercode für Prüfung DFC_Layer_IBS3Sig" VALUE 0x800297D8 Val_Wu16 65535.00 DFES_OneToOne 0.00 65535.00 /end CHARACTERISTIC
/begin CHARACTERISTIC DFES_DTCO.DFC_Layer_MANDETEKMax_C "DFES/OBD spezifischer Fehlercode für Prüfung DFC_Layer_MANDETEKMax" VALUE 0x800297DA Val_Wu16 65535.00 DFES_OneToOne 0.00 65535.00 /end CHARACTERISTIC
/begin CHARACTERISTIC DFES_DTCO.DFC_Layer_MANDETEKMin_C "DFES/OBD spezifischer Fehlercode für Prüfung DFC_Layer_MANDETEKMin" VALUE 0x800297DC Val_Wu16 65535.00 DFES_OneToOne 0.00 65535.00 /end CHARACTERISTIC
/begin CHARACTERISTIC DFES_DTCO.DFC_Layer_MANDETEKNpl_C "DFES/OBD spezifischer Fehlercode für Prüfung DFC_Layer_MANDETEKNpl" VALUE 0x800297DE Val_Wu16 65535.00 DFES_OneToOne 0.00 65535.00 /end CHARACTERISTIC
/begin CHARACTERISTIC DFES_DTCO.DFC_Layer_MANDETEKSig_C "DFES/OBD spezifischer Fehlercode für Prüfung DFC_Layer_MANDETEKSig" VALUE 0x800297E0 Val_Wu16 65535.00 DFES_OneToOne 0.00 65535.00 /end CHARACTERISTIC
/begin CHARACTERISTIC DFES_DTCO.DFC_Layer_NDR1Max_C "DFES/OBD spezifischer Fehlercode für Prüfung DFC_Layer_NDR1Max" VALUE 0x800297E2 Val_Wu16 65535.00 DFES_OneToOne 0.00 65535.00 /end CHARACTERISTIC
/begin CHARACTERISTIC DFES_DTCO.DFC_Layer_NDR1Min_C "DFES/OBD spezifischer Fehlercode für Prüfung DFC_Layer_NDR1Min" VALUE 0x800297E4 Val_Wu16 65535.00 DFES_OneToOne 0.00 65535.00 /end CHARACTERISTIC
/begin CHARACTERISTIC DFES_DTCO.DFC_Layer_NDR1Npl_C "DFES/OBD spezifischer Fehlercode für Prüfung DFC_Layer_NDR1Npl" VALUE 0x800297E6 Val_Wu16 65535.00 DFES_OneToOne 0.00 65535.00 /end CHARACTERISTIC
/begin CHARACTERISTIC DFES_DTCO.DFC_Layer_NDR1Sig_C "DFES/OBD spezifischer Fehlercode für Prüfung DFC_Layer_NDR1Sig" VALUE 0x800297E8 Val_Wu16 65535.00 DFES_OneToOne 0.00 65535.00 /end CHARACTERISTIC
/begin CHARACTERISTIC DFES_DTCO.DFC_Layer_NDR2Max_C "DFES/OBD spezifischer Fehlercode für Prüfung DFC_Layer_NDR2Max" VALUE 0x800297EA Val_Wu16 65535.00 DFES_OneToOne 0.00 65535.00 /end CHARACTERISTIC
/begin CHARACTERISTIC DFES_DTCO.DFC_Layer_NDR2Min_C "DFES/OBD spezifischer Fehlercode für Prüfung DFC_Layer_NDR2Min" VALUE 0x800297EC Val_Wu16 65535.00 DFES_OneToOne 0.00 65535.00 /end CHARACTERISTIC
/begin CHARACTERISTIC DFES_DTCO.DFC_Layer_NDR2Npl_C "DFES/OBD spezifischer Fehlercode für Prüfung DFC_Layer_NDR2Npl" VALUE 0x800297EE Val_Wu16 65535.00 DFES_OneToOne 0.00 65535.00 /end CHARACTERISTIC
/begin CHARACTERISTIC DFES_DTCO.DFC_Layer_NDR2Sig_C "DFES/OBD spezifischer Fehlercode für Prüfung DFC_Layer_NDR2Sig" VALUE 0x800297F0 Val_Wu16 65535.00 DFES_OneToOne 0.00 65535.00 /end CHARACTERISTIC
/begin CHARACTERISTIC DFES_DTCO.DFC_Layer_NGLERNMax_C "DFES/OBD spezifischer Fehlercode für Prüfung DFC_Layer_NGLERNMax" VALUE 0x800297F2 Val_Wu16 65535.00 DFES_OneToOne 0.00 65535.00 /end CHARACTERISTIC
/begin CHARACTERISTIC DFES_DTCO.DFC_Layer_NGLERNMin_C "DFES/OBD spezifischer Fehlercode für Prüfung DFC_Layer_NGLERNMin" VALUE 0x800297F4 Val_Wu16 65535.00 DFES_OneToOne 0.00 65535.00 /end CHARACTERISTIC
/begin CHARACTERISTIC DFES_DTCO.DFC_Layer_NGLERNNpl_C "DFES/OBD spezifischer Fehlercode für Prüfung DFC_Layer_NGLERNNpl" VALUE 0x800297F6 Val_Wu16 65535.00 DFES_OneToOne 0.00 65535.00 /end CHARACTERISTIC
/begin CHARACTERISTIC DFES_DTCO.DFC_Layer_NGLERNSig_C "DFES/OBD spezifischer Fehlercode für Prüfung DFC_Layer_NGLERNSig" VALUE 0x800297F8 Val_Wu16 65535.00 DFES_OneToOne 0.00 65535.00 /end CHARACTERISTIC
/begin CHARACTERISTIC DFES_DTCO.DFC_Layer_PMBATTMax_C "DFES/OBD spezifischer Fehlercode für Prüfung DFC_Layer_PMBATTMax" VALUE 0x800297FA Val_Wu16 65535.00 DFES_OneToOne 0.00 65535.00 /end CHARACTERISTIC
/begin CHARACTERISTIC DFES_DTCO.DFC_Layer_PMBATTMin_C "DFES/OBD spezifischer Fehlercode für Prüfung DFC_Layer_PMBATTMin" VALUE 0x800297FC Val_Wu16 65535.00 DFES_OneToOne 0.00 65535.00 /end CHARACTERISTIC
/begin CHARACTERISTIC DFES_DTCO.DFC_Layer_PMBATTNpl_C "DFES/OBD spezifischer Fehlercode für Prüfung DFC_Layer_PMBATTNpl" VALUE 0x800297FE Val_Wu16 65535.00 DFES_OneToOne 0.00 65535.00 /end CHARACTERISTIC
/begin CHARACTERISTIC DFES_DTCO.DFC_Layer_PMBATTSig_C "DFES/OBD spezifischer Fehlercode für Prüfung DFC_Layer_PMBATTSig" VALUE 0x80029800 Val_Wu16 65535.00 DFES_OneToOne 0.00 65535.00 /end CHARACTERISTIC
/begin CHARACTERISTIC DFES_DTCO.DFC_Layer_PMBNMax_C "DFES/OBD spezifischer Fehlercode für Prüfung DFC_Layer_PMBNMax" VALUE 0x80029802 Val_Wu16 65535.00 DFES_OneToOne 0.00 65535.00 /end CHARACTERISTIC
/begin CHARACTERISTIC DFES_DTCO.DFC_Layer_PMBNMin_C "DFES/OBD spezifischer Fehlercode für Prüfung DFC_Layer_PMBNMin" VALUE 0x80029804 Val_Wu16 65535.00 DFES_OneToOne 0.00 65535.00 /end CHARACTERISTIC
/begin CHARACTERISTIC DFES_DTCO.DFC_Layer_PMBNNpl_C "DFES/OBD spezifischer Fehlercode für Prüfung DFC_Layer_PMBNNpl" VALUE 0x80029806 Val_Wu16 65535.00 DFES_OneToOne 0.00 65535.00 /end CHARACTERISTIC
/begin CHARACTERISTIC DFES_DTCO.DFC_Layer_PMBNSig_C "DFES/OBD spezifischer Fehlercode für Prüfung DFC_Layer_PMBNSig" VALUE 0x80029808 Val_Wu16 65535.00 DFES_OneToOne 0.00 65535.00 /end CHARACTERISTIC
/begin CHARACTERISTIC DFES_DTCO.DFC_Layer_PMRUHVERLMax_C "DFES/OBD spezifischer Fehlercode für Prüfung DFC_Layer_PMRUHVERLMax" VALUE 0x8002980A Val_Wu16 65535.00 DFES_OneToOne 0.00 65535.00 /end CHARACTERISTIC
/begin CHARACTERISTIC DFES_DTCO.DFC_Layer_PMRUHVERLMin_C "DFES/OBD spezifischer Fehlercode für Prüfung DFC_Layer_PMRUHVERLMin" VALUE 0x8002980C Val_Wu16 65535.00 DFES_OneToOne 0.00 65535.00 /end CHARACTERISTIC
/begin CHARACTERISTIC DFES_DTCO.DFC_Layer_PMRUHVERLNpl_C "DFES/OBD spezifischer Fehlercode für Prüfung DFC_Layer_PMRUHVERLNpl" VALUE 0x8002980E Val_Wu16 65535.00 DFES_OneToOne 0.00 65535.00 /end CHARACTERISTIC
/begin CHARACTERISTIC DFES_DTCO.DFC_Layer_PMRUHVERLSig_C "DFES/OBD spezifischer Fehlercode für Prüfung DFC_Layer_PMRUHVERLSig" VALUE 0x80029810 Val_Wu16 65535.00 DFES_OneToOne 0.00 65535.00 /end CHARACTERISTIC
/begin CHARACTERISTIC DFES_DTCO.DFC_Layer_QLTMax_C "DFES/OBD spezifischer Fehlercode für Prüfung DFC_Layer_QLTMax" VALUE 0x80029812 Val_Wu16 65535.00 DFES_OneToOne 0.00 65535.00 /end CHARACTERISTIC
/begin CHARACTERISTIC DFES_DTCO.DFC_Layer_QLTMin_C "DFES/OBD spezifischer Fehlercode für Prüfung DFC_Layer_QLTMin" VALUE 0x80029814 Val_Wu16 65535.00 DFES_OneToOne 0.00 65535.00 /end CHARACTERISTIC
/begin CHARACTERISTIC DFES_DTCO.DFC_Layer_QLTNpl_C "DFES/OBD spezifischer Fehlercode für Prüfung DFC_Layer_QLTNpl" VALUE 0x80029816 Val_Wu16 65535.00 DFES_OneToOne 0.00 65535.00 /end CHARACTERISTIC
/begin CHARACTERISTIC DFES_DTCO.DFC_Layer_QLTSig_C "DFES/OBD spezifischer Fehlercode für Prüfung DFC_Layer_QLTSig" VALUE 0x80029818 Val_Wu16 65535.00 DFES_OneToOne 0.00 65535.00 /end CHARACTERISTIC
/begin CHARACTERISTIC DFES_DTCO.DFC_Layer_TOENSMax_C "DFES/OBD spezifischer Fehlercode für Prüfung DFC_Layer_TOENSMax" VALUE 0x8002981A Val_Wu16 65535.00 DFES_OneToOne 0.00 65535.00 /end CHARACTERISTIC
/begin CHARACTERISTIC DFES_DTCO.DFC_Layer_TOENSMin_C "DFES/OBD spezifischer Fehlercode für Prüfung DFC_Layer_TOENSMin" VALUE 0x8002981C Val_Wu16 65535.00 DFES_OneToOne 0.00 65535.00 /end CHARACTERISTIC
/begin CHARACTERISTIC DFES_DTCO.DFC_Layer_TOENSNpl_C "DFES/OBD spezifischer Fehlercode für Prüfung DFC_Layer_TOENSNpl" VALUE 0x8002981E Val_Wu16 65535.00 DFES_OneToOne 0.00 65535.00 /end CHARACTERISTIC
/begin CHARACTERISTIC DFES_DTCO.DFC_Layer_TOENSSig_C "DFES/OBD spezifischer Fehlercode für Prüfung DFC_Layer_TOENSSig" VALUE 0x80029820 Val_Wu16 65535.00 DFES_OneToOne 0.00 65535.00 /end CHARACTERISTIC
/begin CHARACTERISTIC DFES_DTCO.DFC_MonLimCurr_C "DFES/OBD spezifischer Fehlercode für Prüfung DFC_MonLimCurr" VALUE 0x80029822 Val_Wu16 65535.00 DFES_OneToOne 0.00 65535.00 /end CHARACTERISTIC
/begin CHARACTERISTIC DFES_DTCO.DFC_MonLimLead_C "DFES/OBD spezifischer Fehlercode für Prüfung DFC_MonLimLead" VALUE 0x80029824 Val_Wu16 65535.00 DFES_OneToOne 0.00 65535.00 /end CHARACTERISTIC
/begin CHARACTERISTIC DFES_DTCO.DFC_MonLimSet_C "DFES/OBD spezifischer Fehlercode für Prüfung DFC_MonLimSet" VALUE 0x80029826 Val_Wu16 65535.00 DFES_OneToOne 0.00 65535.00 /end CHARACTERISTIC
/begin CHARACTERISTIC DFES_DTCO.DFC_NSCDsNOxOfsMax_C "DFES/OBD spezifischer Fehlercode für Prüfung DFC_NSCDsNOxOfsMax" VALUE 0x80029828 Val_Wu16 65535.00 DFES_OneToOne 0.00 65535.00 /end CHARACTERISTIC
/begin CHARACTERISTIC DFES_DTCO.DFC_NSCDsNOxOfsMin_C "DFES/OBD spezifischer Fehlercode für Prüfung DFC_NSCDsNOxOfsMin" VALUE 0x8002982A Val_Wu16 65535.00 DFES_OneToOne 0.00 65535.00 /end CHARACTERISTIC
/begin CHARACTERISTIC DFES_DTCO.DFC_NSCDsNOxPlausMin_C "DFES/OBD spezifischer Fehlercode für Prüfung DFC_NSCDsNOxPlausMin" VALUE 0x8002982C Val_Wu16 65535.00 DFES_OneToOne 0.00 65535.00 /end CHARACTERISTIC
/begin CHARACTERISTIC DFES_DTCO.DFC_NoCat2DsNOxOfsMax_C "DFES/OBD spezifischer Fehlercode für Prüfung DFC_NoCat2DsNOxOfsMax" VALUE 0x8002982E Val_Wu16 65535.00 DFES_OneToOne 0.00 65535.00 /end CHARACTERISTIC
/begin CHARACTERISTIC DFES_DTCO.DFC_NoCat2DsNOxOfsMin_C "DFES/OBD spezifischer Fehlercode für Prüfung DFC_NoCat2DsNOxOfsMin" VALUE 0x80029830 Val_Wu16 65535.00 DFES_OneToOne 0.00 65535.00 /end CHARACTERISTIC
/begin CHARACTERISTIC DFES_DTCO.DFC_NoCat2DsNOxPlausMin_C "DFES/OBD spezifischer Fehlercode für Prüfung DFC_NoCat2DsNOxPlausMin" VALUE 0x80029832 Val_Wu16 65535.00 DFES_OneToOne 0.00 65535.00 /end CHARACTERISTIC
/begin CHARACTERISTIC DFES_DTCO.DFC_PCVNoStrt_C "DFES/OBD spezifischer Fehlercode für Prüfung DFC_PCVNoStrt" VALUE 0x80029834 Val_Wu16 65535.00 DFES_OneToOne 0.00 65535.00 /end CHARACTERISTIC
/begin CHARACTERISTIC DFES_DTCO.DFC_RailPGradMon_C "DFES/OBD spezifischer Fehlercode für Prüfung DFC_RailPGradMon" VALUE 0x80029836 Val_Wu16 65535.00 DFES_OneToOne 0.00 65535.00 /end CHARACTERISTIC
/begin CHARACTERISTIC DFES_DTCO.DFC_SCRPODPresBuildUp_C "DFES/OBD spezifischer Fehlercode für Prüfung DFC_SCRPODPresBuildUp" VALUE 0x80029838 Val_Wu16 65535.00 DFES_OneToOne 0.00 65535.00 /end CHARACTERISTIC
/begin CHARACTERISTIC DFES_DTCO.DFC_AFSDrftIdlAdjVal_C "DFES/OBD spezifischer Fehlercode für Prüfung DFC_AFSDrftIdlAdjVal" VALUE 0x8002983A Val_Wu16 65535.00 DFES_OneToOne 0.00 65535.00 /end CHARACTERISTIC
/begin CHARACTERISTIC DFES_DTCO.DFC_AFSDrftLdAdjVal_C "DFES/OBD spezifischer Fehlercode für Prüfung DFC_AFSDrftLdAdjVal" VALUE 0x8002983C Val_Wu16 65535.00 DFES_OneToOne 0.00 65535.00 /end CHARACTERISTIC
/begin CHARACTERISTIC DFES_DTCO.DFC_AdcIADC0Cal_C "DFES/OBD spezifischer Fehlercode für Prüfung DFC_AdcIADC0Cal" VALUE 0x8002983E Val_Wu16 65535.00 DFES_OneToOne 0.00 65535.00 /end CHARACTERISTIC
/begin CHARACTERISTIC DFES_DTCO.DFC_AdcIADC0Conv_C "DFES/OBD spezifischer Fehlercode für Prüfung DFC_AdcIADC0Conv" VALUE 0x80029840 Val_Wu16 65535.00 DFES_OneToOne 0.00 65535.00 /end CHARACTERISTIC
/begin CHARACTERISTIC DFES_DTCO.DFC_AdcIADC1Cal_C "DFES/OBD spezifischer Fehlercode für Prüfung DFC_AdcIADC1Cal" VALUE 0x80029842 Val_Wu16 65535.00 DFES_OneToOne 0.00 65535.00 /end CHARACTERISTIC
/begin CHARACTERISTIC DFES_DTCO.DFC_AdcIADC1Conv_C "DFES/OBD spezifischer Fehlercode für Prüfung DFC_AdcIADC1Conv" VALUE 0x80029844 Val_Wu16 65535.00 DFES_OneToOne 0.00 65535.00 /end CHARACTERISTIC
/begin CHARACTERISTIC DFES_DTCO.DFC_CmbChbMisfireMax_0_C "DFES/OBD spezifischer Fehlercode für Prüfung DFC_CmbChbMisfireMax_0" VALUE 0x80029846 Val_Wu16 65535.00 DFES_OneToOne 0.00 65535.00 /end CHARACTERISTIC
/begin CHARACTERISTIC DFES_DTCO.DFC_CmbChbMisfireMax_1_C "DFES/OBD spezifischer Fehlercode für Prüfung DFC_CmbChbMisfireMax_1" VALUE 0x80029848 Val_Wu16 65535.00 DFES_OneToOne 0.00 65535.00 /end CHARACTERISTIC
/begin CHARACTERISTIC DFES_DTCO.DFC_CmbChbMisfireMax_2_C "DFES/OBD spezifischer Fehlercode für Prüfung DFC_CmbChbMisfireMax_2" VALUE 0x8002984A Val_Wu16 65535.00 DFES_OneToOne 0.00 65535.00 /end CHARACTERISTIC
/begin CHARACTERISTIC DFES_DTCO.DFC_CmbChbMisfireMax_3_C "DFES/OBD spezifischer Fehlercode für Prüfung DFC_CmbChbMisfireMax_3" VALUE 0x8002984C Val_Wu16 65535.00 DFES_OneToOne 0.00 65535.00 /end CHARACTERISTIC
/begin CHARACTERISTIC DFES_DTCO.DFC_CmbChbMisfireMax_4_C "DFES/OBD spezifischer Fehlercode für Prüfung DFC_CmbChbMisfireMax_4" VALUE 0x8002984E Val_Wu16 65535.00 DFES_OneToOne 0.00 65535.00 /end CHARACTERISTIC
/begin CHARACTERISTIC DFES_DTCO.DFC_CmbChbMisfireMax_5_C "DFES/OBD spezifischer Fehlercode für Prüfung DFC_CmbChbMisfireMax_5" VALUE 0x80029850 Val_Wu16 65535.00 DFES_OneToOne 0.00 65535.00 /end CHARACTERISTIC
/begin CHARACTERISTIC DFES_DTCO.DFC_CmbChbMisfireMul_C "DFES/OBD spezifischer Fehlercode für Prüfung DFC_CmbChbMisfireMul" VALUE 0x80029852 Val_Wu16 65535.00 DFES_OneToOne 0.00 65535.00 /end CHARACTERISTIC
/begin CHARACTERISTIC DFES_DTCO.DFC_EGRVlvLPOfsNeutr_C "DFES/" VALUE 0x80029854 Val_Wu16 65535.00 DFES_OneToOne 0.00 65535.00 /end CHARACTERISTIC
/begin CHARACTERISTIC DFES_DTCO.DFC_EGRVlvOfsNeutr_C "DFES/OBD spezifischer Fehlercode für Prüfung DFC_EGRVlvOfsNeutr" VALUE 0x80029856 Val_Wu16 65535.00 DFES_OneToOne 0.00 65535.00 /end CHARACTERISTIC
/begin CHARACTERISTIC DFES_DTCO.DFC_FMAErrModMax_C "DFES/OBD spezifischer Fehlercode für Prüfung DFC_FMAErrModMax" VALUE 0x80029858 Val_Wu16 65535.00 DFES_OneToOne 0.00 65535.00 /end CHARACTERISTIC
/begin CHARACTERISTIC DFES_DTCO.DFC_FMAErrModMin_C "DFES/OBD spezifischer Fehlercode für Prüfung DFC_FMAErrModMin" VALUE 0x8002985A Val_Wu16 65535.00 DFES_OneToOne 0.00 65535.00 /end CHARACTERISTIC
/begin CHARACTERISTIC DFES_DTCO.DFC_FlSysTnkLo_C "DFES/OBD spezifischer Fehlercode für Prüfung DFC_FlSysTnkLo" VALUE 0x8002985C Val_Wu16 65535.00 DFES_OneToOne 0.00 65535.00 /end CHARACTERISTIC
/begin CHARACTERISTIC DFES_DTCO.DFC_GbxNPosPlaus_C "DFES/OBD spezifischer Fehlercode für Prüfung DFC_GbxNPosPlaus" VALUE 0x8002985E Val_Wu16 65535.00 DFES_OneToOne 0.00 65535.00 /end CHARACTERISTIC
/begin CHARACTERISTIC DFES_DTCO.DFC_I14229_ROETst_Appl_C "DFES/" VALUE 0x80029860 Val_Wu16 65535.00 DFES_OneToOne 0.00 65535.00 /end CHARACTERISTIC
/begin CHARACTERISTIC DFES_DTCO.DFC_I14229_ROETst_Netw_C "DFES/" VALUE 0x80029862 Val_Wu16 65535.00 DFES_OneToOne 0.00 65535.00 /end CHARACTERISTIC
/begin CHARACTERISTIC DFES_DTCO.DFC_I14229_ROE_BufFull_C "DFES/" VALUE 0x80029864 Val_Wu16 65535.00 DFES_OneToOne 0.00 65535.00 /end CHARACTERISTIC
/begin CHARACTERISTIC DFES_DTCO.DFC_IVAdjDiaIVAdj_C "DFES/OBD spezifischer Fehlercode für Prüfung DFC_IVAdjDiaIVAdj" VALUE 0x80029866 Val_Wu16 65535.00 DFES_OneToOne 0.00 65535.00 /end CHARACTERISTIC
/begin CHARACTERISTIC DFES_DTCO.DFC_IVAdjIVA_0_C "DFES/OBD spezifischer Fehlercode für Prüfung DFC_IVAdjIVA_0" VALUE 0x80029868 Val_Wu16 65535.00 DFES_OneToOne 0.00 65535.00 /end CHARACTERISTIC
/begin CHARACTERISTIC DFES_DTCO.DFC_IVAdjIVA_1_C "DFES/OBD spezifischer Fehlercode für Prüfung DFC_IVAdjIVA_1" VALUE 0x8002986A Val_Wu16 65535.00 DFES_OneToOne 0.00 65535.00 /end CHARACTERISTIC
/begin CHARACTERISTIC DFES_DTCO.DFC_IVAdjIVA_2_C "DFES/OBD spezifischer Fehlercode für Prüfung DFC_IVAdjIVA_2" VALUE 0x8002986C Val_Wu16 65535.00 DFES_OneToOne 0.00 65535.00 /end CHARACTERISTIC
/begin CHARACTERISTIC DFES_DTCO.DFC_IVAdjIVA_3_C "DFES/OBD spezifischer Fehlercode für Prüfung DFC_IVAdjIVA_3" VALUE 0x8002986E Val_Wu16 65535.00 DFES_OneToOne 0.00 65535.00 /end CHARACTERISTIC
/begin CHARACTERISTIC DFES_DTCO.DFC_IVAdjIVA_4_C "DFES/OBD spezifischer Fehlercode für Prüfung DFC_IVAdjIVA_4" VALUE 0x80029870 Val_Wu16 65535.00 DFES_OneToOne 0.00 65535.00 /end CHARACTERISTIC
/begin CHARACTERISTIC DFES_DTCO.DFC_IVAdjIVA_5_C "DFES/OBD spezifischer Fehlercode für Prüfung DFC_IVAdjIVA_5" VALUE 0x80029872 Val_Wu16 65535.00 DFES_OneToOne 0.00 65535.00 /end CHARACTERISTIC
/begin CHARACTERISTIC DFES_DTCO.DFC_IVPSplyDCDCOff_0_C "DFES/OBD spezifischer Fehlercode für Prüfung DFC_IVPSplyDCDCOff_0" VALUE 0x80029874 Val_Wu16 65535.00 DFES_OneToOne 0.00 65535.00 /end CHARACTERISTIC
/begin CHARACTERISTIC DFES_DTCO.DFC_IVPSplyDCDCOff_1_C "DFES/OBD spezifischer Fehlercode für Prüfung DFC_IVPSplyDCDCOff_1" VALUE 0x80029876 Val_Wu16 65535.00 DFES_OneToOne 0.00 65535.00 /end CHARACTERISTIC
/begin CHARACTERISTIC DFES_DTCO.DFC_IVPSplyDCDCOff_2_C "DFES/OBD spezifischer Fehlercode für Prüfung DFC_IVPSplyDCDCOff_2" VALUE 0x80029878 Val_Wu16 65535.00 DFES_OneToOne 0.00 65535.00 /end CHARACTERISTIC
/begin CHARACTERISTIC DFES_DTCO.DFC_IVPSplyDCDCOff_3_C "DFES/OBD spezifischer Fehlercode für Prüfung DFC_IVPSplyDCDCOff_3" VALUE 0x8002987A Val_Wu16 65535.00 DFES_OneToOne 0.00 65535.00 /end CHARACTERISTIC
/begin CHARACTERISTIC DFES_DTCO.DFC_InjCtlAdjQntEEPCS_C "DFES/OBD spezifischer Fehlercode für Prüfung DFC_InjCtlAdjQntEEPCS" VALUE 0x8002987C Val_Wu16 65535.00 DFES_OneToOne 0.00 65535.00 /end CHARACTERISTIC
/begin CHARACTERISTIC DFES_DTCO.DFC_LSUSPISig_C "DFES/OBD spezifischer Fehlercode für Prüfung DFC_LSUSPISig" VALUE 0x8002987E Val_Wu16 65535.00 DFES_OneToOne 0.00 65535.00 /end CHARACTERISTIC
/begin CHARACTERISTIC DFES_DTCO.DFC_Layer_Dummy_C "DFES/OBD spezifischer Fehlercode für Prüfung DFC_Layer_Dummy" VALUE 0x80029880 Val_Wu16 65535.00 DFES_OneToOne 0.00 65535.00 /end CHARACTERISTIC
/begin CHARACTERISTIC DFES_DTCO.DFC_NplEnvPSensPPFltDiff_C "DFES/OBD spezifischer Fehlercode für Prüfung DFC_NplEnvPSensPPFltDiff" VALUE 0x80029882 Val_Wu16 65535.00 DFES_OneToOne 0.00 65535.00 /end CHARACTERISTIC
/begin CHARACTERISTIC DFES_DTCO.DFC_NplPresSensPPFltDiff_C "DFES/OBD spezifischer Fehlercode für Prüfung DFC_NplPresSensPPFltDiff" VALUE 0x80029884 Val_Wu16 65535.00 DFES_OneToOne 0.00 65535.00 /end CHARACTERISTIC
/begin CHARACTERISTIC DFES_DTCO.DFC_OilLvlPlaus_C "DFES/OBD spezifischer Fehlercode für Prüfung DFC_OilLvlPlaus" VALUE 0x80029886 Val_Wu16 65535.00 DFES_OneToOne 0.00 65535.00 /end CHARACTERISTIC
/begin CHARACTERISTIC DFES_DTCO.DFC_OilTOutLvl_C "DFES/OBD spezifischer Fehlercode für Prüfung DFC_OilTOutLvl" VALUE 0x80029888 Val_Wu16 65535.00 DFES_OneToOne 0.00 65535.00 /end CHARACTERISTIC
/begin CHARACTERISTIC DFES_DTCO.DFC_PCVfacAdaptMax_C "DFES/OBD spezifischer Fehlercode für Prüfung DFC_PCVfacAdaptMax" VALUE 0x8002988A Val_Wu16 65535.00 DFES_OneToOne 0.00 65535.00 /end CHARACTERISTIC
/begin CHARACTERISTIC DFES_DTCO.DFC_PCVfacAdaptMin_C "DFES/OBD spezifischer Fehlercode für Prüfung DFC_PCVfacAdaptMin" VALUE 0x8002988C Val_Wu16 65535.00 DFES_OneToOne 0.00 65535.00 /end CHARACTERISTIC
/begin CHARACTERISTIC DFES_DTCO.DFC_SensFrzPPFltUs_C "DFES/OBD spezifischer Fehlercode für Prüfung DFC_SensFrzPPFltUs" VALUE 0x8002988E Val_Wu16 65535.00 DFES_OneToOne 0.00 65535.00 /end CHARACTERISTIC
/begin CHARACTERISTIC DFES_DTCO.DFC_SensMonUTnkLvl_C "DFES/OBD spezifischer Fehlercode für Prüfung DFC_SensMonUTnkLvl" VALUE 0x80029890 Val_Wu16 65535.00 DFES_OneToOne 0.00 65535.00 /end CHARACTERISTIC
/begin CHARACTERISTIC DFES_DTCO.DFC_T15Sig_C "DFES/OBD spezifischer Fehlercode für Prüfung DFC_T15Sig" VALUE 0x80029892 Val_Wu16 65535.00 DFES_OneToOne 0.00 65535.00 /end CHARACTERISTIC
/begin CHARACTERISTIC DFES_DTCO.DFC_AirCtlRmpTOut_C "DFES/OBD spezifischer Fehlercode für Prüfung DFC_AirCtlRmpTOut" VALUE 0x80029894 Val_Wu16 65535.00 DFES_OneToOne 0.00 65535.00 /end CHARACTERISTIC
/begin CHARACTERISTIC DFES_DTCO.DFC_BrkPPlaus_C "DFES/OBD spezifischer Fehlercode für Prüfung DFC_BrkPPlaus" VALUE 0x80029896 Val_Wu16 65535.00 DFES_OneToOne 0.00 65535.00 /end CHARACTERISTIC
/begin CHARACTERISTIC DFES_DTCO.DFC_CEngDsTDynTst_C "DFES/OBD spezifischer Fehlercode für Prüfung DFC_CEngDsTDynTst" VALUE 0x80029898 Val_Wu16 65535.00 DFES_OneToOne 0.00 65535.00 /end CHARACTERISTIC
/begin CHARACTERISTIC DFES_DTCO.DFC_EEPEraseErr_C "DFES/OBD spezifischer Fehlercode für Prüfung DFC_EEPEraseErr" VALUE 0x8002989A Val_Wu16 65535.00 DFES_OneToOne 0.00 65535.00 /end CHARACTERISTIC
/begin CHARACTERISTIC DFES_DTCO.DFC_EEPRdErr_C "DFES/OBD spezifischer Fehlercode für Prüfung DFC_EEPRdErr" VALUE 0x8002989C Val_Wu16 65535.00 DFES_OneToOne 0.00 65535.00 /end CHARACTERISTIC
/begin CHARACTERISTIC DFES_DTCO.DFC_EEPWrErr_C "DFES/OBD spezifischer Fehlercode für Prüfung DFC_EEPWrErr" VALUE 0x8002989E Val_Wu16 65535.00 DFES_OneToOne 0.00 65535.00 /end CHARACTERISTIC
/begin CHARACTERISTIC DFES_DTCO.DFC_EGRVlvJamVlvClsd_C "DFES/OBD spezifischer Fehlercode für Prüfung DFC_EGRVlvJamVlvClsd" VALUE 0x800298A0 Val_Wu16 65535.00 DFES_OneToOne 0.00 65535.00 /end CHARACTERISTIC
/begin CHARACTERISTIC DFES_DTCO.DFC_EGRVlvJamVlvOpn_C "DFES/OBD spezifischer Fehlercode für Prüfung DFC_EGRVlvJamVlvOpn" VALUE 0x800298A2 Val_Wu16 65535.00 DFES_OneToOne 0.00 65535.00 /end CHARACTERISTIC
/begin CHARACTERISTIC DFES_DTCO.DFC_EGRVlvLPJamVlvClsd_C "DFES/OBD spezifischer Fehlercode für Prüfung DFC_EGRVlvLPJamVlvClsd" VALUE 0x800298A4 Val_Wu16 65535.00 DFES_OneToOne 0.00 65535.00 /end CHARACTERISTIC
/begin CHARACTERISTIC DFES_DTCO.DFC_EGRVlvLPJamVlvOpn_C "DFES/OBD spezifischer Fehlercode für Prüfung DFC_EGRVlvLPJamVlvOpn" VALUE 0x800298A6 Val_Wu16 65535.00 DFES_OneToOne 0.00 65535.00 /end CHARACTERISTIC
/begin CHARACTERISTIC DFES_DTCO.DFC_EGRVlvLPLgTDrft_C "DFES/OBD spezifischer Fehlercode für Prüfung DFC_EGRVlvLPLgTDrft" VALUE 0x800298A8 Val_Wu16 65535.00 DFES_OneToOne 0.00 65535.00 /end CHARACTERISTIC
/begin CHARACTERISTIC DFES_DTCO.DFC_EGRVlvLPOfsLrnJamVlv_C "DFES/OBD spezifischer Fehlercode für Prüfung DFC_EGRVlvLPOfsLrnJamVlv" VALUE 0x800298AA Val_Wu16 65535.00 DFES_OneToOne 0.00 65535.00 /end CHARACTERISTIC
/begin CHARACTERISTIC DFES_DTCO.DFC_EGRVlvLPShTDrft_C "DFES/OBD spezifischer Fehlercode für Prüfung DFC_EGRVlvLPShTDrft" VALUE 0x800298AC Val_Wu16 65535.00 DFES_OneToOne 0.00 65535.00 /end CHARACTERISTIC
/begin CHARACTERISTIC DFES_DTCO.DFC_EGRVlvLgTDrft_C "DFES/OBD spezifischer Fehlercode für Prüfung DFC_EGRVlvLgTDrft" VALUE 0x800298AE Val_Wu16 65535.00 DFES_OneToOne 0.00 65535.00 /end CHARACTERISTIC
/begin CHARACTERISTIC DFES_DTCO.DFC_EGRVlvOfsLrnJamVlv_C "DFES/OBD spezifischer Fehlercode für Prüfung DFC_EGRVlvOfsLrnJamVlv" VALUE 0x800298B0 Val_Wu16 65535.00 DFES_OneToOne 0.00 65535.00 /end CHARACTERISTIC
/begin CHARACTERISTIC DFES_DTCO.DFC_EGRVlvShTDrft_C "DFES/OBD spezifischer Fehlercode für Prüfung DFC_EGRVlvShTDrft" VALUE 0x800298B2 Val_Wu16 65535.00 DFES_OneToOne 0.00 65535.00 /end CHARACTERISTIC
/begin CHARACTERISTIC DFES_DTCO.DFC_EngICO_C "DFES/OBD spezifischer Fehlercode für Prüfung DFC_EngICO" VALUE 0x800298B4 Val_Wu16 65535.00 DFES_OneToOne 0.00 65535.00 /end CHARACTERISTIC
/begin CHARACTERISTIC DFES_DTCO.DFC_EpmCaSI1ErrSig_C "DFES/OBD spezifischer Fehlercode für Prüfung DFC_EpmCaSI1ErrSig" VALUE 0x800298B6 Val_Wu16 65535.00 DFES_OneToOne 0.00 65535.00 /end CHARACTERISTIC
/begin CHARACTERISTIC DFES_DTCO.DFC_EpmCaSI1NoSig_C "DFES/OBD spezifischer Fehlercode für Prüfung DFC_EpmCaSI1NoSig" VALUE 0x800298B8 Val_Wu16 65535.00 DFES_OneToOne 0.00 65535.00 /end CHARACTERISTIC
/begin CHARACTERISTIC DFES_DTCO.DFC_EpmCaSI1OfsErr_C "DFES/OBD spezifischer Fehlercode für Prüfung DFC_EpmCaSI1OfsErr" VALUE 0x800298BA Val_Wu16 65535.00 DFES_OneToOne 0.00 65535.00 /end CHARACTERISTIC
/begin CHARACTERISTIC DFES_DTCO.DFC_EpmCrSErrSig_C "DFES/OBD spezifischer Fehlercode für Prüfung DFC_EpmCrSErrSig" VALUE 0x800298BC Val_Wu16 65535.00 DFES_OneToOne 0.00 65535.00 /end CHARACTERISTIC
/begin CHARACTERISTIC DFES_DTCO.DFC_EpmCrSNoSig_C "DFES/OBD spezifischer Fehlercode für Prüfung DFC_EpmCrSNoSig" VALUE 0x800298BE Val_Wu16 65535.00 DFES_OneToOne 0.00 65535.00 /end CHARACTERISTIC
/begin CHARACTERISTIC DFES_DTCO.DFC_IVPlausComprTst_C "DFES/OBD spezifischer Fehlercode für Prüfung DFC_IVPlausComprTst" VALUE 0x800298C0 Val_Wu16 65535.00 DFES_OneToOne 0.00 65535.00 /end CHARACTERISTIC
/begin CHARACTERISTIC DFES_DTCO.DFC_IVPlausRunUpTst_C "DFES/OBD spezifischer Fehlercode für Prüfung DFC_IVPlausRunUpTst" VALUE 0x800298C2 Val_Wu16 65535.00 DFES_OneToOne 0.00 65535.00 /end CHARACTERISTIC
/begin CHARACTERISTIC DFES_DTCO.DFC_InjCrvShOffTst_C "DFES/OBD spezifischer Fehlercode für Prüfung DFC_InjCrvShOffTst" VALUE 0x800298C4 Val_Wu16 65535.00 DFES_OneToOne 0.00 65535.00 /end CHARACTERISTIC
/begin CHARACTERISTIC DFES_DTCO.DFC_LayerEnSavModProd_C "DFES/OBD spezifischer Fehlercode für Prüfung DFC_LayerEnSavModProd" VALUE 0x800298C6 Val_Wu16 65535.00 DFES_OneToOne 0.00 65535.00 /end CHARACTERISTIC
/begin CHARACTERISTIC DFES_DTCO.DFC_LayerEnSavModRep_C "DFES/OBD spezifischer Fehlercode für Prüfung DFC_LayerEnSavModRep" VALUE 0x800298C8 Val_Wu16 65535.00 DFES_OneToOne 0.00 65535.00 /end CHARACTERISTIC
/begin CHARACTERISTIC DFES_DTCO.DFC_LayerEnSavModShip_C "DFES/OBD spezifischer Fehlercode für Prüfung DFC_LayerEnSavModShip" VALUE 0x800298CA Val_Wu16 65535.00 DFES_OneToOne 0.00 65535.00 /end CHARACTERISTIC
/begin CHARACTERISTIC DFES_DTCO.DFC_MRlyErlyOpng_C "DFES/OBD spezifischer Fehlercode für Prüfung DFC_MRlyErlyOpng" VALUE 0x800298CC Val_Wu16 65535.00 DFES_OneToOne 0.00 65535.00 /end CHARACTERISTIC
/begin CHARACTERISTIC DFES_DTCO.DFC_MRlyStk_C "DFES/OBD spezifischer Fehlercode für Prüfung DFC_MRlyStk" VALUE 0x800298CE Val_Wu16 65535.00 DFES_OneToOne 0.00 65535.00 /end CHARACTERISTIC
/begin CHARACTERISTIC DFES_DTCO.DFC_MeUnActrTst_C "DFES/OBD spezifischer Fehlercode für Prüfung DFC_MeUnActrTst" VALUE 0x800298D0 Val_Wu16 65535.00 DFES_OneToOne 0.00 65535.00 /end CHARACTERISTIC
/begin CHARACTERISTIC DFES_DTCO.DFC_MoCADCCmp_C "DFES/OBD spezifischer Fehlercode für Prüfung DFC_MoCADCCmp" VALUE 0x800298D2 Val_Wu16 65535.00 DFES_OneToOne 0.00 65535.00 /end CHARACTERISTIC
/begin CHARACTERISTIC DFES_DTCO.DFC_MoCADCTst_C "DFES/OBD spezifischer Fehlercode für Prüfung DFC_MoCADCTst" VALUE 0x800298D4 Val_Wu16 65535.00 DFES_OneToOne 0.00 65535.00 /end CHARACTERISTIC
/begin CHARACTERISTIC DFES_DTCO.DFC_MoCADCVltgRatio_C "DFES/OBD spezifischer Fehlercode für Prüfung DFC_MoCADCVltgRatio" VALUE 0x800298D6 Val_Wu16 65535.00 DFES_OneToOne 0.00 65535.00 /end CHARACTERISTIC
/begin CHARACTERISTIC DFES_DTCO.DFC_MoCComErrCnt_C "DFES/OBD spezifischer Fehlercode für Prüfung DFC_MoCComErrCnt" VALUE 0x800298D8 Val_Wu16 65535.00 DFES_OneToOne 0.00 65535.00 /end CHARACTERISTIC
/begin CHARACTERISTIC DFES_DTCO.DFC_MoCComSPI_C "DFES/OBD spezifischer Fehlercode für Prüfung DFC_MoCComSPI" VALUE 0x800298DA Val_Wu16 65535.00 DFES_OneToOne 0.00 65535.00 /end CHARACTERISTIC
/begin CHARACTERISTIC DFES_DTCO.DFC_MoCROMErrXPg_C "DFES/OBD spezifischer Fehlercode für Prüfung DFC_MoCROMErrXPg" VALUE 0x800298DC Val_Wu16 65535.00 DFES_OneToOne 0.00 65535.00 /end CHARACTERISTIC
/begin CHARACTERISTIC DFES_DTCO.DFC_MoCSOPHwNoRdy_C "DFES/OBD spezifischer Fehlercode für Prüfung DFC_MoCSOPHwNoRdy" VALUE 0x800298DE Val_Wu16 65535.00 DFES_OneToOne 0.00 65535.00 /end CHARACTERISTIC
/begin CHARACTERISTIC DFES_DTCO.DFC_MoCSOPLoLi_C "DFES/OBD spezifischer Fehlercode für Prüfung DFC_MoCSOPLoLi" VALUE 0x800298E0 Val_Wu16 65535.00 DFES_OneToOne 0.00 65535.00 /end CHARACTERISTIC
/begin CHARACTERISTIC DFES_DTCO.DFC_MoCSOPMM_C "DFES/OBD spezifischer Fehlercode für Prüfung DFC_MoCSOPMM" VALUE 0x800298E2 Val_Wu16 65535.00 DFES_OneToOne 0.00 65535.00 /end CHARACTERISTIC
/begin CHARACTERISTIC DFES_DTCO.DFC_MoCSOPTimeOut_C "DFES/OBD spezifischer Fehlercode für Prüfung DFC_MoCSOPTimeOut" VALUE 0x800298E4 Val_Wu16 65535.00 DFES_OneToOne 0.00 65535.00 /end CHARACTERISTIC
/begin CHARACTERISTIC DFES_DTCO.DFC_MoCSOPUpLi_C "DFES/OBD spezifischer Fehlercode für Prüfung DFC_MoCSOPUpLi" VALUE 0x800298E6 Val_Wu16 65535.00 DFES_OneToOne 0.00 65535.00 /end CHARACTERISTIC
/begin CHARACTERISTIC DFES_DTCO.DFC_MoFAPP_C "DFES/OBD spezifischer Fehlercode für Prüfung DFC_MoFAPP" VALUE 0x800298E8 Val_Wu16 65535.00 DFES_OneToOne 0.00 65535.00 /end CHARACTERISTIC
/begin CHARACTERISTIC DFES_DTCO.DFC_MoFESpd_C "DFES/OBD spezifischer Fehlercode für Prüfung DFC_MoFESpd" VALUE 0x800298EA Val_Wu16 65535.00 DFES_OneToOne 0.00 65535.00 /end CHARACTERISTIC
/begin CHARACTERISTIC DFES_DTCO.DFC_MoFInjDatPhi_C "DFES/OBD spezifischer Fehlercode für Prüfung DFC_MoFInjDatPhi" VALUE 0x800298EC Val_Wu16 65535.00 DFES_OneToOne 0.00 65535.00 /end CHARACTERISTIC
/begin CHARACTERISTIC DFES_DTCO.DFC_MoFInjDatQnt_C "DFES/OBD spezifischer Fehlercode für Prüfung DFC_MoFInjDatQnt" VALUE 0x800298EE Val_Wu16 65535.00 DFES_OneToOne 0.00 65535.00 /end CHARACTERISTIC
/begin CHARACTERISTIC DFES_DTCO.DFC_MoFInjQnt_C "DFES/OBD spezifischer Fehlercode für Prüfung DFC_MoFInjQnt" VALUE 0x800298F0 Val_Wu16 65535.00 DFES_OneToOne 0.00 65535.00 /end CHARACTERISTIC
/begin CHARACTERISTIC DFES_DTCO.DFC_MoFMode1PoI1_C "DFES/OBD spezifischer Fehlercode für Prüfung DFC_MoFMode1PoI1" VALUE 0x800298F2 Val_Wu16 65535.00 DFES_OneToOne 0.00 65535.00 /end CHARACTERISTIC
/begin CHARACTERISTIC DFES_DTCO.DFC_MoFMode1PoI2_C "DFES/OBD spezifischer Fehlercode für Prüfung DFC_MoFMode1PoI2" VALUE 0x800298F4 Val_Wu16 65535.00 DFES_OneToOne 0.00 65535.00 /end CHARACTERISTIC
/begin CHARACTERISTIC DFES_DTCO.DFC_MoFMode2PoI1_C "DFES/OBD spezifischer Fehlercode für Prüfung DFC_MoFMode2PoI1" VALUE 0x800298F6 Val_Wu16 65535.00 DFES_OneToOne 0.00 65535.00 /end CHARACTERISTIC
/begin CHARACTERISTIC DFES_DTCO.DFC_MoFMode2PoI2_C "DFES/OBD spezifischer Fehlercode für Prüfung DFC_MoFMode2PoI2" VALUE 0x800298F8 Val_Wu16 65535.00 DFES_OneToOne 0.00 65535.00 /end CHARACTERISTIC
/begin CHARACTERISTIC DFES_DTCO.DFC_MoFOvR_C "DFES/OBD spezifischer Fehlercode für Prüfung DFC_MoFOvR" VALUE 0x800298FA Val_Wu16 65535.00 DFES_OneToOne 0.00 65535.00 /end CHARACTERISTIC
/begin CHARACTERISTIC DFES_DTCO.DFC_MoFQntCor_C "DFES/OBD spezifischer Fehlercode für Prüfung DFC_MoFQntCor" VALUE 0x800298FC Val_Wu16 65535.00 DFES_OneToOne 0.00 65535.00 /end CHARACTERISTIC
/begin CHARACTERISTIC DFES_DTCO.DFC_MoFRailP_C "DFES/OBD spezifischer Fehlercode für Prüfung DFC_MoFRailP" VALUE 0x800298FE Val_Wu16 65535.00 DFES_OneToOne 0.00 65535.00 /end CHARACTERISTIC
/begin CHARACTERISTIC DFES_DTCO.DFC_MoFTrqCmp_C "DFES/OBD spezifischer Fehlercode für Prüfung DFC_MoFTrqCmp" VALUE 0x80029900 Val_Wu16 65535.00 DFES_OneToOne 0.00 65535.00 /end CHARACTERISTIC
/begin CHARACTERISTIC DFES_DTCO.DFC_NSCDsHtrSetP_C "DFES/OBD spezifischer Fehlercode für Prüfung DFC_NSCDsHtrSetP" VALUE 0x80029902 Val_Wu16 65535.00 DFES_OneToOne 0.00 65535.00 /end CHARACTERISTIC
/begin CHARACTERISTIC DFES_DTCO.DFC_NoCat2DsHtrSetP_C "DFES/OBD spezifischer Fehlercode für Prüfung DFC_NoCat2DsHtrSetP" VALUE 0x80029904 Val_Wu16 65535.00 DFES_OneToOne 0.00 65535.00 /end CHARACTERISTIC
/begin CHARACTERISTIC DFES_DTCO.DFC_PCVActrTst_C "DFES/OBD spezifischer Fehlercode für Prüfung DFC_PCVActrTst" VALUE 0x80029906 Val_Wu16 65535.00 DFES_OneToOne 0.00 65535.00 /end CHARACTERISTIC
/begin CHARACTERISTIC DFES_DTCO.DFC_PhyModNonMonMapNpl_C "DFES/OBD spezifischer Fehlercode für Prüfung DFC_PhyModNonMonMapNpl" VALUE 0x80029908 Val_Wu16 65535.00 DFES_OneToOne 0.00 65535.00 /end CHARACTERISTIC
/begin CHARACTERISTIC DFES_DTCO.DFC_RailHpTst_C "DFES/OBD spezifischer Fehlercode für Prüfung DFC_RailHpTst" VALUE 0x8002990A Val_Wu16 65535.00 DFES_OneToOne 0.00 65535.00 /end CHARACTERISTIC
/begin CHARACTERISTIC DFES_DTCO.DFC_RailPOfsTstMax_C "DFES/OBD spezifischer Fehlercode für Prüfung DFC_RailPOfsTstMax" VALUE 0x8002990C Val_Wu16 65535.00 DFES_OneToOne 0.00 65535.00 /end CHARACTERISTIC
/begin CHARACTERISTIC DFES_DTCO.DFC_RailPOfsTstMin_C "DFES/OBD spezifischer Fehlercode für Prüfung DFC_RailPOfsTstMin" VALUE 0x8002990E Val_Wu16 65535.00 DFES_OneToOne 0.00 65535.00 /end CHARACTERISTIC
/begin CHARACTERISTIC DFES_DTCO.DFC_SIA_E1max_C "DFES/OBD spezifischer Fehlercode für Prüfung DFC_SIA_E1max" VALUE 0x80029910 Val_Wu16 65535.00 DFES_OneToOne 0.00 65535.00 /end CHARACTERISTIC
/begin CHARACTERISTIC DFES_DTCO.DFC_SIA_E1min_C "DFES/OBD spezifischer Fehlercode für Prüfung DFC_SIA_E1min" VALUE 0x80029912 Val_Wu16 65535.00 DFES_OneToOne 0.00 65535.00 /end CHARACTERISTIC
/begin CHARACTERISTIC DFES_DTCO.DFC_SIA_E1npl_C "DFES/OBD spezifischer Fehlercode für Prüfung DFC_SIA_E1npl" VALUE 0x80029914 Val_Wu16 65535.00 DFES_OneToOne 0.00 65535.00 /end CHARACTERISTIC
/begin CHARACTERISTIC DFES_DTCO.DFC_SIA_E1sig_C "DFES/OBD spezifischer Fehlercode für Prüfung DFC_SIA_E1sig" VALUE 0x80029916 Val_Wu16 65535.00 DFES_OneToOne 0.00 65535.00 /end CHARACTERISTIC
/begin CHARACTERISTIC DFES_DTCO.DFC_SIA_E2max_C "DFES/OBD spezifischer Fehlercode für Prüfung DFC_SIA_E2max" VALUE 0x80029918 Val_Wu16 65535.00 DFES_OneToOne 0.00 65535.00 /end CHARACTERISTIC
/begin CHARACTERISTIC DFES_DTCO.DFC_SIA_E2min_C "DFES/OBD spezifischer Fehlercode für Prüfung DFC_SIA_E2min" VALUE 0x8002991A Val_Wu16 65535.00 DFES_OneToOne 0.00 65535.00 /end CHARACTERISTIC
/begin CHARACTERISTIC DFES_DTCO.DFC_SIA_E2npl_C "DFES/OBD spezifischer Fehlercode für Prüfung DFC_SIA_E2npl" VALUE 0x8002991C Val_Wu16 65535.00 DFES_OneToOne 0.00 65535.00 /end CHARACTERISTIC
/begin CHARACTERISTIC DFES_DTCO.DFC_SIA_E2sig_C "DFES/OBD spezifischer Fehlercode für Prüfung DFC_SIA_E2sig" VALUE 0x8002991E Val_Wu16 65535.00 DFES_OneToOne 0.00 65535.00 /end CHARACTERISTIC
/begin CHARACTERISTIC DFES_DTCO.DFC_SIA_E3max_C "DFES/OBD spezifischer Fehlercode für Prüfung DFC_SIA_E3max" VALUE 0x80029920 Val_Wu16 65535.00 DFES_OneToOne 0.00 65535.00 /end CHARACTERISTIC
/begin CHARACTERISTIC DFES_DTCO.DFC_SIA_E3min_C "DFES/OBD spezifischer Fehlercode für Prüfung DFC_SIA_E3min" VALUE 0x80029922 Val_Wu16 65535.00 DFES_OneToOne 0.00 65535.00 /end CHARACTERISTIC
/begin CHARACTERISTIC DFES_DTCO.DFC_SIA_E3npl_C "DFES/OBD spezifischer Fehlercode für Prüfung DFC_SIA_E3npl" VALUE 0x80029924 Val_Wu16 65535.00 DFES_OneToOne 0.00 65535.00 /end CHARACTERISTIC
/begin CHARACTERISTIC DFES_DTCO.DFC_SIA_E3sig_C "DFES/OBD spezifischer Fehlercode für Prüfung DFC_SIA_E3sig" VALUE 0x80029926 Val_Wu16 65535.00 DFES_OneToOne 0.00 65535.00 /end CHARACTERISTIC
/begin CHARACTERISTIC DFES_DTCO.DFC_SIA_E4max_C "DFES/OBD spezifischer Fehlercode für Prüfung DFC_SIA_E4max" VALUE 0x80029928 Val_Wu16 65535.00 DFES_OneToOne 0.00 65535.00 /end CHARACTERISTIC
/begin CHARACTERISTIC DFES_DTCO.DFC_SIA_E4min_C "DFES/OBD spezifischer Fehlercode für Prüfung DFC_SIA_E4min" VALUE 0x8002992A Val_Wu16 65535.00 DFES_OneToOne 0.00 65535.00 /end CHARACTERISTIC
/begin CHARACTERISTIC DFES_DTCO.DFC_SIA_E4npl_C "DFES/OBD spezifischer Fehlercode für Prüfung DFC_SIA_E4npl" VALUE 0x8002992C Val_Wu16 65535.00 DFES_OneToOne 0.00 65535.00 /end CHARACTERISTIC
/begin CHARACTERISTIC DFES_DTCO.DFC_SIA_E4sig_C "DFES/OBD spezifischer Fehlercode für Prüfung DFC_SIA_E4sig" VALUE 0x8002992E Val_Wu16 65535.00 DFES_OneToOne 0.00 65535.00 /end CHARACTERISTIC
/begin CHARACTERISTIC DFES_DTCO.DFC_SWReset_0_C "DFES/OBD spezifischer Fehlercode für Prüfung DFC_SWReset_0" VALUE 0x80029930 Val_Wu16 65535.00 DFES_OneToOne 0.00 65535.00 /end CHARACTERISTIC
/begin CHARACTERISTIC DFES_DTCO.DFC_SWReset_1_C "DFES/OBD spezifischer Fehlercode für Prüfung DFC_SWReset_1" VALUE 0x80029932 Val_Wu16 65535.00 DFES_OneToOne 0.00 65535.00 /end CHARACTERISTIC
/begin CHARACTERISTIC DFES_DTCO.DFC_SWReset_2_C "DFES/OBD spezifischer Fehlercode für Prüfung DFC_SWReset_2" VALUE 0x80029934 Val_Wu16 65535.00 DFES_OneToOne 0.00 65535.00 /end CHARACTERISTIC
/begin CHARACTERISTIC DFES_DTCO.DFC_ShtrAKKMax_C "DFES/OBD spezifischer Fehlercode für Prüfung DFC_ShtrAKKMax" VALUE 0x80029936 Val_Wu16 65535.00 DFES_OneToOne 0.00 65535.00 /end CHARACTERISTIC
/begin CHARACTERISTIC DFES_DTCO.DFC_ShtrAKKMin_C "DFES/OBD spezifischer Fehlercode für Prüfung DFC_ShtrAKKMin" VALUE 0x80029938 Val_Wu16 65535.00 DFES_OneToOne 0.00 65535.00 /end CHARACTERISTIC
/begin CHARACTERISTIC DFES_DTCO.DFC_ShtrAKKNpl_C "DFES/OBD spezifischer Fehlercode für Prüfung DFC_ShtrAKKNpl" VALUE 0x8002993A Val_Wu16 65535.00 DFES_OneToOne 0.00 65535.00 /end CHARACTERISTIC
/begin CHARACTERISTIC DFES_DTCO.DFC_ShtrPKKMax_C "DFES/OBD spezifischer Fehlercode für Prüfung DFC_ShtrPKKMax" VALUE 0x8002993C Val_Wu16 65535.00 DFES_OneToOne 0.00 65535.00 /end CHARACTERISTIC
/begin CHARACTERISTIC DFES_DTCO.DFC_StopCntTmr_C "DFES/OBD spezifischer Fehlercode für Prüfung DFC_StopCntTmr" VALUE 0x8002993E Val_Wu16 65535.00 DFES_OneToOne 0.00 65535.00 /end CHARACTERISTIC
/begin CHARACTERISTIC DFES_DTCO.DFC_ThrVlvMon_C "DFES/OBD spezifischer Fehlercode für Prüfung DFC_ThrVlvMon" VALUE 0x80029940 Val_Wu16 65535.00 DFES_OneToOne 0.00 65535.00 /end CHARACTERISTIC
/begin CHARACTERISTIC DFES_DTCO.DFC_VSwVlvJamVlv_C "DFES/OBD spezifischer Fehlercode für Prüfung DFC_VSwVlvJamVlv" VALUE 0x80029942 Val_Wu16 65535.00 DFES_OneToOne 0.00 65535.00 /end CHARACTERISTIC
/begin CHARACTERISTIC DFES_DTCO.DFC_VSwVlvLgTDrft_C "DFES/OBD spezifischer Fehlercode für Prüfung DFC_VSwVlvLgTDrft" VALUE 0x80029944 Val_Wu16 65535.00 DFES_OneToOne 0.00 65535.00 /end CHARACTERISTIC
/begin CHARACTERISTIC DFES_DTCO.DFC_VSwVlvOfsLrnJamVlv_C "DFES/OBD spezifischer Fehlercode für Prüfung DFC_VSwVlvOfsLrnJamVlv" VALUE 0x80029946 Val_Wu16 65535.00 DFES_OneToOne 0.00 65535.00 /end CHARACTERISTIC
/begin CHARACTERISTIC DFES_DTCO.DFC_VSwVlvOfsNeutr_C "DFES/OBD spezifischer Fehlercode für Prüfung DFC_VSwVlvOfsNeutr" VALUE 0x80029948 Val_Wu16 65535.00 DFES_OneToOne 0.00 65535.00 /end CHARACTERISTIC
/begin CHARACTERISTIC DFES_DTCO.DFC_VSwVlvShTDrft_C "DFES/OBD spezifischer Fehlercode für Prüfung DFC_VSwVlvShTDrft" VALUE 0x8002994A Val_Wu16 65535.00 DFES_OneToOne 0.00 65535.00 /end CHARACTERISTIC
/begin CHARACTERISTIC DFES_DTCO.DFC_VSwVlvSpgDef_C "DFES/OBD spezifischer Fehlercode für Prüfung DFC_VSwVlvSpgDef" VALUE 0x8002994C Val_Wu16 65535.00 DFES_OneToOne 0.00 65535.00 /end CHARACTERISTIC
/begin CHARACTERISTIC DFES_Env.xSet1_CA "DFES/Signalauswahl für Umweltdatensatz 1" VAL_BLK 0x8002A864 ValA_Wu16 702.000000000 Signals_IntSigNumVerb 0.00 702.000000000 FORMAT "%13.9" NUMBER 15 /end CHARACTERISTIC
/begin CHARACTERISTIC DFES_Env.xSet2_CA "DFES/Signalauswahl für Umweltdatensatz 2" VAL_BLK 0x8002A882 ValA_Wu16 702.000000000 Signals_IntSigNumVerb 0.00 702.000000000 FORMAT "%13.9" NUMBER 15 /end CHARACTERISTIC
/begin CHARACTERISTIC DFES_Env.xSet3_CA "DFES/Signalauswahl für Umweltdatensatz 3" VAL_BLK 0x8002A8A0 ValA_Wu16 702.000000000 Signals_IntSigNumVerb 0.00 702.000000000 FORMAT "%13.9" NUMBER 15 /end CHARACTERISTIC
/begin CHARACTERISTIC DFES_Env.xSet4_CA "DFES/Signalauswahl für Umweltdatensatz 4" VAL_BLK 0x8002A8BE ValA_Wu16 702.000000000 Signals_IntSigNumVerb 0.00 702.000000000 FORMAT "%13.9" NUMBER 15 /end CHARACTERISTIC
/begin CHARACTERISTIC DFES_Env.xSet5_CA "DFES/Signalauswahl für Umweltdatensatz 5" VAL_BLK 0x8002A8DC ValA_Wu16 702.000000000 Signals_IntSigNumVerb 0.00 702.000000000 FORMAT "%13.9" NUMBER 15 /end CHARACTERISTIC
/begin CHARACTERISTIC DFES_Env.xSet6_CA "DFES/Signalauswahl für Umweltdatensatz 6" VAL_BLK 0x8002A8FA ValA_Wu16 702.000000000 Signals_IntSigNumVerb 0.00 702.000000000 FORMAT "%13.9" NUMBER 15 /end CHARACTERISTIC
/begin CHARACTERISTIC DFES_Env.xSet7_CA "DFES/Signalauswahl für Umweltdatensatz 7" VAL_BLK 0x8002A918 ValA_Wu16 702.000000000 Signals_IntSigNumVerb 0.00 702.000000000 FORMAT "%13.9" NUMBER 15 /end CHARACTERISTIC
/begin CHARACTERISTIC DFES_Env.xSet8_CA "DFES/Signalauswahl für Umweltdatensatz 8" VAL_BLK 0x8002A936 ValA_Wu16 702.000000000 Signals_IntSigNumVerb 0.00 702.000000000 FORMAT "%13.9" NUMBER 15 /end CHARACTERISTIC
/begin CHARACTERISTIC DFES_Env.xSet9_CA "DFES/Signalauswahl für Umweltdatensatz 9" VAL_BLK 0x8002A954 ValA_Wu16 702.000000000 Signals_IntSigNumVerb 0.00 702.000000000 FORMAT "%13.9" NUMBER 15 /end CHARACTERISTIC
/begin CHARACTERISTIC DFES_Env.xSet10_CA "DFES/Signalauswahl für Umweltdatensatz 10" VAL_BLK 0x8002A972 ValA_Wu16 702.000000000 Signals_IntSigNumVerb 0.00 702.000000000 FORMAT "%13.9" NUMBER 15 /end CHARACTERISTIC
/begin CHARACTERISTIC DFES_Env.xSet11_CA "DFES/Signalauswahl für Umweltdatensatz 11" VAL_BLK 0x8002A990 ValA_Wu16 702.000000000 Signals_IntSigNumVerb 0.00 702.000000000 FORMAT "%13.9" NUMBER 15 /end CHARACTERISTIC
/begin CHARACTERISTIC DFES_Env.xSet12_CA "DFES/Signalauswahl für Umweltdatensatz 12" VAL_BLK 0x8002A9AE ValA_Wu16 702.000000000 Signals_IntSigNumVerb 0.00 702.000000000 FORMAT "%13.9" NUMBER 15 /end CHARACTERISTIC
/begin CHARACTERISTIC DFES_Env.xSet13_CA "DFES/Signalauswahl für Umweltdatensatz 13" VAL_BLK 0x8002A9CC ValA_Wu16 702.000000000 Signals_IntSigNumVerb 0.00 702.000000000 FORMAT "%13.9" NUMBER 15 /end CHARACTERISTIC
/begin CHARACTERISTIC DFES_Env.xSet14_CA "DFES/Signalauswahl für Umweltdatensatz 14" VAL_BLK 0x8002A9EA ValA_Wu16 702.000000000 Signals_IntSigNumVerb 0.00 702.000000000 FORMAT "%13.9" NUMBER 15 /end CHARACTERISTIC
/begin CHARACTERISTIC DFES_Env.xSet15_CA "DFES/Signalauswahl für Umweltdatensatz 15" VAL_BLK 0x8002AA08 ValA_Wu16 702.000000000 Signals_IntSigNumVerb 0.00 702.000000000 FORMAT "%13.9" NUMBER 15 /end CHARACTERISTIC
/begin CHARACTERISTIC DFES_Env.xSet16_CA "DFES/Signalauswahl für Umweltdatensatz 16" VAL_BLK 0x8002AA26 ValA_Wu16 702.000000000 Signals_IntSigNumVerb 0.00 702.000000000 FORMAT "%13.9" NUMBER 15 /end CHARACTERISTIC
/begin CHARACTERISTIC DFES_Env.xSet17_CA "DFES/Signalauswahl für Umweltdatensatz 17" VAL_BLK 0x8002AA44 ValA_Wu16 702.000000000 Signals_IntSigNumVerb 0.00 702.000000000 FORMAT "%13.9" NUMBER 15 /end CHARACTERISTIC
/begin CHARACTERISTIC DFES_Env.xSet18_CA "DFES/Signalauswahl für Umweltdatensatz 18" VAL_BLK 0x8002AA62 ValA_Wu16 702.000000000 Signals_IntSigNumVerb 0.00 702.000000000 FORMAT "%13.9" NUMBER 15 /end CHARACTERISTIC
/begin CHARACTERISTIC DFES_Env.xSet19_CA "DFES/Signalauswahl für Umweltdatensatz 19" VAL_BLK 0x8002AA80 ValA_Wu16 702.000000000 Signals_IntSigNumVerb 0.00 702.000000000 FORMAT "%13.9" NUMBER 15 /end CHARACTERISTIC
/begin CHARACTERISTIC DFES_Env.xSet20_CA "DFES/Signalauswahl für Umweltdatensatz 20" VAL_BLK 0x8002AA9E ValA_Wu16 702.000000000 Signals_IntSigNumVerb 0.00 702.000000000 FORMAT "%13.9" NUMBER 15 /end CHARACTERISTIC
/begin CHARACTERISTIC DFES_Env.xSet21_CA "DFES/Signalauswahl für Umweltdatensatz 21" VAL_BLK 0x8002AABC ValA_Wu16 702.000000000 Signals_IntSigNumVerb 0.00 702.000000000 FORMAT "%13.9" NUMBER 15 /end CHARACTERISTIC
/begin CHARACTERISTIC DFES_Env.xSet22_CA "DFES/Signalauswahl für Umweltdatensatz 22" VAL_BLK 0x8002AADA ValA_Wu16 702.000000000 Signals_IntSigNumVerb 0.00 702.000000000 FORMAT "%13.9" NUMBER 15 /end CHARACTERISTIC
/begin CHARACTERISTIC DFES_Env.xSet23_CA "DFES/Signalauswahl für Umweltdatensatz 23" VAL_BLK 0x8002AAF8 ValA_Wu16 702.000000000 Signals_IntSigNumVerb 0.00 702.000000000 FORMAT "%13.9" NUMBER 15 /end CHARACTERISTIC
/begin CHARACTERISTIC DFES_Env.xSet24_CA "DFES/Signalauswahl für Umweltdatensatz 24" VAL_BLK 0x8002AB16 ValA_Wu16 702.000000000 Signals_IntSigNumVerb 0.00 702.000000000 FORMAT "%13.9" NUMBER 15 /end CHARACTERISTIC
/begin CHARACTERISTIC DFES_Env.xSet25_CA "DFES/Signalauswahl für Umweltdatensatz 25" VAL_BLK 0x8002AB34 ValA_Wu16 702.000000000 Signals_IntSigNumVerb 0.00 702.000000000 FORMAT "%13.9" NUMBER 15 /end CHARACTERISTIC
/begin CHARACTERISTIC DFES_Env.xSet26_CA "DFES/Signalauswahl für Umweltdatensatz 26" VAL_BLK 0x8002AB52 ValA_Wu16 702.000000000 Signals_IntSigNumVerb 0.00 702.000000000 FORMAT "%13.9" NUMBER 15 /end CHARACTERISTIC
/begin CHARACTERISTIC DFES_Env.xSet27_CA "DFES/Signalauswahl für Umweltdatensatz 27" VAL_BLK 0x8002AB70 ValA_Wu16 702.000000000 Signals_IntSigNumVerb 0.00 702.000000000 FORMAT "%13.9" NUMBER 15 /end CHARACTERISTIC
/begin CHARACTERISTIC DFES_Env.xSet28_CA "DFES/Signalauswahl für Umweltdatensatz 28" VAL_BLK 0x8002AB8E ValA_Wu16 702.000000000 Signals_IntSigNumVerb 0.00 702.000000000 FORMAT "%13.9" NUMBER 15 /end CHARACTERISTIC
/begin CHARACTERISTIC DFES_Env.xSet29_CA "DFES/Signalauswahl für Umweltdatensatz 29" VAL_BLK 0x8002ABAC ValA_Wu16 702.000000000 Signals_IntSigNumVerb 0.00 702.000000000 FORMAT "%13.9" NUMBER 15 /end CHARACTERISTIC
/begin CHARACTERISTIC DFES_Env.xSet30_CA "DFES/Signalauswahl für Umweltdatensatz 30" VAL_BLK 0x8002ABCA ValA_Wu16 702.000000000 Signals_IntSigNumVerb 0.00 702.000000000 FORMAT "%13.9" NUMBER 15 /end CHARACTERISTIC
/begin CHARACTERISTIC DFES_Env.xSet31_CA "DFES/Signalauswahl für Umweltdatensatz 31" VAL_BLK 0x8002ABE8 ValA_Wu16 702.000000000 Signals_IntSigNumVerb 0.00 702.000000000 FORMAT "%13.9" NUMBER 15 /end CHARACTERISTIC
/begin CHARACTERISTIC DFES_Env.xSet32_CA "DFES/Signalauswahl für Umweltdatensatz 32" VAL_BLK 0x8002AC06 ValA_Wu16 702.000000000 Signals_IntSigNumVerb 0.00 702.000000000 FORMAT "%13.9" NUMBER 15 /end CHARACTERISTIC
/begin CHARACTERISTIC DFES_Env.xSet33_CA "DFES/Signalauswahl für Umweltdatensatz 33" VAL_BLK 0x8002AC24 ValA_Wu16 702.000000000 Signals_IntSigNumVerb 0.00 702.000000000 FORMAT "%13.9" NUMBER 15 /end CHARACTERISTIC
/begin CHARACTERISTIC DFES_Env.xSet34_CA "DFES/Signalauswahl für Umweltdatensatz 34" VAL_BLK 0x8002AC42 ValA_Wu16 702.000000000 Signals_IntSigNumVerb 0.00 702.000000000 FORMAT "%13.9" NUMBER 15 /end CHARACTERISTIC
/begin CHARACTERISTIC DFES_Env.xSet35_CA "DFES/Signalauswahl für Umweltdatensatz 35" VAL_BLK 0x8002AC60 ValA_Wu16 702.000000000 Signals_IntSigNumVerb 0.00 702.000000000 FORMAT "%13.9" NUMBER 15 /end CHARACTERISTIC
/begin CHARACTERISTIC DFES_Env.xSet36_CA "DFES/Signalauswahl für Umweltdatensatz 36" VAL_BLK 0x8002AC7E ValA_Wu16 702.000000000 Signals_IntSigNumVerb 0.00 702.000000000 FORMAT "%13.9" NUMBER 15 /end CHARACTERISTIC
/begin CHARACTERISTIC DFES_Env.xSet37_CA "DFES/Signalauswahl für Umweltdatensatz 37" VAL_BLK 0x8002AC9C ValA_Wu16 702.000000000 Signals_IntSigNumVerb 0.00 702.000000000 FORMAT "%13.9" NUMBER 15 /end CHARACTERISTIC
/begin CHARACTERISTIC DFES_Env.xSet38_CA "DFES/Signalauswahl für Umweltdatensatz 38" VAL_BLK 0x8002ACBA ValA_Wu16 702.000000000 Signals_IntSigNumVerb 0.00 702.000000000 FORMAT "%13.9" NUMBER 15 /end CHARACTERISTIC
/begin CHARACTERISTIC DFES_Env.xSet39_CA "DFES/Signalauswahl für Umweltdatensatz 39" VAL_BLK 0x8002ACD8 ValA_Wu16 702.000000000 Signals_IntSigNumVerb 0.00 702.000000000 FORMAT "%13.9" NUMBER 15 /end CHARACTERISTIC
/begin CHARACTERISTIC DFES_Env.xSet40_CA "DFES/Signalauswahl für Umweltdatensatz 40" VAL_BLK 0x8002ACF6 ValA_Wu16 702.000000000 Signals_IntSigNumVerb 0.00 702.000000000 FORMAT "%13.9" NUMBER 15 /end CHARACTERISTIC
/begin CHARACTERISTIC DFES_Env.xSet41_CA "DFES/Signalauswahl für Umweltdatensatz 41" VAL_BLK 0x8002AD14 ValA_Wu16 702.000000000 Signals_IntSigNumVerb 0.00 702.000000000 FORMAT "%13.9" NUMBER 15 /end CHARACTERISTIC
/begin CHARACTERISTIC DFES_Env.xSet42_CA "DFES/Signalauswahl für Umweltdatensatz 42" VAL_BLK 0x8002AD32 ValA_Wu16 702.000000000 Signals_IntSigNumVerb 0.00 702.000000000 FORMAT "%13.9" NUMBER 15 /end CHARACTERISTIC
/begin CHARACTERISTIC DFES_Env.xSet43_CA "DFES/Signalauswahl für Umweltdatensatz 43" VAL_BLK 0x8002AD50 ValA_Wu16 702.000000000 Signals_IntSigNumVerb 0.00 702.000000000 FORMAT "%13.9" NUMBER 15 /end CHARACTERISTIC
/begin CHARACTERISTIC DFES_Env.xSet44_CA "DFES/Signalauswahl für Umweltdatensatz 44" VAL_BLK 0x8002AD6E ValA_Wu16 702.000000000 Signals_IntSigNumVerb 0.00 702.000000000 FORMAT "%13.9" NUMBER 15 /end CHARACTERISTIC
/begin CHARACTERISTIC DFES_Env.xSet45_CA "DFES/Signalauswahl für Umweltdatensatz 45" VAL_BLK 0x8002AD8C ValA_Wu16 702.000000000 Signals_IntSigNumVerb 0.00 702.000000000 FORMAT "%13.9" NUMBER 15 /end CHARACTERISTIC
/begin CHARACTERISTIC DFES_Env.xSet46_CA "DFES/Signalauswahl für Umweltdatensatz 46" VAL_BLK 0x8002ADAA ValA_Wu16 702.000000000 Signals_IntSigNumVerb 0.00 702.000000000 FORMAT "%13.9" NUMBER 15 /end CHARACTERISTIC
/begin CHARACTERISTIC DFES_Env.xSet47_CA "DFES/Signalauswahl für Umweltdatensatz 47" VAL_BLK 0x8002ADC8 ValA_Wu16 702.000000000 Signals_IntSigNumVerb 0.00 702.000000000 FORMAT "%13.9" NUMBER 15 /end CHARACTERISTIC
/begin CHARACTERISTIC DFES_Env.xSet48_CA "DFES/Signalauswahl für Umweltdatensatz 48" VAL_BLK 0x8002ADE6 ValA_Wu16 702.000000000 Signals_IntSigNumVerb 0.00 702.000000000 FORMAT "%13.9" NUMBER 15 /end CHARACTERISTIC
/begin CHARACTERISTIC DFES_Env.xSet49_CA "DFES/Signalauswahl für Umweltdatensatz 49" VAL_BLK 0x8002AE04 ValA_Wu16 702.000000000 Signals_IntSigNumVerb 0.00 702.000000000 FORMAT "%13.9" NUMBER 15 /end CHARACTERISTIC
/begin CHARACTERISTIC DFES_Env.xSet50_CA "DFES/Signalauswahl für Umweltdatensatz 50" VAL_BLK 0x8002AE22 ValA_Wu16 702.000000000 Signals_IntSigNumVerb 0.00 702.000000000 FORMAT "%13.9" NUMBER 15 /end CHARACTERISTIC
/begin CHARACTERISTIC DFES_Env.xSet51_CA "DFES/Signalauswahl für Umweltdatensatz 51" VAL_BLK 0x8002AE40 ValA_Wu16 702.000000000 Signals_IntSigNumVerb 0.00 702.000000000 FORMAT "%13.9" NUMBER 15 /end CHARACTERISTIC
/begin CHARACTERISTIC DFES_Env.xSet52_CA "DFES/Signalauswahl für Umweltdatensatz 52" VAL_BLK 0x8002AE5E ValA_Wu16 702.000000000 Signals_IntSigNumVerb 0.00 702.000000000 FORMAT "%13.9" NUMBER 15 /end CHARACTERISTIC
/begin CHARACTERISTIC DFES_Env.xSet53_CA "DFES/Signalauswahl für Umweltdatensatz 53" VAL_BLK 0x8002AE7C ValA_Wu16 702.000000000 Signals_IntSigNumVerb 0.00 702.000000000 FORMAT "%13.9" NUMBER 15 /end CHARACTERISTIC
/begin CHARACTERISTIC DFES_Env.xSet54_CA "DFES/Signalauswahl für Umweltdatensatz 54" VAL_BLK 0x8002AE9A ValA_Wu16 702.000000000 Signals_IntSigNumVerb 0.00 702.000000000 FORMAT "%13.9" NUMBER 15 /end CHARACTERISTIC
/begin CHARACTERISTIC DFES_Env.xSet55_CA "DFES/Signalauswahl für Umweltdatensatz 55" VAL_BLK 0x8002AEB8 ValA_Wu16 702.000000000 Signals_IntSigNumVerb 0.00 702.000000000 FORMAT "%13.9" NUMBER 15 /end CHARACTERISTIC
/begin CHARACTERISTIC DFES_Env.xSet56_CA "DFES/Signalauswahl für Umweltdatensatz 56" VAL_BLK 0x8002AED6 ValA_Wu16 702.000000000 Signals_IntSigNumVerb 0.00 702.000000000 FORMAT "%13.9" NUMBER 15 /end CHARACTERISTIC
/begin CHARACTERISTIC DFES_Env.xSet57_CA "DFES/Signalauswahl für Umweltdatensatz 57" VAL_BLK 0x8002AEF4 ValA_Wu16 702.000000000 Signals_IntSigNumVerb 0.00 702.000000000 FORMAT "%13.9" NUMBER 15 /end CHARACTERISTIC
/begin CHARACTERISTIC DFES_Env.xSet58_CA "DFES/Signalauswahl für Umweltdatensatz 58" VAL_BLK 0x8002AF12 ValA_Wu16 702.000000000 Signals_IntSigNumVerb 0.00 702.000000000 FORMAT "%13.9" NUMBER 15 /end CHARACTERISTIC
/begin CHARACTERISTIC DFES_Env.xSet59_CA "DFES/Signalauswahl für Umweltdatensatz 59" VAL_BLK 0x8002AF30 ValA_Wu16 702.000000000 Signals_IntSigNumVerb 0.00 702.000000000 FORMAT "%13.9" NUMBER 15 /end CHARACTERISTIC
/begin CHARACTERISTIC DFES_Env.xSet60_CA "DFES/Signalauswahl für Umweltdatensatz 60" VAL_BLK 0x8002AF4E ValA_Wu16 702.000000000 Signals_IntSigNumVerb 0.00 702.000000000 FORMAT "%13.9" NUMBER 15 /end CHARACTERISTIC
/begin CHARACTERISTIC DFES_Env.xSet61_CA "DFES/Signalauswahl für Umweltdatensatz 61" VAL_BLK 0x8002AF6C ValA_Wu16 702.000000000 Signals_IntSigNumVerb 0.00 702.000000000 FORMAT "%13.9" NUMBER 15 /end CHARACTERISTIC
/begin CHARACTERISTIC DFES_Env.xSet62_CA "DFES/Signalauswahl für Umweltdatensatz 62" VAL_BLK 0x8002AF8A ValA_Wu16 702.000000000 Signals_IntSigNumVerb 0.00 702.000000000 FORMAT "%13.9" NUMBER 15 /end CHARACTERISTIC
/begin CHARACTERISTIC DFES_Env.xSet63_CA "DFES/Signalauswahl für Umweltdatensatz 63" VAL_BLK 0x8002AFA8 ValA_Wu16 702.000000000 Signals_IntSigNumVerb 0.00 702.000000000 FORMAT "%13.9" NUMBER 15 /end CHARACTERISTIC
/begin CHARACTERISTIC DFES_Env.xSet64_CA "DFES/Signalauswahl für Umweltdatensatz 64" VAL_BLK 0x8002AFC6 ValA_Wu16 702.000000000 Signals_IntSigNumVerb 0.00 702.000000000 FORMAT "%13.9" NUMBER 15 /end CHARACTERISTIC
/begin CHARACTERISTIC DFES_Env.xSet65_CA "DFES/Signalauswahl für Umweltdatensatz 65" VAL_BLK 0x8002AFE4 ValA_Wu16 702.000000000 Signals_IntSigNumVerb 0.00 702.000000000 FORMAT "%13.9" NUMBER 15 /end CHARACTERISTIC
/begin CHARACTERISTIC DFES_Env.xSet66_CA "DFES/Signalauswahl für Umweltdatensatz 66" VAL_BLK 0x8002B002 ValA_Wu16 702.000000000 Signals_IntSigNumVerb 0.00 702.000000000 FORMAT "%13.9" NUMBER 15 /end CHARACTERISTIC
/begin CHARACTERISTIC DFES_Env.xSet67_CA "DFES/Signalauswahl für Umweltdatensatz 67" VAL_BLK 0x8002B020 ValA_Wu16 702.000000000 Signals_IntSigNumVerb 0.00 702.000000000 FORMAT "%13.9" NUMBER 15 /end CHARACTERISTIC
/begin CHARACTERISTIC DFES_Env.xSet68_CA "DFES/Signalauswahl für Umweltdatensatz 68" VAL_BLK 0x8002B03E ValA_Wu16 702.000000000 Signals_IntSigNumVerb 0.00 702.000000000 FORMAT "%13.9" NUMBER 15 /end CHARACTERISTIC
/begin CHARACTERISTIC DFES_Env.xSet69_CA "DFES/Signalauswahl für Umweltdatensatz 69" VAL_BLK 0x8002B05C ValA_Wu16 702.000000000 Signals_IntSigNumVerb 0.00 702.000000000 FORMAT "%13.9" NUMBER 15 /end CHARACTERISTIC
/begin CHARACTERISTIC DFES_Env.xSet70_CA "DFES/Signalauswahl für Umweltdatensatz 70" VAL_BLK 0x8002B07A ValA_Wu16 702.000000000 Signals_IntSigNumVerb 0.00 702.000000000 FORMAT "%13.9" NUMBER 15 /end CHARACTERISTIC
/begin CHARACTERISTIC DFES_Env.xSet71_CA "DFES/Signalauswahl für Umweltdatensatz 71" VAL_BLK 0x8002B098 ValA_Wu16 702.000000000 Signals_IntSigNumVerb 0.00 702.000000000 FORMAT "%13.9" NUMBER 15 /end CHARACTERISTIC
/begin CHARACTERISTIC DFES_Env.xSet72_CA "DFES/Signalauswahl für Umweltdatensatz 72" VAL_BLK 0x8002B0B6 ValA_Wu16 702.000000000 Signals_IntSigNumVerb 0.00 702.000000000 FORMAT "%13.9" NUMBER 15 /end CHARACTERISTIC
/begin CHARACTERISTIC DFES_Env.xSet73_CA "DFES/Signalauswahl für Umweltdatensatz 73" VAL_BLK 0x8002B0D4 ValA_Wu16 702.000000000 Signals_IntSigNumVerb 0.00 702.000000000 FORMAT "%13.9" NUMBER 15 /end CHARACTERISTIC
/begin CHARACTERISTIC DFES_Env.xSet74_CA "DFES/Signalauswahl für Umweltdatensatz 74" VAL_BLK 0x8002B0F2 ValA_Wu16 702.000000000 Signals_IntSigNumVerb 0.00 702.000000000 FORMAT "%13.9" NUMBER 15 /end CHARACTERISTIC
/begin CHARACTERISTIC DFES_Env.xSet75_CA "DFES/Signalauswahl für Umweltdatensatz 75" VAL_BLK 0x8002B110 ValA_Wu16 702.000000000 Signals_IntSigNumVerb 0.00 702.000000000 FORMAT "%13.9" NUMBER 15 /end CHARACTERISTIC
/begin CHARACTERISTIC DFES_Env.xSet76_CA "DFES/Signalauswahl für Umweltdatensatz 76" VAL_BLK 0x8002B12E ValA_Wu16 702.000000000 Signals_IntSigNumVerb 0.00 702.000000000 FORMAT "%13.9" NUMBER 15 /end CHARACTERISTIC
/begin CHARACTERISTIC DFES_Env.xSet77_CA "DFES/Signalauswahl für Umweltdatensatz 77" VAL_BLK 0x8002B14C ValA_Wu16 702.000000000 Signals_IntSigNumVerb 0.00 702.000000000 FORMAT "%13.9" NUMBER 15 /end CHARACTERISTIC
/begin CHARACTERISTIC DFES_Env.xSet78_CA "DFES/Signalauswahl für Umweltdatensatz 78" VAL_BLK 0x8002B16A ValA_Wu16 702.000000000 Signals_IntSigNumVerb 0.00 702.000000000 FORMAT "%13.9" NUMBER 15 /end CHARACTERISTIC
/begin CHARACTERISTIC DFES_Env.xSet79_CA "DFES/Signalauswahl für Umweltdatensatz 79" VAL_BLK 0x8002B188 ValA_Wu16 702.000000000 Signals_IntSigNumVerb 0.00 702.000000000 FORMAT "%13.9" NUMBER 15 /end CHARACTERISTIC
/begin CHARACTERISTIC DFES_Env.xSet80_CA "DFES/Signalauswahl für Umweltdatensatz 80" VAL_BLK 0x8002B1A6 ValA_Wu16 702.000000000 Signals_IntSigNumVerb 0.00 702.000000000 FORMAT "%13.9" NUMBER 15 /end CHARACTERISTIC
/begin CHARACTERISTIC DFES_EnvAllSets_CA "" VAL_BLK 0x800389C6 ValA_Wu16 702.000000000 Signals_IntSigNumVerb 0.00 702.000000000 FORMAT "%13.9" NUMBER 10 /end CHARACTERISTIC
/begin CHARACTERISTIC DFES_EnvRef.DFC_Unused_C "DFES/intern benötigter Parameter für nicht existierende Fehlerprüfung DFC_Unused" VALUE 0x80029D14 Val_Wu16 79. DFES_EnvTabVerb 0.00 79. FORMAT "%2.0" READ_ONLY /end CHARACTERISTIC
/begin CHARACTERISTIC DFES_EnvRef.DFC_ACCIPlausDrvAst_C "DFES/Zuordnung Umweltdatenset für Prüfung DFC_ACCIPlausDrvAst" VALUE 0x80029D16 Val_Wu16 79. DFES_EnvTabVerb 0.00 79. FORMAT "%2.0" /end CHARACTERISTIC
/begin CHARACTERISTIC DFES_EnvRef.DFC_ACCIPlausTrqDes_C "DFES/Zuordnung Umweltdatenset für Prüfung DFC_ACCIPlausTrqDes" VALUE 0x80029D18 Val_Wu16 79. DFES_EnvTabVerb 0.00 79. FORMAT "%2.0" /end CHARACTERISTIC
/begin CHARACTERISTIC DFES_EnvRef.DFC_AirCtlGovDvtEOMMax_C "DFES/Zuordnung Umweltdatenset für Prüfung DFC_AirCtlGovDvtEOMMax" VALUE 0x80029D1A Val_Wu16 79. DFES_EnvTabVerb 0.00 79. FORMAT "%2.0" /end CHARACTERISTIC
/begin CHARACTERISTIC DFES_EnvRef.DFC_AirCtlGovDvtEOMMin_C "DFES/Zuordnung Umweltdatenset für Prüfung DFC_AirCtlGovDvtEOMMin" VALUE 0x80029D1C Val_Wu16 79. DFES_EnvTabVerb 0.00 79. FORMAT "%2.0" /end CHARACTERISTIC
/begin CHARACTERISTIC DFES_EnvRef.DFC_AirCtlGovDvtMax_C "DFES/Zuordnung Umweltdatenset für Prüfung DFC_AirCtlGovDvtMax" VALUE 0x80029D1E Val_Wu16 79. DFES_EnvTabVerb 0.00 79. FORMAT "%2.0" /end CHARACTERISTIC
/begin CHARACTERISTIC DFES_EnvRef.DFC_AirCtlGovDvtMin_C "DFES/Zuordnung Umweltdatenset für Prüfung DFC_AirCtlGovDvtMin" VALUE 0x80029D20 Val_Wu16 79. DFES_EnvTabVerb 0.00 79. FORMAT "%2.0" /end CHARACTERISTIC
/begin CHARACTERISTIC DFES_EnvRef.DFC_AirCtlGovLPDvtMax_C "DFES/Zuordnung Umweltdatenset für Prüfung DFC_AirCtlGovLPDvtMax" VALUE 0x80029D22 Val_Wu16 79. DFES_EnvTabVerb 0.00 79. FORMAT "%2.0" /end CHARACTERISTIC
/begin CHARACTERISTIC DFES_EnvRef.DFC_AirCtlGovLPDvtMin_C "DFES/Zuordnung Umweltdatenset für Prüfung DFC_AirCtlGovLPDvtMin" VALUE 0x80029D24 Val_Wu16 79. DFES_EnvTabVerb 0.00 79. FORMAT "%2.0" /end CHARACTERISTIC
/begin CHARACTERISTIC DFES_EnvRef.DFC_AltIOComErr_C "DFES/Zuordnung Umweltdatenset für Prüfung DFC_AltIOComErr" VALUE 0x80029D26 Val_Wu16 79. DFES_EnvTabVerb 0.00 79. FORMAT "%2.0" /end CHARACTERISTIC
/begin CHARACTERISTIC DFES_EnvRef.DFC_AltIOComNpl_C "DFES/Zuordnung Umweltdatenset für Prüfung DFC_AltIOComNpl" VALUE 0x80029D28 Val_Wu16 79. DFES_EnvTabVerb 0.00 79. FORMAT "%2.0" /end CHARACTERISTIC
/begin CHARACTERISTIC DFES_EnvRef.DFC_BusDiagBusOffFlexRay_C "DFES/" VALUE 0x80029D2A Val_Wu16 79. DFES_EnvTabVerb 0.00 79. FORMAT "%2.0" /end CHARACTERISTIC
/begin CHARACTERISTIC DFES_EnvRef.DFC_BusDiagBusOffNodeA_C "DFES/Zuordnung Umweltdatenset für Prüfung DFC_BusDiagBusOffNodeA" VALUE 0x80029D2C Val_Wu16 79. DFES_EnvTabVerb 0.00 79. FORMAT "%2.0" /end CHARACTERISTIC
/begin CHARACTERISTIC DFES_EnvRef.DFC_BusDiagBusOffNodeB_C "DFES/Zuordnung Umweltdatenset für Prüfung DFC_BusDiagBusOffNodeB" VALUE 0x80029D2E Val_Wu16 79. DFES_EnvTabVerb 0.00 79. FORMAT "%2.0" /end CHARACTERISTIC
/begin CHARACTERISTIC DFES_EnvRef.DFC_BusDiagBusOffNodeC_C "DFES/Zuordnung Umweltdatenset für Prüfung DFC_BusDiagBusOffNodeC" VALUE 0x80029D30 Val_Wu16 79. DFES_EnvTabVerb 0.00 79. FORMAT "%2.0" /end CHARACTERISTIC
/begin CHARACTERISTIC DFES_EnvRef.DFC_BusDiagHwFlexRay_C "DFES/" VALUE 0x80029D32 Val_Wu16 79. DFES_EnvTabVerb 0.00 79. FORMAT "%2.0" /end CHARACTERISTIC
/begin CHARACTERISTIC DFES_EnvRef.DFC_Cj945SpiCom1_C "DFES/Zuordnung Umweltdatenset für Prüfung DFC_Cj945SpiCom1" VALUE 0x80029D34 Val_Wu16 79. DFES_EnvTabVerb 0.00 79. FORMAT "%2.0" /end CHARACTERISTIC
/begin CHARACTERISTIC DFES_EnvRef.DFC_ComACDemandSig_FA_C "DFES/Zuordnung Umweltdatenset für Prüfung DFC_ComACDemandSig_FA" VALUE 0x80029D36 Val_Wu16 79. DFES_EnvTabVerb 0.00 79. FORMAT "%2.0" /end CHARACTERISTIC
/begin CHARACTERISTIC DFES_EnvRef.DFC_ComACDemandTo_FA_C "DFES/Zuordnung Umweltdatenset für Prüfung DFC_ComACDemandTo_FA" VALUE 0x80029D38 Val_Wu16 79. DFES_EnvTabVerb 0.00 79. FORMAT "%2.0" /end CHARACTERISTIC
/begin CHARACTERISTIC DFES_EnvRef.DFC_ComATempSig_FA_C "DFES/Zuordnung Umweltdatenset für Prüfung DFC_ComATempSig_FA" VALUE 0x80029D3A Val_Wu16 79. DFES_EnvTabVerb 0.00 79. FORMAT "%2.0" /end CHARACTERISTIC
/begin CHARACTERISTIC DFES_EnvRef.DFC_ComATempTo_FA_C "DFES/Zuordnung Umweltdatenset für Prüfung DFC_ComATempTo_FA" VALUE 0x80029D3C Val_Wu16 79. DFES_EnvTabVerb 0.00 79. FORMAT "%2.0" /end CHARACTERISTIC
/begin CHARACTERISTIC DFES_EnvRef.DFC_ComATempTo_FX_C "DFES/Zuordnung Umweltdatenset für Prüfung DFC_ComATempTo_FX" VALUE 0x80029D3E Val_Wu16 79. DFES_EnvTabVerb 0.00 79. FORMAT "%2.0" /end CHARACTERISTIC
/begin CHARACTERISTIC DFES_EnvRef.DFC_ComBrkTrqSumChk_FX_C "DFES/Zuordnung Umweltdatenset für Prüfung DFC_ComBrkTrqSumChk_FX" VALUE 0x80029D40 Val_Wu16 79. DFES_EnvTabVerb 0.00 79. FORMAT "%2.0" /end CHARACTERISTIC
/begin CHARACTERISTIC DFES_EnvRef.DFC_ComBrkTrqSumCtr_FX_C "DFES/Zuordnung Umweltdatenset für Prüfung DFC_ComBrkTrqSumCtr_FX" VALUE 0x80029D42 Val_Wu16 79. DFES_EnvTabVerb 0.00 79. FORMAT "%2.0" /end CHARACTERISTIC
/begin CHARACTERISTIC DFES_EnvRef.DFC_ComBrkTrqSumTo_FX_C "DFES/Zuordnung Umweltdatenset für Prüfung DFC_ComBrkTrqSumTo_FX" VALUE 0x80029D44 Val_Wu16 79. DFES_EnvTabVerb 0.00 79. FORMAT "%2.0" /end CHARACTERISTIC
/begin CHARACTERISTIC DFES_EnvRef.DFC_ComBtnDrvDynChk_FX_C "DFES/Zuordnung Umweltdatenset für Prüfung DFC_ComBtnDrvDynChk_FX" VALUE 0x80029D46 Val_Wu16 79. DFES_EnvTabVerb 0.00 79. FORMAT "%2.0" /end CHARACTERISTIC
/begin CHARACTERISTIC DFES_EnvRef.DFC_ComBtnDrvDynCtr_FX_C "DFES/Zuordnung Umweltdatenset für Prüfung DFC_ComBtnDrvDynCtr_FX" VALUE 0x80029D48 Val_Wu16 79. DFES_EnvTabVerb 0.00 79. FORMAT "%2.0" /end CHARACTERISTIC
/begin CHARACTERISTIC DFES_EnvRef.DFC_ComBtnDrvDynTo_FX_C "DFES/Zuordnung Umweltdatenset für Prüfung DFC_ComBtnDrvDynTo_FX" VALUE 0x80029D4A Val_Wu16 79. DFES_EnvTabVerb 0.00 79. FORMAT "%2.0" /end CHARACTERISTIC
/begin CHARACTERISTIC DFES_EnvRef.DFC_ComButtonMSASig_C "DFES/Zuordnung Umweltdatenset für Prüfung DFC_ComButtonMSASig" VALUE 0x80029D4C Val_Wu16 79. DFES_EnvTabVerb 0.00 79. FORMAT "%2.0" /end CHARACTERISTIC
/begin CHARACTERISTIC DFES_EnvRef.DFC_ComButtonMSATo_C "DFES/Zuordnung Umweltdatenset für Prüfung DFC_ComButtonMSATo" VALUE 0x80029D4E Val_Wu16 79. DFES_EnvTabVerb 0.00 79. FORMAT "%2.0" /end CHARACTERISTIC
/begin CHARACTERISTIC DFES_EnvRef.DFC_ComCodierungPwrmngSig_C "DFES/Zuordnung Umweltdatenset für Prüfung DFC_ComCodierungPwrmngSig" VALUE 0x80029D50 Val_Wu16 79. DFES_EnvTabVerb 0.00 79. FORMAT "%2.0" /end CHARACTERISTIC
/begin CHARACTERISTIC DFES_EnvRef.DFC_ComCodierungPwrmngSig_FA_C "DFES/Zuordnung Umweltdatenset für Prüfung DFC_ComCodierungPwrmngSig_FA" VALUE 0x80029D52 Val_Wu16 79. DFES_EnvTabVerb 0.00 79. FORMAT "%2.0" /end CHARACTERISTIC
/begin CHARACTERISTIC DFES_EnvRef.DFC_ComCrCtlLvrChk_C "DFES/Zuordnung Umweltdatenset für Prüfung DFC_ComCrCtlLvrChk" VALUE 0x80029D54 Val_Wu16 79. DFES_EnvTabVerb 0.00 79. FORMAT "%2.0" /end CHARACTERISTIC
/begin CHARACTERISTIC DFES_EnvRef.DFC_ComCrCtlLvrCtr_C "DFES/Zuordnung Umweltdatenset für Prüfung DFC_ComCrCtlLvrCtr" VALUE 0x80029D56 Val_Wu16 79. DFES_EnvTabVerb 0.00 79. FORMAT "%2.0" /end CHARACTERISTIC
/begin CHARACTERISTIC DFES_EnvRef.DFC_ComCrCtlLvrSig_C "DFES/Zuordnung Umweltdatenset für Prüfung DFC_ComCrCtlLvrSig" VALUE 0x80029D58 Val_Wu16 79. DFES_EnvTabVerb 0.00 79. FORMAT "%2.0" /end CHARACTERISTIC
/begin CHARACTERISTIC DFES_EnvRef.DFC_ComCrCtlLvrTo_C "DFES/Zuordnung Umweltdatenset für Prüfung DFC_ComCrCtlLvrTo" VALUE 0x80029D5A Val_Wu16 79. DFES_EnvTabVerb 0.00 79. FORMAT "%2.0" /end CHARACTERISTIC
/begin CHARACTERISTIC DFES_EnvRef.DFC_ComCtrCrshSwoEkpSig_FA_C "DFES/Zuordnung Umweltdatenset für Prüfung DFC_ComCtrCrshSwoEkpSig_FA" VALUE 0x80029D5C Val_Wu16 79. DFES_EnvTabVerb 0.00 79. FORMAT "%2.0" /end CHARACTERISTIC
/begin CHARACTERISTIC DFES_EnvRef.DFC_ComCtrCrshSwoEkpTo_FA_C "DFES/Zuordnung Umweltdatenset für Prüfung DFC_ComCtrCrshSwoEkpTo_FA" VALUE 0x80029D5E Val_Wu16 79. DFES_EnvTabVerb 0.00 79. FORMAT "%2.0" /end CHARACTERISTIC
/begin CHARACTERISTIC DFES_EnvRef.DFC_ComCtrSecInt_C "DFES/Zuordnung Umweltdatenset für Prüfung DFC_ComCtrSecInt" VALUE 0x80029D60 Val_Wu16 79. DFES_EnvTabVerb 0.00 79. FORMAT "%2.0" /end CHARACTERISTIC
/begin CHARACTERISTIC DFES_EnvRef.DFC_ComDiaOBDGbxSig_A_C "DFES/Zuordnung Umweltdatenset für Prüfung DFC_ComDiaOBDGbxSig_A" VALUE 0x80029D62 Val_Wu16 79. DFES_EnvTabVerb 0.00 79. FORMAT "%2.0" /end CHARACTERISTIC
/begin CHARACTERISTIC DFES_EnvRef.DFC_ComDiaOBDGbxTo_A_C "DFES/Zuordnung Umweltdatenset für Prüfung DFC_ComDiaOBDGbxTo_A" VALUE 0x80029D64 Val_Wu16 79. DFES_EnvTabVerb 0.00 79. FORMAT "%2.0" /end CHARACTERISTIC
/begin CHARACTERISTIC DFES_EnvRef.DFC_ComFahrzeugtypSig_C "DFES/Zuordnung Umweltdatenset für Prüfung DFC_ComFahrzeugtypSig" VALUE 0x80029D66 Val_Wu16 79. DFES_EnvTabVerb 0.00 79. FORMAT "%2.0" /end CHARACTERISTIC
/begin CHARACTERISTIC DFES_EnvRef.DFC_ComFahrzeugtypSig_FA_C "DFES/Zuordnung Umweltdatenset für Prüfung DFC_ComFahrzeugtypSig_FA" VALUE 0x80029D68 Val_Wu16 79. DFES_EnvTabVerb 0.00 79. FORMAT "%2.0" /end CHARACTERISTIC
/begin CHARACTERISTIC DFES_EnvRef.DFC_ComFllupGpwsupSig_FA_C "DFES/Zuordnung Umweltdatenset für Prüfung DFC_ComFllupGpwsupSig_FA" VALUE 0x80029D6A Val_Wu16 79. DFES_EnvTabVerb 0.00 79. FORMAT "%2.0" /end CHARACTERISTIC
/begin CHARACTERISTIC DFES_EnvRef.DFC_ComFllupGpwsupTo_FA_C "DFES/Zuordnung Umweltdatenset für Prüfung DFC_ComFllupGpwsupTo_FA" VALUE 0x80029D6C Val_Wu16 79. DFES_EnvTabVerb 0.00 79. FORMAT "%2.0" /end CHARACTERISTIC
/begin CHARACTERISTIC DFES_EnvRef.DFC_ComGbxDataChk_A_C "DFES/Zuordnung Umweltdatenset für Prüfung DFC_ComGbxDataChk_A" VALUE 0x80029D6E Val_Wu16 79. DFES_EnvTabVerb 0.00 79. FORMAT "%2.0" /end CHARACTERISTIC
/begin CHARACTERISTIC DFES_EnvRef.DFC_ComGbxDataChk_FA_C "DFES/Zuordnung Umweltdatenset für Prüfung DFC_ComGbxDataChk_FA" VALUE 0x80029D70 Val_Wu16 79. DFES_EnvTabVerb 0.00 79. FORMAT "%2.0" /end CHARACTERISTIC
/begin CHARACTERISTIC DFES_EnvRef.DFC_ComGbxDataCtr_A_C "DFES/Zuordnung Umweltdatenset für Prüfung DFC_ComGbxDataCtr_A" VALUE 0x80029D72 Val_Wu16 79. DFES_EnvTabVerb 0.00 79. FORMAT "%2.0" /end CHARACTERISTIC
/begin CHARACTERISTIC DFES_EnvRef.DFC_ComGbxDataCtr_FA_C "DFES/Zuordnung Umweltdatenset für Prüfung DFC_ComGbxDataCtr_FA" VALUE 0x80029D74 Val_Wu16 79. DFES_EnvTabVerb 0.00 79. FORMAT "%2.0" /end CHARACTERISTIC
/begin CHARACTERISTIC DFES_EnvRef.DFC_ComGbxDataSig_A_C "DFES/Zuordnung Umweltdatenset für Prüfung DFC_ComGbxDataSig_A" VALUE 0x80029D76 Val_Wu16 79. DFES_EnvTabVerb 0.00 79. FORMAT "%2.0" /end CHARACTERISTIC
/begin CHARACTERISTIC DFES_EnvRef.DFC_ComGbxDataSig_FA_C "DFES/Zuordnung Umweltdatenset für Prüfung DFC_ComGbxDataSig_FA" VALUE 0x80029D78 Val_Wu16 79. DFES_EnvTabVerb 0.00 79. FORMAT "%2.0" /end CHARACTERISTIC
/begin CHARACTERISTIC DFES_EnvRef.DFC_ComGbxDataTo_A_C "DFES/Zuordnung Umweltdatenset für Prüfung DFC_ComGbxDataTo_A" VALUE 0x80029D7A Val_Wu16 79. DFES_EnvTabVerb 0.00 79. FORMAT "%2.0" /end CHARACTERISTIC
/begin CHARACTERISTIC DFES_EnvRef.DFC_ComGbxDataTo_FA_C "DFES/Zuordnung Umweltdatenset für Prüfung DFC_ComGbxDataTo_FA" VALUE 0x80029D7C Val_Wu16 79. DFES_EnvTabVerb 0.00 79. FORMAT "%2.0" /end CHARACTERISTIC
/begin CHARACTERISTIC DFES_EnvRef.DFC_ComKlemmenChk_FA_C "DFES/Zuordnung Umweltdatenset für Prüfung DFC_ComKlemmenChk_FA" VALUE 0x80029D7E Val_Wu16 79. DFES_EnvTabVerb 0.00 79. FORMAT "%2.0" /end CHARACTERISTIC
/begin CHARACTERISTIC DFES_EnvRef.DFC_ComKlemmenCtr_FA_C "DFES/Zuordnung Umweltdatenset für Prüfung DFC_ComKlemmenCtr_FA" VALUE 0x80029D80 Val_Wu16 79. DFES_EnvTabVerb 0.00 79. FORMAT "%2.0" /end CHARACTERISTIC
/begin CHARACTERISTIC DFES_EnvRef.DFC_ComKlemmenSig_FA_C "DFES/Zuordnung Umweltdatenset für Prüfung DFC_ComKlemmenSig_FA" VALUE 0x80029D82 Val_Wu16 79. DFES_EnvTabVerb 0.00 79. FORMAT "%2.0" /end CHARACTERISTIC
/begin CHARACTERISTIC DFES_EnvRef.DFC_ComKlemmenTo_FA_C "DFES/Zuordnung Umweltdatenset für Prüfung DFC_ComKlemmenTo_FA" VALUE 0x80029D84 Val_Wu16 79. DFES_EnvTabVerb 0.00 79. FORMAT "%2.0" /end CHARACTERISTIC
/begin CHARACTERISTIC DFES_EnvRef.DFC_ComLenkradwinkelSig_C "DFES/Zuordnung Umweltdatenset für Prüfung DFC_ComLenkradwinkelSig" VALUE 0x80029D86 Val_Wu16 79. DFES_EnvTabVerb 0.00 79. FORMAT "%2.0" /end CHARACTERISTIC
/begin CHARACTERISTIC DFES_EnvRef.DFC_ComLenkradwinkelTo_C "DFES/Zuordnung Umweltdatenset für Prüfung DFC_ComLenkradwinkelTo" VALUE 0x80029D88 Val_Wu16 79. DFES_EnvTabVerb 0.00 79. FORMAT "%2.0" /end CHARACTERISTIC
/begin CHARACTERISTIC DFES_EnvRef.DFC_ComMileageRangeSig_FA_C "DFES/Zuordnung Umweltdatenset für Prüfung DFC_ComMileageRangeSig_FA" VALUE 0x80029D8A Val_Wu16 79. DFES_EnvTabVerb 0.00 79. FORMAT "%2.0" /end CHARACTERISTIC
/begin CHARACTERISTIC DFES_EnvRef.DFC_ComMileageRangeTo_FA_C "DFES/Zuordnung Umweltdatenset für Prüfung DFC_ComMileageRangeTo_FA" VALUE 0x80029D8C Val_Wu16 79. DFES_EnvTabVerb 0.00 79. FORMAT "%2.0" /end CHARACTERISTIC
/begin CHARACTERISTIC DFES_EnvRef.DFC_ComPspSig_C "DFES/Zuordnung Umweltdatenset für Prüfung DFC_ComPspSig" VALUE 0x80029D8E Val_Wu16 79. DFES_EnvTabVerb 0.00 79. FORMAT "%2.0" /end CHARACTERISTIC
/begin CHARACTERISTIC DFES_EnvRef.DFC_ComPspTo_C "DFES/Zuordnung Umweltdatenset für Prüfung DFC_ComPspTo" VALUE 0x80029D90 Val_Wu16 79. DFES_EnvTabVerb 0.00 79. FORMAT "%2.0" /end CHARACTERISTIC
/begin CHARACTERISTIC DFES_EnvRef.DFC_ComRelTimeSig_FA_C "DFES/Zuordnung Umweltdatenset für Prüfung DFC_ComRelTimeSig_FA" VALUE 0x80029D92 Val_Wu16 79. DFES_EnvTabVerb 0.00 79. FORMAT "%2.0" /end CHARACTERISTIC
/begin CHARACTERISTIC DFES_EnvRef.DFC_ComRelTimeTo_FA_C "DFES/Zuordnung Umweltdatenset für Prüfung DFC_ComRelTimeTo_FA" VALUE 0x80029D94 Val_Wu16 79. DFES_EnvTabVerb 0.00 79. FORMAT "%2.0" /end CHARACTERISTIC
/begin CHARACTERISTIC DFES_EnvRef.DFC_ComRequestEMFChk_C "DFES/Zuordnung Umweltdatenset für Prüfung DFC_ComRequestEMFChk" VALUE 0x80029D96 Val_Wu16 79. DFES_EnvTabVerb 0.00 79. FORMAT "%2.0" /end CHARACTERISTIC
/begin CHARACTERISTIC DFES_EnvRef.DFC_ComRequestEMFCtr_C "DFES/Zuordnung Umweltdatenset für Prüfung DFC_ComRequestEMFCtr" VALUE 0x80029D98 Val_Wu16 79. DFES_EnvTabVerb 0.00 79. FORMAT "%2.0" /end CHARACTERISTIC
/begin CHARACTERISTIC DFES_EnvRef.DFC_ComRequestEMFSig_C "DFES/Zuordnung Umweltdatenset für Prüfung DFC_ComRequestEMFSig" VALUE 0x80029D9A Val_Wu16 79. DFES_EnvTabVerb 0.00 79. FORMAT "%2.0" /end CHARACTERISTIC
/begin CHARACTERISTIC DFES_EnvRef.DFC_ComRequestEMFTo_C "DFES/Zuordnung Umweltdatenset für Prüfung DFC_ComRequestEMFTo" VALUE 0x80029D9C Val_Wu16 79. DFES_EnvTabVerb 0.00 79. FORMAT "%2.0" /end CHARACTERISTIC
/begin CHARACTERISTIC DFES_EnvRef.DFC_ComRpmWhlChk_FX_C "DFES/Zuordnung Umweltdatenset für Prüfung DFC_ComRpmWhlChk_FX" VALUE 0x80029D9E Val_Wu16 79. DFES_EnvTabVerb 0.00 79. FORMAT "%2.0" /end CHARACTERISTIC
/begin CHARACTERISTIC DFES_EnvRef.DFC_ComRpmWhlCtr_FX_C "DFES/Zuordnung Umweltdatenset für Prüfung DFC_ComRpmWhlCtr_FX" VALUE 0x80029DA0 Val_Wu16 79. DFES_EnvTabVerb 0.00 79. FORMAT "%2.0" /end CHARACTERISTIC
/begin CHARACTERISTIC DFES_EnvRef.DFC_ComRpmWhlTo_FX_C "DFES/Zuordnung Umweltdatenset für Prüfung DFC_ComRpmWhlTo_FX" VALUE 0x80029DA2 Val_Wu16 79. DFES_EnvTabVerb 0.00 79. FORMAT "%2.0" /end CHARACTERISTIC
/begin CHARACTERISTIC DFES_EnvRef.DFC_ComSecCtrRelSig_FA_C "DFES/Zuordnung Umweltdatenset für Prüfung DFC_ComSecCtrRelSig_FA" VALUE 0x80029DA4 Val_Wu16 79. DFES_EnvTabVerb 0.00 79. FORMAT "%2.0" /end CHARACTERISTIC
/begin CHARACTERISTIC DFES_EnvRef.DFC_ComSecCtrRelTo_FA_C "DFES/Zuordnung Umweltdatenset für Prüfung DFC_ComSecCtrRelTo_FA" VALUE 0x80029DA6 Val_Wu16 79. DFES_EnvTabVerb 0.00 79. FORMAT "%2.0" /end CHARACTERISTIC
/begin CHARACTERISTIC DFES_EnvRef.DFC_ComSensNOxGndSig_C "DFES/Zuordnung Umweltdatenset für Prüfung DFC_ComSensNOxGndSig" VALUE 0x80029DA8 Val_Wu16 79. DFES_EnvTabVerb 0.00 79. FORMAT "%2.0" /end CHARACTERISTIC
/begin CHARACTERISTIC DFES_EnvRef.DFC_ComSensNOxGndTo_C "DFES/Zuordnung Umweltdatenset für Prüfung DFC_ComSensNOxGndTo" VALUE 0x80029DAA Val_Wu16 79. DFES_EnvTabVerb 0.00 79. FORMAT "%2.0" /end CHARACTERISTIC
/begin CHARACTERISTIC DFES_EnvRef.DFC_ComSensNOxMode_C "DFES/Zuordnung Umweltdatenset für Prüfung DFC_ComSensNOxMode" VALUE 0x80029DAC Val_Wu16 79. DFES_EnvTabVerb 0.00 79. FORMAT "%2.0" /end CHARACTERISTIC
/begin CHARACTERISTIC DFES_EnvRef.DFC_ComSensNOxUbattSig_C "DFES/Zuordnung Umweltdatenset für Prüfung DFC_ComSensNOxUbattSig" VALUE 0x80029DAE Val_Wu16 79. DFES_EnvTabVerb 0.00 79. FORMAT "%2.0" /end CHARACTERISTIC
/begin CHARACTERISTIC DFES_EnvRef.DFC_ComSensNOxUbattTo_C "DFES/Zuordnung Umweltdatenset für Prüfung DFC_ComSensNOxUbattTo" VALUE 0x80029DB0 Val_Wu16 79. DFES_EnvTabVerb 0.00 79. FORMAT "%2.0" /end CHARACTERISTIC
/begin CHARACTERISTIC DFES_EnvRef.DFC_ComShiftPaddleTo_FX_C "DFES/Zuordnung Umweltdatenset für Prüfung DFC_ComShiftPaddleTo_FX" VALUE 0x80029DB2 Val_Wu16 79. DFES_EnvTabVerb 0.00 79. FORMAT "%2.0" /end CHARACTERISTIC
/begin CHARACTERISTIC DFES_EnvRef.DFC_ComShutOffPSPSig_C "DFES/Zuordnung Umweltdatenset für Prüfung DFC_ComShutOffPSPSig" VALUE 0x80029DB4 Val_Wu16 79. DFES_EnvTabVerb 0.00 79. FORMAT "%2.0" /end CHARACTERISTIC
/begin CHARACTERISTIC DFES_EnvRef.DFC_ComShutOffPSPTo_C "DFES/Zuordnung Umweltdatenset für Prüfung DFC_ComShutOffPSPTo" VALUE 0x80029DB6 Val_Wu16 79. DFES_EnvTabVerb 0.00 79. FORMAT "%2.0" /end CHARACTERISTIC
/begin CHARACTERISTIC DFES_EnvRef.DFC_ComSlrdiGlbFZMTo_FA_C "DFES/Zuordnung Umweltdatenset für Prüfung DFC_ComSlrdiGlbFZMTo_FA" VALUE 0x80029DB8 Val_Wu16 79. DFES_EnvTabVerb 0.00 79. FORMAT "%2.0" /end CHARACTERISTIC
/begin CHARACTERISTIC DFES_EnvRef.DFC_ComSlrdiGlbFZMTo_FX_C "DFES/Zuordnung Umweltdatenset für Prüfung DFC_ComSlrdiGlbFZMTo_FX" VALUE 0x80029DBA Val_Wu16 79. DFES_EnvTabVerb 0.00 79. FORMAT "%2.0" /end CHARACTERISTIC
/begin CHARACTERISTIC DFES_EnvRef.DFC_ComSpeedVehicleChk_FX_C "DFES/Zuordnung Umweltdatenset für Prüfung DFC_ComSpeedVehicleChk_FX" VALUE 0x80029DBC Val_Wu16 79. DFES_EnvTabVerb 0.00 79. FORMAT "%2.0" /end CHARACTERISTIC
/begin CHARACTERISTIC DFES_EnvRef.DFC_ComSpeedVehicleCtr_FX_C "DFES/Zuordnung Umweltdatenset für Prüfung DFC_ComSpeedVehicleCtr_FX" VALUE 0x80029DBE Val_Wu16 79. DFES_EnvTabVerb 0.00 79. FORMAT "%2.0" /end CHARACTERISTIC
/begin CHARACTERISTIC DFES_EnvRef.DFC_ComSpeedVehicleTo_FX_C "DFES/Zuordnung Umweltdatenset für Prüfung DFC_ComSpeedVehicleTo_FX" VALUE 0x80029DC0 Val_Wu16 79. DFES_EnvTabVerb 0.00 79. FORMAT "%2.0" /end CHARACTERISTIC
/begin CHARACTERISTIC DFES_EnvRef.DFC_ComStConintDSCChk_FX_C "DFES/Zuordnung Umweltdatenset für Prüfung DFC_ComStConintDSCChk_FX" VALUE 0x80029DC2 Val_Wu16 79. DFES_EnvTabVerb 0.00 79. FORMAT "%2.0" /end CHARACTERISTIC
/begin CHARACTERISTIC DFES_EnvRef.DFC_ComStConintDSCCtr_FX_C "DFES/Zuordnung Umweltdatenset für Prüfung DFC_ComStConintDSCCtr_FX" VALUE 0x80029DC4 Val_Wu16 79. DFES_EnvTabVerb 0.00 79. FORMAT "%2.0" /end CHARACTERISTIC
/begin CHARACTERISTIC DFES_EnvRef.DFC_ComStConintDSCTo_FX_C "DFES/Zuordnung Umweltdatenset für Prüfung DFC_ComStConintDSCTo_FX" VALUE 0x80029DC6 Val_Wu16 79. DFES_EnvTabVerb 0.00 79. FORMAT "%2.0" /end CHARACTERISTIC
/begin CHARACTERISTIC DFES_EnvRef.DFC_ComStatACFrontSig_FA_C "DFES/Zuordnung Umweltdatenset für Prüfung DFC_ComStatACFrontSig_FA" VALUE 0x80029DC8 Val_Wu16 79. DFES_EnvTabVerb 0.00 79. FORMAT "%2.0" /end CHARACTERISTIC
/begin CHARACTERISTIC DFES_EnvRef.DFC_ComStatACFrontTo_FA_C "DFES/Zuordnung Umweltdatenset für Prüfung DFC_ComStatACFrontTo_FA" VALUE 0x80029DCA Val_Wu16 79. DFES_EnvTabVerb 0.00 79. FORMAT "%2.0" /end CHARACTERISTIC
/begin CHARACTERISTIC DFES_EnvRef.DFC_ComStatEkpSig_A_C "DFES/Zuordnung Umweltdatenset für Prüfung DFC_ComStatEkpSig_A" VALUE 0x80029DCC Val_Wu16 79. DFES_EnvTabVerb 0.00 79. FORMAT "%2.0" /end CHARACTERISTIC
/begin CHARACTERISTIC DFES_EnvRef.DFC_ComStatEkpTo_A_C "DFES/Zuordnung Umweltdatenset für Prüfung DFC_ComStatEkpTo_A" VALUE 0x80029DCE Val_Wu16 79. DFES_EnvTabVerb 0.00 79. FORMAT "%2.0" /end CHARACTERISTIC
/begin CHARACTERISTIC DFES_EnvRef.DFC_ComStatGearRevSig_FA_C "DFES/Zuordnung Umweltdatenset für Prüfung DFC_ComStatGearRevSig_FA" VALUE 0x80029DD0 Val_Wu16 79. DFES_EnvTabVerb 0.00 79. FORMAT "%2.0" /end CHARACTERISTIC
/begin CHARACTERISTIC DFES_EnvRef.DFC_ComStatGearRevTo_FA_C "DFES/Zuordnung Umweltdatenset für Prüfung DFC_ComStatGearRevTo_FA" VALUE 0x80029DD2 Val_Wu16 79. DFES_EnvTabVerb 0.00 79. FORMAT "%2.0" /end CHARACTERISTIC
/begin CHARACTERISTIC DFES_EnvRef.DFC_ComStatZVKlappenSig_FA_C "DFES/Zuordnung Umweltdatenset für Prüfung DFC_ComStatZVKlappenSig_FA" VALUE 0x80029DD4 Val_Wu16 79. DFES_EnvTabVerb 0.00 79. FORMAT "%2.0" /end CHARACTERISTIC
/begin CHARACTERISTIC DFES_EnvRef.DFC_ComStatZVKlappenTo_FA_C "DFES/Zuordnung Umweltdatenset für Prüfung DFC_ComStatZVKlappenTo_FA" VALUE 0x80029DD6 Val_Wu16 79. DFES_EnvTabVerb 0.00 79. FORMAT "%2.0" /end CHARACTERISTIC
/begin CHARACTERISTIC DFES_EnvRef.DFC_ComStateARSCtr_C "DFES/Zuordnung Umweltdatenset für Prüfung DFC_ComStateARSCtr" VALUE 0x80029DD8 Val_Wu16 79. DFES_EnvTabVerb 0.00 79. FORMAT "%2.0" /end CHARACTERISTIC
/begin CHARACTERISTIC DFES_EnvRef.DFC_ComStateARSSig_C "DFES/Zuordnung Umweltdatenset für Prüfung DFC_ComStateARSSig" VALUE 0x80029DDA Val_Wu16 79. DFES_EnvTabVerb 0.00 79. FORMAT "%2.0" /end CHARACTERISTIC
/begin CHARACTERISTIC DFES_EnvRef.DFC_ComStateARSTo_C "DFES/Zuordnung Umweltdatenset für Prüfung DFC_ComStateARSTo" VALUE 0x80029DDC Val_Wu16 79. DFES_EnvTabVerb 0.00 79. FORMAT "%2.0" /end CHARACTERISTIC
/begin CHARACTERISTIC DFES_EnvRef.DFC_ComStateDscSig_C "DFES/Zuordnung Umweltdatenset für Prüfung DFC_ComStateDscSig" VALUE 0x80029DDE Val_Wu16 79. DFES_EnvTabVerb 0.00 79. FORMAT "%2.0" /end CHARACTERISTIC
/begin CHARACTERISTIC DFES_EnvRef.DFC_ComStateDscTo_C "DFES/Zuordnung Umweltdatenset für Prüfung DFC_ComStateDscTo" VALUE 0x80029DE0 Val_Wu16 79. DFES_EnvTabVerb 0.00 79. FORMAT "%2.0" /end CHARACTERISTIC
/begin CHARACTERISTIC DFES_EnvRef.DFC_ComStateSeatSig_C "DFES/Zuordnung Umweltdatenset für Prüfung DFC_ComStateSeatSig" VALUE 0x80029DE2 Val_Wu16 79. DFES_EnvTabVerb 0.00 79. FORMAT "%2.0" /end CHARACTERISTIC
/begin CHARACTERISTIC DFES_EnvRef.DFC_ComStateSeatSig_FA_C "DFES/Zuordnung Umweltdatenset für Prüfung DFC_ComStateSeatSig_FA" VALUE 0x80029DE4 Val_Wu16 79. DFES_EnvTabVerb 0.00 79. FORMAT "%2.0" /end CHARACTERISTIC
/begin CHARACTERISTIC DFES_EnvRef.DFC_ComStateSeatTo_C "DFES/Zuordnung Umweltdatenset für Prüfung DFC_ComStateSeatTo" VALUE 0x80029DE6 Val_Wu16 79. DFES_EnvTabVerb 0.00 79. FORMAT "%2.0" /end CHARACTERISTIC
/begin CHARACTERISTIC DFES_EnvRef.DFC_ComStateSeatTo_FA_C "DFES/Zuordnung Umweltdatenset für Prüfung DFC_ComStateSeatTo_FA" VALUE 0x80029DE8 Val_Wu16 79. DFES_EnvTabVerb 0.00 79. FORMAT "%2.0" /end CHARACTERISTIC
/begin CHARACTERISTIC DFES_EnvRef.DFC_ComStatusEGSSig_A_C "DFES/Zuordnung Umweltdatenset für Prüfung DFC_ComStatusEGSSig_A" VALUE 0x80029DEA Val_Wu16 79. DFES_EnvTabVerb 0.00 79. FORMAT "%2.0" /end CHARACTERISTIC
/begin CHARACTERISTIC DFES_EnvRef.DFC_ComStatusEGSSig_FA_C "DFES/Zuordnung Umweltdatenset für Prüfung DFC_ComStatusEGSSig_FA" VALUE 0x80029DEC Val_Wu16 79. DFES_EnvTabVerb 0.00 79. FORMAT "%2.0" /end CHARACTERISTIC
/begin CHARACTERISTIC DFES_EnvRef.DFC_ComStatusEGSTo_A_C "DFES/Zuordnung Umweltdatenset für Prüfung DFC_ComStatusEGSTo_A" VALUE 0x80029DEE Val_Wu16 79. DFES_EnvTabVerb 0.00 79. FORMAT "%2.0" /end CHARACTERISTIC
/begin CHARACTERISTIC DFES_EnvRef.DFC_ComStatusEGSTo_FA_C "DFES/Zuordnung Umweltdatenset für Prüfung DFC_ComStatusEGSTo_FA" VALUE 0x80029DF0 Val_Wu16 79. DFES_EnvTabVerb 0.00 79. FORMAT "%2.0" /end CHARACTERISTIC
/begin CHARACTERISTIC DFES_EnvRef.DFC_ComStatusEMFChk_C "DFES/Zuordnung Umweltdatenset für Prüfung DFC_ComStatusEMFChk" VALUE 0x80029DF2 Val_Wu16 79. DFES_EnvTabVerb 0.00 79. FORMAT "%2.0" /end CHARACTERISTIC
/begin CHARACTERISTIC DFES_EnvRef.DFC_ComStatusEMFCtr_C "DFES/Zuordnung Umweltdatenset für Prüfung DFC_ComStatusEMFCtr" VALUE 0x80029DF4 Val_Wu16 79. DFES_EnvTabVerb 0.00 79. FORMAT "%2.0" /end CHARACTERISTIC
/begin CHARACTERISTIC DFES_EnvRef.DFC_ComStatusEMFSig_C "DFES/Zuordnung Umweltdatenset für Prüfung DFC_ComStatusEMFSig" VALUE 0x80029DF6 Val_Wu16 79. DFES_EnvTabVerb 0.00 79. FORMAT "%2.0" /end CHARACTERISTIC
/begin CHARACTERISTIC DFES_EnvRef.DFC_ComStatusEMFTo_C "DFES/Zuordnung Umweltdatenset für Prüfung DFC_ComStatusEMFTo" VALUE 0x80029DF8 Val_Wu16 79. DFES_EnvTabVerb 0.00 79. FORMAT "%2.0" /end CHARACTERISTIC
/begin CHARACTERISTIC DFES_EnvRef.DFC_ComStatusRGangSig_C "DFES/Zuordnung Umweltdatenset für Prüfung DFC_ComStatusRGangSig" VALUE 0x80029DFA Val_Wu16 79. DFES_EnvTabVerb 0.00 79. FORMAT "%2.0" /end CHARACTERISTIC
/begin CHARACTERISTIC DFES_EnvRef.DFC_ComStatusRGangTo_C "DFES/Zuordnung Umweltdatenset für Prüfung DFC_ComStatusRGangTo" VALUE 0x80029DFC Val_Wu16 79. DFES_EnvTabVerb 0.00 79. FORMAT "%2.0" /end CHARACTERISTIC
/begin CHARACTERISTIC DFES_EnvRef.DFC_ComSteeringAngleChk_FX_C "DFES/Zuordnung Umweltdatenset für Prüfung DFC_ComSteeringAngleChk_FX" VALUE 0x80029DFE Val_Wu16 79. DFES_EnvTabVerb 0.00 79. FORMAT "%2.0" /end CHARACTERISTIC
/begin CHARACTERISTIC DFES_EnvRef.DFC_ComSteeringAngleCtr_FX_C "DFES/Zuordnung Umweltdatenset für Prüfung DFC_ComSteeringAngleCtr_FX" VALUE 0x80029E00 Val_Wu16 79. DFES_EnvTabVerb 0.00 79. FORMAT "%2.0" /end CHARACTERISTIC
/begin CHARACTERISTIC DFES_EnvRef.DFC_ComSteeringAngleTo_FX_C "DFES/Zuordnung Umweltdatenset für Prüfung DFC_ComSteeringAngleTo_FX" VALUE 0x80029E02 Val_Wu16 79. DFES_EnvTabVerb 0.00 79. FORMAT "%2.0" /end CHARACTERISTIC
/begin CHARACTERISTIC DFES_EnvRef.DFC_ComTerminalChk_C "DFES/Zuordnung Umweltdatenset für Prüfung DFC_ComTerminalChk" VALUE 0x80029E04 Val_Wu16 79. DFES_EnvTabVerb 0.00 79. FORMAT "%2.0" /end CHARACTERISTIC
/begin CHARACTERISTIC DFES_EnvRef.DFC_ComTerminalCtr_C "DFES/Zuordnung Umweltdatenset für Prüfung DFC_ComTerminalCtr" VALUE 0x80029E06 Val_Wu16 79. DFES_EnvTabVerb 0.00 79. FORMAT "%2.0" /end CHARACTERISTIC
/begin CHARACTERISTIC DFES_EnvRef.DFC_ComTerminalSig_C "DFES/Zuordnung Umweltdatenset für Prüfung DFC_ComTerminalSig" VALUE 0x80029E08 Val_Wu16 79. DFES_EnvTabVerb 0.00 79. FORMAT "%2.0" /end CHARACTERISTIC
/begin CHARACTERISTIC DFES_EnvRef.DFC_ComTerminalTo_C "DFES/Zuordnung Umweltdatenset für Prüfung DFC_ComTerminalTo" VALUE 0x80029E0A Val_Wu16 79. DFES_EnvTabVerb 0.00 79. FORMAT "%2.0" /end CHARACTERISTIC
/begin CHARACTERISTIC DFES_EnvRef.DFC_ComTimeDateSig_FA_C "DFES/Zuordnung Umweltdatenset für Prüfung DFC_ComTimeDateSig_FA" VALUE 0x80029E0C Val_Wu16 79. DFES_EnvTabVerb 0.00 79. FORMAT "%2.0" /end CHARACTERISTIC
/begin CHARACTERISTIC DFES_EnvRef.DFC_ComTimeDateTo_FA_C "DFES/Zuordnung Umweltdatenset für Prüfung DFC_ComTimeDateTo_FA" VALUE 0x80029E0E Val_Wu16 79. DFES_EnvTabVerb 0.00 79. FORMAT "%2.0" /end CHARACTERISTIC
/begin CHARACTERISTIC DFES_EnvRef.DFC_ComTrailerSig_C "DFES/Zuordnung Umweltdatenset für Prüfung DFC_ComTrailerSig" VALUE 0x80029E10 Val_Wu16 79. DFES_EnvTabVerb 0.00 79. FORMAT "%2.0" /end CHARACTERISTIC
/begin CHARACTERISTIC DFES_EnvRef.DFC_ComTrailerSig_FA_C "DFES/Zuordnung Umweltdatenset für Prüfung DFC_ComTrailerSig_FA" VALUE 0x80029E12 Val_Wu16 79. DFES_EnvTabVerb 0.00 79. FORMAT "%2.0" /end CHARACTERISTIC
/begin CHARACTERISTIC DFES_EnvRef.DFC_ComTrailerTo_C "DFES/Zuordnung Umweltdatenset für Prüfung DFC_ComTrailerTo" VALUE 0x80029E14 Val_Wu16 79. DFES_EnvTabVerb 0.00 79. FORMAT "%2.0" /end CHARACTERISTIC
/begin CHARACTERISTIC DFES_EnvRef.DFC_ComTrailerTo_FA_C "DFES/Zuordnung Umweltdatenset für Prüfung DFC_ComTrailerTo_FA" VALUE 0x80029E16 Val_Wu16 79. DFES_EnvTabVerb 0.00 79. FORMAT "%2.0" /end CHARACTERISTIC
/begin CHARACTERISTIC DFES_EnvRef.DFC_ComTrqDemCrshDrDyChk_FX_C "DFES/Zuordnung Umweltdatenset für Prüfung DFC_ComTrqDemCrshDrDyChk_FX" VALUE 0x80029E18 Val_Wu16 79. DFES_EnvTabVerb 0.00 79. FORMAT "%2.0" /end CHARACTERISTIC
/begin CHARACTERISTIC DFES_EnvRef.DFC_ComTrqDemCrshDrDyCtr_FX_C "DFES/Zuordnung Umweltdatenset für Prüfung DFC_ComTrqDemCrshDrDyCtr_FX" VALUE 0x80029E1A Val_Wu16 79. DFES_EnvTabVerb 0.00 79. FORMAT "%2.0" /end CHARACTERISTIC
/begin CHARACTERISTIC DFES_EnvRef.DFC_ComTrqDemCrshDrDyTo_FX_C "DFES/Zuordnung Umweltdatenset für Prüfung DFC_ComTrqDemCrshDrDyTo_FX" VALUE 0x80029E1C Val_Wu16 79. DFES_EnvTabVerb 0.00 79. FORMAT "%2.0" /end CHARACTERISTIC
/begin CHARACTERISTIC DFES_EnvRef.DFC_ComTrqDemandDesSig_C "DFES/Zuordnung Umweltdatenset für Prüfung DFC_ComTrqDemandDesSig" VALUE 0x80029E1E Val_Wu16 79. DFES_EnvTabVerb 0.00 79. FORMAT "%2.0" /end CHARACTERISTIC
/begin CHARACTERISTIC DFES_EnvRef.DFC_ComTrqDemandDesTo_C "DFES/Zuordnung Umweltdatenset für Prüfung DFC_ComTrqDemandDesTo" VALUE 0x80029E20 Val_Wu16 79. DFES_EnvTabVerb 0.00 79. FORMAT "%2.0" /end CHARACTERISTIC
/begin CHARACTERISTIC DFES_EnvRef.DFC_ComTrqDemandDscChk_C "DFES/Zuordnung Umweltdatenset für Prüfung DFC_ComTrqDemandDscChk" VALUE 0x80029E22 Val_Wu16 79. DFES_EnvTabVerb 0.00 79. FORMAT "%2.0" /end CHARACTERISTIC
/begin CHARACTERISTIC DFES_EnvRef.DFC_ComTrqDemandDscCtr_C "DFES/Zuordnung Umweltdatenset für Prüfung DFC_ComTrqDemandDscCtr" VALUE 0x80029E24 Val_Wu16 79. DFES_EnvTabVerb 0.00 79. FORMAT "%2.0" /end CHARACTERISTIC
/begin CHARACTERISTIC DFES_EnvRef.DFC_ComTrqDemandDscSig_C "DFES/Zuordnung Umweltdatenset für Prüfung DFC_ComTrqDemandDscSig" VALUE 0x80029E26 Val_Wu16 79. DFES_EnvTabVerb 0.00 79. FORMAT "%2.0" /end CHARACTERISTIC
/begin CHARACTERISTIC DFES_EnvRef.DFC_ComTrqDemandDscTo_C "DFES/Zuordnung Umweltdatenset für Prüfung DFC_ComTrqDemandDscTo" VALUE 0x80029E28 Val_Wu16 79. DFES_EnvTabVerb 0.00 79. FORMAT "%2.0" /end CHARACTERISTIC
/begin CHARACTERISTIC DFES_EnvRef.DFC_ComTrqDemandGbxChk_A_C "DFES/Zuordnung Umweltdatenset für Prüfung DFC_ComTrqDemandGbxChk_A" VALUE 0x80029E2A Val_Wu16 79. DFES_EnvTabVerb 0.00 79. FORMAT "%2.0" /end CHARACTERISTIC
/begin CHARACTERISTIC DFES_EnvRef.DFC_ComTrqDemandGbxChk_FA_C "DFES/Zuordnung Umweltdatenset für Prüfung DFC_ComTrqDemandGbxChk_FA" VALUE 0x80029E2C Val_Wu16 79. DFES_EnvTabVerb 0.00 79. FORMAT "%2.0" /end CHARACTERISTIC
/begin CHARACTERISTIC DFES_EnvRef.DFC_ComTrqDemandGbxCtr_A_C "DFES/Zuordnung Umweltdatenset für Prüfung DFC_ComTrqDemandGbxCtr_A" VALUE 0x80029E2E Val_Wu16 79. DFES_EnvTabVerb 0.00 79. FORMAT "%2.0" /end CHARACTERISTIC
/begin CHARACTERISTIC DFES_EnvRef.DFC_ComTrqDemandGbxCtr_FA_C "DFES/Zuordnung Umweltdatenset für Prüfung DFC_ComTrqDemandGbxCtr_FA" VALUE 0x80029E30 Val_Wu16 79. DFES_EnvTabVerb 0.00 79. FORMAT "%2.0" /end CHARACTERISTIC
/begin CHARACTERISTIC DFES_EnvRef.DFC_ComTrqDemandGbxSig_A_C "DFES/Zuordnung Umweltdatenset für Prüfung DFC_ComTrqDemandGbxSig_A" VALUE 0x80029E32 Val_Wu16 79. DFES_EnvTabVerb 0.00 79. FORMAT "%2.0" /end CHARACTERISTIC
/begin CHARACTERISTIC DFES_EnvRef.DFC_ComTrqDemandGbxSig_FA_C "DFES/Zuordnung Umweltdatenset für Prüfung DFC_ComTrqDemandGbxSig_FA" VALUE 0x80029E34 Val_Wu16 79. DFES_EnvTabVerb 0.00 79. FORMAT "%2.0" /end CHARACTERISTIC
/begin CHARACTERISTIC DFES_EnvRef.DFC_ComTrqDemandGbxTo_A_C "DFES/Zuordnung Umweltdatenset für Prüfung DFC_ComTrqDemandGbxTo_A" VALUE 0x80029E36 Val_Wu16 79. DFES_EnvTabVerb 0.00 79. FORMAT "%2.0" /end CHARACTERISTIC
/begin CHARACTERISTIC DFES_EnvRef.DFC_ComTrqDemandGbxTo_FA_C "DFES/Zuordnung Umweltdatenset für Prüfung DFC_ComTrqDemandGbxTo_FA" VALUE 0x80029E38 Val_Wu16 79. DFES_EnvTabVerb 0.00 79. FORMAT "%2.0" /end CHARACTERISTIC
/begin CHARACTERISTIC DFES_EnvRef.DFC_ComTrqWhlDemChk_C "DFES/Zuordnung Umweltdatenset für Prüfung DFC_ComTrqWhlDemChk" VALUE 0x80029E3A Val_Wu16 79. DFES_EnvTabVerb 0.00 79. FORMAT "%2.0" /end CHARACTERISTIC
/begin CHARACTERISTIC DFES_EnvRef.DFC_ComTrqWhlDemCtr_C "DFES/Zuordnung Umweltdatenset für Prüfung DFC_ComTrqWhlDemCtr" VALUE 0x80029E3C Val_Wu16 79. DFES_EnvTabVerb 0.00 79. FORMAT "%2.0" /end CHARACTERISTIC
/begin CHARACTERISTIC DFES_EnvRef.DFC_ComTrqWhlDemFASChk_FX_C "DFES/Zuordnung Umweltdatenset für Prüfung DFC_ComTrqWhlDemFASChk_FX" VALUE 0x80029E3E Val_Wu16 79. DFES_EnvTabVerb 0.00 79. FORMAT "%2.0" /end CHARACTERISTIC
/begin CHARACTERISTIC DFES_EnvRef.DFC_ComTrqWhlDemFASCtr_FX_C "DFES/Zuordnung Umweltdatenset für Prüfung DFC_ComTrqWhlDemFASCtr_FX" VALUE 0x80029E40 Val_Wu16 79. DFES_EnvTabVerb 0.00 79. FORMAT "%2.0" /end CHARACTERISTIC
/begin CHARACTERISTIC DFES_EnvRef.DFC_ComTrqWhlDemFASTo_FX_C "DFES/Zuordnung Umweltdatenset für Prüfung DFC_ComTrqWhlDemFASTo_FX" VALUE 0x80029E42 Val_Wu16 79. DFES_EnvTabVerb 0.00 79. FORMAT "%2.0" /end CHARACTERISTIC
/begin CHARACTERISTIC DFES_EnvRef.DFC_ComTrqWhlDemSig_C "DFES/Zuordnung Umweltdatenset für Prüfung DFC_ComTrqWhlDemSig" VALUE 0x80029E44 Val_Wu16 79. DFES_EnvTabVerb 0.00 79. FORMAT "%2.0" /end CHARACTERISTIC
/begin CHARACTERISTIC DFES_EnvRef.DFC_ComTrqWhlDemTo_C "DFES/Zuordnung Umweltdatenset für Prüfung DFC_ComTrqWhlDemTo" VALUE 0x80029E46 Val_Wu16 79. DFES_EnvTabVerb 0.00 79. FORMAT "%2.0" /end CHARACTERISTIC
/begin CHARACTERISTIC DFES_EnvRef.DFC_ComVelocityChk_FA_C "DFES/Zuordnung Umweltdatenset für Prüfung DFC_ComVelocityChk_FA" VALUE 0x80029E48 Val_Wu16 79. DFES_EnvTabVerb 0.00 79. FORMAT "%2.0" /end CHARACTERISTIC
/begin CHARACTERISTIC DFES_EnvRef.DFC_ComVelocityCtr_FA_C "DFES/Zuordnung Umweltdatenset für Prüfung DFC_ComVelocityCtr_FA" VALUE 0x80029E4A Val_Wu16 79. DFES_EnvTabVerb 0.00 79. FORMAT "%2.0" /end CHARACTERISTIC
/begin CHARACTERISTIC DFES_EnvRef.DFC_ComVelocitySig_C "DFES/Zuordnung Umweltdatenset für Prüfung DFC_ComVelocitySig" VALUE 0x80029E4C Val_Wu16 79. DFES_EnvTabVerb 0.00 79. FORMAT "%2.0" /end CHARACTERISTIC
/begin CHARACTERISTIC DFES_EnvRef.DFC_ComVelocitySig_FA_C "DFES/Zuordnung Umweltdatenset für Prüfung DFC_ComVelocitySig_FA" VALUE 0x80029E4E Val_Wu16 79. DFES_EnvTabVerb 0.00 79. FORMAT "%2.0" /end CHARACTERISTIC
/begin CHARACTERISTIC DFES_EnvRef.DFC_ComVelocityTo_C "DFES/Zuordnung Umweltdatenset für Prüfung DFC_ComVelocityTo" VALUE 0x80029E50 Val_Wu16 79. DFES_EnvTabVerb 0.00 79. FORMAT "%2.0" /end CHARACTERISTIC
/begin CHARACTERISTIC DFES_EnvRef.DFC_ComVelocityTo_FA_C "DFES/Zuordnung Umweltdatenset für Prüfung DFC_ComVelocityTo_FA" VALUE 0x80029E52 Val_Wu16 79. DFES_EnvTabVerb 0.00 79. FORMAT "%2.0" /end CHARACTERISTIC
/begin CHARACTERISTIC DFES_EnvRef.DFC_ComVerbraucherTo_C "DFES/Zuordnung Umweltdatenset für Prüfung DFC_ComVerbraucherTo" VALUE 0x80029E54 Val_Wu16 79. DFES_EnvTabVerb 0.00 79. FORMAT "%2.0" /end CHARACTERISTIC
/begin CHARACTERISTIC DFES_EnvRef.DFC_ComWMomPTStabChk_FX_C "DFES/Zuordnung Umweltdatenset für Prüfung DFC_ComWMomPTStabChk_FX" VALUE 0x80029E56 Val_Wu16 79. DFES_EnvTabVerb 0.00 79. FORMAT "%2.0" /end CHARACTERISTIC
/begin CHARACTERISTIC DFES_EnvRef.DFC_ComWMomPTStabCtr_FX_C "DFES/Zuordnung Umweltdatenset für Prüfung DFC_ComWMomPTStabCtr_FX" VALUE 0x80029E58 Val_Wu16 79. DFES_EnvTabVerb 0.00 79. FORMAT "%2.0" /end CHARACTERISTIC
/begin CHARACTERISTIC DFES_EnvRef.DFC_ComWMomPTStabTo_FX_C "DFES/Zuordnung Umweltdatenset für Prüfung DFC_ComWMomPTStabTo_FX" VALUE 0x80029E5A Val_Wu16 79. DFES_EnvTabVerb 0.00 79. FORMAT "%2.0" /end CHARACTERISTIC
/begin CHARACTERISTIC DFES_EnvRef.DFC_ComWheelSpeedSig_C "DFES/Zuordnung Umweltdatenset für Prüfung DFC_ComWheelSpeedSig" VALUE 0x80029E5C Val_Wu16 79. DFES_EnvTabVerb 0.00 79. FORMAT "%2.0" /end CHARACTERISTIC
/begin CHARACTERISTIC DFES_EnvRef.DFC_ComWheelSpeedTo_C "DFES/Zuordnung Umweltdatenset für Prüfung DFC_ComWheelSpeedTo" VALUE 0x80029E5E Val_Wu16 79. DFES_EnvTabVerb 0.00 79. FORMAT "%2.0" /end CHARACTERISTIC
/begin CHARACTERISTIC DFES_EnvRef.DFC_ComZvKlappenSig_C "DFES/Zuordnung Umweltdatenset für Prüfung DFC_ComZvKlappenSig" VALUE 0x80029E60 Val_Wu16 79. DFES_EnvTabVerb 0.00 79. FORMAT "%2.0" /end CHARACTERISTIC
/begin CHARACTERISTIC DFES_EnvRef.DFC_ComZvKlappenTo_C "DFES/Zuordnung Umweltdatenset für Prüfung DFC_ComZvKlappenTo" VALUE 0x80029E62 Val_Wu16 79. DFES_EnvTabVerb 0.00 79. FORMAT "%2.0" /end CHARACTERISTIC
/begin CHARACTERISTIC DFES_EnvRef.DFC_ComaDirectChk_FX_C "DFES/Zuordnung Umweltdatenset für Prüfung DFC_ComaDirectChk_FX" VALUE 0x80029E64 Val_Wu16 79. DFES_EnvTabVerb 0.00 79. FORMAT "%2.0" /end CHARACTERISTIC
/begin CHARACTERISTIC DFES_EnvRef.DFC_ComaDirectCtr_FX_C "DFES/Zuordnung Umweltdatenset für Prüfung DFC_ComaDirectCtr_FX" VALUE 0x80029E66 Val_Wu16 79. DFES_EnvTabVerb 0.00 79. FORMAT "%2.0" /end CHARACTERISTIC
/begin CHARACTERISTIC DFES_EnvRef.DFC_ComaDirectTo_FX_C "DFES/Zuordnung Umweltdatenset für Prüfung DFC_ComaDirectTo_FX" VALUE 0x80029E68 Val_Wu16 79. DFES_EnvTabVerb 0.00 79. FORMAT "%2.0" /end CHARACTERISTIC
/begin CHARACTERISTIC DFES_EnvRef.DFC_ComaSideChk_FX_C "DFES/Zuordnung Umweltdatenset für Prüfung DFC_ComaSideChk_FX" VALUE 0x80029E6A Val_Wu16 79. DFES_EnvTabVerb 0.00 79. FORMAT "%2.0" /end CHARACTERISTIC
/begin CHARACTERISTIC DFES_EnvRef.DFC_ComaSideCtr_FX_C "DFES/Zuordnung Umweltdatenset für Prüfung DFC_ComaSideCtr_FX" VALUE 0x80029E6C Val_Wu16 79. DFES_EnvTabVerb 0.00 79. FORMAT "%2.0" /end CHARACTERISTIC
/begin CHARACTERISTIC DFES_EnvRef.DFC_ComaSideTo_FX_C "DFES/Zuordnung Umweltdatenset für Prüfung DFC_ComaSideTo_FX" VALUE 0x80029E6E Val_Wu16 79. DFES_EnvTabVerb 0.00 79. FORMAT "%2.0" /end CHARACTERISTIC
/begin CHARACTERISTIC DFES_EnvRef.DFC_Cy320SpiCom_C "DFES/Zuordnung Umweltdatenset für Prüfung DFC_Cy320SpiCom" VALUE 0x80029E70 Val_Wu16 79. DFES_EnvTabVerb 0.00 79. FORMAT "%2.0" /end CHARACTERISTIC
/begin CHARACTERISTIC DFES_EnvRef.DFC_ETCtlDvtInrMax_C "DFES/Zuordnung Umweltdatenset für Prüfung DFC_ETCtlDvtInrMax" VALUE 0x80029E72 Val_Wu16 79. DFES_EnvTabVerb 0.00 79. FORMAT "%2.0" /end CHARACTERISTIC
/begin CHARACTERISTIC DFES_EnvRef.DFC_ETCtlDvtInrMin_C "DFES/Zuordnung Umweltdatenset für Prüfung DFC_ETCtlDvtInrMin" VALUE 0x80029E74 Val_Wu16 79. DFES_EnvTabVerb 0.00 79. FORMAT "%2.0" /end CHARACTERISTIC
/begin CHARACTERISTIC DFES_EnvRef.DFC_ETCtlDvtOutrMax_C "DFES/Zuordnung Umweltdatenset für Prüfung DFC_ETCtlDvtOutrMax" VALUE 0x80029E76 Val_Wu16 79. DFES_EnvTabVerb 0.00 79. FORMAT "%2.0" /end CHARACTERISTIC
/begin CHARACTERISTIC DFES_EnvRef.DFC_ETCtlDvtOutrMin_C "DFES/Zuordnung Umweltdatenset für Prüfung DFC_ETCtlDvtOutrMin" VALUE 0x80029E78 Val_Wu16 79. DFES_EnvTabVerb 0.00 79. FORMAT "%2.0" /end CHARACTERISTIC
/begin CHARACTERISTIC DFES_EnvRef.DFC_FBCqDvtMax_C "DFES/Zuordnung Umweltdatenset für Prüfung DFC_FBCqDvtMax" VALUE 0x80029E7A Val_Wu16 79. DFES_EnvTabVerb 0.00 79. FORMAT "%2.0" /end CHARACTERISTIC
/begin CHARACTERISTIC DFES_EnvRef.DFC_FBCqDvtMin_C "DFES/Zuordnung Umweltdatenset für Prüfung DFC_FBCqDvtMin" VALUE 0x80029E7C Val_Wu16 79. DFES_EnvTabVerb 0.00 79. FORMAT "%2.0" /end CHARACTERISTIC
/begin CHARACTERISTIC DFES_EnvRef.DFC_Fan4WinErr1_C "DFES/Zuordnung Umweltdatenset für Prüfung DFC_Fan4WinErr1" VALUE 0x80029E7E Val_Wu16 79. DFES_EnvTabVerb 0.00 79. FORMAT "%2.0" /end CHARACTERISTIC
/begin CHARACTERISTIC DFES_EnvRef.DFC_Fan4WinErr2_C "DFES/Zuordnung Umweltdatenset für Prüfung DFC_Fan4WinErr2" VALUE 0x80029E80 Val_Wu16 79. DFES_EnvTabVerb 0.00 79. FORMAT "%2.0" /end CHARACTERISTIC
/begin CHARACTERISTIC DFES_EnvRef.DFC_Fan4WinErr3_C "DFES/Zuordnung Umweltdatenset für Prüfung DFC_Fan4WinErr3" VALUE 0x80029E82 Val_Wu16 79. DFES_EnvTabVerb 0.00 79. FORMAT "%2.0" /end CHARACTERISTIC
/begin CHARACTERISTIC DFES_EnvRef.DFC_Fan4WinErr4_C "DFES/Zuordnung Umweltdatenset für Prüfung DFC_Fan4WinErr4" VALUE 0x80029E84 Val_Wu16 79. DFES_EnvTabVerb 0.00 79. FORMAT "%2.0" /end CHARACTERISTIC
/begin CHARACTERISTIC DFES_EnvRef.DFC_FanSCG_C "DFES/Zuordnung Umweltdatenset für Prüfung DFC_FanSCG" VALUE 0x80029E86 Val_Wu16 79. DFES_EnvTabVerb 0.00 79. FORMAT "%2.0" /end CHARACTERISTIC
/begin CHARACTERISTIC DFES_EnvRef.DFC_FlFCBS_C "DFES/Zuordnung Umweltdatenset für Prüfung DFC_FlFCBS" VALUE 0x80029E88 Val_Wu16 79. DFES_EnvTabVerb 0.00 79. FORMAT "%2.0" /end CHARACTERISTIC
/begin CHARACTERISTIC DFES_EnvRef.DFC_GlwEcuConfigErr_C "DFES/Zuordnung Umweltdatenset für Prüfung DFC_GlwEcuConfigErr" VALUE 0x80029E8A Val_Wu16 79. DFES_EnvTabVerb 0.00 79. FORMAT "%2.0" /end CHARACTERISTIC
/begin CHARACTERISTIC DFES_EnvRef.DFC_GlwEcuEepErr_C "DFES/Zuordnung Umweltdatenset für Prüfung DFC_GlwEcuEepErr" VALUE 0x80029E8C Val_Wu16 79. DFES_EnvTabVerb 0.00 79. FORMAT "%2.0" /end CHARACTERISTIC
/begin CHARACTERISTIC DFES_EnvRef.DFC_GlwEcuFrmErr_C "DFES/Zuordnung Umweltdatenset für Prüfung DFC_GlwEcuFrmErr" VALUE 0x80029E8E Val_Wu16 79. DFES_EnvTabVerb 0.00 79. FORMAT "%2.0" /end CHARACTERISTIC
/begin CHARACTERISTIC DFES_EnvRef.DFC_GlwEcuGPCMFaultInfo_C "DFES/Zuordnung Umweltdatenset für Prüfung DFC_GlwEcuGPCMFaultInfo" VALUE 0x80029E90 Val_Wu16 79. DFES_EnvTabVerb 0.00 79. FORMAT "%2.0" /end CHARACTERISTIC
/begin CHARACTERISTIC DFES_EnvRef.DFC_GlwEcuGPCMInfo_C "DFES/Zuordnung Umweltdatenset für Prüfung DFC_GlwEcuGPCMInfo" VALUE 0x80029E92 Val_Wu16 79. DFES_EnvTabVerb 0.00 79. FORMAT "%2.0" /end CHARACTERISTIC
/begin CHARACTERISTIC DFES_EnvRef.DFC_GlwEcuGk1HSS_C "DFES/Zuordnung Umweltdatenset für Prüfung DFC_GlwEcuGk1HSS" VALUE 0x80029E94 Val_Wu16 79. DFES_EnvTabVerb 0.00 79. FORMAT "%2.0" /end CHARACTERISTIC
/begin CHARACTERISTIC DFES_EnvRef.DFC_GlwEcuGk1OL_C "DFES/Zuordnung Umweltdatenset für Prüfung DFC_GlwEcuGk1OL" VALUE 0x80029E96 Val_Wu16 79. DFES_EnvTabVerb 0.00 79. FORMAT "%2.0" /end CHARACTERISTIC
/begin CHARACTERISTIC DFES_EnvRef.DFC_GlwEcuGk1SC_C "DFES/Zuordnung Umweltdatenset für Prüfung DFC_GlwEcuGk1SC" VALUE 0x80029E98 Val_Wu16 79. DFES_EnvTabVerb 0.00 79. FORMAT "%2.0" /end CHARACTERISTIC
/begin CHARACTERISTIC DFES_EnvRef.DFC_GlwEcuGk1Wdst_C "DFES/Zuordnung Umweltdatenset für Prüfung DFC_GlwEcuGk1Wdst" VALUE 0x80029E9A Val_Wu16 79. DFES_EnvTabVerb 0.00 79. FORMAT "%2.0" /end CHARACTERISTIC
/begin CHARACTERISTIC DFES_EnvRef.DFC_GlwEcuGk2HSS_C "DFES/Zuordnung Umweltdatenset für Prüfung DFC_GlwEcuGk2HSS" VALUE 0x80029E9C Val_Wu16 79. DFES_EnvTabVerb 0.00 79. FORMAT "%2.0" /end CHARACTERISTIC
/begin CHARACTERISTIC DFES_EnvRef.DFC_GlwEcuGk2OL_C "DFES/Zuordnung Umweltdatenset für Prüfung DFC_GlwEcuGk2OL" VALUE 0x80029E9E Val_Wu16 79. DFES_EnvTabVerb 0.00 79. FORMAT "%2.0" /end CHARACTERISTIC
/begin CHARACTERISTIC DFES_EnvRef.DFC_GlwEcuGk2SC_C "DFES/Zuordnung Umweltdatenset für Prüfung DFC_GlwEcuGk2SC" VALUE 0x80029EA0 Val_Wu16 79. DFES_EnvTabVerb 0.00 79. FORMAT "%2.0" /end CHARACTERISTIC
/begin CHARACTERISTIC DFES_EnvRef.DFC_GlwEcuGk2Wdst_C "DFES/Zuordnung Umweltdatenset für Prüfung DFC_GlwEcuGk2Wdst" VALUE 0x80029EA2 Val_Wu16 79. DFES_EnvTabVerb 0.00 79. FORMAT "%2.0" /end CHARACTERISTIC
/begin CHARACTERISTIC DFES_EnvRef.DFC_GlwEcuGk3HSS_C "DFES/Zuordnung Umweltdatenset für Prüfung DFC_GlwEcuGk3HSS" VALUE 0x80029EA4 Val_Wu16 79. DFES_EnvTabVerb 0.00 79. FORMAT "%2.0" /end CHARACTERISTIC
/begin CHARACTERISTIC DFES_EnvRef.DFC_GlwEcuGk3OL_C "DFES/Zuordnung Umweltdatenset für Prüfung DFC_GlwEcuGk3OL" VALUE 0x80029EA6 Val_Wu16 79. DFES_EnvTabVerb 0.00 79. FORMAT "%2.0" /end CHARACTERISTIC
/begin CHARACTERISTIC DFES_EnvRef.DFC_GlwEcuGk3SC_C "DFES/Zuordnung Umweltdatenset für Prüfung DFC_GlwEcuGk3SC" VALUE 0x80029EA8 Val_Wu16 79. DFES_EnvTabVerb 0.00 79. FORMAT "%2.0" /end CHARACTERISTIC
/begin CHARACTERISTIC DFES_EnvRef.DFC_GlwEcuGk3Wdst_C "DFES/Zuordnung Umweltdatenset für Prüfung DFC_GlwEcuGk3Wdst" VALUE 0x80029EAA Val_Wu16 79. DFES_EnvTabVerb 0.00 79. FORMAT "%2.0" /end CHARACTERISTIC
/begin CHARACTERISTIC DFES_EnvRef.DFC_GlwEcuGk4HSS_C "DFES/Zuordnung Umweltdatenset für Prüfung DFC_GlwEcuGk4HSS" VALUE 0x80029EAC Val_Wu16 79. DFES_EnvTabVerb 0.00 79. FORMAT "%2.0" /end CHARACTERISTIC
/begin CHARACTERISTIC DFES_EnvRef.DFC_GlwEcuGk4OL_C "DFES/Zuordnung Umweltdatenset für Prüfung DFC_GlwEcuGk4OL" VALUE 0x80029EAE Val_Wu16 79. DFES_EnvTabVerb 0.00 79. FORMAT "%2.0" /end CHARACTERISTIC
/begin CHARACTERISTIC DFES_EnvRef.DFC_GlwEcuGk4SC_C "DFES/Zuordnung Umweltdatenset für Prüfung DFC_GlwEcuGk4SC" VALUE 0x80029EB0 Val_Wu16 79. DFES_EnvTabVerb 0.00 79. FORMAT "%2.0" /end CHARACTERISTIC
/begin CHARACTERISTIC DFES_EnvRef.DFC_GlwEcuGk4Wdst_C "DFES/Zuordnung Umweltdatenset für Prüfung DFC_GlwEcuGk4Wdst" VALUE 0x80029EB2 Val_Wu16 79. DFES_EnvTabVerb 0.00 79. FORMAT "%2.0" /end CHARACTERISTIC
/begin CHARACTERISTIC DFES_EnvRef.DFC_GlwEcuGk5HSS_C "DFES/Zuordnung Umweltdatenset für Prüfung DFC_GlwEcuGk5HSS" VALUE 0x80029EB4 Val_Wu16 79. DFES_EnvTabVerb 0.00 79. FORMAT "%2.0" /end CHARACTERISTIC
/begin CHARACTERISTIC DFES_EnvRef.DFC_GlwEcuGk5OL_C "DFES/Zuordnung Umweltdatenset für Prüfung DFC_GlwEcuGk5OL" VALUE 0x80029EB6 Val_Wu16 79. DFES_EnvTabVerb 0.00 79. FORMAT "%2.0" /end CHARACTERISTIC
/begin CHARACTERISTIC DFES_EnvRef.DFC_GlwEcuGk5SC_C "DFES/Zuordnung Umweltdatenset für Prüfung DFC_GlwEcuGk5SC" VALUE 0x80029EB8 Val_Wu16 79. DFES_EnvTabVerb 0.00 79. FORMAT "%2.0" /end CHARACTERISTIC
/begin CHARACTERISTIC DFES_EnvRef.DFC_GlwEcuGk5Wdst_C "DFES/Zuordnung Umweltdatenset für Prüfung DFC_GlwEcuGk5Wdst" VALUE 0x80029EBA Val_Wu16 79. DFES_EnvTabVerb 0.00 79. FORMAT "%2.0" /end CHARACTERISTIC
/begin CHARACTERISTIC DFES_EnvRef.DFC_GlwEcuGk6HSS_C "DFES/Zuordnung Umweltdatenset für Prüfung DFC_GlwEcuGk6HSS" VALUE 0x80029EBC Val_Wu16 79. DFES_EnvTabVerb 0.00 79. FORMAT "%2.0" /end CHARACTERISTIC
/begin CHARACTERISTIC DFES_EnvRef.DFC_GlwEcuGk6OL_C "DFES/Zuordnung Umweltdatenset für Prüfung DFC_GlwEcuGk6OL" VALUE 0x80029EBE Val_Wu16 79. DFES_EnvTabVerb 0.00 79. FORMAT "%2.0" /end CHARACTERISTIC
/begin CHARACTERISTIC DFES_EnvRef.DFC_GlwEcuGk6SC_C "DFES/Zuordnung Umweltdatenset für Prüfung DFC_GlwEcuGk6SC" VALUE 0x80029EC0 Val_Wu16 79. DFES_EnvTabVerb 0.00 79. FORMAT "%2.0" /end CHARACTERISTIC
/begin CHARACTERISTIC DFES_EnvRef.DFC_GlwEcuGk6Wdst_C "DFES/Zuordnung Umweltdatenset für Prüfung DFC_GlwEcuGk6Wdst" VALUE 0x80029EC2 Val_Wu16 79. DFES_EnvTabVerb 0.00 79. FORMAT "%2.0" /end CHARACTERISTIC
/begin FUNCTION DFES ""
 /begin DEF_CHARACTERISTIC DFES_DTCO.DFC_NSCDsShCir_C DFES_DTCO.DFC_NoCat2DsCmpChk_C DFES_DTCO.DFC_NoCat2DsLamBinSRCMax_C DFES_DTCO.DFC_NoCat2DsLamBinSRCMin_C DFES_DTCO.DFC_NoCat2DsLamLinSRCMax_C DFES_DTCO.DFC_NoCat2DsLamLinSRCMin_C DFES_DTCO.DFC_NoCat2DsLamPlausMax_C DFES_DTCO.DFC_NoCat2DsLamPlausMin_C DFES_DTCO.DFC_NoCat2DsNOxSRCMax_C DFES_DTCO.DFC_NoCat2DsNOxSRCMin_C DFES_DTCO.DFC_NoCat2DsOpCir_C DFES_DTCO.DFC_NoCat2DsShCir_C DFES_DTCO.DFC_NplDynPPFltDiff_C DFES_DTCO.DFC_NplHsChngPPFltDiff_C DFES_DTCO.DFC_NplHsLnPPFltDiff_C DFES_DTCO.DFC_NplTOxiCatUs_C DFES_DTCO.DFC_NplTPFltUs_C DFES_DTCO.DFC_NplTTrbnUs_C DFES_DTCO.DFC_OilPSwmpSRCMax_C DFES_DTCO.DFC_OilPSwmpSRCMin_C DFES_DTCO.DFC_PCVSCG_C DFES_DTCO.DFC_PFltCharPDiffMin_C DFES_DTCO.DFC_PFltDstrMin_C DFES_DTCO.DFC_PFltEngPrt_C DFES_DTCO.DFC_PFltRgnPerm_C DFES_DTCO.DFC_PFltSRCMaxFlwRstn_C DFES_DTCO.DFC_PFltSRCMinFlwRstn_C DFES_DTCO.DFC_PFltSotMsDvtMax_C DFES_DTCO.DFC_PFltSotMsDvtMin_C DFES_DTCO.DFC_PFltSotMsMax_C DFES_DTCO.DFC_PIntkVUsSRCMax_C DFES_DTCO.DFC_PIntkVUsSRCMin_C DFES_DTCO.DFC_SRCHighAPP1_C DFES_DTCO.DFC_SRCHighAPP2_C DFES_DTCO.DFC_SRCLowAPP1_C DFES_DTCO.DFC_SRCLowAPP2_C DFES_DTCO.DFC_SRCMaxPPFltDiff_C DFES_DTCO.DFC_SRCMaxPPFltUs_C DFES_DTCO.DFC_SRCMaxTECU_C DFES_DTCO.DFC_SRCMaxTOxiCatUs_C DFES_DTCO.DFC_SRCMaxTPFltUs_C DFES_DTCO.DFC_SRCMaxTTrbnUs_C DFES_DTCO.DFC_SRCMaxUCatUsT_C DFES_DTCO.DFC_SRCMaxUPmpP_C DFES_DTCO.DFC_SRCMinPPFltDiff_C DFES_DTCO.DFC_SRCMinPPFltUs_C DFES_DTCO.DFC_SRCMinTECU_C DFES_DTCO.DFC_SRCMinTOxiCatUs_C DFES_DTCO.DFC_SRCMinTPFltUs_C DFES_DTCO.DFC_SRCMinTTrbnUs_C DFES_DTCO.DFC_SRCMinUCatUsT_C DFES_DTCO.DFC_SRCMinUPmpP_C DFES_DTCO.DFC_SigUCatUsT_C DFES_DTCO.DFC_SigUPmpP_C DFES_DTCO.DFC_SyncAPP_C DFES_DTCO.DFC_T15Npl_C DFES_DTCO.DFC_TAFSDtyCycHi_C DFES_DTCO.DFC_TAFSDtyCycLo_C DFES_DTCO.DFC_TAFSPerHi_C DFES_DTCO.DFC_TAFSPerLo_C DFES_DTCO.DFC_TCACDsSRCMax_C DFES_DTCO.DFC_TCACDsSRCMin_C DFES_DTCO.DFC_ThrVlvSRCMax_C DFES_DTCO.DFC_ThrVlvSRCMin_C DFES_DTCO.DFC_TrbChLPOL_C DFES_DTCO.DFC_TrbChLPSCB_C DFES_DTCO.DFC_TrbChLPSCG_C DFES_DTCO.DFC_UHtrPLOL_C DFES_DTCO.DFC_UHtrPLSCB_C DFES_DTCO.DFC_UHtrPLSCG_C DFES_DTCO.DFC_UHtrPLSRCMaxDia_C DFES_DTCO.DFC_UHtrPLSRCMinDia_C DFES_DTCO.DFC_UHtrTnkOL_C DFES_DTCO.DFC_UHtrTnkSCB_C DFES_DTCO.DFC_UHtrTnkSCG_C DFES_DTCO.DFC_UHtrTnkSRCMaxDia_C DFES_DTCO.DFC_UHtrTnkSRCMinDia_C DFES_DTCO.DFC_URevVlvOL_C DFES_DTCO.DFC_URevVlvSCB_C DFES_DTCO.DFC_URevVlvSCG_C DFES_DTCO.DFC_UTnkTSRCMax_C DFES_DTCO.DFC_UTnkTSRCMin_C DFES_DTCO.DFC_UTnkTSig_C DFES_DTCO.DFC_VSwVlvGovDvtMax_C DFES_DTCO.DFC_VSwVlvGovDvtMin_C DFES_DTCO.DFC_VSwVlvHBrgOpnLd_C DFES_DTCO.DFC_VSwVlvHBrgOvrCurr_C DFES_DTCO.DFC_VSwVlvHBrgOvrTemp_C DFES_DTCO.DFC_VSwVlvHBrgShCirBatt1_C DFES_DTCO.DFC_VSwVlvHBrgShCirBatt2_C DFES_DTCO.DFC_VSwVlvHBrgShCirGnd1_C DFES_DTCO.DFC_VSwVlvHBrgShCirGnd2_C DFES_DTCO.DFC_VSwVlvHBrgShCirOvrLd_C DFES_DTCO.DFC_VSwVlvHBrgTempOvrCurr_C DFES_DTCO.DFC_VSwVlvHBrgUndrVltg_C DFES_DTCO.DFC_VSwVlvOL_C DFES_DTCO.DFC_VSwVlvSCB_C DFES_DTCO.DFC_VSwVlvSCG_C DFES_DTCO.DFC_VSwVlvSRCMax_C DFES_DTCO.DFC_VSwVlvSRCMin_C DFES_DTCO.DFC_ClthNpl_C DFES_DTCO.DFC_ETClbETMax_0_C DFES_DTCO.DFC_ETClbETMax_1_C DFES_DTCO.DFC_ETClbETMax_2_C DFES_DTCO.DFC_ETClbETMax_3_C DFES_DTCO.DFC_ETClbETMax_4_C DFES_DTCO.DFC_ETClbETMax_5_C DFES_DTCO.DFC_ETClbETMin_0_C DFES_DTCO.DFC_ETClbETMin_1_C DFES_DTCO.DFC_ETClbETMin_2_C DFES_DTCO.DFC_ETClbETMin_3_C DFES_DTCO.DFC_ETClbETMin_4_C DFES_DTCO.DFC_ETClbETMin_5_C DFES_DTCO.DFC_IVActrEnrgMax_0_C DFES_DTCO.DFC_IVActrEnrgMax_1_C DFES_DTCO.DFC_IVActrEnrgMax_2_C DFES_DTCO.DFC_IVActrEnrgMax_3_C DFES_DTCO.DFC_IVActrEnrgMax_4_C DFES_DTCO.DFC_IVActrEnrgMax_5_C DFES_DTCO.DFC_IVActrEnrgMax_6_C DFES_DTCO.DFC_IVActrEnrgMax_7_C DFES_DTCO.DFC_IVActrEnrgMin_0_C DFES_DTCO.DFC_IVActrEnrgMin_1_C DFES_DTCO.DFC_IVActrEnrgMin_2_C DFES_DTCO.DFC_IVActrEnrgMin_3_C DFES_DTCO.DFC_IVActrEnrgMin_4_C DFES_DTCO.DFC_IVActrEnrgMin_5_C DFES_DTCO.DFC_IVActrEnrgMin_6_C DFES_DTCO.DFC_IVActrEnrgMin_7_C DFES_DTCO.DFC_IVActrEnrgPlaus_0_C DFES_DTCO.DFC_IVActrEnrgPlaus_1_C DFES_DTCO.DFC_IVActrEnrgPlaus_2_C DFES_DTCO.DFC_IVActrEnrgPlaus_3_C DFES_DTCO.DFC_IVActrEnrgPlaus_4_C DFES_DTCO.DFC_IVActrEnrgPlaus_5_C DFES_DTCO.DFC_IVActrEnrgPlaus_6_C DFES_DTCO.DFC_IVActrEnrgPlaus_7_C DFES_DTCO.DFC_IVCtlTiDiff_0_C DFES_DTCO.DFC_IVCtlTiDiff_1_C DFES_DTCO.DFC_IVCtlTiDiff_2_C DFES_DTCO.DFC_IVCtlTiDiff_3_C DFES_DTCO.DFC_IVCtlTiDiff_4_C DFES_DTCO.DFC_IVCtlTiDiff_5_C DFES_DTCO.DFC_IVCtlUDiffUp_0_C DFES_DTCO.DFC_IVCtlUDiffUp_1_C DFES_DTCO.DFC_IVCtlUDiffUp_2_C DFES_DTCO.DFC_IVCtlUDiffUp_3_C DFES_DTCO.DFC_IVCtlUDiffUp_4_C DFES_DTCO.DFC_IVCtlUDiffUp_5_C DFES_DTCO.DFC_IVCtlUUp_0_C DFES_DTCO.DFC_IVCtlUUp_1_C DFES_DTCO.DFC_IVCtlUUp_2_C DFES_DTCO.DFC_IVCtlUUp_3_C DFES_DTCO.DFC_IVCtlUUp_4_C DFES_DTCO.DFC_IVCtlUUp_5_C DFES_DTCO.DFC_IVDiaBnkShCir_0_C DFES_DTCO.DFC_IVDiaBnkShCir_1_C DFES_DTCO.DFC_IVDiaBnkShCirChSwt_0_C DFES_DTCO.DFC_IVDiaBnkShCirChSwt_1_C DFES_DTCO.DFC_IVDiaChp_0_C DFES_DTCO.DFC_IVDiaChp_1_C DFES_DTCO.DFC_IVDiaCylNoCls_0_C DFES_DTCO.DFC_IVDiaCylNoCls_1_C DFES_DTCO.DFC_IVDiaCylNoCls_2_C DFES_DTCO.DFC_IVDiaCylNoCls_3_C DFES_DTCO.DFC_IVDiaCylNoCls_4_C DFES_DTCO.DFC_IVDiaCylNoCls_5_C DFES_DTCO.DFC_IVDiaCylNoLd_0_C DFES_DTCO.DFC_IVDiaCylNoLd_1_C DFES_DTCO.DFC_IVDiaCylNoLd_2_C DFES_DTCO.DFC_IVDiaCylNoLd_3_C DFES_DTCO.DFC_IVDiaCylNoLd_4_C DFES_DTCO.DFC_IVDiaCylNoLd_5_C DFES_DTCO.DFC_IVDiaCylShCir_0_C DFES_DTCO.DFC_IVDiaCylShCir_1_C DFES_DTCO.DFC_IVDiaCylShCir_2_C DFES_DTCO.DFC_IVDiaCylShCir_3_C DFES_DTCO.DFC_IVDiaCylShCir_4_C DFES_DTCO.DFC_IVDiaCylShCir_5_C DFES_DTCO.DFC_IVDiaCylShCirHSLS_0_C DFES_DTCO.DFC_IVDiaCylShCirHSLS_1_C DFES_DTCO.DFC_IVDiaCylShCirHSLS_2_C DFES_DTCO.DFC_IVDiaCylShCirHSLS_3_C DFES_DTCO.DFC_IVDiaCylShCirHSLS_4_C DFES_DTCO.DFC_IVDiaCylShCirHSLS_5_C DFES_DTCO.DFC_IVDiaCylShCirMeas_0_C DFES_DTCO.DFC_IVDiaCylShCirMeas_1_C DFES_DTCO.DFC_IVDiaCylShCirMeas_2_C DFES_DTCO.DFC_IVDiaCylShCirMeas_3_C DFES_DTCO.DFC_IVDiaCylShCirMeas_4_C DFES_DTCO.DFC_IVDiaCylShCirMeas_5_C DFES_DTCO.DFC_LSUDynChk_C DFES_DTCO.DFC_LSUO2ClbMax_C DFES_DTCO.DFC_LSUO2ClbMin_C DFES_DTCO.DFC_LSUO2PlausMaxFLd_C DFES_DTCO.DFC_LSUO2PlausMaxOvrRun_C DFES_DTCO.DFC_LSUO2PlausMaxPartLd_C DFES_DTCO.DFC_LSUO2PlausMinFLd_C DFES_DTCO.DFC_LSUO2PlausMinOvrRun_C DFES_DTCO.DFC_LSUO2PlausMinPartLd_C DFES_DTCO.DFC_LSURiClbMax_C DFES_DTCO.DFC_LSURiClbMin_C DFES_DTCO.DFC_LSUWireIPSig_C DFES_DTCO.DFC_Layer_BSDMax_C DFES_DTCO.DFC_Layer_BSDMin_C DFES_DTCO.DFC_Layer_BSDNpl_C DFES_DTCO.DFC_Layer_BSDSig_C DFES_DTCO.DFC_Layer_FltMngTstMax_C DFES_DTCO.DFC_Layer_FltMngTstMin_C DFES_DTCO.DFC_Layer_FltMngTstNpl_C DFES_DTCO.DFC_Layer_FltMngTstSig_C DFES_DTCO.DFC_Layer_GENELBMax_C DFES_DTCO.DFC_Layer_GENELBMin_C DFES_DTCO.DFC_Layer_GENELBNpl_C DFES_DTCO.DFC_Layer_GENELBSig_C DFES_DTCO.DFC_Layer_GENELMax_C DFES_DTCO.DFC_Layer_GENELMin_C DFES_DTCO.DFC_Layer_GENELNpl_C DFES_DTCO.DFC_Layer_GENELSig_C DFES_DTCO.DFC_Layer_GENHTBMax_C DFES_DTCO.DFC_Layer_GENHTBMin_C DFES_DTCO.DFC_Layer_GENHTBNpl_C DFES_DTCO.DFC_Layer_GENHTBSig_C DFES_DTCO.DFC_Layer_GENHTMax_C DFES_DTCO.DFC_Layer_GENHTMin_C DFES_DTCO.DFC_Layer_GENHTNpl_C DFES_DTCO.DFC_Layer_GENHTSig_C DFES_DTCO.DFC_Layer_GENKOMMMax_C DFES_DTCO.DFC_Layer_GENKOMMMin_C DFES_DTCO.DFC_Layer_GENKOMMNpl_C DFES_DTCO.DFC_Layer_GENKOMMSig_C DFES_DTCO.DFC_Layer_GENMECHMax_C DFES_DTCO.DFC_Layer_GENMECHMin_C DFES_DTCO.DFC_Layer_GENMECHNpl_C DFES_DTCO.DFC_Layer_GENMECHSig_C DFES_DTCO.DFC_Layer_GENMax_C DFES_DTCO.DFC_Layer_GENMin_C DFES_DTCO.DFC_Layer_GENNpl_C DFES_DTCO.DFC_Layer_GENREGUPLMax_C DFES_DTCO.DFC_Layer_GENREGUPLMin_C DFES_DTCO.DFC_Layer_GENREGUPLNpl_C DFES_DTCO.DFC_Layer_GENREGUPLSig_C DFES_DTCO.DFC_Layer_GENSig_C DFES_DTCO.DFC_Layer_GENUPLMax_C DFES_DTCO.DFC_Layer_GENUPLMin_C DFES_DTCO.DFC_Layer_GENUPLNpl_C DFES_DTCO.DFC_Layer_GENUPLSig_C DFES_DTCO.DFC_Layer_IBS1Max_C DFES_DTCO.DFC_Layer_IBS1Min_C DFES_DTCO.DFC_Layer_IBS1Npl_C DFES_DTCO.DFC_Layer_IBS1Sig_C DFES_DTCO.DFC_Layer_IBS2Max_C DFES_DTCO.DFC_Layer_IBS2Min_C DFES_DTCO.DFC_Layer_IBS2Npl_C DFES_DTCO.DFC_Layer_IBS2Sig_C DFES_DTCO.DFC_Layer_IBS3Max_C DFES_DTCO.DFC_Layer_IBS3Min_C DFES_DTCO.DFC_Layer_IBS3Npl_C DFES_DTCO.DFC_Layer_IBS3Sig_C DFES_DTCO.DFC_Layer_MANDETEKMax_C DFES_DTCO.DFC_Layer_MANDETEKMin_C DFES_DTCO.DFC_Layer_MANDETEKNpl_C DFES_DTCO.DFC_Layer_MANDETEKSig_C DFES_DTCO.DFC_Layer_NDR1Max_C DFES_DTCO.DFC_Layer_NDR1Min_C DFES_DTCO.DFC_Layer_NDR1Npl_C DFES_DTCO.DFC_Layer_NDR1Sig_C DFES_DTCO.DFC_Layer_NDR2Max_C DFES_DTCO.DFC_Layer_NDR2Min_C DFES_DTCO.DFC_Layer_NDR2Npl_C DFES_DTCO.DFC_Layer_NDR2Sig_C DFES_DTCO.DFC_Layer_NGLERNMax_C DFES_DTCO.DFC_Layer_NGLERNMin_C DFES_DTCO.DFC_Layer_NGLERNNpl_C DFES_DTCO.DFC_Layer_NGLERNSig_C DFES_DTCO.DFC_Layer_PMBATTMax_C DFES_DTCO.DFC_Layer_PMBATTMin_C DFES_DTCO.DFC_Layer_PMBATTNpl_C DFES_DTCO.DFC_Layer_PMBATTSig_C DFES_DTCO.DFC_Layer_PMBNMax_C DFES_DTCO.DFC_Layer_PMBNMin_C DFES_DTCO.DFC_Layer_PMBNNpl_C DFES_DTCO.DFC_Layer_PMBNSig_C DFES_DTCO.DFC_Layer_PMRUHVERLMax_C DFES_DTCO.DFC_Layer_PMRUHVERLMin_C DFES_DTCO.DFC_Layer_PMRUHVERLNpl_C DFES_DTCO.DFC_Layer_PMRUHVERLSig_C DFES_DTCO.DFC_Layer_QLTMax_C DFES_DTCO.DFC_Layer_QLTMin_C DFES_DTCO.DFC_Layer_QLTNpl_C DFES_DTCO.DFC_Layer_QLTSig_C DFES_DTCO.DFC_Layer_TOENSMax_C DFES_DTCO.DFC_Layer_TOENSMin_C DFES_DTCO.DFC_Layer_TOENSNpl_C DFES_DTCO.DFC_Layer_TOENSSig_C DFES_DTCO.DFC_MonLimCurr_C DFES_DTCO.DFC_MonLimLead_C DFES_DTCO.DFC_MonLimSet_C DFES_DTCO.DFC_NSCDsNOxOfsMax_C DFES_DTCO.DFC_NSCDsNOxOfsMin_C DFES_DTCO.DFC_NSCDsNOxPlausMin_C DFES_DTCO.DFC_NoCat2DsNOxOfsMax_C DFES_DTCO.DFC_NoCat2DsNOxOfsMin_C DFES_DTCO.DFC_NoCat2DsNOxPlausMin_C DFES_DTCO.DFC_PCVNoStrt_C DFES_DTCO.DFC_RailPGradMon_C DFES_DTCO.DFC_SCRPODPresBuildUp_C DFES_DTCO.DFC_AFSDrftIdlAdjVal_C DFES_DTCO.DFC_AFSDrftLdAdjVal_C DFES_DTCO.DFC_AdcIADC0Cal_C DFES_DTCO.DFC_AdcIADC0Conv_C DFES_DTCO.DFC_AdcIADC1Cal_C DFES_DTCO.DFC_AdcIADC1Conv_C DFES_DTCO.DFC_CmbChbMisfireMax_0_C DFES_DTCO.DFC_CmbChbMisfireMax_1_C DFES_DTCO.DFC_CmbChbMisfireMax_2_C DFES_DTCO.DFC_CmbChbMisfireMax_3_C DFES_DTCO.DFC_CmbChbMisfireMax_4_C DFES_DTCO.DFC_CmbChbMisfireMax_5_C DFES_DTCO.DFC_CmbChbMisfireMul_C DFES_DTCO.DFC_EGRVlvLPOfsNeutr_C DFES_DTCO.DFC_EGRVlvOfsNeutr_C DFES_DTCO.DFC_FMAErrModMax_C DFES_DTCO.DFC_FMAErrModMin_C DFES_DTCO.DFC_FlSysTnkLo_C DFES_DTCO.DFC_GbxNPosPlaus_C DFES_DTCO.DFC_I14229_ROETst_Appl_C DFES_DTCO.DFC_I14229_ROETst_Netw_C DFES_DTCO.DFC_I14229_ROE_BufFull_C DFES_DTCO.DFC_IVAdjDiaIVAdj_C DFES_DTCO.DFC_IVAdjIVA_0_C DFES_DTCO.DFC_IVAdjIVA_1_C DFES_DTCO.DFC_IVAdjIVA_2_C DFES_DTCO.DFC_IVAdjIVA_3_C DFES_DTCO.DFC_IVAdjIVA_4_C DFES_DTCO.DFC_IVAdjIVA_5_C DFES_DTCO.DFC_IVPSplyDCDCOff_0_C DFES_DTCO.DFC_IVPSplyDCDCOff_1_C DFES_DTCO.DFC_IVPSplyDCDCOff_2_C DFES_DTCO.DFC_IVPSplyDCDCOff_3_C DFES_DTCO.DFC_InjCtlAdjQntEEPCS_C DFES_DTCO.DFC_LSUSPISig_C DFES_DTCO.DFC_Layer_Dummy_C DFES_DTCO.DFC_NplEnvPSensPPFltDiff_C DFES_DTCO.DFC_NplPresSensPPFltDiff_C DFES_DTCO.DFC_OilLvlPlaus_C DFES_DTCO.DFC_OilTOutLvl_C DFES_DTCO.DFC_PCVfacAdaptMax_C DFES_DTCO.DFC_PCVfacAdaptMin_C DFES_DTCO.DFC_SensFrzPPFltUs_C DFES_DTCO.DFC_SensMonUTnkLvl_C DFES_DTCO.DFC_T15Sig_C DFES_DTCO.DFC_AirCtlRmpTOut_C DFES_DTCO.DFC_BrkPPlaus_C DFES_DTCO.DFC_CEngDsTDynTst_C DFES_DTCO.DFC_EEPEraseErr_C DFES_DTCO.DFC_EEPRdErr_C DFES_DTCO.DFC_EEPWrErr_C DFES_DTCO.DFC_EGRVlvJamVlvClsd_C DFES_DTCO.DFC_EGRVlvJamVlvOpn_C DFES_DTCO.DFC_EGRVlvLPJamVlvClsd_C DFES_DTCO.DFC_EGRVlvLPJamVlvOpn_C DFES_DTCO.DFC_EGRVlvLPLgTDrft_C DFES_DTCO.DFC_EGRVlvLPOfsLrnJamVlv_C DFES_DTCO.DFC_EGRVlvLPShTDrft_C DFES_DTCO.DFC_EGRVlvLgTDrft_C DFES_DTCO.DFC_EGRVlvOfsLrnJamVlv_C DFES_DTCO.DFC_EGRVlvShTDrft_C DFES_DTCO.DFC_EngICO_C DFES_DTCO.DFC_EpmCaSI1ErrSig_C DFES_DTCO.DFC_EpmCaSI1NoSig_C DFES_DTCO.DFC_EpmCaSI1OfsErr_C DFES_DTCO.DFC_EpmCrSErrSig_C DFES_DTCO.DFC_EpmCrSNoSig_C DFES_DTCO.DFC_IVPlausComprTst_C DFES_DTCO.DFC_IVPlausRunUpTst_C DFES_DTCO.DFC_InjCrvShOffTst_C DFES_DTCO.DFC_LayerEnSavModProd_C DFES_DTCO.DFC_LayerEnSavModRep_C DFES_DTCO.DFC_LayerEnSavModShip_C DFES_DTCO.DFC_MRlyErlyOpng_C DFES_DTCO.DFC_MRlyStk_C DFES_DTCO.DFC_MeUnActrTst_C DFES_DTCO.DFC_MoCADCCmp_C DFES_DTCO.DFC_MoCADCTst_C DFES_DTCO.DFC_MoCADCVltgRatio_C DFES_DTCO.DFC_MoCComErrCnt_C DFES_DTCO.DFC_MoCComSPI_C DFES_DTCO.DFC_MoCROMErrXPg_C DFES_DTCO.DFC_MoCSOPHwNoRdy_C DFES_DTCO.DFC_MoCSOPLoLi_C DFES_DTCO.DFC_MoCSOPMM_C DFES_DTCO.DFC_MoCSOPTimeOut_C DFES_DTCO.DFC_MoCSOPUpLi_C DFES_DTCO.DFC_MoFAPP_C DFES_DTCO.DFC_MoFESpd_C DFES_DTCO.DFC_MoFInjDatPhi_C DFES_DTCO.DFC_MoFInjDatQnt_C DFES_DTCO.DFC_MoFInjQnt_C DFES_DTCO.DFC_MoFMode1PoI1_C DFES_DTCO.DFC_MoFMode1PoI2_C DFES_DTCO.DFC_MoFMode2PoI1_C DFES_DTCO.DFC_MoFMode2PoI2_C DFES_DTCO.DFC_MoFOvR_C DFES_DTCO.DFC_MoFQntCor_C DFES_DTCO.DFC_MoFRailP_C DFES_DTCO.DFC_MoFTrqCmp_C DFES_DTCO.DFC_NSCDsHtrSetP_C DFES_DTCO.DFC_NoCat2DsHtrSetP_C DFES_DTCO.DFC_PCVActrTst_C DFES_DTCO.DFC_PhyModNonMonMapNpl_C DFES_DTCO.DFC_RailHpTst_C DFES_DTCO.DFC_RailPOfsTstMax_C DFES_DTCO.DFC_RailPOfsTstMin_C DFES_DTCO.DFC_SIA_E1max_C DFES_DTCO.DFC_SIA_E1min_C DFES_DTCO.DFC_SIA_E1npl_C DFES_DTCO.DFC_SIA_E1sig_C DFES_DTCO.DFC_SIA_E2max_C DFES_DTCO.DFC_SIA_E2min_C DFES_DTCO.DFC_SIA_E2npl_C DFES_DTCO.DFC_SIA_E2sig_C DFES_DTCO.DFC_SIA_E3max_C DFES_DTCO.DFC_SIA_E3min_C DFES_DTCO.DFC_SIA_E3npl_C DFES_DTCO.DFC_SIA_E3sig_C DFES_DTCO.DFC_SIA_E4max_C DFES_DTCO.DFC_SIA_E4min_C DFES_DTCO.DFC_SIA_E4npl_C DFES_DTCO.DFC_SIA_E4sig_C DFES_DTCO.DFC_SWReset_0_C DFES_DTCO.DFC_SWReset_1_C DFES_DTCO.DFC_SWReset_2_C DFES_DTCO.DFC_ShtrAKKMax_C DFES_DTCO.DFC_ShtrAKKMin_C DFES_DTCO.DFC_ShtrAKKNpl_C DFES_DTCO.DFC_ShtrPKKMax_C DFES_DTCO.DFC_StopCntTmr_C DFES_DTCO.DFC_ThrVlvMon_C DFES_DTCO.DFC_VSwVlvJamVlv_C DFES_DTCO.DFC_VSwVlvLgTDrft_C DFES_DTCO.DFC_VSwVlvOfsLrnJamVlv_C DFES_DTCO.DFC_VSwVlvOfsNeutr_C DFES_DTCO.DFC_VSwVlvShTDrft_C DFES_DTCO.DFC_VSwVlvSpgDef_C DFES_Env.xSet1_CA DFES_Env.xSet2_CA DFES_Env.xSet3_CA DFES_Env.xSet4_CA DFES_Env.xSet5_CA DFES_Env.xSet6_CA DFES_Env.xSet7_CA DFES_Env.xSet8_CA DFES_Env.xSet9_CA DFES_Env.xSet10_CA DFES_Env.xSet11_CA DFES_Env.xSet12_CA DFES_Env.xSet13_CA DFES_Env.xSet14_CA DFES_Env.xSet15_CA DFES_Env.xSet16_CA DFES_Env.xSet17_CA DFES_Env.xSet18_CA DFES_Env.xSet19_CA DFES_Env.xSet20_CA DFES_Env.xSet21_CA DFES_Env.xSet22_CA DFES_Env.xSet23_CA DFES_Env.xSet24_CA DFES_Env.xSet25_CA DFES_Env.xSet26_CA DFES_Env.xSet27_CA DFES_Env.xSet28_CA DFES_Env.xSet29_CA DFES_Env.xSet30_CA DFES_Env.xSet31_CA DFES_Env.xSet32_CA DFES_Env.xSet33_CA DFES_Env.xSet34_CA DFES_Env.xSet35_CA DFES_Env.xSet36_CA DFES_Env.xSet37_CA DFES_Env.xSet38_CA DFES_Env.xSet39_CA DFES_Env.xSet40_CA DFES_Env.xSet41_CA DFES_Env.xSet42_CA DFES_Env.xSet43_CA DFES_Env.xSet44_CA DFES_Env.xSet45_CA DFES_Env.xSet46_CA DFES_Env.xSet47_CA DFES_Env.xSet48_CA DFES_Env.xSet49_CA DFES_Env.xSet50_CA DFES_Env.xSet51_CA DFES_Env.xSet52_CA DFES_Env.xSet53_CA DFES_Env.xSet54_CA DFES_Env.xSet55_CA DFES_Env.xSet56_CA DFES_Env.xSet57_CA DFES_Env.xSet58_CA DFES_Env.xSet59_CA DFES_Env.xSet60_CA DFES_Env.xSet61_CA DFES_Env.xSet62_CA DFES_Env.xSet63_CA DFES_Env.xSet64_CA DFES_Env.xSet65_CA DFES_Env.xSet66_CA DFES_Env.xSet67_CA DFES_Env.xSet68_CA DFES_Env.xSet69_CA DFES_Env.xSet70_CA DFES_Env.xSet71_CA DFES_Env.xSet72_CA DFES_Env.xSet73_CA DFES_Env.xSet74_CA DFES_Env.xSet75_CA DFES_Env.xSet76_CA DFES_Env.xSet77_CA DFES_Env.xSet78_CA DFES_Env.xSet79_CA DFES_Env.xSet80_CA DFES_EnvAllSets_CA DFES_EnvRef.DFC_Unused_C DFES_EnvRef.DFC_ACCIPlausDrvAst_C DFES_EnvRef.DFC_ACCIPlausTrqDes_C DFES_EnvRef.DFC_AirCtlGovDvtEOMMax_C DFES_EnvRef.DFC_AirCtlGovDvtEOMMin_C DFES_EnvRef.DFC_AirCtlGovDvtMax_C DFES_EnvRef.DFC_AirCtlGovDvtMin_C DFES_EnvRef.DFC_AirCtlGovLPDvtMax_C DFES_EnvRef.DFC_AirCtlGovLPDvtMin_C DFES_EnvRef.DFC_AltIOComErr_C DFES_EnvRef.DFC_AltIOComNpl_C DFES_EnvRef.DFC_BusDiagBusOffFlexRay_C DFES_EnvRef.DFC_BusDiagBusOffNodeA_C DFES_EnvRef.DFC_BusDiagBusOffNodeB_C DFES_EnvRef.DFC_BusDiagBusOffNodeC_C DFES_EnvRef.DFC_BusDiagHwFlexRay_C DFES_EnvRef.DFC_Cj945SpiCom1_C DFES_EnvRef.DFC_ComACDemandSig_FA_C DFES_EnvRef.DFC_ComACDemandTo_FA_C DFES_EnvRef.DFC_ComATempSig_FA_C DFES_EnvRef.DFC_ComATempTo_FA_C DFES_EnvRef.DFC_ComATempTo_FX_C DFES_EnvRef.DFC_ComBrkTrqSumChk_FX_C DFES_EnvRef.DFC_ComBrkTrqSumCtr_FX_C DFES_EnvRef.DFC_ComBrkTrqSumTo_FX_C DFES_EnvRef.DFC_ComBtnDrvDynChk_FX_C DFES_EnvRef.DFC_ComBtnDrvDynCtr_FX_C DFES_EnvRef.DFC_ComBtnDrvDynTo_FX_C DFES_EnvRef.DFC_ComButtonMSASig_C DFES_EnvRef.DFC_ComButtonMSATo_C DFES_EnvRef.DFC_ComCodierungPwrmngSig_C DFES_EnvRef.DFC_ComCodierungPwrmngSig_FA_C DFES_EnvRef.DFC_ComCrCtlLvrChk_C DFES_EnvRef.DFC_ComCrCtlLvrCtr_C DFES_EnvRef.DFC_ComCrCtlLvrSig_C DFES_EnvRef.DFC_ComCrCtlLvrTo_C DFES_EnvRef.DFC_ComCtrCrshSwoEkpSig_FA_C DFES_EnvRef.DFC_ComCtrCrshSwoEkpTo_FA_C DFES_EnvRef.DFC_ComCtrSecInt_C DFES_EnvRef.DFC_ComDiaOBDGbxSig_A_C DFES_EnvRef.DFC_ComDiaOBDGbxTo_A_C DFES_EnvRef.DFC_ComFahrzeugtypSig_C DFES_EnvRef.DFC_ComFahrzeugtypSig_FA_C DFES_EnvRef.DFC_ComFllupGpwsupSig_FA_C DFES_EnvRef.DFC_ComFllupGpwsupTo_FA_C DFES_EnvRef.DFC_ComGbxDataChk_A_C DFES_EnvRef.DFC_ComGbxDataChk_FA_C DFES_EnvRef.DFC_ComGbxDataCtr_A_C DFES_EnvRef.DFC_ComGbxDataCtr_FA_C DFES_EnvRef.DFC_ComGbxDataSig_A_C DFES_EnvRef.DFC_ComGbxDataSig_FA_C DFES_EnvRef.DFC_ComGbxDataTo_A_C DFES_EnvRef.DFC_ComGbxDataTo_FA_C DFES_EnvRef.DFC_ComKlemmenChk_FA_C DFES_EnvRef.DFC_ComKlemmenCtr_FA_C DFES_EnvRef.DFC_ComKlemmenSig_FA_C DFES_EnvRef.DFC_ComKlemmenTo_FA_C DFES_EnvRef.DFC_ComLenkradwinkelSig_C DFES_EnvRef.DFC_ComLenkradwinkelTo_C DFES_EnvRef.DFC_ComMileageRangeSig_FA_C DFES_EnvRef.DFC_ComMileageRangeTo_FA_C DFES_EnvRef.DFC_ComPspSig_C DFES_EnvRef.DFC_ComPspTo_C DFES_EnvRef.DFC_ComRelTimeSig_FA_C DFES_EnvRef.DFC_ComRelTimeTo_FA_C DFES_EnvRef.DFC_ComRequestEMFChk_C DFES_EnvRef.DFC_ComRequestEMFCtr_C DFES_EnvRef.DFC_ComRequestEMFSig_C DFES_EnvRef.DFC_ComRequestEMFTo_C DFES_EnvRef.DFC_ComRpmWhlChk_FX_C DFES_EnvRef.DFC_ComRpmWhlCtr_FX_C DFES_EnvRef.DFC_ComRpmWhlTo_FX_C DFES_EnvRef.DFC_ComSecCtrRelSig_FA_C DFES_EnvRef.DFC_ComSecCtrRelTo_FA_C DFES_EnvRef.DFC_ComSensNOxGndSig_C DFES_EnvRef.DFC_ComSensNOxGndTo_C DFES_EnvRef.DFC_ComSensNOxMode_C DFES_EnvRef.DFC_ComSensNOxUbattSig_C DFES_EnvRef.DFC_ComSensNOxUbattTo_C DFES_EnvRef.DFC_ComShiftPaddleTo_FX_C DFES_EnvRef.DFC_ComShutOffPSPSig_C DFES_EnvRef.DFC_ComShutOffPSPTo_C DFES_EnvRef.DFC_ComSlrdiGlbFZMTo_FA_C DFES_EnvRef.DFC_ComSlrdiGlbFZMTo_FX_C DFES_EnvRef.DFC_ComSpeedVehicleChk_FX_C DFES_EnvRef.DFC_ComSpeedVehicleCtr_FX_C DFES_EnvRef.DFC_ComSpeedVehicleTo_FX_C DFES_EnvRef.DFC_ComStConintDSCChk_FX_C DFES_EnvRef.DFC_ComStConintDSCCtr_FX_C DFES_EnvRef.DFC_ComStConintDSCTo_FX_C DFES_EnvRef.DFC_ComStatACFrontSig_FA_C DFES_EnvRef.DFC_ComStatACFrontTo_FA_C DFES_EnvRef.DFC_ComStatEkpSig_A_C DFES_EnvRef.DFC_ComStatEkpTo_A_C DFES_EnvRef.DFC_ComStatGearRevSig_FA_C DFES_EnvRef.DFC_ComStatGearRevTo_FA_C DFES_EnvRef.DFC_ComStatZVKlappenSig_FA_C DFES_EnvRef.DFC_ComStatZVKlappenTo_FA_C DFES_EnvRef.DFC_ComStateARSCtr_C DFES_EnvRef.DFC_ComStateARSSig_C DFES_EnvRef.DFC_ComStateARSTo_C DFES_EnvRef.DFC_ComStateDscSig_C DFES_EnvRef.DFC_ComStateDscTo_C DFES_EnvRef.DFC_ComStateSeatSig_C DFES_EnvRef.DFC_ComStateSeatSig_FA_C DFES_EnvRef.DFC_ComStateSeatTo_C DFES_EnvRef.DFC_ComStateSeatTo_FA_C DFES_EnvRef.DFC_ComStatusEGSSig_A_C DFES_EnvRef.DFC_ComStatusEGSSig_FA_C DFES_EnvRef.DFC_ComStatusEGSTo_A_C DFES_EnvRef.DFC_ComStatusEGSTo_FA_C DFES_EnvRef.DFC_ComStatusEMFChk_C DFES_EnvRef.DFC_ComStatusEMFCtr_C DFES_EnvRef.DFC_ComStatusEMFSig_C DFES_EnvRef.DFC_ComStatusEMFTo_C DFES_EnvRef.DFC_ComStatusRGangSig_C DFES_EnvRef.DFC_ComStatusRGangTo_C DFES_EnvRef.DFC_ComSteeringAngleChk_FX_C DFES_EnvRef.DFC_ComSteeringAngleCtr_FX_C DFES_EnvRef.DFC_ComSteeringAngleTo_FX_C DFES_EnvRef.DFC_ComTerminalChk_C DFES_EnvRef.DFC_ComTerminalCtr_C DFES_EnvRef.DFC_ComTerminalSig_C DFES_EnvRef.DFC_ComTerminalTo_C DFES_EnvRef.DFC_ComTimeDateSig_FA_C DFES_EnvRef.DFC_ComTimeDateTo_FA_C DFES_EnvRef.DFC_ComTrailerSig_C DFES_EnvRef.DFC_ComTrailerSig_FA_C DFES_EnvRef.DFC_ComTrailerTo_C DFES_EnvRef.DFC_ComTrailerTo_FA_C DFES_EnvRef.DFC_ComTrqDemCrshDrDyChk_FX_C DFES_EnvRef.DFC_ComTrqDemCrshDrDyCtr_FX_C DFES_EnvRef.DFC_ComTrqDemCrshDrDyTo_FX_C DFES_EnvRef.DFC_ComTrqDemandDesSig_C DFES_EnvRef.DFC_ComTrqDemandDesTo_C DFES_EnvRef.DFC_ComTrqDemandDscChk_C DFES_EnvRef.DFC_ComTrqDemandDscCtr_C DFES_EnvRef.DFC_ComTrqDemandDscSig_C DFES_EnvRef.DFC_ComTrqDemandDscTo_C DFES_EnvRef.DFC_ComTrqDemandGbxChk_A_C DFES_EnvRef.DFC_ComTrqDemandGbxChk_FA_C DFES_EnvRef.DFC_ComTrqDemandGbxCtr_A_C DFES_EnvRef.DFC_ComTrqDemandGbxCtr_FA_C DFES_EnvRef.DFC_ComTrqDemandGbxSig_A_C DFES_EnvRef.DFC_ComTrqDemandGbxSig_FA_C DFES_EnvRef.DFC_ComTrqDemandGbxTo_A_C DFES_EnvRef.DFC_ComTrqDemandGbxTo_FA_C DFES_EnvRef.DFC_ComTrqWhlDemChk_C DFES_EnvRef.DFC_ComTrqWhlDemCtr_C DFES_EnvRef.DFC_ComTrqWhlDemFASChk_FX_C DFES_EnvRef.DFC_ComTrqWhlDemFASCtr_FX_C DFES_EnvRef.DFC_ComTrqWhlDemFASTo_FX_C DFES_EnvRef.DFC_ComTrqWhlDemSig_C DFES_EnvRef.DFC_ComTrqWhlDemTo_C DFES_EnvRef.DFC_ComVelocityChk_FA_C DFES_EnvRef.DFC_ComVelocityCtr_FA_C DFES_EnvRef.DFC_ComVelocitySig_C DFES_EnvRef.DFC_ComVelocitySig_FA_C DFES_EnvRef.DFC_ComVelocityTo_C DFES_EnvRef.DFC_ComVelocityTo_FA_C DFES_EnvRef.DFC_ComVerbraucherTo_C DFES_EnvRef.DFC_ComWMomPTStabChk_FX_C DFES_EnvRef.DFC_ComWMomPTStabCtr_FX_C DFES_EnvRef.DFC_ComWMomPTStabTo_FX_C DFES_EnvRef.DFC_ComWheelSpeedSig_C DFES_EnvRef.DFC_ComWheelSpeedTo_C DFES_EnvRef.DFC_ComZvKlappenSig_C DFES_EnvRef.DFC_ComZvKlappenTo_C DFES_EnvRef.DFC_ComaDirectChk_FX_C DFES_EnvRef.DFC_ComaDirectCtr_FX_C DFES_EnvRef.DFC_ComaDirectTo_FX_C DFES_EnvRef.DFC_ComaSideChk_FX_C DFES_EnvRef.DFC_ComaSideCtr_FX_C DFES_EnvRef.DFC_ComaSideTo_FX_C DFES_EnvRef.DFC_Cy320SpiCom_C DFES_EnvRef.DFC_ETCtlDvtInrMax_C DFES_EnvRef.DFC_ETCtlDvtInrMin_C DFES_EnvRef.DFC_ETCtlDvtOutrMax_C DFES_EnvRef.DFC_ETCtlDvtOutrMin_C DFES_EnvRef.DFC_FBCqDvtMax_C DFES_EnvRef.DFC_FBCqDvtMin_C DFES_EnvRef.DFC_Fan4WinErr1_C DFES_EnvRef.DFC_Fan4WinErr2_C DFES_EnvRef.DFC_Fan4WinErr3_C DFES_EnvRef.DFC_Fan4WinErr4_C DFES_EnvRef.DFC_FanSCG_C DFES_EnvRef.DFC_FlFCBS_C DFES_EnvRef.DFC_GlwEcuConfigErr_C DFES_EnvRef.DFC_GlwEcuEepErr_C DFES_EnvRef.DFC_GlwEcuFrmErr_C DFES_EnvRef.DFC_GlwEcuGPCMFaultInfo_C DFES_EnvRef.DFC_GlwEcuGPCMInfo_C DFES_EnvRef.DFC_GlwEcuGk1HSS_C DFES_EnvRef.DFC_GlwEcuGk1OL_C DFES_EnvRef.DFC_GlwEcuGk1SC_C DFES_EnvRef.DFC_GlwEcuGk1Wdst_C DFES_EnvRef.DFC_GlwEcuGk2HSS_C DFES_EnvRef.DFC_GlwEcuGk2OL_C DFES_EnvRef.DFC_GlwEcuGk2SC_C DFES_EnvRef.DFC_GlwEcuGk2Wdst_C DFES_EnvRef.DFC_GlwEcuGk3HSS_C DFES_EnvRef.DFC_GlwEcuGk3OL_C DFES_EnvRef.DFC_GlwEcuGk3SC_C DFES_EnvRef.DFC_GlwEcuGk3Wdst_C DFES_EnvRef.DFC_GlwEcuGk4HSS_C DFES_EnvRef.DFC_GlwEcuGk4OL_C DFES_EnvRef.DFC_GlwEcuGk4SC_C DFES_EnvRef.DFC_GlwEcuGk4Wdst_C DFES_EnvRef.DFC_GlwEcuGk5HSS_C DFES_EnvRef.DFC_GlwEcuGk5OL_C DFES_EnvRef.DFC_GlwEcuGk5SC_C DFES_EnvRef.DFC_GlwEcuGk5Wdst_C DFES_EnvRef.DFC_GlwEcuGk6HSS_C DFES_EnvRef.DFC_GlwEcuGk6OL_C DFES_EnvRef.DFC_GlwEcuGk6SC_C DFES_EnvRef.DFC_GlwEcuGk6Wdst_C /end DEF_CHARACTERISTIC
/end FUNCTION
/begin COMPU_METHOD DFES_EnvTabVerb "" TAB_VERB "%2.1" "-" COMPU_TAB_REF DFES_EnvTabVerb /end COMPU_METHOD
/begin COMPU_VTAB DFES_EnvTabVerb "" TAB_VERB 80 0 "xSet1" 1 "xSet2" 2 "xSet3" 3 "xSet4" 4 "xSet5" 5 "xSet6" 6 "xSet7" 7 "xSet8" 8 "xSet9" 9 "xSet10" 10 "xSet11" 11 "xSet12" 12 "xSet13" 13 "xSet14" 14 "xSet15" 15 "xSet16" 16 "xSet17" 17 "xSet18" 18 "xSet19" 19 "xSet20" 20 "xSet21" 21 "xSet22" 22 "xSet23" 23 "xSet24" 24 "xSet25" 25 "xSet26" 26 "xSet27" 27 "xSet28" 28 "xSet29" 29 "xSet30" 30 "xSet31" 31 "xSet32" 32 "xSet33" 33 "xSet34" 34 "xSet35" 35 "xSet36" 36 "xSet37" 37 "xSet38" 38 "xSet39" 39 "xSet40" 40 "xSet41" 41 "xSet42" 42 "xSet43" 43 "xSet44" 44 "xSet45" 45 "xSet46" 46 "xSet47" 47 "xSet48" 48 "xSet49" 49 "xSet50" 50 "xSet51" 51 "xSet52" 52 "xSet53" 53 "xSet54" 54 "xSet55" 55 "xSet56" 56 "xSet57" 57 "xSet58" 58 "xSet59" 59 "xSet60" 60 "xSet61" 61 "xSet62" 62 "xSet63" 63 "xSet64" 64 "xSet65" 65 "xSet66" 66 "xSet67" 67 "xSet68" 68 "xSet69" 69 "xSet70" 70 "xSet71" 71 "xSet72" 72 "xSet73" 73 "xSet74" 74 "xSet75" 75 "xSet76" 76 "xSet77" 77 "xSet78" 78 "xSet79" 79 "xSet80" DEFAULT_VALUE "---" /end COMPU_VTAB
/begin COMPU_METHOD DFES_OneToOne "" RAT_FUNC "%6.0" "-" COEFFS 0 1 0 0 0 1 /end COMPU_METHOD
/begin COMPU_METHOD Signals_IntSigNumVerb "" TAB_VERB "%6.3" "" COMPU_TAB_REF Signals_IntSigNumVerb /end COMPU_METHOD
/begin COMPU_VTAB Signals_IntSigNumVerb "" TAB_VERB 703 0 "SIGNALS_Signals_Default" 1 "SIGNALS_ACCtl_stOut_1B" 2 "SIGNALS_AFS_dmSensCorr_mp_2B" 3 "SIGNALS_AFS_dm_2B" 4 "SIGNALS_AFS_facIdlAdjVal_mp_2B" 5 "SIGNALS_AFS_facLdAdjVal_mp_2B" 6 "SIGNALS_AFS_mAirPerCyl_1B" 7 "SIGNALS_AFS_mAirPerCyl_2B" 8 "SIGNALS_AFS_rNorm_mp_2B" 9 "SIGNALS_AFS_stRstLoDrftThres_mp_1B" 10 "SIGNALS_AFS_tiCor_mp_2B" 11 "SIGNALS_AFS_tiRaw_2B" 12 "SIGNALS_APP_rFlt_mp_1B" 13 "SIGNALS_APP_rFlt_mp_2B" 14 "SIGNALS_APP_r_2B" 15 "SIGNALS_APP_stSigSrc_1B" 16 "SIGNALS_APP_uRaw1_2B" 17 "SIGNALS_APP_uRaw2_2B" 18 "SIGNALS_ASDdc_stSelSt_mp_2B" 19 "SIGNALS_ASDdc_trq_2B" 20 "SIGNALS_ASDrf_stSelSt_mp_2B" 21 "SIGNALS_ASMod_dmIndAirRef_2B" 22 "SIGNALS_ASMod_dvolPFltEG_1B" 23 "SIGNALS_ASMod_dvolPFltEG_2B" 24 "SIGNALS_ASMod_mAirPerCylCor_2B" 25 "SIGNALS_ASMod_pPFltSimDs_1B" 26 "SIGNALS_ASMod_pPFltSimDs_2B" 27 "SIGNALS_Absch_korr_2B" 28 "SIGNALS_AccPed_trqDes_4B" 29 "SIGNALS_ActMod_trqClth_2B" 30 "SIGNALS_ActMod_trqInr_2B" 31 "SIGNALS_ActMod_trq_2B" 32 "SIGNALS_AirCtl_mDesBas_2B" 33 "SIGNALS_AirCtl_mDesVal_1B" 34 "SIGNALS_AirCtl_mDesVal_2B" 35 "SIGNALS_AirCtl_mGovDvt_2B" 36 "SIGNALS_AirCtl_rCtlVal_2B" 37 "SIGNALS_AirCtl_rGovDvtNrm_2B" 38 "SIGNALS_AirCtl_rPIDCtl_mp_2B" 39 "SIGNALS_AirCtl_stAirCtlBits_4B" 40 "SIGNALS_AirCtl_stMon_1B" 41 "SIGNALS_AirSys_dRED1_mp_2B" 42 "SIGNALS_AirSys_dRED2_mp_2B" 43 "SIGNALS_AirSys_mLBer1_mp_4B" 44 "SIGNALS_AirSys_mLBer2_mp_4B" 45 "SIGNALS_AirSys_mLHFM1_mp_4B" 46 "SIGNALS_AirSys_mLHFM2_mp_4B" 47 "SIGNALS_AirSys_mLM10_mp_4B" 48 "SIGNALS_AirSys_mLM11_mp_4B" 49 "SIGNALS_AirSys_mLM12_mp_4B" 50 "SIGNALS_AirSys_mLM13_mp_4B" 51 "SIGNALS_AirSys_mLM20_mp_4B" 52 "SIGNALS_AirSys_mLM21_mp_4B" 53 "SIGNALS_AirSys_mLM22_mp_4B" 54 "SIGNALS_AirSys_p21max1_mp_2B" 55 "SIGNALS_AirSys_p21max2_mp_2B" 56 "SIGNALS_AirSys_rDIFF1_mp_2B" 57 "SIGNALS_AirSys_rDIFF2_mp_2B" 58 "SIGNALS_AirSys_rLverh1_mp_2B" 59 "SIGNALS_AirSys_rLverh2_mp_2B" 60 "SIGNALS_AirSys_rRED11_mp_2B" 61 "SIGNALS_AirSys_rRED12_mp_2B" 62 "SIGNALS_AirSys_rRED13_mp_2B" 63 "SIGNALS_AirSys_rRED21_mp_2B" 64 "SIGNALS_AirSys_rRED22_mp_2B" 65 "SIGNALS_AirSys_ststateSysTst_mp_1B" 66 "SIGNALS_AirSys_stsubstateSysTst_mp_1B" 67 "SIGNALS_Air_pIntkVUs_1B" 68 "SIGNALS_Air_pIntkVUs_2B" 69 "SIGNALS_Air_rRawTAFS_2B" 70 "SIGNALS_Air_tAFS_2B" 71 "SIGNALS_Air_tCACDs_2B" 72 "SIGNALS_Air_tSensTAFS_1B" 73 "SIGNALS_Air_tSensTAFS_2B" 74 "SIGNALS_Air_uRawPIntkVUs_2B" 75 "SIGNALS_Air_uRawTCACDs_2B" 76 "SIGNALS_AltIO_rAltLoad_2B" 77 "SIGNALS_BattU_uSens_1B" 78 "SIGNALS_BattU_uSens_2B" 79 "SIGNALS_BattU_u_2B" 80 "SIGNALS_BrkP_pSens_2B" 81 "SIGNALS_BrkP_p_2B" 82 "SIGNALS_BrkP_uRaw_2B" 83 "SIGNALS_Brk_st_1B" 84 "SIGNALS_Bszsi_4B" 85 "SIGNALS_CByVlv_st_1B" 86 "SIGNALS_CEngDsT_t_2B" 87 "SIGNALS_CEngDsT_uRaw_2B" 88 "SIGNALS_Clth_st_1B" 89 "SIGNALS_CoEOM_stOpModeAct_4B" 90 "SIGNALS_CoETS_rTrq_2B" 91 "SIGNALS_CoETS_stCurrLimActive_2B" 92 "SIGNALS_CoETS_trqInrLim_2B" 93 "SIGNALS_CoETS_trqInrSetSlow_2B" 94 "SIGNALS_CoEng_stIRevShutOff_4B" 95 "SIGNALS_CoEng_stRevShutOff_4B" 96 "SIGNALS_CoEng_stShutOffPath_4B" 97 "SIGNALS_CoEng_stState_mp_1B" 98 "SIGNALS_CoEng_stTst_1B" 99 "SIGNALS_CoEng_st_1B" 100 "SIGNALS_CoPT_trqDes_2B" 101 "SIGNALS_Com_lSum_4B" 102 "SIGNALS_Com_lSum_8km_2B" 103 "SIGNALS_Com_nPsp_2B" 104 "SIGNALS_Com_rPspSetPoint_2B" 105 "SIGNALS_Com_stCrCtlLvr_1B" 106 "SIGNALS_Com_stLmpPrkBrk_1B" 107 "SIGNALS_Conv_nTrbn_2B" 108 "SIGNALS_CrCUI_stBtn_2B" 109 "SIGNALS_CrC_stKey_2B" 110 "SIGNALS_CrCtl_aReq_2B" 111 "SIGNALS_CrCtl_stShOffConRvActv_mp_4B" 112 "SIGNALS_CrCtl_stShOff_1B" 113 "SIGNALS_CrCtl_st_1B" 114 "SIGNALS_CrCtl_vDes_2B" 115 "SIGNALS_DFC_ctLDF_mp_2B" 116 "SIGNALS_DFES_ctDef_1B" 117 "SIGNALS_DFES_ctEntry_1B" 118 "SIGNALS_DFES_ctOBDPend_1B" 119 "SIGNALS_DFES_ctOBD_1B" 120 "SIGNALS_DSMAUX_ctWUC_1B" 121 "SIGNALS_DSMRdy_Why_CyclCmplComprCmpnt_mp_2B" 122 "SIGNALS_DSMRdy_Why_CyclCmplEGR_mp_2B" 123 "SIGNALS_DSMRdy_Why_CyclCmplFlSys_mp_2B" 124 "SIGNALS_DSMRdy_Why_RdyComprCmpnt_mp_2B" 125 "SIGNALS_DSMRdy_Why_RdyEGR_mp_2B" 126 "SIGNALS_DSMRdy_Why_RdyFlSys_mp_2B" 127 "SIGNALS_DSM_DisblMode_mp_2B" 128 "SIGNALS_DSM_stPostDrive_1B" 129 "SIGNALS_DSM_stRdyAB_1B" 130 "SIGNALS_DSM_stRdyCD_1B" 131 "SIGNALS_D_soc_2B" 132 "SIGNALS_Dffgen_1B" 133 "SIGNALS_Dfh_lerncnt_2B" 134 "SIGNALS_Dfh_lernpw_2B" 135 "SIGNALS_Dfh_pekpf_1B" 136 "SIGNALS_Dfh_pekpf_2B" 137 "SIGNALS_Dspl_volFlTnkQnt_2B" 138 "SIGNALS_ECBVlv_rAct_2B" 139 "SIGNALS_ECBVlv_rPs_2B" 140 "SIGNALS_EGRVlv_rAct_2B" 141 "SIGNALS_EGRVlv_rPs_1B" 142 "SIGNALS_EGRVlv_rPs_2B" 143 "SIGNALS_EGRVlv_r_2B" 144 "SIGNALS_EMDmp_rPs_0_2B" 145 "SIGNALS_ETClb_ctLrn_mp_0_2B" 146 "SIGNALS_ETClb_ctLrn_mp_1_2B" 147 "SIGNALS_ETClb_ctLrn_mp_2_2B" 148 "SIGNALS_ETClb_dtiETFlt0_mp_0_2B" 149 "SIGNALS_ETClb_dtiETFlt0_mp_1_2B" 150 "SIGNALS_ETClb_dtiETFlt0_mp_2_2B" 151 "SIGNALS_ETClb_dtiETFlt0_mp_3_2B" 152 "SIGNALS_ETClb_dtiETFlt0_mp_4_2B" 153 "SIGNALS_ETClb_dtiETFlt0_mp_5_2B" 154 "SIGNALS_ETClb_dtiETFlt1_mp_0_2B" 155 "SIGNALS_ETClb_dtiETFlt1_mp_1_2B" 156 "SIGNALS_ETClb_dtiETFlt1_mp_2_2B" 157 "SIGNALS_ETClb_dtiETFlt1_mp_3_2B" 158 "SIGNALS_ETClb_dtiETFlt1_mp_4_2B" 159 "SIGNALS_ETClb_dtiETFlt1_mp_5_2B" 160 "SIGNALS_ETClb_dtiETFlt2_mp_0_2B" 161 "SIGNALS_ETClb_dtiETFlt2_mp_1_2B" 162 "SIGNALS_ETClb_dtiETFlt2_mp_2_2B" 163 "SIGNALS_ETClb_dtiETFlt2_mp_3_2B" 164 "SIGNALS_ETClb_dtiETFlt2_mp_4_2B" 165 "SIGNALS_ETClb_dtiETFlt2_mp_5_2B" 166 "SIGNALS_ETClb_pRailSet_0_2B" 167 "SIGNALS_ETClb_pRailSet_1_2B" 168 "SIGNALS_ETClb_pRailSet_2_2B" 169 "SIGNALS_ETClb_stCor_1B" 170 "SIGNALS_ETClb_stRlsCylCor_mp_1B" 171 "SIGNALS_ETClb_tiETAvrg_0_2B" 172 "SIGNALS_ETClb_tiETAvrg_1_2B" 173 "SIGNALS_ETClb_tiETAvrg_2_2B" 174 "SIGNALS_ETClb_tiETMax_0_2B" 175 "SIGNALS_ETClb_tiETMax_1_2B" 176 "SIGNALS_ETClb_tiETMax_2_2B" 177 "SIGNALS_ETClb_tiETMin_0_2B" 178 "SIGNALS_ETClb_tiETMin_1_2B" 179 "SIGNALS_ETClb_tiETMin_2_2B" 180 "SIGNALS_EngDa_tEng_2B" 181 "SIGNALS_EngDa_tFld_0_2B" 182 "SIGNALS_EngDa_tFld_1_2B" 183 "SIGNALS_EngDa_tFld_2_2B" 184 "SIGNALS_EngDa_tFld_3_2B" 185 "SIGNALS_EngDa_tiEngOn_4B" 186 "SIGNALS_EngDem_trqLimErr_2B" 187 "SIGNALS_EngPrt_trqLim_2B" 188 "SIGNALS_EngReq_trqLim_2B" 189 "SIGNALS_EngTrqPtd_stLimDeb_mp_1B" 190 "SIGNALS_EngTrqPtd_stLimUnDeb_mp_1B" 191 "SIGNALS_EngTrqPtd_stPthLim_1B" 192 "SIGNALS_EngTrqPtd_trqASD_2B" 193 "SIGNALS_EngTrqPtd_trqLim_2B" 194 "SIGNALS_EngTrqPtd_trqSpdG_2B" 195 "SIGNALS_EnvP_p_1B" 196 "SIGNALS_EnvP_p_2B" 197 "SIGNALS_EnvP_uRaw_2B" 198 "SIGNALS_EnvT_t_1B" 199 "SIGNALS_EnvT_t_2B" 200 "SIGNALS_EpmCaS_phiOfsCorr_2B" 201 "SIGNALS_EpmHCrS_stSigMode_1B" 202 "SIGNALS_Epm_nEng_2B" 203 "SIGNALS_Epm_stOpMode_1B" 204 "SIGNALS_Epm_stSpd_1B" 205 "SIGNALS_Epm_stSync_1B" 206 "SIGNALS_ErrLmp_stMILReq_1B" 207 "SIGNALS_ErrLmp_stSVSReq_1B" 208 "SIGNALS_Exh_pAdapPPFltDiff_1B" 209 "SIGNALS_Exh_pAdapPPFltDiff_2B" 210 "SIGNALS_Exh_pAdapPPFltUs_1B" 211 "SIGNALS_Exh_pAdapPPFltUs_2B" 212 "SIGNALS_Exh_pDiffOfsValAct_mp_1B" 213 "SIGNALS_Exh_pDiffOfsValAct_mp_2B" 214 "SIGNALS_Exh_pFltPPFltDiff_1B" 215 "SIGNALS_Exh_pFltPPFltDiff_2B" 216 "SIGNALS_Exh_pFltPPFltUs_1B" 217 "SIGNALS_Exh_pFltPPFltUs_2B" 218 "SIGNALS_Exh_pPFltUs_1B" 219 "SIGNALS_Exh_pPFltUs_2B" 220 "SIGNALS_Exh_pRawAdapPPFltDiff_1B" 221 "SIGNALS_Exh_pRawAdapPPFltDiff_2B" 222 "SIGNALS_Exh_tOxiCatUs_1B" 223 "SIGNALS_Exh_tOxiCatUs_2B" 224 "SIGNALS_Exh_tPFltUs_1B" 225 "SIGNALS_Exh_tPFltUs_2B" 226 "SIGNALS_Exh_tSensTOxiCatUs_1B" 227 "SIGNALS_Exh_tSensTOxiCatUs_2B" 228 "SIGNALS_Exh_tSensTPFltUs_1B" 229 "SIGNALS_Exh_tSensTPFltUs_2B" 230 "SIGNALS_Exh_uRawPPFltUs_2B" 231 "SIGNALS_Exh_uRawTOxiCatUs_2B" 232 "SIGNALS_Exh_uRawTPFltUs_2B" 233 "SIGNALS_FBC_qDvtCylPhys_01_0_2B" 234 "SIGNALS_FBC_qDvtCylPhys_01_1_2B" 235 "SIGNALS_FBC_qDvtCylPhys_01_2_2B" 236 "SIGNALS_FBC_qDvtCylPhys_01_3_2B" 237 "SIGNALS_FBC_qDvtCylPhys_01_4_2B" 238 "SIGNALS_FBC_qDvtCylPhys_01_5_2B" 239 "SIGNALS_FBC_qDvtCyl_0_2B" 240 "SIGNALS_FBC_qDvtCyl_1_2B" 241 "SIGNALS_FBC_qDvtCyl_2_2B" 242 "SIGNALS_FBC_qDvtCyl_3_2B" 243 "SIGNALS_FBC_qDvtCyl_4_2B" 244 "SIGNALS_FBC_qDvtCyl_5_2B" 245 "SIGNALS_FMA_qMapRow0_mp_0_2B" 246 "SIGNALS_FMA_qMapRow0_mp_1_2B" 247 "SIGNALS_FMA_qMapRow0_mp_2_2B" 248 "SIGNALS_FMA_qMapRow0_mp_3_2B" 249 "SIGNALS_FMA_qMapRow0_mp_4_2B" 250 "SIGNALS_FMA_qMapRow0_mp_5_2B" 251 "SIGNALS_FMA_qMapRow0_mp_6_2B" 252 "SIGNALS_FMA_qMapRow0_mp_7_2B" 253 "SIGNALS_FMA_qMapRow1_mp_0_2B" 254 "SIGNALS_FMA_qMapRow1_mp_1_2B" 255 "SIGNALS_FMA_qMapRow1_mp_2_2B" 256 "SIGNALS_FMA_qMapRow1_mp_3_2B" 257 "SIGNALS_FMA_qMapRow1_mp_4_2B" 258 "SIGNALS_FMA_qMapRow1_mp_5_2B" 259 "SIGNALS_FMA_qMapRow1_mp_6_2B" 260 "SIGNALS_FMA_qMapRow1_mp_7_2B" 261 "SIGNALS_FMA_qMapRow2_mp_0_2B" 262 "SIGNALS_FMA_qMapRow2_mp_1_2B" 263 "SIGNALS_FMA_qMapRow2_mp_2_2B" 264 "SIGNALS_FMA_qMapRow2_mp_3_2B" 265 "SIGNALS_FMA_qMapRow2_mp_4_2B" 266 "SIGNALS_FMA_qMapRow2_mp_5_2B" 267 "SIGNALS_FMA_qMapRow2_mp_6_2B" 268 "SIGNALS_FMA_qMapRow2_mp_7_2B" 269 "SIGNALS_FMA_qMapRow3_mp_0_2B" 270 "SIGNALS_FMA_qMapRow3_mp_1_2B" 271 "SIGNALS_FMA_qMapRow3_mp_2_2B" 272 "SIGNALS_FMA_qMapRow3_mp_3_2B" 273 "SIGNALS_FMA_qMapRow3_mp_4_2B" 274 "SIGNALS_FMA_qMapRow3_mp_5_2B" 275 "SIGNALS_FMA_qMapRow3_mp_6_2B" 276 "SIGNALS_FMA_qMapRow3_mp_7_2B" 277 "SIGNALS_FMA_qMapRow4_mp_0_2B" 278 "SIGNALS_FMA_qMapRow4_mp_1_2B" 279 "SIGNALS_FMA_qMapRow4_mp_2_2B" 280 "SIGNALS_FMA_qMapRow4_mp_3_2B" 281 "SIGNALS_FMA_qMapRow4_mp_4_2B" 282 "SIGNALS_FMA_qMapRow4_mp_5_2B" 283 "SIGNALS_FMA_qMapRow4_mp_6_2B" 284 "SIGNALS_FMA_qMapRow4_mp_7_2B" 285 "SIGNALS_FMA_qMapRow5_mp_0_2B" 286 "SIGNALS_FMA_qMapRow5_mp_1_2B" 287 "SIGNALS_FMA_qMapRow5_mp_2_2B" 288 "SIGNALS_FMA_qMapRow5_mp_3_2B" 289 "SIGNALS_FMA_qMapRow5_mp_4_2B" 290 "SIGNALS_FMA_qMapRow5_mp_5_2B" 291 "SIGNALS_FMA_qMapRow5_mp_6_2B" 292 "SIGNALS_FMA_qMapRow5_mp_7_2B" 293 "SIGNALS_FMA_qMapRow6_mp_0_2B" 294 "SIGNALS_FMA_qMapRow6_mp_1_2B" 295 "SIGNALS_FMA_qMapRow6_mp_2_2B" 296 "SIGNALS_FMA_qMapRow6_mp_3_2B" 297 "SIGNALS_FMA_qMapRow6_mp_4_2B" 298 "SIGNALS_FMA_qMapRow6_mp_5_2B" 299 "SIGNALS_FMA_qMapRow6_mp_6_2B" 300 "SIGNALS_FMA_qMapRow6_mp_7_2B" 301 "SIGNALS_FMA_qMapRow7_mp_0_2B" 302 "SIGNALS_FMA_qMapRow7_mp_1_2B" 303 "SIGNALS_FMA_qMapRow7_mp_2_2B" 304 "SIGNALS_FMA_qMapRow7_mp_3_2B" 305 "SIGNALS_FMA_qMapRow7_mp_4_2B" 306 "SIGNALS_FMA_qMapRow7_mp_5_2B" 307 "SIGNALS_FMA_qMapRow7_mp_6_2B" 308 "SIGNALS_FMA_qMapRow7_mp_7_2B" 309 "SIGNALS_FMA_q_mp_2B" 310 "SIGNALS_FMA_stSwtOff_1B" 311 "SIGNALS_FMA_tiFuncOp_4B" 312 "SIGNALS_Fan_rPs_1B" 313 "SIGNALS_Fan_rPs_2B" 314 "SIGNALS_FlFltDsP_pSens_1B" 315 "SIGNALS_FlFltDsP_pSens_2B" 316 "SIGNALS_FlFltDsP_p_1B" 317 "SIGNALS_FlFltDsP_p_2B" 318 "SIGNALS_FlFltDsP_uRaw_1B" 319 "SIGNALS_FlFltDsP_uRaw_2B" 320 "SIGNALS_FlFltHt_stPs_1B" 321 "SIGNALS_FlFlt_stRaw_1B" 322 "SIGNALS_FuelLvl_vol_1B" 323 "SIGNALS_FuelLvl_vol_2B" 324 "SIGNALS_FuelT_t_1B" 325 "SIGNALS_FuelT_t_2B" 326 "SIGNALS_FuelT_uRaw_2B" 327 "SIGNALS_Gangi_1B" 328 "SIGNALS_Gbx_ctGbxNPosUnPls_1B" 329 "SIGNALS_Gbx_numGear_1B" 330 "SIGNALS_GlwCtl_stGlw_2B" 331 "SIGNALS_GlwEcu_lSum_mp_2B" 332 "SIGNALS_GlwEcu_pwrGlow_1B" 333 "SIGNALS_GlwEcu_pwrGlow_2B" 334 "SIGNALS_GlwEcu_stGPCMConfig_mp_1B" 335 "SIGNALS_GlwEcu_stGPCMDiag_1B" 336 "SIGNALS_GlwEcu_stGPType_mp_1B" 337 "SIGNALS_GlwEcu_stHSSOpen_1B" 338 "SIGNALS_GlwEcu_stHSSShort_1B" 339 "SIGNALS_GlwEcu_stHighresCold_1B" 340 "SIGNALS_GlwEcu_stHighresHot_1B" 341 "SIGNALS_GlwEcu_stLowresCold_1B" 342 "SIGNALS_GlwEcu_stLowresHot_1B" 343 "SIGNALS_GlwEcu_tGlwPlg_mp_1B" 344 "SIGNALS_GlwEcu_tGlwPlg_mp_2B" 345 "SIGNALS_GlwLmp_st_1B" 346 "SIGNALS_ISC_nSetPLo_0_2B" 347 "SIGNALS_ISC_nSetPLo_1_2B" 348 "SIGNALS_ISC_nSetPLo_2_2B" 349 "SIGNALS_ISC_nSetPLo_3_2B" 350 "SIGNALS_ISC_nSetPLo_4_2B" 351 "SIGNALS_ISC_nSetPLo_5_2B" 352 "SIGNALS_ISC_st_0_4B" 353 "SIGNALS_ISC_st_1_4B" 354 "SIGNALS_ISC_st_2_4B" 355 "SIGNALS_ISC_st_3_4B" 356 "SIGNALS_ISC_st_4_4B" 357 "SIGNALS_ISC_st_5_4B" 358 "SIGNALS_ISC_trq_2B" 359 "SIGNALS_IVActr_uCh_mp_2B" 360 "SIGNALS_IVActr_uUp_2B" 361 "SIGNALS_IVCtl_tiChrg_2B" 362 "SIGNALS_IVCtl_uUp_2B" 363 "SIGNALS_IVPlaus_nCyl_0_2B" 364 "SIGNALS_IVPlaus_nCyl_1_2B" 365 "SIGNALS_IVPlaus_nCyl_2_2B" 366 "SIGNALS_IVPlaus_nCyl_3_2B" 367 "SIGNALS_IVPlaus_nCyl_4_2B" 368 "SIGNALS_IVPlaus_nCyl_5_2B" 369 "SIGNALS_IVPlaus_nHiDwnRunUpTst_2B" 370 "SIGNALS_IVPlaus_nHiUpRunUpTst_2B" 371 "SIGNALS_IVPlaus_nLoDwnRunUpTst_2B" 372 "SIGNALS_IVPlaus_nLoUpRunUpTst_2B" 373 "SIGNALS_IVPlaus_qFBCCyl_0_2B" 374 "SIGNALS_IVPlaus_qFBCCyl_1_2B" 375 "SIGNALS_IVPlaus_qFBCCyl_2_2B" 376 "SIGNALS_IVPlaus_qFBCCyl_3_2B" 377 "SIGNALS_IVPlaus_qFBCCyl_4_2B" 378 "SIGNALS_IVPlaus_qFBCCyl_5_2B" 379 "SIGNALS_IVPlaus_stRefRunUpTst_2B" 380 "SIGNALS_IVPlaus_tiDwnRunUpTst_4B" 381 "SIGNALS_IVPlaus_tiUpRunUpTst_4B" 382 "SIGNALS_I_batt_2B" 383 "SIGNALS_I_gen_1B" 384 "SIGNALS_InjCrv_phiMI1Des_2B" 385 "SIGNALS_InjCrv_phiPiI1Des_2B" 386 "SIGNALS_InjCrv_phiPiI2Des_2B" 387 "SIGNALS_InjCrv_phiPoI1Des_2B" 388 "SIGNALS_InjCrv_phiPoI2Des_2B" 389 "SIGNALS_InjCrv_qPiI1Des_mp_2B" 390 "SIGNALS_InjCrv_qPiI2Des_mp_2B" 391 "SIGNALS_InjCrv_tiPiI1Des_2B" 392 "SIGNALS_InjCtl_qCurr_2B" 393 "SIGNALS_InjCtl_qRaw_2B" 394 "SIGNALS_InjCtl_qSetUnBal_1B" 395 "SIGNALS_InjCtl_qSetUnBal_2B" 396 "SIGNALS_InjUn_stStrt_1B" 397 "SIGNALS_InjVlv_tiMI1ET_mp_2B" 398 "SIGNALS_InjVlv_tiPiI1ET_mp_2B" 399 "SIGNALS_InjVlv_tiPiI2ET_mp_2B" 400 "SIGNALS_InjVlv_tiPoI1ET_mp_2B" 401 "SIGNALS_InjVlv_tiPoI2ET_mp_2B" 402 "SIGNALS_InjVlv_volMI1_mp_2B" 403 "SIGNALS_InjVlv_volPiI1_mp_2B" 404 "SIGNALS_LSU_rLam_1B" 405 "SIGNALS_LSU_rLam_2B" 406 "SIGNALS_LSU_rO2Adap_0_1B" 407 "SIGNALS_LSU_rO2Adap_0_2B" 408 "SIGNALS_LSU_rO2Raw_2B" 409 "SIGNALS_LSU_stAdap_1B" 410 "SIGNALS_LSU_stO2IntValid_1B" 411 "SIGNALS_Layer_stLPCOff_1B" 412 "SIGNALS_Md_gennm_2B" 413 "SIGNALS_MeUn_dvolSet_2B" 414 "SIGNALS_MeUn_iActFlt_mp_1B" 415 "SIGNALS_MeUn_iActFlt_mp_2B" 416 "SIGNALS_MeUn_iSet_1B" 417 "SIGNALS_MeUn_iSet_2B" 418 "SIGNALS_MeUn_rPs_mp_1B" 419 "SIGNALS_MeUn_rPs_mp_2B" 420 "SIGNALS_MeUn_stActrCtl_mp_1B" 421 "SIGNALS_MeUn_uRaw_mp_2B" 422 "SIGNALS_MoCADC_ctDebTst_1B" 423 "SIGNALS_MoCADC_facVltgRatio_2B" 424 "SIGNALS_MoCADC_st_1B" 425 "SIGNALS_MoCCom_Query_4B" 426 "SIGNALS_MoCCom_Response_4B" 427 "SIGNALS_MoCCom_ctErrFC_1B" 428 "SIGNALS_MoCCom_ctErrMM_1B" 429 "SIGNALS_MoCCom_ctErrSPI_1B" 430 "SIGNALS_MoCCom_ctSOPTstActv_1B" 431 "SIGNALS_MoCCom_st_1B" 432 "SIGNALS_MoCMem_st_1B" 433 "SIGNALS_MoCRom_numRomPageErr_1B" 434 "SIGNALS_MoCRom_ptrTabIndexAct_1B" 435 "SIGNALS_MoCSOP_stAct_1B" 436 "SIGNALS_MoCSOP_stActvMsg_1B" 437 "SIGNALS_MoCSOP_stErr_1B" 438 "SIGNALS_MoCSOP_stLdRespTab_1B" 439 "SIGNALS_MoCSOP_stRdyMsg_1B" 440 "SIGNALS_MoCSOP_stRdy_1B" 441 "SIGNALS_MoCSOP_st_1B" 442 "SIGNALS_MoFAPP_stTst_1B" 443 "SIGNALS_MoFAPP_u_1B" 444 "SIGNALS_MoFBrk_st_1B" 445 "SIGNALS_MoFCoEng_rTrqPtd_1B" 446 "SIGNALS_MoFCoOfs_rTrqPtdMsg_1B" 447 "SIGNALS_MoFCoOfs_rTrqPtdOfs_1B" 448 "SIGNALS_MoFCoVeh_trqVehPtd_2B" 449 "SIGNALS_MoFDrAs_trqPtd_2B" 450 "SIGNALS_MoFDrDem_rAPP_1B" 451 "SIGNALS_MoFDrDem_trqPtd_2B" 452 "SIGNALS_MoFESpd_nEng_1B" 453 "SIGNALS_MoFESpd_phiGT1Last_4B" 454 "SIGNALS_MoFESpd_stSync_1B" 455 "SIGNALS_MoFETC_stTst_1B" 456 "SIGNALS_MoFExtInt_trqPtd_2B" 457 "SIGNALS_MoFIn_st_1B" 458 "SIGNALS_MoFInjDat_ctDebQntErr_1B" 459 "SIGNALS_MoFInjDat_facPoI1EffSet_2B" 460 "SIGNALS_MoFInjDat_facPoI2EffSet_2B" 461 "SIGNALS_MoFInjDat_pLinCurr_mp_1B" 462 "SIGNALS_MoFInjDat_p_1B" 463 "SIGNALS_MoFInjDat_phiMI1_2B" 464 "SIGNALS_MoFInjDat_phiPiI1_2B" 465 "SIGNALS_MoFInjDat_phiPiI2_2B" 466 "SIGNALS_MoFInjDat_phiPoI1_2B" 467 "SIGNALS_MoFInjDat_phiPoI2_2B" 468 "SIGNALS_MoFInjDat_stInjState_1B" 469 "SIGNALS_MoFInjDat_stPressSRC_1B" 470 "SIGNALS_MoFInjDat_tiMI1PoI1_2B" 471 "SIGNALS_MoFInjDat_tiMI1PoI2_2B" 472 "SIGNALS_MoFInjDat_tiPiI1ZFCETCor_2B" 473 "SIGNALS_MoFInjDat_tiPiI2ZFCETCor_2B" 474 "SIGNALS_MoFInjDat_tiPiI3ZFCETCor_2B" 475 "SIGNALS_MoFInjDat_tiTDCAvrg_2B" 476 "SIGNALS_MoFInjDat_uRaw_mp_1B" 477 "SIGNALS_MoFInjQnt_qPoI1Cor_2B" 478 "SIGNALS_MoFInjQnt_qPoI2Cor_2B" 479 "SIGNALS_MoFMode_ctDebPoI1Err_1B" 480 "SIGNALS_MoFMode_ctDebPoI2Err_1B" 481 "SIGNALS_MoFMode_qSetUnBal_2B" 482 "SIGNALS_MoFMode_stOpModeMsg_2B" 483 "SIGNALS_MoFOvR_stRls_2B" 484 "SIGNALS_MoFQntCor_qMI1_2B" 485 "SIGNALS_MoFQntCor_stInj_1B" 486 "SIGNALS_MoFQntCor_stMI1ErrAct_mp_1B" 487 "SIGNALS_MoFQntCor_stPiI1ErrAct_mp_1B" 488 "SIGNALS_MoFQntCor_stPoI1ErrAct_mp_1B" 489 "SIGNALS_MoFQntCor_stPoI2ErrAct_mp_1B" 490 "SIGNALS_MoFRailP_ctDebErr_1B" 491 "SIGNALS_MoFRailP_ctDebGradMax_1B" 492 "SIGNALS_MoFRailP_p_1B" 493 "SIGNALS_MoFTrqIdc_facEtaCor_mp_2B" 494 "SIGNALS_MoFTrqIdc_rTrq_1B" 495 "SIGNALS_OBD_PID01_DSMRdy_xPId1_4B" 496 "SIGNALS_OBD_PID04_CoETS_rTrq_1B" 497 "SIGNALS_OBD_PID05_CEngDsT_tSens_1B" 498 "SIGNALS_OBD_PID0B_Air_pSensPIntkVUs_1B" 499 "SIGNALS_OBD_PID0C_Epm_nEngRaw_2B" 500 "SIGNALS_OBD_PID0D_VehV_v_1B" 501 "SIGNALS_OBD_PID0F_Air_tSensTCACDs_1B" 502 "SIGNALS_OBD_PID10_AFS_dmSens_2B" 503 "SIGNALS_OBD_PID11_ThrVlv_rSens_1B" 504 "SIGNALS_OBD_PID1C_I15031_PID1C_1B" 505 "SIGNALS_OBD_PID1D_I15031_PID1D_1B" 506 "SIGNALS_OBD_PID1F_CoEng_tiNormal_2B" 507 "SIGNALS_OBD_PID21_DSMDur_ctGlb_0_2B" 508 "SIGNALS_OBD_PID23_RailP_pLin_2B" 509 "SIGNALS_OBD_PID24_LSU_rLam_uO2Raw_AB_2B" 510 "SIGNALS_OBD_PID24_LSU_rLam_uO2Raw_CD_2B" 511 "SIGNALS_OBD_PID2C_EGRVlv_r_1B" 512 "SIGNALS_OBD_PID2D_AirCtl_rGovDvtNrm_1B" 513 "SIGNALS_OBD_PID30_DSMAUX_ctWUC_1B" 514 "SIGNALS_OBD_PID33_EnvP_pSens_1B" 515 "SIGNALS_OBD_PID3C_Exh_tSensTPFltUs_2B" 516 "SIGNALS_OBD_PID41_DSMRdy_xPId41_4B" 517 "SIGNALS_OBD_PID42_BattU_uSens_2B" 518 "SIGNALS_OBD_PID45_ThrVlv_rAct_1B" 519 "SIGNALS_OBD_PID46_EnvT_tSens_1B" 520 "SIGNALS_OBD_PID49_APP_rUnFlt_1B" 521 "SIGNALS_OBD_PID4A_APP_uRaw2_1B" 522 "SIGNALS_OBD_PID4C_ThrVlv_r_1B" 523 "SIGNALS_OBD_PID4F_I15031_PID4FA_1B" 524 "SIGNALS_OBD_PID4F_I15031_PID4FB_1B" 525 "SIGNALS_OBD_PID4F_I15031_PID4FC_1B" 526 "SIGNALS_OBD_PID4F_I15031_PID4FD_1B" 527 "SIGNALS_OilPLmp_st_2B" 528 "SIGNALS_Oil_tSwmp_2B" 529 "SIGNALS_Oz_kvbmw_4B" 530 "SIGNALS_Oz_kvbog_2B" 531 "SIGNALS_Oz_kvbsm_4B" 532 "SIGNALS_Oz_kvbsm_ul_4B" 533 "SIGNALS_Oz_lp_1B" 534 "SIGNALS_Oz_lv_1B" 535 "SIGNALS_Oz_nivkrzt_1B" 536 "SIGNALS_Oz_nivlangt_1B" 537 "SIGNALS_Oz_oelkm_2B" 538 "SIGNALS_Oz_orikor_1B" 539 "SIGNALS_PCBS_lDistanceOut_2B" 540 "SIGNALS_PCBS_lSumDPFChng_4B" 541 "SIGNALS_PCR_pDesBasLP_mp_2B" 542 "SIGNALS_PCR_pDesBas_mp_2B" 543 "SIGNALS_PCR_pDesValLP_2B" 544 "SIGNALS_PCR_pDesVal_1B" 545 "SIGNALS_PCR_pDesVal_2B" 546 "SIGNALS_PCR_pGovDvtLP_2B" 547 "SIGNALS_PCR_pGovDvt_2B" 548 "SIGNALS_PCR_rCtlVal_2B" 549 "SIGNALS_PCR_stMonLP_1B" 550 "SIGNALS_PCR_stMon_1B" 551 "SIGNALS_PCR_stNrmOpLP_mp_1B" 552 "SIGNALS_PCR_stNrmOp_mp_1B" 553 "SIGNALS_PCR_stPCRBitsLP_4B" 554 "SIGNALS_PCR_stPCRBits_4B" 555 "SIGNALS_PCR_stWrkSphLP_mp_1B" 556 "SIGNALS_PCR_stWrkSph_mp_1B" 557 "SIGNALS_PCV_facAdapt_1B" 558 "SIGNALS_PCV_facAdapt_2B" 559 "SIGNALS_PCV_iActFlt_mp_1B" 560 "SIGNALS_PCV_iActFlt_mp_2B" 561 "SIGNALS_PCV_iSet_1B" 562 "SIGNALS_PCV_iSet_2B" 563 "SIGNALS_PCV_pSet_2B" 564 "SIGNALS_PCV_rPs_1B" 565 "SIGNALS_PCV_rPs_2B" 566 "SIGNALS_PCV_stActrCtl_1B" 567 "SIGNALS_PCV_uRaw_mp_2B" 568 "SIGNALS_PFltLd_mAshOilEG_2B" 569 "SIGNALS_PFltLd_mSotSim_2B" 570 "SIGNALS_PFltLd_mSot_2B" 571 "SIGNALS_PFltLd_resFlwFlt_1B" 572 "SIGNALS_PFltLd_resFlwFlt_2B" 573 "SIGNALS_PFltRgn_dqFlAvrg_mp_1B" 574 "SIGNALS_PFltRgn_dqFlAvrg_mp_2B" 575 "SIGNALS_PFltRgn_lSnceRgn_4B" 576 "SIGNALS_PFltRgn_lSumRgnBck0_mp_4B" 577 "SIGNALS_PFltRgn_lSumRgnBck1_mp_4B" 578 "SIGNALS_PFltRgn_lSumRgnBck2_mp_4B" 579 "SIGNALS_PFltRgn_lSumRgnBck3_mp_4B" 580 "SIGNALS_PFltRgn_lSumRgnBck4_mp_4B" 581 "SIGNALS_PFltRgn_numRgn_1B" 582 "SIGNALS_PFltRgn_qFl_mp_2B" 583 "SIGNALS_PFltRgn_stIntr_2B" 584 "SIGNALS_PFltRgn_stLck_1B" 585 "SIGNALS_PFlt_ctRgnStep1_mp_1B" 586 "SIGNALS_PFlt_ctRgnStep2_mp_1B" 587 "SIGNALS_PFlt_ctRgnStep3_mp_1B" 588 "SIGNALS_PFlt_ctRgnStep4_mp_1B" 589 "SIGNALS_PFlt_ctRgnStep5_mp_1B" 590 "SIGNALS_PFlt_ctRgnStep6_mp_1B" 591 "SIGNALS_PFlt_ctRgnStep7_mp_1B" 592 "SIGNALS_PFlt_ctRgnStep8_mp_1B" 593 "SIGNALS_PFlt_lAvrgRgn_1B" 594 "SIGNALS_PFlt_lAvrgRgn_2B" 595 "SIGNALS_PFlt_pPreCorr_mp_2B" 596 "SIGNALS_PFlt_stPresPlaus_mp_1B" 597 "SIGNALS_PSP_dvolOut_1B" 598 "SIGNALS_PSP_dvolOut_2B" 599 "SIGNALS_PT_stTraType_1B" 600 "SIGNALS_Pbremsu_2B" 601 "SIGNALS_Pr_bn_soll_1B" 602 "SIGNALS_Ptc_pwr_1B" 603 "SIGNALS_PthSet_stActvMonLim_1B" 604 "SIGNALS_PthSet_trqInrSetNoMo_2B" 605 "SIGNALS_PthSet_trqInrSet_2B" 606 "SIGNALS_QWC_tiPiI1MI1_mp_2B" 607 "SIGNALS_RailP_pCurr_mp_2B" 608 "SIGNALS_RailP_pFlt_1B" 609 "SIGNALS_RailP_pFlt_2B" 610 "SIGNALS_RailP_pLin_2B" 611 "SIGNALS_RailP_stGrad_1B" 612 "SIGNALS_RailP_uRaw_2B" 613 "SIGNALS_Rail_dvolPreCtl_2B" 614 "SIGNALS_Rail_pDvt_2B" 615 "SIGNALS_Rail_pSetPoint_1B" 616 "SIGNALS_Rail_pSetPoint_2B" 617 "SIGNALS_Rail_stCPC_1B" 618 "SIGNALS_Rail_stCtlLoop_1B" 619 "SIGNALS_Rail_stDwn1HpTst_4B" 620 "SIGNALS_Rail_stDwn2HpTst_4B" 621 "SIGNALS_Rail_stDwn3HpTst_4B" 622 "SIGNALS_Rail_stDwnHpTst_0_1B" 623 "SIGNALS_Rail_stDwnHpTst_1_1B" 624 "SIGNALS_Rail_stDwnHpTst_2_1B" 625 "SIGNALS_Rail_stDwnHpTst_3_1B" 626 "SIGNALS_Rail_stDwnHpTst_4_1B" 627 "SIGNALS_Rail_stRefHpTst_2B" 628 "SIGNALS_Rail_stStMHpTst_1B" 629 "SIGNALS_Rail_stUpHpTst_0_1B" 630 "SIGNALS_Rail_stUpHpTst_1_1B" 631 "SIGNALS_Rail_stUpHpTst_2_1B" 632 "SIGNALS_Rail_stUpHpTst_3_1B" 633 "SIGNALS_Rail_stUpHpTst_4_1B" 634 "SIGNALS_Rail_tiDwnHpTst_0_4B" 635 "SIGNALS_Rail_tiDwnHpTst_1_4B" 636 "SIGNALS_Rail_tiDwnHpTst_2_4B" 637 "SIGNALS_Rail_tiDwnHpTst_3_4B" 638 "SIGNALS_Rail_tiDwnHpTst_4_4B" 639 "SIGNALS_Rail_tiDwnHpTst_5_4B" 640 "SIGNALS_Rail_tiDwnHpTst_6_4B" 641 "SIGNALS_Rail_tiUpHpTst_0_4B" 642 "SIGNALS_Rail_tiUpHpTst_1_4B" 643 "SIGNALS_Rail_tiUpHpTst_2_4B" 644 "SIGNALS_Rail_tiUpHpTst_3_4B" 645 "SIGNALS_Reset_Env_adLoc_mp_4B" 646 "SIGNALS_Reset_Env_xId_mp_2B" 647 "SIGNALS_Rf_2B" 648 "SIGNALS_RngMod_trqFrc_2B" 649 "SIGNALS_Shtr_rPs_1B" 650 "SIGNALS_Shtr_rPs_2B" 651 "SIGNALS_Shtr_r_2B" 652 "SIGNALS_SmkLim_qLimSmk_2B" 653 "SIGNALS_SpdGov_trqSet_2B" 654 "SIGNALS_St_dfh0_1B" 655 "SIGNALS_St_msaaa_1B" 656 "SIGNALS_St_msaaad_2B" 657 "SIGNALS_St_msaanz_2B" 658 "SIGNALS_St_msaav_1B" 659 "SIGNALS_St_msaavd1_2B" 660 "SIGNALS_St_msaavd2_2B" 661 "SIGNALS_St_msaavd_4B" 662 "SIGNALS_St_msaea_1B" 663 "SIGNALS_St_msaev_1B" 664 "SIGNALS_St_ngang_1B" 665 "SIGNALS_Stat_entl_1B" 666 "SIGNALS_Stat_sv_reg2_1B" 667 "SIGNALS_SyC_stSub_1B" 668 "SIGNALS_T15_st_1B" 669 "SIGNALS_T_batt_2B" 670 "SIGNALS_ThrVlv_rAct_2B" 671 "SIGNALS_ThrVlv_rPs_1B" 672 "SIGNALS_ThrVlv_rPs_2B" 673 "SIGNALS_Tn_abstell_2B" 674 "SIGNALS_Toel_2B" 675 "SIGNALS_Tra_numGear_1B" 676 "SIGNALS_TrbChLP_rPs_1B" 677 "SIGNALS_TrbChLP_rPs_2B" 678 "SIGNALS_TrbChLP_r_2B" 679 "SIGNALS_TrbCh_rPs_1B" 680 "SIGNALS_TrbCh_rPs_2B" 681 "SIGNALS_TrbCh_rRaw_2B" 682 "SIGNALS_TrbCh_r_2B" 683 "SIGNALS_TrbnDsRLam_rLamRec_2B" 684 "SIGNALS_Tw_2B" 685 "SIGNALS_Tw_agr_2B" 686 "SIGNALS_Tw_agrcntg_4B" 687 "SIGNALS_Tw_agrmax_2B" 688 "SIGNALS_Tw_noagr_2B" 689 "SIGNALS_Tw_noagrcntg_4B" 690 "SIGNALS_Tw_noagrmax_2B" 691 "SIGNALS_U_batt_2B" 692 "SIGNALS_U_bn_soll_1B" 693 "SIGNALS_U_gen_2B" 694 "SIGNALS_Uekp_1B" 695 "SIGNALS_VSwVlv_rAct_2B" 696 "SIGNALS_VSwVlv_rPs_1B" 697 "SIGNALS_VSwVlv_rPs_2B" 698 "SIGNALS_VehV_a_2B" 699 "SIGNALS_VehV_v_2B" 700 "SIGNALS_WaHtEl_rPs_1B" 701 "SIGNALS_WaHtEl_rPs_2B" 702 "SIGNALS_WaHt_stShutOff_mp_2B" /end COMPU_VTAB
/begin RECORD_LAYOUT ValA_Wu16 FNC_VALUES 1 UWORD COLUMN_DIR DIRECT /end RECORD_LAYOUT
/begin RECORD_LAYOUT Val_Wu16 FNC_VALUES 1 UWORD COLUMN_DIR DIRECT /end RECORD_LAYOUT
/end MODULE
/end PROJECT

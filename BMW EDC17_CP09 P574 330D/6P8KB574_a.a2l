ASAP2_VERSION 1 4
/begin PROJECT P_574 "EDC17_CP09"
/begin HEADER "" VERSION "V8KB" PROJECT_NO P_574 /end HEADER
/begin MODULE DIM ""
/begin MOD_PAR "EDC17_CP09" VERSION "V8KB" ADDR_EPK 0x80020C78 EPK "33/1/EDC17_CP09/11/P_574//V8KB///" CUSTOMER_NO "11" USER "" PHONE_NO "" ECU "EDC17_CP09" CPU_TYPE "TriCore"
 SYSTEM_CONSTANT "RMP_RES1" "1.953125"
 SYSTEM_CONSTANT "RMP_RES_1" "0.001"
 SYSTEM_CONSTANT "RMP_RES_1_REV" "1000"
 SYSTEM_CONSTANT "RMP_RES_INV" "65.536"
 SYSTEM_CONSTANT "RNGMOD_ACTVEXCHLOSSCOMP_BP" "1"
 SYSTEM_CONSTANT "RNGMOD_ACTVLDCOMP_BP" "0"
 SYSTEM_CONSTANT "RNGMOD_ADAP" "1"
 SYSTEM_CONSTANT "RNGMOD_NOADAP" "0"
 SYSTEM_CONSTANT "RNGMOD_REFUSEADAP" "2"
 SYSTEM_CONSTANT "RNGMOD_TRQCHEXCHLOSS_MAP_X" "2"
 SYSTEM_CONSTANT "RNGMOD_TRQCHEXCHLOSS_MAP_Y" "2"
 SYSTEM_CONSTANT "RNGMOD_TRQFRCLD_MAP_X" "2"
 SYSTEM_CONSTANT "RNGMOD_TRQFRCLD_MAP_Y" "2"
 SYSTEM_CONSTANT "RNGMOD_TRQFRC_MAP_X" "16"
 SYSTEM_CONSTANT "RNGMOD_TRQFRC_MAP_Y" "16"
 SYSTEM_CONSTANT "RNGMOD_TRQSPD_MAP_X" "21"
 SYSTEM_CONSTANT "RNGMOD_TRQSPD_MAP_Y" "8"
 SYSTEM_CONSTANT "RO2EXHGS_RESLO" "20000"
 SYSTEM_CONSTANT "ROOM_RES" "256"
 SYSTEM_CONSTANT "RPM2SEGTIME" "120000000"
 SYSTEM_CONSTANT "RSLTBUFSIZE" "48"
 SYSTEM_CONSTANT "R_COIL_MAX" "5000"
 SYSTEM_CONSTANT "R_COIL_MIN" "0"
 SYSTEM_CONSTANT "R_LAMREC_MAX" "4"
 SYSTEM_CONSTANT "R_LAMREC_MIN" "0"
 SYSTEM_CONSTANT "R_NO2SOT_RES" "0.0001"
 SYSTEM_CONSTANT "R_NO2TOTMAX_RES" "1e-006"
 SYSTEM_CONSTANT "R_RES" "1"
 SYSTEM_CONSTANT "R_STOICH_FL" "14.5"
 SYSTEM_CONSTANT "SCRCHK_FAC32S2MS" "3200000"
 SYSTEM_CONSTANT "SCRCHK_FAC_100TO1000" "10"
 SYSTEM_CONSTANT "SCRCHK_FAC_100TO10000" "100"
 SYSTEM_CONSTANT "SCRCHK_FAC_DM01TODMNOX" "100"
 SYSTEM_CONSTANT "SCRCHK_FAC_PROD100100TO1000_REV" "10"
 SYSTEM_CONSTANT "SCRCHK_NOXFLW_RES_REV" "1000"
 SYSTEM_CONSTANT "SCRCHK_TEMPRNG_NUM" "2"
 SYSTEM_CONSTANT "SCRFFC_NUMAXISX" "6"
 SYSTEM_CONSTANT "SCRFFC_NUMAXISY" "16"
 SYSTEM_CONSTANT "SCRMON_FACSEC2MSEC" "10"
 SYSTEM_CONSTANT "SCRMON_KGPH2MLPS_SY" "0.277777777777778"
 SYSTEM_CONSTANT "SCRMON_NUMAXIDOSVLV_SY" "4"
 SYSTEM_CONSTANT "SCRMON_NUMAXISPMPMOT_SY" "12"
 SYSTEM_CONSTANT "SCRMON_NUMAXISTEMPWAIT" "16"
 SYSTEM_CONSTANT "SCRMON_VOLCALCRES_SY" "0.0007853981633975"
 SYSTEM_CONSTANT "SCRMON_VOL_RES_REV" "10"
 SYSTEM_CONSTANT "SCRT_CTFLD_NUM" "9"
 SYSTEM_CONSTANT "SCRT_FACCPEGBRICK" "1000"
 SYSTEM_CONSTANT "SCRT_FACDIVBRICK" "50000"
 SYSTEM_CONSTANT "SCRT_FACEXCHENV_REV" "10000"
 SYSTEM_CONSTANT "SCRT_FACINBRICK_REV" "1800"
 SYSTEM_CONSTANT "SCRT_NUMAXIS" "4"
 SYSTEM_CONSTANT "SCRT_TFLD_DS_POS" "1"
 SYSTEM_CONSTANT "SCRT_TFLD_TAVRG_POS" "2"
 SYSTEM_CONSTANT "SCRT_TFLD_US_POS" "0"
 SYSTEM_CONSTANT "SCR_AREA_RES" "0.001"
 SYSTEM_CONSTANT "SCR_AREA_RES_REV" "1000"
 SYSTEM_CONSTANT "SCR_CP_RES" "0.2"
 SYSTEM_CONSTANT "SCR_CP_RES_REV" "5"
 SYSTEM_CONSTANT "SCR_DM005_RES" "0.05"
 SYSTEM_CONSTANT "SCR_DM005_RES_REV" "20"
 SYSTEM_CONSTANT "SCR_DM01_RES" "0.1"
 SYSTEM_CONSTANT "SCR_DM01_RES_REV" "10"
 SYSTEM_CONSTANT "SCR_DMNOX_RES" "0.001"
 SYSTEM_CONSTANT "SCR_DMNOX_RES_REV" "1000"
 SYSTEM_CONSTANT "SCR_FACT1000000_RES" "1e-006"
 SYSTEM_CONSTANT "SCR_FACT1000000_RES_REV" "1000000"
 SYSTEM_CONSTANT "SCR_FACT10000_RES" "0.0001"
 SYSTEM_CONSTANT "SCR_FACT10000_RES_REV" "10000"
 SYSTEM_CONSTANT "SCR_FACT1000_RES" "0.001"
 SYSTEM_CONSTANT "SCR_FACT1000_RES_REV" "1000"
 SYSTEM_CONSTANT "SCR_FACT100_RES" "0.01"
 SYSTEM_CONSTANT "SCR_FACT100_RES_REV" "100"
 SYSTEM_CONSTANT "SCR_FACT10_RES" "0.1"
 SYSTEM_CONSTANT "SCR_FACT10_RES_REV" "10"
 SYSTEM_CONSTANT "SCR_HTC_RES" "0.1"
 SYSTEM_CONSTANT "SCR_HTC_RES_REV" "10"
 SYSTEM_CONSTANT "SCR_KGPH1000_RES" "0.001"
 SYSTEM_CONSTANT "SCR_KGPH1000_RES_REV" "1000"
 SYSTEM_CONSTANT "SCR_MASS10000_RES" "0.0001"
 SYSTEM_CONSTANT "SCR_MASS10000_RES_REV" "10000"
 SYSTEM_CONSTANT "SCR_MASS1000_RES" "0.001"
 SYSTEM_CONSTANT "SCR_MASS1000_RES_REV" "1000"
 SYSTEM_CONSTANT "SCR_MASS100_RES" "0.01"
 SYSTEM_CONSTANT "SCR_MASS100_RES_REV" "100"
 SYSTEM_CONSTANT "SCR_MASSKG_RES" "0.001"
 SYSTEM_CONSTANT "SCR_MASSKG_RES_REV" "1000"
 SYSTEM_CONSTANT "SCR_PERIOD10_RES" "0.1"
 SYSTEM_CONSTANT "SCR_PERIOD10_RES_REV" "10"
 SYSTEM_CONSTANT "SCR_RAT1_RES" "1"
 SYSTEM_CONSTANT "SCR_RHO_RES" "0.01"
 SYSTEM_CONSTANT "SCR_RHO_RES_REV" "100"
 SYSTEM_CONSTANT "SCR_TIME100_RES" "0.01"
 SYSTEM_CONSTANT "SCR_TIME100_RES_REV" "100"
 SYSTEM_CONSTANT "SCR_TIME10_RES" "0.1"
 SYSTEM_CONSTANT "SCR_TIME10_RES_REV" "10"
 SYSTEM_CONSTANT "SEC_RES" "1"
 SYSTEM_CONSTANT "SETPOINTCALC_TRQBASED_SY" "0"
 SYSTEM_CONSTANT "SHTR_ATSINTVMOD_SY" "0"
 SYSTEM_CONSTANT "Signals_Mode1PidSize_SY" "32"
 SYSTEM_CONSTANT "Signals_NumberPID_SY" "28"
 SYSTEM_CONSTANT "Signals_NumberSigNumExt_SY" "702"
 SYSTEM_CONSTANT "Signals_NumberSigNumIntStd_SY" "702"
 SYSTEM_CONSTANT "Signals_NumberSigNumInt_SY" "702"
 SYSTEM_CONSTANT "SILFLP_ATSINTVMOD_SY" "1"
 SYSTEM_CONSTANT "SIXTY" "60000"
 SYSTEM_CONSTANT "SMKLIM_FACENVPCORNEG_CUR_X" "6"
 SYSTEM_CONSTANT "SMKLIM_FACENVPCORPOS_CUR_X" "6"
 SYSTEM_CONSTANT "SMKLIM_FACLAMAPSCOREOM1_CUR_X" "8"
 SYSTEM_CONSTANT "SMKLIM_FACLAMAPSCOREOM2_CUR_X" "8"
 SYSTEM_CONSTANT "SMKLIM_FACLAMAPSCOR_CUR_X" "8"
 SYSTEM_CONSTANT "SMKLIM_FACLAMATSCOREOM1_CUR_X" "8"
 SYSTEM_CONSTANT "SMKLIM_FACLAMATSCOREOM2_CUR_X" "8"
 SYSTEM_CONSTANT "SMKLIM_FACLAMATSCOR_CUR_X" "8"
 SYSTEM_CONSTANT "SMKLIM_FACLAMETSCOR_CUR_X" "8"
 SYSTEM_CONSTANT "SMKLIM_NUMINPVAL" "3"
 SYSTEM_CONSTANT "SMKLIM_RLAMAPSCOREOM1_MAP_X" "16"
 SYSTEM_CONSTANT "SMKLIM_RLAMAPSCOREOM1_MAP_Y" "16"
 SYSTEM_CONSTANT "SMKLIM_RLAMAPSCOREOM2_MAP_X" "16"
 SYSTEM_CONSTANT "SMKLIM_RLAMAPSCOREOM2_MAP_Y" "16"
 SYSTEM_CONSTANT "SMKLIM_RLAMAPSCOR_MAP_X" "16"
 SYSTEM_CONSTANT "SMKLIM_RLAMAPSCOR_MAP_Y" "16"
 SYSTEM_CONSTANT "SMKLIM_RLAMATSCOREOM1_MAP_X" "16"
 SYSTEM_CONSTANT "SMKLIM_RLAMATSCOREOM1_MAP_Y" "16"
 SYSTEM_CONSTANT "SMKLIM_RLAMATSCOREOM2_MAP_X" "16"
 SYSTEM_CONSTANT "SMKLIM_RLAMATSCOREOM2_MAP_Y" "16"
 SYSTEM_CONSTANT "SMKLIM_RLAMATSCOR_MAP_X" "16"
 SYSTEM_CONSTANT "SMKLIM_RLAMATSCOR_MAP_Y" "16"
 SYSTEM_CONSTANT "SMKLIM_RLAMETSCOR_MAP_X" "16"
 SYSTEM_CONSTANT "SMKLIM_RLAMETSCOR_MAP_Y" "16"
 SYSTEM_CONSTANT "SMKLIM_RLAMSMK2EOM1_MAP_X" "16"
 SYSTEM_CONSTANT "SMKLIM_RLAMSMK2EOM1_MAP_Y" "16"
 SYSTEM_CONSTANT "SMKLIM_RLAMSMK2EOM2_MAP_X" "16"
 SYSTEM_CONSTANT "SMKLIM_RLAMSMK2EOM2_MAP_Y" "16"
 SYSTEM_CONSTANT "SMKLIM_RLAMSMK2UPPERGBXEOM1_MAP_X" "16"
 SYSTEM_CONSTANT "SMKLIM_RLAMSMK2UPPERGBXEOM1_MAP_Y" "16"
 SYSTEM_CONSTANT "SMKLIM_RLAMSMK2UPPERGBXEOM2_MAP_X" "16"
 SYSTEM_CONSTANT "SMKLIM_RLAMSMK2UPPERGBXEOM2_MAP_Y" "16"
 SYSTEM_CONSTANT "SMKLIM_RLAMSMK2UPPERGBX_MAP_X" "16"
 SYSTEM_CONSTANT "SMKLIM_RLAMSMK2UPPERGBX_MAP_Y" "16"
 SYSTEM_CONSTANT "SMKLIM_RLAMSMK2_MAP_X" "16"
 SYSTEM_CONSTANT "SMKLIM_RLAMSMK2_MAP_Y" "16"
 SYSTEM_CONSTANT "SMKLIM_RLAMSMKEOM1_MAP_X" "16"
 SYSTEM_CONSTANT "SMKLIM_RLAMSMKEOM1_MAP_Y" "16"
 SYSTEM_CONSTANT "SMKLIM_RLAMSMKEOM2_MAP_X" "16"
 SYSTEM_CONSTANT "SMKLIM_RLAMSMKEOM2_MAP_Y" "16"
 SYSTEM_CONSTANT "SMKLIM_RLAMSMKMIN_MAP_X" "16"
 SYSTEM_CONSTANT "SMKLIM_RLAMSMKMIN_MAP_Y" "16"
 SYSTEM_CONSTANT "SMKLIM_RLAMSMKUPPERGBXEOM1_MAP_X" "16"
 SYSTEM_CONSTANT "SMKLIM_RLAMSMKUPPERGBXEOM1_MAP_Y" "16"
 SYSTEM_CONSTANT "SMKLIM_RLAMSMKUPPERGBXEOM2_MAP_X" "16"
 SYSTEM_CONSTANT "SMKLIM_RLAMSMKUPPERGBXEOM2_MAP_Y" "16"
 SYSTEM_CONSTANT "SMKLIM_RLAMSMKUPPERGBX_MAP_X" "16"
 SYSTEM_CONSTANT "SMKLIM_RLAMSMKUPPERGBX_MAP_Y" "16"
 SYSTEM_CONSTANT "SMKLIM_RLAMSMK_MAP_X" "16"
 SYSTEM_CONSTANT "SMKLIM_RLAMSMK_MAP_Y" "16"
 SYSTEM_CONSTANT "SMKLIM_RLMBDFULLLD_MAP_X" "16"
 SYSTEM_CONSTANT "SMKLIM_RLMBDFULLLD_MAP_Y" "16"
 SYSTEM_CONSTANT "SMKLIM_RLMBDSMK_MAP_X" "16"
 SYSTEM_CONSTANT "SMKLIM_RLMBDSMK_MAP_Y" "16"
 SYSTEM_CONSTANT "SMKLIM_TIAFS_MAP_X" "6"
 SYSTEM_CONSTANT "SMKLIM_TIAFS_MAP_Y" "6"
 SYSTEM_CONSTANT "SMKLIM_TIPT1NEG_MAP_X" "6"
 SYSTEM_CONSTANT "SMKLIM_TIPT1NEG_MAP_Y" "6"
 SYSTEM_CONSTANT "SMKLIM_TIPT1POS_MAP_X" "6"
 SYSTEM_CONSTANT "SMKLIM_TIPT1POS_MAP_Y" "6"
 SYSTEM_CONSTANT "SOOT_GPERLTR_RES" "0.01"
 SYSTEM_CONSTANT "SOOT_GPERLTR_RES_REV" "100"
 SYSTEM_CONSTANT "SOTMPT_RES" "0.01"
 SYSTEM_CONSTANT "SOTRESO_DIVADPT" "36"
 SYSTEM_CONSTANT "SOXMPT_RES" "0.0001"
 SYSTEM_CONSTANT "SOXMPT_RES_REV" "10000"
 SYSTEM_CONSTANT "SPDGOV_CORESEL_SY" "1"
 SYSTEM_CONSTANT "SPDGOV_LOWIDLE" "0"
 SYSTEM_CONSTANT "SPDGOV_NAGS_BP" "5"
 SYSTEM_CONSTANT "SPDGOV_NDIA_BP" "4"
 SYSTEM_CONSTANT "SPDGOV_NEGCURRTRQENA" "6"
 SYSTEM_CONSTANT "SPDGOV_NEGLDTRQENA" "5"
 SYSTEM_CONSTANT "SPDGOV_NGSH" "2"
 SYSTEM_CONSTANT "SPDGOV_NGSH_BP" "2"
 SYSTEM_CONSTANT "SPDGOV_NMAX" "1"
 SYSTEM_CONSTANT "SPDGOV_NSETP_ARRAY_AGSDEM_POS" "5"
 SYSTEM_CONSTANT "SPDGOV_NSETP_ARRAY_CURR_POS" "0"
 SYSTEM_CONSTANT "SPDGOV_NSETP_ARRAY_DIADEM_POS" "4"
 SYSTEM_CONSTANT "SPDGOV_NSETP_ARRAY_GSHDEM_POS" "2"
 SYSTEM_CONSTANT "SPDGOV_NSETP_ARRAY_HLSDEM_POS" "1"
 SYSTEM_CONSTANT "SPDGOV_NSETP_ARRAY_WESDEM_POS" "3"
 SYSTEM_CONSTANT "SPDGOV_NWORK" "3"
 SYSTEM_CONSTANT "SPDGOV_OVRDS_PTPRT" "0"
 SYSTEM_CONSTANT "SPDGOV_RESVCONSTDEM" "8"
 SYSTEM_CONSTANT "SPDGOV_RESVRELDEM" "7"
 SYSTEM_CONSTANT "SPDGOV_SETPHI_ARRAYSIZE" "6"
 SYSTEM_CONSTANT "SPDGOV_SETPLO_ARRAYSIZE" "6"
 SYSTEM_CONSTANT "SPDGOV_TRQDEM" "4"
 SYSTEM_CONSTANT "SPDGOV_TRQFLT_BP" "2"
 SYSTEM_CONSTANT "SPDGOV_TRQLEAD_BP" "1"
 SYSTEM_CONSTANT "SPDGOV_TRQSET_BP" "0"
 SYSTEM_CONSTANT "SPDIDX0" "16"
 SYSTEM_CONSTANT "SPDIDX1" "32"
 SYSTEM_CONSTANT "SPDIDX10" "21"
 SYSTEM_CONSTANT "SPDIDX2" "17"
 SYSTEM_CONSTANT "SPDIDX3" "33"
 SYSTEM_CONSTANT "SPDIDX4" "18"
 SYSTEM_CONSTANT "SPDIDX5" "34"
 SYSTEM_CONSTANT "SPDIDX6" "19"
 SYSTEM_CONSTANT "SPDIDX7" "35"
 SYSTEM_CONSTANT "SPDIDX8" "20"
 SYSTEM_CONSTANT "SPDIDX9" "36"
 SYSTEM_CONSTANT "SPDIDXHI" "49"
 SYSTEM_CONSTANT "SPDIDXLO" "48"
 SYSTEM_CONSTANT "SPECHEATFINE_RES" "0.2"
 SYSTEM_CONSTANT "SPECHEATFINE_RES_REV" "5"
 SYSTEM_CONSTANT "SPECHEAT_RES" "2"
 SYSTEM_CONSTANT "SPECHEAT_RES_FL" "2"
 SYSTEM_CONSTANT "SPECIFICHEAT_RES" "0.0001"
 SYSTEM_CONSTANT "SQRVLTG_S_RES" "0.1"
 SYSTEM_CONSTANT "SQRVLTG_S_ZERO" "0"
 SYSTEM_CONSTANT "SSWTS_TYPE_DATASET" "2"
 SYSTEM_CONSTANT "SSWTS_TYPE_EEP" "1"
 SYSTEM_CONSTANT "STAPMP_FACTRQPHISTE_MAP_X" "5"
 SYSTEM_CONSTANT "STAPMP_FACTRQPHISTE_MAP_Y" "5"
 SYSTEM_CONSTANT "STAPMP_FACTRQSTE_MAP_X" "5"
 SYSTEM_CONSTANT "STAPMP_FACTRQSTE_MAP_Y" "5"
 SYSTEM_CONSTANT "STEEP_ADAPT" "1"
 SYSTEM_CONSTANT "STEEP_HOLD" "2"
 SYSTEM_CONSTANT "STROKE_PML_RES" "0.1"
 SYSTEM_CONSTANT "STROKE_PML_RES_REV" "10"
 SYSTEM_CONSTANT "STRTTRQ_OFF" "0"
 SYSTEM_CONSTANT "STRTTRQ_ON" "1"
 SYSTEM_CONSTANT "STRT_ATSINTVMOD_SY" "0"
 SYSTEM_CONSTANT "STSP_SY" "0"
 SYSTEM_CONSTANT "STSYS_NSTRTCUTOUT_MAP_X" "4"
 SYSTEM_CONSTANT "STSYS_NSTRTCUTOUT_MAP_Y" "4"
 SYSTEM_CONSTANT "STSYS_STRTTIP_ACTV" "1"
 SYSTEM_CONSTANT "STSYS_STRTTIP_NACTV" "0"
 SYSTEM_CONSTANT "STSYS_TRQSTRTBAS_MAP_X" "8"
 SYSTEM_CONSTANT "STSYS_TRQSTRTBAS_MAP_Y" "10"
 SYSTEM_CONSTANT "STWHL_DPHI_ZERO" "0"
 SYSTEM_CONSTANT "STWHL_PHI_ZERO" "0"
 SYSTEM_CONSTANT "ST_CHGREG" "4"
 SYSTEM_CONSTANT "ST_DYN" "1"
 SYSTEM_CONSTANT "ST_NOVRRUN" "2"
 SYSTEM_CONSTANT "ST_REGNV" "8"
 SYSTEM_CONSTANT "ST_RES_MAX" "2.5"
 SYSTEM_CONSTANT "ST_RES_MIN" "0"
 SYSTEM_CONSTANT "ST_RES_RES" "0.0001"
 SYSTEM_CONSTANT "ST_RES_RES_INV" "10000"
 SYSTEM_CONSTANT "SWT_DISABLED" "0"
 SYSTEM_CONSTANT "SWT_ENABLED" "1"
 SYSTEM_CONSTANT "SWT_TYPE_APPL" "2"
 SYSTEM_CONSTANT "SWT_TYPE_DATASET" "0"
 SYSTEM_CONSTANT "SWT_TYPE_EEP" "1"
 SYSTEM_CONSTANT "TAA_CFG_SPDRNG" "1"
 SYSTEM_CONSTANT "TAA_ENTRY_PHIDVT" "84"
 SYSTEM_CONSTANT "TAA_ENTRY_TINC" "60"
 SYSTEM_CONSTANT "TAA_FACSINTAB_CAX" "30"
 SYSTEM_CONSTANT "TAA_FSTLRNURG" "25"
 SYSTEM_CONSTANT "TAA_INC_CMB" "30"
 SYSTEM_CONSTANT "TAA_INC_GAPHDL" "5"
 SYSTEM_CONSTANT "TAA_MAX_INC" "60"
 SYSTEM_CONSTANT "TAA_NUM_MAXGAP" "3"
 SYSTEM_CONSTANT "TAA_NUM_SPDRNG" "3"
 SYSTEM_CONSTANT "TAA_PHIMAX" "1"
 SYSTEM_CONSTANT "TAFSCOR_DELTATEMP_RES" "100"
 SYSTEM_CONSTANT "TAFSCOR_HEATFLOW_INTER_RES" "360"
 SYSTEM_CONSTANT "TAFSCOR_HEATFLOW_RES" "1000"
 SYSTEM_CONSTANT "TAFSCOR_HEATRANSCMPR_INTER1_RES" "81920"
 SYSTEM_CONSTANT "TAFSCOR_HEATRANSCMPR_RES" "1"
 SYSTEM_CONSTANT "TAFSCOR_INTER_RES" "1"
 SYSTEM_CONSTANT "TCPRT_NTSCOFS_CUR_X" "6"
 SYSTEM_CONSTANT "TCPRT_RCHRGPMPCTLVAL_MAP_X" "10"
 SYSTEM_CONSTANT "TCPRT_RCHRGPMPCTLVAL_MAP_Y" "10"
 SYSTEM_CONSTANT "TCSOVRDSTSCINC_SY" "1"
 SYSTEM_CONSTANT "TCS_OVRDS_TSCINC" "1"
 SYSTEM_CONSTANT "TEGMOD_ALPHAEGPIPE_RES" "1280"
 SYSTEM_CONSTANT "TEGMOD_ALPHAPIPEENV_RES" "52428.8"
 SYSTEM_CONSTANT "TEGMOD_AREAPIPE_RES" "201.06192982976"
 SYSTEM_CONSTANT "TEGMOD_CMPRPWR_RES" "76747.2972710018"
 SYSTEM_CONSTANT "TEGMOD_DELTATEMP_RES" "100"
 SYSTEM_CONSTANT "TEGMOD_FACPT1_RES" "2812.5"
 SYSTEM_CONSTANT "TEGMOD_HEATFLOWKW_RES" "100000"
 SYSTEM_CONSTANT "TEGMOD_HEATFLOW_INTER_RES" "360"
 SYSTEM_CONSTANT "TEGMOD_HEATFLOW_RES" "1000"
 SYSTEM_CONSTANT "TEGMOD_HEATKJ_RES" "100"
 SYSTEM_CONSTANT "TEGMOD_HEATRANSOXIC_INTER1_RES" "81920"
 SYSTEM_CONSTANT "TEGMOD_HEATRANSOXIC_RES" "1"
 SYSTEM_CONSTANT "TEGMOD_HEATRANS_INTER_RES" "8192"
 SYSTEM_CONSTANT "TEGMOD_HEATRANS_RES" "10"
 SYSTEM_CONSTANT "TEGMOD_INTER1_RES" "0.01"
 SYSTEM_CONSTANT "TEGMOD_INTER_RES" "1"
 SYSTEM_CONSTANT "TEGMOD_PT1TIMECONST_RES" "335.54432"
 SYSTEM_CONSTANT "TEGMOD_REPIPEENV_RES" "17777.7777777778"
 SYSTEM_CONSTANT "TEGMOD_REPIPE_RES" "370.857896905592"
 SYSTEM_CONSTANT "TEGMOD_TEMPEG_INTER_RES" "2812.5"
 SYSTEM_CONSTANT "TEGMOD_TEMPEG_RES" "128"
 SYSTEM_CONSTANT "TEGMOD_TEMPTRBN_INTER_RES" "10485.76"
 SYSTEM_CONSTANT "TEGMOD_TEMPTRBN_RES" "9424.77796077"
 SYSTEM_CONSTANT "TEMP_20_CELS" "20"
 SYSTEM_CONSTANT "TEMP_CELS_OFFSET" "-273.14"
 SYSTEM_CONSTANT "TEMP_CELS_RES" "0.1"
 SYSTEM_CONSTANT "TEMP_CELS_ZERO" "0"
 SYSTEM_CONSTANT "TEMP_ETCTL_SY" "25"
 SYSTEM_CONSTANT "TEMP_HIGH_RES" "0.01"
 SYSTEM_CONSTANT "TEMP_KELV_SEC_CTT_MON_RES" "0"
 SYSTEM_CONSTANT "TEMP_KELV_SEC_CTT_MON_RES_REV" "40960"
 SYSTEM_CONSTANT "TEMP_LOW_RES" "0.1"
 SYSTEM_CONSTANT "TEMP_NULL_C" "-273.14"
 SYSTEM_CONSTANT "TEMP_NULL_C_FL" "-273.14"
 SYSTEM_CONSTANT "TEMP_NULL_F" "-459.652"
 SYSTEM_CONSTANT "TEMP_PA_MAX" "180"
 SYSTEM_CONSTANT "TEMP_PA_MIN" "-40"
 SYSTEM_CONSTANT "TEMP_PA_ZERO" "0"
 SYSTEM_CONSTANT "TEMP_RES" "0.1"
 SYSTEM_CONSTANT "TEMP_RES_FL" "0.1"
 SYSTEM_CONSTANT "TEMP_RES_INV" "10"
 SYSTEM_CONSTANT "TEMP_RES_REV" "10"
 SYSTEM_CONSTANT "TEMP_WVCOR_MAX" "140"
 SYSTEM_CONSTANT "TEMP_WVCOR_MIN" "-40"
 SYSTEM_CONSTANT "TEMP_ZERO" "-273.14"
 SYSTEM_CONSTANT "TEMP_ZERO_KELV" "0"
 SYSTEM_CONSTANT "TEN_THOUSAND" "10000"
 SYSTEM_CONSTANT "THERMAL_COEFF_ONE" "1"
 SYSTEM_CONSTANT "THERMAL_COEFF_RES" "0.1"
 SYSTEM_CONSTANT "THMCND_RES" "0.001"
 SYSTEM_CONSTANT "THMCND_RES_FL" "0.001"
 SYSTEM_CONSTANT "THOUSAND" "1000"
 SYSTEM_CONSTANT "THRVLV_ATSINTVMOD_SY" "0"
 SYSTEM_CONSTANT "TIME100HRS_ENG_ON_RES" "1"
 SYSTEM_CONSTANT "TIMEDELAY_MS_LIN_16_MAX" "12207.4037903989"
 SYSTEM_CONSTANT "TIMEDELAY_MS_LIN_16_REC_RES" "4294967.296"
 SYSTEM_CONSTANT "TIMEDELAY_MS_LIN_16_RES" "0.610370189519944"
 SYSTEM_CONSTANT "TIMEDELAY_S_2_MIN" "0.001"
 SYSTEM_CONSTANT "TIMEDELAY_S_2_NRM" "8"
 SYSTEM_CONSTANT "TIMEDELAY_S_LIN_16_2_MAX" "122.074037903989"
 SYSTEM_CONSTANT "TIMEDELAY_S_LIN_16_2_RES" "0"
 SYSTEM_CONSTANT "TIMEDELAY_S_LIN_16_MAX" "5"
 SYSTEM_CONSTANT "TIMEDELAY_S_LIN_16_MAX_ASDDC" "1.5"
 SYSTEM_CONSTANT "TIMEDELAY_S_LIN_16_MAX_ASDRF" "1.5"
 SYSTEM_CONSTANT "TIMEDELAY_S_LIN_16_REC_RES" "4294.967296"
 SYSTEM_CONSTANT "TIMEDELAY_S_LIN_16_RES" "0.000152592547379986"
 SYSTEM_CONSTANT "TIMEDT_RES" "1e-006"
 SYSTEM_CONSTANT "TIMEDT_RES_REV" "1000000"
 SYSTEM_CONSTANT "TIMEENGON_RES_REV" "1"
 SYSTEM_CONSTANT "TIMEFAC_MS2S" "100"
 SYSTEM_CONSTANT "TIMEHRS_ENG_ON_RES" "100"
 SYSTEM_CONSTANT "TIME_1S_RES" "1"
 SYSTEM_CONSTANT "TIME_20ms_CYCLE" "20000"
 SYSTEM_CONSTANT "TIME_CONV_KGH2GS" "3.6"
 SYSTEM_CONSTANT "TIME_DEB_10MS" "10000"
 SYSTEM_CONSTANT "TIME_DEB_NULL" "0"
 SYSTEM_CONSTANT "TIME_DEB_RES" "10"
 SYSTEM_CONSTANT "TIME_DEB_ZERO" "0"
 SYSTEM_CONSTANT "TIME_DT_1000MS" "1000000"
 SYSTEM_CONSTANT "TIME_DT_100MS" "100000"
 SYSTEM_CONSTANT "TIME_DT_10MS" "10000"
 SYSTEM_CONSTANT "TIME_DT_1MS" "1000"
 SYSTEM_CONSTANT "TIME_DT_200MS" "200000"
 SYSTEM_CONSTANT "TIME_DT_20MS" "20000"
 SYSTEM_CONSTANT "TIME_DT_2MS" "2000"
 SYSTEM_CONSTANT "TIME_DT_50MS" "50000"
 SYSTEM_CONSTANT "TIME_DT_5MS" "5000"
 SYSTEM_CONSTANT "TIME_DT_RES" "1"
 SYSTEM_CONSTANT "TIME_DT_RES_FL" "1"
 SYSTEM_CONSTANT "TIME_DT_S" "1000000"
 SYSTEM_CONSTANT "TIME_ENG_ON_RES" "1"
 SYSTEM_CONSTANT "TIME_GPTA_CLOCK_50ns" "0.05"
 SYSTEM_CONSTANT "TIME_GT0_CLOCK_400ns" "0.0004"
 SYSTEM_CONSTANT "TIME_HR_MAX" "16383"
 SYSTEM_CONSTANT "TIME_HR_MIN" "0"
 SYSTEM_CONSTANT "TIME_HR_RES" "0.5"
 SYSTEM_CONSTANT "TIME_HR_RES_REV" "2"
 SYSTEM_CONSTANT "TIME_MS_10MS" "10"
 SYSTEM_CONSTANT "TIME_MS_MAX" "327460"
 SYSTEM_CONSTANT "TIME_MS_SMAX" "327460"
 SYSTEM_CONSTANT "TIME_MS_ZERO" "0"
 SYSTEM_CONSTANT "TIME_PFLTLIMPHOME_RES" "10"
 SYSTEM_CONSTANT "TIME_PWM_HIGH_RES" "5e-008"
 SYSTEM_CONSTANT "TIME_PZOCHRGPSE_MAX" "20"
 SYSTEM_CONSTANT "TIME_PZOCHRGPSE_MIN" "2"
 SYSTEM_CONSTANT "TIME_PZOCHRGPSE_RES" "0.01"
 SYSTEM_CONSTANT "TIME_PZOCHRGPSE_ZERO" "0"
 SYSTEM_CONSTANT "TIME_PZOMEAS_RES" "0.0546"
 SYSTEM_CONSTANT "TIME_RED_MAX" "3600"
 SYSTEM_CONSTANT "TIME_RED_NRM" "4"
 SYSTEM_CONSTANT "TIME_RED_RES" "0.16"
 SYSTEM_CONSTANT "TIME_RED_RES_REV" "6.25"
 SYSTEM_CONSTANT "TIME_RED_ZERO" "0"
 SYSTEM_CONSTANT "TIME_RES_FL" "1e-006"
 SYSTEM_CONSTANT "TIME_RMP_RES" "53687091.2"
 SYSTEM_CONSTANT "TIME_SEC2HR" "1800"
 SYSTEM_CONSTANT "TIME_S_1_RES" "0.001"
 SYSTEM_CONSTANT "TIME_S_MAX" "327.46"
 SYSTEM_CONSTANT "TIME_S_ONE" "1"
 SYSTEM_CONSTANT "TIME_S_RES_REV" "100"
 SYSTEM_CONSTANT "TIME_S_TIACTRGN" "0.01"
 SYSTEM_CONSTANT "TIME_S_ZERO" "0"
 SYSTEM_CONSTANT "TIME_TEMPSNCERGN16_RES" "40"
 SYSTEM_CONSTANT "TIME_TEMPSNCERGN2FACT" "5"
 SYSTEM_CONSTANT "TIME_TEMPSNCERGN_FACT8" "8"
 SYSTEM_CONSTANT "TIME_TEMPSNCERGN_RES_REV" "1600"
 SYSTEM_CONSTANT "TIME_TICK" "10"
 SYSTEM_CONSTANT "TIME_TICK_S" "0.01"
 SYSTEM_CONSTANT "TIME_TICK_SEC_INV" "100"
 SYSTEM_CONSTANT "TIME_TINO2RGN_FACT11" "11"
 SYSTEM_CONSTANT "TIME_US_400NS_RES" "400"
 SYSTEM_CONSTANT "TIME_US_RES" "1"
 SYSTEM_CONSTANT "TIME_US_ZERO" "0"
 SYSTEM_CONSTANT "TIOP2MOILASH" "200000"
 SYSTEM_CONSTANT "TI_DIFF_HYD_MAX" "5000"
 SYSTEM_CONSTANT "TI_DIFF_HYD_MIN" "-5000"
 SYSTEM_CONSTANT "TI_PII_EARL_REL" "13000"
 SYSTEM_CONSTANT "TI_POI2_LATE_REL" "-13000"
 SYSTEM_CONSTANT "TI_RMPSLP_MAX" "40"
 SYSTEM_CONSTANT "TI_RMPSLP_MIN" "1"
 SYSTEM_CONSTANT "TKM2HR" "100000"
 SYSTEM_CONSTANT "TOXICMOD_HEATFLOWHCCNV_RES" "10"
 SYSTEM_CONSTANT "TOXICMOD_HEATFLOW_RES" "36"
 SYSTEM_CONSTANT "TOXICMOD_REMOXY_RES" "335600"
 SYSTEM_CONSTANT "TOXICMOD_RES" "3.356"
 SYSTEM_CONSTANT "TOXICMOD_UNBRNFL_RES" "100"
 SYSTEM_CONSTANT "TRANS_R_MAX" "32767"
 SYSTEM_CONSTANT "TRANS_R_ONE" "1"
 SYSTEM_CONSTANT "TRANS_R_RES" "0.01"
 SYSTEM_CONSTANT "TRANS_R_RES_REV" "100"
 SYSTEM_CONSTANT "TRAPRT_OVRDS_DCS" "0"
 SYSTEM_CONSTANT "TRATYPE_AST_SY" "2"
 SYSTEM_CONSTANT "TRATYPE_AT_SY" "1"
 SYSTEM_CONSTANT "TRATYPE_CVT_SY" "3"
 SYSTEM_CONSTANT "TRATYPE_DKG_SY" "4"
 SYSTEM_CONSTANT "TRATYPE_MT_SY" "0"
 SYSTEM_CONSTANT "TRATYPE_NEW2_SY" "5"
 SYSTEM_CONSTANT "TRATYPE_NEW3_SY" "6"
 SYSTEM_CONSTANT "TRATYPE_NEW4_SY" "7"
 SYSTEM_CONSTANT "TRA_ASTINTVACTV_BP" "0"
 SYSTEM_CONSTANT "TRA_ASTNEUTR_BP" "1"
 SYSTEM_CONSTANT "TRA_LORNGACT_MSK" "2"
 SYSTEM_CONSTANT "TRA_NMINBRK_MAP_X" "4"
 SYSTEM_CONSTANT "TRA_NMINBRK_MAP_Y" "8"
 SYSTEM_CONSTANT "TRA_NMIN_MAP_X" "4"
 SYSTEM_CONSTANT "TRA_NMIN_MAP_Y" "8"
 SYSTEM_CONSTANT "TRA_NUMSPALOWGEAR_CUR_X" "7"
 SYSTEM_CONSTANT "TRA_NUMSPAMAXGEAR_CUR_X" "7"
 SYSTEM_CONSTANT "TRA_STNSETP_FLT" "0"
 SYSTEM_CONSTANT "TRA_STNSETP_TIPIN" "2"
 SYSTEM_CONSTANT "TRA_STNSETP_UNFLT" "1"
 SYSTEM_CONSTANT "TRA_TRQFRC_DFLVAL" "0"
 SYSTEM_CONSTANT "TRA_TRQGEARBXMAX_ERRVAL" "1000"
 SYSTEM_CONSTANT "TRA_TSCPTD_BP" "0"
 SYSTEM_CONSTANT "TRBCHLP_ATSINTVMOD_SY" "1"
 SYSTEM_CONSTANT "TRBCH_ATSINTVMOD_SY" "0"
 SYSTEM_CONSTANT "TRQINRFACT_EXP" "8"
 SYSTEM_CONSTANT "TRQINRFACT_RES" "256"
 SYSTEM_CONSTANT "TRQINRKD_RES" "1.52587890625e-006"
 SYSTEM_CONSTANT "TRQINRKD_RES_16" "2.44140625e-005"
 SYSTEM_CONSTANT "TRQINRKI_RES" "4.65661287307739e-005"
 SYSTEM_CONSTANT "TRQINRKI_RES_8" "0.000372529029846191"
 SYSTEM_CONSTANT "TRQINRKP_RES" "3.0517578125e-006"
 SYSTEM_CONSTANT "TRQINRKP_RES_128" "0.000390625"
 SYSTEM_CONSTANT "TRQPRPHIGH_MAX" "50000"
 SYSTEM_CONSTANT "TRQPRPHIGH_MIN" "-50000"
 SYSTEM_CONSTANT "TRQPRPHIGH_RES" "0.1"
 SYSTEM_CONSTANT "TRQPRPHIGH_ZERO" "0"
 SYSTEM_CONSTANT "TRQPRP_NRM" "4"
 SYSTEM_CONSTANT "TRQPRP_RES" "1.6"
 SYSTEM_CONSTANT "TRQPRP_ZERO" "0"
 SYSTEM_CONSTANT "TRQSEL_SY" "1"
 SYSTEM_CONSTANT "TRQTONSQR_RES" "1e-007"
 SYSTEM_CONSTANT "TRQWHL_ZERO" "0"
 SYSTEM_CONSTANT "TRQ_400" "400"
 SYSTEM_CONSTANT "TRQ_FRC_INI" "-50"
 SYSTEM_CONSTANT "TRQ_MAX" "1000"
 SYSTEM_CONSTANT "TRQ_MIN" "-500"
 SYSTEM_CONSTANT "TRQ_RES" "0.1"
 SYSTEM_CONSTANT "TRQ_RES_REV" "10"
 SYSTEM_CONSTANT "TRQ_WOTRAINTV_SY" "1"
 SYSTEM_CONSTANT "TRQ_ZERO" "0"
 SYSTEM_CONSTANT "TSCDEC_OVRDS_DCS" "0"
 SYSTEM_CONSTANT "TSCINC_OVRDS_DFFTLPRT" "0"
 SYSTEM_CONSTANT "TSCINC_OVRDS_TCS" "0"
 SYSTEM_CONSTANT "TS_RES_REV" "1"
 SYSTEM_CONSTANT "TTRBN_HEATFLOW_RES" "94247.7796077"
 SYSTEM_CONSTANT "TTRBN_INTER_RES" "1"
 SYSTEM_CONSTANT "TURBODN_RES" "500"
 SYSTEM_CONSTANT "TURBON_RES" "10"
 SYSTEM_CONSTANT "TVACD_DCYCCONV_CUR_X" "25"
 SYSTEM_CONSTANT "TWO_EXP_16" "65536"
 SYSTEM_CONSTANT "TWO_PI" "314.159265359"
 SYSTEM_CONSTANT "TWO_POW_NRM_EXP_RES_TRIGO_FUNC" "4096"
 SYSTEM_CONSTANT "T_1SEC_RESO_SY" "1000000"
 SYSTEM_CONSTANT "T_AIR_MAX" "199.86"
 SYSTEM_CONSTANT "T_AIR_MIN" "-50.14"
 SYSTEM_CONSTANT "T_CLNT_MAX" "149.86"
 SYSTEM_CONSTANT "T_CLNT_MIN" "-50.14"
 SYSTEM_CONSTANT "T_EGAS_MAX" "1273"
 SYSTEM_CONSTANT "T_EGAS_MIN" "223"
 SYSTEM_CONSTANT "T_EGR_MIN" "-50"
 SYSTEM_CONSTANT "T_EGTGOV" "25"
 SYSTEM_CONSTANT "T_EGT_CORMAX_C" "0.5"
 SYSTEM_CONSTANT "T_EGT_CORMIN_C" "0"
 SYSTEM_CONSTANT "T_EGT_WINNEG" "-1000"
 SYSTEM_CONSTANT "T_EGT_WINPOS" "1000"
 SYSTEM_CONSTANT "T_ENG_MAX" "199.86"
 SYSTEM_CONSTANT "T_ENG_MIN" "-50.14"
 SYSTEM_CONSTANT "T_ETCTL_WINNEG_MAX" "100"
 SYSTEM_CONSTANT "T_ETCTL_WINNEG_MIN" "-1000"
 SYSTEM_CONSTANT "T_ETCTL_WINPOS_MAX" "1000"
 SYSTEM_CONSTANT "T_ETCTL_WINPOS_MIN" "-100"
 SYSTEM_CONSTANT "T_EXHGS_MAX" "1050"
 SYSTEM_CONSTANT "T_EXHGS_MIN" "-45"
 SYSTEM_CONSTANT "T_FUEL_MAX" "149.86"
 SYSTEM_CONSTANT "T_FUEL_MIN" "-50.14"
 SYSTEM_CONSTANT "T_GOVIO_MAX" "1500"
 SYSTEM_CONSTANT "T_GOVIO_MIN" "-100"
 SYSTEM_CONSTANT "T_GOV_MAX" "1500"
 SYSTEM_CONSTANT "T_GOV_MIN" "-100"
 SYSTEM_CONSTANT "T_INRCORMAX_MAX" "1500"
 SYSTEM_CONSTANT "T_INRCORMAX_MIN" "-100"
 SYSTEM_CONSTANT "T_INRCORMIN_MAX" "0"
 SYSTEM_CONSTANT "T_INRCORMIN_MIN" "-1500"
 SYSTEM_CONSTANT "T_LAMBDA_MAX" "1300"
 SYSTEM_CONSTANT "T_LAMBDA_MIN" "100"
 SYSTEM_CONSTANT "T_SURF_MAX" "800"
 SYSTEM_CONSTANT "T_SURF_MIN" "100"
 SYSTEM_CONSTANT "T_TEMPDIFF_NULL" "0"
 SYSTEM_CONSTANT "T_TEMP_NORM" "298"
 SYSTEM_CONSTANT "UBATT_ADC_REF" "20000"
 SYSTEM_CONSTANT "UBATT_MAX" "20782"
 SYSTEM_CONSTANT "UDC_TNKLVLAVRG_FLD" "5"
 SYSTEM_CONSTANT "UDOSVLV_ATSINTVMOD_SY" "1"
 SYSTEM_CONSTANT "UHC_TIDFRSTMIN_SY" "60"
 SYSTEM_CONSTANT "UINT2CHG_PA_FAC" "80"
 SYSTEM_CONSTANT "UI_CURR_ADCMAX" "30000"
 SYSTEM_CONSTANT "UI_CURR_HWOFF" "34000"
 SYSTEM_CONSTANT "UNIT_KM" "1"
 SYSTEM_CONSTANT "UPMPMOT_ATSINTVMOD_SY" "1"
 SYSTEM_CONSTANT "URTNKLVL_SENSTYP_SY" "1"
 SYSTEM_CONSTANT "USEC2MSEC" "1000"
 SYSTEM_CONSTANT "U_ADC_MAX" "5200"
 SYSTEM_CONSTANT "U_ADC_MIN" "0"
 SYSTEM_CONSTANT "U_ADC_REF" "5000"
 SYSTEM_CONSTANT "U_GCVOLT_REF" "5000"
 SYSTEM_CONSTANT "U_INTEGADJ_FAC" "5"
 SYSTEM_CONSTANT "U_RATED" "14000"
 SYSTEM_CONSTANT "U_RATED_PASS" "14000"
 SYSTEM_CONSTANT "U_RATED_TRUCK" "28000"
 SYSTEM_CONSTANT "U_TO_RESIST_RES" "0.001"
 SYSTEM_CONSTANT "U_TO_RESIST_REV_RES" "1000"
 SYSTEM_CONSTANT "V2N_NORM" "2000"
 SYSTEM_CONSTANT "V2N_RES" "1e-005"
 SYSTEM_CONSTANT "V2N_ZERO" "0"
 SYSTEM_CONSTANT "VEHMOT_DCS_BP" "1"
 SYSTEM_CONSTANT "VEHMOT_PI" "3.14159562"
 SYSTEM_CONSTANT "VEHMOT_TCS_BP" "0"
 SYSTEM_CONSTANT "VEHMOT_V_MIN" "3"
 SYSTEM_CONSTANT "VEHV_ACC_RES" "100"
 SYSTEM_CONSTANT "VELOCITY_RES" "0.0056"
 SYSTEM_CONSTANT "VELOCITY_RES_FL" "0.0056"
 SYSTEM_CONSTANT "VEL_KMH_RES" "0.036"
 SYSTEM_CONSTANT "VEL_MAX" "300"
 SYSTEM_CONSTANT "VEL_MIN" "0"
 SYSTEM_CONSTANT "VEL_MPS_RES" "100"
 SYSTEM_CONSTANT "VEL_RES" "0.01"
 SYSTEM_CONSTANT "VEL_RES_REV" "100"
 SYSTEM_CONSTANT "VEL_RES_SI" "0.00277777777777778"
 SYSTEM_CONSTANT "VEL_ZERO" "0"
 SYSTEM_CONSTANT "VLTG_PA_MAX" "250"
 SYSTEM_CONSTANT "VLTG_PA_MIN" "-250"
 SYSTEM_CONSTANT "VLTG_PA_RES" "0.01"
 SYSTEM_CONSTANT "VLTG_PA_ZERO" "0"
 SYSTEM_CONSTANT "VLV_VEL_RES" "0.1"
 SYSTEM_CONSTANT "VMSI_DCSPTD_BP" "0"
 SYSTEM_CONSTANT "VMSI_DCS_BP" "1"
 SYSTEM_CONSTANT "VMSI_STCFG_DCSSHOFFRMPENA_BP" "0"
 SYSTEM_CONSTANT "VMSI_TCS_BP" "0"
 SYSTEM_CONSTANT "VOLADD_ML_FINE_RES" "0.001"
 SYSTEM_CONSTANT "VOLADD_ML_FINE_RES_REV" "1000"
 SYSTEM_CONSTANT "VOLFINE_RES" "0.0001"
 SYSTEM_CONSTANT "VOLFINE_RES_FL" "0.0001"
 SYSTEM_CONSTANT "VOLT_ADC_RES" "0.2"
 SYSTEM_CONSTANT "VOLT_BATT_RES" "20"
 SYSTEM_CONSTANT "VOLT_BATT_RES_REV" "0.05"
 SYSTEM_CONSTANT "VOLT_ZERO" "0"
 SYSTEM_CONSTANT "VOL_ADD_RES" "0.1"
 SYSTEM_CONSTANT "VOL_FL_L_TO_FL_2" "1000"
 SYSTEM_CONSTANT "VOL_MAX" "100"
 SYSTEM_CONSTANT "VOL_MIN" "0"
 SYSTEM_CONSTANT "VOL_PFLT_MAX" "100"
 SYSTEM_CONSTANT "VOL_PFLT_MIN" "0.01"
 SYSTEM_CONSTANT "VOL_RES" "0.01"
 SYSTEM_CONSTANT "VOL_ZERO" "0"
 SYSTEM_CONSTANT "VSACD_DCYCCONV_CUR_X" "25"
 SYSTEM_CONSTANT "VSWCTL_FACENGTEMPCTLCOR_CUR_X" "8"
 SYSTEM_CONSTANT "VSWCTL_FACENVPRESCTLCOREOM_CUR_X" "25"
 SYSTEM_CONSTANT "VSWCTL_FACENVPRESCTLCOR_CUR_X" "8"
 SYSTEM_CONSTANT "VSWCTL_FACRMPVALCTLCOR_CUR_X" "13"
 SYSTEM_CONSTANT "VSWCTL_FACVEHTEMPCORR_CUR_X" "2"
 SYSTEM_CONSTANT "VSWCTL_FACVEHVCORR_CUR_X" "4"
 SYSTEM_CONSTANT "VSWCTL_NUMSTPRIOMON" "7"
 SYSTEM_CONSTANT "VSWCTL_RCTLBASEOM_MAP_X" "11"
 SYSTEM_CONSTANT "VSWCTL_RCTLBASEOM_MAP_Y" "11"
 SYSTEM_CONSTANT "VSWCTL_RCTLBASHIALTDEOM_MAP_X" "11"
 SYSTEM_CONSTANT "VSWCTL_RCTLBASHIALTDEOM_MAP_Y" "11"
 SYSTEM_CONSTANT "VSWCTL_RCTLBASHIALTD_MAP_X" "16"
 SYSTEM_CONSTANT "VSWCTL_RCTLBASHIALTD_MAP_Y" "16"
 SYSTEM_CONSTANT "VSWCTL_RCTLBASRGN1_MAP_Y" "16"
 SYSTEM_CONSTANT "VSWCTL_RCTLBASRGN2_MAP_X" "16"
 SYSTEM_CONSTANT "VSWCTL_RCTLBASRGN2_MAP_Y" "16"
 SYSTEM_CONSTANT "VSWCTL_RCTLBAS_MAP_X" "16"
 SYSTEM_CONSTANT "VSWCTL_RCTLBAS_MAP_Y" "16"
 SYSTEM_CONSTANT "VSWCTL_RENGTEMPCORBAS_MAP_X" "16"
 SYSTEM_CONSTANT "VSWCTL_RENGTEMPCORBAS_MAP_Y" "16"
 SYSTEM_CONSTANT "VSWCTL_RVEHVCORR_MAP_X" "6"
 SYSTEM_CONSTANT "VSWCTL_RVEHVCORR_MAP_Y" "5"
 SYSTEM_CONSTANT "VSWCTL_RVSAAIRTEMPCORR_CUR_X" "8"
 SYSTEM_CONSTANT "VSWCTL_RVSAAPSCOR_CUR_X" "6"
 SYSTEM_CONSTANT "VSWCTL_TISTARTDELAY_CUR_X" "8"
 SYSTEM_CONSTANT "VSWVLV_IEFF_CUR_X" "8"
 SYSTEM_CONSTANT "VSWVLV_RGOVMAX_CUR_X" "3"
 SYSTEM_CONSTANT "VSWVLV_RGOVMIN_CUR_X" "3"
 SYSTEM_CONSTANT "WAHTEL_ATSINTVMOD_SY" "0"
 SYSTEM_CONSTANT "WAHT_NUM_HTRS" "3"
 SYSTEM_CONSTANT "WAHT_NUM_PS" "2"
 SYSTEM_CONSTANT "W_PA_MAX" "100"
 SYSTEM_CONSTANT "W_PA_RES" "0.01"
 SYSTEM_CONSTANT "W_PA_ZERO" "0"
 SYSTEM_CONSTANT "ZERO" "0"
 SYSTEM_CONSTANT "ZERO_FL" "0"
 SYSTEM_CONSTANT "ZFC_ACTV" "1"
 SYSTEM_CONSTANT "ZFC_BPFACINV_RES" "546.116666666667"
 SYSTEM_CONSTANT "ZFC_BPFAC_MAX" "30"
 SYSTEM_CONSTANT "ZFC_BPFAC_MIN" "-30"
 SYSTEM_CONSTANT "ZFC_BPFAC_RES" "0.00183111056855983"
 SYSTEM_CONSTANT "ZFC_BPFAC_RES_FL" "0.00183111056855983"
 SYSTEM_CONSTANT "ZFC_INACTV" "0"
 SYSTEM_CONSTANT "ZFC_PHISET_CUR_X" "16"
 SYSTEM_CONSTANT "ZFC_SWTCLBACTV_TYPE" "2"
 SYSTEM_CONSTANT "ZFC_SWTCLBACTV_VAL" "1"
 SYSTEM_CONSTANT "ZFC_TICLDCHAM_CUR_X" "12" /end MOD_PAR
/begin MOD_COMMON "" BYTE_ORDER MSB_LAST ALIGNMENT_BYTE 1 ALIGNMENT_WORD 2 ALIGNMENT_LONG 4 ALIGNMENT_FLOAT32_IEEE 4 /end MOD_COMMON
/begin IF_DATA ASAP1B_Bypass
 /begin TP_BLOB 0x100 /* Bypass version */ 0x100 /end TP_BLOB
/end IF_DATA
/begin IF_DATA ASAP1B_CCP
 /begin SOURCE "segment synchronous" 103 1 /begin QP_BLOB 0 LENGTH 4 CAN_ID_FIXED 0x330 FIRST_PID 0 RASTER 0 /end QP_BLOB /end SOURCE
 /begin SOURCE "10ms time synchronous" 4 1 /begin QP_BLOB 1 LENGTH 8 CAN_ID_FIXED 0x340 FIRST_PID 4 RASTER 1 /end QP_BLOB /end SOURCE
 /begin SOURCE "100ms time synchronous" 4 10 /begin QP_BLOB 2 LENGTH 9 CAN_ID_FIXED 0x350 FIRST_PID 12 RASTER 2 /end QP_BLOB /end SOURCE
 /begin RASTER "segment synchronous" "seg_sync" 0 103 1 /end RASTER
 /begin RASTER "10ms time synchronous" "10_ms" 1 4 1 /end RASTER
 /begin RASTER "100ms time synchronous" "100_ms" 2 4 10 /end RASTER
 /begin SEED_KEY /* seed&key dll for CAL */ "" /* seed&key dll for DAQ */ "" /* seed&key dll for PGM */ "" /end SEED_KEY
 /begin TP_BLOB /* CCP version */ 0x201 0x204 /* CAN msg ID-send */ 0x310 /* CAN msg ID-recv */ 0x320 /* station address */ 0xAD01 /* byte order */ 2 BAUDRATE 500000 /* in Hz */ SAMPLE_POINT 60 /* in % */ SAMPLE_RATE 1 /* 1 or 3 */ BTL_CYCLES 19 SJW 3 SYNC_EDGE SINGLE /* SINGLE or DUAL */ DAQ_MODE BURST CONSISTENCY DAQ
  /begin CHECKSUM_PARAM /* algorithm */ 0xC001 /* limit */ 0xFFFFFFFF CHECKSUM_CALCULATION ACTIVE_PAGE /end CHECKSUM_PARAM
  /begin DEFINED_PAGES /* page number */ 1 /* page name */ "reference page" /* address ext. */ 0x0 /* base address */ 0x80020000 /* page length */ 0x5FF04 ROM /end DEFINED_PAGES
  /begin DEFINED_PAGES /* page number */ 2 /* page name */ "working page" /* address ext. */ 0x0 /* base address */ 0x20000 /* page length */ 0x5FF04 RAM RAM_INIT_BY_ECU /end DEFINED_PAGES
  OPTIONAL_CMD 0x11 /* SELECT_CAL_PAGE */ OPTIONAL_CMD 0xE /* BUILD_CHKSUM */ OPTIONAL_CMD 0x19 /* MOVE */ OPTIONAL_CMD 0x9 /* GET_ACTIVE_CAL_PAGE */ OPTIONAL_CMD 0xC /* SET_S_STATUS */ OPTIONAL_CMD 0xD /* GET_S_STATUS */ OPTIONAL_CMD 0x12 /* GET_SEED */ OPTIONAL_CMD 0x13 /* UNLOCK */ OPTIONAL_CMD 0x23 /* DNLOAD_6 */ OPTIONAL_CMD 0x8 /* START_STOP_ALL */ OPTIONAL_CMD 0x20 /* DIAG_SERVICE */ /end TP_BLOB
/end IF_DATA
/begin IF_DATA ETK
 /begin SOURCE "bypass segment synchronous" 103 1 QP_BLOB 0x101 1 DIRECT 32 BYPASS 0x0 200 0x82120078 0x82100100 100 0x0 0x82120210 1500 100 100 /end SOURCE
 /begin SOURCE "segment synchronous" 103 1 QP_BLOB 0x101 2 DIRECT 31 MEASUREMENT 0x0 200 0x821202E0 0x821001C8 0 0x0 0x0 1500 100 0 /end SOURCE
 /begin SOURCE "bypass 10ms time synchronous" 4 1 QP_BLOB 0x101 3 DIRECT 30 BYPASS 0x0 200 0x82120478 0x82100290 100 0x0 0x82120610 9000 100 100 /end SOURCE
 /begin SOURCE "10ms time synchronous" 4 1 QP_BLOB 0x101 4 DIRECT 29 MEASUREMENT 0x0 200 0x821206E0 0x82100358 0 0x0 0x0 9000 100 0 /end SOURCE
 /begin SOURCE "100ms time synchronous" 5 1 QP_BLOB 0x101 5 DIRECT 28 MEASUREMENT 0x0 200 0x82120878 0x82100420 0 0x0 0x0 90000 100 0 /end SOURCE
 /begin TP_BLOB /* version */ 0x1000103 /* interface speed */ INTERFACE_SPEED_100MBIT /* reset_cfg - only MPC */ 0x7FFFFF07 /* not used for TriCore */
  /begin DISTAB_CFG /* Distab Type */ 13 /* Distab Data type */ 0x122 /* ByteOrder 1=LSB last */ 0x2 /* Trigger Segment Adr */ 0x82100000 /* Trigger Configuration*/ 0x0 TRG_MOD /* only to fix INCA fault while parsing A2L file */ /end DISTAB_CFG
  CODE_CHK /* prg_data */ 0x8217FE74 /* prg_data length */ 4 /* prg_exram */ 0x821004E8 /* prg_exram length */ 4 ERROR_BEHAVIOR PERMANENT_RESET ETK_CFG 0x10 0x07 0x43 0x00 0x00 0xFF 0xFF RESERVED_DISTAB_MEMORY /* start_addr */ 0x80020078 0x998 /* location */ EXTERN /* application */ MEASUREMENT /* usage */ CHECKSUM_EXCLUDE_ONLY /* mirrors */ 0xFFFFFFFF 0xFFFFFFFF 0xFFFFFFFF 0xFFFFFFFF 0xFFFFFFFF /end TP_BLOB
/end IF_DATA
/begin IF_DATA ASAP1B_KWP2000
 /begin SOURCE /* Name */ "10ms time synchronous" /* CSE-units */ 4 /* min periode */ 1 QP_BLOB /* Physical layer */ KLINE_AND_CAN /* Measurement mode */ BLOCKMODE /* Block mode local ID */ 0xF0 /* max. no of signals */ 20 /* max. no of bytes */ 40 /* CAN-ID for EUDTP */ 0x0 /* don't care if not CAN */ /* Raster ID for EUDTP */ 0 /* and FREERUNNINGMODE */ /end SOURCE
 /begin TP_BLOB 0x200 /* KWP Version */ VDA_1996 /* byte order */ MSB_LAST K_LINE /* ECU stimulation mode */ WuP /* ECU address on k line */ 0x11 /* requ. tester address */ 0xF1
  /begin CAN /* Baudrate [Hz] */ 1000000 /* Sample point */ 60 /* samples per bit */ 1 /* BTL_CYCLES */ 19 /* SJW */ 3 /* SYNC_EDGEGE */ 0
   /begin ADDRESS /* CAN_ID ECU */ 0x611 /* CAN_ID INCA */ 0x6F0 /* Extended address ECU */ /* TGT_ECU 0x10 not used with normal addressing */ /* Extended address INCA*/ /* TGT_INCA 0xF1 not used with normal addressing */ /end ADDRESS
   NETWORK_LIMITS /* WFT_MAX */ 10 /* XDL_MAX */ 0xFFF /end CAN
  DATA_ACCESS /* Flash address */ 0x0 /* RAM address */ 0x0 /* Data Read */ 1 /* Code Verify */ 0 /* Code Read */ 0 /* Load mode */ 1
  /begin CHECKSUM /* Checksum Type */ 0x10201 /* only at active Page */ 1 /* loc Routine Id Checksum */ 1 /* result delivered by */ RequestRoutineResults RNC_RESULT 0x23 /end CHECKSUM
  /begin COPY /* mode copy Flash to RAM */ RAM_InitByECU /* DiagModeCopyFlashToRam */ 0xFA /end COPY
  /begin FLASH /* mode copy RAM to Flash */ NOFLASHBACK /* loc Routine Id flashing */ 3 /* result delivered by */ RequestRoutineResults COPY_FRAME 1 RNC_RESULT 0x23 0xFB 0xFC /end FLASH
  /begin DIAG_BAUD 10400 0xFA BD_PARA 0x14 /end DIAG_BAUD
  /begin DIAG_BAUD 41600 0xFA BD_PARA 0x54 /end DIAG_BAUD
  /begin DIAG_BAUD 62400 0xFA BD_PARA 0x67 /end DIAG_BAUD
  /begin DIAG_BAUD 83200 0xFA BD_PARA 0x74 /end DIAG_BAUD
  /begin DIAG_BAUD 125000 0xFA BD_PARA 0x87 /end DIAG_BAUD
  /begin TIME_DEF /* Timing Parameter: p1Max p2Min p2Max p3Min p3Max p4Min in ms */ KWP_TIMING 20 0 50 3 512 0 KWP_TIMING 20 25 50 55 5000 5 KWP_TIMING 20 0 2000 0 5000 65440 /* Timing Parameter: As Bs Cr in ms */ USDTP_TIMING 8192 256 256 USDTP_TIMING 4096 256 256 /end TIME_DEF
  /* Seed&Key Parameter: AccMode CalcMethod Delay */ /* SECURITY_ACCESS 9 1 0 */
  /begin PAGE_SWITCH /* mode for page switch */ ESCAPE_CODE ESCAPE_CODE_PARA_SET 0x90 ESCAPE_CODE_PARA_GET 0x91 PAGE_CODE 0x0 0x1 /end PAGE_SWITCH
 /end TP_BLOB
/end IF_DATA
/begin CHARACTERISTIC ACCI_aMax_C "Maximale Beschleunigungs-Anforderung vom ACC" VALUE 0x8002B5F0 Val_Ws16 65.53500 Acc -32.76800 32.76700 FORMAT "%8.5" /end CHARACTERISTIC
/begin CHARACTERISTIC ACCI_dtrq.Pos_C "Bremsmomentengradient beim Übergang ins Halten/" VALUE 0x8002B5F4 Kw_Ws32 3276799.99847 RmpTrq 0.00 3276799.99847 EXTENDED_LIMITS -3276800.00000 3276799.99847 /end CHARACTERISTIC
/begin CHARACTERISTIC ACCI_dtrq.Neg_C "Bremsmomentengradient beim Übergang ins Halten/" VALUE 0x8002B5F8 Kw_Ws32 3276799.99847 RmpTrq 0.00 3276799.99847 EXTENDED_LIMITS -3276800.00000 3276799.99847 /end CHARACTERISTIC
/begin CHARACTERISTIC ACCI_nDeltaOff_C "" VALUE 0x8002B5FC Val_Ws16 32767.50 EngN -16384.00 16383.50 /end CHARACTERISTIC
/begin CHARACTERISTIC ACCI_nDelta_C "" VALUE 0x8002B5FE Val_Ws16 32767.50 EngN -16384.00 16383.50 /end CHARACTERISTIC
/begin CHARACTERISTIC ACCI_nShiftUp_C "" VALUE 0x8002B600 Val_Ws16 32767.50 EngN -16384.00 16383.50 /end CHARACTERISTIC
/begin CHARACTERISTIC ACCI_swtDrvAssist_C "" VALUE 0x8002B602 Val_Ws16 65535.00 OneToOne -32768.00 32767.00 /end CHARACTERISTIC
/begin CHARACTERISTIC ACCI_swtShiftDwn_C "" VALUE 0x8002B604 Val_Ws16 65535.00 OneToOne -32768.00 32767.00 /end CHARACTERISTIC
/begin CHARACTERISTIC ACCI_swtShiftOff_C "" VALUE 0x8002B606 Val_Ws16 65535.00 OneToOne -32768.00 32767.00 /end CHARACTERISTIC
/begin CHARACTERISTIC ACCI_swtShiftUp_C "" VALUE 0x8002B608 Val_Ws16 65535.00 OneToOne -32768.00 32767.00 /end CHARACTERISTIC
/begin CHARACTERISTIC ACCI_swtTrqSel_C "" VALUE 0x8002B60A Val_Ws16 65535.00 OneToOne -32768.00 32767.00 /end CHARACTERISTIC
/begin CHARACTERISTIC ACCI_tiBrkPressedDel_C "" VALUE 0x8002B60C Val_Ws16 655350.0 Time_ms -327680.0 327670.0 /end CHARACTERISTIC
/begin CHARACTERISTIC ACCI_tiPlausBrk_C "" VALUE 0x8002B60E Val_Ws16 655350.0 Time_ms -327680.0 327670.0 /end CHARACTERISTIC
/begin CHARACTERISTIC ACCI_tiPT1_C "" VALUE 0x8002B610 Val_Ws32 4294.9672940 TimeDelay_s 0.000002000000001 4294.9672960 FORMAT "%12.7" /end CHARACTERISTIC
/begin CHARACTERISTIC ACCI_tiShiftDwn_C "" VALUE 0x8002B614 Val_Ws16 655350.0 TimeDeb -327680.0 327670.0 /end CHARACTERISTIC
/begin CHARACTERISTIC ACCI_tiShiftUp_C "" VALUE 0x8002B616 Val_Ws16 655350.0 TimeDeb -327680.0 327670.0 /end CHARACTERISTIC
/begin CHARACTERISTIC ACCI_tiSwtOffDwn_C "" VALUE 0x8002B618 Val_Ws16 655350.0 TimeDeb -327680.0 327670.0 /end CHARACTERISTIC
/begin CHARACTERISTIC ACCI_tiSwtOffUp_C "" VALUE 0x8002B61A Val_Ws16 655350.0 TimeDeb -327680.0 327670.0 /end CHARACTERISTIC
/begin CHARACTERISTIC ACCI_vLim_C "" VALUE 0x8002B61C Val_Ws16 655.3500 Vel -327.6800 327.6700 /end CHARACTERISTIC
/begin CHARACTERISTIC ACComp_facTrqCAN_C "Skalierungsfaktor für CAN-Größe" VALUE 0x8002B62C Val_Ws16 511.9922 Fact1 -256.0000 255.9922 /end CHARACTERISTIC
/begin CHARACTERISTIC ACComp_tiTrqDyn_C "Filterzeitkonstante für Dynamisches Moment" VALUE 0x8002B630 Val_Wu32 4294.9672950 TimeDelay_s 0.000001000000000 4294.9672960 FORMAT "%12.7" /end CHARACTERISTIC
/begin CHARACTERISTIC ACComp_trqDesMax_C "" VALUE 0x8002B634 Val_Ws16 6553.500 Trq -3276.800 3276.700 /end CHARACTERISTIC
/begin CHARACTERISTIC AccPed_APPDebParam.tiHiLo_C "Entprellparameter für den Status APP gedrückt/nicht gedrückt/" VALUE 0x80031570 Kw_Ws16 655350.0 TimeDeb -327680.0 327670.0 /end CHARACTERISTIC
/begin CHARACTERISTIC AccPed_APPDebParam.tiLoHi_C "Entprellparameter für den Status APP gedrückt/nicht gedrückt/" VALUE 0x80031572 Kw_Ws16 655350.0 TimeDeb -327680.0 327670.0 /end CHARACTERISTIC
/begin CHARACTERISTIC AccPed_nErr_CUR "Kennlinie zur Veränderung der Leerlaufdrehzahl in Abhängigkeit des Getriebezustandes bei Plausibilitätsfehler" CURVE 0x8003155C Kl_Xs16_Ws16 6000.000 EngN 0.00 6000.000 EXTENDED_LIMITS -16384.00 16383.50
 /begin AXIS_DESCR STD_AXIS Tra_numGear OneToOne 2 0.00 6.000 EXTENDED_LIMITS -128.0 127.0 DEPOSIT ABSOLUTE /end AXIS_DESCR
/end CHARACTERISTIC
/begin CHARACTERISTIC AccPed_nMax_C "Maximaler Drehzahlwert bei Fahrpedalfehler" VALUE 0x80031566 Val_Ws16 32767.50 EngN -16384.00 16383.50 /end CHARACTERISTIC
/begin CHARACTERISTIC AccPed_nMinBrkApp_C "Minimale Drehzahl bei Fahrpedal-Bremse Unplausibilität" VALUE 0x80031568 Val_Ws16 32767.50 EngN -16384.00 16383.50 /end CHARACTERISTIC
/begin CHARACTERISTIC AccPed_nMinBrk_C "Minimale Drehzahl bei Fahrpedalfehler und Bremse getreten" VALUE 0x8003156A Val_Ws16 32767.50 EngN -16384.00 16383.50 /end CHARACTERISTIC
/begin CHARACTERISTIC AccPed_rOffset_C "Fahrpedal-Schwellwert für Wechsel auf Aufsetzpunkt ohne Schubabschaltung" VALUE 0x80031574 Val_Ws16 799.9878 Prc -400.0000 399.9878 /end CHARACTERISTIC
/begin CHARACTERISTIC AccPed_rThresPrp_C "Endwert ""Overrun-Rampe""" VALUE 0x80031576 Val_Ws16 799.9878 Prc -400.0000 399.9878 /end CHARACTERISTIC
/begin CHARACTERISTIC AccPed_rZero_C "Anfangswert ""Overrun-Rampe""" VALUE 0x80031578 Val_Ws16 799.9878 Prc -400.0000 399.9878 /end CHARACTERISTIC
/begin CHARACTERISTIC AccPed_swtDrvBehav_C "Wert = 1 : Der Fahrerwunsch wird nur über ein Fahrverhaltenkennfeld (AccPed_trqEngLow_MAP) ermittelt." VALUE 0x8003157A Kw_Wu8 1.000 OneToOne 0.00 1.000 EXTENDED_LIMITS 0.00 255.0 /end CHARACTERISTIC
/begin CHARACTERISTIC AccPed_trqDemThres_C "Schwellwert Fahrerwunschmoment für Status Fahrerwunsch aktiv" VALUE 0x8003157C Val_Ws32 429496729.500 TrqPrpHigh -214748364.800 214748364.700 /end CHARACTERISTIC
/begin CHARACTERISTIC AccPed_trqEngHigh_MAP "Fahrverhaltenkennfeld für Maximalwert des Fahrerwunsches." MAP 0x80031580 Kf_Xs16_Ys16_Ws16 6553.500 Trq -3276.800 3276.700
 /begin AXIS_DESCR STD_AXIS Epm_nEng EngN 14 -16384.00 16383.50 DEPOSIT ABSOLUTE /end AXIS_DESCR
 /begin AXIS_DESCR STD_AXIS APP_r Prc 8 -400.0000 399.9878 DEPOSIT ABSOLUTE /end AXIS_DESCR
/end CHARACTERISTIC
/begin CHARACTERISTIC AccPed_trqEngLow_MAP "Fahrverhaltenkennfeld für Minimalwert des Fahrerwunsches." MAP 0x80031690 Kf_Xs16_Ys16_Ws16 6553.500 Trq -3276.800 3276.700
 /begin AXIS_DESCR STD_AXIS Epm_nEng EngN 14 -16384.00 16383.50 DEPOSIT ABSOLUTE /end AXIS_DESCR
 /begin AXIS_DESCR STD_AXIS APP_r Prc 8 -400.0000 399.9878 DEPOSIT ABSOLUTE /end AXIS_DESCR
/end CHARACTERISTIC
/begin CHARACTERISTIC AccPed_trqLimMax_C "Maximales Radmoment bei Fahrpedalfehler" VALUE 0x8003156C Val_Ws32 429496729.500 TrqPrpHigh -214748364.800 214748364.700 /end CHARACTERISTIC
/begin CHARACTERISTIC AccPed_trqPrp_MAP "Fahrverhaltenkennfeld Mastershift-Betrieb" MAP 0x800317A0 Kf_Xs16_Ys16_Ws16 104856.0 TrqPrp -52428.80 52427.20
 /begin AXIS_DESCR STD_AXIS GlbDa_vX Vel 2 -327.6800 327.6700 DEPOSIT ABSOLUTE /end AXIS_DESCR
 /begin AXIS_DESCR STD_AXIS APP_r Prc 2 -400.0000 399.9878 DEPOSIT ABSOLUTE /end AXIS_DESCR
/end CHARACTERISTIC
/begin CHARACTERISTIC AccPed_vVehVmax_C "Maximalwert der Fahrzeuggeschwindigkeit für lineare Interpolation des Fahrerwunschmomentes." VALUE 0x800317B4 Kw_Ws16 300.0000 Vel 0.00 300.0000 EXTENDED_LIMITS -327.6800 327.6700 /end CHARACTERISTIC
/begin CHARACTERISTIC AccPed_vVehVmin_C "Minimalwert der Fahrzeuggeschwindigkeit für lineare Interpolation des Fahrerwunschmomentes." VALUE 0x800317B6 Kw_Ws16 300.0000 Vel 0.00 300.0000 EXTENDED_LIMITS -327.6800 327.6700 /end CHARACTERISTIC
/begin CHARACTERISTIC ACCtl_dtrqFullLoadLimDn_C "neg. Steigung für Umschaltung Volllastbegrenzung" VALUE 0x8002B638 Val_Wu32 6553599.99847 RmpTrq 0.00 6553599.99847 /end CHARACTERISTIC
/begin CHARACTERISTIC ACCtl_dtrqFullLoadLimUp_C "pos. Steigung für Umschaltung Volllastbegrenzung" VALUE 0x8002B63C Val_Wu32 6553599.99847 RmpTrq 0.00 6553599.99847 /end CHARACTERISTIC
/begin CHARACTERISTIC ACCtl_nACThres_C "Schwellwert Drehzahl" VALUE 0x8002B640 Val_Ws16 65535.00 EngN -32768.00 32767.00 EXTENDED_LIMITS -16384.00 16383.50 /end CHARACTERISTIC
/begin CHARACTERISTIC ACCtl_nFullLoadLimHi_C "Obere Drehzahlschwelle für Volllastbegrenzung" VALUE 0x8002B642 Val_Ws16 65535.00 EngN -32768.00 32767.00 EXTENDED_LIMITS -16384.00 16383.50 /end CHARACTERISTIC
/begin CHARACTERISTIC ACCtl_nFullLoadLimLo_C "Untere Drehzahlschwelle für Volllastbegrenzung" VALUE 0x8002B644 Val_Ws16 65535.00 EngN -32768.00 32767.00 EXTENDED_LIMITS -16384.00 16383.50 /end CHARACTERISTIC
/begin CHARACTERISTIC ACCtl_nMin_C "" VALUE 0x8002B646 Val_Ws16 32767.50 EngN -16384.00 16383.50 /end CHARACTERISTIC
/begin CHARACTERISTIC ACCtl_rTrans_C "" VALUE 0x8002B648 Val_Ws16 9.990000 TransR 0.01000000 10.00000 EXTENDED_LIMITS -327.6800 327.6700 /end CHARACTERISTIC
/begin CHARACTERISTIC ACCtl_stResv_CW "" VALUE 0x8002B64A Val_Wu8 255.0 OneToOne 0.00 255.0 /end CHARACTERISTIC
/begin CHARACTERISTIC ACCtl_stTrailerErr_C "Default-Wert bei Ausfall des Anhängers" VALUE 0x8002B64B Val_Wu8 255.0 OneToOne 0.00 255.0 /end CHARACTERISTIC
/begin CHARACTERISTIC ACCtl_tiDebIdlSpd_C "" VALUE 0x8002B64C Val_Ws32 4294967295.00 TimeDT -2147483648.00 2147483647.00 FORMAT "%13.2" /end CHARACTERISTIC
/begin CHARACTERISTIC ACCtl_tiDebNEngOff_C "Heilzeit bei zu kleiner Motordrehzahl" VALUE 0x8002B650 Val_Wu16 5000.000 TimeDeb 0.00 5000.000 EXTENDED_LIMITS 0.00 655350.0 /end CHARACTERISTIC
/begin CHARACTERISTIC ACCtl_tiDebNEngOn_C "Entprellzeit bei zu kleiner Motordrehzahl" VALUE 0x8002B652 Val_Wu16 8000.000 TimeDeb 0.00 8000.000 EXTENDED_LIMITS 0.00 655350.0 /end CHARACTERISTIC
/begin CHARACTERISTIC ACCtl_tiDebStrtOff_C "Verzögerungszeit Starterkennung" VALUE 0x8002B654 Val_Wu16 5000.000 TimeDeb 0.00 5000.000 EXTENDED_LIMITS 0.00 655350.0 /end CHARACTERISTIC
/begin CHARACTERISTIC ACCtl_tiDebStrtOn_C "Verzögerungszeit nach Startabwurf" VALUE 0x8002B656 Val_Wu16 8000.000 TimeDeb 0.00 8000.000 EXTENDED_LIMITS 0.00 655350.0 /end CHARACTERISTIC
/begin CHARACTERISTIC ACCtl_tiMnSwtDel_C "Entprellzeit des Klimahauptschalters" VALUE 0x8002B658 Val_Ws32 4294967295.00 TimeDT -2147483648.00 2147483647.00 FORMAT "%13.2" /end CHARACTERISTIC
/begin CHARACTERISTIC ACCtl_tiOnLock_C "Ausschaltsperrzeit nach Überschreitrn des Drehmomentschwellwerts" VALUE 0x8002B65C Val_Wu16 655350.0 Time_ms 0.00 655350.0 /end CHARACTERISTIC
/begin CHARACTERISTIC ACCtl_tiTrqLimPT1_C "" VALUE 0x8002B660 Val_Ws32 4294.9662960 TimeDelay_s 0.0010000000689 4294.9672960 FORMAT "%12.7" EXTENDED_LIMITS 0.000002000000001 4294.9672960 /end CHARACTERISTIC
/begin CHARACTERISTIC ACCtl_tiTrqResv_C "" VALUE 0x8002B664 Val_Ws32 2168958483.00 TimeDT -21474836.0000 2147483647.00 FORMAT "%13.2" EXTENDED_LIMITS -2147483648.00 2147483647.00 /end CHARACTERISTIC
/begin CHARACTERISTIC ACCtl_trqACMax_C "Maximalwert des Moments" VALUE 0x8002B668 Val_Ws16 6553.500 Trq -3276.800 3276.700 /end CHARACTERISTIC
/begin CHARACTERISTIC ACCtl_trqACOff_C "" VALUE 0x8002B66A Val_Ws16 6553.500 Trq -3276.800 3276.700 /end CHARACTERISTIC
/begin CHARACTERISTIC ACCtl_trqACTrqErr_C "Grenzmoment bei Ausfall CAN-Signal Drehmomentanf. Klima" VALUE 0x8002B66C Val_Ws16 6553.500 Trq -3276.800 3276.700 /end CHARACTERISTIC
/begin CHARACTERISTIC ACCtl_trqFanErr_C "Grenzmoment bei defektem E-Lüfter" VALUE 0x8002B66E Val_Ws16 6553.500 Trq -3276.800 3276.700 /end CHARACTERISTIC
/begin CHARACTERISTIC ACCtl_trqFastLim_MAP "" MAP 0x8002B670 Map_Xs16Ys16Ws16 1500.000 Trq -500.0000 1000.000 EXTENDED_LIMITS -3276.800 3276.700
 /begin AXIS_DESCR STD_AXIS Epm_nEng EngN 8 0.00 6000.000 EXTENDED_LIMITS -16384.00 16383.50 DEPOSIT ABSOLUTE /end AXIS_DESCR
 /begin AXIS_DESCR STD_AXIS ACCtl_trqInrACDiff_mp Trq 8 -500.0000 1000.000 EXTENDED_LIMITS -3276.800 3276.700 DEPOSIT ABSOLUTE /end AXIS_DESCR
/end CHARACTERISTIC
/begin CHARACTERISTIC ACCtl_trqFullLoadOfs_CUR "Abstand zur Volllast bei Anfahrbegrenzung" CURVE 0x8002B714 Cur_Xs16Ws16 35.00000 Trq -30.00000 5.000000 EXTENDED_LIMITS -3276.800 3276.700
 /begin AXIS_DESCR STD_AXIS Epm_nEng EngN 3 0.00 4500.000 EXTENDED_LIMITS -16384.00 16383.50 DEPOSIT ABSOLUTE /end AXIS_DESCR
/end CHARACTERISTIC
/begin CHARACTERISTIC ACCtl_trqRedAC_C "" VALUE 0x8002B722 Val_Ws16 6553.500 Trq -3276.800 3276.700 /end CHARACTERISTIC
/begin CHARACTERISTIC ACCtl_trqShutOff_C "" VALUE 0x8002B724 Val_Ws16 6553.500 Trq -3276.800 3276.700 /end CHARACTERISTIC
/begin CHARACTERISTIC ACCtl_trqTEngErr_C "Grenzmoment bei defektem Kühlmitteltemperatur-Sensor" VALUE 0x8002B726 Val_Ws16 6553.500 Trq -3276.800 3276.700 /end CHARACTERISTIC
/begin CHARACTERISTIC ACCtl_trqTEngLimTrailer_MAP "" MAP 0x8002B728 Map_Xs16Ys16Ws16 40.00000 Trq 0.00 40.00000 EXTENDED_LIMITS -3276.800 3276.700
 /begin AXIS_DESCR STD_AXIS EngDa_tEng Temp_Cels 5 -50.14000 199.8600 EXTENDED_LIMITS -3549.940 3003.560 DEPOSIT ABSOLUTE /end AXIS_DESCR
 /begin AXIS_DESCR STD_AXIS GlbDa_vX Vel 3 0.00 250.0000 EXTENDED_LIMITS -327.6800 327.6700 DEPOSIT ABSOLUTE /end AXIS_DESCR
/end CHARACTERISTIC
/begin CHARACTERISTIC ACCtl_trqTEngLim_MAP "Grenzmoment Klima über Motortemperatur" MAP 0x8002B75A Map_Xs16Ys16Ws16 40.00000 Trq 0.00 40.00000 EXTENDED_LIMITS -3276.800 3276.700
 /begin AXIS_DESCR STD_AXIS EngDa_tEng Temp_Cels 5 -50.14000 199.8600 EXTENDED_LIMITS -3549.940 3003.560 DEPOSIT ABSOLUTE /end AXIS_DESCR
 /begin AXIS_DESCR STD_AXIS GlbDa_vX Vel 3 0.00 250.0000 EXTENDED_LIMITS -327.6800 327.6700 DEPOSIT ABSOLUTE /end AXIS_DESCR
/end CHARACTERISTIC
/begin CHARACTERISTIC ACCtl_trqTGearbxErr_C "Grenzmoment bei Ausfall CAN-Signal Getriebeöltemperatur" VALUE 0x8002B78C Val_Ws16 6553.500 Trq -3276.800 3276.700 /end CHARACTERISTIC
/begin CHARACTERISTIC ACCtl_trqTGearbxLim_MAP "Grenzmoment Klima über Getriebetemperatur" MAP 0x8002B78E Map_Xs16Ys16Ws16 40.00000 Trq 0.00 40.00000 EXTENDED_LIMITS -3276.800 3276.700
 /begin AXIS_DESCR STD_AXIS Tra_tOil Temp_Cels 5 -0.04000000 249.9600 EXTENDED_LIMITS -3549.940 3003.560 DEPOSIT ABSOLUTE /end AXIS_DESCR
 /begin AXIS_DESCR STD_AXIS GlbDa_vX Vel 3 0.00 250.0000 EXTENDED_LIMITS -327.6800 327.6700 DEPOSIT ABSOLUTE /end AXIS_DESCR
/end CHARACTERISTIC
/begin CHARACTERISTIC ACCtl_trqThres_C "Schwellwert Drehmoment" VALUE 0x8002B7C0 Val_Ws16 6553.500 Trq -3276.800 3276.700 /end CHARACTERISTIC
/begin CHARACTERISTIC ACCtl_trqVehVErr_C "Grenzmoment bei defektem Geschwindigkeitsgeber" VALUE 0x8002B7C2 Val_Ws16 6553.500 Trq -3276.800 3276.700 /end CHARACTERISTIC
/begin CHARACTERISTIC ACCtl_vThres_C "Schwellwert Geschwindigkeit" VALUE 0x8002B7C4 Val_Ws16 300.0000 Vel 0.00 300.0000 EXTENDED_LIMITS -327.6800 327.6700 /end CHARACTERISTIC
/begin CHARACTERISTIC Adc_idxAirCClntIA_C "" VALUE 0x800317B8 Val_Wu16 65535.00 OneToOne 0.00 65535.00 READ_ONLY /end CHARACTERISTIC
/begin CHARACTERISTIC Adc_idxBrkPIA_C "" VALUE 0x800317BA Val_Wu16 65535.00 OneToOne 0.00 65535.00 READ_ONLY /end CHARACTERISTIC
/begin CHARACTERISTIC Adc_idxCEngDsTIA_C "" VALUE 0x800317BC Val_Wu16 65535.00 OneToOne 0.00 65535.00 READ_ONLY /end CHARACTERISTIC
/begin CHARACTERISTIC Adc_idxCEngUsTIA_C "" VALUE 0x800317BE Val_Wu16 65535.00 OneToOne 0.00 65535.00 READ_ONLY /end CHARACTERISTIC
/begin CHARACTERISTIC Adc_idxECBVlvIA_C "" VALUE 0x800317C0 Val_Wu16 65535.00 OneToOne 0.00 65535.00 READ_ONLY /end CHARACTERISTIC
/begin CHARACTERISTIC Adc_idxEGRVlvIA_C "" VALUE 0x800317C2 Val_Wu16 65535.00 OneToOne 0.00 65535.00 READ_ONLY /end CHARACTERISTIC
/begin CHARACTERISTIC Adc_idxEGRVlvLPIA_C "" VALUE 0x800317C4 Val_Wu16 65535.00 OneToOne 0.00 65535.00 READ_ONLY /end CHARACTERISTIC
/begin CHARACTERISTIC Adc_idxEnvTIA_C "" VALUE 0x800317C6 Val_Wu16 65535.00 OneToOne 0.00 65535.00 READ_ONLY /end CHARACTERISTIC
/begin CHARACTERISTIC Adc_idxFlFltDsPIA_C "" VALUE 0x800317C8 Val_Wu16 65535.00 OneToOne 0.00 65535.00 READ_ONLY /end CHARACTERISTIC
/begin CHARACTERISTIC Adc_idxFlFltUsPIA_C "" VALUE 0x800317CA Val_Wu16 65535.00 OneToOne 0.00 65535.00 READ_ONLY /end CHARACTERISTIC
/begin CHARACTERISTIC Adc_idxFuelTIA_C "" VALUE 0x800317CC Val_Wu16 65535.00 OneToOne 0.00 65535.00 READ_ONLY /end CHARACTERISTIC
/begin CHARACTERISTIC Adc_idxOilPIA_C "" VALUE 0x800317CE Val_Wu16 65535.00 OneToOne 0.00 65535.00 READ_ONLY /end CHARACTERISTIC
/begin CHARACTERISTIC Adc_idxOilTIA_C "" VALUE 0x800317D0 Val_Wu16 65535.00 OneToOne 0.00 65535.00 READ_ONLY /end CHARACTERISTIC
/begin CHARACTERISTIC Adc_idxPAirFltDsIA_C "" VALUE 0x800317D2 Val_Wu16 65535.00 OneToOne 0.00 65535.00 READ_ONLY /end CHARACTERISTIC
/begin CHARACTERISTIC Adc_idxPIntkVUsIA_C "" VALUE 0x800317D4 Val_Wu16 65535.00 OneToOne 0.00 65535.00 READ_ONLY /end CHARACTERISTIC
/begin CHARACTERISTIC Adc_idxPPFltDiffIA_C "" VALUE 0x800317D6 Val_Wu16 65535.00 OneToOne 0.00 65535.00 READ_ONLY /end CHARACTERISTIC
/begin CHARACTERISTIC Adc_idxPPFltUsIA_C "" VALUE 0x800317D8 Val_Wu16 65535.00 OneToOne 0.00 65535.00 READ_ONLY /end CHARACTERISTIC
/begin CHARACTERISTIC Adc_idxPTrbnUsIA_C "" VALUE 0x800317DA Val_Wu16 65535.00 OneToOne 0.00 65535.00 READ_ONLY /end CHARACTERISTIC
/begin CHARACTERISTIC Adc_idxStWhlAgIA_C "" VALUE 0x800317DC Val_Wu16 65535.00 OneToOne 0.00 65535.00 READ_ONLY /end CHARACTERISTIC
/begin CHARACTERISTIC Adc_idxTCACDsIA_C "" VALUE 0x800317DE Val_Wu16 65535.00 OneToOne 0.00 65535.00 READ_ONLY /end CHARACTERISTIC
/begin CHARACTERISTIC Adc_idxThrVlvIA_C "" VALUE 0x800317E0 Val_Wu16 65535.00 OneToOne 0.00 65535.00 READ_ONLY /end CHARACTERISTIC
/begin CHARACTERISTIC Adc_idxTOxiCatDsIA_C "" VALUE 0x800317E2 Val_Wu16 65535.00 OneToOne 0.00 65535.00 READ_ONLY /end CHARACTERISTIC
/begin CHARACTERISTIC Adc_idxTOxiCatUsIA_C "" VALUE 0x800317E4 Val_Wu16 65535.00 OneToOne 0.00 65535.00 READ_ONLY /end CHARACTERISTIC
/begin CHARACTERISTIC Adc_idxTPFltDsIA_C "" VALUE 0x800317E6 Val_Wu16 65535.00 OneToOne 0.00 65535.00 READ_ONLY /end CHARACTERISTIC
/begin CHARACTERISTIC Adc_idxTPFltUsIA_C "" VALUE 0x800317E8 Val_Wu16 65535.00 OneToOne 0.00 65535.00 READ_ONLY /end CHARACTERISTIC
/begin CHARACTERISTIC Adc_idxTrbChIA_C "" VALUE 0x800317EA Val_Wu16 65535.00 OneToOne 0.00 65535.00 READ_ONLY /end CHARACTERISTIC
/begin CHARACTERISTIC Adc_idxTTrbnUsIA_C "" VALUE 0x800317EC Val_Wu16 65535.00 OneToOne 0.00 65535.00 READ_ONLY /end CHARACTERISTIC
/begin CHARACTERISTIC Adc_idxUCatUsTIA_C "" VALUE 0x800317EE Val_Wu16 65535.00 OneToOne 0.00 65535.00 READ_ONLY /end CHARACTERISTIC
/begin CHARACTERISTIC Adc_idxUHtrPLDiaIA_C "" VALUE 0x800317F0 Val_Wu16 65535.00 OneToOne 0.00 65535.00 READ_ONLY /end CHARACTERISTIC
/begin CHARACTERISTIC Adc_idxUHtrTnkDiaIA_C "" VALUE 0x800317F2 Val_Wu16 65535.00 OneToOne 0.00 65535.00 READ_ONLY /end CHARACTERISTIC
/begin CHARACTERISTIC Adc_idxUPmpPIA_C "" VALUE 0x800317F4 Val_Wu16 65535.00 OneToOne 0.00 65535.00 READ_ONLY /end CHARACTERISTIC
/begin CHARACTERISTIC Adc_idxUTnkTIA_C "" VALUE 0x800317F6 Val_Wu16 65535.00 OneToOne 0.00 65535.00 READ_ONLY /end CHARACTERISTIC
/begin CHARACTERISTIC Adc_idxVSwVlvIA_C "" VALUE 0x800317F8 Val_Wu16 65535.00 OneToOne 0.00 65535.00 READ_ONLY /end CHARACTERISTIC
/begin CHARACTERISTIC AirC_DigOutCmpr.tiBtwTstSCB_C "Struktur, die Parameter für die Fehlerhandlung der Digitalausgangsendstufe für das Kompressorsteuersignal enthält/" VALUE 0x8002B620 Kw_Ws16 1000.000 Time_ms 0.00 1000.000 EXTENDED_LIMITS -327680.0 327670.0 /end CHARACTERISTIC
/begin CHARACTERISTIC AirC_DigOutCmpr.tiBtwTstOT_C "Struktur, die Parameter für die Fehlerhandlung der Digitalausgangsendstufe für das Kompressorsteuersignal enthält/" VALUE 0x8002B622 Kw_Ws16 100.0000 Time_s 0.00 100.0000 EXTENDED_LIMITS -327.6800 327.6700 /end CHARACTERISTIC
/begin CHARACTERISTIC AirC_DigOutCmpr.numTstMax_C "Struktur, die Parameter für die Fehlerhandlung der Digitalausgangsendstufe für das Kompressorsteuersignal enthält/" VALUE 0x8002B624 Kw_Wu16 65535.00 OneToOne 0.00 65535.00 /end CHARACTERISTIC
/begin CHARACTERISTIC AirC_stCmprPsDiaDisbl_C "Status zur Deaktivierung der Endstufendiagnose" VALUE 0x8002B626 Val_Wu8 255.0 OneToOne 0.00 255.0 /end CHARACTERISTIC
/begin CHARACTERISTIC AirC_stCmprPsDisbl_C "Status zur Aktivierung der Endstufe" VALUE 0x8002B627 Val_Wu8 255.0 OneToOne 0.00 255.0 /end CHARACTERISTIC
/begin CHARACTERISTIC AirC_stCmprTyp_CW "Codewort zur Auswahl des Kompressortyps" VALUE 0x8002B628 Val_Wu8 255.0 OneToOne 0.00 255.0 /end CHARACTERISTIC
/begin CHARACTERISTIC AirC_stSwtDfl_C "" VALUE 0x8002B7C8 Val_Wu8 255.0 OneToOne 0.00 255.0 /end CHARACTERISTIC
/begin CHARACTERISTIC AirC_trqCmprMin_C "Minimaler Wert des Kompressormoments." VALUE 0x8002B62A Val_Ws16 1500.000 Trq -500.0000 1000.000 EXTENDED_LIMITS -3276.800 3276.700 /end CHARACTERISTIC
/begin CHARACTERISTIC Com_bRecACC_C "" VALUE 0x8002B5E4 Val_Wu8 10.00 OneToOne 0.00 10.00 EXTENDED_LIMITS 0.00 255.0 /end CHARACTERISTIC
/begin CHARACTERISTIC Com_ctACCSelfRec_C "" VALUE 0x8002B5DA Val_Wu8 255.0 OneToOne 0.00 255.0 /end CHARACTERISTIC
/begin CHARACTERISTIC Com_rAPPUnFltFAS_C "" VALUE 0x8002B5E6 Val_Ws16 100.0000 Prc 0.00 100.0000 EXTENDED_LIMITS -400.0000 399.9878 /end CHARACTERISTIC
/begin CHARACTERISTIC Com_stMskTrqWhlDemSig_C "" VALUE 0x8002B5DC Val_Wu16 65535.00 OneToOne 0.00 65535.00 /end CHARACTERISTIC
/begin CHARACTERISTIC Com_swtTrqWhlDemFAS_FX_C "" VALUE 0x8002B5EC Val_Wu8 1.000 OneToOne 0.00 1.000 EXTENDED_LIMITS 0.00 255.0 /end CHARACTERISTIC
/begin CHARACTERISTIC Com_swtTrqWhlDem_C "" VALUE 0x8002B5DE Val_Wu8 1.000 OneToOne 0.00 1.000 EXTENDED_LIMITS 0.00 255.0 /end CHARACTERISTIC
/begin CHARACTERISTIC Com_tiACCSelfRec_C "" VALUE 0x8002B5E0 Val_Ws16 327670.0 Time_ms 0.00 327670.0 EXTENDED_LIMITS -327680.0 327670.0 /end CHARACTERISTIC
/begin CHARACTERISTIC Com_vVehFAS_C "" VALUE 0x8002B5E8 Val_Ws32 250.000000000 Vel 0.00 250.000000000 EXTENDED_LIMITS -21474836.4800 21474836.4700 /end CHARACTERISTIC
/begin CHARACTERISTIC CW_CCMASK "CC-Meldung Maske" VALUE 0x80062AD6 Val_Wu8 255. Def_dez_ub_q1 0.00 255. FORMAT "%3.0" /end CHARACTERISTIC
/begin CHARACTERISTIC CW_CCTEST "CC-Meldung Maske" VALUE 0x80062AD7 Val_Wu8 255. Def_dez_ub_q1 0.00 255. FORMAT "%3.0" /end CHARACTERISTIC
/begin CHARACTERISTIC CW_DTCMASK "CC-Meldung Maske" VALUE 0x80062AD8 Val_Wu8 255. Def_dez_ub_q1 0.00 255. FORMAT "%3.0" /end CHARACTERISTIC
/begin CHARACTERISTIC CW_DTCTEST "CC-Meldung Maske" VALUE 0x80062AD9 Val_Wu8 255. Def_dez_ub_q1 0.00 255. FORMAT "%3.0" /end CHARACTERISTIC
/begin CHARACTERISTIC KF_BATT1 "Kennfeld Bestimmung Batt_h2m" MAP 0x8006293E MapTKF_UB_SW_SW 199.9969 Def_f_sw_b100 -100.0000 99.99695 FORMAT "%8.4"
 /begin AXIS_DESCR STD_AXIS T_batt_zw4 Def_t_sw_q0p1 4 -3276.8 3276.7 FORMAT "%6.1" DEPOSIT ABSOLUTE /end AXIS_DESCR
 /begin AXIS_DESCR STD_AXIS Kapa_verlust Def_f_ub_b100 4 0.00 99.61 DEPOSIT ABSOLUTE /end AXIS_DESCR
/end CHARACTERISTIC
/begin CHARACTERISTIC KF_BATT2 "Kennfeld Bestimmung Batt_m2l" MAP 0x8006296C MapTKF_UB_SW_SW 199.9969 Def_f_sw_b100 -100.0000 99.99695 FORMAT "%8.4"
 /begin AXIS_DESCR STD_AXIS T_batt_zw4 Def_t_sw_q0p1 4 -3276.8 3276.7 FORMAT "%6.1" DEPOSIT ABSOLUTE /end AXIS_DESCR
 /begin AXIS_DESCR STD_AXIS Kapa_verlust Def_f_ub_b100 4 0.00 99.61 DEPOSIT ABSOLUTE /end AXIS_DESCR
/end CHARACTERISTIC
/begin CHARACTERISTIC KF_EKPRFNKW "Kennfeld Elektrische Kraftstoffpumpe Minspannungsbestimmung" MAP 0x80062B46 MapTKF_SW_SW_UB 25.50 Def_u_ub_q0p1 0.00 25.50 FORMAT "%5.2"
 /begin AXIS_DESCR STD_AXIS Nkw Def_n_sw_q1p0 4 -32768. 32767. FORMAT "%5.0" DEPOSIT ABSOLUTE /end AXIS_DESCR
 /begin AXIS_DESCR STD_AXIS Y_KF_EKPRFNKW_no_input_quantity Def_rf_sw_q0p01 4 -327.68000 327.67000 FORMAT "%9.5" DEPOSIT ABSOLUTE /end AXIS_DESCR
/end CHARACTERISTIC
/begin CHARACTERISTIC KF_MAXENTL "Kennfeld Bestimmung Entladezeit" MAP 0x8006299A MapTKF_SW_UB_UB 255.0 Def_td_ub_q1 0.00 255.0 FORMAT "%5.1"
 /begin AXIS_DESCR STD_AXIS X_KF_MAXENTL_no_input_quantity Def_f_ub_b100 4 0.00 99.61 DEPOSIT ABSOLUTE /end AXIS_DESCR
 /begin AXIS_DESCR STD_AXIS T_batt Def_t_sw_q0p1 4 -3276.8 3276.7 FORMAT "%6.1" DEPOSIT ABSOLUTE /end AXIS_DESCR
/end CHARACTERISTIC
/begin CHARACTERISTIC KF_UBATT_LL "Kennfeld Bestimmung Batterieleerlaufspg" MAP 0x800629B8 MapTKF_SW_UB_UB 25.50 Def_u_ub_q0p1 0.00 25.50 FORMAT "%5.2"
 /begin AXIS_DESCR STD_AXIS X_KF_UBATT_LL_no_input_quantity Def_f_ub_b100 4 0.00 99.61 DEPOSIT ABSOLUTE /end AXIS_DESCR
 /begin AXIS_DESCR STD_AXIS T_batt Def_t_sw_q0p1 4 -3276.8 3276.7 FORMAT "%6.1" DEPOSIT ABSOLUTE /end AXIS_DESCR
/end CHARACTERISTIC
/begin CHARACTERISTIC KF_UKRAPU "KF Mindestspannung EKP" MAP 0x80062B68 MapTKF_SW_UB_UB 25.50 Def_u_ub_q0p1 0.00 25.50 FORMAT "%5.2"
 /begin AXIS_DESCR STD_AXIS V_krapu Def_dez_ub_q1 4 0.00 255. FORMAT "%3.0" DEPOSIT ABSOLUTE /end AXIS_DESCR
 /begin AXIS_DESCR STD_AXIS Nkw Def_n_sw_q1p0 4 -32768. 32767. FORMAT "%5.0" DEPOSIT ABSOLUTE /end AXIS_DESCR
/end CHARACTERISTIC
/begin CHARACTERISTIC KF_USOLL "Batteriesollspannung aufgrund der Temperatur und soc." MAP 0x800629D6 MapTKF_UW_SW_UW 16.383750 Def_u_uw_q0p25em3_o6 6.0000000 22.383750 FORMAT "%9.6"
 /begin AXIS_DESCR STD_AXIS T_batt Def_t_sw_q0p1 4 -3276.8 3276.7 FORMAT "%6.1" DEPOSIT ABSOLUTE /end AXIS_DESCR
 /begin AXIS_DESCR STD_AXIS Soc_rel Def_f_uw_b100 4 0.00 99.99847 DEPOSIT ABSOLUTE /end AXIS_DESCR
/end CHARACTERISTIC
/begin CHARACTERISTIC KF_WDAFS "Kennfeld Bestimmung Minspannung Elektrische Lenkhilfe bei Active Front steering" MAP 0x80062B86 MapTKF_SW_SW_UB 255. Def_dez_ub_q1 0.00 255. FORMAT "%3.0"
 /begin AXIS_DESCR STD_AXIS W_afs Def_wdk_sw_q0p1 8 -3276.80 3276.70 FORMAT "%7.2" DEPOSIT ABSOLUTE /end AXIS_DESCR
 /begin AXIS_DESCR STD_AXIS W_dafs Def_wdk_sw_q0p1 8 -3276.80 3276.70 FORMAT "%7.2" DEPOSIT ABSOLUTE /end AXIS_DESCR
/end CHARACTERISTIC
/begin CHARACTERISTIC KL_BATTMNG "Hier koennte Ihr Langbezeichner stehen" CURVE 0x80062C50 CurTKL_SF_VV_SF 6.000000000000E+038 Def_f_r32 -3.000000000000E+038 3.000000000000E+038 FORMAT "%14.0" EXTENDED_LIMITS -1.000000000000E+037 1.000000000000E+037
 /begin AXIS_DESCR STD_AXIS X_KL_BATTMNG_no_input_quantity Def_f_r32 8 -1000000000000. 10000000000000. FORMAT "%14.0" EXTENDED_LIMITS -1.000000000000E+037 1.000000000000E+037 DEPOSIT ABSOLUTE /end AXIS_DESCR
/end CHARACTERISTIC
/begin CHARACTERISTIC KL_BNLIM "Kennlinie Grenzwert erhoeter Bordnetzstrom" CURVE 0x80062BE8 CurTKL_SB_VV_UB 25.50 Def_u_ub_q0p1 0.00 25.50 FORMAT "%5.2"
 /begin AXIS_DESCR STD_AXIS I_bnfiltlim Def_dez_sb_q1 3 -128. 127. FORMAT "%3.0" DEPOSIT ABSOLUTE /end AXIS_DESCR
/end CHARACTERISTIC
/begin CHARACTERISTIC KL_ELUEFTER "Kennlinie Elektrischer Lüfter" CURVE 0x80062BF0 CurTKL_UB_VV_UB 25.50 Def_u_ub_q0p1 0.00 25.50 FORMAT "%5.2"
 /begin AXIS_DESCR STD_AXIS L_pwmout Def_tv_ub_q0p390625 5 0.00 99.61 DEPOSIT ABSOLUTE /end AXIS_DESCR
/end CHARACTERISTIC
/begin CHARACTERISTIC KL_ELU_L3 "Kennlinie Elektrischer Lüfter bei MINI" CURVE 0x80062BFC CurTKL_SW_VV_UB 25.50 Def_u_ub_q0p1 0.00 25.50 FORMAT "%5.2"
 /begin AXIS_DESCR STD_AXIS Tmot Def_t_sw_q0p01 5 -327.680 327.670 FORMAT "%7.3" DEPOSIT ABSOLUTE /end AXIS_DESCR
/end CHARACTERISTIC
/begin CHARACTERISTIC KL_ENTLADEZ "KEnnfeld Bestimmung Ladezeit" CURVE 0x80062A08 CurTKL_UB_VV_UW 6553.5 Def_td_uw_q0p1 0.00 6553.5 FORMAT "%6.1"
 /begin AXIS_DESCR STD_AXIS Zentlact Def_td_ub_q1 4 0.00 255.0 FORMAT "%5.1" DEPOSIT ABSOLUTE /end AXIS_DESCR
/end CHARACTERISTIC
/begin CHARACTERISTIC KL_EWP "Kennline Minspannung Elektrische Wasserpumpe" CURVE 0x80062C0E CurTKL_UB_VV_UB 25.50 Def_u_ub_q0p1 0.00 25.50 FORMAT "%5.2"
 /begin AXIS_DESCR STD_AXIS Newp_soll Def_dez_ub_q1 5 0.00 255. FORMAT "%3.0" DEPOSIT ABSOLUTE /end AXIS_DESCR
/end CHARACTERISTIC
/begin CHARACTERISTIC KL_IGRDFGEN_MN "Minimale Generatorauslastung fuer iGR-Regler" CURVE 0x80062B00 CurTKL_SW_VV_UB 99.61 Def_f_ub_b100 0.00 99.61
 /begin AXIS_DESCR STD_AXIS Nkw Def_n_sw_q1p0 3 -32768. 32767. FORMAT "%5.0" DEPOSIT ABSOLUTE /end AXIS_DESCR
/end CHARACTERISTIC
/begin CHARACTERISTIC KL_INVBATTMNG "Hier koennte Ihr Langbezeichner stehen" CURVE 0x80062C94 CurTKL_SF_VV_SF 6.000000000000E+038 Def_f_r32 -3.000000000000E+038 3.000000000000E+038 FORMAT "%14.0" EXTENDED_LIMITS -1.000000000000E+037 1.000000000000E+037
 /begin AXIS_DESCR STD_AXIS X_KL_INVBATTMNG_no_input_quantity Def_f_r32 8 -1000000000000. 10000000000000. FORMAT "%14.0" EXTENDED_LIMITS -1.000000000000E+037 1.000000000000E+037 DEPOSIT ABSOLUTE /end AXIS_DESCR
/end CHARACTERISTIC
/begin CHARACTERISTIC KL_INVLOG "Hier koennte Ihr Langbezeichner stehen" CURVE 0x80062CD8 CurTKL_SF_VV_SF 6.000000000000E+038 Def_f_r32 -3.000000000000E+038 3.000000000000E+038 FORMAT "%14.0" EXTENDED_LIMITS -1.000000000000E+037 1.000000000000E+037
 /begin AXIS_DESCR STD_AXIS X_KL_INVLOG_no_input_quantity Def_f_r32 8 -1000000000000. 10000000000000. FORMAT "%14.0" EXTENDED_LIMITS -1.000000000000E+037 1.000000000000E+037 DEPOSIT ABSOLUTE /end AXIS_DESCR
/end CHARACTERISTIC
/begin CHARACTERISTIC KL_KAPAVZ "Kennfeld Kapazität Vollzyklen" CURVE 0x80062A7C CurTKL_UB_VV_UB 255.00 Def_i_ub_q1 0.00 255.00
 /begin AXIS_DESCR STD_AXIS X_KL_KAPAVZ_no_input_quantity Def_i_ub_q1 3 0.00 255.00 DEPOSIT ABSOLUTE /end AXIS_DESCR
/end CHARACTERISTIC
/begin CHARACTERISTIC KL_LOG "Hier koennte Ihr Langbezeichner stehen" CURVE 0x80062D1C CurTKL_SF_VV_SF 6.000000000000E+038 Def_f_r32 -3.000000000000E+038 3.000000000000E+038 FORMAT "%14.0" EXTENDED_LIMITS -1.000000000000E+037 1.000000000000E+037
 /begin AXIS_DESCR STD_AXIS X_KL_LOG_no_input_quantity Def_f_r32 8 -1000000000000. 10000000000000. FORMAT "%14.0" EXTENDED_LIMITS -1.000000000000E+037 1.000000000000E+037 DEPOSIT ABSOLUTE /end AXIS_DESCR
/end CHARACTERISTIC
/begin CHARACTERISTIC KL_QUALI "Hier koennte Ihr Langbezeichner stehen" CURVE 0x80062D60 CurTKL_SF_VV_SF 6.000000000000E+038 Def_f_r32 -3.000000000000E+038 3.000000000000E+038 FORMAT "%14.0" EXTENDED_LIMITS -1.000000000000E+037 1.000000000000E+037
 /begin AXIS_DESCR STD_AXIS X_KL_QUALI_no_input_quantity Def_f_r32 8 -1000000000000. 10000000000000. FORMAT "%14.0" EXTENDED_LIMITS -1.000000000000E+037 1.000000000000E+037 DEPOSIT ABSOLUTE /end AXIS_DESCR
/end CHARACTERISTIC
/begin CHARACTERISTIC KL_QUALILOG "Hier koennte Ihr Langbezeichner stehen" CURVE 0x80062DA4 CurTKL_SF_VV_SF 6.000000000000E+038 Def_f_r32 -3.000000000000E+038 3.000000000000E+038 FORMAT "%14.0" EXTENDED_LIMITS -1.000000000000E+037 1.000000000000E+037
 /begin AXIS_DESCR STD_AXIS X_KL_QUALILOG_no_input_quantity Def_f_r32 8 -1000000000000. 10000000000000. FORMAT "%14.0" EXTENDED_LIMITS -1.000000000000E+037 1.000000000000E+037 DEPOSIT ABSOLUTE /end AXIS_DESCR
/end CHARACTERISTIC
/begin CHARACTERISTIC KL_UBSOLLTR "Sollspannung bei Transportmodus aktiv" CURVE 0x80062A16 CurTKL_SW_VV_UB 25.50 Def_u_ub_q0p1 0.00 25.50 FORMAT "%5.2"
 /begin AXIS_DESCR STD_AXIS T_batt Def_t_sw_q0p1 4 -3276.8 3276.7 FORMAT "%6.1" DEPOSIT ABSOLUTE /end AXIS_DESCR
/end CHARACTERISTIC
/begin CHARACTERISTIC KL_UBTMTL "Kennlinie einzuhaltende mittlere Spannung" CURVE 0x80062A24 CurTKL_SW_VV_UB 25.50 Def_u_ub_q0p1 0.00 25.50 FORMAT "%5.2"
 /begin AXIS_DESCR STD_AXIS T_batt Def_t_sw_q0p1 6 -3276.8 3276.7 FORMAT "%6.1" DEPOSIT ABSOLUTE /end AXIS_DESCR
/end CHARACTERISTIC
/begin CHARACTERISTIC KL_USOLL2 "Batteriesollspannung aufgrund von tbatt" CURVE 0x80062A38 CurTKL_SW_VV_UB 25.50 Def_u_ub_q0p1 0.00 25.50 FORMAT "%5.2"
 /begin AXIS_DESCR STD_AXIS X_KL_USOLL2_no_input_quantity Def_t_sw_q0p1 4 -3276.8 3276.7 FORMAT "%6.1" DEPOSIT ABSOLUTE /end AXIS_DESCR
/end CHARACTERISTIC
/begin CHARACTERISTIC KL_WSOCLOW "Wichtung Soc low zust" CURVE 0x80062A84 CurTKL_UW_VV_UB 0.99609 Def_f_ub_b1 0.00 0.99609 FORMAT "%7.5"
 /begin AXIS_DESCR STD_AXIS Soc_bila Def_f_uw_b100 6 0.00 99.99847 DEPOSIT ABSOLUTE /end AXIS_DESCR
/end CHARACTERISTIC
/begin CHARACTERISTIC K_ABSTDLY "Verzoegerungszeit fuer B_abstdelay" VALUE 0x80062A98 Val_Wu8 255.0 Def_td_ub_q1 0.00 255.0 FORMAT "%5.1" /end CHARACTERISTIC
/begin CHARACTERISTIC K_ABSTIGRMAX "Offset IGR MAX" VALUE 0x80062AB8 Val_Ws16 199.9969 Def_f_sw_b100 -100.0000 99.99695 FORMAT "%8.4" /end CHARACTERISTIC
/begin CHARACTERISTIC K_ABSTIGRMN1 "Offset IGR MIN 1" VALUE 0x80062ABA Val_Ws16 199.9969 Def_f_sw_b100 -100.0000 99.99695 FORMAT "%8.4" /end CHARACTERISTIC
/begin CHARACTERISTIC K_ABSTIGRMN2 "Offset IGR MIN2" VALUE 0x80062ABC Val_Ws16 199.9969 Def_f_sw_b100 -100.0000 99.99695 FORMAT "%8.4" /end CHARACTERISTIC
/begin CHARACTERISTIC K_AEPFLFILTK "Konstante zum verstellen des Tiefpassfilters" VALUE 0x80062AEA Val_Wu16 0.9999847412109 Def_f_uw_b1 0.00 0.9999847412109 FORMAT "%15.13" /end CHARACTERISTIC
/begin CHARACTERISTIC K_APPCO2M2L "Manuelle Vorgabe Battm2l" VALUE 0x80062ABE Val_Ws16 199.9969 Def_f_sw_b100 -100.0000 99.99695 FORMAT "%8.4" /end CHARACTERISTIC
/begin CHARACTERISTIC K_AVBBATTGD "APPParameter zum Ausbedaten von B_batt_good" VALUE 0x80062E10 Val_Wu8 1.0 Identity 0.00 1.0 EXTENDED_LIMITS 0.00 255. /end CHARACTERISTIC
/begin CHARACTERISTIC K_AVSOCNPL "Freischalten von AV in folge SOC nicht plausibel" VALUE 0x80062E11 Val_Wu8 1.0 Identity 0.00 1.0 EXTENDED_LIMITS 0.00 255. /end CHARACTERISTIC
/begin CHARACTERISTIC K_BATTMXOFF "Deaktivierung Freigabe Batteriemaximalgrenze" VALUE 0x80062A46 Val_Wu8 1.0 Identity 0.00 1.0 EXTENDED_LIMITS 0.00 255. /end CHARACTERISTIC
/begin CHARACTERISTIC K_BATTORT0 "Batterieeinbauort No1" VALUE 0x80062A47 Val_Wu8 255. Def_st_ub_q1 0.00 255. FORMAT "%3.0" /end CHARACTERISTIC
/begin CHARACTERISTIC K_BUPACTRATE "Zeitinterval nach dem die Werte im Pmbackup-Array aktualisiert werden" VALUE 0x80062ADA Val_Wu8 255.0 Def_td_ub_q1 0.00 255.0 FORMAT "%5.1" /end CHARACTERISTIC
/begin CHARACTERISTIC K_C02MSA_OFF "Test Deaktivierung MSA" VALUE 0x80062AC0 Val_Wu8 1.0 Identity 0.00 1.0 EXTENDED_LIMITS 0.00 255. /end CHARACTERISTIC
/begin CHARACTERISTIC K_DELTA1 "Entladung SpannungsHysterese" VALUE 0x80062A48 Val_Wu8 25.50 Def_u_ub_q0p1 0.00 25.50 FORMAT "%5.2" /end CHARACTERISTIC
/begin CHARACTERISTIC K_DELTA2 "Entladung Spannungshysterese" VALUE 0x80062A49 Val_Wu8 25.50 Def_u_ub_q0p1 0.00 25.50 FORMAT "%5.2" /end CHARACTERISTIC
/begin CHARACTERISTIC K_DFLLMIN "DF unterhalb derer die LLDZanh. zurueckgenommen wird." VALUE 0x80062DF8 Val_Wu8 99.61 Def_f_ub_b100 0.00 99.61 /end CHARACTERISTIC
/begin CHARACTERISTIC K_DFMAX "Obere Schwelle DF Signal" VALUE 0x80062DF9 Val_Wu8 99.61 Def_f_ub_b100 0.00 99.61 /end CHARACTERISTIC
/begin CHARACTERISTIC K_DODSTART "Applikationkonstante" VALUE 0x80062A99 Val_Wu8 99.61 Def_f_ub_b100 0.00 99.61 /end CHARACTERISTIC
/begin CHARACTERISTIC K_DQELREGSTART "Hier koennte Ihr Langbezeichner stehen" VALUE 0x80062A9A Val_Wu16 19088.4 Def_ql_uw_q0p29127 0.00 19088.4 FORMAT "%7.1" EXTENDED_LIMITS 0.00 19087.9 /end CHARACTERISTIC
/begin CHARACTERISTIC K_DQ_AUSLOES "Vollzyklen" VALUE 0x80062A9C Val_Wu8 31.88 Def_f_ub_b32 0.00 31.88 /end CHARACTERISTIC
/begin CHARACTERISTIC K_DSCUMIN "Spannungsanhebung bei DSC aktivität" VALUE 0x80062C1A Val_Wu8 25.50 Def_u_ub_q0p1 0.00 25.50 FORMAT "%5.2" /end CHARACTERISTIC
/begin CHARACTERISTIC K_DSCUMN "DSC Minspannung" VALUE 0x80062C1B Val_Wu8 25.50 Def_u_ub_q0p1 0.00 25.50 FORMAT "%5.2" /end CHARACTERISTIC
/begin CHARACTERISTIC K_DSCUMX "DSC Maxspannung" VALUE 0x80062C1C Val_Wu8 25.50 Def_u_ub_q0p1 0.00 25.50 FORMAT "%5.2" /end CHARACTERISTIC
/begin CHARACTERISTIC K_DSOCDELTA1 "Hysterese Bestimmung B_batt_bad D_Soc abh." VALUE 0x80062A4A Val_Ws16 199.9969 Def_f_sw_b100 -100.0000 99.99695 FORMAT "%8.4" /end CHARACTERISTIC
/begin CHARACTERISTIC K_DSOCDELTA2 "Hysterese Bestimmung Batt_m2l" VALUE 0x80062A4C Val_Ws16 199.9969 Def_f_sw_b100 -100.0000 99.99695 FORMAT "%8.4" /end CHARACTERISTIC
/begin CHARACTERISTIC K_DSOCHYST "Hystereschwelle SOC" VALUE 0x80062DFA Val_Ws16 199.9969 Def_f_sw_b100 -100.0000 99.99695 FORMAT "%8.4" /end CHARACTERISTIC
/begin CHARACTERISTIC K_DSOCLLANH "Abstand zur Stfgrz, bei der die LLDZanh aktiviert wird." VALUE 0x80062DFC Val_Ws16 199.9969 Def_f_sw_b100 -100.0000 99.99695 FORMAT "%8.4" /end CHARACTERISTIC
/begin CHARACTERISTIC K_ENKLEMMSTAPP "Hier koennte Ihr Langbezeichner stehen" VALUE 0x80062B44 Val_Wu8 255. Def_dez_ub_q1 0.00 255. FORMAT "%3.0" /end CHARACTERISTIC
/begin CHARACTERISTIC K_EPSUMN "EPS Minspannung" VALUE 0x80062C1D Val_Wu8 25.50 Def_u_ub_q0p1 0.00 25.50 FORMAT "%5.2" /end CHARACTERISTIC
/begin CHARACTERISTIC K_EPS_VMAX "Maximalschwelle V für Auswertung EPS Aktivität" VALUE 0x80062C1E Val_Wu16 65535. Def_v_uw_q1p0 0.00 65535. FORMAT "%5.0" /end CHARACTERISTIC
/begin CHARACTERISTIC K_FLASHDURIN "Applikationsgröße für Flashdurin" VALUE 0x80062AEC Val_Wu16 65535. Def_dez_uw_q1 0.00 65535. FORMAT "%5.0" /end CHARACTERISTIC
/begin CHARACTERISTIC K_FLASHDUROUT "Hier koennte Ihr Langbezeichner stehen" VALUE 0x80062AEE Val_Wu16 65535. Def_dez_uw_q1 0.00 65535. FORMAT "%5.0" /end CHARACTERISTIC
/begin CHARACTERISTIC K_FLASHSTATIN "Applikationsgröße für Flashstatin" VALUE 0x80062AF0 Val_Wu8 255. Def_dez_ub_q1 0.00 255. FORMAT "%3.0" /end CHARACTERISTIC
/begin CHARACTERISTIC K_FLASHSTATOUT "Hier koennte Ihr Langbezeichner stehen" VALUE 0x80062AF1 Val_Wu8 255. Def_dez_ub_q1 0.00 255. FORMAT "%3.0" /end CHARACTERISTIC
/begin CHARACTERISTIC K_FLSOCMIN "Minimaler Ladezustand bei B_tra = 1 und IBS aktiv" VALUE 0x80062AF2 Val_Wu16 99.99847 Def_f_uw_b100 0.00 99.99847 /end CHARACTERISTIC
/begin CHARACTERISTIC K_FLSOCSTFGK "Definierte Ladezustandsgrenze abhängig von Stfgk" VALUE 0x80062AF4 Val_Wu16 99.99847 Def_f_uw_b100 0.00 99.99847 /end CHARACTERISTIC
/begin CHARACTERISTIC K_FSPM "Hier koennte Ihr Langbezeichner stehen" VALUE 0x80062ADB Val_Wu8 255. Def_dez_ub_q1 0.00 255. FORMAT "%3.0" /end CHARACTERISTIC
/begin CHARACTERISTIC K_GEBLAKT "um Spannung und Prios zu testen" VALUE 0x80062C20 Val_Wu8 1.0 Identity 0.00 1.0 EXTENDED_LIMITS 0.00 255. /end CHARACTERISTIC
/begin CHARACTERISTIC K_GEBLDUPMX "Maxspannung pos Gradient Gebläse" VALUE 0x80062C21 Val_Wu8 0.498047 Def_u_ub_b0p5 0.00 0.498047 FORMAT "%8.6" /end CHARACTERISTIC
/begin CHARACTERISTIC K_GEBLUMN "Minspannung Gebläse" VALUE 0x80062C22 Val_Wu8 25.50 Def_u_ub_q0p1 0.00 25.50 FORMAT "%5.2" /end CHARACTERISTIC
/begin CHARACTERISTIC K_IBATTAEP "Angenommener Bordnetzstrom" VALUE 0x80062AF6 Val_Wu16 5242.800 Def_i_uw_q0p08_o200 -200.0000 5042.800 FORMAT "%8.3" /end CHARACTERISTIC
/begin CHARACTERISTIC K_IBATTAPPL "Applikationsparameter Batteriestrom" VALUE 0x80062E12 Val_Wu16 5242.800 Def_i_uw_q0p08_o200 -200.0000 5042.800 FORMAT "%8.3" /end CHARACTERISTIC
/begin CHARACTERISTIC K_IBNAV_GRZ "Grenze AV infolge Bordnetzstrom (gefiltert)" VALUE 0x80062E14 Val_Wu16 5242.800 Def_i_uw_q0p08_o200 -200.0000 5042.800 FORMAT "%8.3" /end CHARACTERISTIC
/begin CHARACTERISTIC K_IBNAV_OK "Grenze ab der AV infolge Bordnetzstrom wieder zurückgenommen wird" VALUE 0x80062E16 Val_Wu16 5242.800 Def_i_uw_q0p08_o200 -200.0000 5042.800 FORMAT "%8.3" /end CHARACTERISTIC
/begin CHARACTERISTIC K_IBNEA "Stromschwelle auf Batteriegröße bezogen, liegt Strom länger als applizierbare Zeitkonst K_TIME_IBNEA an, dann EA" VALUE 0x80062E18 Val_Wu16 8191.8750 Def_str_uw_q0p125 0.00 8191.8750 /end CHARACTERISTIC
/begin CHARACTERISTIC K_ID_VBRES1 "Applikationswert ID Reserveverbraucher 1" VALUE 0x80062C23 Val_Wu8 255. Def_dez_ub_q1 0.00 255. FORMAT "%3.0" /end CHARACTERISTIC
/begin CHARACTERISTIC K_ID_VBRES2 "Applikationswert ID Reserveverbraucher 2" VALUE 0x80062C24 Val_Wu8 255. Def_dez_ub_q1 0.00 255. FORMAT "%3.0" /end CHARACTERISTIC
/begin CHARACTERISTIC K_ID_VBRES3 "Applikationswert ID Reserveverbraucher 3" VALUE 0x80062C25 Val_Wu8 255. Def_dez_ub_q1 0.00 255. FORMAT "%3.0" /end CHARACTERISTIC
/begin CHARACTERISTIC K_ID_VBRES4 "Applikationswert ID Reserveverbraucher 4" VALUE 0x80062C26 Val_Wu8 255. Def_dez_ub_q1 0.00 255. FORMAT "%3.0" /end CHARACTERISTIC
/begin CHARACTERISTIC K_IGRBS "Auswahl Bedingung Schubbit" VALUE 0x80062B3A Val_Wu8 10. ident 0.00 10. FORMAT "%3.0" EXTENDED_LIMITS 0.00 255. /end CHARACTERISTIC
/begin CHARACTERISTIC K_IGRCD_EN "Manuelle Freischaltung iGR" VALUE 0x80062AC1 Val_Wu8 1.0 Identity 0.00 1.0 EXTENDED_LIMITS 0.00 255. /end CHARACTERISTIC
/begin CHARACTERISTIC K_IGRDFGEN_MX "Maximalschwelle DF fuer Batteriestromregelung Generatorstromerhöhung" VALUE 0x80062B0C Val_Wu8 99.61 Def_f_ub_b100 0.00 99.61 /end CHARACTERISTIC
/begin CHARACTERISTIC K_IGRDIAGT_MN "Mindestmesszeit Motor an" VALUE 0x80062B2E Val_Wu16 65535. Def_dez_uw_q1 0.00 65535. FORMAT "%5.0" /end CHARACTERISTIC
/begin CHARACTERISTIC K_IGRDIAG_T1 "Batterietemperaturschwelle" VALUE 0x80062B30 Val_Ws16 6553.5 Def_t_sw_q0p1 -3276.8 3276.7 FORMAT "%6.1" /end CHARACTERISTIC
/begin CHARACTERISTIC K_IGRDIAG_T2 "Saisontemperaturschwelle" VALUE 0x80062B32 Val_Ws16 6553.5 Def_t_sw_q0p1 -3276.8 3276.7 FORMAT "%6.1" /end CHARACTERISTIC
/begin CHARACTERISTIC K_IGRDIAG_TMN "Mindestmesszeit Medium bzw. High" VALUE 0x80062B34 Val_Wu8 255. Def_dez_ub_q1 0.00 255. FORMAT "%3.0" /end CHARACTERISTIC
/begin CHARACTERISTIC K_IGRDIAG_TST "Schrittweite für High/Med-Ago-Zähler" VALUE 0x80062B35 Val_Wu8 255. Def_dez_ub_q1 0.00 255. FORMAT "%3.0" /end CHARACTERISTIC
/begin CHARACTERISTIC K_IGRHIGHEN "Freischaltung High" VALUE 0x80062AC2 Val_Wu8 1.0 Identity 0.00 1.0 EXTENDED_LIMITS 0.00 255. /end CHARACTERISTIC
/begin CHARACTERISTIC K_IGRH_ZYKL "Max-Zahl Vollzyklen mit High" VALUE 0x80062AC3 Val_Wu8 1275. Def_td_ub_b1280 0.00 1275. FORMAT "%4.0" /end CHARACTERISTIC
/begin CHARACTERISTIC K_IGRINF_TSB "TOD Info BSA" VALUE 0x80062B36 Val_Wu8 25.5 Def_td_ub_q0p1 0.00 25.5 FORMAT "%4.1" /end CHARACTERISTIC
/begin CHARACTERISTIC K_IGRLOW_EN "App iGR-Low Applikation freigeschalten" VALUE 0x80062B3B Val_Wu8 1.0 Identity 0.00 1.0 EXTENDED_LIMITS 0.00 255. /end CHARACTERISTIC
/begin CHARACTERISTIC K_IGRMEDEN "Freischaltung Med" VALUE 0x80062AC4 Val_Wu8 1.0 Identity 0.00 1.0 EXTENDED_LIMITS 0.00 255. /end CHARACTERISTIC
/begin CHARACTERISTIC K_IGRMEUMIN "Mindestspannung bei IGR-Medium" VALUE 0x80062B0D Val_Wu8 25.50 Def_u_ub_q0p1 0.00 25.50 FORMAT "%5.2" /end CHARACTERISTIC
/begin CHARACTERISTIC K_IGRM_ZYKL "Max-Zahl Vollzyklen mit Med" VALUE 0x80062AC5 Val_Wu8 1275. Def_td_ub_b1280 0.00 1275. FORMAT "%4.0" /end CHARACTERISTIC
/begin CHARACTERISTIC K_IGRNL "Nachlauf iGR Rekuperationsanforderung" VALUE 0x80062B0E Val_Wu8 25.5 Def_td_ub_q0p1 0.00 25.5 FORMAT "%4.1" /end CHARACTERISTIC
/begin CHARACTERISTIC K_IGRUMAX "Maximalwert Spannungsanforderung iGR" VALUE 0x80062B0F Val_Wu8 25.50 Def_u_ub_q0p1 0.00 25.50 FORMAT "%5.2" /end CHARACTERISTIC
/begin CHARACTERISTIC K_IGRUMINMAX "Maximale Spannungsanhebung im IGR-Regler" VALUE 0x80062B10 Val_Wu8 25.50 Def_u_ub_q0p1 0.00 25.50 FORMAT "%5.2" /end CHARACTERISTIC
/begin CHARACTERISTIC K_IGRUMN "Minimalwert Spannungsanforderung iGR" VALUE 0x80062B11 Val_Wu8 25.50 Def_u_ub_q0p1 0.00 25.50 FORMAT "%5.2" /end CHARACTERISTIC
/begin CHARACTERISTIC K_IGRUMN2 "Angehobene IGR-Mindestspannung" VALUE 0x80062B12 Val_Wu8 25.50 Def_u_ub_q0p1 0.00 25.50 FORMAT "%5.2" /end CHARACTERISTIC
/begin CHARACTERISTIC K_IGR_ANT "Gewichtung neue zu alten Werten" VALUE 0x80062B37 Val_Wu8 0.99609 Def_f_ub_b1 0.00 0.99609 FORMAT "%7.5" /end CHARACTERISTIC
/begin CHARACTERISTIC K_IGR_DI1 "Schwellwert Abweichung fuer Reglerzeittakt 1" VALUE 0x80062B14 Val_Wu16 1310.700 Def_i_uw_q0p02 0.00 1310.700 FORMAT "%8.3" /end CHARACTERISTIC
/begin CHARACTERISTIC K_IGR_DI1DT "Reglerzeittakt 1" VALUE 0x80062B16 Val_Wu8 25.5 Def_td_ub_q0p1 0.00 25.5 FORMAT "%4.1" /end CHARACTERISTIC
/begin CHARACTERISTIC K_IGR_DI2 "Schwellwert Abweichung fuer Reglerzeittakt 2" VALUE 0x80062B18 Val_Wu16 1310.700 Def_i_uw_q0p02 0.00 1310.700 FORMAT "%8.3" /end CHARACTERISTIC
/begin CHARACTERISTIC K_IGR_DI2DT "Reglerzeittakt 2" VALUE 0x80062B1A Val_Wu8 25.5 Def_td_ub_q0p1 0.00 25.5 FORMAT "%4.1" /end CHARACTERISTIC
/begin CHARACTERISTIC K_IGR_ENTPR "Entprellzeit iGR Rekuperationsanforderung" VALUE 0x80062B1B Val_Wu8 25.5 Def_td_ub_q0p1 0.00 25.5 FORMAT "%4.1" /end CHARACTERISTIC
/begin CHARACTERISTIC K_IGR_IHIGH "Sollwert Batteriestrom fuer iGR High (Fahrerpotentialunabhängig)" VALUE 0x80062B1C Val_Ws16 1310.700 Def_i_sw_q0p02 -655.3600 655.3400 FORMAT "%8.4" /end CHARACTERISTIC
/begin CHARACTERISTIC K_IGR_IHIGH2 "Reduzierter Entladestrom High" VALUE 0x80062B1E Val_Ws16 1310.700 Def_i_sw_q0p02 -655.3600 655.3400 FORMAT "%8.4" /end CHARACTERISTIC
/begin CHARACTERISTIC K_IGR_IMED "Sollwert Batteriestrom fuer iGR Medium (Fahrerpotentialunabhängig)" VALUE 0x80062B20 Val_Ws16 1310.700 Def_i_sw_q0p02 -655.3600 655.3400 FORMAT "%8.4" /end CHARACTERISTIC
/begin CHARACTERISTIC K_IGR_MANRAMP "Max U-Delta fuer Aktivierung der Regelung" VALUE 0x80062B22 Val_Wu8 25.50 Def_u_ub_q0p1 0.00 25.50 FORMAT "%5.2" /end CHARACTERISTIC
/begin CHARACTERISTIC K_IGR_NKWMN "Mindestmotordrehzahl iGR-Low" VALUE 0x80062B3C Val_Ws16 65535. Def_n_sw_q1p0 -32768. 32767. FORMAT "%5.0" /end CHARACTERISTIC
/begin CHARACTERISTIC K_IGR_OSDI1 "Toleranzschwelle Berechnung Regelzeittakt" VALUE 0x80062B24 Val_Wu16 1310.700 Def_i_uw_q0p02 0.00 1310.700 FORMAT "%8.3" /end CHARACTERISTIC
/begin CHARACTERISTIC K_IGR_TMOTMN "Mindestmotortemperatur iGR-Low" VALUE 0x80062B3E Val_Ws16 655.350 Def_t_sw_q0p01 -327.680 327.670 FORMAT "%7.3" /end CHARACTERISTIC
/begin CHARACTERISTIC K_IGR_UDPN "Maximale Spannungsrampe iGR (positiv und negativ)" VALUE 0x80062B26 Val_Wu8 0.498047 Def_u_ub_b0p5 0.00 0.498047 FORMAT "%8.6" /end CHARACTERISTIC
/begin CHARACTERISTIC K_IGR_UOS "Stoerabstand zu dynamischen BN- Spannungsgrenzen" VALUE 0x80062B27 Val_Wu8 25.50 Def_u_ub_q0p1 0.00 25.50 FORMAT "%5.2" /end CHARACTERISTIC
/begin CHARACTERISTIC K_IGR_VMIN "Mindestgeschwindigkeit für iGR-Low" VALUE 0x80062B40 Val_Wu16 65535. Def_v_uw_q1p0 0.00 65535. FORMAT "%5.0" /end CHARACTERISTIC
/begin CHARACTERISTIC K_INFORESET "Resetschalter für gesamtes Array" VALUE 0x80062B38 Val_Wu8 1.0 Identity 0.00 1.0 EXTENDED_LIMITS 0.00 255. /end CHARACTERISTIC
/begin CHARACTERISTIC K_INSPRESET "Defaultwert, Leminfospeicher wird gesetzt falls B_pwf kommt" VALUE 0x80062DE8 Val_Wu8 255. Def_dez_ub_q1 0.00 255. FORMAT "%3.0" /end CHARACTERISTIC
/begin CHARACTERISTIC K_KAPAVERLU "Kapazitätsverlust" VALUE 0x80062A4E Val_Wu8 255. Def_dez_ub_q1 0.00 255. FORMAT "%3.0" /end CHARACTERISTIC
/begin CHARACTERISTIC K_KRAPUMNNL "Mindestspannung KraPu f Notlauf" VALUE 0x80062C27 Val_Wu8 25.50 Def_u_ub_q0p1 0.00 25.50 FORMAT "%5.2" /end CHARACTERISTIC
/begin CHARACTERISTIC K_LADEFAKT "Ladefaktor Batterie" VALUE 0x80062A9D Val_Wu8 1.9922 Def_f_ub_b2 0.00 1.9922 /end CHARACTERISTIC
/begin CHARACTERISTIC K_LEMDELAY "Ausblendung Startimpuls" VALUE 0x80062DE9 Val_Wu8 25.5 Def_td_ub_q0p1 0.00 25.5 FORMAT "%4.1" /end CHARACTERISTIC
/begin CHARACTERISTIC K_LEMDIAGU1 "Spannungsgrenze 1" VALUE 0x80062DEA Val_Wu8 25.50 Def_u_ub_q0p1 0.00 25.50 FORMAT "%5.2" /end CHARACTERISTIC
/begin CHARACTERISTIC K_LEMDIAGU2 "Spannungsgrenze 2" VALUE 0x80062DEB Val_Wu8 25.50 Def_u_ub_q0p1 0.00 25.50 FORMAT "%5.2" /end CHARACTERISTIC
/begin CHARACTERISTIC K_LEMDIAGU3 "Spannungsgrenze 3" VALUE 0x80062DEC Val_Wu8 25.50 Def_u_ub_q0p1 0.00 25.50 FORMAT "%5.2" /end CHARACTERISTIC
/begin CHARACTERISTIC K_LEMDIAGU4 "Spannungsgrenze 4" VALUE 0x80062DED Val_Wu8 25.50 Def_u_ub_q0p1 0.00 25.50 FORMAT "%5.2" /end CHARACTERISTIC
/begin CHARACTERISTIC K_LEMDIAGU5 "Spannungsgrenze 5" VALUE 0x80062DEE Val_Wu8 25.50 Def_u_ub_q0p1 0.00 25.50 FORMAT "%5.2" /end CHARACTERISTIC
/begin CHARACTERISTIC K_LEMDIAGU6 "Spannungsgrenze 6" VALUE 0x80062DEF Val_Wu8 25.50 Def_u_ub_q0p1 0.00 25.50 FORMAT "%5.2" /end CHARACTERISTIC
/begin CHARACTERISTIC K_LEMDIAGU7 "Spannungsgrenze 7" VALUE 0x80062DF0 Val_Wu8 25.50 Def_u_ub_q0p1 0.00 25.50 FORMAT "%5.2" /end CHARACTERISTIC
/begin CHARACTERISTIC K_LEMRESET "Rücksetzen des Infospeichers bzw setzen auf Defaultwert K_INSPRESET" VALUE 0x80062DF1 Val_Wu8 255. Def_dez_ub_q1 0.00 255. FORMAT "%3.0" /end CHARACTERISTIC
/begin CHARACTERISTIC K_LICHTAKT "um Spannung und Prios zu testen" VALUE 0x80062C28 Val_Wu8 1.0 Identity 0.00 1.0 EXTENDED_LIMITS 0.00 255. /end CHARACTERISTIC
/begin CHARACTERISTIC K_LICHTDUPNMX "Maxspannung pos und neg Gradient Licht" VALUE 0x80062C29 Val_Wu8 0.498047 Def_u_ub_b0p5 0.00 0.498047 FORMAT "%8.6" /end CHARACTERISTIC
/begin CHARACTERISTIC K_LICHTUMN "Minspannung Licht" VALUE 0x80062C2A Val_Wu8 25.50 Def_u_ub_q0p1 0.00 25.50 FORMAT "%5.2" /end CHARACTERISTIC
/begin CHARACTERISTIC K_LLPMFILTK "Filterkonstante : Tiefpassfilter DF-Signal" VALUE 0x80062DFE Val_Wu8 0.99609 Def_f_ub_b1 0.00 0.99609 FORMAT "%7.5" /end CHARACTERISTIC
/begin CHARACTERISTIC K_LWMIN "Mindestlenkwinkel für Reaktion auf Eps Aktivität" VALUE 0x80062C2B Val_Wu8 255. Def_dez_ub_q1 0.00 255. FORMAT "%3.0" /end CHARACTERISTIC
/begin CHARACTERISTIC K_M2LAV1MSA "Abstand MSA AV1 unterhalb M2L" VALUE 0x80062AC6 Val_Ws16 199.9969 Def_f_sw_b100 -100.0000 99.99695 FORMAT "%8.4" /end CHARACTERISTIC
/begin CHARACTERISTIC K_M2LAV2MSA "Abstand MSA AV2 unterhalb M2L" VALUE 0x80062AC8 Val_Ws16 199.9969 Def_f_sw_b100 -100.0000 99.99695 FORMAT "%8.4" /end CHARACTERISTIC
/begin CHARACTERISTIC K_M2LEA1MSA "Abstand MSA EA1 unterhalb M2L" VALUE 0x80062ACA Val_Ws16 199.9969 Def_f_sw_b100 -100.0000 99.99695 FORMAT "%8.4" /end CHARACTERISTIC
/begin CHARACTERISTIC K_M2LEA2MSA "Abstand MSA EA2 unterhalb M2L" VALUE 0x80062ACC Val_Ws16 199.9969 Def_f_sw_b100 -100.0000 99.99695 FORMAT "%8.4" /end CHARACTERISTIC
/begin CHARACTERISTIC K_MSASTOPAPP "ApplikationsParameter, bei MSA - Stop wird Parameter true, nach Motorstart wird wieder false" VALUE 0x80062E1A Val_Wu8 1.0 Identity 0.00 1.0 EXTENDED_LIMITS 0.00 255. /end CHARACTERISTIC
/begin CHARACTERISTIC K_MSASTRTAPP "Applikationsparameter, wird true bei Motorstart nach MSA-Stopphase, soll länger anliegen, deswegen erst wieder false wenn Motor stoppt" VALUE 0x80062E1B Val_Wu8 1.0 Identity 0.00 1.0 EXTENDED_LIMITS 0.00 255. /end CHARACTERISTIC
/begin CHARACTERISTIC K_MSA_ZYKL "Max-Zahl Vollzyklen mit MSA" VALUE 0x80062ACE Val_Wu8 1275. Def_td_ub_b1280 0.00 1275. FORMAT "%4.0" /end CHARACTERISTIC
/begin CHARACTERISTIC K_NLLAPP "Applikationsdrehzahl zum testen der LL-Anhebung" VALUE 0x80062E00 Val_Ws16 32767. Def_n_sw_q1p0 0.00 32767. FORMAT "%5.0" EXTENDED_LIMITS -32768. 32767. /end CHARACTERISTIC
/begin CHARACTERISTIC K_NLLMIN "Motordrehzahl unterhalb derer die LLDZanh. zurueckgenommen wird." VALUE 0x80062E02 Val_Ws16 65535. Def_n_sw_q1p0 -32768. 32767. FORMAT "%5.0" /end CHARACTERISTIC
/begin CHARACTERISTIC K_NSUBO "N_soll bei Batterieladebilanz zu niedrig" VALUE 0x80062E04 Val_Ws16 32767. Def_n_sw_q1p0 0.00 32767. FORMAT "%5.0" EXTENDED_LIMITS -32768. 32767. /end CHARACTERISTIC
/begin CHARACTERISTIC K_NSUBTRA "Kein Langbezeichner vergeben" VALUE 0x80062E06 Val_Ws16 32767. Def_n_sw_q1p0 0.00 32767. FORMAT "%5.0" EXTENDED_LIMITS -32768. 32767. /end CHARACTERISTIC
/begin CHARACTERISTIC K_NSUBU "N_soll bei Ladebilanz iO" VALUE 0x80062E08 Val_Ws16 32767. Def_n_sw_q1p0 0.00 32767. FORMAT "%5.0" EXTENDED_LIMITS -32768. 32767. /end CHARACTERISTIC
/begin CHARACTERISTIC K_OSPGAPP "Oberspannungsschwelle" VALUE 0x80062ADC Val_Wu8 25.50 Def_u_ub_q0p1 0.00 25.50 FORMAT "%5.2" /end CHARACTERISTIC
/begin CHARACTERISTIC K_PMRDM2LMSA "Konstante um die bei MSA-FZG der batt_m2l reduziert wird" VALUE 0x80062AD0 Val_Ws16 199.9969 Def_f_sw_b100 -100.0000 99.99695 FORMAT "%8.4" /end CHARACTERISTIC
/begin CHARACTERISTIC K_PRELLDFAH "Prellzeit für LLR-Anhebung" VALUE 0x80062E0A Val_Wu8 25.5 Def_td_ub_q0p1 0.00 25.5 FORMAT "%4.1" /end CHARACTERISTIC
/begin CHARACTERISTIC K_PRELLDFRF "Prellzeit für LLR-Absenkung" VALUE 0x80062E0B Val_Wu8 25.5 Def_td_ub_q0p1 0.00 25.5 FORMAT "%4.1" /end CHARACTERISTIC
/begin CHARACTERISTIC K_PR_BAPPDMN "Applikationswert für Prio dyn Batt min" VALUE 0x80062A4F Val_Wu8 255. Def_dez_ub_q1 0.00 255. FORMAT "%3.0" /end CHARACTERISTIC
/begin CHARACTERISTIC K_PR_BAPPMX "Applikationswert für Prio Batt max" VALUE 0x80062A50 Val_Wu8 255. Def_dez_ub_q1 0.00 255. FORMAT "%3.0" /end CHARACTERISTIC
/begin CHARACTERISTIC K_PR_BAPPSMN "Applikationswert für Prio sta Batt max" VALUE 0x80062A51 Val_Wu8 255. Def_dez_ub_q1 0.00 255. FORMAT "%3.0" /end CHARACTERISTIC
/begin CHARACTERISTIC K_PR_BAPPSOLL "Applikationswert für Prio Batt soll" VALUE 0x80062A52 Val_Wu8 255. Def_dez_ub_q1 0.00 255. FORMAT "%3.0" /end CHARACTERISTIC
/begin CHARACTERISTIC K_PR_BATTMX "Prioritaet Batterie Maxspannung" VALUE 0x80062A53 Val_Wu8 255. Def_dez_ub_q1 0.00 255. FORMAT "%3.0" /end CHARACTERISTIC
/begin CHARACTERISTIC K_PR_GEBLDUP "App.wert Prio Gebläse positiver Gradient, bei Gebläse aktiv" VALUE 0x80062C2C Val_Wu8 255. Def_dez_ub_q1 0.00 255. FORMAT "%3.0" /end CHARACTERISTIC
/begin CHARACTERISTIC K_PR_IGRDPN "Prioritaet iGR Spannungsrampe positiv und negativ" VALUE 0x80062B28 Val_Wu8 255. Def_dez_ub_q1 0.00 255. FORMAT "%3.0" /end CHARACTERISTIC
/begin CHARACTERISTIC K_PR_IGRLOW "Prioritaet iGR- LOW" VALUE 0x80062B29 Val_Wu8 255. Def_dez_ub_q1 0.00 255. FORMAT "%3.0" /end CHARACTERISTIC
/begin CHARACTERISTIC K_PR_IGRMH "Prioritaet iGR Medium und High" VALUE 0x80062B2A Val_Wu8 255. Def_dez_ub_q1 0.00 255. FORMAT "%3.0" /end CHARACTERISTIC
/begin CHARACTERISTIC K_PR_LICHTDUPN "Prio pos und neg Gradient Licht" VALUE 0x80062C2D Val_Wu8 255. Def_dez_ub_q1 0.00 255. FORMAT "%3.0" /end CHARACTERISTIC
/begin CHARACTERISTIC K_PR_UBSOLL "Prio Batterie Sollspannung" VALUE 0x80062A54 Val_Wu8 255. Def_dez_ub_q1 0.00 255. FORMAT "%3.0" /end CHARACTERISTIC
/begin CHARACTERISTIC K_PR_UBSOLLTR "Prio Batterie Sollspg TraMode" VALUE 0x80062A55 Val_Wu8 255. Def_dez_ub_q1 0.00 255. FORMAT "%3.0" /end CHARACTERISTIC
/begin CHARACTERISTIC K_PR_UDBMN_H "Prio dyn Batterie min Obergrenze" VALUE 0x80062A56 Val_Wu8 255. Def_dez_ub_q1 0.00 255. FORMAT "%3.0" /end CHARACTERISTIC
/begin CHARACTERISTIC K_PR_UDBMN_L "Prio dyn Batterie min Untergrenze (bei B_batt_good =true)" VALUE 0x80062A57 Val_Wu8 255. Def_dez_ub_q1 0.00 255. FORMAT "%3.0" /end CHARACTERISTIC
/begin CHARACTERISTIC K_PR_UDBMN_M "Prio dyn Batterie Mittelwert (bei B_batt_bad =true)" VALUE 0x80062A58 Val_Wu8 255. Def_dez_ub_q1 0.00 255. FORMAT "%3.0" /end CHARACTERISTIC
/begin CHARACTERISTIC K_PR_USBMN_H "Prio sta Batterie Obergrenze" VALUE 0x80062A59 Val_Wu8 255. Def_dez_ub_q1 0.00 255. FORMAT "%3.0" /end CHARACTERISTIC
/begin CHARACTERISTIC K_PR_USBMN_L "Prio sta Batterie Untergrenze" VALUE 0x80062A5A Val_Wu8 255. Def_dez_ub_q1 0.00 255. FORMAT "%3.0" /end CHARACTERISTIC
/begin CHARACTERISTIC K_PR_VBRES3DUPN "Prio pos und neg Gradient Reserveverbraucher3" VALUE 0x80062C2E Val_Wu8 255. Def_dez_ub_q1 0.00 255. FORMAT "%3.0" /end CHARACTERISTIC
/begin CHARACTERISTIC K_PR_VBRES4DUPN "Prio pos und neg Gradient Reserveverbraucher 4" VALUE 0x80062C2F Val_Wu8 255. Def_dez_ub_q1 0.00 255. FORMAT "%3.0" /end CHARACTERISTIC
/begin CHARACTERISTIC K_QLADAVNAKT "Qlad-Grenzwert der aktuellen Fahrt ab dem der AV zurückgenommen wird" VALUE 0x80062E1C Val_Wu16 1193.023 Def_ql_uw_q0p0182 0.00 1193.023 FORMAT "%8.3" EXTENDED_LIMITS 0.00 1192.750 /end CHARACTERISTIC
/begin CHARACTERISTIC K_QMINREG "minimale Einlademenge" VALUE 0x80062A9E Val_Wu16 19088.4 Def_ql_uw_q0p29127 0.00 19088.4 FORMAT "%7.1" EXTENDED_LIMITS 0.00 19087.9 /end CHARACTERISTIC
/begin CHARACTERISTIC K_QREGEND "Hier koennte Ihr Langbezeichner stehen" VALUE 0x80062AA0 Val_Wu16 19088.4 Def_ql_uw_q0p29127 0.00 19088.4 FORMAT "%7.1" EXTENDED_LIMITS 0.00 19087.9 /end CHARACTERISTIC
/begin CHARACTERISTIC K_QUALI_1 "Spannungsqualität Grenzwert 1" VALUE 0x80062DF2 Val_Wu16 65535. Def_dez_uw_q1 0.00 65535. FORMAT "%5.0" /end CHARACTERISTIC
/begin CHARACTERISTIC K_QUALI_2 "Spannungsqualität Grenzwert 2" VALUE 0x80062DF4 Val_Wu16 65535. Def_dez_uw_q1 0.00 65535. FORMAT "%5.0" /end CHARACTERISTIC
/begin CHARACTERISTIC K_QUALI_3 "Spannungsqualität Grenzwert 3" VALUE 0x80062DF6 Val_Wu16 65535. Def_dez_uw_q1 0.00 65535. FORMAT "%5.0" /end CHARACTERISTIC
/begin CHARACTERISTIC K_QV_NPL "Restkappa für schlechte Qv_quali" VALUE 0x80062A5B Val_Wu8 99.61 Def_f_ub_b100 0.00 99.61 /end CHARACTERISTIC
/begin CHARACTERISTIC K_QV_QUALIMX "Schwellwert Qv_quali" VALUE 0x80062A5C Val_Wu8 99.61 Def_f_ub_b100 0.00 99.61 /end CHARACTERISTIC
/begin CHARACTERISTIC K_REGEN_ON "Aktivierung Regenerationsanforderung" VALUE 0x80062AA2 Val_Wu8 1.0 Identity 0.00 1.0 EXTENDED_LIMITS 0.00 255. /end CHARACTERISTIC
/begin CHARACTERISTIC K_SLPAKT "um Spannung und Prios zu testen" VALUE 0x80062C30 Val_Wu8 1.0 Identity 0.00 1.0 EXTENDED_LIMITS 0.00 255. /end CHARACTERISTIC
/begin CHARACTERISTIC K_SLPUMN "Minspannung sekundärluftpumpe" VALUE 0x80062C31 Val_Wu8 25.50 Def_u_ub_q0p1 0.00 25.50 FORMAT "%5.2" /end CHARACTERISTIC
/begin CHARACTERISTIC K_SOCQSCHW "Schwellwert Soc_quali" VALUE 0x80062AA4 Val_Wu16 1193.023 Def_ql_uw_q0p0182 0.00 1193.023 FORMAT "%8.3" EXTENDED_LIMITS 0.00 1192.750 /end CHARACTERISTIC
/begin CHARACTERISTIC K_STATSVREG2 "Hier koennte Ihr Langbezeichner stehen" VALUE 0x80062ADD Val_Wu8 255. Def_dez_ub_q1 0.00 255. FORMAT "%3.0" /end CHARACTERISTIC
/begin CHARACTERISTIC K_T2PMINFO "T2 Zykluszeit fuer PM Fehlerinfo" VALUE 0x80062ADE Val_Wu16 65535. Def_td_uw_q1 0.00 65535. FORMAT "%5.0" /end CHARACTERISTIC
/begin CHARACTERISTIC K_T3PMINFO "T3 Zykluszeit fuer PM Fehlerinfo" VALUE 0x80062AE0 Val_Wu16 65535. Def_td_uw_q1 0.00 65535. FORMAT "%5.0" /end CHARACTERISTIC
/begin CHARACTERISTIC K_TBATTAPPL "Batterietemperatur Applikationsschalter" VALUE 0x80062E1E Val_Ws16 6553.5 Def_t_sw_q0p1 -3276.8 3276.7 FORMAT "%6.1" /end CHARACTERISTIC
/begin CHARACTERISTIC K_TBATT_O1 "Konstantwert bei erstem Motorstart (Schlüsselstart) Obergrenze der zulässigen Batterietemperatur" VALUE 0x80062E20 Val_Ws16 6553.5 Def_t_sw_q0p1 -3276.8 3276.7 FORMAT "%6.1" /end CHARACTERISTIC
/begin CHARACTERISTIC K_TBTFREIMAX "Maximale Dauer Freigabe Maximalspannung" VALUE 0x80062A5D Val_Wu8 25.5 Def_td_ub_q0p1 0.00 25.5 FORMAT "%4.1" /end CHARACTERISTIC
/begin CHARACTERISTIC K_TBTMXIGRLO "Abschaltung iGR-Low ab T_batt" VALUE 0x80062A5E Val_Ws16 6553.5 Def_t_sw_q0p1 -3276.8 3276.7 FORMAT "%6.1" /end CHARACTERISTIC
/begin CHARACTERISTIC K_TBTPAUMIN "Mindestenstpausenzeit zw Spannungsanhebungen" VALUE 0x80062A60 Val_Wu8 25.5 Def_td_ub_q0p1 0.00 25.5 FORMAT "%4.1" /end CHARACTERISTIC
/begin CHARACTERISTIC K_TCLRAVSOCF "Zeit nach der der AV infolge Soc_fit wieder weggenommen wird" VALUE 0x80062E22 Val_Wu16 65535. Def_dez_uw_q1 0.00 65535. FORMAT "%5.0" /end CHARACTERISTIC
/begin CHARACTERISTIC K_TDREGEN "Hier koennte Ihr Langbezeichner stehen" VALUE 0x80062AA6 Val_Wu16 655.350 Def_td_uw_q0p01 0.00 655.350 FORMAT "%7.3" /end CHARACTERISTIC
/begin CHARACTERISTIC K_TDUB "Verzügerungszeitkonstante" VALUE 0x80062A61 Val_Wu8 25.5 Def_td_ub_q0p1 0.00 25.5 FORMAT "%4.1" /end CHARACTERISTIC
/begin CHARACTERISTIC K_TD_DSC "Verzögerungszeit nach ausschalten von DSC" VALUE 0x80062C32 Val_Wu16 6553.5 Def_td_uw_q0p1 0.00 6553.5 FORMAT "%6.1" /end CHARACTERISTIC
/begin CHARACTERISTIC K_TD_IBNFILT "Filterkonstante Bornetzstrom" VALUE 0x80062C34 Val_Wu16 65535. Def_dez_uw_q1 0.00 65535. FORMAT "%5.0" /end CHARACTERISTIC
/begin CHARACTERISTIC K_TD_IFILT "Verzögerungswert für TimerRetrigger" VALUE 0x80062AF8 Val_Wu8 25.5 Def_td_ub_q0p1 0.00 25.5 FORMAT "%4.1" /end CHARACTERISTIC
/begin CHARACTERISTIC K_TIME_IBNEA "min Dauer als Faktor, damit EA aufgrund hohem Batteriestrom gesetzt wird" VALUE 0x80062E24 Val_Wu8 255. Def_dez_ub_q1 0.00 255. FORMAT "%3.0" /end CHARACTERISTIC
/begin CHARACTERISTIC K_TIME_UAV "Zeit bis Information bereit sein muss, dass es sich um einen MSA Start handelt" VALUE 0x80062E26 Val_Wu16 65535. Def_dez_uw_q1 0.00 65535. FORMAT "%5.0" /end CHARACTERISTIC
/begin CHARACTERISTIC K_TMAXREGEN "maximale Zeit Regeneration" VALUE 0x80062AA8 Val_Wu16 655.350 Def_td_uw_q0p01 0.00 655.350 FORMAT "%7.3" /end CHARACTERISTIC
/begin CHARACTERISTIC K_TNABSPLAUS "max Abweichung Abstellzeit Tn_abstm zu Summe Ruhestromwerte PMDIAG" VALUE 0x80062AAA Val_Wu16 65535. Def_td_uw_q1 0.00 65535. FORMAT "%5.0" /end CHARACTERISTIC
/begin CHARACTERISTIC K_TSTARTREG "Hier koennte Ihr Langbezeichner stehen" VALUE 0x80062AAC Val_Wu16 65535. Def_td_uw_q1 0.00 65535. FORMAT "%5.0" /end CHARACTERISTIC
/begin CHARACTERISTIC K_TUMGFLTTAU "Filterkonstante" VALUE 0x80062A62 Val_Wu16 0.9999847412109 Def_f_uw_b1 0.00 0.9999847412109 FORMAT "%15.13" /end CHARACTERISTIC
/begin CHARACTERISTIC K_TUMGHYST "Hystere für deaktivieren co2 massnahmen bei Umgebungstemperatur" VALUE 0x80062A64 Val_Ws16 6553.5 Def_t_sw_q0p1 -3276.8 3276.7 FORMAT "%6.1" /end CHARACTERISTIC
/begin CHARACTERISTIC K_TUMGMIN "Umgebungstemperaturschwelle Freigabe co2" VALUE 0x80062A66 Val_Ws16 6553.5 Def_t_sw_q0p1 -3276.8 3276.7 FORMAT "%6.1" /end CHARACTERISTIC
/begin CHARACTERISTIC K_TZWSTARTREG "Hier koennte Ihr Langbezeichner stehen" VALUE 0x80062AAE Val_Wu16 65535. Def_td_uw_q1 0.00 65535. FORMAT "%5.0" /end CHARACTERISTIC
/begin CHARACTERISTIC K_T_OUSPGSET "Entrpellzeit FS_oberspannungserkennung" VALUE 0x80062AE2 Val_Wu8 255.0 Def_td_ub_q1 0.00 255.0 FORMAT "%5.1" /end CHARACTERISTIC
/begin CHARACTERISTIC K_T_TIEFPRE "Entprellung Rücksetzen keine Tiefentladung mehr" VALUE 0x80062AE3 Val_Wu8 255.0 Def_td_ub_q1 0.00 255.0 FORMAT "%5.1" /end CHARACTERISTIC
/begin CHARACTERISTIC K_UBAPPDMN "Spannung dyn Batterie min" VALUE 0x80062A68 Val_Wu8 25.50 Def_u_ub_q0p1 0.00 25.50 FORMAT "%5.2" /end CHARACTERISTIC
/begin CHARACTERISTIC K_UBAPPMX "Applikationswert Batterie Max Spannung" VALUE 0x80062A69 Val_Wu8 25.50 Def_u_ub_q0p1 0.00 25.50 FORMAT "%5.2" /end CHARACTERISTIC
/begin CHARACTERISTIC K_UBAPPSMN "Applikationswrt Batterie min Spannung stat" VALUE 0x80062A6A Val_Wu8 25.50 Def_u_ub_q0p1 0.00 25.50 FORMAT "%5.2" /end CHARACTERISTIC
/begin CHARACTERISTIC K_UBAPPSOLL "Applikationswert Batteriesollspannung" VALUE 0x80062A6B Val_Wu8 25.50 Def_u_ub_q0p1 0.00 25.50 FORMAT "%5.2" /end CHARACTERISTIC
/begin CHARACTERISTIC K_UBATTMN_L "Batterieminimalspannung bei Batteriezustand gut" VALUE 0x80062A6C Val_Wu8 25.50 Def_u_ub_q0p1 0.00 25.50 FORMAT "%5.2" /end CHARACTERISTIC
/begin CHARACTERISTIC K_UBATTMN_M "Batterieminimalspannung bei Batteriezustand mittel" VALUE 0x80062A6D Val_Wu8 25.50 Def_u_ub_q0p1 0.00 25.50 FORMAT "%5.2" /end CHARACTERISTIC
/begin CHARACTERISTIC K_UBATT_MX "Maximalwert zulässige Spannung aus Batteriesicht" VALUE 0x80062A6E Val_Wu8 25.50 Def_u_ub_q0p1 0.00 25.50 FORMAT "%5.2" /end CHARACTERISTIC
/begin CHARACTERISTIC K_UBDET_U "Störabstand Erkennung erhöhte Spannung" VALUE 0x80062A6F Val_Wu8 25.50 Def_u_ub_q0p1 0.00 25.50 FORMAT "%5.2" /end CHARACTERISTIC
/begin CHARACTERISTIC K_UBLMN "Appwert Minspanunng" VALUE 0x80062C36 Val_Wu8 25.50 Def_u_ub_q0p1 0.00 25.50 FORMAT "%5.2" /end CHARACTERISTIC
/begin CHARACTERISTIC K_UBNOTLAUF "Notlaufbatteriespannung für U_battsoll =0" VALUE 0x80062A70 Val_Wu8 25.50 Def_u_ub_q0p1 0.00 25.50 FORMAT "%5.2" /end CHARACTERISTIC
/begin CHARACTERISTIC K_UBSOLLREG "Batterieminspg bei Regeneration" VALUE 0x80062A71 Val_Wu8 25.50 Def_u_ub_q0p1 0.00 25.50 FORMAT "%5.2" /end CHARACTERISTIC
/begin CHARACTERISTIC K_UBTDET_U "Entprellung für Erkennung erhöhte Spannung" VALUE 0x80062A72 Val_Wu8 25.50 Def_u_ub_q0p1 0.00 25.50 FORMAT "%5.2" /end CHARACTERISTIC
/begin CHARACTERISTIC K_UGRENZ "Parameter zum einstellen der minimalen Batteriespannung" VALUE 0x80062AFA Val_Wu16 16.383750 Def_u_uw_q0p25em3_o6 6.0000000 22.383750 FORMAT "%9.6" /end CHARACTERISTIC
/begin CHARACTERISTIC K_UNOTLKONST "Konstante Spannung im Notlauf" VALUE 0x80062A73 Val_Wu8 25.50 Def_u_ub_q0p1 0.00 25.50 FORMAT "%5.2" /end CHARACTERISTIC
/begin CHARACTERISTIC K_USPGAPP "Unterspannungschwelle" VALUE 0x80062AE4 Val_Wu8 25.50 Def_u_ub_q0p1 0.00 25.50 FORMAT "%5.2" /end CHARACTERISTIC
/begin CHARACTERISTIC K_USTRTMSAMI "Applikationsparameter für die minimale Spannungslage beim MSA Start" VALUE 0x80062E28 Val_Wu16 2097.120 Def_u_uw_q0p032 0.00 2097.120 FORMAT "%8.3" /end CHARACTERISTIC
/begin CHARACTERISTIC K_UTNSTDETEC "Wert von U_tnstartmsa muss größer als K_UTNSTDETEC sein dann Startwert vorhanden" VALUE 0x80062E2A Val_Wu16 2097.120 Def_u_uw_q0p032 0.00 2097.120 FORMAT "%8.3" /end CHARACTERISTIC
/begin CHARACTERISTIC K_VBRES1UMX "Maxspannung Reserveverbraucher 1" VALUE 0x80062C37 Val_Wu8 25.50 Def_u_ub_q0p1 0.00 25.50 FORMAT "%5.2" /end CHARACTERISTIC
/begin CHARACTERISTIC K_VBRES2UMN "Minspannung Reserveverbraucher 2" VALUE 0x80062C38 Val_Wu8 25.50 Def_u_ub_q0p1 0.00 25.50 FORMAT "%5.2" /end CHARACTERISTIC
/begin CHARACTERISTIC K_VBRES2UMX "Maxspannung Reserveverbraucher 2" VALUE 0x80062C39 Val_Wu8 25.50 Def_u_ub_q0p1 0.00 25.50 FORMAT "%5.2" /end CHARACTERISTIC
/begin CHARACTERISTIC K_VBRES3DUPNMX "Spannung pos und neg Gradient Reserveverbraucher 3" VALUE 0x80062C3A Val_Wu8 0.498047 Def_u_ub_b0p5 0.00 0.498047 FORMAT "%8.6" /end CHARACTERISTIC
/begin CHARACTERISTIC K_VBRES3UMN "Minspannung Reserveverbraucher 3" VALUE 0x80062C3B Val_Wu8 25.50 Def_u_ub_q0p1 0.00 25.50 FORMAT "%5.2" /end CHARACTERISTIC
/begin CHARACTERISTIC K_VBRES3UMX "Maxsspannung Reserveverbraucher 3" VALUE 0x80062C3C Val_Wu8 25.50 Def_u_ub_q0p1 0.00 25.50 FORMAT "%5.2" /end CHARACTERISTIC
/begin CHARACTERISTIC K_VBRES4DUPNMX "Spannung pos und neg Gradient Reserveverbraucher 4" VALUE 0x80062C3D Val_Wu8 0.498047 Def_u_ub_b0p5 0.00 0.498047 FORMAT "%8.6" /end CHARACTERISTIC
/begin CHARACTERISTIC K_VBRES4UMN "Minspannung Reserveverbraucher 4" VALUE 0x80062C3E Val_Wu8 25.50 Def_u_ub_q0p1 0.00 25.50 FORMAT "%5.2" /end CHARACTERISTIC
/begin CHARACTERISTIC K_VBRES4UMX "Maxspannung Reserveverbraucher 4" VALUE 0x80062C3F Val_Wu8 25.50 Def_u_ub_q0p1 0.00 25.50 FORMAT "%5.2" /end CHARACTERISTIC
/begin CHARACTERISTIC K_VBRES5UMN "Minspannung Reserveverbraucher 5" VALUE 0x80062C40 Val_Wu8 25.50 Def_u_ub_q0p1 0.00 25.50 FORMAT "%5.2" /end CHARACTERISTIC
/begin CHARACTERISTIC K_VBRES5UMX "Maxspannung Reserveverbraucher 5" VALUE 0x80062C41 Val_Wu8 25.50 Def_u_ub_q0p1 0.00 25.50 FORMAT "%5.2" /end CHARACTERISTIC
/begin CHARACTERISTIC K_VERB_CAN "Freischalten Verbraucher CAN" VALUE 0x80062C42 Val_Wu8 1.0 Identity 0.00 1.0 EXTENDED_LIMITS 0.00 255. /end CHARACTERISTIC
/begin CHARACTERISTIC K_WISCHERAKT "um Spannung und Prios zu testen" VALUE 0x80062C43 Val_Wu8 1.0 Identity 0.00 1.0 EXTENDED_LIMITS 0.00 255. /end CHARACTERISTIC
/begin CHARACTERISTIC K_WISCHUMN "Minspannung Wischer" VALUE 0x80062C44 Val_Wu8 25.50 Def_u_ub_q0p1 0.00 25.50 FORMAT "%5.2" /end CHARACTERISTIC
/begin CHARACTERISTIC K_WISCHUMX "Maxspannung Wischer" VALUE 0x80062C45 Val_Wu8 25.50 Def_u_ub_q0p1 0.00 25.50 FORMAT "%5.2" /end CHARACTERISTIC
/begin CHARACTERISTIC K_ZKLONG "lange Zeitkonstante" VALUE 0x80062E2C Val_Wu16 65535. Def_dez_uw_q1 0.00 65535. FORMAT "%5.0" /end CHARACTERISTIC
/begin CHARACTERISTIC K_ZRREGEN "Hier koennte Ihr Langbezeichner stehen" VALUE 0x80062AB0 Val_Wu8 255. Def_dez_ub_q1 0.00 255. FORMAT "%3.0" /end CHARACTERISTIC
/begin CHARACTERISTIC K_ZTAGEOLD "Hier koennte Ihr Langbezeichner stehen" VALUE 0x80062AE6 Val_Wu16 65535. Def_dez_uw_q1 0.00 65535. FORMAT "%5.0" /end CHARACTERISTIC
/begin CHARACTERISTIC K_ZYK_BTMXF "Deaktivierung iGR-Low ab Zyklisierungsgrenze" VALUE 0x80062A74 Val_Wu16 19087.9 Def_ql_uw_q0p29127 0.00 19087.9 FORMAT "%7.1" /end CHARACTERISTIC
/begin CHARACTERISTIC S_APPCO2IGRON "Manuelles Überschreiben iGR-Verhinderer" VALUE 0x80062AD2 Val_Wu8 1.0 Identity 0.00 1.0 EXTENDED_LIMITS 0.00 255. /end CHARACTERISTIC
/begin CHARACTERISTIC S_APPCO2M2L "Manuelles Setzen Battm2l" VALUE 0x80062AD3 Val_Wu8 1.0 Identity 0.00 1.0 EXTENDED_LIMITS 0.00 255. /end CHARACTERISTIC
/begin CHARACTERISTIC S_APPCO2MSA "Testschalter MSA aktiv" VALUE 0x80062AD4 Val_Wu8 1.0 Identity 0.00 1.0 EXTENDED_LIMITS 0.00 255. /end CHARACTERISTIC
/begin CHARACTERISTIC S_APP_FTCALCRQ "Applikationsschalter" VALUE 0x80062AFC Val_Wu8 1.0 Identity 0.00 1.0 EXTENDED_LIMITS 0.00 255. /end CHARACTERISTIC
/begin CHARACTERISTIC S_APP_LLAH "Kennwert zum Umschalten auf Applikationskonstante" VALUE 0x80062E0C Val_Wu8 1.0 Identity 0.00 1.0 EXTENDED_LIMITS 0.00 255. /end CHARACTERISTIC
/begin CHARACTERISTIC S_AVDIAG_ACT "Schalter um AV infolge Generatordefekt, diagnosen deaktivieren zu können (1=AV aktiv)" VALUE 0x80062E2E Val_Wu8 1.0 Identity 0.00 1.0 EXTENDED_LIMITS 0.00 255. /end CHARACTERISTIC
/begin CHARACTERISTIC S_AVSOCF_ACT "Schalter um AV infolge SOC_FIT deaktivieren zu können (1=AV aktiv)" VALUE 0x80062E2F Val_Wu8 1.0 Identity 0.00 1.0 EXTENDED_LIMITS 0.00 255. /end CHARACTERISTIC
/begin CHARACTERISTIC S_AVTBAT_ACT "Schalter um AV infolge Batterietemperatur deaktivieren zu können (1=AV aktiv)" VALUE 0x80062E30 Val_Wu8 1.0 Identity 0.00 1.0 EXTENDED_LIMITS 0.00 255. /end CHARACTERISTIC
/begin CHARACTERISTIC S_AVUSTRQLAD "Schalter zurücknahme des AVs bei genügend Ladung in Batterie; 1=aktiv, 2=nciht aktiv" VALUE 0x80062E31 Val_Wu8 1.0 Identity 0.00 1.0 EXTENDED_LIMITS 0.00 255. /end CHARACTERISTIC
/begin CHARACTERISTIC S_AVUSTR_ACT "Schalter um AV infolge Startspannungslage deaktivieren zu können (1=aktiv)" VALUE 0x80062E32 Val_Wu8 1.0 Identity 0.00 1.0 EXTENDED_LIMITS 0.00 255. /end CHARACTERISTIC
/begin CHARACTERISTIC S_BATTAPP "Applikationsschalter1 Auswahl Ersatztemperatur" VALUE 0x80062A76 Val_Wu8 1.0 Identity 0.00 1.0 EXTENDED_LIMITS 0.00 255. /end CHARACTERISTIC
/begin CHARACTERISTIC S_BATTCHGINI "freischalten Neuinitialisierung bei Batterietausch" VALUE 0x80062AB1 Val_Wu8 1.0 Identity 0.00 1.0 EXTENDED_LIMITS 0.00 255. /end CHARACTERISTIC
/begin CHARACTERISTIC S_BATTEMP "Auswahlschalter für T_batt bzw. T_saison" VALUE 0x80062A77 Val_Wu8 1.0 Identity 0.00 1.0 EXTENDED_LIMITS 0.00 255. /end CHARACTERISTIC
/begin CHARACTERISTIC S_BATTREGENECU "ECU-Tester" VALUE 0x80062AB2 Val_Wu8 1.0 Identity 0.00 1.0 EXTENDED_LIMITS 0.00 255. /end CHARACTERISTIC
/begin CHARACTERISTIC S_BBATTREGEN "Hier koennte Ihr Langbezeichner stehen" VALUE 0x80062AB3 Val_Wu8 1.0 Identity 0.00 1.0 EXTENDED_LIMITS 0.00 255. /end CHARACTERISTIC
/begin CHARACTERISTIC S_BBATTREGINI "Hier koennte Ihr Langbezeichner stehen" VALUE 0x80062AB4 Val_Wu8 1.0 Identity 0.00 1.0 EXTENDED_LIMITS 0.00 255. /end CHARACTERISTIC
/begin CHARACTERISTIC S_BCDIGRONR "Hier koennte Ihr Langbezeichner stehen" VALUE 0x80062B2B Val_Wu8 1.0 Identity 0.00 1.0 EXTENDED_LIMITS 0.00 255. /end CHARACTERISTIC
/begin CHARACTERISTIC S_BREGENU_HI "Aktivierung Hohe Spannung bei Batterieregeneration aktiv" VALUE 0x80062A78 Val_Wu8 1.0 Identity 0.00 1.0 EXTENDED_LIMITS 0.00 255. /end CHARACTERISTIC
/begin CHARACTERISTIC S_BZE_EN "Schalter Aktivierung BZE" VALUE 0x80062A79 Val_Wu8 1.0 Identity 0.00 1.0 EXTENDED_LIMITS 0.00 255. /end CHARACTERISTIC
/begin CHARACTERISTIC S_DIAGECU "Hier koennte Ihr Langbezeichner stehen" VALUE 0x80062AE8 Val_Wu8 1.0 Identity 0.00 1.0 EXTENDED_LIMITS 0.00 255. /end CHARACTERISTIC
/begin CHARACTERISTIC S_ELU_L3 "Schalter Kennlinie E-Lufter Mini" VALUE 0x80062C46 Val_Wu8 1.0 Identity 0.00 1.0 EXTENDED_LIMITS 0.00 255. /end CHARACTERISTIC
/begin CHARACTERISTIC S_ENKLEMMSTAPP "Hier koennte Ihr Langbezeichner stehen" VALUE 0x80062B45 Val_Wu8 255. Def_dez_ub_q1 0.00 255. FORMAT "%3.0" /end CHARACTERISTIC
/begin CHARACTERISTIC S_EPS_EN "Elektrische Lenkhilfe enable" VALUE 0x80062C47 Val_Wu8 1.0 Identity 0.00 1.0 EXTENDED_LIMITS 0.00 255. /end CHARACTERISTIC
/begin CHARACTERISTIC S_FITSPERRE "Schalter um die Verriegelung nach Soc Bestimmung über fit-Formel zu deaktivieren" VALUE 0x80062A7A Val_Wu8 1.0 Identity 0.00 1.0 EXTENDED_LIMITS 0.00 255. /end CHARACTERISTIC
/begin CHARACTERISTIC S_FLASHKONSOLE "Applikationsschalter" VALUE 0x80062AFD Val_Wu8 1.0 Identity 0.00 1.0 EXTENDED_LIMITS 0.00 255. /end CHARACTERISTIC
/begin CHARACTERISTIC S_FLASHOLECU "Hier koennte Ihr Langbezeichner stehen" VALUE 0x80062AFE Val_Wu8 1.0 Identity 0.00 1.0 EXTENDED_LIMITS 0.00 255. /end CHARACTERISTIC
/begin CHARACTERISTIC S_FTCALCRDY "Hier koennte Ihr Langbezeichner stehen" VALUE 0x80062AFF Val_Wu8 1.0 Identity 0.00 1.0 EXTENDED_LIMITS 0.00 255. /end CHARACTERISTIC
/begin CHARACTERISTIC S_GENLLAHAPP "Applikationskonstente zum Setzen B_idlespec" VALUE 0x80062E0D Val_Wu8 1.0 Identity 0.00 1.0 EXTENDED_LIMITS 0.00 255. /end CHARACTERISTIC
/begin CHARACTERISTIC S_IGRCD_MAN "Manuelle Freischaltung iGR" VALUE 0x80062AD5 Val_Wu8 1.0 Identity 0.00 1.0 EXTENDED_LIMITS 0.00 255. /end CHARACTERISTIC
/begin CHARACTERISTIC S_IGRECU "Hier koennte Ihr Langbezeichner stehen" VALUE 0x80062B2C Val_Wu8 1.0 Identity 0.00 1.0 EXTENDED_LIMITS 0.00 255. /end CHARACTERISTIC
/begin CHARACTERISTIC S_IGRLOW_MAN "Manuelles Freischalten von iGR Low" VALUE 0x80062B42 Val_Wu8 1.0 Identity 0.00 1.0 EXTENDED_LIMITS 0.00 255. /end CHARACTERISTIC
/begin CHARACTERISTIC S_IGRPF_EN "Beruecksichtigung Partikelfilterregeneration => M+H Deaktiviert" VALUE 0x80062B2D Val_Wu8 1.0 Identity 0.00 1.0 EXTENDED_LIMITS 0.00 255. /end CHARACTERISTIC
/begin CHARACTERISTIC S_KEKP "Elektrische Kraftstoffpumpe" VALUE 0x80062C48 Val_Wu8 1.0 Identity 0.00 1.0 EXTENDED_LIMITS 0.00 255. /end CHARACTERISTIC
/begin CHARACTERISTIC S_LLANHBNS "Schalter zur Aktivierung der Bed. Bordnetztstabilität" VALUE 0x80062E0E Val_Wu8 1.0 Identity 0.00 1.0 EXTENDED_LIMITS 0.00 255. /end CHARACTERISTIC
/begin CHARACTERISTIC S_NTWBGLLGEN "Notlaufwert Leerlaufanhebung bei Generatorfehler" VALUE 0x80062E0F Val_Wu8 1.0 Identity 0.00 1.0 EXTENDED_LIMITS 0.00 255. /end CHARACTERISTIC
/begin CHARACTERISTIC S_PMMSA_AV "Schalter Deaktivierung Ausschaltverhinderer von PMMSA" VALUE 0x80062E33 Val_Wu8 255. Def_dez_ub_q1 0.00 255. FORMAT "%3.0" /end CHARACTERISTIC
/begin CHARACTERISTIC S_PMMSA_EA "Schalter Deaktivierung Einschaltaufforderer von PMMSA" VALUE 0x80062E34 Val_Wu8 255. Def_dez_ub_q1 0.00 255. FORMAT "%3.0" /end CHARACTERISTIC
/begin CHARACTERISTIC S_QVCH2OON "Freischalten von U_Batt_max aus QVC sicht (IGR high)" VALUE 0x80062A7B Val_Wu8 1.0 Identity 0.00 1.0 EXTENDED_LIMITS 0.00 255. /end CHARACTERISTIC
/begin CHARACTERISTIC S_REGOK_MAN "Schalter um Regeneration vorzeitig zu beenden" VALUE 0x80062AB5 Val_Wu8 1.0 Identity 0.00 1.0 EXTENDED_LIMITS 0.00 255. /end CHARACTERISTIC
/begin CHARACTERISTIC S_REGSTART_MAN "Schalter Start Regeneration manuell" VALUE 0x80062AB6 Val_Wu8 1.0 Identity 0.00 1.0 EXTENDED_LIMITS 0.00 255. /end CHARACTERISTIC
/begin CHARACTERISTIC S_RESTOREAP1 "Schalter auf true, d h Werte werden aus Pmrestore übernommen" VALUE 0x80062AE9 Val_Wu8 1.0 Identity 0.00 1.0 EXTENDED_LIMITS 0.00 255. /end CHARACTERISTIC
/begin CHARACTERISTIC S_VBRES1_AK "um Spannung und Prios zu testen" VALUE 0x80062C49 Val_Wu8 1.0 Identity 0.00 1.0 EXTENDED_LIMITS 0.00 255. /end CHARACTERISTIC
/begin CHARACTERISTIC S_VBRES2_AK "um Spannung und Prios zu testen" VALUE 0x80062C4A Val_Wu8 1.0 Identity 0.00 1.0 EXTENDED_LIMITS 0.00 255. /end CHARACTERISTIC
/begin CHARACTERISTIC S_VBRES3_AK "um Spannung und Prios zu testen" VALUE 0x80062C4B Val_Wu8 1.0 Identity 0.00 1.0 EXTENDED_LIMITS 0.00 255. /end CHARACTERISTIC
/begin CHARACTERISTIC S_VBRES4_AK "um Spannung und Prios zu testen" VALUE 0x80062C4C Val_Wu8 1.0 Identity 0.00 1.0 EXTENDED_LIMITS 0.00 255. /end CHARACTERISTIC
/begin CHARACTERISTIC S_VBRES5_AK "um Spannung und Prios zu testen" VALUE 0x80062C4D Val_Wu8 1.0 Identity 0.00 1.0 EXTENDED_LIMITS 0.00 255. /end CHARACTERISTIC
/begin CHARACTERISTIC WaHtEl_4WinDiagDeb.ct4WinErr1DebDef_C "/" VALUE 0x800317FA Kw_Wu8 255.0 OneToOne 0.00 255.0 /end CHARACTERISTIC
/begin CHARACTERISTIC WaHtEl_4WinDiagDeb.ct4WinErr2DebDef_C "/" VALUE 0x800317FB Kw_Wu8 255.0 OneToOne 0.00 255.0 /end CHARACTERISTIC
/begin CHARACTERISTIC WaHtEl_4WinDiagDeb.ct4WinErr3DebDef_C "/" VALUE 0x800317FC Kw_Wu8 255.0 OneToOne 0.00 255.0 /end CHARACTERISTIC
/begin CHARACTERISTIC WaHtEl_4WinDiagDeb.ct4WinErr4DebDef_C "/" VALUE 0x800317FD Kw_Wu8 255.0 OneToOne 0.00 255.0 /end CHARACTERISTIC
/begin CHARACTERISTIC WaHtEl_4WinDiagDeb.ti4WinErrDebDef_C "/" VALUE 0x800317FE Kw_Wu16 655350.0 Time_ms 0.00 655350.0 /end CHARACTERISTIC
/begin CHARACTERISTIC WaHtEl_4WinSigDur.tiErr1Min_C "/" VALUE 0x80031800 Kw_Ws16 655350.0 Time_ms -327680.0 327670.0 /end CHARACTERISTIC
/begin CHARACTERISTIC WaHtEl_4WinSigDur.tiErr1Max_C "/" VALUE 0x80031802 Kw_Ws16 655350.0 Time_ms -327680.0 327670.0 /end CHARACTERISTIC
/begin CHARACTERISTIC WaHtEl_4WinSigDur.tiErr2Min_C "/" VALUE 0x80031804 Kw_Ws16 655350.0 Time_ms -327680.0 327670.0 /end CHARACTERISTIC
/begin CHARACTERISTIC WaHtEl_4WinSigDur.tiErr2Max_C "/" VALUE 0x80031806 Kw_Ws16 655350.0 Time_ms -327680.0 327670.0 /end CHARACTERISTIC
/begin CHARACTERISTIC WaHtEl_4WinSigDur.tiErr3Min_C "/" VALUE 0x80031808 Kw_Ws16 655350.0 Time_ms -327680.0 327670.0 /end CHARACTERISTIC
/begin CHARACTERISTIC WaHtEl_4WinSigDur.tiErr3Max_C "/" VALUE 0x8003180A Kw_Ws16 655350.0 Time_ms -327680.0 327670.0 /end CHARACTERISTIC
/begin CHARACTERISTIC WaHtEl_4WinSigDur.tiErr4Min_C "/" VALUE 0x8003180C Kw_Ws16 655350.0 Time_ms -327680.0 327670.0 /end CHARACTERISTIC
/begin CHARACTERISTIC WaHtEl_4WinSigDur.tiErr4Max_C "/" VALUE 0x8003180E Kw_Ws16 655350.0 Time_ms -327680.0 327670.0 /end CHARACTERISTIC
/begin CHARACTERISTIC WaHtEl_Pwm.tiPer_C "/" VALUE 0x80031810 Kw_Ws16 6553.500 Period -3276.800 3276.700 FORMAT "%8.3" /end CHARACTERISTIC
/begin CHARACTERISTIC WaHtEl_Pwm.stLvl_C "/" VALUE 0x80031812 Kw_Wu8 1.000 OneToOne 0.00 1.000 EXTENDED_LIMITS 0.00 255.0 /end CHARACTERISTIC
/begin CHARACTERISTIC WaHtEl_Pwm.rMaxDty_C "/" VALUE 0x80031814 Kw_Ws16 100.0000 DtyCyc 0.00 100.0000 EXTENDED_LIMITS -327.6800 327.6700 /end CHARACTERISTIC
/begin CHARACTERISTIC WaHtEl_Pwm.rPerUn_C "/" VALUE 0x80031816 Kw_Ws16 3276.700 Period 0.00 3276.700 FORMAT "%8.3" EXTENDED_LIMITS -3276.800 3276.700 /end CHARACTERISTIC
/begin CHARACTERISTIC WaHtEl_Pwm.tiPh_C "/" VALUE 0x80031818 Kw_Ws16 65535.00 OneToOne -32768.00 32767.00 /end CHARACTERISTIC
/begin CHARACTERISTIC WaHtEl_PwmOut.rMin_C "/" VALUE 0x8003181A Kw_Ws16 100.0000 DtyCyc 0.00 100.0000 EXTENDED_LIMITS -327.6800 327.6700 /end CHARACTERISTIC
/begin CHARACTERISTIC WaHtEl_PwmOut.rMax_C "/" VALUE 0x8003181C Kw_Ws16 100.0000 DtyCyc 0.00 100.0000 EXTENDED_LIMITS -327.6800 327.6700 /end CHARACTERISTIC
/begin CHARACTERISTIC WaHtEl_PwmOut.tiBtwTstSCB_C "/" VALUE 0x8003181E Kw_Ws16 1000.000 Time_ms 0.00 1000.000 EXTENDED_LIMITS -327680.0 327670.0 /end CHARACTERISTIC
/begin CHARACTERISTIC WaHtEl_PwmOut.tiBtwTstOT_C "/" VALUE 0x80031820 Kw_Ws16 327.6700 Time_s 0.00 327.6700 EXTENDED_LIMITS -327.6800 327.6700 /end CHARACTERISTIC
/begin CHARACTERISTIC WaHtEl_PwmOut.numTstMax_C "/" VALUE 0x80031822 Kw_Wu16 65535.00 OneToOne 0.00 65535.00 /end CHARACTERISTIC
/begin CHARACTERISTIC WaHtEl_PwmOut.swtBattCor_C "/" VALUE 0x80031824 Kw_Wu8 1.000 OneToOne 0.00 1.000 EXTENDED_LIMITS 0.00 255.0 /end CHARACTERISTIC
/begin CHARACTERISTIC WaHtEl_PwmOut.swtPsInv_C "/" VALUE 0x80031825 Kw_Wu8 255.0 OneToOne 0.00 255.0 /end CHARACTERISTIC
/begin CHARACTERISTIC WaHtEl_rCnv_CUR "" CURVE 0x80031826 Cur_Xs16Ws16 100.0000 DtyCyc 0.00 100.0000 EXTENDED_LIMITS -327.6800 327.6700
 /begin AXIS_DESCR STD_AXIS WaHt_rHtgOut DtyCyc 8 -327.6800 327.6700 DEPOSIT ABSOLUTE /end AXIS_DESCR
/end CHARACTERISTIC
/begin CHARACTERISTIC WaHtEl_rPsDisbl_C "" VALUE 0x80031848 Val_Ws16 100.0000 DtyCyc 0.00 100.0000 EXTENDED_LIMITS -327.6800 327.6700 /end CHARACTERISTIC
/begin CHARACTERISTIC WaHtEl_rPsRecg_C "" VALUE 0x8003184A Val_Ws16 75.00000 DtyCyc 0.00 75.00000 EXTENDED_LIMITS -327.6800 327.6700 /end CHARACTERISTIC
/begin CHARACTERISTIC WaHtEl_stPsDiaDisbl_C "" VALUE 0x8003184C Val_Wu8 255.0 OneToOne 0.00 255.0 /end CHARACTERISTIC
/begin CHARACTERISTIC WaHtEl_stPsDisbl_C "" VALUE 0x8003184D Val_Wu8 255.0 OneToOne 0.00 255.0 /end CHARACTERISTIC
/begin CHARACTERISTIC WaHtEl_swtRecDeAct_C "" VALUE 0x8003184E Val_Wu8 1.000 OneToOne 0.00 1.000 EXTENDED_LIMITS 0.00 255.0 /end CHARACTERISTIC
/begin CHARACTERISTIC WaHtEl_tiRecDeb_C "" VALUE 0x80031850 Val_Ws16 10000.00 TimeDeb 0.00 10000.00 EXTENDED_LIMITS -327680.0 327670.0 /end CHARACTERISTIC
/begin CHARACTERISTIC WaHtEl_typ4WinDia_C "" VALUE 0x80031852 Val_Wu8 0.00 Typ4WinDia 0.00 0.00 FORMAT "%13.2" EXTENDED_LIMITS 0.00 3.00000000000 /end CHARACTERISTIC
/begin MEASUREMENT ACCI_aReq "Beschleunigungs-Anforderung vom ACC" SWORD Acc 1 100 -32.76800 32.76700 FORMAT "%8.5" ECU_ADDRESS 0xD00003F4 /end MEASUREMENT
/begin MEASUREMENT ACCI_stACC "Status von ACC-Steuergerät" UBYTE OneToOne 1 100 0.00 255.0 ECU_ADDRESS 0xD0001BD4 /end MEASUREMENT
/begin MEASUREMENT ACCI_stCLCTRV "" UBYTE OneToOne 1 100 0.00 255.0 ECU_ADDRESS 0xD0001BD6 /end MEASUREMENT
/begin MEASUREMENT ACCI_stError "" UBYTE OneToOne 1 100 0.00 255.0 ECU_ADDRESS 0xD0001BD7 /end MEASUREMENT
/begin MEASUREMENT ACCI_stInActv "Status der Inaktivität (für Ebene 2)" UBYTE OneToOne 1 100 0.00 255.0 ECU_ADDRESS 0xD0001BD8 /end MEASUREMENT
/begin MEASUREMENT ACCI_stOff "" UBYTE OneToOne 1 100 0.00 255.0 ECU_ADDRESS 0xD0001BD9 /end MEASUREMENT
/begin MEASUREMENT ACCI_stReq "Zustand der Beschleunigungs-Anforderung" UBYTE OneToOne 1 100 0.00 255.0 ECU_ADDRESS 0xD0001BDA /end MEASUREMENT
/begin MEASUREMENT ACCI_stRls "" UBYTE OneToOne 1 100 0.00 255.0 ECU_ADDRESS 0xD0001BDB /end MEASUREMENT
/begin MEASUREMENT ACCI_stShift "" UBYTE OneToOne 1 100 0.00 255.0 ECU_ADDRESS 0xD0001BDC /end MEASUREMENT
/begin MEASUREMENT ACCI_trqDes "Momentenanforderung ACC" SLONG Trq 1 100 -214748364.800 214748364.700 ECU_ADDRESS 0xD0002DD4 /end MEASUREMENT
/begin MEASUREMENT ACCI_trqDesRmp_mp "" SWORD Trq 1 100 -3276.800 3276.700 ECU_ADDRESS 0xC0009408 /end MEASUREMENT
/begin MEASUREMENT ACCI_trqRaw_mp "" SLONG Trq 1 100 -214748364.800 214748364.700 ECU_ADDRESS 0xC0008BA0 /end MEASUREMENT
/begin MEASUREMENT ACCI_trqWhlDesFlt_mp "" SWORD Trq 1 100 -3276.800 3276.700 ECU_ADDRESS 0xC000940A /end MEASUREMENT
/begin MEASUREMENT ACComp_trqDesFltAbv_mp "Gefiltertes Wunsch-Moment" SWORD Trq 1 100 -3276.800 3276.700 ECU_ADDRESS 0xC000940C /end MEASUREMENT
/begin MEASUREMENT ACComp_trqStat_mp "Statisches Moment" SWORD Trq 1 100 -3276.800 3276.700 ECU_ADDRESS 0xC000940E /end MEASUREMENT
/begin MEASUREMENT AccPed_facCompAcs "Faktor ""Overrun-Rampe""" SWORD Fact 1 100 -4.000000 3.999878 ECU_ADDRESS 0xD0000580 /end MEASUREMENT
/begin MEASUREMENT AccPed_nMax "Maximale Drehzahl bei Fahrpedalfehler" SWORD EngN 1 100 -16384.00 16383.50 ECU_ADDRESS 0xD0000582 /end MEASUREMENT
/begin MEASUREMENT AccPed_nMin "Minimale Drehzahl bei Fahrpedalfehler" SWORD EngN 1 100 -16384.00 16383.50 ECU_ADDRESS 0xD0000584 /end MEASUREMENT
/begin MEASUREMENT AccPed_rTrq "Gesamttriebstrangübersetzung Motor - Rad" SWORD TransR 1 100 -327.6800 327.6700 ECU_ADDRESS 0xD0000586 /end MEASUREMENT
/begin MEASUREMENT AccPed_stMS "Fahrerwunschstatus Mastershift aktiv" UBYTE OneToOne 1 100 0.00 255.0 ECU_ADDRESS 0xD0001BF2 /end MEASUREMENT
/begin MEASUREMENT AccPed_stNSetP "Status der Drehzahlanforderung der Fahrerwunschinterpretation" UBYTE OneToOne 1 100 0.00 255.0 ECU_ADDRESS 0xD0001BF3 /end MEASUREMENT
/begin MEASUREMENT AccPed_trqDes "Fahrerwunschmoment Sollpfad" SLONG TrqPrpHigh 1 100 -214748364.800 214748364.700 ECU_ADDRESS 0xD0002DF4 /end MEASUREMENT
/begin MEASUREMENT AccPed_trqDesEngLinInt_mp "In Abhängigkeit der Fahrzeuggeschwindigkeit Interpolierter Wert des Fahrerwunsches." SWORD Trq 1 100 -3276.800 3276.700 ECU_ADDRESS 0xC0009410 /end MEASUREMENT
/begin MEASUREMENT AccPed_trqDesOvrRun "Fahrerwunsch Schubbetrieb für Sollwert" SLONG TrqPrpHigh 1 100 -214748364.800 214748364.700 ECU_ADDRESS 0xD0002DF8 /end MEASUREMENT
/begin MEASUREMENT AccPed_trqDesPull "Fahrerwunschmoment Zuganteil Sollpfad" SLONG TrqPrpHigh 1 100 -214748364.800 214748364.700 ECU_ADDRESS 0xD0002DFC /end MEASUREMENT
/begin MEASUREMENT AccPed_trqEngHighDes_mp "Maximalwert des Fahrerwunsches" SWORD Trq 1 100 -3276.800 3276.700 ECU_ADDRESS 0xC0009412 /end MEASUREMENT
/begin MEASUREMENT AccPed_trqEngHighLead_mp "Maximalwert des Fahrerwunsches (Lead-Pfad)" SWORD Trq 1 100 -3276.800 3276.700 ECU_ADDRESS 0xC0009416 /end MEASUREMENT
/begin MEASUREMENT AccPed_trqEngLowDes_mp "Minalwert des Fahrerwunsches" SWORD Trq 1 100 -3276.800 3276.700 ECU_ADDRESS 0xC0009414 /end MEASUREMENT
/begin MEASUREMENT AccPed_trqEngLowLead_mp "Minimalwert des Fahrerwunsches (Lead-Pfad)" SWORD Trq 1 100 -3276.800 3276.700 ECU_ADDRESS 0xC0009418 /end MEASUREMENT
/begin MEASUREMENT AccPed_trqLead "Fahrerwunschmoment Vorhaltpfad" SLONG TrqPrpHigh 1 100 -214748364.800 214748364.700 ECU_ADDRESS 0xD0002E00 /end MEASUREMENT
/begin MEASUREMENT AccPed_trqLeadEngLinInt_mp "In Abhängigkeit der Fahrzeuggeschwindigkeit Interpolierter Wert des Fahrerwunsches (Lead-Pfad)." SWORD Trq 1 100 -3276.800 3276.700 ECU_ADDRESS 0xC000941A /end MEASUREMENT
/begin MEASUREMENT AccPed_trqLeadOvrRun_mp "Fahrerwunschmoment Schubanteil Vorhaltpfad" SLONG TrqPrpHigh 1 100 -214748364.800 214748364.700 ECU_ADDRESS 0xC0008BA4 /end MEASUREMENT
/begin MEASUREMENT AccPed_trqLeadPull_mp "Fahrerwunschmoment Zuganteil Vorhaltpfad" SLONG TrqPrpHigh 1 100 -214748364.800 214748364.700 ECU_ADDRESS 0xC0008BA8 /end MEASUREMENT
/begin MEASUREMENT AccPed_trqLimMax "Maximales Radmoment bei Fahrpedalfehler" SLONG TrqPrpHigh 1 100 -214748364.800 214748364.700 ECU_ADDRESS 0xD0002E04 /end MEASUREMENT
/begin MEASUREMENT ACCtl_stMnSwtTmr_mp "" SWORD OneToOne 1 100 -32768.00 32767.00 ECU_ADDRESS 0xC000941C /end MEASUREMENT
/begin MEASUREMENT ACCtl_stOut "" UBYTE OneToOne 1 100 0.00 255.0 ECU_ADDRESS 0xD0001BDD /end MEASUREMENT
/begin MEASUREMENT ACCtl_stTrqResv "" UBYTE OneToOne 1 100 0.00 255.0 ECU_ADDRESS 0xD0001BDE /end MEASUREMENT
/begin MEASUREMENT ACCtl_trqACFastOffLim_mp "Begrenzung Klimakompressor bei Anfahren wg. Volllast" SWORD Trq 1 100 -3276.800 3276.700 ECU_ADDRESS 0xC000941E /end MEASUREMENT
/begin MEASUREMENT ACCtl_trqACFastOffMax_mp "Maximaler Arbeitsbereich des Klimakompressors bei Volllast" SWORD Trq 1 100 -3276.800 3276.700 ECU_ADDRESS 0xC0009420 /end MEASUREMENT
/begin MEASUREMENT ACCtl_trqACTrqErr_mp "" SWORD Trq 1 100 -3276.800 3276.700 ECU_ADDRESS 0xC0009422 /end MEASUREMENT
/begin MEASUREMENT ACCtl_trqFanErr_mp "" SWORD Trq 1 100 -3276.800 3276.700 ECU_ADDRESS 0xC0009424 /end MEASUREMENT
/begin MEASUREMENT ACCtl_trqInrACDiff_mp "" SWORD Trq 1 100 -3276.800 3276.700 ECU_ADDRESS 0xC0009426 /end MEASUREMENT
/begin MEASUREMENT ACCtl_trqMaxAC "Maximal erlaubtes Kompressormoment" SWORD Trq 1 100 -3276.800 3276.700 ECU_ADDRESS 0xD00003F6 /end MEASUREMENT
/begin MEASUREMENT ACCtl_trqMaxAC_mp "" SWORD Trq 1 100 -3276.800 3276.700 ECU_ADDRESS 0xC0009428 /end MEASUREMENT
/begin MEASUREMENT ACCtl_trqStrtLim_mp "" SWORD Trq 1 100 -3276.800 3276.700 ECU_ADDRESS 0xC000942A /end MEASUREMENT
/begin MEASUREMENT ACCtl_trqTEngErr_mp "" SWORD Trq 1 100 -3276.800 3276.700 ECU_ADDRESS 0xC000942C /end MEASUREMENT
/begin MEASUREMENT ACCtl_trqTEngLim_mp "" SWORD Trq 1 100 -3276.800 3276.700 ECU_ADDRESS 0xC000942E /end MEASUREMENT
/begin MEASUREMENT ACCtl_trqTGearbxErr_mp "" SWORD Trq 1 100 -3276.800 3276.700 ECU_ADDRESS 0xC0009430 /end MEASUREMENT
/begin MEASUREMENT ACCtl_trqTGearbxLim_mp "" SWORD Trq 1 100 -3276.800 3276.700 ECU_ADDRESS 0xC0009432 /end MEASUREMENT
/begin MEASUREMENT ACCtl_trqVehVErr_mp "" SWORD Trq 1 100 -3276.800 3276.700 ECU_ADDRESS 0xC0009434 /end MEASUREMENT
/begin MEASUREMENT Activeflashreqs "Hiermit wird zwischen Active1 und AcitveN unterschieden" UBYTE Def_dez_ub_q1 1 100 0.00 255. FORMAT "%3.0" ECU_ADDRESS 0xC000AF6C /end MEASUREMENT
/begin MEASUREMENT ActMod_trq "aktuelles Motorausgangsmoment" SWORD Trq 1 100 -3276.800 3276.700 ECU_ADDRESS 0xD0000588 /end MEASUREMENT
/begin MEASUREMENT ActMod_trqClth "aktuelles Kupplungsmoment" SWORD Trq 1 100 -3276.800 3276.700 ECU_ADDRESS 0xD000058A /end MEASUREMENT
/begin MEASUREMENT ActMod_trqCurr_mp "aktuelles rückgerechnetes inneres Motormoment ohne Startmoment" SWORD Trq 1 100 -3276.800 3276.700 ECU_ADDRESS 0xC0009436 /end MEASUREMENT
/begin MEASUREMENT ActMod_trqInr "" SWORD Trq 1 100 -3276.800 3276.700 ECU_ADDRESS 0xD000058E /end MEASUREMENT
/begin MEASUREMENT AC_stRedAC "" UBYTE OneToOne 1 100 0.00 255.0 ECU_ADDRESS 0xD0001BDF /end MEASUREMENT
/begin MEASUREMENT AC_trqDes "Wunsch-Moment" SWORD Trq 1 100 -3276.800 3276.700 ECU_ADDRESS 0xD00003F8 /end MEASUREMENT
/begin MEASUREMENT AC_trqMaxAC "Erlaubte Kompressor Momentenlast" SWORD Trq 1 100 -3276.800 3276.700 ECU_ADDRESS 0xD00003FA /end MEASUREMENT
/begin MEASUREMENT AC_trqResv "Reserve-Momment" SWORD Trq 1 100 -3276.800 3276.700 ECU_ADDRESS 0xD00003FC /end MEASUREMENT
/begin MEASUREMENT Aep_klemmstat "Umweltbed. Klemmenstatus" UBYTE Def_dez_ub_q1 1 100 0.00 255. FORMAT "%3.0" ECU_ADDRESS 0xC000AF5B /end MEASUREMENT
/begin MEASUREMENT AirC_stPsCmpr "Endgültiger Digitalausgang zur Endstufe des Klimaanlagen-Kompressorstellers" UBYTE OneToOne 1 100 0.00 255.0 ECU_ADDRESS 0xD0001BF6 /end MEASUREMENT
/begin MEASUREMENT AirC_stPsCmpr_mp "Messpunkt des Digitalausgangs an den Klimaanlagen-Kompressorsteller vor der Fehlerbehandlung." UBYTE OneToOne 1 100 0.00 255.0 ECU_ADDRESS 0xC000AF34 /end MEASUREMENT
/begin MEASUREMENT AirC_stSwt "" UBYTE OneToOne 1 100 0.00 255.0 ECU_ADDRESS 0xD0001BF7 /end MEASUREMENT
/begin MEASUREMENT AirC_stSwtPrs "" UBYTE OneToOne 1 100 0.00 255.0 ECU_ADDRESS 0xD0001BF8 /end MEASUREMENT
/begin MEASUREMENT AirC_stSwtRaw "" UBYTE OneToOne 1 100 0.00 255.0 ECU_ADDRESS 0xD0001BF9 /end MEASUREMENT
/begin MEASUREMENT AirC_trqCmprMax "Maximales Verbrauchsmoment durch den Klimaanlagenkompressor" SWORD Trq 1 100 -3276.800 3276.700 ECU_ADDRESS 0xD0000594 /end MEASUREMENT
/begin MEASUREMENT Battm2loffst "bei MSA Fzg ist Battm2l um diesen Wert verschoben" SWORD Def_f_sw_b100 1 100 -100.0000 99.99695 FORMAT "%8.4" ECU_ADDRESS 0xC0009470 /end MEASUREMENT
/begin MEASUREMENT Batt_h2m_l "high to medium" SWORD Def_f_sw_b100 1 100 -100.0000 99.99695 FORMAT "%8.4" ECU_ADDRESS 0xC0009438 /end MEASUREMENT
/begin MEASUREMENT Batt_h2m_r "high to medium Hysterese" SWORD Def_f_sw_b100 1 100 -100.0000 99.99695 FORMAT "%8.4" ECU_ADDRESS 0xC000943A /end MEASUREMENT
/begin MEASUREMENT Batt_m2l "medium to low" SWORD Def_f_sw_b100 1 100 -100.0000 99.99695 FORMAT "%8.4" ECU_ADDRESS 0xC000943C /end MEASUREMENT
/begin MEASUREMENT Batt_m2l_l "medium 2 low" SWORD Def_f_sw_b100 1 100 -100.0000 99.99695 FORMAT "%8.4" ECU_ADDRESS 0xC000943E /end MEASUREMENT
/begin MEASUREMENT Batt_m2l_r "medium to low Hysterese" SWORD Def_f_sw_b100 1 100 -100.0000 99.99695 FORMAT "%8.4" ECU_ADDRESS 0xC0009440 /end MEASUREMENT
/begin MEASUREMENT Com_bRecACC "" UBYTE OneToOne 1 100 0.00 255.0 ECU_ADDRESS 0xD0001C66 /end MEASUREMENT
/begin MEASUREMENT Com_dTrqWhlDemCHK "" UBYTE OneToOne 1 100 0.00 255.0 ECU_ADDRESS 0xD0001CB0 /end MEASUREMENT
/begin MEASUREMENT Com_dTrqWhlDemCTR "" UWORD OneToOne 1 100 0.00 65535.00 ECU_ADDRESS 0xD000155C /end MEASUREMENT
/begin MEASUREMENT Com_dTrqWhlDemFASCHK_FX "" UBYTE OneToOne 1 100 0.00 255.0 ECU_ADDRESS 0xD0001CB1 /end MEASUREMENT
/begin MEASUREMENT Com_dTrqWhlDemFASCTR_FX "" UWORD OneToOne 1 100 0.00 65535.00 ECU_ADDRESS 0xD000155E /end MEASUREMENT
/begin MEASUREMENT Com_stDrvAssist "" UBYTE OneToOne 1 100 0.00 255.0 ECU_ADDRESS 0xD0001CFF /end MEASUREMENT
/begin MEASUREMENT Com_stFolDyn "" UBYTE OneToOne 1 100 0.00 255.0 ECU_ADDRESS 0xD0001D10 /end MEASUREMENT
/begin MEASUREMENT Com_stShftIdctrDemRglX "" UBYTE OneToOne 1 100 0.00 255.0 ECU_ADDRESS 0xD0001D66 /end MEASUREMENT
/begin MEASUREMENT Com_stTrqWhl "" UBYTE OneToOne 1 100 0.00 255.0 ECU_ADDRESS 0xD0001D9C /end MEASUREMENT
/begin MEASUREMENT Com_stTrqWhlDemFASQl "" UBYTE default 1 100 0.00 255.0 FORMAT "%5.1" ECU_ADDRESS 0xD0001D9D /end MEASUREMENT
/begin MEASUREMENT Com_stTrqWhlDemFASQl_FX "" UBYTE OneToOne 1 100 0.00 255.0 ECU_ADDRESS 0xD0001D9E /end MEASUREMENT
/begin MEASUREMENT Com_stTrqWhlDesQl "" UWORD default 1 100 0.00 65535.00 FORMAT "%8.2" ECU_ADDRESS 0xD000158C /end MEASUREMENT
/begin MEASUREMENT Com_stTrqWhlDesQl_FX "" UWORD OneToOne 1 100 0.00 65535.00 ECU_ADDRESS 0xD000158E /end MEASUREMENT
/begin MEASUREMENT Com_trqWhlDes "" SLONG TrqPrpHigh 1 100 -214748364.800 214748364.700 ECU_ADDRESS 0xD0002E78 /end MEASUREMENT
/begin MEASUREMENT Com_trqWhlDes_FX "" SLONG TrqPrpHigh 1 100 -214748364.800 214748364.700 ECU_ADDRESS 0xD0002E7C /end MEASUREMENT
/begin MEASUREMENT Count_av_utn "Zähler verzögerung bis klar ob msa Start vorliegt" UBYTE Def_dez_ub_q1 1 100 0.00 255. FORMAT "%3.0" ECU_ADDRESS 0xC000AFC2 /end MEASUREMENT
/begin MEASUREMENT Count_ea_ibn "liegt strom schon 10 sekunden unter grenze?" UBYTE Def_dez_ub_q1 1 100 0.00 255. FORMAT "%3.0" ECU_ADDRESS 0xC000AFC3 /end MEASUREMENT
/begin MEASUREMENT Count_out_1 "Zähelr 1" UWORD Def_dez_uw_q1 1 100 0.00 65535. FORMAT "%5.0" ECU_ADDRESS 0xC00094B2 /end MEASUREMENT
/begin MEASUREMENT Count_out_2 "Zähler 2" UWORD Def_dez_uw_q1 1 100 0.00 65535. FORMAT "%5.0" ECU_ADDRESS 0xC00094B4 /end MEASUREMENT
/begin MEASUREMENT Count_out_3 "Zähler 3" UWORD Def_dez_uw_q1 1 100 0.00 65535. FORMAT "%5.0" ECU_ADDRESS 0xC00094B6 /end MEASUREMENT
/begin MEASUREMENT Count_out_4 "Zähler 4" UWORD Def_dez_uw_q1 1 100 0.00 65535. FORMAT "%5.0" ECU_ADDRESS 0xC00094B8 /end MEASUREMENT
/begin MEASUREMENT Count_out_5 "Zähler 5" UWORD Def_dez_uw_q1 1 100 0.00 65535. FORMAT "%5.0" ECU_ADDRESS 0xC00094BA /end MEASUREMENT
/begin MEASUREMENT Count_out_6 "Zähler 6" UWORD Def_dez_uw_q1 1 100 0.00 65535. FORMAT "%5.0" ECU_ADDRESS 0xC00094BC /end MEASUREMENT
/begin MEASUREMENT Count_out_7 "Zähler 7" UWORD Def_dez_uw_q1 1 100 0.00 65535. FORMAT "%5.0" ECU_ADDRESS 0xC00094BE /end MEASUREMENT
/begin MEASUREMENT Ctrpcos "Steuerung_Standverbraucher" UBYTE Def_dez_ub_q1 1 100 0.00 3.0 ECU_ADDRESS 0xC000AF82 /end MEASUREMENT
/begin MEASUREMENT Dfgenfilt "Gefiltertes Signal von Dffgen" UBYTE Def_f_ub_b100 1 100 0.00 99.61 ECU_ADDRESS 0xC000AFBD /end MEASUREMENT
/begin MEASUREMENT Dod_start "DoD bei Start der Regeneration" UBYTE Def_f_ub_b100 1 100 0.00 99.61 ECU_ADDRESS 0xC000AF52 /end MEASUREMENT
/begin MEASUREMENT Dqe_regstart "Entladene Ladungsmenge seit Regenerationsstart" UWORD Def_ql_uw_q0p29127 1 100 0.00 19088.4 FORMAT "%7.1" ECU_ADDRESS 0xC0009452 /end MEASUREMENT
/begin MEASUREMENT Dql_regstart "Geladene Ladungsmenge seit Regenerationsstart" UWORD Def_ql_uw_q0p29127 1 100 0.00 19088.4 FORMAT "%7.1" ECU_ADDRESS 0xC0009454 /end MEASUREMENT
/begin MEASUREMENT Dsoc_igrmax "Obere iGR-DSOC-Grenze" SWORD Def_f_sw_b100 1 100 -100.0000 99.99695 FORMAT "%8.4" ECU_ADDRESS 0xC0009472 /end MEASUREMENT
/begin MEASUREMENT Dsoc_igrmin "Untere iGR-DSOC-Grenze" SWORD Def_f_sw_b100 1 100 -100.0000 99.99695 FORMAT "%8.4" ECU_ADDRESS 0xC0009474 /end MEASUREMENT
/begin MEASUREMENT Dsoc_igrmin2 "unterste IGR-min-Schwelle" SWORD Def_f_sw_b100 1 100 -100.0000 99.99695 FORMAT "%8.4" ECU_ADDRESS 0xC0009476 /end MEASUREMENT
/begin MEASUREMENT Dsoc_msaav1 "Obere MSA Abschaltverhinderer Grenze" SWORD Def_f_sw_b100 1 100 -100.0000 99.99695 FORMAT "%8.4" ECU_ADDRESS 0xC0009478 /end MEASUREMENT
/begin MEASUREMENT Dsoc_msaav2 "Untere MSA Abschaltverhinderer Grenze" SWORD Def_f_sw_b100 1 100 -100.0000 99.99695 FORMAT "%8.4" ECU_ADDRESS 0xC000947A /end MEASUREMENT
/begin MEASUREMENT Dsoc_msaea1 "MSA CC-Meldung Grenze" SWORD Def_f_sw_b100 1 100 -100.0000 99.99695 FORMAT "%8.4" ECU_ADDRESS 0xC000947C /end MEASUREMENT
/begin MEASUREMENT Dsoc_msaea2 "Untere MSA Einschaltaufvorderer Grenze" SWORD Def_f_sw_b100 1 100 -100.0000 99.99695 FORMAT "%8.4" ECU_ADDRESS 0xC000947E /end MEASUREMENT
/begin MEASUREMENT Dsoc_temp "Ladezustand Zwischenvariable" SWORD Def_f_sw_b100 1 100 -100.0000 99.99695 FORMAT "%8.4" ECU_ADDRESS 0xC0009442 /end MEASUREMENT
/begin MEASUREMENT D_qsfg1 "Abstand zur unteren Startfähigkeitsgrenze" UWORD Def_ql_uw_q0p0182 1 100 0.00 1193.023 FORMAT "%8.3" ECU_ADDRESS 0xC00094AA /end MEASUREMENT
/begin MEASUREMENT D_qsfg2 "Abstand zur oberen Startfähikeitsgrenze" UWORD Def_ql_uw_q0p0182 1 100 0.00 1193.023 FORMAT "%8.3" ECU_ADDRESS 0xC00094AC /end MEASUREMENT
/begin MEASUREMENT D_ubatt_bt "Integrationszähler erhöhte Spannung über Mittelwert" SWORD Def_u_sw_q0p00488 1 100 -160.0000 159.9951 FORMAT "%8.4" ECU_ADDRESS 0xC0009444 /end MEASUREMENT
/begin MEASUREMENT Enklemmstate "Klemmenstatus" UBYTE Def_dez_ub_q1 1 100 0.00 255. FORMAT "%3.0" ECU_ADDRESS 0xC000AF83 /end MEASUREMENT
/begin MEASUREMENT Entladezeit "Entladezeit" UBYTE Def_td_ub_q1 1 100 0.00 255.0 FORMAT "%5.1" ECU_ADDRESS 0xC000AF3B /end MEASUREMENT
/begin MEASUREMENT E_flstatin "Temp. Enumeration für Flaststatin" UBYTE Def_dez_ub_q1 1 100 0.00 255. FORMAT "%3.0" ECU_ADDRESS 0xC000AF6D /end MEASUREMENT
/begin MEASUREMENT E_flstatout "Enumeration für Flashstatout" UBYTE Def_dez_ub_q1 1 100 0.00 255. FORMAT "%3.0" ECU_ADDRESS 0xC000AF6E /end MEASUREMENT
/begin MEASUREMENT Flashdurmax "Berechneter dSOC-Duration Wert im Initial Prozess" UWORD Def_dez_uw_q1 1 100 0.00 65535. FORMAT "%5.0" ECU_ADDRESS 0xC0009484 /end MEASUREMENT
/begin MEASUREMENT Flashdurout "Zur Verfügung stehende Flashdauer die von AEPFLASHOL berechnet wird" UWORD Def_dez_uw_q1 1 100 0.00 65535. FORMAT "%5.0" ECU_ADDRESS 0xC0009486 /end MEASUREMENT
/begin MEASUREMENT Flashstatemachine "Gibt die Reihenfolge bzw. den Ablauf im Modul an" UBYTE Def_dez_ub_q1 1 100 0.00 255. FORMAT "%3.0" ECU_ADDRESS 0xC000AF6F /end MEASUREMENT
/begin MEASUREMENT Flashstatout "Liefert den Status von AEP ob weiter geflasht werden kann oder nicht" UBYTE Def_dez_ub_q1 1 100 0.00 255. FORMAT "%3.0" ECU_ADDRESS 0xC000AF70 /end MEASUREMENT
/begin MEASUREMENT Fs_pm "Fehlerspeicher Powermanagement, Bitcodiert" UBYTE Def_dez_ub_q1 1 100 0.00 255. FORMAT "%3.0" ECU_ADDRESS 0xC000AF5C /end MEASUREMENT
/begin MEASUREMENT Fzgzustand "verschiedene Fahrzeugzustände" UBYTE Def_dez_ub_q1 1 100 0.00 255. FORMAT "%3.0" ECU_ADDRESS 0xC000AF71 /end MEASUREMENT
/begin MEASUREMENT Gen_dfvorhs "DF-Signal Vorhersage" UBYTE Def_f_ub_b100 1 100 0.00 99.61 ECU_ADDRESS 0xC000AFBE /end MEASUREMENT
/begin MEASUREMENT Ibsbor_hb "highbyte ibsborctr" UBYTE Def_dez_ub_q1 1 100 0.00 255. FORMAT "%3.0" ECU_ADDRESS 0xC000AF5D /end MEASUREMENT
/begin MEASUREMENT Igrinfo "Infospeicher iGR" UBYTE Def_dez_ub_q1 1 100 0.00 255. FORMAT "%3.0" ARRAY_SIZE 30 ECU_ADDRESS 0xC000B627 /end MEASUREMENT
/begin MEASUREMENT Igr_inforeset "Zähler, wie oft Infospeicher zurückgesetzt wurde" UBYTE Def_dez_ub_q1 1 100 0.00 255. FORMAT "%3.0" ECU_ADDRESS 0xC000AF7B /end MEASUREMENT
/begin MEASUREMENT I_battfiltaep "Gefilterter Batteriestrom" UWORD Def_i_uw_q0p08_o200 1 100 -200.0000 5042.800 FORMAT "%8.3" ECU_ADDRESS 0xC0009488 /end MEASUREMENT
/begin MEASUREMENT I_bnfilt "gefilterter Bordnetzstrom" UWORD Def_i_uw_q0p08_o200 1 100 -200.0000 5042.800 FORMAT "%8.3" ECU_ADDRESS 0xC00094AE /end MEASUREMENT
/begin MEASUREMENT I_bnfiltlim "gefilterter Bordnetzstrom; Quantisierung von nachfolgender KL" SBYTE Def_dez_sb_q1 1 100 -128. 127. FORMAT "%3.0" ECU_ADDRESS 0xC000AF86 /end MEASUREMENT
/begin MEASUREMENT I_bn_bl_filt "gefilterter Bordnetzstrom lange Zeitkonstante" UWORD Def_i_uw_q0p08_o200 1 100 -200.0000 5042.800 FORMAT "%8.3" ECU_ADDRESS 0xC00094E8 /end MEASUREMENT
/begin MEASUREMENT I_bn_unfilt "ungefilterter Bordnetzstrom" UWORD Def_i_uw_q0p08_o200 1 100 -200.0000 5042.800 FORMAT "%8.3" ECU_ADDRESS 0xC00094EA /end MEASUREMENT
/begin MEASUREMENT Kapa_verlust "Zwsichenvariable Kapazitätsverlust" UBYTE Def_f_ub_b100 1 100 0.00 99.61 ECU_ADDRESS 0xC000AF3C /end MEASUREMENT
/begin MEASUREMENT K_TAUSLOES "Oberhalb des Wertes wird die Reg. über die Zeit aktiviert" UWORD Def_td_uw_q1 1 100 0.00 65535. FORMAT "%5.0" ECU_ADDRESS 0xC0009456 /end MEASUREMENT
/begin MEASUREMENT Ladezeit "Ladezeit" UWORD Def_td_uw_q0p1 1 100 0.00 6553.5 FORMAT "%6.1" ECU_ADDRESS 0xC0009446 /end MEASUREMENT
/begin MEASUREMENT Lemcnt_reset "Zwischengröße Setzen LEMINFO auf Defaultwert" UWORD Def_dez_uw_q1 1 100 0.00 65535. FORMAT "%5.0" ECU_ADDRESS 0xC00094C0 /end MEASUREMENT
/begin MEASUREMENT Leminfo "Infospeicher für LEM" UBYTE Def_dez_ub_q1 1 100 0.00 255. FORMAT "%3.0" ARRAY_SIZE 40 ECU_ADDRESS 0xC000B645 /end MEASUREMENT
/begin MEASUREMENT Nslb "N_soll Korrektur von Ladebilanz Batterie" SWORD Def_n_sw_q1p0 1 100 0.00 32767. FORMAT "%5.0" ECU_ADDRESS 0xC00094E6 /end MEASUREMENT
/begin MEASUREMENT Pmbackup "Array zum ständigen Sichern (alle 5 Sek) der Werte für die Individualdatenrettung beim Speichern" UBYTE Def_dez_ub_q1 1 100 0.00 255. FORMAT "%3.0" ARRAY_SIZE 7 ECU_ADDRESS 0xC000B5B8 /end MEASUREMENT
/begin MEASUREMENT Pminfo1 "Infospeicher 1 vom Powermanagement" UWORD Def_dez_uw_q1 1 100 0.00 65535. FORMAT "%5.0" ARRAY_SIZE 37 ECU_ADDRESS 0xC000B5C0 /end MEASUREMENT
/begin MEASUREMENT Pminfo2 "Fehlerinfo2 vom Powermanagement" UBYTE Def_dez_ub_q1 1 100 0.00 255. FORMAT "%3.0" ARRAY_SIZE 29 ECU_ADDRESS 0xC000B60A /end MEASUREMENT
/begin MEASUREMENT Pr_batt_mx "Prio von Batterie MaxSpg" UBYTE Def_dez_ub_q1 1 100 0.00 255. FORMAT "%3.0" ECU_ADDRESS 0xC000AF3D /end MEASUREMENT
/begin MEASUREMENT Pr_batt_soll "Prio von Batterie Sollspg" UBYTE Def_dez_ub_q1 1 100 0.00 255. FORMAT "%3.0" ECU_ADDRESS 0xC000AF3E /end MEASUREMENT
/begin MEASUREMENT Pr_dynbatt_mn "Prio von Batterieminspg dyn" UBYTE Def_dez_ub_q1 1 100 0.00 255. FORMAT "%3.0" ECU_ADDRESS 0xC000AF3F /end MEASUREMENT
/begin MEASUREMENT Pr_geblaese_dpn "Prio Gebläse pos und neg Gradient" UBYTE Def_dez_ub_q1 1 100 0.00 255. FORMAT "%3.0" ECU_ADDRESS 0xC000AF87 /end MEASUREMENT
/begin MEASUREMENT Pr_igr_dpn "Prioritaet iGR Spannungsrampe positiv und negativ" UBYTE Def_dez_ub_q1 1 100 0.00 255. FORMAT "%3.0" ECU_ADDRESS 0xC000AF74 /end MEASUREMENT
/begin MEASUREMENT Pr_igr_soll "Prioritaet iGR Sollspannungsanforderung" UBYTE Def_dez_ub_q1 1 100 0.00 255. FORMAT "%3.0" ECU_ADDRESS 0xC000AF75 /end MEASUREMENT
/begin MEASUREMENT Pr_licht_dpn "Prio Licht pos und neg Gradient" UBYTE Def_dez_ub_q1 1 100 0.00 255. FORMAT "%3.0" ECU_ADDRESS 0xC000AF88 /end MEASUREMENT
/begin MEASUREMENT Pr_stabatt_mn "Prio von Batterieminspg stat" UBYTE Def_dez_ub_q1 1 100 0.00 255. FORMAT "%3.0" ECU_ADDRESS 0xC000AF40 /end MEASUREMENT
/begin MEASUREMENT Pr_vbres3_dpn "Prio Reserveverbraucher 3 pos und neg Gradient" UBYTE Def_dez_ub_q1 1 100 0.00 255. FORMAT "%3.0" ECU_ADDRESS 0xC000AF89 /end MEASUREMENT
/begin MEASUREMENT Pr_vbres4_dpn "Prio Reserveverbraucher 4 pos und neg Gradient" UBYTE Def_dez_ub_q1 1 100 0.00 255. FORMAT "%3.0" ECU_ADDRESS 0xC000AF8A /end MEASUREMENT
/begin MEASUREMENT Pr_vbtherm_mx "Prio Max Thermische Überlastung" UBYTE Def_dez_ub_q1 1 100 0.00 255. FORMAT "%3.0" ECU_ADDRESS 0xC000AF8B /end MEASUREMENT
/begin MEASUREMENT Qeladhi_start "IGR-Info Startwert iGR-High" UWORD Def_ql_uw_q0p29127 1 100 0.00 19087.9 FORMAT "%7.1" ECU_ADDRESS 0xC0009490 /end MEASUREMENT
/begin MEASUREMENT Qeladmed_start "IGR-Info Startwert iGR-Medium" UWORD Def_ql_uw_q0p29127 1 100 0.00 19087.9 FORMAT "%7.1" ECU_ADDRESS 0xC0009492 /end MEASUREMENT
/begin MEASUREMENT Qelad_igrhi "IGR-Info Entladung bei iGR-High" UWORD Def_ql_uw_q0p29127 1 100 0.00 19087.9 FORMAT "%7.1" ECU_ADDRESS 0xC0009494 /end MEASUREMENT
/begin MEASUREMENT Qladlow_int "IGR-InfoIntegrator Ladung iGR-Low" ULONG Def_dez_ul_q1 1 100 0.00 4294967295. FORMAT "%7.0" ECU_ADDRESS 0xC0008BAC /end MEASUREMENT
/begin MEASUREMENT Qladmed_start "IGR-Info Startwert iGR-Medium" UWORD Def_ql_uw_q0p29127 1 100 0.00 19087.9 FORMAT "%7.1" ECU_ADDRESS 0xC0009496 /end MEASUREMENT
/begin MEASUREMENT Qlad_aktfahr "in die Batterie geflossene Lademenge seid letztem MSA-Start" UWORD Def_ql_uw_q0p0182 1 100 0.00 1193.023 FORMAT "%8.3" ECU_ADDRESS 0xC00094EC /end MEASUREMENT
/begin MEASUREMENT Qlad_igrlow "IGR-Info Ladung bei iGR-Low" UWORD Def_ql_uw_q0p29127 1 100 0.00 19087.9 FORMAT "%7.1" ECU_ADDRESS 0xC0009498 /end MEASUREMENT
/begin MEASUREMENT Qtmp "temporärer Ladestrom" UWORD Def_ql_uw_q0p0182 1 100 0.00 1193.023 FORMAT "%8.3" ECU_ADDRESS 0xC000948A /end MEASUREMENT
/begin MEASUREMENT Qvcbackup1 "Wert aus QVC Modul welcher beim Flashen gebackupt wird" UBYTE ident 1 100 0.00 255. FORMAT "%3.0" ECU_ADDRESS 0xC000AF5E /end MEASUREMENT
/begin MEASUREMENT Qvcbackup2 "Wert aus QVC Modul welcher beim Flashen gebackupt wird" UBYTE ident 1 100 0.00 255. FORMAT "%3.0" ECU_ADDRESS 0xC000AF5F /end MEASUREMENT
/begin MEASUREMENT Qvcbackup3 "Wert aus QVC Modul welcher beim Flashen gebackupt wird" UBYTE ident 1 100 0.00 255. FORMAT "%3.0" ECU_ADDRESS 0xC000AF60 /end MEASUREMENT
/begin MEASUREMENT Q_flashdiff "Zwischenwert für Bestimmung der Energiebilanz" UWORD Def_ql_uw_q0p0182 1 100 0.00 1193.023 FORMAT "%8.3" ECU_ADDRESS 0xC000948C /end MEASUREMENT
/begin MEASUREMENT Q_regend "Durchgesetzte Ladung beim Ende der letzten Regeneration" UWORD Def_ql_uw_q0p29127 1 100 0.00 19088.4 FORMAT "%7.1" ECU_ADDRESS 0xC0009458 /end MEASUREMENT
/begin MEASUREMENT Soc_flashdiff "Zwichenwert zur Bestimmung von Energiebilanz" UWORD Def_f_uw_b100 1 100 0.00 99.99847 ECU_ADDRESS 0xC000948E /end MEASUREMENT
/begin MEASUREMENT Stat_quali_1 "Häufigkeit Spannungsqualität A" UBYTE Def_dez_ub_q1 1 100 0.00 255. FORMAT "%3.0" ECU_ADDRESS 0xC000AFAB /end MEASUREMENT
/begin MEASUREMENT Stat_quali_2 "Häufigkeit Spannungsqualität B" UBYTE Def_dez_ub_q1 1 100 0.00 255. FORMAT "%3.0" ECU_ADDRESS 0xC000AFAC /end MEASUREMENT
/begin MEASUREMENT Stat_quali_3 "Häufigkeit Spannungsqualität C" UBYTE Def_dez_ub_q1 1 100 0.00 255. FORMAT "%3.0" ECU_ADDRESS 0xC000AFAD /end MEASUREMENT
/begin MEASUREMENT Stat_sv_reg2 "HiByte Stat_sv_reg für Umweltbedinung" UBYTE Def_dez_ub_q1 1 100 0.00 255. FORMAT "%3.0" ECU_ADDRESS 0xC000AF61 /end MEASUREMENT
/begin MEASUREMENT Stat_ubattsoll_h "Häufigkeit Batterieladung Stufe H" UBYTE Def_dez_ub_q1 1 100 0.00 255. FORMAT "%3.0" ECU_ADDRESS 0xC000AFAE /end MEASUREMENT
/begin MEASUREMENT Stat_ubattsoll_l "Häufigkeit Batterieladung Stufe L" UBYTE Def_dez_ub_q1 1 100 0.00 255. FORMAT "%3.0" ECU_ADDRESS 0xC000AFAF /end MEASUREMENT
/begin MEASUREMENT St_aepflashol0 "Statuswort" UBYTE Def_st_ub_q1 1 100 0.00 255. FORMAT "%3.0" ECU_ADDRESS 0xC000AF72 /end MEASUREMENT
/begin MEASUREMENT St_aepflasholout "Statuswort" UBYTE Def_st_ub_q1 1 100 0.00 255. FORMAT "%3.0" ECU_ADDRESS 0xC000AF73 /end MEASUREMENT
/begin MEASUREMENT St_aepigrdiag1 "Statuswort" UBYTE Def_st_ub_q1 1 100 0.00 255. FORMAT "%3.0" ECU_ADDRESS 0xC000AF7C /end MEASUREMENT
/begin MEASUREMENT St_aepigrdiag_a0 "Statuswort" UBYTE Def_st_ub_q1 1 100 0.00 255. FORMAT "%3.0" ECU_ADDRESS 0xC000AF7D /end MEASUREMENT
/begin MEASUREMENT St_aepigrdiag_b0 "Statuswort" UBYTE Def_st_ub_q1 1 100 0.00 255. FORMAT "%3.0" ECU_ADDRESS 0xC000AF7E /end MEASUREMENT
/begin MEASUREMENT St_aepigrdiag_c0 "Statuswort" UBYTE Def_st_ub_q1 1 100 0.00 255. FORMAT "%3.0" ECU_ADDRESS 0xC000AF7F /end MEASUREMENT
/begin MEASUREMENT St_aepklemmab "Statuswort" UBYTE Def_st_ub_q1 1 100 0.00 255. FORMAT "%3.0" ECU_ADDRESS 0xC000AF84 /end MEASUREMENT
/begin MEASUREMENT St_aepklemmab1 "Statuswort" UBYTE Def_st_ub_q1 1 100 0.00 255. FORMAT "%3.0" ECU_ADDRESS 0xC000AF85 /end MEASUREMENT
/begin MEASUREMENT St_aeplemdiag0 "Statuswort" UBYTE Def_st_ub_q1 1 100 0.00 255. FORMAT "%3.0" ECU_ADDRESS 0xC000AFB0 /end MEASUREMENT
/begin MEASUREMENT St_aeplemdiag1 "Statuswort" UBYTE Def_st_ub_q1 1 100 0.00 255. FORMAT "%3.0" ECU_ADDRESS 0xC000AFB1 /end MEASUREMENT
/begin MEASUREMENT St_aeplemdiag2 "Statuswort" UBYTE Def_st_ub_q1 1 100 0.00 255. FORMAT "%3.0" ECU_ADDRESS 0xC000AFB2 /end MEASUREMENT
/begin MEASUREMENT St_co2mng "Statuswort" UBYTE Def_st_ub_q1 1 100 0.00 255. FORMAT "%3.0" ECU_ADDRESS 0xC000AF59 /end MEASUREMENT
/begin MEASUREMENT St_co2mng_1 "Statuswort" UBYTE Def_st_ub_q1 1 100 0.00 255. FORMAT "%3.0" ECU_ADDRESS 0xC000AF5A /end MEASUREMENT
/begin MEASUREMENT St_igr1 "Statuswort" UBYTE Def_st_ub_q1 1 100 0.00 255. FORMAT "%3.0" ECU_ADDRESS 0xC000AF76 /end MEASUREMENT
/begin MEASUREMENT St_igroutnv "Statuswort" UBYTE Def_st_ub_q1 1 100 0.00 255. FORMAT "%3.0" ECU_ADDRESS 0xC000AF77 /end MEASUREMENT
/begin MEASUREMENT St_igrsbcalc "Statuswort" UBYTE Def_st_ub_q1 1 100 0.00 255. FORMAT "%3.0" ECU_ADDRESS 0xC000AF81 /end MEASUREMENT
/begin MEASUREMENT St_igr_a0old "Altes Statusbyte" UBYTE Def_st_ub_q1 1 100 0.00 255. FORMAT "%3.0" ECU_ADDRESS 0xC000AF80 /end MEASUREMENT
/begin MEASUREMENT St_llpmctrl0 "Statuswort" UBYTE Def_st_ub_q1 1 100 0.00 255. FORMAT "%3.0" ECU_ADDRESS 0xC000AFBF /end MEASUREMENT
/begin MEASUREMENT St_llpmctrl1 "Statuswort" UBYTE Def_st_ub_q1 1 100 0.00 255. FORMAT "%3.0" ECU_ADDRESS 0xC000AFC0 /end MEASUREMENT
/begin MEASUREMENT St_llranh0 "Statuswort" UBYTE Def_st_ub_q1 1 100 0.00 255. FORMAT "%3.0" ECU_ADDRESS 0xC000AFC1 /end MEASUREMENT
/begin MEASUREMENT St_pmbattmng0 "Statuswort" UBYTE Def_st_ub_q1 1 100 0.00 255. FORMAT "%3.0" ECU_ADDRESS 0xC000AF41 /end MEASUREMENT
/begin MEASUREMENT St_pmbattmng1 "Statuswort" UBYTE Def_st_ub_q1 1 100 0.00 255. FORMAT "%3.0" ECU_ADDRESS 0xC000AF42 /end MEASUREMENT
/begin MEASUREMENT St_pmbattmng2 "Statuswort" UBYTE Def_st_ub_q1 1 100 0.00 255. FORMAT "%3.0" ECU_ADDRESS 0xC000AF43 /end MEASUREMENT
/begin MEASUREMENT St_pmbattreg2 "Statuswort" UBYTE Def_st_ub_q1 1 100 0.00 255. FORMAT "%3.0" ECU_ADDRESS 0xC000AF53 /end MEASUREMENT
/begin MEASUREMENT St_pmbattregen "Statuswort" UBYTE Def_st_ub_q1 1 100 0.00 255. FORMAT "%3.0" ECU_ADDRESS 0xC000AF54 /end MEASUREMENT
/begin MEASUREMENT St_pmbattregen2 "Statuswort" UBYTE Def_st_ub_q1 1 100 0.00 255. FORMAT "%3.0" ECU_ADDRESS 0xC000AF55 /end MEASUREMENT
/begin MEASUREMENT St_pmdiag0 "Statuswort" UBYTE Def_st_ub_q1 1 100 0.00 255. FORMAT "%3.0" ECU_ADDRESS 0xC000AF62 /end MEASUREMENT
/begin MEASUREMENT St_pmdiag1 "Statuswort" UBYTE Def_st_ub_q1 1 100 0.00 255. FORMAT "%3.0" ECU_ADDRESS 0xC000AF63 /end MEASUREMENT
/begin MEASUREMENT St_pmdiag2 "Statuswort" UBYTE Def_st_ub_q1 1 100 0.00 255. FORMAT "%3.0" ECU_ADDRESS 0xC000AF64 /end MEASUREMENT
/begin MEASUREMENT St_pmdiagnv "Statuswort" UBYTE Def_st_ub_q1 1 100 0.00 255. FORMAT "%3.0" ECU_ADDRESS 0xC000AF65 /end MEASUREMENT
/begin MEASUREMENT St_pmmsa0 "Statuswort" UBYTE Def_st_ub_q1 1 100 0.00 255. FORMAT "%3.0" ECU_ADDRESS 0xC000AFC4 /end MEASUREMENT
/begin MEASUREMENT St_pmmsa_1s "Statuswort" UBYTE Def_st_ub_q1 1 100 0.00 255. FORMAT "%3.0" ECU_ADDRESS 0xC000AFC5 /end MEASUREMENT
/begin MEASUREMENT St_pmvbmng0 "Statuswort" UBYTE Def_st_ub_q1 1 100 0.00 255. FORMAT "%3.0" ECU_ADDRESS 0xC000AF8C /end MEASUREMENT
/begin MEASUREMENT St_pmvbmng1 "Statuswort" UBYTE Def_st_ub_q1 1 100 0.00 255. FORMAT "%3.0" ECU_ADDRESS 0xC000AF8D /end MEASUREMENT
/begin MEASUREMENT St_pmvbmng2 "Statuswort" UBYTE Def_st_ub_q1 1 100 0.00 255. FORMAT "%3.0" ECU_ADDRESS 0xC000AF8E /end MEASUREMENT
/begin MEASUREMENT T1histshort "T1 Histogramm in 14.9333 MIn. quantisiert" UBYTE Def_td_ub_q14p9333 1 100 0.00 3808. FORMAT "%5.0" ECU_ADDRESS 0xC000AF66 /end MEASUREMENT
/begin MEASUREMENT T2histshort "T2 Histogramm als Umweltbed. bei Ruhestromverletzung" UBYTE Def_td_ub_q14p9333 1 100 0.00 3808. FORMAT "%5.0" ECU_ADDRESS 0xC000AF67 /end MEASUREMENT
/begin MEASUREMENT T2pmcntr "T2PMINFO countdowncounter" UBYTE Def_td_ub_q1 1 100 0.00 255.0 FORMAT "%5.1" ECU_ADDRESS 0xC000AF68 /end MEASUREMENT
/begin MEASUREMENT T3histshort "T3 Histogramm als Umweltbed. bei Ruhestromverletzung" UBYTE Def_td_ub_q14p9333 1 100 0.00 3808. FORMAT "%5.0" ECU_ADDRESS 0xC000AF69 /end MEASUREMENT
/begin MEASUREMENT T3pmcntr "T3PMINFO countdowncounter" UWORD Def_td_uw_q1 1 100 0.00 65535. FORMAT "%5.0" ECU_ADDRESS 0xC0009480 /end MEASUREMENT
/begin MEASUREMENT Td_regen "Zeit Regeneration bzw Pause dazwischen" UWORD Def_td_uw_q0p01 1 100 0.00 655.350 FORMAT "%7.3" ECU_ADDRESS 0xC000945A /end MEASUREMENT
/begin MEASUREMENT Td_regen0 "Präzise Stopuhr" UBYTE Def_dez_ub_q1 1 100 0.00 255. FORMAT "%3.0" ECU_ADDRESS 0xC000AF56 /end MEASUREMENT
/begin MEASUREMENT Tm_entlfunk "mtl Dauer Generatorbegrenzung funktional" UBYTE Def_td_ub_b1280 1 100 0.00 1275. FORMAT "%4.0" ECU_ADDRESS 0xC000AFB3 /end MEASUREMENT
/begin MEASUREMENT Tm_entlsich "mtl Dauer Generatorbegrenzung Sicherheit" UBYTE Def_td_ub_b1280 1 100 0.00 1275. FORMAT "%4.0" ECU_ADDRESS 0xC000AFB4 /end MEASUREMENT
/begin MEASUREMENT Tm_ierrllred "mtl Dauer Generatorbegrenzung LL-Sägen" UBYTE Def_td_ub_b1280 1 100 0.00 1275. FORMAT "%4.0" ECU_ADDRESS 0xC000AFB5 /end MEASUREMENT
/begin MEASUREMENT Tm_ierrtred "mtl Dauer Generatorbegrenzung Übertemperatur" UBYTE Def_td_ub_b1280 1 100 0.00 1275. FORMAT "%4.0" ECU_ADDRESS 0xC000AFB6 /end MEASUREMENT
/begin MEASUREMENT TS_nMinAC "" SWORD EngN 1 100 -16384.00 16383.50 ECU_ADDRESS 0xD00013DE /end MEASUREMENT
/begin MEASUREMENT TS_stMnSwtAC "Status: Klima-Hauptschalter" UBYTE OneToOne 1 100 0.00 255.0 ECU_ADDRESS 0xD0002591 /end MEASUREMENT
/begin MEASUREMENT Tumgersfilt "gefilterter Umgebungstemperaturersatzwert von Umgebungstemperatursensor (can)" SWORD Def_t_sw_q0p1 1 100 -3276.8 3276.7 FORMAT "%6.1" ECU_ADDRESS 0xC0009448 /end MEASUREMENT
/begin MEASUREMENT Tumg_ers "Außentemp. oder Ersatzwert" SWORD Def_t_sw_q0p1 1 100 -3276.8 3276.7 FORMAT "%6.1" ECU_ADDRESS 0xC000944A /end MEASUREMENT
/begin MEASUREMENT T_batt_zw4 "Zwischenvar Eingang KF zu Berechnung Batt_m2l und Batt_h2m" SWORD Def_t_sw_q0p1 1 100 -3276.8 3276.7 FORMAT "%6.1" ECU_ADDRESS 0xC000944C /end MEASUREMENT
/begin MEASUREMENT T_entlfunk "Zeit entlastung aus funktionalen Gründen" UBYTE Def_td_ub_b1280 1 100 0.00 1275. FORMAT "%4.0" ECU_ADDRESS 0xC000AFB7 /end MEASUREMENT
/begin MEASUREMENT T_entlsich "Zeit Entlastung aus Sicherheitsgründen" UBYTE Def_td_ub_b1280 1 100 0.00 1275. FORMAT "%4.0" ECU_ADDRESS 0xC000AFB8 /end MEASUREMENT
/begin MEASUREMENT T_ierrllred "Zeit Dynamikbegrenzung LLSägen" UBYTE Def_td_ub_b1280 1 100 0.00 1275. FORMAT "%4.0" ECU_ADDRESS 0xC000AFB9 /end MEASUREMENT
/begin MEASUREMENT T_ierrtred "Zeit stat. Begrenzung für Übertemperaturschutz" UBYTE Def_td_ub_b1280 1 100 0.00 1275. FORMAT "%4.0" ECU_ADDRESS 0xC000AFBA /end MEASUREMENT
/begin MEASUREMENT T_igrdiagon "Zähler Diagnose aktiv" UWORD Def_dez_uw_q1 1 100 0.00 65535. FORMAT "%5.0" ECU_ADDRESS 0xC000949A /end MEASUREMENT
/begin MEASUREMENT T_igrhigh "iGR-Info High-Zeit" UWORD Def_td_uw_q0p1 1 100 0.00 6553.5 FORMAT "%6.1" ECU_ADDRESS 0xC000949C /end MEASUREMENT
/begin MEASUREMENT T_igrh_antakt "iGR-Info High-Anteil" UWORD Def_f_uw_b1 1 100 0.00 0.9999847412109 FORMAT "%15.13" ECU_ADDRESS 0xC000949E /end MEASUREMENT
/begin MEASUREMENT T_igrlow "iGR-Info Low-Zeit" UWORD Def_td_uw_q0p1 1 100 0.00 6553.5 FORMAT "%6.1" ECU_ADDRESS 0xC00094A0 /end MEASUREMENT
/begin MEASUREMENT T_igrl_antakt "iGR-Info Low-Anteil" UWORD Def_f_uw_b1 1 100 0.00 0.9999847412109 FORMAT "%15.13" ECU_ADDRESS 0xC00094A2 /end MEASUREMENT
/begin MEASUREMENT T_igrmed "iGR-Info Med-Zeit" UWORD Def_td_uw_q0p1 1 100 0.00 6553.5 FORMAT "%6.1" ECU_ADDRESS 0xC00094A4 /end MEASUREMENT
/begin MEASUREMENT T_igrm_antakt "iGR-Info Med-Anteil" UWORD Def_f_uw_b1 1 100 0.00 0.9999847412109 FORMAT "%15.13" ECU_ADDRESS 0xC00094A6 /end MEASUREMENT
/begin MEASUREMENT T_saismem "T Saison zw. speicher" SBYTE Def_dez_sb_q1 1 100 -128. 127. FORMAT "%3.0" ECU_ADDRESS 0xC000AF6A /end MEASUREMENT
/begin MEASUREMENT T_startreg "Aktivierung der Regeneration über die Zeit" UWORD Def_td_uw_q1 1 100 0.00 65535. FORMAT "%5.0" ECU_ADDRESS 0xC000945C /end MEASUREMENT
/begin MEASUREMENT T_zwstartreg "Zwischenwert für die Aktivierung der Reg über die Zeit" UWORD Def_td_uw_q1 1 100 0.00 65535. FORMAT "%5.0" ECU_ADDRESS 0xC000945E /end MEASUREMENT
/begin MEASUREMENT U_battsoll "Batteriesollspannung" UBYTE Def_u_ub_q0p1 1 100 0.00 25.50 FORMAT "%5.2" ECU_ADDRESS 0xC000AF44 /end MEASUREMENT
/begin MEASUREMENT U_batt_ll "Batteriespannung Leerlauf" UBYTE Def_u_ub_q0p1 1 100 0.00 25.50 FORMAT "%5.2" ECU_ADDRESS 0xC000AF45 /end MEASUREMENT
/begin MEASUREMENT U_batt_max "dynamische Vorgabe Batteriemaximalspannungsgrenze" UBYTE Def_u_ub_q0p1 1 100 0.00 25.50 FORMAT "%5.2" ECU_ADDRESS 0xC000AF46 /end MEASUREMENT
/begin MEASUREMENT U_batt_min "Batteriespannung min" UBYTE Def_u_ub_q0p1 1 100 0.00 25.50 FORMAT "%5.2" ECU_ADDRESS 0xC000AF47 /end MEASUREMENT
/begin MEASUREMENT U_batt_mx "max Batteriespannung" UBYTE Def_u_ub_q0p1 1 100 0.00 25.50 FORMAT "%5.2" ECU_ADDRESS 0xC000AF48 /end MEASUREMENT
/begin MEASUREMENT U_batt_soll "Batteriesollspannungsvorgabe nach Ladekennlinie" UBYTE Def_u_ub_q0p1 1 100 0.00 25.50 FORMAT "%5.2" ECU_ADDRESS 0xC000AF49 /end MEASUREMENT
/begin MEASUREMENT U_bl_min "Minspannung" UBYTE Def_u_ub_q0p1 1 100 0.00 25.50 FORMAT "%5.2" ECU_ADDRESS 0xC000AF8F /end MEASUREMENT
/begin MEASUREMENT U_bsoll_lcp "lokales ubattsoll" UBYTE Def_u_ub_q0p1 1 100 0.00 25.50 FORMAT "%5.2" ECU_ADDRESS 0xC000AF4A /end MEASUREMENT
/begin MEASUREMENT U_bt_mtl "Einzuhaltende mittlere Spannung (temperaturabhängig)" UBYTE Def_u_ub_q0p1 1 100 0.00 25.50 FORMAT "%5.2" ECU_ADDRESS 0xC000AF4B /end MEASUREMENT
/begin MEASUREMENT U_deltau "delta zwischen Sollspg und Ub" UBYTE Def_u_ub_q0p1 1 100 0.00 25.50 FORMAT "%5.2" ECU_ADDRESS 0xC000AF4C /end MEASUREMENT
/begin MEASUREMENT U_dsc_max "DSC Maxspannung" UBYTE Def_u_ub_q0p1 1 100 0.00 25.50 FORMAT "%5.2" ECU_ADDRESS 0xC000AF90 /end MEASUREMENT
/begin MEASUREMENT U_dsc_min "DSC Minspannung" UBYTE Def_u_ub_q0p1 1 100 0.00 25.50 FORMAT "%5.2" ECU_ADDRESS 0xC000AF91 /end MEASUREMENT
/begin MEASUREMENT U_dynbatt_mn "Min Batteriespannung" UBYTE Def_u_ub_q0p1 1 100 0.00 25.50 FORMAT "%5.2" ECU_ADDRESS 0xC000AF4D /end MEASUREMENT
/begin MEASUREMENT U_elue_min "Elektrischer Lüfter Minspannung" UBYTE Def_u_ub_q0p1 1 100 0.00 25.50 FORMAT "%5.2" ECU_ADDRESS 0xC000AF92 /end MEASUREMENT
/begin MEASUREMENT U_eps_min "Elektrische Lenkhilfe Minspannung" UBYTE Def_u_ub_q0p1 1 100 0.00 25.50 FORMAT "%5.2" ECU_ADDRESS 0xC000AF93 /end MEASUREMENT
/begin MEASUREMENT U_ewp_min "Elektrische Wasserpumpe Minspannung" UBYTE Def_u_ub_q0p1 1 100 0.00 25.50 FORMAT "%5.2" ECU_ADDRESS 0xC000AF94 /end MEASUREMENT
/begin MEASUREMENT U_geblaese_dpn "Spannung Gebläse pos und neg Grdient" UBYTE Def_u_ub_b0p5 1 100 0.00 0.498047 FORMAT "%8.6" ECU_ADDRESS 0xC000AF95 /end MEASUREMENT
/begin MEASUREMENT U_geblaese_min "Minspannung Gebläse" UBYTE Def_u_ub_q0p1 1 100 0.00 25.50 FORMAT "%5.2" ECU_ADDRESS 0xC000AF96 /end MEASUREMENT
/begin MEASUREMENT U_igrmedhi "Regler-Spannungsvorgabe (ungefiltert)" UBYTE Def_u_ub_q0p1 1 100 0.00 25.50 FORMAT "%5.2" ECU_ADDRESS 0xC000AF78 /end MEASUREMENT
/begin MEASUREMENT U_igr_dpn "iGR Spannungsrampe positiv und negativ" UBYTE Def_u_ub_b0p5 1 100 0.00 0.498047 FORMAT "%8.6" ECU_ADDRESS 0xC000AF79 /end MEASUREMENT
/begin MEASUREMENT U_igr_soll "Spannungsanforderung iGR" UBYTE Def_u_ub_q0p1 1 100 0.00 25.50 FORMAT "%5.2" ECU_ADDRESS 0xC000AF7A /end MEASUREMENT
/begin MEASUREMENT U_krapu_min "Kraftstoffpumpe Minspannung" UBYTE Def_u_ub_q0p1 1 100 0.00 25.50 FORMAT "%5.2" ECU_ADDRESS 0xC000AF97 /end MEASUREMENT
/begin MEASUREMENT U_licht_dpn "Spannung Licht pos und neg Gradient" UBYTE Def_u_ub_b0p5 1 100 0.00 0.498047 FORMAT "%8.6" ECU_ADDRESS 0xC000AF98 /end MEASUREMENT
/begin MEASUREMENT U_licht_min "Minspannung Licht" UBYTE Def_u_ub_q0p1 1 100 0.00 25.50 FORMAT "%5.2" ECU_ADDRESS 0xC000AF99 /end MEASUREMENT
/begin MEASUREMENT U_slp_min "Minspannung Sekundärluftpumpe" UBYTE Def_u_ub_q0p1 1 100 0.00 25.50 FORMAT "%5.2" ECU_ADDRESS 0xC000AF9A /end MEASUREMENT
/begin MEASUREMENT U_stabatt_mn "Min Batteriespg sta" UBYTE Def_u_ub_q0p1 1 100 0.00 25.50 FORMAT "%5.2" ECU_ADDRESS 0xC000AF4E /end MEASUREMENT
/begin MEASUREMENT U_vbres1_max "Maxspannung Reserveverbraucher 1" UBYTE Def_u_ub_q0p1 1 100 0.00 25.50 FORMAT "%5.2" ECU_ADDRESS 0xC000AF9B /end MEASUREMENT
/begin MEASUREMENT U_vbres1_min "Minspannung Reserveverbraucher 1" UBYTE Def_u_ub_q0p1 1 100 0.00 25.50 FORMAT "%5.2" ECU_ADDRESS 0xC000AF9C /end MEASUREMENT
/begin MEASUREMENT U_vbres2_max "Maxspannung Reserveverbraucher 2" UBYTE Def_u_ub_q0p1 1 100 0.00 25.50 FORMAT "%5.2" ECU_ADDRESS 0xC000AF9D /end MEASUREMENT
/begin MEASUREMENT U_vbres2_min "Minspannung Reserveverbraucher 2" UBYTE Def_u_ub_q0p1 1 100 0.00 25.50 FORMAT "%5.2" ECU_ADDRESS 0xC000AF9E /end MEASUREMENT
/begin MEASUREMENT U_vbres3_dpn "Spannung posund neg Gradient Reserveverbraucher 3" UBYTE Def_u_ub_b0p5 1 100 0.00 0.498047 FORMAT "%8.6" ECU_ADDRESS 0xC000AF9F /end MEASUREMENT
/begin MEASUREMENT U_vbres3_max "Maxspannung Reserveverbraucher 3" UBYTE Def_u_ub_q0p1 1 100 0.00 25.50 FORMAT "%5.2" ECU_ADDRESS 0xC000AFA0 /end MEASUREMENT
/begin MEASUREMENT U_vbres3_min "Minspannung Reserveverbraucher 3" UBYTE Def_u_ub_q0p1 1 100 0.00 25.50 FORMAT "%5.2" ECU_ADDRESS 0xC000AFA1 /end MEASUREMENT
/begin MEASUREMENT U_vbres4_dpn "spannung pos und neg Gradient Reserveverbraucher 4" UBYTE Def_u_ub_b0p5 1 100 0.00 0.498047 FORMAT "%8.6" ECU_ADDRESS 0xC000AFA2 /end MEASUREMENT
/begin MEASUREMENT U_vbres4_max "Maxspannung Reserveverbraucher 4" UBYTE Def_u_ub_q0p1 1 100 0.00 25.50 FORMAT "%5.2" ECU_ADDRESS 0xC000AFA3 /end MEASUREMENT
/begin MEASUREMENT U_vbres4_min "Minspannung Reserveverbraucher 4" UBYTE Def_u_ub_q0p1 1 100 0.00 25.50 FORMAT "%5.2" ECU_ADDRESS 0xC000AFA4 /end MEASUREMENT
/begin MEASUREMENT U_vbres5_max "Maxspannung Reserveverbraucher 5" UBYTE Def_u_ub_q0p1 1 100 0.00 25.50 FORMAT "%5.2" ECU_ADDRESS 0xC000AFA5 /end MEASUREMENT
/begin MEASUREMENT U_vbres5_min "Maxspannung Reserveverbraucher 5" UBYTE Def_u_ub_q0p1 1 100 0.00 25.50 FORMAT "%5.2" ECU_ADDRESS 0xC000AFA6 /end MEASUREMENT
/begin MEASUREMENT U_vbtherm_mx "Maxspannung bei thermischer Überlast" UBYTE Def_u_ub_q0p1 1 100 0.00 25.50 FORMAT "%5.2" ECU_ADDRESS 0xC000AFA7 /end MEASUREMENT
/begin MEASUREMENT U_wischer_max "Maxspannung Wischer" UBYTE Def_u_ub_q0p1 1 100 0.00 25.50 FORMAT "%5.2" ECU_ADDRESS 0xC000AFA8 /end MEASUREMENT
/begin MEASUREMENT U_wischer_min "Minspannung Wischer" UBYTE Def_u_ub_q0p1 1 100 0.00 25.50 FORMAT "%5.2" ECU_ADDRESS 0xC000AFA9 /end MEASUREMENT
/begin MEASUREMENT VehMot_drAccPedUnFlt "Ableitung ungefilterter Fahrpedalwert" SWORD PrcPerSec 1 100 -20000.00 19999.39 FORMAT "%8.2" ECU_ADDRESS 0xD00014B8 /end MEASUREMENT
/begin MEASUREMENT VehMot_facDesDyn "Dynamikfaktor Fahrerwunsch" SWORD Fact 1 100 -4.000000 3.999878 ECU_ADDRESS 0xD00014BC /end MEASUREMENT
/begin MEASUREMENT VehMot_rAccPedFlt "Gefilterter Fahrpedalwert" SWORD Prc 1 100 -400.0000 399.9878 ECU_ADDRESS 0xD00014C6 /end MEASUREMENT
/begin MEASUREMENT VehMot_stAccPedOvrRun "Status ""Overrun-Rampe"" appliziert" UBYTE OneToOne 1 100 0.00 255.0 ECU_ADDRESS 0xD00025B4 /end MEASUREMENT
/begin MEASUREMENT VehMot_stPrpAccPed "Status Vortriebsanforderung durch Fahrerwunsch" UBYTE OneToOne 1 100 0.00 255.0 ECU_ADDRESS 0xD00025BA /end MEASUREMENT
/begin MEASUREMENT Verbstat_0 "Zwischenvariable Licht" UBYTE Def_dez_ub_q1 1 100 0.00 255. FORMAT "%3.0" ECU_ADDRESS 0xC000AFAA /end MEASUREMENT
/begin MEASUREMENT WaHtEl_bEval "" UBYTE OneToOne 1 100 0.00 1.000 BIT_MASK 0x20 ECU_ADDRESS 0xD00003C0 /end MEASUREMENT
/begin MEASUREMENT WaHtEl_bRec "" UBYTE OneToOne 1 100 0.00 1.000 BIT_MASK 0x1 ECU_ADDRESS 0xD00003B9 /end MEASUREMENT
/begin MEASUREMENT WaHtEl_bRecActv "" UBYTE OneToOne 1 100 0.00 1.000 BIT_MASK 0x2 ECU_ADDRESS 0xD00003C4 /end MEASUREMENT
/begin MEASUREMENT WaHtEl_ct4WinErr1_mp "" UBYTE OneToOne 1 100 0.00 255.0 ECU_ADDRESS 0xC000AF35 /end MEASUREMENT
/begin MEASUREMENT WaHtEl_ct4WinErr2_mp "" UBYTE OneToOne 1 100 0.00 255.0 ECU_ADDRESS 0xC000AF36 /end MEASUREMENT
/begin MEASUREMENT WaHtEl_ct4WinErr3_mp "" UBYTE OneToOne 1 100 0.00 255.0 ECU_ADDRESS 0xC000AF37 /end MEASUREMENT
/begin MEASUREMENT WaHtEl_ct4WinErr4_mp "" UBYTE OneToOne 1 100 0.00 255.0 ECU_ADDRESS 0xC000AF38 /end MEASUREMENT
/begin MEASUREMENT WaHtEl_rPs "" SWORD DtyCyc 1 100 -327.6800 327.6700 ECU_ADDRESS 0xD00014D2 /end MEASUREMENT
/begin MEASUREMENT WaHtEl_stErrMsg_mp "" UBYTE OneToOne 1 100 0.00 255.0 ECU_ADDRESS 0xC000AF39 /end MEASUREMENT
/begin MEASUREMENT WaHtEl_stRec_mp "" UBYTE OneToOne 1 100 0.00 255.0 ECU_ADDRESS 0xC000AF3A /end MEASUREMENT
/begin MEASUREMENT X_KF_MAXENTL_no_input_quantity "This variable is artificially generated, since DAMOS does not (yet) support 'NO_INPUT_QUANTITY' references at PaVaSt files. It is exclusively referenced by the X axis of calibration parameter 'KF_MAXENTL'." UBYTE Def_f_ub_b100 1 100 0.00 99.61 ECU_ADDRESS 0xC000AF4F /end MEASUREMENT
/begin MEASUREMENT X_KF_UBATT_LL_no_input_quantity "This variable is artificially generated, since DAMOS does not (yet) support 'NO_INPUT_QUANTITY' references at PaVaSt files. It is exclusively referenced by the X axis of calibration parameter 'KF_UBATT_LL'." UBYTE Def_f_ub_b100 1 100 0.00 99.61 ECU_ADDRESS 0xC000AF50 /end MEASUREMENT
/begin MEASUREMENT X_KL_BATTMNG_no_input_quantity "This variable is artificially generated, since DAMOS does not (yet) support 'NO_INPUT_QUANTITY' references at PaVaSt files. It is exclusively referenced by the X axis of calibration parameter 'KL_BATTMNG'." FLOAT32_IEEE Def_f_r32 1 100 -1000000000000. 10000000000000. FORMAT "%14.0" ECU_ADDRESS 0xC0008BB0 /end MEASUREMENT
/begin MEASUREMENT X_KL_INVBATTMNG_no_input_quantity "This variable is artificially generated, since DAMOS does not (yet) support 'NO_INPUT_QUANTITY' references at PaVaSt files. It is exclusively referenced by the X axis of calibration parameter 'KL_INVBATTMNG'." FLOAT32_IEEE Def_f_r32 1 100 -1000000000000. 10000000000000. FORMAT "%14.0" ECU_ADDRESS 0xC0008BB4 /end MEASUREMENT
/begin MEASUREMENT X_KL_INVLOG_no_input_quantity "This variable is artificially generated, since DAMOS does not (yet) support 'NO_INPUT_QUANTITY' references at PaVaSt files. It is exclusively referenced by the X axis of calibration parameter 'KL_INVLOG'." FLOAT32_IEEE Def_f_r32 1 100 -1000000000000. 10000000000000. FORMAT "%14.0" ECU_ADDRESS 0xC0008BB8 /end MEASUREMENT
/begin MEASUREMENT X_KL_KAPAVZ_no_input_quantity "This variable is artificially generated, since DAMOS does not (yet) support 'NO_INPUT_QUANTITY' references at PaVaSt files. It is exclusively referenced by the X axis of calibration parameter 'KL_KAPAVZ'." UBYTE Def_i_ub_q1 1 100 0.00 255.00 ECU_ADDRESS 0xC000AF57 /end MEASUREMENT
/begin MEASUREMENT X_KL_LOG_no_input_quantity "This variable is artificially generated, since DAMOS does not (yet) support 'NO_INPUT_QUANTITY' references at PaVaSt files. It is exclusively referenced by the X axis of calibration parameter 'KL_LOG'." FLOAT32_IEEE Def_f_r32 1 100 -1000000000000. 10000000000000. FORMAT "%14.0" ECU_ADDRESS 0xC0008BBC /end MEASUREMENT
/begin MEASUREMENT X_KL_QUALILOG_no_input_quantity "This variable is artificially generated, since DAMOS does not (yet) support 'NO_INPUT_QUANTITY' references at PaVaSt files. It is exclusively referenced by the X axis of calibration parameter 'KL_QUALILOG'." FLOAT32_IEEE Def_f_r32 1 100 -1000000000000. 10000000000000. FORMAT "%14.0" ECU_ADDRESS 0xC0008BC0 /end MEASUREMENT
/begin MEASUREMENT X_KL_QUALI_no_input_quantity "This variable is artificially generated, since DAMOS does not (yet) support 'NO_INPUT_QUANTITY' references at PaVaSt files. It is exclusively referenced by the X axis of calibration parameter 'KL_QUALI'." FLOAT32_IEEE Def_f_r32 1 100 -1000000000000. 10000000000000. FORMAT "%14.0" ECU_ADDRESS 0xC0008BC4 /end MEASUREMENT
/begin MEASUREMENT X_KL_USOLL2_no_input_quantity "This variable is artificially generated, since DAMOS does not (yet) support 'NO_INPUT_QUANTITY' references at PaVaSt files. It is exclusively referenced by the X axis of calibration parameter 'KL_USOLL2'." SWORD Def_t_sw_q0p1 1 100 -3276.8 3276.7 FORMAT "%6.1" ECU_ADDRESS 0xC000944E /end MEASUREMENT
/begin MEASUREMENT Y_KF_EKPRFNKW_no_input_quantity "This variable is artificially generated, since DAMOS does not (yet) support 'NO_INPUT_QUANTITY' references at PaVaSt files. It is exclusively referenced by the Y axis of calibration parameter 'KF_EKPRFNKW'." SWORD Def_rf_sw_q0p01 1 100 -327.68000 327.67000 FORMAT "%9.5" ECU_ADDRESS 0xC00094B0 /end MEASUREMENT
/begin MEASUREMENT Zentlact "Zähler Entlastung aktiv" UBYTE Def_td_ub_q1 1 100 0.00 255.0 FORMAT "%5.1" ECU_ADDRESS 0xC000AF51 /end MEASUREMENT
/begin MEASUREMENT Zladungact "NN" UWORD Def_td_uw_q0p1 1 100 0.00 6553.5 FORMAT "%6.1" ECU_ADDRESS 0xC0009450 /end MEASUREMENT
/begin MEASUREMENT Zr_entlfunk "Häufigkeit Generatorbegrenzung funktional" UWORD Def_dez_uw_q1 1 100 0.00 65535. FORMAT "%5.0" ECU_ADDRESS 0xC00094C2 /end MEASUREMENT
/begin MEASUREMENT Zr_entlfunknix "Häufigkeit Generatorbegrenzung funktional 0%" UWORD Def_dez_uw_q1 1 100 0.00 65535. FORMAT "%5.0" ECU_ADDRESS 0xC00094C4 /end MEASUREMENT
/begin MEASUREMENT Zr_entlfunkteil "Häufigkeit Generatorbegrenzung funktional eingeschränkt PMBATTMNG" UWORD Def_dez_uw_q1 1 100 0.00 65535. FORMAT "%5.0" ECU_ADDRESS 0xC00094C6 /end MEASUREMENT
/begin MEASUREMENT Zr_entlfunkvoll "Häufigkeit Generatorbegrenzung funktional 100%" UWORD Def_dez_uw_q1 1 100 0.00 65535. FORMAT "%5.0" ECU_ADDRESS 0xC00094C8 /end MEASUREMENT
/begin MEASUREMENT Zr_entlsich "Häufigkeit Generatorbegrenzung Sicherheit" UWORD Def_dez_uw_q1 1 100 0.00 65535. FORMAT "%5.0" ECU_ADDRESS 0xC00094CA /end MEASUREMENT
/begin MEASUREMENT Zr_entlsichvoll "Häufigkeit Generatorbegrenzung Sicherheit 100%" UWORD Def_dez_uw_q1 1 100 0.00 65535. FORMAT "%5.0" ECU_ADDRESS 0xC00094CC /end MEASUREMENT
/begin MEASUREMENT Zr_ierrllred "Häufigkeit Generatorbegrenzung LL-Sägen" UBYTE Def_dez_ub_q1 1 100 0.00 255. FORMAT "%3.0" ECU_ADDRESS 0xC000AFBB /end MEASUREMENT
/begin MEASUREMENT Zr_ierrtred "Häufigkeit Generatorbegrenzung Übertemperatur" UBYTE Def_dez_ub_q1 1 100 0.00 255. FORMAT "%3.0" ECU_ADDRESS 0xC000AFBC /end MEASUREMENT
/begin MEASUREMENT Zr_igr_low "iGR-Info Anzahl Schubphasen" UWORD Def_dez_uw_q1 1 100 0.00 65535. FORMAT "%5.0" ECU_ADDRESS 0xC00094A8 /end MEASUREMENT
/begin MEASUREMENT Zr_quali_1 "Zwischenvar Häufigkeit Spannungsqualität A" UWORD Def_dez_uw_q1 1 100 0.00 65535. FORMAT "%5.0" ECU_ADDRESS 0xC00094CE /end MEASUREMENT
/begin MEASUREMENT Zr_quali_2 "Zwischenvar Häufigkeit Spannungsqualität B" UWORD Def_dez_uw_q1 1 100 0.00 65535. FORMAT "%5.0" ECU_ADDRESS 0xC00094D0 /end MEASUREMENT
/begin MEASUREMENT Zr_quali_3 "Zwischenvar Häufigkeit Spannungsqualität C" UWORD Def_dez_uw_q1 1 100 0.00 65535. FORMAT "%5.0" ECU_ADDRESS 0xC00094D2 /end MEASUREMENT
/begin MEASUREMENT Zr_regen "Zähler Regenerationen" UBYTE Def_dez_ub_q1 1 100 0.00 255. FORMAT "%3.0" ECU_ADDRESS 0xC000AF58 /end MEASUREMENT
/begin MEASUREMENT Zr_ubattsoll_h "Häufigkeit Batterieladung Stufe H" UWORD Def_dez_uw_q1 1 100 0.00 65535. FORMAT "%5.0" ECU_ADDRESS 0xC00094D4 /end MEASUREMENT
/begin MEASUREMENT Zr_ubattsoll_l "Häufigkeit Batterieladung Stufe L" UWORD Def_dez_uw_q1 1 100 0.00 65535. FORMAT "%5.0" ECU_ADDRESS 0xC00094D6 /end MEASUREMENT
/begin MEASUREMENT Zr_ustat_1 "Häufigkeit Spannungsbereich A" UWORD Def_dez_uw_q1 1 100 0.00 65535. FORMAT "%5.0" ECU_ADDRESS 0xC00094D8 /end MEASUREMENT
/begin MEASUREMENT Zr_ustat_2 "Häufigkeit Spannungsbereich B" UWORD Def_dez_uw_q1 1 100 0.00 65535. FORMAT "%5.0" ECU_ADDRESS 0xC00094DA /end MEASUREMENT
/begin MEASUREMENT Zr_ustat_3 "Häufigkeit Spannungsbereich C" UWORD Def_dez_uw_q1 1 100 0.00 65535. FORMAT "%5.0" ECU_ADDRESS 0xC00094DC /end MEASUREMENT
/begin MEASUREMENT Zr_ustat_4 "Häufigkeit Spannungsbereich D" UWORD Def_dez_uw_q1 1 100 0.00 65535. FORMAT "%5.0" ECU_ADDRESS 0xC00094DE /end MEASUREMENT
/begin MEASUREMENT Zr_ustat_5 "Häufigkeit Spannungsbereich E" UWORD Def_dez_uw_q1 1 100 0.00 65535. FORMAT "%5.0" ECU_ADDRESS 0xC00094E0 /end MEASUREMENT
/begin MEASUREMENT Zr_ustat_6 "Häufigkeit Spannungsbereich F" UWORD Def_dez_uw_q1 1 100 0.00 65535. FORMAT "%5.0" ECU_ADDRESS 0xC00094E2 /end MEASUREMENT
/begin MEASUREMENT Zr_ustat_7 "Häufigkeit Spannungsbereich G" UWORD Def_dez_uw_q1 1 100 0.00 65535. FORMAT "%5.0" ECU_ADDRESS 0xC00094E4 /end MEASUREMENT
/begin MEASUREMENT Ztagedelta "verstrichene Tage" UBYTE Def_dez_ub_q1 1 100 0.00 10. FORMAT "%3.0" ECU_ADDRESS 0xC000AF6B /end MEASUREMENT
/begin MEASUREMENT Ztageold "letzter Wert von ztageabs_w" UWORD Def_dez_uw_q1 1 100 0.00 65535. FORMAT "%5.0" ECU_ADDRESS 0xC0009482 /end MEASUREMENT
/begin MEASUREMENT Zw1 "Zwischenvariable" UWORD Def_ql_uw_q0p29127 1 100 0.00 19088.4 FORMAT "%7.1" ECU_ADDRESS 0xC0009460 /end MEASUREMENT
/begin MEASUREMENT Zw10 "Zwischenvariable" UWORD Def_ql_uw_q0p29127 1 100 0.00 19088.4 FORMAT "%7.1" ECU_ADDRESS 0xC0009462 /end MEASUREMENT
/begin MEASUREMENT Zw11 "Zwischenvariable" UWORD Def_ql_uw_q0p29127 1 100 0.00 19088.4 FORMAT "%7.1" ECU_ADDRESS 0xC0009464 /end MEASUREMENT
/begin MEASUREMENT Zw12 "Zwischenvariable" UWORD Def_ql_uw_q0p29127 1 100 0.00 19088.4 FORMAT "%7.1" ECU_ADDRESS 0xC0009466 /end MEASUREMENT
/begin MEASUREMENT Zw6 "Zwischenvariable" UWORD Def_ql_uw_q0p29127 1 100 0.00 19088.4 FORMAT "%7.1" ECU_ADDRESS 0xC0009468 /end MEASUREMENT
/begin MEASUREMENT Zw7 "Zwischenvariable" UWORD Def_ql_uw_q0p29127 1 100 0.00 19088.4 FORMAT "%7.1" ECU_ADDRESS 0xC000946A /end MEASUREMENT
/begin MEASUREMENT Zw8 "Zwischenvariable" UWORD Def_ql_uw_q0p29127 1 100 0.00 19088.4 FORMAT "%7.1" ECU_ADDRESS 0xC000946C /end MEASUREMENT
/begin MEASUREMENT Zw9 "Zwischenvariable" UWORD Def_td_uw_q1 1 100 0.00 65535. FORMAT "%5.0" ECU_ADDRESS 0xC000946E /end MEASUREMENT
/begin FUNCTION ACCECU "" /begin SUB_FUNCTION ACCECU_fx ACCECU_swt ACCECU_flex /end SUB_FUNCTION /end FUNCTION
/begin FUNCTION ACCECU_Can ""
 /begin DEF_CHARACTERISTIC Com_ctACCSelfRec_C Com_stMskTrqWhlDemSig_C Com_swtTrqWhlDem_C Com_tiACCSelfRec_C /end DEF_CHARACTERISTIC
 /begin OUT_MEASUREMENT Com_bRecACC /end OUT_MEASUREMENT
/end FUNCTION
/begin FUNCTION ACCECU_co ""
 /begin OUT_MEASUREMENT Com_dTrqWhlDemCHK Com_dTrqWhlDemCTR Com_stDrvAssist Com_stFolDyn Com_stShftIdctrDemRglX Com_stTrqWhl Com_trqWhlDes /end OUT_MEASUREMENT
/end FUNCTION
/begin FUNCTION ACCECU_flex "" /begin DEF_CHARACTERISTIC Com_bRecACC_C Com_rAPPUnFltFAS_C Com_vVehFAS_C /end DEF_CHARACTERISTIC /begin OUT_MEASUREMENT Com_stTrqWhlDemFASQl Com_stTrqWhlDesQl /end OUT_MEASUREMENT /end FUNCTION
/begin FUNCTION ACCECU_fx "" /begin DEF_CHARACTERISTIC Com_swtTrqWhlDemFAS_FX_C /end DEF_CHARACTERISTIC
 /begin OUT_MEASUREMENT Com_dTrqWhlDemFASCHK_FX Com_dTrqWhlDemFASCTR_FX Com_stTrqWhlDemFASQl_FX Com_stTrqWhlDesQl_FX Com_trqWhlDes_FX /end OUT_MEASUREMENT
/end FUNCTION
/begin FUNCTION ACCECU_swt ""
 /begin IN_MEASUREMENT Com_stTrqWhlDemFASQl Com_stTrqWhlDemFASQl_FX Com_stTrqWhlDesQl Com_stTrqWhlDesQl_FX Com_trqWhlDes Com_trqWhlDes_FX /end IN_MEASUREMENT
/end FUNCTION
/begin FUNCTION ACCI_calcReq ""
 /begin DEF_CHARACTERISTIC ACCI_aMax_C ACCI_dtrq.Pos_C ACCI_dtrq.Neg_C ACCI_nDeltaOff_C ACCI_nDelta_C ACCI_nShiftUp_C ACCI_swtDrvAssist_C ACCI_swtShiftDwn_C ACCI_swtShiftOff_C ACCI_swtShiftUp_C ACCI_swtTrqSel_C ACCI_tiBrkPressedDel_C ACCI_tiPlausBrk_C ACCI_tiPT1_C ACCI_tiShiftDwn_C ACCI_tiShiftUp_C ACCI_tiSwtOffDwn_C ACCI_tiSwtOffUp_C ACCI_vLim_C /end DEF_CHARACTERISTIC
 /begin IN_MEASUREMENT AccPed_trqDes APP_rUnFlt APP_stKD Brk_st CoETS_trqUnFltLtd Com_bRecACC Com_stDrvAssist Com_stTrqWhl Com_trqWhlDes Epm_nEng HLSDem_nSetPLoStat MoFDrAs_stACCPtdMsg PT_rTrq PT_stGrip PT_stTraType PT_trqLos PT_trqWhlMaxEng PT_trqWhlMinEng RngMod_trqClthMin T15_st Tra_numGear VehMot_rTrqDfftl VehV_v /end IN_MEASUREMENT
 /begin OUT_MEASUREMENT ACCI_aReq ACCI_stACC ACCI_stCLCTRV ACCI_stError ACCI_stInActv ACCI_stOff ACCI_stReq ACCI_stRls ACCI_stShift ACCI_trqDes /end OUT_MEASUREMENT
 /begin LOC_MEASUREMENT ACCI_trqDesRmp_mp ACCI_trqRaw_mp ACCI_trqWhlDesFlt_mp /end LOC_MEASUREMENT
/end FUNCTION
/begin FUNCTION ACCmpr_DD ""
 /begin DEF_CHARACTERISTIC AirC_DigOutCmpr.tiBtwTstSCB_C AirC_DigOutCmpr.tiBtwTstOT_C AirC_DigOutCmpr.numTstMax_C AirC_stCmprPsDiaDisbl_C AirC_stCmprPsDisbl_C AirC_stCmprTyp_CW AirC_trqCmprMin_C /end DEF_CHARACTERISTIC
 /begin IN_MEASUREMENT AC_trqMaxAC DevLib_stPwrStgEnaCond /end IN_MEASUREMENT
 /begin OUT_MEASUREMENT AirC_stPsCmpr AirC_trqCmprMax /end OUT_MEASUREMENT
 /begin LOC_MEASUREMENT AirC_stPsCmpr_mp /end LOC_MEASUREMENT
/end FUNCTION
/begin FUNCTION ACComp_Demand "" /begin DEF_CHARACTERISTIC ACComp_facTrqCAN_C ACComp_tiTrqDyn_C ACComp_trqDesMax_C /end DEF_CHARACTERISTIC /begin IN_MEASUREMENT ACCtl_stOut ACCtl_stTrqResv /end IN_MEASUREMENT /begin OUT_MEASUREMENT AC_trqDes AC_trqResv /end OUT_MEASUREMENT /begin LOC_MEASUREMENT ACComp_trqDesFltAbv_mp ACComp_trqStat_mp /end LOC_MEASUREMENT /end FUNCTION
/begin FUNCTION AccPed_DoCoordOut ""
 /begin DEF_CHARACTERISTIC AccPed_nErr_CUR AccPed_nMax_C AccPed_nMinBrkApp_C AccPed_nMinBrk_C AccPed_trqLimMax_C /end DEF_CHARACTERISTIC
 /begin IN_MEASUREMENT AccPed_trqDes APP_drUnFlt APP_r APP_stPlaBrkPres PT_rTrq PT_stGrip PT_swtMstShft PT_trqWhlMaxEng PT_trqWhlMinEng Tra_numGear VehMot_rTrqDfftl VehMot_stBrkPed /end IN_MEASUREMENT
 /begin OUT_MEASUREMENT AccPed_nMax AccPed_nMin AccPed_rTrq AccPed_stMS AccPed_stNSetP AccPed_trqLimMax VehMot_drAccPedUnFlt VehMot_facDesDyn VehMot_rAccPedFlt /end OUT_MEASUREMENT
/end FUNCTION
/begin FUNCTION AccPed_DrvDemDes ""
 /begin DEF_CHARACTERISTIC AccPed_APPDebParam.tiHiLo_C AccPed_APPDebParam.tiLoHi_C AccPed_rOffset_C AccPed_rThresPrp_C AccPed_rZero_C AccPed_swtDrvBehav_C AccPed_trqDemThres_C AccPed_trqEngHigh_MAP AccPed_trqEngLow_MAP AccPed_trqPrp_MAP AccPed_vVehVmax_C AccPed_vVehVmin_C /end DEF_CHARACTERISTIC
 /begin IN_MEASUREMENT AccPed_rTrq AccPed_stMS AccPed_trqLimMax APP_r Epm_nEng GlbDa_vX PT_stTraRevGear PT_trqSpdGovLtd PT_trqWhlMinEng PT_trqWhlMinWoCtOff /end IN_MEASUREMENT
 /begin OUT_MEASUREMENT AccPed_facCompAcs AccPed_trqDes AccPed_trqDesOvrRun AccPed_trqDesPull VehMot_stAccPedOvrRun VehMot_stPrpAccPed /end OUT_MEASUREMENT
 /begin LOC_MEASUREMENT AccPed_trqDesEngLinInt_mp AccPed_trqEngHighDes_mp AccPed_trqEngLowDes_mp /end LOC_MEASUREMENT
/end FUNCTION
/begin FUNCTION AccPed_DrvDemLead ""
 /begin IN_MEASUREMENT AccPed_stMS AccPed_trqLimMax APP_r APP_rUnFlt Epm_nEng GlbDa_vX PT_rTrq PT_stTraRevGear PT_trqSpdGovLtd PT_trqWhlMinEng PT_trqWhlMinWoCtOff VehMot_rTrqDfftl /end IN_MEASUREMENT
 /begin OUT_MEASUREMENT AccPed_trqLead /end OUT_MEASUREMENT
 /begin LOC_MEASUREMENT AccPed_trqEngHighLead_mp AccPed_trqEngLowLead_mp AccPed_trqLeadEngLinInt_mp AccPed_trqLeadOvrRun_mp AccPed_trqLeadPull_mp /end LOC_MEASUREMENT
/end FUNCTION
/begin FUNCTION AccPr "" /end FUNCTION
/begin FUNCTION ACCtl_Demand ""
 /begin DEF_CHARACTERISTIC ACCtl_dtrqFullLoadLimDn_C ACCtl_dtrqFullLoadLimUp_C ACCtl_nACThres_C ACCtl_nFullLoadLimHi_C ACCtl_nFullLoadLimLo_C ACCtl_nMin_C ACCtl_rTrans_C ACCtl_stResv_CW ACCtl_stTrailerErr_C ACCtl_tiDebIdlSpd_C ACCtl_tiDebNEngOff_C ACCtl_tiDebNEngOn_C ACCtl_tiDebStrtOff_C ACCtl_tiDebStrtOn_C ACCtl_tiMnSwtDel_C ACCtl_tiOnLock_C ACCtl_tiTrqLimPT1_C ACCtl_tiTrqResv_C ACCtl_trqACMax_C ACCtl_trqACOff_C ACCtl_trqACTrqErr_C ACCtl_trqFanErr_C ACCtl_trqFastLim_MAP ACCtl_trqFullLoadOfs_CUR ACCtl_trqRedAC_C ACCtl_trqShutOff_C ACCtl_trqTEngErr_C ACCtl_trqTEngLimTrailer_MAP ACCtl_trqTEngLim_MAP ACCtl_trqTGearbxErr_C ACCtl_trqTGearbxLim_MAP ACCtl_trqThres_C ACCtl_trqVehVErr_C ACCtl_vThres_C /end DEF_CHARACTERISTIC
 /begin IN_MEASUREMENT AC_trqDes CoEng_st CoETS_trqInrSetSlow Com_stMSAStop Com_stTrailer EngDa_tEng EngDem_trqInrLim Epm_nEng GlbDa_stTrqDem GlbDa_vX HLSDem_nSetPLo Layer_trqLimRaw SpdGov_trqSet Tra_tOil TS_stMnSwtAC /end IN_MEASUREMENT
 /begin OUT_MEASUREMENT ACCtl_stTrqResv ACCtl_trqMaxAC AC_stRedAC AC_trqMaxAC /end OUT_MEASUREMENT
 /begin LOC_MEASUREMENT ACCtl_stMnSwtTmr_mp ACCtl_stOut ACCtl_trqACFastOffLim_mp ACCtl_trqACFastOffMax_mp ACCtl_trqACTrqErr_mp ACCtl_trqFanErr_mp ACCtl_trqInrACDiff_mp ACCtl_trqMaxAC_mp ACCtl_trqStrtLim_mp ACCtl_trqTEngErr_mp ACCtl_trqTEngLim_mp ACCtl_trqTGearbxErr_mp ACCtl_trqTGearbxLim_mp ACCtl_trqVehVErr_mp TS_nMinAC /end LOC_MEASUREMENT
/end FUNCTION
/begin FUNCTION ACCtl_Demand_Inl "" /end FUNCTION
/begin FUNCTION ACSwt_DD "" /begin OUT_MEASUREMENT AirC_stSwtRaw /end OUT_MEASUREMENT /end FUNCTION
/begin FUNCTION ACSwt_VD "" /begin DEF_CHARACTERISTIC AirC_stSwtDfl_C /end DEF_CHARACTERISTIC /begin IN_MEASUREMENT Com_stAC /end IN_MEASUREMENT /begin OUT_MEASUREMENT AirC_stSwt AirC_stSwtPrs /end OUT_MEASUREMENT /end FUNCTION
/begin FUNCTION ActMod_Q2Trq "" /begin IN_MEASUREMENT CoEng_st InjCtl_qSetUnBal StSys_trqStrt /end IN_MEASUREMENT /begin OUT_MEASUREMENT ActMod_trqInr /end OUT_MEASUREMENT /begin LOC_MEASUREMENT ActMod_trqCurr_mp /end LOC_MEASUREMENT /end FUNCTION
/begin FUNCTION ActMod_TrqCalc "" /begin IN_MEASUREMENT CoVeh_trqAcs RngMod_trqMin /end IN_MEASUREMENT /begin OUT_MEASUREMENT ActMod_trq ActMod_trqClth /end OUT_MEASUREMENT /end FUNCTION
/begin FUNCTION AC_DataAcq "" /begin IN_MEASUREMENT AirC_stSwt /end IN_MEASUREMENT /begin OUT_MEASUREMENT TS_stMnSwtAC /end OUT_MEASUREMENT /end FUNCTION
/begin FUNCTION AdcHal ""
 /begin DEF_CHARACTERISTIC Adc_idxAirCClntIA_C Adc_idxBrkPIA_C Adc_idxCEngDsTIA_C Adc_idxCEngUsTIA_C Adc_idxECBVlvIA_C Adc_idxEGRVlvIA_C Adc_idxEGRVlvLPIA_C Adc_idxEnvTIA_C Adc_idxFlFltDsPIA_C Adc_idxFlFltUsPIA_C Adc_idxFuelTIA_C Adc_idxOilPIA_C Adc_idxOilTIA_C Adc_idxPAirFltDsIA_C Adc_idxPIntkVUsIA_C Adc_idxPPFltDiffIA_C Adc_idxPPFltUsIA_C Adc_idxPTrbnUsIA_C Adc_idxStWhlAgIA_C Adc_idxTCACDsIA_C Adc_idxThrVlvIA_C Adc_idxTOxiCatDsIA_C Adc_idxTOxiCatUsIA_C Adc_idxTPFltDsIA_C Adc_idxTPFltUsIA_C Adc_idxTrbChIA_C Adc_idxTTrbnUsIA_C Adc_idxUCatUsTIA_C Adc_idxUHtrPLDiaIA_C Adc_idxUHtrTnkDiaIA_C Adc_idxUPmpPIA_C Adc_idxUTnkTIA_C Adc_idxVSwVlvIA_C /end DEF_CHARACTERISTIC
/end FUNCTION
/begin FUNCTION AdcI "" /end FUNCTION
/begin FUNCTION AddHtr_DD ""
 /begin DEF_CHARACTERISTIC WaHtEl_4WinDiagDeb.ct4WinErr1DebDef_C WaHtEl_4WinDiagDeb.ct4WinErr2DebDef_C WaHtEl_4WinDiagDeb.ct4WinErr3DebDef_C WaHtEl_4WinDiagDeb.ct4WinErr4DebDef_C WaHtEl_4WinDiagDeb.ti4WinErrDebDef_C WaHtEl_4WinSigDur.tiErr1Min_C WaHtEl_4WinSigDur.tiErr1Max_C WaHtEl_4WinSigDur.tiErr2Min_C WaHtEl_4WinSigDur.tiErr2Max_C WaHtEl_4WinSigDur.tiErr3Min_C WaHtEl_4WinSigDur.tiErr3Max_C WaHtEl_4WinSigDur.tiErr4Min_C WaHtEl_4WinSigDur.tiErr4Max_C WaHtEl_Pwm.tiPer_C WaHtEl_Pwm.stLvl_C WaHtEl_Pwm.rMaxDty_C WaHtEl_Pwm.rPerUn_C WaHtEl_Pwm.tiPh_C WaHtEl_PwmOut.rMin_C WaHtEl_PwmOut.rMax_C WaHtEl_PwmOut.tiBtwTstSCB_C WaHtEl_PwmOut.tiBtwTstOT_C WaHtEl_PwmOut.numTstMax_C WaHtEl_PwmOut.swtBattCor_C WaHtEl_PwmOut.swtPsInv_C WaHtEl_rCnv_CUR WaHtEl_rPsDisbl_C WaHtEl_rPsRecg_C WaHtEl_stPsDiaDisbl_C WaHtEl_stPsDisbl_C WaHtEl_swtRecDeAct_C WaHtEl_tiRecDeb_C WaHtEl_typ4WinDia_C /end DEF_CHARACTERISTIC
 /begin IN_MEASUREMENT BattU_facCor DevLib_stPwrStgEnaCond WaHt_rHtgOut /end IN_MEASUREMENT
 /begin OUT_MEASUREMENT WaHtEl_bEval WaHtEl_bRec WaHtEl_bRecActv WaHtEl_rPs /end OUT_MEASUREMENT
 /begin LOC_MEASUREMENT WaHtEl_ct4WinErr1_mp WaHtEl_ct4WinErr2_mp WaHtEl_ct4WinErr3_mp WaHtEl_ct4WinErr4_mp WaHtEl_stErrMsg_mp WaHtEl_stRec_mp /end LOC_MEASUREMENT
/end FUNCTION
/begin FUNCTION aepbattmng ""
 /begin DEF_CHARACTERISTIC KF_BATT1 KF_BATT2 KF_MAXENTL KF_UBATT_LL KF_USOLL KL_ENTLADEZ KL_UBSOLLTR KL_UBTMTL KL_USOLL2 K_BATTMXOFF K_BATTORT0 K_DELTA1 K_DELTA2 K_DSOCDELTA1 K_DSOCDELTA2 K_KAPAVERLU K_PR_BAPPDMN K_PR_BAPPMX K_PR_BAPPSMN K_PR_BAPPSOLL K_PR_BATTMX K_PR_UBSOLL K_PR_UBSOLLTR K_PR_UDBMN_H K_PR_UDBMN_L K_PR_UDBMN_M K_PR_USBMN_H K_PR_USBMN_L K_QV_NPL K_QV_QUALIMX K_TBTFREIMAX K_TBTMXIGRLO K_TBTPAUMIN K_TDUB K_TUMGFLTTAU K_TUMGHYST K_TUMGMIN K_UBAPPDMN K_UBAPPMX K_UBAPPSMN K_UBAPPSOLL K_UBATTMN_L K_UBATTMN_M K_UBATT_MX K_UBDET_U K_UBNOTLAUF K_UBSOLLREG K_UBTDET_U K_UNOTLKONST K_ZYK_BTMXF S_BATTAPP S_BATTEMP S_BREGENU_HI S_BZE_EN S_FITSPERRE S_QVCH2OON /end DEF_CHARACTERISTIC
 /begin IN_MEASUREMENT Soc_rel T_batt /end IN_MEASUREMENT
 /begin OUT_MEASUREMENT Batt_h2m_l Batt_h2m_r Batt_m2l Batt_m2l_l Batt_m2l_r Dsoc_temp D_ubatt_bt Entladezeit Kapa_verlust Ladezeit Pr_batt_mx Pr_batt_soll Pr_dynbatt_mn Pr_stabatt_mn St_pmbattmng0 St_pmbattmng1 St_pmbattmng2 Tumgersfilt Tumg_ers T_batt_zw4 U_battsoll U_batt_ll U_batt_max U_batt_min U_batt_mx U_batt_soll U_bsoll_lcp U_bt_mtl U_deltau U_dynbatt_mn U_stabatt_mn X_KF_MAXENTL_no_input_quantity X_KF_UBATT_LL_no_input_quantity X_KL_USOLL2_no_input_quantity Zentlact Zladungact /end OUT_MEASUREMENT
/end FUNCTION
/begin FUNCTION aepbattregen ""
 /begin DEF_CHARACTERISTIC KL_KAPAVZ KL_WSOCLOW K_ABSTDLY K_DODSTART K_DQELREGSTART K_DQ_AUSLOES K_LADEFAKT K_QMINREG K_QREGEND K_REGEN_ON K_SOCQSCHW K_TDREGEN K_TMAXREGEN K_TNABSPLAUS K_TSTARTREG K_TZWSTARTREG K_ZRREGEN S_BATTCHGINI S_BATTREGENECU S_BBATTREGEN S_BBATTREGINI S_REGOK_MAN S_REGSTART_MAN /end DEF_CHARACTERISTIC
 /begin IN_MEASUREMENT Soc_bila /end IN_MEASUREMENT
 /begin OUT_MEASUREMENT Dod_start Dqe_regstart Dql_regstart K_TAUSLOES Q_regend St_pmbattreg2 St_pmbattregen St_pmbattregen2 Td_regen Td_regen0 T_startreg T_zwstartreg X_KL_KAPAVZ_no_input_quantity Zr_regen Zw1 Zw10 Zw11 Zw12 Zw6 Zw7 Zw8 Zw9 /end OUT_MEASUREMENT
/end FUNCTION
/begin FUNCTION aepco2mng ""
 /begin DEF_CHARACTERISTIC K_ABSTIGRMAX K_ABSTIGRMN1 K_ABSTIGRMN2 K_APPCO2M2L K_C02MSA_OFF K_IGRCD_EN K_IGRHIGHEN K_IGRH_ZYKL K_IGRMEDEN K_IGRM_ZYKL K_M2LAV1MSA K_M2LAV2MSA K_M2LEA1MSA K_M2LEA2MSA K_MSA_ZYKL K_PMRDM2LMSA S_APPCO2IGRON S_APPCO2M2L S_APPCO2MSA S_IGRCD_MAN /end DEF_CHARACTERISTIC
 /begin OUT_MEASUREMENT Battm2loffst Dsoc_igrmax Dsoc_igrmin Dsoc_igrmin2 Dsoc_msaav1 Dsoc_msaav2 Dsoc_msaea1 Dsoc_msaea2 St_co2mng St_co2mng_1 /end OUT_MEASUREMENT
/end FUNCTION
/begin FUNCTION aepdiag ""
 /begin DEF_CHARACTERISTIC CW_CCMASK CW_CCTEST CW_DTCMASK CW_DTCTEST K_BUPACTRATE K_FSPM K_OSPGAPP K_STATSVREG2 K_T2PMINFO K_T3PMINFO K_T_OUSPGSET K_T_TIEFPRE K_USPGAPP K_ZTAGEOLD S_DIAGECU S_RESTOREAP1 /end DEF_CHARACTERISTIC
 /begin OUT_MEASUREMENT Aep_klemmstat Fs_pm Ibsbor_hb Pmbackup Pminfo1 Pminfo2 Qvcbackup1 Qvcbackup2 Qvcbackup3 Stat_sv_reg2 St_pmdiag0 St_pmdiag1 St_pmdiag2 St_pmdiagnv T1histshort T2histshort T2pmcntr T3histshort T3pmcntr T_saismem Ztagedelta Ztageold /end OUT_MEASUREMENT
/end FUNCTION
/begin FUNCTION aepflashol ""
 /begin DEF_CHARACTERISTIC K_AEPFLFILTK K_FLASHDURIN K_FLASHDUROUT K_FLASHSTATIN K_FLASHSTATOUT K_FLSOCMIN K_FLSOCSTFGK K_IBATTAEP K_TD_IFILT K_UGRENZ S_APP_FTCALCRQ S_FLASHKONSOLE S_FLASHOLECU S_FTCALCRDY /end DEF_CHARACTERISTIC
 /begin OUT_MEASUREMENT Activeflashreqs E_flstatin E_flstatout Flashdurmax Flashdurout Flashstatemachine Flashstatout Fzgzustand I_battfiltaep Qtmp Q_flashdiff Soc_flashdiff St_aepflashol0 St_aepflasholout /end OUT_MEASUREMENT
/end FUNCTION
/begin FUNCTION aepigr ""
 /begin DEF_CHARACTERISTIC KL_IGRDFGEN_MN K_IGRDFGEN_MX K_IGRMEUMIN K_IGRNL K_IGRUMAX K_IGRUMINMAX K_IGRUMN K_IGRUMN2 K_IGR_DI1 K_IGR_DI1DT K_IGR_DI2 K_IGR_DI2DT K_IGR_ENTPR K_IGR_IHIGH K_IGR_IHIGH2 K_IGR_IMED K_IGR_MANRAMP K_IGR_OSDI1 K_IGR_UDPN K_IGR_UOS K_PR_IGRDPN K_PR_IGRLOW K_PR_IGRMH S_BCDIGRONR S_IGRECU S_IGRPF_EN /end DEF_CHARACTERISTIC
 /begin IN_MEASUREMENT Nkw /end IN_MEASUREMENT
 /begin OUT_MEASUREMENT Pr_igr_dpn Pr_igr_soll St_igr1 St_igroutnv U_igrmedhi U_igr_dpn U_igr_soll /end OUT_MEASUREMENT
/end FUNCTION
/begin FUNCTION aepigrdiag ""
 /begin DEF_CHARACTERISTIC K_IGRDIAGT_MN K_IGRDIAG_T1 K_IGRDIAG_T2 K_IGRDIAG_TMN K_IGRDIAG_TST K_IGRINF_TSB K_IGR_ANT K_INFORESET /end DEF_CHARACTERISTIC
 /begin OUT_MEASUREMENT Igrinfo Igr_inforeset Qeladhi_start Qeladmed_start Qelad_igrhi Qladlow_int Qladmed_start Qlad_igrlow St_aepigrdiag1 St_aepigrdiag_a0 St_aepigrdiag_b0 St_aepigrdiag_c0 St_igr_a0old T_igrdiagon T_igrhigh T_igrh_antakt T_igrlow T_igrl_antakt T_igrmed T_igrm_antakt Zr_igr_low /end OUT_MEASUREMENT
/end FUNCTION
/begin FUNCTION aepigrsbcalc ""
 /begin DEF_CHARACTERISTIC K_IGRBS K_IGRLOW_EN K_IGR_NKWMN K_IGR_TMOTMN K_IGR_VMIN S_IGRLOW_MAN /end DEF_CHARACTERISTIC
 /begin OUT_MEASUREMENT St_igrsbcalc /end OUT_MEASUREMENT
/end FUNCTION
/begin FUNCTION aepklemmab "" /begin DEF_CHARACTERISTIC K_ENKLEMMSTAPP S_ENKLEMMSTAPP /end DEF_CHARACTERISTIC
 /begin OUT_MEASUREMENT Ctrpcos D_qsfg1 D_qsfg2 Enklemmstate St_aepklemmab St_aepklemmab1 /end OUT_MEASUREMENT
/end FUNCTION
/begin FUNCTION aepkompanf ""
 /begin DEF_CHARACTERISTIC KF_EKPRFNKW KF_UKRAPU KF_WDAFS KL_BNLIM KL_ELUEFTER KL_ELU_L3 KL_EWP K_DSCUMIN K_DSCUMN K_DSCUMX K_EPSUMN K_EPS_VMAX K_GEBLAKT K_GEBLDUPMX K_GEBLUMN K_ID_VBRES1 K_ID_VBRES2 K_ID_VBRES3 K_ID_VBRES4 K_KRAPUMNNL K_LICHTAKT K_LICHTDUPNMX K_LICHTUMN K_LWMIN K_PR_GEBLDUP K_PR_LICHTDUPN K_PR_VBRES3DUPN K_PR_VBRES4DUPN K_SLPAKT K_SLPUMN K_TD_DSC K_TD_IBNFILT K_UBLMN K_VBRES1UMX K_VBRES2UMN K_VBRES2UMX K_VBRES3DUPNMX K_VBRES3UMN K_VBRES3UMX K_VBRES4DUPNMX K_VBRES4UMN K_VBRES4UMX K_VBRES5UMN K_VBRES5UMX K_VERB_CAN K_WISCHERAKT K_WISCHUMN K_WISCHUMX S_ELU_L3 S_EPS_EN S_KEKP S_VBRES1_AK S_VBRES2_AK S_VBRES3_AK S_VBRES4_AK S_VBRES5_AK /end DEF_CHARACTERISTIC
 /begin IN_MEASUREMENT L_pwmout Newp_soll Nkw Tmot V_krapu W_afs W_dafs /end IN_MEASUREMENT
 /begin OUT_MEASUREMENT I_bnfilt I_bnfiltlim Pr_geblaese_dpn Pr_licht_dpn Pr_vbres3_dpn Pr_vbres4_dpn Pr_vbtherm_mx St_pmvbmng0 St_pmvbmng1 St_pmvbmng2 U_bl_min U_dsc_max U_dsc_min U_elue_min U_eps_min U_ewp_min U_geblaese_dpn U_geblaese_min U_krapu_min U_licht_dpn U_licht_min U_slp_min U_vbres1_max U_vbres1_min U_vbres2_max U_vbres2_min U_vbres3_dpn U_vbres3_max U_vbres3_min U_vbres4_dpn U_vbres4_max U_vbres4_min U_vbres5_max U_vbres5_min U_vbtherm_mx U_wischer_max U_wischer_min Verbstat_0 Y_KF_EKPRFNKW_no_input_quantity /end OUT_MEASUREMENT
/end FUNCTION
/begin FUNCTION aeplemdiag ""
 /begin DEF_CHARACTERISTIC KL_BATTMNG KL_INVBATTMNG KL_INVLOG KL_LOG KL_QUALI KL_QUALILOG K_INSPRESET K_LEMDELAY K_LEMDIAGU1 K_LEMDIAGU2 K_LEMDIAGU3 K_LEMDIAGU4 K_LEMDIAGU5 K_LEMDIAGU6 K_LEMDIAGU7 K_LEMRESET K_QUALI_1 K_QUALI_2 K_QUALI_3 /end DEF_CHARACTERISTIC
 /begin OUT_MEASUREMENT Count_out_1 Count_out_2 Count_out_3 Count_out_4 Count_out_5 Count_out_6 Count_out_7 Lemcnt_reset Leminfo Stat_quali_1 Stat_quali_2 Stat_quali_3 Stat_ubattsoll_h Stat_ubattsoll_l St_aeplemdiag0 St_aeplemdiag1 St_aeplemdiag2 Tm_entlfunk Tm_entlsich Tm_ierrllred Tm_ierrtred T_entlfunk T_entlsich T_ierrllred T_ierrtred X_KL_BATTMNG_no_input_quantity X_KL_INVBATTMNG_no_input_quantity X_KL_INVLOG_no_input_quantity X_KL_LOG_no_input_quantity X_KL_QUALILOG_no_input_quantity X_KL_QUALI_no_input_quantity Zr_entlfunk Zr_entlfunknix Zr_entlfunkteil Zr_entlfunkvoll Zr_entlsich Zr_entlsichvoll Zr_ierrllred Zr_ierrtred Zr_quali_1 Zr_quali_2 Zr_quali_3 Zr_ubattsoll_h Zr_ubattsoll_l Zr_ustat_1 Zr_ustat_2 Zr_ustat_3 Zr_ustat_4 Zr_ustat_5 Zr_ustat_6 Zr_ustat_7 /end OUT_MEASUREMENT
/end FUNCTION
/begin FUNCTION aepllctrl ""
 /begin DEF_CHARACTERISTIC K_DFLLMIN K_DFMAX K_DSOCHYST K_DSOCLLANH K_LLPMFILTK K_NLLAPP K_NLLMIN K_NSUBO K_NSUBTRA K_NSUBU K_PRELLDFAH K_PRELLDFRF S_APP_LLAH S_GENLLAHAPP S_LLANHBNS S_NTWBGLLGEN /end DEF_CHARACTERISTIC
 /begin OUT_MEASUREMENT Dfgenfilt Gen_dfvorhs Nslb St_llpmctrl0 St_llpmctrl1 St_llranh0 /end OUT_MEASUREMENT
/end FUNCTION
/begin FUNCTION aepmsa ""
 /begin DEF_CHARACTERISTIC K_AVBBATTGD K_AVSOCNPL K_IBATTAPPL K_IBNAV_GRZ K_IBNAV_OK K_IBNEA K_MSASTOPAPP K_MSASTRTAPP K_QLADAVNAKT K_TBATTAPPL K_TBATT_O1 K_TCLRAVSOCF K_TIME_IBNEA K_TIME_UAV K_USTRTMSAMI K_UTNSTDETEC K_ZKLONG S_AVDIAG_ACT S_AVSOCF_ACT S_AVTBAT_ACT S_AVUSTRQLAD S_AVUSTR_ACT S_PMMSA_AV S_PMMSA_EA /end DEF_CHARACTERISTIC
 /begin OUT_MEASUREMENT Count_av_utn Count_ea_ibn I_bn_bl_filt I_bn_unfilt Qlad_aktfahr St_pmmsa0 St_pmmsa_1s /end OUT_MEASUREMENT
/end FUNCTION
/begin COMPU_METHOD Acc "" RAT_FUNC "%6.5" "m/s^2" COEFFS 0 1000 0 0 0 1 /end COMPU_METHOD
/begin COMPU_METHOD Def_dez_sb_q1 "" RAT_FUNC "%3.1" "-" COEFFS 0 1 0 0 0 1 /end COMPU_METHOD
/begin COMPU_METHOD Def_dez_ub_q1 "" RAT_FUNC "%3.1" "-" COEFFS 0 1 0 0 0 1 /end COMPU_METHOD
/begin COMPU_METHOD Def_dez_ul_q1 "" RAT_FUNC "%7.3" "-" COEFFS 0 1 0 0 0 1 /end COMPU_METHOD
/begin COMPU_METHOD Def_dez_uw_q1 "" RAT_FUNC "%5.2" "-" COEFFS 0 1 0 0 0 1 /end COMPU_METHOD
/begin COMPU_METHOD Def_f_r32 "" RAT_FUNC "%14.6" "-" COEFFS 0 1 0 0 0 1 /end COMPU_METHOD
/begin COMPU_METHOD Def_f_sw_b100 "" RAT_FUNC "%8.5" "-" COEFFS 0 327.68 0 0 0 1 /end COMPU_METHOD
/begin COMPU_METHOD Def_f_ub_b1 "" RAT_FUNC "%6.4" "-" COEFFS 0 256 0 0 0 1 /end COMPU_METHOD
/begin COMPU_METHOD Def_f_ub_b100 "" RAT_FUNC "%5.2" "%" COEFFS 0 2.56 0 0 0 1 /end COMPU_METHOD
/begin COMPU_METHOD Def_f_ub_b2 "" RAT_FUNC "%6.4" "-" COEFFS 0 128 0 0 0 1 /end COMPU_METHOD
/begin COMPU_METHOD Def_f_ub_b32 "" RAT_FUNC "%5.2" "-" COEFFS 0 8 0 0 0 1 /end COMPU_METHOD
/begin COMPU_METHOD Def_f_uw_b1 "" RAT_FUNC "%14.10" "-" COEFFS 0 65536 0 0 0 1 /end COMPU_METHOD
/begin COMPU_METHOD Def_f_uw_b100 "" RAT_FUNC "%8.5" "%" COEFFS 0 655.36 0 0 0 1 /end COMPU_METHOD
/begin COMPU_METHOD Def_i_sw_q0p02 "" RAT_FUNC "%8.5" "A" COEFFS 0 50 0 0 0 1 /end COMPU_METHOD
/begin COMPU_METHOD Def_i_ub_q1 "" RAT_FUNC "%6.2" "" COEFFS 0 1 0 0 0 1 /end COMPU_METHOD
/begin COMPU_METHOD Def_i_uw_q0p02 "" RAT_FUNC "%8.5" "A" COEFFS 0 50 0 0 0 1 /end COMPU_METHOD
/begin COMPU_METHOD Def_i_uw_q0p08_o200 "" RAT_FUNC "%8.2" "" COEFFS 0 12.5 2500 0 0 1 /end COMPU_METHOD
/begin COMPU_METHOD Def_n_sw_q1p0 "" RAT_FUNC "%5.2" "Upm" COEFFS 0 1 0 0 0 1 /end COMPU_METHOD
/begin COMPU_METHOD Def_ql_uw_q0p0182 "" RAT_FUNC "%8.5" "Ah" COEFFS 0 54.9444444444444 0 0 0 1 /end COMPU_METHOD
/begin COMPU_METHOD Def_ql_uw_q0p29127 "" RAT_FUNC "%7.3" "" COEFFS 0 3.43333333333333 0 0 0 1 /end COMPU_METHOD
/begin COMPU_METHOD Def_rf_sw_q0p01 "" RAT_FUNC "%9.6" "%" COEFFS 0 100 0 0 0 1 /end COMPU_METHOD
/begin COMPU_METHOD Def_str_uw_q0p125 "" RAT_FUNC "%9.4" "1/m" COEFFS 0 8 0 0 0 1 /end COMPU_METHOD
/begin COMPU_METHOD Def_st_ub_q1 "" RAT_FUNC "%3.1" "-" COEFFS 0 1 0 0 0 1 /end COMPU_METHOD
/begin COMPU_METHOD Def_td_ub_b1280 "" RAT_FUNC "%4.1" "ms" COEFFS 0 0.2 0 0 0 1 /end COMPU_METHOD
/begin COMPU_METHOD Def_td_ub_q0p1 "" RAT_FUNC "%4.2" "s" COEFFS 0 10 0 0 0 1 /end COMPU_METHOD
/begin COMPU_METHOD Def_td_ub_q1 "" RAT_FUNC "%5.2" "s" COEFFS 0 1 0 0 0 1 /end COMPU_METHOD
/begin COMPU_METHOD Def_td_ub_q14p9333 "" RAT_FUNC "%5.1" "min" COEFFS 0 0.0669642857142857 0 0 0 1 /end COMPU_METHOD
/begin COMPU_METHOD Def_td_uw_q0p01 "" RAT_FUNC "%7.5" "s" COEFFS 0 100 0 0 0 1 /end COMPU_METHOD
/begin COMPU_METHOD Def_td_uw_q0p1 "" RAT_FUNC "%6.3" "s" COEFFS 0 10 0 0 0 1 /end COMPU_METHOD
/begin COMPU_METHOD Def_td_uw_q1 "" RAT_FUNC "%5.2" "s" COEFFS 0 1 0 0 0 1 /end COMPU_METHOD
/begin COMPU_METHOD Def_tv_ub_q0p390625 "" RAT_FUNC "%5.2" "%" COEFFS 0 2.56 0 0 0 1 /end COMPU_METHOD
/begin COMPU_METHOD Def_t_sw_q0p01 "" RAT_FUNC "%7.5" "°C" COEFFS 0 100 0 0 0 1 /end COMPU_METHOD
/begin COMPU_METHOD Def_t_sw_q0p1 "" RAT_FUNC "%6.3" "°C" COEFFS 0 10 0 0 0 1 /end COMPU_METHOD
/begin COMPU_METHOD Def_u_sw_q0p00488 "" RAT_FUNC "%8.5" "V" COEFFS 0 204.8 0 0 0 1 /end COMPU_METHOD
/begin COMPU_METHOD Def_u_ub_b0p5 "" RAT_FUNC "%7.5" "V" COEFFS 0 512 0 0 0 1 /end COMPU_METHOD
/begin COMPU_METHOD Def_u_ub_q0p1 "" RAT_FUNC "%5.3" "V" COEFFS 0 10 0 0 0 1 /end COMPU_METHOD
/begin COMPU_METHOD Def_u_uw_q0p032 "" RAT_FUNC "%8.5" "V" COEFFS 0 31.25 0 0 0 1 /end COMPU_METHOD
/begin COMPU_METHOD Def_u_uw_q0p25em3_o6 "" RAT_FUNC "%9.5" "" COEFFS 0 4000 -24000 0 0 1 /end COMPU_METHOD
/begin COMPU_METHOD Def_v_uw_q1p0 "" RAT_FUNC "%5.2" "km/h" COEFFS 0 1 0 0 0 1 /end COMPU_METHOD
/begin COMPU_METHOD Def_wdk_sw_q0p1 "" RAT_FUNC "%7.4" "-" COEFFS 0 10 0 0 0 1 /end COMPU_METHOD
/begin COMPU_METHOD DtyCyc "" RAT_FUNC "%5.2" "%" COEFFS 0 100 0 0 0 1 /end COMPU_METHOD
/begin COMPU_METHOD EngN "" RAT_FUNC "%5.1" "rpm" COEFFS 0 2 0 0 0 1 /end COMPU_METHOD
/begin COMPU_METHOD Fact "" RAT_FUNC "%6.5" "-" COEFFS 0 8192 0 0 0 1 /end COMPU_METHOD
/begin COMPU_METHOD Fact1 "" RAT_FUNC "%6.4" "-" COEFFS 0 128 0 0 0 1 /end COMPU_METHOD
/begin COMPU_METHOD ident "" RAT_FUNC "%3.1" "-" COEFFS 0 1 0 0 0 1 /end COMPU_METHOD
/begin COMPU_METHOD Identity "" RAT_FUNC "%3.1" "-" COEFFS 0 1 0 0 0 1 /end COMPU_METHOD
/begin COMPU_METHOD OneToOne "" RAT_FUNC "%6.0" "-" COEFFS 0 1 0 0 0 1 /end COMPU_METHOD
/begin COMPU_METHOD Period "" RAT_FUNC "%6.3" "ms" COEFFS 0 10 0 0 0 1 /end COMPU_METHOD
/begin COMPU_METHOD Prc "" RAT_FUNC "%6.4" "%" COEFFS 0 81.92 0 0 0 1 /end COMPU_METHOD
/begin COMPU_METHOD PrcPerSec "" RAT_FUNC "%6.3" "%/s" COEFFS 0 1.6384 0 0 0 1 /end COMPU_METHOD
/begin COMPU_METHOD RmpTrq "" RAT_FUNC "%6.4" "Nm/s" COEFFS 0 655.36 0 0 0 1 /end COMPU_METHOD
/begin COMPU_METHOD Temp_Cels "" RAT_FUNC "%5.1" "deg C" COEFFS 0 10 2731.4 0 0 1 /end COMPU_METHOD
/begin COMPU_METHOD TimeDeb "" RAT_FUNC "%5.0" "ms" COEFFS 0 0.1 0 0 0 1 /end COMPU_METHOD
/begin COMPU_METHOD TimeDelay_s "" RAT_FUNC "%12.4" "s" COEFFS 0 0 1 0 0.00023283064365387 0 /end COMPU_METHOD
/begin COMPU_METHOD TimeDT "" RAT_FUNC "%6.2" "us" COEFFS 0 1 0 0 0 1 /end COMPU_METHOD
/begin COMPU_METHOD Time_ms "" RAT_FUNC "%5.0" "ms" COEFFS 0 0.1 0 0 0 1 /end COMPU_METHOD
/begin COMPU_METHOD Time_s "" RAT_FUNC "%5.2" "s" COEFFS 0 100 0 0 0 1 /end COMPU_METHOD
/begin COMPU_METHOD TransR "" RAT_FUNC "%4.2" "-" COEFFS 0 100 0 0 0 1 /end COMPU_METHOD
/begin COMPU_METHOD Trq "" RAT_FUNC "%5.1" "Nm" COEFFS 0 10 0 0 0 1 /end COMPU_METHOD
/begin COMPU_METHOD TrqPrp "" RAT_FUNC "%5.1" "Nm" COEFFS 0 0.625 0 0 0 1 /end COMPU_METHOD
/begin COMPU_METHOD TrqPrpHigh "" RAT_FUNC "%5.1" "Nm" COEFFS 0 10 0 0 0 1 /end COMPU_METHOD
/begin COMPU_METHOD Typ4WinDia "" TAB_VERB "%6.3" "" COMPU_TAB_REF Typ4WinDia /end COMPU_METHOD
/begin COMPU_VTAB Typ4WinDia "" TAB_VERB 4 0 "4 Window diagnosis over PWM control line" 1 "4 Window diagnosis through Digital input" 2 "4 Window diagnosis over external interface" 3 "No 4 Window diagnosis." /end COMPU_VTAB
/begin COMPU_METHOD Vel "" RAT_FUNC "%5.2" "km/h" COEFFS 0 100 0 0 0 1 /end COMPU_METHOD
/begin COMPU_METHOD default "" RAT_FUNC "%6.2" "" COEFFS 0 1 0 0 0 1 /end COMPU_METHOD
/begin RECORD_LAYOUT CurTKL_SB_VV_UB NO_AXIS_PTS_X 1 UBYTE RESERVED 2 BYTE AXIS_PTS_X 3 SBYTE INDEX_INCR DIRECT FNC_VALUES 4 UBYTE COLUMN_DIR DIRECT /end RECORD_LAYOUT
/begin RECORD_LAYOUT CurTKL_SF_VV_SF NO_AXIS_PTS_X 1 UBYTE RESERVED 2 BYTE AXIS_PTS_X 3 FLOAT32_IEEE INDEX_INCR DIRECT FNC_VALUES 4 FLOAT32_IEEE COLUMN_DIR DIRECT /end RECORD_LAYOUT
/begin RECORD_LAYOUT CurTKL_SW_VV_UB NO_AXIS_PTS_X 1 UBYTE RESERVED 2 BYTE AXIS_PTS_X 3 SWORD INDEX_INCR DIRECT FNC_VALUES 4 UBYTE COLUMN_DIR DIRECT /end RECORD_LAYOUT
/begin RECORD_LAYOUT CurTKL_UB_VV_UB NO_AXIS_PTS_X 1 UBYTE RESERVED 2 BYTE AXIS_PTS_X 3 UBYTE INDEX_INCR DIRECT FNC_VALUES 4 UBYTE COLUMN_DIR DIRECT /end RECORD_LAYOUT
/begin RECORD_LAYOUT CurTKL_UB_VV_UW NO_AXIS_PTS_X 1 UBYTE RESERVED 2 BYTE AXIS_PTS_X 3 UBYTE INDEX_INCR DIRECT FNC_VALUES 4 UWORD COLUMN_DIR DIRECT /end RECORD_LAYOUT
/begin RECORD_LAYOUT CurTKL_UW_VV_UB NO_AXIS_PTS_X 1 UBYTE RESERVED 2 BYTE AXIS_PTS_X 3 UWORD INDEX_INCR DIRECT FNC_VALUES 4 UBYTE COLUMN_DIR DIRECT /end RECORD_LAYOUT
/begin RECORD_LAYOUT Cur_Xs16Ws16 NO_AXIS_PTS_X 1 SWORD AXIS_PTS_X 2 SWORD INDEX_INCR DIRECT FNC_VALUES 3 SWORD COLUMN_DIR DIRECT /end RECORD_LAYOUT
/begin RECORD_LAYOUT Kf_Xs16_Ys16_Ws16 NO_AXIS_PTS_X 1 SWORD NO_AXIS_PTS_Y 2 SWORD AXIS_PTS_X 3 SWORD INDEX_INCR DIRECT AXIS_PTS_Y 4 SWORD INDEX_INCR DIRECT FNC_VALUES 5 SWORD COLUMN_DIR DIRECT /end RECORD_LAYOUT
/begin RECORD_LAYOUT Kl_Xs16_Ws16 NO_AXIS_PTS_X 1 SWORD AXIS_PTS_X 2 SWORD INDEX_INCR DIRECT FNC_VALUES 3 SWORD COLUMN_DIR DIRECT /end RECORD_LAYOUT
/begin RECORD_LAYOUT Kw_Ws16 FNC_VALUES 1 SWORD COLUMN_DIR DIRECT /end RECORD_LAYOUT
/begin RECORD_LAYOUT Kw_Ws32 FNC_VALUES 1 SLONG COLUMN_DIR DIRECT /end RECORD_LAYOUT
/begin RECORD_LAYOUT Kw_Wu16 FNC_VALUES 1 UWORD COLUMN_DIR DIRECT /end RECORD_LAYOUT
/begin RECORD_LAYOUT Kw_Wu8 FNC_VALUES 1 UBYTE COLUMN_DIR DIRECT /end RECORD_LAYOUT
/begin RECORD_LAYOUT MapTKF_SW_SW_UB NO_AXIS_PTS_X 1 UBYTE NO_AXIS_PTS_Y 2 UBYTE AXIS_PTS_X 3 SWORD INDEX_INCR DIRECT AXIS_PTS_Y 4 SWORD INDEX_INCR DIRECT FNC_VALUES 5 UBYTE COLUMN_DIR DIRECT /end RECORD_LAYOUT
/begin RECORD_LAYOUT MapTKF_SW_UB_UB NO_AXIS_PTS_X 1 UBYTE NO_AXIS_PTS_Y 2 UBYTE AXIS_PTS_X 3 UBYTE INDEX_INCR DIRECT AXIS_PTS_Y 4 SWORD INDEX_INCR DIRECT FNC_VALUES 5 UBYTE COLUMN_DIR DIRECT /end RECORD_LAYOUT
/begin RECORD_LAYOUT MapTKF_UB_SW_SW NO_AXIS_PTS_X 1 UBYTE NO_AXIS_PTS_Y 2 UBYTE AXIS_PTS_X 3 SWORD INDEX_INCR DIRECT AXIS_PTS_Y 4 UBYTE INDEX_INCR DIRECT FNC_VALUES 5 SWORD COLUMN_DIR DIRECT /end RECORD_LAYOUT
/begin RECORD_LAYOUT MapTKF_UW_SW_UW NO_AXIS_PTS_X 1 UBYTE NO_AXIS_PTS_Y 2 UBYTE AXIS_PTS_X 3 SWORD INDEX_INCR DIRECT AXIS_PTS_Y 4 UWORD INDEX_INCR DIRECT FNC_VALUES 5 UWORD COLUMN_DIR DIRECT /end RECORD_LAYOUT
/begin RECORD_LAYOUT Map_Xs16Ys16Ws16 NO_AXIS_PTS_X 1 SWORD NO_AXIS_PTS_Y 2 SWORD AXIS_PTS_X 3 SWORD INDEX_INCR DIRECT AXIS_PTS_Y 4 SWORD INDEX_INCR DIRECT FNC_VALUES 5 SWORD COLUMN_DIR DIRECT /end RECORD_LAYOUT
/begin RECORD_LAYOUT Val_Ws16 FNC_VALUES 1 SWORD COLUMN_DIR DIRECT /end RECORD_LAYOUT
/begin RECORD_LAYOUT Val_Ws32 FNC_VALUES 1 SLONG COLUMN_DIR DIRECT /end RECORD_LAYOUT
/begin RECORD_LAYOUT Val_Wu16 FNC_VALUES 1 UWORD COLUMN_DIR DIRECT /end RECORD_LAYOUT
/begin RECORD_LAYOUT Val_Wu32 FNC_VALUES 1 ULONG COLUMN_DIR DIRECT /end RECORD_LAYOUT
/begin RECORD_LAYOUT Val_Wu8 FNC_VALUES 1 UBYTE COLUMN_DIR DIRECT /end RECORD_LAYOUT
/end MODULE
/end PROJECT

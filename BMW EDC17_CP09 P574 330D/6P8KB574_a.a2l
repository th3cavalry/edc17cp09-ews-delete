ASAP2_VERSION 1 4
/begin PROJECT P_574 "EDC17_CP09"
/begin HEADER "" VERSION "V8KB" PROJECT_NO P_574 /end HEADER
/begin MODULE DIM ""
/begin MOD_COMMON "" BYTE_ORDER MSB_LAST ALIGNMENT_BYTE 1 ALIGNMENT_WORD 2 ALIGNMENT_LONG 4 ALIGNMENT_FLOAT32_IEEE 4 /end MOD_COMMON
/begin MEASUREMENT IVCtl_tiVltgGovCalc04 "Zeitstempel: Letzte Berechnung des Spannungsreglers" ULONG Time_PzoMeas 1 100 0.00 234505214.307 FORMAT "%13.3" ECU_ADDRESS 0xD00031E4 /end MEASUREMENT
/begin MEASUREMENT IVCtl_tiVltgGovCalc05 "Zeitstempel: Letzte Berechnung des Spannungsreglers" ULONG Time_PzoMeas 1 100 0.00 234505214.307 FORMAT "%13.3" ECU_ADDRESS 0xD00031E8 /end MEASUREMENT
/begin MEASUREMENT IVCtl_uChrgUp_mp00 "Sollspannung nach dem Laden" SWORD Vltg_PA 1 100 -327.6800 327.6700 ECU_ADDRESS 0xC000C264 /end MEASUREMENT
/begin MEASUREMENT IVCtl_uChrgUp_mp01 "Sollspannung nach dem Laden" SWORD Vltg_PA 1 100 -327.6800 327.6700 ECU_ADDRESS 0xC000C266 /end MEASUREMENT
/begin MEASUREMENT IVCtl_uChrgUp_mp02 "Sollspannung nach dem Laden" SWORD Vltg_PA 1 100 -327.6800 327.6700 ECU_ADDRESS 0xC000C268 /end MEASUREMENT
/begin MEASUREMENT IVCtl_uChrgUp_mp03 "Sollspannung nach dem Laden" SWORD Vltg_PA 1 100 -327.6800 327.6700 ECU_ADDRESS 0xC000C26A /end MEASUREMENT
/begin MEASUREMENT IVCtl_uChrgUp_mp04 "Sollspannung nach dem Laden" SWORD Vltg_PA 1 100 -327.6800 327.6700 ECU_ADDRESS 0xC000C26C /end MEASUREMENT
/begin MEASUREMENT IVCtl_uChrgUp_mp05 "Sollspannung nach dem Laden" SWORD Vltg_PA 1 100 -327.6800 327.6700 ECU_ADDRESS 0xC000C26E /end MEASUREMENT
/begin MEASUREMENT IVCtl_uCorPI00 "Ausgang des Aktorspannungsreglers" SWORD Vltg_PA 1 100 -327.6800 327.6700 ECU_ADDRESS 0xD0000C78 /end MEASUREMENT
/begin MEASUREMENT IVCtl_uCorPI01 "Ausgang des Aktorspannungsreglers" SWORD Vltg_PA 1 100 -327.6800 327.6700 ECU_ADDRESS 0xD0000C7A /end MEASUREMENT
/begin MEASUREMENT IVCtl_uCorPI02 "Ausgang des Aktorspannungsreglers" SWORD Vltg_PA 1 100 -327.6800 327.6700 ECU_ADDRESS 0xD0000C7C /end MEASUREMENT
/begin MEASUREMENT IVCtl_uCorPI03 "Ausgang des Aktorspannungsreglers" SWORD Vltg_PA 1 100 -327.6800 327.6700 ECU_ADDRESS 0xD0000C7E /end MEASUREMENT
/begin MEASUREMENT IVCtl_uCorPI04 "Ausgang des Aktorspannungsreglers" SWORD Vltg_PA 1 100 -327.6800 327.6700 ECU_ADDRESS 0xD0000C80 /end MEASUREMENT
/begin MEASUREMENT IVCtl_uCorPI05 "Ausgang des Aktorspannungsreglers" SWORD Vltg_PA 1 100 -327.6800 327.6700 ECU_ADDRESS 0xD0000C82 /end MEASUREMENT
/begin MEASUREMENT IVCtl_uCorPIUnLim_mp00 "Unbegrenzter Reglerausgang des PI-Reglers der Aktorspannungsregelung" SWORD Vltg_PA 1 100 -327.6800 327.6700 ECU_ADDRESS 0xC000C294 /end MEASUREMENT
/begin MEASUREMENT IVCtl_uCorPIUnLim_mp01 "Unbegrenzter Reglerausgang des PI-Reglers der Aktorspannungsregelung" SWORD Vltg_PA 1 100 -327.6800 327.6700 ECU_ADDRESS 0xC000C296 /end MEASUREMENT
/begin MEASUREMENT IVCtl_uCorPIUnLim_mp02 "Unbegrenzter Reglerausgang des PI-Reglers der Aktorspannungsregelung" SWORD Vltg_PA 1 100 -327.6800 327.6700 ECU_ADDRESS 0xC000C298 /end MEASUREMENT
/begin MEASUREMENT IVCtl_uCorPIUnLim_mp03 "Unbegrenzter Reglerausgang des PI-Reglers der Aktorspannungsregelung" SWORD Vltg_PA 1 100 -327.6800 327.6700 ECU_ADDRESS 0xC000C29A /end MEASUREMENT
/begin MEASUREMENT IVCtl_uCorPIUnLim_mp04 "Unbegrenzter Reglerausgang des PI-Reglers der Aktorspannungsregelung" SWORD Vltg_PA 1 100 -327.6800 327.6700 ECU_ADDRESS 0xC000C29C /end MEASUREMENT
/begin MEASUREMENT IVCtl_uCorPIUnLim_mp05 "Unbegrenzter Reglerausgang des PI-Reglers der Aktorspannungsregelung" SWORD Vltg_PA 1 100 -327.6800 327.6700 ECU_ADDRESS 0xC000C29E /end MEASUREMENT
/begin MEASUREMENT IVCtl_uCorPreCtl_mp00 "Vorsteuerspannung" SWORD Vltg_PA 1 100 -327.6800 327.6700 ECU_ADDRESS 0xC000C270 /end MEASUREMENT
/begin MEASUREMENT IVCtl_uCorPreCtl_mp01 "Vorsteuerspannung" SWORD Vltg_PA 1 100 -327.6800 327.6700 ECU_ADDRESS 0xC000C272 /end MEASUREMENT
/begin MEASUREMENT IVCtl_uCorPreCtl_mp02 "Vorsteuerspannung" SWORD Vltg_PA 1 100 -327.6800 327.6700 ECU_ADDRESS 0xC000C274 /end MEASUREMENT
/begin MEASUREMENT IVCtl_uCorPreCtl_mp03 "Vorsteuerspannung" SWORD Vltg_PA 1 100 -327.6800 327.6700 ECU_ADDRESS 0xC000C276 /end MEASUREMENT
/begin MEASUREMENT IVCtl_uCorPreCtl_mp04 "Vorsteuerspannung" SWORD Vltg_PA 1 100 -327.6800 327.6700 ECU_ADDRESS 0xC000C278 /end MEASUREMENT
/begin MEASUREMENT IVCtl_uCorPreCtl_mp05 "Vorsteuerspannung" SWORD Vltg_PA 1 100 -327.6800 327.6700 ECU_ADDRESS 0xC000C27A /end MEASUREMENT
/begin MEASUREMENT IVCtl_uDiffUp00 "Eingang des Aktorspannungsreglers" SWORD Vltg_PA 1 100 -327.6800 327.6700 ECU_ADDRESS 0xD0000C84 /end MEASUREMENT
/begin MEASUREMENT IVCtl_uDiffUp01 "Eingang des Aktorspannungsreglers" SWORD Vltg_PA 1 100 -327.6800 327.6700 ECU_ADDRESS 0xD0000C86 /end MEASUREMENT
/begin MEASUREMENT IVCtl_uDiffUp02 "Eingang des Aktorspannungsreglers" SWORD Vltg_PA 1 100 -327.6800 327.6700 ECU_ADDRESS 0xD0000C88 /end MEASUREMENT
/begin MEASUREMENT IVCtl_uDiffUp03 "Eingang des Aktorspannungsreglers" SWORD Vltg_PA 1 100 -327.6800 327.6700 ECU_ADDRESS 0xD0000C8A /end MEASUREMENT
/begin MEASUREMENT IVCtl_uDiffUp04 "Eingang des Aktorspannungsreglers" SWORD Vltg_PA 1 100 -327.6800 327.6700 ECU_ADDRESS 0xD0000C8C /end MEASUREMENT
/begin MEASUREMENT IVCtl_uDiffUp05 "Eingang des Aktorspannungsreglers" SWORD Vltg_PA 1 100 -327.6800 327.6700 ECU_ADDRESS 0xD0000C8E /end MEASUREMENT
/begin MEASUREMENT IVCtl_uUp00 "Spannungssollwert Up-Niveau" SWORD Vltg_PA 1 100 -327.6800 327.6700 ECU_ADDRESS 0xD0000C92 /end MEASUREMENT
/begin MEASUREMENT IVCtl_uUp01 "Spannungssollwert Up-Niveau" SWORD Vltg_PA 1 100 -327.6800 327.6700 ECU_ADDRESS 0xD0000C94 /end MEASUREMENT
/begin MEASUREMENT IVCtl_uUp02 "Spannungssollwert Up-Niveau" SWORD Vltg_PA 1 100 -327.6800 327.6700 ECU_ADDRESS 0xD0000C96 /end MEASUREMENT
/begin MEASUREMENT IVCtl_uUp03 "Spannungssollwert Up-Niveau" SWORD Vltg_PA 1 100 -327.6800 327.6700 ECU_ADDRESS 0xD0000C98 /end MEASUREMENT
/begin MEASUREMENT IVCtl_uUp04 "Spannungssollwert Up-Niveau" SWORD Vltg_PA 1 100 -327.6800 327.6700 ECU_ADDRESS 0xD0000C9A /end MEASUREMENT
/begin MEASUREMENT IVCtl_uUp05 "Spannungssollwert Up-Niveau" SWORD Vltg_PA 1 100 -327.6800 327.6700 ECU_ADDRESS 0xD0000C9C /end MEASUREMENT
/begin MEASUREMENT IVCtl_uUpUnCor_mp00 "Unkorrigierter Spannungssollwert Up-Niveau" SWORD Vltg_PA 1 100 -327.6800 327.6700 ECU_ADDRESS 0xC000C27C /end MEASUREMENT
/begin MEASUREMENT IVCtl_uUpUnCor_mp01 "Unkorrigierter Spannungssollwert Up-Niveau" SWORD Vltg_PA 1 100 -327.6800 327.6700 ECU_ADDRESS 0xC000C27E /end MEASUREMENT
/begin MEASUREMENT IVCtl_uUpUnCor_mp02 "Unkorrigierter Spannungssollwert Up-Niveau" SWORD Vltg_PA 1 100 -327.6800 327.6700 ECU_ADDRESS 0xC000C280 /end MEASUREMENT
/begin MEASUREMENT IVCtl_uUpUnCor_mp03 "Unkorrigierter Spannungssollwert Up-Niveau" SWORD Vltg_PA 1 100 -327.6800 327.6700 ECU_ADDRESS 0xC000C282 /end MEASUREMENT
/begin MEASUREMENT IVCtl_uUpUnCor_mp04 "Unkorrigierter Spannungssollwert Up-Niveau" SWORD Vltg_PA 1 100 -327.6800 327.6700 ECU_ADDRESS 0xC000C284 /end MEASUREMENT
/begin MEASUREMENT IVCtl_uUpUnCor_mp05 "Unkorrigierter Spannungssollwert Up-Niveau" SWORD Vltg_PA 1 100 -327.6800 327.6700 ECU_ADDRESS 0xC000C286 /end MEASUREMENT
/begin MEASUREMENT IVCtl_uUpUnLim_mp00 "Unbegrenzter Spannungssollwert Up-Niveau" SWORD Vltg_PA 1 100 -327.6800 327.6700 ECU_ADDRESS 0xC000C288 /end MEASUREMENT
/begin MEASUREMENT IVCtl_uUpUnLim_mp01 "Unbegrenzter Spannungssollwert Up-Niveau" SWORD Vltg_PA 1 100 -327.6800 327.6700 ECU_ADDRESS 0xC000C28A /end MEASUREMENT
/begin MEASUREMENT IVCtl_uUpUnLim_mp02 "Unbegrenzter Spannungssollwert Up-Niveau" SWORD Vltg_PA 1 100 -327.6800 327.6700 ECU_ADDRESS 0xC000C28C /end MEASUREMENT
/begin MEASUREMENT IVCtl_uUpUnLim_mp03 "Unbegrenzter Spannungssollwert Up-Niveau" SWORD Vltg_PA 1 100 -327.6800 327.6700 ECU_ADDRESS 0xC000C28E /end MEASUREMENT
/begin MEASUREMENT IVCtl_uUpUnLim_mp04 "Unbegrenzter Spannungssollwert Up-Niveau" SWORD Vltg_PA 1 100 -327.6800 327.6700 ECU_ADDRESS 0xC000C290 /end MEASUREMENT
/begin MEASUREMENT IVCtl_uUpUnLim_mp05 "Unbegrenzter Spannungssollwert Up-Niveau" SWORD Vltg_PA 1 100 -327.6800 327.6700 ECU_ADDRESS 0xC000C292 /end MEASUREMENT
/begin MEASUREMENT IVDia_stClctComplInvldCyl_mp00 "Bit des vollständigen Diagnose-Information ist ungültig" UWORD OneToOne 1 100 0.00 65535.00 ECU_ADDRESS 0xC000C2A0 /end MEASUREMENT
/begin MEASUREMENT IVDia_stClctComplInvldCyl_mp01 "Bit des vollständigen Diagnose-Information ist ungültig" UWORD OneToOne 1 100 0.00 65535.00 ECU_ADDRESS 0xC000C2A2 /end MEASUREMENT
/begin MEASUREMENT IVDia_stClctComplInvldCyl_mp02 "Bit des vollständigen Diagnose-Information ist ungültig" UWORD OneToOne 1 100 0.00 65535.00 ECU_ADDRESS 0xC000C2A4 /end MEASUREMENT
/begin MEASUREMENT IVDia_stClctComplInvldCyl_mp03 "Bit des vollständigen Diagnose-Information ist ungültig" UWORD OneToOne 1 100 0.00 65535.00 ECU_ADDRESS 0xC000C2A6 /end MEASUREMENT
/begin MEASUREMENT IVDia_stClctComplInvldCyl_mp04 "Bit des vollständigen Diagnose-Information ist ungültig" UWORD OneToOne 1 100 0.00 65535.00 ECU_ADDRESS 0xC000C2A8 /end MEASUREMENT
/begin MEASUREMENT IVDia_stClctComplInvldCyl_mp05 "Bit des vollständigen Diagnose-Information ist ungültig" UWORD OneToOne 1 100 0.00 65535.00 ECU_ADDRESS 0xC000C2AA /end MEASUREMENT
/begin MEASUREMENT IVDia_stDFCPtt_mp00 "Fehlerart, die in DFC-Patten zugeführt wird" UWORD OneToOne 1 100 0.00 65535.00 ECU_ADDRESS 0xC000C2AC /end MEASUREMENT
/begin MEASUREMENT IVDia_stDFCPtt_mp01 "Fehlerart, die in DFC-Patten zugeführt wird" UWORD OneToOne 1 100 0.00 65535.00 ECU_ADDRESS 0xC000C2AE /end MEASUREMENT
/begin MEASUREMENT IVDia_stDFCPtt_mp02 "Fehlerart, die in DFC-Patten zugeführt wird" UWORD OneToOne 1 100 0.00 65535.00 ECU_ADDRESS 0xC000C2B0 /end MEASUREMENT
/begin MEASUREMENT IVDia_stDFCPtt_mp03 "Fehlerart, die in DFC-Patten zugeführt wird" UWORD OneToOne 1 100 0.00 65535.00 ECU_ADDRESS 0xC000C2B2 /end MEASUREMENT
/begin MEASUREMENT IVDia_stDFCPtt_mp04 "Fehlerart, die in DFC-Patten zugeführt wird" UWORD OneToOne 1 100 0.00 65535.00 ECU_ADDRESS 0xC000C2B4 /end MEASUREMENT
/begin MEASUREMENT IVDia_stDFCPtt_mp05 "Fehlerart, die in DFC-Patten zugeführt wird" UWORD OneToOne 1 100 0.00 65535.00 ECU_ADDRESS 0xC000C2B6 /end MEASUREMENT
/begin MEASUREMENT IVDia_stErrClctChp_mp00 "Versammelte Chip-Fehler" UBYTE OneToOne 1 100 0.00 255.0 ECU_ADDRESS 0xC000C2B8 /end MEASUREMENT
/begin MEASUREMENT IVDia_stErrClctComplCyl_mp00 "Vollständige lowlevel Fehlermeldung für CY33x vorverarbeitet pro Zylinder" UWORD OneToOne 1 100 0.00 65535.00 ECU_ADDRESS 0xC000C2BA /end MEASUREMENT
/begin MEASUREMENT IVDia_stErrClctComplCyl_mp01 "Vollständige lowlevel Fehlermeldung für CY33x vorverarbeitet pro Zylinder" UWORD OneToOne 1 100 0.00 65535.00 ECU_ADDRESS 0xC000C2BC /end MEASUREMENT
/begin MEASUREMENT IVDia_stErrClctComplCyl_mp02 "Vollständige lowlevel Fehlermeldung für CY33x vorverarbeitet pro Zylinder" UWORD OneToOne 1 100 0.00 65535.00 ECU_ADDRESS 0xC000C2BE /end MEASUREMENT
/begin MEASUREMENT IVDia_stErrClctComplCyl_mp03 "Vollständige lowlevel Fehlermeldung für CY33x vorverarbeitet pro Zylinder" UWORD OneToOne 1 100 0.00 65535.00 ECU_ADDRESS 0xC000C2C0 /end MEASUREMENT
/begin MEASUREMENT IVDia_stErrClctComplCyl_mp04 "Vollständige lowlevel Fehlermeldung für CY33x vorverarbeitet pro Zylinder" UWORD OneToOne 1 100 0.00 65535.00 ECU_ADDRESS 0xC000C2C2 /end MEASUREMENT
/begin MEASUREMENT IVDia_stErrClctComplCyl_mp05 "Vollständige lowlevel Fehlermeldung für CY33x vorverarbeitet pro Zylinder" UWORD OneToOne 1 100 0.00 65535.00 ECU_ADDRESS 0xC000C2C4 /end MEASUREMENT
/begin MEASUREMENT IVDia_stErrClctPsIcCyl_mp00 "Messpunkt des Fehlermusters, der sammelt die Fehler aus Diagnoseregister" UWORD OneToOne 1 100 0.00 65535.00 ECU_ADDRESS 0xC000C2C6 /end MEASUREMENT
/begin MEASUREMENT IVDia_stErrClctPsIcCyl_mp01 "Messpunkt des Fehlermusters, der sammelt die Fehler aus Diagnoseregister" UWORD OneToOne 1 100 0.00 65535.00 ECU_ADDRESS 0xC000C2C8 /end MEASUREMENT
/begin MEASUREMENT IVDia_stErrClctPsIcCyl_mp02 "Messpunkt des Fehlermusters, der sammelt die Fehler aus Diagnoseregister" UWORD OneToOne 1 100 0.00 65535.00 ECU_ADDRESS 0xC000C2CA /end MEASUREMENT
/begin MEASUREMENT IVDia_stErrClctPsIcCyl_mp03 "Messpunkt des Fehlermusters, der sammelt die Fehler aus Diagnoseregister" UWORD OneToOne 1 100 0.00 65535.00 ECU_ADDRESS 0xC000C2CC /end MEASUREMENT
/begin MEASUREMENT IVDia_stErrClctPsIcCyl_mp04 "Messpunkt des Fehlermusters, der sammelt die Fehler aus Diagnoseregister" UWORD OneToOne 1 100 0.00 65535.00 ECU_ADDRESS 0xC000C2CE /end MEASUREMENT
/begin MEASUREMENT IVDia_stErrClctPsIcCyl_mp05 "Messpunkt des Fehlermusters, der sammelt die Fehler aus Diagnoseregister" UWORD OneToOne 1 100 0.00 65535.00 ECU_ADDRESS 0xC000C2D0 /end MEASUREMENT
/begin MEASUREMENT IVDia_stErrCyl_mp00 "Zylinderspezifische Diagnoseinformation" UBYTE OneToOne 1 100 0.00 255.0 ECU_ADDRESS 0xC000C2D2 /end MEASUREMENT
/begin MEASUREMENT IVDia_stErrCyl_mp01 "Zylinderspezifische Diagnoseinformation" UBYTE OneToOne 1 100 0.00 255.0 ECU_ADDRESS 0xC000C2D3 /end MEASUREMENT
/begin MEASUREMENT IVDia_stErrCyl_mp02 "Zylinderspezifische Diagnoseinformation" UBYTE OneToOne 1 100 0.00 255.0 ECU_ADDRESS 0xC000C2D4 /end MEASUREMENT
/begin MEASUREMENT IVDia_stErrCyl_mp03 "Zylinderspezifische Diagnoseinformation" UBYTE OneToOne 1 100 0.00 255.0 ECU_ADDRESS 0xC000C2D5 /end MEASUREMENT
/begin MEASUREMENT IVDia_stErrCyl_mp04 "Zylinderspezifische Diagnoseinformation" UBYTE OneToOne 1 100 0.00 255.0 ECU_ADDRESS 0xC000C2D6 /end MEASUREMENT
/begin MEASUREMENT IVDia_stErrCyl_mp05 "Zylinderspezifische Diagnoseinformation" UBYTE OneToOne 1 100 0.00 255.0 ECU_ADDRESS 0xC000C2D7 /end MEASUREMENT
/begin MEASUREMENT IVDia_stPsIcChp00 "Chipspezifisch Diagnose-Information der SPI-Übertragung und SPI Control-Byte" UWORD OneToOne 1 100 0.00 65535.00 ECU_ADDRESS 0xD00015D4 /end MEASUREMENT
/begin MEASUREMENT IVDia_stPsIcCyl00 "Cylinderspezifische Diagnoseinformation aus PsIc Diagnose-Register" UBYTE OneToOne 1 100 0.00 255.0 ECU_ADDRESS 0xD0001EC7 /end MEASUREMENT
/begin MEASUREMENT IVDia_stPsIcCyl01 "Cylinderspezifische Diagnoseinformation aus PsIc Diagnose-Register" UBYTE OneToOne 1 100 0.00 255.0 ECU_ADDRESS 0xD0001EC8 /end MEASUREMENT
/begin MEASUREMENT IVDia_stPsIcCyl02 "Cylinderspezifische Diagnoseinformation aus PsIc Diagnose-Register" UBYTE OneToOne 1 100 0.00 255.0 ECU_ADDRESS 0xD0001EC9 /end MEASUREMENT
/begin MEASUREMENT IVDia_stPsIcCyl03 "Cylinderspezifische Diagnoseinformation aus PsIc Diagnose-Register" UBYTE OneToOne 1 100 0.00 255.0 ECU_ADDRESS 0xD0001ECA /end MEASUREMENT
/begin MEASUREMENT IVDia_stPsIcCyl04 "Cylinderspezifische Diagnoseinformation aus PsIc Diagnose-Register" UBYTE OneToOne 1 100 0.00 255.0 ECU_ADDRESS 0xD0001ECB /end MEASUREMENT
/begin MEASUREMENT IVDia_stPsIcCyl05 "Cylinderspezifische Diagnoseinformation aus PsIc Diagnose-Register" UBYTE OneToOne 1 100 0.00 255.0 ECU_ADDRESS 0xD0001ECC /end MEASUREMENT
/begin MEASUREMENT IVDia_stRlsErrRecgCompl_mp00 "Freegabe der vollständige Fehlererkannung" UWORD OneToOne 1 100 0.00 65535.00 ECU_ADDRESS 0xC000C2D8 /end MEASUREMENT
/begin MEASUREMENT IVDia_stRlsErrRecgCompl_mp01 "Freegabe der vollständige Fehlererkannung" UWORD OneToOne 1 100 0.00 65535.00 ECU_ADDRESS 0xC000C2DA /end MEASUREMENT
/begin MEASUREMENT IVDia_stRlsErrRecgCompl_mp02 "Freegabe der vollständige Fehlererkannung" UWORD OneToOne 1 100 0.00 65535.00 ECU_ADDRESS 0xC000C2DC /end MEASUREMENT
/begin MEASUREMENT IVDia_stRlsErrRecgCompl_mp03 "Freegabe der vollständige Fehlererkannung" UWORD OneToOne 1 100 0.00 65535.00 ECU_ADDRESS 0xC000C2DE /end MEASUREMENT
/begin MEASUREMENT IVDia_stRlsErrRecgCompl_mp04 "Freegabe der vollständige Fehlererkannung" UWORD OneToOne 1 100 0.00 65535.00 ECU_ADDRESS 0xC000C2E0 /end MEASUREMENT
/begin MEASUREMENT IVDia_stRlsErrRecgCompl_mp05 "Freegabe der vollständige Fehlererkannung" UWORD OneToOne 1 100 0.00 65535.00 ECU_ADDRESS 0xC000C2E2 /end MEASUREMENT
/begin MEASUREMENT IVDia_stRlsErrRecgPsIc_mp00 "Freegabe der Fehlererkannung, die nur von PsIc-Diagnoseinformation abhängig ist." UWORD OneToOne 1 100 0.00 65535.00 ECU_ADDRESS 0xC000C2E4 /end MEASUREMENT
/begin MEASUREMENT IVDia_stRlsErrRecgPsIc_mp01 "Freegabe der Fehlererkannung, die nur von PsIc-Diagnoseinformation abhängig ist." UWORD OneToOne 1 100 0.00 65535.00 ECU_ADDRESS 0xC000C2E6 /end MEASUREMENT
/begin MEASUREMENT IVDia_stRlsErrRecgPsIc_mp02 "Freegabe der Fehlererkannung, die nur von PsIc-Diagnoseinformation abhängig ist." UWORD OneToOne 1 100 0.00 65535.00 ECU_ADDRESS 0xC000C2E8 /end MEASUREMENT
/begin MEASUREMENT IVDia_stRlsErrRecgPsIc_mp03 "Freegabe der Fehlererkannung, die nur von PsIc-Diagnoseinformation abhängig ist." UWORD OneToOne 1 100 0.00 65535.00 ECU_ADDRESS 0xC000C2EA /end MEASUREMENT
/begin MEASUREMENT IVDia_stRlsErrRecgPsIc_mp04 "Freegabe der Fehlererkannung, die nur von PsIc-Diagnoseinformation abhängig ist." UWORD OneToOne 1 100 0.00 65535.00 ECU_ADDRESS 0xC000C2EC /end MEASUREMENT
/begin MEASUREMENT IVDia_stRlsErrRecgPsIc_mp05 "Freegabe der Fehlererkannung, die nur von PsIc-Diagnoseinformation abhängig ist." UWORD OneToOne 1 100 0.00 65535.00 ECU_ADDRESS 0xC000C2EE /end MEASUREMENT
/begin MEASUREMENT IVDia_stUPlausBnk00 "Bankspezifische Spannungsplausibilität-Statusmessages" UBYTE OneToOne 1 100 0.00 255.0 ECU_ADDRESS 0xD0001ED8 /end MEASUREMENT
/begin MEASUREMENT IVDia_stUPlausBnk01 "Bankspezifische Spannungsplausibilität-Statusmessages" UBYTE OneToOne 1 100 0.00 255.0 ECU_ADDRESS 0xD0001ED9 /end MEASUREMENT
/begin MEASUREMENT IVDia_stUPlausCyl00 "Zylinderspezifische Spannungsplausibilität-Statusmessage der Aktorspannungsmessung" UBYTE OneToOne 1 100 0.00 255.0 ECU_ADDRESS 0xD0001EDA /end MEASUREMENT
/begin MEASUREMENT IVDia_stUPlausCyl01 "Zylinderspezifische Spannungsplausibilität-Statusmessage der Aktorspannungsmessung" UBYTE OneToOne 1 100 0.00 255.0 ECU_ADDRESS 0xD0001EDB /end MEASUREMENT
/begin MEASUREMENT IVDia_stUPlausCyl02 "Zylinderspezifische Spannungsplausibilität-Statusmessage der Aktorspannungsmessung" UBYTE OneToOne 1 100 0.00 255.0 ECU_ADDRESS 0xD0001EDC /end MEASUREMENT
/begin MEASUREMENT IVDia_stUPlausCyl03 "Zylinderspezifische Spannungsplausibilität-Statusmessage der Aktorspannungsmessung" UBYTE OneToOne 1 100 0.00 255.0 ECU_ADDRESS 0xD0001EDD /end MEASUREMENT
/begin MEASUREMENT IVDia_stUPlausCyl04 "Zylinderspezifische Spannungsplausibilität-Statusmessage der Aktorspannungsmessung" UBYTE OneToOne 1 100 0.00 255.0 ECU_ADDRESS 0xD0001EDE /end MEASUREMENT
/begin MEASUREMENT IVDia_stUPlausCyl05 "Zylinderspezifische Spannungsplausibilität-Statusmessage der Aktorspannungsmessung" UBYTE OneToOne 1 100 0.00 255.0 ECU_ADDRESS 0xD0001EDF /end MEASUREMENT
/begin MEASUREMENT IVDia_stUTunDet00 "" UBYTE OneToOne 1 100 0.00 255.0 ECU_ADDRESS 0xD0001EE0 /end MEASUREMENT
/begin MEASUREMENT IVDia_stUTunDet01 "" UBYTE OneToOne 1 100 0.00 255.0 ECU_ADDRESS 0xD0001EE1 /end MEASUREMENT
/begin MEASUREMENT IVDia_stUTunDet02 "" UBYTE OneToOne 1 100 0.00 255.0 ECU_ADDRESS 0xD0001EE2 /end MEASUREMENT
/begin MEASUREMENT IVDia_stUTunDet03 "" UBYTE OneToOne 1 100 0.00 255.0 ECU_ADDRESS 0xD0001EE3 /end MEASUREMENT
/begin MEASUREMENT IVDia_stUTunDet04 "" UBYTE OneToOne 1 100 0.00 255.0 ECU_ADDRESS 0xD0001EE4 /end MEASUREMENT
/begin MEASUREMENT IVDia_stUTunDet05 "" UBYTE OneToOne 1 100 0.00 255.0 ECU_ADDRESS 0xD0001EE5 /end MEASUREMENT
/begin MEASUREMENT IVDia_uThres_mp00 "Schwelle der Plausibilitätprüfung" SWORD Vltg_PA 1 100 -327.6800 327.6700 ECU_ADDRESS 0xC000C2F0 /end MEASUREMENT
/begin MEASUREMENT IVDia_uThres_mp01 "Schwelle der Plausibilitätprüfung" SWORD Vltg_PA 1 100 -327.6800 327.6700 ECU_ADDRESS 0xC000C2F2 /end MEASUREMENT
/begin MEASUREMENT IVDia_uThres_mp02 "Schwelle der Plausibilitätprüfung" SWORD Vltg_PA 1 100 -327.6800 327.6700 ECU_ADDRESS 0xC000C2F4 /end MEASUREMENT
/begin MEASUREMENT IVPlaus_nCyl00 "zylinderselektive Drehzahl" SWORD EngN 1 100 -16384.00 16383.50 ECU_ADDRESS 0xD0000CA6 /end MEASUREMENT
/begin MEASUREMENT IVPlaus_nCyl01 "zylinderselektive Drehzahl" SWORD EngN 1 100 -16384.00 16383.50 ECU_ADDRESS 0xD0000CA8 /end MEASUREMENT
/begin MEASUREMENT IVPlaus_nCyl02 "zylinderselektive Drehzahl" SWORD EngN 1 100 -16384.00 16383.50 ECU_ADDRESS 0xD0000CAA /end MEASUREMENT
/begin MEASUREMENT IVPlaus_nCyl03 "zylinderselektive Drehzahl" SWORD EngN 1 100 -16384.00 16383.50 ECU_ADDRESS 0xD0000CAC /end MEASUREMENT
/begin MEASUREMENT IVPlaus_nCyl04 "zylinderselektive Drehzahl" SWORD EngN 1 100 -16384.00 16383.50 ECU_ADDRESS 0xD0000CAE /end MEASUREMENT
/begin MEASUREMENT IVPlaus_nCyl05 "zylinderselektive Drehzahl" SWORD EngN 1 100 -16384.00 16383.50 ECU_ADDRESS 0xD0000CB0 /end MEASUREMENT
/begin MEASUREMENT IVPlaus_qFBCCyl00 "zylinderselektive Mengenkorrektur des Laufruhereglers" SWORD InjMass 1 100 -327.6800 327.6700 ECU_ADDRESS 0xD0000CD2 /end MEASUREMENT
/begin MEASUREMENT IVPlaus_qFBCCyl01 "zylinderselektive Mengenkorrektur des Laufruhereglers" SWORD InjMass 1 100 -327.6800 327.6700 ECU_ADDRESS 0xD0000CD4 /end MEASUREMENT
/begin MEASUREMENT IVPlaus_qFBCCyl02 "zylinderselektive Mengenkorrektur des Laufruhereglers" SWORD InjMass 1 100 -327.6800 327.6700 ECU_ADDRESS 0xD0000CD6 /end MEASUREMENT
/begin MEASUREMENT IVPlaus_qFBCCyl03 "zylinderselektive Mengenkorrektur des Laufruhereglers" SWORD InjMass 1 100 -327.6800 327.6700 ECU_ADDRESS 0xD0000CD8 /end MEASUREMENT
/begin MEASUREMENT IVPlaus_qFBCCyl04 "zylinderselektive Mengenkorrektur des Laufruhereglers" SWORD InjMass 1 100 -327.6800 327.6700 ECU_ADDRESS 0xD0000CDA /end MEASUREMENT
/begin MEASUREMENT IVPlaus_qFBCCyl05 "zylinderselektive Mengenkorrektur des Laufruhereglers" SWORD InjMass 1 100 -327.6800 327.6700 ECU_ADDRESS 0xD0000CDC /end MEASUREMENT
/begin MEASUREMENT IVPlaus_tiPreTDCComprTst00 "Array der gemessenen Zeiten zwischen den Winkeln vor TDC" SLONG OneToOne_us 1 100 -2147483648.00 2147483647.00 FORMAT "%13.2" ECU_ADDRESS 0xD0002EEC /end MEASUREMENT
/begin MEASUREMENT IVPlaus_tiPreTDCComprTst01 "Array der gemessenen Zeiten zwischen den Winkeln vor TDC" SLONG OneToOne_us 1 100 -2147483648.00 2147483647.00 FORMAT "%13.2" ECU_ADDRESS 0xD0002EF0 /end MEASUREMENT
/begin MEASUREMENT IVPlaus_tiPreTDCComprTst02 "Array der gemessenen Zeiten zwischen den Winkeln vor TDC" SLONG OneToOne_us 1 100 -2147483648.00 2147483647.00 FORMAT "%13.2" ECU_ADDRESS 0xD0002EF4 /end MEASUREMENT
/begin MEASUREMENT IVPlaus_tiPreTDCComprTst03 "Array der gemessenen Zeiten zwischen den Winkeln vor TDC" SLONG OneToOne_us 1 100 -2147483648.00 2147483647.00 FORMAT "%13.2" ECU_ADDRESS 0xD0002EF8 /end MEASUREMENT
/begin MEASUREMENT IVPlaus_tiPreTDCComprTst04 "Array der gemessenen Zeiten zwischen den Winkeln vor TDC" SLONG OneToOne_us 1 100 -2147483648.00 2147483647.00 FORMAT "%13.2" ECU_ADDRESS 0xD0002EFC /end MEASUREMENT
/begin MEASUREMENT IVPlaus_tiPreTDCComprTst05 "Array der gemessenen Zeiten zwischen den Winkeln vor TDC" SLONG OneToOne_us 1 100 -2147483648.00 2147483647.00 FORMAT "%13.2" ECU_ADDRESS 0xD0002F00 /end MEASUREMENT
/begin MEASUREMENT IVPlaus_tiPstTDCComprTst00 "Array von gemessenen Zeiten zwischen den programmierten Winkeln nach TDC" SLONG OneToOne_us 1 100 -2147483648.00 2147483647.00 FORMAT "%13.2" ECU_ADDRESS 0xD0002F04 /end MEASUREMENT
/begin MEASUREMENT IVPlaus_tiPstTDCComprTst01 "Array von gemessenen Zeiten zwischen den programmierten Winkeln nach TDC" SLONG OneToOne_us 1 100 -2147483648.00 2147483647.00 FORMAT "%13.2" ECU_ADDRESS 0xD0002F08 /end MEASUREMENT
/begin MEASUREMENT IVPlaus_tiPstTDCComprTst02 "Array von gemessenen Zeiten zwischen den programmierten Winkeln nach TDC" SLONG OneToOne_us 1 100 -2147483648.00 2147483647.00 FORMAT "%13.2" ECU_ADDRESS 0xD0002F0C /end MEASUREMENT
/begin MEASUREMENT IVPlaus_tiPstTDCComprTst03 "Array von gemessenen Zeiten zwischen den programmierten Winkeln nach TDC" SLONG OneToOne_us 1 100 -2147483648.00 2147483647.00 FORMAT "%13.2" ECU_ADDRESS 0xD0002F10 /end MEASUREMENT
/begin MEASUREMENT IVPlaus_tiPstTDCComprTst04 "Array von gemessenen Zeiten zwischen den programmierten Winkeln nach TDC" SLONG OneToOne_us 1 100 -2147483648.00 2147483647.00 FORMAT "%13.2" ECU_ADDRESS 0xD0002F14 /end MEASUREMENT
/begin MEASUREMENT IVPlaus_tiPstTDCComprTst05 "Array von gemessenen Zeiten zwischen den programmierten Winkeln nach TDC" SLONG OneToOne_us 1 100 -2147483648.00 2147483647.00 FORMAT "%13.2" ECU_ADDRESS 0xD0002F18 /end MEASUREMENT
/begin MEASUREMENT IVPSIC_stIntegAdjRet00 "Rückgeben Status des Integratorabgleichs" UBYTE OneToOne 1 100 0.00 255.0 ECU_ADDRESS 0xD0001EE6 /end MEASUREMENT
/begin MEASUREMENT IVPSIC_stIntegAdjVld00 "Gültigstatus des Integratorabgleichs" UBYTE OneToOne 1 100 0.00 255.0 ECU_ADDRESS 0xD0001EE8 /end MEASUREMENT
/begin MEASUREMENT IVPSIC_tiIntegAdj00 "Zeitstempel des Integratorabgleichs" ULONG Time_PzoMeas 1 100 0.00 234505214.307 FORMAT "%13.3" ECU_ADDRESS 0xD00031EC /end MEASUREMENT
/begin MEASUREMENT IVPSIC_tiIntegRC00 "RC Zeitkonstant für Ladungsmessung" SWORD InjTime_us 1 100 -13107.20 5000.00 ECU_ADDRESS 0xD0000C9E /end MEASUREMENT
/begin MEASUREMENT IVPSIC_uIntegOfs00 "Offset-Spannung des Integrators" SWORD Volt 1 100 -6553.600 6553.400 ECU_ADDRESS 0xD0000CA0 /end MEASUREMENT
/begin MEASUREMENT IVPSIC_uIntegWrkPnt00 "Arbeitpunktspannung des Integrators" SWORD Volt 1 100 -6553.600 6553.400 ECU_ADDRESS 0xD0000CA2 /end MEASUREMENT
/begin MEASUREMENT IVPSIC_uRawIntegClb_mp00 "Rohwerte der Eichspannung des Integrators" SWORD Volt 1 100 -6553.600 6553.400 ECU_ADDRESS 0xC000C2F6 /end MEASUREMENT
/begin MEASUREMENT IVPSIC_uRawIntegWrkPnt_mp00 "Rohwerte des Arbeitspunkt des Integrators" SWORD Volt 1 100 -6553.600 6553.400 ECU_ADDRESS 0xC000C2F8 /end MEASUREMENT
/begin MEASUREMENT IVPSIC_uRawIntegZr_mp00 "Rohwerte des Nullstromniveau des Integrators" SWORD Volt 1 100 -6553.600 6553.400 ECU_ADDRESS 0xC000C2FA /end MEASUREMENT
/begin MEASUREMENT IVPSply_ctIntrBufMeas00 "Anzahl Interrups des gemessenen Einspritztyps zwischen Start und Auswertung der Bufferspannungsmessung" UBYTE OneToOne 1 100 0.00 255.0 ECU_ADDRESS 0xD0001EE9 /end MEASUREMENT
/begin MEASUREMENT IVPSply_ctIntrBufMeas01 "Anzahl Interrups des gemessenen Einspritztyps zwischen Start und Auswertung der Bufferspannungsmessung" UBYTE OneToOne 1 100 0.00 255.0 ECU_ADDRESS 0xD0001EEA /end MEASUREMENT
/begin MEASUREMENT IVPSply_ctIntrBufMeas02 "Anzahl Interrups des gemessenen Einspritztyps zwischen Start und Auswertung der Bufferspannungsmessung" UBYTE OneToOne 1 100 0.00 255.0 ECU_ADDRESS 0xD0001EEB /end MEASUREMENT
/begin MEASUREMENT IVPSply_ctIntrBufMeas03 "Anzahl Interrups des gemessenen Einspritztyps zwischen Start und Auswertung der Bufferspannungsmessung" UBYTE OneToOne 1 100 0.00 255.0 ECU_ADDRESS 0xD0001EEC /end MEASUREMENT
/begin MEASUREMENT IVPSply_ctIntrBufMeas04 "Anzahl Interrups des gemessenen Einspritztyps zwischen Start und Auswertung der Bufferspannungsmessung" UBYTE OneToOne 1 100 0.00 255.0 ECU_ADDRESS 0xD0001EED /end MEASUREMENT
/begin MEASUREMENT IVPSply_ctIntrBufMeas05 "Anzahl Interrups des gemessenen Einspritztyps zwischen Start und Auswertung der Bufferspannungsmessung" UBYTE OneToOne 1 100 0.00 255.0 ECU_ADDRESS 0xD0001EEE /end MEASUREMENT
/begin MEASUREMENT IVPSply_stGetBufVltg00 "Status der Bufferspannungsmessung" UBYTE OneToOne 1 100 0.00 255.0 ECU_ADDRESS 0xD0001EF1 /end MEASUREMENT
/begin MEASUREMENT IVPSply_stGetBufVltg01 "Status der Bufferspannungsmessung" UBYTE OneToOne 1 100 0.00 255.0 ECU_ADDRESS 0xD0001EF2 /end MEASUREMENT
/begin MEASUREMENT IVPSply_stGetBufVltg02 "Status der Bufferspannungsmessung" UBYTE OneToOne 1 100 0.00 255.0 ECU_ADDRESS 0xD0001EF3 /end MEASUREMENT
/begin MEASUREMENT IVPSply_stGetBufVltg03 "Status der Bufferspannungsmessung" UBYTE OneToOne 1 100 0.00 255.0 ECU_ADDRESS 0xD0001EF4 /end MEASUREMENT
/begin MEASUREMENT IVPSply_stGetBufVltg04 "Status der Bufferspannungsmessung" UBYTE OneToOne 1 100 0.00 255.0 ECU_ADDRESS 0xD0001EF5 /end MEASUREMENT
/begin MEASUREMENT IVPSply_stGetBufVltg05 "Status der Bufferspannungsmessung" UBYTE OneToOne 1 100 0.00 255.0 ECU_ADDRESS 0xD0001EF6 /end MEASUREMENT
/begin MEASUREMENT IVPSply_stUBuf00 "Bufferspannungs-Status" UBYTE OneToOne 1 100 0.00 255.0 ECU_ADDRESS 0xD0001EF7 /end MEASUREMENT
/begin MEASUREMENT IVPSply_tiBufMeasCurr00 "Zeitstempel der aktuellen Bufferspannungsmessung" ULONG Time_PzoMeas 1 100 0.00 234505214.307 FORMAT "%13.3" ECU_ADDRESS 0xD00031F0 /end MEASUREMENT
/begin MEASUREMENT IVPSply_uBuf00 "Bufferspannung" SWORD Vltg_PA 1 100 -327.6800 327.6700 ECU_ADDRESS 0xD0000CA4 /end MEASUREMENT
/begin MEASUREMENT Layer_stInfoEnv00 "" UBYTE OneToOne 1 100 0.00 255.0 ECU_ADDRESS 0xD0001FA9 /end MEASUREMENT
/begin MEASUREMENT Layer_stInfoEnv01 "" UBYTE OneToOne 1 100 0.00 255.0 ECU_ADDRESS 0xD0001FAA /end MEASUREMENT
/begin MEASUREMENT Layer_stInfoEnv02 "" UBYTE OneToOne 1 100 0.00 255.0 ECU_ADDRESS 0xD0001FAB /end MEASUREMENT
/begin MEASUREMENT Layer_stInfoEnv03 "" UBYTE OneToOne 1 100 0.00 255.0 ECU_ADDRESS 0xD0001FAC /end MEASUREMENT
/begin MEASUREMENT Leminfo00 "Infospeicher für LEM" UBYTE Def_dez_ub_q1 1 100 0.00 255. FORMAT "%3.0" ECU_ADDRESS 0xC000B645 /end MEASUREMENT
/begin MEASUREMENT Leminfo01 "Infospeicher für LEM" UBYTE Def_dez_ub_q1 1 100 0.00 255. FORMAT "%3.0" ECU_ADDRESS 0xC000B646 /end MEASUREMENT
/begin MEASUREMENT Leminfo02 "Infospeicher für LEM" UBYTE Def_dez_ub_q1 1 100 0.00 255. FORMAT "%3.0" ECU_ADDRESS 0xC000B647 /end MEASUREMENT
/begin MEASUREMENT Leminfo03 "Infospeicher für LEM" UBYTE Def_dez_ub_q1 1 100 0.00 255. FORMAT "%3.0" ECU_ADDRESS 0xC000B648 /end MEASUREMENT
/begin MEASUREMENT Leminfo04 "Infospeicher für LEM" UBYTE Def_dez_ub_q1 1 100 0.00 255. FORMAT "%3.0" ECU_ADDRESS 0xC000B649 /end MEASUREMENT
/begin MEASUREMENT Leminfo05 "Infospeicher für LEM" UBYTE Def_dez_ub_q1 1 100 0.00 255. FORMAT "%3.0" ECU_ADDRESS 0xC000B64A /end MEASUREMENT
/begin MEASUREMENT Leminfo06 "Infospeicher für LEM" UBYTE Def_dez_ub_q1 1 100 0.00 255. FORMAT "%3.0" ECU_ADDRESS 0xC000B64B /end MEASUREMENT
/begin MEASUREMENT Leminfo07 "Infospeicher für LEM" UBYTE Def_dez_ub_q1 1 100 0.00 255. FORMAT "%3.0" ECU_ADDRESS 0xC000B64C /end MEASUREMENT
/begin MEASUREMENT Leminfo08 "Infospeicher für LEM" UBYTE Def_dez_ub_q1 1 100 0.00 255. FORMAT "%3.0" ECU_ADDRESS 0xC000B64D /end MEASUREMENT
/begin MEASUREMENT Leminfo09 "Infospeicher für LEM" UBYTE Def_dez_ub_q1 1 100 0.00 255. FORMAT "%3.0" ECU_ADDRESS 0xC000B64E /end MEASUREMENT
/begin MEASUREMENT Leminfo10 "Infospeicher für LEM" UBYTE Def_dez_ub_q1 1 100 0.00 255. FORMAT "%3.0" ECU_ADDRESS 0xC000B64F /end MEASUREMENT
/begin MEASUREMENT Leminfo11 "Infospeicher für LEM" UBYTE Def_dez_ub_q1 1 100 0.00 255. FORMAT "%3.0" ECU_ADDRESS 0xC000B650 /end MEASUREMENT
/begin MEASUREMENT Leminfo12 "Infospeicher für LEM" UBYTE Def_dez_ub_q1 1 100 0.00 255. FORMAT "%3.0" ECU_ADDRESS 0xC000B651 /end MEASUREMENT
/begin MEASUREMENT Leminfo13 "Infospeicher für LEM" UBYTE Def_dez_ub_q1 1 100 0.00 255. FORMAT "%3.0" ECU_ADDRESS 0xC000B652 /end MEASUREMENT
/begin MEASUREMENT Leminfo14 "Infospeicher für LEM" UBYTE Def_dez_ub_q1 1 100 0.00 255. FORMAT "%3.0" ECU_ADDRESS 0xC000B653 /end MEASUREMENT
/begin MEASUREMENT Leminfo15 "Infospeicher für LEM" UBYTE Def_dez_ub_q1 1 100 0.00 255. FORMAT "%3.0" ECU_ADDRESS 0xC000B654 /end MEASUREMENT
/begin MEASUREMENT Leminfo16 "Infospeicher für LEM" UBYTE Def_dez_ub_q1 1 100 0.00 255. FORMAT "%3.0" ECU_ADDRESS 0xC000B655 /end MEASUREMENT
/begin MEASUREMENT Leminfo17 "Infospeicher für LEM" UBYTE Def_dez_ub_q1 1 100 0.00 255. FORMAT "%3.0" ECU_ADDRESS 0xC000B656 /end MEASUREMENT
/begin MEASUREMENT Leminfo18 "Infospeicher für LEM" UBYTE Def_dez_ub_q1 1 100 0.00 255. FORMAT "%3.0" ECU_ADDRESS 0xC000B657 /end MEASUREMENT
/begin MEASUREMENT Leminfo19 "Infospeicher für LEM" UBYTE Def_dez_ub_q1 1 100 0.00 255. FORMAT "%3.0" ECU_ADDRESS 0xC000B658 /end MEASUREMENT
/begin MEASUREMENT Leminfo20 "Infospeicher für LEM" UBYTE Def_dez_ub_q1 1 100 0.00 255. FORMAT "%3.0" ECU_ADDRESS 0xC000B659 /end MEASUREMENT
/begin MEASUREMENT Leminfo21 "Infospeicher für LEM" UBYTE Def_dez_ub_q1 1 100 0.00 255. FORMAT "%3.0" ECU_ADDRESS 0xC000B65A /end MEASUREMENT
/begin MEASUREMENT Leminfo22 "Infospeicher für LEM" UBYTE Def_dez_ub_q1 1 100 0.00 255. FORMAT "%3.0" ECU_ADDRESS 0xC000B65B /end MEASUREMENT
/begin MEASUREMENT Leminfo23 "Infospeicher für LEM" UBYTE Def_dez_ub_q1 1 100 0.00 255. FORMAT "%3.0" ECU_ADDRESS 0xC000B65C /end MEASUREMENT
/begin MEASUREMENT Leminfo24 "Infospeicher für LEM" UBYTE Def_dez_ub_q1 1 100 0.00 255. FORMAT "%3.0" ECU_ADDRESS 0xC000B65D /end MEASUREMENT
/begin MEASUREMENT Leminfo25 "Infospeicher für LEM" UBYTE Def_dez_ub_q1 1 100 0.00 255. FORMAT "%3.0" ECU_ADDRESS 0xC000B65E /end MEASUREMENT
/begin MEASUREMENT Leminfo26 "Infospeicher für LEM" UBYTE Def_dez_ub_q1 1 100 0.00 255. FORMAT "%3.0" ECU_ADDRESS 0xC000B65F /end MEASUREMENT
/begin MEASUREMENT Leminfo27 "Infospeicher für LEM" UBYTE Def_dez_ub_q1 1 100 0.00 255. FORMAT "%3.0" ECU_ADDRESS 0xC000B660 /end MEASUREMENT
/begin MEASUREMENT Leminfo28 "Infospeicher für LEM" UBYTE Def_dez_ub_q1 1 100 0.00 255. FORMAT "%3.0" ECU_ADDRESS 0xC000B661 /end MEASUREMENT
/begin MEASUREMENT Leminfo29 "Infospeicher für LEM" UBYTE Def_dez_ub_q1 1 100 0.00 255. FORMAT "%3.0" ECU_ADDRESS 0xC000B662 /end MEASUREMENT
/begin MEASUREMENT Leminfo30 "Infospeicher für LEM" UBYTE Def_dez_ub_q1 1 100 0.00 255. FORMAT "%3.0" ECU_ADDRESS 0xC000B663 /end MEASUREMENT
/begin MEASUREMENT Leminfo31 "Infospeicher für LEM" UBYTE Def_dez_ub_q1 1 100 0.00 255. FORMAT "%3.0" ECU_ADDRESS 0xC000B664 /end MEASUREMENT
/begin MEASUREMENT Leminfo32 "Infospeicher für LEM" UBYTE Def_dez_ub_q1 1 100 0.00 255. FORMAT "%3.0" ECU_ADDRESS 0xC000B665 /end MEASUREMENT
/begin MEASUREMENT Leminfo33 "Infospeicher für LEM" UBYTE Def_dez_ub_q1 1 100 0.00 255. FORMAT "%3.0" ECU_ADDRESS 0xC000B666 /end MEASUREMENT
/begin MEASUREMENT Leminfo34 "Infospeicher für LEM" UBYTE Def_dez_ub_q1 1 100 0.00 255. FORMAT "%3.0" ECU_ADDRESS 0xC000B667 /end MEASUREMENT
/begin MEASUREMENT Leminfo35 "Infospeicher für LEM" UBYTE Def_dez_ub_q1 1 100 0.00 255. FORMAT "%3.0" ECU_ADDRESS 0xC000B668 /end MEASUREMENT
/begin MEASUREMENT Leminfo36 "Infospeicher für LEM" UBYTE Def_dez_ub_q1 1 100 0.00 255. FORMAT "%3.0" ECU_ADDRESS 0xC000B669 /end MEASUREMENT
/begin MEASUREMENT Leminfo37 "Infospeicher für LEM" UBYTE Def_dez_ub_q1 1 100 0.00 255. FORMAT "%3.0" ECU_ADDRESS 0xC000B66A /end MEASUREMENT
/begin MEASUREMENT Leminfo38 "Infospeicher für LEM" UBYTE Def_dez_ub_q1 1 100 0.00 255. FORMAT "%3.0" ECU_ADDRESS 0xC000B66B /end MEASUREMENT
/begin MEASUREMENT Leminfo39 "Infospeicher für LEM" UBYTE Def_dez_ub_q1 1 100 0.00 255. FORMAT "%3.0" ECU_ADDRESS 0xC000B66C /end MEASUREMENT
/begin MEASUREMENT Lin_Ibsl_buffer_mp00 "" UBYTE OneToOne 1 100 0.00 255.0 ECU_ADDRESS 0xC000C31C /end MEASUREMENT
/begin MEASUREMENT Lin_Ibsl_buffer_mp01 "" UBYTE OneToOne 1 100 0.00 255.0 ECU_ADDRESS 0xC000C31D /end MEASUREMENT
/begin MEASUREMENT Lin_Ibsl_buffer_mp02 "" UBYTE OneToOne 1 100 0.00 255.0 ECU_ADDRESS 0xC000C31E /end MEASUREMENT
/begin MEASUREMENT Lin_Ibsl_buffer_mp03 "" UBYTE OneToOne 1 100 0.00 255.0 ECU_ADDRESS 0xC000C31F /end MEASUREMENT
/begin MEASUREMENT Lin_Ibsl_buffer_mp04 "" UBYTE OneToOne 1 100 0.00 255.0 ECU_ADDRESS 0xC000C320 /end MEASUREMENT
/begin MEASUREMENT Lin_Ibsl_buffer_mp05 "" UBYTE OneToOne 1 100 0.00 255.0 ECU_ADDRESS 0xC000C321 /end MEASUREMENT
/begin MEASUREMENT Lin_Ibsl_buffer_mp06 "" UBYTE OneToOne 1 100 0.00 255.0 ECU_ADDRESS 0xC000C322 /end MEASUREMENT
/begin MEASUREMENT Lin_Ibsl_buffer_mp07 "" UBYTE OneToOne 1 100 0.00 255.0 ECU_ADDRESS 0xC000C323 /end MEASUREMENT
/begin MEASUREMENT LSU_ctHtCoup00 "Anzahl Aktivierungen Diagnose Heizereinkopplung LSU" UWORD OneToOne 1 100 0.00 65535.00 ECU_ADDRESS 0xD00015E2 /end MEASUREMENT
/begin MEASUREMENT LSU_d2rO2Eval_mp00 "Maximum des Auswertungsfilterausgangs wird gespeichert" SWORD O2 1 100 -0.3276800 0.3276700 ECU_ADDRESS 0xC000C340 /end MEASUREMENT
/begin MEASUREMENT LSU_d2rO2_mp00 "Ausgewerteter Filtereingang wird gespeichert" SWORD O2 1 100 -0.3276800 0.3276700 ECU_ADDRESS 0xC000C342 /end MEASUREMENT
/begin MEASUREMENT LSU_dcycDT1_mp00 "Messpunkt zum Speichern des Pufferwerts des DT1-Ergebnisses" SWORD DtyCyc 1 100 -327.6800 327.6700 ECU_ADDRESS 0xC000C34C /end MEASUREMENT
/begin MEASUREMENT LSU_dcycHt00 "Aus Steuerungsmodul gesetzter Wert" SWORD DtyCyc 1 100 -327.6800 327.6700 ECU_ADDRESS 0xD0001068 /end MEASUREMENT
/begin MEASUREMENT LSU_dcycHtCor00 "Korrigierter Sollwert für Endstufe" SWORD DtyCyc 1 100 -327.6800 327.6700 ECU_ADDRESS 0xD000105E /end MEASUREMENT
/begin MEASUREMENT LSU_dcycHtCoupStp100 "Heizertastverhältnis LSU (erste Datenerfassung in Diagnose Heizereinkopplung)" SWORD DtyCyc 1 100 -327.6800 327.6700 ECU_ADDRESS 0xD0001060 /end MEASUREMENT
/begin MEASUREMENT LSU_dcycHtCoupStp200 "Heizertastverhältnis LSU (zweite Datenerfassung in Diagnose Heizereinkopplung)" SWORD DtyCyc 1 100 -327.6800 327.6700 ECU_ADDRESS 0xD0001062 /end MEASUREMENT
/begin MEASUREMENT LSU_dcycHtStrt00 "Startup-Wert des Heizertastverhältnisses" SWORD DtyCyc 1 100 -327.6800 327.6700 ECU_ADDRESS 0xD0001066 /end MEASUREMENT
/begin MEASUREMENT LSU_dcycI_mp00 "Aktualisierung des Tastverhältnisses aus dem I-Anteil" SWORD DtyCyc 1 100 -327.6800 327.6700 ECU_ADDRESS 0xC000C34E /end MEASUREMENT
/begin MEASUREMENT LSU_dcycLimActHt00 "Tatsächliche Begrenzung des Tastverhältnisses wegen Batteriespannungskorrektur" SWORD DtyCyc 1 100 -327.6800 327.6700 ECU_ADDRESS 0xD000106A /end MEASUREMENT
/begin MEASUREMENT LSU_dcycP_mp00 "Aktualisierung des Tastverhältnisses aus dem P-Anteil" SWORD DtyCyc 1 100 -327.6800 327.6700 ECU_ADDRESS 0xC000C350 /end MEASUREMENT
/begin MEASUREMENT LSU_dcycRippel_mp00 "Änderung Heizer-Tastverhältnis LSU bei Diagnose Heizereinkopplung" SWORD DtyCyc 1 100 -327.6800 327.6700 ECU_ADDRESS 0xC000C332 /end MEASUREMENT
/begin MEASUREMENT LSU_drO2Adap00 "Gefilterter Sauerstoffwert" SWORD O2 1 100 -0.3276800 0.3276700 ECU_ADDRESS 0xD000106C /end MEASUREMENT
/begin MEASUREMENT LSU_drO2Flt_mp00 "Anpassungsfilterausgang" SWORD O2 1 100 -0.3276800 0.3276700 ECU_ADDRESS 0xC000C344 /end MEASUREMENT
/begin MEASUREMENT LSU_facO2Corr_mp00 "Korrekturfaktor der Anpassung" SWORD Fact 1 100 -4.000000 3.999878 ECU_ADDRESS 0xC000C346 /end MEASUREMENT
/begin MEASUREMENT LSU_facPresComp_mp00 "Messpunkt des Kompensationsfaktors" SWORD Fact 1 100 -4.000000 3.999878 ECU_ADDRESS 0xC000C348 /end MEASUREMENT
/begin MEASUREMENT LSU_resRi00 "Korrekturwert des Ri-Kalibrierwiderstands" SWORD Resist 1 100 -3276.800 3276.700 FORMAT "%8.3" ECU_ADDRESS 0xD0001088 /end MEASUREMENT
/begin MEASUREMENT LSU_resRiClb00 "Korrekturwert des Ri-Kalibrierwiderstands" SWORD Resist 1 100 -3276.800 3276.700 FORMAT "%8.3" ECU_ADDRESS 0xD000107E /end MEASUREMENT
/begin MEASUREMENT LSU_resRiClbRaw_mp00 "Roh Ri-Korrekturwert" SWORD Resist 1 100 -3276.800 3276.700 FORMAT "%8.3" ECU_ADDRESS 0xC000C32C /end MEASUREMENT
/begin MEASUREMENT LSU_resRiDvt00 "Ri-Kalibrierungswert nach Begrenzung und Filterung" SWORD Resist 1 100 -3276.800 3276.700 FORMAT "%8.3" ECU_ADDRESS 0xD0001080 /end MEASUREMENT
/begin MEASUREMENT LSU_resRiHtCoupStp100 "Innenwiderstand LSU (erste Datenerfassung in Diagnose Heizereinkopplung)" SWORD Resist 1 100 -3276.800 3276.700 FORMAT "%8.3" ECU_ADDRESS 0xD0001082 /end MEASUREMENT
/begin MEASUREMENT LSU_resRiHtCoupStp200 "Innenwiderstand LSU (zweite Datenerfassung in Diagnose Heizereinkopplung)" SWORD Resist 1 100 -3276.800 3276.700 FORMAT "%8.3" ECU_ADDRESS 0xD0001084 /end MEASUREMENT
/begin MEASUREMENT LSU_resRiRaw00 "Rohwiderstand der Ri-Auswertung, inklusiv Kalibrierwerte!" SWORD Resist 1 100 -3276.800 3276.700 FORMAT "%8.3" ECU_ADDRESS 0xD0001086 /end MEASUREMENT
/begin MEASUREMENT LSU_resRiRippel_mp00 "Innenwiderstands-Änderung beim Abschalten Heizung LSU" SWORD Resist 1 100 -3276.800 3276.700 FORMAT "%8.3" ECU_ADDRESS 0xC000C334 /end MEASUREMENT
/begin MEASUREMENT LSU_rLam00 "Der aus LSU gemessene Lambdawert" SWORD lambda 1 100 -32.76800 32.76700 ECU_ADDRESS 0xD0001072 /end MEASUREMENT
/begin MEASUREMENT LSU_rLamRec00 "Reziprokale Lambda-Botschaft" SWORD lambdaRecVal 1 100 -32.76800 32.76700 FORMAT "%8.5" ECU_ADDRESS 0xD0001070 /end MEASUREMENT
/begin MEASUREMENT LSU_rO2Act00 "Sauerstoffrohwert ohne Filter und ohne Freeze, nur Offset-kompensiert" SWORD O2 1 100 -0.3276800 0.3276700 ECU_ADDRESS 0xD0001074 /end MEASUREMENT
/begin MEASUREMENT LSU_rO2Adap00 "Adaptierte Sauerstoffkonzentration die an externe Module übertragen wird" SWORD O2 1 100 -0.3276800 0.3276700 ECU_ADDRESS 0xD0001076 /end MEASUREMENT
/begin MEASUREMENT LSU_rO2DiffCmpChk_mp00 "O2-Unterschied eines Sondenpaars" SWORD O2 1 100 -0.3276800 0.3276700 ECU_ADDRESS 0xC000C352 /end MEASUREMENT
/begin MEASUREMENT LSU_rO2FrstValCmpChk_mp00 "O2-Konzentration der ersten Sonde der Differenzprüfung" SWORD O2 1 100 -0.3276800 0.3276700 ECU_ADDRESS 0xC000C354 /end MEASUREMENT
/begin MEASUREMENT LSU_rO2PresComp00 "Druck-korrigierter Sauerstoffwert" SWORD O2 1 100 -0.3276800 0.3276700 ECU_ADDRESS 0xD0001078 /end MEASUREMENT
/begin MEASUREMENT LSU_rO2Raw00 "Sauerstoffrohwert, nur Offset-kompensiert" SWORD O2 1 100 -0.3276800 0.3276700 ECU_ADDRESS 0xD000107A /end MEASUREMENT
/begin MEASUREMENT LSU_rO2RawFlt_mp00 "Gefilterter Wert des LSU_rO2Rau, der in Erkennung Lambda=1 Bedingung verwendet wird." SWORD O2 1 100 -0.3276800 0.3276700 ECU_ADDRESS 0xC000C324 /end MEASUREMENT
/begin MEASUREMENT LSU_rO2SecValCmpChk_mp00 "O2-Konzentration der zweiten Sonde der Differenzprüfung" SWORD O2 1 100 -0.3276800 0.3276700 ECU_ADDRESS 0xC000C356 /end MEASUREMENT
/begin MEASUREMENT LSU_rO2Stat00 "Die durch PT1-Filter gefilterte O2-Konzentration" SWORD O2 1 100 -0.3276800 0.3276700 ECU_ADDRESS 0xD000107C /end MEASUREMENT
/begin MEASUREMENT LSU_rO2Thres1_mp00 "untere O2-Schwelle für Messung der Anstiegszeit" SWORD O2 1 100 -0.3276800 0.3276700 ECU_ADDRESS 0xC000C358 /end MEASUREMENT
/begin MEASUREMENT LSU_rO2Thres2_mp00 "obere O2-Schwelle für Messung der Anstiegszeit" SWORD O2 1 100 -0.3276800 0.3276700 ECU_ADDRESS 0xC000C35A /end MEASUREMENT
/begin MEASUREMENT LSU_rOutHWE_mp00 "Tastverhältnis für HWE inklusiv Testeranforderung" SWORD DtyCyc 1 100 -327.6800 327.6700 ECU_ADDRESS 0xC000C328 /end MEASUREMENT
/begin MEASUREMENT LSU_stAdap00 "Gefilterter Sauerstoffwert" UBYTE OneToOne 1 100 0.00 255.0 ECU_ADDRESS 0xD0001F39 /end MEASUREMENT
/begin MEASUREMENT LSU_stAdapActv_mp00 "Status der Anpassungsaktivierung" UBYTE OneToOne 1 100 0.00 255.0 ECU_ADDRESS 0xC000C34A /end MEASUREMENT
/begin MEASUREMENT LSU_stChkDyn_mp00 "Nummer der zuletzt erreichten O2-Schwelle" UBYTE OneToOne 1 100 0.00 255.0 ECU_ADDRESS 0xC000C35C /end MEASUREMENT
/begin MEASUREMENT LSU_stChng00 "Status, ob im aktuellen Fahrzyklus bereits ein neues Lernergebnis erzeugt wurde." UBYTE OneToOne 1 100 0.00 255.0 ECU_ADDRESS 0xD0001F3A /end MEASUREMENT
/begin MEASUREMENT LSU_stCirModeNew00 "Letzter CJ125 Modusstatus der auf INIT1/INIT2 Register geschrieben wird." UWORD OneToOne 1 100 0.00 65535.00 ECU_ADDRESS 0xD00015E4 /end MEASUREMENT
/begin MEASUREMENT LSU_stCldSensDiaActv00 "Status zur Freigabe der SCB-Prüfung an IA/IP für kalte Sonde" UBYTE OneToOne 1 100 0.00 255.0 ECU_ADDRESS 0xD0001F3B /end MEASUREMENT
/begin MEASUREMENT LSU_stCmpChkCon_mp00 "Statuswort Zustand der Voraussetzungen der Differenzprüfung" UBYTE OneToOne 1 100 0.00 255.0 ECU_ADDRESS 0xC000C35D /end MEASUREMENT
/begin MEASUREMENT LSU_stCmpChk_mp00 "Statuswort Zustand der Differenzprüfung" UBYTE OneToOne 1 100 0.00 255.0 ECU_ADDRESS 0xC000C35E /end MEASUREMENT
/begin MEASUREMENT LSU_stCmpErr_mp00 "Statusbit Ergebnis der Differenzprüfung" UBYTE OneToOne 1 100 0.00 255.0 ECU_ADDRESS 0xC000C35F /end MEASUREMENT
/begin MEASUREMENT LSU_stDiaIAEna00 "Statusvariable zur Initialisierung des CJ125-Registers" UBYTE OneToOne 1 100 0.00 255.0 ECU_ADDRESS 0xD0001F3C /end MEASUREMENT
/begin MEASUREMENT LSU_stDiaReg_mp00 "Inhalt des Diagnoseregister des CJ125" UWORD OneToOne 1 100 0.00 65535.00 ECU_ADDRESS 0xC000C326 /end MEASUREMENT
/begin MEASUREMENT LSU_stDynState00 "Dynamische Plausibilitätstest Zustandsautomatgröße" UBYTE OneToOne 1 100 0.00 255.0 ECU_ADDRESS 0xD0001F3D /end MEASUREMENT
/begin MEASUREMENT LSU_stErr00 "Die bitkodierte Größe zeigt verschiedene Fehler an, die aktuell in LSU gesetzt werden" UWORD OneToOne 1 100 0.00 65535.00 ECU_ADDRESS 0xD00015E6 /end MEASUREMENT
/begin MEASUREMENT LSU_stHold_mp00 "Anpassungsstatus" UBYTE OneToOne 1 100 0.00 255.0 ECU_ADDRESS 0xC000C34B /end MEASUREMENT
/begin MEASUREMENT LSU_stHtCtl00 "Status der Heizerregelung" UBYTE OneToOne 1 100 0.00 255.0 ECU_ADDRESS 0xD0001F3F /end MEASUREMENT
/begin MEASUREMENT LSU_stHtDis00 "Heizer-ausgeschalteter-Status" UBYTE OneToOne 1 100 0.00 255.0 ECU_ADDRESS 0xD0001F40 /end MEASUREMENT
/begin MEASUREMENT LSU_stHtDisbl00 "Heizersperrungs-Anforderung" UBYTE OneToOne 1 100 0.00 255.0 ECU_ADDRESS 0xD0001F41 /end MEASUREMENT
/begin MEASUREMENT LSU_stIpHiCurrEna00 "Statusbit zum Setzen 40uA EIN" UBYTE OneToOne 1 100 0.00 255.0 ECU_ADDRESS 0xD0001F43 /end MEASUREMENT
/begin MEASUREMENT LSU_stIpNrmCurrEna00 "Statusbit zum Setzen 20uA EIN ) , CType(uint8[ctNumberOfSensors]" UBYTE OneToOne 1 100 0.00 255.0 ECU_ADDRESS 0xD0001F44 /end MEASUREMENT
/begin MEASUREMENT LSU_stIsolChkActv00 "Status:: Nebsnschlußerkennung ist momentan aktiv" UBYTE OneToOne 1 100 0.00 255.0 ECU_ADDRESS 0xD0001F45 /end MEASUREMENT
/begin MEASUREMENT LSU_stIsolChkO2Last00 "Status:: O2-Signal im Fenster der Nebenschlußerkennung" UBYTE OneToOne 1 100 0.00 255.0 ECU_ADDRESS 0xD0001F46 /end MEASUREMENT
/begin MEASUREMENT LSU_stO2Act_mp00 "Status der O2-Gültigkeit, der durch O2-Kalibrierungsstatus und LSU-Fehler beeinflußt wird" UBYTE OneToOne 1 100 0.00 255.0 ECU_ADDRESS 0xC000C32A /end MEASUREMENT
/begin MEASUREMENT LSU_stO2Chk00 "Statusmeldung anzuzeigen, ob eine bestimmte Diagnoseroutine durchgeführt wurde oder nicht" UWORD OneToOne 1 100 0.00 65535.00 ECU_ADDRESS 0xD00015E8 /end MEASUREMENT
/begin MEASUREMENT LSU_stO2Err00 "Statusmeldung zur Anzeige des Ergebnisses der Diagnoseroutine - Fehler/ kein Fehler" UWORD OneToOne 1 100 0.00 65535.00 ECU_ADDRESS 0xD00015EA /end MEASUREMENT
/begin MEASUREMENT LSU_stO2IntValid00 "O2-Signal gültig (Intern)" UBYTE OneToOne 1 100 0.00 255.0 ECU_ADDRESS 0xD0001F48 /end MEASUREMENT
/begin MEASUREMENT LSU_stOpnErrIP00 "Lastabfallfehlerbotschaft für Pumpen-Pin (Ip)" UBYTE OneToOne 1 100 0.00 255.0 ECU_ADDRESS 0xD0001F4A /end MEASUREMENT
/begin MEASUREMENT LSU_stOpnLdTstActv00 "Status bei aktivem Lastabfalltest" UBYTE OneToOne 1 100 0.00 255.0 ECU_ADDRESS 0xD0001F4B /end MEASUREMENT
/begin MEASUREMENT LSU_stPlausChk00 "Ergebnis der O2-Plausibilitätsprüfung in dem aktuellen Betriebspunkt" UBYTE OneToOne 1 100 0.00 255.0 ECU_ADDRESS 0xD0001F4D /end MEASUREMENT
/begin MEASUREMENT LSU_stPmpCtl00 "Status des Sauerstoffpumpenstroms" UBYTE OneToOne 1 100 0.00 255.0 ECU_ADDRESS 0xD0001F4E /end MEASUREMENT
/begin MEASUREMENT LSU_stPmpEna00 "Triggerbotschaft zur Freigabe des Pumpenstroms" UBYTE OneToOne 1 100 0.00 255.0 ECU_ADDRESS 0xD0001F4F /end MEASUREMENT
/begin MEASUREMENT LSU_stRecValEval_mp00 "Messpunkt zur Überwachung des Status zur Anzeige, ob aufgenommene Werte bewertet werden sollen" UBYTE OneToOne 1 100 0.00 255.0 ECU_ADDRESS 0xC000C336 /end MEASUREMENT
/begin MEASUREMENT LSU_stRefCurrTrans_mp00 "Instrument für LSU-Referenzpumpenstrom -Statusübergang (von hohem Strom zu niedrigem Strom und umgekehrt)" UBYTE OneToOne 1 100 0.00 255.0 ECU_ADDRESS 0xC000C366 /end MEASUREMENT
/begin MEASUREMENT LSU_stRefPmp00 "Status der Referenzpumpströme" UBYTE OneToOne 1 100 0.00 255.0 ECU_ADDRESS 0xD0001F51 /end MEASUREMENT
/begin MEASUREMENT LSU_stRefPmpDis00 "Statusvariable zur Sperrung des Referenzpumpenstroms bei SCG der Sondenleitungen" UBYTE OneToOne 1 100 0.00 255.0 ECU_ADDRESS 0xD0001F50 /end MEASUREMENT
/begin MEASUREMENT LSU_stRiValid00 "Gültiger Status der Innenwiderstandsmessung" UBYTE OneToOne 1 100 0.00 255.0 ECU_ADDRESS 0xD0001F55 /end MEASUREMENT
/begin MEASUREMENT LSU_stRmp00 "message zum Speichern des Rampenstatus" UBYTE OneToOne 1 100 0.00 255.0 ECU_ADDRESS 0xD0001F56 /end MEASUREMENT
/begin MEASUREMENT LSU_stSCUNEna00 "Status des Tests KurzschlussnachBatterie für UN" UBYTE OneToOne 1 100 0.00 255.0 ECU_ADDRESS 0xD0001F57 /end MEASUREMENT
/begin MEASUREMENT LSU_stSPIIniVal_mp00 "Der aus den CJ125 INIT1/INIT2 -Register gelesene Wert" UWORD OneToOne 1 100 0.00 65535.00 ECU_ADDRESS 0xC000C330 /end MEASUREMENT
/begin MEASUREMENT LSU_stTstTrigger_mp00 "Messpunkt zur Überwachung der Variable, die der Trigger-Status der Nebenschlusserkennung anzeigt" UBYTE OneToOne 1 100 0.00 255.0 ECU_ADDRESS 0xC000C337 /end MEASUREMENT
/begin MEASUREMENT LSU_stWireDiaChk_mp00 "Messpunkt, der anzeigt, welche Diagnoseroutine mit einiger bedeutungsvoller Ergebnisse durchgeführt wurden. Es ist bitcodiert. Wird das Bit gesetzt, bedeutet das, dass die bestimmte Routine durchgeführt wird." UBYTE OneToOne 1 100 0.00 255.0 ECU_ADDRESS 0xC000C338 /end MEASUREMENT
/begin MEASUREMENT LSU_stWireDiaErr_mp00 "Messpunkt zur Anzeige der Diagnosenprüfungsergebnisse" UBYTE OneToOne 1 100 0.00 255.0 ECU_ADDRESS 0xC000C339 /end MEASUREMENT
/begin MEASUREMENT LSU_tDvt00 "Abweichung von Sensortemperatur aus dem Sollwert" SWORD TempDiff_Kelv 1 100 -3276.800 3276.700 ECU_ADDRESS 0xD000108A /end MEASUREMENT
/begin MEASUREMENT LSU_tiState1_mp00 "Timervariable: Kraftstoffmenge liegt innerhalb Toleranzband" UWORD Time_s 1 100 0.00 655.3500 ECU_ADDRESS 0xC000C360 /end MEASUREMENT
/begin MEASUREMENT LSU_tiState2_mp00 "Anstiegszeit O2-Signal beim Übergang Last-Schub" UWORD Time_s 1 100 0.00 655.3500 ECU_ADDRESS 0xC000C362 /end MEASUREMENT
/begin MEASUREMENT LSU_tiState3_mp00 "Zeitdauer bis zum Erreichen des Schubs (Kraftstoffmenge kleiner als Schwellwert)" UWORD Time_s 1 100 0.00 655.3500 ECU_ADDRESS 0xC000C364 /end MEASUREMENT
/begin MEASUREMENT LSU_tRi00 "Äquivalenztemperatur für Ri" SWORD Temp_Cels 1 100 -3549.940 3003.560 ECU_ADDRESS 0xD000108C /end MEASUREMENT
/begin MEASUREMENT LSU_uO2Clb00 "Korrekturwert der Sauerstoffkalibrierung" SWORD Volt 1 100 -6553.600 6553.400 ECU_ADDRESS 0xD000108E /end MEASUREMENT
/begin MEASUREMENT LSU_uO2Dvt00 "Begrenzter und gefilterter Kalibrierungswert" SWORD Volt 1 100 -6553.600 6553.400 ECU_ADDRESS 0xD0001090 /end MEASUREMENT
/begin MEASUREMENT LSU_uO2Flt00 "Gefilterter Wert des O2-Rohsignals" SWORD Volt 1 100 -6553.600 6553.400 ECU_ADDRESS 0xD0001092 /end MEASUREMENT
/begin MEASUREMENT LSU_uO2FltRippel_mp00 "gefilterter Spannungsrippel in Diagnose Heizereinkopplung" SWORD Volt 1 100 -6553.600 6553.400 ECU_ADDRESS 0xC000C33A /end MEASUREMENT
/begin MEASUREMENT LSU_uO2Grad_mp00 "Gradient des O2-Signals während Diagnose Heizereinkopplung" SWORD Volt 1 100 -6553.600 6553.400 ECU_ADDRESS 0xC000C33C /end MEASUREMENT
/begin MEASUREMENT LSU_uO2HtCoupStp100 "O2-Spannungssignal (erste Datenerfassung in Diagnose Heizereinkopplung)" SWORD Volt 1 100 -6553.600 6553.400 ECU_ADDRESS 0xD0001094 /end MEASUREMENT
/begin MEASUREMENT LSU_uO2HtCoupStp200 "O2-Spannungssignal (zweite Datenerfassung in Diagnose Heizereinkopplung)" SWORD Volt 1 100 -6553.600 6553.400 ECU_ADDRESS 0xD0001096 /end MEASUREMENT
/begin MEASUREMENT LSU_uO2HtCoupStp300 "O2-Spannungssignal (dritte Datenerfassung in Diagnose Heizereinkopplung)" SWORD Volt 1 100 -6553.600 6553.400 ECU_ADDRESS 0xD0001098 /end MEASUREMENT
/begin MEASUREMENT LSU_uO2Raw00 "Spannungsrohwert des Lambda-Signals nach Abzug der Referenz" SWORD Volt 1 100 -6553.600 6553.400 ECU_ADDRESS 0xD000109E /end MEASUREMENT
/begin MEASUREMENT LSU_uO2RawAdcDirect00 "Direkter O2-Signalwert aus dem ADC (vor Segmentfilterung)" SWORD Volt 1 100 -6553.600 6553.400 ECU_ADDRESS 0xD000109A /end MEASUREMENT
/begin MEASUREMENT LSU_uO2RawOfsCor00 "Für Offset-Spannung korrigiertes O2-Spannungssignal" SWORD Volt 1 100 -6553.600 6553.400 ECU_ADDRESS 0xD000109C /end MEASUREMENT
/begin MEASUREMENT LSU_uO2Rippel_mp00 "Spannungsänderung O2-Signal beim Abschalten Heizer LSU" SWORD Volt 1 100 -6553.600 6553.400 ECU_ADDRESS 0xC000C33E /end MEASUREMENT
/begin MEASUREMENT LSU_uRiFlt00 "Gefilterter Wert des Ri-Signals" SWORD Volt 1 100 -6553.600 6553.400 ECU_ADDRESS 0xD00010A0 /end MEASUREMENT
/begin MEASUREMENT LSU_uRiRawOfsCor00 "Ri-Spannung nach Offset-Korrektur" SWORD Volt 1 100 -6553.600 6553.400 ECU_ADDRESS 0xD00010A2 /end MEASUREMENT
/begin MEASUREMENT LSU_uRiRaw_mp00 "Messpunkt zum Speichern des gefilterten Werts" SWORD Volt 1 100 -6553.600 6553.400 ECU_ADDRESS 0xC000C32E /end MEASUREMENT
/begin MEASUREMENT MeUn_iRefActrTst_mp00 "Erkannter Strom des Stellertests der Zumesseinheit" SWORD Curr 1 100 -32768.00 32767.00 FORMAT "%8.2" ECU_ADDRESS 0xC000C368 /end MEASUREMENT
/begin MEASUREMENT MeUn_iRefActrTst_mp01 "Erkannter Strom des Stellertests der Zumesseinheit" SWORD Curr 1 100 -32768.00 32767.00 FORMAT "%8.2" ECU_ADDRESS 0xC000C36A /end MEASUREMENT
/begin MEASUREMENT MeUn_iRefActrTst_mp02 "Erkannter Strom des Stellertests der Zumesseinheit" SWORD Curr 1 100 -32768.00 32767.00 FORMAT "%8.2" ECU_ADDRESS 0xC000C36C /end MEASUREMENT
/begin MEASUREMENT MeUn_iResActrTst_mp00 "Durchschnittlicher Strom aus drei Referenzströmen der Zumesseinheit" SWORD Curr 1 100 -32768.00 32767.00 FORMAT "%8.2" ECU_ADDRESS 0xC000C36E /end MEASUREMENT
/begin MEASUREMENT MeUn_iResActrTst_mp01 "Durchschnittlicher Strom aus drei Referenzströmen der Zumesseinheit" SWORD Curr 1 100 -32768.00 32767.00 FORMAT "%8.2" ECU_ADDRESS 0xC000C370 /end MEASUREMENT
/begin MEASUREMENT MeUn_iResActrTst_mp02 "Durchschnittlicher Strom aus drei Referenzströmen der Zumesseinheit" SWORD Curr 1 100 -32768.00 32767.00 FORMAT "%8.2" ECU_ADDRESS 0xC000C372 /end MEASUREMENT
/begin MEASUREMENT MeUn_iResActrTst_mp03 "Durchschnittlicher Strom aus drei Referenzströmen der Zumesseinheit" SWORD Curr 1 100 -32768.00 32767.00 FORMAT "%8.2" ECU_ADDRESS 0xC000C374 /end MEASUREMENT
/begin MEASUREMENT MeUn_nActrTst00 "Drehzahl der Testphasen für den Stellertest der Zumesseinheit" SWORD EngN 1 100 -16384.00 16383.50 ECU_ADDRESS 0xD00010E2 /end MEASUREMENT
/begin MEASUREMENT MeUn_nActrTst01 "Drehzahl der Testphasen für den Stellertest der Zumesseinheit" SWORD EngN 1 100 -16384.00 16383.50 ECU_ADDRESS 0xD00010E4 /end MEASUREMENT
/begin MEASUREMENT MeUn_nActrTst02 "Drehzahl der Testphasen für den Stellertest der Zumesseinheit" SWORD EngN 1 100 -16384.00 16383.50 ECU_ADDRESS 0xD00010E6 /end MEASUREMENT
/begin MEASUREMENT MeUn_nActrTst03 "Drehzahl der Testphasen für den Stellertest der Zumesseinheit" SWORD EngN 1 100 -16384.00 16383.50 ECU_ADDRESS 0xD00010E8 /end MEASUREMENT
/begin MEASUREMENT MeUn_pActrTst00 "Gewünschter Solldruck für den Stellertest der Zumesseinheit" SWORD Pres_Rail 1 100 -3276.800 2000.000 ECU_ADDRESS 0xD00010EA /end MEASUREMENT
/begin MEASUREMENT MeUn_pActrTst01 "Gewünschter Solldruck für den Stellertest der Zumesseinheit" SWORD Pres_Rail 1 100 -3276.800 2000.000 ECU_ADDRESS 0xD00010EC /end MEASUREMENT
/begin MEASUREMENT MeUn_pActrTst02 "Gewünschter Solldruck für den Stellertest der Zumesseinheit" SWORD Pres_Rail 1 100 -3276.800 2000.000 ECU_ADDRESS 0xD00010EE /end MEASUREMENT
/begin MEASUREMENT MeUn_pActrTst03 "Gewünschter Solldruck für den Stellertest der Zumesseinheit" SWORD Pres_Rail 1 100 -3276.800 2000.000 ECU_ADDRESS 0xD00010F0 /end MEASUREMENT
/begin MEASUREMENT MeUn_stResActrTst_mp00 "Ergebnisstatus des Test der Zumesseinheit" UBYTE OneToOne 1 100 0.00 255.0 ECU_ADDRESS 0xC000C376 /end MEASUREMENT
/begin MEASUREMENT MeUn_stResActrTst_mp01 "Ergebnisstatus des Test der Zumesseinheit" UBYTE OneToOne 1 100 0.00 255.0 ECU_ADDRESS 0xC000C377 /end MEASUREMENT
/begin MEASUREMENT MeUn_stResActrTst_mp02 "Ergebnisstatus des Test der Zumesseinheit" UBYTE OneToOne 1 100 0.00 255.0 ECU_ADDRESS 0xC000C378 /end MEASUREMENT
/begin MEASUREMENT MeUn_stResActrTst_mp03 "Ergebnisstatus des Test der Zumesseinheit" UBYTE OneToOne 1 100 0.00 255.0 ECU_ADDRESS 0xC000C379 /end MEASUREMENT
/begin MEASUREMENT MoFInjDat_numCylActr_mp00 "Zylindernummer einspritzplatzspezifisch" UBYTE OneToOne 1 100 0.00 255.0 ECU_ADDRESS 0xC000C37A /end MEASUREMENT
/begin MEASUREMENT MoFInjDat_numCylActr_mp01 "Zylindernummer einspritzplatzspezifisch" UBYTE OneToOne 1 100 0.00 255.0 ECU_ADDRESS 0xC000C37B /end MEASUREMENT
/begin MEASUREMENT MoFInjDat_numCylActr_mp02 "Zylindernummer einspritzplatzspezifisch" UBYTE OneToOne 1 100 0.00 255.0 ECU_ADDRESS 0xC000C37C /end MEASUREMENT
/begin MEASUREMENT MoFInjDat_numCylActr_mp03 "Zylindernummer einspritzplatzspezifisch" UBYTE OneToOne 1 100 0.00 255.0 ECU_ADDRESS 0xC000C37D /end MEASUREMENT
/begin MEASUREMENT MoFInjDat_numCylActr_mp04 "Zylindernummer einspritzplatzspezifisch" UBYTE OneToOne 1 100 0.00 255.0 ECU_ADDRESS 0xC000C37E /end MEASUREMENT
/begin MEASUREMENT MoFInjDat_numCylActr_mp05 "Zylindernummer einspritzplatzspezifisch" UBYTE OneToOne 1 100 0.00 255.0 ECU_ADDRESS 0xC000C37F /end MEASUREMENT
/begin MEASUREMENT MoFInjDat_numCylActr_mp06 "Zylindernummer einspritzplatzspezifisch" UBYTE OneToOne 1 100 0.00 255.0 ECU_ADDRESS 0xC000C380 /end MEASUREMENT
/begin MEASUREMENT MoFInjDat_numCylActr_mp07 "Zylindernummer einspritzplatzspezifisch" UBYTE OneToOne 1 100 0.00 255.0 ECU_ADDRESS 0xC000C381 /end MEASUREMENT
/begin MEASUREMENT MoFInjDat_numCylActr_mp08 "Zylindernummer einspritzplatzspezifisch" UBYTE OneToOne 1 100 0.00 255.0 ECU_ADDRESS 0xC000C382 /end MEASUREMENT
/begin MEASUREMENT MoFInjDat_numCylActr_mp09 "Zylindernummer einspritzplatzspezifisch" UBYTE OneToOne 1 100 0.00 255.0 ECU_ADDRESS 0xC000C383 /end MEASUREMENT
/begin MEASUREMENT MoFInjDat_numInjType_mp00 "Einspritztyp einspritzplatzspezifisch" UBYTE OneToOne 1 100 0.00 255.0 ECU_ADDRESS 0xC000C384 /end MEASUREMENT
/begin MEASUREMENT MoFInjDat_numInjType_mp01 "Einspritztyp einspritzplatzspezifisch" UBYTE OneToOne 1 100 0.00 255.0 ECU_ADDRESS 0xC000C385 /end MEASUREMENT
/begin MEASUREMENT MoFInjDat_numInjType_mp02 "Einspritztyp einspritzplatzspezifisch" UBYTE OneToOne 1 100 0.00 255.0 ECU_ADDRESS 0xC000C386 /end MEASUREMENT
/begin MEASUREMENT MoFInjDat_numInjType_mp03 "Einspritztyp einspritzplatzspezifisch" UBYTE OneToOne 1 100 0.00 255.0 ECU_ADDRESS 0xC000C387 /end MEASUREMENT
/begin MEASUREMENT MoFInjDat_numInjType_mp04 "Einspritztyp einspritzplatzspezifisch" UBYTE OneToOne 1 100 0.00 255.0 ECU_ADDRESS 0xC000C388 /end MEASUREMENT
/begin MEASUREMENT MoFInjDat_numInjType_mp05 "Einspritztyp einspritzplatzspezifisch" UBYTE OneToOne 1 100 0.00 255.0 ECU_ADDRESS 0xC000C389 /end MEASUREMENT
/begin MEASUREMENT MoFInjDat_numInjType_mp06 "Einspritztyp einspritzplatzspezifisch" UBYTE OneToOne 1 100 0.00 255.0 ECU_ADDRESS 0xC000C38A /end MEASUREMENT
/begin MEASUREMENT MoFInjDat_numInjType_mp07 "Einspritztyp einspritzplatzspezifisch" UBYTE OneToOne 1 100 0.00 255.0 ECU_ADDRESS 0xC000C38B /end MEASUREMENT
/begin MEASUREMENT MoFInjDat_numInjType_mp08 "Einspritztyp einspritzplatzspezifisch" UBYTE OneToOne 1 100 0.00 255.0 ECU_ADDRESS 0xC000C38C /end MEASUREMENT
/begin MEASUREMENT MoFInjDat_numInjType_mp09 "Einspritztyp einspritzplatzspezifisch" UBYTE OneToOne 1 100 0.00 255.0 ECU_ADDRESS 0xC000C38D /end MEASUREMENT
/begin MEASUREMENT MoFInjDat_phiInjBegActr_mp00 "Ansteuerwinkel einspritzplatzspezifisch" SWORD Mo_phi_degCrS_q0p02197 1 100 -720.0439 720.0220 FORMAT "%8.4" ECU_ADDRESS 0xC000C38E /end MEASUREMENT
/begin MEASUREMENT MoFInjDat_phiInjBegActr_mp01 "Ansteuerwinkel einspritzplatzspezifisch" SWORD Mo_phi_degCrS_q0p02197 1 100 -720.0439 720.0220 FORMAT "%8.4" ECU_ADDRESS 0xC000C390 /end MEASUREMENT
/begin MEASUREMENT MoFInjDat_phiInjBegActr_mp02 "Ansteuerwinkel einspritzplatzspezifisch" SWORD Mo_phi_degCrS_q0p02197 1 100 -720.0439 720.0220 FORMAT "%8.4" ECU_ADDRESS 0xC000C392 /end MEASUREMENT
/begin MEASUREMENT MoFInjDat_phiInjBegActr_mp03 "Ansteuerwinkel einspritzplatzspezifisch" SWORD Mo_phi_degCrS_q0p02197 1 100 -720.0439 720.0220 FORMAT "%8.4" ECU_ADDRESS 0xC000C394 /end MEASUREMENT
/begin MEASUREMENT MoFInjDat_phiInjBegActr_mp04 "Ansteuerwinkel einspritzplatzspezifisch" SWORD Mo_phi_degCrS_q0p02197 1 100 -720.0439 720.0220 FORMAT "%8.4" ECU_ADDRESS 0xC000C396 /end MEASUREMENT
/begin MEASUREMENT MoFInjDat_phiInjBegActr_mp05 "Ansteuerwinkel einspritzplatzspezifisch" SWORD Mo_phi_degCrS_q0p02197 1 100 -720.0439 720.0220 FORMAT "%8.4" ECU_ADDRESS 0xC000C398 /end MEASUREMENT
/begin MEASUREMENT MoFInjDat_phiInjBegActr_mp06 "Ansteuerwinkel einspritzplatzspezifisch" SWORD Mo_phi_degCrS_q0p02197 1 100 -720.0439 720.0220 FORMAT "%8.4" ECU_ADDRESS 0xC000C39A /end MEASUREMENT
/begin MEASUREMENT MoFInjDat_phiInjBegActr_mp07 "Ansteuerwinkel einspritzplatzspezifisch" SWORD Mo_phi_degCrS_q0p02197 1 100 -720.0439 720.0220 FORMAT "%8.4" ECU_ADDRESS 0xC000C39C /end MEASUREMENT
/begin MEASUREMENT MoFInjDat_phiInjBegActr_mp08 "Ansteuerwinkel einspritzplatzspezifisch" SWORD Mo_phi_degCrS_q0p02197 1 100 -720.0439 720.0220 FORMAT "%8.4" ECU_ADDRESS 0xC000C39E /end MEASUREMENT
/begin MEASUREMENT MoFInjDat_phiInjBegActr_mp09 "Ansteuerwinkel einspritzplatzspezifisch" SWORD Mo_phi_degCrS_q0p02197 1 100 -720.0439 720.0220 FORMAT "%8.4" ECU_ADDRESS 0xC000C3A0 /end MEASUREMENT
/begin MEASUREMENT MoFInjDat_tiInjDurActr_mp00 "Ansteuerdauern einspritzplatzspezifisch" SWORD Mo_ti_us_q0p4 1 100 -13107.20 13106.80 FORMAT "%8.2" ECU_ADDRESS 0xC000C3A2 /end MEASUREMENT
/begin MEASUREMENT MoFInjDat_tiInjDurActr_mp01 "Ansteuerdauern einspritzplatzspezifisch" SWORD Mo_ti_us_q0p4 1 100 -13107.20 13106.80 FORMAT "%8.2" ECU_ADDRESS 0xC000C3A4 /end MEASUREMENT
/begin MEASUREMENT MoFInjDat_tiInjDurActr_mp02 "Ansteuerdauern einspritzplatzspezifisch" SWORD Mo_ti_us_q0p4 1 100 -13107.20 13106.80 FORMAT "%8.2" ECU_ADDRESS 0xC000C3A6 /end MEASUREMENT
/begin MEASUREMENT MoFInjDat_tiInjDurActr_mp03 "Ansteuerdauern einspritzplatzspezifisch" SWORD Mo_ti_us_q0p4 1 100 -13107.20 13106.80 FORMAT "%8.2" ECU_ADDRESS 0xC000C3A8 /end MEASUREMENT
/begin MEASUREMENT MoFInjDat_tiInjDurActr_mp04 "Ansteuerdauern einspritzplatzspezifisch" SWORD Mo_ti_us_q0p4 1 100 -13107.20 13106.80 FORMAT "%8.2" ECU_ADDRESS 0xC000C3AA /end MEASUREMENT
/begin MEASUREMENT MoFInjDat_tiInjDurActr_mp05 "Ansteuerdauern einspritzplatzspezifisch" SWORD Mo_ti_us_q0p4 1 100 -13107.20 13106.80 FORMAT "%8.2" ECU_ADDRESS 0xC000C3AC /end MEASUREMENT
/begin MEASUREMENT MoFInjDat_tiInjDurActr_mp06 "Ansteuerdauern einspritzplatzspezifisch" SWORD Mo_ti_us_q0p4 1 100 -13107.20 13106.80 FORMAT "%8.2" ECU_ADDRESS 0xC000C3AE /end MEASUREMENT
/begin MEASUREMENT MoFInjDat_tiInjDurActr_mp07 "Ansteuerdauern einspritzplatzspezifisch" SWORD Mo_ti_us_q0p4 1 100 -13107.20 13106.80 FORMAT "%8.2" ECU_ADDRESS 0xC000C3B0 /end MEASUREMENT
/begin MEASUREMENT MoFInjDat_tiInjDurActr_mp08 "Ansteuerdauern einspritzplatzspezifisch" SWORD Mo_ti_us_q0p4 1 100 -13107.20 13106.80 FORMAT "%8.2" ECU_ADDRESS 0xC000C3B2 /end MEASUREMENT
/begin MEASUREMENT MoFInjDat_tiInjDurActr_mp09 "Ansteuerdauern einspritzplatzspezifisch" SWORD Mo_ti_us_q0p4 1 100 -13107.20 13106.80 FORMAT "%8.2" ECU_ADDRESS 0xC000C3B4 /end MEASUREMENT
/begin MEASUREMENT MoFInjDat_tiTDCSumET_mp00 "Summe der momentenwirksamen Ansteuerdauer zylinderspezifisch" SWORD Mo_ti_us_q0p4 1 100 -13107.20 13106.80 FORMAT "%8.2" ECU_ADDRESS 0xC000C3B6 /end MEASUREMENT
/begin MEASUREMENT MoFInjDat_tiTDCSumET_mp01 "Summe der momentenwirksamen Ansteuerdauer zylinderspezifisch" SWORD Mo_ti_us_q0p4 1 100 -13107.20 13106.80 FORMAT "%8.2" ECU_ADDRESS 0xC000C3B8 /end MEASUREMENT
/begin MEASUREMENT MoFInjDat_tiTDCSumET_mp02 "Summe der momentenwirksamen Ansteuerdauer zylinderspezifisch" SWORD Mo_ti_us_q0p4 1 100 -13107.20 13106.80 FORMAT "%8.2" ECU_ADDRESS 0xC000C3BA /end MEASUREMENT
/begin MEASUREMENT MoFInjDat_tiTDCSumET_mp03 "Summe der momentenwirksamen Ansteuerdauer zylinderspezifisch" SWORD Mo_ti_us_q0p4 1 100 -13107.20 13106.80 FORMAT "%8.2" ECU_ADDRESS 0xC000C3BC /end MEASUREMENT
/begin MEASUREMENT MoFInjDat_tiTDCSumET_mp04 "Summe der momentenwirksamen Ansteuerdauer zylinderspezifisch" SWORD Mo_ti_us_q0p4 1 100 -13107.20 13106.80 FORMAT "%8.2" ECU_ADDRESS 0xC000C3BE /end MEASUREMENT
/begin MEASUREMENT MoFInjDat_tiTDCSumET_mp05 "Summe der momentenwirksamen Ansteuerdauer zylinderspezifisch" SWORD Mo_ti_us_q0p4 1 100 -13107.20 13106.80 FORMAT "%8.2" ECU_ADDRESS 0xC000C3C0 /end MEASUREMENT
/begin MEASUREMENT MoFInjQnt_stChk_mp00 "Status der Checksummenprüfung beim Auslesen der IMA-Werte aus EEPROM Spiegel" UBYTE OneToOne 1 100 0.00 255.0 ECU_ADDRESS 0xC000C3C2 /begin ANNOTATION /end ANNOTATION /end MEASUREMENT
/begin MEASUREMENT MoFInjQnt_stChk_mp01 "Status der Checksummenprüfung beim Auslesen der IMA-Werte aus EEPROM Spiegel" UBYTE OneToOne 1 100 0.00 255.0 ECU_ADDRESS 0xC000C3C3 /begin ANNOTATION /end ANNOTATION /end MEASUREMENT
/begin MEASUREMENT MoFInjQnt_stChk_mp02 "Status der Checksummenprüfung beim Auslesen der IMA-Werte aus EEPROM Spiegel" UBYTE OneToOne 1 100 0.00 255.0 ECU_ADDRESS 0xC000C3C4 /begin ANNOTATION /end ANNOTATION /end MEASUREMENT
/begin MEASUREMENT MoFInjQnt_stChk_mp03 "Status der Checksummenprüfung beim Auslesen der IMA-Werte aus EEPROM Spiegel" UBYTE OneToOne 1 100 0.00 255.0 ECU_ADDRESS 0xC000C3C5 /begin ANNOTATION /end ANNOTATION /end MEASUREMENT
/begin MEASUREMENT MoFInjQnt_stChk_mp04 "Status der Checksummenprüfung beim Auslesen der IMA-Werte aus EEPROM Spiegel" UBYTE OneToOne 1 100 0.00 255.0 ECU_ADDRESS 0xC000C3C6 /begin ANNOTATION /end ANNOTATION /end MEASUREMENT
/begin MEASUREMENT MoFInjQnt_stChk_mp05 "Status der Checksummenprüfung beim Auslesen der IMA-Werte aus EEPROM Spiegel" UBYTE OneToOne 1 100 0.00 255.0 ECU_ADDRESS 0xC000C3C7 /begin ANNOTATION /end ANNOTATION /end MEASUREMENT
/begin MEASUREMENT MoFInjQnt_volCor00 "Abgleichwerte Injektormengenabgleich im Zylindermittel in der Funktionsüberwachung" SWORD Mo_vol_mm3_q0p01 1 100 -327.6800 327.6700 FORMAT "%8.4" ECU_ADDRESS 0xC000C3D8 /end MEASUREMENT
/begin MEASUREMENT MoFInjQnt_volCor01 "Abgleichwerte Injektormengenabgleich im Zylindermittel in der Funktionsüberwachung" SWORD Mo_vol_mm3_q0p01 1 100 -327.6800 327.6700 FORMAT "%8.4" ECU_ADDRESS 0xC000C3DA /end MEASUREMENT
/begin MEASUREMENT MoFInjQnt_volCor02 "Abgleichwerte Injektormengenabgleich im Zylindermittel in der Funktionsüberwachung" SWORD Mo_vol_mm3_q0p01 1 100 -327.6800 327.6700 FORMAT "%8.4" ECU_ADDRESS 0xC000C3DC /end MEASUREMENT
/begin MEASUREMENT MoFInjQnt_volCor03 "Abgleichwerte Injektormengenabgleich im Zylindermittel in der Funktionsüberwachung" SWORD Mo_vol_mm3_q0p01 1 100 -327.6800 327.6700 FORMAT "%8.4" ECU_ADDRESS 0xC000C3DE /end MEASUREMENT
/begin MEASUREMENT MoFInjQnt_volCor04 "Abgleichwerte Injektormengenabgleich im Zylindermittel in der Funktionsüberwachung" SWORD Mo_vol_mm3_q0p01 1 100 -327.6800 327.6700 FORMAT "%8.4" ECU_ADDRESS 0xC000C3E0 /end MEASUREMENT
/begin MEASUREMENT MoFInjQnt_volCor05 "Abgleichwerte Injektormengenabgleich im Zylindermittel in der Funktionsüberwachung" SWORD Mo_vol_mm3_q0p01 1 100 -327.6800 327.6700 FORMAT "%8.4" ECU_ADDRESS 0xC000C3E2 /end MEASUREMENT
/begin MEASUREMENT MoFInjQnt_volCor06 "Abgleichwerte Injektormengenabgleich im Zylindermittel in der Funktionsüberwachung" SWORD Mo_vol_mm3_q0p01 1 100 -327.6800 327.6700 FORMAT "%8.4" ECU_ADDRESS 0xC000C3E4 /end MEASUREMENT
/begin MEASUREMENT MoFInjQnt_volCor07 "Abgleichwerte Injektormengenabgleich im Zylindermittel in der Funktionsüberwachung" SWORD Mo_vol_mm3_q0p01 1 100 -327.6800 327.6700 FORMAT "%8.4" ECU_ADDRESS 0xC000C3E6 /end MEASUREMENT
/begin MEASUREMENT Msainfo00 "Infospeicher MSA" UBYTE Def_dez_ub_q1 1 100 0.00 255. FORMAT "%3.0" ECU_ADDRESS 0xC000B66D /end MEASUREMENT
/begin MEASUREMENT Msainfo01 "Infospeicher MSA" UBYTE Def_dez_ub_q1 1 100 0.00 255. FORMAT "%3.0" ECU_ADDRESS 0xC000B66E /end MEASUREMENT
/begin MEASUREMENT Msainfo02 "Infospeicher MSA" UBYTE Def_dez_ub_q1 1 100 0.00 255. FORMAT "%3.0" ECU_ADDRESS 0xC000B66F /end MEASUREMENT
/begin MEASUREMENT Msainfo03 "Infospeicher MSA" UBYTE Def_dez_ub_q1 1 100 0.00 255. FORMAT "%3.0" ECU_ADDRESS 0xC000B670 /end MEASUREMENT
/begin MEASUREMENT Msainfo04 "Infospeicher MSA" UBYTE Def_dez_ub_q1 1 100 0.00 255. FORMAT "%3.0" ECU_ADDRESS 0xC000B671 /end MEASUREMENT
/begin MEASUREMENT Msainfo05 "Infospeicher MSA" UBYTE Def_dez_ub_q1 1 100 0.00 255. FORMAT "%3.0" ECU_ADDRESS 0xC000B672 /end MEASUREMENT
/begin MEASUREMENT Msainfo06 "Infospeicher MSA" UBYTE Def_dez_ub_q1 1 100 0.00 255. FORMAT "%3.0" ECU_ADDRESS 0xC000B673 /end MEASUREMENT
/begin MEASUREMENT Msainfo07 "Infospeicher MSA" UBYTE Def_dez_ub_q1 1 100 0.00 255. FORMAT "%3.0" ECU_ADDRESS 0xC000B674 /end MEASUREMENT
/begin MEASUREMENT Msainfo08 "Infospeicher MSA" UBYTE Def_dez_ub_q1 1 100 0.00 255. FORMAT "%3.0" ECU_ADDRESS 0xC000B675 /end MEASUREMENT
/begin MEASUREMENT Msainfo09 "Infospeicher MSA" UBYTE Def_dez_ub_q1 1 100 0.00 255. FORMAT "%3.0" ECU_ADDRESS 0xC000B676 /end MEASUREMENT
/begin MEASUREMENT Msainfo10 "Infospeicher MSA" UBYTE Def_dez_ub_q1 1 100 0.00 255. FORMAT "%3.0" ECU_ADDRESS 0xC000B677 /end MEASUREMENT
/begin MEASUREMENT Msainfo11 "Infospeicher MSA" UBYTE Def_dez_ub_q1 1 100 0.00 255. FORMAT "%3.0" ECU_ADDRESS 0xC000B678 /end MEASUREMENT
/begin MEASUREMENT Msainfo12 "Infospeicher MSA" UBYTE Def_dez_ub_q1 1 100 0.00 255. FORMAT "%3.0" ECU_ADDRESS 0xC000B679 /end MEASUREMENT
/begin MEASUREMENT Msainfo13 "Infospeicher MSA" UBYTE Def_dez_ub_q1 1 100 0.00 255. FORMAT "%3.0" ECU_ADDRESS 0xC000B67A /end MEASUREMENT
/begin MEASUREMENT Msainfo14 "Infospeicher MSA" UBYTE Def_dez_ub_q1 1 100 0.00 255. FORMAT "%3.0" ECU_ADDRESS 0xC000B67B /end MEASUREMENT
/begin MEASUREMENT Msainfo15 "Infospeicher MSA" UBYTE Def_dez_ub_q1 1 100 0.00 255. FORMAT "%3.0" ECU_ADDRESS 0xC000B67C /end MEASUREMENT
/begin MEASUREMENT Msainfo16 "Infospeicher MSA" UBYTE Def_dez_ub_q1 1 100 0.00 255. FORMAT "%3.0" ECU_ADDRESS 0xC000B67D /end MEASUREMENT
/begin MEASUREMENT Msainfo17 "Infospeicher MSA" UBYTE Def_dez_ub_q1 1 100 0.00 255. FORMAT "%3.0" ECU_ADDRESS 0xC000B67E /end MEASUREMENT
/begin MEASUREMENT Msainfo18 "Infospeicher MSA" UBYTE Def_dez_ub_q1 1 100 0.00 255. FORMAT "%3.0" ECU_ADDRESS 0xC000B67F /end MEASUREMENT
/begin MEASUREMENT Msainfo19 "Infospeicher MSA" UBYTE Def_dez_ub_q1 1 100 0.00 255. FORMAT "%3.0" ECU_ADDRESS 0xC000B680 /end MEASUREMENT
/begin MEASUREMENT Msainfo20 "Infospeicher MSA" UBYTE Def_dez_ub_q1 1 100 0.00 255. FORMAT "%3.0" ECU_ADDRESS 0xC000B681 /end MEASUREMENT
/begin MEASUREMENT Msainfo21 "Infospeicher MSA" UBYTE Def_dez_ub_q1 1 100 0.00 255. FORMAT "%3.0" ECU_ADDRESS 0xC000B682 /end MEASUREMENT
/begin MEASUREMENT Msainfo22 "Infospeicher MSA" UBYTE Def_dez_ub_q1 1 100 0.00 255. FORMAT "%3.0" ECU_ADDRESS 0xC000B683 /end MEASUREMENT
/begin MEASUREMENT Msainfo23 "Infospeicher MSA" UBYTE Def_dez_ub_q1 1 100 0.00 255. FORMAT "%3.0" ECU_ADDRESS 0xC000B684 /end MEASUREMENT
/begin MEASUREMENT Msainfo24 "Infospeicher MSA" UBYTE Def_dez_ub_q1 1 100 0.00 255. FORMAT "%3.0" ECU_ADDRESS 0xC000B685 /end MEASUREMENT
/begin MEASUREMENT Msainfo25 "Infospeicher MSA" UBYTE Def_dez_ub_q1 1 100 0.00 255. FORMAT "%3.0" ECU_ADDRESS 0xC000B686 /end MEASUREMENT
/begin MEASUREMENT Msainfo26 "Infospeicher MSA" UBYTE Def_dez_ub_q1 1 100 0.00 255. FORMAT "%3.0" ECU_ADDRESS 0xC000B687 /end MEASUREMENT
/begin MEASUREMENT Msainfo27 "Infospeicher MSA" UBYTE Def_dez_ub_q1 1 100 0.00 255. FORMAT "%3.0" ECU_ADDRESS 0xC000B688 /end MEASUREMENT
/begin MEASUREMENT Msainfo28 "Infospeicher MSA" UBYTE Def_dez_ub_q1 1 100 0.00 255. FORMAT "%3.0" ECU_ADDRESS 0xC000B689 /end MEASUREMENT
/begin MEASUREMENT Msainfo29 "Infospeicher MSA" UBYTE Def_dez_ub_q1 1 100 0.00 255. FORMAT "%3.0" ECU_ADDRESS 0xC000B68A /end MEASUREMENT
/begin MEASUREMENT Msainfo30 "Infospeicher MSA" UBYTE Def_dez_ub_q1 1 100 0.00 255. FORMAT "%3.0" ECU_ADDRESS 0xC000B68B /end MEASUREMENT
/begin MEASUREMENT Msainfo31 "Infospeicher MSA" UBYTE Def_dez_ub_q1 1 100 0.00 255. FORMAT "%3.0" ECU_ADDRESS 0xC000B68C /end MEASUREMENT
/begin MEASUREMENT Msainfo32 "Infospeicher MSA" UBYTE Def_dez_ub_q1 1 100 0.00 255. FORMAT "%3.0" ECU_ADDRESS 0xC000B68D /end MEASUREMENT
/begin MEASUREMENT Msainfo33 "Infospeicher MSA" UBYTE Def_dez_ub_q1 1 100 0.00 255. FORMAT "%3.0" ECU_ADDRESS 0xC000B68E /end MEASUREMENT
/begin MEASUREMENT Msainfo34 "Infospeicher MSA" UBYTE Def_dez_ub_q1 1 100 0.00 255. FORMAT "%3.0" ECU_ADDRESS 0xC000B68F /end MEASUREMENT
/begin MEASUREMENT Msainfo35 "Infospeicher MSA" UBYTE Def_dez_ub_q1 1 100 0.00 255. FORMAT "%3.0" ECU_ADDRESS 0xC000B690 /end MEASUREMENT
/begin MEASUREMENT Msainfo36 "Infospeicher MSA" UBYTE Def_dez_ub_q1 1 100 0.00 255. FORMAT "%3.0" ECU_ADDRESS 0xC000B691 /end MEASUREMENT
/begin MEASUREMENT Msainfo37 "Infospeicher MSA" UBYTE Def_dez_ub_q1 1 100 0.00 255. FORMAT "%3.0" ECU_ADDRESS 0xC000B692 /end MEASUREMENT
/begin MEASUREMENT Msainfo38 "Infospeicher MSA" UBYTE Def_dez_ub_q1 1 100 0.00 255. FORMAT "%3.0" ECU_ADDRESS 0xC000B693 /end MEASUREMENT
/begin MEASUREMENT Msainfo39 "Infospeicher MSA" UBYTE Def_dez_ub_q1 1 100 0.00 255. FORMAT "%3.0" ECU_ADDRESS 0xC000B694 /end MEASUREMENT
/begin MEASUREMENT Msainfo40 "Infospeicher MSA" UBYTE Def_dez_ub_q1 1 100 0.00 255. FORMAT "%3.0" ECU_ADDRESS 0xC000B695 /end MEASUREMENT
/begin MEASUREMENT Msainfo41 "Infospeicher MSA" UBYTE Def_dez_ub_q1 1 100 0.00 255. FORMAT "%3.0" ECU_ADDRESS 0xC000B696 /end MEASUREMENT
/begin MEASUREMENT Msainfo42 "Infospeicher MSA" UBYTE Def_dez_ub_q1 1 100 0.00 255. FORMAT "%3.0" ECU_ADDRESS 0xC000B697 /end MEASUREMENT
/begin MEASUREMENT Msainfo43 "Infospeicher MSA" UBYTE Def_dez_ub_q1 1 100 0.00 255. FORMAT "%3.0" ECU_ADDRESS 0xC000B698 /end MEASUREMENT
/begin MEASUREMENT Msainfo44 "Infospeicher MSA" UBYTE Def_dez_ub_q1 1 100 0.00 255. FORMAT "%3.0" ECU_ADDRESS 0xC000B699 /end MEASUREMENT
/begin MEASUREMENT Msainfo45 "Infospeicher MSA" UBYTE Def_dez_ub_q1 1 100 0.00 255. FORMAT "%3.0" ECU_ADDRESS 0xC000B69A /end MEASUREMENT
/begin MEASUREMENT Msainfo46 "Infospeicher MSA" UBYTE Def_dez_ub_q1 1 100 0.00 255. FORMAT "%3.0" ECU_ADDRESS 0xC000B69B /end MEASUREMENT
/begin MEASUREMENT Msainfo47 "Infospeicher MSA" UBYTE Def_dez_ub_q1 1 100 0.00 255. FORMAT "%3.0" ECU_ADDRESS 0xC000B69C /end MEASUREMENT
/begin MEASUREMENT Msainfo48 "Infospeicher MSA" UBYTE Def_dez_ub_q1 1 100 0.00 255. FORMAT "%3.0" ECU_ADDRESS 0xC000B69D /end MEASUREMENT
/begin MEASUREMENT Msainfo49 "Infospeicher MSA" UBYTE Def_dez_ub_q1 1 100 0.00 255. FORMAT "%3.0" ECU_ADDRESS 0xC000B69E /end MEASUREMENT
/begin MEASUREMENT Msa_arravrs00 "AV Ringspeicher-Array" UBYTE Def_dez_ub_q1 1 100 0.00 255. FORMAT "%3.0" ECU_ADDRESS 0xC000C3E8 /end MEASUREMENT
/begin MEASUREMENT Msa_arravrs01 "AV Ringspeicher-Array" UBYTE Def_dez_ub_q1 1 100 0.00 255. FORMAT "%3.0" ECU_ADDRESS 0xC000C3E9 /end MEASUREMENT
/begin MEASUREMENT Msa_arravrs02 "AV Ringspeicher-Array" UBYTE Def_dez_ub_q1 1 100 0.00 255. FORMAT "%3.0" ECU_ADDRESS 0xC000C3EA /end MEASUREMENT
/begin MEASUREMENT Msa_arravrs03 "AV Ringspeicher-Array" UBYTE Def_dez_ub_q1 1 100 0.00 255. FORMAT "%3.0" ECU_ADDRESS 0xC000C3EB /end MEASUREMENT
/begin MEASUREMENT Msa_arravrs04 "AV Ringspeicher-Array" UBYTE Def_dez_ub_q1 1 100 0.00 255. FORMAT "%3.0" ECU_ADDRESS 0xC000C3EC /end MEASUREMENT
/begin MEASUREMENT Msa_arravrs05 "AV Ringspeicher-Array" UBYTE Def_dez_ub_q1 1 100 0.00 255. FORMAT "%3.0" ECU_ADDRESS 0xC000C3ED /end MEASUREMENT
/begin MEASUREMENT Msa_arravrs06 "AV Ringspeicher-Array" UBYTE Def_dez_ub_q1 1 100 0.00 255. FORMAT "%3.0" ECU_ADDRESS 0xC000C3EE /end MEASUREMENT
/begin MEASUREMENT Msa_arravrs07 "AV Ringspeicher-Array" UBYTE Def_dez_ub_q1 1 100 0.00 255. FORMAT "%3.0" ECU_ADDRESS 0xC000C3EF /end MEASUREMENT
/begin MEASUREMENT Msa_arravrs08 "AV Ringspeicher-Array" UBYTE Def_dez_ub_q1 1 100 0.00 255. FORMAT "%3.0" ECU_ADDRESS 0xC000C3F0 /end MEASUREMENT
/begin MEASUREMENT Msa_arravrs09 "AV Ringspeicher-Array" UBYTE Def_dez_ub_q1 1 100 0.00 255. FORMAT "%3.0" ECU_ADDRESS 0xC000C3F1 /end MEASUREMENT
/begin MEASUREMENT Msa_arravrs10 "AV Ringspeicher-Array" UBYTE Def_dez_ub_q1 1 100 0.00 255. FORMAT "%3.0" ECU_ADDRESS 0xC000C3F2 /end MEASUREMENT
/begin MEASUREMENT Msa_arravrs11 "AV Ringspeicher-Array" UBYTE Def_dez_ub_q1 1 100 0.00 255. FORMAT "%3.0" ECU_ADDRESS 0xC000C3F3 /end MEASUREMENT
/begin MEASUREMENT Msa_arravrs12 "AV Ringspeicher-Array" UBYTE Def_dez_ub_q1 1 100 0.00 255. FORMAT "%3.0" ECU_ADDRESS 0xC000C3F4 /end MEASUREMENT
/begin MEASUREMENT Msa_arravrs13 "AV Ringspeicher-Array" UBYTE Def_dez_ub_q1 1 100 0.00 255. FORMAT "%3.0" ECU_ADDRESS 0xC000C3F5 /end MEASUREMENT
/begin MEASUREMENT Msa_arravrs14 "AV Ringspeicher-Array" UBYTE Def_dez_ub_q1 1 100 0.00 255. FORMAT "%3.0" ECU_ADDRESS 0xC000C3F6 /end MEASUREMENT
/begin MEASUREMENT Msa_arravrs15 "AV Ringspeicher-Array" UBYTE Def_dez_ub_q1 1 100 0.00 255. FORMAT "%3.0" ECU_ADDRESS 0xC000C3F7 /end MEASUREMENT
/begin MEASUREMENT Msa_arravrs16 "AV Ringspeicher-Array" UBYTE Def_dez_ub_q1 1 100 0.00 255. FORMAT "%3.0" ECU_ADDRESS 0xC000C3F8 /end MEASUREMENT
/begin MEASUREMENT Msa_arravrs17 "AV Ringspeicher-Array" UBYTE Def_dez_ub_q1 1 100 0.00 255. FORMAT "%3.0" ECU_ADDRESS 0xC000C3F9 /end MEASUREMENT
/begin MEASUREMENT Msa_arravrs18 "AV Ringspeicher-Array" UBYTE Def_dez_ub_q1 1 100 0.00 255. FORMAT "%3.0" ECU_ADDRESS 0xC000C3FA /end MEASUREMENT
/begin MEASUREMENT Msa_arravrs19 "AV Ringspeicher-Array" UBYTE Def_dez_ub_q1 1 100 0.00 255. FORMAT "%3.0" ECU_ADDRESS 0xC000C3FB /end MEASUREMENT
/begin MEASUREMENT Msa_arravrs20 "AV Ringspeicher-Array" UBYTE Def_dez_ub_q1 1 100 0.00 255. FORMAT "%3.0" ECU_ADDRESS 0xC000C3FC /end MEASUREMENT
/begin MEASUREMENT Msa_arravrs21 "AV Ringspeicher-Array" UBYTE Def_dez_ub_q1 1 100 0.00 255. FORMAT "%3.0" ECU_ADDRESS 0xC000C3FD /end MEASUREMENT
/begin MEASUREMENT Msa_arravrs22 "AV Ringspeicher-Array" UBYTE Def_dez_ub_q1 1 100 0.00 255. FORMAT "%3.0" ECU_ADDRESS 0xC000C3FE /end MEASUREMENT
/begin MEASUREMENT Msa_arravrs23 "AV Ringspeicher-Array" UBYTE Def_dez_ub_q1 1 100 0.00 255. FORMAT "%3.0" ECU_ADDRESS 0xC000C3FF /end MEASUREMENT
/begin MEASUREMENT Msa_arravrs24 "AV Ringspeicher-Array" UBYTE Def_dez_ub_q1 1 100 0.00 255. FORMAT "%3.0" ECU_ADDRESS 0xC000C400 /end MEASUREMENT
/begin MEASUREMENT Msa_arravrs25 "AV Ringspeicher-Array" UBYTE Def_dez_ub_q1 1 100 0.00 255. FORMAT "%3.0" ECU_ADDRESS 0xC000C401 /end MEASUREMENT
/begin MEASUREMENT Msa_arravrs26 "AV Ringspeicher-Array" UBYTE Def_dez_ub_q1 1 100 0.00 255. FORMAT "%3.0" ECU_ADDRESS 0xC000C402 /end MEASUREMENT
/begin MEASUREMENT Msa_arravrs27 "AV Ringspeicher-Array" UBYTE Def_dez_ub_q1 1 100 0.00 255. FORMAT "%3.0" ECU_ADDRESS 0xC000C403 /end MEASUREMENT
/begin MEASUREMENT Msa_arravrs28 "AV Ringspeicher-Array" UBYTE Def_dez_ub_q1 1 100 0.00 255. FORMAT "%3.0" ECU_ADDRESS 0xC000C404 /end MEASUREMENT
/begin MEASUREMENT Msa_arravrs29 "AV Ringspeicher-Array" UBYTE Def_dez_ub_q1 1 100 0.00 255. FORMAT "%3.0" ECU_ADDRESS 0xC000C405 /end MEASUREMENT
/begin MEASUREMENT Msa_arravrs30 "AV Ringspeicher-Array" UBYTE Def_dez_ub_q1 1 100 0.00 255. FORMAT "%3.0" ECU_ADDRESS 0xC000C406 /end MEASUREMENT
/begin MEASUREMENT Msa_arravrs31 "AV Ringspeicher-Array" UBYTE Def_dez_ub_q1 1 100 0.00 255. FORMAT "%3.0" ECU_ADDRESS 0xC000C407 /end MEASUREMENT
/begin MEASUREMENT Msa_arravrs32 "AV Ringspeicher-Array" UBYTE Def_dez_ub_q1 1 100 0.00 255. FORMAT "%3.0" ECU_ADDRESS 0xC000C408 /end MEASUREMENT
/begin MEASUREMENT Msa_arravrs33 "AV Ringspeicher-Array" UBYTE Def_dez_ub_q1 1 100 0.00 255. FORMAT "%3.0" ECU_ADDRESS 0xC000C409 /end MEASUREMENT
/begin MEASUREMENT Msa_arravrs34 "AV Ringspeicher-Array" UBYTE Def_dez_ub_q1 1 100 0.00 255. FORMAT "%3.0" ECU_ADDRESS 0xC000C40A /end MEASUREMENT
/begin MEASUREMENT Msa_arravrs35 "AV Ringspeicher-Array" UBYTE Def_dez_ub_q1 1 100 0.00 255. FORMAT "%3.0" ECU_ADDRESS 0xC000C40B /end MEASUREMENT
/begin MEASUREMENT Msa_arravrs36 "AV Ringspeicher-Array" UBYTE Def_dez_ub_q1 1 100 0.00 255. FORMAT "%3.0" ECU_ADDRESS 0xC000C40C /end MEASUREMENT
/begin MEASUREMENT Msa_arravrs37 "AV Ringspeicher-Array" UBYTE Def_dez_ub_q1 1 100 0.00 255. FORMAT "%3.0" ECU_ADDRESS 0xC000C40D /end MEASUREMENT
/begin MEASUREMENT Msa_arravrs38 "AV Ringspeicher-Array" UBYTE Def_dez_ub_q1 1 100 0.00 255. FORMAT "%3.0" ECU_ADDRESS 0xC000C40E /end MEASUREMENT
/begin MEASUREMENT Msa_arravrs39 "AV Ringspeicher-Array" UBYTE Def_dez_ub_q1 1 100 0.00 255. FORMAT "%3.0" ECU_ADDRESS 0xC000C40F /end MEASUREMENT
/begin MEASUREMENT Msa_arravrs40 "AV Ringspeicher-Array" UBYTE Def_dez_ub_q1 1 100 0.00 255. FORMAT "%3.0" ECU_ADDRESS 0xC000C410 /end MEASUREMENT
/begin MEASUREMENT Msa_arravrs41 "AV Ringspeicher-Array" UBYTE Def_dez_ub_q1 1 100 0.00 255. FORMAT "%3.0" ECU_ADDRESS 0xC000C411 /end MEASUREMENT
/begin MEASUREMENT Msa_arravrs42 "AV Ringspeicher-Array" UBYTE Def_dez_ub_q1 1 100 0.00 255. FORMAT "%3.0" ECU_ADDRESS 0xC000C412 /end MEASUREMENT
/begin MEASUREMENT Msa_arravrs43 "AV Ringspeicher-Array" UBYTE Def_dez_ub_q1 1 100 0.00 255. FORMAT "%3.0" ECU_ADDRESS 0xC000C413 /end MEASUREMENT
/begin MEASUREMENT Msa_arravrs44 "AV Ringspeicher-Array" UBYTE Def_dez_ub_q1 1 100 0.00 255. FORMAT "%3.0" ECU_ADDRESS 0xC000C414 /end MEASUREMENT
/begin MEASUREMENT Msa_arravrs45 "AV Ringspeicher-Array" UBYTE Def_dez_ub_q1 1 100 0.00 255. FORMAT "%3.0" ECU_ADDRESS 0xC000C415 /end MEASUREMENT
/begin MEASUREMENT Msa_arravrs46 "AV Ringspeicher-Array" UBYTE Def_dez_ub_q1 1 100 0.00 255. FORMAT "%3.0" ECU_ADDRESS 0xC000C416 /end MEASUREMENT
/begin MEASUREMENT Msa_arravrs47 "AV Ringspeicher-Array" UBYTE Def_dez_ub_q1 1 100 0.00 255. FORMAT "%3.0" ECU_ADDRESS 0xC000C417 /end MEASUREMENT
/begin MEASUREMENT Msa_arravrs48 "AV Ringspeicher-Array" UBYTE Def_dez_ub_q1 1 100 0.00 255. FORMAT "%3.0" ECU_ADDRESS 0xC000C418 /end MEASUREMENT
/begin MEASUREMENT Msa_arravrs49 "AV Ringspeicher-Array" UBYTE Def_dez_ub_q1 1 100 0.00 255. FORMAT "%3.0" ECU_ADDRESS 0xC000C419 /end MEASUREMENT
/begin MEASUREMENT Msa_arravrs50 "AV Ringspeicher-Array" UBYTE Def_dez_ub_q1 1 100 0.00 255. FORMAT "%3.0" ECU_ADDRESS 0xC000C41A /end MEASUREMENT
/begin MEASUREMENT Msa_arravrs51 "AV Ringspeicher-Array" UBYTE Def_dez_ub_q1 1 100 0.00 255. FORMAT "%3.0" ECU_ADDRESS 0xC000C41B /end MEASUREMENT
/begin MEASUREMENT Msa_arravrs52 "AV Ringspeicher-Array" UBYTE Def_dez_ub_q1 1 100 0.00 255. FORMAT "%3.0" ECU_ADDRESS 0xC000C41C /end MEASUREMENT
/begin MEASUREMENT Msa_arravrs53 "AV Ringspeicher-Array" UBYTE Def_dez_ub_q1 1 100 0.00 255. FORMAT "%3.0" ECU_ADDRESS 0xC000C41D /end MEASUREMENT
/begin MEASUREMENT Msa_arravrs54 "AV Ringspeicher-Array" UBYTE Def_dez_ub_q1 1 100 0.00 255. FORMAT "%3.0" ECU_ADDRESS 0xC000C41E /end MEASUREMENT
/begin MEASUREMENT Msa_arravrs55 "AV Ringspeicher-Array" UBYTE Def_dez_ub_q1 1 100 0.00 255. FORMAT "%3.0" ECU_ADDRESS 0xC000C41F /end MEASUREMENT
/begin MEASUREMENT Msa_arravrs56 "AV Ringspeicher-Array" UBYTE Def_dez_ub_q1 1 100 0.00 255. FORMAT "%3.0" ECU_ADDRESS 0xC000C420 /end MEASUREMENT
/begin MEASUREMENT Msa_arravrs57 "AV Ringspeicher-Array" UBYTE Def_dez_ub_q1 1 100 0.00 255. FORMAT "%3.0" ECU_ADDRESS 0xC000C421 /end MEASUREMENT
/begin MEASUREMENT Msa_arravrs58 "AV Ringspeicher-Array" UBYTE Def_dez_ub_q1 1 100 0.00 255. FORMAT "%3.0" ECU_ADDRESS 0xC000C422 /end MEASUREMENT
/begin MEASUREMENT Msa_arravrs59 "AV Ringspeicher-Array" UBYTE Def_dez_ub_q1 1 100 0.00 255. FORMAT "%3.0" ECU_ADDRESS 0xC000C423 /end MEASUREMENT
/begin MEASUREMENT NSCLd_mNOxFld00 "" SLONG Ms_SOxNOx 1 100 -21474.8364800 21474.8364700 FORMAT "%13.7" ECU_ADDRESS 0xD0002F38 /end MEASUREMENT
/begin MEASUREMENT NSCLd_mNOxFld01 "" SLONG Ms_SOxNOx 1 100 -21474.8364800 21474.8364700 FORMAT "%13.7" ECU_ADDRESS 0xD0002F3C /end MEASUREMENT
/begin MEASUREMENT NSCLd_mNOxFld02 "" SLONG Ms_SOxNOx 1 100 -21474.8364800 21474.8364700 FORMAT "%13.7" ECU_ADDRESS 0xD0002F40 /end MEASUREMENT
/begin MEASUREMENT NSCLd_mNOxFld03 "" SLONG Ms_SOxNOx 1 100 -21474.8364800 21474.8364700 FORMAT "%13.7" ECU_ADDRESS 0xD0002F44 /end MEASUREMENT
/begin MEASUREMENT NSCLd_mNOxFld04 "" SLONG Ms_SOxNOx 1 100 -21474.8364800 21474.8364700 FORMAT "%13.7" ECU_ADDRESS 0xD0002F48 /end MEASUREMENT
/begin MEASUREMENT NSCLd_mNOxFld05 "" SLONG Ms_SOxNOx 1 100 -21474.8364800 21474.8364700 FORMAT "%13.7" ECU_ADDRESS 0xD0002F4C /end MEASUREMENT
/begin MEASUREMENT NSCLd_mNOxFld06 "" SLONG Ms_SOxNOx 1 100 -21474.8364800 21474.8364700 FORMAT "%13.7" ECU_ADDRESS 0xD0002F50 /end MEASUREMENT
/begin MEASUREMENT NSCLd_mNOxFld07 "" SLONG Ms_SOxNOx 1 100 -21474.8364800 21474.8364700 FORMAT "%13.7" ECU_ADDRESS 0xD0002F54 /end MEASUREMENT
/begin MEASUREMENT NSCLd_mNOxFld08 "" SLONG Ms_SOxNOx 1 100 -21474.8364800 21474.8364700 FORMAT "%13.7" ECU_ADDRESS 0xD0002F58 /end MEASUREMENT
/begin MEASUREMENT NSCLd_mNOxFld09 "" SLONG Ms_SOxNOx 1 100 -21474.8364800 21474.8364700 FORMAT "%13.7" ECU_ADDRESS 0xD0002F5C /end MEASUREMENT
/begin MEASUREMENT n_bar_sig_ews4_u3200 "" ULONG OneToOne 1 100 0.00 4294967295.00 ECU_ADDRESS 0xD0003600 /end MEASUREMENT
/begin MEASUREMENT n_bar_sig_ews4_u3201 "" ULONG OneToOne 1 100 0.00 4294967295.00 ECU_ADDRESS 0xD0003604 /end MEASUREMENT
/begin MEASUREMENT n_bar_sig_ews4_u3202 "" ULONG OneToOne 1 100 0.00 4294967295.00 ECU_ADDRESS 0xD0003608 /end MEASUREMENT
/begin MEASUREMENT n_bar_sig_ews4_u3203 "" ULONG OneToOne 1 100 0.00 4294967295.00 ECU_ADDRESS 0xD000360C /end MEASUREMENT
/begin MEASUREMENT n_bar_sig_ews4_u3204 "" ULONG OneToOne 1 100 0.00 4294967295.00 ECU_ADDRESS 0xD0003610 /end MEASUREMENT
/begin MEASUREMENT n_bar_sig_ews4_u3205 "" ULONG OneToOne 1 100 0.00 4294967295.00 ECU_ADDRESS 0xD0003614 /end MEASUREMENT
/begin MEASUREMENT n_bar_sig_ews4_u3206 "" ULONG OneToOne 1 100 0.00 4294967295.00 ECU_ADDRESS 0xD0003618 /end MEASUREMENT
/begin MEASUREMENT n_bar_sig_ews4_u3207 "" ULONG OneToOne 1 100 0.00 4294967295.00 ECU_ADDRESS 0xD000361C /end MEASUREMENT
/begin MEASUREMENT n_bar_sig_ews4_u3208 "" ULONG OneToOne 1 100 0.00 4294967295.00 ECU_ADDRESS 0xD0003620 /end MEASUREMENT
/begin MEASUREMENT n_bar_sig_ews4_u3209 "" ULONG OneToOne 1 100 0.00 4294967295.00 ECU_ADDRESS 0xD0003624 /end MEASUREMENT
/begin MEASUREMENT n_bar_sig_ews4_u3210 "" ULONG OneToOne 1 100 0.00 4294967295.00 ECU_ADDRESS 0xD0003628 /end MEASUREMENT
/begin MEASUREMENT n_bar_sig_ews4_u3211 "" ULONG OneToOne 1 100 0.00 4294967295.00 ECU_ADDRESS 0xD000362C /end MEASUREMENT
/begin MEASUREMENT n_bar_sig_ews4_u3212 "" ULONG OneToOne 1 100 0.00 4294967295.00 ECU_ADDRESS 0xD0003630 /end MEASUREMENT
/begin MEASUREMENT n_bar_sig_ews4_u3213 "" ULONG OneToOne 1 100 0.00 4294967295.00 ECU_ADDRESS 0xD0003634 /end MEASUREMENT
/begin MEASUREMENT n_bar_sig_ews4_u3214 "" ULONG OneToOne 1 100 0.00 4294967295.00 ECU_ADDRESS 0xD0003638 /end MEASUREMENT
/begin MEASUREMENT n_bar_sig_ews4_u3215 "" ULONG OneToOne 1 100 0.00 4294967295.00 ECU_ADDRESS 0xD000363C /end MEASUREMENT
/begin MEASUREMENT n_bar_sig_ews4_u3216 "" ULONG OneToOne 1 100 0.00 4294967295.00 ECU_ADDRESS 0xD0003640 /end MEASUREMENT
/begin MEASUREMENT n_bar_sig_ews4_u3217 "" ULONG OneToOne 1 100 0.00 4294967295.00 ECU_ADDRESS 0xD0003644 /end MEASUREMENT
/begin MEASUREMENT n_bar_sig_ews4_u3218 "" ULONG OneToOne 1 100 0.00 4294967295.00 ECU_ADDRESS 0xD0003648 /end MEASUREMENT
/begin MEASUREMENT n_bar_sig_ews4_u3219 "" ULONG OneToOne 1 100 0.00 4294967295.00 ECU_ADDRESS 0xD000364C /end MEASUREMENT
/begin MEASUREMENT n_bar_sig_ews4_u3220 "" ULONG OneToOne 1 100 0.00 4294967295.00 ECU_ADDRESS 0xD0003650 /end MEASUREMENT
/begin MEASUREMENT n_bar_sig_ews4_u3221 "" ULONG OneToOne 1 100 0.00 4294967295.00 ECU_ADDRESS 0xD0003654 /end MEASUREMENT
/begin MEASUREMENT n_bar_sig_ews4_u3222 "" ULONG OneToOne 1 100 0.00 4294967295.00 ECU_ADDRESS 0xD0003658 /end MEASUREMENT
/begin MEASUREMENT n_bar_sig_ews4_u3223 "" ULONG OneToOne 1 100 0.00 4294967295.00 ECU_ADDRESS 0xD000365C /end MEASUREMENT
/begin MEASUREMENT n_bar_sig_ews4_u3224 "" ULONG OneToOne 1 100 0.00 4294967295.00 ECU_ADDRESS 0xD0003660 /end MEASUREMENT
/begin MEASUREMENT n_bar_sig_ews4_u3225 "" ULONG OneToOne 1 100 0.00 4294967295.00 ECU_ADDRESS 0xD0003664 /end MEASUREMENT
/begin MEASUREMENT n_bar_sig_ews4_u3226 "" ULONG OneToOne 1 100 0.00 4294967295.00 ECU_ADDRESS 0xD0003668 /end MEASUREMENT
/begin MEASUREMENT n_bar_sig_ews4_u3227 "" ULONG OneToOne 1 100 0.00 4294967295.00 ECU_ADDRESS 0xD000366C /end MEASUREMENT
/begin MEASUREMENT n_bar_sig_ews4_u3228 "" ULONG OneToOne 1 100 0.00 4294967295.00 ECU_ADDRESS 0xD0003670 /end MEASUREMENT
/begin MEASUREMENT n_bar_sig_ews4_u3229 "" ULONG OneToOne 1 100 0.00 4294967295.00 ECU_ADDRESS 0xD0003674 /end MEASUREMENT
/begin MEASUREMENT n_bar_sig_ews4_u3230 "" ULONG OneToOne 1 100 0.00 4294967295.00 ECU_ADDRESS 0xD0003678 /end MEASUREMENT
/begin MEASUREMENT n_bar_sig_ews4_u3231 "" ULONG OneToOne 1 100 0.00 4294967295.00 ECU_ADDRESS 0xD000367C /end MEASUREMENT
/begin MEASUREMENT n_bar_sig_ews4_u3232 "" ULONG OneToOne 1 100 0.00 4294967295.00 ECU_ADDRESS 0xD0003680 /end MEASUREMENT
/begin MEASUREMENT n_bar_sig_ews4_u3233 "" ULONG OneToOne 1 100 0.00 4294967295.00 ECU_ADDRESS 0xD0003684 /end MEASUREMENT
/begin MEASUREMENT n_bar_sig_ews4_u3234 "" ULONG OneToOne 1 100 0.00 4294967295.00 ECU_ADDRESS 0xD0003688 /end MEASUREMENT
/begin MEASUREMENT n_bar_sig_ews4_u3235 "" ULONG OneToOne 1 100 0.00 4294967295.00 ECU_ADDRESS 0xD000368C /end MEASUREMENT
/begin MEASUREMENT n_bar_sig_ews4_u3236 "" ULONG OneToOne 1 100 0.00 4294967295.00 ECU_ADDRESS 0xD0003690 /end MEASUREMENT
/begin MEASUREMENT n_bar_sig_ews4_u3237 "" ULONG OneToOne 1 100 0.00 4294967295.00 ECU_ADDRESS 0xD0003694 /end MEASUREMENT
/begin MEASUREMENT n_bar_sig_ews4_u3238 "" ULONG OneToOne 1 100 0.00 4294967295.00 ECU_ADDRESS 0xD0003698 /end MEASUREMENT
/begin MEASUREMENT n_bar_sig_ews4_u3239 "" ULONG OneToOne 1 100 0.00 4294967295.00 ECU_ADDRESS 0xD000369C /end MEASUREMENT
/begin MEASUREMENT n_bar_sig_ews4_u3240 "" ULONG OneToOne 1 100 0.00 4294967295.00 ECU_ADDRESS 0xD00036A0 /end MEASUREMENT
/begin MEASUREMENT n_bar_sig_ews4_u3241 "" ULONG OneToOne 1 100 0.00 4294967295.00 ECU_ADDRESS 0xD00036A4 /end MEASUREMENT
/begin MEASUREMENT n_bar_sig_ews4_u3242 "" ULONG OneToOne 1 100 0.00 4294967295.00 ECU_ADDRESS 0xD00036A8 /end MEASUREMENT
/begin MEASUREMENT n_bar_sig_ews4_u3243 "" ULONG OneToOne 1 100 0.00 4294967295.00 ECU_ADDRESS 0xD00036AC /end MEASUREMENT
/begin MEASUREMENT n_bar_sig_ews4_u3244 "" ULONG OneToOne 1 100 0.00 4294967295.00 ECU_ADDRESS 0xD00036B0 /end MEASUREMENT
/begin MEASUREMENT n_bar_sig_ews4_u3245 "" ULONG OneToOne 1 100 0.00 4294967295.00 ECU_ADDRESS 0xD00036B4 /end MEASUREMENT
/begin MEASUREMENT n_bar_sig_ews4_u3246 "" ULONG OneToOne 1 100 0.00 4294967295.00 ECU_ADDRESS 0xD00036B8 /end MEASUREMENT
/begin MEASUREMENT n_bar_sig_ews4_u3247 "" ULONG OneToOne 1 100 0.00 4294967295.00 ECU_ADDRESS 0xD00036BC /end MEASUREMENT
/begin MEASUREMENT n_bar_sig_ews4_u3248 "" ULONG OneToOne 1 100 0.00 4294967295.00 ECU_ADDRESS 0xD00036C0 /end MEASUREMENT
/begin MEASUREMENT n_bar_sig_ews4_u3249 "" ULONG OneToOne 1 100 0.00 4294967295.00 ECU_ADDRESS 0xD00036C4 /end MEASUREMENT
/begin MEASUREMENT n_sig_ews4_u3200 "" ULONG OneToOne 1 100 0.00 4294967295.00 ECU_ADDRESS 0xD00036C8 /end MEASUREMENT
/begin MEASUREMENT n_sig_ews4_u3201 "" ULONG OneToOne 1 100 0.00 4294967295.00 ECU_ADDRESS 0xD00036CC /end MEASUREMENT
/begin MEASUREMENT n_sig_ews4_u3202 "" ULONG OneToOne 1 100 0.00 4294967295.00 ECU_ADDRESS 0xD00036D0 /end MEASUREMENT
/begin MEASUREMENT n_sig_ews4_u3203 "" ULONG OneToOne 1 100 0.00 4294967295.00 ECU_ADDRESS 0xD00036D4 /end MEASUREMENT
/begin MEASUREMENT n_sig_ews4_u3204 "" ULONG OneToOne 1 100 0.00 4294967295.00 ECU_ADDRESS 0xD00036D8 /end MEASUREMENT
/begin MEASUREMENT n_sig_ews4_u3205 "" ULONG OneToOne 1 100 0.00 4294967295.00 ECU_ADDRESS 0xD00036DC /end MEASUREMENT
/begin MEASUREMENT n_sig_ews4_u3206 "" ULONG OneToOne 1 100 0.00 4294967295.00 ECU_ADDRESS 0xD00036E0 /end MEASUREMENT
/begin MEASUREMENT n_sig_ews4_u3207 "" ULONG OneToOne 1 100 0.00 4294967295.00 ECU_ADDRESS 0xD00036E4 /end MEASUREMENT
/begin MEASUREMENT n_sig_ews4_u3208 "" ULONG OneToOne 1 100 0.00 4294967295.00 ECU_ADDRESS 0xD00036E8 /end MEASUREMENT
/begin MEASUREMENT n_sig_ews4_u3209 "" ULONG OneToOne 1 100 0.00 4294967295.00 ECU_ADDRESS 0xD00036EC /end MEASUREMENT
/begin MEASUREMENT n_sig_ews4_u3210 "" ULONG OneToOne 1 100 0.00 4294967295.00 ECU_ADDRESS 0xD00036F0 /end MEASUREMENT
/begin MEASUREMENT n_sig_ews4_u3211 "" ULONG OneToOne 1 100 0.00 4294967295.00 ECU_ADDRESS 0xD00036F4 /end MEASUREMENT
/begin MEASUREMENT n_sig_ews4_u3212 "" ULONG OneToOne 1 100 0.00 4294967295.00 ECU_ADDRESS 0xD00036F8 /end MEASUREMENT
/begin MEASUREMENT n_sig_ews4_u3213 "" ULONG OneToOne 1 100 0.00 4294967295.00 ECU_ADDRESS 0xD00036FC /end MEASUREMENT
/begin MEASUREMENT n_sig_ews4_u3214 "" ULONG OneToOne 1 100 0.00 4294967295.00 ECU_ADDRESS 0xD0003700 /end MEASUREMENT
/begin MEASUREMENT n_sig_ews4_u3215 "" ULONG OneToOne 1 100 0.00 4294967295.00 ECU_ADDRESS 0xD0003704 /end MEASUREMENT
/begin MEASUREMENT n_sig_ews4_u3216 "" ULONG OneToOne 1 100 0.00 4294967295.00 ECU_ADDRESS 0xD0003708 /end MEASUREMENT
/begin MEASUREMENT n_sig_ews4_u3217 "" ULONG OneToOne 1 100 0.00 4294967295.00 ECU_ADDRESS 0xD000370C /end MEASUREMENT
/begin MEASUREMENT n_sig_ews4_u3218 "" ULONG OneToOne 1 100 0.00 4294967295.00 ECU_ADDRESS 0xD0003710 /end MEASUREMENT
/begin MEASUREMENT n_sig_ews4_u3219 "" ULONG OneToOne 1 100 0.00 4294967295.00 ECU_ADDRESS 0xD0003714 /end MEASUREMENT
/begin MEASUREMENT n_sig_ews4_u3220 "" ULONG OneToOne 1 100 0.00 4294967295.00 ECU_ADDRESS 0xD0003718 /end MEASUREMENT
/begin MEASUREMENT n_sig_ews4_u3221 "" ULONG OneToOne 1 100 0.00 4294967295.00 ECU_ADDRESS 0xD000371C /end MEASUREMENT
/begin MEASUREMENT n_sig_ews4_u3222 "" ULONG OneToOne 1 100 0.00 4294967295.00 ECU_ADDRESS 0xD0003720 /end MEASUREMENT
/begin MEASUREMENT n_sig_ews4_u3223 "" ULONG OneToOne 1 100 0.00 4294967295.00 ECU_ADDRESS 0xD0003724 /end MEASUREMENT
/begin MEASUREMENT n_sig_ews4_u3224 "" ULONG OneToOne 1 100 0.00 4294967295.00 ECU_ADDRESS 0xD0003728 /end MEASUREMENT
/begin MEASUREMENT n_sig_ews4_u3225 "" ULONG OneToOne 1 100 0.00 4294967295.00 ECU_ADDRESS 0xD000372C /end MEASUREMENT
/begin MEASUREMENT n_sig_ews4_u3226 "" ULONG OneToOne 1 100 0.00 4294967295.00 ECU_ADDRESS 0xD0003730 /end MEASUREMENT
/begin MEASUREMENT n_sig_ews4_u3227 "" ULONG OneToOne 1 100 0.00 4294967295.00 ECU_ADDRESS 0xD0003734 /end MEASUREMENT
/begin MEASUREMENT n_sig_ews4_u3228 "" ULONG OneToOne 1 100 0.00 4294967295.00 ECU_ADDRESS 0xD0003738 /end MEASUREMENT
/begin MEASUREMENT n_sig_ews4_u3229 "" ULONG OneToOne 1 100 0.00 4294967295.00 ECU_ADDRESS 0xD000373C /end MEASUREMENT
/begin MEASUREMENT n_sig_ews4_u3230 "" ULONG OneToOne 1 100 0.00 4294967295.00 ECU_ADDRESS 0xD0003740 /end MEASUREMENT
/begin MEASUREMENT n_sig_ews4_u3231 "" ULONG OneToOne 1 100 0.00 4294967295.00 ECU_ADDRESS 0xD0003744 /end MEASUREMENT
/begin MEASUREMENT n_sig_ews4_u3232 "" ULONG OneToOne 1 100 0.00 4294967295.00 ECU_ADDRESS 0xD0003748 /end MEASUREMENT
/begin MEASUREMENT n_sig_ews4_u3233 "" ULONG OneToOne 1 100 0.00 4294967295.00 ECU_ADDRESS 0xD000374C /end MEASUREMENT
/begin MEASUREMENT n_sig_ews4_u3234 "" ULONG OneToOne 1 100 0.00 4294967295.00 ECU_ADDRESS 0xD0003750 /end MEASUREMENT
/begin MEASUREMENT n_sig_ews4_u3235 "" ULONG OneToOne 1 100 0.00 4294967295.00 ECU_ADDRESS 0xD0003754 /end MEASUREMENT
/begin MEASUREMENT n_sig_ews4_u3236 "" ULONG OneToOne 1 100 0.00 4294967295.00 ECU_ADDRESS 0xD0003758 /end MEASUREMENT
/begin MEASUREMENT n_sig_ews4_u3237 "" ULONG OneToOne 1 100 0.00 4294967295.00 ECU_ADDRESS 0xD000375C /end MEASUREMENT
/begin MEASUREMENT n_sig_ews4_u3238 "" ULONG OneToOne 1 100 0.00 4294967295.00 ECU_ADDRESS 0xD0003760 /end MEASUREMENT
/begin MEASUREMENT n_sig_ews4_u3239 "" ULONG OneToOne 1 100 0.00 4294967295.00 ECU_ADDRESS 0xD0003764 /end MEASUREMENT
/begin MEASUREMENT n_sig_ews4_u3240 "" ULONG OneToOne 1 100 0.00 4294967295.00 ECU_ADDRESS 0xD0003768 /end MEASUREMENT
/begin MEASUREMENT n_sig_ews4_u3241 "" ULONG OneToOne 1 100 0.00 4294967295.00 ECU_ADDRESS 0xD000376C /end MEASUREMENT
/begin MEASUREMENT n_sig_ews4_u3242 "" ULONG OneToOne 1 100 0.00 4294967295.00 ECU_ADDRESS 0xD0003770 /end MEASUREMENT
/begin MEASUREMENT n_sig_ews4_u3243 "" ULONG OneToOne 1 100 0.00 4294967295.00 ECU_ADDRESS 0xD0003774 /end MEASUREMENT
/begin MEASUREMENT n_sig_ews4_u3244 "" ULONG OneToOne 1 100 0.00 4294967295.00 ECU_ADDRESS 0xD0003778 /end MEASUREMENT
/begin MEASUREMENT n_sig_ews4_u3245 "" ULONG OneToOne 1 100 0.00 4294967295.00 ECU_ADDRESS 0xD000377C /end MEASUREMENT
/begin MEASUREMENT n_sig_ews4_u3246 "" ULONG OneToOne 1 100 0.00 4294967295.00 ECU_ADDRESS 0xD0003780 /end MEASUREMENT
/begin MEASUREMENT n_sig_ews4_u3247 "" ULONG OneToOne 1 100 0.00 4294967295.00 ECU_ADDRESS 0xD0003784 /end MEASUREMENT
/begin MEASUREMENT n_sig_ews4_u3248 "" ULONG OneToOne 1 100 0.00 4294967295.00 ECU_ADDRESS 0xD0003788 /end MEASUREMENT
/begin MEASUREMENT PCR_pDesVal3EOM_mp00 "Um die Temperatur korrigierte Ladedruck-Sollwerte für die vierte alternative Betriebsart" SWORD Pres_hPa 1 100 -32768.00 3500.00 ECU_ADDRESS 0xC000C428 /end MEASUREMENT
/begin MEASUREMENT PCR_pDesVal3EOM_mp01 "Um die Temperatur korrigierte Ladedruck-Sollwerte für die vierte alternative Betriebsart" SWORD Pres_hPa 1 100 -32768.00 3500.00 ECU_ADDRESS 0xC000C42A /end MEASUREMENT
/begin MEASUREMENT PCR_rCtlVal2EOM_mp00 "Um die Temperatur korrigierte Ladedruck-Steuerwerte für die vierte alternative Betriebsart" SWORD Prc 1 100 -400.0000 399.9878 ECU_ADDRESS 0xC000C424 /end MEASUREMENT
/begin MEASUREMENT PCR_rCtlVal2EOM_mp01 "Um die Temperatur korrigierte Ladedruck-Steuerwerte für die vierte alternative Betriebsart" SWORD Prc 1 100 -400.0000 399.9878 ECU_ADDRESS 0xC000C426 /end MEASUREMENT
/begin MEASUREMENT PhyMod_OpModeMsk00 "Betriebsmasken Feld" ULONG OneToOne 1 100 0.00 4294967295.00 ECU_ADDRESS 0xD0003288 /end MEASUREMENT
/begin MEASUREMENT PhyMod_OpModeMsk01 "Betriebsmasken Feld" ULONG OneToOne 1 100 0.00 4294967295.00 ECU_ADDRESS 0xD000328C /end MEASUREMENT
/begin MEASUREMENT PhyMod_OpModeMsk02 "Betriebsmasken Feld" ULONG OneToOne 1 100 0.00 4294967295.00 ECU_ADDRESS 0xD0003290 /end MEASUREMENT
/begin MEASUREMENT PhyMod_OpModeMsk03 "Betriebsmasken Feld" ULONG OneToOne 1 100 0.00 4294967295.00 ECU_ADDRESS 0xD0003294 /end MEASUREMENT
/begin MEASUREMENT PhyMod_OpModeMsk04 "Betriebsmasken Feld" ULONG OneToOne 1 100 0.00 4294967295.00 ECU_ADDRESS 0xD0003298 /end MEASUREMENT
/begin MEASUREMENT PhyMod_OpModeMsk05 "Betriebsmasken Feld" ULONG OneToOne 1 100 0.00 4294967295.00 ECU_ADDRESS 0xD000329C /end MEASUREMENT
/begin MEASUREMENT PhyMod_OpModeMsk06 "Betriebsmasken Feld" ULONG OneToOne 1 100 0.00 4294967295.00 ECU_ADDRESS 0xD00032A0 /end MEASUREMENT
/begin MEASUREMENT PhyMod_OpModeMsk07 "Betriebsmasken Feld" ULONG OneToOne 1 100 0.00 4294967295.00 ECU_ADDRESS 0xD00032A4 /end MEASUREMENT
/begin MEASUREMENT PhyMod_OpModeMsk08 "Betriebsmasken Feld" ULONG OneToOne 1 100 0.00 4294967295.00 ECU_ADDRESS 0xD00032A8 /end MEASUREMENT
/begin MEASUREMENT PhyMod_OpModeMsk09 "Betriebsmasken Feld" ULONG OneToOne 1 100 0.00 4294967295.00 ECU_ADDRESS 0xD00032AC /end MEASUREMENT
/begin MEASUREMENT Pmbackup00 "Array zum ständigen Sichern (alle 5 Sek) der Werte für die Individualdatenrettung beim Speichern" UBYTE Def_dez_ub_q1 1 100 0.00 255. FORMAT "%3.0" ECU_ADDRESS 0xC000B5B8 /end MEASUREMENT
/begin MEASUREMENT Pmbackup01 "Array zum ständigen Sichern (alle 5 Sek) der Werte für die Individualdatenrettung beim Speichern" UBYTE Def_dez_ub_q1 1 100 0.00 255. FORMAT "%3.0" ECU_ADDRESS 0xC000B5B9 /end MEASUREMENT
/begin MEASUREMENT Pmbackup02 "Array zum ständigen Sichern (alle 5 Sek) der Werte für die Individualdatenrettung beim Speichern" UBYTE Def_dez_ub_q1 1 100 0.00 255. FORMAT "%3.0" ECU_ADDRESS 0xC000B5BA /end MEASUREMENT
/begin MEASUREMENT Pmbackup03 "Array zum ständigen Sichern (alle 5 Sek) der Werte für die Individualdatenrettung beim Speichern" UBYTE Def_dez_ub_q1 1 100 0.00 255. FORMAT "%3.0" ECU_ADDRESS 0xC000B5BB /end MEASUREMENT
/begin MEASUREMENT Pmbackup04 "Array zum ständigen Sichern (alle 5 Sek) der Werte für die Individualdatenrettung beim Speichern" UBYTE Def_dez_ub_q1 1 100 0.00 255. FORMAT "%3.0" ECU_ADDRESS 0xC000B5BC /end MEASUREMENT
/begin MEASUREMENT Pmbackup05 "Array zum ständigen Sichern (alle 5 Sek) der Werte für die Individualdatenrettung beim Speichern" UBYTE Def_dez_ub_q1 1 100 0.00 255. FORMAT "%3.0" ECU_ADDRESS 0xC000B5BD /end MEASUREMENT
/begin MEASUREMENT Pmbackup06 "Array zum ständigen Sichern (alle 5 Sek) der Werte für die Individualdatenrettung beim Speichern" UBYTE Def_dez_ub_q1 1 100 0.00 255. FORMAT "%3.0" ECU_ADDRESS 0xC000B5BE /end MEASUREMENT
/begin MEASUREMENT Pminfo100 "Infospeicher 1 vom Powermanagement" UWORD Def_dez_uw_q1 1 100 0.00 65535. FORMAT "%5.0" ECU_ADDRESS 0xC000B5C0 /end MEASUREMENT
/begin MEASUREMENT Pminfo101 "Infospeicher 1 vom Powermanagement" UWORD Def_dez_uw_q1 1 100 0.00 65535. FORMAT "%5.0" ECU_ADDRESS 0xC000B5C2 /end MEASUREMENT
/begin MEASUREMENT Pminfo102 "Infospeicher 1 vom Powermanagement" UWORD Def_dez_uw_q1 1 100 0.00 65535. FORMAT "%5.0" ECU_ADDRESS 0xC000B5C4 /end MEASUREMENT
/begin MEASUREMENT Pminfo103 "Infospeicher 1 vom Powermanagement" UWORD Def_dez_uw_q1 1 100 0.00 65535. FORMAT "%5.0" ECU_ADDRESS 0xC000B5C6 /end MEASUREMENT
/begin MEASUREMENT Pminfo104 "Infospeicher 1 vom Powermanagement" UWORD Def_dez_uw_q1 1 100 0.00 65535. FORMAT "%5.0" ECU_ADDRESS 0xC000B5C8 /end MEASUREMENT
/begin MEASUREMENT Pminfo105 "Infospeicher 1 vom Powermanagement" UWORD Def_dez_uw_q1 1 100 0.00 65535. FORMAT "%5.0" ECU_ADDRESS 0xC000B5CA /end MEASUREMENT
/begin MEASUREMENT Pminfo106 "Infospeicher 1 vom Powermanagement" UWORD Def_dez_uw_q1 1 100 0.00 65535. FORMAT "%5.0" ECU_ADDRESS 0xC000B5CC /end MEASUREMENT
/begin MEASUREMENT Pminfo107 "Infospeicher 1 vom Powermanagement" UWORD Def_dez_uw_q1 1 100 0.00 65535. FORMAT "%5.0" ECU_ADDRESS 0xC000B5CE /end MEASUREMENT
/begin MEASUREMENT Pminfo108 "Infospeicher 1 vom Powermanagement" UWORD Def_dez_uw_q1 1 100 0.00 65535. FORMAT "%5.0" ECU_ADDRESS 0xC000B5D0 /end MEASUREMENT
/begin MEASUREMENT Pminfo109 "Infospeicher 1 vom Powermanagement" UWORD Def_dez_uw_q1 1 100 0.00 65535. FORMAT "%5.0" ECU_ADDRESS 0xC000B5D2 /end MEASUREMENT
/begin MEASUREMENT Pminfo110 "Infospeicher 1 vom Powermanagement" UWORD Def_dez_uw_q1 1 100 0.00 65535. FORMAT "%5.0" ECU_ADDRESS 0xC000B5D4 /end MEASUREMENT
/begin MEASUREMENT Pminfo111 "Infospeicher 1 vom Powermanagement" UWORD Def_dez_uw_q1 1 100 0.00 65535. FORMAT "%5.0" ECU_ADDRESS 0xC000B5D6 /end MEASUREMENT
/begin MEASUREMENT Pminfo112 "Infospeicher 1 vom Powermanagement" UWORD Def_dez_uw_q1 1 100 0.00 65535. FORMAT "%5.0" ECU_ADDRESS 0xC000B5D8 /end MEASUREMENT
/begin MEASUREMENT Pminfo113 "Infospeicher 1 vom Powermanagement" UWORD Def_dez_uw_q1 1 100 0.00 65535. FORMAT "%5.0" ECU_ADDRESS 0xC000B5DA /end MEASUREMENT
/begin MEASUREMENT Pminfo114 "Infospeicher 1 vom Powermanagement" UWORD Def_dez_uw_q1 1 100 0.00 65535. FORMAT "%5.0" ECU_ADDRESS 0xC000B5DC /end MEASUREMENT
/begin MEASUREMENT Pminfo115 "Infospeicher 1 vom Powermanagement" UWORD Def_dez_uw_q1 1 100 0.00 65535. FORMAT "%5.0" ECU_ADDRESS 0xC000B5DE /end MEASUREMENT
/begin MEASUREMENT Pminfo116 "Infospeicher 1 vom Powermanagement" UWORD Def_dez_uw_q1 1 100 0.00 65535. FORMAT "%5.0" ECU_ADDRESS 0xC000B5E0 /end MEASUREMENT
/begin MEASUREMENT Pminfo117 "Infospeicher 1 vom Powermanagement" UWORD Def_dez_uw_q1 1 100 0.00 65535. FORMAT "%5.0" ECU_ADDRESS 0xC000B5E2 /end MEASUREMENT
/begin MEASUREMENT Pminfo118 "Infospeicher 1 vom Powermanagement" UWORD Def_dez_uw_q1 1 100 0.00 65535. FORMAT "%5.0" ECU_ADDRESS 0xC000B5E4 /end MEASUREMENT
/begin MEASUREMENT Pminfo119 "Infospeicher 1 vom Powermanagement" UWORD Def_dez_uw_q1 1 100 0.00 65535. FORMAT "%5.0" ECU_ADDRESS 0xC000B5E6 /end MEASUREMENT
/begin MEASUREMENT Pminfo120 "Infospeicher 1 vom Powermanagement" UWORD Def_dez_uw_q1 1 100 0.00 65535. FORMAT "%5.0" ECU_ADDRESS 0xC000B5E8 /end MEASUREMENT
/begin MEASUREMENT Pminfo121 "Infospeicher 1 vom Powermanagement" UWORD Def_dez_uw_q1 1 100 0.00 65535. FORMAT "%5.0" ECU_ADDRESS 0xC000B5EA /end MEASUREMENT
/begin MEASUREMENT Pminfo122 "Infospeicher 1 vom Powermanagement" UWORD Def_dez_uw_q1 1 100 0.00 65535. FORMAT "%5.0" ECU_ADDRESS 0xC000B5EC /end MEASUREMENT
/begin MEASUREMENT Pminfo123 "Infospeicher 1 vom Powermanagement" UWORD Def_dez_uw_q1 1 100 0.00 65535. FORMAT "%5.0" ECU_ADDRESS 0xC000B5EE /end MEASUREMENT
/begin MEASUREMENT Pminfo124 "Infospeicher 1 vom Powermanagement" UWORD Def_dez_uw_q1 1 100 0.00 65535. FORMAT "%5.0" ECU_ADDRESS 0xC000B5F0 /end MEASUREMENT
/begin MEASUREMENT Pminfo125 "Infospeicher 1 vom Powermanagement" UWORD Def_dez_uw_q1 1 100 0.00 65535. FORMAT "%5.0" ECU_ADDRESS 0xC000B5F2 /end MEASUREMENT
/begin MEASUREMENT Pminfo126 "Infospeicher 1 vom Powermanagement" UWORD Def_dez_uw_q1 1 100 0.00 65535. FORMAT "%5.0" ECU_ADDRESS 0xC000B5F4 /end MEASUREMENT
/begin MEASUREMENT Pminfo127 "Infospeicher 1 vom Powermanagement" UWORD Def_dez_uw_q1 1 100 0.00 65535. FORMAT "%5.0" ECU_ADDRESS 0xC000B5F6 /end MEASUREMENT
/begin MEASUREMENT Pminfo128 "Infospeicher 1 vom Powermanagement" UWORD Def_dez_uw_q1 1 100 0.00 65535. FORMAT "%5.0" ECU_ADDRESS 0xC000B5F8 /end MEASUREMENT
/begin MEASUREMENT Pminfo129 "Infospeicher 1 vom Powermanagement" UWORD Def_dez_uw_q1 1 100 0.00 65535. FORMAT "%5.0" ECU_ADDRESS 0xC000B5FA /end MEASUREMENT
/begin MEASUREMENT Pminfo130 "Infospeicher 1 vom Powermanagement" UWORD Def_dez_uw_q1 1 100 0.00 65535. FORMAT "%5.0" ECU_ADDRESS 0xC000B5FC /end MEASUREMENT
/begin MEASUREMENT Pminfo131 "Infospeicher 1 vom Powermanagement" UWORD Def_dez_uw_q1 1 100 0.00 65535. FORMAT "%5.0" ECU_ADDRESS 0xC000B5FE /end MEASUREMENT
/begin MEASUREMENT Pminfo132 "Infospeicher 1 vom Powermanagement" UWORD Def_dez_uw_q1 1 100 0.00 65535. FORMAT "%5.0" ECU_ADDRESS 0xC000B600 /end MEASUREMENT
/begin MEASUREMENT Pminfo133 "Infospeicher 1 vom Powermanagement" UWORD Def_dez_uw_q1 1 100 0.00 65535. FORMAT "%5.0" ECU_ADDRESS 0xC000B602 /end MEASUREMENT
/begin MEASUREMENT Pminfo134 "Infospeicher 1 vom Powermanagement" UWORD Def_dez_uw_q1 1 100 0.00 65535. FORMAT "%5.0" ECU_ADDRESS 0xC000B604 /end MEASUREMENT
/begin MEASUREMENT Pminfo135 "Infospeicher 1 vom Powermanagement" UWORD Def_dez_uw_q1 1 100 0.00 65535. FORMAT "%5.0" ECU_ADDRESS 0xC000B606 /end MEASUREMENT
/begin MEASUREMENT Pminfo136 "Infospeicher 1 vom Powermanagement" UWORD Def_dez_uw_q1 1 100 0.00 65535. FORMAT "%5.0" ECU_ADDRESS 0xC000B608 /end MEASUREMENT
/begin MEASUREMENT Pminfo200 "Fehlerinfo2 vom Powermanagement" UBYTE Def_dez_ub_q1 1 100 0.00 255. FORMAT "%3.0" ECU_ADDRESS 0xC000B60A /end MEASUREMENT
/begin MEASUREMENT Pminfo201 "Fehlerinfo2 vom Powermanagement" UBYTE Def_dez_ub_q1 1 100 0.00 255. FORMAT "%3.0" ECU_ADDRESS 0xC000B60B /end MEASUREMENT
/begin MEASUREMENT Pminfo202 "Fehlerinfo2 vom Powermanagement" UBYTE Def_dez_ub_q1 1 100 0.00 255. FORMAT "%3.0" ECU_ADDRESS 0xC000B60C /end MEASUREMENT
/begin MEASUREMENT Pminfo203 "Fehlerinfo2 vom Powermanagement" UBYTE Def_dez_ub_q1 1 100 0.00 255. FORMAT "%3.0" ECU_ADDRESS 0xC000B60D /end MEASUREMENT
/begin MEASUREMENT Pminfo204 "Fehlerinfo2 vom Powermanagement" UBYTE Def_dez_ub_q1 1 100 0.00 255. FORMAT "%3.0" ECU_ADDRESS 0xC000B60E /end MEASUREMENT
/begin MEASUREMENT Pminfo205 "Fehlerinfo2 vom Powermanagement" UBYTE Def_dez_ub_q1 1 100 0.00 255. FORMAT "%3.0" ECU_ADDRESS 0xC000B60F /end MEASUREMENT
/begin MEASUREMENT Pminfo206 "Fehlerinfo2 vom Powermanagement" UBYTE Def_dez_ub_q1 1 100 0.00 255. FORMAT "%3.0" ECU_ADDRESS 0xC000B610 /end MEASUREMENT
/begin MEASUREMENT Pminfo207 "Fehlerinfo2 vom Powermanagement" UBYTE Def_dez_ub_q1 1 100 0.00 255. FORMAT "%3.0" ECU_ADDRESS 0xC000B611 /end MEASUREMENT
/begin MEASUREMENT Pminfo208 "Fehlerinfo2 vom Powermanagement" UBYTE Def_dez_ub_q1 1 100 0.00 255. FORMAT "%3.0" ECU_ADDRESS 0xC000B612 /end MEASUREMENT
/begin MEASUREMENT Pminfo209 "Fehlerinfo2 vom Powermanagement" UBYTE Def_dez_ub_q1 1 100 0.00 255. FORMAT "%3.0" ECU_ADDRESS 0xC000B613 /end MEASUREMENT
/begin MEASUREMENT Pminfo210 "Fehlerinfo2 vom Powermanagement" UBYTE Def_dez_ub_q1 1 100 0.00 255. FORMAT "%3.0" ECU_ADDRESS 0xC000B614 /end MEASUREMENT
/begin MEASUREMENT Pminfo211 "Fehlerinfo2 vom Powermanagement" UBYTE Def_dez_ub_q1 1 100 0.00 255. FORMAT "%3.0" ECU_ADDRESS 0xC000B615 /end MEASUREMENT
/begin MEASUREMENT Pminfo212 "Fehlerinfo2 vom Powermanagement" UBYTE Def_dez_ub_q1 1 100 0.00 255. FORMAT "%3.0" ECU_ADDRESS 0xC000B616 /end MEASUREMENT
/begin MEASUREMENT Pminfo213 "Fehlerinfo2 vom Powermanagement" UBYTE Def_dez_ub_q1 1 100 0.00 255. FORMAT "%3.0" ECU_ADDRESS 0xC000B617 /end MEASUREMENT
/begin MEASUREMENT Pminfo214 "Fehlerinfo2 vom Powermanagement" UBYTE Def_dez_ub_q1 1 100 0.00 255. FORMAT "%3.0" ECU_ADDRESS 0xC000B618 /end MEASUREMENT
/begin MEASUREMENT Pminfo215 "Fehlerinfo2 vom Powermanagement" UBYTE Def_dez_ub_q1 1 100 0.00 255. FORMAT "%3.0" ECU_ADDRESS 0xC000B619 /end MEASUREMENT
/begin MEASUREMENT Pminfo216 "Fehlerinfo2 vom Powermanagement" UBYTE Def_dez_ub_q1 1 100 0.00 255. FORMAT "%3.0" ECU_ADDRESS 0xC000B61A /end MEASUREMENT
/begin MEASUREMENT Pminfo217 "Fehlerinfo2 vom Powermanagement" UBYTE Def_dez_ub_q1 1 100 0.00 255. FORMAT "%3.0" ECU_ADDRESS 0xC000B61B /end MEASUREMENT
/begin MEASUREMENT Pminfo218 "Fehlerinfo2 vom Powermanagement" UBYTE Def_dez_ub_q1 1 100 0.00 255. FORMAT "%3.0" ECU_ADDRESS 0xC000B61C /end MEASUREMENT
/begin MEASUREMENT Pminfo219 "Fehlerinfo2 vom Powermanagement" UBYTE Def_dez_ub_q1 1 100 0.00 255. FORMAT "%3.0" ECU_ADDRESS 0xC000B61D /end MEASUREMENT
/begin MEASUREMENT Pminfo220 "Fehlerinfo2 vom Powermanagement" UBYTE Def_dez_ub_q1 1 100 0.00 255. FORMAT "%3.0" ECU_ADDRESS 0xC000B61E /end MEASUREMENT
/begin MEASUREMENT Pminfo221 "Fehlerinfo2 vom Powermanagement" UBYTE Def_dez_ub_q1 1 100 0.00 255. FORMAT "%3.0" ECU_ADDRESS 0xC000B61F /end MEASUREMENT
/begin MEASUREMENT Pminfo222 "Fehlerinfo2 vom Powermanagement" UBYTE Def_dez_ub_q1 1 100 0.00 255. FORMAT "%3.0" ECU_ADDRESS 0xC000B620 /end MEASUREMENT
/begin MEASUREMENT Pminfo223 "Fehlerinfo2 vom Powermanagement" UBYTE Def_dez_ub_q1 1 100 0.00 255. FORMAT "%3.0" ECU_ADDRESS 0xC000B621 /end MEASUREMENT
/begin MEASUREMENT Pminfo224 "Fehlerinfo2 vom Powermanagement" UBYTE Def_dez_ub_q1 1 100 0.00 255. FORMAT "%3.0" ECU_ADDRESS 0xC000B622 /end MEASUREMENT
/begin MEASUREMENT Pminfo225 "Fehlerinfo2 vom Powermanagement" UBYTE Def_dez_ub_q1 1 100 0.00 255. FORMAT "%3.0" ECU_ADDRESS 0xC000B623 /end MEASUREMENT
/begin MEASUREMENT Pminfo226 "Fehlerinfo2 vom Powermanagement" UBYTE Def_dez_ub_q1 1 100 0.00 255. FORMAT "%3.0" ECU_ADDRESS 0xC000B624 /end MEASUREMENT
/begin MEASUREMENT Pminfo227 "Fehlerinfo2 vom Powermanagement" UBYTE Def_dez_ub_q1 1 100 0.00 255. FORMAT "%3.0" ECU_ADDRESS 0xC000B625 /end MEASUREMENT
/begin MEASUREMENT Pminfo228 "Fehlerinfo2 vom Powermanagement" UBYTE Def_dez_ub_q1 1 100 0.00 255. FORMAT "%3.0" ECU_ADDRESS 0xC000B626 /end MEASUREMENT
/begin MEASUREMENT Pmrestore00 "Restorespeicher" UBYTE Def_dez_ub_q1 1 100 0.00 255. FORMAT "%3.0" ECU_ADDRESS 0xC000C2FC /end MEASUREMENT
/begin MEASUREMENT Pmrestore01 "Restorespeicher" UBYTE Def_dez_ub_q1 1 100 0.00 255. FORMAT "%3.0" ECU_ADDRESS 0xC000C2FD /end MEASUREMENT
/begin MEASUREMENT Pmrestore02 "Restorespeicher" UBYTE Def_dez_ub_q1 1 100 0.00 255. FORMAT "%3.0" ECU_ADDRESS 0xC000C2FE /end MEASUREMENT
/begin MEASUREMENT Pmrestore03 "Restorespeicher" UBYTE Def_dez_ub_q1 1 100 0.00 255. FORMAT "%3.0" ECU_ADDRESS 0xC000C2FF /end MEASUREMENT
/begin MEASUREMENT Pmrestore04 "Restorespeicher" UBYTE Def_dez_ub_q1 1 100 0.00 255. FORMAT "%3.0" ECU_ADDRESS 0xC000C300 /end MEASUREMENT
/begin MEASUREMENT Pmrestore05 "Restorespeicher" UBYTE Def_dez_ub_q1 1 100 0.00 255. FORMAT "%3.0" ECU_ADDRESS 0xC000C301 /end MEASUREMENT
/begin MEASUREMENT Pmrestore06 "Restorespeicher" UBYTE Def_dez_ub_q1 1 100 0.00 255. FORMAT "%3.0" ECU_ADDRESS 0xC000C302 /end MEASUREMENT
/begin MEASUREMENT Pmsv00 "angemeldete Powermanagment Standverbraucher" UBYTE Def_dez_ub_q1 1 100 0.00 255. FORMAT "%3.0" ECU_ADDRESS 0xC000C303 /end MEASUREMENT
/begin MEASUREMENT Pmsv01 "angemeldete Powermanagment Standverbraucher" UBYTE Def_dez_ub_q1 1 100 0.00 255. FORMAT "%3.0" ECU_ADDRESS 0xC000C304 /end MEASUREMENT
/begin MEASUREMENT Pmsv02 "angemeldete Powermanagment Standverbraucher" UBYTE Def_dez_ub_q1 1 100 0.00 255. FORMAT "%3.0" ECU_ADDRESS 0xC000C305 /end MEASUREMENT
/begin MEASUREMENT Pmsv03 "angemeldete Powermanagment Standverbraucher" UBYTE Def_dez_ub_q1 1 100 0.00 255. FORMAT "%3.0" ECU_ADDRESS 0xC000C306 /end MEASUREMENT
/begin MEASUREMENT Pmsv04 "angemeldete Powermanagment Standverbraucher" UBYTE Def_dez_ub_q1 1 100 0.00 255. FORMAT "%3.0" ECU_ADDRESS 0xC000C307 /end MEASUREMENT
/begin MEASUREMENT Pmsv05 "angemeldete Powermanagment Standverbraucher" UBYTE Def_dez_ub_q1 1 100 0.00 255. FORMAT "%3.0" ECU_ADDRESS 0xC000C308 /end MEASUREMENT
/begin MEASUREMENT Pmsv06 "angemeldete Powermanagment Standverbraucher" UBYTE Def_dez_ub_q1 1 100 0.00 255. FORMAT "%3.0" ECU_ADDRESS 0xC000C309 /end MEASUREMENT
/begin MEASUREMENT Pmsv07 "angemeldete Powermanagment Standverbraucher" UBYTE Def_dez_ub_q1 1 100 0.00 255. FORMAT "%3.0" ECU_ADDRESS 0xC000C30A /end MEASUREMENT
/begin MEASUREMENT Pmsv08 "angemeldete Powermanagment Standverbraucher" UBYTE Def_dez_ub_q1 1 100 0.00 255. FORMAT "%3.0" ECU_ADDRESS 0xC000C30B /end MEASUREMENT
/begin MEASUREMENT Pmsv09 "angemeldete Powermanagment Standverbraucher" UBYTE Def_dez_ub_q1 1 100 0.00 255. FORMAT "%3.0" ECU_ADDRESS 0xC000C30C /end MEASUREMENT
/begin MEASUREMENT Pmsv10 "angemeldete Powermanagment Standverbraucher" UBYTE Def_dez_ub_q1 1 100 0.00 255. FORMAT "%3.0" ECU_ADDRESS 0xC000C30D /end MEASUREMENT
/begin MEASUREMENT Pmsv11 "angemeldete Powermanagment Standverbraucher" UBYTE Def_dez_ub_q1 1 100 0.00 255. FORMAT "%3.0" ECU_ADDRESS 0xC000C30E /end MEASUREMENT
/begin MEASUREMENT Pmsv12 "angemeldete Powermanagment Standverbraucher" UBYTE Def_dez_ub_q1 1 100 0.00 255. FORMAT "%3.0" ECU_ADDRESS 0xC000C30F /end MEASUREMENT
/begin MEASUREMENT Pmsv13 "angemeldete Powermanagment Standverbraucher" UBYTE Def_dez_ub_q1 1 100 0.00 255. FORMAT "%3.0" ECU_ADDRESS 0xC000C310 /end MEASUREMENT
/begin MEASUREMENT Pmsv14 "angemeldete Powermanagment Standverbraucher" UBYTE Def_dez_ub_q1 1 100 0.00 255. FORMAT "%3.0" ECU_ADDRESS 0xC000C311 /end MEASUREMENT
/begin MEASUREMENT PosMCCtl_r00 "" SWORD Prc_Fact100 1 100 -327.6800 327.6700 FORMAT "%8.4" ECU_ADDRESS 0xD0001250 /end MEASUREMENT
/begin MEASUREMENT PosMCCtl_r01 "" SWORD Prc_Fact100 1 100 -327.6800 327.6700 FORMAT "%8.4" ECU_ADDRESS 0xD0001252 /end MEASUREMENT
/begin MEASUREMENT PosMCCtl_r02 "" SWORD Prc_Fact100 1 100 -327.6800 327.6700 FORMAT "%8.4" ECU_ADDRESS 0xD0001254 /end MEASUREMENT
/begin MEASUREMENT PosMCCtl_r03 "" SWORD Prc_Fact100 1 100 -327.6800 327.6700 FORMAT "%8.4" ECU_ADDRESS 0xD0001256 /end MEASUREMENT
/begin MEASUREMENT PosMCCtl_r04 "" SWORD Prc_Fact100 1 100 -327.6800 327.6700 FORMAT "%8.4" ECU_ADDRESS 0xD0001258 /end MEASUREMENT
/begin MEASUREMENT PosMCCtl_r05 "" SWORD Prc_Fact100 1 100 -327.6800 327.6700 FORMAT "%8.4" ECU_ADDRESS 0xD000125A /end MEASUREMENT
/begin MEASUREMENT Qvary_i00 "Startauswertung Messwertarray Strom" UWORD Def_i_uw_q0p02 1 100 0.00 1310.700 FORMAT "%8.3" ECU_ADDRESS 0xC000BF84 /end MEASUREMENT
/begin MEASUREMENT Qvary_i01 "Startauswertung Messwertarray Strom" UWORD Def_i_uw_q0p02 1 100 0.00 1310.700 FORMAT "%8.3" ECU_ADDRESS 0xC000BF86 /end MEASUREMENT
/begin MEASUREMENT Qvary_i02 "Startauswertung Messwertarray Strom" UWORD Def_i_uw_q0p02 1 100 0.00 1310.700 FORMAT "%8.3" ECU_ADDRESS 0xC000BF88 /end MEASUREMENT
/begin MEASUREMENT Qvary_i03 "Startauswertung Messwertarray Strom" UWORD Def_i_uw_q0p02 1 100 0.00 1310.700 FORMAT "%8.3" ECU_ADDRESS 0xC000BF8A /end MEASUREMENT
/begin MEASUREMENT Qvary_i04 "Startauswertung Messwertarray Strom" UWORD Def_i_uw_q0p02 1 100 0.00 1310.700 FORMAT "%8.3" ECU_ADDRESS 0xC000BF8C /end MEASUREMENT
/begin MEASUREMENT Qvary_i05 "Startauswertung Messwertarray Strom" UWORD Def_i_uw_q0p02 1 100 0.00 1310.700 FORMAT "%8.3" ECU_ADDRESS 0xC000BF8E /end MEASUREMENT
/begin MEASUREMENT Qvary_i06 "Startauswertung Messwertarray Strom" UWORD Def_i_uw_q0p02 1 100 0.00 1310.700 FORMAT "%8.3" ECU_ADDRESS 0xC000BF90 /end MEASUREMENT
/begin MEASUREMENT Qvary_i07 "Startauswertung Messwertarray Strom" UWORD Def_i_uw_q0p02 1 100 0.00 1310.700 FORMAT "%8.3" ECU_ADDRESS 0xC000BF92 /end MEASUREMENT
/begin MEASUREMENT Qvary_i08 "Startauswertung Messwertarray Strom" UWORD Def_i_uw_q0p02 1 100 0.00 1310.700 FORMAT "%8.3" ECU_ADDRESS 0xC000BF94 /end MEASUREMENT
/begin MEASUREMENT Qvary_i09 "Startauswertung Messwertarray Strom" UWORD Def_i_uw_q0p02 1 100 0.00 1310.700 FORMAT "%8.3" ECU_ADDRESS 0xC000BF96 /end MEASUREMENT
/begin MEASUREMENT Qvary_i10 "Startauswertung Messwertarray Strom" UWORD Def_i_uw_q0p02 1 100 0.00 1310.700 FORMAT "%8.3" ECU_ADDRESS 0xC000BF98 /end MEASUREMENT
/begin MEASUREMENT Qvary_i11 "Startauswertung Messwertarray Strom" UWORD Def_i_uw_q0p02 1 100 0.00 1310.700 FORMAT "%8.3" ECU_ADDRESS 0xC000BF9A /end MEASUREMENT
/begin MEASUREMENT Qvary_i12 "Startauswertung Messwertarray Strom" UWORD Def_i_uw_q0p02 1 100 0.00 1310.700 FORMAT "%8.3" ECU_ADDRESS 0xC000BF9C /end MEASUREMENT
/begin MEASUREMENT Qvary_i13 "Startauswertung Messwertarray Strom" UWORD Def_i_uw_q0p02 1 100 0.00 1310.700 FORMAT "%8.3" ECU_ADDRESS 0xC000BF9E /end MEASUREMENT
/begin MEASUREMENT Qvary_i14 "Startauswertung Messwertarray Strom" UWORD Def_i_uw_q0p02 1 100 0.00 1310.700 FORMAT "%8.3" ECU_ADDRESS 0xC000BFA0 /end MEASUREMENT
/begin MEASUREMENT Qvary_i15 "Startauswertung Messwertarray Strom" UWORD Def_i_uw_q0p02 1 100 0.00 1310.700 FORMAT "%8.3" ECU_ADDRESS 0xC000BFA2 /end MEASUREMENT
/begin MEASUREMENT Qvary_i16 "Startauswertung Messwertarray Strom" UWORD Def_i_uw_q0p02 1 100 0.00 1310.700 FORMAT "%8.3" ECU_ADDRESS 0xC000BFA4 /end MEASUREMENT
/begin MEASUREMENT Qvary_i17 "Startauswertung Messwertarray Strom" UWORD Def_i_uw_q0p02 1 100 0.00 1310.700 FORMAT "%8.3" ECU_ADDRESS 0xC000BFA6 /end MEASUREMENT
/begin MEASUREMENT Qvary_i18 "Startauswertung Messwertarray Strom" UWORD Def_i_uw_q0p02 1 100 0.00 1310.700 FORMAT "%8.3" ECU_ADDRESS 0xC000BFA8 /end MEASUREMENT
/begin MEASUREMENT Qvary_i19 "Startauswertung Messwertarray Strom" UWORD Def_i_uw_q0p02 1 100 0.00 1310.700 FORMAT "%8.3" ECU_ADDRESS 0xC000BFAA /end MEASUREMENT
/begin MEASUREMENT Qvary_i20 "Startauswertung Messwertarray Strom" UWORD Def_i_uw_q0p02 1 100 0.00 1310.700 FORMAT "%8.3" ECU_ADDRESS 0xC000BFAC /end MEASUREMENT
/begin MEASUREMENT Qvary_i21 "Startauswertung Messwertarray Strom" UWORD Def_i_uw_q0p02 1 100 0.00 1310.700 FORMAT "%8.3" ECU_ADDRESS 0xC000BFAE /end MEASUREMENT
/begin MEASUREMENT Qvary_i22 "Startauswertung Messwertarray Strom" UWORD Def_i_uw_q0p02 1 100 0.00 1310.700 FORMAT "%8.3" ECU_ADDRESS 0xC000BFB0 /end MEASUREMENT
/begin MEASUREMENT Qvary_i23 "Startauswertung Messwertarray Strom" UWORD Def_i_uw_q0p02 1 100 0.00 1310.700 FORMAT "%8.3" ECU_ADDRESS 0xC000BFB2 /end MEASUREMENT
/begin MEASUREMENT Qvary_i24 "Startauswertung Messwertarray Strom" UWORD Def_i_uw_q0p02 1 100 0.00 1310.700 FORMAT "%8.3" ECU_ADDRESS 0xC000BFB4 /end MEASUREMENT
/begin MEASUREMENT Qvary_i25 "Startauswertung Messwertarray Strom" UWORD Def_i_uw_q0p02 1 100 0.00 1310.700 FORMAT "%8.3" ECU_ADDRESS 0xC000BFB6 /end MEASUREMENT
/begin MEASUREMENT Qvary_i26 "Startauswertung Messwertarray Strom" UWORD Def_i_uw_q0p02 1 100 0.00 1310.700 FORMAT "%8.3" ECU_ADDRESS 0xC000BFB8 /end MEASUREMENT
/begin MEASUREMENT Qvary_i27 "Startauswertung Messwertarray Strom" UWORD Def_i_uw_q0p02 1 100 0.00 1310.700 FORMAT "%8.3" ECU_ADDRESS 0xC000BFBA /end MEASUREMENT
/begin MEASUREMENT Qvary_i28 "Startauswertung Messwertarray Strom" UWORD Def_i_uw_q0p02 1 100 0.00 1310.700 FORMAT "%8.3" ECU_ADDRESS 0xC000BFBC /end MEASUREMENT
/begin MEASUREMENT Qvary_i29 "Startauswertung Messwertarray Strom" UWORD Def_i_uw_q0p02 1 100 0.00 1310.700 FORMAT "%8.3" ECU_ADDRESS 0xC000BFBE /end MEASUREMENT
/begin MEASUREMENT Qvary_i30 "Startauswertung Messwertarray Strom" UWORD Def_i_uw_q0p02 1 100 0.00 1310.700 FORMAT "%8.3" ECU_ADDRESS 0xC000BFC0 /end MEASUREMENT
/begin MEASUREMENT Qvary_i31 "Startauswertung Messwertarray Strom" UWORD Def_i_uw_q0p02 1 100 0.00 1310.700 FORMAT "%8.3" ECU_ADDRESS 0xC000BFC2 /end MEASUREMENT
/begin MEASUREMENT Qvary_u00 "Startauswertung Messwertarray Spannung" UWORD Def_u_uw_q0p25em3_o6 1 100 6.0000000 22.383750 FORMAT "%9.6" ECU_ADDRESS 0xC000BFC4 /end MEASUREMENT
/begin MEASUREMENT Qvary_u01 "Startauswertung Messwertarray Spannung" UWORD Def_u_uw_q0p25em3_o6 1 100 6.0000000 22.383750 FORMAT "%9.6" ECU_ADDRESS 0xC000BFC6 /end MEASUREMENT
/begin MEASUREMENT Qvary_u02 "Startauswertung Messwertarray Spannung" UWORD Def_u_uw_q0p25em3_o6 1 100 6.0000000 22.383750 FORMAT "%9.6" ECU_ADDRESS 0xC000BFC8 /end MEASUREMENT
/begin MEASUREMENT Qvary_u03 "Startauswertung Messwertarray Spannung" UWORD Def_u_uw_q0p25em3_o6 1 100 6.0000000 22.383750 FORMAT "%9.6" ECU_ADDRESS 0xC000BFCA /end MEASUREMENT
/begin MEASUREMENT Qvary_u04 "Startauswertung Messwertarray Spannung" UWORD Def_u_uw_q0p25em3_o6 1 100 6.0000000 22.383750 FORMAT "%9.6" ECU_ADDRESS 0xC000BFCC /end MEASUREMENT
/begin MEASUREMENT Qvary_u05 "Startauswertung Messwertarray Spannung" UWORD Def_u_uw_q0p25em3_o6 1 100 6.0000000 22.383750 FORMAT "%9.6" ECU_ADDRESS 0xC000BFCE /end MEASUREMENT
/begin MEASUREMENT Qvary_u06 "Startauswertung Messwertarray Spannung" UWORD Def_u_uw_q0p25em3_o6 1 100 6.0000000 22.383750 FORMAT "%9.6" ECU_ADDRESS 0xC000BFD0 /end MEASUREMENT
/begin MEASUREMENT Qvary_u07 "Startauswertung Messwertarray Spannung" UWORD Def_u_uw_q0p25em3_o6 1 100 6.0000000 22.383750 FORMAT "%9.6" ECU_ADDRESS 0xC000BFD2 /end MEASUREMENT
/begin MEASUREMENT Qvary_u08 "Startauswertung Messwertarray Spannung" UWORD Def_u_uw_q0p25em3_o6 1 100 6.0000000 22.383750 FORMAT "%9.6" ECU_ADDRESS 0xC000BFD4 /end MEASUREMENT
/begin MEASUREMENT Qvary_u09 "Startauswertung Messwertarray Spannung" UWORD Def_u_uw_q0p25em3_o6 1 100 6.0000000 22.383750 FORMAT "%9.6" ECU_ADDRESS 0xC000BFD6 /end MEASUREMENT
/begin MEASUREMENT Qvary_u10 "Startauswertung Messwertarray Spannung" UWORD Def_u_uw_q0p25em3_o6 1 100 6.0000000 22.383750 FORMAT "%9.6" ECU_ADDRESS 0xC000BFD8 /end MEASUREMENT
/begin MEASUREMENT Qvary_u11 "Startauswertung Messwertarray Spannung" UWORD Def_u_uw_q0p25em3_o6 1 100 6.0000000 22.383750 FORMAT "%9.6" ECU_ADDRESS 0xC000BFDA /end MEASUREMENT
/begin MEASUREMENT Qvary_u12 "Startauswertung Messwertarray Spannung" UWORD Def_u_uw_q0p25em3_o6 1 100 6.0000000 22.383750 FORMAT "%9.6" ECU_ADDRESS 0xC000BFDC /end MEASUREMENT
/begin MEASUREMENT Qvary_u13 "Startauswertung Messwertarray Spannung" UWORD Def_u_uw_q0p25em3_o6 1 100 6.0000000 22.383750 FORMAT "%9.6" ECU_ADDRESS 0xC000BFDE /end MEASUREMENT
/begin MEASUREMENT Qvary_u14 "Startauswertung Messwertarray Spannung" UWORD Def_u_uw_q0p25em3_o6 1 100 6.0000000 22.383750 FORMAT "%9.6" ECU_ADDRESS 0xC000BFE0 /end MEASUREMENT
/begin MEASUREMENT Qvary_u15 "Startauswertung Messwertarray Spannung" UWORD Def_u_uw_q0p25em3_o6 1 100 6.0000000 22.383750 FORMAT "%9.6" ECU_ADDRESS 0xC000BFE2 /end MEASUREMENT
/begin MEASUREMENT Qvary_u16 "Startauswertung Messwertarray Spannung" UWORD Def_u_uw_q0p25em3_o6 1 100 6.0000000 22.383750 FORMAT "%9.6" ECU_ADDRESS 0xC000BFE4 /end MEASUREMENT
/begin MEASUREMENT Qvary_u17 "Startauswertung Messwertarray Spannung" UWORD Def_u_uw_q0p25em3_o6 1 100 6.0000000 22.383750 FORMAT "%9.6" ECU_ADDRESS 0xC000BFE6 /end MEASUREMENT
/begin MEASUREMENT Qvary_u18 "Startauswertung Messwertarray Spannung" UWORD Def_u_uw_q0p25em3_o6 1 100 6.0000000 22.383750 FORMAT "%9.6" ECU_ADDRESS 0xC000BFE8 /end MEASUREMENT
/begin MEASUREMENT Qvary_u19 "Startauswertung Messwertarray Spannung" UWORD Def_u_uw_q0p25em3_o6 1 100 6.0000000 22.383750 FORMAT "%9.6" ECU_ADDRESS 0xC000BFEA /end MEASUREMENT
/begin MEASUREMENT Qvary_u20 "Startauswertung Messwertarray Spannung" UWORD Def_u_uw_q0p25em3_o6 1 100 6.0000000 22.383750 FORMAT "%9.6" ECU_ADDRESS 0xC000BFEC /end MEASUREMENT
/begin MEASUREMENT Qvary_u21 "Startauswertung Messwertarray Spannung" UWORD Def_u_uw_q0p25em3_o6 1 100 6.0000000 22.383750 FORMAT "%9.6" ECU_ADDRESS 0xC000BFEE /end MEASUREMENT
/begin MEASUREMENT Qvary_u22 "Startauswertung Messwertarray Spannung" UWORD Def_u_uw_q0p25em3_o6 1 100 6.0000000 22.383750 FORMAT "%9.6" ECU_ADDRESS 0xC000BFF0 /end MEASUREMENT
/begin MEASUREMENT Qvary_u23 "Startauswertung Messwertarray Spannung" UWORD Def_u_uw_q0p25em3_o6 1 100 6.0000000 22.383750 FORMAT "%9.6" ECU_ADDRESS 0xC000BFF2 /end MEASUREMENT
/begin MEASUREMENT Qvary_u24 "Startauswertung Messwertarray Spannung" UWORD Def_u_uw_q0p25em3_o6 1 100 6.0000000 22.383750 FORMAT "%9.6" ECU_ADDRESS 0xC000BFF4 /end MEASUREMENT
/begin MEASUREMENT Qvary_u25 "Startauswertung Messwertarray Spannung" UWORD Def_u_uw_q0p25em3_o6 1 100 6.0000000 22.383750 FORMAT "%9.6" ECU_ADDRESS 0xC000BFF6 /end MEASUREMENT
/begin MEASUREMENT Qvary_u26 "Startauswertung Messwertarray Spannung" UWORD Def_u_uw_q0p25em3_o6 1 100 6.0000000 22.383750 FORMAT "%9.6" ECU_ADDRESS 0xC000BFF8 /end MEASUREMENT
/begin MEASUREMENT Qvary_u27 "Startauswertung Messwertarray Spannung" UWORD Def_u_uw_q0p25em3_o6 1 100 6.0000000 22.383750 FORMAT "%9.6" ECU_ADDRESS 0xC000BFFA /end MEASUREMENT
/begin MEASUREMENT Qvary_u28 "Startauswertung Messwertarray Spannung" UWORD Def_u_uw_q0p25em3_o6 1 100 6.0000000 22.383750 FORMAT "%9.6" ECU_ADDRESS 0xC000BFFC /end MEASUREMENT
/begin MEASUREMENT Qvary_u29 "Startauswertung Messwertarray Spannung" UWORD Def_u_uw_q0p25em3_o6 1 100 6.0000000 22.383750 FORMAT "%9.6" ECU_ADDRESS 0xC000BFFE /end MEASUREMENT
/begin MEASUREMENT Qvary_u30 "Startauswertung Messwertarray Spannung" UWORD Def_u_uw_q0p25em3_o6 1 100 6.0000000 22.383750 FORMAT "%9.6" ECU_ADDRESS 0xC000C000 /end MEASUREMENT
/begin MEASUREMENT Qvary_u31 "Startauswertung Messwertarray Spannung" UWORD Def_u_uw_q0p25em3_o6 1 100 6.0000000 22.383750 FORMAT "%9.6" ECU_ADDRESS 0xC000C002 /end MEASUREMENT
/begin MEASUREMENT Rail_facSetPointAPSCorRgn00 "Gewichtungsfaktor für atmosphärendruckabhängige Sollwertkorrektur des Raildrucks im Regenerationsbetrieb" SWORD Fact 1 100 -4.000000 3.999878 ECU_ADDRESS 0xD00012A6 /end MEASUREMENT
/begin MEASUREMENT Rail_facSetPointAPSCorRgn01 "Gewichtungsfaktor für atmosphärendruckabhängige Sollwertkorrektur des Raildrucks im Regenerationsbetrieb" SWORD Fact 1 100 -4.000000 3.999878 ECU_ADDRESS 0xD00012A8 /end MEASUREMENT
/begin MEASUREMENT Rail_facSetPointATSCorRgn00 "Gewichtungsfaktor für ansauglufttemperaturabhängige Sollwertkorrektur des Raildrucks im Regenerationsbetrieb" SWORD Fact 1 100 -4.000000 3.999878 ECU_ADDRESS 0xD00012AC /end MEASUREMENT
/begin MEASUREMENT Rail_facSetPointATSCorRgn01 "Gewichtungsfaktor für ansauglufttemperaturabhängige Sollwertkorrektur des Raildrucks im Regenerationsbetrieb" SWORD Fact 1 100 -4.000000 3.999878 ECU_ADDRESS 0xD00012AE /end MEASUREMENT
/begin MEASUREMENT Rail_facSetPointETSCorRgn00 "Gewichtungsfaktor für motortemperaturabhängige Sollwertkorrektur des Raildrucks im Regenerationsbetrieb" SWORD Fact 1 100 -4.000000 3.999878 ECU_ADDRESS 0xD00012B2 /end MEASUREMENT
/begin MEASUREMENT Rail_facSetPointETSCorRgn01 "Gewichtungsfaktor für motortemperaturabhängige Sollwertkorrektur des Raildrucks im Regenerationsbetrieb" SWORD Fact 1 100 -4.000000 3.999878 ECU_ADDRESS 0xD00012B4 /end MEASUREMENT
/begin MEASUREMENT Rail_nHpTst00 "Array von Drehzahlstufen für HpTst" SWORD EngN 1 100 -16384.00 16383.50 ECU_ADDRESS 0xD0001626 /end MEASUREMENT
/begin MEASUREMENT Rail_nHpTst01 "Array von Drehzahlstufen für HpTst" SWORD EngN 1 100 -16384.00 16383.50 ECU_ADDRESS 0xD0001628 /end MEASUREMENT
/begin MEASUREMENT Rail_nHpTst02 "Array von Drehzahlstufen für HpTst" SWORD EngN 1 100 -16384.00 16383.50 ECU_ADDRESS 0xD000162A /end MEASUREMENT
/begin MEASUREMENT Rail_nHpTst03 "Array von Drehzahlstufen für HpTst" SWORD EngN 1 100 -16384.00 16383.50 ECU_ADDRESS 0xD000162C /end MEASUREMENT
/begin MEASUREMENT Rail_pSetPointAPSCorRgn_mp00 "Raildruck-Korrekturwert im Regenerationsbetrieb, abhängig vom Atmosphärendruck" SWORD Pres_Rail 1 100 -3276.800 2000.000 ECU_ADDRESS 0xC000C450 /end MEASUREMENT
/begin MEASUREMENT Rail_pSetPointAPSCorRgn_mp01 "Raildruck-Korrekturwert im Regenerationsbetrieb, abhängig vom Atmosphärendruck" SWORD Pres_Rail 1 100 -3276.800 2000.000 ECU_ADDRESS 0xC000C452 /end MEASUREMENT
/begin MEASUREMENT Rail_pSetPointATSCorRgn_mp00 "Raildruck-Korrekturwert im Regenerationsbetrieb, abhängig vom Ansauglufttemperatur" SWORD Pres_Rail 1 100 -3276.800 2000.000 ECU_ADDRESS 0xC000C454 /end MEASUREMENT
/begin MEASUREMENT Rail_pSetPointATSCorRgn_mp01 "Raildruck-Korrekturwert im Regenerationsbetrieb, abhängig vom Ansauglufttemperatur" SWORD Pres_Rail 1 100 -3276.800 2000.000 ECU_ADDRESS 0xC000C456 /end MEASUREMENT
/begin MEASUREMENT Rail_pSetPointBasRgn_mp00 "Basiswert des Raildrucksollwerts im Regenerationsbetrieb" SWORD Pres_Rail 1 100 -3276.800 2000.000 ECU_ADDRESS 0xC000C44C /end MEASUREMENT
/begin MEASUREMENT Rail_pSetPointBasRgn_mp01 "Basiswert des Raildrucksollwerts im Regenerationsbetrieb" SWORD Pres_Rail 1 100 -3276.800 2000.000 ECU_ADDRESS 0xC000C44E /end MEASUREMENT
/begin MEASUREMENT Rail_pSetPointEnvCorRgn00 "Raildruck-Korrekturwert, abhängig von den Umgebungsbedingungen im Regenerationsbetrieb" SWORD Pres_Rail 1 100 -3276.800 2000.000 ECU_ADDRESS 0xD00012C6 /end MEASUREMENT
/begin MEASUREMENT Rail_pSetPointEnvCorRgn01 "Raildruck-Korrekturwert, abhängig von den Umgebungsbedingungen im Regenerationsbetrieb" SWORD Pres_Rail 1 100 -3276.800 2000.000 ECU_ADDRESS 0xD00012C8 /end MEASUREMENT
/begin MEASUREMENT Rail_pSetPointETSCorRgn_mp00 "Raildruck-Korrekturwert im Regenerationsbetrieb, abhängig vom Motortemperatur" SWORD Pres_Rail 1 100 -3276.800 2000.000 ECU_ADDRESS 0xC000C458 /end MEASUREMENT
/begin MEASUREMENT Rail_pSetPointETSCorRgn_mp01 "Raildruck-Korrekturwert im Regenerationsbetrieb, abhängig vom Motortemperatur" SWORD Pres_Rail 1 100 -3276.800 2000.000 ECU_ADDRESS 0xC000C45A /end MEASUREMENT
/begin MEASUREMENT Rail_pSetPointRgn00 "Raildruck-Sollwert im Regenerationsbetrieb" SWORD Pres_Rail 1 100 -3276.800 2000.000 ECU_ADDRESS 0xD00012D8 /end MEASUREMENT
/begin MEASUREMENT Rail_pSetPointRgn01 "Raildruck-Sollwert im Regenerationsbetrieb" SWORD Pres_Rail 1 100 -3276.800 2000.000 ECU_ADDRESS 0xD00012DA /end MEASUREMENT
/begin MEASUREMENT Rail_stDwnHpTst00 "Status der aktuellen Druckabfallphase des HpTst" UBYTE OneToOne 1 100 0.00 255.0 ECU_ADDRESS 0xD0002077 /end MEASUREMENT
/begin MEASUREMENT Rail_stDwnHpTst01 "Status der aktuellen Druckabfallphase des HpTst" UBYTE OneToOne 1 100 0.00 255.0 ECU_ADDRESS 0xD0002078 /end MEASUREMENT
/begin MEASUREMENT Rail_stDwnHpTst02 "Status der aktuellen Druckabfallphase des HpTst" UBYTE OneToOne 1 100 0.00 255.0 ECU_ADDRESS 0xD0002079 /end MEASUREMENT
/begin MEASUREMENT Rail_stDwnHpTst03 "Status der aktuellen Druckabfallphase des HpTst" UBYTE OneToOne 1 100 0.00 255.0 ECU_ADDRESS 0xD000207A /end MEASUREMENT
/begin MEASUREMENT Rail_stDwnHpTst04 "Status der aktuellen Druckabfallphase des HpTst" UBYTE OneToOne 1 100 0.00 255.0 ECU_ADDRESS 0xD000207B /end MEASUREMENT
/begin MEASUREMENT Rail_stUpHpTst00 "Array von Status der Druckaufbauphasen des HpTst" UBYTE OneToOne 1 100 0.00 255.0 ECU_ADDRESS 0xD0002080 /end MEASUREMENT
/begin MEASUREMENT Rail_stUpHpTst01 "Array von Status der Druckaufbauphasen des HpTst" UBYTE OneToOne 1 100 0.00 255.0 ECU_ADDRESS 0xD0002081 /end MEASUREMENT
/begin MEASUREMENT Rail_stUpHpTst02 "Array von Status der Druckaufbauphasen des HpTst" UBYTE OneToOne 1 100 0.00 255.0 ECU_ADDRESS 0xD0002082 /end MEASUREMENT
/begin MEASUREMENT Rail_stUpHpTst03 "Array von Status der Druckaufbauphasen des HpTst" UBYTE OneToOne 1 100 0.00 255.0 ECU_ADDRESS 0xD0002083 /end MEASUREMENT
/begin MEASUREMENT Rail_stUpHpTst04 "Array von Status der Druckaufbauphasen des HpTst" UBYTE OneToOne 1 100 0.00 255.0 ECU_ADDRESS 0xD0002084 /end MEASUREMENT
/begin MEASUREMENT Rail_tiDwnHpTst00 "Array der Druckabbauzeiten des HpTst" SLONG Time_ms 1 100 -21474836480.0 21474836470.0 ECU_ADDRESS 0xD0002FC8 /end MEASUREMENT
/begin MEASUREMENT Rail_tiDwnHpTst01 "Array der Druckabbauzeiten des HpTst" SLONG Time_ms 1 100 -21474836480.0 21474836470.0 ECU_ADDRESS 0xD0002FCC /end MEASUREMENT
/begin MEASUREMENT Rail_tiDwnHpTst02 "Array der Druckabbauzeiten des HpTst" SLONG Time_ms 1 100 -21474836480.0 21474836470.0 ECU_ADDRESS 0xD0002FD0 /end MEASUREMENT
/begin MEASUREMENT Rail_tiDwnHpTst03 "Array der Druckabbauzeiten des HpTst" SLONG Time_ms 1 100 -21474836480.0 21474836470.0 ECU_ADDRESS 0xD0002FD4 /end MEASUREMENT
/begin MEASUREMENT Rail_tiDwnHpTst04 "Array der Druckabbauzeiten des HpTst" SLONG Time_ms 1 100 -21474836480.0 21474836470.0 ECU_ADDRESS 0xD0002FD8 /end MEASUREMENT
/begin MEASUREMENT Rail_tiDwnHpTst05 "Array der Druckabbauzeiten des HpTst" SLONG Time_ms 1 100 -21474836480.0 21474836470.0 ECU_ADDRESS 0xD0002FDC /end MEASUREMENT
/begin MEASUREMENT Rail_tiDwnHpTst06 "Array der Druckabbauzeiten des HpTst" SLONG Time_ms 1 100 -21474836480.0 21474836470.0 ECU_ADDRESS 0xD0002FE0 /end MEASUREMENT
/begin MEASUREMENT Rail_tiUpHpTst00 "Array von Dauern der Druckaufbauphasen des HpTst" SLONG Time_ms 1 100 -21474836480.0 21474836470.0 ECU_ADDRESS 0xD0002FE4 /end MEASUREMENT
/begin MEASUREMENT Rail_tiUpHpTst01 "Array von Dauern der Druckaufbauphasen des HpTst" SLONG Time_ms 1 100 -21474836480.0 21474836470.0 ECU_ADDRESS 0xD0002FE8 /end MEASUREMENT
/begin MEASUREMENT Rail_tiUpHpTst02 "Array von Dauern der Druckaufbauphasen des HpTst" SLONG Time_ms 1 100 -21474836480.0 21474836470.0 ECU_ADDRESS 0xD0002FEC /end MEASUREMENT
/begin MEASUREMENT Rail_tiUpHpTst03 "Array von Dauern der Druckaufbauphasen des HpTst" SLONG Time_ms 1 100 -21474836480.0 21474836470.0 ECU_ADDRESS 0xD0002FF0 /end MEASUREMENT
/begin MEASUREMENT Reset_xHistBuf00 "Ringspeicher mit den letzten 8 Reset-ID's" UWORD OneToOne 1 100 0.00 65535.00 ECU_ADDRESS 0xD0008498 /end MEASUREMENT
/begin MEASUREMENT Reset_xHistBuf01 "Ringspeicher mit den letzten 8 Reset-ID's" UWORD OneToOne 1 100 0.00 65535.00 ECU_ADDRESS 0xD000849A /end MEASUREMENT
/begin MEASUREMENT Reset_xHistBuf02 "Ringspeicher mit den letzten 8 Reset-ID's" UWORD OneToOne 1 100 0.00 65535.00 ECU_ADDRESS 0xD000849C /end MEASUREMENT
/begin MEASUREMENT Reset_xHistBuf03 "Ringspeicher mit den letzten 8 Reset-ID's" UWORD OneToOne 1 100 0.00 65535.00 ECU_ADDRESS 0xD000849E /end MEASUREMENT
/begin MEASUREMENT Reset_xHistBuf04 "Ringspeicher mit den letzten 8 Reset-ID's" UWORD OneToOne 1 100 0.00 65535.00 ECU_ADDRESS 0xD00084A0 /end MEASUREMENT
/begin MEASUREMENT Reset_xHistBuf05 "Ringspeicher mit den letzten 8 Reset-ID's" UWORD OneToOne 1 100 0.00 65535.00 ECU_ADDRESS 0xD00084A2 /end MEASUREMENT
/begin MEASUREMENT Reset_xHistBuf06 "Ringspeicher mit den letzten 8 Reset-ID's" UWORD OneToOne 1 100 0.00 65535.00 ECU_ADDRESS 0xD00084A4 /end MEASUREMENT
/begin MEASUREMENT Reset_xHistBuf07 "Ringspeicher mit den letzten 8 Reset-ID's" UWORD OneToOne 1 100 0.00 65535.00 ECU_ADDRESS 0xD00084A6 /end MEASUREMENT
/begin MEASUREMENT SCRAd_facPlaus_Fld00 "Array zur Speicherung der letzten drei Plausibilitäten" SLONG SCR_Fact1000 1 100 -2147483.64800 2147483.64700 FORMAT "%13.5" ECU_ADDRESS 0xD0002FF8 /end MEASUREMENT
/begin MEASUREMENT SCRAd_facPlaus_Fld01 "Array zur Speicherung der letzten drei Plausibilitäten" SLONG SCR_Fact1000 1 100 -2147483.64800 2147483.64700 FORMAT "%13.5" ECU_ADDRESS 0xD0002FFC /end MEASUREMENT
/begin MEASUREMENT SCRAd_facPlaus_Fld02 "Array zur Speicherung der letzten drei Plausibilitäten" SLONG SCR_Fact1000 1 100 -2147483.64800 2147483.64700 FORMAT "%13.5" ECU_ADDRESS 0xD0003000 /end MEASUREMENT
/begin MEASUREMENT SCRAd_mAvrgStr_Fld00 "Array zur Speicherung der Werte der Füllstandskorrektur für die Mittelwertbildung" SWORD SCR_Mass1000 1 100 -32.76800 32.76700 FORMAT "%8.5" ECU_ADDRESS 0xD00012FE /end MEASUREMENT
/begin MEASUREMENT SCRAd_mAvrgStr_Fld01 "Array zur Speicherung der Werte der Füllstandskorrektur für die Mittelwertbildung" SWORD SCR_Mass1000 1 100 -32.76800 32.76700 FORMAT "%8.5" ECU_ADDRESS 0xD0001300 /end MEASUREMENT
/begin MEASUREMENT SCRAd_mAvrgStr_Fld02 "Array zur Speicherung der Werte der Füllstandskorrektur für die Mittelwertbildung" SWORD SCR_Mass1000 1 100 -32.76800 32.76700 FORMAT "%8.5" ECU_ADDRESS 0xD0001302 /end MEASUREMENT
/begin MEASUREMENT SCRAd_mAvrgStr_Fld03 "Array zur Speicherung der Werte der Füllstandskorrektur für die Mittelwertbildung" SWORD SCR_Mass1000 1 100 -32.76800 32.76700 FORMAT "%8.5" ECU_ADDRESS 0xD0001304 /end MEASUREMENT
/begin MEASUREMENT SCRAd_mAvrgStr_Fld04 "Array zur Speicherung der Werte der Füllstandskorrektur für die Mittelwertbildung" SWORD SCR_Mass1000 1 100 -32.76800 32.76700 FORMAT "%8.5" ECU_ADDRESS 0xD0001306 /end MEASUREMENT
/begin MEASUREMENT SCRAd_mAvrgStr_Fld05 "Array zur Speicherung der Werte der Füllstandskorrektur für die Mittelwertbildung" SWORD SCR_Mass1000 1 100 -32.76800 32.76700 FORMAT "%8.5" ECU_ADDRESS 0xD0001308 /end MEASUREMENT
/begin MEASUREMENT SCRAd_mAvrgStr_Fld06 "Array zur Speicherung der Werte der Füllstandskorrektur für die Mittelwertbildung" SWORD SCR_Mass1000 1 100 -32.76800 32.76700 FORMAT "%8.5" ECU_ADDRESS 0xD000130A /end MEASUREMENT
/begin MEASUREMENT SCRAd_mAvrgStr_Fld07 "Array zur Speicherung der Werte der Füllstandskorrektur für die Mittelwertbildung" SWORD SCR_Mass1000 1 100 -32.76800 32.76700 FORMAT "%8.5" ECU_ADDRESS 0xD000130C /end MEASUREMENT
/begin MEASUREMENT SCRAd_mAvrgStr_Fld08 "Array zur Speicherung der Werte der Füllstandskorrektur für die Mittelwertbildung" SWORD SCR_Mass1000 1 100 -32.76800 32.76700 FORMAT "%8.5" ECU_ADDRESS 0xD000130E /end MEASUREMENT
/begin MEASUREMENT SCRAd_mAvrgStr_Fld09 "Array zur Speicherung der Werte der Füllstandskorrektur für die Mittelwertbildung" SWORD SCR_Mass1000 1 100 -32.76800 32.76700 FORMAT "%8.5" ECU_ADDRESS 0xD0001310 /end MEASUREMENT
/begin MEASUREMENT SCRAd_mAvrgStr_Fld10 "Array zur Speicherung der Werte der Füllstandskorrektur für die Mittelwertbildung" SWORD SCR_Mass1000 1 100 -32.76800 32.76700 FORMAT "%8.5" ECU_ADDRESS 0xD0001312 /end MEASUREMENT
/begin MEASUREMENT SCRAd_mPlausNH3LdNom_Fld00 "Array zur Speicherung der Sollfüllstände" SWORD SCR_Mass1000 1 100 -32.76800 32.76700 FORMAT "%8.5" ECU_ADDRESS 0xD0001318 /end MEASUREMENT
/begin MEASUREMENT SCRAd_mPlausNH3LdNom_Fld01 "Array zur Speicherung der Sollfüllstände" SWORD SCR_Mass1000 1 100 -32.76800 32.76700 FORMAT "%8.5" ECU_ADDRESS 0xD000131A /end MEASUREMENT
/begin MEASUREMENT SCRChk_dmNOxDsItg_mp00 "NOx Massenstrom nach SCR für der Hauptintegrator" SLONG SCR_dmNOx_mg_p_s 1 100 -2147483.64800 2147483.64700 FORMAT "%13.5" ECU_ADDRESS 0xC000C45C /end MEASUREMENT
/begin MEASUREMENT SCRChk_dmNOxDsItg_mp01 "NOx Massenstrom nach SCR für der Hauptintegrator" SLONG SCR_dmNOx_mg_p_s 1 100 -2147483.64800 2147483.64700 FORMAT "%13.5" ECU_ADDRESS 0xC000C460 /end MEASUREMENT
/begin MEASUREMENT SCRChk_dmNOxDsPre_mp00 "NOx Massenstrom nach SCR für der Vorintegrator" SLONG SCR_dmNOx_mg_p_s 1 100 -2147483.64800 2147483.64700 FORMAT "%13.5" ECU_ADDRESS 0xC000C464 /end MEASUREMENT
/begin MEASUREMENT SCRChk_dmNOxDsPre_mp01 "NOx Massenstrom nach SCR für der Vorintegrator" SLONG SCR_dmNOx_mg_p_s 1 100 -2147483.64800 2147483.64700 FORMAT "%13.5" ECU_ADDRESS 0xC000C468 /end MEASUREMENT
/begin MEASUREMENT SCRChk_dmNOxDsThresItg_mp00 "Schwelle des NOx Massenflusses nach SCR für den Hauptintegrator" SLONG SCR_dmNOx_mg_p_s 1 100 -2147483.64800 2147483.64700 FORMAT "%13.5" ECU_ADDRESS 0xC000C46C /end MEASUREMENT
/begin MEASUREMENT SCRChk_dmNOxDsThresItg_mp01 "Schwelle des NOx Massenflusses nach SCR für den Hauptintegrator" SLONG SCR_dmNOx_mg_p_s 1 100 -2147483.64800 2147483.64700 FORMAT "%13.5" ECU_ADDRESS 0xC000C470 /end MEASUREMENT
/begin MEASUREMENT SCRChk_dmNOxDsThresPre_mp00 "Schwelle des NOx Massenflusses nach SCR für den Vorintegrator" SLONG SCR_dmNOx_mg_p_s 1 100 -2147483.64800 2147483.64700 FORMAT "%13.5" ECU_ADDRESS 0xC000C474 /end MEASUREMENT
/begin MEASUREMENT SCRChk_dmNOxDsThresPre_mp01 "Schwelle des NOx Massenflusses nach SCR für den Vorintegrator" SLONG SCR_dmNOx_mg_p_s 1 100 -2147483.64800 2147483.64700 FORMAT "%13.5" ECU_ADDRESS 0xC000C478 /end MEASUREMENT
/begin MEASUREMENT SCRChk_dmNOxUsItg_mp00 "NOx Massenfluss vor SCR für den Hauptintegrator" SLONG SCR_dmNOx_mg_p_s 1 100 -2147483.64800 2147483.64700 FORMAT "%13.5" ECU_ADDRESS 0xC000C47C /end MEASUREMENT
/begin MEASUREMENT SCRChk_dmNOxUsItg_mp01 "NOx Massenfluss vor SCR für den Hauptintegrator" SLONG SCR_dmNOx_mg_p_s 1 100 -2147483.64800 2147483.64700 FORMAT "%13.5" ECU_ADDRESS 0xC000C480 /end MEASUREMENT
/begin MEASUREMENT SCRChk_dmNOxUsPre_mp00 "NOx Massenfluss vor SCR für den Vorintegrator" SLONG SCR_dmNOx_mg_p_s 1 100 -2147483.64800 2147483.64700 FORMAT "%13.5" ECU_ADDRESS 0xC000C484 /end MEASUREMENT
/begin MEASUREMENT SCRChk_dmNOxUsPre_mp01 "NOx Massenfluss vor SCR für den Vorintegrator" SLONG SCR_dmNOx_mg_p_s 1 100 -2147483.64800 2147483.64700 FORMAT "%13.5" ECU_ADDRESS 0xC000C488 /end MEASUREMENT
/begin MEASUREMENT SCRChk_mNOxDsPre_mp00 "NOx Menge nach SCR (Vorintegrator)" SLONG SCR_Mass10000 1 100 -214748.364800 214748.364700 FORMAT "%13.6" ECU_ADDRESS 0xC000C48C /end MEASUREMENT
/begin MEASUREMENT SCRChk_mNOxDsPre_mp01 "NOx Menge nach SCR (Vorintegrator)" SLONG SCR_Mass10000 1 100 -214748.364800 214748.364700 FORMAT "%13.6" ECU_ADDRESS 0xC000C490 /end MEASUREMENT
/begin MEASUREMENT SCRChk_mNOxDsThresPre_mp00 "NOx Mengenschwelle nach SCR (Vorintegrator)" SLONG SCR_Mass10000 1 100 -214748.364800 214748.364700 FORMAT "%13.6" ECU_ADDRESS 0xC000C494 /end MEASUREMENT
/begin MEASUREMENT SCRChk_mNOxDsThresPre_mp01 "NOx Mengenschwelle nach SCR (Vorintegrator)" SLONG SCR_Mass10000 1 100 -214748.364800 214748.364700 FORMAT "%13.6" ECU_ADDRESS 0xC000C498 /end MEASUREMENT
/begin MEASUREMENT SCRChk_mNOxDsThres_mp00 "NOx Mengenschwelle nach SCR (Hauptintegrator)" SLONG SCR_Mass10000 1 100 -214748.364800 214748.364700 FORMAT "%13.6" ECU_ADDRESS 0xC000C49C /end MEASUREMENT
/begin MEASUREMENT SCRChk_mNOxDsThres_mp01 "NOx Mengenschwelle nach SCR (Hauptintegrator)" SLONG SCR_Mass10000 1 100 -214748.364800 214748.364700 FORMAT "%13.6" ECU_ADDRESS 0xC000C4A0 /end MEASUREMENT
/begin MEASUREMENT SCRChk_mNOxDs_mp00 "NOx Menge nach SCR (Hauptintegrator)" SLONG SCR_Mass10000 1 100 -214748.364800 214748.364700 FORMAT "%13.6" ECU_ADDRESS 0xC000C4A4 /end MEASUREMENT
/begin MEASUREMENT SCRChk_mNOxDs_mp01 "NOx Menge nach SCR (Hauptintegrator)" SLONG SCR_Mass10000 1 100 -214748.364800 214748.364700 FORMAT "%13.6" ECU_ADDRESS 0xC000C4A8 /end MEASUREMENT
/begin MEASUREMENT SCRChk_mNOxUsPre_mp00 "NOx Menge vor SCR (Vorintegrator)" SLONG SCR_Mass10000 1 100 -214748.364800 214748.364700 FORMAT "%13.6" ECU_ADDRESS 0xC000C4AC /end MEASUREMENT
/begin MEASUREMENT SCRChk_mNOxUsPre_mp01 "NOx Menge vor SCR (Vorintegrator)" SLONG SCR_Mass10000 1 100 -214748.364800 214748.364700 FORMAT "%13.6" ECU_ADDRESS 0xC000C4B0 /end MEASUREMENT
/begin MEASUREMENT SCRChk_mNOxUs_mp00 "NOx Menge vor SCR (Hauptintegrator)" SLONG SCR_Mass10000 1 100 -214748.364800 214748.364700 FORMAT "%13.6" ECU_ADDRESS 0xC000C4B4 /end MEASUREMENT
/begin MEASUREMENT SCRChk_mNOxUs_mp01 "NOx Menge vor SCR (Hauptintegrator)" SLONG SCR_Mass10000 1 100 -214748.364800 214748.364700 FORMAT "%13.6" ECU_ADDRESS 0xC000C4B8 /end MEASUREMENT
/begin MEASUREMENT SCRChk_stEtaCalc_mp00 "Status der Bedingung für die Wirkungsgradberechnung" UBYTE SCRChk_Compu_Fulfilled 1 100 0.00 1.00000000000 FORMAT "%13.11" ECU_ADDRESS 0xC000C4BC /end MEASUREMENT
/begin MEASUREMENT SCRChk_stEtaCalc_mp01 "Status der Bedingung für die Wirkungsgradberechnung" UBYTE SCRChk_Compu_Fulfilled 1 100 0.00 1.00000000000 FORMAT "%13.11" ECU_ADDRESS 0xC000C4BD /end MEASUREMENT
/begin MEASUREMENT SCRChk_stEtaCond_mp00 "Status des Bedingungszählers" UBYTE SCRChk_Compu_Fulfilled 1 100 0.00 1.00000000000 FORMAT "%13.11" ECU_ADDRESS 0xC000C4BE /end MEASUREMENT
/begin MEASUREMENT SCRChk_stEtaCond_mp01 "Status des Bedingungszählers" UBYTE SCRChk_Compu_Fulfilled 1 100 0.00 1.00000000000 FORMAT "%13.11" ECU_ADDRESS 0xC000C4BF /end MEASUREMENT
/begin MEASUREMENT SCRChk_stEtaRstCalc_mp00 "Berechneter Resetstatus" UBYTE SCRChk_Compu_Switch_1 1 100 0.00 1.00000000000 FORMAT "%13.11" ECU_ADDRESS 0xC000C4C0 /end MEASUREMENT
/begin MEASUREMENT SCRChk_stEtaRstCalc_mp01 "Berechneter Resetstatus" UBYTE SCRChk_Compu_Switch_1 1 100 0.00 1.00000000000 FORMAT "%13.11" ECU_ADDRESS 0xC000C4C1 /end MEASUREMENT
/begin MEASUREMENT SCRChk_stMsNOxUsMin_mp00 "Status, ob integrierte NOx Menge vor SCR die Schwelle für die Berechnung übersteigt" UBYTE SCRChk_Compu_Threshold 1 100 0.00 1.00000000000 FORMAT "%13.11" ECU_ADDRESS 0xC000C4C2 /end MEASUREMENT
/begin MEASUREMENT SCRChk_stMsNOxUsMin_mp01 "Status, ob integrierte NOx Menge vor SCR die Schwelle für die Berechnung übersteigt" UBYTE SCRChk_Compu_Threshold 1 100 0.00 1.00000000000 FORMAT "%13.11" ECU_ADDRESS 0xC000C4C3 /end MEASUREMENT
/begin MEASUREMENT SCRChk_tiNOxItgPre_mp00 "Aktuelle Integrationszeit der Vorintegratoren" SWORD SCR_Time10 1 100 -3276.800 3276.700 FORMAT "%8.3" ECU_ADDRESS 0xC000C4C4 /end MEASUREMENT
/begin MEASUREMENT SCRChk_tiNOxItgPre_mp01 "Aktuelle Integrationszeit der Vorintegratoren" SWORD SCR_Time10 1 100 -3276.800 3276.700 FORMAT "%8.3" ECU_ADDRESS 0xC000C4C6 /end MEASUREMENT
/begin MEASUREMENT SCRChk_tiNOxItg_mp00 "Aktuelle Integrationszeit der Hauptintegratoren" SWORD SCR_Time10 1 100 -3276.800 3276.700 FORMAT "%8.3" ECU_ADDRESS 0xC000C4C8 /end MEASUREMENT
/begin MEASUREMENT SCRChk_tiNOxItg_mp01 "Aktuelle Integrationszeit der Hauptintegratoren" SWORD SCR_Time10 1 100 -3276.800 3276.700 FORMAT "%8.3" ECU_ADDRESS 0xC000C4CA /end MEASUREMENT
/begin MEASUREMENT SCRMon_rHydFld00 "Array für hydraulische Füllstände" SWORD DtyCyc 1 100 -327.6800 327.6700 ECU_ADDRESS 0xD000133C /end MEASUREMENT
/begin MEASUREMENT SCRMon_rHydFld01 "Array für hydraulische Füllstände" SWORD DtyCyc 1 100 -327.6800 327.6700 ECU_ADDRESS 0xD000133E /end MEASUREMENT
/begin MEASUREMENT SCRMon_rHydFld02 "Array für hydraulische Füllstände" SWORD DtyCyc 1 100 -327.6800 327.6700 ECU_ADDRESS 0xD0001340 /end MEASUREMENT
/begin MEASUREMENT SCRT_tFld00 "Temperaturfeld des SCR Katalysators" SWORD Temp_Cels 1 100 -3549.940 3003.560 ECU_ADDRESS 0xD0001346 /end MEASUREMENT
/begin MEASUREMENT SCRT_tFld01 "Temperaturfeld des SCR Katalysators" SWORD Temp_Cels 1 100 -3549.940 3003.560 ECU_ADDRESS 0xD0001348 /end MEASUREMENT
/begin MEASUREMENT SCRT_tFld02 "Temperaturfeld des SCR Katalysators" SWORD Temp_Cels 1 100 -3549.940 3003.560 ECU_ADDRESS 0xD000134A /end MEASUREMENT
/begin MEASUREMENT SCRT_tFld03 "Temperaturfeld des SCR Katalysators" SWORD Temp_Cels 1 100 -3549.940 3003.560 ECU_ADDRESS 0xD000134C /end MEASUREMENT
/begin MEASUREMENT SCRT_tFld04 "Temperaturfeld des SCR Katalysators" SWORD Temp_Cels 1 100 -3549.940 3003.560 ECU_ADDRESS 0xD000134E /end MEASUREMENT
/begin MEASUREMENT SCRT_tFld05 "Temperaturfeld des SCR Katalysators" SWORD Temp_Cels 1 100 -3549.940 3003.560 ECU_ADDRESS 0xD0001350 /end MEASUREMENT
/begin MEASUREMENT SCRT_tFld06 "Temperaturfeld des SCR Katalysators" SWORD Temp_Cels 1 100 -3549.940 3003.560 ECU_ADDRESS 0xD0001352 /end MEASUREMENT
/begin MEASUREMENT SCRT_tFld07 "Temperaturfeld des SCR Katalysators" SWORD Temp_Cels 1 100 -3549.940 3003.560 ECU_ADDRESS 0xD0001354 /end MEASUREMENT
/begin MEASUREMENT SCRT_tFld08 "Temperaturfeld des SCR Katalysators" SWORD Temp_Cels 1 100 -3549.940 3003.560 ECU_ADDRESS 0xD0001356 /end MEASUREMENT
/begin MEASUREMENT SpdGov_nSetPHi00 "Drehzahlarray für obere Solldrehzahlen" SWORD EngN 1 100 -16384.00 16383.50 ECU_ADDRESS 0xD0001390 /end MEASUREMENT
/begin MEASUREMENT SpdGov_nSetPHi01 "Drehzahlarray für obere Solldrehzahlen" SWORD EngN 1 100 -16384.00 16383.50 ECU_ADDRESS 0xD0001392 /end MEASUREMENT
/begin MEASUREMENT SpdGov_nSetPHi02 "Drehzahlarray für obere Solldrehzahlen" SWORD EngN 1 100 -16384.00 16383.50 ECU_ADDRESS 0xD0001394 /end MEASUREMENT
/begin MEASUREMENT SpdGov_nSetPHi03 "Drehzahlarray für obere Solldrehzahlen" SWORD EngN 1 100 -16384.00 16383.50 ECU_ADDRESS 0xD0001396 /end MEASUREMENT
/begin MEASUREMENT SpdGov_nSetPHi04 "Drehzahlarray für obere Solldrehzahlen" SWORD EngN 1 100 -16384.00 16383.50 ECU_ADDRESS 0xD0001398 /end MEASUREMENT
/begin MEASUREMENT SpdGov_nSetPHi05 "Drehzahlarray für obere Solldrehzahlen" SWORD EngN 1 100 -16384.00 16383.50 ECU_ADDRESS 0xD000139A /end MEASUREMENT
/begin MEASUREMENT SpdGov_nSetPLo00 "Drehzahlarray für untere Solldrehzahlen" SWORD EngN 1 100 -16384.00 16383.50 ECU_ADDRESS 0xD000139C /end MEASUREMENT
/begin MEASUREMENT SpdGov_nSetPLo01 "Drehzahlarray für untere Solldrehzahlen" SWORD EngN 1 100 -16384.00 16383.50 ECU_ADDRESS 0xD000139E /end MEASUREMENT
/begin MEASUREMENT SpdGov_nSetPLo02 "Drehzahlarray für untere Solldrehzahlen" SWORD EngN 1 100 -16384.00 16383.50 ECU_ADDRESS 0xD00013A0 /end MEASUREMENT
/begin MEASUREMENT SpdGov_nSetPLo03 "Drehzahlarray für untere Solldrehzahlen" SWORD EngN 1 100 -16384.00 16383.50 ECU_ADDRESS 0xD00013A2 /end MEASUREMENT
/begin MEASUREMENT SpdGov_nSetPLo04 "Drehzahlarray für untere Solldrehzahlen" SWORD EngN 1 100 -16384.00 16383.50 ECU_ADDRESS 0xD00013A4 /end MEASUREMENT
/begin MEASUREMENT SpdGov_nSetPLo05 "Drehzahlarray für untere Solldrehzahlen" SWORD EngN 1 100 -16384.00 16383.50 ECU_ADDRESS 0xD00013A6 /end MEASUREMENT
/begin MEASUREMENT TAA_ctLrnCycl00 "Anzahl der erfolgreichen Lern-Zyklen für die verschiedenen Drehzahlbereiche" UBYTE OneToOne 1 100 0.00 255.0 ECU_ADDRESS 0xD0001BC4 /end MEASUREMENT
/begin MEASUREMENT TAA_ctLrnCycl01 "Anzahl der erfolgreichen Lern-Zyklen für die verschiedenen Drehzahlbereiche" UBYTE OneToOne 1 100 0.00 255.0 ECU_ADDRESS 0xD0001BC5 /end MEASUREMENT
/begin MEASUREMENT TAA_ctLrnCycl02 "Anzahl der erfolgreichen Lern-Zyklen für die verschiedenen Drehzahlbereiche" UBYTE OneToOne 1 100 0.00 255.0 ECU_ADDRESS 0xD0001BC6 /end MEASUREMENT
/begin MEASUREMENT Tchip_mwa00 "Array zur Mittelwerbildung Tchip_ist" SWORD Def_t_sw_q0p1 1 100 -3276.8 3276.7 FORMAT "%6.1" ECU_ADDRESS 0xC000C42C /end MEASUREMENT
/begin MEASUREMENT Tchip_mwa01 "Array zur Mittelwerbildung Tchip_ist" SWORD Def_t_sw_q0p1 1 100 -3276.8 3276.7 FORMAT "%6.1" ECU_ADDRESS 0xC000C42E /end MEASUREMENT
/begin MEASUREMENT Tchip_mwa02 "Array zur Mittelwerbildung Tchip_ist" SWORD Def_t_sw_q0p1 1 100 -3276.8 3276.7 FORMAT "%6.1" ECU_ADDRESS 0xC000C430 /end MEASUREMENT
/begin MEASUREMENT Tchip_mwa03 "Array zur Mittelwerbildung Tchip_ist" SWORD Def_t_sw_q0p1 1 100 -3276.8 3276.7 FORMAT "%6.1" ECU_ADDRESS 0xC000C432 /end MEASUREMENT
/begin MEASUREMENT Tchip_mwa04 "Array zur Mittelwerbildung Tchip_ist" SWORD Def_t_sw_q0p1 1 100 -3276.8 3276.7 FORMAT "%6.1" ECU_ADDRESS 0xC000C434 /end MEASUREMENT
/begin MEASUREMENT Tchip_mwa05 "Array zur Mittelwerbildung Tchip_ist" SWORD Def_t_sw_q0p1 1 100 -3276.8 3276.7 FORMAT "%6.1" ECU_ADDRESS 0xC000C436 /end MEASUREMENT
/begin MEASUREMENT Tchip_mwa06 "Array zur Mittelwerbildung Tchip_ist" SWORD Def_t_sw_q0p1 1 100 -3276.8 3276.7 FORMAT "%6.1" ECU_ADDRESS 0xC000C438 /end MEASUREMENT
/begin MEASUREMENT Tchip_mwa07 "Array zur Mittelwerbildung Tchip_ist" SWORD Def_t_sw_q0p1 1 100 -3276.8 3276.7 FORMAT "%6.1" ECU_ADDRESS 0xC000C43A /end MEASUREMENT
/begin MEASUREMENT Tchip_mwa08 "Array zur Mittelwerbildung Tchip_ist" SWORD Def_t_sw_q0p1 1 100 -3276.8 3276.7 FORMAT "%6.1" ECU_ADDRESS 0xC000C43C /end MEASUREMENT
/begin MEASUREMENT Tchip_mwa09 "Array zur Mittelwerbildung Tchip_ist" SWORD Def_t_sw_q0p1 1 100 -3276.8 3276.7 FORMAT "%6.1" ECU_ADDRESS 0xC000C43E /end MEASUREMENT
/begin MEASUREMENT Tchip_mwa10 "Array zur Mittelwerbildung Tchip_ist" SWORD Def_t_sw_q0p1 1 100 -3276.8 3276.7 FORMAT "%6.1" ECU_ADDRESS 0xC000C440 /end MEASUREMENT
/begin MEASUREMENT Tchip_mwa11 "Array zur Mittelwerbildung Tchip_ist" SWORD Def_t_sw_q0p1 1 100 -3276.8 3276.7 FORMAT "%6.1" ECU_ADDRESS 0xC000C442 /end MEASUREMENT
/begin MEASUREMENT Tchip_mwa12 "Array zur Mittelwerbildung Tchip_ist" SWORD Def_t_sw_q0p1 1 100 -3276.8 3276.7 FORMAT "%6.1" ECU_ADDRESS 0xC000C444 /end MEASUREMENT
/begin MEASUREMENT Tchip_mwa13 "Array zur Mittelwerbildung Tchip_ist" SWORD Def_t_sw_q0p1 1 100 -3276.8 3276.7 FORMAT "%6.1" ECU_ADDRESS 0xC000C446 /end MEASUREMENT
/begin MEASUREMENT Tchip_mwa14 "Array zur Mittelwerbildung Tchip_ist" SWORD Def_t_sw_q0p1 1 100 -3276.8 3276.7 FORMAT "%6.1" ECU_ADDRESS 0xC000C448 /end MEASUREMENT
/begin MEASUREMENT Tchip_mwa15 "Array zur Mittelwerbildung Tchip_ist" SWORD Def_t_sw_q0p1 1 100 -3276.8 3276.7 FORMAT "%6.1" ECU_ADDRESS 0xC000C44A /end MEASUREMENT
/begin MEASUREMENT TrqInrCtl_r00 "" SWORD Prc_Fact100 1 100 -327.6800 327.6700 FORMAT "%8.4" ECU_ADDRESS 0xD0001436 /end MEASUREMENT
/begin MEASUREMENT TrqInrCtl_r01 "" SWORD Prc_Fact100 1 100 -327.6800 327.6700 FORMAT "%8.4" ECU_ADDRESS 0xD0001438 /end MEASUREMENT
/begin MEASUREMENT TrqInrCtl_r02 "" SWORD Prc_Fact100 1 100 -327.6800 327.6700 FORMAT "%8.4" ECU_ADDRESS 0xD000143A /end MEASUREMENT
/begin MEASUREMENT TrqInrCtl_r03 "" SWORD Prc_Fact100 1 100 -327.6800 327.6700 FORMAT "%8.4" ECU_ADDRESS 0xD000143C /end MEASUREMENT
/begin MEASUREMENT TrqInrCtl_r04 "" SWORD Prc_Fact100 1 100 -327.6800 327.6700 FORMAT "%8.4" ECU_ADDRESS 0xD000143E /end MEASUREMENT
/begin MEASUREMENT TrqInrCtl_r05 "" SWORD Prc_Fact100 1 100 -327.6800 327.6700 FORMAT "%8.4" ECU_ADDRESS 0xD0001440 /end MEASUREMENT
/begin MEASUREMENT UDC_numUTnkLvlAvrgFld00 "" SWORD Fact 1 100 -4.000000 3.999878 ECU_ADDRESS 0xD0001448 /end MEASUREMENT
/begin MEASUREMENT UDC_numUTnkLvlAvrgFld01 "" SWORD Fact 1 100 -4.000000 3.999878 ECU_ADDRESS 0xD000144A /end MEASUREMENT
/begin MEASUREMENT UDC_numUTnkLvlAvrgFld02 "" SWORD Fact 1 100 -4.000000 3.999878 ECU_ADDRESS 0xD000144C /end MEASUREMENT
/begin MEASUREMENT UDC_numUTnkLvlAvrgFld03 "" SWORD Fact 1 100 -4.000000 3.999878 ECU_ADDRESS 0xD000144E /end MEASUREMENT
/begin MEASUREMENT UDC_numUTnkLvlAvrgFld04 "" SWORD Fact 1 100 -4.000000 3.999878 ECU_ADDRESS 0xD0001450 /end MEASUREMENT
/begin MEASUREMENT Verbredinfo00 "Ringspeicher zum speichern von Verbraucherreduzierungsinfos" UBYTE Def_dez_ub_q1 1 100 0.00 255. FORMAT "%3.0" ECU_ADDRESS 0xC000B69F /end MEASUREMENT
/begin MEASUREMENT Verbredinfo01 "Ringspeicher zum speichern von Verbraucherreduzierungsinfos" UBYTE Def_dez_ub_q1 1 100 0.00 255. FORMAT "%3.0" ECU_ADDRESS 0xC000B6A0 /end MEASUREMENT
/begin MEASUREMENT Verbredinfo02 "Ringspeicher zum speichern von Verbraucherreduzierungsinfos" UBYTE Def_dez_ub_q1 1 100 0.00 255. FORMAT "%3.0" ECU_ADDRESS 0xC000B6A1 /end MEASUREMENT
/begin MEASUREMENT Verbredinfo03 "Ringspeicher zum speichern von Verbraucherreduzierungsinfos" UBYTE Def_dez_ub_q1 1 100 0.00 255. FORMAT "%3.0" ECU_ADDRESS 0xC000B6A2 /end MEASUREMENT
/begin MEASUREMENT Verbredinfo04 "Ringspeicher zum speichern von Verbraucherreduzierungsinfos" UBYTE Def_dez_ub_q1 1 100 0.00 255. FORMAT "%3.0" ECU_ADDRESS 0xC000B6A3 /end MEASUREMENT
/begin MEASUREMENT Verbredinfo05 "Ringspeicher zum speichern von Verbraucherreduzierungsinfos" UBYTE Def_dez_ub_q1 1 100 0.00 255. FORMAT "%3.0" ECU_ADDRESS 0xC000B6A4 /end MEASUREMENT
/begin MEASUREMENT Verbredinfo06 "Ringspeicher zum speichern von Verbraucherreduzierungsinfos" UBYTE Def_dez_ub_q1 1 100 0.00 255. FORMAT "%3.0" ECU_ADDRESS 0xC000B6A5 /end MEASUREMENT
/begin MEASUREMENT Verbredinfo07 "Ringspeicher zum speichern von Verbraucherreduzierungsinfos" UBYTE Def_dez_ub_q1 1 100 0.00 255. FORMAT "%3.0" ECU_ADDRESS 0xC000B6A6 /end MEASUREMENT
/begin MEASUREMENT Verbredinfo08 "Ringspeicher zum speichern von Verbraucherreduzierungsinfos" UBYTE Def_dez_ub_q1 1 100 0.00 255. FORMAT "%3.0" ECU_ADDRESS 0xC000B6A7 /end MEASUREMENT
/begin MEASUREMENT Verbredinfo09 "Ringspeicher zum speichern von Verbraucherreduzierungsinfos" UBYTE Def_dez_ub_q1 1 100 0.00 255. FORMAT "%3.0" ECU_ADDRESS 0xC000B6A8 /end MEASUREMENT
/begin MEASUREMENT Verbredinfo10 "Ringspeicher zum speichern von Verbraucherreduzierungsinfos" UBYTE Def_dez_ub_q1 1 100 0.00 255. FORMAT "%3.0" ECU_ADDRESS 0xC000B6A9 /end MEASUREMENT
/begin MEASUREMENT Verbredinfo11 "Ringspeicher zum speichern von Verbraucherreduzierungsinfos" UBYTE Def_dez_ub_q1 1 100 0.00 255. FORMAT "%3.0" ECU_ADDRESS 0xC000B6AA /end MEASUREMENT
/begin MEASUREMENT Verbredinfo12 "Ringspeicher zum speichern von Verbraucherreduzierungsinfos" UBYTE Def_dez_ub_q1 1 100 0.00 255. FORMAT "%3.0" ECU_ADDRESS 0xC000B6AB /end MEASUREMENT
/begin MEASUREMENT Verbredinfo13 "Ringspeicher zum speichern von Verbraucherreduzierungsinfos" UBYTE Def_dez_ub_q1 1 100 0.00 255. FORMAT "%3.0" ECU_ADDRESS 0xC000B6AC /end MEASUREMENT
/begin MEASUREMENT Verbredinfo14 "Ringspeicher zum speichern von Verbraucherreduzierungsinfos" UBYTE Def_dez_ub_q1 1 100 0.00 255. FORMAT "%3.0" ECU_ADDRESS 0xC000B6AD /end MEASUREMENT
/begin MEASUREMENT Verbredinfo15 "Ringspeicher zum speichern von Verbraucherreduzierungsinfos" UBYTE Def_dez_ub_q1 1 100 0.00 255. FORMAT "%3.0" ECU_ADDRESS 0xC000B6AE /end MEASUREMENT
/begin MEASUREMENT Verbredinfo16 "Ringspeicher zum speichern von Verbraucherreduzierungsinfos" UBYTE Def_dez_ub_q1 1 100 0.00 255. FORMAT "%3.0" ECU_ADDRESS 0xC000B6AF /end MEASUREMENT
/begin MEASUREMENT Verbredinfo17 "Ringspeicher zum speichern von Verbraucherreduzierungsinfos" UBYTE Def_dez_ub_q1 1 100 0.00 255. FORMAT "%3.0" ECU_ADDRESS 0xC000B6B0 /end MEASUREMENT
/begin MEASUREMENT Verbredinfo18 "Ringspeicher zum speichern von Verbraucherreduzierungsinfos" UBYTE Def_dez_ub_q1 1 100 0.00 255. FORMAT "%3.0" ECU_ADDRESS 0xC000B6B1 /end MEASUREMENT
/begin MEASUREMENT Verbredinfo19 "Ringspeicher zum speichern von Verbraucherreduzierungsinfos" UBYTE Def_dez_ub_q1 1 100 0.00 255. FORMAT "%3.0" ECU_ADDRESS 0xC000B6B2 /end MEASUREMENT
/begin MEASUREMENT Verbstatus00 "Verbraucherstatus" UBYTE Def_dez_ub_q1 1 100 0.00 255. FORMAT "%3.0" ECU_ADDRESS 0xC000C312 /end MEASUREMENT
/begin MEASUREMENT Verbstatus01 "Verbraucherstatus" UBYTE Def_dez_ub_q1 1 100 0.00 255. FORMAT "%3.0" ECU_ADDRESS 0xC000C313 /end MEASUREMENT
/begin MEASUREMENT Verbstatus02 "Verbraucherstatus" UBYTE Def_dez_ub_q1 1 100 0.00 255. FORMAT "%3.0" ECU_ADDRESS 0xC000C314 /end MEASUREMENT
/begin MEASUREMENT Verbstatus03 "Verbraucherstatus" UBYTE Def_dez_ub_q1 1 100 0.00 255. FORMAT "%3.0" ECU_ADDRESS 0xC000C315 /end MEASUREMENT
/begin MEASUREMENT Verbstatus04 "Verbraucherstatus" UBYTE Def_dez_ub_q1 1 100 0.00 255. FORMAT "%3.0" ECU_ADDRESS 0xC000C316 /end MEASUREMENT
/begin MEASUREMENT Verbstatus05 "Verbraucherstatus" UBYTE Def_dez_ub_q1 1 100 0.00 255. FORMAT "%3.0" ECU_ADDRESS 0xC000C317 /end MEASUREMENT
/begin MEASUREMENT Verbstatus06 "Verbraucherstatus" UBYTE Def_dez_ub_q1 1 100 0.00 255. FORMAT "%3.0" ECU_ADDRESS 0xC000C318 /end MEASUREMENT
/begin MEASUREMENT Verbstatus07 "Verbraucherstatus" UBYTE Def_dez_ub_q1 1 100 0.00 255. FORMAT "%3.0" ECU_ADDRESS 0xC000C319 /end MEASUREMENT
/begin MEASUREMENT Verbstatus08 "Verbraucherstatus" UBYTE Def_dez_ub_q1 1 100 0.00 255. FORMAT "%3.0" ECU_ADDRESS 0xC000C31A /end MEASUREMENT
/begin MEASUREMENT Verbstatus09 "Verbraucherstatus" UBYTE Def_dez_ub_q1 1 100 0.00 255. FORMAT "%3.0" ECU_ADDRESS 0xC000C31B /end MEASUREMENT
/begin MEASUREMENT WaHtEl_st00 "" UBYTE OneToOne 1 100 0.00 255.0 ECU_ADDRESS 0xD00025BF /end MEASUREMENT
/begin MEASUREMENT WaHtEl_st01 "" UBYTE OneToOne 1 100 0.00 255.0 ECU_ADDRESS 0xD00025C0 /end MEASUREMENT
/begin MEASUREMENT ZFC_Sig_mp00 "Messwert der Kalibrierung" SLONG OneToOne 1 100 -2147483648.00 2147483647.00 ECU_ADDRESS 0xC000C4CC /end MEASUREMENT
/begin MEASUREMENT ZFC_Sig_mp01 "Messwert der Kalibrierung" SLONG OneToOne 1 100 -2147483648.00 2147483647.00 ECU_ADDRESS 0xC000C4D0 /end MEASUREMENT
/begin MEASUREMENT ZFC_Sig_mp02 "Messwert der Kalibrierung" SLONG OneToOne 1 100 -2147483648.00 2147483647.00 ECU_ADDRESS 0xC000C4D4 /end MEASUREMENT
/begin MEASUREMENT ZFC_Sig_mp03 "Messwert der Kalibrierung" SLONG OneToOne 1 100 -2147483648.00 2147483647.00 ECU_ADDRESS 0xC000C4D8 /end MEASUREMENT
/begin MEASUREMENT ZFC_Sig_mp04 "Messwert der Kalibrierung" SLONG OneToOne 1 100 -2147483648.00 2147483647.00 ECU_ADDRESS 0xC000C4DC /end MEASUREMENT
/begin MEASUREMENT ZFC_Sig_mp05 "Messwert der Kalibrierung" SLONG OneToOne 1 100 -2147483648.00 2147483647.00 ECU_ADDRESS 0xC000C4E0 /end MEASUREMENT
/begin COMPU_METHOD Curr "" RAT_FUNC "%6.2" "mA" COEFFS 0 1 0 0 0 1 /end COMPU_METHOD
/begin COMPU_METHOD Def_dez_ub_q1 "" RAT_FUNC "%3.1" "-" COEFFS 0 1 0 0 0 1 /end COMPU_METHOD
/begin COMPU_METHOD Def_dez_uw_q1 "" RAT_FUNC "%5.2" "-" COEFFS 0 1 0 0 0 1 /end COMPU_METHOD
/begin COMPU_METHOD Def_i_uw_q0p02 "" RAT_FUNC "%8.5" "A" COEFFS 0 50 0 0 0 1 /end COMPU_METHOD
/begin COMPU_METHOD Def_t_sw_q0p1 "" RAT_FUNC "%6.3" "°C" COEFFS 0 10 0 0 0 1 /end COMPU_METHOD
/begin COMPU_METHOD Def_u_uw_q0p25em3_o6 "" RAT_FUNC "%9.5" "" COEFFS 0 4000 -24000 0 0 1 /end COMPU_METHOD
/begin COMPU_METHOD DtyCyc "" RAT_FUNC "%5.2" "%" COEFFS 0 100 0 0 0 1 /end COMPU_METHOD
/begin COMPU_METHOD EngN "" RAT_FUNC "%5.1" "rpm" COEFFS 0 2 0 0 0 1 /end COMPU_METHOD
/begin COMPU_METHOD Fact "" RAT_FUNC "%6.5" "-" COEFFS 0 8192 0 0 0 1 /end COMPU_METHOD
/begin COMPU_METHOD InjMass "" RAT_FUNC "%5.2" "mg/hub" COEFFS 0 100 0 0 0 1 /end COMPU_METHOD
/begin COMPU_METHOD InjTime_us "" RAT_FUNC "%5.1" "us" COEFFS 0 2.5 0 0 0 1 /end COMPU_METHOD
/begin COMPU_METHOD lambda "" RAT_FUNC "%4.3" "-" COEFFS 0 1000 0 0 0 1 /end COMPU_METHOD
/begin COMPU_METHOD lambdaRecVal "" RAT_FUNC "%6.5" "-" COEFFS 0 1000 0 0 0 1 /end COMPU_METHOD
/begin COMPU_METHOD Mo_phi_degCrS_q0p02197 "" RAT_FUNC "%6.4" "deg CrS" COEFFS 0 16383 0 0 0 360 /end COMPU_METHOD
/begin COMPU_METHOD Mo_ti_us_q0p4 "" RAT_FUNC "%6.3" "us" COEFFS 0 1000 0 0 0 400 /end COMPU_METHOD
/begin COMPU_METHOD Mo_vol_mm3_q0p01 "" RAT_FUNC "%6.4" "mm3" COEFFS 0 100 0 0 0 1 /end COMPU_METHOD
/begin COMPU_METHOD Ms_SOxNOx "" RAT_FUNC "%8.7" "g" COEFFS 0 100000 0 0 0 1 /end COMPU_METHOD
/begin COMPU_METHOD O2 "" RAT_FUNC "%6.5" "-" COEFFS 0 100000 0 0 0 1 /end COMPU_METHOD
/begin COMPU_METHOD OneToOne "" RAT_FUNC "%6.0" "-" COEFFS 0 1 0 0 0 1 /end COMPU_METHOD
/begin COMPU_METHOD OneToOne_us "" RAT_FUNC "%6.2" "us" COEFFS 0 1 0 0 0 1 /end COMPU_METHOD
/begin COMPU_METHOD Prc "" RAT_FUNC "%6.4" "%" COEFFS 0 81.92 0 0 0 1 /end COMPU_METHOD
/begin COMPU_METHOD Prc_Fact100 "" RAT_FUNC "%6.4" "%" COEFFS 0 100 0 0 0 1 /end COMPU_METHOD
/begin COMPU_METHOD Pres_hPa "" RAT_FUNC "%5.1" "hPa" COEFFS 0 1 0 0 0 1 /end COMPU_METHOD
/begin COMPU_METHOD Pres_Rail "" RAT_FUNC "%5.1" "bar" COEFFS 0 10.000000 0 0 0 1 /end COMPU_METHOD
/begin COMPU_METHOD Resist "" RAT_FUNC "%6.3" "Ohm" COEFFS 0 10 0 0 0 1 /end COMPU_METHOD
/begin COMPU_METHOD SCRChk_Compu_Fulfilled "" TAB_VERB "%6.3" "" COMPU_TAB_REF SCRChk_Compu_Fulfilled /end COMPU_METHOD
/begin COMPU_VTAB SCRChk_Compu_Fulfilled "" TAB_VERB 2 0 "not fulfilled" 1 "fulfilled" DEFAULT_VALUE "unknown" /end COMPU_VTAB
/begin COMPU_METHOD SCRChk_Compu_Switch_1 "" TAB_VERB "%6.3" "" COMPU_TAB_REF SCRChk_Compu_Switch_1 /end COMPU_METHOD
/begin COMPU_VTAB SCRChk_Compu_Switch_1 "" TAB_VERB 2 0 "disable" 1 "enable" DEFAULT_VALUE "unknown" /end COMPU_VTAB
/begin COMPU_METHOD SCRChk_Compu_Threshold "" TAB_VERB "%6.3" "" COMPU_TAB_REF SCRChk_Compu_Threshold /end COMPU_METHOD
/begin COMPU_VTAB SCRChk_Compu_Threshold "" TAB_VERB 2 0 "NOx mass below threshold" 1 "NOx mass exceeds threshold" DEFAULT_VALUE "unknown" /end COMPU_VTAB
/begin COMPU_METHOD SCR_dmNOx_mg_p_s "" RAT_FUNC "%6.5" "mg/s" COEFFS 0 1000 0 0 0 1 /end COMPU_METHOD
/begin COMPU_METHOD SCR_Fact1000 "" RAT_FUNC "%6.5" "" COEFFS 0 1000 0 0 0 1 /end COMPU_METHOD
/begin COMPU_METHOD SCR_Mass1000 "" RAT_FUNC "%6.5" "g" COEFFS 0 1000 0 0 0 1 /end COMPU_METHOD
/begin COMPU_METHOD SCR_Mass10000 "" RAT_FUNC "%7.6" "g" COEFFS 0 10000 0 0 0 1 /end COMPU_METHOD
/begin COMPU_METHOD SCR_Time10 "" RAT_FUNC "%6.3" "s" COEFFS 0 10 0 0 0 1 /end COMPU_METHOD
/begin COMPU_METHOD STRT_ATSINTVMOD_SY_Compu "" TAB_VERB "%6.3" "" COMPU_TAB_REF STRT_ATSINTVMOD_SY_Compu /end COMPU_METHOD
/begin COMPU_VTAB STRT_ATSINTVMOD_SY_Compu "" TAB_VERB 2 0 "False" 1 "True" /end COMPU_VTAB
/begin COMPU_METHOD STSP_SY_Compu "" TAB_VERB "%6.3" "" COMPU_TAB_REF STSP_SY_Compu /end COMPU_METHOD
/begin COMPU_VTAB STSP_SY_Compu "" TAB_VERB 2 0 "0" 1 "1" /end COMPU_VTAB
/begin COMPU_METHOD TempDiff_Kelv "" RAT_FUNC "%4.1" "K" COEFFS 0 10 0 0 0 1 /end COMPU_METHOD
/begin COMPU_METHOD Temp_Cels "" RAT_FUNC "%5.1" "deg C" COEFFS 0 10 2731.4 0 0 1 /end COMPU_METHOD
/begin COMPU_METHOD Temp_Fahr "" RAT_FUNC "%6.1" "deg F" COEFFS 0 5.55555555555556 2553.62222222222 0 0 1 /end COMPU_METHOD
/begin COMPU_METHOD Temp_Kelv_Sec_CtT_Mon "" RAT_FUNC "%7.6" "deg C/s" COEFFS 0 40960 0 0 0 1 /end COMPU_METHOD
/begin COMPU_METHOD ThmCnd "" RAT_FUNC "%6.5" "W/m/K" COEFFS 0 1000 0 0 0 1 /end COMPU_METHOD
/begin COMPU_METHOD THRVLV_ATSINTVMOD_SY_Compu "" TAB_VERB "%6.3" "" COMPU_TAB_REF THRVLV_ATSINTVMOD_SY_Compu /end COMPU_METHOD
/begin COMPU_VTAB THRVLV_ATSINTVMOD_SY_Compu "" TAB_VERB 2 0 "False" 1 "True" /end COMPU_VTAB
/begin COMPU_METHOD TimeHrsEngOn "" RAT_FUNC "%6.0" "100h" COEFFS 0 0.01 0 0 0 1 /end COMPU_METHOD
/begin COMPU_METHOD Time_ms "" RAT_FUNC "%5.0" "ms" COEFFS 0 0.1 0 0 0 1 /end COMPU_METHOD
/begin COMPU_METHOD Time_PzoMeas "" RAT_FUNC "%6.4" "ms" COEFFS 0 18.3150183150183 0 0 0 1 /end COMPU_METHOD
/begin COMPU_METHOD Time_s "" RAT_FUNC "%5.2" "s" COEFFS 0 100 0 0 0 1 /end COMPU_METHOD
/begin COMPU_METHOD TRBCHLP_ATSINTVMOD_SY_Compu "" TAB_VERB "%6.3" "" COMPU_TAB_REF TRBCHLP_ATSINTVMOD_SY_Compu /end COMPU_METHOD
/begin COMPU_VTAB TRBCHLP_ATSINTVMOD_SY_Compu "" TAB_VERB 2 0 "False" 1 "True" /end COMPU_VTAB
/begin COMPU_METHOD TRBCH_ATSINTVMOD_SY_Compu "" TAB_VERB "%6.3" "" COMPU_TAB_REF TRBCH_ATSINTVMOD_SY_Compu /end COMPU_METHOD
/begin COMPU_VTAB TRBCH_ATSINTVMOD_SY_Compu "" TAB_VERB 2 0 "False" 1 "True" /end COMPU_VTAB
/begin COMPU_METHOD Trq32 "" RAT_FUNC "%8.7" "Nm" COEFFS 0 655360 0 0 0 1 /end COMPU_METHOD
/begin COMPU_METHOD TrqInrKd "" RAT_FUNC "%8.7" "%/Nm" COEFFS 0 655360 0 0 0 1 /end COMPU_METHOD
/begin COMPU_METHOD TrqInrKd_16 "" RAT_FUNC "%7.6" "%/Nm" COEFFS 0 40960 0 0 0 1 /end COMPU_METHOD
/begin COMPU_METHOD TrqInrKi "" RAT_FUNC "%7.6" "%/(Nm*s)" COEFFS 0 21474.83648 0 0 0 1 /end COMPU_METHOD
/begin COMPU_METHOD TrqInrKi_8 "" RAT_FUNC "%6.5" "%/(Nm*s)" COEFFS 0 2684.35456 0 0 0 1 /end COMPU_METHOD
/begin COMPU_METHOD TrqInrKp "" RAT_FUNC "%8.7" "%/Nm" COEFFS 0 327680 0 0 0 1 /end COMPU_METHOD
/begin COMPU_METHOD TrqInrKp_128 "" RAT_FUNC "%6.5" "%/Nm" COEFFS 0 2560 0 0 0 1 /end COMPU_METHOD
/begin COMPU_METHOD UDOSVLV_ATSINTVMOD_SY_Compu "" TAB_VERB "%6.3" "" COMPU_TAB_REF UDOSVLV_ATSINTVMOD_SY_Compu /end COMPU_METHOD
/begin COMPU_VTAB UDOSVLV_ATSINTVMOD_SY_Compu "" TAB_VERB 2 0 "False" 1 "True" /end COMPU_VTAB
/begin COMPU_METHOD UI_Curr "" RAT_FUNC "%6.1" "mA" COEFFS 0 0.0341 0 0 0 1 /end COMPU_METHOD
/begin COMPU_METHOD UPMPMOT_ATSINTVMOD_SY_Compu "" TAB_VERB "%6.3" "" COMPU_TAB_REF UPMPMOT_ATSINTVMOD_SY_Compu /end COMPU_METHOD
/begin COMPU_VTAB UPMPMOT_ATSINTVMOD_SY_Compu "" TAB_VERB 2 0 "False" 1 "True" /end COMPU_VTAB
/begin COMPU_METHOD URTNKLVL_SENSTYP_SY_Compu "" TAB_VERB "%6.3" "" COMPU_TAB_REF URTNKLVL_SENSTYP_SY_Compu /end COMPU_METHOD
/begin COMPU_VTAB URTNKLVL_SENSTYP_SY_Compu "" TAB_VERB 5 0 "NO_URTNK_SENS" 1 "INT_URTNK_SENS" 2 "ADCIN_PWMOUT" 3 "CONT_LVL_SENS" 4 "CAN_URTNK_SENS" /end COMPU_VTAB
/begin COMPU_METHOD Velocity "" RAT_FUNC "%6.4" "m/s" COEFFS 0 178.571428571429 0 0 0 1 /end COMPU_METHOD
/begin COMPU_METHOD Velocity_Fl "" RAT_FUNC "%6.2" "m/s" COEFFS 0 1 0 0 0 1 /end COMPU_METHOD
/begin COMPU_METHOD Vltg_PA "" RAT_FUNC "%4.2" "V" COEFFS 0 100 0 0 0 1 /end COMPU_METHOD
/begin COMPU_METHOD volAdd_ml_fine "" RAT_FUNC "%6.5" "ml" COEFFS 0 1000 0 0 0 1 /end COMPU_METHOD
/begin COMPU_METHOD VolFine "" RAT_FUNC "%7.6" "m^3" COEFFS 0 10000 0 0 0 1 /end COMPU_METHOD
/begin COMPU_METHOD Volt "" RAT_FUNC "%6.1" "mV" COEFFS 0 5 0 0 0 1 /end COMPU_METHOD
/begin COMPU_METHOD WAHTEL_ATSINTVMOD_SY_Compu "" TAB_VERB "%6.3" "" COMPU_TAB_REF WAHTEL_ATSINTVMOD_SY_Compu /end COMPU_METHOD
/begin COMPU_VTAB WAHTEL_ATSINTVMOD_SY_Compu "" TAB_VERB 2 0 "False" 1 "True" /end COMPU_VTAB
/end MODULE
/end PROJECT

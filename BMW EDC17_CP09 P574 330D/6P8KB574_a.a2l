ASAP2_VERSION 1 4
/begin PROJECT P_574 "EDC17_CP09"
/begin HEADER "" VERSION "V8KB" PROJECT_NO P_574 /end HEADER
/begin MODULE DIM ""
/begin MOD_COMMON "" BYTE_ORDER MSB_LAST ALIGNMENT_BYTE 1 ALIGNMENT_WORD 2 ALIGNMENT_LONG 4 ALIGNMENT_FLOAT32_IEEE 4 /end MOD_COMMON
/begin CHARACTERISTIC AFS_SSpShOff_ATS.LimitTypeMsk_C "/Tester Anforderungs Überwachungs Maske für Steller" VALUE 0x80031350 Val_Wu8 255.0 OneToOne 0.00 255.0 /end CHARACTERISTIC
/begin CHARACTERISTIC AFS_SSpShOff_ATS.CnvNorm_C "/Normierung für die Umrechnung" VALUE 0x80031351 Val_Wu8 255.0 OneToOne 0.00 255.0 /end CHARACTERISTIC
/begin CHARACTERISTIC AFS_SSpShOff_ATS.LowLim_C "/Untere Grenze für das Monitoring" VALUE 0x80031352 Val_Ws16 65535.00 OneToOne -32768.00 32767.00 /end CHARACTERISTIC
/begin CHARACTERISTIC AFS_SSpShOff_ATS.UpLim_C "/Obere Grenze für das Monitoring" VALUE 0x80031354 Val_Ws16 65535.00 OneToOne -32768.00 32767.00 /end CHARACTERISTIC
/begin CHARACTERISTIC AFS_SSpShOff_ATS.CnvFac_C "/Faktor für die Umrechnung" VALUE 0x80031358 Val_Ws32 4294967295.00 OneToOne -2147483648.00 2147483647.00 /end CHARACTERISTIC
/begin CHARACTERISTIC AFS_SSpShOff_ATS.CnvOfs_C "/Offset für die Umrechnung" VALUE 0x8003135C Val_Ws16 65535.00 OneToOne -32768.00 32767.00 /end CHARACTERISTIC
/begin CHARACTERISTIC AFS_SSpShOff_ATS.DfltVal_C "/Vorgabewert für standbytest" VALUE 0x8003135E Val_Ws16 65535.00 OneToOne -32768.00 32767.00 /end CHARACTERISTIC
/begin CHARACTERISTIC AirCCmpr_ATS.LimitTypeMsk_C "Steller Test AirCCmpr_ATS/Tester Anforderungs Überwachungs Maske für Steller" VALUE 0x80031360 Val_Wu8 255.0 OneToOne 0.00 255.0 /end CHARACTERISTIC
/begin CHARACTERISTIC AirCCmpr_ATS.CnvNorm_C "Steller Test AirCCmpr_ATS/Normierung für die Umrechnung" VALUE 0x80031361 Val_Wu8 255.0 OneToOne 0.00 255.0 /end CHARACTERISTIC
/begin CHARACTERISTIC AirCCmpr_ATS.LowLim_C "Steller Test AirCCmpr_ATS/Untere Grenze für das Monitoring" VALUE 0x80031362 Val_Ws16 65535.00 OneToOne -32768.00 32767.00 /end CHARACTERISTIC
/begin CHARACTERISTIC AirCCmpr_ATS.UpLim_C "Steller Test AirCCmpr_ATS/Obere Grenze für das Monitoring" VALUE 0x80031364 Val_Ws16 65535.00 OneToOne -32768.00 32767.00 /end CHARACTERISTIC
/begin CHARACTERISTIC AirCCmpr_ATS.CnvFac_C "Steller Test AirCCmpr_ATS/Faktor für die Umrechnung" VALUE 0x80031368 Val_Ws32 4294967295.00 OneToOne -2147483648.00 2147483647.00 /end CHARACTERISTIC
/begin CHARACTERISTIC AirCCmpr_ATS.CnvOfs_C "Steller Test AirCCmpr_ATS/Offset für die Umrechnung" VALUE 0x8003136C Val_Ws16 65535.00 OneToOne -32768.00 32767.00 /end CHARACTERISTIC
/begin CHARACTERISTIC AirCCmpr_ATS.DfltVal_C "Steller Test AirCCmpr_ATS/Vorgabewert für standbytest" VALUE 0x8003136E Val_Ws16 65535.00 OneToOne -32768.00 32767.00 /end CHARACTERISTIC
/begin CHARACTERISTIC ASMod_aHPTrbnMin_C "" VALUE 0x80030CA8 Val_Ws16 4.000000 Fact 0.00 4.000000 EXTENDED_LIMITS -4.000000 3.999878 /end CHARACTERISTIC
/begin CHARACTERISTIC ASMod_AirThr.rPresCrit_C "Parameter für Drosselklappe in IndVol/" VALUE 0x8002EC34 Kw_Wr32 1.00000000 OneToOne 0.00 1.00000000 FORMAT "%10.8" EXTENDED_LIMITS -1.00000000E+037 1.00000000E+037 /end CHARACTERISTIC
/begin CHARACTERISTIC ASMod_AirThr.facFlwCrit_C "Parameter für Drosselklappe in IndVol/" VALUE 0x8002EC38 Kw_Wr32 1.00000000 OneToOne 0.00 1.00000000 FORMAT "%10.8" EXTENDED_LIMITS -1.00000000E+037 1.00000000E+037 /end CHARACTERISTIC
/begin CHARACTERISTIC ASMod_AirThr.rPresLin_C "Parameter für Drosselklappe in IndVol/" VALUE 0x8002EC3C Kw_Wr32 1.00000000 OneToOne 0.00 1.00000000 FORMAT "%10.8" EXTENDED_LIMITS -1.00000000E+037 1.00000000E+037 /end CHARACTERISTIC
/begin CHARACTERISTIC ASMod_AirThr.facSlpLin_C "Parameter für Drosselklappe in IndVol/" VALUE 0x8002EC40 Kw_Wr32 100.000000 OneToOne 0.00 100.000000 FORMAT "%10.6" EXTENDED_LIMITS -1.00000000E+037 1.00000000E+037 /end CHARACTERISTIC
/begin CHARACTERISTIC ASMod_aLPTrbnMin_C "" VALUE 0x80030CAA Val_Ws16 4.000000 Fact 0.00 4.000000 EXTENDED_LIMITS -4.000000 3.999878 /end CHARACTERISTIC
/begin CHARACTERISTIC ASMod_arEffHPCmprBypVlv_C "" VALUE 0x8002F790 Val_Wr32 32.0000000 Area_cm2_float 0.00 32.0000000 FORMAT "%10.7" EXTENDED_LIMITS -1.00000000E+037 1.00000000E+037 /end CHARACTERISTIC
/begin CHARACTERISTIC ASMod_arEffHPTrbnCtlFlp_CUR "" CURVE 0x80030CAC Cur_Xr32Wr32 15.0000000 Area_cm2_float 0.00 15.0000000 FORMAT "%10.7" EXTENDED_LIMITS -1.00000000E+037 1.00000000E+037
 /begin AXIS_DESCR STD_AXIS ASMod_rHPTrbCh_mp Pos_Prc_float 4 0.00 100.000000 FORMAT "%10.6" EXTENDED_LIMITS -1.00000000E+037 1.00000000E+037 DEPOSIT ABSOLUTE /end AXIS_DESCR
/end CHARACTERISTIC
/begin CHARACTERISTIC ASMod_arEffLPTrbnBlwBy_CUR "" CURVE 0x80030CD0 Cur_Xr32Wr32 15.0000000 Area_cm2_float 0.00 15.0000000 FORMAT "%10.7" EXTENDED_LIMITS -1.00000000E+037 1.00000000E+037
 /begin AXIS_DESCR STD_AXIS ASMod_rLPTrbCh_mp Pos_Prc_float 8 0.00 100.000000 FORMAT "%10.6" EXTENDED_LIMITS -1.00000000E+037 1.00000000E+037 DEPOSIT ABSOLUTE /end AXIS_DESCR
/end CHARACTERISTIC
/begin CHARACTERISTIC ASMod_arEffTVA_CUR "effektive Querschnittsfläche der Drosselklappe" CURVE 0x8002EC44 Cur_Xr32Wr32 32.0000000 Area_cm2_float 0.00 32.0000000 FORMAT "%10.7" EXTENDED_LIMITS -1.00000000E+037 1.00000000E+037
 /begin AXIS_DESCR STD_AXIS ASMod_rRelPosTVA_mp Pos_Prc_float 10 0.00 100.000000 FORMAT "%10.6" EXTENDED_LIMITS -1.00000000E+037 1.00000000E+037 DEPOSIT ABSOLUTE /end AXIS_DESCR
/end CHARACTERISTIC
/begin CHARACTERISTIC ASMod_arOxiC_CA "Oberfläche des OxiCats" VAL_BLK 0x8002EDF4 ValA_Ws16 4.000000 Area 0.00 4.000000 FORMAT "%8.6" EXTENDED_LIMITS -4.000000 3.999878 NUMBER 1 /end CHARACTERISTIC
/begin CHARACTERISTIC ASMod_aTrbChMin_C "" VALUE 0x8002F400 Val_Ws16 7.999878 Fact -4.000000 3.999878 /end CHARACTERISTIC
/begin CHARACTERISTIC ASMod_cndHtOfsSlw_C "Offsetwert für Wärmeleitfähigkeit" VALUE 0x8002F2F0 Val_Ws16 0.009033203 Fact 0.0009765625 0.01000977 EXTENDED_LIMITS -4.000000 3.999878 READ_ONLY /end CHARACTERISTIC
/begin CHARACTERISTIC ASMod_cndHtOfs_C "Offsetwert für Wärmeleitfähigkeit" VALUE 0x8002F268 Val_Ws16 0.009033203 Fact 0.0009765625 0.01000977 EXTENDED_LIMITS -4.000000 3.999878 READ_ONLY /end CHARACTERISTIC
/begin CHARACTERISTIC ASMod_cpAirHPCmpr_C "" VALUE 0x8002F794 Val_Ws16 2.000000 SpecificHeat 0.00 2.000000 FORMAT "%8.6" EXTENDED_LIMITS -3.276800 3.276700 /end CHARACTERISTIC
/begin CHARACTERISTIC ASMod_cpAirLPCmpr_C "" VALUE 0x8002F796 Val_Ws16 2.000000 SpecificHeat 0.00 2.000000 FORMAT "%8.6" EXTENDED_LIMITS -3.276800 3.276700 /end CHARACTERISTIC
/begin CHARACTERISTIC ASMod_cpHPCmpr_C "" VALUE 0x8002F798 Val_Ws16 2.000000 SpecificHeat 0.00 2.000000 FORMAT "%8.6" EXTENDED_LIMITS -3.276800 3.276700 /end CHARACTERISTIC
/begin CHARACTERISTIC ASMod_cpLPCmpr_C "" VALUE 0x8002F79A Val_Ws16 2.000000 SpecificHeat 0.00 2.000000 FORMAT "%8.6" EXTENDED_LIMITS -3.276800 3.276700 /end CHARACTERISTIC
/begin CHARACTERISTIC ASMod_cpOxiC_CA "Wärmekapazität des OxiCats" VAL_BLK 0x8002EDF6 ValA_Ws16 2999.900 HeatCapacity 0.1000000 3000.000 FORMAT "%8.3" EXTENDED_LIMITS -3276.800 3276.700 NUMBER 1 /end CHARACTERISTIC
/begin CHARACTERISTIC ASMod_cpPFlt_C "Wärmekapazität des Partikelfilters" VALUE 0x8002F128 Val_Ws32 9800.00000000 HeatCapacity 200.000000000 10000.0000000 FORMAT "%13.7" EXTENDED_LIMITS -214748364.800 214748364.700 /end CHARACTERISTIC
/begin CHARACTERISTIC ASMod_cpPipeSlw_CA "Wärmekapazität des Rohres" VAL_BLK 0x8002F2F4 ValA_Ws32 2999.90000000 HeatCapacity 0.100000000000 3000.00000000 FORMAT "%13.8" EXTENDED_LIMITS -214748364.800 214748364.700 NUMBER 4 /end CHARACTERISTIC
/begin CHARACTERISTIC ASMod_cpPipe_CA "Wärmekapazität des Rohres" VAL_BLK 0x8002F26A ValA_Ws16 2999.900 HeatCapacity 0.1000000 3000.000 FORMAT "%8.3" EXTENDED_LIMITS -3276.800 3276.700 NUMBER 3 /end CHARACTERISTIC
/begin CHARACTERISTIC ASMod_dmHCEmiCor_MAP "Kennfeld zur Ermittlung des maximal konvertierbaren HC-Massenstrom" MAP 0x8002EDF8 Map_Xs16Ys16Ws16 100.0000 InjMassPerTime_2 0.00 100.0000 FORMAT "%8.4" EXTENDED_LIMITS -16.38400 16.38350
 /begin AXIS_DESCR STD_AXIS ASMod_dmEGFlCmbOxiC_mp InjMassPerTime 8 0.00 3000.000 FORMAT "%8.3" EXTENDED_LIMITS -327.6800 327.6700 DEPOSIT ABSOLUTE /end AXIS_DESCR
 /begin AXIS_DESCR STD_AXIS ASMod_dmEGFld_mp AirMassPerTime 8 0.00 1000.000 EXTENDED_LIMITS -3276.800 3276.700 DEPOSIT ABSOLUTE /end AXIS_DESCR
/end CHARACTERISTIC
/begin CHARACTERISTIC ASMod_dtHPTrbnDsMin_C "" VALUE 0x80030D14 Val_Ws16 1600.000 Temp_Kelv1_Sec -800.0000 800.0000 FORMAT "%8.4" EXTENDED_LIMITS -3276.800 3276.700 /end CHARACTERISTIC
/begin CHARACTERISTIC ASMod_dtLPTrbnDsMin_C "" VALUE 0x80030D16 Val_Ws16 1600.000 Temp_Kelv1_Sec -800.0000 800.0000 FORMAT "%8.4" EXTENDED_LIMITS -3276.800 3276.700 /end CHARACTERISTIC
/begin CHARACTERISTIC ASMod_dtOxiCatUsMin_C "" VALUE 0x8002F402 Val_Ws16 400.0000 Temp_Kelv1_Sec -200.0000 200.0000 FORMAT "%8.4" EXTENDED_LIMITS -3276.800 3276.700 /end CHARACTERISTIC
/begin CHARACTERISTIC ASMod_dwEnvOxiCDfl_CA "Ersatzwert Wärmestrom vom OxiCat an die Umgebung im Fehlerfall" VAL_BLK 0x8002EE9C ValA_Ws16 10.00000 Pwr1 0.00 10.00000 FORMAT "%8.5" EXTENDED_LIMITS -3276.800 3276.700 NUMBER 1 /end CHARACTERISTIC
/begin CHARACTERISTIC ASMod_etaHPCmpr_MAP "" MAP 0x8002F79C Map_Xr32Yr32Wr32 1.00000000 Fact_float 0.00 1.00000000 FORMAT "%10.8" EXTENDED_LIMITS -1.00000000E+037 1.00000000E+037
 /begin AXIS_DESCR STD_AXIS ASMod_rPresHPCmpr_mp Fact_float 16 0.500000000 3.00000000 FORMAT "%10.8" EXTENDED_LIMITS -1.00000000E+037 1.00000000E+037 DEPOSIT ABSOLUTE /end AXIS_DESCR
 /begin AXIS_DESCR STD_AXIS ASMod_dmHPCmprUsRed_mp AirMassPerTime_float 16 0.00 1400.00000 FORMAT "%10.5" EXTENDED_LIMITS -1.00000000E+037 1.00000000E+037 DEPOSIT ABSOLUTE /end AXIS_DESCR
/end CHARACTERISTIC
/begin CHARACTERISTIC ASMod_etaHPTrbn_CUR "" CURVE 0x80030D18 Cur_Xs16Ws16 1.000000 Fact 0.00 1.000000 EXTENDED_LIMITS -4.000000 3.999878
 /begin AXIS_DESCR STD_AXIS ASMod_rPresHPTrbnRec_mp Fact 8 0.00 4.000000 EXTENDED_LIMITS -4.000000 3.999878 DEPOSIT ABSOLUTE /end AXIS_DESCR
/end CHARACTERISTIC
/begin CHARACTERISTIC ASMod_etaLPCmpr_MAP "" MAP 0x8002FC24 Map_Xr32Yr32Wr32 1.00000000 Fact_float 0.00 1.00000000 FORMAT "%10.8" EXTENDED_LIMITS -1.00000000E+037 1.00000000E+037
 /begin AXIS_DESCR STD_AXIS ASMod_rPresLPCmpr_mp Fact_float 16 0.500000000 3.00000000 FORMAT "%10.8" EXTENDED_LIMITS -1.00000000E+037 1.00000000E+037 DEPOSIT ABSOLUTE /end AXIS_DESCR
 /begin AXIS_DESCR STD_AXIS ASMod_dmLPCmprUsRed_mp AirMassPerTime_float 16 0.00 1400.00000 FORMAT "%10.5" EXTENDED_LIMITS -1.00000000E+037 1.00000000E+037 DEPOSIT ABSOLUTE /end AXIS_DESCR
/end CHARACTERISTIC
/begin CHARACTERISTIC ASMod_etaLPTrbn_CUR "" CURVE 0x80030D3A Cur_Xs16Ws16 1.000000 Fact 0.00 1.000000 EXTENDED_LIMITS -4.000000 3.999878
 /begin AXIS_DESCR STD_AXIS ASMod_rPresLPTrbnRec_mp Fact 8 0.00 4.000000 EXTENDED_LIMITS -4.000000 3.999878 DEPOSIT ABSOLUTE /end AXIS_DESCR
/end CHARACTERISTIC
/begin CHARACTERISTIC ASMod_etaTrbCh_MAP "Kennfeld Gesamtwirkungsgrad Turbolader" MAP 0x8002F404 Map_Xs16Ys16Ws16 0.9998779 Fact 0.0001220703 1.000000 EXTENDED_LIMITS -4.000000 3.999878
 /begin AXIS_DESCR STD_AXIS ASMod_dmAFSCor AirMassPerTime 8 0.00 1000.000 EXTENDED_LIMITS -3276.800 3276.700 DEPOSIT ABSOLUTE /end AXIS_DESCR
 /begin AXIS_DESCR STD_AXIS ASMod_rPresCmpr_mp Fact 8 0.3000488 3.400024 EXTENDED_LIMITS -4.000000 3.999878 DEPOSIT ABSOLUTE /end AXIS_DESCR
/end CHARACTERISTIC
/begin CHARACTERISTIC ASMod_etaTrbn_MAP "" MAP 0x8002F4A8 Map_Xs16Ys16Ws16 1.000000 Fact 0.00 1.000000 EXTENDED_LIMITS -4.000000 3.999878
 /begin AXIS_DESCR STD_AXIS ASMod_rLinTrbChFlt_mp Fact 8 0.00 2.000000 EXTENDED_LIMITS -4.000000 3.999878 DEPOSIT ABSOLUTE /end AXIS_DESCR
 /begin AXIS_DESCR STD_AXIS ASMod_rPresTrbnRec_mp Fact 8 0.00 2.000000 EXTENDED_LIMITS -4.000000 3.999878 DEPOSIT ABSOLUTE /end AXIS_DESCR
/end CHARACTERISTIC
/begin CHARACTERISTIC ASMod_facArHPTrbnCor_C "" VALUE 0x80030D5C Val_Ws16 4.000000 Fact 0.00 4.000000 EXTENDED_LIMITS -4.000000 3.999878 /end CHARACTERISTIC
/begin CHARACTERISTIC ASMod_facArLPTrbnCor_C "" VALUE 0x80030D5E Val_Ws16 4.000000 Fact 0.00 4.000000 EXTENDED_LIMITS -4.000000 3.999878 /end CHARACTERISTIC
/begin CHARACTERISTIC ASMod_facArTrbnCor_C "" VALUE 0x8002F54C Val_Ws16 4.000000 Fact 0.00 4.000000 EXTENDED_LIMITS -4.000000 3.999878 /end CHARACTERISTIC
/begin CHARACTERISTIC ASMod_facBrickHPCmpr_C "" VALUE 0x800300AC Val_Ws16 1.000000 Fact100 0.00 1.000000 FORMAT "%8.6" EXTENDED_LIMITS -327.6800 327.6700 /end CHARACTERISTIC
/begin CHARACTERISTIC ASMod_facBrickLPCmpr_C "" VALUE 0x800300AE Val_Ws16 1.000000 Fact100 0.00 1.000000 FORMAT "%8.6" EXTENDED_LIMITS -327.6800 327.6700 /end CHARACTERISTIC
/begin CHARACTERISTIC ASMod_facBrickOxiC_CA "Faktor zur Aufteilung des Katalysators in Bricks" VAL_BLK 0x8002EE9E ValA_Ws16 0.8000000 Fact100 0.1000000 0.9000000 FORMAT "%9.7" EXTENDED_LIMITS -327.6800 327.6700 NUMBER 1 /end CHARACTERISTIC
/begin CHARACTERISTIC ASMod_facCalValFl_C "unterer Heizwert Kraftstoff" VALUE 0x8002EEA0 Val_Wu16 50000.00 Calory_Asmod 0.00 50000.00 FORMAT "%8.2" EXTENDED_LIMITS 0.00 1310700. /end CHARACTERISTIC
/begin CHARACTERISTIC ASMod_facCndHtSlpSlw_C "Steigungswert für Wärmeleitfähigkeit" VALUE 0x8002F304 Val_Ws16 0.00002000000 Fact8 0.00006000000 0.00008000000 FORMAT "%13.11" EXTENDED_LIMITS -0.0003276800 0.0003276700 READ_ONLY /end CHARACTERISTIC
/begin CHARACTERISTIC ASMod_facCndHtSlp_C "Steigungswert für Wärmeleitfähigkeit" VALUE 0x8002F270 Val_Ws16 0.00002000000 Fact8 0.00006000000 0.00008000000 FORMAT "%13.11" EXTENDED_LIMITS -0.0003276800 0.0003276700 READ_ONLY /end CHARACTERISTIC
/begin CHARACTERISTIC ASMod_facGeoEGPipe_CA "Array der geometrischen Faktoren zur Druckberechnung im Abgassystem" VAL_BLK 0x8002ECF8 ValA_Ws16 100.0000 Fact1 0.00 100.0000 EXTENDED_LIMITS -256.0000 255.9922 NUMBER 4 /end CHARACTERISTIC
/begin CHARACTERISTIC ASMod_facHCCnvOxiC1_MAP "Kennfeld für HC_Umwandlungsrate OxiCat1" MAP 0x8002EEA2 Map_Xs16Ys16Ws16 2.000000 Fact 0.00 2.000000 EXTENDED_LIMITS -4.000000 3.999878
 /begin AXIS_DESCR STD_AXIS ASMod_dmOxiCMapIn_mp AirMassPerTime 8 -30.00000 1000.000 EXTENDED_LIMITS -3276.800 3276.700 DEPOSIT ABSOLUTE /end AXIS_DESCR
 /begin AXIS_DESCR STD_AXIS ASMod_tHCCnvOxiCCrvIn_mp Temp_Cels 8 -30.04000 999.9600 EXTENDED_LIMITS -3549.940 3003.560 DEPOSIT ABSOLUTE /end AXIS_DESCR
/end CHARACTERISTIC
/begin CHARACTERISTIC ASMod_facHCLdOxiCLoad_CUR "Kennlinie für beladungsabhängige HC-Speichervermögen im OxiCat" CURVE 0x8002EF46 Cur_Xs16Ws16 2.000000 Fact 0.00 2.000000 EXTENDED_LIMITS -4.000000 3.999878
 /begin AXIS_DESCR STD_AXIS ASMod_mHCLdOxiCAct_mp InjMass_g 6 0.00 327.6700 FORMAT "%8.4" EXTENDED_LIMITS -327.6800 327.6700 DEPOSIT ABSOLUTE /end AXIS_DESCR
/end CHARACTERISTIC
/begin CHARACTERISTIC ASMod_facHCLdOxiCTemp_CUR "Kennlinie für temperaturabhängige HC-Speichervermögen im OxiCat" CURVE 0x8002EF60 Cur_Xs16Ws16 2.000000 Fact 0.00 2.000000 EXTENDED_LIMITS -4.000000 3.999878
 /begin AXIS_DESCR STD_AXIS ASMod_tOxiCSurf_mp Temp_Cels 6 -45.04000 1049.960 EXTENDED_LIMITS -3549.940 3003.560 DEPOSIT ABSOLUTE /end AXIS_DESCR
/end CHARACTERISTIC
/begin CHARACTERISTIC ASMod_facHPCmprPwrMax_C "" VALUE 0x800300B0 Val_Wr32 10.0000000 Fact_float -5.00000000 5.00000000 FORMAT "%10.8" EXTENDED_LIMITS -1.00000000E+037 1.00000000E+037 /end CHARACTERISTIC
/begin CHARACTERISTIC ASMod_facHPCmprPwrMin_C "" VALUE 0x800300B4 Val_Wr32 10.0000000 Fact_float -5.00000000 5.00000000 FORMAT "%10.8" EXTENDED_LIMITS -1.00000000E+037 1.00000000E+037 /end CHARACTERISTIC
/begin CHARACTERISTIC ASMod_facHtTransNoLin_CUR "Kennlinie des Faktors zur Berücksichtigung des nichtlinearen Wärmeübergangs" CURVE 0x8002F12C Cur_Xs16Ws16 1.000000 Fact 0.00 1.000000 EXTENDED_LIMITS -4.000000 3.999878
 /begin AXIS_DESCR STD_AXIS ASMod_tPFltDiffCorr_mp TempDiff_Kelv 8 500.0000 1000.000 EXTENDED_LIMITS -3276.800 3276.700 DEPOSIT ABSOLUTE /end AXIS_DESCR
/end CHARACTERISTIC
/begin CHARACTERISTIC ASMod_facIntMnfDsTempCor_C "Korrekturfaktor zur Kompensation der Abhängigkeit des Luftaufwands von der Gastemperatur nach Einlasskrümmer" VALUE 0x80030F1C Val_Ws16 2.000000 RatAirMass 0.00 2.000000 FORMAT "%8.6" EXTENDED_LIMITS -327.6800 327.6700 /end CHARACTERISTIC
/begin CHARACTERISTIC ASMod_facLeanNOxOxiC1_MAP "Kennfeld für LeanNOx-Effekt im OxiCat 1" MAP 0x8002EF7A Map_Xs16Ys16Ws16 2.000000 FactLow 0.00 2.000000 FORMAT "%8.6" EXTENDED_LIMITS -32.00000 31.99902
 /begin AXIS_DESCR STD_AXIS ASMod_tLeanNOxOxiCMapIn1_mp Temp_Cels 8 -30.04000 999.9600 EXTENDED_LIMITS -3549.940 3003.560 DEPOSIT ABSOLUTE /end AXIS_DESCR
 /begin AXIS_DESCR STD_AXIS ASMod_tLeanNOxOxiCMapIn2_mp Temp_Cels 8 -100.0400 2999.960 EXTENDED_LIMITS -3549.940 3003.560 DEPOSIT ABSOLUTE /end AXIS_DESCR
/end CHARACTERISTIC
/begin CHARACTERISTIC ASMod_facLeanNOxPFlt_MAP "Kennfeld Faktor für die Berücksichtigung der LeanNOx-Reaktion im DPF." MAP 0x8002F14E Map_Xs16Ys16Ws16 2.000000 FactLow 0.00 2.000000 FORMAT "%8.6" EXTENDED_LIMITS -32.00000 31.99902
 /begin AXIS_DESCR STD_AXIS ASMod_tFld1_mp Temp_Cels 8 -100.0400 2999.960 EXTENDED_LIMITS -3549.940 3003.560 DEPOSIT ABSOLUTE /end AXIS_DESCR
 /begin AXIS_DESCR STD_AXIS ASMod_tPFltUs_mp Temp_Cels 8 -30.04000 999.9600 EXTENDED_LIMITS -3549.940 3003.560 DEPOSIT ABSOLUTE /end AXIS_DESCR
/end CHARACTERISTIC
/begin CHARACTERISTIC ASMod_facLPCmprPwrMax_C "" VALUE 0x800300B8 Val_Wr32 10.0000000 Fact_float -5.00000000 5.00000000 FORMAT "%10.8" EXTENDED_LIMITS -1.00000000E+037 1.00000000E+037 /end CHARACTERISTIC
/begin CHARACTERISTIC ASMod_facLPCmprPwrMin_C "" VALUE 0x800300BC Val_Wr32 10.0000000 Fact_float -5.00000000 5.00000000 FORMAT "%10.8" EXTENDED_LIMITS -1.00000000E+037 1.00000000E+037 /end CHARACTERISTIC
/begin CHARACTERISTIC ASMod_facNOxSensUnCnv_C "Faktor zur Berechnung des NOx-Massenanteils im Abgas vor dem Partikelfilter." VALUE 0x8002F1F4 Val_Ws32 4294.96729500 ASMod_Fact1E6 -2147.48364800 2147.48364700 FORMAT "%13.8" /end CHARACTERISTIC
/begin CHARACTERISTIC ASMod_facPFltBlwBy_C "Thermischer Austauschfaktor für Abgas im Partikelfilter" VALUE 0x8002F1F8 Val_Ws16 1.000000 Fact 0.00 1.000000 EXTENDED_LIMITS -4.000000 3.999878 /end CHARACTERISTIC
/begin CHARACTERISTIC ASMod_facPowEGPipeCorr_CUR "" CURVE 0x8002ED00 Cur_Xs16Ws16 250.0000 Fact1 0.00 250.0000 EXTENDED_LIMITS -256.0000 255.9922
 /begin AXIS_DESCR STD_AXIS ASMod_dVolEGPipe1_mp AirVolPerTime 11 0.00 3200.00000000 FORMAT "%13.8" EXTENDED_LIMITS -214748364.800 214748364.700 DEPOSIT ABSOLUTE /end AXIS_DESCR
/end CHARACTERISTIC
/begin CHARACTERISTIC ASMod_facPowEGPipe_CUR "Potenzfunktion für Druckberechnung im Abgassystem" CURVE 0x8002ED2E Cur_Xs16Ws16 250.0000 Fact1 0.00 250.0000 EXTENDED_LIMITS -256.0000 255.9922 READ_ONLY
 /begin AXIS_DESCR STD_AXIS ASMod_dVolEGPipe1_mp AirVolPerTime 11 0.00 3200.00000000 FORMAT "%13.8" EXTENDED_LIMITS -214748364.800 214748364.700 DEPOSIT ABSOLUTE /end AXIS_DESCR
/end CHARACTERISTIC
/begin CHARACTERISTIC ASMod_facPresLsCmprUs_C "Faktor zur Berechnung des Druckabfalls vor Verdichter" VALUE 0x8002ECB0 Val_Wr32 0.300000000 FactPresLs_float 0.00 0.300000000 FORMAT "%11.9" EXTENDED_LIMITS -1.00000000E+037 1.00000000E+037 /end CHARACTERISTIC
/begin CHARACTERISTIC ASMod_facRhoEtaEGPipe_MAP "Temperaturabhängiger Dichte- und Viskositätsfaktor zur Druckberechnung im Abgassystem" MAP 0x8002ED5C Map_Xs16Ys16Ws16 5.000000 Fact 0.00 5.000000 EXTENDED_LIMITS -4.000000 3.999878
 /begin AXIS_DESCR STD_AXIS ASMod_tEGPresPipe_mp Temp_Cels 9 -40.04000 799.9600 EXTENDED_LIMITS -3549.940 3003.560 DEPOSIT ABSOLUTE /end AXIS_DESCR
 /begin AXIS_DESCR STD_AXIS ASMod_pEGPresPipe_mp Pres_hPa 2 1000.000 3500.000 EXTENDED_LIMITS -32768.00 32767.00 DEPOSIT ABSOLUTE /end AXIS_DESCR
/end CHARACTERISTIC
/begin CHARACTERISTIC ASMod_facSilFlpClsd_C "" VALUE 0x8002ED9A Val_Ws16 511.9922 Fact1 -256.0000 255.9922 /end CHARACTERISTIC
/begin CHARACTERISTIC ASMod_facTempClg_CUR "Abkühlkennlinie der abgasführenden Bauteile" CURVE 0x8002F38C Cur_Xs16Ws16 2.000000 Fact 0.00 2.000000 EXTENDED_LIMITS -4.000000 3.999878
 /begin AXIS_DESCR STD_AXIS ASMod_rTempClgCrvIn_mp Fact1 8 0.00 8.000000 EXTENDED_LIMITS -256.0000 255.9922 DEPOSIT ABSOLUTE /end AXIS_DESCR
/end CHARACTERISTIC
/begin CHARACTERISTIC ASMod_facTimeClg_CUR "inverse Abkühlkennlinie Motor" CURVE 0x8002F3AE Cur_Xs16Ws16 255.0000 Fact1 0.00 255.0000 EXTENDED_LIMITS -256.0000 255.9922
 /begin AXIS_DESCR STD_AXIS ASMod_rTempClnt_mp Fact 8 0.00 1.000000 EXTENDED_LIMITS -4.000000 3.999878 DEPOSIT ABSOLUTE /end AXIS_DESCR
/end CHARACTERISTIC
/begin CHARACTERISTIC ASMod_facVolEffBas_MAP "Basiswert für Luftaufwand des Motors" MAP 0x80030F1E Map_Xs16Ys16Ws16 1.000000 RatAirMass 0.00 1.000000 FORMAT "%8.6" EXTENDED_LIMITS -327.6800 327.6700
 /begin AXIS_DESCR STD_AXIS Epm_nEng EngN 16 0.00 10000.00 EXTENDED_LIMITS -16384.00 16383.50 DEPOSIT ABSOLUTE /end AXIS_DESCR
 /begin AXIS_DESCR STD_AXIS InjCtl_qSetUnBal InjMass 16 0.00 327.6700 EXTENDED_LIMITS -327.6800 327.6700 DEPOSIT ABSOLUTE /end AXIS_DESCR
/end CHARACTERISTIC
/begin CHARACTERISTIC ASMod_facVolEffVSACor_MAP "Korrekturfaktor für Luftaufwand als Funktion von Drehzahl und relativer Drallklappenposition" MAP 0x80031162 Map_Xs16Ys16Ws16 2.000000 RatAirMass 0.00 2.000000 FORMAT "%8.6" EXTENDED_LIMITS -327.6800 327.6700
 /begin AXIS_DESCR STD_AXIS Epm_nEng EngN 10 0.00 10000.00 EXTENDED_LIMITS -16384.00 16383.50 DEPOSIT ABSOLUTE /end AXIS_DESCR
 /begin AXIS_DESCR STD_AXIS ASMod_rRelPosVSA Prc 10 0.00 100.0000 EXTENDED_LIMITS -400.0000 399.9878 DEPOSIT ABSOLUTE /end AXIS_DESCR
/end CHARACTERISTIC
/begin CHARACTERISTIC ASMod_facVscDynSlpSlw_C "Steigungswert für dynamische Viskosität" VALUE 0x8002F306 Val_Ws16 0.0001700000 Fact7 0.00003000000 0.0002000000 FORMAT "%12.10" EXTENDED_LIMITS -0.003276800 0.003276700 READ_ONLY /end CHARACTERISTIC
/begin CHARACTERISTIC ASMod_facVscDynSlp_C "Steigungswert für dynamische Viskosität" VALUE 0x8002F272 Val_Ws16 0.0001700000 Fact7 0.00003000000 0.0002000000 FORMAT "%12.10" EXTENDED_LIMITS -0.003276800 0.003276700 READ_ONLY /end CHARACTERISTIC
/begin CHARACTERISTIC ASMod_facVscKinSlpSlw_C "Steigungswert für kinematische Viskosität" VALUE 0x8002F308 Val_Ws16 0.0000001200000 Fact10 0.00000008000000 0.0000002000000 FORMAT "%15.13" EXTENDED_LIMITS -0.000003276800 0.000003276700 READ_ONLY /end CHARACTERISTIC
/begin CHARACTERISTIC ASMod_facVscKinSlp_C "Steigungswert für kinematische Viskosität" VALUE 0x8002F274 Val_Ws16 0.0000001200000 Fact10 0.00000008000000 0.0000002000000 FORMAT "%15.13" EXTENDED_LIMITS -0.000003276800 0.000003276700 READ_ONLY /end CHARACTERISTIC
/begin CHARACTERISTIC ASMod_HPCmprBypVlv.rPresCrit_C "/" VALUE 0x800300C0 Kw_Wr32 1.00000000 OneToOne 0.00 1.00000000 FORMAT "%10.8" EXTENDED_LIMITS -1.00000000E+037 1.00000000E+037 /end CHARACTERISTIC
/begin CHARACTERISTIC ASMod_HPCmprBypVlv.facFlwCrit_C "/" VALUE 0x800300C4 Kw_Wr32 1.00000000 OneToOne 0.00 1.00000000 FORMAT "%10.8" EXTENDED_LIMITS -1.00000000E+037 1.00000000E+037 /end CHARACTERISTIC
/begin CHARACTERISTIC ASMod_HPCmprBypVlv.rPresLin_C "/" VALUE 0x800300C8 Kw_Wr32 1.00000000 OneToOne 0.00 1.00000000 FORMAT "%10.8" EXTENDED_LIMITS -1.00000000E+037 1.00000000E+037 /end CHARACTERISTIC
/begin CHARACTERISTIC ASMod_HPCmprBypVlv.facSlpLin_C "/" VALUE 0x800300CC Kw_Wr32 100.000000 OneToOne 0.00 100.000000 FORMAT "%10.6" EXTENDED_LIMITS -1.00000000E+037 1.00000000E+037 /end CHARACTERISTIC
/begin CHARACTERISTIC ASMod_HPTrbnCtlFlp.rPresCrit_C "/" VALUE 0x80030D60 Kw_Wr32 1.00000000 OneToOne 0.00 1.00000000 FORMAT "%10.8" EXTENDED_LIMITS -1.00000000E+037 1.00000000E+037 /end CHARACTERISTIC
/begin CHARACTERISTIC ASMod_HPTrbnCtlFlp.facFlwCrit_C "/" VALUE 0x80030D64 Kw_Wr32 1.00000000 OneToOne 0.00 1.00000000 FORMAT "%10.8" EXTENDED_LIMITS -1.00000000E+037 1.00000000E+037 /end CHARACTERISTIC
/begin CHARACTERISTIC ASMod_HPTrbnCtlFlp.rPresLin_C "/" VALUE 0x80030D68 Kw_Wr32 1.00000000 OneToOne 0.00 1.00000000 FORMAT "%10.8" EXTENDED_LIMITS -1.00000000E+037 1.00000000E+037 /end CHARACTERISTIC
/begin CHARACTERISTIC ASMod_HPTrbnCtlFlp.facSlpLin_C "/" VALUE 0x80030D6C Kw_Wr32 100.000000 OneToOne 0.00 100.000000 FORMAT "%10.6" EXTENDED_LIMITS -1.00000000E+037 1.00000000E+037 /end CHARACTERISTIC
/begin CHARACTERISTIC ASMod_htcFreeCnvtPipeSlw_CA "Wärmeübertragungskoeffizient aufgrund freier Konvektion" VAL_BLK 0x8002F30A ValA_Ws16 999.9000 ThermalCoEff 0.1000000 1000.000 FORMAT "%8.3" EXTENDED_LIMITS -3276.800 3276.700 NUMBER 4 /end CHARACTERISTIC
/begin CHARACTERISTIC ASMod_htcFreeCnvtPipe_CA "Wärmeübertragungskoeffizient aufgrund freier Konvektion" VAL_BLK 0x8002F276 ValA_Ws16 999.9000 ThermalCoEff 0.1000000 1000.000 FORMAT "%8.3" EXTENDED_LIMITS -3276.800 3276.700 NUMBER 3 /end CHARACTERISTIC
/begin CHARACTERISTIC ASMod_htcHPCmprEnv_C "" VALUE 0x800300D0 Val_Ws32 999.900000000 ThermalCoEff 0.100000000000 1000.00000000 FORMAT "%13.8" EXTENDED_LIMITS -214748364.800 214748364.700 /end CHARACTERISTIC
/begin CHARACTERISTIC ASMod_htcLPCmprEnv_C "" VALUE 0x800300D4 Val_Ws32 999.900000000 ThermalCoEff 0.100000000000 1000.00000000 FORMAT "%13.8" EXTENDED_LIMITS -214748364.800 214748364.700 /end CHARACTERISTIC
/begin CHARACTERISTIC ASMod_htcOxiC1_MAP "Wärmeübertragungskoeffizient OxiCat 1" MAP 0x8002F01E Map_Xs16Ys16Ws16 2.000000 ThermalCoEff 0.00 2.000000 FORMAT "%8.6" EXTENDED_LIMITS -3276.800 3276.700
 /begin AXIS_DESCR STD_AXIS ASMod_dmEGFld_mp AirMassPerTime 4 -120.0000 320.0000 EXTENDED_LIMITS -3276.800 3276.700 DEPOSIT ABSOLUTE /end AXIS_DESCR
 /begin AXIS_DESCR STD_AXIS VehV_v Vel 4 0.00 200.0000 EXTENDED_LIMITS -327.6800 327.6700 DEPOSIT ABSOLUTE /end AXIS_DESCR
/end CHARACTERISTIC
/begin CHARACTERISTIC ASMod_lDiamPipeSlw_CA "Rohrdurchmesser" VAL_BLK 0x8002F312 ValA_Ws16 0.09375000 Length1 0.007812500 0.1015625 FORMAT "%9.7" EXTENDED_LIMITS -256.0000 255.9922 NUMBER 4 /end CHARACTERISTIC
/begin CHARACTERISTIC ASMod_lDiamPipe_CA "Rohrdurchmesser" VAL_BLK 0x8002F27C ValA_Ws16 0.09375000 Length1 0.007812500 0.1015625 FORMAT "%9.7" EXTENDED_LIMITS -256.0000 255.9922 NUMBER 3 /end CHARACTERISTIC
/begin CHARACTERISTIC ASMod_lLngthPipeSlw_CA "Rohrlänge" VAL_BLK 0x8002F31A ValA_Ws16 2.992188 Length1 0.007812500 3.000000 FORMAT "%8.6" EXTENDED_LIMITS -256.0000 255.9922 NUMBER 4 /end CHARACTERISTIC
/begin CHARACTERISTIC ASMod_lLngthPipe_CA "Rohrlänge" VAL_BLK 0x8002F282 ValA_Ws16 2.992188 Length1 0.007812500 3.000000 FORMAT "%8.6" EXTENDED_LIMITS -256.0000 255.9922 NUMBER 3 /end CHARACTERISTIC
/begin CHARACTERISTIC ASMod_LPTrbnBlwBy.rPresCrit_C "/" VALUE 0x80030D70 Kw_Wr32 1.00000000 OneToOne 0.00 1.00000000 FORMAT "%10.8" EXTENDED_LIMITS -1.00000000E+037 1.00000000E+037 /end CHARACTERISTIC
/begin CHARACTERISTIC ASMod_LPTrbnBlwBy.facFlwCrit_C "/" VALUE 0x80030D74 Kw_Wr32 1.00000000 OneToOne 0.00 1.00000000 FORMAT "%10.8" EXTENDED_LIMITS -1.00000000E+037 1.00000000E+037 /end CHARACTERISTIC
/begin CHARACTERISTIC ASMod_LPTrbnBlwBy.rPresLin_C "/" VALUE 0x80030D78 Kw_Wr32 1.00000000 OneToOne 0.00 1.00000000 FORMAT "%10.8" EXTENDED_LIMITS -1.00000000E+037 1.00000000E+037 /end CHARACTERISTIC
/begin CHARACTERISTIC ASMod_LPTrbnBlwBy.facSlpLin_C "/" VALUE 0x80030D7C Kw_Wr32 100.000000 OneToOne 0.00 100.000000 FORMAT "%10.6" EXTENDED_LIMITS -1.00000000E+037 1.00000000E+037 /end CHARACTERISTIC
/begin CHARACTERISTIC ASMod_mHCLdOxiCMax_C "" VALUE 0x8002F052 Val_Ws16 50.00000 InjMass_g 0.00 50.00000 FORMAT "%8.5" EXTENDED_LIMITS -327.6800 327.6700 /end CHARACTERISTIC
/begin CHARACTERISTIC ASMod_mHCLdOxiCMin_C "" VALUE 0x8002F054 Val_Ws16 0.00 InjMass_g 0.00 0.00 FORMAT "%8.2" EXTENDED_LIMITS -327.6800 327.6700 /end CHARACTERISTIC
/begin CHARACTERISTIC ASMod_mIndVolMin_C "unterer Grenzwert für die Gasmasse im Einlassvolumen" VALUE 0x8002EC98 Val_Wr32 149.500000 Airmass_float 0.500000000 150.000000 FORMAT "%10.6" EXTENDED_LIMITS -1.00000000E+037 1.00000000E+037 /end CHARACTERISTIC
/begin CHARACTERISTIC ASMod_mO2IndVolMin_C "minimale Sauerstoffmasse im Einlassvolumen" VALUE 0x8002EC9C Val_Wr32 150.000000 Airmass_float 0.00 150.000000 FORMAT "%10.6" EXTENDED_LIMITS -1.00000000E+037 1.00000000E+037 /end CHARACTERISTIC
/begin CHARACTERISTIC ASMod_MsFlwIndVolPT1.tiUp_C "Parameter PT1-Glied - Gasmassenstrom vor Einlasskrümmer/" VALUE 0x8002ECA0 Kw_Wr32 1.00000000 Time_s_float 0.00 1.00000000 FORMAT "%10.8" EXTENDED_LIMITS -1.00000000E+037 1.00000000E+037 /end CHARACTERISTIC
/begin CHARACTERISTIC ASMod_MsFlwIndVolPT1.tiDwn_C "Parameter PT1-Glied - Gasmassenstrom vor Einlasskrümmer/" VALUE 0x8002ECA4 Kw_Wr32 1.00000000 Time_s_float 0.00 1.00000000 FORMAT "%10.8" EXTENDED_LIMITS -1.00000000E+037 1.00000000E+037 /end CHARACTERISTIC
/begin CHARACTERISTIC ASMod_nHPTrbChRed_MAP "" MAP 0x800300D8 Map_Xr32Yr32Wr32 300000.000 TrbChN_float 0.00 300000.000 FORMAT "%10.3" EXTENDED_LIMITS -1.00000000E+037 1.00000000E+037
 /begin AXIS_DESCR STD_AXIS ASMod_rPresHPCmpr_mp Fact_float 16 0.500000000 3.00000000 FORMAT "%10.8" EXTENDED_LIMITS -1.00000000E+037 1.00000000E+037 DEPOSIT ABSOLUTE /end AXIS_DESCR
 /begin AXIS_DESCR STD_AXIS ASMod_dmHPCmprUsRed_mp AirMassPerTime_float 16 0.00 1400.00000 FORMAT "%10.5" EXTENDED_LIMITS -1.00000000E+037 1.00000000E+037 DEPOSIT ABSOLUTE /end AXIS_DESCR
/end CHARACTERISTIC
/begin CHARACTERISTIC ASMod_nHPTrbnDT1.T1_C "/" VALUE 0x80030D80 Kw_Ws32 15.016368168 TimeDelay_s 0.0010000000689 15.017368168 FORMAT "%12.9" EXTENDED_LIMITS 0.000002000000001 4294.9672960 /end CHARACTERISTIC
/begin CHARACTERISTIC ASMod_nHPTrbnDT1.Kd_C "/" VALUE 0x80030D84 Kw_Ws32 100.000000000 Kd -50.0000000000 50.0000000000 FORMAT "%13.10" EXTENDED_LIMITS -32768.0000000 32767.9999847 /end CHARACTERISTIC
/begin CHARACTERISTIC ASMod_nLPTrbChRed_MAP "" MAP 0x80030560 Map_Xr32Yr32Wr32 300000.000 TrbChN_float 0.00 300000.000 FORMAT "%10.3" EXTENDED_LIMITS -1.00000000E+037 1.00000000E+037
 /begin AXIS_DESCR STD_AXIS ASMod_rPresLPCmpr_mp Fact_float 16 0.500000000 3.00000000 FORMAT "%10.8" EXTENDED_LIMITS -1.00000000E+037 1.00000000E+037 DEPOSIT ABSOLUTE /end AXIS_DESCR
 /begin AXIS_DESCR STD_AXIS ASMod_dmLPCmprUsRed_mp AirMassPerTime_float 16 0.00 1400.00000 FORMAT "%10.5" EXTENDED_LIMITS -1.00000000E+037 1.00000000E+037 DEPOSIT ABSOLUTE /end AXIS_DESCR
/end CHARACTERISTIC
/begin CHARACTERISTIC ASMod_nLPTrbnDT1.T1_C "/" VALUE 0x80030D88 Kw_Ws32 15.016368168 TimeDelay_s 0.0010000000689 15.017368168 FORMAT "%12.9" EXTENDED_LIMITS 0.000002000000001 4294.9672960 /end CHARACTERISTIC
/begin CHARACTERISTIC ASMod_nLPTrbnDT1.Kd_C "/" VALUE 0x80030D8C Kw_Ws32 100.000000000 Kd -50.0000000000 50.0000000000 FORMAT "%13.10" EXTENDED_LIMITS -32768.0000000 32767.9999847 /end CHARACTERISTIC
/begin CHARACTERISTIC ASMod_nTrbChDT1.T1_C "/" VALUE 0x8002F550 Kw_Ws32 15.016368168 TimeDelay_s 0.0010000000689 15.017368168 FORMAT "%12.9" EXTENDED_LIMITS 0.000002000000001 4294.9672960 /end CHARACTERISTIC
/begin CHARACTERISTIC ASMod_nTrbChDT1.Kd_C "/" VALUE 0x8002F554 Kw_Ws32 100.000000000 Kd -50.0000000000 50.0000000000 FORMAT "%13.10" EXTENDED_LIMITS -32768.0000000 32767.9999847 /end CHARACTERISTIC
/begin CHARACTERISTIC ASMod_numAirTempStrt_C "Index zur Auswahl der gewünschten Lufttemperatur" VALUE 0x8002F3D0 Val_Wu8 3.00000000000 AirTempFldSel 0.00 3.00000000000 FORMAT "%13.11" /end CHARACTERISTIC
/begin CHARACTERISTIC ASMod_numAirTempTrbn_C "Index zur Auswahl der Lufttemperatur" VALUE 0x8002F558 Val_Wu8 3.00000000000 AirTempFldSel 0.00 3.00000000000 FORMAT "%13.11" /end CHARACTERISTIC
/begin CHARACTERISTIC ASMod_numEngTempNOxCorPFlt_C "Parameter zur Auswahl der Motortemperatur" VALUE 0x8002F1FA Val_Wu8 10.00 OneToOne 0.00 10.00 EXTENDED_LIMITS 0.00 255.0 /end CHARACTERISTIC
/begin CHARACTERISTIC ASMod_numEngTempNOxCor_CA "Parameter zur Auswahl der Motortemperatur" VAL_BLK 0x8002F056 ValA_Wu8 3.00000000000 EngTempFldSel 0.00 3.00000000000 FORMAT "%13.11" NUMBER 1 /end CHARACTERISTIC
/begin CHARACTERISTIC ASMod_numEngTempStrt_C "Index zur Auswahl der gewünschten Motortemperatur" VALUE 0x8002F3D1 Val_Wu8 3.00000000000 EngTempFldSel 0.00 3.00000000000 FORMAT "%13.11" /end CHARACTERISTIC
/begin CHARACTERISTIC ASMod_numOxiCUsPT1EOM_CA "" VAL_BLK 0x8002F058 ValA_Ws16 65535.00 OneToOne -32768.00 32767.00 NUMBER 1 /end CHARACTERISTIC
/begin CHARACTERISTIC ASMod_numPipeSilFlp_C "" VALUE 0x8002ED9C Val_Wu8 255.0 OneToOne 0.00 255.0 /end CHARACTERISTIC
/begin CHARACTERISTIC ASMod_nuPipeEnvSlw_CUR "Nusselt-Zahl zwischen Rohrwand und Umgebung" CURVE 0x8002F322 Cur_Xs16Ws16 5309.000 OneToOne 0.00 5309.000 EXTENDED_LIMITS -32768.00 32767.00 READ_ONLY
 /begin AXIS_DESCR STD_AXIS ASMod_rePipeEnvSlw1_mp ReynoldsNum1 8 0.00 3750000. FORMAT "%8.0" EXTENDED_LIMITS -32768000. 32767000. DEPOSIT ABSOLUTE /end AXIS_DESCR
/end CHARACTERISTIC
/begin CHARACTERISTIC ASMod_nuPipeEnv_CUR "Nusselt-Zahl zwischen Rohrwand und Umgebung" CURVE 0x8002F288 Cur_Xs16Ws16 5309.000 OneToOne 0.00 5309.000 EXTENDED_LIMITS -32768.00 32767.00 READ_ONLY
 /begin AXIS_DESCR STD_AXIS ASMod_rePipeEnv1_mp ReynoldsNum1 8 0.00 3750000. FORMAT "%8.0" EXTENDED_LIMITS -32768000. 32767000. DEPOSIT ABSOLUTE /end AXIS_DESCR
/end CHARACTERISTIC
/begin CHARACTERISTIC ASMod_nuPipeSlw_CUR "Nusselt-Zahl zwischen im Rohr" CURVE 0x8002F344 Cur_Xs16Ws16 1130.000 OneToOne 0.00 1130.000 EXTENDED_LIMITS -32768.00 32767.00 READ_ONLY
 /begin AXIS_DESCR STD_AXIS ASMod_rePipeSlw1_mp ReynoldsNum 8 0.00 800000.0 FORMAT "%8.1" EXTENDED_LIMITS -3276800. 3276700. DEPOSIT ABSOLUTE /end AXIS_DESCR
/end CHARACTERISTIC
/begin CHARACTERISTIC ASMod_nuPipe_CUR "Nusselt-Zahl zwischen im Rohr" CURVE 0x8002F2AA Cur_Xs16Ws16 1130.000 OneToOne 0.00 1130.000 EXTENDED_LIMITS -32768.00 32767.00 READ_ONLY
 /begin AXIS_DESCR STD_AXIS ASMod_rePipe1_mp ReynoldsNum 8 0.00 800000.0 FORMAT "%8.1" EXTENDED_LIMITS -3276800. 3276700. DEPOSIT ABSOLUTE /end AXIS_DESCR
/end CHARACTERISTIC
/begin CHARACTERISTIC ASMod_pDiffPipe0_MAP "Kennfeld für Abgasgegendruck" MAP 0x8002ED9E Map_Xs16Ys16Ws16 3500.0000 Pres_hPa 0.00 3500.0000 EXTENDED_LIMITS -32768.00 32767.00
 /begin AXIS_DESCR STD_AXIS Epm_nEng EngN 2 800.0000 4000.000 EXTENDED_LIMITS -16384.00 16383.50 DEPOSIT ABSOLUTE /end AXIS_DESCR
 /begin AXIS_DESCR STD_AXIS ASMod_qPresPipe_mp InjMass 2 0.00 50.00000 EXTENDED_LIMITS -327.6800 327.6700 DEPOSIT ABSOLUTE /end AXIS_DESCR
/end CHARACTERISTIC
/begin CHARACTERISTIC ASMod_pDiffPipe1_MAP "Kennfeld für Abgasgegendruck" MAP 0x8002EDB2 Map_Xs16Ys16Ws16 3500.0000 Pres_hPa 0.00 3500.0000 EXTENDED_LIMITS -32768.00 32767.00
 /begin AXIS_DESCR STD_AXIS Epm_nEng EngN 2 800.0000 4000.000 EXTENDED_LIMITS -16384.00 16383.50 DEPOSIT ABSOLUTE /end AXIS_DESCR
 /begin AXIS_DESCR STD_AXIS ASMod_qPresPipe_mp InjMass 2 0.00 50.00000 EXTENDED_LIMITS -327.6800 327.6700 DEPOSIT ABSOLUTE /end AXIS_DESCR
/end CHARACTERISTIC
/begin CHARACTERISTIC ASMod_pDiffPipe2_MAP "Kennfeld für Abgasgegendruck" MAP 0x8002EDC6 Map_Xs16Ys16Ws16 3500.0000 Pres_hPa 0.00 3500.0000 EXTENDED_LIMITS -32768.00 32767.00
 /begin AXIS_DESCR STD_AXIS Epm_nEng EngN 2 800.0000 4000.000 EXTENDED_LIMITS -16384.00 16383.50 DEPOSIT ABSOLUTE /end AXIS_DESCR
 /begin AXIS_DESCR STD_AXIS ASMod_qPresPipe_mp InjMass 2 0.00 50.00000 EXTENDED_LIMITS -327.6800 327.6700 DEPOSIT ABSOLUTE /end AXIS_DESCR
/end CHARACTERISTIC
/begin CHARACTERISTIC ASMod_pDiffPipe3_MAP "Kennfeld für Abgasgegendruck" MAP 0x8002EDDA Map_Xs16Ys16Ws16 3500.0000 Pres_hPa 0.00 3500.0000 EXTENDED_LIMITS -32768.00 32767.00
 /begin AXIS_DESCR STD_AXIS Epm_nEng EngN 2 800.0000 4000.000 EXTENDED_LIMITS -16384.00 16383.50 DEPOSIT ABSOLUTE /end AXIS_DESCR
 /begin AXIS_DESCR STD_AXIS ASMod_qPresPipe_mp InjMass 2 0.00 50.00000 EXTENDED_LIMITS -327.6800 327.6700 DEPOSIT ABSOLUTE /end AXIS_DESCR
/end CHARACTERISTIC
/begin CHARACTERISTIC ASMod_pHPTrbnUsRef_C "" VALUE 0x80030D90 Val_Ws16 3500.000 Pres_hPa 0.00 3500.000 EXTENDED_LIMITS -32768.00 32767.00 /end CHARACTERISTIC
/begin CHARACTERISTIC ASMod_pLPTrbnUsRef_C "" VALUE 0x80030D92 Val_Ws16 3500.000 Pres_hPa 0.00 3500.000 EXTENDED_LIMITS -32768.00 32767.00 /end CHARACTERISTIC
/begin CHARACTERISTIC ASMod_pTrbnUsRef_C "" VALUE 0x8002F55A Val_Ws16 3500.000 Pres_hPa 0.00 3500.000 EXTENDED_LIMITS -32768.00 32767.00 /end CHARACTERISTIC
/begin CHARACTERISTIC ASMod_rArPipeSlw_CA "Anteil der vom Fahrtwind beaufschlagten Rohroberfläche" VAL_BLK 0x8002F366 ValA_Ws16 1.000000 Fact 0.00 1.000000 EXTENDED_LIMITS -4.000000 3.999878 NUMBER 4 /end CHARACTERISTIC
/begin CHARACTERISTIC ASMod_rArPipe_CA "Anteil der vom Fahrtwind beaufschlagten Rohroberfläche" VAL_BLK 0x8002F2CC ValA_Ws16 1.000000 Fact 0.00 1.000000 EXTENDED_LIMITS -4.000000 3.999878 NUMBER 3 /end CHARACTERISTIC
/begin CHARACTERISTIC ASMod_rHCRgnOxiC_CUR "" CURVE 0x8002F05A Cur_Xs16Ws16 2.000000 Time_1_s 0.00 2.000000 FORMAT "%8.6" EXTENDED_LIMITS -0.2000000 0.1999939
 /begin AXIS_DESCR STD_AXIS ASMod_tOxiCSurf_mp Temp_Cels 6 -45.04000 1049.960 EXTENDED_LIMITS -3549.940 3003.560 DEPOSIT ABSOLUTE /end AXIS_DESCR
/end CHARACTERISTIC
/begin CHARACTERISTIC ASMod_rLinTrbChPos_CUR "" CURVE 0x8002F55C Cur_Xs16Ws16 1.000000 Fact 0.00 1.000000 EXTENDED_LIMITS -4.000000 3.999878
 /begin AXIS_DESCR STD_AXIS TrbCh_r Prc 8 0.00 100.0000 EXTENDED_LIMITS -400.0000 399.9878 DEPOSIT ABSOLUTE /end AXIS_DESCR
/end CHARACTERISTIC
/begin CHARACTERISTIC ASMod_rPresHPCmprRaw_CUR "" CURVE 0x800309E8 Cur_Xr32Wr32 2.50000000 Fact_float 0.500000000 3.00000000 FORMAT "%10.8" EXTENDED_LIMITS -1.00000000E+037 1.00000000E+037
 /begin AXIS_DESCR STD_AXIS ASMod_pwrHPCmprRaw_mp Pwr_float 20 0.00 32000.0000 FORMAT "%10.4" EXTENDED_LIMITS -1.00000000E+037 1.00000000E+037 DEPOSIT ABSOLUTE /end AXIS_DESCR
/end CHARACTERISTIC
/begin CHARACTERISTIC ASMod_rPresHPCmpr_CUR "" CURVE 0x80030A8C Cur_Xr32Wr32 2.50000000 Fact_float 0.500000000 3.00000000 FORMAT "%10.8" EXTENDED_LIMITS -1.00000000E+037 1.00000000E+037
 /begin AXIS_DESCR STD_AXIS ASMod_pwrHPCmpr_mp Pwr_float 20 0.00 32000.0000 FORMAT "%10.4" EXTENDED_LIMITS -1.00000000E+037 1.00000000E+037 DEPOSIT ABSOLUTE /end AXIS_DESCR
/end CHARACTERISTIC
/begin CHARACTERISTIC ASMod_rPresHPTrbnRec_CUR "" CURVE 0x80030D94 Cur_Xs16Ws16 4.000000 Fact 0.00 4.000000 EXTENDED_LIMITS -4.000000 3.999878
 /begin AXIS_DESCR STD_AXIS ASMod_dmHPTrbnUsRed_mp AirMassPerTime 16 0.00 1000.000 EXTENDED_LIMITS -3276.800 3276.700 DEPOSIT ABSOLUTE /end AXIS_DESCR
/end CHARACTERISTIC
/begin CHARACTERISTIC ASMod_rPresLPCmprRaw_CUR "" CURVE 0x80030B30 Cur_Xr32Wr32 2.50000000 Fact_float 0.500000000 3.00000000 FORMAT "%10.8" EXTENDED_LIMITS -1.00000000E+037 1.00000000E+037
 /begin AXIS_DESCR STD_AXIS ASMod_pwrLPCmprRaw_mp Pwr_float 20 0.500000000 3.00000000 FORMAT "%10.8" EXTENDED_LIMITS -1.00000000E+037 1.00000000E+037 DEPOSIT ABSOLUTE /end AXIS_DESCR
/end CHARACTERISTIC
/begin CHARACTERISTIC ASMod_rPresLPCmpr_CUR "" CURVE 0x80030BD4 Cur_Xr32Wr32 2.50000000 Fact_float 0.500000000 3.00000000 FORMAT "%10.8" EXTENDED_LIMITS -1.00000000E+037 1.00000000E+037
 /begin AXIS_DESCR STD_AXIS ASMod_pwrLPCmpr_mp Pwr_float 20 0.00 32000.0000 FORMAT "%10.4" EXTENDED_LIMITS -1.00000000E+037 1.00000000E+037 DEPOSIT ABSOLUTE /end AXIS_DESCR
/end CHARACTERISTIC
/begin CHARACTERISTIC ASMod_rPresLPTrbnRec_CUR "" CURVE 0x80030DD6 Cur_Xs16Ws16 4.000000 Fact 0.00 4.000000 EXTENDED_LIMITS -4.000000 3.999878
 /begin AXIS_DESCR STD_AXIS ASMod_dmLPTrbnUsRed_mp AirMassPerTime 16 0.00 1000.000 EXTENDED_LIMITS -3276.800 3276.700 DEPOSIT ABSOLUTE /end AXIS_DESCR
/end CHARACTERISTIC
/begin CHARACTERISTIC ASMod_rPresTrbnRec_MAP "" MAP 0x8002F57E Map_Xs16Ys16Ws16 2.000000 Fact 1.000000 3.000000 EXTENDED_LIMITS -4.000000 3.999878
 /begin AXIS_DESCR STD_AXIS ASMod_rLinTrbChFlt_mp Fact 8 0.00 2.000000 EXTENDED_LIMITS -4.000000 3.999878 DEPOSIT ABSOLUTE /end AXIS_DESCR
 /begin AXIS_DESCR STD_AXIS ASMod_dmTrbnUsRed_mp AirMassPerTime 16 0.00 1000.000 EXTENDED_LIMITS -3276.800 3276.700 DEPOSIT ABSOLUTE /end AXIS_DESCR
/end CHARACTERISTIC
/begin CHARACTERISTIC ASMod_rTempAdbt_CUR "Kennlinie für die adiabatische Zustandsänderung der Temperatur" CURVE 0x8002F6B2 Cur_Xs16Ws16 1.500000 Fact 0.00 1.500000 EXTENDED_LIMITS -4.000000 3.999878 READ_ONLY
 /begin AXIS_DESCR STD_AXIS ASMod_rPresCmpr_mp Fact 20 0.3000488 3.400024 EXTENDED_LIMITS -4.000000 3.999878 DEPOSIT ABSOLUTE /end AXIS_DESCR
/end CHARACTERISTIC
/begin CHARACTERISTIC ASMod_stMskOxiCExoIncr_C "" VALUE 0x8002F074 Kw_Wu32 4294967295.00 OneToOne 0.00 4294967295.00 /end CHARACTERISTIC
/begin CHARACTERISTIC ASMod_stMskOxiCPT1_C "" VALUE 0x8002F078 Kw_Wu32 4294967295.00 OneToOne 0.00 4294967295.00 /end CHARACTERISTIC
/begin CHARACTERISTIC ASMod_swtFacHCCnvOxiCIn_CA "Schalter zur Auswahl der Eingangstemperatur in die HC Konvertierungskurve" VAL_BLK 0x8002F07C ValA_Ws16 1.000000 OneToOne 0.00 1.000000 EXTENDED_LIMITS -32768.00 32767.00 NUMBER 1 /end CHARACTERISTIC
/begin CHARACTERISTIC ASMod_swtFlMsFlwOxiC_CA "Schalter zur Auswahl der im OxiCat brennenden Kraftstoffmasse" VAL_BLK 0x8002F07E ValA_Ws16 2.000000 OneToOne 0.00 2.000000 EXTENDED_LIMITS -32768.00 32767.00 NUMBER 1 /end CHARACTERISTIC
/begin CHARACTERISTIC ASMod_swtGetOxiCatSens_C "Schalter zur Einspeisung der gemessenen Temperatur vor Oxi-Kat(Exh_tOxiCatUs) in das Temperaturfeld ASMod_TEGFld" VALUE 0x800698C8 Val_Wu8 255.0 OneToOne 0.00 255.0 /end CHARACTERISTIC
/begin CHARACTERISTIC ASMod_swtGetShOffTime_C "" VALUE 0x8002F3D2 Val_Ws16 1.000000 OneToOne 0.00 1.000000 EXTENDED_LIMITS -32768.00 32767.00 /end CHARACTERISTIC
/begin CHARACTERISTIC ASMod_swtHPTrbnDynCor_C "" VALUE 0x80030E18 Val_Wu8 1.000 OneToOne 0.00 1.000 EXTENDED_LIMITS 0.00 255.0 /end CHARACTERISTIC
/begin CHARACTERISTIC ASMod_swtHPTrbnSensSel_C "" VALUE 0x80030E19 Val_Wu8 1.000 OneToOne 0.00 1.000 EXTENDED_LIMITS 0.00 255.0 /end CHARACTERISTIC
/begin CHARACTERISTIC ASMod_swtIntkVUs_C "" VALUE 0x80031256 Val_Wu8 255.0 OneToOne 0.00 255.0 /end CHARACTERISTIC
/begin CHARACTERISTIC ASMod_swtLPTrbnDynCor_C "" VALUE 0x80030E1A Val_Wu8 1.000 OneToOne 0.00 1.000 EXTENDED_LIMITS 0.00 255.0 /end CHARACTERISTIC
/begin CHARACTERISTIC ASMod_swtNOxSensOxiCUsEna_CA "Schaltet zwischen Modellwert und Sensorwert um" VAL_BLK 0x8002F080 ValA_Wu8 255.0 OneToOne 0.00 255.0 NUMBER 1 /end CHARACTERISTIC
/begin CHARACTERISTIC ASMod_swtNOxSensPFltUsEna_C "NOx-Sensorwert zw. Oxi-Kat und DPF soll als Rohemissionswert verwendet werden, wenn der Sensor betriebsbereit ist." VALUE 0x8002F1FB Val_Wu8 255.0 OneToOne 0.00 255.0 /end CHARACTERISTIC
/begin CHARACTERISTIC ASMod_swtOxiCTempSel_C "" VALUE 0x8002F081 Kw_Wu8 1.000 OneToOne 0.00 1.000 EXTENDED_LIMITS 0.00 255.0 /end CHARACTERISTIC
/begin CHARACTERISTIC ASMod_swtPFltTempModOff_C "Schalter zur Abschaltung des Partikelfilter-Temperaturmodells" VALUE 0x8002F1FC Val_Ws16 1.000000 OneToOne 0.00 1.000000 EXTENDED_LIMITS -32768.00 32767.00 /end CHARACTERISTIC
/begin CHARACTERISTIC ASMod_swtPInit_C "" VALUE 0x8002ECA8 Val_Wu8 1.000 OneToOne 0.00 1.000 EXTENDED_LIMITS 0.00 255.0 /end CHARACTERISTIC
/begin CHARACTERISTIC ASMod_swtPresCalc_C "Auswahlschalter für Druckberechnung im Abgassystem (Kennfeldmodell oder Simulation)" VAL_BLK 0x8002EDEE ValA_Wu8 1.000 OneToOne 0.00 1.000 EXTENDED_LIMITS 0.00 255.0 NUMBER 4 /end CHARACTERISTIC
/begin CHARACTERISTIC ASMod_swtPresMidPFlt_C "Schalter für Berechnung des Drucks im Partikelfilter" VALUE 0x8002F1FE Val_Ws16 2.000000 OneToOne 0.00 2.000000 EXTENDED_LIMITS -32768.00 32767.00 /end CHARACTERISTIC
/begin CHARACTERISTIC ASMod_swtTHPTrbnUs_C "" VALUE 0x80030E1B Val_Wu8 1.000 OneToOne 0.00 1.000 EXTENDED_LIMITS 0.00 255.0 /end CHARACTERISTIC
/begin CHARACTERISTIC ASMod_swtTrbChRateSlct_C "schalten furTrbCh i/p auszuwählen im ASMod module" VALUE 0x8002F704 Val_Wu8 1.000 OneToOne 0.00 1.000 EXTENDED_LIMITS 0.00 255.0 /end CHARACTERISTIC
/begin CHARACTERISTIC ASMod_swtTrbnDynCorr_C "" VALUE 0x8002F705 Val_Wu8 255.0 OneToOne 0.00 255.0 /end CHARACTERISTIC
/begin CHARACTERISTIC ASMod_swtTrbnTempUs_C "" VALUE 0x8002F706 Val_Wu8 255.0 OneToOne 0.00 255.0 /end CHARACTERISTIC
/begin CHARACTERISTIC ASMod_swtTTrbnEnv_C "" VALUE 0x8002F707 Val_Wu8 1.000 OneToOne 0.00 1.000 EXTENDED_LIMITS 0.00 255.0 /end CHARACTERISTIC
/begin CHARACTERISTIC ASMod_swtTTrbnUs_C "" VALUE 0x8002F708 Val_Wu8 1.000 OneToOne 0.00 1.000 EXTENDED_LIMITS 0.00 255.0 /end CHARACTERISTIC
/begin CHARACTERISTIC ASMod_swtTTwinTrbnEnv_C "" VALUE 0x80030E1C Val_Wu8 1.000 OneToOne 0.00 1.000 EXTENDED_LIMITS 0.00 255.0 /end CHARACTERISTIC
/begin CHARACTERISTIC ASMod_tCmprInit_C "" VALUE 0x80030C78 Val_Ws16 130.0000 Temp_Cels -40.04000 89.96000 EXTENDED_LIMITS -3549.940 3003.560 /end CHARACTERISTIC
/begin CHARACTERISTIC ASMod_TempCmprHPI.Ki_C "/" VALUE 0x80030C7C Kw_Ws32 2.99885869026 Ki_Kelv_Sec 1.00117176771 4.00003045797 FORMAT "%13.11" EXTENDED_LIMITS -10000000.0000 9999999.99534 /end CHARACTERISTIC
/begin CHARACTERISTIC ASMod_TempCmprHPI.KiPos_C "/" VALUE 0x80030C80 Kw_Ws32 2.99885869026 Ki_Kelv_Sec 1.00117176771 4.00003045797 FORMAT "%13.11" EXTENDED_LIMITS -10000000.0000 9999999.99534 /end CHARACTERISTIC
/begin CHARACTERISTIC ASMod_TempCmprHPI.KiNeg_C "/" VALUE 0x80030C84 Kw_Ws32 2.99885869026 Ki_Kelv_Sec 1.00117176771 4.00003045797 FORMAT "%13.11" EXTENDED_LIMITS -10000000.0000 9999999.99534 /end CHARACTERISTIC
/begin CHARACTERISTIC ASMod_TempCmprHPI.WinPos_C "/" VALUE 0x80030C88 Kw_Ws32 65535.0000000 Temp_Kelv_Sec -32768.0000000 32767.0000000 FORMAT "%13.7" EXTENDED_LIMITS -21474836.4800 21474836.4700 /end CHARACTERISTIC
/begin CHARACTERISTIC ASMod_TempCmprHPI.WinNeg_C "/" VALUE 0x80030C8C Kw_Ws32 65535.0000000 Temp_Kelv_Sec -32768.0000000 32767.0000000 FORMAT "%13.7" EXTENDED_LIMITS -21474836.4800 21474836.4700 /end CHARACTERISTIC
/begin CHARACTERISTIC ASMod_TempCmprLPI.Ki_C "/" VALUE 0x80030C90 Kw_Ws32 2.99885869026 Ki_Kelv_Sec 1.00117176771 4.00003045797 FORMAT "%13.11" EXTENDED_LIMITS -10000000.0000 9999999.99534 /end CHARACTERISTIC
/begin CHARACTERISTIC ASMod_TempCmprLPI.KiPos_C "/" VALUE 0x80030C94 Kw_Ws32 2.99885869026 Ki_Kelv_Sec 1.00117176771 4.00003045797 FORMAT "%13.11" EXTENDED_LIMITS -10000000.0000 9999999.99534 /end CHARACTERISTIC
/begin CHARACTERISTIC ASMod_TempCmprLPI.KiNeg_C "/" VALUE 0x80030C98 Kw_Ws32 2.99885869026 Ki_Kelv_Sec 1.00117176771 4.00003045797 FORMAT "%13.11" EXTENDED_LIMITS -10000000.0000 9999999.99534 /end CHARACTERISTIC
/begin CHARACTERISTIC ASMod_TempCmprLPI.WinPos_C "/" VALUE 0x80030C9C Kw_Ws32 65535.0000000 Temp_Kelv_Sec -32768.0000000 32767.0000000 FORMAT "%13.7" EXTENDED_LIMITS -21474836.4800 21474836.4700 /end CHARACTERISTIC
/begin CHARACTERISTIC ASMod_TempCmprLPI.WinNeg_C "/" VALUE 0x80030CA0 Kw_Ws32 65535.0000000 Temp_Kelv_Sec -32768.0000000 32767.0000000 FORMAT "%13.7" EXTENDED_LIMITS -21474836.4800 21474836.4700 /end CHARACTERISTIC
/begin CHARACTERISTIC ASMod_TempOxiCI.Ki_C "Parameter für I-Glied im Temperaturmodell für den Katalysator/" VALUE 0x8002F084 Kw_Ws32 4.00003045797 Ki_Kelv_Sec 0.00 4.00003045797 FORMAT "%13.11" EXTENDED_LIMITS -10000000.0000 9999999.99534 /end CHARACTERISTIC
/begin CHARACTERISTIC ASMod_TempOxiCI.KiPos_C "Parameter für I-Glied im Temperaturmodell für den Katalysator/" VALUE 0x8002F088 Kw_Ws32 4.00003045797 Ki_Kelv_Sec 0.00 4.00003045797 FORMAT "%13.11" EXTENDED_LIMITS -10000000.0000 9999999.99534 /end CHARACTERISTIC
/begin CHARACTERISTIC ASMod_TempOxiCI.KiNeg_C "Parameter für I-Glied im Temperaturmodell für den Katalysator/" VALUE 0x8002F08C Kw_Ws32 4.00003045797 Ki_Kelv_Sec 0.00 4.00003045797 FORMAT "%13.11" EXTENDED_LIMITS -10000000.0000 9999999.99534 /end CHARACTERISTIC
/begin CHARACTERISTIC ASMod_TempOxiCI.WinPos_C "Parameter für I-Glied im Temperaturmodell für den Katalysator/" VALUE 0x8002F090 Kw_Ws32 65535.0000000 Temp_Kelv_Sec -32768.0000000 32767.0000000 FORMAT "%13.7" EXTENDED_LIMITS -21474836.4800 21474836.4700 /end CHARACTERISTIC
/begin CHARACTERISTIC ASMod_TempOxiCI.WinNeg_C "Parameter für I-Glied im Temperaturmodell für den Katalysator/" VALUE 0x8002F094 Kw_Ws32 65535.0000000 Temp_Kelv_Sec -32768.0000000 32767.0000000 FORMAT "%13.7" EXTENDED_LIMITS -21474836.4800 21474836.4700 /end CHARACTERISTIC
/begin CHARACTERISTIC ASMod_TempPFltDT1.T1_C "Parameter für DT1-Glied im Partikelfiltertemperaturmodell/" VALUE 0x8002F200 Kw_Ws32 15.016368168 TimeDelay_s 0.0010000000689 15.017368168 FORMAT "%12.9" EXTENDED_LIMITS 0.000002000000001 4294.9672960 /end CHARACTERISTIC
/begin CHARACTERISTIC ASMod_TempPFltDT1.Kd_C "Parameter für DT1-Glied im Partikelfiltertemperaturmodell/" VALUE 0x8002F204 Kw_Ws32 100.000000000 Kd -50.0000000000 50.0000000000 FORMAT "%13.10" EXTENDED_LIMITS -32768.0000000 32767.9999847 /end CHARACTERISTIC
/begin CHARACTERISTIC ASMod_TempPFltI.Ki_C "Parameter für I-Glied im Partikelfiltertemperaturmodell/" VALUE 0x8002F208 Kw_Ws32 9.99898475129 Ki_Ampc2Prc 0.00102318153949 10.0000079328 FORMAT "%13.10" EXTENDED_LIMITS -122070.312500 122070.312443 /end CHARACTERISTIC
/begin CHARACTERISTIC ASMod_TempPFltI.KiPos_C "Parameter für I-Glied im Partikelfiltertemperaturmodell/" VALUE 0x8002F20C Kw_Ws32 4.99898078488 Ki_Ampc2Prc 0.00102318153949 5.00000396642 FORMAT "%13.11" EXTENDED_LIMITS -122070.312500 122070.312443 /end CHARACTERISTIC
/begin CHARACTERISTIC ASMod_TempPFltI.KiNeg_C "Parameter für I-Glied im Partikelfiltertemperaturmodell/" VALUE 0x8002F210 Kw_Ws32 4.99898078488 Ki_Ampc2Prc 0.00102318153949 5.00000396642 FORMAT "%13.11" EXTENDED_LIMITS -122070.312500 122070.312443 /end CHARACTERISTIC
/begin CHARACTERISTIC ASMod_TempPFltI.WinPos_C "Parameter für I-Glied im Partikelfiltertemperaturmodell/" VALUE 0x8002F214 Kw_Ws32 65534.0000000 AirMassPerCyl -32767.0000000 32767.0000000 EXTENDED_LIMITS -214748364.800 214748364.700 /end CHARACTERISTIC
/begin CHARACTERISTIC ASMod_TempPFltI.WinNeg_C "Parameter für I-Glied im Partikelfiltertemperaturmodell/" VALUE 0x8002F218 Kw_Ws32 65534.0000000 AirMassPerCyl -32767.0000000 32767.0000000 EXTENDED_LIMITS -214748364.800 214748364.700 /end CHARACTERISTIC
/begin CHARACTERISTIC ASMod_TempPipeI.Ki_C "Parameter für I-Glied im Temperaturmodell für Rohrstücke/" VALUE 0x8002F2D4 Kw_Ws32 4.00003045797 Ki_Kelv_Sec 0.00 4.00003045797 FORMAT "%13.11" EXTENDED_LIMITS -10000000.0000 9999999.99534 /end CHARACTERISTIC
/begin CHARACTERISTIC ASMod_TempPipeI.KiPos_C "Parameter für I-Glied im Temperaturmodell für Rohrstücke/" VALUE 0x8002F2D8 Kw_Ws32 4.00003045797 Ki_Kelv_Sec 0.00 4.00003045797 FORMAT "%13.11" EXTENDED_LIMITS -10000000.0000 9999999.99534 /end CHARACTERISTIC
/begin CHARACTERISTIC ASMod_TempPipeI.KiNeg_C "Parameter für I-Glied im Temperaturmodell für Rohrstücke/" VALUE 0x8002F2DC Kw_Ws32 4.00003045797 Ki_Kelv_Sec 0.00 4.00003045797 FORMAT "%13.11" EXTENDED_LIMITS -10000000.0000 9999999.99534 /end CHARACTERISTIC
/begin CHARACTERISTIC ASMod_TempPipeI.WinPos_C "Parameter für I-Glied im Temperaturmodell für Rohrstücke/" VALUE 0x8002F2E0 Kw_Ws32 4294967295.00 OneToOne -2147483648.00 2147483647.00 /end CHARACTERISTIC
/begin CHARACTERISTIC ASMod_TempPipeI.WinNeg_C "Parameter für I-Glied im Temperaturmodell für Rohrstücke/" VALUE 0x8002F2E4 Kw_Ws32 4294967295.00 OneToOne -2147483648.00 2147483647.00 /end CHARACTERISTIC
/begin CHARACTERISTIC ASMod_TempPipeSlwI.Ki_C "Parameter für I-Glied im Temperaturmodell für Rohrstücke/" VALUE 0x8002F370 Kw_Ws32 4.00003045797 Ki_Kelv_Sec 0.00 4.00003045797 FORMAT "%13.11" EXTENDED_LIMITS -10000000.0000 9999999.99534 /end CHARACTERISTIC
/begin CHARACTERISTIC ASMod_TempPipeSlwI.KiPos_C "Parameter für I-Glied im Temperaturmodell für Rohrstücke/" VALUE 0x8002F374 Kw_Ws32 4.00003045797 Ki_Kelv_Sec 0.00 4.00003045797 FORMAT "%13.11" EXTENDED_LIMITS -10000000.0000 9999999.99534 /end CHARACTERISTIC
/begin CHARACTERISTIC ASMod_TempPipeSlwI.KiNeg_C "Parameter für I-Glied im Temperaturmodell für Rohrstücke/" VALUE 0x8002F378 Kw_Ws32 4.00003045797 Ki_Kelv_Sec 0.00 4.00003045797 FORMAT "%13.11" EXTENDED_LIMITS -10000000.0000 9999999.99534 /end CHARACTERISTIC
/begin CHARACTERISTIC ASMod_TempPipeSlwI.WinPos_C "Parameter für I-Glied im Temperaturmodell für Rohrstücke/" VALUE 0x8002F37C Kw_Ws32 4294967295.00 OneToOne -2147483648.00 2147483647.00 /end CHARACTERISTIC
/begin CHARACTERISTIC ASMod_TempPipeSlwI.WinNeg_C "Parameter für I-Glied im Temperaturmodell für Rohrstücke/" VALUE 0x8002F380 Kw_Ws32 4294967295.00 OneToOne -2147483648.00 2147483647.00 /end CHARACTERISTIC
/begin CHARACTERISTIC ASMod_tHPTrbnDynCor_MAP "" MAP 0x80030E1E Map_Xs16Ys16Ws16 500.0000 Temp_Cels -0.04000000 499.9600 EXTENDED_LIMITS -3549.940 3003.560
 /begin AXIS_DESCR STD_AXIS ASMod_aHPTrbnLim_mp Fact 4 0.00 1.000000 EXTENDED_LIMITS -4.000000 3.999878 DEPOSIT ABSOLUTE /end AXIS_DESCR
 /begin AXIS_DESCR STD_AXIS ASMod_dmHPTrbn_mp AirMassPerTime 4 0.00 1000.000 EXTENDED_LIMITS -3276.800 3276.700 DEPOSIT ABSOLUTE /end AXIS_DESCR
/end CHARACTERISTIC
/begin CHARACTERISTIC ASMod_tHPTrbnTempCor_MAP "" MAP 0x80030E52 Map_Xs16Ys16Ws16 1600.000 Temp_Cels -800.0400 799.9600 EXTENDED_LIMITS -3549.940 3003.560
 /begin AXIS_DESCR STD_AXIS ASMod_dtHPTrbnDsLim_mp Temp_Kelv1_Sec 4 -800.0000 800.0000 FORMAT "%8.4" EXTENDED_LIMITS -3276.800 3276.700 DEPOSIT ABSOLUTE /end AXIS_DESCR
 /begin AXIS_DESCR STD_AXIS ASMod_dmHPTrbn_mp AirMassPerTime 4 -3276.800 3276.700 DEPOSIT ABSOLUTE /end AXIS_DESCR
/end CHARACTERISTIC
/begin CHARACTERISTIC ASMod_tHPTrbnUsDT1.T1_C "/" VALUE 0x80030E88 Kw_Ws32 4294.9472960 TimeDelay_s 0.020000033975 4294.9672960 FORMAT "%12.7" EXTENDED_LIMITS 0.000002000000001 4294.9672960 /end CHARACTERISTIC
/begin CHARACTERISTIC ASMod_tHPTrbnUsDT1.Kd_C "/" VALUE 0x80030E8C Kw_Ws32 4000.00000000 Kd 0.00 4000.00000000 FORMAT "%13.8" EXTENDED_LIMITS -32768.0000000 32767.9999847 /end CHARACTERISTIC
/begin CHARACTERISTIC ASMod_tHPTrbnUsRef_C "" VALUE 0x80030E90 Val_Ws16 1030.000 Temp_Cels -30.04000 999.9600 EXTENDED_LIMITS -3549.940 3003.560 /end CHARACTERISTIC
/begin CHARACTERISTIC ASMod_tiClgOfs_C "Korrektur der Abkühlzeit wg. Stauwärmeeffekten" VALUE 0x8002F3D4 Val_Ws32 40000000.0000 Time_s 0.00 40000000.0000 EXTENDED_LIMITS -21474836.4800 21474836.4700 /end CHARACTERISTIC
/begin CHARACTERISTIC ASMod_tiExhGsDelPFlt_CUR "Wärmeübertragungszeit" CURVE 0x8002F21C Cur_Xs16Ws16 15.00000 Time_s 0.00 15.00000 EXTENDED_LIMITS -327.6800 327.6700
 /begin AXIS_DESCR STD_AXIS ASMod_dmPFltUsCrvIn_mp AirMassPerTime 8 -1000.000 1000.000 EXTENDED_LIMITS -3276.800 3276.700 DEPOSIT ABSOLUTE /end AXIS_DESCR
/end CHARACTERISTIC
/begin CHARACTERISTIC ASMod_tiHaValClnt_C "Abkühl-Halbwertszeit des Motors" VALUE 0x8002F3D8 Val_Ws32 40000000.0000 Time_s 0.00 40000000.0000 EXTENDED_LIMITS -21474836.4800 21474836.4700 /end CHARACTERISTIC
/begin CHARACTERISTIC ASMod_tiHaValOxiC_CA "Array mit Abkühl-Halbwertszeit des OxiC" VAL_BLK 0x8002F3DC ValA_Ws32 42949672.9500 Time_s -21474836.4800 21474836.4700 NUMBER 1 /end CHARACTERISTIC
/begin CHARACTERISTIC ASMod_tiHaValPipe_CA "Abkühl-Halbwertszeit der Abgasrohre" VAL_BLK 0x8002F3E0 ValA_Ws32 40000000.0000 Time_s 0.00 40000000.0000 EXTENDED_LIMITS -21474836.4800 21474836.4700 NUMBER 7 /end CHARACTERISTIC
/begin CHARACTERISTIC ASMod_tiHPCmprBypVlvPT1_C "" VALUE 0x80030CA4 Val_Wr32 3999.00000 Time_s_float 1.00000000 4000.00000 FORMAT "%10.5" EXTENDED_LIMITS -1.00000000E+037 1.00000000E+037 /end CHARACTERISTIC
/begin CHARACTERISTIC ASMod_tiHPTrbnAdbtUsPT1_C "" VALUE 0x80030E92 Val_Ws16 4293.9673036 TimeDelay_s 0.99999238556 4294.9672960 FORMAT "%12.7" EXTENDED_LIMITS 0.13107600012 4294.9672960 /end CHARACTERISTIC
/begin CHARACTERISTIC ASMod_tiHPTrbnDynPT1_C "" VALUE 0x80030E94 Val_Ws16 4293.9673036 TimeDelay_s 0.99999238556 4294.9672960 FORMAT "%12.7" EXTENDED_LIMITS 0.13107600012 4294.9672960 /end CHARACTERISTIC
/begin CHARACTERISTIC ASMod_tiHPTrbnPresUsPT1_C "" VALUE 0x80030E96 Val_Ws16 4293.9673036 TimeDelay_s 0.99999238556 4294.9672960 FORMAT "%12.7" EXTENDED_LIMITS 0.13107600012 4294.9672960 /end CHARACTERISTIC
/begin CHARACTERISTIC ASMod_tiHPTrbnTempPT1_C "" VALUE 0x80030E98 Val_Ws16 4293.9673036 TimeDelay_s 0.99999238556 4294.9672960 FORMAT "%12.7" EXTENDED_LIMITS 0.13107600012 4294.9672960 /end CHARACTERISTIC
/begin CHARACTERISTIC ASMod_tiHPTrbnTempUsPT1_C "" VALUE 0x80030E9A Val_Ws16 4293.9673036 TimeDelay_s 0.99999238556 4294.9672960 FORMAT "%12.7" EXTENDED_LIMITS 0.13107600012 4294.9672960 /end CHARACTERISTIC
/begin CHARACTERISTIC ASMod_tiHtTransDT1_CUR "Filter-Zeitkonstante entsprechend Temperatursensor vor PFlt" CURVE 0x8002F23E Cur_Xs16Ws16 15.00000 Time_s 0.00 15.00000 EXTENDED_LIMITS -327.6800 327.6700
 /begin AXIS_DESCR STD_AXIS ASMod_dmPFltUsCrvIn_mp AirMassPerTime 8 -1000.000 1000.000 EXTENDED_LIMITS -3276.800 3276.700 DEPOSIT ABSOLUTE /end AXIS_DESCR
/end CHARACTERISTIC
/begin CHARACTERISTIC ASMod_tiLamSensDdt_CUR "Totzeit des Verzögerungsglieds in der Funktion Lambda-Sensor" CURVE 0x8002ECB4 Cur_Xs16Ws16 0.3200000 Time_sec 0.00 0.3200000 FORMAT "%9.7" EXTENDED_LIMITS -32.76800 32.76700
 /begin AXIS_DESCR STD_AXIS ASMod_dmExhMnfDs AirMassPerTime 8 0.00 1400.000 EXTENDED_LIMITS -3276.800 3276.700 DEPOSIT ABSOLUTE /end AXIS_DESCR
/end CHARACTERISTIC
/begin CHARACTERISTIC ASMod_tiLamSensPT1_CUR "Zeitkonstante des PT1-Glieds in der Funktion Lambda-Sonde" CURVE 0x8002ECD6 Cur_Xs16Ws16 5.000000 TimeDelay_s_Lin_16 0.00 5.000000 FORMAT "%8.6" EXTENDED_LIMITS -5.000153 5.000000
 /begin AXIS_DESCR STD_AXIS ASMod_dmExhMnfDs AirMassPerTime 8 0.00 1400.000 EXTENDED_LIMITS -3276.800 3276.700 DEPOSIT ABSOLUTE /end AXIS_DESCR
/end CHARACTERISTIC
/begin CHARACTERISTIC ASMod_tiLPTrbnAdbtUsPT1_C "" VALUE 0x80030E9C Val_Ws16 4293.9673036 TimeDelay_s 0.99999238556 4294.9672960 FORMAT "%12.7" EXTENDED_LIMITS 0.13107600012 4294.9672960 /end CHARACTERISTIC
/begin CHARACTERISTIC ASMod_tiLPTrbnDynPT1_C "" VALUE 0x80030E9E Val_Ws16 4293.9673036 TimeDelay_s 0.99999238556 4294.9672960 FORMAT "%12.7" EXTENDED_LIMITS 0.13107600012 4294.9672960 /end CHARACTERISTIC
/begin CHARACTERISTIC ASMod_tiLPTrbnPresUsPT1_C "" VALUE 0x80030EA0 Val_Ws16 4293.9673036 TimeDelay_s 0.99999238556 4294.9672960 FORMAT "%12.7" EXTENDED_LIMITS 0.13107600012 4294.9672960 /end CHARACTERISTIC
/begin CHARACTERISTIC ASMod_tiLPTrbnTempPT1_C "" VALUE 0x80030EA2 Val_Ws16 4293.9673036 TimeDelay_s 0.99999238556 4294.9672960 FORMAT "%12.7" EXTENDED_LIMITS 0.13107600012 4294.9672960 /end CHARACTERISTIC
/begin CHARACTERISTIC ASMod_tiLPTrbnTempUsPT1_C "" VALUE 0x80030EA4 Val_Ws16 4293.9673036 TimeDelay_s 0.99999238556 4294.9672960 FORMAT "%12.7" EXTENDED_LIMITS 0.13107600012 4294.9672960 /end CHARACTERISTIC
/begin CHARACTERISTIC ASMod_tIntMnfDsRef_MAP "Referenz der Gastemperatur nach Einlasskrümmer" MAP 0x80031258 Map_Xs16Ys16Ws16 150.0000 Temp_Cels -50.04000 99.96000 EXTENDED_LIMITS -3549.940 3003.560
 /begin AXIS_DESCR STD_AXIS Epm_nEng EngN 10 0.00 10000.00 EXTENDED_LIMITS -16384.00 16383.50 DEPOSIT ABSOLUTE /end AXIS_DESCR
 /begin AXIS_DESCR STD_AXIS ASMod_qSetUnBalCrvIn_mp InjMass 10 0.00 327.6700 EXTENDED_LIMITS -327.6800 327.6700 DEPOSIT ABSOLUTE /end AXIS_DESCR
/end CHARACTERISTIC
/begin CHARACTERISTIC ASMod_tiOxiCPT1EOM_CUR "" CURVE 0x8002F098 Kl_Xs16_Ws16 4000.000 TimeDelay_s_Lin_16_2 0.00 4000.000 FORMAT "%8.3" EXTENDED_LIMITS -2000.061 2000.000
 /begin AXIS_DESCR STD_AXIS ASMod_dmOxiCPT1EOM_mp AirMassPerTime 8 0.00 1050.000 EXTENDED_LIMITS -3276.800 3276.700 DEPOSIT ABSOLUTE /end AXIS_DESCR
/end CHARACTERISTIC
/begin CHARACTERISTIC ASMod_tiOxiCPT1Nrm_C "" VALUE 0x8002F0BC Kw_Wu32 4294.9672950 TimeDelay_s 0.000001000000000 4294.9672960 FORMAT "%12.7" /end CHARACTERISTIC
/begin CHARACTERISTIC ASMod_tiPFltPT1_C "Filterzeitkonstante für Oberflächentemperatursimulation" VALUE 0x8002F260 Val_Ws32 15.016368168 TimeDelay_s 0.0010000000689 15.017368168 FORMAT "%12.9" EXTENDED_LIMITS 0.000002000000001 4294.9672960 /end CHARACTERISTIC
/begin CHARACTERISTIC ASMod_tiPT1DmPFltUs_C "Filterparameter für den PT1- Filter von ASMod_dmPFltUs" VALUE 0x8002F264 Val_Ws32 4294.9672940 TimeDelay_s 0.000002000000001 4294.9672960 FORMAT "%12.7" /end CHARACTERISTIC
/begin CHARACTERISTIC ASMod_tiTrbChPosPT1_C "" VALUE 0x8002F70A Val_Ws16 4293.9673036 TimeDelay_s 0.99999238556 4294.9672960 FORMAT "%12.7" EXTENDED_LIMITS 0.13107600012 4294.9672960 /end CHARACTERISTIC
/begin CHARACTERISTIC ASMod_tiTrbnAdbtUsPT1_C "" VALUE 0x8002F70C Val_Ws16 4293.9673036 TimeDelay_s 0.99999238556 4294.9672960 FORMAT "%12.7" EXTENDED_LIMITS 0.13107600012 4294.9672960 /end CHARACTERISTIC
/begin CHARACTERISTIC ASMod_tiTrbnDynPT1_C "" VALUE 0x8002F70E Val_Ws16 4293.9673036 TimeDelay_s 0.99999238556 4294.9672960 FORMAT "%12.7" EXTENDED_LIMITS 0.13107600012 4294.9672960 /end CHARACTERISTIC
/begin CHARACTERISTIC ASMod_tiTrbnPresUsPT1_C "" VALUE 0x8002F710 Val_Ws16 4293.9673036 TimeDelay_s 0.99999238556 4294.9672960 FORMAT "%12.7" EXTENDED_LIMITS 0.13107600012 4294.9672960 /end CHARACTERISTIC
/begin CHARACTERISTIC ASMod_tiTrbnPT1_C "Feste Zeitkonstante PT1-Filter" VALUE 0x8002F714 Val_Ws32 4294.9662960 TimeDelay_s 0.0010000000689 4294.9672960 FORMAT "%12.7" EXTENDED_LIMITS 0.000002000000001 4294.9672960 /end CHARACTERISTIC
/begin CHARACTERISTIC ASMod_tiTrbnTempPT1_C "" VALUE 0x8002F718 Val_Ws16 4293.9673036 TimeDelay_s 0.99999238556 4294.9672960 FORMAT "%12.7" EXTENDED_LIMITS 0.13107600012 4294.9672960 /end CHARACTERISTIC
/begin CHARACTERISTIC ASMod_tiTrbnTempUsPT1_C "" VALUE 0x8002F71A Val_Ws16 4293.9673036 TimeDelay_s 0.99999238556 4294.9672960 FORMAT "%12.7" EXTENDED_LIMITS 0.13107600012 4294.9672960 /end CHARACTERISTIC
/begin CHARACTERISTIC ASMod_tLPTrbnDynCor_MAP "" MAP 0x80030EA6 Map_Xs16Ys16Ws16 500.0000 Temp_Cels -0.04000000 499.9600 EXTENDED_LIMITS -3549.940 3003.560
 /begin AXIS_DESCR STD_AXIS ASMod_aLPTrbnLim_mp Fact 4 0.00 1.000000 EXTENDED_LIMITS -4.000000 3.999878 DEPOSIT ABSOLUTE /end AXIS_DESCR
 /begin AXIS_DESCR STD_AXIS ASMod_dmLPTrbn_mp AirMassPerTime 4 0.00 1000.000 EXTENDED_LIMITS -3276.800 3276.700 DEPOSIT ABSOLUTE /end AXIS_DESCR
/end CHARACTERISTIC
/begin CHARACTERISTIC ASMod_tLPTrbnTempCor_MAP "" MAP 0x80030EDA Map_Xs16Ys16Ws16 1600.000 Temp_Cels -800.0400 799.9600 EXTENDED_LIMITS -3549.940 3003.560
 /begin AXIS_DESCR STD_AXIS ASMod_dtLPTrbnDsLim_mp Temp_Kelv1_Sec 4 -800.0000 800.0000 FORMAT "%8.4" EXTENDED_LIMITS -3276.800 3276.700 DEPOSIT ABSOLUTE /end AXIS_DESCR
 /begin AXIS_DESCR STD_AXIS ASMod_dmLPTrbn_mp AirMassPerTime 4 0.00 1000.000 EXTENDED_LIMITS -3276.800 3276.700 DEPOSIT ABSOLUTE /end AXIS_DESCR
/end CHARACTERISTIC
/begin CHARACTERISTIC ASMod_tLPTrbnUsDT1.T1_C "/" VALUE 0x80030F10 Kw_Ws32 4294.9472960 TimeDelay_s 0.020000033975 4294.9672960 FORMAT "%12.7" EXTENDED_LIMITS 0.000002000000001 4294.9672960 /end CHARACTERISTIC
/begin CHARACTERISTIC ASMod_tLPTrbnUsDT1.Kd_C "/" VALUE 0x80030F14 Kw_Ws32 4000.00000000 Kd 0.00 4000.00000000 FORMAT "%13.8" EXTENDED_LIMITS -32768.0000000 32767.9999847 /end CHARACTERISTIC
/begin CHARACTERISTIC ASMod_tLPTrbnUsRef_C "" VALUE 0x80030F18 Val_Ws16 1030.000 Temp_Cels -30.04000 999.9600 EXTENDED_LIMITS -3549.940 3003.560 /end CHARACTERISTIC
/begin CHARACTERISTIC ASMod_tOxiCatUsDT1.T1_C "/" VALUE 0x8002F71C Kw_Ws32 4294.9472960 TimeDelay_s 0.020000033975 4294.9672960 FORMAT "%12.7" EXTENDED_LIMITS 0.000002000000001 4294.9672960 /end CHARACTERISTIC
/begin CHARACTERISTIC ASMod_tOxiCatUsDT1.Kd_C "/" VALUE 0x8002F720 Kw_Ws32 4000.00000000 Kd 0.00 4000.00000000 FORMAT "%13.8" EXTENDED_LIMITS -32768.0000000 32767.9999847 /end CHARACTERISTIC
/begin CHARACTERISTIC ASMod_tOxiCDfl_CA "Ersatzwert Temperatur des Oxidationskatalysators im Fehlerfall" VAL_BLK 0x8002F0C0 ValA_Ws16 1030.000 Temp_Cels -30.04000 999.9600 EXTENDED_LIMITS -3549.940 3003.560 NUMBER 1 /end CHARACTERISTIC
/begin CHARACTERISTIC ASMod_tOxiCExoIncr_MAP "Kennfeld für Temperaturerhöhung im Oxidationskatalysator aufgrund chemischer Reaktionen" MAP 0x8002F0C2 Kf_Xs16_Ys16_Ws16 1095.000 TempDiff_Kelv -45.00000 1050.000 EXTENDED_LIMITS -3276.800 3276.700
 /begin AXIS_DESCR STD_AXIS Epm_nEng EngN 6 0.00 6000.000 EXTENDED_LIMITS -16384.00 16383.50 DEPOSIT ABSOLUTE /end AXIS_DESCR
 /begin AXIS_DESCR STD_AXIS InjCtl_qSetUnBal InjMass 6 0.00 200.0000 EXTENDED_LIMITS -327.6800 327.6700 DEPOSIT ABSOLUTE /end AXIS_DESCR
/end CHARACTERISTIC
/begin CHARACTERISTIC ASMod_tPipeDflSlw_C "Ersatzwert der berechneten Temperatur im Fehlerfall" VALUE 0x8002F384 Val_Ws16 1030.000 Temp_Cels -30.04000 999.9600 EXTENDED_LIMITS -3549.940 3003.560 /end CHARACTERISTIC
/begin CHARACTERISTIC ASMod_tPipeDfl_C "Ersatzwert der berechneten Temperatur im Fehlerfall" VALUE 0x8002F2E8 Val_Ws16 1030.000 Temp_Cels -30.04000 999.9600 EXTENDED_LIMITS -3549.940 3003.560 /end CHARACTERISTIC
/begin CHARACTERISTIC ASMod_tStrtDfl_C "Ersatzwert für Initialisierungstemperaturen im Fehlerfall" VALUE 0x8002F3FC Val_Ws16 1040.000 Temp_Cels -40.04000 999.9600 EXTENDED_LIMITS -3549.940 3003.560 /end CHARACTERISTIC
/begin CHARACTERISTIC ASMod_tTrbnDsRawDfl_C "Ersatzwert für Rohwert Abgastemperatur nach Turbolader im Fehlerfall" VALUE 0x8002F724 Val_Ws16 1030.000 Temp_Cels -30.04000 999.9600 EXTENDED_LIMITS -3549.940 3003.560 /end CHARACTERISTIC
/begin CHARACTERISTIC ASMod_tTrbnDynCorr_MAP "" MAP 0x8002F726 Map_Xs16Ys16Ws16 500.0000 Temp_Cels -0.04000000 499.9600 EXTENDED_LIMITS -3549.940 3003.560
 /begin AXIS_DESCR STD_AXIS ASMod_aTrbChPos_mp Fact 4 0.00 1.000000 EXTENDED_LIMITS -4.000000 3.999878 DEPOSIT ABSOLUTE /end AXIS_DESCR
 /begin AXIS_DESCR STD_AXIS ASMod_dmExhMnfDs AirMassPerTime 4 0.00 1000.000 EXTENDED_LIMITS -3276.800 3276.700 DEPOSIT ABSOLUTE /end AXIS_DESCR
/end CHARACTERISTIC
/begin CHARACTERISTIC ASMod_tTrbnTempCor_MAP "" MAP 0x8002F75A Map_Xs16Ys16Ws16 500.0000 Temp_Cels -0.04000000 499.9600 EXTENDED_LIMITS -3549.940 3003.560
 /begin AXIS_DESCR STD_AXIS ASMod_dtOxiCatUsLim_mp Temp_Kelv1_Sec 4 -3276.800 3276.700 FORMAT "%8.3" DEPOSIT ABSOLUTE /end AXIS_DESCR
 /begin AXIS_DESCR STD_AXIS ASMod_dmExhMnfDs AirMassPerTime 4 0.00 1000.000 EXTENDED_LIMITS -3276.800 3276.700 DEPOSIT ABSOLUTE /end AXIS_DESCR
/end CHARACTERISTIC
/begin CHARACTERISTIC ASMod_tTrbnUsRef_C "" VALUE 0x8002F78E Val_Ws16 1030.000 Temp_Cels -30.04000 999.9600 EXTENDED_LIMITS -3549.940 3003.560 /end CHARACTERISTIC
/begin CHARACTERISTIC ASMod_tWallPipeDflSlw_C "Ersatzwert der berechneten Rohrwandtemperatur im Fehlerfall" VALUE 0x8002F386 Val_Ws16 1030.000 Temp_Cels -30.04000 999.9600 EXTENDED_LIMITS -3549.940 3003.560 /end CHARACTERISTIC
/begin CHARACTERISTIC ASMod_tWallPipeDfl_C "Ersatzwert der berechneten Rohrwandtemperatur im Fehlerfall" VALUE 0x8002F2EA Val_Ws16 1030.000 Temp_Cels -30.04000 999.9600 EXTENDED_LIMITS -3549.940 3003.560 /end CHARACTERISTIC
/begin CHARACTERISTIC ASMod_volEng_C "Hubvolumen des Motors" VALUE 0x8003134C Val_Ws16 20.00000 Vol 0.00 20.00000 FORMAT "%8.5" EXTENDED_LIMITS -327.6800 327.6700 /end CHARACTERISTIC
/begin CHARACTERISTIC ASMod_volIndVol_C "Einlassvolumen zwischen Verdichter und Mischstelle im Einlasskrümmer" VALUE 0x8002ECAC Val_Wr32 50.0000000 Vol_float 0.00 50.0000000 FORMAT "%10.7" EXTENDED_LIMITS -1.00000000E+037 1.00000000E+037 /end CHARACTERISTIC
/begin CHARACTERISTIC ASMod_vscDynOfsSlw_C "Offsetwert für dynamische Viskosität" VALUE 0x8002F388 Val_Ws16 0.05004883 Fact -0.03002930 0.02001953 EXTENDED_LIMITS -4.000000 3.999878 READ_ONLY /end CHARACTERISTIC
/begin CHARACTERISTIC ASMod_vscDynOfs_C "Offsetwert für dynamische Viskosität" VALUE 0x8002F2EC Val_Ws16 0.05004883 Fact -0.03002930 0.02001953 EXTENDED_LIMITS -4.000000 3.999878 READ_ONLY /end CHARACTERISTIC
/begin CHARACTERISTIC ASMod_vscKinOfsSlw_C "Offsetwert für kinematische Viskosität" VALUE 0x8002F38A Val_Ws16 0.00005300000 Fact8 -0.00006000000 -0.000007000000 FORMAT "%13.11" EXTENDED_LIMITS -0.0003276800 0.0003276700 READ_ONLY /end CHARACTERISTIC
/begin CHARACTERISTIC ASMod_vscKinOfs_C "Offsetwert für kinematische Viskosität" VALUE 0x8002F2EE Val_Ws16 0.00005300000 Fact8 -0.00006000000 -0.000007000000 FORMAT "%13.11" EXTENDED_LIMITS -0.0003276800 0.0003276700 READ_ONLY /end CHARACTERISTIC
/begin CHARACTERISTIC ATS_Com_PSP_ATS.LimitTypeMsk_C "/Tester Anforderungs Überwachungs Maske für Steller" VALUE 0x80031370 Val_Wu8 255.0 OneToOne 0.00 255.0 /end CHARACTERISTIC
/begin CHARACTERISTIC ATS_Com_PSP_ATS.CnvNorm_C "/Normierung für die Umrechnung" VALUE 0x80031371 Val_Wu8 255.0 OneToOne 0.00 255.0 /end CHARACTERISTIC
/begin CHARACTERISTIC ATS_Com_PSP_ATS.LowLim_C "/Untere Grenze für das Monitoring" VALUE 0x80031372 Val_Ws16 655.3500 FlConsum_l_h -327.6800 327.6700 FORMAT "%8.4" /end CHARACTERISTIC
/begin CHARACTERISTIC ATS_Com_PSP_ATS.UpLim_C "/Obere Grenze für das Monitoring" VALUE 0x80031374 Val_Ws16 655.3500 FlConsum_l_h -327.6800 327.6700 FORMAT "%8.4" /end CHARACTERISTIC
/begin CHARACTERISTIC ATS_Com_PSP_ATS.CnvFac_C "/Faktor für die Umrechnung" VALUE 0x80031378 Val_Ws32 4294967295.00 OneToOne -2147483648.00 2147483647.00 /end CHARACTERISTIC
/begin CHARACTERISTIC ATS_Com_PSP_ATS.CnvOfs_C "/Offset für die Umrechnung" VALUE 0x8003137C Val_Ws16 65535.00 OneToOne -32768.00 32767.00 /end CHARACTERISTIC
/begin CHARACTERISTIC ATS_Com_PSP_ATS.DfltVal_C "/Vorgabewert für standbytest" VALUE 0x8003137E Val_Ws16 65535.00 OneToOne -32768.00 32767.00 /end CHARACTERISTIC
/begin CHARACTERISTIC ATS_Standby_Disabled_C "Standbytest aktivieren oder deaktivieren" VALUE 0x80031380 Val_Wu8 255.0 OneToOne 0.00 255.0 /end CHARACTERISTIC
/begin CHARACTERISTIC ATS_tiTstDemHeal_C "Mindestzeit ohne Stellertest für Wiederfreigabe nach Zeitgrenze" VALUE 0x80031382 Val_Wu16 655.3500 Time_s 0.00 655.3500 /end CHARACTERISTIC
/begin CHARACTERISTIC ATS_tiTstDemMax_C "Maximal zulässige Stellertestzeit" VALUE 0x80031384 Val_Wu16 655.3500 Time_s 0.00 655.3500 /end CHARACTERISTIC
/begin CHARACTERISTIC ATS_TmrBehaviour_C "Verhalten Zeitlimit bei neuen Testeranforderungen" VALUE 0x80031386 Val_Wu8 255.0 OneToOne 0.00 255.0 /end CHARACTERISTIC
/begin CHARACTERISTIC ATS_TstDemMaxEngN_C "Maximal zulässige Drehzahl für Stellertest" VALUE 0x80031387 Val_Wu8 10200. EngN_LRes 0.00 10200. FORMAT "%5.0" /end CHARACTERISTIC
/begin CHARACTERISTIC ATS_TstDemMaxVSSCDV_C "Maximal zulässige Geschwindigkeit für Stellertest" VALUE 0x80031388 Val_Ws16 655.3500 Vel -327.6800 327.6700 /end CHARACTERISTIC
/begin CHARACTERISTIC BattU_RmpSlp.Pos_C "/" VALUE 0x80037A28 Kw_Ws32 655358999.634 RmpVoltBatt 1000.06103516 655359999.695 FORMAT "%13.3" EXTENDED_LIMITS -655360000.000 655359999.695 /end CHARACTERISTIC
/begin CHARACTERISTIC BattU_RmpSlp.Neg_C "/" VALUE 0x80037A2C Kw_Ws32 655358999.634 RmpVoltBatt 1000.06103516 655359999.695 FORMAT "%13.3" EXTENDED_LIMITS -655360000.000 655359999.695 /end CHARACTERISTIC
/begin CHARACTERISTIC BattU_swtRated_C "Schalter zur Auswahl der Nennspannung" VALUE 0x80037A30 Val_Wu8 255.0 OneToOne 0.00 255.0 /end CHARACTERISTIC
/begin CHARACTERISTIC BattU_TransStagePar.Dfl_C "/" VALUE 0x80037A32 Kw_Ws16 28600.00 Volt_Batt 0.00 28600.00 EXTENDED_LIMITS -655360.0 655340.0 /end CHARACTERISTIC
/begin CHARACTERISTIC BattU_TransStagePar.stSensId_C "/" VALUE 0x80037A34 Kw_Wu8 255.0 OneToOne 0.00 255.0 /end CHARACTERISTIC
/begin CHARACTERISTIC BattU_uNrm_C "Normale Batteriespannung zur Berechnung des Korrekturfaktors" VALUE 0x80037A36 Val_Ws16 655340.0 Volt_Batt 0.00 655340.0 EXTENDED_LIMITS -655360.0 655340.0 /end CHARACTERISTIC
/begin CHARACTERISTIC BattU_uSRCMax_C "Schwelle des SRC-Max-Fehlers" VALUE 0x80037A38 Val_Ws16 5200.000 Volt 0.00 5200.000 EXTENDED_LIMITS -6553.600 6553.400 /end CHARACTERISTIC
/begin CHARACTERISTIC BattU_uSRCMin_C "Schwelle des SRC-Min-Fehlers" VALUE 0x80037A3A Val_Ws16 5200.000 Volt 0.00 5200.000 EXTENDED_LIMITS -6553.600 6553.400 /end CHARACTERISTIC
/begin CHARACTERISTIC BattU_uTransf_CUR "Umwandlungskennlinie für Batteriespannung" CURVE 0x80037A1E Cur_Xs16Ws16 28600.00 Volt_Batt 0.00 28600.00 EXTENDED_LIMITS -655360.0 655340.0
 /begin AXIS_DESCR STD_AXIS BattU_uRaw Volt 2 0.00 5199.000 EXTENDED_LIMITS -6553.600 6553.400 DEPOSIT ABSOLUTE /end AXIS_DESCR
/end CHARACTERISTIC
/begin CHARACTERISTIC CByVlv_ATS.LimitTypeMsk_C "Steller Test CByVlv_ATS/Tester Anforderungs Überwachungs Maske für Steller" VALUE 0x8003138C Val_Wu8 255.0 OneToOne 0.00 255.0 /end CHARACTERISTIC
/begin CHARACTERISTIC CByVlv_ATS.CnvNorm_C "Steller Test CByVlv_ATS/Normierung für die Umrechnung" VALUE 0x8003138D Val_Wu8 255.0 OneToOne 0.00 255.0 /end CHARACTERISTIC
/begin CHARACTERISTIC CByVlv_ATS.LowLim_C "Steller Test CByVlv_ATS/Untere Grenze für das Monitoring" VALUE 0x8003138E Val_Ws16 65535.00 OneToOne -32768.00 32767.00 /end CHARACTERISTIC
/begin CHARACTERISTIC CByVlv_ATS.UpLim_C "Steller Test CByVlv_ATS/Obere Grenze für das Monitoring" VALUE 0x80031390 Val_Ws16 65535.00 OneToOne -32768.00 32767.00 /end CHARACTERISTIC
/begin CHARACTERISTIC CByVlv_ATS.CnvFac_C "Steller Test CByVlv_ATS/Faktor für die Umrechnung" VALUE 0x80031394 Val_Ws32 4294967295.00 OneToOne -2147483648.00 2147483647.00 /end CHARACTERISTIC
/begin CHARACTERISTIC CByVlv_ATS.CnvOfs_C "Steller Test CByVlv_ATS/Offset für die Umrechnung" VALUE 0x80031398 Val_Ws16 65535.00 OneToOne -32768.00 32767.00 /end CHARACTERISTIC
/begin CHARACTERISTIC CByVlv_ATS.DfltVal_C "Steller Test CByVlv_ATS/Vorgabewert für standbytest" VALUE 0x8003139A Val_Ws16 65535.00 OneToOne -32768.00 32767.00 /end CHARACTERISTIC
/begin CHARACTERISTIC CThmst_ATS.LimitTypeMsk_C "Steller Test CThmst_ATS/Tester Anforderungs Überwachungs Maske für Steller" VALUE 0x8003139C Val_Wu8 255.0 OneToOne 0.00 255.0 /end CHARACTERISTIC
/begin CHARACTERISTIC CThmst_ATS.CnvNorm_C "Steller Test CThmst_ATS/Normierung für die Umrechnung" VALUE 0x8003139D Val_Wu8 255.0 OneToOne 0.00 255.0 /end CHARACTERISTIC
/begin CHARACTERISTIC CThmst_ATS.LowLim_C "Steller Test CThmst_ATS/Untere Grenze für das Monitoring" VALUE 0x8003139E Val_Ws16 799.9878 Prc -400.0000 399.9878 /end CHARACTERISTIC
/begin CHARACTERISTIC CThmst_ATS.UpLim_C "Steller Test CThmst_ATS/Obere Grenze für das Monitoring" VALUE 0x800313A0 Val_Ws16 799.9878 Prc -400.0000 399.9878 /end CHARACTERISTIC
/begin CHARACTERISTIC CThmst_ATS.CnvFac_C "Steller Test CThmst_ATS/Faktor für die Umrechnung" VALUE 0x800313A4 Val_Ws32 4294967295.00 OneToOne -2147483648.00 2147483647.00 /end CHARACTERISTIC
/begin CHARACTERISTIC CThmst_ATS.CnvOfs_C "Steller Test CThmst_ATS/Offset für die Umrechnung" VALUE 0x800313A8 Val_Ws16 65535.00 OneToOne -32768.00 32767.00 /end CHARACTERISTIC
/begin CHARACTERISTIC CThmst_ATS.DfltVal_C "Steller Test CThmst_ATS/Vorgabewert für standbytest" VALUE 0x800313AA Val_Ws16 65535.00 OneToOne -32768.00 32767.00 /end CHARACTERISTIC
/begin CHARACTERISTIC EBxFan_ATS.LimitTypeMsk_C "Steller Test EBxFan_ATS/Tester Anforderungs Überwachungs Maske für Steller" VALUE 0x800313AC Val_Wu8 255.0 OneToOne 0.00 255.0 /end CHARACTERISTIC
/begin CHARACTERISTIC EBxFan_ATS.CnvNorm_C "Steller Test EBxFan_ATS/Normierung für die Umrechnung" VALUE 0x800313AD Val_Wu8 255.0 OneToOne 0.00 255.0 /end CHARACTERISTIC
/begin CHARACTERISTIC EBxFan_ATS.LowLim_C "Steller Test EBxFan_ATS/Untere Grenze für das Monitoring" VALUE 0x800313AE Val_Ws16 65535.00 OneToOne -32768.00 32767.00 /end CHARACTERISTIC
/begin CHARACTERISTIC EBxFan_ATS.UpLim_C "Steller Test EBxFan_ATS/Obere Grenze für das Monitoring" VALUE 0x800313B0 Val_Ws16 65535.00 OneToOne -32768.00 32767.00 /end CHARACTERISTIC
/begin CHARACTERISTIC EBxFan_ATS.CnvFac_C "Steller Test EBxFan_ATS/Faktor für die Umrechnung" VALUE 0x800313B4 Val_Ws32 4294967295.00 OneToOne -2147483648.00 2147483647.00 /end CHARACTERISTIC
/begin CHARACTERISTIC EBxFan_ATS.CnvOfs_C "Steller Test EBxFan_ATS/Offset für die Umrechnung" VALUE 0x800313B8 Val_Ws16 65535.00 OneToOne -32768.00 32767.00 /end CHARACTERISTIC
/begin CHARACTERISTIC EBxFan_ATS.DfltVal_C "Steller Test EBxFan_ATS/Vorgabewert für standbytest" VALUE 0x800313BA Val_Ws16 65535.00 OneToOne -32768.00 32767.00 /end CHARACTERISTIC
/begin CHARACTERISTIC ECBVlv_ATS.LimitTypeMsk_C "Steller Test ECBVlv_ATS/Tester Anforderungs Überwachungs Maske für Steller" VALUE 0x800313BC Val_Wu8 255.0 OneToOne 0.00 255.0 /end CHARACTERISTIC
/begin CHARACTERISTIC ECBVlv_ATS.CnvNorm_C "Steller Test ECBVlv_ATS/Normierung für die Umrechnung" VALUE 0x800313BD Val_Wu8 255.0 OneToOne 0.00 255.0 /end CHARACTERISTIC
/begin CHARACTERISTIC ECBVlv_ATS.LowLim_C "Steller Test ECBVlv_ATS/Untere Grenze für das Monitoring" VALUE 0x800313BE Val_Ws16 799.9878 Prc -400.0000 399.9878 /end CHARACTERISTIC
/begin CHARACTERISTIC ECBVlv_ATS.UpLim_C "Steller Test ECBVlv_ATS/Obere Grenze für das Monitoring" VALUE 0x800313C0 Val_Ws16 799.9878 Prc -400.0000 399.9878 /end CHARACTERISTIC
/begin CHARACTERISTIC ECBVlv_ATS.CnvFac_C "Steller Test ECBVlv_ATS/Faktor für die Umrechnung" VALUE 0x800313C4 Val_Ws32 4294967295.00 OneToOne -2147483648.00 2147483647.00 /end CHARACTERISTIC
/begin CHARACTERISTIC ECBVlv_ATS.CnvOfs_C "Steller Test ECBVlv_ATS/Offset für die Umrechnung" VALUE 0x800313C8 Val_Ws16 65535.00 OneToOne -32768.00 32767.00 /end CHARACTERISTIC
/begin CHARACTERISTIC ECBVlv_ATS.DfltVal_C "Steller Test ECBVlv_ATS/Vorgabewert für standbytest" VALUE 0x800313CA Val_Ws16 65535.00 OneToOne -32768.00 32767.00 /end CHARACTERISTIC
/begin CHARACTERISTIC EGRVlvLP_ATS.LimitTypeMsk_C "Steller Test EGRVlvLP_ATS/Tester Anforderungs Überwachungs Maske für Steller" VALUE 0x800313CC Val_Wu8 255.0 OneToOne 0.00 255.0 /end CHARACTERISTIC
/begin CHARACTERISTIC EGRVlvLP_ATS.CnvNorm_C "Steller Test EGRVlvLP_ATS/Normierung für die Umrechnung" VALUE 0x800313CD Val_Wu8 255.0 OneToOne 0.00 255.0 /end CHARACTERISTIC
/begin CHARACTERISTIC EGRVlvLP_ATS.LowLim_C "Steller Test EGRVlvLP_ATS/Untere Grenze für das Monitoring" VALUE 0x800313CE Val_Ws16 799.9878 Prc -400.0000 399.9878 /end CHARACTERISTIC
/begin CHARACTERISTIC EGRVlvLP_ATS.UpLim_C "Steller Test EGRVlvLP_ATS/Obere Grenze für das Monitoring" VALUE 0x800313D0 Val_Ws16 799.9878 Prc -400.0000 399.9878 /end CHARACTERISTIC
/begin CHARACTERISTIC EGRVlvLP_ATS.CnvFac_C "Steller Test EGRVlvLP_ATS/Faktor für die Umrechnung" VALUE 0x800313D4 Val_Ws32 4294967295.00 OneToOne -2147483648.00 2147483647.00 /end CHARACTERISTIC
/begin CHARACTERISTIC EGRVlvLP_ATS.CnvOfs_C "Steller Test EGRVlvLP_ATS/Offset für die Umrechnung" VALUE 0x800313D8 Val_Ws16 65535.00 OneToOne -32768.00 32767.00 /end CHARACTERISTIC
/begin CHARACTERISTIC EGRVlvLP_ATS.DfltVal_C "Steller Test EGRVlvLP_ATS/Vorgabewert für standbytest" VALUE 0x800313DA Val_Ws16 65535.00 OneToOne -32768.00 32767.00 /end CHARACTERISTIC
/begin CHARACTERISTIC EGRVlv_ATS.LimitTypeMsk_C "Steller Test EGRVlv_ATS/Tester Anforderungs Überwachungs Maske für Steller" VALUE 0x800313DC Val_Wu8 255.0 OneToOne 0.00 255.0 /end CHARACTERISTIC
/begin CHARACTERISTIC EGRVlv_ATS.CnvNorm_C "Steller Test EGRVlv_ATS/Normierung für die Umrechnung" VALUE 0x800313DD Val_Wu8 255.0 OneToOne 0.00 255.0 /end CHARACTERISTIC
/begin CHARACTERISTIC EGRVlv_ATS.LowLim_C "Steller Test EGRVlv_ATS/Untere Grenze für das Monitoring" VALUE 0x800313DE Val_Ws16 799.9878 Prc -400.0000 399.9878 /end CHARACTERISTIC
/begin CHARACTERISTIC EGRVlv_ATS.UpLim_C "Steller Test EGRVlv_ATS/Obere Grenze für das Monitoring" VALUE 0x800313E0 Val_Ws16 799.9878 Prc -400.0000 399.9878 /end CHARACTERISTIC
/begin CHARACTERISTIC EGRVlv_ATS.CnvFac_C "Steller Test EGRVlv_ATS/Faktor für die Umrechnung" VALUE 0x800313E4 Val_Ws32 4294967295.00 OneToOne -2147483648.00 2147483647.00 /end CHARACTERISTIC
/begin CHARACTERISTIC EGRVlv_ATS.CnvOfs_C "Steller Test EGRVlv_ATS/Offset für die Umrechnung" VALUE 0x800313E8 Val_Ws16 65535.00 OneToOne -32768.00 32767.00 /end CHARACTERISTIC
/begin CHARACTERISTIC EGRVlv_ATS.DfltVal_C "Steller Test EGRVlv_ATS/Vorgabewert für standbytest" VALUE 0x800313EA Val_Ws16 65535.00 OneToOne -32768.00 32767.00 /end CHARACTERISTIC
/begin CHARACTERISTIC EMDmpDig0_ATS.LimitTypeMsk_C "Steller Test EMDmpDig0_ATS/Tester Anforderungs Überwachungs Maske für Steller" VALUE 0x800313EC Val_Wu8 255.0 OneToOne 0.00 255.0 /end CHARACTERISTIC
/begin CHARACTERISTIC EMDmpDig0_ATS.CnvNorm_C "Steller Test EMDmpDig0_ATS/Normierung für die Umrechnung" VALUE 0x800313ED Val_Wu8 255.0 OneToOne 0.00 255.0 /end CHARACTERISTIC
/begin CHARACTERISTIC EMDmpDig0_ATS.LowLim_C "Steller Test EMDmpDig0_ATS/Untere Grenze für das Monitoring" VALUE 0x800313EE Val_Ws16 65535.00 OneToOne -32768.00 32767.00 /end CHARACTERISTIC
/begin CHARACTERISTIC EMDmpDig0_ATS.UpLim_C "Steller Test EMDmpDig0_ATS/Obere Grenze für das Monitoring" VALUE 0x800313F0 Val_Ws16 65535.00 OneToOne -32768.00 32767.00 /end CHARACTERISTIC
/begin CHARACTERISTIC EMDmpDig0_ATS.CnvFac_C "Steller Test EMDmpDig0_ATS/Faktor für die Umrechnung" VALUE 0x800313F4 Val_Ws32 4294967295.00 OneToOne -2147483648.00 2147483647.00 /end CHARACTERISTIC
/begin CHARACTERISTIC EMDmpDig0_ATS.CnvOfs_C "Steller Test EMDmpDig0_ATS/Offset für die Umrechnung" VALUE 0x800313F8 Val_Ws16 65535.00 OneToOne -32768.00 32767.00 /end CHARACTERISTIC
/begin CHARACTERISTIC EMDmpDig0_ATS.DfltVal_C "Steller Test EMDmpDig0_ATS/Vorgabewert für standbytest" VALUE 0x800313FA Val_Ws16 65535.00 OneToOne -32768.00 32767.00 /end CHARACTERISTIC
/begin CHARACTERISTIC EMDmpDig1_ATS.LimitTypeMsk_C "Steller Test EMDmpDig1_ATS/Tester Anforderungs Überwachungs Maske für Steller" VALUE 0x800313FC Val_Wu8 255.0 OneToOne 0.00 255.0 /end CHARACTERISTIC
/begin CHARACTERISTIC EMDmpDig1_ATS.CnvNorm_C "Steller Test EMDmpDig1_ATS/Normierung für die Umrechnung" VALUE 0x800313FD Val_Wu8 255.0 OneToOne 0.00 255.0 /end CHARACTERISTIC
/begin CHARACTERISTIC EMDmpDig1_ATS.LowLim_C "Steller Test EMDmpDig1_ATS/Untere Grenze für das Monitoring" VALUE 0x800313FE Val_Ws16 65535.00 OneToOne -32768.00 32767.00 /end CHARACTERISTIC
/begin CHARACTERISTIC EMDmpDig1_ATS.UpLim_C "Steller Test EMDmpDig1_ATS/Obere Grenze für das Monitoring" VALUE 0x80031400 Val_Ws16 65535.00 OneToOne -32768.00 32767.00 /end CHARACTERISTIC
/begin CHARACTERISTIC EMDmpDig1_ATS.CnvFac_C "Steller Test EMDmpDig1_ATS/Faktor für die Umrechnung" VALUE 0x80031404 Val_Ws32 4294967295.00 OneToOne -2147483648.00 2147483647.00 /end CHARACTERISTIC
/begin CHARACTERISTIC EMDmpDig1_ATS.CnvOfs_C "Steller Test EMDmpDig1_ATS/Offset für die Umrechnung" VALUE 0x80031408 Val_Ws16 65535.00 OneToOne -32768.00 32767.00 /end CHARACTERISTIC
/begin CHARACTERISTIC EMDmpDig1_ATS.DfltVal_C "Steller Test EMDmpDig1_ATS/Vorgabewert für standbytest" VALUE 0x8003140A Val_Ws16 65535.00 OneToOne -32768.00 32767.00 /end CHARACTERISTIC
/begin CHARACTERISTIC EMDmpPWM0_ATS.LimitTypeMsk_C "/Tester Anforderungs Überwachungs Maske für Steller" VALUE 0x8003140C Val_Wu8 255.0 OneToOne 0.00 255.0 /end CHARACTERISTIC
/begin CHARACTERISTIC EMDmpPWM0_ATS.CnvNorm_C "/Normierung für die Umrechnung" VALUE 0x8003140D Val_Wu8 255.0 OneToOne 0.00 255.0 /end CHARACTERISTIC
/begin CHARACTERISTIC EMDmpPWM0_ATS.LowLim_C "/Untere Grenze für das Monitoring" VALUE 0x8003140E Val_Ws16 799.9878 Prc -400.0000 399.9878 /end CHARACTERISTIC
/begin CHARACTERISTIC EMDmpPWM0_ATS.UpLim_C "/Obere Grenze für das Monitoring" VALUE 0x80031410 Val_Ws16 799.9878 Prc -400.0000 399.9878 /end CHARACTERISTIC
/begin CHARACTERISTIC EMDmpPWM0_ATS.CnvFac_C "/Faktor für die Umrechnung" VALUE 0x80031414 Val_Ws32 4294967295.00 OneToOne -2147483648.00 2147483647.00 /end CHARACTERISTIC
/begin CHARACTERISTIC EMDmpPWM0_ATS.CnvOfs_C "/Offset für die Umrechnung" VALUE 0x80031418 Val_Ws16 65535.00 OneToOne -32768.00 32767.00 /end CHARACTERISTIC
/begin CHARACTERISTIC EMDmpPWM0_ATS.DfltVal_C "/Vorgabewert für standbytest" VALUE 0x8003141A Val_Ws16 65535.00 OneToOne -32768.00 32767.00 /end CHARACTERISTIC
/begin CHARACTERISTIC EMDmpPWM1_ATS.LimitTypeMsk_C "/Tester Anforderungs Überwachungs Maske für Steller" VALUE 0x8003141C Val_Wu8 255.0 OneToOne 0.00 255.0 /end CHARACTERISTIC
/begin CHARACTERISTIC EMDmpPWM1_ATS.CnvNorm_C "/Normierung für die Umrechnung" VALUE 0x8003141D Val_Wu8 255.0 OneToOne 0.00 255.0 /end CHARACTERISTIC
/begin CHARACTERISTIC EMDmpPWM1_ATS.LowLim_C "/Untere Grenze für das Monitoring" VALUE 0x8003141E Val_Ws16 799.9878 Prc -400.0000 399.9878 /end CHARACTERISTIC
/begin CHARACTERISTIC EMDmpPWM1_ATS.UpLim_C "/Obere Grenze für das Monitoring" VALUE 0x80031420 Val_Ws16 799.9878 Prc -400.0000 399.9878 /end CHARACTERISTIC
/begin CHARACTERISTIC EMDmpPWM1_ATS.CnvFac_C "/Faktor für die Umrechnung" VALUE 0x80031424 Val_Ws32 4294967295.00 OneToOne -2147483648.00 2147483647.00 /end CHARACTERISTIC
/begin CHARACTERISTIC EMDmpPWM1_ATS.CnvOfs_C "/Offset für die Umrechnung" VALUE 0x80031428 Val_Ws16 65535.00 OneToOne -32768.00 32767.00 /end CHARACTERISTIC
/begin CHARACTERISTIC EMDmpPWM1_ATS.DfltVal_C "/Vorgabewert für standbytest" VALUE 0x8003142A Val_Ws16 65535.00 OneToOne -32768.00 32767.00 /end CHARACTERISTIC
/begin CHARACTERISTIC EngStA_ATS.LimitTypeMsk_C "/Tester Anforderungs Überwachungs Maske für Steller" VALUE 0x8003142C Val_Wu8 255.0 OneToOne 0.00 255.0 /end CHARACTERISTIC
/begin CHARACTERISTIC EngStA_ATS.CnvNorm_C "/Normierung für die Umrechnung" VALUE 0x8003142D Val_Wu8 255.0 OneToOne 0.00 255.0 /end CHARACTERISTIC
/begin CHARACTERISTIC EngStA_ATS.LowLim_C "/Untere Grenze für das Monitoring" VALUE 0x8003142E Val_Ws16 65535.00 OneToOne -32768.00 32767.00 /end CHARACTERISTIC
/begin CHARACTERISTIC EngStA_ATS.UpLim_C "/Obere Grenze für das Monitoring" VALUE 0x80031430 Val_Ws16 65535.00 OneToOne -32768.00 32767.00 /end CHARACTERISTIC
/begin CHARACTERISTIC EngStA_ATS.CnvFac_C "/Faktor für die Umrechnung" VALUE 0x80031434 Val_Ws32 4294967295.00 OneToOne -2147483648.00 2147483647.00 /end CHARACTERISTIC
/begin CHARACTERISTIC EngStA_ATS.CnvOfs_C "/Offset für die Umrechnung" VALUE 0x80031438 Val_Ws16 65535.00 OneToOne -32768.00 32767.00 /end CHARACTERISTIC
/begin CHARACTERISTIC EngStA_ATS.DfltVal_C "/Vorgabewert für standbytest" VALUE 0x8003143A Val_Ws16 65535.00 OneToOne -32768.00 32767.00 /end CHARACTERISTIC
/begin CHARACTERISTIC ErrLmpMIL_ATS.LimitTypeMsk_C "Steller Test ErrLmpMIL_ATS/Tester Anforderungs Überwachungs Maske für Steller" VALUE 0x8003143C Val_Wu8 255.0 OneToOne 0.00 255.0 /end CHARACTERISTIC
/begin CHARACTERISTIC ErrLmpMIL_ATS.CnvNorm_C "Steller Test ErrLmpMIL_ATS/Normierung für die Umrechnung" VALUE 0x8003143D Val_Wu8 255.0 OneToOne 0.00 255.0 /end CHARACTERISTIC
/begin CHARACTERISTIC ErrLmpMIL_ATS.LowLim_C "Steller Test ErrLmpMIL_ATS/Untere Grenze für das Monitoring" VALUE 0x8003143E Val_Ws16 65535.00 OneToOne -32768.00 32767.00 /end CHARACTERISTIC
/begin CHARACTERISTIC ErrLmpMIL_ATS.UpLim_C "Steller Test ErrLmpMIL_ATS/Obere Grenze für das Monitoring" VALUE 0x80031440 Val_Ws16 65535.00 OneToOne -32768.00 32767.00 /end CHARACTERISTIC
/begin CHARACTERISTIC ErrLmpMIL_ATS.CnvFac_C "Steller Test ErrLmpMIL_ATS/Faktor für die Umrechnung" VALUE 0x80031444 Val_Ws32 4294967295.00 OneToOne -2147483648.00 2147483647.00 /end CHARACTERISTIC
/begin CHARACTERISTIC ErrLmpMIL_ATS.CnvOfs_C "Steller Test ErrLmpMIL_ATS/Offset für die Umrechnung" VALUE 0x80031448 Val_Ws16 65535.00 OneToOne -32768.00 32767.00 /end CHARACTERISTIC
/begin CHARACTERISTIC ErrLmpMIL_ATS.DfltVal_C "Steller Test ErrLmpMIL_ATS/Vorgabewert für standbytest" VALUE 0x8003144A Val_Ws16 65535.00 OneToOne -32768.00 32767.00 /end CHARACTERISTIC
/begin CHARACTERISTIC ErrLmpSVS_ATS.LimitTypeMsk_C "Steller Test ErrLmpSVS_ATS/Tester Anforderungs Überwachungs Maske für Steller" VALUE 0x8003144C Val_Wu8 255.0 OneToOne 0.00 255.0 /end CHARACTERISTIC
/begin CHARACTERISTIC ErrLmpSVS_ATS.CnvNorm_C "Steller Test ErrLmpSVS_ATS/Normierung für die Umrechnung" VALUE 0x8003144D Val_Wu8 255.0 OneToOne 0.00 255.0 /end CHARACTERISTIC
/begin CHARACTERISTIC ErrLmpSVS_ATS.LowLim_C "Steller Test ErrLmpSVS_ATS/Untere Grenze für das Monitoring" VALUE 0x8003144E Val_Ws16 65535.00 OneToOne -32768.00 32767.00 /end CHARACTERISTIC
/begin CHARACTERISTIC ErrLmpSVS_ATS.UpLim_C "Steller Test ErrLmpSVS_ATS/Obere Grenze für das Monitoring" VALUE 0x80031450 Val_Ws16 65535.00 OneToOne -32768.00 32767.00 /end CHARACTERISTIC
/begin CHARACTERISTIC ErrLmpSVS_ATS.CnvFac_C "Steller Test ErrLmpSVS_ATS/Faktor für die Umrechnung" VALUE 0x80031454 Val_Ws32 4294967295.00 OneToOne -2147483648.00 2147483647.00 /end CHARACTERISTIC
/begin CHARACTERISTIC ErrLmpSVS_ATS.CnvOfs_C "Steller Test ErrLmpSVS_ATS/Offset für die Umrechnung" VALUE 0x80031458 Val_Ws16 65535.00 OneToOne -32768.00 32767.00 /end CHARACTERISTIC
/begin CHARACTERISTIC ErrLmpSVS_ATS.DfltVal_C "Steller Test ErrLmpSVS_ATS/Vorgabewert für standbytest" VALUE 0x8003145A Val_Ws16 65535.00 OneToOne -32768.00 32767.00 /end CHARACTERISTIC
/begin CHARACTERISTIC FanOut1_ATS.LimitTypeMsk_C "Steller Test FanOut1_ATS/Tester Anforderungs Überwachungs Maske für Steller" VALUE 0x8003145C Val_Wu8 255.0 OneToOne 0.00 255.0 /end CHARACTERISTIC
/begin CHARACTERISTIC FanOut1_ATS.CnvNorm_C "Steller Test FanOut1_ATS/Normierung für die Umrechnung" VALUE 0x8003145D Val_Wu8 255.0 OneToOne 0.00 255.0 /end CHARACTERISTIC
/begin CHARACTERISTIC FanOut1_ATS.LowLim_C "Steller Test FanOut1_ATS/Untere Grenze für das Monitoring" VALUE 0x8003145E Val_Ws16 799.9878 Prc -400.0000 399.9878 /end CHARACTERISTIC
/begin CHARACTERISTIC FanOut1_ATS.UpLim_C "Steller Test FanOut1_ATS/Obere Grenze für das Monitoring" VALUE 0x80031460 Val_Ws16 799.9878 Prc -400.0000 399.9878 /end CHARACTERISTIC
/begin CHARACTERISTIC FanOut1_ATS.CnvFac_C "Steller Test FanOut1_ATS/Faktor für die Umrechnung" VALUE 0x80031464 Val_Ws32 4294967295.00 OneToOne -2147483648.00 2147483647.00 /end CHARACTERISTIC
/begin CHARACTERISTIC FanOut1_ATS.CnvOfs_C "Steller Test FanOut1_ATS/Offset für die Umrechnung" VALUE 0x80031468 Val_Ws16 65535.00 OneToOne -32768.00 32767.00 /end CHARACTERISTIC
/begin CHARACTERISTIC FanOut1_ATS.DfltVal_C "Steller Test FanOut1_ATS/Vorgabewert für standbytest" VALUE 0x8003146A Val_Ws16 65535.00 OneToOne -32768.00 32767.00 /end CHARACTERISTIC
/begin CHARACTERISTIC FlFltHt_ATS.LimitTypeMsk_C "Steller Test FlFltHt_ATS/Tester Anforderungs Überwachungs Maske für Steller" VALUE 0x8003146C Val_Wu8 255.0 OneToOne 0.00 255.0 /end CHARACTERISTIC
/begin CHARACTERISTIC FlFltHt_ATS.CnvNorm_C "Steller Test FlFltHt_ATS/Normierung für die Umrechnung" VALUE 0x8003146D Val_Wu8 255.0 OneToOne 0.00 255.0 /end CHARACTERISTIC
/begin CHARACTERISTIC FlFltHt_ATS.LowLim_C "Steller Test FlFltHt_ATS/Untere Grenze für das Monitoring" VALUE 0x8003146E Val_Ws16 65535.00 OneToOne -32768.00 32767.00 /end CHARACTERISTIC
/begin CHARACTERISTIC FlFltHt_ATS.UpLim_C "Steller Test FlFltHt_ATS/Obere Grenze für das Monitoring" VALUE 0x80031470 Val_Ws16 65535.00 OneToOne -32768.00 32767.00 /end CHARACTERISTIC
/begin CHARACTERISTIC FlFltHt_ATS.CnvFac_C "Steller Test FlFltHt_ATS/Faktor für die Umrechnung" VALUE 0x80031474 Val_Ws32 4294967295.00 OneToOne -2147483648.00 2147483647.00 /end CHARACTERISTIC
/begin CHARACTERISTIC FlFltHt_ATS.CnvOfs_C "Steller Test FlFltHt_ATS/Offset für die Umrechnung" VALUE 0x80031478 Val_Ws16 65535.00 OneToOne -32768.00 32767.00 /end CHARACTERISTIC
/begin CHARACTERISTIC FlFltHt_ATS.DfltVal_C "Steller Test FlFltHt_ATS/Vorgabewert für standbytest" VALUE 0x8003147A Val_Ws16 65535.00 OneToOne -32768.00 32767.00 /end CHARACTERISTIC
/begin CHARACTERISTIC LSU0_ATS.LimitTypeMsk_C "Steller Test LSU0_ATS/Tester Anforderungs Überwachungs Maske für Steller" VALUE 0x8003147C Val_Wu8 255.0 OneToOne 0.00 255.0 /end CHARACTERISTIC
/begin CHARACTERISTIC LSU0_ATS.CnvNorm_C "Steller Test LSU0_ATS/Normierung für die Umrechnung" VALUE 0x8003147D Val_Wu8 255.0 OneToOne 0.00 255.0 /end CHARACTERISTIC
/begin CHARACTERISTIC LSU0_ATS.LowLim_C "Steller Test LSU0_ATS/Untere Grenze für das Monitoring" VALUE 0x8003147E Val_Ws16 799.9878 Prc -400.0000 399.9878 /end CHARACTERISTIC
/begin CHARACTERISTIC LSU0_ATS.UpLim_C "Steller Test LSU0_ATS/Obere Grenze für das Monitoring" VALUE 0x80031480 Val_Ws16 799.9878 Prc -400.0000 399.9878 /end CHARACTERISTIC
/begin CHARACTERISTIC LSU0_ATS.CnvFac_C "Steller Test LSU0_ATS/Faktor für die Umrechnung" VALUE 0x80031484 Val_Ws32 4294967295.00 OneToOne -2147483648.00 2147483647.00 /end CHARACTERISTIC
/begin CHARACTERISTIC LSU0_ATS.CnvOfs_C "Steller Test LSU0_ATS/Offset für die Umrechnung" VALUE 0x80031488 Val_Ws16 65535.00 OneToOne -32768.00 32767.00 /end CHARACTERISTIC
/begin CHARACTERISTIC LSU0_ATS.DfltVal_C "Steller Test LSU0_ATS/Vorgabewert für standbytest" VALUE 0x8003148A Val_Ws16 65535.00 OneToOne -32768.00 32767.00 /end CHARACTERISTIC
/begin CHARACTERISTIC OilPLmp_ATS.LimitTypeMsk_C "Steller Test OilPLmp_ATS/Tester Anforderungs Überwachungs Maske für Steller" VALUE 0x8003148C Val_Wu8 255.0 OneToOne 0.00 255.0 /end CHARACTERISTIC
/begin CHARACTERISTIC OilPLmp_ATS.CnvNorm_C "Steller Test OilPLmp_ATS/Normierung für die Umrechnung" VALUE 0x8003148D Val_Wu8 255.0 OneToOne 0.00 255.0 /end CHARACTERISTIC
/begin CHARACTERISTIC OilPLmp_ATS.LowLim_C "Steller Test OilPLmp_ATS/Untere Grenze für das Monitoring" VALUE 0x8003148E Val_Ws16 65535.00 OneToOne -32768.00 32767.00 /end CHARACTERISTIC
/begin CHARACTERISTIC OilPLmp_ATS.UpLim_C "Steller Test OilPLmp_ATS/Obere Grenze für das Monitoring" VALUE 0x80031490 Val_Ws16 65535.00 OneToOne -32768.00 32767.00 /end CHARACTERISTIC
/begin CHARACTERISTIC OilPLmp_ATS.CnvFac_C "Steller Test OilPLmp_ATS/Faktor für die Umrechnung" VALUE 0x80031494 Val_Ws32 4294967295.00 OneToOne -2147483648.00 2147483647.00 /end CHARACTERISTIC
/begin CHARACTERISTIC OilPLmp_ATS.CnvOfs_C "Steller Test OilPLmp_ATS/Offset für die Umrechnung" VALUE 0x80031498 Val_Ws16 65535.00 OneToOne -32768.00 32767.00 /end CHARACTERISTIC
/begin CHARACTERISTIC OilPLmp_ATS.DfltVal_C "Steller Test OilPLmp_ATS/Vorgabewert für standbytest" VALUE 0x8003149A Val_Ws16 65535.00 OneToOne -32768.00 32767.00 /end CHARACTERISTIC
/begin CHARACTERISTIC ShtrPWM_ATS.LimitTypeMsk_C "Steller Test ShtrPWM_ATS/Tester Anforderungs Überwachungs Maske für Steller" VALUE 0x8003149C Val_Wu8 255.0 OneToOne 0.00 255.0 /end CHARACTERISTIC
/begin CHARACTERISTIC ShtrPWM_ATS.CnvNorm_C "Steller Test ShtrPWM_ATS/Normierung für die Umrechnung" VALUE 0x8003149D Val_Wu8 255.0 OneToOne 0.00 255.0 /end CHARACTERISTIC
/begin CHARACTERISTIC ShtrPWM_ATS.LowLim_C "Steller Test ShtrPWM_ATS/Untere Grenze für das Monitoring" VALUE 0x8003149E Val_Ws16 799.9878 Prc -400.0000 399.9878 /end CHARACTERISTIC
/begin CHARACTERISTIC ShtrPWM_ATS.UpLim_C "Steller Test ShtrPWM_ATS/Obere Grenze für das Monitoring" VALUE 0x800314A0 Val_Ws16 799.9878 Prc -400.0000 399.9878 /end CHARACTERISTIC
/begin CHARACTERISTIC ShtrPWM_ATS.CnvFac_C "Steller Test ShtrPWM_ATS/Faktor für die Umrechnung" VALUE 0x800314A4 Val_Ws32 4294967295.00 OneToOne -2147483648.00 2147483647.00 /end CHARACTERISTIC
/begin CHARACTERISTIC ShtrPWM_ATS.CnvOfs_C "Steller Test ShtrPWM_ATS/Offset für die Umrechnung" VALUE 0x800314A8 Val_Ws16 65535.00 OneToOne -32768.00 32767.00 /end CHARACTERISTIC
/begin CHARACTERISTIC ShtrPWM_ATS.DfltVal_C "Steller Test ShtrPWM_ATS/Vorgabewert für standbytest" VALUE 0x800314AA Val_Ws16 65535.00 OneToOne -32768.00 32767.00 /end CHARACTERISTIC
/begin CHARACTERISTIC Strt_ATS.LimitTypeMsk_C "Steller Test Strt_ATS/Tester Anforderungs Überwachungs Maske für Steller" VALUE 0x800314AC Val_Wu8 255.0 OneToOne 0.00 255.0 /end CHARACTERISTIC
/begin CHARACTERISTIC Strt_ATS.CnvNorm_C "Steller Test Strt_ATS/Normierung für die Umrechnung" VALUE 0x800314AD Val_Wu8 255.0 OneToOne 0.00 255.0 /end CHARACTERISTIC
/begin CHARACTERISTIC Strt_ATS.LowLim_C "Steller Test Strt_ATS/Untere Grenze für das Monitoring" VALUE 0x800314AE Val_Ws16 65535.00 OneToOne -32768.00 32767.00 /end CHARACTERISTIC
/begin CHARACTERISTIC Strt_ATS.UpLim_C "Steller Test Strt_ATS/Obere Grenze für das Monitoring" VALUE 0x800314B0 Val_Ws16 65535.00 OneToOne -32768.00 32767.00 /end CHARACTERISTIC
/begin CHARACTERISTIC Strt_ATS.CnvFac_C "Steller Test Strt_ATS/Faktor für die Umrechnung" VALUE 0x800314B4 Val_Ws32 4294967295.00 OneToOne -2147483648.00 2147483647.00 /end CHARACTERISTIC
/begin CHARACTERISTIC Strt_ATS.CnvOfs_C "Steller Test Strt_ATS/Offset für die Umrechnung" VALUE 0x800314B8 Val_Ws16 65535.00 OneToOne -32768.00 32767.00 /end CHARACTERISTIC
/begin CHARACTERISTIC Strt_ATS.DfltVal_C "Steller Test Strt_ATS/Vorgabewert für standbytest" VALUE 0x800314BA Val_Ws16 65535.00 OneToOne -32768.00 32767.00 /end CHARACTERISTIC
/begin CHARACTERISTIC ThrVlv_ATS.LimitTypeMsk_C "Steller Test ThrVlv_ATS/Tester Anforderungs Überwachungs Maske für Steller" VALUE 0x800314BC Val_Wu8 255.0 OneToOne 0.00 255.0 /end CHARACTERISTIC
/begin CHARACTERISTIC ThrVlv_ATS.CnvNorm_C "Steller Test ThrVlv_ATS/Normierung für die Umrechnung" VALUE 0x800314BD Val_Wu8 255.0 OneToOne 0.00 255.0 /end CHARACTERISTIC
/begin CHARACTERISTIC ThrVlv_ATS.LowLim_C "Steller Test ThrVlv_ATS/Untere Grenze für das Monitoring" VALUE 0x800314BE Val_Ws16 799.9878 Prc -400.0000 399.9878 /end CHARACTERISTIC
/begin CHARACTERISTIC ThrVlv_ATS.UpLim_C "Steller Test ThrVlv_ATS/Obere Grenze für das Monitoring" VALUE 0x800314C0 Val_Ws16 799.9878 Prc -400.0000 399.9878 /end CHARACTERISTIC
/begin CHARACTERISTIC ThrVlv_ATS.CnvFac_C "Steller Test ThrVlv_ATS/Faktor für die Umrechnung" VALUE 0x800314C4 Val_Ws32 4294967295.00 OneToOne -2147483648.00 2147483647.00 /end CHARACTERISTIC
/begin CHARACTERISTIC ThrVlv_ATS.CnvOfs_C "Steller Test ThrVlv_ATS/Offset für die Umrechnung" VALUE 0x800314C8 Val_Ws16 65535.00 OneToOne -32768.00 32767.00 /end CHARACTERISTIC
/begin CHARACTERISTIC ThrVlv_ATS.DfltVal_C "Steller Test ThrVlv_ATS/Vorgabewert für standbytest" VALUE 0x800314CA Val_Ws16 65535.00 OneToOne -32768.00 32767.00 /end CHARACTERISTIC
/begin CHARACTERISTIC TrbChLP_ATS.LimitTypeMsk_C "Steller Test TrbChLP_ATS/Tester Anforderungs Überwachungs Maske für Steller" VALUE 0x800314CC Val_Wu8 255.0 OneToOne 0.00 255.0 /end CHARACTERISTIC
/begin CHARACTERISTIC TrbChLP_ATS.CnvNorm_C "Steller Test TrbChLP_ATS/Normierung für die Umrechnung" VALUE 0x800314CD Val_Wu8 255.0 OneToOne 0.00 255.0 /end CHARACTERISTIC
/begin CHARACTERISTIC TrbChLP_ATS.LowLim_C "Steller Test TrbChLP_ATS/Untere Grenze für das Monitoring" VALUE 0x800314CE Val_Ws16 799.9878 Prc -400.0000 399.9878 /end CHARACTERISTIC
/begin CHARACTERISTIC TrbChLP_ATS.UpLim_C "Steller Test TrbChLP_ATS/Obere Grenze für das Monitoring" VALUE 0x800314D0 Val_Ws16 799.9878 Prc -400.0000 399.9878 /end CHARACTERISTIC
/begin CHARACTERISTIC TrbChLP_ATS.CnvFac_C "Steller Test TrbChLP_ATS/Faktor für die Umrechnung" VALUE 0x800314D4 Val_Ws32 4294967295.00 OneToOne -2147483648.00 2147483647.00 /end CHARACTERISTIC
/begin CHARACTERISTIC TrbChLP_ATS.CnvOfs_C "Steller Test TrbChLP_ATS/Offset für die Umrechnung" VALUE 0x800314D8 Val_Ws16 65535.00 OneToOne -32768.00 32767.00 /end CHARACTERISTIC
/begin CHARACTERISTIC TrbChLP_ATS.DfltVal_C "Steller Test TrbChLP_ATS/Vorgabewert für standbytest" VALUE 0x800314DA Val_Ws16 65535.00 OneToOne -32768.00 32767.00 /end CHARACTERISTIC
/begin CHARACTERISTIC TrbCh_ATS.LimitTypeMsk_C "Steller Test TrbCh_ATS/Tester Anforderungs Überwachungs Maske für Steller" VALUE 0x800314DC Val_Wu8 255.0 OneToOne 0.00 255.0 /end CHARACTERISTIC
/begin CHARACTERISTIC TrbCh_ATS.CnvNorm_C "Steller Test TrbCh_ATS/Normierung für die Umrechnung" VALUE 0x800314DD Val_Wu8 255.0 OneToOne 0.00 255.0 /end CHARACTERISTIC
/begin CHARACTERISTIC TrbCh_ATS.LowLim_C "Steller Test TrbCh_ATS/Untere Grenze für das Monitoring" VALUE 0x800314DE Val_Ws16 799.9878 Prc -400.0000 399.9878 /end CHARACTERISTIC
/begin CHARACTERISTIC TrbCh_ATS.UpLim_C "Steller Test TrbCh_ATS/Obere Grenze für das Monitoring" VALUE 0x800314E0 Val_Ws16 799.9878 Prc -400.0000 399.9878 /end CHARACTERISTIC
/begin CHARACTERISTIC TrbCh_ATS.CnvFac_C "Steller Test TrbCh_ATS/Faktor für die Umrechnung" VALUE 0x800314E4 Val_Ws32 4294967295.00 OneToOne -2147483648.00 2147483647.00 /end CHARACTERISTIC
/begin CHARACTERISTIC TrbCh_ATS.CnvOfs_C "Steller Test TrbCh_ATS/Offset für die Umrechnung" VALUE 0x800314E8 Val_Ws16 65535.00 OneToOne -32768.00 32767.00 /end CHARACTERISTIC
/begin CHARACTERISTIC TrbCh_ATS.DfltVal_C "Steller Test TrbCh_ATS/Vorgabewert für standbytest" VALUE 0x800314EA Val_Ws16 65535.00 OneToOne -32768.00 32767.00 /end CHARACTERISTIC
/begin CHARACTERISTIC UDosVlv_ATS.LimitTypeMsk_C "Steller Test UDosVlv_ATS/Tester Anforderungs Überwachungs Maske für Steller" VALUE 0x800314EC Val_Wu8 255.0 OneToOne 0.00 255.0 /end CHARACTERISTIC
/begin CHARACTERISTIC UDosVlv_ATS.CnvNorm_C "Steller Test UDosVlv_ATS/Normierung für die Umrechnung" VALUE 0x800314ED Val_Wu8 255.0 OneToOne 0.00 255.0 /end CHARACTERISTIC
/begin CHARACTERISTIC UDosVlv_ATS.LowLim_C "Steller Test UDosVlv_ATS/Untere Grenze für das Monitoring" VALUE 0x800314EE Val_Ws16 655.3500 DtyCyc -327.6800 327.6700 /end CHARACTERISTIC
/begin CHARACTERISTIC UDosVlv_ATS.UpLim_C "Steller Test UDosVlv_ATS/Obere Grenze für das Monitoring" VALUE 0x800314F0 Val_Ws16 655.3500 DtyCyc -327.6800 327.6700 /end CHARACTERISTIC
/begin CHARACTERISTIC UDosVlv_ATS.CnvFac_C "Steller Test UDosVlv_ATS/Faktor für die Umrechnung" VALUE 0x800314F4 Val_Ws32 4294967295.00 OneToOne -2147483648.00 2147483647.00 /end CHARACTERISTIC
/begin CHARACTERISTIC UDosVlv_ATS.CnvOfs_C "Steller Test UDosVlv_ATS/Offset für die Umrechnung" VALUE 0x800314F8 Val_Ws16 65535.00 OneToOne -32768.00 32767.00 /end CHARACTERISTIC
/begin CHARACTERISTIC UDosVlv_ATS.DfltVal_C "Steller Test UDosVlv_ATS/Vorgabewert für standbytest" VALUE 0x800314FA Val_Ws16 65535.00 OneToOne -32768.00 32767.00 /end CHARACTERISTIC
/begin CHARACTERISTIC UHtrPL_ATS.LimitTypeMsk_C "Steller Test UHtrPL_ATS/Tester Anforderungs Überwachungs Maske für Steller" VALUE 0x800314FC Val_Wu8 255.0 OneToOne 0.00 255.0 /end CHARACTERISTIC
/begin CHARACTERISTIC UHtrPL_ATS.CnvNorm_C "Steller Test UHtrPL_ATS/Normierung für die Umrechnung" VALUE 0x800314FD Val_Wu8 255.0 OneToOne 0.00 255.0 /end CHARACTERISTIC
/begin CHARACTERISTIC UHtrPL_ATS.LowLim_C "Steller Test UHtrPL_ATS/Untere Grenze für das Monitoring" VALUE 0x800314FE Val_Ws16 65535.00 OneToOne -32768.00 32767.00 /end CHARACTERISTIC
/begin CHARACTERISTIC UHtrPL_ATS.UpLim_C "Steller Test UHtrPL_ATS/Obere Grenze für das Monitoring" VALUE 0x80031500 Val_Ws16 65535.00 OneToOne -32768.00 32767.00 /end CHARACTERISTIC
/begin CHARACTERISTIC UHtrPL_ATS.CnvFac_C "Steller Test UHtrPL_ATS/Faktor für die Umrechnung" VALUE 0x80031504 Val_Ws32 4294967295.00 OneToOne -2147483648.00 2147483647.00 /end CHARACTERISTIC
/begin CHARACTERISTIC UHtrPL_ATS.CnvOfs_C "Steller Test UHtrPL_ATS/Offset für die Umrechnung" VALUE 0x80031508 Val_Ws16 65535.00 OneToOne -32768.00 32767.00 /end CHARACTERISTIC
/begin CHARACTERISTIC UHtrPL_ATS.DfltVal_C "Steller Test UHtrPL_ATS/Vorgabewert für standbytest" VALUE 0x8003150A Val_Ws16 65535.00 OneToOne -32768.00 32767.00 /end CHARACTERISTIC
/begin CHARACTERISTIC UHtrTnk_ATS.LimitTypeMsk_C "Steller Test UHtrTnk_ATS/Tester Anforderungs Überwachungs Maske für Steller" VALUE 0x8003150C Val_Wu8 255.0 OneToOne 0.00 255.0 /end CHARACTERISTIC
/begin CHARACTERISTIC UHtrTnk_ATS.CnvNorm_C "Steller Test UHtrTnk_ATS/Normierung für die Umrechnung" VALUE 0x8003150D Val_Wu8 255.0 OneToOne 0.00 255.0 /end CHARACTERISTIC
/begin CHARACTERISTIC UHtrTnk_ATS.LowLim_C "Steller Test UHtrTnk_ATS/Untere Grenze für das Monitoring" VALUE 0x8003150E Val_Ws16 65535.00 OneToOne -32768.00 32767.00 /end CHARACTERISTIC
/begin CHARACTERISTIC UHtrTnk_ATS.UpLim_C "Steller Test UHtrTnk_ATS/Obere Grenze für das Monitoring" VALUE 0x80031510 Val_Ws16 65535.00 OneToOne -32768.00 32767.00 /end CHARACTERISTIC
/begin CHARACTERISTIC UHtrTnk_ATS.CnvFac_C "Steller Test UHtrTnk_ATS/Faktor für die Umrechnung" VALUE 0x80031514 Val_Ws32 4294967295.00 OneToOne -2147483648.00 2147483647.00 /end CHARACTERISTIC
/begin CHARACTERISTIC UHtrTnk_ATS.CnvOfs_C "Steller Test UHtrTnk_ATS/Offset für die Umrechnung" VALUE 0x80031518 Val_Ws16 65535.00 OneToOne -32768.00 32767.00 /end CHARACTERISTIC
/begin CHARACTERISTIC UHtrTnk_ATS.DfltVal_C "Steller Test UHtrTnk_ATS/Vorgabewert für standbytest" VALUE 0x8003151A Val_Ws16 65535.00 OneToOne -32768.00 32767.00 /end CHARACTERISTIC
/begin CHARACTERISTIC UPmpMot_ATS.LimitTypeMsk_C "Steller Test UPmpMot_ATS/Tester Anforderungs Überwachungs Maske für Steller" VALUE 0x8003151C Val_Wu8 255.0 OneToOne 0.00 255.0 /end CHARACTERISTIC
/begin CHARACTERISTIC UPmpMot_ATS.CnvNorm_C "Steller Test UPmpMot_ATS/Normierung für die Umrechnung" VALUE 0x8003151D Val_Wu8 255.0 OneToOne 0.00 255.0 /end CHARACTERISTIC
/begin CHARACTERISTIC UPmpMot_ATS.LowLim_C "Steller Test UPmpMot_ATS/Untere Grenze für das Monitoring" VALUE 0x8003151E Val_Ws16 799.9878 Prc -400.0000 399.9878 /end CHARACTERISTIC
/begin CHARACTERISTIC UPmpMot_ATS.UpLim_C "Steller Test UPmpMot_ATS/Obere Grenze für das Monitoring" VALUE 0x80031520 Val_Ws16 799.9878 Prc -400.0000 399.9878 /end CHARACTERISTIC
/begin CHARACTERISTIC UPmpMot_ATS.CnvFac_C "Steller Test UPmpMot_ATS/Faktor für die Umrechnung" VALUE 0x80031524 Val_Ws32 4294967295.00 OneToOne -2147483648.00 2147483647.00 /end CHARACTERISTIC
/begin CHARACTERISTIC UPmpMot_ATS.CnvOfs_C "Steller Test UPmpMot_ATS/Offset für die Umrechnung" VALUE 0x80031528 Val_Ws16 65535.00 OneToOne -32768.00 32767.00 /end CHARACTERISTIC
/begin CHARACTERISTIC UPmpMot_ATS.DfltVal_C "Steller Test UPmpMot_ATS/Vorgabewert für standbytest" VALUE 0x8003152A Val_Ws16 65535.00 OneToOne -32768.00 32767.00 /end CHARACTERISTIC
/begin CHARACTERISTIC URevVlv_ATS.LimitTypeMsk_C "Steller Test URevVlv_ATS/Tester Anforderungs Überwachungs Maske für Steller" VALUE 0x8003152C Val_Wu8 255.0 OneToOne 0.00 255.0 /end CHARACTERISTIC
/begin CHARACTERISTIC URevVlv_ATS.CnvNorm_C "Steller Test URevVlv_ATS/Normierung für die Umrechnung" VALUE 0x8003152D Val_Wu8 255.0 OneToOne 0.00 255.0 /end CHARACTERISTIC
/begin CHARACTERISTIC URevVlv_ATS.LowLim_C "Steller Test URevVlv_ATS/Untere Grenze für das Monitoring" VALUE 0x8003152E Val_Ws16 65535.00 OneToOne -32768.00 32767.00 /end CHARACTERISTIC
/begin CHARACTERISTIC URevVlv_ATS.UpLim_C "Steller Test URevVlv_ATS/Obere Grenze für das Monitoring" VALUE 0x80031530 Val_Ws16 65535.00 OneToOne -32768.00 32767.00 /end CHARACTERISTIC
/begin CHARACTERISTIC URevVlv_ATS.CnvFac_C "Steller Test URevVlv_ATS/Faktor für die Umrechnung" VALUE 0x80031534 Val_Ws32 4294967295.00 OneToOne -2147483648.00 2147483647.00 /end CHARACTERISTIC
/begin CHARACTERISTIC URevVlv_ATS.CnvOfs_C "Steller Test URevVlv_ATS/Offset für die Umrechnung" VALUE 0x80031538 Val_Ws16 65535.00 OneToOne -32768.00 32767.00 /end CHARACTERISTIC
/begin CHARACTERISTIC URevVlv_ATS.DfltVal_C "Steller Test URevVlv_ATS/Vorgabewert für standbytest" VALUE 0x8003153A Val_Ws16 65535.00 OneToOne -32768.00 32767.00 /end CHARACTERISTIC
/begin CHARACTERISTIC VSwVlv_ATS.LimitTypeMsk_C "Steller Test VSwVlv_ATS/Tester Anforderungs Überwachungs Maske für Steller" VALUE 0x8003153C Val_Wu8 255.0 OneToOne 0.00 255.0 /end CHARACTERISTIC
/begin CHARACTERISTIC VSwVlv_ATS.CnvNorm_C "Steller Test VSwVlv_ATS/Normierung für die Umrechnung" VALUE 0x8003153D Val_Wu8 255.0 OneToOne 0.00 255.0 /end CHARACTERISTIC
/begin CHARACTERISTIC VSwVlv_ATS.LowLim_C "Steller Test VSwVlv_ATS/Untere Grenze für das Monitoring" VALUE 0x8003153E Val_Ws16 799.9878 Prc -400.0000 399.9878 /end CHARACTERISTIC
/begin CHARACTERISTIC VSwVlv_ATS.UpLim_C "Steller Test VSwVlv_ATS/Obere Grenze für das Monitoring" VALUE 0x80031540 Val_Ws16 799.9878 Prc -400.0000 399.9878 /end CHARACTERISTIC
/begin CHARACTERISTIC VSwVlv_ATS.CnvFac_C "Steller Test VSwVlv_ATS/Faktor für die Umrechnung" VALUE 0x80031544 Val_Ws32 4294967295.00 OneToOne -2147483648.00 2147483647.00 /end CHARACTERISTIC
/begin CHARACTERISTIC VSwVlv_ATS.CnvOfs_C "Steller Test VSwVlv_ATS/Offset für die Umrechnung" VALUE 0x80031548 Val_Ws16 65535.00 OneToOne -32768.00 32767.00 /end CHARACTERISTIC
/begin CHARACTERISTIC VSwVlv_ATS.DfltVal_C "Steller Test VSwVlv_ATS/Vorgabewert für standbytest" VALUE 0x8003154A Val_Ws16 65535.00 OneToOne -32768.00 32767.00 /end CHARACTERISTIC
/begin CHARACTERISTIC WaHtEl_ATS.LimitTypeMsk_C "/Tester Anforderungs Überwachungs Maske für Steller" VALUE 0x8003154C Val_Wu8 255.0 OneToOne 0.00 255.0 /end CHARACTERISTIC
/begin CHARACTERISTIC WaHtEl_ATS.CnvNorm_C "/Normierung für die Umrechnung" VALUE 0x8003154D Val_Wu8 255.0 OneToOne 0.00 255.0 /end CHARACTERISTIC
/begin CHARACTERISTIC WaHtEl_ATS.LowLim_C "/Untere Grenze für das Monitoring" VALUE 0x8003154E Val_Ws16 65535.00 OneToOne -32768.00 32767.00 /end CHARACTERISTIC
/begin CHARACTERISTIC WaHtEl_ATS.UpLim_C "/Obere Grenze für das Monitoring" VALUE 0x80031550 Val_Ws16 65535.00 OneToOne -32768.00 32767.00 /end CHARACTERISTIC
/begin CHARACTERISTIC WaHtEl_ATS.CnvFac_C "/Faktor für die Umrechnung" VALUE 0x80031554 Val_Ws32 4294967295.00 OneToOne -2147483648.00 2147483647.00 /end CHARACTERISTIC
/begin CHARACTERISTIC WaHtEl_ATS.CnvOfs_C "/Offset für die Umrechnung" VALUE 0x80031558 Val_Ws16 65535.00 OneToOne -32768.00 32767.00 /end CHARACTERISTIC
/begin CHARACTERISTIC WaHtEl_ATS.DfltVal_C "/Vorgabewert für standbytest" VALUE 0x8003155A Val_Ws16 65535.00 OneToOne -32768.00 32767.00 /end CHARACTERISTIC
/begin MEASUREMENT ASMod_aHPTrbnLim_mp "" SWORD Fact 1 100 -4.000000 3.999878 ECU_ADDRESS 0xC0009A5A /end MEASUREMENT
/begin MEASUREMENT ASMod_aHPTrbn_mp "" SWORD Fact 1 100 -4.000000 3.999878 ECU_ADDRESS 0xC0009A5C /end MEASUREMENT
/begin MEASUREMENT ASMod_aLPTrbnLim_mp "" SWORD Fact 1 100 -4.000000 3.999878 ECU_ADDRESS 0xC0009A5E /end MEASUREMENT
/begin MEASUREMENT ASMod_aLPTrbn_mp "" SWORD Fact 1 100 -4.000000 3.999878 ECU_ADDRESS 0xC0009A60 /end MEASUREMENT
/begin MEASUREMENT ASMod_arEffHPCmprBypVlv_mp "" FLOAT32_IEEE Area_cm2_float 1 100 0.00 32.0000000 FORMAT "%10.7" ECU_ADDRESS 0xC0008DB4 /end MEASUREMENT
/begin MEASUREMENT ASMod_arEffHPTrbnCtlFlp_mp "" FLOAT32_IEEE Area_cm2_float 1 100 0.00 32.0000000 FORMAT "%10.7" ECU_ADDRESS 0xC0008E28 /end MEASUREMENT
/begin MEASUREMENT ASMod_arEffLPTrbnBlwBy_mp "" FLOAT32_IEEE Area_cm2_float 1 100 0.00 32.0000000 FORMAT "%10.7" ECU_ADDRESS 0xC0008E2C /end MEASUREMENT
/begin MEASUREMENT ASMod_arEffTVA_mp "effektive Querschnittsfläche der Drosselklappe" FLOAT32_IEEE Area_cm2_float 1 100 0.00 32.0000000 FORMAT "%10.7" ECU_ADDRESS 0xC0008D80 /end MEASUREMENT
/begin MEASUREMENT ASMod_arPipeSlw_mp "Oberfläche Rohrstück" SWORD Area 1 100 -4.000000 3.999878 FORMAT "%8.6" ARRAY_SIZE 4 ECU_ADDRESS 0xC000B7F4 /end MEASUREMENT
/begin MEASUREMENT ASMod_arPipe_mp "Oberfläche Rohrstück" SWORD Area 1 100 -4.000000 3.999878 FORMAT "%8.6" ARRAY_SIZE 3 ECU_ADDRESS 0xC000B732 /end MEASUREMENT
/begin MEASUREMENT ASMod_aTrbChPos_mp "" SWORD Fact 1 100 -4.000000 3.999878 ECU_ADDRESS 0xC0009A12 /end MEASUREMENT
/begin MEASUREMENT ASMod_aTrbCh_mp "" SWORD Fact 1 100 -4.000000 3.999878 ECU_ADDRESS 0xC0009A14 /end MEASUREMENT
/begin MEASUREMENT ASMod_cndHtAirSlw_mp "Wärmeleitfähigkeit der Luft" SWORD Fact 1 100 -4.000000 3.999878 ARRAY_SIZE 4 ECU_ADDRESS 0xC000B7FC /end MEASUREMENT
/begin MEASUREMENT ASMod_cndHtAir_mp "Wärmeleitfähigkeit der Luft" SWORD Fact 1 100 -4.000000 3.999878 ARRAY_SIZE 3 ECU_ADDRESS 0xC000B738 /end MEASUREMENT
/begin MEASUREMENT ASMod_cndHtEGSlw_mp "Wärmeleitfähigkeit des Abgases" SWORD Fact 1 100 -4.000000 3.999878 ARRAY_SIZE 4 ECU_ADDRESS 0xC000B804 /end MEASUREMENT
/begin MEASUREMENT ASMod_cndHtEG_mp "Wärmeleitfähigkeit des Abgases" SWORD Fact 1 100 -4.000000 3.999878 ARRAY_SIZE 3 ECU_ADDRESS 0xC000B73E /end MEASUREMENT
/begin MEASUREMENT ASMod_dmAirEffIntMnfUs_mp "effektiver Luftmassenstrom vor Einlasskrümmer" FLOAT32_IEEE AirMassPerTime_float 1 100 0.00 1400.00000 FORMAT "%10.5" ECU_ADDRESS 0xC0008D84 /end MEASUREMENT
/begin MEASUREMENT ASMod_dmCmprUs_r32 "Gasmassestrom vor Verdichter" FLOAT32_IEEE AirMassPerTime_float 1 100 0.00 1400.00000 FORMAT "%10.5" ECU_ADDRESS 0xD0002D14 /end MEASUREMENT
/begin MEASUREMENT ASMod_dmEGFlCmbOxiC_mp "" SWORD InjMassPerTime 1 100 -327.6800 327.6700 FORMAT "%8.4" ECU_ADDRESS 0xC00099C4 /end MEASUREMENT
/begin MEASUREMENT ASMod_dmFlCmbOxiCAct_mp "Im OxiCat brennende Kraftstoffmassenstrom" SWORD InjMassPerTime_g_s 1 100 -16.38400 16.38350 FORMAT "%8.5" ECU_ADDRESS 0xC00099C8 /end MEASUREMENT
/begin MEASUREMENT ASMod_dmFlCmbOxiCatFld "Feld der im Oxidationskatalysator brennenden Kraftstoffmassenströme" SWORD InjMsPrTime_q0p001_COMPU 1 100 -32.76800 32.76700 FORMAT "%8.5" ARRAY_SIZE 1 ECU_ADDRESS 0xD0000460 /end MEASUREMENT
/begin MEASUREMENT ASMod_dmFlCmbOxiC_mp "Massenstrom des verbrannten Kraftstoffs im Oxidationskatalysator" SWORD InjMassPerTime_2 1 100 -16.38400 16.38350 FORMAT "%8.5" ARRAY_SIZE 1 ECU_ADDRESS 0xC000B6F4 /end MEASUREMENT
/begin MEASUREMENT ASMod_dmHCEmiCor_mp "Maximal konverrtierbarer HC-Massenstrom" SWORD InjMassPerTime_2 1 100 -16.38400 16.38350 FORMAT "%8.5" ECU_ADDRESS 0xC00099CA /end MEASUREMENT
/begin MEASUREMENT ASMod_dmHCEmi_mp "Aus dem nicht an der Verbrennung teilnehmenden Anteil der Einspritzmenge berechnete HC-Massenstrom" SWORD InjMassPerTime_2 1 100 -16.38400 16.38350 FORMAT "%8.5" ECU_ADDRESS 0xC00099CC /end MEASUREMENT
/begin MEASUREMENT ASMod_dmHCLdOxiC "Im OxiCat eingelagerte HC-Massenstrom" SWORD InjMassPerTime_g_s 1 100 -16.38400 16.38350 FORMAT "%8.5" ARRAY_SIZE 1 ECU_ADDRESS 0xD0000464 /end MEASUREMENT
/begin MEASUREMENT ASMod_dmHCLdOxiCAct "Aktuell im OxiCat eingelagerte HC-Massenstrom" SWORD InjMassPerTime_g_s 1 100 -16.38400 16.38350 FORMAT "%8.5" ARRAY_SIZE 1 ECU_ADDRESS 0xD0000462 /end MEASUREMENT
/begin MEASUREMENT ASMod_dmHCRgnOxiC "Abbauender HC-Massenstrom bei HC-Regeneration im OxiCat" SWORD InjMassPerTime_g_s 1 100 -16.38400 16.38350 FORMAT "%8.5" ARRAY_SIZE 1 ECU_ADDRESS 0xD0000466 /end MEASUREMENT
/begin MEASUREMENT ASMod_dmHPCmprBypVlv_mp "" FLOAT32_IEEE AirMassPerTime_float 1 100 0.00 1400.00000 FORMAT "%10.5" ECU_ADDRESS 0xC0008DB8 /end MEASUREMENT
/begin MEASUREMENT ASMod_dmHPCmprUsRed_mp "" FLOAT32_IEEE AirMassPerTime_float 1 100 0.00 1400.00000 FORMAT "%10.5" ECU_ADDRESS 0xC0008DBC /end MEASUREMENT
/begin MEASUREMENT ASMod_dmHPCmprUs_r32 "" FLOAT32_IEEE AirMassPerTime_float 1 100 0.00 1400.00000 FORMAT "%10.5" ECU_ADDRESS 0xD0002D20 /end MEASUREMENT
/begin MEASUREMENT ASMod_dmHPTrbnCtlFlp_mp "" SWORD AirMassPerTime 1 100 -3276.800 3276.700 ECU_ADDRESS 0xC0009A62 /end MEASUREMENT
/begin MEASUREMENT ASMod_dmHPTrbnUsRed_mp "" SWORD AirMassPerTime 1 100 -3276.800 3276.700 ECU_ADDRESS 0xC0009A64 /end MEASUREMENT
/begin MEASUREMENT ASMod_dmHPTrbn_mp "" SWORD AirMassPerTime 1 100 -3276.800 3276.700 ECU_ADDRESS 0xC0009A66 /end MEASUREMENT
/begin MEASUREMENT ASMod_dmIndAirRef "Referenzgasmassenstrom in den Motor" SWORD AirMassPerTime 1 100 -3276.800 3276.700 ECU_ADDRESS 0xD0000468 /end MEASUREMENT
/begin MEASUREMENT ASMod_dmIndVol_mp "zeitliche Änderung der Gasmasse im Einlassvolumen" FLOAT32_IEEE AirMassPerTime_float 1 100 -360.000000 360.000000 FORMAT "%10.6" ECU_ADDRESS 0xC0008D88 /end MEASUREMENT
/begin MEASUREMENT ASMod_dmIndVol_r32 "zeitliche Änderung der Gasmasse im Einlassvolumen" FLOAT32_IEEE AirMassPerTime_float 1 100 -360.000000 360.000000 FORMAT "%10.6" ECU_ADDRESS 0xD0002D24 /end MEASUREMENT
/begin MEASUREMENT ASMod_dmIntMnfUs "Gasmassenstrom vor Einlasskrümmer" SWORD AirMassPerTime 1 100 -3276.800 3276.700 ECU_ADDRESS 0xD000046E /end MEASUREMENT
/begin MEASUREMENT ASMod_dmIntMnfUsRaw_mp "Rohwert des Gasmassenstrom vor Einlasskrümmer" FLOAT32_IEEE AirMassPerTime_float 1 100 0.00 1400.00000 FORMAT "%10.5" ECU_ADDRESS 0xC0008D8C /end MEASUREMENT
/begin MEASUREMENT ASMod_dmIntMnfUs_r32 "Gasmassenstrom vor Einlasskrümmer" FLOAT32_IEEE AirMassPerTime_float 1 100 0.00 1400.00000 FORMAT "%10.5" ECU_ADDRESS 0xD0002D28 /end MEASUREMENT
/begin MEASUREMENT ASMod_dmLastHCLdOxiCAct_mp "" SWORD InjMassPerTime_g_s 1 100 -16.38400 16.38350 FORMAT "%8.5" ECU_ADDRESS 0xC00099CE /end MEASUREMENT
/begin MEASUREMENT ASMod_dmLPCmprUsRed_mp "" FLOAT32_IEEE AirMassPerTime_float 1 100 0.00 1400.00000 FORMAT "%10.5" ECU_ADDRESS 0xC0008DC0 /end MEASUREMENT
/begin MEASUREMENT ASMod_dmLPTrbnBlwBy_mp "" SWORD AirMassPerTime 1 100 -3276.800 3276.700 ECU_ADDRESS 0xC0009A68 /end MEASUREMENT
/begin MEASUREMENT ASMod_dmLPTrbnUsRed_mp "" SWORD AirMassPerTime 1 100 -3276.800 3276.700 ECU_ADDRESS 0xC0009A6A /end MEASUREMENT
/begin MEASUREMENT ASMod_dmLPTrbn_mp "" SWORD AirMassPerTime 1 100 -3276.800 3276.700 ECU_ADDRESS 0xC0009A6C /end MEASUREMENT
/begin MEASUREMENT ASMod_dmO2IndVol_mp "zeitliche Änderung der Sauerstoffmasse im Einlassvolumen" FLOAT32_IEEE AirMassPerTime_float 1 100 -360.000000 360.000000 FORMAT "%10.6" ECU_ADDRESS 0xC0008D90 /end MEASUREMENT
/begin MEASUREMENT ASMod_dmO2OxiCDiff "Sauerstoffmassenstrom-Differenz am Oxidationskatalysator" SWORD O2MassPerTimeLo 1 100 -655.3600 655.3400 FORMAT "%8.4" ARRAY_SIZE 1 ECU_ADDRESS 0xD0000472 /end MEASUREMENT
/begin MEASUREMENT ASMod_dmO2OxiCDs_mp "Sauerstoffmassenstrom nach Oxidationskatalysator" SWORD O2MassPerTimeLo 1 100 -655.3600 655.3400 FORMAT "%8.4" ARRAY_SIZE 1 ECU_ADDRESS 0xC000B6F6 /end MEASUREMENT
/begin MEASUREMENT ASMod_dmO2OxiC_mp "Sauerstoffmassenstrom im Oxidationskatalysator" SWORD O2MassPerTimeLo 1 100 -655.3600 655.3400 FORMAT "%8.4" ARRAY_SIZE 1 ECU_ADDRESS 0xC000B6F8 /end MEASUREMENT
/begin MEASUREMENT ASMod_dmOxiCMapIn_mp "Eingangssignal von ASMod_htcOxiC1_MAP" SWORD AirMassPerTime 1 100 -3276.800 3276.700 ECU_ADDRESS 0xC00099D0 /end MEASUREMENT
/begin MEASUREMENT ASMod_dmOxiCPT1EOM_mp "" SWORD AirMassPerTime 1 100 -3276.800 3276.700 ECU_ADDRESS 0xC00099E4 /end MEASUREMENT
/begin MEASUREMENT ASMod_dmPFltUs "Abgasmassenstrom vor Partikelfilter" SWORD AirMassPerTime 1 100 -3276.800 3276.700 ECU_ADDRESS 0xD0000476 /end MEASUREMENT
/begin MEASUREMENT ASMod_dmPFltUsCrvIn_mp "Abgasmassenstrom vor Partikelfilter" SWORD AirMassPerTime 1 100 -3276.800 3276.700 ECU_ADDRESS 0xC00099E6 /end MEASUREMENT
/begin MEASUREMENT ASMod_dmTrbnUsRed_mp "" SWORD AirMassPerTime 1 100 -3276.800 3276.700 ECU_ADDRESS 0xC0009A16 /end MEASUREMENT
/begin MEASUREMENT ASMod_dpExhGsMap_mp "Messpunkt für Test ASMod_PresPipe" SLONG Pres_hPa 1 100 -2147483648.00 3500.00 ARRAY_SIZE 4 ECU_ADDRESS 0xC000B6BC /end MEASUREMENT
/begin MEASUREMENT ASMod_dpExhGsSim_mp "Messpunkt für Test ASMod_PresPipe" SWORD Pres_hPa 1 100 -32768.00 3500.00 ARRAY_SIZE 4 ECU_ADDRESS 0xC000B6CC /end MEASUREMENT
/begin MEASUREMENT ASMod_dtHPCmprSurf_mp "" SLONG Temp_Kelv_Sec 1 100 -21474836.4800 21474836.4700 FORMAT "%13.4" ECU_ADDRESS 0xC0008DC4 /end MEASUREMENT
/begin MEASUREMENT ASMod_dtHPCmpr_mp "" SLONG Temp_Kelv_Sec 1 100 -21474836.4800 21474836.4700 FORMAT "%13.4" ECU_ADDRESS 0xC0008DC8 /end MEASUREMENT
/begin MEASUREMENT ASMod_dtHPTrbnDsLim_mp "" SWORD Temp_Kelv1_Sec 1 100 -3276.800 3276.700 FORMAT "%8.3" ECU_ADDRESS 0xC0009A6E /end MEASUREMENT
/begin MEASUREMENT ASMod_dtHPTrbnDs_mp "" SWORD Temp_Kelv1_Sec 1 100 -3276.800 3276.700 FORMAT "%8.3" ECU_ADDRESS 0xC0009A70 /end MEASUREMENT
/begin MEASUREMENT ASMod_dtLPCmprSurf_mp "" SLONG Temp_Kelv_Sec 1 100 -21474836.4800 21474836.4700 FORMAT "%13.4" ECU_ADDRESS 0xC0008DCC /end MEASUREMENT
/begin MEASUREMENT ASMod_dtLPCmpr_mp "" SLONG Temp_Kelv_Sec 1 100 -21474836.4800 21474836.4700 FORMAT "%13.4" ECU_ADDRESS 0xC0008DD0 /end MEASUREMENT
/begin MEASUREMENT ASMod_dtLPTrbnDsLim_mp "" SWORD Temp_Kelv1_Sec 1 100 -3276.800 3276.700 FORMAT "%8.3" ECU_ADDRESS 0xC0009A72 /end MEASUREMENT
/begin MEASUREMENT ASMod_dtLPTrbnDs_mp "" SWORD Temp_Kelv1_Sec 1 100 -3276.800 3276.700 FORMAT "%8.3" ECU_ADDRESS 0xC0009A74 /end MEASUREMENT
/begin MEASUREMENT ASMod_dtOxiCatUsLim_mp "" SWORD Temp_Kelv1_Sec 1 100 -3276.800 3276.700 FORMAT "%8.3" ECU_ADDRESS 0xC0009A18 /end MEASUREMENT
/begin MEASUREMENT ASMod_dtOxiCatUs_mp "" SWORD Temp_Kelv1_Sec 1 100 -3276.800 3276.700 FORMAT "%8.3" ECU_ADDRESS 0xC0009A1A /end MEASUREMENT
/begin MEASUREMENT ASMod_dtOxiCSurf_mp "Änderung der OxiCat-Oberflächentemperatur" SLONG Temp_Kelv_Sec 1 100 -21474836.4800 21474836.4700 FORMAT "%13.4" ARRAY_SIZE 1 ECU_ADDRESS 0xC000B6FC /end MEASUREMENT
/begin MEASUREMENT ASMod_dtOxiC_mp "Änderung der OxiCat-Austrittstemperatur" SLONG Temp_Kelv_Sec 1 100 -21474836.4800 21474836.4700 FORMAT "%13.4" ARRAY_SIZE 1 ECU_ADDRESS 0xC000B700 /end MEASUREMENT
/begin MEASUREMENT ASMod_dtPipeSlw_mp "Temperaturänderung Rohrstück" SLONG Temp_Kelv_Sec 1 100 -21474836.4800 21474836.4700 FORMAT "%13.4" ARRAY_SIZE 4 ECU_ADDRESS 0xC000B80C /end MEASUREMENT
/begin MEASUREMENT ASMod_dtPipe_mp "Temperaturänderung Rohrstück" SWORD Temp_Kelv_Sec 1 100 -327.6800 327.6700 FORMAT "%8.4" ARRAY_SIZE 3 ECU_ADDRESS 0xC000B744 /end MEASUREMENT
/begin MEASUREMENT ASMod_dVolEGPipe1_mp "Abgasvolumenstrom zur Druckberechnung im Abgassystem" SLONG AirVolPerTime 1 100 -214748364.800 214748364.700 FORMAT "%13.3" ECU_ADDRESS 0xC0008DA0 /end MEASUREMENT
/begin MEASUREMENT ASMod_dVolEGPipe_mp "Abgasvolumenstrom zur Druckberechnung im Abgassystem" SWORD AirVolPerTime 1 100 -3276.800 3276.700 FORMAT "%8.3" ARRAY_SIZE 4 ECU_ADDRESS 0xC000B6D4 /end MEASUREMENT
/begin MEASUREMENT ASMod_dvolIntMnfDsRaw_mp "Rohwert des Volumenstroms nach Einlasskrümmer" SWORD AirVolPerTime 1 100 -3276.800 3276.700 FORMAT "%8.3" ECU_ADDRESS 0xC0009AB2 /end MEASUREMENT
/begin MEASUREMENT ASMod_dvolIntMnfDsRef "Referenzgasvolumenstrom nach Einlasskrümmer" SWORD AirVolPerTime 1 100 -3276.800 3276.700 FORMAT "%8.3" ECU_ADDRESS 0xD0000478 /end MEASUREMENT
/begin MEASUREMENT ASMod_dvolPFltEG "berechneter Abgasvolumenstrom im Partikelfilter" SLONG AirVolPerTime 1 100 -214748364.800 214748364.700 FORMAT "%13.3" ECU_ADDRESS 0xD0002DE0 /end MEASUREMENT
/begin MEASUREMENT ASMod_dwAirHPCmpr_mp "" SLONG Pwr1 1 100 -214748364.800 214748364.700 FORMAT "%13.3" ECU_ADDRESS 0xC0008DD4 /end MEASUREMENT
/begin MEASUREMENT ASMod_dwAirLPCmpr_mp "" SLONG Pwr1 1 100 -214748364.800 214748364.700 FORMAT "%13.3" ECU_ADDRESS 0xC0008DD8 /end MEASUREMENT
/begin MEASUREMENT ASMod_dwEGHPTrbn_mp "" SWORD Pwr1 1 100 -3276.800 3276.700 FORMAT "%8.3" ECU_ADDRESS 0xC0009A76 /end MEASUREMENT
/begin MEASUREMENT ASMod_dwEGLPTrbn_mp "" SWORD Pwr1 1 100 -3276.800 3276.700 FORMAT "%8.3" ECU_ADDRESS 0xC0009A78 /end MEASUREMENT
/begin MEASUREMENT ASMod_dwEGPipeSlw_mp "Wärmestrom zwischen Gas und Rohrwand" SLONG Pwr1 1 100 -214748364.800 214748364.700 FORMAT "%13.3" ARRAY_SIZE 4 ECU_ADDRESS 0xC000B81C /end MEASUREMENT
/begin MEASUREMENT ASMod_dwEGPipe_mp "Wärmestrom zwischen Gas und Rohrwand" SLONG Pwr1 1 100 -214748364.800 214748364.700 FORMAT "%13.3" ARRAY_SIZE 3 ECU_ADDRESS 0xC000B74C /end MEASUREMENT
/begin MEASUREMENT ASMod_dwEGTrbn_mp "" SWORD Pwr1 1 100 -3276.800 3276.700 FORMAT "%8.3" ECU_ADDRESS 0xC0009A1C /end MEASUREMENT
/begin MEASUREMENT ASMod_dwEnvOxiC "gesamter Wärmeaustausch mit der Umgebung" SLONG Pwr1 1 100 -214748364.800 214748364.700 FORMAT "%13.3" ARRAY_SIZE 1 ECU_ADDRESS 0xD0002DE4 /end MEASUREMENT
/begin MEASUREMENT ASMod_dwEnvOxiCOut_mp "Wärmeaustausch mit der Umgebung in Brick 2" SLONG Pwr1 1 100 -214748364.800 214748364.700 FORMAT "%13.3" ARRAY_SIZE 1 ECU_ADDRESS 0xC000B704 /end MEASUREMENT
/begin MEASUREMENT ASMod_dwEnvOxiCSurf_mp "Wärmeaustausch mit der Umgebung in Brick 1" SLONG Pwr1 1 100 -214748364.800 214748364.700 FORMAT "%13.3" ARRAY_SIZE 1 ECU_ADDRESS 0xC000B708 /end MEASUREMENT
/begin MEASUREMENT ASMod_dwGsHPCmprSurf_mp "" SLONG Pwr1 1 100 -214748364.800 214748364.700 FORMAT "%13.3" ECU_ADDRESS 0xC0008DDC /end MEASUREMENT
/begin MEASUREMENT ASMod_dwGsLPCmprSurf_mp "" SLONG Pwr1 1 100 -214748364.800 214748364.700 FORMAT "%13.3" ECU_ADDRESS 0xC0008DE0 /end MEASUREMENT
/begin MEASUREMENT ASMod_dwGsOxiCSurf_mp "Wärmestrom des Abgases in Brick 1" SLONG Pwr1 1 100 -214748364.800 214748364.700 FORMAT "%13.3" ARRAY_SIZE 1 ECU_ADDRESS 0xC000B70C /end MEASUREMENT
/begin MEASUREMENT ASMod_dwGsOxiC_mp "Wärmestrom des Abgases in Brick 2" SLONG Pwr1 1 100 -214748364.800 214748364.700 FORMAT "%13.3" ARRAY_SIZE 1 ECU_ADDRESS 0xC000B710 /end MEASUREMENT
/begin MEASUREMENT ASMod_dwHCCnvOxiC_mp "Wärmestrom aus HC-Umsatz" SLONG Pwr1 1 100 -214748364.800 214748364.700 FORMAT "%13.3" ARRAY_SIZE 1 ECU_ADDRESS 0xC000B714 /end MEASUREMENT
/begin MEASUREMENT ASMod_dwHPCmprSurf_mp "" SLONG Pwr1 1 100 -214748364.800 214748364.700 FORMAT "%13.3" ECU_ADDRESS 0xC0008DE4 /end MEASUREMENT
/begin MEASUREMENT ASMod_dwHPCmpr_mp "" SLONG Pwr1 1 100 -214748364.800 214748364.700 FORMAT "%13.3" ECU_ADDRESS 0xC0008DE8 /end MEASUREMENT
/begin MEASUREMENT ASMod_dwLPCmprSurf_mp "" SLONG Pwr1 1 100 -214748364.800 214748364.700 FORMAT "%13.3" ECU_ADDRESS 0xC0008DEC /end MEASUREMENT
/begin MEASUREMENT ASMod_dwLPCmpr_mp "" SLONG Pwr1 1 100 -214748364.800 214748364.700 FORMAT "%13.3" ECU_ADDRESS 0xC0008DF0 /end MEASUREMENT
/begin MEASUREMENT ASMod_dwOxiCSurf_mp "Summe aller Wärmeströme im ersten Brick des Katalysators" SLONG Pwr1 1 100 -214748364.800 214748364.700 FORMAT "%13.3" ARRAY_SIZE 1 ECU_ADDRESS 0xC000B718 /end MEASUREMENT
/begin MEASUREMENT ASMod_dwOxiC_mp "Summe aller Wärmeströme im zweiten Brick des Katalysators" SLONG Pwr1 1 100 -214748364.800 214748364.700 FORMAT "%13.3" ARRAY_SIZE 1 ECU_ADDRESS 0xC000B71C /end MEASUREMENT
/begin MEASUREMENT ASMod_dwPipeEnvSlw_mp "Wärmestrom zwischen Rohrwand und Umgebung" SLONG Pwr1 1 100 -214748364.800 214748364.700 FORMAT "%13.3" ARRAY_SIZE 4 ECU_ADDRESS 0xC000B82C /end MEASUREMENT
/begin MEASUREMENT ASMod_dwPipeEnv_mp "Wärmestrom zwischen Rohrwand und Umgebung" SLONG Pwr1 1 100 -214748364.800 214748364.700 FORMAT "%13.3" ARRAY_SIZE 3 ECU_ADDRESS 0xC000B758 /end MEASUREMENT
/begin MEASUREMENT ASMod_dwPipeInSlw_mp "Wärmestrom am Rohreinlass" SLONG Pwr1 1 100 -214748364.800 214748364.700 FORMAT "%13.3" ARRAY_SIZE 4 ECU_ADDRESS 0xC000B83C /end MEASUREMENT
/begin MEASUREMENT ASMod_dwPipeIn_mp "Wärmestrom am Rohreinlass" SLONG Pwr1 1 100 -214748364.800 214748364.700 FORMAT "%13.3" ARRAY_SIZE 3 ECU_ADDRESS 0xC000B764 /end MEASUREMENT
/begin MEASUREMENT ASMod_dwPipeOutSlw_mp "Wärmestrom am Rohrauslass" SLONG Pwr1 1 100 -214748364.800 214748364.700 FORMAT "%13.3" ARRAY_SIZE 4 ECU_ADDRESS 0xC000B84C /end MEASUREMENT
/begin MEASUREMENT ASMod_dwPipeOut_mp "Wärmestrom am Rohrauslass" SLONG Pwr1 1 100 -214748364.800 214748364.700 FORMAT "%13.3" ARRAY_SIZE 3 ECU_ADDRESS 0xC000B770 /end MEASUREMENT
/begin MEASUREMENT ASMod_dwPipeSlw_mp "Wärmeänderung Rohrstück" SLONG Pwr1 1 100 -214748364.800 214748364.700 FORMAT "%13.3" ARRAY_SIZE 4 ECU_ADDRESS 0xC000B85C /end MEASUREMENT
/begin MEASUREMENT ASMod_dwPipe_mp "Wärmeänderung Rohrstück" SLONG Pwr1 1 100 -214748364.800 214748364.700 FORMAT "%13.3" ARRAY_SIZE 3 ECU_ADDRESS 0xC000B77C /end MEASUREMENT
/begin MEASUREMENT ASMod_etaHPCmpr "" SWORD Fact 1 100 -4.000000 3.999878 ECU_ADDRESS 0xD000047E /end MEASUREMENT
/begin MEASUREMENT ASMod_etaHPCmpr_r32 "" FLOAT32_IEEE Fact_float 1 100 0.00 1.00000000 FORMAT "%10.8" ECU_ADDRESS 0xD0002D30 /end MEASUREMENT
/begin MEASUREMENT ASMod_etaLPCmpr "" SWORD Fact 1 100 -4.000000 3.999878 ECU_ADDRESS 0xD0000480 /end MEASUREMENT
/begin MEASUREMENT ASMod_etaLPCmpr_r32 "" FLOAT32_IEEE Fact_float 1 100 0.00 1.00000000 FORMAT "%10.8" ECU_ADDRESS 0xD0002D34 /end MEASUREMENT
/begin MEASUREMENT ASMod_etaTrbCh_mp "Gesamtwirkungsgrad Turbolader" SWORD Fact 1 100 -4.000000 3.999878 ECU_ADDRESS 0xC0009A1E /end MEASUREMENT
/begin MEASUREMENT ASMod_etaTrbn_mp "Turbinenwirkungsgrad" SWORD Fact 1 100 -4.000000 3.999878 ECU_ADDRESS 0xC0009A20 /end MEASUREMENT
/begin MEASUREMENT ASMod_facHCCnvOxiC_mp "temperaturabhängige HC-Umsatzrate im OxiCat" SWORD Fact 1 100 -4.000000 3.999878 ARRAY_SIZE 1 ECU_ADDRESS 0xC000B720 /end MEASUREMENT
/begin MEASUREMENT ASMod_facHCLdOxiCLoad_mp "" SWORD Fact 1 100 -4.000000 3.999878 ARRAY_SIZE 1 ECU_ADDRESS 0xC000B722 /end MEASUREMENT
/begin MEASUREMENT ASMod_facHCLdOxiCTemp_mp "" SWORD Fact 1 100 -4.000000 3.999878 ARRAY_SIZE 1 ECU_ADDRESS 0xC000B724 /end MEASUREMENT
/begin MEASUREMENT ASMod_facHPCmprPwr_mp "" FLOAT32_IEEE Fact_float 1 100 -5.00000000 5.00000000 FORMAT "%10.8" ECU_ADDRESS 0xC0008DF4 /end MEASUREMENT
/begin MEASUREMENT ASMod_facLPCmprPwr_mp "" FLOAT32_IEEE Fact_float 1 100 -5.00000000 5.00000000 FORMAT "%10.8" ECU_ADDRESS 0xC0008DF8 /end MEASUREMENT
/begin MEASUREMENT ASMod_facPowEGPipe_mp "Faktor aus der Potenzfunktion zur Druckberechnung im Abgassystem" SWORD Fact1 1 100 -256.0000 255.9922 ARRAY_SIZE 4 ECU_ADDRESS 0xC000B6DC /end MEASUREMENT
/begin MEASUREMENT ASMod_facRhoEtaEGPipe_mp "temperaturabhängiger Dichte- und Viskositätsfaktor zur Druckberechnung im Abgassystem" SWORD Fact 1 100 -4.000000 3.999878 ARRAY_SIZE 4 ECU_ADDRESS 0xC000B6E4 /end MEASUREMENT
/begin MEASUREMENT ASMod_facTempAdbtHPTrbn_mp "" SWORD Fact 1 100 -4.000000 3.999878 ECU_ADDRESS 0xC0009A7A /end MEASUREMENT
/begin MEASUREMENT ASMod_facTempAdbtLPTrbn_mp "" SWORD Fact 1 100 -4.000000 3.999878 ECU_ADDRESS 0xC0009A7C /end MEASUREMENT
/begin MEASUREMENT ASMod_facTempAdptTrbn_mp "" SWORD Fact 1 100 -4.000000 3.999878 ECU_ADDRESS 0xC0009A22 /end MEASUREMENT
/begin MEASUREMENT ASMod_facTrbnPT1_mp "Variabler Faktor für Turbolader-Temperaturmodell" SLONG Fact_PT1 1 100 -16777216.0000 16777215.9922 FORMAT "%13.4" ECU_ADDRESS 0xC0008DB0 /end MEASUREMENT
/begin MEASUREMENT ASMod_facTwinCmprPwrRaw_mp "" FLOAT32_IEEE Fact_float 1 100 -5.00000000 5.00000000 FORMAT "%10.8" ECU_ADDRESS 0xC0008DFC /end MEASUREMENT
/begin MEASUREMENT ASMod_facVolEff "Luftaufwand des Motors" SWORD RatAirMass 1 100 -327.6800 327.6700 FORMAT "%8.4" ECU_ADDRESS 0xD0000482 /end MEASUREMENT
/begin MEASUREMENT ASMod_facVolEffBasCor_mp "korrigierter Basiswert für Luftaufwand des Motors" SWORD RatAirMass 1 100 -327.6800 327.6700 FORMAT "%8.4" ECU_ADDRESS 0xC0009AB4 /end MEASUREMENT
/begin MEASUREMENT ASMod_facVolEffBas_mp "Basiswert für Luftaufwand des Motors" SWORD RatAirMass 1 100 -327.6800 327.6700 FORMAT "%8.4" ECU_ADDRESS 0xC0009AB6 /end MEASUREMENT
/begin MEASUREMENT ASMod_facVolEffTempCor_mp "Korrekturfaktor für Luftaufwand aufgrund der Gastemperatur nach Einlasskrümmer" SWORD RatAirMass 1 100 -327.6800 327.6700 FORMAT "%8.4" ECU_ADDRESS 0xC0009AB8 /end MEASUREMENT
/begin MEASUREMENT ASMod_facVolEffVSACor_mp "Korrekturfaktor für Luftaufwand aufgrund der aktuellen Drallklappenposition" SWORD RatAirMass 1 100 -327.6800 327.6700 FORMAT "%8.4" ECU_ADDRESS 0xC0009ABA /end MEASUREMENT
/begin MEASUREMENT ASMod_htcArEGPipeSlw_mp "Wärmeübergangsleitwert zwischen Gas und Rohrwand" SLONG ThermalCoEff 1 100 -214748364.800 214748364.700 FORMAT "%13.3" ARRAY_SIZE 4 ECU_ADDRESS 0xC000B86C /end MEASUREMENT
/begin MEASUREMENT ASMod_htcArEGPipe_mp "Wärmeübergangsleitwert zwischen Gas und Rohrwand" SLONG ThermalCoEff 1 100 -214748364.800 214748364.700 FORMAT "%13.3" ARRAY_SIZE 3 ECU_ADDRESS 0xC000B788 /end MEASUREMENT
/begin MEASUREMENT ASMod_htcArEGTrbn "" SLONG ThermalCoEff 1 100 -214748364.800 214748364.700 FORMAT "%13.3" ECU_ADDRESS 0xD0002DE8 /end MEASUREMENT
/begin MEASUREMENT ASMod_htcArHPTrbn_mp "" SWORD ThermalCoEff 1 100 -3276.800 3276.700 FORMAT "%8.3" ECU_ADDRESS 0xC0009A7E /end MEASUREMENT
/begin MEASUREMENT ASMod_htcArLPTrbn_mp "" SWORD ThermalCoEff 1 100 -3276.800 3276.700 FORMAT "%8.3" ECU_ADDRESS 0xC0009A80 /end MEASUREMENT
/begin MEASUREMENT ASMod_htcArPipeEnvSlw_mp "Wärmeübergangsleitwert zwischen Rohrwand und Umgebung" SLONG ThermalCoEff 1 100 -214748364.800 214748364.700 FORMAT "%13.3" ARRAY_SIZE 4 ECU_ADDRESS 0xC000B87C /end MEASUREMENT
/begin MEASUREMENT ASMod_htcArPipeEnv_mp "Wärmeübergangsleitwert zwischen Rohrwand und Umgebung" SLONG ThermalCoEff 1 100 -214748364.800 214748364.700 FORMAT "%13.3" ARRAY_SIZE 3 ECU_ADDRESS 0xC000B794 /end MEASUREMENT
/begin MEASUREMENT ASMod_htcArTrbnEnv "" SLONG ThermalCoEff 1 100 -214748364.800 214748364.700 FORMAT "%13.3" ECU_ADDRESS 0xD0002DEC /end MEASUREMENT
/begin MEASUREMENT ASMod_htcArTrbn_mp "" SWORD ThermalCoEff 1 100 -3276.800 3276.700 FORMAT "%8.3" ECU_ADDRESS 0xC0009A24 /end MEASUREMENT
/begin MEASUREMENT ASMod_htcEGPipeSlw_mp "Wärmeübergangskoeffizient zwischen Gas und Rohrwand" SWORD ThermalCoEff 1 100 -3276.800 3276.700 FORMAT "%8.3" ARRAY_SIZE 4 ECU_ADDRESS 0xC000B88C /end MEASUREMENT
/begin MEASUREMENT ASMod_htcEGPipe_mp "Wärmeübergangskoeffizient zwischen Gas und Rohrwand" SWORD ThermalCoEff 1 100 -3276.800 3276.700 FORMAT "%8.3" ARRAY_SIZE 3 ECU_ADDRESS 0xC000B7A0 /end MEASUREMENT
/begin MEASUREMENT ASMod_htcOxiC_mp "Wärmeübertragungskoeffizient" SLONG ThermalCoEff 1 100 -214748364.800 214748364.700 FORMAT "%13.3" ARRAY_SIZE 1 ECU_ADDRESS 0xC000B728 /end MEASUREMENT
/begin MEASUREMENT ASMod_htcPipeEnvSlw_mp "Wärmeübergangskoeffizient zwischen Rohrwand und Umgebung" SWORD ThermalCoEff 1 100 -3276.800 3276.700 FORMAT "%8.3" ARRAY_SIZE 4 ECU_ADDRESS 0xC000B894 /end MEASUREMENT
/begin MEASUREMENT ASMod_htcPipeEnv_mp "Wärmeübergangskoeffizient zwischen Rohrwand und Umgebung" SWORD ThermalCoEff 1 100 -3276.800 3276.700 FORMAT "%8.3" ARRAY_SIZE 3 ECU_ADDRESS 0xC000B7A6 /end MEASUREMENT
/begin MEASUREMENT ASMod_mAirPerCylCor "dynamisch korrigierte Luftmasse pro Zylinder vor Mischstelle im Einlasskrümmer" SWORD AirMassPerCyl 1 100 0.00 700.0000 ECU_ADDRESS 0xD0000484 /end MEASUREMENT
/begin MEASUREMENT ASMod_mHCLdOciCActOld_mp "" SWORD InjMass_g 1 100 -327.6800 327.6700 FORMAT "%8.4" ARRAY_SIZE 1 ECU_ADDRESS 0xC000B72C /end MEASUREMENT
/begin MEASUREMENT ASMod_mHCLdOxiCAct "" SWORD InjMass_g 1 100 -327.6800 327.6700 FORMAT "%8.4" ARRAY_SIZE 1 ECU_ADDRESS 0xD0000488 /end MEASUREMENT
/begin MEASUREMENT ASMod_mIndVolInit_r32 "Initialisierungswert für die Gasmasse im Einlassvolumen" FLOAT32_IEEE Airmass_float 1 100 0.00 150.000000 FORMAT "%10.6" ECU_ADDRESS 0xD0002D40 /end MEASUREMENT
/begin MEASUREMENT ASMod_mIndVol_mp "gespeicherte Gasmasse im Einlassvolumen" FLOAT32_IEEE Airmass_float 1 100 0.00 150.000000 FORMAT "%10.6" ECU_ADDRESS 0xC0008D94 /end MEASUREMENT
/begin MEASUREMENT ASMod_mIndVol_r32 "gespeicherte Gasmasse im Einlassvolumen" FLOAT32_IEEE Airmass_float 1 100 0.00 150.000000 FORMAT "%10.6" ECU_ADDRESS 0xD0002D44 /end MEASUREMENT
/begin MEASUREMENT ASMod_mLastHCLdOxiCAct_mp "" SWORD InjMass_g 1 100 -327.6800 327.6700 FORMAT "%8.4" ECU_ADDRESS 0xC00099D4 /end MEASUREMENT
/begin MEASUREMENT ASMod_mO2IndVol_mp "Sauerstoffmasse im Einlassvolumen" FLOAT32_IEEE Airmass_float 1 100 0.00 5.00000000 FORMAT "%10.8" ECU_ADDRESS 0xC0008D98 /end MEASUREMENT
/begin MEASUREMENT ASMod_nHPTrbChRed_mp "" FLOAT32_IEEE TrbChN_float 1 100 0.00 300000.000 FORMAT "%10.3" ECU_ADDRESS 0xC0008E00 /end MEASUREMENT
/begin MEASUREMENT ASMod_nHPTrbCh_r32 "" FLOAT32_IEEE TrbChN_float 1 100 0.00 300000.000 FORMAT "%10.3" ECU_ADDRESS 0xD0002D48 /end MEASUREMENT
/begin MEASUREMENT ASMod_nLPTrbChRed_mp "" FLOAT32_IEEE TrbChN_float 1 100 0.00 300000.000 FORMAT "%10.3" ECU_ADDRESS 0xC0008E04 /end MEASUREMENT
/begin MEASUREMENT ASMod_nLPTrbCh_r32 "" FLOAT32_IEEE TrbChN_float 1 100 0.00 300000.000 FORMAT "%10.3" ECU_ADDRESS 0xD0002D4C /end MEASUREMENT
/begin MEASUREMENT ASMod_nuPipeEnvSlw_mp "Nusseltzahl zwischen Rohrwand und Umgebung" SWORD OneToOne 1 100 -32768.00 32767.00 ARRAY_SIZE 4 ECU_ADDRESS 0xC000B89C /end MEASUREMENT
/begin MEASUREMENT ASMod_nuPipeEnv_mp "Nusseltzahl zwischen Rohrwand und Umgebung" SWORD OneToOne 1 100 -32768.00 32767.00 ARRAY_SIZE 3 ECU_ADDRESS 0xC000B7AC /end MEASUREMENT
/begin MEASUREMENT ASMod_nuPipeSlw_mp "Nusseltzahl im Rohrstück" SWORD OneToOne 1 100 -32768.00 32767.00 ARRAY_SIZE 4 ECU_ADDRESS 0xC000B8A4 /end MEASUREMENT
/begin MEASUREMENT ASMod_nuPipe_mp "Nusseltzahl im Rohrstück" SWORD OneToOne 1 100 -32768.00 32767.00 ARRAY_SIZE 3 ECU_ADDRESS 0xC000B7B2 /end MEASUREMENT
/begin MEASUREMENT ASMod_pCACDs_mp "Druck nach Ladeluftkühler" SWORD Pres_hPa 1 100 -32768.00 3500.00 ECU_ADDRESS 0xC0009A26 /end MEASUREMENT
/begin MEASUREMENT ASMod_pCmprUs_r32 "Druck vor Verdichter" FLOAT32_IEEE Pres_hPa_float 1 100 700.000000 1200.00000 FORMAT "%10.5" ECU_ADDRESS 0xD0002D5C /end MEASUREMENT
/begin MEASUREMENT ASMod_pDiffEGPipe_mp "Druckdifferenz über ein Rohrstück der Abgasleitung" SWORD Pres_hPa 1 100 -32768.00 3500.00 ARRAY_SIZE 4 ECU_ADDRESS 0xC000B6EC /end MEASUREMENT
/begin MEASUREMENT ASMod_pDiffEngGsFlw "" SWORD Pres_hPa 1 100 -32768.00 3500.00 ECU_ADDRESS 0xD0000490 /end MEASUREMENT
/begin MEASUREMENT ASMod_pEGPresPipe_mp "Messpunkt des Eingangssignals von ASMod_facRhoEtaEGPipe_MAP" SWORD Pres_hPa 1 100 -32768.00 3500.00 ECU_ADDRESS 0xC00099BE /end MEASUREMENT
/begin MEASUREMENT ASMod_pHPCmprUs_r32 "" FLOAT32_IEEE Pres_hPa_float 1 100 700.000000 1200.00000 FORMAT "%10.5" ECU_ADDRESS 0xD0002D64 /end MEASUREMENT
/begin MEASUREMENT ASMod_pHPDiffEngGsFlw "" SWORD Pres_hPa 1 100 -32768.00 3500.00 ECU_ADDRESS 0xD00004A2 /end MEASUREMENT
/begin MEASUREMENT ASMod_pHPTrbnUs "" SWORD Pres_hPa 1 100 -32768.00 3500.00 ECU_ADDRESS 0xD00004A4 /end MEASUREMENT
/begin MEASUREMENT ASMod_pIndAir_mp "Druck im Gasmassenstrom in den Motor" SWORD Pres_hPa 1 100 -32768.00 3500.00 ECU_ADDRESS 0xC0009ABC /end MEASUREMENT
/begin MEASUREMENT ASMod_pIndVol "Druck im Einlassvolumen" SWORD Pres_hPa 1 100 0.00 3500.000 ECU_ADDRESS 0xD00004A6 /end MEASUREMENT
/begin MEASUREMENT ASMod_pIndVol_r32 "Druck im Einlassvolumen" FLOAT32_IEEE Pres_hPa_float 1 100 0.00 4000.00000 FORMAT "%10.5" ECU_ADDRESS 0xD0002D68 /end MEASUREMENT
/begin MEASUREMENT ASMod_pLPTrbnUs "" SWORD Pres_hPa 1 100 -32768.00 3500.00 ECU_ADDRESS 0xD00004A8 /end MEASUREMENT
/begin MEASUREMENT ASMod_pMidPFlt "Druck im Partikelfilter" SWORD Pres_hPa 1 100 -32768.00 3500.00 ECU_ADDRESS 0xD00004AA /end MEASUREMENT
/begin MEASUREMENT ASMod_pPFltSimDs "simulierter Druck nach Partikelfilter" SWORD Pres_hPa 1 100 -32768.00 3500.00 ECU_ADDRESS 0xD00004AC /end MEASUREMENT
/begin MEASUREMENT ASMod_pPFltUs "" SWORD Pres_hPa 1 100 -32768.00 3500.00 ECU_ADDRESS 0xD00004AE /end MEASUREMENT
/begin MEASUREMENT ASMod_pTrbnUs "" SWORD Pres_hPa 1 100 -32768.00 3500.00 ECU_ADDRESS 0xD00004B0 /end MEASUREMENT
/begin MEASUREMENT ASMod_pwrCmpr_mp "Verdichterleistung" SWORD Pwr 1 100 -308831.1 308821.7 FORMAT "%8.1" ECU_ADDRESS 0xC0009A28 /end MEASUREMENT
/begin MEASUREMENT ASMod_pwrHPCmprRaw_mp "" FLOAT32_IEEE Pwr_float 1 100 0.00 32000.0000 FORMAT "%10.4" ECU_ADDRESS 0xC0008E08 /end MEASUREMENT
/begin MEASUREMENT ASMod_pwrHPCmpr_mp "" FLOAT32_IEEE Pwr_float 1 100 0.00 32000.0000 FORMAT "%10.4" ECU_ADDRESS 0xC0008E0C /end MEASUREMENT
/begin MEASUREMENT ASMod_pwrHPTrbn "" SWORD Pwr 1 100 -308831.1 308821.7 FORMAT "%8.1" ECU_ADDRESS 0xD00004B2 /end MEASUREMENT
/begin MEASUREMENT ASMod_pwrLPCmprRaw_mp "" FLOAT32_IEEE Pwr_float 1 100 0.00 32000.0000 FORMAT "%10.4" ECU_ADDRESS 0xC0008E10 /end MEASUREMENT
/begin MEASUREMENT ASMod_pwrLPCmpr_mp "" FLOAT32_IEEE Pwr_float 1 100 0.00 32000.0000 FORMAT "%10.4" ECU_ADDRESS 0xC0008E14 /end MEASUREMENT
/begin MEASUREMENT ASMod_pwrLPTrbn "" SWORD Pwr 1 100 -308831.1 308821.7 FORMAT "%8.1" ECU_ADDRESS 0xD00004B4 /end MEASUREMENT
/begin MEASUREMENT ASMod_qPresPipe_mp "Eingangssignal für ASMod_pDiffPipe_MAP" SWORD InjMass 1 100 -327.6800 327.6700 ECU_ADDRESS 0xC00099C0 /end MEASUREMENT
/begin MEASUREMENT ASMod_qSetUnBalCrvIn_mp "Einspritzmenge-Sollwert ( ohne Mengenausgleichsregelung )" SWORD InjMass 1 100 -327.6800 327.6700 ECU_ADDRESS 0xC0009ABE /end MEASUREMENT
/begin MEASUREMENT ASMod_rePipe1_mp "Reynoldszahl im Rohrstück" SWORD ReynoldsNum 1 100 -3276800. 3276700. FORMAT "%8.0" ECU_ADDRESS 0xC00099FE /end MEASUREMENT
/begin MEASUREMENT ASMod_rePipeEnv1_mp "Reynoldszahl zwischen Rohrwand und Umgebung" SWORD ReynoldsNum1 1 100 -32768000. 32767000. FORMAT "%8.0" ECU_ADDRESS 0xC0009A00 /end MEASUREMENT
/begin MEASUREMENT ASMod_rePipeEnvSlw1_mp "Reynoldszahl zwischen Rohrwand und Umgebung" SWORD ReynoldsNum1 1 100 -32768000. 32767000. FORMAT "%8.0" ECU_ADDRESS 0xC0009A02 /end MEASUREMENT
/begin MEASUREMENT ASMod_rePipeEnvSlw_mp "Reynoldszahl zwischen Rohrwand und Umgebung" SWORD ReynoldsNum1 1 100 -32768000. 32767000. FORMAT "%8.0" ARRAY_SIZE 4 ECU_ADDRESS 0xC000B8AC /end MEASUREMENT
/begin MEASUREMENT ASMod_rePipeEnv_mp "Reynoldszahl zwischen Rohrwand und Umgebung" SWORD ReynoldsNum1 1 100 -32768000. 32767000. FORMAT "%8.0" ARRAY_SIZE 3 ECU_ADDRESS 0xC000B7B8 /end MEASUREMENT
/begin MEASUREMENT ASMod_rePipeSlw1_mp "Reynoldszahl im Rohrstück" SWORD ReynoldsNum 1 100 -3276800. 3276700. FORMAT "%8.0" ECU_ADDRESS 0xC0009A04 /end MEASUREMENT
/begin MEASUREMENT ASMod_rePipeSlw_mp "Reynoldszahl im Rohrstück" SWORD ReynoldsNum 1 100 -3276800. 3276700. FORMAT "%8.0" ARRAY_SIZE 4 ECU_ADDRESS 0xC000B8B4 /end MEASUREMENT
/begin MEASUREMENT ASMod_rePipe_mp "Reynoldszahl im Rohrstück" SWORD ReynoldsNum 1 100 -3276800. 3276700. FORMAT "%8.0" ARRAY_SIZE 3 ECU_ADDRESS 0xC000B7BE /end MEASUREMENT
/begin MEASUREMENT ASMod_rHCRgnOxiC_mp "" SWORD Time_1_s 1 100 -0.2000000 0.1999939 FORMAT "%9.7" ARRAY_SIZE 1 ECU_ADDRESS 0xC000B72E /end MEASUREMENT
/begin MEASUREMENT ASMod_rHPTrbCh_mp "" FLOAT32_IEEE Pos_Prc_float 1 100 0.00 100.000000 FORMAT "%10.6" ECU_ADDRESS 0xC0008E30 /end MEASUREMENT
/begin MEASUREMENT ASMod_rLamRecEGSensSim "simuliertes reziprokes Lambda-Signal der Lambda-Sonde" SWORD lambdaRecVal 1 100 -32.76800 32.76700 FORMAT "%8.5" ECU_ADDRESS 0xD00004CA /end MEASUREMENT
/begin MEASUREMENT ASMod_rLinTrbChFlt_mp "" SWORD Fact 1 100 -4.000000 3.999878 ECU_ADDRESS 0xC0009A2A /end MEASUREMENT
/begin MEASUREMENT ASMod_rLPTrbCh_mp "" FLOAT32_IEEE Pos_Prc_float 1 100 0.00 100.000000 FORMAT "%10.6" ECU_ADDRESS 0xC0008E34 /end MEASUREMENT
/begin MEASUREMENT ASMod_rNOxSensOxiCUs_mp "" SWORD RatNOxMass 1 100 -0.003276800 0.003276700 FORMAT "%11.9" ECU_ADDRESS 0xC00099D6 /end MEASUREMENT
/begin MEASUREMENT ASMod_rNOxSensPFltUs_mp "Mit NOx-Sensor ermittelter NOx-Massenanteil vor DPF" SWORD RatNOxMass 1 100 -0.003276800 0.003276700 FORMAT "%11.9" ECU_ADDRESS 0xC00099E8 /end MEASUREMENT
/begin MEASUREMENT ASMod_rO2CmprUs_r32 "Sauerstoffanteil im Gasmassenstroms vor Verdichter" FLOAT32_IEEE OneToOne 1 100 0.00 0.231500000 FORMAT "%11.9" ECU_ADDRESS 0xD0002D74 /end MEASUREMENT
/begin MEASUREMENT ASMod_rO2ExhMnfLPUs_mp "Sauerstoffmassenanteil vor niederdruckseitigem Abgaskrümmer" SWORD O2 1 100 -0.3276800 0.3276700 ECU_ADDRESS 0xC00099B8 /end MEASUREMENT
/begin MEASUREMENT ASMod_rO2IntMnfUs_r32 "Sauerstoffanteil im Gasmassenstrom vor Einlasskrümmer" FLOAT32_IEEE OneToOne 1 100 0.00 0.231500000 FORMAT "%11.9" ECU_ADDRESS 0xD0002D78 /end MEASUREMENT
/begin MEASUREMENT ASMod_rPresCmpr_mp "Druckverhältnis am Verdichter" SWORD Fact 1 100 -4.000000 3.999878 ECU_ADDRESS 0xC0009A2C /end MEASUREMENT
/begin MEASUREMENT ASMod_rPresEGRDiff "" SWORD Fact 1 100 -4.000000 3.999878 ECU_ADDRESS 0xD00004F2 /end MEASUREMENT
/begin MEASUREMENT ASMod_rPresHPCmprRaw_mp "" FLOAT32_IEEE Fact_float 1 100 0.500000000 3.00000000 FORMAT "%10.8" ECU_ADDRESS 0xC0008E18 /end MEASUREMENT
/begin MEASUREMENT ASMod_rPresHPCmpr_mp "" FLOAT32_IEEE Fact_float 1 100 0.500000000 3.00000000 FORMAT "%10.8" ECU_ADDRESS 0xC0008E1C /end MEASUREMENT
/begin MEASUREMENT ASMod_rPresHPTrbnRec_mp "" SWORD Fact 1 100 -4.000000 3.999878 ECU_ADDRESS 0xC0009A82 /end MEASUREMENT
/begin MEASUREMENT ASMod_rPresHPTrbn_mp "" SWORD Fact 1 100 -4.000000 3.999878 ECU_ADDRESS 0xC0009A84 /end MEASUREMENT
/begin MEASUREMENT ASMod_rPresLPCmprRaw_mp "" FLOAT32_IEEE Fact_float 1 100 0.500000000 3.00000000 FORMAT "%10.8" ECU_ADDRESS 0xC0008E20 /end MEASUREMENT
/begin MEASUREMENT ASMod_rPresLPCmpr_mp "" FLOAT32_IEEE Fact_float 1 100 0.500000000 3.00000000 FORMAT "%10.8" ECU_ADDRESS 0xC0008E24 /end MEASUREMENT
/begin MEASUREMENT ASMod_rPresLPTrbnRec_mp "" SWORD Fact 1 100 -4.000000 3.999878 ECU_ADDRESS 0xC0009A86 /end MEASUREMENT
/begin MEASUREMENT ASMod_rPresLPTrbn_mp "" SWORD Fact 1 100 -4.000000 3.999878 ECU_ADDRESS 0xC0009A88 /end MEASUREMENT
/begin MEASUREMENT ASMod_rPresTrbnRec_mp "" SWORD Fact 1 100 -4.000000 3.999878 ECU_ADDRESS 0xC0009A2E /end MEASUREMENT
/begin MEASUREMENT ASMod_rPresTrbn_mp "Druckverhältnis an der Turbine" SWORD Fact 1 100 -4.000000 3.999878 ECU_ADDRESS 0xC0009A30 /end MEASUREMENT
/begin MEASUREMENT ASMod_rRelPosTVA_mp "relative Position der Drosselklappe" FLOAT32_IEEE Pos_Prc_float 1 100 0.00 4000.00000 FORMAT "%10.5" ECU_ADDRESS 0xC0008D9C /end MEASUREMENT
/begin MEASUREMENT ASMod_rTempAdbtHPCmpr_mp "" SWORD Fact 1 100 -4.000000 3.999878 ECU_ADDRESS 0xC0009A52 /end MEASUREMENT
/begin MEASUREMENT ASMod_rTempAdbtHPTrbn_mp "" SWORD Fact 1 100 -4.000000 3.999878 ECU_ADDRESS 0xC0009A8A /end MEASUREMENT
/begin MEASUREMENT ASMod_rTempAdbtLPCmpr_mp "" SWORD Fact 1 100 -4.000000 3.999878 ECU_ADDRESS 0xC0009A54 /end MEASUREMENT
/begin MEASUREMENT ASMod_rTempAdbtLPTrbn_mp "" SWORD Fact 1 100 -4.000000 3.999878 ECU_ADDRESS 0xC0009A8C /end MEASUREMENT
/begin MEASUREMENT ASMod_rTempAdbt_mp "adiabatisches Temperatur-Verhältnis" SWORD Fact 1 100 -4.000000 3.999878 ECU_ADDRESS 0xC0009A32 /end MEASUREMENT
/begin MEASUREMENT ASMod_rTempAdptTrbn_mp "" SWORD Fact 1 100 -4.000000 3.999878 ECU_ADDRESS 0xC0009A34 /end MEASUREMENT
/begin MEASUREMENT ASMod_rTempClgCrvIn_mp "Eingangssignal von ASMod_facTempClg_CUR" SWORD Fact1 1 100 -256.0000 255.9922 ECU_ADDRESS 0xC0009A06 /end MEASUREMENT
/begin MEASUREMENT ASMod_rTempClnt_mp "Verhältnis Motorübertemperatur Motorstop / Motorstart" SWORD Fact 1 100 -4.000000 3.999878 ECU_ADDRESS 0xC0009A08 /end MEASUREMENT
/begin MEASUREMENT ASMod_rTimeOxiC_mp "Verhältnis Standzeit zu Abkühl-Halbwertszeit Oxidationskatalysator" SWORD Fact1 1 100 -256.0000 255.9922 ARRAY_SIZE 1 ECU_ADDRESS 0xC000B8FC /end MEASUREMENT
/begin MEASUREMENT ASMod_rTimePipe_mp "Verhältnis Standzeit zu Abkühl-Halbwertszeit Rohrstück" SWORD Fact1 1 100 -256.0000 255.9922 ARRAY_SIZE 7 ECU_ADDRESS 0xC000B8FE /end MEASUREMENT
/begin MEASUREMENT ASMod_stFlwDirEGRLP_mp "Status der Strömungsrichtung des niederdruckseitig rückgeführten Abgasmassenstroms" UBYTE OneToOne 1 100 0.00 255.0 ECU_ADDRESS 0xC000B0AB /end MEASUREMENT
/begin MEASUREMENT ASMod_stInitIndVol "Status der Initialisierung in der Funktion Einlassvolumen" UBYTE OneToOne 1 100 0.00 255.0 ECU_ADDRESS 0xD0001BF0 /end MEASUREMENT
/begin MEASUREMENT ASMod_stNaNIndVol_mp "Status der Erkennung auf NaN und Inf im Modul Einlassvolumen" UBYTE OneToOne 1 100 0.00 255.0 ECU_ADDRESS 0xC000B0AA /end MEASUREMENT
/begin MEASUREMENT ASMod_stNOxSensPFltUs_mp "Status Verwendung NOx-Sensor für Emissionsermittlung zw. Oxi-Kat und DPF" UBYTE OneToOne 1 100 0.00 255.0 ECU_ADDRESS 0xC000B0AC /end MEASUREMENT
/begin MEASUREMENT ASMod_tAirStrt_mp "Lufttemperatur zur Starttemperatur-Berechnung" SWORD Temp_Cels 1 100 -3549.940 3003.560 ECU_ADDRESS 0xC0009A0A /end MEASUREMENT
/begin MEASUREMENT ASMod_tAirTrbn_mp "Lufttemperatur für Turbolader-Temperaturmodell" SWORD Temp_Cels 1 100 -3549.940 3003.560 ECU_ADDRESS 0xC0009A36 /end MEASUREMENT
/begin MEASUREMENT ASMod_tCmprUs_r32 "Temperatur vor Verdichter" FLOAT32_IEEE TempC_float 1 100 -50.0000000 150.000000 FORMAT "%10.6" ECU_ADDRESS 0xD0002D80 /end MEASUREMENT
/begin MEASUREMENT ASMod_tDiffEGHPTrbn_mp "" SWORD TempDiff_Cels 1 100 -3276.800 3276.700 FORMAT "%8.3" ECU_ADDRESS 0xC0009A8E /end MEASUREMENT
/begin MEASUREMENT ASMod_tDiffEGLPTrbn_mp "" SWORD TempDiff_Cels 1 100 -3276.800 3276.700 FORMAT "%8.3" ECU_ADDRESS 0xC0009A90 /end MEASUREMENT
/begin MEASUREMENT ASMod_tDiffEGPipeSlw_mp "Temperaturdifferenz zwischen Gas und Rohrwand" SWORD TempDiff_Kelv 1 100 -3276.800 3276.700 ARRAY_SIZE 4 ECU_ADDRESS 0xC000B8BC /end MEASUREMENT
/begin MEASUREMENT ASMod_tDiffEGPipe_mp "Temperaturdifferenz zwischen Gas und Rohrwand" SWORD TempDiff_Kelv 1 100 -3276.800 3276.700 ARRAY_SIZE 3 ECU_ADDRESS 0xC000B7C4 /end MEASUREMENT
/begin MEASUREMENT ASMod_tDiffEGTrbn_mp "" SWORD TempDiff_Cels 1 100 -3276.800 3276.700 FORMAT "%8.3" ECU_ADDRESS 0xC0009A38 /end MEASUREMENT
/begin MEASUREMENT ASMod_tDiffPipeEnvSlw_mp "Temperaturdifferenz zwischen Rohrwand und Umgebung" SWORD TempDiff_Kelv 1 100 -3276.800 3276.700 ARRAY_SIZE 4 ECU_ADDRESS 0xC000B8C4 /end MEASUREMENT
/begin MEASUREMENT ASMod_tDiffPipeEnv_mp "Temperaturdifferenz zwischen Rohrwand und Umgebung" SWORD TempDiff_Kelv 1 100 -3276.800 3276.700 ARRAY_SIZE 3 ECU_ADDRESS 0xC000B7CA /end MEASUREMENT
/begin MEASUREMENT ASMod_tEGPipeDs_mp "Abgastemperatur am Rohrausgang" SWORD Temp_Cels 1 100 -3549.940 3003.560 ARRAY_SIZE 3 ECU_ADDRESS 0xC000B7D0 /end MEASUREMENT
/begin MEASUREMENT ASMod_tEGPipeSlwDs_mp "Abgastemperatur am Rohrausgang" SWORD Temp_Cels 1 100 -3549.940 3003.560 ARRAY_SIZE 4 ECU_ADDRESS 0xC000B8CC /end MEASUREMENT
/begin MEASUREMENT ASMod_tEGPresPipe_mp "Eingangssignal für die MAP ASMod_facRhoEtaEGPipe_MAP" SWORD Temp_Cels 1 100 -3549.940 3003.560 ECU_ADDRESS 0xC00099C2 /end MEASUREMENT
/begin MEASUREMENT ASMod_tEngStrt_mp "Motortemperatur zur Starttemperatur-Berechnung" SWORD Temp_Cels 1 100 -3549.940 3003.560 ECU_ADDRESS 0xC0009A0C /end MEASUREMENT
/begin MEASUREMENT ASMod_tExsClnt_mp "Motorübertemperatur" SWORD TempDiff_Kelv 1 100 -3276.800 3276.700 ECU_ADDRESS 0xC0009A0E /end MEASUREMENT
/begin MEASUREMENT ASMod_tFld1_mp "Eingangssignal für ASMod_facLeanNOxPFlt_MAP" SWORD Temp_Cels 1 100 -3549.940 3003.560 ECU_ADDRESS 0xC00099EA /end MEASUREMENT
/begin MEASUREMENT ASMod_tHCCnvOxiCCrvIn_mp "Eingangssignal von ASMod_facHCCnvOxiC_CUR" SWORD Temp_Cels 1 100 -3549.940 3003.560 ECU_ADDRESS 0xC00099D8 /end MEASUREMENT
/begin MEASUREMENT ASMod_tHPCmprAdbtDs_mp "" SWORD Temp_Cels 1 100 -3549.940 3003.560 ECU_ADDRESS 0xC0009A56 /end MEASUREMENT
/begin MEASUREMENT ASMod_tHPCmprBypVlvDs "" SWORD Temp_Cels 1 100 -3549.940 3003.560 ECU_ADDRESS 0xD0000530 /end MEASUREMENT
/begin MEASUREMENT ASMod_tHPCmprDs "" SWORD Temp_Cels 1 100 -3549.940 3003.560 ECU_ADDRESS 0xD0000532 /end MEASUREMENT
/begin MEASUREMENT ASMod_tHPCmprSurf "" SWORD Temp_Cels 1 100 -3549.940 3003.560 ECU_ADDRESS 0xD0000534 /end MEASUREMENT
/begin MEASUREMENT ASMod_tHPTrbnAdbtUsUnCor_mp "" SWORD Temp_Cels 1 100 -3549.940 3003.560 ECU_ADDRESS 0xC0009A92 /end MEASUREMENT
/begin MEASUREMENT ASMod_tHPTrbnCor_mp "" SWORD Temp_Cels 1 100 -3549.940 3003.560 ECU_ADDRESS 0xC0009A94 /end MEASUREMENT
/begin MEASUREMENT ASMod_tHPTrbnDynCor_mp "" SWORD Temp_Cels 1 100 -3549.940 3003.560 ECU_ADDRESS 0xC0009A96 /end MEASUREMENT
/begin MEASUREMENT ASMod_tHPTrbnEnvCnvtRaw_mp "" SWORD Temp_Kelv 1 100 -3276.800 3276.700 FORMAT "%8.3" ECU_ADDRESS 0xC0009A98 /end MEASUREMENT
/begin MEASUREMENT ASMod_tHPTrbnEnvCnvt_mp "" SWORD Temp_Kelv 1 100 -3276.800 3276.700 FORMAT "%8.3" ECU_ADDRESS 0xC0009A9A /end MEASUREMENT
/begin MEASUREMENT ASMod_tHPTrbnTempCor_mp "" SWORD Temp_Cels 1 100 -3549.940 3003.560 ECU_ADDRESS 0xC0009A9C /end MEASUREMENT
/begin MEASUREMENT ASMod_tHPTrbnUs "" SWORD Temp_Cels 1 100 -3549.940 3003.560 ECU_ADDRESS 0xD0000536 /end MEASUREMENT
/begin MEASUREMENT ASMod_tHPTrbnUsFlt_mp "" SWORD Temp_Cels 1 100 -3549.940 3003.560 ECU_ADDRESS 0xC0009A9E /end MEASUREMENT
/begin MEASUREMENT ASMod_tHPTrbnUsUnCor "" SWORD Temp_Cels 1 100 -3549.940 3003.560 ECU_ADDRESS 0xD0000538 /end MEASUREMENT
/begin MEASUREMENT ASMod_tHPTrbnUsUnCorRaw_mp "" SWORD Temp_Cels 1 100 -3549.940 3003.560 ECU_ADDRESS 0xC0009AA0 /end MEASUREMENT
/begin MEASUREMENT ASMod_tHtTransCor_mp "Temperatur-Korrekturwert für Wärmeübergang am Temperatursensor vor PFlt" SWORD TempDiff_Kelv 1 100 -3276.800 3276.700 ECU_ADDRESS 0xC00099EC /end MEASUREMENT
/begin MEASUREMENT ASMod_tiClg "Abkühlzeit zur Starttemperatur-Berechnung" SLONG Time_s 1 100 -21474836.4800 21474836.4700 ECU_ADDRESS 0xD0002DF0 /end MEASUREMENT
/begin MEASUREMENT ASMod_tiClgRef_mp "Referenzzeit aus Motor-Abkühlung" SLONG Time_s 1 100 -21474836.4800 21474836.4700 ECU_ADDRESS 0xC0008DAC /end MEASUREMENT
/begin MEASUREMENT ASMod_tiExhGsDelPFlt_mp "Verzögerungszeit Abgas vor Partikelfilter" SWORD TimeDelay_s 1 100 0.13107600012 4294.9672960 FORMAT "%12.7" ECU_ADDRESS 0xC00099EE /end MEASUREMENT
/begin MEASUREMENT ASMod_tiHtTransDT1_mp "Filter-Zeitkonstante entsprechend Temperatursensor vor PFlt" SWORD TimeDelay_s 1 100 0.13107600012 4294.9672960 FORMAT "%12.7" ECU_ADDRESS 0xC00099F0 /end MEASUREMENT
/begin MEASUREMENT ASMod_tiLamSensDdt_mp "Totzeit des Verzögerungsglieds in der Funktion Lambda-Sensor" SWORD Time_sec 1 100 -32.76800 32.76700 FORMAT "%8.5" ECU_ADDRESS 0xC00099BA /end MEASUREMENT
/begin MEASUREMENT ASMod_tiLamSensPT1_mp "Zeitkonstante des PT1-Glieds in der Funktion Lambda-Sonde" SWORD TimeDelay_s_Lin_16 1 100 -5.000153 5.000000 FORMAT "%8.6" ECU_ADDRESS 0xC00099BC /end MEASUREMENT
/begin MEASUREMENT ASMod_tIntMnfDsRef "Referenzgastemperatur nach Einlasskrümmer" SWORD Temp_Cels 1 100 -3549.940 3003.560 ECU_ADDRESS 0xD000053C /end MEASUREMENT
/begin MEASUREMENT ASMod_tiOxiCPT1EOM_mp "" SLONG TimeDelay_s 1 100 0.000002000000001 4294.9672960 FORMAT "%12.7" ECU_ADDRESS 0xC0008DA8 /end MEASUREMENT
/begin MEASUREMENT ASMod_tLeanNOxOxiCMapIn1_mp "Eingangssignal von ASMod_facLeanNOxOxiC_MAP" SWORD Temp_Cels 1 100 -3549.940 3003.560 ECU_ADDRESS 0xC00099DA /end MEASUREMENT
/begin MEASUREMENT ASMod_tLeanNOxOxiCMapIn2_mp "Eingangssignal von ASMod_facLeanNOxOxiC_MAP" SWORD Temp_Cels 1 100 -3549.940 3003.560 ECU_ADDRESS 0xC00099DC /end MEASUREMENT
/begin MEASUREMENT ASMod_tLPCmprAdbtDs_mp "" SWORD Temp_Cels 1 100 -3549.940 3003.560 ECU_ADDRESS 0xC0009A58 /end MEASUREMENT
/begin MEASUREMENT ASMod_tLPCmprDs "" SWORD Temp_Cels 1 100 -3549.940 3003.560 ECU_ADDRESS 0xD0000540 /end MEASUREMENT
/begin MEASUREMENT ASMod_tLPCmprSurf "" SWORD Temp_Cels 1 100 -3549.940 3003.560 ECU_ADDRESS 0xD0000542 /end MEASUREMENT
/begin MEASUREMENT ASMod_tLPTrbnAdbtUsUnCor_mp "" SWORD Temp_Cels 1 100 -3549.940 3003.560 ECU_ADDRESS 0xC0009AA2 /end MEASUREMENT
/begin MEASUREMENT ASMod_tLPTrbnCor_mp "" SWORD Temp_Cels 1 100 -3549.940 3003.560 ECU_ADDRESS 0xC0009AA4 /end MEASUREMENT
/begin MEASUREMENT ASMod_tLPTrbnDynCor_mp "" SWORD Temp_Cels 1 100 -3549.940 3003.560 ECU_ADDRESS 0xC0009AA6 /end MEASUREMENT
/begin MEASUREMENT ASMod_tLPTrbnEnvCnvtRaw_mp "" SWORD Temp_Kelv 1 100 -3276.800 3276.700 FORMAT "%8.3" ECU_ADDRESS 0xC0009AA8 /end MEASUREMENT
/begin MEASUREMENT ASMod_tLPTrbnEnvCnvt_mp "" SWORD Temp_Kelv 1 100 -3276.800 3276.700 FORMAT "%8.3" ECU_ADDRESS 0xC0009AAA /end MEASUREMENT
/begin MEASUREMENT ASMod_tLPTrbnTempCor_mp "" SWORD Temp_Cels 1 100 -3549.940 3003.560 ECU_ADDRESS 0xC0009AAC /end MEASUREMENT
/begin MEASUREMENT ASMod_tLPTrbnUs "" SWORD Temp_Cels 1 100 -3549.940 3003.560 ECU_ADDRESS 0xD0000544 /end MEASUREMENT
/begin MEASUREMENT ASMod_tLPTrbnUsFlt_mp "" SWORD Temp_Cels 1 100 -3549.940 3003.560 ECU_ADDRESS 0xC0009AAE /end MEASUREMENT
/begin MEASUREMENT ASMod_tLPTrbnUsUnCor "" SWORD Temp_Cels 1 100 -3549.940 3003.560 ECU_ADDRESS 0xD0000546 /end MEASUREMENT
/begin MEASUREMENT ASMod_tLPTrbnUsUnCorRaw_mp "" SWORD Temp_Cels 1 100 -3549.940 3003.560 ECU_ADDRESS 0xC0009AB0 /end MEASUREMENT
/begin MEASUREMENT ASMod_tMidEGPipeSlw_mp "mittlere Temperatur zwischen Gas und Rohrwand" SWORD Temp_Cels 1 100 -3549.940 3003.560 ARRAY_SIZE 4 ECU_ADDRESS 0xC000B8D4 /end MEASUREMENT
/begin MEASUREMENT ASMod_tMidEGPipe_mp "mittlere Temperatur zwischen Gas und Rohrwand" SWORD Temp_Cels 1 100 -3549.940 3003.560 ARRAY_SIZE 3 ECU_ADDRESS 0xC000B7D6 /end MEASUREMENT
/begin MEASUREMENT ASMod_tMidPipeEnvSlw_mp "mittlere Temperatur zwischen Rohrwand und Umgebung" SWORD Temp_Cels 1 100 -3549.940 3003.560 ARRAY_SIZE 4 ECU_ADDRESS 0xC000B8DC /end MEASUREMENT
/begin MEASUREMENT ASMod_tMidPipeEnv_mp "mittlere Temperatur zwischen Rohrwand und Umgebung" SWORD Temp_Cels 1 100 -3549.940 3003.560 ARRAY_SIZE 3 ECU_ADDRESS 0xC000B7DC /end MEASUREMENT
/begin MEASUREMENT ASMod_tOxiCDiff "Temperaturdifferenz am Oxidationskatalysator" SWORD TempDiff_Kelv 1 100 -3276.800 3276.700 ARRAY_SIZE 1 ECU_ADDRESS 0xD000054C /end MEASUREMENT
/begin MEASUREMENT ASMod_tOxiCDs "Temperatur nach Oxidationskatalysator" SWORD Temp_Cels 1 100 -3549.940 3003.560 ARRAY_SIZE 1 ECU_ADDRESS 0xD000054E /end MEASUREMENT
/begin MEASUREMENT ASMod_tOxiCDsUnCor_mp "" SWORD TempDiff_Kelv 1 100 -3276.800 3276.700 ARRAY_SIZE 1 ECU_ADDRESS 0xC000B730 /end MEASUREMENT
/begin MEASUREMENT ASMod_tOxiCExoIncr_mp "Temperaturerhöhung im Oxidationskatalysator durch chemische Reaktion" SWORD TempDiff_Kelv 1 100 -3276.800 3276.700 ECU_ADDRESS 0xC00099DE /end MEASUREMENT
/begin MEASUREMENT ASMod_tOxiCStrt "Initialisierungstemperatur für OxiC-Modell bei Motorstart" SWORD Temp_Cels 1 100 -3549.940 3003.560 ARRAY_SIZE 1 ECU_ADDRESS 0xD0000550 /end MEASUREMENT
/begin MEASUREMENT ASMod_tOxiCSurf "Oberflächentemperatur des OxiCat" SWORD Temp_Cels 1 100 -3549.940 3003.560 ARRAY_SIZE 1 ECU_ADDRESS 0xD0000552 /end MEASUREMENT
/begin MEASUREMENT ASMod_tOxiCSurf_mp "" SWORD Temp_Cels 1 100 -3549.940 3003.560 ECU_ADDRESS 0xC00099E0 /end MEASUREMENT
/begin MEASUREMENT ASMod_tOxiCUs_mp "Temperatur vor Oxidationskatalysator" SWORD Temp_Cels 1 100 -3549.940 3003.560 ECU_ADDRESS 0xC00099E2 /end MEASUREMENT
/begin MEASUREMENT ASMod_tPFltCorUs_mp "gefilterte Temperatur vor Partikelfilter" SWORD Temp_Cels 1 100 -3549.940 3003.560 ECU_ADDRESS 0xC00099F2 /end MEASUREMENT
/begin MEASUREMENT ASMod_tPFltDiffCorr_mp "korrigierte Temperaturdifferenz am Partikelfilter" SWORD TempDiff_Kelv 1 100 -3276.800 3276.700 ECU_ADDRESS 0xC00099F4 /end MEASUREMENT
/begin MEASUREMENT ASMod_tPFltFlt_mp "gefilterte Temperatur am Partikelfilter" SWORD Temp_Cels 1 100 -3549.940 3003.560 ECU_ADDRESS 0xC00099F6 /end MEASUREMENT
/begin MEASUREMENT ASMod_tPFltSimDiff "simulierte Temperaturdifferenz am Partikelfilter" SWORD TempDiff_Kelv 1 100 -3276.800 3276.700 ECU_ADDRESS 0xD0000554 /end MEASUREMENT
/begin MEASUREMENT ASMod_tPFltSimDs "simulierte Temperatur nach Partikelfilter" SWORD Temp_Cels 1 100 -3549.940 3003.560 ECU_ADDRESS 0xD0000556 /end MEASUREMENT
/begin MEASUREMENT ASMod_tPFltSurfSim "simulierte Oberflächentemperatur Partikelfilter" SWORD Temp_Cels 1 100 -3549.940 3003.560 ECU_ADDRESS 0xD0000558 /end MEASUREMENT
/begin MEASUREMENT ASMod_tPFltSurfSim_mp "simulierte Oberflächentemperatur Partikelfilter" SWORD Temp_Cels 1 100 -3549.940 3003.560 ECU_ADDRESS 0xC00099F8 /end MEASUREMENT
/begin MEASUREMENT ASMod_tPFltTotCorUs_mp "additiver Temperaturkorrekturwert vor Partikelfilter" SWORD TempDiff_Kelv 1 100 -3276.800 3276.700 ECU_ADDRESS 0xC00099FA /end MEASUREMENT
/begin MEASUREMENT ASMod_tPFltUs "Abgastemperatur vor Partikelfilter" SWORD Temp_Cels 1 100 -3549.940 3003.560 ECU_ADDRESS 0xD000055A /end MEASUREMENT
/begin MEASUREMENT ASMod_tPFltUs_mp "Abgastemperatur vor Partikelfilter" SWORD Temp_Cels 1 100 -3549.940 3003.560 ECU_ADDRESS 0xC00099FC /end MEASUREMENT
/begin MEASUREMENT ASMod_tPipeStrt "Initialisierungstemperatur für Pipe-Modell bei Motorstart" SWORD Temp_Cels 1 100 -3549.940 3003.560 ARRAY_SIZE 7 ECU_ADDRESS 0xD000055C /end MEASUREMENT
/begin MEASUREMENT ASMod_tPipeStrt_mp "Initialisierungstemperatur für Pipe-Modell bei Motorstart" SWORD Temp_Cels 1 100 -3549.940 3003.560 ARRAY_SIZE 7 ECU_ADDRESS 0xC000B90C /end MEASUREMENT
/begin MEASUREMENT ASMod_tShOffExsClnt_mp "Motorübertemperatur bei letztem Motorstop" SWORD TempDiff_Kelv 1 100 -3276.800 3276.700 ECU_ADDRESS 0xC0009A10 /end MEASUREMENT
/begin MEASUREMENT ASMod_tShOffOxiC_mp "Abgastemperatur nach OxiC bei letztem Motorstop" SWORD Temp_Cels 1 100 -3549.940 3003.560 ARRAY_SIZE 1 ECU_ADDRESS 0xC000B91A /end MEASUREMENT
/begin MEASUREMENT ASMod_tShOffPipe_mp "Rohrwandtemperatur bei letztem Motorstop" SWORD Temp_Cels 1 100 -3549.940 3003.560 ARRAY_SIZE 7 ECU_ADDRESS 0xC000B91C /end MEASUREMENT
/begin MEASUREMENT ASMod_tTrbnAdbtUsRaw_mp "" SWORD Temp_Cels 1 100 -3549.940 3003.560 ECU_ADDRESS 0xC0009A3A /end MEASUREMENT
/begin MEASUREMENT ASMod_tTrbnAdbtUsUnCor_mp "" SWORD Temp_Cels 1 100 -3549.940 3003.560 ECU_ADDRESS 0xC0009A3C /end MEASUREMENT
/begin MEASUREMENT ASMod_tTrbnAdbtUs_mp "" SWORD Temp_Cels 1 100 -3549.940 3003.560 ECU_ADDRESS 0xC0009A3E /end MEASUREMENT
/begin MEASUREMENT ASMod_tTrbnCor_mp "" SWORD Temp_Cels 1 100 -3549.940 3003.560 ECU_ADDRESS 0xC0009A40 /end MEASUREMENT
/begin MEASUREMENT ASMod_tTrbnDiffRaw_mp "Rohe Differentialturbinentemperatur" SWORD Temp_Cels 1 100 -3549.940 3003.560 ECU_ADDRESS 0xC0009A42 /end MEASUREMENT
/begin MEASUREMENT ASMod_tTrbnDs "Abgastemperatur nach Turbine" SWORD Temp_Cels 1 100 -3549.940 3003.560 ECU_ADDRESS 0xD000056A /end MEASUREMENT
/begin MEASUREMENT ASMod_tTrbnDsRaw "Rohwert Abgastemperatur nach Turbolader" SWORD Temp_Cels 1 100 -3549.940 3003.560 ECU_ADDRESS 0xD000056C /end MEASUREMENT
/begin MEASUREMENT ASMod_tTrbnDynCor_mp "" SWORD Temp_Cels 1 100 -3549.940 3003.560 ECU_ADDRESS 0xC0009A44 /end MEASUREMENT
/begin MEASUREMENT ASMod_tTrbnEnvCor_mp "" SWORD Temp_Kelv 1 100 -3276.800 3276.700 FORMAT "%8.3" ECU_ADDRESS 0xC0009A46 /end MEASUREMENT
/begin MEASUREMENT ASMod_tTrbnPT1_mp "Test Messpunkt nach PT1-Filter" SWORD TempDiff_Kelv 1 100 -3276.800 3276.700 ECU_ADDRESS 0xC0009A48 /end MEASUREMENT
/begin MEASUREMENT ASMod_tTrbnTempCor_mp "" SWORD Temp_Cels 1 100 -3549.940 3003.560 ECU_ADDRESS 0xC0009A4A /end MEASUREMENT
/begin MEASUREMENT ASMod_tTrbnUs "Temperatur vor Turbine" SWORD Temp_Cels 1 100 -3549.940 3003.560 ECU_ADDRESS 0xD000056E /end MEASUREMENT
/begin MEASUREMENT ASMod_tTrbnUsFlt_mp "" SWORD Temp_Cels 1 100 -3549.940 3003.560 ECU_ADDRESS 0xC0009A4C /end MEASUREMENT
/begin MEASUREMENT ASMod_tTrbnUsRaw_mp "Rohtemperatur vor Turbine" SWORD Temp_Cels 1 100 -3549.940 3003.560 ECU_ADDRESS 0xC0009A4E /end MEASUREMENT
/begin MEASUREMENT ASMod_tTrbn_mp "Test Messpunkt vor PT1-Filter" SWORD TempDiff_Kelv 1 100 -3276.800 3276.700 ECU_ADDRESS 0xC0009A50 /end MEASUREMENT
/begin MEASUREMENT ASMod_tWallPipeSlw_mp "Rohrwandtemperatur" SWORD Temp_Cels 1 100 -3549.940 3003.560 ARRAY_SIZE 4 ECU_ADDRESS 0xC000B8E4 /end MEASUREMENT
/begin MEASUREMENT ASMod_tWallPipe_mp "Rohrwandtemperatur" SWORD Temp_Cels 1 100 -3549.940 3003.560 ARRAY_SIZE 3 ECU_ADDRESS 0xC000B7E2 /end MEASUREMENT
/begin MEASUREMENT ASMod_volEng "Hubvolumen des Motors" SWORD Vol 1 100 -327.6800 327.6700 FORMAT "%8.4" ECU_ADDRESS 0xD000057E /end MEASUREMENT
/begin MEASUREMENT ASMod_vscDynPipeSlw_mp "dynamische Viskosität des Gases im Rohr" SWORD Fact 1 100 -4.000000 3.999878 ARRAY_SIZE 4 ECU_ADDRESS 0xC000B8EC /end MEASUREMENT
/begin MEASUREMENT ASMod_vscDynPipe_mp "dynamische Viskosität des Gases im Rohr" SWORD Fact 1 100 -4.000000 3.999878 ARRAY_SIZE 3 ECU_ADDRESS 0xC000B7E8 /end MEASUREMENT
/begin MEASUREMENT ASMod_vscKinPipeSlw_mp "kinematische Viskosität des Gases im Rohr" SWORD Fact8 1 100 -0.0003276800 0.0003276700 FORMAT "%12.10" ARRAY_SIZE 4 ECU_ADDRESS 0xC000B8F4 /end MEASUREMENT
/begin MEASUREMENT ASMod_vscKinPipe_mp "kinematische Viskosität des Gases im Rohr" SWORD Fact8 1 100 -0.0003276800 0.0003276700 FORMAT "%12.10" ARRAY_SIZE 3 ECU_ADDRESS 0xC000B7EE /end MEASUREMENT
/begin MEASUREMENT ATS_IntvVal_mp "Eingriffswert" SWORD OneToOne 1 100 -32768.00 32767.00 ECU_ADDRESS 0xC0009AC0 /end MEASUREMENT
/begin MEASUREMENT ATS_stMonTimeLimit "Verhalten Zeitlimit bei neuen Testeranforderungen" UBYTE OneToOne 1 100 0.00 255.0 ECU_ADDRESS 0xD0001BF1 /end MEASUREMENT
/begin MEASUREMENT ATS_TstStatus_mp "Status des Stellereingriffes" UBYTE OneToOne 1 100 0.00 255.0 ECU_ADDRESS 0xC000B0AD /end MEASUREMENT
/begin MEASUREMENT BattuEcu_i "" UWORD AmpIbsLin 1 100 -200.0000 1110.700 FORMAT "%8.3" ECU_ADDRESS 0xD00014DC /end MEASUREMENT
/begin MEASUREMENT BattuEcu_qCharge "" UWORD ChargeIbsLin 1 100 0.00 1192.750 FORMAT "%8.3" ECU_ADDRESS 0xD00014DE /end MEASUREMENT
/begin MEASUREMENT BattuEcu_qDischarge "" UWORD ChargeIbsLin 1 100 0.00 1192.750 FORMAT "%8.3" ECU_ADDRESS 0xD00014E0 /end MEASUREMENT
/begin MEASUREMENT BattuEcu_stChg "" UBYTE OneToOne 1 100 0.00 255.0 ECU_ADDRESS 0xD0001C17 /end MEASUREMENT
/begin MEASUREMENT BattuEcu_stIbs "" UBYTE OneToOne 1 100 0.00 255.0 ARRAY_SIZE 3 ECU_ADDRESS 0xD0001C18 /end MEASUREMENT
/begin MEASUREMENT BattuEcu_stInfoDiag "" UBYTE OneToOne 1 100 0.00 255.0 ARRAY_SIZE 4 ECU_ADDRESS 0xD0001C1B /end MEASUREMENT
/begin MEASUREMENT BattuEcu_t "" UBYTE TempIbsLin 1 100 -48.00 143.3 FORMAT "%5.1" ECU_ADDRESS 0xD0001C1F /end MEASUREMENT
/begin MEASUREMENT BattuEcu_u "" UWORD VoltIbsLin 1 100 0.00 65.53500 FORMAT "%8.5" ECU_ADDRESS 0xD00014E2 /end MEASUREMENT
/begin MEASUREMENT BattU_facCor "Batteriekorrekturfaktor" SWORD Fact 1 100 -4.000000 3.999878 ECU_ADDRESS 0xD0000666 /end MEASUREMENT
/begin MEASUREMENT BattU_u "Batteriespannung" SWORD Volt_Batt 1 100 -655360.0 655340.0 ECU_ADDRESS 0xD0000668 /end MEASUREMENT
/begin MEASUREMENT BattU_uRated "Batteriespannung" SWORD Volt_Batt 1 100 -655360.0 655340.0 ECU_ADDRESS 0xD000066A /end MEASUREMENT
/begin MEASUREMENT BattU_uRaw "Rohsignal des Batteriespannungssensors" SWORD Volt 1 100 -6553.600 6553.400 ECU_ADDRESS 0xD000066C /end MEASUREMENT
/begin MEASUREMENT BattU_uSens "Erfasste Batteriespannung" SWORD Volt_Batt 1 100 -655360.0 655340.0 ECU_ADDRESS 0xD000066E /end MEASUREMENT
/begin MEASUREMENT ESS_uBatt "Batteriespannung" SWORD Volt_Batt 1 100 -655360.0 655340.0 ECU_ADDRESS 0xD0000936 /end MEASUREMENT
/begin FUNCTION ASMod_IndVol ""
 /begin DEF_CHARACTERISTIC ASMod_AirThr.rPresCrit_C ASMod_AirThr.facFlwCrit_C ASMod_AirThr.rPresLin_C ASMod_AirThr.facSlpLin_C ASMod_arEffTVA_CUR ASMod_mIndVolMin_C ASMod_mO2IndVolMin_C ASMod_MsFlwIndVolPT1.tiUp_C ASMod_MsFlwIndVolPT1.tiDwn_C ASMod_swtPInit_C ASMod_volIndVol_C /end DEF_CHARACTERISTIC
 /begin REF_CHARACTERISTIC ASMod_numBnk_C ASMod_pInit_C ASMod_tInit_C /end REF_CHARACTERISTIC
 /begin IN_MEASUREMENT ASMod_dmAFSCor ASMod_dmCmprUs_r32 ASMod_pIntMnf_r32 ASMod_rO2CmprUs_r32 ASMod_rRelPosTVA ASMod_stInit ASMod_tCACDs ASMod_tIntMnfDs_r32 EnvP_p Epm_nEng Epm_numCyl /end IN_MEASUREMENT
 /begin OUT_MEASUREMENT ASMod_dmIndVol_r32 ASMod_dmIntMnfUs ASMod_dmIntMnfUs_r32 ASMod_mAirPerCylCor ASMod_mIndVolInit_r32 ASMod_mIndVol_r32 ASMod_pIndVol ASMod_pIndVol_r32 ASMod_rO2IntMnfUs_r32 ASMod_stInitIndVol /end OUT_MEASUREMENT
 /begin LOC_MEASUREMENT ASMod_arEffTVA_mp ASMod_dmAirEffIntMnfUs_mp ASMod_dmIndVol_mp ASMod_dmIntMnfUsRaw_mp ASMod_dmO2IndVol_mp ASMod_mIndVol_mp ASMod_mO2IndVol_mp ASMod_rRelPosTVA_mp ASMod_stNaNIndVol_mp /end LOC_MEASUREMENT
/end FUNCTION
/begin FUNCTION ASMod_IntMnfLP "" /begin DEF_CHARACTERISTIC ASMod_facPresLsCmprUs_C /end DEF_CHARACTERISTIC /begin REF_CHARACTERISTIC ASMod_numExhMnfLPUs_C ASMod_pInit_C /end REF_CHARACTERISTIC
 /begin IN_MEASUREMENT ASMod_dmAFSCor ASMod_dmEGRLPDs_r32 ASMod_rO2EGFld ASMod_tEGRLPDs_r32 EnvP_p EnvT_t /end IN_MEASUREMENT
 /begin OUT_MEASUREMENT ASMod_dmCmprUs_r32 ASMod_pCmprUs_r32 ASMod_rO2CmprUs_r32 ASMod_tCmprUs_r32 /end OUT_MEASUREMENT
 /begin LOC_MEASUREMENT ASMod_rO2ExhMnfLPUs_mp ASMod_stFlwDirEGRLP_mp /end LOC_MEASUREMENT
/end FUNCTION
/begin FUNCTION ASMod_LamSens "" /begin DEF_CHARACTERISTIC ASMod_tiLamSensDdt_CUR ASMod_tiLamSensPT1_CUR /end DEF_CHARACTERISTIC
 /begin IN_MEASUREMENT AFS_mAirPerCyl ASMod_dmExhMnfDs ASMod_rLamRecExhMnfDs InjCtl_qSetUnBal /end IN_MEASUREMENT
 /begin OUT_MEASUREMENT ASMod_rLamRecEGSensSim /end OUT_MEASUREMENT
 /begin LOC_MEASUREMENT ASMod_tiLamSensDdt_mp ASMod_tiLamSensPT1_mp /end LOC_MEASUREMENT
/end FUNCTION
/begin FUNCTION ASMod_Lib "" /end FUNCTION
/begin FUNCTION ASMod_PresPipe ""
 /begin DEF_CHARACTERISTIC ASMod_facGeoEGPipe_CA ASMod_facPowEGPipeCorr_CUR ASMod_facPowEGPipe_CUR ASMod_facRhoEtaEGPipe_MAP ASMod_facSilFlpClsd_C ASMod_numPipeSilFlp_C ASMod_pDiffPipe0_MAP ASMod_pDiffPipe1_MAP ASMod_pDiffPipe2_MAP ASMod_pDiffPipe3_MAP ASMod_swtPresCalc_C /end DEF_CHARACTERISTIC
 /begin IN_MEASUREMENT ASMod_dmEGFld ASMod_pEGFld ASMod_tEGFld EnvP_p Epm_nEng InjCtl_qSetUnBal SilFlp_st /end IN_MEASUREMENT
 /begin LOC_MEASUREMENT ASMod_dpExhGsMap_mp ASMod_dpExhGsSim_mp ASMod_dVolEGPipe1_mp ASMod_dVolEGPipe_mp ASMod_facPowEGPipe_mp ASMod_facRhoEtaEGPipe_mp ASMod_pDiffEGPipe_mp ASMod_pEGPresPipe_mp ASMod_qPresPipe_mp ASMod_tEGPresPipe_mp /end LOC_MEASUREMENT
/end FUNCTION
/begin FUNCTION ASMod_TempOxiC ""
 /begin DEF_CHARACTERISTIC ASMod_arOxiC_CA ASMod_cpOxiC_CA ASMod_dmHCEmiCor_MAP ASMod_dwEnvOxiCDfl_CA ASMod_facBrickOxiC_CA ASMod_facCalValFl_C ASMod_facHCCnvOxiC1_MAP ASMod_facHCLdOxiCLoad_CUR ASMod_facHCLdOxiCTemp_CUR ASMod_facLeanNOxOxiC1_MAP ASMod_htcOxiC1_MAP ASMod_mHCLdOxiCMax_C ASMod_mHCLdOxiCMin_C ASMod_numEngTempNOxCor_CA ASMod_numOxiCUsPT1EOM_CA ASMod_rHCRgnOxiC_CUR ASMod_stMskOxiCExoIncr_C ASMod_stMskOxiCPT1_C ASMod_swtFacHCCnvOxiCIn_CA ASMod_swtFlMsFlwOxiC_CA ASMod_swtNOxSensOxiCUsEna_CA ASMod_swtOxiCTempSel_C ASMod_TempOxiCI.Ki_C ASMod_TempOxiCI.KiPos_C ASMod_TempOxiCI.KiNeg_C ASMod_TempOxiCI.WinPos_C ASMod_TempOxiCI.WinNeg_C ASMod_tiOxiCPT1EOM_CUR ASMod_tiOxiCPT1Nrm_C ASMod_tOxiCDfl_CA ASMod_tOxiCExoIncr_MAP /end DEF_CHARACTERISTIC
 /begin REF_CHARACTERISTIC ASMod_facNOxSensUnCnv_C /end REF_CHARACTERISTIC
 /begin IN_MEASUREMENT ASMod_dmEGFld ASMod_pEGFld ASMod_qInjNoCmb ASMod_rFlEG ASMod_rNOxEGFld ASMod_rO2EGFld ASMod_tEGFld ASMod_tOxiCStrt CoEng_st CoEng_stOld CoEOM_stOpModeAct EngDa_tFld EnvT_t Epm_nEng Epm_numCyl ETCtl_dmHC Exh_rNOxNSCDs Exh_stNOxNSCDs Exh_tAdapTOxiCatUs HCUn_dqDem InjCtl_qSetUnBal SCRFFC_rMolMs VehV_v /end IN_MEASUREMENT
 /begin OUT_MEASUREMENT ASMod_dmFlCmbOxiCatFld ASMod_dmO2OxiCDiff ASMod_dwEnvOxiC ASMod_tOxiCDiff ASMod_tOxiCDs ASMod_tOxiCSurf /end OUT_MEASUREMENT
 /begin LOC_MEASUREMENT ASMod_dmEGFlCmbOxiC_mp ASMod_dmFlCmbOxiCAct_mp ASMod_dmFlCmbOxiC_mp ASMod_dmHCEmiCor_mp ASMod_dmHCEmi_mp ASMod_dmHCLdOxiC ASMod_dmHCLdOxiCAct ASMod_dmHCRgnOxiC ASMod_dmLastHCLdOxiCAct_mp ASMod_dmO2OxiCDs_mp ASMod_dmO2OxiC_mp ASMod_dmOxiCMapIn_mp ASMod_dmOxiCPT1EOM_mp ASMod_dtOxiCSurf_mp ASMod_dtOxiC_mp ASMod_dwEnvOxiCOut_mp ASMod_dwEnvOxiCSurf_mp ASMod_dwGsOxiCSurf_mp ASMod_dwGsOxiC_mp ASMod_dwHCCnvOxiC_mp ASMod_dwOxiCSurf_mp ASMod_dwOxiC_mp ASMod_facHCCnvOxiC_mp ASMod_facHCLdOxiCLoad_mp ASMod_facHCLdOxiCTemp_mp ASMod_htcOxiC_mp ASMod_mHCLdOciCActOld_mp ASMod_mHCLdOxiCAct ASMod_mLastHCLdOxiCAct_mp ASMod_rHCRgnOxiC_mp ASMod_rNOxSensOxiCUs_mp ASMod_tHCCnvOxiCCrvIn_mp ASMod_tiOxiCPT1EOM_mp ASMod_tLeanNOxOxiCMapIn1_mp ASMod_tLeanNOxOxiCMapIn2_mp ASMod_tOxiCDsUnCor_mp ASMod_tOxiCExoIncr_mp ASMod_tOxiCSurf_mp ASMod_tOxiCUs_mp /end LOC_MEASUREMENT
/end FUNCTION
/begin FUNCTION ASMod_TempPFlt ""
 /begin DEF_CHARACTERISTIC ASMod_cpPFlt_C ASMod_facHtTransNoLin_CUR ASMod_facLeanNOxPFlt_MAP ASMod_facNOxSensUnCnv_C ASMod_facPFltBlwBy_C ASMod_numEngTempNOxCorPFlt_C ASMod_swtNOxSensPFltUsEna_C ASMod_swtPFltTempModOff_C ASMod_swtPresMidPFlt_C ASMod_TempPFltDT1.T1_C ASMod_TempPFltDT1.Kd_C ASMod_TempPFltI.Ki_C ASMod_TempPFltI.KiPos_C ASMod_TempPFltI.KiNeg_C ASMod_TempPFltI.WinPos_C ASMod_TempPFltI.WinNeg_C ASMod_tiExhGsDelPFlt_CUR ASMod_tiHtTransDT1_CUR ASMod_tiPFltPT1_C ASMod_tiPT1DmPFltUs_C /end DEF_CHARACTERISTIC
 /begin IN_MEASUREMENT ASMod_dmEGFld ASMod_pEGFld ASMod_rNOxEGFld ASMod_rO2EGFld ASMod_tEGFld CoEng_st EngDa_tFld Exh_pAdapPPFltDiff Exh_pPFltUs Exh_rNOxNSCDs Exh_stNOxNSCDs Exh_tAdapTPFltUs SCRFFC_rMolMs /end IN_MEASUREMENT
 /begin OUT_MEASUREMENT ASMod_dmPFltUs ASMod_dvolPFltEG ASMod_pMidPFlt ASMod_pPFltSimDs ASMod_pPFltUs ASMod_tPFltSimDiff ASMod_tPFltSimDs ASMod_tPFltSurfSim ASMod_tPFltUs /end OUT_MEASUREMENT
 /begin LOC_MEASUREMENT ASMod_dmPFltUsCrvIn_mp ASMod_rNOxSensPFltUs_mp ASMod_stNOxSensPFltUs_mp ASMod_tFld1_mp ASMod_tHtTransCor_mp ASMod_tiExhGsDelPFlt_mp ASMod_tiHtTransDT1_mp ASMod_tPFltCorUs_mp ASMod_tPFltDiffCorr_mp ASMod_tPFltFlt_mp ASMod_tPFltSurfSim_mp ASMod_tPFltTotCorUs_mp ASMod_tPFltUs_mp /end LOC_MEASUREMENT
/end FUNCTION
/begin FUNCTION ASMod_TempPipe ""
 /begin DEF_CHARACTERISTIC ASMod_cndHtOfs_C ASMod_cpPipe_CA ASMod_facCndHtSlp_C ASMod_facVscDynSlp_C ASMod_facVscKinSlp_C ASMod_htcFreeCnvtPipe_CA ASMod_lDiamPipe_CA ASMod_lLngthPipe_CA ASMod_nuPipeEnv_CUR ASMod_nuPipe_CUR ASMod_rArPipe_CA ASMod_TempPipeI.Ki_C ASMod_TempPipeI.KiPos_C ASMod_TempPipeI.KiNeg_C ASMod_TempPipeI.WinPos_C ASMod_TempPipeI.WinNeg_C ASMod_tPipeDfl_C ASMod_tWallPipeDfl_C ASMod_vscDynOfs_C ASMod_vscKinOfs_C /end DEF_CHARACTERISTIC
 /begin REF_CHARACTERISTIC ASMod_cpGs_C ASMod_numTrbn_C /end REF_CHARACTERISTIC
 /begin IN_MEASUREMENT ASMod_dmEGFld ASMod_tEGFld ASMod_tPipeStrt ASMod_tWallFld CoEng_st EnvT_t VehV_v /end IN_MEASUREMENT
 /begin OUT_MEASUREMENT ASMod_htcArEGTrbn ASMod_htcArTrbnEnv /end OUT_MEASUREMENT
 /begin LOC_MEASUREMENT ASMod_arPipe_mp ASMod_cndHtAir_mp ASMod_cndHtEG_mp ASMod_dtPipe_mp ASMod_dwEGPipe_mp ASMod_dwPipeEnv_mp ASMod_dwPipeIn_mp ASMod_dwPipeOut_mp ASMod_dwPipe_mp ASMod_htcArEGPipe_mp ASMod_htcArPipeEnv_mp ASMod_htcEGPipe_mp ASMod_htcPipeEnv_mp ASMod_nuPipeEnv_mp ASMod_nuPipe_mp ASMod_rePipe1_mp ASMod_rePipeEnv1_mp ASMod_rePipeEnv_mp ASMod_rePipe_mp ASMod_tDiffEGPipe_mp ASMod_tDiffPipeEnv_mp ASMod_tEGPipeDs_mp ASMod_tMidEGPipe_mp ASMod_tMidPipeEnv_mp ASMod_tWallPipe_mp ASMod_vscDynPipe_mp ASMod_vscKinPipe_mp /end LOC_MEASUREMENT
/end FUNCTION
/begin FUNCTION ASMod_TempPipeSlw ""
 /begin DEF_CHARACTERISTIC ASMod_cndHtOfsSlw_C ASMod_cpPipeSlw_CA ASMod_facCndHtSlpSlw_C ASMod_facVscDynSlpSlw_C ASMod_facVscKinSlpSlw_C ASMod_htcFreeCnvtPipeSlw_CA ASMod_lDiamPipeSlw_CA ASMod_lLngthPipeSlw_CA ASMod_nuPipeEnvSlw_CUR ASMod_nuPipeSlw_CUR ASMod_rArPipeSlw_CA ASMod_swtGetOxiCatSens_C ASMod_TempPipeSlwI.Ki_C ASMod_TempPipeSlwI.KiPos_C ASMod_TempPipeSlwI.KiNeg_C ASMod_TempPipeSlwI.WinPos_C ASMod_TempPipeSlwI.WinNeg_C ASMod_tPipeDflSlw_C ASMod_tWallPipeDflSlw_C ASMod_vscDynOfsSlw_C ASMod_vscKinOfsSlw_C /end DEF_CHARACTERISTIC
 /begin IN_MEASUREMENT ASMod_dmEGFld ASMod_tEGFld ASMod_tPipeStrt ASMod_tWallFld CoEng_st EnvT_t Exh_tAdapTOxiCatUs VehV_v /end IN_MEASUREMENT
 /begin LOC_MEASUREMENT ASMod_arPipeSlw_mp ASMod_cndHtAirSlw_mp ASMod_cndHtEGSlw_mp ASMod_dtPipeSlw_mp ASMod_dwEGPipeSlw_mp ASMod_dwPipeEnvSlw_mp ASMod_dwPipeInSlw_mp ASMod_dwPipeOutSlw_mp ASMod_dwPipeSlw_mp ASMod_htcArEGPipeSlw_mp ASMod_htcArPipeEnvSlw_mp ASMod_htcEGPipeSlw_mp ASMod_htcPipeEnvSlw_mp ASMod_nuPipeEnvSlw_mp ASMod_nuPipeSlw_mp ASMod_rePipeEnvSlw1_mp ASMod_rePipeEnvSlw_mp ASMod_rePipeSlw1_mp ASMod_rePipeSlw_mp ASMod_tDiffEGPipeSlw_mp ASMod_tDiffPipeEnvSlw_mp ASMod_tEGPipeSlwDs_mp ASMod_tMidEGPipeSlw_mp ASMod_tMidPipeEnvSlw_mp ASMod_tWallPipeSlw_mp ASMod_vscDynPipeSlw_mp ASMod_vscKinPipeSlw_mp /end LOC_MEASUREMENT
/end FUNCTION
/begin FUNCTION ASMod_TempStrtCalc ""
 /begin DEF_CHARACTERISTIC ASMod_facTempClg_CUR ASMod_facTimeClg_CUR ASMod_numAirTempStrt_C ASMod_numEngTempStrt_C ASMod_swtGetShOffTime_C ASMod_tiClgOfs_C ASMod_tiHaValClnt_C ASMod_tiHaValOxiC_CA ASMod_tiHaValPipe_CA ASMod_tStrtDfl_C /end DEF_CHARACTERISTIC
 /begin REF_CHARACTERISTIC ASMod_tInit_C /end REF_CHARACTERISTIC
 /begin IN_MEASUREMENT AirSys_tFld ASMod_stInit ASMod_tOxiCDs ASMod_tWallFld CoEng_st EngDa_tFld Layer_tiEngShOff /end IN_MEASUREMENT
 /begin OUT_MEASUREMENT ASMod_tiClg ASMod_tOxiCStrt ASMod_tPipeStrt /end OUT_MEASUREMENT
 /begin LOC_MEASUREMENT ASMod_rTempClgCrvIn_mp ASMod_rTempClnt_mp ASMod_rTimeOxiC_mp ASMod_rTimePipe_mp ASMod_tAirStrt_mp ASMod_tEngStrt_mp ASMod_tExsClnt_mp ASMod_tiClgRef_mp ASMod_tPipeStrt_mp ASMod_tShOffExsClnt_mp ASMod_tShOffOxiC_mp ASMod_tShOffPipe_mp /end LOC_MEASUREMENT
/end FUNCTION
/begin FUNCTION ASMod_TempTrbCh ""
 /begin DEF_CHARACTERISTIC ASMod_aTrbChMin_C ASMod_dtOxiCatUsMin_C ASMod_etaTrbCh_MAP ASMod_etaTrbn_MAP ASMod_facArTrbnCor_C ASMod_nTrbChDT1.T1_C ASMod_nTrbChDT1.Kd_C ASMod_numAirTempTrbn_C ASMod_pTrbnUsRef_C ASMod_rLinTrbChPos_CUR ASMod_rPresTrbnRec_MAP ASMod_rTempAdbt_CUR ASMod_swtTrbChRateSlct_C ASMod_swtTrbnDynCorr_C ASMod_swtTrbnTempUs_C ASMod_swtTTrbnEnv_C ASMod_swtTTrbnUs_C ASMod_tiTrbChPosPT1_C ASMod_tiTrbnAdbtUsPT1_C ASMod_tiTrbnDynPT1_C ASMod_tiTrbnPresUsPT1_C ASMod_tiTrbnPT1_C ASMod_tiTrbnTempPT1_C ASMod_tiTrbnTempUsPT1_C ASMod_tOxiCatUsDT1.T1_C ASMod_tOxiCatUsDT1.Kd_C ASMod_tTrbnDsRawDfl_C ASMod_tTrbnDynCorr_MAP ASMod_tTrbnTempCor_MAP ASMod_tTrbnUsRef_C /end DEF_CHARACTERISTIC
 /begin REF_CHARACTERISTIC ASMod_cpGs_C /end REF_CHARACTERISTIC
 /begin IN_MEASUREMENT AirSys_tFld Air_pIntkVUs ASMod_dmAFSCor ASMod_dmEGFld ASMod_dmExhMnfDs ASMod_htcArEGTrbn ASMod_htcArTrbnEnv ASMod_nTrbCh ASMod_pHPDiffEngGsFlw ASMod_pHPTrbnUs ASMod_pIndVol ASMod_pIntMnf_r32 ASMod_pPFltUs ASMod_rNOxEG ASMod_rNOxEGFld ASMod_rO2EGFld ASMod_rO2ExhMnfDs ASMod_stInit ASMod_tCmprEnv ASMod_tEGFld ASMod_tExhMnfDs ASMod_tHPTrbnUs CoEng_st EnvP_p EnvT_t Exh_tOxiCatUs TrbCh_r TrbCh_rSens /end IN_MEASUREMENT
 /begin OUT_MEASUREMENT ASMod_pDiffEngGsFlw ASMod_pTrbnUs ASMod_rPresEGRDiff ASMod_tTrbnDs ASMod_tTrbnDsRaw ASMod_tTrbnUs /end OUT_MEASUREMENT
 /begin LOC_MEASUREMENT ASMod_aTrbChPos_mp ASMod_aTrbCh_mp ASMod_dmTrbnUsRed_mp ASMod_dtOxiCatUsLim_mp ASMod_dtOxiCatUs_mp ASMod_dwEGTrbn_mp ASMod_etaTrbCh_mp ASMod_etaTrbn_mp ASMod_facTempAdptTrbn_mp ASMod_facTrbnPT1_mp ASMod_htcArTrbn_mp ASMod_pCACDs_mp ASMod_pwrCmpr_mp ASMod_rLinTrbChFlt_mp ASMod_rPresCmpr_mp ASMod_rPresTrbnRec_mp ASMod_rPresTrbn_mp ASMod_rTempAdbt_mp ASMod_rTempAdptTrbn_mp ASMod_tAirTrbn_mp ASMod_tDiffEGTrbn_mp ASMod_tTrbnAdbtUsRaw_mp ASMod_tTrbnAdbtUsUnCor_mp ASMod_tTrbnAdbtUs_mp ASMod_tTrbnCor_mp ASMod_tTrbnDiffRaw_mp ASMod_tTrbnDynCor_mp ASMod_tTrbnEnvCor_mp ASMod_tTrbnPT1_mp ASMod_tTrbnTempCor_mp ASMod_tTrbnUsFlt_mp ASMod_tTrbnUsRaw_mp ASMod_tTrbn_mp /end LOC_MEASUREMENT
/end FUNCTION
/begin FUNCTION ASMod_TwinCmpr ""
 /begin DEF_CHARACTERISTIC ASMod_arEffHPCmprBypVlv_C ASMod_cpAirHPCmpr_C ASMod_cpAirLPCmpr_C ASMod_cpHPCmpr_C ASMod_cpLPCmpr_C ASMod_etaHPCmpr_MAP ASMod_etaLPCmpr_MAP ASMod_facBrickHPCmpr_C ASMod_facBrickLPCmpr_C ASMod_facHPCmprPwrMax_C ASMod_facHPCmprPwrMin_C ASMod_facLPCmprPwrMax_C ASMod_facLPCmprPwrMin_C ASMod_HPCmprBypVlv.rPresCrit_C ASMod_HPCmprBypVlv.facFlwCrit_C ASMod_HPCmprBypVlv.rPresLin_C ASMod_HPCmprBypVlv.facSlpLin_C ASMod_htcHPCmprEnv_C ASMod_htcLPCmprEnv_C ASMod_nHPTrbChRed_MAP ASMod_nLPTrbChRed_MAP ASMod_rPresHPCmprRaw_CUR ASMod_rPresHPCmpr_CUR ASMod_rPresLPCmprRaw_CUR ASMod_rPresLPCmpr_CUR ASMod_tCmprInit_C ASMod_TempCmprHPI.Ki_C ASMod_TempCmprHPI.KiPos_C ASMod_TempCmprHPI.KiNeg_C ASMod_TempCmprHPI.WinPos_C ASMod_TempCmprHPI.WinNeg_C ASMod_TempCmprLPI.Ki_C ASMod_TempCmprLPI.KiPos_C ASMod_TempCmprLPI.KiNeg_C ASMod_TempCmprLPI.WinPos_C ASMod_TempCmprLPI.WinNeg_C ASMod_tiHPCmprBypVlvPT1_C /end DEF_CHARACTERISTIC
 /begin REF_CHARACTERISTIC ASMod_pCmprUsRef_C ASMod_tCmprUsRef_C /end REF_CHARACTERISTIC
 /begin IN_MEASUREMENT ASMod_dmCmprUs_r32 ASMod_pCmprUs_r32 ASMod_pIndVol_r32 ASMod_pwrHPTrbn ASMod_pwrLPTrbn ASMod_stInit ASMod_tCmprEnv ASMod_tCmprUs_r32 CByVlv_st CoEng_st /end IN_MEASUREMENT
 /begin OUT_MEASUREMENT ASMod_dmHPCmprUs_r32 ASMod_etaHPCmpr ASMod_etaHPCmpr_r32 ASMod_etaLPCmpr ASMod_etaLPCmpr_r32 ASMod_nHPTrbCh_r32 ASMod_nLPTrbCh_r32 ASMod_pHPCmprUs_r32 ASMod_tHPCmprBypVlvDs ASMod_tHPCmprDs ASMod_tHPCmprSurf ASMod_tLPCmprDs ASMod_tLPCmprSurf /end OUT_MEASUREMENT
 /begin LOC_MEASUREMENT ASMod_arEffHPCmprBypVlv_mp ASMod_dmHPCmprBypVlv_mp ASMod_dmHPCmprUsRed_mp ASMod_dmLPCmprUsRed_mp ASMod_dtHPCmprSurf_mp ASMod_dtHPCmpr_mp ASMod_dtLPCmprSurf_mp ASMod_dtLPCmpr_mp ASMod_dwAirHPCmpr_mp ASMod_dwAirLPCmpr_mp ASMod_dwGsHPCmprSurf_mp ASMod_dwGsLPCmprSurf_mp ASMod_dwHPCmprSurf_mp ASMod_dwHPCmpr_mp ASMod_dwLPCmprSurf_mp ASMod_dwLPCmpr_mp ASMod_facHPCmprPwr_mp ASMod_facLPCmprPwr_mp ASMod_facTwinCmprPwrRaw_mp ASMod_nHPTrbChRed_mp ASMod_nLPTrbChRed_mp ASMod_pwrHPCmprRaw_mp ASMod_pwrHPCmpr_mp ASMod_pwrLPCmprRaw_mp ASMod_pwrLPCmpr_mp ASMod_rPresHPCmprRaw_mp ASMod_rPresHPCmpr_mp ASMod_rPresLPCmprRaw_mp ASMod_rPresLPCmpr_mp ASMod_rTempAdbtHPCmpr_mp ASMod_rTempAdbtLPCmpr_mp ASMod_tHPCmprAdbtDs_mp ASMod_tLPCmprAdbtDs_mp /end LOC_MEASUREMENT
/end FUNCTION
/begin FUNCTION ASMod_TwinTrbn ""
 /begin DEF_CHARACTERISTIC ASMod_aHPTrbnMin_C ASMod_aLPTrbnMin_C ASMod_arEffHPTrbnCtlFlp_CUR ASMod_arEffLPTrbnBlwBy_CUR ASMod_dtHPTrbnDsMin_C ASMod_dtLPTrbnDsMin_C ASMod_etaHPTrbn_CUR ASMod_etaLPTrbn_CUR ASMod_facArHPTrbnCor_C ASMod_facArLPTrbnCor_C ASMod_HPTrbnCtlFlp.rPresCrit_C ASMod_HPTrbnCtlFlp.facFlwCrit_C ASMod_HPTrbnCtlFlp.rPresLin_C ASMod_HPTrbnCtlFlp.facSlpLin_C ASMod_LPTrbnBlwBy.rPresCrit_C ASMod_LPTrbnBlwBy.facFlwCrit_C ASMod_LPTrbnBlwBy.rPresLin_C ASMod_LPTrbnBlwBy.facSlpLin_C ASMod_nHPTrbnDT1.T1_C ASMod_nHPTrbnDT1.Kd_C ASMod_nLPTrbnDT1.T1_C ASMod_nLPTrbnDT1.Kd_C ASMod_pHPTrbnUsRef_C ASMod_pLPTrbnUsRef_C ASMod_rPresHPTrbnRec_CUR ASMod_rPresLPTrbnRec_CUR ASMod_swtHPTrbnDynCor_C ASMod_swtHPTrbnSensSel_C ASMod_swtLPTrbnDynCor_C ASMod_swtTHPTrbnUs_C ASMod_swtTTwinTrbnEnv_C ASMod_tHPTrbnDynCor_MAP ASMod_tHPTrbnTempCor_MAP ASMod_tHPTrbnUsDT1.T1_C ASMod_tHPTrbnUsDT1.Kd_C ASMod_tHPTrbnUsRef_C ASMod_tiHPTrbnAdbtUsPT1_C ASMod_tiHPTrbnDynPT1_C ASMod_tiHPTrbnPresUsPT1_C ASMod_tiHPTrbnTempPT1_C ASMod_tiHPTrbnTempUsPT1_C ASMod_tiLPTrbnAdbtUsPT1_C ASMod_tiLPTrbnDynPT1_C ASMod_tiLPTrbnPresUsPT1_C ASMod_tiLPTrbnTempPT1_C ASMod_tiLPTrbnTempUsPT1_C ASMod_tLPTrbnDynCor_MAP ASMod_tLPTrbnTempCor_MAP ASMod_tLPTrbnUsDT1.T1_C ASMod_tLPTrbnUsDT1.Kd_C ASMod_tLPTrbnUsRef_C /end DEF_CHARACTERISTIC
 /begin REF_CHARACTERISTIC ASMod_cpGs_C ASMod_rTempAdbt_CUR /end REF_CHARACTERISTIC
 /begin IN_MEASUREMENT ASMod_dmExhMnfDs ASMod_htcArEGTrbn ASMod_htcArTrbnEnv ASMod_nHPTrbn ASMod_nLPTrbn ASMod_pIntMnf_r32 ASMod_pPFltUs ASMod_stInit ASMod_tCmprEnv ASMod_tExhMnfDs EngDa_tEng EnvP_p EnvT_t Exh_tOxiCatUs TrbChLP_r TrbCh_r TrbCh_rSens /end IN_MEASUREMENT
 /begin OUT_MEASUREMENT ASMod_pHPDiffEngGsFlw ASMod_pHPTrbnUs ASMod_pLPTrbnUs ASMod_pwrHPTrbn ASMod_pwrLPTrbn ASMod_tHPTrbnUs ASMod_tHPTrbnUsUnCor ASMod_tLPTrbnUs ASMod_tLPTrbnUsUnCor /end OUT_MEASUREMENT
 /begin LOC_MEASUREMENT ASMod_aHPTrbnLim_mp ASMod_aHPTrbn_mp ASMod_aLPTrbnLim_mp ASMod_aLPTrbn_mp ASMod_arEffHPTrbnCtlFlp_mp ASMod_arEffLPTrbnBlwBy_mp ASMod_dmHPTrbnCtlFlp_mp ASMod_dmHPTrbnUsRed_mp ASMod_dmHPTrbn_mp ASMod_dmLPTrbnBlwBy_mp ASMod_dmLPTrbnUsRed_mp ASMod_dmLPTrbn_mp ASMod_dtHPTrbnDsLim_mp ASMod_dtHPTrbnDs_mp ASMod_dtLPTrbnDsLim_mp ASMod_dtLPTrbnDs_mp ASMod_dwEGHPTrbn_mp ASMod_dwEGLPTrbn_mp ASMod_facTempAdbtHPTrbn_mp ASMod_facTempAdbtLPTrbn_mp ASMod_htcArHPTrbn_mp ASMod_htcArLPTrbn_mp ASMod_rHPTrbCh_mp ASMod_rLPTrbCh_mp ASMod_rPresHPTrbnRec_mp ASMod_rPresHPTrbn_mp ASMod_rPresLPTrbnRec_mp ASMod_rPresLPTrbn_mp ASMod_rTempAdbtHPTrbn_mp ASMod_rTempAdbtLPTrbn_mp ASMod_tDiffEGHPTrbn_mp ASMod_tDiffEGLPTrbn_mp ASMod_tHPTrbnAdbtUsUnCor_mp ASMod_tHPTrbnCor_mp ASMod_tHPTrbnDynCor_mp ASMod_tHPTrbnEnvCnvtRaw_mp ASMod_tHPTrbnEnvCnvt_mp ASMod_tHPTrbnTempCor_mp ASMod_tHPTrbnUsFlt_mp ASMod_tHPTrbnUsUnCorRaw_mp ASMod_tLPTrbnAdbtUsUnCor_mp ASMod_tLPTrbnCor_mp ASMod_tLPTrbnDynCor_mp ASMod_tLPTrbnEnvCnvtRaw_mp ASMod_tLPTrbnEnvCnvt_mp ASMod_tLPTrbnTempCor_mp ASMod_tLPTrbnUsFlt_mp ASMod_tLPTrbnUsUnCorRaw_mp /end LOC_MEASUREMENT
/end FUNCTION
/begin FUNCTION ASMod_VolEff ""
 /begin DEF_CHARACTERISTIC ASMod_facIntMnfDsTempCor_C ASMod_facVolEffBas_MAP ASMod_facVolEffVSACor_MAP ASMod_swtIntkVUs_C ASMod_tIntMnfDsRef_MAP ASMod_volEng_C /end DEF_CHARACTERISTIC
 /begin REF_CHARACTERISTIC ASMod_numBnk_C /end REF_CHARACTERISTIC
 /begin IN_MEASUREMENT Air_pUnFltPIntkVUs ASMod_rRelPosVSA ASMod_tIntMnfUs Epm_nEng InjCtl_qSetUnBal /end IN_MEASUREMENT
 /begin OUT_MEASUREMENT ASMod_dmIndAirRef ASMod_dvolIntMnfDsRef ASMod_facVolEff ASMod_tIntMnfDsRef ASMod_volEng /end OUT_MEASUREMENT
 /begin LOC_MEASUREMENT ASMod_dvolIntMnfDsRaw_mp ASMod_facVolEffBasCor_mp ASMod_facVolEffBas_mp ASMod_facVolEffTempCor_mp ASMod_facVolEffVSACor_mp ASMod_pIndAir_mp ASMod_qSetUnBalCrvIn_mp /end LOC_MEASUREMENT
/end FUNCTION
/begin FUNCTION ATSAppl "" /begin SUB_FUNCTION ATSAppl_Std /end SUB_FUNCTION /end FUNCTION
/begin FUNCTION ATSAppl_Std "" /end FUNCTION
/begin FUNCTION ATS_Std ""
 /begin DEF_CHARACTERISTIC AFS_SSpShOff_ATS.LimitTypeMsk_C AFS_SSpShOff_ATS.CnvNorm_C AFS_SSpShOff_ATS.LowLim_C AFS_SSpShOff_ATS.UpLim_C AFS_SSpShOff_ATS.CnvFac_C AFS_SSpShOff_ATS.CnvOfs_C AFS_SSpShOff_ATS.DfltVal_C AirCCmpr_ATS.LimitTypeMsk_C AirCCmpr_ATS.CnvNorm_C AirCCmpr_ATS.LowLim_C AirCCmpr_ATS.UpLim_C AirCCmpr_ATS.CnvFac_C AirCCmpr_ATS.CnvOfs_C AirCCmpr_ATS.DfltVal_C ATS_Com_PSP_ATS.LimitTypeMsk_C ATS_Com_PSP_ATS.CnvNorm_C ATS_Com_PSP_ATS.LowLim_C ATS_Com_PSP_ATS.UpLim_C ATS_Com_PSP_ATS.CnvFac_C ATS_Com_PSP_ATS.CnvOfs_C ATS_Com_PSP_ATS.DfltVal_C ATS_Standby_Disabled_C ATS_tiTstDemHeal_C ATS_tiTstDemMax_C ATS_TmrBehaviour_C ATS_TstDemMaxEngN_C ATS_TstDemMaxVSSCDV_C CByVlv_ATS.LimitTypeMsk_C CByVlv_ATS.CnvNorm_C CByVlv_ATS.LowLim_C CByVlv_ATS.UpLim_C CByVlv_ATS.CnvFac_C CByVlv_ATS.CnvOfs_C CByVlv_ATS.DfltVal_C CThmst_ATS.LimitTypeMsk_C CThmst_ATS.CnvNorm_C CThmst_ATS.LowLim_C CThmst_ATS.UpLim_C CThmst_ATS.CnvFac_C CThmst_ATS.CnvOfs_C CThmst_ATS.DfltVal_C EBxFan_ATS.LimitTypeMsk_C EBxFan_ATS.CnvNorm_C EBxFan_ATS.LowLim_C EBxFan_ATS.UpLim_C EBxFan_ATS.CnvFac_C EBxFan_ATS.CnvOfs_C EBxFan_ATS.DfltVal_C ECBVlv_ATS.LimitTypeMsk_C ECBVlv_ATS.CnvNorm_C ECBVlv_ATS.LowLim_C ECBVlv_ATS.UpLim_C ECBVlv_ATS.CnvFac_C ECBVlv_ATS.CnvOfs_C ECBVlv_ATS.DfltVal_C EGRVlvLP_ATS.LimitTypeMsk_C EGRVlvLP_ATS.CnvNorm_C EGRVlvLP_ATS.LowLim_C EGRVlvLP_ATS.UpLim_C EGRVlvLP_ATS.CnvFac_C EGRVlvLP_ATS.CnvOfs_C EGRVlvLP_ATS.DfltVal_C EGRVlv_ATS.LimitTypeMsk_C EGRVlv_ATS.CnvNorm_C EGRVlv_ATS.LowLim_C EGRVlv_ATS.UpLim_C EGRVlv_ATS.CnvFac_C EGRVlv_ATS.CnvOfs_C EGRVlv_ATS.DfltVal_C EMDmpDig0_ATS.LimitTypeMsk_C EMDmpDig0_ATS.CnvNorm_C EMDmpDig0_ATS.LowLim_C EMDmpDig0_ATS.UpLim_C EMDmpDig0_ATS.CnvFac_C EMDmpDig0_ATS.CnvOfs_C EMDmpDig0_ATS.DfltVal_C EMDmpDig1_ATS.LimitTypeMsk_C EMDmpDig1_ATS.CnvNorm_C EMDmpDig1_ATS.LowLim_C EMDmpDig1_ATS.UpLim_C EMDmpDig1_ATS.CnvFac_C EMDmpDig1_ATS.CnvOfs_C EMDmpDig1_ATS.DfltVal_C EMDmpPWM0_ATS.LimitTypeMsk_C EMDmpPWM0_ATS.CnvNorm_C EMDmpPWM0_ATS.LowLim_C EMDmpPWM0_ATS.UpLim_C EMDmpPWM0_ATS.CnvFac_C EMDmpPWM0_ATS.CnvOfs_C EMDmpPWM0_ATS.DfltVal_C EMDmpPWM1_ATS.LimitTypeMsk_C EMDmpPWM1_ATS.CnvNorm_C EMDmpPWM1_ATS.LowLim_C EMDmpPWM1_ATS.UpLim_C EMDmpPWM1_ATS.CnvFac_C EMDmpPWM1_ATS.CnvOfs_C EMDmpPWM1_ATS.DfltVal_C EngStA_ATS.LimitTypeMsk_C EngStA_ATS.CnvNorm_C EngStA_ATS.LowLim_C EngStA_ATS.UpLim_C EngStA_ATS.CnvFac_C EngStA_ATS.CnvOfs_C EngStA_ATS.DfltVal_C ErrLmpMIL_ATS.LimitTypeMsk_C ErrLmpMIL_ATS.CnvNorm_C ErrLmpMIL_ATS.LowLim_C ErrLmpMIL_ATS.UpLim_C ErrLmpMIL_ATS.CnvFac_C ErrLmpMIL_ATS.CnvOfs_C ErrLmpMIL_ATS.DfltVal_C ErrLmpSVS_ATS.LimitTypeMsk_C ErrLmpSVS_ATS.CnvNorm_C ErrLmpSVS_ATS.LowLim_C ErrLmpSVS_ATS.UpLim_C ErrLmpSVS_ATS.CnvFac_C ErrLmpSVS_ATS.CnvOfs_C ErrLmpSVS_ATS.DfltVal_C FanOut1_ATS.LimitTypeMsk_C FanOut1_ATS.CnvNorm_C FanOut1_ATS.LowLim_C FanOut1_ATS.UpLim_C FanOut1_ATS.CnvFac_C FanOut1_ATS.CnvOfs_C FanOut1_ATS.DfltVal_C FlFltHt_ATS.LimitTypeMsk_C FlFltHt_ATS.CnvNorm_C FlFltHt_ATS.LowLim_C FlFltHt_ATS.UpLim_C FlFltHt_ATS.CnvFac_C FlFltHt_ATS.CnvOfs_C FlFltHt_ATS.DfltVal_C LSU0_ATS.LimitTypeMsk_C LSU0_ATS.CnvNorm_C LSU0_ATS.LowLim_C LSU0_ATS.UpLim_C LSU0_ATS.CnvFac_C LSU0_ATS.CnvOfs_C LSU0_ATS.DfltVal_C OilPLmp_ATS.LimitTypeMsk_C OilPLmp_ATS.CnvNorm_C OilPLmp_ATS.LowLim_C OilPLmp_ATS.UpLim_C OilPLmp_ATS.CnvFac_C OilPLmp_ATS.CnvOfs_C OilPLmp_ATS.DfltVal_C ShtrPWM_ATS.LimitTypeMsk_C ShtrPWM_ATS.CnvNorm_C ShtrPWM_ATS.LowLim_C ShtrPWM_ATS.UpLim_C ShtrPWM_ATS.CnvFac_C ShtrPWM_ATS.CnvOfs_C ShtrPWM_ATS.DfltVal_C Strt_ATS.LimitTypeMsk_C Strt_ATS.CnvNorm_C Strt_ATS.LowLim_C Strt_ATS.UpLim_C Strt_ATS.CnvFac_C Strt_ATS.CnvOfs_C Strt_ATS.DfltVal_C ThrVlv_ATS.LimitTypeMsk_C ThrVlv_ATS.CnvNorm_C ThrVlv_ATS.LowLim_C ThrVlv_ATS.UpLim_C ThrVlv_ATS.CnvFac_C ThrVlv_ATS.CnvOfs_C ThrVlv_ATS.DfltVal_C TrbChLP_ATS.LimitTypeMsk_C TrbChLP_ATS.CnvNorm_C TrbChLP_ATS.LowLim_C TrbChLP_ATS.UpLim_C TrbChLP_ATS.CnvFac_C TrbChLP_ATS.CnvOfs_C TrbChLP_ATS.DfltVal_C TrbCh_ATS.LimitTypeMsk_C TrbCh_ATS.CnvNorm_C TrbCh_ATS.LowLim_C TrbCh_ATS.UpLim_C TrbCh_ATS.CnvFac_C TrbCh_ATS.CnvOfs_C TrbCh_ATS.DfltVal_C UDosVlv_ATS.LimitTypeMsk_C UDosVlv_ATS.CnvNorm_C UDosVlv_ATS.LowLim_C UDosVlv_ATS.UpLim_C UDosVlv_ATS.CnvFac_C UDosVlv_ATS.CnvOfs_C UDosVlv_ATS.DfltVal_C UHtrPL_ATS.LimitTypeMsk_C UHtrPL_ATS.CnvNorm_C UHtrPL_ATS.LowLim_C UHtrPL_ATS.UpLim_C UHtrPL_ATS.CnvFac_C UHtrPL_ATS.CnvOfs_C UHtrPL_ATS.DfltVal_C UHtrTnk_ATS.LimitTypeMsk_C UHtrTnk_ATS.CnvNorm_C UHtrTnk_ATS.LowLim_C UHtrTnk_ATS.UpLim_C UHtrTnk_ATS.CnvFac_C UHtrTnk_ATS.CnvOfs_C UHtrTnk_ATS.DfltVal_C UPmpMot_ATS.LimitTypeMsk_C UPmpMot_ATS.CnvNorm_C UPmpMot_ATS.LowLim_C UPmpMot_ATS.UpLim_C UPmpMot_ATS.CnvFac_C UPmpMot_ATS.CnvOfs_C UPmpMot_ATS.DfltVal_C URevVlv_ATS.LimitTypeMsk_C URevVlv_ATS.CnvNorm_C URevVlv_ATS.LowLim_C URevVlv_ATS.UpLim_C URevVlv_ATS.CnvFac_C URevVlv_ATS.CnvOfs_C URevVlv_ATS.DfltVal_C VSwVlv_ATS.LimitTypeMsk_C VSwVlv_ATS.CnvNorm_C VSwVlv_ATS.LowLim_C VSwVlv_ATS.UpLim_C VSwVlv_ATS.CnvFac_C VSwVlv_ATS.CnvOfs_C VSwVlv_ATS.DfltVal_C WaHtEl_ATS.LimitTypeMsk_C WaHtEl_ATS.CnvNorm_C WaHtEl_ATS.LowLim_C WaHtEl_ATS.UpLim_C WaHtEl_ATS.CnvFac_C WaHtEl_ATS.CnvOfs_C WaHtEl_ATS.DfltVal_C /end DEF_CHARACTERISTIC
 /begin IN_MEASUREMENT Epm_nEngLRes VehV_v /end IN_MEASUREMENT
 /begin OUT_MEASUREMENT ATS_stMonTimeLimit /end OUT_MEASUREMENT
 /begin LOC_MEASUREMENT ATS_IntvVal_mp ATS_TstStatus_mp /end LOC_MEASUREMENT
/end FUNCTION
/begin FUNCTION Avs "" /end FUNCTION
/begin FUNCTION BasSvrAppl_Std "" /end FUNCTION
/begin FUNCTION BasUtil_Std "" /end FUNCTION
/begin FUNCTION Battuecu_lin "" /begin IN_MEASUREMENT Layer_stInfoEnv /end IN_MEASUREMENT
 /begin OUT_MEASUREMENT BattuEcu_i BattuEcu_qCharge BattuEcu_qDischarge BattuEcu_stChg BattuEcu_stIbs BattuEcu_stInfoDiag BattuEcu_t BattuEcu_u /end OUT_MEASUREMENT
/end FUNCTION
/begin FUNCTION BattU_DD "" /begin DEF_CHARACTERISTIC BattU_uTransf_CUR /end DEF_CHARACTERISTIC /begin OUT_MEASUREMENT BattU_uRaw BattU_uSens /end OUT_MEASUREMENT /end FUNCTION
/begin FUNCTION BattU_VD ""
 /begin DEF_CHARACTERISTIC BattU_RmpSlp.Pos_C BattU_RmpSlp.Neg_C BattU_swtRated_C BattU_TransStagePar.Dfl_C BattU_TransStagePar.stSensId_C BattU_uNrm_C BattU_uSRCMax_C BattU_uSRCMin_C /end DEF_CHARACTERISTIC
 /begin OUT_MEASUREMENT BattU_facCor BattU_u BattU_uRated /end OUT_MEASUREMENT
/end FUNCTION
/begin FUNCTION Batt_DataAcq "" /begin IN_MEASUREMENT BattU_u /end IN_MEASUREMENT /begin OUT_MEASUREMENT ESS_uBatt /end OUT_MEASUREMENT /end FUNCTION
/begin FUNCTION bmw_global "" /end FUNCTION
/begin COMPU_METHOD AIRC_REDTRQCMPRENA_SY_Compu "" TAB_VERB "%6.3" "" COMPU_TAB_REF AIRC_REDTRQCMPRENA_SY_Compu /end COMPU_METHOD
/begin COMPU_VTAB AIRC_REDTRQCMPRENA_SY_Compu "" TAB_VERB 2 0 "FALSE" 1 "TRUE" /end COMPU_VTAB
/begin COMPU_METHOD AirMassPerCyl "" RAT_FUNC "%5.1" "mg/Hub" COEFFS 0 10 0 0 0 1 /end COMPU_METHOD
/begin COMPU_METHOD AirMassPerTime "" RAT_FUNC "%5.1" "Kg/h" COEFFS 0 10 0 0 0 1 /end COMPU_METHOD
/begin COMPU_METHOD AirMassPerTime_float "" RAT_FUNC "%6.2" "Kg/h" COEFFS 0 1 0 0 0 1 /end COMPU_METHOD
/begin COMPU_METHOD Airmass_float "" RAT_FUNC "%6.2" "g" COEFFS 0 1 0 0 0 1 /end COMPU_METHOD
/begin COMPU_METHOD AirTempFldSel "" TAB_VERB "%6.3" "" COMPU_TAB_REF AirTempFldSel /end COMPU_METHOD
/begin COMPU_VTAB AirTempFldSel "" TAB_VERB 4 0 "Air_tCACDs" 1 "Air_tAFS" 2 "EnvT_t" 3 "Air_tAFSCorr" /end COMPU_VTAB
/begin COMPU_METHOD AirVolPerTime "" RAT_FUNC "%6.3" "m^3/h" COEFFS 0 10 0 0 0 1 /end COMPU_METHOD
/begin COMPU_METHOD AmpIbsLin "" RAT_FUNC "%6.1" "A" COEFFS 0 50 10000 0 0 1 /end COMPU_METHOD
/begin COMPU_METHOD Area "" RAT_FUNC "%6.5" "m*m" COEFFS 0 8192 0 0 0 1 /end COMPU_METHOD
/begin COMPU_METHOD Area_cm2_float "" RAT_FUNC "%6.2" "cm*cm" COEFFS 0 1 0 0 0 1 /end COMPU_METHOD
/begin COMPU_METHOD ASMod_Fact1E6 "" RAT_FUNC "%9.8" "" COEFFS 0 1000000 0 0 0 1 /end COMPU_METHOD
/begin COMPU_METHOD Calory_Asmod "" RAT_FUNC "%6.1" "J/g" COEFFS 0 0.05 0 0 0 1 /end COMPU_METHOD
/begin COMPU_METHOD ChargeIbsLin "" RAT_FUNC "%6.4" "Ah" COEFFS 0 989 0 0 0 18 /end COMPU_METHOD
/begin COMPU_METHOD DtyCyc "" RAT_FUNC "%5.2" "%" COEFFS 0 100 0 0 0 1 /end COMPU_METHOD
/begin COMPU_METHOD EngN "" RAT_FUNC "%5.1" "rpm" COEFFS 0 2 0 0 0 1 /end COMPU_METHOD
/begin COMPU_METHOD EngN_LRes "" RAT_FUNC "%6.1" "rpm" COEFFS 0 0.025 0 0 0 1 /end COMPU_METHOD
/begin COMPU_METHOD EngTempFldSel "" TAB_VERB "%6.3" "" COMPU_TAB_REF EngTempFldSel /end COMPU_METHOD
/begin COMPU_VTAB EngTempFldSel "" TAB_VERB 4 0 "Coolant_Temperature" 1 "Oil_Temperature" 2 "EngDa_tEng" 3 "Chamberwall_Temperature" /end COMPU_VTAB
/begin COMPU_METHOD Fact "" RAT_FUNC "%6.5" "-" COEFFS 0 8192 0 0 0 1 /end COMPU_METHOD
/begin COMPU_METHOD Fact1 "" RAT_FUNC "%6.4" "-" COEFFS 0 128 0 0 0 1 /end COMPU_METHOD
/begin COMPU_METHOD Fact10 "" RAT_FUNC "%13.12" "-" COEFFS 0 10000000000 0 0 0 1 /end COMPU_METHOD
/begin COMPU_METHOD Fact100 "" RAT_FUNC "%6.4" "-" COEFFS 0 100 0 0 0 1 /end COMPU_METHOD
/begin COMPU_METHOD Fact7 "" RAT_FUNC "%10.9" "-" COEFFS 0 10000000 0 0 0 1 /end COMPU_METHOD
/begin COMPU_METHOD Fact8 "" RAT_FUNC "%11.10" "-" COEFFS 0 100000000 0 0 0 1 /end COMPU_METHOD
/begin COMPU_METHOD FactLow "" RAT_FUNC "%6.5" "-" COEFFS 0 1024 0 0 0 1 /end COMPU_METHOD
/begin COMPU_METHOD FactPresLs_float "" RAT_FUNC "%6.2" "(hpa/(kg/h))^2/k" COEFFS 0 1 0 0 0 1 /end COMPU_METHOD
/begin COMPU_METHOD Fact_float "" RAT_FUNC "%6.2" "-" COEFFS 0 1 0 0 0 1 /end COMPU_METHOD
/begin COMPU_METHOD Fact_PT1 "" RAT_FUNC "%6.4" "W/K" COEFFS 0 128 0 0 0 1 /end COMPU_METHOD
/begin COMPU_METHOD FlConsum_l_h "" RAT_FUNC "%6.4" "l/h" COEFFS 0 100 0 0 0 1 /end COMPU_METHOD
/begin COMPU_METHOD HeatCapacity "" RAT_FUNC "%6.3" "J/K" COEFFS 0 10 0 0 0 1 /end COMPU_METHOD
/begin COMPU_METHOD InjMass "" RAT_FUNC "%5.2" "mg/hub" COEFFS 0 100 0 0 0 1 /end COMPU_METHOD
/begin COMPU_METHOD InjMassPerTime "" RAT_FUNC "%6.4" "Kg/h" COEFFS 0 100 0 0 0 1 /end COMPU_METHOD
/begin COMPU_METHOD InjMassPerTime_2 "" RAT_FUNC "%6.5" "Kg/h" COEFFS 0 2000 0 0 0 1 /end COMPU_METHOD
/begin COMPU_METHOD InjMassPerTime_g_s "" RAT_FUNC "%6.5" "g/s" COEFFS 0 2000 0 0 0 1 /end COMPU_METHOD
/begin COMPU_METHOD InjMass_g "" RAT_FUNC "%6.4" "g" COEFFS 0 100 0 0 0 1 /end COMPU_METHOD
/begin COMPU_METHOD InjMsPrTime_q0p001_COMPU "" RAT_FUNC "%6.5" "Kg/h" COEFFS 0 1000 0 0 0 1 /end COMPU_METHOD
/begin COMPU_METHOD Kd "" RAT_FUNC "%7.6" "1/1" COEFFS 0 65536 0 0 0 1 /end COMPU_METHOD
/begin COMPU_METHOD Ki_Ampc2Prc "" RAT_FUNC "%7.6" "%/(mg/Hub Luft)/s" COEFFS 0 17592.186044416 0 0 0 1 /end COMPU_METHOD
/begin COMPU_METHOD Ki_Kelv_Sec "" RAT_FUNC "%6.4" "1/s" COEFFS 0 214.7483648 0 0 0 1 /end COMPU_METHOD
/begin COMPU_METHOD lambdaRecVal "" RAT_FUNC "%6.5" "-" COEFFS 0 1000 0 0 0 1 /end COMPU_METHOD
/begin COMPU_METHOD Length1 "" RAT_FUNC "%6.4" "m" COEFFS 0 128 0 0 0 1 /end COMPU_METHOD
/begin COMPU_METHOD O2 "" RAT_FUNC "%6.5" "-" COEFFS 0 100000 0 0 0 1 /end COMPU_METHOD
/begin COMPU_METHOD O2MassPerTimeLo "" RAT_FUNC "%6.4" "Kg/h" COEFFS 0 50 0 0 0 1 /end COMPU_METHOD
/begin COMPU_METHOD OneToOne "" RAT_FUNC "%6.0" "-" COEFFS 0 1 0 0 0 1 /end COMPU_METHOD
/begin COMPU_METHOD Pos_Prc_float "" RAT_FUNC "%6.2" "%" COEFFS 0 1 0 0 0 1 /end COMPU_METHOD
/begin COMPU_METHOD Prc "" RAT_FUNC "%6.4" "%" COEFFS 0 81.92 0 0 0 1 /end COMPU_METHOD
/begin COMPU_METHOD Pres_hPa "" RAT_FUNC "%5.1" "hPa" COEFFS 0 1 0 0 0 1 /end COMPU_METHOD
/begin COMPU_METHOD Pres_hPa_float "" RAT_FUNC "%6.2" "hPa" COEFFS 0 1 0 0 0 1 /end COMPU_METHOD
/begin COMPU_METHOD Pwr "" RAT_FUNC "%6.2" "W" COEFFS 0 0.10610329539459 0 0 0 1 /end COMPU_METHOD
/begin COMPU_METHOD Pwr1 "" RAT_FUNC "%6.3" "W" COEFFS 0 10 0 0 0 1 /end COMPU_METHOD
/begin COMPU_METHOD Pwr_float "" RAT_FUNC "%6.2" "W" COEFFS 0 1 0 0 0 1 /end COMPU_METHOD
/begin COMPU_METHOD RatAirMass "" RAT_FUNC "%6.4" "-" COEFFS 0 100 0 0 0 1 /end COMPU_METHOD
/begin COMPU_METHOD RatNOxMass "" RAT_FUNC "%10.9" "-" COEFFS 0 10000000 0 0 0 1 /end COMPU_METHOD
/begin COMPU_METHOD ReynoldsNum "" RAT_FUNC "%6.0" "-" COEFFS 0 0.01 0 0 0 1 /end COMPU_METHOD
/begin COMPU_METHOD ReynoldsNum1 "" RAT_FUNC "%7.0" "-" COEFFS 0 0.001 0 0 0 1 /end COMPU_METHOD
/begin COMPU_METHOD RmpVoltBatt "" RAT_FUNC "%6.3" "mV/s" COEFFS 0 3.2768 0 0 0 1 /end COMPU_METHOD
/begin COMPU_METHOD SpecificHeat "" RAT_FUNC "%7.6" "J/g/K" COEFFS 0 10000 0 0 0 1 /end COMPU_METHOD
/begin COMPU_METHOD TempC_float "" RAT_FUNC "%6.1" "deg C" COEFFS 0 1 273.14 0 0 1 /end COMPU_METHOD
/begin COMPU_METHOD TempDiff_Cels "" RAT_FUNC "%6.3" "deg C" COEFFS 0 10 0 0 0 1 /end COMPU_METHOD
/begin COMPU_METHOD TempDiff_Kelv "" RAT_FUNC "%4.1" "K" COEFFS 0 10 0 0 0 1 /end COMPU_METHOD
/begin COMPU_METHOD TempIbsLin "" RAT_FUNC "%6.2" "Cels" COEFFS 0 4 192 0 0 3 /end COMPU_METHOD
/begin COMPU_METHOD Temp_Cels "" RAT_FUNC "%5.1" "deg C" COEFFS 0 10 2731.4 0 0 1 /end COMPU_METHOD
/begin COMPU_METHOD Temp_Kelv "" RAT_FUNC "%6.3" "K" COEFFS 0 10 0 0 0 1 /end COMPU_METHOD
/begin COMPU_METHOD Temp_Kelv1_Sec "" RAT_FUNC "%6.3" "K/s" COEFFS 0 10 0 0 0 1 /end COMPU_METHOD
/begin COMPU_METHOD Temp_Kelv_Sec "" RAT_FUNC "%6.4" "K/s" COEFFS 0 100 0 0 0 1 /end COMPU_METHOD
/begin COMPU_METHOD ThermalCoEff "" RAT_FUNC "%6.3" "W/m/m/k" COEFFS 0 10 0 0 0 1 /end COMPU_METHOD
/begin COMPU_METHOD TimeDelay_s "" RAT_FUNC "%12.4" "s" COEFFS 0 0 1 0 0.00023283064365387 0 /end COMPU_METHOD
/begin COMPU_METHOD TimeDelay_s_Lin_16 "" RAT_FUNC "%6.5" "s" COEFFS 0 6553.4 0 0 0 1 /end COMPU_METHOD
/begin COMPU_METHOD TimeDelay_s_Lin_16_2 "" RAT_FUNC "%6.4" "s" COEFFS 0 16.3835 0 0 0 1 /end COMPU_METHOD
/begin COMPU_METHOD Time_1_s "" RAT_FUNC "%8.7" "1/s" COEFFS 0 163840 0 0 0 1 /end COMPU_METHOD
/begin COMPU_METHOD Time_s "" RAT_FUNC "%5.2" "s" COEFFS 0 100 0 0 0 1 /end COMPU_METHOD
/begin COMPU_METHOD Time_sec "" RAT_FUNC "%6.5" "s" COEFFS 0 1000 0 0 0 1 /end COMPU_METHOD
/begin COMPU_METHOD Time_s_float "" RAT_FUNC "%6.2" "s" COEFFS 0 1 0 0 0 1 /end COMPU_METHOD
/begin COMPU_METHOD TrbChN_float "" RAT_FUNC "%6.2" "rpm" COEFFS 0 1 0 0 0 1 /end COMPU_METHOD
/begin COMPU_METHOD Vel "" RAT_FUNC "%5.2" "km/h" COEFFS 0 100 0 0 0 1 /end COMPU_METHOD
/begin COMPU_METHOD Vol "" RAT_FUNC "%6.4" "l" COEFFS 0 100 0 0 0 1 /end COMPU_METHOD
/begin COMPU_METHOD Volt "" RAT_FUNC "%6.1" "mV" COEFFS 0 5 0 0 0 1 /end COMPU_METHOD
/begin COMPU_METHOD VoltIbsLin "" RAT_FUNC "%6.5" "V" COEFFS 0 1000 0 0 0 1 /end COMPU_METHOD
/begin COMPU_METHOD Volt_Batt "" RAT_FUNC "%5.0" "mV" COEFFS 0 0.05 0 0 0 1 /end COMPU_METHOD
/begin COMPU_METHOD Vol_float "" RAT_FUNC "%6.2" "l" COEFFS 0 1 0 0 0 1 /end COMPU_METHOD
/begin RECORD_LAYOUT Cur_Xr32Wr32 NO_AXIS_PTS_X 1 SLONG AXIS_PTS_X 2 FLOAT32_IEEE INDEX_INCR DIRECT FNC_VALUES 3 FLOAT32_IEEE COLUMN_DIR DIRECT /end RECORD_LAYOUT
/begin RECORD_LAYOUT Cur_Xs16Ws16 NO_AXIS_PTS_X 1 SWORD AXIS_PTS_X 2 SWORD INDEX_INCR DIRECT FNC_VALUES 3 SWORD COLUMN_DIR DIRECT /end RECORD_LAYOUT
/begin RECORD_LAYOUT Kf_Xs16_Ys16_Ws16 NO_AXIS_PTS_X 1 SWORD NO_AXIS_PTS_Y 2 SWORD AXIS_PTS_X 3 SWORD INDEX_INCR DIRECT AXIS_PTS_Y 4 SWORD INDEX_INCR DIRECT FNC_VALUES 5 SWORD COLUMN_DIR DIRECT /end RECORD_LAYOUT
/begin RECORD_LAYOUT Kl_Xs16_Ws16 NO_AXIS_PTS_X 1 SWORD AXIS_PTS_X 2 SWORD INDEX_INCR DIRECT FNC_VALUES 3 SWORD COLUMN_DIR DIRECT /end RECORD_LAYOUT
/begin RECORD_LAYOUT Kw_Wr32 FNC_VALUES 1 FLOAT32_IEEE COLUMN_DIR DIRECT /end RECORD_LAYOUT
/begin RECORD_LAYOUT Kw_Ws16 FNC_VALUES 1 SWORD COLUMN_DIR DIRECT /end RECORD_LAYOUT
/begin RECORD_LAYOUT Kw_Ws32 FNC_VALUES 1 SLONG COLUMN_DIR DIRECT /end RECORD_LAYOUT
/begin RECORD_LAYOUT Kw_Wu32 FNC_VALUES 1 ULONG COLUMN_DIR DIRECT /end RECORD_LAYOUT
/begin RECORD_LAYOUT Kw_Wu8 FNC_VALUES 1 UBYTE COLUMN_DIR DIRECT /end RECORD_LAYOUT
/begin RECORD_LAYOUT Map_Xr32Yr32Wr32 NO_AXIS_PTS_X 1 SLONG NO_AXIS_PTS_Y 2 SLONG AXIS_PTS_X 3 FLOAT32_IEEE INDEX_INCR DIRECT AXIS_PTS_Y 4 FLOAT32_IEEE INDEX_INCR DIRECT FNC_VALUES 5 FLOAT32_IEEE COLUMN_DIR DIRECT /end RECORD_LAYOUT
/begin RECORD_LAYOUT Map_Xs16Ys16Ws16 NO_AXIS_PTS_X 1 SWORD NO_AXIS_PTS_Y 2 SWORD AXIS_PTS_X 3 SWORD INDEX_INCR DIRECT AXIS_PTS_Y 4 SWORD INDEX_INCR DIRECT FNC_VALUES 5 SWORD COLUMN_DIR DIRECT /end RECORD_LAYOUT
/begin RECORD_LAYOUT ValA_Ws16 FNC_VALUES 1 SWORD COLUMN_DIR DIRECT /end RECORD_LAYOUT
/begin RECORD_LAYOUT ValA_Ws32 FNC_VALUES 1 SLONG COLUMN_DIR DIRECT /end RECORD_LAYOUT
/begin RECORD_LAYOUT ValA_Wu8 FNC_VALUES 1 UBYTE COLUMN_DIR DIRECT /end RECORD_LAYOUT
/begin RECORD_LAYOUT Val_Wr32 FNC_VALUES 1 FLOAT32_IEEE COLUMN_DIR DIRECT /end RECORD_LAYOUT
/begin RECORD_LAYOUT Val_Ws16 FNC_VALUES 1 SWORD COLUMN_DIR DIRECT /end RECORD_LAYOUT
/begin RECORD_LAYOUT Val_Ws32 FNC_VALUES 1 SLONG COLUMN_DIR DIRECT /end RECORD_LAYOUT
/begin RECORD_LAYOUT Val_Wu16 FNC_VALUES 1 UWORD COLUMN_DIR DIRECT /end RECORD_LAYOUT
/begin RECORD_LAYOUT Val_Wu8 FNC_VALUES 1 UBYTE COLUMN_DIR DIRECT /end RECORD_LAYOUT
/end MODULE
/end PROJECT

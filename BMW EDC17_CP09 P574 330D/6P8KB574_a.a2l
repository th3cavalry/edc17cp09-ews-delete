ASAP2_VERSION 1 4
/begin PROJECT P_574 "EDC17_CP09"
/begin HEADER "" VERSION "V8KB" PROJECT_NO P_574 /end HEADER
/begin MODULE DIM ""
/begin MOD_COMMON "" BYTE_ORDER MSB_LAST ALIGNMENT_BYTE 1 ALIGNMENT_WORD 2 ALIGNMENT_LONG 4 ALIGNMENT_FLOAT32_IEEE 4 /end MOD_COMMON
/begin CHARACTERISTIC Com_RawMuxValId_C "" VALUE 0x8003BDF8 Val_Wu8 255.0 OneToOne 0.00 255.0 /end CHARACTERISTIC
/begin CHARACTERISTIC Com_RawValIdA_C "" VALUE 0x8003BDFA Val_Wu16 65535.00 OneToOne 0.00 65535.00 /end CHARACTERISTIC
/begin CHARACTERISTIC Com_RawValIdB_C "" VALUE 0x8003BDFC Val_Wu16 65535.00 OneToOne 0.00 65535.00 /end CHARACTERISTIC
/begin CHARACTERISTIC Com_RawValIdC_C "" VALUE 0x8003BDFE Val_Wu16 65535.00 OneToOne 0.00 65535.00 /end CHARACTERISTIC
/begin CHARACTERISTIC Com_RawValIdD_C "" VALUE 0x8003BE00 Val_Wu16 65535.00 OneToOne 0.00 65535.00 /end CHARACTERISTIC
/begin CHARACTERISTIC Com_SelfRecID_C "" VALUE 0x8003BE02 Val_Wu16 65535.00 OneToOne 0.00 65535.00 /end CHARACTERISTIC
/begin CHARACTERISTIC Com_stGear_C "" VAL_BLK 0x8003C110 ValA_Ws8 17.00 OneToOne -1.000 16.00 EXTENDED_LIMITS -128.0 127.0 NUMBER 16 /end CHARACTERISTIC
/begin CHARACTERISTIC Com_swtDiaOBDGbx_A_C "" VALUE 0x8003C10C Val_Wu8 255.0 OneToOne 0.00 255.0 /end CHARACTERISTIC
/begin CHARACTERISTIC Com_swtDtGrdtDrv_FA_C "" VALUE 0x8003C12C Val_Wu8 255.0 OneToOne 0.00 255.0 /end CHARACTERISTIC
/begin CHARACTERISTIC Com_swtGbxData_A_C "" VALUE 0x8003C10D Val_Wu8 255.0 OneToOne 0.00 255.0 /end CHARACTERISTIC
/begin CHARACTERISTIC Com_swtGbxData_FA_C "" VALUE 0x8003C12D Val_Wu8 255.0 OneToOne 0.00 255.0 /end CHARACTERISTIC
/begin CHARACTERISTIC Com_swtGearboxData2_C "" VALUE 0x8003C108 Val_Wu8 255.0 OneToOne 0.00 255.0 /end CHARACTERISTIC
/begin CHARACTERISTIC Com_swtGearboxData_C "" VALUE 0x8003C109 Val_Wu8 255.0 OneToOne 0.00 255.0 /end CHARACTERISTIC
/begin CHARACTERISTIC Com_swtSpdGovTrqCor_C "" VALUE 0x8003C120 Val_Wu8 1.000 OneToOne 0.00 1.000 EXTENDED_LIMITS 0.00 255.0 /end CHARACTERISTIC
/begin CHARACTERISTIC Com_swtStatGang_FA_C "" VALUE 0x8003C12E Val_Wu8 255.0 OneToOne 0.00 255.0 /end CHARACTERISTIC
/begin CHARACTERISTIC Com_swtStatGearRev_FA_C "" VALUE 0x8003C12F Val_Wu8 255.0 OneToOne 0.00 255.0 /end CHARACTERISTIC
/begin CHARACTERISTIC Com_swtStatusEGS_A_C "" VALUE 0x8003C10E Val_Wu8 255.0 OneToOne 0.00 255.0 /end CHARACTERISTIC
/begin CHARACTERISTIC Com_swtStatusEGS_FA_C "" VALUE 0x8003C130 Val_Wu8 255.0 OneToOne 0.00 255.0 /end CHARACTERISTIC
/begin CHARACTERISTIC Com_swtTrqDemandGbx_A_C "" VALUE 0x8003C10F Val_Wu8 255.0 OneToOne 0.00 255.0 /end CHARACTERISTIC
/begin CHARACTERISTIC Com_swtTrqDemandGbx_C "" VALUE 0x8003C10A Val_Wu8 255.0 OneToOne 0.00 255.0 /end CHARACTERISTIC
/begin CHARACTERISTIC Com_swtTrqDemandGbx_FA_C "" VALUE 0x8003C131 Val_Wu8 255.0 OneToOne 0.00 255.0 /end CHARACTERISTIC
/begin CHARACTERISTIC Com_tiFltnTrbn_C "" VALUE 0x8003C124 Val_Ws32 4294967.2940 TimeDelay_ms 0.0020000000009 4294967.2960 FORMAT "%12.4" /end CHARACTERISTIC
/begin CHARACTERISTIC Com_trqGbxMaxSubs_C "" VALUE 0x8003C128 Val_Ws16 6553.500 Trq -3276.800 3276.700 /end CHARACTERISTIC
/begin CHARACTERISTIC ETClb_ctDflLrnAllw_CA "Defaultwert für die Zahl der erlaubten Kalibrierzyklen pro Raildruckkalibrierpunkt" VAL_BLK 0x8003915C ValA_Wu8 255.0 OneToOne 0.00 255.0 NUMBER 3 /end CHARACTERISTIC
/begin CHARACTERISTIC ETClb_ctDflLrn_CA "Defaultwerte für die applikative Änderung der Lernzykluszähler der Ansteuerdauerkalibrierung für die ZFC" VAL_BLK 0x80039160 ValA_Wu16 65535.00 OneToOne 0.00 65535.00 NUMBER 3 /end CHARACTERISTIC
/begin CHARACTERISTIC ETClb_ctLrnPerDelta_C "Anzahl der freigegebenen Lernzyklen pro Streckenintervall" VALUE 0x80039166 Val_Wu8 255.0 OneToOne 0.00 255.0 /end CHARACTERISTIC
/begin CHARACTERISTIC ETClb_dtiDflETFlt0_CA "Defaultwerte für die gefilterte Ansteuerdauerdifferenz der Ansteuerdauerkalibrierung für den Raildruck-Kalibrierpunkt 0" VAL_BLK 0x80039168 ValA_Ws16 5200.000 InjTime_us -200.0000 5000.000 EXTENDED_LIMITS -13107.20 13106.80 NUMBER 6 /end CHARACTERISTIC
/begin CHARACTERISTIC ETClb_dtiDflETFlt1_CA "Defaultwerte für die gefilterte Ansteuerdauerdifferenz der Ansteuerdauerkalibrierung für den Raildruck-Kalibrierpunkt 1" VAL_BLK 0x80039174 ValA_Ws16 5200.000 InjTime_us -200.0000 5000.000 EXTENDED_LIMITS -13107.20 13106.80 NUMBER 6 /end CHARACTERISTIC
/begin CHARACTERISTIC ETClb_dtiDflETFlt2_CA "Defaultwerte für die gefilterte Ansteuerdauerdifferenz der Ansteuerdauerkalibrierung für den Raildruck-Kalibrierpunkt 2" VAL_BLK 0x80039180 ValA_Ws16 5200.000 InjTime_us -200.0000 5000.000 EXTENDED_LIMITS -13107.20 13106.80 NUMBER 6 /end CHARACTERISTIC
/begin CHARACTERISTIC ETClb_dtiDflETFlt3_CA "Defaultwerte für die gefilterte Ansteuerdauerdifferenz der Ansteuerdauerkalibrierung für den Raildruck-Kalibrierpunkt 3" VAL_BLK 0x8003918C ValA_Ws16 5200.000 InjTime_us -200.0000 5000.000 EXTENDED_LIMITS -13107.20 13106.80 NUMBER 6 /end CHARACTERISTIC
/begin CHARACTERISTIC ETClb_dtiDflETFlt4_CA "Defaultwerte für die gefilterte Ansteuerdauerdifferenz der Ansteuerdauerkalibrierung für den Raildruck-Kalibrierpunkt 4" VAL_BLK 0x80039198 ValA_Ws16 5200.000 InjTime_us -200.0000 5000.000 EXTENDED_LIMITS -13107.20 13106.80 NUMBER 6 /end CHARACTERISTIC
/begin CHARACTERISTIC ETClb_dtiDflETFlt5_CA "Defaultwerte für die gefilterte Ansteuerdauerdifferenz der Ansteuerdauerkalibrierung für den Raildruck-Kalibrierpunkt 5" VAL_BLK 0x800391A4 ValA_Ws16 5200.000 InjTime_us -200.0000 5000.000 EXTENDED_LIMITS -13107.20 13106.80 NUMBER 6 /end CHARACTERISTIC
/begin CHARACTERISTIC ETClb_dtiDflETFlt6_CA "Defaultwerte für die gefilterte Ansteuerdauerdifferenz der Ansteuerdauerkalibrierung für den Raildruck-Kalibrierpunkt 6" VAL_BLK 0x800391B0 ValA_Ws16 5200.000 InjTime_us -200.0000 5000.000 EXTENDED_LIMITS -13107.20 13106.80 NUMBER 6 /end CHARACTERISTIC
/begin CHARACTERISTIC ETClb_lDelta_C "Toleranz beim Streckenvergleich für Begrenzung der Lernhäufigkeit" VALUE 0x800391BC Val_Ws16 990.0000 Length 10.00000 1000.000 FORMAT "%8.3" EXTENDED_LIMITS -32768.00 32767.00 /end CHARACTERISTIC
/begin CHARACTERISTIC ETClb_lLrnDelta_C "Länge des Streckenintervalls zur Begrenzung der Lernhäufigkeit" VALUE 0x800391C0 Val_Ws32 19872000.0000 Length 128000.000000 20000000.0000 FORMAT "%13.4" EXTENDED_LIMITS -2147483648.00 2147483647.00 /end CHARACTERISTIC
/begin CHARACTERISTIC ETClb_numDflCylCur_CA "Testwerte für die aktuellen Zylinder der Ansteuerdauerkalibrierung für jeden Raildruck-Kalibrierpunkt" VAL_BLK 0x800391C4 ValA_Wu8 5.000 OneToOne 1.000 6.000 EXTENDED_LIMITS 0.00 255.0 NUMBER 3 /end CHARACTERISTIC
/begin CHARACTERISTIC ETClb_stRlsCylCorDfl_C "Defaultwert für die zylinderspezifische Korrekturfreigabe" VALUE 0x800391C7 Val_Wu8 255.0 OneToOne 0.00 255.0 /end CHARACTERISTIC
/begin CHARACTERISTIC ETClb_swtDflLimClbFrq_C "Schalter zum Schreiben der Defaultwerte für Funktion Begrenzung der Lernhäufigkeit" VALUE 0x800391C8 Val_Wu8 1.000 OneToOne 0.00 1.000 EXTENDED_LIMITS 0.00 255.0 /end CHARACTERISTIC
/begin CHARACTERISTIC ETClb_swtDflQckClb_C "Testwert zum Umschalten auf Schnellkalibrierung der Ansteuerdauerkalibrierung" VALUE 0x800391C9 Val_Wu8 1.000 OneToOne 0.00 1.000 EXTENDED_LIMITS 0.00 255.0 /end CHARACTERISTIC
/begin CHARACTERISTIC ETClb_swtLimClbFrqOff_C "Schalter zum Abschalten der Begrenzung der Lernhäufigkeit (1=ausgeschaltet)" VALUE 0x800391CA Val_Wu8 1.000 OneToOne 0.00 1.000 EXTENDED_LIMITS 0.00 255.0 /end CHARACTERISTIC
/begin CHARACTERISTIC ETClb_tiDflETCur_CA "Testwert der aktuellen Ansteuerdauer für die Ansteuerdauerkalibrierung bei jedem Raildruck-Kalibrierpunkt" VAL_BLK 0x800391CC ValA_Ws16 4850.000 InjTime_us 150.0000 5000.000 EXTENDED_LIMITS -13107.20 13106.80 NUMBER 3 /end CHARACTERISTIC
/begin CHARACTERISTIC ETClb_tiETOfsMax_CA "Offset der max. gefilterten Ansteuerdauer zur max. Ansteuerdauer für jeden Raildruck-Kalibrierpunkt" VAL_BLK 0x800391D2 ValA_Ws16 5000.0000 InjTime_us 0.00 5000.0000 EXTENDED_LIMITS -13107.20 13106.80 NUMBER 3 /end CHARACTERISTIC
/begin CHARACTERISTIC ETClb_tiETOfsMin_CA "Offset der min. gefilterten Ansteuerdauer zur min. Ansteuerdauer für jeden Raildruck-Kalibrierpunkt" VAL_BLK 0x800391D8 ValA_Ws16 5000.0000 InjTime_us 0.00 5000.0000 EXTENDED_LIMITS -13107.20 13106.80 NUMBER 3 /end CHARACTERISTIC
/begin CHARACTERISTIC ETCtl_DebPoI.tiHiLo_C "Entprellzeit für Nacheinspritzung/" VALUE 0x80039968 Kw_Ws16 655.3500 Time_s -327.6800 327.6700 /end CHARACTERISTIC
/begin CHARACTERISTIC ETCtl_DebPoI.tiLoHi_C "Entprellzeit für Nacheinspritzung/" VALUE 0x8003996A Kw_Ws16 655.3500 Time_s -327.6800 327.6700 /end CHARACTERISTIC
/begin CHARACTERISTIC ETCtl_DebTemp.tiHiLo_C "Entprellzeit der Aktivierungsschwellen der Regelkreisen/" VALUE 0x8003996C Kw_Ws16 30.00000 Time_s 0.00 30.00000 EXTENDED_LIMITS -327.6800 327.6700 /end CHARACTERISTIC
/begin CHARACTERISTIC ETCtl_DebTemp.tiLoHi_C "Entprellzeit der Aktivierungsschwellen der Regelkreisen/" VALUE 0x8003996E Kw_Ws16 30.00000 Time_s 0.00 30.00000 EXTENDED_LIMITS -327.6800 327.6700 /end CHARACTERISTIC
/begin CHARACTERISTIC ETCtl_facKiAirMsPT_CUR "Grundwert I-Anteil des Reglereingriffs über Luftmasse" CURVE 0x800391E4 Cur_Xs16Ws16 0.06000046 ETCtlGovKi_fac 0.00 0.06000046 FORMAT "%10.8" EXTENDED_LIMITS -0.07629395 0.07629162
 /begin AXIS_DESCR STD_AXIS Epm_nEng EngN 8 0.00 10000.00 EXTENDED_LIMITS -16384.00 16383.50 DEPOSIT ABSOLUTE /end AXIS_DESCR
/end CHARACTERISTIC
/begin CHARACTERISTIC ETCtl_facKiNegInr_C "Korrekturfaktor des I-Anteil bei negativer Großsignalverstärkung - Innerer Regelkreis" VALUE 0x80039208 Val_Wu32 100.000000000 Fact1 0.00 100.000000000 EXTENDED_LIMITS 0.00 33554431.9922 /end CHARACTERISTIC
/begin CHARACTERISTIC ETCtl_facKiNegOutr_C "Korrekturfaktor des I-Anteil bei negativer Großsignalverstärkung - Äußerer Regelkreis" VALUE 0x80039998 Val_Wu32 100.000000000 Fact1 0.00 100.000000000 EXTENDED_LIMITS 0.00 33554431.9922 /end CHARACTERISTIC
/begin CHARACTERISTIC ETCtl_facKiPosInr_C "Korrekturfaktor des I-Anteil bei positiver Großsignalverstärkung - Innerer Regelkreis" VALUE 0x8003920C Val_Wu32 100.000000000 Fact1 0.00 100.000000000 EXTENDED_LIMITS 0.00 33554431.9922 /end CHARACTERISTIC
/begin CHARACTERISTIC ETCtl_facKiPosOutr_C "Korrekturfaktor des I-Anteil bei positiver Großsignalverstärkung - Äußerer Regelkreis" VALUE 0x8003999C Val_Wu32 100.000000000 Fact1 0.00 100.000000000 EXTENDED_LIMITS 0.00 33554431.9922 /end CHARACTERISTIC
/begin CHARACTERISTIC ETCtl_facKiQntPoI1_MAP "Grundwert I-Anteil des äußeren Regelkreises bei Eingriff über Einspritzung" MAP 0x800399A0 Map_Xs16Ys16Ws16 0.06000046 ETCtlGovKi_fac 0.00 0.06000046 FORMAT "%10.8" EXTENDED_LIMITS -0.07629395 0.07629162
 /begin AXIS_DESCR STD_AXIS Epm_nEng EngN 4 0.00 10000.00 EXTENDED_LIMITS -16384.00 16383.50 DEPOSIT ABSOLUTE /end AXIS_DESCR
 /begin AXIS_DESCR STD_AXIS InjCtl_qSetUnBal InjMass 4 0.00 327.6700 EXTENDED_LIMITS -327.6800 327.6700 DEPOSIT ABSOLUTE /end AXIS_DESCR
/end CHARACTERISTIC
/begin CHARACTERISTIC ETCtl_facKiQntPoI2_MAP "Grundwert I-Anteil des inneren Regelkreises bei Eingriff über Einspritzung" MAP 0x80039210 Map_Xs16Ys16Ws16 0.06000046 ETCtlGovKi_fac 0.00 0.06000046 FORMAT "%10.8" EXTENDED_LIMITS -0.07629395 0.07629162
 /begin AXIS_DESCR STD_AXIS Epm_nEng EngN 8 0.00 10000.00 EXTENDED_LIMITS -16384.00 16383.50 DEPOSIT ABSOLUTE /end AXIS_DESCR
 /begin AXIS_DESCR STD_AXIS InjCtl_qSetUnBal InjMass 8 0.00 327.6700 EXTENDED_LIMITS -327.6800 327.6700 DEPOSIT ABSOLUTE /end AXIS_DESCR
/end CHARACTERISTIC
/begin CHARACTERISTIC ETCtl_facKiTempInrCor_MAP "Grundwert I-Anteil des äußeren Regelkreises bei Eingriff über Temperatursollwert des inneren Regelkreises" MAP 0x800399D4 Map_Xs16Ys16Ws16 0.06000046 ETCtlGovKi_fac 0.00 0.06000046 FORMAT "%10.8" EXTENDED_LIMITS -0.07629395 0.07629162
 /begin AXIS_DESCR STD_AXIS Epm_nEng EngN 8 0.00 10000.00 EXTENDED_LIMITS -16384.00 16383.50 DEPOSIT ABSOLUTE /end AXIS_DESCR
 /begin AXIS_DESCR STD_AXIS InjCtl_qSetUnBal InjMass 8 0.00 327.6700 EXTENDED_LIMITS -327.6800 327.6700 DEPOSIT ABSOLUTE /end AXIS_DESCR
/end CHARACTERISTIC
/begin CHARACTERISTIC ETCtl_facKpAirMsPT_CUR "Grundwert P-Anteil des Reglereingriffs über Luftmasse" CURVE 0x800392B4 Cur_Xs16Ws16 0.06000000 ETCtlGovKp_fac 0.00 0.06000000 FORMAT "%10.8" EXTENDED_LIMITS -1.280000 1.279961
 /begin AXIS_DESCR STD_AXIS Epm_nEng EngN 8 0.00 10000.00 EXTENDED_LIMITS -16384.00 16383.50 DEPOSIT ABSOLUTE /end AXIS_DESCR
/end CHARACTERISTIC
/begin CHARACTERISTIC ETCtl_facKpNegInr_C "Korrekturfaktor des P-Anteils bei negativer Großsignalverstärkung - Innerer Regelkreis" VALUE 0x800392D8 Val_Ws32 4.00000000000 Fact1 0.00 4.00000000000 EXTENDED_LIMITS -16777216.0000 16777215.9922 /end CHARACTERISTIC
/begin CHARACTERISTIC ETCtl_facKpNegOutr_C "Korrekturfaktor des P-Anteils bei negativer Großsignalverstärkung - Äußerer Regelkreis" VALUE 0x80039A78 Val_Ws32 4.00000000000 Fact1 0.00 4.00000000000 EXTENDED_LIMITS -16777216.0000 16777215.9922 /end CHARACTERISTIC
/begin CHARACTERISTIC ETCtl_facKpPosInr_C "Korrekturfaktor des P-Anteils bei positiver Großsignalverstärkung - Innerer Regelkreis" VALUE 0x800392DC Val_Ws32 4.00000000000 Fact1 0.00 4.00000000000 EXTENDED_LIMITS -16777216.0000 16777215.9922 /end CHARACTERISTIC
/begin CHARACTERISTIC ETCtl_facKpPosOutr_C "Korrekturfaktor des P-Anteils bei positiver Großsignalverstärkung - Äußerer Regelkreis" VALUE 0x80039A7C Val_Ws32 4.00000000000 Fact1 0.00 4.00000000000 EXTENDED_LIMITS -16777216.0000 16777215.9922 /end CHARACTERISTIC
/begin CHARACTERISTIC ETCtl_facKpQntPoI1_MAP "Grundwert P-Anteil des äußeren Regelkreises bei Eingriff über Einspritzung" MAP 0x80039A80 Map_Xs16Ys16Ws16 0.06000000 ETCtlGovKp_fac 0.00 0.06000000 FORMAT "%10.8" EXTENDED_LIMITS -1.280000 1.279961
 /begin AXIS_DESCR STD_AXIS Epm_nEng EngN 4 0.00 10000.00 EXTENDED_LIMITS -16384.00 16383.50 DEPOSIT ABSOLUTE /end AXIS_DESCR
 /begin AXIS_DESCR STD_AXIS InjCtl_qSetUnBal InjMass 4 0.00 327.6700 EXTENDED_LIMITS -327.6800 327.6700 DEPOSIT ABSOLUTE /end AXIS_DESCR
/end CHARACTERISTIC
/begin CHARACTERISTIC ETCtl_facKpQntPoI2_MAP "Grundwert P-Anteil des inneren Regelkreises bei Eingriff über Einspritzung" MAP 0x800392E0 Map_Xs16Ys16Ws16 0.06000000 ETCtlGovKp_fac 0.00 0.06000000 FORMAT "%10.8" EXTENDED_LIMITS -1.280000 1.279961
 /begin AXIS_DESCR STD_AXIS Epm_nEng EngN 8 0.00 10000.00 EXTENDED_LIMITS -16384.00 16383.50 DEPOSIT ABSOLUTE /end AXIS_DESCR
 /begin AXIS_DESCR STD_AXIS InjCtl_qSetUnBal InjMass 8 0.00 327.6700 EXTENDED_LIMITS -327.6800 327.6700 DEPOSIT ABSOLUTE /end AXIS_DESCR
/end CHARACTERISTIC
/begin CHARACTERISTIC ETCtl_facKpTempInrCor_MAP "Grundwert P-Anteil des äußeren Regelkreises bei Eingriff über Temperatursollwert des inneren Regelkreises" MAP 0x80039AB4 Map_Xs16Ys16Ws16 0.06000000 ETCtlGovKp_fac 0.00 0.06000000 FORMAT "%10.8" EXTENDED_LIMITS -1.280000 1.279961
 /begin AXIS_DESCR STD_AXIS Epm_nEng EngN 8 0.00 10000.00 EXTENDED_LIMITS -16384.00 16383.50 DEPOSIT ABSOLUTE /end AXIS_DESCR
 /begin AXIS_DESCR STD_AXIS InjCtl_qSetUnBal InjMass 8 0.00 327.6700 EXTENDED_LIMITS -327.6800 327.6700 DEPOSIT ABSOLUTE /end AXIS_DESCR
/end CHARACTERISTIC
/begin CHARACTERISTIC ETCtl_facPoI2PoI1Dist_C "Anteil der vom inneren Regelkreis geforderten Menge die auf die PoI2 entfällt." VALUE 0x80039384 Val_Ws16 1.000000 ETCtlGov_p0q001 0.00 1.000000 FORMAT "%8.6" EXTENDED_LIMITS -32.76800 32.76700 /end CHARACTERISTIC
/begin CHARACTERISTIC ETCtl_mAirLam_CUR "Luftmassenkorrektur über Lambdawert" CURVE 0x80039386 Cur_Xs16Ws16 10000.00 AirMassPerCyl -5000.000 5000.000 EXTENDED_LIMITS -3276.800 3276.700
 /begin AXIS_DESCR STD_AXIS ETCtl_rLamRecExhMnfDs_mp AirMassPerCyl 8 0.00 4.000000 EXTENDED_LIMITS -3276.800 3276.700 DEPOSIT ABSOLUTE /end AXIS_DESCR
/end CHARACTERISTIC
/begin CHARACTERISTIC ETCtl_mAirMax_MAP "Maximal mögliche Luftmassensollwertkorrektur" MAP 0x800393A8 Map_Xs16Ys16Ws16 5000.000 AirMassPerCyl 0.00 5000.000 EXTENDED_LIMITS -3276.800 3276.700
 /begin AXIS_DESCR STD_AXIS Epm_nEng EngN 10 0.00 10000.00 EXTENDED_LIMITS -16384.00 16383.50 DEPOSIT ABSOLUTE /end AXIS_DESCR
 /begin AXIS_DESCR STD_AXIS InjCtl_qSetUnBal InjMass 8 0.00 327.6700 EXTENDED_LIMITS -327.6800 327.6700 DEPOSIT ABSOLUTE /end AXIS_DESCR
/end CHARACTERISTIC
/begin CHARACTERISTIC ETCtl_mAirMin_MAP "Minimal mögliche Luftmassensollwertkorrektur" MAP 0x80039470 Map_Xs16Ys16Ws16 5000.000 AirMassPerCyl -5000.000 0.00 EXTENDED_LIMITS -3276.800 3276.700
 /begin AXIS_DESCR STD_AXIS Epm_nEng EngN 10 0.00 10000.00 EXTENDED_LIMITS -16384.00 16383.50 DEPOSIT ABSOLUTE /end AXIS_DESCR
 /begin AXIS_DESCR STD_AXIS InjCtl_qSetUnBal InjMass 8 0.00 327.6700 EXTENDED_LIMITS -327.6800 327.6700 DEPOSIT ABSOLUTE /end AXIS_DESCR
/end CHARACTERISTIC
/begin CHARACTERISTIC ETCtl_mAirThresOff_C "Abschaltschwelle für Luftmassen-Eingriff" VALUE 0x80039538 Val_Ws16 5000.000 AirMassPerCyl 0.00 5000.000 EXTENDED_LIMITS -3276.800 3276.700 /end CHARACTERISTIC
/begin CHARACTERISTIC ETCtl_numTempSensOutrLp_C "Index zur Auswahl der Temperatur vor dem Partikelfilter aus dem Abgastemperaturfeld" VALUE 0x80039B58 Val_Wu8 8.000 OneToOne 0.00 8.000 EXTENDED_LIMITS 0.00 255.0 /end CHARACTERISTIC
/begin CHARACTERISTIC ETCtl_phiPoI2Cor_MAP "Additive Korrektur des Winkels der angelagerten Nacheinspritzung" MAP 0x8003953A Map_Xs16Ys16Ws16 399.9902 AngleCrS -199.9951 199.9951 EXTENDED_LIMITS -720.0000 719.9780
 /begin AXIS_DESCR STD_AXIS Epm_nEng EngN 2 0.00 10000.00 EXTENDED_LIMITS -16384.00 16383.50 DEPOSIT ABSOLUTE /end AXIS_DESCR
 /begin AXIS_DESCR STD_AXIS InjCtl_qSetUnBal InjMass 2 0.00 327.6700 EXTENDED_LIMITS -327.6800 327.6700 DEPOSIT ABSOLUTE /end AXIS_DESCR
/end CHARACTERISTIC
/begin CHARACTERISTIC ETCtl_qPoI1Max_MAP "Maximal mögliche Korrektur der angelagerten Nacheinspritzung" MAP 0x80039B5A Map_Xs16Ys16Ws16 200.0000 InjMassInj 0.00 200.0000 EXTENDED_LIMITS -327.6800 327.6700
 /begin AXIS_DESCR STD_AXIS Epm_nEng EngN 10 0.00 10000.00 EXTENDED_LIMITS -16384.00 16383.50 DEPOSIT ABSOLUTE /end AXIS_DESCR
 /begin AXIS_DESCR STD_AXIS InjCtl_qSetUnBal InjMass 10 0.00 327.6700 EXTENDED_LIMITS -327.6800 327.6700 DEPOSIT ABSOLUTE /end AXIS_DESCR
/end CHARACTERISTIC
/begin CHARACTERISTIC ETCtl_qPoI1Min_C "Minimalwert der angelagerten Nacheinspritzung" VALUE 0x80039C4E Val_Ws16 327.6700 InjMassInj 0.00 327.6700 EXTENDED_LIMITS -327.6800 327.6700 /end CHARACTERISTIC
/begin CHARACTERISTIC ETCtl_qPoI1Min_MAP "Minimal mögliche Korrektur der angelagerten Nacheinspritzung" MAP 0x80039C50 Map_Xs16Ys16Ws16 655.3500 InjMassInj -327.6800 327.6700
 /begin AXIS_DESCR STD_AXIS Epm_nEng EngN 10 -16384.00 16383.50 DEPOSIT ABSOLUTE /end AXIS_DESCR
 /begin AXIS_DESCR STD_AXIS InjCtl_qSetUnBal InjMass 10 -327.6800 327.6700 DEPOSIT ABSOLUTE /end AXIS_DESCR
/end CHARACTERISTIC
/begin CHARACTERISTIC ETCtl_qPoI1ThresOff_C "Abschaltschwelle für PoI1-Eingriff" VALUE 0x80039D44 Val_Ws16 327.6700 InjMassInj 0.00 327.6700 EXTENDED_LIMITS -327.6800 327.6700 /end CHARACTERISTIC
/begin CHARACTERISTIC ETCtl_qPoI2Max_MAP "Maximal mögliche Korrektur der späten Nacheinspritzung" MAP 0x8003954E Map_Xs16Ys16Ws16 200.0000 InjMassInj 0.00 200.0000 EXTENDED_LIMITS -327.6800 327.6700
 /begin AXIS_DESCR STD_AXIS Epm_nEng EngN 15 0.00 10000.00 EXTENDED_LIMITS -16384.00 16383.50 DEPOSIT ABSOLUTE /end AXIS_DESCR
 /begin AXIS_DESCR STD_AXIS InjCtl_qSetUnBal InjMass 15 0.00 327.6700 EXTENDED_LIMITS -327.6800 327.6700 DEPOSIT ABSOLUTE /end AXIS_DESCR
/end CHARACTERISTIC
/begin CHARACTERISTIC ETCtl_qPoI2Min_C "Untere Grenze des Basiswertkennfelds für abgastemperaturreglerbedingte Korrektur der PoI2-Menge" VALUE 0x80039750 Val_Ws16 327.6700 InjMassInj 0.00 327.6700 EXTENDED_LIMITS -327.6800 327.6700 /end CHARACTERISTIC
/begin CHARACTERISTIC ETCtl_qPoI2Min_MAP "Minimal mögliche Korrektur der späten Nacheinspritzung" MAP 0x80039752 Map_Xs16Ys16Ws16 200.0000 InjMassInj -200.0000 0.00 EXTENDED_LIMITS -327.6800 327.6700
 /begin AXIS_DESCR STD_AXIS Epm_nEng EngN 15 0.00 10000.00 EXTENDED_LIMITS -16384.00 16383.50 DEPOSIT ABSOLUTE /end AXIS_DESCR
 /begin AXIS_DESCR STD_AXIS InjCtl_qSetUnBal InjMass 15 0.00 327.6700 EXTENDED_LIMITS -327.6800 327.6700 DEPOSIT ABSOLUTE /end AXIS_DESCR
/end CHARACTERISTIC
/begin CHARACTERISTIC ETCtl_qPoI2ThresOff_C "Abschaltschwelle für PoI2-Eingriff" VALUE 0x80039954 Val_Ws16 327.6700 InjMassInj 0.00 327.6700 EXTENDED_LIMITS -327.6800 327.6700 /end CHARACTERISTIC
/begin CHARACTERISTIC ETCtl_stMskClsThrVlv_C "Bitmaske Anforderung maximale Androsselung" VALUE 0x80039958 Val_Wu32 4294967295.00 OneToOne 0.00 4294967295.00 /end CHARACTERISTIC
/begin CHARACTERISTIC ETCtl_stMskInr_CA "Maske Aktivierung innerer Regelkreis" VAL_BLK 0x80039970 ValA_Wu32 4294967295.00 OneToOne 0.00 4294967295.00 NUMBER 2 /end CHARACTERISTIC
/begin CHARACTERISTIC ETCtl_stMskNSC_C "Maske Aktivierung der Regeneration des NOx-Speicherkatalysators" VALUE 0x80039978 Val_Wu32 4294967295.00 OneToOne 0.00 4294967295.00 /end CHARACTERISTIC
/begin CHARACTERISTIC ETCtl_stMskOutr_CA "Maske Aktivierung äußerer Regelkreis" VAL_BLK 0x8003997C ValA_Wu32 4294967295.00 OneToOne 0.00 4294967295.00 NUMBER 2 /end CHARACTERISTIC
/begin CHARACTERISTIC ETCtl_swtActv_C "Status Funktionalität des Abgastemperaturreglers aktiv" VALUE 0x800391E0 Val_Wu8 1.000 OneToOne 0.00 1.000 EXTENDED_LIMITS 0.00 255.0 /end CHARACTERISTIC
/begin CHARACTERISTIC ETCtl_swtPoI2PoI1Dist_C "Aktivierung Durchgriff des inneren Regelkreises auf PoI1" VALUE 0x8003995C Val_Wu8 1.000 OneToOne 0.00 1.000 EXTENDED_LIMITS 0.00 255.0 /end CHARACTERISTIC
/begin CHARACTERISTIC ETCtl_tInrCorMax_MAP "Maximal erlaubte Sollwertkorrektur des inneren Regelkreises" MAP 0x80039D46 Map_Xs16Ys16Ws16 1600.000 TempDiff_Kelv -100.0000 1500.000 EXTENDED_LIMITS -3276.800 3276.700
 /begin AXIS_DESCR STD_AXIS Epm_nEng EngN 8 0.00 10000.00 EXTENDED_LIMITS -16384.00 16383.50 DEPOSIT ABSOLUTE /end AXIS_DESCR
 /begin AXIS_DESCR STD_AXIS InjCtl_qSetUnBal InjMass 10 0.00 327.6700 EXTENDED_LIMITS -327.6800 327.6700 DEPOSIT ABSOLUTE /end AXIS_DESCR
/end CHARACTERISTIC
/begin CHARACTERISTIC ETCtl_tInrCorMin_MAP "Minimal erlaubte Sollwertkorrektur des inneren Regelkreises" MAP 0x80039E0E Map_Xs16Ys16Ws16 1500.000 TempDiff_Kelv -1500.000 0.00 EXTENDED_LIMITS -3276.800 3276.700
 /begin AXIS_DESCR STD_AXIS Epm_nEng EngN 8 0.00 10000.00 EXTENDED_LIMITS -16384.00 16383.50 DEPOSIT ABSOLUTE /end AXIS_DESCR
 /begin AXIS_DESCR STD_AXIS InjCtl_qSetUnBal InjMass 10 0.00 327.6700 EXTENDED_LIMITS -327.6800 327.6700 DEPOSIT ABSOLUTE /end AXIS_DESCR
/end CHARACTERISTIC
/begin CHARACTERISTIC ETCtl_tInrCorThresOff_C "Abschaltschwelle für Sollwert-Eingriff" VALUE 0x80039ED6 Val_Ws16 6553.500 TempDiff_Kelv -3276.800 3276.700 /end CHARACTERISTIC
/begin CHARACTERISTIC ETCtl_tInrDvtMax_C "Maximale Regelabweichung des inneren Regelkreises für die Überwachung auf permanente Regelabweichung" VALUE 0x80039984 Val_Ws16 1000.000 TempDiff_Kelv -500.0000 500.0000 EXTENDED_LIMITS -3276.800 3276.700 /end CHARACTERISTIC
/begin CHARACTERISTIC ETCtl_tInrDvtMin_C "Minimale Regelabweichung des inneren Regelkreises für die Überwachung auf permanente Regelabweichung" VALUE 0x80039986 Val_Ws16 1000.000 TempDiff_Kelv -500.0000 500.0000 EXTENDED_LIMITS -3276.800 3276.700 /end CHARACTERISTIC
/begin CHARACTERISTIC ETCtl_tInrThresDwn_C "Untere Temperaturschwelle des inneren Regelkreises" VALUE 0x80039988 Val_Ws16 1500.000 Temp_Cels -0.04000000 1499.960 EXTENDED_LIMITS -3549.940 3003.560 /end CHARACTERISTIC
/begin CHARACTERISTIC ETCtl_tInrThresUp_C "Obere Temperaturschwelle des inneren Regelkreises" VALUE 0x8003998A Val_Ws16 1500.000 Temp_Cels -0.04000000 1499.960 EXTENDED_LIMITS -3549.940 3003.560 /end CHARACTERISTIC
/begin CHARACTERISTIC ETCtl_tiPoI1Cor_MAP "Zusätzliche Zeitkorrektur der nach hinten verlagerten Nacheinspritzung" MAP 0x80039ED8 Map_Xs16Ys16Ws16 5200.0000 InjTime_us -200.0000 5000.0000 EXTENDED_LIMITS -13107.20 13106.80
 /begin AXIS_DESCR STD_AXIS Epm_nEng EngN 2 0.00 10000.00 EXTENDED_LIMITS -16384.00 16383.50 DEPOSIT ABSOLUTE /end AXIS_DESCR
 /begin AXIS_DESCR STD_AXIS InjCtl_qSetUnBal InjMass 2 0.00 327.6700 EXTENDED_LIMITS -327.6800 327.6700 DEPOSIT ABSOLUTE /end AXIS_DESCR
/end CHARACTERISTIC
/begin CHARACTERISTIC ETCtl_tiRmpInr_C "Steigung der Rampe für die Regelabweichung des inneren Regelkreises" VALUE 0x80039960 Val_Wu32 31.775030303030302 ETCtlGovRmp 0.992969696969697 32.768000000000001 FORMAT "%19.16" EXTENDED_LIMITS 0.000000015258789 65.536000000000001 /end CHARACTERISTIC
/begin CHARACTERISTIC ETCtl_tiRmpOutr_C "Steigung der Rampe für die Regelabweichung des äußeren Regelkreises" VALUE 0x80039EEC Val_Wu32 31.775030303030302 ETCtlGovRmp 0.992969696969697 32.768000000000001 FORMAT "%19.16" EXTENDED_LIMITS 0.000000015258789 65.536000000000001 /end CHARACTERISTIC
/begin CHARACTERISTIC ETCtl_tOutrDvtMax_C "Maximale Regelabweichung des äußeren Regelkreises für die Überwachung auf permanente Regelabweichung" VALUE 0x8003998C Val_Ws16 1000.000 TempDiff_Kelv -500.0000 500.0000 EXTENDED_LIMITS -3276.800 3276.700 /end CHARACTERISTIC
/begin CHARACTERISTIC ETCtl_tOutrDvtMin_C "Minimale Regelabweichung des äußeren Regelkreises für die Überwachung auf permanente Regelabweichung" VALUE 0x8003998E Val_Ws16 1000.000 TempDiff_Kelv -500.0000 500.0000 EXTENDED_LIMITS -3276.800 3276.700 /end CHARACTERISTIC
/begin CHARACTERISTIC ETCtl_tOutrThresDwn_C "Untere Temperaturschwelle des äußeren Regelkreises" VALUE 0x80039990 Val_Ws16 1500.000 Temp_Cels -0.04000000 1499.960 EXTENDED_LIMITS -3549.940 3003.560 /end CHARACTERISTIC
/begin CHARACTERISTIC ETCtl_tOutrThresUp_C "Obere Temperaturschwelle des äußeren Regelkreises" VALUE 0x80039992 Val_Ws16 1500.000 Temp_Cels -0.04000000 1499.960 EXTENDED_LIMITS -3549.940 3003.560 /end CHARACTERISTIC
/begin CHARACTERISTIC ETCtl_tOxiCatUsThresBrn_C "Untere Schwelle Temperatur vor Oxidationskatalysator des äußeren Regelkreises" VALUE 0x80039994 Val_Ws16 1500.000 Temp_Cels -0.04000000 1499.960 EXTENDED_LIMITS -3549.940 3003.560 /end CHARACTERISTIC
/begin CHARACTERISTIC ETCtl_tWinNegInr_C "Negative Großsignalverstärkungsschwelle innerer Regler" VALUE 0x80039964 Val_Ws16 2000.000 TempDiff_Kelv -1000.000 1000.000 EXTENDED_LIMITS -3276.800 3276.700 /end CHARACTERISTIC
/begin CHARACTERISTIC ETCtl_tWinNegOutr_C "Negative Großsignalverstärkungsschwelle äußerer Regler" VALUE 0x80039EF0 Val_Ws16 6553.500 TempDiff_Kelv -3276.800 3276.700 /end CHARACTERISTIC
/begin CHARACTERISTIC ETCtl_tWinPosInr_C "Positive Großsignalverstärkungsschwelle innerer Regler" VALUE 0x80039966 Val_Ws16 2000.000 TempDiff_Kelv -1000.000 1000.000 EXTENDED_LIMITS -3276.800 3276.700 /end CHARACTERISTIC
/begin CHARACTERISTIC ETCtl_tWinPosOutr_C "Positive Großsignalverstärkungsschwelle äußerer Regler" VALUE 0x80039EF2 Val_Ws16 1100.000 TempDiff_Kelv -100.0000 1000.000 EXTENDED_LIMITS -3276.800 3276.700 /end CHARACTERISTIC
/begin CHARACTERISTIC Exh_nChkTrgExhTMon_C "" VALUE 0x8003B44C Val_Ws16 32767.50 EngN -16384.00 16383.50 /end CHARACTERISTIC
/begin CHARACTERISTIC Exh_numSimTempPos1_C "" VALUE 0x8003B44E Val_Wu8 255.0 OneToOne 0.00 255.0 /end CHARACTERISTIC
/begin CHARACTERISTIC Exh_numSimTempPos2_C "" VALUE 0x8003B44F Val_Wu8 255.0 OneToOne 0.00 255.0 /end CHARACTERISTIC
/begin CHARACTERISTIC Exh_numSimTempPos3_C "" VALUE 0x8003B450 Val_Wu8 255.0 OneToOne 0.00 255.0 /end CHARACTERISTIC
/begin CHARACTERISTIC Exh_numTempEngMon_C "" VALUE 0x8003B451 Val_Wu8 255.0 OneToOne 0.00 255.0 /end CHARACTERISTIC
/begin CHARACTERISTIC Exh_numTempPos1_C "" VALUE 0x8003B452 Val_Wu8 255.0 OneToOne 0.00 255.0 /end CHARACTERISTIC
/begin CHARACTERISTIC Exh_numTempPos2_C "" VALUE 0x8003B453 Val_Wu8 255.0 OneToOne 0.00 255.0 /end CHARACTERISTIC
/begin CHARACTERISTIC Exh_numTempPos3_C "" VALUE 0x8003B454 Val_Wu8 255.0 OneToOne 0.00 255.0 /end CHARACTERISTIC
/begin CHARACTERISTIC Exh_numTempSens_C "" VALUE 0x8003B455 Val_Wu8 255.0 OneToOne 0.00 255.0 /end CHARACTERISTIC
/begin CHARACTERISTIC Exh_numTempStyChk_C "" VALUE 0x8003B456 Val_Wu8 255.0 OneToOne 0.00 255.0 /end CHARACTERISTIC
/begin CHARACTERISTIC Exh_pMinNmrCldStrt_C "" VALUE 0x8003B458 Val_Ws16 36268.00 Pres_hPa -32768.00 3500.00 EXTENDED_LIMITS -32768.00 32767.00 /end CHARACTERISTIC
/begin CHARACTERISTIC Exh_stMskLckNplExhTMon_C "" VALUE 0x8003B45C Val_Wu32 4294967295.00 OneToOne 0.00 4294967295.00 /end CHARACTERISTIC
/begin CHARACTERISTIC Exh_stPresDevPrs_C "" VALUE 0x8003B5BC Val_Wu8 255.0 OneToOne 0.00 255.0 /end CHARACTERISTIC
/begin CHARACTERISTIC Exh_stTempDevPrs_C "" VALUE 0x8003B5BD Val_Wu8 255.0 OneToOne 0.00 255.0 /end CHARACTERISTIC
/begin CHARACTERISTIC Exh_swtEngOffTmr_C "" VALUE 0x8003B460 Val_Wu8 255.0 OneToOne 0.00 255.0 /end CHARACTERISTIC
/begin CHARACTERISTIC Exh_swtEnvTSensPrs_C "" VALUE 0x8003B461 Val_Wu8 255.0 OneToOne 0.00 255.0 /end CHARACTERISTIC
/begin CHARACTERISTIC Exh_swtStyCondExhTMon_C "" VALUE 0x8003B462 Val_Wu8 255.0 OneToOne 0.00 255.0 /end CHARACTERISTIC
/begin CHARACTERISTIC Exh_tCldStrtExhTMonDfl_C "" VALUE 0x8003B464 Val_Ws16 6553.500 Temp_Cels -3549.940 3003.560 /end CHARACTERISTIC
/begin CHARACTERISTIC Exh_tDiffCldExhTMonMax_C "" VALUE 0x8003B466 Val_Ws16 6553.500 TempDiff_Kelv -3276.800 3276.700 /end CHARACTERISTIC
/begin CHARACTERISTIC Exh_tDiffNgvExhTMon1_CUR "" CURVE 0x8003B468 Cur_Xs16Ws16 6553.500 TempDiff_Kelv -3276.800 3276.700
 /begin AXIS_DESCR STD_AXIS Exh_tSim1Fld_mp Temp_Cels 4 -3549.940 3003.560 DEPOSIT ABSOLUTE /end AXIS_DESCR
/end CHARACTERISTIC
/begin CHARACTERISTIC Exh_tDiffNgvExhTMon2_CUR "" CURVE 0x8003B47A Cur_Xs16Ws16 6553.500 TempDiff_Kelv -3276.800 3276.700
 /begin AXIS_DESCR STD_AXIS Exh_tSim2Fld_mp Temp_Cels 4 -3549.940 3003.560 DEPOSIT ABSOLUTE /end AXIS_DESCR
/end CHARACTERISTIC
/begin CHARACTERISTIC Exh_tDiffNgvExhTMon3_CUR "" CURVE 0x8003B48C Cur_Xs16Ws16 6553.500 TempDiff_Kelv -3276.800 3276.700
 /begin AXIS_DESCR STD_AXIS Exh_tSim3Fld_mp Temp_Cels 4 -3549.940 3003.560 DEPOSIT ABSOLUTE /end AXIS_DESCR
/end CHARACTERISTIC
/begin CHARACTERISTIC Exh_tDiffPsvExhTMon1_CUR "" CURVE 0x8003B49E Cur_Xs16Ws16 6553.500 TempDiff_Kelv -3276.800 3276.700
 /begin AXIS_DESCR STD_AXIS Exh_tSim1Fld_mp Temp_Cels 4 -3549.940 3003.560 DEPOSIT ABSOLUTE /end AXIS_DESCR
/end CHARACTERISTIC
/begin CHARACTERISTIC Exh_tDiffPsvExhTMon2_CUR "" CURVE 0x8003B4B0 Cur_Xs16Ws16 6553.500 TempDiff_Kelv -3276.800 3276.700
 /begin AXIS_DESCR STD_AXIS Exh_tSim2Fld_mp Temp_Cels 4 -3549.940 3003.560 DEPOSIT ABSOLUTE /end AXIS_DESCR
/end CHARACTERISTIC
/begin CHARACTERISTIC Exh_tDiffPsvExhTMon3_CUR "" CURVE 0x8003B4C2 Cur_Xs16Ws16 6553.500 TempDiff_Kelv -3276.800 3276.700
 /begin AXIS_DESCR STD_AXIS Exh_tSim3Fld_mp Temp_Cels 4 -3549.940 3003.560 DEPOSIT ABSOLUTE /end AXIS_DESCR
/end CHARACTERISTIC
/begin CHARACTERISTIC Exh_tExhTMon1TolcMax_CUR "" CURVE 0x8003B4D4 Cur_Xs16Ws16 6553.500 TempDiff_Kelv -3276.800 3276.700
 /begin AXIS_DESCR STD_AXIS EngDa_tiEngOff TimeEngOn 8 -2147483648.00 2147483647.00 FORMAT "%13.2" DEPOSIT ABSOLUTE /end AXIS_DESCR
/end CHARACTERISTIC
/begin CHARACTERISTIC Exh_tExhTMon2TolcMax_CUR "" CURVE 0x8003B4F6 Cur_Xs16Ws16 6553.500 TempDiff_Kelv -3276.800 3276.700
 /begin AXIS_DESCR STD_AXIS EngDa_tiEngOff TimeEngOn 8 -2147483648.00 2147483647.00 FORMAT "%13.2" DEPOSIT ABSOLUTE /end AXIS_DESCR
/end CHARACTERISTIC
/begin CHARACTERISTIC Exh_tExhTMon3TolcMax_CUR "" CURVE 0x8003B518 Cur_Xs16Ws16 6553.500 TempDiff_Kelv -3276.800 3276.700
 /begin AXIS_DESCR STD_AXIS EngDa_tiEngOff TimeEngOn 8 -2147483648.00 2147483647.00 FORMAT "%13.2" DEPOSIT ABSOLUTE /end AXIS_DESCR
/end CHARACTERISTIC
/begin CHARACTERISTIC Exh_tExhTMonMaxVar_C "" VALUE 0x8003B53A Val_Ws16 6553.500 TempDiff_Kelv -3276.800 3276.700 /end CHARACTERISTIC
/begin CHARACTERISTIC Exh_tiChkTempPlausMax_CUR "" CURVE 0x8003B53C Cur_Xs16Ws16 655.3500 Time_s -327.6800 327.6700
 /begin AXIS_DESCR STD_AXIS BattU_u Volt_Batt 25 -655360.0 655340.0 DEPOSIT ABSOLUTE /end AXIS_DESCR
/end CHARACTERISTIC
/begin CHARACTERISTIC Exh_tiLckChkTempPlaus_C "" VALUE 0x8003B5A4 Val_Ws32 42949672.9500 Time_s -21474836.4800 21474836.4700 /end CHARACTERISTIC
/begin CHARACTERISTIC Exh_tiLckPlausRgnExhTMon_C "" VALUE 0x8003B5A8 Val_Ws16 655.3500 Time_s -327.6800 327.6700 /end CHARACTERISTIC
/begin CHARACTERISTIC Exh_tiLckStrtExhTMon_C "" VALUE 0x8003B5AA Val_Ws16 655.3500 Time_s -327.6800 327.6700 /end CHARACTERISTIC
/begin CHARACTERISTIC Exh_tiMinSnceStop_C "" VALUE 0x8003B5AC Val_Ws16 65535.00 Time_Min_One2One -32768.00 32767.00 FORMAT "%8.2" /end CHARACTERISTIC
/begin CHARACTERISTIC Exh_tIncrExhTMon1_C "" VALUE 0x8003B5AE Val_Ws16 6553.500 TempDiff_Kelv -3276.800 3276.700 /end CHARACTERISTIC
/begin CHARACTERISTIC Exh_tIncrExhTMon2_C "" VALUE 0x8003B5B0 Val_Ws16 6553.500 TempDiff_Kelv -3276.800 3276.700 /end CHARACTERISTIC
/begin CHARACTERISTIC Exh_tIncrExhTMon3_C "" VALUE 0x8003B5B2 Val_Ws16 6553.500 TempDiff_Kelv -3276.800 3276.700 /end CHARACTERISTIC
/begin CHARACTERISTIC Exh_tiTempStyChk_C "" VALUE 0x8003B5B4 Val_Ws16 655.3500 Time_s -327.6800 327.6700 /end CHARACTERISTIC
/begin CHARACTERISTIC Exh_tMaxExhTMon_C "" VALUE 0x8003B5B6 Val_Ws16 6553.500 Temp_Cels -3549.940 3003.560 /end CHARACTERISTIC
/begin CHARACTERISTIC Exh_tMinExhTMon_C "" VALUE 0x8003B5B8 Val_Ws16 6553.500 Temp_Cels -3549.940 3003.560 /end CHARACTERISTIC
/begin CHARACTERISTIC Exh_tUnLckTempPlaus_C "" VALUE 0x8003B5BA Val_Ws16 6553.500 Temp_Cels -3549.940 3003.560 /end CHARACTERISTIC
/begin CHARACTERISTIC FanCtl_dcycAftRun_C "TV für 10Hz Nachlauf" VALUE 0x8003B914 Val_Ws16 100.0000 DtyCyc 0.00 100.0000 EXTENDED_LIMITS -327.6800 327.6700 /end CHARACTERISTIC
/begin CHARACTERISTIC FanCtl_dcycHysDelta_C "Hystereseschwelle" VALUE 0x8003B916 Val_Ws16 100.0000 DtyCyc 0.00 100.0000 EXTENDED_LIMITS -327.6800 327.6700 /end CHARACTERISTIC
/begin CHARACTERISTIC FanCtl_dcycMax_C "Maximalwert" VALUE 0x8003B918 Val_Ws16 100.0000 DtyCyc 0.00 100.0000 EXTENDED_LIMITS -327.6800 327.6700 /end CHARACTERISTIC
/begin CHARACTERISTIC FanCtl_dcycMinOff_C "Minimumwert, ""Lüfter aus""" VALUE 0x8003B91A Val_Ws16 100.0000 DtyCyc 0.00 100.0000 EXTENDED_LIMITS -327.6800 327.6700 /end CHARACTERISTIC
/begin CHARACTERISTIC FanCtl_dcycSwtLimOff_C "Schwelle für Erkennung ""Lüfter aus""" VALUE 0x8003B91C Val_Ws16 100.0000 DtyCyc 0.00 100.0000 EXTENDED_LIMITS -327.6800 327.6700 /end CHARACTERISTIC
/begin CHARACTERISTIC FanCtl_dcycSwtLimOn_C "Schwelle für Erkennung ""Lüfter ein""" VALUE 0x8003B91E Val_Ws16 100.0000 DtyCyc 0.00 100.0000 EXTENDED_LIMITS -327.6800 327.6700 /end CHARACTERISTIC
/begin CHARACTERISTIC FanCtl_dcyc_CUR "Umrechnungs-KL, Drehzahl / Tastverhältnis" CURVE 0x8003B920 Cur_Xs16Ws16 100.0000 DtyCyc 0.00 100.0000 EXTENDED_LIMITS -327.6800 327.6700
 /begin AXIS_DESCR STD_AXIS FanCtl_nSetPoint FanSpd 4 0.00 3000.000 FORMAT "%8.3" EXTENDED_LIMITS -3000.092 3000.000 DEPOSIT ABSOLUTE /end AXIS_DESCR
/end CHARACTERISTIC
/begin CHARACTERISTIC FanCtl_facCorErr_C "" VALUE 0x8003B932 Val_Ws16 799.9878 Prc -400.0000 399.9878 /end CHARACTERISTIC
/begin CHARACTERISTIC FanCtl_facWghFctr_CUR "Gewichtungskennlinie Fahrgeschwindigkeit" CURVE 0x8003B934 Cur_Xs16Ws16 10.00000 Fact 0.00 10.00000 EXTENDED_LIMITS -4.000000 3.999878
 /begin AXIS_DESCR STD_AXIS GlbDa_vX Vel 4 0.00 300.0000 EXTENDED_LIMITS -327.6800 327.6700 DEPOSIT ABSOLUTE /end AXIS_DESCR
/end CHARACTERISTIC
/begin CHARACTERISTIC FanCtl_nEFanACDem_CUR "" CURVE 0x8003B946 Cur_Xs16Ws16 3000.000 FanSpd 0.00 3000.000 FORMAT "%8.3" EXTENDED_LIMITS -3000.092 3000.000
 /begin AXIS_DESCR STD_AXIS Com_rACFanDem Prc 10 -400.0000 399.9878 DEPOSIT ABSOLUTE /end AXIS_DESCR
/end CHARACTERISTIC
/begin CHARACTERISTIC FanCtl_nEFanDfl_C "" VALUE 0x8003B970 Val_Ws16 3000.000 FanSpd 0.00 3000.000 FORMAT "%8.3" EXTENDED_LIMITS -3000.092 3000.000 /end CHARACTERISTIC
/begin CHARACTERISTIC FanCtl_nEFan_CUR "" CURVE 0x8003B972 Cur_Xs16Ws16 3000.000 FanSpd 0.00 3000.000 FORMAT "%8.3" EXTENDED_LIMITS -3000.092 3000.000
 /begin AXIS_DESCR STD_AXIS Com_stStgEFan OneToOne 4 0.00 15.00 EXTENDED_LIMITS 0.00 255.0 DEPOSIT ABSOLUTE /end AXIS_DESCR
/end CHARACTERISTIC
/begin CHARACTERISTIC FanCtl_nMin_C "Drehzahlschwelle für ""Lüfter ein""" VALUE 0x8003B984 Val_Ws16 5960.000 EngN 40.00000 6000.000 EXTENDED_LIMITS -16384.00 16383.50 /end CHARACTERISTIC
/begin CHARACTERISTIC FanCtl_nOvrTemp_C "" VALUE 0x8003B986 Val_Ws16 9980.000 EngN 20.00000 10000.00 EXTENDED_LIMITS -16384.00 16383.50 /end CHARACTERISTIC
/begin CHARACTERISTIC FanCtl_nSetGbxOil_MAP "Sollwert-Kennfeld, Getriebeöltemp. abhängig" MAP 0x8003B988 Map_Xs16Ys16Ws16 3000.000 FanSpd 0.00 3000.000 FORMAT "%8.3" EXTENDED_LIMITS -3000.092 3000.000
 /begin AXIS_DESCR STD_AXIS GlbDa_vX Vel 4 0.00 300.0000 EXTENDED_LIMITS -327.6800 327.6700 DEPOSIT ABSOLUTE /end AXIS_DESCR
 /begin AXIS_DESCR STD_AXIS FanCtl_tGbxOil_mp Temp_Cels 8 -50.04000 149.8600 EXTENDED_LIMITS -3549.940 3003.560 DEPOSIT ABSOLUTE /end AXIS_DESCR
/end CHARACTERISTIC
/begin CHARACTERISTIC FanCtl_nSetPntTrailer_MAP "" MAP 0x8003B9E4 Map_Xs16Ys16Ws16 3000.000 FanSpd 0.00 3000.000 FORMAT "%8.3" EXTENDED_LIMITS -3000.092 3000.000
 /begin AXIS_DESCR STD_AXIS GlbDa_vX Vel 8 0.00 300.0000 EXTENDED_LIMITS -327.6800 327.6700 DEPOSIT ABSOLUTE /end AXIS_DESCR
 /begin AXIS_DESCR STD_AXIS FanCtl_tClnt_mp Temp_Cels 10 -50.54000 149.8600 EXTENDED_LIMITS -3549.940 3003.560 DEPOSIT ABSOLUTE /end AXIS_DESCR
/end CHARACTERISTIC
/begin CHARACTERISTIC FanCtl_nSetPnt_MAP "Sollwert-Kennfeld, Kühlmitteltemp. abhängig" MAP 0x8003BAAC Map_Xs16Ys16Ws16 3000.000 FanSpd 0.00 3000.000 FORMAT "%8.3" EXTENDED_LIMITS -3000.092 3000.000
 /begin AXIS_DESCR STD_AXIS GlbDa_vX Vel 4 0.00 300.0000 EXTENDED_LIMITS -327.6800 327.6700 DEPOSIT ABSOLUTE /end AXIS_DESCR
 /begin AXIS_DESCR STD_AXIS FanCtl_tClnt_mp Temp_Cels 10 -50.54000 149.8600 EXTENDED_LIMITS -3549.940 3003.560 DEPOSIT ABSOLUTE /end AXIS_DESCR
/end CHARACTERISTIC
/begin CHARACTERISTIC FanCtl_nSetPointFanOn_C "Drehzahl Vorgabewert des Lüfters für hohe Lenköltemperaturen" VALUE 0x8003BB1C Val_Ws16 3050.539 FanSpd -50.53865 3000.000 FORMAT "%8.3" EXTENDED_LIMITS -3000.092 3000.000 /end CHARACTERISTIC
/begin CHARACTERISTIC FanCtl_nSpd2Win1L_C "" VALUE 0x8003BB1E Val_Ws16 32767.50 EngN -16384.00 16383.50 /end CHARACTERISTIC
/begin CHARACTERISTIC FanCtl_nSpd2Win1R_C "" VALUE 0x8003BB20 Val_Ws16 32767.50 EngN -16384.00 16383.50 /end CHARACTERISTIC
/begin CHARACTERISTIC FanCtl_nSpd2Win2L_C "" VALUE 0x8003BB22 Val_Ws16 32767.50 EngN -16384.00 16383.50 /end CHARACTERISTIC
/begin CHARACTERISTIC FanCtl_nSpd2Win2R_C "" VALUE 0x8003BB24 Val_Ws16 32767.50 EngN -16384.00 16383.50 /end CHARACTERISTIC
/begin CHARACTERISTIC FanCtl_nSpd2Win3L_C "" VALUE 0x8003BB26 Val_Ws16 32767.50 EngN -16384.00 16383.50 /end CHARACTERISTIC
/begin CHARACTERISTIC FanCtl_nSpd2Win3R_C "" VALUE 0x8003BB28 Val_Ws16 32767.50 EngN -16384.00 16383.50 /end CHARACTERISTIC
/begin CHARACTERISTIC FanCtl_nSpdWin1L_C "" VALUE 0x8003BB2A Val_Ws16 32767.50 EngN -16384.00 16383.50 /end CHARACTERISTIC
/begin CHARACTERISTIC FanCtl_nSpdWin1R_C "" VALUE 0x8003BB2C Val_Ws16 32767.50 EngN -16384.00 16383.50 /end CHARACTERISTIC
/begin CHARACTERISTIC FanCtl_nSpdWin2L_C "" VALUE 0x8003BB2E Val_Ws16 32767.50 EngN -16384.00 16383.50 /end CHARACTERISTIC
/begin CHARACTERISTIC FanCtl_nSpdWin2R_C "" VALUE 0x8003BB30 Val_Ws16 32767.50 EngN -16384.00 16383.50 /end CHARACTERISTIC
/begin CHARACTERISTIC FanCtl_nSpdWin3L_C "" VALUE 0x8003BB32 Val_Ws16 32767.50 EngN -16384.00 16383.50 /end CHARACTERISTIC
/begin CHARACTERISTIC FanCtl_nSpdWin3R_C "" VALUE 0x8003BB34 Val_Ws16 32767.50 EngN -16384.00 16383.50 /end CHARACTERISTIC
/begin CHARACTERISTIC FanCtl_stEOMMSK1_C "" VALUE 0x8003BB38 Val_Wu32 2147483647.00 OneToOne 0.00 2147483647.00 EXTENDED_LIMITS 0.00 4294967295.00 /end CHARACTERISTIC
/begin CHARACTERISTIC FanCtl_stEOMMSK2_C "" VALUE 0x8003BB3C Val_Wu32 2147483647.00 OneToOne 0.00 2147483647.00 EXTENDED_LIMITS 0.00 4294967295.00 /end CHARACTERISTIC
/begin CHARACTERISTIC FanCtl_stEOMMSK3_C "" VALUE 0x8003BB40 Val_Wu32 2147483647.00 OneToOne 0.00 2147483647.00 EXTENDED_LIMITS 0.00 4294967295.00 /end CHARACTERISTIC
/begin CHARACTERISTIC FanCtl_stRgnTst_C "" VALUE 0x8003BB44 Val_Wu8 1.000 OneToOne 0.00 1.000 EXTENDED_LIMITS 0.00 255.0 /end CHARACTERISTIC
/begin CHARACTERISTIC FanCtl_stTrailerErr_C "Default-Wert bei Ausfall des Anhängers" VALUE 0x8003BB45 Val_Wu8 255.0 OneToOne 0.00 255.0 /end CHARACTERISTIC
/begin CHARACTERISTIC FanCtl_swtBattCor_C "Schalter zur Aktivierung Ubatt Korrektur (0...aus / 1...ein)" VALUE 0x8003BB46 Val_Ws16 1.000000 OneToOne 0.00 1.000000 EXTENDED_LIMITS -32768.00 32767.00 /end CHARACTERISTIC
/begin CHARACTERISTIC FanCtl_swtRgnTst_C "" VALUE 0x8003BB48 Val_Wu8 1.000 OneToOne 0.00 1.000 EXTENDED_LIMITS 0.00 255.0 /end CHARACTERISTIC
/begin CHARACTERISTIC FanCtl_tClntDfl_C "Kühlmitteltemp. Ersatzwert" VALUE 0x8003BB4A Val_Ws16 200.0000 Temp_Cels -50.14000 149.8600 EXTENDED_LIMITS -3549.940 3003.560 /end CHARACTERISTIC
/begin CHARACTERISTIC FanCtl_tEngAftRunThres_C "Motortemp. Schwelle für 10Hz Nachlauf" VALUE 0x8003BB4C Val_Ws16 250.0000 Temp_Cels -50.14000 199.8600 EXTENDED_LIMITS -3549.940 3003.560 /end CHARACTERISTIC
/begin CHARACTERISTIC FanCtl_tEnvThres_C "" VALUE 0x8003BB4E Val_Ws16 250.0000 Temp_Cels -50.14000 199.8600 EXTENDED_LIMITS -3549.940 3003.560 /end CHARACTERISTIC
/begin CHARACTERISTIC FanCtl_tGbxOilDfl_C "Getriebeöltemp. Ersatzwert" VALUE 0x8003BB50 Val_Ws16 250.0000 Temp_Cels -50.04000 199.9600 EXTENDED_LIMITS -3549.940 3003.560 /end CHARACTERISTIC
/begin CHARACTERISTIC FanCtl_tiDebRgnActv_C "" VALUE 0x8003BB52 Val_Wu16 600000.0 TimeDeb 0.00 600000.0 EXTENDED_LIMITS 0.00 655350.0 /end CHARACTERISTIC
/begin CHARACTERISTIC FanCtl_tiMinAftRunOfs_C "neg. Offset zur min. SG-Nachlaufzeit" VALUE 0x8003BB54 Val_Wu16 60000.00 Time_ms 0.00 60000.00 EXTENDED_LIMITS 0.00 655350.0 /end CHARACTERISTIC
/begin CHARACTERISTIC FanCtl_tiOvrTempOn_C "" VALUE 0x8003BB56 Val_Ws16 327.6700 Time_s 0.00 327.6700 EXTENDED_LIMITS -327.6800 327.6700 /end CHARACTERISTIC
/begin CHARACTERISTIC FanCtl_tiOvrTempReset_C "" VALUE 0x8003BB58 Val_Wu32 42949672.9500 Time_s 0.00 42949672.9500 /end CHARACTERISTIC
/begin CHARACTERISTIC FanCtl_uBattRef_C "Batteriespannungs, Referenzwert" VALUE 0x8003BB5C Val_Ws16 28600.00 Volt_Batt 0.00 28600.00 EXTENDED_LIMITS -655360.0 655340.0 /end CHARACTERISTIC
/begin CHARACTERISTIC Fan_4WinDiagDeb.ct4WinErr1DebDef_C "/" VALUE 0x8003BB60 Kw_Wu8 255.0 OneToOne 0.00 255.0 /end CHARACTERISTIC
/begin CHARACTERISTIC Fan_4WinDiagDeb.ct4WinErr2DebDef_C "/" VALUE 0x8003BB61 Kw_Wu8 255.0 OneToOne 0.00 255.0 /end CHARACTERISTIC
/begin CHARACTERISTIC Fan_4WinDiagDeb.ct4WinErr3DebDef_C "/" VALUE 0x8003BB62 Kw_Wu8 255.0 OneToOne 0.00 255.0 /end CHARACTERISTIC
/begin CHARACTERISTIC Fan_4WinDiagDeb.ct4WinErr4DebDef_C "/" VALUE 0x8003BB63 Kw_Wu8 255.0 OneToOne 0.00 255.0 /end CHARACTERISTIC
/begin CHARACTERISTIC Fan_4WinDiagDeb.ti4WinErrDebDef_C "/" VALUE 0x8003BB64 Kw_Wu16 655350.0 Time_ms 0.00 655350.0 /end CHARACTERISTIC
/begin CHARACTERISTIC Fan_4WinSigDur.tiErr1Min_C "/" VALUE 0x8003BB66 Kw_Ws16 655350.0 Time_ms -327680.0 327670.0 /end CHARACTERISTIC
/begin CHARACTERISTIC Fan_4WinSigDur.tiErr1Max_C "/" VALUE 0x8003BB68 Kw_Ws16 655350.0 Time_ms -327680.0 327670.0 /end CHARACTERISTIC
/begin CHARACTERISTIC Fan_4WinSigDur.tiErr2Min_C "/" VALUE 0x8003BB6A Kw_Ws16 655350.0 Time_ms -327680.0 327670.0 /end CHARACTERISTIC
/begin CHARACTERISTIC Fan_4WinSigDur.tiErr2Max_C "/" VALUE 0x8003BB6C Kw_Ws16 655350.0 Time_ms -327680.0 327670.0 /end CHARACTERISTIC
/begin CHARACTERISTIC Fan_4WinSigDur.tiErr3Min_C "/" VALUE 0x8003BB6E Kw_Ws16 655350.0 Time_ms -327680.0 327670.0 /end CHARACTERISTIC
/begin CHARACTERISTIC Fan_4WinSigDur.tiErr3Max_C "/" VALUE 0x8003BB70 Kw_Ws16 655350.0 Time_ms -327680.0 327670.0 /end CHARACTERISTIC
/begin CHARACTERISTIC Fan_4WinSigDur.tiErr4Min_C "/" VALUE 0x8003BB72 Kw_Ws16 655350.0 Time_ms -327680.0 327670.0 /end CHARACTERISTIC
/begin CHARACTERISTIC Fan_4WinSigDur.tiErr4Max_C "/" VALUE 0x8003BB74 Kw_Ws16 655350.0 Time_ms -327680.0 327670.0 /end CHARACTERISTIC
/begin CHARACTERISTIC Fan_Pwm.tiPer_C "Struktur, die Kalibrierungs- und Umsetzungsdatentypen für Lüftersteller 1 enthält/" VALUE 0x8003BB76 Kw_Ws16 9.900000 Period 0.1000000 10.00000 FORMAT "%8.5" EXTENDED_LIMITS -3276.800 3276.700 /end CHARACTERISTIC
/begin CHARACTERISTIC Fan_Pwm.stLvl_C "Struktur, die Kalibrierungs- und Umsetzungsdatentypen für Lüftersteller 1 enthält/" VALUE 0x8003BB78 Kw_Wu8 1.000 OneToOne 0.00 1.000 EXTENDED_LIMITS 0.00 255.0 /end CHARACTERISTIC
/begin CHARACTERISTIC Fan_Pwm.rMaxDty_C "Struktur, die Kalibrierungs- und Umsetzungsdatentypen für Lüftersteller 1 enthält/" VALUE 0x8003BB7A Kw_Ws16 100.0000 DtyCyc 0.00 100.0000 EXTENDED_LIMITS -327.6800 327.6700 /end CHARACTERISTIC
/begin CHARACTERISTIC Fan_Pwm.rPerUn_C "Struktur, die Kalibrierungs- und Umsetzungsdatentypen für Lüftersteller 1 enthält/" VALUE 0x8003BB7C Kw_Ws16 3276.700 Period 0.00 3276.700 FORMAT "%8.3" EXTENDED_LIMITS -3276.800 3276.700 /end CHARACTERISTIC
/begin CHARACTERISTIC Fan_Pwm.tiPh_C "Struktur, die Kalibrierungs- und Umsetzungsdatentypen für Lüftersteller 1 enthält/" VALUE 0x8003BB7E Kw_Ws16 65535.00 OneToOne -32768.00 32767.00 /end CHARACTERISTIC
/begin CHARACTERISTIC Fan_PwmOut.rMin_C "Struktur, die Parameter zur Fehlerbehandlung der PWM-Ausgangsendstufe für Lüftersteller 1 enthält./" VALUE 0x8003BB80 Kw_Ws16 100.0000 DtyCyc 0.00 100.0000 EXTENDED_LIMITS -327.6800 327.6700 /end CHARACTERISTIC
/begin CHARACTERISTIC Fan_PwmOut.rMax_C "Struktur, die Parameter zur Fehlerbehandlung der PWM-Ausgangsendstufe für Lüftersteller 1 enthält./" VALUE 0x8003BB82 Kw_Ws16 100.0000 DtyCyc 0.00 100.0000 EXTENDED_LIMITS -327.6800 327.6700 /end CHARACTERISTIC
/begin CHARACTERISTIC Fan_PwmOut.tiBtwTstSCB_C "Struktur, die Parameter zur Fehlerbehandlung der PWM-Ausgangsendstufe für Lüftersteller 1 enthält./" VALUE 0x8003BB84 Kw_Ws16 1000.000 Time_ms 0.00 1000.000 EXTENDED_LIMITS -327680.0 327670.0 /end CHARACTERISTIC
/begin CHARACTERISTIC Fan_PwmOut.tiBtwTstOT_C "Struktur, die Parameter zur Fehlerbehandlung der PWM-Ausgangsendstufe für Lüftersteller 1 enthält./" VALUE 0x8003BB86 Kw_Ws16 1000.000 Time_s 0.00 1000.000 EXTENDED_LIMITS -327.6800 327.6700 /end CHARACTERISTIC
/begin CHARACTERISTIC Fan_PwmOut.numTstMax_C "Struktur, die Parameter zur Fehlerbehandlung der PWM-Ausgangsendstufe für Lüftersteller 1 enthält./" VALUE 0x8003BB88 Kw_Wu16 65535.00 OneToOne 0.00 65535.00 /end CHARACTERISTIC
/begin CHARACTERISTIC Fan_PwmOut.swtBattCor_C "Struktur, die Parameter zur Fehlerbehandlung der PWM-Ausgangsendstufe für Lüftersteller 1 enthält./" VALUE 0x8003BB8A Kw_Wu8 1.000 OneToOne 0.00 1.000 EXTENDED_LIMITS 0.00 255.0 /end CHARACTERISTIC
/begin CHARACTERISTIC Fan_PwmOut.swtPsInv_C "Struktur, die Parameter zur Fehlerbehandlung der PWM-Ausgangsendstufe für Lüftersteller 1 enthält./" VALUE 0x8003BB8B Kw_Wu8 255.0 OneToOne 0.00 255.0 /end CHARACTERISTIC
/begin CHARACTERISTIC Fan_rCnv_CUR "Umsetzungskennlinie zur Konvertierung des Sollwerts in den Tastverhältniswert für Lüfter 1" CURVE 0x8003BB8C Cur_Xs16Ws16 655.3500 DtyCyc -327.6800 327.6700
 /begin AXIS_DESCR STD_AXIS Fan_r DtyCyc 10 0.00 100.0000 EXTENDED_LIMITS -327.6800 327.6700 DEPOSIT ABSOLUTE /end AXIS_DESCR
/end CHARACTERISTIC
/begin CHARACTERISTIC Fan_rPsDisbl_C "Ersatzwert für das Ausgangstastverhältnis bei abgeschalteten Lüftern" VALUE 0x8003BBB6 Val_Ws16 100.0000 DtyCyc 0.00 100.0000 EXTENDED_LIMITS -327.6800 327.6700 /end CHARACTERISTIC
/begin CHARACTERISTIC Fan_stPsDiaDisbl_C "Maske zur Auswahl der Bedingungen, unter denen die Diagnose für Lüfter 1 gesperrt werden muss" VALUE 0x8003BBB8 Val_Wu8 255.0 OneToOne 0.00 255.0 /end CHARACTERISTIC
/begin CHARACTERISTIC Fan_stPsDisbl_C "Maske zur Auswahl der Sperrbedingungen der Endstufe für Lüfter 1" VALUE 0x8003BBB9 Val_Wu8 255.0 OneToOne 0.00 255.0 /end CHARACTERISTIC
/begin CHARACTERISTIC Fan_tiAfterrun_C "" VALUE 0x8003BBBA Val_Ws16 499.0000 Period 1.000000 500.0000 FORMAT "%8.4" EXTENDED_LIMITS -3276.800 3276.700 /end CHARACTERISTIC
/begin CHARACTERISTIC Fan_typ4WinDia_C "" VALUE 0x8003BBBC Val_Wu8 0.00 Typ4WinDia 0.00 0.00 FORMAT "%13.2" EXTENDED_LIMITS 0.00 3.00000000000 /end CHARACTERISTIC
/begin CHARACTERISTIC FBC_ActESpP_C "=0: 'keine Drehzahlvorverarbeitung', =1: 'mit Drehzahlvorverarbeitung', =2: 'lösche Adaptionsergebnisspeicher (EEPROM)'" VALUE 0x8003B700 Val_Wu8 2.000 OneToOne 0.00 2.000 EXTENDED_LIMITS 0.00 255.0 /end CHARACTERISTIC
/begin CHARACTERISTIC FBC_BPFac.NumLo_CA "Bandpass-Koeffizienten/Zählerkoeffizienten für unteren Drehzahlbereich" VAL_BLK 0x8003B5C0 ValA_Wr32 30.0000000 OneToOne -15.0000000 15.0000000 FORMAT "%10.7" EXTENDED_LIMITS -1.00000000E+037 1.00000000E+037 NUMBER 3 /end CHARACTERISTIC
/begin CHARACTERISTIC FBC_BPFac.NumHi_CA "Bandpass-Koeffizienten/Zählerkoeffizienten für den oberen Drehzahlbereich" VAL_BLK 0x8003B5CC ValA_Wr32 30.0000000 OneToOne -15.0000000 15.0000000 FORMAT "%10.7" EXTENDED_LIMITS -1.00000000E+037 1.00000000E+037 NUMBER 3 /end CHARACTERISTIC
/begin CHARACTERISTIC FBC_BPFac.Den1_CA "Bandpass-Koeffizienten/Nennerkoeffizient 1" VAL_BLK 0x8003B5D8 ValA_Wr32 20.0000000 OneToOne -10.0000000 10.0000000 FORMAT "%10.7" EXTENDED_LIMITS -1.00000000E+037 1.00000000E+037 NUMBER 3 /end CHARACTERISTIC
/begin CHARACTERISTIC FBC_BPFac.Den2_CA "Bandpass-Koeffizienten/Nennerkoeffizient 2" VAL_BLK 0x8003B5E4 ValA_Wr32 20.0000000 OneToOne -10.0000000 10.0000000 FORMAT "%10.7" EXTENDED_LIMITS -1.00000000E+037 1.00000000E+037 NUMBER 3 /end CHARACTERISTIC
/begin CHARACTERISTIC FBC_BPFac1NumG_CUR "übersetzungsabhängige Zählerkoeffizienten (unterschiedliche Bandpass-Verstärkungen)" CURVE 0x8003B5F0 Cur_Xs16Ws16 30.00092 FBC_BPfac -15.00046 15.00046 FORMAT "%8.5" EXTENDED_LIMITS -60.00183 60.00000
 /begin AXIS_DESCR STD_AXIS PT_rTrq TransR 6 -15.00000 15.00000 EXTENDED_LIMITS -327.6800 327.6700 DEPOSIT ABSOLUTE /end AXIS_DESCR
/end CHARACTERISTIC
/begin CHARACTERISTIC FBC_ctPhComp_C "Kompensation der Totzeit durch Scheduling für FBC_qSet-Berechnung. 0: keine Totzeit, 1: einSegment Totzeit (z.B. wie EDC16 Master/Slave)" VALUE 0x8003B60A Val_Ws8 4.000 OneToOne 0.00 4.000 EXTENDED_LIMITS -128.0 127.0 /end CHARACTERISTIC
/begin CHARACTERISTIC FBC_ctSegOffset_C "Abstand zwischen FBC-Berechnung und entsprechendem OT" VALUE 0x8003B60B Val_Ws8 1.000 OneToOne 2.000 3.000 EXTENDED_LIMITS -128.0 127.0 /end CHARACTERISTIC
/begin CHARACTERISTIC FBC_ctTDCOfs_C "Abstand zwischen OT und Main-Interrupt der zugehörigem Einspritzung" VALUE 0x8003B60C Val_Ws8 0.00 OneToOne 1.000 1.000 EXTENDED_LIMITS -128.0 127.0 /end CHARACTERISTIC
/begin CHARACTERISTIC FBC_dqThresSurge_C "Schwelle zur Erkennung einer impulsfömigen Mengenänderung" VALUE 0x8003B60E Val_Ws16 327.6700 InjMass 0.00 327.6700 EXTENDED_LIMITS -327.6800 327.6700 /end CHARACTERISTIC
/begin CHARACTERISTIC FBC_dSegNhiCaS_CA "Segmentwert für Epm_nEng > FBC_nThresFbc_C" VAL_BLK 0x8003B610 ValA_Wu16 10.00000 Per_Ratio 0.00 10.00000 FORMAT "%8.5" EXTENDED_LIMITS 0.00 255.9961 NUMBER 3 /end CHARACTERISTIC
/begin CHARACTERISTIC FBC_dSegNloCaS_CA "Segmentwert für Epm_nEng < FBC_nThresFbc_C" VAL_BLK 0x8003B616 ValA_Wu16 10.00000 Per_Ratio 0.00 10.00000 FORMAT "%8.5" EXTENDED_LIMITS 0.00 255.9961 NUMBER 3 /end CHARACTERISTIC
/begin CHARACTERISTIC FBC_DSMUrgencyOffset_C "Offset der Priorität im DSCHED bei Schubfahrt." VALUE 0x8003B701 Val_Wu8 255.0 OneToOne 0.00 255.0 /end CHARACTERISTIC
/begin CHARACTERISTIC FBC_dSyn_C "Abstand OT Zyl.1 zu Segmentzählerstand 0 (bezogen auf CrSCD_numSeg)" VALUE 0x8003B61C Val_Ws8 1.000 OneToOne 1.000 2.000 EXTENDED_LIMITS -128.0 127.0 /end CHARACTERISTIC
/begin CHARACTERISTIC FBC_DXAdapLo_C "untere Schwelle der Adaptionsgüte (Geberradadaption)" VALUE 0x8003B702 Val_Ws16 0.9999990 FBC_Dxs_s16 0.00 0.9999990 FORMAT "%8.6" EXTENDED_LIMITS -0.7812500 0.7812262 /end CHARACTERISTIC
/begin CHARACTERISTIC FBC_DXAdapUp_C "obere Schwelle der Adaptionsgüte (Geberradadaption)" VALUE 0x8003B704 Val_Ws16 0.9999990 FBC_Dxs_s16 0.00 0.9999990 FORMAT "%8.6" EXTENDED_LIMITS -0.7812500 0.7812262 /end CHARACTERISTIC
/begin CHARACTERISTIC FBC_DXalf0_C "Startwerte für FBC_DXSfn, FBC_DXSfp" VALUE 0x8003B706 Val_Ws16 2.999997 FBC_Dxs_s16 0.00 2.999997 FORMAT "%8.6" EXTENDED_LIMITS -0.7812500 0.7812262 /end CHARACTERISTIC
/begin CHARACTERISTIC FBC_EnblCpy_C "Erlaubt die Ausgabe von Lernwerten aus benachbarten Lernbereichen, solange Lernfilter nicht eingeschwungen sind." VALUE 0x8003B708 Val_Wu8 1.000 OneToOne 0.00 1.000 EXTENDED_LIMITS 0.00 255.0 /end CHARACTERISTIC
/begin CHARACTERISTIC FBC_EnblIpo_C "Erlaubt interpolation in Drehzahlbereichen zwischen den Lernbereichen." VALUE 0x8003B709 Val_Wu8 1.000 OneToOne 0.00 1.000 EXTENDED_LIMITS 0.00 255.0 /end CHARACTERISTIC
/begin CHARACTERISTIC FBC_facBPRedNum_C "Faktor um den die BP-Verstärkungen bei impulsförmigen Mengenanregungen reduziert werden" VALUE 0x8003B620 Val_Wr32 1.00000000 OneToOne 0.00 1.00000000 FORMAT "%10.8" EXTENDED_LIMITS -1.00000000E+037 1.00000000E+037 /end CHARACTERISTIC
/begin CHARACTERISTIC FBC_fSurge_CUR "übersetzungsabhängige Ruckelfrequenzen" CURVE 0x8003B624 Cur_Xs16Ws16 20.00000 FBC_Surge_Frq 0.00 20.00000 FORMAT "%8.5" EXTENDED_LIMITS -273.0667 273.0583
 /begin AXIS_DESCR STD_AXIS PT_rTrq TransR 6 0.00 20.00000 EXTENDED_LIMITS -327.6800 327.6700 DEPOSIT ABSOLUTE /end AXIS_DESCR
/end CHARACTERISTIC
/begin CHARACTERISTIC FBC_GvrnI.Ki_C "I-Regler/" VALUE 0x8003B640 Kw_Wr32 1.00000000 FBC_GvrnIKi_float 0.00 1.00000000 FORMAT "%10.8" EXTENDED_LIMITS -1.00000000E+037 1.00000000E+037 /end CHARACTERISTIC
/begin CHARACTERISTIC FBC_GvrnI.KiPos_C "I-Regler/" VALUE 0x8003B644 Kw_Wr32 1.00000000 FBC_GvrnIKi_float 0.00 1.00000000 FORMAT "%10.8" EXTENDED_LIMITS -1.00000000E+037 1.00000000E+037 /end CHARACTERISTIC
/begin CHARACTERISTIC FBC_GvrnI.KiNeg_C "I-Regler/" VALUE 0x8003B648 Kw_Wr32 1.00000000 FBC_GvrnIKi_float 0.00 1.00000000 FORMAT "%10.8" EXTENDED_LIMITS -1.00000000E+037 1.00000000E+037 /end CHARACTERISTIC
/begin CHARACTERISTIC FBC_GvrnI.WinPos_C "I-Regler/" VALUE 0x8003B64C Kw_Wr32 12200.0000 EngN_float -6100.00000 6100.00000 EXTENDED_LIMITS -1.00000000E+037 1.00000000E+037 /end CHARACTERISTIC
/begin CHARACTERISTIC FBC_GvrnI.WinNeg_C "I-Regler/" VALUE 0x8003B650 Kw_Wr32 12200.0000 EngN_float -6100.00000 6100.00000 EXTENDED_LIMITS -1.00000000E+037 1.00000000E+037 /end CHARACTERISTIC
/begin CHARACTERISTIC FBC_GvrnP.Kp_C "P-Regler/" VALUE 0x8003B654 Kw_Wr32 1.00000000 FBC_GvrnPKp_float 0.00 1.00000000 FORMAT "%10.8" EXTENDED_LIMITS -1.00000000E+037 1.00000000E+037 /end CHARACTERISTIC
/begin CHARACTERISTIC FBC_GvrnP.KpPos_C "P-Regler/" VALUE 0x8003B658 Kw_Wr32 1.00000000 FBC_GvrnPKp_float 0.00 1.00000000 FORMAT "%10.8" EXTENDED_LIMITS -1.00000000E+037 1.00000000E+037 /end CHARACTERISTIC
/begin CHARACTERISTIC FBC_GvrnP.KpNeg_C "P-Regler/" VALUE 0x8003B65C Kw_Wr32 1.00000000 FBC_GvrnPKp_float 0.00 1.00000000 FORMAT "%10.8" EXTENDED_LIMITS -1.00000000E+037 1.00000000E+037 /end CHARACTERISTIC
/begin CHARACTERISTIC FBC_GvrnP.WinPos_C "P-Regler/" VALUE 0x8003B660 Kw_Wr32 12200.0000 EngN_float -6100.00000 6100.00000 EXTENDED_LIMITS -1.00000000E+037 1.00000000E+037 /end CHARACTERISTIC
/begin CHARACTERISTIC FBC_GvrnP.WinNeg_C "P-Regler/" VALUE 0x8003B664 Kw_Wr32 12200.0000 EngN_float -6100.00000 6100.00000 EXTENDED_LIMITS -1.00000000E+037 1.00000000E+037 /end CHARACTERISTIC
/begin CHARACTERISTIC FBC_nBrIpoRng_CA "Breite der Drehzahlintervalle zwischen den Lernbereichen." VAL_BLK 0x8003B70A ValA_Ws16 2000.000 EngN 0.00 2000.000 EXTENDED_LIMITS -16384.00 16383.50 NUMBER 4 /end CHARACTERISTIC
/begin CHARACTERISTIC FBC_nCtlOfsMin_C "Offset der unteren drehzahlabhängigen Steuerschwelle zur aktuellen Leerlaufdrehzahl" VALUE 0x8003B668 Val_Ws16 1000.000 EngN -1000.000 0.00 EXTENDED_LIMITS -16384.00 16383.50 /end CHARACTERISTIC
/begin CHARACTERISTIC FBC_nCtlThresMax_C "obere Drehzahlsteuerschwelle" VALUE 0x8003B66A Val_Ws16 6100.000 EngN 0.00 6100.000 EXTENDED_LIMITS -16384.00 16383.50 /end CHARACTERISTIC
/begin CHARACTERISTIC FBC_nGvrnOfsMin_C "Offset der unteren drehzahlabhängigen Regelschwelle zur aktuellen Leerlaufdrehzahl" VALUE 0x8003B66C Val_Ws16 1000.000 EngN -1000.000 0.00 EXTENDED_LIMITS -16384.00 16383.50 /end CHARACTERISTIC
/begin CHARACTERISTIC FBC_nGvrnThresMax_C "obere Drehzahlregelschwelle" VALUE 0x8003B66E Val_Ws16 6100.000 EngN 0.00 6100.000 EXTENDED_LIMITS -16384.00 16383.50 /end CHARACTERISTIC
/begin CHARACTERISTIC FBC_nHyst_C "Drehzahlhysterese" VALUE 0x8003B670 Val_Ws16 100.0000 EngN 0.00 100.0000 EXTENDED_LIMITS -16384.00 16383.50 /end CHARACTERISTIC
/begin CHARACTERISTIC FBC_nLrnThres_CA "Drehzahlschwellen der Lernbereiche der Geberradadaption" VAL_BLK 0x8003B712 ValA_Ws16 10000.00 EngN 0.00 10000.00 EXTENDED_LIMITS -16384.00 16383.50 NUMBER 6 /end CHARACTERISTIC
/begin CHARACTERISTIC FBC_nSurgeOffset_C "pos. Offset zur kritischen Drehzahl, bei der fNW=fRuck gilt." VALUE 0x8003B672 Val_Ws16 1000.000 EngN 0.00 1000.000 EXTENDED_LIMITS -16384.00 16383.50 /end CHARACTERISTIC
/begin CHARACTERISTIC FBC_nThresFbc_C "Drehzahlschwelle für Segmentwert- und Bandpassumschaltung, maximale Drehzahl ohne eingelernte Geberradadaption" VALUE 0x8003B71E Val_Ws16 2000.000 EngN 0.00 2000.000 EXTENDED_LIMITS -16384.00 16383.50 /end CHARACTERISTIC
/begin CHARACTERISTIC FBC_PrtnRmp_C "Drehzahlintervall zur Interpolation auf 0 am Rand eines Lernbereichs (relativer Anteil bezogen auf FBC_nBrIpoRng_CA)." VALUE 0x8003B720 Val_Wr32 0.500000000 OneToOne 0.00 0.500000000 FORMAT "%11.9" EXTENDED_LIMITS -1.00000000E+037 1.00000000E+037 /end CHARACTERISTIC
/begin CHARACTERISTIC FBC_qCtlOfsMax_C "Offset für obere mengenabhängige Steuerschwelle" VALUE 0x8003B674 Val_Ws16 10.00000 InjMass 0.00 10.00000 EXTENDED_LIMITS -327.6800 327.6700 /end CHARACTERISTIC
/begin CHARACTERISTIC FBC_qCtlThresMin_C "untere Mengensteuerschwelle" VALUE 0x8003B676 Val_Ws16 5.000000 InjMass 0.00 5.000000 EXTENDED_LIMITS -327.6800 327.6700 /end CHARACTERISTIC
/begin CHARACTERISTIC FBC_qDvtMax_CUR "obere Grenze für die aktuelle zylinderindividuelle Korrekturmenge" CURVE 0x8003B678 Cur_Xs16Ws16 655.3400 InjMass -327.6700 327.6700 EXTENDED_LIMITS -327.6800 327.6700
 /begin AXIS_DESCR STD_AXIS InjCtl_qSetUnBal InjMass 8 0.00 327.6700 EXTENDED_LIMITS -327.6800 327.6700 DEPOSIT ABSOLUTE /end AXIS_DESCR
/end CHARACTERISTIC
/begin CHARACTERISTIC FBC_qDvtMin_CUR "untere Grenze für die aktuelle zylinderindividuelle Korrekturmenge" CURVE 0x8003B69A Cur_Xs16Ws16 655.3400 InjMass -327.6700 327.6700 EXTENDED_LIMITS -327.6800 327.6700
 /begin AXIS_DESCR STD_AXIS InjCtl_qSetUnBal InjMass 8 0.00 327.6700 EXTENDED_LIMITS -327.6800 327.6700 DEPOSIT ABSOLUTE /end AXIS_DESCR
/end CHARACTERISTIC
/begin CHARACTERISTIC FBC_qGvrnThresMax_CUR "obere mengenabhängige Regelschwelle" CURVE 0x8003B6BC Cur_Xs16Ws16 327.6700 InjMass 0.00 327.6700 EXTENDED_LIMITS -327.6800 327.6700
 /begin AXIS_DESCR STD_AXIS Epm_nEng EngN 4 0.00 6100.000 EXTENDED_LIMITS -16384.00 16383.50 DEPOSIT ABSOLUTE /end AXIS_DESCR
/end CHARACTERISTIC
/begin CHARACTERISTIC FBC_qGvrnThresMin_C "untere Mengenregelschwelle" VALUE 0x8003B6CE Val_Ws16 5.000000 InjMass 0.00 5.000000 EXTENDED_LIMITS -327.6800 327.6700 /end CHARACTERISTIC
/begin CHARACTERISTIC FBC_qLimDia_C "Korrekturmengenbegrenzung während Auslesen der FBC-Korrekturmengen mit dem Diagnosetester" VALUE 0x8003B6D0 Val_Ws16 20.00000 InjMass 0.00 20.00000 EXTENDED_LIMITS -327.6800 327.6700 /end CHARACTERISTIC
/begin CHARACTERISTIC FBC_qLim_CUR "mengenabhängige Korrekturmengenbegrenzung (zur Dekativierung der FBC alle Werte auf 0)" CURVE 0x8003B6D2 Cur_Xs16Ws16 327.6700 InjMass 0.00 327.6700 EXTENDED_LIMITS -327.6800 327.6700
 /begin AXIS_DESCR STD_AXIS InjCtl_qSetUnBal InjMass 4 0.00 327.6700 EXTENDED_LIMITS -327.6800 327.6700 DEPOSIT ABSOLUTE /end AXIS_DESCR
/end CHARACTERISTIC
/begin CHARACTERISTIC FBC_qRCLim_C "Begrenzungsmenge für die additiven Korrekturmengen von FBC_qRC_CA" VALUE 0x8003B6E4 Val_Ws16 5.000000 InjMass 0.00 5.000000 EXTENDED_LIMITS -327.6800 327.6700 /end CHARACTERISTIC
/begin CHARACTERISTIC FBC_qRC_CA "zylinderindividuelle Korrekturmenge zur Aufprägung eines Mengenmusters am Ausgang der Mengenausgleichsregelung" VAL_BLK 0x8003B6E6 ValA_Ws16 10.00000 InjMass -5.000000 5.000000 EXTENDED_LIMITS -327.6800 327.6700 NUMBER 6 /end CHARACTERISTIC
/begin CHARACTERISTIC FBC_stOpModeFrz_C "Maske für aktuelle Betriebsart (Einfrieren des Ausgangs der FBC)" VALUE 0x8003B6F4 Val_Wu32 4294967295.00 OneToOne 0.00 4294967295.00 /end CHARACTERISTIC
/begin CHARACTERISTIC FBC_stOpModeInhib_C "Maske für aktuelle Betriebsart (Initialisierung des Ausgangs der FBC mit Null)" VALUE 0x8003B6F8 Val_Wu32 4294967295.00 OneToOne 0.00 4294967295.00 /end CHARACTERISTIC
/begin CHARACTERISTIC FBC_swtInitI_C "Initialisierung des I-Anteils beim Wechsel in den Zustand 'Regeln': '0' mit eingefrorenen Werten, '1' mit Null" VALUE 0x8003B6FC Val_Wu8 3.000 OneToOne 0.00 3.000 EXTENDED_LIMITS 0.00 255.0 /end CHARACTERISTIC
/begin CHARACTERISTIC FBC_swtRC_C "Schalter zur Aktivierung von FBC_qRC_CA (1: 'aktiv'; 0: 'inaktiv')" VALUE 0x8003B6FD Val_Wu8 1.000 OneToOne 0.00 1.000 EXTENDED_LIMITS 0.00 255.0 /end CHARACTERISTIC
/begin CHARACTERISTIC FBC_TFConst_C "Filterkoeffizient des Adaptionsfilters" VALUE 0x8003B724 Val_Wr32 1.00000000 OneToOne 0.00 1.00000000 FORMAT "%10.8" EXTENDED_LIMITS -1.00000000E+037 1.00000000E+037 /end CHARACTERISTIC
/begin CHARACTERISTIC FBC_TFLrnConst_C "Filterkoeffizient des Bewertungsfilters" VALUE 0x8003B728 Val_Wr32 1.00000000 OneToOne 0.00 1.00000000 FORMAT "%10.8" EXTENDED_LIMITS -1.00000000E+037 1.00000000E+037 /end CHARACTERISTIC
/begin CHARACTERISTIC FBC_ThresDyn_C "Drehzahldynamikgrenzwert um die Adaption zu deaktivieren" VALUE 0x8003B72C Val_Wr32 1.00000000 OneToOne 0.00 1.00000000 FORMAT "%10.8" EXTENDED_LIMITS -1.00000000E+037 1.00000000E+037 /end CHARACTERISTIC
/begin CHARACTERISTIC FlFCBS_lCalcDistance_MAP "" MAP 0x8003BBBE Map_Xs16Ys16Ws16 30000.00 km_sw_q10 0.00 30000.00 FORMAT "%8.2" EXTENDED_LIMITS -327680.0 327670.0
 /begin AXIS_DESCR STD_AXIS Layer_facFrcCBS Prc 8 0.00 100.0000 EXTENDED_LIMITS -400.0000 399.9878 DEPOSIT ABSOLUTE /end AXIS_DESCR
 /begin AXIS_DESCR STD_AXIS FlFCBS_voltotFlConsum_l_mp OneToOne 8 0.00 30000.0000000 EXTENDED_LIMITS 0.00 4294967295.00 DEPOSIT ABSOLUTE /end AXIS_DESCR
/end CHARACTERISTIC
/begin CHARACTERISTIC FlFCBS_lCalcProgWay_C "" VALUE 0x8003BC62 Val_Wu8 255000. lProgWay 0.00 255000. FORMAT "%5.0" /end CHARACTERISTIC
/begin CHARACTERISTIC FlFCBS_lDistanceMax_C "" VALUE 0x8003BC64 Val_Ws16 655350.0 km_sw_q10 -327680.0 327670.0 FORMAT "%8.1" /end CHARACTERISTIC
/begin CHARACTERISTIC FlFCBS_lFlFDef_C "" VALUE 0x8003BC66 Val_Ws16 655350.0 km_sw_q10 -327680.0 327670.0 FORMAT "%8.1" /end CHARACTERISTIC
/begin CHARACTERISTIC FlFCBS_lThresOut_C "" VALUE 0x8003BC68 Val_Ws16 655350.0 km_sw_q10 -327680.0 327670.0 FORMAT "%8.1" /end CHARACTERISTIC
/begin CHARACTERISTIC FlFCBS_mskFlLPCSelfRec_C "" VALUE 0x8003BC6A Val_Wu8 7.000 OneToOne 0.00 7.000 EXTENDED_LIMITS 0.00 255.0 /end CHARACTERISTIC
/begin CHARACTERISTIC FlFCBS_qCalcFlTot_CUR "" CURVE 0x8003BC6C Cur_Xs16Ws16 30000.00 OneToOne 0.00 30000.00 EXTENDED_LIMITS -32768.00 32767.00
 /begin AXIS_DESCR STD_AXIS FlFCBS_dAvaiDMEChg_mp OneToOne 8 0.00 100.0 EXTENDED_LIMITS 0.00 255.0 DEPOSIT ABSOLUTE /end AXIS_DESCR
/end CHARACTERISTIC
/begin CHARACTERISTIC FlFCBS_stFlLPCSelfRec_C "" VALUE 0x8003BC8E Val_Wu8 255.0 OneToOne 0.00 255.0 /end CHARACTERISTIC
/begin CHARACTERISTIC FlFltDsP_pTransf_CUR "" CURVE 0x8003BC90 Cur_Xs16Ws16 3500.000 Pres_hPa 0.00 3500.000 EXTENDED_LIMITS -32768.00 32767.00
 /begin AXIS_DESCR STD_AXIS FlFltDsP_uRaw Volt 25 0.00 5000.000 EXTENDED_LIMITS -6553.600 6553.400 DEPOSIT ABSOLUTE /end AXIS_DESCR
/end CHARACTERISTIC
/begin CHARACTERISTIC FlFltDsP_RmpSlp.Pos_C "/" VALUE 0x8003BD04 Kw_Ws32 32767999.9847 RmpPres_hPa 0.00 32767999.9847 FORMAT "%13.4" EXTENDED_LIMITS -32768000.0000 32767999.9847 /end CHARACTERISTIC
/begin CHARACTERISTIC FlFltDsP_RmpSlp.Neg_C "/" VALUE 0x8003BD08 Kw_Ws32 32767999.9847 RmpPres_hPa 0.00 32767999.9847 FORMAT "%13.4" EXTENDED_LIMITS -32768000.0000 32767999.9847 /end CHARACTERISTIC
/begin CHARACTERISTIC FlFltDsP_SRC.uMin_C "/" VALUE 0x8003BCF6 Kw_Ws16 5200.000 Volt 0.00 5200.000 EXTENDED_LIMITS -6553.600 6553.400 /end CHARACTERISTIC
/begin CHARACTERISTIC FlFltDsP_SRC.uMax_C "/" VALUE 0x8003BCF8 Kw_Ws16 5200.000 Volt 0.00 5200.000 EXTENDED_LIMITS -6553.600 6553.400 /end CHARACTERISTIC
/begin CHARACTERISTIC FlFltDsP_swtRecDeAct_C "" VALUE 0x8003BCFA Val_Wu8 1.000 OneToOne 0.00 1.000 EXTENDED_LIMITS 0.00 255.0 /end CHARACTERISTIC
/begin CHARACTERISTIC FlFltDsP_tiLPFiltPT1_C "" VALUE 0x8003BD0C Val_Ws32 4294.9672940 TimeDelay_s 0.000002000000001 4294.9672960 FORMAT "%12.7" /end CHARACTERISTIC
/begin CHARACTERISTIC FlFltDsP_tiRecDeb_C "" VALUE 0x8003BCFC Val_Ws16 327670.0 Time_ms 0.00 327670.0 EXTENDED_LIMITS -327680.0 327670.0 /end CHARACTERISTIC
/begin CHARACTERISTIC FlFltDsP_tiSigRawPT1_C "" VALUE 0x8003BD00 Val_Wr32 32767.0000 Time_s_float 0.00 32767.0000 FORMAT "%10.4" EXTENDED_LIMITS -1.00000000E+037 1.00000000E+037 /end CHARACTERISTIC
/begin CHARACTERISTIC FlFltDsP_TransStg.Dfl_C "/" VALUE 0x8003BD10 Kw_Ws16 3500.000 Pres_hPa 0.00 3500.000 EXTENDED_LIMITS -32768.00 32767.00 /end CHARACTERISTIC
/begin CHARACTERISTIC FlFltDsP_TransStg.stSensId_C "/" VALUE 0x8003BD12 Kw_Wu8 4.000 OneToOne 0.00 4.000 EXTENDED_LIMITS 0.00 255.0 /end CHARACTERISTIC
/begin CHARACTERISTIC FlFltHt_DigOut.tiBtwTstSCB_C "/" VALUE 0x8003BD14 Kw_Ws16 1000.000 Time_ms 0.00 1000.000 EXTENDED_LIMITS -327680.0 327670.0 /end CHARACTERISTIC
/begin CHARACTERISTIC FlFltHt_DigOut.tiBtwTstOT_C "/" VALUE 0x8003BD16 Kw_Ws16 1000.000 Time_s 0.00 1000.000 EXTENDED_LIMITS -327.6800 327.6700 /end CHARACTERISTIC
/begin CHARACTERISTIC FlFltHt_DigOut.numTstMax_C "/" VALUE 0x8003BD18 Kw_Wu16 65535.00 OneToOne 0.00 65535.00 /end CHARACTERISTIC
/begin CHARACTERISTIC FlFltHt_stPsDiaDisbl_C "" VALUE 0x8003BD1A Val_Wu8 255.0 OneToOne 0.00 255.0 /end CHARACTERISTIC
/begin CHARACTERISTIC FlFltHt_stPsDisbl_C "" VALUE 0x8003BD1B Val_Wu8 255.0 OneToOne 0.00 255.0 /end CHARACTERISTIC
/begin CHARACTERISTIC FlFltHt_swtRecDeAct_C "" VALUE 0x8003BD1C Val_Wu8 255.0 OneToOne 0.00 255.0 /end CHARACTERISTIC
/begin CHARACTERISTIC FlFltHt_tiRecDeb_C "" VALUE 0x8003BD1E Val_Wu16 1000.000 Time_ms 0.00 1000.000 EXTENDED_LIMITS 0.00 655350.0 /end CHARACTERISTIC
/begin CHARACTERISTIC FlFltUsP_pTransf_CUR "" CURVE 0x8003BD20 Cur_Xs16Ws16 3500.000 Pres_hPa 0.00 3500.000 EXTENDED_LIMITS -32768.00 32767.00
 /begin AXIS_DESCR STD_AXIS FlFltUsP_uRaw Volt 25 0.00 5000.000 EXTENDED_LIMITS -6553.600 6553.400 DEPOSIT ABSOLUTE /end AXIS_DESCR
/end CHARACTERISTIC
/begin CHARACTERISTIC FlFltUsP_RmpSlp.Pos_C "/" VALUE 0x8003BD90 Kw_Ws32 32767999.9847 RmpPres_hPa 0.00 32767999.9847 FORMAT "%13.4" EXTENDED_LIMITS -32768000.0000 32767999.9847 /end CHARACTERISTIC
/begin CHARACTERISTIC FlFltUsP_RmpSlp.Neg_C "/" VALUE 0x8003BD94 Kw_Ws32 32767999.9847 RmpPres_hPa 0.00 32767999.9847 FORMAT "%13.4" EXTENDED_LIMITS -32768000.0000 32767999.9847 /end CHARACTERISTIC
/begin CHARACTERISTIC FlFltUsP_SRC.uMin_C "/" VALUE 0x8003BD86 Kw_Ws16 5200.000 Volt 0.00 5200.000 EXTENDED_LIMITS -6553.600 6553.400 /end CHARACTERISTIC
/begin CHARACTERISTIC FlFltUsP_SRC.uMax_C "/" VALUE 0x8003BD88 Kw_Ws16 5200.000 Volt 0.00 5200.000 EXTENDED_LIMITS -6553.600 6553.400 /end CHARACTERISTIC
/begin CHARACTERISTIC FlFltUsP_swtSelfRec_C "" VALUE 0x8003BD8A Val_Wu8 1.000 OneToOne 0.00 1.000 EXTENDED_LIMITS 0.00 255.0 /end CHARACTERISTIC
/begin CHARACTERISTIC FlFltUsP_tiDebNoDet_C "" VALUE 0x8003BD8C Val_Ws16 327670.0 Time_ms 0.00 327670.0 EXTENDED_LIMITS -327680.0 327670.0 /end CHARACTERISTIC
/begin CHARACTERISTIC FlFltUsP_tiLPFiltPT1_C "" VALUE 0x8003BD98 Val_Ws32 4294.9672940 TimeDelay_s 0.000002000000001 4294.9672960 FORMAT "%12.7" /end CHARACTERISTIC
/begin CHARACTERISTIC FlFltUsP_TransStg.Dfl_C "/" VALUE 0x8003BD9C Kw_Ws16 3500.000 Pres_hPa 0.00 3500.000 EXTENDED_LIMITS -32768.00 32767.00 /end CHARACTERISTIC
/begin CHARACTERISTIC FlFltUsP_TransStg.stSensId_C "/" VALUE 0x8003BD9E Kw_Wu8 4.000 OneToOne 0.00 4.000 EXTENDED_LIMITS 0.00 255.0 /end CHARACTERISTIC
/begin CHARACTERISTIC FlFlt_Deb.tiHiLo_C "/" VALUE 0x8003BDA0 Kw_Ws16 655350.0 TimeDeb -327680.0 327670.0 /end CHARACTERISTIC
/begin CHARACTERISTIC FlFlt_Deb.tiLoHi_C "/" VALUE 0x8003BDA2 Kw_Ws16 655350.0 TimeDeb -327680.0 327670.0 /end CHARACTERISTIC
/begin CHARACTERISTIC FlFlt_swtSensPrs_C "" VALUE 0x8003BDA4 Val_Wu8 1.000 OneToOne 0.00 1.000 EXTENDED_LIMITS 0.00 255.0 /end CHARACTERISTIC
/begin CHARACTERISTIC FlSys_bFlTnkDes_C "Kalibrierungswert für Tankzustandsanzeige über Remote Control" VALUE 0x8003BDD0 Val_Wu8 1.00000000000 Dspl_bFlTnk_VERB 0.00 1.00000000000 FORMAT "%13.11" /end CHARACTERISTIC
/begin CHARACTERISTIC FlSys_dqSubsRgn.Pos_C "/" VALUE 0x8003BDE4 Kw_Ws32 327679.999847 RmpInjMass 0.00 327679.999847 FORMAT "%13.6" EXTENDED_LIMITS -327680.000000 327679.999847 /end CHARACTERISTIC
/begin CHARACTERISTIC FlSys_dqSubsRgn.Neg_C "/" VALUE 0x8003BDE8 Kw_Ws32 327679.999847 RmpInjMass 0.00 327679.999847 FORMAT "%13.6" EXTENDED_LIMITS -327680.000000 327679.999847 /end CHARACTERISTIC
/begin CHARACTERISTIC FlSys_dvolFlConsTnkLoMax_C "Parameter zur Min/Max-Begrenzung für den momentanen Gesamtverbrauch" VALUE 0x8003BDD2 Val_Ws16 100.0000 FlConsum_l_h 0.00 100.0000 FORMAT "%8.4" EXTENDED_LIMITS -327.6800 327.6700 /end CHARACTERISTIC
/begin CHARACTERISTIC FlSys_dvolFlConsTnkLoMin_C "Parameter zur Min/Max-Begrenzung für den momentanen Gesamtverbrauch" VALUE 0x8003BDD4 Val_Ws16 5.000000 FlConsum_l_h 0.00 5.000000 FORMAT "%8.6" EXTENDED_LIMITS -327.6800 327.6700 /end CHARACTERISTIC
/begin CHARACTERISTIC FlSys_facFlConsAdjDfl_C "Kraftstoffverbrauchs-Ersatzabgleichwert" VALUE 0x8003BDEC Kw_Ws16 2.000000 Fact 0.00 2.000000 EXTENDED_LIMITS -4.000000 3.999878 /end CHARACTERISTIC
/begin CHARACTERISTIC FlSys_facFlConsAdjMax_C "Maximalwert zur Begrenzung des Kraftstoffverbrauch-Abgleichwerts" VALUE 0x8003BDEE Kw_Ws16 2.000000 Fact 0.00 2.000000 EXTENDED_LIMITS -4.000000 3.999878 /end CHARACTERISTIC
/begin CHARACTERISTIC FlSys_facFlConsAdjMin_C "Minimalwert zur Begrenzung des Kraftstoffverbrach-Abgleichwerts" VALUE 0x8003BDF0 Kw_Ws16 2.000000 Fact 0.00 2.000000 EXTENDED_LIMITS -4.000000 3.999878 /end CHARACTERISTIC
/begin CHARACTERISTIC FlSys_facStoich_C "stöchiometrischer Kraftstofffaktor" VALUE 0x8003BDA6 Val_Ws16 511.9922 Fact1 -256.0000 255.9922 /end CHARACTERISTIC
/begin CHARACTERISTIC FlSys_nDeflateMax_C "obere Drehzahlschwelle für die Entlüftung Niederdruckkreis" VALUE 0x8003BDB8 Val_Ws16 16383.50 EngN 0.00 16383.50 EXTENDED_LIMITS -16384.00 16383.50 /end CHARACTERISTIC
/begin CHARACTERISTIC FlSys_nDeflateMin_C "untere Drehzahlschwelle für die Entlüftung Niederdruckkreis" VALUE 0x8003BDBA Val_Ws16 16383.50 EngN 0.00 16383.50 EXTENDED_LIMITS -16384.00 16383.50 /end CHARACTERISTIC
/begin CHARACTERISTIC FlSys_pDeflate_C "Raildruckschwelle für die Entlüftung Niederdruckkreis" VALUE 0x8003BDBC Val_Ws16 2000.000 Pres_Rail 0.00 2000.000 EXTENDED_LIMITS -3276.800 3276.700 /end CHARACTERISTIC
/begin CHARACTERISTIC FlSys_rhoFlCnvFac_C "kundenspezifischer Kraftstoffumrechnungsfaktor" VALUE 0x8003BDA8 Val_Ws16 999.9000 RhoFuel 0.1000000 1000.000 FORMAT "%8.3" EXTENDED_LIMITS -3276.800 3276.700 /end CHARACTERISTIC
/begin CHARACTERISTIC FlSys_rhoFl_C "Kraftstoffdichte bei Normal Temperatur" VALUE 0x8003BDAA Val_Ws16 999.9000 RhoFuel 0.1000000 1000.000 FORMAT "%8.3" EXTENDED_LIMITS -3276.800 3276.700 /end CHARACTERISTIC
/begin CHARACTERISTIC FlSys_rhoFl_CUR "temperaturabhängige Kraftstoffdichte" CURVE 0x8003BDAC Cur_Xs16Ws16 999.9000 RhoFuel 0.1000000 1000.000 FORMAT "%8.3" EXTENDED_LIMITS -3276.800 3276.700
 /begin AXIS_DESCR STD_AXIS FuelT_t Temp_Cels 2 -50.14000 149.8600 EXTENDED_LIMITS -3549.940 3003.560 DEPOSIT ABSOLUTE /end AXIS_DESCR
/end CHARACTERISTIC
/begin CHARACTERISTIC FlSys_rhoFuel_C "Kraftstoffdichte" VALUE 0x8003BDF2 Kw_Ws16 1500.000 RhoFuel 0.00 1500.000 FORMAT "%8.3" EXTENDED_LIMITS -3276.800 3276.700 /end CHARACTERISTIC
/begin CHARACTERISTIC FlSys_stSubsRgnMsk_C "Maske für Umschaltung auf Ersatzkennfel" VALUE 0x8003BDF4 Kw_Wu32 4294967295.00 OneToOne 0.00 4294967295.00 /end CHARACTERISTIC
/begin CHARACTERISTIC FlSys_swtBFlTnkDes_C "Remote Control Schalter für die Auswahl der binarären Tankfüllstandsanzeige" VALUE 0x8003BDD6 Val_Wu8 1.000 OneToOne 0.00 1.000 EXTENDED_LIMITS 0.00 255.0 /end CHARACTERISTIC
/begin CHARACTERISTIC FlSys_swtRhoFlCnv_C "Schalter für kundenspezifischen Kraftstoffumrechnungsfaktor" VALUE 0x8003BDB6 Val_Wu8 1.000 OneToOne 0.00 1.000 EXTENDED_LIMITS 0.00 255.0 /end CHARACTERISTIC
/begin CHARACTERISTIC FlSys_swtTnkInfo_C "Konstante zur Umschaltung der Informationsquelle über den Tankfüllstand" VALUE 0x8003BDD7 Val_Wu8 1.00000000000 FlSys_swtTnkInfo_VERB 0.00 1.00000000000 FORMAT "%13.11" /end CHARACTERISTIC
/begin CHARACTERISTIC FlSys_swtVolFlTnkQntDes_C "Remote Control Schalter für die Auswahl der Tankfüllstandsanzeige" VALUE 0x8003BDD8 Val_Wu8 1.000 OneToOne 0.00 1.000 EXTENDED_LIMITS 0.00 255.0 /end CHARACTERISTIC
/begin CHARACTERISTIC FlSys_tiDeflateDel_C "Verzögerungszeit für die Entlüftung Niederdruckkreis" VALUE 0x8003BDBE Val_Ws16 327670.0 Time_ms 0.00 327670.0 EXTENDED_LIMITS -327680.0 327670.0 /end CHARACTERISTIC
/begin CHARACTERISTIC FlSys_tiDeflatePCVClose_C "" VALUE 0x8003BDC0 Val_Ws32 65535.0000000 Time_s 0.00 65535.0000000 EXTENDED_LIMITS -21474836.4800 21474836.4700 /end CHARACTERISTIC
/begin CHARACTERISTIC FlSys_tiDeflatePCVOpen_C "" VALUE 0x8003BDC4 Val_Ws32 65535.0000000 Time_s 0.00 65535.0000000 EXTENDED_LIMITS -21474836.4800 21474836.4700 /end CHARACTERISTIC
/begin CHARACTERISTIC FlSys_tiDeflate_C "Entlüftungszeit des Niederdruckkreislaufs" VALUE 0x8003BDC8 Val_Ws16 327670.0 Time_ms 0.00 327670.0 EXTENDED_LIMITS -327680.0 327670.0 /end CHARACTERISTIC
/begin CHARACTERISTIC FlSys_tiMaxDeflateTst_C "Maximale Zeitdauer des Motortests" VALUE 0x8003BDCC Val_Ws32 65530.0000000 Time_ms 10.0000000000 65540.0000000 EXTENDED_LIMITS -21474836480.0 21474836470.0 /end CHARACTERISTIC
/begin CHARACTERISTIC FlSys_volFlConsTnkHi_C "Dieser Parameter beschreibt den Verbrauch, der zum Rücksetzen des Fehlers überschritten werden muss" VALUE 0x8003BDDA Val_Ws16 655.3500 Vol -327.6800 327.6700 FORMAT "%8.4" /end CHARACTERISTIC
/begin CHARACTERISTIC FlSys_volFlTnkQntDes_C "Kalibrierungswert für Tankzustandsanzeige über Remote Control" VALUE 0x8003BDDC Val_Ws16 100.0000 Vol 0.00 100.0000 FORMAT "%8.4" EXTENDED_LIMITS -327.6800 327.6700 /end CHARACTERISTIC
/begin CHARACTERISTIC FlSys_volTnkDelta_C "Parameter für die Hysterese zum Tankstand" VALUE 0x8003BDDE Val_Ws16 100.0000 Vol 0.00 100.0000 FORMAT "%8.4" EXTENDED_LIMITS -327.6800 327.6700 /end CHARACTERISTIC
/begin CHARACTERISTIC FlSys_volTnkLo_C "Parameter für die Hysterese zum Tankstand" VALUE 0x8003BDE0 Val_Ws16 100.0000 Vol 0.00 100.0000 FORMAT "%8.4" EXTENDED_LIMITS -327.6800 327.6700 /end CHARACTERISTIC
/begin CHARACTERISTIC FMA_dfacSwtOffMax_C "Maximal zulässige Änderungsgeschwindigkeit der temperaturabhängigen Abschaltfaktoren" VALUE 0x8003B85C Kw_Ws32 50.0000007451 Rmp_Fact 0.00 50.0000007451 FORMAT "%13.10" EXTENDED_LIMITS -4000.00000000 3999.99999814 /end CHARACTERISTIC
/begin CHARACTERISTIC FMA_dqThres_C "Schwelle für Erkennung starker Einspritzmengenänderungen der FMA" VALUE 0x8003B860 Kw_Ws16 200.0000 InjMassSec 0.00 200.0000 FORMAT "%8.4" EXTENDED_LIMITS -327.6800 327.6700 /end CHARACTERISTIC
/begin CHARACTERISTIC FMA_drLamThres_C "Schwelle für Erkennung starker Lambdaänderung der FMA" VALUE 0x8003B862 Kw_Ws16 10.20000 lambdaSec -0.2000000 10.00000 FORMAT "%8.5" EXTENDED_LIMITS -32.76800 32.76700 /end CHARACTERISTIC
/begin CHARACTERISTIC FMA_facAirSwtOff_CUR "Kennlinie des ansauglufttemperaturabhängigen Abschaltfaktors der FMA" CURVE 0x8003B864 Kl_Xs16_Ws16 1.000000 Fact 0.00 1.000000 EXTENDED_LIMITS -4.000000 3.999878
 /begin AXIS_DESCR STD_AXIS Air_tCACDs Temp_Cels 8 -50.14000 199.8600 EXTENDED_LIMITS -3549.940 3003.560 DEPOSIT ABSOLUTE /end AXIS_DESCR
/end CHARACTERISTIC
/begin CHARACTERISTIC FMA_facAPSwtOff_CUR "Kennlinie des atmosphärendruckabhängigen Abschaltfaktors der FMA" CURVE 0x8003B886 Kl_Xs16_Ws16 1.000000 Fact 0.00 1.000000 EXTENDED_LIMITS -4.000000 3.999878
 /begin AXIS_DESCR STD_AXIS EnvP_p Pres_hPa 8 0.00 3500.000 EXTENDED_LIMITS -32768.00 32767.00 DEPOSIT ABSOLUTE /end AXIS_DESCR
/end CHARACTERISTIC
/begin CHARACTERISTIC FMA_facDensCor_C "Faktor für Dichtekorrektur bei Angabe der Kraftstoffmenge in" VALUE 0x8003B730 Kw_Ws16 0.1999512 Fact 0.8000488 1.000000 EXTENDED_LIMITS -4.000000 3.999878 /end CHARACTERISTIC
/begin CHARACTERISTIC FMA_facEngSwtOff_CUR "Kennlinie des motortemperaturabhängigen Abschaltfaktors der FMA" CURVE 0x8003B8A8 Kl_Xs16_Ws16 1.000000 Fact 0.00 1.000000 EXTENDED_LIMITS -4.000000 3.999878
 /begin AXIS_DESCR STD_AXIS EngDa_tEng Temp_Cels 8 -50.14000 149.8600 EXTENDED_LIMITS -3549.940 3003.560 DEPOSIT ABSOLUTE /end AXIS_DESCR
/end CHARACTERISTIC
/begin CHARACTERISTIC FMA_facFlSwtOff_CUR "Kennlinie des kraftstofftemperaturabhängigen Abschaltfaktors der FMA" CURVE 0x8003B8CA Kl_Xs16_Ws16 1.000000 Fact 0.00 1.000000 EXTENDED_LIMITS -4.000000 3.999878
 /begin AXIS_DESCR STD_AXIS FuelT_t Temp_Cels 8 -50.14000 149.8600 EXTENDED_LIMITS -3549.940 3003.560 DEPOSIT ABSOLUTE /end AXIS_DESCR
/end CHARACTERISTIC
/begin CHARACTERISTIC FMA_facNQSwtOff_MAP "Kennfeld des motodrehzahl-/einspritzmengenabhängigen Abschaltfaktors der FMA für betriebsbereichsabhängige Abschaltung" MAP 0x8003B738 Kf_Xs16_Ys16_Ws16 1.000000 Fact 0.00 1.000000 EXTENDED_LIMITS -4.000000 3.999878
 /begin AXIS_DESCR STD_AXIS Epm_nEng EngN 4 0.00 10000.00 EXTENDED_LIMITS -16384.00 16383.50 DEPOSIT ABSOLUTE /end AXIS_DESCR
 /begin AXIS_DESCR STD_AXIS FMA_qCtl_mp InjMass 4 0.00 327.6700 EXTENDED_LIMITS -327.6800 327.6700 DEPOSIT ABSOLUTE /end AXIS_DESCR
/end CHARACTERISTIC
/begin CHARACTERISTIC FMA_IFst.Ki_C "Integriererverstärkung der FMA (schnelles Einlernen des Kennfelds)/" VALUE 0x8003B76C Kw_Ws32 4.00003045797 Ki 0.00 4.00003045797 FORMAT "%13.11" EXTENDED_LIMITS -1000000.00000 999999.999534 /end CHARACTERISTIC
/begin CHARACTERISTIC FMA_IFst.KiPos_C "Integriererverstärkung der FMA (schnelles Einlernen des Kennfelds)/" VALUE 0x8003B770 Kw_Ws32 4.00003045797 Ki 0.00 4.00003045797 FORMAT "%13.11" EXTENDED_LIMITS -1000000.00000 999999.999534 /end CHARACTERISTIC
/begin CHARACTERISTIC FMA_IFst.KiNeg_C "Integriererverstärkung der FMA (schnelles Einlernen des Kennfelds)/" VALUE 0x8003B774 Kw_Ws32 4.00003045797 Ki 0.00 4.00003045797 FORMAT "%13.11" EXTENDED_LIMITS -1000000.00000 999999.999534 /end CHARACTERISTIC
/begin CHARACTERISTIC FMA_IFst.WinPos_C "Integriererverstärkung der FMA (schnelles Einlernen des Kennfelds)/" VALUE 0x8003B778 Kw_Ws32 20.0000000000 InjMass 0.00 20.0000000000 EXTENDED_LIMITS -21474836.4800 21474836.4700 /end CHARACTERISTIC
/begin CHARACTERISTIC FMA_IFst.WinNeg_C "Integriererverstärkung der FMA (schnelles Einlernen des Kennfelds)/" VALUE 0x8003B77C Kw_Ws32 20.0000000000 InjMass -20.0000000000 0.00 EXTENDED_LIMITS -21474836.4800 21474836.4700 /end CHARACTERISTIC
/begin CHARACTERISTIC FMA_ISlw.Ki_C "Integriererverstärkung der FMA (langsames Einlernen des Kennfelds)/" VALUE 0x8003B780 Kw_Ws32 4.00003045797 Ki 0.00 4.00003045797 FORMAT "%13.11" EXTENDED_LIMITS -1000000.00000 999999.999534 /end CHARACTERISTIC
/begin CHARACTERISTIC FMA_ISlw.KiPos_C "Integriererverstärkung der FMA (langsames Einlernen des Kennfelds)/" VALUE 0x8003B784 Kw_Ws32 4.00003045797 Ki 0.00 4.00003045797 FORMAT "%13.11" EXTENDED_LIMITS -1000000.00000 999999.999534 /end CHARACTERISTIC
/begin CHARACTERISTIC FMA_ISlw.KiNeg_C "Integriererverstärkung der FMA (langsames Einlernen des Kennfelds)/" VALUE 0x8003B788 Kw_Ws32 4.00003045797 Ki 0.00 4.00003045797 FORMAT "%13.11" EXTENDED_LIMITS -1000000.00000 999999.999534 /end CHARACTERISTIC
/begin CHARACTERISTIC FMA_ISlw.WinPos_C "Integriererverstärkung der FMA (langsames Einlernen des Kennfelds)/" VALUE 0x8003B78C Kw_Ws32 20.0000000000 InjMass 0.00 20.0000000000 EXTENDED_LIMITS -21474836.4800 21474836.4700 /end CHARACTERISTIC
/begin CHARACTERISTIC FMA_ISlw.WinNeg_C "Integriererverstärkung der FMA (langsames Einlernen des Kennfelds)/" VALUE 0x8003B790 Kw_Ws32 20.0000000000 InjMass -20.0000000000 0.00 EXTENDED_LIMITS -21474836.4800 21474836.4700 /end CHARACTERISTIC
/begin CHARACTERISTIC FMA_nThres_C "Drehzahlschwelle für Schuberkennung der FMA" VALUE 0x8003B8EC Kw_Ws16 9980.000 EngN 20.00000 10000.00 EXTENDED_LIMITS -16384.00 16383.50 /end CHARACTERISTIC
/begin CHARACTERISTIC FMA_numLimMax_C "maximale Anzahl der Kennfeldpunkte, die den oberen Grenzwert überschreiten dürfen" VALUE 0x8003B794 Kw_Ws16 32767.00 OneToOne 0.00 32767.00 EXTENDED_LIMITS -32768.00 32767.00 /end CHARACTERISTIC
/begin CHARACTERISTIC FMA_numLimMin_C "maximale Anzahl der Kennfeldpunkte, die den unteren Grenzwert unterschreiten dürfen" VALUE 0x8003B796 Kw_Ws16 32767.00 OneToOne 0.00 32767.00 EXTENDED_LIMITS -32768.00 32767.00 /end CHARACTERISTIC
/begin CHARACTERISTIC FMA_numNGrid_C "Anzahl der Drehzahlstützstellen des adaptiven Kenfelds" VALUE 0x8003B798 Kw_Wu8 6.000 OneToOne 2.000 8.000 EXTENDED_LIMITS 0.00 255.0 /end CHARACTERISTIC
/begin CHARACTERISTIC FMA_numQGrid_C "Anzahl der Mengenstützstellen des adaptiven Kenfelds" VALUE 0x8003B799 Kw_Wu8 6.000 OneToOne 2.000 8.000 EXTENDED_LIMITS 0.00 255.0 /end CHARACTERISTIC
/begin CHARACTERISTIC FMA_qAdapIni_GMAP "Initialisierungskennfeld" MAP 0x8003B79A MapG_Ws16 80.00000 InjMass -40.00000 40.00000 EXTENDED_LIMITS -327.6800 327.6700
 /begin AXIS_DESCR COM_AXIS InjCtl_qSetUnBal InjMass 8 0.00 327.6700 EXTENDED_LIMITS -327.6800 327.6700 AXIS_PTS_REF FMA_qAdapIni_X_AXIS /end AXIS_DESCR
 /begin AXIS_DESCR COM_AXIS Epm_nEng EngN 8 0.00 10000.00 EXTENDED_LIMITS -16384.00 16383.50 AXIS_PTS_REF FMA_qAdapIni_Y_AXIS /end AXIS_DESCR
/end CHARACTERISTIC
/begin AXIS_PTS FMA_qAdapIni_X_AXIS "x-Axis für Initialisierungskennfeld" 0x8003B81A InjCtl_qSetUnBal Axis_Xs16 327.6700 InjMass 8 0.00 327.6700 FORMAT "%8.4" EXTENDED_LIMITS -327.6800 327.6700 DEPOSIT ABSOLUTE /end AXIS_PTS
/begin AXIS_PTS FMA_qAdapIni_Y_AXIS "y-Axis für Initialisierungskennfeld" 0x8003B82C Epm_nEng Axis_Xs16 10000.00 EngN 8 0.00 10000.00 FORMAT "%8.2" EXTENDED_LIMITS -16384.00 16383.50 DEPOSIT ABSOLUTE /end AXIS_PTS
/begin CHARACTERISTIC FMA_qIntMax_C "Maximal zulässiger Wert für adaptierte Mengenfehler in den Lernpunkten , d.h. für Zustände der Integratoren und PT1-Glieder" VALUE 0x8003B83E Kw_Ws16 80.00000 InjMass -40.00000 40.00000 EXTENDED_LIMITS -327.6800 327.6700 /end CHARACTERISTIC
/begin CHARACTERISTIC FMA_qIntMin_C "Minimal zulässiger Wert für adaptierte Mengenfehler in den Lernpunkten , d.h. für Zustände der Integratoren und PT1-Glieder" VALUE 0x8003B840 Kw_Ws16 80.00000 InjMass -40.00000 40.00000 EXTENDED_LIMITS -327.6800 327.6700 /end CHARACTERISTIC
/begin CHARACTERISTIC FMA_qLimMax_C "oberer Grenzwert für OBD-Überwachung" VALUE 0x8003B842 Kw_Ws16 20.00000 InjMass -10.00000 10.00000 EXTENDED_LIMITS -327.6800 327.6700 /end CHARACTERISTIC
/begin CHARACTERISTIC FMA_qLimMin_C "unterer Grenzwert für OBD-Überwachung" VALUE 0x8003B844 Kw_Ws16 20.00000 InjMass -10.00000 10.00000 EXTENDED_LIMITS -327.6800 327.6700 /end CHARACTERISTIC
/begin CHARACTERISTIC FMA_qMapMax_C "Maximal zulässiger Wert für adaptierte Mengenfehler in den Lernpunkten" VALUE 0x8003B846 Kw_Ws16 80.00000 InjMass -40.00000 40.00000 EXTENDED_LIMITS -327.6800 327.6700 /end CHARACTERISTIC
/begin CHARACTERISTIC FMA_qMapMin_C "Minimal zulässiger Wert für adaptierte Mengenfehler in den Lernpunkten" VALUE 0x8003B848 Kw_Ws16 80.00000 InjMass -40.00000 40.00000 EXTENDED_LIMITS -327.6800 327.6700 /end CHARACTERISTIC
/begin CHARACTERISTIC FMA_qMax_C "Oberer Grenzwert für Einspritzmengenkorrektur der FMA" VALUE 0x8003B84A Kw_Ws16 80.00000 InjMass -40.00000 40.00000 EXTENDED_LIMITS -327.6800 327.6700 /end CHARACTERISTIC
/begin CHARACTERISTIC FMA_qMin_C "Unterer Grenzwert für Einspritzmengenkorrektur der FMA" VALUE 0x8003B84C Kw_Ws16 80.00000 InjMass -40.00000 40.00000 EXTENDED_LIMITS -327.6800 327.6700 /end CHARACTERISTIC
/begin CHARACTERISTIC FMA_qThres_C "Einspritzmengenschwelle für Schuberkennung der FMA" VALUE 0x8003B8EE Kw_Ws16 40.00000 InjMass 0.00 40.00000 EXTENDED_LIMITS -327.6800 327.6700 /end CHARACTERISTIC
/begin CHARACTERISTIC FMA_rLamThresMax_C "Obere Grenze des für FMA zulässigen Lambdabereichs" VALUE 0x8003B8F0 Kw_Ws16 10.20000 lambda -0.2000000 10.00000 EXTENDED_LIMITS -32.76800 32.76700 /end CHARACTERISTIC
/begin CHARACTERISTIC FMA_rLamThresMin_C "Untere Grenze des für FMA zulässigen Lambdabereichs" VALUE 0x8003B8F2 Kw_Ws16 10.20000 lambda -0.2000000 10.00000 EXTENDED_LIMITS -32.76800 32.76700 /end CHARACTERISTIC
/begin CHARACTERISTIC FMA_stRgnMsk_C "Bitmaske zur Abschaltung der FMA bei bestimmten Regenerationszuständen" VALUE 0x8003B8F4 Kw_Wu32 4294967295.00 OneToOne 0.00 4294967295.00 /end CHARACTERISTIC
/begin CHARACTERISTIC FMA_swtChngValErrMod_C "Schalter zur Initialisierung des Lernkennfeldes" VALUE 0x8003B84E Kw_Wu8 2.000 OneToOne 0.00 2.000 EXTENDED_LIMITS 0.00 255.0 /end CHARACTERISTIC
/begin CHARACTERISTIC FMA_swtCorOff_C "Schalter zum Deaktivieren der FMA Korrektur" VALUE 0x8003B732 Kw_Wu8 1.000 OneToOne 0.00 1.000 EXTENDED_LIMITS 0.00 255.0 /end CHARACTERISTIC
/begin CHARACTERISTIC FMA_swtIC_C "Schalter für Betriebsartauswahl der FMA (Indirect Control - Direct Control)" VALUE 0x8003B733 Kw_Wu8 1.000 OneToOne 0.00 1.000 EXTENDED_LIMITS 0.00 255.0 READ_ONLY /end CHARACTERISTIC
/begin CHARACTERISTIC FMA_swtOnFMA_C "Schalter zum Ein-/Ausschalten der gesamten FMA" VALUE 0x8003B8F8 Kw_Wu8 1.000 OneToOne 0.00 1.000 EXTENDED_LIMITS 0.00 255.0 /end CHARACTERISTIC
/begin CHARACTERISTIC FMA_swtRst_C "Schalter zur Reinitialisierung des Fehlermodells" VALUE 0x8003B84F Kw_Wu8 1.000 OneToOne 0.00 1.000 EXTENDED_LIMITS 0.00 255.0 /end CHARACTERISTIC
/begin CHARACTERISTIC FMA_tiDLamThres_C "Wartezeit bis der FMA- Lambdaänderungsstatus nach Ende der Lambdaänderung zurückgesetzt wird" VALUE 0x8003B8FA Kw_Ws16 20.00000 Time_s 0.00 20.00000 EXTENDED_LIMITS -327.6800 327.6700 /end CHARACTERISTIC
/begin CHARACTERISTIC FMA_tiDynThres_C "Wartezeit bis der FMA-Einspritzmengendynamikstatus nach Ende der Einspritzmengenänderung zurückgesetzt wird" VALUE 0x8003B8FC Kw_Ws16 20.00000 Time_s 0.00 20.00000 EXTENDED_LIMITS -327.6800 327.6700 /end CHARACTERISTIC
/begin CHARACTERISTIC FMA_tiFaultRmp_C "Dauer des rampenförmigen Abschaltens der FMA bei schweren Systemfehlern" VALUE 0x8003B900 Kw_Ws32 40.0000000000 Time_s 0.00 40.0000000000 EXTENDED_LIMITS -21474836.4800 21474836.4700 /end CHARACTERISTIC
/begin CHARACTERISTIC FMA_tiLamDT1_C "Verzögerungszeitkonstante der Differentiation von Lambda in der FMA" VALUE 0x8003B904 Kw_Ws32 3.9980384506 TimeDelay_s 0.0010000000689 3.9990384507 FORMAT "%12.10" EXTENDED_LIMITS 0.000002000000001 4294.9672960 /end CHARACTERISTIC
/begin CHARACTERISTIC FMA_tiLamThres_C "Wartezeit bis der FMA- Lambdabereichstatus nach Bereichs-verletzung zurückgesetzt wird" VALUE 0x8003B908 Kw_Ws16 20.00000 Time_s 0.00 20.00000 EXTENDED_LIMITS -327.6800 327.6700 /end CHARACTERISTIC
/begin CHARACTERISTIC FMA_tiOvrRun_C "Wartezeit bis der FMA-Schbstatus nach Schubende zurückgesetzt wird" VALUE 0x8003B90A Kw_Ws16 20.00000 Time_s 0.00 20.00000 EXTENDED_LIMITS -327.6800 327.6700 /end CHARACTERISTIC
/begin CHARACTERISTIC FMA_tiPT1Fst_C "Zeitkonstante der PT1-Filter zur Filterung des aktuellen Mengenfehlers (schnelles Einlernen des Kennfelds)" VALUE 0x8003B850 Kw_Ws32 4294.9662960 TimeDelay_s 0.0010000000689 4294.9672960 FORMAT "%12.7" EXTENDED_LIMITS 0.000002000000001 4294.9672960 /end CHARACTERISTIC
/begin CHARACTERISTIC FMA_tiPT1Slw_C "Zeitkonstante der PT1-Filter zur Filterung des aktuellen Mengenfehlers (langsames Einlernen des Kennfelds)" VALUE 0x8003B854 Kw_Ws32 4294.9662960 TimeDelay_s 0.0010000000689 4294.9672960 FORMAT "%12.7" EXTENDED_LIMITS 0.000002000000001 4294.9672960 /end CHARACTERISTIC
/begin CHARACTERISTIC FMA_tiQDT1_C "Vezögerungszeitkonstante der Differentiation der Einspritzmenge für Erkennung starker Mengenänderungen der FMA" VALUE 0x8003B90C Kw_Ws32 3.9980384506 TimeDelay_s 0.0010000000689 3.9990384507 FORMAT "%12.10" EXTENDED_LIMITS 0.000002000000001 4294.9672960 /end CHARACTERISTIC
/begin CHARACTERISTIC FMA_tiQLam_C "Verzögerungszeit nach einer Resetierung um die Adaption zuzulassen" VALUE 0x8003B910 Kw_Ws16 20.00000 Time_s 0.00 20.00000 EXTENDED_LIMITS -327.6800 327.6700 /end CHARACTERISTIC
/begin CHARACTERISTIC FMA_tiSwtPar_C "Betriebszeit der FMA, nach der von schnellem auf langsames Lernen umgeschaltet wird" VALUE 0x8003B858 Kw_Ws32 1000000.00000 Time_s 0.00 1000000.00000 EXTENDED_LIMITS -21474836.4800 21474836.4700 /end CHARACTERISTIC
/begin CHARACTERISTIC FMA_trqLimMax_C "maximales FMA- Korrekturmoment" VALUE 0x8003B734 Kw_Ws16 40.00000 Trq 40.00000 80.00000 EXTENDED_LIMITS -3276.800 3276.700 /end CHARACTERISTIC
/begin CHARACTERISTIC FMA_trqLimMin_C "Minimales FMA - Korrekturmoment" VALUE 0x8003B736 Kw_Ws16 40.00000 Trq -80.00000 -40.00000 EXTENDED_LIMITS -3276.800 3276.700 /end CHARACTERISTIC
/begin CHARACTERISTIC Frm_MoFFrmFalsify_C "" VALUE 0x80020CE4 Val_Wu8 3.000 OneToOne 0.00 3.000 EXTENDED_LIMITS 0.00 255.0 /end CHARACTERISTIC
/begin CHARACTERISTIC FuelT_RmpSlp.Pos_C "/" VALUE 0x8006415C Kw_Ws32 3276798.99750 RmpTemp 1.00097656250 3276799.99847 FORMAT "%13.5" EXTENDED_LIMITS -3276800.00000 3276799.99847 /end CHARACTERISTIC
/begin CHARACTERISTIC FuelT_RmpSlp.Neg_C "/" VALUE 0x80064160 Kw_Ws32 3276798.99750 RmpTemp 1.00097656250 3276799.99847 FORMAT "%13.5" EXTENDED_LIMITS -3276800.00000 3276799.99847 /end CHARACTERISTIC
/begin CHARACTERISTIC FuelT_SRC.uMin_C "/" VALUE 0x80064106 Kw_Ws16 200.0000 Volt 0.00 200.0000 EXTENDED_LIMITS -6553.600 6553.400 /end CHARACTERISTIC
/begin CHARACTERISTIC FuelT_SRC.uMax_C "/" VALUE 0x80064108 Kw_Ws16 3200.000 Volt 2000.000 5200.000 EXTENDED_LIMITS -6553.600 6553.400 /end CHARACTERISTIC
/begin CHARACTERISTIC FuelT_swtSensPrs_C "Sensorkonfigurationssschalter" VALUE 0x80064164 Kw_Wu8 255.0 OneToOne 0.00 255.0 /end CHARACTERISTIC
/begin CHARACTERISTIC FuelT_swtTempSel_C "Schalter zur Anzeige von dem Vorhandensein des Kraftstofftempertursensors" VALUE 0x80064165 Kw_Wu8 255.0 OneToOne 0.00 255.0 /end CHARACTERISTIC
/begin CHARACTERISTIC FuelT_tDflFlSys_C "Vorgabewert der Kraftstoffsystemtemperatur" VALUE 0x80064166 Kw_Ws16 6553.500 Temp_Cels -3549.940 3003.560 /end CHARACTERISTIC
/begin CHARACTERISTIC FuelT_tiLPFiltPT1_C "" VALUE 0x80064168 Kw_Ws32 4294.9672940 TimeDelay_s 0.000002000000001 4294.9672960 FORMAT "%12.7" /end CHARACTERISTIC
/begin CHARACTERISTIC FuelT_TransStg.Dfl_C "/" VALUE 0x8006416C Kw_Ws16 250.0000 Temp_Cels -50.04000 199.9600 EXTENDED_LIMITS -3549.940 3003.560 /end CHARACTERISTIC
/begin CHARACTERISTIC FuelT_TransStg.stSensId_C "/" VALUE 0x8006416E Kw_Wu8 255.0 OneToOne 0.00 255.0 /end CHARACTERISTIC
/begin CHARACTERISTIC FuelT_tTransf_CUR "Kennlinie zur Konvertierung der ADC-Spannung in erfasste Temperatur" CURVE 0x8006410A Cur_Xs16Ws16 250.0000 Temp_Cels -50.04000 199.9600 EXTENDED_LIMITS -3549.940 3003.560
 /begin AXIS_DESCR STD_AXIS FuelT_uRaw Volt 20 0.00 5200.000 EXTENDED_LIMITS -6553.600 6553.400 DEPOSIT ABSOLUTE /end AXIS_DESCR
/end CHARACTERISTIC
/begin CHARACTERISTIC GbxNPos_dcycPwmInMax_C "" VALUE 0x8003C134 Val_Wu16 655.3500 DtyCyc 0.00 655.3500 /end CHARACTERISTIC
/begin CHARACTERISTIC GbxNPos_dcycPwmInMin_C "" VALUE 0x8003C136 Val_Wu16 655.3500 DtyCyc 0.00 655.3500 /end CHARACTERISTIC
/begin CHARACTERISTIC GbxNPos_rTransfNPos_CUR "" CURVE 0x8003C148 Cur_Xs16Ws16 655.3500 DtyCyc -327.6800 327.6700
 /begin AXIS_DESCR STD_AXIS GbxNPos_rRawNPos DtyCyc 6 -327.6800 327.6700 DEPOSIT ABSOLUTE /end AXIS_DESCR
/end CHARACTERISTIC
/begin CHARACTERISTIC GbxNPos_swtRecDeAct_C "" VALUE 0x8003C162 Val_Wu8 1.000 OneToOne 0.00 1.000 EXTENDED_LIMITS 0.00 255.0 /end CHARACTERISTIC
/begin CHARACTERISTIC GbxNPos_tiPerMax_C "" VALUE 0x8003C138 Val_Ws32 214748364.750 Time_PwmHigh -107374182.400 107374182.350 FORMAT "%13.3" /end CHARACTERISTIC
/begin CHARACTERISTIC GbxNPos_tiPerPwmInMax_C "" VALUE 0x8003C13C Val_Wu32 214748364.750 Time_PwmHigh 0.00 214748364.750 FORMAT "%13.3" /end CHARACTERISTIC
/begin CHARACTERISTIC GbxNPos_tiPerPwmInMin_C "" VALUE 0x8003C140 Val_Wu32 214748364.750 Time_PwmHigh 0.00 214748364.750 FORMAT "%13.3" /end CHARACTERISTIC
/begin CHARACTERISTIC GbxNPos_tiRecDeb_C "" VALUE 0x8003C164 Val_Ws16 1000.000 Time_ms 0.00 1000.000 EXTENDED_LIMITS -327680.0 327670.0 /end CHARACTERISTIC
/begin CHARACTERISTIC Gbx_ctNPosUnPlsDec_C "" VALUE 0x8003C166 Val_Wu8 255.0 OneToOne 0.00 255.0 /end CHARACTERISTIC
/begin CHARACTERISTIC Gbx_ctNPosUnPlsHigh_C "" VALUE 0x8003C167 Val_Wu8 255.0 OneToOne 0.00 255.0 /end CHARACTERISTIC
/begin CHARACTERISTIC Gbx_ctNPosUnPlsLow_C "" VALUE 0x8003C168 Val_Wu8 255.0 OneToOne 0.00 255.0 /end CHARACTERISTIC
/begin CHARACTERISTIC Gbx_NPosDeb.tiHiLo_C "/" VALUE 0x8003C144 Kw_Ws16 655350.0 TimeDeb -327680.0 327670.0 /end CHARACTERISTIC
/begin CHARACTERISTIC Gbx_NPosDeb.tiLoHi_C "/" VALUE 0x8003C146 Kw_Ws16 655350.0 TimeDeb -327680.0 327670.0 /end CHARACTERISTIC
/begin CHARACTERISTIC Gbx_tiNPosPls_C "" VALUE 0x8003C16A Val_Ws16 327670.0 Time_ms 0.00 327670.0 EXTENDED_LIMITS -327680.0 327670.0 /end CHARACTERISTIC
/begin CHARACTERISTIC Gbx_tiNPosUnPls_C "" VALUE 0x8003C16C Val_Ws16 327670.0 Time_ms 0.00 327670.0 EXTENDED_LIMITS -327680.0 327670.0 /end CHARACTERISTIC
/begin CHARACTERISTIC Gbx_trqNPosMax_C "" VALUE 0x8003C16E Val_Ws16 500.0000 Trq 0.00 500.0000 EXTENDED_LIMITS -3276.800 3276.700 /end CHARACTERISTIC
/begin CHARACTERISTIC Gbx_trqNPosMin_C "" VALUE 0x8003C170 Val_Ws16 500.0000 Trq -500.0000 0.00 EXTENDED_LIMITS -3276.800 3276.700 /end CHARACTERISTIC
/begin MEASUREMENT Com_dDtGrdtDrvCHK_FA "" UBYTE OneToOne 1 100 0.00 255.0 ECU_ADDRESS 0xD0001C83 /end MEASUREMENT
/begin MEASUREMENT Com_dDtGrdtDrvCTR_FA "" UWORD OneToOne 1 100 0.00 65535.00 ECU_ADDRESS 0xD000150E /end MEASUREMENT
/begin MEASUREMENT Com_dGbx2CHK "" UBYTE OneToOne 1 100 0.00 255.0 ECU_ADDRESS 0xD0001C84 /end MEASUREMENT
/begin MEASUREMENT Com_dGbx2CTR "" UWORD OneToOne 1 100 0.00 65535.00 ECU_ADDRESS 0xD0001512 /end MEASUREMENT
/begin MEASUREMENT Com_dGbx3CHK "" UBYTE OneToOne 1 100 0.00 255.0 ECU_ADDRESS 0xD0001C85 /end MEASUREMENT
/begin MEASUREMENT Com_dGbx3CTR "" UWORD OneToOne 1 100 0.00 65535.00 ECU_ADDRESS 0xD0001514 /end MEASUREMENT
/begin MEASUREMENT Com_dGbxCHK "" UBYTE OneToOne 1 100 0.00 255.0 ECU_ADDRESS 0xD0001C86 /end MEASUREMENT
/begin MEASUREMENT Com_dGbxCTR "" UWORD OneToOne 1 100 0.00 65535.00 ECU_ADDRESS 0xD0001516 /end MEASUREMENT
/begin MEASUREMENT Com_dGbxDataCHK_A "" UBYTE OneToOne 1 100 0.00 255.0 ECU_ADDRESS 0xD0001C87 /end MEASUREMENT
/begin MEASUREMENT Com_dGbxDataCHK_FA "" UBYTE OneToOne 1 100 0.00 255.0 ECU_ADDRESS 0xD0001C88 /end MEASUREMENT
/begin MEASUREMENT Com_dGbxDataCTR_A "" UWORD OneToOne 1 100 0.00 65535.00 ECU_ADDRESS 0xD0001518 /end MEASUREMENT
/begin MEASUREMENT Com_dGbxDataCTR_FA "" UWORD OneToOne 1 100 0.00 65535.00 ECU_ADDRESS 0xD000151A /end MEASUREMENT
/begin MEASUREMENT Com_dGbxDriveTrainCHK "" UBYTE OneToOne 1 100 0.00 255.0 ECU_ADDRESS 0xD0001C89 /end MEASUREMENT
/begin MEASUREMENT Com_dGbxDriveTrainCTR "" UWORD OneToOne 1 100 0.00 65535.00 ECU_ADDRESS 0xD000151C /end MEASUREMENT
/begin MEASUREMENT Com_dTrqDemandDKGCHK "" UBYTE OneToOne 1 100 0.00 255.0 ECU_ADDRESS 0xD0001CA8 /end MEASUREMENT
/begin MEASUREMENT Com_dTrqDemandDKGCTR "" UWORD OneToOne 1 100 0.00 65535.00 ECU_ADDRESS 0xD000154C /end MEASUREMENT
/begin MEASUREMENT Com_dTrqDemandGbxCHK "" UBYTE OneToOne 1 100 0.00 255.0 ECU_ADDRESS 0xD0001CAA /end MEASUREMENT
/begin MEASUREMENT Com_dTrqDemandGbxCHK_A "" UBYTE OneToOne 1 100 0.00 255.0 ECU_ADDRESS 0xD0001CAB /end MEASUREMENT
/begin MEASUREMENT Com_dTrqDemandGbxCHK_FA "" UBYTE OneToOne 1 100 0.00 255.0 ECU_ADDRESS 0xD0001CAC /end MEASUREMENT
/begin MEASUREMENT Com_dTrqDemandGbxCTR "" UWORD OneToOne 1 100 0.00 65535.00 ECU_ADDRESS 0xD0001550 /end MEASUREMENT
/begin MEASUREMENT Com_dTrqDemandGbxCTR_A "" UWORD OneToOne 1 100 0.00 65535.00 ECU_ADDRESS 0xD0001552 /end MEASUREMENT
/begin MEASUREMENT Com_dTrqDemandGbxCTR_FA "" UWORD OneToOne 1 100 0.00 65535.00 ECU_ADDRESS 0xD0001554 /end MEASUREMENT
/begin MEASUREMENT Com_nDKG "" SWORD EngN 1 100 -16384.00 16383.50 ECU_ADDRESS 0xD0000784 /end MEASUREMENT
/begin MEASUREMENT Com_nGbxOut "" SWORD EngN 1 100 -16384.00 16383.50 ECU_ADDRESS 0xD0000788 /end MEASUREMENT
/begin MEASUREMENT Com_nGbxOut_A "" SLONG EngN 1 100 -1073741824.00 1073741823.50 ECU_ADDRESS 0xD0002E44 /end MEASUREMENT
/begin MEASUREMENT Com_nGbxOut_FA "" SLONG EngN 1 100 -1073741824.00 1073741823.50 ECU_ADDRESS 0xD0002E48 /end MEASUREMENT
/begin MEASUREMENT Com_nRqIdlg "" SWORD EngN 1 100 -16384.00 16383.50 ECU_ADDRESS 0xD0000790 /end MEASUREMENT
/begin MEASUREMENT Com_nTSC "" SWORD EngN 1 100 -16384.00 16383.50 ECU_ADDRESS 0xD0000794 /end MEASUREMENT
/begin MEASUREMENT Com_nTSC_A "" SWORD EngN 1 100 -16384.00 16383.50 ECU_ADDRESS 0xD0000796 /end MEASUREMENT
/begin MEASUREMENT Com_nTSC_FA "" SWORD EngN 1 100 -16384.00 16383.50 ECU_ADDRESS 0xD0000798 /end MEASUREMENT
/begin MEASUREMENT Com_RawMuxVal_mp "" UBYTE OneToOne 1 100 0.00 255.0 ARRAY_SIZE 8 ECU_ADDRESS 0xC000BE14 /end MEASUREMENT
/begin MEASUREMENT Com_RawValA_mp "" UBYTE OneToOne 1 100 0.00 255.0 ARRAY_SIZE 8 ECU_ADDRESS 0xC000BE1C /end MEASUREMENT
/begin MEASUREMENT Com_RawValB_mp "" UBYTE OneToOne 1 100 0.00 255.0 ARRAY_SIZE 8 ECU_ADDRESS 0xC000BE24 /end MEASUREMENT
/begin MEASUREMENT Com_RawValC_mp "" UBYTE OneToOne 1 100 0.00 255.0 ARRAY_SIZE 8 ECU_ADDRESS 0xC000BE2C /end MEASUREMENT
/begin MEASUREMENT Com_RawValD_mp "" UBYTE OneToOne 1 100 0.00 255.0 ARRAY_SIZE 8 ECU_ADDRESS 0xC000BE34 /end MEASUREMENT
/begin MEASUREMENT Com_RawValIdA_mp "" UWORD OneToOne 1 100 0.00 65535.00 ECU_ADDRESS 0xC0009EF2 /end MEASUREMENT
/begin MEASUREMENT Com_RawValIdB_mp "" UWORD OneToOne 1 100 0.00 65535.00 ECU_ADDRESS 0xC0009EF4 /end MEASUREMENT
/begin MEASUREMENT Com_RawValIdC_mp "" UWORD OneToOne 1 100 0.00 65535.00 ECU_ADDRESS 0xC0009EF6 /end MEASUREMENT
/begin MEASUREMENT Com_RawValIdD_mp "" UWORD OneToOne 1 100 0.00 65535.00 ECU_ADDRESS 0xC0009EF8 /end MEASUREMENT
/begin MEASUREMENT Com_rTrq "" SWORD TransR 1 100 -327.6800 327.6700 ECU_ADDRESS 0xD00007EA /end MEASUREMENT
/begin MEASUREMENT Com_rTrqRaw "" SLONG TransR 1 100 -21474836.4800 21474836.4700 ECU_ADDRESS 0xD0002E54 /end MEASUREMENT
/begin MEASUREMENT Com_rTrq_A "" SLONG TransR 1 100 -21474836.4800 21474836.4700 ECU_ADDRESS 0xD0002E58 /end MEASUREMENT
/begin MEASUREMENT Com_rTrq_FA "" SLONG TransR 1 100 -21474836.4800 21474836.4700 ECU_ADDRESS 0xD0002E5C /end MEASUREMENT
/begin MEASUREMENT Com_SelfRecCtr_mp "" UBYTE OneToOne 1 100 0.00 255.0 ECU_ADDRESS 0xC000B1D4 /end MEASUREMENT
/begin MEASUREMENT Com_SelfRecID_mp "" UWORD OneToOne 1 100 0.00 65535.00 ECU_ADDRESS 0xC0009EFA /end MEASUREMENT
/begin MEASUREMENT Com_SelfRecSt_mp "" UBYTE OneToOne 1 100 0.00 255.0 ECU_ADDRESS 0xC000B1D5 /end MEASUREMENT
/begin MEASUREMENT Com_SelfRecTmr_mp "" SWORD Time_ms 1 100 -327680.0 327670.0 ECU_ADDRESS 0xC0009EFC /end MEASUREMENT
/begin MEASUREMENT Com_stAcpd "" UBYTE OneToOne 1 100 0.00 255.0 ECU_ADDRESS 0xD0001CD3 /end MEASUREMENT
/begin MEASUREMENT Com_stCANType "" UBYTE CANType_VerbalConv 1 100 1.00000000000 3.00000000000 FORMAT "%13.11" ECU_ADDRESS 0xD0001CDF /end MEASUREMENT
/begin MEASUREMENT Com_stCBSRequest "" UWORD OneToOne 1 100 0.00 65535.00 ECU_ADDRESS 0xD00003E8 /end MEASUREMENT
/begin MEASUREMENT Com_stCBSRst "" UWORD OneToOne 1 100 0.00 65535.00 ECU_ADDRESS 0xD00003EA /end MEASUREMENT
/begin MEASUREMENT Com_stClth "" UBYTE OneToOne 1 100 0.00 255.0 ECU_ADDRESS 0xD0001CE9 /end MEASUREMENT
/begin MEASUREMENT Com_stClthRaw "" UBYTE OneToOne 1 100 0.00 255.0 ECU_ADDRESS 0xD0001CED /end MEASUREMENT
/begin MEASUREMENT Com_stClthRaw_A "" UBYTE OneToOne 1 100 0.00 255.0 ECU_ADDRESS 0xD0001CEE /end MEASUREMENT
/begin MEASUREMENT Com_stClthRaw_FA "" UBYTE OneToOne 1 100 0.00 255.0 ECU_ADDRESS 0xD0001CEF /end MEASUREMENT
/begin MEASUREMENT Com_stDynDisp "" UBYTE OneToOne 1 100 0.00 255.0 ECU_ADDRESS 0xD0001D07 /end MEASUREMENT
/begin MEASUREMENT Com_stEnableRedIpdu "" UWORD OneToOne 1 100 0.00 65535.00 ECU_ADDRESS 0xD00003EC /end MEASUREMENT
/begin MEASUREMENT Com_stGbxOBD "" UBYTE OneToOne 1 100 0.00 255.0 ECU_ADDRESS 0xD0001D13 /end MEASUREMENT
/begin MEASUREMENT Com_stGbxOBD_A "" UBYTE OneToOne 1 100 0.00 255.0 ECU_ADDRESS 0xD0001D14 /end MEASUREMENT
/begin MEASUREMENT Com_stGear "" UBYTE OneToOne 1 100 0.00 255.0 ECU_ADDRESS 0xD0001D15 /end MEASUREMENT
/begin MEASUREMENT Com_stGear_A "" UBYTE OneToOne 1 100 0.00 255.0 ECU_ADDRESS 0xD0001D18 /end MEASUREMENT
/begin MEASUREMENT Com_stGear_FA "" UBYTE OneToOne 1 100 0.00 255.0 ECU_ADDRESS 0xD0001D19 /end MEASUREMENT
/begin MEASUREMENT Com_stMILReq "" UBYTE OneToOne 1 100 0.00 255.0 ECU_ADDRESS 0xD0001D2C /end MEASUREMENT
/begin MEASUREMENT Com_stModDKG "" UBYTE OneToOne 1 100 0.00 255.0 ECU_ADDRESS 0xD0001D31 /end MEASUREMENT
/begin MEASUREMENT Com_stRaceStrt "" UBYTE OneToOne 1 100 0.00 255.0 ECU_ADDRESS 0xD0001D51 /end MEASUREMENT
/begin MEASUREMENT Com_stRevGear "" UBYTE OneToOne 1 100 0.00 255.0 ECU_ADDRESS 0xD0001D54 /end MEASUREMENT
/begin MEASUREMENT Com_stRevGear_FA "" UBYTE OneToOne 1 100 0.00 255.0 ECU_ADDRESS 0xD0001D55 /end MEASUREMENT
/begin MEASUREMENT Com_stStrtClth "" UBYTE OneToOne 1 100 0.00 255.0 ECU_ADDRESS 0xD0001D7C /end MEASUREMENT
/begin MEASUREMENT Com_stStrtLck_A "" UBYTE OneToOne 1 100 0.00 255.0 ECU_ADDRESS 0xD0001D7E /end MEASUREMENT
/begin MEASUREMENT Com_stStrtLck_FA "" UBYTE OneToOne 1 100 0.00 255.0 ECU_ADDRESS 0xD0001D7F /end MEASUREMENT
/begin MEASUREMENT Com_stTrqFil "" UBYTE OneToOne 1 100 0.00 255.0 ECU_ADDRESS 0xD0001D8F /end MEASUREMENT
/begin MEASUREMENT Com_stTrqGbxDes "" UBYTE OneToOne 1 100 0.00 255.0 ECU_ADDRESS 0xD0001D90 /end MEASUREMENT
/begin MEASUREMENT Com_stTrqGbxDes_A "" UBYTE OneToOne 1 100 0.00 255.0 ECU_ADDRESS 0xD0001D91 /end MEASUREMENT
/begin MEASUREMENT Com_stTrqGbxDes_FA "" UBYTE OneToOne 1 100 0.00 255.0 ECU_ADDRESS 0xD0001D92 /end MEASUREMENT
/begin MEASUREMENT Com_stTrqGbxLim "" UBYTE OneToOne 1 100 0.00 255.0 ECU_ADDRESS 0xD0001D93 /end MEASUREMENT
/begin MEASUREMENT Com_stTrqGbxLim_A "" UBYTE OneToOne 1 100 0.00 255.0 ECU_ADDRESS 0xD0001D94 /end MEASUREMENT
/begin MEASUREMENT Com_stTrqGbxLim_FA "" UBYTE OneToOne 1 100 0.00 255.0 ECU_ADDRESS 0xD0001D95 /end MEASUREMENT
/begin MEASUREMENT Com_stTSC "" UBYTE OneToOne 1 100 0.00 255.0 ECU_ADDRESS 0xD0001D86 /end MEASUREMENT
/begin MEASUREMENT Com_stTSC_A "" UBYTE OneToOne 1 100 0.00 255.0 ECU_ADDRESS 0xD0001D87 /end MEASUREMENT
/begin MEASUREMENT Com_stTSC_FA "" UBYTE OneToOne 1 100 0.00 255.0 ECU_ADDRESS 0xD0001D88 /end MEASUREMENT
/begin MEASUREMENT Com_stTxEvent "" UWORD OneToOne 1 100 0.00 65535.00 ECU_ADDRESS 0xD00003EE /end MEASUREMENT
/begin MEASUREMENT Com_stTxEvent_A "" UWORD OneToOne 1 100 0.00 65535.00 ECU_ADDRESS 0xD00003F0 /end MEASUREMENT
/begin MEASUREMENT Com_stTxEvent_FA "" UWORD OneToOne 1 100 0.00 65535.00 ECU_ADDRESS 0xD00003F2 /end MEASUREMENT
/begin MEASUREMENT Com_test1_mp "" SWORD OneToOne 1 100 -32768.00 32767.00 ECU_ADDRESS 0xC0009EFE /end MEASUREMENT
/begin MEASUREMENT Com_test2_mp "" SWORD OneToOne 1 100 -32768.00 32767.00 ECU_ADDRESS 0xC0009F00 /end MEASUREMENT
/begin MEASUREMENT Com_test3_mp "" SWORD OneToOne 1 100 -32768.00 32767.00 ECU_ADDRESS 0xC0009F02 /end MEASUREMENT
/begin MEASUREMENT Com_test4_mp "" SWORD OneToOne 1 100 -32768.00 32767.00 ECU_ADDRESS 0xC0009F04 /end MEASUREMENT
/begin MEASUREMENT Com_tGbxOil "Getriebeöltemperatur vom CAN" SWORD Temp_Cels 1 100 -3549.940 3003.560 ECU_ADDRESS 0xD0000800 /end MEASUREMENT
/begin MEASUREMENT Com_tGbxOil_A "" SWORD Temp_Cels 1 100 -3549.940 3003.560 ECU_ADDRESS 0xD0000802 /end MEASUREMENT
/begin MEASUREMENT Com_tGbxOil_FA "" SWORD Temp_Cels 1 100 -3549.940 3003.560 ECU_ADDRESS 0xD0000804 /end MEASUREMENT
/begin MEASUREMENT Com_trqAdjrDKG "" SWORD Trq 1 100 -3276.800 3276.700 ECU_ADDRESS 0xD0000818 /end MEASUREMENT
/begin MEASUREMENT Com_trqClthDKG "" SWORD Trq 1 100 -3276.800 3276.700 ECU_ADDRESS 0xD000081C /end MEASUREMENT
/begin MEASUREMENT Com_trqDKGDec_mp "" SWORD Trq 1 100 -3276.800 3276.700 ECU_ADDRESS 0xC0009F06 /end MEASUREMENT
/begin MEASUREMENT Com_trqDKGInc_mp "" SWORD Trq 1 100 -3276.800 3276.700 ECU_ADDRESS 0xC0009F08 /end MEASUREMENT
/begin MEASUREMENT Com_trqDKGMax_mp "" SWORD Trq 1 100 -3276.800 3276.700 ECU_ADDRESS 0xC0009F0A /end MEASUREMENT
/begin MEASUREMENT Com_trqDVCHRise "" SWORD Trq 1 100 -3276.800 3276.700 ECU_ADDRESS 0xD0000822 /end MEASUREMENT
/begin MEASUREMENT Com_trqGbxDes "" SWORD Trq 1 100 -3276.800 3276.700 ECU_ADDRESS 0xD0000826 /end MEASUREMENT
/begin MEASUREMENT Com_trqGbxDes_A "" SWORD Trq 1 100 -3276.800 3276.700 ECU_ADDRESS 0xD0000828 /end MEASUREMENT
/begin MEASUREMENT Com_trqGbxDes_FA "" SWORD Trq 1 100 -3276.800 3276.700 ECU_ADDRESS 0xD000082A /end MEASUREMENT
/begin MEASUREMENT Com_trqGbxFrc "" SWORD Trq 1 100 -3276.800 3276.700 ECU_ADDRESS 0xD000082C /end MEASUREMENT
/begin MEASUREMENT Com_trqGbxFrc_A "" SWORD Trq 1 100 -3276.800 3276.700 ECU_ADDRESS 0xD000082E /end MEASUREMENT
/begin MEASUREMENT Com_trqGbxFrc_FA "" SWORD Trq 1 100 -3276.800 3276.700 ECU_ADDRESS 0xD0000830 /end MEASUREMENT
/begin MEASUREMENT Com_trqGbxMax "" SWORD Trq 1 100 -3276.800 3276.700 ECU_ADDRESS 0xD0000832 /end MEASUREMENT
/begin MEASUREMENT Com_trqGbxMax_A "" SWORD Trq 1 100 -3276.800 3276.700 ECU_ADDRESS 0xD0000834 /end MEASUREMENT
/begin MEASUREMENT Com_trqGbxMax_FA "" SWORD Trq 1 100 -3276.800 3276.700 ECU_ADDRESS 0xD0000836 /end MEASUREMENT
/begin MEASUREMENT Com_trqTarDKG "" SWORD Trq 1 100 -3276.800 3276.700 ECU_ADDRESS 0xD0000844 /end MEASUREMENT
/begin MEASUREMENT ETClb_ctDelta_mp "Zähler für Anzahl der zurückgelegten Intervalle der Länge ETClb_lLrnDelta_C" UWORD OneToOne 1 100 0.00 65535.00 ECU_ADDRESS 0xC0009E2E /end MEASUREMENT
/begin MEASUREMENT ETClb_ctLrnCyclAllw_mp "Anzahl der erlaubten Lernzyklen für jeden Raildruckkalibrierpunkt" UBYTE OneToOne 1 100 0.00 255.0 ARRAY_SIZE 3 ECU_ADDRESS 0xC000BC69 /end MEASUREMENT
/begin MEASUREMENT ETClb_stLimClbFrq "Freigabestatus der Begrenzung der Lernhäufigkeit" UBYTE OneToOne 1 100 0.00 255.0 ECU_ADDRESS 0xD0001DE6 /end MEASUREMENT
/begin MEASUREMENT ETClb_swtRCClb_mp "Anzeige für Rollenprüfstandskalibrierung eingeschaltet" UBYTE OneToOne 1 100 0.00 255.0 ECU_ADDRESS 0xC000B1AA /end MEASUREMENT
/begin MEASUREMENT ETClb_tiETChkCor0_mp "Ansteuerdauer der Nullmenge der ZFC nach Korrektur durch die IMA für Raildruck-Kalibrierpunkt 0" SWORD InjTime_us 1 100 -13107.20 5000.00 ARRAY_SIZE 6 ECU_ADDRESS 0xC000BC6C /end MEASUREMENT
/begin MEASUREMENT ETClb_tiETChkCor1_mp "Ansteuerdauer der Nullmenge der ZFC nach Korrektur durch die IMA für Raildruck-Kalibrierpunkt 1" SWORD InjTime_us 1 100 -13107.20 5000.00 ARRAY_SIZE 6 ECU_ADDRESS 0xC000BC78 /end MEASUREMENT
/begin MEASUREMENT ETClb_tiETChkCor2_mp "Ansteuerdauer der Nullmenge der ZFC nach Korrektur durch die IMA für Raildruck-Kalibrierpunkt 0" SWORD InjTime_us 1 100 -13107.20 5000.00 ARRAY_SIZE 6 ECU_ADDRESS 0xC000BC84 /end MEASUREMENT
/begin MEASUREMENT ETClb_tiETChkCor3_mp "Ansteuerdauer der Nullmenge der ZFC nach Korrektur durch die IMA für Raildruck-Kalibrierpunkt 3" SWORD InjTime_us 1 100 -13107.20 5000.00 ARRAY_SIZE 6 ECU_ADDRESS 0xC000BC90 /end MEASUREMENT
/begin MEASUREMENT ETClb_tiETChkCor4_mp "Ansteuerdauer der Nullmenge der ZFC nach Korrektur durch die IMA für Raildruck-Kalibrierpunkt 4" SWORD InjTime_us 1 100 -13107.20 5000.00 ARRAY_SIZE 6 ECU_ADDRESS 0xC000BC9C /end MEASUREMENT
/begin MEASUREMENT ETClb_tiETChkCor5_mp "Ansteuerdauer der Nullmenge der ZFC nach Korrektur durch die IMA für Raildruck-Kalibrierpunkt 5" SWORD InjTime_us 1 100 -13107.20 5000.00 ARRAY_SIZE 6 ECU_ADDRESS 0xC000BCA8 /end MEASUREMENT
/begin MEASUREMENT ETClb_tiETChkCor6_mp "Ansteuerdauer der Nullmenge der ZFC nach Korrektur durch die IMA für Raildruck-Kalibrierpunkt 6" SWORD InjTime_us 1 100 -13107.20 5000.00 ARRAY_SIZE 6 ECU_ADDRESS 0xC000BCB4 /end MEASUREMENT
/begin MEASUREMENT ETCtl_mAirDesVal "Additive Korrektur des Luftmassensollwerts" SWORD AirMassPerCyl 1 100 -3276.800 3276.700 ECU_ADDRESS 0xD000096A /end MEASUREMENT
/begin MEASUREMENT ETCtl_mAirDes_mp "rohe additive Korrektur des Luftmassensollwerts" SWORD AirMassPerCyl 1 100 -3276.800 3276.700 ECU_ADDRESS 0xC0009E30 /end MEASUREMENT
/begin MEASUREMENT ETCtl_mAirLam_mp "lamda-abhängige Erhöhung der additiven Korrektur des Luftmassensollwerts" SWORD AirMassPerCyl 1 100 -3276.800 3276.700 ECU_ADDRESS 0xC0009E32 /end MEASUREMENT
/begin MEASUREMENT ETCtl_mAirMin_mp "minimale additive Korrektur des Luftmassensollwerts" SWORD AirMassPerCyl 1 100 -3276.800 3276.700 ECU_ADDRESS 0xC0009E34 /end MEASUREMENT
/begin MEASUREMENT ETCtl_mAirRng_mp "Spanne der additiven Korrektur des Luftmassensollwerts" SWORD AirMassPerCyl 1 100 -3276.800 3276.700 ECU_ADDRESS 0xC0009E36 /end MEASUREMENT
/begin MEASUREMENT ETCtl_phiPoI2Cor "Abgastemperaturreglerbedingte Korrektur für PoI2-SOE-Winkel" SWORD AngleCrS 1 100 -720.0000 719.9780 ECU_ADDRESS 0xD0000972 /end MEASUREMENT
/begin MEASUREMENT ETCtl_qPoI1 "Abgastemperaturreglerbedingte Korrektur für PoI1-Menge" SWORD InjMassInj 1 100 -327.6800 327.6700 ECU_ADDRESS 0xD0000974 /end MEASUREMENT
/begin MEASUREMENT ETCtl_qPoI1Min_mp "minimale additive Korrektur von später Nacheinspritzmenge" SWORD InjMassInj 1 100 -327.6800 327.6700 ECU_ADDRESS 0xC0009E4E /end MEASUREMENT
/begin MEASUREMENT ETCtl_qPoI1Raw "aus dem äußeren Regelkreis gefordete Additive Korrektur von später Nacheinspritzmenge" SWORD InjMassInj 1 100 -327.6800 327.6700 ECU_ADDRESS 0xD0000976 /end MEASUREMENT
/begin MEASUREMENT ETCtl_qPoI1RawTmp_mp "rohe additive Korrektur von später Nacheinspritzmenge" SWORD InjMassInj 1 100 -327.6800 327.6700 ECU_ADDRESS 0xC0009E50 /end MEASUREMENT
/begin MEASUREMENT ETCtl_qPoI1Rng_mp "Spanne der additiven Korrektur von später Nacheinspritzmenge" SWORD InjMassInj 1 100 -327.6800 327.6700 ECU_ADDRESS 0xC0009E52 /end MEASUREMENT
/begin MEASUREMENT ETCtl_qPoI2 "Abgastemperaturreglerbedingte Korrektur für PoI2-Menge" SWORD InjMassInj 1 100 -327.6800 327.6700 ECU_ADDRESS 0xD0000978 /end MEASUREMENT
/begin MEASUREMENT ETCtl_qPoI2Min_mp "minimale additive Korrektur von angelagerter Nacheinspritzmenge" SWORD InjMassInj 1 100 -327.6800 327.6700 ECU_ADDRESS 0xC0009E38 /end MEASUREMENT
/begin MEASUREMENT ETCtl_qPoI2Raw_mp "rohe additive Korrektur von angelagerter Nacheinspritzmenge" SWORD InjMassInj 1 100 -327.6800 327.6700 ECU_ADDRESS 0xC0009E3A /end MEASUREMENT
/begin MEASUREMENT ETCtl_qPoI2Rng_mp "Spanne der additiven Korrektur von angelagerter Nacheinspritzmenge" SWORD InjMassInj 1 100 -327.6800 327.6700 ECU_ADDRESS 0xC0009E3C /end MEASUREMENT
/begin MEASUREMENT ETCtl_rIInr_mp "I-Anteil des Ausgangs des inneren Regelkreises" SWORD ETCtlGov_p0q001 1 100 -32.76800 32.76700 FORMAT "%8.5" ECU_ADDRESS 0xC0009E3E /end MEASUREMENT
/begin MEASUREMENT ETCtl_rInr_mp "Ausgang des inneren Regelkreises" SWORD ETCtlGov_p0q001 1 100 -32.76800 32.76700 FORMAT "%8.5" ECU_ADDRESS 0xC0009E40 /end MEASUREMENT
/begin MEASUREMENT ETCtl_rIOutr_mp "I-Anteil des Ausgangs des äußeren Regelkreises" SWORD ETCtlGov_p0q001 1 100 -32.76800 32.76700 FORMAT "%8.5" ECU_ADDRESS 0xC0009E54 /end MEASUREMENT
/begin MEASUREMENT ETCtl_rLamRecExhMnfDs_mp "Arbeitspunktdarstellung des reziproken Lambda-Signals des Gasmassenstroms nach Abgaskrümmer" SWORD AirMassPerCyl 1 100 -3276.800 3276.700 ECU_ADDRESS 0xC0009E42 /end MEASUREMENT
/begin MEASUREMENT ETCtl_rMaxInr_mp "maximaler Ausgang des inneren Regelkreises" SWORD ETCtlGov_p0q001 1 100 -32.76800 32.76700 FORMAT "%8.5" ECU_ADDRESS 0xC0009E44 /end MEASUREMENT
/begin MEASUREMENT ETCtl_rMaxOutr_mp "maximaler Ausgang des äußeren Regelkreises" SWORD ETCtlGov_p0q001 1 100 -32.76800 32.76700 FORMAT "%8.5" ECU_ADDRESS 0xC0009E56 /end MEASUREMENT
/begin MEASUREMENT ETCtl_rMinInr_mp "minimaler Ausgang des inneren Regelkreises" SWORD ETCtlGov_p0q001 1 100 -32.76800 32.76700 FORMAT "%8.5" ECU_ADDRESS 0xC0009E46 /end MEASUREMENT
/begin MEASUREMENT ETCtl_rMinOutr_mp "minimaler Ausgang des äußeren Regelkreises" SWORD ETCtlGov_p0q001 1 100 -32.76800 32.76700 FORMAT "%8.5" ECU_ADDRESS 0xC0009E58 /end MEASUREMENT
/begin MEASUREMENT ETCtl_rOutr_mp "Ausgang des äußeren Regelkreises" SWORD ETCtlGov_p0q001 1 100 -32.76800 32.76700 FORMAT "%8.5" ECU_ADDRESS 0xC0009E5A /end MEASUREMENT
/begin MEASUREMENT ETCtl_rPInr_mp "P-Anteil des Ausgangs des inneren Regelkreises" SWORD ETCtlGov_p0q001 1 100 -32.76800 32.76700 FORMAT "%8.5" ECU_ADDRESS 0xC0009E48 /end MEASUREMENT
/begin MEASUREMENT ETCtl_rPOutr_mp "I-Anteil des Ausgangs des äußeren Regelkreises" SWORD ETCtlGov_p0q001 1 100 -32.76800 32.76700 FORMAT "%8.5" ECU_ADDRESS 0xC0009E5C /end MEASUREMENT
/begin MEASUREMENT ETCtl_rStyInr_mp "Modellierter stationärer Reglerausgang des inneren Regelkreises" SWORD ETCtlGov_p0q001 1 100 -32.76800 32.76700 FORMAT "%8.5" ECU_ADDRESS 0xC0009E4A /end MEASUREMENT
/begin MEASUREMENT ETCtl_rStyOutr_mp "Modellierter stationärer Reglerausgang des äußeren Regelkreises" SWORD ETCtlGov_p0q001 1 100 -32.76800 32.76700 FORMAT "%8.5" ECU_ADDRESS 0xC0009E5E /end MEASUREMENT
/begin MEASUREMENT ETCtl_st "Status-Bitwort des Abgastemperaturreglers" UBYTE OneToOne 1 100 0.00 255.0 ECU_ADDRESS 0xD0001DE8 /end MEASUREMENT
/begin MEASUREMENT ETCtl_stClsThrVlv_mp "Status maximale Androsselung aktiv" UBYTE OneToOne 1 100 0.00 255.0 ECU_ADDRESS 0xC000B1AB /end MEASUREMENT
/begin MEASUREMENT ETCtl_swtActv "Schalter zur Deaktivierung der Funktionalität des Abgastemperaturreglers" UBYTE OneToOne 1 100 0.00 255.0 ECU_ADDRESS 0xD0001DE9 /end MEASUREMENT
/begin MEASUREMENT ETCtl_tDvtInr "Regelabweichung des inneren Regelkreises" SWORD TempDiff_Kelv 1 100 -3276.800 3276.700 ECU_ADDRESS 0xD000097A /end MEASUREMENT
/begin MEASUREMENT ETCtl_tDvtInrRaw_mp "unverarbeitete Regelabweichung des inneren Regelkreises" SWORD TempDiff_Kelv 1 100 -3276.800 3276.700 ECU_ADDRESS 0xC0009E4C /end MEASUREMENT
/begin MEASUREMENT ETCtl_tDvtOutr "Regelabweichung des äußeren Regelkreises" SWORD TempDiff_Kelv 1 100 -3276.800 3276.700 ECU_ADDRESS 0xD000097C /end MEASUREMENT
/begin MEASUREMENT ETCtl_tDvtOutrRaw_mp "unverarbeitete Regelabweichung des äußeren Regelkreises" SWORD TempDiff_Kelv 1 100 -3276.800 3276.700 ECU_ADDRESS 0xC0009E60 /end MEASUREMENT
/begin MEASUREMENT ETCtl_tInrCorMax_mp "Maximale additive Korrektur des Sollwerts des inneren Regelkreises" SWORD TempDiff_Kelv 1 100 -3276.800 3276.700 ECU_ADDRESS 0xC0009E62 /end MEASUREMENT
/begin MEASUREMENT ETCtl_tInrCorRng_mp "Spanne der additiven Korrektur des Sollwerts des inneren Regelkreises" SWORD TempDiff_Kelv 1 100 -3276.800 3276.700 ECU_ADDRESS 0xC0009E64 /end MEASUREMENT
/begin MEASUREMENT ETCtl_tInrDesCor "Additive Korrektur des Sollwerts des inneren Regelkreises" SWORD TempDiff_Kelv 1 100 -3276.800 3276.700 ECU_ADDRESS 0xD000097E /end MEASUREMENT
/begin MEASUREMENT ETCtl_tInrDesCorRaw_mp "unverarbeitete additive Korrektur des Sollwerts des inneren Regelkreises" SWORD TempDiff_Kelv 1 100 -3276.800 3276.700 ECU_ADDRESS 0xC0009E66 /end MEASUREMENT
/begin MEASUREMENT ETCtl_tiPoI1Cor "" SWORD InjTime_us 1 100 -13107.20 5000.00 ECU_ADDRESS 0xD0000980 /end MEASUREMENT
/begin MEASUREMENT ETCtl_tPFltUs_mp "Gemessene Temperatur vor dem Partikelfilter" SWORD Temp_Cels 1 100 -3549.940 3003.560 ECU_ADDRESS 0xC0009E68 /end MEASUREMENT
/begin MEASUREMENT Exh_pFld "" SWORD Pres_hPa 1 100 -32768.00 3500.00 ARRAY_SIZE 8 ECU_ADDRESS 0xD0000A16 /end MEASUREMENT
/begin MEASUREMENT Exh_stCmp_mp "" UBYTE OneToOne 1 100 0.00 255.0 ECU_ADDRESS 0xC000B1AC /end MEASUREMENT
/begin MEASUREMENT Exh_stLckTempPlausTmr_mp "" UBYTE OneToOne 1 100 0.00 255.0 ECU_ADDRESS 0xC000B1AD /end MEASUREMENT
/begin MEASUREMENT Exh_stLckTempPlaus_mp "" UBYTE OneToOne 1 100 0.00 255.0 ECU_ADDRESS 0xC000B1AE /end MEASUREMENT
/begin MEASUREMENT Exh_stLckTmr_mp "" UBYTE OneToOne 1 100 0.00 255.0 ECU_ADDRESS 0xC000B1AF /end MEASUREMENT
/begin MEASUREMENT Exh_stPlausCondExhTMon_mp "" UBYTE OneToOne 1 100 0.00 255.0 ECU_ADDRESS 0xC000B1B0 /end MEASUREMENT
/begin MEASUREMENT Exh_stTempPlausDone_mp "" UBYTE OneToOne 1 100 0.00 255.0 ECU_ADDRESS 0xC000B1B1 /end MEASUREMENT
/begin MEASUREMENT Exh_stTempStyExhTMon "" UBYTE OneToOne 1 100 0.00 255.0 ECU_ADDRESS 0xD0001E2D /end MEASUREMENT
/begin MEASUREMENT Exh_stUnLckCldStrtEEP_mp "" UBYTE OneToOne 1 100 0.00 255.0 ECU_ADDRESS 0xC000B1B2 /end MEASUREMENT
/begin MEASUREMENT Exh_stUnLckCldStrtTst_mp "" UBYTE OneToOne 1 100 0.00 255.0 ECU_ADDRESS 0xC000B1B3 /end MEASUREMENT
/begin MEASUREMENT Exh_tCmp1_mp "" SWORD Temp_Cels 1 100 -3549.940 3003.560 ECU_ADDRESS 0xC0009E6A /end MEASUREMENT
/begin MEASUREMENT Exh_tCmp2_mp "" SWORD Temp_Cels 1 100 -3549.940 3003.560 ECU_ADDRESS 0xC0009E6C /end MEASUREMENT
/begin MEASUREMENT Exh_tCmp3_mp "" SWORD Temp_Cels 1 100 -3549.940 3003.560 ECU_ADDRESS 0xC0009E6E /end MEASUREMENT
/begin MEASUREMENT Exh_tDiffPlausExhTMon1_mp "" SWORD TempDiff_Kelv 1 100 -3276.800 3276.700 ECU_ADDRESS 0xC0009E70 /end MEASUREMENT
/begin MEASUREMENT Exh_tDiffPlausExhTMon2_mp "" SWORD TempDiff_Kelv 1 100 -3276.800 3276.700 ECU_ADDRESS 0xC0009E72 /end MEASUREMENT
/begin MEASUREMENT Exh_tDiffPlausExhTMon3_mp "" SWORD TempDiff_Kelv 1 100 -3276.800 3276.700 ECU_ADDRESS 0xC0009E74 /end MEASUREMENT
/begin MEASUREMENT Exh_tDiffPos1NgvExhTMon_mp "" SWORD TempDiff_Kelv 1 100 -3276.800 3276.700 ECU_ADDRESS 0xC0009E76 /end MEASUREMENT
/begin MEASUREMENT Exh_tDiffPos1PsvExhTMon_mp "" SWORD TempDiff_Kelv 1 100 -3276.800 3276.700 ECU_ADDRESS 0xC0009E78 /end MEASUREMENT
/begin MEASUREMENT Exh_tDiffPos2NgvExhTMon_mp "" SWORD TempDiff_Kelv 1 100 -3276.800 3276.700 ECU_ADDRESS 0xC0009E7A /end MEASUREMENT
/begin MEASUREMENT Exh_tDiffPos2PsvExhTMon_mp "" SWORD TempDiff_Kelv 1 100 -3276.800 3276.700 ECU_ADDRESS 0xC0009E7C /end MEASUREMENT
/begin MEASUREMENT Exh_tDiffPos3NgvExhTMon_mp "" SWORD TempDiff_Kelv 1 100 -3276.800 3276.700 ECU_ADDRESS 0xC0009E7E /end MEASUREMENT
/begin MEASUREMENT Exh_tDiffPos3PsvExhTMon_mp "" SWORD TempDiff_Kelv 1 100 -3276.800 3276.700 ECU_ADDRESS 0xC0009E80 /end MEASUREMENT
/begin MEASUREMENT Exh_tEngMon_mp "" SWORD Temp_Cels 1 100 -3549.940 3003.560 ECU_ADDRESS 0xC0009E82 /end MEASUREMENT
/begin MEASUREMENT Exh_tExhTMon1_mp "" SWORD Temp_Cels 1 100 -3549.940 3003.560 ECU_ADDRESS 0xC0009E84 /end MEASUREMENT
/begin MEASUREMENT Exh_tExhTMon2_mp "" SWORD Temp_Cels 1 100 -3549.940 3003.560 ECU_ADDRESS 0xC0009E86 /end MEASUREMENT
/begin MEASUREMENT Exh_tExhTMon3_mp "" SWORD Temp_Cels 1 100 -3549.940 3003.560 ECU_ADDRESS 0xC0009E88 /end MEASUREMENT
/begin MEASUREMENT Exh_tExhTMonStyTmp_mp "" SWORD Temp_Cels 1 100 -3549.940 3003.560 ECU_ADDRESS 0xC0009E8A /end MEASUREMENT
/begin MEASUREMENT Exh_tFld "" SWORD Temp_Cels 1 100 -3549.940 3003.560 ARRAY_SIZE 8 ECU_ADDRESS 0xD0000A82 /end MEASUREMENT
/begin MEASUREMENT Exh_tMonFld "" SWORD Temp_Cels 1 100 -3549.940 3003.560 ARRAY_SIZE 3 ECU_ADDRESS 0xD0000A92 /end MEASUREMENT
/begin MEASUREMENT Exh_tSim1Fld_mp "" SWORD Temp_Cels 1 100 -3549.940 3003.560 ECU_ADDRESS 0xC0009E8C /end MEASUREMENT
/begin MEASUREMENT Exh_tSim2Fld_mp "" SWORD Temp_Cels 1 100 -3549.940 3003.560 ECU_ADDRESS 0xC0009E8E /end MEASUREMENT
/begin MEASUREMENT Exh_tSim3Fld_mp "" SWORD Temp_Cels 1 100 -3549.940 3003.560 ECU_ADDRESS 0xC0009E90 /end MEASUREMENT
/begin MEASUREMENT Exh_tSimFld "" SWORD Temp_Cels 1 100 -3549.940 3003.560 ARRAY_SIZE 3 ECU_ADDRESS 0xD0000AAE /end MEASUREMENT
/begin MEASUREMENT Exh_tStyChk_mp "" SWORD Temp_Cels 1 100 -3549.940 3003.560 ECU_ADDRESS 0xC0009E92 /end MEASUREMENT
/begin MEASUREMENT FanCtl_dcycBattCor_mp "TV nach Batt-Korr. und Hysteresefunktion" SWORD DtyCyc 1 100 -327.6800 327.6700 ECU_ADDRESS 0xC0009E94 /end MEASUREMENT
/begin MEASUREMENT FanCtl_dcycHysStart_mp "Startwert der Hysterese" SWORD DtyCyc 1 100 -327.6800 327.6700 ECU_ADDRESS 0xC0009E96 /end MEASUREMENT
/begin MEASUREMENT FanCtl_dcycHys_mp "TV am Ausgang der Hysteresefunktion" SWORD DtyCyc 1 100 -327.6800 327.6700 ECU_ADDRESS 0xC0009E98 /end MEASUREMENT
/begin MEASUREMENT FanCtl_dcycRaw_mp "Tastverhältnis Rohwert" SWORD DtyCyc 1 100 -327.6800 327.6700 ECU_ADDRESS 0xC0009E9A /end MEASUREMENT
/begin MEASUREMENT FanCtl_facWghFctr_mp "Gewichtungsfaktor für Lüfterstufe aus Klimasteuerung" SWORD Fact 1 100 -4.000000 3.999878 ECU_ADDRESS 0xC0009E9C /end MEASUREMENT
/begin MEASUREMENT FanCtl_nRqMax "" SWORD FanSpd 1 100 -3000.092 3000.000 FORMAT "%8.3" ECU_ADDRESS 0xD0000B00 /end MEASUREMENT
/begin MEASUREMENT FanCtl_nSetGbxOilMap_mp "Lüfter-Drehzahlsollwert aus Getriebeöltemp." SWORD FanSpd 1 100 -3000.092 3000.000 FORMAT "%8.3" ECU_ADDRESS 0xC0009E9E /end MEASUREMENT
/begin MEASUREMENT FanCtl_nSetPntCAN_mp "gewichteter Lüfter-Drehzahlsollwert aus Klimasteuerung" SWORD FanSpd 1 100 -3000.092 3000.000 FORMAT "%8.3" ECU_ADDRESS 0xC0009EA0 /end MEASUREMENT
/begin MEASUREMENT FanCtl_nSetPntMap_mp "Lüfter-Drehzahlsollwert aus Kühlmitteltemp." SWORD FanSpd 1 100 -3000.092 3000.000 FORMAT "%8.3" ECU_ADDRESS 0xC0009EA2 /end MEASUREMENT
/begin MEASUREMENT FanCtl_nSetPoint "Endgültige Soll- Lüfterdrehzahl" SWORD FanSpd 1 100 -3000.092 3000.000 FORMAT "%8.3" ECU_ADDRESS 0xD0000B02 /end MEASUREMENT
/begin MEASUREMENT FanCtl_stAftRun "Statuswort, Lüftersteuerung" UBYTE OneToOne 1 100 0.00 255.0 ECU_ADDRESS 0xD0001E3A /end MEASUREMENT
/begin MEASUREMENT FanCtl_stHys_mp "Statuswort der Hysteresefunktion" UBYTE OneToOne 1 100 0.00 255.0 ECU_ADDRESS 0xC000B1B4 /end MEASUREMENT
/begin MEASUREMENT FanCtl_stLogic_mp "Statuswort der Ansteuerlogik" UBYTE OneToOne 1 100 0.00 255.0 ECU_ADDRESS 0xC000B1B5 /end MEASUREMENT
/begin MEASUREMENT FanCtl_stOvrTemp_mp "" UBYTE OneToOne 1 100 0.00 255.0 ECU_ADDRESS 0xC000B1B6 /end MEASUREMENT
/begin MEASUREMENT FanCtl_stRgnDeb_mp "" UBYTE OneToOne 1 100 0.00 255.0 ECU_ADDRESS 0xC000B1B7 /end MEASUREMENT
/begin MEASUREMENT FanCtl_stRgnFF_mp "" UBYTE OneToOne 1 100 0.00 255.0 ECU_ADDRESS 0xC000B1B8 /end MEASUREMENT
/begin MEASUREMENT FanCtl_stRgn_mp "" UBYTE OneToOne 1 100 0.00 255.0 ECU_ADDRESS 0xC000B1B9 /end MEASUREMENT
/begin MEASUREMENT FanCtl_tClnt_mp "Kühlmitteltemperatur für Sollwertberechnung" SWORD Temp_Cels 1 100 -3549.940 3003.560 ECU_ADDRESS 0xC0009EA4 /end MEASUREMENT
/begin MEASUREMENT FanCtl_tGbxOil_mp "Getriebeöltemp" SWORD Temp_Cels 1 100 -3549.940 3003.560 ECU_ADDRESS 0xC0009EA6 /end MEASUREMENT
/begin MEASUREMENT Fan_ct4WinErr1_mp "" UBYTE OneToOne 1 100 0.00 255.0 ECU_ADDRESS 0xC000B1BA /end MEASUREMENT
/begin MEASUREMENT Fan_ct4WinErr2_mp "" UBYTE OneToOne 1 100 0.00 255.0 ECU_ADDRESS 0xC000B1BB /end MEASUREMENT
/begin MEASUREMENT Fan_ct4WinErr3_mp "" UBYTE OneToOne 1 100 0.00 255.0 ECU_ADDRESS 0xC000B1BC /end MEASUREMENT
/begin MEASUREMENT Fan_ct4WinErr4_mp "" UBYTE OneToOne 1 100 0.00 255.0 ECU_ADDRESS 0xC000B1BD /end MEASUREMENT
/begin MEASUREMENT Fan_r "Stellersollwert für den ersten Lüfterausgang." SWORD DtyCyc 1 100 -327.6800 327.6700 ECU_ADDRESS 0xD0000B04 /end MEASUREMENT
/begin MEASUREMENT Fan_rCalc_mp "Messpunkt für das Ausgangstastverhältnis an den Steller für Lüfter1" SWORD DtyCyc 1 100 -327.6800 327.6700 ECU_ADDRESS 0xC0009EA8 /end MEASUREMENT
/begin MEASUREMENT Fan_rCor_mp "Messpunkt zur Überprüfung des Batteriekorrekturfaktors des ersten Lüfterstellers" SWORD DtyCyc 1 100 -327.6800 327.6700 ECU_ADDRESS 0xC0009EAA /end MEASUREMENT
/begin MEASUREMENT Fan_rPs "Ausgangstastverhältnis an den ersten Lüftersteller." SWORD DtyCyc 1 100 -327.6800 327.6700 ECU_ADDRESS 0xD0000B06 /end MEASUREMENT
/begin MEASUREMENT Fan_stErrMsg_mp "" UBYTE OneToOne 1 100 0.00 255.0 ECU_ADDRESS 0xC000B1BE /end MEASUREMENT
/begin MEASUREMENT FBC_AACoef_mp "Antialiasingfilterkoeffizienten" FLOAT32_IEEE OneToOne 1 100 0.00 1.00000000 FORMAT "%10.8" ARRAY_SIZE 9 ECU_ADDRESS 0xC000BCE4 /end MEASUREMENT
/begin MEASUREMENT FBC_AAIn "Segmentzeiten der Teilsegmente" FLOAT32_IEEE OneToOne 1 100 -150000000. 150000000. FORMAT "%10.0" ARRAY_SIZE 4 ECU_ADDRESS 0xD0002D90 /end MEASUREMENT
/begin MEASUREMENT FBC_AAInSum_mp "Summe der Segmentzeiten der Minisegmente" FLOAT32_IEEE OneToOne 1 100 -150000000. 150000000. FORMAT "%10.0" ECU_ADDRESS 0xC0008EE8 /end MEASUREMENT
/begin MEASUREMENT FBC_AAOrd_mp "Filterordnung des Antialiasingfilter" UBYTE OneToOne 1 100 0.00 255.0 ECU_ADDRESS 0xC000B1C1 /end MEASUREMENT
/begin MEASUREMENT FBC_AAOut_mp "Ausgang des Antialiasingfiler" FLOAT32_IEEE OneToOne 1 100 -150000000. 150000000. FORMAT "%10.0" ECU_ADDRESS 0xC0008EEC /end MEASUREMENT
/begin MEASUREMENT FBC_AAPhiAbs_mp "absoluter Startwinkel des AntiAliasing-Winkels (FBC_AAPhiAbs_mp[0] ist der jüngste Wert)" SWORD OneToOne 1 100 -32768.00 32767.00 ARRAY_SIZE 4 ECU_ADDRESS 0xC000BD08 /end MEASUREMENT
/begin MEASUREMENT FBC_AAPhiLen_mp "Länge eines AntiAliasing-Segments (FBC_AAPhiInt_mp[0] ist der aktuellste Werte)" SWORD OneToOne 1 100 -32768.00 32767.00 ECU_ADDRESS 0xC0009EB0 /end MEASUREMENT
/begin MEASUREMENT FBC_Badpt "Adaptionsstatus (Bit1: 'Korrekturwert vorhanden', Bit2: 'Adaption angehalten', Bit3: 'neu eingelernt')" UBYTE OneToOne 1 100 0.00 255.0 ECU_ADDRESS 0xD0001E33 /end MEASUREMENT
/begin MEASUREMENT FBC_ctSegInt "interner Segmentzähler von FBC" UBYTE OneToOne 1 100 0.00 255.0 ECU_ADDRESS 0xD0001E35 /end MEASUREMENT
/begin MEASUREMENT FBC_dBPCaS "aktueller Bandpass Zählerkoeffizient f=fNW (gangabhängig)" FLOAT32_IEEE OneToOne 1 100 -5000.00000 5000.00000 FORMAT "%10.5" ARRAY_SIZE 3 ECU_ADDRESS 0xD0002DA4 /end MEASUREMENT
/begin MEASUREMENT FBC_dBPCaSOld_mp "Array mit zurückliegenden Bandpassausgängen" FLOAT32_IEEE OneToOne 1 100 -5000.00000 5000.00000 FORMAT "%10.5" ARRAY_SIZE 3 ECU_ADDRESS 0xC000BCC0 /end MEASUREMENT
/begin MEASUREMENT FBC_dBPSum "FBC Mengenersatzsignal, Eingang PI-Regler" SWORD OneToOne 1 100 -32768.00 32767.00 ECU_ADDRESS 0xD0000AC0 /end MEASUREMENT
/begin MEASUREMENT FBC_DXAdap_mp "aktuelle Adaptionsgüte" SWORD FBC_Dxs_s16 1 100 -0.7812500 0.7812262 FORMAT "%9.7" ECU_ADDRESS 0xC0009EB2 /end MEASUREMENT
/begin MEASUREMENT FBC_DXSfn_mp "Ausgang des negativen Bewertungsfilter" SWORD FBC_Dxs_s16 1 100 -0.7812500 0.7812262 FORMAT "%9.7" ARRAY_SIZE 12 ECU_ADDRESS 0xC000BD10 /end MEASUREMENT
/begin MEASUREMENT FBC_DXSfp_mp "Ausgang des positiven Bewertungsfilter" SWORD FBC_Dxs_s16 1 100 -0.7812500 0.7812262 FORMAT "%9.7" ARRAY_SIZE 12 ECU_ADDRESS 0xC000BD28 /end MEASUREMENT
/begin MEASUREMENT FBC_DXSf_mp "relative,aktuelle gefilterte Zahnteilungsfehler (Adaptionsfilter)" SWORD FBC_Dxs_s16 1 100 -0.7812500 0.7812262 FORMAT "%9.7" ARRAY_SIZE 12 ECU_ADDRESS 0xC000BD40 /end MEASUREMENT
/begin MEASUREMENT FBC_DXSl_mp "relative, gefilterte Zahnteilungsfehler (Adaptionsfilter, eingelernte Werte)" SWORD FBC_Dxs_s16 1 100 -0.7812500 0.7812262 FORMAT "%9.7" ARRAY_SIZE 12 ECU_ADDRESS 0xC000BD58 /end MEASUREMENT
/begin MEASUREMENT FBC_DXS_mp "relative Zahnteilungsfehler (ungefiltert)" SWORD FBC_Dxs_s16 1 100 -0.7812500 0.7812262 FORMAT "%9.7" ARRAY_SIZE 12 ECU_ADDRESS 0xC000BD70 /end MEASUREMENT
/begin MEASUREMENT FBC_dynSpd_mp "Drehzahldynamikwert" FLOAT32_IEEE OneToOne 1 100 -150000000. 150000000. FORMAT "%10.0" ECU_ADDRESS 0xC0008EF0 /end MEASUREMENT
/begin MEASUREMENT FBC_facBPNum_mp "aktuell angewendete Bandpassverstärkung" SWORD FBC_BPfac 1 100 -60.00183 60.00000 FORMAT "%8.5" ARRAY_SIZE 3 ECU_ADDRESS 0xC000BCCC /end MEASUREMENT
/begin MEASUREMENT FBC_facSegVal_mp "aktuell angewendete Segmentwahl" UWORD Per_Ratio 1 100 0.00 255.9961 FORMAT "%8.4" ARRAY_SIZE 3 ECU_ADDRESS 0xC000BCD2 /end MEASUREMENT
/begin MEASUREMENT FBC_nMaxOvrRun_mp "obere Drehzahlgrenze der Bandpassberechnung" SWORD EngN 1 100 -16384.00 16383.50 ECU_ADDRESS 0xC0009EAC /end MEASUREMENT
/begin MEASUREMENT FBC_numAASeg "Anzahl der FBC-Teil-Segmente" UBYTE OneToOne 1 100 0.00 255.0 ECU_ADDRESS 0xD0001E36 /end MEASUREMENT
/begin MEASUREMENT FBC_q "Ausgangsmenge der Mengenausgleichsregelung" SWORD InjMass 1 100 -327.6800 327.6700 ECU_ADDRESS 0xD0000AC2 /end MEASUREMENT
/begin MEASUREMENT FBC_qArr "Ausgangsmenge der Mengenausgleichsregelung, Schnittstelle zum Einspritzsystem" SWORD InjMass 1 100 -327.6800 327.6700 ARRAY_SIZE 6 ECU_ADDRESS 0xD0000AC4 /end MEASUREMENT
/begin MEASUREMENT FBC_qDvtCyl "aktuelle zylinderindividuelle Korrekturmenge: I-Anteile in Zündfolge" SWORD InjMass 1 100 -327.6800 327.6700 ARRAY_SIZE 6 ECU_ADDRESS 0xD0000ADC /end MEASUREMENT
/begin MEASUREMENT FBC_qDvtCylPhys "aktuelle zylinderindividuelle Korrekturmenge: I-Anteile in geometrischer Reihenfolge" SWORD InjMass 1 100 -327.6800 327.6700 ARRAY_SIZE 6 ECU_ADDRESS 0xD0000AD0 /end MEASUREMENT
/begin MEASUREMENT FBC_qIntegrator_mp "Ausgangsmenge der Mengenausgleichsregelung, Integratorinhalte" SWORD InjMass 1 100 -327.6800 327.6700 ARRAY_SIZE 6 ECU_ADDRESS 0xC000BCD8 /end MEASUREMENT
/begin MEASUREMENT FBC_qLimAct "Aktuelle Begrenzungsmenge für FBC_q" SWORD InjMass 1 100 -327.6800 327.6700 ECU_ADDRESS 0xD0000AE8 /end MEASUREMENT
/begin MEASUREMENT FBC_qLimIncr "Offset für FBC-Begrenzungsmenge" SWORD InjMass 1 100 -327.6800 327.6700 ECU_ADDRESS 0xD0000AEA /end MEASUREMENT
/begin MEASUREMENT FBC_qSet "Wunschmenge mit FBC-Korrektur zum Zeitpunkt des jeweiligen MI-Interrupts" SWORD InjMass 1 100 -327.6800 327.6700 ECU_ADDRESS 0xD0000AEC /end MEASUREMENT
/begin MEASUREMENT FBC_qSetOld_mp "zurückliegende Wunschmenge mit FBC-Korrektur zum Zeitpunkt des jeweiligen MI-Interrupts" SWORD InjMass 1 100 -327.6800 327.6700 ECU_ADDRESS 0xC0009EAE /end MEASUREMENT
/begin MEASUREMENT FBC_RegionChng "signalisiert einen Wechsel der Lernregion in der FBC" UBYTE OneToOne 1 100 0.00 255.0 ECU_ADDRESS 0xD0001E34 /end MEASUREMENT
/begin MEASUREMENT FBC_stActive "Status FBC-Regler -> '1': Regeln; '0': Steuern" UBYTE OneToOne 1 100 0.00 255.0 ECU_ADDRESS 0xD0001E37 /end MEASUREMENT
/begin MEASUREMENT FBC_stBPRedNum_mp "Status der Reduzierung der Bandpassverstärkungen (TRUE: 'aktiv' ; FALSE: 'inaktiv')" UBYTE OneToOne 1 100 0.00 255.0 ECU_ADDRESS 0xC000B1BF /end MEASUREMENT
/begin MEASUREMENT FBC_stBufSeg_mp "Rückgabewert der Funktion EpmHCrS_GetBufSegFBC für ein EDC-Segment" UBYTE OneToOne 1 100 0.00 255.0 ECU_ADDRESS 0xC000B1C2 /end MEASUREMENT
/begin MEASUREMENT FBC_stBufSubSeg_mp "Rückgabewerte der Funktion EpmHCrS_GetBufSegFBC für FBC-Teilsegmente" UBYTE OneToOne 1 100 0.00 255.0 ARRAY_SIZE 4 ECU_ADDRESS 0xC000BD88 /end MEASUREMENT
/begin MEASUREMENT FBC_stEqualInit "Initialisierungsstatus für FBC-Regler (0: 'normaler Betrieb', 1: 'Regler initialisieren')" UBYTE OneToOne 1 100 0.00 255.0 ECU_ADDRESS 0xD0001E38 /end MEASUREMENT
/begin MEASUREMENT FBC_stLearn "Status der Geberradadaption(Bit1: 'zu große Drehzahldynamik', Bit2: 'kein Schub', Bit3: 'Änderung des Drehzahlbereiches', Bit4: 'kein gültiger Drehzahlbereich')" UWORD OneToOne 1 100 0.00 65535.00 ECU_ADDRESS 0xD00015B0 /end MEASUREMENT
/begin MEASUREMENT FBC_stRegionESpP_mp "Status der Geberradadaption in Abhängigkeit der Drehzahl" UBYTE FBC_RegionESpP_st 1 100 16.0000000000 49.0000000000 FORMAT "%13.10" ECU_ADDRESS 0xC000B1C3 /end MEASUREMENT
/begin MEASUREMENT FBC_stRegionSRCtl_mp "Status Regler in Abhängigkeit von Menge/Drehzahl ('regeln','steuern','inaktiv')" UBYTE OneToOne 1 100 0.00 255.0 ECU_ADDRESS 0xC000B1C0 /end MEASUREMENT
/begin MEASUREMENT FBC_stStateESpP_mp "Status des Zustandsautomaten der Adaption" UBYTE FBC_StateESpP_st 1 100 1.00000000000 5.00000000000 FORMAT "%13.11" ECU_ADDRESS 0xC000B1C4 /end MEASUREMENT
/begin MEASUREMENT FBC_TSmCoef_mp "Koeffizienten für Mittelwertfilter" FLOAT32_IEEE OneToOne 1 100 -11.5000000 12.5000000 FORMAT "%10.7" ARRAY_SIZE 2 ECU_ADDRESS 0xC000BD8C /end MEASUREMENT
/begin MEASUREMENT FBC_WheelLrnOut "Eingangsignal für FBC Bandpässe" FLOAT32_IEEE OneToOne 1 100 -1.00000000E+035 1.00000000E+035 FORMAT "%10.0" ECU_ADDRESS 0xD0002DA0 /end MEASUREMENT
/begin MEASUREMENT FBC_WheelLrnOutOld_mp "zurückliegendes Eingangsignal für FBC Bandpässe" FLOAT32_IEEE OneToOne 1 100 -1.00000000E+035 1.00000000E+035 FORMAT "%10.0" ECU_ADDRESS 0xC0008EF4 /end MEASUREMENT
/begin MEASUREMENT FlFCBS_dAvaiDMEChg_mp "" UBYTE OneToOne 1 100 0.00 255.0 ECU_ADDRESS 0xC000B1C5 /end MEASUREMENT
/begin MEASUREMENT FlFCBS_dAvaiOut "" UBYTE OneToOne 1 100 0.00 255.0 ECU_ADDRESS 0xD0001E3B /end MEASUREMENT
/begin MEASUREMENT FlFCBS_facCor_mp "" UBYTE Fact_CBS 1 100 0.00 2.550 FORMAT "%5.3" ECU_ADDRESS 0xC000B1C6 /end MEASUREMENT
/begin MEASUREMENT FlFCBS_lDistanceOut "" SWORD km_sw_q10 1 100 -327680.0 327670.0 FORMAT "%8.1" ECU_ADDRESS 0xD0000B08 /end MEASUREMENT
/begin MEASUREMENT FlFCBS_lProgWay "" UBYTE OneToOne 1 100 0.00 255.0 ECU_ADDRESS 0xD0001E3C /end MEASUREMENT
/begin MEASUREMENT FlFCBS_qFlTotDMEChg "" SLONG OneToOne 1 100 -2147483648.00 2147483647.00 ECU_ADDRESS 0xD0002EDC /end MEASUREMENT
/begin MEASUREMENT FlFCBS_stCalc "" UWORD OneToOne 1 100 0.00 65535.00 ECU_ADDRESS 0xD00015B2 /end MEASUREMENT
/begin MEASUREMENT FlFCBS_stCBSMsg "" UBYTE OneToOne 1 100 0.00 255.0 ECU_ADDRESS 0xD0001E3E /end MEASUREMENT
/begin MEASUREMENT FlFCBS_stCntValOut "" UBYTE OneToOne 1 100 0.00 255.0 ECU_ADDRESS 0xD0001E3F /end MEASUREMENT
/begin MEASUREMENT FlFCBS_stDMEChg "" UBYTE OneToOne 1 100 0.00 255.0 ECU_ADDRESS 0xD0001E40 /end MEASUREMENT
/begin MEASUREMENT FlFCBS_stDMEIni "" UBYTE OneToOne 1 100 0.00 255.0 ECU_ADDRESS 0xD0001E41 /end MEASUREMENT
/begin MEASUREMENT FlFCBS_stDMEIni_mp "" UBYTE OneToOne 1 100 0.00 255.0 ECU_ADDRESS 0xC000B1C7 /end MEASUREMENT
/begin MEASUREMENT FlFCBS_stFlFChg "" UBYTE OneToOne 1 100 0.00 255.0 ECU_ADDRESS 0xD0001E42 /end MEASUREMENT
/begin MEASUREMENT FlFCBS_stFlLPCActv "" UBYTE OneToOne 1 100 0.00 255.0 ECU_ADDRESS 0xD0001E43 /end MEASUREMENT
/begin MEASUREMENT FlFCBS_stIdCBS4 "" UBYTE OneToOne 1 100 0.00 255.0 ECU_ADDRESS 0xD0001E44 /end MEASUREMENT
/begin MEASUREMENT FlFCBS_stIdFnCBS4 "" UWORD OneToOne 1 100 0.00 65535.00 ECU_ADDRESS 0xD00015B6 /end MEASUREMENT
/begin MEASUREMENT FlFCBS_stIDMsg "" UWORD OneToOne 1 100 0.00 65535.00 ECU_ADDRESS 0xD00015B4 /end MEASUREMENT
/begin MEASUREMENT FlFCBS_stManip_mp "" UBYTE OneToOne 1 100 0.00 255.0 ECU_ADDRESS 0xC000B1C8 /end MEASUREMENT
/begin MEASUREMENT FlFCBS_stProgMon "" UBYTE OneToOne 1 100 0.00 255.0 ECU_ADDRESS 0xD0001E45 /end MEASUREMENT
/begin MEASUREMENT FlFCBS_stProgTime "" UBYTE OneToOne 1 100 0.00 255.0 ECU_ADDRESS 0xD0001E46 /end MEASUREMENT
/begin MEASUREMENT FlFCBS_stProgYr "" UBYTE OneToOne 1 100 0.00 255.0 ECU_ADDRESS 0xD0001E47 /end MEASUREMENT
/begin MEASUREMENT FlFCBS_stRequest_mp "" UBYTE OneToOne 1 100 0.00 255.0 ECU_ADDRESS 0xC000B1C9 /end MEASUREMENT
/begin MEASUREMENT FlFCBS_stSelfRecClct_mp "" UBYTE OneToOne 1 100 0.00 255.0 ECU_ADDRESS 0xC000B1CA /end MEASUREMENT
/begin MEASUREMENT FlFCBS_stUnit "" UBYTE OneToOne 1 100 0.00 255.0 ECU_ADDRESS 0xD0001E48 /end MEASUREMENT
/begin MEASUREMENT FlFCBS_voltotFlConsum "" ULONG OneToOne 1 100 0.00 4294967295.00 ECU_ADDRESS 0xD000316C /end MEASUREMENT
/begin MEASUREMENT FlFCBS_voltotFlConsum_l_mp "" ULONG OneToOne 1 100 0.00 4294967295.00 ECU_ADDRESS 0xC0008EF8 /end MEASUREMENT
/begin MEASUREMENT FlFltDsP_bEval "" UBYTE OneToOne 1 100 0.00 1.000 BIT_MASK 0x2 ECU_ADDRESS 0xD00003BC /end MEASUREMENT
/begin MEASUREMENT FlFltDsP_bRec "" UBYTE OneToOne 1 100 0.00 1.000 BIT_MASK 0x40 ECU_ADDRESS 0xD00003C4 /end MEASUREMENT
/begin MEASUREMENT FlFltDsP_bRecActv "" UBYTE OneToOne 1 100 0.00 1.000 BIT_MASK 0x80 ECU_ADDRESS 0xD00003BD /end MEASUREMENT
/begin MEASUREMENT FlFltDsP_p "" SWORD Pres_hPa 1 100 -32768.00 3500.00 ECU_ADDRESS 0xD0000B0A /end MEASUREMENT
/begin MEASUREMENT FlFltDsP_pSens "" SWORD Pres_hPa 1 100 -32768.00 3500.00 ECU_ADDRESS 0xD0000B0C /end MEASUREMENT
/begin MEASUREMENT FlFltDsP_stRec "" UBYTE OneToOne 1 100 0.00 255.0 ECU_ADDRESS 0xD0001E49 /end MEASUREMENT
/begin MEASUREMENT FlFltDsP_uRaw "" SWORD Volt 1 100 -6553.600 6553.400 ECU_ADDRESS 0xD0000B0E /end MEASUREMENT
/begin MEASUREMENT FlFltDsP_uRawUnFlt_mp "" SWORD Volt 1 100 -6553.600 6553.400 ECU_ADDRESS 0xC0009EB4 /end MEASUREMENT
/begin MEASUREMENT FlFltHt_bEval "" UBYTE OneToOne 1 100 0.00 1.000 BIT_MASK 0x10 ECU_ADDRESS 0xD00003BD /end MEASUREMENT
/begin MEASUREMENT FlFltHt_bRec "Status selbsterkennung" UBYTE OneToOne 1 100 0.00 1.000 BIT_MASK 0x10 ECU_ADDRESS 0xD00003C3 /end MEASUREMENT
/begin MEASUREMENT FlFltHt_bRecActv "Status selbsterkennung" UBYTE OneToOne 1 100 0.00 1.000 BIT_MASK 0x2 ECU_ADDRESS 0xD00003BA /end MEASUREMENT
/begin MEASUREMENT FlFltHt_stPs "" UBYTE OneToOne 1 100 0.00 255.0 ECU_ADDRESS 0xD0001E4A /end MEASUREMENT
/begin MEASUREMENT FlFltHt_stRec_mp "" UBYTE OneToOne 1 100 0.00 255.0 ECU_ADDRESS 0xC000B1CB /end MEASUREMENT
/begin MEASUREMENT FlFltUsP_p "" SWORD Pres_hPa 1 100 -32768.00 3500.00 ECU_ADDRESS 0xD0000B10 /end MEASUREMENT
/begin MEASUREMENT FlFltUsP_pSens "" SWORD Pres_hPa 1 100 -32768.00 3500.00 ECU_ADDRESS 0xD0000B12 /end MEASUREMENT
/begin MEASUREMENT FlFltUsP_stRec_mp "" UBYTE OneToOne 1 100 0.00 255.0 ECU_ADDRESS 0xC000B1CC /end MEASUREMENT
/begin MEASUREMENT FlFltUsP_stSelfRec "" UBYTE OneToOne 1 100 0.00 255.0 ECU_ADDRESS 0xD0001E4B /end MEASUREMENT
/begin MEASUREMENT FlFltUsP_swtSelfRec "" UBYTE OneToOne 1 100 0.00 255.0 ECU_ADDRESS 0xD0001E4C /end MEASUREMENT
/begin MEASUREMENT FlFltUsP_uRaw "" SWORD Volt 1 100 -6553.600 6553.400 ECU_ADDRESS 0xD0000B14 /end MEASUREMENT
/begin MEASUREMENT FlFlt_st "" UBYTE OneToOne 1 100 0.00 255.0 ECU_ADDRESS 0xD0001E4D /end MEASUREMENT
/begin MEASUREMENT FlFlt_stRaw "" UBYTE OneToOne 1 100 0.00 255.0 ECU_ADDRESS 0xD0001E4E /end MEASUREMENT
/begin MEASUREMENT FlSys_dvolFlCons "Kraftstoffverbrauch in l/h der momentenrelevanten Einspritzmenge" SWORD FlConsum_l_h 1 100 -327.6800 327.6700 FORMAT "%8.4" ECU_ADDRESS 0xD0000B16 /end MEASUREMENT
/begin MEASUREMENT FlSys_dvolPerStroke_mp "Kraftstoffverbrauch in mm^3/Hub der gesamten Einspritzmenge" SWORD InjQnt 1 100 -3276.800 3276.700 FORMAT "%8.3" ECU_ADDRESS 0xC0009EBC /end MEASUREMENT
/begin MEASUREMENT FlSys_facFlConsAdj_mp "EEPROM Abgleichwert zur Korrektur des Kraftstoffverbrauchs" SWORD Fact 1 100 -4.000000 3.999878 ECU_ADDRESS 0xC0009EBE /end MEASUREMENT
/begin MEASUREMENT FlSys_facStoich "stöchiometrischer Kraftstofffaktor" SWORD Fact1 1 100 -256.0000 255.9922 ECU_ADDRESS 0xD0000B18 /end MEASUREMENT
/begin MEASUREMENT FlSys_qSum_mp "tatsächlicher Kraftstoffverbrauch" SWORD InjMassCyc 1 100 -327.6800 327.6700 ECU_ADDRESS 0xC0009EC0 /end MEASUREMENT
/begin MEASUREMENT FlSys_rhoFl "Koeffizient Kraftstoffdichte" SWORD RhoFuel 1 100 -3276.800 3276.700 FORMAT "%8.3" ECU_ADDRESS 0xD0000B1A /end MEASUREMENT
/begin MEASUREMENT FlSys_rhoFlCnvFac "kundenspezifischer Kraftstoffumrechnungsfaktor" SWORD RhoFuel 1 100 -3276.800 3276.700 FORMAT "%8.3" ECU_ADDRESS 0xD0000B1C /end MEASUREMENT
/begin MEASUREMENT FlSys_rhoFlSel_mp "selektierter Kraftstoffkoeffizient" SWORD RhoFuel 1 100 -3276.800 3276.700 FORMAT "%8.3" ECU_ADDRESS 0xC0009EC2 /end MEASUREMENT
/begin MEASUREMENT FlSys_stDeflate "Aktivierung der Niederdruckentlüftung" UBYTE OneToOne 1 100 0.00 255.0 ECU_ADDRESS 0xD0001E4F /end MEASUREMENT
/begin MEASUREMENT FlSys_stDeflateActv_mp "Aktivierung der Niederdruckentlüftung" UBYTE OneToOne 1 100 0.00 255.0 ECU_ADDRESS 0xC000B1CD /end MEASUREMENT
/begin MEASUREMENT FlSys_stDeflateFin "Beendet-Zustand der Niederdruckentlüftung" UBYTE OneToOne 1 100 0.00 255.0 ECU_ADDRESS 0xD0001E50 /end MEASUREMENT
/begin MEASUREMENT FlSys_stDeflateOffDeflateTst "Aktivierung des Beendet-Zustands der Niederdruckentlüftung über den Tester" UBYTE OneToOne 1 100 0.00 255.0 ECU_ADDRESS 0xD0001E51 /end MEASUREMENT
/begin MEASUREMENT FlSys_stPCVSetClose "" UBYTE OneToOne 1 100 0.00 255.0 ECU_ADDRESS 0xD0001E52 /end MEASUREMENT
/begin MEASUREMENT FlSys_stRefDeflateTst "Statusrückmeldung eines abgebrochenen Railentlüftungstests" UWORD OneToOne 1 100 0.00 65535.00 ECU_ADDRESS 0xD00015B8 /end MEASUREMENT
/begin MEASUREMENT FlSys_stStMDeflateTst "aktueller Zustand des Zustandsautomaten des Railentlüftungstests" UBYTE OneToOne 1 100 0.00 255.0 ECU_ADDRESS 0xD0001E53 /end MEASUREMENT
/begin MEASUREMENT FlSys_stTnk "Bit-codierte Botschaft zum Tankstand" UBYTE OneToOne 1 100 0.00 255.0 ECU_ADDRESS 0xD0001E54 /end MEASUREMENT
/begin MEASUREMENT FlSys_swtRhoFlCnv "Schalter für kundenspezifischen Kraftstoffumrechnungsfaktor" UBYTE OneToOne 1 100 0.00 255.0 ECU_ADDRESS 0xD0001E55 /end MEASUREMENT
/begin MEASUREMENT FlSys_swtSrcPSDeflateTst "Unschalten von interner Entlüftungszeit des Niederdruckkreislaufs auf vom Tester vorgegebene" UBYTE OneToOne 1 100 0.00 255.0 ECU_ADDRESS 0xD0001E56 /end MEASUREMENT
/begin MEASUREMENT FlSys_tiDeflate "Abgelaufene Entlüftungszeit des Niederdruckkreislaufs" SWORD Time_ms 1 100 -327680.0 327670.0 ECU_ADDRESS 0xD0000B1E /end MEASUREMENT
/begin MEASUREMENT FlSys_tiDeflateDeflateTst "Vom Tester vorgegebene Entlüftungszeit des Niederdruckkreislaufs" UWORD Time_ms 1 100 0.00 655350.0 ECU_ADDRESS 0xD00015BA /end MEASUREMENT
/begin MEASUREMENT FlSys_tiDeflateMax_mp "Maximale Entlüftungszeit des Niederdruckkreis" SWORD Time_ms 1 100 -327680.0 327670.0 ECU_ADDRESS 0xC0009EB6 /end MEASUREMENT
/begin MEASUREMENT FlSys_tiDeflateRdEEP_mp "Abgelaufene Entlüftungszeit des Niederdruckkreislaufs gespeichert im EEPROM bei SG-Nachlauf" SWORD Time_ms 1 100 -327680.0 327670.0 ECU_ADDRESS 0xC0009EB8 /end MEASUREMENT
/begin MEASUREMENT FlSys_tiDeflateStp_mp "Nach Einschalten des SG abgelaufene Entlüftungszeit des Niederdruckkreislaufs" SWORD Time_ms 1 100 -327680.0 327670.0 ECU_ADDRESS 0xC0009EBA /end MEASUREMENT
/begin MEASUREMENT FlSys_tiEvalDeflateTst_mp "Messpunkt der abgelaufenen Zeit des aktiven Railentlüftungstest" SLONG Time_ms 1 100 -21474836480.0 21474836470.0 ECU_ADDRESS 0xC0008EFC /end MEASUREMENT
/begin MEASUREMENT FlSys_volFlCons "Absoluter Kraftstoffverbrauch in ul/20ms" SLONG FlConsum_ul_20ms 1 100 -2147483648.00 2147483647.00 FORMAT "%13.2" ECU_ADDRESS 0xD0002EE0 /end MEASUREMENT
/begin MEASUREMENT FlSys_volFlConsAct_mp "Bisher aufsummierter Gesamtverbrauch" SLONG Vol 1 100 -21474836.4800 21474836.4700 FORMAT "%13.4" ECU_ADDRESS 0xC0008F00 /end MEASUREMENT
/begin MEASUREMENT FlSys_volFlConsAdj_mp "abgeglichener aktueller absoluter Kraftstoffverbrauch in l/20ms für die Aufsummierung" SLONG FlConsum_ul_20ms 1 100 -2147483648.00 2147483647.00 FORMAT "%13.2" ECU_ADDRESS 0xC0008F0C /end MEASUREMENT
/begin MEASUREMENT FlSys_volFlConsRdEEP_mp "Verbrauch, der im Nachlauf ins EEPROM geschrieben wird" SLONG Vol 1 100 -21474836.4800 21474836.4700 FORMAT "%13.4" ECU_ADDRESS 0xC0008F04 /end MEASUREMENT
/begin MEASUREMENT FlSys_volFlConsWrEEP_mp "Verbrauch, der in der Initialisierung aus dem EEPROM gelesen wird" SLONG Vol 1 100 -21474836.4800 21474836.4700 FORMAT "%13.4" ECU_ADDRESS 0xC0008F08 /end MEASUREMENT
/begin MEASUREMENT FlSys_volTotFlCons "" SLONG FlConsum_ul_20ms 1 100 -2147483648.00 2147483647.00 FORMAT "%13.2" ECU_ADDRESS 0xD0002EE4 /end MEASUREMENT
/begin MEASUREMENT FMA_dqAbs_mp "Absolutwert der Einspritzmengenänderung für FMA" SWORD InjMassSec 1 100 -327.6800 327.6700 FORMAT "%8.4" ECU_ADDRESS 0xC0009EDC /end MEASUREMENT
/begin MEASUREMENT FMA_drLamAbs_mp "Absolutwert der Lambdaänderung für FMA" SWORD lambdaSec 1 100 -32.76800 32.76700 FORMAT "%8.5" ECU_ADDRESS 0xC0009EDE /end MEASUREMENT
/begin MEASUREMENT FMA_facAirSwtOff_mp "Ansauglufttemperaturabhängiger Abschaltfaktor der FMA" SWORD Fact 1 100 -4.000000 3.999878 ECU_ADDRESS 0xC0009EE0 /end MEASUREMENT
/begin MEASUREMENT FMA_facAPSwtOff_mp "Atmosphärendruckabhängiger Abschaltfaktor der FMA" SWORD Fact 1 100 -4.000000 3.999878 ECU_ADDRESS 0xC0009EE2 /end MEASUREMENT
/begin MEASUREMENT FMA_facEngSwtOff_mp "Motortemperaturabhängiger Abschaltfaktor der FMA" SWORD Fact 1 100 -4.000000 3.999878 ECU_ADDRESS 0xC0009EE4 /end MEASUREMENT
/begin MEASUREMENT FMA_facFaultSwtOff_mp "Faktor für langsame FMA-Abschaltung bei schweren Systemfehlern" SWORD Fact 1 100 -4.000000 3.999878 ECU_ADDRESS 0xC0009EE6 /end MEASUREMENT
/begin MEASUREMENT FMA_facFlSwtOff_mp "Kraftstofftemperaturabhängiger Abschaltfaktor der FMA" SWORD Fact 1 100 -4.000000 3.999878 ECU_ADDRESS 0xC0009EE8 /end MEASUREMENT
/begin MEASUREMENT FMA_facNQSwtOff_mp "Drehzahl-/einspritzmengenabhängiger Abschaltfaktor der FMA für betriebsbereichsabhängige Abschaltung" SWORD Fact 1 100 -4.000000 3.999878 ECU_ADDRESS 0xC0009ECC /end MEASUREMENT
/begin MEASUREMENT FMA_facRgnSwtOff_mp "Regenerations-/ Applikationsabhängiger Abschaltfaktor der FMA" SWORD Fact 1 100 -4.000000 3.999878 ECU_ADDRESS 0xC0009EEA /end MEASUREMENT
/begin MEASUREMENT FMA_facSlpSwtOff2Var_mp "FMA-Abschaltfaktor aus variantem Funktionsteil" SWORD Fact 1 100 -4.000000 3.999878 ECU_ADDRESS 0xC0009EEC /end MEASUREMENT
/begin MEASUREMENT FMA_facSlpSwtOff_mp "Abschaltfaktor der FMA nach Steigungsbegrenzung" SWORD Fact 1 100 -4.000000 3.999878 ECU_ADDRESS 0xC0009EEE /end MEASUREMENT
/begin MEASUREMENT FMA_facSwtOff "Abschaltfaktor zum langsamen Aus- und Einschalten der FMA" SWORD Fact 1 100 -4.000000 3.999878 ECU_ADDRESS 0xD0000AEE /end MEASUREMENT
/begin MEASUREMENT FMA_facSwtOffTot_mp "Gesamtabschaltfaktor zum langsamen Aus- und Einschalten der FMA" SWORD Fact 1 100 -4.000000 3.999878 ECU_ADDRESS 0xC0009ECE /end MEASUREMENT
/begin MEASUREMENT FMA_numLimMax_mp "Anzahl der Kennfeldpunkte oberhalb der Überwachungsgrenze" SWORD OneToOne 1 100 -32768.00 32767.00 ECU_ADDRESS 0xC0009ED0 /end MEASUREMENT
/begin MEASUREMENT FMA_numLimMin_mp "Anzahl der Kennfeldpunkte unterhalb der Überwachungsgrenze" SWORD OneToOne 1 100 -32768.00 32767.00 ECU_ADDRESS 0xC0009ED2 /end MEASUREMENT
/begin MEASUREMENT FMA_qAct_mp "Aus Lambda- und Luftmassenmessung ermittelte Einspritzmenge, wirkliche Einspritzmenge der FMA" SWORD InjMass 1 100 -327.6800 327.6700 ECU_ADDRESS 0xC0009EC4 /end MEASUREMENT
/begin MEASUREMENT FMA_qAirCtlCor "FMA Korrekturmenge zur lokalen Verwendung in AirCtl" SWORD InjMass 1 100 -327.6800 327.6700 ECU_ADDRESS 0xD0000AF0 /end MEASUREMENT
/begin MEASUREMENT FMA_qCor "" SWORD InjMass 1 100 -327.6800 327.6700 ECU_ADDRESS 0xD0000AF2 /end MEASUREMENT
/begin MEASUREMENT FMA_qCtl_mp "Für Bestimmung des Mengenfehlers verwendetes Mengensignal" SWORD InjMass 1 100 -327.6800 327.6700 ECU_ADDRESS 0xC0009EC8 /end MEASUREMENT
/begin MEASUREMENT FMA_qDC "Von FMA ermittelter Einspritzmengenfehler bzw. -korrekturwert für Betriebsart Direct Control (Modellfehler)" SWORD InjMass 1 100 -327.6800 327.6700 ECU_ADDRESS 0xD0000AF4 /end MEASUREMENT
/begin MEASUREMENT FMA_qDev_mp "Abweichung der wirklichen Einspritzmenge von der gewünschten Einspritzmenge in der FMA" SWORD InjMass 1 100 -327.6800 327.6700 ECU_ADDRESS 0xC0009EC6 /end MEASUREMENT
/begin MEASUREMENT FMA_qDiff_mp "Differenz aus Einspritzmengenfehler und aktuellem Kennfeldwert" SWORD InjMass 1 100 -327.6800 327.6700 ECU_ADDRESS 0xC0009ED4 /end MEASUREMENT
/begin MEASUREMENT FMA_qErrMod_mp "Aus Fehlermodell ermittelter Rohwert des Einspritzmengenfehlers" SWORD InjMass 1 100 -327.6800 327.6700 ECU_ADDRESS 0xC0009ED6 /end MEASUREMENT
/begin MEASUREMENT FMA_qMapRow0_mp "Kennfeldwerte für erste Mengenstützstelle (erste zeile von adaptive Kennfeld)" SWORD InjMass 1 100 -327.6800 327.6700 ARRAY_SIZE 8 ECU_ADDRESS 0xC000BD94 /end MEASUREMENT
/begin MEASUREMENT FMA_qMapRow1_mp "Kennfeldwerte für zweite Mengenstützstelle (zweite zeile von adaptive Kennfeld)" SWORD InjMass 1 100 -327.6800 327.6700 ARRAY_SIZE 8 ECU_ADDRESS 0xC000BDA4 /end MEASUREMENT
/begin MEASUREMENT FMA_qMapRow2_mp "Kennfeldwerte für dritte Mengenstützstelle (dritte zeile von adaptive Kennfeld)" SWORD InjMass 1 100 -327.6800 327.6700 ARRAY_SIZE 8 ECU_ADDRESS 0xC000BDB4 /end MEASUREMENT
/begin MEASUREMENT FMA_qMapRow3_mp "Kennfeldwerte für vierte Mengenstützstelle (vierte zeile von adaptive Kennfeld)" SWORD InjMass 1 100 -327.6800 327.6700 ARRAY_SIZE 8 ECU_ADDRESS 0xC000BDC4 /end MEASUREMENT
/begin MEASUREMENT FMA_qMapRow4_mp "Kennfeldwerte für fünfte Mengenstützstelle (fünfte zeile von adaptive Kennfeld)" SWORD InjMass 1 100 -327.6800 327.6700 ARRAY_SIZE 8 ECU_ADDRESS 0xC000BDD4 /end MEASUREMENT
/begin MEASUREMENT FMA_qMapRow5_mp "Kennfeldwerte für sechste Mengenstützstelle (sechste zeile von adaptive Kennfeld)" SWORD InjMass 1 100 -327.6800 327.6700 ARRAY_SIZE 8 ECU_ADDRESS 0xC000BDE4 /end MEASUREMENT
/begin MEASUREMENT FMA_qMapRow6_mp "Kennfeldwerte für siebte Mengenstützstelle (siebte zeile von adaptive Kennfeld)" SWORD InjMass 1 100 -327.6800 327.6700 ARRAY_SIZE 8 ECU_ADDRESS 0xC000BDF4 /end MEASUREMENT
/begin MEASUREMENT FMA_qMapRow7_mp "Kennfeldwerte für achte Mengenstützstelle (achte zeile von adaptive Kennfeld)" SWORD InjMass 1 100 -327.6800 327.6700 ARRAY_SIZE 8 ECU_ADDRESS 0xC000BE04 /end MEASUREMENT
/begin MEASUREMENT FMA_qReg_mp "Einspritzmengenfehler im aktuellen Lernbereich" SWORD InjMass 1 100 -327.6800 327.6700 ECU_ADDRESS 0xC0009ED8 /end MEASUREMENT
/begin MEASUREMENT FMA_qSetFil_mp "Initialisierungswert für Integrierer bzw. PT1-Filter" SWORD InjMass 1 100 -327.6800 327.6700 ECU_ADDRESS 0xC0009EDA /end MEASUREMENT
/begin MEASUREMENT FMA_q_mp "Mit Abschaltfaktor multiplizierter Mengenfehler des Fehlermodells" SWORD InjMass 1 100 -327.6800 327.6700 ECU_ADDRESS 0xC0009ECA /end MEASUREMENT
/begin MEASUREMENT FMA_stDynDlyd_mp "FMA-Status: Aktuell oder vor kurzem starke Änderung der Einspritzmenge (verzögerte Einspritzmengendynamik)" UBYTE OneToOne 1 100 0.00 255.0 ECU_ADDRESS 0xC000B1CE /end MEASUREMENT
/begin MEASUREMENT FMA_stDynLam_mp "FMA- Status: Aktuell oder bis vor kurzem starke Lambdaänderung" UBYTE OneToOne 1 100 0.00 255.0 ECU_ADDRESS 0xC000B1CF /end MEASUREMENT
/begin MEASUREMENT FMA_stNoAdapt_mp "Status: Adaption des FMA-Fehlermodells angehalten" UWORD OneToOne 1 100 0.00 65535.00 ECU_ADDRESS 0xC0009EF0 /end MEASUREMENT
/begin MEASUREMENT FMA_stOvrRunDlyd_mp "FMA-Status: Aktuell oder bis vor kurzem Schubbetrieb (verzögerter Schubbetrieb)" UBYTE OneToOne 1 100 0.00 255.0 ECU_ADDRESS 0xC000B1D0 /end MEASUREMENT
/begin MEASUREMENT FMA_stReset_mp "Status: FMA-Fehlermodell wird zurückgesetzt" UBYTE OneToOne 1 100 0.00 255.0 ECU_ADDRESS 0xC000B1D1 /end MEASUREMENT
/begin MEASUREMENT FMA_stRngLam_mp "FMA-Status: Lambda aktuell oder bis vor kurzem außerhalb gültigem Bereich" UBYTE OneToOne 1 100 0.00 255.0 ECU_ADDRESS 0xC000B1D2 /end MEASUREMENT
/begin MEASUREMENT FMA_stSwtOff "Abschaltzustand der FMA" UBYTE OneToOne 1 100 0.00 255.0 ECU_ADDRESS 0xD0001E39 /end MEASUREMENT
/begin MEASUREMENT FMA_stSwtOff3Var_mp "FMA Abschaltanforderung aus variantem Funktionsteil nach Abschaltmöglichkeit 3" UBYTE OneToOne 1 100 0.00 255.0 ECU_ADDRESS 0xC000B1D3 /end MEASUREMENT
/begin MEASUREMENT FMA_tiFuncOp "Betriebszeit des Fehlermodells seit der letzten Initialisierung der Lernwerte" SLONG Time_s 1 100 -21474836.4800 21474836.4700 ECU_ADDRESS 0xD0002ED8 /end MEASUREMENT
/begin MEASUREMENT FMA_trqAirCtlCor "FMA Korrekturmoment zur lokalen Verwendung in AirCtl" SWORD Trq 1 100 -3276.800 3276.700 ECU_ADDRESS 0xD0000AF6 /end MEASUREMENT
/begin MEASUREMENT FMO_facAirMsCor "" SWORD Fact 1 100 -4.000000 3.999878 ECU_ADDRESS 0xD0000AF8 /end MEASUREMENT
/begin MEASUREMENT FMO_qCor "" SWORD InjMass 1 100 -327.6800 327.6700 ECU_ADDRESS 0xD0000AFC /end MEASUREMENT
/begin MEASUREMENT FMO_qFullLdCor "" SWORD InjMass 1 100 -327.6800 327.6700 ECU_ADDRESS 0xD0000AFE /end MEASUREMENT
/begin MEASUREMENT FuelT_t "Kraftstofftemperatur" SWORD Temp_Cels 1 100 -3549.940 3003.560 ECU_ADDRESS 0xD0000B26 /end MEASUREMENT
/begin MEASUREMENT FuelT_tFlSys "Kraftstoffsystemtemperatur" SWORD Temp_Cels 1 100 -3549.940 3003.560 ECU_ADDRESS 0xD0000B28 /end MEASUREMENT
/begin MEASUREMENT FuelT_tSens "Erfasster Wert der Kraftstofftemperatur" SWORD Temp_Cels 1 100 -3549.940 3003.560 ECU_ADDRESS 0xD0000B2A /end MEASUREMENT
/begin MEASUREMENT FuelT_uRaw "Rohspannungswert aus dem ADC für Kraftstofftemperatursensor" SWORD Volt 1 100 -6553.600 6553.400 ECU_ADDRESS 0xD0000B2C /end MEASUREMENT
/begin MEASUREMENT GbxNPos_bEval "" UBYTE OneToOne 1 100 0.00 1.000 BIT_MASK 0x40 ECU_ADDRESS 0xD00003BA /end MEASUREMENT
/begin MEASUREMENT GbxNPos_bRec "" UBYTE OneToOne 1 100 0.00 1.000 BIT_MASK 0x10 ECU_ADDRESS 0xD00003C5 /end MEASUREMENT
/begin MEASUREMENT GbxNPos_bRecActv "" UBYTE OneToOne 1 100 0.00 1.000 BIT_MASK 0x80 ECU_ADDRESS 0xD00003C3 /end MEASUREMENT
/begin MEASUREMENT GbxNPos_rRawNPos "" SWORD DtyCyc 1 100 -327.6800 327.6700 ECU_ADDRESS 0xD0000B38 /end MEASUREMENT
/begin MEASUREMENT GbxNPos_stRec_mp "" UBYTE OneToOne 1 100 0.00 255.0 ECU_ADDRESS 0xC000B1D6 /end MEASUREMENT
/begin MEASUREMENT GbxNPos_tiPer_mp "" ULONG Time_PwmHigh 1 100 0.00 214748364.750 FORMAT "%13.3" ECU_ADDRESS 0xC0008F10 /end MEASUREMENT
/begin MEASUREMENT Gbx_bNPosPls "" UBYTE OneToOne 1 100 0.00 255.0 ECU_ADDRESS 0xD0001E58 /end MEASUREMENT
/begin MEASUREMENT Gbx_bNPosPlsActv "" UBYTE OneToOne 1 100 0.00 255.0 ECU_ADDRESS 0xD0001E59 /end MEASUREMENT
/begin MEASUREMENT Gbx_bNPosPlsErr_mp "" UBYTE OneToOne 1 100 0.00 255.0 ECU_ADDRESS 0xC000B1D7 /end MEASUREMENT
/begin MEASUREMENT Gbx_bNPosPlsUpdate "" UBYTE OneToOne 1 100 0.00 255.0 ECU_ADDRESS 0xD0001E5A /end MEASUREMENT
/begin MEASUREMENT Gbx_bNPosUnPls "" UBYTE OneToOne 1 100 0.00 255.0 ECU_ADDRESS 0xD0001E5B /end MEASUREMENT
/begin MEASUREMENT Gbx_ctGbxNPosUnPls "" UBYTE OneToOne 1 100 0.00 255.0 ECU_ADDRESS 0xD0001E5D /end MEASUREMENT
/begin MEASUREMENT Gbx_ctNPosUnPls "" UBYTE OneToOne 1 100 0.00 255.0 ECU_ADDRESS 0xD0001E5E /end MEASUREMENT
/begin MEASUREMENT Gbx_ctNPosUnPlsHigh "" UBYTE OneToOne 1 100 0.00 255.0 ECU_ADDRESS 0xD0001E5F /end MEASUREMENT
/begin MEASUREMENT Gbx_dNPos "" SWORD DtyCyc 1 100 -327.6800 327.6700 ECU_ADDRESS 0xD0000B3E /end MEASUREMENT
/begin MEASUREMENT Gbx_nTrbn "Turbinendrehzahl Getriebe" SWORD EngN 1 100 -16384.00 16383.50 ECU_ADDRESS 0xD0000B44 /end MEASUREMENT
/begin MEASUREMENT Gbx_numGear "eingelegter Gang (sint8)" SBYTE OneToOne 1 100 -128.0 127.0 ECU_ADDRESS 0xD0001BCA /end MEASUREMENT
/begin MEASUREMENT Gbx_numGearTrgt "Zielgang (sint8)" SBYTE OneToOne 1 100 -128.0 127.0 ECU_ADDRESS 0xD0001BCB /end MEASUREMENT
/begin MEASUREMENT Gbx_stNPosRaw "" UBYTE OneToOne 1 100 0.00 255.0 ECU_ADDRESS 0xD0001E62 /end MEASUREMENT
/begin MEASUREMENT Gbx_trqPrt "Getriebeschutzmoment (Kupplung)" SWORD Trq 1 100 -3276.800 3276.700 ECU_ADDRESS 0xD0000B54 /end MEASUREMENT
/begin MEASUREMENT Gbx_trqTIIDes "inneres erhöhendes Getriebeeingriffsmoment" SWORD Trq 1 100 -3276.800 3276.700 ECU_ADDRESS 0xD0000B56 /end MEASUREMENT
/begin MEASUREMENT Gbx_trqTSCIntv "inneres Motorsollmoment" SWORD Trq 1 100 -3276.800 3276.700 ECU_ADDRESS 0xD0000B58 /end MEASUREMENT
/begin FUNCTION ETClb_Lib ""
 /begin DEF_CHARACTERISTIC ETClb_ctDflLrnAllw_CA ETClb_ctDflLrn_CA ETClb_ctLrnPerDelta_C ETClb_dtiDflETFlt0_CA ETClb_dtiDflETFlt1_CA ETClb_dtiDflETFlt2_CA ETClb_dtiDflETFlt3_CA ETClb_dtiDflETFlt4_CA ETClb_dtiDflETFlt5_CA ETClb_dtiDflETFlt6_CA ETClb_lDelta_C ETClb_lLrnDelta_C ETClb_numDflCylCur_CA ETClb_stRlsCylCorDfl_C ETClb_swtDflLimClbFrq_C ETClb_swtDflQckClb_C ETClb_swtLimClbFrqOff_C ETClb_tiDflETCur_CA ETClb_tiETOfsMax_CA ETClb_tiETOfsMin_CA /end DEF_CHARACTERISTIC
 /begin REF_CHARACTERISTIC ETClb_ctLrnThres_C ETClb_pRailSet_CA ETClb_swtWrDflVal_C ETClb_tiET_MAX_CA ETClb_tiET_MIN_CA ETClb_volEffectiveMin_CA InjVlv_stZFCETCorActv_C InjVlv_swtZFCCorOvrRunOn_C /end REF_CHARACTERISTIC
 /begin IN_MEASUREMENT Epm_numCyl ETClb_stCor ETClb_swtCorActv GlbDa_lTotDst MoFOvR_stActvMsg /end IN_MEASUREMENT
 /begin OUT_MEASUREMENT ETClb_stLimClbFrq /end OUT_MEASUREMENT
 /begin LOC_MEASUREMENT ETClb_ctDelta_mp ETClb_ctLrnCyclAllw_mp ETClb_swtRCClb_mp ETClb_tiETChkCor0_mp ETClb_tiETChkCor1_mp ETClb_tiETChkCor2_mp ETClb_tiETChkCor3_mp ETClb_tiETChkCor4_mp ETClb_tiETChkCor5_mp ETClb_tiETChkCor6_mp /end LOC_MEASUREMENT
/end FUNCTION
/begin FUNCTION ETCtl_Ini "" /begin DEF_CHARACTERISTIC ETCtl_swtActv_C /end DEF_CHARACTERISTIC /begin OUT_MEASUREMENT ETCtl_swtActv /end OUT_MEASUREMENT /end FUNCTION
/begin FUNCTION ETCtl_InrLp ""
 /begin DEF_CHARACTERISTIC ETCtl_facKiAirMsPT_CUR ETCtl_facKiNegInr_C ETCtl_facKiPosInr_C ETCtl_facKiQntPoI2_MAP ETCtl_facKpAirMsPT_CUR ETCtl_facKpNegInr_C ETCtl_facKpPosInr_C ETCtl_facKpQntPoI2_MAP ETCtl_facPoI2PoI1Dist_C ETCtl_mAirLam_CUR ETCtl_mAirMax_MAP ETCtl_mAirMin_MAP ETCtl_mAirThresOff_C ETCtl_phiPoI2Cor_MAP ETCtl_qPoI2Max_MAP ETCtl_qPoI2Min_C ETCtl_qPoI2Min_MAP ETCtl_qPoI2ThresOff_C ETCtl_stMskClsThrVlv_C ETCtl_swtPoI2PoI1Dist_C ETCtl_tiRmpInr_C ETCtl_tWinNegInr_C ETCtl_tWinPosInr_C /end DEF_CHARACTERISTIC
 /begin IN_MEASUREMENT ASMod_rLamRecExhMnfDs CoEOM_stOpModeAct Epm_nEng ETCtl_qPoI1Raw ETCtl_st ETCtl_swtActv ETCtl_tInrDesCor Exh_tAdapTTrbnUs InjCtl_qSetUnBal PFlt_tInrDes /end IN_MEASUREMENT
 /begin OUT_MEASUREMENT ETCtl_mAirDesVal ETCtl_phiPoI2Cor ETCtl_qPoI1 ETCtl_qPoI2 ETCtl_tDvtInr /end OUT_MEASUREMENT
 /begin LOC_MEASUREMENT ETCtl_mAirDes_mp ETCtl_mAirLam_mp ETCtl_mAirMin_mp ETCtl_mAirRng_mp ETCtl_qPoI2Min_mp ETCtl_qPoI2Raw_mp ETCtl_qPoI2Rng_mp ETCtl_rIInr_mp ETCtl_rInr_mp ETCtl_rLamRecExhMnfDs_mp ETCtl_rMaxInr_mp ETCtl_rMinInr_mp ETCtl_rPInr_mp ETCtl_rStyInr_mp ETCtl_stClsThrVlv_mp ETCtl_tDvtInrRaw_mp /end LOC_MEASUREMENT
/end FUNCTION
/begin FUNCTION ETCtl_Mon ""
 /begin DEF_CHARACTERISTIC ETCtl_DebPoI.tiHiLo_C ETCtl_DebPoI.tiLoHi_C ETCtl_DebTemp.tiHiLo_C ETCtl_DebTemp.tiLoHi_C ETCtl_stMskInr_CA ETCtl_stMskNSC_C ETCtl_stMskOutr_CA ETCtl_tInrDvtMax_C ETCtl_tInrDvtMin_C ETCtl_tInrThresDwn_C ETCtl_tInrThresUp_C ETCtl_tOutrDvtMax_C ETCtl_tOutrDvtMin_C ETCtl_tOutrThresDwn_C ETCtl_tOutrThresUp_C ETCtl_tOxiCatUsThresBrn_C /end DEF_CHARACTERISTIC
 /begin IN_MEASUREMENT CoEOM_stOpModeAct ETCtl_swtActv ETCtl_tDvtInr ETCtl_tDvtOutr Exh_tAdapTOxiCatUs Exh_tAdapTPFltUs Exh_tAdapTTrbnUs InjCrv_stInjCharActVal /end IN_MEASUREMENT
 /begin OUT_MEASUREMENT ETCtl_st /end OUT_MEASUREMENT
/end FUNCTION
/begin FUNCTION ETCtl_OutrLp ""
 /begin DEF_CHARACTERISTIC ETCtl_facKiNegOutr_C ETCtl_facKiPosOutr_C ETCtl_facKiQntPoI1_MAP ETCtl_facKiTempInrCor_MAP ETCtl_facKpNegOutr_C ETCtl_facKpPosOutr_C ETCtl_facKpQntPoI1_MAP ETCtl_facKpTempInrCor_MAP ETCtl_numTempSensOutrLp_C ETCtl_qPoI1Max_MAP ETCtl_qPoI1Min_C ETCtl_qPoI1Min_MAP ETCtl_qPoI1ThresOff_C ETCtl_tInrCorMax_MAP ETCtl_tInrCorMin_MAP ETCtl_tInrCorThresOff_C ETCtl_tiPoI1Cor_MAP ETCtl_tiRmpOutr_C ETCtl_tWinNegOutr_C ETCtl_tWinPosOutr_C /end DEF_CHARACTERISTIC
 /begin IN_MEASUREMENT Epm_nEng ETCtl_st ETCtl_swtActv Exh_tFld InjCtl_qSetUnBal PFlt_tOutrDes /end IN_MEASUREMENT
 /begin OUT_MEASUREMENT ETCtl_qPoI1Raw ETCtl_tDvtOutr ETCtl_tInrDesCor ETCtl_tiPoI1Cor /end OUT_MEASUREMENT
 /begin LOC_MEASUREMENT ETCtl_qPoI1Min_mp ETCtl_qPoI1RawTmp_mp ETCtl_qPoI1Rng_mp ETCtl_rIOutr_mp ETCtl_rMaxOutr_mp ETCtl_rMinOutr_mp ETCtl_rOutr_mp ETCtl_rPOutr_mp ETCtl_rStyOutr_mp ETCtl_tDvtOutrRaw_mp ETCtl_tInrCorMax_mp ETCtl_tInrCorRng_mp ETCtl_tInrDesCorRaw_mp ETCtl_tPFltUs_mp /end LOC_MEASUREMENT
/end FUNCTION
/begin FUNCTION EtkS "" /end FUNCTION
/begin FUNCTION ETS_GlbDef "" /end FUNCTION
/begin FUNCTION ExeCon "" /end FUNCTION
/begin FUNCTION ExhTMon ""
 /begin DEF_CHARACTERISTIC Exh_nChkTrgExhTMon_C Exh_numSimTempPos1_C Exh_numSimTempPos2_C Exh_numSimTempPos3_C Exh_numTempEngMon_C Exh_numTempPos1_C Exh_numTempPos2_C Exh_numTempPos3_C Exh_numTempSens_C Exh_numTempStyChk_C Exh_pMinNmrCldStrt_C Exh_stMskLckNplExhTMon_C Exh_swtEngOffTmr_C Exh_swtEnvTSensPrs_C Exh_swtStyCondExhTMon_C Exh_tCldStrtExhTMonDfl_C Exh_tDiffCldExhTMonMax_C Exh_tDiffNgvExhTMon1_CUR Exh_tDiffNgvExhTMon2_CUR Exh_tDiffNgvExhTMon3_CUR Exh_tDiffPsvExhTMon1_CUR Exh_tDiffPsvExhTMon2_CUR Exh_tDiffPsvExhTMon3_CUR Exh_tExhTMon1TolcMax_CUR Exh_tExhTMon2TolcMax_CUR Exh_tExhTMon3TolcMax_CUR Exh_tExhTMonMaxVar_C Exh_tiChkTempPlausMax_CUR Exh_tiLckChkTempPlaus_C Exh_tiLckPlausRgnExhTMon_C Exh_tiLckStrtExhTMon_C Exh_tiMinSnceStop_C Exh_tIncrExhTMon1_C Exh_tIncrExhTMon2_C Exh_tIncrExhTMon3_C Exh_tiTempStyChk_C Exh_tMaxExhTMon_C Exh_tMinExhTMon_C Exh_tUnLckTempPlaus_C /end DEF_CHARACTERISTIC
 /begin IN_MEASUREMENT Air_tCACDs ASMod_tEGFld BattU_u CoEng_st CoEOM_stOpModeAct EngDa_tFld EngDa_tiEngOff EnvP_p EnvT_t Epm_nEng /end IN_MEASUREMENT
 /begin OUT_MEASUREMENT Exh_stTempStyExhTMon Exh_tMonFld Exh_tSimFld /end OUT_MEASUREMENT
 /begin LOC_MEASUREMENT Exh_stCmp_mp Exh_stLckTempPlausTmr_mp Exh_stLckTempPlaus_mp Exh_stLckTmr_mp Exh_stPlausCondExhTMon_mp Exh_stTempPlausDone_mp Exh_stUnLckCldStrtEEP_mp Exh_stUnLckCldStrtTst_mp Exh_tCmp1_mp Exh_tCmp2_mp Exh_tCmp3_mp Exh_tDiffPlausExhTMon1_mp Exh_tDiffPlausExhTMon2_mp Exh_tDiffPlausExhTMon3_mp Exh_tDiffPos1NgvExhTMon_mp Exh_tDiffPos1PsvExhTMon_mp Exh_tDiffPos2NgvExhTMon_mp Exh_tDiffPos2PsvExhTMon_mp Exh_tDiffPos3NgvExhTMon_mp Exh_tDiffPos3PsvExhTMon_mp Exh_tEngMon_mp Exh_tExhTMon1_mp Exh_tExhTMon2_mp Exh_tExhTMon3_mp Exh_tExhTMonStyTmp_mp Exh_tSim1Fld_mp Exh_tSim2Fld_mp Exh_tSim3Fld_mp Exh_tStyChk_mp /end LOC_MEASUREMENT
/end FUNCTION
/begin FUNCTION Exh_Fld "" /begin DEF_CHARACTERISTIC Exh_stPresDevPrs_C Exh_stTempDevPrs_C /end DEF_CHARACTERISTIC
 /begin IN_MEASUREMENT Exh_pPFltDiff Exh_pPFltUs Exh_pTrbnUs Exh_tOxiCatDs Exh_tOxiCatUs Exh_tPFltDs Exh_tPFltUs Exh_tTrbnUs /end IN_MEASUREMENT
 /begin OUT_MEASUREMENT Exh_pFld Exh_tFld /end OUT_MEASUREMENT
/end FUNCTION
/begin FUNCTION FanCtl_Spd ""
 /begin DEF_CHARACTERISTIC FanCtl_dcycAftRun_C FanCtl_dcycHysDelta_C FanCtl_dcycMax_C FanCtl_dcycMinOff_C FanCtl_dcycSwtLimOff_C FanCtl_dcycSwtLimOn_C FanCtl_dcyc_CUR FanCtl_facCorErr_C FanCtl_facWghFctr_CUR FanCtl_nEFanACDem_CUR FanCtl_nEFanDfl_C FanCtl_nEFan_CUR FanCtl_nMin_C FanCtl_nOvrTemp_C FanCtl_nSetGbxOil_MAP FanCtl_nSetPntTrailer_MAP FanCtl_nSetPnt_MAP FanCtl_nSetPointFanOn_C FanCtl_nSpd2Win1L_C FanCtl_nSpd2Win1R_C FanCtl_nSpd2Win2L_C FanCtl_nSpd2Win2R_C FanCtl_nSpd2Win3L_C FanCtl_nSpd2Win3R_C FanCtl_nSpdWin1L_C FanCtl_nSpdWin1R_C FanCtl_nSpdWin2L_C FanCtl_nSpdWin2R_C FanCtl_nSpdWin3L_C FanCtl_nSpdWin3R_C FanCtl_stEOMMSK1_C FanCtl_stEOMMSK2_C FanCtl_stEOMMSK3_C FanCtl_stRgnTst_C FanCtl_stTrailerErr_C FanCtl_swtBattCor_C FanCtl_swtRgnTst_C FanCtl_tClntDfl_C FanCtl_tEngAftRunThres_C FanCtl_tEnvThres_C FanCtl_tGbxOilDfl_C FanCtl_tiDebRgnActv_C FanCtl_tiMinAftRunOfs_C FanCtl_tiOvrTempOn_C FanCtl_tiOvrTempReset_C FanCtl_uBattRef_C /end DEF_CHARACTERISTIC
 /begin REF_CHARACTERISTIC SyC_tiPostDrvMin_C /end REF_CHARACTERISTIC
 /begin IN_MEASUREMENT CoEOM_stOpModeAct Com_rACFanDem Com_stStgEFan Com_stTrailer EnvT_t Epm_nEng GlbDa_vX T15_st /end IN_MEASUREMENT
 /begin OUT_MEASUREMENT FanCtl_nRqMax FanCtl_nSetPoint FanCtl_stAftRun /end OUT_MEASUREMENT
 /begin LOC_MEASUREMENT FanCtl_dcycBattCor_mp FanCtl_dcycHysStart_mp FanCtl_dcycHys_mp FanCtl_dcycRaw_mp FanCtl_facWghFctr_mp FanCtl_nSetGbxOilMap_mp FanCtl_nSetPntCAN_mp FanCtl_nSetPntMap_mp FanCtl_stHys_mp FanCtl_stLogic_mp FanCtl_stOvrTemp_mp FanCtl_stRgnDeb_mp FanCtl_stRgnFF_mp FanCtl_stRgn_mp FanCtl_tClnt_mp FanCtl_tGbxOil_mp /end LOC_MEASUREMENT
/end FUNCTION
/begin FUNCTION Fan_DD ""
 /begin DEF_CHARACTERISTIC Fan_4WinDiagDeb.ct4WinErr1DebDef_C Fan_4WinDiagDeb.ct4WinErr2DebDef_C Fan_4WinDiagDeb.ct4WinErr3DebDef_C Fan_4WinDiagDeb.ct4WinErr4DebDef_C Fan_4WinDiagDeb.ti4WinErrDebDef_C Fan_4WinSigDur.tiErr1Min_C Fan_4WinSigDur.tiErr1Max_C Fan_4WinSigDur.tiErr2Min_C Fan_4WinSigDur.tiErr2Max_C Fan_4WinSigDur.tiErr3Min_C Fan_4WinSigDur.tiErr3Max_C Fan_4WinSigDur.tiErr4Min_C Fan_4WinSigDur.tiErr4Max_C Fan_Pwm.tiPer_C Fan_Pwm.stLvl_C Fan_Pwm.rMaxDty_C Fan_Pwm.rPerUn_C Fan_Pwm.tiPh_C Fan_PwmOut.rMin_C Fan_PwmOut.rMax_C Fan_PwmOut.tiBtwTstSCB_C Fan_PwmOut.tiBtwTstOT_C Fan_PwmOut.numTstMax_C Fan_PwmOut.swtBattCor_C Fan_PwmOut.swtPsInv_C Fan_rCnv_CUR Fan_rPsDisbl_C Fan_stPsDiaDisbl_C Fan_stPsDisbl_C Fan_tiAfterrun_C Fan_typ4WinDia_C /end DEF_CHARACTERISTIC
 /begin IN_MEASUREMENT BattU_facCor DevLib_stPwrStgEnaCond FanCtl_stAftRun /end IN_MEASUREMENT
 /begin OUT_MEASUREMENT Fan_r Fan_rPs /end OUT_MEASUREMENT
 /begin LOC_MEASUREMENT Fan_ct4WinErr1_mp Fan_ct4WinErr2_mp Fan_ct4WinErr3_mp Fan_ct4WinErr4_mp Fan_rCalc_mp Fan_rCor_mp Fan_stErrMsg_mp /end LOC_MEASUREMENT
/end FUNCTION
/begin FUNCTION FBC_Equal ""
 /begin DEF_CHARACTERISTIC FBC_BPFac.NumLo_CA FBC_BPFac.NumHi_CA FBC_BPFac.Den1_CA FBC_BPFac.Den2_CA FBC_BPFac1NumG_CUR FBC_ctPhComp_C FBC_ctSegOffset_C FBC_ctTDCOfs_C FBC_dqThresSurge_C FBC_dSegNhiCaS_CA FBC_dSegNloCaS_CA FBC_dSyn_C FBC_facBPRedNum_C FBC_fSurge_CUR FBC_GvrnI.Ki_C FBC_GvrnI.KiPos_C FBC_GvrnI.KiNeg_C FBC_GvrnI.WinPos_C FBC_GvrnI.WinNeg_C FBC_GvrnP.Kp_C FBC_GvrnP.KpPos_C FBC_GvrnP.KpNeg_C FBC_GvrnP.WinPos_C FBC_GvrnP.WinNeg_C FBC_nCtlOfsMin_C FBC_nCtlThresMax_C FBC_nGvrnOfsMin_C FBC_nGvrnThresMax_C FBC_nHyst_C FBC_nSurgeOffset_C FBC_qCtlOfsMax_C FBC_qCtlThresMin_C FBC_qDvtMax_CUR FBC_qDvtMin_CUR FBC_qGvrnThresMax_CUR FBC_qGvrnThresMin_C FBC_qLimDia_C FBC_qLim_CUR FBC_qRCLim_C FBC_qRC_CA FBC_stOpModeFrz_C FBC_stOpModeInhib_C FBC_swtInitI_C FBC_swtRC_C /end DEF_CHARACTERISTIC
 /begin REF_CHARACTERISTIC FBC_nThresFbc_C /end REF_CHARACTERISTIC
 /begin IN_MEASUREMENT Clth_st CoEng_st CoEng_stTst CoEOM_stOpModeAct EpmCrS_numSeg EpmCrS_tiSeg Epm_nEng Epm_numCyl FBC_WheelLrnOut InjCtl_qSetUnBal PthSet_stOvrRunCoord PT_rTrq PT_stGrip SpdGov_nSetPLo /end IN_MEASUREMENT
 /begin OUT_MEASUREMENT FBC_ctSegInt FBC_dBPSum FBC_qArr FBC_qDvtCyl FBC_qDvtCylPhys FBC_qLimAct FBC_qLimIncr FBC_stActive FBC_stEqualInit /end OUT_MEASUREMENT
 /begin LOC_MEASUREMENT FBC_dBPCaS FBC_dBPCaSOld_mp FBC_facBPNum_mp FBC_facSegVal_mp FBC_nMaxOvrRun_mp FBC_q FBC_qIntegrator_mp FBC_qSet FBC_qSetOld_mp FBC_stBPRedNum_mp FBC_stRegionSRCtl_mp /end LOC_MEASUREMENT
/end FUNCTION
/begin FUNCTION FBC_WheelLrn ""
 /begin DEF_CHARACTERISTIC FBC_ActESpP_C FBC_DSMUrgencyOffset_C FBC_DXAdapLo_C FBC_DXAdapUp_C FBC_DXalf0_C FBC_EnblCpy_C FBC_EnblIpo_C FBC_nBrIpoRng_CA FBC_nLrnThres_CA FBC_nThresFbc_C FBC_PrtnRmp_C FBC_TFConst_C FBC_TFLrnConst_C FBC_ThresDyn_C /end DEF_CHARACTERISTIC
 /begin REF_CHARACTERISTIC FBC_nCtlThresMax_C FBC_nGvrnOfsMin_C FBC_nHyst_C /end REF_CHARACTERISTIC
 /begin IN_MEASUREMENT CoEng_st EpmCrS_numSeg EpmSyn_phiInt Epm_nEng Epm_numCyl FBC_stEqualInit PthSet_stOvrRunCoord SpdGov_nSetPLo /end IN_MEASUREMENT
 /begin OUT_MEASUREMENT FBC_AAIn FBC_Badpt FBC_numAASeg FBC_RegionChng FBC_stLearn FBC_WheelLrnOut /end OUT_MEASUREMENT
 /begin LOC_MEASUREMENT FBC_AACoef_mp FBC_AAInSum_mp FBC_AAOrd_mp FBC_AAOut_mp FBC_AAPhiAbs_mp FBC_AAPhiLen_mp FBC_DXAdap_mp FBC_DXSfn_mp FBC_DXSfp_mp FBC_DXSf_mp FBC_DXSl_mp FBC_DXS_mp FBC_dynSpd_mp FBC_stBufSeg_mp FBC_stBufSubSeg_mp FBC_stRegionESpP_mp FBC_stStateESpP_mp FBC_TSmCoef_mp FBC_WheelLrnOutOld_mp /end LOC_MEASUREMENT
/end FUNCTION
/begin FUNCTION FlashHndl "" /end FUNCTION
/begin FUNCTION FlFCBS "" /begin SUB_FUNCTION FlFCBS_CalcCBS /end SUB_FUNCTION /end FUNCTION
/begin FUNCTION FlFCBS_CalcCBS ""
 /begin DEF_CHARACTERISTIC FlFCBS_lCalcDistance_MAP FlFCBS_lCalcProgWay_C FlFCBS_lDistanceMax_C FlFCBS_lFlFDef_C FlFCBS_lThresOut_C FlFCBS_mskFlLPCSelfRec_C FlFCBS_qCalcFlTot_CUR FlFCBS_stFlLPCSelfRec_C /end DEF_CHARACTERISTIC
 /begin IN_MEASUREMENT Com_ctCBSRstFlF Com_rAvlCBSRstFlF FlFltDsP_bRec FlFltHt_bRec FlSys_volTotFlCons Layer_facFrcCBS T15_st /end IN_MEASUREMENT
 /begin OUT_MEASUREMENT FlFCBS_dAvaiOut FlFCBS_lDistanceOut FlFCBS_lProgWay FlFCBS_qFlTotDMEChg FlFCBS_stCalc FlFCBS_stCBSMsg FlFCBS_stCntValOut FlFCBS_stDMEChg FlFCBS_stDMEIni FlFCBS_stFlFChg FlFCBS_stFlLPCActv FlFCBS_stIdCBS4 FlFCBS_stIdFnCBS4 FlFCBS_stIDMsg FlFCBS_stProgMon FlFCBS_stProgTime FlFCBS_stProgYr FlFCBS_stUnit FlFCBS_voltotFlConsum /end OUT_MEASUREMENT
 /begin LOC_MEASUREMENT FlFCBS_dAvaiDMEChg_mp FlFCBS_facCor_mp FlFCBS_stDMEIni_mp FlFCBS_stManip_mp FlFCBS_stRequest_mp FlFCBS_stSelfRecClct_mp FlFCBS_voltotFlConsum_l_mp /end LOC_MEASUREMENT
/end FUNCTION
/begin FUNCTION FlFltDsP_DD ""
 /begin DEF_CHARACTERISTIC FlFltDsP_pTransf_CUR FlFltDsP_SRC.uMin_C FlFltDsP_SRC.uMax_C FlFltDsP_swtRecDeAct_C FlFltDsP_tiRecDeb_C FlFltDsP_tiSigRawPT1_C /end DEF_CHARACTERISTIC
 /begin OUT_MEASUREMENT FlFltDsP_bEval FlFltDsP_bRec FlFltDsP_bRecActv FlFltDsP_pSens FlFltDsP_uRaw /end OUT_MEASUREMENT
 /begin LOC_MEASUREMENT FlFltDsP_stRec FlFltDsP_uRawUnFlt_mp /end LOC_MEASUREMENT
/end FUNCTION
/begin FUNCTION FlFltDsP_VD ""
 /begin DEF_CHARACTERISTIC FlFltDsP_RmpSlp.Pos_C FlFltDsP_RmpSlp.Neg_C FlFltDsP_tiLPFiltPT1_C FlFltDsP_TransStg.Dfl_C FlFltDsP_TransStg.stSensId_C /end DEF_CHARACTERISTIC
 /begin IN_MEASUREMENT FlFltDsP_bRec FlFltDsP_bRecActv /end IN_MEASUREMENT
 /begin OUT_MEASUREMENT FlFltDsP_p /end OUT_MEASUREMENT
/end FUNCTION
/begin FUNCTION FlFltHt_DD ""
 /begin DEF_CHARACTERISTIC FlFltHt_DigOut.tiBtwTstSCB_C FlFltHt_DigOut.tiBtwTstOT_C FlFltHt_DigOut.numTstMax_C FlFltHt_stPsDiaDisbl_C FlFltHt_stPsDisbl_C FlFltHt_swtRecDeAct_C FlFltHt_tiRecDeb_C /end DEF_CHARACTERISTIC
 /begin IN_MEASUREMENT DevLib_stPwrStgEnaCond Layer_stFlFltHtg /end IN_MEASUREMENT
 /begin OUT_MEASUREMENT FlFltHt_bEval FlFltHt_bRec FlFltHt_bRecActv FlFltHt_stPs /end OUT_MEASUREMENT
 /begin LOC_MEASUREMENT FlFltHt_stRec_mp /end LOC_MEASUREMENT
/end FUNCTION
/begin FUNCTION FlFltUsP_DD ""
 /begin DEF_CHARACTERISTIC FlFltUsP_pTransf_CUR FlFltUsP_SRC.uMin_C FlFltUsP_SRC.uMax_C FlFltUsP_swtSelfRec_C FlFltUsP_tiDebNoDet_C /end DEF_CHARACTERISTIC
 /begin IN_MEASUREMENT FlFCBS_mskFlLPCSelfRec FlFCBS_stFlLPCActv /end IN_MEASUREMENT
 /begin OUT_MEASUREMENT FlFltUsP_pSens FlFltUsP_stSelfRec FlFltUsP_swtSelfRec FlFltUsP_uRaw /end OUT_MEASUREMENT
 /begin LOC_MEASUREMENT FlFltUsP_stRec_mp /end LOC_MEASUREMENT
/end FUNCTION
/begin FUNCTION FlFltUsP_VD ""
 /begin DEF_CHARACTERISTIC FlFltUsP_RmpSlp.Pos_C FlFltUsP_RmpSlp.Neg_C FlFltUsP_tiLPFiltPT1_C FlFltUsP_TransStg.Dfl_C FlFltUsP_TransStg.stSensId_C /end DEF_CHARACTERISTIC
 /begin IN_MEASUREMENT FlFCBS_mskFlLPCSelfRec FlFCBS_stFlLPCActv /end IN_MEASUREMENT
 /begin OUT_MEASUREMENT FlFltUsP_p /end OUT_MEASUREMENT
/end FUNCTION
/begin FUNCTION FlFlt_dd "" /begin DEF_CHARACTERISTIC FlFlt_Deb.tiHiLo_C FlFlt_Deb.tiLoHi_C FlFlt_swtSensPrs_C /end DEF_CHARACTERISTIC /begin OUT_MEASUREMENT FlFlt_stRaw /end OUT_MEASUREMENT /end FUNCTION
/begin FUNCTION FlFlt_vd "" /begin IN_MEASUREMENT CoEng_st /end IN_MEASUREMENT /begin OUT_MEASUREMENT FlFlt_st /end OUT_MEASUREMENT /end FUNCTION
/begin FUNCTION FlSys_CalcCnvFac ""
 /begin DEF_CHARACTERISTIC FlSys_facStoich_C FlSys_rhoFlCnvFac_C FlSys_rhoFl_C FlSys_rhoFl_CUR FlSys_swtRhoFlCnv_C /end DEF_CHARACTERISTIC
 /begin IN_MEASUREMENT FuelT_t /end IN_MEASUREMENT
 /begin OUT_MEASUREMENT FlSys_facStoich FlSys_rhoFl FlSys_rhoFlCnvFac FlSys_swtRhoFlCnv /end OUT_MEASUREMENT
/end FUNCTION
/begin FUNCTION FlSys_Deflate ""
 /begin DEF_CHARACTERISTIC FlSys_nDeflateMax_C FlSys_nDeflateMin_C FlSys_pDeflate_C FlSys_tiDeflateDel_C FlSys_tiDeflatePCVClose_C FlSys_tiDeflatePCVOpen_C FlSys_tiDeflate_C /end DEF_CHARACTERISTIC
 /begin REF_CHARACTERISTIC Rail_stCtlLoopSel_C /end REF_CHARACTERISTIC
 /begin IN_MEASUREMENT CoEng_st Epm_nEng FlSys_stDeflateOffDeflateTst FlSys_stTnk FlSys_swtSrcPSDeflateTst FlSys_tiDeflateDeflateTst PSP_st RailP_pFlt SyC_stMn SyC_stSub /end IN_MEASUREMENT
 /begin OUT_MEASUREMENT FlSys_stDeflate FlSys_stDeflateFin FlSys_stPCVSetClose FlSys_tiDeflate /end OUT_MEASUREMENT
 /begin LOC_MEASUREMENT FlSys_stDeflateActv_mp FlSys_tiDeflateMax_mp FlSys_tiDeflateRdEEP_mp FlSys_tiDeflateStp_mp /end LOC_MEASUREMENT
/end FUNCTION
/begin FUNCTION FlSys_DeflateTst "" /begin DEF_CHARACTERISTIC FlSys_tiMaxDeflateTst_C /end DEF_CHARACTERISTIC /begin IN_MEASUREMENT Epm_nEng FlSys_stDeflateFin /end IN_MEASUREMENT
 /begin OUT_MEASUREMENT FlSys_stDeflateOffDeflateTst FlSys_stStMDeflateTst FlSys_swtSrcPSDeflateTst FlSys_tiDeflateDeflateTst /end OUT_MEASUREMENT
 /begin LOC_MEASUREMENT FlSys_stRefDeflateTst FlSys_tiEvalDeflateTst_mp /end LOC_MEASUREMENT
/end FUNCTION
/begin FUNCTION FlSys_DetFlTnk ""
 /begin DEF_CHARACTERISTIC FlSys_bFlTnkDes_C FlSys_dvolFlConsTnkLoMax_C FlSys_dvolFlConsTnkLoMin_C FlSys_swtBFlTnkDes_C FlSys_swtTnkInfo_C FlSys_swtVolFlTnkQntDes_C FlSys_volFlConsTnkHi_C FlSys_volFlTnkQntDes_C FlSys_volTnkDelta_C FlSys_volTnkLo_C /end DEF_CHARACTERISTIC
 /begin IN_MEASUREMENT CoEng_st Dspl_bFlTnk Dspl_volFlTnkQnt FlSys_dvolFlCons SyC_stMn SyC_stSub /end IN_MEASUREMENT
 /begin OUT_MEASUREMENT FlSys_stTnk /end OUT_MEASUREMENT
 /begin LOC_MEASUREMENT FlSys_volFlConsAct_mp FlSys_volFlConsRdEEP_mp FlSys_volFlConsWrEEP_mp /end LOC_MEASUREMENT
/end FUNCTION
/begin FUNCTION FlSys_FlCons ""
 /begin DEF_CHARACTERISTIC FlSys_dqSubsRgn.Pos_C FlSys_dqSubsRgn.Neg_C FlSys_facFlConsAdjDfl_C FlSys_facFlConsAdjMax_C FlSys_facFlConsAdjMin_C FlSys_rhoFuel_C FlSys_stSubsRgnMsk_C /end DEF_CHARACTERISTIC
 /begin IN_MEASUREMENT FlSys_rhoFlCnvFac FlSys_swtRhoFlCnv InjCtl_qNrm /end IN_MEASUREMENT
 /begin OUT_MEASUREMENT FlSys_dvolFlCons FlSys_volFlCons FlSys_volTotFlCons /end OUT_MEASUREMENT
 /begin LOC_MEASUREMENT FlSys_dvolPerStroke_mp FlSys_facFlConsAdj_mp FlSys_qSum_mp FlSys_rhoFlSel_mp FlSys_volFlConsAdj_mp /end LOC_MEASUREMENT
/end FUNCTION
/begin FUNCTION FlxrEray "" /end FUNCTION
/begin FUNCTION FlxrTja1080 "" /end FUNCTION
/begin FUNCTION FMA_Adapt "" /begin DEF_CHARACTERISTIC FMA_facDensCor_C /end DEF_CHARACTERISTIC
 /begin IN_MEASUREMENT AFS_mAirPerCyl Epm_ctCyl Epm_nEng FMA_stSwtOff InjCtl_qSetUnBal InjSys_qInrCmb TrbnDsRLam_rLamRec /end IN_MEASUREMENT
 /begin LOC_MEASUREMENT FMA_qAct_mp FMA_qDev_mp /end LOC_MEASUREMENT
/end FUNCTION
/begin FUNCTION FMA_CtlCalc ""
 /begin DEF_CHARACTERISTIC FMA_swtCorOff_C FMA_swtIC_C FMA_trqLimMax_C FMA_trqLimMin_C /end DEF_CHARACTERISTIC
 /begin IN_MEASUREMENT CnvSet_etaCurr Epm_ctCyl Epm_nEng FMA_facSwtOff InjCtl_qCurr InjSys_qInrCmb /end IN_MEASUREMENT
 /begin OUT_MEASUREMENT FMA_qAirCtlCor FMA_qCor FMA_qDC FMA_trqAirCtlCor /end OUT_MEASUREMENT
 /begin LOC_MEASUREMENT FMA_qCtl_mp FMA_q_mp /end LOC_MEASUREMENT
/end FUNCTION
/begin FUNCTION FMA_ErrMod ""
 /begin DEF_CHARACTERISTIC FMA_facNQSwtOff_MAP FMA_IFst.Ki_C FMA_IFst.KiPos_C FMA_IFst.KiNeg_C FMA_IFst.WinPos_C FMA_IFst.WinNeg_C FMA_ISlw.Ki_C FMA_ISlw.KiPos_C FMA_ISlw.KiNeg_C FMA_ISlw.WinPos_C FMA_ISlw.WinNeg_C FMA_numLimMax_C FMA_numLimMin_C FMA_numNGrid_C FMA_numQGrid_C FMA_qAdapIni_GMAP FMA_qAdapIni_X_AXIS FMA_qAdapIni_Y_AXIS FMA_qIntMax_C FMA_qIntMin_C FMA_qLimMax_C FMA_qLimMin_C FMA_qMapMax_C FMA_qMapMin_C FMA_qMax_C FMA_qMin_C FMA_swtChngValErrMod_C FMA_swtRst_C FMA_tiPT1Fst_C FMA_tiPT1Slw_C FMA_tiSwtPar_C /end DEF_CHARACTERISTIC
 /begin IN_MEASUREMENT Epm_nEng FMA_qCtl_mp InjCtl_qSetUnBal /end IN_MEASUREMENT
 /begin OUT_MEASUREMENT FMA_tiFuncOp /end OUT_MEASUREMENT
 /begin LOC_MEASUREMENT FMA_facNQSwtOff_mp FMA_facSwtOffTot_mp FMA_numLimMax_mp FMA_numLimMin_mp FMA_qDiff_mp FMA_qErrMod_mp FMA_qMapRow0_mp FMA_qMapRow1_mp FMA_qMapRow2_mp FMA_qMapRow3_mp FMA_qMapRow4_mp FMA_qMapRow5_mp FMA_qMapRow6_mp FMA_qMapRow7_mp FMA_qReg_mp FMA_qSetFil_mp /end LOC_MEASUREMENT
/end FUNCTION
/begin FUNCTION FMA_Monitor ""
 /begin DEF_CHARACTERISTIC FMA_dfacSwtOffMax_C FMA_dqThres_C FMA_drLamThres_C FMA_facAirSwtOff_CUR FMA_facAPSwtOff_CUR FMA_facEngSwtOff_CUR FMA_facFlSwtOff_CUR FMA_nThres_C FMA_qThres_C FMA_rLamThresMax_C FMA_rLamThresMin_C FMA_stRgnMsk_C FMA_swtOnFMA_C FMA_tiDLamThres_C FMA_tiDynThres_C FMA_tiFaultRmp_C FMA_tiLamDT1_C FMA_tiLamThres_C FMA_tiOvrRun_C FMA_tiQDT1_C FMA_tiQLam_C /end DEF_CHARACTERISTIC
 /begin IN_MEASUREMENT AirCtl_stMon Air_tCACDs CoEOM_stOpModeAct CoES_stAVSCoLSU EngDa_tEng EnvP_p Epm_ctCyl Epm_nEng FuelT_t InjSys_qInrCmb InjSys_stCtlQnt TrbnDsRLam_rLam /end IN_MEASUREMENT
 /begin OUT_MEASUREMENT FMA_facSwtOff FMA_stSwtOff /end OUT_MEASUREMENT
 /begin LOC_MEASUREMENT FMA_dqAbs_mp FMA_drLamAbs_mp FMA_facAirSwtOff_mp FMA_facAPSwtOff_mp FMA_facEngSwtOff_mp FMA_facFaultSwtOff_mp FMA_facFlSwtOff_mp FMA_facRgnSwtOff_mp FMA_facSlpSwtOff2Var_mp FMA_facSlpSwtOff_mp FMA_stDynDlyd_mp FMA_stDynLam_mp FMA_stNoAdapt_mp FMA_stOvrRunDlyd_mp FMA_stReset_mp FMA_stRngLam_mp FMA_stSwtOff3Var_mp /end LOC_MEASUREMENT
/end FUNCTION
/begin FUNCTION fmo_corvalcalc "" /begin OUT_MEASUREMENT FMO_facAirMsCor FMO_qCor FMO_qFullLdCor /end OUT_MEASUREMENT /end FUNCTION
/begin FUNCTION FrmAppl_A_User "" /begin IN_MEASUREMENT PT_stTraType /end IN_MEASUREMENT /end FUNCTION
/begin FUNCTION FrmAppl_co ""
 /begin DEF_CHARACTERISTIC Com_RawMuxValId_C Com_RawValIdA_C Com_RawValIdB_C Com_RawValIdC_C Com_RawValIdD_C Com_SelfRecID_C /end DEF_CHARACTERISTIC
 /begin IN_MEASUREMENT BusDiag_stFadeOut Com_stTRadio /end IN_MEASUREMENT
 /begin OUT_MEASUREMENT Com_stCANType Com_stCBSRequest Com_stCBSRst Com_stTxEvent Com_stTxEvent_A Com_stTxEvent_FA /end OUT_MEASUREMENT
 /begin LOC_MEASUREMENT Com_RawMuxVal_mp Com_RawValA_mp Com_RawValB_mp Com_RawValC_mp Com_RawValD_mp Com_RawValIdA_mp Com_RawValIdB_mp Com_RawValIdC_mp Com_RawValIdD_mp Com_SelfRecCtr_mp Com_SelfRecID_mp Com_SelfRecSt_mp Com_SelfRecTmr_mp Com_test1_mp Com_test2_mp Com_test3_mp Com_test4_mp /end LOC_MEASUREMENT
/end FUNCTION
/begin FUNCTION FrmAppl_FA_User "" /begin IN_MEASUREMENT PT_stTraType /end IN_MEASUREMENT /end FUNCTION
/begin FUNCTION FrmAppl_Flex "" /end FUNCTION
/begin FUNCTION FrmAppl_moffrm "" /begin DEF_CHARACTERISTIC Frm_MoFFrmFalsify_C /end DEF_CHARACTERISTIC /end FUNCTION
/begin FUNCTION FrmAppl_Std ""
 /begin IN_MEASUREMENT AC_trqMaxAC APP_drUnFlt APP_r Clth_st CoETS_rTrq Com_ctSleepNeg Com_dAngAcpdCHK_A Com_dAngAcpdCHK_FA Com_dAngAcpdCTR_A Com_dAngAcpdCTR_FA Com_dDispRpmEngCTR_FA Com_dDriveTrainData2CHK_A Com_dDriveTrainData2CHK_FA Com_dDriveTrainData2CTR_A Com_dDriveTrainData2CTR_FA Com_dDtGrdtDrvCHK_FA Com_dDtGrdtDrvCTR_FA Com_dTorque1CHK_A Com_dTorque1CTR_A Com_dTorque2CHK_A Com_dTorque2CTR_A Com_dTorque3CHK_A Com_dTorque3CTR_A Com_dTrqCrsh1CHK_FA Com_dTrqCrsh1CTR_FA Com_dTrqCrsh2CHK_FA Com_dTrqCrsh2CTR_FA Com_dTrqCrsh3CHK_FA Com_dTrqCrsh3CTR_FA Com_dWhlTrqPT4CHK_FA Com_dWhlTrqPT4CTR_FA Com_dWhlTrqPT5CHK_FA Com_dWhlTrqPT5CTR_FA Com_nGbxRed Com_nTSC Com_numSleepNegID0 Com_numSleepNegID1 Com_numSleepNegID2 Com_numSleepNegID3 Com_PSPdvolOut Com_rAPP Com_rWaterVlv Com_stAdptShftPoint Com_stAPPQl Com_stBrkPedal Com_stBrkQl Com_stDDEQual Com_stDrvDirDes Com_stECUQlICM Com_stEng Com_stGbxModDemFAS Com_stGear Com_stGrip Com_stHtgUp Com_stInjDu Com_stLckGbxDemQl Com_stLPCOff Com_stnEngQl Com_stNGbxRedQl Com_stOBDCtl Com_stOvrRun Com_stRdcDwnCtlRpm Com_stSensNOxDewDet Com_stShiftPdl Com_stSLck Com_stSleepAckTx Com_stSleepRdyTx Com_stStrt Com_stStrtLck Com_stTrqGbxQl Com_stTrqInrQl Com_stTrqWhlFASQl Com_stTrqWhlStbQl Com_stTSC Com_stVehDrvCond Com_stvVehQL Com_trqCootdTar Com_trqDVCH Com_trqGbx Com_trqInr Com_trqResPos Com_v Com_vVehCHK_A Com_vVehCTR_A EngDa_tEng Epm_nEng ESS_uBatt FlSys_volTotFlCons GlbDa_pEnv HLSDem_nSetPLo HLSDem_stIDLE Layer_iGen Layer_rCtrPwrSpCos Layer_rLoadGen Layer_stCtrCbr Layer_stCtrPCos Layer_stCtrPwrCos Layer_stEnrgPwrMnmt Layer_stFldLvlEngOil Layer_stGen Layer_stLoadGen Layer_stNdStrtUpSupp Layer_stRqPCos Layer_stSelSpCos Layer_stVolEngOil Layer_stVoltageLevel Layer_tOilEng RngMod_trqClthMax RngMod_trqClthMin TECU_t ThrVlv_rPs /end IN_MEASUREMENT
/end FUNCTION
/begin FUNCTION FrmAppl_swt "" /begin LOC_MEASUREMENT Com_stEnableRedIpdu /end LOC_MEASUREMENT /end FUNCTION
/begin FUNCTION FrmSch_Flex "" /end FUNCTION
/begin FUNCTION FrmSch_Std "" /end FUNCTION
/begin FUNCTION Frm_Flex "" /end FUNCTION
/begin FUNCTION Frm_Std "" /end FUNCTION
/begin FUNCTION fuelt_dd "" /begin DEF_CHARACTERISTIC FuelT_SRC.uMin_C FuelT_SRC.uMax_C FuelT_tTransf_CUR /end DEF_CHARACTERISTIC /begin OUT_MEASUREMENT FuelT_tSens FuelT_uRaw /end OUT_MEASUREMENT /end FUNCTION
/begin FUNCTION fuelt_vd ""
 /begin DEF_CHARACTERISTIC FuelT_RmpSlp.Pos_C FuelT_RmpSlp.Neg_C FuelT_swtSensPrs_C FuelT_swtTempSel_C FuelT_tDflFlSys_C FuelT_tiLPFiltPT1_C FuelT_TransStg.Dfl_C FuelT_TransStg.stSensId_C /end DEF_CHARACTERISTIC
 /begin IN_MEASUREMENT CEngDsT_t /end IN_MEASUREMENT
 /begin OUT_MEASUREMENT FuelT_t FuelT_tFlSys /end OUT_MEASUREMENT
/end FUNCTION
/begin FUNCTION GbxECU ""
 /begin SUB_FUNCTION GbxECU_Can GbxECU_co GbxECU_swt GbxECU_fa GbxECU_a GbxECU_flex /end SUB_FUNCTION
/end FUNCTION
/begin FUNCTION GbxECU_a ""
 /begin DEF_CHARACTERISTIC Com_swtDiaOBDGbx_A_C Com_swtGbxData_A_C Com_swtStatusEGS_A_C Com_swtTrqDemandGbx_A_C /end DEF_CHARACTERISTIC
 /begin OUT_MEASUREMENT Com_dGbxDataCHK_A Com_dGbxDataCTR_A Com_dTrqDemandGbxCHK_A Com_dTrqDemandGbxCTR_A Com_nGbxOut_A Com_nTSC_A Com_rTrq_A Com_stClthRaw_A Com_stGbxOBD_A Com_stGear_A Com_stStrtLck_A Com_stTrqGbxDes_A Com_stTrqGbxLim_A Com_stTSC_A Com_tGbxOil_A Com_trqGbxDes_A Com_trqGbxFrc_A Com_trqGbxMax_A /end OUT_MEASUREMENT
/end FUNCTION
/begin FUNCTION GbxECU_Can ""
 /begin DEF_CHARACTERISTIC Com_swtGearboxData2_C Com_swtGearboxData_C Com_swtTrqDemandGbx_C /end DEF_CHARACTERISTIC
/end FUNCTION
/begin FUNCTION GbxECU_co ""
 /begin DEF_CHARACTERISTIC Com_stGear_C Com_swtSpdGovTrqCor_C Com_tiFltnTrbn_C Com_trqGbxMaxSubs_C /end DEF_CHARACTERISTIC
 /begin IN_MEASUREMENT CoETS_trqUnFltLtdSet PT_stTraType /end IN_MEASUREMENT
 /begin OUT_MEASUREMENT Com_dGbx2CHK Com_dGbx2CTR Com_dGbx3CHK Com_dGbx3CTR Com_dGbxCHK Com_dGbxCTR Com_dTrqDemandDKGCHK Com_dTrqDemandDKGCTR Com_dTrqDemandGbxCHK Com_dTrqDemandGbxCTR Com_nDKG Com_nRqIdlg Com_nTSC Com_rTrq Com_rTrqRaw Com_stAcpd Com_stClth Com_stClthRaw Com_stDynDisp Com_stGbxOBD Com_stGear Com_stMILReq Com_stModDKG Com_stRaceStrt Com_stStrtClth Com_stTrqFil Com_stTrqGbxDes Com_stTrqGbxLim Com_stTSC Com_tGbxOil Com_trqAdjrDKG Com_trqClthDKG Com_trqDVCHRise Com_trqGbxDes Com_trqGbxFrc Com_trqGbxMax Com_trqTarDKG Gbx_nTrbn Gbx_numGear Gbx_numGearTrgt Gbx_trqPrt Gbx_trqTIIDes Gbx_trqTSCIntv /end OUT_MEASUREMENT
 /begin LOC_MEASUREMENT Com_nGbxOut Com_trqDKGDec_mp Com_trqDKGInc_mp Com_trqDKGMax_mp /end LOC_MEASUREMENT
/end FUNCTION
/begin FUNCTION GbxECU_fa ""
 /begin DEF_CHARACTERISTIC Com_swtDtGrdtDrv_FA_C Com_swtGbxData_FA_C Com_swtStatGang_FA_C Com_swtStatGearRev_FA_C Com_swtStatusEGS_FA_C Com_swtTrqDemandGbx_FA_C /end DEF_CHARACTERISTIC
 /begin OUT_MEASUREMENT Com_dDtGrdtDrvCHK_FA Com_dDtGrdtDrvCTR_FA Com_dGbxDataCHK_FA Com_dGbxDataCTR_FA Com_dTrqDemandGbxCHK_FA Com_dTrqDemandGbxCTR_FA Com_nGbxOut_FA Com_nTSC_FA Com_rTrq_FA Com_stClthRaw_FA Com_stGear_FA Com_stRevGear_FA Com_stStrtLck_FA Com_stTrqGbxDes_FA Com_stTrqGbxLim_FA Com_stTSC_FA Com_tGbxOil_FA Com_trqGbxDes_FA Com_trqGbxFrc_FA Com_trqGbxMax_FA /end OUT_MEASUREMENT
/end FUNCTION
/begin FUNCTION GbxECU_flex "" /begin OUT_MEASUREMENT Com_dGbxDriveTrainCHK Com_dGbxDriveTrainCTR Com_stRevGear /end OUT_MEASUREMENT /end FUNCTION
/begin FUNCTION GbxECU_swt ""
 /begin IN_MEASUREMENT Com_nGbxOut Com_nGbxOut_A Com_nGbxOut_FA Com_nTSC Com_nTSC_A Com_nTSC_FA Com_rTrq Com_rTrq_A Com_rTrq_FA Com_stClthRaw Com_stClthRaw_A Com_stClthRaw_FA Com_stGbxOBD Com_stGbxOBD_A Com_stGear Com_stGear_A Com_stGear_FA Com_stRevGear Com_stRevGear_FA Com_stStrtLck Com_stStrtLck_A Com_stStrtLck_FA Com_stTrqGbxDes Com_stTrqGbxDes_A Com_stTrqGbxDes_FA Com_stTrqGbxLim Com_stTrqGbxLim_A Com_stTrqGbxLim_FA Com_stTSC Com_stTSC_A Com_stTSC_FA Com_tGbxOil Com_tGbxOil_A Com_tGbxOil_FA Com_trqGbxDes Com_trqGbxDes_A Com_trqGbxDes_FA Com_trqGbxFrc Com_trqGbxFrc_A Com_trqGbxFrc_FA Com_trqGbxMax Com_trqGbxMax_A Com_trqGbxMax_FA /end IN_MEASUREMENT
/end FUNCTION
/begin FUNCTION GbxNPos_DD ""
 /begin DEF_CHARACTERISTIC GbxNPos_dcycPwmInMax_C GbxNPos_dcycPwmInMin_C GbxNPos_tiPerMax_C GbxNPos_tiPerPwmInMax_C GbxNPos_tiPerPwmInMin_C Gbx_NPosDeb.tiHiLo_C Gbx_NPosDeb.tiLoHi_C /end DEF_CHARACTERISTIC
 /begin OUT_MEASUREMENT Gbx_stNPosRaw /end OUT_MEASUREMENT
 /begin LOC_MEASUREMENT GbxNPos_tiPer_mp /end LOC_MEASUREMENT
/end FUNCTION
/begin FUNCTION GbxNPos_VD ""
 /begin DEF_CHARACTERISTIC GbxNPos_rTransfNPos_CUR GbxNPos_swtRecDeAct_C GbxNPos_tiRecDeb_C /end DEF_CHARACTERISTIC
 /begin OUT_MEASUREMENT GbxNPos_bEval GbxNPos_bRec GbxNPos_bRecActv Gbx_dNPos /end OUT_MEASUREMENT
 /begin LOC_MEASUREMENT GbxNPos_rRawNPos GbxNPos_stRec_mp /end LOC_MEASUREMENT
/end FUNCTION
/begin FUNCTION GbxNPos_VDPlaus ""
 /begin DEF_CHARACTERISTIC Gbx_ctNPosUnPlsDec_C Gbx_ctNPosUnPlsHigh_C Gbx_ctNPosUnPlsLow_C Gbx_tiNPosPls_C Gbx_tiNPosUnPls_C Gbx_trqNPosMax_C Gbx_trqNPosMin_C /end DEF_CHARACTERISTIC
 /begin IN_MEASUREMENT ActMod_trqClth Clth_st CoEng_st Com_stClthOpenPlaus GbxNPos_bRec GbxNPos_bRecActv /end IN_MEASUREMENT
 /begin OUT_MEASUREMENT Gbx_bNPosPls Gbx_bNPosPlsActv Gbx_bNPosPlsUpdate Gbx_bNPosUnPls Gbx_ctGbxNPosUnPls Gbx_ctNPosUnPls Gbx_ctNPosUnPlsHigh /end OUT_MEASUREMENT
 /begin LOC_MEASUREMENT Gbx_bNPosPlsErr_mp /end LOC_MEASUREMENT
/end FUNCTION
/begin COMPU_METHOD AirMassPerCyl "" RAT_FUNC "%5.1" "mg/Hub" COEFFS 0 10 0 0 0 1 /end COMPU_METHOD
/begin COMPU_METHOD AngleCrS "" RAT_FUNC "%6.3" "deg CrS" COEFFS 0 45.5111111111 0 0 0 1 /end COMPU_METHOD
/begin COMPU_METHOD Calory "" RAT_FUNC "%6.2" "J/g" COEFFS 0 1 0 0 0 1 /end COMPU_METHOD
/begin COMPU_METHOD CANType_VerbalConv "" TAB_VERB "%6.3" "" COMPU_TAB_REF CANType_VerbalConv /end COMPU_METHOD
/begin COMPU_VTAB CANType_VerbalConv "" TAB_VERB 3 1 "11HEX" 2 "12HEX" 3 "FLEX" /end COMPU_VTAB
/begin COMPU_METHOD Dspl_bFlTnk_VERB "" TAB_VERB "%6.3" "-" COMPU_TAB_REF Dspl_bFlTnk_VERB /end COMPU_METHOD
/begin COMPU_VTAB Dspl_bFlTnk_VERB "" TAB_VERB 2 0 "NOT_EMPTY" 1 "EMPTY" /end COMPU_VTAB
/begin COMPU_METHOD DtyCyc "" RAT_FUNC "%5.2" "%" COEFFS 0 100 0 0 0 1 /end COMPU_METHOD
/begin COMPU_METHOD EngN "" RAT_FUNC "%5.1" "rpm" COEFFS 0 2 0 0 0 1 /end COMPU_METHOD
/begin COMPU_METHOD EngN_float "" RAT_FUNC "%4.0" "rpm" COEFFS 0 1 0 0 0 1 /end COMPU_METHOD
/begin COMPU_METHOD ETCtlGovKi_fac "" RAT_FUNC "%8.7" "-" COEFFS 0 429496.7296 0 0 0 1 /end COMPU_METHOD
/begin COMPU_METHOD ETCtlGovKp_fac "" RAT_FUNC "%7.6" "-" COEFFS 0 25600 0 0 0 1 /end COMPU_METHOD
/begin COMPU_METHOD ETCtlGovRmp "" RAT_FUNC "%6.3" "s" COEFFS 0 0 1 0 0.0152587890625 0 /end COMPU_METHOD
/begin COMPU_METHOD ETCtlGov_p0q001 "" RAT_FUNC "%6.5" "-" COEFFS 0 1000 0 0 0 1 /end COMPU_METHOD
/begin COMPU_METHOD Fact "" RAT_FUNC "%6.5" "-" COEFFS 0 8192 0 0 0 1 /end COMPU_METHOD
/begin COMPU_METHOD Fact1 "" RAT_FUNC "%6.4" "-" COEFFS 0 128 0 0 0 1 /end COMPU_METHOD
/begin COMPU_METHOD Fact_CBS "" RAT_FUNC "%6.4" "-" COEFFS 0 100 0 0 0 1 /end COMPU_METHOD
/begin COMPU_METHOD FanSpd "" RAT_FUNC "%6.3" "rpm" COEFFS 0 10.9223333333333 0 0 0 1 /end COMPU_METHOD
/begin COMPU_METHOD FBC_BPfac "" RAT_FUNC "%6.4" "-" COEFFS 0 546.116666666667 0 0 0 1 /end COMPU_METHOD
/begin COMPU_METHOD FBC_Dxs_s16 "" RAT_FUNC "%7.6" "%" COEFFS 0 41943.04 0 0 0 1 /end COMPU_METHOD
/begin COMPU_METHOD FBC_GvrnIKi_float "" RAT_FUNC "%6.2" "mg/((1/min^2)*s)" COEFFS 0 1 0 0 0 1 /end COMPU_METHOD
/begin COMPU_METHOD FBC_GvrnPKp_float "" RAT_FUNC "%6.2" "mg/(1/min^2)" COEFFS 0 1 0 0 0 1 /end COMPU_METHOD
/begin COMPU_METHOD FBC_RegionESpP_st "" TAB_VERB "%6.3" "-" COMPU_TAB_REF FBC_RegionESpP_st /end COMPU_METHOD
/begin COMPU_VTAB FBC_RegionESpP_st "" TAB_VERB 13 16 "SPDIDX0" 17 "SPDIDX2" 18 "SPDIDX4" 19 "SPDIDX6" 20 "SPDIDX8" 21 "SPDIDX10" 32 "SPDIDX1" 33 "SPDIDX3" 34 "SPDIDX5" 35 "SPDIDX7" 36 "SPDIDX9" 48 "SPDIDXLO" 49 "SPDIDXHI" /end COMPU_VTAB
/begin COMPU_METHOD FBC_StateESpP_st "" TAB_VERB "%6.3" "-" COMPU_TAB_REF FBC_StateESpP_st /end COMPU_METHOD
/begin COMPU_VTAB FBC_StateESpP_st "" TAB_VERB 5 1 "INIT" 2 "DX_WAIT" 3 "LEARN" 4 "APPLY" 5 "DELAY" /end COMPU_VTAB
/begin COMPU_METHOD FBC_Surge_Frq "" RAT_FUNC "%6.4" "Hz" COEFFS 0 120 0 0 0 1 /end COMPU_METHOD
/begin COMPU_METHOD FlConsum_l_h "" RAT_FUNC "%6.4" "l/h" COEFFS 0 100 0 0 0 1 /end COMPU_METHOD
/begin COMPU_METHOD FlConsum_ul_20ms "" RAT_FUNC "%6.2" "ul/20ms" COEFFS 0 1 0 0 0 1 /end COMPU_METHOD
/begin COMPU_METHOD FlSys_swtTnkInfo_VERB "" TAB_VERB "%6.3" "-" COMPU_TAB_REF FlSys_swtTnkInfo_VERB /end COMPU_METHOD
/begin COMPU_VTAB FlSys_swtTnkInfo_VERB "" TAB_VERB 2 0 "DIGITAL" 1 "ANALOGOUS" /end COMPU_VTAB
/begin COMPU_METHOD InjMass "" RAT_FUNC "%5.2" "mg/hub" COEFFS 0 100 0 0 0 1 /end COMPU_METHOD
/begin COMPU_METHOD InjMassCyc "" RAT_FUNC "%5.2" "mg/cyc" COEFFS 0 100 0 0 0 1 /end COMPU_METHOD
/begin COMPU_METHOD InjMassInj "" RAT_FUNC "%5.2" "mg/inj" COEFFS 0 100 0 0 0 1 /end COMPU_METHOD
/begin COMPU_METHOD InjMassSec "" RAT_FUNC "%6.4" "mg/hub/s" COEFFS 0 100 0 0 0 1 /end COMPU_METHOD
/begin COMPU_METHOD InjQnt "" RAT_FUNC "%6.3" "mm^3/hub" COEFFS 0 10 0 0 0 1 /end COMPU_METHOD
/begin COMPU_METHOD InjTime_us "" RAT_FUNC "%5.1" "us" COEFFS 0 2.5 0 0 0 1 /end COMPU_METHOD
/begin COMPU_METHOD Ki "" RAT_FUNC "%6.5" "1/s" COEFFS 0 2147.483648 0 0 0 1 /end COMPU_METHOD
/begin COMPU_METHOD km_sw_q10 "" RAT_FUNC "%6.1" "km" COEFFS 0 0.1 0 0 0 1 /end COMPU_METHOD
/begin COMPU_METHOD lambda "" RAT_FUNC "%4.3" "-" COEFFS 0 1000 0 0 0 1 /end COMPU_METHOD
/begin COMPU_METHOD lambdaSec "" RAT_FUNC "%6.5" "1/s" COEFFS 0 1000 0 0 0 1 /end COMPU_METHOD
/begin COMPU_METHOD Length "" RAT_FUNC "%6.2" "m" COEFFS 0 1 0 0 0 1 /end COMPU_METHOD
/begin COMPU_METHOD lProgWay "" RAT_FUNC "%7.0" "km" COEFFS 0 0.001 0 0 0 1 /end COMPU_METHOD
/begin COMPU_METHOD OneToOne "" RAT_FUNC "%6.0" "-" COEFFS 0 1 0 0 0 1 /end COMPU_METHOD
/begin COMPU_METHOD Period "" RAT_FUNC "%6.3" "ms" COEFFS 0 10 0 0 0 1 /end COMPU_METHOD
/begin COMPU_METHOD Per_Ratio "" RAT_FUNC "%6.4" "-" COEFFS 0 256 0 0 0 1 /end COMPU_METHOD
/begin COMPU_METHOD Prc "" RAT_FUNC "%6.4" "%" COEFFS 0 81.92 0 0 0 1 /end COMPU_METHOD
/begin COMPU_METHOD Pres_hPa "" RAT_FUNC "%5.1" "hPa" COEFFS 0 1 0 0 0 1 /end COMPU_METHOD
/begin COMPU_METHOD Pres_Rail "" RAT_FUNC "%5.1" "bar" COEFFS 0 10.000000 0 0 0 1 /end COMPU_METHOD
/begin COMPU_METHOD RhoFuel "" RAT_FUNC "%6.3" "kg/m^3" COEFFS 0 10 0 0 0 1 /end COMPU_METHOD
/begin COMPU_METHOD RmpInjMass "" RAT_FUNC "%6.5" "(mg/stroke)/s" COEFFS 0 6553.6 0 0 0 1 /end COMPU_METHOD
/begin COMPU_METHOD RmpPres_hPa "" RAT_FUNC "%6.4" "hPa/s" COEFFS 0 65.536 0 0 0 1 /end COMPU_METHOD
/begin COMPU_METHOD RmpTemp "" RAT_FUNC "%6.4" "K/s" COEFFS 0 655.36 0 0 0 1 /end COMPU_METHOD
/begin COMPU_METHOD Rmp_Fact "" RAT_FUNC "%8.7" "1/s" COEFFS 0 536870.912 0 0 0 1 /end COMPU_METHOD
/begin COMPU_METHOD TempDiff_Kelv "" RAT_FUNC "%4.1" "K" COEFFS 0 10 0 0 0 1 /end COMPU_METHOD
/begin COMPU_METHOD Temp_Cels "" RAT_FUNC "%5.1" "deg C" COEFFS 0 10 2731.4 0 0 1 /end COMPU_METHOD
/begin COMPU_METHOD TimeDeb "" RAT_FUNC "%5.0" "ms" COEFFS 0 0.1 0 0 0 1 /end COMPU_METHOD
/begin COMPU_METHOD TimeDelay_ms "" RAT_FUNC "%12.1" "ms" COEFFS 0 0 1 0 2.3283064365387e-007 0 /end COMPU_METHOD
/begin COMPU_METHOD TimeDelay_s "" RAT_FUNC "%12.4" "s" COEFFS 0 0 1 0 0.00023283064365387 0 /end COMPU_METHOD
/begin COMPU_METHOD TimeEngOn "" RAT_FUNC "%6.2" "s" COEFFS 0 1 0 0 0 1 /end COMPU_METHOD
/begin COMPU_METHOD Time_Min_One2One "" RAT_FUNC "%6.2" "min" COEFFS 0 1 0 0 0 1 /end COMPU_METHOD
/begin COMPU_METHOD Time_ms "" RAT_FUNC "%5.0" "ms" COEFFS 0 0.1 0 0 0 1 /end COMPU_METHOD
/begin COMPU_METHOD Time_PwmHigh "" RAT_FUNC "%6.4" "us" COEFFS 0 20 0 0 0 1 /end COMPU_METHOD
/begin COMPU_METHOD Time_s "" RAT_FUNC "%5.2" "s" COEFFS 0 100 0 0 0 1 /end COMPU_METHOD
/begin COMPU_METHOD Time_s_float "" RAT_FUNC "%6.2" "s" COEFFS 0 1 0 0 0 1 /end COMPU_METHOD
/begin COMPU_METHOD TransR "" RAT_FUNC "%4.2" "-" COEFFS 0 100 0 0 0 1 /end COMPU_METHOD
/begin COMPU_METHOD Trq "" RAT_FUNC "%5.1" "Nm" COEFFS 0 10 0 0 0 1 /end COMPU_METHOD
/begin COMPU_METHOD Typ4WinDia "" TAB_VERB "%6.3" "" COMPU_TAB_REF Typ4WinDia /end COMPU_METHOD
/begin COMPU_VTAB Typ4WinDia "" TAB_VERB 4 0 "4 Window diagnosis over PWM control line" 1 "4 Window diagnosis through Digital input" 2 "4 Window diagnosis over external interface" 3 "No 4 Window diagnosis." /end COMPU_VTAB
/begin COMPU_METHOD Vel "" RAT_FUNC "%5.2" "km/h" COEFFS 0 100 0 0 0 1 /end COMPU_METHOD
/begin COMPU_METHOD Vol "" RAT_FUNC "%6.4" "l" COEFFS 0 100 0 0 0 1 /end COMPU_METHOD
/begin COMPU_METHOD Volt "" RAT_FUNC "%6.1" "mV" COEFFS 0 5 0 0 0 1 /end COMPU_METHOD
/begin COMPU_METHOD Volt_Batt "" RAT_FUNC "%5.0" "mV" COEFFS 0 0.05 0 0 0 1 /end COMPU_METHOD
/begin RECORD_LAYOUT Axis_Xs16 NO_AXIS_PTS_X 1 SWORD AXIS_PTS_X 2 SWORD INDEX_INCR DIRECT /end RECORD_LAYOUT
/begin RECORD_LAYOUT Cur_Xs16Ws16 NO_AXIS_PTS_X 1 SWORD AXIS_PTS_X 2 SWORD INDEX_INCR DIRECT FNC_VALUES 3 SWORD COLUMN_DIR DIRECT /end RECORD_LAYOUT
/begin RECORD_LAYOUT Kf_Xs16_Ys16_Ws16 NO_AXIS_PTS_X 1 SWORD NO_AXIS_PTS_Y 2 SWORD AXIS_PTS_X 3 SWORD INDEX_INCR DIRECT AXIS_PTS_Y 4 SWORD INDEX_INCR DIRECT FNC_VALUES 5 SWORD COLUMN_DIR DIRECT /end RECORD_LAYOUT
/begin RECORD_LAYOUT Kl_Xs16_Ws16 NO_AXIS_PTS_X 1 SWORD AXIS_PTS_X 2 SWORD INDEX_INCR DIRECT FNC_VALUES 3 SWORD COLUMN_DIR DIRECT /end RECORD_LAYOUT
/begin RECORD_LAYOUT Kw_Wr32 FNC_VALUES 1 FLOAT32_IEEE COLUMN_DIR DIRECT /end RECORD_LAYOUT
/begin RECORD_LAYOUT Kw_Ws16 FNC_VALUES 1 SWORD COLUMN_DIR DIRECT /end RECORD_LAYOUT
/begin RECORD_LAYOUT Kw_Ws32 FNC_VALUES 1 SLONG COLUMN_DIR DIRECT /end RECORD_LAYOUT
/begin RECORD_LAYOUT Kw_Wu16 FNC_VALUES 1 UWORD COLUMN_DIR DIRECT /end RECORD_LAYOUT
/begin RECORD_LAYOUT Kw_Wu32 FNC_VALUES 1 ULONG COLUMN_DIR DIRECT /end RECORD_LAYOUT
/begin RECORD_LAYOUT Kw_Wu8 FNC_VALUES 1 UBYTE COLUMN_DIR DIRECT /end RECORD_LAYOUT
/begin RECORD_LAYOUT MapG_Ws16 FNC_VALUES 1 SWORD COLUMN_DIR DIRECT /end RECORD_LAYOUT
/begin RECORD_LAYOUT Map_Xs16Ys16Ws16 NO_AXIS_PTS_X 1 SWORD NO_AXIS_PTS_Y 2 SWORD AXIS_PTS_X 3 SWORD INDEX_INCR DIRECT AXIS_PTS_Y 4 SWORD INDEX_INCR DIRECT FNC_VALUES 5 SWORD COLUMN_DIR DIRECT /end RECORD_LAYOUT
/begin RECORD_LAYOUT ValA_Wr32 FNC_VALUES 1 FLOAT32_IEEE COLUMN_DIR DIRECT /end RECORD_LAYOUT
/begin RECORD_LAYOUT ValA_Ws16 FNC_VALUES 1 SWORD COLUMN_DIR DIRECT /end RECORD_LAYOUT
/begin RECORD_LAYOUT ValA_Ws8 FNC_VALUES 1 SBYTE COLUMN_DIR DIRECT /end RECORD_LAYOUT
/begin RECORD_LAYOUT ValA_Wu16 FNC_VALUES 1 UWORD COLUMN_DIR DIRECT /end RECORD_LAYOUT
/begin RECORD_LAYOUT ValA_Wu32 FNC_VALUES 1 ULONG COLUMN_DIR DIRECT /end RECORD_LAYOUT
/begin RECORD_LAYOUT ValA_Wu8 FNC_VALUES 1 UBYTE COLUMN_DIR DIRECT /end RECORD_LAYOUT
/begin RECORD_LAYOUT Val_Wr32 FNC_VALUES 1 FLOAT32_IEEE COLUMN_DIR DIRECT /end RECORD_LAYOUT
/begin RECORD_LAYOUT Val_Ws16 FNC_VALUES 1 SWORD COLUMN_DIR DIRECT /end RECORD_LAYOUT
/begin RECORD_LAYOUT Val_Ws32 FNC_VALUES 1 SLONG COLUMN_DIR DIRECT /end RECORD_LAYOUT
/begin RECORD_LAYOUT Val_Ws8 FNC_VALUES 1 SBYTE COLUMN_DIR DIRECT /end RECORD_LAYOUT
/begin RECORD_LAYOUT Val_Wu16 FNC_VALUES 1 UWORD COLUMN_DIR DIRECT /end RECORD_LAYOUT
/begin RECORD_LAYOUT Val_Wu32 FNC_VALUES 1 ULONG COLUMN_DIR DIRECT /end RECORD_LAYOUT
/begin RECORD_LAYOUT Val_Wu8 FNC_VALUES 1 UBYTE COLUMN_DIR DIRECT /end RECORD_LAYOUT
/end MODULE
/end PROJECT

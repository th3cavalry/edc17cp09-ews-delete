ASAP2_VERSION 1 4
/begin PROJECT P_574 "EDC17_CP09"
/begin HEADER "" VERSION "V8KB" PROJECT_NO P_574 /end HEADER
/begin MODULE DIM ""
/begin MOD_COMMON "" BYTE_ORDER MSB_LAST ALIGNMENT_BYTE 1 ALIGNMENT_WORD 2 ALIGNMENT_LONG 4 ALIGNMENT_FLOAT32_IEEE 4 /end MOD_COMMON
/begin CHARACTERISTIC K2REI_dCodInd_C "Kennwert Codier Index" VALUE 0x80020078 Kw_Wu8 255.0 OneToOne 0.00 255.0 /end CHARACTERISTIC
/begin CHARACTERISTIC K2REI_dDiaInd_C "Kennwerteblock Diagnose Index" VAL_BLK 0x8007FD86 Kwb_Wu8 255.0 OneToOne 0.00 255.0 NUMBER 2 /end CHARACTERISTIC
/begin CHARACTERISTIC K2REI_dSGFam_C "Kennwerteblock Steuergeraetefamilie/Motortype" VAL_BLK 0x8007FD84 Kwb_Wu8 255.0 OneToOne 0.00 255.0 NUMBER 2 /end CHARACTERISTIC
/begin CHARACTERISTIC VMD_rEng_MAP "Inverses Fahrpedal-Kennfeld konventionieller Betrieb" MAP 0x80061A08 Map_Xs16Ys16Ws16 799.9878 Prc -400.0000 399.9878
 /begin AXIS_DESCR STD_AXIS Epm_nEng EngN 6 -16384.00 16383.50 DEPOSIT ABSOLUTE /end AXIS_DESCR
 /begin AXIS_DESCR STD_AXIS VMD_trqEng Trq 16 -3276.800 3276.700 DEPOSIT ABSOLUTE /end AXIS_DESCR
/end CHARACTERISTIC
/begin CHARACTERISTIC VMD_rPrp_MAP "Inverses Fahrpedal-Kennfeld Mastershift Betrieb" MAP 0x80061AF8 Map_Xs16Ys16Ws16 799.9878 Prc -400.0000 399.9878
 /begin AXIS_DESCR STD_AXIS GlbDa_vX Vel 2 -327.6800 327.6700 DEPOSIT ABSOLUTE /end AXIS_DESCR
 /begin AXIS_DESCR STD_AXIS VMD_trqPrpCorr TrqPrp 2 -52428.80 52427.20 DEPOSIT ABSOLUTE /end AXIS_DESCR
/end CHARACTERISTIC
/begin CHARACTERISTIC VMD_tiFltVirtAPP_C "Filterzeit rückgerechneter Fahrpedalwert" VALUE 0x80061B0C Val_Ws32 4294.9672940 TimeDelay_s 0.000002000000001 4294.9672960 FORMAT "%12.7" /end CHARACTERISTIC
/begin CHARACTERISTIC VMD_trqThresEng_CUR "Kennlinie Schwellwert Zug - Schubverhalten konventioneller Betrieb" CURVE 0x80061B10 Cur_Xs16Ws16 6553.500 Trq -3276.800 3276.700
 /begin AXIS_DESCR STD_AXIS Epm_nEng EngN 6 -16384.00 16383.50 DEPOSIT ABSOLUTE /end AXIS_DESCR
/end CHARACTERISTIC
/begin CHARACTERISTIC VMD_trqThresPrp_CUR "Kennlinie Schwellwert Zug - Schubverhalten Mastershift Betrieb" CURVE 0x80061B2A Cur_Xs16Ws16 104856.0 TrqPrp -52428.80 52427.20
 /begin AXIS_DESCR STD_AXIS GlbDa_vX Vel 6 -327.6800 327.6700 DEPOSIT ABSOLUTE /end AXIS_DESCR
/end CHARACTERISTIC
/begin CHARACTERISTIC VMSI_dtrqRmpDCSP.Pos_C "/" VALUE 0x80061B44 Kw_Ws32 3276799.99847 RmpTrqPrpHigh 0.00 3276799.99847 FORMAT "%13.5" EXTENDED_LIMITS -3276800.00000 3276799.99847 /end CHARACTERISTIC
/begin CHARACTERISTIC VMSI_dtrqRmpDCSP.Neg_C "/" VALUE 0x80061B48 Kw_Ws32 3276799.99847 RmpTrqPrpHigh 0.00 3276799.99847 FORMAT "%13.5" EXTENDED_LIMITS -3276800.00000 3276799.99847 /end CHARACTERISTIC
/begin CHARACTERISTIC VMSI_dtrqRmpTCSP.Pos_C "/" VALUE 0x80061B4C Kw_Ws32 3276799.99847 RmpTrqPrpHigh 0.00 3276799.99847 FORMAT "%13.5" EXTENDED_LIMITS -3276800.00000 3276799.99847 /end CHARACTERISTIC
/begin CHARACTERISTIC VMSI_dtrqRmpTCSP.Neg_C "/" VALUE 0x80061B50 Kw_Ws32 3276799.99847 RmpTrqPrpHigh 0.00 3276799.99847 FORMAT "%13.5" EXTENDED_LIMITS -3276800.00000 3276799.99847 /end CHARACTERISTIC
/begin CHARACTERISTIC VMSI_stCfg_C "Konfigurationsparameter für Stabilitätseingriffe" VALUE 0x80061B54 Val_Wu8 255.0 OneToOne 0.00 255.0 /end CHARACTERISTIC
/begin CHARACTERISTIC VMSI_swtSlipCtl_C "EEPROM-Schalter für verfügbare Stabilitätseingriffe" VALUE 0x80061B55 Val_Wu8 255.0 OneToOne 0.00 255.0 /end CHARACTERISTIC
/begin CHARACTERISTIC VSwCtl_facEngTempCtlCor_CUR "Kennlinie: Atmosphärendruck-Korrekturfaktor für die Drallniveau-Steuerung" CURVE 0x80061B58 Kl_Xs16_Ws16 1.000000 Fact 0.00 1.000000 EXTENDED_LIMITS -4.000000 3.999878
 /begin AXIS_DESCR STD_AXIS VSwCtl_tEngCtlVal_mp Temp_Cels 8 -50.14000 199.8600 EXTENDED_LIMITS -3549.940 3003.560 DEPOSIT ABSOLUTE /end AXIS_DESCR
/end CHARACTERISTIC
/begin CHARACTERISTIC VSwCtl_facEnvPresCtlCorEOMQnt1_CUR "Kennlinie: Atmosphärendruck-Korrekturfaktor für die Drallniveau-Steuerung für die erste auf Einspritzmenge basierte Betriebsart" CURVE 0x80061B7A Kl_Xs16_Ws16 8192.000 Fact 0.00 8192.000 EXTENDED_LIMITS -4.000000 3.999878
 /begin AXIS_DESCR STD_AXIS EnvP_p Pres_hPa 16 0.00 3500.000 EXTENDED_LIMITS -32768.00 32767.00 DEPOSIT ABSOLUTE /end AXIS_DESCR
/end CHARACTERISTIC
/begin CHARACTERISTIC VSwCtl_facEnvPresCtlCor_CUR "Kennlinie: Atmosphärendruck-Korrekturfaktor für die Drallniveau-Steuerung" CURVE 0x80061BBC Kl_Xs16_Ws16 1.000000 Fact 0.00 1.000000 EXTENDED_LIMITS -4.000000 3.999878
 /begin AXIS_DESCR STD_AXIS EnvP_p Pres_hPa 8 0.00 3500.000 EXTENDED_LIMITS -32768.00 32767.00 DEPOSIT ABSOLUTE /end AXIS_DESCR
/end CHARACTERISTIC
/begin CHARACTERISTIC VSwCtl_facRmpValCtlCor_CUR "Korrekturkennlinie für den EOM-Rampenwert" CURVE 0x80061BDE Kl_Xs16_Ws16 3.999939 CoEOMSwt_S16 -2.000000 1.999939 FORMAT "%8.6"
 /begin AXIS_DESCR STD_AXIS VSwCtl_facRmpVal_mp CoEOMSwt_S16 13 -2.000000 1.999939 FORMAT "%8.6" DEPOSIT ABSOLUTE /end AXIS_DESCR
/end CHARACTERISTIC
/begin CHARACTERISTIC VSwCtl_facVehTempCorr_CUR "" CURVE 0x80061C14 Kl_Xs16_Ws16 1.000000 Fact 0.00 1.000000 EXTENDED_LIMITS -4.000000 3.999878
 /begin AXIS_DESCR STD_AXIS CEngDsT_t Temp_Cels 2 -50.14000 149.8600 EXTENDED_LIMITS -3549.940 3003.560 DEPOSIT ABSOLUTE /end AXIS_DESCR
/end CHARACTERISTIC
/begin CHARACTERISTIC VSwCtl_facVehVCorr_CUR "" CURVE 0x80061C1E Kl_Xs16_Ws16 1.000000 Fact 0.00 1.000000 EXTENDED_LIMITS -4.000000 3.999878
 /begin AXIS_DESCR STD_AXIS VehV_v Vel 4 0.00 300.0000 EXTENDED_LIMITS -327.6800 327.6700 DEPOSIT ABSOLUTE /end AXIS_DESCR
/end CHARACTERISTIC
/begin CHARACTERISTIC VSwCtl_numEngTempCtlVal_C "Index zur Auswahl einer Temperatur aus dem Motortemperaturfeld" VALUE 0x80061C30 Kw_Wu8 3.00000000000 EngTempFldSel 0.00 3.00000000000 FORMAT "%13.11" /end CHARACTERISTIC
/begin CHARACTERISTIC VSwCtl_rCtlBasEOMQnt1_MAP "Kennfeld: Basiswert für die Drallniveau-Steuerung für die erste auf Einspritzmenge basierte Betriebsart" MAP 0x80061C32 Kf_Xs16_Ys16_Ws16 8192.004 Prc 0.00 8192.004 EXTENDED_LIMITS -400.0000 399.9878
 /begin AXIS_DESCR STD_AXIS Epm_nEng EngN 11 0.00 20000.00 EXTENDED_LIMITS -16384.00 16383.50 DEPOSIT ABSOLUTE /end AXIS_DESCR
 /begin AXIS_DESCR STD_AXIS VSwCtl_qCurr_mp InjMass 11 0.00 327.6700 EXTENDED_LIMITS -327.6800 327.6700 DEPOSIT ABSOLUTE /end AXIS_DESCR
/end CHARACTERISTIC
/begin CHARACTERISTIC VSwCtl_rCtlBasHiAltdEOMQnt1_MAP "Kennfeld: Höhenbasiswert für die Drallniveau-Steuerung für die erste auf Einspritzmenge basierte Betriebsart" MAP 0x80061D54 Kf_Xs16_Ys16_Ws16 8192.004 Prc 0.00 8192.004 EXTENDED_LIMITS -400.0000 399.9878
 /begin AXIS_DESCR STD_AXIS Epm_nEng EngN 11 0.00 20000.00 EXTENDED_LIMITS -16384.00 16383.50 DEPOSIT ABSOLUTE /end AXIS_DESCR
 /begin AXIS_DESCR STD_AXIS VSwCtl_qCurr_mp InjMass 11 0.00 327.6700 EXTENDED_LIMITS -327.6800 327.6700 DEPOSIT ABSOLUTE /end AXIS_DESCR
/end CHARACTERISTIC
/begin CHARACTERISTIC VSwCtl_rCtlBasHiAltd_MAP "Kennfeld: Höhenbasiswert für die Drallniveau-Steuerung" MAP 0x80061E76 Kf_Xs16_Ys16_Ws16 100.0000 Prc 0.00 100.0000 EXTENDED_LIMITS -400.0000 399.9878
 /begin AXIS_DESCR STD_AXIS Epm_nEng EngN 16 0.00 10000.00 EXTENDED_LIMITS -16384.00 16383.50 DEPOSIT ABSOLUTE /end AXIS_DESCR
 /begin AXIS_DESCR STD_AXIS VSwCtl_qCtlVal_mp InjMass 16 0.00 1500.000 EXTENDED_LIMITS -327.6800 327.6700 DEPOSIT ABSOLUTE /end AXIS_DESCR
/end CHARACTERISTIC
/begin CHARACTERISTIC VSwCtl_rCtlBas_MAP "Kennfeld: Basiswert für die Drallniveau-Steuerung" MAP 0x800620BA Kf_Xs16_Ys16_Ws16 100.0000 Prc 0.00 100.0000 EXTENDED_LIMITS -400.0000 399.9878
 /begin AXIS_DESCR STD_AXIS Epm_nEng EngN 16 0.00 10000.00 EXTENDED_LIMITS -16384.00 16383.50 DEPOSIT ABSOLUTE /end AXIS_DESCR
 /begin AXIS_DESCR STD_AXIS VSwCtl_qCtlVal_mp InjMass 16 0.00 1500.000 EXTENDED_LIMITS -327.6800 327.6700 DEPOSIT ABSOLUTE /end AXIS_DESCR
/end CHARACTERISTIC
/begin CHARACTERISTIC VSwCtl_rCtlValCorMax_C "Obere Grenze für Sollwert des Drallniveaustellers" VALUE 0x800622FE Kw_Ws16 100.0000 Prc 0.00 100.0000 EXTENDED_LIMITS -400.0000 399.9878 /end CHARACTERISTIC
/begin CHARACTERISTIC VSwCtl_rCtlValCorMin_C "Untere Grenze für Sollwert des Drallniveaustellers" VALUE 0x80062300 Kw_Ws16 100.0000 Prc 0.00 100.0000 EXTENDED_LIMITS -400.0000 399.9878 /end CHARACTERISTIC
/begin CHARACTERISTIC VSwCtl_rDflVal_CA "Vorgabewerteliste" VAL_BLK 0x80062302 ValA_Ws16 799.9878 Prc -400.0000 399.9878 NUMBER 7 /end CHARACTERISTIC
/begin CHARACTERISTIC VSwCtl_rEngTempCorBas_MAP "Basissteuerwert für die Motortemperatur Korrektur" MAP 0x80062310 Kf_Xs16_Ys16_Ws16 100.0000 Prc 0.00 100.0000 EXTENDED_LIMITS -400.0000 399.9878
 /begin AXIS_DESCR STD_AXIS Epm_nEng EngN 16 0.00 10000.00 EXTENDED_LIMITS -16384.00 16383.50 DEPOSIT ABSOLUTE /end AXIS_DESCR
 /begin AXIS_DESCR STD_AXIS VSwCtl_qCtlVal_mp InjMass 16 0.00 1500.000 EXTENDED_LIMITS -327.6800 327.6700 DEPOSIT ABSOLUTE /end AXIS_DESCR
/end CHARACTERISTIC
/begin CHARACTERISTIC VSwCtl_rThresMax_C "Obere Grenze des zweistufigen Schwellwertschalters" VALUE 0x80062554 Kw_Ws16 100.0000 Prc 0.00 100.0000 EXTENDED_LIMITS -400.0000 399.9878 /end CHARACTERISTIC
/begin CHARACTERISTIC VSwCtl_rThresMin_C "Untere Grenze des zweistufigen Schwellwertschalters" VALUE 0x80062556 Kw_Ws16 100.0000 Prc 0.00 100.0000 EXTENDED_LIMITS -400.0000 399.9878 /end CHARACTERISTIC
/begin CHARACTERISTIC VSwCtl_rVehVCorr_MAP "" MAP 0x80062558 Kf_Xs16_Ys16_Ws16 100.0000 Prc 0.00 100.0000 EXTENDED_LIMITS -400.0000 399.9878
 /begin AXIS_DESCR STD_AXIS Epm_nEng EngN 6 0.00 10000.00 EXTENDED_LIMITS -16384.00 16383.50 DEPOSIT ABSOLUTE /end AXIS_DESCR
 /begin AXIS_DESCR STD_AXIS VSwCtl_qCtlVal InjMass 5 0.00 100.0000 EXTENDED_LIMITS -327.6800 327.6700 DEPOSIT ABSOLUTE /end AXIS_DESCR
/end CHARACTERISTIC
/begin CHARACTERISTIC VSwCtl_rVSAAirTempCorr_CUR "Korrektur Vorsteuerung über Lufttemperatur" CURVE 0x800625AE Kl_Xs16_Ws16 100.0000 Prc 0.00 100.0000 EXTENDED_LIMITS -400.0000 399.9878
 /begin AXIS_DESCR STD_AXIS Air_tAFSCorr Temp_Cels 8 -50.14000 199.8600 EXTENDED_LIMITS -3549.940 3003.560 DEPOSIT ABSOLUTE /end AXIS_DESCR
/end CHARACTERISTIC
/begin CHARACTERISTIC VSwCtl_rVSAMax_C "Maximales Drallniveausteller Ansteuerverhältnis" VALUE 0x800625D0 Kw_Ws16 100.0000 Prc 0.00 100.0000 EXTENDED_LIMITS -400.0000 399.9878 /end CHARACTERISTIC
/begin CHARACTERISTIC VSwCtl_rVSAMin_C "Minimales Drallniveausteller Ansteuerverhältnis" VALUE 0x800625D2 Kw_Ws16 100.0000 Prc 0.00 100.0000 EXTENDED_LIMITS -400.0000 399.9878 /end CHARACTERISTIC
/begin CHARACTERISTIC VSwCtl_stBitMskEOM_CA "Bitmaske zur Auswahl der relevanten Abschaltfälle im Regenerationsbetrieb" VAL_BLK 0x800625D4 ValA_Wu32 4294967295.00 OneToOne 0.00 4294967295.00 NUMBER 2 /end CHARACTERISTIC
/begin CHARACTERISTIC VSwCtl_stCtlValEOMMsk_CA "Bitmaske für die Auswahl der Regenerationsstufe" VAL_BLK 0x800625DC ValA_Wu32 4294967295.00 OneToOne 0.00 4294967295.00 NUMBER 1 /end CHARACTERISTIC
/begin CHARACTERISTIC VSwCtl_stMonEOMMsk_CA "Bitmaske für den Abschaltfall im Regenerationsbetrieb" VAL_BLK 0x800625E0 ValA_Wu32 4294967295.00 OneToOne 0.00 4294967295.00 NUMBER 2 /end CHARACTERISTIC
/begin CHARACTERISTIC VSwCtl_stPrioMon_CA "Prioritätenliste" VAL_BLK 0x800625E8 ValA_Ws16 65535.00 OneToOne -32768.00 32767.00 NUMBER 7 /end CHARACTERISTIC
/begin CHARACTERISTIC VSwCtl_stShOffEOMMsk_C "Bitmaske für für einen relevanten Betriebsartwechsel" VALUE 0x800625F8 Kw_Wu32 4294967295.00 OneToOne 0.00 4294967295.00 /end CHARACTERISTIC
/begin CHARACTERISTIC VSwCtl_swtHysOff_C "Schalter für die Umschaltung zwischen kontinuierlicher und zwei Punkt Drallniveausteuerung" VALUE 0x800625FC Kw_Wu8 255.0 OneToOne 0.00 255.0 /end CHARACTERISTIC
/begin CHARACTERISTIC VSwCtl_swtQntCtl_C "" VALUE 0x800625FD Kw_Wu8 1.000 OneToOne 0.00 1.000 EXTENDED_LIMITS 0.00 255.0 /end CHARACTERISTIC
/begin CHARACTERISTIC VSwCtl_swtTrqCtl_C "" VALUE 0x800625FE Kw_Wu8 1.000 OneToOne 0.00 1.000 EXTENDED_LIMITS 0.00 255.0 /end CHARACTERISTIC
/begin CHARACTERISTIC VSwCtl_tiMonEOM_CA "Verzögerungszeit zum Vergleich der Bitmasken der relevanten Abschaltfälle" VAL_BLK 0x80062600 ValA_Ws16 655350.0 TimeDeb -327680.0 327670.0 NUMBER 2 /end CHARACTERISTIC
/begin CHARACTERISTIC VSwCtl_tiPT1CtlValCor_C "" VALUE 0x80062604 Val_Ws32 4294.9672940 TimeDelay_s 0.000002000000000 4294.9672960 FORMAT "%12.7" EXTENDED_LIMITS 0.000002000000001 4294.9672960 /end CHARACTERISTIC
/begin CHARACTERISTIC VSwCtl_tiStartDelay_CUR "Delay-Zeit, in der die Steuerung nach Startabwurf abgeschaltet bleibt" CURVE 0x80062608 Kl_Xs16_Ws16 20.00000 TimeDeb 0.00 20.00000 EXTENDED_LIMITS -327680.0 327670.0
 /begin AXIS_DESCR STD_AXIS VSwCtl_tEngCtlVal_mp Temp_Cels 8 0.9600000 198.9600 EXTENDED_LIMITS -3549.940 3003.560 DEPOSIT ABSOLUTE /end AXIS_DESCR
/end CHARACTERISTIC
/begin CHARACTERISTIC VSwVlv_ctStrtOfsLrn_C "Zähler für Motorstart" VALUE 0x8006985C Val_Wu16 65535.00 OneToOne 0.00 65535.00 /end CHARACTERISTIC
/begin CHARACTERISTIC VSwVlv_DKdNgv_C "Für negative Großsignale (DT1-Regler)." VALUE 0x80069704 Val_Ws32 10.0000000000 Kd 0.00 10.0000000000 FORMAT "%13.10" EXTENDED_LIMITS -32768.0000000 32767.9999847 /end CHARACTERISTIC
/begin CHARACTERISTIC VSwVlv_DKdPsv_C "Für positive Großsignale (DT1-Regler)." VALUE 0x80069708 Val_Ws32 10.0000000000 Kd 0.00 10.0000000000 FORMAT "%13.10" EXTENDED_LIMITS -32768.0000000 32767.9999847 /end CHARACTERISTIC
/begin CHARACTERISTIC VSwVlv_drActNgv_C "Schwellwert für Ventilgeschwindigkeit bei Erkennung auf langsames Schließen." VALUE 0x8006970C Val_Ws16 7999.878 VlvVel -4000.000 3999.878 FORMAT "%8.3" /end CHARACTERISTIC
/begin CHARACTERISTIC VSwVlv_drActPsv_C "Schwellwert für Ventilgeschwindigkeit bei Erkennung auf langsames Schließen." VALUE 0x8006970E Val_Ws16 7999.878 VlvVel -4000.000 3999.878 FORMAT "%8.3" /end CHARACTERISTIC
/begin CHARACTERISTIC VSwVlv_drOfsLrnVlvSlpDwn_C "Rampensteigung abwärts." VALUE 0x80069860 Val_Ws32 399999.999814 RmpPrc 0.00 399999.999814 FORMAT "%13.6" EXTENDED_LIMITS -400000.000000 399999.999814 /end CHARACTERISTIC
/begin CHARACTERISTIC VSwVlv_drOfsLrnVlvSlpUp_C "Rampensteigung aufwärts." VALUE 0x80069864 Val_Ws32 399999.999814 RmpPrc 0.00 399999.999814 FORMAT "%13.6" EXTENDED_LIMITS -400000.000000 399999.999814 /end CHARACTERISTIC
/begin CHARACTERISTIC VSwVlv_drSpgDiagVlvSlpDwn_C "" VALUE 0x80069868 Val_Ws32 399999.999814 RmpPrc 0.00 399999.999814 FORMAT "%13.6" EXTENDED_LIMITS -400000.000000 399999.999814 /end CHARACTERISTIC
/begin CHARACTERISTIC VSwVlv_drSpgDiagVlvSlpUp_C "" VALUE 0x8006986C Val_Ws32 399999.999814 RmpPrc 0.00 399999.999814 FORMAT "%13.6" EXTENDED_LIMITS -400000.000000 399999.999814 /end CHARACTERISTIC
/begin CHARACTERISTIC VSwVlv_facLpGnStrt_C "Kompensation des Korrekturfaktors im Zustand START" VALUE 0x8006262C Val_Ws16 7.999878 Fact -4.000000 3.999878 /end CHARACTERISTIC
/begin CHARACTERISTIC VSwVlv_HBrgPar.rTstDtyCyc_C "Parameterstruktur fuer H-Brueckendiagnose/" VALUE 0x8006262E Val_Ws16 100.0000 DtyCyc 0.00 100.0000 EXTENDED_LIMITS -327.6800 327.6700 /end CHARACTERISTIC
/begin CHARACTERISTIC VSwVlv_HBrgPar.tiDisblDiaTmpDef_C "Parameterstruktur fuer H-Brueckendiagnose/" VALUE 0x80062630 Val_Ws16 3000.000 Time_ms 0.00 3000.000 EXTENDED_LIMITS -327680.0 327670.0 /end CHARACTERISTIC
/begin CHARACTERISTIC VSwVlv_HBrgPar.tiDisblDiaPermDef_C "Parameterstruktur fuer H-Brueckendiagnose/" VALUE 0x80062632 Val_Ws16 327670.0 Time_ms 0.00 327670.0 EXTENDED_LIMITS -327680.0 327670.0 /end CHARACTERISTIC
/begin CHARACTERISTIC VSwVlv_HBrgPar.tiOpnLdDiaEna_C "Parameterstruktur fuer H-Brueckendiagnose/" VALUE 0x80062634 Val_Ws16 327670.0 Time_ms 0.00 327670.0 EXTENDED_LIMITS -327680.0 327670.0 /end CHARACTERISTIC
/begin CHARACTERISTIC VSwVlv_HBrgPar.tiMaxOpnLdDiaEna_C "Parameterstruktur fuer H-Brueckendiagnose/" VALUE 0x80062636 Val_Ws16 5000.000 Time_ms 0.00 5000.000 EXTENDED_LIMITS -327680.0 327670.0 /end CHARACTERISTIC
/begin CHARACTERISTIC VSwVlv_iEff_CUR "Kennlinie zur Berechnung des effektiven Stroms durch den Steller." CURVE 0x80069710 Cur_Xs16Ws16 10.00000 Curr_A 0.00 10.00000 FORMAT "%8.5" EXTENDED_LIMITS -327.6800 327.6700
 /begin AXIS_DESCR STD_AXIS VSwVlv_rAbsVSw_mp DtyCyc 8 0.00 100.0000 EXTENDED_LIMITS -327.6800 327.6700 DEPOSIT ABSOLUTE /end AXIS_DESCR
/end CHARACTERISTIC
/begin CHARACTERISTIC VSwVlv_IKiNgv_C "Für negative Großsignale (I-Regler)" VALUE 0x80069734 Val_Ws32 99.9998301268 Ki 0.00 99.9998301268 FORMAT "%13.9" EXTENDED_LIMITS -1000000.00000 999999.999534 /end CHARACTERISTIC
/begin CHARACTERISTIC VSwVlv_IKiPsv_C "Für positive Großsignale (I-Regler)" VALUE 0x80069738 Val_Ws32 99.9998301268 Ki 0.00 99.9998301268 FORMAT "%13.9" EXTENDED_LIMITS -1000000.00000 999999.999534 /end CHARACTERISTIC
/begin CHARACTERISTIC VSwVlv_numAdapClsMax_C "Maximale Anzahl von Öffnungs- / Schließungs-Zyklen." VALUE 0x80069870 Val_Wu8 255.0 OneToOne 0.00 255.0 /end CHARACTERISTIC
/begin CHARACTERISTIC VSwVlv_PKpNgv_C "Für negative Großsignale (P-Regler)" VALUE 0x8006973C Val_Ws32 20.0000000000 Kp 0.00 20.0000000000 FORMAT "%13.10" EXTENDED_LIMITS -65536.0000000 65535.9999695 /end CHARACTERISTIC
/begin CHARACTERISTIC VSwVlv_PKpPsv_C "Für positive Großsignale (P-Regler)." VALUE 0x80069740 Val_Ws32 20.0000000000 Kp 0.00 20.0000000000 FORMAT "%13.10" EXTENDED_LIMITS -65536.0000000 65535.9999695 /end CHARACTERISTIC
/begin CHARACTERISTIC VSwVlv_Pwm.tiPer_C "PWM out Parameterstruktur/" VALUE 0x80062638 Kw_Ws16 9.900000 Period 0.1000000 10.00000 FORMAT "%8.5" EXTENDED_LIMITS -3276.800 3276.700 /end CHARACTERISTIC
/begin CHARACTERISTIC VSwVlv_Pwm.stLvl_C "PWM out Parameterstruktur/" VALUE 0x8006263A Kw_Wu8 1.000 OneToOne 0.00 1.000 EXTENDED_LIMITS 0.00 255.0 /end CHARACTERISTIC
/begin CHARACTERISTIC VSwVlv_Pwm.rMaxDty_C "PWM out Parameterstruktur/" VALUE 0x8006263C Kw_Ws16 100.0000 DtyCyc 0.00 100.0000 EXTENDED_LIMITS -327.6800 327.6700 /end CHARACTERISTIC
/begin CHARACTERISTIC VSwVlv_Pwm.rPerUn_C "PWM out Parameterstruktur/" VALUE 0x8006263E Kw_Ws16 32767.00 OneToOne 0.00 32767.00 EXTENDED_LIMITS -32768.00 32767.00 /end CHARACTERISTIC
/begin CHARACTERISTIC VSwVlv_Pwm.tiPh_C "PWM out Parameterstruktur/" VALUE 0x80062640 Kw_Ws16 65535.00 OneToOne -32768.00 32767.00 /end CHARACTERISTIC
/begin CHARACTERISTIC VSwVlv_PwmOut.rMin_C "Parameter-Struktur der Devlib-Diagnose./" VALUE 0x80062642 Kw_Ws16 200.0000 DtyCyc -100.0000 100.0000 EXTENDED_LIMITS -327.6800 327.6700 /end CHARACTERISTIC
/begin CHARACTERISTIC VSwVlv_PwmOut.rMax_C "Parameter-Struktur der Devlib-Diagnose./" VALUE 0x80062644 Kw_Ws16 200.0000 DtyCyc -100.0000 100.0000 EXTENDED_LIMITS -327.6800 327.6700 /end CHARACTERISTIC
/begin CHARACTERISTIC VSwVlv_PwmOut.tiBtwTstSCB_C "Parameter-Struktur der Devlib-Diagnose./" VALUE 0x80062646 Kw_Ws16 1000.000 Time_ms 0.00 1000.000 EXTENDED_LIMITS -327680.0 327670.0 /end CHARACTERISTIC
/begin CHARACTERISTIC VSwVlv_PwmOut.tiBtwTstOT_C "Parameter-Struktur der Devlib-Diagnose./" VALUE 0x80062648 Kw_Ws16 327.6700 Time_s 0.00 327.6700 EXTENDED_LIMITS -327.6800 327.6700 /end CHARACTERISTIC
/begin CHARACTERISTIC VSwVlv_PwmOut.numTstMax_C "Parameter-Struktur der Devlib-Diagnose./" VALUE 0x8006264A Kw_Wu16 65535.00 OneToOne 0.00 65535.00 /end CHARACTERISTIC
/begin CHARACTERISTIC VSwVlv_PwmOut.swtBattCor_C "Parameter-Struktur der Devlib-Diagnose./" VALUE 0x8006264C Kw_Wu8 1.000 OneToOne 0.00 1.000 EXTENDED_LIMITS 0.00 255.0 /end CHARACTERISTIC
/begin CHARACTERISTIC VSwVlv_PwmOut.swtPsInv_C "Parameter-Struktur der Devlib-Diagnose./" VALUE 0x8006264D Kw_Wu8 255.0 OneToOne 0.00 255.0 /end CHARACTERISTIC
/begin CHARACTERISTIC VSwVlv_rActMax_C "Maximalwert vom Ausgangsansteuersignal." VALUE 0x80069872 Val_Ws16 100.0000 Prc 0.00 100.0000 EXTENDED_LIMITS -400.0000 399.9878 /end CHARACTERISTIC
/begin CHARACTERISTIC VSwVlv_rActMin_C "Minimalwert vom Ausgangsansteuersignal." VALUE 0x80069874 Val_Ws16 100.0000 Prc 0.00 100.0000 EXTENDED_LIMITS -400.0000 399.9878 /end CHARACTERISTIC
/begin CHARACTERISTIC VSwVlv_rActNgv_C "Ventilstellungsschwelle zur Aktivierung des langsamen Öffnens" VALUE 0x80069744 Val_Ws16 799.9878 Prc -400.0000 399.9878 /end CHARACTERISTIC
/begin CHARACTERISTIC VSwVlv_rActPosMin_C "Offsetkorrekturwert." VALUE 0x80069876 Val_Ws16 100.0000 Prc 0.00 100.0000 EXTENDED_LIMITS -400.0000 399.9878 /end CHARACTERISTIC
/begin CHARACTERISTIC VSwVlv_rActPosOfs_C "Offsetkorrekturwert." VALUE 0x80069878 Val_Ws16 100.0000 Prc 0.00 100.0000 EXTENDED_LIMITS -400.0000 399.9878 /end CHARACTERISTIC
/begin CHARACTERISTIC VSwVlv_rActPsv_C "Ventilstellungsschwelle zur Aktivierung des langsamen Schließens" VALUE 0x80069746 Val_Ws16 799.9878 Prc -400.0000 399.9878 /end CHARACTERISTIC
/begin CHARACTERISTIC VSwVlv_rAdapAgClsMin_C "Minimaler Öffnungswinkel." VALUE 0x8006987A Val_Ws16 100.0000 Prc 0.00 100.0000 EXTENDED_LIMITS -400.0000 399.9878 /end CHARACTERISTIC
/begin CHARACTERISTIC VSwVlv_rAdapAgOpnMax_C "Maximaler zulässiger Öffnungswinkel." VALUE 0x8006987C Val_Ws16 100.0000 Prc 0.00 100.0000 EXTENDED_LIMITS -400.0000 399.9878 /end CHARACTERISTIC
/begin CHARACTERISTIC VSwVlv_rAdapDiffPlausLgT_C "Zulässige langfristige Drift." VALUE 0x8006987E Val_Ws16 100.0000 Prc 0.00 100.0000 EXTENDED_LIMITS -400.0000 399.9878 /end CHARACTERISTIC
/begin CHARACTERISTIC VSwVlv_rAdapDiffPlausMin_C "Zulässiger Unterschied zwischen maximalen Anpassungswerten." VALUE 0x80069880 Val_Ws16 100.0000 Prc 0.00 100.0000 EXTENDED_LIMITS -400.0000 399.9878 /end CHARACTERISTIC
/begin CHARACTERISTIC VSwVlv_rAdapDiffPlausShT_C "Zulässige kurzfristige Drift." VALUE 0x80069882 Val_Ws16 100.0000 Prc 0.00 100.0000 EXTENDED_LIMITS -400.0000 399.9878 /end CHARACTERISTIC
/begin CHARACTERISTIC VSwVlv_rAdapDiffPlaus_C "Zulässiger Unterschied zwischen maximalen Anpassungswerten." VALUE 0x80069884 Val_Ws16 100.0000 Prc 0.00 100.0000 EXTENDED_LIMITS -400.0000 399.9878 /end CHARACTERISTIC
/begin CHARACTERISTIC VSwVlv_rAdap_CUR "Anpassungskennlinie ( um die Sollanforderung zu invertieren / nicht invertieren)" CURVE 0x80069748 Cur_Xs16Ws16 799.9878 Prc -400.0000 399.9878
 /begin AXIS_DESCR STD_AXIS VSwVlv_r Prc 8 -400.0000 399.9878 DEPOSIT ABSOLUTE /end AXIS_DESCR
/end CHARACTERISTIC
/begin CHARACTERISTIC VSwVlv_rCmpNewCtlUn_C "Vorgabewert an EEPROM-Adresse für neues Steuergerät." VALUE 0x80069886 Val_Ws16 100.0000 Prc 0.00 100.0000 EXTENDED_LIMITS -400.0000 399.9878 /end CHARACTERISTIC
/begin CHARACTERISTIC VSwVlv_rCmpNewECU_C "" VALUE 0x80069888 Val_Ws16 100.0000 Prc 0.00 100.0000 EXTENDED_LIMITS -400.0000 399.9878 /end CHARACTERISTIC
/begin CHARACTERISTIC VSwVlv_rCnv_CUR "Kennlinie zur Umrechung des Steuerwertes in Tastverhaeltnis" CURVE 0x8006264E Cur_Xs16Ws16 655.3500 DtyCyc -327.6800 327.6700
 /begin AXIS_DESCR STD_AXIS VSwVlv_rVSw Prc 2 -400.0000 399.9878 DEPOSIT ABSOLUTE /end AXIS_DESCR
/end CHARACTERISTIC
/begin CHARACTERISTIC VSwVlv_rDfl_C "" VALUE 0x8006976A Val_Ws16 200.0000 Prc -100.0000 100.0000 EXTENDED_LIMITS -400.0000 399.9878 /end CHARACTERISTIC
/begin CHARACTERISTIC VSwVlv_rDMax_C "" VALUE 0x8006976C Val_Ws16 100.0000 Prc 0.00 100.0000 EXTENDED_LIMITS -400.0000 399.9878 /end CHARACTERISTIC
/begin CHARACTERISTIC VSwVlv_rDvtMax_C "Grenze fuer Erkennung der positiven Regelabweichung." VALUE 0x800696F0 Val_Ws16 799.9878 Prc -400.0000 399.9878 /end CHARACTERISTIC
/begin CHARACTERISTIC VSwVlv_rDvtMin_C "Grenze fuer Erkennung der negativen Regelabweichung." VALUE 0x800696F2 Val_Ws16 799.9878 Prc -400.0000 399.9878 /end CHARACTERISTIC
/begin CHARACTERISTIC VSwVlv_rdycMaxRed_C "" VALUE 0x8006976E Val_Ws16 100.0000 Prc 0.00 100.0000 EXTENDED_LIMITS -400.0000 399.9878 /end CHARACTERISTIC
/begin CHARACTERISTIC VSwVlv_rdycMin_C "" VALUE 0x80069770 Val_Ws16 100.0000 Prc 0.00 100.0000 EXTENDED_LIMITS -400.0000 399.9878 /end CHARACTERISTIC
/begin CHARACTERISTIC VSwVlv_rGovDvtThres_C "Schwellwert fuer Ausblendung des D-Anteils des PID-Reglers." VALUE 0x80069772 Val_Ws16 100.0000 Prc 0.00 100.0000 EXTENDED_LIMITS -400.0000 399.9878 /end CHARACTERISTIC
/begin CHARACTERISTIC VSwVlv_rGovMax_CUR "Kennlinie zur Strombegrenzung" CURVE 0x80069774 Cur_Xs16Ws16 100.0000 Prc 0.00 100.0000 EXTENDED_LIMITS -400.0000 399.9878
 /begin AXIS_DESCR STD_AXIS VSwVlv_iEffFlt_mp Curr_A 3 0.00 10.00000 FORMAT "%8.5" EXTENDED_LIMITS -327.6800 327.6700 DEPOSIT ABSOLUTE /end AXIS_DESCR
/end CHARACTERISTIC
/begin CHARACTERISTIC VSwVlv_rGovMin_CUR "" CURVE 0x80069782 Cur_Xs16Ws16 100.0000 Prc -100.0000 0.00 EXTENDED_LIMITS -400.0000 399.9878
 /begin AXIS_DESCR STD_AXIS VSwVlv_iEffFlt_mp Curr_A 3 0.00 10.00000 FORMAT "%8.5" EXTENDED_LIMITS -327.6800 327.6700 DEPOSIT ABSOLUTE /end AXIS_DESCR
/end CHARACTERISTIC
/begin CHARACTERISTIC VSwVlv_rIRedStep_C "" VALUE 0x80069790 Val_Ws16 100.0000 Prc 0.00 100.0000 EXTENDED_LIMITS -400.0000 399.9878 /end CHARACTERISTIC
/begin CHARACTERISTIC VSwVlv_RlsIKi_C "Verstärkung für RepRls-Integrator" VALUE 0x800696F4 Val_Ws32 66076419.9231 Ki_ThrVlv -33038209.9692 33038209.9538 FORMAT "%13.4" /end CHARACTERISTIC
/begin CHARACTERISTIC VSwVlv_rMax_C "Maximalzulässiger Sollwert der VSwVlv-Drosselklappenposition." VALUE 0x80069792 Val_Ws16 100.0000 Prc 0.00 100.0000 EXTENDED_LIMITS -400.0000 399.9878 /end CHARACTERISTIC
/begin CHARACTERISTIC VSwVlv_rMinLrnLstCor_C "Um mechanische Anschläge zu vermeiden." VALUE 0x8006988A Val_Ws16 200.0000 Prc -100.0000 100.0000 EXTENDED_LIMITS -400.0000 399.9878 /end CHARACTERISTIC
/begin CHARACTERISTIC VSwVlv_rMin_C "Minimalzulässiger Sollwert der VSWVlv-Stellung." VALUE 0x80069794 Val_Ws16 150.0000 Prc -50.00000 100.0000 EXTENDED_LIMITS -400.0000 399.9878 /end CHARACTERISTIC
/begin CHARACTERISTIC VSwVlv_RmpSlp.Pos_C "Rampensteigungsstruktur/" VALUE 0x8006988C Kw_Ws32 5.00008463860 RmpPrc 0.00 5.00008463860 FORMAT "%13.11" EXTENDED_LIMITS -400000.000000 399999.999814 /end CHARACTERISTIC
/begin CHARACTERISTIC VSwVlv_RmpSlp.Neg_C "Rampensteigungsstruktur/" VALUE 0x80069890 Kw_Ws32 5.00008463860 RmpPrc 0.00 5.00008463860 FORMAT "%13.11" EXTENDED_LIMITS -400000.000000 399999.999814 /end CHARACTERISTIC
/begin CHARACTERISTIC VSwVlv_rOfsLrnLstCor_C "Um mechanische Anschläge zu vermeiden." VALUE 0x80069894 Val_Ws16 200.0000 Prc -100.0000 100.0000 EXTENDED_LIMITS -400.0000 399.9878 /end CHARACTERISTIC
/begin CHARACTERISTIC VSwVlv_rOfsLrnVlvMax_C "Maximalwert des Offset-Lernens." VALUE 0x80069896 Val_Ws16 100.0000 Prc 0.00 100.0000 EXTENDED_LIMITS -400.0000 399.9878 /end CHARACTERISTIC
/begin CHARACTERISTIC VSwVlv_rOfsLrnVlvMin_C "Minimalwert des Offset-Lernens." VALUE 0x80069898 Val_Ws16 200.0000 Prc -100.0000 100.0000 EXTENDED_LIMITS -400.0000 399.9878 /end CHARACTERISTIC
/begin CHARACTERISTIC VSwVlv_rOfsMax_C "Maximaler plausibler Offset für Drallklappe" VALUE 0x8006989A Val_Ws16 19.99512 Prc -9.997559 9.997559 EXTENDED_LIMITS -400.0000 399.9878 /end CHARACTERISTIC
/begin CHARACTERISTIC VSwVlv_rOfsMin_C "Minimaler plausibler Offset für Drallklappe" VALUE 0x8006989C Val_Ws16 19.99512 Prc -9.997559 9.997559 EXTENDED_LIMITS -400.0000 399.9878 /end CHARACTERISTIC
/begin CHARACTERISTIC VSwVlv_rOpnSpgDiag_C "" VALUE 0x8006989E Val_Ws16 100.0000 Prc 0.00 100.0000 EXTENDED_LIMITS -400.0000 399.9878 /end CHARACTERISTIC
/begin CHARACTERISTIC VSwVlv_rOutDMax_C "Maximale zulaessige Stellgroesse des D-Anteils des PID-Reglers" VALUE 0x80069796 Val_Ws16 100.0000 Prc 0.00 100.0000 EXTENDED_LIMITS -400.0000 399.9878 /end CHARACTERISTIC
/begin CHARACTERISTIC VSwVlv_rOutIMax_C "Maximale zulaessige Stellgroesse des I-Anteils des PID-Reglers" VALUE 0x80069798 Val_Ws16 100.0000 Prc 0.00 100.0000 EXTENDED_LIMITS -400.0000 399.9878 /end CHARACTERISTIC
/begin CHARACTERISTIC VSwVlv_rPlausLgTMin_C "Zulässige langfristige Drift." VALUE 0x800698A0 Val_Ws16 100.0000 Prc 0.00 100.0000 EXTENDED_LIMITS -400.0000 399.9878 /end CHARACTERISTIC
/begin CHARACTERISTIC VSwVlv_rPlausShTMin_C "Zulässige kurzfristige Drift." VALUE 0x800698A2 Val_Ws16 100.0000 Prc 0.00 100.0000 EXTENDED_LIMITS -400.0000 399.9878 /end CHARACTERISTIC
/begin CHARACTERISTIC VSwVlv_rPreCtl_CUR "Vorsteuerkennlinie" CURVE 0x8006979A Cur_Xs16Ws16 100.0000 Prc 0.00 100.0000 EXTENDED_LIMITS -400.0000 399.9878
 /begin AXIS_DESCR STD_AXIS VSwVlv_rGov_mp Prc 10 0.00 100.0000 EXTENDED_LIMITS -400.0000 399.9878 DEPOSIT ABSOLUTE /end AXIS_DESCR
/end CHARACTERISTIC
/begin CHARACTERISTIC VSwVlv_rRlsMax_C "Maximale Grenze fuer den Integratorausgang." VALUE 0x800696F8 Val_Ws16 799.9878 Prc -400.0000 399.9878 /end CHARACTERISTIC
/begin CHARACTERISTIC VSwVlv_rRlsMin_C "Minimale Grenze für den Integratorausgang." VALUE 0x800696FA Val_Ws16 799.9878 Prc -400.0000 399.9878 /end CHARACTERISTIC
/begin CHARACTERISTIC VSwVlv_rSpgDiagVlvMax_C "" VALUE 0x800698A4 Val_Ws16 100.0000 Prc 0.00 100.0000 EXTENDED_LIMITS -400.0000 399.9878 /end CHARACTERISTIC
/begin CHARACTERISTIC VSwVlv_rSpgDiagVlvMin_C "" VALUE 0x800698A6 Val_Ws16 200.0000 Prc -100.0000 100.0000 EXTENDED_LIMITS -400.0000 399.9878 /end CHARACTERISTIC
/begin CHARACTERISTIC VSwVlv_rTransf_CUR "Umwandlungskennlinie zur Umsetzung der Rohspannung in den prozentualen Anteil der Drallklappenventilposition." CURVE 0x80069830 Kl_Xs16_Ws16 100.0000 Prc 0.00 100.0000 EXTENDED_LIMITS -400.0000 399.9878
 /begin AXIS_DESCR STD_AXIS VSwVlv_uRaw Volt 8 0.00 5200.000 EXTENDED_LIMITS -6553.600 6553.400 DEPOSIT ABSOLUTE /end AXIS_DESCR
/end CHARACTERISTIC
/begin CHARACTERISTIC VSwVlv_rWinNeg_CUR "" CURVE 0x800697C4 Cur_Xs16Ws16 100.0000 Prc -100.0000 0.00 EXTENDED_LIMITS -400.0000 399.9878
 /begin AXIS_DESCR STD_AXIS VSwVlv_r Prc 4 -100.0000 0.00 EXTENDED_LIMITS -400.0000 399.9878 DEPOSIT ABSOLUTE /end AXIS_DESCR
/end CHARACTERISTIC
/begin CHARACTERISTIC VSwVlv_rWinPos_CUR "" CURVE 0x800697D6 Cur_Xs16Ws16 100.0000 Prc 0.00 100.0000 EXTENDED_LIMITS -400.0000 399.9878
 /begin AXIS_DESCR STD_AXIS VSwVlv_r Prc 4 0.00 100.0000 EXTENDED_LIMITS -400.0000 399.9878 DEPOSIT ABSOLUTE /end AXIS_DESCR
/end CHARACTERISTIC
/begin CHARACTERISTIC VSwVlv_SlwClsDKd_C "Für langsames Schließen (DT1-Regler)." VALUE 0x800697E8 Val_Ws32 65535.9999847 Kd -32768.0000000 32767.9999847 FORMAT "%13.7" /end CHARACTERISTIC
/begin CHARACTERISTIC VSwVlv_SlwClsIKi_C "Für langsames Schließen (I-Regler)." VALUE 0x800697EC Val_Ws32 1999999.99953 Ki -1000000.00000 999999.999534 FORMAT "%13.5" /end CHARACTERISTIC
/begin CHARACTERISTIC VSwVlv_SlwClsPKp_C "Für langsames Schließen (P-Regler)." VALUE 0x800697F0 Val_Ws32 131071.999969 Kp -65536.0000000 65535.9999695 FORMAT "%13.7" /end CHARACTERISTIC
/begin CHARACTERISTIC VSwVlv_SlwOpnDKd_C "Für langsames Öffnen (DT1-Regler)." VALUE 0x800697F4 Val_Ws32 65535.9999847 Kd -32768.0000000 32767.9999847 FORMAT "%13.7" /end CHARACTERISTIC
/begin CHARACTERISTIC VSwVlv_SlwOpnIKi_C "Für langsames Öffnen (I-Regler)." VALUE 0x800697F8 Val_Ws32 1999999.99953 Ki -1000000.00000 999999.999534 FORMAT "%13.5" /end CHARACTERISTIC
/begin CHARACTERISTIC VSwVlv_SlwOpnPKp_C "Für langsames Schließen (P-Regler)." VALUE 0x800697FC Val_Ws32 131071.999969 Kp -65536.0000000 65535.9999695 FORMAT "%13.7" /end CHARACTERISTIC
/begin CHARACTERISTIC VSwVlv_SmlSigNgvDKd_C "Für negative Kleinsignale (DT1-Regler)." VALUE 0x80069800 Val_Ws32 10.0000000000 Kd 0.00 10.0000000000 FORMAT "%13.10" EXTENDED_LIMITS -32768.0000000 32767.9999847 /end CHARACTERISTIC
/begin CHARACTERISTIC VSwVlv_SmlSigNgvIKi_C "Für negative Kleinsignale (I-Regler)" VALUE 0x80069804 Val_Ws32 99.9998301268 Ki 0.00 99.9998301268 FORMAT "%13.9" EXTENDED_LIMITS -1000000.00000 999999.999534 /end CHARACTERISTIC
/begin CHARACTERISTIC VSwVlv_SmlSigNgvPKp_C "Für negative Kleinsignale (P-Regler)." VALUE 0x80069808 Val_Ws32 20.0000000000 Kp 0.00 20.0000000000 FORMAT "%13.10" EXTENDED_LIMITS -65536.0000000 65535.9999695 /end CHARACTERISTIC
/begin CHARACTERISTIC VSwVlv_SmlSigPsvDKd_C "Für positive Kleinsignale (DT1-Regler)." VALUE 0x8006980C Val_Ws32 10.0000000000 Kd 0.00 10.0000000000 FORMAT "%13.10" EXTENDED_LIMITS -32768.0000000 32767.9999847 /end CHARACTERISTIC
/begin CHARACTERISTIC VSwVlv_SmlSigPsvIKi_C "Für positive Kleinsignale (I-Regler)" VALUE 0x80069810 Val_Ws32 99.9998301268 Ki 0.00 99.9998301268 FORMAT "%13.9" EXTENDED_LIMITS -1000000.00000 999999.999534 /end CHARACTERISTIC
/begin CHARACTERISTIC VSwVlv_SmlSigPsvPKp_C "Für positive Kleinsignale (P-Regler)." VALUE 0x80069814 Val_Ws32 20.0000000000 Kp 0.00 20.0000000000 FORMAT "%13.10" EXTENDED_LIMITS -65536.0000000 65535.9999695 /end CHARACTERISTIC
/begin CHARACTERISTIC VSwVlv_SRC.uMin_C "Struktur zum Einhalten der SRC-Schwellen/" VALUE 0x80069852 Kw_Ws16 5200.000 Volt 0.00 5200.000 EXTENDED_LIMITS -6553.600 6553.400 /end CHARACTERISTIC
/begin CHARACTERISTIC VSwVlv_SRC.uMax_C "Struktur zum Einhalten der SRC-Schwellen/" VALUE 0x80069854 Kw_Ws16 5200.000 Volt 0.00 5200.000 EXTENDED_LIMITS -6553.600 6553.400 /end CHARACTERISTIC
/begin CHARACTERISTIC VSwVlv_stNewVlvTrg_C "Trigger für neues Ventil." VALUE 0x800698A8 Val_Wu8 1.000 OneToOne 0.00 1.000 EXTENDED_LIMITS 0.00 255.0 /end CHARACTERISTIC
/begin CHARACTERISTIC VSwVlv_stOfsLrnTrg_C "Auslöser für das Offset-Lernen." VALUE 0x800698A9 Val_Wu8 1.000 OneToOne 0.00 1.000 EXTENDED_LIMITS 0.00 255.0 /end CHARACTERISTIC
/begin CHARACTERISTIC VSwVlv_stPsDiaDisbl_C "Applikationsparameter zur Sperrung der Diagnose der Endstufe für veränderlichen Drallklappenventilsteller unter bestimmten Batterie- und Motorbedingungen" VALUE 0x80062658 Val_Wu8 255.0 OneToOne 0.00 255.0 /end CHARACTERISTIC
/begin CHARACTERISTIC VSwVlv_stPsDisbl_C "Applikationsparameter zur Sperrung der Endstufe für veränderlichen Drallklappenventilsteller unter bestimmten Batterie- und Motorbedingungen" VALUE 0x80062659 Val_Wu8 255.0 OneToOne 0.00 255.0 /end CHARACTERISTIC
/begin CHARACTERISTIC VSwVlv_stSpgDiagTrg_C "" VALUE 0x800698AA Val_Wu8 255.0 OneToOne 0.00 255.0 /end CHARACTERISTIC
/begin CHARACTERISTIC VSwVlv_swtActPosOfs_C "Schalter zur Aktivierung des Offsetkorrektur-Ersatzwerts." VALUE 0x800698AB Val_Wu8 1.000 OneToOne 0.00 1.000 EXTENDED_LIMITS 0.00 255.0 /end CHARACTERISTIC
/begin CHARACTERISTIC VSwVlv_swtChpSel_C "Schalter zur Auswahl des konfigurierten Chips fuer das PWM-Ausgangssignal." VALUE 0x8006265A Val_Wu8 1.00000000000 HBrgChpSel 0.00 1.00000000000 FORMAT "%13.11" /end CHARACTERISTIC
/begin CHARACTERISTIC VSwVlv_swtGovByp_C "Schalter zur Umgehung des Lagereglers." VALUE 0x80069818 Val_Wu8 1.000 OneToOne 0.00 1.000 EXTENDED_LIMITS 0.00 255.0 /end CHARACTERISTIC
/begin CHARACTERISTIC VSwVlv_swtHwSel_C "Schalter zur Auswahl zwischen CJ945/TLE6244 und CJ230/TLE7209 Endstufen." VALUE 0x8006265B Val_Wu8 255.0 OneToOne 0.00 255.0 /end CHARACTERISTIC
/begin CHARACTERISTIC VSwVlv_swtLim_C "" VALUE 0x80069819 Val_Wu8 1.000 OneToOne 0.00 1.000 EXTENDED_LIMITS 0.00 255.0 /end CHARACTERISTIC
/begin CHARACTERISTIC VSwVlv_swtNrmSel_C "Schalter zur Auswahl des normalisierten Wertes." VALUE 0x80069856 Val_Wu8 255.0 OneToOne 0.00 255.0 /end CHARACTERISTIC
/begin CHARACTERISTIC VSwVlv_swtOfsLrnActv_C "Schalter zur Aktivierung des Offsetkorrektur-Ersatzwerts." VALUE 0x800698AC Val_Wu8 255.0 OneToOne 0.00 255.0 /end CHARACTERISTIC
/begin CHARACTERISTIC VSwVlv_swtOpnLdDiaStrt_C "Schalter zur Diagnose fuer den Lastabfall zu Beginn." VALUE 0x8006265C Val_Wu8 255.0 OneToOne 0.00 255.0 /end CHARACTERISTIC
/begin CHARACTERISTIC VSwVlv_swtSelOvrCurrErr_C "Schalter zur Auswahl der Ãœberstrom-Fehlererkennung." VALUE 0x8006265D Val_Wu8 255.0 OneToOne 0.00 255.0 /end CHARACTERISTIC
/begin CHARACTERISTIC VSwVlv_swtSensPrs_C "Schalter anzuzeigen, ob ein Sensor vorhanden ist." VALUE 0x80069857 Val_Wu8 255.0 OneToOne 0.00 255.0 /end CHARACTERISTIC
/begin CHARACTERISTIC VSwVlv_swtSpgDiagActv_C "" VALUE 0x800698AD Val_Wu8 255.0 OneToOne 0.00 255.0 /end CHARACTERISTIC
/begin CHARACTERISTIC VSwVlv_tEngMax_C "Maximalwert der Motortemperatur zur Freigabe der Nullpunktanpassung." VALUE 0x800698AE Val_Ws16 250.0000 Temp_Cels -50.14000 199.8600 EXTENDED_LIMITS -3549.940 3003.560 /end CHARACTERISTIC
/begin CHARACTERISTIC VSwVlv_tEngMin_C "Minimalwert der Motortemperatur zur Freigabe der Nullpunktanpassung." VALUE 0x800698B0 Val_Ws16 250.0000 Temp_Cels -50.14000 199.8600 EXTENDED_LIMITS -3549.940 3003.560 /end CHARACTERISTIC
/begin CHARACTERISTIC VSwVlv_tiAdapJamVlv_C "Entprellzeit für Erkennung des klemmenden Ventils in geschlossenem Zustand." VALUE 0x800698B2 Val_Ws16 20000.00 Time_ms 0.00 20000.00 EXTENDED_LIMITS -327680.0 327670.0 /end CHARACTERISTIC
/begin CHARACTERISTIC VSwVlv_tiAdapPullDwn_C "Zeit für Pull-Down nachdem unterer Anschlag erkannt wurde." VALUE 0x800698B4 Val_Ws16 20000.00 Time_ms 0.00 20000.00 EXTENDED_LIMITS -327680.0 327670.0 /end CHARACTERISTIC
/begin CHARACTERISTIC VSwVlv_tiAdapPullUp_C "Zeit für Pull-Down nachdem unterer Anschlag erkannt wurde." VALUE 0x800698B6 Val_Ws16 20000.00 Time_ms 0.00 20000.00 EXTENDED_LIMITS -327680.0 327670.0 /end CHARACTERISTIC
/begin CHARACTERISTIC VSwVlv_tiCrntEffFlt_C "" VALUE 0x8006981C Val_Ws32 4294.9672940 TimeDelay_s 0.000002000000001 4294.9672960 FORMAT "%12.7" /end CHARACTERISTIC
/begin CHARACTERISTIC VSwVlv_tiFailSafe_C "" VALUE 0x80069820 Val_Ws16 327660.0 Time_ms 10.00000 327670.0 EXTENDED_LIMITS -327680.0 327670.0 /end CHARACTERISTIC
/begin CHARACTERISTIC VSwVlv_tiGovDT1_C "Zeitkonstante des DT1-Gliedes im PID-Regler." VALUE 0x80069824 Val_Ws32 4294.9672940 TimeDelay_s 0.000002000000001 4294.9672960 FORMAT "%12.7" /end CHARACTERISTIC
/begin CHARACTERISTIC VSwVlv_tiIRedDly_C "" VALUE 0x80069828 Val_Ws16 327660.0 Time_ms 10.00000 327670.0 EXTENDED_LIMITS -327680.0 327670.0 /end CHARACTERISTIC
/begin CHARACTERISTIC VSwVlv_tiOpnJamVlv_C "Entprellzeit für Erkennung des klemmenden Ventils in offenem Zustand." VALUE 0x800698B8 Val_Ws16 655350.0 Time_ms -327680.0 327670.0 /end CHARACTERISTIC
/begin CHARACTERISTIC VSwVlv_tiOpnSpgDiag_C "" VALUE 0x800698BA Val_Ws16 5000.000 Time_ms 0.00 5000.000 EXTENDED_LIMITS -327680.0 327670.0 /end CHARACTERISTIC
/begin CHARACTERISTIC VSwVlv_tiPT1FacCor_C "Batteriespannungskorrekturfilter." VALUE 0x80062660 Val_Ws32 4294.9672940 TimeDelay_s 0.000002000000001 4294.9672960 FORMAT "%12.7" /end CHARACTERISTIC
/begin CHARACTERISTIC VSwVlv_tiRepRls_C "Wartezeit fuer den naechsten Freigabeversuch." VALUE 0x800696FC Val_Ws32 36.0000000000 Time_s 0.00 36.0000000000 EXTENDED_LIMITS -21474836.4800 21474836.4700 /end CHARACTERISTIC
/begin CHARACTERISTIC VSwVlv_tiRls_C "Zeit fuer die Freigabefunktion" VALUE 0x80069700 Val_Ws16 5.000000 Time_s 0.00 5.000000 EXTENDED_LIMITS -327.6800 327.6700 /end CHARACTERISTIC
/begin CHARACTERISTIC VSwVlv_tiRmpOpnOvr_C "" VALUE 0x800698BC Val_Ws16 5000.000 Time_ms 0.00 5000.000 EXTENDED_LIMITS -327680.0 327670.0 /end CHARACTERISTIC
/begin CHARACTERISTIC VSwVlv_tiSlwParDT1_C "Zeitkonstante des DT1-Gliedes im PID-Regler." VALUE 0x8006982C Val_Ws32 4294.9672940 TimeDelay_s 0.000002000000001 4294.9672960 FORMAT "%12.7" /end CHARACTERISTIC
/begin CHARACTERISTIC VSwVlv_tiSmallWin_C "" VALUE 0x800698BE Val_Ws16 327670.0 Time_ms 0.00 327670.0 EXTENDED_LIMITS -327680.0 327670.0 /end CHARACTERISTIC
/begin CHARACTERISTIC VSwVlv_tiUpdate_C "" VALUE 0x80062664 Val_Ws16 327670.0 Time_ms 0.00 327670.0 EXTENDED_LIMITS -327680.0 327670.0 /end CHARACTERISTIC
/begin CHARACTERISTIC VSwVlv_TransStg.Dfl_C "Transstage-Struktur/" VALUE 0x800698C0 Kw_Ws16 100.0000 Prc 0.00 100.0000 EXTENDED_LIMITS -400.0000 399.9878 /end CHARACTERISTIC
/begin CHARACTERISTIC VSwVlv_TransStg.stSensId_C "Transstage-Struktur/" VALUE 0x800698C2 Kw_Wu8 255.0 OneToOne 0.00 255.0 /end CHARACTERISTIC
/begin CHARACTERISTIC VSwVlv_uBattMax_C "Maximalwert der Batteriespannung zur Freigabe der Nullpunktanpassung." VALUE 0x800698C4 Val_Ws16 28600.00 Volt_Batt 0.00 28600.00 EXTENDED_LIMITS -655360.0 655340.0 /end CHARACTERISTIC
/begin CHARACTERISTIC VSwVlv_uBattMin_C "Minimalwert der Batteriespannung zur Freigabe der Nullpunktanpassung." VALUE 0x800698C6 Val_Ws16 28600.00 Volt_Batt 0.00 28600.00 EXTENDED_LIMITS -655360.0 655340.0 /end CHARACTERISTIC
/begin CHARACTERISTIC VSwVlv_uRefSens_C "Kalibriersparameter fuer die ADC-Referenzspannung." VALUE 0x80069858 Val_Ws16 13107.00 Volt -6553.600 6553.400 /end CHARACTERISTIC
/begin CHARACTERISTIC WaHt_nACEngXHigh_C "oberer Grenzwert für Epm_nEng" VALUE 0x800626C2 Kw_Ws16 6000.000 EngN 0.00 6000.000 EXTENDED_LIMITS -16384.00 16383.50 /end CHARACTERISTIC
/begin CHARACTERISTIC WaHt_nACEngXLow_C "unterer Grenzwert für Epm_nEng" VALUE 0x800626C4 Kw_Ws16 6000.000 EngN 0.00 6000.000 EXTENDED_LIMITS -16384.00 16383.50 /end CHARACTERISTIC
/begin CHARACTERISTIC WaHt_nDAEng_C "Motordrehzahlschwelle für Antrieb wegzustand" VALUE 0x800626C6 Kw_Ws16 6000.000 EngN 0.00 6000.000 EXTENDED_LIMITS -16384.00 16383.50 /end CHARACTERISTIC
/begin CHARACTERISTIC WaHt_nMin_C "Leerlaufanhebung bei Zuheizung" VALUE 0x800626C8 Kw_Ws16 500.0000 EngN 0.00 500.0000 EXTENDED_LIMITS -16384.00 16383.50 /end CHARACTERISTIC
/begin CHARACTERISTIC WaHt_rHtgOutMax_C "Maximal-Tastverhältnis am PI-Regler Ausgang" VALUE 0x800626CA Kw_Ws16 100.0000 DtyCyc 0.00 100.0000 EXTENDED_LIMITS -327.6800 327.6700 /end CHARACTERISTIC
/begin CHARACTERISTIC WaHt_rHtgOutMin_C "Minimal-Tastverhältnis am PI-Regler Ausgang" VALUE 0x800626CC Kw_Ws16 100.0000 DtyCyc 0.00 100.0000 EXTENDED_LIMITS -327.6800 327.6700 /end CHARACTERISTIC
/begin CHARACTERISTIC WaHt_swtHtgUp_C "Schalter um den Aufheizstatus des Motors zu ändern (0: berechnen, 1: rücksetzen, 2: setzen des Aufheizstatus)" VALUE 0x800626CE Kw_Wu8 2.000 OneToOne 0.00 2.000 EXTENDED_LIMITS 0.00 255.0 /end CHARACTERISTIC
/begin CHARACTERISTIC WaHt_tEnvHysDelta_C "Delta-Wert für Kühlmitteltemperaturhysterese" VALUE 0x800626D0 Kw_Ws16 100.0000 TempDiff_Cels 0.00 100.0000 FORMAT "%8.4" EXTENDED_LIMITS -3276.800 3276.700 /end CHARACTERISTIC
/begin CHARACTERISTIC WaHt_tEnv_CUR "Umgebungstemperatur Umrechnungskennlinie" CURVE 0x800626D2 Kl_Xs16_Ws16 200.0000 Temp_Cels -50.04000 149.9600 EXTENDED_LIMITS -3549.940 3003.560
 /begin AXIS_DESCR STD_AXIS GlbDa_tEnv Temp_Cels 2 -40.04000 134.9600 EXTENDED_LIMITS -3549.940 3003.560 DEPOSIT ABSOLUTE /end AXIS_DESCR
/end CHARACTERISTIC
/begin CHARACTERISTIC WaHt_tiACMin_C "Timer für den Beschleunigungs-Fall" VALUE 0x800626DC Kw_Wu16 60000.00 Time_ms 0.00 60000.00 EXTENDED_LIMITS 0.00 655350.0 /end CHARACTERISTIC
/begin CHARACTERISTIC WaHt_tiDAMin_C "Timer im Wegfahr-Fall" VALUE 0x800626DE Kw_Wu16 60000.00 Time_ms 0.00 60000.00 EXTENDED_LIMITS 0.00 655350.0 /end CHARACTERISTIC
/begin CHARACTERISTIC WaHt_tiStrt_C "Startverzoegerung fuer die Heizleistungssteigerung" VALUE 0x800626E0 Kw_Wu16 2000.000 Time_ms 0.00 2000.000 EXTENDED_LIMITS 0.00 655350.0 /end CHARACTERISTIC
/begin CHARACTERISTIC WaHt_trqInrLimDelta_C "Delta Torque" VALUE 0x800626E2 Kw_Ws16 1500.000 Trq -500.0000 1000.000 EXTENDED_LIMITS -3276.800 3276.700 /end CHARACTERISTIC
/begin CHARACTERISTIC WaHt_vDAVeh_C "Trägergeschwindigkeit Schwelle für Antrieb wegzustand" VALUE 0x800626E4 Kw_Ws16 300.0000 Vel 0.00 300.0000 EXTENDED_LIMITS -327.6800 327.6700 /end CHARACTERISTIC
/begin CHARACTERISTIC ZFC_dBPFacFBCG3_GMAP "FBC Bandpassparameter für ZFC im 3. Gang" MAP 0x8006271A MapG_Ws16 60.00000 ZFC_BPfac 0.00 60.00000 FORMAT "%8.5" EXTENDED_LIMITS -60.00183 60.00000
 /begin AXIS_DESCR COM_AXIS Epm_nEng EngN 7 20.00000 10000.00 EXTENDED_LIMITS -16384.00 16383.50 AXIS_PTS_REF ZFC_nFBCVal_AXIS /end AXIS_DESCR
 /begin AXIS_DESCR COM_AXIS ZFC_idxFBCElm_mp OneToOne 3 0.00 4.000 EXTENDED_LIMITS 0.00 255.0 AXIS_PTS_REF ZFC_idxFBCVal_AXIS /end AXIS_DESCR
/end CHARACTERISTIC
/begin CHARACTERISTIC ZFC_dBPFacFBCG4_GMAP "FBC Bandpassparameter für ZFC im 4. Gang" MAP 0x80062744 MapG_Ws16 60.00000 ZFC_BPfac 0.00 60.00000 FORMAT "%8.5" EXTENDED_LIMITS -60.00183 60.00000
 /begin AXIS_DESCR COM_AXIS Epm_nEng EngN 7 20.00000 10000.00 EXTENDED_LIMITS -16384.00 16383.50 AXIS_PTS_REF ZFC_nFBCVal_AXIS /end AXIS_DESCR
 /begin AXIS_DESCR COM_AXIS ZFC_idxFBCElm_mp OneToOne 3 0.00 4.000 EXTENDED_LIMITS 0.00 255.0 AXIS_PTS_REF ZFC_idxFBCVal_AXIS /end AXIS_DESCR
/end CHARACTERISTIC
/begin CHARACTERISTIC ZFC_dBPFacFBCG5_GMAP "FBC Bandpassparameter für ZFC im 5. Gang" MAP 0x8006276E MapG_Ws16 60.00000 ZFC_BPfac 0.00 60.00000 FORMAT "%8.5" EXTENDED_LIMITS -60.00183 60.00000
 /begin AXIS_DESCR COM_AXIS Epm_nEng EngN 7 20.00000 10000.00 EXTENDED_LIMITS -16384.00 16383.50 AXIS_PTS_REF ZFC_nFBCVal_AXIS /end AXIS_DESCR
 /begin AXIS_DESCR COM_AXIS ZFC_idxFBCElm_mp OneToOne 3 0.00 4.000 EXTENDED_LIMITS 0.00 255.0 AXIS_PTS_REF ZFC_idxFBCVal_AXIS /end AXIS_DESCR
/end CHARACTERISTIC
/begin CHARACTERISTIC ZFC_dBPFacFBCG6_GMAP "FBC Bandpassparameter für ZFC im 6. Gang" MAP 0x80062798 MapG_Ws16 60.00000 ZFC_BPfac 0.00 60.00000 FORMAT "%8.5" EXTENDED_LIMITS -60.00183 60.00000
 /begin AXIS_DESCR COM_AXIS Epm_nEng EngN 7 20.00000 10000.00 EXTENDED_LIMITS -16384.00 16383.50 AXIS_PTS_REF ZFC_nFBCVal_AXIS /end AXIS_DESCR
 /begin AXIS_DESCR COM_AXIS ZFC_idxFBCElm_mp OneToOne 3 0.00 4.000 EXTENDED_LIMITS 0.00 255.0 AXIS_PTS_REF ZFC_idxFBCVal_AXIS /end AXIS_DESCR
/end CHARACTERISTIC
/begin CHARACTERISTIC ZFC_dBPFacFBCG7_GMAP "FBC Bandpassparameter für ZFC im 7. Gang" MAP 0x800627C2 MapG_Ws16 60.00000 ZFC_BPfac 0.00 60.00000 FORMAT "%8.5" EXTENDED_LIMITS -60.00183 60.00000
 /begin AXIS_DESCR COM_AXIS Epm_nEng EngN 7 20.00000 10000.00 EXTENDED_LIMITS -16384.00 16383.50 AXIS_PTS_REF ZFC_nFBCVal_AXIS /end AXIS_DESCR
 /begin AXIS_DESCR COM_AXIS ZFC_idxFBCElm_mp OneToOne 3 0.00 4.000 EXTENDED_LIMITS 0.00 255.0 AXIS_PTS_REF ZFC_idxFBCVal_AXIS /end AXIS_DESCR
/end CHARACTERISTIC
/begin CHARACTERISTIC ZFC_dSegFBCCaSG3_GMAP "FBC Segmentwahlparameter für ZFC im 3. Gang" MAP 0x800627EC MapG_Ws16 255.9922 ZFC_PerHalfRatio 0.00 255.9922 FORMAT "%8.4" EXTENDED_LIMITS -256.0000 255.9922
 /begin AXIS_DESCR COM_AXIS Epm_nEng EngN 7 20.00000 10000.00 EXTENDED_LIMITS -16384.00 16383.50 AXIS_PTS_REF ZFC_nFBCVal_AXIS /end AXIS_DESCR
 /begin AXIS_DESCR COM_AXIS ZFC_idxFBCElm_mp OneToOne 3 0.00 4.000 EXTENDED_LIMITS 0.00 255.0 AXIS_PTS_REF ZFC_idxFBCVal_AXIS /end AXIS_DESCR
/end CHARACTERISTIC
/begin CHARACTERISTIC ZFC_dSegFBCCaSG4_GMAP "FBC Segmentwahlparameter für ZFC im 4. Gang" MAP 0x80062816 MapG_Ws16 255.9922 ZFC_PerHalfRatio 0.00 255.9922 FORMAT "%8.4" EXTENDED_LIMITS -256.0000 255.9922
 /begin AXIS_DESCR COM_AXIS Epm_nEng EngN 7 20.00000 10000.00 EXTENDED_LIMITS -16384.00 16383.50 AXIS_PTS_REF ZFC_nFBCVal_AXIS /end AXIS_DESCR
 /begin AXIS_DESCR COM_AXIS ZFC_idxFBCElm_mp OneToOne 3 0.00 4.000 EXTENDED_LIMITS 0.00 255.0 AXIS_PTS_REF ZFC_idxFBCVal_AXIS /end AXIS_DESCR
/end CHARACTERISTIC
/begin CHARACTERISTIC ZFC_dSegFBCCaSG5_GMAP "FBC Segmentwahlparameter für ZFC im 5. Gang" MAP 0x80062840 MapG_Ws16 255.9922 ZFC_PerHalfRatio 0.00 255.9922 FORMAT "%8.4" EXTENDED_LIMITS -256.0000 255.9922
 /begin AXIS_DESCR COM_AXIS Epm_nEng EngN 7 20.00000 10000.00 EXTENDED_LIMITS -16384.00 16383.50 AXIS_PTS_REF ZFC_nFBCVal_AXIS /end AXIS_DESCR
 /begin AXIS_DESCR COM_AXIS ZFC_idxFBCElm_mp OneToOne 3 0.00 4.000 EXTENDED_LIMITS 0.00 255.0 AXIS_PTS_REF ZFC_idxFBCVal_AXIS /end AXIS_DESCR
/end CHARACTERISTIC
/begin CHARACTERISTIC ZFC_dSegFBCCaSG6_GMAP "FBC Segmentwahlparameter für ZFC im 6. Gang" MAP 0x8006286A MapG_Ws16 255.9922 ZFC_PerHalfRatio 0.00 255.9922 FORMAT "%8.4" EXTENDED_LIMITS -256.0000 255.9922
 /begin AXIS_DESCR COM_AXIS Epm_nEng EngN 7 20.00000 10000.00 EXTENDED_LIMITS -16384.00 16383.50 AXIS_PTS_REF ZFC_nFBCVal_AXIS /end AXIS_DESCR
 /begin AXIS_DESCR COM_AXIS ZFC_idxFBCElm_mp OneToOne 3 0.00 4.000 EXTENDED_LIMITS 0.00 255.0 AXIS_PTS_REF ZFC_idxFBCVal_AXIS /end AXIS_DESCR
/end CHARACTERISTIC
/begin CHARACTERISTIC ZFC_dSegFBCCaSG7_GMAP "FBC Segmentwahlparameter für ZFC im 7. Gang" MAP 0x80062894 MapG_Ws16 255.9922 ZFC_PerHalfRatio 0.00 255.9922 FORMAT "%8.4" EXTENDED_LIMITS -256.0000 255.9922
 /begin AXIS_DESCR COM_AXIS Epm_nEng EngN 7 20.00000 10000.00 EXTENDED_LIMITS -16384.00 16383.50 AXIS_PTS_REF ZFC_nFBCVal_AXIS /end AXIS_DESCR
 /begin AXIS_DESCR COM_AXIS ZFC_idxFBCElm_mp OneToOne 3 0.00 4.000 EXTENDED_LIMITS 0.00 255.0 AXIS_PTS_REF ZFC_idxFBCVal_AXIS /end AXIS_DESCR
/end CHARACTERISTIC
/begin CHARACTERISTIC ZFC_idxFBCElm_C "Index der FBC Parameterkennfelder zur Betriebspunktanzeige" VALUE 0x800628BE Val_Wu8 4.000 OneToOne 0.00 4.000 EXTENDED_LIMITS 0.00 255.0 /end CHARACTERISTIC
/begin AXIS_PTS ZFC_idxFBCVal_AXIS "" 0x800628BF ZFC_idxFBCElm_mp Axis_Xu8 4.000 OneToOne 3 0.00 4.000 FORMAT "%5.3" EXTENDED_LIMITS 0.00 255.0 DEPOSIT ABSOLUTE /end AXIS_PTS
/begin CHARACTERISTIC ZFC_nAvrgMax_C "Maximale Drehzahl für die Nullmengenkalibrierung" VALUE 0x800628C4 Val_Ws16 9980.000 EngN 20.00000 10000.00 EXTENDED_LIMITS -16384.00 16383.50 /end CHARACTERISTIC
/begin CHARACTERISTIC ZFC_nAvrgMin_C "Minimale Drehzahl für die Nullmengenkalibrierung" VALUE 0x800628C6 Val_Ws16 9980.000 EngN 20.00000 10000.00 EXTENDED_LIMITS -16384.00 16383.50 /end CHARACTERISTIC
/begin CHARACTERISTIC ZFC_nChngPRailMax_C "Maximale Drehzahl für die eine Raildruckanforderung der Nullmengenkalibrierung erfolgt" VALUE 0x800628C8 Val_Ws16 9980.000 EngN 20.00000 10000.00 EXTENDED_LIMITS -16384.00 16383.50 /end CHARACTERISTIC
/begin CHARACTERISTIC ZFC_nFBCThresMax_C "Maximale Drehzahl der FBC bei aktiver ZFC" VALUE 0x800628CA Val_Ws16 9980.000 EngN 20.00000 10000.00 EXTENDED_LIMITS -16384.00 16383.50 /end CHARACTERISTIC
/begin AXIS_PTS ZFC_nFBCVal_AXIS "" 0x800628CC Epm_nEng Axis_Xs16 9980.000 EngN 7 20.00000 10000.00 FORMAT "%8.2" EXTENDED_LIMITS -16384.00 16383.50 DEPOSIT ABSOLUTE /end AXIS_PTS
/begin CHARACTERISTIC ZFC_nHyst_C "Hysteresewert Drehzahl für die Nullmengenkalibrierung" VALUE 0x800628DC Val_Ws16 9980.000 EngN 20.00000 10000.00 EXTENDED_LIMITS -16384.00 16383.50 /end CHARACTERISTIC
/begin CHARACTERISTIC ZFC_pACMax_C "Maximaler Klimaanlagendruck für die ZFC" VALUE 0x800628DE Val_Ws16 1000.000 PresAC_hPa 0.00 1000.000 FORMAT "%8.3" EXTENDED_LIMITS -65536.00 65534.00 /end CHARACTERISTIC
/begin CHARACTERISTIC ZFC_pBstMin_C "Minimaler Ladedruck für die ZFC Kalibrierung" VALUE 0x800628E0 Val_Ws16 3500.000 Pres_hPa 0.00 3500.000 EXTENDED_LIMITS -32768.00 32767.00 /end CHARACTERISTIC
/begin CHARACTERISTIC ZFC_phiSet_CUR "Ansteuerbeginn für Einspritzung der Nullmengenkalibrierung" CURVE 0x800628FC Cur_Xs16Ws16 1440.000 AngleCrS -720.0000 720.0000 EXTENDED_LIMITS -720.0000 719.9780
 /begin AXIS_DESCR STD_AXIS Epm_nEng EngN 16 20.00000 10000.00 EXTENDED_LIMITS -16384.00 16383.50 DEPOSIT ABSOLUTE /end AXIS_DESCR
/end CHARACTERISTIC
/begin CHARACTERISTIC ZFC_rAccPedMax_C "Maximale Gaspedalstellung für die ZFC Kalibrierung" VALUE 0x800628E2 Val_Ws16 799.9878 Prc -400.0000 399.9878 /end CHARACTERISTIC
/begin CHARACTERISTIC ZFC_stACSel_C "Auswahl der Klimaanlagenbedingungen für die ZFC" VALUE 0x800628E4 Val_Wu8 255.0 OneToOne 0.00 255.0 /end CHARACTERISTIC
/begin CHARACTERISTIC ZFC_stClthSel_C "Bitmaske zur Freigabe des Kupplungssignals für die Kalibrierung" VALUE 0x800628E5 Val_Wu8 255.0 OneToOne 0.00 255.0 /end CHARACTERISTIC
/begin CHARACTERISTIC ZFC_stGearRls_CA "Gangabhängige Freigabe der ZFC Kalibrierung" VAL_BLK 0x800628E6 ValA_Wu8 1.000 OneToOne 0.00 1.000 EXTENDED_LIMITS 0.00 255.0 NUMBER 7 /end CHARACTERISTIC
/begin CHARACTERISTIC ZFC_tAirThres_C "Minimale Ansauglufttemperatur für die Nullmengenkalibrierung" VALUE 0x800628EE Val_Ws16 250.0000 Temp_Cels -50.14000 199.8600 EXTENDED_LIMITS -3549.940 3003.560 /end CHARACTERISTIC
/begin CHARACTERISTIC ZFC_tEngThres_C "Minimale Motortemperatur für die Nullmengenkalibrierung" VALUE 0x800628F0 Val_Ws16 250.0000 Temp_Cels -50.14000 199.8600 EXTENDED_LIMITS -3549.940 3003.560 /end CHARACTERISTIC
/begin CHARACTERISTIC ZFC_tFuelThresMax_C "Maximale Kraftstofftemperatur für die Nullmengenkalibrierung" VALUE 0x800628F2 Val_Ws16 200.0000 Temp_Cels -50.14000 149.8600 EXTENDED_LIMITS -3549.940 3003.560 /end CHARACTERISTIC
/begin CHARACTERISTIC ZFC_tFuelThresMin_C "Minimale Kraftstofftemperatur für die Nullmengenkalibrierung" VALUE 0x800628F4 Val_Ws16 200.0000 Temp_Cels -50.14000 149.8600 EXTENDED_LIMITS -3549.940 3003.560 /end CHARACTERISTIC
/begin CHARACTERISTIC ZFC_tiCldCham_CUR "Zeit bis der Brennraum für die Nullmengenkalibrierung zu stark abgekühlt ist" CURVE 0x800626E6 Cur_Xs16Ws16 327670.0 Time_ms 0.00 327670.0 EXTENDED_LIMITS -327680.0 327670.0
 /begin AXIS_DESCR STD_AXIS CACDsT_t Temp_Cels 12 -50.14000 199.8600 EXTENDED_LIMITS -3549.940 3003.560 DEPOSIT ABSOLUTE /end AXIS_DESCR
/end CHARACTERISTIC
/begin CHARACTERISTIC ZFC_tiDelOvrRun_C "Verzögerung nach dem Einsetzen der Schubphase für die Nullmengenkalibrierung" VALUE 0x800628F6 Val_Ws16 327670.0 Time_ms 0.00 327670.0 EXTENDED_LIMITS -327680.0 327670.0 /end CHARACTERISTIC
/begin CHARACTERISTIC ZFC_tiDelpRailLim_C "Verzögerung zum Einschwingen des Raildrucks für die Nullmengenkalibrierung" VALUE 0x800628F8 Val_Ws16 327670.0 Time_ms 0.00 327670.0 EXTENDED_LIMITS -327680.0 327670.0 /end CHARACTERISTIC
/begin CHARACTERISTIC ZFC_tiHotCham_C "Zeit bis der Brennraum warm genug für die Nullmengenkalibrierung ist" VALUE 0x80062718 Val_Ws16 327670.0 Time_ms 0.00 327670.0 EXTENDED_LIMITS -327680.0 327670.0 /end CHARACTERISTIC
/begin CHARACTERISTIC ZFC_uBattMin_C "Minimale Batteriespannung für die Nullmengenkalibrierung" VALUE 0x800628FA Val_Ws16 655340.0 Volt_Batt 0.00 655340.0 EXTENDED_LIMITS -655360.0 655340.0 /end CHARACTERISTIC
/begin MEASUREMENT AirCtl_mDesVal5EOMCor_mp00 "" SWORD AirMassPerCyl 1 100 -3276.800 3276.700 ECU_ADDRESS 0xC000B6B4 /end MEASUREMENT
/begin MEASUREMENT AirCtl_mDesVal5EOMCor_mp01 "" SWORD AirMassPerCyl 1 100 -3276.800 3276.700 ECU_ADDRESS 0xC000B6B6 /end MEASUREMENT
/begin MEASUREMENT AirCtl_mDesVal5EOMCor_mp02 "" SWORD AirMassPerCyl 1 100 -3276.800 3276.700 ECU_ADDRESS 0xC000B6B8 /end MEASUREMENT
/begin MEASUREMENT AirSys_tFld00 "Temperaturfeld Ansaugtrakt" SWORD Temp_Cels 1 100 -3549.940 3003.560 ECU_ADDRESS 0xD0000624 /end MEASUREMENT
/begin MEASUREMENT AirSys_tFld01 "Temperaturfeld Ansaugtrakt" SWORD Temp_Cels 1 100 -3549.940 3003.560 ECU_ADDRESS 0xD0000626 /end MEASUREMENT
/begin MEASUREMENT AirSys_tFld02 "Temperaturfeld Ansaugtrakt" SWORD Temp_Cels 1 100 -3549.940 3003.560 ECU_ADDRESS 0xD0000628 /end MEASUREMENT
/begin MEASUREMENT AirSys_tFld03 "Temperaturfeld Ansaugtrakt" SWORD Temp_Cels 1 100 -3549.940 3003.560 ECU_ADDRESS 0xD000062A /end MEASUREMENT
/begin MEASUREMENT ASMod_arPipeSlw_mp00 "Oberfläche Rohrstück" SWORD Area 1 100 -4.000000 3.999878 FORMAT "%8.6" ECU_ADDRESS 0xC000B7F4 /end MEASUREMENT
/begin MEASUREMENT ASMod_arPipeSlw_mp01 "Oberfläche Rohrstück" SWORD Area 1 100 -4.000000 3.999878 FORMAT "%8.6" ECU_ADDRESS 0xC000B7F6 /end MEASUREMENT
/begin MEASUREMENT ASMod_arPipeSlw_mp02 "Oberfläche Rohrstück" SWORD Area 1 100 -4.000000 3.999878 FORMAT "%8.6" ECU_ADDRESS 0xC000B7F8 /end MEASUREMENT
/begin MEASUREMENT ASMod_arPipeSlw_mp03 "Oberfläche Rohrstück" SWORD Area 1 100 -4.000000 3.999878 FORMAT "%8.6" ECU_ADDRESS 0xC000B7FA /end MEASUREMENT
/begin MEASUREMENT ASMod_arPipe_mp00 "Oberfläche Rohrstück" SWORD Area 1 100 -4.000000 3.999878 FORMAT "%8.6" ECU_ADDRESS 0xC000B732 /end MEASUREMENT
/begin MEASUREMENT ASMod_arPipe_mp01 "Oberfläche Rohrstück" SWORD Area 1 100 -4.000000 3.999878 FORMAT "%8.6" ECU_ADDRESS 0xC000B734 /end MEASUREMENT
/begin MEASUREMENT ASMod_arPipe_mp02 "Oberfläche Rohrstück" SWORD Area 1 100 -4.000000 3.999878 FORMAT "%8.6" ECU_ADDRESS 0xC000B736 /end MEASUREMENT
/begin MEASUREMENT ASMod_cndHtAirSlw_mp00 "Wärmeleitfähigkeit der Luft" SWORD Fact 1 100 -4.000000 3.999878 ECU_ADDRESS 0xC000B7FC /end MEASUREMENT
/begin MEASUREMENT ASMod_cndHtAirSlw_mp01 "Wärmeleitfähigkeit der Luft" SWORD Fact 1 100 -4.000000 3.999878 ECU_ADDRESS 0xC000B7FE /end MEASUREMENT
/begin MEASUREMENT ASMod_cndHtAirSlw_mp02 "Wärmeleitfähigkeit der Luft" SWORD Fact 1 100 -4.000000 3.999878 ECU_ADDRESS 0xC000B800 /end MEASUREMENT
/begin MEASUREMENT ASMod_cndHtAirSlw_mp03 "Wärmeleitfähigkeit der Luft" SWORD Fact 1 100 -4.000000 3.999878 ECU_ADDRESS 0xC000B802 /end MEASUREMENT
/begin MEASUREMENT ASMod_cndHtAir_mp00 "Wärmeleitfähigkeit der Luft" SWORD Fact 1 100 -4.000000 3.999878 ECU_ADDRESS 0xC000B738 /end MEASUREMENT
/begin MEASUREMENT ASMod_cndHtAir_mp01 "Wärmeleitfähigkeit der Luft" SWORD Fact 1 100 -4.000000 3.999878 ECU_ADDRESS 0xC000B73A /end MEASUREMENT
/begin MEASUREMENT ASMod_cndHtAir_mp02 "Wärmeleitfähigkeit der Luft" SWORD Fact 1 100 -4.000000 3.999878 ECU_ADDRESS 0xC000B73C /end MEASUREMENT
/begin MEASUREMENT ASMod_cndHtEGSlw_mp00 "Wärmeleitfähigkeit des Abgases" SWORD Fact 1 100 -4.000000 3.999878 ECU_ADDRESS 0xC000B804 /end MEASUREMENT
/begin MEASUREMENT ASMod_cndHtEGSlw_mp01 "Wärmeleitfähigkeit des Abgases" SWORD Fact 1 100 -4.000000 3.999878 ECU_ADDRESS 0xC000B806 /end MEASUREMENT
/begin MEASUREMENT ASMod_cndHtEGSlw_mp02 "Wärmeleitfähigkeit des Abgases" SWORD Fact 1 100 -4.000000 3.999878 ECU_ADDRESS 0xC000B808 /end MEASUREMENT
/begin MEASUREMENT ASMod_cndHtEGSlw_mp03 "Wärmeleitfähigkeit des Abgases" SWORD Fact 1 100 -4.000000 3.999878 ECU_ADDRESS 0xC000B80A /end MEASUREMENT
/begin MEASUREMENT ASMod_cndHtEG_mp00 "Wärmeleitfähigkeit des Abgases" SWORD Fact 1 100 -4.000000 3.999878 ECU_ADDRESS 0xC000B73E /end MEASUREMENT
/begin MEASUREMENT ASMod_cndHtEG_mp01 "Wärmeleitfähigkeit des Abgases" SWORD Fact 1 100 -4.000000 3.999878 ECU_ADDRESS 0xC000B740 /end MEASUREMENT
/begin MEASUREMENT ASMod_cndHtEG_mp02 "Wärmeleitfähigkeit des Abgases" SWORD Fact 1 100 -4.000000 3.999878 ECU_ADDRESS 0xC000B742 /end MEASUREMENT
/begin MEASUREMENT ASMod_dmEGFld00 "Feld der Abgasmassenströme" SWORD AirMassPerTime 1 100 -3276.800 3276.700 ECU_ADDRESS 0xD0000448 /end MEASUREMENT
/begin MEASUREMENT ASMod_dmEGFld01 "Feld der Abgasmassenströme" SWORD AirMassPerTime 1 100 -3276.800 3276.700 ECU_ADDRESS 0xD000044A /end MEASUREMENT
/begin MEASUREMENT ASMod_dmEGFld02 "Feld der Abgasmassenströme" SWORD AirMassPerTime 1 100 -3276.800 3276.700 ECU_ADDRESS 0xD000044C /end MEASUREMENT
/begin MEASUREMENT ASMod_dmEGFld03 "Feld der Abgasmassenströme" SWORD AirMassPerTime 1 100 -3276.800 3276.700 ECU_ADDRESS 0xD000044E /end MEASUREMENT
/begin MEASUREMENT ASMod_dmEGFld04 "Feld der Abgasmassenströme" SWORD AirMassPerTime 1 100 -3276.800 3276.700 ECU_ADDRESS 0xD0000450 /end MEASUREMENT
/begin MEASUREMENT ASMod_dmEGFld05 "Feld der Abgasmassenströme" SWORD AirMassPerTime 1 100 -3276.800 3276.700 ECU_ADDRESS 0xD0000452 /end MEASUREMENT
/begin MEASUREMENT ASMod_dmEGFld06 "Feld der Abgasmassenströme" SWORD AirMassPerTime 1 100 -3276.800 3276.700 ECU_ADDRESS 0xD0000454 /end MEASUREMENT
/begin MEASUREMENT ASMod_dmFlCmbOxiCatFld00 "Feld der im Oxidationskatalysator brennenden Kraftstoffmassenströme" SWORD InjMsPrTime_q0p001_COMPU 1 100 -32.76800 32.76700 FORMAT "%8.5" ECU_ADDRESS 0xD0000460 /end MEASUREMENT
/begin MEASUREMENT ASMod_dmFlCmbOxiC_mp00 "Massenstrom des verbrannten Kraftstoffs im Oxidationskatalysator" SWORD InjMassPerTime_2 1 100 -16.38400 16.38350 FORMAT "%8.5" ECU_ADDRESS 0xC000B6F4 /end MEASUREMENT
/begin MEASUREMENT ASMod_dmHCLdOxiC00 "Im OxiCat eingelagerte HC-Massenstrom" SWORD InjMassPerTime_g_s 1 100 -16.38400 16.38350 FORMAT "%8.5" ECU_ADDRESS 0xD0000464 /end MEASUREMENT
/begin MEASUREMENT ASMod_dmHCLdOxiCAct00 "Aktuell im OxiCat eingelagerte HC-Massenstrom" SWORD InjMassPerTime_g_s 1 100 -16.38400 16.38350 FORMAT "%8.5" ECU_ADDRESS 0xD0000462 /end MEASUREMENT
/begin MEASUREMENT ASMod_dmHCRgnOxiC00 "Abbauender HC-Massenstrom bei HC-Regeneration im OxiCat" SWORD InjMassPerTime_g_s 1 100 -16.38400 16.38350 FORMAT "%8.5" ECU_ADDRESS 0xD0000466 /end MEASUREMENT
/begin MEASUREMENT ASMod_dmO2OxiCDiff00 "Sauerstoffmassenstrom-Differenz am Oxidationskatalysator" SWORD O2MassPerTimeLo 1 100 -655.3600 655.3400 FORMAT "%8.4" ECU_ADDRESS 0xD0000472 /end MEASUREMENT
/begin MEASUREMENT ASMod_dmO2OxiCDs_mp00 "Sauerstoffmassenstrom nach Oxidationskatalysator" SWORD O2MassPerTimeLo 1 100 -655.3600 655.3400 FORMAT "%8.4" ECU_ADDRESS 0xC000B6F6 /end MEASUREMENT
/begin MEASUREMENT ASMod_dmO2OxiC_mp00 "Sauerstoffmassenstrom im Oxidationskatalysator" SWORD O2MassPerTimeLo 1 100 -655.3600 655.3400 FORMAT "%8.4" ECU_ADDRESS 0xC000B6F8 /end MEASUREMENT
/begin MEASUREMENT ASMod_dpExhGsMap_mp00 "Messpunkt für Test ASMod_PresPipe" SLONG Pres_hPa 1 100 -2147483648.00 3500.00 ECU_ADDRESS 0xC000B6BC /end MEASUREMENT
/begin MEASUREMENT ASMod_dpExhGsMap_mp01 "Messpunkt für Test ASMod_PresPipe" SLONG Pres_hPa 1 100 -2147483648.00 3500.00 ECU_ADDRESS 0xC000B6C0 /end MEASUREMENT
/begin MEASUREMENT ASMod_dpExhGsMap_mp02 "Messpunkt für Test ASMod_PresPipe" SLONG Pres_hPa 1 100 -2147483648.00 3500.00 ECU_ADDRESS 0xC000B6C4 /end MEASUREMENT
/begin MEASUREMENT ASMod_dpExhGsMap_mp03 "Messpunkt für Test ASMod_PresPipe" SLONG Pres_hPa 1 100 -2147483648.00 3500.00 ECU_ADDRESS 0xC000B6C8 /end MEASUREMENT
/begin MEASUREMENT ASMod_dpExhGsSim_mp00 "Messpunkt für Test ASMod_PresPipe" SWORD Pres_hPa 1 100 -32768.00 3500.00 ECU_ADDRESS 0xC000B6CC /end MEASUREMENT
/begin MEASUREMENT ASMod_dpExhGsSim_mp01 "Messpunkt für Test ASMod_PresPipe" SWORD Pres_hPa 1 100 -32768.00 3500.00 ECU_ADDRESS 0xC000B6CE /end MEASUREMENT
/begin MEASUREMENT ASMod_dpExhGsSim_mp02 "Messpunkt für Test ASMod_PresPipe" SWORD Pres_hPa 1 100 -32768.00 3500.00 ECU_ADDRESS 0xC000B6D0 /end MEASUREMENT
/begin MEASUREMENT ASMod_dpExhGsSim_mp03 "Messpunkt für Test ASMod_PresPipe" SWORD Pres_hPa 1 100 -32768.00 3500.00 ECU_ADDRESS 0xC000B6D2 /end MEASUREMENT
/begin MEASUREMENT ASMod_dtOxiCSurf_mp00 "Änderung der OxiCat-Oberflächentemperatur" SLONG Temp_Kelv_Sec 1 100 -21474836.4800 21474836.4700 FORMAT "%13.4" ECU_ADDRESS 0xC000B6FC /end MEASUREMENT
/begin MEASUREMENT ASMod_dtOxiC_mp00 "Änderung der OxiCat-Austrittstemperatur" SLONG Temp_Kelv_Sec 1 100 -21474836.4800 21474836.4700 FORMAT "%13.4" ECU_ADDRESS 0xC000B700 /end MEASUREMENT
/begin MEASUREMENT ASMod_dtPipeSlw_mp00 "Temperaturänderung Rohrstück" SLONG Temp_Kelv_Sec 1 100 -21474836.4800 21474836.4700 FORMAT "%13.4" ECU_ADDRESS 0xC000B80C /end MEASUREMENT
/begin MEASUREMENT ASMod_dtPipeSlw_mp01 "Temperaturänderung Rohrstück" SLONG Temp_Kelv_Sec 1 100 -21474836.4800 21474836.4700 FORMAT "%13.4" ECU_ADDRESS 0xC000B810 /end MEASUREMENT
/begin MEASUREMENT ASMod_dtPipeSlw_mp02 "Temperaturänderung Rohrstück" SLONG Temp_Kelv_Sec 1 100 -21474836.4800 21474836.4700 FORMAT "%13.4" ECU_ADDRESS 0xC000B814 /end MEASUREMENT
/begin MEASUREMENT ASMod_dtPipeSlw_mp03 "Temperaturänderung Rohrstück" SLONG Temp_Kelv_Sec 1 100 -21474836.4800 21474836.4700 FORMAT "%13.4" ECU_ADDRESS 0xC000B818 /end MEASUREMENT
/begin MEASUREMENT ASMod_dtPipe_mp00 "Temperaturänderung Rohrstück" SWORD Temp_Kelv_Sec 1 100 -327.6800 327.6700 FORMAT "%8.4" ECU_ADDRESS 0xC000B744 /end MEASUREMENT
/begin MEASUREMENT ASMod_dtPipe_mp01 "Temperaturänderung Rohrstück" SWORD Temp_Kelv_Sec 1 100 -327.6800 327.6700 FORMAT "%8.4" ECU_ADDRESS 0xC000B746 /end MEASUREMENT
/begin MEASUREMENT ASMod_dtPipe_mp02 "Temperaturänderung Rohrstück" SWORD Temp_Kelv_Sec 1 100 -327.6800 327.6700 FORMAT "%8.4" ECU_ADDRESS 0xC000B748 /end MEASUREMENT
/begin MEASUREMENT ASMod_dVolEGPipe_mp00 "Abgasvolumenstrom zur Druckberechnung im Abgassystem" SWORD AirVolPerTime 1 100 -3276.800 3276.700 FORMAT "%8.3" ECU_ADDRESS 0xC000B6D4 /end MEASUREMENT
/begin MEASUREMENT ASMod_dVolEGPipe_mp01 "Abgasvolumenstrom zur Druckberechnung im Abgassystem" SWORD AirVolPerTime 1 100 -3276.800 3276.700 FORMAT "%8.3" ECU_ADDRESS 0xC000B6D6 /end MEASUREMENT
/begin MEASUREMENT ASMod_dVolEGPipe_mp02 "Abgasvolumenstrom zur Druckberechnung im Abgassystem" SWORD AirVolPerTime 1 100 -3276.800 3276.700 FORMAT "%8.3" ECU_ADDRESS 0xC000B6D8 /end MEASUREMENT
/begin MEASUREMENT ASMod_dVolEGPipe_mp03 "Abgasvolumenstrom zur Druckberechnung im Abgassystem" SWORD AirVolPerTime 1 100 -3276.800 3276.700 FORMAT "%8.3" ECU_ADDRESS 0xC000B6DA /end MEASUREMENT
/begin MEASUREMENT ASMod_dwEGPipeSlw_mp00 "Wärmestrom zwischen Gas und Rohrwand" SLONG Pwr1 1 100 -214748364.800 214748364.700 FORMAT "%13.3" ECU_ADDRESS 0xC000B81C /end MEASUREMENT
/begin MEASUREMENT ASMod_dwEGPipeSlw_mp01 "Wärmestrom zwischen Gas und Rohrwand" SLONG Pwr1 1 100 -214748364.800 214748364.700 FORMAT "%13.3" ECU_ADDRESS 0xC000B820 /end MEASUREMENT
/begin MEASUREMENT ASMod_dwEGPipeSlw_mp02 "Wärmestrom zwischen Gas und Rohrwand" SLONG Pwr1 1 100 -214748364.800 214748364.700 FORMAT "%13.3" ECU_ADDRESS 0xC000B824 /end MEASUREMENT
/begin MEASUREMENT ASMod_dwEGPipeSlw_mp03 "Wärmestrom zwischen Gas und Rohrwand" SLONG Pwr1 1 100 -214748364.800 214748364.700 FORMAT "%13.3" ECU_ADDRESS 0xC000B828 /end MEASUREMENT
/begin MEASUREMENT ASMod_dwEGPipe_mp00 "Wärmestrom zwischen Gas und Rohrwand" SLONG Pwr1 1 100 -214748364.800 214748364.700 FORMAT "%13.3" ECU_ADDRESS 0xC000B74C /end MEASUREMENT
/begin MEASUREMENT ASMod_dwEGPipe_mp01 "Wärmestrom zwischen Gas und Rohrwand" SLONG Pwr1 1 100 -214748364.800 214748364.700 FORMAT "%13.3" ECU_ADDRESS 0xC000B750 /end MEASUREMENT
/begin MEASUREMENT ASMod_dwEGPipe_mp02 "Wärmestrom zwischen Gas und Rohrwand" SLONG Pwr1 1 100 -214748364.800 214748364.700 FORMAT "%13.3" ECU_ADDRESS 0xC000B754 /end MEASUREMENT
/begin MEASUREMENT ASMod_dwEnvOxiC00 "gesamter Wärmeaustausch mit der Umgebung" SLONG Pwr1 1 100 -214748364.800 214748364.700 FORMAT "%13.3" ECU_ADDRESS 0xD0002DE4 /end MEASUREMENT
/begin MEASUREMENT ASMod_dwEnvOxiCOut_mp00 "Wärmeaustausch mit der Umgebung in Brick 2" SLONG Pwr1 1 100 -214748364.800 214748364.700 FORMAT "%13.3" ECU_ADDRESS 0xC000B704 /end MEASUREMENT
/begin MEASUREMENT ASMod_dwEnvOxiCSurf_mp00 "Wärmeaustausch mit der Umgebung in Brick 1" SLONG Pwr1 1 100 -214748364.800 214748364.700 FORMAT "%13.3" ECU_ADDRESS 0xC000B708 /end MEASUREMENT
/begin MEASUREMENT ASMod_dwGsOxiCSurf_mp00 "Wärmestrom des Abgases in Brick 1" SLONG Pwr1 1 100 -214748364.800 214748364.700 FORMAT "%13.3" ECU_ADDRESS 0xC000B70C /end MEASUREMENT
/begin MEASUREMENT ASMod_dwGsOxiC_mp00 "Wärmestrom des Abgases in Brick 2" SLONG Pwr1 1 100 -214748364.800 214748364.700 FORMAT "%13.3" ECU_ADDRESS 0xC000B710 /end MEASUREMENT
/begin MEASUREMENT ASMod_dwHCCnvOxiC_mp00 "Wärmestrom aus HC-Umsatz" SLONG Pwr1 1 100 -214748364.800 214748364.700 FORMAT "%13.3" ECU_ADDRESS 0xC000B714 /end MEASUREMENT
/begin MEASUREMENT ASMod_dwOxiCSurf_mp00 "Summe aller Wärmeströme im ersten Brick des Katalysators" SLONG Pwr1 1 100 -214748364.800 214748364.700 FORMAT "%13.3" ECU_ADDRESS 0xC000B718 /end MEASUREMENT
/begin MEASUREMENT ASMod_dwOxiC_mp00 "Summe aller Wärmeströme im zweiten Brick des Katalysators" SLONG Pwr1 1 100 -214748364.800 214748364.700 FORMAT "%13.3" ECU_ADDRESS 0xC000B71C /end MEASUREMENT
/begin MEASUREMENT ASMod_dwPipeEnvSlw_mp00 "Wärmestrom zwischen Rohrwand und Umgebung" SLONG Pwr1 1 100 -214748364.800 214748364.700 FORMAT "%13.3" ECU_ADDRESS 0xC000B82C /end MEASUREMENT
/begin MEASUREMENT ASMod_dwPipeEnvSlw_mp01 "Wärmestrom zwischen Rohrwand und Umgebung" SLONG Pwr1 1 100 -214748364.800 214748364.700 FORMAT "%13.3" ECU_ADDRESS 0xC000B830 /end MEASUREMENT
/begin MEASUREMENT ASMod_dwPipeEnvSlw_mp02 "Wärmestrom zwischen Rohrwand und Umgebung" SLONG Pwr1 1 100 -214748364.800 214748364.700 FORMAT "%13.3" ECU_ADDRESS 0xC000B834 /end MEASUREMENT
/begin MEASUREMENT ASMod_dwPipeEnvSlw_mp03 "Wärmestrom zwischen Rohrwand und Umgebung" SLONG Pwr1 1 100 -214748364.800 214748364.700 FORMAT "%13.3" ECU_ADDRESS 0xC000B838 /end MEASUREMENT
/begin MEASUREMENT ASMod_dwPipeEnv_mp00 "Wärmestrom zwischen Rohrwand und Umgebung" SLONG Pwr1 1 100 -214748364.800 214748364.700 FORMAT "%13.3" ECU_ADDRESS 0xC000B758 /end MEASUREMENT
/begin MEASUREMENT ASMod_dwPipeEnv_mp01 "Wärmestrom zwischen Rohrwand und Umgebung" SLONG Pwr1 1 100 -214748364.800 214748364.700 FORMAT "%13.3" ECU_ADDRESS 0xC000B75C /end MEASUREMENT
/begin MEASUREMENT ASMod_dwPipeEnv_mp02 "Wärmestrom zwischen Rohrwand und Umgebung" SLONG Pwr1 1 100 -214748364.800 214748364.700 FORMAT "%13.3" ECU_ADDRESS 0xC000B760 /end MEASUREMENT
/begin MEASUREMENT ASMod_dwPipeInSlw_mp00 "Wärmestrom am Rohreinlass" SLONG Pwr1 1 100 -214748364.800 214748364.700 FORMAT "%13.3" ECU_ADDRESS 0xC000B83C /end MEASUREMENT
/begin MEASUREMENT ASMod_dwPipeInSlw_mp01 "Wärmestrom am Rohreinlass" SLONG Pwr1 1 100 -214748364.800 214748364.700 FORMAT "%13.3" ECU_ADDRESS 0xC000B840 /end MEASUREMENT
/begin MEASUREMENT ASMod_dwPipeInSlw_mp02 "Wärmestrom am Rohreinlass" SLONG Pwr1 1 100 -214748364.800 214748364.700 FORMAT "%13.3" ECU_ADDRESS 0xC000B844 /end MEASUREMENT
/begin MEASUREMENT ASMod_dwPipeInSlw_mp03 "Wärmestrom am Rohreinlass" SLONG Pwr1 1 100 -214748364.800 214748364.700 FORMAT "%13.3" ECU_ADDRESS 0xC000B848 /end MEASUREMENT
/begin MEASUREMENT ASMod_dwPipeIn_mp00 "Wärmestrom am Rohreinlass" SLONG Pwr1 1 100 -214748364.800 214748364.700 FORMAT "%13.3" ECU_ADDRESS 0xC000B764 /end MEASUREMENT
/begin MEASUREMENT ASMod_dwPipeIn_mp01 "Wärmestrom am Rohreinlass" SLONG Pwr1 1 100 -214748364.800 214748364.700 FORMAT "%13.3" ECU_ADDRESS 0xC000B768 /end MEASUREMENT
/begin MEASUREMENT ASMod_dwPipeIn_mp02 "Wärmestrom am Rohreinlass" SLONG Pwr1 1 100 -214748364.800 214748364.700 FORMAT "%13.3" ECU_ADDRESS 0xC000B76C /end MEASUREMENT
/begin MEASUREMENT ASMod_dwPipeOutSlw_mp00 "Wärmestrom am Rohrauslass" SLONG Pwr1 1 100 -214748364.800 214748364.700 FORMAT "%13.3" ECU_ADDRESS 0xC000B84C /end MEASUREMENT
/begin MEASUREMENT ASMod_dwPipeOutSlw_mp01 "Wärmestrom am Rohrauslass" SLONG Pwr1 1 100 -214748364.800 214748364.700 FORMAT "%13.3" ECU_ADDRESS 0xC000B850 /end MEASUREMENT
/begin MEASUREMENT ASMod_dwPipeOutSlw_mp02 "Wärmestrom am Rohrauslass" SLONG Pwr1 1 100 -214748364.800 214748364.700 FORMAT "%13.3" ECU_ADDRESS 0xC000B854 /end MEASUREMENT
/begin MEASUREMENT ASMod_dwPipeOutSlw_mp03 "Wärmestrom am Rohrauslass" SLONG Pwr1 1 100 -214748364.800 214748364.700 FORMAT "%13.3" ECU_ADDRESS 0xC000B858 /end MEASUREMENT
/begin MEASUREMENT ASMod_dwPipeOut_mp00 "Wärmestrom am Rohrauslass" SLONG Pwr1 1 100 -214748364.800 214748364.700 FORMAT "%13.3" ECU_ADDRESS 0xC000B770 /end MEASUREMENT
/begin MEASUREMENT ASMod_dwPipeOut_mp01 "Wärmestrom am Rohrauslass" SLONG Pwr1 1 100 -214748364.800 214748364.700 FORMAT "%13.3" ECU_ADDRESS 0xC000B774 /end MEASUREMENT
/begin MEASUREMENT ASMod_dwPipeOut_mp02 "Wärmestrom am Rohrauslass" SLONG Pwr1 1 100 -214748364.800 214748364.700 FORMAT "%13.3" ECU_ADDRESS 0xC000B778 /end MEASUREMENT
/begin MEASUREMENT ASMod_dwPipeSlw_mp00 "Wärmeänderung Rohrstück" SLONG Pwr1 1 100 -214748364.800 214748364.700 FORMAT "%13.3" ECU_ADDRESS 0xC000B85C /end MEASUREMENT
/begin MEASUREMENT ASMod_dwPipeSlw_mp01 "Wärmeänderung Rohrstück" SLONG Pwr1 1 100 -214748364.800 214748364.700 FORMAT "%13.3" ECU_ADDRESS 0xC000B860 /end MEASUREMENT
/begin MEASUREMENT ASMod_dwPipeSlw_mp02 "Wärmeänderung Rohrstück" SLONG Pwr1 1 100 -214748364.800 214748364.700 FORMAT "%13.3" ECU_ADDRESS 0xC000B864 /end MEASUREMENT
/begin MEASUREMENT ASMod_dwPipeSlw_mp03 "Wärmeänderung Rohrstück" SLONG Pwr1 1 100 -214748364.800 214748364.700 FORMAT "%13.3" ECU_ADDRESS 0xC000B868 /end MEASUREMENT
/begin MEASUREMENT ASMod_dwPipe_mp00 "Wärmeänderung Rohrstück" SLONG Pwr1 1 100 -214748364.800 214748364.700 FORMAT "%13.3" ECU_ADDRESS 0xC000B77C /end MEASUREMENT
/begin MEASUREMENT ASMod_dwPipe_mp01 "Wärmeänderung Rohrstück" SLONG Pwr1 1 100 -214748364.800 214748364.700 FORMAT "%13.3" ECU_ADDRESS 0xC000B780 /end MEASUREMENT
/begin MEASUREMENT ASMod_dwPipe_mp02 "Wärmeänderung Rohrstück" SLONG Pwr1 1 100 -214748364.800 214748364.700 FORMAT "%13.3" ECU_ADDRESS 0xC000B784 /end MEASUREMENT
/begin MEASUREMENT ASMod_facHCCnvOxiC_mp00 "temperaturabhängige HC-Umsatzrate im OxiCat" SWORD Fact 1 100 -4.000000 3.999878 ECU_ADDRESS 0xC000B720 /end MEASUREMENT
/begin MEASUREMENT ASMod_facHCLdOxiCLoad_mp00 "" SWORD Fact 1 100 -4.000000 3.999878 ECU_ADDRESS 0xC000B722 /end MEASUREMENT
/begin MEASUREMENT ASMod_facHCLdOxiCTemp_mp00 "" SWORD Fact 1 100 -4.000000 3.999878 ECU_ADDRESS 0xC000B724 /end MEASUREMENT
/begin MEASUREMENT ASMod_facPowEGPipe_mp00 "Faktor aus der Potenzfunktion zur Druckberechnung im Abgassystem" SWORD Fact1 1 100 -256.0000 255.9922 ECU_ADDRESS 0xC000B6DC /end MEASUREMENT
/begin MEASUREMENT ASMod_facPowEGPipe_mp01 "Faktor aus der Potenzfunktion zur Druckberechnung im Abgassystem" SWORD Fact1 1 100 -256.0000 255.9922 ECU_ADDRESS 0xC000B6DE /end MEASUREMENT
/begin MEASUREMENT ASMod_facPowEGPipe_mp02 "Faktor aus der Potenzfunktion zur Druckberechnung im Abgassystem" SWORD Fact1 1 100 -256.0000 255.9922 ECU_ADDRESS 0xC000B6E0 /end MEASUREMENT
/begin MEASUREMENT ASMod_facPowEGPipe_mp03 "Faktor aus der Potenzfunktion zur Druckberechnung im Abgassystem" SWORD Fact1 1 100 -256.0000 255.9922 ECU_ADDRESS 0xC000B6E2 /end MEASUREMENT
/begin MEASUREMENT ASMod_facRhoEtaEGPipe_mp00 "temperaturabhängiger Dichte- und Viskositätsfaktor zur Druckberechnung im Abgassystem" SWORD Fact 1 100 -4.000000 3.999878 ECU_ADDRESS 0xC000B6E4 /end MEASUREMENT
/begin MEASUREMENT ASMod_facRhoEtaEGPipe_mp01 "temperaturabhängiger Dichte- und Viskositätsfaktor zur Druckberechnung im Abgassystem" SWORD Fact 1 100 -4.000000 3.999878 ECU_ADDRESS 0xC000B6E6 /end MEASUREMENT
/begin MEASUREMENT ASMod_facRhoEtaEGPipe_mp02 "temperaturabhängiger Dichte- und Viskositätsfaktor zur Druckberechnung im Abgassystem" SWORD Fact 1 100 -4.000000 3.999878 ECU_ADDRESS 0xC000B6E8 /end MEASUREMENT
/begin MEASUREMENT ASMod_facRhoEtaEGPipe_mp03 "temperaturabhängiger Dichte- und Viskositätsfaktor zur Druckberechnung im Abgassystem" SWORD Fact 1 100 -4.000000 3.999878 ECU_ADDRESS 0xC000B6EA /end MEASUREMENT
/begin MEASUREMENT ASMod_htcArEGPipeSlw_mp00 "Wärmeübergangsleitwert zwischen Gas und Rohrwand" SLONG ThermalCoEff 1 100 -214748364.800 214748364.700 FORMAT "%13.3" ECU_ADDRESS 0xC000B86C /end MEASUREMENT
/begin MEASUREMENT ASMod_htcArEGPipeSlw_mp01 "Wärmeübergangsleitwert zwischen Gas und Rohrwand" SLONG ThermalCoEff 1 100 -214748364.800 214748364.700 FORMAT "%13.3" ECU_ADDRESS 0xC000B870 /end MEASUREMENT
/begin MEASUREMENT ASMod_htcArEGPipeSlw_mp02 "Wärmeübergangsleitwert zwischen Gas und Rohrwand" SLONG ThermalCoEff 1 100 -214748364.800 214748364.700 FORMAT "%13.3" ECU_ADDRESS 0xC000B874 /end MEASUREMENT
/begin MEASUREMENT ASMod_htcArEGPipeSlw_mp03 "Wärmeübergangsleitwert zwischen Gas und Rohrwand" SLONG ThermalCoEff 1 100 -214748364.800 214748364.700 FORMAT "%13.3" ECU_ADDRESS 0xC000B878 /end MEASUREMENT
/begin MEASUREMENT ASMod_htcArEGPipe_mp00 "Wärmeübergangsleitwert zwischen Gas und Rohrwand" SLONG ThermalCoEff 1 100 -214748364.800 214748364.700 FORMAT "%13.3" ECU_ADDRESS 0xC000B788 /end MEASUREMENT
/begin MEASUREMENT ASMod_htcArEGPipe_mp01 "Wärmeübergangsleitwert zwischen Gas und Rohrwand" SLONG ThermalCoEff 1 100 -214748364.800 214748364.700 FORMAT "%13.3" ECU_ADDRESS 0xC000B78C /end MEASUREMENT
/begin MEASUREMENT ASMod_htcArEGPipe_mp02 "Wärmeübergangsleitwert zwischen Gas und Rohrwand" SLONG ThermalCoEff 1 100 -214748364.800 214748364.700 FORMAT "%13.3" ECU_ADDRESS 0xC000B790 /end MEASUREMENT
/begin MEASUREMENT ASMod_htcArPipeEnvSlw_mp00 "Wärmeübergangsleitwert zwischen Rohrwand und Umgebung" SLONG ThermalCoEff 1 100 -214748364.800 214748364.700 FORMAT "%13.3" ECU_ADDRESS 0xC000B87C /end MEASUREMENT
/begin MEASUREMENT ASMod_htcArPipeEnvSlw_mp01 "Wärmeübergangsleitwert zwischen Rohrwand und Umgebung" SLONG ThermalCoEff 1 100 -214748364.800 214748364.700 FORMAT "%13.3" ECU_ADDRESS 0xC000B880 /end MEASUREMENT
/begin MEASUREMENT ASMod_htcArPipeEnvSlw_mp02 "Wärmeübergangsleitwert zwischen Rohrwand und Umgebung" SLONG ThermalCoEff 1 100 -214748364.800 214748364.700 FORMAT "%13.3" ECU_ADDRESS 0xC000B884 /end MEASUREMENT
/begin MEASUREMENT ASMod_htcArPipeEnvSlw_mp03 "Wärmeübergangsleitwert zwischen Rohrwand und Umgebung" SLONG ThermalCoEff 1 100 -214748364.800 214748364.700 FORMAT "%13.3" ECU_ADDRESS 0xC000B888 /end MEASUREMENT
/begin MEASUREMENT ASMod_htcArPipeEnv_mp00 "Wärmeübergangsleitwert zwischen Rohrwand und Umgebung" SLONG ThermalCoEff 1 100 -214748364.800 214748364.700 FORMAT "%13.3" ECU_ADDRESS 0xC000B794 /end MEASUREMENT
/begin MEASUREMENT ASMod_htcArPipeEnv_mp01 "Wärmeübergangsleitwert zwischen Rohrwand und Umgebung" SLONG ThermalCoEff 1 100 -214748364.800 214748364.700 FORMAT "%13.3" ECU_ADDRESS 0xC000B798 /end MEASUREMENT
/begin MEASUREMENT ASMod_htcArPipeEnv_mp02 "Wärmeübergangsleitwert zwischen Rohrwand und Umgebung" SLONG ThermalCoEff 1 100 -214748364.800 214748364.700 FORMAT "%13.3" ECU_ADDRESS 0xC000B79C /end MEASUREMENT
/begin MEASUREMENT ASMod_htcEGPipeSlw_mp00 "Wärmeübergangskoeffizient zwischen Gas und Rohrwand" SWORD ThermalCoEff 1 100 -3276.800 3276.700 FORMAT "%8.3" ECU_ADDRESS 0xC000B88C /end MEASUREMENT
/begin MEASUREMENT ASMod_htcEGPipeSlw_mp01 "Wärmeübergangskoeffizient zwischen Gas und Rohrwand" SWORD ThermalCoEff 1 100 -3276.800 3276.700 FORMAT "%8.3" ECU_ADDRESS 0xC000B88E /end MEASUREMENT
/begin MEASUREMENT ASMod_htcEGPipeSlw_mp02 "Wärmeübergangskoeffizient zwischen Gas und Rohrwand" SWORD ThermalCoEff 1 100 -3276.800 3276.700 FORMAT "%8.3" ECU_ADDRESS 0xC000B890 /end MEASUREMENT
/begin MEASUREMENT ASMod_htcEGPipeSlw_mp03 "Wärmeübergangskoeffizient zwischen Gas und Rohrwand" SWORD ThermalCoEff 1 100 -3276.800 3276.700 FORMAT "%8.3" ECU_ADDRESS 0xC000B892 /end MEASUREMENT
/begin MEASUREMENT ASMod_htcEGPipe_mp00 "Wärmeübergangskoeffizient zwischen Gas und Rohrwand" SWORD ThermalCoEff 1 100 -3276.800 3276.700 FORMAT "%8.3" ECU_ADDRESS 0xC000B7A0 /end MEASUREMENT
/begin MEASUREMENT ASMod_htcEGPipe_mp01 "Wärmeübergangskoeffizient zwischen Gas und Rohrwand" SWORD ThermalCoEff 1 100 -3276.800 3276.700 FORMAT "%8.3" ECU_ADDRESS 0xC000B7A2 /end MEASUREMENT
/begin MEASUREMENT ASMod_htcEGPipe_mp02 "Wärmeübergangskoeffizient zwischen Gas und Rohrwand" SWORD ThermalCoEff 1 100 -3276.800 3276.700 FORMAT "%8.3" ECU_ADDRESS 0xC000B7A4 /end MEASUREMENT
/begin MEASUREMENT ASMod_htcOxiC_mp00 "Wärmeübertragungskoeffizient" SLONG ThermalCoEff 1 100 -214748364.800 214748364.700 FORMAT "%13.3" ECU_ADDRESS 0xC000B728 /end MEASUREMENT
/begin MEASUREMENT ASMod_htcPipeEnvSlw_mp00 "Wärmeübergangskoeffizient zwischen Rohrwand und Umgebung" SWORD ThermalCoEff 1 100 -3276.800 3276.700 FORMAT "%8.3" ECU_ADDRESS 0xC000B894 /end MEASUREMENT
/begin MEASUREMENT ASMod_htcPipeEnvSlw_mp01 "Wärmeübergangskoeffizient zwischen Rohrwand und Umgebung" SWORD ThermalCoEff 1 100 -3276.800 3276.700 FORMAT "%8.3" ECU_ADDRESS 0xC000B896 /end MEASUREMENT
/begin MEASUREMENT ASMod_htcPipeEnvSlw_mp02 "Wärmeübergangskoeffizient zwischen Rohrwand und Umgebung" SWORD ThermalCoEff 1 100 -3276.800 3276.700 FORMAT "%8.3" ECU_ADDRESS 0xC000B898 /end MEASUREMENT
/begin MEASUREMENT ASMod_htcPipeEnvSlw_mp03 "Wärmeübergangskoeffizient zwischen Rohrwand und Umgebung" SWORD ThermalCoEff 1 100 -3276.800 3276.700 FORMAT "%8.3" ECU_ADDRESS 0xC000B89A /end MEASUREMENT
/begin MEASUREMENT ASMod_htcPipeEnv_mp00 "Wärmeübergangskoeffizient zwischen Rohrwand und Umgebung" SWORD ThermalCoEff 1 100 -3276.800 3276.700 FORMAT "%8.3" ECU_ADDRESS 0xC000B7A6 /end MEASUREMENT
/begin MEASUREMENT ASMod_htcPipeEnv_mp01 "Wärmeübergangskoeffizient zwischen Rohrwand und Umgebung" SWORD ThermalCoEff 1 100 -3276.800 3276.700 FORMAT "%8.3" ECU_ADDRESS 0xC000B7A8 /end MEASUREMENT
/begin MEASUREMENT ASMod_htcPipeEnv_mp02 "Wärmeübergangskoeffizient zwischen Rohrwand und Umgebung" SWORD ThermalCoEff 1 100 -3276.800 3276.700 FORMAT "%8.3" ECU_ADDRESS 0xC000B7AA /end MEASUREMENT
/begin MEASUREMENT ASMod_mHCLdOciCActOld_mp00 "" SWORD InjMass_g 1 100 -327.6800 327.6700 FORMAT "%8.4" ECU_ADDRESS 0xC000B72C /end MEASUREMENT
/begin MEASUREMENT ASMod_mHCLdOxiCAct00 "" SWORD InjMass_g 1 100 -327.6800 327.6700 FORMAT "%8.4" ECU_ADDRESS 0xD0000488 /end MEASUREMENT
/begin MEASUREMENT ASMod_nuPipeEnvSlw_mp00 "Nusseltzahl zwischen Rohrwand und Umgebung" SWORD OneToOne 1 100 -32768.00 32767.00 ECU_ADDRESS 0xC000B89C /end MEASUREMENT
/begin MEASUREMENT ASMod_nuPipeEnvSlw_mp01 "Nusseltzahl zwischen Rohrwand und Umgebung" SWORD OneToOne 1 100 -32768.00 32767.00 ECU_ADDRESS 0xC000B89E /end MEASUREMENT
/begin MEASUREMENT ASMod_nuPipeEnvSlw_mp02 "Nusseltzahl zwischen Rohrwand und Umgebung" SWORD OneToOne 1 100 -32768.00 32767.00 ECU_ADDRESS 0xC000B8A0 /end MEASUREMENT
/begin MEASUREMENT ASMod_nuPipeEnvSlw_mp03 "Nusseltzahl zwischen Rohrwand und Umgebung" SWORD OneToOne 1 100 -32768.00 32767.00 ECU_ADDRESS 0xC000B8A2 /end MEASUREMENT
/begin MEASUREMENT ASMod_nuPipeEnv_mp00 "Nusseltzahl zwischen Rohrwand und Umgebung" SWORD OneToOne 1 100 -32768.00 32767.00 ECU_ADDRESS 0xC000B7AC /end MEASUREMENT
/begin MEASUREMENT ASMod_nuPipeEnv_mp01 "Nusseltzahl zwischen Rohrwand und Umgebung" SWORD OneToOne 1 100 -32768.00 32767.00 ECU_ADDRESS 0xC000B7AE /end MEASUREMENT
/begin MEASUREMENT ASMod_nuPipeEnv_mp02 "Nusseltzahl zwischen Rohrwand und Umgebung" SWORD OneToOne 1 100 -32768.00 32767.00 ECU_ADDRESS 0xC000B7B0 /end MEASUREMENT
/begin MEASUREMENT ASMod_nuPipeSlw_mp00 "Nusseltzahl im Rohrstück" SWORD OneToOne 1 100 -32768.00 32767.00 ECU_ADDRESS 0xC000B8A4 /end MEASUREMENT
/begin MEASUREMENT ASMod_nuPipeSlw_mp01 "Nusseltzahl im Rohrstück" SWORD OneToOne 1 100 -32768.00 32767.00 ECU_ADDRESS 0xC000B8A6 /end MEASUREMENT
/begin MEASUREMENT ASMod_nuPipeSlw_mp02 "Nusseltzahl im Rohrstück" SWORD OneToOne 1 100 -32768.00 32767.00 ECU_ADDRESS 0xC000B8A8 /end MEASUREMENT
/begin MEASUREMENT ASMod_nuPipeSlw_mp03 "Nusseltzahl im Rohrstück" SWORD OneToOne 1 100 -32768.00 32767.00 ECU_ADDRESS 0xC000B8AA /end MEASUREMENT
/begin MEASUREMENT ASMod_nuPipe_mp00 "Nusseltzahl im Rohrstück" SWORD OneToOne 1 100 -32768.00 32767.00 ECU_ADDRESS 0xC000B7B2 /end MEASUREMENT
/begin MEASUREMENT ASMod_nuPipe_mp01 "Nusseltzahl im Rohrstück" SWORD OneToOne 1 100 -32768.00 32767.00 ECU_ADDRESS 0xC000B7B4 /end MEASUREMENT
/begin MEASUREMENT ASMod_nuPipe_mp02 "Nusseltzahl im Rohrstück" SWORD OneToOne 1 100 -32768.00 32767.00 ECU_ADDRESS 0xC000B7B6 /end MEASUREMENT
/begin MEASUREMENT ASMod_pDiffEGPipe_mp00 "Druckdifferenz über ein Rohrstück der Abgasleitung" SWORD Pres_hPa 1 100 -32768.00 3500.00 ECU_ADDRESS 0xC000B6EC /end MEASUREMENT
/begin MEASUREMENT ASMod_pDiffEGPipe_mp01 "Druckdifferenz über ein Rohrstück der Abgasleitung" SWORD Pres_hPa 1 100 -32768.00 3500.00 ECU_ADDRESS 0xC000B6EE /end MEASUREMENT
/begin MEASUREMENT ASMod_pDiffEGPipe_mp02 "Druckdifferenz über ein Rohrstück der Abgasleitung" SWORD Pres_hPa 1 100 -32768.00 3500.00 ECU_ADDRESS 0xC000B6F0 /end MEASUREMENT
/begin MEASUREMENT ASMod_pDiffEGPipe_mp03 "Druckdifferenz über ein Rohrstück der Abgasleitung" SWORD Pres_hPa 1 100 -32768.00 3500.00 ECU_ADDRESS 0xC000B6F2 /end MEASUREMENT
/begin MEASUREMENT ASMod_pEGFld00 "Feld der Abgasdrücke" SWORD Pres_hPa 1 100 -32768.00 3500.00 ECU_ADDRESS 0xD0000492 /end MEASUREMENT
/begin MEASUREMENT ASMod_pEGFld01 "Feld der Abgasdrücke" SWORD Pres_hPa 1 100 -32768.00 3500.00 ECU_ADDRESS 0xD0000494 /end MEASUREMENT
/begin MEASUREMENT ASMod_pEGFld02 "Feld der Abgasdrücke" SWORD Pres_hPa 1 100 -32768.00 3500.00 ECU_ADDRESS 0xD0000496 /end MEASUREMENT
/begin MEASUREMENT ASMod_pEGFld03 "Feld der Abgasdrücke" SWORD Pres_hPa 1 100 -32768.00 3500.00 ECU_ADDRESS 0xD0000498 /end MEASUREMENT
/begin MEASUREMENT ASMod_pEGFld04 "Feld der Abgasdrücke" SWORD Pres_hPa 1 100 -32768.00 3500.00 ECU_ADDRESS 0xD000049A /end MEASUREMENT
/begin MEASUREMENT ASMod_pEGFld05 "Feld der Abgasdrücke" SWORD Pres_hPa 1 100 -32768.00 3500.00 ECU_ADDRESS 0xD000049C /end MEASUREMENT
/begin MEASUREMENT ASMod_pEGFld06 "Feld der Abgasdrücke" SWORD Pres_hPa 1 100 -32768.00 3500.00 ECU_ADDRESS 0xD000049E /end MEASUREMENT
/begin MEASUREMENT ASMod_pEGFld07 "Feld der Abgasdrücke" SWORD Pres_hPa 1 100 -32768.00 3500.00 ECU_ADDRESS 0xD00004A0 /end MEASUREMENT
/begin MEASUREMENT ASMod_rePipeEnvSlw_mp00 "Reynoldszahl zwischen Rohrwand und Umgebung" SWORD ReynoldsNum1 1 100 -32768000. 32767000. FORMAT "%8.0" ECU_ADDRESS 0xC000B8AC /end MEASUREMENT
/begin MEASUREMENT ASMod_rePipeEnvSlw_mp01 "Reynoldszahl zwischen Rohrwand und Umgebung" SWORD ReynoldsNum1 1 100 -32768000. 32767000. FORMAT "%8.0" ECU_ADDRESS 0xC000B8AE /end MEASUREMENT
/begin MEASUREMENT ASMod_rePipeEnvSlw_mp02 "Reynoldszahl zwischen Rohrwand und Umgebung" SWORD ReynoldsNum1 1 100 -32768000. 32767000. FORMAT "%8.0" ECU_ADDRESS 0xC000B8B0 /end MEASUREMENT
/begin MEASUREMENT ASMod_rePipeEnvSlw_mp03 "Reynoldszahl zwischen Rohrwand und Umgebung" SWORD ReynoldsNum1 1 100 -32768000. 32767000. FORMAT "%8.0" ECU_ADDRESS 0xC000B8B2 /end MEASUREMENT
/begin MEASUREMENT ASMod_rePipeEnv_mp00 "Reynoldszahl zwischen Rohrwand und Umgebung" SWORD ReynoldsNum1 1 100 -32768000. 32767000. FORMAT "%8.0" ECU_ADDRESS 0xC000B7B8 /end MEASUREMENT
/begin MEASUREMENT ASMod_rePipeEnv_mp01 "Reynoldszahl zwischen Rohrwand und Umgebung" SWORD ReynoldsNum1 1 100 -32768000. 32767000. FORMAT "%8.0" ECU_ADDRESS 0xC000B7BA /end MEASUREMENT
/begin MEASUREMENT ASMod_rePipeEnv_mp02 "Reynoldszahl zwischen Rohrwand und Umgebung" SWORD ReynoldsNum1 1 100 -32768000. 32767000. FORMAT "%8.0" ECU_ADDRESS 0xC000B7BC /end MEASUREMENT
/begin MEASUREMENT ASMod_rePipeSlw_mp00 "Reynoldszahl im Rohrstück" SWORD ReynoldsNum 1 100 -3276800. 3276700. FORMAT "%8.0" ECU_ADDRESS 0xC000B8B4 /end MEASUREMENT
/begin MEASUREMENT ASMod_rePipeSlw_mp01 "Reynoldszahl im Rohrstück" SWORD ReynoldsNum 1 100 -3276800. 3276700. FORMAT "%8.0" ECU_ADDRESS 0xC000B8B6 /end MEASUREMENT
/begin MEASUREMENT ASMod_rePipeSlw_mp02 "Reynoldszahl im Rohrstück" SWORD ReynoldsNum 1 100 -3276800. 3276700. FORMAT "%8.0" ECU_ADDRESS 0xC000B8B8 /end MEASUREMENT
/begin MEASUREMENT ASMod_rePipeSlw_mp03 "Reynoldszahl im Rohrstück" SWORD ReynoldsNum 1 100 -3276800. 3276700. FORMAT "%8.0" ECU_ADDRESS 0xC000B8BA /end MEASUREMENT
/begin MEASUREMENT ASMod_rePipe_mp00 "Reynoldszahl im Rohrstück" SWORD ReynoldsNum 1 100 -3276800. 3276700. FORMAT "%8.0" ECU_ADDRESS 0xC000B7BE /end MEASUREMENT
/begin MEASUREMENT ASMod_rePipe_mp01 "Reynoldszahl im Rohrstück" SWORD ReynoldsNum 1 100 -3276800. 3276700. FORMAT "%8.0" ECU_ADDRESS 0xC000B7C0 /end MEASUREMENT
/begin MEASUREMENT ASMod_rePipe_mp02 "Reynoldszahl im Rohrstück" SWORD ReynoldsNum 1 100 -3276800. 3276700. FORMAT "%8.0" ECU_ADDRESS 0xC000B7C2 /end MEASUREMENT
/begin MEASUREMENT ASMod_rHCRgnOxiC_mp00 "" SWORD Time_1_s 1 100 -0.2000000 0.1999939 FORMAT "%9.7" ECU_ADDRESS 0xC000B72E /end MEASUREMENT
/begin MEASUREMENT ASMod_rNOxEGFld00 "Feld der NOx-Massenanteile im Abgas" SWORD RatNOxMass 1 100 -0.003276800 0.003276700 FORMAT "%11.9" ECU_ADDRESS 0xD00004D0 /end MEASUREMENT
/begin MEASUREMENT ASMod_rNOxEGFld01 "Feld der NOx-Massenanteile im Abgas" SWORD RatNOxMass 1 100 -0.003276800 0.003276700 FORMAT "%11.9" ECU_ADDRESS 0xD00004D2 /end MEASUREMENT
/begin MEASUREMENT ASMod_rNOxEGFld02 "Feld der NOx-Massenanteile im Abgas" SWORD RatNOxMass 1 100 -0.003276800 0.003276700 FORMAT "%11.9" ECU_ADDRESS 0xD00004D4 /end MEASUREMENT
/begin MEASUREMENT ASMod_rNOxEGFld03 "Feld der NOx-Massenanteile im Abgas" SWORD RatNOxMass 1 100 -0.003276800 0.003276700 FORMAT "%11.9" ECU_ADDRESS 0xD00004D6 /end MEASUREMENT
/begin MEASUREMENT ASMod_rNOxEGFld04 "Feld der NOx-Massenanteile im Abgas" SWORD RatNOxMass 1 100 -0.003276800 0.003276700 FORMAT "%11.9" ECU_ADDRESS 0xD00004D8 /end MEASUREMENT
/begin MEASUREMENT ASMod_rNOxEGFld05 "Feld der NOx-Massenanteile im Abgas" SWORD RatNOxMass 1 100 -0.003276800 0.003276700 FORMAT "%11.9" ECU_ADDRESS 0xD00004DA /end MEASUREMENT
/begin MEASUREMENT ASMod_rNOxEGFld06 "Feld der NOx-Massenanteile im Abgas" SWORD RatNOxMass 1 100 -0.003276800 0.003276700 FORMAT "%11.9" ECU_ADDRESS 0xD00004DC /end MEASUREMENT
/begin MEASUREMENT ASMod_rO2EGFld00 "Feld der Sauerstoffanteile der Abgasmassenströme" SWORD O2 1 100 -0.3276800 0.3276700 ECU_ADDRESS 0xD00004DE /end MEASUREMENT
/begin MEASUREMENT ASMod_rO2EGFld01 "Feld der Sauerstoffanteile der Abgasmassenströme" SWORD O2 1 100 -0.3276800 0.3276700 ECU_ADDRESS 0xD00004E0 /end MEASUREMENT
/begin MEASUREMENT ASMod_rO2EGFld02 "Feld der Sauerstoffanteile der Abgasmassenströme" SWORD O2 1 100 -0.3276800 0.3276700 ECU_ADDRESS 0xD00004E2 /end MEASUREMENT
/begin MEASUREMENT ASMod_rO2EGFld03 "Feld der Sauerstoffanteile der Abgasmassenströme" SWORD O2 1 100 -0.3276800 0.3276700 ECU_ADDRESS 0xD00004E4 /end MEASUREMENT
/begin MEASUREMENT ASMod_rO2EGFld04 "Feld der Sauerstoffanteile der Abgasmassenströme" SWORD O2 1 100 -0.3276800 0.3276700 ECU_ADDRESS 0xD00004E6 /end MEASUREMENT
/begin MEASUREMENT ASMod_rO2EGFld05 "Feld der Sauerstoffanteile der Abgasmassenströme" SWORD O2 1 100 -0.3276800 0.3276700 ECU_ADDRESS 0xD00004E8 /end MEASUREMENT
/begin MEASUREMENT ASMod_rO2EGFld06 "Feld der Sauerstoffanteile der Abgasmassenströme" SWORD O2 1 100 -0.3276800 0.3276700 ECU_ADDRESS 0xD00004EA /end MEASUREMENT
/begin MEASUREMENT ASMod_rTimeOxiC_mp00 "Verhältnis Standzeit zu Abkühl-Halbwertszeit Oxidationskatalysator" SWORD Fact1 1 100 -256.0000 255.9922 ECU_ADDRESS 0xC000B8FC /end MEASUREMENT
/begin MEASUREMENT ASMod_rTimePipe_mp00 "Verhältnis Standzeit zu Abkühl-Halbwertszeit Rohrstück" SWORD Fact1 1 100 -256.0000 255.9922 ECU_ADDRESS 0xC000B8FE /end MEASUREMENT
/begin MEASUREMENT ASMod_rTimePipe_mp01 "Verhältnis Standzeit zu Abkühl-Halbwertszeit Rohrstück" SWORD Fact1 1 100 -256.0000 255.9922 ECU_ADDRESS 0xC000B900 /end MEASUREMENT
/begin MEASUREMENT ASMod_rTimePipe_mp02 "Verhältnis Standzeit zu Abkühl-Halbwertszeit Rohrstück" SWORD Fact1 1 100 -256.0000 255.9922 ECU_ADDRESS 0xC000B902 /end MEASUREMENT
/begin MEASUREMENT ASMod_rTimePipe_mp03 "Verhältnis Standzeit zu Abkühl-Halbwertszeit Rohrstück" SWORD Fact1 1 100 -256.0000 255.9922 ECU_ADDRESS 0xC000B904 /end MEASUREMENT
/begin MEASUREMENT ASMod_rTimePipe_mp04 "Verhältnis Standzeit zu Abkühl-Halbwertszeit Rohrstück" SWORD Fact1 1 100 -256.0000 255.9922 ECU_ADDRESS 0xC000B906 /end MEASUREMENT
/begin MEASUREMENT ASMod_rTimePipe_mp05 "Verhältnis Standzeit zu Abkühl-Halbwertszeit Rohrstück" SWORD Fact1 1 100 -256.0000 255.9922 ECU_ADDRESS 0xC000B908 /end MEASUREMENT
/begin MEASUREMENT ASMod_rTimePipe_mp06 "Verhältnis Standzeit zu Abkühl-Halbwertszeit Rohrstück" SWORD Fact1 1 100 -256.0000 255.9922 ECU_ADDRESS 0xC000B90A /end MEASUREMENT
/begin MEASUREMENT ASMod_tDiffEGPipeSlw_mp00 "Temperaturdifferenz zwischen Gas und Rohrwand" SWORD TempDiff_Kelv 1 100 -3276.800 3276.700 ECU_ADDRESS 0xC000B8BC /end MEASUREMENT
/begin MEASUREMENT ASMod_tDiffEGPipeSlw_mp01 "Temperaturdifferenz zwischen Gas und Rohrwand" SWORD TempDiff_Kelv 1 100 -3276.800 3276.700 ECU_ADDRESS 0xC000B8BE /end MEASUREMENT
/begin MEASUREMENT ASMod_tDiffEGPipeSlw_mp02 "Temperaturdifferenz zwischen Gas und Rohrwand" SWORD TempDiff_Kelv 1 100 -3276.800 3276.700 ECU_ADDRESS 0xC000B8C0 /end MEASUREMENT
/begin MEASUREMENT ASMod_tDiffEGPipeSlw_mp03 "Temperaturdifferenz zwischen Gas und Rohrwand" SWORD TempDiff_Kelv 1 100 -3276.800 3276.700 ECU_ADDRESS 0xC000B8C2 /end MEASUREMENT
/begin MEASUREMENT ASMod_tDiffEGPipe_mp00 "Temperaturdifferenz zwischen Gas und Rohrwand" SWORD TempDiff_Kelv 1 100 -3276.800 3276.700 ECU_ADDRESS 0xC000B7C4 /end MEASUREMENT
/begin MEASUREMENT ASMod_tDiffEGPipe_mp01 "Temperaturdifferenz zwischen Gas und Rohrwand" SWORD TempDiff_Kelv 1 100 -3276.800 3276.700 ECU_ADDRESS 0xC000B7C6 /end MEASUREMENT
/begin MEASUREMENT ASMod_tDiffEGPipe_mp02 "Temperaturdifferenz zwischen Gas und Rohrwand" SWORD TempDiff_Kelv 1 100 -3276.800 3276.700 ECU_ADDRESS 0xC000B7C8 /end MEASUREMENT
/begin MEASUREMENT ASMod_tDiffPipeEnvSlw_mp00 "Temperaturdifferenz zwischen Rohrwand und Umgebung" SWORD TempDiff_Kelv 1 100 -3276.800 3276.700 ECU_ADDRESS 0xC000B8C4 /end MEASUREMENT
/begin MEASUREMENT ASMod_tDiffPipeEnvSlw_mp01 "Temperaturdifferenz zwischen Rohrwand und Umgebung" SWORD TempDiff_Kelv 1 100 -3276.800 3276.700 ECU_ADDRESS 0xC000B8C6 /end MEASUREMENT
/begin MEASUREMENT ASMod_tDiffPipeEnvSlw_mp02 "Temperaturdifferenz zwischen Rohrwand und Umgebung" SWORD TempDiff_Kelv 1 100 -3276.800 3276.700 ECU_ADDRESS 0xC000B8C8 /end MEASUREMENT
/begin MEASUREMENT ASMod_tDiffPipeEnvSlw_mp03 "Temperaturdifferenz zwischen Rohrwand und Umgebung" SWORD TempDiff_Kelv 1 100 -3276.800 3276.700 ECU_ADDRESS 0xC000B8CA /end MEASUREMENT
/begin MEASUREMENT ASMod_tDiffPipeEnv_mp00 "Temperaturdifferenz zwischen Rohrwand und Umgebung" SWORD TempDiff_Kelv 1 100 -3276.800 3276.700 ECU_ADDRESS 0xC000B7CA /end MEASUREMENT
/begin MEASUREMENT ASMod_tDiffPipeEnv_mp01 "Temperaturdifferenz zwischen Rohrwand und Umgebung" SWORD TempDiff_Kelv 1 100 -3276.800 3276.700 ECU_ADDRESS 0xC000B7CC /end MEASUREMENT
/begin MEASUREMENT ASMod_tDiffPipeEnv_mp02 "Temperaturdifferenz zwischen Rohrwand und Umgebung" SWORD TempDiff_Kelv 1 100 -3276.800 3276.700 ECU_ADDRESS 0xC000B7CE /end MEASUREMENT
/begin MEASUREMENT ASMod_tEGFld00 "Feld der Abgastemperaturen" SWORD Temp_Cels 1 100 -3549.940 3003.560 ECU_ADDRESS 0xD000050C /end MEASUREMENT
/begin MEASUREMENT ASMod_tEGFld01 "Feld der Abgastemperaturen" SWORD Temp_Cels 1 100 -3549.940 3003.560 ECU_ADDRESS 0xD000050E /end MEASUREMENT
/begin MEASUREMENT ASMod_tEGFld02 "Feld der Abgastemperaturen" SWORD Temp_Cels 1 100 -3549.940 3003.560 ECU_ADDRESS 0xD0000510 /end MEASUREMENT
/begin MEASUREMENT ASMod_tEGFld03 "Feld der Abgastemperaturen" SWORD Temp_Cels 1 100 -3549.940 3003.560 ECU_ADDRESS 0xD0000512 /end MEASUREMENT
/begin MEASUREMENT ASMod_tEGFld04 "Feld der Abgastemperaturen" SWORD Temp_Cels 1 100 -3549.940 3003.560 ECU_ADDRESS 0xD0000514 /end MEASUREMENT
/begin MEASUREMENT ASMod_tEGFld05 "Feld der Abgastemperaturen" SWORD Temp_Cels 1 100 -3549.940 3003.560 ECU_ADDRESS 0xD0000516 /end MEASUREMENT
/begin MEASUREMENT ASMod_tEGFld06 "Feld der Abgastemperaturen" SWORD Temp_Cels 1 100 -3549.940 3003.560 ECU_ADDRESS 0xD0000518 /end MEASUREMENT
/begin MEASUREMENT ASMod_tEGFld07 "Feld der Abgastemperaturen" SWORD Temp_Cels 1 100 -3549.940 3003.560 ECU_ADDRESS 0xD000051A /end MEASUREMENT
/begin MEASUREMENT ASMod_tEGFld08 "Feld der Abgastemperaturen" SWORD Temp_Cels 1 100 -3549.940 3003.560 ECU_ADDRESS 0xD000051C /end MEASUREMENT
/begin MEASUREMENT ASMod_tEGFld09 "Feld der Abgastemperaturen" SWORD Temp_Cels 1 100 -3549.940 3003.560 ECU_ADDRESS 0xD000051E /end MEASUREMENT
/begin MEASUREMENT ASMod_tEGFld10 "Feld der Abgastemperaturen" SWORD Temp_Cels 1 100 -3549.940 3003.560 ECU_ADDRESS 0xD0000520 /end MEASUREMENT
/begin MEASUREMENT ASMod_tEGFld11 "Feld der Abgastemperaturen" SWORD Temp_Cels 1 100 -3549.940 3003.560 ECU_ADDRESS 0xD0000522 /end MEASUREMENT
/begin MEASUREMENT ASMod_tEGFld12 "Feld der Abgastemperaturen" SWORD Temp_Cels 1 100 -3549.940 3003.560 ECU_ADDRESS 0xD0000524 /end MEASUREMENT
/begin MEASUREMENT ASMod_tEGFld13 "Feld der Abgastemperaturen" SWORD Temp_Cels 1 100 -3549.940 3003.560 ECU_ADDRESS 0xD0000526 /end MEASUREMENT
/begin MEASUREMENT ASMod_tEGPipeDs_mp00 "Abgastemperatur am Rohrausgang" SWORD Temp_Cels 1 100 -3549.940 3003.560 ECU_ADDRESS 0xC000B7D0 /end MEASUREMENT
/begin MEASUREMENT ASMod_tEGPipeDs_mp01 "Abgastemperatur am Rohrausgang" SWORD Temp_Cels 1 100 -3549.940 3003.560 ECU_ADDRESS 0xC000B7D2 /end MEASUREMENT
/begin MEASUREMENT ASMod_tEGPipeDs_mp02 "Abgastemperatur am Rohrausgang" SWORD Temp_Cels 1 100 -3549.940 3003.560 ECU_ADDRESS 0xC000B7D4 /end MEASUREMENT
/begin MEASUREMENT ASMod_tEGPipeSlwDs_mp00 "Abgastemperatur am Rohrausgang" SWORD Temp_Cels 1 100 -3549.940 3003.560 ECU_ADDRESS 0xC000B8CC /end MEASUREMENT
/begin MEASUREMENT ASMod_tEGPipeSlwDs_mp01 "Abgastemperatur am Rohrausgang" SWORD Temp_Cels 1 100 -3549.940 3003.560 ECU_ADDRESS 0xC000B8CE /end MEASUREMENT
/begin MEASUREMENT ASMod_tEGPipeSlwDs_mp02 "Abgastemperatur am Rohrausgang" SWORD Temp_Cels 1 100 -3549.940 3003.560 ECU_ADDRESS 0xC000B8D0 /end MEASUREMENT
/begin MEASUREMENT ASMod_tEGPipeSlwDs_mp03 "Abgastemperatur am Rohrausgang" SWORD Temp_Cels 1 100 -3549.940 3003.560 ECU_ADDRESS 0xC000B8D2 /end MEASUREMENT
/begin MEASUREMENT ASMod_tMidEGPipeSlw_mp00 "mittlere Temperatur zwischen Gas und Rohrwand" SWORD Temp_Cels 1 100 -3549.940 3003.560 ECU_ADDRESS 0xC000B8D4 /end MEASUREMENT
/begin MEASUREMENT ASMod_tMidEGPipeSlw_mp01 "mittlere Temperatur zwischen Gas und Rohrwand" SWORD Temp_Cels 1 100 -3549.940 3003.560 ECU_ADDRESS 0xC000B8D6 /end MEASUREMENT
/begin MEASUREMENT ASMod_tMidEGPipeSlw_mp02 "mittlere Temperatur zwischen Gas und Rohrwand" SWORD Temp_Cels 1 100 -3549.940 3003.560 ECU_ADDRESS 0xC000B8D8 /end MEASUREMENT
/begin MEASUREMENT ASMod_tMidEGPipeSlw_mp03 "mittlere Temperatur zwischen Gas und Rohrwand" SWORD Temp_Cels 1 100 -3549.940 3003.560 ECU_ADDRESS 0xC000B8DA /end MEASUREMENT
/begin MEASUREMENT ASMod_tMidEGPipe_mp00 "mittlere Temperatur zwischen Gas und Rohrwand" SWORD Temp_Cels 1 100 -3549.940 3003.560 ECU_ADDRESS 0xC000B7D6 /end MEASUREMENT
/begin MEASUREMENT ASMod_tMidEGPipe_mp01 "mittlere Temperatur zwischen Gas und Rohrwand" SWORD Temp_Cels 1 100 -3549.940 3003.560 ECU_ADDRESS 0xC000B7D8 /end MEASUREMENT
/begin MEASUREMENT ASMod_tMidEGPipe_mp02 "mittlere Temperatur zwischen Gas und Rohrwand" SWORD Temp_Cels 1 100 -3549.940 3003.560 ECU_ADDRESS 0xC000B7DA /end MEASUREMENT
/begin MEASUREMENT ASMod_tMidPipeEnvSlw_mp00 "mittlere Temperatur zwischen Rohrwand und Umgebung" SWORD Temp_Cels 1 100 -3549.940 3003.560 ECU_ADDRESS 0xC000B8DC /end MEASUREMENT
/begin MEASUREMENT ASMod_tMidPipeEnvSlw_mp01 "mittlere Temperatur zwischen Rohrwand und Umgebung" SWORD Temp_Cels 1 100 -3549.940 3003.560 ECU_ADDRESS 0xC000B8DE /end MEASUREMENT
/begin MEASUREMENT ASMod_tMidPipeEnvSlw_mp02 "mittlere Temperatur zwischen Rohrwand und Umgebung" SWORD Temp_Cels 1 100 -3549.940 3003.560 ECU_ADDRESS 0xC000B8E0 /end MEASUREMENT
/begin MEASUREMENT ASMod_tMidPipeEnvSlw_mp03 "mittlere Temperatur zwischen Rohrwand und Umgebung" SWORD Temp_Cels 1 100 -3549.940 3003.560 ECU_ADDRESS 0xC000B8E2 /end MEASUREMENT
/begin MEASUREMENT ASMod_tMidPipeEnv_mp00 "mittlere Temperatur zwischen Rohrwand und Umgebung" SWORD Temp_Cels 1 100 -3549.940 3003.560 ECU_ADDRESS 0xC000B7DC /end MEASUREMENT
/begin MEASUREMENT ASMod_tMidPipeEnv_mp01 "mittlere Temperatur zwischen Rohrwand und Umgebung" SWORD Temp_Cels 1 100 -3549.940 3003.560 ECU_ADDRESS 0xC000B7DE /end MEASUREMENT
/begin MEASUREMENT ASMod_tMidPipeEnv_mp02 "mittlere Temperatur zwischen Rohrwand und Umgebung" SWORD Temp_Cels 1 100 -3549.940 3003.560 ECU_ADDRESS 0xC000B7E0 /end MEASUREMENT
/begin MEASUREMENT ASMod_tNSCDs00 "Temperatur nach NSC" SWORD Temp_Cels 1 100 -3549.940 3003.560 ECU_ADDRESS 0xD000054A /end MEASUREMENT
/begin MEASUREMENT ASMod_tOxiCDiff00 "Temperaturdifferenz am Oxidationskatalysator" SWORD TempDiff_Kelv 1 100 -3276.800 3276.700 ECU_ADDRESS 0xD000054C /end MEASUREMENT
/begin MEASUREMENT ASMod_tOxiCDs00 "Temperatur nach Oxidationskatalysator" SWORD Temp_Cels 1 100 -3549.940 3003.560 ECU_ADDRESS 0xD000054E /end MEASUREMENT
/begin MEASUREMENT ASMod_tOxiCDsUnCor_mp00 "" SWORD TempDiff_Kelv 1 100 -3276.800 3276.700 ECU_ADDRESS 0xC000B730 /end MEASUREMENT
/begin MEASUREMENT ASMod_tOxiCStrt00 "Initialisierungstemperatur für OxiC-Modell bei Motorstart" SWORD Temp_Cels 1 100 -3549.940 3003.560 ECU_ADDRESS 0xD0000550 /end MEASUREMENT
/begin MEASUREMENT ASMod_tOxiCSurf00 "Oberflächentemperatur des OxiCat" SWORD Temp_Cels 1 100 -3549.940 3003.560 ECU_ADDRESS 0xD0000552 /end MEASUREMENT
/begin MEASUREMENT ASMod_tPipeStrt00 "Initialisierungstemperatur für Pipe-Modell bei Motorstart" SWORD Temp_Cels 1 100 -3549.940 3003.560 ECU_ADDRESS 0xD000055C /end MEASUREMENT
/begin MEASUREMENT ASMod_tPipeStrt01 "Initialisierungstemperatur für Pipe-Modell bei Motorstart" SWORD Temp_Cels 1 100 -3549.940 3003.560 ECU_ADDRESS 0xD000055E /end MEASUREMENT
/begin MEASUREMENT ASMod_tPipeStrt02 "Initialisierungstemperatur für Pipe-Modell bei Motorstart" SWORD Temp_Cels 1 100 -3549.940 3003.560 ECU_ADDRESS 0xD0000560 /end MEASUREMENT
/begin MEASUREMENT ASMod_tPipeStrt03 "Initialisierungstemperatur für Pipe-Modell bei Motorstart" SWORD Temp_Cels 1 100 -3549.940 3003.560 ECU_ADDRESS 0xD0000562 /end MEASUREMENT
/begin MEASUREMENT ASMod_tPipeStrt04 "Initialisierungstemperatur für Pipe-Modell bei Motorstart" SWORD Temp_Cels 1 100 -3549.940 3003.560 ECU_ADDRESS 0xD0000564 /end MEASUREMENT
/begin MEASUREMENT ASMod_tPipeStrt05 "Initialisierungstemperatur für Pipe-Modell bei Motorstart" SWORD Temp_Cels 1 100 -3549.940 3003.560 ECU_ADDRESS 0xD0000566 /end MEASUREMENT
/begin MEASUREMENT ASMod_tPipeStrt06 "Initialisierungstemperatur für Pipe-Modell bei Motorstart" SWORD Temp_Cels 1 100 -3549.940 3003.560 ECU_ADDRESS 0xD0000568 /end MEASUREMENT
/begin MEASUREMENT ASMod_tPipeStrt_mp00 "Initialisierungstemperatur für Pipe-Modell bei Motorstart" SWORD Temp_Cels 1 100 -3549.940 3003.560 ECU_ADDRESS 0xC000B90C /end MEASUREMENT
/begin MEASUREMENT ASMod_tPipeStrt_mp01 "Initialisierungstemperatur für Pipe-Modell bei Motorstart" SWORD Temp_Cels 1 100 -3549.940 3003.560 ECU_ADDRESS 0xC000B90E /end MEASUREMENT
/begin MEASUREMENT ASMod_tPipeStrt_mp02 "Initialisierungstemperatur für Pipe-Modell bei Motorstart" SWORD Temp_Cels 1 100 -3549.940 3003.560 ECU_ADDRESS 0xC000B910 /end MEASUREMENT
/begin MEASUREMENT ASMod_tPipeStrt_mp03 "Initialisierungstemperatur für Pipe-Modell bei Motorstart" SWORD Temp_Cels 1 100 -3549.940 3003.560 ECU_ADDRESS 0xC000B912 /end MEASUREMENT
/begin MEASUREMENT ASMod_tPipeStrt_mp04 "Initialisierungstemperatur für Pipe-Modell bei Motorstart" SWORD Temp_Cels 1 100 -3549.940 3003.560 ECU_ADDRESS 0xC000B914 /end MEASUREMENT
/begin MEASUREMENT ASMod_tPipeStrt_mp05 "Initialisierungstemperatur für Pipe-Modell bei Motorstart" SWORD Temp_Cels 1 100 -3549.940 3003.560 ECU_ADDRESS 0xC000B916 /end MEASUREMENT
/begin MEASUREMENT ASMod_tPipeStrt_mp06 "Initialisierungstemperatur für Pipe-Modell bei Motorstart" SWORD Temp_Cels 1 100 -3549.940 3003.560 ECU_ADDRESS 0xC000B918 /end MEASUREMENT
/begin MEASUREMENT ASMod_tShOffOxiC_mp00 "Abgastemperatur nach OxiC bei letztem Motorstop" SWORD Temp_Cels 1 100 -3549.940 3003.560 ECU_ADDRESS 0xC000B91A /end MEASUREMENT
/begin MEASUREMENT ASMod_tShOffPipe_mp00 "Rohrwandtemperatur bei letztem Motorstop" SWORD Temp_Cels 1 100 -3549.940 3003.560 ECU_ADDRESS 0xC000B91C /end MEASUREMENT
/begin MEASUREMENT ASMod_tShOffPipe_mp01 "Rohrwandtemperatur bei letztem Motorstop" SWORD Temp_Cels 1 100 -3549.940 3003.560 ECU_ADDRESS 0xC000B91E /end MEASUREMENT
/begin MEASUREMENT ASMod_tShOffPipe_mp02 "Rohrwandtemperatur bei letztem Motorstop" SWORD Temp_Cels 1 100 -3549.940 3003.560 ECU_ADDRESS 0xC000B920 /end MEASUREMENT
/begin MEASUREMENT ASMod_tShOffPipe_mp03 "Rohrwandtemperatur bei letztem Motorstop" SWORD Temp_Cels 1 100 -3549.940 3003.560 ECU_ADDRESS 0xC000B922 /end MEASUREMENT
/begin MEASUREMENT ASMod_tShOffPipe_mp04 "Rohrwandtemperatur bei letztem Motorstop" SWORD Temp_Cels 1 100 -3549.940 3003.560 ECU_ADDRESS 0xC000B924 /end MEASUREMENT
/begin MEASUREMENT ASMod_tShOffPipe_mp05 "Rohrwandtemperatur bei letztem Motorstop" SWORD Temp_Cels 1 100 -3549.940 3003.560 ECU_ADDRESS 0xC000B926 /end MEASUREMENT
/begin MEASUREMENT ASMod_tShOffPipe_mp06 "Rohrwandtemperatur bei letztem Motorstop" SWORD Temp_Cels 1 100 -3549.940 3003.560 ECU_ADDRESS 0xC000B928 /end MEASUREMENT
/begin MEASUREMENT ASMod_tWallFld00 "Feld der Rohrwand-Temperaturen" SWORD Temp_Cels 1 100 -3549.940 3003.560 ECU_ADDRESS 0xD0000570 /end MEASUREMENT
/begin MEASUREMENT ASMod_tWallFld01 "Feld der Rohrwand-Temperaturen" SWORD Temp_Cels 1 100 -3549.940 3003.560 ECU_ADDRESS 0xD0000572 /end MEASUREMENT
/begin MEASUREMENT ASMod_tWallFld02 "Feld der Rohrwand-Temperaturen" SWORD Temp_Cels 1 100 -3549.940 3003.560 ECU_ADDRESS 0xD0000574 /end MEASUREMENT
/begin MEASUREMENT ASMod_tWallFld03 "Feld der Rohrwand-Temperaturen" SWORD Temp_Cels 1 100 -3549.940 3003.560 ECU_ADDRESS 0xD0000576 /end MEASUREMENT
/begin MEASUREMENT ASMod_tWallFld04 "Feld der Rohrwand-Temperaturen" SWORD Temp_Cels 1 100 -3549.940 3003.560 ECU_ADDRESS 0xD0000578 /end MEASUREMENT
/begin MEASUREMENT ASMod_tWallFld05 "Feld der Rohrwand-Temperaturen" SWORD Temp_Cels 1 100 -3549.940 3003.560 ECU_ADDRESS 0xD000057A /end MEASUREMENT
/begin MEASUREMENT ASMod_tWallFld06 "Feld der Rohrwand-Temperaturen" SWORD Temp_Cels 1 100 -3549.940 3003.560 ECU_ADDRESS 0xD000057C /end MEASUREMENT
/begin MEASUREMENT ASMod_tWallPipeSlw_mp00 "Rohrwandtemperatur" SWORD Temp_Cels 1 100 -3549.940 3003.560 ECU_ADDRESS 0xC000B8E4 /end MEASUREMENT
/begin MEASUREMENT ASMod_tWallPipeSlw_mp01 "Rohrwandtemperatur" SWORD Temp_Cels 1 100 -3549.940 3003.560 ECU_ADDRESS 0xC000B8E6 /end MEASUREMENT
/begin MEASUREMENT ASMod_tWallPipeSlw_mp02 "Rohrwandtemperatur" SWORD Temp_Cels 1 100 -3549.940 3003.560 ECU_ADDRESS 0xC000B8E8 /end MEASUREMENT
/begin MEASUREMENT ASMod_tWallPipeSlw_mp03 "Rohrwandtemperatur" SWORD Temp_Cels 1 100 -3549.940 3003.560 ECU_ADDRESS 0xC000B8EA /end MEASUREMENT
/begin MEASUREMENT ASMod_tWallPipe_mp00 "Rohrwandtemperatur" SWORD Temp_Cels 1 100 -3549.940 3003.560 ECU_ADDRESS 0xC000B7E2 /end MEASUREMENT
/begin MEASUREMENT ASMod_tWallPipe_mp01 "Rohrwandtemperatur" SWORD Temp_Cels 1 100 -3549.940 3003.560 ECU_ADDRESS 0xC000B7E4 /end MEASUREMENT
/begin MEASUREMENT ASMod_tWallPipe_mp02 "Rohrwandtemperatur" SWORD Temp_Cels 1 100 -3549.940 3003.560 ECU_ADDRESS 0xC000B7E6 /end MEASUREMENT
/begin MEASUREMENT ASMod_vscDynPipeSlw_mp00 "dynamische Viskosität des Gases im Rohr" SWORD Fact 1 100 -4.000000 3.999878 ECU_ADDRESS 0xC000B8EC /end MEASUREMENT
/begin MEASUREMENT ASMod_vscDynPipeSlw_mp01 "dynamische Viskosität des Gases im Rohr" SWORD Fact 1 100 -4.000000 3.999878 ECU_ADDRESS 0xC000B8EE /end MEASUREMENT
/begin MEASUREMENT ASMod_vscDynPipeSlw_mp02 "dynamische Viskosität des Gases im Rohr" SWORD Fact 1 100 -4.000000 3.999878 ECU_ADDRESS 0xC000B8F0 /end MEASUREMENT
/begin MEASUREMENT ASMod_vscDynPipeSlw_mp03 "dynamische Viskosität des Gases im Rohr" SWORD Fact 1 100 -4.000000 3.999878 ECU_ADDRESS 0xC000B8F2 /end MEASUREMENT
/begin MEASUREMENT ASMod_vscDynPipe_mp00 "dynamische Viskosität des Gases im Rohr" SWORD Fact 1 100 -4.000000 3.999878 ECU_ADDRESS 0xC000B7E8 /end MEASUREMENT
/begin MEASUREMENT ASMod_vscDynPipe_mp01 "dynamische Viskosität des Gases im Rohr" SWORD Fact 1 100 -4.000000 3.999878 ECU_ADDRESS 0xC000B7EA /end MEASUREMENT
/begin MEASUREMENT ASMod_vscDynPipe_mp02 "dynamische Viskosität des Gases im Rohr" SWORD Fact 1 100 -4.000000 3.999878 ECU_ADDRESS 0xC000B7EC /end MEASUREMENT
/begin MEASUREMENT ASMod_vscKinPipeSlw_mp00 "kinematische Viskosität des Gases im Rohr" SWORD Fact8 1 100 -0.0003276800 0.0003276700 FORMAT "%12.10" ECU_ADDRESS 0xC000B8F4 /end MEASUREMENT
/begin MEASUREMENT ASMod_vscKinPipeSlw_mp01 "kinematische Viskosität des Gases im Rohr" SWORD Fact8 1 100 -0.0003276800 0.0003276700 FORMAT "%12.10" ECU_ADDRESS 0xC000B8F6 /end MEASUREMENT
/begin MEASUREMENT ASMod_vscKinPipeSlw_mp02 "kinematische Viskosität des Gases im Rohr" SWORD Fact8 1 100 -0.0003276800 0.0003276700 FORMAT "%12.10" ECU_ADDRESS 0xC000B8F8 /end MEASUREMENT
/begin MEASUREMENT ASMod_vscKinPipeSlw_mp03 "kinematische Viskosität des Gases im Rohr" SWORD Fact8 1 100 -0.0003276800 0.0003276700 FORMAT "%12.10" ECU_ADDRESS 0xC000B8FA /end MEASUREMENT
/begin MEASUREMENT ASMod_vscKinPipe_mp00 "kinematische Viskosität des Gases im Rohr" SWORD Fact8 1 100 -0.0003276800 0.0003276700 FORMAT "%12.10" ECU_ADDRESS 0xC000B7EE /end MEASUREMENT
/begin MEASUREMENT ASMod_vscKinPipe_mp01 "kinematische Viskosität des Gases im Rohr" SWORD Fact8 1 100 -0.0003276800 0.0003276700 FORMAT "%12.10" ECU_ADDRESS 0xC000B7F0 /end MEASUREMENT
/begin MEASUREMENT ASMod_vscKinPipe_mp02 "kinematische Viskosität des Gases im Rohr" SWORD Fact8 1 100 -0.0003276800 0.0003276700 FORMAT "%12.10" ECU_ADDRESS 0xC000B7F2 /end MEASUREMENT
/begin MEASUREMENT BattuEcu_stIbs00 "" UBYTE OneToOne 1 100 0.00 255.0 ECU_ADDRESS 0xD0001C18 /end MEASUREMENT
/begin MEASUREMENT BattuEcu_stIbs01 "" UBYTE OneToOne 1 100 0.00 255.0 ECU_ADDRESS 0xD0001C19 /end MEASUREMENT
/begin MEASUREMENT BattuEcu_stIbs02 "" UBYTE OneToOne 1 100 0.00 255.0 ECU_ADDRESS 0xD0001C1A /end MEASUREMENT
/begin MEASUREMENT BattuEcu_stInfoDiag00 "" UBYTE OneToOne 1 100 0.00 255.0 ECU_ADDRESS 0xD0001C1B /end MEASUREMENT
/begin MEASUREMENT BattuEcu_stInfoDiag01 "" UBYTE OneToOne 1 100 0.00 255.0 ECU_ADDRESS 0xD0001C1C /end MEASUREMENT
/begin MEASUREMENT BattuEcu_stInfoDiag02 "" UBYTE OneToOne 1 100 0.00 255.0 ECU_ADDRESS 0xD0001C1D /end MEASUREMENT
/begin MEASUREMENT BattuEcu_stInfoDiag03 "" UBYTE OneToOne 1 100 0.00 255.0 ECU_ADDRESS 0xD0001C1E /end MEASUREMENT
/begin MEASUREMENT CmbChb_ctMifBuf1_mp00 "Meßpunkt für die Erkennung der Fehlzündungen der einzelnen Zylinder, Puffer1" SWORD OneToOne 1 100 -32768.00 32767.00 ECU_ADDRESS 0xC000B92A /end MEASUREMENT
/begin MEASUREMENT CmbChb_ctMifBuf1_mp01 "Meßpunkt für die Erkennung der Fehlzündungen der einzelnen Zylinder, Puffer1" SWORD OneToOne 1 100 -32768.00 32767.00 ECU_ADDRESS 0xC000B92C /end MEASUREMENT
/begin MEASUREMENT CmbChb_ctMifBuf1_mp02 "Meßpunkt für die Erkennung der Fehlzündungen der einzelnen Zylinder, Puffer1" SWORD OneToOne 1 100 -32768.00 32767.00 ECU_ADDRESS 0xC000B92E /end MEASUREMENT
/begin MEASUREMENT CmbChb_ctMifBuf1_mp03 "Meßpunkt für die Erkennung der Fehlzündungen der einzelnen Zylinder, Puffer1" SWORD OneToOne 1 100 -32768.00 32767.00 ECU_ADDRESS 0xC000B930 /end MEASUREMENT
/begin MEASUREMENT CmbChb_ctMifBuf1_mp04 "Meßpunkt für die Erkennung der Fehlzündungen der einzelnen Zylinder, Puffer1" SWORD OneToOne 1 100 -32768.00 32767.00 ECU_ADDRESS 0xC000B932 /end MEASUREMENT
/begin MEASUREMENT CmbChb_ctMifBuf1_mp05 "Meßpunkt für die Erkennung der Fehlzündungen der einzelnen Zylinder, Puffer1" SWORD OneToOne 1 100 -32768.00 32767.00 ECU_ADDRESS 0xC000B934 /end MEASUREMENT
/begin MEASUREMENT CmbChb_ctMifBuf1_mp06 "Meßpunkt für die Erkennung der Fehlzündungen der einzelnen Zylinder, Puffer1" SWORD OneToOne 1 100 -32768.00 32767.00 ECU_ADDRESS 0xC000B936 /end MEASUREMENT
/begin MEASUREMENT CmbChb_ctMifBuf2_mp00 "Meßpunkt für die Erkennung der Fehlzündungen der einzelnen Zylinder, Puffer2" SWORD OneToOne 1 100 -32768.00 32767.00 ECU_ADDRESS 0xC000B938 /end MEASUREMENT
/begin MEASUREMENT CmbChb_ctMifBuf2_mp01 "Meßpunkt für die Erkennung der Fehlzündungen der einzelnen Zylinder, Puffer2" SWORD OneToOne 1 100 -32768.00 32767.00 ECU_ADDRESS 0xC000B93A /end MEASUREMENT
/begin MEASUREMENT CmbChb_ctMifBuf2_mp02 "Meßpunkt für die Erkennung der Fehlzündungen der einzelnen Zylinder, Puffer2" SWORD OneToOne 1 100 -32768.00 32767.00 ECU_ADDRESS 0xC000B93C /end MEASUREMENT
/begin MEASUREMENT CmbChb_ctMifBuf2_mp03 "Meßpunkt für die Erkennung der Fehlzündungen der einzelnen Zylinder, Puffer2" SWORD OneToOne 1 100 -32768.00 32767.00 ECU_ADDRESS 0xC000B93E /end MEASUREMENT
/begin MEASUREMENT CmbChb_ctMifBuf2_mp04 "Meßpunkt für die Erkennung der Fehlzündungen der einzelnen Zylinder, Puffer2" SWORD OneToOne 1 100 -32768.00 32767.00 ECU_ADDRESS 0xC000B940 /end MEASUREMENT
/begin MEASUREMENT CmbChb_ctMifBuf2_mp05 "Meßpunkt für die Erkennung der Fehlzündungen der einzelnen Zylinder, Puffer2" SWORD OneToOne 1 100 -32768.00 32767.00 ECU_ADDRESS 0xC000B942 /end MEASUREMENT
/begin MEASUREMENT CmbChb_ctMifBuf2_mp06 "Meßpunkt für die Erkennung der Fehlzündungen der einzelnen Zylinder, Puffer2" SWORD OneToOne 1 100 -32768.00 32767.00 ECU_ADDRESS 0xC000B944 /end MEASUREMENT
/begin MEASUREMENT CmbChb_ctMifMem_mp00 "Meßpunkt für die Erkennung der Fehlzündungen der einzelnen Zylinder, Logging Speicher" SWORD OneToOne 1 100 -32768.00 32767.00 ECU_ADDRESS 0xC000B946 /end MEASUREMENT
/begin MEASUREMENT CmbChb_ctMifMem_mp01 "Meßpunkt für die Erkennung der Fehlzündungen der einzelnen Zylinder, Logging Speicher" SWORD OneToOne 1 100 -32768.00 32767.00 ECU_ADDRESS 0xC000B948 /end MEASUREMENT
/begin MEASUREMENT CmbChb_ctMifMem_mp02 "Meßpunkt für die Erkennung der Fehlzündungen der einzelnen Zylinder, Logging Speicher" SWORD OneToOne 1 100 -32768.00 32767.00 ECU_ADDRESS 0xC000B94A /end MEASUREMENT
/begin MEASUREMENT CmbChb_ctMifMem_mp03 "Meßpunkt für die Erkennung der Fehlzündungen der einzelnen Zylinder, Logging Speicher" SWORD OneToOne 1 100 -32768.00 32767.00 ECU_ADDRESS 0xC000B94C /end MEASUREMENT
/begin MEASUREMENT CmbChb_ctMifMem_mp04 "Meßpunkt für die Erkennung der Fehlzündungen der einzelnen Zylinder, Logging Speicher" SWORD OneToOne 1 100 -32768.00 32767.00 ECU_ADDRESS 0xC000B94E /end MEASUREMENT
/begin MEASUREMENT CmbChb_ctMifMem_mp05 "Meßpunkt für die Erkennung der Fehlzündungen der einzelnen Zylinder, Logging Speicher" SWORD OneToOne 1 100 -32768.00 32767.00 ECU_ADDRESS 0xC000B950 /end MEASUREMENT
/begin MEASUREMENT CmbChb_ctMifMem_mp06 "Meßpunkt für die Erkennung der Fehlzündungen der einzelnen Zylinder, Logging Speicher" SWORD OneToOne 1 100 -32768.00 32767.00 ECU_ADDRESS 0xC000B952 /end MEASUREMENT
/begin MEASUREMENT CoEOM_stOpModeItm00 "Array mit den eingesammelten Betriebsartenwünschen" ULONG OneToOne 1 100 0.00 4294967295.00 ECU_ADDRESS 0xD00030C0 /end MEASUREMENT
/begin MEASUREMENT CoEOM_stOpModeItm01 "Array mit den eingesammelten Betriebsartenwünschen" ULONG OneToOne 1 100 0.00 4294967295.00 ECU_ADDRESS 0xD00030C4 /end MEASUREMENT
/begin MEASUREMENT CoEOM_stOpModeItm02 "Array mit den eingesammelten Betriebsartenwünschen" ULONG OneToOne 1 100 0.00 4294967295.00 ECU_ADDRESS 0xD00030C8 /end MEASUREMENT
/begin MEASUREMENT CoEOM_stOpModeItm03 "Array mit den eingesammelten Betriebsartenwünschen" ULONG OneToOne 1 100 0.00 4294967295.00 ECU_ADDRESS 0xD00030CC /end MEASUREMENT
/begin MEASUREMENT CoEOM_stOpModeItm04 "Array mit den eingesammelten Betriebsartenwünschen" ULONG OneToOne 1 100 0.00 4294967295.00 ECU_ADDRESS 0xD00030D0 /end MEASUREMENT
/begin MEASUREMENT CoEOM_stOpModeItm05 "Array mit den eingesammelten Betriebsartenwünschen" ULONG OneToOne 1 100 0.00 4294967295.00 ECU_ADDRESS 0xD00030D4 /end MEASUREMENT
/begin MEASUREMENT CoEOM_stOpModeSort00 "Array mit den sortierten Betriebsartenwünschen" ULONG OneToOne 1 100 0.00 4294967295.00 ECU_ADDRESS 0xD00030E4 /end MEASUREMENT
/begin MEASUREMENT CoEOM_stOpModeSort01 "Array mit den sortierten Betriebsartenwünschen" ULONG OneToOne 1 100 0.00 4294967295.00 ECU_ADDRESS 0xD00030E8 /end MEASUREMENT
/begin MEASUREMENT CoEOM_stOpModeSort02 "Array mit den sortierten Betriebsartenwünschen" ULONG OneToOne 1 100 0.00 4294967295.00 ECU_ADDRESS 0xD00030EC /end MEASUREMENT
/begin MEASUREMENT CoEOM_stOpModeSort03 "Array mit den sortierten Betriebsartenwünschen" ULONG OneToOne 1 100 0.00 4294967295.00 ECU_ADDRESS 0xD00030F0 /end MEASUREMENT
/begin MEASUREMENT CoEOM_stOpModeSort04 "Array mit den sortierten Betriebsartenwünschen" ULONG OneToOne 1 100 0.00 4294967295.00 ECU_ADDRESS 0xD00030F4 /end MEASUREMENT
/begin MEASUREMENT CoEOM_tiRmpDem00 "Array mit den eingesammelten Rampen-Laufzeiten" SWORD TimeCoEOMRmp 1 100 0.0020000610370 65.536000000 FORMAT "%12.9" ECU_ADDRESS 0xD00006B6 /end MEASUREMENT
/begin MEASUREMENT CoEOM_tiRmpDem01 "Array mit den eingesammelten Rampen-Laufzeiten" SWORD TimeCoEOMRmp 1 100 0.0020000610370 65.536000000 FORMAT "%12.9" ECU_ADDRESS 0xD00006B8 /end MEASUREMENT
/begin MEASUREMENT CoEOM_tiRmpDem02 "Array mit den eingesammelten Rampen-Laufzeiten" SWORD TimeCoEOMRmp 1 100 0.0020000610370 65.536000000 FORMAT "%12.9" ECU_ADDRESS 0xD00006BA /end MEASUREMENT
/begin MEASUREMENT CoEOM_tiRmpDem03 "Array mit den eingesammelten Rampen-Laufzeiten" SWORD TimeCoEOMRmp 1 100 0.0020000610370 65.536000000 FORMAT "%12.9" ECU_ADDRESS 0xD00006BC /end MEASUREMENT
/begin MEASUREMENT CoEOM_tiRmpDem04 "Array mit den eingesammelten Rampen-Laufzeiten" SWORD TimeCoEOMRmp 1 100 0.0020000610370 65.536000000 FORMAT "%12.9" ECU_ADDRESS 0xD00006BE /end MEASUREMENT
/begin MEASUREMENT Com_RawMuxVal_mp00 "" UBYTE OneToOne 1 100 0.00 255.0 ECU_ADDRESS 0xC000BE14 /end MEASUREMENT
/begin MEASUREMENT Com_RawMuxVal_mp01 "" UBYTE OneToOne 1 100 0.00 255.0 ECU_ADDRESS 0xC000BE15 /end MEASUREMENT
/begin MEASUREMENT Com_RawMuxVal_mp02 "" UBYTE OneToOne 1 100 0.00 255.0 ECU_ADDRESS 0xC000BE16 /end MEASUREMENT
/begin MEASUREMENT Com_RawMuxVal_mp03 "" UBYTE OneToOne 1 100 0.00 255.0 ECU_ADDRESS 0xC000BE17 /end MEASUREMENT
/begin MEASUREMENT Com_RawMuxVal_mp04 "" UBYTE OneToOne 1 100 0.00 255.0 ECU_ADDRESS 0xC000BE18 /end MEASUREMENT
/begin MEASUREMENT Com_RawMuxVal_mp05 "" UBYTE OneToOne 1 100 0.00 255.0 ECU_ADDRESS 0xC000BE19 /end MEASUREMENT
/begin MEASUREMENT Com_RawMuxVal_mp06 "" UBYTE OneToOne 1 100 0.00 255.0 ECU_ADDRESS 0xC000BE1A /end MEASUREMENT
/begin MEASUREMENT Com_RawMuxVal_mp07 "" UBYTE OneToOne 1 100 0.00 255.0 ECU_ADDRESS 0xC000BE1B /end MEASUREMENT
/begin MEASUREMENT Com_RawValA_mp00 "" UBYTE OneToOne 1 100 0.00 255.0 ECU_ADDRESS 0xC000BE1C /end MEASUREMENT
/begin MEASUREMENT Com_RawValA_mp01 "" UBYTE OneToOne 1 100 0.00 255.0 ECU_ADDRESS 0xC000BE1D /end MEASUREMENT
/begin MEASUREMENT Com_RawValA_mp02 "" UBYTE OneToOne 1 100 0.00 255.0 ECU_ADDRESS 0xC000BE1E /end MEASUREMENT
/begin MEASUREMENT Com_RawValA_mp03 "" UBYTE OneToOne 1 100 0.00 255.0 ECU_ADDRESS 0xC000BE1F /end MEASUREMENT
/begin MEASUREMENT Com_RawValA_mp04 "" UBYTE OneToOne 1 100 0.00 255.0 ECU_ADDRESS 0xC000BE20 /end MEASUREMENT
/begin MEASUREMENT Com_RawValA_mp05 "" UBYTE OneToOne 1 100 0.00 255.0 ECU_ADDRESS 0xC000BE21 /end MEASUREMENT
/begin MEASUREMENT Com_RawValA_mp06 "" UBYTE OneToOne 1 100 0.00 255.0 ECU_ADDRESS 0xC000BE22 /end MEASUREMENT
/begin MEASUREMENT Com_RawValA_mp07 "" UBYTE OneToOne 1 100 0.00 255.0 ECU_ADDRESS 0xC000BE23 /end MEASUREMENT
/begin MEASUREMENT Com_RawValB_mp00 "" UBYTE OneToOne 1 100 0.00 255.0 ECU_ADDRESS 0xC000BE24 /end MEASUREMENT
/begin MEASUREMENT Com_RawValB_mp01 "" UBYTE OneToOne 1 100 0.00 255.0 ECU_ADDRESS 0xC000BE25 /end MEASUREMENT
/begin MEASUREMENT Com_RawValB_mp02 "" UBYTE OneToOne 1 100 0.00 255.0 ECU_ADDRESS 0xC000BE26 /end MEASUREMENT
/begin MEASUREMENT Com_RawValB_mp03 "" UBYTE OneToOne 1 100 0.00 255.0 ECU_ADDRESS 0xC000BE27 /end MEASUREMENT
/begin MEASUREMENT Com_RawValB_mp04 "" UBYTE OneToOne 1 100 0.00 255.0 ECU_ADDRESS 0xC000BE28 /end MEASUREMENT
/begin MEASUREMENT Com_RawValB_mp05 "" UBYTE OneToOne 1 100 0.00 255.0 ECU_ADDRESS 0xC000BE29 /end MEASUREMENT
/begin MEASUREMENT Com_RawValB_mp06 "" UBYTE OneToOne 1 100 0.00 255.0 ECU_ADDRESS 0xC000BE2A /end MEASUREMENT
/begin MEASUREMENT Com_RawValB_mp07 "" UBYTE OneToOne 1 100 0.00 255.0 ECU_ADDRESS 0xC000BE2B /end MEASUREMENT
/begin MEASUREMENT Com_RawValC_mp00 "" UBYTE OneToOne 1 100 0.00 255.0 ECU_ADDRESS 0xC000BE2C /end MEASUREMENT
/begin MEASUREMENT Com_RawValC_mp01 "" UBYTE OneToOne 1 100 0.00 255.0 ECU_ADDRESS 0xC000BE2D /end MEASUREMENT
/begin MEASUREMENT Com_RawValC_mp02 "" UBYTE OneToOne 1 100 0.00 255.0 ECU_ADDRESS 0xC000BE2E /end MEASUREMENT
/begin MEASUREMENT Com_RawValC_mp03 "" UBYTE OneToOne 1 100 0.00 255.0 ECU_ADDRESS 0xC000BE2F /end MEASUREMENT
/begin MEASUREMENT Com_RawValC_mp04 "" UBYTE OneToOne 1 100 0.00 255.0 ECU_ADDRESS 0xC000BE30 /end MEASUREMENT
/begin MEASUREMENT Com_RawValC_mp05 "" UBYTE OneToOne 1 100 0.00 255.0 ECU_ADDRESS 0xC000BE31 /end MEASUREMENT
/begin MEASUREMENT Com_RawValC_mp06 "" UBYTE OneToOne 1 100 0.00 255.0 ECU_ADDRESS 0xC000BE32 /end MEASUREMENT
/begin MEASUREMENT Com_RawValC_mp07 "" UBYTE OneToOne 1 100 0.00 255.0 ECU_ADDRESS 0xC000BE33 /end MEASUREMENT
/begin MEASUREMENT Com_RawValD_mp00 "" UBYTE OneToOne 1 100 0.00 255.0 ECU_ADDRESS 0xC000BE34 /end MEASUREMENT
/begin MEASUREMENT Com_RawValD_mp01 "" UBYTE OneToOne 1 100 0.00 255.0 ECU_ADDRESS 0xC000BE35 /end MEASUREMENT
/begin MEASUREMENT Com_RawValD_mp02 "" UBYTE OneToOne 1 100 0.00 255.0 ECU_ADDRESS 0xC000BE36 /end MEASUREMENT
/begin MEASUREMENT Com_RawValD_mp03 "" UBYTE OneToOne 1 100 0.00 255.0 ECU_ADDRESS 0xC000BE37 /end MEASUREMENT
/begin MEASUREMENT Com_RawValD_mp04 "" UBYTE OneToOne 1 100 0.00 255.0 ECU_ADDRESS 0xC000BE38 /end MEASUREMENT
/begin MEASUREMENT Com_RawValD_mp05 "" UBYTE OneToOne 1 100 0.00 255.0 ECU_ADDRESS 0xC000BE39 /end MEASUREMENT
/begin MEASUREMENT Com_RawValD_mp06 "" UBYTE OneToOne 1 100 0.00 255.0 ECU_ADDRESS 0xC000BE3A /end MEASUREMENT
/begin MEASUREMENT Com_RawValD_mp07 "" UBYTE OneToOne 1 100 0.00 255.0 ECU_ADDRESS 0xC000BE3B /end MEASUREMENT
/begin MEASUREMENT Com_stDrvDynQl "" UBYTE OneToOne 1 100 0.00 255.0 ECU_ADDRESS 0xD0001D02 /end MEASUREMENT
/begin MEASUREMENT DewDet_ctCldStrtLSU_mp00 "Zähler für wiederholte Kaltstarts" UBYTE OneToOne 1 100 0.00 255.0 ECU_ADDRESS 0xC000B954 /end MEASUREMENT
/begin MEASUREMENT DewDet_ctCldStrtLSU_mp01 "Zähler für wiederholte Kaltstarts" UBYTE OneToOne 1 100 0.00 255.0 ECU_ADDRESS 0xC000B955 /end MEASUREMENT
/begin MEASUREMENT DewDet_ctPlsLSUSrvTst_mp00 "Anzahl der gültigen Gasstöße im Servicetest-Modus" UBYTE OneToOne 1 100 0.00 255.0 ECU_ADDRESS 0xC000B956 /end MEASUREMENT
/begin MEASUREMENT DewDet_ctPlsLSUSrvTst_mp01 "Anzahl der gültigen Gasstöße im Servicetest-Modus" UBYTE OneToOne 1 100 0.00 255.0 ECU_ADDRESS 0xC000B957 /end MEASUREMENT
/begin MEASUREMENT DewDet_dwLSU_mp00 "Abgaswärmestrom an Sondenposition" SWORD Pwr_kW_Sec 1 100 -327.6800 327.6700 FORMAT "%8.4" ECU_ADDRESS 0xC000B958 /end MEASUREMENT
/begin MEASUREMENT DewDet_dwLSU_mp01 "Abgaswärmestrom an Sondenposition" SWORD Pwr_kW_Sec 1 100 -327.6800 327.6700 FORMAT "%8.4" ECU_ADDRESS 0xC000B95A /end MEASUREMENT
/begin MEASUREMENT DewDet_stHtgLSU00 "Statusbit Freigabe Sensor-Heizung" UBYTE OneToOne 1 100 0.00 255.0 ECU_ADDRESS 0xD0001DD4 /end MEASUREMENT
/begin MEASUREMENT DewDet_stHtgLSU01 "Statusbit Freigabe Sensor-Heizung" UBYTE OneToOne 1 100 0.00 255.0 ECU_ADDRESS 0xD0001DD5 /end MEASUREMENT
/begin MEASUREMENT DewDet_stHtgLSULstTrp_mp00 "Status der Taupunktfreigabe des letzten Fahrzyklus" UBYTE OneToOne 1 100 0.00 255.0 ECU_ADDRESS 0xC000B95C /end MEASUREMENT
/begin MEASUREMENT DewDet_stHtgLSULstTrp_mp01 "Status der Taupunktfreigabe des letzten Fahrzyklus" UBYTE OneToOne 1 100 0.00 255.0 ECU_ADDRESS 0xC000B95D /end MEASUREMENT
/begin MEASUREMENT DewDet_stHtgThresLSUHit_mp00 "Status für Überschreiten des Wärmemengenschwellwertes" UBYTE OneToOne 1 100 0.00 255.0 ECU_ADDRESS 0xC000B95E /end MEASUREMENT
/begin MEASUREMENT DewDet_stHtgThresLSUHit_mp01 "Status für Überschreiten des Wärmemengenschwellwertes" UBYTE OneToOne 1 100 0.00 255.0 ECU_ADDRESS 0xC000B95F /end MEASUREMENT
/begin MEASUREMENT DewDet_stIntegIni_mp00 "Status Integrator Initialisierung" UBYTE OneToOne 1 100 0.00 255.0 ECU_ADDRESS 0xC000B960 /end MEASUREMENT
/begin MEASUREMENT DewDet_stIntegIni_mp01 "Status Integrator Initialisierung" UBYTE OneToOne 1 100 0.00 255.0 ECU_ADDRESS 0xC000B961 /end MEASUREMENT
/begin MEASUREMENT DewDet_stPlsLSU_mp00 "Status-Bit gültiger Gasstösse" UBYTE OneToOne 1 100 0.00 255.0 ECU_ADDRESS 0xC000B962 /end MEASUREMENT
/begin MEASUREMENT DewDet_stPlsLSU_mp01 "Status-Bit gültiger Gasstösse" UBYTE OneToOne 1 100 0.00 255.0 ECU_ADDRESS 0xC000B963 /end MEASUREMENT
/begin MEASUREMENT DewDet_tEG_mp00 "Gewählte Abgastemperatur am jeweiligen Sondeneinbauort" SWORD Temp_Cels 1 100 -3549.940 3003.560 ECU_ADDRESS 0xC000B964 /end MEASUREMENT
/begin MEASUREMENT DewDet_tEG_mp01 "Gewählte Abgastemperatur am jeweiligen Sondeneinbauort" SWORD Temp_Cels 1 100 -3549.940 3003.560 ECU_ADDRESS 0xC000B966 /end MEASUREMENT
/begin MEASUREMENT DewDet_tWall_mp00 "Gewählte Rohrwandtemperatur am jeweiligen Sondeneinbauort" SWORD Temp_Cels 1 100 -3549.940 3003.560 ECU_ADDRESS 0xC000B968 /end MEASUREMENT
/begin MEASUREMENT DewDet_tWall_mp01 "Gewählte Rohrwandtemperatur am jeweiligen Sondeneinbauort" SWORD Temp_Cels 1 100 -3549.940 3003.560 ECU_ADDRESS 0xC000B96A /end MEASUREMENT
/begin MEASUREMENT DewDet_wLSU_mp00 "integrierte Wärmemenge an Sensor-Position." SWORD Energy 1 100 -32768.00 32767.00 FORMAT "%8.2" ECU_ADDRESS 0xC000B96C /end MEASUREMENT
/begin MEASUREMENT DewDet_wLSU_mp01 "integrierte Wärmemenge an Sensor-Position." SWORD Energy 1 100 -32768.00 32767.00 FORMAT "%8.2" ECU_ADDRESS 0xC000B96E /end MEASUREMENT
/begin MEASUREMENT DewDet_wThresLSUAct_mp00 "aktueller Wärmeschwellwert an Sensorposition." SWORD Energy 1 100 -32768.00 32767.00 FORMAT "%8.2" ECU_ADDRESS 0xC000B970 /end MEASUREMENT
/begin MEASUREMENT DewDet_wThresLSUAct_mp01 "aktueller Wärmeschwellwert an Sensorposition." SWORD Energy 1 100 -32768.00 32767.00 FORMAT "%8.2" ECU_ADDRESS 0xC000B972 /end MEASUREMENT
/begin MEASUREMENT DewDet_wThresLSUNoPls_mp00 "Wärmeschwelle ohne gültigen Gasstoss." SWORD Energy 1 100 -32768.00 32767.00 FORMAT "%8.2" ECU_ADDRESS 0xC000B974 /end MEASUREMENT
/begin MEASUREMENT DewDet_wThresLSUNoPls_mp01 "Wärmeschwelle ohne gültigen Gasstoss." SWORD Energy 1 100 -32768.00 32767.00 FORMAT "%8.2" ECU_ADDRESS 0xC000B976 /end MEASUREMENT
/begin MEASUREMENT DewDet_wThresLSUPls_mp00 "Hitzeschwelle für gültigen Gaspuls" SWORD Energy 1 100 -32768.00 32767.00 FORMAT "%8.2" ECU_ADDRESS 0xC000B978 /end MEASUREMENT
/begin MEASUREMENT DewDet_wThresLSUPls_mp01 "Hitzeschwelle für gültigen Gaspuls" SWORD Energy 1 100 -32768.00 32767.00 FORMAT "%8.2" ECU_ADDRESS 0xC000B97A /end MEASUREMENT
/begin MEASUREMENT DewDet_wThresLSU_mp00 "Schwellwert Wärmemenge" SWORD Energy 1 100 -32768.00 32767.00 FORMAT "%8.2" ECU_ADDRESS 0xC000B97C /end MEASUREMENT
/begin MEASUREMENT DewDet_wThresLSU_mp01 "Schwellwert Wärmemenge" SWORD Energy 1 100 -32768.00 32767.00 FORMAT "%8.2" ECU_ADDRESS 0xC000B97E /end MEASUREMENT
/begin MEASUREMENT DFC_stClctFault_mp00 "gesammelte Fehlerzustände aller Fehlerpruefungen" UWORD DFC_OneToOne 1 100 0.00 65535.00 ECU_ADDRESS 0xC000B980 /end MEASUREMENT
/begin MEASUREMENT DFC_stClctFault_mp01 "gesammelte Fehlerzustände aller Fehlerpruefungen" UWORD DFC_OneToOne 1 100 0.00 65535.00 ECU_ADDRESS 0xC000B982 /end MEASUREMENT
/begin MEASUREMENT DFC_stClctFault_mp02 "gesammelte Fehlerzustände aller Fehlerpruefungen" UWORD DFC_OneToOne 1 100 0.00 65535.00 ECU_ADDRESS 0xC000B984 /end MEASUREMENT
/begin MEASUREMENT DFC_stClctFault_mp03 "gesammelte Fehlerzustände aller Fehlerpruefungen" UWORD DFC_OneToOne 1 100 0.00 65535.00 ECU_ADDRESS 0xC000B986 /end MEASUREMENT
/begin MEASUREMENT DFC_stClctFault_mp04 "gesammelte Fehlerzustände aller Fehlerpruefungen" UWORD DFC_OneToOne 1 100 0.00 65535.00 ECU_ADDRESS 0xC000B988 /end MEASUREMENT
/begin MEASUREMENT DFC_stClctFault_mp05 "gesammelte Fehlerzustände aller Fehlerpruefungen" UWORD DFC_OneToOne 1 100 0.00 65535.00 ECU_ADDRESS 0xC000B98A /end MEASUREMENT
/begin MEASUREMENT DFC_stClctFault_mp06 "gesammelte Fehlerzustände aller Fehlerpruefungen" UWORD DFC_OneToOne 1 100 0.00 65535.00 ECU_ADDRESS 0xC000B98C /end MEASUREMENT
/begin MEASUREMENT DFC_stClctFault_mp07 "gesammelte Fehlerzustände aller Fehlerpruefungen" UWORD DFC_OneToOne 1 100 0.00 65535.00 ECU_ADDRESS 0xC000B98E /end MEASUREMENT
/begin MEASUREMENT DFC_stClctFault_mp08 "gesammelte Fehlerzustände aller Fehlerpruefungen" UWORD DFC_OneToOne 1 100 0.00 65535.00 ECU_ADDRESS 0xC000B990 /end MEASUREMENT
/begin MEASUREMENT DFC_stClctFault_mp09 "gesammelte Fehlerzustände aller Fehlerpruefungen" UWORD DFC_OneToOne 1 100 0.00 65535.00 ECU_ADDRESS 0xC000B992 /end MEASUREMENT
/begin MEASUREMENT DFC_stClctFault_mp10 "gesammelte Fehlerzustände aller Fehlerpruefungen" UWORD DFC_OneToOne 1 100 0.00 65535.00 ECU_ADDRESS 0xC000B994 /end MEASUREMENT
/begin MEASUREMENT DFC_stClctFault_mp11 "gesammelte Fehlerzustände aller Fehlerpruefungen" UWORD DFC_OneToOne 1 100 0.00 65535.00 ECU_ADDRESS 0xC000B996 /end MEASUREMENT
/begin MEASUREMENT DFC_stClctFault_mp12 "gesammelte Fehlerzustände aller Fehlerpruefungen" UWORD DFC_OneToOne 1 100 0.00 65535.00 ECU_ADDRESS 0xC000B998 /end MEASUREMENT
/begin MEASUREMENT DFC_stClctFault_mp13 "gesammelte Fehlerzustände aller Fehlerpruefungen" UWORD DFC_OneToOne 1 100 0.00 65535.00 ECU_ADDRESS 0xC000B99A /end MEASUREMENT
/begin MEASUREMENT DFC_stClctFault_mp14 "gesammelte Fehlerzustände aller Fehlerpruefungen" UWORD DFC_OneToOne 1 100 0.00 65535.00 ECU_ADDRESS 0xC000B99C /end MEASUREMENT
/begin MEASUREMENT DFC_stClctFault_mp15 "gesammelte Fehlerzustände aller Fehlerpruefungen" UWORD DFC_OneToOne 1 100 0.00 65535.00 ECU_ADDRESS 0xC000B99E /end MEASUREMENT
/begin MEASUREMENT DFC_stClctFault_mp16 "gesammelte Fehlerzustände aller Fehlerpruefungen" UWORD DFC_OneToOne 1 100 0.00 65535.00 ECU_ADDRESS 0xC000B9A0 /end MEASUREMENT
/begin MEASUREMENT DFC_stClctFault_mp17 "gesammelte Fehlerzustände aller Fehlerpruefungen" UWORD DFC_OneToOne 1 100 0.00 65535.00 ECU_ADDRESS 0xC000B9A2 /end MEASUREMENT
/begin MEASUREMENT DFC_stClctFault_mp18 "gesammelte Fehlerzustände aller Fehlerpruefungen" UWORD DFC_OneToOne 1 100 0.00 65535.00 ECU_ADDRESS 0xC000B9A4 /end MEASUREMENT
/begin MEASUREMENT DFC_stClctFault_mp19 "gesammelte Fehlerzustände aller Fehlerpruefungen" UWORD DFC_OneToOne 1 100 0.00 65535.00 ECU_ADDRESS 0xC000B9A6 /end MEASUREMENT
/begin MEASUREMENT DFC_stClctFault_mp20 "gesammelte Fehlerzustände aller Fehlerpruefungen" UWORD DFC_OneToOne 1 100 0.00 65535.00 ECU_ADDRESS 0xC000B9A8 /end MEASUREMENT
/begin MEASUREMENT DFC_stClctFault_mp21 "gesammelte Fehlerzustände aller Fehlerpruefungen" UWORD DFC_OneToOne 1 100 0.00 65535.00 ECU_ADDRESS 0xC000B9AA /end MEASUREMENT
/begin MEASUREMENT DFC_stClctFault_mp22 "gesammelte Fehlerzustände aller Fehlerpruefungen" UWORD DFC_OneToOne 1 100 0.00 65535.00 ECU_ADDRESS 0xC000B9AC /end MEASUREMENT
/begin MEASUREMENT DFC_stClctFault_mp23 "gesammelte Fehlerzustände aller Fehlerpruefungen" UWORD DFC_OneToOne 1 100 0.00 65535.00 ECU_ADDRESS 0xC000B9AE /end MEASUREMENT
/begin MEASUREMENT DFC_stClctFault_mp24 "gesammelte Fehlerzustände aller Fehlerpruefungen" UWORD DFC_OneToOne 1 100 0.00 65535.00 ECU_ADDRESS 0xC000B9B0 /end MEASUREMENT
/begin MEASUREMENT DFC_stClctFault_mp25 "gesammelte Fehlerzustände aller Fehlerpruefungen" UWORD DFC_OneToOne 1 100 0.00 65535.00 ECU_ADDRESS 0xC000B9B2 /end MEASUREMENT
/begin MEASUREMENT DFC_stClctFault_mp26 "gesammelte Fehlerzustände aller Fehlerpruefungen" UWORD DFC_OneToOne 1 100 0.00 65535.00 ECU_ADDRESS 0xC000B9B4 /end MEASUREMENT
/begin MEASUREMENT DFC_stClctFault_mp27 "gesammelte Fehlerzustände aller Fehlerpruefungen" UWORD DFC_OneToOne 1 100 0.00 65535.00 ECU_ADDRESS 0xC000B9B6 /end MEASUREMENT
/begin MEASUREMENT DFC_stClctFault_mp28 "gesammelte Fehlerzustände aller Fehlerpruefungen" UWORD DFC_OneToOne 1 100 0.00 65535.00 ECU_ADDRESS 0xC000B9B8 /end MEASUREMENT
/begin MEASUREMENT DFC_stClctFault_mp29 "gesammelte Fehlerzustände aller Fehlerpruefungen" UWORD DFC_OneToOne 1 100 0.00 65535.00 ECU_ADDRESS 0xC000B9BA /end MEASUREMENT
/begin MEASUREMENT DFC_stClctFault_mp30 "gesammelte Fehlerzustände aller Fehlerpruefungen" UWORD DFC_OneToOne 1 100 0.00 65535.00 ECU_ADDRESS 0xC000B9BC /end MEASUREMENT
/begin MEASUREMENT DFC_stClctFault_mp31 "gesammelte Fehlerzustände aller Fehlerpruefungen" UWORD DFC_OneToOne 1 100 0.00 65535.00 ECU_ADDRESS 0xC000B9BE /end MEASUREMENT
/begin MEASUREMENT DFC_stClctFault_mp32 "gesammelte Fehlerzustände aller Fehlerpruefungen" UWORD DFC_OneToOne 1 100 0.00 65535.00 ECU_ADDRESS 0xC000B9C0 /end MEASUREMENT
/begin MEASUREMENT DFC_stClctFault_mp33 "gesammelte Fehlerzustände aller Fehlerpruefungen" UWORD DFC_OneToOne 1 100 0.00 65535.00 ECU_ADDRESS 0xC000B9C2 /end MEASUREMENT
/begin MEASUREMENT DFC_stClctFault_mp34 "gesammelte Fehlerzustände aller Fehlerpruefungen" UWORD DFC_OneToOne 1 100 0.00 65535.00 ECU_ADDRESS 0xC000B9C4 /end MEASUREMENT
/begin MEASUREMENT DFC_stClctFault_mp35 "gesammelte Fehlerzustände aller Fehlerpruefungen" UWORD DFC_OneToOne 1 100 0.00 65535.00 ECU_ADDRESS 0xC000B9C6 /end MEASUREMENT
/begin MEASUREMENT DFC_stClctFault_mp36 "gesammelte Fehlerzustände aller Fehlerpruefungen" UWORD DFC_OneToOne 1 100 0.00 65535.00 ECU_ADDRESS 0xC000B9C8 /end MEASUREMENT
/begin MEASUREMENT DFC_stClctFault_mp37 "gesammelte Fehlerzustände aller Fehlerpruefungen" UWORD DFC_OneToOne 1 100 0.00 65535.00 ECU_ADDRESS 0xC000B9CA /end MEASUREMENT
/begin MEASUREMENT DFC_stClctFault_mp38 "gesammelte Fehlerzustände aller Fehlerpruefungen" UWORD DFC_OneToOne 1 100 0.00 65535.00 ECU_ADDRESS 0xC000B9CC /end MEASUREMENT
/begin MEASUREMENT DFC_stClctFault_mp39 "gesammelte Fehlerzustände aller Fehlerpruefungen" UWORD DFC_OneToOne 1 100 0.00 65535.00 ECU_ADDRESS 0xC000B9CE /end MEASUREMENT
/begin MEASUREMENT DFC_stClctFault_mp40 "gesammelte Fehlerzustände aller Fehlerpruefungen" UWORD DFC_OneToOne 1 100 0.00 65535.00 ECU_ADDRESS 0xC000B9D0 /end MEASUREMENT
/begin MEASUREMENT DFC_stClctFault_mp41 "gesammelte Fehlerzustände aller Fehlerpruefungen" UWORD DFC_OneToOne 1 100 0.00 65535.00 ECU_ADDRESS 0xC000B9D2 /end MEASUREMENT
/begin MEASUREMENT DFC_stClctFault_mp42 "gesammelte Fehlerzustände aller Fehlerpruefungen" UWORD DFC_OneToOne 1 100 0.00 65535.00 ECU_ADDRESS 0xC000B9D4 /end MEASUREMENT
/begin MEASUREMENT DFC_stClctFault_mp43 "gesammelte Fehlerzustände aller Fehlerpruefungen" UWORD DFC_OneToOne 1 100 0.00 65535.00 ECU_ADDRESS 0xC000B9D6 /end MEASUREMENT
/begin MEASUREMENT DFC_stClctFault_mp44 "gesammelte Fehlerzustände aller Fehlerpruefungen" UWORD DFC_OneToOne 1 100 0.00 65535.00 ECU_ADDRESS 0xC000B9D8 /end MEASUREMENT
/begin MEASUREMENT DFC_stClctFault_mp45 "gesammelte Fehlerzustände aller Fehlerpruefungen" UWORD DFC_OneToOne 1 100 0.00 65535.00 ECU_ADDRESS 0xC000B9DA /end MEASUREMENT
/begin MEASUREMENT DFC_stClctFault_mp46 "gesammelte Fehlerzustände aller Fehlerpruefungen" UWORD DFC_OneToOne 1 100 0.00 65535.00 ECU_ADDRESS 0xC000B9DC /end MEASUREMENT
/begin MEASUREMENT DFC_stClctFault_mp47 "gesammelte Fehlerzustände aller Fehlerpruefungen" UWORD DFC_OneToOne 1 100 0.00 65535.00 ECU_ADDRESS 0xC000B9DE /end MEASUREMENT
/begin MEASUREMENT DFC_stClctFault_mp48 "gesammelte Fehlerzustände aller Fehlerpruefungen" UWORD DFC_OneToOne 1 100 0.00 65535.00 ECU_ADDRESS 0xC000B9E0 /end MEASUREMENT
/begin MEASUREMENT DFC_stClctFault_mp49 "gesammelte Fehlerzustände aller Fehlerpruefungen" UWORD DFC_OneToOne 1 100 0.00 65535.00 ECU_ADDRESS 0xC000B9E2 /end MEASUREMENT
/begin MEASUREMENT DFC_stClctFault_mp50 "gesammelte Fehlerzustände aller Fehlerpruefungen" UWORD DFC_OneToOne 1 100 0.00 65535.00 ECU_ADDRESS 0xC000B9E4 /end MEASUREMENT
/begin MEASUREMENT DFC_stClctFault_mp51 "gesammelte Fehlerzustände aller Fehlerpruefungen" UWORD DFC_OneToOne 1 100 0.00 65535.00 ECU_ADDRESS 0xC000B9E6 /end MEASUREMENT
/begin MEASUREMENT DFC_stClctFault_mp52 "gesammelte Fehlerzustände aller Fehlerpruefungen" UWORD DFC_OneToOne 1 100 0.00 65535.00 ECU_ADDRESS 0xC000B9E8 /end MEASUREMENT
/begin MEASUREMENT DFC_stClctFault_mp53 "gesammelte Fehlerzustände aller Fehlerpruefungen" UWORD DFC_OneToOne 1 100 0.00 65535.00 ECU_ADDRESS 0xC000B9EA /end MEASUREMENT
/begin MEASUREMENT DFC_stClctFault_mp54 "gesammelte Fehlerzustände aller Fehlerpruefungen" UWORD DFC_OneToOne 1 100 0.00 65535.00 ECU_ADDRESS 0xC000B9EC /end MEASUREMENT
/begin MEASUREMENT DFC_stClctFault_mp55 "gesammelte Fehlerzustände aller Fehlerpruefungen" UWORD DFC_OneToOne 1 100 0.00 65535.00 ECU_ADDRESS 0xC000B9EE /end MEASUREMENT
/begin MEASUREMENT DFC_stClctFault_mp56 "gesammelte Fehlerzustände aller Fehlerpruefungen" UWORD DFC_OneToOne 1 100 0.00 65535.00 ECU_ADDRESS 0xC000B9F0 /end MEASUREMENT
/begin MEASUREMENT DFC_stClctFault_mp57 "gesammelte Fehlerzustände aller Fehlerpruefungen" UWORD DFC_OneToOne 1 100 0.00 65535.00 ECU_ADDRESS 0xC000B9F2 /end MEASUREMENT
/begin MEASUREMENT DFC_stClctFault_mp58 "gesammelte Fehlerzustände aller Fehlerpruefungen" UWORD DFC_OneToOne 1 100 0.00 65535.00 ECU_ADDRESS 0xC000B9F4 /end MEASUREMENT
/begin MEASUREMENT DFC_stClctFault_mp59 "gesammelte Fehlerzustände aller Fehlerpruefungen" UWORD DFC_OneToOne 1 100 0.00 65535.00 ECU_ADDRESS 0xC000B9F6 /end MEASUREMENT
/begin MEASUREMENT DFC_stClctFault_mp60 "gesammelte Fehlerzustände aller Fehlerpruefungen" UWORD DFC_OneToOne 1 100 0.00 65535.00 ECU_ADDRESS 0xC000B9F8 /end MEASUREMENT
/begin MEASUREMENT DFC_stClctTst_mp00 "gesammelte getestet Infomationen aller Fehlerpruefungen" UWORD DFC_OneToOne 1 100 0.00 65535.00 ECU_ADDRESS 0xC000B9FA /end MEASUREMENT
/begin MEASUREMENT DFC_stClctTst_mp01 "gesammelte getestet Infomationen aller Fehlerpruefungen" UWORD DFC_OneToOne 1 100 0.00 65535.00 ECU_ADDRESS 0xC000B9FC /end MEASUREMENT
/begin MEASUREMENT DFC_stClctTst_mp02 "gesammelte getestet Infomationen aller Fehlerpruefungen" UWORD DFC_OneToOne 1 100 0.00 65535.00 ECU_ADDRESS 0xC000B9FE /end MEASUREMENT
/begin MEASUREMENT DFC_stClctTst_mp03 "gesammelte getestet Infomationen aller Fehlerpruefungen" UWORD DFC_OneToOne 1 100 0.00 65535.00 ECU_ADDRESS 0xC000BA00 /end MEASUREMENT
/begin MEASUREMENT DFC_stClctTst_mp04 "gesammelte getestet Infomationen aller Fehlerpruefungen" UWORD DFC_OneToOne 1 100 0.00 65535.00 ECU_ADDRESS 0xC000BA02 /end MEASUREMENT
/begin MEASUREMENT DFC_stClctTst_mp05 "gesammelte getestet Infomationen aller Fehlerpruefungen" UWORD DFC_OneToOne 1 100 0.00 65535.00 ECU_ADDRESS 0xC000BA04 /end MEASUREMENT
/begin MEASUREMENT DFC_stClctTst_mp06 "gesammelte getestet Infomationen aller Fehlerpruefungen" UWORD DFC_OneToOne 1 100 0.00 65535.00 ECU_ADDRESS 0xC000BA06 /end MEASUREMENT
/begin MEASUREMENT DFC_stClctTst_mp07 "gesammelte getestet Infomationen aller Fehlerpruefungen" UWORD DFC_OneToOne 1 100 0.00 65535.00 ECU_ADDRESS 0xC000BA08 /end MEASUREMENT
/begin MEASUREMENT DFC_stClctTst_mp08 "gesammelte getestet Infomationen aller Fehlerpruefungen" UWORD DFC_OneToOne 1 100 0.00 65535.00 ECU_ADDRESS 0xC000BA0A /end MEASUREMENT
/begin MEASUREMENT DFC_stClctTst_mp09 "gesammelte getestet Infomationen aller Fehlerpruefungen" UWORD DFC_OneToOne 1 100 0.00 65535.00 ECU_ADDRESS 0xC000BA0C /end MEASUREMENT
/begin MEASUREMENT DFC_stClctTst_mp10 "gesammelte getestet Infomationen aller Fehlerpruefungen" UWORD DFC_OneToOne 1 100 0.00 65535.00 ECU_ADDRESS 0xC000BA0E /end MEASUREMENT
/begin MEASUREMENT DFC_stClctTst_mp11 "gesammelte getestet Infomationen aller Fehlerpruefungen" UWORD DFC_OneToOne 1 100 0.00 65535.00 ECU_ADDRESS 0xC000BA10 /end MEASUREMENT
/begin MEASUREMENT DFC_stClctTst_mp12 "gesammelte getestet Infomationen aller Fehlerpruefungen" UWORD DFC_OneToOne 1 100 0.00 65535.00 ECU_ADDRESS 0xC000BA12 /end MEASUREMENT
/begin MEASUREMENT DFC_stClctTst_mp13 "gesammelte getestet Infomationen aller Fehlerpruefungen" UWORD DFC_OneToOne 1 100 0.00 65535.00 ECU_ADDRESS 0xC000BA14 /end MEASUREMENT
/begin MEASUREMENT DFC_stClctTst_mp14 "gesammelte getestet Infomationen aller Fehlerpruefungen" UWORD DFC_OneToOne 1 100 0.00 65535.00 ECU_ADDRESS 0xC000BA16 /end MEASUREMENT
/begin MEASUREMENT DFC_stClctTst_mp15 "gesammelte getestet Infomationen aller Fehlerpruefungen" UWORD DFC_OneToOne 1 100 0.00 65535.00 ECU_ADDRESS 0xC000BA18 /end MEASUREMENT
/begin MEASUREMENT DFC_stClctTst_mp16 "gesammelte getestet Infomationen aller Fehlerpruefungen" UWORD DFC_OneToOne 1 100 0.00 65535.00 ECU_ADDRESS 0xC000BA1A /end MEASUREMENT
/begin MEASUREMENT DFC_stClctTst_mp17 "gesammelte getestet Infomationen aller Fehlerpruefungen" UWORD DFC_OneToOne 1 100 0.00 65535.00 ECU_ADDRESS 0xC000BA1C /end MEASUREMENT
/begin MEASUREMENT DFC_stClctTst_mp18 "gesammelte getestet Infomationen aller Fehlerpruefungen" UWORD DFC_OneToOne 1 100 0.00 65535.00 ECU_ADDRESS 0xC000BA1E /end MEASUREMENT
/begin MEASUREMENT DFC_stClctTst_mp19 "gesammelte getestet Infomationen aller Fehlerpruefungen" UWORD DFC_OneToOne 1 100 0.00 65535.00 ECU_ADDRESS 0xC000BA20 /end MEASUREMENT
/begin MEASUREMENT DFC_stClctTst_mp20 "gesammelte getestet Infomationen aller Fehlerpruefungen" UWORD DFC_OneToOne 1 100 0.00 65535.00 ECU_ADDRESS 0xC000BA22 /end MEASUREMENT
/begin MEASUREMENT DFC_stClctTst_mp21 "gesammelte getestet Infomationen aller Fehlerpruefungen" UWORD DFC_OneToOne 1 100 0.00 65535.00 ECU_ADDRESS 0xC000BA24 /end MEASUREMENT
/begin MEASUREMENT DFC_stClctTst_mp22 "gesammelte getestet Infomationen aller Fehlerpruefungen" UWORD DFC_OneToOne 1 100 0.00 65535.00 ECU_ADDRESS 0xC000BA26 /end MEASUREMENT
/begin MEASUREMENT DFC_stClctTst_mp23 "gesammelte getestet Infomationen aller Fehlerpruefungen" UWORD DFC_OneToOne 1 100 0.00 65535.00 ECU_ADDRESS 0xC000BA28 /end MEASUREMENT
/begin MEASUREMENT DFC_stClctTst_mp24 "gesammelte getestet Infomationen aller Fehlerpruefungen" UWORD DFC_OneToOne 1 100 0.00 65535.00 ECU_ADDRESS 0xC000BA2A /end MEASUREMENT
/begin MEASUREMENT DFC_stClctTst_mp25 "gesammelte getestet Infomationen aller Fehlerpruefungen" UWORD DFC_OneToOne 1 100 0.00 65535.00 ECU_ADDRESS 0xC000BA2C /end MEASUREMENT
/begin MEASUREMENT DFC_stClctTst_mp26 "gesammelte getestet Infomationen aller Fehlerpruefungen" UWORD DFC_OneToOne 1 100 0.00 65535.00 ECU_ADDRESS 0xC000BA2E /end MEASUREMENT
/begin MEASUREMENT DFC_stClctTst_mp27 "gesammelte getestet Infomationen aller Fehlerpruefungen" UWORD DFC_OneToOne 1 100 0.00 65535.00 ECU_ADDRESS 0xC000BA30 /end MEASUREMENT
/begin MEASUREMENT DFC_stClctTst_mp28 "gesammelte getestet Infomationen aller Fehlerpruefungen" UWORD DFC_OneToOne 1 100 0.00 65535.00 ECU_ADDRESS 0xC000BA32 /end MEASUREMENT
/begin MEASUREMENT DFC_stClctTst_mp29 "gesammelte getestet Infomationen aller Fehlerpruefungen" UWORD DFC_OneToOne 1 100 0.00 65535.00 ECU_ADDRESS 0xC000BA34 /end MEASUREMENT
/begin MEASUREMENT DFC_stClctTst_mp30 "gesammelte getestet Infomationen aller Fehlerpruefungen" UWORD DFC_OneToOne 1 100 0.00 65535.00 ECU_ADDRESS 0xC000BA36 /end MEASUREMENT
/begin MEASUREMENT DFC_stClctTst_mp31 "gesammelte getestet Infomationen aller Fehlerpruefungen" UWORD DFC_OneToOne 1 100 0.00 65535.00 ECU_ADDRESS 0xC000BA38 /end MEASUREMENT
/begin MEASUREMENT DFC_stClctTst_mp32 "gesammelte getestet Infomationen aller Fehlerpruefungen" UWORD DFC_OneToOne 1 100 0.00 65535.00 ECU_ADDRESS 0xC000BA3A /end MEASUREMENT
/begin MEASUREMENT DFC_stClctTst_mp33 "gesammelte getestet Infomationen aller Fehlerpruefungen" UWORD DFC_OneToOne 1 100 0.00 65535.00 ECU_ADDRESS 0xC000BA3C /end MEASUREMENT
/begin MEASUREMENT DFC_stClctTst_mp34 "gesammelte getestet Infomationen aller Fehlerpruefungen" UWORD DFC_OneToOne 1 100 0.00 65535.00 ECU_ADDRESS 0xC000BA3E /end MEASUREMENT
/begin MEASUREMENT DFC_stClctTst_mp35 "gesammelte getestet Infomationen aller Fehlerpruefungen" UWORD DFC_OneToOne 1 100 0.00 65535.00 ECU_ADDRESS 0xC000BA40 /end MEASUREMENT
/begin MEASUREMENT DFC_stClctTst_mp36 "gesammelte getestet Infomationen aller Fehlerpruefungen" UWORD DFC_OneToOne 1 100 0.00 65535.00 ECU_ADDRESS 0xC000BA42 /end MEASUREMENT
/begin MEASUREMENT DFC_stClctTst_mp37 "gesammelte getestet Infomationen aller Fehlerpruefungen" UWORD DFC_OneToOne 1 100 0.00 65535.00 ECU_ADDRESS 0xC000BA44 /end MEASUREMENT
/begin MEASUREMENT DFC_stClctTst_mp38 "gesammelte getestet Infomationen aller Fehlerpruefungen" UWORD DFC_OneToOne 1 100 0.00 65535.00 ECU_ADDRESS 0xC000BA46 /end MEASUREMENT
/begin MEASUREMENT DFC_stClctTst_mp39 "gesammelte getestet Infomationen aller Fehlerpruefungen" UWORD DFC_OneToOne 1 100 0.00 65535.00 ECU_ADDRESS 0xC000BA48 /end MEASUREMENT
/begin MEASUREMENT DFC_stClctTst_mp40 "gesammelte getestet Infomationen aller Fehlerpruefungen" UWORD DFC_OneToOne 1 100 0.00 65535.00 ECU_ADDRESS 0xC000BA4A /end MEASUREMENT
/begin MEASUREMENT DFC_stClctTst_mp41 "gesammelte getestet Infomationen aller Fehlerpruefungen" UWORD DFC_OneToOne 1 100 0.00 65535.00 ECU_ADDRESS 0xC000BA4C /end MEASUREMENT
/begin MEASUREMENT DFC_stClctTst_mp42 "gesammelte getestet Infomationen aller Fehlerpruefungen" UWORD DFC_OneToOne 1 100 0.00 65535.00 ECU_ADDRESS 0xC000BA4E /end MEASUREMENT
/begin MEASUREMENT DFC_stClctTst_mp43 "gesammelte getestet Infomationen aller Fehlerpruefungen" UWORD DFC_OneToOne 1 100 0.00 65535.00 ECU_ADDRESS 0xC000BA50 /end MEASUREMENT
/begin MEASUREMENT DFC_stClctTst_mp44 "gesammelte getestet Infomationen aller Fehlerpruefungen" UWORD DFC_OneToOne 1 100 0.00 65535.00 ECU_ADDRESS 0xC000BA52 /end MEASUREMENT
/begin MEASUREMENT DFC_stClctTst_mp45 "gesammelte getestet Infomationen aller Fehlerpruefungen" UWORD DFC_OneToOne 1 100 0.00 65535.00 ECU_ADDRESS 0xC000BA54 /end MEASUREMENT
/begin MEASUREMENT DFC_stClctTst_mp46 "gesammelte getestet Infomationen aller Fehlerpruefungen" UWORD DFC_OneToOne 1 100 0.00 65535.00 ECU_ADDRESS 0xC000BA56 /end MEASUREMENT
/begin MEASUREMENT DFC_stClctTst_mp47 "gesammelte getestet Infomationen aller Fehlerpruefungen" UWORD DFC_OneToOne 1 100 0.00 65535.00 ECU_ADDRESS 0xC000BA58 /end MEASUREMENT
/begin MEASUREMENT DFC_stClctTst_mp48 "gesammelte getestet Infomationen aller Fehlerpruefungen" UWORD DFC_OneToOne 1 100 0.00 65535.00 ECU_ADDRESS 0xC000BA5A /end MEASUREMENT
/begin MEASUREMENT DFC_stClctTst_mp49 "gesammelte getestet Infomationen aller Fehlerpruefungen" UWORD DFC_OneToOne 1 100 0.00 65535.00 ECU_ADDRESS 0xC000BA5C /end MEASUREMENT
/begin MEASUREMENT DFC_stClctTst_mp50 "gesammelte getestet Infomationen aller Fehlerpruefungen" UWORD DFC_OneToOne 1 100 0.00 65535.00 ECU_ADDRESS 0xC000BA5E /end MEASUREMENT
/begin MEASUREMENT DFC_stClctTst_mp51 "gesammelte getestet Infomationen aller Fehlerpruefungen" UWORD DFC_OneToOne 1 100 0.00 65535.00 ECU_ADDRESS 0xC000BA60 /end MEASUREMENT
/begin MEASUREMENT DFC_stClctTst_mp52 "gesammelte getestet Infomationen aller Fehlerpruefungen" UWORD DFC_OneToOne 1 100 0.00 65535.00 ECU_ADDRESS 0xC000BA62 /end MEASUREMENT
/begin MEASUREMENT DFC_stClctTst_mp53 "gesammelte getestet Infomationen aller Fehlerpruefungen" UWORD DFC_OneToOne 1 100 0.00 65535.00 ECU_ADDRESS 0xC000BA64 /end MEASUREMENT
/begin MEASUREMENT DFC_stClctTst_mp54 "gesammelte getestet Infomationen aller Fehlerpruefungen" UWORD DFC_OneToOne 1 100 0.00 65535.00 ECU_ADDRESS 0xC000BA66 /end MEASUREMENT
/begin MEASUREMENT DFC_stClctTst_mp55 "gesammelte getestet Infomationen aller Fehlerpruefungen" UWORD DFC_OneToOne 1 100 0.00 65535.00 ECU_ADDRESS 0xC000BA68 /end MEASUREMENT
/begin MEASUREMENT DFC_stClctTst_mp56 "gesammelte getestet Infomationen aller Fehlerpruefungen" UWORD DFC_OneToOne 1 100 0.00 65535.00 ECU_ADDRESS 0xC000BA6A /end MEASUREMENT
/begin MEASUREMENT DFC_stClctTst_mp57 "gesammelte getestet Infomationen aller Fehlerpruefungen" UWORD DFC_OneToOne 1 100 0.00 65535.00 ECU_ADDRESS 0xC000BA6C /end MEASUREMENT
/begin MEASUREMENT DFC_stClctTst_mp58 "gesammelte getestet Infomationen aller Fehlerpruefungen" UWORD DFC_OneToOne 1 100 0.00 65535.00 ECU_ADDRESS 0xC000BA6E /end MEASUREMENT
/begin MEASUREMENT DFC_stClctTst_mp59 "gesammelte getestet Infomationen aller Fehlerpruefungen" UWORD DFC_OneToOne 1 100 0.00 65535.00 ECU_ADDRESS 0xC000BA70 /end MEASUREMENT
/begin MEASUREMENT DFC_stClctTst_mp60 "gesammelte getestet Infomationen aller Fehlerpruefungen" UWORD DFC_OneToOne 1 100 0.00 65535.00 ECU_ADDRESS 0xC000BA72 /end MEASUREMENT
/begin MEASUREMENT Dfdp00 "Primärkennfeld FASTA Generatorauslastung" UWORD Def_dez_uw_q1 1 100 0.00 65535. FORMAT "%5.0" ECU_ADDRESS 0xC000BE3C /end MEASUREMENT
/begin MEASUREMENT Dfdp01 "Primärkennfeld FASTA Generatorauslastung" UWORD Def_dez_uw_q1 1 100 0.00 65535. FORMAT "%5.0" ECU_ADDRESS 0xC000BE3E /end MEASUREMENT
/begin MEASUREMENT Dfdp02 "Primärkennfeld FASTA Generatorauslastung" UWORD Def_dez_uw_q1 1 100 0.00 65535. FORMAT "%5.0" ECU_ADDRESS 0xC000BE40 /end MEASUREMENT
/begin MEASUREMENT Dfdp03 "Primärkennfeld FASTA Generatorauslastung" UWORD Def_dez_uw_q1 1 100 0.00 65535. FORMAT "%5.0" ECU_ADDRESS 0xC000BE42 /end MEASUREMENT
/begin MEASUREMENT Dfdp04 "Primärkennfeld FASTA Generatorauslastung" UWORD Def_dez_uw_q1 1 100 0.00 65535. FORMAT "%5.0" ECU_ADDRESS 0xC000BE44 /end MEASUREMENT
/begin MEASUREMENT Dfdp05 "Primärkennfeld FASTA Generatorauslastung" UWORD Def_dez_uw_q1 1 100 0.00 65535. FORMAT "%5.0" ECU_ADDRESS 0xC000BE46 /end MEASUREMENT
/begin MEASUREMENT Dfdp06 "Primärkennfeld FASTA Generatorauslastung" UWORD Def_dez_uw_q1 1 100 0.00 65535. FORMAT "%5.0" ECU_ADDRESS 0xC000BE48 /end MEASUREMENT
/begin MEASUREMENT Dfdp07 "Primärkennfeld FASTA Generatorauslastung" UWORD Def_dez_uw_q1 1 100 0.00 65535. FORMAT "%5.0" ECU_ADDRESS 0xC000BE4A /end MEASUREMENT
/begin MEASUREMENT Dfdp08 "Primärkennfeld FASTA Generatorauslastung" UWORD Def_dez_uw_q1 1 100 0.00 65535. FORMAT "%5.0" ECU_ADDRESS 0xC000BE4C /end MEASUREMENT
/begin MEASUREMENT Dfdp09 "Primärkennfeld FASTA Generatorauslastung" UWORD Def_dez_uw_q1 1 100 0.00 65535. FORMAT "%5.0" ECU_ADDRESS 0xC000BE4E /end MEASUREMENT
/begin MEASUREMENT Dfdp10 "Primärkennfeld FASTA Generatorauslastung" UWORD Def_dez_uw_q1 1 100 0.00 65535. FORMAT "%5.0" ECU_ADDRESS 0xC000BE50 /end MEASUREMENT
/begin MEASUREMENT Dfdp11 "Primärkennfeld FASTA Generatorauslastung" UWORD Def_dez_uw_q1 1 100 0.00 65535. FORMAT "%5.0" ECU_ADDRESS 0xC000BE52 /end MEASUREMENT
/begin MEASUREMENT Dfdp12 "Primärkennfeld FASTA Generatorauslastung" UWORD Def_dez_uw_q1 1 100 0.00 65535. FORMAT "%5.0" ECU_ADDRESS 0xC000BE54 /end MEASUREMENT
/begin MEASUREMENT Dfdp13 "Primärkennfeld FASTA Generatorauslastung" UWORD Def_dez_uw_q1 1 100 0.00 65535. FORMAT "%5.0" ECU_ADDRESS 0xC000BE56 /end MEASUREMENT
/begin MEASUREMENT Dfdp14 "Primärkennfeld FASTA Generatorauslastung" UWORD Def_dez_uw_q1 1 100 0.00 65535. FORMAT "%5.0" ECU_ADDRESS 0xC000BE58 /end MEASUREMENT
/begin MEASUREMENT Dfdp15 "Primärkennfeld FASTA Generatorauslastung" UWORD Def_dez_uw_q1 1 100 0.00 65535. FORMAT "%5.0" ECU_ADDRESS 0xC000BE5A /end MEASUREMENT
/begin MEASUREMENT Dfds00 "Sekundärkennfeld FASTA Generatorauslastung" UBYTE Def_st_ub_q1 1 100 0.00 255. FORMAT "%3.0" ECU_ADDRESS 0xC000BE5C /end MEASUREMENT
/begin MEASUREMENT Dfds01 "Sekundärkennfeld FASTA Generatorauslastung" UBYTE Def_st_ub_q1 1 100 0.00 255. FORMAT "%3.0" ECU_ADDRESS 0xC000BE5D /end MEASUREMENT
/begin MEASUREMENT Dfds02 "Sekundärkennfeld FASTA Generatorauslastung" UBYTE Def_st_ub_q1 1 100 0.00 255. FORMAT "%3.0" ECU_ADDRESS 0xC000BE5E /end MEASUREMENT
/begin MEASUREMENT Dfds03 "Sekundärkennfeld FASTA Generatorauslastung" UBYTE Def_st_ub_q1 1 100 0.00 255. FORMAT "%3.0" ECU_ADDRESS 0xC000BE5F /end MEASUREMENT
/begin MEASUREMENT Layer_rPTC "" SWORD DtyCyc 1 100 -327.6800 327.6700 ECU_ADDRESS 0xD00010C2 /end MEASUREMENT
/begin MEASUREMENT StbIntv_bDCSIntv "Freigabe für Momentenanforderungen aus der Schleppmomentenregelung (MSR)" UBYTE OneToOne 1 100 0.00 255.0 ECU_ADDRESS 0xD0002579 /end MEASUREMENT
/begin MEASUREMENT StbIntv_bDCSNeutr "Neutralwert für Momentenanforderungen aus der Schleppmomentenregelung (MSR) empfangen" UBYTE OneToOne 1 100 0.00 255.0 ECU_ADDRESS 0xD000257A /end MEASUREMENT
/begin MEASUREMENT StbIntv_bTCSIntv "Freigabe für Antischlupfregelungsmomente (ASR)" UBYTE OneToOne 1 100 0.00 255.0 ECU_ADDRESS 0xD000257B /end MEASUREMENT
/begin MEASUREMENT StbIntv_bTCSNeutr "Neutralwert für Antischlupfregelungsmomente (ASR) empfangen" UBYTE OneToOne 1 100 0.00 255.0 ECU_ADDRESS 0xD000257C /end MEASUREMENT
/begin MEASUREMENT StbIntv_trqDCSDes "MSR Eingriffsmoment (Radmoment)" SLONG TrqPrpHigh 1 100 -214748364.800 214748364.700 ECU_ADDRESS 0xD000302C /end MEASUREMENT
/begin MEASUREMENT StbIntv_trqTCSDes "ASR Solleingriffsmoment (Radmoment)" SLONG TrqPrpHigh 1 100 -214748364.800 214748364.700 ECU_ADDRESS 0xD0003030 /end MEASUREMENT
/begin MEASUREMENT StbIntv_trqTCSLead "ASR Vorhaltmomenteneingriff (Radmoment)" SLONG TrqPrpHigh 1 100 -214748364.800 214748364.700 ECU_ADDRESS 0xD0003034 /end MEASUREMENT
/begin MEASUREMENT VMD_rVirtAPP "Rückgerechneter Fahrpedalwert" SWORD Prc 1 100 -400.0000 399.9878 ECU_ADDRESS 0xD000147C /end MEASUREMENT
/begin MEASUREMENT VMD_rVirtAPPDes "" SWORD Prc 1 100 -400.0000 399.9878 ECU_ADDRESS 0xD000147E /end MEASUREMENT
/begin MEASUREMENT VMD_rVirtAPP_raw_mp "Rohwert des virtuellen Fahrpedalwinkels" SWORD Prc 1 100 -400.0000 399.9878 ECU_ADDRESS 0xC000AEA2 /end MEASUREMENT
/begin MEASUREMENT VMD_stVirtAPP "" UBYTE OneToOne 1 100 0.00 255.0 ECU_ADDRESS 0xD00025AC /end MEASUREMENT
/begin MEASUREMENT VMD_stVirtAPPOvr_mp "Status für Umschaltung auf Schubverhalten im virtuellen Fahrpedal" UBYTE OneToOne 1 100 0.00 255.0 ECU_ADDRESS 0xC000B591 /end MEASUREMENT
/begin MEASUREMENT VMD_trqEng "Vortriebsmomentenwunsch, umgerechnet auf Motormoment für Rückrechnung Pedalwert" SWORD Trq 1 100 -3276.800 3276.700 ECU_ADDRESS 0xD0005028 /end MEASUREMENT
/begin MEASUREMENT VMD_trqPrpCorr "Vortriebsmomentenwunsch, korrigiert für Rückrechnung Pedalwert" SWORD TrqPrp 1 100 -52428.80 52427.20 ECU_ADDRESS 0xD000502A /end MEASUREMENT
/begin MEASUREMENT VMD_trqRaw "" SWORD Trq 1 100 -3276.800 3276.700 ECU_ADDRESS 0xD0001480 /end MEASUREMENT
/begin MEASUREMENT VMSI_stDCSPtd "Erhöhender Stabilitätseingriff von Ebene1 verboten." UBYTE OneToOne 1 100 0.00 255.0 ECU_ADDRESS 0xD00025AD /end MEASUREMENT
/begin MEASUREMENT VMSI_trqDCSRmpOut_mp "Messpunkt des Rampenausgangs der Abschaltrampe des erhöhenden Stabilitätseingriffs" SLONG TrqPrpHigh 1 100 -214748364.800 214748364.700 ECU_ADDRESS 0xC00093E8 /end MEASUREMENT
/begin MEASUREMENT VMSI_trqDesMax "Reduzierender Wunschmomenteneingriff vom ESP" SLONG TrqPrpHigh 1 100 -214748364.800 214748364.700 ECU_ADDRESS 0xD0003054 /end MEASUREMENT
/begin MEASUREMENT VMSI_trqLeadMax "Reduzierender Vorhaltmomenteneingriff vom ESP" SLONG TrqPrpHigh 1 100 -214748364.800 214748364.700 ECU_ADDRESS 0xD0003058 /end MEASUREMENT
/begin MEASUREMENT VMSI_trqMin "Erhöhender Wunschmomenteneingriff vom ESP" SLONG TrqPrpHigh 1 100 -214748364.800 214748364.700 ECU_ADDRESS 0xD000305C /end MEASUREMENT
/begin MEASUREMENT VMSI_trqTCSRmpOut_mp "Messpunkt des Rampenausgangs der Abschaltrampe des reduzierenden Stabilitätseingriffs" SLONG TrqPrpHigh 1 100 -214748364.800 214748364.700 ECU_ADDRESS 0xC00093EC /end MEASUREMENT
/begin MEASUREMENT VSwCtl_facEngTempCtlCor_mp "Motortemperaturabhängiger Korrekturfaktor" SWORD Fact 1 100 -4.000000 3.999878 ECU_ADDRESS 0xC000AEA4 /end MEASUREMENT
/begin MEASUREMENT VSwCtl_facEnvPresCtlCorEOMQnt1_mp "Atmosphärendruckabhängiger Korrekturfaktor für die erste auf Einspritzmenge basierte Betriebsart" SWORD Fact 1 100 -4.000000 3.999878 ECU_ADDRESS 0xC000AEA6 /end MEASUREMENT
/begin MEASUREMENT VSwCtl_facEnvPresCtlCor_mp "Atmosphärendruckabhängiger Korrekturfaktor" SWORD Fact 1 100 -4.000000 3.999878 ECU_ADDRESS 0xC000AEA8 /end MEASUREMENT
/begin MEASUREMENT VSwCtl_facRmpValCtlCor_mp "korrigierter EGT-Rampenwert" SWORD CoEOMSwt_S16 1 100 -2.000000 1.999939 FORMAT "%8.6" ECU_ADDRESS 0xC000AEAA /end MEASUREMENT
/begin MEASUREMENT VSwCtl_facRmpVal_mp "EOM-Rampenwert" SWORD CoEOMSwt_S16 1 100 -2.000000 1.999939 FORMAT "%8.6" ECU_ADDRESS 0xC000AEAC /end MEASUREMENT
/begin MEASUREMENT VSwCtl_numEOMMode_mp "Index der geforderten Betriebsart" UBYTE OneToOne 1 100 0.00 255.0 ECU_ADDRESS 0xC000B592 /end MEASUREMENT
/begin MEASUREMENT VSwCtl_qCtlVal "Einspritzmenge für die Drallviveausteuerung" SWORD InjMass 1 100 -327.6800 327.6700 ECU_ADDRESS 0xD0001482 /end MEASUREMENT
/begin MEASUREMENT VSwCtl_qCtlVal_mp "Einspritzmenge für die Drallniveausteuerung" SWORD InjMass 1 100 -327.6800 327.6700 ECU_ADDRESS 0xC000AEAE /end MEASUREMENT
/begin MEASUREMENT VSwCtl_qCurr_mp "aktuelle Einspritzmenge" SWORD InjMass 1 100 -327.6800 327.6700 ECU_ADDRESS 0xC000AEB0 /end MEASUREMENT
/begin MEASUREMENT VSwCtl_rCtlBasEOMQnt1_mp "Basiswert für die erste auf Einspritzmenge basierte Betriebsart" SWORD Prc 1 100 -400.0000 399.9878 ECU_ADDRESS 0xC000AEB2 /end MEASUREMENT
/begin MEASUREMENT VSwCtl_rCtlBasEOMTrq4_mp "Basiswert für die vierte auf Drehmoment basierte Betriebsart" SWORD Prc 1 100 -400.0000 399.9878 ECU_ADDRESS 0xC000AEB4 /end MEASUREMENT
/begin MEASUREMENT VSwCtl_rCtlBasHiAltdEOMQnt1_mp "Höhenbasiswert für die erste auf Einspritzmenge basierten Betriebsart" SWORD Prc 1 100 -400.0000 399.9878 ECU_ADDRESS 0xC000AEB6 /end MEASUREMENT
/begin MEASUREMENT VSwCtl_rCtlBasHiAltd_mp "Steuerwert in der Höhe im Normalbetrieb" SWORD Prc 1 100 -400.0000 399.9878 ECU_ADDRESS 0xC000AEB8 /end MEASUREMENT
/begin MEASUREMENT VSwCtl_rCtlBas_mp "Basissteuerwert für den Drallniveausteller" SWORD Prc 1 100 -400.0000 399.9878 ECU_ADDRESS 0xC000AEBA /end MEASUREMENT
/begin MEASUREMENT VSwCtl_rCtlCor_mp "korrigierter Steuerwert" SWORD Prc 1 100 -400.0000 399.9878 ECU_ADDRESS 0xC000AEBC /end MEASUREMENT
/begin MEASUREMENT VSwCtl_rCtlVal1EOMQnt1_mp "Steuerwert nach Atmosphärendruck Korrektur für die erste auf Einspritzmenge basierte Betriebsart" SWORD Prc 1 100 -400.0000 399.9878 ECU_ADDRESS 0xC000AEBE /end MEASUREMENT
/begin MEASUREMENT VSwCtl_rCtlVal1_mp "Steuerwert nach Atmosphärendruck Korrektur im Normalbetrieb" SWORD Prc 1 100 -400.0000 399.9878 ECU_ADDRESS 0xC000AEC0 /end MEASUREMENT
/begin MEASUREMENT VSwCtl_rCtlVal2_mp "Steuerwert nach Motortemperatur Korrektur" SWORD Prc 1 100 -400.0000 399.9878 ECU_ADDRESS 0xC000AEC2 /end MEASUREMENT
/begin MEASUREMENT VSwCtl_rCtlValCorLim_mp "begrenzter Steuerwert für den Drallniveausteller" SWORD Prc 1 100 -400.0000 399.9878 ECU_ADDRESS 0xC000AEC4 /end MEASUREMENT
/begin MEASUREMENT VSwCtl_rCtlValCorUnFlt_mp "" SWORD Prc 1 100 -400.0000 399.9878 ECU_ADDRESS 0xC000AEC6 /end MEASUREMENT
/begin MEASUREMENT VSwCtl_rCtlValCor_mp "Steuerwert für den Drallniveausteller" SWORD Prc 1 100 -400.0000 399.9878 ECU_ADDRESS 0xC000AEC8 /end MEASUREMENT
/begin MEASUREMENT VSwCtl_rCtlValNrm_mp "Steuerwert für den Drallniveausteller im Normalbetrieb" SWORD Prc 1 100 -400.0000 399.9878 ECU_ADDRESS 0xC000AECA /end MEASUREMENT
/begin MEASUREMENT VSwCtl_rEngTempCorBas_mp "Basissteuerwert für die Motortemperatur Korrektur" SWORD Prc 1 100 -400.0000 399.9878 ECU_ADDRESS 0xC000AECC /end MEASUREMENT
/begin MEASUREMENT VSwCtl_rEngTempCor_mp "Motortemperaturabhängiger Korrekturwert" SWORD Prc 1 100 -400.0000 399.9878 ECU_ADDRESS 0xC000AECE /end MEASUREMENT
/begin MEASUREMENT VSwCtl_rVehCorrSwt_mp "" SWORD Prc 1 100 -400.0000 399.9878 ECU_ADDRESS 0xC000AED0 /end MEASUREMENT
/begin MEASUREMENT VSwCtl_rVehCorr_mp "" SWORD Prc 1 100 -400.0000 399.9878 ECU_ADDRESS 0xC000AED2 /end MEASUREMENT
/begin MEASUREMENT VSwCtl_stBitMskEOM_mp "Bitmaske zur Auswahl der relevanten Abschaltfälle für die gewählte Betriebsart" ULONG OneToOne 1 100 0.00 4294967295.00 ECU_ADDRESS 0xC00093F0 /end MEASUREMENT
/begin MEASUREMENT VSwCtl_stEOMCtlVal_mp "Status über den Wechsel in eine andere Betriebsart" ULONG OneToOne 1 100 0.00 4294967295.00 ECU_ADDRESS 0xC00093F4 /end MEASUREMENT
/begin MEASUREMENT VSwCtl_stEOMMon "Status der Betriebsartenüberwachung" ULONG OneToOne 1 100 0.00 4294967295.00 ECU_ADDRESS 0xD00035E8 /end MEASUREMENT
/begin MEASUREMENT VSwCtl_stMon "priorisierte Abschaltfälle der Drallniveausteuerung" UBYTE OneToOne 1 100 0.00 255.0 ECU_ADDRESS 0xD00025AE /end MEASUREMENT
/begin MEASUREMENT VSwCtl_stMonBits_mp "selektierte Abschaltfälle" ULONG OneToOne 1 100 0.00 4294967295.00 ECU_ADDRESS 0xC00093F8 /end MEASUREMENT
/begin MEASUREMENT VSwCtl_stSelBitMskEOM_mp "selektierte Bitmaske für Abschaltfälle für die gewählte Betriebsart" ULONG OneToOne 1 100 0.00 4294967295.00 ECU_ADDRESS 0xC00093FC /end MEASUREMENT
/begin MEASUREMENT VSwCtl_stVSwBits "Status der Abschaltfälle" ULONG OneToOne 1 100 0.00 4294967295.00 ECU_ADDRESS 0xD00035F4 /end MEASUREMENT
/begin MEASUREMENT VSwCtl_tEngCtlVal_mp "ausgewählte Temperatur aus dem Motortemperaturfeld" SWORD Temp_Cels 1 100 -3549.940 3003.560 ECU_ADDRESS 0xC000AED4 /end MEASUREMENT
/begin MEASUREMENT VSwCtl_tiMonEOM_mp "Zeitverzögerung bei Auswahl der Abschaltfallmaske" SWORD TimeDeb 1 100 -327680.0 327670.0 ECU_ADDRESS 0xC000AED6 /end MEASUREMENT
/begin MEASUREMENT VSwCtl_tiStartDelay_mp "Delay-Zeit, in der die Steuerung nach Startabwurf abgeschaltet bleibt" SWORD Time_ms 1 100 -327680.0 327670.0 ECU_ADDRESS 0xC000AED8 /end MEASUREMENT
/begin MEASUREMENT VSwCtl_trqCtlVal "Drehmoment für die Drallniveausteuerung" SWORD Trq 1 100 -3276.800 3276.700 ECU_ADDRESS 0xD0001484 /end MEASUREMENT
/begin MEASUREMENT VSwCtl_trqInrCurr_mp "aktuelles inneres Drehmoment für die Drallniveausteuerung" SWORD Trq 1 100 -3276.800 3276.700 ECU_ADDRESS 0xC000AEDA /end MEASUREMENT
/begin MEASUREMENT VSwVlv_ctAdapCls_mp "Anzahl der Schließen-Zyklen." UBYTE OneToOne 1 100 0.00 255.0 ECU_ADDRESS 0xC000B593 /end MEASUREMENT
/begin MEASUREMENT VSwVlv_ctStrtOfsLrn_mp "Zähler für Motorstart" UWORD OneToOne 1 100 0.00 65535.00 ECU_ADDRESS 0xC000AEDC /end MEASUREMENT
/begin MEASUREMENT VSwVlv_facCorFlt_mp "Messpunkt fuer den Batteriekorrekturfaktor." SWORD Fact 1 100 -4.000000 3.999878 ECU_ADDRESS 0xC000AF04 /end MEASUREMENT
/begin MEASUREMENT VSwVlv_iEffFlt_mp "Gefilterter Wert des modellierten Stroms" SWORD Curr_A 1 100 -327.6800 327.6700 FORMAT "%8.4" ECU_ADDRESS 0xC000AF08 /end MEASUREMENT
/begin MEASUREMENT VSwVlv_iEff_mp "" SWORD Curr_A 1 100 -327.6800 327.6700 FORMAT "%8.4" ECU_ADDRESS 0xC000AF0A /end MEASUREMENT
/begin MEASUREMENT VSwVlv_r "Sollwert aus ASW." SWORD Prc 1 100 -400.0000 399.9878 ECU_ADDRESS 0xD0001486 /end MEASUREMENT
/begin MEASUREMENT VSwVlv_rAbsVSw_mp "" SWORD DtyCyc 1 100 -327.6800 327.6700 ECU_ADDRESS 0xC000AF0C /end MEASUREMENT
/begin MEASUREMENT VSwVlv_rAct "Stellgliedposition." SWORD Prc 1 100 -400.0000 399.9878 ECU_ADDRESS 0xD0001488 /end MEASUREMENT
/begin MEASUREMENT VSwVlv_rActPosMin_mp "Tatsächlicher Wert des Offsets." SWORD Prc 1 100 -400.0000 399.9878 ECU_ADDRESS 0xC000AEDE /end MEASUREMENT
/begin MEASUREMENT VSwVlv_rActPosOfs_mp "Tatsächlicher Wert des Offsets." SWORD Prc 1 100 -400.0000 399.9878 ECU_ADDRESS 0xC000AEE0 /end MEASUREMENT
/begin MEASUREMENT VSwVlv_rActUnCor_mp "Aktueller Übergangsausgang." SWORD Prc 1 100 -400.0000 399.9878 ECU_ADDRESS 0xC000AEE2 /end MEASUREMENT
/begin MEASUREMENT VSwVlv_rAdapLrnMax_mp "Maximales Lern-Offset." SWORD Prc 1 100 -400.0000 399.9878 ECU_ADDRESS 0xC000AEE4 /end MEASUREMENT
/begin MEASUREMENT VSwVlv_rAdapLrnMinVal_mp "Gelernter Anpassungswert." SWORD Prc 1 100 -400.0000 399.9878 ECU_ADDRESS 0xC000AEE6 /end MEASUREMENT
/begin MEASUREMENT VSwVlv_rAdapLrnMin_mp "Minimales Lern-Offset." SWORD Prc 1 100 -400.0000 399.9878 ECU_ADDRESS 0xC000AEE8 /end MEASUREMENT
/begin MEASUREMENT VSwVlv_rAdapLrn_mp "Gelernter Anpassungswert." SWORD Prc 1 100 -400.0000 399.9878 ECU_ADDRESS 0xC000AEEA /end MEASUREMENT
/begin MEASUREMENT VSwVlv_rAdapMax_mp "maximales Lern-Offset in Minimalstellung." SWORD Prc 1 100 -400.0000 399.9878 ECU_ADDRESS 0xC000AEEC /end MEASUREMENT
/begin MEASUREMENT VSwVlv_rAdapMin_mp "Minimales Lern-Offset in Minimalstellung." SWORD Prc 1 100 -400.0000 399.9878 ECU_ADDRESS 0xC000AEEE /end MEASUREMENT
/begin MEASUREMENT VSwVlv_rAdapPosMin_mp "Gespeicherte Position bei offener Stellung." SWORD Prc 1 100 -400.0000 399.9878 ECU_ADDRESS 0xC000AEF0 /end MEASUREMENT
/begin MEASUREMENT VSwVlv_rAdapPos_mp "Position des Nullpunkts." SWORD Prc 1 100 -400.0000 399.9878 ECU_ADDRESS 0xC000AEF2 /end MEASUREMENT
/begin MEASUREMENT VSwVlv_rCnv_mp "Messpunkt fuer den Ausgang nach der Umrechnung auf Tastverhaeltnis ." SWORD DtyCyc 1 100 -327.6800 327.6700 ECU_ADDRESS 0xC000AF06 /end MEASUREMENT
/begin MEASUREMENT VSwVlv_rGovDvt "Regelabweichung der Lageregelung." SWORD Prc 1 100 -400.0000 399.9878 ECU_ADDRESS 0xD000148E /end MEASUREMENT
/begin MEASUREMENT VSwVlv_rGovMax_mp "Maximale Schwelle des Reglers." SWORD Prc 1 100 -400.0000 399.9878 ECU_ADDRESS 0xC000AF0E /end MEASUREMENT
/begin MEASUREMENT VSwVlv_rGovMin_mp "Minimale Schwelle des Reglers" SWORD Prc 1 100 -400.0000 399.9878 ECU_ADDRESS 0xC000AF10 /end MEASUREMENT
/begin MEASUREMENT VSwVlv_rGovOfsLrnVlv "" SWORD Prc 1 100 -400.0000 399.9878 ECU_ADDRESS 0xD0001490 /end MEASUREMENT
/begin MEASUREMENT VSwVlv_rGovVSw "Stellgröße für den Lageregler." SWORD Prc 1 100 -400.0000 399.9878 ECU_ADDRESS 0xD0001492 /end MEASUREMENT
/begin MEASUREMENT VSwVlv_rGov_mp "Messpunkt für den reglergewünschten Wert." SWORD Prc 1 100 -400.0000 399.9878 ECU_ADDRESS 0xC000AF12 /end MEASUREMENT
/begin MEASUREMENT VSwVlv_rIRed_mp "" SWORD Prc 1 100 -400.0000 399.9878 ECU_ADDRESS 0xC000AF14 /end MEASUREMENT
/begin MEASUREMENT VSwVlv_rLinOfs_mp "Offsetkorrigierter Übergangsausgang." SWORD Prc 1 100 -400.0000 399.9878 ECU_ADDRESS 0xC000AEF4 /end MEASUREMENT
/begin MEASUREMENT VSwVlv_rMinLrnFrst "Erster gelernter Minimalwert." SWORD Prc 1 100 -400.0000 399.9878 ECU_ADDRESS 0xD0001494 /end MEASUREMENT
/begin MEASUREMENT VSwVlv_rMinLrnLst "Zuletzt gelernter Minimalwert" SWORD Prc 1 100 -400.0000 399.9878 ECU_ADDRESS 0xD0001496 /end MEASUREMENT
/begin MEASUREMENT VSwVlv_rMinLrnNew "Neuer minimaler Anpassungswert." SWORD Prc 1 100 -400.0000 399.9878 ECU_ADDRESS 0xD0001498 /end MEASUREMENT
/begin MEASUREMENT VSwVlv_rNrm "normalisierte Position der Regelklappe" SWORD Prc 1 100 -400.0000 399.9878 ECU_ADDRESS 0xD000149A /end MEASUREMENT
/begin MEASUREMENT VSwVlv_rOfsLrnFrst "Erster gelernter Offset-Wert." SWORD Prc 1 100 -400.0000 399.9878 ECU_ADDRESS 0xD000149C /end MEASUREMENT
/begin MEASUREMENT VSwVlv_rOfsLrnLst "Zuletzt gelernter Offset-Wert." SWORD Prc 1 100 -400.0000 399.9878 ECU_ADDRESS 0xD000149E /end MEASUREMENT
/begin MEASUREMENT VSwVlv_rOfsLrnNew "Neuer Anpassungswert." SWORD Prc 1 100 -400.0000 399.9878 ECU_ADDRESS 0xD00014A0 /end MEASUREMENT
/begin MEASUREMENT VSwVlv_rOfsLrnVlv "Tastverhältnis des gelernten Offset-Werts." SWORD Prc 1 100 -400.0000 399.9878 ECU_ADDRESS 0xD00014A2 /end MEASUREMENT
/begin MEASUREMENT VSwVlv_rOutD_mp "Invertierter DT1-Reglerausgang." SWORD Prc 1 100 -400.0000 399.9878 ECU_ADDRESS 0xC000AF16 /end MEASUREMENT
/begin MEASUREMENT VSwVlv_rOutI_mp "I-Reglerausgang." SWORD Prc 1 100 -400.0000 399.9878 ECU_ADDRESS 0xC000AF18 /end MEASUREMENT
/begin MEASUREMENT VSwVlv_rOutP_mp "P-Reglerausgang." SWORD Prc 1 100 -400.0000 399.9878 ECU_ADDRESS 0xC000AF1A /end MEASUREMENT
/begin MEASUREMENT VSwVlv_rPlausLgTMin_mp "Langfristige driftplausibler Wert in minimaler Stellung." SWORD Prc 1 100 -400.0000 399.9878 ECU_ADDRESS 0xC000AEF6 /end MEASUREMENT
/begin MEASUREMENT VSwVlv_rPlausLgT_mp "Langfristiger driftplausibler Wert." SWORD Prc 1 100 -400.0000 399.9878 ECU_ADDRESS 0xC000AEF8 /end MEASUREMENT
/begin MEASUREMENT VSwVlv_rPlausShTMin_mp "Maximale mögliche kurzfristige Drift an minimaler Stellung." SWORD Prc 1 100 -400.0000 399.9878 ECU_ADDRESS 0xC000AEFA /end MEASUREMENT
/begin MEASUREMENT VSwVlv_rPlausShT_mp "Kurzfristiger driftplausibler Wert." SWORD Prc 1 100 -400.0000 399.9878 ECU_ADDRESS 0xC000AEFC /end MEASUREMENT
/begin MEASUREMENT VSwVlv_rPlausValMin_mp "plausibler Wert." SWORD Prc 1 100 -400.0000 399.9878 ECU_ADDRESS 0xC000AEFE /end MEASUREMENT
/begin MEASUREMENT VSwVlv_rPlausVal_mp "plausibler Wert." SWORD Prc 1 100 -400.0000 399.9878 ECU_ADDRESS 0xC000AF00 /end MEASUREMENT
/begin MEASUREMENT VSwVlv_rPs "Ausgabe zur Endstufe" SWORD DtyCyc 1 100 -327.6800 327.6700 ECU_ADDRESS 0xD00014A4 /end MEASUREMENT
/begin MEASUREMENT VSwVlv_rRlsVSw "Stellgröße der Freigabefunktion." SWORD Prc 1 100 -400.0000 399.9878 ECU_ADDRESS 0xD00014A6 /end MEASUREMENT
/begin MEASUREMENT VSwVlv_rSens "Erfasster Wert des Stellgliedesposition" SWORD Prc 1 100 -400.0000 399.9878 ECU_ADDRESS 0xD00014A8 /end MEASUREMENT
/begin MEASUREMENT VSwVlv_rSpgDiagVlv "" SWORD Prc 1 100 -400.0000 399.9878 ECU_ADDRESS 0xD00014AA /end MEASUREMENT
/begin MEASUREMENT VSwVlv_rSumMin_mp "Summierte Anpassungsposition." SLONG Prc 1 100 -26214400.0000 26214399.9878 ECU_ADDRESS 0xC0009400 /end MEASUREMENT
/begin MEASUREMENT VSwVlv_rSum_mp "Summierte Anpassungsposition." SLONG Prc 1 100 -26214400.0000 26214399.9878 ECU_ADDRESS 0xC0009404 /end MEASUREMENT
/begin MEASUREMENT VSwVlv_rVSw "Ansteuertastverhältnis für das VSw-Ventil." SWORD Prc 1 100 -400.0000 399.9878 ECU_ADDRESS 0xD00014AC /end MEASUREMENT
/begin MEASUREMENT VSwVlv_rWinNeg_mp "" SWORD Prc 1 100 -400.0000 399.9878 ECU_ADDRESS 0xC000AF1C /end MEASUREMENT
/begin MEASUREMENT VSwVlv_rWinPos_mp "" SWORD Prc 1 100 -400.0000 399.9878 ECU_ADDRESS 0xC000AF1E /end MEASUREMENT
/begin MEASUREMENT VSwVlv_stAdap "Schalter Status-Anpassung" UWORD OneToOne 1 100 0.00 65535.00 ECU_ADDRESS 0xD000166A /end MEASUREMENT
/begin MEASUREMENT VSwVlv_stAdapActv_mp "Zustand Anpassung aktiv-Open, Close oder Pull-Down Zustände." UBYTE OneToOne 1 100 0.00 255.0 ECU_ADDRESS 0xC000B594 /end MEASUREMENT
/begin MEASUREMENT VSwVlv_stAdapRls_mp "Status der Anpassungsfreigabe." UBYTE OneToOne 1 100 0.00 255.0 ECU_ADDRESS 0xC000B595 /end MEASUREMENT
/begin MEASUREMENT VSwVlv_stAdapVlv_mp "Status des Ventilschließens." UBYTE OneToOne 1 100 0.00 255.0 ECU_ADDRESS 0xC000B596 /end MEASUREMENT
/begin MEASUREMENT VSwVlv_stEdgeCls_mp "Geschlossener Status des Anpassungsventils außer zum ersten Mal." UBYTE OneToOne 1 100 0.00 255.0 ECU_ADDRESS 0xC000B597 /end MEASUREMENT
/begin MEASUREMENT VSwVlv_stFrstCls_mp "Status, ob das Ventil zum ersten Mal geschlossen ist." UBYTE OneToOne 1 100 0.00 255.0 ECU_ADDRESS 0xC000B598 /end MEASUREMENT
/begin MEASUREMENT VSwVlv_stMon "Status der Systemwachung" UWORD OneToOne 1 100 0.00 65535.00 ECU_ADDRESS 0xD000166C /end MEASUREMENT
/begin MEASUREMENT VSwVlv_stMovFin_mp "Status des Anpassungszählers, der den maximalen Zählwert überschreitet." UBYTE OneToOne 1 100 0.00 255.0 ECU_ADDRESS 0xC000B599 /end MEASUREMENT
/begin MEASUREMENT VSwVlv_stNewVlvTrg_mp "Trigger für das neue Ventil" UBYTE OneToOne 1 100 0.00 255.0 ECU_ADDRESS 0xC000B59A /end MEASUREMENT
/begin MEASUREMENT VSwVlv_stOfsLrn "Stabiler Anpassungszustand." UBYTE OneToOne 1 100 0.00 255.0 ECU_ADDRESS 0xD00025AF /end MEASUREMENT
/begin MEASUREMENT VSwVlv_stOfsLrnDisbl_mp "Bool zur Sperrung des Offset-Lernens" UBYTE OneToOne 1 100 0.00 255.0 ECU_ADDRESS 0xC000B59B /end MEASUREMENT
/begin MEASUREMENT VSwVlv_stOfsLrnStMch_mp "Aktueller Zustand des Zustandsautomatens." UBYTE OneToOne 1 100 0.00 255.0 ECU_ADDRESS 0xC000B59C /end MEASUREMENT
/begin MEASUREMENT VSwVlv_stOfsLrnStrt "Tester-Schnittstelle." UBYTE OneToOne 1 100 0.00 255.0 ECU_ADDRESS 0xD00025B0 /end MEASUREMENT
/begin MEASUREMENT VSwVlv_stOpnLdDia "Status der Lastabfalldiagnose" UBYTE OneToOne 1 100 0.00 255.0 ECU_ADDRESS 0xD00025B1 /end MEASUREMENT
/begin MEASUREMENT VSwVlv_stPullDwnBuf_mp "Unentprellter Status des Anpassungsventils." UBYTE OneToOne 1 100 0.00 255.0 ECU_ADDRESS 0xC000B59D /end MEASUREMENT
/begin MEASUREMENT VSwVlv_stPullUpBuf_mp "Unentprellter Status des Anpassungsventils." UBYTE OneToOne 1 100 0.00 255.0 ECU_ADDRESS 0xC000B59E /end MEASUREMENT
/begin MEASUREMENT VSwVlv_stRst_mp "Reset-Status des Zustandsautomatens." UBYTE OneToOne 1 100 0.00 255.0 ECU_ADDRESS 0xC000B59F /end MEASUREMENT
/begin MEASUREMENT VSwVlv_stSmallWin "" UBYTE OneToOne 1 100 0.00 255.0 ECU_ADDRESS 0xD00025B2 /end MEASUREMENT
/begin MEASUREMENT VSwVlv_stSpgDiagActv_mp "" UBYTE OneToOne 1 100 0.00 255.0 ECU_ADDRESS 0xC000B5A0 /end MEASUREMENT
/begin MEASUREMENT VSwVlv_stSpgDiagAdap "" UBYTE OneToOne 1 100 0.00 255.0 ECU_ADDRESS 0xD00025B3 /end MEASUREMENT
/begin MEASUREMENT VSwVlv_stSpgDiag_mp "" UBYTE OneToOne 1 100 0.00 255.0 ECU_ADDRESS 0xC000B5A1 /end MEASUREMENT
/begin MEASUREMENT VSwVlv_stStrStMch_mp "Verschiedene Zustände des Store-Zustandsautomatens." UBYTE OneToOne 1 100 0.00 255.0 ECU_ADDRESS 0xC000B5A2 /end MEASUREMENT
/begin MEASUREMENT VSwVlv_stStr_mp "Status des Store-Zustandsautomatens." UBYTE OneToOne 1 100 0.00 255.0 ECU_ADDRESS 0xC000B5A3 /end MEASUREMENT
/begin MEASUREMENT VSwVlv_stTPullDwn_mp "Entprellter Status des Anpassungsventils." UBYTE OneToOne 1 100 0.00 255.0 ECU_ADDRESS 0xC000B5A4 /end MEASUREMENT
/begin MEASUREMENT VSwVlv_stTPullUp_mp "Entprellter Status des Anpassungsventils." UBYTE OneToOne 1 100 0.00 255.0 ECU_ADDRESS 0xC000B5A5 /end MEASUREMENT
/begin MEASUREMENT VSwVlv_stTrgSpgDiag_mp "" UBYTE OneToOne 1 100 0.00 255.0 ECU_ADDRESS 0xC000B5A6 /end MEASUREMENT
/begin MEASUREMENT VSwVlv_stTrg_mp "Triggerstatus für Zustandsübergänge." UBYTE OneToOne 1 100 0.00 255.0 ECU_ADDRESS 0xC000B5A7 /end MEASUREMENT
/begin MEASUREMENT VSwVlv_stVlvClsBuf_mp "Geschlossener Status des Anpassungsventils." UBYTE OneToOne 1 100 0.00 255.0 ECU_ADDRESS 0xC000B5A8 /end MEASUREMENT
/begin MEASUREMENT VSwVlv_stVlvJamBuf_mp "Klemmender Status des Anpassungsventils." UBYTE OneToOne 1 100 0.00 255.0 ECU_ADDRESS 0xC000B5A9 /end MEASUREMENT
/begin MEASUREMENT VSwVlv_stVlvOpnBuf_mp "Offener Status des Anpassungsventils." UBYTE OneToOne 1 100 0.00 255.0 ECU_ADDRESS 0xC000B5AA /end MEASUREMENT
/begin MEASUREMENT VSwVlv_stVlvOpnd_mp "Status des geöffneten Ventils." UBYTE OneToOne 1 100 0.00 255.0 ECU_ADDRESS 0xC000B5AB /end MEASUREMENT
/begin MEASUREMENT VSwVlv_stVlvStkOpn_mp "Status des klemmenden Anpassungsventils bei offener Stellung." UBYTE OneToOne 1 100 0.00 255.0 ECU_ADDRESS 0xC000B5AC /end MEASUREMENT
/begin MEASUREMENT VSwVlv_stVlvStk_mp "Status des klemmenden Anpassungsventils." UBYTE OneToOne 1 100 0.00 255.0 ECU_ADDRESS 0xC000B5AD /end MEASUREMENT
/begin MEASUREMENT VSwVlv_swtSlwCls_mp "Messpunkt zur Erkennung des langsamen Schließens." UBYTE OneToOne 1 100 0.00 255.0 ECU_ADDRESS 0xC000B5AE /end MEASUREMENT
/begin MEASUREMENT VSwVlv_swtSlwOpn_mp "Messpunkt zur Erkennung des langsamen Öffnens." UBYTE OneToOne 1 100 0.00 255.0 ECU_ADDRESS 0xC000B5AF /end MEASUREMENT
/begin MEASUREMENT VSwVlv_tiIRedTmr_mp "" SWORD Time_ms 1 100 -327680.0 327670.0 ECU_ADDRESS 0xC000AF20 /end MEASUREMENT
/begin MEASUREMENT VSwVlv_tiRmpOpnOvr_mp "" SWORD Time_ms 1 100 -327680.0 327670.0 ECU_ADDRESS 0xC000AF02 /end MEASUREMENT
/begin MEASUREMENT VSwVlv_uRaw "Rohspannungswert aus ADC" SWORD Volt 1 100 -6553.600 6553.400 ECU_ADDRESS 0xD00014AE /end MEASUREMENT
/begin MEASUREMENT WaHt_nMin "Erhöhte Leerlaufdrehzahl bei Zuschalten eines elektrischen Zusatzwasserheizers." SWORD EngN 1 100 -16384.00 16383.50 ECU_ADDRESS 0xD00014D4 /end MEASUREMENT
/begin MEASUREMENT WaHt_rHtgOut "verfügbare Generatorlast für Zuheizer." SWORD DtyCyc 1 100 -327.6800 327.6700 ECU_ADDRESS 0xD00014D6 /end MEASUREMENT
/begin MEASUREMENT WaHt_stHtgUp "Warmlaufzustand des Motors (0...Zustand Warmlauf, 1...Zustand Betriebswarm)." UBYTE OneToOne 1 100 0.00 255.0 ECU_ADDRESS 0xD00025C2 /end MEASUREMENT
/begin MEASUREMENT WaHt_stShutOff_mp "Status Abschaltbedingengungen." UWORD OneToOne 1 100 0.00 65535.00 ECU_ADDRESS 0xC000AF24 /end MEASUREMENT
/begin MEASUREMENT WaHt_tEnvLin_mp "Umgebungstemperatur nach Kennlinie" SWORD Temp_Cels 1 100 -3549.940 3003.560 ECU_ADDRESS 0xC000AF22 /end MEASUREMENT
/begin MEASUREMENT ZFC_dpRailLim_mp "Aktuelle max Raildruckabweichung für die Nullmengenkalibrierung" SWORD Pres_Rail 1 100 -3276.800 2000.000 ECU_ADDRESS 0xC000AF26 /end MEASUREMENT
/begin MEASUREMENT ZFC_dpRail_mp "Raildruckabweichung zum Raildruck Kalibrierungspunkt" SWORD Pres_Rail 1 100 -3276.800 2000.000 ECU_ADDRESS 0xC000AF28 /end MEASUREMENT
/begin MEASUREMENT ZFC_idxFBCElm_mp "Index des FBC Parameter für Betriebspunktanzeige in Kennfeldern" UBYTE OneToOne 1 100 0.00 255.0 ECU_ADDRESS 0xC000B5B1 /end MEASUREMENT
/begin MEASUREMENT ZFC_numCylInj_mp "Aktuelle Zylindernummer für die Einspritzung der Nullmengenkalibrierung" UBYTE OneToOne 1 100 0.00 255.0 ECU_ADDRESS 0xC000B5B5 /end MEASUREMENT
/begin MEASUREMENT ZFC_phiInj_mp "Ansteuerbeginn der Einspritzung für die Nullmengenkalibrierung" SWORD AngleCrS 1 100 -720.0000 719.9780 ECU_ADDRESS 0xC000AF30 /end MEASUREMENT
/begin MEASUREMENT ZFC_pRailSetPoint_mp "Angeforderter Raildrucksollwert der Nullmengenkalibrierung" SWORD Pres_Rail 1 100 -3276.800 2000.000 ECU_ADDRESS 0xC000AF2A /end MEASUREMENT
/begin MEASUREMENT ZFC_SigThres_mp "Aktuelle Signalschwelle für die Nullmengenkalibrierung" SWORD OneToOne 1 100 -32768.00 32767.00 ECU_ADDRESS 0xC000AF2E /end MEASUREMENT
/begin MEASUREMENT ZFC_Sig_mp "Messwert der Kalibrierung" SLONG OneToOne 1 100 -2147483648.00 2147483647.00 ARRAY_SIZE 6 ECU_ADDRESS 0xC000C4CC /end MEASUREMENT
/begin MEASUREMENT ZFC_stCldCham "Zustand des Brennraums für die Nullmengenkalibrierung" UBYTE OneToOne 1 100 0.00 255.0 ECU_ADDRESS 0xD00025C3 /end MEASUREMENT
/begin MEASUREMENT ZFC_stCmbCham_mp "Zustand der Erkennung kalter Brennraum für die Nullmengenkalibrierung" UBYTE OneToOne 1 100 0.00 255.0 ECU_ADDRESS 0xC000B5B0 /end MEASUREMENT
/begin MEASUREMENT ZFC_stDem_mp "Anforderungen der Nullmengenkalibrierung" UBYTE OneToOne 1 100 0.00 255.0 ECU_ADDRESS 0xC000B5B2 /end MEASUREMENT
/begin MEASUREMENT ZFC_stEvalSig_mp "Status der Auswertung des Signals der Nullmengenkalibrierung" UBYTE ZFC_EvalEngSpd_Rslt 1 100 0.00 2.00000000000 FORMAT "%13.11" ECU_ADDRESS 0xC000B5B4 /end MEASUREMENT
/begin MEASUREMENT ZFC_stInj_mp "Status der Einspritzprogrammierung der Nullmengenkalibrierung" UBYTE ZFC_Inj_State 1 100 0.00 64.0000000000 FORMAT "%13.10" ECU_ADDRESS 0xC000B5B6 /end MEASUREMENT
/begin MEASUREMENT ZFC_st_mp "Status der Nullmengenkalibrierung" UBYTE ZFC_State 1 100 1.00000000000 16.0000000000 FORMAT "%13.10" ECU_ADDRESS 0xC000B5B3 /end MEASUREMENT
/begin MEASUREMENT ZFC_swtClbActv "SW-Schalter für die Aktivierung der ZFC Kalibrierung" UBYTE OneToOne 1 100 0.00 255.0 ECU_ADDRESS 0xD00025C4 /end MEASUREMENT
/begin MEASUREMENT ZFC_tiET_mp "Ansteuerdauer für die Einspritzung der Nullmengenkalibrierung" SWORD InjTime_us 1 100 -13107.20 5000.00 ECU_ADDRESS 0xC000AF32 /end MEASUREMENT
/begin MEASUREMENT ZFC_vStopClb_mp "Minimale Fahrzeuggeschwindigkeit der aktuellen Ansteuerdauerkalibrierung" SWORD Vel 1 100 -327.6800 327.6700 ECU_ADDRESS 0xC000AF2C /end MEASUREMENT
/begin FUNCTION vmadapt_adapt ""
 /begin OUT_MEASUREMENT Com_stDrvDynQl StbIntv_bDCSIntv StbIntv_bDCSNeutr StbIntv_bTCSIntv StbIntv_bTCSNeutr StbIntv_trqDCSDes StbIntv_trqTCSDes StbIntv_trqTCSLead /end OUT_MEASUREMENT
/end FUNCTION
/begin FUNCTION VMDAdapt_Adapt "" /end FUNCTION
/begin FUNCTION VMD_VirtAPP ""
 /begin DEF_CHARACTERISTIC VMD_rEng_MAP VMD_rPrp_MAP VMD_tiFltVirtAPP_C VMD_trqThresEng_CUR VMD_trqThresPrp_CUR /end DEF_CHARACTERISTIC
 /begin IN_MEASUREMENT ACCI_trqDes AccPed_rTrq AccPed_stMS AccPed_trqDes Com_trqWhlDes CoVMD_trqCrCtl Epm_nEng GlbDa_vX PT_trqSpdGovLtd PT_trqWhlMinEng VehMot_rAccPedFlt VehMot_stAccPedOvrRun /end IN_MEASUREMENT
 /begin OUT_MEASUREMENT VMD_rVirtAPP VMD_stVirtAPP /end OUT_MEASUREMENT
 /begin LOC_MEASUREMENT VMD_rVirtAPPDes VMD_rVirtAPP_raw_mp VMD_stVirtAPPOvr_mp VMD_trqEng VMD_trqPrpCorr VMD_trqRaw /end LOC_MEASUREMENT
/end FUNCTION
/begin FUNCTION VMSI_PlausTrqIntv ""
 /begin DEF_CHARACTERISTIC VMSI_dtrqRmpDCSP.Pos_C VMSI_dtrqRmpDCSP.Neg_C VMSI_dtrqRmpTCSP.Pos_C VMSI_dtrqRmpTCSP.Neg_C VMSI_stCfg_C VMSI_swtSlipCtl_C /end DEF_CHARACTERISTIC
 /begin IN_MEASUREMENT MoFExtInt_stDCSPtdMsg StbIntv_bDCSIntv StbIntv_bDCSNeutr StbIntv_bTCSIntv StbIntv_bTCSNeutr StbIntv_trqDCSDes StbIntv_trqTCSDes StbIntv_trqTCSLead VehMot_stStabIntv /end IN_MEASUREMENT
 /begin OUT_MEASUREMENT VMSI_stDCSPtd VMSI_trqDesMax VMSI_trqLeadMax VMSI_trqMin /end OUT_MEASUREMENT
 /begin LOC_MEASUREMENT VMSI_trqDCSRmpOut_mp VMSI_trqTCSRmpOut_mp /end LOC_MEASUREMENT
/end FUNCTION
/begin FUNCTION VSwCtl_CtlValCalc ""
 /begin DEF_CHARACTERISTIC VSwCtl_facEngTempCtlCor_CUR VSwCtl_facEnvPresCtlCorEOMQnt1_CUR VSwCtl_facEnvPresCtlCor_CUR VSwCtl_facRmpValCtlCor_CUR VSwCtl_facVehTempCorr_CUR VSwCtl_facVehVCorr_CUR VSwCtl_numEngTempCtlVal_C VSwCtl_rCtlBasEOMQnt1_MAP VSwCtl_rCtlBasHiAltdEOMQnt1_MAP VSwCtl_rCtlBasHiAltd_MAP VSwCtl_rCtlBas_MAP VSwCtl_rCtlValCorMax_C VSwCtl_rCtlValCorMin_C VSwCtl_rDflVal_CA VSwCtl_rEngTempCorBas_MAP VSwCtl_rThresMax_C VSwCtl_rThresMin_C VSwCtl_rVehVCorr_MAP VSwCtl_rVSAAirTempCorr_CUR VSwCtl_rVSAMax_C VSwCtl_rVSAMin_C VSwCtl_stBitMskEOM_CA VSwCtl_stCtlValEOMMsk_CA VSwCtl_stMonEOMMsk_CA VSwCtl_stPrioMon_CA VSwCtl_stShOffEOMMsk_C VSwCtl_swtHysOff_C VSwCtl_swtQntCtl_C VSwCtl_swtTrqCtl_C VSwCtl_tiMonEOM_CA VSwCtl_tiPT1CtlValCor_C VSwCtl_tiStartDelay_CUR /end DEF_CHARACTERISTIC
 /begin IN_MEASUREMENT AFS_stDrft AirCtl_stMon Air_tAFSCorr CEngDsT_t CoEng_st CoEOM_facRmpVal CoEOM_stOpModeAct EngDa_tFld EnvP_p Epm_nEng InjCtl_qCurr InjCtl_qRaw PthLead_trqInrCurr PthLead_trqInrLead VehV_v VSwVlv_r /end IN_MEASUREMENT
 /begin OUT_MEASUREMENT VSwCtl_qCtlVal VSwCtl_stEOMMon VSwCtl_stMon VSwCtl_stVSwBits VSwCtl_trqCtlVal /end OUT_MEASUREMENT
 /begin LOC_MEASUREMENT VSwCtl_facEngTempCtlCor_mp VSwCtl_facEnvPresCtlCorEOMQnt1_mp VSwCtl_facEnvPresCtlCor_mp VSwCtl_facRmpValCtlCor_mp VSwCtl_facRmpVal_mp VSwCtl_numEOMMode_mp VSwCtl_qCtlVal_mp VSwCtl_qCurr_mp VSwCtl_rCtlBasEOMQnt1_mp VSwCtl_rCtlBasEOMTrq4_mp VSwCtl_rCtlBasHiAltdEOMQnt1_mp VSwCtl_rCtlBasHiAltd_mp VSwCtl_rCtlBas_mp VSwCtl_rCtlCor_mp VSwCtl_rCtlVal1EOMQnt1_mp VSwCtl_rCtlVal1_mp VSwCtl_rCtlVal2_mp VSwCtl_rCtlValCorLim_mp VSwCtl_rCtlValCorUnFlt_mp VSwCtl_rCtlValCor_mp VSwCtl_rCtlValNrm_mp VSwCtl_rEngTempCorBas_mp VSwCtl_rEngTempCor_mp VSwCtl_rVehCorrSwt_mp VSwCtl_rVehCorr_mp VSwCtl_stBitMskEOM_mp VSwCtl_stEOMCtlVal_mp VSwCtl_stMonBits_mp VSwCtl_stSelBitMskEOM_mp VSwCtl_tEngCtlVal_mp VSwCtl_tiMonEOM_mp VSwCtl_tiStartDelay_mp VSwCtl_trqInrCurr_mp /end LOC_MEASUREMENT
/end FUNCTION
/begin FUNCTION vswvlvapos_dd ""
 /begin DEF_CHARACTERISTIC VSwVlv_rTransf_CUR VSwVlv_SRC.uMin_C VSwVlv_SRC.uMax_C VSwVlv_swtNrmSel_C VSwVlv_swtSensPrs_C VSwVlv_uRefSens_C /end DEF_CHARACTERISTIC
 /begin OUT_MEASUREMENT VSwVlv_rNrm VSwVlv_rSens VSwVlv_uRaw /end OUT_MEASUREMENT
/end FUNCTION
/begin FUNCTION vswvlvapos_vd ""
 /begin DEF_CHARACTERISTIC VSwVlv_ctStrtOfsLrn_C VSwVlv_drOfsLrnVlvSlpDwn_C VSwVlv_drOfsLrnVlvSlpUp_C VSwVlv_drSpgDiagVlvSlpDwn_C VSwVlv_drSpgDiagVlvSlpUp_C VSwVlv_numAdapClsMax_C VSwVlv_rActMax_C VSwVlv_rActMin_C VSwVlv_rActPosMin_C VSwVlv_rActPosOfs_C VSwVlv_rAdapAgClsMin_C VSwVlv_rAdapAgOpnMax_C VSwVlv_rAdapDiffPlausLgT_C VSwVlv_rAdapDiffPlausMin_C VSwVlv_rAdapDiffPlausShT_C VSwVlv_rAdapDiffPlaus_C VSwVlv_rCmpNewCtlUn_C VSwVlv_rCmpNewECU_C VSwVlv_rMinLrnLstCor_C VSwVlv_RmpSlp.Pos_C VSwVlv_RmpSlp.Neg_C VSwVlv_rOfsLrnLstCor_C VSwVlv_rOfsLrnVlvMax_C VSwVlv_rOfsLrnVlvMin_C VSwVlv_rOfsMax_C VSwVlv_rOfsMin_C VSwVlv_rOpnSpgDiag_C VSwVlv_rPlausLgTMin_C VSwVlv_rPlausShTMin_C VSwVlv_rSpgDiagVlvMax_C VSwVlv_rSpgDiagVlvMin_C VSwVlv_stNewVlvTrg_C VSwVlv_stOfsLrnTrg_C VSwVlv_stSpgDiagTrg_C VSwVlv_swtActPosOfs_C VSwVlv_swtOfsLrnActv_C VSwVlv_swtSpgDiagActv_C VSwVlv_tEngMax_C VSwVlv_tEngMin_C VSwVlv_tiAdapJamVlv_C VSwVlv_tiAdapPullDwn_C VSwVlv_tiAdapPullUp_C VSwVlv_tiOpnJamVlv_C VSwVlv_tiOpnSpgDiag_C VSwVlv_tiRmpOpnOvr_C VSwVlv_tiSmallWin_C VSwVlv_TransStg.Dfl_C VSwVlv_TransStg.stSensId_C VSwVlv_uBattMax_C VSwVlv_uBattMin_C /end DEF_CHARACTERISTIC
 /begin IN_MEASUREMENT BattU_u CoEng_st CoEng_stOld CoEng_stOldOld DevLib_stPwrStgEnaCond EngDa_tEng SyC_stSub VSwVlv_rSens VSwVlv_stMon /end IN_MEASUREMENT
 /begin OUT_MEASUREMENT VSwVlv_rAct VSwVlv_rGovOfsLrnVlv VSwVlv_rMinLrnFrst VSwVlv_rMinLrnLst VSwVlv_rMinLrnNew VSwVlv_rOfsLrnFrst VSwVlv_rOfsLrnLst VSwVlv_rOfsLrnNew VSwVlv_rOfsLrnVlv VSwVlv_rSpgDiagVlv VSwVlv_stAdap VSwVlv_stOfsLrn VSwVlv_stOfsLrnStrt VSwVlv_stSpgDiagAdap /end OUT_MEASUREMENT
 /begin LOC_MEASUREMENT VSwVlv_ctAdapCls_mp VSwVlv_ctStrtOfsLrn_mp VSwVlv_rActPosMin_mp VSwVlv_rActPosOfs_mp VSwVlv_rActUnCor_mp VSwVlv_rAdapLrnMax_mp VSwVlv_rAdapLrnMinVal_mp VSwVlv_rAdapLrnMin_mp VSwVlv_rAdapLrn_mp VSwVlv_rAdapMax_mp VSwVlv_rAdapMin_mp VSwVlv_rAdapPosMin_mp VSwVlv_rAdapPos_mp VSwVlv_rLinOfs_mp VSwVlv_rPlausLgTMin_mp VSwVlv_rPlausLgT_mp VSwVlv_rPlausShTMin_mp VSwVlv_rPlausShT_mp VSwVlv_rPlausValMin_mp VSwVlv_rPlausVal_mp VSwVlv_rSumMin_mp VSwVlv_rSum_mp VSwVlv_stAdapActv_mp VSwVlv_stAdapRls_mp VSwVlv_stAdapVlv_mp VSwVlv_stEdgeCls_mp VSwVlv_stFrstCls_mp VSwVlv_stMovFin_mp VSwVlv_stNewVlvTrg_mp VSwVlv_stOfsLrnDisbl_mp VSwVlv_stOfsLrnStMch_mp VSwVlv_stPullDwnBuf_mp VSwVlv_stPullUpBuf_mp VSwVlv_stRst_mp VSwVlv_stSpgDiagActv_mp VSwVlv_stSpgDiag_mp VSwVlv_stStrStMch_mp VSwVlv_stStr_mp VSwVlv_stTPullDwn_mp VSwVlv_stTPullUp_mp VSwVlv_stTrgSpgDiag_mp VSwVlv_stTrg_mp VSwVlv_stVlvClsBuf_mp VSwVlv_stVlvJamBuf_mp VSwVlv_stVlvOpnBuf_mp VSwVlv_stVlvOpnd_mp VSwVlv_stVlvStkOpn_mp VSwVlv_stVlvStk_mp VSwVlv_tiRmpOpnOvr_mp /end LOC_MEASUREMENT
/end FUNCTION
/begin FUNCTION VSwVlv_DD ""
 /begin DEF_CHARACTERISTIC VSwVlv_facLpGnStrt_C VSwVlv_HBrgPar.rTstDtyCyc_C VSwVlv_HBrgPar.tiDisblDiaTmpDef_C VSwVlv_HBrgPar.tiDisblDiaPermDef_C VSwVlv_HBrgPar.tiOpnLdDiaEna_C VSwVlv_HBrgPar.tiMaxOpnLdDiaEna_C VSwVlv_Pwm.tiPer_C VSwVlv_Pwm.stLvl_C VSwVlv_Pwm.rMaxDty_C VSwVlv_Pwm.rPerUn_C VSwVlv_Pwm.tiPh_C VSwVlv_PwmOut.rMin_C VSwVlv_PwmOut.rMax_C VSwVlv_PwmOut.tiBtwTstSCB_C VSwVlv_PwmOut.tiBtwTstOT_C VSwVlv_PwmOut.numTstMax_C VSwVlv_PwmOut.swtBattCor_C VSwVlv_PwmOut.swtPsInv_C VSwVlv_rCnv_CUR VSwVlv_stPsDiaDisbl_C VSwVlv_stPsDisbl_C VSwVlv_swtChpSel_C VSwVlv_swtHwSel_C VSwVlv_swtOpnLdDiaStrt_C VSwVlv_swtSelOvrCurrErr_C VSwVlv_tiPT1FacCor_C VSwVlv_tiUpdate_C /end DEF_CHARACTERISTIC
 /begin IN_MEASUREMENT BattU_facCor DevLib_stPwrStgEnaCond VSwVlv_rSpgDiagVlv VSwVlv_rVSw VSwVlv_stSpgDiagAdap /end IN_MEASUREMENT
 /begin OUT_MEASUREMENT VSwVlv_rPs /end OUT_MEASUREMENT
 /begin LOC_MEASUREMENT VSwVlv_facCorFlt_mp VSwVlv_rCnv_mp VSwVlv_stOpnLdDia /end LOC_MEASUREMENT
/end FUNCTION
/begin FUNCTION vswvlv_vdmon ""
 /begin DEF_CHARACTERISTIC VSwVlv_rDvtMax_C VSwVlv_rDvtMin_C VSwVlv_RlsIKi_C VSwVlv_rRlsMax_C VSwVlv_rRlsMin_C VSwVlv_tiRepRls_C VSwVlv_tiRls_C /end DEF_CHARACTERISTIC
 /begin IN_MEASUREMENT CoEng_st VSwVlv_rGovDvt VSwVlv_stAdap /end IN_MEASUREMENT
 /begin OUT_MEASUREMENT VSwVlv_rRlsVSw VSwVlv_stMon /end OUT_MEASUREMENT
/end FUNCTION
/begin FUNCTION vswvlv_vdposgov ""
 /begin DEF_CHARACTERISTIC VSwVlv_DKdNgv_C VSwVlv_DKdPsv_C VSwVlv_drActNgv_C VSwVlv_drActPsv_C VSwVlv_iEff_CUR VSwVlv_IKiNgv_C VSwVlv_IKiPsv_C VSwVlv_PKpNgv_C VSwVlv_PKpPsv_C VSwVlv_rActNgv_C VSwVlv_rActPsv_C VSwVlv_rAdap_CUR VSwVlv_rDfl_C VSwVlv_rDMax_C VSwVlv_rdycMaxRed_C VSwVlv_rdycMin_C VSwVlv_rGovDvtThres_C VSwVlv_rGovMax_CUR VSwVlv_rGovMin_CUR VSwVlv_rIRedStep_C VSwVlv_rMax_C VSwVlv_rMin_C VSwVlv_rOutDMax_C VSwVlv_rOutIMax_C VSwVlv_rPreCtl_CUR VSwVlv_rWinNeg_CUR VSwVlv_rWinPos_CUR VSwVlv_SlwClsDKd_C VSwVlv_SlwClsIKi_C VSwVlv_SlwClsPKp_C VSwVlv_SlwOpnDKd_C VSwVlv_SlwOpnIKi_C VSwVlv_SlwOpnPKp_C VSwVlv_SmlSigNgvDKd_C VSwVlv_SmlSigNgvIKi_C VSwVlv_SmlSigNgvPKp_C VSwVlv_SmlSigPsvDKd_C VSwVlv_SmlSigPsvIKi_C VSwVlv_SmlSigPsvPKp_C VSwVlv_swtGovByp_C VSwVlv_swtLim_C VSwVlv_tiCrntEffFlt_C VSwVlv_tiFailSafe_C VSwVlv_tiGovDT1_C VSwVlv_tiIRedDly_C VSwVlv_tiSlwParDT1_C /end DEF_CHARACTERISTIC
 /begin IN_MEASUREMENT VSwVlv_rGovOfsLrnVlv VSwVlv_stOfsLrn /end IN_MEASUREMENT
 /begin OUT_MEASUREMENT VSwVlv_r VSwVlv_rGovDvt VSwVlv_rGovVSw VSwVlv_rVSw VSwVlv_stSmallWin /end OUT_MEASUREMENT
 /begin LOC_MEASUREMENT VSwVlv_iEffFlt_mp VSwVlv_iEff_mp VSwVlv_rAbsVSw_mp VSwVlv_rGovMax_mp VSwVlv_rGovMin_mp VSwVlv_rGov_mp VSwVlv_rIRed_mp VSwVlv_rOutD_mp VSwVlv_rOutI_mp VSwVlv_rOutP_mp VSwVlv_rWinNeg_mp VSwVlv_rWinPos_mp VSwVlv_swtSlwCls_mp VSwVlv_swtSlwOpn_mp VSwVlv_tiIRedTmr_mp /end LOC_MEASUREMENT
/end FUNCTION
/begin FUNCTION WaHt_Demand ""
 /begin DEF_CHARACTERISTIC WaHt_nACEngXHigh_C WaHt_nACEngXLow_C WaHt_nDAEng_C WaHt_nMin_C WaHt_rHtgOutMax_C WaHt_rHtgOutMin_C WaHt_swtHtgUp_C WaHt_tEnvHysDelta_C WaHt_tEnv_CUR WaHt_tiACMin_C WaHt_tiDAMin_C WaHt_tiStrt_C WaHt_trqInrLimDelta_C WaHt_vDAVeh_C /end DEF_CHARACTERISTIC
 /begin IN_MEASUREMENT GlbDa_tEnv /end IN_MEASUREMENT
 /begin OUT_MEASUREMENT WaHt_nMin WaHt_rHtgOut WaHt_stHtgUp /end OUT_MEASUREMENT
 /begin LOC_MEASUREMENT Layer_rPTC WaHt_stShutOff_mp WaHt_tEnvLin_mp /end LOC_MEASUREMENT
/end FUNCTION
/begin FUNCTION ZFC_CldCmbCham "" /begin DEF_CHARACTERISTIC ZFC_tiCldCham_CUR ZFC_tiHotCham_C /end DEF_CHARACTERISTIC /begin IN_MEASUREMENT CACDsT_t InjCtl_qSetUnBal /end IN_MEASUREMENT /begin OUT_MEASUREMENT ZFC_stCldCham /end OUT_MEASUREMENT /begin LOC_MEASUREMENT ZFC_stCmbCham_mp /end LOC_MEASUREMENT /end FUNCTION
/begin FUNCTION ZFC_Co ""
 /begin DEF_CHARACTERISTIC ZFC_dBPFacFBCG3_GMAP ZFC_dBPFacFBCG4_GMAP ZFC_dBPFacFBCG5_GMAP ZFC_dBPFacFBCG6_GMAP ZFC_dBPFacFBCG7_GMAP ZFC_dSegFBCCaSG3_GMAP ZFC_dSegFBCCaSG4_GMAP ZFC_dSegFBCCaSG5_GMAP ZFC_dSegFBCCaSG6_GMAP ZFC_dSegFBCCaSG7_GMAP ZFC_idxFBCElm_C ZFC_idxFBCVal_AXIS ZFC_nAvrgMax_C ZFC_nAvrgMin_C ZFC_nChngPRailMax_C ZFC_nFBCThresMax_C ZFC_nFBCVal_AXIS ZFC_nHyst_C ZFC_pACMax_C ZFC_pBstMin_C ZFC_rAccPedMax_C ZFC_stACSel_C ZFC_stClthSel_C ZFC_stGearRls_CA ZFC_tAirThres_C ZFC_tEngThres_C ZFC_tFuelThresMax_C ZFC_tFuelThresMin_C ZFC_tiDelOvrRun_C ZFC_tiDelpRailLim_C ZFC_uBattMin_C /end DEF_CHARACTERISTIC
 /begin IN_MEASUREMENT ACCtl_stOut AirC_pClnt Air_pIntkVUs BattU_u CACDsT_t Clth_st EngDa_tEng Epm_nEng Epm_numCyl ETClb_stLimClbFrq FBC_Badpt FBC_ctSegInt FBC_dBPSum FBC_RegionChng FBC_stLearn FuelT_t PCR_stMon PthSet_stOvrRunCoord RailP_pFlt Tra_numGearDes TS_stMnSwtAC VehV_v ZFC_stCldCham /end IN_MEASUREMENT
 /begin LOC_MEASUREMENT ZFC_dpRailLim_mp ZFC_dpRail_mp ZFC_idxFBCElm_mp ZFC_pRailSetPoint_mp ZFC_stDem_mp ZFC_st_mp ZFC_swtClbActv ZFC_vStopClb_mp /end LOC_MEASUREMENT
/end FUNCTION
/begin FUNCTION ZFC_EvalEngSpd "" /begin IN_MEASUREMENT Epm_numCyl /end IN_MEASUREMENT /begin LOC_MEASUREMENT ZFC_SigThres_mp ZFC_Sig_mp ZFC_stEvalSig_mp /end LOC_MEASUREMENT /end FUNCTION
/begin FUNCTION ZFC_Inj "" /begin DEF_CHARACTERISTIC ZFC_phiSet_CUR /end DEF_CHARACTERISTIC /begin IN_MEASUREMENT Epm_nEng /end IN_MEASUREMENT /begin LOC_MEASUREMENT ZFC_numCylInj_mp ZFC_phiInj_mp ZFC_stInj_mp ZFC_tiET_mp /end LOC_MEASUREMENT /end FUNCTION
/begin FUNCTION _k2rei "Applizierbare Diagnose Informationen" /begin DEF_CHARACTERISTIC K2REI_dCodInd_C K2REI_dDiaInd_C K2REI_dSGFam_C /end DEF_CHARACTERISTIC /end FUNCTION
/begin COMPU_METHOD AirMassPerCyl "" RAT_FUNC "%5.1" "mg/Hub" COEFFS 0 10 0 0 0 1 /end COMPU_METHOD
/begin COMPU_METHOD AirMassPerTime "" RAT_FUNC "%5.1" "Kg/h" COEFFS 0 10 0 0 0 1 /end COMPU_METHOD
/begin COMPU_METHOD AirVolPerTime "" RAT_FUNC "%6.3" "m^3/h" COEFFS 0 10 0 0 0 1 /end COMPU_METHOD
/begin COMPU_METHOD AngleCrS "" RAT_FUNC "%6.3" "deg CrS" COEFFS 0 45.5111111111 0 0 0 1 /end COMPU_METHOD
/begin COMPU_METHOD Area "" RAT_FUNC "%6.5" "m*m" COEFFS 0 8192 0 0 0 1 /end COMPU_METHOD
/begin COMPU_METHOD CoEOMSwt_S16 "" RAT_FUNC "%7.6" "-" COEFFS 0 16384 0 0 0 1 /end COMPU_METHOD
/begin COMPU_METHOD COEOM_PCRTRQNUMMAP_SY_Compu "" TAB_NOINTP "%6.3" "" COMPU_TAB_REF COEOM_PCRTRQNUMMAP_SY_Compu /end COMPU_METHOD
/begin COMPU_TAB COEOM_PCRTRQNUMMAP_SY_Compu "" TAB_NOINTP 8 0 0 1 1 2 2 3 3 4 4 5 5 6 6 7 7 /end COMPU_TAB
/begin COMPU_METHOD COEOM_TYP_SY_Compu "" TAB_VERB "%6.3" "" COMPU_TAB_REF COEOM_TYP_SY_Compu /end COMPU_METHOD
/begin COMPU_VTAB COEOM_TYP_SY_Compu "" TAB_VERB 2 1 "HESRV_SNGLFLW" 2 "HESRV_TWFLW" /end COMPU_VTAB
/begin COMPU_METHOD COEOM_VSWCTLQNTNUMMAP_SY_Compu "" TAB_NOINTP "%6.3" "" COMPU_TAB_REF COEOM_VSWCTLQNTNUMMAP_SY_Compu /end COMPU_METHOD
/begin COMPU_TAB COEOM_VSWCTLQNTNUMMAP_SY_Compu "" TAB_NOINTP 8 0 0 1 1 2 2 3 3 4 4 5 5 6 6 7 7 /end COMPU_TAB
/begin COMPU_METHOD COEOM_VSWCTLTRQNUMMAP_SY_Compu "" TAB_NOINTP "%6.3" "" COMPU_TAB_REF COEOM_VSWCTLTRQNUMMAP_SY_Compu /end COMPU_METHOD
/begin COMPU_TAB COEOM_VSWCTLTRQNUMMAP_SY_Compu "" TAB_NOINTP 8 0 0 1 1 2 2 3 3 4 4 5 5 6 6 7 7 /end COMPU_TAB
/begin COMPU_METHOD COMassPerTime "" RAT_FUNC "%6.4" "mg/s" COEFFS 0 20 0 0 0 1 /end COMPU_METHOD
/begin COMPU_METHOD CppFacCylVol "" RAT_FUNC "%7.6" "-" COEFFS 0 32768 0 0 0 1 /end COMPU_METHOD
/begin COMPU_METHOD CppOfsFact "" RAT_FUNC "%6.4" "-" COEFFS 0 256 0 0 0 1 /end COMPU_METHOD
/begin COMPU_METHOD CRSSENSTYP_SY_Compu "" TAB_VERB "%6.3" "" COMPU_TAB_REF CRSSENSTYP_SY_Compu /end COMPU_METHOD
/begin COMPU_VTAB CRSSENSTYP_SY_Compu "" TAB_VERB 3 0 "CRSSENS_STD" 1 "CRSSENS_ITL" 2 "CRSSENS_ABS" /end COMPU_VTAB
/begin COMPU_METHOD CTHMST_ATSINTVMOD_SY_Compu "" TAB_VERB "%6.3" "" COMPU_TAB_REF CTHMST_ATSINTVMOD_SY_Compu /end COMPU_METHOD
/begin COMPU_VTAB CTHMST_ATSINTVMOD_SY_Compu "" TAB_VERB 2 0 "False" 1 "True" /end COMPU_VTAB
/begin COMPU_METHOD Curr_A "" RAT_FUNC "%6.4" "A" COEFFS 0 100 0 0 0 1 /end COMPU_METHOD
/begin COMPU_METHOD CylFltPrm "" RAT_FUNC "%7.6" "-" COEFFS 0 32767 0 0 0 1 /end COMPU_METHOD
/begin COMPU_METHOD CylHtRls "" RAT_FUNC "%6.3" "J" COEFFS 0 4 0 0 0 1 /end COMPU_METHOD
/begin COMPU_METHOD CylHtRlsRate "" RAT_FUNC "%6.4" "J/AgCA" COEFFS 0 64 0 0 0 1 /end COMPU_METHOD
/begin COMPU_METHOD CylinderVolumeCpp "" RAT_FUNC "%9.8" "m^3" COEFFS 0 1000000 0 0 0 1 /end COMPU_METHOD
/begin COMPU_METHOD CylK1 "" RAT_FUNC "%6.4" "10^-5m^3/AgCA" COEFFS 0 128 0 0 0 1 /end COMPU_METHOD
/begin COMPU_METHOD CylK2 "" RAT_FUNC "%7.6" "-" COEFFS 0 16384 0 0 0 1 /end COMPU_METHOD
/begin COMPU_METHOD Def_dez_uw_q1 "" RAT_FUNC "%5.2" "-" COEFFS 0 1 0 0 0 1 /end COMPU_METHOD
/begin COMPU_METHOD Def_st_ub_q1 "" RAT_FUNC "%3.1" "-" COEFFS 0 1 0 0 0 1 /end COMPU_METHOD
/begin COMPU_METHOD DFC_OneToOne "" RAT_FUNC "%6.0" "-" COEFFS 0 1 0 0 0 1 /end COMPU_METHOD
/begin COMPU_METHOD DtyCyc "" RAT_FUNC "%5.2" "%" COEFFS 0 100 0 0 0 1 /end COMPU_METHOD
/begin COMPU_METHOD Energy "" RAT_FUNC "%6.2" "kJ" COEFFS 0 1 0 0 0 1 /end COMPU_METHOD
/begin COMPU_METHOD EngN "" RAT_FUNC "%5.1" "rpm" COEFFS 0 2 0 0 0 1 /end COMPU_METHOD
/begin COMPU_METHOD EngTempFldSel "" TAB_VERB "%6.3" "" COMPU_TAB_REF EngTempFldSel /end COMPU_METHOD
/begin COMPU_VTAB EngTempFldSel "" TAB_VERB 4 0 "Coolant_Temperature" 1 "Oil_Temperature" 2 "EngDa_tEng" 3 "Chamberwall_Temperature" /end COMPU_VTAB
/begin COMPU_METHOD Fact "" RAT_FUNC "%6.5" "-" COEFFS 0 8192 0 0 0 1 /end COMPU_METHOD
/begin COMPU_METHOD Fact1 "" RAT_FUNC "%6.4" "-" COEFFS 0 128 0 0 0 1 /end COMPU_METHOD
/begin COMPU_METHOD Fact8 "" RAT_FUNC "%11.10" "-" COEFFS 0 100000000 0 0 0 1 /end COMPU_METHOD
/begin COMPU_METHOD HBrgChpSel "" TAB_VERB "%6.3" "" COMPU_TAB_REF HBrgChpSel /end COMPU_METHOD
/begin COMPU_VTAB HBrgChpSel "" TAB_VERB 2 0 "CJ230_1/TLE7209_1" 1 "CJ230_2/TLE7209_2" /end COMPU_VTAB
/begin COMPU_METHOD InjMass "" RAT_FUNC "%5.2" "mg/hub" COEFFS 0 100 0 0 0 1 /end COMPU_METHOD
/begin COMPU_METHOD InjMassPerTime_2 "" RAT_FUNC "%6.5" "Kg/h" COEFFS 0 2000 0 0 0 1 /end COMPU_METHOD
/begin COMPU_METHOD InjMassPerTime_g_s "" RAT_FUNC "%6.5" "g/s" COEFFS 0 2000 0 0 0 1 /end COMPU_METHOD
/begin COMPU_METHOD InjMass_g "" RAT_FUNC "%6.4" "g" COEFFS 0 100 0 0 0 1 /end COMPU_METHOD
/begin COMPU_METHOD InjMsPrTime_q0p001_COMPU "" RAT_FUNC "%6.5" "Kg/h" COEFFS 0 1000 0 0 0 1 /end COMPU_METHOD
/begin COMPU_METHOD InjTime_us "" RAT_FUNC "%5.1" "us" COEFFS 0 2.5 0 0 0 1 /end COMPU_METHOD
/begin COMPU_METHOD Kd "" RAT_FUNC "%7.6" "1/1" COEFFS 0 65536 0 0 0 1 /end COMPU_METHOD
/begin COMPU_METHOD Ki "" RAT_FUNC "%6.5" "1/s" COEFFS 0 2147.483648 0 0 0 1 /end COMPU_METHOD
/begin COMPU_METHOD Ki_ThrVlv "" RAT_FUNC "%6.4" "1/s" COEFFS 0 65 0 0 0 1 /end COMPU_METHOD
/begin COMPU_METHOD Kp "" RAT_FUNC "%7.6" "1/1" COEFFS 0 32768 0 0 0 1 /end COMPU_METHOD
/begin COMPU_METHOD O2 "" RAT_FUNC "%6.5" "-" COEFFS 0 100000 0 0 0 1 /end COMPU_METHOD
/begin COMPU_METHOD O2MassPerTimeLo "" RAT_FUNC "%6.4" "Kg/h" COEFFS 0 50 0 0 0 1 /end COMPU_METHOD
/begin COMPU_METHOD OneToOne "" RAT_FUNC "%6.0" "-" COEFFS 0 1 0 0 0 1 /end COMPU_METHOD
/begin COMPU_METHOD Period "" RAT_FUNC "%6.3" "ms" COEFFS 0 10 0 0 0 1 /end COMPU_METHOD
/begin COMPU_METHOD Prc "" RAT_FUNC "%6.4" "%" COEFFS 0 81.92 0 0 0 1 /end COMPU_METHOD
/begin COMPU_METHOD PresAC_hPa "" RAT_FUNC "%6.2" "hPa" COEFFS 0 0.5 0 0 0 1 /end COMPU_METHOD
/begin COMPU_METHOD Pres_hPa "" RAT_FUNC "%5.1" "hPa" COEFFS 0 1 0 0 0 1 /end COMPU_METHOD
/begin COMPU_METHOD Pres_Rail "" RAT_FUNC "%5.1" "bar" COEFFS 0 10.000000 0 0 0 1 /end COMPU_METHOD
/begin COMPU_METHOD Pwr1 "" RAT_FUNC "%6.3" "W" COEFFS 0 10 0 0 0 1 /end COMPU_METHOD
/begin COMPU_METHOD Pwr_kW_Sec "" RAT_FUNC "%6.4" "kW/s" COEFFS 0 100 0 0 0 1 /end COMPU_METHOD
/begin COMPU_METHOD RatNOxMass "" RAT_FUNC "%10.9" "-" COEFFS 0 10000000 0 0 0 1 /end COMPU_METHOD
/begin COMPU_METHOD ReynoldsNum "" RAT_FUNC "%6.0" "-" COEFFS 0 0.01 0 0 0 1 /end COMPU_METHOD
/begin COMPU_METHOD ReynoldsNum1 "" RAT_FUNC "%7.0" "-" COEFFS 0 0.001 0 0 0 1 /end COMPU_METHOD
/begin COMPU_METHOD RmpPrc "" RAT_FUNC "%6.5" "%/s" COEFFS 0 5368.70912 0 0 0 1 /end COMPU_METHOD
/begin COMPU_METHOD RmpTrqPrpHigh "" RAT_FUNC "%6.4" "Nm/s" COEFFS 0 655.36 0 0 0 1 /end COMPU_METHOD
/begin COMPU_METHOD TempDiff_Cels "" RAT_FUNC "%6.3" "deg C" COEFFS 0 10 0 0 0 1 /end COMPU_METHOD
/begin COMPU_METHOD TempDiff_Kelv "" RAT_FUNC "%4.1" "K" COEFFS 0 10 0 0 0 1 /end COMPU_METHOD
/begin COMPU_METHOD Temp_Cels "" RAT_FUNC "%5.1" "deg C" COEFFS 0 10 2731.4 0 0 1 /end COMPU_METHOD
/begin COMPU_METHOD Temp_Kelv_Sec "" RAT_FUNC "%6.4" "K/s" COEFFS 0 100 0 0 0 1 /end COMPU_METHOD
/begin COMPU_METHOD ThermalCoEff "" RAT_FUNC "%6.3" "W/m/m/k" COEFFS 0 10 0 0 0 1 /end COMPU_METHOD
/begin COMPU_METHOD TimeCoEOMRmp "" RAT_FUNC "%6.3" "s" COEFFS 0 0 1 0 0.0152587890625 0 /end COMPU_METHOD
/begin COMPU_METHOD TimeDeb "" RAT_FUNC "%5.0" "ms" COEFFS 0 0.1 0 0 0 1 /end COMPU_METHOD
/begin COMPU_METHOD TimeDelay_s "" RAT_FUNC "%12.4" "s" COEFFS 0 0 1 0 0.00023283064365387 0 /end COMPU_METHOD
/begin COMPU_METHOD Time_1_s "" RAT_FUNC "%8.7" "1/s" COEFFS 0 163840 0 0 0 1 /end COMPU_METHOD
/begin COMPU_METHOD Time_ms "" RAT_FUNC "%5.0" "ms" COEFFS 0 0.1 0 0 0 1 /end COMPU_METHOD
/begin COMPU_METHOD Time_s "" RAT_FUNC "%5.2" "s" COEFFS 0 100 0 0 0 1 /end COMPU_METHOD
/begin COMPU_METHOD Trq "" RAT_FUNC "%5.1" "Nm" COEFFS 0 10 0 0 0 1 /end COMPU_METHOD
/begin COMPU_METHOD TrqPrp "" RAT_FUNC "%5.1" "Nm" COEFFS 0 0.625 0 0 0 1 /end COMPU_METHOD
/begin COMPU_METHOD TrqPrpHigh "" RAT_FUNC "%5.1" "Nm" COEFFS 0 10 0 0 0 1 /end COMPU_METHOD
/begin COMPU_METHOD Vel "" RAT_FUNC "%5.2" "km/h" COEFFS 0 100 0 0 0 1 /end COMPU_METHOD
/begin COMPU_METHOD VlvVel "" RAT_FUNC "%6.3" "%/s" COEFFS 0 8.192 0 0 0 1 /end COMPU_METHOD
/begin COMPU_METHOD Volt "" RAT_FUNC "%6.1" "mV" COEFFS 0 5 0 0 0 1 /end COMPU_METHOD
/begin COMPU_METHOD Volt_Batt "" RAT_FUNC "%5.0" "mV" COEFFS 0 0.05 0 0 0 1 /end COMPU_METHOD
/begin COMPU_METHOD ZFC_BPfac "" RAT_FUNC "%6.4" "-" COEFFS 0 546.116666666667 0 0 0 1 /end COMPU_METHOD
/begin COMPU_METHOD ZFC_EvalEngSpd_Rslt "" TAB_VERB "%6.3" "-" COMPU_TAB_REF ZFC_EvalEngSpd_Rslt /end COMPU_METHOD
/begin COMPU_VTAB ZFC_EvalEngSpd_Rslt "" TAB_VERB 3 0 "ZFC_ST_ALL_INJ_LOW" 1 "ZFC_ST_DES_INJ_MAX" 2 "ZFC_ST_ERR_INJ_MAX" /end COMPU_VTAB
/begin COMPU_METHOD ZFC_Inj_State "" TAB_VERB "%6.3" "-" COMPU_TAB_REF ZFC_Inj_State /end COMPU_METHOD
/begin COMPU_VTAB ZFC_Inj_State "" TAB_VERB 5 0 "ZFC_ST_INJ_IDLE" 16 "ZFC_ST_INJ_DEM" 32 "ZFC_ST_INJ_PROG" 48 "ZFC_ST_INJ_RES_OK" 64 "ZFC_ST_INJ_RES_NOK" /end COMPU_VTAB
/begin COMPU_METHOD ZFC_PerHalfRatio "" RAT_FUNC "%6.4" "-" COEFFS 0 128 0 0 0 1 /end COMPU_METHOD
/begin COMPU_METHOD ZFC_State "" TAB_VERB "%6.3" "-" COMPU_TAB_REF ZFC_State /end COMPU_METHOD
/begin COMPU_VTAB ZFC_State "" TAB_VERB 8 1 "ZFC_ST_BREAK" 2 "ZFC_ST_WAIT" 3 "ZFC_ST_START_OVRRUN" 4 "ZFC_ST_CHANGE_PRAIL" 5 "ZFC_ST_CHECK_PRAIL" 6 "ZFC_ST_ETCLB" 7 "ZFC_ST_NVCLB" 16 "ZFC_ST_SUBS_FUNC" /end COMPU_VTAB
/begin RECORD_LAYOUT Axis_Xs16 NO_AXIS_PTS_X 1 SWORD AXIS_PTS_X 2 SWORD INDEX_INCR DIRECT /end RECORD_LAYOUT
/begin RECORD_LAYOUT Axis_Xu8 NO_AXIS_PTS_X 1 UBYTE AXIS_PTS_X 2 UBYTE INDEX_INCR DIRECT /end RECORD_LAYOUT
/begin RECORD_LAYOUT Cur_Xs16Ws16 NO_AXIS_PTS_X 1 SWORD AXIS_PTS_X 2 SWORD INDEX_INCR DIRECT FNC_VALUES 3 SWORD COLUMN_DIR DIRECT /end RECORD_LAYOUT
/begin RECORD_LAYOUT Kf_Xs16_Ys16_Ws16 NO_AXIS_PTS_X 1 SWORD NO_AXIS_PTS_Y 2 SWORD AXIS_PTS_X 3 SWORD INDEX_INCR DIRECT AXIS_PTS_Y 4 SWORD INDEX_INCR DIRECT FNC_VALUES 5 SWORD COLUMN_DIR DIRECT /end RECORD_LAYOUT
/begin RECORD_LAYOUT Kl_Xs16_Ws16 NO_AXIS_PTS_X 1 SWORD AXIS_PTS_X 2 SWORD INDEX_INCR DIRECT FNC_VALUES 3 SWORD COLUMN_DIR DIRECT /end RECORD_LAYOUT
/begin RECORD_LAYOUT Kwb_Wu8 FNC_VALUES 1 UBYTE COLUMN_DIR DIRECT /end RECORD_LAYOUT
/begin RECORD_LAYOUT Kw_Ws16 FNC_VALUES 1 SWORD COLUMN_DIR DIRECT /end RECORD_LAYOUT
/begin RECORD_LAYOUT Kw_Ws32 FNC_VALUES 1 SLONG COLUMN_DIR DIRECT /end RECORD_LAYOUT
/begin RECORD_LAYOUT Kw_Wu16 FNC_VALUES 1 UWORD COLUMN_DIR DIRECT /end RECORD_LAYOUT
/begin RECORD_LAYOUT Kw_Wu32 FNC_VALUES 1 ULONG COLUMN_DIR DIRECT /end RECORD_LAYOUT
/begin RECORD_LAYOUT Kw_Wu8 FNC_VALUES 1 UBYTE COLUMN_DIR DIRECT /end RECORD_LAYOUT
/begin RECORD_LAYOUT MapG_Ws16 FNC_VALUES 1 SWORD COLUMN_DIR DIRECT /end RECORD_LAYOUT
/begin RECORD_LAYOUT Map_Xs16Ys16Ws16 NO_AXIS_PTS_X 1 SWORD NO_AXIS_PTS_Y 2 SWORD AXIS_PTS_X 3 SWORD INDEX_INCR DIRECT AXIS_PTS_Y 4 SWORD INDEX_INCR DIRECT FNC_VALUES 5 SWORD COLUMN_DIR DIRECT /end RECORD_LAYOUT
/begin RECORD_LAYOUT ValA_Ws16 FNC_VALUES 1 SWORD COLUMN_DIR DIRECT /end RECORD_LAYOUT
/begin RECORD_LAYOUT ValA_Wu32 FNC_VALUES 1 ULONG COLUMN_DIR DIRECT /end RECORD_LAYOUT
/begin RECORD_LAYOUT ValA_Wu8 FNC_VALUES 1 UBYTE COLUMN_DIR DIRECT /end RECORD_LAYOUT
/begin RECORD_LAYOUT Val_Ws16 FNC_VALUES 1 SWORD COLUMN_DIR DIRECT /end RECORD_LAYOUT
/begin RECORD_LAYOUT Val_Ws32 FNC_VALUES 1 SLONG COLUMN_DIR DIRECT /end RECORD_LAYOUT
/begin RECORD_LAYOUT Val_Wu16 FNC_VALUES 1 UWORD COLUMN_DIR DIRECT /end RECORD_LAYOUT
/begin RECORD_LAYOUT Val_Wu8 FNC_VALUES 1 UBYTE COLUMN_DIR DIRECT /end RECORD_LAYOUT
/end MODULE
/end PROJECT

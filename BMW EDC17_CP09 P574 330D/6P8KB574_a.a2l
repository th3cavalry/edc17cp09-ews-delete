ASAP2_VERSION 1 4
/begin PROJECT P_574 "EDC17_CP09"
/begin HEADER "" VERSION "V8KB" PROJECT_NO P_574 /end HEADER
/begin MODULE DIM ""
/begin MOD_COMMON "" BYTE_ORDER MSB_LAST ALIGNMENT_BYTE 1 ALIGNMENT_WORD 2 ALIGNMENT_LONG 4 ALIGNMENT_FLOAT32_IEEE 4 /end MOD_COMMON
/begin CHARACTERISTIC DINH_FId.DFC_ACCIPlausDrvAst_CA "DINH/Zugeordnete FId für Verriegelungsquelle DFC_ACCIPlausDrvAst" VAL_BLK 0x80023A64 ValA_Wu16 688. DINH_FIdVerb 0.00 688. FORMAT "%2.0" NUMBER 3 /end CHARACTERISTIC
/begin CHARACTERISTIC DINH_FId.DFC_ACCIPlausTrqDes_CA "DINH/Zugeordnete FId für Verriegelungsquelle DFC_ACCIPlausTrqDes" VAL_BLK 0x80023A6A ValA_Wu16 688. DINH_FIdVerb 0.00 688. FORMAT "%2.0" NUMBER 3 /end CHARACTERISTIC
/begin CHARACTERISTIC DINH_FId.DFC_AirCtlGovDvtEOMMax_CA "DINH/Zugeordnete FId für Verriegelungsquelle DFC_AirCtlGovDvtEOMMax" VAL_BLK 0x80023A70 ValA_Wu16 688. DINH_FIdVerb 0.00 688. FORMAT "%2.0" NUMBER 2 /end CHARACTERISTIC
/begin CHARACTERISTIC DINH_FId.DFC_AirCtlGovDvtEOMMin_CA "DINH/Zugeordnete FId für Verriegelungsquelle DFC_AirCtlGovDvtEOMMin" VAL_BLK 0x80023A74 ValA_Wu16 688. DINH_FIdVerb 0.00 688. FORMAT "%2.0" NUMBER 2 /end CHARACTERISTIC
/begin CHARACTERISTIC DINH_FId.DFC_AirCtlGovDvtMax_CA "DINH/Zugeordnete FId für Verriegelungsquelle DFC_AirCtlGovDvtMax" VAL_BLK 0x80023A78 ValA_Wu16 688. DINH_FIdVerb 0.00 688. FORMAT "%2.0" NUMBER 7 /end CHARACTERISTIC
/begin CHARACTERISTIC DINH_FId.DFC_AirCtlGovDvtMin_CA "DINH/Zugeordnete FId für Verriegelungsquelle DFC_AirCtlGovDvtMin" VAL_BLK 0x80023A86 ValA_Wu16 688. DINH_FIdVerb 0.00 688. FORMAT "%2.0" NUMBER 3 /end CHARACTERISTIC
/begin CHARACTERISTIC DINH_FId.DFC_AirCtlGovLPDvtMax_CA "DINH/Zugeordnete FId für Verriegelungsquelle DFC_AirCtlGovLPDvtMax" VAL_BLK 0x80023A8C ValA_Wu16 688. DINH_FIdVerb 0.00 688. FORMAT "%2.0" NUMBER 3 /end CHARACTERISTIC
/begin CHARACTERISTIC DINH_FId.DFC_AirCtlGovLPDvtMin_CA "DINH/Zugeordnete FId für Verriegelungsquelle DFC_AirCtlGovLPDvtMin" VAL_BLK 0x80023A92 ValA_Wu16 688. DINH_FIdVerb 0.00 688. FORMAT "%2.0" NUMBER 3 /end CHARACTERISTIC
/begin CHARACTERISTIC DINH_FId.DFC_AltIOComErr_CA "DINH/Zugeordnete FId für Verriegelungsquelle DFC_AltIOComErr" VAL_BLK 0x80023A98 ValA_Wu16 688. DINH_FIdVerb 0.00 688. FORMAT "%2.0" NUMBER 2 /end CHARACTERISTIC
/begin CHARACTERISTIC DINH_FId.DFC_AltIOComNpl_CA "DINH/Zugeordnete FId für Verriegelungsquelle DFC_AltIOComNpl" VAL_BLK 0x80023A9C ValA_Wu16 688. DINH_FIdVerb 0.00 688. FORMAT "%2.0" NUMBER 2 /end CHARACTERISTIC
/begin CHARACTERISTIC DINH_FId.DFC_BusDiagBusOffFlexRay_CA "DINH/" VAL_BLK 0x80023AA0 ValA_Wu16 688. DINH_FIdVerb 0.00 688. FORMAT "%2.0" NUMBER 2 /end CHARACTERISTIC
/begin CHARACTERISTIC DINH_FId.DFC_BusDiagBusOffNodeA_CA "DINH/Zugeordnete FId für Verriegelungsquelle DFC_BusDiagBusOffNodeA" VAL_BLK 0x80023AA4 ValA_Wu16 688. DINH_FIdVerb 0.00 688. FORMAT "%2.0" NUMBER 6 /end CHARACTERISTIC
/begin CHARACTERISTIC DINH_FId.DFC_BusDiagBusOffNodeB_CA "DINH/Zugeordnete FId für Verriegelungsquelle DFC_BusDiagBusOffNodeB" VAL_BLK 0x80023AB0 ValA_Wu16 688. DINH_FIdVerb 0.00 688. FORMAT "%2.0" NUMBER 4 /end CHARACTERISTIC
/begin CHARACTERISTIC DINH_FId.DFC_BusDiagBusOffNodeC_CA "DINH/Zugeordnete FId für Verriegelungsquelle DFC_BusDiagBusOffNodeC" VAL_BLK 0x80023AB8 ValA_Wu16 688. DINH_FIdVerb 0.00 688. FORMAT "%2.0" NUMBER 2 /end CHARACTERISTIC
/begin CHARACTERISTIC DINH_FId.DFC_BusDiagHwFlexRay_CA "DINH/" VAL_BLK 0x80023ABC ValA_Wu16 688. DINH_FIdVerb 0.00 688. FORMAT "%2.0" NUMBER 2 /end CHARACTERISTIC
/begin CHARACTERISTIC DINH_FId.DFC_Cj945SpiCom1_CA "DINH/Zugeordnete FId für Verriegelungsquelle DFC_Cj945SpiCom1" VAL_BLK 0x80023AC0 ValA_Wu16 688. DINH_FIdVerb 0.00 688. FORMAT "%2.0" NUMBER 3 /end CHARACTERISTIC
/begin CHARACTERISTIC DINH_FId.DFC_ComACDemandSig_FA_CA "DINH/Zugeordnete FId für Verriegelungsquelle DFC_ComACDemandSig_FA" VAL_BLK 0x80023AC6 ValA_Wu16 688. DINH_FIdVerb 0.00 688. FORMAT "%2.0" NUMBER 2 /end CHARACTERISTIC
/begin CHARACTERISTIC DINH_FId.DFC_ComACDemandTo_FA_CA "DINH/Zugeordnete FId für Verriegelungsquelle DFC_ComACDemandTo_FA" VAL_BLK 0x80023ACA ValA_Wu16 688. DINH_FIdVerb 0.00 688. FORMAT "%2.0" NUMBER 2 /end CHARACTERISTIC
/begin CHARACTERISTIC DINH_FId.DFC_ComATempSig_FA_CA "DINH/Zugeordnete FId für Verriegelungsquelle DFC_ComATempSig_FA" VAL_BLK 0x80023ACE ValA_Wu16 688. DINH_FIdVerb 0.00 688. FORMAT "%2.0" NUMBER 2 /end CHARACTERISTIC
/begin CHARACTERISTIC DINH_FId.DFC_ComATempTo_FA_CA "DINH/Zugeordnete FId für Verriegelungsquelle DFC_ComATempTo_FA" VAL_BLK 0x80023AD2 ValA_Wu16 688. DINH_FIdVerb 0.00 688. FORMAT "%2.0" NUMBER 2 /end CHARACTERISTIC
/begin CHARACTERISTIC DINH_FId.DFC_ComATempTo_FX_CA "DINH/Zugeordnete FId für Verriegelungsquelle DFC_ComATempTo_FX" VAL_BLK 0x80023AD6 ValA_Wu16 688. DINH_FIdVerb 0.00 688. FORMAT "%2.0" NUMBER 2 /end CHARACTERISTIC
/begin CHARACTERISTIC DINH_FId.DFC_ComBrkTrqSumChk_FX_CA "DINH/Zugeordnete FId für Verriegelungsquelle DFC_ComBrkTrqSumChk_FX" VAL_BLK 0x80023ADA ValA_Wu16 688. DINH_FIdVerb 0.00 688. FORMAT "%2.0" NUMBER 2 /end CHARACTERISTIC
/begin CHARACTERISTIC DINH_FId.DFC_ComBrkTrqSumCtr_FX_CA "DINH/Zugeordnete FId für Verriegelungsquelle DFC_ComBrkTrqSumCtr_FX" VAL_BLK 0x80023ADE ValA_Wu16 688. DINH_FIdVerb 0.00 688. FORMAT "%2.0" NUMBER 2 /end CHARACTERISTIC
/begin CHARACTERISTIC DINH_FId.DFC_ComBrkTrqSumTo_FX_CA "DINH/Zugeordnete FId für Verriegelungsquelle DFC_ComBrkTrqSumTo_FX" VAL_BLK 0x80023AE2 ValA_Wu16 688. DINH_FIdVerb 0.00 688. FORMAT "%2.0" NUMBER 2 /end CHARACTERISTIC
/begin CHARACTERISTIC DINH_FId.DFC_ComBtnDrvDynChk_FX_CA "DINH/Zugeordnete FId für Verriegelungsquelle DFC_ComBtnDrvDynChk_FX" VAL_BLK 0x80023AE6 ValA_Wu16 688. DINH_FIdVerb 0.00 688. FORMAT "%2.0" NUMBER 2 /end CHARACTERISTIC
/begin CHARACTERISTIC DINH_FId.DFC_ComBtnDrvDynCtr_FX_CA "DINH/Zugeordnete FId für Verriegelungsquelle DFC_ComBtnDrvDynCtr_FX" VAL_BLK 0x80023AEA ValA_Wu16 688. DINH_FIdVerb 0.00 688. FORMAT "%2.0" NUMBER 2 /end CHARACTERISTIC
/begin CHARACTERISTIC DINH_FId.DFC_ComBtnDrvDynTo_FX_CA "DINH/Zugeordnete FId für Verriegelungsquelle DFC_ComBtnDrvDynTo_FX" VAL_BLK 0x80023AEE ValA_Wu16 688. DINH_FIdVerb 0.00 688. FORMAT "%2.0" NUMBER 2 /end CHARACTERISTIC
/begin CHARACTERISTIC DINH_FId.DFC_ComButtonMSASig_CA "DINH/Zugeordnete FId für Verriegelungsquelle DFC_ComButtonMSASig" VAL_BLK 0x80023AF2 ValA_Wu16 688. DINH_FIdVerb 0.00 688. FORMAT "%2.0" NUMBER 2 /end CHARACTERISTIC
/begin CHARACTERISTIC DINH_FId.DFC_ComButtonMSATo_CA "DINH/Zugeordnete FId für Verriegelungsquelle DFC_ComButtonMSATo" VAL_BLK 0x80023AF6 ValA_Wu16 688. DINH_FIdVerb 0.00 688. FORMAT "%2.0" NUMBER 2 /end CHARACTERISTIC
/begin CHARACTERISTIC DINH_FId.DFC_ComCodierungPwrmngSig_CA "DINH/Zugeordnete FId für Verriegelungsquelle DFC_ComCodierungPwrmngSig" VAL_BLK 0x80023AFA ValA_Wu16 688. DINH_FIdVerb 0.00 688. FORMAT "%2.0" NUMBER 2 /end CHARACTERISTIC
/begin CHARACTERISTIC DINH_FId.DFC_ComCodierungPwrmngSig_FA_CA "DINH/Zugeordnete FId für Verriegelungsquelle DFC_ComCodierungPwrmngSig_FA" VAL_BLK 0x80023AFE ValA_Wu16 688. DINH_FIdVerb 0.00 688. FORMAT "%2.0" NUMBER 2 /end CHARACTERISTIC
/begin CHARACTERISTIC DINH_FId.DFC_ComCrCtlLvrChk_CA "DINH/Zugeordnete FId für Verriegelungsquelle DFC_ComCrCtlLvrChk" VAL_BLK 0x80023B02 ValA_Wu16 688. DINH_FIdVerb 0.00 688. FORMAT "%2.0" NUMBER 2 /end CHARACTERISTIC
/begin CHARACTERISTIC DINH_FId.DFC_ComCrCtlLvrCtr_CA "DINH/Zugeordnete FId für Verriegelungsquelle DFC_ComCrCtlLvrCtr" VAL_BLK 0x80023B06 ValA_Wu16 688. DINH_FIdVerb 0.00 688. FORMAT "%2.0" NUMBER 2 /end CHARACTERISTIC
/begin CHARACTERISTIC DINH_FId.DFC_ComCrCtlLvrSig_CA "DINH/Zugeordnete FId für Verriegelungsquelle DFC_ComCrCtlLvrSig" VAL_BLK 0x80023B0A ValA_Wu16 688. DINH_FIdVerb 0.00 688. FORMAT "%2.0" NUMBER 2 /end CHARACTERISTIC
/begin CHARACTERISTIC DINH_FId.DFC_ComCrCtlLvrTo_CA "DINH/Zugeordnete FId für Verriegelungsquelle DFC_ComCrCtlLvrTo" VAL_BLK 0x80023B0E ValA_Wu16 688. DINH_FIdVerb 0.00 688. FORMAT "%2.0" NUMBER 2 /end CHARACTERISTIC
/begin CHARACTERISTIC DINH_FId.DFC_ComCtrCrshSwoEkpSig_FA_CA "DINH/Zugeordnete FId für Verriegelungsquelle DFC_ComCtrCrshSwoEkpSig_FA" VAL_BLK 0x80023B12 ValA_Wu16 688. DINH_FIdVerb 0.00 688. FORMAT "%2.0" NUMBER 2 /end CHARACTERISTIC
/begin CHARACTERISTIC DINH_FId.DFC_ComCtrCrshSwoEkpTo_FA_CA "DINH/Zugeordnete FId für Verriegelungsquelle DFC_ComCtrCrshSwoEkpTo_FA" VAL_BLK 0x80023B16 ValA_Wu16 688. DINH_FIdVerb 0.00 688. FORMAT "%2.0" NUMBER 2 /end CHARACTERISTIC
/begin CHARACTERISTIC DINH_FId.DFC_ComCtrSecInt_CA "DINH/Zugeordnete FId für Verriegelungsquelle DFC_ComCtrSecInt" VAL_BLK 0x80023B1A ValA_Wu16 688. DINH_FIdVerb 0.00 688. FORMAT "%2.0" NUMBER 2 /end CHARACTERISTIC
/begin CHARACTERISTIC DINH_FId.DFC_ComDiaOBDGbxSig_A_CA "DINH/Zugeordnete FId für Verriegelungsquelle DFC_ComDiaOBDGbxSig_A" VAL_BLK 0x80023B1E ValA_Wu16 688. DINH_FIdVerb 0.00 688. FORMAT "%2.0" NUMBER 2 /end CHARACTERISTIC
/begin CHARACTERISTIC DINH_FId.DFC_ComDiaOBDGbxTo_A_CA "DINH/Zugeordnete FId für Verriegelungsquelle DFC_ComDiaOBDGbxTo_A" VAL_BLK 0x80023B22 ValA_Wu16 688. DINH_FIdVerb 0.00 688. FORMAT "%2.0" NUMBER 2 /end CHARACTERISTIC
/begin CHARACTERISTIC DINH_FId.DFC_ComFahrzeugtypSig_CA "DINH/Zugeordnete FId für Verriegelungsquelle DFC_ComFahrzeugtypSig" VAL_BLK 0x80023B26 ValA_Wu16 688. DINH_FIdVerb 0.00 688. FORMAT "%2.0" NUMBER 2 /end CHARACTERISTIC
/begin CHARACTERISTIC DINH_FId.DFC_ComFahrzeugtypSig_FA_CA "DINH/Zugeordnete FId für Verriegelungsquelle DFC_ComFahrzeugtypSig_FA" VAL_BLK 0x80023B2A ValA_Wu16 688. DINH_FIdVerb 0.00 688. FORMAT "%2.0" NUMBER 2 /end CHARACTERISTIC
/begin CHARACTERISTIC DINH_FId.DFC_ComFllupGpwsupSig_FA_CA "DINH/Zugeordnete FId für Verriegelungsquelle DFC_ComFllupGpwsupSig_FA" VAL_BLK 0x80023B2E ValA_Wu16 688. DINH_FIdVerb 0.00 688. FORMAT "%2.0" NUMBER 2 /end CHARACTERISTIC
/begin CHARACTERISTIC DINH_FId.DFC_ComFllupGpwsupTo_FA_CA "DINH/Zugeordnete FId für Verriegelungsquelle DFC_ComFllupGpwsupTo_FA" VAL_BLK 0x80023B32 ValA_Wu16 688. DINH_FIdVerb 0.00 688. FORMAT "%2.0" NUMBER 2 /end CHARACTERISTIC
/begin CHARACTERISTIC DINH_FId.DFC_ComGbxDataChk_A_CA "DINH/Zugeordnete FId für Verriegelungsquelle DFC_ComGbxDataChk_A" VAL_BLK 0x80023B36 ValA_Wu16 688. DINH_FIdVerb 0.00 688. FORMAT "%2.0" NUMBER 2 /end CHARACTERISTIC
/begin CHARACTERISTIC DINH_FId.DFC_ComGbxDataChk_FA_CA "DINH/Zugeordnete FId für Verriegelungsquelle DFC_ComGbxDataChk_FA" VAL_BLK 0x80023B3A ValA_Wu16 688. DINH_FIdVerb 0.00 688. FORMAT "%2.0" NUMBER 2 /end CHARACTERISTIC
/begin CHARACTERISTIC DINH_FId.DFC_ComGbxDataCtr_A_CA "DINH/Zugeordnete FId für Verriegelungsquelle DFC_ComGbxDataCtr_A" VAL_BLK 0x80023B3E ValA_Wu16 688. DINH_FIdVerb 0.00 688. FORMAT "%2.0" NUMBER 2 /end CHARACTERISTIC
/begin CHARACTERISTIC DINH_FId.DFC_ComGbxDataCtr_FA_CA "DINH/Zugeordnete FId für Verriegelungsquelle DFC_ComGbxDataCtr_FA" VAL_BLK 0x80023B42 ValA_Wu16 688. DINH_FIdVerb 0.00 688. FORMAT "%2.0" NUMBER 2 /end CHARACTERISTIC
/begin CHARACTERISTIC DINH_FId.DFC_ComGbxDataSig_A_CA "DINH/Zugeordnete FId für Verriegelungsquelle DFC_ComGbxDataSig_A" VAL_BLK 0x80023B46 ValA_Wu16 688. DINH_FIdVerb 0.00 688. FORMAT "%2.0" NUMBER 2 /end CHARACTERISTIC
/begin CHARACTERISTIC DINH_FId.DFC_ComGbxDataSig_FA_CA "DINH/Zugeordnete FId für Verriegelungsquelle DFC_ComGbxDataSig_FA" VAL_BLK 0x80023B4A ValA_Wu16 688. DINH_FIdVerb 0.00 688. FORMAT "%2.0" NUMBER 2 /end CHARACTERISTIC
/begin CHARACTERISTIC DINH_FId.DFC_ComGbxDataTo_A_CA "DINH/Zugeordnete FId für Verriegelungsquelle DFC_ComGbxDataTo_A" VAL_BLK 0x80023B4E ValA_Wu16 688. DINH_FIdVerb 0.00 688. FORMAT "%2.0" NUMBER 2 /end CHARACTERISTIC
/begin CHARACTERISTIC DINH_FId.DFC_ComGbxDataTo_FA_CA "DINH/Zugeordnete FId für Verriegelungsquelle DFC_ComGbxDataTo_FA" VAL_BLK 0x80023B52 ValA_Wu16 688. DINH_FIdVerb 0.00 688. FORMAT "%2.0" NUMBER 2 /end CHARACTERISTIC
/begin CHARACTERISTIC DINH_FId.DFC_ComKlemmenChk_FA_CA "DINH/Zugeordnete FId für Verriegelungsquelle DFC_ComKlemmenChk_FA" VAL_BLK 0x80023B56 ValA_Wu16 688. DINH_FIdVerb 0.00 688. FORMAT "%2.0" NUMBER 2 /end CHARACTERISTIC
/begin CHARACTERISTIC DINH_FId.DFC_ComKlemmenCtr_FA_CA "DINH/Zugeordnete FId für Verriegelungsquelle DFC_ComKlemmenCtr_FA" VAL_BLK 0x80023B5A ValA_Wu16 688. DINH_FIdVerb 0.00 688. FORMAT "%2.0" NUMBER 2 /end CHARACTERISTIC
/begin CHARACTERISTIC DINH_FId.DFC_ComKlemmenSig_FA_CA "DINH/Zugeordnete FId für Verriegelungsquelle DFC_ComKlemmenSig_FA" VAL_BLK 0x80023B5E ValA_Wu16 688. DINH_FIdVerb 0.00 688. FORMAT "%2.0" NUMBER 2 /end CHARACTERISTIC
/begin CHARACTERISTIC DINH_FId.DFC_ComKlemmenTo_FA_CA "DINH/Zugeordnete FId für Verriegelungsquelle DFC_ComKlemmenTo_FA" VAL_BLK 0x80023B62 ValA_Wu16 688. DINH_FIdVerb 0.00 688. FORMAT "%2.0" NUMBER 2 /end CHARACTERISTIC
/begin CHARACTERISTIC DINH_FId.DFC_ComLenkradwinkelSig_CA "DINH/Zugeordnete FId für Verriegelungsquelle DFC_ComLenkradwinkelSig" VAL_BLK 0x80023B66 ValA_Wu16 688. DINH_FIdVerb 0.00 688. FORMAT "%2.0" NUMBER 2 /end CHARACTERISTIC
/begin CHARACTERISTIC DINH_FId.DFC_ComLenkradwinkelTo_CA "DINH/Zugeordnete FId für Verriegelungsquelle DFC_ComLenkradwinkelTo" VAL_BLK 0x80023B6A ValA_Wu16 688. DINH_FIdVerb 0.00 688. FORMAT "%2.0" NUMBER 2 /end CHARACTERISTIC
/begin CHARACTERISTIC DINH_FId.DFC_ComMileageRangeSig_FA_CA "DINH/Zugeordnete FId für Verriegelungsquelle DFC_ComMileageRangeSig_FA" VAL_BLK 0x80023B6E ValA_Wu16 688. DINH_FIdVerb 0.00 688. FORMAT "%2.0" NUMBER 2 /end CHARACTERISTIC
/begin CHARACTERISTIC DINH_FId.DFC_ComMileageRangeTo_FA_CA "DINH/Zugeordnete FId für Verriegelungsquelle DFC_ComMileageRangeTo_FA" VAL_BLK 0x80023B72 ValA_Wu16 688. DINH_FIdVerb 0.00 688. FORMAT "%2.0" NUMBER 2 /end CHARACTERISTIC
/begin CHARACTERISTIC DINH_FId.DFC_ComPspSig_CA "DINH/Zugeordnete FId für Verriegelungsquelle DFC_ComPspSig" VAL_BLK 0x80023B76 ValA_Wu16 688. DINH_FIdVerb 0.00 688. FORMAT "%2.0" NUMBER 2 /end CHARACTERISTIC
/begin CHARACTERISTIC DINH_FId.DFC_ComPspTo_CA "DINH/Zugeordnete FId für Verriegelungsquelle DFC_ComPspTo" VAL_BLK 0x80023B7A ValA_Wu16 688. DINH_FIdVerb 0.00 688. FORMAT "%2.0" NUMBER 2 /end CHARACTERISTIC
/begin CHARACTERISTIC DINH_FId.DFC_ComRelTimeSig_FA_CA "DINH/Zugeordnete FId für Verriegelungsquelle DFC_ComRelTimeSig_FA" VAL_BLK 0x80023B7E ValA_Wu16 688. DINH_FIdVerb 0.00 688. FORMAT "%2.0" NUMBER 2 /end CHARACTERISTIC
/begin CHARACTERISTIC DINH_FId.DFC_ComRelTimeTo_FA_CA "DINH/Zugeordnete FId für Verriegelungsquelle DFC_ComRelTimeTo_FA" VAL_BLK 0x80023B82 ValA_Wu16 688. DINH_FIdVerb 0.00 688. FORMAT "%2.0" NUMBER 2 /end CHARACTERISTIC
/begin CHARACTERISTIC DINH_FId.DFC_ComRequestEMFChk_CA "DINH/Zugeordnete FId für Verriegelungsquelle DFC_ComRequestEMFChk" VAL_BLK 0x80023B86 ValA_Wu16 688. DINH_FIdVerb 0.00 688. FORMAT "%2.0" NUMBER 2 /end CHARACTERISTIC
/begin CHARACTERISTIC DINH_FId.DFC_ComRequestEMFCtr_CA "DINH/Zugeordnete FId für Verriegelungsquelle DFC_ComRequestEMFCtr" VAL_BLK 0x80023B8A ValA_Wu16 688. DINH_FIdVerb 0.00 688. FORMAT "%2.0" NUMBER 2 /end CHARACTERISTIC
/begin CHARACTERISTIC DINH_FId.DFC_ComRequestEMFSig_CA "DINH/Zugeordnete FId für Verriegelungsquelle DFC_ComRequestEMFSig" VAL_BLK 0x80023B8E ValA_Wu16 688. DINH_FIdVerb 0.00 688. FORMAT "%2.0" NUMBER 2 /end CHARACTERISTIC
/begin CHARACTERISTIC DINH_FId.DFC_ComRequestEMFTo_CA "DINH/Zugeordnete FId für Verriegelungsquelle DFC_ComRequestEMFTo" VAL_BLK 0x80023B92 ValA_Wu16 688. DINH_FIdVerb 0.00 688. FORMAT "%2.0" NUMBER 2 /end CHARACTERISTIC
/begin CHARACTERISTIC DINH_FId.DFC_ComRpmWhlChk_FX_CA "DINH/Zugeordnete FId für Verriegelungsquelle DFC_ComRpmWhlChk_FX" VAL_BLK 0x80023B96 ValA_Wu16 688. DINH_FIdVerb 0.00 688. FORMAT "%2.0" NUMBER 2 /end CHARACTERISTIC
/begin CHARACTERISTIC DINH_FId.DFC_ComRpmWhlCtr_FX_CA "DINH/Zugeordnete FId für Verriegelungsquelle DFC_ComRpmWhlCtr_FX" VAL_BLK 0x80023B9A ValA_Wu16 688. DINH_FIdVerb 0.00 688. FORMAT "%2.0" NUMBER 2 /end CHARACTERISTIC
/begin CHARACTERISTIC DINH_FId.DFC_ComRpmWhlTo_FX_CA "DINH/Zugeordnete FId für Verriegelungsquelle DFC_ComRpmWhlTo_FX" VAL_BLK 0x80023B9E ValA_Wu16 688. DINH_FIdVerb 0.00 688. FORMAT "%2.0" NUMBER 2 /end CHARACTERISTIC
/begin CHARACTERISTIC DINH_FId.DFC_ComSecCtrRelSig_FA_CA "DINH/Zugeordnete FId für Verriegelungsquelle DFC_ComSecCtrRelSig_FA" VAL_BLK 0x80023BA2 ValA_Wu16 688. DINH_FIdVerb 0.00 688. FORMAT "%2.0" NUMBER 2 /end CHARACTERISTIC
/begin CHARACTERISTIC DINH_FId.DFC_ComSecCtrRelTo_FA_CA "DINH/Zugeordnete FId für Verriegelungsquelle DFC_ComSecCtrRelTo_FA" VAL_BLK 0x80023BA6 ValA_Wu16 688. DINH_FIdVerb 0.00 688. FORMAT "%2.0" NUMBER 3 /end CHARACTERISTIC
/begin CHARACTERISTIC DINH_FId.DFC_ComSensNOxGndSig_CA "DINH/Zugeordnete FId für Verriegelungsquelle DFC_ComSensNOxGndSig" VAL_BLK 0x80023BAC ValA_Wu16 688. DINH_FIdVerb 0.00 688. FORMAT "%2.0" NUMBER 2 /end CHARACTERISTIC
/begin CHARACTERISTIC DINH_FId.DFC_ComSensNOxGndTo_CA "DINH/Zugeordnete FId für Verriegelungsquelle DFC_ComSensNOxGndTo" VAL_BLK 0x80023BB0 ValA_Wu16 688. DINH_FIdVerb 0.00 688. FORMAT "%2.0" NUMBER 2 /end CHARACTERISTIC
/begin CHARACTERISTIC DINH_FId.DFC_ComSensNOxMode_CA "DINH/Zugeordnete FId für Verriegelungsquelle DFC_ComSensNOxMode" VAL_BLK 0x80023BB4 ValA_Wu16 688. DINH_FIdVerb 0.00 688. FORMAT "%2.0" NUMBER 2 /end CHARACTERISTIC
/begin CHARACTERISTIC DINH_FId.DFC_ComSensNOxUbattSig_CA "DINH/Zugeordnete FId für Verriegelungsquelle DFC_ComSensNOxUbattSig" VAL_BLK 0x80023BB8 ValA_Wu16 688. DINH_FIdVerb 0.00 688. FORMAT "%2.0" NUMBER 2 /end CHARACTERISTIC
/begin CHARACTERISTIC DINH_FId.DFC_ComSensNOxUbattTo_CA "DINH/Zugeordnete FId für Verriegelungsquelle DFC_ComSensNOxUbattTo" VAL_BLK 0x80023BBC ValA_Wu16 688. DINH_FIdVerb 0.00 688. FORMAT "%2.0" NUMBER 2 /end CHARACTERISTIC
/begin CHARACTERISTIC DINH_FId.DFC_ComShiftPaddleTo_FX_CA "DINH/Zugeordnete FId für Verriegelungsquelle DFC_ComShiftPaddleTo_FX" VAL_BLK 0x80023BC0 ValA_Wu16 688. DINH_FIdVerb 0.00 688. FORMAT "%2.0" NUMBER 2 /end CHARACTERISTIC
/begin CHARACTERISTIC DINH_FId.DFC_ComShutOffPSPSig_CA "DINH/Zugeordnete FId für Verriegelungsquelle DFC_ComShutOffPSPSig" VAL_BLK 0x80023BC4 ValA_Wu16 688. DINH_FIdVerb 0.00 688. FORMAT "%2.0" NUMBER 2 /end CHARACTERISTIC
/begin CHARACTERISTIC DINH_FId.DFC_ComShutOffPSPTo_CA "DINH/Zugeordnete FId für Verriegelungsquelle DFC_ComShutOffPSPTo" VAL_BLK 0x80023BC8 ValA_Wu16 688. DINH_FIdVerb 0.00 688. FORMAT "%2.0" NUMBER 2 /end CHARACTERISTIC
/begin CHARACTERISTIC DINH_FId.DFC_ComSlrdiGlbFZMTo_FA_CA "DINH/Zugeordnete FId für Verriegelungsquelle DFC_ComSlrdiGlbFZMTo_FA" VAL_BLK 0x80023BCC ValA_Wu16 688. DINH_FIdVerb 0.00 688. FORMAT "%2.0" NUMBER 2 /end CHARACTERISTIC
/begin CHARACTERISTIC DINH_FId.DFC_ComSlrdiGlbFZMTo_FX_CA "DINH/Zugeordnete FId für Verriegelungsquelle DFC_ComSlrdiGlbFZMTo_FX" VAL_BLK 0x80023BD0 ValA_Wu16 688. DINH_FIdVerb 0.00 688. FORMAT "%2.0" NUMBER 2 /end CHARACTERISTIC
/begin CHARACTERISTIC DINH_FId.DFC_ComSpeedVehicleChk_FX_CA "DINH/Zugeordnete FId für Verriegelungsquelle DFC_ComSpeedVehicleChk_FX" VAL_BLK 0x80023BD4 ValA_Wu16 688. DINH_FIdVerb 0.00 688. FORMAT "%2.0" NUMBER 2 /end CHARACTERISTIC
/begin CHARACTERISTIC DINH_FId.DFC_ComSpeedVehicleCtr_FX_CA "DINH/Zugeordnete FId für Verriegelungsquelle DFC_ComSpeedVehicleCtr_FX" VAL_BLK 0x80023BD8 ValA_Wu16 688. DINH_FIdVerb 0.00 688. FORMAT "%2.0" NUMBER 2 /end CHARACTERISTIC
/begin CHARACTERISTIC DINH_FId.DFC_ComSpeedVehicleTo_FX_CA "DINH/Zugeordnete FId für Verriegelungsquelle DFC_ComSpeedVehicleTo_FX" VAL_BLK 0x80023BDC ValA_Wu16 688. DINH_FIdVerb 0.00 688. FORMAT "%2.0" NUMBER 2 /end CHARACTERISTIC
/begin CHARACTERISTIC DINH_FId.DFC_ComStConintDSCChk_FX_CA "DINH/Zugeordnete FId für Verriegelungsquelle DFC_ComStConintDSCChk_FX" VAL_BLK 0x80023BE0 ValA_Wu16 688. DINH_FIdVerb 0.00 688. FORMAT "%2.0" NUMBER 2 /end CHARACTERISTIC
/begin CHARACTERISTIC DINH_FId.DFC_ComStConintDSCCtr_FX_CA "DINH/Zugeordnete FId für Verriegelungsquelle DFC_ComStConintDSCCtr_FX" VAL_BLK 0x80023BE4 ValA_Wu16 688. DINH_FIdVerb 0.00 688. FORMAT "%2.0" NUMBER 2 /end CHARACTERISTIC
/begin CHARACTERISTIC DINH_FId.DFC_ComStConintDSCTo_FX_CA "DINH/Zugeordnete FId für Verriegelungsquelle DFC_ComStConintDSCTo_FX" VAL_BLK 0x80023BE8 ValA_Wu16 688. DINH_FIdVerb 0.00 688. FORMAT "%2.0" NUMBER 2 /end CHARACTERISTIC
/begin CHARACTERISTIC DINH_FId.DFC_ComStatACFrontSig_FA_CA "DINH/Zugeordnete FId für Verriegelungsquelle DFC_ComStatACFrontSig_FA" VAL_BLK 0x80023BEC ValA_Wu16 688. DINH_FIdVerb 0.00 688. FORMAT "%2.0" NUMBER 2 /end CHARACTERISTIC
/begin CHARACTERISTIC DINH_FId.DFC_ComStatACFrontTo_FA_CA "DINH/Zugeordnete FId für Verriegelungsquelle DFC_ComStatACFrontTo_FA" VAL_BLK 0x80023BF0 ValA_Wu16 688. DINH_FIdVerb 0.00 688. FORMAT "%2.0" NUMBER 2 /end CHARACTERISTIC
/begin CHARACTERISTIC DINH_FId.DFC_ComStatEkpSig_A_CA "DINH/Zugeordnete FId für Verriegelungsquelle DFC_ComStatEkpSig_A" VAL_BLK 0x80023BF4 ValA_Wu16 688. DINH_FIdVerb 0.00 688. FORMAT "%2.0" NUMBER 2 /end CHARACTERISTIC
/begin CHARACTERISTIC DINH_FId.DFC_ComStatEkpTo_A_CA "DINH/Zugeordnete FId für Verriegelungsquelle DFC_ComStatEkpTo_A" VAL_BLK 0x80023BF8 ValA_Wu16 688. DINH_FIdVerb 0.00 688. FORMAT "%2.0" NUMBER 2 /end CHARACTERISTIC
/begin CHARACTERISTIC DINH_FId.DFC_ComStatGearRevSig_FA_CA "DINH/Zugeordnete FId für Verriegelungsquelle DFC_ComStatGearRevSig_FA" VAL_BLK 0x80023BFC ValA_Wu16 688. DINH_FIdVerb 0.00 688. FORMAT "%2.0" NUMBER 2 /end CHARACTERISTIC
/begin CHARACTERISTIC DINH_FId.DFC_ComStatGearRevTo_FA_CA "DINH/Zugeordnete FId für Verriegelungsquelle DFC_ComStatGearRevTo_FA" VAL_BLK 0x80023C00 ValA_Wu16 688. DINH_FIdVerb 0.00 688. FORMAT "%2.0" NUMBER 2 /end CHARACTERISTIC
/begin CHARACTERISTIC DINH_FId.DFC_ComStatZVKlappenSig_FA_CA "DINH/Zugeordnete FId für Verriegelungsquelle DFC_ComStatZVKlappenSig_FA" VAL_BLK 0x80023C04 ValA_Wu16 688. DINH_FIdVerb 0.00 688. FORMAT "%2.0" NUMBER 2 /end CHARACTERISTIC
/begin CHARACTERISTIC DINH_FId.DFC_ComStatZVKlappenTo_FA_CA "DINH/Zugeordnete FId für Verriegelungsquelle DFC_ComStatZVKlappenTo_FA" VAL_BLK 0x80023C08 ValA_Wu16 688. DINH_FIdVerb 0.00 688. FORMAT "%2.0" NUMBER 2 /end CHARACTERISTIC
/begin CHARACTERISTIC DINH_FId.DFC_ComStateARSCtr_CA "DINH/Zugeordnete FId für Verriegelungsquelle DFC_ComStateARSCtr" VAL_BLK 0x80023C0C ValA_Wu16 688. DINH_FIdVerb 0.00 688. FORMAT "%2.0" NUMBER 2 /end CHARACTERISTIC
/begin CHARACTERISTIC DINH_FId.DFC_ComStateARSSig_CA "DINH/Zugeordnete FId für Verriegelungsquelle DFC_ComStateARSSig" VAL_BLK 0x80023C10 ValA_Wu16 688. DINH_FIdVerb 0.00 688. FORMAT "%2.0" NUMBER 2 /end CHARACTERISTIC
/begin CHARACTERISTIC DINH_FId.DFC_ComStateARSTo_CA "DINH/Zugeordnete FId für Verriegelungsquelle DFC_ComStateARSTo" VAL_BLK 0x80023C14 ValA_Wu16 688. DINH_FIdVerb 0.00 688. FORMAT "%2.0" NUMBER 2 /end CHARACTERISTIC
/begin CHARACTERISTIC DINH_FId.DFC_ComStateDscSig_CA "DINH/Zugeordnete FId für Verriegelungsquelle DFC_ComStateDscSig" VAL_BLK 0x80023C18 ValA_Wu16 688. DINH_FIdVerb 0.00 688. FORMAT "%2.0" NUMBER 2 /end CHARACTERISTIC
/begin CHARACTERISTIC DINH_FId.DFC_ComStateDscTo_CA "DINH/Zugeordnete FId für Verriegelungsquelle DFC_ComStateDscTo" VAL_BLK 0x80023C1C ValA_Wu16 688. DINH_FIdVerb 0.00 688. FORMAT "%2.0" NUMBER 2 /end CHARACTERISTIC
/begin CHARACTERISTIC DINH_FId.DFC_ComStateSeatSig_CA "DINH/Zugeordnete FId für Verriegelungsquelle DFC_ComStateSeatSig" VAL_BLK 0x80023C20 ValA_Wu16 688. DINH_FIdVerb 0.00 688. FORMAT "%2.0" NUMBER 2 /end CHARACTERISTIC
/begin CHARACTERISTIC DINH_FId.DFC_ComStateSeatSig_FA_CA "DINH/Zugeordnete FId für Verriegelungsquelle DFC_ComStateSeatSig_FA" VAL_BLK 0x80023C24 ValA_Wu16 688. DINH_FIdVerb 0.00 688. FORMAT "%2.0" NUMBER 2 /end CHARACTERISTIC
/begin CHARACTERISTIC DINH_FId.DFC_ComStateSeatTo_CA "DINH/Zugeordnete FId für Verriegelungsquelle DFC_ComStateSeatTo" VAL_BLK 0x80023C28 ValA_Wu16 688. DINH_FIdVerb 0.00 688. FORMAT "%2.0" NUMBER 2 /end CHARACTERISTIC
/begin CHARACTERISTIC DINH_FId.DFC_ComStateSeatTo_FA_CA "DINH/Zugeordnete FId für Verriegelungsquelle DFC_ComStateSeatTo_FA" VAL_BLK 0x80023C2C ValA_Wu16 688. DINH_FIdVerb 0.00 688. FORMAT "%2.0" NUMBER 2 /end CHARACTERISTIC
/begin CHARACTERISTIC DINH_FId.DFC_ComStatusEGSSig_A_CA "DINH/Zugeordnete FId für Verriegelungsquelle DFC_ComStatusEGSSig_A" VAL_BLK 0x80023C30 ValA_Wu16 688. DINH_FIdVerb 0.00 688. FORMAT "%2.0" NUMBER 2 /end CHARACTERISTIC
/begin CHARACTERISTIC DINH_FId.DFC_ComStatusEGSSig_FA_CA "DINH/Zugeordnete FId für Verriegelungsquelle DFC_ComStatusEGSSig_FA" VAL_BLK 0x80023C34 ValA_Wu16 688. DINH_FIdVerb 0.00 688. FORMAT "%2.0" NUMBER 2 /end CHARACTERISTIC
/begin CHARACTERISTIC DINH_FId.DFC_ComStatusEGSTo_A_CA "DINH/Zugeordnete FId für Verriegelungsquelle DFC_ComStatusEGSTo_A" VAL_BLK 0x80023C38 ValA_Wu16 688. DINH_FIdVerb 0.00 688. FORMAT "%2.0" NUMBER 2 /end CHARACTERISTIC
/begin CHARACTERISTIC DINH_FId.DFC_ComStatusEGSTo_FA_CA "DINH/Zugeordnete FId für Verriegelungsquelle DFC_ComStatusEGSTo_FA" VAL_BLK 0x80023C3C ValA_Wu16 688. DINH_FIdVerb 0.00 688. FORMAT "%2.0" NUMBER 2 /end CHARACTERISTIC
/begin CHARACTERISTIC DINH_FId.DFC_ComStatusEMFChk_CA "DINH/Zugeordnete FId für Verriegelungsquelle DFC_ComStatusEMFChk" VAL_BLK 0x80023C40 ValA_Wu16 688. DINH_FIdVerb 0.00 688. FORMAT "%2.0" NUMBER 2 /end CHARACTERISTIC
/begin CHARACTERISTIC DINH_FId.DFC_ComStatusEMFCtr_CA "DINH/Zugeordnete FId für Verriegelungsquelle DFC_ComStatusEMFCtr" VAL_BLK 0x80023C44 ValA_Wu16 688. DINH_FIdVerb 0.00 688. FORMAT "%2.0" NUMBER 2 /end CHARACTERISTIC
/begin CHARACTERISTIC DINH_FId.DFC_ComStatusEMFSig_CA "DINH/Zugeordnete FId für Verriegelungsquelle DFC_ComStatusEMFSig" VAL_BLK 0x80023C48 ValA_Wu16 688. DINH_FIdVerb 0.00 688. FORMAT "%2.0" NUMBER 2 /end CHARACTERISTIC
/begin CHARACTERISTIC DINH_FId.DFC_ComStatusEMFTo_CA "DINH/Zugeordnete FId für Verriegelungsquelle DFC_ComStatusEMFTo" VAL_BLK 0x80023C4C ValA_Wu16 688. DINH_FIdVerb 0.00 688. FORMAT "%2.0" NUMBER 2 /end CHARACTERISTIC
/begin CHARACTERISTIC DINH_FId.DFC_ComStatusRGangSig_CA "DINH/Zugeordnete FId für Verriegelungsquelle DFC_ComStatusRGangSig" VAL_BLK 0x80023C50 ValA_Wu16 688. DINH_FIdVerb 0.00 688. FORMAT "%2.0" NUMBER 2 /end CHARACTERISTIC
/begin CHARACTERISTIC DINH_FId.DFC_ComStatusRGangTo_CA "DINH/Zugeordnete FId für Verriegelungsquelle DFC_ComStatusRGangTo" VAL_BLK 0x80023C54 ValA_Wu16 688. DINH_FIdVerb 0.00 688. FORMAT "%2.0" NUMBER 2 /end CHARACTERISTIC
/begin CHARACTERISTIC DINH_FId.DFC_ComSteeringAngleChk_FX_CA "DINH/Zugeordnete FId für Verriegelungsquelle DFC_ComSteeringAngleChk_FX" VAL_BLK 0x80023C58 ValA_Wu16 688. DINH_FIdVerb 0.00 688. FORMAT "%2.0" NUMBER 2 /end CHARACTERISTIC
/begin CHARACTERISTIC DINH_FId.DFC_ComSteeringAngleCtr_FX_CA "DINH/Zugeordnete FId für Verriegelungsquelle DFC_ComSteeringAngleCtr_FX" VAL_BLK 0x80023C5C ValA_Wu16 688. DINH_FIdVerb 0.00 688. FORMAT "%2.0" NUMBER 2 /end CHARACTERISTIC
/begin CHARACTERISTIC DINH_FId.DFC_ComSteeringAngleTo_FX_CA "DINH/Zugeordnete FId für Verriegelungsquelle DFC_ComSteeringAngleTo_FX" VAL_BLK 0x80023C60 ValA_Wu16 688. DINH_FIdVerb 0.00 688. FORMAT "%2.0" NUMBER 2 /end CHARACTERISTIC
/begin CHARACTERISTIC DINH_FId.DFC_ComTerminalChk_CA "DINH/Zugeordnete FId für Verriegelungsquelle DFC_ComTerminalChk" VAL_BLK 0x80023C64 ValA_Wu16 688. DINH_FIdVerb 0.00 688. FORMAT "%2.0" NUMBER 2 /end CHARACTERISTIC
/begin CHARACTERISTIC DINH_FId.DFC_ComTerminalCtr_CA "DINH/Zugeordnete FId für Verriegelungsquelle DFC_ComTerminalCtr" VAL_BLK 0x80023C68 ValA_Wu16 688. DINH_FIdVerb 0.00 688. FORMAT "%2.0" NUMBER 2 /end CHARACTERISTIC
/begin CHARACTERISTIC DINH_FId.DFC_ComTerminalSig_CA "DINH/Zugeordnete FId für Verriegelungsquelle DFC_ComTerminalSig" VAL_BLK 0x80023C6C ValA_Wu16 688. DINH_FIdVerb 0.00 688. FORMAT "%2.0" NUMBER 2 /end CHARACTERISTIC
/begin CHARACTERISTIC DINH_FId.DFC_ComTerminalTo_CA "DINH/Zugeordnete FId für Verriegelungsquelle DFC_ComTerminalTo" VAL_BLK 0x80023C70 ValA_Wu16 688. DINH_FIdVerb 0.00 688. FORMAT "%2.0" NUMBER 2 /end CHARACTERISTIC
/begin CHARACTERISTIC DINH_FId.DFC_ComTimeDateSig_FA_CA "DINH/Zugeordnete FId für Verriegelungsquelle DFC_ComTimeDateSig_FA" VAL_BLK 0x80023C74 ValA_Wu16 688. DINH_FIdVerb 0.00 688. FORMAT "%2.0" NUMBER 2 /end CHARACTERISTIC
/begin CHARACTERISTIC DINH_FId.DFC_ComTimeDateTo_FA_CA "DINH/Zugeordnete FId für Verriegelungsquelle DFC_ComTimeDateTo_FA" VAL_BLK 0x80023C78 ValA_Wu16 688. DINH_FIdVerb 0.00 688. FORMAT "%2.0" NUMBER 2 /end CHARACTERISTIC
/begin CHARACTERISTIC DINH_FId.DFC_ComTrailerSig_CA "DINH/Zugeordnete FId für Verriegelungsquelle DFC_ComTrailerSig" VAL_BLK 0x80023C7C ValA_Wu16 688. DINH_FIdVerb 0.00 688. FORMAT "%2.0" NUMBER 2 /end CHARACTERISTIC
/begin CHARACTERISTIC DINH_FId.DFC_ComTrailerSig_FA_CA "DINH/Zugeordnete FId für Verriegelungsquelle DFC_ComTrailerSig_FA" VAL_BLK 0x80023C80 ValA_Wu16 688. DINH_FIdVerb 0.00 688. FORMAT "%2.0" NUMBER 2 /end CHARACTERISTIC
/begin CHARACTERISTIC DINH_FId.DFC_ComTrailerTo_CA "DINH/Zugeordnete FId für Verriegelungsquelle DFC_ComTrailerTo" VAL_BLK 0x80023C84 ValA_Wu16 688. DINH_FIdVerb 0.00 688. FORMAT "%2.0" NUMBER 2 /end CHARACTERISTIC
/begin CHARACTERISTIC DINH_FId.DFC_ComTrailerTo_FA_CA "DINH/Zugeordnete FId für Verriegelungsquelle DFC_ComTrailerTo_FA" VAL_BLK 0x80023C88 ValA_Wu16 688. DINH_FIdVerb 0.00 688. FORMAT "%2.0" NUMBER 2 /end CHARACTERISTIC
/begin CHARACTERISTIC DINH_FId.DFC_ComTrqDemCrshDrDyChk_FX_CA "DINH/Zugeordnete FId für Verriegelungsquelle DFC_ComTrqDemCrshDrDyChk_FX" VAL_BLK 0x80023C8C ValA_Wu16 688. DINH_FIdVerb 0.00 688. FORMAT "%2.0" NUMBER 2 /end CHARACTERISTIC
/begin CHARACTERISTIC DINH_FId.DFC_ComTrqDemCrshDrDyCtr_FX_CA "DINH/Zugeordnete FId für Verriegelungsquelle DFC_ComTrqDemCrshDrDyCtr_FX" VAL_BLK 0x80023C90 ValA_Wu16 688. DINH_FIdVerb 0.00 688. FORMAT "%2.0" NUMBER 2 /end CHARACTERISTIC
/begin CHARACTERISTIC DINH_FId.DFC_ComTrqDemCrshDrDyTo_FX_CA "DINH/Zugeordnete FId für Verriegelungsquelle DFC_ComTrqDemCrshDrDyTo_FX" VAL_BLK 0x80023C94 ValA_Wu16 688. DINH_FIdVerb 0.00 688. FORMAT "%2.0" NUMBER 2 /end CHARACTERISTIC
/begin CHARACTERISTIC DINH_FId.DFC_ComTrqDemandDesSig_CA "DINH/Zugeordnete FId für Verriegelungsquelle DFC_ComTrqDemandDesSig" VAL_BLK 0x80023C98 ValA_Wu16 688. DINH_FIdVerb 0.00 688. FORMAT "%2.0" NUMBER 2 /end CHARACTERISTIC
/begin CHARACTERISTIC DINH_FId.DFC_ComTrqDemandDesTo_CA "DINH/Zugeordnete FId für Verriegelungsquelle DFC_ComTrqDemandDesTo" VAL_BLK 0x80023C9C ValA_Wu16 688. DINH_FIdVerb 0.00 688. FORMAT "%2.0" NUMBER 2 /end CHARACTERISTIC
/begin CHARACTERISTIC DINH_FId.DFC_ComTrqDemandDscChk_CA "DINH/Zugeordnete FId für Verriegelungsquelle DFC_ComTrqDemandDscChk" VAL_BLK 0x80023CA0 ValA_Wu16 688. DINH_FIdVerb 0.00 688. FORMAT "%2.0" NUMBER 3 /end CHARACTERISTIC
/begin CHARACTERISTIC DINH_FId.DFC_ComTrqDemandDscCtr_CA "DINH/Zugeordnete FId für Verriegelungsquelle DFC_ComTrqDemandDscCtr" VAL_BLK 0x80023CA6 ValA_Wu16 688. DINH_FIdVerb 0.00 688. FORMAT "%2.0" NUMBER 3 /end CHARACTERISTIC
/begin CHARACTERISTIC DINH_FId.DFC_ComTrqDemandDscSig_CA "DINH/Zugeordnete FId für Verriegelungsquelle DFC_ComTrqDemandDscSig" VAL_BLK 0x80023CAC ValA_Wu16 688. DINH_FIdVerb 0.00 688. FORMAT "%2.0" NUMBER 3 /end CHARACTERISTIC
/begin CHARACTERISTIC DINH_FId.DFC_ComTrqDemandDscTo_CA "DINH/Zugeordnete FId für Verriegelungsquelle DFC_ComTrqDemandDscTo" VAL_BLK 0x80023CB2 ValA_Wu16 688. DINH_FIdVerb 0.00 688. FORMAT "%2.0" NUMBER 3 /end CHARACTERISTIC
/begin CHARACTERISTIC DINH_FId.DFC_ComTrqDemandGbxChk_A_CA "DINH/Zugeordnete FId für Verriegelungsquelle DFC_ComTrqDemandGbxChk_A" VAL_BLK 0x80023CB8 ValA_Wu16 688. DINH_FIdVerb 0.00 688. FORMAT "%2.0" NUMBER 2 /end CHARACTERISTIC
/begin CHARACTERISTIC DINH_FId.DFC_ComTrqDemandGbxChk_FA_CA "DINH/Zugeordnete FId für Verriegelungsquelle DFC_ComTrqDemandGbxChk_FA" VAL_BLK 0x80023CBC ValA_Wu16 688. DINH_FIdVerb 0.00 688. FORMAT "%2.0" NUMBER 2 /end CHARACTERISTIC
/begin CHARACTERISTIC DINH_FId.DFC_ComTrqDemandGbxCtr_A_CA "DINH/Zugeordnete FId für Verriegelungsquelle DFC_ComTrqDemandGbxCtr_A" VAL_BLK 0x80023CC0 ValA_Wu16 688. DINH_FIdVerb 0.00 688. FORMAT "%2.0" NUMBER 2 /end CHARACTERISTIC
/begin CHARACTERISTIC DINH_FId.DFC_ComTrqDemandGbxCtr_FA_CA "DINH/Zugeordnete FId für Verriegelungsquelle DFC_ComTrqDemandGbxCtr_FA" VAL_BLK 0x80023CC4 ValA_Wu16 688. DINH_FIdVerb 0.00 688. FORMAT "%2.0" NUMBER 2 /end CHARACTERISTIC
/begin CHARACTERISTIC DINH_FId.DFC_ComTrqDemandGbxSig_A_CA "DINH/Zugeordnete FId für Verriegelungsquelle DFC_ComTrqDemandGbxSig_A" VAL_BLK 0x80023CC8 ValA_Wu16 688. DINH_FIdVerb 0.00 688. FORMAT "%2.0" NUMBER 2 /end CHARACTERISTIC
/begin CHARACTERISTIC DINH_FId.DFC_ComTrqDemandGbxSig_FA_CA "DINH/Zugeordnete FId für Verriegelungsquelle DFC_ComTrqDemandGbxSig_FA" VAL_BLK 0x80023CCC ValA_Wu16 688. DINH_FIdVerb 0.00 688. FORMAT "%2.0" NUMBER 2 /end CHARACTERISTIC
/begin CHARACTERISTIC DINH_FId.DFC_ComTrqDemandGbxTo_A_CA "DINH/Zugeordnete FId für Verriegelungsquelle DFC_ComTrqDemandGbxTo_A" VAL_BLK 0x80023CD0 ValA_Wu16 688. DINH_FIdVerb 0.00 688. FORMAT "%2.0" NUMBER 2 /end CHARACTERISTIC
/begin CHARACTERISTIC DINH_FId.DFC_ComTrqDemandGbxTo_FA_CA "DINH/Zugeordnete FId für Verriegelungsquelle DFC_ComTrqDemandGbxTo_FA" VAL_BLK 0x80023CD4 ValA_Wu16 688. DINH_FIdVerb 0.00 688. FORMAT "%2.0" NUMBER 2 /end CHARACTERISTIC
/begin CHARACTERISTIC DINH_FId.DFC_ComTrqWhlDemChk_CA "DINH/Zugeordnete FId für Verriegelungsquelle DFC_ComTrqWhlDemChk" VAL_BLK 0x80023CD8 ValA_Wu16 688. DINH_FIdVerb 0.00 688. FORMAT "%2.0" NUMBER 2 /end CHARACTERISTIC
/begin CHARACTERISTIC DINH_FId.DFC_ComTrqWhlDemCtr_CA "DINH/Zugeordnete FId für Verriegelungsquelle DFC_ComTrqWhlDemCtr" VAL_BLK 0x80023CDC ValA_Wu16 688. DINH_FIdVerb 0.00 688. FORMAT "%2.0" NUMBER 2 /end CHARACTERISTIC
/begin CHARACTERISTIC DINH_FId.DFC_ComTrqWhlDemFASChk_FX_CA "DINH/Zugeordnete FId für Verriegelungsquelle DFC_ComTrqWhlDemFASChk_FX" VAL_BLK 0x80023CE0 ValA_Wu16 688. DINH_FIdVerb 0.00 688. FORMAT "%2.0" NUMBER 2 /end CHARACTERISTIC
/begin CHARACTERISTIC DINH_FId.DFC_ComTrqWhlDemFASCtr_FX_CA "DINH/Zugeordnete FId für Verriegelungsquelle DFC_ComTrqWhlDemFASCtr_FX" VAL_BLK 0x80023CE4 ValA_Wu16 688. DINH_FIdVerb 0.00 688. FORMAT "%2.0" NUMBER 2 /end CHARACTERISTIC
/begin CHARACTERISTIC DINH_FId.DFC_ComTrqWhlDemFASTo_FX_CA "DINH/Zugeordnete FId für Verriegelungsquelle DFC_ComTrqWhlDemFASTo_FX" VAL_BLK 0x80023CE8 ValA_Wu16 688. DINH_FIdVerb 0.00 688. FORMAT "%2.0" NUMBER 2 /end CHARACTERISTIC
/begin CHARACTERISTIC DINH_FId.DFC_ComTrqWhlDemSig_CA "DINH/Zugeordnete FId für Verriegelungsquelle DFC_ComTrqWhlDemSig" VAL_BLK 0x80023CEC ValA_Wu16 688. DINH_FIdVerb 0.00 688. FORMAT "%2.0" NUMBER 2 /end CHARACTERISTIC
/begin CHARACTERISTIC DINH_FId.DFC_ComTrqWhlDemTo_CA "DINH/Zugeordnete FId für Verriegelungsquelle DFC_ComTrqWhlDemTo" VAL_BLK 0x80023CF0 ValA_Wu16 688. DINH_FIdVerb 0.00 688. FORMAT "%2.0" NUMBER 2 /end CHARACTERISTIC
/begin CHARACTERISTIC DINH_FId.DFC_ComVelocityChk_FA_CA "DINH/Zugeordnete FId für Verriegelungsquelle DFC_ComVelocityChk_FA" VAL_BLK 0x80023CF4 ValA_Wu16 688. DINH_FIdVerb 0.00 688. FORMAT "%2.0" NUMBER 2 /end CHARACTERISTIC
/begin CHARACTERISTIC DINH_FId.DFC_ComVelocityCtr_FA_CA "DINH/Zugeordnete FId für Verriegelungsquelle DFC_ComVelocityCtr_FA" VAL_BLK 0x80023CF8 ValA_Wu16 688. DINH_FIdVerb 0.00 688. FORMAT "%2.0" NUMBER 2 /end CHARACTERISTIC
/begin CHARACTERISTIC DINH_FId.DFC_ComVelocitySig_CA "DINH/Zugeordnete FId für Verriegelungsquelle DFC_ComVelocitySig" VAL_BLK 0x80023CFC ValA_Wu16 688. DINH_FIdVerb 0.00 688. FORMAT "%2.0" NUMBER 2 /end CHARACTERISTIC
/begin CHARACTERISTIC DINH_FId.DFC_ComVelocitySig_FA_CA "DINH/Zugeordnete FId für Verriegelungsquelle DFC_ComVelocitySig_FA" VAL_BLK 0x80023D00 ValA_Wu16 688. DINH_FIdVerb 0.00 688. FORMAT "%2.0" NUMBER 2 /end CHARACTERISTIC
/begin CHARACTERISTIC DINH_FId.DFC_ComVelocityTo_CA "DINH/Zugeordnete FId für Verriegelungsquelle DFC_ComVelocityTo" VAL_BLK 0x80023D04 ValA_Wu16 688. DINH_FIdVerb 0.00 688. FORMAT "%2.0" NUMBER 2 /end CHARACTERISTIC
/begin CHARACTERISTIC DINH_FId.DFC_ComVelocityTo_FA_CA "DINH/Zugeordnete FId für Verriegelungsquelle DFC_ComVelocityTo_FA" VAL_BLK 0x80023D08 ValA_Wu16 688. DINH_FIdVerb 0.00 688. FORMAT "%2.0" NUMBER 2 /end CHARACTERISTIC
/begin CHARACTERISTIC DINH_FId.DFC_ComVerbraucherTo_CA "DINH/Zugeordnete FId für Verriegelungsquelle DFC_ComVerbraucherTo" VAL_BLK 0x80023D0C ValA_Wu16 688. DINH_FIdVerb 0.00 688. FORMAT "%2.0" NUMBER 2 /end CHARACTERISTIC
/begin CHARACTERISTIC DINH_FId.DFC_ComWMomPTStabChk_FX_CA "DINH/Zugeordnete FId für Verriegelungsquelle DFC_ComWMomPTStabChk_FX" VAL_BLK 0x80023D10 ValA_Wu16 688. DINH_FIdVerb 0.00 688. FORMAT "%2.0" NUMBER 2 /end CHARACTERISTIC
/begin CHARACTERISTIC DINH_FId.DFC_ComWMomPTStabCtr_FX_CA "DINH/Zugeordnete FId für Verriegelungsquelle DFC_ComWMomPTStabCtr_FX" VAL_BLK 0x80023D14 ValA_Wu16 688. DINH_FIdVerb 0.00 688. FORMAT "%2.0" NUMBER 2 /end CHARACTERISTIC
/begin CHARACTERISTIC DINH_FId.DFC_ComWMomPTStabTo_FX_CA "DINH/Zugeordnete FId für Verriegelungsquelle DFC_ComWMomPTStabTo_FX" VAL_BLK 0x80023D18 ValA_Wu16 688. DINH_FIdVerb 0.00 688. FORMAT "%2.0" NUMBER 2 /end CHARACTERISTIC
/begin CHARACTERISTIC DINH_FId.DFC_ComWheelSpeedSig_CA "DINH/Zugeordnete FId für Verriegelungsquelle DFC_ComWheelSpeedSig" VAL_BLK 0x80023D1C ValA_Wu16 688. DINH_FIdVerb 0.00 688. FORMAT "%2.0" NUMBER 5 /end CHARACTERISTIC
/begin CHARACTERISTIC DINH_FId.DFC_ComWheelSpeedTo_CA "DINH/Zugeordnete FId für Verriegelungsquelle DFC_ComWheelSpeedTo" VAL_BLK 0x80023D26 ValA_Wu16 688. DINH_FIdVerb 0.00 688. FORMAT "%2.0" NUMBER 5 /end CHARACTERISTIC
/begin CHARACTERISTIC DINH_FId.DFC_ComZvKlappenSig_CA "DINH/Zugeordnete FId für Verriegelungsquelle DFC_ComZvKlappenSig" VAL_BLK 0x80023D30 ValA_Wu16 688. DINH_FIdVerb 0.00 688. FORMAT "%2.0" NUMBER 2 /end CHARACTERISTIC
/begin CHARACTERISTIC DINH_FId.DFC_ComZvKlappenTo_CA "DINH/Zugeordnete FId für Verriegelungsquelle DFC_ComZvKlappenTo" VAL_BLK 0x80023D34 ValA_Wu16 688. DINH_FIdVerb 0.00 688. FORMAT "%2.0" NUMBER 2 /end CHARACTERISTIC
/begin CHARACTERISTIC DINH_FId.DFC_ComaDirectChk_FX_CA "DINH/Zugeordnete FId für Verriegelungsquelle DFC_ComaDirectChk_FX" VAL_BLK 0x80023D38 ValA_Wu16 688. DINH_FIdVerb 0.00 688. FORMAT "%2.0" NUMBER 2 /end CHARACTERISTIC
/begin CHARACTERISTIC DINH_FId.DFC_ComaDirectCtr_FX_CA "DINH/Zugeordnete FId für Verriegelungsquelle DFC_ComaDirectCtr_FX" VAL_BLK 0x80023D3C ValA_Wu16 688. DINH_FIdVerb 0.00 688. FORMAT "%2.0" NUMBER 2 /end CHARACTERISTIC
/begin CHARACTERISTIC DINH_FId.DFC_ComaDirectTo_FX_CA "DINH/Zugeordnete FId für Verriegelungsquelle DFC_ComaDirectTo_FX" VAL_BLK 0x80023D40 ValA_Wu16 688. DINH_FIdVerb 0.00 688. FORMAT "%2.0" NUMBER 2 /end CHARACTERISTIC
/begin CHARACTERISTIC DINH_FId.DFC_ComaSideChk_FX_CA "DINH/Zugeordnete FId für Verriegelungsquelle DFC_ComaSideChk_FX" VAL_BLK 0x80023D44 ValA_Wu16 688. DINH_FIdVerb 0.00 688. FORMAT "%2.0" NUMBER 2 /end CHARACTERISTIC
/begin CHARACTERISTIC DINH_FId.DFC_ComaSideCtr_FX_CA "DINH/Zugeordnete FId für Verriegelungsquelle DFC_ComaSideCtr_FX" VAL_BLK 0x80023D48 ValA_Wu16 688. DINH_FIdVerb 0.00 688. FORMAT "%2.0" NUMBER 2 /end CHARACTERISTIC
/begin CHARACTERISTIC DINH_FId.DFC_ComaSideTo_FX_CA "DINH/Zugeordnete FId für Verriegelungsquelle DFC_ComaSideTo_FX" VAL_BLK 0x80023D4C ValA_Wu16 688. DINH_FIdVerb 0.00 688. FORMAT "%2.0" NUMBER 2 /end CHARACTERISTIC
/begin CHARACTERISTIC DINH_FId.DFC_Cy320SpiCom_CA "DINH/Zugeordnete FId für Verriegelungsquelle DFC_Cy320SpiCom" VAL_BLK 0x80023D50 ValA_Wu16 688. DINH_FIdVerb 0.00 688. FORMAT "%2.0" NUMBER 2 /end CHARACTERISTIC
/begin CHARACTERISTIC DINH_FId.DFC_ETCtlDvtInrMax_CA "DINH/Zugeordnete FId für Verriegelungsquelle DFC_ETCtlDvtInrMax" VAL_BLK 0x80023D54 ValA_Wu16 688. DINH_FIdVerb 0.00 688. FORMAT "%2.0" NUMBER 2 /end CHARACTERISTIC
/begin CHARACTERISTIC DINH_FId.DFC_ETCtlDvtInrMin_CA "DINH/Zugeordnete FId für Verriegelungsquelle DFC_ETCtlDvtInrMin" VAL_BLK 0x80023D58 ValA_Wu16 688. DINH_FIdVerb 0.00 688. FORMAT "%2.0" NUMBER 2 /end CHARACTERISTIC
/begin CHARACTERISTIC DINH_FId.DFC_ETCtlDvtOutrMax_CA "DINH/Zugeordnete FId für Verriegelungsquelle DFC_ETCtlDvtOutrMax" VAL_BLK 0x80023D5C ValA_Wu16 688. DINH_FIdVerb 0.00 688. FORMAT "%2.0" NUMBER 2 /end CHARACTERISTIC
/begin CHARACTERISTIC DINH_FId.DFC_ETCtlDvtOutrMin_CA "DINH/Zugeordnete FId für Verriegelungsquelle DFC_ETCtlDvtOutrMin" VAL_BLK 0x80023D60 ValA_Wu16 688. DINH_FIdVerb 0.00 688. FORMAT "%2.0" NUMBER 2 /end CHARACTERISTIC
/begin CHARACTERISTIC DINH_FId.DFC_FBCqDvtMax_CA "DINH/Zugeordnete FId für Verriegelungsquelle DFC_FBCqDvtMax" VAL_BLK 0x80023D64 ValA_Wu16 688. DINH_FIdVerb 0.00 688. FORMAT "%2.0" NUMBER 2 /end CHARACTERISTIC
/begin CHARACTERISTIC DINH_FId.DFC_FBCqDvtMin_CA "DINH/Zugeordnete FId für Verriegelungsquelle DFC_FBCqDvtMin" VAL_BLK 0x80023D68 ValA_Wu16 688. DINH_FIdVerb 0.00 688. FORMAT "%2.0" NUMBER 2 /end CHARACTERISTIC
/begin CHARACTERISTIC DINH_FId.DFC_Fan4WinErr1_CA "DINH/Zugeordnete FId für Verriegelungsquelle DFC_Fan4WinErr1" VAL_BLK 0x80023D6C ValA_Wu16 688. DINH_FIdVerb 0.00 688. FORMAT "%2.0" NUMBER 2 /end CHARACTERISTIC
/begin CHARACTERISTIC DINH_FId.DFC_Fan4WinErr2_CA "DINH/Zugeordnete FId für Verriegelungsquelle DFC_Fan4WinErr2" VAL_BLK 0x80023D70 ValA_Wu16 688. DINH_FIdVerb 0.00 688. FORMAT "%2.0" NUMBER 2 /end CHARACTERISTIC
/begin CHARACTERISTIC DINH_FId.DFC_Fan4WinErr3_CA "DINH/Zugeordnete FId für Verriegelungsquelle DFC_Fan4WinErr3" VAL_BLK 0x80023D74 ValA_Wu16 688. DINH_FIdVerb 0.00 688. FORMAT "%2.0" NUMBER 2 /end CHARACTERISTIC
/begin CHARACTERISTIC DINH_FId.DFC_Fan4WinErr4_CA "DINH/Zugeordnete FId für Verriegelungsquelle DFC_Fan4WinErr4" VAL_BLK 0x80023D78 ValA_Wu16 688. DINH_FIdVerb 0.00 688. FORMAT "%2.0" NUMBER 2 /end CHARACTERISTIC
/begin CHARACTERISTIC DINH_FId.DFC_FanSCG_CA "DINH/Zugeordnete FId für Verriegelungsquelle DFC_FanSCG" VAL_BLK 0x80023D7C ValA_Wu16 688. DINH_FIdVerb 0.00 688. FORMAT "%2.0" NUMBER 2 /end CHARACTERISTIC
/begin CHARACTERISTIC DINH_FId.DFC_FlFCBS_CA "DINH/Zugeordnete FId für Verriegelungsquelle DFC_FlFCBS" VAL_BLK 0x80023D80 ValA_Wu16 688. DINH_FIdVerb 0.00 688. FORMAT "%2.0" NUMBER 2 /end CHARACTERISTIC
/begin CHARACTERISTIC DINH_FId.DFC_GlwEcuConfigErr_CA "DINH/Zugeordnete FId für Verriegelungsquelle DFC_GlwEcuConfigErr" VAL_BLK 0x80023D84 ValA_Wu16 688. DINH_FIdVerb 0.00 688. FORMAT "%2.0" NUMBER 2 /end CHARACTERISTIC
/begin CHARACTERISTIC DINH_FId.DFC_GlwEcuEepErr_CA "DINH/Zugeordnete FId für Verriegelungsquelle DFC_GlwEcuEepErr" VAL_BLK 0x80023D88 ValA_Wu16 688. DINH_FIdVerb 0.00 688. FORMAT "%2.0" NUMBER 2 /end CHARACTERISTIC
/begin CHARACTERISTIC DINH_FId.DFC_GlwEcuFrmErr_CA "DINH/Zugeordnete FId für Verriegelungsquelle DFC_GlwEcuFrmErr" VAL_BLK 0x80023D8C ValA_Wu16 688. DINH_FIdVerb 0.00 688. FORMAT "%2.0" NUMBER 2 /end CHARACTERISTIC
/begin CHARACTERISTIC DINH_FId.DFC_GlwEcuGPCMFaultInfo_CA "DINH/Zugeordnete FId für Verriegelungsquelle DFC_GlwEcuGPCMFaultInfo" VAL_BLK 0x80023D90 ValA_Wu16 688. DINH_FIdVerb 0.00 688. FORMAT "%2.0" NUMBER 3 /end CHARACTERISTIC
/begin CHARACTERISTIC DINH_FId.DFC_GlwEcuGPCMInfo_CA "DINH/Zugeordnete FId für Verriegelungsquelle DFC_GlwEcuGPCMInfo" VAL_BLK 0x80023D96 ValA_Wu16 688. DINH_FIdVerb 0.00 688. FORMAT "%2.0" NUMBER 4 /end CHARACTERISTIC
/begin CHARACTERISTIC DINH_FId.DFC_GlwEcuGk1HSS_CA "DINH/Zugeordnete FId für Verriegelungsquelle DFC_GlwEcuGk1HSS" VAL_BLK 0x80023D9E ValA_Wu16 688. DINH_FIdVerb 0.00 688. FORMAT "%2.0" NUMBER 2 /end CHARACTERISTIC
/begin CHARACTERISTIC DINH_FId.DFC_GlwEcuGk1OL_CA "DINH/Zugeordnete FId für Verriegelungsquelle DFC_GlwEcuGk1OL" VAL_BLK 0x80023DA2 ValA_Wu16 688. DINH_FIdVerb 0.00 688. FORMAT "%2.0" NUMBER 2 /end CHARACTERISTIC
/begin CHARACTERISTIC DINH_FId.DFC_GlwEcuGk1SC_CA "DINH/Zugeordnete FId für Verriegelungsquelle DFC_GlwEcuGk1SC" VAL_BLK 0x80023DA6 ValA_Wu16 688. DINH_FIdVerb 0.00 688. FORMAT "%2.0" NUMBER 2 /end CHARACTERISTIC
/begin CHARACTERISTIC DINH_FId.DFC_GlwEcuGk1Wdst_CA "DINH/Zugeordnete FId für Verriegelungsquelle DFC_GlwEcuGk1Wdst" VAL_BLK 0x80023DAA ValA_Wu16 688. DINH_FIdVerb 0.00 688. FORMAT "%2.0" NUMBER 2 /end CHARACTERISTIC
/begin CHARACTERISTIC DINH_FId.DFC_GlwEcuGk2HSS_CA "DINH/Zugeordnete FId für Verriegelungsquelle DFC_GlwEcuGk2HSS" VAL_BLK 0x80023DAE ValA_Wu16 688. DINH_FIdVerb 0.00 688. FORMAT "%2.0" NUMBER 2 /end CHARACTERISTIC
/begin CHARACTERISTIC DINH_FId.DFC_GlwEcuGk2OL_CA "DINH/Zugeordnete FId für Verriegelungsquelle DFC_GlwEcuGk2OL" VAL_BLK 0x80023DB2 ValA_Wu16 688. DINH_FIdVerb 0.00 688. FORMAT "%2.0" NUMBER 2 /end CHARACTERISTIC
/begin CHARACTERISTIC DINH_FId.DFC_GlwEcuGk2SC_CA "DINH/Zugeordnete FId für Verriegelungsquelle DFC_GlwEcuGk2SC" VAL_BLK 0x80023DB6 ValA_Wu16 688. DINH_FIdVerb 0.00 688. FORMAT "%2.0" NUMBER 2 /end CHARACTERISTIC
/begin CHARACTERISTIC DINH_FId.DFC_GlwEcuGk2Wdst_CA "DINH/Zugeordnete FId für Verriegelungsquelle DFC_GlwEcuGk2Wdst" VAL_BLK 0x80023DBA ValA_Wu16 688. DINH_FIdVerb 0.00 688. FORMAT "%2.0" NUMBER 2 /end CHARACTERISTIC
/begin CHARACTERISTIC DINH_FId.DFC_GlwEcuGk3HSS_CA "DINH/Zugeordnete FId für Verriegelungsquelle DFC_GlwEcuGk3HSS" VAL_BLK 0x80023DBE ValA_Wu16 688. DINH_FIdVerb 0.00 688. FORMAT "%2.0" NUMBER 2 /end CHARACTERISTIC
/begin CHARACTERISTIC DINH_FId.DFC_GlwEcuGk3OL_CA "DINH/Zugeordnete FId für Verriegelungsquelle DFC_GlwEcuGk3OL" VAL_BLK 0x80023DC2 ValA_Wu16 688. DINH_FIdVerb 0.00 688. FORMAT "%2.0" NUMBER 2 /end CHARACTERISTIC
/begin CHARACTERISTIC DINH_FId.DFC_GlwEcuGk3SC_CA "DINH/Zugeordnete FId für Verriegelungsquelle DFC_GlwEcuGk3SC" VAL_BLK 0x80023DC6 ValA_Wu16 688. DINH_FIdVerb 0.00 688. FORMAT "%2.0" NUMBER 2 /end CHARACTERISTIC
/begin CHARACTERISTIC DINH_FId.DFC_GlwEcuGk3Wdst_CA "DINH/Zugeordnete FId für Verriegelungsquelle DFC_GlwEcuGk3Wdst" VAL_BLK 0x80023DCA ValA_Wu16 688. DINH_FIdVerb 0.00 688. FORMAT "%2.0" NUMBER 2 /end CHARACTERISTIC
/begin CHARACTERISTIC DINH_FId.DFC_GlwEcuGk4HSS_CA "DINH/Zugeordnete FId für Verriegelungsquelle DFC_GlwEcuGk4HSS" VAL_BLK 0x80023DCE ValA_Wu16 688. DINH_FIdVerb 0.00 688. FORMAT "%2.0" NUMBER 2 /end CHARACTERISTIC
/begin CHARACTERISTIC DINH_FId.DFC_GlwEcuGk4OL_CA "DINH/Zugeordnete FId für Verriegelungsquelle DFC_GlwEcuGk4OL" VAL_BLK 0x80023DD2 ValA_Wu16 688. DINH_FIdVerb 0.00 688. FORMAT "%2.0" NUMBER 2 /end CHARACTERISTIC
/begin CHARACTERISTIC DINH_FId.DFC_GlwEcuGk4SC_CA "DINH/Zugeordnete FId für Verriegelungsquelle DFC_GlwEcuGk4SC" VAL_BLK 0x80023DD6 ValA_Wu16 688. DINH_FIdVerb 0.00 688. FORMAT "%2.0" NUMBER 2 /end CHARACTERISTIC
/begin CHARACTERISTIC DINH_FId.DFC_GlwEcuGk4Wdst_CA "DINH/Zugeordnete FId für Verriegelungsquelle DFC_GlwEcuGk4Wdst" VAL_BLK 0x80023DDA ValA_Wu16 688. DINH_FIdVerb 0.00 688. FORMAT "%2.0" NUMBER 2 /end CHARACTERISTIC
/begin CHARACTERISTIC DINH_FId.DFC_GlwEcuGk5HSS_CA "DINH/Zugeordnete FId für Verriegelungsquelle DFC_GlwEcuGk5HSS" VAL_BLK 0x80023DDE ValA_Wu16 688. DINH_FIdVerb 0.00 688. FORMAT "%2.0" NUMBER 2 /end CHARACTERISTIC
/begin CHARACTERISTIC DINH_FId.DFC_GlwEcuGk5OL_CA "DINH/Zugeordnete FId für Verriegelungsquelle DFC_GlwEcuGk5OL" VAL_BLK 0x80023DE2 ValA_Wu16 688. DINH_FIdVerb 0.00 688. FORMAT "%2.0" NUMBER 2 /end CHARACTERISTIC
/begin CHARACTERISTIC DINH_FId.DFC_GlwEcuGk5SC_CA "DINH/Zugeordnete FId für Verriegelungsquelle DFC_GlwEcuGk5SC" VAL_BLK 0x80023DE6 ValA_Wu16 688. DINH_FIdVerb 0.00 688. FORMAT "%2.0" NUMBER 2 /end CHARACTERISTIC
/begin CHARACTERISTIC DINH_FId.DFC_GlwEcuGk5Wdst_CA "DINH/Zugeordnete FId für Verriegelungsquelle DFC_GlwEcuGk5Wdst" VAL_BLK 0x80023DEA ValA_Wu16 688. DINH_FIdVerb 0.00 688. FORMAT "%2.0" NUMBER 2 /end CHARACTERISTIC
/begin CHARACTERISTIC DINH_FId.DFC_GlwEcuGk6HSS_CA "DINH/Zugeordnete FId für Verriegelungsquelle DFC_GlwEcuGk6HSS" VAL_BLK 0x80023DEE ValA_Wu16 688. DINH_FIdVerb 0.00 688. FORMAT "%2.0" NUMBER 2 /end CHARACTERISTIC
/begin CHARACTERISTIC DINH_FId.DFC_GlwEcuGk6OL_CA "DINH/Zugeordnete FId für Verriegelungsquelle DFC_GlwEcuGk6OL" VAL_BLK 0x80023DF2 ValA_Wu16 688. DINH_FIdVerb 0.00 688. FORMAT "%2.0" NUMBER 2 /end CHARACTERISTIC
/begin CHARACTERISTIC DINH_FId.DFC_GlwEcuGk6SC_CA "DINH/Zugeordnete FId für Verriegelungsquelle DFC_GlwEcuGk6SC" VAL_BLK 0x80023DF6 ValA_Wu16 688. DINH_FIdVerb 0.00 688. FORMAT "%2.0" NUMBER 2 /end CHARACTERISTIC
/begin CHARACTERISTIC DINH_FId.DFC_GlwEcuGk6Wdst_CA "DINH/Zugeordnete FId für Verriegelungsquelle DFC_GlwEcuGk6Wdst" VAL_BLK 0x80023DFA ValA_Wu16 688. DINH_FIdVerb 0.00 688. FORMAT "%2.0" NUMBER 2 /end CHARACTERISTIC
/begin CHARACTERISTIC DINH_FId.DFC_GlwEcuGndErr_CA "DINH/Zugeordnete FId für Verriegelungsquelle DFC_GlwEcuGndErr" VAL_BLK 0x80023DFE ValA_Wu16 688. DINH_FIdVerb 0.00 688. FORMAT "%2.0" NUMBER 2 /end CHARACTERISTIC
/begin CHARACTERISTIC DINH_FId.DFC_GlwEcuIntErr_CA "DINH/Zugeordnete FId für Verriegelungsquelle DFC_GlwEcuIntErr" VAL_BLK 0x80023E02 ValA_Wu16 688. DINH_FIdVerb 0.00 688. FORMAT "%2.0" NUMBER 2 /end CHARACTERISTIC
/begin CHARACTERISTIC DINH_FId.DFC_GlwEcuMsgTimeout_CA "DINH/Zugeordnete FId für Verriegelungsquelle DFC_GlwEcuMsgTimeout" VAL_BLK 0x80023E06 ValA_Wu16 688. DINH_FIdVerb 0.00 688. FORMAT "%2.0" NUMBER 2 /end CHARACTERISTIC
/begin CHARACTERISTIC DINH_FId.DFC_GlwEcuT30Err_CA "DINH/Zugeordnete FId für Verriegelungsquelle DFC_GlwEcuT30Err" VAL_BLK 0x80023E0A ValA_Wu16 688. DINH_FIdVerb 0.00 688. FORMAT "%2.0" NUMBER 2 /end CHARACTERISTIC
/begin CHARACTERISTIC DINH_FId.DFC_GlwEcuTempErr_CA "DINH/Zugeordnete FId für Verriegelungsquelle DFC_GlwEcuTempErr" VAL_BLK 0x80023E0E ValA_Wu16 688. DINH_FIdVerb 0.00 688. FORMAT "%2.0" NUMBER 2 /end CHARACTERISTIC
/begin CHARACTERISTIC DINH_FId.DFC_GlwEcuUdiffT30_CA "DINH/Zugeordnete FId für Verriegelungsquelle DFC_GlwEcuUdiffT30" VAL_BLK 0x80023E12 ValA_Wu16 688. DINH_FIdVerb 0.00 688. FORMAT "%2.0" NUMBER 2 /end CHARACTERISTIC
/begin CHARACTERISTIC DINH_FId.DFC_IBSComErr_CA "DINH/Zugeordnete FId für Verriegelungsquelle DFC_IBSComErr" VAL_BLK 0x80023E16 ValA_Wu16 688. DINH_FIdVerb 0.00 688. FORMAT "%2.0" NUMBER 3 /end CHARACTERISTIC
/begin CHARACTERISTIC DINH_FId.DFC_LubSRCOilFldtCrit_CA "DINH/Zugeordnete FId für Verriegelungsquelle DFC_LubSRCOilFldtCrit" VAL_BLK 0x80023E1C ValA_Wu16 688. DINH_FIdVerb 0.00 688. FORMAT "%2.0" NUMBER 3 /end CHARACTERISTIC
/begin CHARACTERISTIC DINH_FId.DFC_LubSRCOilFldtCritDflMin_CA "DINH/Zugeordnete FId für Verriegelungsquelle DFC_LubSRCOilFldtCritDflMin" VAL_BLK 0x80023E22 ValA_Wu16 688. DINH_FIdVerb 0.00 688. FORMAT "%2.0" NUMBER 2 /end CHARACTERISTIC
/begin CHARACTERISTIC DINH_FId.DFC_LubSRCOilLvlCritMax_CA "DINH/Zugeordnete FId für Verriegelungsquelle DFC_LubSRCOilLvlCritMax" VAL_BLK 0x80023E26 ValA_Wu16 688. DINH_FIdVerb 0.00 688. FORMAT "%2.0" NUMBER 2 /end CHARACTERISTIC
/begin CHARACTERISTIC DINH_FId.DFC_LubSRCOilLvlCritMin_CA "DINH/Zugeordnete FId für Verriegelungsquelle DFC_LubSRCOilLvlCritMin" VAL_BLK 0x80023E2A ValA_Wu16 688. DINH_FIdVerb 0.00 688. FORMAT "%2.0" NUMBER 2 /end CHARACTERISTIC
/begin CHARACTERISTIC DINH_FId.DFC_LubSRCTot_CA "DINH/Zugeordnete FId für Verriegelungsquelle DFC_LubSRCTot" VAL_BLK 0x80023E2E ValA_Wu16 688. DINH_FIdVerb 0.00 688. FORMAT "%2.0" NUMBER 2 /end CHARACTERISTIC
/begin CHARACTERISTIC DINH_FId.DFC_MonUMaxSupply1_CA "DINH/Zugeordnete FId für Verriegelungsquelle DFC_MonUMaxSupply1" VAL_BLK 0x80023E32 ValA_Wu16 688. DINH_FIdVerb 0.00 688. FORMAT "%2.0" NUMBER 5 /end CHARACTERISTIC
/begin CHARACTERISTIC DINH_FId.DFC_MonUMinSupply1_CA "DINH/Zugeordnete FId für Verriegelungsquelle DFC_MonUMinSupply1" VAL_BLK 0x80023E3C ValA_Wu16 688. DINH_FIdVerb 0.00 688. FORMAT "%2.0" NUMBER 5 /end CHARACTERISTIC
/begin CHARACTERISTIC DINH_FId.DFC_OilComNpl_CA "DINH/Zugeordnete FId für Verriegelungsquelle DFC_OilComNpl" VAL_BLK 0x80023E46 ValA_Wu16 688. DINH_FIdVerb 0.00 688. FORMAT "%2.0" NUMBER 2 /end CHARACTERISTIC
/begin CHARACTERISTIC DINH_FId.DFC_PCBS_CA "DINH/Zugeordnete FId für Verriegelungsquelle DFC_PCBS" VAL_BLK 0x80023E4A ValA_Wu16 688. DINH_FIdVerb 0.00 688. FORMAT "%2.0" NUMBER 5 /end CHARACTERISTIC
/begin CHARACTERISTIC DINH_FId.DFC_PCBSPFltChg_CA "DINH/Zugeordnete FId für Verriegelungsquelle DFC_PCBSPFltChg" VAL_BLK 0x80023E54 ValA_Wu16 688. DINH_FIdVerb 0.00 688. FORMAT "%2.0" NUMBER 2 /end CHARACTERISTIC
/begin CHARACTERISTIC DINH_FId.DFC_PCRGovDvtLPMax_CA "DINH/Zugeordnete FId für Verriegelungsquelle DFC_PCRGovDvtLPMax" VAL_BLK 0x80023E58 ValA_Wu16 688. DINH_FIdVerb 0.00 688. FORMAT "%2.0" NUMBER 3 /end CHARACTERISTIC
/begin CHARACTERISTIC DINH_FId.DFC_PCRGovDvtLPMin_CA "DINH/Zugeordnete FId für Verriegelungsquelle DFC_PCRGovDvtLPMin" VAL_BLK 0x80023E5E ValA_Wu16 688. DINH_FIdVerb 0.00 688. FORMAT "%2.0" NUMBER 3 /end CHARACTERISTIC
/begin CHARACTERISTIC DINH_FId.DFC_PCRGovDvtMax_CA "DINH/Zugeordnete FId für Verriegelungsquelle DFC_PCRGovDvtMax" VAL_BLK 0x80023E64 ValA_Wu16 688. DINH_FIdVerb 0.00 688. FORMAT "%2.0" NUMBER 6 /end CHARACTERISTIC
/begin CHARACTERISTIC DINH_FId.DFC_PCRGovDvtMin_CA "DINH/Zugeordnete FId für Verriegelungsquelle DFC_PCRGovDvtMin" VAL_BLK 0x80023E70 ValA_Wu16 688. DINH_FIdVerb 0.00 688. FORMAT "%2.0" NUMBER 5 /end CHARACTERISTIC
/begin CHARACTERISTIC DINH_FId.DFC_PFltAPSPlausMAX_CA "DINH/Zugeordnete FId für Verriegelungsquelle DFC_PFltAPSPlausMAX" VAL_BLK 0x80023E7A ValA_Wu16 688. DINH_FIdVerb 0.00 688. FORMAT "%2.0" NUMBER 8 /end CHARACTERISTIC
/begin CHARACTERISTIC DINH_FId.DFC_PFltAPSPlausMIN_CA "DINH/Zugeordnete FId für Verriegelungsquelle DFC_PFltAPSPlausMIN" VAL_BLK 0x80023E8A ValA_Wu16 688. DINH_FIdVerb 0.00 688. FORMAT "%2.0" NUMBER 8 /end CHARACTERISTIC
/begin CHARACTERISTIC DINH_FId.DFC_PFltBPSPlausMAX_CA "DINH/Zugeordnete FId für Verriegelungsquelle DFC_PFltBPSPlausMAX" VAL_BLK 0x80023E9A ValA_Wu16 688. DINH_FIdVerb 0.00 688. FORMAT "%2.0" NUMBER 8 /end CHARACTERISTIC
/begin CHARACTERISTIC DINH_FId.DFC_PFltBPSPlausMIN_CA "DINH/Zugeordnete FId für Verriegelungsquelle DFC_PFltBPSPlausMIN" VAL_BLK 0x80023EAA ValA_Wu16 688. DINH_FIdVerb 0.00 688. FORMAT "%2.0" NUMBER 8 /end CHARACTERISTIC
/begin CHARACTERISTIC DINH_FId.DFC_PFltOvldInhRgn_CA "DINH/Zugeordnete FId für Verriegelungsquelle DFC_PFltOvldInhRgn" VAL_BLK 0x80023EBA ValA_Wu16 688. DINH_FIdVerb 0.00 688. FORMAT "%2.0" NUMBER 7 /end CHARACTERISTIC
/begin CHARACTERISTIC DINH_FId.DFC_PFltOvldTrqLim_CA "DINH/Zugeordnete FId für Verriegelungsquelle DFC_PFltOvldTrqLim" VAL_BLK 0x80023EC8 ValA_Wu16 688. DINH_FIdVerb 0.00 688. FORMAT "%2.0" NUMBER 7 /end CHARACTERISTIC
/begin CHARACTERISTIC DINH_FId.DFC_PFltPresPlausMAX_CA "DINH/Zugeordnete FId für Verriegelungsquelle DFC_PFltPresPlausMAX" VAL_BLK 0x80023ED6 ValA_Wu16 688. DINH_FIdVerb 0.00 688. FORMAT "%2.0" NUMBER 7 /end CHARACTERISTIC
/begin CHARACTERISTIC DINH_FId.DFC_PFltPresPlausMIN_CA "DINH/Zugeordnete FId für Verriegelungsquelle DFC_PFltPresPlausMIN" VAL_BLK 0x80023EE4 ValA_Wu16 688. DINH_FIdVerb 0.00 688. FORMAT "%2.0" NUMBER 7 /end CHARACTERISTIC
/begin CHARACTERISTIC DINH_FId.DFC_PFltTraRpmRdc_CA "DINH/Zugeordnete FId für Verriegelungsquelle DFC_PFltTraRpmRdc" VAL_BLK 0x80023EF2 ValA_Wu16 688. DINH_FIdVerb 0.00 688. FORMAT "%2.0" NUMBER 7 /end CHARACTERISTIC
/begin CHARACTERISTIC DINH_FId.DFC_PFlt_tOxiPreMax_CA "DINH/Zugeordnete FId für Verriegelungsquelle DFC_PFlt_tOxiPreMax" VAL_BLK 0x80023F00 ValA_Wu16 688. DINH_FIdVerb 0.00 688. FORMAT "%2.0" NUMBER 7 /end CHARACTERISTIC
/begin CHARACTERISTIC DINH_FId.DFC_PFlt_tOxiPreMaxRgn_CA "DINH/Zugeordnete FId für Verriegelungsquelle DFC_PFlt_tOxiPreMaxRgn" VAL_BLK 0x80023F0E ValA_Wu16 688. DINH_FIdVerb 0.00 688. FORMAT "%2.0" NUMBER 7 /end CHARACTERISTIC
/begin CHARACTERISTIC DINH_FId.DFC_PFlt_tOxiPreNpl_CA "DINH/Zugeordnete FId für Verriegelungsquelle DFC_PFlt_tOxiPreNpl" VAL_BLK 0x80023F1C ValA_Wu16 688. DINH_FIdVerb 0.00 688. FORMAT "%2.0" NUMBER 7 /end CHARACTERISTIC
/begin CHARACTERISTIC DINH_FId.DFC_PFlt_tPreMax_CA "DINH/Zugeordnete FId für Verriegelungsquelle DFC_PFlt_tPreMax" VAL_BLK 0x80023F2A ValA_Wu16 688. DINH_FIdVerb 0.00 688. FORMAT "%2.0" NUMBER 7 /end CHARACTERISTIC
/begin CHARACTERISTIC DINH_FId.DFC_PFlt_tPreMaxRgn_CA "DINH/Zugeordnete FId für Verriegelungsquelle DFC_PFlt_tPreMaxRgn" VAL_BLK 0x80023F38 ValA_Wu16 688. DINH_FIdVerb 0.00 688. FORMAT "%2.0" NUMBER 7 /end CHARACTERISTIC
/begin CHARACTERISTIC DINH_FId.DFC_PFlt_tPreNpl_CA "DINH/Zugeordnete FId für Verriegelungsquelle DFC_PFlt_tPreNpl" VAL_BLK 0x80023F46 ValA_Wu16 688. DINH_FIdVerb 0.00 688. FORMAT "%2.0" NUMBER 7 /end CHARACTERISTIC
/begin CHARACTERISTIC DINH_FId.DFC_PFltmSotDiffMAX_CA "DINH/Zugeordnete FId für Verriegelungsquelle DFC_PFltmSotDiffMAX" VAL_BLK 0x80023F54 ValA_Wu16 688. DINH_FIdVerb 0.00 688. FORMAT "%2.0" NUMBER 7 /end CHARACTERISTIC
/begin CHARACTERISTIC DINH_FId.DFC_PFltmSotDiffMIN_CA "DINH/Zugeordnete FId für Verriegelungsquelle DFC_PFltmSotDiffMIN" VAL_BLK 0x80023F62 ValA_Wu16 688. DINH_FIdVerb 0.00 688. FORMAT "%2.0" NUMBER 7 /end CHARACTERISTIC
/begin CHARACTERISTIC DINH_FId.DFC_PFltmSotDiffSIG_CA "DINH/Zugeordnete FId für Verriegelungsquelle DFC_PFltmSotDiffSIG" VAL_BLK 0x80023F70 ValA_Wu16 688. DINH_FIdVerb 0.00 688. FORMAT "%2.0" NUMBER 7 /end CHARACTERISTIC
/begin CHARACTERISTIC DINH_FId.DFC_PIntkVUsEnvPPls_CA "DINH/Zugeordnete FId für Verriegelungsquelle DFC_PIntkVUsEnvPPls" VAL_BLK 0x80023F7E ValA_Wu16 688. DINH_FIdVerb 0.00 688. FORMAT "%2.0" NUMBER 2 /end CHARACTERISTIC
/begin CHARACTERISTIC DINH_FId.DFC_PresPlausDblDef_CA "DINH/Zugeordnete FId für Verriegelungsquelle DFC_PresPlausDblDef" VAL_BLK 0x80023F82 ValA_Wu16 688. DINH_FIdVerb 0.00 688. FORMAT "%2.0" NUMBER 2 /end CHARACTERISTIC
/begin CHARACTERISTIC DINH_FId.DFC_RailCPC1_CA "DINH/Zugeordnete FId für Verriegelungsquelle DFC_RailCPC1" VAL_BLK 0x80023F86 ValA_Wu16 688. DINH_FIdVerb 0.00 688. FORMAT "%2.0" NUMBER 3 /end CHARACTERISTIC
/begin CHARACTERISTIC DINH_FId.DFC_RailCPC3_CA "DINH/Zugeordnete FId für Verriegelungsquelle DFC_RailCPC3" VAL_BLK 0x80023F8C ValA_Wu16 688. DINH_FIdVerb 0.00 688. FORMAT "%2.0" NUMBER 4 /end CHARACTERISTIC
/begin CHARACTERISTIC DINH_FId.DFC_RailCPC4_CA "DINH/Zugeordnete FId für Verriegelungsquelle DFC_RailCPC4" VAL_BLK 0x80023F94 ValA_Wu16 688. DINH_FIdVerb 0.00 688. FORMAT "%2.0" NUMBER 4 /end CHARACTERISTIC
/begin CHARACTERISTIC DINH_FId.DFC_RailMeUn0_CA "DINH/Zugeordnete FId für Verriegelungsquelle DFC_RailMeUn0" VAL_BLK 0x80023F9C ValA_Wu16 688. DINH_FIdVerb 0.00 688. FORMAT "%2.0" NUMBER 9 /end CHARACTERISTIC
/begin CHARACTERISTIC DINH_FId.DFC_RailMeUn1_CA "DINH/Zugeordnete FId für Verriegelungsquelle DFC_RailMeUn1" VAL_BLK 0x80023FAE ValA_Wu16 688. DINH_FIdVerb 0.00 688. FORMAT "%2.0" NUMBER 8 /end CHARACTERISTIC
/begin CHARACTERISTIC DINH_FId.DFC_RailMeUn2_CA "DINH/Zugeordnete FId für Verriegelungsquelle DFC_RailMeUn2" VAL_BLK 0x80023FBE ValA_Wu16 688. DINH_FIdVerb 0.00 688. FORMAT "%2.0" NUMBER 10 /end CHARACTERISTIC
/begin CHARACTERISTIC DINH_FId.DFC_RailMeUn22_CA "DINH/Zugeordnete FId für Verriegelungsquelle DFC_RailMeUn22" VAL_BLK 0x80023FD2 ValA_Wu16 688. DINH_FIdVerb 0.00 688. FORMAT "%2.0" NUMBER 2 /end CHARACTERISTIC
/begin CHARACTERISTIC DINH_FId.DFC_RailMeUn3_CA "DINH/Zugeordnete FId für Verriegelungsquelle DFC_RailMeUn3" VAL_BLK 0x80023FD6 ValA_Wu16 688. DINH_FIdVerb 0.00 688. FORMAT "%2.0" NUMBER 15 /end CHARACTERISTIC
/begin CHARACTERISTIC DINH_FId.DFC_RailMeUn4_CA "DINH/Zugeordnete FId für Verriegelungsquelle DFC_RailMeUn4" VAL_BLK 0x80023FF4 ValA_Wu16 688. DINH_FIdVerb 0.00 688. FORMAT "%2.0" NUMBER 10 /end CHARACTERISTIC
/begin CHARACTERISTIC DINH_FId.DFC_RailMeUn42_CA "DINH/Zugeordnete FId für Verriegelungsquelle DFC_RailMeUn42" VAL_BLK 0x80024008 ValA_Wu16 688. DINH_FIdVerb 0.00 688. FORMAT "%2.0" NUMBER 2 /end CHARACTERISTIC
/begin CHARACTERISTIC DINH_FId.DFC_RailMeUn5_CA "DINH/Zugeordnete FId für Verriegelungsquelle DFC_RailMeUn5" VAL_BLK 0x8002400C ValA_Wu16 688. DINH_FIdVerb 0.00 688. FORMAT "%2.0" NUMBER 2 /end CHARACTERISTIC
/begin CHARACTERISTIC DINH_FId.DFC_RailPCV0_CA "DINH/Zugeordnete FId für Verriegelungsquelle DFC_RailPCV0" VAL_BLK 0x80024010 ValA_Wu16 688. DINH_FIdVerb 0.00 688. FORMAT "%2.0" NUMBER 12 /end CHARACTERISTIC
/begin CHARACTERISTIC DINH_FId.DFC_RailPCV1_CA "DINH/Zugeordnete FId für Verriegelungsquelle DFC_RailPCV1" VAL_BLK 0x80024028 ValA_Wu16 688. DINH_FIdVerb 0.00 688. FORMAT "%2.0" NUMBER 13 /end CHARACTERISTIC
/begin CHARACTERISTIC DINH_FId.DFC_RailPCV2_CA "DINH/Zugeordnete FId für Verriegelungsquelle DFC_RailPCV2" VAL_BLK 0x80024042 ValA_Wu16 688. DINH_FIdVerb 0.00 688. FORMAT "%2.0" NUMBER 9 /end CHARACTERISTIC
/begin CHARACTERISTIC DINH_FId.DFC_RailPCV22_CA "DINH/Zugeordnete FId für Verriegelungsquelle DFC_RailPCV22" VAL_BLK 0x80024054 ValA_Wu16 688. DINH_FIdVerb 0.00 688. FORMAT "%2.0" NUMBER 2 /end CHARACTERISTIC
/begin CHARACTERISTIC DINH_FId.DFC_RailPCV3_CA "DINH/Zugeordnete FId für Verriegelungsquelle DFC_RailPCV3" VAL_BLK 0x80024058 ValA_Wu16 688. DINH_FIdVerb 0.00 688. FORMAT "%2.0" NUMBER 15 /end CHARACTERISTIC
/begin CHARACTERISTIC DINH_FId.DFC_RailPCV4_CA "DINH/Zugeordnete FId für Verriegelungsquelle DFC_RailPCV4" VAL_BLK 0x80024076 ValA_Wu16 688. DINH_FIdVerb 0.00 688. FORMAT "%2.0" NUMBER 9 /end CHARACTERISTIC
/begin CHARACTERISTIC DINH_FId.DFC_RailPCV42_CA "DINH/Zugeordnete FId für Verriegelungsquelle DFC_RailPCV42" VAL_BLK 0x80024088 ValA_Wu16 688. DINH_FIdVerb 0.00 688. FORMAT "%2.0" NUMBER 2 /end CHARACTERISTIC
/begin CHARACTERISTIC DINH_FId.DFC_RailPMonStrt_CA "DINH/Zugeordnete FId für Verriegelungsquelle DFC_RailPMonStrt" VAL_BLK 0x8002408C ValA_Wu16 688. DINH_FIdVerb 0.00 688. FORMAT "%2.0" NUMBER 2 /end CHARACTERISTIC
/begin CHARACTERISTIC DINH_FId.DFC_SSpMon1_CA "DINH/Zugeordnete FId für Verriegelungsquelle DFC_SSpMon1" VAL_BLK 0x80024090 ValA_Wu16 688. DINH_FIdVerb 0.00 688. FORMAT "%2.0" NUMBER 10 /end CHARACTERISTIC
/begin CHARACTERISTIC DINH_FId.DFC_SSpMon2_CA "DINH/Zugeordnete FId für Verriegelungsquelle DFC_SSpMon2" VAL_BLK 0x800240A4 ValA_Wu16 688. DINH_FIdVerb 0.00 688. FORMAT "%2.0" NUMBER 9 /end CHARACTERISTIC
/begin CHARACTERISTIC DINH_FId.DFC_SSpMon3_CA "DINH/Zugeordnete FId für Verriegelungsquelle DFC_SSpMon3" VAL_BLK 0x800240B6 ValA_Wu16 688. DINH_FIdVerb 0.00 688. FORMAT "%2.0" NUMBER 8 /end CHARACTERISTIC
/begin CHARACTERISTIC DINH_FId.DFC_ThrVlv4WinErr1_CA "DINH/Zugeordnete FId für Verriegelungsquelle DFC_ThrVlv4WinErr1" VAL_BLK 0x800240C6 ValA_Wu16 688. DINH_FIdVerb 0.00 688. FORMAT "%2.0" NUMBER 2 /end CHARACTERISTIC
/begin CHARACTERISTIC DINH_FId.DFC_ThrVlv4WinErr2_CA "DINH/Zugeordnete FId für Verriegelungsquelle DFC_ThrVlv4WinErr2" VAL_BLK 0x800240CA ValA_Wu16 688. DINH_FIdVerb 0.00 688. FORMAT "%2.0" NUMBER 2 /end CHARACTERISTIC
/begin CHARACTERISTIC DINH_FId.DFC_ThrVlv4WinErr3_CA "DINH/Zugeordnete FId für Verriegelungsquelle DFC_ThrVlv4WinErr3" VAL_BLK 0x800240CE ValA_Wu16 688. DINH_FIdVerb 0.00 688. FORMAT "%2.0" NUMBER 2 /end CHARACTERISTIC
/begin CHARACTERISTIC DINH_FId.DFC_ThrVlv4WinErr4_CA "DINH/Zugeordnete FId für Verriegelungsquelle DFC_ThrVlv4WinErr4" VAL_BLK 0x800240D2 ValA_Wu16 688. DINH_FIdVerb 0.00 688. FORMAT "%2.0" NUMBER 2 /end CHARACTERISTIC
/begin CHARACTERISTIC DINH_FId.DFC_ThrVlvSCG_CA "DINH/Zugeordnete FId für Verriegelungsquelle DFC_ThrVlvSCG" VAL_BLK 0x800240D6 ValA_Wu16 688. DINH_FIdVerb 0.00 688. FORMAT "%2.0" NUMBER 9 /end CHARACTERISTIC
/begin CHARACTERISTIC DINH_FId.DFC_Tle6232Spi1_CA "DINH/Zugeordnete FId für Verriegelungsquelle DFC_Tle6232Spi1" VAL_BLK 0x800240E8 ValA_Wu16 688. DINH_FIdVerb 0.00 688. FORMAT "%2.0" NUMBER 2 /end CHARACTERISTIC
/begin CHARACTERISTIC DINH_FId.DFC_TrbCh4WinErr1_CA "DINH/Zugeordnete FId für Verriegelungsquelle DFC_TrbCh4WinErr1" VAL_BLK 0x800240EC ValA_Wu16 688. DINH_FIdVerb 0.00 688. FORMAT "%2.0" NUMBER 2 /end CHARACTERISTIC
/begin CHARACTERISTIC DINH_FId.DFC_TrbCh4WinErr2_CA "DINH/Zugeordnete FId für Verriegelungsquelle DFC_TrbCh4WinErr2" VAL_BLK 0x800240F0 ValA_Wu16 688. DINH_FIdVerb 0.00 688. FORMAT "%2.0" NUMBER 2 /end CHARACTERISTIC
/begin CHARACTERISTIC DINH_FId.DFC_TrbCh4WinErr3_CA "DINH/Zugeordnete FId für Verriegelungsquelle DFC_TrbCh4WinErr3" VAL_BLK 0x800240F4 ValA_Wu16 688. DINH_FIdVerb 0.00 688. FORMAT "%2.0" NUMBER 2 /end CHARACTERISTIC
/begin CHARACTERISTIC DINH_FId.DFC_TrbCh4WinErr4_CA "DINH/Zugeordnete FId für Verriegelungsquelle DFC_TrbCh4WinErr4" VAL_BLK 0x800240F8 ValA_Wu16 688. DINH_FIdVerb 0.00 688. FORMAT "%2.0" NUMBER 2 /end CHARACTERISTIC
/begin CHARACTERISTIC DINH_FId.DFC_TrbChSCG_CA "DINH/Zugeordnete FId für Verriegelungsquelle DFC_TrbChSCG" VAL_BLK 0x800240FC ValA_Wu16 688. DINH_FIdVerb 0.00 688. FORMAT "%2.0" NUMBER 9 /end CHARACTERISTIC
/begin CHARACTERISTIC DINH_FId.DFC_TrbChSRCMax_CA "DINH/Zugeordnete FId für Verriegelungsquelle DFC_TrbChSRCMax" VAL_BLK 0x8002410E ValA_Wu16 688. DINH_FIdVerb 0.00 688. FORMAT "%2.0" NUMBER 5 /end CHARACTERISTIC
/begin CHARACTERISTIC DINH_FId.DFC_TrbChSRCMin_CA "DINH/Zugeordnete FId für Verriegelungsquelle DFC_TrbChSRCMin" VAL_BLK 0x80024118 ValA_Wu16 688. DINH_FIdVerb 0.00 688. FORMAT "%2.0" NUMBER 5 /end CHARACTERISTIC
/begin CHARACTERISTIC DINH_FId.DFC_WaHtEl4WinErr1_CA "DINH/Zugeordnete FId für Verriegelungsquelle DFC_WaHtEl4WinErr1" VAL_BLK 0x80024122 ValA_Wu16 688. DINH_FIdVerb 0.00 688. FORMAT "%2.0" NUMBER 2 /end CHARACTERISTIC
/begin CHARACTERISTIC DINH_FId.DFC_WaHtEl4WinErr2_CA "DINH/Zugeordnete FId für Verriegelungsquelle DFC_WaHtEl4WinErr2" VAL_BLK 0x80024126 ValA_Wu16 688. DINH_FIdVerb 0.00 688. FORMAT "%2.0" NUMBER 2 /end CHARACTERISTIC
/begin CHARACTERISTIC DINH_FId.DFC_WaHtEl4WinErr3_CA "DINH/Zugeordnete FId für Verriegelungsquelle DFC_WaHtEl4WinErr3" VAL_BLK 0x8002412A ValA_Wu16 688. DINH_FIdVerb 0.00 688. FORMAT "%2.0" NUMBER 2 /end CHARACTERISTIC
/begin CHARACTERISTIC DINH_FId.DFC_WaHtEl4WinErr4_CA "DINH/Zugeordnete FId für Verriegelungsquelle DFC_WaHtEl4WinErr4" VAL_BLK 0x8002412E ValA_Wu16 688. DINH_FIdVerb 0.00 688. FORMAT "%2.0" NUMBER 2 /end CHARACTERISTIC
/begin CHARACTERISTIC DINH_FId.DFC_WaHtElSCG_CA "DINH/Zugeordnete FId für Verriegelungsquelle DFC_WaHtElSCG" VAL_BLK 0x80024132 ValA_Wu16 688. DINH_FIdVerb 0.00 688. FORMAT "%2.0" NUMBER 2 /end CHARACTERISTIC
/begin CHARACTERISTIC DINH_FId.DFC_ETClbETFltMax_0_CA "DINH/Zugeordnete FId für Verriegelungsquelle DFC_ETClbETFltMax_0" VAL_BLK 0x80024136 ValA_Wu16 688. DINH_FIdVerb 0.00 688. FORMAT "%2.0" NUMBER 2 /end CHARACTERISTIC
/begin CHARACTERISTIC DINH_FId.DFC_ETClbETFltMax_1_CA "DINH/Zugeordnete FId für Verriegelungsquelle DFC_ETClbETFltMax_1" VAL_BLK 0x8002413A ValA_Wu16 688. DINH_FIdVerb 0.00 688. FORMAT "%2.0" NUMBER 2 /end CHARACTERISTIC
/begin CHARACTERISTIC DINH_FId.DFC_ETClbETFltMax_2_CA "DINH/Zugeordnete FId für Verriegelungsquelle DFC_ETClbETFltMax_2" VAL_BLK 0x8002413E ValA_Wu16 688. DINH_FIdVerb 0.00 688. FORMAT "%2.0" NUMBER 2 /end CHARACTERISTIC
/begin CHARACTERISTIC DINH_FId.DFC_ETClbETFltMax_3_CA "DINH/Zugeordnete FId für Verriegelungsquelle DFC_ETClbETFltMax_3" VAL_BLK 0x80024142 ValA_Wu16 688. DINH_FIdVerb 0.00 688. FORMAT "%2.0" NUMBER 2 /end CHARACTERISTIC
/begin CHARACTERISTIC DINH_FId.DFC_ETClbETFltMax_4_CA "DINH/Zugeordnete FId für Verriegelungsquelle DFC_ETClbETFltMax_4" VAL_BLK 0x80024146 ValA_Wu16 688. DINH_FIdVerb 0.00 688. FORMAT "%2.0" NUMBER 2 /end CHARACTERISTIC
/begin CHARACTERISTIC DINH_FId.DFC_ETClbETFltMax_5_CA "DINH/Zugeordnete FId für Verriegelungsquelle DFC_ETClbETFltMax_5" VAL_BLK 0x8002414A ValA_Wu16 688. DINH_FIdVerb 0.00 688. FORMAT "%2.0" NUMBER 2 /end CHARACTERISTIC
/begin CHARACTERISTIC DINH_FId.DFC_ETClbETFltMin_0_CA "DINH/Zugeordnete FId für Verriegelungsquelle DFC_ETClbETFltMin_0" VAL_BLK 0x8002414E ValA_Wu16 688. DINH_FIdVerb 0.00 688. FORMAT "%2.0" NUMBER 2 /end CHARACTERISTIC
/begin CHARACTERISTIC DINH_FId.DFC_ETClbETFltMin_1_CA "DINH/Zugeordnete FId für Verriegelungsquelle DFC_ETClbETFltMin_1" VAL_BLK 0x80024152 ValA_Wu16 688. DINH_FIdVerb 0.00 688. FORMAT "%2.0" NUMBER 2 /end CHARACTERISTIC
/begin CHARACTERISTIC DINH_FId.DFC_ETClbETFltMin_2_CA "DINH/Zugeordnete FId für Verriegelungsquelle DFC_ETClbETFltMin_2" VAL_BLK 0x80024156 ValA_Wu16 688. DINH_FIdVerb 0.00 688. FORMAT "%2.0" NUMBER 2 /end CHARACTERISTIC
/begin CHARACTERISTIC DINH_FId.DFC_ETClbETFltMin_3_CA "DINH/Zugeordnete FId für Verriegelungsquelle DFC_ETClbETFltMin_3" VAL_BLK 0x8002415A ValA_Wu16 688. DINH_FIdVerb 0.00 688. FORMAT "%2.0" NUMBER 2 /end CHARACTERISTIC
/begin CHARACTERISTIC DINH_FId.DFC_ETClbETFltMin_4_CA "DINH/Zugeordnete FId für Verriegelungsquelle DFC_ETClbETFltMin_4" VAL_BLK 0x8002415E ValA_Wu16 688. DINH_FIdVerb 0.00 688. FORMAT "%2.0" NUMBER 2 /end CHARACTERISTIC
/begin CHARACTERISTIC DINH_FId.DFC_ETClbETFltMin_5_CA "DINH/Zugeordnete FId für Verriegelungsquelle DFC_ETClbETFltMin_5" VAL_BLK 0x80024162 ValA_Wu16 688. DINH_FIdVerb 0.00 688. FORMAT "%2.0" NUMBER 2 /end CHARACTERISTIC
/begin CHARACTERISTIC DINH_FId.DFC_InjCrvInjLimChrgBal_CA "DINH/Zugeordnete FId für Verriegelungsquelle DFC_InjCrvInjLimChrgBal" VAL_BLK 0x80024166 ValA_Wu16 688. DINH_FIdVerb 0.00 688. FORMAT "%2.0" NUMBER 2 /end CHARACTERISTIC
/begin CHARACTERISTIC DINH_FId.DFC_InjCrvInjLimQntBal_CA "DINH/Zugeordnete FId für Verriegelungsquelle DFC_InjCrvInjLimQntBal" VAL_BLK 0x8002416A ValA_Wu16 688. DINH_FIdVerb 0.00 688. FORMAT "%2.0" NUMBER 2 /end CHARACTERISTIC
/begin CHARACTERISTIC DINH_FId.DFC_InjCrvInjLimSys_CA "DINH/Zugeordnete FId für Verriegelungsquelle DFC_InjCrvInjLimSys" VAL_BLK 0x8002416E ValA_Wu16 688. DINH_FIdVerb 0.00 688. FORMAT "%2.0" NUMBER 2 /end CHARACTERISTIC
/begin CHARACTERISTIC DINH_FId.DFC_InjCrvNumInjRtmLim_CA "DINH/Zugeordnete FId für Verriegelungsquelle DFC_InjCrvNumInjRtmLim" VAL_BLK 0x80024172 ValA_Wu16 688. DINH_FIdVerb 0.00 688. FORMAT "%2.0" NUMBER 2 /end CHARACTERISTIC
/begin CHARACTERISTIC DINH_FId.DFC_LSUHtCoupSig_CA "DINH/Zugeordnete FId für Verriegelungsquelle DFC_LSUHtCoupSig" VAL_BLK 0x80024176 ValA_Wu16 688. DINH_FIdVerb 0.00 688. FORMAT "%2.0" NUMBER 10 /end CHARACTERISTIC
/begin CHARACTERISTIC DINH_FId.DFC_AFS_SSpShOffOL_CA "DINH/Zugeordnete FId für Verriegelungsquelle DFC_AFS_SSpShOffOL" VAL_BLK 0x8002418A ValA_Wu16 688. DINH_FIdVerb 0.00 688. FORMAT "%2.0" NUMBER 5 /end CHARACTERISTIC
/begin CHARACTERISTIC DINH_FId.DFC_AFS_SSpShOffOvrTemp_CA "DINH/Zugeordnete FId für Verriegelungsquelle DFC_AFS_SSpShOffOvrTemp" VAL_BLK 0x80024194 ValA_Wu16 688. DINH_FIdVerb 0.00 688. FORMAT "%2.0" NUMBER 5 /end CHARACTERISTIC
/begin CHARACTERISTIC DINH_FId.DFC_AFS_SSpShOffSCB_CA "DINH/Zugeordnete FId für Verriegelungsquelle DFC_AFS_SSpShOffSCB" VAL_BLK 0x8002419E ValA_Wu16 688. DINH_FIdVerb 0.00 688. FORMAT "%2.0" NUMBER 5 /end CHARACTERISTIC
/begin CHARACTERISTIC DINH_FId.DFC_AFS_SSpShOffSCG_CA "DINH/Zugeordnete FId für Verriegelungsquelle DFC_AFS_SSpShOffSCG" VAL_BLK 0x800241A8 ValA_Wu16 688. DINH_FIdVerb 0.00 688. FORMAT "%2.0" NUMBER 5 /end CHARACTERISTIC
/begin CHARACTERISTIC DINH_FId.DFC_AirCCmprOL_CA "DINH/Zugeordnete FId für Verriegelungsquelle DFC_AirCCmprOL" VAL_BLK 0x800241B2 ValA_Wu16 688. DINH_FIdVerb 0.00 688. FORMAT "%2.0" NUMBER 2 /end CHARACTERISTIC
/begin CHARACTERISTIC DINH_FId.DFC_AirCCmprOvrTemp_CA "DINH/Zugeordnete FId für Verriegelungsquelle DFC_AirCCmprOvrTemp" VAL_BLK 0x800241B6 ValA_Wu16 688. DINH_FIdVerb 0.00 688. FORMAT "%2.0" NUMBER 2 /end CHARACTERISTIC
/begin CHARACTERISTIC DINH_FId.DFC_AirCCmprSCB_CA "DINH/Zugeordnete FId für Verriegelungsquelle DFC_AirCCmprSCB" VAL_BLK 0x800241BA ValA_Wu16 688. DINH_FIdVerb 0.00 688. FORMAT "%2.0" NUMBER 2 /end CHARACTERISTIC
/begin CHARACTERISTIC DINH_FId.DFC_AirCCmprSCG_CA "DINH/Zugeordnete FId für Verriegelungsquelle DFC_AirCCmprSCG" VAL_BLK 0x800241BE ValA_Wu16 688. DINH_FIdVerb 0.00 688. FORMAT "%2.0" NUMBER 2 /end CHARACTERISTIC
/begin CHARACTERISTIC DINH_FId.DFC_CByVlvOL_CA "DINH/Zugeordnete FId für Verriegelungsquelle DFC_CByVlvOL" VAL_BLK 0x800241C2 ValA_Wu16 688. DINH_FIdVerb 0.00 688. FORMAT "%2.0" NUMBER 2 /end CHARACTERISTIC
/begin CHARACTERISTIC DINH_FId.DFC_CByVlvOvrTemp_CA "DINH/Zugeordnete FId für Verriegelungsquelle DFC_CByVlvOvrTemp" VAL_BLK 0x800241C6 ValA_Wu16 688. DINH_FIdVerb 0.00 688. FORMAT "%2.0" NUMBER 2 /end CHARACTERISTIC
/begin CHARACTERISTIC DINH_FId.DFC_CByVlvSCB_CA "DINH/Zugeordnete FId für Verriegelungsquelle DFC_CByVlvSCB" VAL_BLK 0x800241CA ValA_Wu16 688. DINH_FIdVerb 0.00 688. FORMAT "%2.0" NUMBER 2 /end CHARACTERISTIC
/begin CHARACTERISTIC DINH_FId.DFC_CByVlvSCG_CA "DINH/Zugeordnete FId für Verriegelungsquelle DFC_CByVlvSCG" VAL_BLK 0x800241CE ValA_Wu16 688. DINH_FIdVerb 0.00 688. FORMAT "%2.0" NUMBER 2 /end CHARACTERISTIC
/begin CHARACTERISTIC DINH_FId.DFC_CThmstOL_CA "DINH/Zugeordnete FId für Verriegelungsquelle DFC_CThmstOL" VAL_BLK 0x800241D2 ValA_Wu16 688. DINH_FIdVerb 0.00 688. FORMAT "%2.0" NUMBER 2 /end CHARACTERISTIC
/begin CHARACTERISTIC DINH_FId.DFC_CThmstOvrTemp_CA "DINH/Zugeordnete FId für Verriegelungsquelle DFC_CThmstOvrTemp" VAL_BLK 0x800241D6 ValA_Wu16 688. DINH_FIdVerb 0.00 688. FORMAT "%2.0" NUMBER 2 /end CHARACTERISTIC
/begin CHARACTERISTIC DINH_FId.DFC_CThmstSCB_CA "DINH/Zugeordnete FId für Verriegelungsquelle DFC_CThmstSCB" VAL_BLK 0x800241DA ValA_Wu16 688. DINH_FIdVerb 0.00 688. FORMAT "%2.0" NUMBER 2 /end CHARACTERISTIC
/begin CHARACTERISTIC DINH_FId.DFC_CThmstSCG_CA "DINH/Zugeordnete FId für Verriegelungsquelle DFC_CThmstSCG" VAL_BLK 0x800241DE ValA_Wu16 688. DINH_FIdVerb 0.00 688. FORMAT "%2.0" NUMBER 2 /end CHARACTERISTIC
/begin CHARACTERISTIC DINH_FId.DFC_DSMDummy_CA "DINH/Zugeordnete FId für Verriegelungsquelle DFC_DSMDummy" VAL_BLK 0x800241E2 ValA_Wu16 688. DINH_FIdVerb 0.00 688. FORMAT "%2.0" NUMBER 2 /end CHARACTERISTIC
/begin CHARACTERISTIC DINH_FId.DFC_EBxFanOL_CA "DINH/Zugeordnete FId für Verriegelungsquelle DFC_EBxFanOL" VAL_BLK 0x800241E6 ValA_Wu16 688. DINH_FIdVerb 0.00 688. FORMAT "%2.0" NUMBER 2 /end CHARACTERISTIC
/begin CHARACTERISTIC DINH_FId.DFC_EBxFanOvrTemp_CA "DINH/Zugeordnete FId für Verriegelungsquelle DFC_EBxFanOvrTemp" VAL_BLK 0x800241EA ValA_Wu16 688. DINH_FIdVerb 0.00 688. FORMAT "%2.0" NUMBER 2 /end CHARACTERISTIC
/begin CHARACTERISTIC DINH_FId.DFC_EBxFanSCB_CA "DINH/Zugeordnete FId für Verriegelungsquelle DFC_EBxFanSCB" VAL_BLK 0x800241EE ValA_Wu16 688. DINH_FIdVerb 0.00 688. FORMAT "%2.0" NUMBER 2 /end CHARACTERISTIC
/begin CHARACTERISTIC DINH_FId.DFC_EBxFanSCG_CA "DINH/Zugeordnete FId für Verriegelungsquelle DFC_EBxFanSCG" VAL_BLK 0x800241F2 ValA_Wu16 688. DINH_FIdVerb 0.00 688. FORMAT "%2.0" NUMBER 2 /end CHARACTERISTIC
/begin CHARACTERISTIC DINH_FId.DFC_ECBVlvOL_CA "DINH/Zugeordnete FId für Verriegelungsquelle DFC_ECBVlvOL" VAL_BLK 0x800241F6 ValA_Wu16 688. DINH_FIdVerb 0.00 688. FORMAT "%2.0" NUMBER 4 /end CHARACTERISTIC
/begin CHARACTERISTIC DINH_FId.DFC_ECBVlvOvrTemp_CA "DINH/Zugeordnete FId für Verriegelungsquelle DFC_ECBVlvOvrTemp" VAL_BLK 0x800241FE ValA_Wu16 688. DINH_FIdVerb 0.00 688. FORMAT "%2.0" NUMBER 2 /end CHARACTERISTIC
/begin CHARACTERISTIC DINH_FId.DFC_ECBVlvSCB_CA "DINH/Zugeordnete FId für Verriegelungsquelle DFC_ECBVlvSCB" VAL_BLK 0x80024202 ValA_Wu16 688. DINH_FIdVerb 0.00 688. FORMAT "%2.0" NUMBER 4 /end CHARACTERISTIC
/begin CHARACTERISTIC DINH_FId.DFC_ECBVlvSCG_CA "DINH/Zugeordnete FId für Verriegelungsquelle DFC_ECBVlvSCG" VAL_BLK 0x8002420A ValA_Wu16 688. DINH_FIdVerb 0.00 688. FORMAT "%2.0" NUMBER 4 /end CHARACTERISTIC
/begin CHARACTERISTIC DINH_FId.DFC_EMDmpOL_0_CA "DINH/Zugeordnete FId für Verriegelungsquelle DFC_EMDmpOL_0" VAL_BLK 0x80024212 ValA_Wu16 688. DINH_FIdVerb 0.00 688. FORMAT "%2.0" NUMBER 2 /end CHARACTERISTIC
/begin CHARACTERISTIC DINH_FId.DFC_EMDmpOL_1_CA "DINH/Zugeordnete FId für Verriegelungsquelle DFC_EMDmpOL_1" VAL_BLK 0x80024216 ValA_Wu16 688. DINH_FIdVerb 0.00 688. FORMAT "%2.0" NUMBER 2 /end CHARACTERISTIC
/begin CHARACTERISTIC DINH_FId.DFC_EMDmpOvrTemp_0_CA "DINH/Zugeordnete FId für Verriegelungsquelle DFC_EMDmpOvrTemp_0" VAL_BLK 0x8002421A ValA_Wu16 688. DINH_FIdVerb 0.00 688. FORMAT "%2.0" NUMBER 2 /end CHARACTERISTIC
/begin CHARACTERISTIC DINH_FId.DFC_EMDmpOvrTemp_1_CA "DINH/Zugeordnete FId für Verriegelungsquelle DFC_EMDmpOvrTemp_1" VAL_BLK 0x8002421E ValA_Wu16 688. DINH_FIdVerb 0.00 688. FORMAT "%2.0" NUMBER 2 /end CHARACTERISTIC
/begin CHARACTERISTIC DINH_FId.DFC_EMDmpSCB_0_CA "DINH/Zugeordnete FId für Verriegelungsquelle DFC_EMDmpSCB_0" VAL_BLK 0x80024222 ValA_Wu16 688. DINH_FIdVerb 0.00 688. FORMAT "%2.0" NUMBER 2 /end CHARACTERISTIC
/begin CHARACTERISTIC DINH_FId.DFC_EMDmpSCB_1_CA "DINH/Zugeordnete FId für Verriegelungsquelle DFC_EMDmpSCB_1" VAL_BLK 0x80024226 ValA_Wu16 688. DINH_FIdVerb 0.00 688. FORMAT "%2.0" NUMBER 2 /end CHARACTERISTIC
/begin CHARACTERISTIC DINH_FId.DFC_EMDmpSCG_0_CA "DINH/Zugeordnete FId für Verriegelungsquelle DFC_EMDmpSCG_0" VAL_BLK 0x8002422A ValA_Wu16 688. DINH_FIdVerb 0.00 688. FORMAT "%2.0" NUMBER 2 /end CHARACTERISTIC
/begin CHARACTERISTIC DINH_FId.DFC_EMDmpSCG_1_CA "DINH/Zugeordnete FId für Verriegelungsquelle DFC_EMDmpSCG_1" VAL_BLK 0x8002422E ValA_Wu16 688. DINH_FIdVerb 0.00 688. FORMAT "%2.0" NUMBER 2 /end CHARACTERISTIC
/begin CHARACTERISTIC DINH_FId.DFC_EngStAOL_CA "DINH/Zugeordnete FId für Verriegelungsquelle DFC_EngStAOL" VAL_BLK 0x80024232 ValA_Wu16 688. DINH_FIdVerb 0.00 688. FORMAT "%2.0" NUMBER 2 /end CHARACTERISTIC
/begin CHARACTERISTIC DINH_FId.DFC_EngStAOvrTemp_CA "DINH/Zugeordnete FId für Verriegelungsquelle DFC_EngStAOvrTemp" VAL_BLK 0x80024236 ValA_Wu16 688. DINH_FIdVerb 0.00 688. FORMAT "%2.0" NUMBER 2 /end CHARACTERISTIC
/begin CHARACTERISTIC DINH_FId.DFC_EngStASCB_CA "DINH/Zugeordnete FId für Verriegelungsquelle DFC_EngStASCB" VAL_BLK 0x8002423A ValA_Wu16 688. DINH_FIdVerb 0.00 688. FORMAT "%2.0" NUMBER 2 /end CHARACTERISTIC
/begin CHARACTERISTIC DINH_FId.DFC_EngStASCG_CA "DINH/Zugeordnete FId für Verriegelungsquelle DFC_EngStASCG" VAL_BLK 0x8002423E ValA_Wu16 688. DINH_FIdVerb 0.00 688. FORMAT "%2.0" NUMBER 2 /end CHARACTERISTIC
/begin CHARACTERISTIC DINH_FId.DFC_FanOL_CA "DINH/Zugeordnete FId für Verriegelungsquelle DFC_FanOL" VAL_BLK 0x80024242 ValA_Wu16 688. DINH_FIdVerb 0.00 688. FORMAT "%2.0" NUMBER 2 /end CHARACTERISTIC
/begin CHARACTERISTIC DINH_FId.DFC_FanOvrTemp_CA "DINH/Zugeordnete FId für Verriegelungsquelle DFC_FanOvrTemp" VAL_BLK 0x80024246 ValA_Wu16 688. DINH_FIdVerb 0.00 688. FORMAT "%2.0" NUMBER 2 /end CHARACTERISTIC
/begin CHARACTERISTIC DINH_FId.DFC_FanSCB_CA "DINH/Zugeordnete FId für Verriegelungsquelle DFC_FanSCB" VAL_BLK 0x8002424A ValA_Wu16 688. DINH_FIdVerb 0.00 688. FORMAT "%2.0" NUMBER 2 /end CHARACTERISTIC
/begin CHARACTERISTIC DINH_FId.DFC_FlFltHtOL_CA "DINH/Zugeordnete FId für Verriegelungsquelle DFC_FlFltHtOL" VAL_BLK 0x8002424E ValA_Wu16 688. DINH_FIdVerb 0.00 688. FORMAT "%2.0" NUMBER 2 /end CHARACTERISTIC
/begin CHARACTERISTIC DINH_FId.DFC_FlFltHtOvrTemp_CA "DINH/Zugeordnete FId für Verriegelungsquelle DFC_FlFltHtOvrTemp" VAL_BLK 0x80024252 ValA_Wu16 688. DINH_FIdVerb 0.00 688. FORMAT "%2.0" NUMBER 2 /end CHARACTERISTIC
/begin CHARACTERISTIC DINH_FId.DFC_FlFltHtSCB_CA "DINH/Zugeordnete FId für Verriegelungsquelle DFC_FlFltHtSCB" VAL_BLK 0x80024256 ValA_Wu16 688. DINH_FIdVerb 0.00 688. FORMAT "%2.0" NUMBER 2 /end CHARACTERISTIC
/begin CHARACTERISTIC DINH_FId.DFC_FlFltHtSCG_CA "DINH/Zugeordnete FId für Verriegelungsquelle DFC_FlFltHtSCG" VAL_BLK 0x8002425A ValA_Wu16 688. DINH_FIdVerb 0.00 688. FORMAT "%2.0" NUMBER 2 /end CHARACTERISTIC
/begin CHARACTERISTIC DINH_FId.DFC_LSUHtrMax_CA "DINH/Zugeordnete FId für Verriegelungsquelle DFC_LSUHtrMax" VAL_BLK 0x8002425E ValA_Wu16 688. DINH_FIdVerb 0.00 688. FORMAT "%2.0" NUMBER 13 /end CHARACTERISTIC
/begin CHARACTERISTIC DINH_FId.DFC_LSUHtrMin_CA "DINH/Zugeordnete FId für Verriegelungsquelle DFC_LSUHtrMin" VAL_BLK 0x80024278 ValA_Wu16 688. DINH_FIdVerb 0.00 688. FORMAT "%2.0" NUMBER 13 /end CHARACTERISTIC
/begin CHARACTERISTIC DINH_FId.DFC_LSUHtrNpl_CA "DINH/Zugeordnete FId für Verriegelungsquelle DFC_LSUHtrNpl" VAL_BLK 0x80024292 ValA_Wu16 688. DINH_FIdVerb 0.00 688. FORMAT "%2.0" NUMBER 13 /end CHARACTERISTIC
/begin CHARACTERISTIC DINH_FId.DFC_LSUHtrSig_CA "DINH/Zugeordnete FId für Verriegelungsquelle DFC_LSUHtrSig" VAL_BLK 0x800242AC ValA_Wu16 688. DINH_FIdVerb 0.00 688. FORMAT "%2.0" NUMBER 13 /end CHARACTERISTIC
/begin CHARACTERISTIC DINH_FId.DFC_LSUtExcMax_CA "DINH/Zugeordnete FId für Verriegelungsquelle DFC_LSUtExcMax" VAL_BLK 0x800242C6 ValA_Wu16 688. DINH_FIdVerb 0.00 688. FORMAT "%2.0" NUMBER 12 /end CHARACTERISTIC
/begin CHARACTERISTIC DINH_FId.DFC_LSUtExcMin_CA "DINH/Zugeordnete FId für Verriegelungsquelle DFC_LSUtExcMin" VAL_BLK 0x800242DE ValA_Wu16 688. DINH_FIdVerb 0.00 688. FORMAT "%2.0" NUMBER 12 /end CHARACTERISTIC
/begin CHARACTERISTIC DINH_FId.DFC_MeUnOL_CA "DINH/Zugeordnete FId für Verriegelungsquelle DFC_MeUnOL" VAL_BLK 0x800242F6 ValA_Wu16 688. DINH_FIdVerb 0.00 688. FORMAT "%2.0" NUMBER 12 /end CHARACTERISTIC
/begin CHARACTERISTIC DINH_FId.DFC_MeUnSCB_CA "DINH/Zugeordnete FId für Verriegelungsquelle DFC_MeUnSCB" VAL_BLK 0x8002430E ValA_Wu16 688. DINH_FIdVerb 0.00 688. FORMAT "%2.0" NUMBER 12 /end CHARACTERISTIC
/begin CHARACTERISTIC DINH_FId.DFC_MeUnSRCMax_CA "DINH/Zugeordnete FId für Verriegelungsquelle DFC_MeUnSRCMax" VAL_BLK 0x80024326 ValA_Wu16 688. DINH_FIdVerb 0.00 688. FORMAT "%2.0" NUMBER 4 /end CHARACTERISTIC
/begin CHARACTERISTIC DINH_FId.DFC_MeUnSRCMin_CA "DINH/Zugeordnete FId für Verriegelungsquelle DFC_MeUnSRCMin" VAL_BLK 0x8002432E ValA_Wu16 688. DINH_FIdVerb 0.00 688. FORMAT "%2.0" NUMBER 4 /end CHARACTERISTIC
/begin CHARACTERISTIC DINH_FId.DFC_PCVOL_CA "DINH/Zugeordnete FId für Verriegelungsquelle DFC_PCVOL" VAL_BLK 0x80024336 ValA_Wu16 688. DINH_FIdVerb 0.00 688. FORMAT "%2.0" NUMBER 9 /end CHARACTERISTIC
/begin CHARACTERISTIC DINH_FId.DFC_PCVSCB_CA "DINH/Zugeordnete FId für Verriegelungsquelle DFC_PCVSCB" VAL_BLK 0x80024348 ValA_Wu16 688. DINH_FIdVerb 0.00 688. FORMAT "%2.0" NUMBER 9 /end CHARACTERISTIC
/begin CHARACTERISTIC DINH_FId.DFC_PCVSRCMax_CA "DINH/Zugeordnete FId für Verriegelungsquelle DFC_PCVSRCMax" VAL_BLK 0x8002435A ValA_Wu16 688. DINH_FIdVerb 0.00 688. FORMAT "%2.0" NUMBER 3 /end CHARACTERISTIC
/begin CHARACTERISTIC DINH_FId.DFC_PCVSRCMin_CA "DINH/Zugeordnete FId für Verriegelungsquelle DFC_PCVSRCMin" VAL_BLK 0x80024360 ValA_Wu16 688. DINH_FIdVerb 0.00 688. FORMAT "%2.0" NUMBER 3 /end CHARACTERISTIC
/begin CHARACTERISTIC DINH_FId.DFC_RailPSRCMax_CA "DINH/Zugeordnete FId für Verriegelungsquelle DFC_RailPSRCMax" VAL_BLK 0x80024366 ValA_Wu16 688. DINH_FIdVerb 0.00 688. FORMAT "%2.0" NUMBER 14 /end CHARACTERISTIC
/begin CHARACTERISTIC DINH_FId.DFC_RailPSRCMin_CA "DINH/Zugeordnete FId für Verriegelungsquelle DFC_RailPSRCMin" VAL_BLK 0x80024382 ValA_Wu16 688. DINH_FIdVerb 0.00 688. FORMAT "%2.0" NUMBER 14 /end CHARACTERISTIC
/begin CHARACTERISTIC DINH_FId.DFC_ShtrOL_CA "DINH/Zugeordnete FId für Verriegelungsquelle DFC_ShtrOL" VAL_BLK 0x8002439E ValA_Wu16 688. DINH_FIdVerb 0.00 688. FORMAT "%2.0" NUMBER 2 /end CHARACTERISTIC
/begin CHARACTERISTIC DINH_FId.DFC_ShtrOvrTemp_CA "DINH/Zugeordnete FId für Verriegelungsquelle DFC_ShtrOvrTemp" VAL_BLK 0x800243A2 ValA_Wu16 688. DINH_FIdVerb 0.00 688. FORMAT "%2.0" NUMBER 2 /end CHARACTERISTIC
/begin CHARACTERISTIC DINH_FId.DFC_ShtrSCB_CA "DINH/Zugeordnete FId für Verriegelungsquelle DFC_ShtrSCB" VAL_BLK 0x800243A6 ValA_Wu16 688. DINH_FIdVerb 0.00 688. FORMAT "%2.0" NUMBER 2 /end CHARACTERISTIC
/begin CHARACTERISTIC DINH_FId.DFC_ShtrSCG_CA "DINH/Zugeordnete FId für Verriegelungsquelle DFC_ShtrSCG" VAL_BLK 0x800243AA ValA_Wu16 688. DINH_FIdVerb 0.00 688. FORMAT "%2.0" NUMBER 2 /end CHARACTERISTIC
/begin CHARACTERISTIC DINH_FId.DFC_StrtOL_CA "DINH/Zugeordnete FId für Verriegelungsquelle DFC_StrtOL" VAL_BLK 0x800243AE ValA_Wu16 688. DINH_FIdVerb 0.00 688. FORMAT "%2.0" NUMBER 2 /end CHARACTERISTIC
/begin CHARACTERISTIC DINH_FId.DFC_StrtOvrTemp_CA "DINH/Zugeordnete FId für Verriegelungsquelle DFC_StrtOvrTemp" VAL_BLK 0x800243B2 ValA_Wu16 688. DINH_FIdVerb 0.00 688. FORMAT "%2.0" NUMBER 2 /end CHARACTERISTIC
/begin CHARACTERISTIC DINH_FId.DFC_StrtSCB_CA "DINH/Zugeordnete FId für Verriegelungsquelle DFC_StrtSCB" VAL_BLK 0x800243B6 ValA_Wu16 688. DINH_FIdVerb 0.00 688. FORMAT "%2.0" NUMBER 2 /end CHARACTERISTIC
/begin CHARACTERISTIC DINH_FId.DFC_StrtSCG_CA "DINH/Zugeordnete FId für Verriegelungsquelle DFC_StrtSCG" VAL_BLK 0x800243BA ValA_Wu16 688. DINH_FIdVerb 0.00 688. FORMAT "%2.0" NUMBER 2 /end CHARACTERISTIC
/begin CHARACTERISTIC DINH_FId.DFC_ThrVlvOL_CA "DINH/Zugeordnete FId für Verriegelungsquelle DFC_ThrVlvOL" VAL_BLK 0x800243BE ValA_Wu16 688. DINH_FIdVerb 0.00 688. FORMAT "%2.0" NUMBER 8 /end CHARACTERISTIC
/begin CHARACTERISTIC DINH_FId.DFC_ThrVlvOvrTemp_CA "DINH/Zugeordnete FId für Verriegelungsquelle DFC_ThrVlvOvrTemp" VAL_BLK 0x800243CE ValA_Wu16 688. DINH_FIdVerb 0.00 688. FORMAT "%2.0" NUMBER 2 /end CHARACTERISTIC
/begin CHARACTERISTIC DINH_FId.DFC_ThrVlvSCB_CA "DINH/Zugeordnete FId für Verriegelungsquelle DFC_ThrVlvSCB" VAL_BLK 0x800243D2 ValA_Wu16 688. DINH_FIdVerb 0.00 688. FORMAT "%2.0" NUMBER 8 /end CHARACTERISTIC
/begin CHARACTERISTIC DINH_FId.DFC_TrbChOL_CA "DINH/Zugeordnete FId für Verriegelungsquelle DFC_TrbChOL" VAL_BLK 0x800243E2 ValA_Wu16 688. DINH_FIdVerb 0.00 688. FORMAT "%2.0" NUMBER 9 /end CHARACTERISTIC
/begin CHARACTERISTIC DINH_FId.DFC_TrbChOvrTemp_CA "DINH/Zugeordnete FId für Verriegelungsquelle DFC_TrbChOvrTemp" VAL_BLK 0x800243F4 ValA_Wu16 688. DINH_FIdVerb 0.00 688. FORMAT "%2.0" NUMBER 2 /end CHARACTERISTIC
/begin CHARACTERISTIC DINH_FId.DFC_TrbChSCB_CA "DINH/Zugeordnete FId für Verriegelungsquelle DFC_TrbChSCB" VAL_BLK 0x800243F8 ValA_Wu16 688. DINH_FIdVerb 0.00 688. FORMAT "%2.0" NUMBER 8 /end CHARACTERISTIC
/begin CHARACTERISTIC DINH_FId.DFC_UDosVlvOL_CA "DINH/Zugeordnete FId für Verriegelungsquelle DFC_UDosVlvOL" VAL_BLK 0x80024408 ValA_Wu16 688. DINH_FIdVerb 0.00 688. FORMAT "%2.0" NUMBER 12 /end CHARACTERISTIC
/begin CHARACTERISTIC DINH_FId.DFC_UDosVlvOvrTemp_CA "DINH/Zugeordnete FId für Verriegelungsquelle DFC_UDosVlvOvrTemp" VAL_BLK 0x80024420 ValA_Wu16 688. DINH_FIdVerb 0.00 688. FORMAT "%2.0" NUMBER 2 /end CHARACTERISTIC
/begin CHARACTERISTIC DINH_FId.DFC_UDosVlvSCB_CA "DINH/Zugeordnete FId für Verriegelungsquelle DFC_UDosVlvSCB" VAL_BLK 0x80024424 ValA_Wu16 688. DINH_FIdVerb 0.00 688. FORMAT "%2.0" NUMBER 12 /end CHARACTERISTIC
/begin CHARACTERISTIC DINH_FId.DFC_UDosVlvSCG_CA "DINH/Zugeordnete FId für Verriegelungsquelle DFC_UDosVlvSCG" VAL_BLK 0x8002443C ValA_Wu16 688. DINH_FIdVerb 0.00 688. FORMAT "%2.0" NUMBER 10 /end CHARACTERISTIC
/begin CHARACTERISTIC DINH_FId.DFC_UPmpMotOL_CA "DINH/Zugeordnete FId für Verriegelungsquelle DFC_UPmpMotOL" VAL_BLK 0x80024450 ValA_Wu16 688. DINH_FIdVerb 0.00 688. FORMAT "%2.0" NUMBER 11 /end CHARACTERISTIC
/begin CHARACTERISTIC DINH_FId.DFC_UPmpMotOvrTemp_CA "DINH/Zugeordnete FId für Verriegelungsquelle DFC_UPmpMotOvrTemp" VAL_BLK 0x80024466 ValA_Wu16 688. DINH_FIdVerb 0.00 688. FORMAT "%2.0" NUMBER 2 /end CHARACTERISTIC
/begin CHARACTERISTIC DINH_FId.DFC_UPmpMotSCB_CA "DINH/Zugeordnete FId für Verriegelungsquelle DFC_UPmpMotSCB" VAL_BLK 0x8002446A ValA_Wu16 688. DINH_FIdVerb 0.00 688. FORMAT "%2.0" NUMBER 12 /end CHARACTERISTIC
/begin CHARACTERISTIC DINH_FId.DFC_UPmpMotSCG_CA "DINH/Zugeordnete FId für Verriegelungsquelle DFC_UPmpMotSCG" VAL_BLK 0x80024482 ValA_Wu16 688. DINH_FIdVerb 0.00 688. FORMAT "%2.0" NUMBER 3 /end CHARACTERISTIC
/begin CHARACTERISTIC DINH_FId.DFC_WaHtElOL_CA "DINH/Zugeordnete FId für Verriegelungsquelle DFC_WaHtElOL" VAL_BLK 0x80024488 ValA_Wu16 688. DINH_FIdVerb 0.00 688. FORMAT "%2.0" NUMBER 2 /end CHARACTERISTIC
/begin CHARACTERISTIC DINH_FId.DFC_WaHtElOvrTemp_CA "DINH/Zugeordnete FId für Verriegelungsquelle DFC_WaHtElOvrTemp" VAL_BLK 0x8002448C ValA_Wu16 688. DINH_FIdVerb 0.00 688. FORMAT "%2.0" NUMBER 2 /end CHARACTERISTIC
/begin CHARACTERISTIC DINH_FId.DFC_WaHtElSCB_CA "DINH/Zugeordnete FId für Verriegelungsquelle DFC_WaHtElSCB" VAL_BLK 0x80024490 ValA_Wu16 688. DINH_FIdVerb 0.00 688. FORMAT "%2.0" NUMBER 2 /end CHARACTERISTIC
/begin CHARACTERISTIC DINH_FId.DFC_IVActrUChSRCMax_CA "DINH/Zugeordnete FId für Verriegelungsquelle DFC_IVActrUChSRCMax" VAL_BLK 0x80024494 ValA_Wu16 688. DINH_FIdVerb 0.00 688. FORMAT "%2.0" NUMBER 2 /end CHARACTERISTIC
/begin CHARACTERISTIC DINH_FId.DFC_IVActrUChSRCMin_CA "DINH/Zugeordnete FId für Verriegelungsquelle DFC_IVActrUChSRCMin" VAL_BLK 0x80024498 ValA_Wu16 688. DINH_FIdVerb 0.00 688. FORMAT "%2.0" NUMBER 2 /end CHARACTERISTIC
/begin CHARACTERISTIC DINH_FId.DFC_IVActrVltgSRCMax_CA "DINH/Zugeordnete FId für Verriegelungsquelle DFC_IVActrVltgSRCMax" VAL_BLK 0x8002449C ValA_Wu16 688. DINH_FIdVerb 0.00 688. FORMAT "%2.0" NUMBER 2 /end CHARACTERISTIC
/begin CHARACTERISTIC DINH_FId.DFC_IVActrVltgSRCMin_CA "DINH/Zugeordnete FId für Verriegelungsquelle DFC_IVActrVltgSRCMin" VAL_BLK 0x800244A0 ValA_Wu16 688. DINH_FIdVerb 0.00 688. FORMAT "%2.0" NUMBER 2 /end CHARACTERISTIC
/begin CHARACTERISTIC DINH_FId.DFC_IVDiaTunDet_CA "DINH/Zugeordnete FId für Verriegelungsquelle DFC_IVDiaTunDet" VAL_BLK 0x800244A4 ValA_Wu16 688. DINH_FIdVerb 0.00 688. FORMAT "%2.0" NUMBER 2 /end CHARACTERISTIC
/begin CHARACTERISTIC DINH_FId.DFC_IVPSplyStopDCDC_CA "DINH/Zugeordnete FId für Verriegelungsquelle DFC_IVPSplyStopDCDC" VAL_BLK 0x800244A8 ValA_Wu16 688. DINH_FIdVerb 0.00 688. FORMAT "%2.0" NUMBER 2 /end CHARACTERISTIC
/begin CHARACTERISTIC DINH_FId.DFC_IVPSplyVltgSRCMax_CA "DINH/Zugeordnete FId für Verriegelungsquelle DFC_IVPSplyVltgSRCMax" VAL_BLK 0x800244AC ValA_Wu16 688. DINH_FIdVerb 0.00 688. FORMAT "%2.0" NUMBER 2 /end CHARACTERISTIC
/begin CHARACTERISTIC DINH_FId.DFC_IVPSplyVltgSRCMin_CA "DINH/Zugeordnete FId für Verriegelungsquelle DFC_IVPSplyVltgSRCMin" VAL_BLK 0x800244B0 ValA_Wu16 688. DINH_FIdVerb 0.00 688. FORMAT "%2.0" NUMBER 2 /end CHARACTERISTIC
/begin CHARACTERISTIC DINH_FId.DFC_SCREtaErr_CA "DINH/Zugeordnete FId für Verriegelungsquelle DFC_SCREtaErr" VAL_BLK 0x800244B4 ValA_Wu16 688. DINH_FIdVerb 0.00 688. FORMAT "%2.0" NUMBER 2 /end CHARACTERISTIC
/begin CHARACTERISTIC DINH_FId.DFC_SCREtaErr1_CA "DINH/Zugeordnete FId für Verriegelungsquelle DFC_SCREtaErr1" VAL_BLK 0x800244B8 ValA_Wu16 688. DINH_FIdVerb 0.00 688. FORMAT "%2.0" NUMBER 2 /end CHARACTERISTIC
/begin CHARACTERISTIC DINH_FId.DFC_SCREtaErr2_CA "DINH/Zugeordnete FId für Verriegelungsquelle DFC_SCREtaErr2" VAL_BLK 0x800244BC ValA_Wu16 688. DINH_FIdVerb 0.00 688. FORMAT "%2.0" NUMBER 2 /end CHARACTERISTIC
/begin CHARACTERISTIC DINH_FId.DFC_SCRMonMetCtlPresErr_CA "DINH/Zugeordnete FId für Verriegelungsquelle DFC_SCRMonMetCtlPresErr" VAL_BLK 0x800244C0 ValA_Wu16 688. DINH_FIdVerb 0.00 688. FORMAT "%2.0" NUMBER 2 /end CHARACTERISTIC
/begin CHARACTERISTIC DINH_FId.DFC_SCRMonPresBuildUpErr_CA "DINH/Zugeordnete FId für Verriegelungsquelle DFC_SCRMonPresBuildUpErr" VAL_BLK 0x800244C4 ValA_Wu16 688. DINH_FIdVerb 0.00 688. FORMAT "%2.0" NUMBER 2 /end CHARACTERISTIC
/begin CHARACTERISTIC DINH_FId.DFC_SCRMonPresRdcErr_CA "DINH/Zugeordnete FId für Verriegelungsquelle DFC_SCRMonPresRdcErr" VAL_BLK 0x800244C8 ValA_Wu16 688. DINH_FIdVerb 0.00 688. FORMAT "%2.0" NUMBER 4 /end CHARACTERISTIC
/begin CHARACTERISTIC DINH_FId.DFC_AFSOffsDrftMax_CA "DINH/Zugeordnete FId für Verriegelungsquelle DFC_AFSOffsDrftMax" VAL_BLK 0x800244D0 ValA_Wu16 688. DINH_FIdVerb 0.00 688. FORMAT "%2.0" NUMBER 19 /end CHARACTERISTIC
/begin CHARACTERISTIC DINH_FId.DFC_AFSOffsDrftMin_CA "DINH/Zugeordnete FId für Verriegelungsquelle DFC_AFSOffsDrftMin" VAL_BLK 0x800244F6 ValA_Wu16 688. DINH_FIdVerb 0.00 688. FORMAT "%2.0" NUMBER 18 /end CHARACTERISTIC
/begin CHARACTERISTIC DINH_FId.DFC_AFSSRCCorMax_CA "DINH/Zugeordnete FId für Verriegelungsquelle DFC_AFSSRCCorMax" VAL_BLK 0x8002451A ValA_Wu16 688. DINH_FIdVerb 0.00 688. FORMAT "%2.0" NUMBER 10 /end CHARACTERISTIC
/begin CHARACTERISTIC DINH_FId.DFC_AFSSRCCorMin_CA "DINH/Zugeordnete FId für Verriegelungsquelle DFC_AFSSRCCorMin" VAL_BLK 0x8002452E ValA_Wu16 688. DINH_FIdVerb 0.00 688. FORMAT "%2.0" NUMBER 10 /end CHARACTERISTIC
/begin CHARACTERISTIC DINH_FId.DFC_AFSSRCRawMax_CA "DINH/Zugeordnete FId für Verriegelungsquelle DFC_AFSSRCRawMax" VAL_BLK 0x80024542 ValA_Wu16 688. DINH_FIdVerb 0.00 688. FORMAT "%2.0" NUMBER 10 /end CHARACTERISTIC
/begin CHARACTERISTIC DINH_FId.DFC_AFSSRCRawMin_CA "DINH/Zugeordnete FId für Verriegelungsquelle DFC_AFSSRCRawMin" VAL_BLK 0x80024556 ValA_Wu16 688. DINH_FIdVerb 0.00 688. FORMAT "%2.0" NUMBER 10 /end CHARACTERISTIC
/begin CHARACTERISTIC DINH_FId.DFC_AFSSetyDrftMax_CA "DINH/Zugeordnete FId für Verriegelungsquelle DFC_AFSSetyDrftMax" VAL_BLK 0x8002456A ValA_Wu16 688. DINH_FIdVerb 0.00 688. FORMAT "%2.0" NUMBER 19 /end CHARACTERISTIC
/begin CHARACTERISTIC DINH_FId.DFC_AFSSetyDrftMin_CA "DINH/Zugeordnete FId für Verriegelungsquelle DFC_AFSSetyDrftMin" VAL_BLK 0x80024590 ValA_Wu16 688. DINH_FIdVerb 0.00 688. FORMAT "%2.0" NUMBER 19 /end CHARACTERISTIC
/begin CHARACTERISTIC DINH_FId.DFC_AirCSwtNpl_CA "DINH/Zugeordnete FId für Verriegelungsquelle DFC_AirCSwtNpl" VAL_BLK 0x800245B6 ValA_Wu16 688. DINH_FIdVerb 0.00 688. FORMAT "%2.0" NUMBER 3 /end CHARACTERISTIC
/begin CHARACTERISTIC DINH_FId.DFC_AirCSwtSig_CA "DINH/Zugeordnete FId für Verriegelungsquelle DFC_AirCSwtSig" VAL_BLK 0x800245BC ValA_Wu16 688. DINH_FIdVerb 0.00 688. FORMAT "%2.0" NUMBER 3 /end CHARACTERISTIC
/begin CHARACTERISTIC DINH_FId.DFC_BattUSRCMax_CA "DINH/Zugeordnete FId für Verriegelungsquelle DFC_BattUSRCMax" VAL_BLK 0x800245C2 ValA_Wu16 688. DINH_FIdVerb 0.00 688. FORMAT "%2.0" NUMBER 7 /end CHARACTERISTIC
/begin CHARACTERISTIC DINH_FId.DFC_BattUSRCMin_CA "DINH/Zugeordnete FId für Verriegelungsquelle DFC_BattUSRCMin" VAL_BLK 0x800245D0 ValA_Wu16 688. DINH_FIdVerb 0.00 688. FORMAT "%2.0" NUMBER 7 /end CHARACTERISTIC
/begin CHARACTERISTIC DINH_FId.DFC_BrkNpl_CA "DINH/Zugeordnete FId für Verriegelungsquelle DFC_BrkNpl" VAL_BLK 0x800245DE ValA_Wu16 688. DINH_FIdVerb 0.00 688. FORMAT "%2.0" NUMBER 18 /end CHARACTERISTIC
/begin CHARACTERISTIC DINH_FId.DFC_BrkPSRCMax_CA "DINH/Zugeordnete FId für Verriegelungsquelle DFC_BrkPSRCMax" VAL_BLK 0x80024602 ValA_Wu16 688. DINH_FIdVerb 0.00 688. FORMAT "%2.0" NUMBER 6 /end CHARACTERISTIC
/begin CHARACTERISTIC DINH_FId.DFC_BrkPSRCMin_CA "DINH/Zugeordnete FId für Verriegelungsquelle DFC_BrkPSRCMin" VAL_BLK 0x8002460E ValA_Wu16 688. DINH_FIdVerb 0.00 688. FORMAT "%2.0" NUMBER 6 /end CHARACTERISTIC
/begin CHARACTERISTIC DINH_FId.DFC_CEngDsTSRCMax_CA "DINH/Zugeordnete FId für Verriegelungsquelle DFC_CEngDsTSRCMax" VAL_BLK 0x8002461A ValA_Wu16 688. DINH_FIdVerb 0.00 688. FORMAT "%2.0" NUMBER 22 /end CHARACTERISTIC
/begin CHARACTERISTIC DINH_FId.DFC_CEngDsTSRCMin_CA "DINH/Zugeordnete FId für Verriegelungsquelle DFC_CEngDsTSRCMin" VAL_BLK 0x80024646 ValA_Wu16 688. DINH_FIdVerb 0.00 688. FORMAT "%2.0" NUMBER 22 /end CHARACTERISTIC
/begin CHARACTERISTIC DINH_FId.DFC_CrCUIDet_CA "DINH/Zugeordnete FId für Verriegelungsquelle DFC_CrCUIDet" VAL_BLK 0x80024672 ValA_Wu16 688. DINH_FIdVerb 0.00 688. FORMAT "%2.0" NUMBER 2 /end CHARACTERISTIC
/begin CHARACTERISTIC DINH_FId.DFC_ECBVlvSRCMax_CA "DINH/Zugeordnete FId für Verriegelungsquelle DFC_ECBVlvSRCMax" VAL_BLK 0x80024676 ValA_Wu16 688. DINH_FIdVerb 0.00 688. FORMAT "%2.0" NUMBER 4 /end CHARACTERISTIC
/begin CHARACTERISTIC DINH_FId.DFC_ECBVlvSRCMin_CA "DINH/Zugeordnete FId für Verriegelungsquelle DFC_ECBVlvSRCMin" VAL_BLK 0x8002467E ValA_Wu16 688. DINH_FIdVerb 0.00 688. FORMAT "%2.0" NUMBER 4 /end CHARACTERISTIC
/begin CHARACTERISTIC DINH_FId.DFC_ECUOvrTemp_CA "DINH/Zugeordnete FId für Verriegelungsquelle DFC_ECUOvrTemp" VAL_BLK 0x80024686 ValA_Wu16 688. DINH_FIdVerb 0.00 688. FORMAT "%2.0" NUMBER 2 /end CHARACTERISTIC
/begin CHARACTERISTIC DINH_FId.DFC_EGRVlvGovDvtMax_CA "DINH/Zugeordnete FId für Verriegelungsquelle DFC_EGRVlvGovDvtMax" VAL_BLK 0x8002468A ValA_Wu16 688. DINH_FIdVerb 0.00 688. FORMAT "%2.0" NUMBER 2 /end CHARACTERISTIC
/begin CHARACTERISTIC DINH_FId.DFC_EGRVlvGovDvtMin_CA "DINH/Zugeordnete FId für Verriegelungsquelle DFC_EGRVlvGovDvtMin" VAL_BLK 0x8002468E ValA_Wu16 688. DINH_FIdVerb 0.00 688. FORMAT "%2.0" NUMBER 2 /end CHARACTERISTIC
/begin CHARACTERISTIC DINH_FId.DFC_EGRVlvHBrgOpnLd_CA "DINH/Zugeordnete FId für Verriegelungsquelle DFC_EGRVlvHBrgOpnLd" VAL_BLK 0x80024692 ValA_Wu16 688. DINH_FIdVerb 0.00 688. FORMAT "%2.0" NUMBER 2 /end CHARACTERISTIC
/begin CHARACTERISTIC DINH_FId.DFC_EGRVlvHBrgOvrCurr_CA "DINH/Zugeordnete FId für Verriegelungsquelle DFC_EGRVlvHBrgOvrCurr" VAL_BLK 0x80024696 ValA_Wu16 688. DINH_FIdVerb 0.00 688. FORMAT "%2.0" NUMBER 2 /end CHARACTERISTIC
/begin CHARACTERISTIC DINH_FId.DFC_EGRVlvHBrgOvrTemp_CA "DINH/Zugeordnete FId für Verriegelungsquelle DFC_EGRVlvHBrgOvrTemp" VAL_BLK 0x8002469A ValA_Wu16 688. DINH_FIdVerb 0.00 688. FORMAT "%2.0" NUMBER 2 /end CHARACTERISTIC
/begin CHARACTERISTIC DINH_FId.DFC_EGRVlvHBrgShCirBatt1_CA "DINH/Zugeordnete FId für Verriegelungsquelle DFC_EGRVlvHBrgShCirBatt1" VAL_BLK 0x8002469E ValA_Wu16 688. DINH_FIdVerb 0.00 688. FORMAT "%2.0" NUMBER 2 /end CHARACTERISTIC
/begin CHARACTERISTIC DINH_FId.DFC_EGRVlvHBrgShCirBatt2_CA "DINH/Zugeordnete FId für Verriegelungsquelle DFC_EGRVlvHBrgShCirBatt2" VAL_BLK 0x800246A2 ValA_Wu16 688. DINH_FIdVerb 0.00 688. FORMAT "%2.0" NUMBER 2 /end CHARACTERISTIC
/begin CHARACTERISTIC DINH_FId.DFC_EGRVlvHBrgShCirGnd1_CA "DINH/Zugeordnete FId für Verriegelungsquelle DFC_EGRVlvHBrgShCirGnd1" VAL_BLK 0x800246A6 ValA_Wu16 688. DINH_FIdVerb 0.00 688. FORMAT "%2.0" NUMBER 2 /end CHARACTERISTIC
/begin CHARACTERISTIC DINH_FId.DFC_EGRVlvHBrgShCirGnd2_CA "DINH/Zugeordnete FId für Verriegelungsquelle DFC_EGRVlvHBrgShCirGnd2" VAL_BLK 0x800246AA ValA_Wu16 688. DINH_FIdVerb 0.00 688. FORMAT "%2.0" NUMBER 2 /end CHARACTERISTIC
/begin CHARACTERISTIC DINH_FId.DFC_EGRVlvHBrgShCirOvrLd_CA "DINH/Zugeordnete FId für Verriegelungsquelle DFC_EGRVlvHBrgShCirOvrLd" VAL_BLK 0x800246AE ValA_Wu16 688. DINH_FIdVerb 0.00 688. FORMAT "%2.0" NUMBER 2 /end CHARACTERISTIC
/begin CHARACTERISTIC DINH_FId.DFC_EGRVlvHBrgTempOvrCurr_CA "DINH/Zugeordnete FId für Verriegelungsquelle DFC_EGRVlvHBrgTempOvrCurr" VAL_BLK 0x800246B2 ValA_Wu16 688. DINH_FIdVerb 0.00 688. FORMAT "%2.0" NUMBER 2 /end CHARACTERISTIC
/begin CHARACTERISTIC DINH_FId.DFC_EGRVlvHBrgUndrVltg_CA "DINH/Zugeordnete FId für Verriegelungsquelle DFC_EGRVlvHBrgUndrVltg" VAL_BLK 0x800246B6 ValA_Wu16 688. DINH_FIdVerb 0.00 688. FORMAT "%2.0" NUMBER 2 /end CHARACTERISTIC
/begin CHARACTERISTIC DINH_FId.DFC_EGRVlvLPGovDvtMax_CA "DINH/Zugeordnete FId für Verriegelungsquelle DFC_EGRVlvLPGovDvtMax" VAL_BLK 0x800246BA ValA_Wu16 688. DINH_FIdVerb 0.00 688. FORMAT "%2.0" NUMBER 2 /end CHARACTERISTIC
/begin CHARACTERISTIC DINH_FId.DFC_EGRVlvLPGovDvtMin_CA "DINH/Zugeordnete FId für Verriegelungsquelle DFC_EGRVlvLPGovDvtMin" VAL_BLK 0x800246BE ValA_Wu16 688. DINH_FIdVerb 0.00 688. FORMAT "%2.0" NUMBER 2 /end CHARACTERISTIC
/begin CHARACTERISTIC DINH_FId.DFC_EGRVlvLPHBrgOpnLd_CA "DINH/Zugeordnete FId für Verriegelungsquelle DFC_EGRVlvLPHBrgOpnLd" VAL_BLK 0x800246C2 ValA_Wu16 688. DINH_FIdVerb 0.00 688. FORMAT "%2.0" NUMBER 2 /end CHARACTERISTIC
/begin CHARACTERISTIC DINH_FId.DFC_EGRVlvLPHBrgOvrCurr_CA "DINH/Zugeordnete FId für Verriegelungsquelle DFC_EGRVlvLPHBrgOvrCurr" VAL_BLK 0x800246C6 ValA_Wu16 688. DINH_FIdVerb 0.00 688. FORMAT "%2.0" NUMBER 2 /end CHARACTERISTIC
/begin CHARACTERISTIC DINH_FId.DFC_EGRVlvLPHBrgOvrTemp_CA "DINH/Zugeordnete FId für Verriegelungsquelle DFC_EGRVlvLPHBrgOvrTemp" VAL_BLK 0x800246CA ValA_Wu16 688. DINH_FIdVerb 0.00 688. FORMAT "%2.0" NUMBER 2 /end CHARACTERISTIC
/begin CHARACTERISTIC DINH_FId.DFC_EGRVlvLPHBrgShCirBatt1_CA "DINH/Zugeordnete FId für Verriegelungsquelle DFC_EGRVlvLPHBrgShCirBatt1" VAL_BLK 0x800246CE ValA_Wu16 688. DINH_FIdVerb 0.00 688. FORMAT "%2.0" NUMBER 2 /end CHARACTERISTIC
/begin CHARACTERISTIC DINH_FId.DFC_EGRVlvLPHBrgShCirBatt2_CA "DINH/Zugeordnete FId für Verriegelungsquelle DFC_EGRVlvLPHBrgShCirBatt2" VAL_BLK 0x800246D2 ValA_Wu16 688. DINH_FIdVerb 0.00 688. FORMAT "%2.0" NUMBER 2 /end CHARACTERISTIC
/begin CHARACTERISTIC DINH_FId.DFC_EGRVlvLPHBrgShCirGnd1_CA "DINH/Zugeordnete FId für Verriegelungsquelle DFC_EGRVlvLPHBrgShCirGnd1" VAL_BLK 0x800246D6 ValA_Wu16 688. DINH_FIdVerb 0.00 688. FORMAT "%2.0" NUMBER 2 /end CHARACTERISTIC
/begin CHARACTERISTIC DINH_FId.DFC_EGRVlvLPHBrgShCirGnd2_CA "DINH/Zugeordnete FId für Verriegelungsquelle DFC_EGRVlvLPHBrgShCirGnd2" VAL_BLK 0x800246DA ValA_Wu16 688. DINH_FIdVerb 0.00 688. FORMAT "%2.0" NUMBER 2 /end CHARACTERISTIC
/begin CHARACTERISTIC DINH_FId.DFC_EGRVlvLPHBrgShCirOvrLd_CA "DINH/Zugeordnete FId für Verriegelungsquelle DFC_EGRVlvLPHBrgShCirOvrLd" VAL_BLK 0x800246DE ValA_Wu16 688. DINH_FIdVerb 0.00 688. FORMAT "%2.0" NUMBER 2 /end CHARACTERISTIC
/begin CHARACTERISTIC DINH_FId.DFC_EGRVlvLPHBrgTempOvrCurr_CA "DINH/Zugeordnete FId für Verriegelungsquelle DFC_EGRVlvLPHBrgTempOvrCurr" VAL_BLK 0x800246E2 ValA_Wu16 688. DINH_FIdVerb 0.00 688. FORMAT "%2.0" NUMBER 2 /end CHARACTERISTIC
/begin CHARACTERISTIC DINH_FId.DFC_EGRVlvLPHBrgUndrVltg_CA "DINH/Zugeordnete FId für Verriegelungsquelle DFC_EGRVlvLPHBrgUndrVltg" VAL_BLK 0x800246E6 ValA_Wu16 688. DINH_FIdVerb 0.00 688. FORMAT "%2.0" NUMBER 2 /end CHARACTERISTIC
/begin CHARACTERISTIC DINH_FId.DFC_EGRVlvLPOL_CA "DINH/Zugeordnete FId für Verriegelungsquelle DFC_EGRVlvLPOL" VAL_BLK 0x800246EA ValA_Wu16 688. DINH_FIdVerb 0.00 688. FORMAT "%2.0" NUMBER 5 /end CHARACTERISTIC
/begin CHARACTERISTIC DINH_FId.DFC_EGRVlvLPSCB_CA "DINH/Zugeordnete FId für Verriegelungsquelle DFC_EGRVlvLPSCB" VAL_BLK 0x800246F4 ValA_Wu16 688. DINH_FIdVerb 0.00 688. FORMAT "%2.0" NUMBER 5 /end CHARACTERISTIC
/begin CHARACTERISTIC DINH_FId.DFC_EGRVlvLPSCG_CA "DINH/Zugeordnete FId für Verriegelungsquelle DFC_EGRVlvLPSCG" VAL_BLK 0x800246FE ValA_Wu16 688. DINH_FIdVerb 0.00 688. FORMAT "%2.0" NUMBER 5 /end CHARACTERISTIC
/begin CHARACTERISTIC DINH_FId.DFC_EGRVlvLPSRCMax_CA "DINH/Zugeordnete FId für Verriegelungsquelle DFC_EGRVlvLPSRCMax" VAL_BLK 0x80024708 ValA_Wu16 688. DINH_FIdVerb 0.00 688. FORMAT "%2.0" NUMBER 6 /end CHARACTERISTIC
/begin CHARACTERISTIC DINH_FId.DFC_EGRVlvLPSRCMin_CA "DINH/Zugeordnete FId für Verriegelungsquelle DFC_EGRVlvLPSRCMin" VAL_BLK 0x80024714 ValA_Wu16 688. DINH_FIdVerb 0.00 688. FORMAT "%2.0" NUMBER 6 /end CHARACTERISTIC
/begin CHARACTERISTIC DINH_FId.DFC_EGRVlvOL_CA "DINH/Zugeordnete FId für Verriegelungsquelle DFC_EGRVlvOL" VAL_BLK 0x80024720 ValA_Wu16 688. DINH_FIdVerb 0.00 688. FORMAT "%2.0" NUMBER 10 /end CHARACTERISTIC
/begin CHARACTERISTIC DINH_FId.DFC_EGRVlvSCB_CA "DINH/Zugeordnete FId für Verriegelungsquelle DFC_EGRVlvSCB" VAL_BLK 0x80024734 ValA_Wu16 688. DINH_FIdVerb 0.00 688. FORMAT "%2.0" NUMBER 11 /end CHARACTERISTIC
/begin CHARACTERISTIC DINH_FId.DFC_EGRVlvSCG_CA "DINH/Zugeordnete FId für Verriegelungsquelle DFC_EGRVlvSCG" VAL_BLK 0x8002474A ValA_Wu16 688. DINH_FIdVerb 0.00 688. FORMAT "%2.0" NUMBER 14 /end CHARACTERISTIC
/begin CHARACTERISTIC DINH_FId.DFC_EGRVlvSRCMax_CA "DINH/Zugeordnete FId für Verriegelungsquelle DFC_EGRVlvSRCMax" VAL_BLK 0x80024766 ValA_Wu16 688. DINH_FIdVerb 0.00 688. FORMAT "%2.0" NUMBER 6 /end CHARACTERISTIC
/begin CHARACTERISTIC DINH_FId.DFC_EGRVlvSRCMin_CA "DINH/Zugeordnete FId für Verriegelungsquelle DFC_EGRVlvSRCMin" VAL_BLK 0x80024772 ValA_Wu16 688. DINH_FIdVerb 0.00 688. FORMAT "%2.0" NUMBER 6 /end CHARACTERISTIC
/begin CHARACTERISTIC DINH_FId.DFC_EngPrtOvrSpd_CA "DINH/Zugeordnete FId für Verriegelungsquelle DFC_EngPrtOvrSpd" VAL_BLK 0x8002477E ValA_Wu16 688. DINH_FIdVerb 0.00 688. FORMAT "%2.0" NUMBER 2 /end CHARACTERISTIC
/begin CHARACTERISTIC DINH_FId.DFC_EngSpdOL_CA "DINH/Zugeordnete FId für Verriegelungsquelle DFC_EngSpdOL" VAL_BLK 0x80024782 ValA_Wu16 688. DINH_FIdVerb 0.00 688. FORMAT "%2.0" NUMBER 2 /end CHARACTERISTIC
/begin CHARACTERISTIC DINH_FId.DFC_EngSpdSCB_CA "DINH/Zugeordnete FId für Verriegelungsquelle DFC_EngSpdSCB" VAL_BLK 0x80024786 ValA_Wu16 688. DINH_FIdVerb 0.00 688. FORMAT "%2.0" NUMBER 2 /end CHARACTERISTIC
/begin CHARACTERISTIC DINH_FId.DFC_EngSpdSCG_CA "DINH/Zugeordnete FId für Verriegelungsquelle DFC_EngSpdSCG" VAL_BLK 0x8002478A ValA_Wu16 688. DINH_FIdVerb 0.00 688. FORMAT "%2.0" NUMBER 2 /end CHARACTERISTIC
/begin CHARACTERISTIC DINH_FId.DFC_EnhSRCMaxPPFltDiff_CA "DINH/Zugeordnete FId für Verriegelungsquelle DFC_EnhSRCMaxPPFltDiff" VAL_BLK 0x8002478E ValA_Wu16 688. DINH_FIdVerb 0.00 688. FORMAT "%2.0" NUMBER 8 /end CHARACTERISTIC
/begin CHARACTERISTIC DINH_FId.DFC_EnhSRCMaxT1ExhTMon_CA "DINH/Zugeordnete FId für Verriegelungsquelle DFC_EnhSRCMaxT1ExhTMon" VAL_BLK 0x8002479E ValA_Wu16 688. DINH_FIdVerb 0.00 688. FORMAT "%2.0" NUMBER 10 /end CHARACTERISTIC
/begin CHARACTERISTIC DINH_FId.DFC_EnhSRCMaxT2ExhTMon_CA "DINH/Zugeordnete FId für Verriegelungsquelle DFC_EnhSRCMaxT2ExhTMon" VAL_BLK 0x800247B2 ValA_Wu16 688. DINH_FIdVerb 0.00 688. FORMAT "%2.0" NUMBER 10 /end CHARACTERISTIC
/begin CHARACTERISTIC DINH_FId.DFC_EnhSRCMaxT3ExhTMon_CA "DINH/Zugeordnete FId für Verriegelungsquelle DFC_EnhSRCMaxT3ExhTMon" VAL_BLK 0x800247C6 ValA_Wu16 688. DINH_FIdVerb 0.00 688. FORMAT "%2.0" NUMBER 2 /end CHARACTERISTIC
/begin CHARACTERISTIC DINH_FId.DFC_EnhSRCMinPPFltDiff_CA "DINH/Zugeordnete FId für Verriegelungsquelle DFC_EnhSRCMinPPFltDiff" VAL_BLK 0x800247CA ValA_Wu16 688. DINH_FIdVerb 0.00 688. FORMAT "%2.0" NUMBER 8 /end CHARACTERISTIC
/begin CHARACTERISTIC DINH_FId.DFC_EnhSRCMinT1ExhTMon_CA "DINH/Zugeordnete FId für Verriegelungsquelle DFC_EnhSRCMinT1ExhTMon" VAL_BLK 0x800247DA ValA_Wu16 688. DINH_FIdVerb 0.00 688. FORMAT "%2.0" NUMBER 10 /end CHARACTERISTIC
/begin CHARACTERISTIC DINH_FId.DFC_EnhSRCMinT2ExhTMon_CA "DINH/Zugeordnete FId für Verriegelungsquelle DFC_EnhSRCMinT2ExhTMon" VAL_BLK 0x800247EE ValA_Wu16 688. DINH_FIdVerb 0.00 688. FORMAT "%2.0" NUMBER 10 /end CHARACTERISTIC
/begin CHARACTERISTIC DINH_FId.DFC_EnhSRCMinT3ExhTMon_CA "DINH/Zugeordnete FId für Verriegelungsquelle DFC_EnhSRCMinT3ExhTMon" VAL_BLK 0x80024802 ValA_Wu16 688. DINH_FIdVerb 0.00 688. FORMAT "%2.0" NUMBER 2 /end CHARACTERISTIC
/begin CHARACTERISTIC DINH_FId.DFC_EnvPSRCMax_CA "DINH/Zugeordnete FId für Verriegelungsquelle DFC_EnvPSRCMax" VAL_BLK 0x80024806 ValA_Wu16 688. DINH_FIdVerb 0.00 688. FORMAT "%2.0" NUMBER 18 /end CHARACTERISTIC
/begin CHARACTERISTIC DINH_FId.DFC_EnvPSRCMin_CA "DINH/Zugeordnete FId für Verriegelungsquelle DFC_EnvPSRCMin" VAL_BLK 0x8002482A ValA_Wu16 688. DINH_FIdVerb 0.00 688. FORMAT "%2.0" NUMBER 18 /end CHARACTERISTIC
/begin CHARACTERISTIC DINH_FId.DFC_ExhTMonPlaus_CA "DINH/Zugeordnete FId für Verriegelungsquelle DFC_ExhTMonPlaus" VAL_BLK 0x8002484E ValA_Wu16 688. DINH_FIdVerb 0.00 688. FORMAT "%2.0" NUMBER 5 /end CHARACTERISTIC
/begin CHARACTERISTIC DINH_FId.DFC_ExhTMonPlausPos1_CA "DINH/Zugeordnete FId für Verriegelungsquelle DFC_ExhTMonPlausPos1" VAL_BLK 0x80024858 ValA_Wu16 688. DINH_FIdVerb 0.00 688. FORMAT "%2.0" NUMBER 5 /end CHARACTERISTIC
/begin CHARACTERISTIC DINH_FId.DFC_ExhTMonPlausPos2_CA "DINH/Zugeordnete FId für Verriegelungsquelle DFC_ExhTMonPlausPos2" VAL_BLK 0x80024862 ValA_Wu16 688. DINH_FIdVerb 0.00 688. FORMAT "%2.0" NUMBER 5 /end CHARACTERISTIC
/begin CHARACTERISTIC DINH_FId.DFC_ExhTMonPlausPos3_CA "DINH/Zugeordnete FId für Verriegelungsquelle DFC_ExhTMonPlausPos3" VAL_BLK 0x8002486C ValA_Wu16 688. DINH_FIdVerb 0.00 688. FORMAT "%2.0" NUMBER 2 /end CHARACTERISTIC
/begin CHARACTERISTIC DINH_FId.DFC_ExhTMonT1Plaus_CA "DINH/Zugeordnete FId für Verriegelungsquelle DFC_ExhTMonT1Plaus" VAL_BLK 0x80024870 ValA_Wu16 688. DINH_FIdVerb 0.00 688. FORMAT "%2.0" NUMBER 5 /end CHARACTERISTIC
/begin CHARACTERISTIC DINH_FId.DFC_ExhTMonT2Plaus_CA "DINH/Zugeordnete FId für Verriegelungsquelle DFC_ExhTMonT2Plaus" VAL_BLK 0x8002487A ValA_Wu16 688. DINH_FIdVerb 0.00 688. FORMAT "%2.0" NUMBER 5 /end CHARACTERISTIC
/begin CHARACTERISTIC DINH_FId.DFC_ExhTMonT3Plaus_CA "DINH/Zugeordnete FId für Verriegelungsquelle DFC_ExhTMonT3Plaus" VAL_BLK 0x80024884 ValA_Wu16 688. DINH_FIdVerb 0.00 688. FORMAT "%2.0" NUMBER 2 /end CHARACTERISTIC
/begin CHARACTERISTIC DINH_FId.DFC_FlFltDsPSRCMax_CA "DINH/Zugeordnete FId für Verriegelungsquelle DFC_FlFltDsPSRCMax" VAL_BLK 0x80024888 ValA_Wu16 688. DINH_FIdVerb 0.00 688. FORMAT "%2.0" NUMBER 4 /end CHARACTERISTIC
/begin CHARACTERISTIC DINH_FId.DFC_FlFltDsPSRCMin_CA "DINH/Zugeordnete FId für Verriegelungsquelle DFC_FlFltDsPSRCMin" VAL_BLK 0x80024890 ValA_Wu16 688. DINH_FIdVerb 0.00 688. FORMAT "%2.0" NUMBER 4 /end CHARACTERISTIC
/begin CHARACTERISTIC DINH_FId.DFC_FlFltSig_CA "DINH/Zugeordnete FId für Verriegelungsquelle DFC_FlFltSig" VAL_BLK 0x80024898 ValA_Wu16 688. DINH_FIdVerb 0.00 688. FORMAT "%2.0" NUMBER 2 /end CHARACTERISTIC
/begin CHARACTERISTIC DINH_FId.DFC_FlFltUsPSRCMax_CA "DINH/Zugeordnete FId für Verriegelungsquelle DFC_FlFltUsPSRCMax" VAL_BLK 0x8002489C ValA_Wu16 688. DINH_FIdVerb 0.00 688. FORMAT "%2.0" NUMBER 4 /end CHARACTERISTIC
/begin CHARACTERISTIC DINH_FId.DFC_FlFltUsPSRCMin_CA "DINH/Zugeordnete FId für Verriegelungsquelle DFC_FlFltUsPSRCMin" VAL_BLK 0x800248A4 ValA_Wu16 688. DINH_FIdVerb 0.00 688. FORMAT "%2.0" NUMBER 4 /end CHARACTERISTIC
/begin CHARACTERISTIC DINH_FId.DFC_FuelTSRCMax_CA "DINH/Zugeordnete FId für Verriegelungsquelle DFC_FuelTSRCMax" VAL_BLK 0x800248AC ValA_Wu16 688. DINH_FIdVerb 0.00 688. FORMAT "%2.0" NUMBER 8 /end CHARACTERISTIC
/begin CHARACTERISTIC DINH_FId.DFC_FuelTSRCMin_CA "DINH/Zugeordnete FId für Verriegelungsquelle DFC_FuelTSRCMin" VAL_BLK 0x800248BC ValA_Wu16 688. DINH_FIdVerb 0.00 688. FORMAT "%2.0" NUMBER 8 /end CHARACTERISTIC
/begin CHARACTERISTIC DINH_FId.DFC_GbxNPosPPerSRCMax_CA "DINH/Zugeordnete FId für Verriegelungsquelle DFC_GbxNPosPPerSRCMax" VAL_BLK 0x800248CC ValA_Wu16 688. DINH_FIdVerb 0.00 688. FORMAT "%2.0" NUMBER 3 /end CHARACTERISTIC
/begin CHARACTERISTIC DINH_FId.DFC_GbxNPosPPerSRCMin_CA "DINH/Zugeordnete FId für Verriegelungsquelle DFC_GbxNPosPPerSRCMin" VAL_BLK 0x800248D2 ValA_Wu16 688. DINH_FIdVerb 0.00 688. FORMAT "%2.0" NUMBER 3 /end CHARACTERISTIC
/begin CHARACTERISTIC DINH_FId.DFC_GbxNPosPdcycSRCMax_CA "DINH/Zugeordnete FId für Verriegelungsquelle DFC_GbxNPosPdcycSRCMax" VAL_BLK 0x800248D8 ValA_Wu16 688. DINH_FIdVerb 0.00 688. FORMAT "%2.0" NUMBER 3 /end CHARACTERISTIC
/begin CHARACTERISTIC DINH_FId.DFC_GbxNPosPdcycSRCMin_CA "DINH/Zugeordnete FId für Verriegelungsquelle DFC_GbxNPosPdcycSRCMin" VAL_BLK 0x800248DE ValA_Wu16 688. DINH_FIdVerb 0.00 688. FORMAT "%2.0" NUMBER 3 /end CHARACTERISTIC
/begin CHARACTERISTIC DINH_FId.DFC_InjVlvPresMin_CA "DINH/Zugeordnete FId für Verriegelungsquelle DFC_InjVlvPresMin" VAL_BLK 0x800248E4 ValA_Wu16 688. DINH_FIdVerb 0.00 688. FORMAT "%2.0" NUMBER 2 /end CHARACTERISTIC
/begin CHARACTERISTIC DINH_FId.DFC_LSUCircNernstSig_CA "DINH/Zugeordnete FId für Verriegelungsquelle DFC_LSUCircNernstSig" VAL_BLK 0x800248E8 ValA_Wu16 688. DINH_FIdVerb 0.00 688. FORMAT "%2.0" NUMBER 18 /end CHARACTERISTIC
/begin CHARACTERISTIC DINH_FId.DFC_LSUCircPmpCurSig_CA "DINH/Zugeordnete FId für Verriegelungsquelle DFC_LSUCircPmpCurSig" VAL_BLK 0x8002490C ValA_Wu16 688. DINH_FIdVerb 0.00 688. FORMAT "%2.0" NUMBER 14 /end CHARACTERISTIC
/begin CHARACTERISTIC DINH_FId.DFC_LSUCircVirtGndSig_CA "DINH/Zugeordnete FId für Verriegelungsquelle DFC_LSUCircVirtGndSig" VAL_BLK 0x80024928 ValA_Wu16 688. DINH_FIdVerb 0.00 688. FORMAT "%2.0" NUMBER 18 /end CHARACTERISTIC
/begin CHARACTERISTIC DINH_FId.DFC_LSUO2Max_CA "DINH/Zugeordnete FId für Verriegelungsquelle DFC_LSUO2Max" VAL_BLK 0x8002494C ValA_Wu16 688. DINH_FIdVerb 0.00 688. FORMAT "%2.0" NUMBER 13 /end CHARACTERISTIC
/begin CHARACTERISTIC DINH_FId.DFC_LSUO2Min_CA "DINH/Zugeordnete FId für Verriegelungsquelle DFC_LSUO2Min" VAL_BLK 0x80024966 ValA_Wu16 688. DINH_FIdVerb 0.00 688. FORMAT "%2.0" NUMBER 13 /end CHARACTERISTIC
/begin CHARACTERISTIC DINH_FId.DFC_LSUSPIBattLowMin_CA "DINH/Zugeordnete FId für Verriegelungsquelle DFC_LSUSPIBattLowMin" VAL_BLK 0x80024980 ValA_Wu16 688. DINH_FIdVerb 0.00 688. FORMAT "%2.0" NUMBER 19 /end CHARACTERISTIC
/begin CHARACTERISTIC DINH_FId.DFC_LSUWireSCB_CA "DINH/Zugeordnete FId für Verriegelungsquelle DFC_LSUWireSCB" VAL_BLK 0x800249A6 ValA_Wu16 688. DINH_FIdVerb 0.00 688. FORMAT "%2.0" NUMBER 18 /end CHARACTERISTIC
/begin CHARACTERISTIC DINH_FId.DFC_LSUWireSCG_CA "DINH/Zugeordnete FId für Verriegelungsquelle DFC_LSUWireSCG" VAL_BLK 0x800249CA ValA_Wu16 688. DINH_FIdVerb 0.00 688. FORMAT "%2.0" NUMBER 18 /end CHARACTERISTIC
/begin CHARACTERISTIC DINH_FId.DFC_MeUnSCG_CA "DINH/Zugeordnete FId für Verriegelungsquelle DFC_MeUnSCG" VAL_BLK 0x800249EE ValA_Wu16 688. DINH_FIdVerb 0.00 688. FORMAT "%2.0" NUMBER 10 /end CHARACTERISTIC
/begin CHARACTERISTIC DINH_FId.DFC_NSCDsCmpChk_CA "DINH/Zugeordnete FId für Verriegelungsquelle DFC_NSCDsCmpChk" VAL_BLK 0x80024A02 ValA_Wu16 688. DINH_FIdVerb 0.00 688. FORMAT "%2.0" NUMBER 2 /end CHARACTERISTIC
/begin CHARACTERISTIC DINH_FId.DFC_NSCDsLamBinSRCMax_CA "DINH/Zugeordnete FId für Verriegelungsquelle DFC_NSCDsLamBinSRCMax" VAL_BLK 0x80024A06 ValA_Wu16 688. DINH_FIdVerb 0.00 688. FORMAT "%2.0" NUMBER 2 /end CHARACTERISTIC
/begin CHARACTERISTIC DINH_FId.DFC_NSCDsLamBinSRCMin_CA "DINH/Zugeordnete FId für Verriegelungsquelle DFC_NSCDsLamBinSRCMin" VAL_BLK 0x80024A0A ValA_Wu16 688. DINH_FIdVerb 0.00 688. FORMAT "%2.0" NUMBER 2 /end CHARACTERISTIC
/begin CHARACTERISTIC DINH_FId.DFC_NSCDsLamLinSRCMax_CA "DINH/Zugeordnete FId für Verriegelungsquelle DFC_NSCDsLamLinSRCMax" VAL_BLK 0x80024A0E ValA_Wu16 688. DINH_FIdVerb 0.00 688. FORMAT "%2.0" NUMBER 2 /end CHARACTERISTIC
/begin CHARACTERISTIC DINH_FId.DFC_NSCDsLamLinSRCMin_CA "DINH/Zugeordnete FId für Verriegelungsquelle DFC_NSCDsLamLinSRCMin" VAL_BLK 0x80024A12 ValA_Wu16 688. DINH_FIdVerb 0.00 688. FORMAT "%2.0" NUMBER 2 /end CHARACTERISTIC
/begin MEASUREMENT DINH_stClctFId_mp "gesammelte Zustände aller function identifer, bei Verriegelung ist das Bit gesetzt" UWORD DFC_OneToOne 1 100 0.00 65535.00 ARRAY_SIZE 44 ECU_ADDRESS 0xC000BB0C /end MEASUREMENT
/begin MEASUREMENT DINH_stFId.FId_RailPMonStrt "FId/Status des Funktions Identifiers FId_RailPMonStrt" UBYTE DFC_OneToOne 1 100 0.00 255.0 ECU_ADDRESS 0xD0003B9D /end MEASUREMENT
/begin MEASUREMENT DINH_stFId.FId_RailPSS "FId/FId zum stoppen des Einlesens der Raildsrucksensorwerte und setzen eines Raildrucksensor default Wertes" UBYTE DFC_OneToOne 1 100 0.00 255.0 ECU_ADDRESS 0xD0003B9E /end MEASUREMENT
/begin MEASUREMENT DINH_stFId.FId_RailPSubsVal "FId/FId zum Umschalten auf einen Default Raildruckwert des Raildrucksensors" UBYTE DFC_OneToOne 1 100 0.00 255.0 ECU_ADDRESS 0xD0003B9F /end MEASUREMENT
/begin MEASUREMENT DINH_stFId.FId_RailSetPointLim "FId/Fid zur Verriegelung der ""normalen"" Begrenzung des Raildruck-Sollwertes" UBYTE DFC_OneToOne 1 100 0.00 255.0 ECU_ADDRESS 0xD0003BA0 /end MEASUREMENT
/begin MEASUREMENT DINH_stFId.FId_RailSetPointRed "FId/Funktionsidentifizierer zur Freigabe der Solldruckabsenkung im Systemfehlerfall" UBYTE DFC_OneToOne 1 100 0.00 255.0 ECU_ADDRESS 0xD0003BA1 /end MEASUREMENT
/begin MEASUREMENT DINH_stFId.FId_RailSetPointVehCor "" UBYTE DFC_OneToOne 1 100 0.00 255.0 ECU_ADDRESS 0xD0003BA2 /end MEASUREMENT
/begin MEASUREMENT DINH_stFId.FId_ReFl "" UBYTE DFC_OneToOne 1 100 0.00 255.0 ECU_ADDRESS 0xD0003BA3 /end MEASUREMENT
/begin MEASUREMENT DINH_stFId.FId_ReplValTPFltUs "FId/Status des Funktions Identifiers FId_ReplValTPFltUs" UBYTE DFC_OneToOne 1 100 0.00 255.0 ECU_ADDRESS 0xD0003BA4 /end MEASUREMENT
/begin MEASUREMENT DINH_stFId.FId_RplValAbsUPmpP "" UBYTE DFC_OneToOne 1 100 0.00 255.0 ECU_ADDRESS 0xD0003BA5 /end MEASUREMENT
/begin MEASUREMENT DINH_stFId.FId_RplValCANAbsUPmpP "" UBYTE DFC_OneToOne 1 100 0.00 255.0 ECU_ADDRESS 0xD0003BA6 /end MEASUREMENT
/begin MEASUREMENT DINH_stFId.FId_RplValCANUCatUsT "FId/Status des Funktions Identifiers FId_RplValCANUCatUsT" UBYTE DFC_OneToOne 1 100 0.00 255.0 ECU_ADDRESS 0xD0003BA7 /end MEASUREMENT
/begin MEASUREMENT DINH_stFId.FId_RplValPPFltDiff "FId/Status des Funktions Identifiers FId_RplValPPFltDiff" UBYTE DFC_OneToOne 1 100 0.00 255.0 ECU_ADDRESS 0xD0003BA8 /end MEASUREMENT
/begin MEASUREMENT DINH_stFId.FId_RplValPPFltUs "FId/Status des Funktions Identifiers FId_RplValPPFltUs" UBYTE DFC_OneToOne 1 100 0.00 255.0 ECU_ADDRESS 0xD0003BA9 /end MEASUREMENT
/begin MEASUREMENT DINH_stFId.FId_RplValTOxiCatUs "FId/Status des Funktions Identifiers FId_RplValTOxiCatUs" UBYTE DFC_OneToOne 1 100 0.00 255.0 ECU_ADDRESS 0xD0003BAA /end MEASUREMENT
/begin MEASUREMENT DINH_stFId.FId_RplValTTrbnUs "FId/Status des Funktions Identifiers FId_RplValTTrbnUs" UBYTE DFC_OneToOne 1 100 0.00 255.0 ECU_ADDRESS 0xD0003BAB /end MEASUREMENT
/begin MEASUREMENT DINH_stFId.FId_RplValUCatUsT "FId/Status des Funktions Identifiers FId_RplValUCatUsT" UBYTE DFC_OneToOne 1 100 0.00 255.0 ECU_ADDRESS 0xD0003BAC /end MEASUREMENT
/begin MEASUREMENT DINH_stFId.FId_RplValUTnkLvl "" UBYTE DFC_OneToOne 1 100 0.00 255.0 ECU_ADDRESS 0xD0003BAD /end MEASUREMENT
/begin MEASUREMENT DINH_stFId.FId_SCRChkNOxEff "FId/Status des Funktions Identifiers FId_SCRChkNOxEff" UBYTE DFC_OneToOne 1 100 0.00 255.0 ECU_ADDRESS 0xD0003BAE /end MEASUREMENT
/begin MEASUREMENT DINH_stFId.FId_SCRPODPresBuildUp "" UBYTE DFC_OneToOne 1 100 0.00 255.0 ECU_ADDRESS 0xD0003BAF /end MEASUREMENT
/begin MEASUREMENT DINH_stFId.FId_SRCFlwRstn "FId/Status des Funktions Identifiers FId_SRCFlwRstn" UBYTE DFC_OneToOne 1 100 0.00 255.0 ECU_ADDRESS 0xD0003BB0 /end MEASUREMENT
/begin MEASUREMENT DINH_stFId.FId_SSMonFlFltDsP "" UBYTE DFC_OneToOne 1 100 0.00 255.0 ECU_ADDRESS 0xD0003BB1 /end MEASUREMENT
/begin MEASUREMENT DINH_stFId.FId_SSMonFlFltUsP "" UBYTE DFC_OneToOne 1 100 0.00 255.0 ECU_ADDRESS 0xD0003BB2 /end MEASUREMENT
/begin MEASUREMENT DINH_stFId.FId_SSPIntkVUs "FId/Status des Funktions Identifiers FId_SSPIntkVUs" UBYTE DFC_OneToOne 1 100 0.00 255.0 ECU_ADDRESS 0xD0003BB3 /end MEASUREMENT
/begin MEASUREMENT DINH_stFId.FId_SSTOxiCatUs "FId/Status des Funktions Identifiers FId_SSTOxiCatUs" UBYTE DFC_OneToOne 1 100 0.00 255.0 ECU_ADDRESS 0xD0003BB4 /end MEASUREMENT
/begin MEASUREMENT DINH_stFId.FId_SSTPFltUs "FId/Status des Funktions Identifiers FId_SSTPFltUs" UBYTE DFC_OneToOne 1 100 0.00 255.0 ECU_ADDRESS 0xD0003BB5 /end MEASUREMENT
/begin MEASUREMENT DINH_stFId.FId_SSUCatUsT "FId/Status des Funktions Identifiers FId_SSUCatUsT" UBYTE DFC_OneToOne 1 100 0.00 255.0 ECU_ADDRESS 0xD0003BB6 /end MEASUREMENT
/begin MEASUREMENT DINH_stFId.FId_SSUPmpP "" UBYTE DFC_OneToOne 1 100 0.00 255.0 ECU_ADDRESS 0xD0003BB7 /end MEASUREMENT
/begin MEASUREMENT DINH_stFId.FId_SSUTnkT "" UBYTE DFC_OneToOne 1 100 0.00 255.0 ECU_ADDRESS 0xD0003BB8 /end MEASUREMENT
/begin MEASUREMENT DINH_stFId.FId_SensAdapTPFltUs "FId/Status des Funktions Identifiers FId_SensAdapTPFltUs" UBYTE DFC_OneToOne 1 100 0.00 255.0 ECU_ADDRESS 0xD0003BB9 /end MEASUREMENT
/begin MEASUREMENT DINH_stFId.FId_StAPmpEna "" UBYTE DFC_OneToOne 1 100 0.00 255.0 ECU_ADDRESS 0xD0003BBA /end MEASUREMENT
/begin MEASUREMENT DINH_stFId.FId_StBy "" UBYTE DFC_OneToOne 1 100 0.00 255.0 ECU_ADDRESS 0xD0003BBB /end MEASUREMENT
/begin MEASUREMENT DINH_stFId.FId_SubsValPrtTrqDfftl "FId/Status des Funktions Identifiers FId_SubsValPrtTrqDfftl" UBYTE DFC_OneToOne 1 100 0.00 255.0 ECU_ADDRESS 0xD0003BBC /end MEASUREMENT
/begin MEASUREMENT DINH_stFId.FId_SubsValRatTrqDfftl "FId/Status des Funktions Identifiers FId_SubsValRatTrqDfftl" UBYTE DFC_OneToOne 1 100 0.00 255.0 ECU_ADDRESS 0xD0003BBD /end MEASUREMENT
/begin MEASUREMENT DINH_stFId.FId_T15 "FId/Status des Funktions Identifiers FId_T15" UBYTE DFC_OneToOne 1 100 0.00 255.0 ECU_ADDRESS 0xD0003BBE /end MEASUREMENT
/begin MEASUREMENT DINH_stFId.FId_T50Sig "FId/Status des Funktions Identifiers FId_T50Sig" UBYTE DFC_OneToOne 1 100 0.00 255.0 ECU_ADDRESS 0xD0003BBF /end MEASUREMENT
/begin MEASUREMENT DINH_stFId.FId_TAA "FId/Substitute : FId zum Abschalten der TAA (Inkrementwinkel-Lernverfahren), wenn Fehler in Eingangssignalen auftreten." UBYTE DFC_OneToOne 1 100 0.00 255.0 ECU_ADDRESS 0xD0003BC0 /end MEASUREMENT
/begin MEASUREMENT DINH_stFId.FId_TAFSFrzVal "FId/Status des Funktions Identifiers FId_TAFSFrzVal" UBYTE DFC_OneToOne 1 100 0.00 255.0 ECU_ADDRESS 0xD0003BC1 /end MEASUREMENT
/begin MEASUREMENT DINH_stFId.FId_TAFSReplVal "FId/Status des Funktions Identifiers FId_TAFSReplVal" UBYTE DFC_OneToOne 1 100 0.00 255.0 ECU_ADDRESS 0xD0003BC2 /end MEASUREMENT
/begin MEASUREMENT DINH_stFId.FId_TAFSSRC "FId/Status des Funktions Identifiers FId_TAFSSRC" UBYTE DFC_OneToOne 1 100 0.00 255.0 ECU_ADDRESS 0xD0003BC3 /end MEASUREMENT
/begin MEASUREMENT DINH_stFId.FId_TCACDsCANFrzVal "FId/Status des Funktions Identifiers FId_TCACDsCANFrzVal" UBYTE DFC_OneToOne 1 100 0.00 255.0 ECU_ADDRESS 0xD0003BC4 /end MEASUREMENT
/begin MEASUREMENT DINH_stFId.FId_TCACDsCANRplVal "FId/Status des Funktions Identifiers FId_TCACDsCANRplVal" UBYTE DFC_OneToOne 1 100 0.00 255.0 ECU_ADDRESS 0xD0003BC5 /end MEASUREMENT
/begin MEASUREMENT DINH_stFId.FId_TCACDsFrzVal "FId/Status des Funktions Identifiers FId_TCACDsFrzVal" UBYTE DFC_OneToOne 1 100 0.00 255.0 ECU_ADDRESS 0xD0003BC6 /end MEASUREMENT
/begin MEASUREMENT DINH_stFId.FId_TCACDsModel "FId/Status des Funktions Identifiers FId_TCACDsModel" UBYTE DFC_OneToOne 1 100 0.00 255.0 ECU_ADDRESS 0xD0003BC7 /end MEASUREMENT
/begin MEASUREMENT DINH_stFId.FId_TCACDsRplVal "FId/Status des Funktions Identifiers FId_TCACDsRplVal" UBYTE DFC_OneToOne 1 100 0.00 255.0 ECU_ADDRESS 0xD0003BC8 /end MEASUREMENT
/begin MEASUREMENT DINH_stFId.FId_TCACDsSS "FId/Status des Funktions Identifiers FId_TCACDsSS" UBYTE DFC_OneToOne 1 100 0.00 255.0 ECU_ADDRESS 0xD0003BC9 /end MEASUREMENT
/begin MEASUREMENT DINH_stFId.FId_TCPrtChrgPmpCtl "FId/Status des Funktions Identifiers FId_TCPrtChrgPmpCtl" UBYTE DFC_OneToOne 1 100 0.00 255.0 ECU_ADDRESS 0xD0003BCA /end MEASUREMENT
/begin MEASUREMENT DINH_stFId.FId_TCPrtChrgPmpGov "FId/Status des Funktions Identifiers FId_TCPrtChrgPmpGov" UBYTE DFC_OneToOne 1 100 0.00 255.0 ECU_ADDRESS 0xD0003BCB /end MEASUREMENT
/begin MEASUREMENT DINH_stFId.FId_TCPrtChrgPmpHLSDem "FId/Status des Funktions Identifiers FId_TCPrtChrgPmpHLSDem" UBYTE DFC_OneToOne 1 100 0.00 255.0 ECU_ADDRESS 0xD0003BCC /end MEASUREMENT
/begin MEASUREMENT DINH_stFId.FId_TCPrt_ChrgPmpDet "FId/Status des Funktions Identifiers FId_TCPrt_ChrgPmpDet" UBYTE DFC_OneToOne 1 100 0.00 255.0 ECU_ADDRESS 0xD0003BCD /end MEASUREMENT
/begin MEASUREMENT DINH_stFId.FId_TCPrtnSetTSC "" UBYTE DFC_OneToOne 1 100 0.00 255.0 ECU_ADDRESS 0xD0003BCE /end MEASUREMENT
/begin MEASUREMENT DINH_stFId.FId_TCSRmpShOff "FId/Status des Funktions Identifiers FId_TCSRmpShOff" UBYTE DFC_OneToOne 1 100 0.00 255.0 ECU_ADDRESS 0xD0003BCF /end MEASUREMENT
/begin MEASUREMENT DINH_stFId.FId_TCSShOff "FId/Status des Funktions Identifiers FId_TCSShOff" UBYTE DFC_OneToOne 1 100 0.00 255.0 ECU_ADDRESS 0xD0003BD0 /end MEASUREMENT
/begin MEASUREMENT DINH_stFId.FId_TECUFrzVal "FId/Status des Funktions Identifiers FId_TECUFrzVal" UBYTE DFC_OneToOne 1 100 0.00 255.0 ECU_ADDRESS 0xD0003BD1 /end MEASUREMENT
/begin MEASUREMENT DINH_stFId.FId_TECURplVal "FId/Status des Funktions Identifiers FId_TECURplVal" UBYTE DFC_OneToOne 1 100 0.00 255.0 ECU_ADDRESS 0xD0003BD2 /end MEASUREMENT
/begin MEASUREMENT DINH_stFId.FId_TOxiCatUs "FId/Status des Funktions Identifiers FId_TOxiCatUs" UBYTE DFC_OneToOne 1 100 0.00 255.0 ECU_ADDRESS 0xD0003BD3 /end MEASUREMENT
/begin MEASUREMENT DINH_stFId.FId_TempSensFrzPPFltUs "FId/Status des Funktions Identifiers FId_TempSensFrzPPFltUs" UBYTE DFC_OneToOne 1 100 0.00 255.0 ECU_ADDRESS 0xD0003BD4 /end MEASUREMENT
/begin MEASUREMENT DINH_stFId.FId_TempWait "" UBYTE DFC_OneToOne 1 100 0.00 255.0 ECU_ADDRESS 0xD0003BD5 /end MEASUREMENT
/begin MEASUREMENT DINH_stFId.FId_ThrVlvFrzVal "FId/Status des Funktions Identifiers FId_ThrVlvFrzVal" UBYTE DFC_OneToOne 1 100 0.00 255.0 ECU_ADDRESS 0xD0003BD6 /end MEASUREMENT
/begin MEASUREMENT DINH_stFId.FId_ThrVlvMon "" UBYTE DFC_OneToOne 1 100 0.00 255.0 ECU_ADDRESS 0xD0003BD7 /end MEASUREMENT
/begin MEASUREMENT DINH_stFId.FId_ThrVlvRplVal "FId/Status des Funktions Identifiers FId_ThrVlvRplVal" UBYTE DFC_OneToOne 1 100 0.00 255.0 ECU_ADDRESS 0xD0003BD8 /end MEASUREMENT
/begin MEASUREMENT DINH_stFId.FId_ThrVlvSS "FId/Status des Funktions Identifiers FId_ThrVlvSS" UBYTE DFC_OneToOne 1 100 0.00 255.0 ECU_ADDRESS 0xD0003BD9 /end MEASUREMENT
/begin MEASUREMENT DINH_stFId.FId_TraAddAirCANPtd "FId/Status des Funktions Identifiers FId_TraAddAirCANPtd" UBYTE DFC_OneToOne 1 100 0.00 255.0 ECU_ADDRESS 0xD0003BDA /end MEASUREMENT
/begin MEASUREMENT DINH_stFId.FId_TraAddClntCANPtd "FId/Status des Funktions Identifiers FId_TraAddClntCANPtd" UBYTE DFC_OneToOne 1 100 0.00 255.0 ECU_ADDRESS 0xD0003BDB /end MEASUREMENT
/begin MEASUREMENT DINH_stFId.FId_TraDrvAway "FId/Status des Funktions Identifiers FId_TraDrvAway" UBYTE DFC_OneToOne 1 100 0.00 255.0 ECU_ADDRESS 0xD0003BDC /end MEASUREMENT
/begin MEASUREMENT DINH_stFId.FId_TraDrvAwayInactiv "FId/Status des Funktions Identifiers FId_TraDrvAwayInactiv" UBYTE DFC_OneToOne 1 100 0.00 255.0 ECU_ADDRESS 0xD0003BDD /end MEASUREMENT
/begin MEASUREMENT DINH_stFId.FId_TraGearInfoDet "FId/Status des Funktions Identifiers FId_TraGearInfoDet" UBYTE DFC_OneToOne 1 100 0.00 255.0 ECU_ADDRESS 0xD0003BDE /end MEASUREMENT
/begin MEASUREMENT DINH_stFId.FId_TraGearInfoInfoCan "FId/Status des Funktions Identifiers FId_TraGearInfoInfoCan" UBYTE DFC_OneToOne 1 100 0.00 255.0 ECU_ADDRESS 0xD0003BDF /end MEASUREMENT
/begin MEASUREMENT DINH_stFId.FId_TraGearInfoLevPos "FId/Status des Funktions Identifiers FId_TraGearInfoLevPos" UBYTE DFC_OneToOne 1 100 0.00 255.0 ECU_ADDRESS 0xD0003BE0 /end MEASUREMENT
/begin MEASUREMENT DINH_stFId.FId_TraGearInfoLoRng "FId/Status des Funktions Identifiers FId_TraGearInfoLoRng" UBYTE DFC_OneToOne 1 100 0.00 255.0 ECU_ADDRESS 0xD0003BE1 /end MEASUREMENT
/begin MEASUREMENT DINH_stFId.FId_TraGearInfoRTra "FId/Status des Funktions Identifiers FId_TraGearInfoRTra" UBYTE DFC_OneToOne 1 100 0.00 255.0 ECU_ADDRESS 0xD0003BE2 /end MEASUREMENT
/begin MEASUREMENT DINH_stFId.FId_TraGearInfoRevGear "FId/Status des Funktions Identifiers FId_TraGearInfoRevGear" UBYTE DFC_OneToOne 1 100 0.00 255.0 ECU_ADDRESS 0xD0003BE3 /end MEASUREMENT
/begin MEASUREMENT DINH_stFId.FId_TraNmin "" UBYTE DFC_OneToOne 1 100 0.00 255.0 ECU_ADDRESS 0xD0003BE4 /end MEASUREMENT
/begin MEASUREMENT DINH_stFId.FId_TraOilTemp "FId/Status des Funktions Identifiers FId_TraOilTemp" UBYTE DFC_OneToOne 1 100 0.00 255.0 ECU_ADDRESS 0xD0003BE5 /end MEASUREMENT
/begin MEASUREMENT DINH_stFId.FId_TraPrtGearCANPtd "FId/Status des Funktions Identifiers FId_TraPrtGearCANPtd" UBYTE DFC_OneToOne 1 100 0.00 255.0 ECU_ADDRESS 0xD0003BE6 /end MEASUREMENT
/begin MEASUREMENT DINH_stFId.FId_TraRtnIntfcASTIntv "FId/Status des Funktions Identifiers FId_TraRtnIntfcASTIntv" UBYTE DFC_OneToOne 1 100 0.00 255.0 ECU_ADDRESS 0xD0003BE7 /end MEASUREMENT
/begin MEASUREMENT DINH_stFId.FId_TraRtnIntfcIdlSetP "FId/Status des Funktions Identifiers FId_TraRtnIntfcIdlSetP" UBYTE DFC_OneToOne 1 100 0.00 255.0 ECU_ADDRESS 0xD0003BE8 /end MEASUREMENT
/begin MEASUREMENT DINH_stFId.FId_TraSlip "" UBYTE DFC_OneToOne 1 100 0.00 255.0 ECU_ADDRESS 0xD0003BE9 /end MEASUREMENT
/begin MEASUREMENT DINH_stFId.FId_TraSpaCAN "" UBYTE DFC_OneToOne 1 100 0.00 255.0 ECU_ADDRESS 0xD0003BEA /end MEASUREMENT
/begin MEASUREMENT DINH_stFId.FId_TraSpaEngSpd "" UBYTE DFC_OneToOne 1 100 0.00 255.0 ECU_ADDRESS 0xD0003BEB /end MEASUREMENT
/begin MEASUREMENT DINH_stFId.FId_TraSpaVehV "" UBYTE DFC_OneToOne 1 100 0.00 255.0 ECU_ADDRESS 0xD0003BEC /end MEASUREMENT
/begin MEASUREMENT DINH_stFId.FId_TraTrqLimErr "FId/Status des Funktions Identifiers FId_TraTrqLimErr" UBYTE DFC_OneToOne 1 100 0.00 255.0 ECU_ADDRESS 0xD0003BED /end MEASUREMENT
/begin MEASUREMENT DINH_stFId.FId_TraTrqLos "FId/Status des Funktions Identifiers FId_TraTrqLos" UBYTE DFC_OneToOne 1 100 0.00 255.0 ECU_ADDRESS 0xD0003BEE /end MEASUREMENT
/begin MEASUREMENT DINH_stFId.FId_TraTrqRedLmpHmeDec "FId/Status des Funktions Identifiers FId_TraTrqRedLmpHmeDec" UBYTE DFC_OneToOne 1 100 0.00 255.0 ECU_ADDRESS 0xD0003BEF /end MEASUREMENT
/begin MEASUREMENT DINH_stFId.FId_TraTrqRedLmpHmeInc "FId/Status des Funktions Identifiers FId_TraTrqRedLmpHmeInc" UBYTE DFC_OneToOne 1 100 0.00 255.0 ECU_ADDRESS 0xD0003BF0 /end MEASUREMENT
/begin MEASUREMENT DINH_stFId.FId_TraTrqRedPlausDecIntv "FId/Status des Funktions Identifiers FId_TraTrqRedPlausDecIntv" UBYTE DFC_OneToOne 1 100 0.00 255.0 ECU_ADDRESS 0xD0003BF1 /end MEASUREMENT
/begin MEASUREMENT DINH_stFId.FId_TraTrqRedPlausIncIntv "FId/Status des Funktions Identifiers FId_TraTrqRedPlausIncIntv" UBYTE DFC_OneToOne 1 100 0.00 255.0 ECU_ADDRESS 0xD0003BF2 /end MEASUREMENT
/begin MEASUREMENT DINH_stFId.FId_TrbChPWMIn "" UBYTE DFC_OneToOne 1 100 0.00 255.0 ECU_ADDRESS 0xD0003BF3 /end MEASUREMENT
/begin MEASUREMENT DINH_stFId.FId_UHCMonUHtrPL "" UBYTE DFC_OneToOne 1 100 0.00 255.0 ECU_ADDRESS 0xD0003BF4 /end MEASUREMENT
/begin MEASUREMENT DINH_stFId.FId_UHCMonUHtrTnk "" UBYTE DFC_OneToOne 1 100 0.00 255.0 ECU_ADDRESS 0xD0003BF5 /end MEASUREMENT
/begin MEASUREMENT DINH_stFId.FId_UHtrPLFrzValDia "" UBYTE DFC_OneToOne 1 100 0.00 255.0 ECU_ADDRESS 0xD0003BF6 /end MEASUREMENT
/begin MEASUREMENT DINH_stFId.FId_UHtrPLRplValDia "" UBYTE DFC_OneToOne 1 100 0.00 255.0 ECU_ADDRESS 0xD0003BF7 /end MEASUREMENT
/begin MEASUREMENT DINH_stFId.FId_UHtrPLSSDia "" UBYTE DFC_OneToOne 1 100 0.00 255.0 ECU_ADDRESS 0xD0003BF8 /end MEASUREMENT
/begin MEASUREMENT DINH_stFId.FId_UHtrTnkFrzValDia "" UBYTE DFC_OneToOne 1 100 0.00 255.0 ECU_ADDRESS 0xD0003BF9 /end MEASUREMENT
/begin MEASUREMENT DINH_stFId.FId_UHtrTnkRplValDia "" UBYTE DFC_OneToOne 1 100 0.00 255.0 ECU_ADDRESS 0xD0003BFA /end MEASUREMENT
/begin MEASUREMENT DINH_stFId.FId_UHtrTnkSSDia "" UBYTE DFC_OneToOne 1 100 0.00 255.0 ECU_ADDRESS 0xD0003BFB /end MEASUREMENT
/begin MEASUREMENT DINH_stFId.FId_UTnkLvlSensTst "" UBYTE DFC_OneToOne 1 100 0.00 255.0 ECU_ADDRESS 0xD0003BFC /end MEASUREMENT
/begin MEASUREMENT DINH_stFId.FId_UTnkTFrzVal "" UBYTE DFC_OneToOne 1 100 0.00 255.0 ECU_ADDRESS 0xD0003BFD /end MEASUREMENT
/begin MEASUREMENT DINH_stFId.FId_UTnkTFrzValCAN "" UBYTE DFC_OneToOne 1 100 0.00 255.0 ECU_ADDRESS 0xD0003BFE /end MEASUREMENT
/begin MEASUREMENT DINH_stFId.FId_UTnkTRplVal "" UBYTE DFC_OneToOne 1 100 0.00 255.0 ECU_ADDRESS 0xD0003BFF /end MEASUREMENT
/begin MEASUREMENT DINH_stFId.FId_UTnkTRplValCAN "" UBYTE DFC_OneToOne 1 100 0.00 255.0 ECU_ADDRESS 0xD0003C00 /end MEASUREMENT
/begin MEASUREMENT DINH_stFId.FId_VMDTrqWhl "" UBYTE DFC_OneToOne 1 100 0.00 255.0 ECU_ADDRESS 0xD0003C01 /end MEASUREMENT
/begin MEASUREMENT DINH_stFId.FId_VSwCtl "FId/Status des Funktions Identifiers FId_VSwCtl" UBYTE DFC_OneToOne 1 100 0.00 255.0 ECU_ADDRESS 0xD0003C02 /end MEASUREMENT
/begin MEASUREMENT DINH_stFId.FId_VSwCtlVehCorr "" UBYTE DFC_OneToOne 1 100 0.00 255.0 ECU_ADDRESS 0xD0003C03 /end MEASUREMENT
/begin MEASUREMENT DINH_stFId.FId_VSwVlvFrzVal "FId/Status des Funktions Identifiers FId_VSwVlvFrzVal" UBYTE DFC_OneToOne 1 100 0.00 255.0 ECU_ADDRESS 0xD0003C04 /end MEASUREMENT
/begin MEASUREMENT DINH_stFId.FId_VSwVlvGovOn "FId/Status des Funktions Identifiers FId_VSwVlvGovOn" UBYTE DFC_OneToOne 1 100 0.00 255.0 ECU_ADDRESS 0xD0003C05 /end MEASUREMENT
/begin MEASUREMENT DINH_stFId.FId_VSwVlvJamVlv "FId/Status des Funktions Identifiers FId_VSwVlvJamVlv" UBYTE DFC_OneToOne 1 100 0.00 255.0 ECU_ADDRESS 0xD0003C06 /end MEASUREMENT
/begin MEASUREMENT DINH_stFId.FId_VSwVlvOfsLrnInhib "FId/Status des Funktions Identifiers FId_VSwVlvOfsLrnInhib" UBYTE DFC_OneToOne 1 100 0.00 255.0 ECU_ADDRESS 0xD0003C07 /end MEASUREMENT
/begin MEASUREMENT DINH_stFId.FId_VSwVlvRplVal "FId/Status des Funktions Identifiers FId_VSwVlvRplVal" UBYTE DFC_OneToOne 1 100 0.00 255.0 ECU_ADDRESS 0xD0003C08 /end MEASUREMENT
/begin MEASUREMENT DINH_stFId.FId_VSwVlvSS "FId/Status des Funktions Identifiers FId_VSwVlvSS" UBYTE DFC_OneToOne 1 100 0.00 255.0 ECU_ADDRESS 0xD0003C09 /end MEASUREMENT
/begin MEASUREMENT DINH_stFId.FId_VSwVlvSpgDiagInhib "" UBYTE DFC_OneToOne 1 100 0.00 255.0 ECU_ADDRESS 0xD0003C0A /end MEASUREMENT
/begin MEASUREMENT DINH_stFId.FId_VehVReplVal "FId/Status des Funktions Identifiers FId_VehVReplVal" UBYTE DFC_OneToOne 1 100 0.00 255.0 ECU_ADDRESS 0xD0003C0B /end MEASUREMENT
/begin MEASUREMENT DINH_stFId.FId_Vtln "" UBYTE DFC_OneToOne 1 100 0.00 255.0 ECU_ADDRESS 0xD0003C0C /end MEASUREMENT
/begin MEASUREMENT DINH_stFId.FId_ZFCClbActv "FId/Status des Funktions Identifiers FId_ZFCClbActv" UBYTE DFC_OneToOne 1 100 0.00 255.0 ECU_ADDRESS 0xD0003C0D /end MEASUREMENT
/begin MEASUREMENT DINH_stFId.FId_ZFCCldCmbCham "FId/Status des Funktions Identifiers FId_ZFCCldCmbCham" UBYTE DFC_OneToOne 1 100 0.00 255.0 ECU_ADDRESS 0xD0003C0E /end MEASUREMENT
/begin MEASUREMENT DINH_stFId.FId_stAVSCoESLSU "FId/Status des Funktions Identifiers FId_stAVSCoESLSU" UBYTE DFC_OneToOne 1 100 0.00 255.0 ECU_ADDRESS 0xD0003C0F /end MEASUREMENT
/begin MEASUREMENT DINH_stFId.Fid_ComnTSC "" UBYTE DFC_OneToOne 1 100 0.00 255.0 ECU_ADDRESS 0xD0003C10 /end MEASUREMENT
/begin MEASUREMENT DINH_stFId.Fid_CustDiag_DiaDem_AT "" UBYTE DFC_OneToOne 1 100 0.00 255.0 ECU_ADDRESS 0xD0003C11 /end MEASUREMENT
/begin MEASUREMENT DINH_stFId.Fid_CustDiag_DiaDem_MT "" UBYTE DFC_OneToOne 1 100 0.00 255.0 ECU_ADDRESS 0xD0003C12 /end MEASUREMENT
/begin MEASUREMENT DINH_stFId.Fid_HLSDemHDC "" UBYTE DFC_OneToOne 1 100 0.00 255.0 ECU_ADDRESS 0xD0003C13 /end MEASUREMENT
/begin MEASUREMENT DINH_stFId.Fid_IVActrTempRplVal "" UBYTE DFC_OneToOne 1 100 0.00 255.0 ECU_ADDRESS 0xD0003C14 /end MEASUREMENT
/begin MEASUREMENT DINH_stFId.Fid_StSysStrtTipGbxDat "FId/Status des Funktions Identifiers Fid_StSysStrtTipGbxDat" UBYTE DFC_OneToOne 1 100 0.00 255.0 ECU_ADDRESS 0xD0003C15 /end MEASUREMENT
/begin MEASUREMENT DINH_stFId.Fid_TraCanNeutral "" UBYTE DFC_OneToOne 1 100 0.00 255.0 ECU_ADDRESS 0xD0003C16 /end MEASUREMENT
/begin MEASUREMENT DINH_stFId.Fid_WaHtShOffErr "FId/Status des Funktions Identifiers Fid_WaHtShOffErr" UBYTE DFC_OneToOne 1 100 0.00 255.0 ECU_ADDRESS 0xD0003C17 /end MEASUREMENT
/begin MEASUREMENT DINH_xFIDObsvInh_mp "Liste der Verriegelungsquellen die den über DINH_xFIDObsv_C ausgewählten FID aktuell sperren" UWORD DFCDSQ_Verb 1 100 0.00 1213. FORMAT "%2.0" ARRAY_SIZE 1 ECU_ADDRESS 0xC000BB64 /end MEASUREMENT
/begin MEASUREMENT DINH_xFIDObsvRls_mp "Liste der möglichen Verriegelungsquellen die den über DINH_xFIDObsv_C ausgewählten FID aktuell nicht sperren" UWORD DFCDSQ_Verb 1 100 0.00 1213. FORMAT "%2.0" ARRAY_SIZE 1 ECU_ADDRESS 0xC000BB66 /end MEASUREMENT
/begin FUNCTION DINH ""
 /begin DEF_CHARACTERISTIC DINH_FId.DFC_ACCIPlausDrvAst_CA DINH_FId.DFC_ACCIPlausTrqDes_CA DINH_FId.DFC_AirCtlGovDvtEOMMax_CA DINH_FId.DFC_AirCtlGovDvtEOMMin_CA DINH_FId.DFC_AirCtlGovDvtMax_CA DINH_FId.DFC_AirCtlGovDvtMin_CA DINH_FId.DFC_AirCtlGovLPDvtMax_CA DINH_FId.DFC_AirCtlGovLPDvtMin_CA DINH_FId.DFC_AltIOComErr_CA DINH_FId.DFC_AltIOComNpl_CA DINH_FId.DFC_BusDiagBusOffFlexRay_CA DINH_FId.DFC_BusDiagBusOffNodeA_CA DINH_FId.DFC_BusDiagBusOffNodeB_CA DINH_FId.DFC_BusDiagBusOffNodeC_CA DINH_FId.DFC_BusDiagHwFlexRay_CA DINH_FId.DFC_Cj945SpiCom1_CA DINH_FId.DFC_ComACDemandSig_FA_CA DINH_FId.DFC_ComACDemandTo_FA_CA DINH_FId.DFC_ComATempSig_FA_CA DINH_FId.DFC_ComATempTo_FA_CA DINH_FId.DFC_ComATempTo_FX_CA DINH_FId.DFC_ComBrkTrqSumChk_FX_CA DINH_FId.DFC_ComBrkTrqSumCtr_FX_CA DINH_FId.DFC_ComBrkTrqSumTo_FX_CA DINH_FId.DFC_ComBtnDrvDynChk_FX_CA DINH_FId.DFC_ComBtnDrvDynCtr_FX_CA DINH_FId.DFC_ComBtnDrvDynTo_FX_CA DINH_FId.DFC_ComButtonMSASig_CA DINH_FId.DFC_ComButtonMSATo_CA DINH_FId.DFC_ComCodierungPwrmngSig_CA DINH_FId.DFC_ComCodierungPwrmngSig_FA_CA DINH_FId.DFC_ComCrCtlLvrChk_CA DINH_FId.DFC_ComCrCtlLvrCtr_CA DINH_FId.DFC_ComCrCtlLvrSig_CA DINH_FId.DFC_ComCrCtlLvrTo_CA DINH_FId.DFC_ComCtrCrshSwoEkpSig_FA_CA DINH_FId.DFC_ComCtrCrshSwoEkpTo_FA_CA DINH_FId.DFC_ComCtrSecInt_CA DINH_FId.DFC_ComDiaOBDGbxSig_A_CA DINH_FId.DFC_ComDiaOBDGbxTo_A_CA DINH_FId.DFC_ComFahrzeugtypSig_CA DINH_FId.DFC_ComFahrzeugtypSig_FA_CA DINH_FId.DFC_ComFllupGpwsupSig_FA_CA DINH_FId.DFC_ComFllupGpwsupTo_FA_CA DINH_FId.DFC_ComGbxDataChk_A_CA DINH_FId.DFC_ComGbxDataChk_FA_CA DINH_FId.DFC_ComGbxDataCtr_A_CA DINH_FId.DFC_ComGbxDataCtr_FA_CA DINH_FId.DFC_ComGbxDataSig_A_CA DINH_FId.DFC_ComGbxDataSig_FA_CA DINH_FId.DFC_ComGbxDataTo_A_CA DINH_FId.DFC_ComGbxDataTo_FA_CA DINH_FId.DFC_ComKlemmenChk_FA_CA DINH_FId.DFC_ComKlemmenCtr_FA_CA DINH_FId.DFC_ComKlemmenSig_FA_CA DINH_FId.DFC_ComKlemmenTo_FA_CA DINH_FId.DFC_ComLenkradwinkelSig_CA DINH_FId.DFC_ComLenkradwinkelTo_CA DINH_FId.DFC_ComMileageRangeSig_FA_CA DINH_FId.DFC_ComMileageRangeTo_FA_CA DINH_FId.DFC_ComPspSig_CA DINH_FId.DFC_ComPspTo_CA DINH_FId.DFC_ComRelTimeSig_FA_CA DINH_FId.DFC_ComRelTimeTo_FA_CA DINH_FId.DFC_ComRequestEMFChk_CA DINH_FId.DFC_ComRequestEMFCtr_CA DINH_FId.DFC_ComRequestEMFSig_CA DINH_FId.DFC_ComRequestEMFTo_CA DINH_FId.DFC_ComRpmWhlChk_FX_CA DINH_FId.DFC_ComRpmWhlCtr_FX_CA DINH_FId.DFC_ComRpmWhlTo_FX_CA DINH_FId.DFC_ComSecCtrRelSig_FA_CA DINH_FId.DFC_ComSecCtrRelTo_FA_CA DINH_FId.DFC_ComSensNOxGndSig_CA DINH_FId.DFC_ComSensNOxGndTo_CA DINH_FId.DFC_ComSensNOxMode_CA DINH_FId.DFC_ComSensNOxUbattSig_CA DINH_FId.DFC_ComSensNOxUbattTo_CA DINH_FId.DFC_ComShiftPaddleTo_FX_CA DINH_FId.DFC_ComShutOffPSPSig_CA DINH_FId.DFC_ComShutOffPSPTo_CA DINH_FId.DFC_ComSlrdiGlbFZMTo_FA_CA DINH_FId.DFC_ComSlrdiGlbFZMTo_FX_CA DINH_FId.DFC_ComSpeedVehicleChk_FX_CA DINH_FId.DFC_ComSpeedVehicleCtr_FX_CA DINH_FId.DFC_ComSpeedVehicleTo_FX_CA DINH_FId.DFC_ComStConintDSCChk_FX_CA DINH_FId.DFC_ComStConintDSCCtr_FX_CA DINH_FId.DFC_ComStConintDSCTo_FX_CA DINH_FId.DFC_ComStatACFrontSig_FA_CA DINH_FId.DFC_ComStatACFrontTo_FA_CA DINH_FId.DFC_ComStatEkpSig_A_CA DINH_FId.DFC_ComStatEkpTo_A_CA DINH_FId.DFC_ComStatGearRevSig_FA_CA DINH_FId.DFC_ComStatGearRevTo_FA_CA DINH_FId.DFC_ComStatZVKlappenSig_FA_CA DINH_FId.DFC_ComStatZVKlappenTo_FA_CA DINH_FId.DFC_ComStateARSCtr_CA DINH_FId.DFC_ComStateARSSig_CA DINH_FId.DFC_ComStateARSTo_CA DINH_FId.DFC_ComStateDscSig_CA DINH_FId.DFC_ComStateDscTo_CA DINH_FId.DFC_ComStateSeatSig_CA DINH_FId.DFC_ComStateSeatSig_FA_CA DINH_FId.DFC_ComStateSeatTo_CA DINH_FId.DFC_ComStateSeatTo_FA_CA DINH_FId.DFC_ComStatusEGSSig_A_CA DINH_FId.DFC_ComStatusEGSSig_FA_CA DINH_FId.DFC_ComStatusEGSTo_A_CA DINH_FId.DFC_ComStatusEGSTo_FA_CA DINH_FId.DFC_ComStatusEMFChk_CA DINH_FId.DFC_ComStatusEMFCtr_CA DINH_FId.DFC_ComStatusEMFSig_CA DINH_FId.DFC_ComStatusEMFTo_CA DINH_FId.DFC_ComStatusRGangSig_CA DINH_FId.DFC_ComStatusRGangTo_CA DINH_FId.DFC_ComSteeringAngleChk_FX_CA DINH_FId.DFC_ComSteeringAngleCtr_FX_CA DINH_FId.DFC_ComSteeringAngleTo_FX_CA DINH_FId.DFC_ComTerminalChk_CA DINH_FId.DFC_ComTerminalCtr_CA DINH_FId.DFC_ComTerminalSig_CA DINH_FId.DFC_ComTerminalTo_CA DINH_FId.DFC_ComTimeDateSig_FA_CA DINH_FId.DFC_ComTimeDateTo_FA_CA DINH_FId.DFC_ComTrailerSig_CA DINH_FId.DFC_ComTrailerSig_FA_CA DINH_FId.DFC_ComTrailerTo_CA DINH_FId.DFC_ComTrailerTo_FA_CA DINH_FId.DFC_ComTrqDemCrshDrDyChk_FX_CA DINH_FId.DFC_ComTrqDemCrshDrDyCtr_FX_CA DINH_FId.DFC_ComTrqDemCrshDrDyTo_FX_CA DINH_FId.DFC_ComTrqDemandDesSig_CA DINH_FId.DFC_ComTrqDemandDesTo_CA DINH_FId.DFC_ComTrqDemandDscChk_CA DINH_FId.DFC_ComTrqDemandDscCtr_CA DINH_FId.DFC_ComTrqDemandDscSig_CA DINH_FId.DFC_ComTrqDemandDscTo_CA DINH_FId.DFC_ComTrqDemandGbxChk_A_CA DINH_FId.DFC_ComTrqDemandGbxChk_FA_CA DINH_FId.DFC_ComTrqDemandGbxCtr_A_CA DINH_FId.DFC_ComTrqDemandGbxCtr_FA_CA DINH_FId.DFC_ComTrqDemandGbxSig_A_CA DINH_FId.DFC_ComTrqDemandGbxSig_FA_CA DINH_FId.DFC_ComTrqDemandGbxTo_A_CA DINH_FId.DFC_ComTrqDemandGbxTo_FA_CA DINH_FId.DFC_ComTrqWhlDemChk_CA DINH_FId.DFC_ComTrqWhlDemCtr_CA DINH_FId.DFC_ComTrqWhlDemFASChk_FX_CA DINH_FId.DFC_ComTrqWhlDemFASCtr_FX_CA DINH_FId.DFC_ComTrqWhlDemFASTo_FX_CA DINH_FId.DFC_ComTrqWhlDemSig_CA DINH_FId.DFC_ComTrqWhlDemTo_CA DINH_FId.DFC_ComVelocityChk_FA_CA DINH_FId.DFC_ComVelocityCtr_FA_CA DINH_FId.DFC_ComVelocitySig_CA DINH_FId.DFC_ComVelocitySig_FA_CA DINH_FId.DFC_ComVelocityTo_CA DINH_FId.DFC_ComVelocityTo_FA_CA DINH_FId.DFC_ComVerbraucherTo_CA DINH_FId.DFC_ComWMomPTStabChk_FX_CA DINH_FId.DFC_ComWMomPTStabCtr_FX_CA DINH_FId.DFC_ComWMomPTStabTo_FX_CA DINH_FId.DFC_ComWheelSpeedSig_CA DINH_FId.DFC_ComWheelSpeedTo_CA DINH_FId.DFC_ComZvKlappenSig_CA DINH_FId.DFC_ComZvKlappenTo_CA DINH_FId.DFC_ComaDirectChk_FX_CA DINH_FId.DFC_ComaDirectCtr_FX_CA DINH_FId.DFC_ComaDirectTo_FX_CA DINH_FId.DFC_ComaSideChk_FX_CA DINH_FId.DFC_ComaSideCtr_FX_CA DINH_FId.DFC_ComaSideTo_FX_CA DINH_FId.DFC_Cy320SpiCom_CA DINH_FId.DFC_ETCtlDvtInrMax_CA DINH_FId.DFC_ETCtlDvtInrMin_CA DINH_FId.DFC_ETCtlDvtOutrMax_CA DINH_FId.DFC_ETCtlDvtOutrMin_CA DINH_FId.DFC_FBCqDvtMax_CA DINH_FId.DFC_FBCqDvtMin_CA DINH_FId.DFC_Fan4WinErr1_CA DINH_FId.DFC_Fan4WinErr2_CA DINH_FId.DFC_Fan4WinErr3_CA DINH_FId.DFC_Fan4WinErr4_CA DINH_FId.DFC_FanSCG_CA DINH_FId.DFC_FlFCBS_CA DINH_FId.DFC_GlwEcuConfigErr_CA DINH_FId.DFC_GlwEcuEepErr_CA DINH_FId.DFC_GlwEcuFrmErr_CA DINH_FId.DFC_GlwEcuGPCMFaultInfo_CA DINH_FId.DFC_GlwEcuGPCMInfo_CA DINH_FId.DFC_GlwEcuGk1HSS_CA DINH_FId.DFC_GlwEcuGk1OL_CA DINH_FId.DFC_GlwEcuGk1SC_CA DINH_FId.DFC_GlwEcuGk1Wdst_CA DINH_FId.DFC_GlwEcuGk2HSS_CA DINH_FId.DFC_GlwEcuGk2OL_CA DINH_FId.DFC_GlwEcuGk2SC_CA DINH_FId.DFC_GlwEcuGk2Wdst_CA DINH_FId.DFC_GlwEcuGk3HSS_CA DINH_FId.DFC_GlwEcuGk3OL_CA DINH_FId.DFC_GlwEcuGk3SC_CA DINH_FId.DFC_GlwEcuGk3Wdst_CA DINH_FId.DFC_GlwEcuGk4HSS_CA DINH_FId.DFC_GlwEcuGk4OL_CA DINH_FId.DFC_GlwEcuGk4SC_CA DINH_FId.DFC_GlwEcuGk4Wdst_CA DINH_FId.DFC_GlwEcuGk5HSS_CA DINH_FId.DFC_GlwEcuGk5OL_CA DINH_FId.DFC_GlwEcuGk5SC_CA DINH_FId.DFC_GlwEcuGk5Wdst_CA DINH_FId.DFC_GlwEcuGk6HSS_CA DINH_FId.DFC_GlwEcuGk6OL_CA DINH_FId.DFC_GlwEcuGk6SC_CA DINH_FId.DFC_GlwEcuGk6Wdst_CA DINH_FId.DFC_GlwEcuGndErr_CA DINH_FId.DFC_GlwEcuIntErr_CA DINH_FId.DFC_GlwEcuMsgTimeout_CA DINH_FId.DFC_GlwEcuT30Err_CA DINH_FId.DFC_GlwEcuTempErr_CA DINH_FId.DFC_GlwEcuUdiffT30_CA DINH_FId.DFC_IBSComErr_CA DINH_FId.DFC_LubSRCOilFldtCrit_CA DINH_FId.DFC_LubSRCOilFldtCritDflMin_CA DINH_FId.DFC_LubSRCOilLvlCritMax_CA DINH_FId.DFC_LubSRCOilLvlCritMin_CA DINH_FId.DFC_LubSRCTot_CA DINH_FId.DFC_MonUMaxSupply1_CA DINH_FId.DFC_MonUMinSupply1_CA DINH_FId.DFC_OilComNpl_CA DINH_FId.DFC_PCBS_CA DINH_FId.DFC_PCBSPFltChg_CA DINH_FId.DFC_PCRGovDvtLPMax_CA DINH_FId.DFC_PCRGovDvtLPMin_CA DINH_FId.DFC_PCRGovDvtMax_CA DINH_FId.DFC_PCRGovDvtMin_CA DINH_FId.DFC_PFltAPSPlausMAX_CA DINH_FId.DFC_PFltAPSPlausMIN_CA DINH_FId.DFC_PFltBPSPlausMAX_CA DINH_FId.DFC_PFltBPSPlausMIN_CA DINH_FId.DFC_PFltOvldInhRgn_CA DINH_FId.DFC_PFltOvldTrqLim_CA DINH_FId.DFC_PFltPresPlausMAX_CA DINH_FId.DFC_PFltPresPlausMIN_CA DINH_FId.DFC_PFltTraRpmRdc_CA DINH_FId.DFC_PFlt_tOxiPreMax_CA DINH_FId.DFC_PFlt_tOxiPreMaxRgn_CA DINH_FId.DFC_PFlt_tOxiPreNpl_CA DINH_FId.DFC_PFlt_tPreMax_CA DINH_FId.DFC_PFlt_tPreMaxRgn_CA DINH_FId.DFC_PFlt_tPreNpl_CA DINH_FId.DFC_PFltmSotDiffMAX_CA DINH_FId.DFC_PFltmSotDiffMIN_CA DINH_FId.DFC_PFltmSotDiffSIG_CA DINH_FId.DFC_PIntkVUsEnvPPls_CA DINH_FId.DFC_PresPlausDblDef_CA DINH_FId.DFC_RailCPC1_CA DINH_FId.DFC_RailCPC3_CA DINH_FId.DFC_RailCPC4_CA DINH_FId.DFC_RailMeUn0_CA DINH_FId.DFC_RailMeUn1_CA DINH_FId.DFC_RailMeUn2_CA DINH_FId.DFC_RailMeUn22_CA DINH_FId.DFC_RailMeUn3_CA DINH_FId.DFC_RailMeUn4_CA DINH_FId.DFC_RailMeUn42_CA DINH_FId.DFC_RailMeUn5_CA DINH_FId.DFC_RailPCV0_CA DINH_FId.DFC_RailPCV1_CA DINH_FId.DFC_RailPCV2_CA DINH_FId.DFC_RailPCV22_CA DINH_FId.DFC_RailPCV3_CA DINH_FId.DFC_RailPCV4_CA DINH_FId.DFC_RailPCV42_CA DINH_FId.DFC_RailPMonStrt_CA DINH_FId.DFC_SSpMon1_CA DINH_FId.DFC_SSpMon2_CA DINH_FId.DFC_SSpMon3_CA DINH_FId.DFC_ThrVlv4WinErr1_CA DINH_FId.DFC_ThrVlv4WinErr2_CA DINH_FId.DFC_ThrVlv4WinErr3_CA DINH_FId.DFC_ThrVlv4WinErr4_CA DINH_FId.DFC_ThrVlvSCG_CA DINH_FId.DFC_Tle6232Spi1_CA DINH_FId.DFC_TrbCh4WinErr1_CA DINH_FId.DFC_TrbCh4WinErr2_CA DINH_FId.DFC_TrbCh4WinErr3_CA DINH_FId.DFC_TrbCh4WinErr4_CA DINH_FId.DFC_TrbChSCG_CA DINH_FId.DFC_TrbChSRCMax_CA DINH_FId.DFC_TrbChSRCMin_CA DINH_FId.DFC_WaHtEl4WinErr1_CA DINH_FId.DFC_WaHtEl4WinErr2_CA DINH_FId.DFC_WaHtEl4WinErr3_CA DINH_FId.DFC_WaHtEl4WinErr4_CA DINH_FId.DFC_WaHtElSCG_CA DINH_FId.DFC_ETClbETFltMax_0_CA DINH_FId.DFC_ETClbETFltMax_1_CA DINH_FId.DFC_ETClbETFltMax_2_CA DINH_FId.DFC_ETClbETFltMax_3_CA DINH_FId.DFC_ETClbETFltMax_4_CA DINH_FId.DFC_ETClbETFltMax_5_CA DINH_FId.DFC_ETClbETFltMin_0_CA DINH_FId.DFC_ETClbETFltMin_1_CA DINH_FId.DFC_ETClbETFltMin_2_CA DINH_FId.DFC_ETClbETFltMin_3_CA DINH_FId.DFC_ETClbETFltMin_4_CA DINH_FId.DFC_ETClbETFltMin_5_CA DINH_FId.DFC_InjCrvInjLimChrgBal_CA DINH_FId.DFC_InjCrvInjLimQntBal_CA DINH_FId.DFC_InjCrvInjLimSys_CA DINH_FId.DFC_InjCrvNumInjRtmLim_CA DINH_FId.DFC_LSUHtCoupSig_CA DINH_FId.DFC_AFS_SSpShOffOL_CA DINH_FId.DFC_AFS_SSpShOffOvrTemp_CA DINH_FId.DFC_AFS_SSpShOffSCB_CA DINH_FId.DFC_AFS_SSpShOffSCG_CA DINH_FId.DFC_AirCCmprOL_CA DINH_FId.DFC_AirCCmprOvrTemp_CA DINH_FId.DFC_AirCCmprSCB_CA DINH_FId.DFC_AirCCmprSCG_CA DINH_FId.DFC_CByVlvOL_CA DINH_FId.DFC_CByVlvOvrTemp_CA DINH_FId.DFC_CByVlvSCB_CA DINH_FId.DFC_CByVlvSCG_CA DINH_FId.DFC_CThmstOL_CA DINH_FId.DFC_CThmstOvrTemp_CA DINH_FId.DFC_CThmstSCB_CA DINH_FId.DFC_CThmstSCG_CA DINH_FId.DFC_DSMDummy_CA DINH_FId.DFC_EBxFanOL_CA DINH_FId.DFC_EBxFanOvrTemp_CA DINH_FId.DFC_EBxFanSCB_CA DINH_FId.DFC_EBxFanSCG_CA DINH_FId.DFC_ECBVlvOL_CA DINH_FId.DFC_ECBVlvOvrTemp_CA DINH_FId.DFC_ECBVlvSCB_CA DINH_FId.DFC_ECBVlvSCG_CA DINH_FId.DFC_EMDmpOL_0_CA DINH_FId.DFC_EMDmpOL_1_CA DINH_FId.DFC_EMDmpOvrTemp_0_CA DINH_FId.DFC_EMDmpOvrTemp_1_CA DINH_FId.DFC_EMDmpSCB_0_CA DINH_FId.DFC_EMDmpSCB_1_CA DINH_FId.DFC_EMDmpSCG_0_CA DINH_FId.DFC_EMDmpSCG_1_CA DINH_FId.DFC_EngStAOL_CA DINH_FId.DFC_EngStAOvrTemp_CA DINH_FId.DFC_EngStASCB_CA DINH_FId.DFC_EngStASCG_CA DINH_FId.DFC_FanOL_CA DINH_FId.DFC_FanOvrTemp_CA DINH_FId.DFC_FanSCB_CA DINH_FId.DFC_FlFltHtOL_CA DINH_FId.DFC_FlFltHtOvrTemp_CA DINH_FId.DFC_FlFltHtSCB_CA DINH_FId.DFC_FlFltHtSCG_CA DINH_FId.DFC_LSUHtrMax_CA DINH_FId.DFC_LSUHtrMin_CA DINH_FId.DFC_LSUHtrNpl_CA DINH_FId.DFC_LSUHtrSig_CA DINH_FId.DFC_LSUtExcMax_CA DINH_FId.DFC_LSUtExcMin_CA DINH_FId.DFC_MeUnOL_CA DINH_FId.DFC_MeUnSCB_CA DINH_FId.DFC_MeUnSRCMax_CA DINH_FId.DFC_MeUnSRCMin_CA DINH_FId.DFC_PCVOL_CA DINH_FId.DFC_PCVSCB_CA DINH_FId.DFC_PCVSRCMax_CA DINH_FId.DFC_PCVSRCMin_CA DINH_FId.DFC_RailPSRCMax_CA DINH_FId.DFC_RailPSRCMin_CA DINH_FId.DFC_ShtrOL_CA DINH_FId.DFC_ShtrOvrTemp_CA DINH_FId.DFC_ShtrSCB_CA DINH_FId.DFC_ShtrSCG_CA DINH_FId.DFC_StrtOL_CA DINH_FId.DFC_StrtOvrTemp_CA DINH_FId.DFC_StrtSCB_CA DINH_FId.DFC_StrtSCG_CA DINH_FId.DFC_ThrVlvOL_CA DINH_FId.DFC_ThrVlvOvrTemp_CA DINH_FId.DFC_ThrVlvSCB_CA DINH_FId.DFC_TrbChOL_CA DINH_FId.DFC_TrbChOvrTemp_CA DINH_FId.DFC_TrbChSCB_CA DINH_FId.DFC_UDosVlvOL_CA DINH_FId.DFC_UDosVlvOvrTemp_CA DINH_FId.DFC_UDosVlvSCB_CA DINH_FId.DFC_UDosVlvSCG_CA DINH_FId.DFC_UPmpMotOL_CA DINH_FId.DFC_UPmpMotOvrTemp_CA DINH_FId.DFC_UPmpMotSCB_CA DINH_FId.DFC_UPmpMotSCG_CA DINH_FId.DFC_WaHtElOL_CA DINH_FId.DFC_WaHtElOvrTemp_CA DINH_FId.DFC_WaHtElSCB_CA DINH_FId.DFC_IVActrUChSRCMax_CA DINH_FId.DFC_IVActrUChSRCMin_CA DINH_FId.DFC_IVActrVltgSRCMax_CA DINH_FId.DFC_IVActrVltgSRCMin_CA DINH_FId.DFC_IVDiaTunDet_CA DINH_FId.DFC_IVPSplyStopDCDC_CA DINH_FId.DFC_IVPSplyVltgSRCMax_CA DINH_FId.DFC_IVPSplyVltgSRCMin_CA DINH_FId.DFC_SCREtaErr_CA DINH_FId.DFC_SCREtaErr1_CA DINH_FId.DFC_SCREtaErr2_CA DINH_FId.DFC_SCRMonMetCtlPresErr_CA DINH_FId.DFC_SCRMonPresBuildUpErr_CA DINH_FId.DFC_SCRMonPresRdcErr_CA DINH_FId.DFC_AFSOffsDrftMax_CA DINH_FId.DFC_AFSOffsDrftMin_CA DINH_FId.DFC_AFSSRCCorMax_CA DINH_FId.DFC_AFSSRCCorMin_CA DINH_FId.DFC_AFSSRCRawMax_CA DINH_FId.DFC_AFSSRCRawMin_CA DINH_FId.DFC_AFSSetyDrftMax_CA DINH_FId.DFC_AFSSetyDrftMin_CA DINH_FId.DFC_AirCSwtNpl_CA DINH_FId.DFC_AirCSwtSig_CA DINH_FId.DFC_BattUSRCMax_CA DINH_FId.DFC_BattUSRCMin_CA DINH_FId.DFC_BrkNpl_CA DINH_FId.DFC_BrkPSRCMax_CA DINH_FId.DFC_BrkPSRCMin_CA DINH_FId.DFC_CEngDsTSRCMax_CA DINH_FId.DFC_CEngDsTSRCMin_CA DINH_FId.DFC_CrCUIDet_CA DINH_FId.DFC_ECBVlvSRCMax_CA DINH_FId.DFC_ECBVlvSRCMin_CA DINH_FId.DFC_ECUOvrTemp_CA DINH_FId.DFC_EGRVlvGovDvtMax_CA DINH_FId.DFC_EGRVlvGovDvtMin_CA DINH_FId.DFC_EGRVlvHBrgOpnLd_CA DINH_FId.DFC_EGRVlvHBrgOvrCurr_CA DINH_FId.DFC_EGRVlvHBrgOvrTemp_CA DINH_FId.DFC_EGRVlvHBrgShCirBatt1_CA DINH_FId.DFC_EGRVlvHBrgShCirBatt2_CA DINH_FId.DFC_EGRVlvHBrgShCirGnd1_CA DINH_FId.DFC_EGRVlvHBrgShCirGnd2_CA DINH_FId.DFC_EGRVlvHBrgShCirOvrLd_CA DINH_FId.DFC_EGRVlvHBrgTempOvrCurr_CA DINH_FId.DFC_EGRVlvHBrgUndrVltg_CA DINH_FId.DFC_EGRVlvLPGovDvtMax_CA DINH_FId.DFC_EGRVlvLPGovDvtMin_CA DINH_FId.DFC_EGRVlvLPHBrgOpnLd_CA DINH_FId.DFC_EGRVlvLPHBrgOvrCurr_CA DINH_FId.DFC_EGRVlvLPHBrgOvrTemp_CA DINH_FId.DFC_EGRVlvLPHBrgShCirBatt1_CA DINH_FId.DFC_EGRVlvLPHBrgShCirBatt2_CA DINH_FId.DFC_EGRVlvLPHBrgShCirGnd1_CA DINH_FId.DFC_EGRVlvLPHBrgShCirGnd2_CA DINH_FId.DFC_EGRVlvLPHBrgShCirOvrLd_CA DINH_FId.DFC_EGRVlvLPHBrgTempOvrCurr_CA DINH_FId.DFC_EGRVlvLPHBrgUndrVltg_CA DINH_FId.DFC_EGRVlvLPOL_CA DINH_FId.DFC_EGRVlvLPSCB_CA DINH_FId.DFC_EGRVlvLPSCG_CA DINH_FId.DFC_EGRVlvLPSRCMax_CA DINH_FId.DFC_EGRVlvLPSRCMin_CA DINH_FId.DFC_EGRVlvOL_CA DINH_FId.DFC_EGRVlvSCB_CA DINH_FId.DFC_EGRVlvSCG_CA DINH_FId.DFC_EGRVlvSRCMax_CA DINH_FId.DFC_EGRVlvSRCMin_CA DINH_FId.DFC_EngPrtOvrSpd_CA DINH_FId.DFC_EngSpdOL_CA DINH_FId.DFC_EngSpdSCB_CA DINH_FId.DFC_EngSpdSCG_CA DINH_FId.DFC_EnhSRCMaxPPFltDiff_CA DINH_FId.DFC_EnhSRCMaxT1ExhTMon_CA DINH_FId.DFC_EnhSRCMaxT2ExhTMon_CA DINH_FId.DFC_EnhSRCMaxT3ExhTMon_CA DINH_FId.DFC_EnhSRCMinPPFltDiff_CA DINH_FId.DFC_EnhSRCMinT1ExhTMon_CA DINH_FId.DFC_EnhSRCMinT2ExhTMon_CA DINH_FId.DFC_EnhSRCMinT3ExhTMon_CA DINH_FId.DFC_EnvPSRCMax_CA DINH_FId.DFC_EnvPSRCMin_CA DINH_FId.DFC_ExhTMonPlaus_CA DINH_FId.DFC_ExhTMonPlausPos1_CA DINH_FId.DFC_ExhTMonPlausPos2_CA DINH_FId.DFC_ExhTMonPlausPos3_CA DINH_FId.DFC_ExhTMonT1Plaus_CA DINH_FId.DFC_ExhTMonT2Plaus_CA DINH_FId.DFC_ExhTMonT3Plaus_CA DINH_FId.DFC_FlFltDsPSRCMax_CA DINH_FId.DFC_FlFltDsPSRCMin_CA DINH_FId.DFC_FlFltSig_CA DINH_FId.DFC_FlFltUsPSRCMax_CA DINH_FId.DFC_FlFltUsPSRCMin_CA DINH_FId.DFC_FuelTSRCMax_CA DINH_FId.DFC_FuelTSRCMin_CA DINH_FId.DFC_GbxNPosPPerSRCMax_CA DINH_FId.DFC_GbxNPosPPerSRCMin_CA DINH_FId.DFC_GbxNPosPdcycSRCMax_CA DINH_FId.DFC_GbxNPosPdcycSRCMin_CA DINH_FId.DFC_InjVlvPresMin_CA DINH_FId.DFC_LSUCircNernstSig_CA DINH_FId.DFC_LSUCircPmpCurSig_CA DINH_FId.DFC_LSUCircVirtGndSig_CA DINH_FId.DFC_LSUO2Max_CA DINH_FId.DFC_LSUO2Min_CA DINH_FId.DFC_LSUSPIBattLowMin_CA DINH_FId.DFC_LSUWireSCB_CA DINH_FId.DFC_LSUWireSCG_CA DINH_FId.DFC_MeUnSCG_CA DINH_FId.DFC_NSCDsCmpChk_CA DINH_FId.DFC_NSCDsLamBinSRCMax_CA DINH_FId.DFC_NSCDsLamBinSRCMin_CA DINH_FId.DFC_NSCDsLamLinSRCMax_CA DINH_FId.DFC_NSCDsLamLinSRCMin_CA /end DEF_CHARACTERISTIC
 /begin OUT_MEASUREMENT DINH_stFId.FId_RailPMonStrt DINH_stFId.FId_RailPSS DINH_stFId.FId_RailPSubsVal DINH_stFId.FId_RailSetPointLim DINH_stFId.FId_RailSetPointRed DINH_stFId.FId_RailSetPointVehCor DINH_stFId.FId_ReFl DINH_stFId.FId_ReplValTPFltUs DINH_stFId.FId_RplValAbsUPmpP DINH_stFId.FId_RplValCANAbsUPmpP DINH_stFId.FId_RplValCANUCatUsT DINH_stFId.FId_RplValPPFltDiff DINH_stFId.FId_RplValPPFltUs DINH_stFId.FId_RplValTOxiCatUs DINH_stFId.FId_RplValTTrbnUs DINH_stFId.FId_RplValUCatUsT DINH_stFId.FId_RplValUTnkLvl DINH_stFId.FId_SCRChkNOxEff DINH_stFId.FId_SCRPODPresBuildUp DINH_stFId.FId_SRCFlwRstn DINH_stFId.FId_SSMonFlFltDsP DINH_stFId.FId_SSMonFlFltUsP DINH_stFId.FId_SSPIntkVUs DINH_stFId.FId_SSTOxiCatUs DINH_stFId.FId_SSTPFltUs DINH_stFId.FId_SSUCatUsT DINH_stFId.FId_SSUPmpP DINH_stFId.FId_SSUTnkT DINH_stFId.FId_SensAdapTPFltUs DINH_stFId.FId_StAPmpEna DINH_stFId.FId_StBy DINH_stFId.FId_SubsValPrtTrqDfftl DINH_stFId.FId_SubsValRatTrqDfftl DINH_stFId.FId_T15 DINH_stFId.FId_T50Sig DINH_stFId.FId_TAA DINH_stFId.FId_TAFSFrzVal DINH_stFId.FId_TAFSReplVal DINH_stFId.FId_TAFSSRC DINH_stFId.FId_TCACDsCANFrzVal DINH_stFId.FId_TCACDsCANRplVal DINH_stFId.FId_TCACDsFrzVal DINH_stFId.FId_TCACDsModel DINH_stFId.FId_TCACDsRplVal DINH_stFId.FId_TCACDsSS DINH_stFId.FId_TCPrtChrgPmpCtl DINH_stFId.FId_TCPrtChrgPmpGov DINH_stFId.FId_TCPrtChrgPmpHLSDem DINH_stFId.FId_TCPrt_ChrgPmpDet DINH_stFId.FId_TCPrtnSetTSC DINH_stFId.FId_TCSRmpShOff DINH_stFId.FId_TCSShOff DINH_stFId.FId_TECUFrzVal DINH_stFId.FId_TECURplVal DINH_stFId.FId_TOxiCatUs DINH_stFId.FId_TempSensFrzPPFltUs DINH_stFId.FId_TempWait DINH_stFId.FId_ThrVlvFrzVal DINH_stFId.FId_ThrVlvMon DINH_stFId.FId_ThrVlvRplVal DINH_stFId.FId_ThrVlvSS DINH_stFId.FId_TraAddAirCANPtd DINH_stFId.FId_TraAddClntCANPtd DINH_stFId.FId_TraDrvAway DINH_stFId.FId_TraDrvAwayInactiv DINH_stFId.FId_TraGearInfoDet DINH_stFId.FId_TraGearInfoInfoCan DINH_stFId.FId_TraGearInfoLevPos DINH_stFId.FId_TraGearInfoLoRng DINH_stFId.FId_TraGearInfoRTra DINH_stFId.FId_TraGearInfoRevGear DINH_stFId.FId_TraNmin DINH_stFId.FId_TraOilTemp DINH_stFId.FId_TraPrtGearCANPtd DINH_stFId.FId_TraRtnIntfcASTIntv DINH_stFId.FId_TraRtnIntfcIdlSetP DINH_stFId.FId_TraSlip DINH_stFId.FId_TraSpaCAN DINH_stFId.FId_TraSpaEngSpd DINH_stFId.FId_TraSpaVehV DINH_stFId.FId_TraTrqLimErr DINH_stFId.FId_TraTrqLos DINH_stFId.FId_TraTrqRedLmpHmeDec DINH_stFId.FId_TraTrqRedLmpHmeInc DINH_stFId.FId_TraTrqRedPlausDecIntv DINH_stFId.FId_TraTrqRedPlausIncIntv DINH_stFId.FId_TrbChPWMIn DINH_stFId.FId_UHCMonUHtrPL DINH_stFId.FId_UHCMonUHtrTnk DINH_stFId.FId_UHtrPLFrzValDia DINH_stFId.FId_UHtrPLRplValDia DINH_stFId.FId_UHtrPLSSDia DINH_stFId.FId_UHtrTnkFrzValDia DINH_stFId.FId_UHtrTnkRplValDia DINH_stFId.FId_UHtrTnkSSDia DINH_stFId.FId_UTnkLvlSensTst DINH_stFId.FId_UTnkTFrzVal DINH_stFId.FId_UTnkTFrzValCAN DINH_stFId.FId_UTnkTRplVal DINH_stFId.FId_UTnkTRplValCAN DINH_stFId.FId_VMDTrqWhl DINH_stFId.FId_VSwCtl DINH_stFId.FId_VSwCtlVehCorr DINH_stFId.FId_VSwVlvFrzVal DINH_stFId.FId_VSwVlvGovOn DINH_stFId.FId_VSwVlvJamVlv DINH_stFId.FId_VSwVlvOfsLrnInhib DINH_stFId.FId_VSwVlvRplVal DINH_stFId.FId_VSwVlvSS DINH_stFId.FId_VSwVlvSpgDiagInhib DINH_stFId.FId_VehVReplVal DINH_stFId.FId_Vtln DINH_stFId.FId_ZFCClbActv DINH_stFId.FId_ZFCCldCmbCham DINH_stFId.FId_stAVSCoESLSU DINH_stFId.Fid_ComnTSC DINH_stFId.Fid_CustDiag_DiaDem_AT DINH_stFId.Fid_CustDiag_DiaDem_MT DINH_stFId.Fid_HLSDemHDC DINH_stFId.Fid_IVActrTempRplVal DINH_stFId.Fid_StSysStrtTipGbxDat DINH_stFId.Fid_TraCanNeutral DINH_stFId.Fid_WaHtShOffErr /end OUT_MEASUREMENT
 /begin LOC_MEASUREMENT DINH_stClctFId_mp DINH_xFIDObsvInh_mp DINH_xFIDObsvRls_mp /end LOC_MEASUREMENT
/end FUNCTION
/begin COMPU_METHOD DFCDSQ_Verb "" TAB_VERB "%2.1" "-" COMPU_TAB_REF DFCDSQ_Verb /end COMPU_METHOD
/begin COMPU_VTAB DFCDSQ_Verb "" TAB_VERB 1214 0 "NoInhibit" 1 "DFC_ACCIPlausDrvAst" 2 "DFC_ACCIPlausTrqDes" 3 "DFC_AirCtlGovDvtEOMMax" 4 "DFC_AirCtlGovDvtEOMMin" 5 "DFC_AirCtlGovDvtMax" 6 "DFC_AirCtlGovDvtMin" 7 "DFC_AirCtlGovLPDvtMax" 8 "DFC_AirCtlGovLPDvtMin" 9 "DFC_AltIOComErr" 10 "DFC_AltIOComNpl" 11 "DFC_BusDiagBusOffFlexRay" 12 "DFC_BusDiagBusOffNodeA" 13 "DFC_BusDiagBusOffNodeB" 14 "DFC_BusDiagBusOffNodeC" 15 "DFC_BusDiagHwFlexRay" 16 "DFC_Cj945SpiCom1" 17 "DFC_ComACDemandSig_FA" 18 "DFC_ComACDemandTo_FA" 19 "DFC_ComATempSig_FA" 20 "DFC_ComATempTo_FA" 21 "DFC_ComATempTo_FX" 22 "DFC_ComBrkTrqSumChk_FX" 23 "DFC_ComBrkTrqSumCtr_FX" 24 "DFC_ComBrkTrqSumTo_FX" 25 "DFC_ComBtnDrvDynChk_FX" 26 "DFC_ComBtnDrvDynCtr_FX" 27 "DFC_ComBtnDrvDynTo_FX" 28 "DFC_ComButtonMSASig" 29 "DFC_ComButtonMSATo" 30 "DFC_ComCodierungPwrmngSig" 31 "DFC_ComCodierungPwrmngSig_FA" 32 "DFC_ComCrCtlLvrChk" 33 "DFC_ComCrCtlLvrCtr" 34 "DFC_ComCrCtlLvrSig" 35 "DFC_ComCrCtlLvrTo" 36 "DFC_ComCtrCrshSwoEkpSig_FA" 37 "DFC_ComCtrCrshSwoEkpTo_FA" 38 "DFC_ComCtrSecInt" 39 "DFC_ComDiaOBDGbxSig_A" 40 "DFC_ComDiaOBDGbxTo_A" 41 "DFC_ComFahrzeugtypSig" 42 "DFC_ComFahrzeugtypSig_FA" 43 "DFC_ComFllupGpwsupSig_FA" 44 "DFC_ComFllupGpwsupTo_FA" 45 "DFC_ComGbxDataChk_A" 46 "DFC_ComGbxDataChk_FA" 47 "DFC_ComGbxDataCtr_A" 48 "DFC_ComGbxDataCtr_FA" 49 "DFC_ComGbxDataSig_A" 50 "DFC_ComGbxDataSig_FA" 51 "DFC_ComGbxDataTo_A" 52 "DFC_ComGbxDataTo_FA" 53 "DFC_ComKlemmenChk_FA" 54 "DFC_ComKlemmenCtr_FA" 55 "DFC_ComKlemmenSig_FA" 56 "DFC_ComKlemmenTo_FA" 57 "DFC_ComLenkradwinkelSig" 58 "DFC_ComLenkradwinkelTo" 59 "DFC_ComMileageRangeSig_FA" 60 "DFC_ComMileageRangeTo_FA" 61 "DFC_ComPspSig" 62 "DFC_ComPspTo" 63 "DFC_ComRelTimeSig_FA" 64 "DFC_ComRelTimeTo_FA" 65 "DFC_ComRequestEMFChk" 66 "DFC_ComRequestEMFCtr" 67 "DFC_ComRequestEMFSig" 68 "DFC_ComRequestEMFTo" 69 "DFC_ComRpmWhlChk_FX" 70 "DFC_ComRpmWhlCtr_FX" 71 "DFC_ComRpmWhlTo_FX" 72 "DFC_ComSecCtrRelSig_FA" 73 "DFC_ComSecCtrRelTo_FA" 74 "DFC_ComSensNOxGndSig" 75 "DFC_ComSensNOxGndTo" 76 "DFC_ComSensNOxMode" 77 "DFC_ComSensNOxUbattSig" 78 "DFC_ComSensNOxUbattTo" 79 "DFC_ComShiftPaddleTo_FX" 80 "DFC_ComShutOffPSPSig" 81 "DFC_ComShutOffPSPTo" 82 "DFC_ComSlrdiGlbFZMTo_FA" 83 "DFC_ComSlrdiGlbFZMTo_FX" 84 "DFC_ComSpeedVehicleChk_FX" 85 "DFC_ComSpeedVehicleCtr_FX" 86 "DFC_ComSpeedVehicleTo_FX" 87 "DFC_ComStConintDSCChk_FX" 88 "DFC_ComStConintDSCCtr_FX" 89 "DFC_ComStConintDSCTo_FX" 90 "DFC_ComStatACFrontSig_FA" 91 "DFC_ComStatACFrontTo_FA" 92 "DFC_ComStatEkpSig_A" 93 "DFC_ComStatEkpTo_A" 94 "DFC_ComStatGearRevSig_FA" 95 "DFC_ComStatGearRevTo_FA" 96 "DFC_ComStatZVKlappenSig_FA" 97 "DFC_ComStatZVKlappenTo_FA" 98 "DFC_ComStateARSCtr" 99 "DFC_ComStateARSSig" 100 "DFC_ComStateARSTo" 101 "DFC_ComStateDscSig" 102 "DFC_ComStateDscTo" 103 "DFC_ComStateSeatSig" 104 "DFC_ComStateSeatSig_FA" 105 "DFC_ComStateSeatTo" 106 "DFC_ComStateSeatTo_FA" 107 "DFC_ComStatusEGSSig_A" 108 "DFC_ComStatusEGSSig_FA" 109 "DFC_ComStatusEGSTo_A" 110 "DFC_ComStatusEGSTo_FA" 111 "DFC_ComStatusEMFChk" 112 "DFC_ComStatusEMFCtr" 113 "DFC_ComStatusEMFSig" 114 "DFC_ComStatusEMFTo" 115 "DFC_ComStatusRGangSig" 116 "DFC_ComStatusRGangTo" 117 "DFC_ComSteeringAngleChk_FX" 118 "DFC_ComSteeringAngleCtr_FX" 119 "DFC_ComSteeringAngleTo_FX" 120 "DFC_ComTerminalChk" 121 "DFC_ComTerminalCtr" 122 "DFC_ComTerminalSig" 123 "DFC_ComTerminalTo" 124 "DFC_ComTimeDateSig_FA" 125 "DFC_ComTimeDateTo_FA" 126 "DFC_ComTrailerSig" 127 "DFC_ComTrailerSig_FA" 128 "DFC_ComTrailerTo" 129 "DFC_ComTrailerTo_FA" 130 "DFC_ComTrqDemCrshDrDyChk_FX" 131 "DFC_ComTrqDemCrshDrDyCtr_FX" 132 "DFC_ComTrqDemCrshDrDyTo_FX" 133 "DFC_ComTrqDemandDesSig" 134 "DFC_ComTrqDemandDesTo" 135 "DFC_ComTrqDemandDscChk" 136 "DFC_ComTrqDemandDscCtr" 137 "DFC_ComTrqDemandDscSig" 138 "DFC_ComTrqDemandDscTo" 139 "DFC_ComTrqDemandGbxChk_A" 140 "DFC_ComTrqDemandGbxChk_FA" 141 "DFC_ComTrqDemandGbxCtr_A" 142 "DFC_ComTrqDemandGbxCtr_FA" 143 "DFC_ComTrqDemandGbxSig_A" 144 "DFC_ComTrqDemandGbxSig_FA" 145 "DFC_ComTrqDemandGbxTo_A" 146 "DFC_ComTrqDemandGbxTo_FA" 147 "DFC_ComTrqWhlDemChk" 148 "DFC_ComTrqWhlDemCtr" 149 "DFC_ComTrqWhlDemFASChk_FX" 150 "DFC_ComTrqWhlDemFASCtr_FX" 151 "DFC_ComTrqWhlDemFASTo_FX" 152 "DFC_ComTrqWhlDemSig" 153 "DFC_ComTrqWhlDemTo" 154 "DFC_ComVelocityChk_FA" 155 "DFC_ComVelocityCtr_FA" 156 "DFC_ComVelocitySig" 157 "DFC_ComVelocitySig_FA" 158 "DFC_ComVelocityTo" 159 "DFC_ComVelocityTo_FA" 160 "DFC_ComVerbraucherTo" 161 "DFC_ComWMomPTStabChk_FX" 162 "DFC_ComWMomPTStabCtr_FX" 163 "DFC_ComWMomPTStabTo_FX" 164 "DFC_ComWheelSpeedSig" 165 "DFC_ComWheelSpeedTo" 166 "DFC_ComZvKlappenSig" 167 "DFC_ComZvKlappenTo" 168 "DFC_ComaDirectChk_FX" 169 "DFC_ComaDirectCtr_FX" 170 "DFC_ComaDirectTo_FX" 171 "DFC_ComaSideChk_FX" 172 "DFC_ComaSideCtr_FX" 173 "DFC_ComaSideTo_FX" 174 "DFC_Cy320SpiCom" 175 "DFC_ETCtlDvtInrMax" 176 "DFC_ETCtlDvtInrMin" 177 "DFC_ETCtlDvtOutrMax" 178 "DFC_ETCtlDvtOutrMin" 179 "DFC_FBCqDvtMax" 180 "DFC_FBCqDvtMin" 181 "DFC_Fan4WinErr1" 182 "DFC_Fan4WinErr2" 183 "DFC_Fan4WinErr3" 184 "DFC_Fan4WinErr4" 185 "DFC_FanSCG" 186 "DFC_FlFCBS" 187 "DFC_GlwEcuConfigErr" 188 "DFC_GlwEcuEepErr" 189 "DFC_GlwEcuFrmErr" 190 "DFC_GlwEcuGPCMFaultInfo" 191 "DFC_GlwEcuGPCMInfo" 192 "DFC_GlwEcuGk1HSS" 193 "DFC_GlwEcuGk1OL" 194 "DFC_GlwEcuGk1SC" 195 "DFC_GlwEcuGk1Wdst" 196 "DFC_GlwEcuGk2HSS" 197 "DFC_GlwEcuGk2OL" 198 "DFC_GlwEcuGk2SC" 199 "DFC_GlwEcuGk2Wdst" 200 "DFC_GlwEcuGk3HSS" 201 "DFC_GlwEcuGk3OL" 202 "DFC_GlwEcuGk3SC" 203 "DFC_GlwEcuGk3Wdst" 204 "DFC_GlwEcuGk4HSS" 205 "DFC_GlwEcuGk4OL" 206 "DFC_GlwEcuGk4SC" 207 "DFC_GlwEcuGk4Wdst" 208 "DFC_GlwEcuGk5HSS" 209 "DFC_GlwEcuGk5OL" 210 "DFC_GlwEcuGk5SC" 211 "DFC_GlwEcuGk5Wdst" 212 "DFC_GlwEcuGk6HSS" 213 "DFC_GlwEcuGk6OL" 214 "DFC_GlwEcuGk6SC" 215 "DFC_GlwEcuGk6Wdst" 216 "DFC_GlwEcuGndErr" 217 "DFC_GlwEcuIntErr" 218 "DFC_GlwEcuMsgTimeout" 219 "DFC_GlwEcuT30Err" 220 "DFC_GlwEcuTempErr" 221 "DFC_GlwEcuUdiffT30" 222 "DFC_IBSComErr" 223 "DFC_LubSRCOilFldtCrit" 224 "DFC_LubSRCOilFldtCritDflMin" 225 "DFC_LubSRCOilLvlCritMax" 226 "DFC_LubSRCOilLvlCritMin" 227 "DFC_LubSRCTot" 228 "DFC_MonUMaxSupply1" 229 "DFC_MonUMinSupply1" 230 "DFC_OilComNpl" 231 "DFC_PCBS" 232 "DFC_PCBSPFltChg" 233 "DFC_PCRGovDvtLPMax" 234 "DFC_PCRGovDvtLPMin" 235 "DFC_PCRGovDvtMax" 236 "DFC_PCRGovDvtMin" 237 "DFC_PFltAPSPlausMAX" 238 "DFC_PFltAPSPlausMIN" 239 "DFC_PFltBPSPlausMAX" 240 "DFC_PFltBPSPlausMIN" 241 "DFC_PFltOvldInhRgn" 242 "DFC_PFltOvldTrqLim" 243 "DFC_PFltPresPlausMAX" 244 "DFC_PFltPresPlausMIN" 245 "DFC_PFltTraRpmRdc" 246 "DFC_PFlt_tOxiPreMax" 247 "DFC_PFlt_tOxiPreMaxRgn" 248 "DFC_PFlt_tOxiPreNpl" 249 "DFC_PFlt_tPreMax" 250 "DFC_PFlt_tPreMaxRgn" 251 "DFC_PFlt_tPreNpl" 252 "DFC_PFltmSotDiffMAX" 253 "DFC_PFltmSotDiffMIN" 254 "DFC_PFltmSotDiffSIG" 255 "DFC_PIntkVUsEnvPPls" 256 "DFC_PresPlausDblDef" 257 "DFC_RailCPC1" 258 "DFC_RailCPC3" 259 "DFC_RailCPC4" 260 "DFC_RailMeUn0" 261 "DFC_RailMeUn1" 262 "DFC_RailMeUn2" 263 "DFC_RailMeUn22" 264 "DFC_RailMeUn3" 265 "DFC_RailMeUn4" 266 "DFC_RailMeUn42" 267 "DFC_RailMeUn5" 268 "DFC_RailPCV0" 269 "DFC_RailPCV1" 270 "DFC_RailPCV2" 271 "DFC_RailPCV22" 272 "DFC_RailPCV3" 273 "DFC_RailPCV4" 274 "DFC_RailPCV42" 275 "DFC_RailPMonStrt" 276 "DFC_SSpMon1" 277 "DFC_SSpMon2" 278 "DFC_SSpMon3" 279 "DFC_ThrVlv4WinErr1" 280 "DFC_ThrVlv4WinErr2" 281 "DFC_ThrVlv4WinErr3" 282 "DFC_ThrVlv4WinErr4" 283 "DFC_ThrVlvSCG" 284 "DFC_Tle6232Spi1" 285 "DFC_TrbCh4WinErr1" 286 "DFC_TrbCh4WinErr2" 287 "DFC_TrbCh4WinErr3" 288 "DFC_TrbCh4WinErr4" 289 "DFC_TrbChSCG" 290 "DFC_TrbChSRCMax" 291 "DFC_TrbChSRCMin" 292 "DFC_WaHtEl4WinErr1" 293 "DFC_WaHtEl4WinErr2" 294 "DFC_WaHtEl4WinErr3" 295 "DFC_WaHtEl4WinErr4" 296 "DFC_WaHtElSCG" 297 "DFC_ETClbETFltMax_0" 298 "DFC_ETClbETFltMax_1" 299 "DFC_ETClbETFltMax_2" 300 "DFC_ETClbETFltMax_3" 301 "DFC_ETClbETFltMax_4" 302 "DFC_ETClbETFltMax_5" 303 "DFC_ETClbETFltMin_0" 304 "DFC_ETClbETFltMin_1" 305 "DFC_ETClbETFltMin_2" 306 "DFC_ETClbETFltMin_3" 307 "DFC_ETClbETFltMin_4" 308 "DFC_ETClbETFltMin_5" 309 "DFC_InjCrvInjLimChrgBal" 310 "DFC_InjCrvInjLimQntBal" 311 "DFC_InjCrvInjLimSys" 312 "DFC_InjCrvNumInjRtmLim" 313 "DFC_LSUHtCoupSig" 314 "DFC_AFS_SSpShOffOL" 315 "DFC_AFS_SSpShOffOvrTemp" 316 "DFC_AFS_SSpShOffSCB" 317 "DFC_AFS_SSpShOffSCG" 318 "DFC_AirCCmprOL" 319 "DFC_AirCCmprOvrTemp" 320 "DFC_AirCCmprSCB" 321 "DFC_AirCCmprSCG" 322 "DFC_CByVlvOL" 323 "DFC_CByVlvOvrTemp" 324 "DFC_CByVlvSCB" 325 "DFC_CByVlvSCG" 326 "DFC_CThmstOL" 327 "DFC_CThmstOvrTemp" 328 "DFC_CThmstSCB" 329 "DFC_CThmstSCG" 330 "DFC_DSMDummy" 331 "DFC_EBxFanOL" 332 "DFC_EBxFanOvrTemp" 333 "DFC_EBxFanSCB" 334 "DFC_EBxFanSCG" 335 "DFC_ECBVlvOL" 336 "DFC_ECBVlvOvrTemp" 337 "DFC_ECBVlvSCB" 338 "DFC_ECBVlvSCG" 339 "DFC_EMDmpOL_0" 340 "DFC_EMDmpOL_1" 341 "DFC_EMDmpOvrTemp_0" 342 "DFC_EMDmpOvrTemp_1" 343 "DFC_EMDmpSCB_0" 344 "DFC_EMDmpSCB_1" 345 "DFC_EMDmpSCG_0" 346 "DFC_EMDmpSCG_1" 347 "DFC_EngStAOL" 348 "DFC_EngStAOvrTemp" 349 "DFC_EngStASCB" 350 "DFC_EngStASCG" 351 "DFC_FanOL" 352 "DFC_FanOvrTemp" 353 "DFC_FanSCB" 354 "DFC_FlFltHtOL" 355 "DFC_FlFltHtOvrTemp" 356 "DFC_FlFltHtSCB" 357 "DFC_FlFltHtSCG" 358 "DFC_LSUHtrMax" 359 "DFC_LSUHtrMin" 360 "DFC_LSUHtrNpl" 361 "DFC_LSUHtrSig" 362 "DFC_LSUtExcMax" 363 "DFC_LSUtExcMin" 364 "DFC_MeUnOL" 365 "DFC_MeUnSCB" 366 "DFC_MeUnSRCMax" 367 "DFC_MeUnSRCMin" 368 "DFC_PCVOL" 369 "DFC_PCVSCB" 370 "DFC_PCVSRCMax" 371 "DFC_PCVSRCMin" 372 "DFC_RailPSRCMax" 373 "DFC_RailPSRCMin" 374 "DFC_ShtrOL" 375 "DFC_ShtrOvrTemp" 376 "DFC_ShtrSCB" 377 "DFC_ShtrSCG" 378 "DFC_StrtOL" 379 "DFC_StrtOvrTemp" 380 "DFC_StrtSCB" 381 "DFC_StrtSCG" 382 "DFC_ThrVlvOL" 383 "DFC_ThrVlvOvrTemp" 384 "DFC_ThrVlvSCB" 385 "DFC_TrbChOL" 386 "DFC_TrbChOvrTemp" 387 "DFC_TrbChSCB" 388 "DFC_UDosVlvOL" 389 "DFC_UDosVlvOvrTemp" 390 "DFC_UDosVlvSCB" 391 "DFC_UDosVlvSCG" 392 "DFC_UPmpMotOL" 393 "DFC_UPmpMotOvrTemp" 394 "DFC_UPmpMotSCB" 395 "DFC_UPmpMotSCG" 396 "DFC_WaHtElOL" 397 "DFC_WaHtElOvrTemp" 398 "DFC_WaHtElSCB" 399 "DFC_IVActrUChSRCMax" 400 "DFC_IVActrUChSRCMin" 401 "DFC_IVActrVltgSRCMax" 402 "DFC_IVActrVltgSRCMin" 403 "DFC_IVDiaTunDet" 404 "DFC_IVPSplyStopDCDC" 405 "DFC_IVPSplyVltgSRCMax" 406 "DFC_IVPSplyVltgSRCMin" 407 "DFC_SCREtaErr" 408 "DFC_SCREtaErr1" 409 "DFC_SCREtaErr2" 410 "DFC_SCRMonMetCtlPresErr" 411 "DFC_SCRMonPresBuildUpErr" 412 "DFC_SCRMonPresRdcErr" 413 "DFC_AFSOffsDrftMax" 414 "DFC_AFSOffsDrftMin" 415 "DFC_AFSSRCCorMax" 416 "DFC_AFSSRCCorMin" 417 "DFC_AFSSRCRawMax" 418 "DFC_AFSSRCRawMin" 419 "DFC_AFSSetyDrftMax" 420 "DFC_AFSSetyDrftMin" 421 "DFC_AirCSwtNpl" 422 "DFC_AirCSwtSig" 423 "DFC_BattUSRCMax" 424 "DFC_BattUSRCMin" 425 "DFC_BrkNpl" 426 "DFC_BrkPSRCMax" 427 "DFC_BrkPSRCMin" 428 "DFC_CEngDsTSRCMax" 429 "DFC_CEngDsTSRCMin" 430 "DFC_CrCUIDet" 431 "DFC_ECBVlvSRCMax" 432 "DFC_ECBVlvSRCMin" 433 "DFC_ECUOvrTemp" 434 "DFC_EGRVlvGovDvtMax" 435 "DFC_EGRVlvGovDvtMin" 436 "DFC_EGRVlvHBrgOpnLd" 437 "DFC_EGRVlvHBrgOvrCurr" 438 "DFC_EGRVlvHBrgOvrTemp" 439 "DFC_EGRVlvHBrgShCirBatt1" 440 "DFC_EGRVlvHBrgShCirBatt2" 441 "DFC_EGRVlvHBrgShCirGnd1" 442 "DFC_EGRVlvHBrgShCirGnd2" 443 "DFC_EGRVlvHBrgShCirOvrLd" 444 "DFC_EGRVlvHBrgTempOvrCurr" 445 "DFC_EGRVlvHBrgUndrVltg" 446 "DFC_EGRVlvLPGovDvtMax" 447 "DFC_EGRVlvLPGovDvtMin" 448 "DFC_EGRVlvLPHBrgOpnLd" 449 "DFC_EGRVlvLPHBrgOvrCurr" 450 "DFC_EGRVlvLPHBrgOvrTemp" 451 "DFC_EGRVlvLPHBrgShCirBatt1" 452 "DFC_EGRVlvLPHBrgShCirBatt2" 453 "DFC_EGRVlvLPHBrgShCirGnd1" 454 "DFC_EGRVlvLPHBrgShCirGnd2" 455 "DFC_EGRVlvLPHBrgShCirOvrLd" 456 "DFC_EGRVlvLPHBrgTempOvrCurr" 457 "DFC_EGRVlvLPHBrgUndrVltg" 458 "DFC_EGRVlvLPOL" 459 "DFC_EGRVlvLPSCB" 460 "DFC_EGRVlvLPSCG" 461 "DFC_EGRVlvLPSRCMax" 462 "DFC_EGRVlvLPSRCMin" 463 "DFC_EGRVlvOL" 464 "DFC_EGRVlvSCB" 465 "DFC_EGRVlvSCG" 466 "DFC_EGRVlvSRCMax" 467 "DFC_EGRVlvSRCMin" 468 "DFC_EngPrtOvrSpd" 469 "DFC_EngSpdOL" 470 "DFC_EngSpdSCB" 471 "DFC_EngSpdSCG" 472 "DFC_EnhSRCMaxPPFltDiff" 473 "DFC_EnhSRCMaxT1ExhTMon" 474 "DFC_EnhSRCMaxT2ExhTMon" 475 "DFC_EnhSRCMaxT3ExhTMon" 476 "DFC_EnhSRCMinPPFltDiff" 477 "DFC_EnhSRCMinT1ExhTMon" 478 "DFC_EnhSRCMinT2ExhTMon" 479 "DFC_EnhSRCMinT3ExhTMon" 480 "DFC_EnvPSRCMax" 481 "DFC_EnvPSRCMin" 482 "DFC_ExhTMonPlaus" 483 "DFC_ExhTMonPlausPos1" 484 "DFC_ExhTMonPlausPos2" 485 "DFC_ExhTMonPlausPos3" 486 "DFC_ExhTMonT1Plaus" 487 "DFC_ExhTMonT2Plaus" 488 "DFC_ExhTMonT3Plaus" 489 "DFC_FlFltDsPSRCMax" 490 "DFC_FlFltDsPSRCMin" 491 "DFC_FlFltSig" 492 "DFC_FlFltUsPSRCMax" 493 "DFC_FlFltUsPSRCMin" 494 "DFC_FuelTSRCMax" 495 "DFC_FuelTSRCMin" 496 "DFC_GbxNPosPPerSRCMax" 497 "DFC_GbxNPosPPerSRCMin" 498 "DFC_GbxNPosPdcycSRCMax" 499 "DFC_GbxNPosPdcycSRCMin" 500 "DFC_InjVlvPresMin" 501 "DFC_LSUCircNernstSig" 502 "DFC_LSUCircPmpCurSig" 503 "DFC_LSUCircVirtGndSig" 504 "DFC_LSUO2Max" 505 "DFC_LSUO2Min" 506 "DFC_LSUSPIBattLowMin" 507 "DFC_LSUWireSCB" 508 "DFC_LSUWireSCG" 509 "DFC_MeUnSCG" 510 "DFC_NSCDsCmpChk" 511 "DFC_NSCDsLamBinSRCMax" 512 "DFC_NSCDsLamBinSRCMin" 513 "DFC_NSCDsLamLinSRCMax" 514 "DFC_NSCDsLamLinSRCMin" 515 "DFC_NSCDsLamPlausMax" 516 "DFC_NSCDsLamPlausMin" 517 "DFC_NSCDsNOxSRCMax" 518 "DFC_NSCDsNOxSRCMin" 519 "DFC_NSCDsOpCir" 520 "DFC_NSCDsShCir" 521 "DFC_NoCat2DsCmpChk" 522 "DFC_NoCat2DsLamBinSRCMax" 523 "DFC_NoCat2DsLamBinSRCMin" 524 "DFC_NoCat2DsLamLinSRCMax" 525 "DFC_NoCat2DsLamLinSRCMin" 526 "DFC_NoCat2DsLamPlausMax" 527 "DFC_NoCat2DsLamPlausMin" 528 "DFC_NoCat2DsNOxSRCMax" 529 "DFC_NoCat2DsNOxSRCMin" 530 "DFC_NoCat2DsOpCir" 531 "DFC_NoCat2DsShCir" 532 "DFC_NplDynPPFltDiff" 533 "DFC_NplHsChngPPFltDiff" 534 "DFC_NplHsLnPPFltDiff" 535 "DFC_NplTOxiCatUs" 536 "DFC_NplTPFltUs" 537 "DFC_NplTTrbnUs" 538 "DFC_OilPSwmpSRCMax" 539 "DFC_OilPSwmpSRCMin" 540 "DFC_PCVSCG" 541 "DFC_PFltCharPDiffMin" 542 "DFC_PFltDstrMin" 543 "DFC_PFltEngPrt" 544 "DFC_PFltRgnPerm" 545 "DFC_PFltSRCMaxFlwRstn" 546 "DFC_PFltSRCMinFlwRstn" 547 "DFC_PFltSotMsDvtMax" 548 "DFC_PFltSotMsDvtMin" 549 "DFC_PFltSotMsMax" 550 "DFC_PIntkVUsSRCMax" 551 "DFC_PIntkVUsSRCMin" 552 "DFC_SRCHighAPP1" 553 "DFC_SRCHighAPP2" 554 "DFC_SRCLowAPP1" 555 "DFC_SRCLowAPP2" 556 "DFC_SRCMaxPPFltDiff" 557 "DFC_SRCMaxPPFltUs" 558 "DFC_SRCMaxTECU" 559 "DFC_SRCMaxTOxiCatUs" 560 "DFC_SRCMaxTPFltUs" 561 "DFC_SRCMaxTTrbnUs" 562 "DFC_SRCMaxUCatUsT" 563 "DFC_SRCMaxUPmpP" 564 "DFC_SRCMinPPFltDiff" 565 "DFC_SRCMinPPFltUs" 566 "DFC_SRCMinTECU" 567 "DFC_SRCMinTOxiCatUs" 568 "DFC_SRCMinTPFltUs" 569 "DFC_SRCMinTTrbnUs" 570 "DFC_SRCMinUCatUsT" 571 "DFC_SRCMinUPmpP" 572 "DFC_SigUCatUsT" 573 "DFC_SigUPmpP" 574 "DFC_SyncAPP" 575 "DFC_T15Npl" 576 "DFC_TAFSDtyCycHi" 577 "DFC_TAFSDtyCycLo" 578 "DFC_TAFSPerHi" 579 "DFC_TAFSPerLo" 580 "DFC_TCACDsSRCMax" 581 "DFC_TCACDsSRCMin" 582 "DFC_ThrVlvSRCMax" 583 "DFC_ThrVlvSRCMin" 584 "DFC_TrbChLPOL" 585 "DFC_TrbChLPSCB" 586 "DFC_TrbChLPSCG" 587 "DFC_UHtrPLOL" 588 "DFC_UHtrPLSCB" 589 "DFC_UHtrPLSCG" 590 "DFC_UHtrPLSRCMaxDia" 591 "DFC_UHtrPLSRCMinDia" 592 "DFC_UHtrTnkOL" 593 "DFC_UHtrTnkSCB" 594 "DFC_UHtrTnkSCG" 595 "DFC_UHtrTnkSRCMaxDia" 596 "DFC_UHtrTnkSRCMinDia" 597 "DFC_URevVlvOL" 598 "DFC_URevVlvSCB" 599 "DFC_URevVlvSCG" 600 "DFC_UTnkTSRCMax" 601 "DFC_UTnkTSRCMin" 602 "DFC_UTnkTSig" 603 "DFC_VSwVlvGovDvtMax" 604 "DFC_VSwVlvGovDvtMin" 605 "DFC_VSwVlvHBrgOpnLd" 606 "DFC_VSwVlvHBrgOvrCurr" 607 "DFC_VSwVlvHBrgOvrTemp" 608 "DFC_VSwVlvHBrgShCirBatt1" 609 "DFC_VSwVlvHBrgShCirBatt2" 610 "DFC_VSwVlvHBrgShCirGnd1" 611 "DFC_VSwVlvHBrgShCirGnd2" 612 "DFC_VSwVlvHBrgShCirOvrLd" 613 "DFC_VSwVlvHBrgTempOvrCurr" 614 "DFC_VSwVlvHBrgUndrVltg" 615 "DFC_VSwVlvOL" 616 "DFC_VSwVlvSCB" 617 "DFC_VSwVlvSCG" 618 "DFC_VSwVlvSRCMax" 619 "DFC_VSwVlvSRCMin" 620 "DFC_ClthNpl" 621 "DFC_ETClbETMax_0" 622 "DFC_ETClbETMax_1" 623 "DFC_ETClbETMax_2" 624 "DFC_ETClbETMax_3" 625 "DFC_ETClbETMax_4" 626 "DFC_ETClbETMax_5" 627 "DFC_ETClbETMin_0" 628 "DFC_ETClbETMin_1" 629 "DFC_ETClbETMin_2" 630 "DFC_ETClbETMin_3" 631 "DFC_ETClbETMin_4" 632 "DFC_ETClbETMin_5" 633 "DFC_IVActrEnrgMax_0" 634 "DFC_IVActrEnrgMax_1" 635 "DFC_IVActrEnrgMax_2" 636 "DFC_IVActrEnrgMax_3" 637 "DFC_IVActrEnrgMax_4" 638 "DFC_IVActrEnrgMax_5" 639 "DFC_IVActrEnrgMax_6" 640 "DFC_IVActrEnrgMax_7" 641 "DFC_IVActrEnrgMin_0" 642 "DFC_IVActrEnrgMin_1" 643 "DFC_IVActrEnrgMin_2" 644 "DFC_IVActrEnrgMin_3" 645 "DFC_IVActrEnrgMin_4" 646 "DFC_IVActrEnrgMin_5" 647 "DFC_IVActrEnrgMin_6" 648 "DFC_IVActrEnrgMin_7" 649 "DFC_IVActrEnrgPlaus_0" 650 "DFC_IVActrEnrgPlaus_1" 651 "DFC_IVActrEnrgPlaus_2" 652 "DFC_IVActrEnrgPlaus_3" 653 "DFC_IVActrEnrgPlaus_4" 654 "DFC_IVActrEnrgPlaus_5" 655 "DFC_IVActrEnrgPlaus_6" 656 "DFC_IVActrEnrgPlaus_7" 657 "DFC_IVCtlTiDiff_0" 658 "DFC_IVCtlTiDiff_1" 659 "DFC_IVCtlTiDiff_2" 660 "DFC_IVCtlTiDiff_3" 661 "DFC_IVCtlTiDiff_4" 662 "DFC_IVCtlTiDiff_5" 663 "DFC_IVCtlUDiffUp_0" 664 "DFC_IVCtlUDiffUp_1" 665 "DFC_IVCtlUDiffUp_2" 666 "DFC_IVCtlUDiffUp_3" 667 "DFC_IVCtlUDiffUp_4" 668 "DFC_IVCtlUDiffUp_5" 669 "DFC_IVCtlUUp_0" 670 "DFC_IVCtlUUp_1" 671 "DFC_IVCtlUUp_2" 672 "DFC_IVCtlUUp_3" 673 "DFC_IVCtlUUp_4" 674 "DFC_IVCtlUUp_5" 675 "DFC_IVDiaBnkShCir_0" 676 "DFC_IVDiaBnkShCir_1" 677 "DFC_IVDiaBnkShCirChSwt_0" 678 "DFC_IVDiaBnkShCirChSwt_1" 679 "DFC_IVDiaChp_0" 680 "DFC_IVDiaChp_1" 681 "DFC_IVDiaCylNoCls_0" 682 "DFC_IVDiaCylNoCls_1" 683 "DFC_IVDiaCylNoCls_2" 684 "DFC_IVDiaCylNoCls_3" 685 "DFC_IVDiaCylNoCls_4" 686 "DFC_IVDiaCylNoCls_5" 687 "DFC_IVDiaCylNoLd_0" 688 "DFC_IVDiaCylNoLd_1" 689 "DFC_IVDiaCylNoLd_2" 690 "DFC_IVDiaCylNoLd_3" 691 "DFC_IVDiaCylNoLd_4" 692 "DFC_IVDiaCylNoLd_5" 693 "DFC_IVDiaCylShCir_0" 694 "DFC_IVDiaCylShCir_1" 695 "DFC_IVDiaCylShCir_2" 696 "DFC_IVDiaCylShCir_3" 697 "DFC_IVDiaCylShCir_4" 698 "DFC_IVDiaCylShCir_5" 699 "DFC_IVDiaCylShCirHSLS_0" 700 "DFC_IVDiaCylShCirHSLS_1" 701 "DFC_IVDiaCylShCirHSLS_2" 702 "DFC_IVDiaCylShCirHSLS_3" 703 "DFC_IVDiaCylShCirHSLS_4" 704 "DFC_IVDiaCylShCirHSLS_5" 705 "DFC_IVDiaCylShCirMeas_0" 706 "DFC_IVDiaCylShCirMeas_1" 707 "DFC_IVDiaCylShCirMeas_2" 708 "DFC_IVDiaCylShCirMeas_3" 709 "DFC_IVDiaCylShCirMeas_4" 710 "DFC_IVDiaCylShCirMeas_5" 711 "DFC_LSUDynChk" 712 "DFC_LSUO2ClbMax" 713 "DFC_LSUO2ClbMin" 714 "DFC_LSUO2PlausMaxFLd" 715 "DFC_LSUO2PlausMaxOvrRun" 716 "DFC_LSUO2PlausMaxPartLd" 717 "DFC_LSUO2PlausMinFLd" 718 "DFC_LSUO2PlausMinOvrRun" 719 "DFC_LSUO2PlausMinPartLd" 720 "DFC_LSURiClbMax" 721 "DFC_LSURiClbMin" 722 "DFC_LSUWireIPSig" 723 "DFC_Layer_BSDMax" 724 "DFC_Layer_BSDMin" 725 "DFC_Layer_BSDNpl" 726 "DFC_Layer_BSDSig" 727 "DFC_Layer_FltMngTstMax" 728 "DFC_Layer_FltMngTstMin" 729 "DFC_Layer_FltMngTstNpl" 730 "DFC_Layer_FltMngTstSig" 731 "DFC_Layer_GENELBMax" 732 "DFC_Layer_GENELBMin" 733 "DFC_Layer_GENELBNpl" 734 "DFC_Layer_GENELBSig" 735 "DFC_Layer_GENELMax" 736 "DFC_Layer_GENELMin" 737 "DFC_Layer_GENELNpl" 738 "DFC_Layer_GENELSig" 739 "DFC_Layer_GENHTBMax" 740 "DFC_Layer_GENHTBMin" 741 "DFC_Layer_GENHTBNpl" 742 "DFC_Layer_GENHTBSig" 743 "DFC_Layer_GENHTMax" 744 "DFC_Layer_GENHTMin" 745 "DFC_Layer_GENHTNpl" 746 "DFC_Layer_GENHTSig" 747 "DFC_Layer_GENKOMMMax" 748 "DFC_Layer_GENKOMMMin" 749 "DFC_Layer_GENKOMMNpl" 750 "DFC_Layer_GENKOMMSig" 751 "DFC_Layer_GENMECHMax" 752 "DFC_Layer_GENMECHMin" 753 "DFC_Layer_GENMECHNpl" 754 "DFC_Layer_GENMECHSig" 755 "DFC_Layer_GENMax" 756 "DFC_Layer_GENMin" 757 "DFC_Layer_GENNpl" 758 "DFC_Layer_GENREGUPLMax" 759 "DFC_Layer_GENREGUPLMin" 760 "DFC_Layer_GENREGUPLNpl" 761 "DFC_Layer_GENREGUPLSig" 762 "DFC_Layer_GENSig" 763 "DFC_Layer_GENUPLMax" 764 "DFC_Layer_GENUPLMin" 765 "DFC_Layer_GENUPLNpl" 766 "DFC_Layer_GENUPLSig" 767 "DFC_Layer_IBS1Max" 768 "DFC_Layer_IBS1Min" 769 "DFC_Layer_IBS1Npl" 770 "DFC_Layer_IBS1Sig" 771 "DFC_Layer_IBS2Max" 772 "DFC_Layer_IBS2Min" 773 "DFC_Layer_IBS2Npl" 774 "DFC_Layer_IBS2Sig" 775 "DFC_Layer_IBS3Max" 776 "DFC_Layer_IBS3Min" 777 "DFC_Layer_IBS3Npl" 778 "DFC_Layer_IBS3Sig" 779 "DFC_Layer_MANDETEKMax" 780 "DFC_Layer_MANDETEKMin" 781 "DFC_Layer_MANDETEKNpl" 782 "DFC_Layer_MANDETEKSig" 783 "DFC_Layer_NDR1Max" 784 "DFC_Layer_NDR1Min" 785 "DFC_Layer_NDR1Npl" 786 "DFC_Layer_NDR1Sig" 787 "DFC_Layer_NDR2Max" 788 "DFC_Layer_NDR2Min" 789 "DFC_Layer_NDR2Npl" 790 "DFC_Layer_NDR2Sig" 791 "DFC_Layer_NGLERNMax" 792 "DFC_Layer_NGLERNMin" 793 "DFC_Layer_NGLERNNpl" 794 "DFC_Layer_NGLERNSig" 795 "DFC_Layer_PMBATTMax" 796 "DFC_Layer_PMBATTMin" 797 "DFC_Layer_PMBATTNpl" 798 "DFC_Layer_PMBATTSig" 799 "DFC_Layer_PMBNMax" 800 "DFC_Layer_PMBNMin" 801 "DFC_Layer_PMBNNpl" 802 "DFC_Layer_PMBNSig" 803 "DFC_Layer_PMRUHVERLMax" 804 "DFC_Layer_PMRUHVERLMin" 805 "DFC_Layer_PMRUHVERLNpl" 806 "DFC_Layer_PMRUHVERLSig" 807 "DFC_Layer_QLTMax" 808 "DFC_Layer_QLTMin" 809 "DFC_Layer_QLTNpl" 810 "DFC_Layer_QLTSig" 811 "DFC_Layer_TOENSMax" 812 "DFC_Layer_TOENSMin" 813 "DFC_Layer_TOENSNpl" 814 "DFC_Layer_TOENSSig" 815 "DFC_MonLimCurr" 816 "DFC_MonLimLead" 817 "DFC_MonLimSet" 818 "DFC_NSCDsNOxOfsMax" 819 "DFC_NSCDsNOxOfsMin" 820 "DFC_NSCDsNOxPlausMin" 821 "DFC_NoCat2DsNOxOfsMax" 822 "DFC_NoCat2DsNOxOfsMin" 823 "DFC_NoCat2DsNOxPlausMin" 824 "DFC_PCVNoStrt" 825 "DFC_RailPGradMon" 826 "DFC_SCRPODPresBuildUp" 827 "DFC_AFSDrftIdlAdjVal" 828 "DFC_AFSDrftLdAdjVal" 829 "DFC_AdcIADC0Cal" 830 "DFC_AdcIADC0Conv" 831 "DFC_AdcIADC1Cal" 832 "DFC_AdcIADC1Conv" 833 "DFC_CmbChbMisfireMax_0" 834 "DFC_CmbChbMisfireMax_1" 835 "DFC_CmbChbMisfireMax_2" 836 "DFC_CmbChbMisfireMax_3" 837 "DFC_CmbChbMisfireMax_4" 838 "DFC_CmbChbMisfireMax_5" 839 "DFC_CmbChbMisfireMul" 840 "DFC_EGRVlvLPOfsNeutr" 841 "DFC_EGRVlvOfsNeutr" 842 "DFC_FMAErrModMax" 843 "DFC_FMAErrModMin" 844 "DFC_FlSysTnkLo" 845 "DFC_GbxNPosPlaus" 846 "DFC_I14229_ROETst_Appl" 847 "DFC_I14229_ROETst_Netw" 848 "DFC_I14229_ROE_BufFull" 849 "DFC_IVAdjDiaIVAdj" 850 "DFC_IVAdjIVA_0" 851 "DFC_IVAdjIVA_1" 852 "DFC_IVAdjIVA_2" 853 "DFC_IVAdjIVA_3" 854 "DFC_IVAdjIVA_4" 855 "DFC_IVAdjIVA_5" 856 "DFC_IVPSplyDCDCOff_0" 857 "DFC_IVPSplyDCDCOff_1" 858 "DFC_IVPSplyDCDCOff_2" 859 "DFC_IVPSplyDCDCOff_3" 860 "DFC_InjCtlAdjQntEEPCS" 861 "DFC_LSUSPISig" 862 "DFC_Layer_Dummy" 863 "DFC_NplEnvPSensPPFltDiff" 864 "DFC_NplPresSensPPFltDiff" 865 "DFC_OilLvlPlaus" 866 "DFC_OilTOutLvl" 867 "DFC_PCVfacAdaptMax" 868 "DFC_PCVfacAdaptMin" 869 "DFC_SensFrzPPFltUs" 870 "DFC_SensMonUTnkLvl" 871 "DFC_T15Sig" 872 "DFC_AirCtlRmpTOut" 873 "DFC_BrkPPlaus" 874 "DFC_CEngDsTDynTst" 875 "DFC_EEPEraseErr" 876 "DFC_EEPRdErr" 877 "DFC_EEPWrErr" 878 "DFC_EGRVlvJamVlvClsd" 879 "DFC_EGRVlvJamVlvOpn" 880 "DFC_EGRVlvLPJamVlvClsd" 881 "DFC_EGRVlvLPJamVlvOpn" 882 "DFC_EGRVlvLPLgTDrft" 883 "DFC_EGRVlvLPOfsLrnJamVlv" 884 "DFC_EGRVlvLPShTDrft" 885 "DFC_EGRVlvLgTDrft" 886 "DFC_EGRVlvOfsLrnJamVlv" 887 "DFC_EGRVlvShTDrft" 888 "DFC_EngICO" 889 "DFC_EpmCaSI1ErrSig" 890 "DFC_EpmCaSI1NoSig" 891 "DFC_EpmCaSI1OfsErr" 892 "DFC_EpmCrSErrSig" 893 "DFC_EpmCrSNoSig" 894 "DFC_IVPlausComprTst" 895 "DFC_IVPlausRunUpTst" 896 "DFC_InjCrvShOffTst" 897 "DFC_LayerEnSavModProd" 898 "DFC_LayerEnSavModRep" 899 "DFC_LayerEnSavModShip" 900 "DFC_MRlyErlyOpng" 901 "DFC_MRlyStk" 902 "DFC_MeUnActrTst" 903 "DFC_MoCADCCmp" 904 "DFC_MoCADCTst" 905 "DFC_MoCADCVltgRatio" 906 "DFC_MoCComErrCnt" 907 "DFC_MoCComSPI" 908 "DFC_MoCROMErrXPg" 909 "DFC_MoCSOPHwNoRdy" 910 "DFC_MoCSOPLoLi" 911 "DFC_MoCSOPMM" 912 "DFC_MoCSOPTimeOut" 913 "DFC_MoCSOPUpLi" 914 "DFC_MoFAPP" 915 "DFC_MoFESpd" 916 "DFC_MoFInjDatPhi" 917 "DFC_MoFInjDatQnt" 918 "DFC_MoFInjQnt" 919 "DFC_MoFMode1PoI1" 920 "DFC_MoFMode1PoI2" 921 "DFC_MoFMode2PoI1" 922 "DFC_MoFMode2PoI2" 923 "DFC_MoFOvR" 924 "DFC_MoFQntCor" 925 "DFC_MoFRailP" 926 "DFC_MoFTrqCmp" 927 "DFC_NSCDsHtrSetP" 928 "DFC_NoCat2DsHtrSetP" 929 "DFC_PCVActrTst" 930 "DFC_PhyModNonMonMapNpl" 931 "DFC_RailHpTst" 932 "DFC_RailPOfsTstMax" 933 "DFC_RailPOfsTstMin" 934 "DFC_SIA_E1max" 935 "DFC_SIA_E1min" 936 "DFC_SIA_E1npl" 937 "DFC_SIA_E1sig" 938 "DFC_SIA_E2max" 939 "DFC_SIA_E2min" 940 "DFC_SIA_E2npl" 941 "DFC_SIA_E2sig" 942 "DFC_SIA_E3max" 943 "DFC_SIA_E3min" 944 "DFC_SIA_E3npl" 945 "DFC_SIA_E3sig" 946 "DFC_SIA_E4max" 947 "DFC_SIA_E4min" 948 "DFC_SIA_E4npl" 949 "DFC_SIA_E4sig" 950 "DFC_SWReset_0" 951 "DFC_SWReset_1" 952 "DFC_SWReset_2" 953 "DFC_ShtrAKKMax" 954 "DFC_ShtrAKKMin" 955 "DFC_ShtrAKKNpl" 956 "DFC_ShtrPKKMax" 957 "DFC_StopCntTmr" 958 "DFC_ThrVlvMon" 959 "DFC_VSwVlvJamVlv" 960 "DFC_VSwVlvLgTDrft" 961 "DFC_VSwVlvOfsLrnJamVlv" 962 "DFC_VSwVlvOfsNeutr" 963 "DFC_VSwVlvShTDrft" 964 "DFC_VSwVlvSpgDef" 965 "DSQ_AFS" 966 "DSQ_AFS_SSpShOffActr" 967 "DSQ_AirCCmprActr" 968 "DSQ_BattU" 969 "DSQ_BrkP" 970 "DSQ_CByVlvActr" 971 "DSQ_CEngDsT" 972 "DSQ_CThmstActr" 973 "DSQ_Com_aDirect" 974 "DSQ_Com_aSide" 975 "DSQ_Com_ctrDay" 976 "DSQ_Com_ctrSec" 977 "DSQ_Com_ctrSecAbs" 978 "DSQ_Com_dDay" 979 "DSQ_Com_dMonth" 980 "DSQ_Com_dYear" 981 "DSQ_Com_dphiStWhlAg" 982 "DSQ_Com_dvolPspDes" 983 "DSQ_Com_iHiLimCurr" 984 "DSQ_Com_iLoLimCurr" 985 "DSQ_Com_iPsp" 986 "DSQ_Com_iZrLimCurr" 987 "DSQ_Com_idParkConsumer" 988 "DSQ_Com_idVerbraucher" 989 "DSQ_Com_lFlTnkQntLow" 990 "DSQ_Com_lSum" 991 "DSQ_Com_nDKG" 992 "DSQ_Com_nGbxOut" 993 "DSQ_Com_nPsp" 994 "DSQ_Com_nRqIdlg" 995 "DSQ_Com_nTSC" 996 "DSQ_Com_nWhl" 997 "DSQ_Com_nWhlFL" 998 "DSQ_Com_nWhlFR" 999 "DSQ_Com_nWhlRL" 1000 "DSQ_Com_nWhlRR" 1001 "DSQ_Com_pBrkSys" 1002 "DSQ_Com_phiStWhlAg" 1003 "DSQ_Com_rACFanDem" 1004 "DSQ_Com_rHtFlowReq" 1005 "DSQ_Com_rLamLinRecGndRaw" 1006 "DSQ_Com_rLamLinRecUbattRaw" 1007 "DSQ_Com_rNOxCat2DsGndRaw" 1008 "DSQ_Com_rNOxCat2DsUbattRaw" 1009 "DSQ_Com_rPspSetPoint" 1010 "DSQ_Com_rPwrSpCons" 1011 "DSQ_Com_rTrq" 1012 "DSQ_Com_stAC" 1013 "DSQ_Com_stACEFan" 1014 "DSQ_Com_stARS" 1015 "DSQ_Com_stAcpd" 1016 "DSQ_Com_stBattClass" 1017 "DSQ_Com_stBonnet" 1018 "DSQ_Com_stBrkTrqDVCHQl" 1019 "DSQ_Com_stButtonMSA" 1020 "DSQ_Com_stCat2DsGndRaw" 1021 "DSQ_Com_stCat2DsUbattRaw" 1022 "DSQ_Com_stClCtr" 1023 "DSQ_Com_stClassPwr" 1024 "DSQ_Com_stClth" 1025 "DSQ_Com_stClthOpen" 1026 "DSQ_Com_stClthRaw" 1027 "DSQ_Com_stCrCtlKombi" 1028 "DSQ_Com_stCrCtlLvr" 1029 "DSQ_Com_stDSC" 1030 "DSQ_Com_stDecellDSC" 1031 "DSQ_Com_stDiagPsp" 1032 "DSQ_Com_stDoorDriver" 1033 "DSQ_Com_stDrWghSeat" 1034 "DSQ_Com_stDrvAssist" 1035 "DSQ_Com_stDrvDyn" 1036 "DSQ_Com_stDrvPrgQl" 1037 "DSQ_Com_stDynDisp" 1038 "DSQ_Com_stEngStop" 1039 "DSQ_Com_stErrAFS" 1040 "DSQ_Com_stErrStrg" 1041 "DSQ_Com_stFlTnkQntRes" 1042 "DSQ_Com_stFolDyn" 1043 "DSQ_Com_stGbxOBD" 1044 "DSQ_Com_stGear" 1045 "DSQ_Com_stGearBck" 1046 "DSQ_Com_stHDC" 1047 "DSQ_Com_stKeyVld" 1048 "DSQ_Com_stLckGbxDemQl" 1049 "DSQ_Com_stLmpPrkBrk" 1050 "DSQ_Com_stMSALmp" 1051 "DSQ_Com_stModDKG" 1052 "DSQ_Com_stNOxErrGndRaw" 1053 "DSQ_Com_stNOxErrUbattRaw" 1054 "DSQ_Com_stPBrComf" 1055 "DSQ_Com_stPBrHold" 1056 "DSQ_Com_stPBrHyd" 1057 "DSQ_Com_stPBrkSysQl" 1058 "DSQ_Com_stPHtr" 1059 "DSQ_Com_stParkConsumer" 1060 "DSQ_Com_stPsp" 1061 "DSQ_Com_stPspCntr" 1062 "DSQ_Com_stRaceStrt" 1063 "DSQ_Com_stReqMSA" 1064 "DSQ_Com_stRevGear" 1065 "DSQ_Com_stSTEQl" 1066 "DSQ_Com_stSeason" 1067 "DSQ_Com_stShftIdctrDemRglX" 1068 "DSQ_Com_stShiftPdl" 1069 "DSQ_Com_stShutOffPSP" 1070 "DSQ_Com_stSleepBus" 1071 "DSQ_Com_stSleepConst" 1072 "DSQ_Com_stSleepDest" 1073 "DSQ_Com_stSleepRdy" 1074 "DSQ_Com_stStrg" 1075 "DSQ_Com_stStrtClth" 1076 "DSQ_Com_stStrtLck" 1077 "DSQ_Com_stT15" 1078 "DSQ_Com_stT15Hw" 1079 "DSQ_Com_stT50" 1080 "DSQ_Com_stTRadio" 1081 "DSQ_Com_stTSC" 1082 "DSQ_Com_stTerminal" 1083 "DSQ_Com_stTrailer" 1084 "DSQ_Com_stTrqAFS" 1085 "DSQ_Com_stTrqDSCDes" 1086 "DSQ_Com_stTrqFil" 1087 "DSQ_Com_stTrqGbxDes" 1088 "DSQ_Com_stTrqGbxLim" 1089 "DSQ_Com_stTrqStbDesQl" 1090 "DSQ_Com_stTrqStrg" 1091 "DSQ_Com_stTrqWhl" 1092 "DSQ_Com_stTrqWhlDemFASQl" 1093 "DSQ_Com_stTrqWhlDesQl" 1094 "DSQ_Com_stTypBody" 1095 "DSQ_Com_stUnVel" 1096 "DSQ_Com_stVehCond" 1097 "DSQ_Com_stVehDrvCond" 1098 "DSQ_Com_stVerbraucher" 1099 "DSQ_Com_stphiStWhlAg" 1100 "DSQ_Com_swtAC" 1101 "DSQ_Com_swtDrBltb" 1102 "DSQ_Com_tEnvT" 1103 "DSQ_Com_tGbxOil" 1104 "DSQ_Com_tiPostRunPwrSpl" 1105 "DSQ_Com_trqAC" 1106 "DSQ_Com_trqAFS" 1107 "DSQ_Com_trqAFSDes" 1108 "DSQ_Com_trqARSCur" 1109 "DSQ_Com_trqARSDes" 1110 "DSQ_Com_trqAdjrDKG" 1111 "DSQ_Com_trqBrkDVCH" 1112 "DSQ_Com_trqClthDKG" 1113 "DSQ_Com_trqDSCDes" 1114 "DSQ_Com_trqDVCHRise" 1115 "DSQ_Com_trqGbxDes" 1116 "DSQ_Com_trqGbxFrc" 1117 "DSQ_Com_trqGbxMax" 1118 "DSQ_Com_trqGbxMaxRaw" 1119 "DSQ_Com_trqStbDes" 1120 "DSQ_Com_trqStrg" 1121 "DSQ_Com_trqStrgDes" 1122 "DSQ_Com_trqTarDKG" 1123 "DSQ_Com_trqTarDrvDyn" 1124 "DSQ_Com_trqTarDrvDynDes" 1125 "DSQ_Com_trqTarDrvDynMax" 1126 "DSQ_Com_trqWhlDes" 1127 "DSQ_Com_uLamBinGndRaw" 1128 "DSQ_Com_uLamBinUbattRaw" 1129 "DSQ_Com_uPsp" 1130 "DSQ_Com_uT30Psp" 1131 "DSQ_Com_v" 1132 "DSQ_Com_vBd" 1133 "DSQ_Com_vDspl" 1134 "DSQ_Com_vVeh" 1135 "DSQ_Com_volFlTnkQnt" 1136 "DSQ_Com_volFlTnkQntLH" 1137 "DSQ_Com_volFlTnkQntRH" 1138 "DSQ_DSMInhibitAlways" 1139 "DSQ_EBxFan" 1140 "DSQ_ECBVlvActr" 1141 "DSQ_ECBVlvSens" 1142 "DSQ_EGRVlvActr" 1143 "DSQ_EGRVlvLPActr" 1144 "DSQ_EGRVlvLPSens" 1145 "DSQ_EGRVlvSens" 1146 "DSQ_EMDmp_0" 1147 "DSQ_EMDmp_1" 1148 "DSQ_EngPrtFWOsc" 1149 "DSQ_EngStAActr" 1150 "DSQ_EnvP" 1151 "DSQ_EnvT" 1152 "DSQ_ErrLmpActrMIL" 1153 "DSQ_ErrLmpActrSVS" 1154 "DSQ_FanActr" 1155 "DSQ_FlFltDsP" 1156 "DSQ_FlFltHtActr" 1157 "DSQ_FlFltUsP" 1158 "DSQ_FuelLvl_vol" 1159 "DSQ_FuelT" 1160 "DSQ_GbxNPosPls" 1161 "DSQ_IVDiast" 1162 "DSQ_InjVlvInjCo" 1163 "DSQ_InjVlvPresMin" 1164 "DSQ_LAYER2EDCMSAStp" 1165 "DSQ_LSUO2" 1166 "DSQ_Layer_rCtrPwrSpCos" 1167 "DSQ_MRly" 1168 "DSQ_MeUnActr" 1169 "DSQ_NSCDsRLamO2" 1170 "DSQ_NoCat2DsO2Val" 1171 "DSQ_O2ValNSCDs" 1172 "DSQ_O2ValNoCat2Ds" 1173 "DSQ_OilPSwmp" 1174 "DSQ_PCVActr" 1175 "DSQ_PIntkVUs" 1176 "DSQ_PPFltDiff" 1177 "DSQ_PPFltUs" 1178 "DSQ_RailShutOffDblCtl" 1179 "DSQ_RailShutOffMeUnCtl" 1180 "DSQ_SOPTstInjShOff" 1181 "DSQ_ShtrActr" 1182 "DSQ_StrtActr" 1183 "DSQ_TAFS" 1184 "DSQ_TCACDs" 1185 "DSQ_TECU" 1186 "DSQ_TOxiCatUs" 1187 "DSQ_TPFltUs" 1188 "DSQ_TTrbnUs" 1189 "DSQ_ThrVlvActr" 1190 "DSQ_ThrVlvSens" 1191 "DSQ_TrbChActr" 1192 "DSQ_TrbChLPActr" 1193 "DSQ_TrbChSens" 1194 "DSQ_TrbnDsRLamO2" 1195 "DSQ_UCatUsT" 1196 "DSQ_UDosVlvActr" 1197 "DSQ_UHtrPL" 1198 "DSQ_UHtrPLDia" 1199 "DSQ_UHtrTnk" 1200 "DSQ_UHtrTnkDia" 1201 "DSQ_UPmpMotActr" 1202 "DSQ_UPmpP" 1203 "DSQ_URevVlv" 1204 "DSQ_UTnkLvl" 1205 "DSQ_UTnkT" 1206 "DSQ_VSwVlvActr" 1207 "DSQ_VSwVlvSens" 1208 "DSQ_WaHtElActr" 1209 "DSQ_stAPP" 1210 "DSQ_stAPP1" 1211 "DSQ_stAPP2" 1212 "DSQ_stLSUSrvTstDem" 1213 "DSQ_stSrvOpLSUAdap" DEFAULT_VALUE "---" /end COMPU_VTAB
/begin COMPU_METHOD DFC_OneToOne "" RAT_FUNC "%6.0" "-" COEFFS 0 1 0 0 0 1 /end COMPU_METHOD
/begin COMPU_METHOD DINH_FIdVerb "" TAB_VERB "%2.1" "-" COMPU_TAB_REF DINH_FIdVerb /end COMPU_METHOD
/begin COMPU_VTAB DINH_FIdVerb "" TAB_VERB 689 0 "FId_Unused" 1 "FId_InhibitAlways" 2 "FId_CoordALS" 3 "FId_CoordFBC" 4 "FId_CoordTAA" 5 "FId_CoordZFC" 6 "FId_IVPlausRunUpTstActv" 7 "FId_RailHpTstActv" 8 "FId_ACCIRevErr" 9 "FId_ACCRevErr" 10 "FId_ACCtlTEngErr" 11 "FId_ACCtlTGearbxErr" 12 "FId_ACCtlVehVErr" 13 "FId_ACCtl_AC" 14 "FId_ACCtl_Fan" 15 "FId_ACCtlstTrailer" 16 "FId_AFS" 17 "FId_AFSActrTst" 18 "FId_AFSDrftMaxLim" 19 "FId_AFSFrzAirMs" 20 "FId_AFSPlOffsDrft" 21 "FId_AFSPlSetyDrft" 22 "FId_AFSSRC" 23 "FId_AFSSysErr" 24 "FId_AFSTPer" 25 "FId_AFStCond" 26 "FId_AFStEnv" 27 "FId_AGSDem_SelectParameter" 28 "FId_APP1FinalDef" 29 "FId_APP1ProvDef" 30 "FId_APP1SRCHigh" 31 "FId_APP1SigPath" 32 "FId_APP2FinalDef" 33 "FId_APP2ProvDef" 34 "FId_APP2SRCHigh" 35 "FId_APP2SigPath" 36 "FId_APPBrkDef" 37 "FId_APPBrkTrq" 38 "FId_APPNTP" 39 "FId_APPSyncChk" 40 "FId_APPSyncDef" 41 "FId_APPSyncProvDef" 42 "FId_APPSyncSigProv" 43 "FId_APPVel" 44 "FId_APProvDef" 45 "FId_ASDdc" 46 "FId_ASDrfLAD2" 47 "FId_ASModAFS" 48 "FId_ASModAFSTCmpr" 49 "FId_ASModEGRVlvLrn" 50 "FId_ASModOxiC" 51 "FId_ASModPipe" 52 "FId_ASModPipeSlw" 53 "FId_ASModPresCalc" 54 "FId_ASModPresEnv" 55 "FId_ASModStrt" 56 "FId_ASModSwtOffEng" 57 "FId_ASModSwtOffExhMnfLP" 58 "FId_ASModSwtOffIndVol" 59 "FId_ASModT20" 60 "FId_ASModTrbn" 61 "FId_AccPedNMaxLim" 62 "FId_AccPedNMinLim" 63 "FId_AccPedTrqLim" 64 "FId_AdapNSCDs" 65 "FId_AdcIADC0" 66 "FId_AdcIADC1" 67 "FId_AftRun" 68 "FId_AirCSwt" 69 "FId_AirCtl" 70 "FId_AirCtlACCorr" 71 "FId_AirCtlBrk" 72 "FId_AirCtlBstPresCor" 73 "FId_AirCtlCmpntActv" 74 "FId_AirCtlCorAltEOM" 75 "FId_AirCtlDyn" 76 "FId_AirCtlEGR" 77 "FId_AirCtlEGRPreCtl" 78 "FId_AirCtlGear" 79 "FId_AirCtlGovDvt" 80 "FId_AirCtlGovLPDvt" 81 "FId_AirCtlInvEGRMod" 82 "FId_AirCtlLP" 83 "FId_AirCtlLPACCor" 84 "FId_AirCtlLPBstPresCor" 85 "FId_AirCtlLPCmpntActv" 86 "FId_AirCtlLPGear" 87 "FId_AirCtlLPPFltEGRRed" 88 "FId_AirCtlLPStrgCor" 89 "FId_AirCtlLPVehVCor" 90 "FId_AirCtlPFltEGRRed" 91 "FId_AirCtlStrg" 92 "FId_AirCtlTVA" 93 "FId_AirCtlTVACtl" 94 "FId_AirCtlmDesVehCorr" 95 "FId_AirSysTst" 96 "FId_BattUFrzVal" 97 "FId_BattUReplVal" 98 "FId_BattUSRC" 99 "FId_BrkP" 100 "FId_BrkPFrzVal" 101 "FId_BrkPReplVal" 102 "FId_BrkPSens" 103 "FId_BusDiag_stFadeOut" 104 "FId_CEngDsTDynTst" 105 "FId_CEngDsTFrzVal" 106 "FId_CEngDsTModel" 107 "FId_CEngDsTRdClnt" 108 "FId_CEngDsTRplVal" 109 "FId_CEngDsTSS" 110 "FId_Clth" 111 "FId_ClthCAN" 112 "FId_CmbChb" 113 "FId_CoEngNrml2Strt" 114 "FId_CoEngPthClsEGR" 115 "FId_CoEngPthClsThr" 116 "FId_CoEngPthCylOff" 117 "FId_CoEngPthETZr" 118 "FId_CoEngPthFlQnt" 119 "FId_CoEngPthInjVlvOff" 120 "FId_CoEngPthLpSysOff" 121 "FId_CoEngPthRPMin" 122 "FId_CoEngPthTrqZr" 123 "FId_CoEngSoftShOff" 124 "FId_CoEngStop" 125 "FId_CoSCR_CAN" 126 "FId_CoTS_SwtOff" 127 "FId_CoVMDComErr" 128 "FId_CoVMvBd" 129 "FId_CoVehPrpLimErr" 130 "FId_ComAPP" 131 "FId_ComBrkDef" 132 "FId_ComClth" 133 "FId_ComCoEng" 134 "FId_ComCtrSecInt" 135 "FId_ComCtrSecIntTo" 136 "FId_ComDKGIntv" 137 "FId_ComDscAck1" 138 "FId_ComDscAck2" 139 "FId_ComDscAck3" 140 "FId_ComDscTrqIntv" 141 "FId_ComEngDem" 142 "FId_ComGbxAck1" 143 "FId_ComGbxAck2" 144 "FId_ComGbxAck3" 145 "FId_ComGbxTrqIntv" 146 "FId_ComInjDu1" 147 "FId_ComInjDu2" 148 "FId_ComInjVlv" 149 "FId_ComMSA" 150 "FId_ComNDynDispOff" 151 "FId_ComNGbxOut" 152 "FId_ComPCBSPFlt" 153 "FId_ComRCtrPwrSpCos" 154 "FId_ComRpmRduc" 155 "FId_ComSLck" 156 "FId_ComStBrkPedal" 157 "FId_ComStDDEQl" 158 "FId_ComStDrvDirDes" 159 "FId_ComStEnrgPwrMnmt" 160 "FId_ComStGbxModDemFAS" 161 "FId_ComStGrip" 162 "FId_ComStLPCOff" 163 "FId_ComStLckGbxDemQl" 164 "FId_ComStRTrqPTQl" 165 "FId_ComStShiftPdl" 166 "FId_ComStShutOffPSP" 167 "FId_ComStTerminal" 168 "FId_ComStTrq" 169 "FId_ComStTrqGbxQl" 170 "FId_ComStTrqWhlStbQl" 171 "FId_ComStVehDrvCond" 172 "FId_ComStnEngQl" 173 "FId_ComStrtLck" 174 "FId_ComTEng" 175 "FId_ComTOilEng" 176 "FId_ComThrVlv" 177 "FId_ComTrqCootd" 178 "FId_ComTrqWhl" 179 "FId_ComTrqWhlDes" 180 "FId_ComUBatt" 181 "FId_ComVolTotFlCons" 182 "FId_ComnEng" 183 "FId_ComnGbxOut" 184 "FId_ComnSetPLo" 185 "FId_ComnTSC" 186 "FId_CompEnv" 187 "FId_ComrTrq" 188 "FId_ComrTrqPT" 189 "FId_ComrVirtAPP" 190 "FId_ComrWaterVlv" 191 "FId_ComrtrqDifftl" 192 "FId_ComstGear" 193 "FId_ComvVeh" 194 "FId_ConvLdNTrbnCan" 195 "FId_ConvLdOilTemp" 196 "FId_ConvLdTrqLdCan" 197 "FId_ConvLdVel" 198 "FId_CrCUILvr" 199 "FId_CrCtlCan" 200 "FId_CrCtlCanAT" 201 "FId_CrCtlEcu" 202 "FId_Cy100Dev1" 203 "FId_Cy100Dev2" 204 "FId_DCSRmpShOff" 205 "FId_DCSShOff" 206 "FId_DIOnumChip1Cj945" 207 "FId_DIUMPRGenDenom1" 208 "FId_DIUMPRGenDenom2" 209 "FId_DIUMPRGenDenom3" 210 "FId_DIUMPRIgn" 211 "FId_DSMIVAdjNVCEna" 212 "FId_DSMWarmUpCycle" 213 "FId_DStgyMon" 214 "FId_DevLibActrPrt" 215 "FId_DewDetHtgDel" 216 "FId_DewDetstSrvTstDem" 217 "FId_DiaDem_SelectParameter" 218 "FId_DynChkPPFltDiff" 219 "FId_ECBVlvFrzVal" 220 "FId_ECBVlvReplVal" 221 "FId_ECBVlvSS" 222 "FId_EGRClg" 223 "FId_EGRVlvFrzVal" 224 "FId_EGRVlvGovOn" 225 "FId_EGRVlvJamVlv" 226 "FId_EGRVlvLPFrzVal" 227 "FId_EGRVlvLPGovOn" 228 "FId_EGRVlvLPJamVlv" 229 "FId_EGRVlvLPOfsLrnInhib" 230 "FId_EGRVlvLPReplVal" 231 "FId_EGRVlvLPSSpMon" 232 "FId_EGRVlvOfsLrnInhib" 233 "FId_EGRVlvReplVal" 234 "FId_EGRVlvSSpMon" 235 "FId_EGSysMaxTOxiPre" 236 "FId_EGSysMaxTOxiPreRgn" 237 "FId_EGSysMaxTPre" 238 "FId_EGSysMaxTPreRgn" 239 "FId_EMCtl" 240 "FId_ETClbCorActv" 241 "FId_ETCtlAirCtl" 242 "FId_ETCtlInr" 243 "FId_ETCtlOutr" 244 "FId_Empt" 245 "FId_EngDaClntTemp" 246 "FId_EngDemPFltErr" 247 "FId_EngDemPFltOvldErr" 248 "FId_EngDemTrqLimErr" 249 "FId_EngDemTrqLimErr1" 250 "FId_EngDemTrqLimErr2" 251 "FId_EngDemTrqLimErr3" 252 "FId_EngDemTrqLimErr4" 253 "FId_EngPrtEnvP" 254 "FId_EngPrtFWOscInactv" 255 "FId_EngPrtNLimErr" 256 "FId_EngPrtT31" 257 "FId_EngPrtstTrailer" 258 "FId_EnhSRCPPFltDiff" 259 "FId_EnhSRCT1ExhTMon" 260 "FId_EnhSRCT2ExhTMon" 261 "FId_EnhSRCT3ExhTMon" 262 "FId_EnvPFrzVal" 263 "FId_EnvPModel" 264 "FId_EnvPNplPPFltDiff" 265 "FId_EnvPRplVal" 266 "FId_EnvPSS" 267 "FId_EnvTCANFrzVal" 268 "FId_EnvTCANRplVal" 269 "FId_EnvTModel" 270 "FId_EnvTSS" 271 "FId_EpmBCr" 272 "FId_EpmCaSAdapCaSI1" 273 "FId_EpmCaSDiag" 274 "FId_EpmCaSOfsDiagCaSI1" 275 "FId_EpmCaSOfsErrCaSI1" 276 "FId_EpmCaSSegCor" 277 "FId_EpmCrSDiag" 278 "FId_EpmCrSDiagVeh" 279 "FId_EpmOpMode_InjLock" 280 "FId_EpmRRSFaultCheck" 281 "FId_EpmRRSRdCheck" 282 "FId_ExhTMonCondPlaus" 283 "FId_ExhTMonPlausTemp" 284 "FId_FBC" 285 "FId_FBCMonI" 286 "FId_FMALamO2Valid" 287 "FId_FMASwtOff1" 288 "FId_FMASwtOff3" 289 "FId_FanCtl" 290 "FId_FanCtl2" 291 "FId_FanCtlCor" 292 "FId_FanCtlCor2" 293 "FId_FanCtlnEFan" 294 "FId_FanCtlstTrailer" 295 "FId_FanTraOil" 296 "FId_FlFCBSDef" 297 "FId_FlFltDsPFrzVal" 298 "FId_FlFltDsPReplVal" 299 "FId_FlFltUsPFrzVal" 300 "FId_FlFltUsPReplVal" 301 "FId_FlSysDens" 302 "FId_FlSysTnkLoEEP" 303 "FId_FlSysTnkLoInfo" 304 "FId_FrzPrtTrqDfftl" 305 "FId_FrzValAbsUPmpP" 306 "FId_FrzValCANAbsUPmpP" 307 "FId_FrzValCANUCatUsT" 308 "FId_FrzValPPFltDiff" 309 "FId_FrzValPPFltUs" 310 "FId_FrzValTOxiCatUs" 311 "FId_FrzValTPFltUs" 312 "FId_FrzValTTrbnUs" 313 "FId_FrzValUCatUsT" 314 "FId_FrzValUTnkLvl" 315 "FId_FuelTCTS" 316 "FId_FuelTFlSys" 317 "FId_FuelTFrzVal" 318 "FId_FuelTReplVal" 319 "FId_GSHDem_SelectParameter" 320 "FId_GbxNPosPWM" 321 "FId_GlbDaLSumvXPtd" 322 "FId_GlwCtl1" 323 "FId_GlwCtlDrWghSeat" 324 "FId_GlwCtlTRadio" 325 "FId_GlwEcuGPCMFaultInfoTstLck" 326 "FId_GlwEcuGPCMInfoTstLck" 327 "FId_HLSDemDeclGradLim" 328 "FId_HLSDemSetPLoDrvAwy" 329 "FId_HLSDemUndrBrk" 330 "FId_HLSDemtrqConv" 331 "FId_HsLnChkPPFltDiff" 332 "FId_I14229Appl_RC" 333 "FId_ISCnTrbnMod" 334 "FId_ISCtrqConv" 335 "FId_ISCvBd" 336 "FId_IVDiaTst" 337 "FId_IVPSplyDCDCOff" 338 "FId_IVPlausComprTst" 339 "FId_IVPlausRunUpTst" 340 "FId_InhibitNever" 341 "FId_InjCrvCoErr" 342 "FId_InjCrvCylOffs" 343 "FId_InjCrvDisblPoI1" 344 "FId_InjCrvDisblPoI2" 345 "FId_InjCrvPiI1VehCor" 346 "FId_InjCrvPiI2VehCor" 347 "FId_InjCrvPoIOvrLim" 348 "FId_InjCrvShOffTst" 349 "FId_InjUnStrtPlsBlk" 350 "FId_InjVlvBnk0ShutOff" 351 "FId_InjVlvBnk1ShutOff" 352 "FId_InjVlvBnk2ShutOff" 353 "FId_InjVlvBnk3ShutOff" 354 "FId_InjVlvCyl0ShutOff" 355 "FId_InjVlvCyl1ShutOff" 356 "FId_InjVlvCyl2ShutOff" 357 "FId_InjVlvCyl3ShutOff" 358 "FId_InjVlvCyl4ShutOff" 359 "FId_InjVlvCyl5ShutOff" 360 "FId_InjVlvCyl6ShutOff" 361 "FId_InjVlvCyl7ShutOff" 362 "FId_InjVlvPrep" 363 "FId_InjVlvPresMin" 364 "FId_InjVlvPresMinRun" 365 "FId_InjVlvPresMinStrt" 366 "FId_LSUAdap0" 367 "FId_LSUClbSched" 368 "FId_LSUCmpChk0" 369 "FId_LSUCtl0" 370 "FId_LSUDewRls0" 371 "FId_LSUDynChk0" 372 "FId_LSUHtCoup0" 373 "FId_LSUHtrPS0" 374 "FId_LSUIPOpnLdTst0" 375 "FId_LSUIsolChk0" 376 "FId_LSULoBatt0" 377 "FId_LSUMon0" 378 "FId_LSUO20" 379 "FId_LSUO2Clb0" 380 "FId_LSUO2SRC0" 381 "FId_LSUPlausChk0" 382 "FId_LSURi0" 383 "FId_LSURiClb0" 384 "FId_LSUShCir0" 385 "FId_LSUUNVGOpnLdTst0" 386 "FId_LSUlsu0" 387 "FId_Layer_ACFZGL11" 388 "FId_Layer_ACFZGQ11" 389 "FId_Layer_AQUERABS11" 390 "FId_Layer_ATEMPRELATIVZEIT" 391 "FId_Layer_BATTCLASS" 392 "FId_Layer_BEDIENUNG_MSA" 393 "FId_Layer_CANErr" 394 "FId_Layer_CODIERUNG_PM" 395 "FId_Layer_CRASHABSCHALTUNG" 396 "FId_Layer_DIENSTE_19" 397 "FId_Layer_FAHRZEUGTYP" 398 "FId_Layer_FltHtg" 399 "FId_Layer_FltMng_Sig1" 400 "FId_Layer_FltMng_Sig2" 401 "FId_Layer_GESCHWINDIGKEIT" 402 "FId_Layer_GETRIEBEDATEN" 403 "FId_Layer_GETRIEBEDATEN_2" 404 "FId_Layer_KILOMETERSTAND" 405 "FId_Layer_KLEMMENSTATUS" 406 "FId_Layer_LENKRADWINKEL" 407 "FId_Layer_LPC" 408 "FId_Layer_MANDETEK" 409 "FId_Layer_MSACANErr" 410 "FId_Layer_MSAVAdapt" 411 "FId_Layer_MSAVDiag" 412 "FId_Layer_STANDVERBRAUCHER" 413 "FId_Layer_STATDSC" 414 "FId_Layer_STATESEAT" 415 "FId_Layer_STATGANGRUECKWAERTS" 416 "FId_Layer_STATZVKLAPPEN" 417 "FId_Layer_STAT_ANHAENGER" 418 "FId_Layer_STAT_EKP" 419 "FId_Layer_UHRZEIT_DATUM" 420 "FId_Layer_ULCP" 421 "FId_Layer_VCAN11" 422 "FId_Layer_VERBRAUCHER" 423 "FId_Layer_WAERMESTROMKLIMA" 424 "FId_LubmOil" 425 "FId_MeUnActrTst" 426 "FId_MeUnFrzI" 427 "FId_MeUnRot" 428 "FId_MetCtl" 429 "FId_NSCDsAdapEep" 430 "FId_NSCDsCmpChk" 431 "FId_NSCDsNOx" 432 "FId_NSCDsOvrRunPlaus" 433 "FId_NSCDsRdy" 434 "FId_NSCDsSensDia" 435 "FId_NSCDsTO" 436 "FId_NoCat2DsAdap" 437 "FId_NoCat2DsAdapEep" 438 "FId_NoCat2DsCmpChk" 439 "FId_NoCat2DsNOx" 440 "FId_NoCat2DsOvrRunPlaus" 441 "FId_NoCat2DsRdy" 442 "FId_NoCat2DsSensDia" 443 "FId_NoCat2DsTO" 444 "FId_NoPresCtl" 445 "FId_NplPresSensPPFltDiff" 446 "FId_NplTOxiCatUs" 447 "FId_NplTPFltUs" 448 "FId_OilPLmpVOff" 449 "FId_OilPSwmpRplVal" 450 "FId_PCBSDef" 451 "FId_PCBSPFltDef" 452 "FId_PCR" 453 "FId_PCRCByVlvOff" 454 "FId_PCRClthActv" 455 "FId_PCRCmpntActv" 456 "FId_PCRCmpntActvLP" 457 "FId_PCRExtnLimActr" 458 "FId_PCRGovDvt" 459 "FId_PCRGovDvtLP" 460 "FId_PCRLP" 461 "FId_PCROfsRls" 462 "FId_PCRPFltPresCor" 463 "FId_PCRT20" 464 "FId_PCRTrbCh" 465 "FId_PCVActrTst" 466 "FId_PCVFrzI" 467 "FId_PCVNoStrt" 468 "FId_PCVPwrStgTst" 469 "FId_PFltAirSysFail" 470 "FId_PFltChar" 471 "FId_PFltComLSum" 472 "FId_PFltDstr" 473 "FId_PFltEngPrtRgnMon" 474 "FId_PFltLckRgnErr" 475 "FId_PFltLckRgnFl" 476 "FId_PFltLckRgnOilDil" 477 "FId_PFltLdAshCor" 478 "FId_PFltLdAshCorErr" 479 "FId_PFltLdIniAftSuc" 480 "FId_PFltLdNOxEng" 481 "FId_PFltLdO2Aprx" 482 "FId_PFltLdSimRgnThr" 483 "FId_PFltOvldHealInhRn" 484 "FId_PFltOvldHealTrqLm" 485 "FId_PFltPOpBrk" 486 "FId_PFltPOpClth" 487 "FId_PFltPOpGearDet" 488 "FId_PFltPOpSpdVeh" 489 "FId_PFltPOpTempAir" 490 "FId_PFltPOpTempClnt" 491 "FId_PFltPOpVltgBatt" 492 "FId_PFltPoI1Fail" 493 "FId_PFltPoI2Fail" 494 "FId_PFltPresPlausProj" 495 "FId_PFltRgnChngPar" 496 "FId_PFltRgnNoSucDet" 497 "FId_PFltRgnNumErrLck" 498 "FId_PFltRgnNumPFltErr" 499 "FId_PFltRgnSuc" 500 "FId_PFltSimOn" 501 "FId_PFltSysErr2Can" 502 "FId_PFltSysFail" 503 "FId_PFltTOxiPreDiff" 504 "FId_PFltTPreDiff" 505 "FId_PIntkVUsEnvPPls" 506 "FId_PIntkVUsFrzVal" 507 "FId_PIntkVUsRplVal" 508 "FId_PTCltDKG" 509 "FId_PTGripDebPtd" 510 "FId_PTTrqRatCANPtd" 511 "FId_PhyModPCRCorr" 512 "FId_PlausTTrbnUs" 513 "FId_PresBuildUp" 514 "FId_PresCtl" 515 "FId_PresRdc" 516 "FId_PresSensFrzPPFltUs" 517 "FId_QWCCTSDef" 518 "FId_QWCFTSDef" 519 "FId_QWCOff" 520 "FId_RadShtCTS" 521 "FId_RadShtConsum" 522 "FId_RadShtEGS" 523 "FId_RadShtEnvT" 524 "FId_RadShtstTrailer" 525 "FId_RailCPCtlMeUnMode" 526 "FId_RailCPCtlPCVMode" 527 "FId_RailCtlMode" 528 "FId_RailFuelTErr" 529 "FId_RailHpTst" 530 "FId_RailMeUn0Blk" 531 "FId_RailMeUn0Rls" 532 "FId_RailMeUn1Blk" 533 "FId_RailMeUn1Rls" 534 "FId_RailMeUn22Blk" 535 "FId_RailMeUn22Rls" 536 "FId_RailMeUn2Blk" 537 "FId_RailMeUn2Rls" 538 "FId_RailMeUn3Blk" 539 "FId_RailMeUn3Rls" 540 "FId_RailMeUn42Blk" 541 "FId_RailMeUn42Rls" 542 "FId_RailMeUn4Blk" 543 "FId_RailMeUn4Rls" 544 "FId_RailMeUn5Blk" 545 "FId_RailMeUn5Rls" 546 "FId_RailMeUnClsdShutOff" 547 "FId_RailMeUnCtlMode" 548 "FId_RailMeUnCtlUpLim" 549 "FId_RailPCV0Blk" 550 "FId_RailPCV0Rls" 551 "FId_RailPCV1Blk" 552 "FId_RailPCV1Rls" 553 "FId_RailPCV22Blk" 554 "FId_RailPCV22Rls" 555 "FId_RailPCV2Blk" 556 "FId_RailPCV2Rls" 557 "FId_RailPCV3Blk" 558 "FId_RailPCV3Rls" 559 "FId_RailPCV42Blk" 560 "FId_RailPCV42Rls" 561 "FId_RailPCV4Blk" 562 "FId_RailPCV4Rls" 563 "FId_RailPCVCtlMode" 564 "FId_RailPCVCtlUpLim" 565 "FId_RailPFrzVal" 566 "FId_RailPMonStrt" 567 "FId_RailPSS" 568 "FId_RailPSubsVal" 569 "FId_RailSetPointLim" 570 "FId_RailSetPointRed" 571 "FId_RailSetPointVehCor" 572 "FId_ReFl" 573 "FId_ReplValTPFltUs" 574 "FId_RplValAbsUPmpP" 575 "FId_RplValCANAbsUPmpP" 576 "FId_RplValCANUCatUsT" 577 "FId_RplValPPFltDiff" 578 "FId_RplValPPFltUs" 579 "FId_RplValTOxiCatUs" 580 "FId_RplValTTrbnUs" 581 "FId_RplValUCatUsT" 582 "FId_RplValUTnkLvl" 583 "FId_SCRChkNOxEff" 584 "FId_SCRPODPresBuildUp" 585 "FId_SRCFlwRstn" 586 "FId_SSMonFlFltDsP" 587 "FId_SSMonFlFltUsP" 588 "FId_SSPIntkVUs" 589 "FId_SSTOxiCatUs" 590 "FId_SSTPFltUs" 591 "FId_SSUCatUsT" 592 "FId_SSUPmpP" 593 "FId_SSUTnkT" 594 "FId_SensAdapTPFltUs" 595 "FId_StAPmpEna" 596 "FId_StBy" 597 "FId_SubsValPrtTrqDfftl" 598 "FId_SubsValRatTrqDfftl" 599 "FId_T15" 600 "FId_T50Sig" 601 "FId_TAA" 602 "FId_TAFSFrzVal" 603 "FId_TAFSReplVal" 604 "FId_TAFSSRC" 605 "FId_TCACDsCANFrzVal" 606 "FId_TCACDsCANRplVal" 607 "FId_TCACDsFrzVal" 608 "FId_TCACDsModel" 609 "FId_TCACDsRplVal" 610 "FId_TCACDsSS" 611 "FId_TCPrtChrgPmpCtl" 612 "FId_TCPrtChrgPmpGov" 613 "FId_TCPrtChrgPmpHLSDem" 614 "FId_TCPrt_ChrgPmpDet" 615 "FId_TCPrtnSetTSC" 616 "FId_TCSRmpShOff" 617 "FId_TCSShOff" 618 "FId_TECUFrzVal" 619 "FId_TECURplVal" 620 "FId_TOxiCatUs" 621 "FId_TempSensFrzPPFltUs" 622 "FId_TempWait" 623 "FId_ThrVlvFrzVal" 624 "FId_ThrVlvMon" 625 "FId_ThrVlvRplVal" 626 "FId_ThrVlvSS" 627 "FId_TraAddAirCANPtd" 628 "FId_TraAddClntCANPtd" 629 "FId_TraDrvAway" 630 "FId_TraDrvAwayInactiv" 631 "FId_TraGearInfoDet" 632 "FId_TraGearInfoInfoCan" 633 "FId_TraGearInfoLevPos" 634 "FId_TraGearInfoLoRng" 635 "FId_TraGearInfoRTra" 636 "FId_TraGearInfoRevGear" 637 "FId_TraNmin" 638 "FId_TraOilTemp" 639 "FId_TraPrtGearCANPtd" 640 "FId_TraRtnIntfcASTIntv" 641 "FId_TraRtnIntfcIdlSetP" 642 "FId_TraSlip" 643 "FId_TraSpaCAN" 644 "FId_TraSpaEngSpd" 645 "FId_TraSpaVehV" 646 "FId_TraTrqLimErr" 647 "FId_TraTrqLos" 648 "FId_TraTrqRedLmpHmeDec" 649 "FId_TraTrqRedLmpHmeInc" 650 "FId_TraTrqRedPlausDecIntv" 651 "FId_TraTrqRedPlausIncIntv" 652 "FId_TrbChPWMIn" 653 "FId_UHCMonUHtrPL" 654 "FId_UHCMonUHtrTnk" 655 "FId_UHtrPLFrzValDia" 656 "FId_UHtrPLRplValDia" 657 "FId_UHtrPLSSDia" 658 "FId_UHtrTnkFrzValDia" 659 "FId_UHtrTnkRplValDia" 660 "FId_UHtrTnkSSDia" 661 "FId_UTnkLvlSensTst" 662 "FId_UTnkTFrzVal" 663 "FId_UTnkTFrzValCAN" 664 "FId_UTnkTRplVal" 665 "FId_UTnkTRplValCAN" 666 "FId_VMDTrqWhl" 667 "FId_VSwCtl" 668 "FId_VSwCtlVehCorr" 669 "FId_VSwVlvFrzVal" 670 "FId_VSwVlvGovOn" 671 "FId_VSwVlvJamVlv" 672 "FId_VSwVlvOfsLrnInhib" 673 "FId_VSwVlvRplVal" 674 "FId_VSwVlvSS" 675 "FId_VSwVlvSpgDiagInhib" 676 "FId_VehVReplVal" 677 "FId_Vtln" 678 "FId_ZFCClbActv" 679 "FId_ZFCCldCmbCham" 680 "FId_stAVSCoESLSU" 681 "Fid_ComnTSC" 682 "Fid_CustDiag_DiaDem_AT" 683 "Fid_CustDiag_DiaDem_MT" 684 "Fid_HLSDemHDC" 685 "Fid_IVActrTempRplVal" 686 "Fid_StSysStrtTipGbxDat" 687 "Fid_TraCanNeutral" 688 "Fid_WaHtShOffErr" DEFAULT_VALUE "---" /end COMPU_VTAB
/begin RECORD_LAYOUT ValA_Wu16 FNC_VALUES 1 UWORD COLUMN_DIR DIRECT /end RECORD_LAYOUT
/end MODULE
/end PROJECT

ASAP2_VERSION 1 4
/begin PROJECT P_574 "EDC17_CP09"
/begin HEADER "" VERSION "V8KB" PROJECT_NO P_574 /end HEADER
/begin MODULE DIM ""
/begin MOD_COMMON "" BYTE_ORDER MSB_LAST ALIGNMENT_BYTE 1 ALIGNMENT_WORD 2 ALIGNMENT_LONG 4 ALIGNMENT_FLOAT32_IEEE 4 /end MOD_COMMON
/begin CHARACTERISTIC AFS_dmB1_C "" VALUE 0x8002CF18 Val_Ws16 6553.500 AirMassPerTime -3276.800 3276.700 /end CHARACTERISTIC
/begin CHARACTERISTIC AFS_dmB2_C "" VALUE 0x8002CF1A Val_Ws16 6553.500 AirMassPerTime -3276.800 3276.700 /end CHARACTERISTIC
/begin CHARACTERISTIC AFS_mAirPerCylB1_C "" VALUE 0x8002CF1C Val_Ws16 6553.500 AirMassPerCyl -3276.800 3276.700 /end CHARACTERISTIC
/begin CHARACTERISTIC AFS_mAirPerCylB2_C "" VALUE 0x8002CF1E Val_Ws16 6553.500 AirMassPerCyl -3276.800 3276.700 /end CHARACTERISTIC
/begin CHARACTERISTIC AirCtl_mDesBasB1_C "" VALUE 0x8002CF20 Val_Ws16 6553.500 AirMassPerCyl -3276.800 3276.700 /end CHARACTERISTIC
/begin CHARACTERISTIC AirCtl_mDesBasB2_C "" VALUE 0x8002CF22 Val_Ws16 6553.500 AirMassPerCyl -3276.800 3276.700 /end CHARACTERISTIC
/begin CHARACTERISTIC AirCtl_mDesBas_C "" VALUE 0x8002CF24 Val_Ws16 6553.500 AirMassPerCyl -3276.800 3276.700 /end CHARACTERISTIC
/begin CHARACTERISTIC Air_tAirFldB1_C "Vorgabewert für die Botschaft Air_tAirFldB1" VALUE 0x8002CF26 Val_Ws16 6553.500 Temp_Cels -3549.940 3003.560 /end CHARACTERISTIC
/begin CHARACTERISTIC Air_tAirFldB2_C "Vorgabewert für die Botschaft Air_tAirFldB2" VALUE 0x8002CF28 Val_Ws16 6553.500 Temp_Cels -3549.940 3003.560 /end CHARACTERISTIC
/begin CHARACTERISTIC Air_tCACDsB1_C "" VALUE 0x8002CF2A Val_Ws16 6553.500 Temp_Cels -3549.940 3003.560 /end CHARACTERISTIC
/begin CHARACTERISTIC Air_tCACDsB2_C "" VALUE 0x8002CF2C Val_Ws16 6553.500 Temp_Cels -3549.940 3003.560 /end CHARACTERISTIC
/begin CHARACTERISTIC APP_dRawSigFac_C "Faktor zwischen den Sensor-Rohsignalen" VALUE 0x8002C090 Val_Wu16 6.000000 Fact 0.00 6.000000 EXTENDED_LIMITS 0.00 7.999878 /end CHARACTERISTIC
/begin CHARACTERISTIC APP_duLimErr.Pos_C "Fehlerrampe bei der Auswahl des Führungssignales/" VALUE 0x8002C084 Kw_Ws32 6553599.99695 RmpVolt 0.00 6553599.99695 FORMAT "%13.5" EXTENDED_LIMITS -6553600.00000 6553599.99695 /end CHARACTERISTIC
/begin CHARACTERISTIC APP_duLimErr.Neg_C "Fehlerrampe bei der Auswahl des Führungssignales/" VALUE 0x8002C088 Kw_Ws32 6553599.99695 RmpVolt 0.00 6553599.99695 FORMAT "%13.5" EXTENDED_LIMITS -6553600.00000 6553599.99695 /end CHARACTERISTIC
/begin CHARACTERISTIC APP_rLinAPP_CUR "Linearisierungskennlinie für das Fahrpedal" CURVE 0x8002C092 Cur_Xs16Ws16 100.0000 Prc 0.00 100.0000 EXTENDED_LIMITS -400.0000 399.9878
 /begin AXIS_DESCR STD_AXIS APP_uUnJit_mp Volt 3 0.00 5200.000 EXTENDED_LIMITS -6553.600 6553.400 DEPOSIT ABSOLUTE /end AXIS_DESCR
/end CHARACTERISTIC
/begin CHARACTERISTIC APP_rThresFltLowNeg_C "Schwelle zwischen unterem und mittleren Bereich für Filterung bei fallendem Signal" VALUE 0x8002C0A0 Val_Ws16 100.0000 Prc 0.00 100.0000 EXTENDED_LIMITS -400.0000 399.9878 /end CHARACTERISTIC
/begin CHARACTERISTIC APP_rThresFltLowPos_C "Schwelle zwischen unterem und mittleren Bereich für Filterung bei steigendem Signal" VALUE 0x8002C0A2 Val_Ws16 100.0000 Prc 0.00 100.0000 EXTENDED_LIMITS -400.0000 399.9878 /end CHARACTERISTIC
/begin CHARACTERISTIC APP_rThresFltMidNeg_C "Schwelle zwischen mittlerem und oberen Bereich für Filterung bei fallendem Signal" VALUE 0x8002C0A4 Val_Ws16 100.0000 Prc 0.00 100.0000 EXTENDED_LIMITS -400.0000 399.9878 /end CHARACTERISTIC
/begin CHARACTERISTIC APP_rThresFltMidPos_C "Schwelle zwischen mittlerem und oberen Bereich für Filterung bei steigendem Signal" VALUE 0x8002C0A6 Val_Ws16 100.0000 Prc 0.00 100.0000 EXTENDED_LIMITS -400.0000 399.9878 /end CHARACTERISTIC
/begin CHARACTERISTIC APP_swtEnaUnJit_C "Schalter zum Aktivieren der Entjitterung" VALUE 0x8002C0A8 Val_Wu8 1.000 OneToOne 0.00 1.000 EXTENDED_LIMITS 0.00 255.0 /end CHARACTERISTIC
/begin CHARACTERISTIC APP_swtNoFlt_C "Schalter zum Deaktivieren der Filterung bei gedrückter Kupplung" VALUE 0x8002C0A9 Val_Wu8 1.000 OneToOne 0.00 1.000 EXTENDED_LIMITS 0.00 255.0 /end CHARACTERISTIC
/begin CHARACTERISTIC APP_swtStepLim_C "Schalter um die Schrittbegrentzungsfunktion zu aktivieren (1: aktieviert, 0:deaktiviert)" VALUE 0x8002C0AA Val_Wu8 255.0 OneToOne 0.00 255.0 /end CHARACTERISTIC
/begin CHARACTERISTIC APP_tidrPT1Flt_C "" VALUE 0x8002C0AC Val_Ws32 0.98999239186 TimeDelay_s 0.0099999937043 0.99999238556 FORMAT "%12.10" EXTENDED_LIMITS 0.000002000000001 4294.9672960 /end CHARACTERISTIC
/begin CHARACTERISTIC APP_tiLowNegPT1_C "Filterparameter für fallendes Signal im unteren Bereich" VALUE 0x8002C0B0 Val_Ws32 4294.9672940 TimeDelay_s 0.000002000000001 4294.9672960 FORMAT "%12.7" /end CHARACTERISTIC
/begin CHARACTERISTIC APP_tiLowPosPT1_C "Filterparameter für steigendes Signal im unteren Bereich" VALUE 0x8002C0B4 Val_Ws32 4294.9672940 TimeDelay_s 0.000002000000001 4294.9672960 FORMAT "%12.7" /end CHARACTERISTIC
/begin CHARACTERISTIC APP_tiMidNegPT1_C "Filterparameter für fallendes Signal im mittleren Bereich" VALUE 0x8002C0B8 Val_Ws32 4294.9672940 TimeDelay_s 0.000002000000001 4294.9672960 FORMAT "%12.7" /end CHARACTERISTIC
/begin CHARACTERISTIC APP_tiMidPosPT1_C "Filterparameter für steigendes Signal im mittleren Bereich" VALUE 0x8002C0BC Val_Ws32 4294.9672940 TimeDelay_s 0.000002000000001 4294.9672960 FORMAT "%12.7" /end CHARACTERISTIC
/begin CHARACTERISTIC APP_tiUppNegPT1_C "Filterparameter für fallendes Signal im oberen Bereich" VALUE 0x8002C0C0 Val_Ws32 4294.9672940 TimeDelay_s 0.000002000000001 4294.9672960 FORMAT "%12.7" /end CHARACTERISTIC
/begin CHARACTERISTIC APP_tiUppPosPT1_C "Filterparameter für steigendes Signal im oberen Bereich" VALUE 0x8002C0C4 Val_Ws32 4294.9672940 TimeDelay_s 0.000002000000001 4294.9672960 FORMAT "%12.7" /end CHARACTERISTIC
/begin CHARACTERISTIC APP_uAPPDef_C "Fahrpedalersatzwert bei Defekt beider Geber" VALUE 0x8002C08C Val_Ws16 5300.000 Volt 0.00 5300.000 EXTENDED_LIMITS -6553.600 6553.400 /end CHARACTERISTIC
/begin CHARACTERISTIC APP_uJitter_C "Spannungsschwelle für Entjittern" VALUE 0x8002C0C8 Val_Ws16 0.4000000 Volt 0.00 0.4000000 EXTENDED_LIMITS -6553.600 6553.400 /end CHARACTERISTIC
/begin CHARACTERISTIC APP_uRaw1Def_C "Ersatzwert bei Sensor 1 defekt" VALUE 0x8002C0CA Val_Ws16 5000.000 Volt 0.00 5000.000 EXTENDED_LIMITS -6553.600 6553.400 /end CHARACTERISTIC
/begin CHARACTERISTIC APP_uRaw2Def_C "Ersatzwert bei Sensor 2 defekt" VALUE 0x8002C0CC Val_Ws16 5000.000 Volt 0.00 5000.000 EXTENDED_LIMITS -6553.600 6553.400 /end CHARACTERISTIC
/begin CHARACTERISTIC APP_uRaw2Offset_C "Offset für Sensorsignal 2" VALUE 0x8002C08E Val_Ws16 5300.000 Volt 0.00 5300.000 EXTENDED_LIMITS -6553.600 6553.400 /end CHARACTERISTIC
/begin CHARACTERISTIC ASDdc_GovClth.T1_C "ASD Störungsregler, offener Antriebsstrang (Primärzustand 1)/Zeitkonstante (T1)" VALUE 0x8002C0E0 Val_Ws16 1.499985 TimeDelay_s_Lin_16 0.00 1.499985 FORMAT "%8.6" EXTENDED_LIMITS -5.000153 5.000000 /end CHARACTERISTIC
/begin CHARACTERISTIC ASDdc_GovClth.Kd_C "ASD Störungsregler, offener Antriebsstrang (Primärzustand 1)/Verstärkungsfaktor (Kd = Td/T1)" VALUE 0x8002C0E2 Val_Ws16 5.000000 Kd16_sqr_rpm2Nm 0.00 5.000000 FORMAT "%8.6" EXTENDED_LIMITS -32.00000 31.99902 /end CHARACTERISTIC
/begin CHARACTERISTIC ASDdc_GovExtIntv.T1_C "ASD Störungsregler, externer Momenteneingriff (Primärzustand 2)/Zeitkonstante (T1)" VALUE 0x8002C0E4 Val_Ws16 1.499985 TimeDelay_s_Lin_16 0.00 1.499985 FORMAT "%8.6" EXTENDED_LIMITS -5.000153 5.000000 /end CHARACTERISTIC
/begin CHARACTERISTIC ASDdc_GovExtIntv.Kd_C "ASD Störungsregler, externer Momenteneingriff (Primärzustand 2)/Verstärkungsfaktor (Kd = Td/T1)" VALUE 0x8002C0E6 Val_Ws16 5.000000 Kd16_sqr_rpm2Nm 0.00 5.000000 FORMAT "%8.6" EXTENDED_LIMITS -32.00000 31.99902 /end CHARACTERISTIC
/begin CHARACTERISTIC ASDdc_GovGrip.T1_GMAP "ASD Störungsregler, geschlossener Antriebsstrang (Primärzustand 0)/Zeitkonstante (T1)" MAP 0x8002C0E8 MapG_Ws16 1.498917 TimeDelay_s_Lin_16 0.001068148 1.499985 FORMAT "%8.6" EXTENDED_LIMITS -5.000153 5.000000
 /begin AXIS_DESCR COM_AXIS ASDdc_rTraParSel_mp TransR 8 -327.6800 327.6700 AXIS_PTS_REF ASDdc_rTra_X_AXIS /end AXIS_DESCR
 /begin AXIS_DESCR COM_AXIS ASDdc_nEngParSel_mp EngN 5 -16384.00 16383.50 AXIS_PTS_REF ASDdc_nEngGovGrip_Y_AXIS /end AXIS_DESCR
/end CHARACTERISTIC
/begin CHARACTERISTIC ASDdc_GovGrip.Kd_GMAP "ASD Störungsregler, geschlossener Antriebsstrang (Primärzustand 0)/Verstärkungsfaktor (Kd = Td/T1)" MAP 0x8002C138 MapG_Ws16 1.500000 Kd16_sqr_rpm2Nm 0.00 1.500000 FORMAT "%8.6" EXTENDED_LIMITS -32.00000 31.99902
 /begin AXIS_DESCR COM_AXIS ASDdc_rTraParSel_mp TransR 8 -327.6800 327.6700 AXIS_PTS_REF ASDdc_rTra_X_AXIS /end AXIS_DESCR
 /begin AXIS_DESCR COM_AXIS ASDdc_nEngParSel_mp EngN 5 -16384.00 16383.50 AXIS_PTS_REF ASDdc_nEngGovGrip_Y_AXIS /end AXIS_DESCR
/end CHARACTERISTIC
/begin CHARACTERISTIC ASDdc_GovSt3.T1_GMAP "ASD Störungsregler (Primärzustand 3)/" MAP 0x8002C188 MapG_Ws16 1.498917 TimeDelay_s_Lin_16 0.001068148 1.499985 FORMAT "%8.6" EXTENDED_LIMITS -5.000153 5.000000
 /begin AXIS_DESCR COM_AXIS ASDdc_rTraParSel_mp TransR 8 -327.6800 327.6700 AXIS_PTS_REF ASDdc_rTra_X_AXIS /end AXIS_DESCR
 /begin AXIS_DESCR COM_AXIS ASDdc_nEngParSel_mp EngN 5 -16384.00 16383.50 AXIS_PTS_REF ASDdc_nEngGovGrip_Y_AXIS /end AXIS_DESCR
/end CHARACTERISTIC
/begin CHARACTERISTIC ASDdc_GovSt3.Kd_GMAP "ASD Störungsregler (Primärzustand 3)/" MAP 0x8002C1D8 MapG_Ws16 1.500000 Kd16_sqr_rpm2Nm 0.00 1.500000 FORMAT "%8.6" EXTENDED_LIMITS -32.00000 31.99902
 /begin AXIS_DESCR COM_AXIS ASDdc_rTraParSel_mp TransR 8 -327.6800 327.6700 AXIS_PTS_REF ASDdc_rTra_X_AXIS /end AXIS_DESCR
 /begin AXIS_DESCR COM_AXIS ASDdc_nEngParSel_mp EngN 5 -16384.00 16383.50 AXIS_PTS_REF ASDdc_nEngGovGrip_Y_AXIS /end AXIS_DESCR
/end CHARACTERISTIC
/begin CHARACTERISTIC ASDdc_GovSt4.T1_C "ASD Störungsregler (Primärzustand 4)/Zeitkonstante (T1)" VALUE 0x8002C228 Val_Ws16 1.499985 TimeDelay_s_Lin_16 0.00 1.499985 FORMAT "%8.6" EXTENDED_LIMITS -5.000153 5.000000 /end CHARACTERISTIC
/begin CHARACTERISTIC ASDdc_GovSt4.Kd_C "ASD Störungsregler (Primärzustand 4)/Verstärkungsfaktor (Kd = Td/T1)" VALUE 0x8002C22A Val_Ws16 5.000000 Kd16_sqr_rpm2Nm 0.00 5.000000 FORMAT "%8.6" EXTENDED_LIMITS -32.00000 31.99902 /end CHARACTERISTIC
/begin AXIS_PTS ASDdc_nEngGovGrip_Y_AXIS "Gruppenachse für Motordrehzahl" 0x8002C22C ASDdc_nEngParSel_mp Axis_Xs16 32767.50 EngN 5 -16384.00 16383.50 FORMAT "%8.2" DEPOSIT ABSOLUTE /end AXIS_PTS
/begin CHARACTERISTIC ASDdc_numDflSt_C "Nummer des Default-Primärzustandes (dezimal kodiert)" VALUE 0x8002C238 Val_Wu16 4.00000000000 ASDdc_numDflSt 0.00 4.00000000000 FORMAT "%13.11" /end CHARACTERISTIC
/begin CHARACTERISTIC ASDdc_numPrio_CA "Prioritäten der Primärzustände" VAL_BLK 0x8002C23A ValA_Wu8 255.0 OneToOne 0.00 255.0 NUMBER 5 /end CHARACTERISTIC
/begin CHARACTERISTIC ASDdc_rClthGripThres_C "Kraftschlussschwelle für Eingangsbedingung ""Kraftschluss und Nulldurchgang des Störungsreglers""" VALUE 0x8002C240 Val_Ws16 655.3500 Fact100 -327.6800 327.6700 FORMAT "%8.4" /end CHARACTERISTIC
/begin CHARACTERISTIC ASDdc_rGripThres1_C "Kraftschlussschwelle für Eingangsbedingung ""Kraftschluss 1""" VALUE 0x8002C242 Val_Ws16 655.3500 Fact100 -327.6800 327.6700 FORMAT "%8.4" /end CHARACTERISTIC
/begin CHARACTERISTIC ASDdc_rGripThres2_C "Kraftschlussschwelle für Eingangsbedingung ""Kraftschluss 2""" VALUE 0x8002C244 Val_Ws16 655.3500 Fact100 -327.6800 327.6700 FORMAT "%8.4" /end CHARACTERISTIC
/begin CHARACTERISTIC ASDdc_rGripThres3_C "Kraftschlussschwelle für Eingangsbedingung ""Kraftschluss 3""" VALUE 0x8002C246 Val_Ws16 655.3500 Fact100 -327.6800 327.6700 FORMAT "%8.4" /end CHARACTERISTIC
/begin CHARACTERISTIC ASDdc_rGripThres4_C "Kraftschlussschwelle für Eingangsbedingung ""Kraftschluss 4""" VALUE 0x8002C248 Val_Ws16 655.3500 Fact100 -327.6800 327.6700 FORMAT "%8.4" /end CHARACTERISTIC
/begin AXIS_PTS ASDdc_rTra_X_AXIS "Gruppenachse für Getriebeübersetzung" 0x8002C24A ASDdc_rTraParSel_mp Axis_Xs16 655.3500 TransR 8 -327.6800 327.6700 FORMAT "%8.4" DEPOSIT ABSOLUTE /end AXIS_PTS
/begin CHARACTERISTIC ASDdc_stCfgConExtIntv_C "Festlegung der Eingangsbedingung ""externer Momenteneingriff"" (Bitmaske zur Nachricht GlbDa_stTrqDem)" VALUE 0x8002C25C Val_Wu16 65535.00 OneToOne 0.00 65535.00 /end CHARACTERISTIC
/begin CHARACTERISTIC ASDdc_stClthGrip_C "Konfiguration der Eingangsbedingung ""Kraftschluss und Nulldurchgang des Störungsreglers""" VALUE 0x8002C25E Val_Wu16 65535.00 OneToOne 0.00 65535.00 /end CHARACTERISTIC
/begin CHARACTERISTIC ASDdc_stExtIntv_C "Konfiguration der Eingangsbedingung ""externer Momenteneingriff""" VALUE 0x8002C260 Val_Wu16 65535.00 OneToOne 0.00 65535.00 /end CHARACTERISTIC
/begin CHARACTERISTIC ASDdc_stGearSwt_C "Konfiguration der Eingangsbedingung ""Gangumschaltung aktiv""" VALUE 0x8002C262 Val_Wu16 65535.00 OneToOne 0.00 65535.00 /end CHARACTERISTIC
/begin CHARACTERISTIC ASDdc_stGrip1_C "Konfiguration der Eingangsbedingung ""Kraftschluss 1""" VALUE 0x8002C264 Val_Wu16 65535.00 OneToOne 0.00 65535.00 /end CHARACTERISTIC
/begin CHARACTERISTIC ASDdc_stGrip2_C "Konfiguration der Eingangsbedingung ""Kraftschluss 2""" VALUE 0x8002C266 Val_Wu16 65535.00 OneToOne 0.00 65535.00 /end CHARACTERISTIC
/begin CHARACTERISTIC ASDdc_stGrip3_C "Konfiguration der Eingangsbedingung ""Kraftschluss 3""" VALUE 0x8002C268 Val_Wu16 65535.00 OneToOne 0.00 65535.00 /end CHARACTERISTIC
/begin CHARACTERISTIC ASDdc_stGrip4_C "Konfiguration der Eingangsbedingung ""Kraftschluss 4""" VALUE 0x8002C26A Val_Wu16 65535.00 OneToOne 0.00 65535.00 /end CHARACTERISTIC
/begin CHARACTERISTIC ASDdc_stGripRaw_C "Konfiguration der Eingangsbedingung ""geschlossener Antriebsstrang""" VALUE 0x8002C26C Val_Wu16 65535.00 OneToOne 0.00 65535.00 /end CHARACTERISTIC
/begin CHARACTERISTIC ASDdc_stLADOff_C "Schalter zum Deaktivieren des ASDdc in speziellen Fällen des ASDrf_stLAD (FF = nie deaktivieren)" VALUE 0x8002C0D0 Val_Wu8 255.0 OneToOne 0.00 255.0 /end CHARACTERISTIC
/begin CHARACTERISTIC ASDdc_swtCalcN_C "1: ASDdc_nEngParSel_mp = EPM_nEng; 0: ASDdc_nEngParSel_mp = EPM_nEng - SpdGov_nSetPLo[1]" VALUE 0x8002C26E Val_Wu8 1.000 OneToOne 0.00 1.000 EXTENDED_LIMITS 0.00 255.0 /end CHARACTERISTIC
/begin CHARACTERISTIC ASDdc_swtFolDyn_C "" VALUE 0x8002C26F Val_Wu8 2.000 OneToOne 0.00 2.000 EXTENDED_LIMITS 0.00 255.0 /end CHARACTERISTIC
/begin CHARACTERISTIC ASDdc_swtIniParSet_C "Schalter zur Aktivierung/Deaktivierung der kontinuierlichen Initialisierung aufgrund Parametersatzwechsels" VALUE 0x8002C0D1 Val_Wu8 1.000 OneToOne 0.00 1.000 EXTENDED_LIMITS 0.00 255.0 /end CHARACTERISTIC
/begin CHARACTERISTIC ASDdc_swtOpr_C "Schalter des Verknüpfungsoperators (00=OR : 01=AND : 10=NAND : 11=NOR)" VALUE 0x8002C270 Val_Wu16 65535.00 OneToOne 0.00 65535.00 /end CHARACTERISTIC
/begin CHARACTERISTIC ASDdc_trqLimMax_C "ASD Störungsregler Ausgangsbegrenzung Maximum" VALUE 0x8002C0D4 Val_Wr32 1500.00000 Trq_float -500.000000 1000.00000 EXTENDED_LIMITS -1.00000000E+037 1.00000000E+037 /end CHARACTERISTIC
/begin CHARACTERISTIC ASDdc_trqLimMin_C "ASD Störungsregler Ausgangsbegrenzung Minimum" VALUE 0x8002C0D8 Val_Wr32 1500.00000 Trq_float -500.000000 1000.00000 EXTENDED_LIMITS -1.00000000E+037 1.00000000E+037 /end CHARACTERISTIC
/begin CHARACTERISTIC ASDdc_vLimIni_C "ASD Störungsregler Geschwindigkeitsschwelle für Initialisierung / Deaktivierung" VALUE 0x8002C0DC Val_Ws16 655.3400 Vel -327.6700 327.6700 EXTENDED_LIMITS -327.6800 327.6700 /end CHARACTERISTIC
/begin CHARACTERISTIC ASDrf_CoefBLimNegHysHi_C "Koeffizient B Hystereseschwelle oben zur Deaktivierung des LAD für neg. Eingangsgradienten" VALUE 0x8002C274 Val_Wr32 10100.0000 ASDrf_dTrq_float 0.00 10100.0000 FORMAT "%10.4" EXTENDED_LIMITS -1.00000000E+037 1.00000000E+037 /end CHARACTERISTIC
/begin CHARACTERISTIC ASDrf_CoefBLimNegHysLo_C "Koeffizient B Hystereseschwelle unten zur Deaktivierung des LAD für neg. Eingangsgradienten" VALUE 0x8002C278 Val_Wr32 10100.0000 ASDrf_dTrq_float 0.00 10100.0000 FORMAT "%10.4" EXTENDED_LIMITS -1.00000000E+037 1.00000000E+037 /end CHARACTERISTIC
/begin CHARACTERISTIC ASDrf_CoefBLimPosHysHi_C "Koeffizient B Hystereseschwelle oben zur Deaktivierung des LAD für pos. Eingangsgradienten" VALUE 0x8002C27C Val_Wr32 10100.0000 ASDrf_dTrq_float 0.00 10100.0000 FORMAT "%10.4" EXTENDED_LIMITS -1.00000000E+037 1.00000000E+037 /end CHARACTERISTIC
/begin CHARACTERISTIC ASDrf_CoefBLimPosHysLo_C "Koeffizient B Hystereseschwelle unten zur Deaktivierung des LAD für pos. Eingangsgradienten" VALUE 0x8002C280 Val_Wr32 10100.0000 ASDrf_dTrq_float 0.00 10100.0000 FORMAT "%10.4" EXTENDED_LIMITS -1.00000000E+037 1.00000000E+037 /end CHARACTERISTIC
/begin CHARACTERISTIC ASDrf_dtrqSwtLimOff_C "Schwell zur Aktivierung/Deaktivierung der Steigungsbegrenzung" VALUE 0x8002C284 Val_Wr32 2000.00000 ASDrf_dTrq_float 0.00 2000.00000 FORMAT "%10.5" EXTENDED_LIMITS -1.00000000E+037 1.00000000E+037 /end CHARACTERISTIC
/begin AXIS_PTS ASDrf_facDyn_X_AXIS "Gruppenachse für Dynamikfaktor" 0x8002C2F0 ASDrf_facDesDynFlt_mp Axis_Xs16 7.999878 Fact 11 -4.000000 3.999878 FORMAT "%8.6" DEPOSIT ABSOLUTE /end AXIS_PTS
/begin CHARACTERISTIC ASDrf_facLAD2ClthEngNNeg_C "Korrekturfaktor für Motordrehzahl für negative Eingangsgradienten bei offenem Antriebsstrang" VALUE 0x8002C308 Val_Ws16 40.00000 Fact1 -20.00000 20.00000 EXTENDED_LIMITS -256.0000 255.9922 /end CHARACTERISTIC
/begin CHARACTERISTIC ASDrf_facLAD2ClthEngNPos_C "Korrekturfaktor für Motordrehzahl für positive Eingangsgradienten bei offenem Antriebsstrang" VALUE 0x8002C30A Val_Ws16 40.00000 Fact1 -20.00000 20.00000 EXTENDED_LIMITS -256.0000 255.9922 /end CHARACTERISTIC
/begin CHARACTERISTIC ASDrf_facLAD2GripEngNNeg_GCUR "Korrekturfaktor für Motordrehzahl für negative Eingangsgradienten bei geschlossenem Antriebsstrang" CURVE 0x8002C30C CurG_Ws16 40.00000 Fact1 -20.00000 20.00000 EXTENDED_LIMITS -256.0000 255.9922
 /begin AXIS_DESCR COM_AXIS ASDrf_rTraParSel_mp TransR 8 -327.6800 327.6700 AXIS_PTS_REF ASDrf_rTra_X_AXIS /end AXIS_DESCR
/end CHARACTERISTIC
/begin CHARACTERISTIC ASDrf_facLAD2GripEngNPos_GCUR "Korrekturfaktor für Motordrehzahl für positive Eingangsgradienten bei geschlossenem Antriebsstrang" CURVE 0x8002C31C CurG_Ws16 40.00000 Fact1 -20.00000 20.00000 EXTENDED_LIMITS -256.0000 255.9922
 /begin AXIS_DESCR COM_AXIS ASDrf_rTraParSel_mp TransR 8 -327.6800 327.6700 AXIS_PTS_REF ASDrf_rTra_X_AXIS /end AXIS_DESCR
/end CHARACTERISTIC
/begin CHARACTERISTIC ASDrf_facLAD2St0EngNNeg_C "Korrekturfaktor für Motordrehzahl für negative Eingangsgradienten im Primärzustand 0" VALUE 0x8002C32C Val_Ws16 40.00000 Fact1 -20.00000 20.00000 EXTENDED_LIMITS -256.0000 255.9922 /end CHARACTERISTIC
/begin CHARACTERISTIC ASDrf_facLAD2St0EngNPos_C "Korrekturfaktor für Motordrehzahl für positive Eingangsgradienten im Primärzustand 0" VALUE 0x8002C32E Val_Ws16 40.00000 Fact1 -20.00000 20.00000 EXTENDED_LIMITS -256.0000 255.9922 /end CHARACTERISTIC
/begin CHARACTERISTIC ASDrf_facLAD2St3EngNNeg_GCUR "Korrekturfaktor für Motordrehzahl für negative Eingangsgradienten im Primärzustand 3" CURVE 0x8002C330 CurG_Ws16 40.00000 Fact1 -20.00000 20.00000 EXTENDED_LIMITS -256.0000 255.9922
 /begin AXIS_DESCR COM_AXIS ASDrf_rTraParSel_mp TransR 8 -327.6800 327.6700 AXIS_PTS_REF ASDrf_rTra_X_AXIS /end AXIS_DESCR
/end CHARACTERISTIC
/begin CHARACTERISTIC ASDrf_facLAD2St3EngNPos_GCUR "Korrekturfaktor für Motordrehzahl für positive Eingangsgradienten im Primärzustand 3" CURVE 0x8002C340 CurG_Ws16 40.00000 Fact1 -20.00000 20.00000 EXTENDED_LIMITS -256.0000 255.9922
 /begin AXIS_DESCR COM_AXIS ASDrf_rTraParSel_mp TransR 8 -327.6800 327.6700 AXIS_PTS_REF ASDrf_rTra_X_AXIS /end AXIS_DESCR
/end CHARACTERISTIC
/begin CHARACTERISTIC ASDrf_facLAD2St4EngNNeg_C "Korrekturfaktor für Motordrehzahl für negative Eingangsgradienten im Primärzustand 4" VALUE 0x8002C350 Val_Ws16 40.00000 Fact1 -20.00000 20.00000 EXTENDED_LIMITS -256.0000 255.9922 /end CHARACTERISTIC
/begin CHARACTERISTIC ASDrf_facLAD2St4EngNPos_C "Korrekturfaktor für Motordrehzahl für positive Eingangsgradienten im Primärzustand 4" VALUE 0x8002C352 Val_Ws16 40.00000 Fact1 -20.00000 20.00000 EXTENDED_LIMITS -256.0000 255.9922 /end CHARACTERISTIC
/begin CHARACTERISTIC ASDrf_FltClthNeg.T1_C "ASD Führungsformer neg. Gradient, offener Antriebsstrang (Primärzustand 1)/Zeitkonstante (T1)" VALUE 0x8002C354 Val_Ws16 4.999847 TimeDelay_s_Lin_16 0.0001525925 5.000000 FORMAT "%8.6" EXTENDED_LIMITS -5.000153 5.000000 /end CHARACTERISTIC
/begin CHARACTERISTIC ASDrf_FltClthNeg.Kd_C "ASD Führungsformer neg. Gradient, offener Antriebsstrang (Primärzustand 1)/Verstärkungsfaktor (Kd)" VALUE 0x8002C356 Val_Ws16 1.000000 Kd_Lin_16 0.00 1.000000 FORMAT "%8.6" EXTENDED_LIMITS -1.000031 1.000000 /end CHARACTERISTIC
/begin CHARACTERISTIC ASDrf_FltClthPos.T1_C "ASD Führungsformer pos. Gradient, offener Antriebsstrang (Primärzustand 1)/Zeitkonstante (T1)" VALUE 0x8002C358 Val_Ws16 4.999847 TimeDelay_s_Lin_16 0.0001525925 5.000000 FORMAT "%8.6" EXTENDED_LIMITS -5.000153 5.000000 /end CHARACTERISTIC
/begin CHARACTERISTIC ASDrf_FltClthPos.Kd_C "ASD Führungsformer pos. Gradient, offener Antriebsstrang (Primärzustand 1)/Verstärkungsfaktor (Kd)" VALUE 0x8002C35A Val_Ws16 1.000000 Kd_Lin_16 0.00 1.000000 FORMAT "%8.6" EXTENDED_LIMITS -1.000031 1.000000 /end CHARACTERISTIC
/begin CHARACTERISTIC ASDrf_FltGripNeg.T1_GMAP "ASD Führungsformer neg. Gradient, geschlossener Antriebsstrang (Primärzustand 2)/Zeitkonstante (T1)" MAP 0x8002C35C MapG_Ws16 4.999847 TimeDelay_s_Lin_16 0.0001525925 5.000000 FORMAT "%8.6" EXTENDED_LIMITS -5.000153 5.000000
 /begin AXIS_DESCR COM_AXIS ASDrf_rTraParSel_mp TransR 8 -327.6800 327.6700 AXIS_PTS_REF ASDrf_rTra_X_AXIS /end AXIS_DESCR
 /begin AXIS_DESCR COM_AXIS Epm_nEng EngN 8 -16384.00 16383.50 AXIS_PTS_REF ASDrf_nEngFltGripNeg_Y_AXIS /end AXIS_DESCR
/end CHARACTERISTIC
/begin CHARACTERISTIC ASDrf_FltGripNeg.Kd_GMAP "ASD Führungsformer neg. Gradient, geschlossener Antriebsstrang (Primärzustand 2)/Verstärkungsfaktor (Kd)" MAP 0x8002C3DC MapG_Ws16 1.000000 Kd_Lin_16 0.00 1.000000 FORMAT "%8.6" EXTENDED_LIMITS -1.000031 1.000000
 /begin AXIS_DESCR COM_AXIS ASDrf_rTraParSel_mp TransR 8 -327.6800 327.6700 AXIS_PTS_REF ASDrf_rTra_X_AXIS /end AXIS_DESCR
 /begin AXIS_DESCR COM_AXIS Epm_nEng EngN 8 -16384.00 16383.50 AXIS_PTS_REF ASDrf_nEngFltGripNeg_Y_AXIS /end AXIS_DESCR
/end CHARACTERISTIC
/begin CHARACTERISTIC ASDrf_FltGripPos.T1_GMAP "ASD Führungsformer pos. Gradient, geschlossener Antriebsstrang (Primärzustand 2)/Zeitkonstante (T1)" MAP 0x8002C45C MapG_Ws16 4.999847 TimeDelay_s_Lin_16 0.0001525925 5.000000 FORMAT "%8.6" EXTENDED_LIMITS -5.000153 5.000000
 /begin AXIS_DESCR COM_AXIS ASDrf_rTraParSel_mp TransR 8 -327.6800 327.6700 AXIS_PTS_REF ASDrf_rTra_X_AXIS /end AXIS_DESCR
 /begin AXIS_DESCR COM_AXIS Epm_nEng EngN 8 -16384.00 16383.50 AXIS_PTS_REF ASDrf_nEngFltGripPos_Y_AXIS /end AXIS_DESCR
/end CHARACTERISTIC
/begin CHARACTERISTIC ASDrf_FltGripPos.Kd_GMAP "ASD Führungsformer pos. Gradient, geschlossener Antriebsstrang (Primärzustand 2)/Verstärkungsfaktor (Kd)" MAP 0x8002C4DC MapG_Ws16 1.000000 Kd_Lin_16 0.00 1.000000 FORMAT "%8.6" EXTENDED_LIMITS -1.000031 1.000000
 /begin AXIS_DESCR COM_AXIS ASDrf_rTraParSel_mp TransR 8 -327.6800 327.6700 AXIS_PTS_REF ASDrf_rTra_X_AXIS /end AXIS_DESCR
 /begin AXIS_DESCR COM_AXIS Epm_nEng EngN 8 -16384.00 16383.50 AXIS_PTS_REF ASDrf_nEngFltGripPos_Y_AXIS /end AXIS_DESCR
/end CHARACTERISTIC
/begin CHARACTERISTIC ASDrf_FltSt0Neg.T1_C "ASD Führungsformer neg. Gradient (Primärzustand 0)/Zeitkonstante (T1)" VALUE 0x8002C55C Val_Ws16 4.999847 TimeDelay_s_Lin_16 0.0001525925 5.000000 FORMAT "%8.6" EXTENDED_LIMITS -5.000153 5.000000 /end CHARACTERISTIC
/begin CHARACTERISTIC ASDrf_FltSt0Neg.Kd_C "ASD Führungsformer neg. Gradient (Primärzustand 0)/Verstärkungsfaktor (Kd)" VALUE 0x8002C55E Val_Ws16 1.000000 Kd_Lin_16 0.00 1.000000 FORMAT "%8.6" EXTENDED_LIMITS -1.000031 1.000000 /end CHARACTERISTIC
/begin CHARACTERISTIC ASDrf_FltSt0Pos.T1_C "ASD Führungsformer pos. Gradient (Primärzustand 0)/Zeitkonstante (T1)" VALUE 0x8002C560 Val_Ws16 4.999847 TimeDelay_s_Lin_16 0.0001525925 5.000000 FORMAT "%8.6" EXTENDED_LIMITS -5.000153 5.000000 /end CHARACTERISTIC
/begin CHARACTERISTIC ASDrf_FltSt0Pos.Kd_C "ASD Führungsformer pos. Gradient (Primärzustand 0)/Verstärkungsfaktor (Kd)" VALUE 0x8002C562 Val_Ws16 1.000000 Kd_Lin_16 0.00 1.000000 FORMAT "%8.6" EXTENDED_LIMITS -1.000031 1.000000 /end CHARACTERISTIC
/begin CHARACTERISTIC ASDrf_FltSt3Neg.T1_GMAP "ASD Führungsformer neg. Gradient (Primärzustand 3)/Zeitkonstante (T1)" MAP 0x8002C564 MapG_Ws16 4.999847 TimeDelay_s_Lin_16 0.0001525925 5.000000 FORMAT "%8.6" EXTENDED_LIMITS -5.000153 5.000000
 /begin AXIS_DESCR COM_AXIS ASDrf_rTraParSel_mp TransR 8 -327.6800 327.6700 AXIS_PTS_REF ASDrf_rTra_X_AXIS /end AXIS_DESCR
 /begin AXIS_DESCR COM_AXIS Epm_nEng EngN 8 -16384.00 16383.50 AXIS_PTS_REF ASDrf_nEngFltSt3Neg_Y_AXIS /end AXIS_DESCR
/end CHARACTERISTIC
/begin CHARACTERISTIC ASDrf_FltSt3Neg.Kd_GMAP "ASD Führungsformer neg. Gradient (Primärzustand 3)/Verstärkungsfaktor (Kd)" MAP 0x8002C5E4 MapG_Ws16 1.000000 Kd_Lin_16 0.00 1.000000 FORMAT "%8.6" EXTENDED_LIMITS -1.000031 1.000000
 /begin AXIS_DESCR COM_AXIS ASDrf_rTraParSel_mp TransR 8 -327.6800 327.6700 AXIS_PTS_REF ASDrf_rTra_X_AXIS /end AXIS_DESCR
 /begin AXIS_DESCR COM_AXIS Epm_nEng EngN 8 -16384.00 16383.50 AXIS_PTS_REF ASDrf_nEngFltSt3Neg_Y_AXIS /end AXIS_DESCR
/end CHARACTERISTIC
/begin CHARACTERISTIC ASDrf_FltSt3Pos.T1_GMAP "ASD Führungsformer pos. Gradient (Primärzustand 3)/Zeitkonstante (T1)" MAP 0x8002C664 MapG_Ws16 4.999847 TimeDelay_s_Lin_16 0.0001525925 5.000000 FORMAT "%8.6" EXTENDED_LIMITS -5.000153 5.000000
 /begin AXIS_DESCR COM_AXIS ASDrf_rTraParSel_mp TransR 8 -327.6800 327.6700 AXIS_PTS_REF ASDrf_rTra_X_AXIS /end AXIS_DESCR
 /begin AXIS_DESCR COM_AXIS Epm_nEng EngN 8 -16384.00 16383.50 AXIS_PTS_REF ASDrf_nEngFltSt3Pos_Y_AXIS /end AXIS_DESCR
/end CHARACTERISTIC
/begin CHARACTERISTIC ASDrf_FltSt3Pos.Kd_GMAP "ASD Führungsformer pos. Gradient (Primärzustand 3)/Verstärkungsfaktor (Kd)" MAP 0x8002C6E4 MapG_Ws16 1.000000 Kd_Lin_16 0.00 1.000000 FORMAT "%8.6" EXTENDED_LIMITS -1.000031 1.000000
 /begin AXIS_DESCR COM_AXIS ASDrf_rTraParSel_mp TransR 8 -327.6800 327.6700 AXIS_PTS_REF ASDrf_rTra_X_AXIS /end AXIS_DESCR
 /begin AXIS_DESCR COM_AXIS Epm_nEng EngN 8 -16384.00 16383.50 AXIS_PTS_REF ASDrf_nEngFltSt3Pos_Y_AXIS /end AXIS_DESCR
/end CHARACTERISTIC
/begin CHARACTERISTIC ASDrf_FltSt4Neg.T1_C "ASD Führungsformer neg. Gradient (Primärzustand 4)/Zeitkonstante (T1)" VALUE 0x8002C764 Val_Ws16 4.999847 TimeDelay_s_Lin_16 0.0001525925 5.000000 FORMAT "%8.6" EXTENDED_LIMITS -5.000153 5.000000 /end CHARACTERISTIC
/begin CHARACTERISTIC ASDrf_FltSt4Neg.Kd_C "ASD Führungsformer neg. Gradient (Primärzustand 4)/Verstärkungsfaktor (Kd)" VALUE 0x8002C766 Val_Ws16 1.000000 Kd_Lin_16 0.00 1.000000 FORMAT "%8.6" EXTENDED_LIMITS -1.000031 1.000000 /end CHARACTERISTIC
/begin CHARACTERISTIC ASDrf_FltSt4Pos.T1_C "ASD Führungsformer pos. Gradient (Primärzustand 4)/Zeitkonstante (T1)" VALUE 0x8002C768 Val_Ws16 4.999847 TimeDelay_s_Lin_16 0.0001525925 5.000000 FORMAT "%8.6" EXTENDED_LIMITS -5.000153 5.000000 /end CHARACTERISTIC
/begin CHARACTERISTIC ASDrf_FltSt4Pos.Kd_C "ASD Führungsformer pos. Gradient (Primärzustand 4)/Verstärkungsfaktor (Kd)" VALUE 0x8002C76A Val_Ws16 1.000000 Kd_Lin_16 0.00 1.000000 FORMAT "%8.6" EXTENDED_LIMITS -1.000031 1.000000 /end CHARACTERISTIC
/begin CHARACTERISTIC ASDrf_FltSt4Pos.ASDrf_swtFolDyn_C "ASD Führungsformer pos. Gradient (Primärzustand 4)/" VALUE 0x8002C76C Val_Wu8 2.000 OneToOne 0.00 2.000 EXTENDED_LIMITS 0.00 255.0 /end CHARACTERISTIC
/begin CHARACTERISTIC ASDrf_KpLAD2PGovNeg_C "Verstärkungsfaktor des P-Reglers für neg. Eingangsgradienten (LAD Betriebsmodus 2)" VALUE 0x8002C288 Val_Ws32 20.0000000000 ASDrf_Kp_rpm2Nm 0.00 20.0000000000 FORMAT "%13.10" EXTENDED_LIMITS -13107.2000000 13107.1999939 /end CHARACTERISTIC
/begin CHARACTERISTIC ASDrf_KpLAD2PGovPos_C "Verstärkungsfaktor des P-Reglers für pos. Eingangsgradienten (LAD Betriebsmodus 2)" VALUE 0x8002C28C Val_Ws32 20.0000000000 ASDrf_Kp_rpm2Nm 0.00 20.0000000000 FORMAT "%13.10" EXTENDED_LIMITS -13107.2000000 13107.1999939 /end CHARACTERISTIC
/begin CHARACTERISTIC ASDrf_LADClthNeg.CoefA_C "Parabelkennwerte des LAD Steigungsbegrenzung neg. Gradient, offener Antriebsstrang (Primärzustand 1)/Parabelkoeffizient A" VALUE 0x8002C76E Val_Ws16 159.9951 ASDrf_LADCoefA 0.00 159.9951 FORMAT "%8.4" EXTENDED_LIMITS -160.0000 159.9951 /end CHARACTERISTIC
/begin CHARACTERISTIC ASDrf_LADClthNeg.CoefB_C "Parabelkennwerte des LAD Steigungsbegrenzung neg. Gradient, offener Antriebsstrang (Primärzustand 1)/Parabelkoeffizient B" VALUE 0x8002C770 Val_Ws16 3276.700 dTrq 0.00 3276.700 FORMAT "%8.3" EXTENDED_LIMITS -3276.800 3276.700 /end CHARACTERISTIC
/begin CHARACTERISTIC ASDrf_LADClthPos.CoefA_C "Parabelkennwerte des LAD Steigungsbegrenzung pos. Gradient, offener Antriebsstrang (Primärzustand 1)/Parabelkoeffizient A" VALUE 0x8002C772 Val_Ws16 159.9951 ASDrf_LADCoefA 0.00 159.9951 FORMAT "%8.4" EXTENDED_LIMITS -160.0000 159.9951 /end CHARACTERISTIC
/begin CHARACTERISTIC ASDrf_LADClthPos.CoefB_C "Parabelkennwerte des LAD Steigungsbegrenzung pos. Gradient, offener Antriebsstrang (Primärzustand 1)/Parabelkoeffizient B" VALUE 0x8002C774 Val_Ws16 3276.700 dTrq 0.00 3276.700 FORMAT "%8.3" EXTENDED_LIMITS -3276.800 3276.700 /end CHARACTERISTIC
/begin CHARACTERISTIC ASDrf_LADGripFacNeg.facCoefA_GCUR "Faktor zum Parabelkennwerte des LAD Steigungsbegrenzung neg. Gradient, geschlossener Antriebsstrang (Primärzustand 2)/Faktor zum Parabelkoeffizient A" CURVE 0x8002C776 CurG_Ws16 100.0000 Fact1 0.00 100.0000 EXTENDED_LIMITS -256.0000 255.9922
 /begin AXIS_DESCR COM_AXIS ASDrf_facDesDynFlt_mp Fact 11 -4.000000 3.999878 AXIS_PTS_REF ASDrf_facDyn_X_AXIS /end AXIS_DESCR
/end CHARACTERISTIC
/begin CHARACTERISTIC ASDrf_LADGripFacNeg.facCoefB_GCUR "Faktor zum Parabelkennwerte des LAD Steigungsbegrenzung neg. Gradient, geschlossener Antriebsstrang (Primärzustand 2)/Faktor zum Parabelkoeffizient B" CURVE 0x8002C78C CurG_Ws16 100.0000 Fact1 0.00 100.0000 EXTENDED_LIMITS -256.0000 255.9922
 /begin AXIS_DESCR COM_AXIS ASDrf_facDesDynFlt_mp Fact 11 -4.000000 3.999878 AXIS_PTS_REF ASDrf_facDyn_X_AXIS /end AXIS_DESCR
/end CHARACTERISTIC
/begin CHARACTERISTIC ASDrf_LADGripFacPos.facCoefA_GCUR "Faktor zum Parabelkennwerte des LAD Steigungsbegrenzung pos. Gradient, geschlossener Antriebsstrang (Primärzustand 2)/Faktor zum Parabelkoeffizient A" CURVE 0x8002C7A2 CurG_Ws16 100.0000 Fact1 0.00 100.0000 EXTENDED_LIMITS -256.0000 255.9922
 /begin AXIS_DESCR COM_AXIS ASDrf_facDesDynFlt_mp Fact 11 -4.000000 3.999878 AXIS_PTS_REF ASDrf_facDyn_X_AXIS /end AXIS_DESCR
/end CHARACTERISTIC
/begin CHARACTERISTIC ASDrf_LADGripFacPos.facCoefB_GCUR "Faktor zum Parabelkennwerte des LAD Steigungsbegrenzung pos. Gradient, geschlossener Antriebsstrang (Primärzustand 2)/Faktor zum Parabelkoeffizient B" CURVE 0x8002C7B8 CurG_Ws16 100.0000 Fact1 0.00 100.0000 EXTENDED_LIMITS -256.0000 255.9922
 /begin AXIS_DESCR COM_AXIS ASDrf_facDesDynFlt_mp Fact 11 -4.000000 3.999878 AXIS_PTS_REF ASDrf_facDyn_X_AXIS /end AXIS_DESCR
/end CHARACTERISTIC
/begin CHARACTERISTIC ASDrf_LADGripNeg.CoefA_GMAP "Parabelkennwerte des LAD Steigungsbegrenzung neg. Gradient, geschlossener Antriebsstrang (Primärzustand 2)/Parabelkoeffizient A" MAP 0x8002C7CE MapG_Ws16 159.9951 ASDrf_LADCoefA 0.00 159.9951 FORMAT "%8.4" EXTENDED_LIMITS -160.0000 159.9951
 /begin AXIS_DESCR COM_AXIS ASDrf_rTraParSel_mp TransR 8 -327.6800 327.6700 AXIS_PTS_REF ASDrf_rTra_X_AXIS /end AXIS_DESCR
 /begin AXIS_DESCR COM_AXIS Epm_nEng EngN 8 -16384.00 16383.50 AXIS_PTS_REF ASDrf_nEngLADGripNeg_Y_AXIS /end AXIS_DESCR
/end CHARACTERISTIC
/begin CHARACTERISTIC ASDrf_LADGripNeg.CoefB_GMAP "Parabelkennwerte des LAD Steigungsbegrenzung neg. Gradient, geschlossener Antriebsstrang (Primärzustand 2)/Parabelkoeffizient B" MAP 0x8002C84E MapG_Ws16 3276.700 dTrq 0.00 3276.700 FORMAT "%8.3" EXTENDED_LIMITS -3276.800 3276.700
 /begin AXIS_DESCR COM_AXIS ASDrf_rTraParSel_mp TransR 8 -327.6800 327.6700 AXIS_PTS_REF ASDrf_rTra_X_AXIS /end AXIS_DESCR
 /begin AXIS_DESCR COM_AXIS Epm_nEng EngN 8 -16384.00 16383.50 AXIS_PTS_REF ASDrf_nEngLADGripNeg_Y_AXIS /end AXIS_DESCR
/end CHARACTERISTIC
/begin CHARACTERISTIC ASDrf_LADGripPos.CoefA_GMAP "Parabelkennwerte des LAD Steigungsbegrenzung pos. Gradient, geschlossener Antriebsstrang (Primärzustand 2)/Parabelkoeffizient A" MAP 0x8002C8CE MapG_Ws16 159.9951 ASDrf_LADCoefA 0.00 159.9951 FORMAT "%8.4" EXTENDED_LIMITS -160.0000 159.9951
 /begin AXIS_DESCR COM_AXIS ASDrf_rTraParSel_mp TransR 8 -327.6800 327.6700 AXIS_PTS_REF ASDrf_rTra_X_AXIS /end AXIS_DESCR
 /begin AXIS_DESCR COM_AXIS Epm_nEng EngN 8 -16384.00 16383.50 AXIS_PTS_REF ASDrf_nEngLADGripPos_Y_AXIS /end AXIS_DESCR
/end CHARACTERISTIC
/begin CHARACTERISTIC ASDrf_LADGripPos.CoefB_GMAP "Parabelkennwerte des LAD Steigungsbegrenzung pos. Gradient, geschlossener Antriebsstrang (Primärzustand 2)/Parabelkoeffizient B" MAP 0x8002C94E MapG_Ws16 3276.700 dTrq 0.00 3276.700 FORMAT "%8.3" EXTENDED_LIMITS -3276.800 3276.700
 /begin AXIS_DESCR COM_AXIS ASDrf_rTraParSel_mp TransR 8 -327.6800 327.6700 AXIS_PTS_REF ASDrf_rTra_X_AXIS /end AXIS_DESCR
 /begin AXIS_DESCR COM_AXIS Epm_nEng EngN 8 -16384.00 16383.50 AXIS_PTS_REF ASDrf_nEngLADGripPos_Y_AXIS /end AXIS_DESCR
/end CHARACTERISTIC
/begin CHARACTERISTIC ASDrf_LADSt0Neg.CoefA_C "Parabelkennwerte des LAD Steigungsbegrenzung neg. Gradient (Primärzustand 0)/Parabelkoeffizient A" VALUE 0x8002C9CE Val_Ws16 159.9951 ASDrf_LADCoefA 0.00 159.9951 FORMAT "%8.4" EXTENDED_LIMITS -160.0000 159.9951 /end CHARACTERISTIC
/begin CHARACTERISTIC ASDrf_LADSt0Neg.CoefB_C "Parabelkennwerte des LAD Steigungsbegrenzung neg. Gradient (Primärzustand 0)/Parabelkoeffizient B" VALUE 0x8002C9D0 Val_Ws16 3276.700 dTrq 0.00 3276.700 FORMAT "%8.3" EXTENDED_LIMITS -3276.800 3276.700 /end CHARACTERISTIC
/begin CHARACTERISTIC ASDrf_LADSt0Pos.CoefA_C "Parabelkennwerte des LAD Steigungsbegrenzung pos. Gradient (Primärzustand 0)/Parabelkoeffizient A" VALUE 0x8002C9D2 Val_Ws16 159.9951 ASDrf_LADCoefA 0.00 159.9951 FORMAT "%8.4" EXTENDED_LIMITS -160.0000 159.9951 /end CHARACTERISTIC
/begin CHARACTERISTIC ASDrf_LADSt0Pos.CoefB_C "Parabelkennwerte des LAD Steigungsbegrenzung pos. Gradient (Primärzustand 0)/Parabelkoeffizient B" VALUE 0x8002C9D4 Val_Ws16 3276.700 dTrq 0.00 3276.700 FORMAT "%8.3" EXTENDED_LIMITS -3276.800 3276.700 /end CHARACTERISTIC
/begin CHARACTERISTIC ASDrf_LADSt3FacNeg.facCoefA_GCUR "Faktor zum Parabelkennwerte des LAD Steigungsbegrenzung neg. Gradient (Primärzustand 3)/Faktor zum Parabelkoeffizient A" CURVE 0x8002C9D6 CurG_Ws16 100.0000 Fact1 0.00 100.0000 EXTENDED_LIMITS -256.0000 255.9922
 /begin AXIS_DESCR COM_AXIS ASDrf_facDesDynFlt_mp Fact 11 -4.000000 3.999878 AXIS_PTS_REF ASDrf_facDyn_X_AXIS /end AXIS_DESCR
/end CHARACTERISTIC
/begin CHARACTERISTIC ASDrf_LADSt3FacNeg.facCoefB_GCUR "Faktor zum Parabelkennwerte des LAD Steigungsbegrenzung neg. Gradient (Primärzustand 3)/Faktor zum Parabelkoeffizient B" CURVE 0x8002C9EC CurG_Ws16 100.0000 Fact1 0.00 100.0000 EXTENDED_LIMITS -256.0000 255.9922
 /begin AXIS_DESCR COM_AXIS ASDrf_facDesDynFlt_mp Fact 11 -4.000000 3.999878 AXIS_PTS_REF ASDrf_facDyn_X_AXIS /end AXIS_DESCR
/end CHARACTERISTIC
/begin CHARACTERISTIC ASDrf_LADSt3FacPos.facCoefA_GCUR "Faktor zum Parabelkennwerte des LAD Steigungsbegrenzung pos. Gradient (Primärzustand 3)/Faktor zum Parabelkoeffizient A" CURVE 0x8002CA02 CurG_Ws16 100.0000 Fact1 0.00 100.0000 EXTENDED_LIMITS -256.0000 255.9922
 /begin AXIS_DESCR COM_AXIS ASDrf_facDesDynFlt_mp Fact 11 -4.000000 3.999878 AXIS_PTS_REF ASDrf_facDyn_X_AXIS /end AXIS_DESCR
/end CHARACTERISTIC
/begin CHARACTERISTIC ASDrf_LADSt3FacPos.facCoefB_GCUR "Faktor zum Parabelkennwerte des LAD Steigungsbegrenzung pos. Gradient (Primärzustand 3)/Faktor zum Parabelkoeffizient B" CURVE 0x8002CA18 CurG_Ws16 100.0000 Fact1 0.00 100.0000 EXTENDED_LIMITS -256.0000 255.9922
 /begin AXIS_DESCR COM_AXIS ASDrf_facDesDynFlt_mp Fact 11 -4.000000 3.999878 AXIS_PTS_REF ASDrf_facDyn_X_AXIS /end AXIS_DESCR
/end CHARACTERISTIC
/begin CHARACTERISTIC ASDrf_LADSt3Neg.CoefA_GMAP "Parabelkennwerte des LAD Steigungsbegrenzung neg. Gradient (Primärzustand 3)/Parabelkoeffizient A" MAP 0x8002CA2E MapG_Ws16 159.9951 ASDrf_LADCoefA 0.00 159.9951 FORMAT "%8.4" EXTENDED_LIMITS -160.0000 159.9951
 /begin AXIS_DESCR COM_AXIS ASDrf_rTraParSel_mp TransR 8 -327.6800 327.6700 AXIS_PTS_REF ASDrf_rTra_X_AXIS /end AXIS_DESCR
 /begin AXIS_DESCR COM_AXIS Epm_nEng EngN 8 -16384.00 16383.50 AXIS_PTS_REF ASDrf_nEngLADSt3Neg_Y_AXIS /end AXIS_DESCR
/end CHARACTERISTIC
/begin CHARACTERISTIC ASDrf_LADSt3Neg.CoefB_GMAP "Parabelkennwerte des LAD Steigungsbegrenzung neg. Gradient (Primärzustand 3)/Parabelkoeffizient B" MAP 0x8002CAAE MapG_Ws16 3276.700 dTrq 0.00 3276.700 FORMAT "%8.3" EXTENDED_LIMITS -3276.800 3276.700
 /begin AXIS_DESCR COM_AXIS ASDrf_rTraParSel_mp TransR 8 -327.6800 327.6700 AXIS_PTS_REF ASDrf_rTra_X_AXIS /end AXIS_DESCR
 /begin AXIS_DESCR COM_AXIS Epm_nEng EngN 8 -16384.00 16383.50 AXIS_PTS_REF ASDrf_nEngLADSt3Neg_Y_AXIS /end AXIS_DESCR
/end CHARACTERISTIC
/begin CHARACTERISTIC ASDrf_LADSt3Pos.CoefA_GMAP "Parabelkennwerte des LAD Steigungsbegrenzung pos. Gradient (Primärzustand 3)/Parabelkoeffizient A" MAP 0x8002CB2E MapG_Ws16 159.9951 ASDrf_LADCoefA 0.00 159.9951 FORMAT "%8.4" EXTENDED_LIMITS -160.0000 159.9951
 /begin AXIS_DESCR COM_AXIS ASDrf_rTraParSel_mp TransR 8 -327.6800 327.6700 AXIS_PTS_REF ASDrf_rTra_X_AXIS /end AXIS_DESCR
 /begin AXIS_DESCR COM_AXIS Epm_nEng EngN 8 -16384.00 16383.50 AXIS_PTS_REF ASDrf_nEngLADSt3Pos_Y_AXIS /end AXIS_DESCR
/end CHARACTERISTIC
/begin CHARACTERISTIC ASDrf_LADSt3Pos.CoefB_GMAP "Parabelkennwerte des LAD Steigungsbegrenzung pos. Gradient (Primärzustand 3)/Parabelkoeffizient B" MAP 0x8002CBAE MapG_Ws16 3276.700 dTrq 0.00 3276.700 FORMAT "%8.3" EXTENDED_LIMITS -3276.800 3276.700
 /begin AXIS_DESCR COM_AXIS ASDrf_rTraParSel_mp TransR 8 -327.6800 327.6700 AXIS_PTS_REF ASDrf_rTra_X_AXIS /end AXIS_DESCR
 /begin AXIS_DESCR COM_AXIS Epm_nEng EngN 8 -16384.00 16383.50 AXIS_PTS_REF ASDrf_nEngLADSt3Pos_Y_AXIS /end AXIS_DESCR
/end CHARACTERISTIC
/begin CHARACTERISTIC ASDrf_LADSt4Neg.CoefA_C "Parabelkennwerte des LAD Steigungsbegrenzung neg. Gradient (Primärzustand 4)/Parabelkoeffizient A" VALUE 0x8002CC2E Val_Ws16 159.9951 ASDrf_LADCoefA 0.00 159.9951 FORMAT "%8.4" EXTENDED_LIMITS -160.0000 159.9951 /end CHARACTERISTIC
/begin CHARACTERISTIC ASDrf_LADSt4Neg.CoefB_C "Parabelkennwerte des LAD Steigungsbegrenzung neg. Gradient (Primärzustand 4)/Parabelkoeffizient B" VALUE 0x8002CC30 Val_Ws16 3276.700 dTrq 0.00 3276.700 FORMAT "%8.3" EXTENDED_LIMITS -3276.800 3276.700 /end CHARACTERISTIC
/begin CHARACTERISTIC ASDrf_LADSt4Pos.CoefA_C "Parabelkennwerte des LAD Steigungsbegrenzung pos. Gradient (Primärzustand 4)/Parabelkoeffizient A" VALUE 0x8002CC32 Val_Ws16 159.9951 ASDrf_LADCoefA 0.00 159.9951 FORMAT "%8.4" EXTENDED_LIMITS -160.0000 159.9951 /end CHARACTERISTIC
/begin CHARACTERISTIC ASDrf_LADSt4Pos.CoefB_C "Parabelkennwerte des LAD Steigungsbegrenzung pos. Gradient (Primärzustand 4)/Parabelkoeffizient B" VALUE 0x8002CC34 Val_Ws16 3276.700 dTrq 0.00 3276.700 FORMAT "%8.3" EXTENDED_LIMITS -3276.800 3276.700 /end CHARACTERISTIC
/begin AXIS_PTS ASDrf_nEngFltGripNeg_Y_AXIS "Gruppenachse für Motordrehzahl" 0x8002CC36 Epm_nEng Axis_Xs16 32767.50 EngN 8 -16384.00 16383.50 FORMAT "%8.2" DEPOSIT ABSOLUTE /end AXIS_PTS
/begin AXIS_PTS ASDrf_nEngFltGripPos_Y_AXIS "Gruppenachse für Motordrehzahl" 0x8002CC48 Epm_nEng Axis_Xs16 32767.50 EngN 8 -16384.00 16383.50 FORMAT "%8.2" DEPOSIT ABSOLUTE /end AXIS_PTS
/begin AXIS_PTS ASDrf_nEngFltSt3Neg_Y_AXIS "Gruppenachse für Motordrehzahl" 0x8002CC5A Epm_nEng Axis_Xs16 32767.50 EngN 8 -16384.00 16383.50 FORMAT "%8.2" DEPOSIT ABSOLUTE /end AXIS_PTS
/begin AXIS_PTS ASDrf_nEngFltSt3Pos_Y_AXIS "Gruppenachse für Motordrehzahl" 0x8002CC6C Epm_nEng Axis_Xs16 32767.50 EngN 8 -16384.00 16383.50 FORMAT "%8.2" DEPOSIT ABSOLUTE /end AXIS_PTS
/begin AXIS_PTS ASDrf_nEngLADGripNeg_Y_AXIS "Gruppenachse für Motordrehzahl" 0x8002CC7E Epm_nEng Axis_Xs16 32767.50 EngN 8 -16384.00 16383.50 FORMAT "%8.2" DEPOSIT ABSOLUTE /end AXIS_PTS
/begin AXIS_PTS ASDrf_nEngLADGripPos_Y_AXIS "Gruppenachse für Motordrehzahl" 0x8002CC90 Epm_nEng Axis_Xs16 32767.50 EngN 8 -16384.00 16383.50 FORMAT "%8.2" DEPOSIT ABSOLUTE /end AXIS_PTS
/begin AXIS_PTS ASDrf_nEngLADSt3Neg_Y_AXIS "Gruppenachse für Motordrehzahl" 0x8002CCA2 Epm_nEng Axis_Xs16 32767.50 EngN 8 -16384.00 16383.50 FORMAT "%8.2" DEPOSIT ABSOLUTE /end AXIS_PTS
/begin AXIS_PTS ASDrf_nEngLADSt3Pos_Y_AXIS "Gruppenachse für Motordrehzahl" 0x8002CCB4 Epm_nEng Axis_Xs16 32767.50 EngN 8 -16384.00 16383.50 FORMAT "%8.2" DEPOSIT ABSOLUTE /end AXIS_PTS
/begin CHARACTERISTIC ASDrf_nLAD2NoImp_C "Drehzahlschwelle zum Auslösen des LAD für pos. Eingangsgradienten im Betriebsmodus 2" VALUE 0x8002C290 Val_Ws16 2000.000 EngN -1000.000 1000.000 EXTENDED_LIMITS -16384.00 16383.50 /end CHARACTERISTIC
/begin CHARACTERISTIC ASDrf_nLAD2SetPNeg_GCUR "Sollwert für Lastschlagdämpfer im Modus 2 für negative Eingangsgradienten" CURVE 0x8002CCC6 CurG_Ws16 2000.000 EngN -1000.000 1000.000 EXTENDED_LIMITS -16384.00 16383.50
 /begin AXIS_DESCR COM_AXIS ASDrf_rTraParSel_mp TransR 8 -327.6800 327.6700 AXIS_PTS_REF ASDrf_rTra_X_AXIS /end AXIS_DESCR
/end CHARACTERISTIC
/begin CHARACTERISTIC ASDrf_nLAD2SetPPos_GCUR "Sollwert für Lastschlagdämpfer im Modus 2 für positive Eingangsgradienten" CURVE 0x8002CCD6 CurG_Ws16 2000.000 EngN -1000.000 1000.000 EXTENDED_LIMITS -16384.00 16383.50
 /begin AXIS_DESCR COM_AXIS ASDrf_rTraParSel_mp TransR 8 -327.6800 327.6700 AXIS_PTS_REF ASDrf_rTra_X_AXIS /end AXIS_DESCR
/end CHARACTERISTIC
/begin CHARACTERISTIC ASDrf_numDflSt_C "Nummer des Default-Primärzustandes (dezimal kodiert)" VALUE 0x8002CCE6 Val_Wu16 4.00000000000 ASDrf_numDflSt 0.00 4.00000000000 FORMAT "%13.11" /end CHARACTERISTIC
/begin CHARACTERISTIC ASDrf_numEngTemp_C "Temperaturauswahl für Verlustmomentkennfeld" VALUE 0x8002CCE8 Val_Wu8 3.00000000000 EngTempFldSel 0.00 3.00000000000 FORMAT "%13.11" /end CHARACTERISTIC
/begin CHARACTERISTIC ASDrf_numPrio_CA "Prioritäten der Primärzustände" VAL_BLK 0x8002CCE9 ValA_Wu8 255.0 OneToOne 0.00 255.0 NUMBER 5 /end CHARACTERISTIC
/begin CHARACTERISTIC ASDrf_phiLAD2IMax_C "Maximum Begrenzung des Winkels zwischen Eingang und Ausgang des Drehmomentwandlers (Abschaltschwelle P-Regler für pos. LAD)" VALUE 0x8002C292 Val_Ws16 720.0000 ASDrf_Angle 0.00 720.0000 FORMAT "%8.4" EXTENDED_LIMITS -3276.800 3276.700 /end CHARACTERISTIC
/begin CHARACTERISTIC ASDrf_phiLAD2IMin_C "Minimum Begrenzung des Winkels zwischen Eingang und Ausgang des Drehmomentwandlers (Abschaltschwelle P-Regler für pos. LAD)" VALUE 0x8002C294 Val_Ws16 720.0000 ASDrf_Angle -720.0000 0.00 FORMAT "%8.4" EXTENDED_LIMITS -3276.800 3276.700 /end CHARACTERISTIC
/begin CHARACTERISTIC ASDrf_rGripThres1_C "Kraftschlussschwelle für Eingangsbedingung ""Kraftschluss 1""" VALUE 0x8002CCEE Val_Ws16 655.3500 Fact100 -327.6800 327.6700 FORMAT "%8.4" /end CHARACTERISTIC
/begin CHARACTERISTIC ASDrf_rGripThres2_C "Kraftschlussschwelle für Eingangsbedingung ""Kraftschluss 2""" VALUE 0x8002CCF0 Val_Ws16 655.3500 Fact100 -327.6800 327.6700 FORMAT "%8.4" /end CHARACTERISTIC
/begin CHARACTERISTIC ASDrf_rGripThres3_C "Kraftschlussschwelle für Eingangsbedingung ""Kraftschluss 3""" VALUE 0x8002CCF2 Val_Ws16 655.3500 Fact100 -327.6800 327.6700 FORMAT "%8.4" /end CHARACTERISTIC
/begin CHARACTERISTIC ASDrf_rGripThres4_C "Kraftschlussschwelle für Eingangsbedingung ""Kraftschluss 4""" VALUE 0x8002CCF4 Val_Ws16 655.3500 Fact100 -327.6800 327.6700 FORMAT "%8.4" /end CHARACTERISTIC
/begin AXIS_PTS ASDrf_rTra_X_AXIS "Gruppenachse für Getriebeübersetzung" 0x8002CCF6 ASDrf_rTraParSel_mp Axis_Xs16 655.3500 TransR 8 -327.6800 327.6700 FORMAT "%8.4" DEPOSIT ABSOLUTE /end AXIS_PTS
/begin CHARACTERISTIC ASDrf_stCfgConExtIntv_C "Festlegung der Eingangsbedingung ""externer Momenteneingriff"" (Bitmaske zur Nachricht GlbDa_stTrqDem)" VALUE 0x8002CD08 Val_Wu16 65535.00 OneToOne 0.00 65535.00 /end CHARACTERISTIC
/begin CHARACTERISTIC ASDrf_stEntcClth_C "Initialisierungsanforderung beim Eintritt in den Zustand ""offener Antriebstrang"" (Primärzustand 1)" VALUE 0x8002CD0A Val_Wu8 2.000 OneToOne 0.00 2.000 EXTENDED_LIMITS 0.00 255.0 /end CHARACTERISTIC
/begin CHARACTERISTIC ASDrf_stEntcGrip_C "Initialisierungsanforderung beim Eintritt in den Zustand ""geschlossener Antriebsstrang"" (Primärzustand 2)" VALUE 0x8002CD0B Val_Wu8 2.000 OneToOne 0.00 2.000 EXTENDED_LIMITS 0.00 255.0 /end CHARACTERISTIC
/begin CHARACTERISTIC ASDrf_stEntcSt0_C "Initialisierungsanforderung beim Eintritt in den Primärzustand 0" VALUE 0x8002CD0C Val_Wu8 2.000 OneToOne 0.00 2.000 EXTENDED_LIMITS 0.00 255.0 /end CHARACTERISTIC
/begin CHARACTERISTIC ASDrf_stEntcSt3_C "Initialisierungsanforderung beim Eintritt in den Primärzustand 3" VALUE 0x8002CD0D Val_Wu8 2.000 OneToOne 0.00 2.000 EXTENDED_LIMITS 0.00 255.0 /end CHARACTERISTIC
/begin CHARACTERISTIC ASDrf_stEntcSt4_C "Initialisierungsanforderung beim Eintritt in den Primärzustand 4" VALUE 0x8002CD0E Val_Wu8 2.000 OneToOne 0.00 2.000 EXTENDED_LIMITS 0.00 255.0 /end CHARACTERISTIC
/begin CHARACTERISTIC ASDrf_stExClth_C "Initialisierungsanforderung beim Verlassen des Zustands ""offener Antriebsstrang"" (Primärzustand 1)" VALUE 0x8002CD0F Val_Wu8 2.000 OneToOne 0.00 2.000 EXTENDED_LIMITS 0.00 255.0 /end CHARACTERISTIC
/begin CHARACTERISTIC ASDrf_stExGrip_C "Initialisierungsanforderung beim Verlassen des Zustands ""geschlossener Antriebsstrang"" (Primärzustand 2)" VALUE 0x8002CD10 Val_Wu8 2.000 OneToOne 0.00 2.000 EXTENDED_LIMITS 0.00 255.0 /end CHARACTERISTIC
/begin CHARACTERISTIC ASDrf_stExSt0_C "Initialisierungsanforderung beim Verlassen des Primärzustandes 0" VALUE 0x8002CD11 Val_Wu8 2.000 OneToOne 0.00 2.000 EXTENDED_LIMITS 0.00 255.0 /end CHARACTERISTIC
/begin CHARACTERISTIC ASDrf_stExSt3_C "Initialisierungsanforderung beim Verlassen des Primärzustandes 3" VALUE 0x8002CD12 Val_Wu8 2.000 OneToOne 0.00 2.000 EXTENDED_LIMITS 0.00 255.0 /end CHARACTERISTIC
/begin CHARACTERISTIC ASDrf_stExSt4_C "Initialisierungsanforderung beim Verlassen des Primärzustandes 4" VALUE 0x8002CD13 Val_Wu8 2.000 OneToOne 0.00 2.000 EXTENDED_LIMITS 0.00 255.0 /end CHARACTERISTIC
/begin CHARACTERISTIC ASDrf_stExtIntv_C "Konfiguration der Eingangsbedingung ""Externer Momenteneingriff""" VALUE 0x8002CD14 Val_Wu16 65535.00 OneToOne 0.00 65535.00 /end CHARACTERISTIC
/begin CHARACTERISTIC ASDrf_stGrip1_C "Konfiguration der Eingangsbedingung ""Kraftschluss 1""" VALUE 0x8002CD16 Val_Wu16 65535.00 OneToOne 0.00 65535.00 /end CHARACTERISTIC
/begin CHARACTERISTIC ASDrf_stGrip2_C "Konfiguration der Eingangsbedingung ""Kraftschluss 2""" VALUE 0x8002CD18 Val_Wu16 65535.00 OneToOne 0.00 65535.00 /end CHARACTERISTIC
/begin CHARACTERISTIC ASDrf_stGrip3_C "Konfiguration der Eingangsbedingung ""Kraftschluss 3""" VALUE 0x8002CD1A Val_Wu16 65535.00 OneToOne 0.00 65535.00 /end CHARACTERISTIC
/begin CHARACTERISTIC ASDrf_stGrip4_C "Konfiguration der Eingangsbedingung ""Kraftschluss 4""" VALUE 0x8002CD1C Val_Wu16 65535.00 OneToOne 0.00 65535.00 /end CHARACTERISTIC
/begin CHARACTERISTIC ASDrf_stGrip_C "Konfiguration der Eingangsbedingung ""geschlossener Antriebsstrang""" VALUE 0x8002CD1E Val_Wu16 65535.00 OneToOne 0.00 65535.00 /end CHARACTERISTIC
/begin CHARACTERISTIC ASDrf_swtCalcTrq_C "Schalter für die Berechnung des aktuellen ASD Moments (mit oder ohne ASDdc_trq)" VALUE 0x8002C296 Val_Wu8 3.000 OneToOne 0.00 3.000 EXTENDED_LIMITS 0.00 255.0 /end CHARACTERISTIC
/begin CHARACTERISTIC ASDrf_swtDeComp_C "Schalter zur Aktivierung/Deaktivierung der Schleppfehlerkompensation (1 = aktiv)" VALUE 0x8002C297 Val_Wu8 1.000 OneToOne 0.00 1.000 EXTENDED_LIMITS 0.00 255.0 /end CHARACTERISTIC
/begin CHARACTERISTIC ASDrf_swtFolDyn_C "" VALUE 0x8002CD20 Val_Wu8 2.000 OneToOne 0.00 2.000 EXTENDED_LIMITS 0.00 255.0 /end CHARACTERISTIC
/begin CHARACTERISTIC ASDrf_swtFrzLos_C "Schalter für die Berechnung des Verlustmoments bei aktiver Steigungsbegrenzung (1 = eingefroren)" VALUE 0x8002C298 Val_Wu8 1.000 OneToOne 0.00 1.000 EXTENDED_LIMITS 0.00 255.0 /end CHARACTERISTIC
/begin CHARACTERISTIC ASDrf_swtLADMode_CA "Betriebsmodus des Lastschlagdämpfers (0: Deaktiviert; 1: Parabel; 2: Impuls)" VAL_BLK 0x8002CD21 ValA_Wu8 2.00000000000 ASDrf_LADMode 0.00 2.00000000000 FORMAT "%13.11" NUMBER 5 /end CHARACTERISTIC
/begin CHARACTERISTIC ASDrf_swtLim_C "Schalter zur Begrenzung von ASDrf_trqInrSet auf CoETS_trqInrLtd" VALUE 0x8002C299 Val_Wu8 3.000 OneToOne 0.00 3.000 EXTENDED_LIMITS 0.00 255.0 /end CHARACTERISTIC
/begin CHARACTERISTIC ASDrf_swtLosCalc_C "Schalter für die Berechnung des Verlustmoments (0 = Kennlinie : 1 = adaptiertes Verlustmoment)" VALUE 0x8002CD26 Val_Wu8 2.000 OneToOne 0.00 2.000 EXTENDED_LIMITS 0.00 255.0 /end CHARACTERISTIC
/begin CHARACTERISTIC ASDrf_swtOpr_C "Schalter des Verknüpfungsoperators (00=OR : 01=AND : 10=NAND : 11=NOR)" VALUE 0x8002CD28 Val_Wu16 65535.00 OneToOne 0.00 65535.00 /end CHARACTERISTIC
/begin CHARACTERISTIC ASDrf_swtSpdGovCor_C "Schalter zur Aktivierung/Deaktivierung der Drehzahlreglerkompensation (Bit 0: pos. Eingangsgr; Bit 1: neg. Eingangsgrad.)" VALUE 0x8002C29A Val_Wu8 3.000 OneToOne 0.00 3.000 EXTENDED_LIMITS 0.00 255.0 /end CHARACTERISTIC
/begin CHARACTERISTIC ASDrf_tiLAD2ActvPGovNeg_C "Zeit von Eintritt in LAD Zustand ""Limit"" bis zur Aktivierung des P-Reglers für neg. Eingangsgradienten (LAD Betriebsmodus 2)" VALUE 0x8002C29C Val_Ws16 300000.0 Time_ms 0.00 300000.0 EXTENDED_LIMITS -327680.0 327670.0 /end CHARACTERISTIC
/begin CHARACTERISTIC ASDrf_tiLAD2ActvPGovPos_C "Zeit von Eintritt in LAD Zustand ""Limit"" bis zur Aktivierung des P-Reglers für pos. Eingangsgradienten (LAD Betriebsmodus 2)" VALUE 0x8002C29E Val_Ws16 300000.0 Time_ms 0.00 300000.0 EXTENDED_LIMITS -327680.0 327670.0 /end CHARACTERISTIC
/begin CHARACTERISTIC ASDrf_tiLAD2DeActvPGovNeg_C "Zeit von Eintritt in LAD Zustand ""Limit"" bis zur Deaktivierung des P-Reglers für neg. Eingangsgradienten (LAD Betriebsmodus 2)" VALUE 0x8002C2A0 Val_Ws16 300000.0 Time_ms 0.00 300000.0 EXTENDED_LIMITS -327680.0 327670.0 /end CHARACTERISTIC
/begin CHARACTERISTIC ASDrf_tiLAD2DeActvPGovPos_C "Zeit von Eintritt in LAD Zustand ""Limit"" bis zur Deaktivierung des P-Reglers für pos. Eingangsgradienten (LAD Betriebsmodus 2)" VALUE 0x8002C2A2 Val_Ws16 300000.0 Time_ms 0.00 300000.0 EXTENDED_LIMITS -327680.0 327670.0 /end CHARACTERISTIC
/begin CHARACTERISTIC ASDrf_tiPT1DesDynFltNeg_C "Zeitkonstante (T1) zur Filterung des Fahrerwunsches bei negativen Eingangsgradienten" VALUE 0x8002CD2C Val_Ws32 99.882860372 TimeDelay_s 0.000099999999907 99.882960372 FORMAT "%12.8" EXTENDED_LIMITS 0.000002000000001 4294.9672960 /end CHARACTERISTIC
/begin CHARACTERISTIC ASDrf_tiPT1DesDynFltPos_C "Zeitkonstante (T1) zur Filterung des Fahrerwunsches bei positive Eingangsgradienten" VALUE 0x8002CD30 Val_Ws32 99.882860372 TimeDelay_s 0.000099999999907 99.882960372 FORMAT "%12.8" EXTENDED_LIMITS 0.000002000000001 4294.9672960 /end CHARACTERISTIC
/begin CHARACTERISTIC ASDrf_trqClthOfsLosNeg_C "Offset zum Verlustmoment für negative Eingangsgradienten bei offenem Antriebsstrang" VALUE 0x8002CD34 Val_Ws16 1500.000 Trq -500.0000 1000.000 EXTENDED_LIMITS -3276.800 3276.700 /end CHARACTERISTIC
/begin CHARACTERISTIC ASDrf_trqClthOfsLosPos_C "Offset zum Verlustmoment für positive Eingangsgradienten bei offenem Antriebsstrang" VALUE 0x8002CD36 Val_Ws16 1500.000 Trq -500.0000 1000.000 EXTENDED_LIMITS -3276.800 3276.700 /end CHARACTERISTIC
/begin CHARACTERISTIC ASDrf_trqGripOfsLosNeg_CUR "Offset zum Verlustmoment für negative Eingangsgradienten bei geschlossenem Antriebsstrang" CURVE 0x8002CD38 Cur_Xs16Ws16 1500.000 Trq -500.0000 1000.000 EXTENDED_LIMITS -3276.800 3276.700
 /begin AXIS_DESCR STD_AXIS Epm_nEng EngN 16 -16384.00 16383.50 DEPOSIT ABSOLUTE /end AXIS_DESCR
/end CHARACTERISTIC
/begin CHARACTERISTIC ASDrf_trqGripOfsLosPos_CUR "Offset zum Verlustmoment für positive Eingangsgradienten bei geschlossenem Antriebsstrang" CURVE 0x8002CD7A Cur_Xs16Ws16 1500.000 Trq -500.0000 1000.000 EXTENDED_LIMITS -3276.800 3276.700
 /begin AXIS_DESCR STD_AXIS Epm_nEng EngN 16 -16384.00 16383.50 DEPOSIT ABSOLUTE /end AXIS_DESCR
/end CHARACTERISTIC
/begin CHARACTERISTIC ASDrf_trqLAD1OfsNegHi_C "Annäherungsschwelle zum Verlustmoment (LAD Betriebsmodus 1)" VALUE 0x8002C2A4 Val_Wr32 1500.00000 Trq_float -500.000000 1000.00000 EXTENDED_LIMITS -1.00000000E+037 1.00000000E+037 /end CHARACTERISTIC
/begin CHARACTERISTIC ASDrf_trqLAD1OfsNegLo_C "Offset zum Verlustmoment für die Beendigung des Zustands ""Steigungsbegrenzung"" (LAD Betriebsmodus 1)" VALUE 0x8002C2A8 Val_Wr32 1500.00000 Trq_float -500.000000 1000.00000 EXTENDED_LIMITS -1.00000000E+037 1.00000000E+037 /end CHARACTERISTIC
/begin CHARACTERISTIC ASDrf_trqLAD1OfsNegMid_C "Offset zum Verslustmoment für die Annäherungserkennung und Aktivierung des Zustands ""Steigungsbegrenzung"" (LAD Betriebsmodus 1)" VALUE 0x8002C2AC Val_Wr32 1500.00000 Trq_float -500.000000 1000.00000 EXTENDED_LIMITS -1.00000000E+037 1.00000000E+037 /end CHARACTERISTIC
/begin CHARACTERISTIC ASDrf_trqLAD1OfsPosHi_C "Offset zum Verlustmoment für die Beendigung des Zustands ""Steigungsbegrenzung"" (LAD Betriebsmodus 1)" VALUE 0x8002C2B0 Val_Wr32 1500.00000 Trq_float -500.000000 1000.00000 EXTENDED_LIMITS -1.00000000E+037 1.00000000E+037 /end CHARACTERISTIC
/begin CHARACTERISTIC ASDrf_trqLAD1OfsPosLo_C "Annäherungsschwelle zum Verlustmoment (LAD Betriebsmodus 1)" VALUE 0x8002C2B4 Val_Wr32 1500.00000 Trq_float -500.000000 1000.00000 EXTENDED_LIMITS -1.00000000E+037 1.00000000E+037 /end CHARACTERISTIC
/begin CHARACTERISTIC ASDrf_trqLAD1OfsPosMid_C "Offset zum Verslustmoment für die Annäherungserkennung und Aktivierung des Zustands ""Steigungsbegrenzung"" (LAD Betriebsmodus 1)" VALUE 0x8002C2B8 Val_Wr32 1500.00000 Trq_float -500.000000 1000.00000 EXTENDED_LIMITS -1.00000000E+037 1.00000000E+037 /end CHARACTERISTIC
/begin CHARACTERISTIC ASDrf_trqLAD2BlwLimPosHi_C "Obere Schwelle für Zustandsübergang ""Below - Limit"" (LAD Betriebsmodus 2)" VALUE 0x8002C2BC Val_Wr32 1500.00000 Trq_float -500.000000 1000.00000 EXTENDED_LIMITS -1.00000000E+037 1.00000000E+037 /end CHARACTERISTIC
/begin CHARACTERISTIC ASDrf_trqLAD2BlwLimPosLo_C "Untere Schwelle für Zustandsübergang ""Below - Limit"" (LAD Betriebsmodus 2)" VALUE 0x8002C2C0 Val_Wr32 1500.00000 Trq_float -500.000000 1000.00000 EXTENDED_LIMITS -1.00000000E+037 1.00000000E+037 /end CHARACTERISTIC
/begin CHARACTERISTIC ASDrf_trqLAD2OfsNegHi_C "Annäherungsschwelle zum Verlustmoment (LAD Betriebsmodus 2)" VALUE 0x8002C2C4 Val_Wr32 1500.00000 Trq_float -500.000000 1000.00000 EXTENDED_LIMITS -1.00000000E+037 1.00000000E+037 /end CHARACTERISTIC
/begin CHARACTERISTIC ASDrf_trqLAD2OfsNegLo_C "Offset zum Verlustmoment für die Beendigung des Zustands ""Steigungsbegrenzung"" (LAD Betriebsmodus 2)" VALUE 0x8002C2C8 Val_Wr32 1500.00000 Trq_float -500.000000 1000.00000 EXTENDED_LIMITS -1.00000000E+037 1.00000000E+037 /end CHARACTERISTIC
/begin CHARACTERISTIC ASDrf_trqLAD2OfsNegMid_C "Offset zum Verslustmoment für die Annäherungserkennung und Aktivierung des Zustands ""Steigungsbegrenzung"" (LAD Betriebsmodus 2)" VALUE 0x8002C2CC Val_Wr32 1500.00000 Trq_float -500.000000 1000.00000 EXTENDED_LIMITS -1.00000000E+037 1.00000000E+037 /end CHARACTERISTIC
/begin CHARACTERISTIC ASDrf_trqLAD2OfsPosHi_C "Offset zum Verlustmoment für die Beendigung des Zustands ""Steigungsbegrenzung"" (LAD Betriebsmodus 2)" VALUE 0x8002C2D0 Val_Wr32 1500.00000 Trq_float -500.000000 1000.00000 EXTENDED_LIMITS -1.00000000E+037 1.00000000E+037 /end CHARACTERISTIC
/begin CHARACTERISTIC ASDrf_trqLAD2OfsPosLo_C "Annäherungsschwelle zum Verlustmoment (LAD Betriebsmodus 2)" VALUE 0x8002C2D4 Val_Wr32 1500.00000 Trq_float -500.000000 1000.00000 EXTENDED_LIMITS -1.00000000E+037 1.00000000E+037 /end CHARACTERISTIC
/begin CHARACTERISTIC ASDrf_trqLAD2OfsPosMid_C "Offset zum Verslustmoment für die Annäherungserkennung und Aktivierung des Zustands ""Steigungsbegrenzung"" (LAD Betriebsmodus 2)" VALUE 0x8002C2D8 Val_Wr32 1500.00000 Trq_float -500.000000 1000.00000 EXTENDED_LIMITS -1.00000000E+037 1.00000000E+037 /end CHARACTERISTIC
/begin CHARACTERISTIC ASDrf_trqLAD2PGovMax_C "Obere Stellgrenze des P-Reglers für LAD im Betriebsmods 2" VALUE 0x8002C2DC Val_Ws16 1500.000 Trq -500.0000 1000.000 EXTENDED_LIMITS -3276.800 3276.700 /end CHARACTERISTIC
/begin CHARACTERISTIC ASDrf_trqLAD2PGovMin_C "Untere Stellgrenze des P-Reglers für LAD im Betriebsmods 2" VALUE 0x8002C2DE Val_Ws16 1500.000 Trq -500.0000 1000.000 EXTENDED_LIMITS -3276.800 3276.700 /end CHARACTERISTIC
/begin CHARACTERISTIC ASDrf_trqLos_MAP "Verlustmoment bzw. Offset zum Verlustmoment" MAP 0x8002CDBC Map_Xs16Ys16Ws16 1500.000 Trq -500.0000 1000.000 EXTENDED_LIMITS -3276.800 3276.700
 /begin AXIS_DESCR STD_AXIS Epm_nEng EngN 16 -16384.00 16383.50 DEPOSIT ABSOLUTE /end AXIS_DESCR
 /begin AXIS_DESCR STD_AXIS ASDrf_tEngLos_mp Temp_Cels 5 -3549.940 3003.560 DEPOSIT ABSOLUTE /end AXIS_DESCR
/end CHARACTERISTIC
/begin CHARACTERISTIC ASDrf_trqSt0OfsLosNeg_C "Offset zum Verlustmoment für negative Eingangsgradienten im Zustand 0" VALUE 0x8002CE8A Val_Ws16 1500.000 Trq -500.0000 1000.000 EXTENDED_LIMITS -3276.800 3276.700 /end CHARACTERISTIC
/begin CHARACTERISTIC ASDrf_trqSt0OfsLosPos_C "Offset zum Verlustmoment für positive Eingangsgradienten im Zustand 0" VALUE 0x8002CE8C Val_Ws16 1500.000 Trq -500.0000 1000.000 EXTENDED_LIMITS -3276.800 3276.700 /end CHARACTERISTIC
/begin CHARACTERISTIC ASDrf_trqSt3OfsLosNeg_CUR "Offset zum Verlustmoment für negative Eingangsgradienten im Zustand 3" CURVE 0x8002CE8E Cur_Xs16Ws16 1500.000 Trq -500.0000 1000.000 EXTENDED_LIMITS -3276.800 3276.700
 /begin AXIS_DESCR STD_AXIS Epm_nEng EngN 16 -16384.00 16383.50 DEPOSIT ABSOLUTE /end AXIS_DESCR
/end CHARACTERISTIC
/begin CHARACTERISTIC ASDrf_trqSt3OfsLosPos_CUR "Offset zum Verlustmoment für positive Eingangsgradienten im Zustand 3" CURVE 0x8002CED0 Cur_Xs16Ws16 1500.000 Trq -500.0000 1000.000 EXTENDED_LIMITS -3276.800 3276.700
 /begin AXIS_DESCR STD_AXIS Epm_nEng EngN 16 -16384.00 16383.50 DEPOSIT ABSOLUTE /end AXIS_DESCR
/end CHARACTERISTIC
/begin CHARACTERISTIC ASDrf_trqSt4OfsLosNeg_C "Offset zum Verlustmoment für negative Eingangsgradienten im Zustand 4" VALUE 0x8002CF12 Val_Ws16 1500.000 Trq -500.0000 1000.000 EXTENDED_LIMITS -3276.800 3276.700 /end CHARACTERISTIC
/begin CHARACTERISTIC ASDrf_trqSt4OfsLosPos_C "Offset zum Verlustmoment für positive Eingangsgradienten im Zustand 4" VALUE 0x8002CF14 Val_Ws16 1500.000 Trq -500.0000 1000.000 EXTENDED_LIMITS -3276.800 3276.700 /end CHARACTERISTIC
/begin CHARACTERISTIC ASDrf_trqSteepNeg_C "Schwelle (neg.) für die Initialisierung der Führungsformers bei steilen Eingangsgrenzen" VALUE 0x8002C2E0 Val_Wr32 3276.80000 Trq_float -3276.80000 0.00 EXTENDED_LIMITS -1.00000000E+037 1.00000000E+037 /end CHARACTERISTIC
/begin CHARACTERISTIC ASDrf_trqSteepPos_C "Schwelle (pos.) für die Initialisierung der Führungsformers bei steilen Eingangsgrenzen" VALUE 0x8002C2E4 Val_Wr32 3276.70000 Trq_float 0.00 3276.70000 EXTENDED_LIMITS -1.00000000E+037 1.00000000E+037 /end CHARACTERISTIC
/begin CHARACTERISTIC ASDrf_trqThresNeg_C "ASD Führungsformer Hystereseschwelle neg. Wunschmomentgradient" VALUE 0x8002C2E8 Val_Wr32 1500.00000 Trq_float -500.000000 1000.00000 EXTENDED_LIMITS -1.00000000E+037 1.00000000E+037 /end CHARACTERISTIC
/begin CHARACTERISTIC ASDrf_trqThresPos_C "ASD Führungsformer Hystereseschwelle pos. Wunschmomentgradient" VALUE 0x8002C2EC Val_Wr32 1500.00000 Trq_float -500.000000 1000.00000 EXTENDED_LIMITS -1.00000000E+037 1.00000000E+037 /end CHARACTERISTIC
/begin CHARACTERISTIC ASMod_AirEGR.rPresCrit_C "/" VALUE 0x8002DA80 Kw_Wr32 0.00 OneToOne 0.528282000 0.528282000 FORMAT "%11.9" EXTENDED_LIMITS -1.00000000E+037 1.00000000E+037 READ_ONLY /end CHARACTERISTIC
/begin CHARACTERISTIC ASMod_AirEGR.facFlwCrit_C "/" VALUE 0x8002DA84 Kw_Wr32 0.00 OneToOne 0.484179000 0.484179000 FORMAT "%11.9" EXTENDED_LIMITS -1.00000000E+037 1.00000000E+037 READ_ONLY /end CHARACTERISTIC
/begin CHARACTERISTIC ASMod_AirEGR.rPresLin_C "/" VALUE 0x8002DA88 Kw_Wr32 0.00 OneToOne 0.990000000 0.990000000 FORMAT "%11.9" EXTENDED_LIMITS -1.00000000E+037 1.00000000E+037 READ_ONLY /end CHARACTERISTIC
/begin CHARACTERISTIC ASMod_AirEGR.facSlpLin_C "/" VALUE 0x8002DA8C Kw_Wr32 0.00 OneToOne 9.94628000 9.94628000 FORMAT "%10.8" EXTENDED_LIMITS -1.00000000E+037 1.00000000E+037 READ_ONLY /end CHARACTERISTIC
/begin CHARACTERISTIC ASMod_arEffEGRLP_CUR "" CURVE 0x8002DAEC Cur_Xr32Wr32 50.0000000 Area_cm2_float 0.00 50.0000000 FORMAT "%10.7" EXTENDED_LIMITS -1.00000000E+037 1.00000000E+037
 /begin AXIS_DESCR STD_AXIS ASMod_rEffEGRLP_CrvIn_mp Pos_Prc_float 12 0.00 100.000000 FORMAT "%10.6" EXTENDED_LIMITS -1.00000000E+037 1.00000000E+037 DEPOSIT ABSOLUTE /end AXIS_DESCR
/end CHARACTERISTIC
/begin CHARACTERISTIC ASMod_arEffEGRVlv_CUR "" CURVE 0x8002DA90 Cur_Xr32Wr32 15.0000000 Area_cm2_float 0.00 15.0000000 FORMAT "%10.7" EXTENDED_LIMITS -1.00000000E+037 1.00000000E+037
 /begin AXIS_DESCR STD_AXIS ASMod_rEGRActVal_mp Pos_Prc_float 8 0.00 100.000000 FORMAT "%10.6" EXTENDED_LIMITS -1.00000000E+037 1.00000000E+037 DEPOSIT ABSOLUTE /end AXIS_DESCR
/end CHARACTERISTIC
/begin CHARACTERISTIC ASMod_arEffExhFlpLP_CUR "Kennlinie der effektiven Querschnittsfläche vom niedrigem Druck-Abgasventil" CURVE 0x8002EBC0 Cur_Xr32Wr32 32.0000000 Area_cm2_float 0.00 32.0000000 FORMAT "%10.7" EXTENDED_LIMITS -1.00000000E+037 1.00000000E+037
 /begin AXIS_DESCR STD_AXIS ASMod_rExhMnfLPlp_CrvIn_mp Area_cm2_float 10 0.00 100.000000 FORMAT "%10.6" EXTENDED_LIMITS -1.00000000E+037 1.00000000E+037 DEPOSIT ABSOLUTE /end AXIS_DESCR
/end CHARACTERISTIC
/begin CHARACTERISTIC ASMod_cpCmpr_C "" VALUE 0x8002CF64 Val_Ws16 2.000000 SpecificHeat 0.00 2.000000 FORMAT "%8.6" EXTENDED_LIMITS -3.276800 3.276700 /end CHARACTERISTIC
/begin CHARACTERISTIC ASMod_cpGs_C "Spezifische Wärmekapazität Gas" VALUE 0x8002D908 Val_Ws32 2.00000000000 SpecificHeat 0.00 2.00000000000 FORMAT "%13.11" EXTENDED_LIMITS -214748.364800 214748.364700 /end CHARACTERISTIC
/begin CHARACTERISTIC ASMod_dmAshEG_CUR "Kennlinie für Rußmassentrom nach Verbrennung (aus Ölverbrauch)" CURVE 0x8002DC04 Cur_Xs16Ws16 16.00000 AshEGMassPerTime 0.00 16.00000 FORMAT "%8.5" EXTENDED_LIMITS -16.38400 16.38350
 /begin AXIS_DESCR STD_AXIS ASMod_dmOilCons OilMassPerTime 8 0.00 7.000000 FORMAT "%8.6" EXTENDED_LIMITS -3.276800 3.276700 DEPOSIT ABSOLUTE /end AXIS_DESCR
/end CHARACTERISTIC
/begin CHARACTERISTIC ASMod_dmEGRActSwt_C "" VALUE 0x8002D9E4 Val_Ws32 720.001220703 RmpAirMassPerTime -360.000610352 360.000610352 FORMAT "%13.9" EXTENDED_LIMITS -3276800.00000 3276799.99847 /end CHARACTERISTIC
/begin CHARACTERISTIC ASMod_dmEGRSimSwt_C "" VALUE 0x8002D9E8 Val_Ws32 720.001220703 RmpAirMassPerTime -360.000610352 360.000610352 FORMAT "%13.9" EXTENDED_LIMITS -3276800.00000 3276799.99847 /end CHARACTERISTIC
/begin CHARACTERISTIC ASMod_dmIntMnfDsRef_MAP "Referenz des Gasmassenstroms nach Einlasskrümmer" MAP 0x8002DC26 Map_Xs16Ys16Ws16 1400.000 AirMassPerTime 0.00 1400.000 EXTENDED_LIMITS -3276.800 3276.700
 /begin AXIS_DESCR STD_AXIS Epm_nEng EngN 8 0.00 10000.00 EXTENDED_LIMITS -16384.00 16383.50 DEPOSIT ABSOLUTE /end AXIS_DESCR
 /begin AXIS_DESCR STD_AXIS ASMod_qBrn_mp InjMass 8 0.00 150.0000 EXTENDED_LIMITS -327.6800 327.6700 DEPOSIT ABSOLUTE /end AXIS_DESCR
/end CHARACTERISTIC
/begin CHARACTERISTIC ASMod_dmNOxBasLM_MAP "Kennfeld für den Basiswert des NOx-Massenstroms nach Verbrennung, Betriebsart 'Magerbetrieb'" MAP 0x8002DCCA Map_Xs16Ys16Ws16 1000.000 NOxMassPerTime 0.00 1000.000 FORMAT "%8.3" EXTENDED_LIMITS -3276.800 3276.700
 /begin AXIS_DESCR STD_AXIS Epm_nEng EngN 10 0.00 10000.00 EXTENDED_LIMITS -16384.00 16383.50 DEPOSIT ABSOLUTE /end AXIS_DESCR
 /begin AXIS_DESCR STD_AXIS PthSet_trqInrSet Trq 10 -500.0000 1000.000 EXTENDED_LIMITS -3276.800 3276.700 DEPOSIT ABSOLUTE /end AXIS_DESCR
/end CHARACTERISTIC
/begin CHARACTERISTIC ASMod_dmNOxEGROff_MAP "Kennfeld für den NOx-Massenstrom bei abgeschalteter ARF" MAP 0x8002DDBE Map_Xs16Ys16Ws16 1000.000 NOxMassPerTime 0.00 1000.000 FORMAT "%8.3" EXTENDED_LIMITS -3276.800 3276.700
 /begin AXIS_DESCR STD_AXIS Epm_nEng EngN 10 0.00 10000.00 EXTENDED_LIMITS -16384.00 16383.50 DEPOSIT ABSOLUTE /end AXIS_DESCR
 /begin AXIS_DESCR STD_AXIS PthSet_trqInrSet Trq 10 -500.0000 1000.000 EXTENDED_LIMITS -3276.800 3276.700 DEPOSIT ABSOLUTE /end AXIS_DESCR
/end CHARACTERISTIC
/begin CHARACTERISTIC ASMod_dmOilConsBas_CUR "Kennlinie für den Massenstroms des verbrannten Öls abhängig vom Kraftstoff-Verbrauch" CURVE 0x8002DEB2 Cur_Xs16Ws16 1.000000 OilMassPerTime 0.00 1.000000 FORMAT "%8.6" EXTENDED_LIMITS -3.276800 3.276700
 /begin AXIS_DESCR STD_AXIS FlSys_dvolFlCons FlConsum_l_h 8 0.00 40.00000 FORMAT "%8.5" EXTENDED_LIMITS -327.6800 327.6700 DEPOSIT ABSOLUTE /end AXIS_DESCR
/end CHARACTERISTIC
/begin CHARACTERISTIC ASMod_dmSotBasLM_MAP "Kennfeld für den Basiswert des Ruß-Massenstroms nach Verbrennung, Betriebsart 'Magerbetrieb'" MAP 0x8002DED4 Map_Xs16Ys16Ws16 327.6700 SotMassPerTime 0.00 327.6700 FORMAT "%8.4" EXTENDED_LIMITS -327.6800 327.6700
 /begin AXIS_DESCR STD_AXIS Epm_nEng EngN 8 0.00 10000.00 EXTENDED_LIMITS -16384.00 16383.50 DEPOSIT ABSOLUTE /end AXIS_DESCR
 /begin AXIS_DESCR STD_AXIS PthSet_trqInrSet Trq 8 -500.0000 1000.000 EXTENDED_LIMITS -3276.800 3276.700 DEPOSIT ABSOLUTE /end AXIS_DESCR
/end CHARACTERISTIC
/begin CHARACTERISTIC ASMod_dmSotLamCor_MAP "Kennfeld für Lambda-Korrekturmassenstrom des Rußmassenstroms" MAP 0x8002DF78 Map_Xs16Ys16Ws16 327.6700 SotMassPerTime 0.00 327.6700 FORMAT "%8.4" EXTENDED_LIMITS -327.6800 327.6700
 /begin AXIS_DESCR STD_AXIS ASMod_rSotLamCorCrvIn1_mp lambdaRecVal 8 0.00 2.000000 FORMAT "%8.6" EXTENDED_LIMITS -32.76800 32.76700 DEPOSIT ABSOLUTE /end AXIS_DESCR
 /begin AXIS_DESCR STD_AXIS ASMod_rSotLamCorCrvIn2_mp lambdaRecVal 8 0.00 2.000000 FORMAT "%8.6" EXTENDED_LIMITS -32.76800 32.76700 DEPOSIT ABSOLUTE /end AXIS_DESCR
/end CHARACTERISTIC
/begin CHARACTERISTIC ASMod_dmSotRatEGRCorBas_MAP "Kennfeld für betriebspunktabhängige ARF-Korrektur des Rußmassenstroms" MAP 0x8002E01C Map_Xs16Ys16Ws16 327.6700 SotMassPerTime 0.00 327.6700 FORMAT "%8.4" EXTENDED_LIMITS -327.6800 327.6700
 /begin AXIS_DESCR STD_AXIS Epm_nEng EngN 8 0.00 10000.00 EXTENDED_LIMITS -16384.00 16383.50 DEPOSIT ABSOLUTE /end AXIS_DESCR
 /begin AXIS_DESCR STD_AXIS PthSet_trqInrSet Trq 8 -500.0000 1000.000 EXTENDED_LIMITS -3276.800 3276.700 DEPOSIT ABSOLUTE /end AXIS_DESCR
/end CHARACTERISTIC
/begin CHARACTERISTIC ASMod_dnRlsEGRLrnHigh_C "" VALUE 0x8002DAD4 Val_Ws16 3000.000 EngNGrd -1500.000 1500.000 FORMAT "%8.3" EXTENDED_LIMITS -16384.00 16383.50 /end CHARACTERISTIC
/begin CHARACTERISTIC ASMod_dnRlsEGRLrnLow_C "" VALUE 0x8002DAD6 Val_Ws16 3000.000 EngNGrd -1500.000 1500.000 FORMAT "%8.3" EXTENDED_LIMITS -16384.00 16383.50 /end CHARACTERISTIC
/begin CHARACTERISTIC ASMod_dqRlsEGRLrnHigh_C "" VALUE 0x8002DAD8 Val_Ws16 500.0000 InjMassSec -250.0000 250.0000 FORMAT "%8.4" EXTENDED_LIMITS -327.6800 327.6700 /end CHARACTERISTIC
/begin CHARACTERISTIC ASMod_dqRlsEGRLrnLow_C "" VALUE 0x8002DADA Val_Ws16 500.0000 InjMassSec -250.0000 250.0000 FORMAT "%8.4" EXTENDED_LIMITS -327.6800 327.6700 /end CHARACTERISTIC
/begin CHARACTERISTIC ASMod_drLamRecMin_C "minimaler Gradient des reziproken Lambdasignals zur Erkennung rußemissionsrelevanter Lambda-Dynamik" VALUE 0x8002E0C0 Val_Ws16 200.0000 drLamRec_Persec -100.0000 100.0000 FORMAT "%8.4" EXTENDED_LIMITS -327.6800 327.6700 /end CHARACTERISTIC
/begin CHARACTERISTIC ASMod_EGRLPThr.rPresCrit_C "ungefilterter rückgeführter Abgasmassenstrom ND-EGR/" VALUE 0x8002DB50 Kw_Wr32 1.00000000 OneToOne 0.00 1.00000000 FORMAT "%10.8" EXTENDED_LIMITS -1.00000000E+037 1.00000000E+037 /end CHARACTERISTIC
/begin CHARACTERISTIC ASMod_EGRLPThr.facFlwCrit_C "ungefilterter rückgeführter Abgasmassenstrom ND-EGR/" VALUE 0x8002DB54 Kw_Wr32 1.00000000 OneToOne 0.00 1.00000000 FORMAT "%10.8" EXTENDED_LIMITS -1.00000000E+037 1.00000000E+037 /end CHARACTERISTIC
/begin CHARACTERISTIC ASMod_EGRLPThr.rPresLin_C "ungefilterter rückgeführter Abgasmassenstrom ND-EGR/" VALUE 0x8002DB58 Kw_Wr32 1.00000000 OneToOne 0.00 1.00000000 FORMAT "%10.8" EXTENDED_LIMITS -1.00000000E+037 1.00000000E+037 /end CHARACTERISTIC
/begin CHARACTERISTIC ASMod_EGRLPThr.facSlpLin_C "ungefilterter rückgeführter Abgasmassenstrom ND-EGR/" VALUE 0x8002DB5C Kw_Wr32 100.000000 OneToOne 0.00 100.000000 FORMAT "%10.6" EXTENDED_LIMITS -1.00000000E+037 1.00000000E+037 /end CHARACTERISTIC
/begin CHARACTERISTIC ASMod_EGRThr.rPresCrit_C "/" VALUE 0x8002D9EC Kw_Wr32 1.00000000 OneToOne 0.00 1.00000000 FORMAT "%10.8" EXTENDED_LIMITS -1.00000000E+037 1.00000000E+037 /end CHARACTERISTIC
/begin CHARACTERISTIC ASMod_EGRThr.facFlwCrit_C "/" VALUE 0x8002D9F0 Kw_Wr32 1.00000000 OneToOne 0.00 1.00000000 FORMAT "%10.8" EXTENDED_LIMITS -1.00000000E+037 1.00000000E+037 /end CHARACTERISTIC
/begin CHARACTERISTIC ASMod_EGRThr.rPresLin_C "/" VALUE 0x8002D9F4 Kw_Wr32 1.00000000 OneToOne 0.00 1.00000000 FORMAT "%10.8" EXTENDED_LIMITS -1.00000000E+037 1.00000000E+037 /end CHARACTERISTIC
/begin CHARACTERISTIC ASMod_EGRThr.facSlpLin_C "/" VALUE 0x8002D9F8 Kw_Wr32 100.000000 OneToOne 0.00 100.000000 FORMAT "%10.6" EXTENDED_LIMITS -1.00000000E+037 1.00000000E+037 /end CHARACTERISTIC
/begin CHARACTERISTIC ASMod_etaCmpr_MAP "" MAP 0x8002CF68 Map_Xr32Yr32Wr32 1.00000000 Fact_float 0.00 1.00000000 FORMAT "%10.8" EXTENDED_LIMITS -1.00000000E+037 1.00000000E+037
 /begin AXIS_DESCR STD_AXIS ASMod_rPresCmprFMod_mp OneToOne 16 0.500000000 3.00000000 FORMAT "%6.3" EXTENDED_LIMITS -1.00000000E+037 1.00000000E+037 DEPOSIT ABSOLUTE /end AXIS_DESCR
 /begin AXIS_DESCR STD_AXIS ASMod_dmCmprUsRed_mp AirMassPerTime_float 16 0.00 1400.00000 FORMAT "%10.5" EXTENDED_LIMITS -1.00000000E+037 1.00000000E+037 DEPOSIT ABSOLUTE /end AXIS_DESCR
/end CHARACTERISTIC
/begin CHARACTERISTIC ASMod_etaEGRClgLP_MAP "" MAP 0x8002DB60 Map_Xr32Yr32Wr32 1.00000000 OneToOne 0.00 1.00000000 EXTENDED_LIMITS -1.00000000E+037 1.00000000E+037
 /begin AXIS_DESCR STD_AXIS ASMod_etaEGRClgLP1_MapIn_mp AirMassPerTime_float 6 -700.000000 700.000000 FORMAT "%10.6" EXTENDED_LIMITS -1.00000000E+037 1.00000000E+037 DEPOSIT ABSOLUTE /end AXIS_DESCR
 /begin AXIS_DESCR STD_AXIS ASMod_etaEGRClgLP2_MapIn_mp Pos_Prc_float 3 0.00 100.000000 FORMAT "%10.6" EXTENDED_LIMITS -1.00000000E+037 1.00000000E+037 DEPOSIT ABSOLUTE /end AXIS_DESCR
/end CHARACTERISTIC
/begin CHARACTERISTIC ASMod_etaEGRClg_MAP "Wirkungsgrad des ARF-Kühlers" MAP 0x8002D9FC Map_Xs16Ys16Ws16 1.000000 Fact 0.00 1.000000 EXTENDED_LIMITS -4.000000 3.999878
 /begin AXIS_DESCR STD_AXIS ASMod_dmEGRDs AirMassPerTime 6 0.00 500.0000 EXTENDED_LIMITS -3276.800 3276.700 DEPOSIT ABSOLUTE /end AXIS_DESCR
 /begin AXIS_DESCR STD_AXIS ASMod_rRelPosECB Prc 3 0.00 100.0000 EXTENDED_LIMITS -400.0000 399.9878 DEPOSIT ABSOLUTE /end AXIS_DESCR
/end CHARACTERISTIC
/begin CHARACTERISTIC ASMod_ExhMnfLPThr.rPresCrit_C "Parameter für Drossel Abgaskrümmer/" VALUE 0x8002EC14 Kw_Wr32 1.00000000 OneToOne 0.00 1.00000000 FORMAT "%10.8" EXTENDED_LIMITS -1.00000000E+037 1.00000000E+037 /end CHARACTERISTIC
/begin CHARACTERISTIC ASMod_ExhMnfLPThr.facFlwCrit_C "Parameter für Drossel Abgaskrümmer/" VALUE 0x8002EC18 Kw_Wr32 1.00000000 OneToOne 0.00 1.00000000 FORMAT "%10.8" EXTENDED_LIMITS -1.00000000E+037 1.00000000E+037 /end CHARACTERISTIC
/begin CHARACTERISTIC ASMod_ExhMnfLPThr.rPresLin_C "Parameter für Drossel Abgaskrümmer/" VALUE 0x8002EC1C Kw_Wr32 1.00000000 OneToOne 0.00 1.00000000 FORMAT "%10.8" EXTENDED_LIMITS -1.00000000E+037 1.00000000E+037 /end CHARACTERISTIC
/begin CHARACTERISTIC ASMod_ExhMnfLPThr.facSlpLin_C "Parameter für Drossel Abgaskrümmer/" VALUE 0x8002EC20 Kw_Wr32 100.000000 OneToOne 0.00 100.000000 FORMAT "%10.6" EXTENDED_LIMITS -1.00000000E+037 1.00000000E+037 /end CHARACTERISTIC
/begin CHARACTERISTIC ASMod_facBrickCmpr_C "" VALUE 0x8002D3F0 Val_Ws16 1.000000 Fact100 0.00 1.000000 FORMAT "%8.6" EXTENDED_LIMITS -327.6800 327.6700 /end CHARACTERISTIC
/begin CHARACTERISTIC ASMod_facDdT_C "Faktor zur Berechnung der Gaslaufzeit durch den Motor" VALUE 0x8002E0C2 Val_Ws16 7.000000 Fact1 1.000000 8.000000 EXTENDED_LIMITS -256.0000 255.9922 /end CHARACTERISTIC
/begin CHARACTERISTIC ASMod_facEGRClgEtaCor_CUR "" CURVE 0x8002DA36 Cur_Xs16Ws16 1.000000 Fact 0.00 1.000000 EXTENDED_LIMITS -4.000000 3.999878
 /begin AXIS_DESCR STD_AXIS Epm_nEng EngN 10 0.00 6000.000 EXTENDED_LIMITS -16384.00 16383.50 DEPOSIT ABSOLUTE /end AXIS_DESCR
/end CHARACTERISTIC
/begin CHARACTERISTIC ASMod_facEGRDvtCorMax_C "obere Begrenzung des Korrekturfaktors für den NOx-Massenstrom abhängig von der ARF-Raten-Abweichung" VALUE 0x8002E0C4 Val_Ws16 2.000000 Fact1 0.00 2.000000 EXTENDED_LIMITS -256.0000 255.9922 /end CHARACTERISTIC
/begin CHARACTERISTIC ASMod_facEGRDvtCorMin_C "untere Begrenzung des Korrekturfaktors für den NOx-Massenstrom abhängig von der ARF-Raten-Abweichung" VALUE 0x8002E0C6 Val_Ws16 4.000000 Fact1 -2.000000 2.000000 EXTENDED_LIMITS -256.0000 255.9922 /end CHARACTERISTIC
/begin CHARACTERISTIC ASMod_facEGRDvtPOp_MAP "Kennfeld des Korrekturfaktors für die Gewichtungs der NOx-Emissionen abhängig vom Motor-Betriebspunkt" MAP 0x8002E0C8 Map_Xs16Ys16Ws16 20.00000 Fact1 -10.00000 10.00000 EXTENDED_LIMITS -256.0000 255.9922
 /begin AXIS_DESCR STD_AXIS Epm_nEng EngN 10 0.00 10000.00 EXTENDED_LIMITS -16384.00 16383.50 DEPOSIT ABSOLUTE /end AXIS_DESCR
 /begin AXIS_DESCR STD_AXIS PthSet_trqInrSet Trq 10 -500.0000 1000.000 EXTENDED_LIMITS -3276.800 3276.700 DEPOSIT ABSOLUTE /end AXIS_DESCR
/end CHARACTERISTIC
/begin CHARACTERISTIC ASMod_facEGRDvtWgh1_CUR "Kennlinie der höheren Gewichtungsfaktoren für die NOx-Emissionen abhängig von der ARF-Raten-Abweichung" CURVE 0x8002E1BC Cur_Xs16Ws16 2.000000 Fact1 -1.000000 1.000000 EXTENDED_LIMITS -256.0000 255.9922
 /begin AXIS_DESCR STD_AXIS ASMod_rEGRDvtWghCrvIn_mp RatAirMass 16 -0.5000000 1.000000 FORMAT "%8.6" EXTENDED_LIMITS -327.6800 327.6700 DEPOSIT ABSOLUTE /end AXIS_DESCR
/end CHARACTERISTIC
/begin CHARACTERISTIC ASMod_facEGRDvtWgh2_CUR "Kennlinie der niedrigeren Gewichtungsfaktoren für die NOx-Emissionen abhängig von der ARF-Raten-Abweichung" CURVE 0x8002E1FE Cur_Xs16Ws16 2.000000 Fact1 -1.000000 1.000000 EXTENDED_LIMITS -256.0000 255.9922
 /begin AXIS_DESCR STD_AXIS ASMod_rEGRDvtWghCrvIn_mp RatAirMass 16 -0.5000000 1.000000 FORMAT "%8.6" EXTENDED_LIMITS -327.6800 327.6700 DEPOSIT ABSOLUTE /end AXIS_DESCR
/end CHARACTERISTIC
/begin CHARACTERISTIC ASMod_facEGTempMsFlwCor_CUR "Kennlinie für Korrekturfaktor der Temperaturerhöhung aufgrund des aktuellen Gasmassenstroms nach Einlasskrümmer" CURVE 0x8002E240 Cur_Xs16Ws16 2.000000 Fact 0.00 2.000000 EXTENDED_LIMITS -4.000000 3.999878
 /begin AXIS_DESCR STD_AXIS ASMod_rMsFlwRef_mp RatAirMass 8 -1.000000 1.000000 FORMAT "%8.6" EXTENDED_LIMITS -327.6800 327.6700 DEPOSIT ABSOLUTE /end AXIS_DESCR
/end CHARACTERISTIC
/begin CHARACTERISTIC ASMod_facEGTempSOICor_CUR "Kennlinie für Korrekturfaktor der Temperaturerhöhung aufgrund des aktuellen Spritzbeginns" CURVE 0x8002E262 Cur_Xs16Ws16 2.000000 Fact 0.00 2.000000 EXTENDED_LIMITS -4.000000 3.999878
 /begin AXIS_DESCR STD_AXIS ASMod_phiDiffSOIRef_mp AngleCrS 8 -19.99512 19.99512 EXTENDED_LIMITS -720.0000 719.9780 DEPOSIT ABSOLUTE /end AXIS_DESCR
/end CHARACTERISTIC
/begin CHARACTERISTIC ASMod_facEnvPresCmpr_CUR "Korrekturkennlinie für reduzierten Gasmassenstrom vor Verdichter" CURVE 0x8002D3F4 Cur_Xr32Wr32 4.00000000 Fact_float -2.00000000 2.00000000 FORMAT "%10.8" EXTENDED_LIMITS -1.00000000E+037 1.00000000E+037
 /begin AXIS_DESCR STD_AXIS ASMod_facEnvPresCmpr_mp Fact_float 6 500.000000 1200.00000 FORMAT "%10.5" EXTENDED_LIMITS -1.00000000E+037 1.00000000E+037 DEPOSIT ABSOLUTE /end AXIS_DESCR
/end CHARACTERISTIC
/begin CHARACTERISTIC ASMod_facKdDT1LamSot_C "Verstärkungsfaktor für Ermittlung der Ableitung des reziproken Lambda-Signals" VALUE 0x8002E284 Val_Ws32 100.000000000 Kd -50.0000000000 50.0000000000 FORMAT "%13.10" EXTENDED_LIMITS -32768.0000000 32767.9999847 /end CHARACTERISTIC
/begin CHARACTERISTIC ASMod_facLamRecRef_C "Faktor zur Ermittlung des minimalen reziproken Lambda-Signals für Erkennung rußemissionsrelevanter Lambda-Dynamik" VALUE 0x8002E288 Val_Ws16 1.000000 Fact 0.00 1.000000 EXTENDED_LIMITS -4.000000 3.999878 /end CHARACTERISTIC
/begin CHARACTERISTIC ASMod_facOilConsLfTCor_CUR "Kennlinie für Motorlaufzeitkorrekturfaktor des Ölverbrauchs des Motors" CURVE 0x8002E28A Cur_Xs16Ws16 3.000000 Fact 0.00 3.000000 EXTENDED_LIMITS -4.000000 3.999878
 /begin AXIS_DESCR STD_AXIS ASMod_tiEngOn_mp Time100HrsEngOn 16 0.00 8000.000 FORMAT "%8.3" EXTENDED_LIMITS -32768.00 32767.00 DEPOSIT ABSOLUTE /end AXIS_DESCR
/end CHARACTERISTIC
/begin CHARACTERISTIC ASMod_facPresLsCmprDs_C "Faktor zur Berechnung des Druckabfalls nach Verdichter" VALUE 0x8002D428 Val_Wr32 0.300000000 FactPresLs_float 0.00 0.300000000 FORMAT "%11.9" EXTENDED_LIMITS -1.00000000E+037 1.00000000E+037 /end CHARACTERISTIC
/begin CHARACTERISTIC ASMod_facPresLsEGRClgLP_CUR "" CURVE 0x8002DBD4 Cur_Xr32Wr32 0.300000000 FactPresLs_float 0.00 0.300000000 FORMAT "%11.9" EXTENDED_LIMITS -1.00000000E+037 1.00000000E+037
 /begin AXIS_DESCR STD_AXIS ASMod_rPresLsEGRClgLP_CrvIn_mp Pos_Prc_float 3 0.00 100.000000 FORMAT "%10.6" EXTENDED_LIMITS -1.00000000E+037 1.00000000E+037 DEPOSIT ABSOLUTE /end AXIS_DESCR
/end CHARACTERISTIC
/begin CHARACTERISTIC ASMod_facPresTotCorDs_C "Faktor zur Berechnung des Totaldrucks nach Verdichter" VALUE 0x8002D42C Val_Wr32 0.300000000 FactPresLs_float 0.00 0.300000000 FORMAT "%11.9" EXTENDED_LIMITS -1.00000000E+037 1.00000000E+037 /end CHARACTERISTIC
/begin CHARACTERISTIC ASMod_facPresTotCorUs_C "Faktor zur Berechnung des Totaldrucks vor Verdichter" VALUE 0x8002D430 Val_Wr32 0.300000000 FactPresLs_float 0.00 0.300000000 FORMAT "%11.9" EXTENDED_LIMITS -1.00000000E+037 1.00000000E+037 /end CHARACTERISTIC
/begin CHARACTERISTIC ASMod_facSotLfTCor_CUR "Kennlinie des Korrekturfaktors für die Ruß-Emissionen abhängig Fahrzeug-Betriebszeit" CURVE 0x8002E2CC Cur_Xs16Ws16 1.000000 Fact 0.00 1.000000 EXTENDED_LIMITS -4.000000 3.999878
 /begin AXIS_DESCR STD_AXIS ASMod_lSumVehLfTSot_mp LengthKm 8 0.00 500000.0 FORMAT "%8.1" EXTENDED_LIMITS -655360.0 655340.0 DEPOSIT ABSOLUTE /end AXIS_DESCR
/end CHARACTERISTIC
/begin CHARACTERISTIC ASMod_facSotRatEGRCor_CUR "Kennlinie für ARF-Korrekturfaktor des Rußmassenstroms" CURVE 0x8002E2EE Cur_Xs16Ws16 3.000000 Fact 0.00 3.000000 EXTENDED_LIMITS -4.000000 3.999878
 /begin AXIS_DESCR STD_AXIS ASMod_rSotRatEGRCorCrvIn_mp RatAirMass 8 0.00 0.8000000 FORMAT "%9.7" EXTENDED_LIMITS -327.6800 327.6700 DEPOSIT ABSOLUTE /end AXIS_DESCR
/end CHARACTERISTIC
/begin CHARACTERISTIC ASMod_facSpdCmprEnv_CUR "" CURVE 0x8002D434 Cur_Xs16Ws16 1.000000 Fact 0.00 1.000000 EXTENDED_LIMITS -4.000000 3.999878
 /begin AXIS_DESCR STD_AXIS VehV_v Vel 4 0.00 300.0000 EXTENDED_LIMITS -327.6800 327.6700 DEPOSIT ABSOLUTE /end AXIS_DESCR
/end CHARACTERISTIC
/begin CHARACTERISTIC ASMod_facTempCmprEnv_CUR "" CURVE 0x8002D446 Cur_Xs16Ws16 1.000000 Fact 0.00 1.000000 EXTENDED_LIMITS -4.000000 3.999878
 /begin AXIS_DESCR STD_AXIS EnvT_t Temp_Cels 4 -30.04000 999.9600 EXTENDED_LIMITS -3549.940 3003.560 DEPOSIT ABSOLUTE /end AXIS_DESCR
/end CHARACTERISTIC
/begin CHARACTERISTIC ASMod_htcCmprEnv_C "" VALUE 0x8002D458 Val_Ws32 999.900000000 ThermalCoEff 0.100000000000 1000.00000000 FORMAT "%13.8" EXTENDED_LIMITS -214748364.800 214748364.700 /end CHARACTERISTIC
/begin CHARACTERISTIC ASMod_mExhMnfLPMin_C "minimale Luftmasse im Niederdruck-Abgaskrümmer" VALUE 0x8002EC24 Val_Wr32 149.500000 Airmass_float 0.500000000 150.000000 FORMAT "%10.6" EXTENDED_LIMITS -1.00000000E+037 1.00000000E+037 /end CHARACTERISTIC
/begin CHARACTERISTIC ASMod_MsFlwEGRLPPT1.tiUp_C "Gefilterter zurückgeführter Abgasmassenstrom nach ND-EGR Kühler/" VALUE 0x8002DBF0 Kw_Wr32 1.00000000 Time_s_float 0.00 1.00000000 FORMAT "%10.8" EXTENDED_LIMITS -1.00000000E+037 1.00000000E+037 /end CHARACTERISTIC
/begin CHARACTERISTIC ASMod_MsFlwEGRLPPT1.tiDwn_C "Gefilterter zurückgeführter Abgasmassenstrom nach ND-EGR Kühler/" VALUE 0x8002DBF4 Kw_Wr32 1.00000000 Time_s_float 0.00 1.00000000 FORMAT "%10.8" EXTENDED_LIMITS -1.00000000E+037 1.00000000E+037 /end CHARACTERISTIC
/begin CHARACTERISTIC ASMod_MsFlwExhMnfLPPT1.tiUp_C "Parameter PT1-Glied - Abgasmassenstrom Abgaskrümmer/" VALUE 0x8002EC28 Kw_Wr32 1.00000000 Time_s_float 0.00 1.00000000 FORMAT "%10.8" EXTENDED_LIMITS -1.00000000E+037 1.00000000E+037 /end CHARACTERISTIC
/begin CHARACTERISTIC ASMod_MsFlwExhMnfLPPT1.tiDwn_C "Parameter PT1-Glied - Abgasmassenstrom Abgaskrümmer/" VALUE 0x8002EC2C Kw_Wr32 1.00000000 Time_s_float 0.00 1.00000000 FORMAT "%10.8" EXTENDED_LIMITS -1.00000000E+037 1.00000000E+037 /end CHARACTERISTIC
/begin CHARACTERISTIC ASMod_nHPTrbn_C "" VALUE 0x8002CF2E Val_Ws16 655350.0 TurboN -327680.0 327670.0 FORMAT "%8.1" /end CHARACTERISTIC
/begin CHARACTERISTIC ASMod_nLPTrbn_C "" VALUE 0x8002CF30 Val_Ws16 655350.0 TurboN -327680.0 327670.0 FORMAT "%8.1" /end CHARACTERISTIC
/begin CHARACTERISTIC ASMod_nRlsEGRLrnHigh_C "" VALUE 0x8002DADC Val_Ws16 6000.000 EngN1 0.00 6000.000 FORMAT "%8.3" EXTENDED_LIMITS -16384.00 16383.50 /end CHARACTERISTIC
/begin CHARACTERISTIC ASMod_nRlsEGRLrnLow_C "" VALUE 0x8002DADE Val_Ws16 6000.000 EngN1 0.00 6000.000 FORMAT "%8.3" EXTENDED_LIMITS -16384.00 16383.50 /end CHARACTERISTIC
/begin CHARACTERISTIC ASMod_nThresDwn_C "Drehzahlschwellwert zur Erkennung auf Motorstillstand" VALUE 0x8002D90C Val_Ws16 900.0000 EngN 0.00 900.0000 EXTENDED_LIMITS -16384.00 16383.50 /end CHARACTERISTIC
/begin CHARACTERISTIC ASMod_nTrbChRed_MAP "charakteristisches Verdichterkennfeld" MAP 0x8002D45C Map_Xr32Yr32Wr32 300000.000 TrbChN_float 0.00 300000.000 FORMAT "%10.3" EXTENDED_LIMITS -1.00000000E+037 1.00000000E+037
 /begin AXIS_DESCR STD_AXIS ASMod_rPresCmprFMod_mp OneToOne 16 0.500000000 3.00000000 FORMAT "%6.3" EXTENDED_LIMITS -1.00000000E+037 1.00000000E+037 DEPOSIT ABSOLUTE /end AXIS_DESCR
 /begin AXIS_DESCR STD_AXIS ASMod_dmCmprUsRed_mp AirMassPerTime_float 16 0.00 1400.00000 FORMAT "%10.5" EXTENDED_LIMITS -1.00000000E+037 1.00000000E+037 DEPOSIT ABSOLUTE /end AXIS_DESCR
/end CHARACTERISTIC
/begin CHARACTERISTIC ASMod_numBnk_C "Anzahl der Motorbänke" VALUE 0x8002D90E Val_Wu8 2.000 OneToOne 0.00 2.000 EXTENDED_LIMITS 0.00 255.0 /end CHARACTERISTIC
/begin CHARACTERISTIC ASMod_numEnvPres_C "Index zur Auswahl des Umgebungsdrucks aus dem Druck-Feld" VALUE 0x8002D910 Val_Ws16 6.000000 OneToOne 0.00 6.000000 EXTENDED_LIMITS -32768.00 32767.00 /end CHARACTERISTIC
/begin CHARACTERISTIC ASMod_numExhMnfLPDs_C "Index zur Auswahl des Rohrmodells nach dem niederdruckseitigen Abgaskrümmer" VALUE 0x8002D912 Val_Ws16 7.000000 OneToOne 0.00 7.000000 EXTENDED_LIMITS -32768.00 32767.00 /end CHARACTERISTIC
/begin CHARACTERISTIC ASMod_numExhMnfLPUs_C "Index zur Auswahl des Rohrmodells vor dem niederdruckseitigen Abgaskrümmer" VALUE 0x8002D914 Val_Ws16 7.000000 OneToOne 0.00 7.000000 EXTENDED_LIMITS -32768.00 32767.00 /end CHARACTERISTIC
/begin CHARACTERISTIC ASMod_numExhMnfLP_C "Index zur Auswahl des Rohrmodells für den niederdruckseitigen Abgaskrümmer" VALUE 0x8002D916 Val_Ws16 7.000000 OneToOne 0.00 7.000000 EXTENDED_LIMITS -32768.00 32767.00 /end CHARACTERISTIC
/begin CHARACTERISTIC ASMod_numMixPntEGDs_C "Index zur Auswahl des Rohrmodells nach Mischstelle" VALUE 0x8002D918 Val_Ws16 65535.00 OneToOne -32768.00 32767.00 /end CHARACTERISTIC
/begin CHARACTERISTIC ASMod_numMixPntEGUs_C "Index zur Auswahl des Rohrmodells vor Mischstelle" VALUE 0x8002D91A Val_Ws16 65535.00 OneToOne -32768.00 32767.00 /end CHARACTERISTIC
/begin CHARACTERISTIC ASMod_numOxiCDs_CA "Index-Array zum Temperaturfeld ASMod_tFld für die Temperaturen am Ausgang des Oxidationskatalysators" VAL_BLK 0x8002D91C ValA_Ws16 65535.00 OneToOne -32768.00 32767.00 NUMBER 1 /end CHARACTERISTIC
/begin CHARACTERISTIC ASMod_numOxiCUs_CA "Index-Array zum Temperaturfeld ASMod_tFld für die Temperaturen am Eingang des Oxidationskatalysators" VAL_BLK 0x8002D91E ValA_Ws16 65535.00 OneToOne -32768.00 32767.00 NUMBER 1 /end CHARACTERISTIC
/begin CHARACTERISTIC ASMod_numPFltDs_C "Index zur Auswahl des Rohrmodells nach Partikelfilter" VALUE 0x8002D920 Val_Ws16 6.000000 OneToOne 0.00 6.000000 EXTENDED_LIMITS -32768.00 32767.00 /end CHARACTERISTIC
/begin CHARACTERISTIC ASMod_numPFltUs_C "Index zur Auswahl des Rohrmodells vor Partikelfilter" VALUE 0x8002D922 Val_Ws16 6.000000 OneToOne 0.00 6.000000 EXTENDED_LIMITS -32768.00 32767.00 /end CHARACTERISTIC
/begin CHARACTERISTIC ASMod_numSotEOMPFltRgn_C "Parameter zur Erkennung des Partikelfilter- Regenerationsbetriebes" VALUE 0x8002E310 Val_Wu8 4.000 OneToOne 0.00 4.000 EXTENDED_LIMITS 0.00 255.0 /end CHARACTERISTIC
/begin CHARACTERISTIC ASMod_numSotLamCorEGROff_C "Parameter zur Auswahl des Lambdareferenzsignals bei abgeschalteter ARF, Abschaltfall oder Partikelfilter-Regeneration" VALUE 0x8002E311 Val_Wu8 2.000 OneToOne 0.00 2.000 EXTENDED_LIMITS 0.00 255.0 /end CHARACTERISTIC
/begin CHARACTERISTIC ASMod_numSotLamCor_C "Parameter zur Auswahl des Lambdareferenzsignals" VALUE 0x8002E312 Val_Wu8 2.000 OneToOne 0.00 2.000 EXTENDED_LIMITS 0.00 255.0 /end CHARACTERISTIC
/begin CHARACTERISTIC ASMod_numTrbnDs_C "Index zur Auswahl des Rohrmodells nach Turbolader" VALUE 0x8002D924 Val_Ws16 6.000000 OneToOne 0.00 6.000000 EXTENDED_LIMITS -32768.00 32767.00 /end CHARACTERISTIC
/begin CHARACTERISTIC ASMod_numTrbn_C "Index zur Auswahl des Rohrmodells für Turboladertemperaturmodell" VALUE 0x8002D926 Val_Ws16 6.000000 OneToOne 0.00 6.000000 EXTENDED_LIMITS -32768.00 32767.00 /end CHARACTERISTIC
/begin CHARACTERISTIC ASMod_pCmprUsRef_C "Referenzdruck vor Verdichter" VALUE 0x8002D8E4 Val_Wr32 4000.00000 Pres_hPa_float 0.00 4000.00000 FORMAT "%10.5" EXTENDED_LIMITS -1.00000000E+037 1.00000000E+037 /end CHARACTERISTIC
/begin CHARACTERISTIC ASMod_phiSOIRefRgn_MAP "" MAP 0x8002E314 Map_Xs16Ys16Ws16 59.98535 AngleCrS -19.99512 39.99023 EXTENDED_LIMITS -720.0000 719.9780
 /begin AXIS_DESCR STD_AXIS Epm_nEng EngN 10 0.00 10000.00 EXTENDED_LIMITS -16384.00 16383.50 DEPOSIT ABSOLUTE /end AXIS_DESCR
 /begin AXIS_DESCR STD_AXIS ASMod_qBrn_mp InjMass 10 0.00 150.0000 EXTENDED_LIMITS -327.6800 327.6700 DEPOSIT ABSOLUTE /end AXIS_DESCR
/end CHARACTERISTIC
/begin CHARACTERISTIC ASMod_phiSOIRef_MAP "Referenzkennfeld für Spritzbeginn der MI1" MAP 0x8002E408 Map_Xs16Ys16Ws16 59.98535 AngleCrS -19.99512 39.99023 EXTENDED_LIMITS -720.0000 719.9780
 /begin AXIS_DESCR STD_AXIS Epm_nEng EngN 8 0.00 10000.00 EXTENDED_LIMITS -16384.00 16383.50 DEPOSIT ABSOLUTE /end AXIS_DESCR
 /begin AXIS_DESCR STD_AXIS ASMod_qBrn_mp InjMass 8 0.00 150.0000 EXTENDED_LIMITS -327.6800 327.6700 DEPOSIT ABSOLUTE /end AXIS_DESCR
/end CHARACTERISTIC
/begin CHARACTERISTIC ASMod_pInit_C "Druck zur Druck-Initialisierung" VALUE 0x8002D928 Val_Ws16 2600.000 Pres_hPa 900.0000 3500.000 EXTENDED_LIMITS -32768.00 32767.00 /end CHARACTERISTIC
/begin CHARACTERISTIC ASMod_qPoI1Ref_MAP "" MAP 0x8002E4AC Map_Xs16Ys16Ws16 327.6700 InjMass 0.00 327.6700 EXTENDED_LIMITS -327.6800 327.6700
 /begin AXIS_DESCR STD_AXIS Epm_nEng EngN 10 0.00 10000.00 EXTENDED_LIMITS -16384.00 16383.50 DEPOSIT ABSOLUTE /end AXIS_DESCR
 /begin AXIS_DESCR STD_AXIS ASMod_qBrn_mp InjMass 10 0.00 150.0000 EXTENDED_LIMITS -327.6800 327.6700 DEPOSIT ABSOLUTE /end AXIS_DESCR
/end CHARACTERISTIC
/begin CHARACTERISTIC ASMod_qPoI2Ref_MAP "" MAP 0x8002E5A0 Map_Xs16Ys16Ws16 327.6700 InjMass 0.00 327.6700 EXTENDED_LIMITS -327.6800 327.6700
 /begin AXIS_DESCR STD_AXIS Epm_nEng EngN 10 0.00 10000.00 EXTENDED_LIMITS -16384.00 16383.50 DEPOSIT ABSOLUTE /end AXIS_DESCR
 /begin AXIS_DESCR STD_AXIS ASMod_qBrn_mp InjMass 10 0.00 150.0000 EXTENDED_LIMITS -327.6800 327.6700 DEPOSIT ABSOLUTE /end AXIS_DESCR
/end CHARACTERISTIC
/begin CHARACTERISTIC ASMod_qRlsEGRLrnHigh_C "" VALUE 0x8002DAE0 Val_Ws16 327.6700 InjMass 0.00 327.6700 EXTENDED_LIMITS -327.6800 327.6700 /end CHARACTERISTIC
/begin CHARACTERISTIC ASMod_qRlsEGRLrnLow_C "" VALUE 0x8002DAE2 Val_Ws16 327.6700 InjMass 0.00 327.6700 EXTENDED_LIMITS -327.6800 327.6700 /end CHARACTERISTIC
/begin CHARACTERISTIC ASMod_rECBLin_CUR "Linearisierungskennlinie für den ARF-Kühler-Bypass-Steller" CURVE 0x8002D92A Cur_Xs16Ws16 100.0000 Prc 0.00 100.0000 EXTENDED_LIMITS -400.0000 399.9878
 /begin AXIS_DESCR STD_AXIS ASMod_rECBLinCrvIn_mp Prc 6 0.00 100.0000 EXTENDED_LIMITS -400.0000 399.9878 DEPOSIT ABSOLUTE /end AXIS_DESCR
/end CHARACTERISTIC
/begin CHARACTERISTIC ASMod_rECBLPLin_CUR "Linearisierungskennlinie für den niederdruckseitigen ARF-Kühler-Bypass-Steller" CURVE 0x8002D944 Kl_Xs16_Ws16 100.0000 Prc 0.00 100.0000 EXTENDED_LIMITS -400.0000 399.9878
 /begin AXIS_DESCR STD_AXIS ASMod_rECBLPLinCrvIn_mp Prc 6 0.00 100.0000 EXTENDED_LIMITS -400.0000 399.9878 DEPOSIT ABSOLUTE /end AXIS_DESCR
/end CHARACTERISTIC
/begin CHARACTERISTIC ASMod_rEGRCorOff_C "Schwellwert der ARF-Rate zum Abschalten der NOx-Emissions-Korrekturen aus ARF-Raten-Abweichung" VALUE 0x8002E694 Val_Ws16 100.0000 RatAirMass 0.00 100.0000 FORMAT "%8.4" EXTENDED_LIMITS -327.6800 327.6700 /end CHARACTERISTIC
/begin CHARACTERISTIC ASMod_rEGRLamCorMax_C "oberer Grenzwert zur Erkennung der abgeschalteten Abgasrückführung" VALUE 0x8002E696 Val_Ws16 100.0000 RatAirMass 0.00 100.0000 FORMAT "%8.4" EXTENDED_LIMITS -327.6800 327.6700 /end CHARACTERISTIC
/begin CHARACTERISTIC ASMod_rEGRLamCorMin_C "unterer Grenzwert zur Erkennung der abgeschalteten Abgasrückführung" VALUE 0x8002E698 Val_Ws16 100.0000 RatAirMass 0.00 100.0000 FORMAT "%8.4" EXTENDED_LIMITS -327.6800 327.6700 /end CHARACTERISTIC
/begin CHARACTERISTIC ASMod_rEGRLPLin_CUR "Linearisierungskennlinie für den niederdruckseitigen ARF-Steller" CURVE 0x8002D95E Kl_Xs16_Ws16 100.0000 Prc 0.00 100.0000 EXTENDED_LIMITS -400.0000 399.9878
 /begin AXIS_DESCR STD_AXIS ASMod_rEGRLPLinCrvIn_mp Prc 6 0.00 100.0000 EXTENDED_LIMITS -400.0000 399.9878 DEPOSIT ABSOLUTE /end AXIS_DESCR
/end CHARACTERISTIC
/begin CHARACTERISTIC ASMod_rEGRSetMin_C "untere Begrenzung des Sollwerts der ARF-Rate zur Korrektur der NOx-Emissionen aus ARF-Raten-Abweichung" VALUE 0x8002E69A Val_Ws16 100.0000 RatAirMass 0.00 100.0000 FORMAT "%8.4" EXTENDED_LIMITS -327.6800 327.6700 /end CHARACTERISTIC
/begin CHARACTERISTIC ASMod_rEGRSet_MAP "Kennfeld der Sollwerte der ARF-Raten im Normalbetrieb" MAP 0x8002E69C Map_Xs16Ys16Ws16 100.0000 RatAirMass 0.00 100.0000 FORMAT "%8.4" EXTENDED_LIMITS -327.6800 327.6700
 /begin AXIS_DESCR STD_AXIS Epm_nEng EngN 10 0.00 10000.00 EXTENDED_LIMITS -16384.00 16383.50 DEPOSIT ABSOLUTE /end AXIS_DESCR
 /begin AXIS_DESCR STD_AXIS PthSet_trqInrSet Trq 10 -500.0000 1000.000 EXTENDED_LIMITS -3276.800 3276.700 DEPOSIT ABSOLUTE /end AXIS_DESCR
/end CHARACTERISTIC
/begin CHARACTERISTIC ASMod_rExhFlpLPLin_CUR "Linearisierungskennlinie für die niederdruckseitige Abgasklappe" CURVE 0x8002D978 Kl_Xs16_Ws16 100.0000 Prc 0.00 100.0000 EXTENDED_LIMITS -400.0000 399.9878
 /begin AXIS_DESCR STD_AXIS ASMod_rExhFlpLPLinCrvIn_mp Prc 6 0.00 100.0000 EXTENDED_LIMITS -400.0000 399.9878 DEPOSIT ABSOLUTE /end AXIS_DESCR
/end CHARACTERISTIC
/begin CHARACTERISTIC ASMod_rLamRecRefBas_MAP "Referenz des reziproken Lambda-Signals" MAP 0x8002E790 Map_Xs16Ys16Ws16 10.00000 lambdaRecVal 0.00 10.00000 FORMAT "%8.5" EXTENDED_LIMITS -32.76800 32.76700
 /begin AXIS_DESCR STD_AXIS Epm_nEng EngN 14 0.00 10000.00 EXTENDED_LIMITS -16384.00 16383.50 DEPOSIT ABSOLUTE /end AXIS_DESCR
 /begin AXIS_DESCR STD_AXIS PthSet_trqInrSet Trq 16 -500.0000 1000.000 EXTENDED_LIMITS -3276.800 3276.700 DEPOSIT ABSOLUTE /end AXIS_DESCR
/end CHARACTERISTIC
/begin CHARACTERISTIC ASMod_rLamRecRefMin_C "minimales reziprokes Lambdasignal zur Erkennung rußemissionsrelevanter Lambda-Dynamik" VALUE 0x8002E990 Val_Ws16 10.00000 lambdaRecVal 0.00 10.00000 FORMAT "%8.5" EXTENDED_LIMITS -32.76800 32.76700 /end CHARACTERISTIC
/begin CHARACTERISTIC ASMod_rRlsPresEGRDiffMin_C "" VALUE 0x8002DAE4 Val_Ws16 4.000000 Fact 0.00 4.000000 EXTENDED_LIMITS -4.000000 3.999878 /end CHARACTERISTIC
/begin CHARACTERISTIC ASMod_rTVALin_CUR "Linearisierungskennlinie für den Regelklappensteller" CURVE 0x8002D992 Cur_Xs16Ws16 100.0000 Prc 0.00 100.0000 EXTENDED_LIMITS -400.0000 399.9878
 /begin AXIS_DESCR STD_AXIS ASMod_rTVALinCrvIn_mp DtyCyc 6 0.00 100.0000 EXTENDED_LIMITS -327.6800 327.6700 DEPOSIT ABSOLUTE /end AXIS_DESCR
/end CHARACTERISTIC
/begin CHARACTERISTIC ASMod_rVSALin_CUR "Linearisierungskennlinie für den Drallklappensteller" CURVE 0x8002D9AC Cur_Xs16Ws16 100.0000 Prc 0.00 100.0000 EXTENDED_LIMITS -400.0000 399.9878
 /begin AXIS_DESCR STD_AXIS ASMod_rVSALinCrvIn_mp Prc 6 0.00 100.0000 EXTENDED_LIMITS -400.0000 399.9878 DEPOSIT ABSOLUTE /end AXIS_DESCR
/end CHARACTERISTIC
/begin CHARACTERISTIC ASMod_stMskOpModeRlsEGRLrn_C "" VALUE 0x8002DAE8 Val_Wu32 4294967295.00 OneToOne 0.00 4294967295.00 /end CHARACTERISTIC
/begin CHARACTERISTIC ASMod_stMskPhiSOIRef_C "" VALUE 0x8002E994 Val_Wu32 4294967295.00 OneToOne 0.00 4294967295.00 /end CHARACTERISTIC
/begin CHARACTERISTIC ASMod_stMskTempDiffEng_C "" VALUE 0x8002E998 Val_Wu32 4294967295.00 OneToOne 0.00 4294967295.00 /end CHARACTERISTIC
/begin CHARACTERISTIC ASMod_stSotEmiEOMMsk_CA "Maskenvektor zur Bestimmung der aktuellen Betriebsart zur Ruß-Emissions-Berechnung" VAL_BLK 0x8002E99C ValA_Wu32 4294967295.00 OneToOne 0.00 4294967295.00 NUMBER 3 /end CHARACTERISTIC
/begin CHARACTERISTIC ASMod_swtAFSSimSel_C "" VALUE 0x8002D9C6 Val_Wu8 1.000 OneToOne 0.00 1.000 EXTENDED_LIMITS 0.00 255.0 /end CHARACTERISTIC
/begin CHARACTERISTIC ASMod_swtAFSSim_C "" VALUE 0x8002DA60 Val_Wu8 1.000 OneToOne 0.00 1.000 EXTENDED_LIMITS 0.00 255.0 /end CHARACTERISTIC
/begin CHARACTERISTIC ASMod_swtCalcQntInjCmb_C "Schalterwert für die Methode zur Berechnung der an der Verbrennung teilnehmenden Kraftstoffmassen" VALUE 0x8002D9C7 Val_Wu8 3.000 OneToOne 0.00 3.000 EXTENDED_LIMITS 0.00 255.0 /end CHARACTERISTIC
/begin CHARACTERISTIC ASMod_swtCalcQntInjNoCmb_C "Schalterwert für die Methode zur Berechnung der nicht an der Verbrennung teilnehmenden Kraftstoffmassen" VALUE 0x8002D9C8 Val_Wu8 3.000 OneToOne 0.00 3.000 EXTENDED_LIMITS 0.00 255.0 /end CHARACTERISTIC
/begin CHARACTERISTIC ASMod_swtEGRClgDsMin_C "" VALUE 0x8002DA61 Val_Wu8 2.000 OneToOne 0.00 2.000 EXTENDED_LIMITS 0.00 255.0 /end CHARACTERISTIC
/begin CHARACTERISTIC ASMod_swtEGRMsFlwSim_C "" VALUE 0x8002DA62 Val_Wu8 1.000 OneToOne 0.00 1.000 EXTENDED_LIMITS 0.00 255.0 /end CHARACTERISTIC
/begin CHARACTERISTIC ASMod_swtPIntkVUs_C "" VALUE 0x8002DA63 Val_Wu8 1.000 OneToOne 0.00 1.000 EXTENDED_LIMITS 0.00 255.0 /end CHARACTERISTIC
/begin CHARACTERISTIC ASMod_swtQntHCEmi_C "" VALUE 0x8002D9C9 Val_Wu8 3.000 OneToOne 0.00 3.000 EXTENDED_LIMITS 0.00 255.0 /end CHARACTERISTIC
/begin CHARACTERISTIC ASMod_swtTEGRThrVlvUs_C "" VALUE 0x8002DA64 Val_Wu8 2.000 OneToOne 0.00 2.000 EXTENDED_LIMITS 0.00 255.0 /end CHARACTERISTIC
/begin CHARACTERISTIC ASMod_swtTempCmprUs_C "" VALUE 0x8002D8E8 Val_Wu8 255.0 OneToOne 0.00 255.0 /end CHARACTERISTIC
/begin CHARACTERISTIC ASMod_tCmprUsRef_C "Referenztemperatur vor Verdichter" VALUE 0x8002D8EC Val_Wr32 250.000000 TempC_float -50.0000000 200.000000 FORMAT "%10.6" EXTENDED_LIMITS -1.00000000E+037 1.00000000E+037 /end CHARACTERISTIC
/begin CHARACTERISTIC ASMod_tDiffEngBas_MAP "Grundkennfeld der Temperaturerhöhung durch Verbrennung" MAP 0x8002E9A8 Map_Xs16Ys16Ws16 1200.000 TempDiff_Kelv -600.0000 600.0000 EXTENDED_LIMITS -3276.800 3276.700
 /begin AXIS_DESCR STD_AXIS Epm_nEng EngN 8 0.00 10000.00 EXTENDED_LIMITS -16384.00 16383.50 DEPOSIT ABSOLUTE /end AXIS_DESCR
 /begin AXIS_DESCR STD_AXIS ASMod_qBrn_mp InjMass 8 0.00 150.0000 EXTENDED_LIMITS -327.6800 327.6700 DEPOSIT ABSOLUTE /end AXIS_DESCR
/end CHARACTERISTIC
/begin CHARACTERISTIC ASMod_tDiffEngRgn_MAP "" MAP 0x8002EA4C Map_Xs16Ys16Ws16 1200.000 TempDiff_Kelv -600.0000 600.0000 EXTENDED_LIMITS -3276.800 3276.700
 /begin AXIS_DESCR STD_AXIS Epm_nEng EngN 10 0.00 10000.00 EXTENDED_LIMITS -16384.00 16383.50 DEPOSIT ABSOLUTE /end AXIS_DESCR
 /begin AXIS_DESCR STD_AXIS ASMod_qBrn_mp InjMass 10 0.00 150.0000 EXTENDED_LIMITS -327.6800 327.6700 DEPOSIT ABSOLUTE /end AXIS_DESCR
/end CHARACTERISTIC
/begin CHARACTERISTIC ASMod_tEGEngTempCor_CUR "Korrektur der Temperaturerhöhung aufgrund der Motortemperatur" CURVE 0x8002EB40 Cur_Xs16Ws16 200.0000 TempDiff_Kelv -100.0000 100.0000 EXTENDED_LIMITS -3276.800 3276.700
 /begin AXIS_DESCR STD_AXIS ASMod_tDiffEngRef_mp TempDiff_Kelv 8 -80.00000 120.0000 EXTENDED_LIMITS -3276.800 3276.700 DEPOSIT ABSOLUTE /end AXIS_DESCR
/end CHARACTERISTIC
/begin CHARACTERISTIC ASMod_tEGPoI1Cor_CUR "" CURVE 0x8002EB62 Cur_Xs16Ws16 200.0000 TempDiff_Kelv -100.0000 100.0000 EXTENDED_LIMITS -3276.800 3276.700
 /begin AXIS_DESCR STD_AXIS ASMod_qDiffPoI1Ref InjMass 10 0.00 327.6700 EXTENDED_LIMITS -327.6800 327.6700 DEPOSIT ABSOLUTE /end AXIS_DESCR
/end CHARACTERISTIC
/begin CHARACTERISTIC ASMod_tEGPoI2Cor_CUR "" CURVE 0x8002EB8C Cur_Xs16Ws16 200.0000 TempDiff_Kelv -100.0000 100.0000 EXTENDED_LIMITS -3276.800 3276.700
 /begin AXIS_DESCR STD_AXIS ASMod_qDiffPoI2Ref InjMass 10 0.00 327.6700 EXTENDED_LIMITS -327.6800 327.6700 DEPOSIT ABSOLUTE /end AXIS_DESCR
/end CHARACTERISTIC
/begin CHARACTERISTIC ASMod_tEGRDsMin_C "untere Begrenzung der Temperatur des rückgeführten Abgases nach ARF-Kühler" VALUE 0x8002DA66 Val_Ws16 350.0000 Temp_Cels -50.04000 299.9600 EXTENDED_LIMITS -3549.940 3003.560 /end CHARACTERISTIC
/begin CHARACTERISTIC ASMod_tEGRLPDsMin_C "Kalibrierparameter für die Temperatur des rückgeführten Abgases" VALUE 0x8002DBF8 Val_Wr32 350.000000 TempC_float -50.0000000 300.000000 FORMAT "%10.6" EXTENDED_LIMITS -1.00000000E+037 1.00000000E+037 /end CHARACTERISTIC
/begin CHARACTERISTIC ASMod_TempCmprI.Ki_C "/" VALUE 0x8002D8F0 Kw_Ws32 2.99885869026 Ki_Kelv_Sec 1.00117176771 4.00003045797 FORMAT "%13.11" EXTENDED_LIMITS -10000000.0000 9999999.99534 /end CHARACTERISTIC
/begin CHARACTERISTIC ASMod_TempCmprI.KiPos_C "/" VALUE 0x8002D8F4 Kw_Ws32 2.99885869026 Ki_Kelv_Sec 1.00117176771 4.00003045797 FORMAT "%13.11" EXTENDED_LIMITS -10000000.0000 9999999.99534 /end CHARACTERISTIC
/begin CHARACTERISTIC ASMod_TempCmprI.KiNeg_C "/" VALUE 0x8002D8F8 Kw_Ws32 2.99885869026 Ki_Kelv_Sec 1.00117176771 4.00003045797 FORMAT "%13.11" EXTENDED_LIMITS -10000000.0000 9999999.99534 /end CHARACTERISTIC
/begin CHARACTERISTIC ASMod_TempCmprI.WinPos_C "/" VALUE 0x8002D8FC Kw_Ws32 65535.0000000 Temp_Kelv_Sec -32768.0000000 32767.0000000 FORMAT "%13.7" EXTENDED_LIMITS -21474836.4800 21474836.4700 /end CHARACTERISTIC
/begin CHARACTERISTIC ASMod_TempCmprI.WinNeg_C "/" VALUE 0x8002D900 Kw_Ws32 65535.0000000 Temp_Kelv_Sec -32768.0000000 32767.0000000 FORMAT "%13.7" EXTENDED_LIMITS -21474836.4800 21474836.4700 /end CHARACTERISTIC
/begin CHARACTERISTIC ASMod_TempEGRLPDsPT1.tiUp_C "PT1-Glied für die Temperatur nach dem ND-ARF-Ventil/" VALUE 0x8002DBFC Kw_Wr32 1.00000000 Time_s_float 0.00 1.00000000 FORMAT "%10.8" EXTENDED_LIMITS -1.00000000E+037 1.00000000E+037 /end CHARACTERISTIC
/begin CHARACTERISTIC ASMod_TempEGRLPDsPT1.tiDwn_C "PT1-Glied für die Temperatur nach dem ND-ARF-Ventil/" VALUE 0x8002DC00 Kw_Wr32 1.00000000 Time_s_float 0.00 1.00000000 FORMAT "%10.8" EXTENDED_LIMITS -1.00000000E+037 1.00000000E+037 /end CHARACTERISTIC
/begin CHARACTERISTIC ASMod_tEngRef_C "Referenz der Motoretemperatur" VALUE 0x8002EBB6 Val_Ws16 200.0000 Temp_Cels -50.04000 149.9600 EXTENDED_LIMITS -3549.940 3003.560 /end CHARACTERISTIC
/begin CHARACTERISTIC ASMod_tiCmprEnvPT1_C "" VALUE 0x8002D904 Val_Ws16 4293.9673036 TimeDelay_s 0.99999238556 4294.9672960 FORMAT "%12.7" EXTENDED_LIMITS 0.13107600012 4294.9672960 /end CHARACTERISTIC
/begin CHARACTERISTIC ASMod_tiLamRecStatPT1_C "Zeitkonstante zur Ermittlung des gefilterten Lambda-Referenzsignals" VALUE 0x8002EBB8 Val_Ws32 10.010578778 TimeDelay_s 0.0010000000689 10.011578779 FORMAT "%12.9" EXTENDED_LIMITS 0.000002000000001 4294.9672960 /end CHARACTERISTIC
/begin CHARACTERISTIC ASMod_tInit_C "Temperatur zur Temperatur-Initialisierung" VALUE 0x8002D9CA Val_Ws16 130.0000 Temp_Cels -40.04000 89.96000 EXTENDED_LIMITS -3549.940 3003.560 /end CHARACTERISTIC
/begin CHARACTERISTIC ASMod_tiPT1pIntMnf_CUR "" CURVE 0x8002DA68 Cur_Xs16Ws16 3999.756 TimeDelay_ms_Lin_16 0.00 3999.756 FORMAT "%8.3" EXTENDED_LIMITS -20000.61 20000.00
 /begin AXIS_DESCR STD_AXIS ASMod_pCmprDiff_mp Pres_hPa 4 -32768.00 3500.00 EXTENDED_LIMITS -32768.00 32767.00 DEPOSIT ABSOLUTE /end AXIS_DESCR
/end CHARACTERISTIC
/begin CHARACTERISTIC ASMod_tiRelPosECBLPPT1_C "Zeitkonstante der PT1-Filterung bei Positionsänderung des niederdruckseitigen ARF-Kühler-Bypass-Stellers" VALUE 0x8002D9CC Val_Ws32 0.98999239186 TimeDelay_s 0.0099999937043 0.99999238556 FORMAT "%12.10" EXTENDED_LIMITS 0.000002000000001 4294.9672960 /end CHARACTERISTIC
/begin CHARACTERISTIC ASMod_tiRelPosECBPT1_C "Zeitkonstante der PT1-Filterung bei Positionsänderung des Stellers für den ARF-Kühler-Bypass" VALUE 0x8002D9D0 Val_Ws32 0.99999038556 TimeDelay_s 0.000002000000000 0.99999238556 FORMAT "%12.10" EXTENDED_LIMITS 0.000002000000001 4294.9672960 /end CHARACTERISTIC
/begin CHARACTERISTIC ASMod_tiRelPosEGRLPPT1_C "Zeitkonstante der PT1-Filterung bei Positionsänderung des niederdruckseitigen ARF-Stellers" VALUE 0x8002D9D4 Val_Ws32 0.98999239186 TimeDelay_s 0.0099999937043 0.99999238556 FORMAT "%12.10" EXTENDED_LIMITS 0.000002000000001 4294.9672960 /end CHARACTERISTIC
/begin CHARACTERISTIC ASMod_tiRelPosExhFlpLPPT1_C "Zeitkonstante der PT1-Filterung bei Positionsänderung der niederdruckseitigen Abgasklappe" VALUE 0x8002D9D8 Val_Ws32 0.98999239186 TimeDelay_s 0.0099999937043 0.99999238556 FORMAT "%12.10" EXTENDED_LIMITS 0.000002000000001 4294.9672960 /end CHARACTERISTIC
/begin CHARACTERISTIC ASMod_tiRelPosTVAPT1_C "Zeitkonstante der PT1-Filterung bei Positionsänderung des Drosselklappestellers" VALUE 0x8002D9DC Val_Ws32 0.99999038556 TimeDelay_s 0.000002000000000 0.99999238556 FORMAT "%12.10" EXTENDED_LIMITS 0.000002000000001 4294.9672960 /end CHARACTERISTIC
/begin CHARACTERISTIC ASMod_tiRelPosVSAPT1_C "Zeitkonstante der PT1-Filterung bei Positionsänderung des Drallklappenstellers" VALUE 0x8002D9E0 Val_Ws32 0.99999038556 TimeDelay_s 0.000002000000000 0.99999238556 FORMAT "%12.10" EXTENDED_LIMITS 0.000002000000001 4294.9672960 /end CHARACTERISTIC
/begin CHARACTERISTIC ASMod_tiT1DT1LamSot_C "Zeitkonstante zur Ermittlung der Ableitung des reziproken Lambda-Signals" VALUE 0x8002EBBC Val_Ws32 10.010578778 TimeDelay_s 0.0010000000689 10.011578779 FORMAT "%12.9" EXTENDED_LIMITS 0.000002000000001 4294.9672960 /end CHARACTERISTIC
/begin CHARACTERISTIC ASMod_tiTempEGRDsPT1_C "Zeitkonstante zur Tiefpassfilterung der Temperatur nach ARF-Kühler" VALUE 0x8002DA7C Val_Ws32 0.99999038556 TimeDelay_s 0.000002000000000 0.99999238556 FORMAT "%12.10" EXTENDED_LIMITS 0.000002000000001 4294.9672960 /end CHARACTERISTIC
/begin CHARACTERISTIC ASMod_volExhMnfLP_C "Volumen des niedrigen Abgaskrümmer" VALUE 0x8002EC30 Val_Wr32 50.0000000 Vol_float 0.00 50.0000000 FORMAT "%10.7" EXTENDED_LIMITS -1.00000000E+037 1.00000000E+037 /end CHARACTERISTIC
/begin CHARACTERISTIC ECBVlvLP_r_C "" VALUE 0x8002CF32 Val_Ws16 799.9878 Prc -400.0000 399.9878 /end CHARACTERISTIC
/begin CHARACTERISTIC ECBVlv_rB1_C "" VALUE 0x8002CF34 Val_Ws16 799.9878 Prc -400.0000 399.9878 /end CHARACTERISTIC
/begin CHARACTERISTIC ECBVlv_rB2_C "" VALUE 0x8002CF36 Val_Ws16 799.9878 Prc -400.0000 399.9878 /end CHARACTERISTIC
/begin CHARACTERISTIC EGRVlvLP_rAct_C "" VALUE 0x8002CF38 Val_Ws16 799.9878 Prc -400.0000 399.9878 /end CHARACTERISTIC
/begin CHARACTERISTIC EGRVlv_rActB1_C "Vorgabewert für die Botschaft EGRVlv_rActB1" VALUE 0x8002CF3A Val_Ws16 799.9878 Prc -400.0000 399.9878 /end CHARACTERISTIC
/begin CHARACTERISTIC EGRVlv_rActB2_C "Vorgabewert für die Botschaft EGRVlv_rActB2" VALUE 0x8002CF3C Val_Ws16 799.9878 Prc -400.0000 399.9878 /end CHARACTERISTIC
/begin CHARACTERISTIC ETCtl_dmHC_C "Applikationsparameter zum ändern von der Message ETCtl_dmHC" VALUE 0x8002CF3E Val_Ws16 655.3500 InjMassPerTime -327.6800 327.6700 FORMAT "%8.4" /end CHARACTERISTIC
/begin CHARACTERISTIC Exh_pAdapPPFltDiffB1_C "Vorgabewert für die Botschaft Exh_pAdapPPFltDiffB1" VALUE 0x8002CF40 Val_Ws16 36268.00 Pres_hPa -32768.00 3500.00 EXTENDED_LIMITS -32768.00 32767.00 /end CHARACTERISTIC
/begin CHARACTERISTIC Exh_pAdapPPFltDiffB2_C "Vorgabewert für die Botschaft Exh_pAdapPPFltDiffB2" VALUE 0x8002CF42 Val_Ws16 36268.00 Pres_hPa -32768.00 3500.00 EXTENDED_LIMITS -32768.00 32767.00 /end CHARACTERISTIC
/begin CHARACTERISTIC Exh_pPFltUsB1_C "Vorgabewert für die Botschaft Exh_pPFltUsB1" VALUE 0x8002CF44 Val_Ws16 36268.00 Pres_hPa -32768.00 3500.00 EXTENDED_LIMITS -32768.00 32767.00 /end CHARACTERISTIC
/begin CHARACTERISTIC Exh_pPFltUsB2_C "Vorgabewert für die Botschaft Exh_pPFltUsB2" VALUE 0x8002CF46 Val_Ws16 36268.00 Pres_hPa -32768.00 3500.00 EXTENDED_LIMITS -32768.00 32767.00 /end CHARACTERISTIC
/begin CHARACTERISTIC Exh_tPFltUsB1_C "Vorgabewert für die Botschaft Exh_tPFltUsB1" VALUE 0x8002CF48 Val_Ws16 6553.500 Temp_Cels -3549.940 3003.560 /end CHARACTERISTIC
/begin CHARACTERISTIC Exh_tPFltUsB2_C "Vorgabewert für die Botschaft Exh_tPFltUsB2" VALUE 0x8002CF4A Val_Ws16 6553.500 Temp_Cels -3549.940 3003.560 /end CHARACTERISTIC
/begin CHARACTERISTIC HCUn_dqDem_C "Applikationswert HC Gesamtmenge" VALUE 0x8002CF4C Kw_Ws16 6553.500 HCMassPerTime -3276.800 3276.700 FORMAT "%8.3" /end CHARACTERISTIC
/begin CHARACTERISTIC InjCrv_phiMI1DesB1_C "gewünschter Bezugswinkel für den Beginn der MI1 für Bank 1" VALUE 0x8002CF50 Val_Ws16 1439.978 AngleCrS -720.0000 719.9780 /end CHARACTERISTIC
/begin CHARACTERISTIC InjCrv_phiMI1DesB2_C "gewünschter Bezugswinkel für den Beginn der MI1 für Bank 2" VALUE 0x8002CF52 Val_Ws16 1439.978 AngleCrS -720.0000 719.9780 /end CHARACTERISTIC
/begin CHARACTERISTIC NSC_stRMB1_C "" VALUE 0x8002CF54 Val_Wu8 255.0 OneToOne 0.00 255.0 /end CHARACTERISTIC
/begin CHARACTERISTIC NSC_stRMB2_C "" VALUE 0x8002CF55 Val_Wu8 255.0 OneToOne 0.00 255.0 /end CHARACTERISTIC
/begin CHARACTERISTIC NSC_stRM_C "" VALUE 0x8002CF56 Val_Wu8 255.0 OneToOne 0.00 255.0 /end CHARACTERISTIC
/begin CHARACTERISTIC ThrVlv_rActB1_C "Vorgabewert für die Botschaft ThrVlv_rActB1" VALUE 0x8002CF58 Val_Ws16 655.3500 DtyCyc -327.6800 327.6700 /end CHARACTERISTIC
/begin CHARACTERISTIC ThrVlv_rActB2_C "Vorgabewert für die Botschaft ThrVlv_rActB2" VALUE 0x8002CF5A Val_Ws16 655.3500 DtyCyc -327.6800 327.6700 /end CHARACTERISTIC
/begin CHARACTERISTIC TrbCh_rActB1_C "Vorgabewert für die Botschaft TrbCh_rActB1" VALUE 0x8002CF5C Val_Ws16 799.9878 Prc -400.0000 399.9878 /end CHARACTERISTIC
/begin CHARACTERISTIC TrbCh_rActB2_C "Vorgabewert für die Botschaft TrbCh_rActB2" VALUE 0x8002CF5E Val_Ws16 799.9878 Prc -400.0000 399.9878 /end CHARACTERISTIC
/begin CHARACTERISTIC VSwVlv_rB1_C "" VALUE 0x8002CF60 Val_Ws16 799.9878 Prc -400.0000 399.9878 /end CHARACTERISTIC
/begin CHARACTERISTIC VSwVlv_rB2_C "" VALUE 0x8002CF62 Val_Ws16 799.9878 Prc -400.0000 399.9878 /end CHARACTERISTIC
/begin MEASUREMENT AFS_dmB1 "Ansaugluftmasse pro Zeit für Bank1[kg/ h]" SWORD AirMassPerTime 1 100 -3276.800 3276.700 ECU_ADDRESS 0xD0000402 /end MEASUREMENT
/begin MEASUREMENT AFS_dmB2 "Ansaugluftmasse pro Zeit für Bank2[kg/ h]" SWORD AirMassPerTime 1 100 -3276.800 3276.700 ECU_ADDRESS 0xD0000404 /end MEASUREMENT
/begin MEASUREMENT AFS_mAirPerCylB1 "Luftmasse pro Zylinder auf Bank1" SWORD AirMassPerCyl 1 100 -3276.800 3276.700 ECU_ADDRESS 0xD0000412 /end MEASUREMENT
/begin MEASUREMENT AFS_mAirPerCylB2 "Luftmasse pro Zylinder auf bank2" SWORD AirMassPerCyl 1 100 -3276.800 3276.700 ECU_ADDRESS 0xD0000414 /end MEASUREMENT
/begin MEASUREMENT Air_tCACDsB1 "" SWORD Temp_Cels 1 100 -3549.940 3003.560 ECU_ADDRESS 0xD0000642 /end MEASUREMENT
/begin MEASUREMENT Air_tCACDsB2 "" SWORD Temp_Cels 1 100 -3549.940 3003.560 ECU_ADDRESS 0xD0000644 /end MEASUREMENT
/begin MEASUREMENT APP_drFlt "Differentialquotient des gefilterten APP-Verhältnisses" SWORD PrcPerSec_10ms 1 100 -40000.00 39998.78 FORMAT "%8.2" ECU_ADDRESS 0xD0000424 /end MEASUREMENT
/begin MEASUREMENT APP_drUnFlt "Gaspedal Neigungsposition für ungefilterten Wert" SWORD PrcPerSec_10ms 1 100 -40000.00 39998.78 FORMAT "%8.2" ECU_ADDRESS 0xD0000426 /end MEASUREMENT
/begin MEASUREMENT APP_r "Gaspedal Position" SWORD Prc 1 100 -400.0000 399.9878 ECU_ADDRESS 0xD0000428 /end MEASUREMENT
/begin MEASUREMENT APP_rFltUnLim_mp "Gefilterter Wert von APP ohne Step limitation" SWORD Prc 1 100 -400.0000 399.9878 ECU_ADDRESS 0xC00098D8 /end MEASUREMENT
/begin MEASUREMENT APP_rFlt_mp "Gefilterter Fahrpedalwert" SWORD Prc 1 100 -400.0000 399.9878 ECU_ADDRESS 0xC00098DA /end MEASUREMENT
/begin MEASUREMENT APP_rNextThres_mp "Berechneter Wert des nächsten Schwellwertes" SWORD Prc 1 100 -400.0000 399.9878 ECU_ADDRESS 0xC00098DC /end MEASUREMENT
/begin MEASUREMENT APP_rStepLim_mp "" SWORD Prc 1 100 -400.0000 399.9878 ECU_ADDRESS 0xC00098DE /end MEASUREMENT
/begin MEASUREMENT APP_rUnFlt "Gaspedal Position (ungefiltert)" SWORD Prc 1 100 -400.0000 399.9878 ECU_ADDRESS 0xD000042A /end MEASUREMENT
/begin MEASUREMENT APP_stKD "Status Kickdown" UBYTE OneToOne 1 100 0.00 255.0 ECU_ADDRESS 0xD00025C5 /end MEASUREMENT
/begin MEASUREMENT APP_stPlaBrk "" UBYTE OneToOne 1 100 0.00 255.0 ECU_ADDRESS 0xD00025C6 /end MEASUREMENT
/begin MEASUREMENT APP_stPlaBrkPres "Status, ob die Bremsdruckglaubwürdigkeit aktiv ist" UBYTE OneToOne 1 100 0.00 255.0 ECU_ADDRESS 0xD00025C7 /end MEASUREMENT
/begin MEASUREMENT APP_stPlaBrkTrq "" UBYTE OneToOne 1 100 0.00 255.0 ECU_ADDRESS 0xD00025C8 /end MEASUREMENT
/begin MEASUREMENT APP_stPos_mp "Status der PWG Position" UBYTE OneToOne 1 100 0.00 255.0 ECU_ADDRESS 0xC000B096 /end MEASUREMENT
/begin MEASUREMENT APP_stSigSrc "Status des Führungssignals zur weiteren Berechnung des Fahrerwunsches" UBYTE OneToOne 1 100 0.00 255.0 ECU_ADDRESS 0xD0001BE9 /end MEASUREMENT
/begin MEASUREMENT APP_stTempErr_mp "Status für vorläufige Fehler" UBYTE OneToOne 1 100 0.00 255.0 ECU_ADDRESS 0xC000B095 /end MEASUREMENT
/begin MEASUREMENT APP_uRaw1 "Rohwert von Fahrpedal-Sensor 1" SWORD Volt 1 100 -6553.600 6553.400 ECU_ADDRESS 0xD000042C /end MEASUREMENT
/begin MEASUREMENT APP_uRaw1unLim_mp "Fahrpedalrohwert Sensor 1 ohne Begrenzungen" SWORD Volt 1 100 -6553.600 6553.400 ECU_ADDRESS 0xC00098E0 /end MEASUREMENT
/begin MEASUREMENT APP_uRaw2 "Rohwert von Fahrpedal-Sensor 2" SWORD Volt 1 100 -6553.600 6553.400 ECU_ADDRESS 0xD000042E /end MEASUREMENT
/begin MEASUREMENT APP_uRaw2unLim_mp "Fahrpedalrohwert Sensor 2 ohne Begrenzungen" SWORD Volt 1 100 -6553.600 6553.400 ECU_ADDRESS 0xC00098E2 /end MEASUREMENT
/begin MEASUREMENT APP_uRaw_mp "Rohwert der Fahrpedalposition" SWORD Volt 1 100 -6553.600 6553.400 ECU_ADDRESS 0xC00098E4 /end MEASUREMENT
/begin MEASUREMENT APP_uUnJit_mp "Entjitterter Fahrpedalwert" SWORD Volt 1 100 -6553.600 6553.400 ECU_ADDRESS 0xC00098E6 /end MEASUREMENT
/begin MEASUREMENT ASDdc_KdGovCurr_mp "Aktueller Parameter Kd des ASD Störungsreglers" FLOAT32_IEEE ASDdc_GovDT1Kd_float 1 100 0.00 100.000000 FORMAT "%10.6" ECU_ADDRESS 0xC0008C68 /end MEASUREMENT
/begin MEASUREMENT ASDdc_nEngParSel_mp "Motordrehzahl für die Parametersatzauswahl beim ASD Störungsregler" SWORD EngN 1 100 -16384.00 16383.50 ECU_ADDRESS 0xC00098E8 /end MEASUREMENT
/begin MEASUREMENT ASDdc_rTraParSel_mp "Betrag der Getriebeübersetzung für Parameterauswahl" SWORD TransR 1 100 -327.6800 327.6700 ECU_ADDRESS 0xC00098EA /end MEASUREMENT
/begin MEASUREMENT ASDdc_stClthGrip_mp "Kraftschlussparametersatz aktiv/inaktiv (aktiv = TRUE)" UBYTE OneToOne 1 100 0.00 255.0 ECU_ADDRESS 0xC000B098 /end MEASUREMENT
/begin MEASUREMENT ASDdc_stCon_mp "Zustand der Eingangsbedingungen (bitkodiert)" UWORD OneToOne 1 100 0.00 65535.00 ECU_ADDRESS 0xC00098EC /end MEASUREMENT
/begin MEASUREMENT ASDdc_stPrioSt_mp "Aktiver Zustand nach der Priorisierung (dezimal kodiert)" UWORD OneToOne 1 100 0.00 65535.00 ECU_ADDRESS 0xC00098EE /end MEASUREMENT
/begin MEASUREMENT ASDdc_stReIni_mp "Deaktivierung (Initialisierung) des Störungsreglers (inaktiv = TRUE)" UBYTE OneToOne 1 100 0.00 255.0 ECU_ADDRESS 0xC000B097 /end MEASUREMENT
/begin MEASUREMENT ASDdc_stSelSt_mp "Ausgewählter Primärzustand (dezimal kodiert)" UWORD OneToOne 1 100 0.00 65535.00 ECU_ADDRESS 0xC00098F0 /end MEASUREMENT
/begin MEASUREMENT ASDdc_stVldSt_mp "Auswertung der Primärzustände; konkurrierende Zustände möglich (bitkodiert)" UWORD OneToOne 1 100 0.00 65535.00 ECU_ADDRESS 0xC00098F2 /end MEASUREMENT
/begin MEASUREMENT ASDdc_T1GovCurr_mp "Aktueller Parameter T1 des ASD Störungsreglers" FLOAT32_IEEE ASDdc_GovDT1T1_float 1 100 0.00 100.000000 FORMAT "%10.6" ECU_ADDRESS 0xC0008C6C /end MEASUREMENT
/begin MEASUREMENT ASDdc_trq "ASD Störungsregler Ausgangsmoment" SWORD Trq 1 100 -3276.800 3276.700 ECU_ADDRESS 0xD0000432 /end MEASUREMENT
/begin MEASUREMENT ASDdc_trqUnLtd_mp "ASD Störungsregler Momentforderung vor der Limitierung" FLOAT32_IEEE Trq_float 1 100 -50.0000000 50.0000000 ECU_ADDRESS 0xC0008C70 /end MEASUREMENT
/begin MEASUREMENT ASDrf_CoefALADCurr_mp "Aktueller Kennwert für den Koeffizienten zweiter Ordnung des LAD Steigungsbegrenzung" FLOAT32_IEEE ASDrf_LADCoefA_float 1 100 0.00 200.000000 FORMAT "%10.6" ECU_ADDRESS 0xC0008C74 /end MEASUREMENT
/begin MEASUREMENT ASDrf_CoefBLADCurr_mp "Aktueller Kennwert für den Koeffizienten nullter Ordnung des LAD Steigungsbegrenzung" FLOAT32_IEEE ASDrf_dTrq_float 1 100 -3276.80000 3276.70000 FORMAT "%10.5" ECU_ADDRESS 0xC0008C78 /end MEASUREMENT
/begin MEASUREMENT ASDrf_dtrqDeComp_mp "Drehmomentsteigung der Schleppfehlerkorrektur" FLOAT32_IEEE ASDrf_dTrq_float 1 100 -2000.00000 2000.00000 FORMAT "%10.5" ECU_ADDRESS 0xC0008C7C /end MEASUREMENT
/begin MEASUREMENT ASDrf_dtrqMax_mp "Max. Momentensteigung in der Umgebung des Verlustmoments oder durch die Begrenzung bei Momentabsenkung" FLOAT32_IEEE ASDrf_dTrq_float 1 100 -2000.00000 2000.00000 FORMAT "%10.5" ECU_ADDRESS 0xC0008C80 /end MEASUREMENT
/begin MEASUREMENT ASDrf_dtrqMin_mp "Min. Momentensteigung in der Umgebung des Verlustmoments oder durch die Begrenzung bei Momentabsenkung" FLOAT32_IEEE ASDrf_dTrq_float 1 100 -2000.00000 2000.00000 FORMAT "%10.5" ECU_ADDRESS 0xC0008C84 /end MEASUREMENT
/begin MEASUREMENT ASDrf_facDesDynFlt_mp "Gefilterter Fahrerwunsch zur Parametersatzauswahl" SWORD Fact 1 100 -4.000000 3.999878 ECU_ADDRESS 0xC00098FC /end MEASUREMENT
/begin MEASUREMENT ASDrf_facLAD2EngNNeg "Korrekturfaktor für Motordrehzahl für negative Eingangsgradienten" SWORD Fact1 1 100 -256.0000 255.9922 ECU_ADDRESS 0xD0000434 /end MEASUREMENT
/begin MEASUREMENT ASDrf_facLAD2EngNPos "Korrekturfaktor für Motordrehzahl für positive Eingangsgradienten" SWORD Fact1 1 100 -256.0000 255.9922 ECU_ADDRESS 0xD0000436 /end MEASUREMENT
/begin MEASUREMENT ASDrf_facLAD2EngN_mp "Aktueller Korrekturfaktor für Motordrehzahl (LAD Betriebsmodus 2)" SWORD Fact1 1 100 -256.0000 255.9922 ECU_ADDRESS 0xC00098F4 /end MEASUREMENT
/begin MEASUREMENT ASDrf_KdFltCurr_mp "Aktueller Parameter Kd des ASD Führungsformers" FLOAT32_IEEE ASDrf_FltDT1Kd_float 1 100 0.00 5.00000000 FORMAT "%10.8" ECU_ADDRESS 0xC0008C88 /end MEASUREMENT
/begin MEASUREMENT ASDrf_nEngCor_mp "Korrigierte Motordrehzahl (LAD Betriebsmodus 2)" SWORD EngN 1 100 -16384.00 16383.50 ECU_ADDRESS 0xC00098F6 /end MEASUREMENT
/begin MEASUREMENT ASDrf_nLAD2SetPNeg "Drehzahlsollwert für Lastschlagdämpfer für negative Eingangsgradienten" SWORD EngN 1 100 -16384.00 16383.50 ECU_ADDRESS 0xD0000438 /end MEASUREMENT
/begin MEASUREMENT ASDrf_nLAD2SetPPos "Drehzahlsollwert für Lastschlagdämpfer für positive Eingangsgradienten" SWORD EngN 1 100 -16384.00 16383.50 ECU_ADDRESS 0xD000043A /end MEASUREMENT
/begin MEASUREMENT ASDrf_phiLAD2I_mp "Winkel zwischen Eingang und Ausgang des Drehmomentwandler" SWORD ASDrf_Angle 1 100 -3276.800 3276.700 FORMAT "%8.3" ECU_ADDRESS 0xC00098F8 /end MEASUREMENT
/begin MEASUREMENT ASDrf_rTraParSel_mp "Betrag der Getriebeübersetzung für Parameterauswahl" SWORD TransR 1 100 -327.6800 327.6700 ECU_ADDRESS 0xC00098FE /end MEASUREMENT
/begin MEASUREMENT ASDrf_stCoefBNegHi_mp "Ausgang der Hysterese zur Erkennung von großen B Koeffizienten bei negativen Eingangsgradienten" UBYTE OneToOne 1 100 0.00 255.0 ECU_ADDRESS 0xC000B099 /end MEASUREMENT
/begin MEASUREMENT ASDrf_stCoefBNoLimNeg_mp "Negative Steigungsbegrenzung deaktiviert aufgrund großem Koeffizient B" UBYTE OneToOne 1 100 0.00 255.0 ECU_ADDRESS 0xC000B09A /end MEASUREMENT
/begin MEASUREMENT ASDrf_stCoefBNoLimPos_mp "Positive Steigungsbegrenzung deaktiviert aufgrund großem Koeffizient B" UBYTE OneToOne 1 100 0.00 255.0 ECU_ADDRESS 0xC000B09B /end MEASUREMENT
/begin MEASUREMENT ASDrf_stCoefBPosHi_mp "Ausgang der Hysterese zur Erkennung von großen B Koeffizienten bei positiven Eingangsgradienten" UBYTE OneToOne 1 100 0.00 255.0 ECU_ADDRESS 0xC000B09C /end MEASUREMENT
/begin MEASUREMENT ASDrf_stCon_mp "Zustand der Eingangsbedingungen (bitkodiert)" UWORD OneToOne 1 100 0.00 65535.00 ECU_ADDRESS 0xC0009900 /end MEASUREMENT
/begin MEASUREMENT ASDrf_stIni "Initialisierungsanforderungen / Quittierungen an PT1, PDT1-Glieder" UBYTE OneToOne 1 100 0.00 255.0 ECU_ADDRESS 0xC000B09F /end MEASUREMENT
/begin MEASUREMENT ASDrf_stIniSteepIn_mp "Indikator für Initialisierung aufgrund großer Eingangsgradienten" UBYTE OneToOne 1 100 0.00 255.0 ECU_ADDRESS 0xC000B09D /end MEASUREMENT
/begin MEASUREMENT ASDrf_stLAD "Zustandsvariable für den Automaten zur LAD Steuerung." UBYTE OneToOne 1 100 0.00 255.0 ECU_ADDRESS 0xD0001BEA /end MEASUREMENT
/begin MEASUREMENT ASDrf_stLADMode "Aktueller Betriebsmodus des Lastschlagdämpfers" UBYTE ASDrf_LADMode 1 100 0.00 2.00000000000 FORMAT "%13.11" ECU_ADDRESS 0xD0001BEB /end MEASUREMENT
/begin MEASUREMENT ASDrf_stPosNeg "pos/neg Mengentendenz" UBYTE OneToOne 1 100 0.00 255.0 ECU_ADDRESS 0xD0001BEC /end MEASUREMENT
/begin MEASUREMENT ASDrf_stPrioSt_mp "Aktiver Zustand nach der Priorisierung (dezimal kodiert)" UWORD OneToOne 1 100 0.00 65535.00 ECU_ADDRESS 0xC0009902 /end MEASUREMENT
/begin MEASUREMENT ASDrf_stSelSt_mp "Ausgewählter Primärzustand (dezimal kodiert)" UWORD OneToOne 1 100 0.00 65535.00 ECU_ADDRESS 0xC0009904 /end MEASUREMENT
/begin MEASUREMENT ASDrf_stTrqLim_mp "Zustand der Moment Gradientenbegrenzung (0 = inaktiv, 1 = aktiv)" UBYTE OneToOne 1 100 0.00 255.0 ECU_ADDRESS 0xC000B09E /end MEASUREMENT
/begin MEASUREMENT ASDrf_stVldSt_mp "Auswertung der Primärzustände; konkurrierende Zustände möglich (bitkodiert)" UWORD OneToOne 1 100 0.00 65535.00 ECU_ADDRESS 0xC0009906 /end MEASUREMENT
/begin MEASUREMENT ASDrf_T1FltCurr_mp "Aktueller Parameter T1 des ASD Führungsformers" FLOAT32_IEEE ASDrf_FltDT1T1_float 1 100 0.00 2.00000000 FORMAT "%10.8" ECU_ADDRESS 0xC0008C8C /end MEASUREMENT
/begin MEASUREMENT ASDrf_tEngLos_mp "Motortemperatur zur Bestimmung des Verlustmoments" SWORD Temp_Cels 1 100 -3549.940 3003.560 ECU_ADDRESS 0xC0009908 /end MEASUREMENT
/begin MEASUREMENT ASDrf_trqASDSumK1_mp "Letztes ASD Moment (Berechnung abhängig von ASDrf_swtCalcTrq_C)" FLOAT32_IEEE Trq_float 1 100 -500.000000 1000.00000 ECU_ADDRESS 0xC0008C90 /end MEASUREMENT
/begin MEASUREMENT ASDrf_trqASDSum_mp "Aktuelles ASD Moment (Berechnung abhängig von ASDrf_swtCalcTrq_C)" FLOAT32_IEEE Trq_float 1 100 -500.000000 1000.00000 ECU_ADDRESS 0xC0008C94 /end MEASUREMENT
/begin MEASUREMENT ASDrf_trqDeCompCor_mp "Korrektur der Schleppfehlerkompensation durch die Kompensation des Drehzahlreglers" FLOAT32_IEEE Trq_float 1 100 -500.000000 1000.00000 ECU_ADDRESS 0xC0008C98 /end MEASUREMENT
/begin MEASUREMENT ASDrf_trqDeCompOfs_mp "Offset für Schleppfehlerkompensation" FLOAT32_IEEE Trq_float 1 100 -500.000000 1000.00000 ECU_ADDRESS 0xC0008C9C /end MEASUREMENT
/begin MEASUREMENT ASDrf_trqIni_mp "Berechneter Initialisierungswert für PT1 Zustandsvariable" FLOAT32_IEEE Trq_float 1 100 -500.000000 1000.00000 ECU_ADDRESS 0xC0008CA0 /end MEASUREMENT
/begin MEASUREMENT ASDrf_trqInrSet "ASD Führungsformer Ausgangsmoment" SWORD Trq 1 100 -3276.800 3276.700 ECU_ADDRESS 0xD000043C /end MEASUREMENT
/begin MEASUREMENT ASDrf_trqInrSetMaxUnLtd_mp "Aktuelle Obergrenze für ASDrf_trqInr vor der Begrenzung mit CoETS_trqInrLtd (abhängig von ASDrf_swtLim_C)" FLOAT32_IEEE Trq_float 1 100 -500.000000 1000.00000 ECU_ADDRESS 0xC0008CA4 /end MEASUREMENT
/begin MEASUREMENT ASDrf_trqInrSetMax_mp "Max. zulässiges Moment durch Steigungsbegrenzung" FLOAT32_IEEE Trq_float 1 100 -500.000000 1000.00000 ECU_ADDRESS 0xC0008CA8 /end MEASUREMENT
/begin MEASUREMENT ASDrf_trqInrSetMinUnLtd_mp "Aktuelle Untergrenze für ASDrf_trqInr vor der Begrenzung mit 0 (abhängig von ASDrf_swtLim_C)" FLOAT32_IEEE Trq_float 1 100 -500.000000 1000.00000 ECU_ADDRESS 0xC0008CAC /end MEASUREMENT
/begin MEASUREMENT ASDrf_trqInrSetMin_mp "Min. zulässiges Moment durch Steigungsbegrenzung" FLOAT32_IEEE Trq_float 1 100 -500.000000 1000.00000 ECU_ADDRESS 0xC0008CB0 /end MEASUREMENT
/begin MEASUREMENT ASDrf_trqInrSetUnLtd_mp "Ausgang des PDT1-Glieds, vor der Steigungsbegrenzung des ASD Führungsformers" FLOAT32_IEEE Trq_float 1 100 -500.000000 1000.00000 ECU_ADDRESS 0xC0008CB4 /end MEASUREMENT
/begin MEASUREMENT ASDrf_trqLAD2PGov_mp "Ausgangsmoment des P-Reglers für LAD im Betriebsmodus 2" SWORD Trq 1 100 -3276.800 3276.700 ECU_ADDRESS 0xC00098FA /end MEASUREMENT
/begin MEASUREMENT ASDrf_trqLosMap_mp "Verlustmomentanteil aus Kennfeld" SWORD Trq 1 100 -3276.800 3276.700 ECU_ADDRESS 0xC000990A /end MEASUREMENT
/begin MEASUREMENT ASDrf_trqLosNeg "Verlustmoment bei negativem Eingangsgradient von CoETS_trqInrLtd" FLOAT32_IEEE Trq_float 1 100 -500.000000 1000.00000 ECU_ADDRESS 0xD0002D08 /end MEASUREMENT
/begin MEASUREMENT ASDrf_trqLosPos "Verlustmoment bei positivem Eingangsgradient von CoETS_trqInrLtd" FLOAT32_IEEE Trq_float 1 100 -500.000000 1000.00000 ECU_ADDRESS 0xD0002D0C /end MEASUREMENT
/begin MEASUREMENT ASDrf_trqLos_mp "Aktuelles Verlustmoment inklusive Nebenaggregate" FLOAT32_IEEE Trq_float 1 100 -500.000000 1000.00000 ECU_ADDRESS 0xC0008CB8 /end MEASUREMENT
/begin MEASUREMENT ASDrf_trqOfsLosNeg_mp "Verlustmoment Offset für negative Eingangsgradienten" SWORD Trq 1 100 -3276.800 3276.700 ECU_ADDRESS 0xC000990C /end MEASUREMENT
/begin MEASUREMENT ASDrf_trqOfsLosPos_mp "Verlustmoment Offset für positive Eingangsgradienten" SWORD Trq 1 100 -3276.800 3276.700 ECU_ADDRESS 0xC000990E /end MEASUREMENT
/begin MEASUREMENT ASDrf_trqPT1In_mp "Aktueller PT1 Eingangswert" FLOAT32_IEEE Trq_float 1 100 -500.000000 1000.00000 ECU_ADDRESS 0xC0008CBC /end MEASUREMENT
/begin MEASUREMENT ASDrf_trqPT1Out_mp "Aktueller PT1 Ausgangswert" FLOAT32_IEEE Trq_float 1 100 -500.000000 1000.00000 ECU_ADDRESS 0xC0008CC0 /end MEASUREMENT
/begin MEASUREMENT ASDrf_trqPT1P_mp "Ausgang P-Anteil in PT1 gefiltertem Signal" FLOAT32_IEEE Trq_float 1 100 -500.000000 1000.00000 ECU_ADDRESS 0xC0008CC4 /end MEASUREMENT
/begin MEASUREMENT ASDrf_trqP_mp "Ausgang ASD Führungsformer P-Anteil" FLOAT32_IEEE Trq_float 1 100 -500.000000 1000.00000 ECU_ADDRESS 0xC0008CC8 /end MEASUREMENT
/begin MEASUREMENT ASDrf_trqSpdGovCor_mp "Aktueller Korrekturwert der Drehzahlreglerkompensation" FLOAT32_IEEE Trq_float 1 100 -500.000000 1000.00000 ECU_ADDRESS 0xC0008CCC /end MEASUREMENT
/begin MEASUREMENT ASMod_arEffEGRDes_mp "" FLOAT32_IEEE Area_cm2_float 1 100 0.00 720.000000 FORMAT "%10.6" ECU_ADDRESS 0xC0008D10 /end MEASUREMENT
/begin MEASUREMENT ASMod_arEffEGRDiff_mp "" FLOAT32_IEEE Area_cm2_float 1 100 0.00 720.000000 FORMAT "%10.6" ECU_ADDRESS 0xC0008D14 /end MEASUREMENT
/begin MEASUREMENT ASMod_arEffEGRLPCor "Korrigierte Effektive ND-AGR Querschnittsfläche" SWORD Area_cm2 1 100 -32.76800 32.76700 FORMAT "%8.5" ECU_ADDRESS 0xD000043E /end MEASUREMENT
/begin MEASUREMENT ASMod_arEffEGRLP_mp "Effektive ND-AGR Querschnittsfläche" FLOAT32_IEEE Area_cm2_float 1 100 0.00 50.0000000 FORMAT "%10.7" ECU_ADDRESS 0xC0008D1C /end MEASUREMENT
/begin MEASUREMENT ASMod_arEffEGRVlv_r32 "" FLOAT32_IEEE Area_cm2_float 1 100 0.00 32.0000000 FORMAT "%10.7" ECU_ADDRESS 0xD0002D10 /end MEASUREMENT
/begin MEASUREMENT ASMod_arEffExhFlpLP_mp "Effektive Querschnittsfläche der Niederdruck-Abgasklappe" FLOAT32_IEEE Area_cm2_float 1 100 0.00 32.0000000 FORMAT "%10.7" ECU_ADDRESS 0xC0008D68 /end MEASUREMENT
/begin MEASUREMENT ASMod_dmAFSCor "korrigierter Frischluftmassenstrom" SWORD AirMassPerTime 1 100 -3276.800 3276.700 ECU_ADDRESS 0xD0000440 /end MEASUREMENT
/begin MEASUREMENT ASMod_dmAFSSim "" SWORD AirMassPerTime 1 100 -3276.800 3276.700 ECU_ADDRESS 0xD0000442 /end MEASUREMENT
/begin MEASUREMENT ASMod_dmAshEG "Aschemassenstrom nach Verbrennung" SWORD AshEGMassPerTime 1 100 -16.38400 16.38350 FORMAT "%8.5" ECU_ADDRESS 0xD0000444 /end MEASUREMENT
/begin MEASUREMENT ASMod_dmCmprUsRed "Reduzierter Gasmassenstrom vor Verdichter" SWORD AirMassPerTime 1 100 -3276.800 3276.700 ECU_ADDRESS 0xD0000446 /end MEASUREMENT
/begin MEASUREMENT ASMod_dmCmprUsRed_mp "reduzierter Gasmassenstrom vor Verdichter" FLOAT32_IEEE AirMassPerTime_float 1 100 0.00 1400.00000 FORMAT "%10.5" ECU_ADDRESS 0xC0008CD0 /end MEASUREMENT
/begin MEASUREMENT ASMod_dmEGFld "Feld der Abgasmassenströme" SWORD AirMassPerTime 1 100 -3276.800 3276.700 ARRAY_SIZE 7 ECU_ADDRESS 0xD0000448 /end MEASUREMENT
/begin MEASUREMENT ASMod_dmEGMgScnd_mp "Abgasmassenstrom nach Verbrennung" SLONG AirMassPerTimeMgScnd 1 100 -214748364.800 214748364.700 FORMAT "%13.3" ECU_ADDRESS 0xC0008D44 /end MEASUREMENT
/begin MEASUREMENT ASMod_dmEGRAct "" SWORD AirMassPerTime 1 100 -3276.800 3276.700 ECU_ADDRESS 0xD0000456 /end MEASUREMENT
/begin MEASUREMENT ASMod_dmEGRDs "rückgeführter Abgasmassenstrom nach ARF-Kühler" SWORD AirMassPerTime 1 100 -3276.800 3276.700 ECU_ADDRESS 0xD0000458 /end MEASUREMENT
/begin MEASUREMENT ASMod_dmEGRLPDs "rückgeführter Abgasmassenstrom nach Niederdruck-AGR" SWORD AirMassPerTime 1 100 -3276.800 3276.700 ECU_ADDRESS 0xD000045A /end MEASUREMENT
/begin MEASUREMENT ASMod_dmEGRLPDsRaw_mp "Ungefilterter Abgasmassenstrom nach ND-AGR" FLOAT32_IEEE AirMassPerTime_float 1 100 -700.000000 700.000000 FORMAT "%10.6" ECU_ADDRESS 0xC0008D20 /end MEASUREMENT
/begin MEASUREMENT ASMod_dmEGRLPDs_r32 "Gefilterter Abgasmassenstrom nach ND-AGR" FLOAT32_IEEE AirMassPerTime_float 1 100 -700.000000 700.000000 FORMAT "%10.6" ECU_ADDRESS 0xD0002D18 /end MEASUREMENT
/begin MEASUREMENT ASMod_dmEGRSimRaw_mp "" FLOAT32_IEEE AirMassPerTime_float 1 100 -700.000000 700.000000 FORMAT "%10.6" ECU_ADDRESS 0xC0008D08 /end MEASUREMENT
/begin MEASUREMENT ASMod_dmEGRSim_mp "" SWORD AirMassPerTime 1 100 -3276.800 3276.700 ECU_ADDRESS 0xC0009926 /end MEASUREMENT
/begin MEASUREMENT ASMod_dmEGR_mp "rückgeführter Abgasmassenstrom" SWORD AirMassPerTime 1 100 -3276.800 3276.700 ECU_ADDRESS 0xC0009928 /end MEASUREMENT
/begin MEASUREMENT ASMod_dmEG_mp "Abgasmassenstrom nach Verbrennung" SWORD AirMassPerTime 1 100 -3276.800 3276.700 ECU_ADDRESS 0xC000993A /end MEASUREMENT
/begin MEASUREMENT ASMod_dmExhMnfDs "Abgasmassenstrom nach Abgaskrümmer" SWORD AirMassPerTime 1 100 -3276.800 3276.700 ECU_ADDRESS 0xD000045C /end MEASUREMENT
/begin MEASUREMENT ASMod_dmExhMnfDs_r32 "Abgasmassenstrom nach Abgaskrümmer" FLOAT32_IEEE AirMassPerTime_float 1 100 0.00 1400.00000 FORMAT "%10.5" ECU_ADDRESS 0xD0002D1C /end MEASUREMENT
/begin MEASUREMENT ASMod_dmExhMnfLPDsRaw_mp "Rohwert des Gasmassenstroms nach dem niederdruckseitigen Abgaskrümmer" FLOAT32_IEEE AirMassPerTime_float 1 100 0.00 1400.00000 FORMAT "%10.5" ECU_ADDRESS 0xC0008D6C /end MEASUREMENT
/begin MEASUREMENT ASMod_dmExhMnfLPDs_mp "Gasmassenstrom nach dem niederdruckseitigen Abgaskrümmer" FLOAT32_IEEE AirMassPerTime_float 1 100 0.00 1400.00000 FORMAT "%10.5" ECU_ADDRESS 0xC0008D70 /end MEASUREMENT
/begin MEASUREMENT ASMod_dmExhMnfLP_mp "Luftmasse nach dem Abgaskrümmer LP" FLOAT32_IEEE AirMassPerTime_float 1 100 0.00 1400.00000 FORMAT "%10.5" ECU_ADDRESS 0xC0008D74 /end MEASUREMENT
/begin MEASUREMENT ASMod_dmExhMnfUs "Abgasmassenstrom vor Abgaskrümmer" SWORD AirMassPerTime 1 100 -3276.800 3276.700 ECU_ADDRESS 0xD000045E /end MEASUREMENT
/begin MEASUREMENT ASMod_dmFlBrn_mp "Massenstrom des verbrannten Kraftstoffs" SWORD InjMassPerTime 1 100 -327.6800 327.6700 FORMAT "%8.4" ECU_ADDRESS 0xC000993C /end MEASUREMENT
/begin MEASUREMENT ASMod_dmFlEG_mp "Kraftstoffmassenstrom nach Verbrennung" SWORD InjMassPerTime 1 100 -327.6800 327.6700 FORMAT "%8.4" ECU_ADDRESS 0xC000993E /end MEASUREMENT
/begin MEASUREMENT ASMod_dmFlInjCmb_mp "an Verbrennung teilnehmender Kraftstoffmassenstrom" SWORD InjMassPerTime 1 100 -327.6800 327.6700 FORMAT "%8.4" ECU_ADDRESS 0xC0009940 /end MEASUREMENT
/begin MEASUREMENT ASMod_dmFlInjNoCmb_mp "an Verbrennung nicht teilnehmender Kraftstoffmassenstrom" SWORD InjMassPerTime 1 100 -327.6800 327.6700 FORMAT "%8.4" ECU_ADDRESS 0xC0009942 /end MEASUREMENT
/begin MEASUREMENT ASMod_dmFlNoBrn_mp "bei Verbrennung nicht umgesetzter Kraftstoffmassenstrom" SWORD InjMassPerTime 1 100 -327.6800 327.6700 FORMAT "%8.4" ECU_ADDRESS 0xC0009944 /end MEASUREMENT
/begin MEASUREMENT ASMod_dmIntMnfDs "Gasmassenstrom nach Einlasskrümmer" SWORD AirMassPerTime 1 100 -3276.800 3276.700 ECU_ADDRESS 0xD000046A /end MEASUREMENT
/begin MEASUREMENT ASMod_dmIntMnfDsRef "Referenz des Gasmassenstroms nach Einlasskrümmer" SWORD AirMassPerTime 1 100 -3276.800 3276.700 ECU_ADDRESS 0xD000046C /end MEASUREMENT
/begin MEASUREMENT ASMod_dmNOxBasLM_mp "Basiswert NOx-Massenstrom nach Verbrennung, Betriebsart 'Magerbetrieb'" SWORD NOxMassPerTime 1 100 -3276.800 3276.700 FORMAT "%8.3" ECU_ADDRESS 0xC0009946 /end MEASUREMENT
/begin MEASUREMENT ASMod_dmNOxDiffEGRRng_mp "Differenzwert des NOx-Massenstroms aus 'ohne ARF' - 'mit ARF'" SWORD NOxMassPerTime 1 100 -3276.800 3276.700 FORMAT "%8.3" ECU_ADDRESS 0xC0009948 /end MEASUREMENT
/begin MEASUREMENT ASMod_dmNOxEG "NOx-Massenstrom im Abgas nach Verbrennung" SLONG NOxMassPerTime 1 100 -214748364.800 214748364.700 FORMAT "%13.3" ECU_ADDRESS 0xD0002DD8 /end MEASUREMENT
/begin MEASUREMENT ASMod_dmNOxEGRCor_mp "ARF-Raten abhängiger NOx-Korrektur-Massenstrom" SWORD NOxMassPerTime 1 100 -3276.800 3276.700 FORMAT "%8.3" ECU_ADDRESS 0xC000994A /end MEASUREMENT
/begin MEASUREMENT ASMod_dmNOxEGROff_mp "NOx-Massenstrom bei abgeschalteter ARF" SWORD NOxMassPerTime 1 100 -3276.800 3276.700 FORMAT "%8.3" ECU_ADDRESS 0xC000994C /end MEASUREMENT
/begin MEASUREMENT ASMod_dmNOxLMEGRCor_mp "NOx-Massenstrom im Magerbetrieb nach Korrektur durch ARF-Rate" SLONG NOxMassPerTime 1 100 -214748364.800 214748364.700 FORMAT "%13.3" ECU_ADDRESS 0xC0008D48 /end MEASUREMENT
/begin MEASUREMENT ASMod_dmO2EG_mp "Sauerstoffmassenstrom nach Verbrennung" SWORD O2MassPerTimeLo 1 100 -655.3600 655.3400 FORMAT "%8.4" ECU_ADDRESS 0xC000994E /end MEASUREMENT
/begin MEASUREMENT ASMod_dmO2IntMnfDs "Sauerstoffmassenstrom nach Einlasskrümmer" SWORD O2MassPerTimeLo 1 100 -655.3600 655.3400 FORMAT "%8.4" ECU_ADDRESS 0xD0000470 /end MEASUREMENT
/begin MEASUREMENT ASMod_dmOilCons "Massenstrom für den Ölverbrauch des Motors" SWORD OilMassPerTime 1 100 -3.276800 3.276700 FORMAT "%8.6" ECU_ADDRESS 0xD0000474 /end MEASUREMENT
/begin MEASUREMENT ASMod_dmOilConsBas_mp "Basis-Massenstrom für den Ölverbrauch des Motors" SWORD OilMassPerTime 1 100 -3.276800 3.276700 FORMAT "%8.6" ECU_ADDRESS 0xC0009950 /end MEASUREMENT
/begin MEASUREMENT ASMod_dmSotBasLM_mp "Basiswert Ruß-Massenstrom nach Verbrennung, Betriebsart 'Magerbetrieb'" SWORD SotMassPerTime 1 100 -327.6800 327.6700 FORMAT "%8.4" ECU_ADDRESS 0xC0009952 /end MEASUREMENT
/begin MEASUREMENT ASMod_dmSotEG "Ruß-Massenstrom im Abgas nach Verbrennung" SLONG SotMassPerTime 1 100 -21474836.4800 21474836.4700 FORMAT "%13.4" ECU_ADDRESS 0xD0002DDC /end MEASUREMENT
/begin MEASUREMENT ASMod_dmSotEngLM1_mp "Ruß-Massenstrom nach Verbrennung aus dem Motor, Betriebsart 'Magerbetrieb'" SLONG SotMassPerTime 1 100 -21474836.4800 21474836.4700 FORMAT "%13.4" ECU_ADDRESS 0xC0008D4C /end MEASUREMENT
/begin MEASUREMENT ASMod_dmSotEngLM2_mp "Ruß-Massenstrom nach Verbrennung aus dem Motor, Betriebsart 'Magerbetrieb'" SLONG SotMassPerTime 1 100 -21474836.4800 21474836.4700 FORMAT "%13.4" ECU_ADDRESS 0xC0008D50 /end MEASUREMENT
/begin MEASUREMENT ASMod_dmSotEngLM3_mp "Ruß-Massenstrom nach Verbrennung aus dem Motor, Betriebsart 'Magerbetrieb'" SLONG SotMassPerTime 1 100 -21474836.4800 21474836.4700 FORMAT "%13.4" ECU_ADDRESS 0xC0008D54 /end MEASUREMENT
/begin MEASUREMENT ASMod_dmSotEngLM_mp "Ruß-Massenstrom nach Verbrennung aus dem Motor, Betriebsart 'Magerbetrieb'" SLONG SotMassPerTime 1 100 -21474836.4800 21474836.4700 FORMAT "%13.4" ECU_ADDRESS 0xC0008D58 /end MEASUREMENT
/begin MEASUREMENT ASMod_dmSotLamCor_mp "Rußmassenstrom Korrekturwert in Abhängigkeit von Lambda" SWORD SotMassPerTime 1 100 -327.6800 327.6700 FORMAT "%8.4" ECU_ADDRESS 0xC0009954 /end MEASUREMENT
/begin MEASUREMENT ASMod_dmSotRatEGRCorBas_mp "Basis-Rußmassenstrom für betriebspunktabhängige ARF-Korrektur" SWORD SotMassPerTime 1 100 -327.6800 327.6700 FORMAT "%8.4" ECU_ADDRESS 0xC0009956 /end MEASUREMENT
/begin MEASUREMENT ASMod_dmSotRatEGRCor_mp "Rußmassenstrom für betriebspunktabhängige ARF-Korrektur" SWORD SotMassPerTime 1 100 -327.6800 327.6700 FORMAT "%8.4" ECU_ADDRESS 0xC0009958 /end MEASUREMENT
/begin MEASUREMENT ASMod_drLamRec_mp "Gradient des reziproken Lambdasignals zur Erkennung rußemissionsrelevanter Lambda-Dynamik" SWORD drLamRec_Persec 1 100 -327.6800 327.6700 FORMAT "%8.4" ECU_ADDRESS 0xC000995A /end MEASUREMENT
/begin MEASUREMENT ASMod_dtCmprSurf_mp "" SLONG Temp_Kelv_Sec 1 100 -21474836.4800 21474836.4700 FORMAT "%13.4" ECU_ADDRESS 0xC0008CD4 /end MEASUREMENT
/begin MEASUREMENT ASMod_dtCmpr_mp "" SLONG Temp_Kelv_Sec 1 100 -21474836.4800 21474836.4700 FORMAT "%13.4" ECU_ADDRESS 0xC0008CD8 /end MEASUREMENT
/begin MEASUREMENT ASMod_dwAirCmpr_mp "" SLONG Pwr1 1 100 -214748364.800 214748364.700 FORMAT "%13.3" ECU_ADDRESS 0xC0008CDC /end MEASUREMENT
/begin MEASUREMENT ASMod_dwCmprSurf_mp "" SLONG Pwr1 1 100 -214748364.800 214748364.700 FORMAT "%13.3" ECU_ADDRESS 0xC0008CE0 /end MEASUREMENT
/begin MEASUREMENT ASMod_dwCmpr_mp "" SLONG Pwr1 1 100 -214748364.800 214748364.700 FORMAT "%13.3" ECU_ADDRESS 0xC0008CE4 /end MEASUREMENT
/begin MEASUREMENT ASMod_dwGsCmprSurf_mp "" SLONG Pwr1 1 100 -214748364.800 214748364.700 FORMAT "%13.3" ECU_ADDRESS 0xC0008CE8 /end MEASUREMENT
/begin MEASUREMENT ASMod_etaCmpr "" SWORD Fact 1 100 0.00 1.000000 ECU_ADDRESS 0xD000047A /end MEASUREMENT
/begin MEASUREMENT ASMod_etaCmpr_r32 "" FLOAT32_IEEE Fact_float 1 100 0.00 1.00000000 FORMAT "%10.8" ECU_ADDRESS 0xD0002D2C /end MEASUREMENT
/begin MEASUREMENT ASMod_etaEGRClg "Wirkungsgrad des ARF-Kühlers" SWORD Fact 1 100 -4.000000 3.999878 ECU_ADDRESS 0xD000047C /end MEASUREMENT
/begin MEASUREMENT ASMod_etaEGRClgCor_mp "" SWORD Fact 1 100 -4.000000 3.999878 ECU_ADDRESS 0xC000992A /end MEASUREMENT
/begin MEASUREMENT ASMod_etaEGRClgLP1_MapIn_mp "Eingangssignal von ASMod_etaEGRClgLP_MAP" FLOAT32_IEEE AirMassPerTime_float 1 100 -700.000000 700.000000 FORMAT "%10.6" ECU_ADDRESS 0xC0008D24 /end MEASUREMENT
/begin MEASUREMENT ASMod_etaEGRClgLP2_MapIn_mp "Eingangssignal von ASMod_etaEGRClgLP_MAP" FLOAT32_IEEE Pos_Prc_float 1 100 0.00 100.000000 FORMAT "%10.6" ECU_ADDRESS 0xC0008D28 /end MEASUREMENT
/begin MEASUREMENT ASMod_etaEGRClgLP_mp "Wirkungsgrad des ND-AGR Kühlers" FLOAT32_IEEE OneToOne 1 100 0.00 800.000000 FORMAT "%10.6" ECU_ADDRESS 0xC0008D2C /end MEASUREMENT
/begin MEASUREMENT ASMod_facEGRClgEtaCor_mp "" SWORD Fact 1 100 -4.000000 3.999878 ECU_ADDRESS 0xC000992C /end MEASUREMENT
/begin MEASUREMENT ASMod_facEGRDvtLim_mp "begrenzte gewichtete Abweichung der ARF-Rate" SWORD Fact1 1 100 -256.0000 255.9922 ECU_ADDRESS 0xC000995C /end MEASUREMENT
/begin MEASUREMENT ASMod_facEGRDvtPOp_mp "betriebspunkt-abhängiger Gewichtungsfaktor für die ARF-Rate-Abweichung" SWORD Fact1 1 100 -256.0000 255.9922 ECU_ADDRESS 0xC000995E /end MEASUREMENT
/begin MEASUREMENT ASMod_facEGRDvtWgh1_mp "oberer Extremwert der ARF-Raten-Abweichung" SWORD Fact1 1 100 -256.0000 255.9922 ECU_ADDRESS 0xC0009960 /end MEASUREMENT
/begin MEASUREMENT ASMod_facEGRDvtWgh2_mp "unterer Extremwert der ARF-Raten-Abweichung" SWORD Fact1 1 100 -256.0000 255.9922 ECU_ADDRESS 0xC0009962 /end MEASUREMENT
/begin MEASUREMENT ASMod_facEGRDvt_mp "gewichtete Abweichung der ARF-Rate" SWORD Fact1 1 100 -256.0000 255.9922 ECU_ADDRESS 0xC0009964 /end MEASUREMENT
/begin MEASUREMENT ASMod_facEGTempMsFlwCor_mp "Korrekturfaktor der Temperaturerhöhung aufgrund des aktuellen Gasmassenstroms" SWORD Fact 1 100 -4.000000 3.999878 ECU_ADDRESS 0xC0009966 /end MEASUREMENT
/begin MEASUREMENT ASMod_facEGTempSOICor_mp "Korrekturfaktor der Temperaturerhöhung aufgrund des aktuellen Spritzbeginns" SWORD Fact 1 100 -4.000000 3.999878 ECU_ADDRESS 0xC0009968 /end MEASUREMENT
/begin MEASUREMENT ASMod_facEnvPresCmpr_mp "Messpunkt für Korrekturkennlinie für reduzierten Gasmassenstrom vor Verdichter" FLOAT32_IEEE Fact_float 1 100 -2.00000000 2.00000000 FORMAT "%10.8" ECU_ADDRESS 0xC0008CEC /end MEASUREMENT
/begin MEASUREMENT ASMod_facOilConsLfTCor_mp "Korrektur-Faktor für den Massenstrom des verbrauchen Öls abhängig von der Laufzeit des Fahrzeugs" SWORD Fact 1 100 -4.000000 3.999878 ECU_ADDRESS 0xC000996A /end MEASUREMENT
/begin MEASUREMENT ASMod_facPresLsEGRClgLP_mp "Faktor für Druckabfall über ND-AGR" FLOAT32_IEEE FactPresLs_float 1 100 0.00 0.300000000 FORMAT "%11.9" ECU_ADDRESS 0xC0008D30 /end MEASUREMENT
/begin MEASUREMENT ASMod_facSotLfTCor_mp "Korrektur-Faktor für den Ruß-Massenstrom abhängig von der Laufzeit des Fahrzeugs" SWORD Fact 1 100 -4.000000 3.999878 ECU_ADDRESS 0xC000996C /end MEASUREMENT
/begin MEASUREMENT ASMod_facSotRatEGRCor_mp "Faktor für ARF-Ratenkorektur des Rußmassenstroms" SWORD Fact 1 100 -4.000000 3.999878 ECU_ADDRESS 0xC000996E /end MEASUREMENT
/begin MEASUREMENT ASMod_htcCmprEnv_mp "" SLONG ThermalCoEff 1 100 0.100000000000 1000.00000000 FORMAT "%13.8" ECU_ADDRESS 0xC0008CF0 /end MEASUREMENT
/begin MEASUREMENT ASMod_lSumSotEmiEEP_mp "emissions-relevante Fahrstrecke aus dem EEPROM für Ruß-Emissionsberechnung" SLONG Length 1 100 -2147483648.00 2147483647.00 FORMAT "%13.2" ECU_ADDRESS 0xC0008D5C /end MEASUREMENT
/begin MEASUREMENT ASMod_lSumVehAct_mp "emmissions-relevante Fahrstrecke des aktuellen Fahrzyklus" SLONG Length 1 100 -2147483648.00 2147483647.00 FORMAT "%13.2" ECU_ADDRESS 0xC0008D60 /end MEASUREMENT
/begin MEASUREMENT ASMod_lSumVehLfTSotEEP_mp "gesamte emissionsrelevante Fahrstrecke für Ruß-Emissionsberechnung" SLONG Length 1 100 -2147483648.00 2147483647.00 FORMAT "%13.2" ECU_ADDRESS 0xC0008D64 /end MEASUREMENT
/begin MEASUREMENT ASMod_lSumVehLfTSot_mp "gesamte emissionsrelevante Fahrstrecke für Ruß-Emissionsberechnung" SWORD LengthKm 1 100 -655360.0 655340.0 FORMAT "%8.1" ECU_ADDRESS 0xC0009970 /end MEASUREMENT
/begin MEASUREMENT ASMod_mEGRIntMnfDsCmb "" SWORD AirMassPerCyl 1 100 -3276.800 3276.700 ECU_ADDRESS 0xD0000486 /end MEASUREMENT
/begin MEASUREMENT ASMod_mExhMnfLPInit_r32 "Initialisierung der Luftmassen für ExhMnfLP" FLOAT32_IEEE Airmass_float 1 100 0.00 150.000000 FORMAT "%10.6" ECU_ADDRESS 0xD0002D38 /end MEASUREMENT
/begin MEASUREMENT ASMod_mExhMnfLP_r32 "Luftmassenstrom in ExhMnfLP" FLOAT32_IEEE Airmass_float 1 100 0.00 150.000000 FORMAT "%10.6" ECU_ADDRESS 0xD0002D3C /end MEASUREMENT
/begin MEASUREMENT ASMod_nHPTrbn "" SWORD TurboN 1 100 -327680.0 327670.0 FORMAT "%8.1" ECU_ADDRESS 0xD000048A /end MEASUREMENT
/begin MEASUREMENT ASMod_nLPTrbn "" SWORD TurboN 1 100 -327680.0 327670.0 FORMAT "%8.1" ECU_ADDRESS 0xD000048C /end MEASUREMENT
/begin MEASUREMENT ASMod_nTrbCh "aktuelle Drehzahl des Turboladers" SWORD TurboN 1 100 0.00 300000.0 FORMAT "%8.1" ECU_ADDRESS 0xD000048E /end MEASUREMENT
/begin MEASUREMENT ASMod_nTrbChRed_mp "reduzierte Drehzahl des Turboladers" FLOAT32_IEEE TrbChN_float 1 100 0.00 300000.000 FORMAT "%10.3" ECU_ADDRESS 0xC0008CF4 /end MEASUREMENT
/begin MEASUREMENT ASMod_nTrbCh_r32 "aktuelle Drehzahl des Turboladers" FLOAT32_IEEE TrbChN_float 1 100 0.00 300000.000 FORMAT "%10.3" ECU_ADDRESS 0xD0002D50 /end MEASUREMENT
/begin MEASUREMENT ASMod_numSotEOM_mp "Nummer der aktueller Betriebsart für Ruß-Betriebsart-Umschalterung" UBYTE OneToOne 1 100 0.00 255.0 ECU_ADDRESS 0xC000B0A3 /end MEASUREMENT
/begin MEASUREMENT ASMod_pCmprDiff_mp "" SWORD Pres_hPa 1 100 -32768.00 3500.00 ECU_ADDRESS 0xC000992E /end MEASUREMENT
/begin MEASUREMENT ASMod_pCmprDsDyn_mp "dynamischer Druck nach Verdichter" FLOAT32_IEEE Pres_hPa_float 1 100 0.00 4000.00000 FORMAT "%10.5" ECU_ADDRESS 0xC0008CF8 /end MEASUREMENT
/begin MEASUREMENT ASMod_pCmprDsTot_r32 "totaler Druck nach Verdichter" FLOAT32_IEEE Pres_hPa_float 1 100 0.00 4000.00000 FORMAT "%10.5" ECU_ADDRESS 0xD0002D54 /end MEASUREMENT
/begin MEASUREMENT ASMod_pCmprDs_mp "Druck nach Verdichter" FLOAT32_IEEE Pres_hPa_float 1 100 0.00 4000.00000 FORMAT "%10.5" ECU_ADDRESS 0xC0008CFC /end MEASUREMENT
/begin MEASUREMENT ASMod_pCmprUsDyn_mp "dynamischer Druck vor Verdichter" FLOAT32_IEEE Pres_hPa_float 1 100 0.00 4000.00000 FORMAT "%10.5" ECU_ADDRESS 0xC0008D00 /end MEASUREMENT
/begin MEASUREMENT ASMod_pCmprUsTot_r32 "totaler Druck vor Verdichter" FLOAT32_IEEE Pres_hPa_float 1 100 0.00 4000.00000 FORMAT "%10.5" ECU_ADDRESS 0xD0002D58 /end MEASUREMENT
/begin MEASUREMENT ASMod_pEGFld "Feld der Abgasdrücke" SWORD Pres_hPa 1 100 -32768.00 3500.00 ARRAY_SIZE 8 ECU_ADDRESS 0xD0000492 /end MEASUREMENT
/begin MEASUREMENT ASMod_pEGRLPDs_r32 "Druck nach ND-AGR" FLOAT32_IEEE Pres_hPa_float 1 100 0.00 6000.00000 FORMAT "%10.5" ECU_ADDRESS 0xD0002D60 /end MEASUREMENT
/begin MEASUREMENT ASMod_pExhMnfLP_mp "Druck im niederdruckseitigen Abgaskrümmer" FLOAT32_IEEE Pres_hPa_float 1 100 0.00 4000.00000 FORMAT "%10.5" ECU_ADDRESS 0xC0008D78 /end MEASUREMENT
/begin MEASUREMENT ASMod_phiDiffSOIRef_mp "Abweichung von der Referenz des Spritzbeginns der MI1" SWORD AngleCrS 1 100 -720.0000 719.9780 ECU_ADDRESS 0xC0009972 /end MEASUREMENT
/begin MEASUREMENT ASMod_phiSOIRefRgn_mp "" SWORD AngleCrS 1 100 -720.0000 719.9780 ECU_ADDRESS 0xC0009974 /end MEASUREMENT
/begin MEASUREMENT ASMod_phiSOIRef_mp "Referenz des Spritzbeginns der MI1" SWORD AngleCrS 1 100 -720.0000 719.9780 ECU_ADDRESS 0xC0009976 /end MEASUREMENT
/begin MEASUREMENT ASMod_pIntMnf_mp "Druck im Einlasskrümmer" SWORD Pres_hPa 1 100 -32768.00 3500.00 ECU_ADDRESS 0xC0009930 /end MEASUREMENT
/begin MEASUREMENT ASMod_pIntMnf_r32 "Druck im Einlasskrümmer" FLOAT32_IEEE Pres_hPa_float 1 100 0.00 4000.00000 FORMAT "%10.5" ECU_ADDRESS 0xD0002D6C /end MEASUREMENT
/begin MEASUREMENT ASMod_pLsEGRClgLP_mp "Druckabfall über ND-AGR" FLOAT32_IEEE Pres_hPa_float 1 100 0.00 1000.00000 FORMAT "%10.5" ECU_ADDRESS 0xC0008D34 /end MEASUREMENT
/begin MEASUREMENT ASMod_pTrbnUs_r32 "" FLOAT32_IEEE Pres_hPa_float 1 100 500.000000 1500.00000 FORMAT "%10.5" ECU_ADDRESS 0xD0002D70 /end MEASUREMENT
/begin MEASUREMENT ASMod_qBrn_mp "verbrannte Kraftstoffmenge" SWORD InjMass 1 100 -327.6800 327.6700 ECU_ADDRESS 0xC0009978 /end MEASUREMENT
/begin MEASUREMENT ASMod_qDiffPoI1Ref "" SWORD InjMass 1 100 -327.6800 327.6700 ECU_ADDRESS 0xD00004B8 /end MEASUREMENT
/begin MEASUREMENT ASMod_qDiffPoI2Ref "" SWORD InjMass 1 100 -327.6800 327.6700 ECU_ADDRESS 0xD00004BA /end MEASUREMENT
/begin MEASUREMENT ASMod_qInjCmb "an der Verbrennung teilnehmende Kraftstoffmenge" SWORD InjMass 1 100 -327.6800 327.6700 ECU_ADDRESS 0xD00004BC /end MEASUREMENT
/begin MEASUREMENT ASMod_qInjNoCmb "an der Verbrennung nicht teilnehmende Kraftstoffmenge" SWORD InjMass 1 100 -327.6800 327.6700 ECU_ADDRESS 0xD00004BE /end MEASUREMENT
/begin MEASUREMENT ASMod_qPoI1Ref_mp "" SWORD InjMass 1 100 -327.6800 327.6700 ECU_ADDRESS 0xC000997A /end MEASUREMENT
/begin MEASUREMENT ASMod_qPoI2Ref_mp "" SWORD InjMass 1 100 -327.6800 327.6700 ECU_ADDRESS 0xC000997C /end MEASUREMENT
/begin MEASUREMENT ASMod_rECBLinCrvIn_mp "Positionssignal des ARF-Kühler-Bypass in die Linearisierungkennlinie" SWORD Prc 1 100 -400.0000 399.9878 ECU_ADDRESS 0xC0009916 /end MEASUREMENT
/begin MEASUREMENT ASMod_rECBLPLinCrvIn_mp "Eingangssignal von ASMod_rECBLPLin_CUR" SWORD Prc 1 100 -400.0000 399.9878 ECU_ADDRESS 0xC0009918 /end MEASUREMENT
/begin MEASUREMENT ASMod_rEffEGRLP_CrvIn_mp "Eingangssignal von ASMod_arEffEGRLP_CUR" FLOAT32_IEEE Pos_Prc_float 1 100 0.00 100.000000 FORMAT "%10.6" ECU_ADDRESS 0xC0008D38 /end MEASUREMENT
/begin MEASUREMENT ASMod_rEGR "Abgasrückführrate in den Motor" SWORD RatAirMass 1 100 -327.6800 327.6700 FORMAT "%8.4" ECU_ADDRESS 0xD00004C2 /end MEASUREMENT
/begin MEASUREMENT ASMod_rEGRActVal_mp "" FLOAT32_IEEE Pos_Prc_float 1 100 0.00 100.000000 FORMAT "%10.6" ECU_ADDRESS 0xC0008D18 /end MEASUREMENT
/begin MEASUREMENT ASMod_rEGRDvtNrm_mp "normierte ARF-Raten-Abweichung" SWORD RatAirMass 1 100 -327.6800 327.6700 FORMAT "%8.4" ECU_ADDRESS 0xC000997E /end MEASUREMENT
/begin MEASUREMENT ASMod_rEGRDvtWghCrvIn_mp "ARF-Raten-Abweichung zur Gewichtungsberechnung" SWORD RatAirMass 1 100 -327.6800 327.6700 FORMAT "%8.4" ECU_ADDRESS 0xC0009980 /end MEASUREMENT
/begin MEASUREMENT ASMod_rEGRDvt_mp "Abweichung der ARF-Rate" SWORD RatAirMass 1 100 -327.6800 327.6700 FORMAT "%8.4" ECU_ADDRESS 0xC0009982 /end MEASUREMENT
/begin MEASUREMENT ASMod_rEGRLPLinCrvIn_mp "Eingangssignal von ASMod_rEGRLPLin_CUR" SWORD Prc 1 100 -400.0000 399.9878 ECU_ADDRESS 0xC000991A /end MEASUREMENT
/begin MEASUREMENT ASMod_rEGRSet_mp "Sollwert der ARF-Rate" SWORD RatAirMass 1 100 -327.6800 327.6700 FORMAT "%8.4" ECU_ADDRESS 0xC0009984 /end MEASUREMENT
/begin MEASUREMENT ASMod_rExhFlpLPLinCrvIn_mp "Eingangssignal von ASMod_rExhFlpLPLin_CUR" SWORD Prc 1 100 -400.0000 399.9878 ECU_ADDRESS 0xC000991C /end MEASUREMENT
/begin MEASUREMENT ASMod_rExhMnfLPlp_CrvIn_mp "Eingangssignal von ASMod_arEffExhFlpLP_CUR" FLOAT32_IEEE Area_cm2_float 1 100 0.00 100.000000 FORMAT "%10.6" ECU_ADDRESS 0xC0008D7C /end MEASUREMENT
/begin MEASUREMENT ASMod_rFlBrn_mp "Verhältnis des verbrannten Kraftstoffmassenstroms und des an der Verbrennung teilnehmenden Kraftstoffmassenstroms" SWORD RatFuelMass 1 100 -327.6800 327.6700 FORMAT "%8.4" ECU_ADDRESS 0xC0009986 /end MEASUREMENT
/begin MEASUREMENT ASMod_rFlEG "Anteil des Kraftstoffs im Abgasmassenstrom nach Verbrennung" SWORD RatFuelMass 1 100 -327.6800 327.6700 FORMAT "%8.4" ECU_ADDRESS 0xD00004C4 /end MEASUREMENT
/begin MEASUREMENT ASMod_rLamRecDfl "Defaultwert des reziproken Lambda-Signals" SWORD lambdaRecVal 1 100 -32.76800 32.76700 FORMAT "%8.5" ECU_ADDRESS 0xD00004C6 /end MEASUREMENT
/begin MEASUREMENT ASMod_rLamRecDiffRef_mp "rekursiver Lambda-Differenzwert zwischen Referenz- und Lambdasondenwert für Rußmassenstromkorrektur" SWORD lambdaRecVal 1 100 -32.76800 32.76700 FORMAT "%8.5" ECU_ADDRESS 0xC0009988 /end MEASUREMENT
/begin MEASUREMENT ASMod_rLamRecEG "reziprokes Lambda-Signal nach Verbrennung" SWORD lambdaRecVal 1 100 -32.76800 32.76700 FORMAT "%8.5" ECU_ADDRESS 0xD00004C8 /end MEASUREMENT
/begin MEASUREMENT ASMod_rLamRecEGFlt_mp "gefilteres reziprokes Lambda-Signal nach Verbrennung" SWORD lambdaRecVal 1 100 -32.76800 32.76700 FORMAT "%8.5" ECU_ADDRESS 0xC000998A /end MEASUREMENT
/begin MEASUREMENT ASMod_rLamRecExhMnfDs "reziprokes Lambda-Signal des Gasmassenstroms nach Abgaskrümmer" SWORD lambdaRecVal 1 100 -32.76800 32.76700 FORMAT "%8.5" ECU_ADDRESS 0xD00004CC /end MEASUREMENT
/begin MEASUREMENT ASMod_rLamRecRefBas_mp "Referenz des reziproken Lambda-Signals" SWORD lambdaRecVal 1 100 -32.76800 32.76700 FORMAT "%8.5" ECU_ADDRESS 0xC000998C /end MEASUREMENT
/begin MEASUREMENT ASMod_rLamRecRefMin_mp "minimales reziprokes Lambdasignal zur Erkennung rußemissionsrelevanter Lambda-Dynamik" SWORD lambdaRecVal 1 100 -32.76800 32.76700 FORMAT "%8.5" ECU_ADDRESS 0xC000998E /end MEASUREMENT
/begin MEASUREMENT ASMod_rLamRecRef_mp "rekursive Lambda-Referenzwert für Rußmassenstromkorrektur" SWORD lambdaRecVal 1 100 -32.76800 32.76700 FORMAT "%8.5" ECU_ADDRESS 0xC0009990 /end MEASUREMENT
/begin MEASUREMENT ASMod_rLamRecStat_mp "gefilteres reziprokes Lambda-Signal nach Verbrennung" SWORD lambdaRecVal 1 100 -32.76800 32.76700 FORMAT "%8.5" ECU_ADDRESS 0xC0009992 /end MEASUREMENT
/begin MEASUREMENT ASMod_rMsFlwRef_mp "relative Abweichung von der Referenz des Gasmassenstroms nach Einlasskrümmer" SWORD RatAirMass 1 100 -327.6800 327.6700 FORMAT "%8.4" ECU_ADDRESS 0xC0009994 /end MEASUREMENT
/begin MEASUREMENT ASMod_rNOxEG "Anteil der NOx-Emission im Abgassmassenstrom nach Verbrennung" SWORD RatNOxMass 1 100 -0.003276800 0.003276700 FORMAT "%11.9" ECU_ADDRESS 0xD00004CE /end MEASUREMENT
/begin MEASUREMENT ASMod_rNOxEGFld "Feld der NOx-Massenanteile im Abgas" SWORD RatNOxMass 1 100 -0.003276800 0.003276700 FORMAT "%11.9" ARRAY_SIZE 7 ECU_ADDRESS 0xD00004D0 /end MEASUREMENT
/begin MEASUREMENT ASMod_rO2EGFld "Feld der Sauerstoffanteile der Abgasmassenströme" SWORD O2 1 100 -0.3276800 0.3276700 ARRAY_SIZE 7 ECU_ADDRESS 0xD00004DE /end MEASUREMENT
/begin MEASUREMENT ASMod_rO2EG_mp "Sauerstoffanteil im Abgasmassenstroms nach Verbrennung" SWORD O2 1 100 -0.3276800 0.3276700 ECU_ADDRESS 0xC0009996 /end MEASUREMENT
/begin MEASUREMENT ASMod_rO2ExhMnfDs "Sauerstoffanteil im Abgasmassenstroms nach Abgaskrümmer" SWORD O2 1 100 -0.3276800 0.3276700 ECU_ADDRESS 0xD00004EC /end MEASUREMENT
/begin MEASUREMENT ASMod_rO2ExhMnfLPDs_mp "Sauerstoffanteil des niedrigen Abgasdruck" SWORD O2 1 100 -0.3276800 0.3276700 ECU_ADDRESS 0xC00099B2 /end MEASUREMENT
/begin MEASUREMENT ASMod_rO2ExhMnfUs "Sauerstoffanteil im Abgasmassenstroms vor Abgaskrümmer" SWORD O2 1 100 -0.3276800 0.3276700 ECU_ADDRESS 0xD00004EE /end MEASUREMENT
/begin MEASUREMENT ASMod_rO2IntMnfDs_mp "Sauerstoffanteil im Gasmassenstroms nach Einlasskrümmer" SWORD O2 1 100 -0.3276800 0.3276700 ECU_ADDRESS 0xC0009932 /end MEASUREMENT
/begin MEASUREMENT ASMod_rO2IntMnfUs_mp "Sauerstoffanteil im Gasmassenstrom vor Einlasskrümmer" SWORD O2 1 100 -0.3276800 0.3276700 ECU_ADDRESS 0xC0009934 /end MEASUREMENT
/begin MEASUREMENT ASMod_rPresCmprFMod "" SWORD Fact 1 100 -4.000000 3.999878 ECU_ADDRESS 0xD00004F0 /end MEASUREMENT
/begin MEASUREMENT ASMod_rPresCmprFMod_mp "" FLOAT32_IEEE OneToOne 1 100 0.500000000 3.00000000 FORMAT "%10.8" ECU_ADDRESS 0xC0008D04 /end MEASUREMENT
/begin MEASUREMENT ASMod_rPresLsEGRClgLP_CrvIn_mp "Eingangssignal von ASMod_facPresLsEGRClgLP_CUR" FLOAT32_IEEE Pos_Prc_float 1 100 0.00 100.000000 FORMAT "%10.6" ECU_ADDRESS 0xC0008D3C /end MEASUREMENT
/begin MEASUREMENT ASMod_rRelPosECB "relative Position des Stellers für den ARF-Kühler-Bypass" SWORD Prc 1 100 -400.0000 399.9878 ECU_ADDRESS 0xD00004F4 /end MEASUREMENT
/begin MEASUREMENT ASMod_rRelPosECBLP "Relative Position des niederdruckseitigen ARF-Kühler-Bypass-Stellers" SWORD Prc 1 100 -400.0000 399.9878 ECU_ADDRESS 0xD00004F6 /end MEASUREMENT
/begin MEASUREMENT ASMod_rRelPosEGRLP "Relative Position des niederdruckseitigen ARF-Stellers" SWORD Prc 1 100 -400.0000 399.9878 ECU_ADDRESS 0xD00004F8 /end MEASUREMENT
/begin MEASUREMENT ASMod_rRelPosEGRLPNoCor_mp "unkorrigierte relative Position des niederdruckseitigen ARF-Stellers" SWORD Prc 1 100 -400.0000 399.9878 ECU_ADDRESS 0xC000991E /end MEASUREMENT
/begin MEASUREMENT ASMod_rRelPosExhFlpLP "Relative Position der niederdruckseitigen Abgasklappe" SWORD Prc 1 100 -400.0000 399.9878 ECU_ADDRESS 0xD00004FA /end MEASUREMENT
/begin MEASUREMENT ASMod_rRelPosExhFlpLPNoCor_mp "unkorrigierte relative Position der niederdruckseitigen Abgasklappe" SWORD Prc 1 100 -400.0000 399.9878 ECU_ADDRESS 0xC0009920 /end MEASUREMENT
/begin MEASUREMENT ASMod_rRelPosTVA "relative Position der Drosselklappe" SWORD Prc 1 100 -400.0000 399.9878 ECU_ADDRESS 0xD00004FC /end MEASUREMENT
/begin MEASUREMENT ASMod_rRelPosVSA "relative Position der Drallklappe" SWORD Prc 1 100 -400.0000 399.9878 ECU_ADDRESS 0xD00004FE /end MEASUREMENT
/begin MEASUREMENT ASMod_rSotLamCorCrvIn1_mp "rekursiver Lambda-Differenzwert zwischen Referenz- und Lambdasondenwert" SWORD lambdaRecVal 1 100 -32.76800 32.76700 FORMAT "%8.5" ECU_ADDRESS 0xC0009998 /end MEASUREMENT
/begin MEASUREMENT ASMod_rSotLamCorCrvIn2_mp "reziprokes Lambda-Signal nach Verbrennung" SWORD lambdaRecVal 1 100 -32.76800 32.76700 FORMAT "%8.5" ECU_ADDRESS 0xC000999A /end MEASUREMENT
/begin MEASUREMENT ASMod_rSotRatEGRCorCrvIn_mp "ARF-Rate" SWORD RatAirMass 1 100 -327.6800 327.6700 FORMAT "%8.4" ECU_ADDRESS 0xC000999C /end MEASUREMENT
/begin MEASUREMENT ASMod_rTempAdbtCmpr_mp "" SWORD Fact 1 100 -4.000000 3.999878 ECU_ADDRESS 0xC0009910 /end MEASUREMENT
/begin MEASUREMENT ASMod_rTVALinCrvIn_mp "Positionssignal der Drosselklappe in die Linearisierungkennlinie" SWORD DtyCyc 1 100 -327.6800 327.6700 ECU_ADDRESS 0xC0009922 /end MEASUREMENT
/begin MEASUREMENT ASMod_rVSALinCrvIn_mp "Positionssignal der Drallklappe in die Linearisierungkennlinie" SWORD Prc 1 100 -400.0000 399.9878 ECU_ADDRESS 0xC0009924 /end MEASUREMENT
/begin MEASUREMENT ASMod_stCmpLamRecRef_mp "Status der Begrenzung auf minimalen reziproken Lambdawert zur Erkennung rußemissionsrelevanter Lambda-Dynamik" UBYTE OneToOne 1 100 0.00 255.0 ECU_ADDRESS 0xC000B0A4 /end MEASUREMENT
/begin MEASUREMENT ASMod_stDynRatLamRec_mp "Status der Begrenzung auf den minimalen Gradient des reziproken Lambdasignals zur Erkennung rußemissionsrelevanter Lambda-Dynamik" UBYTE OneToOne 1 100 0.00 255.0 ECU_ADDRESS 0xC000B0A5 /end MEASUREMENT
/begin MEASUREMENT ASMod_stEnaEGRLrnBits_mp "" UBYTE OneToOne 1 100 0.00 255.0 ECU_ADDRESS 0xC000B0A0 /end MEASUREMENT
/begin MEASUREMENT ASMod_stEnaEGRLrn_mp "" UBYTE OneToOne 1 100 0.00 255.0 ECU_ADDRESS 0xC000B0A1 /end MEASUREMENT
/begin MEASUREMENT ASMod_stFIdASModAFSok "" UBYTE OneToOne 1 100 0.00 255.0 ECU_ADDRESS 0xD0001BED /end MEASUREMENT
/begin MEASUREMENT ASMod_stFIdASModT20ok "" UBYTE OneToOne 1 100 0.00 255.0 ECU_ADDRESS 0xD0001BEE /end MEASUREMENT
/begin MEASUREMENT ASMod_stInit "Status der Umschaltung auf Initialisierungswerte" UBYTE OneToOne 1 100 0.00 255.0 ECU_ADDRESS 0xD0001BEF /end MEASUREMENT
/begin MEASUREMENT ASMod_stInitExhMnfLP_mp "Status von ExhMnfLP" UBYTE OneToOne 1 100 0.00 255.0 ECU_ADDRESS 0xC000B0A8 /end MEASUREMENT
/begin MEASUREMENT ASMod_stLamRecRef_mp "Status der Abfrage auf abgeschaltete ARF, Abschaltfall oder Partikelfilter-Regeneration" UBYTE OneToOne 1 100 0.00 255.0 ECU_ADDRESS 0xC000B0A6 /end MEASUREMENT
/begin MEASUREMENT ASMod_stNaNEGRLP_mp "Status der Erkennung auf NaN und Inf im Modul niederdruckseitige Abgasrückführung" UBYTE OneToOne 1 100 0.00 255.0 ECU_ADDRESS 0xC000B0A2 /end MEASUREMENT
/begin MEASUREMENT ASMod_stNaNExhMnfLP_mp "Status der Erkennung auf NaN und Inf im Modul niederdruckseitiger Abgaskrümmer" UBYTE OneToOne 1 100 0.00 255.0 ECU_ADDRESS 0xC000B0A9 /end MEASUREMENT
/begin MEASUREMENT ASMod_swtLamRecRef_mp "aktuelle Auswahl der Lambda- Referenzwert- Ermittlung im Normalbetrieb" UBYTE OneToOne 1 100 0.00 255.0 ECU_ADDRESS 0xC000B0A7 /end MEASUREMENT
/begin MEASUREMENT ASMod_tCACDs "Temperatur nach Ladeluftkühler" SWORD Temp_Cels 1 100 -3549.940 3003.560 ECU_ADDRESS 0xD0000502 /end MEASUREMENT
/begin MEASUREMENT ASMod_tCmprAdbtDs_mp "" SWORD Temp_Cels 1 100 -30.04000 499.9600 ECU_ADDRESS 0xC0009912 /end MEASUREMENT
/begin MEASUREMENT ASMod_tCmprDs "" SWORD Temp_Cels 1 100 -30.04000 999.9600 ECU_ADDRESS 0xD0000504 /end MEASUREMENT
/begin MEASUREMENT ASMod_tCmprEnv "" SWORD Temp_Cels 1 100 -3549.940 3003.560 ECU_ADDRESS 0xD0000506 /end MEASUREMENT
/begin MEASUREMENT ASMod_tCmprEnv_mp "" SWORD Temp_Cels 1 100 -30.04000 499.9600 ECU_ADDRESS 0xC0009914 /end MEASUREMENT
/begin MEASUREMENT ASMod_tCmprSurf "" SWORD Temp_Cels 1 100 -30.04000 999.9600 ECU_ADDRESS 0xD0000508 /end MEASUREMENT
/begin MEASUREMENT ASMod_tCmprUsSlct_r32 "" FLOAT32_IEEE TempC_float 1 100 -50.0000000 150.000000 FORMAT "%10.6" ECU_ADDRESS 0xD0002D7C /end MEASUREMENT
/begin MEASUREMENT ASMod_tDiffEGRClgLP_mp "Temperaturabfall des Abgases über ND-AGR Kühler" FLOAT32_IEEE TempK_float 1 100 0.00 576.000000 FORMAT "%10.6" ECU_ADDRESS 0xC0008D40 /end MEASUREMENT
/begin MEASUREMENT ASMod_tDiffEGRClg_mp "Temperaturabsenkung des rückgeführten Abgases im ARF-Kühler" SWORD Temp_Kelv 1 100 -3276.800 3276.700 FORMAT "%8.3" ECU_ADDRESS 0xC0009936 /end MEASUREMENT
/begin MEASUREMENT ASMod_tDiffEG_mp "Temperaturerhöhung des Gasmassenstroms durch Verbrennung" SWORD TempDiff_Kelv 1 100 -3276.800 3276.700 ECU_ADDRESS 0xC000999E /end MEASUREMENT
/begin MEASUREMENT ASMod_tDiffEngBas "Grundkennfeld der Temperaturerhöhung durch Verbrennung" SWORD TempDiff_Kelv 1 100 -3276.800 3276.700 ECU_ADDRESS 0xD000050A /end MEASUREMENT
/begin MEASUREMENT ASMod_tDiffEngRef_mp "Temperaturabweichung von der Referenz der Motortemperatur" SWORD TempDiff_Kelv 1 100 -3276.800 3276.700 ECU_ADDRESS 0xC00099A0 /end MEASUREMENT
/begin MEASUREMENT ASMod_tDiffEngRgn_mp "" SWORD TempDiff_Kelv 1 100 -3276.800 3276.700 ECU_ADDRESS 0xC00099A2 /end MEASUREMENT
/begin MEASUREMENT ASMod_tDiffEng_mp "Temperaturerhöhung des Gasmassenstroms aus dem Grundkennfeld" SWORD TempDiff_Kelv 1 100 -3276.800 3276.700 ECU_ADDRESS 0xC00099A4 /end MEASUREMENT
/begin MEASUREMENT ASMod_tEGEngTempCor_mp "Korrekturwert der Temperaturerhöhung aufgrund der Motortemperatur" SWORD TempDiff_Kelv 1 100 -3276.800 3276.700 ECU_ADDRESS 0xC00099A6 /end MEASUREMENT
/begin MEASUREMENT ASMod_tEGFld "Feld der Abgastemperaturen" SWORD Temp_Cels 1 100 -3549.940 3003.560 ARRAY_SIZE 14 ECU_ADDRESS 0xD000050C /end MEASUREMENT
/begin MEASUREMENT ASMod_tEGPoI1Cor_mp "" SWORD TempDiff_Kelv 1 100 -3276.800 3276.700 ECU_ADDRESS 0xC00099A8 /end MEASUREMENT
/begin MEASUREMENT ASMod_tEGPoI2Cor_mp "" SWORD TempDiff_Kelv 1 100 -3276.800 3276.700 ECU_ADDRESS 0xC00099AA /end MEASUREMENT
/begin MEASUREMENT ASMod_tEGRDs "Temperatur des rückgeführten Abgases nach ARF-Kühler" SWORD Temp_Cels 1 100 -3549.940 3003.560 ECU_ADDRESS 0xD0000528 /end MEASUREMENT
/begin MEASUREMENT ASMod_tEGRLPDs "Temperatur des rückgeführten Abgases bei Niederdruck-AGR" SWORD Temp_Cels 1 100 -3549.940 3003.560 ECU_ADDRESS 0xD000052A /end MEASUREMENT
/begin MEASUREMENT ASMod_tEGRLPDs_r32 "Temperatur des rückgeführten Abgases" FLOAT32_IEEE TempC_float 1 100 -50.0000000 1000.00000 FORMAT "%10.5" ECU_ADDRESS 0xD0002D84 /end MEASUREMENT
/begin MEASUREMENT ASMod_tEGRThrVlvUs_r32 "" FLOAT32_IEEE TempC_float 1 100 -50.0000000 150.000000 FORMAT "%10.6" ECU_ADDRESS 0xD0002D88 /end MEASUREMENT
/begin MEASUREMENT ASMod_tEG_mp "Temperatur des Abgases nach Verbrennung" SWORD Temp_Cels 1 100 -3549.940 3003.560 ECU_ADDRESS 0xC00099AC /end MEASUREMENT
/begin MEASUREMENT ASMod_tExhMnfDs "Abgastemperatur nach Abgaskrümmer" SWORD Temp_Cels 1 100 -3549.940 3003.560 ECU_ADDRESS 0xD000052C /end MEASUREMENT
/begin MEASUREMENT ASMod_tExhMnfLPDs_mp "Niedriger Abgasdruck nach Temperature" SWORD Temp_Cels 1 100 -3549.940 3003.560 ECU_ADDRESS 0xC00099B4 /end MEASUREMENT
/begin MEASUREMENT ASMod_tExhMnfLP_mp "Abgastemperaturabsenkung im EGRLP-Kühler" SWORD Temp_Cels 1 100 -3549.940 3003.560 ECU_ADDRESS 0xC00099B6 /end MEASUREMENT
/begin MEASUREMENT ASMod_tExhMnfUs "Abgastemperatur vor Abgaskrümmer" SWORD Temp_Cels 1 100 -3549.940 3003.560 ECU_ADDRESS 0xD000052E /end MEASUREMENT
/begin MEASUREMENT ASMod_tiDdT_mp "Gaslaufzeit durch den Motor" SWORD TimeDeb 1 100 -327680.0 327670.0 ECU_ADDRESS 0xC00099AE /end MEASUREMENT
/begin MEASUREMENT ASMod_tiEngOn_mp "Motorbetriebszeit" SWORD Time100HrsEngOn 1 100 -32768.00 32767.00 FORMAT "%8.2" ECU_ADDRESS 0xC00099B0 /end MEASUREMENT
/begin MEASUREMENT ASMod_tIntMnfDs "Temperatur des Gasmassenstroms nach Einlasskrümmer" SWORD Temp_Cels 1 100 -3549.940 3003.560 ECU_ADDRESS 0xD000053A /end MEASUREMENT
/begin MEASUREMENT ASMod_tIntMnfDs_r32 "Temperatur des Gasmassenstroms nach Einlasskrümmer" FLOAT32_IEEE TempC_float 1 100 -50.0000000 400.000000 FORMAT "%10.6" ECU_ADDRESS 0xD0002D8C /end MEASUREMENT
/begin MEASUREMENT ASMod_tIntMnfUs "Temperaturvor Einlasskrümmer" SWORD Temp_Cels 1 100 -3549.940 3003.560 ECU_ADDRESS 0xD000053E /end MEASUREMENT
/begin MEASUREMENT ASMod_tiPT1pIntMnf_mp "" SLONG TimeDelay_ms 1 100 0.0020000000009 4294967.2960 FORMAT "%12.4" ECU_ADDRESS 0xC0008D0C /end MEASUREMENT
/begin MEASUREMENT ASMod_tMixPntEGDs_mp "Abgastemperatur nach Mischstelle im Abgaskrümmer" SWORD Temp_Cels 1 100 -3549.940 3003.560 ECU_ADDRESS 0xC0009938 /end MEASUREMENT
/begin MEASUREMENT ASMod_tMixPntEGUs "Abgastemperatur vor Mischstelle im Abgaskrümmer" SWORD Temp_Cels 1 100 -3549.940 3003.560 ECU_ADDRESS 0xD0000548 /end MEASUREMENT
/begin MEASUREMENT ASMod_tNSCDs "Temperatur nach NSC" SWORD Temp_Cels 1 100 -3549.940 3003.560 ARRAY_SIZE 1 ECU_ADDRESS 0xD000054A /end MEASUREMENT
/begin MEASUREMENT ASMod_tWallFld "Feld der Rohrwand-Temperaturen" SWORD Temp_Cels 1 100 -3549.940 3003.560 ARRAY_SIZE 7 ECU_ADDRESS 0xD0000570 /end MEASUREMENT
/begin MEASUREMENT ECBVlvLP_r "" SWORD Prc 1 100 -400.0000 399.9878 ECU_ADDRESS 0xD00008D4 /end MEASUREMENT
/begin MEASUREMENT ECBVlv_rB1 "Steuerwert des Reglers (fuer Bank 1 in zweiflutigem System)" SWORD Prc 1 100 -400.0000 399.9878 ECU_ADDRESS 0xD00008DA /end MEASUREMENT
/begin MEASUREMENT ECBVlv_rB2 "Steuerwert des Reglers (fuer Bank 2 in zweiflutigem System)" SWORD Prc 1 100 -400.0000 399.9878 ECU_ADDRESS 0xD00008DC /end MEASUREMENT
/begin MEASUREMENT EGRVlv_rActB1 "Ventilstellung (Offset korrigiert und nach der Fehlerbehandlung), Bank 1" SWORD Prc 1 100 -400.0000 399.9878 ECU_ADDRESS 0xD000090A /end MEASUREMENT
/begin MEASUREMENT EGRVlv_rActB2 "Ventilstellung (Offset korrigiert und nach der Fehlerbehandlung), Bank 2" SWORD Prc 1 100 -400.0000 399.9878 ECU_ADDRESS 0xD000090C /end MEASUREMENT
/begin MEASUREMENT ETCtl_dmHC "HC Massenstrom" SWORD InjMassPerTime 1 100 -327.6800 327.6700 FORMAT "%8.4" ECU_ADDRESS 0xD0000968 /end MEASUREMENT
/begin MEASUREMENT ExhFlpLP_r "" SWORD Prc 1 100 -400.0000 399.9878 ECU_ADDRESS 0xD00009FA /end MEASUREMENT
/begin MEASUREMENT Exh_pAdapPPFltDiffB1 "" SWORD Pres_hPa 1 100 -32768.00 3500.00 ECU_ADDRESS 0xD0000A06 /end MEASUREMENT
/begin MEASUREMENT Exh_pAdapPPFltDiffB2 "" SWORD Pres_hPa 1 100 -32768.00 3500.00 ECU_ADDRESS 0xD0000A08 /end MEASUREMENT
/begin MEASUREMENT Exh_pPFltUsB1 "Druck vor Partikelfilter, Bank 1" SWORD Pres_hPa 1 100 -32768.00 3500.00 ECU_ADDRESS 0xD0000A36 /end MEASUREMENT
/begin MEASUREMENT Exh_pPFltUsB2 "Druck vor Partikelfilter, Bank 2" SWORD Pres_hPa 1 100 -32768.00 3500.00 ECU_ADDRESS 0xD0000A38 /end MEASUREMENT
/begin MEASUREMENT Exh_tPFltUsB1 "Temperatur vor Partikelfilter (Bank-1)" SWORD Temp_Cels 1 100 -3549.940 3003.560 ECU_ADDRESS 0xD0000AA4 /end MEASUREMENT
/begin MEASUREMENT Exh_tPFltUsB2 "Temperatur vor Partikelfilter (Bank-2)" SWORD Temp_Cels 1 100 -3549.940 3003.560 ECU_ADDRESS 0xD0000AA6 /end MEASUREMENT
/begin MEASUREMENT FMO_qASMod "" SWORD InjMass 1 100 -327.6800 327.6700 ECU_ADDRESS 0xD0000AFA /end MEASUREMENT
/begin MEASUREMENT HCUn_dqDem "HC Gesamtmenge" SLONG HCMassPerTime 1 100 -214748364.800 214748364.700 FORMAT "%13.3" ECU_ADDRESS 0xD0002EE8 /end MEASUREMENT
/begin MEASUREMENT InjCrv_phiMI1DesB1 "gewünschter Bezugswinkel für den Beginn der MI1 für Bank 1" SWORD AngleCrS 1 100 -720.0000 719.9780 ECU_ADDRESS 0xD0000E1E /end MEASUREMENT
/begin MEASUREMENT InjCrv_phiMI1DesB2 "gewünschter Bezugswinkel für den Beginn der MI1 für Bank 2" SWORD AngleCrS 1 100 -720.0000 719.9780 ECU_ADDRESS 0xD0000E20 /end MEASUREMENT
/begin MEASUREMENT NSC_stRM "" UBYTE OneToOne 1 100 0.00 255.0 ECU_ADDRESS 0xD0001FE4 /end MEASUREMENT
/begin MEASUREMENT NSC_stRMB1 "" UBYTE OneToOne 1 100 0.00 255.0 ECU_ADDRESS 0xD0001FE5 /end MEASUREMENT
/begin MEASUREMENT NSC_stRMB2 "" UBYTE OneToOne 1 100 0.00 255.0 ECU_ADDRESS 0xD0001FE6 /end MEASUREMENT
/begin MEASUREMENT ThrVlv_rActB1 "" SWORD DtyCyc 1 100 -327.6800 327.6700 ECU_ADDRESS 0xD00013EC /end MEASUREMENT
/begin MEASUREMENT ThrVlv_rActB2 "" SWORD DtyCyc 1 100 -327.6800 327.6700 ECU_ADDRESS 0xD00013EE /end MEASUREMENT
/begin MEASUREMENT TrbCh_rActB1 "" SWORD Prc 1 100 -400.0000 399.9878 ECU_ADDRESS 0xD0001422 /end MEASUREMENT
/begin MEASUREMENT TrbCh_rActB2 "" SWORD Prc 1 100 -400.0000 399.9878 ECU_ADDRESS 0xD0001424 /end MEASUREMENT
/begin MEASUREMENT VSwVlv_rB1 "Sollwert aus dem ASW ( fuer Bank1 in zweiflutigem System)." SWORD Prc 1 100 -400.0000 399.9878 ECU_ADDRESS 0xD000148A /end MEASUREMENT
/begin MEASUREMENT VSwVlv_rB2 "Sollwert aus dem ASW ( fuer Bank2 in zweiflutigem System)." SWORD Prc 1 100 -400.0000 399.9878 ECU_ADDRESS 0xD000148C /end MEASUREMENT
/begin FUNCTION APP_SelSig ""
 /begin DEF_CHARACTERISTIC APP_duLimErr.Pos_C APP_duLimErr.Neg_C APP_uAPPDef_C APP_uRaw2Offset_C /end DEF_CHARACTERISTIC
 /begin IN_MEASUREMENT MoFAPP_stLimpMsg /end IN_MEASUREMENT
 /begin LOC_MEASUREMENT APP_stTempErr_mp /end LOC_MEASUREMENT
/end FUNCTION
/begin FUNCTION APP_VD ""
 /begin DEF_CHARACTERISTIC APP_dRawSigFac_C APP_rLinAPP_CUR APP_rThresFltLowNeg_C APP_rThresFltLowPos_C APP_rThresFltMidNeg_C APP_rThresFltMidPos_C APP_swtEnaUnJit_C APP_swtNoFlt_C APP_swtStepLim_C APP_tidrPT1Flt_C APP_tiLowNegPT1_C APP_tiLowPosPT1_C APP_tiMidNegPT1_C APP_tiMidPosPT1_C APP_tiUppNegPT1_C APP_tiUppPosPT1_C APP_uJitter_C APP_uRaw1Def_C APP_uRaw2Def_C /end DEF_CHARACTERISTIC
 /begin IN_MEASUREMENT Brk_st Clth_st /end IN_MEASUREMENT
 /begin OUT_MEASUREMENT APP_drFlt APP_drUnFlt APP_r APP_rUnFlt APP_stKD APP_stPlaBrk APP_stPlaBrkPres APP_stPlaBrkTrq APP_stSigSrc APP_uRaw1 APP_uRaw2 /end OUT_MEASUREMENT
 /begin LOC_MEASUREMENT APP_rFltUnLim_mp APP_rFlt_mp APP_rNextThres_mp APP_rStepLim_mp APP_stPos_mp APP_uRaw1unLim_mp APP_uRaw2unLim_mp APP_uRaw_mp APP_uUnJit_mp /end LOC_MEASUREMENT
/end FUNCTION
/begin FUNCTION ASDdc_Governor ""
 /begin DEF_CHARACTERISTIC ASDdc_stLADOff_C ASDdc_swtIniParSet_C ASDdc_trqLimMax_C ASDdc_trqLimMin_C ASDdc_vLimIni_C /end DEF_CHARACTERISTIC
 /begin IN_MEASUREMENT ASDrf_stLAD ASDrf_stPosNeg CoEng_st Epm_nEng PthSet_stOvrRun PthSet_trqASDdcInit VehV_v /end IN_MEASUREMENT
 /begin OUT_MEASUREMENT ASDdc_trq /end OUT_MEASUREMENT
 /begin LOC_MEASUREMENT ASDdc_KdGovCurr_mp ASDdc_stReIni_mp ASDdc_T1GovCurr_mp ASDdc_trqUnLtd_mp /end LOC_MEASUREMENT
/end FUNCTION
/begin FUNCTION ASDdc_SelectParameter ""
 /begin DEF_CHARACTERISTIC ASDdc_GovClth.T1_C ASDdc_GovClth.Kd_C ASDdc_GovExtIntv.T1_C ASDdc_GovExtIntv.Kd_C ASDdc_GovGrip.T1_GMAP ASDdc_GovGrip.Kd_GMAP ASDdc_GovSt3.T1_GMAP ASDdc_GovSt3.Kd_GMAP ASDdc_GovSt4.T1_C ASDdc_GovSt4.Kd_C ASDdc_nEngGovGrip_Y_AXIS ASDdc_numDflSt_C ASDdc_numPrio_CA ASDdc_rClthGripThres_C ASDdc_rGripThres1_C ASDdc_rGripThres2_C ASDdc_rGripThres3_C ASDdc_rGripThres4_C ASDdc_rTra_X_AXIS ASDdc_stCfgConExtIntv_C ASDdc_stClthGrip_C ASDdc_stExtIntv_C ASDdc_stGearSwt_C ASDdc_stGrip1_C ASDdc_stGrip2_C ASDdc_stGrip3_C ASDdc_stGrip4_C ASDdc_stGripRaw_C ASDdc_swtCalcN_C ASDdc_swtFolDyn_C ASDdc_swtOpr_C /end DEF_CHARACTERISTIC
 /begin IN_MEASUREMENT ASDdc_trq Com_stFolDyn Epm_nEng GlbDa_stTrqDem PT_rGrip PT_rTraGear PT_stGrip PT_stTraShftOp SpdGov_nSetPLo /end IN_MEASUREMENT
 /begin LOC_MEASUREMENT ASDdc_nEngParSel_mp ASDdc_rTraParSel_mp ASDdc_stClthGrip_mp ASDdc_stCon_mp ASDdc_stPrioSt_mp ASDdc_stSelSt_mp ASDdc_stVldSt_mp /end LOC_MEASUREMENT
/end FUNCTION
/begin FUNCTION ASDrf_Governor ""
 /begin DEF_CHARACTERISTIC ASDrf_CoefBLimNegHysHi_C ASDrf_CoefBLimNegHysLo_C ASDrf_CoefBLimPosHysHi_C ASDrf_CoefBLimPosHysLo_C ASDrf_dtrqSwtLimOff_C ASDrf_KpLAD2PGovNeg_C ASDrf_KpLAD2PGovPos_C ASDrf_nLAD2NoImp_C ASDrf_phiLAD2IMax_C ASDrf_phiLAD2IMin_C ASDrf_swtCalcTrq_C ASDrf_swtDeComp_C ASDrf_swtFrzLos_C ASDrf_swtLim_C ASDrf_swtSpdGovCor_C ASDrf_tiLAD2ActvPGovNeg_C ASDrf_tiLAD2ActvPGovPos_C ASDrf_tiLAD2DeActvPGovNeg_C ASDrf_tiLAD2DeActvPGovPos_C ASDrf_trqLAD1OfsNegHi_C ASDrf_trqLAD1OfsNegLo_C ASDrf_trqLAD1OfsNegMid_C ASDrf_trqLAD1OfsPosHi_C ASDrf_trqLAD1OfsPosLo_C ASDrf_trqLAD1OfsPosMid_C ASDrf_trqLAD2BlwLimPosHi_C ASDrf_trqLAD2BlwLimPosLo_C ASDrf_trqLAD2OfsNegHi_C ASDrf_trqLAD2OfsNegLo_C ASDrf_trqLAD2OfsNegMid_C ASDrf_trqLAD2OfsPosHi_C ASDrf_trqLAD2OfsPosLo_C ASDrf_trqLAD2OfsPosMid_C ASDrf_trqLAD2PGovMax_C ASDrf_trqLAD2PGovMin_C ASDrf_trqSteepNeg_C ASDrf_trqSteepPos_C ASDrf_trqThresNeg_C ASDrf_trqThresPos_C /end DEF_CHARACTERISTIC
 /begin IN_MEASUREMENT ASDdc_trq ASDrf_facLAD2EngNNeg ASDrf_facLAD2EngNPos ASDrf_nLAD2SetPNeg ASDrf_nLAD2SetPPos ASDrf_stLADMode ASDrf_trqLosNeg ASDrf_trqLosPos CoETS_bFltDemSet CoETS_trqInrLimSet CoETS_trqInrLtd CoETS_trqInrSetSlow Conv_nTrbn Epm_nEng PthSet_stOvrRun PthSet_trqASDrfInit SpdGov_trqSet /end IN_MEASUREMENT
 /begin OUT_MEASUREMENT ASDrf_stIni ASDrf_stLAD ASDrf_stPosNeg ASDrf_trqInrSet /end OUT_MEASUREMENT
 /begin LOC_MEASUREMENT ASDrf_CoefALADCurr_mp ASDrf_CoefBLADCurr_mp ASDrf_dtrqDeComp_mp ASDrf_dtrqMax_mp ASDrf_dtrqMin_mp ASDrf_facLAD2EngN_mp ASDrf_KdFltCurr_mp ASDrf_nEngCor_mp ASDrf_phiLAD2I_mp ASDrf_stCoefBNegHi_mp ASDrf_stCoefBNoLimNeg_mp ASDrf_stCoefBNoLimPos_mp ASDrf_stCoefBPosHi_mp ASDrf_stIniSteepIn_mp ASDrf_stTrqLim_mp ASDrf_T1FltCurr_mp ASDrf_trqASDSumK1_mp ASDrf_trqASDSum_mp ASDrf_trqDeCompCor_mp ASDrf_trqDeCompOfs_mp ASDrf_trqIni_mp ASDrf_trqInrSetMaxUnLtd_mp ASDrf_trqInrSetMax_mp ASDrf_trqInrSetMinUnLtd_mp ASDrf_trqInrSetMin_mp ASDrf_trqInrSetUnLtd_mp ASDrf_trqLAD2PGov_mp ASDrf_trqLos_mp ASDrf_trqPT1In_mp ASDrf_trqPT1Out_mp ASDrf_trqPT1P_mp ASDrf_trqP_mp ASDrf_trqSpdGovCor_mp /end LOC_MEASUREMENT
/end FUNCTION
/begin FUNCTION ASDrf_SelectParameter ""
 /begin DEF_CHARACTERISTIC ASDrf_facDyn_X_AXIS ASDrf_facLAD2ClthEngNNeg_C ASDrf_facLAD2ClthEngNPos_C ASDrf_facLAD2GripEngNNeg_GCUR ASDrf_facLAD2GripEngNPos_GCUR ASDrf_facLAD2St0EngNNeg_C ASDrf_facLAD2St0EngNPos_C ASDrf_facLAD2St3EngNNeg_GCUR ASDrf_facLAD2St3EngNPos_GCUR ASDrf_facLAD2St4EngNNeg_C ASDrf_facLAD2St4EngNPos_C ASDrf_FltClthNeg.T1_C ASDrf_FltClthNeg.Kd_C ASDrf_FltClthPos.T1_C ASDrf_FltClthPos.Kd_C ASDrf_FltGripNeg.T1_GMAP ASDrf_FltGripNeg.Kd_GMAP ASDrf_FltGripPos.T1_GMAP ASDrf_FltGripPos.Kd_GMAP ASDrf_FltSt0Neg.T1_C ASDrf_FltSt0Neg.Kd_C ASDrf_FltSt0Pos.T1_C ASDrf_FltSt0Pos.Kd_C ASDrf_FltSt3Neg.T1_GMAP ASDrf_FltSt3Neg.Kd_GMAP ASDrf_FltSt3Pos.T1_GMAP ASDrf_FltSt3Pos.Kd_GMAP ASDrf_FltSt4Neg.T1_C ASDrf_FltSt4Neg.Kd_C ASDrf_FltSt4Pos.T1_C ASDrf_FltSt4Pos.Kd_C ASDrf_FltSt4Pos.ASDrf_swtFolDyn_C ASDrf_LADClthNeg.CoefA_C ASDrf_LADClthNeg.CoefB_C ASDrf_LADClthPos.CoefA_C ASDrf_LADClthPos.CoefB_C ASDrf_LADGripFacNeg.facCoefA_GCUR ASDrf_LADGripFacNeg.facCoefB_GCUR ASDrf_LADGripFacPos.facCoefA_GCUR ASDrf_LADGripFacPos.facCoefB_GCUR ASDrf_LADGripNeg.CoefA_GMAP ASDrf_LADGripNeg.CoefB_GMAP ASDrf_LADGripPos.CoefA_GMAP ASDrf_LADGripPos.CoefB_GMAP ASDrf_LADSt0Neg.CoefA_C ASDrf_LADSt0Neg.CoefB_C ASDrf_LADSt0Pos.CoefA_C ASDrf_LADSt0Pos.CoefB_C ASDrf_LADSt3FacNeg.facCoefA_GCUR ASDrf_LADSt3FacNeg.facCoefB_GCUR ASDrf_LADSt3FacPos.facCoefA_GCUR ASDrf_LADSt3FacPos.facCoefB_GCUR ASDrf_LADSt3Neg.CoefA_GMAP ASDrf_LADSt3Neg.CoefB_GMAP ASDrf_LADSt3Pos.CoefA_GMAP ASDrf_LADSt3Pos.CoefB_GMAP ASDrf_LADSt4Neg.CoefA_C ASDrf_LADSt4Neg.CoefB_C ASDrf_LADSt4Pos.CoefA_C ASDrf_LADSt4Pos.CoefB_C ASDrf_nEngFltGripNeg_Y_AXIS ASDrf_nEngFltGripPos_Y_AXIS ASDrf_nEngFltSt3Neg_Y_AXIS ASDrf_nEngFltSt3Pos_Y_AXIS ASDrf_nEngLADGripNeg_Y_AXIS ASDrf_nEngLADGripPos_Y_AXIS ASDrf_nEngLADSt3Neg_Y_AXIS ASDrf_nEngLADSt3Pos_Y_AXIS ASDrf_nLAD2SetPNeg_GCUR ASDrf_nLAD2SetPPos_GCUR ASDrf_numDflSt_C ASDrf_numEngTemp_C ASDrf_numPrio_CA ASDrf_rGripThres1_C ASDrf_rGripThres2_C ASDrf_rGripThres3_C ASDrf_rGripThres4_C ASDrf_rTra_X_AXIS ASDrf_stCfgConExtIntv_C ASDrf_stEntcClth_C ASDrf_stEntcGrip_C ASDrf_stEntcSt0_C ASDrf_stEntcSt3_C ASDrf_stEntcSt4_C ASDrf_stExClth_C ASDrf_stExGrip_C ASDrf_stExSt0_C ASDrf_stExSt3_C ASDrf_stExSt4_C ASDrf_stExtIntv_C ASDrf_stGrip1_C ASDrf_stGrip2_C ASDrf_stGrip3_C ASDrf_stGrip4_C ASDrf_stGrip_C ASDrf_swtFolDyn_C ASDrf_swtLADMode_CA ASDrf_swtLosCalc_C ASDrf_swtOpr_C ASDrf_tiPT1DesDynFltNeg_C ASDrf_tiPT1DesDynFltPos_C ASDrf_trqClthOfsLosNeg_C ASDrf_trqClthOfsLosPos_C ASDrf_trqGripOfsLosNeg_CUR ASDrf_trqGripOfsLosPos_CUR ASDrf_trqLos_MAP ASDrf_trqSt0OfsLosNeg_C ASDrf_trqSt0OfsLosPos_C ASDrf_trqSt3OfsLosNeg_CUR ASDrf_trqSt3OfsLosPos_CUR ASDrf_trqSt4OfsLosNeg_C ASDrf_trqSt4OfsLosPos_C /end DEF_CHARACTERISTIC
 /begin IN_MEASUREMENT ASDrf_stPosNeg Com_stFolDyn CoPT_facDesDyn EngDa_tFld Epm_nEng GlbDa_stTrqDem PT_rGrip PT_rTraGear RngMod_trqClthMin RngMod_trqLosAdap /end IN_MEASUREMENT
 /begin OUT_MEASUREMENT ASDrf_facLAD2EngNNeg ASDrf_facLAD2EngNPos ASDrf_nLAD2SetPNeg ASDrf_nLAD2SetPPos ASDrf_stLADMode ASDrf_trqLosNeg ASDrf_trqLosPos /end OUT_MEASUREMENT
 /begin LOC_MEASUREMENT ASDrf_facDesDynFlt_mp ASDrf_rTraParSel_mp ASDrf_stCon_mp ASDrf_stPrioSt_mp ASDrf_stSelSt_mp ASDrf_stVldSt_mp ASDrf_tEngLos_mp ASDrf_trqLosMap_mp ASDrf_trqOfsLosNeg_mp ASDrf_trqOfsLosPos_mp /end LOC_MEASUREMENT
/end FUNCTION
/begin FUNCTION ASD_Axispoints "" /end FUNCTION
/begin FUNCTION ASD_AxispointsCust "" /end FUNCTION
/begin FUNCTION ASD_Lib "" /end FUNCTION
/begin FUNCTION ASMod_Adapt ""
 /begin DEF_CHARACTERISTIC AFS_dmB1_C AFS_dmB2_C AFS_mAirPerCylB1_C AFS_mAirPerCylB2_C AirCtl_mDesBasB1_C AirCtl_mDesBasB2_C AirCtl_mDesBas_C Air_tAirFldB1_C Air_tAirFldB2_C Air_tCACDsB1_C Air_tCACDsB2_C ASMod_nHPTrbn_C ASMod_nLPTrbn_C ECBVlvLP_r_C ECBVlv_rB1_C ECBVlv_rB2_C EGRVlvLP_rAct_C EGRVlv_rActB1_C EGRVlv_rActB2_C ETCtl_dmHC_C Exh_pAdapPPFltDiffB1_C Exh_pAdapPPFltDiffB2_C Exh_pPFltUsB1_C Exh_pPFltUsB2_C Exh_tPFltUsB1_C Exh_tPFltUsB2_C HCUn_dqDem_C InjCrv_phiMI1DesB1_C InjCrv_phiMI1DesB2_C NSC_stRMB1_C NSC_stRMB2_C NSC_stRM_C ThrVlv_rActB1_C ThrVlv_rActB2_C TrbCh_rActB1_C TrbCh_rActB2_C VSwVlv_rB1_C VSwVlv_rB2_C /end DEF_CHARACTERISTIC
 /begin IN_MEASUREMENT EGRVlvLP_rAct /end IN_MEASUREMENT
 /begin OUT_MEASUREMENT AFS_dmB1 AFS_dmB2 AFS_mAirPerCylB1 AFS_mAirPerCylB2 Air_tCACDsB1 Air_tCACDsB2 ASMod_nHPTrbn ASMod_nLPTrbn ASMod_tNSCDs ECBVlvLP_r ECBVlv_rB1 ECBVlv_rB2 EGRVlv_rActB1 EGRVlv_rActB2 ETCtl_dmHC ExhFlpLP_r Exh_pAdapPPFltDiffB1 Exh_pAdapPPFltDiffB2 Exh_pPFltUsB1 Exh_pPFltUsB2 Exh_tPFltUsB1 Exh_tPFltUsB2 FMO_qASMod HCUn_dqDem InjCrv_phiMI1DesB1 InjCrv_phiMI1DesB2 NSC_stRM NSC_stRMB1 NSC_stRMB2 ThrVlv_rActB1 ThrVlv_rActB2 TrbCh_rActB1 TrbCh_rActB2 VSwVlv_rB1 /end OUT_MEASUREMENT
 /begin LOC_MEASUREMENT VSwVlv_rB2 /end LOC_MEASUREMENT
/end FUNCTION
/begin FUNCTION ASMod_AxisPoints "" /end FUNCTION
/begin FUNCTION ASMod_AxispointsCust "" /end FUNCTION
/begin FUNCTION ASMod_Cmpr ""
 /begin DEF_CHARACTERISTIC ASMod_cpCmpr_C ASMod_etaCmpr_MAP ASMod_facBrickCmpr_C ASMod_facEnvPresCmpr_CUR ASMod_facPresLsCmprDs_C ASMod_facPresTotCorDs_C ASMod_facPresTotCorUs_C ASMod_facSpdCmprEnv_CUR ASMod_facTempCmprEnv_CUR ASMod_htcCmprEnv_C ASMod_nTrbChRed_MAP ASMod_pCmprUsRef_C ASMod_swtTempCmprUs_C ASMod_tCmprUsRef_C ASMod_TempCmprI.Ki_C ASMod_TempCmprI.KiPos_C ASMod_TempCmprI.KiNeg_C ASMod_TempCmprI.WinPos_C ASMod_TempCmprI.WinNeg_C ASMod_tiCmprEnvPT1_C /end DEF_CHARACTERISTIC
 /begin REF_CHARACTERISTIC ASMod_rTempAdbt_CUR ASMod_tInit_C HESrv_swtScndFlwActv_C /end REF_CHARACTERISTIC
 /begin IN_MEASUREMENT Air_tAFS ASMod_dmAFSCor ASMod_dmCmprUs_r32 ASMod_nLPTrbCh_r32 ASMod_pCmprUs_r32 ASMod_pIndVol ASMod_stInit ASMod_tCACDs ASMod_tCmprUs_r32 ASMod_tExhMnfDs ASMod_tHPCmprDs CoEng_st EngDa_tEng EnvT_t PCR_swtBstLPActv VehV_v /end IN_MEASUREMENT
 /begin OUT_MEASUREMENT ASMod_dmCmprUsRed ASMod_etaCmpr ASMod_etaCmpr_r32 ASMod_nTrbCh ASMod_nTrbCh_r32 ASMod_pCmprDsTot_r32 ASMod_pCmprUsTot_r32 ASMod_rPresCmprFMod ASMod_tCmprDs ASMod_tCmprEnv ASMod_tCmprSurf ASMod_tCmprUsSlct_r32 /end OUT_MEASUREMENT
 /begin LOC_MEASUREMENT ASMod_dmCmprUsRed_mp ASMod_dtCmprSurf_mp ASMod_dtCmpr_mp ASMod_dwAirCmpr_mp ASMod_dwCmprSurf_mp ASMod_dwCmpr_mp ASMod_dwGsCmprSurf_mp ASMod_facEnvPresCmpr_mp ASMod_htcCmprEnv_mp ASMod_nTrbChRed_mp ASMod_pCmprDsDyn_mp ASMod_pCmprDs_mp ASMod_pCmprUsDyn_mp ASMod_rPresCmprFMod_mp ASMod_rTempAdbtCmpr_mp ASMod_tCmprAdbtDs_mp ASMod_tCmprEnv_mp /end LOC_MEASUREMENT
/end FUNCTION
/begin FUNCTION ASMod_Co ""
 /begin DEF_CHARACTERISTIC ASMod_cpGs_C ASMod_nThresDwn_C ASMod_numBnk_C ASMod_numEnvPres_C ASMod_numExhMnfLPDs_C ASMod_numExhMnfLPUs_C ASMod_numExhMnfLP_C ASMod_numMixPntEGDs_C ASMod_numMixPntEGUs_C ASMod_numOxiCDs_CA ASMod_numOxiCUs_CA ASMod_numPFltDs_C ASMod_numPFltUs_C ASMod_numTrbnDs_C ASMod_numTrbn_C ASMod_pInit_C ASMod_rECBLin_CUR ASMod_rECBLPLin_CUR ASMod_rEGRLPLin_CUR ASMod_rExhFlpLPLin_CUR ASMod_rTVALin_CUR ASMod_rVSALin_CUR ASMod_swtAFSSimSel_C ASMod_swtCalcQntInjCmb_C ASMod_swtCalcQntInjNoCmb_C ASMod_swtQntHCEmi_C ASMod_tInit_C ASMod_tiRelPosECBLPPT1_C ASMod_tiRelPosECBPT1_C ASMod_tiRelPosEGRLPPT1_C ASMod_tiRelPosExhFlpLPPT1_C ASMod_tiRelPosTVAPT1_C ASMod_tiRelPosVSAPT1_C /end DEF_CHARACTERISTIC
 /begin IN_MEASUREMENT AFS_dm AFS_dmComp AFS_mAirPerCyl Air_tCACDs ASMod_dmAFSSim ECBVlvLP_r ECBVlv_r EGRVlvLP_rAct Epm_nEng ExhFlpLP_r FMO_qASMod InjCtl_qSetUnBal InjSys_qHCEmi InjSys_qPoIHCEmi InjSys_qTot ThrVlv_r VSwVlv_rAct /end IN_MEASUREMENT
 /begin OUT_MEASUREMENT ASMod_dmAFSCor ASMod_dmEGFld ASMod_pEGFld ASMod_qInjCmb ASMod_qInjNoCmb ASMod_rLamRecDfl ASMod_rNOxEGFld ASMod_rO2EGFld ASMod_rRelPosECB ASMod_rRelPosECBLP ASMod_rRelPosEGRLP ASMod_rRelPosExhFlpLP ASMod_rRelPosTVA ASMod_rRelPosVSA ASMod_stFIdASModAFSok ASMod_stInit ASMod_tCACDs ASMod_tEGFld ASMod_tIntMnfUs ASMod_tWallFld /end OUT_MEASUREMENT
 /begin LOC_MEASUREMENT ASMod_rECBLinCrvIn_mp ASMod_rECBLPLinCrvIn_mp ASMod_rEGRLPLinCrvIn_mp ASMod_rExhFlpLPLinCrvIn_mp ASMod_rRelPosEGRLPNoCor_mp ASMod_rRelPosExhFlpLPNoCor_mp ASMod_rTVALinCrvIn_mp ASMod_rVSALinCrvIn_mp /end LOC_MEASUREMENT
/end FUNCTION
/begin FUNCTION ASMod_DetCylCh ""
 /begin DEF_CHARACTERISTIC ASMod_dmEGRActSwt_C ASMod_dmEGRSimSwt_C ASMod_EGRThr.rPresCrit_C ASMod_EGRThr.facFlwCrit_C ASMod_EGRThr.rPresLin_C ASMod_EGRThr.facSlpLin_C ASMod_etaEGRClg_MAP ASMod_facEGRClgEtaCor_CUR ASMod_swtAFSSim_C ASMod_swtEGRClgDsMin_C ASMod_swtEGRMsFlwSim_C ASMod_swtPIntkVUs_C ASMod_swtTEGRThrVlvUs_C ASMod_tEGRDsMin_C ASMod_tiPT1pIntMnf_CUR ASMod_tiTempEGRDsPT1_C /end DEF_CHARACTERISTIC
 /begin REF_CHARACTERISTIC ASMod_numMixPntEGDs_C ASMod_numMixPntEGUs_C ASMod_tInit_C /end REF_CHARACTERISTIC
 /begin IN_MEASUREMENT Air_pIntkVUs Air_pUnFltPIntkVUs ASMod_arEffEGRVlv_r32 ASMod_dmEGRLPDs ASMod_dmExhMnfUs ASMod_dmIntMnfUs ASMod_dvolIntMnfDsRef ASMod_pCmprDsTot_r32 ASMod_pCmprUsTot_r32 ASMod_pTrbnUs_r32 ASMod_rO2ExhMnfUs ASMod_rO2IntMnfUs_r32 ASMod_rRelPosECB ASMod_stFIdASModAFSok ASMod_stInit ASMod_tIntMnfUs ASMod_tTrbnUs EngDa_tEng Epm_nEng Epm_numCyl /end IN_MEASUREMENT
 /begin OUT_MEASUREMENT ASMod_dmAFSSim ASMod_dmEGRAct ASMod_dmEGRDs ASMod_dmExhMnfDs ASMod_dmExhMnfDs_r32 ASMod_dmIntMnfDs ASMod_dmO2IntMnfDs ASMod_etaEGRClg ASMod_mEGRIntMnfDsCmb ASMod_pIntMnf_r32 ASMod_rEGR ASMod_rLamRecExhMnfDs ASMod_rO2ExhMnfDs ASMod_stFIdASModT20ok ASMod_tEGRDs ASMod_tEGRThrVlvUs_r32 ASMod_tExhMnfDs ASMod_tIntMnfDs ASMod_tIntMnfDs_r32 ASMod_tMixPntEGUs /end OUT_MEASUREMENT
 /begin LOC_MEASUREMENT ASMod_dmEGRSimRaw_mp ASMod_dmEGRSim_mp ASMod_dmEGR_mp ASMod_etaEGRClgCor_mp ASMod_facEGRClgEtaCor_mp ASMod_pCmprDiff_mp ASMod_pIntMnf_mp ASMod_rO2IntMnfDs_mp ASMod_rO2IntMnfUs_mp ASMod_tDiffEGRClg_mp ASMod_tiPT1pIntMnf_mp ASMod_tMixPntEGDs_mp /end LOC_MEASUREMENT
/end FUNCTION
/begin FUNCTION ASMod_EGRErrMod ""
 /begin DEF_CHARACTERISTIC ASMod_AirEGR.rPresCrit_C ASMod_AirEGR.facFlwCrit_C ASMod_AirEGR.rPresLin_C ASMod_AirEGR.facSlpLin_C ASMod_arEffEGRVlv_CUR ASMod_dnRlsEGRLrnHigh_C ASMod_dnRlsEGRLrnLow_C ASMod_dqRlsEGRLrnHigh_C ASMod_dqRlsEGRLrnLow_C ASMod_nRlsEGRLrnHigh_C ASMod_nRlsEGRLrnLow_C ASMod_qRlsEGRLrnHigh_C ASMod_qRlsEGRLrnLow_C ASMod_rRlsPresEGRDiffMin_C ASMod_stMskOpModeRlsEGRLrn_C /end DEF_CHARACTERISTIC
 /begin IN_MEASUREMENT AirCtl_stMon ASMod_dmEGRAct ASMod_pIntMnf_r32 ASMod_pTrbnUs ASMod_rPresEGRDiff ASMod_tEGRThrVlvUs_r32 ASMod_tIntMnfDs_r32 CoEOM_stOpModeAct EGRVlv_rAct Epm_dnEngFlt Epm_nEng InjCtl_dqLead InjCtl_qCurr /end IN_MEASUREMENT
 /begin OUT_MEASUREMENT ASMod_arEffEGRVlv_r32 ASMod_pTrbnUs_r32 /end OUT_MEASUREMENT
 /begin LOC_MEASUREMENT ASMod_arEffEGRDes_mp ASMod_arEffEGRDiff_mp ASMod_rEGRActVal_mp ASMod_stEnaEGRLrnBits_mp ASMod_stEnaEGRLrn_mp /end LOC_MEASUREMENT
/end FUNCTION
/begin FUNCTION ASMod_EGRLP ""
 /begin DEF_CHARACTERISTIC ASMod_arEffEGRLP_CUR ASMod_EGRLPThr.rPresCrit_C ASMod_EGRLPThr.facFlwCrit_C ASMod_EGRLPThr.rPresLin_C ASMod_EGRLPThr.facSlpLin_C ASMod_etaEGRClgLP_MAP ASMod_facPresLsEGRClgLP_CUR ASMod_MsFlwEGRLPPT1.tiUp_C ASMod_MsFlwEGRLPPT1.tiDwn_C ASMod_tEGRLPDsMin_C ASMod_TempEGRLPDsPT1.tiUp_C ASMod_TempEGRLPDsPT1.tiDwn_C /end DEF_CHARACTERISTIC
 /begin REF_CHARACTERISTIC HESrv_swtScndFlwActv_C /end REF_CHARACTERISTIC
 /begin IN_MEASUREMENT ASMod_pCmprUs_r32 ASMod_pEGFld ASMod_rRelPosECBLP ASMod_rRelPosEGRLP ASMod_stInit ASMod_tEGFld EngDa_tEng EnvT_t /end IN_MEASUREMENT
 /begin OUT_MEASUREMENT ASMod_arEffEGRLPCor ASMod_dmEGRLPDs ASMod_dmEGRLPDs_r32 ASMod_pEGRLPDs_r32 ASMod_tEGRLPDs ASMod_tEGRLPDs_r32 /end OUT_MEASUREMENT
 /begin LOC_MEASUREMENT ASMod_arEffEGRLP_mp ASMod_dmEGRLPDsRaw_mp ASMod_etaEGRClgLP1_MapIn_mp ASMod_etaEGRClgLP2_MapIn_mp ASMod_etaEGRClgLP_mp ASMod_facPresLsEGRClgLP_mp ASMod_pLsEGRClgLP_mp ASMod_rEffEGRLP_CrvIn_mp ASMod_rPresLsEGRClgLP_CrvIn_mp ASMod_stNaNEGRLP_mp ASMod_tDiffEGRClgLP_mp /end LOC_MEASUREMENT
/end FUNCTION
/begin FUNCTION ASMod_Eng ""
 /begin DEF_CHARACTERISTIC ASMod_dmAshEG_CUR ASMod_dmIntMnfDsRef_MAP ASMod_dmNOxBasLM_MAP ASMod_dmNOxEGROff_MAP ASMod_dmOilConsBas_CUR ASMod_dmSotBasLM_MAP ASMod_dmSotLamCor_MAP ASMod_dmSotRatEGRCorBas_MAP ASMod_drLamRecMin_C ASMod_facDdT_C ASMod_facEGRDvtCorMax_C ASMod_facEGRDvtCorMin_C ASMod_facEGRDvtPOp_MAP ASMod_facEGRDvtWgh1_CUR ASMod_facEGRDvtWgh2_CUR ASMod_facEGTempMsFlwCor_CUR ASMod_facEGTempSOICor_CUR ASMod_facKdDT1LamSot_C ASMod_facLamRecRef_C ASMod_facOilConsLfTCor_CUR ASMod_facSotLfTCor_CUR ASMod_facSotRatEGRCor_CUR ASMod_numSotEOMPFltRgn_C ASMod_numSotLamCorEGROff_C ASMod_numSotLamCor_C ASMod_phiSOIRefRgn_MAP ASMod_phiSOIRef_MAP ASMod_qPoI1Ref_MAP ASMod_qPoI2Ref_MAP ASMod_rEGRCorOff_C ASMod_rEGRLamCorMax_C ASMod_rEGRLamCorMin_C ASMod_rEGRSetMin_C ASMod_rEGRSet_MAP ASMod_rLamRecRefBas_MAP ASMod_rLamRecRefMin_C ASMod_stMskPhiSOIRef_C ASMod_stMskTempDiffEng_C ASMod_stSotEmiEOMMsk_CA ASMod_tDiffEngBas_MAP ASMod_tDiffEngRgn_MAP ASMod_tEGEngTempCor_CUR ASMod_tEGPoI1Cor_CUR ASMod_tEGPoI2Cor_CUR ASMod_tEngRef_C ASMod_tiLamRecStatPT1_C ASMod_tiT1DT1LamSot_C /end DEF_CHARACTERISTIC
 /begin IN_MEASUREMENT AirCtl_stMon ASMod_dmIntMnfDs ASMod_dmO2IntMnfDs ASMod_qInjCmb ASMod_qInjNoCmb ASMod_rEGR ASMod_rLamRecDfl ASMod_stInit ASMod_tIntMnfDs CoEOM_stOpModeAct EngDa_tEng EngDa_tiEngOn Epm_ctCyl Epm_nEng Epm_numCyl FlSys_dvolFlCons InjCrv_phiMI1Des InjCrv_qPoI1Des InjCrv_qPoI2Des PthSet_trqInrSet VehV_v /end IN_MEASUREMENT
 /begin OUT_MEASUREMENT ASMod_dmAshEG ASMod_dmExhMnfUs ASMod_dmIntMnfDsRef ASMod_dmNOxEG ASMod_dmOilCons ASMod_dmSotEG ASMod_qDiffPoI1Ref ASMod_qDiffPoI2Ref ASMod_rFlEG ASMod_rLamRecEG ASMod_rNOxEG ASMod_rO2ExhMnfUs ASMod_tDiffEngBas ASMod_tExhMnfUs /end OUT_MEASUREMENT
 /begin LOC_MEASUREMENT ASMod_dmEGMgScnd_mp ASMod_dmEG_mp ASMod_dmFlBrn_mp ASMod_dmFlEG_mp ASMod_dmFlInjCmb_mp ASMod_dmFlInjNoCmb_mp ASMod_dmFlNoBrn_mp ASMod_dmNOxBasLM_mp ASMod_dmNOxDiffEGRRng_mp ASMod_dmNOxEGRCor_mp ASMod_dmNOxEGROff_mp ASMod_dmNOxLMEGRCor_mp ASMod_dmO2EG_mp ASMod_dmOilConsBas_mp ASMod_dmSotBasLM_mp ASMod_dmSotEngLM1_mp ASMod_dmSotEngLM2_mp ASMod_dmSotEngLM3_mp ASMod_dmSotEngLM_mp ASMod_dmSotLamCor_mp ASMod_dmSotRatEGRCorBas_mp ASMod_dmSotRatEGRCor_mp ASMod_drLamRec_mp ASMod_facEGRDvtLim_mp ASMod_facEGRDvtPOp_mp ASMod_facEGRDvtWgh1_mp ASMod_facEGRDvtWgh2_mp ASMod_facEGRDvt_mp ASMod_facEGTempMsFlwCor_mp ASMod_facEGTempSOICor_mp ASMod_facOilConsLfTCor_mp ASMod_facSotLfTCor_mp ASMod_facSotRatEGRCor_mp ASMod_lSumSotEmiEEP_mp ASMod_lSumVehAct_mp ASMod_lSumVehLfTSotEEP_mp ASMod_lSumVehLfTSot_mp ASMod_numSotEOM_mp ASMod_phiDiffSOIRef_mp ASMod_phiSOIRefRgn_mp ASMod_phiSOIRef_mp ASMod_qBrn_mp ASMod_qPoI1Ref_mp ASMod_qPoI2Ref_mp ASMod_rEGRDvtNrm_mp ASMod_rEGRDvtWghCrvIn_mp ASMod_rEGRDvt_mp ASMod_rEGRSet_mp ASMod_rFlBrn_mp ASMod_rLamRecDiffRef_mp ASMod_rLamRecEGFlt_mp ASMod_rLamRecRefBas_mp ASMod_rLamRecRefMin_mp ASMod_rLamRecRef_mp ASMod_rLamRecStat_mp ASMod_rMsFlwRef_mp ASMod_rO2EG_mp ASMod_rSotLamCorCrvIn1_mp ASMod_rSotLamCorCrvIn2_mp ASMod_rSotRatEGRCorCrvIn_mp ASMod_stCmpLamRecRef_mp ASMod_stDynRatLamRec_mp ASMod_stLamRecRef_mp ASMod_swtLamRecRef_mp ASMod_tDiffEG_mp ASMod_tDiffEngRef_mp ASMod_tDiffEngRgn_mp ASMod_tDiffEng_mp ASMod_tEGEngTempCor_mp ASMod_tEGPoI1Cor_mp ASMod_tEGPoI2Cor_mp ASMod_tEG_mp ASMod_tiDdT_mp ASMod_tiEngOn_mp /end LOC_MEASUREMENT
/end FUNCTION
/begin FUNCTION ASMod_ExhMnfLP ""
 /begin DEF_CHARACTERISTIC ASMod_arEffExhFlpLP_CUR ASMod_ExhMnfLPThr.rPresCrit_C ASMod_ExhMnfLPThr.facFlwCrit_C ASMod_ExhMnfLPThr.rPresLin_C ASMod_ExhMnfLPThr.facSlpLin_C ASMod_mExhMnfLPMin_C ASMod_MsFlwExhMnfLPPT1.tiUp_C ASMod_MsFlwExhMnfLPPT1.tiDwn_C ASMod_volExhMnfLP_C /end DEF_CHARACTERISTIC
 /begin REF_CHARACTERISTIC ASMod_numExhMnfLPDs_C ASMod_numExhMnfLPUs_C ASMod_numExhMnfLP_C ASMod_pInit_C ASMod_tInit_C HESrv_swtScndFlwActv_C /end REF_CHARACTERISTIC
 /begin IN_MEASUREMENT ASMod_dmAFSCor ASMod_dmEGFld ASMod_dmEGRLPDs_r32 ASMod_dmExhMnfDs_r32 ASMod_pEGFld ASMod_rO2EGFld ASMod_rRelPosExhFlpLP ASMod_stInit ASMod_tEGFld EnvT_t /end IN_MEASUREMENT
 /begin OUT_MEASUREMENT ASMod_mExhMnfLPInit_r32 ASMod_mExhMnfLP_r32 /end OUT_MEASUREMENT
 /begin LOC_MEASUREMENT ASMod_arEffExhFlpLP_mp ASMod_dmExhMnfLPDsRaw_mp ASMod_dmExhMnfLPDs_mp ASMod_dmExhMnfLP_mp ASMod_pExhMnfLP_mp ASMod_rExhMnfLPlp_CrvIn_mp ASMod_rO2ExhMnfLPDs_mp ASMod_stInitExhMnfLP_mp ASMod_stNaNExhMnfLP_mp ASMod_tExhMnfLPDs_mp ASMod_tExhMnfLP_mp /end LOC_MEASUREMENT
/end FUNCTION
/begin FUNCTION ASMod_GlbDef "" /end FUNCTION
/begin COMPU_METHOD AirMassPerCyl "" RAT_FUNC "%5.1" "mg/Hub" COEFFS 0 10 0 0 0 1 /end COMPU_METHOD
/begin COMPU_METHOD AirMassPerTime "" RAT_FUNC "%5.1" "Kg/h" COEFFS 0 10 0 0 0 1 /end COMPU_METHOD
/begin COMPU_METHOD AirMassPerTimeMgScnd "" RAT_FUNC "%6.3" "mg/s" COEFFS 0 10 0 0 0 1 /end COMPU_METHOD
/begin COMPU_METHOD AirMassPerTime_float "" RAT_FUNC "%6.2" "Kg/h" COEFFS 0 1 0 0 0 1 /end COMPU_METHOD
/begin COMPU_METHOD Airmass_float "" RAT_FUNC "%6.2" "g" COEFFS 0 1 0 0 0 1 /end COMPU_METHOD
/begin COMPU_METHOD AngleCrS "" RAT_FUNC "%6.3" "deg CrS" COEFFS 0 45.5111111111 0 0 0 1 /end COMPU_METHOD
/begin COMPU_METHOD Area_cm2 "" RAT_FUNC "%6.5" "cm*cm" COEFFS 0 1000 0 0 0 1 /end COMPU_METHOD
/begin COMPU_METHOD Area_cm2_float "" RAT_FUNC "%6.2" "cm*cm" COEFFS 0 1 0 0 0 1 /end COMPU_METHOD
/begin COMPU_METHOD ASDdc_GovDT1Kd_float "Umrechnungsformel: Kd in float" RAT_FUNC "%6.2" "(Nm/rpm)^0.5" COEFFS 0 1 0 0 0 1 /end COMPU_METHOD
/begin COMPU_METHOD ASDdc_GovDT1T1_float "Umrechnungsformel: T1 in float" RAT_FUNC "%6.2" "s" COEFFS 0 1 0 0 0 1 /end COMPU_METHOD
/begin COMPU_METHOD ASDdc_numDflSt "Verbale Umrechnungsformel: ""Default State""" TAB_VERB "%6.3" "" COMPU_TAB_REF ASDdc_numDflSt /end COMPU_METHOD
/begin COMPU_VTAB ASDdc_numDflSt "Verbale Umrechnungsformel: ""Default State""" TAB_VERB 5 0 "Grip" 1 "Clutch" 2 "ExtInt" 3 "State3" 4 "State4" /end COMPU_VTAB
/begin COMPU_METHOD ASDrf_Angle "Umrechnungformel: Winkel" RAT_FUNC "%6.3" "deg" COEFFS 0 10 0 0 0 1 /end COMPU_METHOD
/begin COMPU_METHOD ASDrf_dTrq_float "Umrechnungsformel: Drehmomentableitung float" RAT_FUNC "%6.2" "Nm/s" COEFFS 0 1 0 0 0 1 /end COMPU_METHOD
/begin COMPU_METHOD ASDrf_FltDT1Kd_float "Umrechnungsformel: Kd in float" RAT_FUNC "%6.2" "1/1" COEFFS 0 1 0 0 0 1 /end COMPU_METHOD
/begin COMPU_METHOD ASDrf_FltDT1T1_float "Umrechnungsformel: T1 in float" RAT_FUNC "%6.2" "s" COEFFS 0 1 0 0 0 1 /end COMPU_METHOD
/begin COMPU_METHOD ASDrf_Kp_rpm2Nm "Umrechnungformel: Verstärkung P-Anteil" RAT_FUNC "%8.7" "Nm/rpm" COEFFS 0 163840 0 0 0 1 /end COMPU_METHOD
/begin COMPU_METHOD ASDrf_LADCoefA "Umrechnungsformel: Parabelkoeffizient A" RAT_FUNC "%6.4" "1/(s*Nm)" COEFFS 0 204.8 0 0 0 1 /end COMPU_METHOD
/begin COMPU_METHOD ASDrf_LADCoefA_float "Umrechnungsformel: Parabelkoeffizient A in float" RAT_FUNC "%6.2" "1/(s*Nm)" COEFFS 0 1 0 0 0 1 /end COMPU_METHOD
/begin COMPU_METHOD ASDrf_LADMode "Verbale Umrechnungsformel: Betriebsmodus des Lastschlagdämpfers" TAB_VERB "%6.3" "" COMPU_TAB_REF ASDrf_LADMode /end COMPU_METHOD
/begin COMPU_VTAB ASDrf_LADMode "Verbale Umrechnungsformel: Betriebsmodus des Lastschlagdämpfers" TAB_VERB 3 0 "LAD off" 1 "LAD 1 (parabola)" 2 "LAD 2 (impulse)" /end COMPU_VTAB
/begin COMPU_METHOD ASDrf_numDflSt "Verbale Umrechnungsformel: ""Default State""" TAB_VERB "%6.3" "" COMPU_TAB_REF ASDrf_numDflSt /end COMPU_METHOD
/begin COMPU_VTAB ASDrf_numDflSt "Verbale Umrechnungsformel: ""Default State""" TAB_VERB 5 0 "State0" 1 "Clutch" 2 "Grip" 3 "State3" 4 "State4" /end COMPU_VTAB
/begin COMPU_METHOD AshEGMassPerTime "" RAT_FUNC "%6.5" "mg/s" COEFFS 0 2000 0 0 0 1 /end COMPU_METHOD
/begin COMPU_METHOD drLamRec_Persec "" RAT_FUNC "%6.4" "1/s" COEFFS 0 100 0 0 0 1 /end COMPU_METHOD
/begin COMPU_METHOD dTrq "" RAT_FUNC "%6.3" "Nm/s" COEFFS 0 10 0 0 0 1 /end COMPU_METHOD
/begin COMPU_METHOD DtyCyc "" RAT_FUNC "%5.2" "%" COEFFS 0 100 0 0 0 1 /end COMPU_METHOD
/begin COMPU_METHOD EngN "" RAT_FUNC "%5.1" "rpm" COEFFS 0 2 0 0 0 1 /end COMPU_METHOD
/begin COMPU_METHOD EngN1 "" RAT_FUNC "%6.3" "rpm" COEFFS 0 2 0 0 0 1 /end COMPU_METHOD
/begin COMPU_METHOD EngNGrd "" RAT_FUNC "%6.3" "rpm/s" COEFFS 0 2 0 0 0 1 /end COMPU_METHOD
/begin COMPU_METHOD EngTempFldSel "" TAB_VERB "%6.3" "" COMPU_TAB_REF EngTempFldSel /end COMPU_METHOD
/begin COMPU_VTAB EngTempFldSel "" TAB_VERB 4 0 "Coolant_Temperature" 1 "Oil_Temperature" 2 "EngDa_tEng" 3 "Chamberwall_Temperature" /end COMPU_VTAB
/begin COMPU_METHOD Fact "" RAT_FUNC "%6.5" "-" COEFFS 0 8192 0 0 0 1 /end COMPU_METHOD
/begin COMPU_METHOD Fact1 "" RAT_FUNC "%6.4" "-" COEFFS 0 128 0 0 0 1 /end COMPU_METHOD
/begin COMPU_METHOD Fact100 "" RAT_FUNC "%6.4" "-" COEFFS 0 100 0 0 0 1 /end COMPU_METHOD
/begin COMPU_METHOD FactPresLs_float "" RAT_FUNC "%6.2" "(hpa/(kg/h))^2/k" COEFFS 0 1 0 0 0 1 /end COMPU_METHOD
/begin COMPU_METHOD Fact_float "" RAT_FUNC "%6.2" "-" COEFFS 0 1 0 0 0 1 /end COMPU_METHOD
/begin COMPU_METHOD FlConsum_l_h "" RAT_FUNC "%6.4" "l/h" COEFFS 0 100 0 0 0 1 /end COMPU_METHOD
/begin COMPU_METHOD HCMassPerTime "" RAT_FUNC "%6.3" "mg/s" COEFFS 0 10 0 0 0 1 /end COMPU_METHOD
/begin COMPU_METHOD InjMass "" RAT_FUNC "%5.2" "mg/hub" COEFFS 0 100 0 0 0 1 /end COMPU_METHOD
/begin COMPU_METHOD InjMassPerTime "" RAT_FUNC "%6.4" "Kg/h" COEFFS 0 100 0 0 0 1 /end COMPU_METHOD
/begin COMPU_METHOD InjMassSec "" RAT_FUNC "%6.4" "mg/hub/s" COEFFS 0 100 0 0 0 1 /end COMPU_METHOD
/begin COMPU_METHOD Kd "" RAT_FUNC "%7.6" "1/1" COEFFS 0 65536 0 0 0 1 /end COMPU_METHOD
/begin COMPU_METHOD Kd16_sqr_rpm2Nm "" RAT_FUNC "%6.5" "(Nm/rpm)^0.5" COEFFS 0 1024 0 0 0 1 /end COMPU_METHOD
/begin COMPU_METHOD Kd_Lin_16 "" RAT_FUNC "%7.6" "1/1" COEFFS 0 32767 0 0 0 1 /end COMPU_METHOD
/begin COMPU_METHOD Ki_Kelv_Sec "" RAT_FUNC "%6.4" "1/s" COEFFS 0 214.7483648 0 0 0 1 /end COMPU_METHOD
/begin COMPU_METHOD lambdaRecVal "" RAT_FUNC "%6.5" "-" COEFFS 0 1000 0 0 0 1 /end COMPU_METHOD
/begin COMPU_METHOD Length "" RAT_FUNC "%6.2" "m" COEFFS 0 1 0 0 0 1 /end COMPU_METHOD
/begin COMPU_METHOD LengthKm "" RAT_FUNC "%6.1" "Km" COEFFS 0 0.05 0 0 0 1 /end COMPU_METHOD
/begin COMPU_METHOD NOxMassPerTime "" RAT_FUNC "%6.3" "mg/s" COEFFS 0 10 0 0 0 1 /end COMPU_METHOD
/begin COMPU_METHOD O2 "" RAT_FUNC "%6.5" "-" COEFFS 0 100000 0 0 0 1 /end COMPU_METHOD
/begin COMPU_METHOD O2MassPerTimeLo "" RAT_FUNC "%6.4" "Kg/h" COEFFS 0 50 0 0 0 1 /end COMPU_METHOD
/begin COMPU_METHOD OilMassPerTime "" RAT_FUNC "%7.6" "mg/s" COEFFS 0 10000 0 0 0 1 /end COMPU_METHOD
/begin COMPU_METHOD OneToOne "" RAT_FUNC "%6.0" "-" COEFFS 0 1 0 0 0 1 /end COMPU_METHOD
/begin COMPU_METHOD Pos_Prc_float "" RAT_FUNC "%6.2" "%" COEFFS 0 1 0 0 0 1 /end COMPU_METHOD
/begin COMPU_METHOD Prc "" RAT_FUNC "%6.4" "%" COEFFS 0 81.92 0 0 0 1 /end COMPU_METHOD
/begin COMPU_METHOD PrcPerSec_10ms "" RAT_FUNC "%6.2" "%/s" COEFFS 0 0.8192 0 0 0 1 /end COMPU_METHOD
/begin COMPU_METHOD Pres_hPa "" RAT_FUNC "%5.1" "hPa" COEFFS 0 1 0 0 0 1 /end COMPU_METHOD
/begin COMPU_METHOD Pres_hPa_float "" RAT_FUNC "%6.2" "hPa" COEFFS 0 1 0 0 0 1 /end COMPU_METHOD
/begin COMPU_METHOD Pwr1 "" RAT_FUNC "%6.3" "W" COEFFS 0 10 0 0 0 1 /end COMPU_METHOD
/begin COMPU_METHOD RatAirMass "" RAT_FUNC "%6.4" "-" COEFFS 0 100 0 0 0 1 /end COMPU_METHOD
/begin COMPU_METHOD RatFuelMass "" RAT_FUNC "%6.4" "-" COEFFS 0 100 0 0 0 1 /end COMPU_METHOD
/begin COMPU_METHOD RatNOxMass "" RAT_FUNC "%10.9" "-" COEFFS 0 10000000 0 0 0 1 /end COMPU_METHOD
/begin COMPU_METHOD RmpAirMassPerTime "" RAT_FUNC "%6.4" "Kg/h" COEFFS 0 655.36 0 0 0 1 /end COMPU_METHOD
/begin COMPU_METHOD RmpVolt "" RAT_FUNC "%6.4" "mV/s" COEFFS 0 327.68 0 0 0 1 /end COMPU_METHOD
/begin COMPU_METHOD SotMassPerTime "" RAT_FUNC "%6.4" "mg/s" COEFFS 0 100 0 0 0 1 /end COMPU_METHOD
/begin COMPU_METHOD SpecificHeat "" RAT_FUNC "%7.6" "J/g/K" COEFFS 0 10000 0 0 0 1 /end COMPU_METHOD
/begin COMPU_METHOD TempC_float "" RAT_FUNC "%6.1" "deg C" COEFFS 0 1 273.14 0 0 1 /end COMPU_METHOD
/begin COMPU_METHOD TempDiff_Kelv "" RAT_FUNC "%4.1" "K" COEFFS 0 10 0 0 0 1 /end COMPU_METHOD
/begin COMPU_METHOD TempK_float "" RAT_FUNC "%6.2" "K" COEFFS 0 1 0 0 0 1 /end COMPU_METHOD
/begin COMPU_METHOD Temp_Cels "" RAT_FUNC "%5.1" "deg C" COEFFS 0 10 2731.4 0 0 1 /end COMPU_METHOD
/begin COMPU_METHOD Temp_Kelv "" RAT_FUNC "%6.3" "K" COEFFS 0 10 0 0 0 1 /end COMPU_METHOD
/begin COMPU_METHOD Temp_Kelv_Sec "" RAT_FUNC "%6.4" "K/s" COEFFS 0 100 0 0 0 1 /end COMPU_METHOD
/begin COMPU_METHOD ThermalCoEff "" RAT_FUNC "%6.3" "W/m/m/k" COEFFS 0 10 0 0 0 1 /end COMPU_METHOD
/begin COMPU_METHOD Time100HrsEngOn "" RAT_FUNC "%6.2" "100h" COEFFS 0 1 0 0 0 1 /end COMPU_METHOD
/begin COMPU_METHOD TimeDeb "" RAT_FUNC "%5.0" "ms" COEFFS 0 0.1 0 0 0 1 /end COMPU_METHOD
/begin COMPU_METHOD TimeDelay_ms "" RAT_FUNC "%12.1" "ms" COEFFS 0 0 1 0 2.3283064365387e-007 0 /end COMPU_METHOD
/begin COMPU_METHOD TimeDelay_ms_Lin_16 "" RAT_FUNC "%6.3" "ms" COEFFS 0 1.63835 0 0 0 1 /end COMPU_METHOD
/begin COMPU_METHOD TimeDelay_s "" RAT_FUNC "%12.4" "s" COEFFS 0 0 1 0 0.00023283064365387 0 /end COMPU_METHOD
/begin COMPU_METHOD TimeDelay_s_Lin_16 "" RAT_FUNC "%6.5" "s" COEFFS 0 6553.4 0 0 0 1 /end COMPU_METHOD
/begin COMPU_METHOD Time_ms "" RAT_FUNC "%5.0" "ms" COEFFS 0 0.1 0 0 0 1 /end COMPU_METHOD
/begin COMPU_METHOD Time_s_float "" RAT_FUNC "%6.2" "s" COEFFS 0 1 0 0 0 1 /end COMPU_METHOD
/begin COMPU_METHOD TransR "" RAT_FUNC "%4.2" "-" COEFFS 0 100 0 0 0 1 /end COMPU_METHOD
/begin COMPU_METHOD TrbChN_float "" RAT_FUNC "%6.2" "rpm" COEFFS 0 1 0 0 0 1 /end COMPU_METHOD
/begin COMPU_METHOD Trq "" RAT_FUNC "%5.1" "Nm" COEFFS 0 10 0 0 0 1 /end COMPU_METHOD
/begin COMPU_METHOD Trq_float "" RAT_FUNC "%5.1" "Nm" COEFFS 0 1 0 0 0 1 /end COMPU_METHOD
/begin COMPU_METHOD TurboN "" RAT_FUNC "%6.1" "rpm" COEFFS 0 0.1 0 0 0 1 /end COMPU_METHOD
/begin COMPU_METHOD Vel "" RAT_FUNC "%5.2" "km/h" COEFFS 0 100 0 0 0 1 /end COMPU_METHOD
/begin COMPU_METHOD Volt "" RAT_FUNC "%6.1" "mV" COEFFS 0 5 0 0 0 1 /end COMPU_METHOD
/begin COMPU_METHOD Vol_float "" RAT_FUNC "%6.2" "l" COEFFS 0 1 0 0 0 1 /end COMPU_METHOD
/begin RECORD_LAYOUT Axis_Xs16 NO_AXIS_PTS_X 1 SWORD AXIS_PTS_X 2 SWORD INDEX_INCR DIRECT /end RECORD_LAYOUT
/begin RECORD_LAYOUT CurG_Ws16 FNC_VALUES 1 SWORD COLUMN_DIR DIRECT /end RECORD_LAYOUT
/begin RECORD_LAYOUT Cur_Xr32Wr32 NO_AXIS_PTS_X 1 SLONG AXIS_PTS_X 2 FLOAT32_IEEE INDEX_INCR DIRECT FNC_VALUES 3 FLOAT32_IEEE COLUMN_DIR DIRECT /end RECORD_LAYOUT
/begin RECORD_LAYOUT Cur_Xs16Ws16 NO_AXIS_PTS_X 1 SWORD AXIS_PTS_X 2 SWORD INDEX_INCR DIRECT FNC_VALUES 3 SWORD COLUMN_DIR DIRECT /end RECORD_LAYOUT
/begin RECORD_LAYOUT Kl_Xs16_Ws16 NO_AXIS_PTS_X 1 SWORD AXIS_PTS_X 2 SWORD INDEX_INCR DIRECT FNC_VALUES 3 SWORD COLUMN_DIR DIRECT /end RECORD_LAYOUT
/begin RECORD_LAYOUT Kw_Wr32 FNC_VALUES 1 FLOAT32_IEEE COLUMN_DIR DIRECT /end RECORD_LAYOUT
/begin RECORD_LAYOUT Kw_Ws16 FNC_VALUES 1 SWORD COLUMN_DIR DIRECT /end RECORD_LAYOUT
/begin RECORD_LAYOUT Kw_Ws32 FNC_VALUES 1 SLONG COLUMN_DIR DIRECT /end RECORD_LAYOUT
/begin RECORD_LAYOUT MapG_Ws16 FNC_VALUES 1 SWORD COLUMN_DIR DIRECT /end RECORD_LAYOUT
/begin RECORD_LAYOUT Map_Xr32Yr32Wr32 NO_AXIS_PTS_X 1 SLONG NO_AXIS_PTS_Y 2 SLONG AXIS_PTS_X 3 FLOAT32_IEEE INDEX_INCR DIRECT AXIS_PTS_Y 4 FLOAT32_IEEE INDEX_INCR DIRECT FNC_VALUES 5 FLOAT32_IEEE COLUMN_DIR DIRECT /end RECORD_LAYOUT
/begin RECORD_LAYOUT Map_Xs16Ys16Ws16 NO_AXIS_PTS_X 1 SWORD NO_AXIS_PTS_Y 2 SWORD AXIS_PTS_X 3 SWORD INDEX_INCR DIRECT AXIS_PTS_Y 4 SWORD INDEX_INCR DIRECT FNC_VALUES 5 SWORD COLUMN_DIR DIRECT /end RECORD_LAYOUT
/begin RECORD_LAYOUT ValA_Ws16 FNC_VALUES 1 SWORD COLUMN_DIR DIRECT /end RECORD_LAYOUT
/begin RECORD_LAYOUT ValA_Wu32 FNC_VALUES 1 ULONG COLUMN_DIR DIRECT /end RECORD_LAYOUT
/begin RECORD_LAYOUT ValA_Wu8 FNC_VALUES 1 UBYTE COLUMN_DIR DIRECT /end RECORD_LAYOUT
/begin RECORD_LAYOUT Val_Wr32 FNC_VALUES 1 FLOAT32_IEEE COLUMN_DIR DIRECT /end RECORD_LAYOUT
/begin RECORD_LAYOUT Val_Ws16 FNC_VALUES 1 SWORD COLUMN_DIR DIRECT /end RECORD_LAYOUT
/begin RECORD_LAYOUT Val_Ws32 FNC_VALUES 1 SLONG COLUMN_DIR DIRECT /end RECORD_LAYOUT
/begin RECORD_LAYOUT Val_Wu16 FNC_VALUES 1 UWORD COLUMN_DIR DIRECT /end RECORD_LAYOUT
/begin RECORD_LAYOUT Val_Wu32 FNC_VALUES 1 ULONG COLUMN_DIR DIRECT /end RECORD_LAYOUT
/begin RECORD_LAYOUT Val_Wu8 FNC_VALUES 1 UBYTE COLUMN_DIR DIRECT /end RECORD_LAYOUT
/end MODULE
/end PROJECT

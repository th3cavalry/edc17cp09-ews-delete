ASAP2_VERSION 1 4
/begin PROJECT P_574 "EDC17_CP09"
/begin HEADER "" VERSION "V8KB" PROJECT_NO P_574 /end HEADER
/begin MODULE DIM ""
/begin MOD_COMMON "" BYTE_ORDER MSB_LAST ALIGNMENT_BYTE 1 ALIGNMENT_WORD 2 ALIGNMENT_LONG 4 ALIGNMENT_FLOAT32_IEEE 4 /end MOD_COMMON
/begin CHARACTERISTIC DINH_Lim.DFC_LSUWireIPSig_CA "DINH/Zugeordnete Verriegelungslimits für Verriegelungsquelle DFC_LSUWireIPSig" VAL_BLK 0x8002859E ValA_Wu16 8192.00000000 DINH_LimDFCVerb 12079.0000000 20271.0000000 FORMAT "%13.7" NUMBER 11 /end CHARACTERISTIC
/begin CHARACTERISTIC DINH_Lim.DFC_Layer_BSDMax_CA "DINH/Zugeordnete Verriegelungslimits für Verriegelungsquelle DFC_Layer_BSDMax" VAL_BLK 0x800285B4 ValA_Wu16 8192.00000000 DINH_LimDFCVerb 12079.0000000 20271.0000000 FORMAT "%13.7" NUMBER 2 /end CHARACTERISTIC
/begin CHARACTERISTIC DINH_Lim.DFC_Layer_BSDMin_CA "DINH/Zugeordnete Verriegelungslimits für Verriegelungsquelle DFC_Layer_BSDMin" VAL_BLK 0x800285B8 ValA_Wu16 8192.00000000 DINH_LimDFCVerb 12079.0000000 20271.0000000 FORMAT "%13.7" NUMBER 2 /end CHARACTERISTIC
/begin CHARACTERISTIC DINH_Lim.DFC_Layer_BSDNpl_CA "DINH/Zugeordnete Verriegelungslimits für Verriegelungsquelle DFC_Layer_BSDNpl" VAL_BLK 0x800285BC ValA_Wu16 8192.00000000 DINH_LimDFCVerb 12079.0000000 20271.0000000 FORMAT "%13.7" NUMBER 2 /end CHARACTERISTIC
/begin CHARACTERISTIC DINH_Lim.DFC_Layer_BSDSig_CA "DINH/Zugeordnete Verriegelungslimits für Verriegelungsquelle DFC_Layer_BSDSig" VAL_BLK 0x800285C0 ValA_Wu16 8192.00000000 DINH_LimDFCVerb 12079.0000000 20271.0000000 FORMAT "%13.7" NUMBER 2 /end CHARACTERISTIC
/begin CHARACTERISTIC DINH_Lim.DFC_Layer_FltMngTstMax_CA "DINH/Zugeordnete Verriegelungslimits für Verriegelungsquelle DFC_Layer_FltMngTstMax" VAL_BLK 0x800285C4 ValA_Wu16 8192.00000000 DINH_LimDFCVerb 12079.0000000 20271.0000000 FORMAT "%13.7" NUMBER 2 /end CHARACTERISTIC
/begin CHARACTERISTIC DINH_Lim.DFC_Layer_FltMngTstMin_CA "DINH/Zugeordnete Verriegelungslimits für Verriegelungsquelle DFC_Layer_FltMngTstMin" VAL_BLK 0x800285C8 ValA_Wu16 8192.00000000 DINH_LimDFCVerb 12079.0000000 20271.0000000 FORMAT "%13.7" NUMBER 2 /end CHARACTERISTIC
/begin CHARACTERISTIC DINH_Lim.DFC_Layer_FltMngTstNpl_CA "DINH/Zugeordnete Verriegelungslimits für Verriegelungsquelle DFC_Layer_FltMngTstNpl" VAL_BLK 0x800285CC ValA_Wu16 8192.00000000 DINH_LimDFCVerb 12079.0000000 20271.0000000 FORMAT "%13.7" NUMBER 2 /end CHARACTERISTIC
/begin CHARACTERISTIC DINH_Lim.DFC_Layer_FltMngTstSig_CA "DINH/Zugeordnete Verriegelungslimits für Verriegelungsquelle DFC_Layer_FltMngTstSig" VAL_BLK 0x800285D0 ValA_Wu16 8192.00000000 DINH_LimDFCVerb 12079.0000000 20271.0000000 FORMAT "%13.7" NUMBER 2 /end CHARACTERISTIC
/begin CHARACTERISTIC DINH_Lim.DFC_Layer_GENELBMax_CA "DINH/Zugeordnete Verriegelungslimits für Verriegelungsquelle DFC_Layer_GENELBMax" VAL_BLK 0x800285D4 ValA_Wu16 8192.00000000 DINH_LimDFCVerb 12079.0000000 20271.0000000 FORMAT "%13.7" NUMBER 2 /end CHARACTERISTIC
/begin CHARACTERISTIC DINH_Lim.DFC_Layer_GENELBMin_CA "DINH/Zugeordnete Verriegelungslimits für Verriegelungsquelle DFC_Layer_GENELBMin" VAL_BLK 0x800285D8 ValA_Wu16 8192.00000000 DINH_LimDFCVerb 12079.0000000 20271.0000000 FORMAT "%13.7" NUMBER 2 /end CHARACTERISTIC
/begin CHARACTERISTIC DINH_Lim.DFC_Layer_GENELBNpl_CA "DINH/Zugeordnete Verriegelungslimits für Verriegelungsquelle DFC_Layer_GENELBNpl" VAL_BLK 0x800285DC ValA_Wu16 8192.00000000 DINH_LimDFCVerb 12079.0000000 20271.0000000 FORMAT "%13.7" NUMBER 2 /end CHARACTERISTIC
/begin CHARACTERISTIC DINH_Lim.DFC_Layer_GENELBSig_CA "DINH/Zugeordnete Verriegelungslimits für Verriegelungsquelle DFC_Layer_GENELBSig" VAL_BLK 0x800285E0 ValA_Wu16 8192.00000000 DINH_LimDFCVerb 12079.0000000 20271.0000000 FORMAT "%13.7" NUMBER 2 /end CHARACTERISTIC
/begin CHARACTERISTIC DINH_Lim.DFC_Layer_GENELMax_CA "DINH/Zugeordnete Verriegelungslimits für Verriegelungsquelle DFC_Layer_GENELMax" VAL_BLK 0x800285E4 ValA_Wu16 8192.00000000 DINH_LimDFCVerb 12079.0000000 20271.0000000 FORMAT "%13.7" NUMBER 2 /end CHARACTERISTIC
/begin CHARACTERISTIC DINH_Lim.DFC_Layer_GENELMin_CA "DINH/Zugeordnete Verriegelungslimits für Verriegelungsquelle DFC_Layer_GENELMin" VAL_BLK 0x800285E8 ValA_Wu16 8192.00000000 DINH_LimDFCVerb 12079.0000000 20271.0000000 FORMAT "%13.7" NUMBER 2 /end CHARACTERISTIC
/begin CHARACTERISTIC DINH_Lim.DFC_Layer_GENELNpl_CA "DINH/Zugeordnete Verriegelungslimits für Verriegelungsquelle DFC_Layer_GENELNpl" VAL_BLK 0x800285EC ValA_Wu16 8192.00000000 DINH_LimDFCVerb 12079.0000000 20271.0000000 FORMAT "%13.7" NUMBER 2 /end CHARACTERISTIC
/begin CHARACTERISTIC DINH_Lim.DFC_Layer_GENELSig_CA "DINH/Zugeordnete Verriegelungslimits für Verriegelungsquelle DFC_Layer_GENELSig" VAL_BLK 0x800285F0 ValA_Wu16 8192.00000000 DINH_LimDFCVerb 12079.0000000 20271.0000000 FORMAT "%13.7" NUMBER 2 /end CHARACTERISTIC
/begin CHARACTERISTIC DINH_Lim.DFC_Layer_GENHTBMax_CA "DINH/Zugeordnete Verriegelungslimits für Verriegelungsquelle DFC_Layer_GENHTBMax" VAL_BLK 0x800285F4 ValA_Wu16 8192.00000000 DINH_LimDFCVerb 12079.0000000 20271.0000000 FORMAT "%13.7" NUMBER 2 /end CHARACTERISTIC
/begin CHARACTERISTIC DINH_Lim.DFC_Layer_GENHTBMin_CA "DINH/Zugeordnete Verriegelungslimits für Verriegelungsquelle DFC_Layer_GENHTBMin" VAL_BLK 0x800285F8 ValA_Wu16 8192.00000000 DINH_LimDFCVerb 12079.0000000 20271.0000000 FORMAT "%13.7" NUMBER 2 /end CHARACTERISTIC
/begin CHARACTERISTIC DINH_Lim.DFC_Layer_GENHTBNpl_CA "DINH/Zugeordnete Verriegelungslimits für Verriegelungsquelle DFC_Layer_GENHTBNpl" VAL_BLK 0x800285FC ValA_Wu16 8192.00000000 DINH_LimDFCVerb 12079.0000000 20271.0000000 FORMAT "%13.7" NUMBER 2 /end CHARACTERISTIC
/begin CHARACTERISTIC DINH_Lim.DFC_Layer_GENHTBSig_CA "DINH/Zugeordnete Verriegelungslimits für Verriegelungsquelle DFC_Layer_GENHTBSig" VAL_BLK 0x80028600 ValA_Wu16 8192.00000000 DINH_LimDFCVerb 12079.0000000 20271.0000000 FORMAT "%13.7" NUMBER 2 /end CHARACTERISTIC
/begin CHARACTERISTIC DINH_Lim.DFC_Layer_GENHTMax_CA "DINH/Zugeordnete Verriegelungslimits für Verriegelungsquelle DFC_Layer_GENHTMax" VAL_BLK 0x80028604 ValA_Wu16 8192.00000000 DINH_LimDFCVerb 12079.0000000 20271.0000000 FORMAT "%13.7" NUMBER 2 /end CHARACTERISTIC
/begin CHARACTERISTIC DINH_Lim.DFC_Layer_GENHTMin_CA "DINH/Zugeordnete Verriegelungslimits für Verriegelungsquelle DFC_Layer_GENHTMin" VAL_BLK 0x80028608 ValA_Wu16 8192.00000000 DINH_LimDFCVerb 12079.0000000 20271.0000000 FORMAT "%13.7" NUMBER 2 /end CHARACTERISTIC
/begin CHARACTERISTIC DINH_Lim.DFC_Layer_GENHTNpl_CA "DINH/Zugeordnete Verriegelungslimits für Verriegelungsquelle DFC_Layer_GENHTNpl" VAL_BLK 0x8002860C ValA_Wu16 8192.00000000 DINH_LimDFCVerb 12079.0000000 20271.0000000 FORMAT "%13.7" NUMBER 2 /end CHARACTERISTIC
/begin CHARACTERISTIC DINH_Lim.DFC_Layer_GENHTSig_CA "DINH/Zugeordnete Verriegelungslimits für Verriegelungsquelle DFC_Layer_GENHTSig" VAL_BLK 0x80028610 ValA_Wu16 8192.00000000 DINH_LimDFCVerb 12079.0000000 20271.0000000 FORMAT "%13.7" NUMBER 2 /end CHARACTERISTIC
/begin CHARACTERISTIC DINH_Lim.DFC_Layer_GENKOMMMax_CA "DINH/Zugeordnete Verriegelungslimits für Verriegelungsquelle DFC_Layer_GENKOMMMax" VAL_BLK 0x80028614 ValA_Wu16 8192.00000000 DINH_LimDFCVerb 12079.0000000 20271.0000000 FORMAT "%13.7" NUMBER 2 /end CHARACTERISTIC
/begin CHARACTERISTIC DINH_Lim.DFC_Layer_GENKOMMMin_CA "DINH/Zugeordnete Verriegelungslimits für Verriegelungsquelle DFC_Layer_GENKOMMMin" VAL_BLK 0x80028618 ValA_Wu16 8192.00000000 DINH_LimDFCVerb 12079.0000000 20271.0000000 FORMAT "%13.7" NUMBER 2 /end CHARACTERISTIC
/begin CHARACTERISTIC DINH_Lim.DFC_Layer_GENKOMMNpl_CA "DINH/Zugeordnete Verriegelungslimits für Verriegelungsquelle DFC_Layer_GENKOMMNpl" VAL_BLK 0x8002861C ValA_Wu16 8192.00000000 DINH_LimDFCVerb 12079.0000000 20271.0000000 FORMAT "%13.7" NUMBER 2 /end CHARACTERISTIC
/begin CHARACTERISTIC DINH_Lim.DFC_Layer_GENKOMMSig_CA "DINH/Zugeordnete Verriegelungslimits für Verriegelungsquelle DFC_Layer_GENKOMMSig" VAL_BLK 0x80028620 ValA_Wu16 8192.00000000 DINH_LimDFCVerb 12079.0000000 20271.0000000 FORMAT "%13.7" NUMBER 2 /end CHARACTERISTIC
/begin CHARACTERISTIC DINH_Lim.DFC_Layer_GENMECHMax_CA "DINH/Zugeordnete Verriegelungslimits für Verriegelungsquelle DFC_Layer_GENMECHMax" VAL_BLK 0x80028624 ValA_Wu16 8192.00000000 DINH_LimDFCVerb 12079.0000000 20271.0000000 FORMAT "%13.7" NUMBER 2 /end CHARACTERISTIC
/begin CHARACTERISTIC DINH_Lim.DFC_Layer_GENMECHMin_CA "DINH/Zugeordnete Verriegelungslimits für Verriegelungsquelle DFC_Layer_GENMECHMin" VAL_BLK 0x80028628 ValA_Wu16 8192.00000000 DINH_LimDFCVerb 12079.0000000 20271.0000000 FORMAT "%13.7" NUMBER 2 /end CHARACTERISTIC
/begin CHARACTERISTIC DINH_Lim.DFC_Layer_GENMECHNpl_CA "DINH/Zugeordnete Verriegelungslimits für Verriegelungsquelle DFC_Layer_GENMECHNpl" VAL_BLK 0x8002862C ValA_Wu16 8192.00000000 DINH_LimDFCVerb 12079.0000000 20271.0000000 FORMAT "%13.7" NUMBER 2 /end CHARACTERISTIC
/begin CHARACTERISTIC DINH_Lim.DFC_Layer_GENMECHSig_CA "DINH/Zugeordnete Verriegelungslimits für Verriegelungsquelle DFC_Layer_GENMECHSig" VAL_BLK 0x80028630 ValA_Wu16 8192.00000000 DINH_LimDFCVerb 12079.0000000 20271.0000000 FORMAT "%13.7" NUMBER 2 /end CHARACTERISTIC
/begin CHARACTERISTIC DINH_Lim.DFC_Layer_GENMax_CA "DINH/Zugeordnete Verriegelungslimits für Verriegelungsquelle DFC_Layer_GENMax" VAL_BLK 0x80028634 ValA_Wu16 8192.00000000 DINH_LimDFCVerb 12079.0000000 20271.0000000 FORMAT "%13.7" NUMBER 2 /end CHARACTERISTIC
/begin CHARACTERISTIC DINH_Lim.DFC_Layer_GENMin_CA "DINH/Zugeordnete Verriegelungslimits für Verriegelungsquelle DFC_Layer_GENMin" VAL_BLK 0x80028638 ValA_Wu16 8192.00000000 DINH_LimDFCVerb 12079.0000000 20271.0000000 FORMAT "%13.7" NUMBER 2 /end CHARACTERISTIC
/begin CHARACTERISTIC DINH_Lim.DFC_Layer_GENNpl_CA "DINH/Zugeordnete Verriegelungslimits für Verriegelungsquelle DFC_Layer_GENNpl" VAL_BLK 0x8002863C ValA_Wu16 8192.00000000 DINH_LimDFCVerb 12079.0000000 20271.0000000 FORMAT "%13.7" NUMBER 2 /end CHARACTERISTIC
/begin CHARACTERISTIC DINH_Lim.DFC_Layer_GENREGUPLMax_CA "DINH/Zugeordnete Verriegelungslimits für Verriegelungsquelle DFC_Layer_GENREGUPLMax" VAL_BLK 0x80028640 ValA_Wu16 8192.00000000 DINH_LimDFCVerb 12079.0000000 20271.0000000 FORMAT "%13.7" NUMBER 2 /end CHARACTERISTIC
/begin CHARACTERISTIC DINH_Lim.DFC_Layer_GENREGUPLMin_CA "DINH/Zugeordnete Verriegelungslimits für Verriegelungsquelle DFC_Layer_GENREGUPLMin" VAL_BLK 0x80028644 ValA_Wu16 8192.00000000 DINH_LimDFCVerb 12079.0000000 20271.0000000 FORMAT "%13.7" NUMBER 2 /end CHARACTERISTIC
/begin CHARACTERISTIC DINH_Lim.DFC_Layer_GENREGUPLNpl_CA "DINH/Zugeordnete Verriegelungslimits für Verriegelungsquelle DFC_Layer_GENREGUPLNpl" VAL_BLK 0x80028648 ValA_Wu16 8192.00000000 DINH_LimDFCVerb 12079.0000000 20271.0000000 FORMAT "%13.7" NUMBER 2 /end CHARACTERISTIC
/begin CHARACTERISTIC DINH_Lim.DFC_Layer_GENREGUPLSig_CA "DINH/Zugeordnete Verriegelungslimits für Verriegelungsquelle DFC_Layer_GENREGUPLSig" VAL_BLK 0x8002864C ValA_Wu16 8192.00000000 DINH_LimDFCVerb 12079.0000000 20271.0000000 FORMAT "%13.7" NUMBER 2 /end CHARACTERISTIC
/begin CHARACTERISTIC DINH_Lim.DFC_Layer_GENSig_CA "DINH/Zugeordnete Verriegelungslimits für Verriegelungsquelle DFC_Layer_GENSig" VAL_BLK 0x80028650 ValA_Wu16 8192.00000000 DINH_LimDFCVerb 12079.0000000 20271.0000000 FORMAT "%13.7" NUMBER 2 /end CHARACTERISTIC
/begin CHARACTERISTIC DINH_Lim.DFC_Layer_GENUPLMax_CA "DINH/Zugeordnete Verriegelungslimits für Verriegelungsquelle DFC_Layer_GENUPLMax" VAL_BLK 0x80028654 ValA_Wu16 8192.00000000 DINH_LimDFCVerb 12079.0000000 20271.0000000 FORMAT "%13.7" NUMBER 2 /end CHARACTERISTIC
/begin CHARACTERISTIC DINH_Lim.DFC_Layer_GENUPLMin_CA "DINH/Zugeordnete Verriegelungslimits für Verriegelungsquelle DFC_Layer_GENUPLMin" VAL_BLK 0x80028658 ValA_Wu16 8192.00000000 DINH_LimDFCVerb 12079.0000000 20271.0000000 FORMAT "%13.7" NUMBER 2 /end CHARACTERISTIC
/begin CHARACTERISTIC DINH_Lim.DFC_Layer_GENUPLNpl_CA "DINH/Zugeordnete Verriegelungslimits für Verriegelungsquelle DFC_Layer_GENUPLNpl" VAL_BLK 0x8002865C ValA_Wu16 8192.00000000 DINH_LimDFCVerb 12079.0000000 20271.0000000 FORMAT "%13.7" NUMBER 2 /end CHARACTERISTIC
/begin CHARACTERISTIC DINH_Lim.DFC_Layer_GENUPLSig_CA "DINH/Zugeordnete Verriegelungslimits für Verriegelungsquelle DFC_Layer_GENUPLSig" VAL_BLK 0x80028660 ValA_Wu16 8192.00000000 DINH_LimDFCVerb 12079.0000000 20271.0000000 FORMAT "%13.7" NUMBER 2 /end CHARACTERISTIC
/begin CHARACTERISTIC DINH_Lim.DFC_Layer_IBS1Max_CA "DINH/Zugeordnete Verriegelungslimits für Verriegelungsquelle DFC_Layer_IBS1Max" VAL_BLK 0x80028664 ValA_Wu16 8192.00000000 DINH_LimDFCVerb 12079.0000000 20271.0000000 FORMAT "%13.7" NUMBER 2 /end CHARACTERISTIC
/begin CHARACTERISTIC DINH_Lim.DFC_Layer_IBS1Min_CA "DINH/Zugeordnete Verriegelungslimits für Verriegelungsquelle DFC_Layer_IBS1Min" VAL_BLK 0x80028668 ValA_Wu16 8192.00000000 DINH_LimDFCVerb 12079.0000000 20271.0000000 FORMAT "%13.7" NUMBER 2 /end CHARACTERISTIC
/begin CHARACTERISTIC DINH_Lim.DFC_Layer_IBS1Npl_CA "DINH/Zugeordnete Verriegelungslimits für Verriegelungsquelle DFC_Layer_IBS1Npl" VAL_BLK 0x8002866C ValA_Wu16 8192.00000000 DINH_LimDFCVerb 12079.0000000 20271.0000000 FORMAT "%13.7" NUMBER 2 /end CHARACTERISTIC
/begin CHARACTERISTIC DINH_Lim.DFC_Layer_IBS1Sig_CA "DINH/Zugeordnete Verriegelungslimits für Verriegelungsquelle DFC_Layer_IBS1Sig" VAL_BLK 0x80028670 ValA_Wu16 8192.00000000 DINH_LimDFCVerb 12079.0000000 20271.0000000 FORMAT "%13.7" NUMBER 2 /end CHARACTERISTIC
/begin CHARACTERISTIC DINH_Lim.DFC_Layer_IBS2Max_CA "DINH/Zugeordnete Verriegelungslimits für Verriegelungsquelle DFC_Layer_IBS2Max" VAL_BLK 0x80028674 ValA_Wu16 8192.00000000 DINH_LimDFCVerb 12079.0000000 20271.0000000 FORMAT "%13.7" NUMBER 2 /end CHARACTERISTIC
/begin CHARACTERISTIC DINH_Lim.DFC_Layer_IBS2Min_CA "DINH/Zugeordnete Verriegelungslimits für Verriegelungsquelle DFC_Layer_IBS2Min" VAL_BLK 0x80028678 ValA_Wu16 8192.00000000 DINH_LimDFCVerb 12079.0000000 20271.0000000 FORMAT "%13.7" NUMBER 2 /end CHARACTERISTIC
/begin CHARACTERISTIC DINH_Lim.DFC_Layer_IBS2Npl_CA "DINH/Zugeordnete Verriegelungslimits für Verriegelungsquelle DFC_Layer_IBS2Npl" VAL_BLK 0x8002867C ValA_Wu16 8192.00000000 DINH_LimDFCVerb 12079.0000000 20271.0000000 FORMAT "%13.7" NUMBER 2 /end CHARACTERISTIC
/begin CHARACTERISTIC DINH_Lim.DFC_Layer_IBS2Sig_CA "DINH/Zugeordnete Verriegelungslimits für Verriegelungsquelle DFC_Layer_IBS2Sig" VAL_BLK 0x80028680 ValA_Wu16 8192.00000000 DINH_LimDFCVerb 12079.0000000 20271.0000000 FORMAT "%13.7" NUMBER 2 /end CHARACTERISTIC
/begin CHARACTERISTIC DINH_Lim.DFC_Layer_IBS3Max_CA "DINH/Zugeordnete Verriegelungslimits für Verriegelungsquelle DFC_Layer_IBS3Max" VAL_BLK 0x80028684 ValA_Wu16 8192.00000000 DINH_LimDFCVerb 12079.0000000 20271.0000000 FORMAT "%13.7" NUMBER 2 /end CHARACTERISTIC
/begin CHARACTERISTIC DINH_Lim.DFC_Layer_IBS3Min_CA "DINH/Zugeordnete Verriegelungslimits für Verriegelungsquelle DFC_Layer_IBS3Min" VAL_BLK 0x80028688 ValA_Wu16 8192.00000000 DINH_LimDFCVerb 12079.0000000 20271.0000000 FORMAT "%13.7" NUMBER 2 /end CHARACTERISTIC
/begin CHARACTERISTIC DINH_Lim.DFC_Layer_IBS3Npl_CA "DINH/Zugeordnete Verriegelungslimits für Verriegelungsquelle DFC_Layer_IBS3Npl" VAL_BLK 0x8002868C ValA_Wu16 8192.00000000 DINH_LimDFCVerb 12079.0000000 20271.0000000 FORMAT "%13.7" NUMBER 2 /end CHARACTERISTIC
/begin CHARACTERISTIC DINH_Lim.DFC_Layer_IBS3Sig_CA "DINH/Zugeordnete Verriegelungslimits für Verriegelungsquelle DFC_Layer_IBS3Sig" VAL_BLK 0x80028690 ValA_Wu16 8192.00000000 DINH_LimDFCVerb 12079.0000000 20271.0000000 FORMAT "%13.7" NUMBER 2 /end CHARACTERISTIC
/begin CHARACTERISTIC DINH_Lim.DFC_Layer_MANDETEKMax_CA "DINH/Zugeordnete Verriegelungslimits für Verriegelungsquelle DFC_Layer_MANDETEKMax" VAL_BLK 0x80028694 ValA_Wu16 8192.00000000 DINH_LimDFCVerb 12079.0000000 20271.0000000 FORMAT "%13.7" NUMBER 2 /end CHARACTERISTIC
/begin CHARACTERISTIC DINH_Lim.DFC_Layer_MANDETEKMin_CA "DINH/Zugeordnete Verriegelungslimits für Verriegelungsquelle DFC_Layer_MANDETEKMin" VAL_BLK 0x80028698 ValA_Wu16 8192.00000000 DINH_LimDFCVerb 12079.0000000 20271.0000000 FORMAT "%13.7" NUMBER 2 /end CHARACTERISTIC
/begin CHARACTERISTIC DINH_Lim.DFC_Layer_MANDETEKNpl_CA "DINH/Zugeordnete Verriegelungslimits für Verriegelungsquelle DFC_Layer_MANDETEKNpl" VAL_BLK 0x8002869C ValA_Wu16 8192.00000000 DINH_LimDFCVerb 12079.0000000 20271.0000000 FORMAT "%13.7" NUMBER 2 /end CHARACTERISTIC
/begin CHARACTERISTIC DINH_Lim.DFC_Layer_MANDETEKSig_CA "DINH/Zugeordnete Verriegelungslimits für Verriegelungsquelle DFC_Layer_MANDETEKSig" VAL_BLK 0x800286A0 ValA_Wu16 8192.00000000 DINH_LimDFCVerb 12079.0000000 20271.0000000 FORMAT "%13.7" NUMBER 2 /end CHARACTERISTIC
/begin CHARACTERISTIC DINH_Lim.DFC_Layer_NDR1Max_CA "DINH/Zugeordnete Verriegelungslimits für Verriegelungsquelle DFC_Layer_NDR1Max" VAL_BLK 0x800286A4 ValA_Wu16 8192.00000000 DINH_LimDFCVerb 12079.0000000 20271.0000000 FORMAT "%13.7" NUMBER 2 /end CHARACTERISTIC
/begin CHARACTERISTIC DINH_Lim.DFC_Layer_NDR1Min_CA "DINH/Zugeordnete Verriegelungslimits für Verriegelungsquelle DFC_Layer_NDR1Min" VAL_BLK 0x800286A8 ValA_Wu16 8192.00000000 DINH_LimDFCVerb 12079.0000000 20271.0000000 FORMAT "%13.7" NUMBER 2 /end CHARACTERISTIC
/begin CHARACTERISTIC DINH_Lim.DFC_Layer_NDR1Npl_CA "DINH/Zugeordnete Verriegelungslimits für Verriegelungsquelle DFC_Layer_NDR1Npl" VAL_BLK 0x800286AC ValA_Wu16 8192.00000000 DINH_LimDFCVerb 12079.0000000 20271.0000000 FORMAT "%13.7" NUMBER 2 /end CHARACTERISTIC
/begin CHARACTERISTIC DINH_Lim.DFC_Layer_NDR1Sig_CA "DINH/Zugeordnete Verriegelungslimits für Verriegelungsquelle DFC_Layer_NDR1Sig" VAL_BLK 0x800286B0 ValA_Wu16 8192.00000000 DINH_LimDFCVerb 12079.0000000 20271.0000000 FORMAT "%13.7" NUMBER 2 /end CHARACTERISTIC
/begin CHARACTERISTIC DINH_Lim.DFC_Layer_NDR2Max_CA "DINH/Zugeordnete Verriegelungslimits für Verriegelungsquelle DFC_Layer_NDR2Max" VAL_BLK 0x800286B4 ValA_Wu16 8192.00000000 DINH_LimDFCVerb 12079.0000000 20271.0000000 FORMAT "%13.7" NUMBER 2 /end CHARACTERISTIC
/begin CHARACTERISTIC DINH_Lim.DFC_Layer_NDR2Min_CA "DINH/Zugeordnete Verriegelungslimits für Verriegelungsquelle DFC_Layer_NDR2Min" VAL_BLK 0x800286B8 ValA_Wu16 8192.00000000 DINH_LimDFCVerb 12079.0000000 20271.0000000 FORMAT "%13.7" NUMBER 2 /end CHARACTERISTIC
/begin CHARACTERISTIC DINH_Lim.DFC_Layer_NDR2Npl_CA "DINH/Zugeordnete Verriegelungslimits für Verriegelungsquelle DFC_Layer_NDR2Npl" VAL_BLK 0x800286BC ValA_Wu16 8192.00000000 DINH_LimDFCVerb 12079.0000000 20271.0000000 FORMAT "%13.7" NUMBER 2 /end CHARACTERISTIC
/begin CHARACTERISTIC DINH_Lim.DFC_Layer_NDR2Sig_CA "DINH/Zugeordnete Verriegelungslimits für Verriegelungsquelle DFC_Layer_NDR2Sig" VAL_BLK 0x800286C0 ValA_Wu16 8192.00000000 DINH_LimDFCVerb 12079.0000000 20271.0000000 FORMAT "%13.7" NUMBER 2 /end CHARACTERISTIC
/begin CHARACTERISTIC DINH_Lim.DFC_Layer_NGLERNMax_CA "DINH/Zugeordnete Verriegelungslimits für Verriegelungsquelle DFC_Layer_NGLERNMax" VAL_BLK 0x800286C4 ValA_Wu16 8192.00000000 DINH_LimDFCVerb 12079.0000000 20271.0000000 FORMAT "%13.7" NUMBER 2 /end CHARACTERISTIC
/begin CHARACTERISTIC DINH_Lim.DFC_Layer_NGLERNMin_CA "DINH/Zugeordnete Verriegelungslimits für Verriegelungsquelle DFC_Layer_NGLERNMin" VAL_BLK 0x800286C8 ValA_Wu16 8192.00000000 DINH_LimDFCVerb 12079.0000000 20271.0000000 FORMAT "%13.7" NUMBER 2 /end CHARACTERISTIC
/begin CHARACTERISTIC DINH_Lim.DFC_Layer_NGLERNNpl_CA "DINH/Zugeordnete Verriegelungslimits für Verriegelungsquelle DFC_Layer_NGLERNNpl" VAL_BLK 0x800286CC ValA_Wu16 8192.00000000 DINH_LimDFCVerb 12079.0000000 20271.0000000 FORMAT "%13.7" NUMBER 2 /end CHARACTERISTIC
/begin CHARACTERISTIC DINH_Lim.DFC_Layer_NGLERNSig_CA "DINH/Zugeordnete Verriegelungslimits für Verriegelungsquelle DFC_Layer_NGLERNSig" VAL_BLK 0x800286D0 ValA_Wu16 8192.00000000 DINH_LimDFCVerb 12079.0000000 20271.0000000 FORMAT "%13.7" NUMBER 2 /end CHARACTERISTIC
/begin CHARACTERISTIC DINH_Lim.DFC_Layer_PMBATTMax_CA "DINH/Zugeordnete Verriegelungslimits für Verriegelungsquelle DFC_Layer_PMBATTMax" VAL_BLK 0x800286D4 ValA_Wu16 8192.00000000 DINH_LimDFCVerb 12079.0000000 20271.0000000 FORMAT "%13.7" NUMBER 2 /end CHARACTERISTIC
/begin CHARACTERISTIC DINH_Lim.DFC_Layer_PMBATTMin_CA "DINH/Zugeordnete Verriegelungslimits für Verriegelungsquelle DFC_Layer_PMBATTMin" VAL_BLK 0x800286D8 ValA_Wu16 8192.00000000 DINH_LimDFCVerb 12079.0000000 20271.0000000 FORMAT "%13.7" NUMBER 2 /end CHARACTERISTIC
/begin CHARACTERISTIC DINH_Lim.DFC_Layer_PMBATTNpl_CA "DINH/Zugeordnete Verriegelungslimits für Verriegelungsquelle DFC_Layer_PMBATTNpl" VAL_BLK 0x800286DC ValA_Wu16 8192.00000000 DINH_LimDFCVerb 12079.0000000 20271.0000000 FORMAT "%13.7" NUMBER 2 /end CHARACTERISTIC
/begin CHARACTERISTIC DINH_Lim.DFC_Layer_PMBATTSig_CA "DINH/Zugeordnete Verriegelungslimits für Verriegelungsquelle DFC_Layer_PMBATTSig" VAL_BLK 0x800286E0 ValA_Wu16 8192.00000000 DINH_LimDFCVerb 12079.0000000 20271.0000000 FORMAT "%13.7" NUMBER 2 /end CHARACTERISTIC
/begin CHARACTERISTIC DINH_Lim.DFC_Layer_PMBNMax_CA "DINH/Zugeordnete Verriegelungslimits für Verriegelungsquelle DFC_Layer_PMBNMax" VAL_BLK 0x800286E4 ValA_Wu16 8192.00000000 DINH_LimDFCVerb 12079.0000000 20271.0000000 FORMAT "%13.7" NUMBER 2 /end CHARACTERISTIC
/begin CHARACTERISTIC DINH_Lim.DFC_Layer_PMBNMin_CA "DINH/Zugeordnete Verriegelungslimits für Verriegelungsquelle DFC_Layer_PMBNMin" VAL_BLK 0x800286E8 ValA_Wu16 8192.00000000 DINH_LimDFCVerb 12079.0000000 20271.0000000 FORMAT "%13.7" NUMBER 2 /end CHARACTERISTIC
/begin CHARACTERISTIC DINH_Lim.DFC_Layer_PMBNNpl_CA "DINH/Zugeordnete Verriegelungslimits für Verriegelungsquelle DFC_Layer_PMBNNpl" VAL_BLK 0x800286EC ValA_Wu16 8192.00000000 DINH_LimDFCVerb 12079.0000000 20271.0000000 FORMAT "%13.7" NUMBER 2 /end CHARACTERISTIC
/begin CHARACTERISTIC DINH_Lim.DFC_Layer_PMBNSig_CA "DINH/Zugeordnete Verriegelungslimits für Verriegelungsquelle DFC_Layer_PMBNSig" VAL_BLK 0x800286F0 ValA_Wu16 8192.00000000 DINH_LimDFCVerb 12079.0000000 20271.0000000 FORMAT "%13.7" NUMBER 2 /end CHARACTERISTIC
/begin CHARACTERISTIC DINH_Lim.DFC_Layer_PMRUHVERLMax_CA "DINH/Zugeordnete Verriegelungslimits für Verriegelungsquelle DFC_Layer_PMRUHVERLMax" VAL_BLK 0x800286F4 ValA_Wu16 8192.00000000 DINH_LimDFCVerb 12079.0000000 20271.0000000 FORMAT "%13.7" NUMBER 2 /end CHARACTERISTIC
/begin CHARACTERISTIC DINH_Lim.DFC_Layer_PMRUHVERLMin_CA "DINH/Zugeordnete Verriegelungslimits für Verriegelungsquelle DFC_Layer_PMRUHVERLMin" VAL_BLK 0x800286F8 ValA_Wu16 8192.00000000 DINH_LimDFCVerb 12079.0000000 20271.0000000 FORMAT "%13.7" NUMBER 2 /end CHARACTERISTIC
/begin CHARACTERISTIC DINH_Lim.DFC_Layer_PMRUHVERLNpl_CA "DINH/Zugeordnete Verriegelungslimits für Verriegelungsquelle DFC_Layer_PMRUHVERLNpl" VAL_BLK 0x800286FC ValA_Wu16 8192.00000000 DINH_LimDFCVerb 12079.0000000 20271.0000000 FORMAT "%13.7" NUMBER 2 /end CHARACTERISTIC
/begin CHARACTERISTIC DINH_Lim.DFC_Layer_PMRUHVERLSig_CA "DINH/Zugeordnete Verriegelungslimits für Verriegelungsquelle DFC_Layer_PMRUHVERLSig" VAL_BLK 0x80028700 ValA_Wu16 8192.00000000 DINH_LimDFCVerb 12079.0000000 20271.0000000 FORMAT "%13.7" NUMBER 2 /end CHARACTERISTIC
/begin CHARACTERISTIC DINH_Lim.DFC_Layer_QLTMax_CA "DINH/Zugeordnete Verriegelungslimits für Verriegelungsquelle DFC_Layer_QLTMax" VAL_BLK 0x80028704 ValA_Wu16 8192.00000000 DINH_LimDFCVerb 12079.0000000 20271.0000000 FORMAT "%13.7" NUMBER 2 /end CHARACTERISTIC
/begin CHARACTERISTIC DINH_Lim.DFC_Layer_QLTMin_CA "DINH/Zugeordnete Verriegelungslimits für Verriegelungsquelle DFC_Layer_QLTMin" VAL_BLK 0x80028708 ValA_Wu16 8192.00000000 DINH_LimDFCVerb 12079.0000000 20271.0000000 FORMAT "%13.7" NUMBER 2 /end CHARACTERISTIC
/begin CHARACTERISTIC DINH_Lim.DFC_Layer_QLTNpl_CA "DINH/Zugeordnete Verriegelungslimits für Verriegelungsquelle DFC_Layer_QLTNpl" VAL_BLK 0x8002870C ValA_Wu16 8192.00000000 DINH_LimDFCVerb 12079.0000000 20271.0000000 FORMAT "%13.7" NUMBER 2 /end CHARACTERISTIC
/begin CHARACTERISTIC DINH_Lim.DFC_Layer_QLTSig_CA "DINH/Zugeordnete Verriegelungslimits für Verriegelungsquelle DFC_Layer_QLTSig" VAL_BLK 0x80028710 ValA_Wu16 8192.00000000 DINH_LimDFCVerb 12079.0000000 20271.0000000 FORMAT "%13.7" NUMBER 2 /end CHARACTERISTIC
/begin CHARACTERISTIC DINH_Lim.DFC_Layer_TOENSMax_CA "DINH/Zugeordnete Verriegelungslimits für Verriegelungsquelle DFC_Layer_TOENSMax" VAL_BLK 0x80028714 ValA_Wu16 8192.00000000 DINH_LimDFCVerb 12079.0000000 20271.0000000 FORMAT "%13.7" NUMBER 2 /end CHARACTERISTIC
/begin CHARACTERISTIC DINH_Lim.DFC_Layer_TOENSMin_CA "DINH/Zugeordnete Verriegelungslimits für Verriegelungsquelle DFC_Layer_TOENSMin" VAL_BLK 0x80028718 ValA_Wu16 8192.00000000 DINH_LimDFCVerb 12079.0000000 20271.0000000 FORMAT "%13.7" NUMBER 2 /end CHARACTERISTIC
/begin CHARACTERISTIC DINH_Lim.DFC_Layer_TOENSNpl_CA "DINH/Zugeordnete Verriegelungslimits für Verriegelungsquelle DFC_Layer_TOENSNpl" VAL_BLK 0x8002871C ValA_Wu16 8192.00000000 DINH_LimDFCVerb 12079.0000000 20271.0000000 FORMAT "%13.7" NUMBER 2 /end CHARACTERISTIC
/begin CHARACTERISTIC DINH_Lim.DFC_Layer_TOENSSig_CA "DINH/Zugeordnete Verriegelungslimits für Verriegelungsquelle DFC_Layer_TOENSSig" VAL_BLK 0x80028720 ValA_Wu16 8192.00000000 DINH_LimDFCVerb 12079.0000000 20271.0000000 FORMAT "%13.7" NUMBER 2 /end CHARACTERISTIC
/begin CHARACTERISTIC DINH_Lim.DFC_MonLimCurr_CA "DINH/Zugeordnete Verriegelungslimits für Verriegelungsquelle DFC_MonLimCurr" VAL_BLK 0x80028724 ValA_Wu16 8192.00000000 DINH_LimDFCVerb 12079.0000000 20271.0000000 FORMAT "%13.7" NUMBER 2 /end CHARACTERISTIC
/begin CHARACTERISTIC DINH_Lim.DFC_MonLimLead_CA "DINH/Zugeordnete Verriegelungslimits für Verriegelungsquelle DFC_MonLimLead" VAL_BLK 0x80028728 ValA_Wu16 8192.00000000 DINH_LimDFCVerb 12079.0000000 20271.0000000 FORMAT "%13.7" NUMBER 2 /end CHARACTERISTIC
/begin CHARACTERISTIC DINH_Lim.DFC_MonLimSet_CA "DINH/Zugeordnete Verriegelungslimits für Verriegelungsquelle DFC_MonLimSet" VAL_BLK 0x8002872C ValA_Wu16 8192.00000000 DINH_LimDFCVerb 12079.0000000 20271.0000000 FORMAT "%13.7" NUMBER 2 /end CHARACTERISTIC
/begin CHARACTERISTIC DINH_Lim.DFC_NSCDsNOxOfsMax_CA "DINH/Zugeordnete Verriegelungslimits für Verriegelungsquelle DFC_NSCDsNOxOfsMax" VAL_BLK 0x80028730 ValA_Wu16 8192.00000000 DINH_LimDFCVerb 12079.0000000 20271.0000000 FORMAT "%13.7" NUMBER 2 /end CHARACTERISTIC
/begin CHARACTERISTIC DINH_Lim.DFC_NSCDsNOxOfsMin_CA "DINH/Zugeordnete Verriegelungslimits für Verriegelungsquelle DFC_NSCDsNOxOfsMin" VAL_BLK 0x80028734 ValA_Wu16 8192.00000000 DINH_LimDFCVerb 12079.0000000 20271.0000000 FORMAT "%13.7" NUMBER 2 /end CHARACTERISTIC
/begin CHARACTERISTIC DINH_Lim.DFC_NSCDsNOxPlausMin_CA "DINH/Zugeordnete Verriegelungslimits für Verriegelungsquelle DFC_NSCDsNOxPlausMin" VAL_BLK 0x80028738 ValA_Wu16 8192.00000000 DINH_LimDFCVerb 12079.0000000 20271.0000000 FORMAT "%13.7" NUMBER 3 /end CHARACTERISTIC
/begin CHARACTERISTIC DINH_Lim.DFC_NoCat2DsNOxOfsMax_CA "DINH/Zugeordnete Verriegelungslimits für Verriegelungsquelle DFC_NoCat2DsNOxOfsMax" VAL_BLK 0x8002873E ValA_Wu16 8192.00000000 DINH_LimDFCVerb 12079.0000000 20271.0000000 FORMAT "%13.7" NUMBER 2 /end CHARACTERISTIC
/begin CHARACTERISTIC DINH_Lim.DFC_NoCat2DsNOxOfsMin_CA "DINH/Zugeordnete Verriegelungslimits für Verriegelungsquelle DFC_NoCat2DsNOxOfsMin" VAL_BLK 0x80028742 ValA_Wu16 8192.00000000 DINH_LimDFCVerb 12079.0000000 20271.0000000 FORMAT "%13.7" NUMBER 2 /end CHARACTERISTIC
/begin CHARACTERISTIC DINH_Lim.DFC_NoCat2DsNOxPlausMin_CA "DINH/Zugeordnete Verriegelungslimits für Verriegelungsquelle DFC_NoCat2DsNOxPlausMin" VAL_BLK 0x80028746 ValA_Wu16 8192.00000000 DINH_LimDFCVerb 12079.0000000 20271.0000000 FORMAT "%13.7" NUMBER 3 /end CHARACTERISTIC
/begin CHARACTERISTIC DINH_Lim.DFC_PCVNoStrt_CA "DINH/Zugeordnete Verriegelungslimits für Verriegelungsquelle DFC_PCVNoStrt" VAL_BLK 0x8002874C ValA_Wu16 8192.00000000 DINH_LimDFCVerb 12079.0000000 20271.0000000 FORMAT "%13.7" NUMBER 2 /end CHARACTERISTIC
/begin CHARACTERISTIC DINH_Lim.DFC_RailPGradMon_CA "DINH/Zugeordnete Verriegelungslimits für Verriegelungsquelle DFC_RailPGradMon" VAL_BLK 0x80028750 ValA_Wu16 8192.00000000 DINH_LimDFCVerb 12079.0000000 20271.0000000 FORMAT "%13.7" NUMBER 2 /end CHARACTERISTIC
/begin CHARACTERISTIC DINH_Lim.DFC_SCRPODPresBuildUp_CA "DINH/Zugeordnete Verriegelungslimits für Verriegelungsquelle DFC_SCRPODPresBuildUp" VAL_BLK 0x80028754 ValA_Wu16 8192.00000000 DINH_LimDFCVerb 12079.0000000 20271.0000000 FORMAT "%13.7" NUMBER 2 /end CHARACTERISTIC
/begin CHARACTERISTIC DINH_Lim.DFC_AFSDrftIdlAdjVal_CA "DINH/Zugeordnete Verriegelungslimits für Verriegelungsquelle DFC_AFSDrftIdlAdjVal" VAL_BLK 0x80028758 ValA_Wu16 8192.00000000 DINH_LimDFCVerb 12079.0000000 20271.0000000 FORMAT "%13.7" NUMBER 6 /end CHARACTERISTIC
/begin CHARACTERISTIC DINH_Lim.DFC_AFSDrftLdAdjVal_CA "DINH/Zugeordnete Verriegelungslimits für Verriegelungsquelle DFC_AFSDrftLdAdjVal" VAL_BLK 0x80028764 ValA_Wu16 8192.00000000 DINH_LimDFCVerb 12079.0000000 20271.0000000 FORMAT "%13.7" NUMBER 6 /end CHARACTERISTIC
/begin CHARACTERISTIC DINH_Lim.DFC_AdcIADC0Cal_CA "DINH/Zugeordnete Verriegelungslimits für Verriegelungsquelle DFC_AdcIADC0Cal" VAL_BLK 0x80028770 ValA_Wu16 8192.00000000 DINH_LimDFCVerb 12079.0000000 20271.0000000 FORMAT "%13.7" NUMBER 3 /end CHARACTERISTIC
/begin CHARACTERISTIC DINH_Lim.DFC_AdcIADC0Conv_CA "DINH/Zugeordnete Verriegelungslimits für Verriegelungsquelle DFC_AdcIADC0Conv" VAL_BLK 0x80028776 ValA_Wu16 8192.00000000 DINH_LimDFCVerb 12079.0000000 20271.0000000 FORMAT "%13.7" NUMBER 3 /end CHARACTERISTIC
/begin CHARACTERISTIC DINH_Lim.DFC_AdcIADC1Cal_CA "DINH/Zugeordnete Verriegelungslimits für Verriegelungsquelle DFC_AdcIADC1Cal" VAL_BLK 0x8002877C ValA_Wu16 8192.00000000 DINH_LimDFCVerb 12079.0000000 20271.0000000 FORMAT "%13.7" NUMBER 3 /end CHARACTERISTIC
/begin CHARACTERISTIC DINH_Lim.DFC_AdcIADC1Conv_CA "DINH/Zugeordnete Verriegelungslimits für Verriegelungsquelle DFC_AdcIADC1Conv" VAL_BLK 0x80028782 ValA_Wu16 8192.00000000 DINH_LimDFCVerb 12079.0000000 20271.0000000 FORMAT "%13.7" NUMBER 3 /end CHARACTERISTIC
/begin CHARACTERISTIC DINH_Lim.DFC_CmbChbMisfireMax_0_CA "DINH/Zugeordnete Verriegelungslimits für Verriegelungsquelle DFC_CmbChbMisfireMax_0" VAL_BLK 0x80028788 ValA_Wu16 8192.00000000 DINH_LimDFCVerb 12079.0000000 20271.0000000 FORMAT "%13.7" NUMBER 2 /end CHARACTERISTIC
/begin CHARACTERISTIC DINH_Lim.DFC_CmbChbMisfireMax_1_CA "DINH/Zugeordnete Verriegelungslimits für Verriegelungsquelle DFC_CmbChbMisfireMax_1" VAL_BLK 0x8002878C ValA_Wu16 8192.00000000 DINH_LimDFCVerb 12079.0000000 20271.0000000 FORMAT "%13.7" NUMBER 2 /end CHARACTERISTIC
/begin CHARACTERISTIC DINH_Lim.DFC_CmbChbMisfireMax_2_CA "DINH/Zugeordnete Verriegelungslimits für Verriegelungsquelle DFC_CmbChbMisfireMax_2" VAL_BLK 0x80028790 ValA_Wu16 8192.00000000 DINH_LimDFCVerb 12079.0000000 20271.0000000 FORMAT "%13.7" NUMBER 2 /end CHARACTERISTIC
/begin CHARACTERISTIC DINH_Lim.DFC_CmbChbMisfireMax_3_CA "DINH/Zugeordnete Verriegelungslimits für Verriegelungsquelle DFC_CmbChbMisfireMax_3" VAL_BLK 0x80028794 ValA_Wu16 8192.00000000 DINH_LimDFCVerb 12079.0000000 20271.0000000 FORMAT "%13.7" NUMBER 2 /end CHARACTERISTIC
/begin CHARACTERISTIC DINH_Lim.DFC_CmbChbMisfireMax_4_CA "DINH/Zugeordnete Verriegelungslimits für Verriegelungsquelle DFC_CmbChbMisfireMax_4" VAL_BLK 0x80028798 ValA_Wu16 8192.00000000 DINH_LimDFCVerb 12079.0000000 20271.0000000 FORMAT "%13.7" NUMBER 2 /end CHARACTERISTIC
/begin CHARACTERISTIC DINH_Lim.DFC_CmbChbMisfireMax_5_CA "DINH/Zugeordnete Verriegelungslimits für Verriegelungsquelle DFC_CmbChbMisfireMax_5" VAL_BLK 0x8002879C ValA_Wu16 8192.00000000 DINH_LimDFCVerb 12079.0000000 20271.0000000 FORMAT "%13.7" NUMBER 2 /end CHARACTERISTIC
/begin CHARACTERISTIC DINH_Lim.DFC_CmbChbMisfireMul_CA "DINH/Zugeordnete Verriegelungslimits für Verriegelungsquelle DFC_CmbChbMisfireMul" VAL_BLK 0x800287A0 ValA_Wu16 8192.00000000 DINH_LimDFCVerb 12079.0000000 20271.0000000 FORMAT "%13.7" NUMBER 2 /end CHARACTERISTIC
/begin CHARACTERISTIC DINH_Lim.DFC_EGRVlvLPOfsNeutr_CA "DINH/" VAL_BLK 0x800287A4 ValA_Wu16 8192.00000000 DINH_LimDFCVerb 12079.0000000 20271.0000000 FORMAT "%13.7" NUMBER 2 /end CHARACTERISTIC
/begin CHARACTERISTIC DINH_Lim.DFC_EGRVlvOfsNeutr_CA "DINH/Zugeordnete Verriegelungslimits für Verriegelungsquelle DFC_EGRVlvOfsNeutr" VAL_BLK 0x800287A8 ValA_Wu16 8192.00000000 DINH_LimDFCVerb 12079.0000000 20271.0000000 FORMAT "%13.7" NUMBER 2 /end CHARACTERISTIC
/begin CHARACTERISTIC DINH_Lim.DFC_FMAErrModMax_CA "DINH/Zugeordnete Verriegelungslimits für Verriegelungsquelle DFC_FMAErrModMax" VAL_BLK 0x800287AC ValA_Wu16 8192.00000000 DINH_LimDFCVerb 12079.0000000 20271.0000000 FORMAT "%13.7" NUMBER 2 /end CHARACTERISTIC
/begin CHARACTERISTIC DINH_Lim.DFC_FMAErrModMin_CA "DINH/Zugeordnete Verriegelungslimits für Verriegelungsquelle DFC_FMAErrModMin" VAL_BLK 0x800287B0 ValA_Wu16 8192.00000000 DINH_LimDFCVerb 12079.0000000 20271.0000000 FORMAT "%13.7" NUMBER 2 /end CHARACTERISTIC
/begin CHARACTERISTIC DINH_Lim.DFC_FlSysTnkLo_CA "DINH/Zugeordnete Verriegelungslimits für Verriegelungsquelle DFC_FlSysTnkLo" VAL_BLK 0x800287B4 ValA_Wu16 8192.00000000 DINH_LimDFCVerb 12079.0000000 20271.0000000 FORMAT "%13.7" NUMBER 2 /end CHARACTERISTIC
/begin CHARACTERISTIC DINH_Lim.DFC_GbxNPosPlaus_CA "DINH/Zugeordnete Verriegelungslimits für Verriegelungsquelle DFC_GbxNPosPlaus" VAL_BLK 0x800287B8 ValA_Wu16 8192.00000000 DINH_LimDFCVerb 12079.0000000 20271.0000000 FORMAT "%13.7" NUMBER 2 /end CHARACTERISTIC
/begin CHARACTERISTIC DINH_Lim.DFC_I14229_ROETst_Appl_CA "DINH/" VAL_BLK 0x800287BC ValA_Wu16 8192.00000000 DINH_LimDFCVerb 12079.0000000 20271.0000000 FORMAT "%13.7" NUMBER 2 /end CHARACTERISTIC
/begin CHARACTERISTIC DINH_Lim.DFC_I14229_ROETst_Netw_CA "DINH/" VAL_BLK 0x800287C0 ValA_Wu16 8192.00000000 DINH_LimDFCVerb 12079.0000000 20271.0000000 FORMAT "%13.7" NUMBER 2 /end CHARACTERISTIC
/begin CHARACTERISTIC DINH_Lim.DFC_I14229_ROE_BufFull_CA "DINH/" VAL_BLK 0x800287C4 ValA_Wu16 8192.00000000 DINH_LimDFCVerb 12079.0000000 20271.0000000 FORMAT "%13.7" NUMBER 2 /end CHARACTERISTIC
/begin CHARACTERISTIC DINH_Lim.DFC_IVAdjDiaIVAdj_CA "DINH/Zugeordnete Verriegelungslimits für Verriegelungsquelle DFC_IVAdjDiaIVAdj" VAL_BLK 0x800287C8 ValA_Wu16 8192.00000000 DINH_LimDFCVerb 12079.0000000 20271.0000000 FORMAT "%13.7" NUMBER 2 /end CHARACTERISTIC
/begin CHARACTERISTIC DINH_Lim.DFC_IVAdjIVA_0_CA "DINH/Zugeordnete Verriegelungslimits für Verriegelungsquelle DFC_IVAdjIVA_0" VAL_BLK 0x800287CC ValA_Wu16 8192.00000000 DINH_LimDFCVerb 12079.0000000 20271.0000000 FORMAT "%13.7" NUMBER 2 /end CHARACTERISTIC
/begin CHARACTERISTIC DINH_Lim.DFC_IVAdjIVA_1_CA "DINH/Zugeordnete Verriegelungslimits für Verriegelungsquelle DFC_IVAdjIVA_1" VAL_BLK 0x800287D0 ValA_Wu16 8192.00000000 DINH_LimDFCVerb 12079.0000000 20271.0000000 FORMAT "%13.7" NUMBER 2 /end CHARACTERISTIC
/begin CHARACTERISTIC DINH_Lim.DFC_IVAdjIVA_2_CA "DINH/Zugeordnete Verriegelungslimits für Verriegelungsquelle DFC_IVAdjIVA_2" VAL_BLK 0x800287D4 ValA_Wu16 8192.00000000 DINH_LimDFCVerb 12079.0000000 20271.0000000 FORMAT "%13.7" NUMBER 2 /end CHARACTERISTIC
/begin CHARACTERISTIC DINH_Lim.DFC_IVAdjIVA_3_CA "DINH/Zugeordnete Verriegelungslimits für Verriegelungsquelle DFC_IVAdjIVA_3" VAL_BLK 0x800287D8 ValA_Wu16 8192.00000000 DINH_LimDFCVerb 12079.0000000 20271.0000000 FORMAT "%13.7" NUMBER 2 /end CHARACTERISTIC
/begin CHARACTERISTIC DINH_Lim.DFC_IVAdjIVA_4_CA "DINH/Zugeordnete Verriegelungslimits für Verriegelungsquelle DFC_IVAdjIVA_4" VAL_BLK 0x800287DC ValA_Wu16 8192.00000000 DINH_LimDFCVerb 12079.0000000 20271.0000000 FORMAT "%13.7" NUMBER 2 /end CHARACTERISTIC
/begin CHARACTERISTIC DINH_Lim.DFC_IVAdjIVA_5_CA "DINH/Zugeordnete Verriegelungslimits für Verriegelungsquelle DFC_IVAdjIVA_5" VAL_BLK 0x800287E0 ValA_Wu16 8192.00000000 DINH_LimDFCVerb 12079.0000000 20271.0000000 FORMAT "%13.7" NUMBER 2 /end CHARACTERISTIC
/begin CHARACTERISTIC DINH_Lim.DFC_IVPSplyDCDCOff_0_CA "DINH/Zugeordnete Verriegelungslimits für Verriegelungsquelle DFC_IVPSplyDCDCOff_0" VAL_BLK 0x800287E4 ValA_Wu16 8192.00000000 DINH_LimDFCVerb 12079.0000000 20271.0000000 FORMAT "%13.7" NUMBER 3 /end CHARACTERISTIC
/begin CHARACTERISTIC DINH_Lim.DFC_IVPSplyDCDCOff_1_CA "DINH/Zugeordnete Verriegelungslimits für Verriegelungsquelle DFC_IVPSplyDCDCOff_1" VAL_BLK 0x800287EA ValA_Wu16 8192.00000000 DINH_LimDFCVerb 12079.0000000 20271.0000000 FORMAT "%13.7" NUMBER 3 /end CHARACTERISTIC
/begin CHARACTERISTIC DINH_Lim.DFC_IVPSplyDCDCOff_2_CA "DINH/Zugeordnete Verriegelungslimits für Verriegelungsquelle DFC_IVPSplyDCDCOff_2" VAL_BLK 0x800287F0 ValA_Wu16 8192.00000000 DINH_LimDFCVerb 12079.0000000 20271.0000000 FORMAT "%13.7" NUMBER 3 /end CHARACTERISTIC
/begin CHARACTERISTIC DINH_Lim.DFC_IVPSplyDCDCOff_3_CA "DINH/Zugeordnete Verriegelungslimits für Verriegelungsquelle DFC_IVPSplyDCDCOff_3" VAL_BLK 0x800287F6 ValA_Wu16 8192.00000000 DINH_LimDFCVerb 12079.0000000 20271.0000000 FORMAT "%13.7" NUMBER 3 /end CHARACTERISTIC
/begin CHARACTERISTIC DINH_Lim.DFC_InjCtlAdjQntEEPCS_CA "DINH/Zugeordnete Verriegelungslimits für Verriegelungsquelle DFC_InjCtlAdjQntEEPCS" VAL_BLK 0x800287FC ValA_Wu16 8192.00000000 DINH_LimDFCVerb 12079.0000000 20271.0000000 FORMAT "%13.7" NUMBER 2 /end CHARACTERISTIC
/begin CHARACTERISTIC DINH_Lim.DFC_LSUSPISig_CA "DINH/Zugeordnete Verriegelungslimits für Verriegelungsquelle DFC_LSUSPISig" VAL_BLK 0x80028800 ValA_Wu16 8192.00000000 DINH_LimDFCVerb 12079.0000000 20271.0000000 FORMAT "%13.7" NUMBER 20 /end CHARACTERISTIC
/begin CHARACTERISTIC DINH_Lim.DFC_Layer_Dummy_CA "DINH/Zugeordnete Verriegelungslimits für Verriegelungsquelle DFC_Layer_Dummy" VAL_BLK 0x80028828 ValA_Wu16 8192.00000000 DINH_LimDFCVerb 12079.0000000 20271.0000000 FORMAT "%13.7" NUMBER 2 /end CHARACTERISTIC
/begin CHARACTERISTIC DINH_Lim.DFC_NplEnvPSensPPFltDiff_CA "DINH/Zugeordnete Verriegelungslimits für Verriegelungsquelle DFC_NplEnvPSensPPFltDiff" VAL_BLK 0x8002882C ValA_Wu16 8192.00000000 DINH_LimDFCVerb 12079.0000000 20271.0000000 FORMAT "%13.7" NUMBER 10 /end CHARACTERISTIC
/begin CHARACTERISTIC DINH_Lim.DFC_NplPresSensPPFltDiff_CA "DINH/Zugeordnete Verriegelungslimits für Verriegelungsquelle DFC_NplPresSensPPFltDiff" VAL_BLK 0x80028840 ValA_Wu16 8192.00000000 DINH_LimDFCVerb 12079.0000000 20271.0000000 FORMAT "%13.7" NUMBER 13 /end CHARACTERISTIC
/begin CHARACTERISTIC DINH_Lim.DFC_OilLvlPlaus_CA "DINH/Zugeordnete Verriegelungslimits für Verriegelungsquelle DFC_OilLvlPlaus" VAL_BLK 0x8002885A ValA_Wu16 8192.00000000 DINH_LimDFCVerb 12079.0000000 20271.0000000 FORMAT "%13.7" NUMBER 2 /end CHARACTERISTIC
/begin CHARACTERISTIC DINH_Lim.DFC_OilTOutLvl_CA "DINH/Zugeordnete Verriegelungslimits für Verriegelungsquelle DFC_OilTOutLvl" VAL_BLK 0x8002885E ValA_Wu16 8192.00000000 DINH_LimDFCVerb 12079.0000000 20271.0000000 FORMAT "%13.7" NUMBER 2 /end CHARACTERISTIC
/begin CHARACTERISTIC DINH_Lim.DFC_PCVfacAdaptMax_CA "DINH/Zugeordnete Verriegelungslimits für Verriegelungsquelle DFC_PCVfacAdaptMax" VAL_BLK 0x80028862 ValA_Wu16 8192.00000000 DINH_LimDFCVerb 12079.0000000 20271.0000000 FORMAT "%13.7" NUMBER 2 /end CHARACTERISTIC
/begin CHARACTERISTIC DINH_Lim.DFC_PCVfacAdaptMin_CA "DINH/Zugeordnete Verriegelungslimits für Verriegelungsquelle DFC_PCVfacAdaptMin" VAL_BLK 0x80028866 ValA_Wu16 8192.00000000 DINH_LimDFCVerb 12079.0000000 20271.0000000 FORMAT "%13.7" NUMBER 2 /end CHARACTERISTIC
/begin CHARACTERISTIC DINH_Lim.DFC_SensFrzPPFltUs_CA "DINH/Zugeordnete Verriegelungslimits für Verriegelungsquelle DFC_SensFrzPPFltUs" VAL_BLK 0x8002886A ValA_Wu16 8192.00000000 DINH_LimDFCVerb 12079.0000000 20271.0000000 FORMAT "%13.7" NUMBER 2 /end CHARACTERISTIC
/begin CHARACTERISTIC DINH_Lim.DFC_SensMonUTnkLvl_CA "DINH/Zugeordnete Verriegelungslimits für Verriegelungsquelle DFC_SensMonUTnkLvl" VAL_BLK 0x8002886E ValA_Wu16 8192.00000000 DINH_LimDFCVerb 12079.0000000 20271.0000000 FORMAT "%13.7" NUMBER 4 /end CHARACTERISTIC
/begin CHARACTERISTIC DINH_Lim.DFC_T15Sig_CA "DINH/Zugeordnete Verriegelungslimits für Verriegelungsquelle DFC_T15Sig" VAL_BLK 0x80028876 ValA_Wu16 8192.00000000 DINH_LimDFCVerb 12079.0000000 20271.0000000 FORMAT "%13.7" NUMBER 2 /end CHARACTERISTIC
/begin CHARACTERISTIC DINH_Lim.DFC_AirCtlRmpTOut_CA "DINH/Zugeordnete Verriegelungslimits für Verriegelungsquelle DFC_AirCtlRmpTOut" VAL_BLK 0x8002887A ValA_Wu16 8192.00000000 DINH_LimDFCVerb 12079.0000000 20271.0000000 FORMAT "%13.7" NUMBER 2 /end CHARACTERISTIC
/begin CHARACTERISTIC DINH_Lim.DFC_BrkPPlaus_CA "DINH/Zugeordnete Verriegelungslimits für Verriegelungsquelle DFC_BrkPPlaus" VAL_BLK 0x8002887E ValA_Wu16 8192.00000000 DINH_LimDFCVerb 12079.0000000 20271.0000000 FORMAT "%13.7" NUMBER 2 /end CHARACTERISTIC
/begin CHARACTERISTIC DINH_Lim.DFC_CEngDsTDynTst_CA "DINH/Zugeordnete Verriegelungslimits für Verriegelungsquelle DFC_CEngDsTDynTst" VAL_BLK 0x80028882 ValA_Wu16 8192.00000000 DINH_LimDFCVerb 12079.0000000 20271.0000000 FORMAT "%13.7" NUMBER 2 /end CHARACTERISTIC
/begin CHARACTERISTIC DINH_Lim.DFC_EEPEraseErr_CA "DINH/Zugeordnete Verriegelungslimits für Verriegelungsquelle DFC_EEPEraseErr" VAL_BLK 0x80028886 ValA_Wu16 8192.00000000 DINH_LimDFCVerb 12079.0000000 20271.0000000 FORMAT "%13.7" NUMBER 3 /end CHARACTERISTIC
/begin CHARACTERISTIC DINH_Lim.DFC_EEPRdErr_CA "DINH/Zugeordnete Verriegelungslimits für Verriegelungsquelle DFC_EEPRdErr" VAL_BLK 0x8002888C ValA_Wu16 8192.00000000 DINH_LimDFCVerb 12079.0000000 20271.0000000 FORMAT "%13.7" NUMBER 3 /end CHARACTERISTIC
/begin CHARACTERISTIC DINH_Lim.DFC_EEPWrErr_CA "DINH/Zugeordnete Verriegelungslimits für Verriegelungsquelle DFC_EEPWrErr" VAL_BLK 0x80028892 ValA_Wu16 8192.00000000 DINH_LimDFCVerb 12079.0000000 20271.0000000 FORMAT "%13.7" NUMBER 3 /end CHARACTERISTIC
/begin CHARACTERISTIC DINH_Lim.DFC_EGRVlvJamVlvClsd_CA "DINH/Zugeordnete Verriegelungslimits für Verriegelungsquelle DFC_EGRVlvJamVlvClsd" VAL_BLK 0x80028898 ValA_Wu16 8192.00000000 DINH_LimDFCVerb 12079.0000000 20271.0000000 FORMAT "%13.7" NUMBER 3 /end CHARACTERISTIC
/begin CHARACTERISTIC DINH_Lim.DFC_EGRVlvJamVlvOpn_CA "DINH/Zugeordnete Verriegelungslimits für Verriegelungsquelle DFC_EGRVlvJamVlvOpn" VAL_BLK 0x8002889E ValA_Wu16 8192.00000000 DINH_LimDFCVerb 12079.0000000 20271.0000000 FORMAT "%13.7" NUMBER 3 /end CHARACTERISTIC
/begin CHARACTERISTIC DINH_Lim.DFC_EGRVlvLPJamVlvClsd_CA "DINH/Zugeordnete Verriegelungslimits für Verriegelungsquelle DFC_EGRVlvLPJamVlvClsd" VAL_BLK 0x800288A4 ValA_Wu16 8192.00000000 DINH_LimDFCVerb 12079.0000000 20271.0000000 FORMAT "%13.7" NUMBER 3 /end CHARACTERISTIC
/begin CHARACTERISTIC DINH_Lim.DFC_EGRVlvLPJamVlvOpn_CA "DINH/Zugeordnete Verriegelungslimits für Verriegelungsquelle DFC_EGRVlvLPJamVlvOpn" VAL_BLK 0x800288AA ValA_Wu16 8192.00000000 DINH_LimDFCVerb 12079.0000000 20271.0000000 FORMAT "%13.7" NUMBER 3 /end CHARACTERISTIC
/begin CHARACTERISTIC DINH_Lim.DFC_EGRVlvLPLgTDrft_CA "DINH/Zugeordnete Verriegelungslimits für Verriegelungsquelle DFC_EGRVlvLPLgTDrft" VAL_BLK 0x800288B0 ValA_Wu16 8192.00000000 DINH_LimDFCVerb 12079.0000000 20271.0000000 FORMAT "%13.7" NUMBER 3 /end CHARACTERISTIC
/begin CHARACTERISTIC DINH_Lim.DFC_EGRVlvLPOfsLrnJamVlv_CA "DINH/Zugeordnete Verriegelungslimits für Verriegelungsquelle DFC_EGRVlvLPOfsLrnJamVlv" VAL_BLK 0x800288B6 ValA_Wu16 8192.00000000 DINH_LimDFCVerb 12079.0000000 20271.0000000 FORMAT "%13.7" NUMBER 3 /end CHARACTERISTIC
/begin CHARACTERISTIC DINH_Lim.DFC_EGRVlvLPShTDrft_CA "DINH/Zugeordnete Verriegelungslimits für Verriegelungsquelle DFC_EGRVlvLPShTDrft" VAL_BLK 0x800288BC ValA_Wu16 8192.00000000 DINH_LimDFCVerb 12079.0000000 20271.0000000 FORMAT "%13.7" NUMBER 3 /end CHARACTERISTIC
/begin CHARACTERISTIC DINH_Lim.DFC_EGRVlvLgTDrft_CA "DINH/Zugeordnete Verriegelungslimits für Verriegelungsquelle DFC_EGRVlvLgTDrft" VAL_BLK 0x800288C2 ValA_Wu16 8192.00000000 DINH_LimDFCVerb 12079.0000000 20271.0000000 FORMAT "%13.7" NUMBER 3 /end CHARACTERISTIC
/begin CHARACTERISTIC DINH_Lim.DFC_EGRVlvOfsLrnJamVlv_CA "DINH/Zugeordnete Verriegelungslimits für Verriegelungsquelle DFC_EGRVlvOfsLrnJamVlv" VAL_BLK 0x800288C8 ValA_Wu16 8192.00000000 DINH_LimDFCVerb 12079.0000000 20271.0000000 FORMAT "%13.7" NUMBER 3 /end CHARACTERISTIC
/begin CHARACTERISTIC DINH_Lim.DFC_EGRVlvShTDrft_CA "DINH/Zugeordnete Verriegelungslimits für Verriegelungsquelle DFC_EGRVlvShTDrft" VAL_BLK 0x800288CE ValA_Wu16 8192.00000000 DINH_LimDFCVerb 12079.0000000 20271.0000000 FORMAT "%13.7" NUMBER 3 /end CHARACTERISTIC
/begin CHARACTERISTIC DINH_Lim.DFC_EngICO_CA "DINH/Zugeordnete Verriegelungslimits für Verriegelungsquelle DFC_EngICO" VAL_BLK 0x800288D4 ValA_Wu16 8192.00000000 DINH_LimDFCVerb 12079.0000000 20271.0000000 FORMAT "%13.7" NUMBER 3 /end CHARACTERISTIC
/begin CHARACTERISTIC DINH_Lim.DFC_EpmCaSI1ErrSig_CA "DINH/Zugeordnete Verriegelungslimits für Verriegelungsquelle DFC_EpmCaSI1ErrSig" VAL_BLK 0x800288DA ValA_Wu16 8192.00000000 DINH_LimDFCVerb 12079.0000000 20271.0000000 FORMAT "%13.7" NUMBER 7 /end CHARACTERISTIC
/begin CHARACTERISTIC DINH_Lim.DFC_EpmCaSI1NoSig_CA "DINH/Zugeordnete Verriegelungslimits für Verriegelungsquelle DFC_EpmCaSI1NoSig" VAL_BLK 0x800288E8 ValA_Wu16 8192.00000000 DINH_LimDFCVerb 12079.0000000 20271.0000000 FORMAT "%13.7" NUMBER 9 /end CHARACTERISTIC
/begin CHARACTERISTIC DINH_Lim.DFC_EpmCaSI1OfsErr_CA "DINH/Zugeordnete Verriegelungslimits für Verriegelungsquelle DFC_EpmCaSI1OfsErr" VAL_BLK 0x800288FA ValA_Wu16 8192.00000000 DINH_LimDFCVerb 12079.0000000 20271.0000000 FORMAT "%13.7" NUMBER 5 /end CHARACTERISTIC
/begin CHARACTERISTIC DINH_Lim.DFC_EpmCrSErrSig_CA "DINH/Zugeordnete Verriegelungslimits für Verriegelungsquelle DFC_EpmCrSErrSig" VAL_BLK 0x80028904 ValA_Wu16 8192.00000000 DINH_LimDFCVerb 12079.0000000 20271.0000000 FORMAT "%13.7" NUMBER 22 /end CHARACTERISTIC
/begin CHARACTERISTIC DINH_Lim.DFC_EpmCrSNoSig_CA "DINH/Zugeordnete Verriegelungslimits für Verriegelungsquelle DFC_EpmCrSNoSig" VAL_BLK 0x80028930 ValA_Wu16 8192.00000000 DINH_LimDFCVerb 12079.0000000 20271.0000000 FORMAT "%13.7" NUMBER 24 /end CHARACTERISTIC
/begin CHARACTERISTIC DINH_Lim.DFC_IVPlausComprTst_CA "DINH/Zugeordnete Verriegelungslimits für Verriegelungsquelle DFC_IVPlausComprTst" VAL_BLK 0x80028960 ValA_Wu16 8192.00000000 DINH_LimDFCVerb 12079.0000000 20271.0000000 FORMAT "%13.7" NUMBER 2 /end CHARACTERISTIC
/begin CHARACTERISTIC DINH_Lim.DFC_IVPlausRunUpTst_CA "DINH/Zugeordnete Verriegelungslimits für Verriegelungsquelle DFC_IVPlausRunUpTst" VAL_BLK 0x80028964 ValA_Wu16 8192.00000000 DINH_LimDFCVerb 12079.0000000 20271.0000000 FORMAT "%13.7" NUMBER 9 /end CHARACTERISTIC
/begin CHARACTERISTIC DINH_Lim.DFC_InjCrvShOffTst_CA "DINH/Zugeordnete Verriegelungslimits für Verriegelungsquelle DFC_InjCrvShOffTst" VAL_BLK 0x80028976 ValA_Wu16 8192.00000000 DINH_LimDFCVerb 12079.0000000 20271.0000000 FORMAT "%13.7" NUMBER 2 /end CHARACTERISTIC
/begin CHARACTERISTIC DINH_Lim.DFC_LayerEnSavModProd_CA "DINH/Zugeordnete Verriegelungslimits für Verriegelungsquelle DFC_LayerEnSavModProd" VAL_BLK 0x8002897A ValA_Wu16 8192.00000000 DINH_LimDFCVerb 12079.0000000 20271.0000000 FORMAT "%13.7" NUMBER 3 /end CHARACTERISTIC
/begin CHARACTERISTIC DINH_Lim.DFC_LayerEnSavModRep_CA "DINH/Zugeordnete Verriegelungslimits für Verriegelungsquelle DFC_LayerEnSavModRep" VAL_BLK 0x80028980 ValA_Wu16 8192.00000000 DINH_LimDFCVerb 12079.0000000 20271.0000000 FORMAT "%13.7" NUMBER 3 /end CHARACTERISTIC
/begin CHARACTERISTIC DINH_Lim.DFC_LayerEnSavModShip_CA "DINH/Zugeordnete Verriegelungslimits für Verriegelungsquelle DFC_LayerEnSavModShip" VAL_BLK 0x80028986 ValA_Wu16 8192.00000000 DINH_LimDFCVerb 12079.0000000 20271.0000000 FORMAT "%13.7" NUMBER 3 /end CHARACTERISTIC
/begin CHARACTERISTIC DINH_Lim.DFC_MRlyErlyOpng_CA "DINH/Zugeordnete Verriegelungslimits für Verriegelungsquelle DFC_MRlyErlyOpng" VAL_BLK 0x8002898C ValA_Wu16 8192.00000000 DINH_LimDFCVerb 12079.0000000 20271.0000000 FORMAT "%13.7" NUMBER 2 /end CHARACTERISTIC
/begin CHARACTERISTIC DINH_Lim.DFC_MRlyStk_CA "DINH/Zugeordnete Verriegelungslimits für Verriegelungsquelle DFC_MRlyStk" VAL_BLK 0x80028990 ValA_Wu16 8192.00000000 DINH_LimDFCVerb 12079.0000000 20271.0000000 FORMAT "%13.7" NUMBER 2 /end CHARACTERISTIC
/begin CHARACTERISTIC DINH_Lim.DFC_MeUnActrTst_CA "DINH/Zugeordnete Verriegelungslimits für Verriegelungsquelle DFC_MeUnActrTst" VAL_BLK 0x80028994 ValA_Wu16 8192.00000000 DINH_LimDFCVerb 12079.0000000 20271.0000000 FORMAT "%13.7" NUMBER 2 /end CHARACTERISTIC
/begin CHARACTERISTIC DINH_Lim.DFC_MoCADCCmp_CA "DINH/Zugeordnete Verriegelungslimits für Verriegelungsquelle DFC_MoCADCCmp" VAL_BLK 0x80028998 ValA_Wu16 8192.00000000 DINH_LimDFCVerb 12079.0000000 20271.0000000 FORMAT "%13.7" NUMBER 2 /end CHARACTERISTIC
/begin CHARACTERISTIC DINH_Lim.DFC_MoCADCTst_CA "DINH/Zugeordnete Verriegelungslimits für Verriegelungsquelle DFC_MoCADCTst" VAL_BLK 0x8002899C ValA_Wu16 8192.00000000 DINH_LimDFCVerb 12079.0000000 20271.0000000 FORMAT "%13.7" NUMBER 2 /end CHARACTERISTIC
/begin CHARACTERISTIC DINH_Lim.DFC_MoCADCVltgRatio_CA "DINH/Zugeordnete Verriegelungslimits für Verriegelungsquelle DFC_MoCADCVltgRatio" VAL_BLK 0x800289A0 ValA_Wu16 8192.00000000 DINH_LimDFCVerb 12079.0000000 20271.0000000 FORMAT "%13.7" NUMBER 2 /end CHARACTERISTIC
/begin CHARACTERISTIC DINH_Lim.DFC_MoCComErrCnt_CA "DINH/Zugeordnete Verriegelungslimits für Verriegelungsquelle DFC_MoCComErrCnt" VAL_BLK 0x800289A4 ValA_Wu16 8192.00000000 DINH_LimDFCVerb 12079.0000000 20271.0000000 FORMAT "%13.7" NUMBER 2 /end CHARACTERISTIC
/begin CHARACTERISTIC DINH_Lim.DFC_MoCComSPI_CA "DINH/Zugeordnete Verriegelungslimits für Verriegelungsquelle DFC_MoCComSPI" VAL_BLK 0x800289A8 ValA_Wu16 8192.00000000 DINH_LimDFCVerb 12079.0000000 20271.0000000 FORMAT "%13.7" NUMBER 2 /end CHARACTERISTIC
/begin CHARACTERISTIC DINH_Lim.DFC_MoCROMErrXPg_CA "DINH/Zugeordnete Verriegelungslimits für Verriegelungsquelle DFC_MoCROMErrXPg" VAL_BLK 0x800289AC ValA_Wu16 8192.00000000 DINH_LimDFCVerb 12079.0000000 20271.0000000 FORMAT "%13.7" NUMBER 2 /end CHARACTERISTIC
/begin CHARACTERISTIC DINH_Lim.DFC_MoCSOPHwNoRdy_CA "DINH/Zugeordnete Verriegelungslimits für Verriegelungsquelle DFC_MoCSOPHwNoRdy" VAL_BLK 0x800289B0 ValA_Wu16 8192.00000000 DINH_LimDFCVerb 12079.0000000 20271.0000000 FORMAT "%13.7" NUMBER 3 /end CHARACTERISTIC
/begin CHARACTERISTIC DINH_Lim.DFC_MoCSOPLoLi_CA "DINH/Zugeordnete Verriegelungslimits für Verriegelungsquelle DFC_MoCSOPLoLi" VAL_BLK 0x800289B6 ValA_Wu16 8192.00000000 DINH_LimDFCVerb 12079.0000000 20271.0000000 FORMAT "%13.7" NUMBER 4 /end CHARACTERISTIC
/begin CHARACTERISTIC DINH_Lim.DFC_MoCSOPMM_CA "DINH/Zugeordnete Verriegelungslimits für Verriegelungsquelle DFC_MoCSOPMM" VAL_BLK 0x800289BE ValA_Wu16 8192.00000000 DINH_LimDFCVerb 12079.0000000 20271.0000000 FORMAT "%13.7" NUMBER 4 /end CHARACTERISTIC
/begin CHARACTERISTIC DINH_Lim.DFC_MoCSOPTimeOut_CA "DINH/Zugeordnete Verriegelungslimits für Verriegelungsquelle DFC_MoCSOPTimeOut" VAL_BLK 0x800289C6 ValA_Wu16 8192.00000000 DINH_LimDFCVerb 12079.0000000 20271.0000000 FORMAT "%13.7" NUMBER 4 /end CHARACTERISTIC
/begin CHARACTERISTIC DINH_Lim.DFC_MoCSOPUpLi_CA "DINH/Zugeordnete Verriegelungslimits für Verriegelungsquelle DFC_MoCSOPUpLi" VAL_BLK 0x800289CE ValA_Wu16 8192.00000000 DINH_LimDFCVerb 12079.0000000 20271.0000000 FORMAT "%13.7" NUMBER 4 /end CHARACTERISTIC
/begin CHARACTERISTIC DINH_Lim.DFC_MoFAPP_CA "DINH/Zugeordnete Verriegelungslimits für Verriegelungsquelle DFC_MoFAPP" VAL_BLK 0x800289D6 ValA_Wu16 8192.00000000 DINH_LimDFCVerb 12079.0000000 20271.0000000 FORMAT "%13.7" NUMBER 2 /end CHARACTERISTIC
/begin CHARACTERISTIC DINH_Lim.DFC_MoFESpd_CA "DINH/Zugeordnete Verriegelungslimits für Verriegelungsquelle DFC_MoFESpd" VAL_BLK 0x800289DA ValA_Wu16 8192.00000000 DINH_LimDFCVerb 12079.0000000 20271.0000000 FORMAT "%13.7" NUMBER 2 /end CHARACTERISTIC
/begin CHARACTERISTIC DINH_Lim.DFC_MoFInjDatPhi_CA "DINH/Zugeordnete Verriegelungslimits für Verriegelungsquelle DFC_MoFInjDatPhi" VAL_BLK 0x800289DE ValA_Wu16 8192.00000000 DINH_LimDFCVerb 12079.0000000 20271.0000000 FORMAT "%13.7" NUMBER 2 /end CHARACTERISTIC
/begin CHARACTERISTIC DINH_Lim.DFC_MoFInjDatQnt_CA "DINH/Zugeordnete Verriegelungslimits für Verriegelungsquelle DFC_MoFInjDatQnt" VAL_BLK 0x800289E2 ValA_Wu16 8192.00000000 DINH_LimDFCVerb 12079.0000000 20271.0000000 FORMAT "%13.7" NUMBER 2 /end CHARACTERISTIC
/begin CHARACTERISTIC DINH_Lim.DFC_MoFInjQnt_CA "DINH/Zugeordnete Verriegelungslimits für Verriegelungsquelle DFC_MoFInjQnt" VAL_BLK 0x800289E6 ValA_Wu16 8192.00000000 DINH_LimDFCVerb 12079.0000000 20271.0000000 FORMAT "%13.7" NUMBER 2 /end CHARACTERISTIC
/begin CHARACTERISTIC DINH_Lim.DFC_MoFMode1PoI1_CA "DINH/Zugeordnete Verriegelungslimits für Verriegelungsquelle DFC_MoFMode1PoI1" VAL_BLK 0x800289EA ValA_Wu16 8192.00000000 DINH_LimDFCVerb 12079.0000000 20271.0000000 FORMAT "%13.7" NUMBER 2 /end CHARACTERISTIC
/begin CHARACTERISTIC DINH_Lim.DFC_MoFMode1PoI2_CA "DINH/Zugeordnete Verriegelungslimits für Verriegelungsquelle DFC_MoFMode1PoI2" VAL_BLK 0x800289EE ValA_Wu16 8192.00000000 DINH_LimDFCVerb 12079.0000000 20271.0000000 FORMAT "%13.7" NUMBER 2 /end CHARACTERISTIC
/begin CHARACTERISTIC DINH_Lim.DFC_MoFMode2PoI1_CA "DINH/Zugeordnete Verriegelungslimits für Verriegelungsquelle DFC_MoFMode2PoI1" VAL_BLK 0x800289F2 ValA_Wu16 8192.00000000 DINH_LimDFCVerb 12079.0000000 20271.0000000 FORMAT "%13.7" NUMBER 2 /end CHARACTERISTIC
/begin CHARACTERISTIC DINH_Lim.DFC_MoFMode2PoI2_CA "DINH/Zugeordnete Verriegelungslimits für Verriegelungsquelle DFC_MoFMode2PoI2" VAL_BLK 0x800289F6 ValA_Wu16 8192.00000000 DINH_LimDFCVerb 12079.0000000 20271.0000000 FORMAT "%13.7" NUMBER 2 /end CHARACTERISTIC
/begin CHARACTERISTIC DINH_Lim.DFC_MoFOvR_CA "DINH/Zugeordnete Verriegelungslimits für Verriegelungsquelle DFC_MoFOvR" VAL_BLK 0x800289FA ValA_Wu16 8192.00000000 DINH_LimDFCVerb 12079.0000000 20271.0000000 FORMAT "%13.7" NUMBER 2 /end CHARACTERISTIC
/begin CHARACTERISTIC DINH_Lim.DFC_MoFQntCor_CA "DINH/Zugeordnete Verriegelungslimits für Verriegelungsquelle DFC_MoFQntCor" VAL_BLK 0x800289FE ValA_Wu16 8192.00000000 DINH_LimDFCVerb 12079.0000000 20271.0000000 FORMAT "%13.7" NUMBER 2 /end CHARACTERISTIC
/begin CHARACTERISTIC DINH_Lim.DFC_MoFRailP_CA "DINH/Zugeordnete Verriegelungslimits für Verriegelungsquelle DFC_MoFRailP" VAL_BLK 0x80028A02 ValA_Wu16 8192.00000000 DINH_LimDFCVerb 12079.0000000 20271.0000000 FORMAT "%13.7" NUMBER 2 /end CHARACTERISTIC
/begin CHARACTERISTIC DINH_Lim.DFC_MoFTrqCmp_CA "DINH/Zugeordnete Verriegelungslimits für Verriegelungsquelle DFC_MoFTrqCmp" VAL_BLK 0x80028A06 ValA_Wu16 8192.00000000 DINH_LimDFCVerb 12079.0000000 20271.0000000 FORMAT "%13.7" NUMBER 2 /end CHARACTERISTIC
/begin CHARACTERISTIC DINH_Lim.DFC_NSCDsHtrSetP_CA "DINH/Zugeordnete Verriegelungslimits für Verriegelungsquelle DFC_NSCDsHtrSetP" VAL_BLK 0x80028A0A ValA_Wu16 8192.00000000 DINH_LimDFCVerb 12079.0000000 20271.0000000 FORMAT "%13.7" NUMBER 3 /end CHARACTERISTIC
/begin CHARACTERISTIC DINH_Lim.DFC_NoCat2DsHtrSetP_CA "DINH/Zugeordnete Verriegelungslimits für Verriegelungsquelle DFC_NoCat2DsHtrSetP" VAL_BLK 0x80028A10 ValA_Wu16 8192.00000000 DINH_LimDFCVerb 12079.0000000 20271.0000000 FORMAT "%13.7" NUMBER 3 /end CHARACTERISTIC
/begin CHARACTERISTIC DINH_Lim.DFC_PCVActrTst_CA "DINH/Zugeordnete Verriegelungslimits für Verriegelungsquelle DFC_PCVActrTst" VAL_BLK 0x80028A16 ValA_Wu16 8192.00000000 DINH_LimDFCVerb 12079.0000000 20271.0000000 FORMAT "%13.7" NUMBER 2 /end CHARACTERISTIC
/begin CHARACTERISTIC DINH_Lim.DFC_PhyModNonMonMapNpl_CA "DINH/Zugeordnete Verriegelungslimits für Verriegelungsquelle DFC_PhyModNonMonMapNpl" VAL_BLK 0x80028A1A ValA_Wu16 8192.00000000 DINH_LimDFCVerb 12079.0000000 20271.0000000 FORMAT "%13.7" NUMBER 2 /end CHARACTERISTIC
/begin CHARACTERISTIC DINH_Lim.DFC_RailHpTst_CA "DINH/Zugeordnete Verriegelungslimits für Verriegelungsquelle DFC_RailHpTst" VAL_BLK 0x80028A1E ValA_Wu16 8192.00000000 DINH_LimDFCVerb 12079.0000000 20271.0000000 FORMAT "%13.7" NUMBER 10 /end CHARACTERISTIC
/begin CHARACTERISTIC DINH_Lim.DFC_RailPOfsTstMax_CA "DINH/Zugeordnete Verriegelungslimits für Verriegelungsquelle DFC_RailPOfsTstMax" VAL_BLK 0x80028A32 ValA_Wu16 8192.00000000 DINH_LimDFCVerb 12079.0000000 20271.0000000 FORMAT "%13.7" NUMBER 11 /end CHARACTERISTIC
/begin CHARACTERISTIC DINH_Lim.DFC_RailPOfsTstMin_CA "DINH/Zugeordnete Verriegelungslimits für Verriegelungsquelle DFC_RailPOfsTstMin" VAL_BLK 0x80028A48 ValA_Wu16 8192.00000000 DINH_LimDFCVerb 12079.0000000 20271.0000000 FORMAT "%13.7" NUMBER 11 /end CHARACTERISTIC
/begin CHARACTERISTIC DINH_Lim.DFC_SIA_E1max_CA "DINH/Zugeordnete Verriegelungslimits für Verriegelungsquelle DFC_SIA_E1max" VAL_BLK 0x80028A5E ValA_Wu16 8192.00000000 DINH_LimDFCVerb 12079.0000000 20271.0000000 FORMAT "%13.7" NUMBER 2 /end CHARACTERISTIC
/begin CHARACTERISTIC DINH_Lim.DFC_SIA_E1min_CA "DINH/Zugeordnete Verriegelungslimits für Verriegelungsquelle DFC_SIA_E1min" VAL_BLK 0x80028A62 ValA_Wu16 8192.00000000 DINH_LimDFCVerb 12079.0000000 20271.0000000 FORMAT "%13.7" NUMBER 2 /end CHARACTERISTIC
/begin CHARACTERISTIC DINH_Lim.DFC_SIA_E1npl_CA "DINH/Zugeordnete Verriegelungslimits für Verriegelungsquelle DFC_SIA_E1npl" VAL_BLK 0x80028A66 ValA_Wu16 8192.00000000 DINH_LimDFCVerb 12079.0000000 20271.0000000 FORMAT "%13.7" NUMBER 2 /end CHARACTERISTIC
/begin CHARACTERISTIC DINH_Lim.DFC_SIA_E1sig_CA "DINH/Zugeordnete Verriegelungslimits für Verriegelungsquelle DFC_SIA_E1sig" VAL_BLK 0x80028A6A ValA_Wu16 8192.00000000 DINH_LimDFCVerb 12079.0000000 20271.0000000 FORMAT "%13.7" NUMBER 2 /end CHARACTERISTIC
/begin CHARACTERISTIC DINH_Lim.DFC_SIA_E2max_CA "DINH/Zugeordnete Verriegelungslimits für Verriegelungsquelle DFC_SIA_E2max" VAL_BLK 0x80028A6E ValA_Wu16 8192.00000000 DINH_LimDFCVerb 12079.0000000 20271.0000000 FORMAT "%13.7" NUMBER 2 /end CHARACTERISTIC
/begin CHARACTERISTIC DINH_Lim.DFC_SIA_E2min_CA "DINH/Zugeordnete Verriegelungslimits für Verriegelungsquelle DFC_SIA_E2min" VAL_BLK 0x80028A72 ValA_Wu16 8192.00000000 DINH_LimDFCVerb 12079.0000000 20271.0000000 FORMAT "%13.7" NUMBER 2 /end CHARACTERISTIC
/begin CHARACTERISTIC DINH_Lim.DFC_SIA_E2npl_CA "DINH/Zugeordnete Verriegelungslimits für Verriegelungsquelle DFC_SIA_E2npl" VAL_BLK 0x80028A76 ValA_Wu16 8192.00000000 DINH_LimDFCVerb 12079.0000000 20271.0000000 FORMAT "%13.7" NUMBER 2 /end CHARACTERISTIC
/begin CHARACTERISTIC DINH_Lim.DFC_SIA_E2sig_CA "DINH/Zugeordnete Verriegelungslimits für Verriegelungsquelle DFC_SIA_E2sig" VAL_BLK 0x80028A7A ValA_Wu16 8192.00000000 DINH_LimDFCVerb 12079.0000000 20271.0000000 FORMAT "%13.7" NUMBER 2 /end CHARACTERISTIC
/begin CHARACTERISTIC DINH_Lim.DFC_SIA_E3max_CA "DINH/Zugeordnete Verriegelungslimits für Verriegelungsquelle DFC_SIA_E3max" VAL_BLK 0x80028A7E ValA_Wu16 8192.00000000 DINH_LimDFCVerb 12079.0000000 20271.0000000 FORMAT "%13.7" NUMBER 2 /end CHARACTERISTIC
/begin CHARACTERISTIC DINH_Lim.DFC_SIA_E3min_CA "DINH/Zugeordnete Verriegelungslimits für Verriegelungsquelle DFC_SIA_E3min" VAL_BLK 0x80028A82 ValA_Wu16 8192.00000000 DINH_LimDFCVerb 12079.0000000 20271.0000000 FORMAT "%13.7" NUMBER 2 /end CHARACTERISTIC
/begin CHARACTERISTIC DINH_Lim.DFC_SIA_E3npl_CA "DINH/Zugeordnete Verriegelungslimits für Verriegelungsquelle DFC_SIA_E3npl" VAL_BLK 0x80028A86 ValA_Wu16 8192.00000000 DINH_LimDFCVerb 12079.0000000 20271.0000000 FORMAT "%13.7" NUMBER 2 /end CHARACTERISTIC
/begin CHARACTERISTIC DINH_Lim.DFC_SIA_E3sig_CA "DINH/Zugeordnete Verriegelungslimits für Verriegelungsquelle DFC_SIA_E3sig" VAL_BLK 0x80028A8A ValA_Wu16 8192.00000000 DINH_LimDFCVerb 12079.0000000 20271.0000000 FORMAT "%13.7" NUMBER 2 /end CHARACTERISTIC
/begin CHARACTERISTIC DINH_Lim.DFC_SIA_E4max_CA "DINH/Zugeordnete Verriegelungslimits für Verriegelungsquelle DFC_SIA_E4max" VAL_BLK 0x80028A8E ValA_Wu16 8192.00000000 DINH_LimDFCVerb 12079.0000000 20271.0000000 FORMAT "%13.7" NUMBER 2 /end CHARACTERISTIC
/begin CHARACTERISTIC DINH_Lim.DFC_SIA_E4min_CA "DINH/Zugeordnete Verriegelungslimits für Verriegelungsquelle DFC_SIA_E4min" VAL_BLK 0x80028A92 ValA_Wu16 8192.00000000 DINH_LimDFCVerb 12079.0000000 20271.0000000 FORMAT "%13.7" NUMBER 2 /end CHARACTERISTIC
/begin CHARACTERISTIC DINH_Lim.DFC_SIA_E4npl_CA "DINH/Zugeordnete Verriegelungslimits für Verriegelungsquelle DFC_SIA_E4npl" VAL_BLK 0x80028A96 ValA_Wu16 8192.00000000 DINH_LimDFCVerb 12079.0000000 20271.0000000 FORMAT "%13.7" NUMBER 2 /end CHARACTERISTIC
/begin CHARACTERISTIC DINH_Lim.DFC_SIA_E4sig_CA "DINH/Zugeordnete Verriegelungslimits für Verriegelungsquelle DFC_SIA_E4sig" VAL_BLK 0x80028A9A ValA_Wu16 8192.00000000 DINH_LimDFCVerb 12079.0000000 20271.0000000 FORMAT "%13.7" NUMBER 2 /end CHARACTERISTIC
/begin CHARACTERISTIC DINH_Lim.DFC_SWReset_0_CA "DINH/Zugeordnete Verriegelungslimits für Verriegelungsquelle DFC_SWReset_0" VAL_BLK 0x80028A9E ValA_Wu16 8192.00000000 DINH_LimDFCVerb 12079.0000000 20271.0000000 FORMAT "%13.7" NUMBER 2 /end CHARACTERISTIC
/begin CHARACTERISTIC DINH_Lim.DFC_SWReset_1_CA "DINH/Zugeordnete Verriegelungslimits für Verriegelungsquelle DFC_SWReset_1" VAL_BLK 0x80028AA2 ValA_Wu16 8192.00000000 DINH_LimDFCVerb 12079.0000000 20271.0000000 FORMAT "%13.7" NUMBER 2 /end CHARACTERISTIC
/begin CHARACTERISTIC DINH_Lim.DFC_SWReset_2_CA "DINH/Zugeordnete Verriegelungslimits für Verriegelungsquelle DFC_SWReset_2" VAL_BLK 0x80028AA6 ValA_Wu16 8192.00000000 DINH_LimDFCVerb 12079.0000000 20271.0000000 FORMAT "%13.7" NUMBER 2 /end CHARACTERISTIC
/begin CHARACTERISTIC DINH_Lim.DFC_ShtrAKKMax_CA "DINH/Zugeordnete Verriegelungslimits für Verriegelungsquelle DFC_ShtrAKKMax" VAL_BLK 0x80028AAA ValA_Wu16 8192.00000000 DINH_LimDFCVerb 12079.0000000 20271.0000000 FORMAT "%13.7" NUMBER 2 /end CHARACTERISTIC
/begin CHARACTERISTIC DINH_Lim.DFC_ShtrAKKMin_CA "DINH/Zugeordnete Verriegelungslimits für Verriegelungsquelle DFC_ShtrAKKMin" VAL_BLK 0x80028AAE ValA_Wu16 8192.00000000 DINH_LimDFCVerb 12079.0000000 20271.0000000 FORMAT "%13.7" NUMBER 2 /end CHARACTERISTIC
/begin CHARACTERISTIC DINH_Lim.DFC_ShtrAKKNpl_CA "DINH/Zugeordnete Verriegelungslimits für Verriegelungsquelle DFC_ShtrAKKNpl" VAL_BLK 0x80028AB2 ValA_Wu16 8192.00000000 DINH_LimDFCVerb 12079.0000000 20271.0000000 FORMAT "%13.7" NUMBER 2 /end CHARACTERISTIC
/begin CHARACTERISTIC DINH_Lim.DFC_ShtrPKKMax_CA "DINH/Zugeordnete Verriegelungslimits für Verriegelungsquelle DFC_ShtrPKKMax" VAL_BLK 0x80028AB6 ValA_Wu16 8192.00000000 DINH_LimDFCVerb 12079.0000000 20271.0000000 FORMAT "%13.7" NUMBER 2 /end CHARACTERISTIC
/begin CHARACTERISTIC DINH_Lim.DFC_StopCntTmr_CA "DINH/Zugeordnete Verriegelungslimits für Verriegelungsquelle DFC_StopCntTmr" VAL_BLK 0x80028ABA ValA_Wu16 8192.00000000 DINH_LimDFCVerb 12079.0000000 20271.0000000 FORMAT "%13.7" NUMBER 2 /end CHARACTERISTIC
/begin CHARACTERISTIC DINH_Lim.DFC_ThrVlvMon_CA "DINH/Zugeordnete Verriegelungslimits für Verriegelungsquelle DFC_ThrVlvMon" VAL_BLK 0x80028ABE ValA_Wu16 8192.00000000 DINH_LimDFCVerb 12079.0000000 20271.0000000 FORMAT "%13.7" NUMBER 2 /end CHARACTERISTIC
/begin CHARACTERISTIC DINH_Lim.DFC_VSwVlvJamVlv_CA "DINH/Zugeordnete Verriegelungslimits für Verriegelungsquelle DFC_VSwVlvJamVlv" VAL_BLK 0x80028AC2 ValA_Wu16 8192.00000000 DINH_LimDFCVerb 12079.0000000 20271.0000000 FORMAT "%13.7" NUMBER 3 /end CHARACTERISTIC
/begin CHARACTERISTIC DINH_Lim.DFC_VSwVlvLgTDrft_CA "DINH/Zugeordnete Verriegelungslimits für Verriegelungsquelle DFC_VSwVlvLgTDrft" VAL_BLK 0x80028AC8 ValA_Wu16 8192.00000000 DINH_LimDFCVerb 12079.0000000 20271.0000000 FORMAT "%13.7" NUMBER 3 /end CHARACTERISTIC
/begin CHARACTERISTIC DINH_Lim.DFC_VSwVlvOfsLrnJamVlv_CA "DINH/Zugeordnete Verriegelungslimits für Verriegelungsquelle DFC_VSwVlvOfsLrnJamVlv" VAL_BLK 0x80028ACE ValA_Wu16 8192.00000000 DINH_LimDFCVerb 12079.0000000 20271.0000000 FORMAT "%13.7" NUMBER 3 /end CHARACTERISTIC
/begin CHARACTERISTIC DINH_Lim.DFC_VSwVlvOfsNeutr_CA "DINH/Zugeordnete Verriegelungslimits für Verriegelungsquelle DFC_VSwVlvOfsNeutr" VAL_BLK 0x80028AD4 ValA_Wu16 8192.00000000 DINH_LimDFCVerb 12079.0000000 20271.0000000 FORMAT "%13.7" NUMBER 2 /end CHARACTERISTIC
/begin CHARACTERISTIC DINH_Lim.DFC_VSwVlvShTDrft_CA "DINH/Zugeordnete Verriegelungslimits für Verriegelungsquelle DFC_VSwVlvShTDrft" VAL_BLK 0x80028AD8 ValA_Wu16 8192.00000000 DINH_LimDFCVerb 12079.0000000 20271.0000000 FORMAT "%13.7" NUMBER 3 /end CHARACTERISTIC
/begin CHARACTERISTIC DINH_Lim.DFC_VSwVlvSpgDef_CA "DINH/Zugeordnete Verriegelungslimits für Verriegelungsquelle DFC_VSwVlvSpgDef" VAL_BLK 0x80028ADE ValA_Wu16 8192.00000000 DINH_LimDFCVerb 12079.0000000 20271.0000000 FORMAT "%13.7" NUMBER 2 /end CHARACTERISTIC
/begin CHARACTERISTIC DINH_Lim.DSQ_AFS_SSpShOffActr_CA "DINH/Zugeordnete Verriegelungslimits für Verriegelungsquelle DSQ_AFS_SSpShOffActr" VAL_BLK 0x80028AE2 ValA_Wu16 15.0000000000 DINH_LimDSQVerb 0.00 15.0000000000 FORMAT "%13.10" NUMBER 3 /end CHARACTERISTIC
/begin CHARACTERISTIC DINH_Lim.DSQ_AirCCmprActr_CA "DINH/Zugeordnete Verriegelungslimits für Verriegelungsquelle DSQ_AirCCmprActr" VAL_BLK 0x80028AE8 ValA_Wu16 15.0000000000 DINH_LimDSQVerb 0.00 15.0000000000 FORMAT "%13.10" NUMBER 2 /end CHARACTERISTIC
/begin CHARACTERISTIC DINH_Lim.DSQ_CEngDsT_CA "DINH/Zugeordnete Verriegelungslimits für Verriegelungsquelle DSQ_CEngDsT" VAL_BLK 0x80028AEC ValA_Wu16 15.0000000000 DINH_LimDSQVerb 0.00 15.0000000000 FORMAT "%13.10" NUMBER 2 /end CHARACTERISTIC
/begin CHARACTERISTIC DINH_Lim.DSQ_CThmstActr_CA "DINH/Zugeordnete Verriegelungslimits für Verriegelungsquelle DSQ_CThmstActr" VAL_BLK 0x80028AF0 ValA_Wu16 15.0000000000 DINH_LimDSQVerb 0.00 15.0000000000 FORMAT "%13.10" NUMBER 2 /end CHARACTERISTIC
/begin CHARACTERISTIC DINH_Lim.DSQ_Com_aDirect_CA "DINH/Zugeordnete Verriegelungslimits für Verriegelungsquelle DSQ_Com_aDirect" VAL_BLK 0x80028AF4 ValA_Wu16 15.0000000000 DINH_LimDSQVerb 0.00 15.0000000000 FORMAT "%13.10" NUMBER 2 /end CHARACTERISTIC
/begin CHARACTERISTIC DINH_Lim.DSQ_Com_aSide_CA "DINH/Zugeordnete Verriegelungslimits für Verriegelungsquelle DSQ_Com_aSide" VAL_BLK 0x80028AF8 ValA_Wu16 15.0000000000 DINH_LimDSQVerb 0.00 15.0000000000 FORMAT "%13.10" NUMBER 2 /end CHARACTERISTIC
/begin CHARACTERISTIC DINH_Lim.DSQ_Com_ctrDay_CA "DINH/Zugeordnete Verriegelungslimits für Verriegelungsquelle DSQ_Com_ctrDay" VAL_BLK 0x80028AFC ValA_Wu16 15.0000000000 DINH_LimDSQVerb 0.00 15.0000000000 FORMAT "%13.10" NUMBER 2 /end CHARACTERISTIC
/begin CHARACTERISTIC DINH_Lim.DSQ_Com_ctrSec_CA "DINH/Zugeordnete Verriegelungslimits für Verriegelungsquelle DSQ_Com_ctrSec" VAL_BLK 0x80028B00 ValA_Wu16 15.0000000000 DINH_LimDSQVerb 0.00 15.0000000000 FORMAT "%13.10" NUMBER 2 /end CHARACTERISTIC
/begin CHARACTERISTIC DINH_Lim.DSQ_Com_ctrSecAbs_CA "DINH/Zugeordnete Verriegelungslimits für Verriegelungsquelle DSQ_Com_ctrSecAbs" VAL_BLK 0x80028B04 ValA_Wu16 15.0000000000 DINH_LimDSQVerb 0.00 15.0000000000 FORMAT "%13.10" NUMBER 3 /end CHARACTERISTIC
/begin CHARACTERISTIC DINH_Lim.DSQ_Com_dDay_CA "DINH/Zugeordnete Verriegelungslimits für Verriegelungsquelle DSQ_Com_dDay" VAL_BLK 0x80028B0A ValA_Wu16 15.0000000000 DINH_LimDSQVerb 0.00 15.0000000000 FORMAT "%13.10" NUMBER 2 /end CHARACTERISTIC
/begin CHARACTERISTIC DINH_Lim.DSQ_Com_dMonth_CA "DINH/Zugeordnete Verriegelungslimits für Verriegelungsquelle DSQ_Com_dMonth" VAL_BLK 0x80028B0E ValA_Wu16 15.0000000000 DINH_LimDSQVerb 0.00 15.0000000000 FORMAT "%13.10" NUMBER 2 /end CHARACTERISTIC
/begin CHARACTERISTIC DINH_Lim.DSQ_Com_dYear_CA "DINH/Zugeordnete Verriegelungslimits für Verriegelungsquelle DSQ_Com_dYear" VAL_BLK 0x80028B12 ValA_Wu16 15.0000000000 DINH_LimDSQVerb 0.00 15.0000000000 FORMAT "%13.10" NUMBER 2 /end CHARACTERISTIC
/begin CHARACTERISTIC DINH_Lim.DSQ_Com_dphiStWhlAg_CA "DINH/Zugeordnete Verriegelungslimits für Verriegelungsquelle DSQ_Com_dphiStWhlAg" VAL_BLK 0x80028B16 ValA_Wu16 15.0000000000 DINH_LimDSQVerb 0.00 15.0000000000 FORMAT "%13.10" NUMBER 2 /end CHARACTERISTIC
/begin CHARACTERISTIC DINH_Lim.DSQ_Com_dvolPspDes_CA "DINH/Zugeordnete Verriegelungslimits für Verriegelungsquelle DSQ_Com_dvolPspDes" VAL_BLK 0x80028B1A ValA_Wu16 15.0000000000 DINH_LimDSQVerb 0.00 15.0000000000 FORMAT "%13.10" NUMBER 2 /end CHARACTERISTIC
/begin CHARACTERISTIC DINH_Lim.DSQ_Com_iHiLimCurr_CA "DINH/Zugeordnete Verriegelungslimits für Verriegelungsquelle DSQ_Com_iHiLimCurr" VAL_BLK 0x80028B1E ValA_Wu16 15.0000000000 DINH_LimDSQVerb 0.00 15.0000000000 FORMAT "%13.10" NUMBER 3 /end CHARACTERISTIC
/begin CHARACTERISTIC DINH_Lim.DSQ_Com_iLoLimCurr_CA "DINH/Zugeordnete Verriegelungslimits für Verriegelungsquelle DSQ_Com_iLoLimCurr" VAL_BLK 0x80028B24 ValA_Wu16 15.0000000000 DINH_LimDSQVerb 0.00 15.0000000000 FORMAT "%13.10" NUMBER 3 /end CHARACTERISTIC
/begin CHARACTERISTIC DINH_Lim.DSQ_Com_iPsp_CA "DINH/Zugeordnete Verriegelungslimits für Verriegelungsquelle DSQ_Com_iPsp" VAL_BLK 0x80028B2A ValA_Wu16 15.0000000000 DINH_LimDSQVerb 0.00 15.0000000000 FORMAT "%13.10" NUMBER 2 /end CHARACTERISTIC
/begin CHARACTERISTIC DINH_Lim.DSQ_Com_iZrLimCurr_CA "DINH/Zugeordnete Verriegelungslimits für Verriegelungsquelle DSQ_Com_iZrLimCurr" VAL_BLK 0x80028B2E ValA_Wu16 15.0000000000 DINH_LimDSQVerb 0.00 15.0000000000 FORMAT "%13.10" NUMBER 3 /end CHARACTERISTIC
/begin CHARACTERISTIC DINH_Lim.DSQ_Com_idParkConsumer_CA "DINH/Zugeordnete Verriegelungslimits für Verriegelungsquelle DSQ_Com_idParkConsumer" VAL_BLK 0x80028B34 ValA_Wu16 15.0000000000 DINH_LimDSQVerb 0.00 15.0000000000 FORMAT "%13.10" NUMBER 2 /end CHARACTERISTIC
/begin CHARACTERISTIC DINH_Lim.DSQ_Com_idVerbraucher_CA "DINH/Zugeordnete Verriegelungslimits für Verriegelungsquelle DSQ_Com_idVerbraucher" VAL_BLK 0x80028B38 ValA_Wu16 15.0000000000 DINH_LimDSQVerb 0.00 15.0000000000 FORMAT "%13.10" NUMBER 3 /end CHARACTERISTIC
/begin CHARACTERISTIC DINH_Lim.DSQ_Com_lFlTnkQntLow_CA "DINH/Zugeordnete Verriegelungslimits für Verriegelungsquelle DSQ_Com_lFlTnkQntLow" VAL_BLK 0x80028B3E ValA_Wu16 15.0000000000 DINH_LimDSQVerb 0.00 15.0000000000 FORMAT "%13.10" NUMBER 2 /end CHARACTERISTIC
/begin CHARACTERISTIC DINH_Lim.DSQ_Com_lSum_CA "DINH/Zugeordnete Verriegelungslimits für Verriegelungsquelle DSQ_Com_lSum" VAL_BLK 0x80028B42 ValA_Wu16 15.0000000000 DINH_LimDSQVerb 0.00 15.0000000000 FORMAT "%13.10" NUMBER 3 /end CHARACTERISTIC
/begin CHARACTERISTIC DINH_Lim.DSQ_Com_nDKG_CA "DINH/Zugeordnete Verriegelungslimits für Verriegelungsquelle DSQ_Com_nDKG" VAL_BLK 0x80028B48 ValA_Wu16 15.0000000000 DINH_LimDSQVerb 0.00 15.0000000000 FORMAT "%13.10" NUMBER 2 /end CHARACTERISTIC
/begin CHARACTERISTIC DINH_Lim.DSQ_Com_nGbxOut_CA "DINH/Zugeordnete Verriegelungslimits für Verriegelungsquelle DSQ_Com_nGbxOut" VAL_BLK 0x80028B4C ValA_Wu16 15.0000000000 DINH_LimDSQVerb 0.00 15.0000000000 FORMAT "%13.10" NUMBER 2 /end CHARACTERISTIC
/begin CHARACTERISTIC DINH_Lim.DSQ_Com_nPsp_CA "DINH/Zugeordnete Verriegelungslimits für Verriegelungsquelle DSQ_Com_nPsp" VAL_BLK 0x80028B50 ValA_Wu16 15.0000000000 DINH_LimDSQVerb 0.00 15.0000000000 FORMAT "%13.10" NUMBER 2 /end CHARACTERISTIC
/begin CHARACTERISTIC DINH_Lim.DSQ_Com_nRqIdlg_CA "DINH/Zugeordnete Verriegelungslimits für Verriegelungsquelle DSQ_Com_nRqIdlg" VAL_BLK 0x80028B54 ValA_Wu16 15.0000000000 DINH_LimDSQVerb 0.00 15.0000000000 FORMAT "%13.10" NUMBER 2 /end CHARACTERISTIC
/begin CHARACTERISTIC DINH_Lim.DSQ_Com_nTSC_CA "DINH/Zugeordnete Verriegelungslimits für Verriegelungsquelle DSQ_Com_nTSC" VAL_BLK 0x80028B58 ValA_Wu16 15.0000000000 DINH_LimDSQVerb 0.00 15.0000000000 FORMAT "%13.10" NUMBER 5 /end CHARACTERISTIC
/begin CHARACTERISTIC DINH_Lim.DSQ_Com_nWhl_CA "DINH/" VAL_BLK 0x80028B62 ValA_Wu16 15.0000000000 DINH_LimDSQVerb 0.00 15.0000000000 FORMAT "%13.10" NUMBER 2 /end CHARACTERISTIC
/begin CHARACTERISTIC DINH_Lim.DSQ_Com_nWhlFL_CA "DINH/Zugeordnete Verriegelungslimits für Verriegelungsquelle DSQ_Com_nWhlFL" VAL_BLK 0x80028B66 ValA_Wu16 15.0000000000 DINH_LimDSQVerb 0.00 15.0000000000 FORMAT "%13.10" NUMBER 2 /end CHARACTERISTIC
/begin CHARACTERISTIC DINH_Lim.DSQ_Com_nWhlFR_CA "DINH/Zugeordnete Verriegelungslimits für Verriegelungsquelle DSQ_Com_nWhlFR" VAL_BLK 0x80028B6A ValA_Wu16 15.0000000000 DINH_LimDSQVerb 0.00 15.0000000000 FORMAT "%13.10" NUMBER 2 /end CHARACTERISTIC
/begin CHARACTERISTIC DINH_Lim.DSQ_Com_nWhlRL_CA "DINH/Zugeordnete Verriegelungslimits für Verriegelungsquelle DSQ_Com_nWhlRL" VAL_BLK 0x80028B6E ValA_Wu16 15.0000000000 DINH_LimDSQVerb 0.00 15.0000000000 FORMAT "%13.10" NUMBER 2 /end CHARACTERISTIC
/begin CHARACTERISTIC DINH_Lim.DSQ_Com_nWhlRR_CA "DINH/Zugeordnete Verriegelungslimits für Verriegelungsquelle DSQ_Com_nWhlRR" VAL_BLK 0x80028B72 ValA_Wu16 15.0000000000 DINH_LimDSQVerb 0.00 15.0000000000 FORMAT "%13.10" NUMBER 2 /end CHARACTERISTIC
/begin CHARACTERISTIC DINH_Lim.DSQ_Com_pBrkSys_CA "DINH/Zugeordnete Verriegelungslimits für Verriegelungsquelle DSQ_Com_pBrkSys" VAL_BLK 0x80028B76 ValA_Wu16 15.0000000000 DINH_LimDSQVerb 0.00 15.0000000000 FORMAT "%13.10" NUMBER 2 /end CHARACTERISTIC
/begin CHARACTERISTIC DINH_Lim.DSQ_Com_phiStWhlAg_CA "DINH/Zugeordnete Verriegelungslimits für Verriegelungsquelle DSQ_Com_phiStWhlAg" VAL_BLK 0x80028B7A ValA_Wu16 15.0000000000 DINH_LimDSQVerb 0.00 15.0000000000 FORMAT "%13.10" NUMBER 2 /end CHARACTERISTIC
/begin CHARACTERISTIC DINH_Lim.DSQ_Com_rACFanDem_CA "DINH/Zugeordnete Verriegelungslimits für Verriegelungsquelle DSQ_Com_rACFanDem" VAL_BLK 0x80028B7E ValA_Wu16 15.0000000000 DINH_LimDSQVerb 0.00 15.0000000000 FORMAT "%13.10" NUMBER 3 /end CHARACTERISTIC
/begin CHARACTERISTIC DINH_Lim.DSQ_Com_rHtFlowReq_CA "DINH/Zugeordnete Verriegelungslimits für Verriegelungsquelle DSQ_Com_rHtFlowReq" VAL_BLK 0x80028B84 ValA_Wu16 15.0000000000 DINH_LimDSQVerb 0.00 15.0000000000 FORMAT "%13.10" NUMBER 2 /end CHARACTERISTIC
/begin CHARACTERISTIC DINH_Lim.DSQ_Com_rLamLinRecGndRaw_CA "DINH/Zugeordnete Verriegelungslimits für Verriegelungsquelle DSQ_Com_rLamLinRecGndRaw" VAL_BLK 0x80028B88 ValA_Wu16 15.0000000000 DINH_LimDSQVerb 0.00 15.0000000000 FORMAT "%13.10" NUMBER 2 /end CHARACTERISTIC
/begin CHARACTERISTIC DINH_Lim.DSQ_Com_rLamLinRecUbattRaw_CA "DINH/Zugeordnete Verriegelungslimits für Verriegelungsquelle DSQ_Com_rLamLinRecUbattRaw" VAL_BLK 0x80028B8C ValA_Wu16 15.0000000000 DINH_LimDSQVerb 0.00 15.0000000000 FORMAT "%13.10" NUMBER 2 /end CHARACTERISTIC
/begin CHARACTERISTIC DINH_Lim.DSQ_Com_rNOxCat2DsGndRaw_CA "DINH/Zugeordnete Verriegelungslimits für Verriegelungsquelle DSQ_Com_rNOxCat2DsGndRaw" VAL_BLK 0x80028B90 ValA_Wu16 15.0000000000 DINH_LimDSQVerb 0.00 15.0000000000 FORMAT "%13.10" NUMBER 2 /end CHARACTERISTIC
/begin CHARACTERISTIC DINH_Lim.DSQ_Com_rNOxCat2DsUbattRaw_CA "DINH/Zugeordnete Verriegelungslimits für Verriegelungsquelle DSQ_Com_rNOxCat2DsUbattRaw" VAL_BLK 0x80028B94 ValA_Wu16 15.0000000000 DINH_LimDSQVerb 0.00 15.0000000000 FORMAT "%13.10" NUMBER 2 /end CHARACTERISTIC
/begin CHARACTERISTIC DINH_Lim.DSQ_Com_rPspSetPoint_CA "DINH/Zugeordnete Verriegelungslimits für Verriegelungsquelle DSQ_Com_rPspSetPoint" VAL_BLK 0x80028B98 ValA_Wu16 15.0000000000 DINH_LimDSQVerb 0.00 15.0000000000 FORMAT "%13.10" NUMBER 2 /end CHARACTERISTIC
/begin CHARACTERISTIC DINH_Lim.DSQ_Com_rPwrSpCons_CA "DINH/Zugeordnete Verriegelungslimits für Verriegelungsquelle DSQ_Com_rPwrSpCons" VAL_BLK 0x80028B9C ValA_Wu16 15.0000000000 DINH_LimDSQVerb 0.00 15.0000000000 FORMAT "%13.10" NUMBER 2 /end CHARACTERISTIC
/begin CHARACTERISTIC DINH_Lim.DSQ_Com_rTrq_CA "DINH/Zugeordnete Verriegelungslimits für Verriegelungsquelle DSQ_Com_rTrq" VAL_BLK 0x80028BA0 ValA_Wu16 15.0000000000 DINH_LimDSQVerb 0.00 15.0000000000 FORMAT "%13.10" NUMBER 4 /end CHARACTERISTIC
/begin CHARACTERISTIC DINH_Lim.DSQ_Com_stAC_CA "DINH/Zugeordnete Verriegelungslimits für Verriegelungsquelle DSQ_Com_stAC" VAL_BLK 0x80028BA8 ValA_Wu16 15.0000000000 DINH_LimDSQVerb 0.00 15.0000000000 FORMAT "%13.10" NUMBER 2 /end CHARACTERISTIC
/begin CHARACTERISTIC DINH_Lim.DSQ_Com_stACEFan_CA "DINH/Zugeordnete Verriegelungslimits für Verriegelungsquelle DSQ_Com_stACEFan" VAL_BLK 0x80028BAC ValA_Wu16 15.0000000000 DINH_LimDSQVerb 0.00 15.0000000000 FORMAT "%13.10" NUMBER 2 /end CHARACTERISTIC
/begin CHARACTERISTIC DINH_Lim.DSQ_Com_stARS_CA "DINH/Zugeordnete Verriegelungslimits für Verriegelungsquelle DSQ_Com_stARS" VAL_BLK 0x80028BB0 ValA_Wu16 15.0000000000 DINH_LimDSQVerb 0.00 15.0000000000 FORMAT "%13.10" NUMBER 2 /end CHARACTERISTIC
/begin CHARACTERISTIC DINH_Lim.DSQ_Com_stAcpd_CA "DINH/Zugeordnete Verriegelungslimits für Verriegelungsquelle DSQ_Com_stAcpd" VAL_BLK 0x80028BB4 ValA_Wu16 15.0000000000 DINH_LimDSQVerb 0.00 15.0000000000 FORMAT "%13.10" NUMBER 2 /end CHARACTERISTIC
/begin CHARACTERISTIC DINH_Lim.DSQ_Com_stBattClass_CA "DINH/Zugeordnete Verriegelungslimits für Verriegelungsquelle DSQ_Com_stBattClass" VAL_BLK 0x80028BB8 ValA_Wu16 15.0000000000 DINH_LimDSQVerb 0.00 15.0000000000 FORMAT "%13.10" NUMBER 3 /end CHARACTERISTIC
/begin CHARACTERISTIC DINH_Lim.DSQ_Com_stBonnet_CA "DINH/Zugeordnete Verriegelungslimits für Verriegelungsquelle DSQ_Com_stBonnet" VAL_BLK 0x80028BBE ValA_Wu16 15.0000000000 DINH_LimDSQVerb 0.00 15.0000000000 FORMAT "%13.10" NUMBER 2 /end CHARACTERISTIC
/begin CHARACTERISTIC DINH_Lim.DSQ_Com_stBrkTrqDVCHQl_CA "DINH/Zugeordnete Verriegelungslimits für Verriegelungsquelle DSQ_Com_stBrkTrqDVCHQl" VAL_BLK 0x80028BC2 ValA_Wu16 15.0000000000 DINH_LimDSQVerb 0.00 15.0000000000 FORMAT "%13.10" NUMBER 3 /end CHARACTERISTIC
/begin CHARACTERISTIC DINH_Lim.DSQ_Com_stButtonMSA_CA "DINH/Zugeordnete Verriegelungslimits für Verriegelungsquelle DSQ_Com_stButtonMSA" VAL_BLK 0x80028BC8 ValA_Wu16 15.0000000000 DINH_LimDSQVerb 0.00 15.0000000000 FORMAT "%13.10" NUMBER 3 /end CHARACTERISTIC
/begin CHARACTERISTIC DINH_Lim.DSQ_Com_stCat2DsGndRaw_CA "DINH/Zugeordnete Verriegelungslimits für Verriegelungsquelle DSQ_Com_stCat2DsGndRaw" VAL_BLK 0x80028BCE ValA_Wu16 15.0000000000 DINH_LimDSQVerb 0.00 15.0000000000 FORMAT "%13.10" NUMBER 2 /end CHARACTERISTIC
/begin CHARACTERISTIC DINH_Lim.DSQ_Com_stCat2DsUbattRaw_CA "DINH/Zugeordnete Verriegelungslimits für Verriegelungsquelle DSQ_Com_stCat2DsUbattRaw" VAL_BLK 0x80028BD2 ValA_Wu16 15.0000000000 DINH_LimDSQVerb 0.00 15.0000000000 FORMAT "%13.10" NUMBER 2 /end CHARACTERISTIC
/begin CHARACTERISTIC DINH_Lim.DSQ_Com_stClCtr_CA "DINH/Zugeordnete Verriegelungslimits für Verriegelungsquelle DSQ_Com_stClCtr" VAL_BLK 0x80028BD6 ValA_Wu16 15.0000000000 DINH_LimDSQVerb 0.00 15.0000000000 FORMAT "%13.10" NUMBER 3 /end CHARACTERISTIC
/begin CHARACTERISTIC DINH_Lim.DSQ_Com_stClassPwr_CA "DINH/Zugeordnete Verriegelungslimits für Verriegelungsquelle DSQ_Com_stClassPwr" VAL_BLK 0x80028BDC ValA_Wu16 15.0000000000 DINH_LimDSQVerb 0.00 15.0000000000 FORMAT "%13.10" NUMBER 2 /end CHARACTERISTIC
/begin CHARACTERISTIC DINH_Lim.DSQ_Com_stClth_CA "DINH/Zugeordnete Verriegelungslimits für Verriegelungsquelle DSQ_Com_stClth" VAL_BLK 0x80028BE0 ValA_Wu16 15.0000000000 DINH_LimDSQVerb 0.00 15.0000000000 FORMAT "%13.10" NUMBER 5 /end CHARACTERISTIC
/begin CHARACTERISTIC DINH_Lim.DSQ_Com_stClthOpen_CA "DINH/Zugeordnete Verriegelungslimits für Verriegelungsquelle DSQ_Com_stClthOpen" VAL_BLK 0x80028BEA ValA_Wu16 15.0000000000 DINH_LimDSQVerb 0.00 15.0000000000 FORMAT "%13.10" NUMBER 3 /end CHARACTERISTIC
/begin CHARACTERISTIC DINH_Lim.DSQ_Com_stClthRaw_CA "DINH/Zugeordnete Verriegelungslimits für Verriegelungsquelle DSQ_Com_stClthRaw" VAL_BLK 0x80028BF0 ValA_Wu16 15.0000000000 DINH_LimDSQVerb 0.00 15.0000000000 FORMAT "%13.10" NUMBER 3 /end CHARACTERISTIC
/begin CHARACTERISTIC DINH_Lim.DSQ_Com_stCrCtlKombi_CA "DINH/Zugeordnete Verriegelungslimits für Verriegelungsquelle DSQ_Com_stCrCtlKombi" VAL_BLK 0x80028BF6 ValA_Wu16 15.0000000000 DINH_LimDSQVerb 0.00 15.0000000000 FORMAT "%13.10" NUMBER 3 /end CHARACTERISTIC
/begin CHARACTERISTIC DINH_Lim.DSQ_Com_stCrCtlLvr_CA "DINH/Zugeordnete Verriegelungslimits für Verriegelungsquelle DSQ_Com_stCrCtlLvr" VAL_BLK 0x80028BFC ValA_Wu16 15.0000000000 DINH_LimDSQVerb 0.00 15.0000000000 FORMAT "%13.10" NUMBER 3 /end CHARACTERISTIC
/begin CHARACTERISTIC DINH_Lim.DSQ_Com_stDSC_CA "DINH/Zugeordnete Verriegelungslimits für Verriegelungsquelle DSQ_Com_stDSC" VAL_BLK 0x80028C02 ValA_Wu16 15.0000000000 DINH_LimDSQVerb 0.00 15.0000000000 FORMAT "%13.10" NUMBER 4 /end CHARACTERISTIC
/begin CHARACTERISTIC DINH_Lim.DSQ_Com_stDecellDSC_CA "DINH/Zugeordnete Verriegelungslimits für Verriegelungsquelle DSQ_Com_stDecellDSC" VAL_BLK 0x80028C0A ValA_Wu16 15.0000000000 DINH_LimDSQVerb 0.00 15.0000000000 FORMAT "%13.10" NUMBER 2 /end CHARACTERISTIC
/begin CHARACTERISTIC DINH_Lim.DSQ_Com_stDiagPsp_CA "DINH/Zugeordnete Verriegelungslimits für Verriegelungsquelle DSQ_Com_stDiagPsp" VAL_BLK 0x80028C0E ValA_Wu16 15.0000000000 DINH_LimDSQVerb 0.00 15.0000000000 FORMAT "%13.10" NUMBER 2 /end CHARACTERISTIC
/begin CHARACTERISTIC DINH_Lim.DSQ_Com_stDoorDriver_CA "DINH/Zugeordnete Verriegelungslimits für Verriegelungsquelle DSQ_Com_stDoorDriver" VAL_BLK 0x80028C12 ValA_Wu16 15.0000000000 DINH_LimDSQVerb 0.00 15.0000000000 FORMAT "%13.10" NUMBER 2 /end CHARACTERISTIC
/begin CHARACTERISTIC DINH_Lim.DSQ_Com_stDrWghSeat_CA "DINH/Zugeordnete Verriegelungslimits für Verriegelungsquelle DSQ_Com_stDrWghSeat" VAL_BLK 0x80028C16 ValA_Wu16 15.0000000000 DINH_LimDSQVerb 0.00 15.0000000000 FORMAT "%13.10" NUMBER 3 /end CHARACTERISTIC
/begin CHARACTERISTIC DINH_Lim.DSQ_Com_stDrvAssist_CA "DINH/Zugeordnete Verriegelungslimits für Verriegelungsquelle DSQ_Com_stDrvAssist" VAL_BLK 0x80028C1C ValA_Wu16 15.0000000000 DINH_LimDSQVerb 0.00 15.0000000000 FORMAT "%13.10" NUMBER 2 /end CHARACTERISTIC
/begin CHARACTERISTIC DINH_Lim.DSQ_Com_stDrvDyn_CA "DINH/Zugeordnete Verriegelungslimits für Verriegelungsquelle DSQ_Com_stDrvDyn" VAL_BLK 0x80028C20 ValA_Wu16 15.0000000000 DINH_LimDSQVerb 0.00 15.0000000000 FORMAT "%13.10" NUMBER 2 /end CHARACTERISTIC
/begin CHARACTERISTIC DINH_Lim.DSQ_Com_stDrvPrgQl_CA "DINH/Zugeordnete Verriegelungslimits für Verriegelungsquelle DSQ_Com_stDrvPrgQl" VAL_BLK 0x80028C24 ValA_Wu16 15.0000000000 DINH_LimDSQVerb 0.00 15.0000000000 FORMAT "%13.10" NUMBER 2 /end CHARACTERISTIC
/begin CHARACTERISTIC DINH_Lim.DSQ_Com_stDynDisp_CA "DINH/Zugeordnete Verriegelungslimits für Verriegelungsquelle DSQ_Com_stDynDisp" VAL_BLK 0x80028C28 ValA_Wu16 15.0000000000 DINH_LimDSQVerb 0.00 15.0000000000 FORMAT "%13.10" NUMBER 2 /end CHARACTERISTIC
/begin CHARACTERISTIC DINH_Lim.DSQ_Com_stEngStop_CA "DINH/Zugeordnete Verriegelungslimits für Verriegelungsquelle DSQ_Com_stEngStop" VAL_BLK 0x80028C2C ValA_Wu16 15.0000000000 DINH_LimDSQVerb 0.00 15.0000000000 FORMAT "%13.10" NUMBER 3 /end CHARACTERISTIC
/begin CHARACTERISTIC DINH_Lim.DSQ_Com_stErrAFS_CA "DINH/Zugeordnete Verriegelungslimits für Verriegelungsquelle DSQ_Com_stErrAFS" VAL_BLK 0x80028C32 ValA_Wu16 15.0000000000 DINH_LimDSQVerb 0.00 15.0000000000 FORMAT "%13.10" NUMBER 2 /end CHARACTERISTIC
/begin CHARACTERISTIC DINH_Lim.DSQ_Com_stErrStrg_CA "DINH/Zugeordnete Verriegelungslimits für Verriegelungsquelle DSQ_Com_stErrStrg" VAL_BLK 0x80028C36 ValA_Wu16 15.0000000000 DINH_LimDSQVerb 0.00 15.0000000000 FORMAT "%13.10" NUMBER 2 /end CHARACTERISTIC
/begin CHARACTERISTIC DINH_Lim.DSQ_Com_stFlTnkQntRes_CA "DINH/Zugeordnete Verriegelungslimits für Verriegelungsquelle DSQ_Com_stFlTnkQntRes" VAL_BLK 0x80028C3A ValA_Wu16 15.0000000000 DINH_LimDSQVerb 0.00 15.0000000000 FORMAT "%13.10" NUMBER 2 /end CHARACTERISTIC
/begin CHARACTERISTIC DINH_Lim.DSQ_Com_stFolDyn_CA "DINH/Zugeordnete Verriegelungslimits für Verriegelungsquelle DSQ_Com_stFolDyn" VAL_BLK 0x80028C3E ValA_Wu16 15.0000000000 DINH_LimDSQVerb 0.00 15.0000000000 FORMAT "%13.10" NUMBER 2 /end CHARACTERISTIC
/begin CHARACTERISTIC DINH_Lim.DSQ_Com_stGbxOBD_CA "DINH/Zugeordnete Verriegelungslimits für Verriegelungsquelle DSQ_Com_stGbxOBD" VAL_BLK 0x80028C42 ValA_Wu16 15.0000000000 DINH_LimDSQVerb 0.00 15.0000000000 FORMAT "%13.10" NUMBER 2 /end CHARACTERISTIC
/begin CHARACTERISTIC DINH_Lim.DSQ_Com_stGear_CA "DINH/Zugeordnete Verriegelungslimits für Verriegelungsquelle DSQ_Com_stGear" VAL_BLK 0x80028C46 ValA_Wu16 15.0000000000 DINH_LimDSQVerb 0.00 15.0000000000 FORMAT "%13.10" NUMBER 9 /end CHARACTERISTIC
/begin CHARACTERISTIC DINH_Lim.DSQ_Com_stGearBck_CA "DINH/Zugeordnete Verriegelungslimits für Verriegelungsquelle DSQ_Com_stGearBck" VAL_BLK 0x80028C58 ValA_Wu16 15.0000000000 DINH_LimDSQVerb 0.00 15.0000000000 FORMAT "%13.10" NUMBER 3 /end CHARACTERISTIC
/begin CHARACTERISTIC DINH_Lim.DSQ_Com_stHDC_CA "DINH/Zugeordnete Verriegelungslimits für Verriegelungsquelle DSQ_Com_stHDC" VAL_BLK 0x80028C5E ValA_Wu16 15.0000000000 DINH_LimDSQVerb 0.00 15.0000000000 FORMAT "%13.10" NUMBER 2 /end CHARACTERISTIC
/begin CHARACTERISTIC DINH_Lim.DSQ_Com_stKeyVld_CA "DINH/Zugeordnete Verriegelungslimits für Verriegelungsquelle DSQ_Com_stKeyVld" VAL_BLK 0x80028C62 ValA_Wu16 15.0000000000 DINH_LimDSQVerb 0.00 15.0000000000 FORMAT "%13.10" NUMBER 2 /end CHARACTERISTIC
/begin CHARACTERISTIC DINH_Lim.DSQ_Com_stLckGbxDemQl_CA "DINH/Zugeordnete Verriegelungslimits für Verriegelungsquelle DSQ_Com_stLckGbxDemQl" VAL_BLK 0x80028C66 ValA_Wu16 15.0000000000 DINH_LimDSQVerb 0.00 15.0000000000 FORMAT "%13.10" NUMBER 2 /end CHARACTERISTIC
/begin CHARACTERISTIC DINH_Lim.DSQ_Com_stLmpPrkBrk_CA "DINH/Zugeordnete Verriegelungslimits für Verriegelungsquelle DSQ_Com_stLmpPrkBrk" VAL_BLK 0x80028C6A ValA_Wu16 15.0000000000 DINH_LimDSQVerb 0.00 15.0000000000 FORMAT "%13.10" NUMBER 3 /end CHARACTERISTIC
/begin CHARACTERISTIC DINH_Lim.DSQ_Com_stMSALmp_CA "DINH/Zugeordnete Verriegelungslimits für Verriegelungsquelle DSQ_Com_stMSALmp" VAL_BLK 0x80028C70 ValA_Wu16 15.0000000000 DINH_LimDSQVerb 0.00 15.0000000000 FORMAT "%13.10" NUMBER 3 /end CHARACTERISTIC
/begin CHARACTERISTIC DINH_Lim.DSQ_Com_stModDKG_CA "DINH/Zugeordnete Verriegelungslimits für Verriegelungsquelle DSQ_Com_stModDKG" VAL_BLK 0x80028C76 ValA_Wu16 15.0000000000 DINH_LimDSQVerb 0.00 15.0000000000 FORMAT "%13.10" NUMBER 2 /end CHARACTERISTIC
/begin CHARACTERISTIC DINH_Lim.DSQ_Com_stNOxErrGndRaw_CA "DINH/Zugeordnete Verriegelungslimits für Verriegelungsquelle DSQ_Com_stNOxErrGndRaw" VAL_BLK 0x80028C7A ValA_Wu16 15.0000000000 DINH_LimDSQVerb 0.00 15.0000000000 FORMAT "%13.10" NUMBER 2 /end CHARACTERISTIC
/begin CHARACTERISTIC DINH_Lim.DSQ_Com_stNOxErrUbattRaw_CA "DINH/Zugeordnete Verriegelungslimits für Verriegelungsquelle DSQ_Com_stNOxErrUbattRaw" VAL_BLK 0x80028C7E ValA_Wu16 15.0000000000 DINH_LimDSQVerb 0.00 15.0000000000 FORMAT "%13.10" NUMBER 2 /end CHARACTERISTIC
/begin CHARACTERISTIC DINH_Lim.DSQ_Com_stPBrComf_CA "DINH/Zugeordnete Verriegelungslimits für Verriegelungsquelle DSQ_Com_stPBrComf" VAL_BLK 0x80028C82 ValA_Wu16 15.0000000000 DINH_LimDSQVerb 0.00 15.0000000000 FORMAT "%13.10" NUMBER 3 /end CHARACTERISTIC
/begin CHARACTERISTIC DINH_Lim.DSQ_Com_stPBrHold_CA "DINH/Zugeordnete Verriegelungslimits für Verriegelungsquelle DSQ_Com_stPBrHold" VAL_BLK 0x80028C88 ValA_Wu16 15.0000000000 DINH_LimDSQVerb 0.00 15.0000000000 FORMAT "%13.10" NUMBER 4 /end CHARACTERISTIC
/begin CHARACTERISTIC DINH_Lim.DSQ_Com_stPBrHyd_CA "DINH/Zugeordnete Verriegelungslimits für Verriegelungsquelle DSQ_Com_stPBrHyd" VAL_BLK 0x80028C90 ValA_Wu16 15.0000000000 DINH_LimDSQVerb 0.00 15.0000000000 FORMAT "%13.10" NUMBER 3 /end CHARACTERISTIC
/begin CHARACTERISTIC DINH_Lim.DSQ_Com_stPBrkSysQl_CA "DINH/Zugeordnete Verriegelungslimits für Verriegelungsquelle DSQ_Com_stPBrkSysQl" VAL_BLK 0x80028C96 ValA_Wu16 15.0000000000 DINH_LimDSQVerb 0.00 15.0000000000 FORMAT "%13.10" NUMBER 2 /end CHARACTERISTIC
/begin CHARACTERISTIC DINH_Lim.DSQ_Com_stPHtr_CA "DINH/Zugeordnete Verriegelungslimits für Verriegelungsquelle DSQ_Com_stPHtr" VAL_BLK 0x80028C9A ValA_Wu16 15.0000000000 DINH_LimDSQVerb 0.00 15.0000000000 FORMAT "%13.10" NUMBER 2 /end CHARACTERISTIC
/begin CHARACTERISTIC DINH_Lim.DSQ_Com_stParkConsumer_CA "DINH/Zugeordnete Verriegelungslimits für Verriegelungsquelle DSQ_Com_stParkConsumer" VAL_BLK 0x80028C9E ValA_Wu16 15.0000000000 DINH_LimDSQVerb 0.00 15.0000000000 FORMAT "%13.10" NUMBER 2 /end CHARACTERISTIC
/begin CHARACTERISTIC DINH_Lim.DSQ_Com_stPsp_CA "DINH/Zugeordnete Verriegelungslimits für Verriegelungsquelle DSQ_Com_stPsp" VAL_BLK 0x80028CA2 ValA_Wu16 15.0000000000 DINH_LimDSQVerb 0.00 15.0000000000 FORMAT "%13.10" NUMBER 2 /end CHARACTERISTIC
/begin CHARACTERISTIC DINH_Lim.DSQ_Com_stPspCntr_CA "DINH/Zugeordnete Verriegelungslimits für Verriegelungsquelle DSQ_Com_stPspCntr" VAL_BLK 0x80028CA6 ValA_Wu16 15.0000000000 DINH_LimDSQVerb 0.00 15.0000000000 FORMAT "%13.10" NUMBER 2 /end CHARACTERISTIC
/begin CHARACTERISTIC DINH_Lim.DSQ_Com_stRaceStrt_CA "DINH/Zugeordnete Verriegelungslimits für Verriegelungsquelle DSQ_Com_stRaceStrt" VAL_BLK 0x80028CAA ValA_Wu16 15.0000000000 DINH_LimDSQVerb 0.00 15.0000000000 FORMAT "%13.10" NUMBER 2 /end CHARACTERISTIC
/begin CHARACTERISTIC DINH_Lim.DSQ_Com_stReqMSA_CA "DINH/Zugeordnete Verriegelungslimits für Verriegelungsquelle DSQ_Com_stReqMSA" VAL_BLK 0x80028CAE ValA_Wu16 15.0000000000 DINH_LimDSQVerb 0.00 15.0000000000 FORMAT "%13.10" NUMBER 2 /end CHARACTERISTIC
/begin CHARACTERISTIC DINH_Lim.DSQ_Com_stRevGear_CA "DINH/Zugeordnete Verriegelungslimits für Verriegelungsquelle DSQ_Com_stRevGear" VAL_BLK 0x80028CB2 ValA_Wu16 15.0000000000 DINH_LimDSQVerb 0.00 15.0000000000 FORMAT "%13.10" NUMBER 2 /end CHARACTERISTIC
/begin CHARACTERISTIC DINH_Lim.DSQ_Com_stSTEQl_CA "DINH/Zugeordnete Verriegelungslimits für Verriegelungsquelle DSQ_Com_stSTEQl" VAL_BLK 0x80028CB6 ValA_Wu16 15.0000000000 DINH_LimDSQVerb 0.00 15.0000000000 FORMAT "%13.10" NUMBER 2 /end CHARACTERISTIC
/begin CHARACTERISTIC DINH_Lim.DSQ_Com_stSeason_CA "DINH/Zugeordnete Verriegelungslimits für Verriegelungsquelle DSQ_Com_stSeason" VAL_BLK 0x80028CBA ValA_Wu16 15.0000000000 DINH_LimDSQVerb 0.00 15.0000000000 FORMAT "%13.10" NUMBER 2 /end CHARACTERISTIC
/begin CHARACTERISTIC DINH_Lim.DSQ_Com_stShftIdctrDemRglX_CA "DINH/Zugeordnete Verriegelungslimits für Verriegelungsquelle DSQ_Com_stShftIdctrDemRglX" VAL_BLK 0x80028CBE ValA_Wu16 15.0000000000 DINH_LimDSQVerb 0.00 15.0000000000 FORMAT "%13.10" NUMBER 2 /end CHARACTERISTIC
/begin CHARACTERISTIC DINH_Lim.DSQ_Com_stShiftPdl_CA "DINH/Zugeordnete Verriegelungslimits für Verriegelungsquelle DSQ_Com_stShiftPdl" VAL_BLK 0x80028CC2 ValA_Wu16 15.0000000000 DINH_LimDSQVerb 0.00 15.0000000000 FORMAT "%13.10" NUMBER 2 /end CHARACTERISTIC
/begin CHARACTERISTIC DINH_Lim.DSQ_Com_stShutOffPSP_CA "DINH/Zugeordnete Verriegelungslimits für Verriegelungsquelle DSQ_Com_stShutOffPSP" VAL_BLK 0x80028CC6 ValA_Wu16 15.0000000000 DINH_LimDSQVerb 0.00 15.0000000000 FORMAT "%13.10" NUMBER 2 /end CHARACTERISTIC
/begin CHARACTERISTIC DINH_Lim.DSQ_Com_stSleepBus_CA "DINH/Zugeordnete Verriegelungslimits für Verriegelungsquelle DSQ_Com_stSleepBus" VAL_BLK 0x80028CCA ValA_Wu16 15.0000000000 DINH_LimDSQVerb 0.00 15.0000000000 FORMAT "%13.10" NUMBER 2 /end CHARACTERISTIC
/begin CHARACTERISTIC DINH_Lim.DSQ_Com_stSleepConst_CA "DINH/Zugeordnete Verriegelungslimits für Verriegelungsquelle DSQ_Com_stSleepConst" VAL_BLK 0x80028CCE ValA_Wu16 15.0000000000 DINH_LimDSQVerb 0.00 15.0000000000 FORMAT "%13.10" NUMBER 2 /end CHARACTERISTIC
/begin CHARACTERISTIC DINH_Lim.DSQ_Com_stSleepDest_CA "DINH/Zugeordnete Verriegelungslimits für Verriegelungsquelle DSQ_Com_stSleepDest" VAL_BLK 0x80028CD2 ValA_Wu16 15.0000000000 DINH_LimDSQVerb 0.00 15.0000000000 FORMAT "%13.10" NUMBER 2 /end CHARACTERISTIC
/begin CHARACTERISTIC DINH_Lim.DSQ_Com_stSleepRdy_CA "DINH/Zugeordnete Verriegelungslimits für Verriegelungsquelle DSQ_Com_stSleepRdy" VAL_BLK 0x80028CD6 ValA_Wu16 15.0000000000 DINH_LimDSQVerb 0.00 15.0000000000 FORMAT "%13.10" NUMBER 2 /end CHARACTERISTIC
/begin CHARACTERISTIC DINH_Lim.DSQ_Com_stStrg_CA "DINH/Zugeordnete Verriegelungslimits für Verriegelungsquelle DSQ_Com_stStrg" VAL_BLK 0x80028CDA ValA_Wu16 15.0000000000 DINH_LimDSQVerb 0.00 15.0000000000 FORMAT "%13.10" NUMBER 2 /end CHARACTERISTIC
/begin CHARACTERISTIC DINH_Lim.DSQ_Com_stStrtClth_CA "DINH/Zugeordnete Verriegelungslimits für Verriegelungsquelle DSQ_Com_stStrtClth" VAL_BLK 0x80028CDE ValA_Wu16 15.0000000000 DINH_LimDSQVerb 0.00 15.0000000000 FORMAT "%13.10" NUMBER 2 /end CHARACTERISTIC
/begin CHARACTERISTIC DINH_Lim.DSQ_Com_stStrtLck_CA "DINH/Zugeordnete Verriegelungslimits für Verriegelungsquelle DSQ_Com_stStrtLck" VAL_BLK 0x80028CE2 ValA_Wu16 15.0000000000 DINH_LimDSQVerb 0.00 15.0000000000 FORMAT "%13.10" NUMBER 2 /end CHARACTERISTIC
/begin CHARACTERISTIC DINH_Lim.DSQ_Com_stT15_CA "DINH/Zugeordnete Verriegelungslimits für Verriegelungsquelle DSQ_Com_stT15" VAL_BLK 0x80028CE6 ValA_Wu16 15.0000000000 DINH_LimDSQVerb 0.00 15.0000000000 FORMAT "%13.10" NUMBER 3 /end CHARACTERISTIC
/begin CHARACTERISTIC DINH_Lim.DSQ_Com_stT15Hw_CA "DINH/Zugeordnete Verriegelungslimits für Verriegelungsquelle DSQ_Com_stT15Hw" VAL_BLK 0x80028CEC ValA_Wu16 15.0000000000 DINH_LimDSQVerb 0.00 15.0000000000 FORMAT "%13.10" NUMBER 2 /end CHARACTERISTIC
/begin CHARACTERISTIC DINH_Lim.DSQ_Com_stT50_CA "DINH/Zugeordnete Verriegelungslimits für Verriegelungsquelle DSQ_Com_stT50" VAL_BLK 0x80028CF0 ValA_Wu16 15.0000000000 DINH_LimDSQVerb 0.00 15.0000000000 FORMAT "%13.10" NUMBER 3 /end CHARACTERISTIC
/begin CHARACTERISTIC DINH_Lim.DSQ_Com_stTRadio_CA "DINH/Zugeordnete Verriegelungslimits für Verriegelungsquelle DSQ_Com_stTRadio" VAL_BLK 0x80028CF6 ValA_Wu16 15.0000000000 DINH_LimDSQVerb 0.00 15.0000000000 FORMAT "%13.10" NUMBER 3 /end CHARACTERISTIC
/begin CHARACTERISTIC DINH_Lim.DSQ_Com_stTSC_CA "DINH/Zugeordnete Verriegelungslimits für Verriegelungsquelle DSQ_Com_stTSC" VAL_BLK 0x80028CFC ValA_Wu16 15.0000000000 DINH_LimDSQVerb 0.00 15.0000000000 FORMAT "%13.10" NUMBER 3 /end CHARACTERISTIC
/begin CHARACTERISTIC DINH_Lim.DSQ_Com_stTerminal_CA "DINH/Zugeordnete Verriegelungslimits für Verriegelungsquelle DSQ_Com_stTerminal" VAL_BLK 0x80028D02 ValA_Wu16 15.0000000000 DINH_LimDSQVerb 0.00 15.0000000000 FORMAT "%13.10" NUMBER 3 /end CHARACTERISTIC
/begin CHARACTERISTIC DINH_Lim.DSQ_Com_stTrailer_CA "DINH/Zugeordnete Verriegelungslimits für Verriegelungsquelle DSQ_Com_stTrailer" VAL_BLK 0x80028D08 ValA_Wu16 15.0000000000 DINH_LimDSQVerb 0.00 15.0000000000 FORMAT "%13.10" NUMBER 6 /end CHARACTERISTIC
/begin CHARACTERISTIC DINH_Lim.DSQ_Com_stTrqAFS_CA "DINH/Zugeordnete Verriegelungslimits für Verriegelungsquelle DSQ_Com_stTrqAFS" VAL_BLK 0x80028D14 ValA_Wu16 15.0000000000 DINH_LimDSQVerb 0.00 15.0000000000 FORMAT "%13.10" NUMBER 2 /end CHARACTERISTIC
/begin CHARACTERISTIC DINH_Lim.DSQ_Com_stTrqDSCDes_CA "DINH/Zugeordnete Verriegelungslimits für Verriegelungsquelle DSQ_Com_stTrqDSCDes" VAL_BLK 0x80028D18 ValA_Wu16 15.0000000000 DINH_LimDSQVerb 0.00 15.0000000000 FORMAT "%13.10" NUMBER 4 /end CHARACTERISTIC
/begin CHARACTERISTIC DINH_Lim.DSQ_Com_stTrqFil_CA "DINH/Zugeordnete Verriegelungslimits für Verriegelungsquelle DSQ_Com_stTrqFil" VAL_BLK 0x80028D20 ValA_Wu16 15.0000000000 DINH_LimDSQVerb 0.00 15.0000000000 FORMAT "%13.10" NUMBER 2 /end CHARACTERISTIC
/begin CHARACTERISTIC DINH_Lim.DSQ_Com_stTrqGbxDes_CA "DINH/Zugeordnete Verriegelungslimits für Verriegelungsquelle DSQ_Com_stTrqGbxDes" VAL_BLK 0x80028D24 ValA_Wu16 15.0000000000 DINH_LimDSQVerb 0.00 15.0000000000 FORMAT "%13.10" NUMBER 6 /end CHARACTERISTIC
/begin CHARACTERISTIC DINH_Lim.DSQ_Com_stTrqGbxLim_CA "DINH/Zugeordnete Verriegelungslimits für Verriegelungsquelle DSQ_Com_stTrqGbxLim" VAL_BLK 0x80028D30 ValA_Wu16 15.0000000000 DINH_LimDSQVerb 0.00 15.0000000000 FORMAT "%13.10" NUMBER 2 /end CHARACTERISTIC
/begin CHARACTERISTIC DINH_Lim.DSQ_Com_stTrqStbDesQl_CA "DINH/Zugeordnete Verriegelungslimits für Verriegelungsquelle DSQ_Com_stTrqStbDesQl" VAL_BLK 0x80028D34 ValA_Wu16 15.0000000000 DINH_LimDSQVerb 0.00 15.0000000000 FORMAT "%13.10" NUMBER 2 /end CHARACTERISTIC
/begin CHARACTERISTIC DINH_Lim.DSQ_Com_stTrqStrg_CA "DINH/Zugeordnete Verriegelungslimits für Verriegelungsquelle DSQ_Com_stTrqStrg" VAL_BLK 0x80028D38 ValA_Wu16 15.0000000000 DINH_LimDSQVerb 0.00 15.0000000000 FORMAT "%13.10" NUMBER 2 /end CHARACTERISTIC
/begin CHARACTERISTIC DINH_Lim.DSQ_Com_stTrqWhl_CA "DINH/Zugeordnete Verriegelungslimits für Verriegelungsquelle DSQ_Com_stTrqWhl" VAL_BLK 0x80028D3C ValA_Wu16 15.0000000000 DINH_LimDSQVerb 0.00 15.0000000000 FORMAT "%13.10" NUMBER 2 /end CHARACTERISTIC
/begin CHARACTERISTIC DINH_Lim.DSQ_Com_stTrqWhlDemFASQl_CA "DINH/Zugeordnete Verriegelungslimits für Verriegelungsquelle DSQ_Com_stTrqWhlDemFASQl" VAL_BLK 0x80028D40 ValA_Wu16 15.0000000000 DINH_LimDSQVerb 0.00 15.0000000000 FORMAT "%13.10" NUMBER 2 /end CHARACTERISTIC
/begin CHARACTERISTIC DINH_Lim.DSQ_Com_stTrqWhlDesQl_CA "DINH/Zugeordnete Verriegelungslimits für Verriegelungsquelle DSQ_Com_stTrqWhlDesQl" VAL_BLK 0x80028D44 ValA_Wu16 15.0000000000 DINH_LimDSQVerb 0.00 15.0000000000 FORMAT "%13.10" NUMBER 2 /end CHARACTERISTIC
/begin CHARACTERISTIC DINH_Lim.DSQ_Com_stTypBody_CA "DINH/Zugeordnete Verriegelungslimits für Verriegelungsquelle DSQ_Com_stTypBody" VAL_BLK 0x80028D48 ValA_Wu16 15.0000000000 DINH_LimDSQVerb 0.00 15.0000000000 FORMAT "%13.10" NUMBER 2 /end CHARACTERISTIC
/begin CHARACTERISTIC DINH_Lim.DSQ_Com_stUnVel_CA "DINH/Zugeordnete Verriegelungslimits für Verriegelungsquelle DSQ_Com_stUnVel" VAL_BLK 0x80028D4C ValA_Wu16 15.0000000000 DINH_LimDSQVerb 0.00 15.0000000000 FORMAT "%13.10" NUMBER 3 /end CHARACTERISTIC
/begin CHARACTERISTIC DINH_Lim.DSQ_Com_stVehCond_CA "DINH/Zugeordnete Verriegelungslimits für Verriegelungsquelle DSQ_Com_stVehCond" VAL_BLK 0x80028D52 ValA_Wu16 15.0000000000 DINH_LimDSQVerb 0.00 15.0000000000 FORMAT "%13.10" NUMBER 2 /end CHARACTERISTIC
/begin CHARACTERISTIC DINH_Lim.DSQ_Com_stVehDrvCond_CA "DINH/Zugeordnete Verriegelungslimits für Verriegelungsquelle DSQ_Com_stVehDrvCond" VAL_BLK 0x80028D56 ValA_Wu16 15.0000000000 DINH_LimDSQVerb 0.00 15.0000000000 FORMAT "%13.10" NUMBER 3 /end CHARACTERISTIC
/begin CHARACTERISTIC DINH_Lim.DSQ_Com_stVerbraucher_CA "DINH/Zugeordnete Verriegelungslimits für Verriegelungsquelle DSQ_Com_stVerbraucher" VAL_BLK 0x80028D5C ValA_Wu16 15.0000000000 DINH_LimDSQVerb 0.00 15.0000000000 FORMAT "%13.10" NUMBER 3 /end CHARACTERISTIC
/begin CHARACTERISTIC DINH_Lim.DSQ_Com_stphiStWhlAg_CA "DINH/Zugeordnete Verriegelungslimits für Verriegelungsquelle DSQ_Com_stphiStWhlAg" VAL_BLK 0x80028D62 ValA_Wu16 15.0000000000 DINH_LimDSQVerb 0.00 15.0000000000 FORMAT "%13.10" NUMBER 2 /end CHARACTERISTIC
/begin CHARACTERISTIC DINH_Lim.DSQ_Com_swtAC_CA "DINH/Zugeordnete Verriegelungslimits für Verriegelungsquelle DSQ_Com_swtAC" VAL_BLK 0x80028D66 ValA_Wu16 15.0000000000 DINH_LimDSQVerb 0.00 15.0000000000 FORMAT "%13.10" NUMBER 2 /end CHARACTERISTIC
/begin CHARACTERISTIC DINH_Lim.DSQ_Com_swtDrBltb_CA "DINH/Zugeordnete Verriegelungslimits für Verriegelungsquelle DSQ_Com_swtDrBltb" VAL_BLK 0x80028D6A ValA_Wu16 15.0000000000 DINH_LimDSQVerb 0.00 15.0000000000 FORMAT "%13.10" NUMBER 3 /end CHARACTERISTIC
/begin CHARACTERISTIC DINH_Lim.DSQ_Com_tEnvT_CA "DINH/Zugeordnete Verriegelungslimits für Verriegelungsquelle DSQ_Com_tEnvT" VAL_BLK 0x80028D70 ValA_Wu16 15.0000000000 DINH_LimDSQVerb 0.00 15.0000000000 FORMAT "%13.10" NUMBER 2 /end CHARACTERISTIC
/begin CHARACTERISTIC DINH_Lim.DSQ_Com_tGbxOil_CA "DINH/Zugeordnete Verriegelungslimits für Verriegelungsquelle DSQ_Com_tGbxOil" VAL_BLK 0x80028D74 ValA_Wu16 15.0000000000 DINH_LimDSQVerb 0.00 15.0000000000 FORMAT "%13.10" NUMBER 3 /end CHARACTERISTIC
/begin CHARACTERISTIC DINH_Lim.DSQ_Com_tiPostRunPwrSpl_CA "DINH/Zugeordnete Verriegelungslimits für Verriegelungsquelle DSQ_Com_tiPostRunPwrSpl" VAL_BLK 0x80028D7A ValA_Wu16 15.0000000000 DINH_LimDSQVerb 0.00 15.0000000000 FORMAT "%13.10" NUMBER 2 /end CHARACTERISTIC
/begin CHARACTERISTIC DINH_Lim.DSQ_Com_trqAC_CA "DINH/Zugeordnete Verriegelungslimits für Verriegelungsquelle DSQ_Com_trqAC" VAL_BLK 0x80028D7E ValA_Wu16 15.0000000000 DINH_LimDSQVerb 0.00 15.0000000000 FORMAT "%13.10" NUMBER 2 /end CHARACTERISTIC
/begin CHARACTERISTIC DINH_Lim.DSQ_Com_trqAFS_CA "DINH/Zugeordnete Verriegelungslimits für Verriegelungsquelle DSQ_Com_trqAFS" VAL_BLK 0x80028D82 ValA_Wu16 15.0000000000 DINH_LimDSQVerb 0.00 15.0000000000 FORMAT "%13.10" NUMBER 2 /end CHARACTERISTIC
/begin CHARACTERISTIC DINH_Lim.DSQ_Com_trqAFSDes_CA "DINH/Zugeordnete Verriegelungslimits für Verriegelungsquelle DSQ_Com_trqAFSDes" VAL_BLK 0x80028D86 ValA_Wu16 15.0000000000 DINH_LimDSQVerb 0.00 15.0000000000 FORMAT "%13.10" NUMBER 2 /end CHARACTERISTIC
/begin CHARACTERISTIC DINH_Lim.DSQ_Com_trqARSCur_CA "DINH/Zugeordnete Verriegelungslimits für Verriegelungsquelle DSQ_Com_trqARSCur" VAL_BLK 0x80028D8A ValA_Wu16 15.0000000000 DINH_LimDSQVerb 0.00 15.0000000000 FORMAT "%13.10" NUMBER 2 /end CHARACTERISTIC
/begin CHARACTERISTIC DINH_Lim.DSQ_Com_trqARSDes_CA "DINH/Zugeordnete Verriegelungslimits für Verriegelungsquelle DSQ_Com_trqARSDes" VAL_BLK 0x80028D8E ValA_Wu16 15.0000000000 DINH_LimDSQVerb 0.00 15.0000000000 FORMAT "%13.10" NUMBER 2 /end CHARACTERISTIC
/begin CHARACTERISTIC DINH_Lim.DSQ_Com_trqAdjrDKG_CA "DINH/Zugeordnete Verriegelungslimits für Verriegelungsquelle DSQ_Com_trqAdjrDKG" VAL_BLK 0x80028D92 ValA_Wu16 15.0000000000 DINH_LimDSQVerb 0.00 15.0000000000 FORMAT "%13.10" NUMBER 2 /end CHARACTERISTIC
/begin CHARACTERISTIC DINH_Lim.DSQ_Com_trqBrkDVCH_CA "DINH/Zugeordnete Verriegelungslimits für Verriegelungsquelle DSQ_Com_trqBrkDVCH" VAL_BLK 0x80028D96 ValA_Wu16 15.0000000000 DINH_LimDSQVerb 0.00 15.0000000000 FORMAT "%13.10" NUMBER 3 /end CHARACTERISTIC
/begin CHARACTERISTIC DINH_Lim.DSQ_Com_trqClthDKG_CA "DINH/Zugeordnete Verriegelungslimits für Verriegelungsquelle DSQ_Com_trqClthDKG" VAL_BLK 0x80028D9C ValA_Wu16 15.0000000000 DINH_LimDSQVerb 0.00 15.0000000000 FORMAT "%13.10" NUMBER 2 /end CHARACTERISTIC
/begin CHARACTERISTIC DINH_Lim.DSQ_Com_trqDSCDes_CA "DINH/Zugeordnete Verriegelungslimits für Verriegelungsquelle DSQ_Com_trqDSCDes" VAL_BLK 0x80028DA0 ValA_Wu16 15.0000000000 DINH_LimDSQVerb 0.00 15.0000000000 FORMAT "%13.10" NUMBER 5 /end CHARACTERISTIC
/begin CHARACTERISTIC DINH_Lim.DSQ_Com_trqDVCHRise_CA "DINH/Zugeordnete Verriegelungslimits für Verriegelungsquelle DSQ_Com_trqDVCHRise" VAL_BLK 0x80028DAA ValA_Wu16 15.0000000000 DINH_LimDSQVerb 0.00 15.0000000000 FORMAT "%13.10" NUMBER 2 /end CHARACTERISTIC
/begin CHARACTERISTIC DINH_Lim.DSQ_Com_trqGbxDes_CA "DINH/Zugeordnete Verriegelungslimits für Verriegelungsquelle DSQ_Com_trqGbxDes" VAL_BLK 0x80028DAE ValA_Wu16 15.0000000000 DINH_LimDSQVerb 0.00 15.0000000000 FORMAT "%13.10" NUMBER 8 /end CHARACTERISTIC
/begin CHARACTERISTIC DINH_Lim.DSQ_Com_trqGbxFrc_CA "DINH/Zugeordnete Verriegelungslimits für Verriegelungsquelle DSQ_Com_trqGbxFrc" VAL_BLK 0x80028DBE ValA_Wu16 15.0000000000 DINH_LimDSQVerb 0.00 15.0000000000 FORMAT "%13.10" NUMBER 3 /end CHARACTERISTIC
/begin CHARACTERISTIC DINH_Lim.DSQ_Com_trqGbxMax_CA "DINH/Zugeordnete Verriegelungslimits für Verriegelungsquelle DSQ_Com_trqGbxMax" VAL_BLK 0x80028DC4 ValA_Wu16 15.0000000000 DINH_LimDSQVerb 0.00 15.0000000000 FORMAT "%13.10" NUMBER 3 /end CHARACTERISTIC
/begin CHARACTERISTIC DINH_Lim.DSQ_Com_trqGbxMaxRaw_CA "DINH/Zugeordnete Verriegelungslimits für Verriegelungsquelle DSQ_Com_trqGbxMaxRaw" VAL_BLK 0x80028DCA ValA_Wu16 15.0000000000 DINH_LimDSQVerb 0.00 15.0000000000 FORMAT "%13.10" NUMBER 2 /end CHARACTERISTIC
/begin CHARACTERISTIC DINH_Lim.DSQ_Com_trqStbDes_CA "DINH/Zugeordnete Verriegelungslimits für Verriegelungsquelle DSQ_Com_trqStbDes" VAL_BLK 0x80028DCE ValA_Wu16 15.0000000000 DINH_LimDSQVerb 0.00 15.0000000000 FORMAT "%13.10" NUMBER 2 /end CHARACTERISTIC
/begin CHARACTERISTIC DINH_Lim.DSQ_Com_trqStrg_CA "DINH/Zugeordnete Verriegelungslimits für Verriegelungsquelle DSQ_Com_trqStrg" VAL_BLK 0x80028DD2 ValA_Wu16 15.0000000000 DINH_LimDSQVerb 0.00 15.0000000000 FORMAT "%13.10" NUMBER 2 /end CHARACTERISTIC
/begin CHARACTERISTIC DINH_Lim.DSQ_Com_trqStrgDes_CA "DINH/Zugeordnete Verriegelungslimits für Verriegelungsquelle DSQ_Com_trqStrgDes" VAL_BLK 0x80028DD6 ValA_Wu16 15.0000000000 DINH_LimDSQVerb 0.00 15.0000000000 FORMAT "%13.10" NUMBER 2 /end CHARACTERISTIC
/begin CHARACTERISTIC DINH_Lim.DSQ_Com_trqTarDKG_CA "DINH/Zugeordnete Verriegelungslimits für Verriegelungsquelle DSQ_Com_trqTarDKG" VAL_BLK 0x80028DDA ValA_Wu16 15.0000000000 DINH_LimDSQVerb 0.00 15.0000000000 FORMAT "%13.10" NUMBER 2 /end CHARACTERISTIC
/begin CHARACTERISTIC DINH_Lim.DSQ_Com_trqTarDrvDyn_CA "DINH/Zugeordnete Verriegelungslimits für Verriegelungsquelle DSQ_Com_trqTarDrvDyn" VAL_BLK 0x80028DDE ValA_Wu16 15.0000000000 DINH_LimDSQVerb 0.00 15.0000000000 FORMAT "%13.10" NUMBER 2 /end CHARACTERISTIC
/begin CHARACTERISTIC DINH_Lim.DSQ_Com_trqTarDrvDynDes_CA "DINH/Zugeordnete Verriegelungslimits für Verriegelungsquelle DSQ_Com_trqTarDrvDynDes" VAL_BLK 0x80028DE2 ValA_Wu16 15.0000000000 DINH_LimDSQVerb 0.00 15.0000000000 FORMAT "%13.10" NUMBER 2 /end CHARACTERISTIC
/begin CHARACTERISTIC DINH_Lim.DSQ_Com_trqTarDrvDynMax_CA "DINH/Zugeordnete Verriegelungslimits für Verriegelungsquelle DSQ_Com_trqTarDrvDynMax" VAL_BLK 0x80028DE6 ValA_Wu16 15.0000000000 DINH_LimDSQVerb 0.00 15.0000000000 FORMAT "%13.10" NUMBER 2 /end CHARACTERISTIC
/begin CHARACTERISTIC DINH_Lim.DSQ_Com_trqWhlDes_CA "DINH/Zugeordnete Verriegelungslimits für Verriegelungsquelle DSQ_Com_trqWhlDes" VAL_BLK 0x80028DEA ValA_Wu16 15.0000000000 DINH_LimDSQVerb 0.00 15.0000000000 FORMAT "%13.10" NUMBER 3 /end CHARACTERISTIC
/begin CHARACTERISTIC DINH_Lim.DSQ_Com_uLamBinGndRaw_CA "DINH/Zugeordnete Verriegelungslimits für Verriegelungsquelle DSQ_Com_uLamBinGndRaw" VAL_BLK 0x80028DF0 ValA_Wu16 15.0000000000 DINH_LimDSQVerb 0.00 15.0000000000 FORMAT "%13.10" NUMBER 2 /end CHARACTERISTIC
/begin CHARACTERISTIC DINH_Lim.DSQ_Com_uLamBinUbattRaw_CA "DINH/Zugeordnete Verriegelungslimits für Verriegelungsquelle DSQ_Com_uLamBinUbattRaw" VAL_BLK 0x80028DF4 ValA_Wu16 15.0000000000 DINH_LimDSQVerb 0.00 15.0000000000 FORMAT "%13.10" NUMBER 2 /end CHARACTERISTIC
/begin CHARACTERISTIC DINH_Lim.DSQ_Com_uPsp_CA "DINH/Zugeordnete Verriegelungslimits für Verriegelungsquelle DSQ_Com_uPsp" VAL_BLK 0x80028DF8 ValA_Wu16 15.0000000000 DINH_LimDSQVerb 0.00 15.0000000000 FORMAT "%13.10" NUMBER 2 /end CHARACTERISTIC
/begin CHARACTERISTIC DINH_Lim.DSQ_Com_uT30Psp_CA "DINH/Zugeordnete Verriegelungslimits für Verriegelungsquelle DSQ_Com_uT30Psp" VAL_BLK 0x80028DFC ValA_Wu16 15.0000000000 DINH_LimDSQVerb 0.00 15.0000000000 FORMAT "%13.10" NUMBER 2 /end CHARACTERISTIC
/begin CHARACTERISTIC DINH_Lim.DSQ_Com_v_CA "DINH/Zugeordnete Verriegelungslimits für Verriegelungsquelle DSQ_Com_v" VAL_BLK 0x80028E00 ValA_Wu16 15.0000000000 DINH_LimDSQVerb 0.00 15.0000000000 FORMAT "%13.10" NUMBER 17 /end CHARACTERISTIC
/begin CHARACTERISTIC DINH_Lim.DSQ_Com_vBd_CA "DINH/Zugeordnete Verriegelungslimits für Verriegelungsquelle DSQ_Com_vBd" VAL_BLK 0x80028E22 ValA_Wu16 15.0000000000 DINH_LimDSQVerb 0.00 15.0000000000 FORMAT "%13.10" NUMBER 5 /end CHARACTERISTIC
/begin CHARACTERISTIC DINH_Lim.DSQ_Com_vDspl_CA "DINH/Zugeordnete Verriegelungslimits für Verriegelungsquelle DSQ_Com_vDspl" VAL_BLK 0x80028E2C ValA_Wu16 15.0000000000 DINH_LimDSQVerb 0.00 15.0000000000 FORMAT "%13.10" NUMBER 3 /end CHARACTERISTIC
/begin CHARACTERISTIC DINH_Lim.DSQ_Com_vVeh_CA "DINH/Zugeordnete Verriegelungslimits für Verriegelungsquelle DSQ_Com_vVeh" VAL_BLK 0x80028E32 ValA_Wu16 15.0000000000 DINH_LimDSQVerb 0.00 15.0000000000 FORMAT "%13.10" NUMBER 3 /end CHARACTERISTIC
/begin CHARACTERISTIC DINH_Lim.DSQ_Com_volFlTnkQnt_CA "DINH/Zugeordnete Verriegelungslimits für Verriegelungsquelle DSQ_Com_volFlTnkQnt" VAL_BLK 0x80028E38 ValA_Wu16 15.0000000000 DINH_LimDSQVerb 0.00 15.0000000000 FORMAT "%13.10" NUMBER 2 /end CHARACTERISTIC
/begin CHARACTERISTIC DINH_Lim.DSQ_Com_volFlTnkQntLH_CA "DINH/Zugeordnete Verriegelungslimits für Verriegelungsquelle DSQ_Com_volFlTnkQntLH" VAL_BLK 0x80028E3C ValA_Wu16 15.0000000000 DINH_LimDSQVerb 0.00 15.0000000000 FORMAT "%13.10" NUMBER 2 /end CHARACTERISTIC
/begin CHARACTERISTIC DINH_Lim.DSQ_Com_volFlTnkQntRH_CA "DINH/Zugeordnete Verriegelungslimits für Verriegelungsquelle DSQ_Com_volFlTnkQntRH" VAL_BLK 0x80028E40 ValA_Wu16 15.0000000000 DINH_LimDSQVerb 0.00 15.0000000000 FORMAT "%13.10" NUMBER 2 /end CHARACTERISTIC
/begin CHARACTERISTIC DINH_Lim.DSQ_DSMInhibitAlways_CA "DINH/Zugeordnete Verriegelungslimits für Verriegelungsquelle DSQ_DSMInhibitAlways" VAL_BLK 0x80028E44 ValA_Wu16 15.0000000000 DINH_LimDSQVerb 0.00 15.0000000000 FORMAT "%13.10" NUMBER 6 /end CHARACTERISTIC
/begin CHARACTERISTIC DINH_Lim.DSQ_EBxFan_CA "DINH/Zugeordnete Verriegelungslimits für Verriegelungsquelle DSQ_EBxFan" VAL_BLK 0x80028E50 ValA_Wu16 15.0000000000 DINH_LimDSQVerb 0.00 15.0000000000 FORMAT "%13.10" NUMBER 2 /end CHARACTERISTIC
/begin CHARACTERISTIC DINH_Lim.DSQ_EGRVlvActr_CA "DINH/Zugeordnete Verriegelungslimits für Verriegelungsquelle DSQ_EGRVlvActr" VAL_BLK 0x80028E54 ValA_Wu16 15.0000000000 DINH_LimDSQVerb 0.00 15.0000000000 FORMAT "%13.10" NUMBER 3 /end CHARACTERISTIC
/begin CHARACTERISTIC DINH_Lim.DSQ_EGRVlvLPActr_CA "DINH/Zugeordnete Verriegelungslimits für Verriegelungsquelle DSQ_EGRVlvLPActr" VAL_BLK 0x80028E5A ValA_Wu16 15.0000000000 DINH_LimDSQVerb 0.00 15.0000000000 FORMAT "%13.10" NUMBER 3 /end CHARACTERISTIC
/begin CHARACTERISTIC DINH_Lim.DSQ_EGRVlvLPSens_CA "DINH/Zugeordnete Verriegelungslimits für Verriegelungsquelle DSQ_EGRVlvLPSens" VAL_BLK 0x80028E60 ValA_Wu16 15.0000000000 DINH_LimDSQVerb 0.00 15.0000000000 FORMAT "%13.10" NUMBER 2 /end CHARACTERISTIC
/begin CHARACTERISTIC DINH_Lim.DSQ_EMDmp_0_CA "DINH/Zugeordnete Verriegelungslimits für Verriegelungsquelle DSQ_EMDmp_0" VAL_BLK 0x80028E64 ValA_Wu16 15.0000000000 DINH_LimDSQVerb 0.00 15.0000000000 FORMAT "%13.10" NUMBER 2 /end CHARACTERISTIC
/begin CHARACTERISTIC DINH_Lim.DSQ_EMDmp_1_CA "DINH/Zugeordnete Verriegelungslimits für Verriegelungsquelle DSQ_EMDmp_1" VAL_BLK 0x80028E68 ValA_Wu16 15.0000000000 DINH_LimDSQVerb 0.00 15.0000000000 FORMAT "%13.10" NUMBER 2 /end CHARACTERISTIC
/begin CHARACTERISTIC DINH_Lim.DSQ_EngPrtFWOsc_CA "DINH/Zugeordnete Verriegelungslimits für Verriegelungsquelle DSQ_EngPrtFWOsc" VAL_BLK 0x80028E6C ValA_Wu16 15.0000000000 DINH_LimDSQVerb 0.00 15.0000000000 FORMAT "%13.10" NUMBER 5 /end CHARACTERISTIC
/begin CHARACTERISTIC DINH_Lim.DSQ_EngStAActr_CA "DINH/Zugeordnete Verriegelungslimits für Verriegelungsquelle DSQ_EngStAActr" VAL_BLK 0x80028E76 ValA_Wu16 15.0000000000 DINH_LimDSQVerb 0.00 15.0000000000 FORMAT "%13.10" NUMBER 2 /end CHARACTERISTIC
/begin CHARACTERISTIC DINH_Lim.DSQ_EnvP_CA "DINH/Zugeordnete Verriegelungslimits für Verriegelungsquelle DSQ_EnvP" VAL_BLK 0x80028E7A ValA_Wu16 15.0000000000 DINH_LimDSQVerb 0.00 15.0000000000 FORMAT "%13.10" NUMBER 3 /end CHARACTERISTIC
/begin CHARACTERISTIC DINH_Lim.DSQ_EnvT_CA "DINH/Zugeordnete Verriegelungslimits für Verriegelungsquelle DSQ_EnvT" VAL_BLK 0x80028E80 ValA_Wu16 15.0000000000 DINH_LimDSQVerb 0.00 15.0000000000 FORMAT "%13.10" NUMBER 1 /end CHARACTERISTIC
/begin CHARACTERISTIC DINH_Lim.DSQ_ErrLmpActrMIL_CA "DINH/Zugeordnete Verriegelungslimits für Verriegelungsquelle DSQ_ErrLmpActrMIL" VAL_BLK 0x80028E82 ValA_Wu16 15.0000000000 DINH_LimDSQVerb 0.00 15.0000000000 FORMAT "%13.10" NUMBER 2 /end CHARACTERISTIC
/begin CHARACTERISTIC DINH_Lim.DSQ_ErrLmpActrSVS_CA "DINH/Zugeordnete Verriegelungslimits für Verriegelungsquelle DSQ_ErrLmpActrSVS" VAL_BLK 0x80028E86 ValA_Wu16 15.0000000000 DINH_LimDSQVerb 0.00 15.0000000000 FORMAT "%13.10" NUMBER 2 /end CHARACTERISTIC
/begin CHARACTERISTIC DINH_Lim.DSQ_FlFltDsP_CA "DINH/Zugeordnete Verriegelungslimits für Verriegelungsquelle DSQ_FlFltDsP" VAL_BLK 0x80028E8A ValA_Wu16 15.0000000000 DINH_LimDSQVerb 0.00 15.0000000000 FORMAT "%13.10" NUMBER 2 /end CHARACTERISTIC
/begin CHARACTERISTIC DINH_Lim.DSQ_FlFltHtActr_CA "DINH/Zugeordnete Verriegelungslimits für Verriegelungsquelle DSQ_FlFltHtActr" VAL_BLK 0x80028E8E ValA_Wu16 15.0000000000 DINH_LimDSQVerb 0.00 15.0000000000 FORMAT "%13.10" NUMBER 2 /end CHARACTERISTIC
/begin CHARACTERISTIC DINH_Lim.DSQ_FlFltUsP_CA "DINH/Zugeordnete Verriegelungslimits für Verriegelungsquelle DSQ_FlFltUsP" VAL_BLK 0x80028E92 ValA_Wu16 15.0000000000 DINH_LimDSQVerb 0.00 15.0000000000 FORMAT "%13.10" NUMBER 2 /end CHARACTERISTIC
/begin CHARACTERISTIC DINH_Lim.DSQ_FuelLvl_vol_CA "DINH/Zugeordnete Verriegelungslimits für Verriegelungsquelle DSQ_FuelLvl_vol" VAL_BLK 0x80028E96 ValA_Wu16 15.0000000000 DINH_LimDSQVerb 0.00 15.0000000000 FORMAT "%13.10" NUMBER 2 /end CHARACTERISTIC
/begin CHARACTERISTIC DINH_Lim.DSQ_GbxNPosPls_CA "DINH/Zugeordnete Verriegelungslimits für Verriegelungsquelle DSQ_GbxNPosPls" VAL_BLK 0x80028E9A ValA_Wu16 15.0000000000 DINH_LimDSQVerb 0.00 15.0000000000 FORMAT "%13.10" NUMBER 2 /end CHARACTERISTIC
/begin CHARACTERISTIC DINH_Lim.DSQ_IVDiast_CA "DINH/Zugeordnete Verriegelungslimits für Verriegelungsquelle DSQ_IVDiast" VAL_BLK 0x80028E9E ValA_Wu16 15.0000000000 DINH_LimDSQVerb 0.00 15.0000000000 FORMAT "%13.10" NUMBER 3 /end CHARACTERISTIC
/begin CHARACTERISTIC DINH_Lim.DSQ_InjVlvInjCo_CA "DINH/Zugeordnete Verriegelungslimits für Verriegelungsquelle DSQ_InjVlvInjCo" VAL_BLK 0x80028EA4 ValA_Wu16 15.0000000000 DINH_LimDSQVerb 0.00 15.0000000000 FORMAT "%13.10" NUMBER 10 /end CHARACTERISTIC
/begin CHARACTERISTIC DINH_Lim.DSQ_InjVlvPresMin_CA "DINH/Zugeordnete Verriegelungslimits für Verriegelungsquelle DSQ_InjVlvPresMin" VAL_BLK 0x80028EB8 ValA_Wu16 15.0000000000 DINH_LimDSQVerb 0.00 15.0000000000 FORMAT "%13.10" NUMBER 2 /end CHARACTERISTIC
/begin CHARACTERISTIC DINH_Lim.DSQ_LSUO2_CA "DINH/Zugeordnete Verriegelungslimits für Verriegelungsquelle DSQ_LSUO2" VAL_BLK 0x80028EBC ValA_Wu16 15.0000000000 DINH_LimDSQVerb 0.00 15.0000000000 FORMAT "%13.10" NUMBER 1 /end CHARACTERISTIC
/begin CHARACTERISTIC DINH_Lim.DSQ_Layer_rCtrPwrSpCos_CA "DINH/Zugeordnete Verriegelungslimits für Verriegelungsquelle DSQ_Layer_rCtrPwrSpCos" VAL_BLK 0x80028EBE ValA_Wu16 15.0000000000 DINH_LimDSQVerb 0.00 15.0000000000 FORMAT "%13.10" NUMBER 2 /end CHARACTERISTIC
/begin CHARACTERISTIC DINH_Lim.DSQ_MRly_CA "DINH/Zugeordnete Verriegelungslimits für Verriegelungsquelle DSQ_MRly" VAL_BLK 0x80028EC2 ValA_Wu16 15.0000000000 DINH_LimDSQVerb 0.00 15.0000000000 FORMAT "%13.10" NUMBER 2 /end CHARACTERISTIC
/begin CHARACTERISTIC DINH_Lim.DSQ_NoCat2DsO2Val_CA "DINH/Zugeordnete Verriegelungslimits für Verriegelungsquelle DSQ_NoCat2DsO2Val" VAL_BLK 0x80028EC6 ValA_Wu16 15.0000000000 DINH_LimDSQVerb 0.00 15.0000000000 FORMAT "%13.10" NUMBER 2 /end CHARACTERISTIC
/begin CHARACTERISTIC DINH_Lim.DSQ_O2ValNSCDs_CA "DINH/Zugeordnete Verriegelungslimits für Verriegelungsquelle DSQ_O2ValNSCDs" VAL_BLK 0x80028ECA ValA_Wu16 15.0000000000 DINH_LimDSQVerb 0.00 15.0000000000 FORMAT "%13.10" NUMBER 2 /end CHARACTERISTIC
/begin CHARACTERISTIC DINH_Lim.DSQ_O2ValNoCat2Ds_CA "DINH/Zugeordnete Verriegelungslimits für Verriegelungsquelle DSQ_O2ValNoCat2Ds" VAL_BLK 0x80028ECE ValA_Wu16 15.0000000000 DINH_LimDSQVerb 0.00 15.0000000000 FORMAT "%13.10" NUMBER 2 /end CHARACTERISTIC
/begin CHARACTERISTIC DINH_Lim.DSQ_PIntkVUs_CA "DINH/Zugeordnete Verriegelungslimits für Verriegelungsquelle DSQ_PIntkVUs" VAL_BLK 0x80028ED2 ValA_Wu16 15.0000000000 DINH_LimDSQVerb 0.00 15.0000000000 FORMAT "%13.10" NUMBER 3 /end CHARACTERISTIC
/begin CHARACTERISTIC DINH_Lim.DSQ_PPFltUs_CA "DINH/Zugeordnete Verriegelungslimits für Verriegelungsquelle DSQ_PPFltUs" VAL_BLK 0x80028ED8 ValA_Wu16 15.0000000000 DINH_LimDSQVerb 0.00 15.0000000000 FORMAT "%13.10" NUMBER 1 /end CHARACTERISTIC
/begin CHARACTERISTIC DINH_Lim.DSQ_RailShutOffDblCtl_CA "DINH/Zugeordnete Verriegelungslimits für Verriegelungsquelle DSQ_RailShutOffDblCtl" VAL_BLK 0x80028EDA ValA_Wu16 15.0000000000 DINH_LimDSQVerb 0.00 15.0000000000 FORMAT "%13.10" NUMBER 3 /end CHARACTERISTIC
/begin CHARACTERISTIC DINH_Lim.DSQ_RailShutOffMeUnCtl_CA "DINH/Zugeordnete Verriegelungslimits für Verriegelungsquelle DSQ_RailShutOffMeUnCtl" VAL_BLK 0x80028EE0 ValA_Wu16 15.0000000000 DINH_LimDSQVerb 0.00 15.0000000000 FORMAT "%13.10" NUMBER 2 /end CHARACTERISTIC
/begin CHARACTERISTIC DINH_Lim.DSQ_StrtActr_CA "DINH/Zugeordnete Verriegelungslimits für Verriegelungsquelle DSQ_StrtActr" VAL_BLK 0x80028EE4 ValA_Wu16 15.0000000000 DINH_LimDSQVerb 0.00 15.0000000000 FORMAT "%13.10" NUMBER 2 /end CHARACTERISTIC
/begin CHARACTERISTIC DINH_Lim.DSQ_TAFS_CA "DINH/Zugeordnete Verriegelungslimits für Verriegelungsquelle DSQ_TAFS" VAL_BLK 0x80028EE8 ValA_Wu16 15.0000000000 DINH_LimDSQVerb 0.00 15.0000000000 FORMAT "%13.10" NUMBER 1 /end CHARACTERISTIC
/begin CHARACTERISTIC DINH_Lim.DSQ_TCACDs_CA "DINH/Zugeordnete Verriegelungslimits für Verriegelungsquelle DSQ_TCACDs" VAL_BLK 0x80028EEA ValA_Wu16 15.0000000000 DINH_LimDSQVerb 0.00 15.0000000000 FORMAT "%13.10" NUMBER 2 /end CHARACTERISTIC
/begin CHARACTERISTIC DINH_Lim.DSQ_TTrbnUs_CA "DINH/Zugeordnete Verriegelungslimits für Verriegelungsquelle DSQ_TTrbnUs" VAL_BLK 0x80028EEE ValA_Wu16 15.0000000000 DINH_LimDSQVerb 0.00 15.0000000000 FORMAT "%13.10" NUMBER 2 /end CHARACTERISTIC
/begin CHARACTERISTIC DINH_Lim.DSQ_ThrVlvActr_CA "DINH/Zugeordnete Verriegelungslimits für Verriegelungsquelle DSQ_ThrVlvActr" VAL_BLK 0x80028EF2 ValA_Wu16 15.0000000000 DINH_LimDSQVerb 0.00 15.0000000000 FORMAT "%13.10" NUMBER 5 /end CHARACTERISTIC
/begin CHARACTERISTIC DINH_Lim.DSQ_TrbChActr_CA "DINH/Zugeordnete Verriegelungslimits für Verriegelungsquelle DSQ_TrbChActr" VAL_BLK 0x80028EFC ValA_Wu16 15.0000000000 DINH_LimDSQVerb 0.00 15.0000000000 FORMAT "%13.10" NUMBER 3 /end CHARACTERISTIC
/begin CHARACTERISTIC DINH_Lim.DSQ_TrbnDsRLamO2_CA "DINH/Zugeordnete Verriegelungslimits für Verriegelungsquelle DSQ_TrbnDsRLamO2" VAL_BLK 0x80028F02 ValA_Wu16 15.0000000000 DINH_LimDSQVerb 0.00 15.0000000000 FORMAT "%13.10" NUMBER 1 /end CHARACTERISTIC
/begin CHARACTERISTIC DINH_Lim.DSQ_UCatUsT_CA "DINH/Zugeordnete Verriegelungslimits für Verriegelungsquelle DSQ_UCatUsT" VAL_BLK 0x80028F04 ValA_Wu16 15.0000000000 DINH_LimDSQVerb 0.00 15.0000000000 FORMAT "%13.10" NUMBER 2 /end CHARACTERISTIC
/begin CHARACTERISTIC DINH_Lim.DSQ_UDosVlvActr_CA "DINH/Zugeordnete Verriegelungslimits für Verriegelungsquelle DSQ_UDosVlvActr" VAL_BLK 0x80028F08 ValA_Wu16 15.0000000000 DINH_LimDSQVerb 0.00 15.0000000000 FORMAT "%13.10" NUMBER 2 /end CHARACTERISTIC
/begin CHARACTERISTIC DINH_Lim.DSQ_UHtrPL_CA "DINH/Zugeordnete Verriegelungslimits für Verriegelungsquelle DSQ_UHtrPL" VAL_BLK 0x80028F0C ValA_Wu16 15.0000000000 DINH_LimDSQVerb 0.00 15.0000000000 FORMAT "%13.10" NUMBER 2 /end CHARACTERISTIC
/begin CHARACTERISTIC DINH_Lim.DSQ_UHtrPLDia_CA "DINH/Zugeordnete Verriegelungslimits für Verriegelungsquelle DSQ_UHtrPLDia" VAL_BLK 0x80028F10 ValA_Wu16 15.0000000000 DINH_LimDSQVerb 0.00 15.0000000000 FORMAT "%13.10" NUMBER 2 /end CHARACTERISTIC
/begin CHARACTERISTIC DINH_Lim.DSQ_UHtrTnk_CA "DINH/Zugeordnete Verriegelungslimits für Verriegelungsquelle DSQ_UHtrTnk" VAL_BLK 0x80028F14 ValA_Wu16 15.0000000000 DINH_LimDSQVerb 0.00 15.0000000000 FORMAT "%13.10" NUMBER 2 /end CHARACTERISTIC
/begin CHARACTERISTIC DINH_Lim.DSQ_UHtrTnkDia_CA "DINH/Zugeordnete Verriegelungslimits für Verriegelungsquelle DSQ_UHtrTnkDia" VAL_BLK 0x80028F18 ValA_Wu16 15.0000000000 DINH_LimDSQVerb 0.00 15.0000000000 FORMAT "%13.10" NUMBER 2 /end CHARACTERISTIC
/begin CHARACTERISTIC DINH_Lim.DSQ_UPmpMotActr_CA "DINH/Zugeordnete Verriegelungslimits für Verriegelungsquelle DSQ_UPmpMotActr" VAL_BLK 0x80028F1C ValA_Wu16 15.0000000000 DINH_LimDSQVerb 0.00 15.0000000000 FORMAT "%13.10" NUMBER 2 /end CHARACTERISTIC
/begin CHARACTERISTIC DINH_Lim.DSQ_UPmpP_CA "DINH/Zugeordnete Verriegelungslimits für Verriegelungsquelle DSQ_UPmpP" VAL_BLK 0x80028F20 ValA_Wu16 15.0000000000 DINH_LimDSQVerb 0.00 15.0000000000 FORMAT "%13.10" NUMBER 3 /end CHARACTERISTIC
/begin CHARACTERISTIC DINH_Lim.DSQ_URevVlv_CA "DINH/Zugeordnete Verriegelungslimits für Verriegelungsquelle DSQ_URevVlv" VAL_BLK 0x80028F26 ValA_Wu16 15.0000000000 DINH_LimDSQVerb 0.00 15.0000000000 FORMAT "%13.10" NUMBER 2 /end CHARACTERISTIC
/begin CHARACTERISTIC DINH_Lim.DSQ_UTnkLvl_CA "DINH/Zugeordnete Verriegelungslimits für Verriegelungsquelle DSQ_UTnkLvl" VAL_BLK 0x80028F2A ValA_Wu16 15.0000000000 DINH_LimDSQVerb 0.00 15.0000000000 FORMAT "%13.10" NUMBER 2 /end CHARACTERISTIC
/begin CHARACTERISTIC DINH_Lim.DSQ_UTnkT_CA "DINH/Zugeordnete Verriegelungslimits für Verriegelungsquelle DSQ_UTnkT" VAL_BLK 0x80028F2E ValA_Wu16 15.0000000000 DINH_LimDSQVerb 0.00 15.0000000000 FORMAT "%13.10" NUMBER 2 /end CHARACTERISTIC
/begin CHARACTERISTIC DINH_Lim.DSQ_VSwVlvActr_CA "DINH/Zugeordnete Verriegelungslimits für Verriegelungsquelle DSQ_VSwVlvActr" VAL_BLK 0x80028F32 ValA_Wu16 15.0000000000 DINH_LimDSQVerb 0.00 15.0000000000 FORMAT "%13.10" NUMBER 2 /end CHARACTERISTIC
/begin CHARACTERISTIC DINH_Lim.DSQ_stAPP_CA "DINH/Zugeordnete Verriegelungslimits für Verriegelungsquelle DSQ_stAPP" VAL_BLK 0x80028F36 ValA_Wu16 15.0000000000 DINH_LimDSQVerb 0.00 15.0000000000 FORMAT "%13.10" NUMBER 6 /end CHARACTERISTIC
/begin CHARACTERISTIC DINH_Lim.DSQ_stAPP1_CA "DINH/Zugeordnete Verriegelungslimits für Verriegelungsquelle DSQ_stAPP1" VAL_BLK 0x80028F42 ValA_Wu16 15.0000000000 DINH_LimDSQVerb 0.00 15.0000000000 FORMAT "%13.10" NUMBER 6 /end CHARACTERISTIC
/begin CHARACTERISTIC DINH_Lim.DSQ_stAPP2_CA "DINH/Zugeordnete Verriegelungslimits für Verriegelungsquelle DSQ_stAPP2" VAL_BLK 0x80028F4E ValA_Wu16 15.0000000000 DINH_LimDSQVerb 0.00 15.0000000000 FORMAT "%13.10" NUMBER 7 /end CHARACTERISTIC
/begin CHARACTERISTIC DINH_Lim.DSQ_stLSUSrvTstDem_CA "DINH/Zugeordnete Verriegelungslimits für Verriegelungsquelle DSQ_stLSUSrvTstDem" VAL_BLK 0x80028F5C ValA_Wu16 15.0000000000 DINH_LimDSQVerb 0.00 15.0000000000 FORMAT "%13.10" NUMBER 1 /end CHARACTERISTIC
/begin CHARACTERISTIC DINH_Lim.DSQ_stSrvOpLSUAdap_CA "DINH/Zugeordnete Verriegelungslimits für Verriegelungsquelle DSQ_stSrvOpLSUAdap" VAL_BLK 0x80028F5E ValA_Wu16 15.0000000000 DINH_LimDSQVerb 0.00 15.0000000000 FORMAT "%13.10" NUMBER 1 /end CHARACTERISTIC
/begin CHARACTERISTIC DINH_tiUpdObsv_C "Zeitabstand zwischen Seitenwechsel des FId observer" VALUE 0x80025BEA Val_Wu16 655.3500 Time_s 0.00 655.3500 /end CHARACTERISTIC
/begin CHARACTERISTIC DINH_xFIDObsv_C "zu betrachtender Funktionsidentifer im FID observer" VALUE 0x80025BEC Val_Wu16 688. DINH_FIdVerb 0.00 688. FORMAT "%2.0" /end CHARACTERISTIC
/begin CHARACTERISTIC Dio_idxAFSSSpShOffOD_C "" VALUE 0x80038D30 Val_Wu16 65535.00 OneToOne 0.00 65535.00 READ_ONLY /end CHARACTERISTIC
/begin CHARACTERISTIC Dio_idxBrkMnID_C "" VALUE 0x80038D32 Val_Wu16 65535.00 OneToOne 0.00 65535.00 READ_ONLY /end CHARACTERISTIC
/begin CHARACTERISTIC Dio_idxBrkRedID_C "" VALUE 0x80038D34 Val_Wu16 65535.00 OneToOne 0.00 65535.00 READ_ONLY /end CHARACTERISTIC
/begin CHARACTERISTIC Dio_idxCByVlvOD_C "" VALUE 0x80038D36 Val_Wu16 65535.00 OneToOne 0.00 65535.00 READ_ONLY /end CHARACTERISTIC
/begin CHARACTERISTIC Dio_idxClthID_C "" VALUE 0x80038D38 Val_Wu16 65535.00 OneToOne 0.00 65535.00 READ_ONLY /end CHARACTERISTIC
/begin CHARACTERISTIC Dio_idxEBxFanOD_C "" VALUE 0x80038D3A Val_Wu16 65535.00 OneToOne 0.00 65535.00 READ_ONLY /end CHARACTERISTIC
/begin CHARACTERISTIC Dio_idxEGRVlvODDir_C "" VALUE 0x80038D3C Val_Wu16 65535.00 OneToOne 0.00 65535.00 READ_ONLY /end CHARACTERISTIC
/begin CHARACTERISTIC Dio_idxEGRVlvODDis_C "" VALUE 0x80038D3E Val_Wu16 65535.00 OneToOne 0.00 65535.00 READ_ONLY /end CHARACTERISTIC
/begin CHARACTERISTIC Dio_idxEMDmp0OD_C "" VALUE 0x80038D40 Val_Wu16 65535.00 OneToOne 0.00 65535.00 READ_ONLY /end CHARACTERISTIC
/begin CHARACTERISTIC Dio_idxEMDmp1OD_C "" VALUE 0x80038D42 Val_Wu16 65535.00 OneToOne 0.00 65535.00 READ_ONLY /end CHARACTERISTIC
/begin CHARACTERISTIC Dio_idxEngStAOD_C "" VALUE 0x80038D44 Val_Wu16 65535.00 OneToOne 0.00 65535.00 READ_ONLY /end CHARACTERISTIC
/begin CHARACTERISTIC Dio_idxErrLmpMILOD_C "" VALUE 0x80038D46 Val_Wu16 65535.00 OneToOne 0.00 65535.00 READ_ONLY /end CHARACTERISTIC
/begin CHARACTERISTIC Dio_idxErrLmpSVSOD_C "" VALUE 0x80038D48 Val_Wu16 65535.00 OneToOne 0.00 65535.00 READ_ONLY /end CHARACTERISTIC
/begin CHARACTERISTIC Dio_idxFlFltHtOD_C "" VALUE 0x80038D4A Val_Wu16 65535.00 OneToOne 0.00 65535.00 READ_ONLY /end CHARACTERISTIC
/begin CHARACTERISTIC Dio_idxFlFltID_C "" VALUE 0x80038D4C Val_Wu16 65535.00 OneToOne 0.00 65535.00 READ_ONLY /end CHARACTERISTIC
/begin CHARACTERISTIC Dio_idxGbxNPosID_C "" VALUE 0x80038D4E Val_Wu16 65535.00 OneToOne 0.00 65535.00 READ_ONLY /end CHARACTERISTIC
/begin CHARACTERISTIC Dio_idxOilPLmpOD_C "" VALUE 0x80038D50 Val_Wu16 65535.00 OneToOne 0.00 65535.00 READ_ONLY /end CHARACTERISTIC
/begin CHARACTERISTIC Dio_idxStrtOD_C "" VALUE 0x80038D52 Val_Wu16 65535.00 OneToOne 0.00 65535.00 READ_ONLY /end CHARACTERISTIC
/begin CHARACTERISTIC Dio_idxT50ID_C "" VALUE 0x80038D54 Val_Wu16 65535.00 OneToOne 0.00 65535.00 READ_ONLY /end CHARACTERISTIC
/begin CHARACTERISTIC Dio_idxVSwVlvODDir_C "" VALUE 0x80038D56 Val_Wu16 65535.00 OneToOne 0.00 65535.00 READ_ONLY /end CHARACTERISTIC
/begin CHARACTERISTIC Dio_idxVSwVlvODDis_C "" VALUE 0x80038D58 Val_Wu16 65535.00 OneToOne 0.00 65535.00 READ_ONLY /end CHARACTERISTIC
/begin FUNCTION DINH ""
 /begin DEF_CHARACTERISTIC DINH_Lim.DFC_LSUWireIPSig_CA DINH_Lim.DFC_Layer_BSDMax_CA DINH_Lim.DFC_Layer_BSDMin_CA DINH_Lim.DFC_Layer_BSDNpl_CA DINH_Lim.DFC_Layer_BSDSig_CA DINH_Lim.DFC_Layer_FltMngTstMax_CA DINH_Lim.DFC_Layer_FltMngTstMin_CA DINH_Lim.DFC_Layer_FltMngTstNpl_CA DINH_Lim.DFC_Layer_FltMngTstSig_CA DINH_Lim.DFC_Layer_GENELBMax_CA DINH_Lim.DFC_Layer_GENELBMin_CA DINH_Lim.DFC_Layer_GENELBNpl_CA DINH_Lim.DFC_Layer_GENELBSig_CA DINH_Lim.DFC_Layer_GENELMax_CA DINH_Lim.DFC_Layer_GENELMin_CA DINH_Lim.DFC_Layer_GENELNpl_CA DINH_Lim.DFC_Layer_GENELSig_CA DINH_Lim.DFC_Layer_GENHTBMax_CA DINH_Lim.DFC_Layer_GENHTBMin_CA DINH_Lim.DFC_Layer_GENHTBNpl_CA DINH_Lim.DFC_Layer_GENHTBSig_CA DINH_Lim.DFC_Layer_GENHTMax_CA DINH_Lim.DFC_Layer_GENHTMin_CA DINH_Lim.DFC_Layer_GENHTNpl_CA DINH_Lim.DFC_Layer_GENHTSig_CA DINH_Lim.DFC_Layer_GENKOMMMax_CA DINH_Lim.DFC_Layer_GENKOMMMin_CA DINH_Lim.DFC_Layer_GENKOMMNpl_CA DINH_Lim.DFC_Layer_GENKOMMSig_CA DINH_Lim.DFC_Layer_GENMECHMax_CA DINH_Lim.DFC_Layer_GENMECHMin_CA DINH_Lim.DFC_Layer_GENMECHNpl_CA DINH_Lim.DFC_Layer_GENMECHSig_CA DINH_Lim.DFC_Layer_GENMax_CA DINH_Lim.DFC_Layer_GENMin_CA DINH_Lim.DFC_Layer_GENNpl_CA DINH_Lim.DFC_Layer_GENREGUPLMax_CA DINH_Lim.DFC_Layer_GENREGUPLMin_CA DINH_Lim.DFC_Layer_GENREGUPLNpl_CA DINH_Lim.DFC_Layer_GENREGUPLSig_CA DINH_Lim.DFC_Layer_GENSig_CA DINH_Lim.DFC_Layer_GENUPLMax_CA DINH_Lim.DFC_Layer_GENUPLMin_CA DINH_Lim.DFC_Layer_GENUPLNpl_CA DINH_Lim.DFC_Layer_GENUPLSig_CA DINH_Lim.DFC_Layer_IBS1Max_CA DINH_Lim.DFC_Layer_IBS1Min_CA DINH_Lim.DFC_Layer_IBS1Npl_CA DINH_Lim.DFC_Layer_IBS1Sig_CA DINH_Lim.DFC_Layer_IBS2Max_CA DINH_Lim.DFC_Layer_IBS2Min_CA DINH_Lim.DFC_Layer_IBS2Npl_CA DINH_Lim.DFC_Layer_IBS2Sig_CA DINH_Lim.DFC_Layer_IBS3Max_CA DINH_Lim.DFC_Layer_IBS3Min_CA DINH_Lim.DFC_Layer_IBS3Npl_CA DINH_Lim.DFC_Layer_IBS3Sig_CA DINH_Lim.DFC_Layer_MANDETEKMax_CA DINH_Lim.DFC_Layer_MANDETEKMin_CA DINH_Lim.DFC_Layer_MANDETEKNpl_CA DINH_Lim.DFC_Layer_MANDETEKSig_CA DINH_Lim.DFC_Layer_NDR1Max_CA DINH_Lim.DFC_Layer_NDR1Min_CA DINH_Lim.DFC_Layer_NDR1Npl_CA DINH_Lim.DFC_Layer_NDR1Sig_CA DINH_Lim.DFC_Layer_NDR2Max_CA DINH_Lim.DFC_Layer_NDR2Min_CA DINH_Lim.DFC_Layer_NDR2Npl_CA DINH_Lim.DFC_Layer_NDR2Sig_CA DINH_Lim.DFC_Layer_NGLERNMax_CA DINH_Lim.DFC_Layer_NGLERNMin_CA DINH_Lim.DFC_Layer_NGLERNNpl_CA DINH_Lim.DFC_Layer_NGLERNSig_CA DINH_Lim.DFC_Layer_PMBATTMax_CA DINH_Lim.DFC_Layer_PMBATTMin_CA DINH_Lim.DFC_Layer_PMBATTNpl_CA DINH_Lim.DFC_Layer_PMBATTSig_CA DINH_Lim.DFC_Layer_PMBNMax_CA DINH_Lim.DFC_Layer_PMBNMin_CA DINH_Lim.DFC_Layer_PMBNNpl_CA DINH_Lim.DFC_Layer_PMBNSig_CA DINH_Lim.DFC_Layer_PMRUHVERLMax_CA DINH_Lim.DFC_Layer_PMRUHVERLMin_CA DINH_Lim.DFC_Layer_PMRUHVERLNpl_CA DINH_Lim.DFC_Layer_PMRUHVERLSig_CA DINH_Lim.DFC_Layer_QLTMax_CA DINH_Lim.DFC_Layer_QLTMin_CA DINH_Lim.DFC_Layer_QLTNpl_CA DINH_Lim.DFC_Layer_QLTSig_CA DINH_Lim.DFC_Layer_TOENSMax_CA DINH_Lim.DFC_Layer_TOENSMin_CA DINH_Lim.DFC_Layer_TOENSNpl_CA DINH_Lim.DFC_Layer_TOENSSig_CA DINH_Lim.DFC_MonLimCurr_CA DINH_Lim.DFC_MonLimLead_CA DINH_Lim.DFC_MonLimSet_CA DINH_Lim.DFC_NSCDsNOxOfsMax_CA DINH_Lim.DFC_NSCDsNOxOfsMin_CA DINH_Lim.DFC_NSCDsNOxPlausMin_CA DINH_Lim.DFC_NoCat2DsNOxOfsMax_CA DINH_Lim.DFC_NoCat2DsNOxOfsMin_CA DINH_Lim.DFC_NoCat2DsNOxPlausMin_CA DINH_Lim.DFC_PCVNoStrt_CA DINH_Lim.DFC_RailPGradMon_CA DINH_Lim.DFC_SCRPODPresBuildUp_CA DINH_Lim.DFC_AFSDrftIdlAdjVal_CA DINH_Lim.DFC_AFSDrftLdAdjVal_CA DINH_Lim.DFC_AdcIADC0Cal_CA DINH_Lim.DFC_AdcIADC0Conv_CA DINH_Lim.DFC_AdcIADC1Cal_CA DINH_Lim.DFC_AdcIADC1Conv_CA DINH_Lim.DFC_CmbChbMisfireMax_0_CA DINH_Lim.DFC_CmbChbMisfireMax_1_CA DINH_Lim.DFC_CmbChbMisfireMax_2_CA DINH_Lim.DFC_CmbChbMisfireMax_3_CA DINH_Lim.DFC_CmbChbMisfireMax_4_CA DINH_Lim.DFC_CmbChbMisfireMax_5_CA DINH_Lim.DFC_CmbChbMisfireMul_CA DINH_Lim.DFC_EGRVlvLPOfsNeutr_CA DINH_Lim.DFC_EGRVlvOfsNeutr_CA DINH_Lim.DFC_FMAErrModMax_CA DINH_Lim.DFC_FMAErrModMin_CA DINH_Lim.DFC_FlSysTnkLo_CA DINH_Lim.DFC_GbxNPosPlaus_CA DINH_Lim.DFC_I14229_ROETst_Appl_CA DINH_Lim.DFC_I14229_ROETst_Netw_CA DINH_Lim.DFC_I14229_ROE_BufFull_CA DINH_Lim.DFC_IVAdjDiaIVAdj_CA DINH_Lim.DFC_IVAdjIVA_0_CA DINH_Lim.DFC_IVAdjIVA_1_CA DINH_Lim.DFC_IVAdjIVA_2_CA DINH_Lim.DFC_IVAdjIVA_3_CA DINH_Lim.DFC_IVAdjIVA_4_CA DINH_Lim.DFC_IVAdjIVA_5_CA DINH_Lim.DFC_IVPSplyDCDCOff_0_CA DINH_Lim.DFC_IVPSplyDCDCOff_1_CA DINH_Lim.DFC_IVPSplyDCDCOff_2_CA DINH_Lim.DFC_IVPSplyDCDCOff_3_CA DINH_Lim.DFC_InjCtlAdjQntEEPCS_CA DINH_Lim.DFC_LSUSPISig_CA DINH_Lim.DFC_Layer_Dummy_CA DINH_Lim.DFC_NplEnvPSensPPFltDiff_CA DINH_Lim.DFC_NplPresSensPPFltDiff_CA DINH_Lim.DFC_OilLvlPlaus_CA DINH_Lim.DFC_OilTOutLvl_CA DINH_Lim.DFC_PCVfacAdaptMax_CA DINH_Lim.DFC_PCVfacAdaptMin_CA DINH_Lim.DFC_SensFrzPPFltUs_CA DINH_Lim.DFC_SensMonUTnkLvl_CA DINH_Lim.DFC_T15Sig_CA DINH_Lim.DFC_AirCtlRmpTOut_CA DINH_Lim.DFC_BrkPPlaus_CA DINH_Lim.DFC_CEngDsTDynTst_CA DINH_Lim.DFC_EEPEraseErr_CA DINH_Lim.DFC_EEPRdErr_CA DINH_Lim.DFC_EEPWrErr_CA DINH_Lim.DFC_EGRVlvJamVlvClsd_CA DINH_Lim.DFC_EGRVlvJamVlvOpn_CA DINH_Lim.DFC_EGRVlvLPJamVlvClsd_CA DINH_Lim.DFC_EGRVlvLPJamVlvOpn_CA DINH_Lim.DFC_EGRVlvLPLgTDrft_CA DINH_Lim.DFC_EGRVlvLPOfsLrnJamVlv_CA DINH_Lim.DFC_EGRVlvLPShTDrft_CA DINH_Lim.DFC_EGRVlvLgTDrft_CA DINH_Lim.DFC_EGRVlvOfsLrnJamVlv_CA DINH_Lim.DFC_EGRVlvShTDrft_CA DINH_Lim.DFC_EngICO_CA DINH_Lim.DFC_EpmCaSI1ErrSig_CA DINH_Lim.DFC_EpmCaSI1NoSig_CA DINH_Lim.DFC_EpmCaSI1OfsErr_CA DINH_Lim.DFC_EpmCrSErrSig_CA DINH_Lim.DFC_EpmCrSNoSig_CA DINH_Lim.DFC_IVPlausComprTst_CA DINH_Lim.DFC_IVPlausRunUpTst_CA DINH_Lim.DFC_InjCrvShOffTst_CA DINH_Lim.DFC_LayerEnSavModProd_CA DINH_Lim.DFC_LayerEnSavModRep_CA DINH_Lim.DFC_LayerEnSavModShip_CA DINH_Lim.DFC_MRlyErlyOpng_CA DINH_Lim.DFC_MRlyStk_CA DINH_Lim.DFC_MeUnActrTst_CA DINH_Lim.DFC_MoCADCCmp_CA DINH_Lim.DFC_MoCADCTst_CA DINH_Lim.DFC_MoCADCVltgRatio_CA DINH_Lim.DFC_MoCComErrCnt_CA DINH_Lim.DFC_MoCComSPI_CA DINH_Lim.DFC_MoCROMErrXPg_CA DINH_Lim.DFC_MoCSOPHwNoRdy_CA DINH_Lim.DFC_MoCSOPLoLi_CA DINH_Lim.DFC_MoCSOPMM_CA DINH_Lim.DFC_MoCSOPTimeOut_CA DINH_Lim.DFC_MoCSOPUpLi_CA DINH_Lim.DFC_MoFAPP_CA DINH_Lim.DFC_MoFESpd_CA DINH_Lim.DFC_MoFInjDatPhi_CA DINH_Lim.DFC_MoFInjDatQnt_CA DINH_Lim.DFC_MoFInjQnt_CA DINH_Lim.DFC_MoFMode1PoI1_CA DINH_Lim.DFC_MoFMode1PoI2_CA DINH_Lim.DFC_MoFMode2PoI1_CA DINH_Lim.DFC_MoFMode2PoI2_CA DINH_Lim.DFC_MoFOvR_CA DINH_Lim.DFC_MoFQntCor_CA DINH_Lim.DFC_MoFRailP_CA DINH_Lim.DFC_MoFTrqCmp_CA DINH_Lim.DFC_NSCDsHtrSetP_CA DINH_Lim.DFC_NoCat2DsHtrSetP_CA DINH_Lim.DFC_PCVActrTst_CA DINH_Lim.DFC_PhyModNonMonMapNpl_CA DINH_Lim.DFC_RailHpTst_CA DINH_Lim.DFC_RailPOfsTstMax_CA DINH_Lim.DFC_RailPOfsTstMin_CA DINH_Lim.DFC_SIA_E1max_CA DINH_Lim.DFC_SIA_E1min_CA DINH_Lim.DFC_SIA_E1npl_CA DINH_Lim.DFC_SIA_E1sig_CA DINH_Lim.DFC_SIA_E2max_CA DINH_Lim.DFC_SIA_E2min_CA DINH_Lim.DFC_SIA_E2npl_CA DINH_Lim.DFC_SIA_E2sig_CA DINH_Lim.DFC_SIA_E3max_CA DINH_Lim.DFC_SIA_E3min_CA DINH_Lim.DFC_SIA_E3npl_CA DINH_Lim.DFC_SIA_E3sig_CA DINH_Lim.DFC_SIA_E4max_CA DINH_Lim.DFC_SIA_E4min_CA DINH_Lim.DFC_SIA_E4npl_CA DINH_Lim.DFC_SIA_E4sig_CA DINH_Lim.DFC_SWReset_0_CA DINH_Lim.DFC_SWReset_1_CA DINH_Lim.DFC_SWReset_2_CA DINH_Lim.DFC_ShtrAKKMax_CA DINH_Lim.DFC_ShtrAKKMin_CA DINH_Lim.DFC_ShtrAKKNpl_CA DINH_Lim.DFC_ShtrPKKMax_CA DINH_Lim.DFC_StopCntTmr_CA DINH_Lim.DFC_ThrVlvMon_CA DINH_Lim.DFC_VSwVlvJamVlv_CA DINH_Lim.DFC_VSwVlvLgTDrft_CA DINH_Lim.DFC_VSwVlvOfsLrnJamVlv_CA DINH_Lim.DFC_VSwVlvOfsNeutr_CA DINH_Lim.DFC_VSwVlvShTDrft_CA DINH_Lim.DFC_VSwVlvSpgDef_CA DINH_Lim.DSQ_AFS_SSpShOffActr_CA DINH_Lim.DSQ_AirCCmprActr_CA DINH_Lim.DSQ_CEngDsT_CA DINH_Lim.DSQ_CThmstActr_CA DINH_Lim.DSQ_Com_aDirect_CA DINH_Lim.DSQ_Com_aSide_CA DINH_Lim.DSQ_Com_ctrDay_CA DINH_Lim.DSQ_Com_ctrSec_CA DINH_Lim.DSQ_Com_ctrSecAbs_CA DINH_Lim.DSQ_Com_dDay_CA DINH_Lim.DSQ_Com_dMonth_CA DINH_Lim.DSQ_Com_dYear_CA DINH_Lim.DSQ_Com_dphiStWhlAg_CA DINH_Lim.DSQ_Com_dvolPspDes_CA DINH_Lim.DSQ_Com_iHiLimCurr_CA DINH_Lim.DSQ_Com_iLoLimCurr_CA DINH_Lim.DSQ_Com_iPsp_CA DINH_Lim.DSQ_Com_iZrLimCurr_CA DINH_Lim.DSQ_Com_idParkConsumer_CA DINH_Lim.DSQ_Com_idVerbraucher_CA DINH_Lim.DSQ_Com_lFlTnkQntLow_CA DINH_Lim.DSQ_Com_lSum_CA DINH_Lim.DSQ_Com_nDKG_CA DINH_Lim.DSQ_Com_nGbxOut_CA DINH_Lim.DSQ_Com_nPsp_CA DINH_Lim.DSQ_Com_nRqIdlg_CA DINH_Lim.DSQ_Com_nTSC_CA DINH_Lim.DSQ_Com_nWhl_CA DINH_Lim.DSQ_Com_nWhlFL_CA DINH_Lim.DSQ_Com_nWhlFR_CA DINH_Lim.DSQ_Com_nWhlRL_CA DINH_Lim.DSQ_Com_nWhlRR_CA DINH_Lim.DSQ_Com_pBrkSys_CA DINH_Lim.DSQ_Com_phiStWhlAg_CA DINH_Lim.DSQ_Com_rACFanDem_CA DINH_Lim.DSQ_Com_rHtFlowReq_CA DINH_Lim.DSQ_Com_rLamLinRecGndRaw_CA DINH_Lim.DSQ_Com_rLamLinRecUbattRaw_CA DINH_Lim.DSQ_Com_rNOxCat2DsGndRaw_CA DINH_Lim.DSQ_Com_rNOxCat2DsUbattRaw_CA DINH_Lim.DSQ_Com_rPspSetPoint_CA DINH_Lim.DSQ_Com_rPwrSpCons_CA DINH_Lim.DSQ_Com_rTrq_CA DINH_Lim.DSQ_Com_stAC_CA DINH_Lim.DSQ_Com_stACEFan_CA DINH_Lim.DSQ_Com_stARS_CA DINH_Lim.DSQ_Com_stAcpd_CA DINH_Lim.DSQ_Com_stBattClass_CA DINH_Lim.DSQ_Com_stBonnet_CA DINH_Lim.DSQ_Com_stBrkTrqDVCHQl_CA DINH_Lim.DSQ_Com_stButtonMSA_CA DINH_Lim.DSQ_Com_stCat2DsGndRaw_CA DINH_Lim.DSQ_Com_stCat2DsUbattRaw_CA DINH_Lim.DSQ_Com_stClCtr_CA DINH_Lim.DSQ_Com_stClassPwr_CA DINH_Lim.DSQ_Com_stClth_CA DINH_Lim.DSQ_Com_stClthOpen_CA DINH_Lim.DSQ_Com_stClthRaw_CA DINH_Lim.DSQ_Com_stCrCtlKombi_CA DINH_Lim.DSQ_Com_stCrCtlLvr_CA DINH_Lim.DSQ_Com_stDSC_CA DINH_Lim.DSQ_Com_stDecellDSC_CA DINH_Lim.DSQ_Com_stDiagPsp_CA DINH_Lim.DSQ_Com_stDoorDriver_CA DINH_Lim.DSQ_Com_stDrWghSeat_CA DINH_Lim.DSQ_Com_stDrvAssist_CA DINH_Lim.DSQ_Com_stDrvDyn_CA DINH_Lim.DSQ_Com_stDrvPrgQl_CA DINH_Lim.DSQ_Com_stDynDisp_CA DINH_Lim.DSQ_Com_stEngStop_CA DINH_Lim.DSQ_Com_stErrAFS_CA DINH_Lim.DSQ_Com_stErrStrg_CA DINH_Lim.DSQ_Com_stFlTnkQntRes_CA DINH_Lim.DSQ_Com_stFolDyn_CA DINH_Lim.DSQ_Com_stGbxOBD_CA DINH_Lim.DSQ_Com_stGear_CA DINH_Lim.DSQ_Com_stGearBck_CA DINH_Lim.DSQ_Com_stHDC_CA DINH_Lim.DSQ_Com_stKeyVld_CA DINH_Lim.DSQ_Com_stLckGbxDemQl_CA DINH_Lim.DSQ_Com_stLmpPrkBrk_CA DINH_Lim.DSQ_Com_stMSALmp_CA DINH_Lim.DSQ_Com_stModDKG_CA DINH_Lim.DSQ_Com_stNOxErrGndRaw_CA DINH_Lim.DSQ_Com_stNOxErrUbattRaw_CA DINH_Lim.DSQ_Com_stPBrComf_CA DINH_Lim.DSQ_Com_stPBrHold_CA DINH_Lim.DSQ_Com_stPBrHyd_CA DINH_Lim.DSQ_Com_stPBrkSysQl_CA DINH_Lim.DSQ_Com_stPHtr_CA DINH_Lim.DSQ_Com_stParkConsumer_CA DINH_Lim.DSQ_Com_stPsp_CA DINH_Lim.DSQ_Com_stPspCntr_CA DINH_Lim.DSQ_Com_stRaceStrt_CA DINH_Lim.DSQ_Com_stReqMSA_CA DINH_Lim.DSQ_Com_stRevGear_CA DINH_Lim.DSQ_Com_stSTEQl_CA DINH_Lim.DSQ_Com_stSeason_CA DINH_Lim.DSQ_Com_stShftIdctrDemRglX_CA DINH_Lim.DSQ_Com_stShiftPdl_CA DINH_Lim.DSQ_Com_stShutOffPSP_CA DINH_Lim.DSQ_Com_stSleepBus_CA DINH_Lim.DSQ_Com_stSleepConst_CA DINH_Lim.DSQ_Com_stSleepDest_CA DINH_Lim.DSQ_Com_stSleepRdy_CA DINH_Lim.DSQ_Com_stStrg_CA DINH_Lim.DSQ_Com_stStrtClth_CA DINH_Lim.DSQ_Com_stStrtLck_CA DINH_Lim.DSQ_Com_stT15_CA DINH_Lim.DSQ_Com_stT15Hw_CA DINH_Lim.DSQ_Com_stT50_CA DINH_Lim.DSQ_Com_stTRadio_CA DINH_Lim.DSQ_Com_stTSC_CA DINH_Lim.DSQ_Com_stTerminal_CA DINH_Lim.DSQ_Com_stTrailer_CA DINH_Lim.DSQ_Com_stTrqAFS_CA DINH_Lim.DSQ_Com_stTrqDSCDes_CA DINH_Lim.DSQ_Com_stTrqFil_CA DINH_Lim.DSQ_Com_stTrqGbxDes_CA DINH_Lim.DSQ_Com_stTrqGbxLim_CA DINH_Lim.DSQ_Com_stTrqStbDesQl_CA DINH_Lim.DSQ_Com_stTrqStrg_CA DINH_Lim.DSQ_Com_stTrqWhl_CA DINH_Lim.DSQ_Com_stTrqWhlDemFASQl_CA DINH_Lim.DSQ_Com_stTrqWhlDesQl_CA DINH_Lim.DSQ_Com_stTypBody_CA DINH_Lim.DSQ_Com_stUnVel_CA DINH_Lim.DSQ_Com_stVehCond_CA DINH_Lim.DSQ_Com_stVehDrvCond_CA DINH_Lim.DSQ_Com_stVerbraucher_CA DINH_Lim.DSQ_Com_stphiStWhlAg_CA DINH_Lim.DSQ_Com_swtAC_CA DINH_Lim.DSQ_Com_swtDrBltb_CA DINH_Lim.DSQ_Com_tEnvT_CA DINH_Lim.DSQ_Com_tGbxOil_CA DINH_Lim.DSQ_Com_tiPostRunPwrSpl_CA DINH_Lim.DSQ_Com_trqAC_CA DINH_Lim.DSQ_Com_trqAFS_CA DINH_Lim.DSQ_Com_trqAFSDes_CA DINH_Lim.DSQ_Com_trqARSCur_CA DINH_Lim.DSQ_Com_trqARSDes_CA DINH_Lim.DSQ_Com_trqAdjrDKG_CA DINH_Lim.DSQ_Com_trqBrkDVCH_CA DINH_Lim.DSQ_Com_trqClthDKG_CA DINH_Lim.DSQ_Com_trqDSCDes_CA DINH_Lim.DSQ_Com_trqDVCHRise_CA DINH_Lim.DSQ_Com_trqGbxDes_CA DINH_Lim.DSQ_Com_trqGbxFrc_CA DINH_Lim.DSQ_Com_trqGbxMax_CA DINH_Lim.DSQ_Com_trqGbxMaxRaw_CA DINH_Lim.DSQ_Com_trqStbDes_CA DINH_Lim.DSQ_Com_trqStrg_CA DINH_Lim.DSQ_Com_trqStrgDes_CA DINH_Lim.DSQ_Com_trqTarDKG_CA DINH_Lim.DSQ_Com_trqTarDrvDyn_CA DINH_Lim.DSQ_Com_trqTarDrvDynDes_CA DINH_Lim.DSQ_Com_trqTarDrvDynMax_CA DINH_Lim.DSQ_Com_trqWhlDes_CA DINH_Lim.DSQ_Com_uLamBinGndRaw_CA DINH_Lim.DSQ_Com_uLamBinUbattRaw_CA DINH_Lim.DSQ_Com_uPsp_CA DINH_Lim.DSQ_Com_uT30Psp_CA DINH_Lim.DSQ_Com_v_CA DINH_Lim.DSQ_Com_vBd_CA DINH_Lim.DSQ_Com_vDspl_CA DINH_Lim.DSQ_Com_vVeh_CA DINH_Lim.DSQ_Com_volFlTnkQnt_CA DINH_Lim.DSQ_Com_volFlTnkQntLH_CA DINH_Lim.DSQ_Com_volFlTnkQntRH_CA DINH_Lim.DSQ_DSMInhibitAlways_CA DINH_Lim.DSQ_EBxFan_CA DINH_Lim.DSQ_EGRVlvActr_CA DINH_Lim.DSQ_EGRVlvLPActr_CA DINH_Lim.DSQ_EGRVlvLPSens_CA DINH_Lim.DSQ_EMDmp_0_CA DINH_Lim.DSQ_EMDmp_1_CA DINH_Lim.DSQ_EngPrtFWOsc_CA DINH_Lim.DSQ_EngStAActr_CA DINH_Lim.DSQ_EnvP_CA DINH_Lim.DSQ_EnvT_CA DINH_Lim.DSQ_ErrLmpActrMIL_CA DINH_Lim.DSQ_ErrLmpActrSVS_CA DINH_Lim.DSQ_FlFltDsP_CA DINH_Lim.DSQ_FlFltHtActr_CA DINH_Lim.DSQ_FlFltUsP_CA DINH_Lim.DSQ_FuelLvl_vol_CA DINH_Lim.DSQ_GbxNPosPls_CA DINH_Lim.DSQ_IVDiast_CA DINH_Lim.DSQ_InjVlvInjCo_CA DINH_Lim.DSQ_InjVlvPresMin_CA DINH_Lim.DSQ_LSUO2_CA DINH_Lim.DSQ_Layer_rCtrPwrSpCos_CA DINH_Lim.DSQ_MRly_CA DINH_Lim.DSQ_NoCat2DsO2Val_CA DINH_Lim.DSQ_O2ValNSCDs_CA DINH_Lim.DSQ_O2ValNoCat2Ds_CA DINH_Lim.DSQ_PIntkVUs_CA DINH_Lim.DSQ_PPFltUs_CA DINH_Lim.DSQ_RailShutOffDblCtl_CA DINH_Lim.DSQ_RailShutOffMeUnCtl_CA DINH_Lim.DSQ_StrtActr_CA DINH_Lim.DSQ_TAFS_CA DINH_Lim.DSQ_TCACDs_CA DINH_Lim.DSQ_TTrbnUs_CA DINH_Lim.DSQ_ThrVlvActr_CA DINH_Lim.DSQ_TrbChActr_CA DINH_Lim.DSQ_TrbnDsRLamO2_CA DINH_Lim.DSQ_UCatUsT_CA DINH_Lim.DSQ_UDosVlvActr_CA DINH_Lim.DSQ_UHtrPL_CA DINH_Lim.DSQ_UHtrPLDia_CA DINH_Lim.DSQ_UHtrTnk_CA DINH_Lim.DSQ_UHtrTnkDia_CA DINH_Lim.DSQ_UPmpMotActr_CA DINH_Lim.DSQ_UPmpP_CA DINH_Lim.DSQ_URevVlv_CA DINH_Lim.DSQ_UTnkLvl_CA DINH_Lim.DSQ_UTnkT_CA DINH_Lim.DSQ_VSwVlvActr_CA DINH_Lim.DSQ_stAPP_CA DINH_Lim.DSQ_stAPP1_CA DINH_Lim.DSQ_stAPP2_CA DINH_Lim.DSQ_stLSUSrvTstDem_CA DINH_Lim.DSQ_stSrvOpLSUAdap_CA DINH_tiUpdObsv_C DINH_xFIDObsv_C /end DEF_CHARACTERISTIC
/end FUNCTION
/begin FUNCTION Dio ""
 /begin DEF_CHARACTERISTIC Dio_idxAFSSSpShOffOD_C Dio_idxBrkMnID_C Dio_idxBrkRedID_C Dio_idxCByVlvOD_C Dio_idxClthID_C Dio_idxEBxFanOD_C Dio_idxEGRVlvODDir_C Dio_idxEGRVlvODDis_C Dio_idxEMDmp0OD_C Dio_idxEMDmp1OD_C Dio_idxEngStAOD_C Dio_idxErrLmpMILOD_C Dio_idxErrLmpSVSOD_C Dio_idxFlFltHtOD_C Dio_idxFlFltID_C Dio_idxGbxNPosID_C Dio_idxOilPLmpOD_C Dio_idxStrtOD_C Dio_idxT50ID_C Dio_idxVSwVlvODDir_C Dio_idxVSwVlvODDis_C /end DEF_CHARACTERISTIC
/end FUNCTION
/begin FUNCTION Distab "" /end FUNCTION
/begin COMPU_METHOD DINH_FIdVerb "" TAB_VERB "%2.1" "-" COMPU_TAB_REF DINH_FIdVerb /end COMPU_METHOD
/begin COMPU_VTAB DINH_FIdVerb "" TAB_VERB 689 0 "FId_Unused" 1 "FId_InhibitAlways" 2 "FId_CoordALS" 3 "FId_CoordFBC" 4 "FId_CoordTAA" 5 "FId_CoordZFC" 6 "FId_IVPlausRunUpTstActv" 7 "FId_RailHpTstActv" 8 "FId_ACCIRevErr" 9 "FId_ACCRevErr" 10 "FId_ACCtlTEngErr" 11 "FId_ACCtlTGearbxErr" 12 "FId_ACCtlVehVErr" 13 "FId_ACCtl_AC" 14 "FId_ACCtl_Fan" 15 "FId_ACCtlstTrailer" 16 "FId_AFS" 17 "FId_AFSActrTst" 18 "FId_AFSDrftMaxLim" 19 "FId_AFSFrzAirMs" 20 "FId_AFSPlOffsDrft" 21 "FId_AFSPlSetyDrft" 22 "FId_AFSSRC" 23 "FId_AFSSysErr" 24 "FId_AFSTPer" 25 "FId_AFStCond" 26 "FId_AFStEnv" 27 "FId_AGSDem_SelectParameter" 28 "FId_APP1FinalDef" 29 "FId_APP1ProvDef" 30 "FId_APP1SRCHigh" 31 "FId_APP1SigPath" 32 "FId_APP2FinalDef" 33 "FId_APP2ProvDef" 34 "FId_APP2SRCHigh" 35 "FId_APP2SigPath" 36 "FId_APPBrkDef" 37 "FId_APPBrkTrq" 38 "FId_APPNTP" 39 "FId_APPSyncChk" 40 "FId_APPSyncDef" 41 "FId_APPSyncProvDef" 42 "FId_APPSyncSigProv" 43 "FId_APPVel" 44 "FId_APProvDef" 45 "FId_ASDdc" 46 "FId_ASDrfLAD2" 47 "FId_ASModAFS" 48 "FId_ASModAFSTCmpr" 49 "FId_ASModEGRVlvLrn" 50 "FId_ASModOxiC" 51 "FId_ASModPipe" 52 "FId_ASModPipeSlw" 53 "FId_ASModPresCalc" 54 "FId_ASModPresEnv" 55 "FId_ASModStrt" 56 "FId_ASModSwtOffEng" 57 "FId_ASModSwtOffExhMnfLP" 58 "FId_ASModSwtOffIndVol" 59 "FId_ASModT20" 60 "FId_ASModTrbn" 61 "FId_AccPedNMaxLim" 62 "FId_AccPedNMinLim" 63 "FId_AccPedTrqLim" 64 "FId_AdapNSCDs" 65 "FId_AdcIADC0" 66 "FId_AdcIADC1" 67 "FId_AftRun" 68 "FId_AirCSwt" 69 "FId_AirCtl" 70 "FId_AirCtlACCorr" 71 "FId_AirCtlBrk" 72 "FId_AirCtlBstPresCor" 73 "FId_AirCtlCmpntActv" 74 "FId_AirCtlCorAltEOM" 75 "FId_AirCtlDyn" 76 "FId_AirCtlEGR" 77 "FId_AirCtlEGRPreCtl" 78 "FId_AirCtlGear" 79 "FId_AirCtlGovDvt" 80 "FId_AirCtlGovLPDvt" 81 "FId_AirCtlInvEGRMod" 82 "FId_AirCtlLP" 83 "FId_AirCtlLPACCor" 84 "FId_AirCtlLPBstPresCor" 85 "FId_AirCtlLPCmpntActv" 86 "FId_AirCtlLPGear" 87 "FId_AirCtlLPPFltEGRRed" 88 "FId_AirCtlLPStrgCor" 89 "FId_AirCtlLPVehVCor" 90 "FId_AirCtlPFltEGRRed" 91 "FId_AirCtlStrg" 92 "FId_AirCtlTVA" 93 "FId_AirCtlTVACtl" 94 "FId_AirCtlmDesVehCorr" 95 "FId_AirSysTst" 96 "FId_BattUFrzVal" 97 "FId_BattUReplVal" 98 "FId_BattUSRC" 99 "FId_BrkP" 100 "FId_BrkPFrzVal" 101 "FId_BrkPReplVal" 102 "FId_BrkPSens" 103 "FId_BusDiag_stFadeOut" 104 "FId_CEngDsTDynTst" 105 "FId_CEngDsTFrzVal" 106 "FId_CEngDsTModel" 107 "FId_CEngDsTRdClnt" 108 "FId_CEngDsTRplVal" 109 "FId_CEngDsTSS" 110 "FId_Clth" 111 "FId_ClthCAN" 112 "FId_CmbChb" 113 "FId_CoEngNrml2Strt" 114 "FId_CoEngPthClsEGR" 115 "FId_CoEngPthClsThr" 116 "FId_CoEngPthCylOff" 117 "FId_CoEngPthETZr" 118 "FId_CoEngPthFlQnt" 119 "FId_CoEngPthInjVlvOff" 120 "FId_CoEngPthLpSysOff" 121 "FId_CoEngPthRPMin" 122 "FId_CoEngPthTrqZr" 123 "FId_CoEngSoftShOff" 124 "FId_CoEngStop" 125 "FId_CoSCR_CAN" 126 "FId_CoTS_SwtOff" 127 "FId_CoVMDComErr" 128 "FId_CoVMvBd" 129 "FId_CoVehPrpLimErr" 130 "FId_ComAPP" 131 "FId_ComBrkDef" 132 "FId_ComClth" 133 "FId_ComCoEng" 134 "FId_ComCtrSecInt" 135 "FId_ComCtrSecIntTo" 136 "FId_ComDKGIntv" 137 "FId_ComDscAck1" 138 "FId_ComDscAck2" 139 "FId_ComDscAck3" 140 "FId_ComDscTrqIntv" 141 "FId_ComEngDem" 142 "FId_ComGbxAck1" 143 "FId_ComGbxAck2" 144 "FId_ComGbxAck3" 145 "FId_ComGbxTrqIntv" 146 "FId_ComInjDu1" 147 "FId_ComInjDu2" 148 "FId_ComInjVlv" 149 "FId_ComMSA" 150 "FId_ComNDynDispOff" 151 "FId_ComNGbxOut" 152 "FId_ComPCBSPFlt" 153 "FId_ComRCtrPwrSpCos" 154 "FId_ComRpmRduc" 155 "FId_ComSLck" 156 "FId_ComStBrkPedal" 157 "FId_ComStDDEQl" 158 "FId_ComStDrvDirDes" 159 "FId_ComStEnrgPwrMnmt" 160 "FId_ComStGbxModDemFAS" 161 "FId_ComStGrip" 162 "FId_ComStLPCOff" 163 "FId_ComStLckGbxDemQl" 164 "FId_ComStRTrqPTQl" 165 "FId_ComStShiftPdl" 166 "FId_ComStShutOffPSP" 167 "FId_ComStTerminal" 168 "FId_ComStTrq" 169 "FId_ComStTrqGbxQl" 170 "FId_ComStTrqWhlStbQl" 171 "FId_ComStVehDrvCond" 172 "FId_ComStnEngQl" 173 "FId_ComStrtLck" 174 "FId_ComTEng" 175 "FId_ComTOilEng" 176 "FId_ComThrVlv" 177 "FId_ComTrqCootd" 178 "FId_ComTrqWhl" 179 "FId_ComTrqWhlDes" 180 "FId_ComUBatt" 181 "FId_ComVolTotFlCons" 182 "FId_ComnEng" 183 "FId_ComnGbxOut" 184 "FId_ComnSetPLo" 185 "FId_ComnTSC" 186 "FId_CompEnv" 187 "FId_ComrTrq" 188 "FId_ComrTrqPT" 189 "FId_ComrVirtAPP" 190 "FId_ComrWaterVlv" 191 "FId_ComrtrqDifftl" 192 "FId_ComstGear" 193 "FId_ComvVeh" 194 "FId_ConvLdNTrbnCan" 195 "FId_ConvLdOilTemp" 196 "FId_ConvLdTrqLdCan" 197 "FId_ConvLdVel" 198 "FId_CrCUILvr" 199 "FId_CrCtlCan" 200 "FId_CrCtlCanAT" 201 "FId_CrCtlEcu" 202 "FId_Cy100Dev1" 203 "FId_Cy100Dev2" 204 "FId_DCSRmpShOff" 205 "FId_DCSShOff" 206 "FId_DIOnumChip1Cj945" 207 "FId_DIUMPRGenDenom1" 208 "FId_DIUMPRGenDenom2" 209 "FId_DIUMPRGenDenom3" 210 "FId_DIUMPRIgn" 211 "FId_DSMIVAdjNVCEna" 212 "FId_DSMWarmUpCycle" 213 "FId_DStgyMon" 214 "FId_DevLibActrPrt" 215 "FId_DewDetHtgDel" 216 "FId_DewDetstSrvTstDem" 217 "FId_DiaDem_SelectParameter" 218 "FId_DynChkPPFltDiff" 219 "FId_ECBVlvFrzVal" 220 "FId_ECBVlvReplVal" 221 "FId_ECBVlvSS" 222 "FId_EGRClg" 223 "FId_EGRVlvFrzVal" 224 "FId_EGRVlvGovOn" 225 "FId_EGRVlvJamVlv" 226 "FId_EGRVlvLPFrzVal" 227 "FId_EGRVlvLPGovOn" 228 "FId_EGRVlvLPJamVlv" 229 "FId_EGRVlvLPOfsLrnInhib" 230 "FId_EGRVlvLPReplVal" 231 "FId_EGRVlvLPSSpMon" 232 "FId_EGRVlvOfsLrnInhib" 233 "FId_EGRVlvReplVal" 234 "FId_EGRVlvSSpMon" 235 "FId_EGSysMaxTOxiPre" 236 "FId_EGSysMaxTOxiPreRgn" 237 "FId_EGSysMaxTPre" 238 "FId_EGSysMaxTPreRgn" 239 "FId_EMCtl" 240 "FId_ETClbCorActv" 241 "FId_ETCtlAirCtl" 242 "FId_ETCtlInr" 243 "FId_ETCtlOutr" 244 "FId_Empt" 245 "FId_EngDaClntTemp" 246 "FId_EngDemPFltErr" 247 "FId_EngDemPFltOvldErr" 248 "FId_EngDemTrqLimErr" 249 "FId_EngDemTrqLimErr1" 250 "FId_EngDemTrqLimErr2" 251 "FId_EngDemTrqLimErr3" 252 "FId_EngDemTrqLimErr4" 253 "FId_EngPrtEnvP" 254 "FId_EngPrtFWOscInactv" 255 "FId_EngPrtNLimErr" 256 "FId_EngPrtT31" 257 "FId_EngPrtstTrailer" 258 "FId_EnhSRCPPFltDiff" 259 "FId_EnhSRCT1ExhTMon" 260 "FId_EnhSRCT2ExhTMon" 261 "FId_EnhSRCT3ExhTMon" 262 "FId_EnvPFrzVal" 263 "FId_EnvPModel" 264 "FId_EnvPNplPPFltDiff" 265 "FId_EnvPRplVal" 266 "FId_EnvPSS" 267 "FId_EnvTCANFrzVal" 268 "FId_EnvTCANRplVal" 269 "FId_EnvTModel" 270 "FId_EnvTSS" 271 "FId_EpmBCr" 272 "FId_EpmCaSAdapCaSI1" 273 "FId_EpmCaSDiag" 274 "FId_EpmCaSOfsDiagCaSI1" 275 "FId_EpmCaSOfsErrCaSI1" 276 "FId_EpmCaSSegCor" 277 "FId_EpmCrSDiag" 278 "FId_EpmCrSDiagVeh" 279 "FId_EpmOpMode_InjLock" 280 "FId_EpmRRSFaultCheck" 281 "FId_EpmRRSRdCheck" 282 "FId_ExhTMonCondPlaus" 283 "FId_ExhTMonPlausTemp" 284 "FId_FBC" 285 "FId_FBCMonI" 286 "FId_FMALamO2Valid" 287 "FId_FMASwtOff1" 288 "FId_FMASwtOff3" 289 "FId_FanCtl" 290 "FId_FanCtl2" 291 "FId_FanCtlCor" 292 "FId_FanCtlCor2" 293 "FId_FanCtlnEFan" 294 "FId_FanCtlstTrailer" 295 "FId_FanTraOil" 296 "FId_FlFCBSDef" 297 "FId_FlFltDsPFrzVal" 298 "FId_FlFltDsPReplVal" 299 "FId_FlFltUsPFrzVal" 300 "FId_FlFltUsPReplVal" 301 "FId_FlSysDens" 302 "FId_FlSysTnkLoEEP" 303 "FId_FlSysTnkLoInfo" 304 "FId_FrzPrtTrqDfftl" 305 "FId_FrzValAbsUPmpP" 306 "FId_FrzValCANAbsUPmpP" 307 "FId_FrzValCANUCatUsT" 308 "FId_FrzValPPFltDiff" 309 "FId_FrzValPPFltUs" 310 "FId_FrzValTOxiCatUs" 311 "FId_FrzValTPFltUs" 312 "FId_FrzValTTrbnUs" 313 "FId_FrzValUCatUsT" 314 "FId_FrzValUTnkLvl" 315 "FId_FuelTCTS" 316 "FId_FuelTFlSys" 317 "FId_FuelTFrzVal" 318 "FId_FuelTReplVal" 319 "FId_GSHDem_SelectParameter" 320 "FId_GbxNPosPWM" 321 "FId_GlbDaLSumvXPtd" 322 "FId_GlwCtl1" 323 "FId_GlwCtlDrWghSeat" 324 "FId_GlwCtlTRadio" 325 "FId_GlwEcuGPCMFaultInfoTstLck" 326 "FId_GlwEcuGPCMInfoTstLck" 327 "FId_HLSDemDeclGradLim" 328 "FId_HLSDemSetPLoDrvAwy" 329 "FId_HLSDemUndrBrk" 330 "FId_HLSDemtrqConv" 331 "FId_HsLnChkPPFltDiff" 332 "FId_I14229Appl_RC" 333 "FId_ISCnTrbnMod" 334 "FId_ISCtrqConv" 335 "FId_ISCvBd" 336 "FId_IVDiaTst" 337 "FId_IVPSplyDCDCOff" 338 "FId_IVPlausComprTst" 339 "FId_IVPlausRunUpTst" 340 "FId_InhibitNever" 341 "FId_InjCrvCoErr" 342 "FId_InjCrvCylOffs" 343 "FId_InjCrvDisblPoI1" 344 "FId_InjCrvDisblPoI2" 345 "FId_InjCrvPiI1VehCor" 346 "FId_InjCrvPiI2VehCor" 347 "FId_InjCrvPoIOvrLim" 348 "FId_InjCrvShOffTst" 349 "FId_InjUnStrtPlsBlk" 350 "FId_InjVlvBnk0ShutOff" 351 "FId_InjVlvBnk1ShutOff" 352 "FId_InjVlvBnk2ShutOff" 353 "FId_InjVlvBnk3ShutOff" 354 "FId_InjVlvCyl0ShutOff" 355 "FId_InjVlvCyl1ShutOff" 356 "FId_InjVlvCyl2ShutOff" 357 "FId_InjVlvCyl3ShutOff" 358 "FId_InjVlvCyl4ShutOff" 359 "FId_InjVlvCyl5ShutOff" 360 "FId_InjVlvCyl6ShutOff" 361 "FId_InjVlvCyl7ShutOff" 362 "FId_InjVlvPrep" 363 "FId_InjVlvPresMin" 364 "FId_InjVlvPresMinRun" 365 "FId_InjVlvPresMinStrt" 366 "FId_LSUAdap0" 367 "FId_LSUClbSched" 368 "FId_LSUCmpChk0" 369 "FId_LSUCtl0" 370 "FId_LSUDewRls0" 371 "FId_LSUDynChk0" 372 "FId_LSUHtCoup0" 373 "FId_LSUHtrPS0" 374 "FId_LSUIPOpnLdTst0" 375 "FId_LSUIsolChk0" 376 "FId_LSULoBatt0" 377 "FId_LSUMon0" 378 "FId_LSUO20" 379 "FId_LSUO2Clb0" 380 "FId_LSUO2SRC0" 381 "FId_LSUPlausChk0" 382 "FId_LSURi0" 383 "FId_LSURiClb0" 384 "FId_LSUShCir0" 385 "FId_LSUUNVGOpnLdTst0" 386 "FId_LSUlsu0" 387 "FId_Layer_ACFZGL11" 388 "FId_Layer_ACFZGQ11" 389 "FId_Layer_AQUERABS11" 390 "FId_Layer_ATEMPRELATIVZEIT" 391 "FId_Layer_BATTCLASS" 392 "FId_Layer_BEDIENUNG_MSA" 393 "FId_Layer_CANErr" 394 "FId_Layer_CODIERUNG_PM" 395 "FId_Layer_CRASHABSCHALTUNG" 396 "FId_Layer_DIENSTE_19" 397 "FId_Layer_FAHRZEUGTYP" 398 "FId_Layer_FltHtg" 399 "FId_Layer_FltMng_Sig1" 400 "FId_Layer_FltMng_Sig2" 401 "FId_Layer_GESCHWINDIGKEIT" 402 "FId_Layer_GETRIEBEDATEN" 403 "FId_Layer_GETRIEBEDATEN_2" 404 "FId_Layer_KILOMETERSTAND" 405 "FId_Layer_KLEMMENSTATUS" 406 "FId_Layer_LENKRADWINKEL" 407 "FId_Layer_LPC" 408 "FId_Layer_MANDETEK" 409 "FId_Layer_MSACANErr" 410 "FId_Layer_MSAVAdapt" 411 "FId_Layer_MSAVDiag" 412 "FId_Layer_STANDVERBRAUCHER" 413 "FId_Layer_STATDSC" 414 "FId_Layer_STATESEAT" 415 "FId_Layer_STATGANGRUECKWAERTS" 416 "FId_Layer_STATZVKLAPPEN" 417 "FId_Layer_STAT_ANHAENGER" 418 "FId_Layer_STAT_EKP" 419 "FId_Layer_UHRZEIT_DATUM" 420 "FId_Layer_ULCP" 421 "FId_Layer_VCAN11" 422 "FId_Layer_VERBRAUCHER" 423 "FId_Layer_WAERMESTROMKLIMA" 424 "FId_LubmOil" 425 "FId_MeUnActrTst" 426 "FId_MeUnFrzI" 427 "FId_MeUnRot" 428 "FId_MetCtl" 429 "FId_NSCDsAdapEep" 430 "FId_NSCDsCmpChk" 431 "FId_NSCDsNOx" 432 "FId_NSCDsOvrRunPlaus" 433 "FId_NSCDsRdy" 434 "FId_NSCDsSensDia" 435 "FId_NSCDsTO" 436 "FId_NoCat2DsAdap" 437 "FId_NoCat2DsAdapEep" 438 "FId_NoCat2DsCmpChk" 439 "FId_NoCat2DsNOx" 440 "FId_NoCat2DsOvrRunPlaus" 441 "FId_NoCat2DsRdy" 442 "FId_NoCat2DsSensDia" 443 "FId_NoCat2DsTO" 444 "FId_NoPresCtl" 445 "FId_NplPresSensPPFltDiff" 446 "FId_NplTOxiCatUs" 447 "FId_NplTPFltUs" 448 "FId_OilPLmpVOff" 449 "FId_OilPSwmpRplVal" 450 "FId_PCBSDef" 451 "FId_PCBSPFltDef" 452 "FId_PCR" 453 "FId_PCRCByVlvOff" 454 "FId_PCRClthActv" 455 "FId_PCRCmpntActv" 456 "FId_PCRCmpntActvLP" 457 "FId_PCRExtnLimActr" 458 "FId_PCRGovDvt" 459 "FId_PCRGovDvtLP" 460 "FId_PCRLP" 461 "FId_PCROfsRls" 462 "FId_PCRPFltPresCor" 463 "FId_PCRT20" 464 "FId_PCRTrbCh" 465 "FId_PCVActrTst" 466 "FId_PCVFrzI" 467 "FId_PCVNoStrt" 468 "FId_PCVPwrStgTst" 469 "FId_PFltAirSysFail" 470 "FId_PFltChar" 471 "FId_PFltComLSum" 472 "FId_PFltDstr" 473 "FId_PFltEngPrtRgnMon" 474 "FId_PFltLckRgnErr" 475 "FId_PFltLckRgnFl" 476 "FId_PFltLckRgnOilDil" 477 "FId_PFltLdAshCor" 478 "FId_PFltLdAshCorErr" 479 "FId_PFltLdIniAftSuc" 480 "FId_PFltLdNOxEng" 481 "FId_PFltLdO2Aprx" 482 "FId_PFltLdSimRgnThr" 483 "FId_PFltOvldHealInhRn" 484 "FId_PFltOvldHealTrqLm" 485 "FId_PFltPOpBrk" 486 "FId_PFltPOpClth" 487 "FId_PFltPOpGearDet" 488 "FId_PFltPOpSpdVeh" 489 "FId_PFltPOpTempAir" 490 "FId_PFltPOpTempClnt" 491 "FId_PFltPOpVltgBatt" 492 "FId_PFltPoI1Fail" 493 "FId_PFltPoI2Fail" 494 "FId_PFltPresPlausProj" 495 "FId_PFltRgnChngPar" 496 "FId_PFltRgnNoSucDet" 497 "FId_PFltRgnNumErrLck" 498 "FId_PFltRgnNumPFltErr" 499 "FId_PFltRgnSuc" 500 "FId_PFltSimOn" 501 "FId_PFltSysErr2Can" 502 "FId_PFltSysFail" 503 "FId_PFltTOxiPreDiff" 504 "FId_PFltTPreDiff" 505 "FId_PIntkVUsEnvPPls" 506 "FId_PIntkVUsFrzVal" 507 "FId_PIntkVUsRplVal" 508 "FId_PTCltDKG" 509 "FId_PTGripDebPtd" 510 "FId_PTTrqRatCANPtd" 511 "FId_PhyModPCRCorr" 512 "FId_PlausTTrbnUs" 513 "FId_PresBuildUp" 514 "FId_PresCtl" 515 "FId_PresRdc" 516 "FId_PresSensFrzPPFltUs" 517 "FId_QWCCTSDef" 518 "FId_QWCFTSDef" 519 "FId_QWCOff" 520 "FId_RadShtCTS" 521 "FId_RadShtConsum" 522 "FId_RadShtEGS" 523 "FId_RadShtEnvT" 524 "FId_RadShtstTrailer" 525 "FId_RailCPCtlMeUnMode" 526 "FId_RailCPCtlPCVMode" 527 "FId_RailCtlMode" 528 "FId_RailFuelTErr" 529 "FId_RailHpTst" 530 "FId_RailMeUn0Blk" 531 "FId_RailMeUn0Rls" 532 "FId_RailMeUn1Blk" 533 "FId_RailMeUn1Rls" 534 "FId_RailMeUn22Blk" 535 "FId_RailMeUn22Rls" 536 "FId_RailMeUn2Blk" 537 "FId_RailMeUn2Rls" 538 "FId_RailMeUn3Blk" 539 "FId_RailMeUn3Rls" 540 "FId_RailMeUn42Blk" 541 "FId_RailMeUn42Rls" 542 "FId_RailMeUn4Blk" 543 "FId_RailMeUn4Rls" 544 "FId_RailMeUn5Blk" 545 "FId_RailMeUn5Rls" 546 "FId_RailMeUnClsdShutOff" 547 "FId_RailMeUnCtlMode" 548 "FId_RailMeUnCtlUpLim" 549 "FId_RailPCV0Blk" 550 "FId_RailPCV0Rls" 551 "FId_RailPCV1Blk" 552 "FId_RailPCV1Rls" 553 "FId_RailPCV22Blk" 554 "FId_RailPCV22Rls" 555 "FId_RailPCV2Blk" 556 "FId_RailPCV2Rls" 557 "FId_RailPCV3Blk" 558 "FId_RailPCV3Rls" 559 "FId_RailPCV42Blk" 560 "FId_RailPCV42Rls" 561 "FId_RailPCV4Blk" 562 "FId_RailPCV4Rls" 563 "FId_RailPCVCtlMode" 564 "FId_RailPCVCtlUpLim" 565 "FId_RailPFrzVal" 566 "FId_RailPMonStrt" 567 "FId_RailPSS" 568 "FId_RailPSubsVal" 569 "FId_RailSetPointLim" 570 "FId_RailSetPointRed" 571 "FId_RailSetPointVehCor" 572 "FId_ReFl" 573 "FId_ReplValTPFltUs" 574 "FId_RplValAbsUPmpP" 575 "FId_RplValCANAbsUPmpP" 576 "FId_RplValCANUCatUsT" 577 "FId_RplValPPFltDiff" 578 "FId_RplValPPFltUs" 579 "FId_RplValTOxiCatUs" 580 "FId_RplValTTrbnUs" 581 "FId_RplValUCatUsT" 582 "FId_RplValUTnkLvl" 583 "FId_SCRChkNOxEff" 584 "FId_SCRPODPresBuildUp" 585 "FId_SRCFlwRstn" 586 "FId_SSMonFlFltDsP" 587 "FId_SSMonFlFltUsP" 588 "FId_SSPIntkVUs" 589 "FId_SSTOxiCatUs" 590 "FId_SSTPFltUs" 591 "FId_SSUCatUsT" 592 "FId_SSUPmpP" 593 "FId_SSUTnkT" 594 "FId_SensAdapTPFltUs" 595 "FId_StAPmpEna" 596 "FId_StBy" 597 "FId_SubsValPrtTrqDfftl" 598 "FId_SubsValRatTrqDfftl" 599 "FId_T15" 600 "FId_T50Sig" 601 "FId_TAA" 602 "FId_TAFSFrzVal" 603 "FId_TAFSReplVal" 604 "FId_TAFSSRC" 605 "FId_TCACDsCANFrzVal" 606 "FId_TCACDsCANRplVal" 607 "FId_TCACDsFrzVal" 608 "FId_TCACDsModel" 609 "FId_TCACDsRplVal" 610 "FId_TCACDsSS" 611 "FId_TCPrtChrgPmpCtl" 612 "FId_TCPrtChrgPmpGov" 613 "FId_TCPrtChrgPmpHLSDem" 614 "FId_TCPrt_ChrgPmpDet" 615 "FId_TCPrtnSetTSC" 616 "FId_TCSRmpShOff" 617 "FId_TCSShOff" 618 "FId_TECUFrzVal" 619 "FId_TECURplVal" 620 "FId_TOxiCatUs" 621 "FId_TempSensFrzPPFltUs" 622 "FId_TempWait" 623 "FId_ThrVlvFrzVal" 624 "FId_ThrVlvMon" 625 "FId_ThrVlvRplVal" 626 "FId_ThrVlvSS" 627 "FId_TraAddAirCANPtd" 628 "FId_TraAddClntCANPtd" 629 "FId_TraDrvAway" 630 "FId_TraDrvAwayInactiv" 631 "FId_TraGearInfoDet" 632 "FId_TraGearInfoInfoCan" 633 "FId_TraGearInfoLevPos" 634 "FId_TraGearInfoLoRng" 635 "FId_TraGearInfoRTra" 636 "FId_TraGearInfoRevGear" 637 "FId_TraNmin" 638 "FId_TraOilTemp" 639 "FId_TraPrtGearCANPtd" 640 "FId_TraRtnIntfcASTIntv" 641 "FId_TraRtnIntfcIdlSetP" 642 "FId_TraSlip" 643 "FId_TraSpaCAN" 644 "FId_TraSpaEngSpd" 645 "FId_TraSpaVehV" 646 "FId_TraTrqLimErr" 647 "FId_TraTrqLos" 648 "FId_TraTrqRedLmpHmeDec" 649 "FId_TraTrqRedLmpHmeInc" 650 "FId_TraTrqRedPlausDecIntv" 651 "FId_TraTrqRedPlausIncIntv" 652 "FId_TrbChPWMIn" 653 "FId_UHCMonUHtrPL" 654 "FId_UHCMonUHtrTnk" 655 "FId_UHtrPLFrzValDia" 656 "FId_UHtrPLRplValDia" 657 "FId_UHtrPLSSDia" 658 "FId_UHtrTnkFrzValDia" 659 "FId_UHtrTnkRplValDia" 660 "FId_UHtrTnkSSDia" 661 "FId_UTnkLvlSensTst" 662 "FId_UTnkTFrzVal" 663 "FId_UTnkTFrzValCAN" 664 "FId_UTnkTRplVal" 665 "FId_UTnkTRplValCAN" 666 "FId_VMDTrqWhl" 667 "FId_VSwCtl" 668 "FId_VSwCtlVehCorr" 669 "FId_VSwVlvFrzVal" 670 "FId_VSwVlvGovOn" 671 "FId_VSwVlvJamVlv" 672 "FId_VSwVlvOfsLrnInhib" 673 "FId_VSwVlvRplVal" 674 "FId_VSwVlvSS" 675 "FId_VSwVlvSpgDiagInhib" 676 "FId_VehVReplVal" 677 "FId_Vtln" 678 "FId_ZFCClbActv" 679 "FId_ZFCCldCmbCham" 680 "FId_stAVSCoESLSU" 681 "Fid_ComnTSC" 682 "Fid_CustDiag_DiaDem_AT" 683 "Fid_CustDiag_DiaDem_MT" 684 "Fid_HLSDemHDC" 685 "Fid_IVActrTempRplVal" 686 "Fid_StSysStrtTipGbxDat" 687 "Fid_TraCanNeutral" 688 "Fid_WaHtShOffErr" DEFAULT_VALUE "---" /end COMPU_VTAB
/begin COMPU_METHOD DINH_LimDFCVerb "" TAB_VERB "%6.3" "-" COMPU_TAB_REF DINH_LimDFCVerb /end COMPU_METHOD
/begin COMPU_VTAB DINH_LimDFCVerb "" TAB_VERB 19 12079 "Def0_Deb0" 12083 "Def25_Deb0" 12087 "Def50_Deb0" 12091 "Def75_Deb0" 12094 "Def100_Deb0" 12111 "NotTested" 13111 "Def50_Deb25" 13115 "Def75_Deb25" 13118 "Def100_Deb25" 14135 "Def50_Deb50" 14139 "Def75_Deb50" 14142 "Def100_Deb50" 15159 "Def50_Deb75" 15163 "Def75_Deb75" 15166 "Def100_Deb75" 15927 "Def50_Deb100" 15931 "Def75_Deb100" 15934 "Def100_Deb100" 20271 "Tested" /end COMPU_VTAB
/begin COMPU_METHOD DINH_LimDSQVerb "" TAB_VERB "%6.3" "-" COMPU_TAB_REF DINH_LimDSQVerb /end COMPU_METHOD
/begin COMPU_VTAB DINH_LimDSQVerb "" TAB_VERB 16 0 "Qual_AllOk_0" 1 "Qual_1" 2 "Qual_Meas_2" 3 "Qual_PremFrozen_3" 4 "Qual_Model_4" 5 "Qual_5" 6 "Qual_6" 7 "Qual_7" 8 "Qual_Frozen_8" 9 "Qual_9" 10 "Qual_10" 11 "Qual_Tester_11" 12 "Qual_Default_12" 13 "Qual_13" 14 "Qual_14" 15 "Qual_Invalid_15" /end COMPU_VTAB
/begin COMPU_METHOD OneToOne "" RAT_FUNC "%6.0" "-" COEFFS 0 1 0 0 0 1 /end COMPU_METHOD
/begin COMPU_METHOD Time_s "" RAT_FUNC "%5.2" "s" COEFFS 0 100 0 0 0 1 /end COMPU_METHOD
/begin RECORD_LAYOUT ValA_Wu16 FNC_VALUES 1 UWORD COLUMN_DIR DIRECT /end RECORD_LAYOUT
/begin RECORD_LAYOUT Val_Wu16 FNC_VALUES 1 UWORD COLUMN_DIR DIRECT /end RECORD_LAYOUT
/end MODULE
/end PROJECT

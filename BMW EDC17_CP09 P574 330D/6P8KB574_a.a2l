/* MODASAP17: (V4.0 - 05.05.2006) Datei V:\SOFTWARE\BMW\DDE7.3\V8K.B\6-ZYLINDER\6P8KB574+.a2l bearbeitet: 25.10.2006 11:39:08 by system MSWin32*/
/* Erstellt von DAMOS++ V3.12B Test-1 Win2000 */
ASAP2_VERSION 1 4
/begin PROJECT P_574 "EDC17_CP09"
/begin HEADER "" VERSION "V8KB" PROJECT_NO P_574 /end HEADER
/begin MODULE DIM ""
/begin MOD_PAR "EDC17_CP09" VERSION "V8KB" ADDR_EPK 0x80020C78 EPK "33/1/EDC17_CP09/11/P_574//V8KB///" CUSTOMER_NO "11" USER "" PHONE_NO "" ECU "EDC17_CP09" CPU_TYPE "TriCore"
 /begin MEMORY_SEGMENT Pst80004000 "" RESERVED FLASH INTERN 0x80004000 0xFD78 -1 -1 -1 -1 -1 /begin IF_DATA ASAP1B_KWP2000 ADDRESS_MAPPING 0x80004000 0x4000 0xFD78 /end IF_DATA /end MEMORY_SEGMENT
 /begin MEMORY_SEGMENT Pst80013D78 "" RESERVED FLASH INTERN 0x80013D78 0x8C -1 -1 -1 -1 -1 /begin IF_DATA ASAP1B_KWP2000 ADDRESS_MAPPING 0x80013D78 0x13D78 0x8C /end IF_DATA /end MEMORY_SEGMENT
 /begin MEMORY_SEGMENT Pst80080000 "" CODE FLASH INTERN 0x80080000 0x17FE78 -1 -1 -1 -1 -1 /begin IF_DATA ASAP1B_KWP2000 ADDRESS_MAPPING 0x80080000 0x80000 0x17FE78 /end IF_DATA /end MEMORY_SEGMENT
 /begin MEMORY_SEGMENT Pst801FFE78 "" RESERVED FLASH INTERN 0x801FFE78 0x8C -1 -1 -1 -1 -1 /begin IF_DATA ASAP1B_KWP2000 ADDRESS_MAPPING 0x801FFE78 0x1FFE78 0x8C /end IF_DATA /end MEMORY_SEGMENT
 /begin MEMORY_SEGMENT Pst80000000 "" CODE FLASH INTERN 0x80000000 0x3F74 -1 -1 -1 -1 -1 /begin IF_DATA ASAP1B_KWP2000 ADDRESS_MAPPING 0x80000000 0x0 0x3F74 /end IF_DATA /end MEMORY_SEGMENT
 /begin MEMORY_SEGMENT Pst80003F74 "" RESERVED FLASH INTERN 0x80003F74 0x8C -1 -1 -1 -1 -1 /begin IF_DATA ASAP1B_KWP2000 ADDRESS_MAPPING 0x80003F74 0x3F74 0x8C /end IF_DATA /end MEMORY_SEGMENT
 /begin MEMORY_SEGMENT Pst8007FE78 "" RESERVED FLASH INTERN 0x8007FE78 0x8C -1 -1 -1 -1 -1 /begin IF_DATA ASAP1B_KWP2000 ADDRESS_MAPPING 0x8007FE78 0x7FE78 0x8C /end IF_DATA /end MEMORY_SEGMENT
 /begin MEMORY_SEGMENT Pst80018000 "" RESERVED FLASH INTERN 0x80018000 0x7E74 -1 -1 -1 -1 -1 /begin IF_DATA ASAP1B_KWP2000 ADDRESS_MAPPING 0x80018000 0x18000 0x7E74 /end IF_DATA /end MEMORY_SEGMENT
 /begin MEMORY_SEGMENT Pst8001FE74 "" RESERVED FLASH INTERN 0x8001FE74 0x18C -1 -1 -1 -1 -1 /begin IF_DATA ASAP1B_KWP2000 ADDRESS_MAPPING 0x8001FE74 0x1FE74 0x18C /end IF_DATA /end MEMORY_SEGMENT
 /begin MEMORY_SEGMENT Pst80014000 "" RESERVED FLASH INTERN 0x80014000 0x3E74 -1 -1 -1 -1 -1 /begin IF_DATA ASAP1B_KWP2000 ADDRESS_MAPPING 0x80014000 0x14000 0x3E74 /end IF_DATA /end MEMORY_SEGMENT
 /begin MEMORY_SEGMENT Pst80017E74 "" RESERVED FLASH INTERN 0x80017E74 0x18C -1 -1 -1 -1 -1 /begin IF_DATA ASAP1B_KWP2000 ADDRESS_MAPPING 0x80017E74 0x17E74 0x18C /end IF_DATA /end MEMORY_SEGMENT
 /begin MEMORY_SEGMENT Pst80013E04 "" RESERVED FLASH INTERN 0x80013E04 0x1FC -1 -1 -1 -1 -1 /begin IF_DATA ASAP1B_KWP2000 ADDRESS_MAPPING 0x80013E04 0x13E04 0x1FC /end IF_DATA /end MEMORY_SEGMENT
 /begin MEMORY_SEGMENT Pst801FFF04 "" RESERVED FLASH INTERN 0x801FFF04 0xFC -1 -1 -1 -1 -1 /begin IF_DATA ASAP1B_KWP2000 ADDRESS_MAPPING 0x801FFF04 0x1FFF04 0xFC /end IF_DATA /end MEMORY_SEGMENT
 /begin MEMORY_SEGMENT Pst8007FF04 "" RESERVED FLASH INTERN 0x8007FF04 0xFC -1 -1 -1 -1 -1 /begin IF_DATA ASAP1B_KWP2000 ADDRESS_MAPPING 0x8007FF04 0x7FF04 0xFC /end IF_DATA /end MEMORY_SEGMENT
 /begin MEMORY_SEGMENT Dst80020000 "" DATA FLASH INTERN 0x80020000 0x5FE78 -1 -1 -1 -1 -1 /begin IF_DATA ETK ADDRESS_MAPPING 0x80020000 0x82120000 0x5FE78 /end IF_DATA /begin IF_DATA ASAP1B_KWP2000 ADDRESS_MAPPING 0x80020000 0x20000 0x5FE78 /end IF_DATA /end MEMORY_SEGMENT
 /begin MEMORY_SEGMENT Ram82100000 "" VARIABLES RAM EXTERN 0x82100000 0x8000 -1 -1 -1 -1 -1 /begin IF_DATA ASAP1B_KWP2000 ADDRESS_MAPPING 0x82100000 0x700000 0x8000 /end IF_DATA /end MEMORY_SEGMENT
 /begin MEMORY_SEGMENT RamC0000000 "" VARIABLES RAM INTERN 0xC0000000 0x10000 -1 -1 -1 -1 -1 /begin IF_DATA ASAP1B_KWP2000 ADDRESS_MAPPING 0xC0000000 0x400000 0x10000 /end IF_DATA /end MEMORY_SEGMENT
 /begin MEMORY_SEGMENT RamC03FC000 "" VARIABLES RAM INTERN 0xC03FC000 0x4000 -1 -1 -1 -1 -1 /begin IF_DATA ASAP1B_KWP2000 ADDRESS_MAPPING 0xC03FC000 0x4FC000 0x4000 /end IF_DATA /end MEMORY_SEGMENT
 /begin MEMORY_SEGMENT RamD0000000 "" VARIABLES RAM INTERN 0xD0000000 0xE000 -1 -1 -1 -1 -1 /begin IF_DATA ASAP1B_KWP2000 ADDRESS_MAPPING 0xD0000000 0x500000 0xE000 /end IF_DATA /end MEMORY_SEGMENT
 /begin MEMORY_SEGMENT RamD000E000 "" VARIABLES RAM INTERN 0xD000E000 0x2000 -1 -1 -1 -1 -1 /begin IF_DATA ASAP1B_KWP2000 ADDRESS_MAPPING 0xD000E000 0x50E000 0x2000 /end IF_DATA /end MEMORY_SEGMENT
 /begin MEMORY_SEGMENT RamD4000000 "" VARIABLES RAM INTERN 0xD4000000 0xC000 -1 -1 -1 -1 -1 /begin IF_DATA ASAP1B_KWP2000 ADDRESS_MAPPING 0xD4000000 0x600000 0xC000 /end IF_DATA /end MEMORY_SEGMENT
 /begin MEMORY_SEGMENT RamF0060000 "" VARIABLES RAM INTERN 0xF0060000 0x8000 -1 -1 -1 -1 -1 /begin IF_DATA ASAP1B_KWP2000 ADDRESS_MAPPING 0xF0060000 0x660000 0x8000 /end IF_DATA /end MEMORY_SEGMENT
 /begin MEMORY_SEGMENT RamF0050000 "" VARIABLES RAM INTERN 0xF0050000 0x4000 -1 -1 -1 -1 -1 /begin IF_DATA ASAP1B_KWP2000 ADDRESS_MAPPING 0xF0050000 0x650000 0x4000 /end IF_DATA /end MEMORY_SEGMENT
 /begin CALIBRATION_METHOD /* name calibration methode */ "DataSetId" /* version calibration metode */ 256 /begin CALIBRATION_HANDLE /* adr data set id characteristic */ 0x8004DE26 /end CALIBRATION_HANDLE /end CALIBRATION_METHOD
 SYSTEM_CONSTANT "ACCD_PANALIN_CUR_X" "8"
 SYSTEM_CONSTANT "EXTERNAL HEXFILE POST TREATMENT NAME" "hpt_hexmod17_v363.dll"
 SYSTEM_CONSTANT "EXTERNAL HEXFILE POST TREATMENT PARAMETER" "BLK_START=0x80018000"
 SYSTEM_CONSTANT "ACCD_PPRESLIN_CUR_X" "8"
 SYSTEM_CONSTANT "ACCOMP_FACTRQAC_MAP_X" "4"
 SYSTEM_CONSTANT "ACCOMP_FACTRQAC_MAP_Y" "4"
 SYSTEM_CONSTANT "ACCPED_TRQENG_MAP_X" "16"
 SYSTEM_CONSTANT "ACCPED_TRQENG_MAP_Y" "16"
 SYSTEM_CONSTANT "ACCPED_TRQPRP_MAP_X" "16"
 SYSTEM_CONSTANT "ACCPED_TRQPRP_MAP_Y" "16"
 SYSTEM_CONSTANT "ACCTL_TRQFASTLIM_MAP_X" "8"
 SYSTEM_CONSTANT "ACCTL_TRQFASTLIM_MAP_Y" "8"
 SYSTEM_CONSTANT "ACC_NORM_FAC" "2777777.77777778"
 SYSTEM_CONSTANT "ACC_RES" "0.001"
 SYSTEM_CONSTANT "ACC_ZERO" "0"
 SYSTEM_CONSTANT "AC_GEAR" "8"
 SYSTEM_CONSTANT "AC_NOGEAR" "2"
 SYSTEM_CONSTANT "ADC_RES" "1023"
 SYSTEM_CONSTANT "ADC_RESOLUTION_BITS" "12"
 SYSTEM_CONSTANT "ADDHTR_CONST" "360"
 SYSTEM_CONSTANT "AFSCD_DMAIRSUBSVAL_MAP_X" "16"
 SYSTEM_CONSTANT "AFSCD_DMAIRSUBSVAL_MAP_Y" "16"
 SYSTEM_CONSTANT "AFSCD_DMLIN_CUR_X" "32"
 SYSTEM_CONSTANT "AFSCD_PLSCOR_MAP_X" "16"
 SYSTEM_CONSTANT "AFSCD_PLSCOR_MAP_Y" "16"
 SYSTEM_CONSTANT "AFSCD_QAIRMTHRSRCHIACTV_CUR_X" "25"
 SYSTEM_CONSTANT "AFSCD_TLIN_CUR_X" "25"
 SYSTEM_CONSTANT "AFS_MAIRCONV" "66666"
 SYSTEM_CONSTANT "AFS_SSPSHOFF_ATSINTVMOD_SY" "1"
 SYSTEM_CONSTANT "AGSDEM_MSK_ACTIVE" "6"
 SYSTEM_CONSTANT "AG_CRS_REV_SY" "16383.999999996"
 SYSTEM_CONSTANT "AIRCTL_ADD" "0"
 SYSTEM_CONSTANT "AIRCTL_AIRTEMPCORBAS_MAP_X" "16"
 SYSTEM_CONSTANT "AIRCTL_AIRTEMPCORBAS_MAP_Y" "16"
 SYSTEM_CONSTANT "AIRCTL_APSCOR_CUR_X" "25"
 SYSTEM_CONSTANT "AIRCTL_ARLIMMAX_MAP_X" "4"
 SYSTEM_CONSTANT "AIRCTL_ARLIMMAX_MAP_Y" "4"
 SYSTEM_CONSTANT "AIRCTL_DKDNEGEOM_CUR_X" "8"
 SYSTEM_CONSTANT "AIRCTL_DKDNEGGOVEOM_MAP_X" "8"
 SYSTEM_CONSTANT "AIRCTL_DKDNEGGOVEOM_MAP_Y" "8"
 SYSTEM_CONSTANT "AIRCTL_DKDNEGGOVOFF_MAP_X" "8"
 SYSTEM_CONSTANT "AIRCTL_DKDNEGGOVOFF_MAP_Y" "8"
 SYSTEM_CONSTANT "AIRCTL_DKDNEGMDES_MAP_X" "2"
 SYSTEM_CONSTANT "AIRCTL_DKDNEGMDES_MAP_Y" "2"
 SYSTEM_CONSTANT "AIRCTL_DKDNEG_CUR_X" "8"
 SYSTEM_CONSTANT "AIRCTL_DKDPOSEOM_CUR_X" "8"
 SYSTEM_CONSTANT "AIRCTL_DKDPOSGOVEOM_MAP_X" "8"
 SYSTEM_CONSTANT "AIRCTL_DKDPOSGOVEOM_MAP_Y" "8"
 SYSTEM_CONSTANT "AIRCTL_DKDPOSGOVOFF_MAP_X" "8"
 SYSTEM_CONSTANT "AIRCTL_DKDPOSGOVOFF_MAP_Y" "8"
 SYSTEM_CONSTANT "AIRCTL_DKDPOSMDES_MAP_X" "8"
 SYSTEM_CONSTANT "AIRCTL_DKDPOSMDES_MAP_Y" "8"
 SYSTEM_CONSTANT "AIRCTL_DKDPOS_CUR_X" "12"
 SYSTEM_CONSTANT "AIRCTL_DNSURGEHIGH_CUR_X" "5"
 SYSTEM_CONSTANT "AIRCTL_DNSURGELOW_CUR_X" "5"
 SYSTEM_CONSTANT "AIRCTL_FACAIRTEMPDYNCOR_CUR_X" "8"
 SYSTEM_CONSTANT "AIRCTL_FACAIRTEMPLPCOR_MAP_X" "5"
 SYSTEM_CONSTANT "AIRCTL_FACAIRTEMPLPCOR_MAP_Y" "12"
 SYSTEM_CONSTANT "AIRCTL_FACCTSCOR_CUR_X" "10"
 SYSTEM_CONSTANT "AIRCTL_FACDESEGRHIGHMCOR_MAP_X" "4"
 SYSTEM_CONSTANT "AIRCTL_FACDESEGRHIGHMCOR_MAP_Y" "4"
 SYSTEM_CONSTANT "AIRCTL_FACDESLPENGTEMPVCOR_CUR_X" "8"
 SYSTEM_CONSTANT "AIRCTL_FACDESLPVEHVCOR_CUR_X" "4"
 SYSTEM_CONSTANT "AIRCTL_FACDQDYNCOR_CUR_X" "8"
 SYSTEM_CONSTANT "AIRCTL_FACEGRCORALTEOMQNT1_CUR_X" "6"
 SYSTEM_CONSTANT "AIRCTL_FACEGRCORALTEOMQNT2_CUR_X" "6"
 SYSTEM_CONSTANT "AIRCTL_FACENGTEMPCOR2_CUR_X" "16"
 SYSTEM_CONSTANT "AIRCTL_FACENGTEMPDYNCOR_CUR_X" "8"
 SYSTEM_CONSTANT "AIRCTL_FACENGTEMPLPCOR2_CUR_X" "8"
 SYSTEM_CONSTANT "AIRCTL_FACENGTEMPLPCOR_MAP_X" "3"
 SYSTEM_CONSTANT "AIRCTL_FACENGTEMPLPCOR_MAP_Y" "8"
 SYSTEM_CONSTANT "AIRCTL_FACENVPDYNCOR_CUR_X" "8"
 SYSTEM_CONSTANT "AIRCTL_FACENVPRESCORDEF_CUR_X" "6"
 SYSTEM_CONSTANT "AIRCTL_FACENVPRESLPCORDEF_CUR_X" "6"
 SYSTEM_CONSTANT "AIRCTL_FACENVPRESLPCOR_CUR_X" "10"
 SYSTEM_CONSTANT "AIRCTL_FACIATSCOR_CUR_X" "10"
 SYSTEM_CONSTANT "AIRCTL_FACIATSPAR_CUR_X" "25"
 SYSTEM_CONSTANT "AIRCTL_FACIPARBAS_MAP_X" "6"
 SYSTEM_CONSTANT "AIRCTL_FACIPARBAS_MAP_Y" "6"
 SYSTEM_CONSTANT "AIRCTL_FACIPARNEGBAS_MAP_X" "6"
 SYSTEM_CONSTANT "AIRCTL_FACIPARNEGBAS_MAP_Y" "6"
 SYSTEM_CONSTANT "AIRCTL_FACIPARPOSBAS_MAP_X" "6"
 SYSTEM_CONSTANT "AIRCTL_FACIPARPOSBAS_MAP_Y" "6"
 SYSTEM_CONSTANT "AIRCTL_FACMDESVEHTEMPCORR_CUR_X" "8"
 SYSTEM_CONSTANT "AIRCTL_FACMDESVEHVCORR_CUR_X" "4"
 SYSTEM_CONSTANT "AIRCTL_FACNQPAR_MAP_X" "16"
 SYSTEM_CONSTANT "AIRCTL_FACNQPAR_MAP_Y" "16"
 SYSTEM_CONSTANT "AIRCTL_FACPARBASEOM_MAP_X" "2"
 SYSTEM_CONSTANT "AIRCTL_FACPARBASEOM_MAP_Y" "2"
 SYSTEM_CONSTANT "AIRCTL_FACPARBAS_MAP_X" "10"
 SYSTEM_CONSTANT "AIRCTL_FACPARBAS_MAP_Y" "10"
 SYSTEM_CONSTANT "AIRCTL_FACPARLPAIRTEMP_CUR_X" "10"
 SYSTEM_CONSTANT "AIRCTL_FACPARLPBAS_MAP_X" "10"
 SYSTEM_CONSTANT "AIRCTL_FACPARLPBAS_MAP_Y" "10"
 SYSTEM_CONSTANT "AIRCTL_FACPARPRESEGRDIFF_CUR_X" "6"
 SYSTEM_CONSTANT "AIRCTL_FACPCRCORNEG_MAP_X" "8"
 SYSTEM_CONSTANT "AIRCTL_FACPCRCORNEG_MAP_Y" "8"
 SYSTEM_CONSTANT "AIRCTL_FACPCRCORPOS_MAP_X" "8"
 SYSTEM_CONSTANT "AIRCTL_FACPCRCORPOS_MAP_Y" "8"
 SYSTEM_CONSTANT "AIRCTL_FACPPARBAS_MAP_X" "6"
 SYSTEM_CONSTANT "AIRCTL_FACPPARBAS_MAP_Y" "6"
 SYSTEM_CONSTANT "AIRCTL_FACPPARNEGBAS_MAP_X" "6"
 SYSTEM_CONSTANT "AIRCTL_FACPPARNEGBAS_MAP_Y" "6"
 SYSTEM_CONSTANT "AIRCTL_FACPPARPOSBAS_MAP_X" "6"
 SYSTEM_CONSTANT "AIRCTL_FACPPARPOSBAS_MAP_Y" "6"
 SYSTEM_CONSTANT "AIRCTL_FACTVACTLATCOR_CUR_X" "6"
 SYSTEM_CONSTANT "AIRCTL_FACTVACTLCTCOR_CUR_X" "6"
 SYSTEM_CONSTANT "AIRCTL_MDESACCORR_CUR_X" "8"
 SYSTEM_CONSTANT "AIRCTL_MDESBASDEFQNT_MAP_Y" "16"
 SYSTEM_CONSTANT "AIRCTL_MDESBASDEFTRQ_MAP_Y" "16"
 SYSTEM_CONSTANT "AIRCTL_MDESBASDEF_MAP_X" "16"
 SYSTEM_CONSTANT "AIRCTL_MDESBASHIALTDDEFQNT_MAP_Y" "16"
 SYSTEM_CONSTANT "AIRCTL_MDESBASHIALTDDEFTRQ_MAP_Y" "16"
 SYSTEM_CONSTANT "AIRCTL_MDESBASHIALTDDEF_MAP_X" "16"
 SYSTEM_CONSTANT "AIRCTL_MDESBASLPDEF_MAP_X" "8"
 SYSTEM_CONSTANT "AIRCTL_MDESBASLPDEF_MAP_Y" "12"
 SYSTEM_CONSTANT "AIRCTL_MDESBASLPHIALTDDEF_MAP_X" "8"
 SYSTEM_CONSTANT "AIRCTL_MDESBASLPHIALTDDEF_MAP_Y" "12"
 SYSTEM_CONSTANT "AIRCTL_MDESBASLPHIALTD_MAP_X" "16"
 SYSTEM_CONSTANT "AIRCTL_MDESBASLPHIALTD_MAP_Y" "16"
 SYSTEM_CONSTANT "AIRCTL_MDESBAS_MAP_X" "16"
 SYSTEM_CONSTANT "AIRCTL_MDESBAS_MAP_Y" "16"
 SYSTEM_CONSTANT "AIRCTL_MDESGEAREOMQNT_MAP_Y" "4"
 SYSTEM_CONSTANT "AIRCTL_MDESGEAREOMTRQ_MAP_Y" "4"
 SYSTEM_CONSTANT "AIRCTL_MDESGEARQNT_MAP_Y" "4"
 SYSTEM_CONSTANT "AIRCTL_MDESGEARTRQ_MAP_Y" "4"
 SYSTEM_CONSTANT "AIRCTL_MDESGEAR_MAP_X" "4"
 SYSTEM_CONSTANT "AIRCTL_MDESLPACCOR_CUR_X" "8"
 SYSTEM_CONSTANT "AIRCTL_MDESLPVEHVCOR_MAP_X" "4"
 SYSTEM_CONSTANT "AIRCTL_MDESLPVEHVCOR_MAP_Y" "6"
 SYSTEM_CONSTANT "AIRCTL_MDESRMP_CUR_X" "7"
 SYSTEM_CONSTANT "AIRCTL_MDESSTRGCORREOM_MAP_X" "4"
 SYSTEM_CONSTANT "AIRCTL_MDESSTRGCORREOM_MAP_Y" "4"
 SYSTEM_CONSTANT "AIRCTL_MDESSTRGCORR_MAP_X" "4"
 SYSTEM_CONSTANT "AIRCTL_MDESSTRGCORR_MAP_Y" "4"
 SYSTEM_CONSTANT "AIRCTL_MDESVEHVCORR_MAP_X" "16"
 SYSTEM_CONSTANT "AIRCTL_MDESVEHVCORR_MAP_Y" "16"
 SYSTEM_CONSTANT "AIRCTL_MDQDYNCOR_MAP_X" "16"
 SYSTEM_CONSTANT "AIRCTL_MDQDYNCOR_MAP_Y" "16"
 SYSTEM_CONSTANT "AIRCTL_MENGTEMPCORBAS2QNT_MAP_Y" "16"
 SYSTEM_CONSTANT "AIRCTL_MENGTEMPCORBAS2TRQ_MAP_Y" "16"
 SYSTEM_CONSTANT "AIRCTL_MENGTEMPCORBAS2_MAP_X" "16"
 SYSTEM_CONSTANT "AIRCTL_MENGTEMPLPCORBAS2_MAP_X" "8"
 SYSTEM_CONSTANT "AIRCTL_MENGTEMPLPCORBAS2_MAP_Y" "8"
 SYSTEM_CONSTANT "AIRCTL_MENGTEMPLPCORBAS_MAP_X" "12"
 SYSTEM_CONSTANT "AIRCTL_MENGTEMPLPCORBAS_MAP_Y" "16"
 SYSTEM_CONSTANT "AIRCTL_MMAXDVT_MAP_X" "14"
 SYSTEM_CONSTANT "AIRCTL_MMAXDVT_MAP_Y" "16"
 SYSTEM_CONSTANT "AIRCTL_MMAXLPDVT_MAP_X" "6"
 SYSTEM_CONSTANT "AIRCTL_MMAXLPDVT_MAP_Y" "6"
 SYSTEM_CONSTANT "AIRCTL_MMINLPDVT_MAP_X" "6"
 SYSTEM_CONSTANT "AIRCTL_MMINLPDVT_MAP_Y" "6"
 SYSTEM_CONSTANT "AIRCTL_MNQCTSCOR_MAP_X" "16"
 SYSTEM_CONSTANT "AIRCTL_MNQCTSCOR_MAP_Y" "16"
 SYSTEM_CONSTANT "AIRCTL_MTRMVALQNT_MAP_Y" "16"
 SYSTEM_CONSTANT "AIRCTL_MTRMVALTRQ_MAP_Y" "16"
 SYSTEM_CONSTANT "AIRCTL_MTRMVAL_MAP_X" "16"
 SYSTEM_CONSTANT "AIRCTL_MUL" "1"
 SYSTEM_CONSTANT "AIRCTL_NQIATSCOR_MAP_X" "16"
 SYSTEM_CONSTANT "AIRCTL_NQIATSCOR_MAP_Y" "16"
 SYSTEM_CONSTANT "AIRCTL_NUMSTPRIOMON" "31"
 SYSTEM_CONSTANT "AIRCTL_NUMSTPRIOMONLP" "21"
 SYSTEM_CONSTANT "AIRCTL_PBSTPRESLPREF_MAP_X" "4"
 SYSTEM_CONSTANT "AIRCTL_PBSTPRESLPREF_MAP_Y" "4"
 SYSTEM_CONSTANT "AIRCTL_PBSTPRESREF_MAP_X" "2"
 SYSTEM_CONSTANT "AIRCTL_PBSTPRESREF_MAP_Y" "2"
 SYSTEM_CONSTANT "AIRCTL_QHI_CUR_X" "16"
 SYSTEM_CONSTANT "AIRCTL_QHPMIXOFF_CUR_X" "8"
 SYSTEM_CONSTANT "AIRCTL_QHPMIXON_CUR_X" "8"
 SYSTEM_CONSTANT "AIRCTL_QLO_CUR_X" "16"
 SYSTEM_CONSTANT "AIRCTL_QLPHI_CUR_X" "12"
 SYSTEM_CONSTANT "AIRCTL_QLPLO_CUR_X" "12"
 SYSTEM_CONSTANT "AIRCTL_QNTCTL_QRAW" "1"
 SYSTEM_CONSTANT "AIRCTL_QNTDES_QRAW" "1"
 SYSTEM_CONSTANT "AIRCTL_QNTGOV_QCURR" "0"
 SYSTEM_CONSTANT "AIRCTL_QNTMON_QCURR" "0"
 SYSTEM_CONSTANT "AIRCTL_QSURGEHIGH_CUR_X" "5"
 SYSTEM_CONSTANT "AIRCTL_QSURGELOW_CUR_X" "5"
 SYSTEM_CONSTANT "AIRCTL_RAT2PRC" "8192"
 SYSTEM_CONSTANT "AIRCTL_RCTLVALLPNRM_MAP_X" "4"
 SYSTEM_CONSTANT "AIRCTL_RCTLVALLPNRM_MAP_Y" "4"
 SYSTEM_CONSTANT "AIRCTL_RDIFFDYNMIN_CUR_X" "6"
 SYSTEM_CONSTANT "AIRCTL_RDYNMINEOM1_MAP_X" "2"
 SYSTEM_CONSTANT "AIRCTL_RDYNMINEOM1_MAP_Y" "2"
 SYSTEM_CONSTANT "AIRCTL_RDYNMIN_MAP_X" "2"
 SYSTEM_CONSTANT "AIRCTL_RDYNMIN_MAP_Y" "2"
 SYSTEM_CONSTANT "AIRCTL_REFFEGRINV_CUR_X" "10"
 SYSTEM_CONSTANT "AIRCTL_REGRCORALTEOMQNT1_MAP_X" "6"
 SYSTEM_CONSTANT "AIRCTL_REGRCORALTEOMQNT1_MAP_Y" "6"
 SYSTEM_CONSTANT "AIRCTL_REGRCORALTEOMQNT2_MAP_X" "6"
 SYSTEM_CONSTANT "AIRCTL_REGRCORALTEOMQNT2_MAP_Y" "6"
 SYSTEM_CONSTANT "AIRCTL_REGREOMQNT2_MAP_X" "12"
 SYSTEM_CONSTANT "AIRCTL_REGREOMQNT2_MAP_Y" "10"
 SYSTEM_CONSTANT "AIRCTL_REGREOM_MAP_X" "12"
 SYSTEM_CONSTANT "AIRCTL_REGREOM_MAP_Y" "10"
 SYSTEM_CONSTANT "AIRCTL_REGRPRERCTLINV_CUR_X" "10"
 SYSTEM_CONSTANT "AIRCTL_REGR_MAP_X" "6"
 SYSTEM_CONSTANT "AIRCTL_REGR_MAP_Y" "11"
 SYSTEM_CONSTANT "AIRCTL_RGOVDYNMINEOM1_CUR_X" "2"
 SYSTEM_CONSTANT "AIRCTL_RGOVDYNMIN_CUR_X" "2"
 SYSTEM_CONSTANT "AIRCTL_RGOVLPMIN_MAP_X" "5"
 SYSTEM_CONSTANT "AIRCTL_RGOVLPMIN_MAP_Y" "5"
 SYSTEM_CONSTANT "AIRCTL_RPCRCORDIFF_CUR_X" "12"
 SYSTEM_CONSTANT "AIRCTL_RSURGEHIGH_MAP_X" "6"
 SYSTEM_CONSTANT "AIRCTL_RSURGEHIGH_MAP_Y" "4"
 SYSTEM_CONSTANT "AIRCTL_RSURGEOFS_CUR_X" "5"
 SYSTEM_CONSTANT "AIRCTL_RTVACTLATCOR_MAP_X" "8"
 SYSTEM_CONSTANT "AIRCTL_RTVACTLATCOR_MAP_Y" "8"
 SYSTEM_CONSTANT "AIRCTL_RTVACTLBASOVRRUN_MAP_X" "6"
 SYSTEM_CONSTANT "AIRCTL_RTVACTLBASOVRRUN_MAP_Y" "2"
 SYSTEM_CONSTANT "AIRCTL_RTVACTLBAS_MAP_X" "16"
 SYSTEM_CONSTANT "AIRCTL_RTVACTLBAS_MAP_Y" "16"
 SYSTEM_CONSTANT "AIRCTL_RTVACTLCTCOR_MAP_X" "8"
 SYSTEM_CONSTANT "AIRCTL_RTVACTLCTCOR_MAP_Y" "8"
 SYSTEM_CONSTANT "AIRCTL_RTVACTLENVPCOR_CUR_X" "8"
 SYSTEM_CONSTANT "AIRCTL_RTVAEOM_MAP_X" "4"
 SYSTEM_CONSTANT "AIRCTL_RTVAEOM_MAP_Y" "8"
 SYSTEM_CONSTANT "AIRCTL_RTVA_MAP_X" "6"
 SYSTEM_CONSTANT "AIRCTL_RTVA_MAP_Y" "11"
 SYSTEM_CONSTANT "AIRCTL_SWTAIRTEMPCOR_TYPE" "0"
 SYSTEM_CONSTANT "AIRCTL_SWTAIRTEMPCOR_VAL" "0"
 SYSTEM_CONSTANT "AIRCTL_SWTAPSCOR_TYPE" "0"
 SYSTEM_CONSTANT "AIRCTL_SWTAPSCOR_VAL" "0"
 SYSTEM_CONSTANT "AIRCTL_SWTGOV_TYPE" "2"
 SYSTEM_CONSTANT "AIRCTL_SWTGOV_VAL" "1"
 SYSTEM_CONSTANT "AIRCTL_SWTGVNR_TYPE" "2"
 SYSTEM_CONSTANT "AIRCTL_SWTGVNR_VAL" "1"
 SYSTEM_CONSTANT "AIRCTL_SWTIATSCOR_TYPE" "0"
 SYSTEM_CONSTANT "AIRCTL_SWTIATSCOR_VAL" "0"
 SYSTEM_CONSTANT "AIRCTL_SWTTRM_TYPE" "0"
 SYSTEM_CONSTANT "AIRCTL_SWTTRM_VAL" "0"
 SYSTEM_CONSTANT "AIRCTL_TIAFSPT1_MAP_X" "6"
 SYSTEM_CONSTANT "AIRCTL_TIAFSPT1_MAP_Y" "6"
 SYSTEM_CONSTANT "AIRCTL_TICLDSTRT_CUR_X" "8"
 SYSTEM_CONSTANT "AIRCTL_TRQINRCTL_RAW" "1"
 SYSTEM_CONSTANT "AIRCTL_TRQINRDES_RAW" "1"
 SYSTEM_CONSTANT "AIRCTL_TRQINRGOV_CURR" "0"
 SYSTEM_CONSTANT "AIRCTL_TRQINRMON_CURR" "0"
 SYSTEM_CONSTANT "AIRC_ATSINTVMODCMPR_SY" "0"
 SYSTEM_CONSTANT "AIRC_ATSINTVMODREDTRQ_SY" "0"
 SYSTEM_CONSTANT "AIRC_REDTRQCMPRENA_SY" "0"
 SYSTEM_CONSTANT "AIRFLRAT_RES" "0.005"
 SYSTEM_CONSTANT "AIRFLRAT_RES_REV" "200"
 SYSTEM_CONSTANT "AIRMASS_MAX" "5000"
 SYSTEM_CONSTANT "AIRMASS_MIN" "-5000"
 SYSTEM_CONSTANT "AIRMASS_ONE" "1"
 SYSTEM_CONSTANT "AIRMASS_ZERO" "0"
 SYSTEM_CONSTANT "AIRSYSSWT_RES" "6.103515625e-008"
 SYSTEM_CONSTANT "AIRSYSSWT_RES_S16" "6.103515625e-005"
 SYSTEM_CONSTANT "AIRSYS_CTFLD_NUM" "4"
 SYSTEM_CONSTANT "AIRSYS_RMPTIME_MIN" "1e-008"
 SYSTEM_CONSTANT "AIRSYS_RMP_MAX" "1"
 SYSTEM_CONSTANT "AIRSYS_RMP_MAX_S16" "1"
 SYSTEM_CONSTANT "AIRSYS_RMP_MIN" "0"
 SYSTEM_CONSTANT "AIRSYS_SWT_FACT" "16384000"
 SYSTEM_CONSTANT "AIRSYS_SWT_FACT_S16" "16384"
 SYSTEM_CONSTANT "AIRSYS_SWT_NRM_EXP" "14"
 SYSTEM_CONSTANT "AIR_HEAT_CAPACITY" "1.006"
 SYSTEM_CONSTANT "AIR_KG_GM" "10"
 SYSTEM_CONSTANT "AIR_MASS_NORM" "66666"
 SYSTEM_CONSTANT "ALTCRNT_LIM_RES_SY" "0.25"
 SYSTEM_CONSTANT "ALTCRNT_OUT_RES_SY" "0.125"
 SYSTEM_CONSTANT "ALTIO_ALTTYP_BSS1" "1"
 SYSTEM_CONSTANT "ALTIO_ALTTYP_BSS2" "2"
 SYSTEM_CONSTANT "ALTIO_BSS_PERI_ID_SY" "6"
 SYSTEM_CONSTANT "ALTLD_RES_SY" "3.125"
 SYSTEM_CONSTANT "ALTVLTG_OFS_SY" "10.6"
 SYSTEM_CONSTANT "ALTVLTG_RES_SY" "0.1"
 SYSTEM_CONSTANT "ALT_CHPTEMP_OFS_SY" "-32"
 SYSTEM_CONSTANT "ALT_CHPTEMP_RES_SY" "8"
 SYSTEM_CONSTANT "AMPC_NULL" "0"
 SYSTEM_CONSTANT "AMPC_RES" "0.1"
 SYSTEM_CONSTANT "AMPC_RES_FL" "0.1"
 SYSTEM_CONSTANT "AMPC_RES_REV" "10"
 SYSTEM_CONSTANT "AMPC_ZERO" "0"
 SYSTEM_CONSTANT "AMPERE_ADC_RES" "0.2"
 SYSTEM_CONSTANT "AMPERE_ZERO" "0"
 SYSTEM_CONSTANT "AMPTGPERSEC_RES" "0.05"
 SYSTEM_CONSTANT "AMPTGPERSEC_RES_FL" "0.05"
 SYSTEM_CONSTANT "AMPTGPERSEC_RES_REV" "20"
 SYSTEM_CONSTANT "AMPTSCND_RES" "0.1"
 SYSTEM_CONSTANT "AMPT_NULL" "0"
 SYSTEM_CONSTANT "AMPT_RES" "0.1"
 SYSTEM_CONSTANT "AMPT_RES_FL" "0.1"
 SYSTEM_CONSTANT "AMPT_RES_REV" "10"
 SYSTEM_CONSTANT "AMPT_ZERO" "0"
 SYSTEM_CONSTANT "AM_KG_RES" "0.1"
 SYSTEM_CONSTANT "AM_RES" "0.01"
 SYSTEM_CONSTANT "AM_RES_2" "0.1"
 SYSTEM_CONSTANT "AM_RES_FL" "0.01"
 SYSTEM_CONSTANT "ANGLE_CPP_RES" "46603.3777777664"
 SYSTEM_CONSTANT "ANGLE_DER1" "16"
 SYSTEM_CONSTANT "ANGLE_DER1_ZERO" "0"
 SYSTEM_CONSTANT "ANGLE_DER2" "8"
 SYSTEM_CONSTANT "ANGLE_DER2_ZERO" "0"
 SYSTEM_CONSTANT "ANGLE_INDEX_CPP_RES" "1"
 SYSTEM_CONSTANT "ANGLE_RES" "45.5111111111"
 SYSTEM_CONSTANT "ANGLE_RES_1" "32"
 SYSTEM_CONSTANT "ANGLE_RES_FL" "45.5111111111"
 SYSTEM_CONSTANT "ANGLE_STWHL_RES" "0.03125"
 SYSTEM_CONSTANT "ANGLE_STWHL_RES_REV" "32"
 SYSTEM_CONSTANT "ANGLE_ZERO" "0"
 SYSTEM_CONSTANT "AOHT_TAIRUPLI_CUR_X" "25"
 SYSTEM_CONSTANT "APPCD_DUSYNC_CUR_X" "2"
 SYSTEM_CONSTANT "APPCD_RLINAPP1_CUR_X" "2"
 SYSTEM_CONSTANT "APPCD_RLINAPP2_CUR_X" "2"
 SYSTEM_CONSTANT "APPCD_RLINAPP_CUR_X" "2"
 SYSTEM_CONSTANT "APPLY" "4"
 SYSTEM_CONSTANT "APSCD_PCOR_MAP_X" "16"
 SYSTEM_CONSTANT "APSCD_PCOR_MAP_Y" "16"
 SYSTEM_CONSTANT "APSCD_PLIN_CUR_X" "25"
 SYSTEM_CONSTANT "AREA_CM2_MAX" "50"
 SYSTEM_CONSTANT "AREA_CM2_RES" "0.001"
 SYSTEM_CONSTANT "AREA_CM2_RES_FL" "0.001"
 SYSTEM_CONSTANT "AREA_CM2_RES_REV" "1000"
 SYSTEM_CONSTANT "AREA_CM2_ZERO" "0"
 SYSTEM_CONSTANT "AREA_RES_FL" "0.0001220703125"
 SYSTEM_CONSTANT "ASDDC_CONDCLTHGRIP_BP" "4"
 SYSTEM_CONSTANT "ASDDC_CONDEXTINTV_BP" "1"
 SYSTEM_CONSTANT "ASDDC_CONDGEARSWITCH_BP" "128"
 SYSTEM_CONSTANT "ASDDC_CONDGRIP1_BP" "8"
 SYSTEM_CONSTANT "ASDDC_CONDGRIP2_BP" "16"
 SYSTEM_CONSTANT "ASDDC_CONDGRIP3_BP" "32"
 SYSTEM_CONSTANT "ASDDC_CONDGRIP4_BP" "64"
 SYSTEM_CONSTANT "ASDDC_CONDGRIPRAW_BP" "2"
 SYSTEM_CONSTANT "ASDDC_FDT1PARAMMAP_KD_MAP_X" "6"
 SYSTEM_CONSTANT "ASDDC_FDT1PARAMMAP_KD_MAP_Y" "2"
 SYSTEM_CONSTANT "ASDDC_FDT1PARAMMAP_T1_MAP_X" "6"
 SYSTEM_CONSTANT "ASDDC_FDT1PARAMMAP_T1_MAP_Y" "3"
 SYSTEM_CONSTANT "ASDDC_GRIP" "1"
 SYSTEM_CONSTANT "ASDDC_GRIP_MAP_X" "16"
 SYSTEM_CONSTANT "ASDDC_GRIP_MAP_Y" "5"
 SYSTEM_CONSTANT "ASDDC_KD_RES16_REV_FL" "1024"
 SYSTEM_CONSTANT "ASDDC_NENGGOVGRIP_Y_AXISY" "5"
 SYSTEM_CONSTANT "ASDDC_NOGRIP" "0"
 SYSTEM_CONSTANT "ASDDC_NUMST" "5"
 SYSTEM_CONSTANT "ASDDC_RTRA_X_AXISX" "8"
 SYSTEM_CONSTANT "ASDDC_ST0" "1"
 SYSTEM_CONSTANT "ASDDC_ST1" "2"
 SYSTEM_CONSTANT "ASDDC_ST2" "4"
 SYSTEM_CONSTANT "ASDDC_ST3" "8"
 SYSTEM_CONSTANT "ASDDC_ST4" "16"
 SYSTEM_CONSTANT "ASDDC_TIMEDELAY_SLIN16_RES_FL" "0.000152592547379986"
 SYSTEM_CONSTANT "ASDDC_TIME_DT_RES_FL" "1e-006"
 SYSTEM_CONSTANT "ASDDC_TRQ_RES_FL" "0.1"
 SYSTEM_CONSTANT "ASDRF_ANGLE_RES" "0.1"
 SYSTEM_CONSTANT "ASDRF_ANGLE_RES_REV" "10"
 SYSTEM_CONSTANT "ASDRF_COEFA_RES" "0.0048828125"
 SYSTEM_CONSTANT "ASDRF_COEFA_RES_FL" "0.0048828125"
 SYSTEM_CONSTANT "ASDRF_COEFB_MAX_FL" "10000"
 SYSTEM_CONSTANT "ASDRF_COEFB_MIN_FL" "0"
 SYSTEM_CONSTANT "ASDRF_CONDEXTINTV_BP" "1"
 SYSTEM_CONSTANT "ASDRF_CONDGRIP1_BP" "4"
 SYSTEM_CONSTANT "ASDRF_CONDGRIP2_BP" "8"
 SYSTEM_CONSTANT "ASDRF_CONDGRIP3_BP" "16"
 SYSTEM_CONSTANT "ASDRF_CONDGRIP4_BP" "32"
 SYSTEM_CONSTANT "ASDRF_CONDGRIP_BP" "2"
 SYSTEM_CONSTANT "ASDRF_DECOMP_ON" "1"
 SYSTEM_CONSTANT "ASDRF_DTRQINRLTDLIM_CUR_X" "5"
 SYSTEM_CONSTANT "ASDRF_DTRQ_MAX_FL" "2000"
 SYSTEM_CONSTANT "ASDRF_DTRQ_MIN_FL" "-2000"
 SYSTEM_CONSTANT "ASDRF_DTRQ_RES_FL" "0.1"
 SYSTEM_CONSTANT "ASDRF_DTRQ_ZR_FL" "0"
 SYSTEM_CONSTANT "ASDRF_FACDYN_X_AXISX" "11"
 SYSTEM_CONSTANT "ASDRF_FACT1_RES_FL" "0.0078125"
 SYSTEM_CONSTANT "ASDRF_KDLIM_FL" "0.99"
 SYSTEM_CONSTANT "ASDRF_KD_LIN16_RES_FL" "32767"
 SYSTEM_CONSTANT "ASDRF_LADMODEST0" "0"
 SYSTEM_CONSTANT "ASDRF_LADMODEST1" "1"
 SYSTEM_CONSTANT "ASDRF_LADMODEST2" "2"
 SYSTEM_CONSTANT "ASDRF_LADMODEST3" "3"
 SYSTEM_CONSTANT "ASDRF_LADMODEST4" "4"
 SYSTEM_CONSTANT "ASDRF_LIM_HI" "1"
 SYSTEM_CONSTANT "ASDRF_LIM_LO" "0"
 SYSTEM_CONSTANT "ASDRF_NENGFLTGRIPNEG_Y_AXISY" "8"
 SYSTEM_CONSTANT "ASDRF_NENGFLTGRIPPOS_Y_AXISY" "8"
 SYSTEM_CONSTANT "ASDRF_NENGFLTST3NEG_Y_AXISY" "8"
 SYSTEM_CONSTANT "ASDRF_NENGFLTST3POS_Y_AXISY" "8"
 SYSTEM_CONSTANT "ASDRF_NENGLADGRIPNEG_Y_AXISY" "8"
 SYSTEM_CONSTANT "ASDRF_NENGLADGRIPPOS_Y_AXISY" "8"
 SYSTEM_CONSTANT "ASDRF_NENGLADST3NEG_Y_AXISY" "8"
 SYSTEM_CONSTANT "ASDRF_NENGLADST3POS_Y_AXISY" "8"
 SYSTEM_CONSTANT "ASDRF_NUMST" "5"
 SYSTEM_CONSTANT "ASDRF_PARABLEPARAMCUR_COEFA_CUR_X" "6"
 SYSTEM_CONSTANT "ASDRF_PARABLEPARAMCUR_COEFB_CUR_X" "6"
 SYSTEM_CONSTANT "ASDRF_PRIOSTUNDEF" "65535"
 SYSTEM_CONSTANT "ASDRF_RTRA_X_AXISX" "8"
 SYSTEM_CONSTANT "ASDRF_SPDGOV_COR_NEG_BP" "1"
 SYSTEM_CONSTANT "ASDRF_SPDGOV_COR_POS_BP" "0"
 SYSTEM_CONSTANT "ASDRF_ST0" "1"
 SYSTEM_CONSTANT "ASDRF_ST1" "2"
 SYSTEM_CONSTANT "ASDRF_ST2" "4"
 SYSTEM_CONSTANT "ASDRF_ST3" "8"
 SYSTEM_CONSTANT "ASDRF_ST4" "16"
 SYSTEM_CONSTANT "ASDRF_STINIRST_PDT1_MSK" "253"
 SYSTEM_CONSTANT "ASDRF_STINI_PDT1_MSK" "2"
 SYSTEM_CONSTANT "ASDRF_STLADMODE_1" "1"
 SYSTEM_CONSTANT "ASDRF_STLADMODE_2" "2"
 SYSTEM_CONSTANT "ASDRF_STLADMODE_OFF" "0"
 SYSTEM_CONSTANT "ASDRF_STLADNEG_ABOVE" "32"
 SYSTEM_CONSTANT "ASDRF_STLADNEG_ALLBIT" "240"
 SYSTEM_CONSTANT "ASDRF_STLADNEG_BELOW" "16"
 SYSTEM_CONSTANT "ASDRF_STLADNEG_INACTIVE" "64"
 SYSTEM_CONSTANT "ASDRF_STLADNEG_LIMIT" "48"
 SYSTEM_CONSTANT "ASDRF_STLADPOS_ABOVE" "2"
 SYSTEM_CONSTANT "ASDRF_STLADPOS_ALLBIT" "15"
 SYSTEM_CONSTANT "ASDRF_STLADPOS_BELOW" "1"
 SYSTEM_CONSTANT "ASDRF_STLADPOS_INACTIVE" "4"
 SYSTEM_CONSTANT "ASDRF_STLADPOS_LIMIT" "3"
 SYSTEM_CONSTANT "ASDRF_SWTCALCTRQ_0" "0"
 SYSTEM_CONSTANT "ASDRF_SWTCALCTRQ_1" "1"
 SYSTEM_CONSTANT "ASDRF_SWTCALCTRQ_2" "2"
 SYSTEM_CONSTANT "ASDRF_SWTCALCTRQ_3" "3"
 SYSTEM_CONSTANT "ASDRF_TIMEDELAY_SLIN16_RES_FL" "0.000152592547379986"
 SYSTEM_CONSTANT "ASDRF_TIME_DT_RES_FL" "1e-006"
 SYSTEM_CONSTANT "ASDRF_TRQABS" "0"
 SYSTEM_CONSTANT "ASDRF_TRQADAP" "1"
 SYSTEM_CONSTANT "ASDRF_TRQCLTHMIN" "2"
 SYSTEM_CONSTANT "ASDRF_TRQLOSNEG_CUR_X" "6"
 SYSTEM_CONSTANT "ASDRF_TRQLOSPOS_CUR_X" "6"
 SYSTEM_CONSTANT "ASDRF_TRQLOS_MAPX" "16"
 SYSTEM_CONSTANT "ASDRF_TRQLOS_MAPY" "5"
 SYSTEM_CONSTANT "ASDRF_TRQOFSLOS_CURX" "16"
 SYSTEM_CONSTANT "ASDRF_TRQ_MAXSINT16_FL" "3276.7"
 SYSTEM_CONSTANT "ASDRF_TRQ_MAX_FL" "1000"
 SYSTEM_CONSTANT "ASDRF_TRQ_MINSINT16_FL" "-3276.8"
 SYSTEM_CONSTANT "ASDRF_TRQ_MIN_FL" "-500"
 SYSTEM_CONSTANT "ASDRF_TRQ_RES_FL" "0.1"
 SYSTEM_CONSTANT "ASDRF_TRQ_ZR_FL" "0"
 SYSTEM_CONSTANT "ASDRF_XDT1PARAMCUR_KD_CUR_X" "6"
 SYSTEM_CONSTANT "ASDRF_XDT1PARAMCUR_T1_CUR_X" "6"
 SYSTEM_CONSTANT "ASDRF_ZR_FL" "0"
 SYSTEM_CONSTANT "ASD_AND_MSK" "1"
 SYSTEM_CONSTANT "ASD_CONDBITS" "2"
 SYSTEM_CONSTANT "ASD_CONDFALSE" "0"
 SYSTEM_CONSTANT "ASD_CONDTRUE" "3"
 SYSTEM_CONSTANT "ASD_COND_MSK" "3"
 SYSTEM_CONSTANT "ASD_MAXNUMST" "8"
 SYSTEM_CONSTANT "ASD_NAND_MSK" "2"
 SYSTEM_CONSTANT "ASD_NOR_MSK" "3"
 SYSTEM_CONSTANT "ASD_OR_MSK" "0"
 SYSTEM_CONSTANT "ASHMPTEG_RES" "0.0005"
 SYSTEM_CONSTANT "ASHMPT_RES" "0.01"
 SYSTEM_CONSTANT "ASHMSGP0Q1_RES" "0.1"
 SYSTEM_CONSTANT "ASHMSMGP0Q0016_RES" "0.0016"
 SYSTEM_CONSTANT "ASMOD_ACCURACY_FACT1" "1000"
 SYSTEM_CONSTANT "ASMOD_ACCURACY_FACT2" "10"
 SYSTEM_CONSTANT "ASMOD_AREFFEGRLP_CUR_X" "12"
 SYSTEM_CONSTANT "ASMOD_AREFFEGRLP_MAX_FL" "50"
 SYSTEM_CONSTANT "ASMOD_AREFFEGRLP_MIN_FL" "0"
 SYSTEM_CONSTANT "ASMOD_AREFFEGRVLV_CUR_X" "8"
 SYSTEM_CONSTANT "ASMOD_AREFFEGR_CUR_X" "12"
 SYSTEM_CONSTANT "ASMOD_AREFFEGR_MAX_FL" "720"
 SYSTEM_CONSTANT "ASMOD_AREFFEGR_MIN_FL" "0"
 SYSTEM_CONSTANT "ASMOD_AREFFEXHFLPLP_CUR_X" "10"
 SYSTEM_CONSTANT "ASMOD_AREFFHPTRBNCTLFLP_CUR_X" "4"
 SYSTEM_CONSTANT "ASMOD_AREFFLPTRBNBLWBY_CUR_X" "8"
 SYSTEM_CONSTANT "ASMOD_AREFFTVA_CUR_X" "10"
 SYSTEM_CONSTANT "ASMOD_AREFF_LONG_MAX_FL" "100"
 SYSTEM_CONSTANT "ASMOD_AREFF_LONG_MIN_FL" "0"
 SYSTEM_CONSTANT "ASMOD_AREFF_MAX" "32"
 SYSTEM_CONSTANT "ASMOD_AREFF_MAX_FL" "32"
 SYSTEM_CONSTANT "ASMOD_AREFF_MIN" "0"
 SYSTEM_CONSTANT "ASMOD_AREFF_MIN_FL" "0"
 SYSTEM_CONSTANT "ASMOD_AREXCHNSCBRICK_MAX" "1"
 SYSTEM_CONSTANT "ASMOD_AREXCHNSCBRICK_MIN" "0"
 SYSTEM_CONSTANT "ASMOD_AROXIC_MAX" "4"
 SYSTEM_CONSTANT "ASMOD_AROXIC_MIN" "0"
 SYSTEM_CONSTANT "ASMOD_CNDHTOFS_MAX" "0.01"
 SYSTEM_CONSTANT "ASMOD_CNDHTOFS_MIN" "0.001"
 SYSTEM_CONSTANT "ASMOD_CNDHT_RES" "122070.3125"
 SYSTEM_CONSTANT "ASMOD_CPEGNSC_MAX" "65534"
 SYSTEM_CONSTANT "ASMOD_CPEGNSC_MIN" "0"
 SYSTEM_CONSTANT "ASMOD_CPGAS_MAX" "2"
 SYSTEM_CONSTANT "ASMOD_CPGAS_MIN" "0"
 SYSTEM_CONSTANT "ASMOD_CPNSCBRICK_CUR_X" "2"
 SYSTEM_CONSTANT "ASMOD_CPNSCBRICK_MAX" "1500"
 SYSTEM_CONSTANT "ASMOD_CPNSCBRICK_MIN" "500"
 SYSTEM_CONSTANT "ASMOD_CPOXIC_MAX" "3000"
 SYSTEM_CONSTANT "ASMOD_CPOXIC_MIN" "0.1"
 SYSTEM_CONSTANT "ASMOD_CPPFLT_MAX" "10000"
 SYSTEM_CONSTANT "ASMOD_CPPFLT_MIN" "200"
 SYSTEM_CONSTANT "ASMOD_CPPIPE_MAX" "3000"
 SYSTEM_CONSTANT "ASMOD_CPPIPE_MIN" "0.1"
 SYSTEM_CONSTANT "ASMOD_CT_PIPE" "3"
 SYSTEM_CONSTANT "ASMOD_CT_PIPESLW" "4"
 SYSTEM_CONSTANT "ASMOD_CT_PIPESLW_MAX" "4"
 SYSTEM_CONSTANT "ASMOD_CT_PIPE_MAX" "4"
 SYSTEM_CONSTANT "ASMOD_DELAYFLD_SY" "10"
 SYSTEM_CONSTANT "ASMOD_DELAY_ARRSIZE" "16"
 SYSTEM_CONSTANT "ASMOD_DMAIRCONV" "360"
 SYSTEM_CONSTANT "ASMOD_DMAIRDESREF_MAP_X" "16"
 SYSTEM_CONSTANT "ASMOD_DMAIRDESREF_MAP_Y" "16"
 SYSTEM_CONSTANT "ASMOD_DMAIRDESREF_MAX" "1400"
 SYSTEM_CONSTANT "ASMOD_DMAIRDESREF_MIN" "0"
 SYSTEM_CONSTANT "ASMOD_DMASHEG_CUR_X" "8"
 SYSTEM_CONSTANT "ASMOD_DMASHEG_MAX" "16"
 SYSTEM_CONSTANT "ASMOD_DMASHEG_MIN" "0"
 SYSTEM_CONSTANT "ASMOD_DMCMPRUS_MAX_FL" "1400"
 SYSTEM_CONSTANT "ASMOD_DMCMPRUS_MIN_FL" "0"
 SYSTEM_CONSTANT "ASMOD_DMCOBASLM_MAP_X" "2"
 SYSTEM_CONSTANT "ASMOD_DMCOBASLM_MAP_Y" "2"
 SYSTEM_CONSTANT "ASMOD_DMCOBASPHC_MAP_X" "2"
 SYSTEM_CONSTANT "ASMOD_DMCOBASPHC_MAP_Y" "2"
 SYSTEM_CONSTANT "ASMOD_DMCOBASRM_MAP_X" "2"
 SYSTEM_CONSTANT "ASMOD_DMCOBASRM_MAP_Y" "2"
 SYSTEM_CONSTANT "ASMOD_DMCO_MAX" "1638.35"
 SYSTEM_CONSTANT "ASMOD_DMCO_MIN" "0"
 SYSTEM_CONSTANT "ASMOD_DMDESBAS_RES" "66666.6666666667"
 SYSTEM_CONSTANT "ASMOD_DMEGCRVIN_MAX" "1500"
 SYSTEM_CONSTANT "ASMOD_DMEGCRVIN_MIN" "0"
 SYSTEM_CONSTANT "ASMOD_DMEGFLD_MAX" "320"
 SYSTEM_CONSTANT "ASMOD_DMEGFLD_MIN" "-120"
 SYSTEM_CONSTANT "ASMOD_DMEGRDS_MAX_FL" "700"
 SYSTEM_CONSTANT "ASMOD_DMEGRDS_MIN_FL" "-700"
 SYSTEM_CONSTANT "ASMOD_DMEGRINTMNFDS_MAX_FL" "720"
 SYSTEM_CONSTANT "ASMOD_DMEGRINTMNFDS_MIN_FL" "0"
 SYSTEM_CONSTANT "ASMOD_DMEGRINTMNF_MAX_FL" "180"
 SYSTEM_CONSTANT "ASMOD_DMEGRINTMNF_MIN_FL" "-180"
 SYSTEM_CONSTANT "ASMOD_DMEGRLPDS_MAX_FL" "700"
 SYSTEM_CONSTANT "ASMOD_DMEGRLPDS_MIN_FL" "-700"
 SYSTEM_CONSTANT "ASMOD_DMEXHMNFDSRED_MAX_FL" "1500"
 SYSTEM_CONSTANT "ASMOD_DMEXHMNFDSRED_MIN_FL" "0"
 SYSTEM_CONSTANT "ASMOD_DMEXHMNFDS_MAX" "1400"
 SYSTEM_CONSTANT "ASMOD_DMEXHMNFDS_MAX_FL" "1400"
 SYSTEM_CONSTANT "ASMOD_DMEXHMNFDS_MIN" "0"
 SYSTEM_CONSTANT "ASMOD_DMEXHMNFDS_MIN_FL" "0"
 SYSTEM_CONSTANT "ASMOD_DMEXHMNFLPDS_MAX_FL" "1400"
 SYSTEM_CONSTANT "ASMOD_DMEXHMNFLPDS_MIN_FL" "0"
 SYSTEM_CONSTANT "ASMOD_DMFUELBURNED_RES" "6896.55172413793"
 SYSTEM_CONSTANT "ASMOD_DMFUEL_RES" "66666.6666666667"
 SYSTEM_CONSTANT "ASMOD_DMINDVOL_MAX_FL" "360"
 SYSTEM_CONSTANT "ASMOD_DMINDVOL_MIN_FL" "-360"
 SYSTEM_CONSTANT "ASMOD_DMIND_RES" "100"
 SYSTEM_CONSTANT "ASMOD_DMINTMNFDSREF_MAP_X" "8"
 SYSTEM_CONSTANT "ASMOD_DMINTMNFDSREF_MAP_Y" "8"
 SYSTEM_CONSTANT "ASMOD_DMINTMNFDSREF_MAX" "1400"
 SYSTEM_CONSTANT "ASMOD_DMINTMNFDSREF_MIN" "0"
 SYSTEM_CONSTANT "ASMOD_DMINTMNFDS_MAX_FL" "1400"
 SYSTEM_CONSTANT "ASMOD_DMINTMNFDS_MIN_FL" "0"
 SYSTEM_CONSTANT "ASMOD_DMINTMNFUS_MAX_FL" "1400"
 SYSTEM_CONSTANT "ASMOD_DMINTMNFUS_MIN_FL" "0"
 SYSTEM_CONSTANT "ASMOD_DMINTMNF_MAX_FL" "360"
 SYSTEM_CONSTANT "ASMOD_DMINTMNF_MIN_FL" "-360"
 SYSTEM_CONSTANT "ASMOD_DMMSAIRDVT_MAX" "100"
 SYSTEM_CONSTANT "ASMOD_DMMSAIRDVT_MIN" "-100"
 SYSTEM_CONSTANT "ASMOD_DMNOXBASLM_MAP_X" "10"
 SYSTEM_CONSTANT "ASMOD_DMNOXBASLM_MAP_Y" "10"
 SYSTEM_CONSTANT "ASMOD_DMNOXBASPHC_MAP_X" "2"
 SYSTEM_CONSTANT "ASMOD_DMNOXBASPHC_MAP_Y" "2"
 SYSTEM_CONSTANT "ASMOD_DMNOXBASRM_MAP_X" "8"
 SYSTEM_CONSTANT "ASMOD_DMNOXBASRM_MAP_Y" "8"
 SYSTEM_CONSTANT "ASMOD_DMNOXEGROFF_MAP_X" "10"
 SYSTEM_CONSTANT "ASMOD_DMNOXEGROFF_MAP_Y" "10"
 SYSTEM_CONSTANT "ASMOD_DMNOX_MAX" "1000"
 SYSTEM_CONSTANT "ASMOD_DMNOX_MIN" "0"
 SYSTEM_CONSTANT "ASMOD_DMNSCUS_MAX" "100"
 SYSTEM_CONSTANT "ASMOD_DMNSCUS_MIN" "0"
 SYSTEM_CONSTANT "ASMOD_DMO2INTMNF_MAX_FL" "80"
 SYSTEM_CONSTANT "ASMOD_DMO2INTMNF_MIN_FL" "-80"
 SYSTEM_CONSTANT "ASMOD_DMO2_RES" "10000"
 SYSTEM_CONSTANT "ASMOD_DMOILCONSBAS_CUR_X" "8"
 SYSTEM_CONSTANT "ASMOD_DMOILCONSBAS_MAX" "1"
 SYSTEM_CONSTANT "ASMOD_DMOILCONSBAS_MIN" "0"
 SYSTEM_CONSTANT "ASMOD_DMOILCONS_MAX" "7"
 SYSTEM_CONSTANT "ASMOD_DMOILCONS_MIN" "0"
 SYSTEM_CONSTANT "ASMOD_DMPFLTUS_MAX" "1000"
 SYSTEM_CONSTANT "ASMOD_DMPFLTUS_MIN" "-1000"
 SYSTEM_CONSTANT "ASMOD_DMSOTBASLM_MAP_X" "8"
 SYSTEM_CONSTANT "ASMOD_DMSOTBASLM_MAP_Y" "8"
 SYSTEM_CONSTANT "ASMOD_DMSOTBASPHC_MAP_X" "2"
 SYSTEM_CONSTANT "ASMOD_DMSotBASPHC_MAP_X" "6"
 SYSTEM_CONSTANT "ASMOD_DMSOTBASPHC_MAP_Y" "2"
 SYSTEM_CONSTANT "ASMOD_DMSotBASPHC_MAP_Y" "6"
 SYSTEM_CONSTANT "ASMOD_DMSOTBASRM_MAP_X" "8"
 SYSTEM_CONSTANT "ASMOD_DMSOTBASRM_MAP_Y" "8"
 SYSTEM_CONSTANT "ASMOD_DMSOTDYNRM_MAP_X" "8"
 SYSTEM_CONSTANT "ASMOD_DMSOTDYNRM_MAP_Y" "8"
 SYSTEM_CONSTANT "ASMOD_DMSOTLAMCOR_MAP_X" "8"
 SYSTEM_CONSTANT "ASMOD_DMSOTLAMCOR_MAP_Y" "8"
 SYSTEM_CONSTANT "ASMOD_DMSOTRATEGRCORBAS_MAP_X" "8"
 SYSTEM_CONSTANT "ASMOD_DMSOTRATEGRCORBAS_MAP_Y" "8"
 SYSTEM_CONSTANT "ASMOD_DMSOT_MAX" "327.67"
 SYSTEM_CONSTANT "ASMOD_DMSOT_MIN" "0"
 SYSTEM_CONSTANT "ASMOD_DMSOXOIL_CUR_X" "2"
 SYSTEM_CONSTANT "ASMOD_DMSOXOIL_MAX" "0.5"
 SYSTEM_CONSTANT "ASMOD_DMSOXOIL_MIN" "0"
 SYSTEM_CONSTANT "ASMOD_DMSOXREDMSFLWEGCRVIN_MAX" "450"
 SYSTEM_CONSTANT "ASMOD_DMSOXREDMSFLWEGCRVIN_MIN" "0"
 SYSTEM_CONSTANT "ASMOD_DM_MAX" "1000"
 SYSTEM_CONSTANT "ASMOD_DM_MIN" "0"
 SYSTEM_CONSTANT "ASMOD_DRLAMRECMIN_MAX" "100"
 SYSTEM_CONSTANT "ASMOD_DRLAMRECMIN_MIN" "-100"
 SYSTEM_CONSTANT "ASMOD_DT1KDLAMSOT_MAX" "50"
 SYSTEM_CONSTANT "ASMOD_DT1KDLAMSOT_MIN" "-50"
 SYSTEM_CONSTANT "ASMOD_DT1T1LAMSOT_MAX" "10"
 SYSTEM_CONSTANT "ASMOD_DT1T1LAMSOT_MIN" "0.001"
 SYSTEM_CONSTANT "ASMOD_DVOLEGPIPE_MAX" "3200"
 SYSTEM_CONSTANT "ASMOD_DVOLEGPIPE_MIN" "0"
 SYSTEM_CONSTANT "ASMOD_DVOLFLCONS_MAX" "40"
 SYSTEM_CONSTANT "ASMOD_DVOLFLCONS_MIN" "0"
 SYSTEM_CONSTANT "ASMOD_DVOLPFLTEG_RES" "347.826086956522"
 SYSTEM_CONSTANT "ASMOD_DWENVOXICDFL_MAX" "10"
 SYSTEM_CONSTANT "ASMOD_DWENVOXICDFL_MIN" "0"
 SYSTEM_CONSTANT "ASMOD_DWEXODSOXNSCBRICK_MAP_X" "2"
 SYSTEM_CONSTANT "ASMOD_DWEXODSOXNSCBRICK_MAP_Y" "2"
 SYSTEM_CONSTANT "ASMOD_DWEXODSOXNSCBRICK_MAX" "65534"
 SYSTEM_CONSTANT "ASMOD_DWEXODSOXNSCBRICK_MAX_FL" "65534"
 SYSTEM_CONSTANT "ASMOD_DWEXODSOXNSCBRICK_MIN" "0"
 SYSTEM_CONSTANT "ASMOD_DWEXODSOXNSCBRICK_MIN_FL" "0"
 SYSTEM_CONSTANT "ASMOD_DWEXOLEANNSCBRICK_MAX" "65534"
 SYSTEM_CONSTANT "ASMOD_DWEXOLEANNSCBRICK_MIN" "0"
 SYSTEM_CONSTANT "ASMOD_DWEXONSCBRICKIN_MAX" "5000"
 SYSTEM_CONSTANT "ASMOD_DWEXONSCBRICKIN_MIN" "0"
 SYSTEM_CONSTANT "ASMOD_DWEXONSCBRICK_MAX" "65534"
 SYSTEM_CONSTANT "ASMOD_DWEXONSCBRICK_MIN" "0"
 SYSTEM_CONSTANT "ASMOD_DWEXORICHNSCBRICK_MAP_X" "2"
 SYSTEM_CONSTANT "ASMOD_DWEXORICHNSCBRICK_MAP_Y" "2"
 SYSTEM_CONSTANT "ASMOD_DWEXORICHNSCBRICK_MAX" "65534"
 SYSTEM_CONSTANT "ASMOD_DWEXORICHNSCBRICK_MAX_FL" "65534"
 SYSTEM_CONSTANT "ASMOD_DWEXORICHNSCBRICK_MIN" "0"
 SYSTEM_CONSTANT "ASMOD_DWEXORICHNSCBRICK_MIN_FL" "0"
 SYSTEM_CONSTANT "ASMOD_ENERGYPERMOL2TEMP" "10000000"
 SYSTEM_CONSTANT "ASMOD_ENGN_VOLEFF" "1000"
 SYSTEM_CONSTANT "ASMOD_ENG_FACTOR3" "20000"
 SYSTEM_CONSTANT "ASMOD_ENG_FACTOR4" "100"
 SYSTEM_CONSTANT "ASMOD_ETACMPR_MAP_X" "16"
 SYSTEM_CONSTANT "ASMOD_ETACMPR_MAP_Y" "16"
 SYSTEM_CONSTANT "ASMOD_ETAEGRCLGLP1_MAX_FL" "1"
 SYSTEM_CONSTANT "ASMOD_ETAEGRCLGLP1_MIN_FL" "0"
 SYSTEM_CONSTANT "ASMOD_ETAEGRCLGLP2_MAX_FL" "700"
 SYSTEM_CONSTANT "ASMOD_ETAEGRCLGLP2_MIN_FL" "-700"
 SYSTEM_CONSTANT "ASMOD_ETAEGRCLGLP3_MAX_FL" "100"
 SYSTEM_CONSTANT "ASMOD_ETAEGRCLGLP3_MIN_FL" "0"
 SYSTEM_CONSTANT "ASMOD_ETAEGRCLGLP_MAP_X" "6"
 SYSTEM_CONSTANT "ASMOD_ETAEGRCLGLP_MAP_Y" "3"
 SYSTEM_CONSTANT "ASMOD_ETAEGRCLGLP_MAX_FL" "800"
 SYSTEM_CONSTANT "ASMOD_ETAEGRCLGLP_MIN_FL" "0"
 SYSTEM_CONSTANT "ASMOD_ETAEGRCLG_CUR_X" "6"
 SYSTEM_CONSTANT "ASMOD_ETAEGRCLG_MAP_X" "6"
 SYSTEM_CONSTANT "ASMOD_ETAEGRCLG_MAP_Y" "3"
 SYSTEM_CONSTANT "ASMOD_ETAEGRCLG_MAX_FL" "1"
 SYSTEM_CONSTANT "ASMOD_ETAEGRCLG_MIN_FL" "0"
 SYSTEM_CONSTANT "ASMOD_ETAEGRLPCLG_CUR_X" "6"
 SYSTEM_CONSTANT "ASMOD_ETAHPCMPR_MAP_X" "16"
 SYSTEM_CONSTANT "ASMOD_ETAHPCMPR_MAP_Y" "16"
 SYSTEM_CONSTANT "ASMOD_ETAHPTRBN_CUR_X" "8"
 SYSTEM_CONSTANT "ASMOD_ETALPCMPR_MAP_X" "16"
 SYSTEM_CONSTANT "ASMOD_ETALPCMPR_MAP_Y" "16"
 SYSTEM_CONSTANT "ASMOD_ETALPTRBN_CUR_X" "8"
 SYSTEM_CONSTANT "ASMOD_ETATRBCH_MAP_X" "8"
 SYSTEM_CONSTANT "ASMOD_ETATRBCH_MAP_Y" "8"
 SYSTEM_CONSTANT "ASMOD_ETATRBCH_MAX" "1"
 SYSTEM_CONSTANT "ASMOD_ETATRBCH_MIN" "0.0001"
 SYSTEM_CONSTANT "ASMOD_ETATRBN_CUR_X" "8"
 SYSTEM_CONSTANT "ASMOD_ETATRBN_MAP_X" "8"
 SYSTEM_CONSTANT "ASMOD_ETATRBN_MAP_Y" "8"
 SYSTEM_CONSTANT "ASMOD_ETATRBN_MAX_FL" "1"
 SYSTEM_CONSTANT "ASMOD_ETATRBN_MIN_FL" "0"
 SYSTEM_CONSTANT "ASMOD_EXHMASS_MAX" "500"
 SYSTEM_CONSTANT "ASMOD_EXHMASS_MIN" "0"
 SYSTEM_CONSTANT "ASMOD_FACAMCOR_RES" "122.0703125"
 SYSTEM_CONSTANT "ASMOD_FACBRICKOXIC_MAX" "0.9"
 SYSTEM_CONSTANT "ASMOD_FACBRICKOXIC_MIN" "0.1"
 SYSTEM_CONSTANT "ASMOD_FACCALVALFL_MAX" "50000"
 SYSTEM_CONSTANT "ASMOD_FACCALVALFL_MIN" "0"
 SYSTEM_CONSTANT "ASMOD_FACCNDHTSLP_MAX" "8e-005"
 SYSTEM_CONSTANT "ASMOD_FACCNDHTSLP_MIN" "6e-005"
 SYSTEM_CONSTANT "ASMOD_FACCNVTEGNSCCOR_MAX" "2.55"
 SYSTEM_CONSTANT "ASMOD_FACCNVTEGNSCCOR_MIN" "0"
 SYSTEM_CONSTANT "ASMOD_FACCNVTEGNSC_MAX" "6000"
 SYSTEM_CONSTANT "ASMOD_FACCNVTEGNSC_MIN" "100"
 SYSTEM_CONSTANT "ASMOD_FACCOCLNTTEMPCOR_CUR_X" "2"
 SYSTEM_CONSTANT "ASMOD_FACCOCLNTTEMPCOR_MAX" "1"
 SYSTEM_CONSTANT "ASMOD_FACCOCLNTTEMPCOR_MIN" "0"
 SYSTEM_CONSTANT "ASMOD_FACDDT_MAX" "8"
 SYSTEM_CONSTANT "ASMOD_FACDDT_MIN" "1"
 SYSTEM_CONSTANT "ASMOD_FACEGRCLGETACOR_CUR_X" "10"
 SYSTEM_CONSTANT "ASMOD_FACEGRDVTCORMAX" "2"
 SYSTEM_CONSTANT "ASMOD_FACEGRDVTCORMAX_MIN" "0"
 SYSTEM_CONSTANT "ASMOD_FACEGRDVTCORMIN" "-2"
 SYSTEM_CONSTANT "ASMOD_FACEGRDVTCORMIN_MAX" "2"
 SYSTEM_CONSTANT "ASMOD_FACEGRDVTPOP_MAP_X" "10"
 SYSTEM_CONSTANT "ASMOD_FACEGRDVTPOP_MAP_Y" "10"
 SYSTEM_CONSTANT "ASMOD_FACEGRDVTPOP_MAX" "10"
 SYSTEM_CONSTANT "ASMOD_FACEGRDVTPOP_MIN" "-10"
 SYSTEM_CONSTANT "ASMOD_FACEGRDVTWGH1_CUR_X" "16"
 SYSTEM_CONSTANT "ASMOD_FACEGRDVTWGH2_CUR_X" "16"
 SYSTEM_CONSTANT "ASMOD_FACEGRDVTWGH_MAX" "1"
 SYSTEM_CONSTANT "ASMOD_FACEGRDVTWGH_MIN" "-1"
 SYSTEM_CONSTANT "ASMOD_FACEGRLPCLGETACOR_CUR_X" "10"
 SYSTEM_CONSTANT "ASMOD_FACEGTEMPMSFLWCOR_CUR_X" "8"
 SYSTEM_CONSTANT "ASMOD_FACEGTEMPMSFLWCOR_MAX" "2"
 SYSTEM_CONSTANT "ASMOD_FACEGTEMPMSFLWCOR_MIN" "0"
 SYSTEM_CONSTANT "ASMOD_FACEGTEMPSOICOR_CUR_X" "8"
 SYSTEM_CONSTANT "ASMOD_FACEGTEMPSOICOR_MAX" "2"
 SYSTEM_CONSTANT "ASMOD_FACEGTEMPSOICOR_MIN" "0"
 SYSTEM_CONSTANT "ASMOD_FACENVPRESCMPR_CUR_X" "6"
 SYSTEM_CONSTANT "ASMOD_FACEXOEG_CUR_X" "11"
 SYSTEM_CONSTANT "ASMOD_FACEXOEG_MAX" "0.1"
 SYSTEM_CONSTANT "ASMOD_FACEXOEG_MIN" "0"
 SYSTEM_CONSTANT "ASMOD_FACEXOGN_MAX" "0.1"
 SYSTEM_CONSTANT "ASMOD_FACEXOGN_MIN" "0"
 SYSTEM_CONSTANT "ASMOD_FACEXPOCALC_CUR_X" "11"
 SYSTEM_CONSTANT "ASMOD_FACEXPOCALC_MAX" "0.003"
 SYSTEM_CONSTANT "ASMOD_FACEXPOCALC_MIN" "0"
 SYSTEM_CONSTANT "ASMOD_FACEXPOENRG_MAX" "-1"
 SYSTEM_CONSTANT "ASMOD_FACEXPOENRG_MIN" "-69"
 SYSTEM_CONSTANT "ASMOD_FACGEOEGPIPE_MAX" "100"
 SYSTEM_CONSTANT "ASMOD_FACGEOEGPIPE_MIN" "0"
 SYSTEM_CONSTANT "ASMOD_FACHCCNVOXIC_MAP_X" "8"
 SYSTEM_CONSTANT "ASMOD_FACHCCNVOXIC_MAP_Y" "8"
 SYSTEM_CONSTANT "ASMOD_FACHCCNVOXIC_MAX" "2"
 SYSTEM_CONSTANT "ASMOD_FACHCCNVOXIC_MIN" "0"
 SYSTEM_CONSTANT "ASMOD_FACHTTRANSNOLIN_CUR_X" "8"
 SYSTEM_CONSTANT "ASMOD_FACINTMNFDSTEMPCOR_MAX" "2"
 SYSTEM_CONSTANT "ASMOD_FACINTMNFDSTEMPCOR_MIN" "0"
 SYSTEM_CONSTANT "ASMOD_FACINTMNFTEMPMSFLWCOR_MAP_X" "8"
 SYSTEM_CONSTANT "ASMOD_FACINTMNFTEMPMSFLWCOR_MAP_Y" "8"
 SYSTEM_CONSTANT "ASMOD_FACINTMNFTEMPMSFLWCOR_MAX_FL" "1"
 SYSTEM_CONSTANT "ASMOD_FACINTMNFTEMPMSFLWCOR_MIN_FL" "-1"
 SYSTEM_CONSTANT "ASMOD_FACKINCONSTCOOXI_MAX" "100000"
 SYSTEM_CONSTANT "ASMOD_FACKINCONSTCOOXI_MIN" "10000"
 SYSTEM_CONSTANT "ASMOD_FACLAMRECREF_MAX" "1"
 SYSTEM_CONSTANT "ASMOD_FACLAMRECREF_MIN" "0"
 SYSTEM_CONSTANT "ASMOD_FACLEANNOXOXIC_MAP_X" "8"
 SYSTEM_CONSTANT "ASMOD_FACLEANNOXOXIC_MAP_Y" "8"
 SYSTEM_CONSTANT "ASMOD_FACLEANNOXOXIC_MAX" "2"
 SYSTEM_CONSTANT "ASMOD_FACLEANNOXOXIC_MIN" "0"
 SYSTEM_CONSTANT "ASMOD_FACLEANNOXPFLT_MAP_X" "8"
 SYSTEM_CONSTANT "ASMOD_FACLEANNOXPFLT_MAP_Y" "8"
 SYSTEM_CONSTANT "ASMOD_FACLEANNOXPFLT_MAX" "2"
 SYSTEM_CONSTANT "ASMOD_FACLEANNOXPFLT_MIN" "0"
 SYSTEM_CONSTANT "ASMOD_FACMFLEGSPECHTCOR_CUR_X" "8"
 SYSTEM_CONSTANT "ASMOD_FACMFLEGSPECHTCOR_MAX" "30"
 SYSTEM_CONSTANT "ASMOD_FACMFLEGSPECHTCOR_MIN" "5"
 SYSTEM_CONSTANT "ASMOD_FACMFLNOXLFTCOR_CUR_X" "8"
 SYSTEM_CONSTANT "ASMOD_FACMFLNOXLFTCOR_MAX" "10"
 SYSTEM_CONSTANT "ASMOD_FACMFLNOXLFTCOR_MIN" "-10"
 SYSTEM_CONSTANT "ASMOD_FACMSAIRDVTPOPCOR_MAP_X" "8"
 SYSTEM_CONSTANT "ASMOD_FACMSAIRDVTPOPCOR_MAP_Y" "8"
 SYSTEM_CONSTANT "ASMOD_FACMSAIRDVTPOPCOR_MAX" "2"
 SYSTEM_CONSTANT "ASMOD_FACMSAIRDVTPOPCOR_MIN" "-2"
 SYSTEM_CONSTANT "ASMOD_FACMSFLWTEMPCOR_MAX_FL" "2"
 SYSTEM_CONSTANT "ASMOD_FACMSFLWTEMPCOR_MIN_FL" "0"
 SYSTEM_CONSTANT "ASMOD_FACNOXCLNTTEMPCORBAS_MAP_X" "6"
 SYSTEM_CONSTANT "ASMOD_FACNOXCLNTTEMPCORBAS_MAP_Y" "6"
 SYSTEM_CONSTANT "ASMOD_FACNOXCLNTTEMPCOR_CUR_X" "8"
 SYSTEM_CONSTANT "ASMOD_FACNOXCLNT_MAX" "3"
 SYSTEM_CONSTANT "ASMOD_FACNOXCLNT_MIN" "0"
 SYSTEM_CONSTANT "ASMOD_FACNOXENGCHCOR_CUR_X" "8"
 SYSTEM_CONSTANT "ASMOD_FACNOXENG_MAX" "10"
 SYSTEM_CONSTANT "ASMOD_FACNOXENG_MIN" "-10"
 SYSTEM_CONSTANT "ASMOD_FACNOXEPCOR_CUR_X" "8"
 SYSTEM_CONSTANT "ASMOD_FACNOXEPCOR_MAX" "2"
 SYSTEM_CONSTANT "ASMOD_FACNOXEPCOR_MIN" "-3"
 SYSTEM_CONSTANT "ASMOD_FACNOXEPPOPCOR_MAP_X" "8"
 SYSTEM_CONSTANT "ASMOD_FACNOXEPPOPCOR_MAP_Y" "8"
 SYSTEM_CONSTANT "ASMOD_FACNOXEPPOPCOR_MAX" "2"
 SYSTEM_CONSTANT "ASMOD_FACNOXEPPOPCOR_MIN" "-3"
 SYSTEM_CONSTANT "ASMOD_FACNOXMSAIRDVT_CUR_X" "8"
 SYSTEM_CONSTANT "ASMOD_FACNOXMSAIRDVT_MAX" "5"
 SYSTEM_CONSTANT "ASMOD_FACNOXMSAIRDVT_MIN" "-5"
 SYSTEM_CONSTANT "ASMOD_FACOILCONSLFTCOR_CUR_X" "16"
 SYSTEM_CONSTANT "ASMOD_FACOILCONSLFTCOR_MAX" "3"
 SYSTEM_CONSTANT "ASMOD_FACOILCONSLFTCOR_MIN" "0"
 SYSTEM_CONSTANT "ASMOD_FACPOWEGPIPE_CUR_X" "11"
 SYSTEM_CONSTANT "ASMOD_FACPOWEGPIPE_MAX" "250"
 SYSTEM_CONSTANT "ASMOD_FACPOWEGPIPE_MIN" "0"
 SYSTEM_CONSTANT "ASMOD_FACPRESEGRLP_MAX_FL" "0.3"
 SYSTEM_CONSTANT "ASMOD_FACPRESEGRLP_MIN_FL" "0"
 SYSTEM_CONSTANT "ASMOD_FACPRESLSEGRCLGLP_CUR_X" "3"
 SYSTEM_CONSTANT "ASMOD_FACPRESLSEGRCLG_CUR_X" "3"
 SYSTEM_CONSTANT "ASMOD_FACPRESLS_MAX_FL" "0.3"
 SYSTEM_CONSTANT "ASMOD_FACPRESLS_MIN_FL" "0"
 SYSTEM_CONSTANT "ASMOD_FACPRSTNSC_MAX" "0.9"
 SYSTEM_CONSTANT "ASMOD_FACPRSTNSC_MIN" "0.5"
 SYSTEM_CONSTANT "ASMOD_FACRECOR_CUR_X" "11"
 SYSTEM_CONSTANT "ASMOD_FACRECOR_MAX" "16383.5"
 SYSTEM_CONSTANT "ASMOD_FACRECOR_MIN" "100"
 SYSTEM_CONSTANT "ASMOD_FACRHOETAEGPIPE_MAP_X" "9"
 SYSTEM_CONSTANT "ASMOD_FACRHOETAEGPIPE_MAP_Y" "2"
 SYSTEM_CONSTANT "ASMOD_FACRHOETAEGPIPE_MAX" "5"
 SYSTEM_CONSTANT "ASMOD_FACRHOETAEGPIPE_MIN" "0"
 SYSTEM_CONSTANT "ASMOD_FACRSTOICH" "14.5"
 SYSTEM_CONSTANT "ASMOD_FACSOTLFTCOR_CUR_X" "8"
 SYSTEM_CONSTANT "ASMOD_FACSOTLFTCOR_MAX" "1"
 SYSTEM_CONSTANT "ASMOD_FACSOTLFTCOR_MIN" "0"
 SYSTEM_CONSTANT "ASMOD_FACSOTRATEGRCOR_CUR_X" "8"
 SYSTEM_CONSTANT "ASMOD_FACSOTRATEGRCOR_MAX" "3"
 SYSTEM_CONSTANT "ASMOD_FACSOTRATEGRCOR_MIN" "0"
 SYSTEM_CONSTANT "ASMOD_FACSOXREDMSFLWEG_CUR_X" "2"
 SYSTEM_CONSTANT "ASMOD_FACSOXREDMSFLWEG_MAX" "1"
 SYSTEM_CONSTANT "ASMOD_FACSOXREDMSFLWEG_MIN" "0"
 SYSTEM_CONSTANT "ASMOD_FACSPDCMPRENV_CUR_X" "4"
 SYSTEM_CONSTANT "ASMOD_FACSQR" "100"
 SYSTEM_CONSTANT "ASMOD_FACSQR_CUR_X" "10"
 SYSTEM_CONSTANT "ASMOD_FACT1E6_RES" "1e-006"
 SYSTEM_CONSTANT "ASMOD_FACT1E6_RES_REV" "1000000"
 SYSTEM_CONSTANT "ASMOD_FACTEMPCLG_CUR_X" "8"
 SYSTEM_CONSTANT "ASMOD_FACTEMPCLG_MAX" "2"
 SYSTEM_CONSTANT "ASMOD_FACTEMPCLG_MIN" "0"
 SYSTEM_CONSTANT "ASMOD_FACTEMPCMPRENV_CUR_X" "4"
 SYSTEM_CONSTANT "ASMOD_FACTEMPENVCOR_CUR_X" "8"
 SYSTEM_CONSTANT "ASMOD_FACTEMPENVCOR_MAX" "100"
 SYSTEM_CONSTANT "ASMOD_FACTEMPENVCOR_MIN" "-50"
 SYSTEM_CONSTANT "ASMOD_FACTEMPENVPOPCOR_MAP_X" "8"
 SYSTEM_CONSTANT "ASMOD_FACTEMPENVPOPCOR_MAP_Y" "8"
 SYSTEM_CONSTANT "ASMOD_FACTEMPENVPOPCOR_MAX" "2"
 SYSTEM_CONSTANT "ASMOD_FACTEMPENVPOPCOR_MIN" "-3"
 SYSTEM_CONSTANT "ASMOD_FACTEMPINTMNFDSCOR_MAP_X" "10"
 SYSTEM_CONSTANT "ASMOD_FACTEMPINTMNFDSCOR_MAP_Y" "10"
 SYSTEM_CONSTANT "ASMOD_FACTEMPINTMNFDSCOR_MAX" "2"
 SYSTEM_CONSTANT "ASMOD_FACTEMPINTMNFDSCOR_MIN" "-2"
 SYSTEM_CONSTANT "ASMOD_FACTHMCNDNSC_MAX" "0.09"
 SYSTEM_CONSTANT "ASMOD_FACTHMCNDNSC_MIN" "0.01"
 SYSTEM_CONSTANT "ASMOD_FACTIMECLG_CUR_X" "8"
 SYSTEM_CONSTANT "ASMOD_FACTIMECLG_MAX" "255"
 SYSTEM_CONSTANT "ASMOD_FACTIMECLG_MIN" "0"
 SYSTEM_CONSTANT "ASMOD_FACTOR1" "0.472336"
 SYSTEM_CONSTANT "ASMOD_FACTOR2" "0.47172"
 SYSTEM_CONSTANT "ASMOD_FACTOR3" "0.52828"
 SYSTEM_CONSTANT "ASMOD_FACTRBN1_MAX_FL" "2000"
 SYSTEM_CONSTANT "ASMOD_FACTRBN1_MIN_FL" "0"
 SYSTEM_CONSTANT "ASMOD_FACTRBN2_MAX_FL" "200"
 SYSTEM_CONSTANT "ASMOD_FACTRBN2_MIN_FL" "0"
 SYSTEM_CONSTANT "ASMOD_FACTRBN3_MAX_FL" "300000"
 SYSTEM_CONSTANT "ASMOD_FACTRBN3_MIN_FL" "-300000"
 SYSTEM_CONSTANT "ASMOD_FACTRBN4_MAX_FL" "1000000"
 SYSTEM_CONSTANT "ASMOD_FACTRBN4_MIN_FL" "-1000000"
 SYSTEM_CONSTANT "ASMOD_FACVELTHMDPN_CUR_X" "16"
 SYSTEM_CONSTANT "ASMOD_FACVELTHMDPN_MAX" "655.34"
 SYSTEM_CONSTANT "ASMOD_FACVELTHMDPN_MIN" "0"
 SYSTEM_CONSTANT "ASMOD_FACVOLEFF" "1000"
 SYSTEM_CONSTANT "ASMOD_FACVOLEFFBAS_MAP_X" "16"
 SYSTEM_CONSTANT "ASMOD_FACVOLEFFBAS_MAP_Y" "16"
 SYSTEM_CONSTANT "ASMOD_FACVOLEFFBAS_MAX" "1"
 SYSTEM_CONSTANT "ASMOD_FACVOLEFFBAS_MIN" "0"
 SYSTEM_CONSTANT "ASMOD_FACVOLEFFVSACOR_MAP_X" "10"
 SYSTEM_CONSTANT "ASMOD_FACVOLEFFVSACOR_MAP_Y" "10"
 SYSTEM_CONSTANT "ASMOD_FACVOLEFFVSACOR_MAX" "2"
 SYSTEM_CONSTANT "ASMOD_FACVOLEFFVSACOR_MIN" "0"
 SYSTEM_CONSTANT "ASMOD_FACVOLEFF_MAP_X" "10"
 SYSTEM_CONSTANT "ASMOD_FACVOLEFF_MAP_Y" "10"
 SYSTEM_CONSTANT "ASMOD_FACVSACORVOLEFF_MAP_X" "4"
 SYSTEM_CONSTANT "ASMOD_FACVSACORVOLEFF_MAP_Y" "4"
 SYSTEM_CONSTANT "ASMOD_FACVSCDYNSLP_MAX" "0.0002"
 SYSTEM_CONSTANT "ASMOD_FACVSCDYNSLP_MIN" "3e-005"
 SYSTEM_CONSTANT "ASMOD_FACVSCKINSLP_MAX" "2e-007"
 SYSTEM_CONSTANT "ASMOD_FACVSCKINSLP_MIN" "8e-008"
 SYSTEM_CONSTANT "ASMOD_FAC_AIRMASSPERTIME" "3.6"
 SYSTEM_CONSTANT "ASMOD_FAC_AREA" "10000"
 SYSTEM_CONSTANT "ASMOD_FAC_DENS" "0.348432055749129"
 SYSTEM_CONSTANT "ASMOD_FAC_MHC" "0.01"
 SYSTEM_CONSTANT "ASMOD_FAC_PRC" "100"
 SYSTEM_CONSTANT "ASMOD_FAC_PRC_FL" "100"
 SYSTEM_CONSTANT "ASMOD_FAC_PRES" "100"
 SYSTEM_CONSTANT "ASMOD_FAC_PSI" "36"
 SYSTEM_CONSTANT "ASMOD_FAC_VOLEFF" "1000"
 SYSTEM_CONSTANT "ASMOD_FlAIREXHGS_RES" "10"
 SYSTEM_CONSTANT "ASMOD_GAS_CONST1" "0.85"
 SYSTEM_CONSTANT "ASMOD_GAS_CONST2" "1.2177075"
 SYSTEM_CONSTANT "ASMOD_GAS_CONST_FL" "8.314"
 SYSTEM_CONSTANT "ASMOD_GAS_CONST_INT" "8314"
 SYSTEM_CONSTANT "ASMOD_HENG_CALC" "348"
 SYSTEM_CONSTANT "ASMOD_HENG_RES" "34.8"
 SYSTEM_CONSTANT "ASMOD_HTCFREECNVTPIPE_MAX" "1000"
 SYSTEM_CONSTANT "ASMOD_HTCFREECNVTPIPE_MIN" "0.1"
 SYSTEM_CONSTANT "ASMOD_HTCOXIC_MAP_X" "4"
 SYSTEM_CONSTANT "ASMOD_HTCOXIC_MAP_Y" "4"
 SYSTEM_CONSTANT "ASMOD_HTCOXIC_MAX" "2"
 SYSTEM_CONSTANT "ASMOD_HTCOXIC_MIN" "0"
 SYSTEM_CONSTANT "ASMOD_HTFLW_RES" "2"
 SYSTEM_CONSTANT "ASMOD_HTFLW_RES_FL" "2"
 SYSTEM_CONSTANT "ASMOD_IMPT2AMPT" "10"
 SYSTEM_CONSTANT "ASMOD_INDVOL_MAX" "50"
 SYSTEM_CONSTANT "ASMOD_INDVOL_MIN" "0"
 SYSTEM_CONSTANT "ASMOD_INTEGLIMIT" "655340000"
 SYSTEM_CONSTANT "ASMOD_KGH2GS" "16384"
 SYSTEM_CONSTANT "ASMOD_LAMBDAREC1" "3.35671375"
 SYSTEM_CONSTANT "ASMOD_LCHNNSC_MAX" "0.65534"
 SYSTEM_CONSTANT "ASMOD_LCHNNSC_MIN" "0"
 SYSTEM_CONSTANT "ASMOD_LDIAMPIPE_MAX" "0.1"
 SYSTEM_CONSTANT "ASMOD_LDIAMPIPE_MIN" "0.01"
 SYSTEM_CONSTANT "ASMOD_LLNGTHPIPE_MAX" "3"
 SYSTEM_CONSTANT "ASMOD_LLNGTHPIPE_MIN" "0.01"
 SYSTEM_CONSTANT "ASMOD_LMEXO_SY" "1"
 SYSTEM_CONSTANT "ASMOD_LNSCBRICK_MAX" "0.65534"
 SYSTEM_CONSTANT "ASMOD_LNSCBRICK_MIN" "0"
 SYSTEM_CONSTANT "ASMOD_LSUMVEHLFTNOX_MAX" "500000"
 SYSTEM_CONSTANT "ASMOD_LSUMVEHLFTNOX_MIN" "0"
 SYSTEM_CONSTANT "ASMOD_LSUMVEHLFTSOT_MAX" "500000"
 SYSTEM_CONSTANT "ASMOD_LSUMVEHLFTSOT_MIN" "0"
 SYSTEM_CONSTANT "ASMOD_LSUMVEH_MAX" "600000"
 SYSTEM_CONSTANT "ASMOD_LSUMVEH_MIN" "0"
 SYSTEM_CONSTANT "ASMOD_MAIRCONV" "66666"
 SYSTEM_CONSTANT "ASMOD_MAIRINTMNF_MAX_FL" "20"
 SYSTEM_CONSTANT "ASMOD_MAIRINTMNF_MIN_FL" "0"
 SYSTEM_CONSTANT "ASMOD_MAIRPERCYLCOR_MAX" "700"
 SYSTEM_CONSTANT "ASMOD_MAIRPERCYLCOR_MIN" "0"
 SYSTEM_CONSTANT "ASMOD_MASS_NORM" "287.356321839081"
 SYSTEM_CONSTANT "ASMOD_MEGRINTMNF_MAX_FL" "10"
 SYSTEM_CONSTANT "ASMOD_MEGRINTMNF_MIN_FL" "0"
 SYSTEM_CONSTANT "ASMOD_MEXHMNFLP_MAX_FL" "150"
 SYSTEM_CONSTANT "ASMOD_MEXHMNFLP_MIN_FL" "0"
 SYSTEM_CONSTANT "ASMOD_MINDAIR" "445.44"
 SYSTEM_CONSTANT "ASMOD_MINDVOL_MAX_FL" "150"
 SYSTEM_CONSTANT "ASMOD_MINDVOL_MIN_FL" "0"
 SYSTEM_CONSTANT "ASMOD_MINMEXHMNFLP_FL" "0.5"
 SYSTEM_CONSTANT "ASMOD_MINMINDVOL_FL" "0.5"
 SYSTEM_CONSTANT "ASMOD_MINTMNFMIN_MAX_FL" "10"
 SYSTEM_CONSTANT "ASMOD_MINTMNF_MAX_FL" "20"
 SYSTEM_CONSTANT "ASMOD_MINTMNF_MIN_FL" "0"
 SYSTEM_CONSTANT "ASMOD_MO2INDVOL_MAX_FL" "5"
 SYSTEM_CONSTANT "ASMOD_MO2INDVOL_MIN_FL" "0"
 SYSTEM_CONSTANT "ASMOD_MO2INTMNFMIN_MAX_FL" "3"
 SYSTEM_CONSTANT "ASMOD_MO2INTMNF_MAX_FL" "5"
 SYSTEM_CONSTANT "ASMOD_MO2INTMNF_MIN_FL" "0"
 SYSTEM_CONSTANT "ASMOD_NDELAY_RES" "1875000"
 SYSTEM_CONSTANT "ASMOD_NENGIN_MAX" "4000"
 SYSTEM_CONSTANT "ASMOD_NENGIN_MIN" "800"
 SYSTEM_CONSTANT "ASMOD_NENG_MAX_FL" "6000"
 SYSTEM_CONSTANT "ASMOD_NENG_MIN_FL" "0"
 SYSTEM_CONSTANT "ASMOD_NHPTRBCHRED_MAP_X" "16"
 SYSTEM_CONSTANT "ASMOD_NHPTRBCHRED_MAP_Y" "16"
 SYSTEM_CONSTANT "ASMOD_NLPTRBCHRED_MAP_X" "16"
 SYSTEM_CONSTANT "ASMOD_NLPTRBCHRED_MAP_Y" "16"
 SYSTEM_CONSTANT "ASMOD_NTHRESDWN_MAX" "900"
 SYSTEM_CONSTANT "ASMOD_NTHRESDWN_MIN" "0"
 SYSTEM_CONSTANT "ASMOD_NTRBCHRED_MAP_X" "16"
 SYSTEM_CONSTANT "ASMOD_NTRBCHRED_MAP_Y" "16"
 SYSTEM_CONSTANT "ASMOD_NTRBCH_MAX" "300000"
 SYSTEM_CONSTANT "ASMOD_NTRBCH_MAX_FL" "300000"
 SYSTEM_CONSTANT "ASMOD_NTRBCH_MIN" "0"
 SYSTEM_CONSTANT "ASMOD_NTRBCH_MIN_FL" "0"
 SYSTEM_CONSTANT "ASMOD_NTRBNRED_MAX_FL" "300000"
 SYSTEM_CONSTANT "ASMOD_NTRBNRED_MIN_FL" "0"
 SYSTEM_CONSTANT "ASMOD_NUMBNK_MAX" "2"
 SYSTEM_CONSTANT "ASMOD_NUMBNK_MIN" "0"
 SYSTEM_CONSTANT "ASMOD_NUMBRICKNSC1_SY" "1"
 SYSTEM_CONSTANT "ASMOD_NUMBRICKNSC2_SY" "0"
 SYSTEM_CONSTANT "ASMOD_NUMBRICKNSCTOT_SY" "1"
 SYSTEM_CONSTANT "ASMOD_NUMCLNTTEMP_MAX" "2"
 SYSTEM_CONSTANT "ASMOD_NUMCLNTTEMP_MIN" "0"
 SYSTEM_CONSTANT "ASMOD_NUMENGTEMPNOXCORPFLT_MAX" "10"
 SYSTEM_CONSTANT "ASMOD_NUMENGTEMPNOXCORPFLT_MIN" "0"
 SYSTEM_CONSTANT "ASMOD_NUMEOMCOEMI_SY" "3"
 SYSTEM_CONSTANT "ASMOD_NUMEOMNOXEMI_SY" "3"
 SYSTEM_CONSTANT "ASMOD_NUMEOMSOTEMI_SY" "3"
 SYSTEM_CONSTANT "ASMOD_NUMEXHMNFLP_MAX" "7"
 SYSTEM_CONSTANT "ASMOD_NUMEXHMNFLP_MIN" "0"
 SYSTEM_CONSTANT "ASMOD_NUMFLDTOT_SY" "3"
 SYSTEM_CONSTANT "ASMOD_NUMNSC_CA_X" "2"
 SYSTEM_CONSTANT "ASMOD_NUMNSC_SY" "1"
 SYSTEM_CONSTANT "ASMOD_NUMOXICMOD_SY" "1"
 SYSTEM_CONSTANT "ASMOD_NUMOXIC_SY" "1"
 SYSTEM_CONSTANT "ASMOD_NUMPIPES_MAX" "6"
 SYSTEM_CONSTANT "ASMOD_NUMPIPES_MIN" "0"
 SYSTEM_CONSTANT "ASMOD_NUMSOTEOMPFLTRGN_MAX" "4"
 SYSTEM_CONSTANT "ASMOD_NUMSOTEOMPFLTRGN_MIN" "0"
 SYSTEM_CONSTANT "ASMOD_NUMSOTLAMCOREGROFF_MAX" "2"
 SYSTEM_CONSTANT "ASMOD_NUMSOTLAMCOREGROFF_MIN" "0"
 SYSTEM_CONSTANT "ASMOD_NUMSOTLAMCOR_MAX" "2"
 SYSTEM_CONSTANT "ASMOD_NUMSOTLAMCOR_MIN" "0"
 SYSTEM_CONSTANT "ASMOD_NUPIPEENVSLW_CUR_X" "8"
 SYSTEM_CONSTANT "ASMOD_NUPIPEENV_CUR_X" "8"
 SYSTEM_CONSTANT "ASMOD_NUPIPEENV_MAX" "5309"
 SYSTEM_CONSTANT "ASMOD_NUPIPEENV_MIN" "0"
 SYSTEM_CONSTANT "ASMOD_NUPIPESLW_CUR_X" "8"
 SYSTEM_CONSTANT "ASMOD_NUPIPE_CUR_X" "8"
 SYSTEM_CONSTANT "ASMOD_NUPIPE_MAX" "1130"
 SYSTEM_CONSTANT "ASMOD_NUPIPE_MIN" "0"
 SYSTEM_CONSTANT "ASMOD_ONE_R32" "1"
 SYSTEM_CONSTANT "ASMOD_PCMPRUS_MAX_FL" "1200"
 SYSTEM_CONSTANT "ASMOD_PCMPRUS_MIN_FL" "700"
 SYSTEM_CONSTANT "ASMOD_PCMPR_MAX_FL" "4000"
 SYSTEM_CONSTANT "ASMOD_PCMPR_MIN_FL" "0"
 SYSTEM_CONSTANT "ASMOD_PDIFFPIPE_MAP_X" "2"
 SYSTEM_CONSTANT "ASMOD_PDIFFPIPE_MAP_Y" "2"
 SYSTEM_CONSTANT "ASMOD_PDIFFPIPE_MAX" "400"
 SYSTEM_CONSTANT "ASMOD_PDIFFPIPE_MIN" "0"
 SYSTEM_CONSTANT "ASMOD_PEGPRESPIPE_MAX" "3000"
 SYSTEM_CONSTANT "ASMOD_PEGPRESPIPE_MIN" "1000"
 SYSTEM_CONSTANT "ASMOD_PEGRDS_MAX_FL" "6000"
 SYSTEM_CONSTANT "ASMOD_PEGRDS_MIN_FL" "0"
 SYSTEM_CONSTANT "ASMOD_PEGRLPDS_MAX_FL" "6000"
 SYSTEM_CONSTANT "ASMOD_PEGRLPDS_MIN_FL" "0"
 SYSTEM_CONSTANT "ASMOD_PEXHMNFLP_MAX_FL" "4000"
 SYSTEM_CONSTANT "ASMOD_PEXHMNFLP_MIN_FL" "0"
 SYSTEM_CONSTANT "ASMOD_PEXHMNF_MAX_FL" "6000"
 SYSTEM_CONSTANT "ASMOD_PEXHMNF_MIN_FL" "0"
 SYSTEM_CONSTANT "ASMOD_PHC" "3"
 SYSTEM_CONSTANT "ASMOD_PHIDIFFSOIREF_MAX" "20"
 SYSTEM_CONSTANT "ASMOD_PHIDIFFSOIREF_MIN" "-20"
 SYSTEM_CONSTANT "ASMOD_PHISOIREFRGN_MAP_X" "10"
 SYSTEM_CONSTANT "ASMOD_PHISOIREFRGN_MAP_Y" "10"
 SYSTEM_CONSTANT "ASMOD_PHISOIREF_MAP_X" "8"
 SYSTEM_CONSTANT "ASMOD_PHISOIREF_MAP_Y" "8"
 SYSTEM_CONSTANT "ASMOD_PHISOIREF_MAX" "40"
 SYSTEM_CONSTANT "ASMOD_PHISOIREF_MIN" "-20"
 SYSTEM_CONSTANT "ASMOD_PINDVOL_MAX" "4000"
 SYSTEM_CONSTANT "ASMOD_PINDVOL_MAX_FL" "4000"
 SYSTEM_CONSTANT "ASMOD_PINDVOL_MIN" "0"
 SYSTEM_CONSTANT "ASMOD_PINDVOL_MIN_FL" "0"
 SYSTEM_CONSTANT "ASMOD_PINIT_MAX" "1100"
 SYSTEM_CONSTANT "ASMOD_PINIT_MIN" "900"
 SYSTEM_CONSTANT "ASMOD_PINTMNFMIN_MAX_FL" "1000"
 SYSTEM_CONSTANT "ASMOD_PINTMNF_MAX_FL" "4000"
 SYSTEM_CONSTANT "ASMOD_PINTMNF_MIN_FL" "0"
 SYSTEM_CONSTANT "ASMOD_PLSEGRCLG_MAX_FL" "1000"
 SYSTEM_CONSTANT "ASMOD_PLSEGRCLG_MIN_FL" "0"
 SYSTEM_CONSTANT "ASMOD_PRESEXHMNFPT1_MAX_FL" "1"
 SYSTEM_CONSTANT "ASMOD_PRESEXHMNFPT1_MIN_FL" "0"
 SYSTEM_CONSTANT "ASMOD_PTRBNDSREF_MAX_FL" "6000"
 SYSTEM_CONSTANT "ASMOD_PTRBNDSREF_MIN_FL" "0"
 SYSTEM_CONSTANT "ASMOD_PTRBNUS_MAX_FL" "1500"
 SYSTEM_CONSTANT "ASMOD_PTRBNUS_MIN_FL" "500"
 SYSTEM_CONSTANT "ASMOD_QBRN_MAX" "150"
 SYSTEM_CONSTANT "ASMOD_QBRN_MIN" "0"
 SYSTEM_CONSTANT "ASMOD_QLMBD" "100"
 SYSTEM_CONSTANT "ASMOD_QPOI1REF_MAP_X" "10"
 SYSTEM_CONSTANT "ASMOD_QPOI1REF_MAP_Y" "10"
 SYSTEM_CONSTANT "ASMOD_QPOI2REF_MAP_X" "10"
 SYSTEM_CONSTANT "ASMOD_QPOI2REF_MAP_Y" "10"
 SYSTEM_CONSTANT "ASMOD_QPRESPIPE_MAX" "50"
 SYSTEM_CONSTANT "ASMOD_QSETUNBAL_MAX" "327.67"
 SYSTEM_CONSTANT "ASMOD_QSETUNBAL_MIN" "0"
 SYSTEM_CONSTANT "ASMOD_QSWTOUTOBSVRMAX_CUR_X" "8"
 SYSTEM_CONSTANT "ASMOD_QSWTOUTOBSVRMIN_CUR_X" "8"
 SYSTEM_CONSTANT "ASMOD_RARPIPE_MAX" "1"
 SYSTEM_CONSTANT "ASMOD_RARPIPE_MIN" "0"
 SYSTEM_CONSTANT "ASMOD_RASHEXHGS_RES" "10000"
 SYSTEM_CONSTANT "ASMOD_RBPALIN_CUR_X" "6"
 SYSTEM_CONSTANT "ASMOD_RCOEXHGS_RES" "500000"
 SYSTEM_CONSTANT "ASMOD_RECBLIN_CUR_X" "6"
 SYSTEM_CONSTANT "ASMOD_RECBLPLIN_CUR_X" "6"
 SYSTEM_CONSTANT "ASMOD_REGRAIRDVTCORACTV_MAX" "100"
 SYSTEM_CONSTANT "ASMOD_REGRAIRDVTCORACTV_MIN" "0"
 SYSTEM_CONSTANT "ASMOD_REGRDVTWGHCRVIN_MAX" "1"
 SYSTEM_CONSTANT "ASMOD_REGRDVTWGHCRVIN_MIN" "-0.5"
 SYSTEM_CONSTANT "ASMOD_REGRLAMCORMAX" "100"
 SYSTEM_CONSTANT "ASMOD_REGRLAMCORMAX_MIN" "0"
 SYSTEM_CONSTANT "ASMOD_REGRLAMCORMIN" "0"
 SYSTEM_CONSTANT "ASMOD_REGRLAMCORMIN_MAX" "100"
 SYSTEM_CONSTANT "ASMOD_REGRLAM_MAX" "100"
 SYSTEM_CONSTANT "ASMOD_REGRLAM_MIN" "-5"
 SYSTEM_CONSTANT "ASMOD_REGRLIN_CUR_X" "6"
 SYSTEM_CONSTANT "ASMOD_REGRSET_MAP_X" "10"
 SYSTEM_CONSTANT "ASMOD_REGRSET_MAP_Y" "10"
 SYSTEM_CONSTANT "ASMOD_REGR_LIMMAX" "100"
 SYSTEM_CONSTANT "ASMOD_REGR_LIMMIN" "0"
 SYSTEM_CONSTANT "ASMOD_REGR_MAX" "1"
 SYSTEM_CONSTANT "ASMOD_REGR_MAX_FL" "100"
 SYSTEM_CONSTANT "ASMOD_REGR_MIN" "0"
 SYSTEM_CONSTANT "ASMOD_REGR_MIN_FL" "0"
 SYSTEM_CONSTANT "ASMOD_REGR_ONE" "1"
 SYSTEM_CONSTANT "ASMOD_REPIPEENV_MAX" "3750000"
 SYSTEM_CONSTANT "ASMOD_REPIPEENV_MIN" "0"
 SYSTEM_CONSTANT "ASMOD_REPIPE_MAX" "800000"
 SYSTEM_CONSTANT "ASMOD_REPIPE_MIN" "0"
 SYSTEM_CONSTANT "ASMOD_RFUELBURNED_RES" "100"
 SYSTEM_CONSTANT "ASMOD_RGN" "4"
 SYSTEM_CONSTANT "ASMOD_RHOFL" "1"
 SYSTEM_CONSTANT "ASMOD_RHONSC_MAX" "3200"
 SYSTEM_CONSTANT "ASMOD_RHONSC_MIN" "0"
 SYSTEM_CONSTANT "ASMOD_RLAMRECEXHMNFDD_MAX" "2"
 SYSTEM_CONSTANT "ASMOD_RLAMRECEXHMNFDD_MIN" "0"
 SYSTEM_CONSTANT "ASMOD_RLAMRECINTMNFDS_MAX_FL" "2"
 SYSTEM_CONSTANT "ASMOD_RLAMRECINTMNFDS_MIN_FL" "0"
 SYSTEM_CONSTANT "ASMOD_RLAMRECREFBAS_MAP_X" "14"
 SYSTEM_CONSTANT "ASMOD_RLAMRECREFBAS_MAP_Y" "16"
 SYSTEM_CONSTANT "ASMOD_RLAMRECREFBAS_MAX" "10"
 SYSTEM_CONSTANT "ASMOD_RLAMRECREFBAS_MIN" "0"
 SYSTEM_CONSTANT "ASMOD_RLAMRECREFMIN" "0"
 SYSTEM_CONSTANT "ASMOD_RLAMRECREFMIN_MAX" "10"
 SYSTEM_CONSTANT "ASMOD_RLAMRECREF_MAP_X" "8"
 SYSTEM_CONSTANT "ASMOD_RLAMRECREF_MAP_Y" "8"
 SYSTEM_CONSTANT "ASMOD_RLAMRECREF_MAX" "2"
 SYSTEM_CONSTANT "ASMOD_RLAMRECREF_MIN" "0"
 SYSTEM_CONSTANT "ASMOD_RLINTRBCHPOS_CUR_X" "8"
 SYSTEM_CONSTANT "ASMOD_RLMBDREC" "1450"
 SYSTEM_CONSTANT "ASMOD_RM" "2"
 SYSTEM_CONSTANT "ASMOD_RMDNOXEXO_SY" "2"
 SYSTEM_CONSTANT "ASMOD_RMDSOXEXO_SY" "0"
 SYSTEM_CONSTANT "ASMOD_RMSFLWREF_MAX" "1"
 SYSTEM_CONSTANT "ASMOD_RMSFLWREF_MIN" "-1"
 SYSTEM_CONSTANT "ASMOD_RNOXENGCHCORCRVIN_MAX" "1"
 SYSTEM_CONSTANT "ASMOD_RNOXENGCHCORCRVIN_MIN" "-1"
 SYSTEM_CONSTANT "ASMOD_RNOXEXHGS_RES" "10000000"
 SYSTEM_CONSTANT "ASMOD_RO2EXHGS_RES" "10000"
 SYSTEM_CONSTANT "ASMOD_RO2_MAX" "0.2315"
 SYSTEM_CONSTANT "ASMOD_RO2_MAX_FL" "0.2315"
 SYSTEM_CONSTANT "ASMOD_RO2_MIN" "0"
 SYSTEM_CONSTANT "ASMOD_RO2_MIN_FL" "0"
 SYSTEM_CONSTANT "ASMOD_RPRESCMPR_MAX" "3.4"
 SYSTEM_CONSTANT "ASMOD_RPRESCMPR_MAX_FL" "3"
 SYSTEM_CONSTANT "ASMOD_RPRESCMPR_MIN" "0.3"
 SYSTEM_CONSTANT "ASMOD_RPRESCMPR_MIN_FL" "0.5"
 SYSTEM_CONSTANT "ASMOD_RPRESHPCMPRRAW_CUR_X" "20"
 SYSTEM_CONSTANT "ASMOD_RPRESHPCMPR_CUR_X" "20"
 SYSTEM_CONSTANT "ASMOD_RPRESHPTRBNREC_CUR_X" "16"
 SYSTEM_CONSTANT "ASMOD_RPRESLPCMPRRAW_CUR_X" "20"
 SYSTEM_CONSTANT "ASMOD_RPRESLPCMPR_CUR_X" "20"
 SYSTEM_CONSTANT "ASMOD_RPRESLPTRBNREC_CUR_X" "16"
 SYSTEM_CONSTANT "ASMOD_RPRESTRBNREC_MAP_X" "8"
 SYSTEM_CONSTANT "ASMOD_RPRESTRBNREC_MAP_Y" "16"
 SYSTEM_CONSTANT "ASMOD_RPRESTRBN_MAX_FL" "5"
 SYSTEM_CONSTANT "ASMOD_RPRESTRBN_MIN_FL" "0"
 SYSTEM_CONSTANT "ASMOD_RRELPOS_MAX_FL" "100"
 SYSTEM_CONSTANT "ASMOD_RRELPOS_MIN_FL" "0"
 SYSTEM_CONSTANT "ASMOD_RSOTEXHGS_RES" "10000"
 SYSTEM_CONSTANT "ASMOD_RSOTLAMCORCRVIN_MAX" "2"
 SYSTEM_CONSTANT "ASMOD_RSOTLAMCORCRVIN_MIN" "0"
 SYSTEM_CONSTANT "ASMOD_RSOTRATEGRCORCRVIN_MAX" "0.8"
 SYSTEM_CONSTANT "ASMOD_RSOTRATEGRCORCRVIN_MIN" "0"
 SYSTEM_CONSTANT "ASMOD_RSOXEXHGS_RES" "100000"
 SYSTEM_CONSTANT "ASMOD_RSOXFL_MAX" "0.000118"
 SYSTEM_CONSTANT "ASMOD_RSOXFL_MIN" "0"
 SYSTEM_CONSTANT "ASMOD_RTEMPADBT_CUR_X" "20"
 SYSTEM_CONSTANT "ASMOD_RTEMPADBT_MAX" "1.5"
 SYSTEM_CONSTANT "ASMOD_RTEMPADBT_MIN" "0"
 SYSTEM_CONSTANT "ASMOD_RTEMPCLNT_MAX" "1"
 SYSTEM_CONSTANT "ASMOD_RTEMPCLNT_MIN" "0"
 SYSTEM_CONSTANT "ASMOD_RTEMPDIFFTRBNADBT_CUR_X" "8"
 SYSTEM_CONSTANT "ASMOD_RTEMPDIFFTRBNADBT_MAX_FL" "1"
 SYSTEM_CONSTANT "ASMOD_RTEMPDIFFTRBNADBT_MIN_FL" "0"
 SYSTEM_CONSTANT "ASMOD_RTIME_MAX" "8"
 SYSTEM_CONSTANT "ASMOD_RTIME_MIN" "0"
 SYSTEM_CONSTANT "ASMOD_RTVALIN_CUR_X" "6"
 SYSTEM_CONSTANT "ASMOD_RVOLCOLEAN_MAX" "0.06554"
 SYSTEM_CONSTANT "ASMOD_RVOLCOLEAN_MIN" "0"
 SYSTEM_CONSTANT "ASMOD_RVOLO2LEAN_MAX" "65.534"
 SYSTEM_CONSTANT "ASMOD_RVOLO2LEAN_MIN" "0"
 SYSTEM_CONSTANT "ASMOD_RVSALIN_CUR_X" "6"
 SYSTEM_CONSTANT "ASMOD_R_STOICH" "1450"
 SYSTEM_CONSTANT "ASMOD_SEC2HUNDREDHRS_RES" "36000000"
 SYSTEM_CONSTANT "ASMOD_SECTO100HRS_RES" "360000"
 SYSTEM_CONSTANT "ASMOD_SOXFL_RES" "29492025.7767217"
 SYSTEM_CONSTANT "ASMOD_SPECHEAT_FACT" "250"
 SYSTEM_CONSTANT "ASMOD_STAIRCTLBITMSK_MAX" "4294967295"
 SYSTEM_CONSTANT "ASMOD_STAIRCTLBITMSK_MIN" "0"
 SYSTEM_CONSTANT "ASMOD_STMSK_UINT32_MAX" "4294967295"
 SYSTEM_CONSTANT "ASMOD_STMSK_UINT32_MIN" "0"
 SYSTEM_CONSTANT "ASMOD_SWTCALCQNTINJCMB_MAX" "3"
 SYSTEM_CONSTANT "ASMOD_SWTCALCQNTINJCMB_MIN" "0"
 SYSTEM_CONSTANT "ASMOD_SWTFACHCCNVOXIC_MAX" "1"
 SYSTEM_CONSTANT "ASMOD_SWTFACHCCNVOXIC_MIN" "0"
 SYSTEM_CONSTANT "ASMOD_SWTFLMSFLWOXIC_MAX" "2"
 SYSTEM_CONSTANT "ASMOD_SWTFLMSFLWOXIC_MIN" "0"
 SYSTEM_CONSTANT "ASMOD_SWTNOXMSFLWRM_MAX" "1"
 SYSTEM_CONSTANT "ASMOD_SWTNOXMSFLWRM_MIN" "0"
 SYSTEM_CONSTANT "ASMOD_SWTOFFINDVOL_MAX" "1"
 SYSTEM_CONSTANT "ASMOD_SWTOFFINDVOL_MIN" "0"
 SYSTEM_CONSTANT "ASMOD_SWTPFLTTEMPMODOFF_MAX" "1"
 SYSTEM_CONSTANT "ASMOD_SWTPFLTTEMPMODOFF_MIN" "0"
 SYSTEM_CONSTANT "ASMOD_SWTPRESMIDPFLT_MAX" "2"
 SYSTEM_CONSTANT "ASMOD_SWTPRESMIDPFLT_MIN" "0"
 SYSTEM_CONSTANT "ASMOD_SWTTEMPEXHMNFCORON_MAX" "1"
 SYSTEM_CONSTANT "ASMOD_SWTTEMPEXHMNFCORON_MIN" "0"
 SYSTEM_CONSTANT "ASMOD_SWTTEMPTRBNCORON_MAX" "1"
 SYSTEM_CONSTANT "ASMOD_SWTTEMPTRBNCORON_MIN" "0"
 SYSTEM_CONSTANT "ASMOD_TCACDS_MAX" "400"
 SYSTEM_CONSTANT "ASMOD_TCACDS_MIN" "-50"
 SYSTEM_CONSTANT "ASMOD_TCLNT_MAX" "150"
 SYSTEM_CONSTANT "ASMOD_TCLNT_MIN" "-50"
 SYSTEM_CONSTANT "ASMOD_TCMPRUSREF_MAX_FL" "200"
 SYSTEM_CONSTANT "ASMOD_TCMPRUSREF_MIN_FL" "-50"
 SYSTEM_CONSTANT "ASMOD_TCMPRUS_MAX_FL" "150"
 SYSTEM_CONSTANT "ASMOD_TCMPRUS_MIN_FL" "-50"
 SYSTEM_CONSTANT "ASMOD_TDIFFEGRCLG_MAX_FL" "800"
 SYSTEM_CONSTANT "ASMOD_TDIFFEGRCLG_MIN_FL" "0"
 SYSTEM_CONSTANT "ASMOD_TDIFFEGRLP_MAX_FL" "576"
 SYSTEM_CONSTANT "ASMOD_TDIFFEGRLP_MIN_FL" "0"
 SYSTEM_CONSTANT "ASMOD_TDIFFENGBAS_MAP_X" "8"
 SYSTEM_CONSTANT "ASMOD_TDIFFENGBAS_MAP_Y" "8"
 SYSTEM_CONSTANT "ASMOD_TDIFFENGBAS_MAX" "600"
 SYSTEM_CONSTANT "ASMOD_TDIFFENGBAS_MIN" "-600"
 SYSTEM_CONSTANT "ASMOD_TDIFFENGREF_MAX" "120"
 SYSTEM_CONSTANT "ASMOD_TDIFFENGREF_MIN" "-80"
 SYSTEM_CONSTANT "ASMOD_TDIFFENGRGN_MAP_X" "10"
 SYSTEM_CONSTANT "ASMOD_TDIFFENGRGN_MAP_Y" "10"
 SYSTEM_CONSTANT "ASMOD_TEGENGTEMPCOR_CUR_X" "8"
 SYSTEM_CONSTANT "ASMOD_TEGENGTEMPCOR_MAX" "100"
 SYSTEM_CONSTANT "ASMOD_TEGENGTEMPCOR_MIN" "-100"
 SYSTEM_CONSTANT "ASMOD_TEGNSCSRC_MAX" "1500"
 SYSTEM_CONSTANT "ASMOD_TEGNSCSRC_MIN" "-100"
 SYSTEM_CONSTANT "ASMOD_TEGPOI1COR_CUR_X" "10"
 SYSTEM_CONSTANT "ASMOD_TEGPOI2COR_CUR_X" "10"
 SYSTEM_CONSTANT "ASMOD_TEGPRESPIPE_MAX" "800"
 SYSTEM_CONSTANT "ASMOD_TEGPRESPIPE_MIN" "-40"
 SYSTEM_CONSTANT "ASMOD_TEGRDSMIN_MAX" "300"
 SYSTEM_CONSTANT "ASMOD_TEGRDSMIN_MAX_FL" "300"
 SYSTEM_CONSTANT "ASMOD_TEGRDS_MAX" "1000"
 SYSTEM_CONSTANT "ASMOD_TEGRDS_MAX_FL" "1000"
 SYSTEM_CONSTANT "ASMOD_TEGRDS_MIN" "-50"
 SYSTEM_CONSTANT "ASMOD_TEGRDS_MIN_FL" "-50"
 SYSTEM_CONSTANT "ASMOD_TEGRLPDS1_MAX_FL" "1000"
 SYSTEM_CONSTANT "ASMOD_TEGRLPDS1_MIN_FL" "-50"
 SYSTEM_CONSTANT "ASMOD_TEGRLPDS_MAX_FL" "300"
 SYSTEM_CONSTANT "ASMOD_TEGRLPDS_MIN_FL" "-50"
 SYSTEM_CONSTANT "ASMOD_TEGRTHRVLV_MAX_FL" "150"
 SYSTEM_CONSTANT "ASMOD_TEGRTHRVLV_MIN_FL" "-50"
 SYSTEM_CONSTANT "ASMOD_TEMP1" "1000"
 SYSTEM_CONSTANT "ASMOD_TEMPINTMNFDSPT1_MAX_FL" "0.5"
 SYSTEM_CONSTANT "ASMOD_TEMPINTMNFDSPT1_MIN_FL" "0"
 SYSTEM_CONSTANT "ASMOD_TEMPKS" "12.8"
 SYSTEM_CONSTANT "ASMOD_TEMPNULL_NORM" "-819.42"
 SYSTEM_CONSTANT "ASMOD_TEMPOXICI_KI_MAX" "4"
 SYSTEM_CONSTANT "ASMOD_TEMPOXICI_KI_MIN" "0"
 SYSTEM_CONSTANT "ASMOD_TEMPPFLTDT1_KD_MAX" "50"
 SYSTEM_CONSTANT "ASMOD_TEMPPFLTDT1_KD_MIN" "-50"
 SYSTEM_CONSTANT "ASMOD_TEMPPFLTDT1_TI_MAX" "15"
 SYSTEM_CONSTANT "ASMOD_TEMPPFLTDT1_TI_MIN" "0.001"
 SYSTEM_CONSTANT "ASMOD_TEMPPFLTI_KINEG_MAX" "5"
 SYSTEM_CONSTANT "ASMOD_TEMPPFLTI_KINEG_MIN" "0.001"
 SYSTEM_CONSTANT "ASMOD_TEMPPFLTI_KIPOS_MAX" "5"
 SYSTEM_CONSTANT "ASMOD_TEMPPFLTI_KIPOS_MIN" "0.001"
 SYSTEM_CONSTANT "ASMOD_TEMPPFLTI_KI_MAX" "10"
 SYSTEM_CONSTANT "ASMOD_TEMPPFLTI_KI_MIN" "0.001"
 SYSTEM_CONSTANT "ASMOD_TEMPPIPEI_KI_MAX" "4"
 SYSTEM_CONSTANT "ASMOD_TEMPPIPEI_KI_MIN" "0"
 SYSTEM_CONSTANT "ASMOD_TENGREF_MAX" "150"
 SYSTEM_CONSTANT "ASMOD_TENGREF_MIN" "-50"
 SYSTEM_CONSTANT "ASMOD_TEXHMNFDSREF_MAX_FL" "1000"
 SYSTEM_CONSTANT "ASMOD_TEXHMNFDSREF_MIN_FL" "-50"
 SYSTEM_CONSTANT "ASMOD_TEXHMNFDS_MAX" "1000"
 SYSTEM_CONSTANT "ASMOD_TEXHMNFDS_MAX_FL" "1000"
 SYSTEM_CONSTANT "ASMOD_TEXHMNFDS_MIN" "0"
 SYSTEM_CONSTANT "ASMOD_TEXHMNFDS_MIN_FL" "0"
 SYSTEM_CONSTANT "ASMOD_TFLD_MAX" "3000"
 SYSTEM_CONSTANT "ASMOD_TFLD_MIN" "-100"
 SYSTEM_CONSTANT "ASMOD_THPTRBNDYNCOR_MAP_X" "4"
 SYSTEM_CONSTANT "ASMOD_THPTRBNDYNCOR_MAP_Y" "4"
 SYSTEM_CONSTANT "ASMOD_THPTRBNTEMPCOR_MAP_X" "4"
 SYSTEM_CONSTANT "ASMOD_THPTRBNTEMPCOR_MAP_Y" "4"
 SYSTEM_CONSTANT "ASMOD_TICLGOFS_MAX" "40000000"
 SYSTEM_CONSTANT "ASMOD_TICLGOFS_MIN" "0"
 SYSTEM_CONSTANT "ASMOD_TIDT1_MAX" "5"
 SYSTEM_CONSTANT "ASMOD_TIDT1_MIN" "0.05"
 SYSTEM_CONSTANT "ASMOD_TIENGON_MAX" "8000"
 SYSTEM_CONSTANT "ASMOD_TIENGON_MIN" "0"
 SYSTEM_CONSTANT "ASMOD_TIEXHGSDELPFLT_CUR_X" "8"
 SYSTEM_CONSTANT "ASMOD_TIEXHGSDELPFLT_MAX" "15"
 SYSTEM_CONSTANT "ASMOD_TIEXHGSDELPFLT_MIN" "0.001"
 SYSTEM_CONSTANT "ASMOD_TIHAVALCLNT_MAX" "40000000"
 SYSTEM_CONSTANT "ASMOD_TIHAVALCLNT_MIN" "0"
 SYSTEM_CONSTANT "ASMOD_TIHAVALNSC_MAX" "40000000"
 SYSTEM_CONSTANT "ASMOD_TIHAVALNSC_MIN" "0"
 SYSTEM_CONSTANT "ASMOD_TIHAVALOXIC_MAX" "40000000"
 SYSTEM_CONSTANT "ASMOD_TIHAVALOXIC_MIN" "0"
 SYSTEM_CONSTANT "ASMOD_TIHAVALPIPE_MAX" "40000000"
 SYSTEM_CONSTANT "ASMOD_TIHAVALPIPE_MIN" "0"
 SYSTEM_CONSTANT "ASMOD_TIHTTRANSDT1_CUR_X" "8"
 SYSTEM_CONSTANT "ASMOD_TIHTTRANSDT1_MAX" "15"
 SYSTEM_CONSTANT "ASMOD_TIHTTRANSDT1_MIN" "0.001"
 SYSTEM_CONSTANT "ASMOD_TILAMRECSTATPT1_MAX" "10"
 SYSTEM_CONSTANT "ASMOD_TILAMRECSTATPT1_MIN" "0.001"
 SYSTEM_CONSTANT "ASMOD_TILAMSENSDDT_CUR_X" "8"
 SYSTEM_CONSTANT "ASMOD_TILAMSENSDDT_MAX" "0.32"
 SYSTEM_CONSTANT "ASMOD_TILAMSENSDDT_MIN" "0"
 SYSTEM_CONSTANT "ASMOD_TILAMSENSPT1_CUR_X" "8"
 SYSTEM_CONSTANT "ASMOD_TILAMSENSPT1_MAX" "5"
 SYSTEM_CONSTANT "ASMOD_TILAMSENSPT1_MIN" "0"
 SYSTEM_CONSTANT "ASMOD_TIMEDELAY_S_MIN" "2e-006"
 SYSTEM_CONSTANT "ASMOD_TINDAIRREF_MAP_X" "10"
 SYSTEM_CONSTANT "ASMOD_TINDAIRREF_MAP_Y" "10"
 SYSTEM_CONSTANT "ASMOD_TINDMNFDSDIFF_MAX" "100"
 SYSTEM_CONSTANT "ASMOD_TINDMNFDSDIFF_MIN" "-100"
 SYSTEM_CONSTANT "ASMOD_TINIT_MAX" "90"
 SYSTEM_CONSTANT "ASMOD_TINIT_MIN" "-30"
 SYSTEM_CONSTANT "ASMOD_TINI_MAX" "90"
 SYSTEM_CONSTANT "ASMOD_TINI_MIN" "-40"
 SYSTEM_CONSTANT "ASMOD_TINTMNFDSEGRREF_MAP_X" "10"
 SYSTEM_CONSTANT "ASMOD_TINTMNFDSEGRREF_MAP_Y" "10"
 SYSTEM_CONSTANT "ASMOD_TINTMNFDSEGRREF_MAX" "400"
 SYSTEM_CONSTANT "ASMOD_TINTMNFDSEGRREF_MIN" "-50"
 SYSTEM_CONSTANT "ASMOD_TINTMNFDSREF_MAP_X" "10"
 SYSTEM_CONSTANT "ASMOD_TINTMNFDSREF_MAP_Y" "10"
 SYSTEM_CONSTANT "ASMOD_TINTMNFDSREF_MAX" "100"
 SYSTEM_CONSTANT "ASMOD_TINTMNFDSREF_MIN" "-50"
 SYSTEM_CONSTANT "ASMOD_TINTMNF_MAX_FL" "400"
 SYSTEM_CONSTANT "ASMOD_TINTMNF_MIN_FL" "-50"
 SYSTEM_CONSTANT "ASMOD_TIOXICPT1EOM_CUR_X" "8"
 SYSTEM_CONSTANT "ASMOD_TIPFLTPT1_MAX" "15"
 SYSTEM_CONSTANT "ASMOD_TIPFLTPT1_MIN" "0.001"
 SYSTEM_CONSTANT "ASMOD_TIPT1PINTMNF_CUR_X" "4"
 SYSTEM_CONSTANT "ASMOD_TIPT1_MAX" "5"
 SYSTEM_CONSTANT "ASMOD_TIPT1_MIN" "0.05"
 SYSTEM_CONSTANT "ASMOD_TIRELPOSPT1_MAX" "1"
 SYSTEM_CONSTANT "ASMOD_TIRELPOSPT1_MIN" "0.01"
 SYSTEM_CONSTANT "ASMOD_TIRELPOS_MAX" "1"
 SYSTEM_CONSTANT "ASMOD_TIRELPOS_MIN" "2e-006"
 SYSTEM_CONSTANT "ASMOD_TISTPDELVAL_CUR_X" "10"
 SYSTEM_CONSTANT "ASMOD_TISTPDELVAL_MAX" "655"
 SYSTEM_CONSTANT "ASMOD_TISTPDELVAL_MIN" "0"
 SYSTEM_CONSTANT "ASMOD_TISWTSOTRMDEL_MAX" "120"
 SYSTEM_CONSTANT "ASMOD_TISWTSOTRMDEL_MIN" "0"
 SYSTEM_CONSTANT "ASMOD_TITEMPEGRDSPT1_MAX" "1"
 SYSTEM_CONSTANT "ASMOD_TITRBNPT1_MAX" "4000"
 SYSTEM_CONSTANT "ASMOD_TITRBNPT1_MIN" "0.001"
 SYSTEM_CONSTANT "ASMOD_TLPTRBNDYNCOR_MAP_X" "4"
 SYSTEM_CONSTANT "ASMOD_TLPTRBNDYNCOR_MAP_Y" "4"
 SYSTEM_CONSTANT "ASMOD_TLPTRBNTEMPCOR_MAP_X" "4"
 SYSTEM_CONSTANT "ASMOD_TLPTRBNTEMPCOR_MAP_Y" "4"
 SYSTEM_CONSTANT "ASMOD_TMIXPNTEG_MAX" "1000"
 SYSTEM_CONSTANT "ASMOD_TMIXPNTEG_MAX_FL" "1000"
 SYSTEM_CONSTANT "ASMOD_TMIXPNTEG_MIN" "0"
 SYSTEM_CONSTANT "ASMOD_TMIXPNTEG_MIN_FL" "0"
 SYSTEM_CONSTANT "ASMOD_TNSCEXOINCR_MAP_X" "8"
 SYSTEM_CONSTANT "ASMOD_TNSCEXOINCR_MAP_Y" "8"
 SYSTEM_CONSTANT "ASMOD_TNSCSPCHTBRICK_MAX" "1500"
 SYSTEM_CONSTANT "ASMOD_TNSCSPCHTBRICK_MIN" "-100"
 SYSTEM_CONSTANT "ASMOD_TOXICDFL_MAX" "1000"
 SYSTEM_CONSTANT "ASMOD_TOXICDFL_MIN" "-30"
 SYSTEM_CONSTANT "ASMOD_TOXICEXOINCR_MAP_X" "6"
 SYSTEM_CONSTANT "ASMOD_TOXICEXOINCR_MAP_Y" "6"
 SYSTEM_CONSTANT "ASMOD_TOXICUS_MAX" "1000"
 SYSTEM_CONSTANT "ASMOD_TOXICUS_MIN" "-30"
 SYSTEM_CONSTANT "ASMOD_TPARNSC_AXIS_X" "2"
 SYSTEM_CONSTANT "ASMOD_TPFLTDIFFCORR_MAX" "1000"
 SYSTEM_CONSTANT "ASMOD_TPFLTDIFFCORR_MIN" "500"
 SYSTEM_CONSTANT "ASMOD_TPFLTUS_MAX" "1000"
 SYSTEM_CONSTANT "ASMOD_TPFLTUS_MIN" "-30"
 SYSTEM_CONSTANT "ASMOD_TPIPEDFL_MAX" "1000"
 SYSTEM_CONSTANT "ASMOD_TPIPEDFL_MIN" "-30"
 SYSTEM_CONSTANT "ASMOD_TRQINRSET_MAX" "35"
 SYSTEM_CONSTANT "ASMOD_TRQINRSET_MIN" "0"
 SYSTEM_CONSTANT "ASMOD_TSTRTDFL_MAX" "1000"
 SYSTEM_CONSTANT "ASMOD_TSTRTDFL_MIN" "-40"
 SYSTEM_CONSTANT "ASMOD_TTRBNDDRAWDFL_MAX" "1000"
 SYSTEM_CONSTANT "ASMOD_TTRBNDDRAWDFL_MIN" "-30"
 SYSTEM_CONSTANT "ASMOD_TTRBNDS_MAX_FL" "500"
 SYSTEM_CONSTANT "ASMOD_TTRBNDS_MIN_FL" "-50"
 SYSTEM_CONSTANT "ASMOD_TTRBNDYNCORR_MAP_X" "8"
 SYSTEM_CONSTANT "ASMOD_TTRBNDYNCORR_MAP_Y" "8"
 SYSTEM_CONSTANT "ASMOD_TTRBNDYNCOR_MAP_X" "8"
 SYSTEM_CONSTANT "ASMOD_TTRBNDYNCOR_MAP_Y" "8"
 SYSTEM_CONSTANT "ASMOD_TTRBNTEMPCOR_MAP_X" "4"
 SYSTEM_CONSTANT "ASMOD_TTRBNTEMPCOR_MAP_Y" "4"
 SYSTEM_CONSTANT "ASMOD_TWALLPIPEDFL_MAX" "1000"
 SYSTEM_CONSTANT "ASMOD_TWALLPIPEDFL_MIN" "-30"
 SYSTEM_CONSTANT "ASMOD_TWO_R32" "2"
 SYSTEM_CONSTANT "ASMOD_VEGNSCBRICK_MAX" "400"
 SYSTEM_CONSTANT "ASMOD_VEGNSCBRICK_MIN" "5"
 SYSTEM_CONSTANT "ASMOD_VEGNSC_CONST" "1000"
 SYSTEM_CONSTANT "ASMOD_VEHV_MAX" "200"
 SYSTEM_CONSTANT "ASMOD_VEHV_MIN" "0"
 SYSTEM_CONSTANT "ASMOD_VOLENG_MAX" "20"
 SYSTEM_CONSTANT "ASMOD_VOLENG_MIN" "0"
 SYSTEM_CONSTANT "ASMOD_VOLEXHMNFLP_MAX_FL" "50"
 SYSTEM_CONSTANT "ASMOD_VOLEXHMNFLP_MIN_FL" "0"
 SYSTEM_CONSTANT "ASMOD_VOLINDVOL_MAX_FL" "50"
 SYSTEM_CONSTANT "ASMOD_VOLINDVOL_MIN_FL" "0"
 SYSTEM_CONSTANT "ASMOD_VOLINTMNF_MAX_FL" "5"
 SYSTEM_CONSTANT "ASMOD_VOLINTMNF_MIN_FL" "0"
 SYSTEM_CONSTANT "ASMOD_VOLNSCBRICK_MAX" "0.01"
 SYSTEM_CONSTANT "ASMOD_VOLNSCBRICK_MIN" "0.0001"
 SYSTEM_CONSTANT "ASMOD_VOL_NORM" "666.666666666667"
 SYSTEM_CONSTANT "ASMOD_VRECOR_MAX" "183"
 SYSTEM_CONSTANT "ASMOD_VRECOR_MIN" "0"
 SYSTEM_CONSTANT "ASMOD_VSCDYNOFS_MAX" "0.02"
 SYSTEM_CONSTANT "ASMOD_VSCDYNOFS_MIN" "-0.03"
 SYSTEM_CONSTANT "ASMOD_VSCDYN_RES" "12207.03125"
 SYSTEM_CONSTANT "ASMOD_VSCKINOFS_MAX" "-7e-006"
 SYSTEM_CONSTANT "ASMOD_VSCKINOFS_MIN" "-6e-005"
 SYSTEM_CONSTANT "ASMOD_VSCKIN_RES" "1000"
 SYSTEM_CONSTANT "ASMOD_WOXICO_CUR_X" "11"
 SYSTEM_CONSTANT "ASMOD_WOXICO_MAX" "300000"
 SYSTEM_CONSTANT "ASMOD_WOXICO_MIN" "200000"
 SYSTEM_CONSTANT "ASMOD_WREACACTV_MAX" "65534"
 SYSTEM_CONSTANT "ASMOD_WREACACTV_MIN" "0"
 SYSTEM_CONSTANT "ASTINTVENG_NO" "0"
 SYSTEM_CONSTANT "ASTINTVENG_SY" "0"
 SYSTEM_CONSTANT "AVPT_RES" "0.1"
 SYSTEM_CONSTANT "AVPT_RES_REV" "10"
 SYSTEM_CONSTANT "Avs_NumAdjVal_SY" "64"
 SYSTEM_CONSTANT "BANK1" "0"
 SYSTEM_CONSTANT "BANK1_SY" "0"
 SYSTEM_CONSTANT "BANK2" "1"
 SYSTEM_CONSTANT "BANK2_SY" "1"
 SYSTEM_CONSTANT "BATTCD_ULIN_CUR_X" "25"
 SYSTEM_CONSTANT "BATTU_VOLT_MIN" "0"
 SYSTEM_CONSTANT "BATTU_ZERO_VOLT" "0"
 SYSTEM_CONSTANT "BPACD_DCYCCONV_CUR_X" "25"
 SYSTEM_CONSTANT "BPSCD_PLIN_CUR_X" "25"
 SYSTEM_CONSTANT "BRKPED_ACTV" "3"
 SYSTEM_CONSTANT "BRKPED_INACTV" "0"
 SYSTEM_CONSTANT "BRKPED_PSBLACTV" "1"
 SYSTEM_CONSTANT "BRKP_PRESS_DFL" "0"
 SYSTEM_CONSTANT "CALORIFIC_VALUE" "42.5"
 SYSTEM_CONSTANT "CALORY_ASMOD_RES" "20"
 SYSTEM_CONSTANT "CALORY_RES" "1"
 SYSTEM_CONSTANT "CALORY_RES_REV" "1"
 SYSTEM_CONSTANT "CAP_PA_MAX" "8"
 SYSTEM_CONSTANT "CAP_PA_MIN" "0"
 SYSTEM_CONSTANT "CAP_PA_RES" "0.001"
 SYSTEM_CONSTANT "CAP_PA_ZERO" "0"
 SYSTEM_CONSTANT "CASCD_FACPLAUSHIGH_CUR_X" "12"
 SYSTEM_CONSTANT "CASCD_FACPLAUSLOW_CUR_X" "12"
 SYSTEM_CONSTANT "CASTYP_SY" "0"
 SYSTEM_CONSTANT "CAS_ADAP_SY" "1"
 SYSTEM_CONSTANT "CAS_FAC_ADAP_SY" "1000"
 SYSTEM_CONSTANT "CAS_FAC_PLAUS_SY" "1000"
 SYSTEM_CONSTANT "CAS_MAX" "3"
 SYSTEM_CONSTANT "CAS_MOUNTCHK_SY" "0"
 SYSTEM_CONSTANT "CBYVLV_ATSINTVMOD_SY" "0"
 SYSTEM_CONSTANT "CHG2W_PA_FAC" "1000"
 SYSTEM_CONSTANT "CHG_PA_MAX" "3000"
 SYSTEM_CONSTANT "CHG_PA_MIN" "-3000"
 SYSTEM_CONSTANT "CHG_PA_RES" "1"
 SYSTEM_CONSTANT "CHG_PA_ZERO" "0"
 SYSTEM_CONSTANT "CHKPNTWORD_NUM" "2"
 SYSTEM_CONSTANT "CLG_TIMAXDYNTST_CUR_X" "10"
 SYSTEM_CONSTANT "CMBCHB_CONST" "1000"
 SYSTEM_CONSTANT "CMBCHB_CT_ZERO" "0"
 SYSTEM_CONSTANT "CMBCHB_DISABLED" "0"
 SYSTEM_CONSTANT "CMBCHB_DIS_MISF_REC" "0"
 SYSTEM_CONSTANT "CMBCHB_DN_ZERO" "0"
 SYSTEM_CONSTANT "CMBCHB_ENABLED" "3"
 SYSTEM_CONSTANT "CMBCHB_EN_MISF_REC" "1"
 SYSTEM_CONSTANT "CMBCHB_MISF_NR_DFCS" "6"
 SYSTEM_CONSTANT "CMBCHB_NOT_PRESSED" "2"
 SYSTEM_CONSTANT "CMBCHB_ONERPM_SY" "1"
 SYSTEM_CONSTANT "CMBCHB_PHIMAX_SY" "720"
 SYSTEM_CONSTANT "CMBCHB_PRESSED" "1"
 SYSTEM_CONSTANT "CMBTYP_DS" "0"
 SYSTEM_CONSTANT "CMBTYP_GS" "1"
 SYSTEM_CONSTANT "CMBTYP_SY" "0"
 SYSTEM_CONSTANT "CnvAngleByNToInjTime" "18310.5468750045"
 SYSTEM_CONSTANT "CNVTCOEFFCATAIR_RES" "0.02"
 SYSTEM_CONSTANT "CNVTCOEFFCATAIR_RES_FL" "0.02"
 SYSTEM_CONSTANT "COEFFA_MAX" "159.9951171875"
 SYSTEM_CONSTANT "COEFFA_MIN" "0"
 SYSTEM_CONSTANT "COEFFA_RES" "0.0048828125"
 SYSTEM_CONSTANT "COENG_GLWCTLTIMEMS_2_TIMEMS_CNV" "10"
 SYSTEM_CONSTANT "COENG_STSHOFFIMMO" "7"
 SYSTEM_CONSTANT "COEOMSWT_RES" "6.103515625e-008"
 SYSTEM_CONSTANT "COEOMSWT_RES_S16" "6.103515625e-005"
 SYSTEM_CONSTANT "COEOM_AIRCTLQNTNUMMAP_SY" "3"
 SYSTEM_CONSTANT "COEOM_AIRCTLTRQNUMMAP_SY" "0"
 SYSTEM_CONSTANT "COEOM_EGRCLGQNTNUMMAP_SY" "2"
 SYSTEM_CONSTANT "COEOM_EGRCLGTRQNUMMAP_SY" "2"
 SYSTEM_CONSTANT "COEOM_INJCRVMI1NUMMAP_SY" "2"
 SYSTEM_CONSTANT "COEOM_INJCRVMI1NUMSWTDES_SY" "2"
 SYSTEM_CONSTANT "COEOM_INJCRVPII1NUMMAP_SY" "2"
 SYSTEM_CONSTANT "COEOM_INJCRVPII1NUMSWTDES_SY" "2"
 SYSTEM_CONSTANT "COEOM_INJCRVPII2NUMMAP_SY" "2"
 SYSTEM_CONSTANT "COEOM_INJCRVPII2NUMSWTDES_SY" "2"
 SYSTEM_CONSTANT "COEOM_INJCRVPII3NUMMAP_SY" "2"
 SYSTEM_CONSTANT "COEOM_INJCRVPIIRLSNUMMAP_SY" "2"
 SYSTEM_CONSTANT "COEOM_INJCRVPOI1NUMMAP_SY" "2"
 SYSTEM_CONSTANT "COEOM_INJCRVPOI1NUMSWTDES_SY" "2"
 SYSTEM_CONSTANT "COEOM_INJCRVPOI2NUMMAP_SY" "2"
 SYSTEM_CONSTANT "COEOM_INJCRVPOI2NUMSWTDES_SY" "2"
 SYSTEM_CONSTANT "COEOM_MAX_OPMODE_BP" "2"
 SYSTEM_CONSTANT "COEOM_MAX_STAGE_NUM" "11"
 SYSTEM_CONSTANT "COEOM_NUMPCRDESMON_SY" "2"
 SYSTEM_CONSTANT "COEOM_NUMRGNMAX_SY" "7"
 SYSTEM_CONSTANT "COEOM_NUM_MAX_OPMODE" "3"
 SYSTEM_CONSTANT "COEOM_NUM_MAX_STAGE" "7"
 SYSTEM_CONSTANT "COEOM_NUM_OPMODE_MAX" "16"
 SYSTEM_CONSTANT "COEOM_NUM_OPMODE_REQ" "8"
 SYSTEM_CONSTANT "COEOM_OPMODE_MAX_BP" "15"
 SYSTEM_CONSTANT "COEOM_OPMODE_REQ_NUM" "5"
 SYSTEM_CONSTANT "COEOM_PCRCTLAUTLPQNTNUMMAP_SY" "1"
 SYSTEM_CONSTANT "COEOM_PCRCTLAUTLPTRQNUMMAP_SY" "0"
 SYSTEM_CONSTANT "COEOM_PCRCTLLPQNTNUMMAP_SY" "1"
 SYSTEM_CONSTANT "COEOM_PCRCTLLPTRQNUMMAP_SY" "0"
 SYSTEM_CONSTANT "COEOM_PCRQNTNUMMAP_SY" "2"
 SYSTEM_CONSTANT "COEOM_PCRTRQNUMMAP_SY" "0"
 SYSTEM_CONSTANT "COEOM_RAILNUMMAP_SY" "2"
 SYSTEM_CONSTANT "COEOM_RAILNUMSWTDES_SY" "2"
 SYSTEM_CONSTANT "COEOM_RMP_MAX" "1"
 SYSTEM_CONSTANT "COEOM_RMP_MAX_S16" "1"
 SYSTEM_CONSTANT "COEOM_RMP_MIN" "0"
 SYSTEM_CONSTANT "COEOM_SWT_FACT" "16384000"
 SYSTEM_CONSTANT "COEOM_SWT_FACT_S16" "16384"
 SYSTEM_CONSTANT "COEOM_SWT_NRM_EXP" "14"
 SYSTEM_CONSTANT "COEOM_TRANS_ARRAY_SIZE" "9"
 SYSTEM_CONSTANT "COEOM_TRANS_INL1" "1"
 SYSTEM_CONSTANT "COEOM_TRANS_INL2" "0"
 SYSTEM_CONSTANT "COEOM_TRANS_INL3" "0"
 SYSTEM_CONSTANT "COEOM_TRANS_INL4" "1"
 SYSTEM_CONSTANT "COEOM_TRANS_INL5" "1"
 SYSTEM_CONSTANT "COEOM_TRANS_INL6" "1"
 SYSTEM_CONSTANT "COEOM_TRANS_INL7" "0"
 SYSTEM_CONSTANT "COEOM_TRANS_INL8" "0"
 SYSTEM_CONSTANT "COEOM_TYP_SY" "1"
 SYSTEM_CONSTANT "COEOM_VSWCTLQNTNUMMAP_SY" "1"
 SYSTEM_CONSTANT "COEOM_VSWCTLTRQNUMMAP_SY" "0"
 SYSTEM_CONSTANT "COMPACCPED_OFF" "0"
 SYSTEM_CONSTANT "COMPACCPED_ON" "1"
 SYSTEM_CONSTANT "COMPACCPED_SY" "1"
 SYSTEM_CONSTANT "COMPT_RES" "0.05"
 SYSTEM_CONSTANT "COM_STCLTH_ENG" "3"
 SYSTEM_CONSTANT "COM_TRQLOSDFLT_MAP_X" "6"
 SYSTEM_CONSTANT "COM_TRQLOSDFLT_MAP_Y" "6"
 SYSTEM_CONSTANT "CONV_CALC_BP" "7"
 SYSTEM_CONSTANT "CONV_CONVACTV_BP" "0"
 SYSTEM_CONSTANT "CONV_GEAROFF_BP" "3"
 SYSTEM_CONSTANT "CONV_HR2SEC" "36"
 SYSTEM_CONSTANT "CONV_KD_16_TO_KD_32" "2.00006103701895"
 SYSTEM_CONSTANT "CONV_NTRBNCAN_BP" "1"
 SYSTEM_CONSTANT "CONV_RAT2PRC" "10000"
 SYSTEM_CONSTANT "CONV_RPM_RES" "100"
 SYSTEM_CONSTANT "CONV_T1_16_2_TO_1_T1_32" "70367"
 SYSTEM_CONSTANT "CONV_T1_16_TO_1_T1_32" "28146638.6776064"
 SYSTEM_CONSTANT "CONV_T1_16_TO_T1_32" "7036659"
 SYSTEM_CONSTANT "CONV_TOIL_BP" "2"
 SYSTEM_CONSTANT "CONV_TRQLDCAN_BP" "0"
 SYSTEM_CONSTANT "CONV_TRQLDFLT_BP" "4"
 SYSTEM_CONSTANT "CONV_TRQRESVBRKEND_BP" "6"
 SYSTEM_CONSTANT "CONV_TRQRESVLVROFF_BP" "5"
 SYSTEM_CONSTANT "COPT_STNSETP_ACS_FLT" "0"
 SYSTEM_CONSTANT "COPT_STNSETP_ACS_TIPIN" "2"
 SYSTEM_CONSTANT "COPT_STNSETP_ACS_UNFLT" "1"
 SYSTEM_CONSTANT "COPT_STNSETP_SYSERR_FLT" "0"
 SYSTEM_CONSTANT "COPT_STNSETP_SYSERR_TIPIN" "2"
 SYSTEM_CONSTANT "COPT_STNSETP_SYSERR_UNFLT" "1"
 SYSTEM_CONSTANT "COPT_STNSETP_TRA_FLT" "0"
 SYSTEM_CONSTANT "COPT_STNSETP_TRA_TIPIN" "2"
 SYSTEM_CONSTANT "COPT_STNSETP_TRA_UNFLT" "1"
 SYSTEM_CONSTANT "COPT_TRADEC_BP" "2"
 SYSTEM_CONSTANT "COPT_TRAINC_BP" "1"
 SYSTEM_CONSTANT "COPT_TRAPRT_BP" "0"
 SYSTEM_CONSTANT "COTEMP_RCLGDES_CUR_X" "5"
 SYSTEM_CONSTANT "COTEMP_TENGDESBASENTRQ_MAP_X" "2"
 SYSTEM_CONSTANT "COTEMP_TENGDESBASENTRQ_MAP_Y" "2"
 SYSTEM_CONSTANT "COTEMP_TENGDESBASETEMPVEL_MAP_X" "2"
 SYSTEM_CONSTANT "COTEMP_TENGDESBASETEMPVEL_MAP_Y" "2"
 SYSTEM_CONSTANT "COVEH_TRQLIM_CUR_X" "25"
 SYSTEM_CONSTANT "COVMD_ACCI" "2"
 SYSTEM_CONSTANT "COVMD_CRCTL" "1"
 SYSTEM_CONSTANT "CPPFEAT_FACT" "1256.637061436"
 SYSTEM_CONSTANT "CPP_ANGLE1_POSTTDC" "-150"
 SYSTEM_CONSTANT "CPP_ANGLE2_POSTTDC" "-5"
 SYSTEM_CONSTANT "CPP_ANGLE_MAX" "-179"
 SYSTEM_CONSTANT "CPP_ANGLE_MIN" "180"
 SYSTEM_CONSTANT "CPP_ANGLE_ZERO" "0"
 SYSTEM_CONSTANT "CPP_FACT" "1024"
 SYSTEM_CONSTANT "CPP_FACT1" "16"
 SYSTEM_CONSTANT "CPP_FACT1_EXP" "4"
 SYSTEM_CONSTANT "CPP_FACT_EXP" "10"
 SYSTEM_CONSTANT "CPP_FAC_VOL_CYL_RES" "3.0517578125e-005"
 SYSTEM_CONSTANT "CPP_FAC_VOL_CYL_RES_REV" "32768"
 SYSTEM_CONSTANT "CPP_HTRLSRATE_ANGLE_OFS" "175"
 SYSTEM_CONSTANT "CPP_HTRLS_ANGLE_OFS" "174"
 SYSTEM_CONSTANT "CPP_HT_RLS_OFS" "-6"
 SYSTEM_CONSTANT "CPP_HT_RLS_RATE_FLT_OFS" "-5"
 SYSTEM_CONSTANT "CPP_HT_RLS_RATE_FLT_ORD_MAX" "4"
 SYSTEM_CONSTANT "CPP_HT_RLS_RATE_OFS" "-1"
 SYSTEM_CONSTANT "CPP_MAX_FLT_ORD" "32"
 SYSTEM_CONSTANT "CPP_NUMCYLMAX_SY" "6"
 SYSTEM_CONSTANT "CPP_OFS_FACT_RES" "0.00390625"
 SYSTEM_CONSTANT "CPP_OFS_FACT_RES_REV" "256"
 SYSTEM_CONSTANT "CPP_PRESCALC_CUR_SIZE" "33"
 SYSTEM_CONSTANT "CPP_PRESCALC_EXP" "5"
 SYSTEM_CONSTANT "CPP_PRESCALC_EXP1" "7"
 SYSTEM_CONSTANT "CRCTL_AMAXFLTRMP_SY" "1"
 SYSTEM_CONSTANT "CRCTL_DVACCG3_CUR_X" "5"
 SYSTEM_CONSTANT "CRCTL_DVACCG4_CUR_X" "5"
 SYSTEM_CONSTANT "CRCTL_DVACCG5_CUR_X" "5"
 SYSTEM_CONSTANT "CRCTL_DVACCG6_CUR_X" "5"
 SYSTEM_CONSTANT "CRCTL_DVDECLG3_CUR_X" "5"
 SYSTEM_CONSTANT "CRCTL_DVDECLG4_CUR_X" "5"
 SYSTEM_CONSTANT "CRCTL_DVDECLG5_CUR_X" "5"
 SYSTEM_CONSTANT "CRCTL_DVDECLG6_CUR_X" "5"
 SYSTEM_CONSTANT "CRCTL_DVRESABVG3_MAP_X" "2"
 SYSTEM_CONSTANT "CRCTL_DVRESABVG3_MAP_Y" "2"
 SYSTEM_CONSTANT "CRCTL_DVRESABVG4_MAP_X" "2"
 SYSTEM_CONSTANT "CRCTL_DVRESABVG4_MAP_Y" "2"
 SYSTEM_CONSTANT "CRCTL_DVRESABVG5_MAP_X" "2"
 SYSTEM_CONSTANT "CRCTL_DVRESABVG5_MAP_Y" "2"
 SYSTEM_CONSTANT "CRCTL_DVRESABVG6_MAP_X" "2"
 SYSTEM_CONSTANT "CRCTL_DVRESABVG6_MAP_Y" "2"
 SYSTEM_CONSTANT "CRCTL_DVRESBLWG3_MAP_X" "2"
 SYSTEM_CONSTANT "CRCTL_DVRESBLWG3_MAP_Y" "2"
 SYSTEM_CONSTANT "CRCTL_DVRESBLWG4_MAP_X" "2"
 SYSTEM_CONSTANT "CRCTL_DVRESBLWG4_MAP_Y" "2"
 SYSTEM_CONSTANT "CRCTL_DVRESBLWG5_MAP_X" "2"
 SYSTEM_CONSTANT "CRCTL_DVRESBLWG5_MAP_Y" "2"
 SYSTEM_CONSTANT "CRCTL_DVRESBLWG6_MAP_X" "2"
 SYSTEM_CONSTANT "CRCTL_DVRESBLWG6_MAP_Y" "2"
 SYSTEM_CONSTANT "CRCTL_TIDEBPTD_SY" "60"
 SYSTEM_CONSTANT "CRSCD_FACGAPPLAUSHIGH_CUR_X" "10"
 SYSTEM_CONSTANT "CRSCD_FACGAPPLAUSLOW_CUR_X" "10"
 SYSTEM_CONSTANT "CRSCD_FACINCPLAUSHIGH_CUR_X" "10"
 SYSTEM_CONSTANT "CRSCD_FACINCPLAUSLOW_CUR_X" "10"
 SYSTEM_CONSTANT "CRSCD_PHIINCCOR_CUR_X" "12"
 SYSTEM_CONSTANT "CRSSENSTYP_SY" "1"
 SYSTEM_CONSTANT "CRS_TO_CAS" "2"
 SYSTEM_CONSTANT "CTHMST_ATSINTVMOD_SY" "0"
 SYSTEM_CONSTANT "CTL_NEG" "3"
 SYSTEM_CONSTANT "CTL_POS" "2"
 SYSTEM_CONSTANT "CTL_ZFC" "6"
 SYSTEM_CONSTANT "CTSCD_TLIN_CUR_X" "25"
 SYSTEM_CONSTANT "CURR_A_RES" "0.01"
 SYSTEM_CONSTANT "CURR_PA_MAX" "30000"
 SYSTEM_CONSTANT "CURR_PA_MIN" "-30000"
 SYSTEM_CONSTANT "CURR_PA_ZERO" "0"
 SYSTEM_CONSTANT "CURR_RES" "1"
 SYSTEM_CONSTANT "CURR_RMP_RES_SY" "6553.6"
 SYSTEM_CONSTANT "CYLFLTPRM_REC_NRM_EXP" "15"
 SYSTEM_CONSTANT "CYLFLTPRM_REC_RES" "32767"
 SYSTEM_CONSTANT "CYLHTRLSRATE_NRM_EXP" "6"
 SYSTEM_CONSTANT "CYLHTRLSRATE_RES" "0.015625"
 SYSTEM_CONSTANT "CYLHTRLSRATE_RES_REV" "64"
 SYSTEM_CONSTANT "CYLHTRLS_NRM_EXP" "2"
 SYSTEM_CONSTANT "CYLHTRLS_RES" "0.25"
 SYSTEM_CONSTANT "CYLHTRLS_RES_REV" "4"
 SYSTEM_CONSTANT "CYLINDER_VOLUME_RES" "1e-006"
 SYSTEM_CONSTANT "CYLK1_RES" "0.0078125"
 SYSTEM_CONSTANT "CYLK1_RES_REV" "128"
 SYSTEM_CONSTANT "CYLK2_REC_NRM_EXP" "14"
 SYSTEM_CONSTANT "CYLK2_REC_RES" "16384"
 SYSTEM_CONSTANT "CYLPRESVOLT_RES" "0.805860805860806"
 SYSTEM_CONSTANT "CYLPRES_HTRLSRATE_CONV" "200"
 SYSTEM_CONSTANT "CYLPRES_K2_HTRLSRATE_CONV" "3276800"
 SYSTEM_CONSTANT "CYLPRES_RES" "0.01"
 SYSTEM_CONSTANT "CYLPRES_RES_REV" "100"
 SYSTEM_CONSTANT "CYL_FAC_NORM" "33333"
 SYSTEM_CONSTANT "CYL_MAX" "6"
 SYSTEM_CONSTANT "DCSOVRDSDFFTLPRT_SY" "0"
 SYSTEM_CONSTANT "DCSOVRDSENGPRT_SY" "0"
 SYSTEM_CONSTANT "DCSOVRDSTRAPRT_SY" "0"
 SYSTEM_CONSTANT "DCSOVRDSTSCDEC_SY" "0"
 SYSTEM_CONSTANT "DCS_OVRDS_DFFTLPRT" "1"
 SYSTEM_CONSTANT "DCS_OVRDS_ENGPRT" "1"
 SYSTEM_CONSTANT "DCS_OVRDS_TRAPRT" "1"
 SYSTEM_CONSTANT "DCS_OVRDS_TSCDEC" "1"
 SYSTEM_CONSTANT "DDVOL_RES" "10"
 SYSTEM_CONSTANT "DELAY" "5"
 SYSTEM_CONSTANT "DELTA_PRES_FAC" "250000"
 SYSTEM_CONSTANT "DELTA_P_PER_TIME_NBR" "5"
 SYSTEM_CONSTANT "DENSFINE_RES" "0.002"
 SYSTEM_CONSTANT "DENSFINE_RES_FL" "0.002"
 SYSTEM_CONSTANT "DENSFINE_RES_REV" "500"
 SYSTEM_CONSTANT "DENSFINE_TEMP2PRES" "5000000"
 SYSTEM_CONSTANT "DENS_RES" "0.1"
 SYSTEM_CONSTANT "DENS_RES_FL" "0.1"
 SYSTEM_CONSTANT "DEVLIB_4WINDIACMPNENA_SY" "1"
 SYSTEM_CONSTANT "DEVLIB_4WINDIA_TYP_CTLLN" "0"
 SYSTEM_CONSTANT "DEVLIB_4WINDIA_TYP_DIGIN" "1"
 SYSTEM_CONSTANT "DEVLIB_4WINDIA_TYP_EXT" "2"
 SYSTEM_CONSTANT "DEVLIB_4WINDIA_TYP_NONE" "3"
 SYSTEM_CONSTANT "DEVLIB_ACTRPRTCMPNENA_SY" "1"
 SYSTEM_CONSTANT "DEVLIB_DIACTLLINECMPNENA_SY" "0"
 SYSTEM_CONSTANT "DEVLIB_PHYSRNGCHK_SY" "0"
 SYSTEM_CONSTANT "DEWDET_WTHRESLSUAXISPNT0_MAP_X" "10"
 SYSTEM_CONSTANT "DEWDET_WTHRESLSUAXISPNT0_MAP_Y" "10"
 SYSTEM_CONSTANT "DEWDET_WTHRESLSUAXISPNT1_MAP_X" "10"
 SYSTEM_CONSTANT "DEWDET_WTHRESLSUAXISPNT1_MAP_Y" "10"
 SYSTEM_CONSTANT "DEWDET_WTHRESLSUAXISPNT2_MAP_X" "10"
 SYSTEM_CONSTANT "DEWDET_WTHRESLSUAXISPNT2_MAP_Y" "10"
 SYSTEM_CONSTANT "DEWDET_WTHRESLSUAXISPNT3_MAP_X" "10"
 SYSTEM_CONSTANT "DEWDET_WTHRESLSUAXISPNT3_MAP_Y" "10"
 SYSTEM_CONSTANT "DE_ATSINTVMOD_NOSHOFFBYP" "0"
 SYSTEM_CONSTANT "DE_ATSINTVMOD_SHOFFBYP" "1"
 SYSTEM_CONSTANT "DFES_COMMILDEB_SY" "0"
 SYSTEM_CONSTANT "DFES_EXTDFLT_SY" "0"
 SYSTEM_CONSTANT "DFES_IRV_SY" "0"
 SYSTEM_CONSTANT "DFES_MONITORING_LEN_SY" "2"
 SYSTEM_CONSTANT "DFES_SIMCOND_SY" "1"
 SYSTEM_CONSTANT "DFFTLPRTOVRDSTSCINC_SY" "1"
 SYSTEM_CONSTANT "DFFTLPRT_ACTV" "1"
 SYSTEM_CONSTANT "DFFTLPRT_INACTV" "0"
 SYSTEM_CONSTANT "DFFTLPRT_OVRDS_DCS" "0"
 SYSTEM_CONSTANT "DFFTLPRT_OVRDS_TSCINC" "1"
 SYSTEM_CONSTANT "DIADEM_ACTIVE" "1"
 SYSTEM_CONSTANT "DIADEM_EPM_N_ZERO" "0"
 SYSTEM_CONSTANT "DIADEM_NO_REQ" "0"
 SYSTEM_CONSTANT "DIADEM_OFFSET_INL" "20"
 SYSTEM_CONSTANT "DIADEM_RAMP" "19"
 SYSTEM_CONSTANT "DIADEM_RAMPHI_BP" "2"
 SYSTEM_CONSTANT "DIADEM_RAMPINLHI_BP" "2"
 SYSTEM_CONSTANT "DIADEM_RAMPINLLO_BP" "1"
 SYSTEM_CONSTANT "DIADEM_RAMPLO_BP" "1"
 SYSTEM_CONSTANT "DIADEM_ST_ACTV" "1"
 SYSTEM_CONSTANT "DIADEM_ST_INACTV" "0"
 SYSTEM_CONSTANT "DIADEM_ST_RAMPOUT" "2"
 SYSTEM_CONSTANT "DIADEM_ZERO_STATUS" "0"
 SYSTEM_CONSTANT "DIUMPR_500MD_SY" "0"
 SYSTEM_CONSTANT "DIUMPR_NUMRATCFG" "0"
 SYSTEM_CONSTANT "DIUMPR_NUMRATCLB" "20"
 SYSTEM_CONSTANT "DIUMPR_NUM_GROUPS_SY" "8"
 SYSTEM_CONSTANT "DIV_INJTIME_US" "2"
 SYSTEM_CONSTANT "DMFL_BRN_RESLO" "13793.1034482759"
 SYSTEM_CONSTANT "DMO2_RESLO" "20000"
 SYSTEM_CONSTANT "DM_NOX2SOOT" "15"
 SYSTEM_CONSTANT "DM_NOX_100" "100"
 SYSTEM_CONSTANT "DM_NOX_RES" "0.15"
 SYSTEM_CONSTANT "DM_NOX_RES_100" "15"
 SYSTEM_CONSTANT "DM_NOX_RES_REV" "6.66666666666667"
 SYSTEM_CONSTANT "DM_OILASH_RES" "0.01"
 SYSTEM_CONSTANT "DM_OILASH_RES_REV" "100"
 SYSTEM_CONSTANT "DM_SOOT_MAX" "327"
 SYSTEM_CONSTANT "DM_SOOT_MIN" "0"
 SYSTEM_CONSTANT "DM_SOOT_PPM_RES" "1"
 SYSTEM_CONSTANT "DM_SOOT_RES" "0.01"
 SYSTEM_CONSTANT "DM_SOOT_RES_REV" "100"
 SYSTEM_CONSTANT "DN_DZFINE_RES" "0.5"
 SYSTEM_CONSTANT "DPDIFFTMP_RES" "100"
 SYSTEM_CONSTANT "DPDIFF_RES" "0.1"
 SYSTEM_CONSTANT "DPRES_RES" "1"
 SYSTEM_CONSTANT "DRLAMREC_RES" "0.01"
 SYSTEM_CONSTANT "DRV_T15RST_SY" "0"
 SYSTEM_CONSTANT "DSCHED_DFCSPEC_SY" "0"
 SYSTEM_CONSTANT "DSCHED_FTI_SY" "0"
 SYSTEM_CONSTANT "DSCHED_RATECALC_SY" "0"
 SYSTEM_CONSTANT "DSCHED_WTT_SY" "0"
 SYSTEM_CONSTANT "DSMAUX_ROEBUFLEN" "3"
 SYSTEM_CONSTANT "DSMAUX_ROEBUFUSEENVRAM" "0"
 SYSTEM_CONSTANT "DSMAUX_TCSORT_SY" "0"
 SYSTEM_CONSTANT "DSMCONF_DTCTABLE_DTCM" "1"
 SYSTEM_CONSTANT "DSMCONF_DTCTABLE_DTCX" "0"
 SYSTEM_CONSTANT "DSMCONF_NUM_CLASSES" "30"
 SYSTEM_CONSTANT "DSMCONF_SUPGLBCTLMSK" "0"
 SYSTEM_CONSTANT "DSMCONF_SUPGLBDBLV" "0"
 SYSTEM_CONSTANT "DSMCONF_SUPGLBDISBLMSK" "0"
 SYSTEM_CONSTANT "DSMCONF_SUPGLBENVREF" "0"
 SYSTEM_CONSTANT "DSMCONF_SUPGLBFAULTTYP" "0"
 SYSTEM_CONSTANT "DSMCONF_SUPGLBFLTCLS" "0"
 SYSTEM_CONSTANT "DSMCONF_SUP_TNPSCPU" "0"
 SYSTEM_CONSTANT "DSMCONF_SUP_TNPSDTCC" "0"
 SYSTEM_CONSTANT "DSMRDY_ENVCOND_SUP" "0"
 SYSTEM_CONSTANT "DSMRDY_FIDINH_SUP" "0"
 SYSTEM_CONSTANT "DSMRDY_INHP41_SY" "0"
 SYSTEM_CONSTANT "DSMRDY_SIZE_LST_AC" "10"
 SYSTEM_CONSTANT "DSMRDY_SIZE_LST_Cat" "10"
 SYSTEM_CONSTANT "DSMRDY_SIZE_LST_ComprCmpnt" "100"
 SYSTEM_CONSTANT "DSMRDY_SIZE_LST_EGR" "30"
 SYSTEM_CONSTANT "DSMRDY_SIZE_LST_EvpSys" "10"
 SYSTEM_CONSTANT "DSMRDY_SIZE_LST_FlSys" "30"
 SYSTEM_CONSTANT "DSMRDY_SIZE_LST_HtCat" "10"
 SYSTEM_CONSTANT "DSMRDY_SIZE_LST_Misf" "10"
 SYSTEM_CONSTANT "DSMRDY_SIZE_LST_O2Sens" "10"
 SYSTEM_CONSTANT "DSMRDY_SIZE_LST_O2SensHt" "10"
 SYSTEM_CONSTANT "DSMRDY_SIZE_LST_SecAirSys" "10"
 SYSTEM_CONSTANT "DSM_CONF_SUP_DSMRDY_CT" "1"
 SYSTEM_CONSTANT "DSM_CONF_SUP_DSMRDY_XWHY" "1"
 SYSTEM_CONSTANT "DSM_NUMDFC" "965"
 SYSTEM_CONSTANT "DSM_NUMFID" "689"
 SYSTEM_CONSTANT "DSM_WUCDET_SY" "0"
 SYSTEM_CONSTANT "DT1INITI_ZERO_SY" "0"
 SYSTEM_CONSTANT "DT1INITO_ZERO_SY" "0"
 SYSTEM_CONSTANT "DTRQ_MAX" "2000"
 SYSTEM_CONSTANT "DTRQ_MIN" "-2000"
 SYSTEM_CONSTANT "DTRQ_RES" "0.1"
 SYSTEM_CONSTANT "DTRQ_ZERO" "0"
 SYSTEM_CONSTANT "DTR_LEGIFC_SY" "0"
 SYSTEM_CONSTANT "DTY_CYC_10" "10"
 SYSTEM_CONSTANT "DTY_CYC_100" "100"
 SYSTEM_CONSTANT "DTY_CYC_150" "1.5"
 SYSTEM_CONSTANT "DTY_CYC_25" "25"
 SYSTEM_CONSTANT "DTY_CYC_33" "33.33"
 SYSTEM_CONSTANT "DTY_CYC_5" "5"
 SYSTEM_CONSTANT "DTY_CYC_FAC" "1.95503421309873"
 SYSTEM_CONSTANT "DTY_CYC_MAX" "100"
 SYSTEM_CONSTANT "DTY_CYC_MIN" "0"
 SYSTEM_CONSTANT "DTY_CYC_RES" "0.01"
 SYSTEM_CONSTANT "DTY_CYC_RES_REV" "100"
 SYSTEM_CONSTANT "DT_KELV_RES" "0.1"
 SYSTEM_CONSTANT "DVOL_MAX" "3000"
 SYSTEM_CONSTANT "DVOL_MIN" "0"
 SYSTEM_CONSTANT "DVOL_RES" "0.1"
 SYSTEM_CONSTANT "DVOL_RES_FL" "0.1"
 SYSTEM_CONSTANT "DVOL_RES_INV" "10"
 SYSTEM_CONSTANT "DX_WAIT" "2"
 SYSTEM_CONSTANT "DYN_TST_TIME_FACT" "256"
 SYSTEM_CONSTANT "D_FLCONS_RES" "0.01"
 SYSTEM_CONSTANT "EATSCD_TLIN_CUR_X" "25"
 SYSTEM_CONSTANT "EBXFAN_ATSINTVMOD_SY" "0"
 SYSTEM_CONSTANT "ECBVLV_ATSINTVMOD_SY" "0"
 SYSTEM_CONSTANT "ECUNUM_SY" "1"
 SYSTEM_CONSTANT "ECUOFF_TMR_SY" "0"
 SYSTEM_CONSTANT "EGRCD_DCYCEGR_MAP_X" "16"
 SYSTEM_CONSTANT "EGRCD_DCYCEGR_MAP_Y" "16"
 SYSTEM_CONSTANT "EGRCLG_CLGOFF_CUR_X" "25"
 SYSTEM_CONSTANT "EGRCLG_CLGON_CUR_X" "25"
 SYSTEM_CONSTANT "EGRCLG_NUMSTPRIOMON" "3"
 SYSTEM_CONSTANT "EGRVLVHP" "0"
 SYSTEM_CONSTANT "EGRVLVHPLPCOMBO" "1"
 SYSTEM_CONSTANT "EGRVLVTYPE" "1"
 SYSTEM_CONSTANT "EGRVLV_RBELAIR_MAP_X" "5"
 SYSTEM_CONSTANT "EGRVLV_RBELAIR_MAP_Y" "5"
 SYSTEM_CONSTANT "EGRVLV_RBELCTL_MAP_X" "5"
 SYSTEM_CONSTANT "EGRVLV_RBELCTL_MAP_Y" "5"
 SYSTEM_CONSTANT "EGTFACT_RES" "0.001"
 SYSTEM_CONSTANT "EGTSWT_FACT" "16384000"
 SYSTEM_CONSTANT "EGTSWT_FACT_S16" "16384"
 SYSTEM_CONSTANT "EGTSWT_NRM_EXP" "14"
 SYSTEM_CONSTANT "EGTSWT_RES" "6.103515625e-008"
 SYSTEM_CONSTANT "EGTSWT_RES_S16" "6.103515625e-005"
 SYSTEM_CONSTANT "EGT_FACT" "0"
 SYSTEM_CONSTANT "EGT_FACTMAX" "1"
 SYSTEM_CONSTANT "EGT_LIMMAX" "1"
 SYSTEM_CONSTANT "EGT_LIMMIN" "-1"
 SYSTEM_CONSTANT "EGT_NUMRGNSTG" "2"
 SYSTEM_CONSTANT "EGT_STATE" "1"
 SYSTEM_CONSTANT "EGT_SWTRGN_VAL" "0"
 SYSTEM_CONSTANT "EGT_SWT_DISABLED" "0"
 SYSTEM_CONSTANT "EGT_SWT_ENABLED" "1"
 SYSTEM_CONSTANT "EGT_ZERO" "0"
 SYSTEM_CONSTANT "EISDEM_NSETPOINTINIT_CUR_X" "25"
 SYSTEM_CONSTANT "EISDEM_TIPT1_CUR_X" "25"
 SYSTEM_CONSTANT "EISDEM_TRQINITI_CUR_X" "25"
 SYSTEM_CONSTANT "EISGOV_TIPT1TRQFLT_CUR_X" "25"
 SYSTEM_CONSTANT "EMDMP_ATSINTVMOD_SY" "0"
 SYSTEM_CONSTANT "EMDMP_DIGOUT_SEL" "0"
 SYSTEM_CONSTANT "EMDMP_NUM_PS" "1"
 SYSTEM_CONSTANT "EMDMP_PWM_SEL" "1"
 SYSTEM_CONSTANT "EMDMP_SWTPWMORDIGOUT_SY" "1"
 SYSTEM_CONSTANT "ENERGYPERMOLHIGH_RES" "2"
 SYSTEM_CONSTANT "ENERGYPERMOLLOW_RES" "10"
 SYSTEM_CONSTANT "ENERGYPERMOLLOW_RES_FL" "10"
 SYSTEM_CONSTANT "ENERGY_RES" "1"
 SYSTEM_CONSTANT "ENGDA_CTFLD_NUM" "4"
 SYSTEM_CONSTANT "ENGDA_ENGOFFRSTDLY" "2000"
 SYSTEM_CONSTANT "ENGDA_ENGOFFRSTVAL" "1"
 SYSTEM_CONSTANT "ENGDA_TFLD_TCHAMWll_POS" "3"
 SYSTEM_CONSTANT "ENGDA_TFLD_TCLNT_POS" "0"
 SYSTEM_CONSTANT "ENGDA_TFLD_TENG_POS" "2"
 SYSTEM_CONSTANT "ENGDA_TFLD_TOIL_POS" "1"
 SYSTEM_CONSTANT "ENGDEM_RMP_ACTV_BP" "1"
 SYSTEM_CONSTANT "ENGDEM_RMP_POS_BP" "0"
 SYSTEM_CONSTANT "ENGDEM_TRQLIMERR_CUR_X" "25"
 SYSTEM_CONSTANT "ENGICO_COMFORT_MSK" "1"
 SYSTEM_CONSTANT "ENGM_NUMCYL_10" "10"
 SYSTEM_CONSTANT "ENGM_NUMCYL_3" "3"
 SYSTEM_CONSTANT "ENGM_NUMCYL_4" "4"
 SYSTEM_CONSTANT "ENGM_NUMCYL_5" "5"
 SYSTEM_CONSTANT "ENGM_NUMCYL_6" "6"
 SYSTEM_CONSTANT "ENGM_NUMCYL_8" "8"
 SYSTEM_CONSTANT "ENGM_SWTNUMCYL_TYPE" "0"
 SYSTEM_CONSTANT "ENGM_SWTNUMCYL_VAL" "6"
 SYSTEM_CONSTANT "ENGPRT_FACAPSPRV2_MAP_X" "9"
 SYSTEM_CONSTANT "ENGPRT_FACAPSPRV2_MAP_Y" "9"
 SYSTEM_CONSTANT "ENGPRT_FACAPSPRVEOM_MAP_X" "9"
 SYSTEM_CONSTANT "ENGPRT_FACAPSPRVEOM_MAP_Y" "9"
 SYSTEM_CONSTANT "ENGPRT_FACAPSPRV_MAP_X" "10"
 SYSTEM_CONSTANT "ENGPRT_FACAPSPRV_MAP_Y" "10"
 SYSTEM_CONSTANT "ENGPRT_FACOVHTPRTRMP_CUR_X" "8"
 SYSTEM_CONSTANT "ENGPRT_FACOVHTPRVTRAILER_MAP_X" "7"
 SYSTEM_CONSTANT "ENGPRT_FACOVHTPRVTRAILER_MAP_Y" "7"
 SYSTEM_CONSTANT "ENGPRT_FACOVHTPRV_MAP_X" "7"
 SYSTEM_CONSTANT "ENGPRT_FACOVHTPRV_MAP_Y" "7"
 SYSTEM_CONSTANT "ENGPRT_FACT31OVHT_MAP_X" "4"
 SYSTEM_CONSTANT "ENGPRT_FACT31OVHT_MAP_Y" "4"
 SYSTEM_CONSTANT "ENGPRT_FACTCACDSPRV_CUR_X" "8"
 SYSTEM_CONSTANT "ENGPRT_MON_OVRSPD_BP" "0"
 SYSTEM_CONSTANT "ENGPRT_NUMOVHTPRT" "1"
 SYSTEM_CONSTANT "ENGPRT_OVRDS_DCS" "0"
 SYSTEM_CONSTANT "ENGPRT_QLIM_CUR_X" "25"
 SYSTEM_CONSTANT "ENGPRT_TRQLIMDIFFOVHTMIN_MAP_X" "4"
 SYSTEM_CONSTANT "ENGPRT_TRQLIMDIFFOVHTMIN_MAP_Y" "4"
 SYSTEM_CONSTANT "ENGPRT_TRQLIM_CUR_X" "25"
 SYSTEM_CONSTANT "ENGPRT_TRQNLIMSPR_CUR_X" "25"
 SYSTEM_CONSTANT "ENGPRT_TRQNLIM_CUR_X" "25"
 SYSTEM_CONSTANT "ENGPRT_TT31PRTOFS_CUR_X" "4"
 SYSTEM_CONSTANT "ENGRESTRT_SY" "0"
 SYSTEM_CONSTANT "ENGSPDLIMSTRT_SY" "0"
 SYSTEM_CONSTANT "ENGSTA_ATSINTVMOD_SY" "1"
 SYSTEM_CONSTANT "ENGTRQPTD_40MS_MSK" "3"
 SYSTEM_CONSTANT "ENG_CTFLD_NUM" "3"
 SYSTEM_CONSTANT "ENG_DN_DT_RES" "0.5"
 SYSTEM_CONSTANT "ENG_DP_DT_RES" "0.5"
 SYSTEM_CONSTANT "ENG_N_HIRES" "0.03125"
 SYSTEM_CONSTANT "ENG_N_HIRES_EXP" "5"
 SYSTEM_CONSTANT "ENG_N_IDL_RES" "10"
 SYSTEM_CONSTANT "ENG_N_L_RES" "40"
 SYSTEM_CONSTANT "ENG_N_MAX" "10000"
 SYSTEM_CONSTANT "ENG_N_MIN" "20"
 SYSTEM_CONSTANT "ENG_N_RES" "0.5"
 SYSTEM_CONSTANT "ENG_N_RES1" "0.5"
 SYSTEM_CONSTANT "ENG_N_RES_FL" "0.5"
 SYSTEM_CONSTANT "ENG_N_RES_REV" "2"
 SYSTEM_CONSTANT "ENG_N_ZERO" "0"
 SYSTEM_CONSTANT "ENG_OFF" "0"
 SYSTEM_CONSTANT "ENG_ON" "1"
 SYSTEM_CONSTANT "ENRGPERMASS_RES" "0.1"
 SYSTEM_CONSTANT "ENVT_TAIRCORR_MAP_X" "8"
 SYSTEM_CONSTANT "ENVT_TAIRCORR_MAP_Y" "8"
 SYSTEM_CONSTANT "ENVT_TCLNTMOD_CUR_X" "8"
 SYSTEM_CONSTANT "EPMBCA_FACSEGTIMEACC_CURX" "3"
 SYSTEM_CONSTANT "EPMBCA_FAC_TSTINJ_SY" "1000"
 SYSTEM_CONSTANT "EPMBCR_DTINCSTRT_CURX" "5"
 SYSTEM_CONSTANT "EPMBCR_FACWEIGHTPAS_DSTX" "4"
 SYSTEM_CONSTANT "EPMBCR_FACWEIGHT_DSTX" "4"
 SYSTEM_CONSTANT "EPMBCR_NENG_DSTX" "5"
 SYSTEM_CONSTANT "EPMCAS_DETECTBOTHEDGES" "2"
 SYSTEM_CONSTANT "EPMCAS_DETECTFALLINGEDGES" "0"
 SYSTEM_CONSTANT "EPMCAS_DETECTRISINGEDGES" "1"
 SYSTEM_CONSTANT "EPMCAS_FACPLAUS_DSTX" "3"
 SYSTEM_CONSTANT "EPMCAS_I1_SY" "0"
 SYSTEM_CONSTANT "EPMCAS_MOUNTCHK" "0"
 SYSTEM_CONSTANT "EPMCAS_NUMSEG" "10"
 SYSTEM_CONSTANT "EPMCAS_NUMSEGLEN" "10"
 SYSTEM_CONSTANT "EPMCAS_PHINCOR_CURX" "6"
 SYSTEM_CONSTANT "EPMCAS_PHITEMPCOR05_DSTX" "3"
 SYSTEM_CONSTANT "EPMCAS_SEGCOR_SY" "0"
 SYSTEM_CONSTANT "EPMCRS_DIAG_VEH_V_MAX" "25"
 SYSTEM_CONSTANT "EPMCRS_DIAG_VEH_V_MIN" "1"
 SYSTEM_CONSTANT "EPMCRS_NUMTHRESH" "4"
 SYSTEM_CONSTANT "EPMCRS_NUMVAL" "4"
 SYSTEM_CONSTANT "EPMCRS_TIPLSFWD" "45"
 SYSTEM_CONSTANT "EPMCRS_TIPLSREV" "90"
 SYSTEM_CONSTANT "EPMHCRS_INCDVTBUF_MAX_SY" "0"
 SYSTEM_CONSTANT "EPMHCRS_NUMINC" "60"
 SYSTEM_CONSTANT "EPMHCRS_PHIINCR" "6"
 SYSTEM_CONSTANT "EPMHCRS_SWTALTPIN_SY" "0"
 SYSTEM_CONSTANT "EPMHCRS_SWTCODEDGAP_SY" "0"
 SYSTEM_CONSTANT "EPMHCRS_SWTDGI_SY" "1"
 SYSTEM_CONSTANT "EPMHCRS_SWTGAP12_SY" "0"
 SYSTEM_CONSTANT "EPMHCRS_SWTIAP_SY" "1"
 SYSTEM_CONSTANT "EPMHCRS_SWTIAS_SY" "1"
 SYSTEM_CONSTANT "EPMHCRS_SWTINCDVTMEAS_SY" "0"
 SYSTEM_CONSTANT "EPMRRS_NUMPER" "10"
 SYSTEM_CONSTANT "EPMRRS_SY" "4"
 SYSTEM_CONSTANT "EPMRRS_TISWOFFDLY" "1000000"
 SYSTEM_CONSTANT "EPMRRS_TITEMP_CURX" "3"
 SYSTEM_CONSTANT "EPMRRS_TITOOTHPERTOL" "1000"
 SYSTEM_CONSTANT "EPMRRS_TITRNOFFDLY" "100000"
 SYSTEM_CONSTANT "EPMRRS_VMIN" "20"
 SYSTEM_CONSTANT "EPMSYN_PHIINCCOR_CURX" "4"
 SYSTEM_CONSTANT "EPM_NENG10MSMAX" "2550"
 SYSTEM_CONSTANT "EPM_NENG_10" "20"
 SYSTEM_CONSTANT "EPM_NUMCRSREVWCY_SY" "2"
 SYSTEM_CONSTANT "EPM_NUMCYLMAX" "6"
 SYSTEM_CONSTANT "EPM_N_HIRES" "0.03125"
 SYSTEM_CONSTANT "EPM_N_HIRES_EXP" "5"
 SYSTEM_CONSTANT "EPM_N_IDL_RES" "10"
 SYSTEM_CONSTANT "EPM_N_L_RES" "40"
 SYSTEM_CONSTANT "EPM_N_MAX" "10000"
 SYSTEM_CONSTANT "EPM_N_MIN" "20"
 SYSTEM_CONSTANT "EPM_N_RES" "0.5"
 SYSTEM_CONSTANT "EPM_N_RES_FL" "0.5"
 SYSTEM_CONSTANT "EPM_N_RES_INV" "2"
 SYSTEM_CONSTANT "EPM_N_RES_REV" "2"
 SYSTEM_CONSTANT "EPM_N_TO_CAS" "750"
 SYSTEM_CONSTANT "EPM_N_ZERO" "0"
 SYSTEM_CONSTANT "EPM_PHICRSREV_SY" "360"
 SYSTEM_CONSTANT "EPM_PHIMAX" "720"
 SYSTEM_CONSTANT "EPM_PHIMAX_SY" "32767"
 SYSTEM_CONSTANT "EPM_STRTALE_NENGMAX" "2000"
 SYSTEM_CONSTANT "EPM_SYNCSLV_SY" "0"
 SYSTEM_CONSTANT "EPM_TI_SHORTINT" "2500"
 SYSTEM_CONSTANT "EQUALINIT" "255"
 SYSTEM_CONSTANT "ERRLMP_ATSINTVMOD_SY" "1"
 SYSTEM_CONSTANT "ERRLMP_PSPRS_SY" "1"
 SYSTEM_CONSTANT "ERRVAL_S16" "32767"
 SYSTEM_CONSTANT "ERRVAL_S32" "2147483647"
 SYSTEM_CONSTANT "ERRVAL_S8" "127"
 SYSTEM_CONSTANT "ERRVAL_U16" "65535"
 SYSTEM_CONSTANT "ERRVAL_U32" "4294967295"
 SYSTEM_CONSTANT "ERRVAL_U8" "255"
 SYSTEM_CONSTANT "ESC_DT_NESTING_DEPTH" "10"
 SYSTEM_CONSTANT "ESC_NUMTHRESH" "3"
 SYSTEM_CONSTANT "ESC_STACKSIZE" "10"
 SYSTEM_CONSTANT "ESC_STSCHDSX_SIZE" "16"
 SYSTEM_CONSTANT "ETA1_EXP" "7"
 SYSTEM_CONSTANT "ETA1_RES" "0.0078125"
 SYSTEM_CONSTANT "ETA1_RES_REV" "128"
 SYSTEM_CONSTANT "ETA2_EXP" "7"
 SYSTEM_CONSTANT "ETA2_RES" "0.0078125"
 SYSTEM_CONSTANT "ETA2_RES_REV" "128"
 SYSTEM_CONSTANT "ETA_CORR_FACT_ONE" "1"
 SYSTEM_CONSTANT "ETA_COR_FACT_ONE" "1"
 SYSTEM_CONSTANT "ETA_EXP" "7"
 SYSTEM_CONSTANT "ETA_RES" "0.0078125"
 SYSTEM_CONSTANT "ETA_RES_REV" "128"
 SYSTEM_CONSTANT "ETA_THM_ENG_ONE" "1"
 SYSTEM_CONSTANT "ETCLB_COR_OFF" "0"
 SYSTEM_CONSTANT "ETCLB_COR_ON" "1"
 SYSTEM_CONSTANT "ETCLB_NUMRAILPCLBPNT_SY" "3"
 SYSTEM_CONSTANT "ETCLB_NUM_RAILP_CLB_PNT" "3"
 SYSTEM_CONSTANT "ETCLB_SWTCORACTV_TYPE" "2"
 SYSTEM_CONSTANT "ETCLB_SWTCORACTV_VAL" "1"
 SYSTEM_CONSTANT "ETCLB_TIBSTPRESCORR_CUR_X" "12"
 SYSTEM_CONSTANT "ETCTLGOV_P0Q001_LIMMAX" "1"
 SYSTEM_CONSTANT "ETCTLGOV_P0Q001_LIMMIN" "-1"
 SYSTEM_CONSTANT "ETCTLGOV_P0Q001_RES" "0.001"
 SYSTEM_CONSTANT "ETCTLGOV_P0Q001_RES_INV" "1000"
 SYSTEM_CONSTANT "ETCTLGOV_P0Q001_ZERO" "0"
 SYSTEM_CONSTANT "ETCTL_ACTV_BP" "0"
 SYSTEM_CONSTANT "ETCTL_NUMOPMODEMSK_SY" "2"
 SYSTEM_CONSTANT "ETCTL_QPOI1MAX_MAP_X" "10"
 SYSTEM_CONSTANT "ETCTL_QPOI1MAX_MAP_Y" "10"
 SYSTEM_CONSTANT "ETCTL_QPOI2MAX_MAP_X" "15"
 SYSTEM_CONSTANT "ETCTL_QPOI2MAX_MAP_Y" "15"
 SYSTEM_CONSTANT "ETCTL_QPOI2MIN_MAP_X" "15"
 SYSTEM_CONSTANT "ETCTL_QPOI2MIN_MAP_Y" "15"
 SYSTEM_CONSTANT "ETCTL_SLOPENEG" "0"
 SYSTEM_CONSTANT "ETCTL_STMSKINR_CA_X" "2"
 SYSTEM_CONSTANT "ETCTL_STMSKOUTR_CA_X" "2"
 SYSTEM_CONSTANT "ETS_DPF_SY" "2"
 SYSTEM_CONSTANT "ETS_HOM_SY" "2"
 SYSTEM_CONSTANT "ETS_INJMI" "3"
 SYSTEM_CONSTANT "ETS_INJNUM_SY" "6"
 SYSTEM_CONSTANT "ETS_INJPII1" "2"
 SYSTEM_CONSTANT "ETS_INJPII2" "1"
 SYSTEM_CONSTANT "ETS_INJPII3" "0"
 SYSTEM_CONSTANT "ETS_INJPOI1" "4"
 SYSTEM_CONSTANT "ETS_INJPOI2" "5"
 SYSTEM_CONSTANT "ETS_LEAN_0" "10"
 SYSTEM_CONSTANT "ETS_LEAN_1" "11"
 SYSTEM_CONSTANT "ETS_LEAN_2" "12"
 SYSTEM_CONSTANT "ETS_LEAN_SY" "1"
 SYSTEM_CONSTANT "ETS_NSC_0" "50"
 SYSTEM_CONSTANT "ETS_NSC_1" "51"
 SYSTEM_CONSTANT "ETS_NSC_2" "52"
 SYSTEM_CONSTANT "ETS_NSC_SY" "1"
 SYSTEM_CONSTANT "ETS_NUMINPMSK_SY" "7"
 SYSTEM_CONSTANT "ETS_PFLT1_0" "20"
 SYSTEM_CONSTANT "ETS_PFLT1_1" "21"
 SYSTEM_CONSTANT "ETS_PFLT1_2" "22"
 SYSTEM_CONSTANT "ETS_PFLT1_SY" "1"
 SYSTEM_CONSTANT "ETS_PFLT2_0" "30"
 SYSTEM_CONSTANT "ETS_PFLT2_1" "31"
 SYSTEM_CONSTANT "ETS_PFLT2_2" "32"
 SYSTEM_CONSTANT "ETS_PFLT2_SY" "1"
 SYSTEM_CONSTANT "ETS_PHC_0" "40"
 SYSTEM_CONSTANT "ETS_PHC_1" "41"
 SYSTEM_CONSTANT "ETS_PHC_2" "42"
 SYSTEM_CONSTANT "ETS_PHC_SY" "2"
 SYSTEM_CONSTANT "ETS_SOX_0" "60"
 SYSTEM_CONSTANT "ETS_SOX_1" "61"
 SYSTEM_CONSTANT "ETS_SOX_2" "62"
 SYSTEM_CONSTANT "ETS_SOX_SY" "1"
 SYSTEM_CONSTANT "EVEN_SEGMENT" "0"
 SYSTEM_CONSTANT "EXHPRES_CT_SENSORS" "8"
 SYSTEM_CONSTANT "EXHTEMP_CT_SENSORS" "8"
 SYSTEM_CONSTANT "EXHTMON_CT_SENSORS" "3"
 SYSTEM_CONSTANT "EXH_DMNOX_RES" "0.001"
 SYSTEM_CONSTANT "EXH_DMNOX_RES_REV" "1000"
 SYSTEM_CONSTANT "EXH_PMNTCOR_CUR_X" "25"
 SYSTEM_CONSTANT "EXH_TMNTCOR_MAP_X" "16"
 SYSTEM_CONSTANT "EXH_TMNTCOR_MAP_Y" "12"
 SYSTEM_CONSTANT "FACT100_ONE" "1"
 SYSTEM_CONSTANT "FACT100_RES" "0.01"
 SYSTEM_CONSTANT "FACT100_RES_REV" "100"
 SYSTEM_CONSTANT "FACT10_EXP" "10"
 SYSTEM_CONSTANT "FACT10_RES" "1e-010"
 SYSTEM_CONSTANT "FACT16_EXP" "16"
 SYSTEM_CONSTANT "FACT16_RES_REV" "65536"
 SYSTEM_CONSTANT "FACT1_EXP" "7"
 SYSTEM_CONSTANT "FACT1_ONE" "1"
 SYSTEM_CONSTANT "FACT1_ONE_RES" "0.1"
 SYSTEM_CONSTANT "FACT1_ONE_RES_REV" "10"
 SYSTEM_CONSTANT "FACT1_RES" "0.0078125"
 SYSTEM_CONSTANT "FACT1_RES_FL" "0.0078125"
 SYSTEM_CONSTANT "FACT1_RES_REV" "128"
 SYSTEM_CONSTANT "FACT1_ZERO" "0"
 SYSTEM_CONSTANT "FACT256_RES" "0.00390625"
 SYSTEM_CONSTANT "FACT256_RES_REV" "256"
 SYSTEM_CONSTANT "FACT26_EXP" "26"
 SYSTEM_CONSTANT "FACT26_RES" "1.49011611938477e-008"
 SYSTEM_CONSTANT "FACT26_RES_REV" "67108864"
 SYSTEM_CONSTANT "FACT3_RES" "0.01"
 SYSTEM_CONSTANT "FACT3_RES_FL" "0.01"
 SYSTEM_CONSTANT "FACT4_MAX" "1500"
 SYSTEM_CONSTANT "FACT4_MIN" "0"
 SYSTEM_CONSTANT "FACT4_ONE" "1"
 SYSTEM_CONSTANT "FACT4_RES" "0.05"
 SYSTEM_CONSTANT "FACT4_RES_REV" "20"
 SYSTEM_CONSTANT "FACT5_RES" "0.5"
 SYSTEM_CONSTANT "FACT5_RES_FL" "0.5"
 SYSTEM_CONSTANT "FACT6_RES" "0.002"
 SYSTEM_CONSTANT "FACT6_RES_REV" "500"
 SYSTEM_CONSTANT "FACT7_RES" "1e-007"
 SYSTEM_CONSTANT "FACT7_RES_REV" "10000000"
 SYSTEM_CONSTANT "FACT8_EXP" "8"
 SYSTEM_CONSTANT "FACT8_RES" "1e-008"
 SYSTEM_CONSTANT "FACT8_RES_REV" "100000000"
 SYSTEM_CONSTANT "FACT9_RES" "0.0002"
 SYSTEM_CONSTANT "FACT9_RES_FL" "0.0002"
 SYSTEM_CONSTANT "FACTFINE_MIN" "0"
 SYSTEM_CONSTANT "FACTFINE_RES" "1e-006"
 SYSTEM_CONSTANT "FACTFINE_RES_FL" "1e-006"
 SYSTEM_CONSTANT "FACTGOVILMBDRESREV_SY" "64"
 SYSTEM_CONSTANT "FACTGOVIT3RESREV_SY" "512"
 SYSTEM_CONSTANT "FACTGOVPLMBDRESREV_SY" "128"
 SYSTEM_CONSTANT "FACTGOVPT3RESREV_SY" "256"
 SYSTEM_CONSTANT "FACTLOW1_RES" "0.04"
 SYSTEM_CONSTANT "FACTLOW1_RES_REV" "25"
 SYSTEM_CONSTANT "FACTM_EXP" "4"
 SYSTEM_CONSTANT "FACTM_RES" "0"
 SYSTEM_CONSTANT "FACTM_RES_REV" "16"
 SYSTEM_CONSTANT "FACTM_ZERO" "0"
 SYSTEM_CONSTANT "FACTOR_100" "100"
 SYSTEM_CONSTANT "FACTOR_1000" "1000"
 SYSTEM_CONSTANT "FACTOR_100MS_TO_10MS_RESOLUTION" "10"
 SYSTEM_CONSTANT "FACTPIINT_SY" "2147"
 SYSTEM_CONSTANT "FACTPIPROP_SY" "32768"
 SYSTEM_CONSTANT "FACTR_RES" "10"
 SYSTEM_CONSTANT "FACTR_RES_FL" "10"
 SYSTEM_CONSTANT "FACT_BIP_RES" "4096"
 SYSTEM_CONSTANT "FACT_EGT_RES" "0.001"
 SYSTEM_CONSTANT "FACT_EGT_RES_REV" "1000"
 SYSTEM_CONSTANT "FACT_ETCTL_ONE" "1"
 SYSTEM_CONSTANT "FACT_LAMBDAREC1" "100"
 SYSTEM_CONSTANT "FACT_LAMBDAREC2" "1000000"
 SYSTEM_CONSTANT "FACT_LENGTH_TO_LSNCERGNRES" "0.0078125"
 SYSTEM_CONSTANT "FACT_LENGTH_TO_VEL" "360"
 SYSTEM_CONSTANT "FACT_LPM_TO_LP100KM" "20000000"
 SYSTEM_CONSTANT "FACT_MASSOILASH_TO_VOLOILASH" "10"
 SYSTEM_CONSTANT "FACT_MAX" "1.2"
 SYSTEM_CONSTANT "FACT_MIN" "0.8333"
 SYSTEM_CONSTANT "FACT_NRM_EXP" "13"
 SYSTEM_CONSTANT "FACT_NRM_EXP_LOW" "10"
 SYSTEM_CONSTANT "FACT_OILMFLMGPSQ0P1_2_MSMG_REV" "10"
 SYSTEM_CONSTANT "FACT_OILMSMG_2_Q0P1" "10"
 SYSTEM_CONSTANT "FACT_OILMSQ0P1_2_Q10" "100"
 SYSTEM_CONSTANT "FACT_ONE" "1"
 SYSTEM_CONSTANT "FACT_POI2POI1_MAX" "1"
 SYSTEM_CONSTANT "FACT_POI2POI1_MIN" "0"
 SYSTEM_CONSTANT "FACT_Q0P001_RES" "0.001"
 SYSTEM_CONSTANT "FACT_Q0P001_RES_REV" "1000"
 SYSTEM_CONSTANT "FACT_RES" "0.0001220703125"
 SYSTEM_CONSTANT "FACT_RES_FL" "0.0001220703125"
 SYSTEM_CONSTANT "FACT_RES_LOW" "0.0009765625"
 SYSTEM_CONSTANT "FACT_RES_REV" "8192"
 SYSTEM_CONSTANT "FACT_RES_REV_LOW" "1024"
 SYSTEM_CONSTANT "FACT_RES_RLX" "10"
 SYSTEM_CONSTANT "FACT_TEMP" "-2731.4"
 SYSTEM_CONSTANT "FACT_TWO" "2"
 SYSTEM_CONSTANT "FACT_TWO_SY" "2"
 SYSTEM_CONSTANT "FACT_ZERO" "0"
 SYSTEM_CONSTANT "FAC_AG_CRS_HI_RESO" "128"
 SYSTEM_CONSTANT "FAC_DERIVATIVE" "500000"
 SYSTEM_CONSTANT "FAC_MASSINJ_TO_QNTINJ" "10000"
 SYSTEM_CONSTANT "FAC_PLAUS" "16"
 SYSTEM_CONSTANT "FAC_PRECTL_CTLINJ" "240000"
 SYSTEM_CONSTANT "FAC_PRES2TRQ_REV" "500"
 SYSTEM_CONSTANT "FAC_QNTADJ_TO_QNTINJ_0" "1000"
 SYSTEM_CONSTANT "FAC_QNTADJ_TO_QNTINJ_1" "1500"
 SYSTEM_CONSTANT "FAC_QNTADJ_TO_QNTINJ_2" "2500"
 SYSTEM_CONSTANT "FAC_QNTADJ_TO_QNTINJ_3" "5000"
 SYSTEM_CONSTANT "FAC_QNTADJ_TO_QNTINJ_RES" "100"
 SYSTEM_CONSTANT "FAC_T_INC_PER_DUR_HI_RESO" "256"
 SYSTEM_CONSTANT "FAC_USEC_TO_RPM" "60000000"
 SYSTEM_CONSTANT "FANCTL_DCYCCALC_CUR_X" "25"
 SYSTEM_CONSTANT "FANCTL_NEFANACDEM_CUR_X" "10"
 SYSTEM_CONSTANT "FANCTL_NSETPNTTRAILER_MAP_X" "8"
 SYSTEM_CONSTANT "FANCTL_NSETPNTTRAILER_MAP_Y" "10"
 SYSTEM_CONSTANT "FANSPD_MAX" "3000"
 SYSTEM_CONSTANT "FAN_ATSINTVMOD_SY" "0"
 SYSTEM_CONSTANT "FAN_CTLAFTRUN_BP" "1"
 SYSTEM_CONSTANT "FAN_TPER_MAX_SY" "100"
 SYSTEM_CONSTANT "FAN_TPER_MIN_SY" "10"
 SYSTEM_CONSTANT "FBC_BPfacINV_RES" "546.116666666667"
 SYSTEM_CONSTANT "FBC_BPfac_MAX" "30"
 SYSTEM_CONSTANT "FBC_BPfac_MIN" "-30"
 SYSTEM_CONSTANT "FBC_BPfac_RES" "0.00183111056855983"
 SYSTEM_CONSTANT "FBC_CTPHCOMP_MAX" "4"
 SYSTEM_CONSTANT "FBC_CTPHCOMP_MIN" "0"
 SYSTEM_CONSTANT "FBC_CTSEGOFFSET" "2"
 SYSTEM_CONSTANT "FBC_CTTDCOFFSET" "1"
 SYSTEM_CONSTANT "FBC_DBPFAC1DEN1" "1.3611"
 SYSTEM_CONSTANT "FBC_DBPFAC1DEN2" "0.9245"
 SYSTEM_CONSTANT "FBC_DBPFAC2DEN1" "0.000944"
 SYSTEM_CONSTANT "FBC_DBPFAC2DEN2" "0.9245"
 SYSTEM_CONSTANT "FBC_DBPFAC3DEN1" "0"
 SYSTEM_CONSTANT "FBC_DBPFAC3DEN2" "0"
 SYSTEM_CONSTANT "FBC_DBPFAC4DEN1" "0"
 SYSTEM_CONSTANT "FBC_DBPFAC4DEN2" "0"
 SYSTEM_CONSTANT "FBC_DBPFAC5DEN1" "0"
 SYSTEM_CONSTANT "FBC_DBPFAC5DEN2" "0"
 SYSTEM_CONSTANT "FBC_DSYN" "1"
 SYSTEM_CONSTANT "FBC_DXS_FL" "4194304"
 SYSTEM_CONSTANT "FBC_FIOMAX_SY" "8"
 SYSTEM_CONSTANT "FBC_NUMAASEGMAX_SY" "4"
 SYSTEM_CONSTANT "FBC_NUMCYL03_AA0" "0.0681483474"
 SYSTEM_CONSTANT "FBC_NUMCYL03_AA1" "0.131652498"
 SYSTEM_CONSTANT "FBC_NUMCYL03_AA2" "0.186184748"
 SYSTEM_CONSTANT "FBC_NUMCYL03_AA3" "0.228028815"
 SYSTEM_CONSTANT "FBC_NUMCYL03_AA4" "0.186184748"
 SYSTEM_CONSTANT "FBC_NUMCYL03_AA5" "0.131652498"
 SYSTEM_CONSTANT "FBC_NUMCYL03_AA6" "0.0681483474"
 SYSTEM_CONSTANT "FBC_NUMCYL03_AA7" "0"
 SYSTEM_CONSTANT "FBC_NUMCYL03_AA8" "0"
 SYSTEM_CONSTANT "FBC_NUMCYL03_AAORD" "6"
 SYSTEM_CONSTANT "FBC_NUMCYL03_NUMAASEG" "4"
 SYSTEM_CONSTANT "FBC_NUMCYL03_TSM0" "3.5"
 SYSTEM_CONSTANT "FBC_NUMCYL03_TSM1" "-2.5"
 SYSTEM_CONSTANT "FBC_NUMCYL04_AA0" "0.0155861364"
 SYSTEM_CONSTANT "FBC_NUMCYL04_AA1" "0.0571060835"
 SYSTEM_CONSTANT "FBC_NUMCYL04_AA2" "0.125906618"
 SYSTEM_CONSTANT "FBC_NUMCYL04_AA3" "0.191080679"
 SYSTEM_CONSTANT "FBC_NUMCYL04_AA4" "0.220640963"
 SYSTEM_CONSTANT "FBC_NUMCYL04_AA5" "0.191080679"
 SYSTEM_CONSTANT "FBC_NUMCYL04_AA6" "0.125906618"
 SYSTEM_CONSTANT "FBC_NUMCYL04_AA7" "0.0571060835"
 SYSTEM_CONSTANT "FBC_NUMCYL04_AA8" "0.0155861364"
 SYSTEM_CONSTANT "FBC_NUMCYL04_AAORD" "8"
 SYSTEM_CONSTANT "FBC_NUMCYL04_NUMAASEG" "3"
 SYSTEM_CONSTANT "FBC_NUMCYL04_TSM0" "4.5"
 SYSTEM_CONSTANT "FBC_NUMCYL04_TSM1" "-3.5"
 SYSTEM_CONSTANT "FBC_NUMCYL05_AA0" "0.0143161042"
 SYSTEM_CONSTANT "FBC_NUMCYL05_AA1" "0.0541633501"
 SYSTEM_CONSTANT "FBC_NUMCYL05_AA2" "0.125118189"
 SYSTEM_CONSTANT "FBC_NUMCYL05_AA3" "0.193597643"
 SYSTEM_CONSTANT "FBC_NUMCYL05_AA4" "0.225609425"
 SYSTEM_CONSTANT "FBC_NUMCYL05_AA5" "0.193597643"
 SYSTEM_CONSTANT "FBC_NUMCYL05_AA6" "0.125118189"
 SYSTEM_CONSTANT "FBC_NUMCYL05_AA7" "0.0541633501"
 SYSTEM_CONSTANT "FBC_NUMCYL05_AA8" "0.0143161042"
 SYSTEM_CONSTANT "FBC_NUMCYL05_AAORD" "8"
 SYSTEM_CONSTANT "FBC_NUMCYL05_NUMAASEG" "3"
 SYSTEM_CONSTANT "FBC_NUMCYL05_TSM0" "5.5"
 SYSTEM_CONSTANT "FBC_NUMCYL05_TSM1" "-4.5"
 SYSTEM_CONSTANT "FBC_NUMCYL06_AA0" "0.0744924388"
 SYSTEM_CONSTANT "FBC_NUMCYL06_AA1" "0.249256558"
 SYSTEM_CONSTANT "FBC_NUMCYL06_AA2" "0.352502005"
 SYSTEM_CONSTANT "FBC_NUMCYL06_AA3" "0.249256558"
 SYSTEM_CONSTANT "FBC_NUMCYL06_AA4" "0.0744924388"
 SYSTEM_CONSTANT "FBC_NUMCYL06_AA5" "0"
 SYSTEM_CONSTANT "FBC_NUMCYL06_AA6" "0"
 SYSTEM_CONSTANT "FBC_NUMCYL06_AA7" "0"
 SYSTEM_CONSTANT "FBC_NUMCYL06_AA8" "0"
 SYSTEM_CONSTANT "FBC_NUMCYL06_AAORD" "4"
 SYSTEM_CONSTANT "FBC_NUMCYL06_NUMAASEG" "2"
 SYSTEM_CONSTANT "FBC_NUMCYL06_TSM0" "6.5"
 SYSTEM_CONSTANT "FBC_NUMCYL06_TSM1" "-5.5"
 SYSTEM_CONSTANT "FBC_NUMCYL08_AA0" "0.0155861364"
 SYSTEM_CONSTANT "FBC_NUMCYL08_AA1" "0.0571060835"
 SYSTEM_CONSTANT "FBC_NUMCYL08_AA2" "0.125906618"
 SYSTEM_CONSTANT "FBC_NUMCYL08_AA3" "0.191080679"
 SYSTEM_CONSTANT "FBC_NUMCYL08_AA4" "0.220640963"
 SYSTEM_CONSTANT "FBC_NUMCYL08_AA5" "0.191080679"
 SYSTEM_CONSTANT "FBC_NUMCYL08_AA6" "0.125906618"
 SYSTEM_CONSTANT "FBC_NUMCYL08_AA7" "0.0571060835"
 SYSTEM_CONSTANT "FBC_NUMCYL08_AA8" "0.0155861364"
 SYSTEM_CONSTANT "FBC_NUMCYL08_AAORD" "8"
 SYSTEM_CONSTANT "FBC_NUMCYL08_NUMAASEG" "3"
 SYSTEM_CONSTANT "FBC_NUMCYL08_TSM0" "8.5"
 SYSTEM_CONSTANT "FBC_NUMCYL08_TSM1" "-7.5"
 SYSTEM_CONSTANT "FBC_NUMCYL10_AA0" "0.0750601575"
 SYSTEM_CONSTANT "FBC_NUMCYL10_AA1" "0.248923997"
 SYSTEM_CONSTANT "FBC_NUMCYL10_AA2" "0.352031692"
 SYSTEM_CONSTANT "FBC_NUMCYL10_AA3" "0.248923997"
 SYSTEM_CONSTANT "FBC_NUMCYL10_AA4" "0.0750601575"
 SYSTEM_CONSTANT "FBC_NUMCYL10_AA5" "0"
 SYSTEM_CONSTANT "FBC_NUMCYL10_AA6" "0"
 SYSTEM_CONSTANT "FBC_NUMCYL10_AA7" "0"
 SYSTEM_CONSTANT "FBC_NUMCYL10_AA8" "0"
 SYSTEM_CONSTANT "FBC_NUMCYL10_AAORD" "4"
 SYSTEM_CONSTANT "FBC_NUMCYL10_NUMAASEG" "2"
 SYSTEM_CONSTANT "FBC_NUMCYL10_TSM0" "10.5"
 SYSTEM_CONSTANT "FBC_NUMCYL10_TSM1" "-9.5"
 SYSTEM_CONSTANT "FBC_NUMSEG" "2"
 SYSTEM_CONSTANT "FBC_QLIM_CUR_X" "4"
 SYSTEM_CONSTANT "FLCONS1_RES" "0.01"
 SYSTEM_CONSTANT "FLCONS1_RES_INV" "100"
 SYSTEM_CONSTANT "FLCONS2_RES" "1"
 SYSTEM_CONSTANT "FLCONS2_RES_1" "0.001"
 SYSTEM_CONSTANT "FLCONS_LPS_RES" "0.0001"
 SYSTEM_CONSTANT "FLDETREFUEL_HALF_L" "0.5"
 SYSTEM_CONSTANT "FLFCBS_LCALCDISTANCE_MAP_X" "8"
 SYSTEM_CONSTANT "FLFCBS_LCALCDISTANCE_MAP_Y" "8"
 SYSTEM_CONSTANT "FLFCBS_QCALCFLTOT_CUR_X" "8"
 SYSTEM_CONSTANT "FLFLTDSP_PTRANSF_CUR_X" "25"
 SYSTEM_CONSTANT "FLFLTHT_ATSINTVMOD_SY" "1"
 SYSTEM_CONSTANT "FLFLTUSP_PTRANSF_CUR_X" "25"
 SYSTEM_CONSTANT "FLMNG_FULLLDRGLIKI_CUR_X" "7"
 SYSTEM_CONSTANT "FLMNG_FULLLDRGLPKP_CUR_X" "7"
 SYSTEM_CONSTANT "FLMNG_R_STOICH" "14.5"
 SYSTEM_CONSTANT "FLMNG_SMK_NORM" "689.655172413793"
 SYSTEM_CONSTANT "FLMNG_TIFULLLDRGLDEL_CUR_X" "10"
 SYSTEM_CONSTANT "FLSYS_FTS_EXISTS" "1"
 SYSTEM_CONSTANT "FLSYS_FTS_NONE" "0"
 SYSTEM_CONSTANT "FLSYS_RHOFL_CUR_X" "2"
 SYSTEM_CONSTANT "FLSYS_SWTTEMPSENSCFG_TYPE" "2"
 SYSTEM_CONSTANT "FLSYS_SWTTEMPSENSCFG_VAL" "0"
 SYSTEM_CONSTANT "FLVOL_RES" "0.05"
 SYSTEM_CONSTANT "FL_2_RES" "10"
 SYSTEM_CONSTANT "Fl_Half_L_2_VOL" "50"
 SYSTEM_CONSTANT "FL_Half_L_MAX" "300"
 SYSTEM_CONSTANT "FL_Half_L_MIN" "0"
 SYSTEM_CONSTANT "FL_L_MAX" "320"
 SYSTEM_CONSTANT "FL_L_MIN" "0"
 SYSTEM_CONSTANT "FL_L_RES" "0.01"
 SYSTEM_CONSTANT "FL_L_RES_INV" "100"
 SYSTEM_CONSTANT "FL_RES" "0.5"
 SYSTEM_CONSTANT "FL_RES_INV" "2"
 SYSTEM_CONSTANT "FL_VOL_MAX" "65.5"
 SYSTEM_CONSTANT "FL_VOL_MIN" "0"
 SYSTEM_CONSTANT "Fl_Vol_q0p05_MAX" "300"
 SYSTEM_CONSTANT "Fl_Vol_q0p05_MIN" "0"
 SYSTEM_CONSTANT "FL_VOL_RES" "0.001"
 SYSTEM_CONSTANT "FL_VOL_RES_INV" "1000"
 SYSTEM_CONSTANT "FMA_DT1_RES" "4294.967296"
 SYSTEM_CONSTANT "FMA_N_2_PSI" "33554.432"
 SYSTEM_CONSTANT "FMA_QADAPINI_X_AXIS" "8"
 SYSTEM_CONSTANT "FMA_QADAPINI_Y_AXIS" "8"
 SYSTEM_CONSTANT "FMA_Q_2_PSI" "67108.864"
 SYSTEM_CONSTANT "FMA_SWTQNTAIRCTLCOR_SY" "0"
 SYSTEM_CONSTANT "FRQTDC_RES" "0.02"
 SYSTEM_CONSTANT "FRQTDC_RES_REV" "50"
 SYSTEM_CONSTANT "FTSCD_TLIN_CUR_X" "25"
 SYSTEM_CONSTANT "FUELT_FTS_NONE" "0"
 SYSTEM_CONSTANT "FUELT_TEMP_CTS" "1"
 SYSTEM_CONSTANT "FUELT_TEMP_DFL" "2"
 SYSTEM_CONSTANT "FUELT_TEMP_FTS" "0"
 SYSTEM_CONSTANT "G2MG" "1000"
 SYSTEM_CONSTANT "GCVOLT_RES" "1023"
 SYSTEM_CONSTANT "GCVOLT_VOLT_BATT_REV" "409.2"
 SYSTEM_CONSTANT "GDI_SY" "0"
 SYSTEM_CONSTANT "GEAR0" "0"
 SYSTEM_CONSTANT "GEAR1" "1"
 SYSTEM_CONSTANT "GEAR2" "2"
 SYSTEM_CONSTANT "GEAR3" "3"
 SYSTEM_CONSTANT "GEAR4" "4"
 SYSTEM_CONSTANT "GEAR5" "5"
 SYSTEM_CONSTANT "GEAR6" "6"
 SYSTEM_CONSTANT "GEAR7" "7"
 SYSTEM_CONSTANT "GEARBX_NUMGEAR_MAX" "6"
 SYSTEM_CONSTANT "GEARBX_NUMGEAR_MIN" "-1"
 SYSTEM_CONSTANT "GEARBX_TRQMAXGEAR1_CUR_X" "15"
 SYSTEM_CONSTANT "GEARBX_TRQMAXGEAR2_CUR_X" "15"
 SYSTEM_CONSTANT "GEARBX_TRQMAXGEAR3_CUR_X" "15"
 SYSTEM_CONSTANT "GEARBX_TRQMAXGEAR4_CUR_X" "15"
 SYSTEM_CONSTANT "GEARBX_TRQMAXGEAR5_CUR_X" "15"
 SYSTEM_CONSTANT "GEARBX_TRQMAXGEAR6_CUR_X" "15"
 SYSTEM_CONSTANT "GEARBX_TRQMAXGEARR_CUR_X" "15"
 SYSTEM_CONSTANT "GEARBX_TYPE_MT" "0"
 SYSTEM_CONSTANT "GLBDA_LOAD_SEC_X" "6"
 SYSTEM_CONSTANT "GLBDA_LOAD_SEC_Y" "8"
 SYSTEM_CONSTANT "GLBDA_STIARLSVEHDIFFTLPRT_BP" "1"
 SYSTEM_CONSTANT "GLBDA_STIARLSVEHSTABINTV_BP" "0"
 SYSTEM_CONSTANT "GLBDA_STIARLSVEHTRAINTV_BP" "3"
 SYSTEM_CONSTANT "GLBDA_STIARLSVEHTRASHFTINTV_BP" "2"
 SYSTEM_CONSTANT "GLBDA_STIARLSVEH_MSK" "11"
 SYSTEM_CONSTANT "GLBDA_STLIMMINDFL" "0"
 SYSTEM_CONSTANT "GLBDA_STTRQDEMDFL" "0"
 SYSTEM_CONSTANT "GLBDA_STTRQDEMDRVDEM_MSK" "384"
 SYSTEM_CONSTANT "GLBDA_STTRQDEM_ACCPED_BP" "8"
 SYSTEM_CONSTANT "GLBDA_STTRQDEM_ACCPED_MSK" "256"
 SYSTEM_CONSTANT "GLBDA_STTRQDEM_CRCTL" "1"
 SYSTEM_CONSTANT "GLBDA_STTRQDEM_CRCTL_BP" "7"
 SYSTEM_CONSTANT "GLBDA_STTRQDEM_CRCTL_MSK" "128"
 SYSTEM_CONSTANT "GLBDA_STTRQDEM_DCS" "3"
 SYSTEM_CONSTANT "GLBDA_STTRQDEM_DCS_BP" "5"
 SYSTEM_CONSTANT "GLBDA_STTRQDEM_DCS_MSK" "32"
 SYSTEM_CONSTANT "GLBDA_STTRQDEM_LLIM_BP" "6"
 SYSTEM_CONSTANT "GLBDA_STTRQDEM_LLIM_MSK" "64"
 SYSTEM_CONSTANT "GLBDA_STTRQDEM_NODEM_BP" "10"
 SYSTEM_CONSTANT "GLBDA_STTRQDEM_NODEM_MSK" "1024"
 SYSTEM_CONSTANT "GLBDA_STTRQDEM_SPDGOV_BP" "9"
 SYSTEM_CONSTANT "GLBDA_STTRQDEM_SPDGOV_MSK" "512"
 SYSTEM_CONSTANT "GLBDA_STTRQDEM_TCS" "4"
 SYSTEM_CONSTANT "GLBDA_STTRQDEM_TCS_BP" "4"
 SYSTEM_CONSTANT "GLBDA_STTRQDEM_TCS_MSK" "16"
 SYSTEM_CONSTANT "GLBDA_STTRQDEM_TRADEC_BP" "2"
 SYSTEM_CONSTANT "GLBDA_STTRQDEM_TRADEC_MSK" "4"
 SYSTEM_CONSTANT "GLBDA_STTRQDEM_TRAINC_BP" "1"
 SYSTEM_CONSTANT "GLBDA_STTRQDEM_TRAINC_MSK" "2"
 SYSTEM_CONSTANT "GLBDA_STTRQDEM_TRAPRT_BP" "0"
 SYSTEM_CONSTANT "GLBDA_STTRQDEM_TRAPRT_MSK" "1"
 SYSTEM_CONSTANT "GLBDA_STTRQDEM_VMLIM_BP" "3"
 SYSTEM_CONSTANT "GLBDA_STTRQDEM_VMLIM_MSK" "8"
 SYSTEM_CONSTANT "GLBDA_TRQDEM_COVEH_BP" "2"
 SYSTEM_CONSTANT "GLBDA_TRQDEM_COVEH_MSK" "4"
 SYSTEM_CONSTANT "GLBDA_TRQDEM_PT_BP" "1"
 SYSTEM_CONSTANT "GLBDA_TRQDEM_PT_MSK" "2"
 SYSTEM_CONSTANT "GLBDA_TRQDEM_VEHMOT_BP" "0"
 SYSTEM_CONSTANT "GLBDA_TRQDEM_VEHMOT_MSK" "1"
 SYSTEM_CONSTANT "GLWCTL_BATTCORR" "2"
 SYSTEM_CONSTANT "GLWCTL_BATTCORR_MSG" "3"
 SYSTEM_CONSTANT "GLWCTL_FACT_TIME" "10"
 SYSTEM_CONSTANT "GLWCTL_GSK3" "1"
 SYSTEM_CONSTANT "GLWCTL_PREGLWDURCALC_AIRPRESS" "1"
 SYSTEM_CONSTANT "GLWCTL_PREGLWDURCALC_UBATT" "0"
 SYSTEM_CONSTANT "GLWCTL_QPOST_CUR_X" "25"
 SYSTEM_CONSTANT "GLWCTL_RLIMITCLNT_CUR_X" "8"
 SYSTEM_CONSTANT "GLWCTL_RLIMITNM_MAP_X" "6"
 SYSTEM_CONSTANT "GLWCTL_RLIMITNM_MAP_Y" "8"
 SYSTEM_CONSTANT "GLWCTL_RPWRCLNT_CUR_X" "8"
 SYSTEM_CONSTANT "GLWCTL_RPWRNM_MAP_X" "8"
 SYSTEM_CONSTANT "GLWCTL_RPWRNM_MAP_Y" "8"
 SYSTEM_CONSTANT "GLWCTL_RPWRPAIR_CUR_X" "8"
 SYSTEM_CONSTANT "GLWCTL_RPWRTAIR_CUR_X" "8"
 SYSTEM_CONSTANT "GLWCTL_RSTART_CUR_X" "2"
 SYSTEM_CONSTANT "GLWCTL_STINTR1_MAP_X" "16"
 SYSTEM_CONSTANT "GLWCTL_STINTR1_MAP_Y" "16"
 SYSTEM_CONSTANT "GLWCTL_STINTR2_MAP_X" "16"
 SYSTEM_CONSTANT "GLWCTL_STINTR2_MAP_Y" "16"
 SYSTEM_CONSTANT "GLWCTL_STRLYCTL_MAP_X" "16"
 SYSTEM_CONSTANT "GLWCTL_STRLYCTL_MAP_Y" "16"
 SYSTEM_CONSTANT "GLWCTL_SWTPREGLWDURCALC_TYPE" "2"
 SYSTEM_CONSTANT "GLWCTL_SWTPREGLWDURCALC_VAL" "0"
 SYSTEM_CONSTANT "GLWCTL_TILAMPBASE_CUR_X" "8"
 SYSTEM_CONSTANT "GLWCTL_TILAMPPAIR_CUR_X" "4"
 SYSTEM_CONSTANT "GLWCTL_TILAMPUBATT_CUR_X" "4"
 SYSTEM_CONSTANT "GLWCTL_TIPOST_MAP_X" "16"
 SYSTEM_CONSTANT "GLWCTL_TIPOST_MAP_Y" "16"
 SYSTEM_CONSTANT "GLWCTL_TIPRE1_MAP_X" "16"
 SYSTEM_CONSTANT "GLWCTL_TIPRE1_MAP_Y" "16"
 SYSTEM_CONSTANT "GLWCTL_TIPRE2_MAP_X" "16"
 SYSTEM_CONSTANT "GLWCTL_TIPRE2_MAP_Y" "16"
 SYSTEM_CONSTANT "GLWCTL_TIPRE_CUR_X" "8"
 SYSTEM_CONSTANT "GLWCTL_UGLWPLGRAW" "11000"
 SYSTEM_CONSTANT "GLWCTL_UVOLTBATTGLWPLGRAW" "11000"
 SYSTEM_CONSTANT "GLWPLG_FACQNT" "9.84615384615385"
 SYSTEM_CONSTANT "GLWPLG_NUM_MAX" "8"
 SYSTEM_CONSTANT "GLWPLG_NUM_PLGS" "6"
 SYSTEM_CONSTANT "GLWPLG_PWRPERLSB" "13"
 SYSTEM_CONSTANT "GLWPLG_PWRQNT" "128"
 SYSTEM_CONSTANT "GLWPLG_PWRZERO" "0"
 SYSTEM_CONSTANT "GSHDEM_CLUTCH_DISENGAGED" "1"
 SYSTEM_CONSTANT "GSHDEM_COLD" "18"
 SYSTEM_CONSTANT "GSHDEM_INC_GEAR" "1"
 SYSTEM_CONSTANT "GSHDEM_NO_REQ" "0"
 SYSTEM_CONSTANT "GSHDEM_RAMP" "16"
 SYSTEM_CONSTANT "GSHDEM_TRANS_R_ZERO" "0"
 SYSTEM_CONSTANT "GSHDEM_TRQMAX_MAPX" "16"
 SYSTEM_CONSTANT "GSHDEM_TRQMAX_MAPY" "16"
 SYSTEM_CONSTANT "GSHDEM_TRQMAX_MAP_X" "16"
 SYSTEM_CONSTANT "GSHDEM_TRQMAX_MAP_Y" "16"
 SYSTEM_CONSTANT "GSSYS_TYPAIRCTL_SY" "1"
 SYSTEM_CONSTANT "GSSYS_TYPAIRFLW_SY" "1"
 SYSTEM_CONSTANT "GSSYS_TYPAIRSYS_SY" "1"
 SYSTEM_CONSTANT "GSSYS_TYPEAIRFLW_SY" "1"
 SYSTEM_CONSTANT "GSSYS_TYPEEXHFLW_SY" "1"
 SYSTEM_CONSTANT "GSSYS_TYPEGRCLG_SY" "1"
 SYSTEM_CONSTANT "GSSYS_TYPEGRLP_SY" "1"
 SYSTEM_CONSTANT "GSSYS_TYPEGR_SY" "1"
 SYSTEM_CONSTANT "GSSYS_TYPENG_SY" "1"
 SYSTEM_CONSTANT "GSSYS_TYPEXHMNFLP_SY" "1"
 SYSTEM_CONSTANT "GSSYS_TYPEXHMNF_SY" "1"
 SYSTEM_CONSTANT "GSSYS_TYPINDVOL_SY" "1"
 SYSTEM_CONSTANT "GSSYS_TYPINTMNFLP_SY" "1"
 SYSTEM_CONSTANT "GSSYS_TYPINTMNF_SY" "1"
 SYSTEM_CONSTANT "GSSYS_TYPNSC_SY" "1"
 SYSTEM_CONSTANT "GSSYS_TYPOXIC_SY" "1"
 SYSTEM_CONSTANT "GSSYS_TYPPCR_SY" "1"
 SYSTEM_CONSTANT "GSSYS_TYPPFLT_SY" "1"
 SYSTEM_CONSTANT "GSSYS_TYPTRBCHR_SY" "1"
 SYSTEM_CONSTANT "GSSYS_TYPVSWCTL_SY" "1"
 SYSTEM_CONSTANT "GVRN" "1"
 SYSTEM_CONSTANT "HCMPT_RES" "0.1"
 SYSTEM_CONSTANT "HCMPT_RES_REV" "10"
 SYSTEM_CONSTANT "HEAT_CAPACITY_RES" "0.1"
 SYSTEM_CONSTANT "HESRV_AIRSYSCALCLOCB1" "0"
 SYSTEM_CONSTANT "HESRV_AIRSYSCALCLOCB2" "0"
 SYSTEM_CONSTANT "HESRV_COSWTAVG" "0"
 SYSTEM_CONSTANT "HESRV_COSWTAVG_SY" "0"
 SYSTEM_CONSTANT "HESRV_COSWTMAX" "2"
 SYSTEM_CONSTANT "HESRV_COSWTMAX_SY" "2"
 SYSTEM_CONSTANT "HESRV_COSWTMIN" "1"
 SYSTEM_CONSTANT "HESRV_COSWTMIN_SY" "1"
 SYSTEM_CONSTANT "HESRV_COSWTSUM" "3"
 SYSTEM_CONSTANT "HESRV_COSWTSUM_SY" "3"
 SYSTEM_CONSTANT "HESRV_EGSYSCALCLOCB1" "0"
 SYSTEM_CONSTANT "HESRV_EGSYSCALCLOCB2" "0"
 SYSTEM_CONSTANT "HESRV_ENASCNDFLW_SY" "1"
 SYSTEM_CONSTANT "HESRV_HETYP_SY" "255"
 SYSTEM_CONSTANT "HESRV_LOCAL" "255"
 SYSTEM_CONSTANT "HESRV_MASTER" "0"
 SYSTEM_CONSTANT "HESRV_MASTERSLAVE" "1"
 SYSTEM_CONSTANT "HESRV_ONEBOX" "255"
 SYSTEM_CONSTANT "HESRV_SLAVE" "1"
 SYSTEM_CONSTANT "HESRV_SNGLFLW" "1"
 SYSTEM_CONSTANT "HESRV_TWFLW" "2"
 SYSTEM_CONSTANT "HIGH_PREGLOW_NORM" "250"
 SYSTEM_CONSTANT "HLSDEMFIRSTROUND" "1"
 SYSTEM_CONSTANT "HLSDEM_CLTH_CLSD" "8"
 SYSTEM_CONSTANT "HLSDEM_CLTH_CLSD_POS" "3"
 SYSTEM_CONSTANT "HLSDEM_CLTH_CTL" "2"
 SYSTEM_CONSTANT "HLSDEM_CLTH_CTL_POS" "2"
 SYSTEM_CONSTANT "HLSDEM_CLTH_OPN" "4"
 SYSTEM_CONSTANT "HLSDEM_CLTH_OPN_POS" "1"
 SYSTEM_CONSTANT "HLSDEM_CLTH_PN" "5"
 SYSTEM_CONSTANT "HLSDEM_CLTH_PN_POS" "0"
 SYSTEM_CONSTANT "HLSDEM_COLD" "17"
 SYSTEM_CONSTANT "HLSDEM_NOGRIP" "16"
 SYSTEM_CONSTANT "HLSDEM_NSETPHI_MAPX" "8"
 SYSTEM_CONSTANT "HLSDEM_NSETPHI_MAPY" "8"
 SYSTEM_CONSTANT "HLSDEM_NSETPHI_MAP_X" "8"
 SYSTEM_CONSTANT "HLSDEM_NSETPHI_MAP_Y" "8"
 SYSTEM_CONSTANT "HLSDEM_NSETPLOINI_CURX" "25"
 SYSTEM_CONSTANT "HLSDEM_NSETPLOINI_CUR_X" "25"
 SYSTEM_CONSTANT "HLSDEM_SETPFLT_ACS" "1"
 SYSTEM_CONSTANT "HLSDEM_SETPFLT_OTHER" "32767"
 SYSTEM_CONSTANT "HLSDEM_SETPFLT_SYSERR" "3"
 SYSTEM_CONSTANT "HLSDEM_SETPFLT_TRA" "2"
 SYSTEM_CONSTANT "HLSDEM_STSETPFLT_FLT" "2"
 SYSTEM_CONSTANT "HLSDEM_STSETPFLT_RAMP" "32767"
 SYSTEM_CONSTANT "HLSDEM_STSETPFLT_TIPIN" "1"
 SYSTEM_CONSTANT "HLSDEM_STSETPFLT_UNFLT" "3"
 SYSTEM_CONSTANT "HLSDEM_TRQCONV" "19"
 SYSTEM_CONSTANT "HLSDEM_TRQREQSTRT_CURX" "25"
 SYSTEM_CONSTANT "HLSDEM_TRQREQSTRT_MAP_X" "8"
 SYSTEM_CONSTANT "HLSDEM_TRQREQSTRT_MAP_Y" "8"
 SYSTEM_CONSTANT "HLSDEM_UNDERBRAKING" "18"
 SYSTEM_CONSTANT "HPUN_2PI_REV" "9.54929658551309"
 SYSTEM_CONSTANT "HPUN_DVOLPMPAGED_CUR_X" "12"
 SYSTEM_CONSTANT "HPUN_ETAPMPFLTEMP_CURX" "2"
 SYSTEM_CONSTANT "HPUN_ETAPMPMAXAGED_CURX" "2"
 SYSTEM_CONSTANT "HPUN_QBALLIM_CUR_X" "8"
 SYSTEM_CONSTANT "HPUN_QFLTEMPLIM_MAP_X" "16"
 SYSTEM_CONSTANT "HPUN_QFLTEMPLIM_MAP_Y" "16"
 SYSTEM_CONSTANT "HPUN_VOL2DVOL_RES" "12000"
 SYSTEM_CONSTANT "HR2SEC" "3600"
 SYSTEM_CONSTANT "I15031_SIZE_SUPP_PIDS" "20"
 SYSTEM_CONSTANT "IATSCD_TLIN_CUR_X" "25"
 SYSTEM_CONSTANT "IDEAL_GAS_CONSTANT" "287.5"
 SYSTEM_CONSTANT "IDEAL_GAS_CONSTANT_FL" "287"
 SYSTEM_CONSTANT "IDEAL_GAS_CONSTANT_INT" "2875"
 SYSTEM_CONSTANT "IMPT_INC_RES" "20"
 SYSTEM_CONSTANT "IMPT_INC_RES_REV" "0.05"
 SYSTEM_CONSTANT "IMPT_RES" "0.01"
 SYSTEM_CONSTANT "IMPT_RES_REV" "100"
 SYSTEM_CONSTANT "INACTIV" "4"
 SYSTEM_CONSTANT "INDSYS_RVSA_MAP_X" "16"
 SYSTEM_CONSTANT "INDSYS_RVSA_MAP_Y" "16"
 SYSTEM_CONSTANT "INIT" "1"
 SYSTEM_CONSTANT "INJCRV_FACAPPRMI1DYNCOR2_CUR_X" "6"
 SYSTEM_CONSTANT "INJCRV_FACAPPRPII1DYNCOR_CUR_X" "6"
 SYSTEM_CONSTANT "INJCRV_FACAPPRPII1DYNQCOR_CUR_X" "6"
 SYSTEM_CONSTANT "INJCRV_FACMI1APSSOECORRGN_AXIS" "10"
 SYSTEM_CONSTANT "INJCRV_FACMI1ATSSOECORRGN_AXIS" "6"
 SYSTEM_CONSTANT "INJCRV_FACMI1ETSSOECORRGN_AXIS" "10"
 SYSTEM_CONSTANT "INJCRV_FACMI1QNTRMPVAL_GCUR_X" "11"
 SYSTEM_CONSTANT "INJCRV_FACMI1RMPVAL_GCUR_X" "10"
 SYSTEM_CONSTANT "INJCRV_FACMI1SOERMPVAL_CUR_X" "2"
 SYSTEM_CONSTANT "INJCRV_FACMIAPSPHICOR_AXIS" "8"
 SYSTEM_CONSTANT "INJCRV_FACMIAPSPHICOR_CUR_X" "8"
 SYSTEM_CONSTANT "INJCRV_FACMIATSPHICOR_AXIS" "8"
 SYSTEM_CONSTANT "INJCRV_FACMIATSPHICOR_CUR_X" "8"
 SYSTEM_CONSTANT "INJCRV_FACMIEGRDYNCOR_CUR_X" "6"
 SYSTEM_CONSTANT "INJCRV_FACMIEGRPHICOR_CUR_X" "8"
 SYSTEM_CONSTANT "INJCRV_FACMIETSPHICOR_AXIS" "8"
 SYSTEM_CONSTANT "INJCRV_FACMIETSPHICOR_CUR_X" "8"
 SYSTEM_CONSTANT "INJCRV_FACMIFTSRAILCOR_CUR_X" "8"
 SYSTEM_CONSTANT "INJCRV_FACMIIMTSPHICOR_CUR_X" "8"
 SYSTEM_CONSTANT "INJCRV_FACMIPFLTPHICOR_CUR_X" "2"
 SYSTEM_CONSTANT "INJCRV_FACPII1APSQCORRGN_AXIS" "10"
 SYSTEM_CONSTANT "INJCRV_FACPII1APSQCOR_AXIS" "8"
 SYSTEM_CONSTANT "INJCRV_FACPII1APSSOECORRGN_AXIS" "10"
 SYSTEM_CONSTANT "INJCRV_FACPII1APSSOECOR_AXIS" "10"
 SYSTEM_CONSTANT "INJCRV_FACPII1ATSQCORRGN_AXIS" "6"
 SYSTEM_CONSTANT "INJCRV_FACPII1ATSQCOR_AXIS" "8"
 SYSTEM_CONSTANT "INJCRV_FACPII1ATSSOECORRGN_AXIS" "6"
 SYSTEM_CONSTANT "INJCRV_FACPII1ATSSOECOR_AXIS" "12"
 SYSTEM_CONSTANT "INJCRV_FACPII1ETSQCORRGN_AXIS" "10"
 SYSTEM_CONSTANT "INJCRV_FACPII1ETSQCOR_AXIS" "8"
 SYSTEM_CONSTANT "INJCRV_FACPII1ETSSOECORRGN_AXIS" "10"
 SYSTEM_CONSTANT "INJCRV_FACPII1ETSSOECOR_AXIS" "8"
 SYSTEM_CONSTANT "INJCRV_FACPII1QNTMIN_CUR_X" "8"
 SYSTEM_CONSTANT "INJCRV_FACPII1QNTRMPVAL_CUR_X" "2"
 SYSTEM_CONSTANT "INJCRV_FACPII1RMPVAL_GCUR_X" "10"
 SYSTEM_CONSTANT "INJCRV_FACPII1SOERMPVAL_CUR_X" "2"
 SYSTEM_CONSTANT "INJCRV_FACPII2APSQCORRGN_AXIS" "10"
 SYSTEM_CONSTANT "INJCRV_FACPII2APSQCOR_CUR_X" "12"
 SYSTEM_CONSTANT "INJCRV_FACPII2APSSOECORRGN_AXIS" "10"
 SYSTEM_CONSTANT "INJCRV_FACPII2APSSOECOR_CUR_X" "2"
 SYSTEM_CONSTANT "INJCRV_FACPII2ATSQCORRGN_AXIS" "6"
 SYSTEM_CONSTANT "INJCRV_FACPII2ATSQCOR_CUR_X" "12"
 SYSTEM_CONSTANT "INJCRV_FACPII2ATSSOECORRGN_AXIS" "6"
 SYSTEM_CONSTANT "INJCRV_FACPII2ATSSOECOR_CUR_X" "12"
 SYSTEM_CONSTANT "INJCRV_FACPII2ETSQCOR11_CUR_X" "8"
 SYSTEM_CONSTANT "INJCRV_FACPII2ETSQCORRGN_AXIS" "10"
 SYSTEM_CONSTANT "INJCRV_FACPII2ETSQCOR_CUR_X" "12"
 SYSTEM_CONSTANT "INJCRV_FACPII2ETSSOECORRGN_AXIS" "10"
 SYSTEM_CONSTANT "INJCRV_FACPII2ETSSOECOR_CUR_X" "12"
 SYSTEM_CONSTANT "INJCRV_FACPII2QNTMIN_CUR_X" "8"
 SYSTEM_CONSTANT "INJCRV_FACPII2RMPVAL_GCUR_X" "10"
 SYSTEM_CONSTANT "INJCRV_FACPII3APSQCOR_CUR_X" "8"
 SYSTEM_CONSTANT "INJCRV_FACPII3ATSQCOR_CUR_X" "8"
 SYSTEM_CONSTANT "INJCRV_FACPII3ETSQCOR_CUR_X" "8"
 SYSTEM_CONSTANT "INJCRV_FACPII3ETSSOECOR_CUR_X" "8"
 SYSTEM_CONSTANT "INJCRV_FACPII3QNTMIN_CUR_X" "8"
 SYSTEM_CONSTANT "INJCRV_FACPIIAPSQCOR2_CUR_X" "8"
 SYSTEM_CONSTANT "INJCRV_FACPIIAPSQCOR_CUR_X" "8"
 SYSTEM_CONSTANT "INJCRV_FACPIIATSQCOR2_CUR_X" "8"
 SYSTEM_CONSTANT "INJCRV_FACPIIATSQCOR_CUR_X" "8"
 SYSTEM_CONSTANT "INJCRV_FACPIIETSQCOR2_CUR_X" "8"
 SYSTEM_CONSTANT "INJCRV_FACPIIETSQCOR_CUR_X" "8"
 SYSTEM_CONSTANT "INJCRV_FACPIIETSSOECOR_CUR_X" "8"
 SYSTEM_CONSTANT "INJCRV_FACPOI1APSQCOR_CUR_X" "6"
 SYSTEM_CONSTANT "INJCRV_FACPOI1CATPHICOR_CUR_X" "6"
 SYSTEM_CONSTANT "INJCRV_FACPOI1CATQCOR_CUR_X" "6"
 SYSTEM_CONSTANT "INJCRV_FACPOI1ETSPHICOR_CUR_X" "2"
 SYSTEM_CONSTANT "INJCRV_FACPOI1ETSQCOR_CUR_X" "2"
 SYSTEM_CONSTANT "INJCRV_FACPOI1QNTRMPVAL_CUR_X" "2"
 SYSTEM_CONSTANT "INJCRV_FACPOI1RGNAPSQCOR_CUR_X" "16"
 SYSTEM_CONSTANT "INJCRV_FACPOI1RMPVAL_GCUR_X" "10"
 SYSTEM_CONSTANT "INJCRV_FACPOI1SOERMPVAL_CUR_X" "2"
 SYSTEM_CONSTANT "INJCRV_FACPOI2ANGRMPVAL_CUR_X" "12"
 SYSTEM_CONSTANT "INJCRV_FACPOI2APSQCORRGN_AXIS" "10"
 SYSTEM_CONSTANT "INJCRV_FACPOI2APSQCORSTRT_CUR_X" "6"
 SYSTEM_CONSTANT "INJCRV_FACPOI2APSQCOR_CUR_X" "6"
 SYSTEM_CONSTANT "INJCRV_FACPOI2APSSOECORRGN_AXIS" "10"
 SYSTEM_CONSTANT "INJCRV_FACPOI2APSSOECOR_CUR_X" "6"
 SYSTEM_CONSTANT "INJCRV_FACPOI2ATSQCORRGN_AXIS" "6"
 SYSTEM_CONSTANT "INJCRV_FACPOI2ATSQCORSTRT_CUR_X" "6"
 SYSTEM_CONSTANT "INJCRV_FACPOI2ATSQCOR_CUR_X" "6"
 SYSTEM_CONSTANT "INJCRV_FACPOI2ATSSOECORRGN_AXIS" "6"
 SYSTEM_CONSTANT "INJCRV_FACPOI2ATSSOECOR_CUR_X" "6"
 SYSTEM_CONSTANT "INJCRV_FACPOI2EFFRGN_CUR_X" "12"
 SYSTEM_CONSTANT "INJCRV_FACPOI2EFFRGN_MAP_X" "16"
 SYSTEM_CONSTANT "INJCRV_FACPOI2EFFRGN_MAP_Y" "16"
 SYSTEM_CONSTANT "INJCRV_FACPOI2EFF_MAP_X" "8"
 SYSTEM_CONSTANT "INJCRV_FACPOI2EFF_MAP_Y" "8"
 SYSTEM_CONSTANT "INJCRV_FACPOI2ETSQCORRGN_AXIS" "10"
 SYSTEM_CONSTANT "INJCRV_FACPOI2ETSQCORSTRT_CUR_X" "8"
 SYSTEM_CONSTANT "INJCRV_FACPOI2ETSQCOR_CUR_X" "6"
 SYSTEM_CONSTANT "INJCRV_FACPOI2ETSSOECORRGN_AXIS" "10"
 SYSTEM_CONSTANT "INJCRV_FACPOI2ETSSOECORSTRT_CUR_X" "6"
 SYSTEM_CONSTANT "INJCRV_FACPOI2ETSSOECOR_CUR_X" "6"
 SYSTEM_CONSTANT "INJCRV_FACPOI2QNTMIN_CUR_X" "8"
 SYSTEM_CONSTANT "INJCRV_FACPOI2QNTRMPVAL_CUR_X" "2"
 SYSTEM_CONSTANT "INJCRV_FACPOI2RMPVAL_GCUR_X" "10"
 SYSTEM_CONSTANT "INJCRV_FACPOI2SOERMPVAL_CUR_X" "2"
 SYSTEM_CONSTANT "INJCRV_FACPOI2TIRMPVAL_CUR_X" "12"
 SYSTEM_CONSTANT "INJCRV_FACPOPPOI2ETSCORSTRT_CUR_X" "6"
 SYSTEM_CONSTANT "INJCRV_FACPOPPOI2ETSCOR_CUR_X" "6"
 SYSTEM_CONSTANT "INJCRV_MI1NUMSWTMAX" "6"
 SYSTEM_CONSTANT "INJCRV_MI1NUMSWTSET" "2"
 SYSTEM_CONSTANT "INJCRV_NUMINJRTMLIM_CUR_X" "8"
 SYSTEM_CONSTANT "INJCRV_PHIDYNOFS_CUR_X" "8"
 SYSTEM_CONSTANT "INJCRV_PHIMI1APSCORRGNX_AXIS" "10"
 SYSTEM_CONSTANT "INJCRV_PHIMI1APSCORRGNY_AXIS" "10"
 SYSTEM_CONSTANT "INJCRV_PHIMI1ATSCORRGNX_AXIS" "6"
 SYSTEM_CONSTANT "INJCRV_PHIMI1ATSCORRGNY_AXIS" "6"
 SYSTEM_CONSTANT "INJCRV_PHIMI1BAS1_MAP_X" "10"
 SYSTEM_CONSTANT "INJCRV_PHIMI1BAS1_MAP_Y" "10"
 SYSTEM_CONSTANT "INJCRV_PHIMI1BAS2_MAP_X" "10"
 SYSTEM_CONSTANT "INJCRV_PHIMI1BAS2_MAP_Y" "10"
 SYSTEM_CONSTANT "INJCRV_PHIMI1BAS3_MAP_X" "10"
 SYSTEM_CONSTANT "INJCRV_PHIMI1BAS3_MAP_Y" "10"
 SYSTEM_CONSTANT "INJCRV_PHIMI1BAS4_MAP_X" "2"
 SYSTEM_CONSTANT "INJCRV_PHIMI1BAS4_MAP_Y" "2"
 SYSTEM_CONSTANT "INJCRV_PHIMI1BAS5_MAP_X" "2"
 SYSTEM_CONSTANT "INJCRV_PHIMI1BAS5_MAP_Y" "2"
 SYSTEM_CONSTANT "INJCRV_PHIMI1BASCYLOFFS_MAP_X" "5"
 SYSTEM_CONSTANT "INJCRV_PHIMI1BASCYLOFFS_MAP_Y" "5"
 SYSTEM_CONSTANT "INJCRV_PHIMI1BASRGN1X_AXIS" "16"
 SYSTEM_CONSTANT "INJCRV_PHIMI1BASRGN1Y_AXIS" "16"
 SYSTEM_CONSTANT "INJCRV_PHIMI1BASRGN2X_AXIS" "16"
 SYSTEM_CONSTANT "INJCRV_PHIMI1BASRGN2Y_AXIS" "16"
 SYSTEM_CONSTANT "INJCRV_PHIMI1BASRGN3X_AXIS" "2"
 SYSTEM_CONSTANT "INJCRV_PHIMI1BASRGN3Y_AXIS" "2"
 SYSTEM_CONSTANT "INJCRV_PHIMI1DESCSCMAX_MAP_X" "2"
 SYSTEM_CONSTANT "INJCRV_PHIMI1DESCSCMAX_MAP_Y" "2"
 SYSTEM_CONSTANT "INJCRV_PHIMI1DESCSCMIN_MAP_X" "2"
 SYSTEM_CONSTANT "INJCRV_PHIMI1DESCSCMIN_MAP_Y" "2"
 SYSTEM_CONSTANT "INJCRV_PHIMI1DESCSC_CUR_X" "2"
 SYSTEM_CONSTANT "INJCRV_PHIMI1ETSCORRGNX_AXIS" "2"
 SYSTEM_CONSTANT "INJCRV_PHIMI1ETSCORRGNY_AXIS" "2"
 SYSTEM_CONSTANT "INJCRV_PHIMI1MAX_MAP_X" "8"
 SYSTEM_CONSTANT "INJCRV_PHIMI1MAX_MAP_Y" "8"
 SYSTEM_CONSTANT "INJCRV_PHIMI1MAX_X_AXIS" "16"
 SYSTEM_CONSTANT "INJCRV_PHIMI1MAX_Y_AXIS" "10"
 SYSTEM_CONSTANT "INJCRV_PHIMIAPSCOR_MAP_X" "12"
 SYSTEM_CONSTANT "INJCRV_PHIMIAPSCOR_MAP_Y" "8"
 SYSTEM_CONSTANT "INJCRV_PHIMIAPSCOR_X_AXIS" "16"
 SYSTEM_CONSTANT "INJCRV_PHIMIAPSCOR_Y_AXIS" "16"
 SYSTEM_CONSTANT "INJCRV_PHIMIATSCOR_MAP_X" "12"
 SYSTEM_CONSTANT "INJCRV_PHIMIATSCOR_MAP_Y" "8"
 SYSTEM_CONSTANT "INJCRV_PHIMIATSCOR_X_AXIS" "12"
 SYSTEM_CONSTANT "INJCRV_PHIMIATSCOR_Y_AXIS" "8"
 SYSTEM_CONSTANT "INJCRV_PHIMIEGRDYNCOR_MAP_X" "10"
 SYSTEM_CONSTANT "INJCRV_PHIMIEGRDYNCOR_MAP_Y" "10"
 SYSTEM_CONSTANT "INJCRV_PHIMIEGRLPCOR_MAP_X" "10"
 SYSTEM_CONSTANT "INJCRV_PHIMIEGRLPCOR_MAP_Y" "10"
 SYSTEM_CONSTANT "INJCRV_PHIMIETSCOR_MAP_X" "12"
 SYSTEM_CONSTANT "INJCRV_PHIMIETSCOR_MAP_Y" "8"
 SYSTEM_CONSTANT "INJCRV_PHIMIETSCOR_X_AXIS" "12"
 SYSTEM_CONSTANT "INJCRV_PHIMIETSCOR_Y_AXIS" "8"
 SYSTEM_CONSTANT "INJCRV_PHIMIFTSRAILCOR_MAP_X" "2"
 SYSTEM_CONSTANT "INJCRV_PHIMIFTSRAILCOR_MAP_Y" "2"
 SYSTEM_CONSTANT "INJCRV_PHIMIPFLTCOR_MAP_X" "2"
 SYSTEM_CONSTANT "INJCRV_PHIMIPFLTCOR_MAP_Y" "2"
 SYSTEM_CONSTANT "INJCRV_PHIPII1APSCOR1_MAP_X" "16"
 SYSTEM_CONSTANT "INJCRV_PHIPII1APSCOR1_MAP_Y" "8"
 SYSTEM_CONSTANT "INJCRV_PHIPII1APSCOR2_MAP_X" "16"
 SYSTEM_CONSTANT "INJCRV_PHIPII1APSCOR2_MAP_Y" "8"
 SYSTEM_CONSTANT "INJCRV_PHIPII1ATSCOR1_MAP_X" "16"
 SYSTEM_CONSTANT "INJCRV_PHIPII1ATSCOR1_MAP_Y" "8"
 SYSTEM_CONSTANT "INJCRV_PHIPII1ATSCOR2_MAP_X" "16"
 SYSTEM_CONSTANT "INJCRV_PHIPII1ATSCOR2_MAP_Y" "8"
 SYSTEM_CONSTANT "INJCRV_PHIPII1BAS1_MAP_X" "10"
 SYSTEM_CONSTANT "INJCRV_PHIPII1BAS1_MAP_Y" "10"
 SYSTEM_CONSTANT "INJCRV_PHIPII1BAS2_MAP_X" "10"
 SYSTEM_CONSTANT "INJCRV_PHIPII1BAS2_MAP_Y" "10"
 SYSTEM_CONSTANT "INJCRV_PHIPII1BAS3_MAP_X" "10"
 SYSTEM_CONSTANT "INJCRV_PHIPII1BAS3_MAP_Y" "10"
 SYSTEM_CONSTANT "INJCRV_PHIPII1ETSCOR1_MAP_X" "16"
 SYSTEM_CONSTANT "INJCRV_PHIPII1ETSCOR1_MAP_Y" "8"
 SYSTEM_CONSTANT "INJCRV_PHIPII1ETSCOR2_MAP_X" "16"
 SYSTEM_CONSTANT "INJCRV_PHIPII1ETSCOR2_MAP_Y" "8"
 SYSTEM_CONSTANT "INJCRV_PHIPII1ETSCOR_MAP_X" "16"
 SYSTEM_CONSTANT "INJCRV_PHIPII1ETSCOR_MAP_Y" "8"
 SYSTEM_CONSTANT "INJCRV_PHIPII2APSCOR_MAP_X" "16"
 SYSTEM_CONSTANT "INJCRV_PHIPII2APSCOR_MAP_Y" "8"
 SYSTEM_CONSTANT "INJCRV_PHIPII2ATSCOR_MAP_X" "16"
 SYSTEM_CONSTANT "INJCRV_PHIPII2ATSCOR_MAP_Y" "8"
 SYSTEM_CONSTANT "INJCRV_PHIPII2BAS_MAP_X" "10"
 SYSTEM_CONSTANT "INJCRV_PHIPII2BAS_MAP_Y" "10"
 SYSTEM_CONSTANT "INJCRV_PHIPII2ETSCOR_MAP_X" "16"
 SYSTEM_CONSTANT "INJCRV_PHIPII2ETSCOR_MAP_Y" "8"
 SYSTEM_CONSTANT "INJCRV_PHIPII3BAS1_MAP_X" "10"
 SYSTEM_CONSTANT "INJCRV_PHIPII3BAS1_MAP_Y" "10"
 SYSTEM_CONSTANT "INJCRV_PHIPII3BAS2_MAP_X" "10"
 SYSTEM_CONSTANT "INJCRV_PHIPII3BAS2_MAP_Y" "10"
 SYSTEM_CONSTANT "INJCRV_PHIPII3ETSCOR_MAP_X" "16"
 SYSTEM_CONSTANT "INJCRV_PHIPII3ETSCOR_MAP_Y" "8"
 SYSTEM_CONSTANT "INJCRV_PHIPII3ETS_MAP_X" "10"
 SYSTEM_CONSTANT "INJCRV_PHIPII3ETS_MAP_Y" "10"
 SYSTEM_CONSTANT "INJCRV_PHIPOI1CATCOR_MAP_X" "6"
 SYSTEM_CONSTANT "INJCRV_PHIPOI1CATCOR_MAP_Y" "6"
 SYSTEM_CONSTANT "INJCRV_PHIPOI1MAX_MAP_X" "8"
 SYSTEM_CONSTANT "INJCRV_PHIPOI1MAX_MAP_Y" "8"
 SYSTEM_CONSTANT "INJCRV_PHIPOI2APSCORRGNX_AXIS" "2"
 SYSTEM_CONSTANT "INJCRV_PHIPOI2APSCORRGNY_AXIS" "2"
 SYSTEM_CONSTANT "INJCRV_PHIPOI2APSCOR_MAP_X" "16"
 SYSTEM_CONSTANT "INJCRV_PHIPOI2APSCOR_MAP_Y" "8"
 SYSTEM_CONSTANT "INJCRV_PHIPOI2ATSCORRGNX_AXIS" "2"
 SYSTEM_CONSTANT "INJCRV_PHIPOI2ATSCORRGNY_AXIS" "2"
 SYSTEM_CONSTANT "INJCRV_PHIPOI2ATSCOR_MAP_X" "2"
 SYSTEM_CONSTANT "INJCRV_PHIPOI2ATSCOR_MAP_Y" "2"
 SYSTEM_CONSTANT "INJCRV_PHIPOI2BASRGNX_AXIS" "2"
 SYSTEM_CONSTANT "INJCRV_PHIPOI2BASRGNY_AXIS" "2"
 SYSTEM_CONSTANT "INJCRV_PHIPOI2BAS_MAP_X" "10"
 SYSTEM_CONSTANT "INJCRV_PHIPOI2BAS_MAP_Y" "10"
 SYSTEM_CONSTANT "INJCRV_PHIPOI2ETSCORRGNX_AXIS" "2"
 SYSTEM_CONSTANT "INJCRV_PHIPOI2ETSCORRGNY_AXIS" "2"
 SYSTEM_CONSTANT "INJCRV_PHIPOI2ETSCOR_MAP_X" "2"
 SYSTEM_CONSTANT "INJCRV_PHIPOI2ETSCOR_MAP_Y" "2"
 SYSTEM_CONSTANT "INJCRV_PHIPOI2MAXRGN_MAP_X" "2"
 SYSTEM_CONSTANT "INJCRV_PHIPOI2MAXRGN_MAP_Y" "2"
 SYSTEM_CONSTANT "INJCRV_PHIPOI2MINOILDIL_CUR_X" "6"
 SYSTEM_CONSTANT "INJCRV_PHIPOI2REPLNRM_MAP_X" "16"
 SYSTEM_CONSTANT "INJCRV_PHIPOI2REPLNRM_MAP_Y" "16"
 SYSTEM_CONSTANT "INJCRV_PII1NUMSWTMAX" "6"
 SYSTEM_CONSTANT "INJCRV_PII1NUMSWTSET" "2"
 SYSTEM_CONSTANT "INJCRV_PII2NUMSWTMAX" "6"
 SYSTEM_CONSTANT "INJCRV_PII2NUMSWTSET" "2"
 SYSTEM_CONSTANT "INJCRV_PIIDBLCORMAP_OFF" "0"
 SYSTEM_CONSTANT "INJCRV_PIIDBLCORMAP_ON" "1"
 SYSTEM_CONSTANT "INJCRV_PIONOFF_OFF" "255"
 SYSTEM_CONSTANT "INJCRV_PIONOFF_ON" "0"
 SYSTEM_CONSTANT "INJCRV_POI1NUMSWTMAX" "6"
 SYSTEM_CONSTANT "INJCRV_POI1NUMSWTSET" "2"
 SYSTEM_CONSTANT "INJCRV_POI2NUMSWTMAX" "6"
 SYSTEM_CONSTANT "INJCRV_POI2NUMSWTSET" "2"
 SYSTEM_CONSTANT "INJCRV_POPPII1BAS_MAP_X" "16"
 SYSTEM_CONSTANT "INJCRV_POPPII1BAS_MAP_Y" "10"
 SYSTEM_CONSTANT "INJCRV_POPPII2BAS_MAP_X" "16"
 SYSTEM_CONSTANT "INJCRV_POPPII2BAS_MAP_Y" "10"
 SYSTEM_CONSTANT "INJCRV_POPPIIAIRCOR_CUR_X" "8"
 SYSTEM_CONSTANT "INJCRV_POPPIICTSCOR_CUR_X" "8"
 SYSTEM_CONSTANT "INJCRV_POPPOI1BAS_MAP_X" "2"
 SYSTEM_CONSTANT "INJCRV_POPPOI1BAS_MAP_Y" "2"
 SYSTEM_CONSTANT "INJCRV_POPPOI1ETSCOR_CUR_X" "2"
 SYSTEM_CONSTANT "INJCRV_POPPOI1RGN_MAP_X" "6"
 SYSTEM_CONSTANT "INJCRV_POPPOI1RGN_MAP_Y" "6"
 SYSTEM_CONSTANT "INJCRV_POPPOI2BASSTRT_MAP_X" "8"
 SYSTEM_CONSTANT "INJCRV_POPPOI2BASSTRT_MAP_Y" "8"
 SYSTEM_CONSTANT "INJCRV_POPPOI2BAS_MAP_X" "2"
 SYSTEM_CONSTANT "INJCRV_POPPOI2BAS_MAP_Y" "2"
 SYSTEM_CONSTANT "INJCRV_POPPOI2ETSCORSTRT_MAP_X" "2"
 SYSTEM_CONSTANT "INJCRV_POPPOI2ETSCORSTRT_MAP_Y" "2"
 SYSTEM_CONSTANT "INJCRV_POPPOI2ETSCOR_MAP_X" "2"
 SYSTEM_CONSTANT "INJCRV_POPPOI2ETSCOR_MAP_Y" "2"
 SYSTEM_CONSTANT "INJCRV_POPPOI2RGN_MAP_X" "6"
 SYSTEM_CONSTANT "INJCRV_POPPOI2RGN_MAP_Y" "6"
 SYSTEM_CONSTANT "INJCRV_QACT" "1"
 SYSTEM_CONSTANT "INJCRV_QMI1CORX_AXIS" "8"
 SYSTEM_CONSTANT "INJCRV_QMI1CORY_AXIS" "8"
 SYSTEM_CONSTANT "INJCRV_QMI1CSCMAX_MAP_X" "2"
 SYSTEM_CONSTANT "INJCRV_QMI1CSCMAX_MAP_Y" "2"
 SYSTEM_CONSTANT "INJCRV_QMI1CSCMIN_MAP_X" "2"
 SYSTEM_CONSTANT "INJCRV_QMI1CSCMIN_MAP_Y" "2"
 SYSTEM_CONSTANT "INJCRV_QMI1CSC_CUR_X" "2"
 SYSTEM_CONSTANT "INJCRV_QMIN1_CUR_X" "25"
 SYSTEM_CONSTANT "INJCRV_QMIN2_CUR_X" "25"
 SYSTEM_CONSTANT "INJCRV_QMIN3_CUR_X" "25"
 SYSTEM_CONSTANT "INJCRV_QMIN4_CUR_X" "25"
 SYSTEM_CONSTANT "INJCRV_QMIN5_CUR_X" "25"
 SYSTEM_CONSTANT "INJCRV_QMIN_CUR_X" "16"
 SYSTEM_CONSTANT "INJCRV_QMIN_MAP_X" "16"
 SYSTEM_CONSTANT "INJCRV_QMIN_MAP_Y" "16"
 SYSTEM_CONSTANT "INJCRV_QPII1APSCORRGNX_AXIS" "10"
 SYSTEM_CONSTANT "INJCRV_QPII1APSCORRGNY_AXIS" "10"
 SYSTEM_CONSTANT "INJCRV_QPII1APSCOR_MAP_X" "16"
 SYSTEM_CONSTANT "INJCRV_QPII1APSCOR_MAP_Y" "8"
 SYSTEM_CONSTANT "INJCRV_QPII1APSCOR_X_AXIS" "16"
 SYSTEM_CONSTANT "INJCRV_QPII1APSCOR_Y_AXIS" "8"
 SYSTEM_CONSTANT "INJCRV_QPII1ATSCORRGNX_AXIS" "10"
 SYSTEM_CONSTANT "INJCRV_QPII1ATSCORRGNY_AXIS" "10"
 SYSTEM_CONSTANT "INJCRV_QPII1ATSCOR_MAP_X" "16"
 SYSTEM_CONSTANT "INJCRV_QPII1ATSCOR_MAP_Y" "8"
 SYSTEM_CONSTANT "INJCRV_QPII1ATSCOR_X_AXIS" "16"
 SYSTEM_CONSTANT "INJCRV_QPII1ATSCOR_Y_AXIS" "16"
 SYSTEM_CONSTANT "INJCRV_QPII1BASCYLOFFS_MAP_X" "5"
 SYSTEM_CONSTANT "INJCRV_QPII1BASCYLOFFS_MAP_Y" "5"
 SYSTEM_CONSTANT "INJCRV_QPII1BASRGNX_AXIS" "10"
 SYSTEM_CONSTANT "INJCRV_QPII1BASRGNY_AXIS" "10"
 SYSTEM_CONSTANT "INJCRV_QPII1BAS_MAP_X" "16"
 SYSTEM_CONSTANT "INJCRV_QPII1BAS_MAP_Y" "16"
 SYSTEM_CONSTANT "INJCRV_QPII1BAS_X_AXIS" "16"
 SYSTEM_CONSTANT "INJCRV_QPII1BAS_Y_AXIS" "16"
 SYSTEM_CONSTANT "INJCRV_QPII1ETSCORRGNX_AXIS" "2"
 SYSTEM_CONSTANT "INJCRV_QPII1ETSCORRGNY_AXIS" "2"
 SYSTEM_CONSTANT "INJCRV_QPII1ETSCOR_MAP_X" "16"
 SYSTEM_CONSTANT "INJCRV_QPII1ETSCOR_MAP_Y" "8"
 SYSTEM_CONSTANT "INJCRV_QPII1ETSCOR_X_AXIS" "16"
 SYSTEM_CONSTANT "INJCRV_QPII1ETSCOR_Y_AXIS" "8"
 SYSTEM_CONSTANT "INJCRV_QPII1MAXRGNX_AXIS" "16"
 SYSTEM_CONSTANT "INJCRV_QPII1MAXRGNY_AXIS" "16"
 SYSTEM_CONSTANT "INJCRV_QPII1MAXRGN_MAP_X" "8"
 SYSTEM_CONSTANT "INJCRV_QPII1MAXRGN_MAP_Y" "16"
 SYSTEM_CONSTANT "INJCRV_QPII1MAX_MAP_X" "16"
 SYSTEM_CONSTANT "INJCRV_QPII1MAX_MAP_Y" "10"
 SYSTEM_CONSTANT "INJCRV_QPII1MAX_X_AXIS" "16"
 SYSTEM_CONSTANT "INJCRV_QPII1MAX_Y_AXIS" "10"
 SYSTEM_CONSTANT "INJCRV_QPII2APSCORRGNX_AXIS" "10"
 SYSTEM_CONSTANT "INJCRV_QPII2APSCORRGNY_AXIS" "10"
 SYSTEM_CONSTANT "INJCRV_QPII2APSCOR_MAP_X" "9"
 SYSTEM_CONSTANT "INJCRV_QPII2APSCOR_MAP_Y" "8"
 SYSTEM_CONSTANT "INJCRV_QPII2ATSCORRGNX_AXIS" "10"
 SYSTEM_CONSTANT "INJCRV_QPII2ATSCORRGNY_AXIS" "10"
 SYSTEM_CONSTANT "INJCRV_QPII2ATSCOR_MAP_X" "13"
 SYSTEM_CONSTANT "INJCRV_QPII2ATSCOR_MAP_Y" "8"
 SYSTEM_CONSTANT "INJCRV_QPII2BAS_MAP_X" "16"
 SYSTEM_CONSTANT "INJCRV_QPII2BAS_MAP_Y" "16"
 SYSTEM_CONSTANT "INJCRV_QPII2ETSCOR11_MAP_X" "10"
 SYSTEM_CONSTANT "INJCRV_QPII2ETSCOR11_MAP_Y" "10"
 SYSTEM_CONSTANT "INJCRV_QPII2ETSCORRGNX_AXIS" "2"
 SYSTEM_CONSTANT "INJCRV_QPII2ETSCORRGNY_AXIS" "2"
 SYSTEM_CONSTANT "INJCRV_QPII2ETSCOR_MAP_X" "10"
 SYSTEM_CONSTANT "INJCRV_QPII2ETSCOR_MAP_Y" "8"
 SYSTEM_CONSTANT "INJCRV_QPII2MAX_MAP_X" "8"
 SYSTEM_CONSTANT "INJCRV_QPII2MAX_MAP_Y" "8"
 SYSTEM_CONSTANT "INJCRV_QPII3APSCOR_MAP_X" "16"
 SYSTEM_CONSTANT "INJCRV_QPII3APSCOR_MAP_Y" "8"
 SYSTEM_CONSTANT "INJCRV_QPII3ATSCOR_MAP_X" "16"
 SYSTEM_CONSTANT "INJCRV_QPII3ATSCOR_MAP_Y" "8"
 SYSTEM_CONSTANT "INJCRV_QPII3BAS_MAP_X" "16"
 SYSTEM_CONSTANT "INJCRV_QPII3BAS_MAP_Y" "16"
 SYSTEM_CONSTANT "INJCRV_QPII3ETSCOR_MAP_X" "16"
 SYSTEM_CONSTANT "INJCRV_QPII3ETSCOR_MAP_Y" "8"
 SYSTEM_CONSTANT "INJCRV_QPII3MAX_MAP_X" "16"
 SYSTEM_CONSTANT "INJCRV_QPII3MAX_MAP_Y" "10"
 SYSTEM_CONSTANT "INJCRV_QPIIAPSCOR_MAP_X" "16"
 SYSTEM_CONSTANT "INJCRV_QPIIAPSCOR_MAP_Y" "8"
 SYSTEM_CONSTANT "INJCRV_QPIIATSCOR_MAP_X" "16"
 SYSTEM_CONSTANT "INJCRV_QPIIATSCOR_MAP_Y" "8"
 SYSTEM_CONSTANT "INJCRV_QPIIETSCOR_MAP_X" "16"
 SYSTEM_CONSTANT "INJCRV_QPIIETSCOR_MAP_Y" "8"
 SYSTEM_CONSTANT "INJCRV_QPOI1APSCOR_MAP_X" "2"
 SYSTEM_CONSTANT "INJCRV_QPOI1APSCOR_MAP_Y" "2"
 SYSTEM_CONSTANT "INJCRV_QPOI1BASRGNX_AXIS" "16"
 SYSTEM_CONSTANT "INJCRV_QPOI1BASRGNY_AXIS" "16"
 SYSTEM_CONSTANT "INJCRV_QPOI1BAS_MAP_X" "2"
 SYSTEM_CONSTANT "INJCRV_QPOI1BAS_MAP_Y" "2"
 SYSTEM_CONSTANT "INJCRV_QPOI1CATCOR_MAP_X" "6"
 SYSTEM_CONSTANT "INJCRV_QPOI1CATCOR_MAP_Y" "6"
 SYSTEM_CONSTANT "INJCRV_QPOI1ETSCOR_MAP_X" "2"
 SYSTEM_CONSTANT "INJCRV_QPOI1ETSCOR_MAP_Y" "2"
 SYSTEM_CONSTANT "INJCRV_QPOI1MAX_MAP_X" "6"
 SYSTEM_CONSTANT "INJCRV_QPOI1MAX_MAP_Y" "6"
 SYSTEM_CONSTANT "INJCRV_QPOI1RGNAPSCOR_MAP_X" "16"
 SYSTEM_CONSTANT "INJCRV_QPOI1RGNAPSCOR_MAP_Y" "16"
 SYSTEM_CONSTANT "INJCRV_QPOI2APSCORRGNX_AXIS" "10"
 SYSTEM_CONSTANT "INJCRV_QPOI2APSCORRGNY_AXIS" "10"
 SYSTEM_CONSTANT "INJCRV_QPOI2APSCORSTRT_MAP_X" "12"
 SYSTEM_CONSTANT "INJCRV_QPOI2APSCORSTRT_MAP_Y" "9"
 SYSTEM_CONSTANT "INJCRV_QPOI2APSCOR_MAP_X" "6"
 SYSTEM_CONSTANT "INJCRV_QPOI2APSCOR_MAP_Y" "6"
 SYSTEM_CONSTANT "INJCRV_QPOI2ATSCORRGNX_AXIS" "10"
 SYSTEM_CONSTANT "INJCRV_QPOI2ATSCORRGNY_AXIS" "10"
 SYSTEM_CONSTANT "INJCRV_QPOI2ATSCORSTRT_MAP_X" "2"
 SYSTEM_CONSTANT "INJCRV_QPOI2ATSCORSTRT_MAP_Y" "2"
 SYSTEM_CONSTANT "INJCRV_QPOI2ATSCOR_MAP_X" "12"
 SYSTEM_CONSTANT "INJCRV_QPOI2ATSCOR_MAP_Y" "9"
 SYSTEM_CONSTANT "INJCRV_QPOI2BASRGNX_AXIS" "16"
 SYSTEM_CONSTANT "INJCRV_QPOI2BASRGNY_AXIS" "16"
 SYSTEM_CONSTANT "INJCRV_QPOI2BASSTRT_MAP_X" "8"
 SYSTEM_CONSTANT "INJCRV_QPOI2BASSTRT_MAP_Y" "8"
 SYSTEM_CONSTANT "INJCRV_QPOI2BAS_MAP_X" "8"
 SYSTEM_CONSTANT "INJCRV_QPOI2BAS_MAP_Y" "8"
 SYSTEM_CONSTANT "INJCRV_QPOI2ETSCORRGNX_AXIS" "2"
 SYSTEM_CONSTANT "INJCRV_QPOI2ETSCORRGNY_AXIS" "2"
 SYSTEM_CONSTANT "INJCRV_QPOI2ETSCORSTRT_MAP_X" "7"
 SYSTEM_CONSTANT "INJCRV_QPOI2ETSCORSTRT_MAP_Y" "6"
 SYSTEM_CONSTANT "INJCRV_QPOI2ETSCOR_MAP_X" "2"
 SYSTEM_CONSTANT "INJCRV_QPOI2ETSCOR_MAP_Y" "2"
 SYSTEM_CONSTANT "INJCRV_QPOI2MIN_CUR_X" "6"
 SYSTEM_CONSTANT "INJCRV_QRAW" "0"
 SYSTEM_CONSTANT "INJCRV_RMI1DESCSC_CUR_X" "16"
 SYSTEM_CONSTANT "INJCRV_RMI1QNTCSC_CUR_X" "16"
 SYSTEM_CONSTANT "INJCRV_STPIIRLSOPRNG1_MAP_X" "10"
 SYSTEM_CONSTANT "INJCRV_STPIIRLSOPRNG1_MAP_Y" "10"
 SYSTEM_CONSTANT "INJCRV_STPIIRLSOPRNG2_MAP_X" "10"
 SYSTEM_CONSTANT "INJCRV_STPIIRLSOPRNG2_MAP_Y" "10"
 SYSTEM_CONSTANT "INJCRV_STPIIRLSOPRNG3_MAP_X" "10"
 SYSTEM_CONSTANT "INJCRV_STPIIRLSOPRNG3_MAP_Y" "10"
 SYSTEM_CONSTANT "INJCRV_STPIIRLSOPRNG4_MAP_X" "10"
 SYSTEM_CONSTANT "INJCRV_STPIIRLSOPRNG4_MAP_Y" "10"
 SYSTEM_CONSTANT "INJCRV_STPIIRLSOPRNG5_MAP_X" "10"
 SYSTEM_CONSTANT "INJCRV_STPIIRLSOPRNG5_MAP_Y" "10"
 SYSTEM_CONSTANT "INJCRV_STPIIRLSOPRNG6_MAP_X" "10"
 SYSTEM_CONSTANT "INJCRV_STPIIRLSOPRNG6_MAP_Y" "10"
 SYSTEM_CONSTANT "INJCRV_STRLSOPRNGTHRESRGN_MAP_X" "10"
 SYSTEM_CONSTANT "INJCRV_STRLSOPRNGTHRESRGN_MAP_Y" "10"
 SYSTEM_CONSTANT "INJCRV_STRLSOPRNGTHRES_MAP_X" "16"
 SYSTEM_CONSTANT "INJCRV_STRLSOPRNGTHRES_MAP_Y" "16"
 SYSTEM_CONSTANT "INJCRV_SWTPIIDBLCORMAP_TYPE" "2"
 SYSTEM_CONSTANT "INJCRV_SWTPIIDBLCORMAP_VAL" "0"
 SYSTEM_CONSTANT "INJCRV_SWTPIONOFF_TYPE" "0"
 SYSTEM_CONSTANT "INJCRV_SWTPIONOFF_VAL" "0"
 SYSTEM_CONSTANT "INJCRV_SWTTIPSE_TYPE" "2"
 SYSTEM_CONSTANT "INJCRV_SWTTIPSE_VAL" "0"
 SYSTEM_CONSTANT "INJCRV_TIPII1APSCOR1_MAP_X" "10"
 SYSTEM_CONSTANT "INJCRV_TIPII1APSCOR1_MAP_Y" "8"
 SYSTEM_CONSTANT "INJCRV_TIPII1APSCOR2_MAP_X" "10"
 SYSTEM_CONSTANT "INJCRV_TIPII1APSCOR2_MAP_Y" "8"
 SYSTEM_CONSTANT "INJCRV_TIPII1APSCORRGNX_AXIS" "10"
 SYSTEM_CONSTANT "INJCRV_TIPII1APSCORRGNY_AXIS" "10"
 SYSTEM_CONSTANT "INJCRV_TIPII1ATSCOR1_MAP_X" "16"
 SYSTEM_CONSTANT "INJCRV_TIPII1ATSCOR1_MAP_Y" "8"
 SYSTEM_CONSTANT "INJCRV_TIPII1ATSCOR2_MAP_X" "10"
 SYSTEM_CONSTANT "INJCRV_TIPII1ATSCOR2_MAP_Y" "8"
 SYSTEM_CONSTANT "INJCRV_TIPII1ATSCORRGNX_AXIS" "10"
 SYSTEM_CONSTANT "INJCRV_TIPII1ATSCORRGNY_AXIS" "10"
 SYSTEM_CONSTANT "INJCRV_TIPII1BAS1_MAP_X" "16"
 SYSTEM_CONSTANT "INJCRV_TIPII1BAS1_MAP_Y" "16"
 SYSTEM_CONSTANT "INJCRV_TIPII1BAS2_MAP_X" "16"
 SYSTEM_CONSTANT "INJCRV_TIPII1BAS2_MAP_Y" "16"
 SYSTEM_CONSTANT "INJCRV_TIPII1BAS3_MAP_X" "2"
 SYSTEM_CONSTANT "INJCRV_TIPII1BAS3_MAP_Y" "2"
 SYSTEM_CONSTANT "INJCRV_TIPII1BASCYLOFFS_MAP_X" "5"
 SYSTEM_CONSTANT "INJCRV_TIPII1BASCYLOFFS_MAP_Y" "5"
 SYSTEM_CONSTANT "INJCRV_TIPII1BASRGNX_AXIS" "12"
 SYSTEM_CONSTANT "INJCRV_TIPII1BASRGNY_AXIS" "16"
 SYSTEM_CONSTANT "INJCRV_TIPII1ETSCOR1_MAP_X" "16"
 SYSTEM_CONSTANT "INJCRV_TIPII1ETSCOR1_MAP_Y" "8"
 SYSTEM_CONSTANT "INJCRV_TIPII1ETSCOR2_MAP_X" "16"
 SYSTEM_CONSTANT "INJCRV_TIPII1ETSCOR2_MAP_Y" "8"
 SYSTEM_CONSTANT "INJCRV_TIPII1ETSCORRGNX_AXIS" "2"
 SYSTEM_CONSTANT "INJCRV_TIPII1ETSCORRGNY_AXIS" "2"
 SYSTEM_CONSTANT "INJCRV_TIPII1ETSCOR_MAP_X" "16"
 SYSTEM_CONSTANT "INJCRV_TIPII1ETSCOR_MAP_Y" "8"
 SYSTEM_CONSTANT "INJCRV_TIPII1MIN2_MAP_X" "10"
 SYSTEM_CONSTANT "INJCRV_TIPII1MIN2_MAP_Y" "10"
 SYSTEM_CONSTANT "INJCRV_TIPII2APSCORRGNX_AXIS" "10"
 SYSTEM_CONSTANT "INJCRV_TIPII2APSCORRGNY_AXIS" "10"
 SYSTEM_CONSTANT "INJCRV_TIPII2APSCOR_MAP_X" "10"
 SYSTEM_CONSTANT "INJCRV_TIPII2APSCOR_MAP_Y" "10"
 SYSTEM_CONSTANT "INJCRV_TIPII2ATSCORRGNX_AXIS" "10"
 SYSTEM_CONSTANT "INJCRV_TIPII2ATSCORRGNY_AXIS" "10"
 SYSTEM_CONSTANT "INJCRV_TIPII2ATSCOR_MAP_X" "10"
 SYSTEM_CONSTANT "INJCRV_TIPII2ATSCOR_MAP_Y" "10"
 SYSTEM_CONSTANT "INJCRV_TIPII2BASCYLOFFS_MAP_X" "5"
 SYSTEM_CONSTANT "INJCRV_TIPII2BASCYLOFFS_MAP_Y" "5"
 SYSTEM_CONSTANT "INJCRV_TIPII2BAS_MAP_X" "10"
 SYSTEM_CONSTANT "INJCRV_TIPII2BAS_MAP_Y" "10"
 SYSTEM_CONSTANT "INJCRV_TIPII2ETSCORRGNX_AXIS" "2"
 SYSTEM_CONSTANT "INJCRV_TIPII2ETSCORRGNY_AXIS" "2"
 SYSTEM_CONSTANT "INJCRV_TIPII2ETSCOR_MAP_X" "16"
 SYSTEM_CONSTANT "INJCRV_TIPII2ETSCOR_MAP_Y" "16"
 SYSTEM_CONSTANT "INJCRV_TIPII2MIN_MAP_X" "10"
 SYSTEM_CONSTANT "INJCRV_TIPII2MIN_MAP_Y" "10"
 SYSTEM_CONSTANT "INJCRV_TIPOI1BASRGNX_AXIS" "16"
 SYSTEM_CONSTANT "INJCRV_TIPOI1BASRGNY_AXIS" "16"
 SYSTEM_CONSTANT "INJCRV_TIPOI1BAS_MAP_X" "2"
 SYSTEM_CONSTANT "INJCRV_TIPOI1BAS_MAP_Y" "2"
 SYSTEM_CONSTANT "INJCRV_TIPOI1ETSCOR_MAP_X" "2"
 SYSTEM_CONSTANT "INJCRV_TIPOI1ETSCOR_MAP_Y" "2"
 SYSTEM_CONSTANT "INJCRV_TIPOI1MAXOFS_MAP_X" "8"
 SYSTEM_CONSTANT "INJCRV_TIPOI1MAXOFS_MAP_Y" "8"
 SYSTEM_CONSTANT "INJCRV_TIPOI2APSCOR_MAP_X" "16"
 SYSTEM_CONSTANT "INJCRV_TIPOI2APSCOR_MAP_Y" "8"
 SYSTEM_CONSTANT "INJCRV_TIPOI2ATSCOR_MAP_X" "2"
 SYSTEM_CONSTANT "INJCRV_TIPOI2ATSCOR_MAP_Y" "2"
 SYSTEM_CONSTANT "INJCRV_TIPOI2BASSTRT_MAP_X" "8"
 SYSTEM_CONSTANT "INJCRV_TIPOI2BASSTRT_MAP_Y" "8"
 SYSTEM_CONSTANT "INJCRV_TIPOI2BAS_MAP_X" "10"
 SYSTEM_CONSTANT "INJCRV_TIPOI2BAS_MAP_Y" "10"
 SYSTEM_CONSTANT "INJCRV_TIPOI2ETSCORSTRT_MAP_X" "2"
 SYSTEM_CONSTANT "INJCRV_TIPOI2ETSCORSTRT_MAP_Y" "2"
 SYSTEM_CONSTANT "INJCRV_TIPOI2ETSCOR_MAP_X" "2"
 SYSTEM_CONSTANT "INJCRV_TIPOI2ETSCOR_MAP_Y" "2"
 SYSTEM_CONSTANT "INJCRV_TIPOI2MAX_MAP_X" "4"
 SYSTEM_CONSTANT "INJCRV_TIPOI2MAX_MAP_Y" "4"
 SYSTEM_CONSTANT "INJCRV_TIPSE_CONST" "0"
 SYSTEM_CONSTANT "INJCRV_TIPSE_UPD" "1"
 SYSTEM_CONSTANT "INJCRV_ZR" "0"
 SYSTEM_CONSTANT "INJCTL_QADJQNT_MAP_X" "8"
 SYSTEM_CONSTANT "INJCTL_QADJQNT_MAP_Y" "6"
 SYSTEM_CONSTANT "INJCTL_QLIMERR_CUR_X" "25"
 SYSTEM_CONSTANT "INJMASS_PERS_RES" "0.01"
 SYSTEM_CONSTANT "INJMSPRTIMEQ0P001_INVRESO" "1000"
 SYSTEM_CONSTANT "INJMSPRTIMEQ0P001_RESO" "0.001"
 SYSTEM_CONSTANT "INJSYS_CRS_PII2" "1"
 SYSTEM_CONSTANT "INJSYS_CRS_PII3" "0"
 SYSTEM_CONSTANT "INJSYS_CRS_POI1" "1"
 SYSTEM_CONSTANT "INJSYS_CRS_POI2" "1"
 SYSTEM_CONSTANT "INJSYS_CRS_QWC" "1"
 SYSTEM_CONSTANT "INJSYS_SWTRC" "1"
 SYSTEM_CONSTANT "INJTIME_US_MAX" "400"
 SYSTEM_CONSTANT "INJTIME_US_MIN" "20"
 SYSTEM_CONSTANT "INJTIME_US_ZERO" "0"
 SYSTEM_CONSTANT "INJUN_FACFLMASSCNV_MAP_X" "16"
 SYSTEM_CONSTANT "INJUN_FACFLMASSCNV_MAP_Y" "16"
 SYSTEM_CONSTANT "INJVCD_TIET2_MAP_X" "16"
 SYSTEM_CONSTANT "INJVCD_TIET2_MAP_Y" "20"
 SYSTEM_CONSTANT "INJVCD_TIET3_MAP_X" "16"
 SYSTEM_CONSTANT "INJVCD_TIET3_MAP_Y" "20"
 SYSTEM_CONSTANT "INJVCD_TIET4_MAP_X" "16"
 SYSTEM_CONSTANT "INJVCD_TIET4_MAP_Y" "20"
 SYSTEM_CONSTANT "INJVCD_TIET5_MAP_X" "16"
 SYSTEM_CONSTANT "INJVCD_TIET5_MAP_Y" "20"
 SYSTEM_CONSTANT "INJVCD_TIET6_MAP_X" "16"
 SYSTEM_CONSTANT "INJVCD_TIET6_MAP_Y" "20"
 SYSTEM_CONSTANT "INJVCD_TIET_MAP_X" "16"
 SYSTEM_CONSTANT "INJVCD_TIET_MAP_Y" "20"
 SYSTEM_CONSTANT "INJVCD_TIPICKUPCURR_CUR_X" "2"
 SYSTEM_CONSTANT "INJVLV_FACADDBALRLS_MAP_X" "3"
 SYSTEM_CONSTANT "INJVLV_FACADDBALRLS_MAP_Y" "2"
 SYSTEM_CONSTANT "INJVLV_FACPII1QNTCOR_CUR_X" "10"
 SYSTEM_CONSTANT "INJVLV_MI1" "2"
 SYSTEM_CONSTANT "INJVLV_MI2" "3"
 SYSTEM_CONSTANT "INJVLV_NUMINJCHRGBAL_MAP_X" "8"
 SYSTEM_CONSTANT "INJVLV_NUMINJCHRGBAL_MAP_Y" "4"
 SYSTEM_CONSTANT "INJVLV_NUM_BNK" "2"
 SYSTEM_CONSTANT "INJVLV_NUM_BUFVLTG" "1"
 SYSTEM_CONSTANT "INJVLV_NUM_BUF_PER_ADCCHN" "2"
 SYSTEM_CONSTANT "INJVLV_NUM_CHIPS" "1"
 SYSTEM_CONSTANT "INJVLV_NUM_INJ_PLC" "10"
 SYSTEM_CONSTANT "INJVLV_PII1" "4"
 SYSTEM_CONSTANT "INJVLV_PII2" "5"
 SYSTEM_CONSTANT "INJVLV_PII3" "6"
 SYSTEM_CONSTANT "INJVLV_PII4" "7"
 SYSTEM_CONSTANT "INJVLV_PMIN_CUR_X" "8"
 SYSTEM_CONSTANT "INJVLV_POI1" "0"
 SYSTEM_CONSTANT "INJVLV_POI1EFF" "9"
 SYSTEM_CONSTANT "INJVLV_POI2" "1"
 SYSTEM_CONSTANT "INJVLV_POI2EFF" "8"
 SYSTEM_CONSTANT "INJVLV_RMI1TCSC_CUR_X" "2"
 SYSTEM_CONSTANT "INJVLV_SEL_MI1" "6"
 SYSTEM_CONSTANT "INJVLV_SEL_MI1PII1" "7"
 SYSTEM_CONSTANT "INJVLV_SEL_MI1PII1PII2" "8"
 SYSTEM_CONSTANT "INJVLV_SEL_MI1PII1PII3" "9"
 SYSTEM_CONSTANT "INJVLV_SEL_MI1_ESTET" "3"
 SYSTEM_CONSTANT "INJVLV_SEL_PII1" "10"
 SYSTEM_CONSTANT "INJVLV_SEL_PII1PII2" "11"
 SYSTEM_CONSTANT "INJVLV_SEL_PII1_ESTET" "0"
 SYSTEM_CONSTANT "INJVLV_SEL_PII2" "12"
 SYSTEM_CONSTANT "INJVLV_SEL_PII2_ESTET" "1"
 SYSTEM_CONSTANT "INJVLV_SEL_PII3" "13"
 SYSTEM_CONSTANT "INJVLV_SEL_PII3_ESTET" "2"
 SYSTEM_CONSTANT "INJVLV_SEL_POI1" "14"
 SYSTEM_CONSTANT "INJVLV_SEL_POI1_ESTET" "4"
 SYSTEM_CONSTANT "INJVLV_SEL_POI2" "15"
 SYSTEM_CONSTANT "INJVLV_SEL_POI2_ESTET" "5"
 SYSTEM_CONSTANT "INJVLV_TCTLINJ" "63"
 SYSTEM_CONSTANT "INJVLV_TIET2_MAP_X" "16"
 SYSTEM_CONSTANT "INJVLV_TIET2_MAP_Y" "20"
 SYSTEM_CONSTANT "INJVLV_TIET3_MAP_X" "16"
 SYSTEM_CONSTANT "INJVLV_TIET3_MAP_Y" "20"
 SYSTEM_CONSTANT "INJVLV_TIET4_MAP_X" "16"
 SYSTEM_CONSTANT "INJVLV_TIET4_MAP_Y" "20"
 SYSTEM_CONSTANT "INJVLV_TIET5_MAP_X" "16"
 SYSTEM_CONSTANT "INJVLV_TIET5_MAP_Y" "20"
 SYSTEM_CONSTANT "INJVLV_TIET6_MAP_X" "16"
 SYSTEM_CONSTANT "INJVLV_TIET6_MAP_Y" "20"
 SYSTEM_CONSTANT "INJVLV_TIET_C011_MAP_Y" "40"
 SYSTEM_CONSTANT "INJVLV_TIET_MAP_X" "18"
 SYSTEM_CONSTANT "INJVLV_TIET_MAP_Y" "40"
 SYSTEM_CONSTANT "INJVLV_TIMI1CSCMAX_MAP_X" "2"
 SYSTEM_CONSTANT "INJVLV_TIMI1CSCMAX_MAP_Y" "2"
 SYSTEM_CONSTANT "INJVLV_TIMI1CSCMIN_MAP_X" "2"
 SYSTEM_CONSTANT "INJVLV_TIMI1CSCMIN_MAP_Y" "2"
 SYSTEM_CONSTANT "INJVLV_TIMI1CSC_CUR_X" "2"
 SYSTEM_CONSTANT "INJVLV_TIPICKUPCURR_CUR_X" "2"
 SYSTEM_CONSTANT "INJVLV_ZFC" "9"
 SYSTEM_CONSTANT "INJ_MASS100_MAX" "100"
 SYSTEM_CONSTANT "INJ_MASSCYC_MAX" "327.67"
 SYSTEM_CONSTANT "INJ_MASSCYC_MIN" "0"
 SYSTEM_CONSTANT "INJ_MASSCYC_RES" "0.01"
 SYSTEM_CONSTANT "INJ_MASSCYC_RES_INV" "100"
 SYSTEM_CONSTANT "INJ_MASSCYC_ZERO" "0"
 SYSTEM_CONSTANT "INJ_MASSETCTL_MAX" "200"
 SYSTEM_CONSTANT "INJ_MASSETCTL_MIN" "-200"
 SYSTEM_CONSTANT "INJ_MASSINJ_MAX" "327.67"
 SYSTEM_CONSTANT "INJ_MASSINJ_MIN" "0"
 SYSTEM_CONSTANT "INJ_MASSINJ_RES" "0.01"
 SYSTEM_CONSTANT "INJ_MASSINJ_RES_REV" "100"
 SYSTEM_CONSTANT "INJ_MASSMIN_MAX" "10"
 SYSTEM_CONSTANT "INJ_MASSPII1_MAX" "10"
 SYSTEM_CONSTANT "INJ_MASSPII2_MAX" "10"
 SYSTEM_CONSTANT "INJ_MASSPII3_MAX" "10"
 SYSTEM_CONSTANT "INJ_MASSPOI1_MAX" "10"
 SYSTEM_CONSTANT "INJ_MASSPOI2_MAX" "10"
 SYSTEM_CONSTANT "INJ_MASS_ETCTL" "0.1"
 SYSTEM_CONSTANT "INJ_MASS_MAX" "327.67"
 SYSTEM_CONSTANT "INJ_MASS_MIN" "0"
 SYSTEM_CONSTANT "INJ_MASS_ONE" "1"
 SYSTEM_CONSTANT "INJ_MASS_RES" "0.01"
 SYSTEM_CONSTANT "INJ_MASS_RES_FL" "0.01"
 SYSTEM_CONSTANT "INJ_MASS_RES_INV" "100"
 SYSTEM_CONSTANT "INJ_MASS_RES_INV_FL" "100"
 SYSTEM_CONSTANT "INJ_MASS_ZERO" "0"
 SYSTEM_CONSTANT "INJ_QNTINJ_MAX" "100"
 SYSTEM_CONSTANT "INJ_QNTINJ_MIN" "0"
 SYSTEM_CONSTANT "INJ_QNTINJ_RES" "0.01"
 SYSTEM_CONSTANT "INJ_QNTINJ_ZERO" "0"
 SYSTEM_CONSTANT "INJ_QNT_RES" "0.1"
 SYSTEM_CONSTANT "INTAMP_FAC_RES" "0.001"
 SYSTEM_CONSTANT "ISC_ACTIVE" "0"
 SYSTEM_CONSTANT "ISC_CLTH_CLSD" "8"
 SYSTEM_CONSTANT "ISC_CLTH_CLSD_POS" "3"
 SYSTEM_CONSTANT "ISC_CLTH_CTL" "2"
 SYSTEM_CONSTANT "ISC_CLTH_CTL_POS" "2"
 SYSTEM_CONSTANT "ISC_CLTH_OPN" "4"
 SYSTEM_CONSTANT "ISC_CLTH_OPN_POS" "1"
 SYSTEM_CONSTANT "ISC_CLTH_PN" "5"
 SYSTEM_CONSTANT "ISC_CLTH_PN_POS" "0"
 SYSTEM_CONSTANT "ISC_CNVACCBD_FL" "3.6"
 SYSTEM_CONSTANT "ISC_DNACCLIM_MAX" "12000"
 SYSTEM_CONSTANT "ISC_DNACCLIM_MIN" "0"
 SYSTEM_CONSTANT "ISC_DNDECLIM_MAX" "0"
 SYSTEM_CONSTANT "ISC_DNDECLIM_MIN" "-12000"
 SYSTEM_CONSTANT "ISC_DN_ZERO_FL" "0"
 SYSTEM_CONSTANT "ISC_EPM_N_MAX_FL" "10000"
 SYSTEM_CONSTANT "ISC_EPM_N_MIN_FL" "20"
 SYSTEM_CONSTANT "ISC_EPM_N_ZERO_FL" "0"
 SYSTEM_CONSTANT "ISC_INIRTIA_MAX" "20"
 SYSTEM_CONSTANT "ISC_INIRTIA_MIN" "0"
 SYSTEM_CONSTANT "ISC_LO_MAX_CONF" "10"
 SYSTEM_CONSTANT "ISC_NOEXTINIT" "255"
 SYSTEM_CONSTANT "ISC_NRFU_AGSDEM" "5"
 SYSTEM_CONSTANT "ISC_NRFU_DIADEM" "4"
 SYSTEM_CONSTANT "ISC_NRFU_ENGICO" "128"
 SYSTEM_CONSTANT "ISC_NRFU_GSHDEM" "2"
 SYSTEM_CONSTANT "ISC_NRFU_HLSDEM" "1"
 SYSTEM_CONSTANT "ISC_NRFU_INVALID" "-1"
 SYSTEM_CONSTANT "ISC_NRFU_ISC" "0"
 SYSTEM_CONSTANT "ISC_NRFU_MAXNR" "5"
 SYSTEM_CONSTANT "ISC_NRFU_WESDEM" "3"
 SYSTEM_CONSTANT "ISC_N_RES_FL" "0.5"
 SYSTEM_CONSTANT "ISC_RNENGVVEH_MAX" "1000"
 SYSTEM_CONSTANT "ISC_RNENGVVEH_MIN" "0"
 SYSTEM_CONSTANT "ISC_SETGOVCORE_PI" "1"
 SYSTEM_CONSTANT "ISC_SLIPDETEC_FAULT" "1"
 SYSTEM_CONSTANT "ISC_SLIP_DETEC" "0"
 SYSTEM_CONSTANT "ISC_STPRECTL_NEG" "-1"
 SYSTEM_CONSTANT "ISC_STPRECTL_POS" "1"
 SYSTEM_CONSTANT "ISC_ST_LOHIINVALID" "255"
 SYSTEM_CONSTANT "ISC_ST_LONENGHIGH" "3"
 SYSTEM_CONSTANT "ISC_ST_NENGLOWER" "1"
 SYSTEM_CONSTANT "ISC_ST_NENGUPPER" "2"
 SYSTEM_CONSTANT "ISC_ST_NOOP" "0"
 SYSTEM_CONSTANT "ISC_TIFLTNENG_MAX" "60"
 SYSTEM_CONSTANT "ISC_TIFLTNENG_MIN" "0"
 SYSTEM_CONSTANT "ISC_TIFLTTRQLOS_MAX" "60"
 SYSTEM_CONSTANT "ISC_TIFLTTRQLOS_MIN" "0"
 SYSTEM_CONSTANT "ISC_TIMEDELAY_S_LIN_16_RES_FL" "0.000152592547379986"
 SYSTEM_CONSTANT "ISC_TIME_DT_RES_FL" "1e-006"
 SYSTEM_CONSTANT "ISC_TIPT1TRQFLT_CUR_X" "25"
 SYSTEM_CONSTANT "ISC_TRJPLN_REQ" "8"
 SYSTEM_CONSTANT "ISC_TRQACC_POS" "20"
 SYSTEM_CONSTANT "ISC_TRQCONV_POS" "19"
 SYSTEM_CONSTANT "ISC_TRQDEC" "12"
 SYSTEM_CONSTANT "ISC_TRQDEC_POW2" "4096"
 SYSTEM_CONSTANT "ISC_TRQINC" "11"
 SYSTEM_CONSTANT "ISC_TRQINC_POW2" "2048"
 SYSTEM_CONSTANT "ISC_TRQINIT_DONE" "2"
 SYSTEM_CONSTANT "ISC_TRQINIT_MODE0" "4"
 SYSTEM_CONSTANT "ISC_TRQINIT_MODE0_POW2" "16"
 SYSTEM_CONSTANT "ISC_TRQINIT_MODE1" "5"
 SYSTEM_CONSTANT "ISC_TRQINIT_MODE1_POW2" "32"
 SYSTEM_CONSTANT "ISC_TRQINIT_MODE2" "6"
 SYSTEM_CONSTANT "ISC_TRQINIT_MODE2_POW2" "64"
 SYSTEM_CONSTANT "ISC_TRQINIT_MODE3" "7"
 SYSTEM_CONSTANT "ISC_TRQINIT_MODE3_POW2" "128"
 SYSTEM_CONSTANT "ISC_TRQINIT_MULTIPLE" "3"
 SYSTEM_CONSTANT "ISC_TRQINIT_REQ" "1"
 SYSTEM_CONSTANT "ISC_TRQINIT_TRQLOS" "1"
 SYSTEM_CONSTANT "ISC_TRQLOSS_CONST" "2"
 SYSTEM_CONSTANT "ISC_TRQ_RES_FL" "0.1"
 SYSTEM_CONSTANT "ISC_TRQ_ZERO16" "0"
 SYSTEM_CONSTANT "ISC_TRQ_ZERO32" "0"
 SYSTEM_CONSTANT "ISC_TRQ_ZERO_FL" "0"
 SYSTEM_CONSTANT "IVACTR_SWTSELTEMP_CLNT" "0"
 SYSTEM_CONSTANT "IVACTR_SWTSELTEMP_FUEL" "1"
 SYSTEM_CONSTANT "IVADJ_NUMCHKPNT" "5"
 SYSTEM_CONSTANT "IVADJ_NUMREPLVAL" "12"
 SYSTEM_CONSTANT "IVADJ_STQNTADJ_MAP_X" "7"
 SYSTEM_CONSTANT "IVADJ_STQNTADJ_MAP_Y" "8"
 SYSTEM_CONSTANT "IVDIA_DFCBNKSHCIR" "5"
 SYSTEM_CONSTANT "IVDIA_DFCBNKSHCIRCHSWT" "4"
 SYSTEM_CONSTANT "IVDIA_DFCCHP" "6"
 SYSTEM_CONSTANT "IVDIA_DFCCYLNOCLS" "7"
 SYSTEM_CONSTANT "IVDIA_DFCCYLNOLD" "1"
 SYSTEM_CONSTANT "IVDIA_DFCCYLSHCIR" "2"
 SYSTEM_CONSTANT "IVDIA_DFCCYLSHCIRHSLS" "0"
 SYSTEM_CONSTANT "IVDIA_DFCCYLSHCIRMEAS" "3"
 SYSTEM_CONSTANT "IVDIA_ERR_MAX" "32"
 SYSTEM_CONSTANT "IVDIA_NUMCYLDFC" "4"
 SYSTEM_CONSTANT "IVPLAUS_MODERUNUPTST" "0"
 SYSTEM_CONSTANT "IVPLAUS_WAIT_TIME_COMPR_TST" "1000"
 SYSTEM_CONSTANT "I_COIL_MAX" "5000"
 SYSTEM_CONSTANT "I_COIL_MIN" "0"
 SYSTEM_CONSTANT "KD_1_MAX" "50"
 SYSTEM_CONSTANT "KD_1_NRM" "7"
 SYSTEM_CONSTANT "KD_LIN_16_RES" "32767"
 SYSTEM_CONSTANT "KD_PRAIL2Q_1_MAX" "0.5"
 SYSTEM_CONSTANT "KD_PRAIL2Q_1_NRM" "4"
 SYSTEM_CONSTANT "KD_RED_RES" "512"
 SYSTEM_CONSTANT "KD_RED_RES_2" "64"
 SYSTEM_CONSTANT "KD_RES16_REV" "1024"
 SYSTEM_CONSTANT "KD_RES_REV" "65536"
 SYSTEM_CONSTANT "KD_SHIFT_2" "1024"
 SYSTEM_CONSTANT "KFACT_MAX" "1"
 SYSTEM_CONSTANT "KFACT_MIN" "0"
 SYSTEM_CONSTANT "KGPHR2MGPSEC" "277.77"
 SYSTEM_CONSTANT "KGPHR2MGPSEC_CNV" "27777"
 SYSTEM_CONSTANT "KIRMNSOTMS_INVRESO_SY" "2"
 SYSTEM_CONSTANT "KIRMNSOTMS_NRMEXPO_SY" "1"
 SYSTEM_CONSTANT "KI_1_MAX" "250"
 SYSTEM_CONSTANT "KI_1_NRM" "5"
 SYSTEM_CONSTANT "KI_EGR_RES_REV" "5368.70912"
 SYSTEM_CONSTANT "KI_EGTFACT_EXP" "1"
 SYSTEM_CONSTANT "KI_EGTFACT_NRM" "2"
 SYSTEM_CONSTANT "KI_ETCTLGOV_FAC_MAX" "0.06"
 SYSTEM_CONSTANT "KI_ETCTLGOV_FAC_MIN" "0"
 SYSTEM_CONSTANT "KI_ETCTLGOV_P0Q001_EXP" "1"
 SYSTEM_CONSTANT "KI_ETCTLGOV_P0Q001_NRM" "2"
 SYSTEM_CONSTANT "KI_ETCTL_MAX" "100"
 SYSTEM_CONSTANT "KI_ETCTL_MIN" "0"
 SYSTEM_CONSTANT "KI_FACTEGT_MAX" "0.06"
 SYSTEM_CONSTANT "KI_FACTEGT_MIN" "0"
 SYSTEM_CONSTANT "KI_IMPT2IM_FACT" "214.75"
 SYSTEM_CONSTANT "KI_MSOOT_RES_REV" "819"
 SYSTEM_CONSTANT "KI_PRAIL2Q_1_MAX" "2"
 SYSTEM_CONSTANT "KI_PRAIL2Q_1_NRM" "1"
 SYSTEM_CONSTANT "KI_PRCEGRRMP2PRC_ONE" "1"
 SYSTEM_CONSTANT "KI_RES_REV" "2147.483648"
 SYSTEM_CONSTANT "KI_RES_REV_2" "4294.967296"
 SYSTEM_CONSTANT "KI_RES_REV_VEL2TRQ" "134.217728"
 SYSTEM_CONSTANT "KI_THRVLV_RES_REV" "65"
 SYSTEM_CONSTANT "KMH_EXP" "4"
 SYSTEM_CONSTANT "KMPH2CMPS_1" "1000"
 SYSTEM_CONSTANT "KMPH2CMPS_2" "36"
 SYSTEM_CONSTANT "KP_1_MAX" "300"
 SYSTEM_CONSTANT "KP_1_NRM" "9"
 SYSTEM_CONSTANT "KP_EGTFACT_EXP" "7"
 SYSTEM_CONSTANT "KP_EGTFACT_RES_REV" "128"
 SYSTEM_CONSTANT "KP_ETCTLGOV_FAC_MAX" "0.06"
 SYSTEM_CONSTANT "KP_ETCTLGOV_FAC_MIN" "0"
 SYSTEM_CONSTANT "KP_ETCTLGOV_P0Q001_EXP" "7"
 SYSTEM_CONSTANT "KP_ETCTLGOV_P0Q001_RES_REV" "128"
 SYSTEM_CONSTANT "KP_ETCTL_MAX" "4"
 SYSTEM_CONSTANT "KP_ETCTL_MIN" "0"
 SYSTEM_CONSTANT "KP_LMBDREC2INJMASS_1_MAX" "250"
 SYSTEM_CONSTANT "KP_LMBDREC2INJMASS_1_NRM" "2"
 SYSTEM_CONSTANT "KP_LMBDREC2INJMASS_1_RES_REV" "4"
 SYSTEM_CONSTANT "KP_PRAIL2Q_1_MAX" "0.2"
 SYSTEM_CONSTANT "KP_PRAIL2Q_1_NRM" "2"
 SYSTEM_CONSTANT "KP_RES_REV" "32768"
 SYSTEM_CONSTANT "KP_RES_REV_2" "65536"
 SYSTEM_CONSTANT "KP_RES_REV_20" "4096"
 SYSTEM_CONSTANT "LAMBDAREC_ONE" "1"
 SYSTEM_CONSTANT "LAMBDAREC_RES" "0.0001"
 SYSTEM_CONSTANT "LAMBDAREC_RESVAL" "0.001"
 SYSTEM_CONSTANT "LAMBDAREC_RESVAL_FL" "0.001"
 SYSTEM_CONSTANT "LAMBDAREC_RESVAL_REV" "1000"
 SYSTEM_CONSTANT "LAMBDAREC_RES_REV" "10000"
 SYSTEM_CONSTANT "LAMBDATEMPRESREV_SY" "1000"
 SYSTEM_CONSTANT "LAMBDA_INJMASS_RES" "1450"
 SYSTEM_CONSTANT "LAMBDA_RES" "0.001"
 SYSTEM_CONSTANT "LAMBDA_RES2LAMBDAREC_RES" "10"
 SYSTEM_CONSTANT "LAMBDA_RES_REV" "1000"
 SYSTEM_CONSTANT "LAYER_FUEL_L_RES" "0.01"
 SYSTEM_CONSTANT "LAYER_M2VOL_RES" "16"
 SYSTEM_CONSTANT "LAYER_M2VOL_RES_EXP" "4"
 SYSTEM_CONSTANT "LEARN" "3"
 SYSTEM_CONSTANT "LENGTHFINE_RES" "0.001"
 SYSTEM_CONSTANT "LENGTHFINE_RES_FL" "0.001"
 SYSTEM_CONSTANT "LENGTH_HCCOND_M_RES" "128"
 SYSTEM_CONSTANT "LENGTH_KM_RES" "20"
 SYSTEM_CONSTANT "LENGTH_RES" "1"
 SYSTEM_CONSTANT "LENGTH_RES_CPP_SY" "1e-005"
 SYSTEM_CONSTANT "LENGTH_RES_FINE" "0.001"
 SYSTEM_CONSTANT "LENGTH_RES_FINE_REV" "1000"
 SYSTEM_CONSTANT "LENGTH_RES_INV" "1"
 SYSTEM_CONSTANT "LIN_CYCLIC_COM_1000MS" "1000"
 SYSTEM_CONSTANT "LLIM_CALCLIM_TYPE" "2"
 SYSTEM_CONSTANT "LLIM_CALCLIM_VAL" "1"
 SYSTEM_CONSTANT "LLIM_FACSPDCORR" "15"
 SYSTEM_CONSTANT "LSNCERGN_U16_EXP" "7"
 SYSTEM_CONSTANT "LSNCERGN_U16_RES" "128"
 SYSTEM_CONSTANT "LSU_CT_SENSORS" "1"
 SYSTEM_CONSTANT "LSU_CT_SENSORS_MAX" "4"
 SYSTEM_CONSTANT "LSU_CT_SENSORS_SY" "1"
 SYSTEM_CONSTANT "LSU_CT_SENSORS_TWFLW_SYS" "1"
 SYSTEM_CONSTANT "LSU_NUM_SENSCMPCHKS" "0"
 SYSTEM_CONSTANT "LUB_CRITOILLVLMSK_SY" "2"
 SYSTEM_CONSTANT "LUB_DMFLADDBAS_MAP_X" "2"
 SYSTEM_CONSTANT "LUB_DMFLADDBAS_MAP_Y" "2"
 SYSTEM_CONSTANT "LUB_DMFLEVPBAS_MAP_X" "2"
 SYSTEM_CONSTANT "LUB_DMFLEVPBAS_MAP_Y" "2"
 SYSTEM_CONSTANT "LUB_DMFLOILRMVBAS_MAP_X" "2"
 SYSTEM_CONSTANT "LUB_DMFLOILRMVBAS_MAP_Y" "2"
 SYSTEM_CONSTANT "LUB_FACFLADDTEMPENG_CUR_X" "8"
 SYSTEM_CONSTANT "LUB_FACFLEVPTEMP_CUR_X" "8"
 SYSTEM_CONSTANT "LUB_FACFLOILRMVMS_CUR_X" "8"
 SYSTEM_CONSTANT "LUB_FACFLOILRMVTEMP_CUR_X" "8"
 SYSTEM_CONSTANT "LUB_MLVL2MS_MAP_X" "16"
 SYSTEM_CONSTANT "LUB_MLVL2MS_MAP_Y" "16"
 SYSTEM_CONSTANT "M2DM" "1000"
 SYSTEM_CONSTANT "MASSLENGTH_RES" "0.2"
 SYSTEM_CONSTANT "MASS_CONV_G2MG" "1000"
 SYSTEM_CONSTANT "MASS_RES" "1"
 SYSTEM_CONSTANT "MAXSINT16" "32767"
 SYSTEM_CONSTANT "MAXSINT32" "2147483647"
 SYSTEM_CONSTANT "MAXSINT8" "127"
 SYSTEM_CONSTANT "MAXUINT16" "65535"
 SYSTEM_CONSTANT "MAXUINT32" "4294967295"
 SYSTEM_CONSTANT "MAXUINT8" "255"
 SYSTEM_CONSTANT "MEUN_AVRG_COUNT_SY" "3"
 SYSTEM_CONSTANT "MEUN_FACCRNTCTLINIT_CUR_X" "2"
 SYSTEM_CONSTANT "MEUN_ICNVFLOWRATE_CUR_X" "10"
 SYSTEM_CONSTANT "MEUN_ILIN_CUR_X" "2"
 SYSTEM_CONSTANT "MEUN_RLIM_CUR_X" "2"
 SYSTEM_CONSTANT "MEUN_RSETLIN_CUR_X" "4"
 SYSTEM_CONSTANT "MEUN_SPEED_COUNT_SY" "4"
 SYSTEM_CONSTANT "MEUN_TIPER_CUR_X" "30"
 SYSTEM_CONSTANT "MINSINT16" "-32768"
 SYSTEM_CONSTANT "MINSINT32" "-2147483648"
 SYSTEM_CONSTANT "MINSINT8" "-128"
 SYSTEM_CONSTANT "MOCCPU_FIT_SY" "0"
 SYSTEM_CONSTANT "MOCMEM_DATA_CHECK" "13"
 SYSTEM_CONSTANT "MOCMEM_DATA_DME_SY" "13"
 SYSTEM_CONSTANT "MOCMEM_DATA_ROM_SY" "10"
 SYSTEM_CONSTANT "MOCMEM_DATA_USAP_MEDC17_OFFSET_SY" "11"
 SYSTEM_CONSTANT "MOCMEM_DATA_USAP_MEDC17_R9_SY" "12"
 SYSTEM_CONSTANT "MOCRAM_PROTRAMCLEARED" "51"
 SYSTEM_CONSTANT "MOCRAM_PROTRAMNOTCLEARED" "204"
 SYSTEM_CONSTANT "MOCSOP_CJ840AT_SY" "0"
 SYSTEM_CONSTANT "MOCSOP_CJ840_SY" "0"
 SYSTEM_CONSTANT "MOCSOP_GET_STATUS_FAIL" "255"
 SYSTEM_CONSTANT "MOCSOP_POWERSTAGE_OFF_SY" "0"
 SYSTEM_CONSTANT "MOCSOP_POWERSTAGE_ON_SY" "1"
 SYSTEM_CONSTANT "MOFACC_PTD_MSK" "1"
 SYSTEM_CONSTANT "MOFACC_SHUTOFF_MSK" "2"
 SYSTEM_CONSTANT "MOFCCTL_ACT_MSK" "1"
 SYSTEM_CONSTANT "MOFCCTL_SHUTOFF_MSK" "2"
 SYSTEM_CONSTANT "MOFEXTINT_DCSPTD_BP" "1"
 SYSTEM_CONSTANT "MOFEXTINT_TRQDCSIDC_MSK" "1"
 SYSTEM_CONSTANT "MOFEXTINT_TRQTSCIDC_MSK" "2"
 SYSTEM_CONSTANT "MOFEXTINT_TSCPTD_BP" "1"
 SYSTEM_CONSTANT "MOFINJDAT_FACINJEFF_MAP_X" "6"
 SYSTEM_CONSTANT "MOFINJDAT_FACINJEFF_MAP_Y" "4"
 SYSTEM_CONSTANT "MOFINJDAT_INJACTV_MSK" "1"
 SYSTEM_CONSTANT "MOFOVR_TILIMET_CUR_X" "4"
 SYSTEM_CONSTANT "MOFSPDG_GSHDEM_MSK" "1"
 SYSTEM_CONSTANT "MOFTRA_DKGRPM_INTERVENTION_MSK" "8"
 SYSTEM_CONSTANT "MOLMASS_RES" "0.01"
 SYSTEM_CONSTANT "MOMENT_INERTIA_RES" "100"
 SYSTEM_CONSTANT "MO_PRCMAX_SY" "256"
 SYSTEM_CONSTANT "MO_ROM_SY" "0"
 SYSTEM_CONSTANT "MO_ROOM_RES_SY" "256"
 SYSTEM_CONSTANT "MS_SOXNOX_RES" "1e-005"
 SYSTEM_CONSTANT "MUL_INJTIME_US" "5"
 SYSTEM_CONSTANT "M_NOXLD_RES" "1e-005"
 SYSTEM_CONSTANT "M_NOXLD_RES_REV" "100000"
 SYSTEM_CONSTANT "M_OILASH_RES" "0.01"
 SYSTEM_CONSTANT "M_SOOT_MAX" "300"
 SYSTEM_CONSTANT "M_SOOT_MIN" "0"
 SYSTEM_CONSTANT "M_SOOT_RES" "0.01"
 SYSTEM_CONSTANT "M_SOOT_RES_REV" "100"
 SYSTEM_CONSTANT "NEUTVAL_S16" "-32768"
 SYSTEM_CONSTANT "NEUTVAL_S32" "-2147483648"
 SYSTEM_CONSTANT "NEUTVAL_S8" "-128"
 SYSTEM_CONSTANT "NEUTVAL_U16" "65534"
 SYSTEM_CONSTANT "NEUTVAL_U32" "4294967294"
 SYSTEM_CONSTANT "NEUTVAL_U8" "254"
 SYSTEM_CONSTANT "NOAC_GEAR" "4"
 SYSTEM_CONSTANT "NOAC_NOGEAR" "1"
 SYSTEM_CONSTANT "NORM_ACC2TRQPRPHIGH" "500"
 SYSTEM_CONSTANT "NORM_ACC_BY_TIMEMS" "6553.6"
 SYSTEM_CONSTANT "NORM_DVOLPERSTRK_X_N" "6666.66666666667"
 SYSTEM_CONSTANT "NORM_DVOL_X_DT" "360000"
 SYSTEM_CONSTANT "NORM_ENGN2RMPENGN" "3276.8"
 SYSTEM_CONSTANT "NORM_FANSPD2RELFANSPD" "8192"
 SYSTEM_CONSTANT "NORM_LMBD_RES" "0.00145"
 SYSTEM_CONSTANT "NORM_MINUTE_MICROSEC" "60000000"
 SYSTEM_CONSTANT "NORM_Q2PWR" "10644.4551086344"
 SYSTEM_CONSTANT "NORM_Q_BY_FAC" "8192"
 SYSTEM_CONSTANT "NORM_Q_BY_RHO" "1000"
 SYSTEM_CONSTANT "NORM_R_X_R" "100"
 SYSTEM_CONSTANT "NORM_R_X_TRQ" "100"
 SYSTEM_CONSTANT "NORM_TRQ2PWR" "3599.99660074774"
 SYSTEM_CONSTANT "NORM_TRQ2TRQPRP" "1600"
 SYSTEM_CONSTANT "NORM_TRQ2TRQPRPHIGH" "100"
 SYSTEM_CONSTANT "NORM_TRQPRPHIGH2ACC" "500"
 SYSTEM_CONSTANT "NORM_TRQTONSQR" "4000000"
 SYSTEM_CONSTANT "NORM_TRQ_BY_ETA" "1280"
 SYSTEM_CONSTANT "NORM_TRQ_BY_Q" "1280"
 SYSTEM_CONSTANT "NORM_TRQ_BY_R" "100"
 SYSTEM_CONSTANT "NORM_TRQ_INRT" "500"
 SYSTEM_CONSTANT "NORM_TRQ_X_FAC" "8192"
 SYSTEM_CONSTANT "NORM_VEL_LENGTH2ENGN" "50"
 SYSTEM_CONSTANT "NORM_VXT_SI" "360000"
 SYSTEM_CONSTANT "NORM_W2PWR_PZOACTR" "500"
 SYSTEM_CONSTANT "NORM_WHL_RADIUS" "200"
 SYSTEM_CONSTANT "NOXFLWEG_RES" "0.025"
 SYSTEM_CONSTANT "NOXFLW_RES" "0.001"
 SYSTEM_CONSTANT "NOXMPT_RES" "0.1"
 SYSTEM_CONSTANT "NOXMPT_RES_REV" "10"
 SYSTEM_CONSTANT "NOXRESO_DIVADPT" "54000"
 SYSTEM_CONSTANT "NOX_RES" "1"
 SYSTEM_CONSTANT "NOX_ZERO" "0"
 SYSTEM_CONSTANT "NRM_DVOLPERSTRK_X_N" "6666.66666666667"
 SYSTEM_CONSTANT "NRM_DVOL_X_DT" "360000"
 SYSTEM_CONSTANT "NRM_EXPO_AG_CRS_HI_RESO" "7"
 SYSTEM_CONSTANT "NRM_EXPO_T_INC_PER_DUR_HI_RESO" "8"
 SYSTEM_CONSTANT "NRM_EXP_RES_TRIGO_FUNC" "12"
 SYSTEM_CONSTANT "NRM_Q_BY_RHO" "1000"
 SYSTEM_CONSTANT "NSCDS_CT_SENSORS" "1"
 SYSTEM_CONSTANT "NSCLD_MNOXFLD_NUM" "10"
 SYSTEM_CONSTANT "NSC_CT_SENSORS_MAX" "4"
 SYSTEM_CONSTANT "NSC_CT_SENSORS_SY" "1"
 SYSTEM_CONSTANT "NSC_CT_SENSORS_TWFLW_SYS" "1"
 SYSTEM_CONSTANT "NTRBCH_RES_FL" "10"
 SYSTEM_CONSTANT "NTRBCH_ZERO" "0"
 SYSTEM_CONSTANT "NTRBCH_ZERO_FL" "0"
 SYSTEM_CONSTANT "NUMCASFRQ_MAX" "3"
 SYSTEM_CONSTANT "NUMCASMAX" "1"
 SYSTEM_CONSTANT "NUMCYLACT_SY" "4"
 SYSTEM_CONSTANT "NUMCYLMAX_SY" "6"
 SYSTEM_CONSTANT "NUMFANS_SY" "2"
 SYSTEM_CONSTANT "NUMINJCHRGBALRAW_RES" "0.01"
 SYSTEM_CONSTANT "NUMINJCHRGBALRAW_RES_REV" "100"
 SYSTEM_CONSTANT "NUM_BNK" "2"
 SYSTEM_CONSTANT "NUM_CHIP" "1"
 SYSTEM_CONSTANT "NUM_EXH_SENSORS" "2"
 SYSTEM_CONSTANT "NUM_EXH_SENSORS_MAX" "8"
 SYSTEM_CONSTANT "NUM_INJ_MAX" "6"
 SYSTEM_CONSTANT "NUM_MAX_FBC_SEG" "8"
 SYSTEM_CONSTANT "NUM_SINTAB_IDX" "30"
 SYSTEM_CONSTANT "O2MASS_MAX" "50"
 SYSTEM_CONSTANT "O2MASS_MIN" "0"
 SYSTEM_CONSTANT "O2MPT_RES" "0.01"
 SYSTEM_CONSTANT "O2MPT_RESLO" "0.02"
 SYSTEM_CONSTANT "O2MPT_RESLO_REV" "50"
 SYSTEM_CONSTANT "O2MPT_RES_FL" "0.01"
 SYSTEM_CONSTANT "O2MPT_RES_REV" "100"
 SYSTEM_CONSTANT "O2_NORM" "0.21"
 SYSTEM_CONSTANT "O2_NORM_INV" "4.773"
 SYSTEM_CONSTANT "O2_RES" "1e-005"
 SYSTEM_CONSTANT "O2_RES_FL" "1e-005"
 SYSTEM_CONSTANT "O2_RES_REV" "100000"
 SYSTEM_CONSTANT "O2_RMASS_AIR" "0.2314975"
 SYSTEM_CONSTANT "O2_RMASS_AIR_FL" "0.2314975"
 SYSTEM_CONSTANT "O2_RVOL_AIR" "0.2095"
 SYSTEM_CONSTANT "O2_THRES1_ADD" "0.063"
 SYSTEM_CONSTANT "O2_THRES1_FAC" "0.7"
 SYSTEM_CONSTANT "O2_THRES2_ADD" "0.126"
 SYSTEM_CONSTANT "O2_THRES2_FAC" "0.4"
 SYSTEM_CONSTANT "OBD_PHYSMEDM_SY" "0"
 SYSTEM_CONSTANT "ODD_SEGMENT" "1"
 SYSTEM_CONSTANT "OILMFL_MGPS_Q0P1_RES" "0.1"
 SYSTEM_CONSTANT "OILMFL_MGPS_Q0P1_RES_REV" "10"
 SYSTEM_CONSTANT "OILMPT_RES" "0.0001"
 SYSTEM_CONSTANT "OILMSPRCQ0P01_100" "100"
 SYSTEM_CONSTANT "OILMSPRC_Q0P01_RES" "0.01"
 SYSTEM_CONSTANT "OILMSPRC_Q0P01_RES_REV" "100"
 SYSTEM_CONSTANT "OILMS_MG_RES" "1"
 SYSTEM_CONSTANT "OILMS_MG_RES_REV" "1"
 SYSTEM_CONSTANT "OILMS_Q0P1_RES" "0.1"
 SYSTEM_CONSTANT "OILMS_Q0P1_RES_REV" "10"
 SYSTEM_CONSTANT "OILMS_Q10_RES" "10"
 SYSTEM_CONSTANT "OILPLMP_DIGOUT_SY" "0"
 SYSTEM_CONSTANT "OIL_BSS_PERI_ID_SY" "4"
 SYSTEM_CONSTANT "OIL_SENSTYP_QLT_SY" "0"
 SYSTEM_CONSTANT "ONE_FACT26" "1"
 SYSTEM_CONSTANT "ONE_LAMBDAREC_VAL" "1"
 SYSTEM_CONSTANT "OTSCD_TLIN_CUR_X" "25"
 SYSTEM_CONSTANT "OVRMON_FACINJEFF_CUR_X" "16"
 SYSTEM_CONSTANT "OVRMON_FACINJEFF_CUR_Y" "16"
 SYSTEM_CONSTANT "OVRMON_TILIMET_CUR_X" "16"
 SYSTEM_CONSTANT "OVRRUN" "5"
 SYSTEM_CONSTANT "PCBS_LCALCDISTANCE_CUR_X" "8"
 SYSTEM_CONSTANT "PCBS_MASHOIL_CUR_X" "6"
 SYSTEM_CONSTANT "PCBS_QCALCFLTOT_CUR_X" "8"
 SYSTEM_CONSTANT "PCR_CURLIM" "0"
 SYSTEM_CONSTANT "PCR_DRRMPCBOPN_CUR_X" "6"
 SYSTEM_CONSTANT "PCR_FACAIRCTLCORNEG_MAP_X" "8"
 SYSTEM_CONSTANT "PCR_FACAIRCTLCORNEG_MAP_Y" "8"
 SYSTEM_CONSTANT "PCR_FACAIRCTLCORPOS_MAP_X" "8"
 SYSTEM_CONSTANT "PCR_FACAIRCTLCORPOS_MAP_Y" "8"
 SYSTEM_CONSTANT "PCR_FACAIRTEMPCTLACORLPEOM_CUR_X" "8"
 SYSTEM_CONSTANT "PCR_FACAIRTEMPCTLAUTLPCOR_CUR_X" "8"
 SYSTEM_CONSTANT "PCR_FACAIRTEMPCTLCOREOM_CUR_X" "8"
 SYSTEM_CONSTANT "PCR_FACAIRTEMPDESCORLPEOMQNT_CUR_X" "4"
 SYSTEM_CONSTANT "PCR_FACAIRTEMPDESCORLP_CUR_X" "4"
 SYSTEM_CONSTANT "PCR_FACCBYVLVRMP_CUR_X" "8"
 SYSTEM_CONSTANT "PCR_FACCTLIAT_CUR_X" "25"
 SYSTEM_CONSTANT "PCR_FACCTQNT_MAP_X" "16"
 SYSTEM_CONSTANT "PCR_FACCTQNT_MAP_Y" "16"
 SYSTEM_CONSTANT "PCR_FACDPCORR_CUR_X" "10"
 SYSTEM_CONSTANT "PCR_FACD_MAP_X" "10"
 SYSTEM_CONSTANT "PCR_FACD_MAP_Y" "4"
 SYSTEM_CONSTANT "PCR_FACENGTEMPCTLCOR_MAP_X" "10"
 SYSTEM_CONSTANT "PCR_FACENGTEMPCTLCOR_MAP_Y" "10"
 SYSTEM_CONSTANT "PCR_FACENVPRESCTLAIRCTLCOR_CUR_X" "8"
 SYSTEM_CONSTANT "PCR_FACENVPRESCTLCOREOMQNT1_CUR_X" "8"
 SYSTEM_CONSTANT "PCR_FACENVPRESCTLCOR_CUR_X" "8"
 SYSTEM_CONSTANT "PCR_FACENVPRESDESAIRCTLCOR_CUR_X" "8"
 SYSTEM_CONSTANT "PCR_FACENVPRESDESCORLPEOMQNT_CUR_X" "4"
 SYSTEM_CONSTANT "PCR_FACENVPRESDESCORLP_CUR_X" "8"
 SYSTEM_CONSTANT "PCR_FACENVPRESDESCOR_CUR_X" "8"
 SYSTEM_CONSTANT "PCR_FACGOVMAXCORR_CUR_X" "8"
 SYSTEM_CONSTANT "PCR_FACIAT_CUR_X" "16"
 SYSTEM_CONSTANT "PCR_FACI_MAP_X" "10"
 SYSTEM_CONSTANT "PCR_FACI_MAP_Y" "4"
 SYSTEM_CONSTANT "PCR_FACLPD_MAP_X" "4"
 SYSTEM_CONSTANT "PCR_FACLPD_MAP_Y" "4"
 SYSTEM_CONSTANT "PCR_FACLPI_MAP_X" "4"
 SYSTEM_CONSTANT "PCR_FACLPI_MAP_Y" "4"
 SYSTEM_CONSTANT "PCR_FACLPP_MAP_X" "4"
 SYSTEM_CONSTANT "PCR_FACLPP_MAP_Y" "4"
 SYSTEM_CONSTANT "PCR_FACMFLOWRAW_MAP_X" "10"
 SYSTEM_CONSTANT "PCR_FACMFLOWRAW_MAP_Y" "8"
 SYSTEM_CONSTANT "PCR_FACN_CUR_X" "6"
 SYSTEM_CONSTANT "PCR_FACPFLTLDCTLVAL_CUR_X" "12"
 SYSTEM_CONSTANT "PCR_FACPRESPFLTMAX_CUR_X" "12"
 SYSTEM_CONSTANT "PCR_FACPRESPFLTMIN_CUR_X" "2"
 SYSTEM_CONSTANT "PCR_FACP_MAP_X" "10"
 SYSTEM_CONSTANT "PCR_FACP_MAP_Y" "4"
 SYSTEM_CONSTANT "PCR_FACRMPVALCTLCORQNT1_CUR_X" "10"
 SYSTEM_CONSTANT "PCR_FACRMPVALDESCORLP_CUR_X" "10"
 SYSTEM_CONSTANT "PCR_FACRMPVALDESCOR_CUR_X" "5"
 SYSTEM_CONSTANT "PCR_FACT1LP_MAP_X" "4"
 SYSTEM_CONSTANT "PCR_FACT1LP_MAP_Y" "4"
 SYSTEM_CONSTANT "PCR_FACTEMPDESCORLPEOMQNT_CUR_X" "4"
 SYSTEM_CONSTANT "PCR_FACTEMPDESCORLP_CUR_X" "4"
 SYSTEM_CONSTANT "PCR_GOVMIN_CUR_X" "16"
 SYSTEM_CONSTANT "PCR_GOVOFFAIRMSTST_CUR_X" "16"
 SYSTEM_CONSTANT "PCR_GOVOFFEOMLP_CUR_X" "8"
 SYSTEM_CONSTANT "PCR_GOVOFFEOM_CUR_X" "16"
 SYSTEM_CONSTANT "PCR_GOVOFFLP_CUR_X" "8"
 SYSTEM_CONSTANT "PCR_GOVOFF_CUR_X" "16"
 SYSTEM_CONSTANT "PCR_GOVONAIRMSTST_CUR_X" "16"
 SYSTEM_CONSTANT "PCR_GOVONEOMLP_CUR_X" "8"
 SYSTEM_CONSTANT "PCR_GOVONEOM_CUR_X" "16"
 SYSTEM_CONSTANT "PCR_GOVONLP_CUR_X" "8"
 SYSTEM_CONSTANT "PCR_GOVON_CUR_X" "16"
 SYSTEM_CONSTANT "PCR_MAPLIM" "1"
 SYSTEM_CONSTANT "PCR_NUMCBYVLV" "1"
 SYSTEM_CONSTANT "PCR_NUMSTPRIOMON" "17"
 SYSTEM_CONSTANT "PCR_NUMSTPRIOMONLP" "8"
 SYSTEM_CONSTANT "PCR_PAPQNTCOR_MAP_X" "16"
 SYSTEM_CONSTANT "PCR_PAPQNTCOR_MAP_Y" "16"
 SYSTEM_CONSTANT "PCR_PDESBASAIRCTLOFFHIALTD_MAP_X" "16"
 SYSTEM_CONSTANT "PCR_PDESBASAIRCTLOFFHIALTD_MAP_Y" "16"
 SYSTEM_CONSTANT "PCR_PDESBASAIRCTLOFF_MAP_X" "16"
 SYSTEM_CONSTANT "PCR_PDESBASAIRCTLOFF_MAP_Y" "16"
 SYSTEM_CONSTANT "PCR_PDESBASLPEOMQNT_MAP_X" "12"
 SYSTEM_CONSTANT "PCR_PDESBASLPEOMQNT_MAP_Y" "12"
 SYSTEM_CONSTANT "PCR_PDESBASLPHIALTDEOMQNT_MAP_X" "12"
 SYSTEM_CONSTANT "PCR_PDESBASLPHIALTDEOMQNT_MAP_Y" "12"
 SYSTEM_CONSTANT "PCR_PDESBASLPHIALTD_MAP_X" "16"
 SYSTEM_CONSTANT "PCR_PDESBASLPHIALTD_MAP_Y" "16"
 SYSTEM_CONSTANT "PCR_PDESBASLP_MAP_X" "16"
 SYSTEM_CONSTANT "PCR_PDESBASLP_MAP_Y" "16"
 SYSTEM_CONSTANT "PCR_PDESBAS_MAP_X" "16"
 SYSTEM_CONSTANT "PCR_PDESBAS_MAP_Y" "16"
 SYSTEM_CONSTANT "PCR_PDESMAXAP_MAP_X" "16"
 SYSTEM_CONSTANT "PCR_PDESMAXAP_MAP_Y" "16"
 SYSTEM_CONSTANT "PCR_PDESMONHIALTD_MAP_X" "8"
 SYSTEM_CONSTANT "PCR_PDESMONHIALTD_MAP_Y" "6"
 SYSTEM_CONSTANT "PCR_PDVTMAX_MAP_X" "12"
 SYSTEM_CONSTANT "PCR_PDVTMAX_MAP_Y" "12"
 SYSTEM_CONSTANT "PCR_PDVTMIN_MAP_X" "12"
 SYSTEM_CONSTANT "PCR_PDVTMIN_MAP_Y" "12"
 SYSTEM_CONSTANT "PCR_PMAXDESVALLP_MAP_X" "16"
 SYSTEM_CONSTANT "PCR_PMAXDESVALLP_MAP_Y" "16"
 SYSTEM_CONSTANT "PCR_PNQNTCTCOR_MAP_X" "16"
 SYSTEM_CONSTANT "PCR_PNQNTCTCOR_MAP_Y" "16"
 SYSTEM_CONSTANT "PCR_PRESPRCCNV" "82"
 SYSTEM_CONSTANT "PCR_PTEMPCORBASLPEOMQNT_MAP_X" "4"
 SYSTEM_CONSTANT "PCR_PTEMPCORBASLPEOMQNT_MAP_Y" "4"
 SYSTEM_CONSTANT "PCR_PTEMPCORBASLP_MAP_X" "4"
 SYSTEM_CONSTANT "PCR_PTEMPCORBASLP_MAP_Y" "4"
 SYSTEM_CONSTANT "PCR_QCBYVLVCLOSEEOM1_MAP_X" "12"
 SYSTEM_CONSTANT "PCR_QCBYVLVCLOSEEOM1_MAP_Y" "6"
 SYSTEM_CONSTANT "PCR_QCBYVLVCLOSE_MAP_X" "12"
 SYSTEM_CONSTANT "PCR_QCBYVLVCLOSE_MAP_Y" "6"
 SYSTEM_CONSTANT "PCR_QCBYVLVOPNEOM1_MAP_X" "12"
 SYSTEM_CONSTANT "PCR_QCBYVLVOPNEOM1_MAP_Y" "6"
 SYSTEM_CONSTANT "PCR_QCBYVLVOPN_MAP_X" "12"
 SYSTEM_CONSTANT "PCR_QCBYVLVOPN_MAP_Y" "6"
 SYSTEM_CONSTANT "PCR_QCLTHTHRES_CUR_X" "6"
 SYSTEM_CONSTANT "PCR_QGVNROFF_CUR_X" "25"
 SYSTEM_CONSTANT "PCR_QGVNRON_CUR_X" "25"
 SYSTEM_CONSTANT "PCR_QNTCTL_QCURR" "0"
 SYSTEM_CONSTANT "PCR_QNTCTL_QRAW" "1"
 SYSTEM_CONSTANT "PCR_QNTGOV_QCURR" "0"
 SYSTEM_CONSTANT "PCR_QNTMON_QRAW" "1"
 SYSTEM_CONSTANT "PCR_Q_QCURR" "0"
 SYSTEM_CONSTANT "PCR_Q_QRAW" "1"
 SYSTEM_CONSTANT "PCR_RAIRCTLCORDIFF_CUR_X" "12"
 SYSTEM_CONSTANT "PCR_RAIRTEMPCTLACORBASLPEOM_MAP_X" "8"
 SYSTEM_CONSTANT "PCR_RAIRTEMPCTLACORBASLPEOM_MAP_Y" "8"
 SYSTEM_CONSTANT "PCR_RAIRTEMPCTLAUTLPCORBAS_MAP_X" "8"
 SYSTEM_CONSTANT "PCR_RAIRTEMPCTLAUTLPCORBAS_MAP_Y" "8"
 SYSTEM_CONSTANT "PCR_RAIRTEMPCTLCORBASEOM_MAP_X" "8"
 SYSTEM_CONSTANT "PCR_RAIRTEMPCTLCORBASEOM_MAP_Y" "8"
 SYSTEM_CONSTANT "PCR_RAIRTEMPCTLCORBAS_MAP_X" "16"
 SYSTEM_CONSTANT "PCR_RAIRTEMPCTLCORBAS_MAP_Y" "16"
 SYSTEM_CONSTANT "PCR_RAIRTEMPCTLCOREOMBAS_MAP_X" "16"
 SYSTEM_CONSTANT "PCR_RAIRTEMPCTLCOREOMBAS_MAP_Y" "16"
 SYSTEM_CONSTANT "PCR_RCTLAPCOR_MAP_X" "16"
 SYSTEM_CONSTANT "PCR_RCTLAPCOR_MAP_Y" "16"
 SYSTEM_CONSTANT "PCR_RCTLBASAIRCTLOFFHIALTD_MAP_X" "16"
 SYSTEM_CONSTANT "PCR_RCTLBASAIRCTLOFFHIALTD_MAP_Y" "16"
 SYSTEM_CONSTANT "PCR_RCTLBASAIRCTLOFF_MAP_X" "16"
 SYSTEM_CONSTANT "PCR_RCTLBASAIRCTLOFF_MAP_Y" "16"
 SYSTEM_CONSTANT "PCR_RCTLBASHIALTD_MAP_X" "16"
 SYSTEM_CONSTANT "PCR_RCTLBASHIALTD_MAP_Y" "16"
 SYSTEM_CONSTANT "PCR_RCTLBAS_MAP_X" "16"
 SYSTEM_CONSTANT "PCR_RCTLBAS_MAP_Y" "16"
 SYSTEM_CONSTANT "PCR_RELABSLP_ABS" "0"
 SYSTEM_CONSTANT "PCR_RELABSLP_REL" "1"
 SYSTEM_CONSTANT "PCR_RELABS_ABS" "0"
 SYSTEM_CONSTANT "PCR_RELABS_REL" "1"
 SYSTEM_CONSTANT "PCR_RENGTEMPCORBASQNT_MAP_Y" "12"
 SYSTEM_CONSTANT "PCR_RENGTEMPCORBASTRQ_MAP_Y" "16"
 SYSTEM_CONSTANT "PCR_RENGTEMPCORBAS_MAP_X" "12"
 SYSTEM_CONSTANT "PCR_RGOVLPMAX_MAP_X" "12"
 SYSTEM_CONSTANT "PCR_RGOVLPMAX_MAP_Y" "12"
 SYSTEM_CONSTANT "PCR_RGOVLPMIN_MAP_X" "6"
 SYSTEM_CONSTANT "PCR_RGOVLPMIN_MAP_Y" "6"
 SYSTEM_CONSTANT "PCR_RGOVMAXCORR_MAP_X" "14"
 SYSTEM_CONSTANT "PCR_RGOVMAXCORR_MAP_Y" "12"
 SYSTEM_CONSTANT "PCR_RGOVMAXDYNCORR_MAP_X" "10"
 SYSTEM_CONSTANT "PCR_RGOVMAXDYNCORR_MAP_Y" "12"
 SYSTEM_CONSTANT "PCR_RGOVMAXDYN_MAP_X" "16"
 SYSTEM_CONSTANT "PCR_RGOVMAXDYN_MAP_Y" "16"
 SYSTEM_CONSTANT "PCR_RGVNRMAX_MAP_X" "16"
 SYSTEM_CONSTANT "PCR_RGVNRMAX_MAP_Y" "16"
 SYSTEM_CONSTANT "PCR_RGVNRMIN_MAP_X" "16"
 SYSTEM_CONSTANT "PCR_RGVNRMIN_MAP_Y" "16"
 SYSTEM_CONSTANT "PCR_ROFSRLSMAX_MAP_X" "8"
 SYSTEM_CONSTANT "PCR_ROFSRLSMAX_MAP_Y" "8"
 SYSTEM_CONSTANT "PCR_ROFSRLSMIN_MAP_X" "8"
 SYSTEM_CONSTANT "PCR_ROFSRLSMIN_MAP_Y" "8"
 SYSTEM_CONSTANT "PCR_ROUTIMAXAIRMSTST_MAP_X" "8"
 SYSTEM_CONSTANT "PCR_ROUTIMAXAIRMSTST_MAP_Y" "8"
 SYSTEM_CONSTANT "PCR_ROUTIMAXLP_MAP_X" "4"
 SYSTEM_CONSTANT "PCR_ROUTIMAXLP_MAP_Y" "4"
 SYSTEM_CONSTANT "PCR_ROUTIMAX_MAP_X" "8"
 SYSTEM_CONSTANT "PCR_ROUTIMAX_MAP_Y" "8"
 SYSTEM_CONSTANT "PCR_ROUTIMINLP_MAP_X" "4"
 SYSTEM_CONSTANT "PCR_ROUTIMINLP_MAP_Y" "4"
 SYSTEM_CONSTANT "PCR_ROUTIMIN_MAP_X" "8"
 SYSTEM_CONSTANT "PCR_ROUTIMIN_MAP_Y" "8"
 SYSTEM_CONSTANT "PCR_SWTLIMSEL_TYPE" "0"
 SYSTEM_CONSTANT "PCR_SWTLIMSEL_VAL" "1"
 SYSTEM_CONSTANT "PCR_SWTQNTCTL_TYPE" "2"
 SYSTEM_CONSTANT "PCR_SWTQNTCTL_VAL" "0"
 SYSTEM_CONSTANT "PCR_SWTQNTDES_TYPE" "2"
 SYSTEM_CONSTANT "PCR_SWTQNTDES_VAL" "0"
 SYSTEM_CONSTANT "PCR_SWTRELABS_TYPE" "2"
 SYSTEM_CONSTANT "PCR_SWTRELABS_VAL" "0"
 SYSTEM_CONSTANT "PCR_SWTTEMPCOR_TYPE" "2"
 SYSTEM_CONSTANT "PCR_SWTTEMPCOR_VAL" "0"
 SYSTEM_CONSTANT "PCR_SWTTRQCTL_TYPE" "2"
 SYSTEM_CONSTANT "PCR_SWTTRQCTL_VAL" "0"
 SYSTEM_CONSTANT "PCR_SWTTRQDES_TYPE" "2"
 SYSTEM_CONSTANT "PCR_SWTTRQDES_VAL" "0"
 SYSTEM_CONSTANT "PCR_TAIR" "1"
 SYSTEM_CONSTANT "PCR_TCMPRDSOFS_CUR_X" "4"
 SYSTEM_CONSTANT "PCR_TENG" "0"
 SYSTEM_CONSTANT "PCR_TICLDSTRT_CUR_X" "6"
 SYSTEM_CONSTANT "PCR_TIGOVOFFDELLP_CUR_X" "4"
 SYSTEM_CONSTANT "PCR_TIGVNROFFDEL_CUR_X" "6"
 SYSTEM_CONSTANT "PCR_TRQINRGOV_CURR" "0"
 SYSTEM_CONSTANT "PCR_TRQINRMON_RAW" "1"
 SYSTEM_CONSTANT "PCVCD_CTLSTATE_CONST" "0"
 SYSTEM_CONSTANT "PCVCD_CTLSTATE_DEP" "1"
 SYSTEM_CONSTANT "PCVCD_SWTCTLSTATE_TYPE" "2"
 SYSTEM_CONSTANT "PCVCD_SWTCTLSTATE_VAL" "0"
 SYSTEM_CONSTANT "PCV_ACTRTST_NUMMAXCALCAVRG" "20"
 SYSTEM_CONSTANT "PCV_CTLSTATE_CONST" "0"
 SYSTEM_CONSTANT "PCV_CTLSTATE_DEP" "1"
 SYSTEM_CONSTANT "PCV_DVOLLEAK_CUR_X" "6"
 SYSTEM_CONSTANT "PCV_DVOLUPLIM_CUR_X" "10"
 SYSTEM_CONSTANT "PCV_FACADAPTFLOW_MAP_X" "6"
 SYSTEM_CONSTANT "PCV_FACADAPTFLOW_MAP_Y" "4"
 SYSTEM_CONSTANT "PCV_FACCRNTCTLINIT_CUR_X" "2"
 SYSTEM_CONSTANT "PCV_ICNVPRES_CUR_X" "10"
 SYSTEM_CONSTANT "PCV_IGOV_ACTV" "0"
 SYSTEM_CONSTANT "PCV_IGOV_ACTVOPNLOP" "1"
 SYSTEM_CONSTANT "PCV_ILIN_CUR_X" "2"
 SYSTEM_CONSTANT "PCV_ISETCLOSE_CUR_X" "8"
 SYSTEM_CONSTANT "PCV_RSETLIN_CUR_X" "4"
 SYSTEM_CONSTANT "PCV_SWTCTLSTATE_TYPE" "2"
 SYSTEM_CONSTANT "PCV_SWTCTLSTATE_VAL" "0"
 SYSTEM_CONSTANT "PERIOD_MAX" "100"
 SYSTEM_CONSTANT "PERIOD_MIN" "10"
 SYSTEM_CONSTANT "PERIOD_RES" "100"
 SYSTEM_CONSTANT "PERMSPLYSYS_SY" "0"
 SYSTEM_CONSTANT "PER_CNT_MAX" "1000000"
 SYSTEM_CONSTANT "PER_DUR_RES" "1"
 SYSTEM_CONSTANT "PER_DUR_SHIFT" "256"
 SYSTEM_CONSTANT "PFLTENGPOPMAX_SY" "11"
 SYSTEM_CONSTANT "PFLTLD_DMSOTEGROFF_MAP_X" "8"
 SYSTEM_CONSTANT "PFLTLD_DMSOTEGROFF_MAP_Y" "8"
 SYSTEM_CONSTANT "PFLTLD_DMSOTSIMDYNNCOR_CUR_X" "8"
 SYSTEM_CONSTANT "PFLTLD_DMSOTSIMDYN_CUR_X" "8"
 SYSTEM_CONSTANT "PFLTLD_DMSOTSIMLMBD_MAP_X" "8"
 SYSTEM_CONSTANT "PFLTLD_DMSOTSIMLMBD_MAP_Y" "8"
 SYSTEM_CONSTANT "PFLTLD_DMSOTSIMRGNBAS_CUR_X" "8"
 SYSTEM_CONSTANT "PFLTLD_FACNO2CNVCATLV_CUR_X" "8"
 SYSTEM_CONSTANT "PFLTLD_FACNO2CNVCAT_MAP_X" "8"
 SYSTEM_CONSTANT "PFLTLD_FACNO2CNVCAT_MAP_Y" "8"
 SYSTEM_CONSTANT "PFLTLD_FACTEMPNO2_CUR_X" "8"
 SYSTEM_CONSTANT "PFLTLD_FACTEMPSIMRGN_CUR_X" "8"
 SYSTEM_CONSTANT "PFLTLD_FACVOLFLWNO2_CUR_X" "8"
 SYSTEM_CONSTANT "PFLTLD_MASHCOR_MAP_X" "8"
 SYSTEM_CONSTANT "PFLTLD_MASHCOR_MAP_Y" "8"
 SYSTEM_CONSTANT "PFLTLD_MASHPHY2EEP" "62500"
 SYSTEM_CONSTANT "PFLTLD_MRESFLWMEASAFTRGN_MAP_X" "5"
 SYSTEM_CONSTANT "PFLTLD_MRESFLWMEASAFTRGN_MAP_Y" "14"
 SYSTEM_CONSTANT "PFLTLD_MSOTRESAFTRGN_MAP_X" "2"
 SYSTEM_CONSTANT "PFLTLD_MSOTRESAFTRGN_MAP_Y" "2"
 SYSTEM_CONSTANT "PFLTLD_MSOTSIMRGNNO2_CUR_X" "8"
 SYSTEM_CONSTANT "PFLTLD_RLMBDSTAT_MAP_X" "8"
 SYSTEM_CONSTANT "PFLTLD_RLMBDSTAT_MAP_Y" "8"
 SYSTEM_CONSTANT "PFLTLD_RNOXENGBAS_MAP_X" "8"
 SYSTEM_CONSTANT "PFLTLD_RNOXENGBAS_MAP_Y" "8"
 SYSTEM_CONSTANT "PFLTLD_RNOXENGEGROFF_MAP_X" "8"
 SYSTEM_CONSTANT "PFLTLD_RNOXENGEGROFF_MAP_Y" "8"
 SYSTEM_CONSTANT "PFLTLD_RNOXENGERR_MAP_X" "8"
 SYSTEM_CONSTANT "PFLTLD_RNOXENGERR_MAP_Y" "8"
 SYSTEM_CONSTANT "PFLTLD_RO2EGONE_SY" "1"
 SYSTEM_CONSTANT "PFLTLD_RO2EG_SY" "0.2315"
 SYSTEM_CONSTANT "PFLTLD_RO2SIMRGN_MAP_X" "8"
 SYSTEM_CONSTANT "PFLTLD_RO2SIMRGN_MAP_Y" "8"
 SYSTEM_CONSTANT "PFLTLD_TIME_DT" "1000000"
 SYSTEM_CONSTANT "PFLTLD_TIME_S" "10000"
 SYSTEM_CONSTANT "PFLTLD_TINO2RGNDEL_MAP_X" "2"
 SYSTEM_CONSTANT "PFLTLD_TINO2RGNDEL_MAP_Y" "2"
 SYSTEM_CONSTANT "PFLTNUMCHNGIMMD_SY" "3"
 SYSTEM_CONSTANT "PFLTNUMCHNG_SY" "6"
 SYSTEM_CONSTANT "PFLTNUMRGNMAX_SY" "6"
 SYSTEM_CONSTANT "PFLTPOP_NUMTHRESH_X" "11"
 SYSTEM_CONSTANT "PFLTPOP_NUMTHRESH_Y" "2"
 SYSTEM_CONSTANT "PFLTPOP_QSETUNBAL_CUR_X" "8"
 SYSTEM_CONSTANT "PFLTRGNSTGMAX_SY" "10"
 SYSTEM_CONSTANT "PFLTRGN_ADYNMINLIM_MAP_X" "6"
 SYSTEM_CONSTANT "PFLTRGN_ADYNMINLIM_MAP_Y" "6"
 SYSTEM_CONSTANT "PFLTRGN_FACFULLLDCOR_MAP_X" "8"
 SYSTEM_CONSTANT "PFLTRGN_FACFULLLDCOR_MAP_Y" "8"
 SYSTEM_CONSTANT "PFLTRGN_FACNO2RGNPRTMAX_CUR_X" "10"
 SYSTEM_CONSTANT "PFLTRGN_FACTINO2RGNPRTMAX_CUR_X" "10"
 SYSTEM_CONSTANT "PFLTRGN_LSNCERGNINTR_CA_X" "10"
 SYSTEM_CONSTANT "PFLTRGN_LSUMMAX_MAP_X" "12"
 SYSTEM_CONSTANT "PFLTRGN_LSUMMAX_MAP_Y" "10"
 SYSTEM_CONSTANT "PFLTRGN_NUMENGPOPDEL_CA_X" "12"
 SYSTEM_CONSTANT "PFLTRGN_NUMENGPOPDEL_CA_Y" "7"
 SYSTEM_CONSTANT "PFLTRGN_NUMENGPOP_CA_X" "12"
 SYSTEM_CONSTANT "PFLTRGN_NUMENGPOP_CA_Y" "7"
 SYSTEM_CONSTANT "PFLTRGN_PENGPRTASHCOR_MAP_X" "2"
 SYSTEM_CONSTANT "PFLTRGN_PENGPRTASHCOR_MAP_Y" "2"
 SYSTEM_CONSTANT "PFLTRGN_RESFLWENGPRTCOR_MAP_X" "2"
 SYSTEM_CONSTANT "PFLTRGN_RESFLWENGPRTCOR_MAP_Y" "2"
 SYSTEM_CONSTANT "PFLTRGN_RESFLWENGPRTMAX_MAP_X" "8"
 SYSTEM_CONSTANT "PFLTRGN_RESFLWENGPRTMAX_MAP_Y" "8"
 SYSTEM_CONSTANT "PFLTRGN_RESFLWENGPRTMIN_MAP_X" "8"
 SYSTEM_CONSTANT "PFLTRGN_RESFLWENGPRTMIN_MAP_Y" "8"
 SYSTEM_CONSTANT "PFLTRGN_RFULLLDBAS_MAP_X" "8"
 SYSTEM_CONSTANT "PFLTRGN_RFULLLDBAS_MAP_Y" "8"
 SYSTEM_CONSTANT "PFLTRGN_TICHNGRGNDELBAS_MAP_X" "8"
 SYSTEM_CONSTANT "PFLTRGN_TICHNGRGNDELBAS_MAP_Y" "8"
 SYSTEM_CONSTANT "PFLTRGN_TILCKRGNERR_CA_X" "7"
 SYSTEM_CONSTANT "PFLTRGN_TILCKRGN_CA_X" "7"
 SYSTEM_CONSTANT "PFLTRGN_TIRGNMAX_CA_X" "7"
 SYSTEM_CONSTANT "PFLT_ACTV_BP" "0"
 SYSTEM_CONSTANT "PFLT_FACINRDESAPSTCOR_CUR_X" "16"
 SYSTEM_CONSTANT "PFLT_NUMOPMODEMSK_SY" "2"
 SYSTEM_CONSTANT "PFLT_PDIFFCHARMONMIN_MAP_X" "8"
 SYSTEM_CONSTANT "PFLT_PDIFFCHARMONMIN_MAP_Y" "8"
 SYSTEM_CONSTANT "PFLT_PDIFFNODSTRMIN_CUR_X" "8"
 SYSTEM_CONSTANT "PFLT_PRIOMAX_SY" "2047"
 SYSTEM_CONSTANT "PFLT_RATSOTSOT_INVRESO" "4000"
 SYSTEM_CONSTANT "PFLT_RESFLWMAX_CUR_X" "8"
 SYSTEM_CONSTANT "PFLT_RESFLWMIN_CUR_X" "8"
 SYSTEM_CONSTANT "PFLT_STGMAX_SY" "15"
 SYSTEM_CONSTANT "PFLT_TINRDESAPSCOR_MAP_X" "16"
 SYSTEM_CONSTANT "PFLT_TINRDESAPSCOR_MAP_Y" "16"
 SYSTEM_CONSTANT "PHC_EGRMAXDEV_MAP_X" "12"
 SYSTEM_CONSTANT "PHC_EGRMAXDEV_MAP_Y" "8"
 SYSTEM_CONSTANT "PHC_EGRMINDEV_MAP_X" "12"
 SYSTEM_CONSTANT "PHC_EGRMINDEV_MAP_Y" "8"
 SYSTEM_CONSTANT "PHC_STDIRSWT_CA_X" "4"
 SYSTEM_CONSTANT "PHC_TIOVRRUN_CUR_X" "25"
 SYSTEM_CONSTANT "PHC_TISTG2DELAY_CUR_X" "8"
 SYSTEM_CONSTANT "PHC_TRQINRHIGH_MAP_X" "16"
 SYSTEM_CONSTANT "PHC_TRQINRHIGH_MAP_Y" "8"
 SYSTEM_CONSTANT "PHC_TRQINRLOW_MAP_X" "16"
 SYSTEM_CONSTANT "PHC_TRQINRLOW_MAP_Y" "8"
 SYSTEM_CONSTANT "PHC_TRQINROVRRUN_CUR_X" "25"
 SYSTEM_CONSTANT "PHI_COR_MAX" "10"
 SYSTEM_CONSTANT "PHI_ETCTL_MAX" "200"
 SYSTEM_CONSTANT "PHI_ETCTL_MIN" "-200"
 SYSTEM_CONSTANT "PHI_INJBEG_UIS_EARL" "50"
 SYSTEM_CONSTANT "PHI_INJBEG_UIS_LATE" "-60"
 SYSTEM_CONSTANT "PHI_MI_EARL" "40"
 SYSTEM_CONSTANT "PHI_MI_LATE" "-10"
 SYSTEM_CONSTANT "PHI_PII_EARL_ABS" "100"
 SYSTEM_CONSTANT "PHI_PII_EARL_REL" "90"
 SYSTEM_CONSTANT "PHI_PII_LATE_REL" "5"
 SYSTEM_CONSTANT "PHI_POI1_EARL" "-40"
 SYSTEM_CONSTANT "PHI_POI1_LATE" "-100"
 SYSTEM_CONSTANT "PHI_POI1_ZERO" "0"
 SYSTEM_CONSTANT "PHI_POI2_LATE" "-40"
 SYSTEM_CONSTANT "PHI_TIME_BY_N" "1831.05468750045"
 SYSTEM_CONSTANT "PHI_ZERO" "0"
 SYSTEM_CONSTANT "PHYMOD_CALCCOR_SY" "0"
 SYSTEM_CONSTANT "PHYMOD_FACPHIMICOR4_MAP_X" "2"
 SYSTEM_CONSTANT "PHYMOD_FACPHIMICOR4_MAP_Y" "2"
 SYSTEM_CONSTANT "PHYMOD_FACPHIMICOR5_MAP_X" "2"
 SYSTEM_CONSTANT "PHYMOD_FACPHIMICOR5_MAP_Y" "2"
 SYSTEM_CONSTANT "PHYMOD_FACPHIMICOR6_MAP_X" "2"
 SYSTEM_CONSTANT "PHYMOD_FACPHIMICOR6_MAP_Y" "2"
 SYSTEM_CONSTANT "PHYMOD_FACPHIMICOR7_MAP_X" "2"
 SYSTEM_CONSTANT "PHYMOD_FACPHIMICOR7_MAP_Y" "2"
 SYSTEM_CONSTANT "PHYMOD_FACPHIMICOR8_MAP_X" "2"
 SYSTEM_CONSTANT "PHYMOD_FACPHIMICOR8_MAP_Y" "2"
 SYSTEM_CONSTANT "PHYMOD_FACPHIMICOR9_MAP_X" "2"
 SYSTEM_CONSTANT "PHYMOD_FACPHIMICOR9_MAP_Y" "2"
 SYSTEM_CONSTANT "PHYMOD_GENCUR_SY" "1"
 SYSTEM_CONSTANT "PHYMOD_NUMOPMODE_SY" "10"
 SYSTEM_CONSTANT "PHYMOD_OPMODELEAN_SY" "3"
 SYSTEM_CONSTANT "PHYMOD_OPMODENSC_SY" "0"
 SYSTEM_CONSTANT "PHYMOD_OPMODEPFLT1_SY" "7"
 SYSTEM_CONSTANT "PHYMOD_OPMODEPFLT2_SY" "0"
 SYSTEM_CONSTANT "PHYMOD_OPMODEPHC_SY" "0"
 SYSTEM_CONSTANT "PHYMOD_OPMODESOX_SY" "0"
 SYSTEM_CONSTANT "PHYMOD_PHIMIREF4_MAP_X" "2"
 SYSTEM_CONSTANT "PHYMOD_PHIMIREF4_MAP_Y" "2"
 SYSTEM_CONSTANT "PHYMOD_PHIMIREF5_MAP_X" "2"
 SYSTEM_CONSTANT "PHYMOD_PHIMIREF5_MAP_Y" "2"
 SYSTEM_CONSTANT "PHYMOD_PHIMIREF6_MAP_X" "2"
 SYSTEM_CONSTANT "PHYMOD_PHIMIREF6_MAP_Y" "2"
 SYSTEM_CONSTANT "PHYMOD_PHIMIREF7_MAP_X" "2"
 SYSTEM_CONSTANT "PHYMOD_PHIMIREF7_MAP_Y" "2"
 SYSTEM_CONSTANT "PHYMOD_PHIMIREF8_MAP_X" "2"
 SYSTEM_CONSTANT "PHYMOD_PHIMIREF8_MAP_Y" "2"
 SYSTEM_CONSTANT "PHYMOD_PHIMIREF9_MAP_X" "2"
 SYSTEM_CONSTANT "PHYMOD_PHIMIREF9_MAP_Y" "2"
 SYSTEM_CONSTANT "PhyMod_pwrEGLos_MAP_X" "8"
 SYSTEM_CONSTANT "PhyMod_pwrEGLos_MAP_Y" "8"
 SYSTEM_CONSTANT "PHYMOD_QBASRED_MAP_X" "2"
 SYSTEM_CONSTANT "PHYMOD_QBASRED_MAP_Y" "2"
 SYSTEM_CONSTANT "PHYMOD_QBAS_MAP_X" "16"
 SYSTEM_CONSTANT "PHYMOD_QBAS_MAP_Y" "16"
 SYSTEM_CONSTANT "PI" "3.14159265359"
 SYSTEM_CONSTANT "PMP_QNT_MAX" "1500"
 SYSTEM_CONSTANT "PMP_QNT_RES" "0.1"
 SYSTEM_CONSTANT "PMP_QNT_ZERO" "0"
 SYSTEM_CONSTANT "POSMCDES_RMP_FACT" "100"
 SYSTEM_CONSTANT "POSMCKD_RES" "6.94444444444275e-006"
 SYSTEM_CONSTANT "POSMCKD_RES_4" "2.7777777777771e-005"
 SYSTEM_CONSTANT "POSMCKI_RES" "0.000211927625868004"
 SYSTEM_CONSTANT "POSMCKI_RES_2" "0.000423855251736008"
 SYSTEM_CONSTANT "POSMCKP_RES" "1.38888888888855e-005"
 SYSTEM_CONSTANT "POSMCKP_RES_32" "0.000444444444444336"
 SYSTEM_CONSTANT "POSTDRV_SOFTRST_SY" "0"
 SYSTEM_CONSTANT "POSTDRV_T15RST_SY" "0"
 SYSTEM_CONSTANT "POS_PRC_RES_FL" "0.01220703125"
 SYSTEM_CONSTANT "PRC_100" "100"
 SYSTEM_CONSTANT "PRC_150" "150"
 SYSTEM_CONSTANT "PRC_50" "50"
 SYSTEM_CONSTANT "PRC_90" "90"
 SYSTEM_CONSTANT "PRC_EGRRMP_RES" "0.152587890625"
 SYSTEM_CONSTANT "PRC_RES" "0.01220703125"
 SYSTEM_CONSTANT "PRC_RES_REV" "81.92"
 SYSTEM_CONSTANT "PRC_RMPPRC_MS" "65536"
 SYSTEM_CONSTANT "PRC_ZERO" "0"
 SYSTEM_CONSTANT "PREDRV_T15RST_SY" "0"
 SYSTEM_CONSTANT "PRESHPA_FNRESO" "0.1"
 SYSTEM_CONSTANT "PRES_AC_HPA_RES" "2"
 SYSTEM_CONSTANT "PRES_AIR_MAX" "3500"
 SYSTEM_CONSTANT "PRES_AIR_MIN" "0"
 SYSTEM_CONSTANT "PRES_BAR_RES" "1"
 SYSTEM_CONSTANT "PRES_HPA_RES" "1"
 SYSTEM_CONSTANT "PRES_HPA_RES_FL" "1"
 SYSTEM_CONSTANT "PRES_HPA_RES_INV" "1"
 SYSTEM_CONSTANT "PRES_HPA_RES_REV" "1"
 SYSTEM_CONSTANT "PRES_HPA_ZERO" "0"
 SYSTEM_CONSTANT "PRES_RAIL_GRAD_TO_VAL" "4"
 SYSTEM_CONSTANT "PRES_RAIL_RES" "100"
 SYSTEM_CONSTANT "PRES_RES" "0.1"
 SYSTEM_CONSTANT "PRES_SI_RES" "100"
 SYSTEM_CONSTANT "PRES_TIME_RES" "400"
 SYSTEM_CONSTANT "PRE_SCALER_ENGPRTRGNMON" "1000000"
 SYSTEM_CONSTANT "PRE_SCALER_LIMPHOME" "10000000"
 SYSTEM_CONSTANT "PRP_RENG_MAP_X" "16"
 SYSTEM_CONSTANT "PRP_RENG_MAP_Y" "16"
 SYSTEM_CONSTANT "PRP_RPRP_MAP_X" "16"
 SYSTEM_CONSTANT "PRP_RPRP_MAP_Y" "16"
 SYSTEM_CONSTANT "PRP_TRQTHRESENG_CUR_X" "25"
 SYSTEM_CONSTANT "PRP_TRQTHRESPRP_CUR_X" "25"
 SYSTEM_CONSTANT "PSC_COEOM_EGT_NUMINP" "4"
 SYSTEM_CONSTANT "PSC_COEOM_RMP_MAX" "16384000"
 SYSTEM_CONSTANT "PSC_FACT_REC_RES" "3.05185094759972e-005"
 SYSTEM_CONSTANT "PSC_FACT_REC_RES_REV" "32767"
 SYSTEM_CONSTANT "PSC_LSIG_IDX_MAX" "14"
 SYSTEM_CONSTANT "PSC_NRMPHC_SPD_IDX_MAX" "13"
 SYSTEM_CONSTANT "PSC_NUMCYLMAX_SY" "5"
 SYSTEM_CONSTANT "PSC_WARNTHRES_FACT" "10000"
 SYSTEM_CONSTANT "PSPCTL_DVOLBASE_CUR_X" "8"
 SYSTEM_CONSTANT "PSPCTL_DVOLTEMPLIM_MAP_X" "3"
 SYSTEM_CONSTANT "PSPCTL_DVOLTEMPLIM_MAP_Y" "3"
 SYSTEM_CONSTANT "PSPCTL_FACFUELTCOR_CUR_X" "16"
 SYSTEM_CONSTANT "PSPCTL_TIT15DELAY_CUR_X" "8"
 SYSTEM_CONSTANT "PSP_ATSINTVMOD_SY" "0"
 SYSTEM_CONSTANT "PT1INIT_ZERO_SY" "0"
 SYSTEM_CONSTANT "PTHDIST_FACCTCOR_CUR_X" "8"
 SYSTEM_CONSTANT "PTHDIST_FACEPCOR_CUR_X" "8"
 SYSTEM_CONSTANT "PTHDIST_FACPOI1EGTCOR_CUR_X" "8"
 SYSTEM_CONSTANT "PTHDIST_PII1_MAP_X" "16"
 SYSTEM_CONSTANT "PTHDIST_PII1_MAP_Y" "16"
 SYSTEM_CONSTANT "PTHDIST_PII2_MAP_X" "16"
 SYSTEM_CONSTANT "PTHDIST_PII2_MAP_Y" "16"
 SYSTEM_CONSTANT "PTHDIST_PII3_MAP_X" "16"
 SYSTEM_CONSTANT "PTHDIST_PII3_MAP_Y" "16"
 SYSTEM_CONSTANT "PTHDIST_POI1_MAP_X" "16"
 SYSTEM_CONSTANT "PTHDIST_POI1_MAP_Y" "16"
 SYSTEM_CONSTANT "PTHDIST_POI2_MAP_X" "16"
 SYSTEM_CONSTANT "PTHDIST_POI2_MAP_Y" "16"
 SYSTEM_CONSTANT "PTHDIST_TRQCTCOR_MAP_X" "8"
 SYSTEM_CONSTANT "PTHDIST_TRQCTCOR_MAP_Y" "8"
 SYSTEM_CONSTANT "PTHDIST_TRQEPCOR_MAP_X" "8"
 SYSTEM_CONSTANT "PTHDIST_TRQEPCOR_MAP_Y" "8"
 SYSTEM_CONSTANT "PTHDIST_TRQPOI1EGTCOR_MAP_X" "8"
 SYSTEM_CONSTANT "PTHDIST_TRQPOI1EGTCOR_MAP_Y" "8"
 SYSTEM_CONSTANT "PTHLEAD_STACTVMONLIMCURR_BP" "0"
 SYSTEM_CONSTANT "PTHLEAD_STACTVMONLIMLEAD_BP" "1"
 SYSTEM_CONSTANT "PTHSET_DTRQRMPDWN_CUR_X" "6"
 SYSTEM_CONSTANT "PTHSET_STACTVMONLIMSET_BP" "0"
 SYSTEM_CONSTANT "PTHSET_TIRMPSTRT_CUR_X" "6"
 SYSTEM_CONSTANT "PTHSET_TISWTOFF_CUR_X" "6"
 SYSTEM_CONSTANT "PTODI_40MS" "40000"
 SYSTEM_CONSTANT "PTPRTOVRDSSPDGOV_SY" "0"
 SYSTEM_CONSTANT "PTPRT_OVRDS_SPDGOV" "1"
 SYSTEM_CONSTANT "PT_CLTHCLSD_MSK" "30"
 SYSTEM_CONSTANT "PT_CLTHOPN_MSK" "16"
 SYSTEM_CONSTANT "PT_CLTHSLIP_MSK" "28"
 SYSTEM_CONSTANT "PT_CLTHTCHPNT_MSK" "24"
 SYSTEM_CONSTANT "PT_CONVNOSLIP_MSK" "31"
 SYSTEM_CONSTANT "PT_CONVSLIPCTL_MSK" "29"
 SYSTEM_CONSTANT "PT_CONVSLIPOPN_MSK" "17"
 SYSTEM_CONSTANT "PT_CONVSLIP_MSK" "25"
 SYSTEM_CONSTANT "PT_GRIPNOGRIP_BP" "4"
 SYSTEM_CONSTANT "PT_GRIP_BP" "0"
 SYSTEM_CONSTANT "PT_GRIP_CLTH_SLIP_CLSD_MSK" "0"
 SYSTEM_CONSTANT "PT_GRIP_CLTH_SWT_SS_MSK" "0"
 SYSTEM_CONSTANT "PT_GRIP_NO_GRIP_MSK" "0"
 SYSTEM_CONSTANT "PT_NOGRIP_MSK" "0"
 SYSTEM_CONSTANT "PT_RINVLDCALCRSLT" "0"
 SYSTEM_CONSTANT "PT_TRAGRIP_MSK" "31"
 SYSTEM_CONSTANT "PT_TRANOGRIP_MSK" "0"
 SYSTEM_CONSTANT "PWR2_RES" "18.84955592154"
 SYSTEM_CONSTANT "PWR_HIGH_RES" "0.1"
 SYSTEM_CONSTANT "PWR_HIGH_RES_REV" "10"
 SYSTEM_CONSTANT "PWR_HI_RES" "1"
 SYSTEM_CONSTANT "PWR_KW_RES" "0.01"
 SYSTEM_CONSTANT "PWR_PA_MAX" "32000"
 SYSTEM_CONSTANT "PWR_PA_RES" "5"
 SYSTEM_CONSTANT "PWR_PA_ZERO" "0"
 SYSTEM_CONSTANT "PWR_Q1_RES" "1"
 SYSTEM_CONSTANT "PWR_Q1_RES_REV" "1"
 SYSTEM_CONSTANT "PWR_RES" "9.42477796077"
 SYSTEM_CONSTANT "PWR_RES_FL" "9.42477796077"
 SYSTEM_CONSTANT "PWR_ZERO" "0"
 SYSTEM_CONSTANT "P_ENGPRT_MAX" "1500"
 SYSTEM_CONSTANT "P_ENGPRT_MIN" "0"
 SYSTEM_CONSTANT "QLAMBDARESREV_SY" "1000"
 SYSTEM_CONSTANT "QNTR_EXP" "10"
 SYSTEM_CONSTANT "QNTR_MAX" "24"
 SYSTEM_CONSTANT "QNTR_MIN" "0.0009765625"
 SYSTEM_CONSTANT "QNTR_RES" "0.0009765625"
 SYSTEM_CONSTANT "QNTR_RES_REV" "1024"
 SYSTEM_CONSTANT "QNTSEL_SY" "0"
 SYSTEM_CONSTANT "Qp_RES" "10"
 SYSTEM_CONSTANT "QWC_FACCOR1_MAP_X" "8"
 SYSTEM_CONSTANT "QWC_FACCOR1_MAP_Y" "16"
 SYSTEM_CONSTANT "QWC_FACCOR2_MAP_X" "8"
 SYSTEM_CONSTANT "QWC_FACCOR2_MAP_Y" "16"
 SYSTEM_CONSTANT "QWC_FACFTS_MAP_X" "16"
 SYSTEM_CONSTANT "QWC_FACFTS_MAP_Y" "8"
 SYSTEM_CONSTANT "QWC_QCOR1_MAP_X" "32"
 SYSTEM_CONSTANT "QWC_QCOR1_MAP_Y" "16"
 SYSTEM_CONSTANT "QWC_QCOR2_MAP_X" "32"
 SYSTEM_CONSTANT "QWC_QCOR2_MAP_Y" "12"
 SYSTEM_CONSTANT "QWC_QNORM_CUR_X" "14"
 SYSTEM_CONSTANT "QWC_TCOR_MAP_X" "16"
 SYSTEM_CONSTANT "QWC_TCOR_MAP_Y" "16"
 SYSTEM_CONSTANT "QWC_TIDIFFHYD_MAP_X" "14"
 SYSTEM_CONSTANT "QWC_TIDIFFHYD_MAP_Y" "16"
 SYSTEM_CONSTANT "R2RPS" "1000"
 SYSTEM_CONSTANT "RAILP_NUMDPMAXUPLIM_SY" "1000"
 SYSTEM_CONSTANT "RAILP_PFLTWINNEG_CUR_X" "10"
 SYSTEM_CONSTANT "RAILP_PLIN_CUR_X" "4"
 SYSTEM_CONSTANT "RAILP_SSPMON1_SY" "1"
 SYSTEM_CONSTANT "RAILP_SSPMON2_SY" "2"
 SYSTEM_CONSTANT "RAILP_SSPMON3_SY" "3"
 SYSTEM_CONSTANT "RAILP_TIOFSTSTDEL_CUR_X" "6"
 SYSTEM_CONSTANT "RAIL_CALCBACK_I" "1"
 SYSTEM_CONSTANT "RAIL_CNT_NHPTST" "4"
 SYSTEM_CONSTANT "RAIL_CNT_NHPTST_PLUS_ONE" "5"
 SYSTEM_CONSTANT "RAIL_CNT_NHPTST_PLUS_THREE" "7"
 SYSTEM_CONSTANT "RAIL_CPC" "1"
 SYSTEM_CONSTANT "RAIL_DPDECMONMAX_CUR_X" "8"
 SYSTEM_CONSTANT "RAIL_DPSETPOINTDEC_CUR_X" "8"
 SYSTEM_CONSTANT "RAIL_DPSETPOINTINC_MAP_X" "12"
 SYSTEM_CONSTANT "RAIL_DPSETPOINTINC_MAP_Y" "8"
 SYSTEM_CONSTANT "RAIL_DP_MAX" "13000000"
 SYSTEM_CONSTANT "RAIL_DP_ZERO" "0"
 SYSTEM_CONSTANT "RAIL_DVOLLEAKAGED_MAP_X" "10"
 SYSTEM_CONSTANT "RAIL_DVOLLEAKAGED_MAP_Y" "10"
 SYSTEM_CONSTANT "RAIL_DVOLLEAK_MAP_X" "10"
 SYSTEM_CONSTANT "RAIL_DVOLLEAK_MAP_Y" "10"
 SYSTEM_CONSTANT "RAIL_DVOLMEUNCLOSE_CUR_X" "12"
 SYSTEM_CONSTANT "RAIL_DVOLMEUNCTLINITI_CUR_X" "2"
 SYSTEM_CONSTANT "RAIL_DVOLMEUNCTLTYPE_CUR_X" "6"
 SYSTEM_CONSTANT "RAIL_DVOLMEUNCTLUPLIM_CUR_X" "11"
 SYSTEM_CONSTANT "RAIL_DVOLMEUNLIMFST_CUR_X" "16"
 SYSTEM_CONSTANT "RAIL_DVOLMEUNOPN_CUR_X" "12"
 SYSTEM_CONSTANT "RAIL_DVOLMEUNOVRRUN_CUR_X" "8"
 SYSTEM_CONSTANT "RAIL_DVOLPCVCLOSE_CUR_X" "12"
 SYSTEM_CONSTANT "RAIL_DVOLPCVOPN_CUR_X" "12"
 SYSTEM_CONSTANT "RAIL_DVOLPRECTLBAS_MAP_X" "16"
 SYSTEM_CONSTANT "RAIL_DVOLPRECTLBAS_MAP_Y" "16"
 SYSTEM_CONSTANT "RAIL_DVOLPRECTLOFS_MAP_X" "8"
 SYSTEM_CONSTANT "RAIL_DVOLPRECTLOFS_MAP_Y" "8"
 SYSTEM_CONSTANT "RAIL_DVOLPRECTLPOI1_MAP_X" "2"
 SYSTEM_CONSTANT "RAIL_DVOLPRECTLPOI1_MAP_Y" "4"
 SYSTEM_CONSTANT "RAIL_DVOLPRECTLPOI2_MAP_X" "2"
 SYSTEM_CONSTANT "RAIL_DVOLPRECTLPOI2_MAP_Y" "4"
 SYSTEM_CONSTANT "RAIL_DVOLSTRT_MAP_X" "8"
 SYSTEM_CONSTANT "RAIL_DVOLSTRT_MAP_Y" "8"
 SYSTEM_CONSTANT "RAIL_FACAPPRSETPDYNCOR_CUR_X" "6"
 SYSTEM_CONSTANT "RAIL_FACAPSETPDYNCOR_CUR_X" "6"
 SYSTEM_CONSTANT "RAIL_FACDQSETPDYNCOR_CUR_X" "6"
 SYSTEM_CONSTANT "RAIL_FACEGRPSETPCOR_CUR_X" "8"
 SYSTEM_CONSTANT "RAIL_FACETSETPDYNCOR_CUR_X" "6"
 SYSTEM_CONSTANT "RAIL_FACIASETPDYNCOR_CUR_X" "6"
 SYSTEM_CONSTANT "RAIL_FACIMTSPSETPCOR_CUR_X" "8"
 SYSTEM_CONSTANT "RAIL_FACMEUNCTLDCOR_CUR_X" "4"
 SYSTEM_CONSTANT "RAIL_FACMEUNCTLICOR_CUR_X" "4"
 SYSTEM_CONSTANT "RAIL_FACMEUNCTLPCOR_CUR_X" "4"
 SYSTEM_CONSTANT "RAIL_FACMEUNDVT_CUR_X" "12"
 SYSTEM_CONSTANT "RAIL_FACMEUNSETPOINT_CUR_X" "12"
 SYSTEM_CONSTANT "RAIL_FACPCVDVT_CUR_X" "12"
 SYSTEM_CONSTANT "RAIL_FACSETPOINTAPSCORRGN_AXIS" "8"
 SYSTEM_CONSTANT "RAIL_FACSETPOINTAPSCOR_CUR_X" "8"
 SYSTEM_CONSTANT "RAIL_FACSETPOINTAPSCSTRT_CUR_X" "8"
 SYSTEM_CONSTANT "RAIL_FACSETPOINTATSCORRGN_AXIS" "8"
 SYSTEM_CONSTANT "RAIL_FACSETPOINTATSCOR_CUR_X" "8"
 SYSTEM_CONSTANT "RAIL_FACSETPOINTATSCSTRT_CUR_X" "8"
 SYSTEM_CONSTANT "RAIL_FACSETPOINTETSCOR1_CUR_X" "8"
 SYSTEM_CONSTANT "RAIL_FACSETPOINTETSCORRGN_AXIS" "8"
 SYSTEM_CONSTANT "RAIL_FACSETPOINTETSCOR_CUR_X" "8"
 SYSTEM_CONSTANT "RAIL_FACSETPOINTETSCSTRT_CUR_X" "8"
 SYSTEM_CONSTANT "RAIL_FACSETPOINTFTSCOR_CUR_X" "2"
 SYSTEM_CONSTANT "RAIL_FACSETPOINTRMPVAL_CUR_X" "12"
 SYSTEM_CONSTANT "RAIL_FACSETPOINTRMPVAL_GCUR_X" "10"
 SYSTEM_CONSTANT "RAIL_FREEZE_I" "0"
 SYSTEM_CONSTANT "RAIL_MAX_TIME_PRAMP_HPTST" "5000"
 SYSTEM_CONSTANT "RAIL_MEUNCTLDKD_CUR_X" "3"
 SYSTEM_CONSTANT "RAIL_MEUNCTLIKINEG_CUR_X" "13"
 SYSTEM_CONSTANT "RAIL_MEUNCTLIKIPOS_CUR_X" "13"
 SYSTEM_CONSTANT "RAIL_MEUNCTLIKI_CUR_X" "13"
 SYSTEM_CONSTANT "RAIL_MEUNCTLPKPNEG_CUR_X" "13"
 SYSTEM_CONSTANT "RAIL_MEUNCTLPKPPOS_CUR_X" "13"
 SYSTEM_CONSTANT "RAIL_MEUNCTLPKP_CUR_X" "13"
 SYSTEM_CONSTANT "RAIL_MEUN_PCV" "0"
 SYSTEM_CONSTANT "RAIL_PCPCFLTMIN_CUR_X" "16"
 SYSTEM_CONSTANT "RAIL_PCVCTLDKD_CUR_X" "2"
 SYSTEM_CONSTANT "RAIL_PCVCTLIKINEG_CUR_X" "13"
 SYSTEM_CONSTANT "RAIL_PCVCTLIKIPOS_CUR_X" "13"
 SYSTEM_CONSTANT "RAIL_PCVCTLIKI_CUR_X" "13"
 SYSTEM_CONSTANT "RAIL_PCVCTLPKPNEG_CUR_X" "13"
 SYSTEM_CONSTANT "RAIL_PCVCTLPKPPOS_CUR_X" "13"
 SYSTEM_CONSTANT "RAIL_PCVCTLPKP_CUR_X" "13"
 SYSTEM_CONSTANT "RAIL_PMAXSETSUBST_CUR_X" "5"
 SYSTEM_CONSTANT "RAIL_PMEUNDVTFST_CUR_X" "16"
 SYSTEM_CONSTANT "RAIL_PMEUNDVTMAX_CUR_X" "4"
 SYSTEM_CONSTANT "RAIL_PMEUNDVTMIN2_CUR_X" "16"
 SYSTEM_CONSTANT "RAIL_PMEUNDVTMIN_CUR_X" "4"
 SYSTEM_CONSTANT "RAIL_PMEUNFLTMIN_CUR_X" "16"
 SYSTEM_CONSTANT "RAIL_PNIPCVMAX_MAP_X" "6"
 SYSTEM_CONSTANT "RAIL_PNIPCVMAX_MAP_Y" "12"
 SYSTEM_CONSTANT "RAIL_PNIPCVMIN_MAP_X" "6"
 SYSTEM_CONSTANT "RAIL_PNIPCVMIN_MAP_Y" "12"
 SYSTEM_CONSTANT "RAIL_PPCVCLOSEOFS_CUR_X" "4"
 SYSTEM_CONSTANT "RAIL_PPCVDVTMAX_CUR_X" "4"
 SYSTEM_CONSTANT "RAIL_PPCVFLTMIN_CUR_X" "16"
 SYSTEM_CONSTANT "RAIL_PPCVINITI_MAP_X" "8"
 SYSTEM_CONSTANT "RAIL_PPCVINITI_MAP_Y" "12"
 SYSTEM_CONSTANT "RAIL_PPCVREDOFS_CUR_X" "4"
 SYSTEM_CONSTANT "RAIL_PPCVSETMAX_CUR_X" "4"
 SYSTEM_CONSTANT "RAIL_PPRECTL_MAP_X" "16"
 SYSTEM_CONSTANT "RAIL_PPRECTL_MAP_Y" "16"
 SYSTEM_CONSTANT "RAIL_PRESS_ABS" "0"
 SYSTEM_CONSTANT "RAIL_PRESS_DIF" "1"
 SYSTEM_CONSTANT "RAIL_PSETMIN_CURX" "4"
 SYSTEM_CONSTANT "RAIL_PSETMIN_CUR_X" "4"
 SYSTEM_CONSTANT "RAIL_PSETPDYNCOR_MAP_X" "4"
 SYSTEM_CONSTANT "RAIL_PSETPDYNCOR_MAP_Y" "4"
 SYSTEM_CONSTANT "RAIL_PSETPEGRLPCOR_MAP_X" "10"
 SYSTEM_CONSTANT "RAIL_PSETPEGRLPCOR_MAP_Y" "10"
 SYSTEM_CONSTANT "RAIL_PSETPOINTAPSCORRGNX_AXIS" "8"
 SYSTEM_CONSTANT "RAIL_PSETPOINTAPSCORRGNY_AXIS" "8"
 SYSTEM_CONSTANT "RAIL_PSETPOINTAPSCOR_MAP_X" "16"
 SYSTEM_CONSTANT "RAIL_PSETPOINTAPSCOR_MAP_Y" "16"
 SYSTEM_CONSTANT "RAIL_PSETPOINTAPSCSTRT_MAP_X" "2"
 SYSTEM_CONSTANT "RAIL_PSETPOINTAPSCSTRT_MAP_Y" "2"
 SYSTEM_CONSTANT "RAIL_PSETPOINTATSCORRGNX_AXIS" "16"
 SYSTEM_CONSTANT "RAIL_PSETPOINTATSCORRGNY_AXIS" "16"
 SYSTEM_CONSTANT "RAIL_PSETPOINTATSCOR_MAP_X" "16"
 SYSTEM_CONSTANT "RAIL_PSETPOINTATSCOR_MAP_Y" "16"
 SYSTEM_CONSTANT "RAIL_PSETPOINTATSCSTRT_MAP_X" "16"
 SYSTEM_CONSTANT "RAIL_PSETPOINTATSCSTRT_MAP_Y" "16"
 SYSTEM_CONSTANT "RAIL_PSETPOINTBASESTRT_MAP_X" "8"
 SYSTEM_CONSTANT "RAIL_PSETPOINTBASESTRT_MAP_Y" "8"
 SYSTEM_CONSTANT "RAIL_PSETPOINTBASE_MAP_X" "16"
 SYSTEM_CONSTANT "RAIL_PSETPOINTBASE_MAP_Y" "16"
 SYSTEM_CONSTANT "RAIL_PSETPOINTBASRGNX_AXIS" "16"
 SYSTEM_CONSTANT "RAIL_PSETPOINTBASRGNY_AXIS" "16"
 SYSTEM_CONSTANT "RAIL_PSETPOINTBATTMIN_CUR_X" "4"
 SYSTEM_CONSTANT "RAIL_PSETPOINTETSCOR1_MAP_X" "16"
 SYSTEM_CONSTANT "RAIL_PSETPOINTETSCOR1_MAP_Y" "16"
 SYSTEM_CONSTANT "RAIL_PSETPOINTETSCORRGNX_AXIS" "2"
 SYSTEM_CONSTANT "RAIL_PSETPOINTETSCORRGNY_AXIS" "2"
 SYSTEM_CONSTANT "RAIL_PSETPOINTETSCOR_MAP_X" "16"
 SYSTEM_CONSTANT "RAIL_PSETPOINTETSCOR_MAP_Y" "16"
 SYSTEM_CONSTANT "RAIL_PSETPOINTETSCSTRT_MAP_X" "8"
 SYSTEM_CONSTANT "RAIL_PSETPOINTETSCSTRT_MAP_Y" "8"
 SYSTEM_CONSTANT "RAIL_PSETPOINTFTSCOR_MAP_X" "2"
 SYSTEM_CONSTANT "RAIL_PSETPOINTFTSCOR_MAP_Y" "2"
 SYSTEM_CONSTANT "RAIL_PSETPOINTLIMNFLTEMP_MAP_X" "2"
 SYSTEM_CONSTANT "RAIL_PSETPOINTLIMNFLTEMP_MAP_Y" "2"
 SYSTEM_CONSTANT "RAIL_PSETPOINTMAXDEF_CUR_X" "6"
 SYSTEM_CONSTANT "RAIL_PSETPOINTMAXDEF_MAP_X" "6"
 SYSTEM_CONSTANT "RAIL_PSETPOINTMAXDEF_MAP_Y" "5"
 SYSTEM_CONSTANT "RAIL_PSETPOINTMAX_MAP_X" "5"
 SYSTEM_CONSTANT "RAIL_PSETPOINTMAX_MAP_Y" "6"
 SYSTEM_CONSTANT "RAIL_PSETPOINTMIN_MAP_X" "2"
 SYSTEM_CONSTANT "RAIL_PSETPOINTMIN_MAP_Y" "2"
 SYSTEM_CONSTANT "RAIL_PSETPOINTTEMPCORRGNX_AXIS" "12"
 SYSTEM_CONSTANT "RAIL_PSETPOINTTEMPCORRGNY_AXIS" "8"
 SYSTEM_CONSTANT "RAIL_P_MAX" "1800000"
 SYSTEM_CONSTANT "RAIL_P_ZERO" "0"
 SYSTEM_CONSTANT "RAIL_QCPCTLTYPERGN_CUR_X" "8"
 SYSTEM_CONSTANT "RAIL_QCPCTLTYPE_CUR_X" "8"
 SYSTEM_CONSTANT "RAIL_QMEUNCTLTYPE_CUR_X" "8"
 SYSTEM_CONSTANT "RAIL_QPCVCTLTYPE_CUR_X" "8"
 SYSTEM_CONSTANT "RAIL_RZFCINITDWN_CUR_X" "3"
 SYSTEM_CONSTANT "RAIL_RZFCINITUP_CUR_X" "3"
 SYSTEM_CONSTANT "RAIL_SETPOINTNUMSWTMAX" "6"
 SYSTEM_CONSTANT "RAIL_SETPOINTNUMSWTSET" "2"
 SYSTEM_CONSTANT "RAIL_SPEED_CNT" "4"
 SYSTEM_CONSTANT "RAIL_SWTCTLSEL_TYPE" "2"
 SYSTEM_CONSTANT "RAIL_SWTCTLSEL_VAL" "0"
 SYSTEM_CONSTANT "RAIL_SWTPRECTL_TYPE" "2"
 SYSTEM_CONSTANT "RAIL_SWTPRECTL_VAL" "0"
 SYSTEM_CONSTANT "RAIL_SWTPRESS_TYPE" "2"
 SYSTEM_CONSTANT "RAIL_SWTPRESS_VAL" "0"
 SYSTEM_CONSTANT "RAIL_SWTWINDUP_TYPE" "2"
 SYSTEM_CONSTANT "RAIL_SWTWINDUP_VAL" "1"
 SYSTEM_CONSTANT "RAIL_TIMEUNCTLDT1_CUR_X" "5"
 SYSTEM_CONSTANT "RAIL_TIMEUNCTLPT1_CUR_X" "8"
 SYSTEM_CONSTANT "RAIL_TIMEUNRMPDUR_CURX" "10"
 SYSTEM_CONSTANT "RAIL_TIMEUNRMPDUR_CUR_X" "8"
 SYSTEM_CONSTANT "RAIL_TIPCVCTLDT1_CUR_X" "5"
 SYSTEM_CONSTANT "RAIL_TIPCVRMPDUR_CUR_X" "8"
 SYSTEM_CONSTANT "RAIL_TMEUNCTLTYPE_CUR_X" "8"
 SYSTEM_CONSTANT "RAIL_TPCVCTLTYPE_CUR_X" "8"
 SYSTEM_CONSTANT "RAIL_TRQFLTEMPLIM_MAPX" "16"
 SYSTEM_CONSTANT "RAIL_TRQFLTEMPLIM_MAPY" "16"
 SYSTEM_CONSTANT "RAIL_WITHOUT_PRECTL" "0"
 SYSTEM_CONSTANT "RAIL_WITH_PRECTL" "1"
 SYSTEM_CONSTANT "RATAM_RES" "0.01"
 SYSTEM_CONSTANT "RATAM_RES_FL" "0.01"
 SYSTEM_CONSTANT "RATAM_RES_REV" "100"
 SYSTEM_CONSTANT "RATAM_ZERO" "0"
 SYSTEM_CONSTANT "RATASHM_RES" "1e-005"
 SYSTEM_CONSTANT "RATASHM_RES_REV" "100000"
 SYSTEM_CONSTANT "RATCM_RES" "1e-006"
 SYSTEM_CONSTANT "RATCOMASS_RES_FL" "1"
 SYSTEM_CONSTANT "RATFM_ONE" "1"
 SYSTEM_CONSTANT "RATFM_RES" "0.01"
 SYSTEM_CONSTANT "RATFM_RES_REV" "100"
 SYSTEM_CONSTANT "RATFM_ZERO" "0"
 SYSTEM_CONSTANT "RATNOXM_RES" "1e-007"
 SYSTEM_CONSTANT "RATNOXM_RES_REV" "10000000"
 SYSTEM_CONSTANT "RATSOTM_RES" "1e-005"
 SYSTEM_CONSTANT "RATSOTM_RES_REV" "100000"
 SYSTEM_CONSTANT "RATSOTSOT_RESO" "0.001"
 SYSTEM_CONSTANT "RATSOXM_RES" "1e-008"
 SYSTEM_CONSTANT "RATSOXM_RES_REV" "100000000"
 SYSTEM_CONSTANT "RESIST_RES" "0.1"
 SYSTEM_CONSTANT "RESO_T_INC_PER_DUR_TTH_ADAP" "10"
 SYSTEM_CONSTANT "RESVCONST_SY" "1"
 SYSTEM_CONSTANT "RESVREL_SY" "1"
 SYSTEM_CONSTANT "RES_FACT_256" "256"
 SYSTEM_CONSTANT "REVCNT_RES" "16"
 SYSTEM_CONSTANT "REVCNT_RES_EXP" "4"
 SYSTEM_CONSTANT "REVGEAR1" "-1"
 SYSTEM_CONSTANT "REYNOLDS_NUM1_RES" "1000"
 SYSTEM_CONSTANT "REYNOLDS_NUM_RES" "100"
 SYSTEM_CONSTANT "RHO_FUEL_RES" "0.1"
 SYSTEM_CONSTANT "RHO_OILASH_RES" "0.1"
 SYSTEM_CONSTANT "RMPGOVRESREV_SY" "512"
 SYSTEM_CONSTANT "RMPPRC_MAX" "399999.999814"
 SYSTEM_CONSTANT "RMPSQRVLG_S_REF" "1000"
 SYSTEM_CONSTANT "RMPSQRVLG_S_RES" "65536"
 SYSTEM_CONSTANT "RMP_INTMIN_DT10" "6554"
 SYSTEM_CONSTANT "RMP_INTMIN_DT100" "656"
 SYSTEM_CONSTANT "RMP_INTMIN_DT20" "3277"
 SYSTEM_CONSTANT "RMP_NORM_FAC" "6554"
 SYSTEM_CONSTANT "RMP_NRM_EXP" "16"
 SYSTEM_CONSTANT "RMP_NRM_EXP1" "9"
 SYSTEM_CONSTANT "RMP_RES" "0.0152587890625" /end MOD_PAR
/begin MOD_COMMON "" BYTE_ORDER MSB_LAST ALIGNMENT_BYTE 1 ALIGNMENT_WORD 2 ALIGNMENT_LONG 4 ALIGNMENT_FLOAT32_IEEE 4 /end MOD_COMMON
/end MODULE
/end PROJECT

ASAP2_VERSION 1 4
/begin PROJECT P_574 "EDC17_CP09"
/begin HEADER "" VERSION "V8KB" PROJECT_NO P_574 /end HEADER
/begin MODULE DIM ""
/begin MOD_COMMON "" BYTE_ORDER MSB_LAST ALIGNMENT_BYTE 1 ALIGNMENT_WORD 2 ALIGNMENT_LONG 4 ALIGNMENT_FLOAT32_IEEE 4 /end MOD_COMMON
/begin CHARACTERISTIC DFES_EnvRef.DFC_GlwEcuGndErr_C "DFES/Zuordnung Umweltdatenset für Prüfung DFC_GlwEcuGndErr" VALUE 0x80029EC4 Val_Wu16 79. DFES_EnvTabVerb 0.00 79. FORMAT "%2.0" /end CHARACTERISTIC
/begin CHARACTERISTIC DFES_EnvRef.DFC_GlwEcuIntErr_C "DFES/Zuordnung Umweltdatenset für Prüfung DFC_GlwEcuIntErr" VALUE 0x80029EC6 Val_Wu16 79. DFES_EnvTabVerb 0.00 79. FORMAT "%2.0" /end CHARACTERISTIC
/begin CHARACTERISTIC DFES_EnvRef.DFC_GlwEcuMsgTimeout_C "DFES/Zuordnung Umweltdatenset für Prüfung DFC_GlwEcuMsgTimeout" VALUE 0x80029EC8 Val_Wu16 79. DFES_EnvTabVerb 0.00 79. FORMAT "%2.0" /end CHARACTERISTIC
/begin CHARACTERISTIC DFES_EnvRef.DFC_GlwEcuT30Err_C "DFES/Zuordnung Umweltdatenset für Prüfung DFC_GlwEcuT30Err" VALUE 0x80029ECA Val_Wu16 79. DFES_EnvTabVerb 0.00 79. FORMAT "%2.0" /end CHARACTERISTIC
/begin CHARACTERISTIC DFES_EnvRef.DFC_GlwEcuTempErr_C "DFES/Zuordnung Umweltdatenset für Prüfung DFC_GlwEcuTempErr" VALUE 0x80029ECC Val_Wu16 79. DFES_EnvTabVerb 0.00 79. FORMAT "%2.0" /end CHARACTERISTIC
/begin CHARACTERISTIC DFES_EnvRef.DFC_GlwEcuUdiffT30_C "DFES/Zuordnung Umweltdatenset für Prüfung DFC_GlwEcuUdiffT30" VALUE 0x80029ECE Val_Wu16 79. DFES_EnvTabVerb 0.00 79. FORMAT "%2.0" /end CHARACTERISTIC
/begin CHARACTERISTIC DFES_EnvRef.DFC_IBSComErr_C "DFES/Zuordnung Umweltdatenset für Prüfung DFC_IBSComErr" VALUE 0x80029ED0 Val_Wu16 79. DFES_EnvTabVerb 0.00 79. FORMAT "%2.0" /end CHARACTERISTIC
/begin CHARACTERISTIC DFES_EnvRef.DFC_LubSRCOilFldtCrit_C "DFES/Zuordnung Umweltdatenset für Prüfung DFC_LubSRCOilFldtCrit" VALUE 0x80029ED2 Val_Wu16 79. DFES_EnvTabVerb 0.00 79. FORMAT "%2.0" /end CHARACTERISTIC
/begin CHARACTERISTIC DFES_EnvRef.DFC_LubSRCOilFldtCritDflMin_C "DFES/Zuordnung Umweltdatenset für Prüfung DFC_LubSRCOilFldtCritDflMin" VALUE 0x80029ED4 Val_Wu16 79. DFES_EnvTabVerb 0.00 79. FORMAT "%2.0" /end CHARACTERISTIC
/begin CHARACTERISTIC DFES_EnvRef.DFC_LubSRCOilLvlCritMax_C "DFES/Zuordnung Umweltdatenset für Prüfung DFC_LubSRCOilLvlCritMax" VALUE 0x80029ED6 Val_Wu16 79. DFES_EnvTabVerb 0.00 79. FORMAT "%2.0" /end CHARACTERISTIC
/begin CHARACTERISTIC DFES_EnvRef.DFC_LubSRCOilLvlCritMin_C "DFES/Zuordnung Umweltdatenset für Prüfung DFC_LubSRCOilLvlCritMin" VALUE 0x80029ED8 Val_Wu16 79. DFES_EnvTabVerb 0.00 79. FORMAT "%2.0" /end CHARACTERISTIC
/begin CHARACTERISTIC DFES_EnvRef.DFC_LubSRCTot_C "DFES/Zuordnung Umweltdatenset für Prüfung DFC_LubSRCTot" VALUE 0x80029EDA Val_Wu16 79. DFES_EnvTabVerb 0.00 79. FORMAT "%2.0" /end CHARACTERISTIC
/begin CHARACTERISTIC DFES_EnvRef.DFC_MonUMaxSupply1_C "DFES/Zuordnung Umweltdatenset für Prüfung DFC_MonUMaxSupply1" VALUE 0x80029EDC Val_Wu16 79. DFES_EnvTabVerb 0.00 79. FORMAT "%2.0" /end CHARACTERISTIC
/begin CHARACTERISTIC DFES_EnvRef.DFC_MonUMinSupply1_C "DFES/Zuordnung Umweltdatenset für Prüfung DFC_MonUMinSupply1" VALUE 0x80029EDE Val_Wu16 79. DFES_EnvTabVerb 0.00 79. FORMAT "%2.0" /end CHARACTERISTIC
/begin CHARACTERISTIC DFES_EnvRef.DFC_OilComNpl_C "DFES/Zuordnung Umweltdatenset für Prüfung DFC_OilComNpl" VALUE 0x80029EE0 Val_Wu16 79. DFES_EnvTabVerb 0.00 79. FORMAT "%2.0" /end CHARACTERISTIC
/begin CHARACTERISTIC DFES_EnvRef.DFC_PCBS_C "DFES/Zuordnung Umweltdatenset für Prüfung DFC_PCBS" VALUE 0x80029EE2 Val_Wu16 79. DFES_EnvTabVerb 0.00 79. FORMAT "%2.0" /end CHARACTERISTIC
/begin CHARACTERISTIC DFES_EnvRef.DFC_PCBSPFltChg_C "DFES/Zuordnung Umweltdatenset für Prüfung DFC_PCBSPFltChg" VALUE 0x80029EE4 Val_Wu16 79. DFES_EnvTabVerb 0.00 79. FORMAT "%2.0" /end CHARACTERISTIC
/begin CHARACTERISTIC DFES_EnvRef.DFC_PCRGovDvtLPMax_C "DFES/Zuordnung Umweltdatenset für Prüfung DFC_PCRGovDvtLPMax" VALUE 0x80029EE6 Val_Wu16 79. DFES_EnvTabVerb 0.00 79. FORMAT "%2.0" /end CHARACTERISTIC
/begin CHARACTERISTIC DFES_EnvRef.DFC_PCRGovDvtLPMin_C "DFES/Zuordnung Umweltdatenset für Prüfung DFC_PCRGovDvtLPMin" VALUE 0x80029EE8 Val_Wu16 79. DFES_EnvTabVerb 0.00 79. FORMAT "%2.0" /end CHARACTERISTIC
/begin CHARACTERISTIC DFES_EnvRef.DFC_PCRGovDvtMax_C "DFES/Zuordnung Umweltdatenset für Prüfung DFC_PCRGovDvtMax" VALUE 0x80029EEA Val_Wu16 79. DFES_EnvTabVerb 0.00 79. FORMAT "%2.0" /end CHARACTERISTIC
/begin CHARACTERISTIC DFES_EnvRef.DFC_PCRGovDvtMin_C "DFES/Zuordnung Umweltdatenset für Prüfung DFC_PCRGovDvtMin" VALUE 0x80029EEC Val_Wu16 79. DFES_EnvTabVerb 0.00 79. FORMAT "%2.0" /end CHARACTERISTIC
/begin CHARACTERISTIC DFES_EnvRef.DFC_PFltAPSPlausMAX_C "DFES/Zuordnung Umweltdatenset für Prüfung DFC_PFltAPSPlausMAX" VALUE 0x80029EEE Val_Wu16 79. DFES_EnvTabVerb 0.00 79. FORMAT "%2.0" /end CHARACTERISTIC
/begin CHARACTERISTIC DFES_EnvRef.DFC_PFltAPSPlausMIN_C "DFES/Zuordnung Umweltdatenset für Prüfung DFC_PFltAPSPlausMIN" VALUE 0x80029EF0 Val_Wu16 79. DFES_EnvTabVerb 0.00 79. FORMAT "%2.0" /end CHARACTERISTIC
/begin CHARACTERISTIC DFES_EnvRef.DFC_PFltBPSPlausMAX_C "DFES/Zuordnung Umweltdatenset für Prüfung DFC_PFltBPSPlausMAX" VALUE 0x80029EF2 Val_Wu16 79. DFES_EnvTabVerb 0.00 79. FORMAT "%2.0" /end CHARACTERISTIC
/begin CHARACTERISTIC DFES_EnvRef.DFC_PFltBPSPlausMIN_C "DFES/Zuordnung Umweltdatenset für Prüfung DFC_PFltBPSPlausMIN" VALUE 0x80029EF4 Val_Wu16 79. DFES_EnvTabVerb 0.00 79. FORMAT "%2.0" /end CHARACTERISTIC
/begin CHARACTERISTIC DFES_EnvRef.DFC_PFltOvldInhRgn_C "DFES/Zuordnung Umweltdatenset für Prüfung DFC_PFltOvldInhRgn" VALUE 0x80029EF6 Val_Wu16 79. DFES_EnvTabVerb 0.00 79. FORMAT "%2.0" /end CHARACTERISTIC
/begin CHARACTERISTIC DFES_EnvRef.DFC_PFltOvldTrqLim_C "DFES/Zuordnung Umweltdatenset für Prüfung DFC_PFltOvldTrqLim" VALUE 0x80029EF8 Val_Wu16 79. DFES_EnvTabVerb 0.00 79. FORMAT "%2.0" /end CHARACTERISTIC
/begin CHARACTERISTIC DFES_EnvRef.DFC_PFltPresPlausMAX_C "DFES/Zuordnung Umweltdatenset für Prüfung DFC_PFltPresPlausMAX" VALUE 0x80029EFA Val_Wu16 79. DFES_EnvTabVerb 0.00 79. FORMAT "%2.0" /end CHARACTERISTIC
/begin CHARACTERISTIC DFES_EnvRef.DFC_PFltPresPlausMIN_C "DFES/Zuordnung Umweltdatenset für Prüfung DFC_PFltPresPlausMIN" VALUE 0x80029EFC Val_Wu16 79. DFES_EnvTabVerb 0.00 79. FORMAT "%2.0" /end CHARACTERISTIC
/begin CHARACTERISTIC DFES_EnvRef.DFC_PFltTraRpmRdc_C "DFES/Zuordnung Umweltdatenset für Prüfung DFC_PFltTraRpmRdc" VALUE 0x80029EFE Val_Wu16 79. DFES_EnvTabVerb 0.00 79. FORMAT "%2.0" /end CHARACTERISTIC
/begin CHARACTERISTIC DFES_EnvRef.DFC_PFlt_tOxiPreMax_C "DFES/Zuordnung Umweltdatenset für Prüfung DFC_PFlt_tOxiPreMax" VALUE 0x80029F00 Val_Wu16 79. DFES_EnvTabVerb 0.00 79. FORMAT "%2.0" /end CHARACTERISTIC
/begin CHARACTERISTIC DFES_EnvRef.DFC_PFlt_tOxiPreMaxRgn_C "DFES/Zuordnung Umweltdatenset für Prüfung DFC_PFlt_tOxiPreMaxRgn" VALUE 0x80029F02 Val_Wu16 79. DFES_EnvTabVerb 0.00 79. FORMAT "%2.0" /end CHARACTERISTIC
/begin CHARACTERISTIC DFES_EnvRef.DFC_PFlt_tOxiPreNpl_C "DFES/Zuordnung Umweltdatenset für Prüfung DFC_PFlt_tOxiPreNpl" VALUE 0x80029F04 Val_Wu16 79. DFES_EnvTabVerb 0.00 79. FORMAT "%2.0" /end CHARACTERISTIC
/begin CHARACTERISTIC DFES_EnvRef.DFC_PFlt_tPreMax_C "DFES/Zuordnung Umweltdatenset für Prüfung DFC_PFlt_tPreMax" VALUE 0x80029F06 Val_Wu16 79. DFES_EnvTabVerb 0.00 79. FORMAT "%2.0" /end CHARACTERISTIC
/begin CHARACTERISTIC DFES_EnvRef.DFC_PFlt_tPreMaxRgn_C "DFES/Zuordnung Umweltdatenset für Prüfung DFC_PFlt_tPreMaxRgn" VALUE 0x80029F08 Val_Wu16 79. DFES_EnvTabVerb 0.00 79. FORMAT "%2.0" /end CHARACTERISTIC
/begin CHARACTERISTIC DFES_EnvRef.DFC_PFlt_tPreNpl_C "DFES/Zuordnung Umweltdatenset für Prüfung DFC_PFlt_tPreNpl" VALUE 0x80029F0A Val_Wu16 79. DFES_EnvTabVerb 0.00 79. FORMAT "%2.0" /end CHARACTERISTIC
/begin CHARACTERISTIC DFES_EnvRef.DFC_PFltmSotDiffMAX_C "DFES/Zuordnung Umweltdatenset für Prüfung DFC_PFltmSotDiffMAX" VALUE 0x80029F0C Val_Wu16 79. DFES_EnvTabVerb 0.00 79. FORMAT "%2.0" /end CHARACTERISTIC
/begin CHARACTERISTIC DFES_EnvRef.DFC_PFltmSotDiffMIN_C "DFES/Zuordnung Umweltdatenset für Prüfung DFC_PFltmSotDiffMIN" VALUE 0x80029F0E Val_Wu16 79. DFES_EnvTabVerb 0.00 79. FORMAT "%2.0" /end CHARACTERISTIC
/begin CHARACTERISTIC DFES_EnvRef.DFC_PFltmSotDiffSIG_C "DFES/Zuordnung Umweltdatenset für Prüfung DFC_PFltmSotDiffSIG" VALUE 0x80029F10 Val_Wu16 79. DFES_EnvTabVerb 0.00 79. FORMAT "%2.0" /end CHARACTERISTIC
/begin CHARACTERISTIC DFES_EnvRef.DFC_PIntkVUsEnvPPls_C "DFES/Zuordnung Umweltdatenset für Prüfung DFC_PIntkVUsEnvPPls" VALUE 0x80029F12 Val_Wu16 79. DFES_EnvTabVerb 0.00 79. FORMAT "%2.0" /end CHARACTERISTIC
/begin CHARACTERISTIC DFES_EnvRef.DFC_PresPlausDblDef_C "DFES/Zuordnung Umweltdatenset für Prüfung DFC_PresPlausDblDef" VALUE 0x80029F14 Val_Wu16 79. DFES_EnvTabVerb 0.00 79. FORMAT "%2.0" /end CHARACTERISTIC
/begin CHARACTERISTIC DFES_EnvRef.DFC_RailCPC1_C "DFES/Zuordnung Umweltdatenset für Prüfung DFC_RailCPC1" VALUE 0x80029F16 Val_Wu16 79. DFES_EnvTabVerb 0.00 79. FORMAT "%2.0" /end CHARACTERISTIC
/begin CHARACTERISTIC DFES_EnvRef.DFC_RailCPC3_C "DFES/Zuordnung Umweltdatenset für Prüfung DFC_RailCPC3" VALUE 0x80029F18 Val_Wu16 79. DFES_EnvTabVerb 0.00 79. FORMAT "%2.0" /end CHARACTERISTIC
/begin CHARACTERISTIC DFES_EnvRef.DFC_RailCPC4_C "DFES/Zuordnung Umweltdatenset für Prüfung DFC_RailCPC4" VALUE 0x80029F1A Val_Wu16 79. DFES_EnvTabVerb 0.00 79. FORMAT "%2.0" /end CHARACTERISTIC
/begin CHARACTERISTIC DFES_EnvRef.DFC_RailMeUn0_C "DFES/Zuordnung Umweltdatenset für Prüfung DFC_RailMeUn0" VALUE 0x80029F1C Val_Wu16 79. DFES_EnvTabVerb 0.00 79. FORMAT "%2.0" /end CHARACTERISTIC
/begin CHARACTERISTIC DFES_EnvRef.DFC_RailMeUn1_C "DFES/Zuordnung Umweltdatenset für Prüfung DFC_RailMeUn1" VALUE 0x80029F1E Val_Wu16 79. DFES_EnvTabVerb 0.00 79. FORMAT "%2.0" /end CHARACTERISTIC
/begin CHARACTERISTIC DFES_EnvRef.DFC_RailMeUn2_C "DFES/Zuordnung Umweltdatenset für Prüfung DFC_RailMeUn2" VALUE 0x80029F20 Val_Wu16 79. DFES_EnvTabVerb 0.00 79. FORMAT "%2.0" /end CHARACTERISTIC
/begin CHARACTERISTIC DFES_EnvRef.DFC_RailMeUn22_C "DFES/Zuordnung Umweltdatenset für Prüfung DFC_RailMeUn22" VALUE 0x80029F22 Val_Wu16 79. DFES_EnvTabVerb 0.00 79. FORMAT "%2.0" /end CHARACTERISTIC
/begin CHARACTERISTIC DFES_EnvRef.DFC_RailMeUn3_C "DFES/Zuordnung Umweltdatenset für Prüfung DFC_RailMeUn3" VALUE 0x80029F24 Val_Wu16 79. DFES_EnvTabVerb 0.00 79. FORMAT "%2.0" /end CHARACTERISTIC
/begin CHARACTERISTIC DFES_EnvRef.DFC_RailMeUn4_C "DFES/Zuordnung Umweltdatenset für Prüfung DFC_RailMeUn4" VALUE 0x80029F26 Val_Wu16 79. DFES_EnvTabVerb 0.00 79. FORMAT "%2.0" /end CHARACTERISTIC
/begin CHARACTERISTIC DFES_EnvRef.DFC_RailMeUn42_C "DFES/Zuordnung Umweltdatenset für Prüfung DFC_RailMeUn42" VALUE 0x80029F28 Val_Wu16 79. DFES_EnvTabVerb 0.00 79. FORMAT "%2.0" /end CHARACTERISTIC
/begin CHARACTERISTIC DFES_EnvRef.DFC_RailMeUn5_C "DFES/Zuordnung Umweltdatenset für Prüfung DFC_RailMeUn5" VALUE 0x80029F2A Val_Wu16 79. DFES_EnvTabVerb 0.00 79. FORMAT "%2.0" /end CHARACTERISTIC
/begin CHARACTERISTIC DFES_EnvRef.DFC_RailPCV0_C "DFES/Zuordnung Umweltdatenset für Prüfung DFC_RailPCV0" VALUE 0x80029F2C Val_Wu16 79. DFES_EnvTabVerb 0.00 79. FORMAT "%2.0" /end CHARACTERISTIC
/begin CHARACTERISTIC DFES_EnvRef.DFC_RailPCV1_C "DFES/Zuordnung Umweltdatenset für Prüfung DFC_RailPCV1" VALUE 0x80029F2E Val_Wu16 79. DFES_EnvTabVerb 0.00 79. FORMAT "%2.0" /end CHARACTERISTIC
/begin CHARACTERISTIC DFES_EnvRef.DFC_RailPCV2_C "DFES/Zuordnung Umweltdatenset für Prüfung DFC_RailPCV2" VALUE 0x80029F30 Val_Wu16 79. DFES_EnvTabVerb 0.00 79. FORMAT "%2.0" /end CHARACTERISTIC
/begin CHARACTERISTIC DFES_EnvRef.DFC_RailPCV22_C "DFES/Zuordnung Umweltdatenset für Prüfung DFC_RailPCV22" VALUE 0x80029F32 Val_Wu16 79. DFES_EnvTabVerb 0.00 79. FORMAT "%2.0" /end CHARACTERISTIC
/begin CHARACTERISTIC DFES_EnvRef.DFC_RailPCV3_C "DFES/Zuordnung Umweltdatenset für Prüfung DFC_RailPCV3" VALUE 0x80029F34 Val_Wu16 79. DFES_EnvTabVerb 0.00 79. FORMAT "%2.0" /end CHARACTERISTIC
/begin CHARACTERISTIC DFES_EnvRef.DFC_RailPCV4_C "DFES/Zuordnung Umweltdatenset für Prüfung DFC_RailPCV4" VALUE 0x80029F36 Val_Wu16 79. DFES_EnvTabVerb 0.00 79. FORMAT "%2.0" /end CHARACTERISTIC
/begin CHARACTERISTIC DFES_EnvRef.DFC_RailPCV42_C "DFES/Zuordnung Umweltdatenset für Prüfung DFC_RailPCV42" VALUE 0x80029F38 Val_Wu16 79. DFES_EnvTabVerb 0.00 79. FORMAT "%2.0" /end CHARACTERISTIC
/begin CHARACTERISTIC DFES_EnvRef.DFC_RailPMonStrt_C "DFES/Zuordnung Umweltdatenset für Prüfung DFC_RailPMonStrt" VALUE 0x80029F3A Val_Wu16 79. DFES_EnvTabVerb 0.00 79. FORMAT "%2.0" /end CHARACTERISTIC
/begin CHARACTERISTIC DFES_EnvRef.DFC_SSpMon1_C "DFES/Zuordnung Umweltdatenset für Prüfung DFC_SSpMon1" VALUE 0x80029F3C Val_Wu16 79. DFES_EnvTabVerb 0.00 79. FORMAT "%2.0" /end CHARACTERISTIC
/begin CHARACTERISTIC DFES_EnvRef.DFC_SSpMon2_C "DFES/Zuordnung Umweltdatenset für Prüfung DFC_SSpMon2" VALUE 0x80029F3E Val_Wu16 79. DFES_EnvTabVerb 0.00 79. FORMAT "%2.0" /end CHARACTERISTIC
/begin CHARACTERISTIC DFES_EnvRef.DFC_SSpMon3_C "DFES/Zuordnung Umweltdatenset für Prüfung DFC_SSpMon3" VALUE 0x80029F40 Val_Wu16 79. DFES_EnvTabVerb 0.00 79. FORMAT "%2.0" /end CHARACTERISTIC
/begin CHARACTERISTIC DFES_EnvRef.DFC_ThrVlv4WinErr1_C "DFES/Zuordnung Umweltdatenset für Prüfung DFC_ThrVlv4WinErr1" VALUE 0x80029F42 Val_Wu16 79. DFES_EnvTabVerb 0.00 79. FORMAT "%2.0" /end CHARACTERISTIC
/begin CHARACTERISTIC DFES_EnvRef.DFC_ThrVlv4WinErr2_C "DFES/Zuordnung Umweltdatenset für Prüfung DFC_ThrVlv4WinErr2" VALUE 0x80029F44 Val_Wu16 79. DFES_EnvTabVerb 0.00 79. FORMAT "%2.0" /end CHARACTERISTIC
/begin CHARACTERISTIC DFES_EnvRef.DFC_ThrVlv4WinErr3_C "DFES/Zuordnung Umweltdatenset für Prüfung DFC_ThrVlv4WinErr3" VALUE 0x80029F46 Val_Wu16 79. DFES_EnvTabVerb 0.00 79. FORMAT "%2.0" /end CHARACTERISTIC
/begin CHARACTERISTIC DFES_EnvRef.DFC_ThrVlv4WinErr4_C "DFES/Zuordnung Umweltdatenset für Prüfung DFC_ThrVlv4WinErr4" VALUE 0x80029F48 Val_Wu16 79. DFES_EnvTabVerb 0.00 79. FORMAT "%2.0" /end CHARACTERISTIC
/begin CHARACTERISTIC DFES_EnvRef.DFC_ThrVlvSCG_C "DFES/Zuordnung Umweltdatenset für Prüfung DFC_ThrVlvSCG" VALUE 0x80029F4A Val_Wu16 79. DFES_EnvTabVerb 0.00 79. FORMAT "%2.0" /end CHARACTERISTIC
/begin CHARACTERISTIC DFES_EnvRef.DFC_Tle6232Spi1_C "DFES/Zuordnung Umweltdatenset für Prüfung DFC_Tle6232Spi1" VALUE 0x80029F4C Val_Wu16 79. DFES_EnvTabVerb 0.00 79. FORMAT "%2.0" /end CHARACTERISTIC
/begin CHARACTERISTIC DFES_EnvRef.DFC_TrbCh4WinErr1_C "DFES/Zuordnung Umweltdatenset für Prüfung DFC_TrbCh4WinErr1" VALUE 0x80029F4E Val_Wu16 79. DFES_EnvTabVerb 0.00 79. FORMAT "%2.0" /end CHARACTERISTIC
/begin CHARACTERISTIC DFES_EnvRef.DFC_TrbCh4WinErr2_C "DFES/Zuordnung Umweltdatenset für Prüfung DFC_TrbCh4WinErr2" VALUE 0x80029F50 Val_Wu16 79. DFES_EnvTabVerb 0.00 79. FORMAT "%2.0" /end CHARACTERISTIC
/begin CHARACTERISTIC DFES_EnvRef.DFC_TrbCh4WinErr3_C "DFES/Zuordnung Umweltdatenset für Prüfung DFC_TrbCh4WinErr3" VALUE 0x80029F52 Val_Wu16 79. DFES_EnvTabVerb 0.00 79. FORMAT "%2.0" /end CHARACTERISTIC
/begin CHARACTERISTIC DFES_EnvRef.DFC_TrbCh4WinErr4_C "DFES/Zuordnung Umweltdatenset für Prüfung DFC_TrbCh4WinErr4" VALUE 0x80029F54 Val_Wu16 79. DFES_EnvTabVerb 0.00 79. FORMAT "%2.0" /end CHARACTERISTIC
/begin CHARACTERISTIC DFES_EnvRef.DFC_TrbChSCG_C "DFES/Zuordnung Umweltdatenset für Prüfung DFC_TrbChSCG" VALUE 0x80029F56 Val_Wu16 79. DFES_EnvTabVerb 0.00 79. FORMAT "%2.0" /end CHARACTERISTIC
/begin CHARACTERISTIC DFES_EnvRef.DFC_TrbChSRCMax_C "DFES/Zuordnung Umweltdatenset für Prüfung DFC_TrbChSRCMax" VALUE 0x80029F58 Val_Wu16 79. DFES_EnvTabVerb 0.00 79. FORMAT "%2.0" /end CHARACTERISTIC
/begin CHARACTERISTIC DFES_EnvRef.DFC_TrbChSRCMin_C "DFES/Zuordnung Umweltdatenset für Prüfung DFC_TrbChSRCMin" VALUE 0x80029F5A Val_Wu16 79. DFES_EnvTabVerb 0.00 79. FORMAT "%2.0" /end CHARACTERISTIC
/begin CHARACTERISTIC DFES_EnvRef.DFC_WaHtEl4WinErr1_C "DFES/Zuordnung Umweltdatenset für Prüfung DFC_WaHtEl4WinErr1" VALUE 0x80029F5C Val_Wu16 79. DFES_EnvTabVerb 0.00 79. FORMAT "%2.0" /end CHARACTERISTIC
/begin CHARACTERISTIC DFES_EnvRef.DFC_WaHtEl4WinErr2_C "DFES/Zuordnung Umweltdatenset für Prüfung DFC_WaHtEl4WinErr2" VALUE 0x80029F5E Val_Wu16 79. DFES_EnvTabVerb 0.00 79. FORMAT "%2.0" /end CHARACTERISTIC
/begin CHARACTERISTIC DFES_EnvRef.DFC_WaHtEl4WinErr3_C "DFES/Zuordnung Umweltdatenset für Prüfung DFC_WaHtEl4WinErr3" VALUE 0x80029F60 Val_Wu16 79. DFES_EnvTabVerb 0.00 79. FORMAT "%2.0" /end CHARACTERISTIC
/begin CHARACTERISTIC DFES_EnvRef.DFC_WaHtEl4WinErr4_C "DFES/Zuordnung Umweltdatenset für Prüfung DFC_WaHtEl4WinErr4" VALUE 0x80029F62 Val_Wu16 79. DFES_EnvTabVerb 0.00 79. FORMAT "%2.0" /end CHARACTERISTIC
/begin CHARACTERISTIC DFES_EnvRef.DFC_WaHtElSCG_C "DFES/Zuordnung Umweltdatenset für Prüfung DFC_WaHtElSCG" VALUE 0x80029F64 Val_Wu16 79. DFES_EnvTabVerb 0.00 79. FORMAT "%2.0" /end CHARACTERISTIC
/begin CHARACTERISTIC DFES_EnvRef.DFC_ETClbETFltMax_0_C "DFES/Zuordnung Umweltdatenset für Prüfung DFC_ETClbETFltMax_0" VALUE 0x80029F66 Val_Wu16 79. DFES_EnvTabVerb 0.00 79. FORMAT "%2.0" /end CHARACTERISTIC
/begin CHARACTERISTIC DFES_EnvRef.DFC_ETClbETFltMax_1_C "DFES/Zuordnung Umweltdatenset für Prüfung DFC_ETClbETFltMax_1" VALUE 0x80029F68 Val_Wu16 79. DFES_EnvTabVerb 0.00 79. FORMAT "%2.0" /end CHARACTERISTIC
/begin CHARACTERISTIC DFES_EnvRef.DFC_ETClbETFltMax_2_C "DFES/Zuordnung Umweltdatenset für Prüfung DFC_ETClbETFltMax_2" VALUE 0x80029F6A Val_Wu16 79. DFES_EnvTabVerb 0.00 79. FORMAT "%2.0" /end CHARACTERISTIC
/begin CHARACTERISTIC DFES_EnvRef.DFC_ETClbETFltMax_3_C "DFES/Zuordnung Umweltdatenset für Prüfung DFC_ETClbETFltMax_3" VALUE 0x80029F6C Val_Wu16 79. DFES_EnvTabVerb 0.00 79. FORMAT "%2.0" /end CHARACTERISTIC
/begin CHARACTERISTIC DFES_EnvRef.DFC_ETClbETFltMax_4_C "DFES/Zuordnung Umweltdatenset für Prüfung DFC_ETClbETFltMax_4" VALUE 0x80029F6E Val_Wu16 79. DFES_EnvTabVerb 0.00 79. FORMAT "%2.0" /end CHARACTERISTIC
/begin CHARACTERISTIC DFES_EnvRef.DFC_ETClbETFltMax_5_C "DFES/Zuordnung Umweltdatenset für Prüfung DFC_ETClbETFltMax_5" VALUE 0x80029F70 Val_Wu16 79. DFES_EnvTabVerb 0.00 79. FORMAT "%2.0" /end CHARACTERISTIC
/begin CHARACTERISTIC DFES_EnvRef.DFC_ETClbETFltMin_0_C "DFES/Zuordnung Umweltdatenset für Prüfung DFC_ETClbETFltMin_0" VALUE 0x80029F72 Val_Wu16 79. DFES_EnvTabVerb 0.00 79. FORMAT "%2.0" /end CHARACTERISTIC
/begin CHARACTERISTIC DFES_EnvRef.DFC_ETClbETFltMin_1_C "DFES/Zuordnung Umweltdatenset für Prüfung DFC_ETClbETFltMin_1" VALUE 0x80029F74 Val_Wu16 79. DFES_EnvTabVerb 0.00 79. FORMAT "%2.0" /end CHARACTERISTIC
/begin CHARACTERISTIC DFES_EnvRef.DFC_ETClbETFltMin_2_C "DFES/Zuordnung Umweltdatenset für Prüfung DFC_ETClbETFltMin_2" VALUE 0x80029F76 Val_Wu16 79. DFES_EnvTabVerb 0.00 79. FORMAT "%2.0" /end CHARACTERISTIC
/begin CHARACTERISTIC DFES_EnvRef.DFC_ETClbETFltMin_3_C "DFES/Zuordnung Umweltdatenset für Prüfung DFC_ETClbETFltMin_3" VALUE 0x80029F78 Val_Wu16 79. DFES_EnvTabVerb 0.00 79. FORMAT "%2.0" /end CHARACTERISTIC
/begin CHARACTERISTIC DFES_EnvRef.DFC_ETClbETFltMin_4_C "DFES/Zuordnung Umweltdatenset für Prüfung DFC_ETClbETFltMin_4" VALUE 0x80029F7A Val_Wu16 79. DFES_EnvTabVerb 0.00 79. FORMAT "%2.0" /end CHARACTERISTIC
/begin CHARACTERISTIC DFES_EnvRef.DFC_ETClbETFltMin_5_C "DFES/Zuordnung Umweltdatenset für Prüfung DFC_ETClbETFltMin_5" VALUE 0x80029F7C Val_Wu16 79. DFES_EnvTabVerb 0.00 79. FORMAT "%2.0" /end CHARACTERISTIC
/begin CHARACTERISTIC DFES_EnvRef.DFC_InjCrvInjLimChrgBal_C "DFES/Zuordnung Umweltdatenset für Prüfung DFC_InjCrvInjLimChrgBal" VALUE 0x80029F7E Val_Wu16 79. DFES_EnvTabVerb 0.00 79. FORMAT "%2.0" /end CHARACTERISTIC
/begin CHARACTERISTIC DFES_EnvRef.DFC_InjCrvInjLimQntBal_C "DFES/Zuordnung Umweltdatenset für Prüfung DFC_InjCrvInjLimQntBal" VALUE 0x80029F80 Val_Wu16 79. DFES_EnvTabVerb 0.00 79. FORMAT "%2.0" /end CHARACTERISTIC
/begin CHARACTERISTIC DFES_EnvRef.DFC_InjCrvInjLimSys_C "DFES/Zuordnung Umweltdatenset für Prüfung DFC_InjCrvInjLimSys" VALUE 0x80029F82 Val_Wu16 79. DFES_EnvTabVerb 0.00 79. FORMAT "%2.0" /end CHARACTERISTIC
/begin CHARACTERISTIC DFES_EnvRef.DFC_InjCrvNumInjRtmLim_C "DFES/Zuordnung Umweltdatenset für Prüfung DFC_InjCrvNumInjRtmLim" VALUE 0x80029F84 Val_Wu16 79. DFES_EnvTabVerb 0.00 79. FORMAT "%2.0" /end CHARACTERISTIC
/begin CHARACTERISTIC DFES_EnvRef.DFC_LSUHtCoupSig_C "DFES/Zuordnung Umweltdatenset für Prüfung DFC_LSUHtCoupSig" VALUE 0x80029F86 Val_Wu16 79. DFES_EnvTabVerb 0.00 79. FORMAT "%2.0" /end CHARACTERISTIC
/begin CHARACTERISTIC DFES_EnvRef.DFC_AFS_SSpShOffOL_C "DFES/Zuordnung Umweltdatenset für Prüfung DFC_AFS_SSpShOffOL" VALUE 0x80029F88 Val_Wu16 79. DFES_EnvTabVerb 0.00 79. FORMAT "%2.0" /end CHARACTERISTIC
/begin CHARACTERISTIC DFES_EnvRef.DFC_AFS_SSpShOffOvrTemp_C "DFES/Zuordnung Umweltdatenset für Prüfung DFC_AFS_SSpShOffOvrTemp" VALUE 0x80029F8A Val_Wu16 79. DFES_EnvTabVerb 0.00 79. FORMAT "%2.0" /end CHARACTERISTIC
/begin CHARACTERISTIC DFES_EnvRef.DFC_AFS_SSpShOffSCB_C "DFES/Zuordnung Umweltdatenset für Prüfung DFC_AFS_SSpShOffSCB" VALUE 0x80029F8C Val_Wu16 79. DFES_EnvTabVerb 0.00 79. FORMAT "%2.0" /end CHARACTERISTIC
/begin CHARACTERISTIC DFES_EnvRef.DFC_AFS_SSpShOffSCG_C "DFES/Zuordnung Umweltdatenset für Prüfung DFC_AFS_SSpShOffSCG" VALUE 0x80029F8E Val_Wu16 79. DFES_EnvTabVerb 0.00 79. FORMAT "%2.0" /end CHARACTERISTIC
/begin CHARACTERISTIC DFES_EnvRef.DFC_AirCCmprOL_C "DFES/Zuordnung Umweltdatenset für Prüfung DFC_AirCCmprOL" VALUE 0x80029F90 Val_Wu16 79. DFES_EnvTabVerb 0.00 79. FORMAT "%2.0" /end CHARACTERISTIC
/begin CHARACTERISTIC DFES_EnvRef.DFC_AirCCmprOvrTemp_C "DFES/Zuordnung Umweltdatenset für Prüfung DFC_AirCCmprOvrTemp" VALUE 0x80029F92 Val_Wu16 79. DFES_EnvTabVerb 0.00 79. FORMAT "%2.0" /end CHARACTERISTIC
/begin CHARACTERISTIC DFES_EnvRef.DFC_AirCCmprSCB_C "DFES/Zuordnung Umweltdatenset für Prüfung DFC_AirCCmprSCB" VALUE 0x80029F94 Val_Wu16 79. DFES_EnvTabVerb 0.00 79. FORMAT "%2.0" /end CHARACTERISTIC
/begin CHARACTERISTIC DFES_EnvRef.DFC_AirCCmprSCG_C "DFES/Zuordnung Umweltdatenset für Prüfung DFC_AirCCmprSCG" VALUE 0x80029F96 Val_Wu16 79. DFES_EnvTabVerb 0.00 79. FORMAT "%2.0" /end CHARACTERISTIC
/begin CHARACTERISTIC DFES_EnvRef.DFC_CByVlvOL_C "DFES/Zuordnung Umweltdatenset für Prüfung DFC_CByVlvOL" VALUE 0x80029F98 Val_Wu16 79. DFES_EnvTabVerb 0.00 79. FORMAT "%2.0" /end CHARACTERISTIC
/begin CHARACTERISTIC DFES_EnvRef.DFC_CByVlvOvrTemp_C "DFES/Zuordnung Umweltdatenset für Prüfung DFC_CByVlvOvrTemp" VALUE 0x80029F9A Val_Wu16 79. DFES_EnvTabVerb 0.00 79. FORMAT "%2.0" /end CHARACTERISTIC
/begin CHARACTERISTIC DFES_EnvRef.DFC_CByVlvSCB_C "DFES/Zuordnung Umweltdatenset für Prüfung DFC_CByVlvSCB" VALUE 0x80029F9C Val_Wu16 79. DFES_EnvTabVerb 0.00 79. FORMAT "%2.0" /end CHARACTERISTIC
/begin CHARACTERISTIC DFES_EnvRef.DFC_CByVlvSCG_C "DFES/Zuordnung Umweltdatenset für Prüfung DFC_CByVlvSCG" VALUE 0x80029F9E Val_Wu16 79. DFES_EnvTabVerb 0.00 79. FORMAT "%2.0" /end CHARACTERISTIC
/begin CHARACTERISTIC DFES_EnvRef.DFC_CThmstOL_C "DFES/Zuordnung Umweltdatenset für Prüfung DFC_CThmstOL" VALUE 0x80029FA0 Val_Wu16 79. DFES_EnvTabVerb 0.00 79. FORMAT "%2.0" /end CHARACTERISTIC
/begin CHARACTERISTIC DFES_EnvRef.DFC_CThmstOvrTemp_C "DFES/Zuordnung Umweltdatenset für Prüfung DFC_CThmstOvrTemp" VALUE 0x80029FA2 Val_Wu16 79. DFES_EnvTabVerb 0.00 79. FORMAT "%2.0" /end CHARACTERISTIC
/begin CHARACTERISTIC DFES_EnvRef.DFC_CThmstSCB_C "DFES/Zuordnung Umweltdatenset für Prüfung DFC_CThmstSCB" VALUE 0x80029FA4 Val_Wu16 79. DFES_EnvTabVerb 0.00 79. FORMAT "%2.0" /end CHARACTERISTIC
/begin CHARACTERISTIC DFES_EnvRef.DFC_CThmstSCG_C "DFES/Zuordnung Umweltdatenset für Prüfung DFC_CThmstSCG" VALUE 0x80029FA6 Val_Wu16 79. DFES_EnvTabVerb 0.00 79. FORMAT "%2.0" /end CHARACTERISTIC
/begin CHARACTERISTIC DFES_EnvRef.DFC_DSMDummy_C "DFES/Zuordnung Umweltdatenset für Prüfung DFC_DSMDummy" VALUE 0x80029FA8 Val_Wu16 79. DFES_EnvTabVerb 0.00 79. FORMAT "%2.0" /end CHARACTERISTIC
/begin CHARACTERISTIC DFES_EnvRef.DFC_EBxFanOL_C "DFES/Zuordnung Umweltdatenset für Prüfung DFC_EBxFanOL" VALUE 0x80029FAA Val_Wu16 79. DFES_EnvTabVerb 0.00 79. FORMAT "%2.0" /end CHARACTERISTIC
/begin CHARACTERISTIC DFES_EnvRef.DFC_EBxFanOvrTemp_C "DFES/Zuordnung Umweltdatenset für Prüfung DFC_EBxFanOvrTemp" VALUE 0x80029FAC Val_Wu16 79. DFES_EnvTabVerb 0.00 79. FORMAT "%2.0" /end CHARACTERISTIC
/begin CHARACTERISTIC DFES_EnvRef.DFC_EBxFanSCB_C "DFES/Zuordnung Umweltdatenset für Prüfung DFC_EBxFanSCB" VALUE 0x80029FAE Val_Wu16 79. DFES_EnvTabVerb 0.00 79. FORMAT "%2.0" /end CHARACTERISTIC
/begin CHARACTERISTIC DFES_EnvRef.DFC_EBxFanSCG_C "DFES/Zuordnung Umweltdatenset für Prüfung DFC_EBxFanSCG" VALUE 0x80029FB0 Val_Wu16 79. DFES_EnvTabVerb 0.00 79. FORMAT "%2.0" /end CHARACTERISTIC
/begin CHARACTERISTIC DFES_EnvRef.DFC_ECBVlvOL_C "DFES/Zuordnung Umweltdatenset für Prüfung DFC_ECBVlvOL" VALUE 0x80029FB2 Val_Wu16 79. DFES_EnvTabVerb 0.00 79. FORMAT "%2.0" /end CHARACTERISTIC
/begin CHARACTERISTIC DFES_EnvRef.DFC_ECBVlvOvrTemp_C "DFES/Zuordnung Umweltdatenset für Prüfung DFC_ECBVlvOvrTemp" VALUE 0x80029FB4 Val_Wu16 79. DFES_EnvTabVerb 0.00 79. FORMAT "%2.0" /end CHARACTERISTIC
/begin CHARACTERISTIC DFES_EnvRef.DFC_ECBVlvSCB_C "DFES/Zuordnung Umweltdatenset für Prüfung DFC_ECBVlvSCB" VALUE 0x80029FB6 Val_Wu16 79. DFES_EnvTabVerb 0.00 79. FORMAT "%2.0" /end CHARACTERISTIC
/begin CHARACTERISTIC DFES_EnvRef.DFC_ECBVlvSCG_C "DFES/Zuordnung Umweltdatenset für Prüfung DFC_ECBVlvSCG" VALUE 0x80029FB8 Val_Wu16 79. DFES_EnvTabVerb 0.00 79. FORMAT "%2.0" /end CHARACTERISTIC
/begin CHARACTERISTIC DFES_EnvRef.DFC_EMDmpOL_0_C "DFES/Zuordnung Umweltdatenset für Prüfung DFC_EMDmpOL_0" VALUE 0x80029FBA Val_Wu16 79. DFES_EnvTabVerb 0.00 79. FORMAT "%2.0" /end CHARACTERISTIC
/begin CHARACTERISTIC DFES_EnvRef.DFC_EMDmpOL_1_C "DFES/Zuordnung Umweltdatenset für Prüfung DFC_EMDmpOL_1" VALUE 0x80029FBC Val_Wu16 79. DFES_EnvTabVerb 0.00 79. FORMAT "%2.0" /end CHARACTERISTIC
/begin CHARACTERISTIC DFES_EnvRef.DFC_EMDmpOvrTemp_0_C "DFES/Zuordnung Umweltdatenset für Prüfung DFC_EMDmpOvrTemp_0" VALUE 0x80029FBE Val_Wu16 79. DFES_EnvTabVerb 0.00 79. FORMAT "%2.0" /end CHARACTERISTIC
/begin CHARACTERISTIC DFES_EnvRef.DFC_EMDmpOvrTemp_1_C "DFES/Zuordnung Umweltdatenset für Prüfung DFC_EMDmpOvrTemp_1" VALUE 0x80029FC0 Val_Wu16 79. DFES_EnvTabVerb 0.00 79. FORMAT "%2.0" /end CHARACTERISTIC
/begin CHARACTERISTIC DFES_EnvRef.DFC_EMDmpSCB_0_C "DFES/Zuordnung Umweltdatenset für Prüfung DFC_EMDmpSCB_0" VALUE 0x80029FC2 Val_Wu16 79. DFES_EnvTabVerb 0.00 79. FORMAT "%2.0" /end CHARACTERISTIC
/begin CHARACTERISTIC DFES_EnvRef.DFC_EMDmpSCB_1_C "DFES/Zuordnung Umweltdatenset für Prüfung DFC_EMDmpSCB_1" VALUE 0x80029FC4 Val_Wu16 79. DFES_EnvTabVerb 0.00 79. FORMAT "%2.0" /end CHARACTERISTIC
/begin CHARACTERISTIC DFES_EnvRef.DFC_EMDmpSCG_0_C "DFES/Zuordnung Umweltdatenset für Prüfung DFC_EMDmpSCG_0" VALUE 0x80029FC6 Val_Wu16 79. DFES_EnvTabVerb 0.00 79. FORMAT "%2.0" /end CHARACTERISTIC
/begin CHARACTERISTIC DFES_EnvRef.DFC_EMDmpSCG_1_C "DFES/Zuordnung Umweltdatenset für Prüfung DFC_EMDmpSCG_1" VALUE 0x80029FC8 Val_Wu16 79. DFES_EnvTabVerb 0.00 79. FORMAT "%2.0" /end CHARACTERISTIC
/begin CHARACTERISTIC DFES_EnvRef.DFC_EngStAOL_C "DFES/Zuordnung Umweltdatenset für Prüfung DFC_EngStAOL" VALUE 0x80029FCA Val_Wu16 79. DFES_EnvTabVerb 0.00 79. FORMAT "%2.0" /end CHARACTERISTIC
/begin CHARACTERISTIC DFES_EnvRef.DFC_EngStAOvrTemp_C "DFES/Zuordnung Umweltdatenset für Prüfung DFC_EngStAOvrTemp" VALUE 0x80029FCC Val_Wu16 79. DFES_EnvTabVerb 0.00 79. FORMAT "%2.0" /end CHARACTERISTIC
/begin CHARACTERISTIC DFES_EnvRef.DFC_EngStASCB_C "DFES/Zuordnung Umweltdatenset für Prüfung DFC_EngStASCB" VALUE 0x80029FCE Val_Wu16 79. DFES_EnvTabVerb 0.00 79. FORMAT "%2.0" /end CHARACTERISTIC
/begin CHARACTERISTIC DFES_EnvRef.DFC_EngStASCG_C "DFES/Zuordnung Umweltdatenset für Prüfung DFC_EngStASCG" VALUE 0x80029FD0 Val_Wu16 79. DFES_EnvTabVerb 0.00 79. FORMAT "%2.0" /end CHARACTERISTIC
/begin CHARACTERISTIC DFES_EnvRef.DFC_FanOL_C "DFES/Zuordnung Umweltdatenset für Prüfung DFC_FanOL" VALUE 0x80029FD2 Val_Wu16 79. DFES_EnvTabVerb 0.00 79. FORMAT "%2.0" /end CHARACTERISTIC
/begin CHARACTERISTIC DFES_EnvRef.DFC_FanOvrTemp_C "DFES/Zuordnung Umweltdatenset für Prüfung DFC_FanOvrTemp" VALUE 0x80029FD4 Val_Wu16 79. DFES_EnvTabVerb 0.00 79. FORMAT "%2.0" /end CHARACTERISTIC
/begin CHARACTERISTIC DFES_EnvRef.DFC_FanSCB_C "DFES/Zuordnung Umweltdatenset für Prüfung DFC_FanSCB" VALUE 0x80029FD6 Val_Wu16 79. DFES_EnvTabVerb 0.00 79. FORMAT "%2.0" /end CHARACTERISTIC
/begin CHARACTERISTIC DFES_EnvRef.DFC_FlFltHtOL_C "DFES/Zuordnung Umweltdatenset für Prüfung DFC_FlFltHtOL" VALUE 0x80029FD8 Val_Wu16 79. DFES_EnvTabVerb 0.00 79. FORMAT "%2.0" /end CHARACTERISTIC
/begin CHARACTERISTIC DFES_EnvRef.DFC_FlFltHtOvrTemp_C "DFES/Zuordnung Umweltdatenset für Prüfung DFC_FlFltHtOvrTemp" VALUE 0x80029FDA Val_Wu16 79. DFES_EnvTabVerb 0.00 79. FORMAT "%2.0" /end CHARACTERISTIC
/begin CHARACTERISTIC DFES_EnvRef.DFC_FlFltHtSCB_C "DFES/Zuordnung Umweltdatenset für Prüfung DFC_FlFltHtSCB" VALUE 0x80029FDC Val_Wu16 79. DFES_EnvTabVerb 0.00 79. FORMAT "%2.0" /end CHARACTERISTIC
/begin CHARACTERISTIC DFES_EnvRef.DFC_FlFltHtSCG_C "DFES/Zuordnung Umweltdatenset für Prüfung DFC_FlFltHtSCG" VALUE 0x80029FDE Val_Wu16 79. DFES_EnvTabVerb 0.00 79. FORMAT "%2.0" /end CHARACTERISTIC
/begin CHARACTERISTIC DFES_EnvRef.DFC_LSUHtrMax_C "DFES/Zuordnung Umweltdatenset für Prüfung DFC_LSUHtrMax" VALUE 0x80029FE0 Val_Wu16 79. DFES_EnvTabVerb 0.00 79. FORMAT "%2.0" /end CHARACTERISTIC
/begin CHARACTERISTIC DFES_EnvRef.DFC_LSUHtrMin_C "DFES/Zuordnung Umweltdatenset für Prüfung DFC_LSUHtrMin" VALUE 0x80029FE2 Val_Wu16 79. DFES_EnvTabVerb 0.00 79. FORMAT "%2.0" /end CHARACTERISTIC
/begin CHARACTERISTIC DFES_EnvRef.DFC_LSUHtrNpl_C "DFES/Zuordnung Umweltdatenset für Prüfung DFC_LSUHtrNpl" VALUE 0x80029FE4 Val_Wu16 79. DFES_EnvTabVerb 0.00 79. FORMAT "%2.0" /end CHARACTERISTIC
/begin CHARACTERISTIC DFES_EnvRef.DFC_LSUHtrSig_C "DFES/Zuordnung Umweltdatenset für Prüfung DFC_LSUHtrSig" VALUE 0x80029FE6 Val_Wu16 79. DFES_EnvTabVerb 0.00 79. FORMAT "%2.0" /end CHARACTERISTIC
/begin CHARACTERISTIC DFES_EnvRef.DFC_LSUtExcMax_C "DFES/Zuordnung Umweltdatenset für Prüfung DFC_LSUtExcMax" VALUE 0x80029FE8 Val_Wu16 79. DFES_EnvTabVerb 0.00 79. FORMAT "%2.0" /end CHARACTERISTIC
/begin CHARACTERISTIC DFES_EnvRef.DFC_LSUtExcMin_C "DFES/Zuordnung Umweltdatenset für Prüfung DFC_LSUtExcMin" VALUE 0x80029FEA Val_Wu16 79. DFES_EnvTabVerb 0.00 79. FORMAT "%2.0" /end CHARACTERISTIC
/begin CHARACTERISTIC DFES_EnvRef.DFC_MeUnOL_C "DFES/Zuordnung Umweltdatenset für Prüfung DFC_MeUnOL" VALUE 0x80029FEC Val_Wu16 79. DFES_EnvTabVerb 0.00 79. FORMAT "%2.0" /end CHARACTERISTIC
/begin CHARACTERISTIC DFES_EnvRef.DFC_MeUnSCB_C "DFES/Zuordnung Umweltdatenset für Prüfung DFC_MeUnSCB" VALUE 0x80029FEE Val_Wu16 79. DFES_EnvTabVerb 0.00 79. FORMAT "%2.0" /end CHARACTERISTIC
/begin CHARACTERISTIC DFES_EnvRef.DFC_MeUnSRCMax_C "DFES/Zuordnung Umweltdatenset für Prüfung DFC_MeUnSRCMax" VALUE 0x80029FF0 Val_Wu16 79. DFES_EnvTabVerb 0.00 79. FORMAT "%2.0" /end CHARACTERISTIC
/begin CHARACTERISTIC DFES_EnvRef.DFC_MeUnSRCMin_C "DFES/Zuordnung Umweltdatenset für Prüfung DFC_MeUnSRCMin" VALUE 0x80029FF2 Val_Wu16 79. DFES_EnvTabVerb 0.00 79. FORMAT "%2.0" /end CHARACTERISTIC
/begin CHARACTERISTIC DFES_EnvRef.DFC_PCVOL_C "DFES/Zuordnung Umweltdatenset für Prüfung DFC_PCVOL" VALUE 0x80029FF4 Val_Wu16 79. DFES_EnvTabVerb 0.00 79. FORMAT "%2.0" /end CHARACTERISTIC
/begin CHARACTERISTIC DFES_EnvRef.DFC_PCVSCB_C "DFES/Zuordnung Umweltdatenset für Prüfung DFC_PCVSCB" VALUE 0x80029FF6 Val_Wu16 79. DFES_EnvTabVerb 0.00 79. FORMAT "%2.0" /end CHARACTERISTIC
/begin CHARACTERISTIC DFES_EnvRef.DFC_PCVSRCMax_C "DFES/Zuordnung Umweltdatenset für Prüfung DFC_PCVSRCMax" VALUE 0x80029FF8 Val_Wu16 79. DFES_EnvTabVerb 0.00 79. FORMAT "%2.0" /end CHARACTERISTIC
/begin CHARACTERISTIC DFES_EnvRef.DFC_PCVSRCMin_C "DFES/Zuordnung Umweltdatenset für Prüfung DFC_PCVSRCMin" VALUE 0x80029FFA Val_Wu16 79. DFES_EnvTabVerb 0.00 79. FORMAT "%2.0" /end CHARACTERISTIC
/begin CHARACTERISTIC DFES_EnvRef.DFC_RailPSRCMax_C "DFES/Zuordnung Umweltdatenset für Prüfung DFC_RailPSRCMax" VALUE 0x80029FFC Val_Wu16 79. DFES_EnvTabVerb 0.00 79. FORMAT "%2.0" /end CHARACTERISTIC
/begin CHARACTERISTIC DFES_EnvRef.DFC_RailPSRCMin_C "DFES/Zuordnung Umweltdatenset für Prüfung DFC_RailPSRCMin" VALUE 0x80029FFE Val_Wu16 79. DFES_EnvTabVerb 0.00 79. FORMAT "%2.0" /end CHARACTERISTIC
/begin CHARACTERISTIC DFES_EnvRef.DFC_ShtrOL_C "DFES/Zuordnung Umweltdatenset für Prüfung DFC_ShtrOL" VALUE 0x8002A000 Val_Wu16 79. DFES_EnvTabVerb 0.00 79. FORMAT "%2.0" /end CHARACTERISTIC
/begin CHARACTERISTIC DFES_EnvRef.DFC_ShtrOvrTemp_C "DFES/Zuordnung Umweltdatenset für Prüfung DFC_ShtrOvrTemp" VALUE 0x8002A002 Val_Wu16 79. DFES_EnvTabVerb 0.00 79. FORMAT "%2.0" /end CHARACTERISTIC
/begin CHARACTERISTIC DFES_EnvRef.DFC_ShtrSCB_C "DFES/Zuordnung Umweltdatenset für Prüfung DFC_ShtrSCB" VALUE 0x8002A004 Val_Wu16 79. DFES_EnvTabVerb 0.00 79. FORMAT "%2.0" /end CHARACTERISTIC
/begin CHARACTERISTIC DFES_EnvRef.DFC_ShtrSCG_C "DFES/Zuordnung Umweltdatenset für Prüfung DFC_ShtrSCG" VALUE 0x8002A006 Val_Wu16 79. DFES_EnvTabVerb 0.00 79. FORMAT "%2.0" /end CHARACTERISTIC
/begin CHARACTERISTIC DFES_EnvRef.DFC_StrtOL_C "DFES/Zuordnung Umweltdatenset für Prüfung DFC_StrtOL" VALUE 0x8002A008 Val_Wu16 79. DFES_EnvTabVerb 0.00 79. FORMAT "%2.0" /end CHARACTERISTIC
/begin CHARACTERISTIC DFES_EnvRef.DFC_StrtOvrTemp_C "DFES/Zuordnung Umweltdatenset für Prüfung DFC_StrtOvrTemp" VALUE 0x8002A00A Val_Wu16 79. DFES_EnvTabVerb 0.00 79. FORMAT "%2.0" /end CHARACTERISTIC
/begin CHARACTERISTIC DFES_EnvRef.DFC_StrtSCB_C "DFES/Zuordnung Umweltdatenset für Prüfung DFC_StrtSCB" VALUE 0x8002A00C Val_Wu16 79. DFES_EnvTabVerb 0.00 79. FORMAT "%2.0" /end CHARACTERISTIC
/begin CHARACTERISTIC DFES_EnvRef.DFC_StrtSCG_C "DFES/Zuordnung Umweltdatenset für Prüfung DFC_StrtSCG" VALUE 0x8002A00E Val_Wu16 79. DFES_EnvTabVerb 0.00 79. FORMAT "%2.0" /end CHARACTERISTIC
/begin CHARACTERISTIC DFES_EnvRef.DFC_ThrVlvOL_C "DFES/Zuordnung Umweltdatenset für Prüfung DFC_ThrVlvOL" VALUE 0x8002A010 Val_Wu16 79. DFES_EnvTabVerb 0.00 79. FORMAT "%2.0" /end CHARACTERISTIC
/begin CHARACTERISTIC DFES_EnvRef.DFC_ThrVlvOvrTemp_C "DFES/Zuordnung Umweltdatenset für Prüfung DFC_ThrVlvOvrTemp" VALUE 0x8002A012 Val_Wu16 79. DFES_EnvTabVerb 0.00 79. FORMAT "%2.0" /end CHARACTERISTIC
/begin CHARACTERISTIC DFES_EnvRef.DFC_ThrVlvSCB_C "DFES/Zuordnung Umweltdatenset für Prüfung DFC_ThrVlvSCB" VALUE 0x8002A014 Val_Wu16 79. DFES_EnvTabVerb 0.00 79. FORMAT "%2.0" /end CHARACTERISTIC
/begin CHARACTERISTIC DFES_EnvRef.DFC_TrbChOL_C "DFES/Zuordnung Umweltdatenset für Prüfung DFC_TrbChOL" VALUE 0x8002A016 Val_Wu16 79. DFES_EnvTabVerb 0.00 79. FORMAT "%2.0" /end CHARACTERISTIC
/begin CHARACTERISTIC DFES_EnvRef.DFC_TrbChOvrTemp_C "DFES/Zuordnung Umweltdatenset für Prüfung DFC_TrbChOvrTemp" VALUE 0x8002A018 Val_Wu16 79. DFES_EnvTabVerb 0.00 79. FORMAT "%2.0" /end CHARACTERISTIC
/begin CHARACTERISTIC DFES_EnvRef.DFC_TrbChSCB_C "DFES/Zuordnung Umweltdatenset für Prüfung DFC_TrbChSCB" VALUE 0x8002A01A Val_Wu16 79. DFES_EnvTabVerb 0.00 79. FORMAT "%2.0" /end CHARACTERISTIC
/begin CHARACTERISTIC DFES_EnvRef.DFC_UDosVlvOL_C "DFES/Zuordnung Umweltdatenset für Prüfung DFC_UDosVlvOL" VALUE 0x8002A01C Val_Wu16 79. DFES_EnvTabVerb 0.00 79. FORMAT "%2.0" /end CHARACTERISTIC
/begin CHARACTERISTIC DFES_EnvRef.DFC_UDosVlvOvrTemp_C "DFES/Zuordnung Umweltdatenset für Prüfung DFC_UDosVlvOvrTemp" VALUE 0x8002A01E Val_Wu16 79. DFES_EnvTabVerb 0.00 79. FORMAT "%2.0" /end CHARACTERISTIC
/begin CHARACTERISTIC DFES_EnvRef.DFC_UDosVlvSCB_C "DFES/Zuordnung Umweltdatenset für Prüfung DFC_UDosVlvSCB" VALUE 0x8002A020 Val_Wu16 79. DFES_EnvTabVerb 0.00 79. FORMAT "%2.0" /end CHARACTERISTIC
/begin CHARACTERISTIC DFES_EnvRef.DFC_UDosVlvSCG_C "DFES/Zuordnung Umweltdatenset für Prüfung DFC_UDosVlvSCG" VALUE 0x8002A022 Val_Wu16 79. DFES_EnvTabVerb 0.00 79. FORMAT "%2.0" /end CHARACTERISTIC
/begin CHARACTERISTIC DFES_EnvRef.DFC_UPmpMotOL_C "DFES/Zuordnung Umweltdatenset für Prüfung DFC_UPmpMotOL" VALUE 0x8002A024 Val_Wu16 79. DFES_EnvTabVerb 0.00 79. FORMAT "%2.0" /end CHARACTERISTIC
/begin CHARACTERISTIC DFES_EnvRef.DFC_UPmpMotOvrTemp_C "DFES/Zuordnung Umweltdatenset für Prüfung DFC_UPmpMotOvrTemp" VALUE 0x8002A026 Val_Wu16 79. DFES_EnvTabVerb 0.00 79. FORMAT "%2.0" /end CHARACTERISTIC
/begin CHARACTERISTIC DFES_EnvRef.DFC_UPmpMotSCB_C "DFES/Zuordnung Umweltdatenset für Prüfung DFC_UPmpMotSCB" VALUE 0x8002A028 Val_Wu16 79. DFES_EnvTabVerb 0.00 79. FORMAT "%2.0" /end CHARACTERISTIC
/begin CHARACTERISTIC DFES_EnvRef.DFC_UPmpMotSCG_C "DFES/Zuordnung Umweltdatenset für Prüfung DFC_UPmpMotSCG" VALUE 0x8002A02A Val_Wu16 79. DFES_EnvTabVerb 0.00 79. FORMAT "%2.0" /end CHARACTERISTIC
/begin CHARACTERISTIC DFES_EnvRef.DFC_WaHtElOL_C "DFES/Zuordnung Umweltdatenset für Prüfung DFC_WaHtElOL" VALUE 0x8002A02C Val_Wu16 79. DFES_EnvTabVerb 0.00 79. FORMAT "%2.0" /end CHARACTERISTIC
/begin CHARACTERISTIC DFES_EnvRef.DFC_WaHtElOvrTemp_C "DFES/Zuordnung Umweltdatenset für Prüfung DFC_WaHtElOvrTemp" VALUE 0x8002A02E Val_Wu16 79. DFES_EnvTabVerb 0.00 79. FORMAT "%2.0" /end CHARACTERISTIC
/begin CHARACTERISTIC DFES_EnvRef.DFC_WaHtElSCB_C "DFES/Zuordnung Umweltdatenset für Prüfung DFC_WaHtElSCB" VALUE 0x8002A030 Val_Wu16 79. DFES_EnvTabVerb 0.00 79. FORMAT "%2.0" /end CHARACTERISTIC
/begin CHARACTERISTIC DFES_EnvRef.DFC_IVActrUChSRCMax_C "DFES/Zuordnung Umweltdatenset für Prüfung DFC_IVActrUChSRCMax" VALUE 0x8002A032 Val_Wu16 79. DFES_EnvTabVerb 0.00 79. FORMAT "%2.0" /end CHARACTERISTIC
/begin CHARACTERISTIC DFES_EnvRef.DFC_IVActrUChSRCMin_C "DFES/Zuordnung Umweltdatenset für Prüfung DFC_IVActrUChSRCMin" VALUE 0x8002A034 Val_Wu16 79. DFES_EnvTabVerb 0.00 79. FORMAT "%2.0" /end CHARACTERISTIC
/begin CHARACTERISTIC DFES_EnvRef.DFC_IVActrVltgSRCMax_C "DFES/Zuordnung Umweltdatenset für Prüfung DFC_IVActrVltgSRCMax" VALUE 0x8002A036 Val_Wu16 79. DFES_EnvTabVerb 0.00 79. FORMAT "%2.0" /end CHARACTERISTIC
/begin CHARACTERISTIC DFES_EnvRef.DFC_IVActrVltgSRCMin_C "DFES/Zuordnung Umweltdatenset für Prüfung DFC_IVActrVltgSRCMin" VALUE 0x8002A038 Val_Wu16 79. DFES_EnvTabVerb 0.00 79. FORMAT "%2.0" /end CHARACTERISTIC
/begin CHARACTERISTIC DFES_EnvRef.DFC_IVDiaTunDet_C "DFES/Zuordnung Umweltdatenset für Prüfung DFC_IVDiaTunDet" VALUE 0x8002A03A Val_Wu16 79. DFES_EnvTabVerb 0.00 79. FORMAT "%2.0" /end CHARACTERISTIC
/begin CHARACTERISTIC DFES_EnvRef.DFC_IVPSplyStopDCDC_C "DFES/Zuordnung Umweltdatenset für Prüfung DFC_IVPSplyStopDCDC" VALUE 0x8002A03C Val_Wu16 79. DFES_EnvTabVerb 0.00 79. FORMAT "%2.0" /end CHARACTERISTIC
/begin CHARACTERISTIC DFES_EnvRef.DFC_IVPSplyVltgSRCMax_C "DFES/Zuordnung Umweltdatenset für Prüfung DFC_IVPSplyVltgSRCMax" VALUE 0x8002A03E Val_Wu16 79. DFES_EnvTabVerb 0.00 79. FORMAT "%2.0" /end CHARACTERISTIC
/begin CHARACTERISTIC DFES_EnvRef.DFC_IVPSplyVltgSRCMin_C "DFES/Zuordnung Umweltdatenset für Prüfung DFC_IVPSplyVltgSRCMin" VALUE 0x8002A040 Val_Wu16 79. DFES_EnvTabVerb 0.00 79. FORMAT "%2.0" /end CHARACTERISTIC
/begin CHARACTERISTIC DFES_EnvRef.DFC_SCREtaErr_C "DFES/Zuordnung Umweltdatenset für Prüfung DFC_SCREtaErr" VALUE 0x8002A042 Val_Wu16 79. DFES_EnvTabVerb 0.00 79. FORMAT "%2.0" /end CHARACTERISTIC
/begin CHARACTERISTIC DFES_EnvRef.DFC_SCREtaErr1_C "DFES/Zuordnung Umweltdatenset für Prüfung DFC_SCREtaErr1" VALUE 0x8002A044 Val_Wu16 79. DFES_EnvTabVerb 0.00 79. FORMAT "%2.0" /end CHARACTERISTIC
/begin CHARACTERISTIC DFES_EnvRef.DFC_SCREtaErr2_C "DFES/Zuordnung Umweltdatenset für Prüfung DFC_SCREtaErr2" VALUE 0x8002A046 Val_Wu16 79. DFES_EnvTabVerb 0.00 79. FORMAT "%2.0" /end CHARACTERISTIC
/begin CHARACTERISTIC DFES_EnvRef.DFC_SCRMonMetCtlPresErr_C "DFES/Zuordnung Umweltdatenset für Prüfung DFC_SCRMonMetCtlPresErr" VALUE 0x8002A048 Val_Wu16 79. DFES_EnvTabVerb 0.00 79. FORMAT "%2.0" /end CHARACTERISTIC
/begin CHARACTERISTIC DFES_EnvRef.DFC_SCRMonPresBuildUpErr_C "DFES/Zuordnung Umweltdatenset für Prüfung DFC_SCRMonPresBuildUpErr" VALUE 0x8002A04A Val_Wu16 79. DFES_EnvTabVerb 0.00 79. FORMAT "%2.0" /end CHARACTERISTIC
/begin CHARACTERISTIC DFES_EnvRef.DFC_SCRMonPresRdcErr_C "DFES/Zuordnung Umweltdatenset für Prüfung DFC_SCRMonPresRdcErr" VALUE 0x8002A04C Val_Wu16 79. DFES_EnvTabVerb 0.00 79. FORMAT "%2.0" /end CHARACTERISTIC
/begin CHARACTERISTIC DFES_EnvRef.DFC_AFSOffsDrftMax_C "DFES/Zuordnung Umweltdatenset für Prüfung DFC_AFSOffsDrftMax" VALUE 0x8002A04E Val_Wu16 79. DFES_EnvTabVerb 0.00 79. FORMAT "%2.0" /end CHARACTERISTIC
/begin CHARACTERISTIC DFES_EnvRef.DFC_AFSOffsDrftMin_C "DFES/Zuordnung Umweltdatenset für Prüfung DFC_AFSOffsDrftMin" VALUE 0x8002A050 Val_Wu16 79. DFES_EnvTabVerb 0.00 79. FORMAT "%2.0" /end CHARACTERISTIC
/begin CHARACTERISTIC DFES_EnvRef.DFC_AFSSRCCorMax_C "DFES/Zuordnung Umweltdatenset für Prüfung DFC_AFSSRCCorMax" VALUE 0x8002A052 Val_Wu16 79. DFES_EnvTabVerb 0.00 79. FORMAT "%2.0" /end CHARACTERISTIC
/begin CHARACTERISTIC DFES_EnvRef.DFC_AFSSRCCorMin_C "DFES/Zuordnung Umweltdatenset für Prüfung DFC_AFSSRCCorMin" VALUE 0x8002A054 Val_Wu16 79. DFES_EnvTabVerb 0.00 79. FORMAT "%2.0" /end CHARACTERISTIC
/begin CHARACTERISTIC DFES_EnvRef.DFC_AFSSRCRawMax_C "DFES/Zuordnung Umweltdatenset für Prüfung DFC_AFSSRCRawMax" VALUE 0x8002A056 Val_Wu16 79. DFES_EnvTabVerb 0.00 79. FORMAT "%2.0" /end CHARACTERISTIC
/begin CHARACTERISTIC DFES_EnvRef.DFC_AFSSRCRawMin_C "DFES/Zuordnung Umweltdatenset für Prüfung DFC_AFSSRCRawMin" VALUE 0x8002A058 Val_Wu16 79. DFES_EnvTabVerb 0.00 79. FORMAT "%2.0" /end CHARACTERISTIC
/begin CHARACTERISTIC DFES_EnvRef.DFC_AFSSetyDrftMax_C "DFES/Zuordnung Umweltdatenset für Prüfung DFC_AFSSetyDrftMax" VALUE 0x8002A05A Val_Wu16 79. DFES_EnvTabVerb 0.00 79. FORMAT "%2.0" /end CHARACTERISTIC
/begin CHARACTERISTIC DFES_EnvRef.DFC_AFSSetyDrftMin_C "DFES/Zuordnung Umweltdatenset für Prüfung DFC_AFSSetyDrftMin" VALUE 0x8002A05C Val_Wu16 79. DFES_EnvTabVerb 0.00 79. FORMAT "%2.0" /end CHARACTERISTIC
/begin CHARACTERISTIC DFES_EnvRef.DFC_AirCSwtNpl_C "DFES/Zuordnung Umweltdatenset für Prüfung DFC_AirCSwtNpl" VALUE 0x8002A05E Val_Wu16 79. DFES_EnvTabVerb 0.00 79. FORMAT "%2.0" /end CHARACTERISTIC
/begin CHARACTERISTIC DFES_EnvRef.DFC_AirCSwtSig_C "DFES/Zuordnung Umweltdatenset für Prüfung DFC_AirCSwtSig" VALUE 0x8002A060 Val_Wu16 79. DFES_EnvTabVerb 0.00 79. FORMAT "%2.0" /end CHARACTERISTIC
/begin CHARACTERISTIC DFES_EnvRef.DFC_BattUSRCMax_C "DFES/Zuordnung Umweltdatenset für Prüfung DFC_BattUSRCMax" VALUE 0x8002A062 Val_Wu16 79. DFES_EnvTabVerb 0.00 79. FORMAT "%2.0" /end CHARACTERISTIC
/begin CHARACTERISTIC DFES_EnvRef.DFC_BattUSRCMin_C "DFES/Zuordnung Umweltdatenset für Prüfung DFC_BattUSRCMin" VALUE 0x8002A064 Val_Wu16 79. DFES_EnvTabVerb 0.00 79. FORMAT "%2.0" /end CHARACTERISTIC
/begin CHARACTERISTIC DFES_EnvRef.DFC_BrkNpl_C "DFES/Zuordnung Umweltdatenset für Prüfung DFC_BrkNpl" VALUE 0x8002A066 Val_Wu16 79. DFES_EnvTabVerb 0.00 79. FORMAT "%2.0" /end CHARACTERISTIC
/begin CHARACTERISTIC DFES_EnvRef.DFC_BrkPSRCMax_C "DFES/Zuordnung Umweltdatenset für Prüfung DFC_BrkPSRCMax" VALUE 0x8002A068 Val_Wu16 79. DFES_EnvTabVerb 0.00 79. FORMAT "%2.0" /end CHARACTERISTIC
/begin CHARACTERISTIC DFES_EnvRef.DFC_BrkPSRCMin_C "DFES/Zuordnung Umweltdatenset für Prüfung DFC_BrkPSRCMin" VALUE 0x8002A06A Val_Wu16 79. DFES_EnvTabVerb 0.00 79. FORMAT "%2.0" /end CHARACTERISTIC
/begin CHARACTERISTIC DFES_EnvRef.DFC_CEngDsTSRCMax_C "DFES/Zuordnung Umweltdatenset für Prüfung DFC_CEngDsTSRCMax" VALUE 0x8002A06C Val_Wu16 79. DFES_EnvTabVerb 0.00 79. FORMAT "%2.0" /end CHARACTERISTIC
/begin CHARACTERISTIC DFES_EnvRef.DFC_CEngDsTSRCMin_C "DFES/Zuordnung Umweltdatenset für Prüfung DFC_CEngDsTSRCMin" VALUE 0x8002A06E Val_Wu16 79. DFES_EnvTabVerb 0.00 79. FORMAT "%2.0" /end CHARACTERISTIC
/begin CHARACTERISTIC DFES_EnvRef.DFC_CrCUIDet_C "DFES/Zuordnung Umweltdatenset für Prüfung DFC_CrCUIDet" VALUE 0x8002A070 Val_Wu16 79. DFES_EnvTabVerb 0.00 79. FORMAT "%2.0" /end CHARACTERISTIC
/begin CHARACTERISTIC DFES_EnvRef.DFC_ECBVlvSRCMax_C "DFES/Zuordnung Umweltdatenset für Prüfung DFC_ECBVlvSRCMax" VALUE 0x8002A072 Val_Wu16 79. DFES_EnvTabVerb 0.00 79. FORMAT "%2.0" /end CHARACTERISTIC
/begin CHARACTERISTIC DFES_EnvRef.DFC_ECBVlvSRCMin_C "DFES/Zuordnung Umweltdatenset für Prüfung DFC_ECBVlvSRCMin" VALUE 0x8002A074 Val_Wu16 79. DFES_EnvTabVerb 0.00 79. FORMAT "%2.0" /end CHARACTERISTIC
/begin CHARACTERISTIC DFES_EnvRef.DFC_ECUOvrTemp_C "DFES/Zuordnung Umweltdatenset für Prüfung DFC_ECUOvrTemp" VALUE 0x8002A076 Val_Wu16 79. DFES_EnvTabVerb 0.00 79. FORMAT "%2.0" /end CHARACTERISTIC
/begin CHARACTERISTIC DFES_EnvRef.DFC_EGRVlvGovDvtMax_C "DFES/Zuordnung Umweltdatenset für Prüfung DFC_EGRVlvGovDvtMax" VALUE 0x8002A078 Val_Wu16 79. DFES_EnvTabVerb 0.00 79. FORMAT "%2.0" /end CHARACTERISTIC
/begin CHARACTERISTIC DFES_EnvRef.DFC_EGRVlvGovDvtMin_C "DFES/Zuordnung Umweltdatenset für Prüfung DFC_EGRVlvGovDvtMin" VALUE 0x8002A07A Val_Wu16 79. DFES_EnvTabVerb 0.00 79. FORMAT "%2.0" /end CHARACTERISTIC
/begin CHARACTERISTIC DFES_EnvRef.DFC_EGRVlvHBrgOpnLd_C "DFES/Zuordnung Umweltdatenset für Prüfung DFC_EGRVlvHBrgOpnLd" VALUE 0x8002A07C Val_Wu16 79. DFES_EnvTabVerb 0.00 79. FORMAT "%2.0" /end CHARACTERISTIC
/begin CHARACTERISTIC DFES_EnvRef.DFC_EGRVlvHBrgOvrCurr_C "DFES/Zuordnung Umweltdatenset für Prüfung DFC_EGRVlvHBrgOvrCurr" VALUE 0x8002A07E Val_Wu16 79. DFES_EnvTabVerb 0.00 79. FORMAT "%2.0" /end CHARACTERISTIC
/begin CHARACTERISTIC DFES_EnvRef.DFC_EGRVlvHBrgOvrTemp_C "DFES/Zuordnung Umweltdatenset für Prüfung DFC_EGRVlvHBrgOvrTemp" VALUE 0x8002A080 Val_Wu16 79. DFES_EnvTabVerb 0.00 79. FORMAT "%2.0" /end CHARACTERISTIC
/begin CHARACTERISTIC DFES_EnvRef.DFC_EGRVlvHBrgShCirBatt1_C "DFES/Zuordnung Umweltdatenset für Prüfung DFC_EGRVlvHBrgShCirBatt1" VALUE 0x8002A082 Val_Wu16 79. DFES_EnvTabVerb 0.00 79. FORMAT "%2.0" /end CHARACTERISTIC
/begin CHARACTERISTIC DFES_EnvRef.DFC_EGRVlvHBrgShCirBatt2_C "DFES/Zuordnung Umweltdatenset für Prüfung DFC_EGRVlvHBrgShCirBatt2" VALUE 0x8002A084 Val_Wu16 79. DFES_EnvTabVerb 0.00 79. FORMAT "%2.0" /end CHARACTERISTIC
/begin CHARACTERISTIC DFES_EnvRef.DFC_EGRVlvHBrgShCirGnd1_C "DFES/Zuordnung Umweltdatenset für Prüfung DFC_EGRVlvHBrgShCirGnd1" VALUE 0x8002A086 Val_Wu16 79. DFES_EnvTabVerb 0.00 79. FORMAT "%2.0" /end CHARACTERISTIC
/begin CHARACTERISTIC DFES_EnvRef.DFC_EGRVlvHBrgShCirGnd2_C "DFES/Zuordnung Umweltdatenset für Prüfung DFC_EGRVlvHBrgShCirGnd2" VALUE 0x8002A088 Val_Wu16 79. DFES_EnvTabVerb 0.00 79. FORMAT "%2.0" /end CHARACTERISTIC
/begin CHARACTERISTIC DFES_EnvRef.DFC_EGRVlvHBrgShCirOvrLd_C "DFES/Zuordnung Umweltdatenset für Prüfung DFC_EGRVlvHBrgShCirOvrLd" VALUE 0x8002A08A Val_Wu16 79. DFES_EnvTabVerb 0.00 79. FORMAT "%2.0" /end CHARACTERISTIC
/begin CHARACTERISTIC DFES_EnvRef.DFC_EGRVlvHBrgTempOvrCurr_C "DFES/Zuordnung Umweltdatenset für Prüfung DFC_EGRVlvHBrgTempOvrCurr" VALUE 0x8002A08C Val_Wu16 79. DFES_EnvTabVerb 0.00 79. FORMAT "%2.0" /end CHARACTERISTIC
/begin CHARACTERISTIC DFES_EnvRef.DFC_EGRVlvHBrgUndrVltg_C "DFES/Zuordnung Umweltdatenset für Prüfung DFC_EGRVlvHBrgUndrVltg" VALUE 0x8002A08E Val_Wu16 79. DFES_EnvTabVerb 0.00 79. FORMAT "%2.0" /end CHARACTERISTIC
/begin CHARACTERISTIC DFES_EnvRef.DFC_EGRVlvLPGovDvtMax_C "DFES/Zuordnung Umweltdatenset für Prüfung DFC_EGRVlvLPGovDvtMax" VALUE 0x8002A090 Val_Wu16 79. DFES_EnvTabVerb 0.00 79. FORMAT "%2.0" /end CHARACTERISTIC
/begin CHARACTERISTIC DFES_EnvRef.DFC_EGRVlvLPGovDvtMin_C "DFES/Zuordnung Umweltdatenset für Prüfung DFC_EGRVlvLPGovDvtMin" VALUE 0x8002A092 Val_Wu16 79. DFES_EnvTabVerb 0.00 79. FORMAT "%2.0" /end CHARACTERISTIC
/begin CHARACTERISTIC DFES_EnvRef.DFC_EGRVlvLPHBrgOpnLd_C "DFES/Zuordnung Umweltdatenset für Prüfung DFC_EGRVlvLPHBrgOpnLd" VALUE 0x8002A094 Val_Wu16 79. DFES_EnvTabVerb 0.00 79. FORMAT "%2.0" /end CHARACTERISTIC
/begin CHARACTERISTIC DFES_EnvRef.DFC_EGRVlvLPHBrgOvrCurr_C "DFES/Zuordnung Umweltdatenset für Prüfung DFC_EGRVlvLPHBrgOvrCurr" VALUE 0x8002A096 Val_Wu16 79. DFES_EnvTabVerb 0.00 79. FORMAT "%2.0" /end CHARACTERISTIC
/begin CHARACTERISTIC DFES_EnvRef.DFC_EGRVlvLPHBrgOvrTemp_C "DFES/Zuordnung Umweltdatenset für Prüfung DFC_EGRVlvLPHBrgOvrTemp" VALUE 0x8002A098 Val_Wu16 79. DFES_EnvTabVerb 0.00 79. FORMAT "%2.0" /end CHARACTERISTIC
/begin CHARACTERISTIC DFES_EnvRef.DFC_EGRVlvLPHBrgShCirBatt1_C "DFES/Zuordnung Umweltdatenset für Prüfung DFC_EGRVlvLPHBrgShCirBatt1" VALUE 0x8002A09A Val_Wu16 79. DFES_EnvTabVerb 0.00 79. FORMAT "%2.0" /end CHARACTERISTIC
/begin CHARACTERISTIC DFES_EnvRef.DFC_EGRVlvLPHBrgShCirBatt2_C "DFES/Zuordnung Umweltdatenset für Prüfung DFC_EGRVlvLPHBrgShCirBatt2" VALUE 0x8002A09C Val_Wu16 79. DFES_EnvTabVerb 0.00 79. FORMAT "%2.0" /end CHARACTERISTIC
/begin CHARACTERISTIC DFES_EnvRef.DFC_EGRVlvLPHBrgShCirGnd1_C "DFES/Zuordnung Umweltdatenset für Prüfung DFC_EGRVlvLPHBrgShCirGnd1" VALUE 0x8002A09E Val_Wu16 79. DFES_EnvTabVerb 0.00 79. FORMAT "%2.0" /end CHARACTERISTIC
/begin CHARACTERISTIC DFES_EnvRef.DFC_EGRVlvLPHBrgShCirGnd2_C "DFES/Zuordnung Umweltdatenset für Prüfung DFC_EGRVlvLPHBrgShCirGnd2" VALUE 0x8002A0A0 Val_Wu16 79. DFES_EnvTabVerb 0.00 79. FORMAT "%2.0" /end CHARACTERISTIC
/begin CHARACTERISTIC DFES_EnvRef.DFC_EGRVlvLPHBrgShCirOvrLd_C "DFES/Zuordnung Umweltdatenset für Prüfung DFC_EGRVlvLPHBrgShCirOvrLd" VALUE 0x8002A0A2 Val_Wu16 79. DFES_EnvTabVerb 0.00 79. FORMAT "%2.0" /end CHARACTERISTIC
/begin CHARACTERISTIC DFES_EnvRef.DFC_EGRVlvLPHBrgTempOvrCurr_C "DFES/Zuordnung Umweltdatenset für Prüfung DFC_EGRVlvLPHBrgTempOvrCurr" VALUE 0x8002A0A4 Val_Wu16 79. DFES_EnvTabVerb 0.00 79. FORMAT "%2.0" /end CHARACTERISTIC
/begin CHARACTERISTIC DFES_EnvRef.DFC_EGRVlvLPHBrgUndrVltg_C "DFES/Zuordnung Umweltdatenset für Prüfung DFC_EGRVlvLPHBrgUndrVltg" VALUE 0x8002A0A6 Val_Wu16 79. DFES_EnvTabVerb 0.00 79. FORMAT "%2.0" /end CHARACTERISTIC
/begin CHARACTERISTIC DFES_EnvRef.DFC_EGRVlvLPOL_C "DFES/Zuordnung Umweltdatenset für Prüfung DFC_EGRVlvLPOL" VALUE 0x8002A0A8 Val_Wu16 79. DFES_EnvTabVerb 0.00 79. FORMAT "%2.0" /end CHARACTERISTIC
/begin CHARACTERISTIC DFES_EnvRef.DFC_EGRVlvLPSCB_C "DFES/Zuordnung Umweltdatenset für Prüfung DFC_EGRVlvLPSCB" VALUE 0x8002A0AA Val_Wu16 79. DFES_EnvTabVerb 0.00 79. FORMAT "%2.0" /end CHARACTERISTIC
/begin CHARACTERISTIC DFES_EnvRef.DFC_EGRVlvLPSCG_C "DFES/Zuordnung Umweltdatenset für Prüfung DFC_EGRVlvLPSCG" VALUE 0x8002A0AC Val_Wu16 79. DFES_EnvTabVerb 0.00 79. FORMAT "%2.0" /end CHARACTERISTIC
/begin CHARACTERISTIC DFES_EnvRef.DFC_EGRVlvLPSRCMax_C "DFES/Zuordnung Umweltdatenset für Prüfung DFC_EGRVlvLPSRCMax" VALUE 0x8002A0AE Val_Wu16 79. DFES_EnvTabVerb 0.00 79. FORMAT "%2.0" /end CHARACTERISTIC
/begin CHARACTERISTIC DFES_EnvRef.DFC_EGRVlvLPSRCMin_C "DFES/Zuordnung Umweltdatenset für Prüfung DFC_EGRVlvLPSRCMin" VALUE 0x8002A0B0 Val_Wu16 79. DFES_EnvTabVerb 0.00 79. FORMAT "%2.0" /end CHARACTERISTIC
/begin CHARACTERISTIC DFES_EnvRef.DFC_EGRVlvOL_C "DFES/Zuordnung Umweltdatenset für Prüfung DFC_EGRVlvOL" VALUE 0x8002A0B2 Val_Wu16 79. DFES_EnvTabVerb 0.00 79. FORMAT "%2.0" /end CHARACTERISTIC
/begin CHARACTERISTIC DFES_EnvRef.DFC_EGRVlvSCB_C "DFES/Zuordnung Umweltdatenset für Prüfung DFC_EGRVlvSCB" VALUE 0x8002A0B4 Val_Wu16 79. DFES_EnvTabVerb 0.00 79. FORMAT "%2.0" /end CHARACTERISTIC
/begin CHARACTERISTIC DFES_EnvRef.DFC_EGRVlvSCG_C "DFES/Zuordnung Umweltdatenset für Prüfung DFC_EGRVlvSCG" VALUE 0x8002A0B6 Val_Wu16 79. DFES_EnvTabVerb 0.00 79. FORMAT "%2.0" /end CHARACTERISTIC
/begin CHARACTERISTIC DFES_EnvRef.DFC_EGRVlvSRCMax_C "DFES/Zuordnung Umweltdatenset für Prüfung DFC_EGRVlvSRCMax" VALUE 0x8002A0B8 Val_Wu16 79. DFES_EnvTabVerb 0.00 79. FORMAT "%2.0" /end CHARACTERISTIC
/begin CHARACTERISTIC DFES_EnvRef.DFC_EGRVlvSRCMin_C "DFES/Zuordnung Umweltdatenset für Prüfung DFC_EGRVlvSRCMin" VALUE 0x8002A0BA Val_Wu16 79. DFES_EnvTabVerb 0.00 79. FORMAT "%2.0" /end CHARACTERISTIC
/begin CHARACTERISTIC DFES_EnvRef.DFC_EngPrtOvrSpd_C "DFES/Zuordnung Umweltdatenset für Prüfung DFC_EngPrtOvrSpd" VALUE 0x8002A0BC Val_Wu16 79. DFES_EnvTabVerb 0.00 79. FORMAT "%2.0" /end CHARACTERISTIC
/begin CHARACTERISTIC DFES_EnvRef.DFC_EngSpdOL_C "DFES/Zuordnung Umweltdatenset für Prüfung DFC_EngSpdOL" VALUE 0x8002A0BE Val_Wu16 79. DFES_EnvTabVerb 0.00 79. FORMAT "%2.0" /end CHARACTERISTIC
/begin CHARACTERISTIC DFES_EnvRef.DFC_EngSpdSCB_C "DFES/Zuordnung Umweltdatenset für Prüfung DFC_EngSpdSCB" VALUE 0x8002A0C0 Val_Wu16 79. DFES_EnvTabVerb 0.00 79. FORMAT "%2.0" /end CHARACTERISTIC
/begin CHARACTERISTIC DFES_EnvRef.DFC_EngSpdSCG_C "DFES/Zuordnung Umweltdatenset für Prüfung DFC_EngSpdSCG" VALUE 0x8002A0C2 Val_Wu16 79. DFES_EnvTabVerb 0.00 79. FORMAT "%2.0" /end CHARACTERISTIC
/begin CHARACTERISTIC DFES_EnvRef.DFC_EnhSRCMaxPPFltDiff_C "DFES/Zuordnung Umweltdatenset für Prüfung DFC_EnhSRCMaxPPFltDiff" VALUE 0x8002A0C4 Val_Wu16 79. DFES_EnvTabVerb 0.00 79. FORMAT "%2.0" /end CHARACTERISTIC
/begin CHARACTERISTIC DFES_EnvRef.DFC_EnhSRCMaxT1ExhTMon_C "DFES/Zuordnung Umweltdatenset für Prüfung DFC_EnhSRCMaxT1ExhTMon" VALUE 0x8002A0C6 Val_Wu16 79. DFES_EnvTabVerb 0.00 79. FORMAT "%2.0" /end CHARACTERISTIC
/begin CHARACTERISTIC DFES_EnvRef.DFC_EnhSRCMaxT2ExhTMon_C "DFES/Zuordnung Umweltdatenset für Prüfung DFC_EnhSRCMaxT2ExhTMon" VALUE 0x8002A0C8 Val_Wu16 79. DFES_EnvTabVerb 0.00 79. FORMAT "%2.0" /end CHARACTERISTIC
/begin CHARACTERISTIC DFES_EnvRef.DFC_EnhSRCMaxT3ExhTMon_C "DFES/Zuordnung Umweltdatenset für Prüfung DFC_EnhSRCMaxT3ExhTMon" VALUE 0x8002A0CA Val_Wu16 79. DFES_EnvTabVerb 0.00 79. FORMAT "%2.0" /end CHARACTERISTIC
/begin CHARACTERISTIC DFES_EnvRef.DFC_EnhSRCMinPPFltDiff_C "DFES/Zuordnung Umweltdatenset für Prüfung DFC_EnhSRCMinPPFltDiff" VALUE 0x8002A0CC Val_Wu16 79. DFES_EnvTabVerb 0.00 79. FORMAT "%2.0" /end CHARACTERISTIC
/begin CHARACTERISTIC DFES_EnvRef.DFC_EnhSRCMinT1ExhTMon_C "DFES/Zuordnung Umweltdatenset für Prüfung DFC_EnhSRCMinT1ExhTMon" VALUE 0x8002A0CE Val_Wu16 79. DFES_EnvTabVerb 0.00 79. FORMAT "%2.0" /end CHARACTERISTIC
/begin CHARACTERISTIC DFES_EnvRef.DFC_EnhSRCMinT2ExhTMon_C "DFES/Zuordnung Umweltdatenset für Prüfung DFC_EnhSRCMinT2ExhTMon" VALUE 0x8002A0D0 Val_Wu16 79. DFES_EnvTabVerb 0.00 79. FORMAT "%2.0" /end CHARACTERISTIC
/begin CHARACTERISTIC DFES_EnvRef.DFC_EnhSRCMinT3ExhTMon_C "DFES/Zuordnung Umweltdatenset für Prüfung DFC_EnhSRCMinT3ExhTMon" VALUE 0x8002A0D2 Val_Wu16 79. DFES_EnvTabVerb 0.00 79. FORMAT "%2.0" /end CHARACTERISTIC
/begin CHARACTERISTIC DFES_EnvRef.DFC_EnvPSRCMax_C "DFES/Zuordnung Umweltdatenset für Prüfung DFC_EnvPSRCMax" VALUE 0x8002A0D4 Val_Wu16 79. DFES_EnvTabVerb 0.00 79. FORMAT "%2.0" /end CHARACTERISTIC
/begin CHARACTERISTIC DFES_EnvRef.DFC_EnvPSRCMin_C "DFES/Zuordnung Umweltdatenset für Prüfung DFC_EnvPSRCMin" VALUE 0x8002A0D6 Val_Wu16 79. DFES_EnvTabVerb 0.00 79. FORMAT "%2.0" /end CHARACTERISTIC
/begin CHARACTERISTIC DFES_EnvRef.DFC_ExhTMonPlaus_C "DFES/Zuordnung Umweltdatenset für Prüfung DFC_ExhTMonPlaus" VALUE 0x8002A0D8 Val_Wu16 79. DFES_EnvTabVerb 0.00 79. FORMAT "%2.0" /end CHARACTERISTIC
/begin CHARACTERISTIC DFES_EnvRef.DFC_ExhTMonPlausPos1_C "DFES/Zuordnung Umweltdatenset für Prüfung DFC_ExhTMonPlausPos1" VALUE 0x8002A0DA Val_Wu16 79. DFES_EnvTabVerb 0.00 79. FORMAT "%2.0" /end CHARACTERISTIC
/begin CHARACTERISTIC DFES_EnvRef.DFC_ExhTMonPlausPos2_C "DFES/Zuordnung Umweltdatenset für Prüfung DFC_ExhTMonPlausPos2" VALUE 0x8002A0DC Val_Wu16 79. DFES_EnvTabVerb 0.00 79. FORMAT "%2.0" /end CHARACTERISTIC
/begin CHARACTERISTIC DFES_EnvRef.DFC_ExhTMonPlausPos3_C "DFES/Zuordnung Umweltdatenset für Prüfung DFC_ExhTMonPlausPos3" VALUE 0x8002A0DE Val_Wu16 79. DFES_EnvTabVerb 0.00 79. FORMAT "%2.0" /end CHARACTERISTIC
/begin CHARACTERISTIC DFES_EnvRef.DFC_ExhTMonT1Plaus_C "DFES/Zuordnung Umweltdatenset für Prüfung DFC_ExhTMonT1Plaus" VALUE 0x8002A0E0 Val_Wu16 79. DFES_EnvTabVerb 0.00 79. FORMAT "%2.0" /end CHARACTERISTIC
/begin CHARACTERISTIC DFES_EnvRef.DFC_ExhTMonT2Plaus_C "DFES/Zuordnung Umweltdatenset für Prüfung DFC_ExhTMonT2Plaus" VALUE 0x8002A0E2 Val_Wu16 79. DFES_EnvTabVerb 0.00 79. FORMAT "%2.0" /end CHARACTERISTIC
/begin CHARACTERISTIC DFES_EnvRef.DFC_ExhTMonT3Plaus_C "DFES/Zuordnung Umweltdatenset für Prüfung DFC_ExhTMonT3Plaus" VALUE 0x8002A0E4 Val_Wu16 79. DFES_EnvTabVerb 0.00 79. FORMAT "%2.0" /end CHARACTERISTIC
/begin CHARACTERISTIC DFES_EnvRef.DFC_FlFltDsPSRCMax_C "DFES/Zuordnung Umweltdatenset für Prüfung DFC_FlFltDsPSRCMax" VALUE 0x8002A0E6 Val_Wu16 79. DFES_EnvTabVerb 0.00 79. FORMAT "%2.0" /end CHARACTERISTIC
/begin CHARACTERISTIC DFES_EnvRef.DFC_FlFltDsPSRCMin_C "DFES/Zuordnung Umweltdatenset für Prüfung DFC_FlFltDsPSRCMin" VALUE 0x8002A0E8 Val_Wu16 79. DFES_EnvTabVerb 0.00 79. FORMAT "%2.0" /end CHARACTERISTIC
/begin CHARACTERISTIC DFES_EnvRef.DFC_FlFltSig_C "DFES/Zuordnung Umweltdatenset für Prüfung DFC_FlFltSig" VALUE 0x8002A0EA Val_Wu16 79. DFES_EnvTabVerb 0.00 79. FORMAT "%2.0" /end CHARACTERISTIC
/begin CHARACTERISTIC DFES_EnvRef.DFC_FlFltUsPSRCMax_C "DFES/Zuordnung Umweltdatenset für Prüfung DFC_FlFltUsPSRCMax" VALUE 0x8002A0EC Val_Wu16 79. DFES_EnvTabVerb 0.00 79. FORMAT "%2.0" /end CHARACTERISTIC
/begin CHARACTERISTIC DFES_EnvRef.DFC_FlFltUsPSRCMin_C "DFES/Zuordnung Umweltdatenset für Prüfung DFC_FlFltUsPSRCMin" VALUE 0x8002A0EE Val_Wu16 79. DFES_EnvTabVerb 0.00 79. FORMAT "%2.0" /end CHARACTERISTIC
/begin CHARACTERISTIC DFES_EnvRef.DFC_FuelTSRCMax_C "DFES/Zuordnung Umweltdatenset für Prüfung DFC_FuelTSRCMax" VALUE 0x8002A0F0 Val_Wu16 79. DFES_EnvTabVerb 0.00 79. FORMAT "%2.0" /end CHARACTERISTIC
/begin CHARACTERISTIC DFES_EnvRef.DFC_FuelTSRCMin_C "DFES/Zuordnung Umweltdatenset für Prüfung DFC_FuelTSRCMin" VALUE 0x8002A0F2 Val_Wu16 79. DFES_EnvTabVerb 0.00 79. FORMAT "%2.0" /end CHARACTERISTIC
/begin CHARACTERISTIC DFES_EnvRef.DFC_GbxNPosPPerSRCMax_C "DFES/Zuordnung Umweltdatenset für Prüfung DFC_GbxNPosPPerSRCMax" VALUE 0x8002A0F4 Val_Wu16 79. DFES_EnvTabVerb 0.00 79. FORMAT "%2.0" /end CHARACTERISTIC
/begin CHARACTERISTIC DFES_EnvRef.DFC_GbxNPosPPerSRCMin_C "DFES/Zuordnung Umweltdatenset für Prüfung DFC_GbxNPosPPerSRCMin" VALUE 0x8002A0F6 Val_Wu16 79. DFES_EnvTabVerb 0.00 79. FORMAT "%2.0" /end CHARACTERISTIC
/begin CHARACTERISTIC DFES_EnvRef.DFC_GbxNPosPdcycSRCMax_C "DFES/Zuordnung Umweltdatenset für Prüfung DFC_GbxNPosPdcycSRCMax" VALUE 0x8002A0F8 Val_Wu16 79. DFES_EnvTabVerb 0.00 79. FORMAT "%2.0" /end CHARACTERISTIC
/begin CHARACTERISTIC DFES_EnvRef.DFC_GbxNPosPdcycSRCMin_C "DFES/Zuordnung Umweltdatenset für Prüfung DFC_GbxNPosPdcycSRCMin" VALUE 0x8002A0FA Val_Wu16 79. DFES_EnvTabVerb 0.00 79. FORMAT "%2.0" /end CHARACTERISTIC
/begin CHARACTERISTIC DFES_EnvRef.DFC_InjVlvPresMin_C "DFES/Zuordnung Umweltdatenset für Prüfung DFC_InjVlvPresMin" VALUE 0x8002A0FC Val_Wu16 79. DFES_EnvTabVerb 0.00 79. FORMAT "%2.0" /end CHARACTERISTIC
/begin CHARACTERISTIC DFES_EnvRef.DFC_LSUCircNernstSig_C "DFES/Zuordnung Umweltdatenset für Prüfung DFC_LSUCircNernstSig" VALUE 0x8002A0FE Val_Wu16 79. DFES_EnvTabVerb 0.00 79. FORMAT "%2.0" /end CHARACTERISTIC
/begin CHARACTERISTIC DFES_EnvRef.DFC_LSUCircPmpCurSig_C "DFES/Zuordnung Umweltdatenset für Prüfung DFC_LSUCircPmpCurSig" VALUE 0x8002A100 Val_Wu16 79. DFES_EnvTabVerb 0.00 79. FORMAT "%2.0" /end CHARACTERISTIC
/begin CHARACTERISTIC DFES_EnvRef.DFC_LSUCircVirtGndSig_C "DFES/Zuordnung Umweltdatenset für Prüfung DFC_LSUCircVirtGndSig" VALUE 0x8002A102 Val_Wu16 79. DFES_EnvTabVerb 0.00 79. FORMAT "%2.0" /end CHARACTERISTIC
/begin CHARACTERISTIC DFES_EnvRef.DFC_LSUO2Max_C "DFES/Zuordnung Umweltdatenset für Prüfung DFC_LSUO2Max" VALUE 0x8002A104 Val_Wu16 79. DFES_EnvTabVerb 0.00 79. FORMAT "%2.0" /end CHARACTERISTIC
/begin CHARACTERISTIC DFES_EnvRef.DFC_LSUO2Min_C "DFES/Zuordnung Umweltdatenset für Prüfung DFC_LSUO2Min" VALUE 0x8002A106 Val_Wu16 79. DFES_EnvTabVerb 0.00 79. FORMAT "%2.0" /end CHARACTERISTIC
/begin CHARACTERISTIC DFES_EnvRef.DFC_LSUSPIBattLowMin_C "DFES/Zuordnung Umweltdatenset für Prüfung DFC_LSUSPIBattLowMin" VALUE 0x8002A108 Val_Wu16 79. DFES_EnvTabVerb 0.00 79. FORMAT "%2.0" /end CHARACTERISTIC
/begin CHARACTERISTIC DFES_EnvRef.DFC_LSUWireSCB_C "DFES/Zuordnung Umweltdatenset für Prüfung DFC_LSUWireSCB" VALUE 0x8002A10A Val_Wu16 79. DFES_EnvTabVerb 0.00 79. FORMAT "%2.0" /end CHARACTERISTIC
/begin CHARACTERISTIC DFES_EnvRef.DFC_LSUWireSCG_C "DFES/Zuordnung Umweltdatenset für Prüfung DFC_LSUWireSCG" VALUE 0x8002A10C Val_Wu16 79. DFES_EnvTabVerb 0.00 79. FORMAT "%2.0" /end CHARACTERISTIC
/begin CHARACTERISTIC DFES_EnvRef.DFC_MeUnSCG_C "DFES/Zuordnung Umweltdatenset für Prüfung DFC_MeUnSCG" VALUE 0x8002A10E Val_Wu16 79. DFES_EnvTabVerb 0.00 79. FORMAT "%2.0" /end CHARACTERISTIC
/begin CHARACTERISTIC DFES_EnvRef.DFC_NSCDsCmpChk_C "DFES/Zuordnung Umweltdatenset für Prüfung DFC_NSCDsCmpChk" VALUE 0x8002A110 Val_Wu16 79. DFES_EnvTabVerb 0.00 79. FORMAT "%2.0" /end CHARACTERISTIC
/begin CHARACTERISTIC DFES_EnvRef.DFC_NSCDsLamBinSRCMax_C "DFES/Zuordnung Umweltdatenset für Prüfung DFC_NSCDsLamBinSRCMax" VALUE 0x8002A112 Val_Wu16 79. DFES_EnvTabVerb 0.00 79. FORMAT "%2.0" /end CHARACTERISTIC
/begin CHARACTERISTIC DFES_EnvRef.DFC_NSCDsLamBinSRCMin_C "DFES/Zuordnung Umweltdatenset für Prüfung DFC_NSCDsLamBinSRCMin" VALUE 0x8002A114 Val_Wu16 79. DFES_EnvTabVerb 0.00 79. FORMAT "%2.0" /end CHARACTERISTIC
/begin CHARACTERISTIC DFES_EnvRef.DFC_NSCDsLamLinSRCMax_C "DFES/Zuordnung Umweltdatenset für Prüfung DFC_NSCDsLamLinSRCMax" VALUE 0x8002A116 Val_Wu16 79. DFES_EnvTabVerb 0.00 79. FORMAT "%2.0" /end CHARACTERISTIC
/begin CHARACTERISTIC DFES_EnvRef.DFC_NSCDsLamLinSRCMin_C "DFES/Zuordnung Umweltdatenset für Prüfung DFC_NSCDsLamLinSRCMin" VALUE 0x8002A118 Val_Wu16 79. DFES_EnvTabVerb 0.00 79. FORMAT "%2.0" /end CHARACTERISTIC
/begin CHARACTERISTIC DFES_EnvRef.DFC_NSCDsLamPlausMax_C "DFES/Zuordnung Umweltdatenset für Prüfung DFC_NSCDsLamPlausMax" VALUE 0x8002A11A Val_Wu16 79. DFES_EnvTabVerb 0.00 79. FORMAT "%2.0" /end CHARACTERISTIC
/begin CHARACTERISTIC DFES_EnvRef.DFC_NSCDsLamPlausMin_C "DFES/Zuordnung Umweltdatenset für Prüfung DFC_NSCDsLamPlausMin" VALUE 0x8002A11C Val_Wu16 79. DFES_EnvTabVerb 0.00 79. FORMAT "%2.0" /end CHARACTERISTIC
/begin CHARACTERISTIC DFES_EnvRef.DFC_NSCDsNOxSRCMax_C "DFES/Zuordnung Umweltdatenset für Prüfung DFC_NSCDsNOxSRCMax" VALUE 0x8002A11E Val_Wu16 79. DFES_EnvTabVerb 0.00 79. FORMAT "%2.0" /end CHARACTERISTIC
/begin CHARACTERISTIC DFES_EnvRef.DFC_NSCDsNOxSRCMin_C "DFES/Zuordnung Umweltdatenset für Prüfung DFC_NSCDsNOxSRCMin" VALUE 0x8002A120 Val_Wu16 79. DFES_EnvTabVerb 0.00 79. FORMAT "%2.0" /end CHARACTERISTIC
/begin CHARACTERISTIC DFES_EnvRef.DFC_NSCDsOpCir_C "DFES/Zuordnung Umweltdatenset für Prüfung DFC_NSCDsOpCir" VALUE 0x8002A122 Val_Wu16 79. DFES_EnvTabVerb 0.00 79. FORMAT "%2.0" /end CHARACTERISTIC
/begin CHARACTERISTIC DFES_EnvRef.DFC_NSCDsShCir_C "DFES/Zuordnung Umweltdatenset für Prüfung DFC_NSCDsShCir" VALUE 0x8002A124 Val_Wu16 79. DFES_EnvTabVerb 0.00 79. FORMAT "%2.0" /end CHARACTERISTIC
/begin CHARACTERISTIC DFES_EnvRef.DFC_NoCat2DsCmpChk_C "DFES/Zuordnung Umweltdatenset für Prüfung DFC_NoCat2DsCmpChk" VALUE 0x8002A126 Val_Wu16 79. DFES_EnvTabVerb 0.00 79. FORMAT "%2.0" /end CHARACTERISTIC
/begin CHARACTERISTIC DFES_EnvRef.DFC_NoCat2DsLamBinSRCMax_C "DFES/Zuordnung Umweltdatenset für Prüfung DFC_NoCat2DsLamBinSRCMax" VALUE 0x8002A128 Val_Wu16 79. DFES_EnvTabVerb 0.00 79. FORMAT "%2.0" /end CHARACTERISTIC
/begin CHARACTERISTIC DFES_EnvRef.DFC_NoCat2DsLamBinSRCMin_C "DFES/Zuordnung Umweltdatenset für Prüfung DFC_NoCat2DsLamBinSRCMin" VALUE 0x8002A12A Val_Wu16 79. DFES_EnvTabVerb 0.00 79. FORMAT "%2.0" /end CHARACTERISTIC
/begin CHARACTERISTIC DFES_EnvRef.DFC_NoCat2DsLamLinSRCMax_C "DFES/Zuordnung Umweltdatenset für Prüfung DFC_NoCat2DsLamLinSRCMax" VALUE 0x8002A12C Val_Wu16 79. DFES_EnvTabVerb 0.00 79. FORMAT "%2.0" /end CHARACTERISTIC
/begin CHARACTERISTIC DFES_EnvRef.DFC_NoCat2DsLamLinSRCMin_C "DFES/Zuordnung Umweltdatenset für Prüfung DFC_NoCat2DsLamLinSRCMin" VALUE 0x8002A12E Val_Wu16 79. DFES_EnvTabVerb 0.00 79. FORMAT "%2.0" /end CHARACTERISTIC
/begin CHARACTERISTIC DFES_EnvRef.DFC_NoCat2DsLamPlausMax_C "DFES/Zuordnung Umweltdatenset für Prüfung DFC_NoCat2DsLamPlausMax" VALUE 0x8002A130 Val_Wu16 79. DFES_EnvTabVerb 0.00 79. FORMAT "%2.0" /end CHARACTERISTIC
/begin CHARACTERISTIC DFES_EnvRef.DFC_NoCat2DsLamPlausMin_C "DFES/Zuordnung Umweltdatenset für Prüfung DFC_NoCat2DsLamPlausMin" VALUE 0x8002A132 Val_Wu16 79. DFES_EnvTabVerb 0.00 79. FORMAT "%2.0" /end CHARACTERISTIC
/begin CHARACTERISTIC DFES_EnvRef.DFC_NoCat2DsNOxSRCMax_C "DFES/Zuordnung Umweltdatenset für Prüfung DFC_NoCat2DsNOxSRCMax" VALUE 0x8002A134 Val_Wu16 79. DFES_EnvTabVerb 0.00 79. FORMAT "%2.0" /end CHARACTERISTIC
/begin CHARACTERISTIC DFES_EnvRef.DFC_NoCat2DsNOxSRCMin_C "DFES/Zuordnung Umweltdatenset für Prüfung DFC_NoCat2DsNOxSRCMin" VALUE 0x8002A136 Val_Wu16 79. DFES_EnvTabVerb 0.00 79. FORMAT "%2.0" /end CHARACTERISTIC
/begin CHARACTERISTIC DFES_EnvRef.DFC_NoCat2DsOpCir_C "DFES/Zuordnung Umweltdatenset für Prüfung DFC_NoCat2DsOpCir" VALUE 0x8002A138 Val_Wu16 79. DFES_EnvTabVerb 0.00 79. FORMAT "%2.0" /end CHARACTERISTIC
/begin CHARACTERISTIC DFES_EnvRef.DFC_NoCat2DsShCir_C "DFES/Zuordnung Umweltdatenset für Prüfung DFC_NoCat2DsShCir" VALUE 0x8002A13A Val_Wu16 79. DFES_EnvTabVerb 0.00 79. FORMAT "%2.0" /end CHARACTERISTIC
/begin CHARACTERISTIC DFES_EnvRef.DFC_NplDynPPFltDiff_C "DFES/Zuordnung Umweltdatenset für Prüfung DFC_NplDynPPFltDiff" VALUE 0x8002A13C Val_Wu16 79. DFES_EnvTabVerb 0.00 79. FORMAT "%2.0" /end CHARACTERISTIC
/begin CHARACTERISTIC DFES_EnvRef.DFC_NplHsChngPPFltDiff_C "DFES/Zuordnung Umweltdatenset für Prüfung DFC_NplHsChngPPFltDiff" VALUE 0x8002A13E Val_Wu16 79. DFES_EnvTabVerb 0.00 79. FORMAT "%2.0" /end CHARACTERISTIC
/begin CHARACTERISTIC DFES_EnvRef.DFC_NplHsLnPPFltDiff_C "DFES/Zuordnung Umweltdatenset für Prüfung DFC_NplHsLnPPFltDiff" VALUE 0x8002A140 Val_Wu16 79. DFES_EnvTabVerb 0.00 79. FORMAT "%2.0" /end CHARACTERISTIC
/begin CHARACTERISTIC DFES_EnvRef.DFC_NplTOxiCatUs_C "DFES/Zuordnung Umweltdatenset für Prüfung DFC_NplTOxiCatUs" VALUE 0x8002A142 Val_Wu16 79. DFES_EnvTabVerb 0.00 79. FORMAT "%2.0" /end CHARACTERISTIC
/begin CHARACTERISTIC DFES_EnvRef.DFC_NplTPFltUs_C "DFES/Zuordnung Umweltdatenset für Prüfung DFC_NplTPFltUs" VALUE 0x8002A144 Val_Wu16 79. DFES_EnvTabVerb 0.00 79. FORMAT "%2.0" /end CHARACTERISTIC
/begin CHARACTERISTIC DFES_EnvRef.DFC_NplTTrbnUs_C "DFES/Zuordnung Umweltdatenset für Prüfung DFC_NplTTrbnUs" VALUE 0x8002A146 Val_Wu16 79. DFES_EnvTabVerb 0.00 79. FORMAT "%2.0" /end CHARACTERISTIC
/begin CHARACTERISTIC DFES_EnvRef.DFC_OilPSwmpSRCMax_C "DFES/Zuordnung Umweltdatenset für Prüfung DFC_OilPSwmpSRCMax" VALUE 0x8002A148 Val_Wu16 79. DFES_EnvTabVerb 0.00 79. FORMAT "%2.0" /end CHARACTERISTIC
/begin CHARACTERISTIC DFES_EnvRef.DFC_OilPSwmpSRCMin_C "DFES/Zuordnung Umweltdatenset für Prüfung DFC_OilPSwmpSRCMin" VALUE 0x8002A14A Val_Wu16 79. DFES_EnvTabVerb 0.00 79. FORMAT "%2.0" /end CHARACTERISTIC
/begin CHARACTERISTIC DFES_EnvRef.DFC_PCVSCG_C "DFES/Zuordnung Umweltdatenset für Prüfung DFC_PCVSCG" VALUE 0x8002A14C Val_Wu16 79. DFES_EnvTabVerb 0.00 79. FORMAT "%2.0" /end CHARACTERISTIC
/begin CHARACTERISTIC DFES_EnvRef.DFC_PFltCharPDiffMin_C "DFES/Zuordnung Umweltdatenset für Prüfung DFC_PFltCharPDiffMin" VALUE 0x8002A14E Val_Wu16 79. DFES_EnvTabVerb 0.00 79. FORMAT "%2.0" /end CHARACTERISTIC
/begin CHARACTERISTIC DFES_EnvRef.DFC_PFltDstrMin_C "DFES/Zuordnung Umweltdatenset für Prüfung DFC_PFltDstrMin" VALUE 0x8002A150 Val_Wu16 79. DFES_EnvTabVerb 0.00 79. FORMAT "%2.0" /end CHARACTERISTIC
/begin CHARACTERISTIC DFES_EnvRef.DFC_PFltEngPrt_C "DFES/Zuordnung Umweltdatenset für Prüfung DFC_PFltEngPrt" VALUE 0x8002A152 Val_Wu16 79. DFES_EnvTabVerb 0.00 79. FORMAT "%2.0" /end CHARACTERISTIC
/begin CHARACTERISTIC DFES_EnvRef.DFC_PFltRgnPerm_C "DFES/Zuordnung Umweltdatenset für Prüfung DFC_PFltRgnPerm" VALUE 0x8002A154 Val_Wu16 79. DFES_EnvTabVerb 0.00 79. FORMAT "%2.0" /end CHARACTERISTIC
/begin CHARACTERISTIC DFES_EnvRef.DFC_PFltSRCMaxFlwRstn_C "DFES/Zuordnung Umweltdatenset für Prüfung DFC_PFltSRCMaxFlwRstn" VALUE 0x8002A156 Val_Wu16 79. DFES_EnvTabVerb 0.00 79. FORMAT "%2.0" /end CHARACTERISTIC
/begin CHARACTERISTIC DFES_EnvRef.DFC_PFltSRCMinFlwRstn_C "DFES/Zuordnung Umweltdatenset für Prüfung DFC_PFltSRCMinFlwRstn" VALUE 0x8002A158 Val_Wu16 79. DFES_EnvTabVerb 0.00 79. FORMAT "%2.0" /end CHARACTERISTIC
/begin CHARACTERISTIC DFES_EnvRef.DFC_PFltSotMsDvtMax_C "DFES/Zuordnung Umweltdatenset für Prüfung DFC_PFltSotMsDvtMax" VALUE 0x8002A15A Val_Wu16 79. DFES_EnvTabVerb 0.00 79. FORMAT "%2.0" /end CHARACTERISTIC
/begin CHARACTERISTIC DFES_EnvRef.DFC_PFltSotMsDvtMin_C "DFES/Zuordnung Umweltdatenset für Prüfung DFC_PFltSotMsDvtMin" VALUE 0x8002A15C Val_Wu16 79. DFES_EnvTabVerb 0.00 79. FORMAT "%2.0" /end CHARACTERISTIC
/begin CHARACTERISTIC DFES_EnvRef.DFC_PFltSotMsMax_C "DFES/Zuordnung Umweltdatenset für Prüfung DFC_PFltSotMsMax" VALUE 0x8002A15E Val_Wu16 79. DFES_EnvTabVerb 0.00 79. FORMAT "%2.0" /end CHARACTERISTIC
/begin CHARACTERISTIC DFES_EnvRef.DFC_PIntkVUsSRCMax_C "DFES/Zuordnung Umweltdatenset für Prüfung DFC_PIntkVUsSRCMax" VALUE 0x8002A160 Val_Wu16 79. DFES_EnvTabVerb 0.00 79. FORMAT "%2.0" /end CHARACTERISTIC
/begin CHARACTERISTIC DFES_EnvRef.DFC_PIntkVUsSRCMin_C "DFES/Zuordnung Umweltdatenset für Prüfung DFC_PIntkVUsSRCMin" VALUE 0x8002A162 Val_Wu16 79. DFES_EnvTabVerb 0.00 79. FORMAT "%2.0" /end CHARACTERISTIC
/begin CHARACTERISTIC DFES_EnvRef.DFC_SRCHighAPP1_C "DFES/Zuordnung Umweltdatenset für Prüfung DFC_SRCHighAPP1" VALUE 0x8002A164 Val_Wu16 79. DFES_EnvTabVerb 0.00 79. FORMAT "%2.0" /end CHARACTERISTIC
/begin CHARACTERISTIC DFES_EnvRef.DFC_SRCHighAPP2_C "DFES/Zuordnung Umweltdatenset für Prüfung DFC_SRCHighAPP2" VALUE 0x8002A166 Val_Wu16 79. DFES_EnvTabVerb 0.00 79. FORMAT "%2.0" /end CHARACTERISTIC
/begin CHARACTERISTIC DFES_EnvRef.DFC_SRCLowAPP1_C "DFES/Zuordnung Umweltdatenset für Prüfung DFC_SRCLowAPP1" VALUE 0x8002A168 Val_Wu16 79. DFES_EnvTabVerb 0.00 79. FORMAT "%2.0" /end CHARACTERISTIC
/begin CHARACTERISTIC DFES_EnvRef.DFC_SRCLowAPP2_C "DFES/Zuordnung Umweltdatenset für Prüfung DFC_SRCLowAPP2" VALUE 0x8002A16A Val_Wu16 79. DFES_EnvTabVerb 0.00 79. FORMAT "%2.0" /end CHARACTERISTIC
/begin CHARACTERISTIC DFES_EnvRef.DFC_SRCMaxPPFltDiff_C "DFES/Zuordnung Umweltdatenset für Prüfung DFC_SRCMaxPPFltDiff" VALUE 0x8002A16C Val_Wu16 79. DFES_EnvTabVerb 0.00 79. FORMAT "%2.0" /end CHARACTERISTIC
/begin CHARACTERISTIC DFES_EnvRef.DFC_SRCMaxPPFltUs_C "DFES/Zuordnung Umweltdatenset für Prüfung DFC_SRCMaxPPFltUs" VALUE 0x8002A16E Val_Wu16 79. DFES_EnvTabVerb 0.00 79. FORMAT "%2.0" /end CHARACTERISTIC
/begin CHARACTERISTIC DFES_EnvRef.DFC_SRCMaxTECU_C "DFES/Zuordnung Umweltdatenset für Prüfung DFC_SRCMaxTECU" VALUE 0x8002A170 Val_Wu16 79. DFES_EnvTabVerb 0.00 79. FORMAT "%2.0" /end CHARACTERISTIC
/begin CHARACTERISTIC DFES_EnvRef.DFC_SRCMaxTOxiCatUs_C "DFES/Zuordnung Umweltdatenset für Prüfung DFC_SRCMaxTOxiCatUs" VALUE 0x8002A172 Val_Wu16 79. DFES_EnvTabVerb 0.00 79. FORMAT "%2.0" /end CHARACTERISTIC
/begin CHARACTERISTIC DFES_EnvRef.DFC_SRCMaxTPFltUs_C "DFES/Zuordnung Umweltdatenset für Prüfung DFC_SRCMaxTPFltUs" VALUE 0x8002A174 Val_Wu16 79. DFES_EnvTabVerb 0.00 79. FORMAT "%2.0" /end CHARACTERISTIC
/begin CHARACTERISTIC DFES_EnvRef.DFC_SRCMaxTTrbnUs_C "DFES/Zuordnung Umweltdatenset für Prüfung DFC_SRCMaxTTrbnUs" VALUE 0x8002A176 Val_Wu16 79. DFES_EnvTabVerb 0.00 79. FORMAT "%2.0" /end CHARACTERISTIC
/begin CHARACTERISTIC DFES_EnvRef.DFC_SRCMaxUCatUsT_C "DFES/Zuordnung Umweltdatenset für Prüfung DFC_SRCMaxUCatUsT" VALUE 0x8002A178 Val_Wu16 79. DFES_EnvTabVerb 0.00 79. FORMAT "%2.0" /end CHARACTERISTIC
/begin CHARACTERISTIC DFES_EnvRef.DFC_SRCMaxUPmpP_C "DFES/Zuordnung Umweltdatenset für Prüfung DFC_SRCMaxUPmpP" VALUE 0x8002A17A Val_Wu16 79. DFES_EnvTabVerb 0.00 79. FORMAT "%2.0" /end CHARACTERISTIC
/begin CHARACTERISTIC DFES_EnvRef.DFC_SRCMinPPFltDiff_C "DFES/Zuordnung Umweltdatenset für Prüfung DFC_SRCMinPPFltDiff" VALUE 0x8002A17C Val_Wu16 79. DFES_EnvTabVerb 0.00 79. FORMAT "%2.0" /end CHARACTERISTIC
/begin CHARACTERISTIC DFES_EnvRef.DFC_SRCMinPPFltUs_C "DFES/Zuordnung Umweltdatenset für Prüfung DFC_SRCMinPPFltUs" VALUE 0x8002A17E Val_Wu16 79. DFES_EnvTabVerb 0.00 79. FORMAT "%2.0" /end CHARACTERISTIC
/begin CHARACTERISTIC DFES_EnvRef.DFC_SRCMinTECU_C "DFES/Zuordnung Umweltdatenset für Prüfung DFC_SRCMinTECU" VALUE 0x8002A180 Val_Wu16 79. DFES_EnvTabVerb 0.00 79. FORMAT "%2.0" /end CHARACTERISTIC
/begin CHARACTERISTIC DFES_EnvRef.DFC_SRCMinTOxiCatUs_C "DFES/Zuordnung Umweltdatenset für Prüfung DFC_SRCMinTOxiCatUs" VALUE 0x8002A182 Val_Wu16 79. DFES_EnvTabVerb 0.00 79. FORMAT "%2.0" /end CHARACTERISTIC
/begin CHARACTERISTIC DFES_EnvRef.DFC_SRCMinTPFltUs_C "DFES/Zuordnung Umweltdatenset für Prüfung DFC_SRCMinTPFltUs" VALUE 0x8002A184 Val_Wu16 79. DFES_EnvTabVerb 0.00 79. FORMAT "%2.0" /end CHARACTERISTIC
/begin CHARACTERISTIC DFES_EnvRef.DFC_SRCMinTTrbnUs_C "DFES/Zuordnung Umweltdatenset für Prüfung DFC_SRCMinTTrbnUs" VALUE 0x8002A186 Val_Wu16 79. DFES_EnvTabVerb 0.00 79. FORMAT "%2.0" /end CHARACTERISTIC
/begin CHARACTERISTIC DFES_EnvRef.DFC_SRCMinUCatUsT_C "DFES/Zuordnung Umweltdatenset für Prüfung DFC_SRCMinUCatUsT" VALUE 0x8002A188 Val_Wu16 79. DFES_EnvTabVerb 0.00 79. FORMAT "%2.0" /end CHARACTERISTIC
/begin CHARACTERISTIC DFES_EnvRef.DFC_SRCMinUPmpP_C "DFES/Zuordnung Umweltdatenset für Prüfung DFC_SRCMinUPmpP" VALUE 0x8002A18A Val_Wu16 79. DFES_EnvTabVerb 0.00 79. FORMAT "%2.0" /end CHARACTERISTIC
/begin CHARACTERISTIC DFES_EnvRef.DFC_SigUCatUsT_C "DFES/Zuordnung Umweltdatenset für Prüfung DFC_SigUCatUsT" VALUE 0x8002A18C Val_Wu16 79. DFES_EnvTabVerb 0.00 79. FORMAT "%2.0" /end CHARACTERISTIC
/begin CHARACTERISTIC DFES_EnvRef.DFC_SigUPmpP_C "DFES/Zuordnung Umweltdatenset für Prüfung DFC_SigUPmpP" VALUE 0x8002A18E Val_Wu16 79. DFES_EnvTabVerb 0.00 79. FORMAT "%2.0" /end CHARACTERISTIC
/begin CHARACTERISTIC DFES_EnvRef.DFC_SyncAPP_C "DFES/Zuordnung Umweltdatenset für Prüfung DFC_SyncAPP" VALUE 0x8002A190 Val_Wu16 79. DFES_EnvTabVerb 0.00 79. FORMAT "%2.0" /end CHARACTERISTIC
/begin CHARACTERISTIC DFES_EnvRef.DFC_T15Npl_C "DFES/Zuordnung Umweltdatenset für Prüfung DFC_T15Npl" VALUE 0x8002A192 Val_Wu16 79. DFES_EnvTabVerb 0.00 79. FORMAT "%2.0" /end CHARACTERISTIC
/begin CHARACTERISTIC DFES_EnvRef.DFC_TAFSDtyCycHi_C "DFES/Zuordnung Umweltdatenset für Prüfung DFC_TAFSDtyCycHi" VALUE 0x8002A194 Val_Wu16 79. DFES_EnvTabVerb 0.00 79. FORMAT "%2.0" /end CHARACTERISTIC
/begin CHARACTERISTIC DFES_EnvRef.DFC_TAFSDtyCycLo_C "DFES/Zuordnung Umweltdatenset für Prüfung DFC_TAFSDtyCycLo" VALUE 0x8002A196 Val_Wu16 79. DFES_EnvTabVerb 0.00 79. FORMAT "%2.0" /end CHARACTERISTIC
/begin CHARACTERISTIC DFES_EnvRef.DFC_TAFSPerHi_C "DFES/Zuordnung Umweltdatenset für Prüfung DFC_TAFSPerHi" VALUE 0x8002A198 Val_Wu16 79. DFES_EnvTabVerb 0.00 79. FORMAT "%2.0" /end CHARACTERISTIC
/begin CHARACTERISTIC DFES_EnvRef.DFC_TAFSPerLo_C "DFES/Zuordnung Umweltdatenset für Prüfung DFC_TAFSPerLo" VALUE 0x8002A19A Val_Wu16 79. DFES_EnvTabVerb 0.00 79. FORMAT "%2.0" /end CHARACTERISTIC
/begin CHARACTERISTIC DFES_EnvRef.DFC_TCACDsSRCMax_C "DFES/Zuordnung Umweltdatenset für Prüfung DFC_TCACDsSRCMax" VALUE 0x8002A19C Val_Wu16 79. DFES_EnvTabVerb 0.00 79. FORMAT "%2.0" /end CHARACTERISTIC
/begin CHARACTERISTIC DFES_EnvRef.DFC_TCACDsSRCMin_C "DFES/Zuordnung Umweltdatenset für Prüfung DFC_TCACDsSRCMin" VALUE 0x8002A19E Val_Wu16 79. DFES_EnvTabVerb 0.00 79. FORMAT "%2.0" /end CHARACTERISTIC
/begin CHARACTERISTIC DFES_EnvRef.DFC_ThrVlvSRCMax_C "DFES/Zuordnung Umweltdatenset für Prüfung DFC_ThrVlvSRCMax" VALUE 0x8002A1A0 Val_Wu16 79. DFES_EnvTabVerb 0.00 79. FORMAT "%2.0" /end CHARACTERISTIC
/begin CHARACTERISTIC DFES_EnvRef.DFC_ThrVlvSRCMin_C "DFES/Zuordnung Umweltdatenset für Prüfung DFC_ThrVlvSRCMin" VALUE 0x8002A1A2 Val_Wu16 79. DFES_EnvTabVerb 0.00 79. FORMAT "%2.0" /end CHARACTERISTIC
/begin CHARACTERISTIC DFES_EnvRef.DFC_TrbChLPOL_C "DFES/Zuordnung Umweltdatenset für Prüfung DFC_TrbChLPOL" VALUE 0x8002A1A4 Val_Wu16 79. DFES_EnvTabVerb 0.00 79. FORMAT "%2.0" /end CHARACTERISTIC
/begin CHARACTERISTIC DFES_EnvRef.DFC_TrbChLPSCB_C "DFES/Zuordnung Umweltdatenset für Prüfung DFC_TrbChLPSCB" VALUE 0x8002A1A6 Val_Wu16 79. DFES_EnvTabVerb 0.00 79. FORMAT "%2.0" /end CHARACTERISTIC
/begin CHARACTERISTIC DFES_EnvRef.DFC_TrbChLPSCG_C "DFES/Zuordnung Umweltdatenset für Prüfung DFC_TrbChLPSCG" VALUE 0x8002A1A8 Val_Wu16 79. DFES_EnvTabVerb 0.00 79. FORMAT "%2.0" /end CHARACTERISTIC
/begin CHARACTERISTIC DFES_EnvRef.DFC_UHtrPLOL_C "DFES/Zuordnung Umweltdatenset für Prüfung DFC_UHtrPLOL" VALUE 0x8002A1AA Val_Wu16 79. DFES_EnvTabVerb 0.00 79. FORMAT "%2.0" /end CHARACTERISTIC
/begin CHARACTERISTIC DFES_EnvRef.DFC_UHtrPLSCB_C "DFES/Zuordnung Umweltdatenset für Prüfung DFC_UHtrPLSCB" VALUE 0x8002A1AC Val_Wu16 79. DFES_EnvTabVerb 0.00 79. FORMAT "%2.0" /end CHARACTERISTIC
/begin CHARACTERISTIC DFES_EnvRef.DFC_UHtrPLSCG_C "DFES/Zuordnung Umweltdatenset für Prüfung DFC_UHtrPLSCG" VALUE 0x8002A1AE Val_Wu16 79. DFES_EnvTabVerb 0.00 79. FORMAT "%2.0" /end CHARACTERISTIC
/begin CHARACTERISTIC DFES_EnvRef.DFC_UHtrPLSRCMaxDia_C "DFES/Zuordnung Umweltdatenset für Prüfung DFC_UHtrPLSRCMaxDia" VALUE 0x8002A1B0 Val_Wu16 79. DFES_EnvTabVerb 0.00 79. FORMAT "%2.0" /end CHARACTERISTIC
/begin CHARACTERISTIC DFES_EnvRef.DFC_UHtrPLSRCMinDia_C "DFES/Zuordnung Umweltdatenset für Prüfung DFC_UHtrPLSRCMinDia" VALUE 0x8002A1B2 Val_Wu16 79. DFES_EnvTabVerb 0.00 79. FORMAT "%2.0" /end CHARACTERISTIC
/begin CHARACTERISTIC DFES_EnvRef.DFC_UHtrTnkOL_C "DFES/Zuordnung Umweltdatenset für Prüfung DFC_UHtrTnkOL" VALUE 0x8002A1B4 Val_Wu16 79. DFES_EnvTabVerb 0.00 79. FORMAT "%2.0" /end CHARACTERISTIC
/begin CHARACTERISTIC DFES_EnvRef.DFC_UHtrTnkSCB_C "DFES/Zuordnung Umweltdatenset für Prüfung DFC_UHtrTnkSCB" VALUE 0x8002A1B6 Val_Wu16 79. DFES_EnvTabVerb 0.00 79. FORMAT "%2.0" /end CHARACTERISTIC
/begin CHARACTERISTIC DFES_EnvRef.DFC_UHtrTnkSCG_C "DFES/Zuordnung Umweltdatenset für Prüfung DFC_UHtrTnkSCG" VALUE 0x8002A1B8 Val_Wu16 79. DFES_EnvTabVerb 0.00 79. FORMAT "%2.0" /end CHARACTERISTIC
/begin CHARACTERISTIC DFES_EnvRef.DFC_UHtrTnkSRCMaxDia_C "DFES/Zuordnung Umweltdatenset für Prüfung DFC_UHtrTnkSRCMaxDia" VALUE 0x8002A1BA Val_Wu16 79. DFES_EnvTabVerb 0.00 79. FORMAT "%2.0" /end CHARACTERISTIC
/begin CHARACTERISTIC DFES_EnvRef.DFC_UHtrTnkSRCMinDia_C "DFES/Zuordnung Umweltdatenset für Prüfung DFC_UHtrTnkSRCMinDia" VALUE 0x8002A1BC Val_Wu16 79. DFES_EnvTabVerb 0.00 79. FORMAT "%2.0" /end CHARACTERISTIC
/begin CHARACTERISTIC DFES_EnvRef.DFC_URevVlvOL_C "DFES/Zuordnung Umweltdatenset für Prüfung DFC_URevVlvOL" VALUE 0x8002A1BE Val_Wu16 79. DFES_EnvTabVerb 0.00 79. FORMAT "%2.0" /end CHARACTERISTIC
/begin CHARACTERISTIC DFES_EnvRef.DFC_URevVlvSCB_C "DFES/Zuordnung Umweltdatenset für Prüfung DFC_URevVlvSCB" VALUE 0x8002A1C0 Val_Wu16 79. DFES_EnvTabVerb 0.00 79. FORMAT "%2.0" /end CHARACTERISTIC
/begin CHARACTERISTIC DFES_EnvRef.DFC_URevVlvSCG_C "DFES/Zuordnung Umweltdatenset für Prüfung DFC_URevVlvSCG" VALUE 0x8002A1C2 Val_Wu16 79. DFES_EnvTabVerb 0.00 79. FORMAT "%2.0" /end CHARACTERISTIC
/begin CHARACTERISTIC DFES_EnvRef.DFC_UTnkTSRCMax_C "DFES/Zuordnung Umweltdatenset für Prüfung DFC_UTnkTSRCMax" VALUE 0x8002A1C4 Val_Wu16 79. DFES_EnvTabVerb 0.00 79. FORMAT "%2.0" /end CHARACTERISTIC
/begin CHARACTERISTIC DFES_EnvRef.DFC_UTnkTSRCMin_C "DFES/Zuordnung Umweltdatenset für Prüfung DFC_UTnkTSRCMin" VALUE 0x8002A1C6 Val_Wu16 79. DFES_EnvTabVerb 0.00 79. FORMAT "%2.0" /end CHARACTERISTIC
/begin CHARACTERISTIC DFES_EnvRef.DFC_UTnkTSig_C "DFES/Zuordnung Umweltdatenset für Prüfung DFC_UTnkTSig" VALUE 0x8002A1C8 Val_Wu16 79. DFES_EnvTabVerb 0.00 79. FORMAT "%2.0" /end CHARACTERISTIC
/begin CHARACTERISTIC DFES_EnvRef.DFC_VSwVlvGovDvtMax_C "DFES/Zuordnung Umweltdatenset für Prüfung DFC_VSwVlvGovDvtMax" VALUE 0x8002A1CA Val_Wu16 79. DFES_EnvTabVerb 0.00 79. FORMAT "%2.0" /end CHARACTERISTIC
/begin CHARACTERISTIC DFES_EnvRef.DFC_VSwVlvGovDvtMin_C "DFES/Zuordnung Umweltdatenset für Prüfung DFC_VSwVlvGovDvtMin" VALUE 0x8002A1CC Val_Wu16 79. DFES_EnvTabVerb 0.00 79. FORMAT "%2.0" /end CHARACTERISTIC
/begin CHARACTERISTIC DFES_EnvRef.DFC_VSwVlvHBrgOpnLd_C "DFES/Zuordnung Umweltdatenset für Prüfung DFC_VSwVlvHBrgOpnLd" VALUE 0x8002A1CE Val_Wu16 79. DFES_EnvTabVerb 0.00 79. FORMAT "%2.0" /end CHARACTERISTIC
/begin CHARACTERISTIC DFES_EnvRef.DFC_VSwVlvHBrgOvrCurr_C "DFES/Zuordnung Umweltdatenset für Prüfung DFC_VSwVlvHBrgOvrCurr" VALUE 0x8002A1D0 Val_Wu16 79. DFES_EnvTabVerb 0.00 79. FORMAT "%2.0" /end CHARACTERISTIC
/begin CHARACTERISTIC DFES_EnvRef.DFC_VSwVlvHBrgOvrTemp_C "DFES/Zuordnung Umweltdatenset für Prüfung DFC_VSwVlvHBrgOvrTemp" VALUE 0x8002A1D2 Val_Wu16 79. DFES_EnvTabVerb 0.00 79. FORMAT "%2.0" /end CHARACTERISTIC
/begin CHARACTERISTIC DFES_EnvRef.DFC_VSwVlvHBrgShCirBatt1_C "DFES/Zuordnung Umweltdatenset für Prüfung DFC_VSwVlvHBrgShCirBatt1" VALUE 0x8002A1D4 Val_Wu16 79. DFES_EnvTabVerb 0.00 79. FORMAT "%2.0" /end CHARACTERISTIC
/begin CHARACTERISTIC DFES_EnvRef.DFC_VSwVlvHBrgShCirBatt2_C "DFES/Zuordnung Umweltdatenset für Prüfung DFC_VSwVlvHBrgShCirBatt2" VALUE 0x8002A1D6 Val_Wu16 79. DFES_EnvTabVerb 0.00 79. FORMAT "%2.0" /end CHARACTERISTIC
/begin CHARACTERISTIC DFES_EnvRef.DFC_VSwVlvHBrgShCirGnd1_C "DFES/Zuordnung Umweltdatenset für Prüfung DFC_VSwVlvHBrgShCirGnd1" VALUE 0x8002A1D8 Val_Wu16 79. DFES_EnvTabVerb 0.00 79. FORMAT "%2.0" /end CHARACTERISTIC
/begin CHARACTERISTIC DFES_EnvRef.DFC_VSwVlvHBrgShCirGnd2_C "DFES/Zuordnung Umweltdatenset für Prüfung DFC_VSwVlvHBrgShCirGnd2" VALUE 0x8002A1DA Val_Wu16 79. DFES_EnvTabVerb 0.00 79. FORMAT "%2.0" /end CHARACTERISTIC
/begin CHARACTERISTIC DFES_EnvRef.DFC_VSwVlvHBrgShCirOvrLd_C "DFES/Zuordnung Umweltdatenset für Prüfung DFC_VSwVlvHBrgShCirOvrLd" VALUE 0x8002A1DC Val_Wu16 79. DFES_EnvTabVerb 0.00 79. FORMAT "%2.0" /end CHARACTERISTIC
/begin CHARACTERISTIC DFES_EnvRef.DFC_VSwVlvHBrgTempOvrCurr_C "DFES/Zuordnung Umweltdatenset für Prüfung DFC_VSwVlvHBrgTempOvrCurr" VALUE 0x8002A1DE Val_Wu16 79. DFES_EnvTabVerb 0.00 79. FORMAT "%2.0" /end CHARACTERISTIC
/begin CHARACTERISTIC DFES_EnvRef.DFC_VSwVlvHBrgUndrVltg_C "DFES/Zuordnung Umweltdatenset für Prüfung DFC_VSwVlvHBrgUndrVltg" VALUE 0x8002A1E0 Val_Wu16 79. DFES_EnvTabVerb 0.00 79. FORMAT "%2.0" /end CHARACTERISTIC
/begin CHARACTERISTIC DFES_EnvRef.DFC_VSwVlvOL_C "DFES/Zuordnung Umweltdatenset für Prüfung DFC_VSwVlvOL" VALUE 0x8002A1E2 Val_Wu16 79. DFES_EnvTabVerb 0.00 79. FORMAT "%2.0" /end CHARACTERISTIC
/begin CHARACTERISTIC DFES_EnvRef.DFC_VSwVlvSCB_C "DFES/Zuordnung Umweltdatenset für Prüfung DFC_VSwVlvSCB" VALUE 0x8002A1E4 Val_Wu16 79. DFES_EnvTabVerb 0.00 79. FORMAT "%2.0" /end CHARACTERISTIC
/begin CHARACTERISTIC DFES_EnvRef.DFC_VSwVlvSCG_C "DFES/Zuordnung Umweltdatenset für Prüfung DFC_VSwVlvSCG" VALUE 0x8002A1E6 Val_Wu16 79. DFES_EnvTabVerb 0.00 79. FORMAT "%2.0" /end CHARACTERISTIC
/begin CHARACTERISTIC DFES_EnvRef.DFC_VSwVlvSRCMax_C "DFES/Zuordnung Umweltdatenset für Prüfung DFC_VSwVlvSRCMax" VALUE 0x8002A1E8 Val_Wu16 79. DFES_EnvTabVerb 0.00 79. FORMAT "%2.0" /end CHARACTERISTIC
/begin CHARACTERISTIC DFES_EnvRef.DFC_VSwVlvSRCMin_C "DFES/Zuordnung Umweltdatenset für Prüfung DFC_VSwVlvSRCMin" VALUE 0x8002A1EA Val_Wu16 79. DFES_EnvTabVerb 0.00 79. FORMAT "%2.0" /end CHARACTERISTIC
/begin CHARACTERISTIC DFES_EnvRef.DFC_ClthNpl_C "DFES/Zuordnung Umweltdatenset für Prüfung DFC_ClthNpl" VALUE 0x8002A1EC Val_Wu16 79. DFES_EnvTabVerb 0.00 79. FORMAT "%2.0" /end CHARACTERISTIC
/begin CHARACTERISTIC DFES_EnvRef.DFC_ETClbETMax_0_C "DFES/Zuordnung Umweltdatenset für Prüfung DFC_ETClbETMax_0" VALUE 0x8002A1EE Val_Wu16 79. DFES_EnvTabVerb 0.00 79. FORMAT "%2.0" /end CHARACTERISTIC
/begin CHARACTERISTIC DFES_EnvRef.DFC_ETClbETMax_1_C "DFES/Zuordnung Umweltdatenset für Prüfung DFC_ETClbETMax_1" VALUE 0x8002A1F0 Val_Wu16 79. DFES_EnvTabVerb 0.00 79. FORMAT "%2.0" /end CHARACTERISTIC
/begin CHARACTERISTIC DFES_EnvRef.DFC_ETClbETMax_2_C "DFES/Zuordnung Umweltdatenset für Prüfung DFC_ETClbETMax_2" VALUE 0x8002A1F2 Val_Wu16 79. DFES_EnvTabVerb 0.00 79. FORMAT "%2.0" /end CHARACTERISTIC
/begin CHARACTERISTIC DFES_EnvRef.DFC_ETClbETMax_3_C "DFES/Zuordnung Umweltdatenset für Prüfung DFC_ETClbETMax_3" VALUE 0x8002A1F4 Val_Wu16 79. DFES_EnvTabVerb 0.00 79. FORMAT "%2.0" /end CHARACTERISTIC
/begin CHARACTERISTIC DFES_EnvRef.DFC_ETClbETMax_4_C "DFES/Zuordnung Umweltdatenset für Prüfung DFC_ETClbETMax_4" VALUE 0x8002A1F6 Val_Wu16 79. DFES_EnvTabVerb 0.00 79. FORMAT "%2.0" /end CHARACTERISTIC
/begin CHARACTERISTIC DFES_EnvRef.DFC_ETClbETMax_5_C "DFES/Zuordnung Umweltdatenset für Prüfung DFC_ETClbETMax_5" VALUE 0x8002A1F8 Val_Wu16 79. DFES_EnvTabVerb 0.00 79. FORMAT "%2.0" /end CHARACTERISTIC
/begin CHARACTERISTIC DFES_EnvRef.DFC_ETClbETMin_0_C "DFES/Zuordnung Umweltdatenset für Prüfung DFC_ETClbETMin_0" VALUE 0x8002A1FA Val_Wu16 79. DFES_EnvTabVerb 0.00 79. FORMAT "%2.0" /end CHARACTERISTIC
/begin CHARACTERISTIC DFES_EnvRef.DFC_ETClbETMin_1_C "DFES/Zuordnung Umweltdatenset für Prüfung DFC_ETClbETMin_1" VALUE 0x8002A1FC Val_Wu16 79. DFES_EnvTabVerb 0.00 79. FORMAT "%2.0" /end CHARACTERISTIC
/begin CHARACTERISTIC DFES_EnvRef.DFC_ETClbETMin_2_C "DFES/Zuordnung Umweltdatenset für Prüfung DFC_ETClbETMin_2" VALUE 0x8002A1FE Val_Wu16 79. DFES_EnvTabVerb 0.00 79. FORMAT "%2.0" /end CHARACTERISTIC
/begin CHARACTERISTIC DFES_EnvRef.DFC_ETClbETMin_3_C "DFES/Zuordnung Umweltdatenset für Prüfung DFC_ETClbETMin_3" VALUE 0x8002A200 Val_Wu16 79. DFES_EnvTabVerb 0.00 79. FORMAT "%2.0" /end CHARACTERISTIC
/begin CHARACTERISTIC DFES_EnvRef.DFC_ETClbETMin_4_C "DFES/Zuordnung Umweltdatenset für Prüfung DFC_ETClbETMin_4" VALUE 0x8002A202 Val_Wu16 79. DFES_EnvTabVerb 0.00 79. FORMAT "%2.0" /end CHARACTERISTIC
/begin CHARACTERISTIC DFES_EnvRef.DFC_ETClbETMin_5_C "DFES/Zuordnung Umweltdatenset für Prüfung DFC_ETClbETMin_5" VALUE 0x8002A204 Val_Wu16 79. DFES_EnvTabVerb 0.00 79. FORMAT "%2.0" /end CHARACTERISTIC
/begin CHARACTERISTIC DFES_EnvRef.DFC_IVActrEnrgMax_0_C "DFES/Zuordnung Umweltdatenset für Prüfung DFC_IVActrEnrgMax_0" VALUE 0x8002A206 Val_Wu16 79. DFES_EnvTabVerb 0.00 79. FORMAT "%2.0" /end CHARACTERISTIC
/begin CHARACTERISTIC DFES_EnvRef.DFC_IVActrEnrgMax_1_C "DFES/Zuordnung Umweltdatenset für Prüfung DFC_IVActrEnrgMax_1" VALUE 0x8002A208 Val_Wu16 79. DFES_EnvTabVerb 0.00 79. FORMAT "%2.0" /end CHARACTERISTIC
/begin CHARACTERISTIC DFES_EnvRef.DFC_IVActrEnrgMax_2_C "DFES/Zuordnung Umweltdatenset für Prüfung DFC_IVActrEnrgMax_2" VALUE 0x8002A20A Val_Wu16 79. DFES_EnvTabVerb 0.00 79. FORMAT "%2.0" /end CHARACTERISTIC
/begin CHARACTERISTIC DFES_EnvRef.DFC_IVActrEnrgMax_3_C "DFES/Zuordnung Umweltdatenset für Prüfung DFC_IVActrEnrgMax_3" VALUE 0x8002A20C Val_Wu16 79. DFES_EnvTabVerb 0.00 79. FORMAT "%2.0" /end CHARACTERISTIC
/begin CHARACTERISTIC DFES_EnvRef.DFC_IVActrEnrgMax_4_C "DFES/Zuordnung Umweltdatenset für Prüfung DFC_IVActrEnrgMax_4" VALUE 0x8002A20E Val_Wu16 79. DFES_EnvTabVerb 0.00 79. FORMAT "%2.0" /end CHARACTERISTIC
/begin CHARACTERISTIC DFES_EnvRef.DFC_IVActrEnrgMax_5_C "DFES/Zuordnung Umweltdatenset für Prüfung DFC_IVActrEnrgMax_5" VALUE 0x8002A210 Val_Wu16 79. DFES_EnvTabVerb 0.00 79. FORMAT "%2.0" /end CHARACTERISTIC
/begin CHARACTERISTIC DFES_EnvRef.DFC_IVActrEnrgMax_6_C "DFES/Zuordnung Umweltdatenset für Prüfung DFC_IVActrEnrgMax_6" VALUE 0x8002A212 Val_Wu16 79. DFES_EnvTabVerb 0.00 79. FORMAT "%2.0" /end CHARACTERISTIC
/begin CHARACTERISTIC DFES_EnvRef.DFC_IVActrEnrgMax_7_C "DFES/Zuordnung Umweltdatenset für Prüfung DFC_IVActrEnrgMax_7" VALUE 0x8002A214 Val_Wu16 79. DFES_EnvTabVerb 0.00 79. FORMAT "%2.0" /end CHARACTERISTIC
/begin CHARACTERISTIC DFES_EnvRef.DFC_IVActrEnrgMin_0_C "DFES/Zuordnung Umweltdatenset für Prüfung DFC_IVActrEnrgMin_0" VALUE 0x8002A216 Val_Wu16 79. DFES_EnvTabVerb 0.00 79. FORMAT "%2.0" /end CHARACTERISTIC
/begin CHARACTERISTIC DFES_EnvRef.DFC_IVActrEnrgMin_1_C "DFES/Zuordnung Umweltdatenset für Prüfung DFC_IVActrEnrgMin_1" VALUE 0x8002A218 Val_Wu16 79. DFES_EnvTabVerb 0.00 79. FORMAT "%2.0" /end CHARACTERISTIC
/begin CHARACTERISTIC DFES_EnvRef.DFC_IVActrEnrgMin_2_C "DFES/Zuordnung Umweltdatenset für Prüfung DFC_IVActrEnrgMin_2" VALUE 0x8002A21A Val_Wu16 79. DFES_EnvTabVerb 0.00 79. FORMAT "%2.0" /end CHARACTERISTIC
/begin CHARACTERISTIC DFES_EnvRef.DFC_IVActrEnrgMin_3_C "DFES/Zuordnung Umweltdatenset für Prüfung DFC_IVActrEnrgMin_3" VALUE 0x8002A21C Val_Wu16 79. DFES_EnvTabVerb 0.00 79. FORMAT "%2.0" /end CHARACTERISTIC
/begin CHARACTERISTIC DFES_EnvRef.DFC_IVActrEnrgMin_4_C "DFES/Zuordnung Umweltdatenset für Prüfung DFC_IVActrEnrgMin_4" VALUE 0x8002A21E Val_Wu16 79. DFES_EnvTabVerb 0.00 79. FORMAT "%2.0" /end CHARACTERISTIC
/begin CHARACTERISTIC DFES_EnvRef.DFC_IVActrEnrgMin_5_C "DFES/Zuordnung Umweltdatenset für Prüfung DFC_IVActrEnrgMin_5" VALUE 0x8002A220 Val_Wu16 79. DFES_EnvTabVerb 0.00 79. FORMAT "%2.0" /end CHARACTERISTIC
/begin CHARACTERISTIC DFES_EnvRef.DFC_IVActrEnrgMin_6_C "DFES/Zuordnung Umweltdatenset für Prüfung DFC_IVActrEnrgMin_6" VALUE 0x8002A222 Val_Wu16 79. DFES_EnvTabVerb 0.00 79. FORMAT "%2.0" /end CHARACTERISTIC
/begin CHARACTERISTIC DFES_EnvRef.DFC_IVActrEnrgMin_7_C "DFES/Zuordnung Umweltdatenset für Prüfung DFC_IVActrEnrgMin_7" VALUE 0x8002A224 Val_Wu16 79. DFES_EnvTabVerb 0.00 79. FORMAT "%2.0" /end CHARACTERISTIC
/begin CHARACTERISTIC DFES_EnvRef.DFC_IVActrEnrgPlaus_0_C "DFES/Zuordnung Umweltdatenset für Prüfung DFC_IVActrEnrgPlaus_0" VALUE 0x8002A226 Val_Wu16 79. DFES_EnvTabVerb 0.00 79. FORMAT "%2.0" /end CHARACTERISTIC
/begin CHARACTERISTIC DFES_EnvRef.DFC_IVActrEnrgPlaus_1_C "DFES/Zuordnung Umweltdatenset für Prüfung DFC_IVActrEnrgPlaus_1" VALUE 0x8002A228 Val_Wu16 79. DFES_EnvTabVerb 0.00 79. FORMAT "%2.0" /end CHARACTERISTIC
/begin CHARACTERISTIC DFES_EnvRef.DFC_IVActrEnrgPlaus_2_C "DFES/Zuordnung Umweltdatenset für Prüfung DFC_IVActrEnrgPlaus_2" VALUE 0x8002A22A Val_Wu16 79. DFES_EnvTabVerb 0.00 79. FORMAT "%2.0" /end CHARACTERISTIC
/begin CHARACTERISTIC DFES_EnvRef.DFC_IVActrEnrgPlaus_3_C "DFES/Zuordnung Umweltdatenset für Prüfung DFC_IVActrEnrgPlaus_3" VALUE 0x8002A22C Val_Wu16 79. DFES_EnvTabVerb 0.00 79. FORMAT "%2.0" /end CHARACTERISTIC
/begin CHARACTERISTIC DFES_EnvRef.DFC_IVActrEnrgPlaus_4_C "DFES/Zuordnung Umweltdatenset für Prüfung DFC_IVActrEnrgPlaus_4" VALUE 0x8002A22E Val_Wu16 79. DFES_EnvTabVerb 0.00 79. FORMAT "%2.0" /end CHARACTERISTIC
/begin CHARACTERISTIC DFES_EnvRef.DFC_IVActrEnrgPlaus_5_C "DFES/Zuordnung Umweltdatenset für Prüfung DFC_IVActrEnrgPlaus_5" VALUE 0x8002A230 Val_Wu16 79. DFES_EnvTabVerb 0.00 79. FORMAT "%2.0" /end CHARACTERISTIC
/begin CHARACTERISTIC DFES_EnvRef.DFC_IVActrEnrgPlaus_6_C "DFES/Zuordnung Umweltdatenset für Prüfung DFC_IVActrEnrgPlaus_6" VALUE 0x8002A232 Val_Wu16 79. DFES_EnvTabVerb 0.00 79. FORMAT "%2.0" /end CHARACTERISTIC
/begin CHARACTERISTIC DFES_EnvRef.DFC_IVActrEnrgPlaus_7_C "DFES/Zuordnung Umweltdatenset für Prüfung DFC_IVActrEnrgPlaus_7" VALUE 0x8002A234 Val_Wu16 79. DFES_EnvTabVerb 0.00 79. FORMAT "%2.0" /end CHARACTERISTIC
/begin CHARACTERISTIC DFES_EnvRef.DFC_IVCtlTiDiff_0_C "DFES/Zuordnung Umweltdatenset für Prüfung DFC_IVCtlTiDiff_0" VALUE 0x8002A236 Val_Wu16 79. DFES_EnvTabVerb 0.00 79. FORMAT "%2.0" /end CHARACTERISTIC
/begin CHARACTERISTIC DFES_EnvRef.DFC_IVCtlTiDiff_1_C "DFES/Zuordnung Umweltdatenset für Prüfung DFC_IVCtlTiDiff_1" VALUE 0x8002A238 Val_Wu16 79. DFES_EnvTabVerb 0.00 79. FORMAT "%2.0" /end CHARACTERISTIC
/begin CHARACTERISTIC DFES_EnvRef.DFC_IVCtlTiDiff_2_C "DFES/Zuordnung Umweltdatenset für Prüfung DFC_IVCtlTiDiff_2" VALUE 0x8002A23A Val_Wu16 79. DFES_EnvTabVerb 0.00 79. FORMAT "%2.0" /end CHARACTERISTIC
/begin CHARACTERISTIC DFES_EnvRef.DFC_IVCtlTiDiff_3_C "DFES/Zuordnung Umweltdatenset für Prüfung DFC_IVCtlTiDiff_3" VALUE 0x8002A23C Val_Wu16 79. DFES_EnvTabVerb 0.00 79. FORMAT "%2.0" /end CHARACTERISTIC
/begin CHARACTERISTIC DFES_EnvRef.DFC_IVCtlTiDiff_4_C "DFES/Zuordnung Umweltdatenset für Prüfung DFC_IVCtlTiDiff_4" VALUE 0x8002A23E Val_Wu16 79. DFES_EnvTabVerb 0.00 79. FORMAT "%2.0" /end CHARACTERISTIC
/begin CHARACTERISTIC DFES_EnvRef.DFC_IVCtlTiDiff_5_C "DFES/Zuordnung Umweltdatenset für Prüfung DFC_IVCtlTiDiff_5" VALUE 0x8002A240 Val_Wu16 79. DFES_EnvTabVerb 0.00 79. FORMAT "%2.0" /end CHARACTERISTIC
/begin CHARACTERISTIC DFES_EnvRef.DFC_IVCtlUDiffUp_0_C "DFES/Zuordnung Umweltdatenset für Prüfung DFC_IVCtlUDiffUp_0" VALUE 0x8002A242 Val_Wu16 79. DFES_EnvTabVerb 0.00 79. FORMAT "%2.0" /end CHARACTERISTIC
/begin CHARACTERISTIC DFES_EnvRef.DFC_IVCtlUDiffUp_1_C "DFES/Zuordnung Umweltdatenset für Prüfung DFC_IVCtlUDiffUp_1" VALUE 0x8002A244 Val_Wu16 79. DFES_EnvTabVerb 0.00 79. FORMAT "%2.0" /end CHARACTERISTIC
/begin CHARACTERISTIC DFES_EnvRef.DFC_IVCtlUDiffUp_2_C "DFES/Zuordnung Umweltdatenset für Prüfung DFC_IVCtlUDiffUp_2" VALUE 0x8002A246 Val_Wu16 79. DFES_EnvTabVerb 0.00 79. FORMAT "%2.0" /end CHARACTERISTIC
/begin CHARACTERISTIC DFES_EnvRef.DFC_IVCtlUDiffUp_3_C "DFES/Zuordnung Umweltdatenset für Prüfung DFC_IVCtlUDiffUp_3" VALUE 0x8002A248 Val_Wu16 79. DFES_EnvTabVerb 0.00 79. FORMAT "%2.0" /end CHARACTERISTIC
/begin CHARACTERISTIC DFES_EnvRef.DFC_IVCtlUDiffUp_4_C "DFES/Zuordnung Umweltdatenset für Prüfung DFC_IVCtlUDiffUp_4" VALUE 0x8002A24A Val_Wu16 79. DFES_EnvTabVerb 0.00 79. FORMAT "%2.0" /end CHARACTERISTIC
/begin CHARACTERISTIC DFES_EnvRef.DFC_IVCtlUDiffUp_5_C "DFES/Zuordnung Umweltdatenset für Prüfung DFC_IVCtlUDiffUp_5" VALUE 0x8002A24C Val_Wu16 79. DFES_EnvTabVerb 0.00 79. FORMAT "%2.0" /end CHARACTERISTIC
/begin CHARACTERISTIC DFES_EnvRef.DFC_IVCtlUUp_0_C "DFES/Zuordnung Umweltdatenset für Prüfung DFC_IVCtlUUp_0" VALUE 0x8002A24E Val_Wu16 79. DFES_EnvTabVerb 0.00 79. FORMAT "%2.0" /end CHARACTERISTIC
/begin CHARACTERISTIC DFES_EnvRef.DFC_IVCtlUUp_1_C "DFES/Zuordnung Umweltdatenset für Prüfung DFC_IVCtlUUp_1" VALUE 0x8002A250 Val_Wu16 79. DFES_EnvTabVerb 0.00 79. FORMAT "%2.0" /end CHARACTERISTIC
/begin CHARACTERISTIC DFES_EnvRef.DFC_IVCtlUUp_2_C "DFES/Zuordnung Umweltdatenset für Prüfung DFC_IVCtlUUp_2" VALUE 0x8002A252 Val_Wu16 79. DFES_EnvTabVerb 0.00 79. FORMAT "%2.0" /end CHARACTERISTIC
/begin CHARACTERISTIC DFES_EnvRef.DFC_IVCtlUUp_3_C "DFES/Zuordnung Umweltdatenset für Prüfung DFC_IVCtlUUp_3" VALUE 0x8002A254 Val_Wu16 79. DFES_EnvTabVerb 0.00 79. FORMAT "%2.0" /end CHARACTERISTIC
/begin CHARACTERISTIC DFES_EnvRef.DFC_IVCtlUUp_4_C "DFES/Zuordnung Umweltdatenset für Prüfung DFC_IVCtlUUp_4" VALUE 0x8002A256 Val_Wu16 79. DFES_EnvTabVerb 0.00 79. FORMAT "%2.0" /end CHARACTERISTIC
/begin CHARACTERISTIC DFES_EnvRef.DFC_IVCtlUUp_5_C "DFES/Zuordnung Umweltdatenset für Prüfung DFC_IVCtlUUp_5" VALUE 0x8002A258 Val_Wu16 79. DFES_EnvTabVerb 0.00 79. FORMAT "%2.0" /end CHARACTERISTIC
/begin CHARACTERISTIC DFES_EnvRef.DFC_IVDiaBnkShCir_0_C "DFES/Zuordnung Umweltdatenset für Prüfung DFC_IVDiaBnkShCir_0" VALUE 0x8002A25A Val_Wu16 79. DFES_EnvTabVerb 0.00 79. FORMAT "%2.0" /end CHARACTERISTIC
/begin CHARACTERISTIC DFES_EnvRef.DFC_IVDiaBnkShCir_1_C "DFES/Zuordnung Umweltdatenset für Prüfung DFC_IVDiaBnkShCir_1" VALUE 0x8002A25C Val_Wu16 79. DFES_EnvTabVerb 0.00 79. FORMAT "%2.0" /end CHARACTERISTIC
/begin CHARACTERISTIC DFES_EnvRef.DFC_IVDiaBnkShCirChSwt_0_C "DFES/Zuordnung Umweltdatenset für Prüfung DFC_IVDiaBnkShCirChSwt_0" VALUE 0x8002A25E Val_Wu16 79. DFES_EnvTabVerb 0.00 79. FORMAT "%2.0" /end CHARACTERISTIC
/begin CHARACTERISTIC DFES_EnvRef.DFC_IVDiaBnkShCirChSwt_1_C "DFES/Zuordnung Umweltdatenset für Prüfung DFC_IVDiaBnkShCirChSwt_1" VALUE 0x8002A260 Val_Wu16 79. DFES_EnvTabVerb 0.00 79. FORMAT "%2.0" /end CHARACTERISTIC
/begin CHARACTERISTIC DFES_EnvRef.DFC_IVDiaChp_0_C "DFES/Zuordnung Umweltdatenset für Prüfung DFC_IVDiaChp_0" VALUE 0x8002A262 Val_Wu16 79. DFES_EnvTabVerb 0.00 79. FORMAT "%2.0" /end CHARACTERISTIC
/begin CHARACTERISTIC DFES_EnvRef.DFC_IVDiaChp_1_C "DFES/Zuordnung Umweltdatenset für Prüfung DFC_IVDiaChp_1" VALUE 0x8002A264 Val_Wu16 79. DFES_EnvTabVerb 0.00 79. FORMAT "%2.0" /end CHARACTERISTIC
/begin CHARACTERISTIC DFES_EnvRef.DFC_IVDiaCylNoCls_0_C "DFES/Zuordnung Umweltdatenset für Prüfung DFC_IVDiaCylNoCls_0" VALUE 0x8002A266 Val_Wu16 79. DFES_EnvTabVerb 0.00 79. FORMAT "%2.0" /end CHARACTERISTIC
/begin CHARACTERISTIC DFES_EnvRef.DFC_IVDiaCylNoCls_1_C "DFES/Zuordnung Umweltdatenset für Prüfung DFC_IVDiaCylNoCls_1" VALUE 0x8002A268 Val_Wu16 79. DFES_EnvTabVerb 0.00 79. FORMAT "%2.0" /end CHARACTERISTIC
/begin CHARACTERISTIC DFES_EnvRef.DFC_IVDiaCylNoCls_2_C "DFES/Zuordnung Umweltdatenset für Prüfung DFC_IVDiaCylNoCls_2" VALUE 0x8002A26A Val_Wu16 79. DFES_EnvTabVerb 0.00 79. FORMAT "%2.0" /end CHARACTERISTIC
/begin CHARACTERISTIC DFES_EnvRef.DFC_IVDiaCylNoCls_3_C "DFES/Zuordnung Umweltdatenset für Prüfung DFC_IVDiaCylNoCls_3" VALUE 0x8002A26C Val_Wu16 79. DFES_EnvTabVerb 0.00 79. FORMAT "%2.0" /end CHARACTERISTIC
/begin CHARACTERISTIC DFES_EnvRef.DFC_IVDiaCylNoCls_4_C "DFES/Zuordnung Umweltdatenset für Prüfung DFC_IVDiaCylNoCls_4" VALUE 0x8002A26E Val_Wu16 79. DFES_EnvTabVerb 0.00 79. FORMAT "%2.0" /end CHARACTERISTIC
/begin CHARACTERISTIC DFES_EnvRef.DFC_IVDiaCylNoCls_5_C "DFES/Zuordnung Umweltdatenset für Prüfung DFC_IVDiaCylNoCls_5" VALUE 0x8002A270 Val_Wu16 79. DFES_EnvTabVerb 0.00 79. FORMAT "%2.0" /end CHARACTERISTIC
/begin CHARACTERISTIC DFES_EnvRef.DFC_IVDiaCylNoLd_0_C "DFES/Zuordnung Umweltdatenset für Prüfung DFC_IVDiaCylNoLd_0" VALUE 0x8002A272 Val_Wu16 79. DFES_EnvTabVerb 0.00 79. FORMAT "%2.0" /end CHARACTERISTIC
/begin CHARACTERISTIC DFES_EnvRef.DFC_IVDiaCylNoLd_1_C "DFES/Zuordnung Umweltdatenset für Prüfung DFC_IVDiaCylNoLd_1" VALUE 0x8002A274 Val_Wu16 79. DFES_EnvTabVerb 0.00 79. FORMAT "%2.0" /end CHARACTERISTIC
/begin CHARACTERISTIC DFES_EnvRef.DFC_IVDiaCylNoLd_2_C "DFES/Zuordnung Umweltdatenset für Prüfung DFC_IVDiaCylNoLd_2" VALUE 0x8002A276 Val_Wu16 79. DFES_EnvTabVerb 0.00 79. FORMAT "%2.0" /end CHARACTERISTIC
/begin CHARACTERISTIC DFES_EnvRef.DFC_IVDiaCylNoLd_3_C "DFES/Zuordnung Umweltdatenset für Prüfung DFC_IVDiaCylNoLd_3" VALUE 0x8002A278 Val_Wu16 79. DFES_EnvTabVerb 0.00 79. FORMAT "%2.0" /end CHARACTERISTIC
/begin CHARACTERISTIC DFES_EnvRef.DFC_IVDiaCylNoLd_4_C "DFES/Zuordnung Umweltdatenset für Prüfung DFC_IVDiaCylNoLd_4" VALUE 0x8002A27A Val_Wu16 79. DFES_EnvTabVerb 0.00 79. FORMAT "%2.0" /end CHARACTERISTIC
/begin CHARACTERISTIC DFES_EnvRef.DFC_IVDiaCylNoLd_5_C "DFES/Zuordnung Umweltdatenset für Prüfung DFC_IVDiaCylNoLd_5" VALUE 0x8002A27C Val_Wu16 79. DFES_EnvTabVerb 0.00 79. FORMAT "%2.0" /end CHARACTERISTIC
/begin CHARACTERISTIC DFES_EnvRef.DFC_IVDiaCylShCir_0_C "DFES/Zuordnung Umweltdatenset für Prüfung DFC_IVDiaCylShCir_0" VALUE 0x8002A27E Val_Wu16 79. DFES_EnvTabVerb 0.00 79. FORMAT "%2.0" /end CHARACTERISTIC
/begin CHARACTERISTIC DFES_EnvRef.DFC_IVDiaCylShCir_1_C "DFES/Zuordnung Umweltdatenset für Prüfung DFC_IVDiaCylShCir_1" VALUE 0x8002A280 Val_Wu16 79. DFES_EnvTabVerb 0.00 79. FORMAT "%2.0" /end CHARACTERISTIC
/begin CHARACTERISTIC DFES_EnvRef.DFC_IVDiaCylShCir_2_C "DFES/Zuordnung Umweltdatenset für Prüfung DFC_IVDiaCylShCir_2" VALUE 0x8002A282 Val_Wu16 79. DFES_EnvTabVerb 0.00 79. FORMAT "%2.0" /end CHARACTERISTIC
/begin CHARACTERISTIC DFES_EnvRef.DFC_IVDiaCylShCir_3_C "DFES/Zuordnung Umweltdatenset für Prüfung DFC_IVDiaCylShCir_3" VALUE 0x8002A284 Val_Wu16 79. DFES_EnvTabVerb 0.00 79. FORMAT "%2.0" /end CHARACTERISTIC
/begin CHARACTERISTIC DFES_EnvRef.DFC_IVDiaCylShCir_4_C "DFES/Zuordnung Umweltdatenset für Prüfung DFC_IVDiaCylShCir_4" VALUE 0x8002A286 Val_Wu16 79. DFES_EnvTabVerb 0.00 79. FORMAT "%2.0" /end CHARACTERISTIC
/begin CHARACTERISTIC DFES_EnvRef.DFC_IVDiaCylShCir_5_C "DFES/Zuordnung Umweltdatenset für Prüfung DFC_IVDiaCylShCir_5" VALUE 0x8002A288 Val_Wu16 79. DFES_EnvTabVerb 0.00 79. FORMAT "%2.0" /end CHARACTERISTIC
/begin CHARACTERISTIC DFES_EnvRef.DFC_IVDiaCylShCirHSLS_0_C "DFES/Zuordnung Umweltdatenset für Prüfung DFC_IVDiaCylShCirHSLS_0" VALUE 0x8002A28A Val_Wu16 79. DFES_EnvTabVerb 0.00 79. FORMAT "%2.0" /end CHARACTERISTIC
/begin CHARACTERISTIC DFES_EnvRef.DFC_IVDiaCylShCirHSLS_1_C "DFES/Zuordnung Umweltdatenset für Prüfung DFC_IVDiaCylShCirHSLS_1" VALUE 0x8002A28C Val_Wu16 79. DFES_EnvTabVerb 0.00 79. FORMAT "%2.0" /end CHARACTERISTIC
/begin CHARACTERISTIC DFES_EnvRef.DFC_IVDiaCylShCirHSLS_2_C "DFES/Zuordnung Umweltdatenset für Prüfung DFC_IVDiaCylShCirHSLS_2" VALUE 0x8002A28E Val_Wu16 79. DFES_EnvTabVerb 0.00 79. FORMAT "%2.0" /end CHARACTERISTIC
/begin CHARACTERISTIC DFES_EnvRef.DFC_IVDiaCylShCirHSLS_3_C "DFES/Zuordnung Umweltdatenset für Prüfung DFC_IVDiaCylShCirHSLS_3" VALUE 0x8002A290 Val_Wu16 79. DFES_EnvTabVerb 0.00 79. FORMAT "%2.0" /end CHARACTERISTIC
/begin CHARACTERISTIC DFES_EnvRef.DFC_IVDiaCylShCirHSLS_4_C "DFES/Zuordnung Umweltdatenset für Prüfung DFC_IVDiaCylShCirHSLS_4" VALUE 0x8002A292 Val_Wu16 79. DFES_EnvTabVerb 0.00 79. FORMAT "%2.0" /end CHARACTERISTIC
/begin CHARACTERISTIC DFES_EnvRef.DFC_IVDiaCylShCirHSLS_5_C "DFES/Zuordnung Umweltdatenset für Prüfung DFC_IVDiaCylShCirHSLS_5" VALUE 0x8002A294 Val_Wu16 79. DFES_EnvTabVerb 0.00 79. FORMAT "%2.0" /end CHARACTERISTIC
/begin CHARACTERISTIC DFES_EnvRef.DFC_IVDiaCylShCirMeas_0_C "DFES/Zuordnung Umweltdatenset für Prüfung DFC_IVDiaCylShCirMeas_0" VALUE 0x8002A296 Val_Wu16 79. DFES_EnvTabVerb 0.00 79. FORMAT "%2.0" /end CHARACTERISTIC
/begin CHARACTERISTIC DFES_EnvRef.DFC_IVDiaCylShCirMeas_1_C "DFES/Zuordnung Umweltdatenset für Prüfung DFC_IVDiaCylShCirMeas_1" VALUE 0x8002A298 Val_Wu16 79. DFES_EnvTabVerb 0.00 79. FORMAT "%2.0" /end CHARACTERISTIC
/begin CHARACTERISTIC DFES_EnvRef.DFC_IVDiaCylShCirMeas_2_C "DFES/Zuordnung Umweltdatenset für Prüfung DFC_IVDiaCylShCirMeas_2" VALUE 0x8002A29A Val_Wu16 79. DFES_EnvTabVerb 0.00 79. FORMAT "%2.0" /end CHARACTERISTIC
/begin CHARACTERISTIC DFES_EnvRef.DFC_IVDiaCylShCirMeas_3_C "DFES/Zuordnung Umweltdatenset für Prüfung DFC_IVDiaCylShCirMeas_3" VALUE 0x8002A29C Val_Wu16 79. DFES_EnvTabVerb 0.00 79. FORMAT "%2.0" /end CHARACTERISTIC
/begin CHARACTERISTIC DFES_EnvRef.DFC_IVDiaCylShCirMeas_4_C "DFES/Zuordnung Umweltdatenset für Prüfung DFC_IVDiaCylShCirMeas_4" VALUE 0x8002A29E Val_Wu16 79. DFES_EnvTabVerb 0.00 79. FORMAT "%2.0" /end CHARACTERISTIC
/begin CHARACTERISTIC DFES_EnvRef.DFC_IVDiaCylShCirMeas_5_C "DFES/Zuordnung Umweltdatenset für Prüfung DFC_IVDiaCylShCirMeas_5" VALUE 0x8002A2A0 Val_Wu16 79. DFES_EnvTabVerb 0.00 79. FORMAT "%2.0" /end CHARACTERISTIC
/begin CHARACTERISTIC DFES_EnvRef.DFC_LSUDynChk_C "DFES/Zuordnung Umweltdatenset für Prüfung DFC_LSUDynChk" VALUE 0x8002A2A2 Val_Wu16 79. DFES_EnvTabVerb 0.00 79. FORMAT "%2.0" /end CHARACTERISTIC
/begin CHARACTERISTIC DFES_EnvRef.DFC_LSUO2ClbMax_C "DFES/Zuordnung Umweltdatenset für Prüfung DFC_LSUO2ClbMax" VALUE 0x8002A2A4 Val_Wu16 79. DFES_EnvTabVerb 0.00 79. FORMAT "%2.0" /end CHARACTERISTIC
/begin CHARACTERISTIC DFES_EnvRef.DFC_LSUO2ClbMin_C "DFES/Zuordnung Umweltdatenset für Prüfung DFC_LSUO2ClbMin" VALUE 0x8002A2A6 Val_Wu16 79. DFES_EnvTabVerb 0.00 79. FORMAT "%2.0" /end CHARACTERISTIC
/begin CHARACTERISTIC DFES_EnvRef.DFC_LSUO2PlausMaxFLd_C "DFES/Zuordnung Umweltdatenset für Prüfung DFC_LSUO2PlausMaxFLd" VALUE 0x8002A2A8 Val_Wu16 79. DFES_EnvTabVerb 0.00 79. FORMAT "%2.0" /end CHARACTERISTIC
/begin CHARACTERISTIC DFES_EnvRef.DFC_LSUO2PlausMaxOvrRun_C "DFES/Zuordnung Umweltdatenset für Prüfung DFC_LSUO2PlausMaxOvrRun" VALUE 0x8002A2AA Val_Wu16 79. DFES_EnvTabVerb 0.00 79. FORMAT "%2.0" /end CHARACTERISTIC
/begin CHARACTERISTIC DFES_EnvRef.DFC_LSUO2PlausMaxPartLd_C "DFES/Zuordnung Umweltdatenset für Prüfung DFC_LSUO2PlausMaxPartLd" VALUE 0x8002A2AC Val_Wu16 79. DFES_EnvTabVerb 0.00 79. FORMAT "%2.0" /end CHARACTERISTIC
/begin CHARACTERISTIC DFES_EnvRef.DFC_LSUO2PlausMinFLd_C "DFES/Zuordnung Umweltdatenset für Prüfung DFC_LSUO2PlausMinFLd" VALUE 0x8002A2AE Val_Wu16 79. DFES_EnvTabVerb 0.00 79. FORMAT "%2.0" /end CHARACTERISTIC
/begin CHARACTERISTIC DFES_EnvRef.DFC_LSUO2PlausMinOvrRun_C "DFES/Zuordnung Umweltdatenset für Prüfung DFC_LSUO2PlausMinOvrRun" VALUE 0x8002A2B0 Val_Wu16 79. DFES_EnvTabVerb 0.00 79. FORMAT "%2.0" /end CHARACTERISTIC
/begin CHARACTERISTIC DFES_EnvRef.DFC_LSUO2PlausMinPartLd_C "DFES/Zuordnung Umweltdatenset für Prüfung DFC_LSUO2PlausMinPartLd" VALUE 0x8002A2B2 Val_Wu16 79. DFES_EnvTabVerb 0.00 79. FORMAT "%2.0" /end CHARACTERISTIC
/begin CHARACTERISTIC DFES_EnvRef.DFC_LSURiClbMax_C "DFES/Zuordnung Umweltdatenset für Prüfung DFC_LSURiClbMax" VALUE 0x8002A2B4 Val_Wu16 79. DFES_EnvTabVerb 0.00 79. FORMAT "%2.0" /end CHARACTERISTIC
/begin CHARACTERISTIC DFES_EnvRef.DFC_LSURiClbMin_C "DFES/Zuordnung Umweltdatenset für Prüfung DFC_LSURiClbMin" VALUE 0x8002A2B6 Val_Wu16 79. DFES_EnvTabVerb 0.00 79. FORMAT "%2.0" /end CHARACTERISTIC
/begin CHARACTERISTIC DFES_EnvRef.DFC_LSUWireIPSig_C "DFES/Zuordnung Umweltdatenset für Prüfung DFC_LSUWireIPSig" VALUE 0x8002A2B8 Val_Wu16 79. DFES_EnvTabVerb 0.00 79. FORMAT "%2.0" /end CHARACTERISTIC
/begin CHARACTERISTIC DFES_EnvRef.DFC_Layer_BSDMax_C "DFES/Zuordnung Umweltdatenset für Prüfung DFC_Layer_BSDMax" VALUE 0x8002A2BA Val_Wu16 79. DFES_EnvTabVerb 0.00 79. FORMAT "%2.0" /end CHARACTERISTIC
/begin CHARACTERISTIC DFES_EnvRef.DFC_Layer_BSDMin_C "DFES/Zuordnung Umweltdatenset für Prüfung DFC_Layer_BSDMin" VALUE 0x8002A2BC Val_Wu16 79. DFES_EnvTabVerb 0.00 79. FORMAT "%2.0" /end CHARACTERISTIC
/begin CHARACTERISTIC DFES_EnvRef.DFC_Layer_BSDNpl_C "DFES/Zuordnung Umweltdatenset für Prüfung DFC_Layer_BSDNpl" VALUE 0x8002A2BE Val_Wu16 79. DFES_EnvTabVerb 0.00 79. FORMAT "%2.0" /end CHARACTERISTIC
/begin CHARACTERISTIC DFES_EnvRef.DFC_Layer_BSDSig_C "DFES/Zuordnung Umweltdatenset für Prüfung DFC_Layer_BSDSig" VALUE 0x8002A2C0 Val_Wu16 79. DFES_EnvTabVerb 0.00 79. FORMAT "%2.0" /end CHARACTERISTIC
/begin CHARACTERISTIC DFES_EnvRef.DFC_Layer_FltMngTstMax_C "DFES/Zuordnung Umweltdatenset für Prüfung DFC_Layer_FltMngTstMax" VALUE 0x8002A2C2 Val_Wu16 79. DFES_EnvTabVerb 0.00 79. FORMAT "%2.0" /end CHARACTERISTIC
/begin CHARACTERISTIC DFES_EnvRef.DFC_Layer_FltMngTstMin_C "DFES/Zuordnung Umweltdatenset für Prüfung DFC_Layer_FltMngTstMin" VALUE 0x8002A2C4 Val_Wu16 79. DFES_EnvTabVerb 0.00 79. FORMAT "%2.0" /end CHARACTERISTIC
/begin CHARACTERISTIC DFES_EnvRef.DFC_Layer_FltMngTstNpl_C "DFES/Zuordnung Umweltdatenset für Prüfung DFC_Layer_FltMngTstNpl" VALUE 0x8002A2C6 Val_Wu16 79. DFES_EnvTabVerb 0.00 79. FORMAT "%2.0" /end CHARACTERISTIC
/begin CHARACTERISTIC DFES_EnvRef.DFC_Layer_FltMngTstSig_C "DFES/Zuordnung Umweltdatenset für Prüfung DFC_Layer_FltMngTstSig" VALUE 0x8002A2C8 Val_Wu16 79. DFES_EnvTabVerb 0.00 79. FORMAT "%2.0" /end CHARACTERISTIC
/begin CHARACTERISTIC DFES_EnvRef.DFC_Layer_GENELBMax_C "DFES/Zuordnung Umweltdatenset für Prüfung DFC_Layer_GENELBMax" VALUE 0x8002A2CA Val_Wu16 79. DFES_EnvTabVerb 0.00 79. FORMAT "%2.0" /end CHARACTERISTIC
/begin CHARACTERISTIC DFES_EnvRef.DFC_Layer_GENELBMin_C "DFES/Zuordnung Umweltdatenset für Prüfung DFC_Layer_GENELBMin" VALUE 0x8002A2CC Val_Wu16 79. DFES_EnvTabVerb 0.00 79. FORMAT "%2.0" /end CHARACTERISTIC
/begin CHARACTERISTIC DFES_EnvRef.DFC_Layer_GENELBNpl_C "DFES/Zuordnung Umweltdatenset für Prüfung DFC_Layer_GENELBNpl" VALUE 0x8002A2CE Val_Wu16 79. DFES_EnvTabVerb 0.00 79. FORMAT "%2.0" /end CHARACTERISTIC
/begin CHARACTERISTIC DFES_EnvRef.DFC_Layer_GENELBSig_C "DFES/Zuordnung Umweltdatenset für Prüfung DFC_Layer_GENELBSig" VALUE 0x8002A2D0 Val_Wu16 79. DFES_EnvTabVerb 0.00 79. FORMAT "%2.0" /end CHARACTERISTIC
/begin CHARACTERISTIC DFES_EnvRef.DFC_Layer_GENELMax_C "DFES/Zuordnung Umweltdatenset für Prüfung DFC_Layer_GENELMax" VALUE 0x8002A2D2 Val_Wu16 79. DFES_EnvTabVerb 0.00 79. FORMAT "%2.0" /end CHARACTERISTIC
/begin CHARACTERISTIC DFES_EnvRef.DFC_Layer_GENELMin_C "DFES/Zuordnung Umweltdatenset für Prüfung DFC_Layer_GENELMin" VALUE 0x8002A2D4 Val_Wu16 79. DFES_EnvTabVerb 0.00 79. FORMAT "%2.0" /end CHARACTERISTIC
/begin CHARACTERISTIC DFES_EnvRef.DFC_Layer_GENELNpl_C "DFES/Zuordnung Umweltdatenset für Prüfung DFC_Layer_GENELNpl" VALUE 0x8002A2D6 Val_Wu16 79. DFES_EnvTabVerb 0.00 79. FORMAT "%2.0" /end CHARACTERISTIC
/begin CHARACTERISTIC DFES_EnvRef.DFC_Layer_GENELSig_C "DFES/Zuordnung Umweltdatenset für Prüfung DFC_Layer_GENELSig" VALUE 0x8002A2D8 Val_Wu16 79. DFES_EnvTabVerb 0.00 79. FORMAT "%2.0" /end CHARACTERISTIC
/begin CHARACTERISTIC DFES_EnvRef.DFC_Layer_GENHTBMax_C "DFES/Zuordnung Umweltdatenset für Prüfung DFC_Layer_GENHTBMax" VALUE 0x8002A2DA Val_Wu16 79. DFES_EnvTabVerb 0.00 79. FORMAT "%2.0" /end CHARACTERISTIC
/begin CHARACTERISTIC DFES_EnvRef.DFC_Layer_GENHTBMin_C "DFES/Zuordnung Umweltdatenset für Prüfung DFC_Layer_GENHTBMin" VALUE 0x8002A2DC Val_Wu16 79. DFES_EnvTabVerb 0.00 79. FORMAT "%2.0" /end CHARACTERISTIC
/begin CHARACTERISTIC DFES_EnvRef.DFC_Layer_GENHTBNpl_C "DFES/Zuordnung Umweltdatenset für Prüfung DFC_Layer_GENHTBNpl" VALUE 0x8002A2DE Val_Wu16 79. DFES_EnvTabVerb 0.00 79. FORMAT "%2.0" /end CHARACTERISTIC
/begin CHARACTERISTIC DFES_EnvRef.DFC_Layer_GENHTBSig_C "DFES/Zuordnung Umweltdatenset für Prüfung DFC_Layer_GENHTBSig" VALUE 0x8002A2E0 Val_Wu16 79. DFES_EnvTabVerb 0.00 79. FORMAT "%2.0" /end CHARACTERISTIC
/begin CHARACTERISTIC DFES_EnvRef.DFC_Layer_GENHTMax_C "DFES/Zuordnung Umweltdatenset für Prüfung DFC_Layer_GENHTMax" VALUE 0x8002A2E2 Val_Wu16 79. DFES_EnvTabVerb 0.00 79. FORMAT "%2.0" /end CHARACTERISTIC
/begin CHARACTERISTIC DFES_EnvRef.DFC_Layer_GENHTMin_C "DFES/Zuordnung Umweltdatenset für Prüfung DFC_Layer_GENHTMin" VALUE 0x8002A2E4 Val_Wu16 79. DFES_EnvTabVerb 0.00 79. FORMAT "%2.0" /end CHARACTERISTIC
/begin CHARACTERISTIC DFES_EnvRef.DFC_Layer_GENHTNpl_C "DFES/Zuordnung Umweltdatenset für Prüfung DFC_Layer_GENHTNpl" VALUE 0x8002A2E6 Val_Wu16 79. DFES_EnvTabVerb 0.00 79. FORMAT "%2.0" /end CHARACTERISTIC
/begin CHARACTERISTIC DFES_EnvRef.DFC_Layer_GENHTSig_C "DFES/Zuordnung Umweltdatenset für Prüfung DFC_Layer_GENHTSig" VALUE 0x8002A2E8 Val_Wu16 79. DFES_EnvTabVerb 0.00 79. FORMAT "%2.0" /end CHARACTERISTIC
/begin CHARACTERISTIC DFES_EnvRef.DFC_Layer_GENKOMMMax_C "DFES/Zuordnung Umweltdatenset für Prüfung DFC_Layer_GENKOMMMax" VALUE 0x8002A2EA Val_Wu16 79. DFES_EnvTabVerb 0.00 79. FORMAT "%2.0" /end CHARACTERISTIC
/begin CHARACTERISTIC DFES_EnvRef.DFC_Layer_GENKOMMMin_C "DFES/Zuordnung Umweltdatenset für Prüfung DFC_Layer_GENKOMMMin" VALUE 0x8002A2EC Val_Wu16 79. DFES_EnvTabVerb 0.00 79. FORMAT "%2.0" /end CHARACTERISTIC
/begin CHARACTERISTIC DFES_EnvRef.DFC_Layer_GENKOMMNpl_C "DFES/Zuordnung Umweltdatenset für Prüfung DFC_Layer_GENKOMMNpl" VALUE 0x8002A2EE Val_Wu16 79. DFES_EnvTabVerb 0.00 79. FORMAT "%2.0" /end CHARACTERISTIC
/begin CHARACTERISTIC DFES_EnvRef.DFC_Layer_GENKOMMSig_C "DFES/Zuordnung Umweltdatenset für Prüfung DFC_Layer_GENKOMMSig" VALUE 0x8002A2F0 Val_Wu16 79. DFES_EnvTabVerb 0.00 79. FORMAT "%2.0" /end CHARACTERISTIC
/begin CHARACTERISTIC DFES_EnvRef.DFC_Layer_GENMECHMax_C "DFES/Zuordnung Umweltdatenset für Prüfung DFC_Layer_GENMECHMax" VALUE 0x8002A2F2 Val_Wu16 79. DFES_EnvTabVerb 0.00 79. FORMAT "%2.0" /end CHARACTERISTIC
/begin CHARACTERISTIC DFES_EnvRef.DFC_Layer_GENMECHMin_C "DFES/Zuordnung Umweltdatenset für Prüfung DFC_Layer_GENMECHMin" VALUE 0x8002A2F4 Val_Wu16 79. DFES_EnvTabVerb 0.00 79. FORMAT "%2.0" /end CHARACTERISTIC
/begin CHARACTERISTIC DFES_EnvRef.DFC_Layer_GENMECHNpl_C "DFES/Zuordnung Umweltdatenset für Prüfung DFC_Layer_GENMECHNpl" VALUE 0x8002A2F6 Val_Wu16 79. DFES_EnvTabVerb 0.00 79. FORMAT "%2.0" /end CHARACTERISTIC
/begin CHARACTERISTIC DFES_EnvRef.DFC_Layer_GENMECHSig_C "DFES/Zuordnung Umweltdatenset für Prüfung DFC_Layer_GENMECHSig" VALUE 0x8002A2F8 Val_Wu16 79. DFES_EnvTabVerb 0.00 79. FORMAT "%2.0" /end CHARACTERISTIC
/begin CHARACTERISTIC DFES_EnvRef.DFC_Layer_GENMax_C "DFES/Zuordnung Umweltdatenset für Prüfung DFC_Layer_GENMax" VALUE 0x8002A2FA Val_Wu16 79. DFES_EnvTabVerb 0.00 79. FORMAT "%2.0" /end CHARACTERISTIC
/begin CHARACTERISTIC DFES_EnvRef.DFC_Layer_GENMin_C "DFES/Zuordnung Umweltdatenset für Prüfung DFC_Layer_GENMin" VALUE 0x8002A2FC Val_Wu16 79. DFES_EnvTabVerb 0.00 79. FORMAT "%2.0" /end CHARACTERISTIC
/begin CHARACTERISTIC DFES_EnvRef.DFC_Layer_GENNpl_C "DFES/Zuordnung Umweltdatenset für Prüfung DFC_Layer_GENNpl" VALUE 0x8002A2FE Val_Wu16 79. DFES_EnvTabVerb 0.00 79. FORMAT "%2.0" /end CHARACTERISTIC
/begin CHARACTERISTIC DFES_EnvRef.DFC_Layer_GENREGUPLMax_C "DFES/Zuordnung Umweltdatenset für Prüfung DFC_Layer_GENREGUPLMax" VALUE 0x8002A300 Val_Wu16 79. DFES_EnvTabVerb 0.00 79. FORMAT "%2.0" /end CHARACTERISTIC
/begin CHARACTERISTIC DFES_EnvRef.DFC_Layer_GENREGUPLMin_C "DFES/Zuordnung Umweltdatenset für Prüfung DFC_Layer_GENREGUPLMin" VALUE 0x8002A302 Val_Wu16 79. DFES_EnvTabVerb 0.00 79. FORMAT "%2.0" /end CHARACTERISTIC
/begin CHARACTERISTIC DFES_EnvRef.DFC_Layer_GENREGUPLNpl_C "DFES/Zuordnung Umweltdatenset für Prüfung DFC_Layer_GENREGUPLNpl" VALUE 0x8002A304 Val_Wu16 79. DFES_EnvTabVerb 0.00 79. FORMAT "%2.0" /end CHARACTERISTIC
/begin CHARACTERISTIC DFES_EnvRef.DFC_Layer_GENREGUPLSig_C "DFES/Zuordnung Umweltdatenset für Prüfung DFC_Layer_GENREGUPLSig" VALUE 0x8002A306 Val_Wu16 79. DFES_EnvTabVerb 0.00 79. FORMAT "%2.0" /end CHARACTERISTIC
/begin CHARACTERISTIC DFES_EnvRef.DFC_Layer_GENSig_C "DFES/Zuordnung Umweltdatenset für Prüfung DFC_Layer_GENSig" VALUE 0x8002A308 Val_Wu16 79. DFES_EnvTabVerb 0.00 79. FORMAT "%2.0" /end CHARACTERISTIC
/begin CHARACTERISTIC DFES_EnvRef.DFC_Layer_GENUPLMax_C "DFES/Zuordnung Umweltdatenset für Prüfung DFC_Layer_GENUPLMax" VALUE 0x8002A30A Val_Wu16 79. DFES_EnvTabVerb 0.00 79. FORMAT "%2.0" /end CHARACTERISTIC
/begin CHARACTERISTIC DFES_EnvRef.DFC_Layer_GENUPLMin_C "DFES/Zuordnung Umweltdatenset für Prüfung DFC_Layer_GENUPLMin" VALUE 0x8002A30C Val_Wu16 79. DFES_EnvTabVerb 0.00 79. FORMAT "%2.0" /end CHARACTERISTIC
/begin CHARACTERISTIC DFES_EnvRef.DFC_Layer_GENUPLNpl_C "DFES/Zuordnung Umweltdatenset für Prüfung DFC_Layer_GENUPLNpl" VALUE 0x8002A30E Val_Wu16 79. DFES_EnvTabVerb 0.00 79. FORMAT "%2.0" /end CHARACTERISTIC
/begin CHARACTERISTIC DFES_EnvRef.DFC_Layer_GENUPLSig_C "DFES/Zuordnung Umweltdatenset für Prüfung DFC_Layer_GENUPLSig" VALUE 0x8002A310 Val_Wu16 79. DFES_EnvTabVerb 0.00 79. FORMAT "%2.0" /end CHARACTERISTIC
/begin CHARACTERISTIC DFES_EnvRef.DFC_Layer_IBS1Max_C "DFES/Zuordnung Umweltdatenset für Prüfung DFC_Layer_IBS1Max" VALUE 0x8002A312 Val_Wu16 79. DFES_EnvTabVerb 0.00 79. FORMAT "%2.0" /end CHARACTERISTIC
/begin CHARACTERISTIC DFES_EnvRef.DFC_Layer_IBS1Min_C "DFES/Zuordnung Umweltdatenset für Prüfung DFC_Layer_IBS1Min" VALUE 0x8002A314 Val_Wu16 79. DFES_EnvTabVerb 0.00 79. FORMAT "%2.0" /end CHARACTERISTIC
/begin CHARACTERISTIC DFES_EnvRef.DFC_Layer_IBS1Npl_C "DFES/Zuordnung Umweltdatenset für Prüfung DFC_Layer_IBS1Npl" VALUE 0x8002A316 Val_Wu16 79. DFES_EnvTabVerb 0.00 79. FORMAT "%2.0" /end CHARACTERISTIC
/begin CHARACTERISTIC DFES_EnvRef.DFC_Layer_IBS1Sig_C "DFES/Zuordnung Umweltdatenset für Prüfung DFC_Layer_IBS1Sig" VALUE 0x8002A318 Val_Wu16 79. DFES_EnvTabVerb 0.00 79. FORMAT "%2.0" /end CHARACTERISTIC
/begin CHARACTERISTIC DFES_EnvRef.DFC_Layer_IBS2Max_C "DFES/Zuordnung Umweltdatenset für Prüfung DFC_Layer_IBS2Max" VALUE 0x8002A31A Val_Wu16 79. DFES_EnvTabVerb 0.00 79. FORMAT "%2.0" /end CHARACTERISTIC
/begin CHARACTERISTIC DFES_EnvRef.DFC_Layer_IBS2Min_C "DFES/Zuordnung Umweltdatenset für Prüfung DFC_Layer_IBS2Min" VALUE 0x8002A31C Val_Wu16 79. DFES_EnvTabVerb 0.00 79. FORMAT "%2.0" /end CHARACTERISTIC
/begin CHARACTERISTIC DFES_EnvRef.DFC_Layer_IBS2Npl_C "DFES/Zuordnung Umweltdatenset für Prüfung DFC_Layer_IBS2Npl" VALUE 0x8002A31E Val_Wu16 79. DFES_EnvTabVerb 0.00 79. FORMAT "%2.0" /end CHARACTERISTIC
/begin CHARACTERISTIC DFES_EnvRef.DFC_Layer_IBS2Sig_C "DFES/Zuordnung Umweltdatenset für Prüfung DFC_Layer_IBS2Sig" VALUE 0x8002A320 Val_Wu16 79. DFES_EnvTabVerb 0.00 79. FORMAT "%2.0" /end CHARACTERISTIC
/begin CHARACTERISTIC DFES_EnvRef.DFC_Layer_IBS3Max_C "DFES/Zuordnung Umweltdatenset für Prüfung DFC_Layer_IBS3Max" VALUE 0x8002A322 Val_Wu16 79. DFES_EnvTabVerb 0.00 79. FORMAT "%2.0" /end CHARACTERISTIC
/begin CHARACTERISTIC DFES_EnvRef.DFC_Layer_IBS3Min_C "DFES/Zuordnung Umweltdatenset für Prüfung DFC_Layer_IBS3Min" VALUE 0x8002A324 Val_Wu16 79. DFES_EnvTabVerb 0.00 79. FORMAT "%2.0" /end CHARACTERISTIC
/begin CHARACTERISTIC DFES_EnvRef.DFC_Layer_IBS3Npl_C "DFES/Zuordnung Umweltdatenset für Prüfung DFC_Layer_IBS3Npl" VALUE 0x8002A326 Val_Wu16 79. DFES_EnvTabVerb 0.00 79. FORMAT "%2.0" /end CHARACTERISTIC
/begin CHARACTERISTIC DFES_EnvRef.DFC_Layer_IBS3Sig_C "DFES/Zuordnung Umweltdatenset für Prüfung DFC_Layer_IBS3Sig" VALUE 0x8002A328 Val_Wu16 79. DFES_EnvTabVerb 0.00 79. FORMAT "%2.0" /end CHARACTERISTIC
/begin CHARACTERISTIC DFES_EnvRef.DFC_Layer_MANDETEKMax_C "DFES/Zuordnung Umweltdatenset für Prüfung DFC_Layer_MANDETEKMax" VALUE 0x8002A32A Val_Wu16 79. DFES_EnvTabVerb 0.00 79. FORMAT "%2.0" /end CHARACTERISTIC
/begin CHARACTERISTIC DFES_EnvRef.DFC_Layer_MANDETEKMin_C "DFES/Zuordnung Umweltdatenset für Prüfung DFC_Layer_MANDETEKMin" VALUE 0x8002A32C Val_Wu16 79. DFES_EnvTabVerb 0.00 79. FORMAT "%2.0" /end CHARACTERISTIC
/begin CHARACTERISTIC DFES_EnvRef.DFC_Layer_MANDETEKNpl_C "DFES/Zuordnung Umweltdatenset für Prüfung DFC_Layer_MANDETEKNpl" VALUE 0x8002A32E Val_Wu16 79. DFES_EnvTabVerb 0.00 79. FORMAT "%2.0" /end CHARACTERISTIC
/begin CHARACTERISTIC DFES_EnvRef.DFC_Layer_MANDETEKSig_C "DFES/Zuordnung Umweltdatenset für Prüfung DFC_Layer_MANDETEKSig" VALUE 0x8002A330 Val_Wu16 79. DFES_EnvTabVerb 0.00 79. FORMAT "%2.0" /end CHARACTERISTIC
/begin CHARACTERISTIC DFES_EnvRef.DFC_Layer_NDR1Max_C "DFES/Zuordnung Umweltdatenset für Prüfung DFC_Layer_NDR1Max" VALUE 0x8002A332 Val_Wu16 79. DFES_EnvTabVerb 0.00 79. FORMAT "%2.0" /end CHARACTERISTIC
/begin CHARACTERISTIC DFES_EnvRef.DFC_Layer_NDR1Min_C "DFES/Zuordnung Umweltdatenset für Prüfung DFC_Layer_NDR1Min" VALUE 0x8002A334 Val_Wu16 79. DFES_EnvTabVerb 0.00 79. FORMAT "%2.0" /end CHARACTERISTIC
/begin CHARACTERISTIC DFES_EnvRef.DFC_Layer_NDR1Npl_C "DFES/Zuordnung Umweltdatenset für Prüfung DFC_Layer_NDR1Npl" VALUE 0x8002A336 Val_Wu16 79. DFES_EnvTabVerb 0.00 79. FORMAT "%2.0" /end CHARACTERISTIC
/begin CHARACTERISTIC DFES_EnvRef.DFC_Layer_NDR1Sig_C "DFES/Zuordnung Umweltdatenset für Prüfung DFC_Layer_NDR1Sig" VALUE 0x8002A338 Val_Wu16 79. DFES_EnvTabVerb 0.00 79. FORMAT "%2.0" /end CHARACTERISTIC
/begin CHARACTERISTIC DFES_EnvRef.DFC_Layer_NDR2Max_C "DFES/Zuordnung Umweltdatenset für Prüfung DFC_Layer_NDR2Max" VALUE 0x8002A33A Val_Wu16 79. DFES_EnvTabVerb 0.00 79. FORMAT "%2.0" /end CHARACTERISTIC
/begin CHARACTERISTIC DFES_EnvRef.DFC_Layer_NDR2Min_C "DFES/Zuordnung Umweltdatenset für Prüfung DFC_Layer_NDR2Min" VALUE 0x8002A33C Val_Wu16 79. DFES_EnvTabVerb 0.00 79. FORMAT "%2.0" /end CHARACTERISTIC
/begin CHARACTERISTIC DFES_EnvRef.DFC_Layer_NDR2Npl_C "DFES/Zuordnung Umweltdatenset für Prüfung DFC_Layer_NDR2Npl" VALUE 0x8002A33E Val_Wu16 79. DFES_EnvTabVerb 0.00 79. FORMAT "%2.0" /end CHARACTERISTIC
/begin CHARACTERISTIC DFES_EnvRef.DFC_Layer_NDR2Sig_C "DFES/Zuordnung Umweltdatenset für Prüfung DFC_Layer_NDR2Sig" VALUE 0x8002A340 Val_Wu16 79. DFES_EnvTabVerb 0.00 79. FORMAT "%2.0" /end CHARACTERISTIC
/begin CHARACTERISTIC DFES_EnvRef.DFC_Layer_NGLERNMax_C "DFES/Zuordnung Umweltdatenset für Prüfung DFC_Layer_NGLERNMax" VALUE 0x8002A342 Val_Wu16 79. DFES_EnvTabVerb 0.00 79. FORMAT "%2.0" /end CHARACTERISTIC
/begin CHARACTERISTIC DFES_EnvRef.DFC_Layer_NGLERNMin_C "DFES/Zuordnung Umweltdatenset für Prüfung DFC_Layer_NGLERNMin" VALUE 0x8002A344 Val_Wu16 79. DFES_EnvTabVerb 0.00 79. FORMAT "%2.0" /end CHARACTERISTIC
/begin CHARACTERISTIC DFES_EnvRef.DFC_Layer_NGLERNNpl_C "DFES/Zuordnung Umweltdatenset für Prüfung DFC_Layer_NGLERNNpl" VALUE 0x8002A346 Val_Wu16 79. DFES_EnvTabVerb 0.00 79. FORMAT "%2.0" /end CHARACTERISTIC
/begin CHARACTERISTIC DFES_EnvRef.DFC_Layer_NGLERNSig_C "DFES/Zuordnung Umweltdatenset für Prüfung DFC_Layer_NGLERNSig" VALUE 0x8002A348 Val_Wu16 79. DFES_EnvTabVerb 0.00 79. FORMAT "%2.0" /end CHARACTERISTIC
/begin CHARACTERISTIC DFES_EnvRef.DFC_Layer_PMBATTMax_C "DFES/Zuordnung Umweltdatenset für Prüfung DFC_Layer_PMBATTMax" VALUE 0x8002A34A Val_Wu16 79. DFES_EnvTabVerb 0.00 79. FORMAT "%2.0" /end CHARACTERISTIC
/begin CHARACTERISTIC DFES_EnvRef.DFC_Layer_PMBATTMin_C "DFES/Zuordnung Umweltdatenset für Prüfung DFC_Layer_PMBATTMin" VALUE 0x8002A34C Val_Wu16 79. DFES_EnvTabVerb 0.00 79. FORMAT "%2.0" /end CHARACTERISTIC
/begin CHARACTERISTIC DFES_EnvRef.DFC_Layer_PMBATTNpl_C "DFES/Zuordnung Umweltdatenset für Prüfung DFC_Layer_PMBATTNpl" VALUE 0x8002A34E Val_Wu16 79. DFES_EnvTabVerb 0.00 79. FORMAT "%2.0" /end CHARACTERISTIC
/begin CHARACTERISTIC DFES_EnvRef.DFC_Layer_PMBATTSig_C "DFES/Zuordnung Umweltdatenset für Prüfung DFC_Layer_PMBATTSig" VALUE 0x8002A350 Val_Wu16 79. DFES_EnvTabVerb 0.00 79. FORMAT "%2.0" /end CHARACTERISTIC
/begin CHARACTERISTIC DFES_EnvRef.DFC_Layer_PMBNMax_C "DFES/Zuordnung Umweltdatenset für Prüfung DFC_Layer_PMBNMax" VALUE 0x8002A352 Val_Wu16 79. DFES_EnvTabVerb 0.00 79. FORMAT "%2.0" /end CHARACTERISTIC
/begin CHARACTERISTIC DFES_EnvRef.DFC_Layer_PMBNMin_C "DFES/Zuordnung Umweltdatenset für Prüfung DFC_Layer_PMBNMin" VALUE 0x8002A354 Val_Wu16 79. DFES_EnvTabVerb 0.00 79. FORMAT "%2.0" /end CHARACTERISTIC
/begin CHARACTERISTIC DFES_EnvRef.DFC_Layer_PMBNNpl_C "DFES/Zuordnung Umweltdatenset für Prüfung DFC_Layer_PMBNNpl" VALUE 0x8002A356 Val_Wu16 79. DFES_EnvTabVerb 0.00 79. FORMAT "%2.0" /end CHARACTERISTIC
/begin CHARACTERISTIC DFES_EnvRef.DFC_Layer_PMBNSig_C "DFES/Zuordnung Umweltdatenset für Prüfung DFC_Layer_PMBNSig" VALUE 0x8002A358 Val_Wu16 79. DFES_EnvTabVerb 0.00 79. FORMAT "%2.0" /end CHARACTERISTIC
/begin CHARACTERISTIC DFES_EnvRef.DFC_Layer_PMRUHVERLMax_C "DFES/Zuordnung Umweltdatenset für Prüfung DFC_Layer_PMRUHVERLMax" VALUE 0x8002A35A Val_Wu16 79. DFES_EnvTabVerb 0.00 79. FORMAT "%2.0" /end CHARACTERISTIC
/begin CHARACTERISTIC DFES_EnvRef.DFC_Layer_PMRUHVERLMin_C "DFES/Zuordnung Umweltdatenset für Prüfung DFC_Layer_PMRUHVERLMin" VALUE 0x8002A35C Val_Wu16 79. DFES_EnvTabVerb 0.00 79. FORMAT "%2.0" /end CHARACTERISTIC
/begin CHARACTERISTIC DFES_EnvRef.DFC_Layer_PMRUHVERLNpl_C "DFES/Zuordnung Umweltdatenset für Prüfung DFC_Layer_PMRUHVERLNpl" VALUE 0x8002A35E Val_Wu16 79. DFES_EnvTabVerb 0.00 79. FORMAT "%2.0" /end CHARACTERISTIC
/begin CHARACTERISTIC DFES_EnvRef.DFC_Layer_PMRUHVERLSig_C "DFES/Zuordnung Umweltdatenset für Prüfung DFC_Layer_PMRUHVERLSig" VALUE 0x8002A360 Val_Wu16 79. DFES_EnvTabVerb 0.00 79. FORMAT "%2.0" /end CHARACTERISTIC
/begin CHARACTERISTIC DFES_EnvRef.DFC_Layer_QLTMax_C "DFES/Zuordnung Umweltdatenset für Prüfung DFC_Layer_QLTMax" VALUE 0x8002A362 Val_Wu16 79. DFES_EnvTabVerb 0.00 79. FORMAT "%2.0" /end CHARACTERISTIC
/begin CHARACTERISTIC DFES_EnvRef.DFC_Layer_QLTMin_C "DFES/Zuordnung Umweltdatenset für Prüfung DFC_Layer_QLTMin" VALUE 0x8002A364 Val_Wu16 79. DFES_EnvTabVerb 0.00 79. FORMAT "%2.0" /end CHARACTERISTIC
/begin CHARACTERISTIC DFES_EnvRef.DFC_Layer_QLTNpl_C "DFES/Zuordnung Umweltdatenset für Prüfung DFC_Layer_QLTNpl" VALUE 0x8002A366 Val_Wu16 79. DFES_EnvTabVerb 0.00 79. FORMAT "%2.0" /end CHARACTERISTIC
/begin CHARACTERISTIC DFES_EnvRef.DFC_Layer_QLTSig_C "DFES/Zuordnung Umweltdatenset für Prüfung DFC_Layer_QLTSig" VALUE 0x8002A368 Val_Wu16 79. DFES_EnvTabVerb 0.00 79. FORMAT "%2.0" /end CHARACTERISTIC
/begin CHARACTERISTIC DFES_EnvRef.DFC_Layer_TOENSMax_C "DFES/Zuordnung Umweltdatenset für Prüfung DFC_Layer_TOENSMax" VALUE 0x8002A36A Val_Wu16 79. DFES_EnvTabVerb 0.00 79. FORMAT "%2.0" /end CHARACTERISTIC
/begin CHARACTERISTIC DFES_EnvRef.DFC_Layer_TOENSMin_C "DFES/Zuordnung Umweltdatenset für Prüfung DFC_Layer_TOENSMin" VALUE 0x8002A36C Val_Wu16 79. DFES_EnvTabVerb 0.00 79. FORMAT "%2.0" /end CHARACTERISTIC
/begin CHARACTERISTIC DFES_EnvRef.DFC_Layer_TOENSNpl_C "DFES/Zuordnung Umweltdatenset für Prüfung DFC_Layer_TOENSNpl" VALUE 0x8002A36E Val_Wu16 79. DFES_EnvTabVerb 0.00 79. FORMAT "%2.0" /end CHARACTERISTIC
/begin CHARACTERISTIC DFES_EnvRef.DFC_Layer_TOENSSig_C "DFES/Zuordnung Umweltdatenset für Prüfung DFC_Layer_TOENSSig" VALUE 0x8002A370 Val_Wu16 79. DFES_EnvTabVerb 0.00 79. FORMAT "%2.0" /end CHARACTERISTIC
/begin CHARACTERISTIC DFES_EnvRef.DFC_MonLimCurr_C "DFES/Zuordnung Umweltdatenset für Prüfung DFC_MonLimCurr" VALUE 0x8002A372 Val_Wu16 79. DFES_EnvTabVerb 0.00 79. FORMAT "%2.0" /end CHARACTERISTIC
/begin CHARACTERISTIC DFES_EnvRef.DFC_MonLimLead_C "DFES/Zuordnung Umweltdatenset für Prüfung DFC_MonLimLead" VALUE 0x8002A374 Val_Wu16 79. DFES_EnvTabVerb 0.00 79. FORMAT "%2.0" /end CHARACTERISTIC
/begin CHARACTERISTIC DFES_EnvRef.DFC_MonLimSet_C "DFES/Zuordnung Umweltdatenset für Prüfung DFC_MonLimSet" VALUE 0x8002A376 Val_Wu16 79. DFES_EnvTabVerb 0.00 79. FORMAT "%2.0" /end CHARACTERISTIC
/begin CHARACTERISTIC DFES_EnvRef.DFC_NSCDsNOxOfsMax_C "DFES/Zuordnung Umweltdatenset für Prüfung DFC_NSCDsNOxOfsMax" VALUE 0x8002A378 Val_Wu16 79. DFES_EnvTabVerb 0.00 79. FORMAT "%2.0" /end CHARACTERISTIC
/begin CHARACTERISTIC DFES_EnvRef.DFC_NSCDsNOxOfsMin_C "DFES/Zuordnung Umweltdatenset für Prüfung DFC_NSCDsNOxOfsMin" VALUE 0x8002A37A Val_Wu16 79. DFES_EnvTabVerb 0.00 79. FORMAT "%2.0" /end CHARACTERISTIC
/begin CHARACTERISTIC DFES_EnvRef.DFC_NSCDsNOxPlausMin_C "DFES/Zuordnung Umweltdatenset für Prüfung DFC_NSCDsNOxPlausMin" VALUE 0x8002A37C Val_Wu16 79. DFES_EnvTabVerb 0.00 79. FORMAT "%2.0" /end CHARACTERISTIC
/begin CHARACTERISTIC DFES_EnvRef.DFC_NoCat2DsNOxOfsMax_C "DFES/Zuordnung Umweltdatenset für Prüfung DFC_NoCat2DsNOxOfsMax" VALUE 0x8002A37E Val_Wu16 79. DFES_EnvTabVerb 0.00 79. FORMAT "%2.0" /end CHARACTERISTIC
/begin CHARACTERISTIC DFES_EnvRef.DFC_NoCat2DsNOxOfsMin_C "DFES/Zuordnung Umweltdatenset für Prüfung DFC_NoCat2DsNOxOfsMin" VALUE 0x8002A380 Val_Wu16 79. DFES_EnvTabVerb 0.00 79. FORMAT "%2.0" /end CHARACTERISTIC
/begin CHARACTERISTIC DFES_EnvRef.DFC_NoCat2DsNOxPlausMin_C "DFES/Zuordnung Umweltdatenset für Prüfung DFC_NoCat2DsNOxPlausMin" VALUE 0x8002A382 Val_Wu16 79. DFES_EnvTabVerb 0.00 79. FORMAT "%2.0" /end CHARACTERISTIC
/begin CHARACTERISTIC DFES_EnvRef.DFC_PCVNoStrt_C "DFES/Zuordnung Umweltdatenset für Prüfung DFC_PCVNoStrt" VALUE 0x8002A384 Val_Wu16 79. DFES_EnvTabVerb 0.00 79. FORMAT "%2.0" /end CHARACTERISTIC
/begin CHARACTERISTIC DFES_EnvRef.DFC_RailPGradMon_C "DFES/Zuordnung Umweltdatenset für Prüfung DFC_RailPGradMon" VALUE 0x8002A386 Val_Wu16 79. DFES_EnvTabVerb 0.00 79. FORMAT "%2.0" /end CHARACTERISTIC
/begin CHARACTERISTIC DFES_EnvRef.DFC_SCRPODPresBuildUp_C "DFES/Zuordnung Umweltdatenset für Prüfung DFC_SCRPODPresBuildUp" VALUE 0x8002A388 Val_Wu16 79. DFES_EnvTabVerb 0.00 79. FORMAT "%2.0" /end CHARACTERISTIC
/begin CHARACTERISTIC DFES_EnvRef.DFC_AFSDrftIdlAdjVal_C "DFES/Zuordnung Umweltdatenset für Prüfung DFC_AFSDrftIdlAdjVal" VALUE 0x8002A38A Val_Wu16 79. DFES_EnvTabVerb 0.00 79. FORMAT "%2.0" /end CHARACTERISTIC
/begin CHARACTERISTIC DFES_EnvRef.DFC_AFSDrftLdAdjVal_C "DFES/Zuordnung Umweltdatenset für Prüfung DFC_AFSDrftLdAdjVal" VALUE 0x8002A38C Val_Wu16 79. DFES_EnvTabVerb 0.00 79. FORMAT "%2.0" /end CHARACTERISTIC
/begin CHARACTERISTIC DFES_EnvRef.DFC_AdcIADC0Cal_C "DFES/Zuordnung Umweltdatenset für Prüfung DFC_AdcIADC0Cal" VALUE 0x8002A38E Val_Wu16 79. DFES_EnvTabVerb 0.00 79. FORMAT "%2.0" /end CHARACTERISTIC
/begin CHARACTERISTIC DFES_EnvRef.DFC_AdcIADC0Conv_C "DFES/Zuordnung Umweltdatenset für Prüfung DFC_AdcIADC0Conv" VALUE 0x8002A390 Val_Wu16 79. DFES_EnvTabVerb 0.00 79. FORMAT "%2.0" /end CHARACTERISTIC
/begin CHARACTERISTIC DFES_EnvRef.DFC_AdcIADC1Cal_C "DFES/Zuordnung Umweltdatenset für Prüfung DFC_AdcIADC1Cal" VALUE 0x8002A392 Val_Wu16 79. DFES_EnvTabVerb 0.00 79. FORMAT "%2.0" /end CHARACTERISTIC
/begin CHARACTERISTIC DFES_EnvRef.DFC_AdcIADC1Conv_C "DFES/Zuordnung Umweltdatenset für Prüfung DFC_AdcIADC1Conv" VALUE 0x8002A394 Val_Wu16 79. DFES_EnvTabVerb 0.00 79. FORMAT "%2.0" /end CHARACTERISTIC
/begin CHARACTERISTIC DFES_EnvRef.DFC_CmbChbMisfireMax_0_C "DFES/Zuordnung Umweltdatenset für Prüfung DFC_CmbChbMisfireMax_0" VALUE 0x8002A396 Val_Wu16 79. DFES_EnvTabVerb 0.00 79. FORMAT "%2.0" /end CHARACTERISTIC
/begin CHARACTERISTIC DFES_EnvRef.DFC_CmbChbMisfireMax_1_C "DFES/Zuordnung Umweltdatenset für Prüfung DFC_CmbChbMisfireMax_1" VALUE 0x8002A398 Val_Wu16 79. DFES_EnvTabVerb 0.00 79. FORMAT "%2.0" /end CHARACTERISTIC
/begin CHARACTERISTIC DFES_EnvRef.DFC_CmbChbMisfireMax_2_C "DFES/Zuordnung Umweltdatenset für Prüfung DFC_CmbChbMisfireMax_2" VALUE 0x8002A39A Val_Wu16 79. DFES_EnvTabVerb 0.00 79. FORMAT "%2.0" /end CHARACTERISTIC
/begin CHARACTERISTIC DFES_EnvRef.DFC_CmbChbMisfireMax_3_C "DFES/Zuordnung Umweltdatenset für Prüfung DFC_CmbChbMisfireMax_3" VALUE 0x8002A39C Val_Wu16 79. DFES_EnvTabVerb 0.00 79. FORMAT "%2.0" /end CHARACTERISTIC
/begin CHARACTERISTIC DFES_EnvRef.DFC_CmbChbMisfireMax_4_C "DFES/Zuordnung Umweltdatenset für Prüfung DFC_CmbChbMisfireMax_4" VALUE 0x8002A39E Val_Wu16 79. DFES_EnvTabVerb 0.00 79. FORMAT "%2.0" /end CHARACTERISTIC
/begin CHARACTERISTIC DFES_EnvRef.DFC_CmbChbMisfireMax_5_C "DFES/Zuordnung Umweltdatenset für Prüfung DFC_CmbChbMisfireMax_5" VALUE 0x8002A3A0 Val_Wu16 79. DFES_EnvTabVerb 0.00 79. FORMAT "%2.0" /end CHARACTERISTIC
/begin CHARACTERISTIC DFES_EnvRef.DFC_CmbChbMisfireMul_C "DFES/Zuordnung Umweltdatenset für Prüfung DFC_CmbChbMisfireMul" VALUE 0x8002A3A2 Val_Wu16 79. DFES_EnvTabVerb 0.00 79. FORMAT "%2.0" /end CHARACTERISTIC
/begin CHARACTERISTIC DFES_EnvRef.DFC_EGRVlvLPOfsNeutr_C "DFES/" VALUE 0x8002A3A4 Val_Wu16 79. DFES_EnvTabVerb 0.00 79. FORMAT "%2.0" /end CHARACTERISTIC
/begin CHARACTERISTIC DFES_EnvRef.DFC_EGRVlvOfsNeutr_C "DFES/Zuordnung Umweltdatenset für Prüfung DFC_EGRVlvOfsNeutr" VALUE 0x8002A3A6 Val_Wu16 79. DFES_EnvTabVerb 0.00 79. FORMAT "%2.0" /end CHARACTERISTIC
/begin CHARACTERISTIC DFES_EnvRef.DFC_FMAErrModMax_C "DFES/Zuordnung Umweltdatenset für Prüfung DFC_FMAErrModMax" VALUE 0x8002A3A8 Val_Wu16 79. DFES_EnvTabVerb 0.00 79. FORMAT "%2.0" /end CHARACTERISTIC
/begin CHARACTERISTIC DFES_EnvRef.DFC_FMAErrModMin_C "DFES/Zuordnung Umweltdatenset für Prüfung DFC_FMAErrModMin" VALUE 0x8002A3AA Val_Wu16 79. DFES_EnvTabVerb 0.00 79. FORMAT "%2.0" /end CHARACTERISTIC
/begin CHARACTERISTIC DFES_EnvRef.DFC_FlSysTnkLo_C "DFES/Zuordnung Umweltdatenset für Prüfung DFC_FlSysTnkLo" VALUE 0x8002A3AC Val_Wu16 79. DFES_EnvTabVerb 0.00 79. FORMAT "%2.0" /end CHARACTERISTIC
/begin CHARACTERISTIC DFES_EnvRef.DFC_GbxNPosPlaus_C "DFES/Zuordnung Umweltdatenset für Prüfung DFC_GbxNPosPlaus" VALUE 0x8002A3AE Val_Wu16 79. DFES_EnvTabVerb 0.00 79. FORMAT "%2.0" /end CHARACTERISTIC
/begin CHARACTERISTIC DFES_EnvRef.DFC_I14229_ROETst_Appl_C "DFES/" VALUE 0x8002A3B0 Val_Wu16 79. DFES_EnvTabVerb 0.00 79. FORMAT "%2.0" /end CHARACTERISTIC
/begin CHARACTERISTIC DFES_EnvRef.DFC_I14229_ROETst_Netw_C "DFES/" VALUE 0x8002A3B2 Val_Wu16 79. DFES_EnvTabVerb 0.00 79. FORMAT "%2.0" /end CHARACTERISTIC
/begin CHARACTERISTIC DFES_EnvRef.DFC_I14229_ROE_BufFull_C "DFES/" VALUE 0x8002A3B4 Val_Wu16 79. DFES_EnvTabVerb 0.00 79. FORMAT "%2.0" /end CHARACTERISTIC
/begin CHARACTERISTIC DFES_EnvRef.DFC_IVAdjDiaIVAdj_C "DFES/Zuordnung Umweltdatenset für Prüfung DFC_IVAdjDiaIVAdj" VALUE 0x8002A3B6 Val_Wu16 79. DFES_EnvTabVerb 0.00 79. FORMAT "%2.0" /end CHARACTERISTIC
/begin CHARACTERISTIC DFES_EnvRef.DFC_IVAdjIVA_0_C "DFES/Zuordnung Umweltdatenset für Prüfung DFC_IVAdjIVA_0" VALUE 0x8002A3B8 Val_Wu16 79. DFES_EnvTabVerb 0.00 79. FORMAT "%2.0" /end CHARACTERISTIC
/begin CHARACTERISTIC DFES_EnvRef.DFC_IVAdjIVA_1_C "DFES/Zuordnung Umweltdatenset für Prüfung DFC_IVAdjIVA_1" VALUE 0x8002A3BA Val_Wu16 79. DFES_EnvTabVerb 0.00 79. FORMAT "%2.0" /end CHARACTERISTIC
/begin CHARACTERISTIC DFES_EnvRef.DFC_IVAdjIVA_2_C "DFES/Zuordnung Umweltdatenset für Prüfung DFC_IVAdjIVA_2" VALUE 0x8002A3BC Val_Wu16 79. DFES_EnvTabVerb 0.00 79. FORMAT "%2.0" /end CHARACTERISTIC
/begin CHARACTERISTIC DFES_EnvRef.DFC_IVAdjIVA_3_C "DFES/Zuordnung Umweltdatenset für Prüfung DFC_IVAdjIVA_3" VALUE 0x8002A3BE Val_Wu16 79. DFES_EnvTabVerb 0.00 79. FORMAT "%2.0" /end CHARACTERISTIC
/begin CHARACTERISTIC DFES_EnvRef.DFC_IVAdjIVA_4_C "DFES/Zuordnung Umweltdatenset für Prüfung DFC_IVAdjIVA_4" VALUE 0x8002A3C0 Val_Wu16 79. DFES_EnvTabVerb 0.00 79. FORMAT "%2.0" /end CHARACTERISTIC
/begin CHARACTERISTIC DFES_EnvRef.DFC_IVAdjIVA_5_C "DFES/Zuordnung Umweltdatenset für Prüfung DFC_IVAdjIVA_5" VALUE 0x8002A3C2 Val_Wu16 79. DFES_EnvTabVerb 0.00 79. FORMAT "%2.0" /end CHARACTERISTIC
/begin CHARACTERISTIC DFES_EnvRef.DFC_IVPSplyDCDCOff_0_C "DFES/Zuordnung Umweltdatenset für Prüfung DFC_IVPSplyDCDCOff_0" VALUE 0x8002A3C4 Val_Wu16 79. DFES_EnvTabVerb 0.00 79. FORMAT "%2.0" /end CHARACTERISTIC
/begin CHARACTERISTIC DFES_EnvRef.DFC_IVPSplyDCDCOff_1_C "DFES/Zuordnung Umweltdatenset für Prüfung DFC_IVPSplyDCDCOff_1" VALUE 0x8002A3C6 Val_Wu16 79. DFES_EnvTabVerb 0.00 79. FORMAT "%2.0" /end CHARACTERISTIC
/begin CHARACTERISTIC DFES_EnvRef.DFC_IVPSplyDCDCOff_2_C "DFES/Zuordnung Umweltdatenset für Prüfung DFC_IVPSplyDCDCOff_2" VALUE 0x8002A3C8 Val_Wu16 79. DFES_EnvTabVerb 0.00 79. FORMAT "%2.0" /end CHARACTERISTIC
/begin CHARACTERISTIC DFES_EnvRef.DFC_IVPSplyDCDCOff_3_C "DFES/Zuordnung Umweltdatenset für Prüfung DFC_IVPSplyDCDCOff_3" VALUE 0x8002A3CA Val_Wu16 79. DFES_EnvTabVerb 0.00 79. FORMAT "%2.0" /end CHARACTERISTIC
/begin CHARACTERISTIC DFES_EnvRef.DFC_InjCtlAdjQntEEPCS_C "DFES/Zuordnung Umweltdatenset für Prüfung DFC_InjCtlAdjQntEEPCS" VALUE 0x8002A3CC Val_Wu16 79. DFES_EnvTabVerb 0.00 79. FORMAT "%2.0" /end CHARACTERISTIC
/begin CHARACTERISTIC DFES_EnvRef.DFC_LSUSPISig_C "DFES/Zuordnung Umweltdatenset für Prüfung DFC_LSUSPISig" VALUE 0x8002A3CE Val_Wu16 79. DFES_EnvTabVerb 0.00 79. FORMAT "%2.0" /end CHARACTERISTIC
/begin CHARACTERISTIC DFES_EnvRef.DFC_Layer_Dummy_C "DFES/Zuordnung Umweltdatenset für Prüfung DFC_Layer_Dummy" VALUE 0x8002A3D0 Val_Wu16 79. DFES_EnvTabVerb 0.00 79. FORMAT "%2.0" /end CHARACTERISTIC
/begin CHARACTERISTIC DFES_EnvRef.DFC_NplEnvPSensPPFltDiff_C "DFES/Zuordnung Umweltdatenset für Prüfung DFC_NplEnvPSensPPFltDiff" VALUE 0x8002A3D2 Val_Wu16 79. DFES_EnvTabVerb 0.00 79. FORMAT "%2.0" /end CHARACTERISTIC
/begin CHARACTERISTIC DFES_EnvRef.DFC_NplPresSensPPFltDiff_C "DFES/Zuordnung Umweltdatenset für Prüfung DFC_NplPresSensPPFltDiff" VALUE 0x8002A3D4 Val_Wu16 79. DFES_EnvTabVerb 0.00 79. FORMAT "%2.0" /end CHARACTERISTIC
/begin CHARACTERISTIC DFES_EnvRef.DFC_OilLvlPlaus_C "DFES/Zuordnung Umweltdatenset für Prüfung DFC_OilLvlPlaus" VALUE 0x8002A3D6 Val_Wu16 79. DFES_EnvTabVerb 0.00 79. FORMAT "%2.0" /end CHARACTERISTIC
/begin CHARACTERISTIC DFES_EnvRef.DFC_OilTOutLvl_C "DFES/Zuordnung Umweltdatenset für Prüfung DFC_OilTOutLvl" VALUE 0x8002A3D8 Val_Wu16 79. DFES_EnvTabVerb 0.00 79. FORMAT "%2.0" /end CHARACTERISTIC
/begin CHARACTERISTIC DFES_EnvRef.DFC_PCVfacAdaptMax_C "DFES/Zuordnung Umweltdatenset für Prüfung DFC_PCVfacAdaptMax" VALUE 0x8002A3DA Val_Wu16 79. DFES_EnvTabVerb 0.00 79. FORMAT "%2.0" /end CHARACTERISTIC
/begin CHARACTERISTIC DFES_EnvRef.DFC_PCVfacAdaptMin_C "DFES/Zuordnung Umweltdatenset für Prüfung DFC_PCVfacAdaptMin" VALUE 0x8002A3DC Val_Wu16 79. DFES_EnvTabVerb 0.00 79. FORMAT "%2.0" /end CHARACTERISTIC
/begin CHARACTERISTIC DFES_EnvRef.DFC_SensFrzPPFltUs_C "DFES/Zuordnung Umweltdatenset für Prüfung DFC_SensFrzPPFltUs" VALUE 0x8002A3DE Val_Wu16 79. DFES_EnvTabVerb 0.00 79. FORMAT "%2.0" /end CHARACTERISTIC
/begin CHARACTERISTIC DFES_EnvRef.DFC_SensMonUTnkLvl_C "DFES/Zuordnung Umweltdatenset für Prüfung DFC_SensMonUTnkLvl" VALUE 0x8002A3E0 Val_Wu16 79. DFES_EnvTabVerb 0.00 79. FORMAT "%2.0" /end CHARACTERISTIC
/begin CHARACTERISTIC DFES_EnvRef.DFC_T15Sig_C "DFES/Zuordnung Umweltdatenset für Prüfung DFC_T15Sig" VALUE 0x8002A3E2 Val_Wu16 79. DFES_EnvTabVerb 0.00 79. FORMAT "%2.0" /end CHARACTERISTIC
/begin CHARACTERISTIC DFES_EnvRef.DFC_AirCtlRmpTOut_C "DFES/Zuordnung Umweltdatenset für Prüfung DFC_AirCtlRmpTOut" VALUE 0x8002A3E4 Val_Wu16 79. DFES_EnvTabVerb 0.00 79. FORMAT "%2.0" /end CHARACTERISTIC
/begin CHARACTERISTIC DFES_EnvRef.DFC_BrkPPlaus_C "DFES/Zuordnung Umweltdatenset für Prüfung DFC_BrkPPlaus" VALUE 0x8002A3E6 Val_Wu16 79. DFES_EnvTabVerb 0.00 79. FORMAT "%2.0" /end CHARACTERISTIC
/begin CHARACTERISTIC DFES_EnvRef.DFC_CEngDsTDynTst_C "DFES/Zuordnung Umweltdatenset für Prüfung DFC_CEngDsTDynTst" VALUE 0x8002A3E8 Val_Wu16 79. DFES_EnvTabVerb 0.00 79. FORMAT "%2.0" /end CHARACTERISTIC
/begin CHARACTERISTIC DFES_EnvRef.DFC_EEPEraseErr_C "DFES/Zuordnung Umweltdatenset für Prüfung DFC_EEPEraseErr" VALUE 0x8002A3EA Val_Wu16 79. DFES_EnvTabVerb 0.00 79. FORMAT "%2.0" /end CHARACTERISTIC
/begin CHARACTERISTIC DFES_EnvRef.DFC_EEPRdErr_C "DFES/Zuordnung Umweltdatenset für Prüfung DFC_EEPRdErr" VALUE 0x8002A3EC Val_Wu16 79. DFES_EnvTabVerb 0.00 79. FORMAT "%2.0" /end CHARACTERISTIC
/begin CHARACTERISTIC DFES_EnvRef.DFC_EEPWrErr_C "DFES/Zuordnung Umweltdatenset für Prüfung DFC_EEPWrErr" VALUE 0x8002A3EE Val_Wu16 79. DFES_EnvTabVerb 0.00 79. FORMAT "%2.0" /end CHARACTERISTIC
/begin CHARACTERISTIC DFES_EnvRef.DFC_EGRVlvJamVlvClsd_C "DFES/Zuordnung Umweltdatenset für Prüfung DFC_EGRVlvJamVlvClsd" VALUE 0x8002A3F0 Val_Wu16 79. DFES_EnvTabVerb 0.00 79. FORMAT "%2.0" /end CHARACTERISTIC
/begin CHARACTERISTIC DFES_EnvRef.DFC_EGRVlvJamVlvOpn_C "DFES/Zuordnung Umweltdatenset für Prüfung DFC_EGRVlvJamVlvOpn" VALUE 0x8002A3F2 Val_Wu16 79. DFES_EnvTabVerb 0.00 79. FORMAT "%2.0" /end CHARACTERISTIC
/begin CHARACTERISTIC DFES_EnvRef.DFC_EGRVlvLPJamVlvClsd_C "DFES/Zuordnung Umweltdatenset für Prüfung DFC_EGRVlvLPJamVlvClsd" VALUE 0x8002A3F4 Val_Wu16 79. DFES_EnvTabVerb 0.00 79. FORMAT "%2.0" /end CHARACTERISTIC
/begin CHARACTERISTIC DFES_EnvRef.DFC_EGRVlvLPJamVlvOpn_C "DFES/Zuordnung Umweltdatenset für Prüfung DFC_EGRVlvLPJamVlvOpn" VALUE 0x8002A3F6 Val_Wu16 79. DFES_EnvTabVerb 0.00 79. FORMAT "%2.0" /end CHARACTERISTIC
/begin CHARACTERISTIC DFES_EnvRef.DFC_EGRVlvLPLgTDrft_C "DFES/Zuordnung Umweltdatenset für Prüfung DFC_EGRVlvLPLgTDrft" VALUE 0x8002A3F8 Val_Wu16 79. DFES_EnvTabVerb 0.00 79. FORMAT "%2.0" /end CHARACTERISTIC
/begin CHARACTERISTIC DFES_EnvRef.DFC_EGRVlvLPOfsLrnJamVlv_C "DFES/Zuordnung Umweltdatenset für Prüfung DFC_EGRVlvLPOfsLrnJamVlv" VALUE 0x8002A3FA Val_Wu16 79. DFES_EnvTabVerb 0.00 79. FORMAT "%2.0" /end CHARACTERISTIC
/begin CHARACTERISTIC DFES_EnvRef.DFC_EGRVlvLPShTDrft_C "DFES/Zuordnung Umweltdatenset für Prüfung DFC_EGRVlvLPShTDrft" VALUE 0x8002A3FC Val_Wu16 79. DFES_EnvTabVerb 0.00 79. FORMAT "%2.0" /end CHARACTERISTIC
/begin CHARACTERISTIC DFES_EnvRef.DFC_EGRVlvLgTDrft_C "DFES/Zuordnung Umweltdatenset für Prüfung DFC_EGRVlvLgTDrft" VALUE 0x8002A3FE Val_Wu16 79. DFES_EnvTabVerb 0.00 79. FORMAT "%2.0" /end CHARACTERISTIC
/begin CHARACTERISTIC DFES_EnvRef.DFC_EGRVlvOfsLrnJamVlv_C "DFES/Zuordnung Umweltdatenset für Prüfung DFC_EGRVlvOfsLrnJamVlv" VALUE 0x8002A400 Val_Wu16 79. DFES_EnvTabVerb 0.00 79. FORMAT "%2.0" /end CHARACTERISTIC
/begin CHARACTERISTIC DFES_EnvRef.DFC_EGRVlvShTDrft_C "DFES/Zuordnung Umweltdatenset für Prüfung DFC_EGRVlvShTDrft" VALUE 0x8002A402 Val_Wu16 79. DFES_EnvTabVerb 0.00 79. FORMAT "%2.0" /end CHARACTERISTIC
/begin CHARACTERISTIC DFES_EnvRef.DFC_EngICO_C "DFES/Zuordnung Umweltdatenset für Prüfung DFC_EngICO" VALUE 0x8002A404 Val_Wu16 79. DFES_EnvTabVerb 0.00 79. FORMAT "%2.0" /end CHARACTERISTIC
/begin CHARACTERISTIC DFES_EnvRef.DFC_EpmCaSI1ErrSig_C "DFES/Zuordnung Umweltdatenset für Prüfung DFC_EpmCaSI1ErrSig" VALUE 0x8002A406 Val_Wu16 79. DFES_EnvTabVerb 0.00 79. FORMAT "%2.0" /end CHARACTERISTIC
/begin CHARACTERISTIC DFES_EnvRef.DFC_EpmCaSI1NoSig_C "DFES/Zuordnung Umweltdatenset für Prüfung DFC_EpmCaSI1NoSig" VALUE 0x8002A408 Val_Wu16 79. DFES_EnvTabVerb 0.00 79. FORMAT "%2.0" /end CHARACTERISTIC
/begin CHARACTERISTIC DFES_EnvRef.DFC_EpmCaSI1OfsErr_C "DFES/Zuordnung Umweltdatenset für Prüfung DFC_EpmCaSI1OfsErr" VALUE 0x8002A40A Val_Wu16 79. DFES_EnvTabVerb 0.00 79. FORMAT "%2.0" /end CHARACTERISTIC
/begin CHARACTERISTIC DFES_EnvRef.DFC_EpmCrSErrSig_C "DFES/Zuordnung Umweltdatenset für Prüfung DFC_EpmCrSErrSig" VALUE 0x8002A40C Val_Wu16 79. DFES_EnvTabVerb 0.00 79. FORMAT "%2.0" /end CHARACTERISTIC
/begin CHARACTERISTIC DFES_EnvRef.DFC_EpmCrSNoSig_C "DFES/Zuordnung Umweltdatenset für Prüfung DFC_EpmCrSNoSig" VALUE 0x8002A40E Val_Wu16 79. DFES_EnvTabVerb 0.00 79. FORMAT "%2.0" /end CHARACTERISTIC
/begin CHARACTERISTIC DFES_EnvRef.DFC_IVPlausComprTst_C "DFES/Zuordnung Umweltdatenset für Prüfung DFC_IVPlausComprTst" VALUE 0x8002A410 Val_Wu16 79. DFES_EnvTabVerb 0.00 79. FORMAT "%2.0" /end CHARACTERISTIC
/begin CHARACTERISTIC DFES_EnvRef.DFC_IVPlausRunUpTst_C "DFES/Zuordnung Umweltdatenset für Prüfung DFC_IVPlausRunUpTst" VALUE 0x8002A412 Val_Wu16 79. DFES_EnvTabVerb 0.00 79. FORMAT "%2.0" /end CHARACTERISTIC
/begin CHARACTERISTIC DFES_EnvRef.DFC_InjCrvShOffTst_C "DFES/Zuordnung Umweltdatenset für Prüfung DFC_InjCrvShOffTst" VALUE 0x8002A414 Val_Wu16 79. DFES_EnvTabVerb 0.00 79. FORMAT "%2.0" /end CHARACTERISTIC
/begin CHARACTERISTIC DFES_EnvRef.DFC_LayerEnSavModProd_C "DFES/Zuordnung Umweltdatenset für Prüfung DFC_LayerEnSavModProd" VALUE 0x8002A416 Val_Wu16 79. DFES_EnvTabVerb 0.00 79. FORMAT "%2.0" /end CHARACTERISTIC
/begin CHARACTERISTIC DFES_EnvRef.DFC_LayerEnSavModRep_C "DFES/Zuordnung Umweltdatenset für Prüfung DFC_LayerEnSavModRep" VALUE 0x8002A418 Val_Wu16 79. DFES_EnvTabVerb 0.00 79. FORMAT "%2.0" /end CHARACTERISTIC
/begin CHARACTERISTIC DFES_EnvRef.DFC_LayerEnSavModShip_C "DFES/Zuordnung Umweltdatenset für Prüfung DFC_LayerEnSavModShip" VALUE 0x8002A41A Val_Wu16 79. DFES_EnvTabVerb 0.00 79. FORMAT "%2.0" /end CHARACTERISTIC
/begin CHARACTERISTIC DFES_EnvRef.DFC_MRlyErlyOpng_C "DFES/Zuordnung Umweltdatenset für Prüfung DFC_MRlyErlyOpng" VALUE 0x8002A41C Val_Wu16 79. DFES_EnvTabVerb 0.00 79. FORMAT "%2.0" /end CHARACTERISTIC
/begin CHARACTERISTIC DFES_EnvRef.DFC_MRlyStk_C "DFES/Zuordnung Umweltdatenset für Prüfung DFC_MRlyStk" VALUE 0x8002A41E Val_Wu16 79. DFES_EnvTabVerb 0.00 79. FORMAT "%2.0" /end CHARACTERISTIC
/begin CHARACTERISTIC DFES_EnvRef.DFC_MeUnActrTst_C "DFES/Zuordnung Umweltdatenset für Prüfung DFC_MeUnActrTst" VALUE 0x8002A420 Val_Wu16 79. DFES_EnvTabVerb 0.00 79. FORMAT "%2.0" /end CHARACTERISTIC
/begin CHARACTERISTIC DFES_EnvRef.DFC_MoCADCCmp_C "DFES/Zuordnung Umweltdatenset für Prüfung DFC_MoCADCCmp" VALUE 0x8002A422 Val_Wu16 79. DFES_EnvTabVerb 0.00 79. FORMAT "%2.0" /end CHARACTERISTIC
/begin CHARACTERISTIC DFES_EnvRef.DFC_MoCADCTst_C "DFES/Zuordnung Umweltdatenset für Prüfung DFC_MoCADCTst" VALUE 0x8002A424 Val_Wu16 79. DFES_EnvTabVerb 0.00 79. FORMAT "%2.0" /end CHARACTERISTIC
/begin CHARACTERISTIC DFES_EnvRef.DFC_MoCADCVltgRatio_C "DFES/Zuordnung Umweltdatenset für Prüfung DFC_MoCADCVltgRatio" VALUE 0x8002A426 Val_Wu16 79. DFES_EnvTabVerb 0.00 79. FORMAT "%2.0" /end CHARACTERISTIC
/begin CHARACTERISTIC DFES_EnvRef.DFC_MoCComErrCnt_C "DFES/Zuordnung Umweltdatenset für Prüfung DFC_MoCComErrCnt" VALUE 0x8002A428 Val_Wu16 79. DFES_EnvTabVerb 0.00 79. FORMAT "%2.0" /end CHARACTERISTIC
/begin CHARACTERISTIC DFES_EnvRef.DFC_MoCComSPI_C "DFES/Zuordnung Umweltdatenset für Prüfung DFC_MoCComSPI" VALUE 0x8002A42A Val_Wu16 79. DFES_EnvTabVerb 0.00 79. FORMAT "%2.0" /end CHARACTERISTIC
/begin CHARACTERISTIC DFES_EnvRef.DFC_MoCROMErrXPg_C "DFES/Zuordnung Umweltdatenset für Prüfung DFC_MoCROMErrXPg" VALUE 0x8002A42C Val_Wu16 79. DFES_EnvTabVerb 0.00 79. FORMAT "%2.0" /end CHARACTERISTIC
/begin CHARACTERISTIC DFES_EnvRef.DFC_MoCSOPHwNoRdy_C "DFES/Zuordnung Umweltdatenset für Prüfung DFC_MoCSOPHwNoRdy" VALUE 0x8002A42E Val_Wu16 79. DFES_EnvTabVerb 0.00 79. FORMAT "%2.0" /end CHARACTERISTIC
/begin CHARACTERISTIC DFES_EnvRef.DFC_MoCSOPLoLi_C "DFES/Zuordnung Umweltdatenset für Prüfung DFC_MoCSOPLoLi" VALUE 0x8002A430 Val_Wu16 79. DFES_EnvTabVerb 0.00 79. FORMAT "%2.0" /end CHARACTERISTIC
/begin CHARACTERISTIC DFES_EnvRef.DFC_MoCSOPMM_C "DFES/Zuordnung Umweltdatenset für Prüfung DFC_MoCSOPMM" VALUE 0x8002A432 Val_Wu16 79. DFES_EnvTabVerb 0.00 79. FORMAT "%2.0" /end CHARACTERISTIC
/begin CHARACTERISTIC DFES_EnvRef.DFC_MoCSOPTimeOut_C "DFES/Zuordnung Umweltdatenset für Prüfung DFC_MoCSOPTimeOut" VALUE 0x8002A434 Val_Wu16 79. DFES_EnvTabVerb 0.00 79. FORMAT "%2.0" /end CHARACTERISTIC
/begin CHARACTERISTIC DFES_EnvRef.DFC_MoCSOPUpLi_C "DFES/Zuordnung Umweltdatenset für Prüfung DFC_MoCSOPUpLi" VALUE 0x8002A436 Val_Wu16 79. DFES_EnvTabVerb 0.00 79. FORMAT "%2.0" /end CHARACTERISTIC
/begin CHARACTERISTIC DFES_EnvRef.DFC_MoFAPP_C "DFES/Zuordnung Umweltdatenset für Prüfung DFC_MoFAPP" VALUE 0x8002A438 Val_Wu16 79. DFES_EnvTabVerb 0.00 79. FORMAT "%2.0" /end CHARACTERISTIC
/begin CHARACTERISTIC DFES_EnvRef.DFC_MoFESpd_C "DFES/Zuordnung Umweltdatenset für Prüfung DFC_MoFESpd" VALUE 0x8002A43A Val_Wu16 79. DFES_EnvTabVerb 0.00 79. FORMAT "%2.0" /end CHARACTERISTIC
/begin CHARACTERISTIC DFES_EnvRef.DFC_MoFInjDatPhi_C "DFES/Zuordnung Umweltdatenset für Prüfung DFC_MoFInjDatPhi" VALUE 0x8002A43C Val_Wu16 79. DFES_EnvTabVerb 0.00 79. FORMAT "%2.0" /end CHARACTERISTIC
/begin CHARACTERISTIC DFES_EnvRef.DFC_MoFInjDatQnt_C "DFES/Zuordnung Umweltdatenset für Prüfung DFC_MoFInjDatQnt" VALUE 0x8002A43E Val_Wu16 79. DFES_EnvTabVerb 0.00 79. FORMAT "%2.0" /end CHARACTERISTIC
/begin CHARACTERISTIC DFES_EnvRef.DFC_MoFInjQnt_C "DFES/Zuordnung Umweltdatenset für Prüfung DFC_MoFInjQnt" VALUE 0x8002A440 Val_Wu16 79. DFES_EnvTabVerb 0.00 79. FORMAT "%2.0" /end CHARACTERISTIC
/begin CHARACTERISTIC DFES_EnvRef.DFC_MoFMode1PoI1_C "DFES/Zuordnung Umweltdatenset für Prüfung DFC_MoFMode1PoI1" VALUE 0x8002A442 Val_Wu16 79. DFES_EnvTabVerb 0.00 79. FORMAT "%2.0" /end CHARACTERISTIC
/begin CHARACTERISTIC DFES_EnvRef.DFC_MoFMode1PoI2_C "DFES/Zuordnung Umweltdatenset für Prüfung DFC_MoFMode1PoI2" VALUE 0x8002A444 Val_Wu16 79. DFES_EnvTabVerb 0.00 79. FORMAT "%2.0" /end CHARACTERISTIC
/begin CHARACTERISTIC DFES_EnvRef.DFC_MoFMode2PoI1_C "DFES/Zuordnung Umweltdatenset für Prüfung DFC_MoFMode2PoI1" VALUE 0x8002A446 Val_Wu16 79. DFES_EnvTabVerb 0.00 79. FORMAT "%2.0" /end CHARACTERISTIC
/begin CHARACTERISTIC DFES_EnvRef.DFC_MoFMode2PoI2_C "DFES/Zuordnung Umweltdatenset für Prüfung DFC_MoFMode2PoI2" VALUE 0x8002A448 Val_Wu16 79. DFES_EnvTabVerb 0.00 79. FORMAT "%2.0" /end CHARACTERISTIC
/begin CHARACTERISTIC DFES_EnvRef.DFC_MoFOvR_C "DFES/Zuordnung Umweltdatenset für Prüfung DFC_MoFOvR" VALUE 0x8002A44A Val_Wu16 79. DFES_EnvTabVerb 0.00 79. FORMAT "%2.0" /end CHARACTERISTIC
/begin CHARACTERISTIC DFES_EnvRef.DFC_MoFQntCor_C "DFES/Zuordnung Umweltdatenset für Prüfung DFC_MoFQntCor" VALUE 0x8002A44C Val_Wu16 79. DFES_EnvTabVerb 0.00 79. FORMAT "%2.0" /end CHARACTERISTIC
/begin CHARACTERISTIC DFES_EnvRef.DFC_MoFRailP_C "DFES/Zuordnung Umweltdatenset für Prüfung DFC_MoFRailP" VALUE 0x8002A44E Val_Wu16 79. DFES_EnvTabVerb 0.00 79. FORMAT "%2.0" /end CHARACTERISTIC
/begin CHARACTERISTIC DFES_EnvRef.DFC_MoFTrqCmp_C "DFES/Zuordnung Umweltdatenset für Prüfung DFC_MoFTrqCmp" VALUE 0x8002A450 Val_Wu16 79. DFES_EnvTabVerb 0.00 79. FORMAT "%2.0" /end CHARACTERISTIC
/begin CHARACTERISTIC DFES_EnvRef.DFC_NSCDsHtrSetP_C "DFES/Zuordnung Umweltdatenset für Prüfung DFC_NSCDsHtrSetP" VALUE 0x8002A452 Val_Wu16 79. DFES_EnvTabVerb 0.00 79. FORMAT "%2.0" /end CHARACTERISTIC
/begin CHARACTERISTIC DFES_EnvRef.DFC_NoCat2DsHtrSetP_C "DFES/Zuordnung Umweltdatenset für Prüfung DFC_NoCat2DsHtrSetP" VALUE 0x8002A454 Val_Wu16 79. DFES_EnvTabVerb 0.00 79. FORMAT "%2.0" /end CHARACTERISTIC
/begin CHARACTERISTIC DFES_EnvRef.DFC_PCVActrTst_C "DFES/Zuordnung Umweltdatenset für Prüfung DFC_PCVActrTst" VALUE 0x8002A456 Val_Wu16 79. DFES_EnvTabVerb 0.00 79. FORMAT "%2.0" /end CHARACTERISTIC
/begin CHARACTERISTIC DFES_EnvRef.DFC_PhyModNonMonMapNpl_C "DFES/Zuordnung Umweltdatenset für Prüfung DFC_PhyModNonMonMapNpl" VALUE 0x8002A458 Val_Wu16 79. DFES_EnvTabVerb 0.00 79. FORMAT "%2.0" /end CHARACTERISTIC
/begin CHARACTERISTIC DFES_EnvRef.DFC_RailHpTst_C "DFES/Zuordnung Umweltdatenset für Prüfung DFC_RailHpTst" VALUE 0x8002A45A Val_Wu16 79. DFES_EnvTabVerb 0.00 79. FORMAT "%2.0" /end CHARACTERISTIC
/begin CHARACTERISTIC DFES_EnvRef.DFC_RailPOfsTstMax_C "DFES/Zuordnung Umweltdatenset für Prüfung DFC_RailPOfsTstMax" VALUE 0x8002A45C Val_Wu16 79. DFES_EnvTabVerb 0.00 79. FORMAT "%2.0" /end CHARACTERISTIC
/begin CHARACTERISTIC DFES_EnvRef.DFC_RailPOfsTstMin_C "DFES/Zuordnung Umweltdatenset für Prüfung DFC_RailPOfsTstMin" VALUE 0x8002A45E Val_Wu16 79. DFES_EnvTabVerb 0.00 79. FORMAT "%2.0" /end CHARACTERISTIC
/begin CHARACTERISTIC DFES_EnvRef.DFC_SIA_E1max_C "DFES/Zuordnung Umweltdatenset für Prüfung DFC_SIA_E1max" VALUE 0x8002A460 Val_Wu16 79. DFES_EnvTabVerb 0.00 79. FORMAT "%2.0" /end CHARACTERISTIC
/begin CHARACTERISTIC DFES_EnvRef.DFC_SIA_E1min_C "DFES/Zuordnung Umweltdatenset für Prüfung DFC_SIA_E1min" VALUE 0x8002A462 Val_Wu16 79. DFES_EnvTabVerb 0.00 79. FORMAT "%2.0" /end CHARACTERISTIC
/begin CHARACTERISTIC DFES_EnvRef.DFC_SIA_E1npl_C "DFES/Zuordnung Umweltdatenset für Prüfung DFC_SIA_E1npl" VALUE 0x8002A464 Val_Wu16 79. DFES_EnvTabVerb 0.00 79. FORMAT "%2.0" /end CHARACTERISTIC
/begin CHARACTERISTIC DFES_EnvRef.DFC_SIA_E1sig_C "DFES/Zuordnung Umweltdatenset für Prüfung DFC_SIA_E1sig" VALUE 0x8002A466 Val_Wu16 79. DFES_EnvTabVerb 0.00 79. FORMAT "%2.0" /end CHARACTERISTIC
/begin CHARACTERISTIC DFES_EnvRef.DFC_SIA_E2max_C "DFES/Zuordnung Umweltdatenset für Prüfung DFC_SIA_E2max" VALUE 0x8002A468 Val_Wu16 79. DFES_EnvTabVerb 0.00 79. FORMAT "%2.0" /end CHARACTERISTIC
/begin CHARACTERISTIC DFES_EnvRef.DFC_SIA_E2min_C "DFES/Zuordnung Umweltdatenset für Prüfung DFC_SIA_E2min" VALUE 0x8002A46A Val_Wu16 79. DFES_EnvTabVerb 0.00 79. FORMAT "%2.0" /end CHARACTERISTIC
/begin CHARACTERISTIC DFES_EnvRef.DFC_SIA_E2npl_C "DFES/Zuordnung Umweltdatenset für Prüfung DFC_SIA_E2npl" VALUE 0x8002A46C Val_Wu16 79. DFES_EnvTabVerb 0.00 79. FORMAT "%2.0" /end CHARACTERISTIC
/begin CHARACTERISTIC DFES_EnvRef.DFC_SIA_E2sig_C "DFES/Zuordnung Umweltdatenset für Prüfung DFC_SIA_E2sig" VALUE 0x8002A46E Val_Wu16 79. DFES_EnvTabVerb 0.00 79. FORMAT "%2.0" /end CHARACTERISTIC
/begin CHARACTERISTIC DFES_EnvRef.DFC_SIA_E3max_C "DFES/Zuordnung Umweltdatenset für Prüfung DFC_SIA_E3max" VALUE 0x8002A470 Val_Wu16 79. DFES_EnvTabVerb 0.00 79. FORMAT "%2.0" /end CHARACTERISTIC
/begin CHARACTERISTIC DFES_EnvRef.DFC_SIA_E3min_C "DFES/Zuordnung Umweltdatenset für Prüfung DFC_SIA_E3min" VALUE 0x8002A472 Val_Wu16 79. DFES_EnvTabVerb 0.00 79. FORMAT "%2.0" /end CHARACTERISTIC
/begin CHARACTERISTIC DFES_EnvRef.DFC_SIA_E3npl_C "DFES/Zuordnung Umweltdatenset für Prüfung DFC_SIA_E3npl" VALUE 0x8002A474 Val_Wu16 79. DFES_EnvTabVerb 0.00 79. FORMAT "%2.0" /end CHARACTERISTIC
/begin CHARACTERISTIC DFES_EnvRef.DFC_SIA_E3sig_C "DFES/Zuordnung Umweltdatenset für Prüfung DFC_SIA_E3sig" VALUE 0x8002A476 Val_Wu16 79. DFES_EnvTabVerb 0.00 79. FORMAT "%2.0" /end CHARACTERISTIC
/begin CHARACTERISTIC DFES_EnvRef.DFC_SIA_E4max_C "DFES/Zuordnung Umweltdatenset für Prüfung DFC_SIA_E4max" VALUE 0x8002A478 Val_Wu16 79. DFES_EnvTabVerb 0.00 79. FORMAT "%2.0" /end CHARACTERISTIC
/begin CHARACTERISTIC DFES_EnvRef.DFC_SIA_E4min_C "DFES/Zuordnung Umweltdatenset für Prüfung DFC_SIA_E4min" VALUE 0x8002A47A Val_Wu16 79. DFES_EnvTabVerb 0.00 79. FORMAT "%2.0" /end CHARACTERISTIC
/begin CHARACTERISTIC DFES_EnvRef.DFC_SIA_E4npl_C "DFES/Zuordnung Umweltdatenset für Prüfung DFC_SIA_E4npl" VALUE 0x8002A47C Val_Wu16 79. DFES_EnvTabVerb 0.00 79. FORMAT "%2.0" /end CHARACTERISTIC
/begin CHARACTERISTIC DFES_EnvRef.DFC_SIA_E4sig_C "DFES/Zuordnung Umweltdatenset für Prüfung DFC_SIA_E4sig" VALUE 0x8002A47E Val_Wu16 79. DFES_EnvTabVerb 0.00 79. FORMAT "%2.0" /end CHARACTERISTIC
/begin CHARACTERISTIC DFES_EnvRef.DFC_SWReset_0_C "DFES/Zuordnung Umweltdatenset für Prüfung DFC_SWReset_0" VALUE 0x8002A480 Val_Wu16 79. DFES_EnvTabVerb 0.00 79. FORMAT "%2.0" /end CHARACTERISTIC
/begin CHARACTERISTIC DFES_EnvRef.DFC_SWReset_1_C "DFES/Zuordnung Umweltdatenset für Prüfung DFC_SWReset_1" VALUE 0x8002A482 Val_Wu16 79. DFES_EnvTabVerb 0.00 79. FORMAT "%2.0" /end CHARACTERISTIC
/begin CHARACTERISTIC DFES_EnvRef.DFC_SWReset_2_C "DFES/Zuordnung Umweltdatenset für Prüfung DFC_SWReset_2" VALUE 0x8002A484 Val_Wu16 79. DFES_EnvTabVerb 0.00 79. FORMAT "%2.0" /end CHARACTERISTIC
/begin CHARACTERISTIC DFES_EnvRef.DFC_ShtrAKKMax_C "DFES/Zuordnung Umweltdatenset für Prüfung DFC_ShtrAKKMax" VALUE 0x8002A486 Val_Wu16 79. DFES_EnvTabVerb 0.00 79. FORMAT "%2.0" /end CHARACTERISTIC
/begin CHARACTERISTIC DFES_EnvRef.DFC_ShtrAKKMin_C "DFES/Zuordnung Umweltdatenset für Prüfung DFC_ShtrAKKMin" VALUE 0x8002A488 Val_Wu16 79. DFES_EnvTabVerb 0.00 79. FORMAT "%2.0" /end CHARACTERISTIC
/begin CHARACTERISTIC DFES_EnvRef.DFC_ShtrAKKNpl_C "DFES/Zuordnung Umweltdatenset für Prüfung DFC_ShtrAKKNpl" VALUE 0x8002A48A Val_Wu16 79. DFES_EnvTabVerb 0.00 79. FORMAT "%2.0" /end CHARACTERISTIC
/begin CHARACTERISTIC DFES_EnvRef.DFC_ShtrPKKMax_C "DFES/Zuordnung Umweltdatenset für Prüfung DFC_ShtrPKKMax" VALUE 0x8002A48C Val_Wu16 79. DFES_EnvTabVerb 0.00 79. FORMAT "%2.0" /end CHARACTERISTIC
/begin CHARACTERISTIC DFES_EnvRef.DFC_StopCntTmr_C "DFES/Zuordnung Umweltdatenset für Prüfung DFC_StopCntTmr" VALUE 0x8002A48E Val_Wu16 79. DFES_EnvTabVerb 0.00 79. FORMAT "%2.0" /end CHARACTERISTIC
/begin CHARACTERISTIC DFES_EnvRef.DFC_ThrVlvMon_C "DFES/Zuordnung Umweltdatenset für Prüfung DFC_ThrVlvMon" VALUE 0x8002A490 Val_Wu16 79. DFES_EnvTabVerb 0.00 79. FORMAT "%2.0" /end CHARACTERISTIC
/begin CHARACTERISTIC DFES_EnvRef.DFC_VSwVlvJamVlv_C "DFES/Zuordnung Umweltdatenset für Prüfung DFC_VSwVlvJamVlv" VALUE 0x8002A492 Val_Wu16 79. DFES_EnvTabVerb 0.00 79. FORMAT "%2.0" /end CHARACTERISTIC
/begin CHARACTERISTIC DFES_EnvRef.DFC_VSwVlvLgTDrft_C "DFES/Zuordnung Umweltdatenset für Prüfung DFC_VSwVlvLgTDrft" VALUE 0x8002A494 Val_Wu16 79. DFES_EnvTabVerb 0.00 79. FORMAT "%2.0" /end CHARACTERISTIC
/begin CHARACTERISTIC DFES_EnvRef.DFC_VSwVlvOfsLrnJamVlv_C "DFES/Zuordnung Umweltdatenset für Prüfung DFC_VSwVlvOfsLrnJamVlv" VALUE 0x8002A496 Val_Wu16 79. DFES_EnvTabVerb 0.00 79. FORMAT "%2.0" /end CHARACTERISTIC
/begin CHARACTERISTIC DFES_EnvRef.DFC_VSwVlvOfsNeutr_C "DFES/Zuordnung Umweltdatenset für Prüfung DFC_VSwVlvOfsNeutr" VALUE 0x8002A498 Val_Wu16 79. DFES_EnvTabVerb 0.00 79. FORMAT "%2.0" /end CHARACTERISTIC
/begin CHARACTERISTIC DFES_EnvRef.DFC_VSwVlvShTDrft_C "DFES/Zuordnung Umweltdatenset für Prüfung DFC_VSwVlvShTDrft" VALUE 0x8002A49A Val_Wu16 79. DFES_EnvTabVerb 0.00 79. FORMAT "%2.0" /end CHARACTERISTIC
/begin CHARACTERISTIC DFES_EnvRef.DFC_VSwVlvSpgDef_C "DFES/Zuordnung Umweltdatenset für Prüfung DFC_VSwVlvSpgDef" VALUE 0x8002A49C Val_Wu16 79. DFES_EnvTabVerb 0.00 79. FORMAT "%2.0" /end CHARACTERISTIC
/begin CHARACTERISTIC DFES_FaultTyp.DFC_Unused_C "DFES/intern benötigter Parameter für nicht existierende Fehlerprüfung DFC_Unused" VALUE 0x8002A49E Val_Wu8 255.0 DFES_OneToOne 0.00 255.0 READ_ONLY /end CHARACTERISTIC
/begin CHARACTERISTIC DFES_FaultTyp.DFC_ACCIPlausDrvAst_C "DFES/Fehlertyp Zuordnung für Prüfung DFC_ACCIPlausDrvAst" VALUE 0x8002A49F Val_Wu8 255.0 DFES_OneToOne 0.00 255.0 /end CHARACTERISTIC
/begin CHARACTERISTIC DFES_FaultTyp.DFC_ACCIPlausTrqDes_C "DFES/Fehlertyp Zuordnung für Prüfung DFC_ACCIPlausTrqDes" VALUE 0x8002A4A0 Val_Wu8 255.0 DFES_OneToOne 0.00 255.0 /end CHARACTERISTIC
/begin CHARACTERISTIC DFES_FaultTyp.DFC_AirCtlGovDvtEOMMax_C "DFES/Fehlertyp Zuordnung für Prüfung DFC_AirCtlGovDvtEOMMax" VALUE 0x8002A4A1 Val_Wu8 255.0 DFES_OneToOne 0.00 255.0 /end CHARACTERISTIC
/begin CHARACTERISTIC DFES_FaultTyp.DFC_AirCtlGovDvtEOMMin_C "DFES/Fehlertyp Zuordnung für Prüfung DFC_AirCtlGovDvtEOMMin" VALUE 0x8002A4A2 Val_Wu8 255.0 DFES_OneToOne 0.00 255.0 /end CHARACTERISTIC
/begin CHARACTERISTIC DFES_FaultTyp.DFC_AirCtlGovDvtMax_C "DFES/Fehlertyp Zuordnung für Prüfung DFC_AirCtlGovDvtMax" VALUE 0x8002A4A3 Val_Wu8 255.0 DFES_OneToOne 0.00 255.0 /end CHARACTERISTIC
/begin CHARACTERISTIC DFES_FaultTyp.DFC_AirCtlGovDvtMin_C "DFES/Fehlertyp Zuordnung für Prüfung DFC_AirCtlGovDvtMin" VALUE 0x8002A4A4 Val_Wu8 255.0 DFES_OneToOne 0.00 255.0 /end CHARACTERISTIC
/begin CHARACTERISTIC DFES_FaultTyp.DFC_AirCtlGovLPDvtMax_C "DFES/Fehlertyp Zuordnung für Prüfung DFC_AirCtlGovLPDvtMax" VALUE 0x8002A4A5 Val_Wu8 255.0 DFES_OneToOne 0.00 255.0 /end CHARACTERISTIC
/begin CHARACTERISTIC DFES_FaultTyp.DFC_AirCtlGovLPDvtMin_C "DFES/Fehlertyp Zuordnung für Prüfung DFC_AirCtlGovLPDvtMin" VALUE 0x8002A4A6 Val_Wu8 255.0 DFES_OneToOne 0.00 255.0 /end CHARACTERISTIC
/begin CHARACTERISTIC DFES_FaultTyp.DFC_AltIOComErr_C "DFES/Fehlertyp Zuordnung für Prüfung DFC_AltIOComErr" VALUE 0x8002A4A7 Val_Wu8 255.0 DFES_OneToOne 0.00 255.0 /end CHARACTERISTIC
/begin CHARACTERISTIC DFES_FaultTyp.DFC_AltIOComNpl_C "DFES/Fehlertyp Zuordnung für Prüfung DFC_AltIOComNpl" VALUE 0x8002A4A8 Val_Wu8 255.0 DFES_OneToOne 0.00 255.0 /end CHARACTERISTIC
/begin CHARACTERISTIC DFES_FaultTyp.DFC_BusDiagBusOffFlexRay_C "DFES/" VALUE 0x8002A4A9 Val_Wu8 255.0 DFES_OneToOne 0.00 255.0 /end CHARACTERISTIC
/begin CHARACTERISTIC DFES_FaultTyp.DFC_BusDiagBusOffNodeA_C "DFES/Fehlertyp Zuordnung für Prüfung DFC_BusDiagBusOffNodeA" VALUE 0x8002A4AA Val_Wu8 255.0 DFES_OneToOne 0.00 255.0 /end CHARACTERISTIC
/begin CHARACTERISTIC DFES_FaultTyp.DFC_BusDiagBusOffNodeB_C "DFES/Fehlertyp Zuordnung für Prüfung DFC_BusDiagBusOffNodeB" VALUE 0x8002A4AB Val_Wu8 255.0 DFES_OneToOne 0.00 255.0 /end CHARACTERISTIC
/begin CHARACTERISTIC DFES_FaultTyp.DFC_BusDiagBusOffNodeC_C "DFES/Fehlertyp Zuordnung für Prüfung DFC_BusDiagBusOffNodeC" VALUE 0x8002A4AC Val_Wu8 255.0 DFES_OneToOne 0.00 255.0 /end CHARACTERISTIC
/begin CHARACTERISTIC DFES_FaultTyp.DFC_BusDiagHwFlexRay_C "DFES/" VALUE 0x8002A4AD Val_Wu8 255.0 DFES_OneToOne 0.00 255.0 /end CHARACTERISTIC
/begin CHARACTERISTIC DFES_FaultTyp.DFC_Cj945SpiCom1_C "DFES/Fehlertyp Zuordnung für Prüfung DFC_Cj945SpiCom1" VALUE 0x8002A4AE Val_Wu8 255.0 DFES_OneToOne 0.00 255.0 /end CHARACTERISTIC
/begin CHARACTERISTIC DFES_FaultTyp.DFC_ComACDemandSig_FA_C "DFES/Fehlertyp Zuordnung für Prüfung DFC_ComACDemandSig_FA" VALUE 0x8002A4AF Val_Wu8 255.0 DFES_OneToOne 0.00 255.0 /end CHARACTERISTIC
/begin CHARACTERISTIC DFES_FaultTyp.DFC_ComACDemandTo_FA_C "DFES/Fehlertyp Zuordnung für Prüfung DFC_ComACDemandTo_FA" VALUE 0x8002A4B0 Val_Wu8 255.0 DFES_OneToOne 0.00 255.0 /end CHARACTERISTIC
/begin CHARACTERISTIC DFES_FaultTyp.DFC_ComATempSig_FA_C "DFES/Fehlertyp Zuordnung für Prüfung DFC_ComATempSig_FA" VALUE 0x8002A4B1 Val_Wu8 255.0 DFES_OneToOne 0.00 255.0 /end CHARACTERISTIC
/begin CHARACTERISTIC DFES_FaultTyp.DFC_ComATempTo_FA_C "DFES/Fehlertyp Zuordnung für Prüfung DFC_ComATempTo_FA" VALUE 0x8002A4B2 Val_Wu8 255.0 DFES_OneToOne 0.00 255.0 /end CHARACTERISTIC
/begin CHARACTERISTIC DFES_FaultTyp.DFC_ComATempTo_FX_C "DFES/Fehlertyp Zuordnung für Prüfung DFC_ComATempTo_FX" VALUE 0x8002A4B3 Val_Wu8 255.0 DFES_OneToOne 0.00 255.0 /end CHARACTERISTIC
/begin CHARACTERISTIC DFES_FaultTyp.DFC_ComBrkTrqSumChk_FX_C "DFES/Fehlertyp Zuordnung für Prüfung DFC_ComBrkTrqSumChk_FX" VALUE 0x8002A4B4 Val_Wu8 255.0 DFES_OneToOne 0.00 255.0 /end CHARACTERISTIC
/begin CHARACTERISTIC DFES_FaultTyp.DFC_ComBrkTrqSumCtr_FX_C "DFES/Fehlertyp Zuordnung für Prüfung DFC_ComBrkTrqSumCtr_FX" VALUE 0x8002A4B5 Val_Wu8 255.0 DFES_OneToOne 0.00 255.0 /end CHARACTERISTIC
/begin CHARACTERISTIC DFES_FaultTyp.DFC_ComBrkTrqSumTo_FX_C "DFES/Fehlertyp Zuordnung für Prüfung DFC_ComBrkTrqSumTo_FX" VALUE 0x8002A4B6 Val_Wu8 255.0 DFES_OneToOne 0.00 255.0 /end CHARACTERISTIC
/begin CHARACTERISTIC DFES_FaultTyp.DFC_ComBtnDrvDynChk_FX_C "DFES/Fehlertyp Zuordnung für Prüfung DFC_ComBtnDrvDynChk_FX" VALUE 0x8002A4B7 Val_Wu8 255.0 DFES_OneToOne 0.00 255.0 /end CHARACTERISTIC
/begin CHARACTERISTIC DFES_FaultTyp.DFC_ComBtnDrvDynCtr_FX_C "DFES/Fehlertyp Zuordnung für Prüfung DFC_ComBtnDrvDynCtr_FX" VALUE 0x8002A4B8 Val_Wu8 255.0 DFES_OneToOne 0.00 255.0 /end CHARACTERISTIC
/begin CHARACTERISTIC DFES_FaultTyp.DFC_ComBtnDrvDynTo_FX_C "DFES/Fehlertyp Zuordnung für Prüfung DFC_ComBtnDrvDynTo_FX" VALUE 0x8002A4B9 Val_Wu8 255.0 DFES_OneToOne 0.00 255.0 /end CHARACTERISTIC
/begin CHARACTERISTIC DFES_FaultTyp.DFC_ComButtonMSASig_C "DFES/Fehlertyp Zuordnung für Prüfung DFC_ComButtonMSASig" VALUE 0x8002A4BA Val_Wu8 255.0 DFES_OneToOne 0.00 255.0 /end CHARACTERISTIC
/begin CHARACTERISTIC DFES_FaultTyp.DFC_ComButtonMSATo_C "DFES/Fehlertyp Zuordnung für Prüfung DFC_ComButtonMSATo" VALUE 0x8002A4BB Val_Wu8 255.0 DFES_OneToOne 0.00 255.0 /end CHARACTERISTIC
/begin CHARACTERISTIC DFES_FaultTyp.DFC_ComCodierungPwrmngSig_C "DFES/Fehlertyp Zuordnung für Prüfung DFC_ComCodierungPwrmngSig" VALUE 0x8002A4BC Val_Wu8 255.0 DFES_OneToOne 0.00 255.0 /end CHARACTERISTIC
/begin CHARACTERISTIC DFES_FaultTyp.DFC_ComCodierungPwrmngSig_FA_C "DFES/Fehlertyp Zuordnung für Prüfung DFC_ComCodierungPwrmngSig_FA" VALUE 0x8002A4BD Val_Wu8 255.0 DFES_OneToOne 0.00 255.0 /end CHARACTERISTIC
/begin CHARACTERISTIC DFES_FaultTyp.DFC_ComCrCtlLvrChk_C "DFES/Fehlertyp Zuordnung für Prüfung DFC_ComCrCtlLvrChk" VALUE 0x8002A4BE Val_Wu8 255.0 DFES_OneToOne 0.00 255.0 /end CHARACTERISTIC
/begin CHARACTERISTIC DFES_FaultTyp.DFC_ComCrCtlLvrCtr_C "DFES/Fehlertyp Zuordnung für Prüfung DFC_ComCrCtlLvrCtr" VALUE 0x8002A4BF Val_Wu8 255.0 DFES_OneToOne 0.00 255.0 /end CHARACTERISTIC
/begin CHARACTERISTIC DFES_FaultTyp.DFC_ComCrCtlLvrSig_C "DFES/Fehlertyp Zuordnung für Prüfung DFC_ComCrCtlLvrSig" VALUE 0x8002A4C0 Val_Wu8 255.0 DFES_OneToOne 0.00 255.0 /end CHARACTERISTIC
/begin CHARACTERISTIC DFES_FaultTyp.DFC_ComCrCtlLvrTo_C "DFES/Fehlertyp Zuordnung für Prüfung DFC_ComCrCtlLvrTo" VALUE 0x8002A4C1 Val_Wu8 255.0 DFES_OneToOne 0.00 255.0 /end CHARACTERISTIC
/begin CHARACTERISTIC DFES_FaultTyp.DFC_ComCtrCrshSwoEkpSig_FA_C "DFES/Fehlertyp Zuordnung für Prüfung DFC_ComCtrCrshSwoEkpSig_FA" VALUE 0x8002A4C2 Val_Wu8 255.0 DFES_OneToOne 0.00 255.0 /end CHARACTERISTIC
/begin CHARACTERISTIC DFES_FaultTyp.DFC_ComCtrCrshSwoEkpTo_FA_C "DFES/Fehlertyp Zuordnung für Prüfung DFC_ComCtrCrshSwoEkpTo_FA" VALUE 0x8002A4C3 Val_Wu8 255.0 DFES_OneToOne 0.00 255.0 /end CHARACTERISTIC
/begin CHARACTERISTIC DFES_FaultTyp.DFC_ComCtrSecInt_C "DFES/Fehlertyp Zuordnung für Prüfung DFC_ComCtrSecInt" VALUE 0x8002A4C4 Val_Wu8 255.0 DFES_OneToOne 0.00 255.0 /end CHARACTERISTIC
/begin CHARACTERISTIC DFES_FaultTyp.DFC_ComDiaOBDGbxSig_A_C "DFES/Fehlertyp Zuordnung für Prüfung DFC_ComDiaOBDGbxSig_A" VALUE 0x8002A4C5 Val_Wu8 255.0 DFES_OneToOne 0.00 255.0 /end CHARACTERISTIC
/begin CHARACTERISTIC DFES_FaultTyp.DFC_ComDiaOBDGbxTo_A_C "DFES/Fehlertyp Zuordnung für Prüfung DFC_ComDiaOBDGbxTo_A" VALUE 0x8002A4C6 Val_Wu8 255.0 DFES_OneToOne 0.00 255.0 /end CHARACTERISTIC
/begin CHARACTERISTIC DFES_FaultTyp.DFC_ComFahrzeugtypSig_C "DFES/Fehlertyp Zuordnung für Prüfung DFC_ComFahrzeugtypSig" VALUE 0x8002A4C7 Val_Wu8 255.0 DFES_OneToOne 0.00 255.0 /end CHARACTERISTIC
/begin CHARACTERISTIC DFES_FaultTyp.DFC_ComFahrzeugtypSig_FA_C "DFES/Fehlertyp Zuordnung für Prüfung DFC_ComFahrzeugtypSig_FA" VALUE 0x8002A4C8 Val_Wu8 255.0 DFES_OneToOne 0.00 255.0 /end CHARACTERISTIC
/begin CHARACTERISTIC DFES_FaultTyp.DFC_ComFllupGpwsupSig_FA_C "DFES/Fehlertyp Zuordnung für Prüfung DFC_ComFllupGpwsupSig_FA" VALUE 0x8002A4C9 Val_Wu8 255.0 DFES_OneToOne 0.00 255.0 /end CHARACTERISTIC
/begin CHARACTERISTIC DFES_FaultTyp.DFC_ComFllupGpwsupTo_FA_C "DFES/Fehlertyp Zuordnung für Prüfung DFC_ComFllupGpwsupTo_FA" VALUE 0x8002A4CA Val_Wu8 255.0 DFES_OneToOne 0.00 255.0 /end CHARACTERISTIC
/begin CHARACTERISTIC DFES_FaultTyp.DFC_ComGbxDataChk_A_C "DFES/Fehlertyp Zuordnung für Prüfung DFC_ComGbxDataChk_A" VALUE 0x8002A4CB Val_Wu8 255.0 DFES_OneToOne 0.00 255.0 /end CHARACTERISTIC
/begin CHARACTERISTIC DFES_FaultTyp.DFC_ComGbxDataChk_FA_C "DFES/Fehlertyp Zuordnung für Prüfung DFC_ComGbxDataChk_FA" VALUE 0x8002A4CC Val_Wu8 255.0 DFES_OneToOne 0.00 255.0 /end CHARACTERISTIC
/begin CHARACTERISTIC DFES_FaultTyp.DFC_ComGbxDataCtr_A_C "DFES/Fehlertyp Zuordnung für Prüfung DFC_ComGbxDataCtr_A" VALUE 0x8002A4CD Val_Wu8 255.0 DFES_OneToOne 0.00 255.0 /end CHARACTERISTIC
/begin CHARACTERISTIC DFES_FaultTyp.DFC_ComGbxDataCtr_FA_C "DFES/Fehlertyp Zuordnung für Prüfung DFC_ComGbxDataCtr_FA" VALUE 0x8002A4CE Val_Wu8 255.0 DFES_OneToOne 0.00 255.0 /end CHARACTERISTIC
/begin CHARACTERISTIC DFES_FaultTyp.DFC_ComGbxDataSig_A_C "DFES/Fehlertyp Zuordnung für Prüfung DFC_ComGbxDataSig_A" VALUE 0x8002A4CF Val_Wu8 255.0 DFES_OneToOne 0.00 255.0 /end CHARACTERISTIC
/begin CHARACTERISTIC DFES_FaultTyp.DFC_ComGbxDataSig_FA_C "DFES/Fehlertyp Zuordnung für Prüfung DFC_ComGbxDataSig_FA" VALUE 0x8002A4D0 Val_Wu8 255.0 DFES_OneToOne 0.00 255.0 /end CHARACTERISTIC
/begin CHARACTERISTIC DFES_FaultTyp.DFC_ComGbxDataTo_A_C "DFES/Fehlertyp Zuordnung für Prüfung DFC_ComGbxDataTo_A" VALUE 0x8002A4D1 Val_Wu8 255.0 DFES_OneToOne 0.00 255.0 /end CHARACTERISTIC
/begin CHARACTERISTIC DFES_FaultTyp.DFC_ComGbxDataTo_FA_C "DFES/Fehlertyp Zuordnung für Prüfung DFC_ComGbxDataTo_FA" VALUE 0x8002A4D2 Val_Wu8 255.0 DFES_OneToOne 0.00 255.0 /end CHARACTERISTIC
/begin CHARACTERISTIC DFES_FaultTyp.DFC_ComKlemmenChk_FA_C "DFES/Fehlertyp Zuordnung für Prüfung DFC_ComKlemmenChk_FA" VALUE 0x8002A4D3 Val_Wu8 255.0 DFES_OneToOne 0.00 255.0 /end CHARACTERISTIC
/begin CHARACTERISTIC DFES_FaultTyp.DFC_ComKlemmenCtr_FA_C "DFES/Fehlertyp Zuordnung für Prüfung DFC_ComKlemmenCtr_FA" VALUE 0x8002A4D4 Val_Wu8 255.0 DFES_OneToOne 0.00 255.0 /end CHARACTERISTIC
/begin CHARACTERISTIC DFES_FaultTyp.DFC_ComKlemmenSig_FA_C "DFES/Fehlertyp Zuordnung für Prüfung DFC_ComKlemmenSig_FA" VALUE 0x8002A4D5 Val_Wu8 255.0 DFES_OneToOne 0.00 255.0 /end CHARACTERISTIC
/begin CHARACTERISTIC DFES_FaultTyp.DFC_ComKlemmenTo_FA_C "DFES/Fehlertyp Zuordnung für Prüfung DFC_ComKlemmenTo_FA" VALUE 0x8002A4D6 Val_Wu8 255.0 DFES_OneToOne 0.00 255.0 /end CHARACTERISTIC
/begin CHARACTERISTIC DFES_FaultTyp.DFC_ComLenkradwinkelSig_C "DFES/Fehlertyp Zuordnung für Prüfung DFC_ComLenkradwinkelSig" VALUE 0x8002A4D7 Val_Wu8 255.0 DFES_OneToOne 0.00 255.0 /end CHARACTERISTIC
/begin CHARACTERISTIC DFES_FaultTyp.DFC_ComLenkradwinkelTo_C "DFES/Fehlertyp Zuordnung für Prüfung DFC_ComLenkradwinkelTo" VALUE 0x8002A4D8 Val_Wu8 255.0 DFES_OneToOne 0.00 255.0 /end CHARACTERISTIC
/begin CHARACTERISTIC DFES_FaultTyp.DFC_ComMileageRangeSig_FA_C "DFES/Fehlertyp Zuordnung für Prüfung DFC_ComMileageRangeSig_FA" VALUE 0x8002A4D9 Val_Wu8 255.0 DFES_OneToOne 0.00 255.0 /end CHARACTERISTIC
/begin CHARACTERISTIC DFES_FaultTyp.DFC_ComMileageRangeTo_FA_C "DFES/Fehlertyp Zuordnung für Prüfung DFC_ComMileageRangeTo_FA" VALUE 0x8002A4DA Val_Wu8 255.0 DFES_OneToOne 0.00 255.0 /end CHARACTERISTIC
/begin CHARACTERISTIC DFES_FaultTyp.DFC_ComPspSig_C "DFES/Fehlertyp Zuordnung für Prüfung DFC_ComPspSig" VALUE 0x8002A4DB Val_Wu8 255.0 DFES_OneToOne 0.00 255.0 /end CHARACTERISTIC
/begin CHARACTERISTIC DFES_FaultTyp.DFC_ComPspTo_C "DFES/Fehlertyp Zuordnung für Prüfung DFC_ComPspTo" VALUE 0x8002A4DC Val_Wu8 255.0 DFES_OneToOne 0.00 255.0 /end CHARACTERISTIC
/begin CHARACTERISTIC DFES_FaultTyp.DFC_ComRelTimeSig_FA_C "DFES/Fehlertyp Zuordnung für Prüfung DFC_ComRelTimeSig_FA" VALUE 0x8002A4DD Val_Wu8 255.0 DFES_OneToOne 0.00 255.0 /end CHARACTERISTIC
/begin CHARACTERISTIC DFES_FaultTyp.DFC_ComRelTimeTo_FA_C "DFES/Fehlertyp Zuordnung für Prüfung DFC_ComRelTimeTo_FA" VALUE 0x8002A4DE Val_Wu8 255.0 DFES_OneToOne 0.00 255.0 /end CHARACTERISTIC
/begin CHARACTERISTIC DFES_FaultTyp.DFC_ComRequestEMFChk_C "DFES/Fehlertyp Zuordnung für Prüfung DFC_ComRequestEMFChk" VALUE 0x8002A4DF Val_Wu8 255.0 DFES_OneToOne 0.00 255.0 /end CHARACTERISTIC
/begin CHARACTERISTIC DFES_FaultTyp.DFC_ComRequestEMFCtr_C "DFES/Fehlertyp Zuordnung für Prüfung DFC_ComRequestEMFCtr" VALUE 0x8002A4E0 Val_Wu8 255.0 DFES_OneToOne 0.00 255.0 /end CHARACTERISTIC
/begin CHARACTERISTIC DFES_FaultTyp.DFC_ComRequestEMFSig_C "DFES/Fehlertyp Zuordnung für Prüfung DFC_ComRequestEMFSig" VALUE 0x8002A4E1 Val_Wu8 255.0 DFES_OneToOne 0.00 255.0 /end CHARACTERISTIC
/begin CHARACTERISTIC DFES_FaultTyp.DFC_ComRequestEMFTo_C "DFES/Fehlertyp Zuordnung für Prüfung DFC_ComRequestEMFTo" VALUE 0x8002A4E2 Val_Wu8 255.0 DFES_OneToOne 0.00 255.0 /end CHARACTERISTIC
/begin CHARACTERISTIC DFES_FaultTyp.DFC_ComRpmWhlChk_FX_C "DFES/Fehlertyp Zuordnung für Prüfung DFC_ComRpmWhlChk_FX" VALUE 0x8002A4E3 Val_Wu8 255.0 DFES_OneToOne 0.00 255.0 /end CHARACTERISTIC
/begin CHARACTERISTIC DFES_FaultTyp.DFC_ComRpmWhlCtr_FX_C "DFES/Fehlertyp Zuordnung für Prüfung DFC_ComRpmWhlCtr_FX" VALUE 0x8002A4E4 Val_Wu8 255.0 DFES_OneToOne 0.00 255.0 /end CHARACTERISTIC
/begin CHARACTERISTIC DFES_FaultTyp.DFC_ComRpmWhlTo_FX_C "DFES/Fehlertyp Zuordnung für Prüfung DFC_ComRpmWhlTo_FX" VALUE 0x8002A4E5 Val_Wu8 255.0 DFES_OneToOne 0.00 255.0 /end CHARACTERISTIC
/begin CHARACTERISTIC DFES_FaultTyp.DFC_ComSecCtrRelSig_FA_C "DFES/Fehlertyp Zuordnung für Prüfung DFC_ComSecCtrRelSig_FA" VALUE 0x8002A4E6 Val_Wu8 255.0 DFES_OneToOne 0.00 255.0 /end CHARACTERISTIC
/begin CHARACTERISTIC DFES_FaultTyp.DFC_ComSecCtrRelTo_FA_C "DFES/Fehlertyp Zuordnung für Prüfung DFC_ComSecCtrRelTo_FA" VALUE 0x8002A4E7 Val_Wu8 255.0 DFES_OneToOne 0.00 255.0 /end CHARACTERISTIC
/begin CHARACTERISTIC DFES_FaultTyp.DFC_ComSensNOxGndSig_C "DFES/Fehlertyp Zuordnung für Prüfung DFC_ComSensNOxGndSig" VALUE 0x8002A4E8 Val_Wu8 255.0 DFES_OneToOne 0.00 255.0 /end CHARACTERISTIC
/begin CHARACTERISTIC DFES_FaultTyp.DFC_ComSensNOxGndTo_C "DFES/Fehlertyp Zuordnung für Prüfung DFC_ComSensNOxGndTo" VALUE 0x8002A4E9 Val_Wu8 255.0 DFES_OneToOne 0.00 255.0 /end CHARACTERISTIC
/begin CHARACTERISTIC DFES_FaultTyp.DFC_ComSensNOxMode_C "DFES/Fehlertyp Zuordnung für Prüfung DFC_ComSensNOxMode" VALUE 0x8002A4EA Val_Wu8 255.0 DFES_OneToOne 0.00 255.0 /end CHARACTERISTIC
/begin CHARACTERISTIC DFES_FaultTyp.DFC_ComSensNOxUbattSig_C "DFES/Fehlertyp Zuordnung für Prüfung DFC_ComSensNOxUbattSig" VALUE 0x8002A4EB Val_Wu8 255.0 DFES_OneToOne 0.00 255.0 /end CHARACTERISTIC
/begin CHARACTERISTIC DFES_FaultTyp.DFC_ComSensNOxUbattTo_C "DFES/Fehlertyp Zuordnung für Prüfung DFC_ComSensNOxUbattTo" VALUE 0x8002A4EC Val_Wu8 255.0 DFES_OneToOne 0.00 255.0 /end CHARACTERISTIC
/begin CHARACTERISTIC DFES_FaultTyp.DFC_ComShiftPaddleTo_FX_C "DFES/Fehlertyp Zuordnung für Prüfung DFC_ComShiftPaddleTo_FX" VALUE 0x8002A4ED Val_Wu8 255.0 DFES_OneToOne 0.00 255.0 /end CHARACTERISTIC
/begin CHARACTERISTIC DFES_FaultTyp.DFC_ComShutOffPSPSig_C "DFES/Fehlertyp Zuordnung für Prüfung DFC_ComShutOffPSPSig" VALUE 0x8002A4EE Val_Wu8 255.0 DFES_OneToOne 0.00 255.0 /end CHARACTERISTIC
/begin CHARACTERISTIC DFES_FaultTyp.DFC_ComShutOffPSPTo_C "DFES/Fehlertyp Zuordnung für Prüfung DFC_ComShutOffPSPTo" VALUE 0x8002A4EF Val_Wu8 255.0 DFES_OneToOne 0.00 255.0 /end CHARACTERISTIC
/begin CHARACTERISTIC DFES_FaultTyp.DFC_ComSlrdiGlbFZMTo_FA_C "DFES/Fehlertyp Zuordnung für Prüfung DFC_ComSlrdiGlbFZMTo_FA" VALUE 0x8002A4F0 Val_Wu8 255.0 DFES_OneToOne 0.00 255.0 /end CHARACTERISTIC
/begin CHARACTERISTIC DFES_FaultTyp.DFC_ComSlrdiGlbFZMTo_FX_C "DFES/Fehlertyp Zuordnung für Prüfung DFC_ComSlrdiGlbFZMTo_FX" VALUE 0x8002A4F1 Val_Wu8 255.0 DFES_OneToOne 0.00 255.0 /end CHARACTERISTIC
/begin CHARACTERISTIC DFES_FaultTyp.DFC_ComSpeedVehicleChk_FX_C "DFES/Fehlertyp Zuordnung für Prüfung DFC_ComSpeedVehicleChk_FX" VALUE 0x8002A4F2 Val_Wu8 255.0 DFES_OneToOne 0.00 255.0 /end CHARACTERISTIC
/begin CHARACTERISTIC DFES_FaultTyp.DFC_ComSpeedVehicleCtr_FX_C "DFES/Fehlertyp Zuordnung für Prüfung DFC_ComSpeedVehicleCtr_FX" VALUE 0x8002A4F3 Val_Wu8 255.0 DFES_OneToOne 0.00 255.0 /end CHARACTERISTIC
/begin FUNCTION DFES ""
 /begin DEF_CHARACTERISTIC DFES_EnvRef.DFC_GlwEcuGndErr_C DFES_EnvRef.DFC_GlwEcuIntErr_C DFES_EnvRef.DFC_GlwEcuMsgTimeout_C DFES_EnvRef.DFC_GlwEcuT30Err_C DFES_EnvRef.DFC_GlwEcuTempErr_C DFES_EnvRef.DFC_GlwEcuUdiffT30_C DFES_EnvRef.DFC_IBSComErr_C DFES_EnvRef.DFC_LubSRCOilFldtCrit_C DFES_EnvRef.DFC_LubSRCOilFldtCritDflMin_C DFES_EnvRef.DFC_LubSRCOilLvlCritMax_C DFES_EnvRef.DFC_LubSRCOilLvlCritMin_C DFES_EnvRef.DFC_LubSRCTot_C DFES_EnvRef.DFC_MonUMaxSupply1_C DFES_EnvRef.DFC_MonUMinSupply1_C DFES_EnvRef.DFC_OilComNpl_C DFES_EnvRef.DFC_PCBS_C DFES_EnvRef.DFC_PCBSPFltChg_C DFES_EnvRef.DFC_PCRGovDvtLPMax_C DFES_EnvRef.DFC_PCRGovDvtLPMin_C DFES_EnvRef.DFC_PCRGovDvtMax_C DFES_EnvRef.DFC_PCRGovDvtMin_C DFES_EnvRef.DFC_PFltAPSPlausMAX_C DFES_EnvRef.DFC_PFltAPSPlausMIN_C DFES_EnvRef.DFC_PFltBPSPlausMAX_C DFES_EnvRef.DFC_PFltBPSPlausMIN_C DFES_EnvRef.DFC_PFltOvldInhRgn_C DFES_EnvRef.DFC_PFltOvldTrqLim_C DFES_EnvRef.DFC_PFltPresPlausMAX_C DFES_EnvRef.DFC_PFltPresPlausMIN_C DFES_EnvRef.DFC_PFltTraRpmRdc_C DFES_EnvRef.DFC_PFlt_tOxiPreMax_C DFES_EnvRef.DFC_PFlt_tOxiPreMaxRgn_C DFES_EnvRef.DFC_PFlt_tOxiPreNpl_C DFES_EnvRef.DFC_PFlt_tPreMax_C DFES_EnvRef.DFC_PFlt_tPreMaxRgn_C DFES_EnvRef.DFC_PFlt_tPreNpl_C DFES_EnvRef.DFC_PFltmSotDiffMAX_C DFES_EnvRef.DFC_PFltmSotDiffMIN_C DFES_EnvRef.DFC_PFltmSotDiffSIG_C DFES_EnvRef.DFC_PIntkVUsEnvPPls_C DFES_EnvRef.DFC_PresPlausDblDef_C DFES_EnvRef.DFC_RailCPC1_C DFES_EnvRef.DFC_RailCPC3_C DFES_EnvRef.DFC_RailCPC4_C DFES_EnvRef.DFC_RailMeUn0_C DFES_EnvRef.DFC_RailMeUn1_C DFES_EnvRef.DFC_RailMeUn2_C DFES_EnvRef.DFC_RailMeUn22_C DFES_EnvRef.DFC_RailMeUn3_C DFES_EnvRef.DFC_RailMeUn4_C DFES_EnvRef.DFC_RailMeUn42_C DFES_EnvRef.DFC_RailMeUn5_C DFES_EnvRef.DFC_RailPCV0_C DFES_EnvRef.DFC_RailPCV1_C DFES_EnvRef.DFC_RailPCV2_C DFES_EnvRef.DFC_RailPCV22_C DFES_EnvRef.DFC_RailPCV3_C DFES_EnvRef.DFC_RailPCV4_C DFES_EnvRef.DFC_RailPCV42_C DFES_EnvRef.DFC_RailPMonStrt_C DFES_EnvRef.DFC_SSpMon1_C DFES_EnvRef.DFC_SSpMon2_C DFES_EnvRef.DFC_SSpMon3_C DFES_EnvRef.DFC_ThrVlv4WinErr1_C DFES_EnvRef.DFC_ThrVlv4WinErr2_C DFES_EnvRef.DFC_ThrVlv4WinErr3_C DFES_EnvRef.DFC_ThrVlv4WinErr4_C DFES_EnvRef.DFC_ThrVlvSCG_C DFES_EnvRef.DFC_Tle6232Spi1_C DFES_EnvRef.DFC_TrbCh4WinErr1_C DFES_EnvRef.DFC_TrbCh4WinErr2_C DFES_EnvRef.DFC_TrbCh4WinErr3_C DFES_EnvRef.DFC_TrbCh4WinErr4_C DFES_EnvRef.DFC_TrbChSCG_C DFES_EnvRef.DFC_TrbChSRCMax_C DFES_EnvRef.DFC_TrbChSRCMin_C DFES_EnvRef.DFC_WaHtEl4WinErr1_C DFES_EnvRef.DFC_WaHtEl4WinErr2_C DFES_EnvRef.DFC_WaHtEl4WinErr3_C DFES_EnvRef.DFC_WaHtEl4WinErr4_C DFES_EnvRef.DFC_WaHtElSCG_C DFES_EnvRef.DFC_ETClbETFltMax_0_C DFES_EnvRef.DFC_ETClbETFltMax_1_C DFES_EnvRef.DFC_ETClbETFltMax_2_C DFES_EnvRef.DFC_ETClbETFltMax_3_C DFES_EnvRef.DFC_ETClbETFltMax_4_C DFES_EnvRef.DFC_ETClbETFltMax_5_C DFES_EnvRef.DFC_ETClbETFltMin_0_C DFES_EnvRef.DFC_ETClbETFltMin_1_C DFES_EnvRef.DFC_ETClbETFltMin_2_C DFES_EnvRef.DFC_ETClbETFltMin_3_C DFES_EnvRef.DFC_ETClbETFltMin_4_C DFES_EnvRef.DFC_ETClbETFltMin_5_C DFES_EnvRef.DFC_InjCrvInjLimChrgBal_C DFES_EnvRef.DFC_InjCrvInjLimQntBal_C DFES_EnvRef.DFC_InjCrvInjLimSys_C DFES_EnvRef.DFC_InjCrvNumInjRtmLim_C DFES_EnvRef.DFC_LSUHtCoupSig_C DFES_EnvRef.DFC_AFS_SSpShOffOL_C DFES_EnvRef.DFC_AFS_SSpShOffOvrTemp_C DFES_EnvRef.DFC_AFS_SSpShOffSCB_C DFES_EnvRef.DFC_AFS_SSpShOffSCG_C DFES_EnvRef.DFC_AirCCmprOL_C DFES_EnvRef.DFC_AirCCmprOvrTemp_C DFES_EnvRef.DFC_AirCCmprSCB_C DFES_EnvRef.DFC_AirCCmprSCG_C DFES_EnvRef.DFC_CByVlvOL_C DFES_EnvRef.DFC_CByVlvOvrTemp_C DFES_EnvRef.DFC_CByVlvSCB_C DFES_EnvRef.DFC_CByVlvSCG_C DFES_EnvRef.DFC_CThmstOL_C DFES_EnvRef.DFC_CThmstOvrTemp_C DFES_EnvRef.DFC_CThmstSCB_C DFES_EnvRef.DFC_CThmstSCG_C DFES_EnvRef.DFC_DSMDummy_C DFES_EnvRef.DFC_EBxFanOL_C DFES_EnvRef.DFC_EBxFanOvrTemp_C DFES_EnvRef.DFC_EBxFanSCB_C DFES_EnvRef.DFC_EBxFanSCG_C DFES_EnvRef.DFC_ECBVlvOL_C DFES_EnvRef.DFC_ECBVlvOvrTemp_C DFES_EnvRef.DFC_ECBVlvSCB_C DFES_EnvRef.DFC_ECBVlvSCG_C DFES_EnvRef.DFC_EMDmpOL_0_C DFES_EnvRef.DFC_EMDmpOL_1_C DFES_EnvRef.DFC_EMDmpOvrTemp_0_C DFES_EnvRef.DFC_EMDmpOvrTemp_1_C DFES_EnvRef.DFC_EMDmpSCB_0_C DFES_EnvRef.DFC_EMDmpSCB_1_C DFES_EnvRef.DFC_EMDmpSCG_0_C DFES_EnvRef.DFC_EMDmpSCG_1_C DFES_EnvRef.DFC_EngStAOL_C DFES_EnvRef.DFC_EngStAOvrTemp_C DFES_EnvRef.DFC_EngStASCB_C DFES_EnvRef.DFC_EngStASCG_C DFES_EnvRef.DFC_FanOL_C DFES_EnvRef.DFC_FanOvrTemp_C DFES_EnvRef.DFC_FanSCB_C DFES_EnvRef.DFC_FlFltHtOL_C DFES_EnvRef.DFC_FlFltHtOvrTemp_C DFES_EnvRef.DFC_FlFltHtSCB_C DFES_EnvRef.DFC_FlFltHtSCG_C DFES_EnvRef.DFC_LSUHtrMax_C DFES_EnvRef.DFC_LSUHtrMin_C DFES_EnvRef.DFC_LSUHtrNpl_C DFES_EnvRef.DFC_LSUHtrSig_C DFES_EnvRef.DFC_LSUtExcMax_C DFES_EnvRef.DFC_LSUtExcMin_C DFES_EnvRef.DFC_MeUnOL_C DFES_EnvRef.DFC_MeUnSCB_C DFES_EnvRef.DFC_MeUnSRCMax_C DFES_EnvRef.DFC_MeUnSRCMin_C DFES_EnvRef.DFC_PCVOL_C DFES_EnvRef.DFC_PCVSCB_C DFES_EnvRef.DFC_PCVSRCMax_C DFES_EnvRef.DFC_PCVSRCMin_C DFES_EnvRef.DFC_RailPSRCMax_C DFES_EnvRef.DFC_RailPSRCMin_C DFES_EnvRef.DFC_ShtrOL_C DFES_EnvRef.DFC_ShtrOvrTemp_C DFES_EnvRef.DFC_ShtrSCB_C DFES_EnvRef.DFC_ShtrSCG_C DFES_EnvRef.DFC_StrtOL_C DFES_EnvRef.DFC_StrtOvrTemp_C DFES_EnvRef.DFC_StrtSCB_C DFES_EnvRef.DFC_StrtSCG_C DFES_EnvRef.DFC_ThrVlvOL_C DFES_EnvRef.DFC_ThrVlvOvrTemp_C DFES_EnvRef.DFC_ThrVlvSCB_C DFES_EnvRef.DFC_TrbChOL_C DFES_EnvRef.DFC_TrbChOvrTemp_C DFES_EnvRef.DFC_TrbChSCB_C DFES_EnvRef.DFC_UDosVlvOL_C DFES_EnvRef.DFC_UDosVlvOvrTemp_C DFES_EnvRef.DFC_UDosVlvSCB_C DFES_EnvRef.DFC_UDosVlvSCG_C DFES_EnvRef.DFC_UPmpMotOL_C DFES_EnvRef.DFC_UPmpMotOvrTemp_C DFES_EnvRef.DFC_UPmpMotSCB_C DFES_EnvRef.DFC_UPmpMotSCG_C DFES_EnvRef.DFC_WaHtElOL_C DFES_EnvRef.DFC_WaHtElOvrTemp_C DFES_EnvRef.DFC_WaHtElSCB_C DFES_EnvRef.DFC_IVActrUChSRCMax_C DFES_EnvRef.DFC_IVActrUChSRCMin_C DFES_EnvRef.DFC_IVActrVltgSRCMax_C DFES_EnvRef.DFC_IVActrVltgSRCMin_C DFES_EnvRef.DFC_IVDiaTunDet_C DFES_EnvRef.DFC_IVPSplyStopDCDC_C DFES_EnvRef.DFC_IVPSplyVltgSRCMax_C DFES_EnvRef.DFC_IVPSplyVltgSRCMin_C DFES_EnvRef.DFC_SCREtaErr_C DFES_EnvRef.DFC_SCREtaErr1_C DFES_EnvRef.DFC_SCREtaErr2_C DFES_EnvRef.DFC_SCRMonMetCtlPresErr_C DFES_EnvRef.DFC_SCRMonPresBuildUpErr_C DFES_EnvRef.DFC_SCRMonPresRdcErr_C DFES_EnvRef.DFC_AFSOffsDrftMax_C DFES_EnvRef.DFC_AFSOffsDrftMin_C DFES_EnvRef.DFC_AFSSRCCorMax_C DFES_EnvRef.DFC_AFSSRCCorMin_C DFES_EnvRef.DFC_AFSSRCRawMax_C DFES_EnvRef.DFC_AFSSRCRawMin_C DFES_EnvRef.DFC_AFSSetyDrftMax_C DFES_EnvRef.DFC_AFSSetyDrftMin_C DFES_EnvRef.DFC_AirCSwtNpl_C DFES_EnvRef.DFC_AirCSwtSig_C DFES_EnvRef.DFC_BattUSRCMax_C DFES_EnvRef.DFC_BattUSRCMin_C DFES_EnvRef.DFC_BrkNpl_C DFES_EnvRef.DFC_BrkPSRCMax_C DFES_EnvRef.DFC_BrkPSRCMin_C DFES_EnvRef.DFC_CEngDsTSRCMax_C DFES_EnvRef.DFC_CEngDsTSRCMin_C DFES_EnvRef.DFC_CrCUIDet_C DFES_EnvRef.DFC_ECBVlvSRCMax_C DFES_EnvRef.DFC_ECBVlvSRCMin_C DFES_EnvRef.DFC_ECUOvrTemp_C DFES_EnvRef.DFC_EGRVlvGovDvtMax_C DFES_EnvRef.DFC_EGRVlvGovDvtMin_C DFES_EnvRef.DFC_EGRVlvHBrgOpnLd_C DFES_EnvRef.DFC_EGRVlvHBrgOvrCurr_C DFES_EnvRef.DFC_EGRVlvHBrgOvrTemp_C DFES_EnvRef.DFC_EGRVlvHBrgShCirBatt1_C DFES_EnvRef.DFC_EGRVlvHBrgShCirBatt2_C DFES_EnvRef.DFC_EGRVlvHBrgShCirGnd1_C DFES_EnvRef.DFC_EGRVlvHBrgShCirGnd2_C DFES_EnvRef.DFC_EGRVlvHBrgShCirOvrLd_C DFES_EnvRef.DFC_EGRVlvHBrgTempOvrCurr_C DFES_EnvRef.DFC_EGRVlvHBrgUndrVltg_C DFES_EnvRef.DFC_EGRVlvLPGovDvtMax_C DFES_EnvRef.DFC_EGRVlvLPGovDvtMin_C DFES_EnvRef.DFC_EGRVlvLPHBrgOpnLd_C DFES_EnvRef.DFC_EGRVlvLPHBrgOvrCurr_C DFES_EnvRef.DFC_EGRVlvLPHBrgOvrTemp_C DFES_EnvRef.DFC_EGRVlvLPHBrgShCirBatt1_C DFES_EnvRef.DFC_EGRVlvLPHBrgShCirBatt2_C DFES_EnvRef.DFC_EGRVlvLPHBrgShCirGnd1_C DFES_EnvRef.DFC_EGRVlvLPHBrgShCirGnd2_C DFES_EnvRef.DFC_EGRVlvLPHBrgShCirOvrLd_C DFES_EnvRef.DFC_EGRVlvLPHBrgTempOvrCurr_C DFES_EnvRef.DFC_EGRVlvLPHBrgUndrVltg_C DFES_EnvRef.DFC_EGRVlvLPOL_C DFES_EnvRef.DFC_EGRVlvLPSCB_C DFES_EnvRef.DFC_EGRVlvLPSCG_C DFES_EnvRef.DFC_EGRVlvLPSRCMax_C DFES_EnvRef.DFC_EGRVlvLPSRCMin_C DFES_EnvRef.DFC_EGRVlvOL_C DFES_EnvRef.DFC_EGRVlvSCB_C DFES_EnvRef.DFC_EGRVlvSCG_C DFES_EnvRef.DFC_EGRVlvSRCMax_C DFES_EnvRef.DFC_EGRVlvSRCMin_C DFES_EnvRef.DFC_EngPrtOvrSpd_C DFES_EnvRef.DFC_EngSpdOL_C DFES_EnvRef.DFC_EngSpdSCB_C DFES_EnvRef.DFC_EngSpdSCG_C DFES_EnvRef.DFC_EnhSRCMaxPPFltDiff_C DFES_EnvRef.DFC_EnhSRCMaxT1ExhTMon_C DFES_EnvRef.DFC_EnhSRCMaxT2ExhTMon_C DFES_EnvRef.DFC_EnhSRCMaxT3ExhTMon_C DFES_EnvRef.DFC_EnhSRCMinPPFltDiff_C DFES_EnvRef.DFC_EnhSRCMinT1ExhTMon_C DFES_EnvRef.DFC_EnhSRCMinT2ExhTMon_C DFES_EnvRef.DFC_EnhSRCMinT3ExhTMon_C DFES_EnvRef.DFC_EnvPSRCMax_C DFES_EnvRef.DFC_EnvPSRCMin_C DFES_EnvRef.DFC_ExhTMonPlaus_C DFES_EnvRef.DFC_ExhTMonPlausPos1_C DFES_EnvRef.DFC_ExhTMonPlausPos2_C DFES_EnvRef.DFC_ExhTMonPlausPos3_C DFES_EnvRef.DFC_ExhTMonT1Plaus_C DFES_EnvRef.DFC_ExhTMonT2Plaus_C DFES_EnvRef.DFC_ExhTMonT3Plaus_C DFES_EnvRef.DFC_FlFltDsPSRCMax_C DFES_EnvRef.DFC_FlFltDsPSRCMin_C DFES_EnvRef.DFC_FlFltSig_C DFES_EnvRef.DFC_FlFltUsPSRCMax_C DFES_EnvRef.DFC_FlFltUsPSRCMin_C DFES_EnvRef.DFC_FuelTSRCMax_C DFES_EnvRef.DFC_FuelTSRCMin_C DFES_EnvRef.DFC_GbxNPosPPerSRCMax_C DFES_EnvRef.DFC_GbxNPosPPerSRCMin_C DFES_EnvRef.DFC_GbxNPosPdcycSRCMax_C DFES_EnvRef.DFC_GbxNPosPdcycSRCMin_C DFES_EnvRef.DFC_InjVlvPresMin_C DFES_EnvRef.DFC_LSUCircNernstSig_C DFES_EnvRef.DFC_LSUCircPmpCurSig_C DFES_EnvRef.DFC_LSUCircVirtGndSig_C DFES_EnvRef.DFC_LSUO2Max_C DFES_EnvRef.DFC_LSUO2Min_C DFES_EnvRef.DFC_LSUSPIBattLowMin_C DFES_EnvRef.DFC_LSUWireSCB_C DFES_EnvRef.DFC_LSUWireSCG_C DFES_EnvRef.DFC_MeUnSCG_C DFES_EnvRef.DFC_NSCDsCmpChk_C DFES_EnvRef.DFC_NSCDsLamBinSRCMax_C DFES_EnvRef.DFC_NSCDsLamBinSRCMin_C DFES_EnvRef.DFC_NSCDsLamLinSRCMax_C DFES_EnvRef.DFC_NSCDsLamLinSRCMin_C DFES_EnvRef.DFC_NSCDsLamPlausMax_C DFES_EnvRef.DFC_NSCDsLamPlausMin_C DFES_EnvRef.DFC_NSCDsNOxSRCMax_C DFES_EnvRef.DFC_NSCDsNOxSRCMin_C DFES_EnvRef.DFC_NSCDsOpCir_C DFES_EnvRef.DFC_NSCDsShCir_C DFES_EnvRef.DFC_NoCat2DsCmpChk_C DFES_EnvRef.DFC_NoCat2DsLamBinSRCMax_C DFES_EnvRef.DFC_NoCat2DsLamBinSRCMin_C DFES_EnvRef.DFC_NoCat2DsLamLinSRCMax_C DFES_EnvRef.DFC_NoCat2DsLamLinSRCMin_C DFES_EnvRef.DFC_NoCat2DsLamPlausMax_C DFES_EnvRef.DFC_NoCat2DsLamPlausMin_C DFES_EnvRef.DFC_NoCat2DsNOxSRCMax_C DFES_EnvRef.DFC_NoCat2DsNOxSRCMin_C DFES_EnvRef.DFC_NoCat2DsOpCir_C DFES_EnvRef.DFC_NoCat2DsShCir_C DFES_EnvRef.DFC_NplDynPPFltDiff_C DFES_EnvRef.DFC_NplHsChngPPFltDiff_C DFES_EnvRef.DFC_NplHsLnPPFltDiff_C DFES_EnvRef.DFC_NplTOxiCatUs_C DFES_EnvRef.DFC_NplTPFltUs_C DFES_EnvRef.DFC_NplTTrbnUs_C DFES_EnvRef.DFC_OilPSwmpSRCMax_C DFES_EnvRef.DFC_OilPSwmpSRCMin_C DFES_EnvRef.DFC_PCVSCG_C DFES_EnvRef.DFC_PFltCharPDiffMin_C DFES_EnvRef.DFC_PFltDstrMin_C DFES_EnvRef.DFC_PFltEngPrt_C DFES_EnvRef.DFC_PFltRgnPerm_C DFES_EnvRef.DFC_PFltSRCMaxFlwRstn_C DFES_EnvRef.DFC_PFltSRCMinFlwRstn_C DFES_EnvRef.DFC_PFltSotMsDvtMax_C DFES_EnvRef.DFC_PFltSotMsDvtMin_C DFES_EnvRef.DFC_PFltSotMsMax_C DFES_EnvRef.DFC_PIntkVUsSRCMax_C DFES_EnvRef.DFC_PIntkVUsSRCMin_C DFES_EnvRef.DFC_SRCHighAPP1_C DFES_EnvRef.DFC_SRCHighAPP2_C DFES_EnvRef.DFC_SRCLowAPP1_C DFES_EnvRef.DFC_SRCLowAPP2_C DFES_EnvRef.DFC_SRCMaxPPFltDiff_C DFES_EnvRef.DFC_SRCMaxPPFltUs_C DFES_EnvRef.DFC_SRCMaxTECU_C DFES_EnvRef.DFC_SRCMaxTOxiCatUs_C DFES_EnvRef.DFC_SRCMaxTPFltUs_C DFES_EnvRef.DFC_SRCMaxTTrbnUs_C DFES_EnvRef.DFC_SRCMaxUCatUsT_C DFES_EnvRef.DFC_SRCMaxUPmpP_C DFES_EnvRef.DFC_SRCMinPPFltDiff_C DFES_EnvRef.DFC_SRCMinPPFltUs_C DFES_EnvRef.DFC_SRCMinTECU_C DFES_EnvRef.DFC_SRCMinTOxiCatUs_C DFES_EnvRef.DFC_SRCMinTPFltUs_C DFES_EnvRef.DFC_SRCMinTTrbnUs_C DFES_EnvRef.DFC_SRCMinUCatUsT_C DFES_EnvRef.DFC_SRCMinUPmpP_C DFES_EnvRef.DFC_SigUCatUsT_C DFES_EnvRef.DFC_SigUPmpP_C DFES_EnvRef.DFC_SyncAPP_C DFES_EnvRef.DFC_T15Npl_C DFES_EnvRef.DFC_TAFSDtyCycHi_C DFES_EnvRef.DFC_TAFSDtyCycLo_C DFES_EnvRef.DFC_TAFSPerHi_C DFES_EnvRef.DFC_TAFSPerLo_C DFES_EnvRef.DFC_TCACDsSRCMax_C DFES_EnvRef.DFC_TCACDsSRCMin_C DFES_EnvRef.DFC_ThrVlvSRCMax_C DFES_EnvRef.DFC_ThrVlvSRCMin_C DFES_EnvRef.DFC_TrbChLPOL_C DFES_EnvRef.DFC_TrbChLPSCB_C DFES_EnvRef.DFC_TrbChLPSCG_C DFES_EnvRef.DFC_UHtrPLOL_C DFES_EnvRef.DFC_UHtrPLSCB_C DFES_EnvRef.DFC_UHtrPLSCG_C DFES_EnvRef.DFC_UHtrPLSRCMaxDia_C DFES_EnvRef.DFC_UHtrPLSRCMinDia_C DFES_EnvRef.DFC_UHtrTnkOL_C DFES_EnvRef.DFC_UHtrTnkSCB_C DFES_EnvRef.DFC_UHtrTnkSCG_C DFES_EnvRef.DFC_UHtrTnkSRCMaxDia_C DFES_EnvRef.DFC_UHtrTnkSRCMinDia_C DFES_EnvRef.DFC_URevVlvOL_C DFES_EnvRef.DFC_URevVlvSCB_C DFES_EnvRef.DFC_URevVlvSCG_C DFES_EnvRef.DFC_UTnkTSRCMax_C DFES_EnvRef.DFC_UTnkTSRCMin_C DFES_EnvRef.DFC_UTnkTSig_C DFES_EnvRef.DFC_VSwVlvGovDvtMax_C DFES_EnvRef.DFC_VSwVlvGovDvtMin_C DFES_EnvRef.DFC_VSwVlvHBrgOpnLd_C DFES_EnvRef.DFC_VSwVlvHBrgOvrCurr_C DFES_EnvRef.DFC_VSwVlvHBrgOvrTemp_C DFES_EnvRef.DFC_VSwVlvHBrgShCirBatt1_C DFES_EnvRef.DFC_VSwVlvHBrgShCirBatt2_C DFES_EnvRef.DFC_VSwVlvHBrgShCirGnd1_C DFES_EnvRef.DFC_VSwVlvHBrgShCirGnd2_C DFES_EnvRef.DFC_VSwVlvHBrgShCirOvrLd_C DFES_EnvRef.DFC_VSwVlvHBrgTempOvrCurr_C DFES_EnvRef.DFC_VSwVlvHBrgUndrVltg_C DFES_EnvRef.DFC_VSwVlvOL_C DFES_EnvRef.DFC_VSwVlvSCB_C DFES_EnvRef.DFC_VSwVlvSCG_C DFES_EnvRef.DFC_VSwVlvSRCMax_C DFES_EnvRef.DFC_VSwVlvSRCMin_C DFES_EnvRef.DFC_ClthNpl_C DFES_EnvRef.DFC_ETClbETMax_0_C DFES_EnvRef.DFC_ETClbETMax_1_C DFES_EnvRef.DFC_ETClbETMax_2_C DFES_EnvRef.DFC_ETClbETMax_3_C DFES_EnvRef.DFC_ETClbETMax_4_C DFES_EnvRef.DFC_ETClbETMax_5_C DFES_EnvRef.DFC_ETClbETMin_0_C DFES_EnvRef.DFC_ETClbETMin_1_C DFES_EnvRef.DFC_ETClbETMin_2_C DFES_EnvRef.DFC_ETClbETMin_3_C DFES_EnvRef.DFC_ETClbETMin_4_C DFES_EnvRef.DFC_ETClbETMin_5_C DFES_EnvRef.DFC_IVActrEnrgMax_0_C DFES_EnvRef.DFC_IVActrEnrgMax_1_C DFES_EnvRef.DFC_IVActrEnrgMax_2_C DFES_EnvRef.DFC_IVActrEnrgMax_3_C DFES_EnvRef.DFC_IVActrEnrgMax_4_C DFES_EnvRef.DFC_IVActrEnrgMax_5_C DFES_EnvRef.DFC_IVActrEnrgMax_6_C DFES_EnvRef.DFC_IVActrEnrgMax_7_C DFES_EnvRef.DFC_IVActrEnrgMin_0_C DFES_EnvRef.DFC_IVActrEnrgMin_1_C DFES_EnvRef.DFC_IVActrEnrgMin_2_C DFES_EnvRef.DFC_IVActrEnrgMin_3_C DFES_EnvRef.DFC_IVActrEnrgMin_4_C DFES_EnvRef.DFC_IVActrEnrgMin_5_C DFES_EnvRef.DFC_IVActrEnrgMin_6_C DFES_EnvRef.DFC_IVActrEnrgMin_7_C DFES_EnvRef.DFC_IVActrEnrgPlaus_0_C DFES_EnvRef.DFC_IVActrEnrgPlaus_1_C DFES_EnvRef.DFC_IVActrEnrgPlaus_2_C DFES_EnvRef.DFC_IVActrEnrgPlaus_3_C DFES_EnvRef.DFC_IVActrEnrgPlaus_4_C DFES_EnvRef.DFC_IVActrEnrgPlaus_5_C DFES_EnvRef.DFC_IVActrEnrgPlaus_6_C DFES_EnvRef.DFC_IVActrEnrgPlaus_7_C DFES_EnvRef.DFC_IVCtlTiDiff_0_C DFES_EnvRef.DFC_IVCtlTiDiff_1_C DFES_EnvRef.DFC_IVCtlTiDiff_2_C DFES_EnvRef.DFC_IVCtlTiDiff_3_C DFES_EnvRef.DFC_IVCtlTiDiff_4_C DFES_EnvRef.DFC_IVCtlTiDiff_5_C DFES_EnvRef.DFC_IVCtlUDiffUp_0_C DFES_EnvRef.DFC_IVCtlUDiffUp_1_C DFES_EnvRef.DFC_IVCtlUDiffUp_2_C DFES_EnvRef.DFC_IVCtlUDiffUp_3_C DFES_EnvRef.DFC_IVCtlUDiffUp_4_C DFES_EnvRef.DFC_IVCtlUDiffUp_5_C DFES_EnvRef.DFC_IVCtlUUp_0_C DFES_EnvRef.DFC_IVCtlUUp_1_C DFES_EnvRef.DFC_IVCtlUUp_2_C DFES_EnvRef.DFC_IVCtlUUp_3_C DFES_EnvRef.DFC_IVCtlUUp_4_C DFES_EnvRef.DFC_IVCtlUUp_5_C DFES_EnvRef.DFC_IVDiaBnkShCir_0_C DFES_EnvRef.DFC_IVDiaBnkShCir_1_C DFES_EnvRef.DFC_IVDiaBnkShCirChSwt_0_C DFES_EnvRef.DFC_IVDiaBnkShCirChSwt_1_C DFES_EnvRef.DFC_IVDiaChp_0_C DFES_EnvRef.DFC_IVDiaChp_1_C DFES_EnvRef.DFC_IVDiaCylNoCls_0_C DFES_EnvRef.DFC_IVDiaCylNoCls_1_C DFES_EnvRef.DFC_IVDiaCylNoCls_2_C DFES_EnvRef.DFC_IVDiaCylNoCls_3_C DFES_EnvRef.DFC_IVDiaCylNoCls_4_C DFES_EnvRef.DFC_IVDiaCylNoCls_5_C DFES_EnvRef.DFC_IVDiaCylNoLd_0_C DFES_EnvRef.DFC_IVDiaCylNoLd_1_C DFES_EnvRef.DFC_IVDiaCylNoLd_2_C DFES_EnvRef.DFC_IVDiaCylNoLd_3_C DFES_EnvRef.DFC_IVDiaCylNoLd_4_C DFES_EnvRef.DFC_IVDiaCylNoLd_5_C DFES_EnvRef.DFC_IVDiaCylShCir_0_C DFES_EnvRef.DFC_IVDiaCylShCir_1_C DFES_EnvRef.DFC_IVDiaCylShCir_2_C DFES_EnvRef.DFC_IVDiaCylShCir_3_C DFES_EnvRef.DFC_IVDiaCylShCir_4_C DFES_EnvRef.DFC_IVDiaCylShCir_5_C DFES_EnvRef.DFC_IVDiaCylShCirHSLS_0_C DFES_EnvRef.DFC_IVDiaCylShCirHSLS_1_C DFES_EnvRef.DFC_IVDiaCylShCirHSLS_2_C DFES_EnvRef.DFC_IVDiaCylShCirHSLS_3_C DFES_EnvRef.DFC_IVDiaCylShCirHSLS_4_C DFES_EnvRef.DFC_IVDiaCylShCirHSLS_5_C DFES_EnvRef.DFC_IVDiaCylShCirMeas_0_C DFES_EnvRef.DFC_IVDiaCylShCirMeas_1_C DFES_EnvRef.DFC_IVDiaCylShCirMeas_2_C DFES_EnvRef.DFC_IVDiaCylShCirMeas_3_C DFES_EnvRef.DFC_IVDiaCylShCirMeas_4_C DFES_EnvRef.DFC_IVDiaCylShCirMeas_5_C DFES_EnvRef.DFC_LSUDynChk_C DFES_EnvRef.DFC_LSUO2ClbMax_C DFES_EnvRef.DFC_LSUO2ClbMin_C DFES_EnvRef.DFC_LSUO2PlausMaxFLd_C DFES_EnvRef.DFC_LSUO2PlausMaxOvrRun_C DFES_EnvRef.DFC_LSUO2PlausMaxPartLd_C DFES_EnvRef.DFC_LSUO2PlausMinFLd_C DFES_EnvRef.DFC_LSUO2PlausMinOvrRun_C DFES_EnvRef.DFC_LSUO2PlausMinPartLd_C DFES_EnvRef.DFC_LSURiClbMax_C DFES_EnvRef.DFC_LSURiClbMin_C DFES_EnvRef.DFC_LSUWireIPSig_C DFES_EnvRef.DFC_Layer_BSDMax_C DFES_EnvRef.DFC_Layer_BSDMin_C DFES_EnvRef.DFC_Layer_BSDNpl_C DFES_EnvRef.DFC_Layer_BSDSig_C DFES_EnvRef.DFC_Layer_FltMngTstMax_C DFES_EnvRef.DFC_Layer_FltMngTstMin_C DFES_EnvRef.DFC_Layer_FltMngTstNpl_C DFES_EnvRef.DFC_Layer_FltMngTstSig_C DFES_EnvRef.DFC_Layer_GENELBMax_C DFES_EnvRef.DFC_Layer_GENELBMin_C DFES_EnvRef.DFC_Layer_GENELBNpl_C DFES_EnvRef.DFC_Layer_GENELBSig_C DFES_EnvRef.DFC_Layer_GENELMax_C DFES_EnvRef.DFC_Layer_GENELMin_C DFES_EnvRef.DFC_Layer_GENELNpl_C DFES_EnvRef.DFC_Layer_GENELSig_C DFES_EnvRef.DFC_Layer_GENHTBMax_C DFES_EnvRef.DFC_Layer_GENHTBMin_C DFES_EnvRef.DFC_Layer_GENHTBNpl_C DFES_EnvRef.DFC_Layer_GENHTBSig_C DFES_EnvRef.DFC_Layer_GENHTMax_C DFES_EnvRef.DFC_Layer_GENHTMin_C DFES_EnvRef.DFC_Layer_GENHTNpl_C DFES_EnvRef.DFC_Layer_GENHTSig_C DFES_EnvRef.DFC_Layer_GENKOMMMax_C DFES_EnvRef.DFC_Layer_GENKOMMMin_C DFES_EnvRef.DFC_Layer_GENKOMMNpl_C DFES_EnvRef.DFC_Layer_GENKOMMSig_C DFES_EnvRef.DFC_Layer_GENMECHMax_C DFES_EnvRef.DFC_Layer_GENMECHMin_C DFES_EnvRef.DFC_Layer_GENMECHNpl_C DFES_EnvRef.DFC_Layer_GENMECHSig_C DFES_EnvRef.DFC_Layer_GENMax_C DFES_EnvRef.DFC_Layer_GENMin_C DFES_EnvRef.DFC_Layer_GENNpl_C DFES_EnvRef.DFC_Layer_GENREGUPLMax_C DFES_EnvRef.DFC_Layer_GENREGUPLMin_C DFES_EnvRef.DFC_Layer_GENREGUPLNpl_C DFES_EnvRef.DFC_Layer_GENREGUPLSig_C DFES_EnvRef.DFC_Layer_GENSig_C DFES_EnvRef.DFC_Layer_GENUPLMax_C DFES_EnvRef.DFC_Layer_GENUPLMin_C DFES_EnvRef.DFC_Layer_GENUPLNpl_C DFES_EnvRef.DFC_Layer_GENUPLSig_C DFES_EnvRef.DFC_Layer_IBS1Max_C DFES_EnvRef.DFC_Layer_IBS1Min_C DFES_EnvRef.DFC_Layer_IBS1Npl_C DFES_EnvRef.DFC_Layer_IBS1Sig_C DFES_EnvRef.DFC_Layer_IBS2Max_C DFES_EnvRef.DFC_Layer_IBS2Min_C DFES_EnvRef.DFC_Layer_IBS2Npl_C DFES_EnvRef.DFC_Layer_IBS2Sig_C DFES_EnvRef.DFC_Layer_IBS3Max_C DFES_EnvRef.DFC_Layer_IBS3Min_C DFES_EnvRef.DFC_Layer_IBS3Npl_C DFES_EnvRef.DFC_Layer_IBS3Sig_C DFES_EnvRef.DFC_Layer_MANDETEKMax_C DFES_EnvRef.DFC_Layer_MANDETEKMin_C DFES_EnvRef.DFC_Layer_MANDETEKNpl_C DFES_EnvRef.DFC_Layer_MANDETEKSig_C DFES_EnvRef.DFC_Layer_NDR1Max_C DFES_EnvRef.DFC_Layer_NDR1Min_C DFES_EnvRef.DFC_Layer_NDR1Npl_C DFES_EnvRef.DFC_Layer_NDR1Sig_C DFES_EnvRef.DFC_Layer_NDR2Max_C DFES_EnvRef.DFC_Layer_NDR2Min_C DFES_EnvRef.DFC_Layer_NDR2Npl_C DFES_EnvRef.DFC_Layer_NDR2Sig_C DFES_EnvRef.DFC_Layer_NGLERNMax_C DFES_EnvRef.DFC_Layer_NGLERNMin_C DFES_EnvRef.DFC_Layer_NGLERNNpl_C DFES_EnvRef.DFC_Layer_NGLERNSig_C DFES_EnvRef.DFC_Layer_PMBATTMax_C DFES_EnvRef.DFC_Layer_PMBATTMin_C DFES_EnvRef.DFC_Layer_PMBATTNpl_C DFES_EnvRef.DFC_Layer_PMBATTSig_C DFES_EnvRef.DFC_Layer_PMBNMax_C DFES_EnvRef.DFC_Layer_PMBNMin_C DFES_EnvRef.DFC_Layer_PMBNNpl_C DFES_EnvRef.DFC_Layer_PMBNSig_C DFES_EnvRef.DFC_Layer_PMRUHVERLMax_C DFES_EnvRef.DFC_Layer_PMRUHVERLMin_C DFES_EnvRef.DFC_Layer_PMRUHVERLNpl_C DFES_EnvRef.DFC_Layer_PMRUHVERLSig_C DFES_EnvRef.DFC_Layer_QLTMax_C DFES_EnvRef.DFC_Layer_QLTMin_C DFES_EnvRef.DFC_Layer_QLTNpl_C DFES_EnvRef.DFC_Layer_QLTSig_C DFES_EnvRef.DFC_Layer_TOENSMax_C DFES_EnvRef.DFC_Layer_TOENSMin_C DFES_EnvRef.DFC_Layer_TOENSNpl_C DFES_EnvRef.DFC_Layer_TOENSSig_C DFES_EnvRef.DFC_MonLimCurr_C DFES_EnvRef.DFC_MonLimLead_C DFES_EnvRef.DFC_MonLimSet_C DFES_EnvRef.DFC_NSCDsNOxOfsMax_C DFES_EnvRef.DFC_NSCDsNOxOfsMin_C DFES_EnvRef.DFC_NSCDsNOxPlausMin_C DFES_EnvRef.DFC_NoCat2DsNOxOfsMax_C DFES_EnvRef.DFC_NoCat2DsNOxOfsMin_C DFES_EnvRef.DFC_NoCat2DsNOxPlausMin_C DFES_EnvRef.DFC_PCVNoStrt_C DFES_EnvRef.DFC_RailPGradMon_C DFES_EnvRef.DFC_SCRPODPresBuildUp_C DFES_EnvRef.DFC_AFSDrftIdlAdjVal_C DFES_EnvRef.DFC_AFSDrftLdAdjVal_C DFES_EnvRef.DFC_AdcIADC0Cal_C DFES_EnvRef.DFC_AdcIADC0Conv_C DFES_EnvRef.DFC_AdcIADC1Cal_C DFES_EnvRef.DFC_AdcIADC1Conv_C DFES_EnvRef.DFC_CmbChbMisfireMax_0_C DFES_EnvRef.DFC_CmbChbMisfireMax_1_C DFES_EnvRef.DFC_CmbChbMisfireMax_2_C DFES_EnvRef.DFC_CmbChbMisfireMax_3_C DFES_EnvRef.DFC_CmbChbMisfireMax_4_C DFES_EnvRef.DFC_CmbChbMisfireMax_5_C DFES_EnvRef.DFC_CmbChbMisfireMul_C DFES_EnvRef.DFC_EGRVlvLPOfsNeutr_C DFES_EnvRef.DFC_EGRVlvOfsNeutr_C DFES_EnvRef.DFC_FMAErrModMax_C DFES_EnvRef.DFC_FMAErrModMin_C DFES_EnvRef.DFC_FlSysTnkLo_C DFES_EnvRef.DFC_GbxNPosPlaus_C DFES_EnvRef.DFC_I14229_ROETst_Appl_C DFES_EnvRef.DFC_I14229_ROETst_Netw_C DFES_EnvRef.DFC_I14229_ROE_BufFull_C DFES_EnvRef.DFC_IVAdjDiaIVAdj_C DFES_EnvRef.DFC_IVAdjIVA_0_C DFES_EnvRef.DFC_IVAdjIVA_1_C DFES_EnvRef.DFC_IVAdjIVA_2_C DFES_EnvRef.DFC_IVAdjIVA_3_C DFES_EnvRef.DFC_IVAdjIVA_4_C DFES_EnvRef.DFC_IVAdjIVA_5_C DFES_EnvRef.DFC_IVPSplyDCDCOff_0_C DFES_EnvRef.DFC_IVPSplyDCDCOff_1_C DFES_EnvRef.DFC_IVPSplyDCDCOff_2_C DFES_EnvRef.DFC_IVPSplyDCDCOff_3_C DFES_EnvRef.DFC_InjCtlAdjQntEEPCS_C DFES_EnvRef.DFC_LSUSPISig_C DFES_EnvRef.DFC_Layer_Dummy_C DFES_EnvRef.DFC_NplEnvPSensPPFltDiff_C DFES_EnvRef.DFC_NplPresSensPPFltDiff_C DFES_EnvRef.DFC_OilLvlPlaus_C DFES_EnvRef.DFC_OilTOutLvl_C DFES_EnvRef.DFC_PCVfacAdaptMax_C DFES_EnvRef.DFC_PCVfacAdaptMin_C DFES_EnvRef.DFC_SensFrzPPFltUs_C DFES_EnvRef.DFC_SensMonUTnkLvl_C DFES_EnvRef.DFC_T15Sig_C DFES_EnvRef.DFC_AirCtlRmpTOut_C DFES_EnvRef.DFC_BrkPPlaus_C DFES_EnvRef.DFC_CEngDsTDynTst_C DFES_EnvRef.DFC_EEPEraseErr_C DFES_EnvRef.DFC_EEPRdErr_C DFES_EnvRef.DFC_EEPWrErr_C DFES_EnvRef.DFC_EGRVlvJamVlvClsd_C DFES_EnvRef.DFC_EGRVlvJamVlvOpn_C DFES_EnvRef.DFC_EGRVlvLPJamVlvClsd_C DFES_EnvRef.DFC_EGRVlvLPJamVlvOpn_C DFES_EnvRef.DFC_EGRVlvLPLgTDrft_C DFES_EnvRef.DFC_EGRVlvLPOfsLrnJamVlv_C DFES_EnvRef.DFC_EGRVlvLPShTDrft_C DFES_EnvRef.DFC_EGRVlvLgTDrft_C DFES_EnvRef.DFC_EGRVlvOfsLrnJamVlv_C DFES_EnvRef.DFC_EGRVlvShTDrft_C DFES_EnvRef.DFC_EngICO_C DFES_EnvRef.DFC_EpmCaSI1ErrSig_C DFES_EnvRef.DFC_EpmCaSI1NoSig_C DFES_EnvRef.DFC_EpmCaSI1OfsErr_C DFES_EnvRef.DFC_EpmCrSErrSig_C DFES_EnvRef.DFC_EpmCrSNoSig_C DFES_EnvRef.DFC_IVPlausComprTst_C DFES_EnvRef.DFC_IVPlausRunUpTst_C DFES_EnvRef.DFC_InjCrvShOffTst_C DFES_EnvRef.DFC_LayerEnSavModProd_C DFES_EnvRef.DFC_LayerEnSavModRep_C DFES_EnvRef.DFC_LayerEnSavModShip_C DFES_EnvRef.DFC_MRlyErlyOpng_C DFES_EnvRef.DFC_MRlyStk_C DFES_EnvRef.DFC_MeUnActrTst_C DFES_EnvRef.DFC_MoCADCCmp_C DFES_EnvRef.DFC_MoCADCTst_C DFES_EnvRef.DFC_MoCADCVltgRatio_C DFES_EnvRef.DFC_MoCComErrCnt_C DFES_EnvRef.DFC_MoCComSPI_C DFES_EnvRef.DFC_MoCROMErrXPg_C DFES_EnvRef.DFC_MoCSOPHwNoRdy_C DFES_EnvRef.DFC_MoCSOPLoLi_C DFES_EnvRef.DFC_MoCSOPMM_C DFES_EnvRef.DFC_MoCSOPTimeOut_C DFES_EnvRef.DFC_MoCSOPUpLi_C DFES_EnvRef.DFC_MoFAPP_C DFES_EnvRef.DFC_MoFESpd_C DFES_EnvRef.DFC_MoFInjDatPhi_C DFES_EnvRef.DFC_MoFInjDatQnt_C DFES_EnvRef.DFC_MoFInjQnt_C DFES_EnvRef.DFC_MoFMode1PoI1_C DFES_EnvRef.DFC_MoFMode1PoI2_C DFES_EnvRef.DFC_MoFMode2PoI1_C DFES_EnvRef.DFC_MoFMode2PoI2_C DFES_EnvRef.DFC_MoFOvR_C DFES_EnvRef.DFC_MoFQntCor_C DFES_EnvRef.DFC_MoFRailP_C DFES_EnvRef.DFC_MoFTrqCmp_C DFES_EnvRef.DFC_NSCDsHtrSetP_C DFES_EnvRef.DFC_NoCat2DsHtrSetP_C DFES_EnvRef.DFC_PCVActrTst_C DFES_EnvRef.DFC_PhyModNonMonMapNpl_C DFES_EnvRef.DFC_RailHpTst_C DFES_EnvRef.DFC_RailPOfsTstMax_C DFES_EnvRef.DFC_RailPOfsTstMin_C DFES_EnvRef.DFC_SIA_E1max_C DFES_EnvRef.DFC_SIA_E1min_C DFES_EnvRef.DFC_SIA_E1npl_C DFES_EnvRef.DFC_SIA_E1sig_C DFES_EnvRef.DFC_SIA_E2max_C DFES_EnvRef.DFC_SIA_E2min_C DFES_EnvRef.DFC_SIA_E2npl_C DFES_EnvRef.DFC_SIA_E2sig_C DFES_EnvRef.DFC_SIA_E3max_C DFES_EnvRef.DFC_SIA_E3min_C DFES_EnvRef.DFC_SIA_E3npl_C DFES_EnvRef.DFC_SIA_E3sig_C DFES_EnvRef.DFC_SIA_E4max_C DFES_EnvRef.DFC_SIA_E4min_C DFES_EnvRef.DFC_SIA_E4npl_C DFES_EnvRef.DFC_SIA_E4sig_C DFES_EnvRef.DFC_SWReset_0_C DFES_EnvRef.DFC_SWReset_1_C DFES_EnvRef.DFC_SWReset_2_C DFES_EnvRef.DFC_ShtrAKKMax_C DFES_EnvRef.DFC_ShtrAKKMin_C DFES_EnvRef.DFC_ShtrAKKNpl_C DFES_EnvRef.DFC_ShtrPKKMax_C DFES_EnvRef.DFC_StopCntTmr_C DFES_EnvRef.DFC_ThrVlvMon_C DFES_EnvRef.DFC_VSwVlvJamVlv_C DFES_EnvRef.DFC_VSwVlvLgTDrft_C DFES_EnvRef.DFC_VSwVlvOfsLrnJamVlv_C DFES_EnvRef.DFC_VSwVlvOfsNeutr_C DFES_EnvRef.DFC_VSwVlvShTDrft_C DFES_EnvRef.DFC_VSwVlvSpgDef_C DFES_FaultTyp.DFC_Unused_C DFES_FaultTyp.DFC_ACCIPlausDrvAst_C DFES_FaultTyp.DFC_ACCIPlausTrqDes_C DFES_FaultTyp.DFC_AirCtlGovDvtEOMMax_C DFES_FaultTyp.DFC_AirCtlGovDvtEOMMin_C DFES_FaultTyp.DFC_AirCtlGovDvtMax_C DFES_FaultTyp.DFC_AirCtlGovDvtMin_C DFES_FaultTyp.DFC_AirCtlGovLPDvtMax_C DFES_FaultTyp.DFC_AirCtlGovLPDvtMin_C DFES_FaultTyp.DFC_AltIOComErr_C DFES_FaultTyp.DFC_AltIOComNpl_C DFES_FaultTyp.DFC_BusDiagBusOffFlexRay_C DFES_FaultTyp.DFC_BusDiagBusOffNodeA_C DFES_FaultTyp.DFC_BusDiagBusOffNodeB_C DFES_FaultTyp.DFC_BusDiagBusOffNodeC_C DFES_FaultTyp.DFC_BusDiagHwFlexRay_C DFES_FaultTyp.DFC_Cj945SpiCom1_C DFES_FaultTyp.DFC_ComACDemandSig_FA_C DFES_FaultTyp.DFC_ComACDemandTo_FA_C DFES_FaultTyp.DFC_ComATempSig_FA_C DFES_FaultTyp.DFC_ComATempTo_FA_C DFES_FaultTyp.DFC_ComATempTo_FX_C DFES_FaultTyp.DFC_ComBrkTrqSumChk_FX_C DFES_FaultTyp.DFC_ComBrkTrqSumCtr_FX_C DFES_FaultTyp.DFC_ComBrkTrqSumTo_FX_C DFES_FaultTyp.DFC_ComBtnDrvDynChk_FX_C DFES_FaultTyp.DFC_ComBtnDrvDynCtr_FX_C DFES_FaultTyp.DFC_ComBtnDrvDynTo_FX_C DFES_FaultTyp.DFC_ComButtonMSASig_C DFES_FaultTyp.DFC_ComButtonMSATo_C DFES_FaultTyp.DFC_ComCodierungPwrmngSig_C DFES_FaultTyp.DFC_ComCodierungPwrmngSig_FA_C DFES_FaultTyp.DFC_ComCrCtlLvrChk_C DFES_FaultTyp.DFC_ComCrCtlLvrCtr_C DFES_FaultTyp.DFC_ComCrCtlLvrSig_C DFES_FaultTyp.DFC_ComCrCtlLvrTo_C DFES_FaultTyp.DFC_ComCtrCrshSwoEkpSig_FA_C DFES_FaultTyp.DFC_ComCtrCrshSwoEkpTo_FA_C DFES_FaultTyp.DFC_ComCtrSecInt_C DFES_FaultTyp.DFC_ComDiaOBDGbxSig_A_C DFES_FaultTyp.DFC_ComDiaOBDGbxTo_A_C DFES_FaultTyp.DFC_ComFahrzeugtypSig_C DFES_FaultTyp.DFC_ComFahrzeugtypSig_FA_C DFES_FaultTyp.DFC_ComFllupGpwsupSig_FA_C DFES_FaultTyp.DFC_ComFllupGpwsupTo_FA_C DFES_FaultTyp.DFC_ComGbxDataChk_A_C DFES_FaultTyp.DFC_ComGbxDataChk_FA_C DFES_FaultTyp.DFC_ComGbxDataCtr_A_C DFES_FaultTyp.DFC_ComGbxDataCtr_FA_C DFES_FaultTyp.DFC_ComGbxDataSig_A_C DFES_FaultTyp.DFC_ComGbxDataSig_FA_C DFES_FaultTyp.DFC_ComGbxDataTo_A_C DFES_FaultTyp.DFC_ComGbxDataTo_FA_C DFES_FaultTyp.DFC_ComKlemmenChk_FA_C DFES_FaultTyp.DFC_ComKlemmenCtr_FA_C DFES_FaultTyp.DFC_ComKlemmenSig_FA_C DFES_FaultTyp.DFC_ComKlemmenTo_FA_C DFES_FaultTyp.DFC_ComLenkradwinkelSig_C DFES_FaultTyp.DFC_ComLenkradwinkelTo_C DFES_FaultTyp.DFC_ComMileageRangeSig_FA_C DFES_FaultTyp.DFC_ComMileageRangeTo_FA_C DFES_FaultTyp.DFC_ComPspSig_C DFES_FaultTyp.DFC_ComPspTo_C DFES_FaultTyp.DFC_ComRelTimeSig_FA_C DFES_FaultTyp.DFC_ComRelTimeTo_FA_C DFES_FaultTyp.DFC_ComRequestEMFChk_C DFES_FaultTyp.DFC_ComRequestEMFCtr_C DFES_FaultTyp.DFC_ComRequestEMFSig_C DFES_FaultTyp.DFC_ComRequestEMFTo_C DFES_FaultTyp.DFC_ComRpmWhlChk_FX_C DFES_FaultTyp.DFC_ComRpmWhlCtr_FX_C DFES_FaultTyp.DFC_ComRpmWhlTo_FX_C DFES_FaultTyp.DFC_ComSecCtrRelSig_FA_C DFES_FaultTyp.DFC_ComSecCtrRelTo_FA_C DFES_FaultTyp.DFC_ComSensNOxGndSig_C DFES_FaultTyp.DFC_ComSensNOxGndTo_C DFES_FaultTyp.DFC_ComSensNOxMode_C DFES_FaultTyp.DFC_ComSensNOxUbattSig_C DFES_FaultTyp.DFC_ComSensNOxUbattTo_C DFES_FaultTyp.DFC_ComShiftPaddleTo_FX_C DFES_FaultTyp.DFC_ComShutOffPSPSig_C DFES_FaultTyp.DFC_ComShutOffPSPTo_C DFES_FaultTyp.DFC_ComSlrdiGlbFZMTo_FA_C DFES_FaultTyp.DFC_ComSlrdiGlbFZMTo_FX_C DFES_FaultTyp.DFC_ComSpeedVehicleChk_FX_C DFES_FaultTyp.DFC_ComSpeedVehicleCtr_FX_C /end DEF_CHARACTERISTIC
/end FUNCTION
/begin COMPU_METHOD DFES_EnvTabVerb "" TAB_VERB "%2.1" "-" COMPU_TAB_REF DFES_EnvTabVerb /end COMPU_METHOD
/begin COMPU_VTAB DFES_EnvTabVerb "" TAB_VERB 80 0 "xSet1" 1 "xSet2" 2 "xSet3" 3 "xSet4" 4 "xSet5" 5 "xSet6" 6 "xSet7" 7 "xSet8" 8 "xSet9" 9 "xSet10" 10 "xSet11" 11 "xSet12" 12 "xSet13" 13 "xSet14" 14 "xSet15" 15 "xSet16" 16 "xSet17" 17 "xSet18" 18 "xSet19" 19 "xSet20" 20 "xSet21" 21 "xSet22" 22 "xSet23" 23 "xSet24" 24 "xSet25" 25 "xSet26" 26 "xSet27" 27 "xSet28" 28 "xSet29" 29 "xSet30" 30 "xSet31" 31 "xSet32" 32 "xSet33" 33 "xSet34" 34 "xSet35" 35 "xSet36" 36 "xSet37" 37 "xSet38" 38 "xSet39" 39 "xSet40" 40 "xSet41" 41 "xSet42" 42 "xSet43" 43 "xSet44" 44 "xSet45" 45 "xSet46" 46 "xSet47" 47 "xSet48" 48 "xSet49" 49 "xSet50" 50 "xSet51" 51 "xSet52" 52 "xSet53" 53 "xSet54" 54 "xSet55" 55 "xSet56" 56 "xSet57" 57 "xSet58" 58 "xSet59" 59 "xSet60" 60 "xSet61" 61 "xSet62" 62 "xSet63" 63 "xSet64" 64 "xSet65" 65 "xSet66" 66 "xSet67" 67 "xSet68" 68 "xSet69" 69 "xSet70" 70 "xSet71" 71 "xSet72" 72 "xSet73" 73 "xSet74" 74 "xSet75" 75 "xSet76" 76 "xSet77" 77 "xSet78" 78 "xSet79" 79 "xSet80" DEFAULT_VALUE "---" /end COMPU_VTAB
/begin COMPU_METHOD DFES_OneToOne "" RAT_FUNC "%6.0" "-" COEFFS 0 1 0 0 0 1 /end COMPU_METHOD
/begin RECORD_LAYOUT Val_Wu16 FNC_VALUES 1 UWORD COLUMN_DIR DIRECT /end RECORD_LAYOUT
/begin RECORD_LAYOUT Val_Wu8 FNC_VALUES 1 UBYTE COLUMN_DIR DIRECT /end RECORD_LAYOUT
/end MODULE
/end PROJECT

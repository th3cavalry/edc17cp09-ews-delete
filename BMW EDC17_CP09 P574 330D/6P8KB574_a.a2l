ASAP2_VERSION 1 4
/begin PROJECT P_574 "EDC17_CP09"
/begin HEADER "" VERSION "V8KB" PROJECT_NO P_574 /end HEADER
/begin MODULE DIM ""
/begin MOD_COMMON "" BYTE_ORDER MSB_LAST ALIGNMENT_BYTE 1 ALIGNMENT_WORD 2 ALIGNMENT_LONG 4 ALIGNMENT_FLOAT32_IEEE 4 /end MOD_COMMON
/begin CHARACTERISTIC DINH_Lim.DFC_ComKlemmenChk_FA_CA "DINH/Zugeordnete Verriegelungslimits für Verriegelungsquelle DFC_ComKlemmenChk_FA" VAL_BLK 0x80026ECC ValA_Wu16 8192.00000000 DINH_LimDFCVerb 12079.0000000 20271.0000000 FORMAT "%13.7" NUMBER 2 /end CHARACTERISTIC
/begin CHARACTERISTIC DINH_Lim.DFC_ComKlemmenCtr_FA_CA "DINH/Zugeordnete Verriegelungslimits für Verriegelungsquelle DFC_ComKlemmenCtr_FA" VAL_BLK 0x80026ED0 ValA_Wu16 8192.00000000 DINH_LimDFCVerb 12079.0000000 20271.0000000 FORMAT "%13.7" NUMBER 2 /end CHARACTERISTIC
/begin CHARACTERISTIC DINH_Lim.DFC_ComKlemmenSig_FA_CA "DINH/Zugeordnete Verriegelungslimits für Verriegelungsquelle DFC_ComKlemmenSig_FA" VAL_BLK 0x80026ED4 ValA_Wu16 8192.00000000 DINH_LimDFCVerb 12079.0000000 20271.0000000 FORMAT "%13.7" NUMBER 2 /end CHARACTERISTIC
/begin CHARACTERISTIC DINH_Lim.DFC_ComKlemmenTo_FA_CA "DINH/Zugeordnete Verriegelungslimits für Verriegelungsquelle DFC_ComKlemmenTo_FA" VAL_BLK 0x80026ED8 ValA_Wu16 8192.00000000 DINH_LimDFCVerb 12079.0000000 20271.0000000 FORMAT "%13.7" NUMBER 2 /end CHARACTERISTIC
/begin CHARACTERISTIC DINH_Lim.DFC_ComLenkradwinkelSig_CA "DINH/Zugeordnete Verriegelungslimits für Verriegelungsquelle DFC_ComLenkradwinkelSig" VAL_BLK 0x80026EDC ValA_Wu16 8192.00000000 DINH_LimDFCVerb 12079.0000000 20271.0000000 FORMAT "%13.7" NUMBER 2 /end CHARACTERISTIC
/begin CHARACTERISTIC DINH_Lim.DFC_ComLenkradwinkelTo_CA "DINH/Zugeordnete Verriegelungslimits für Verriegelungsquelle DFC_ComLenkradwinkelTo" VAL_BLK 0x80026EE0 ValA_Wu16 8192.00000000 DINH_LimDFCVerb 12079.0000000 20271.0000000 FORMAT "%13.7" NUMBER 2 /end CHARACTERISTIC
/begin CHARACTERISTIC DINH_Lim.DFC_ComMileageRangeSig_FA_CA "DINH/Zugeordnete Verriegelungslimits für Verriegelungsquelle DFC_ComMileageRangeSig_FA" VAL_BLK 0x80026EE4 ValA_Wu16 8192.00000000 DINH_LimDFCVerb 12079.0000000 20271.0000000 FORMAT "%13.7" NUMBER 2 /end CHARACTERISTIC
/begin CHARACTERISTIC DINH_Lim.DFC_ComMileageRangeTo_FA_CA "DINH/Zugeordnete Verriegelungslimits für Verriegelungsquelle DFC_ComMileageRangeTo_FA" VAL_BLK 0x80026EE8 ValA_Wu16 8192.00000000 DINH_LimDFCVerb 12079.0000000 20271.0000000 FORMAT "%13.7" NUMBER 2 /end CHARACTERISTIC
/begin CHARACTERISTIC DINH_Lim.DFC_ComPspSig_CA "DINH/Zugeordnete Verriegelungslimits für Verriegelungsquelle DFC_ComPspSig" VAL_BLK 0x80026EEC ValA_Wu16 8192.00000000 DINH_LimDFCVerb 12079.0000000 20271.0000000 FORMAT "%13.7" NUMBER 2 /end CHARACTERISTIC
/begin CHARACTERISTIC DINH_Lim.DFC_ComPspTo_CA "DINH/Zugeordnete Verriegelungslimits für Verriegelungsquelle DFC_ComPspTo" VAL_BLK 0x80026EF0 ValA_Wu16 8192.00000000 DINH_LimDFCVerb 12079.0000000 20271.0000000 FORMAT "%13.7" NUMBER 2 /end CHARACTERISTIC
/begin CHARACTERISTIC DINH_Lim.DFC_ComRelTimeSig_FA_CA "DINH/Zugeordnete Verriegelungslimits für Verriegelungsquelle DFC_ComRelTimeSig_FA" VAL_BLK 0x80026EF4 ValA_Wu16 8192.00000000 DINH_LimDFCVerb 12079.0000000 20271.0000000 FORMAT "%13.7" NUMBER 2 /end CHARACTERISTIC
/begin CHARACTERISTIC DINH_Lim.DFC_ComRelTimeTo_FA_CA "DINH/Zugeordnete Verriegelungslimits für Verriegelungsquelle DFC_ComRelTimeTo_FA" VAL_BLK 0x80026EF8 ValA_Wu16 8192.00000000 DINH_LimDFCVerb 12079.0000000 20271.0000000 FORMAT "%13.7" NUMBER 2 /end CHARACTERISTIC
/begin CHARACTERISTIC DINH_Lim.DFC_ComRequestEMFChk_CA "DINH/Zugeordnete Verriegelungslimits für Verriegelungsquelle DFC_ComRequestEMFChk" VAL_BLK 0x80026EFC ValA_Wu16 8192.00000000 DINH_LimDFCVerb 12079.0000000 20271.0000000 FORMAT "%13.7" NUMBER 2 /end CHARACTERISTIC
/begin CHARACTERISTIC DINH_Lim.DFC_ComRequestEMFCtr_CA "DINH/Zugeordnete Verriegelungslimits für Verriegelungsquelle DFC_ComRequestEMFCtr" VAL_BLK 0x80026F00 ValA_Wu16 8192.00000000 DINH_LimDFCVerb 12079.0000000 20271.0000000 FORMAT "%13.7" NUMBER 2 /end CHARACTERISTIC
/begin CHARACTERISTIC DINH_Lim.DFC_ComRequestEMFSig_CA "DINH/Zugeordnete Verriegelungslimits für Verriegelungsquelle DFC_ComRequestEMFSig" VAL_BLK 0x80026F04 ValA_Wu16 8192.00000000 DINH_LimDFCVerb 12079.0000000 20271.0000000 FORMAT "%13.7" NUMBER 2 /end CHARACTERISTIC
/begin CHARACTERISTIC DINH_Lim.DFC_ComRequestEMFTo_CA "DINH/Zugeordnete Verriegelungslimits für Verriegelungsquelle DFC_ComRequestEMFTo" VAL_BLK 0x80026F08 ValA_Wu16 8192.00000000 DINH_LimDFCVerb 12079.0000000 20271.0000000 FORMAT "%13.7" NUMBER 2 /end CHARACTERISTIC
/begin CHARACTERISTIC DINH_Lim.DFC_ComRpmWhlChk_FX_CA "DINH/Zugeordnete Verriegelungslimits für Verriegelungsquelle DFC_ComRpmWhlChk_FX" VAL_BLK 0x80026F0C ValA_Wu16 8192.00000000 DINH_LimDFCVerb 12079.0000000 20271.0000000 FORMAT "%13.7" NUMBER 2 /end CHARACTERISTIC
/begin CHARACTERISTIC DINH_Lim.DFC_ComRpmWhlCtr_FX_CA "DINH/Zugeordnete Verriegelungslimits für Verriegelungsquelle DFC_ComRpmWhlCtr_FX" VAL_BLK 0x80026F10 ValA_Wu16 8192.00000000 DINH_LimDFCVerb 12079.0000000 20271.0000000 FORMAT "%13.7" NUMBER 2 /end CHARACTERISTIC
/begin CHARACTERISTIC DINH_Lim.DFC_ComRpmWhlTo_FX_CA "DINH/Zugeordnete Verriegelungslimits für Verriegelungsquelle DFC_ComRpmWhlTo_FX" VAL_BLK 0x80026F14 ValA_Wu16 8192.00000000 DINH_LimDFCVerb 12079.0000000 20271.0000000 FORMAT "%13.7" NUMBER 2 /end CHARACTERISTIC
/begin CHARACTERISTIC DINH_Lim.DFC_ComSecCtrRelSig_FA_CA "DINH/Zugeordnete Verriegelungslimits für Verriegelungsquelle DFC_ComSecCtrRelSig_FA" VAL_BLK 0x80026F18 ValA_Wu16 8192.00000000 DINH_LimDFCVerb 12079.0000000 20271.0000000 FORMAT "%13.7" NUMBER 2 /end CHARACTERISTIC
/begin CHARACTERISTIC DINH_Lim.DFC_ComSecCtrRelTo_FA_CA "DINH/Zugeordnete Verriegelungslimits für Verriegelungsquelle DFC_ComSecCtrRelTo_FA" VAL_BLK 0x80026F1C ValA_Wu16 8192.00000000 DINH_LimDFCVerb 12079.0000000 20271.0000000 FORMAT "%13.7" NUMBER 3 /end CHARACTERISTIC
/begin CHARACTERISTIC DINH_Lim.DFC_ComSensNOxGndSig_CA "DINH/Zugeordnete Verriegelungslimits für Verriegelungsquelle DFC_ComSensNOxGndSig" VAL_BLK 0x80026F22 ValA_Wu16 8192.00000000 DINH_LimDFCVerb 12079.0000000 20271.0000000 FORMAT "%13.7" NUMBER 2 /end CHARACTERISTIC
/begin CHARACTERISTIC DINH_Lim.DFC_ComSensNOxGndTo_CA "DINH/Zugeordnete Verriegelungslimits für Verriegelungsquelle DFC_ComSensNOxGndTo" VAL_BLK 0x80026F26 ValA_Wu16 8192.00000000 DINH_LimDFCVerb 12079.0000000 20271.0000000 FORMAT "%13.7" NUMBER 2 /end CHARACTERISTIC
/begin CHARACTERISTIC DINH_Lim.DFC_ComSensNOxMode_CA "DINH/Zugeordnete Verriegelungslimits für Verriegelungsquelle DFC_ComSensNOxMode" VAL_BLK 0x80026F2A ValA_Wu16 8192.00000000 DINH_LimDFCVerb 12079.0000000 20271.0000000 FORMAT "%13.7" NUMBER 2 /end CHARACTERISTIC
/begin CHARACTERISTIC DINH_Lim.DFC_ComSensNOxUbattSig_CA "DINH/Zugeordnete Verriegelungslimits für Verriegelungsquelle DFC_ComSensNOxUbattSig" VAL_BLK 0x80026F2E ValA_Wu16 8192.00000000 DINH_LimDFCVerb 12079.0000000 20271.0000000 FORMAT "%13.7" NUMBER 2 /end CHARACTERISTIC
/begin CHARACTERISTIC DINH_Lim.DFC_ComSensNOxUbattTo_CA "DINH/Zugeordnete Verriegelungslimits für Verriegelungsquelle DFC_ComSensNOxUbattTo" VAL_BLK 0x80026F32 ValA_Wu16 8192.00000000 DINH_LimDFCVerb 12079.0000000 20271.0000000 FORMAT "%13.7" NUMBER 2 /end CHARACTERISTIC
/begin CHARACTERISTIC DINH_Lim.DFC_ComShiftPaddleTo_FX_CA "DINH/Zugeordnete Verriegelungslimits für Verriegelungsquelle DFC_ComShiftPaddleTo_FX" VAL_BLK 0x80026F36 ValA_Wu16 8192.00000000 DINH_LimDFCVerb 12079.0000000 20271.0000000 FORMAT "%13.7" NUMBER 2 /end CHARACTERISTIC
/begin CHARACTERISTIC DINH_Lim.DFC_ComShutOffPSPSig_CA "DINH/Zugeordnete Verriegelungslimits für Verriegelungsquelle DFC_ComShutOffPSPSig" VAL_BLK 0x80026F3A ValA_Wu16 8192.00000000 DINH_LimDFCVerb 12079.0000000 20271.0000000 FORMAT "%13.7" NUMBER 2 /end CHARACTERISTIC
/begin CHARACTERISTIC DINH_Lim.DFC_ComShutOffPSPTo_CA "DINH/Zugeordnete Verriegelungslimits für Verriegelungsquelle DFC_ComShutOffPSPTo" VAL_BLK 0x80026F3E ValA_Wu16 8192.00000000 DINH_LimDFCVerb 12079.0000000 20271.0000000 FORMAT "%13.7" NUMBER 2 /end CHARACTERISTIC
/begin CHARACTERISTIC DINH_Lim.DFC_ComSlrdiGlbFZMTo_FA_CA "DINH/Zugeordnete Verriegelungslimits für Verriegelungsquelle DFC_ComSlrdiGlbFZMTo_FA" VAL_BLK 0x80026F42 ValA_Wu16 8192.00000000 DINH_LimDFCVerb 12079.0000000 20271.0000000 FORMAT "%13.7" NUMBER 2 /end CHARACTERISTIC
/begin CHARACTERISTIC DINH_Lim.DFC_ComSlrdiGlbFZMTo_FX_CA "DINH/Zugeordnete Verriegelungslimits für Verriegelungsquelle DFC_ComSlrdiGlbFZMTo_FX" VAL_BLK 0x80026F46 ValA_Wu16 8192.00000000 DINH_LimDFCVerb 12079.0000000 20271.0000000 FORMAT "%13.7" NUMBER 2 /end CHARACTERISTIC
/begin CHARACTERISTIC DINH_Lim.DFC_ComSpeedVehicleChk_FX_CA "DINH/Zugeordnete Verriegelungslimits für Verriegelungsquelle DFC_ComSpeedVehicleChk_FX" VAL_BLK 0x80026F4A ValA_Wu16 8192.00000000 DINH_LimDFCVerb 12079.0000000 20271.0000000 FORMAT "%13.7" NUMBER 2 /end CHARACTERISTIC
/begin CHARACTERISTIC DINH_Lim.DFC_ComSpeedVehicleCtr_FX_CA "DINH/Zugeordnete Verriegelungslimits für Verriegelungsquelle DFC_ComSpeedVehicleCtr_FX" VAL_BLK 0x80026F4E ValA_Wu16 8192.00000000 DINH_LimDFCVerb 12079.0000000 20271.0000000 FORMAT "%13.7" NUMBER 2 /end CHARACTERISTIC
/begin CHARACTERISTIC DINH_Lim.DFC_ComSpeedVehicleTo_FX_CA "DINH/Zugeordnete Verriegelungslimits für Verriegelungsquelle DFC_ComSpeedVehicleTo_FX" VAL_BLK 0x80026F52 ValA_Wu16 8192.00000000 DINH_LimDFCVerb 12079.0000000 20271.0000000 FORMAT "%13.7" NUMBER 2 /end CHARACTERISTIC
/begin CHARACTERISTIC DINH_Lim.DFC_ComStConintDSCChk_FX_CA "DINH/Zugeordnete Verriegelungslimits für Verriegelungsquelle DFC_ComStConintDSCChk_FX" VAL_BLK 0x80026F56 ValA_Wu16 8192.00000000 DINH_LimDFCVerb 12079.0000000 20271.0000000 FORMAT "%13.7" NUMBER 2 /end CHARACTERISTIC
/begin CHARACTERISTIC DINH_Lim.DFC_ComStConintDSCCtr_FX_CA "DINH/Zugeordnete Verriegelungslimits für Verriegelungsquelle DFC_ComStConintDSCCtr_FX" VAL_BLK 0x80026F5A ValA_Wu16 8192.00000000 DINH_LimDFCVerb 12079.0000000 20271.0000000 FORMAT "%13.7" NUMBER 2 /end CHARACTERISTIC
/begin CHARACTERISTIC DINH_Lim.DFC_ComStConintDSCTo_FX_CA "DINH/Zugeordnete Verriegelungslimits für Verriegelungsquelle DFC_ComStConintDSCTo_FX" VAL_BLK 0x80026F5E ValA_Wu16 8192.00000000 DINH_LimDFCVerb 12079.0000000 20271.0000000 FORMAT "%13.7" NUMBER 2 /end CHARACTERISTIC
/begin CHARACTERISTIC DINH_Lim.DFC_ComStatACFrontSig_FA_CA "DINH/Zugeordnete Verriegelungslimits für Verriegelungsquelle DFC_ComStatACFrontSig_FA" VAL_BLK 0x80026F62 ValA_Wu16 8192.00000000 DINH_LimDFCVerb 12079.0000000 20271.0000000 FORMAT "%13.7" NUMBER 2 /end CHARACTERISTIC
/begin CHARACTERISTIC DINH_Lim.DFC_ComStatACFrontTo_FA_CA "DINH/Zugeordnete Verriegelungslimits für Verriegelungsquelle DFC_ComStatACFrontTo_FA" VAL_BLK 0x80026F66 ValA_Wu16 8192.00000000 DINH_LimDFCVerb 12079.0000000 20271.0000000 FORMAT "%13.7" NUMBER 2 /end CHARACTERISTIC
/begin CHARACTERISTIC DINH_Lim.DFC_ComStatEkpSig_A_CA "DINH/Zugeordnete Verriegelungslimits für Verriegelungsquelle DFC_ComStatEkpSig_A" VAL_BLK 0x80026F6A ValA_Wu16 8192.00000000 DINH_LimDFCVerb 12079.0000000 20271.0000000 FORMAT "%13.7" NUMBER 2 /end CHARACTERISTIC
/begin CHARACTERISTIC DINH_Lim.DFC_ComStatEkpTo_A_CA "DINH/Zugeordnete Verriegelungslimits für Verriegelungsquelle DFC_ComStatEkpTo_A" VAL_BLK 0x80026F6E ValA_Wu16 8192.00000000 DINH_LimDFCVerb 12079.0000000 20271.0000000 FORMAT "%13.7" NUMBER 2 /end CHARACTERISTIC
/begin CHARACTERISTIC DINH_Lim.DFC_ComStatGearRevSig_FA_CA "DINH/Zugeordnete Verriegelungslimits für Verriegelungsquelle DFC_ComStatGearRevSig_FA" VAL_BLK 0x80026F72 ValA_Wu16 8192.00000000 DINH_LimDFCVerb 12079.0000000 20271.0000000 FORMAT "%13.7" NUMBER 2 /end CHARACTERISTIC
/begin CHARACTERISTIC DINH_Lim.DFC_ComStatGearRevTo_FA_CA "DINH/Zugeordnete Verriegelungslimits für Verriegelungsquelle DFC_ComStatGearRevTo_FA" VAL_BLK 0x80026F76 ValA_Wu16 8192.00000000 DINH_LimDFCVerb 12079.0000000 20271.0000000 FORMAT "%13.7" NUMBER 2 /end CHARACTERISTIC
/begin CHARACTERISTIC DINH_Lim.DFC_ComStatZVKlappenSig_FA_CA "DINH/Zugeordnete Verriegelungslimits für Verriegelungsquelle DFC_ComStatZVKlappenSig_FA" VAL_BLK 0x80026F7A ValA_Wu16 8192.00000000 DINH_LimDFCVerb 12079.0000000 20271.0000000 FORMAT "%13.7" NUMBER 2 /end CHARACTERISTIC
/begin CHARACTERISTIC DINH_Lim.DFC_ComStatZVKlappenTo_FA_CA "DINH/Zugeordnete Verriegelungslimits für Verriegelungsquelle DFC_ComStatZVKlappenTo_FA" VAL_BLK 0x80026F7E ValA_Wu16 8192.00000000 DINH_LimDFCVerb 12079.0000000 20271.0000000 FORMAT "%13.7" NUMBER 2 /end CHARACTERISTIC
/begin CHARACTERISTIC DINH_Lim.DFC_ComStateARSCtr_CA "DINH/Zugeordnete Verriegelungslimits für Verriegelungsquelle DFC_ComStateARSCtr" VAL_BLK 0x80026F82 ValA_Wu16 8192.00000000 DINH_LimDFCVerb 12079.0000000 20271.0000000 FORMAT "%13.7" NUMBER 2 /end CHARACTERISTIC
/begin CHARACTERISTIC DINH_Lim.DFC_ComStateARSSig_CA "DINH/Zugeordnete Verriegelungslimits für Verriegelungsquelle DFC_ComStateARSSig" VAL_BLK 0x80026F86 ValA_Wu16 8192.00000000 DINH_LimDFCVerb 12079.0000000 20271.0000000 FORMAT "%13.7" NUMBER 2 /end CHARACTERISTIC
/begin CHARACTERISTIC DINH_Lim.DFC_ComStateARSTo_CA "DINH/Zugeordnete Verriegelungslimits für Verriegelungsquelle DFC_ComStateARSTo" VAL_BLK 0x80026F8A ValA_Wu16 8192.00000000 DINH_LimDFCVerb 12079.0000000 20271.0000000 FORMAT "%13.7" NUMBER 2 /end CHARACTERISTIC
/begin CHARACTERISTIC DINH_Lim.DFC_ComStateDscSig_CA "DINH/Zugeordnete Verriegelungslimits für Verriegelungsquelle DFC_ComStateDscSig" VAL_BLK 0x80026F8E ValA_Wu16 8192.00000000 DINH_LimDFCVerb 12079.0000000 20271.0000000 FORMAT "%13.7" NUMBER 2 /end CHARACTERISTIC
/begin CHARACTERISTIC DINH_Lim.DFC_ComStateDscTo_CA "DINH/Zugeordnete Verriegelungslimits für Verriegelungsquelle DFC_ComStateDscTo" VAL_BLK 0x80026F92 ValA_Wu16 8192.00000000 DINH_LimDFCVerb 12079.0000000 20271.0000000 FORMAT "%13.7" NUMBER 2 /end CHARACTERISTIC
/begin CHARACTERISTIC DINH_Lim.DFC_ComStateSeatSig_CA "DINH/Zugeordnete Verriegelungslimits für Verriegelungsquelle DFC_ComStateSeatSig" VAL_BLK 0x80026F96 ValA_Wu16 8192.00000000 DINH_LimDFCVerb 12079.0000000 20271.0000000 FORMAT "%13.7" NUMBER 2 /end CHARACTERISTIC
/begin CHARACTERISTIC DINH_Lim.DFC_ComStateSeatSig_FA_CA "DINH/Zugeordnete Verriegelungslimits für Verriegelungsquelle DFC_ComStateSeatSig_FA" VAL_BLK 0x80026F9A ValA_Wu16 8192.00000000 DINH_LimDFCVerb 12079.0000000 20271.0000000 FORMAT "%13.7" NUMBER 2 /end CHARACTERISTIC
/begin CHARACTERISTIC DINH_Lim.DFC_ComStateSeatTo_CA "DINH/Zugeordnete Verriegelungslimits für Verriegelungsquelle DFC_ComStateSeatTo" VAL_BLK 0x80026F9E ValA_Wu16 8192.00000000 DINH_LimDFCVerb 12079.0000000 20271.0000000 FORMAT "%13.7" NUMBER 2 /end CHARACTERISTIC
/begin CHARACTERISTIC DINH_Lim.DFC_ComStateSeatTo_FA_CA "DINH/Zugeordnete Verriegelungslimits für Verriegelungsquelle DFC_ComStateSeatTo_FA" VAL_BLK 0x80026FA2 ValA_Wu16 8192.00000000 DINH_LimDFCVerb 12079.0000000 20271.0000000 FORMAT "%13.7" NUMBER 2 /end CHARACTERISTIC
/begin CHARACTERISTIC DINH_Lim.DFC_ComStatusEGSSig_A_CA "DINH/Zugeordnete Verriegelungslimits für Verriegelungsquelle DFC_ComStatusEGSSig_A" VAL_BLK 0x80026FA6 ValA_Wu16 8192.00000000 DINH_LimDFCVerb 12079.0000000 20271.0000000 FORMAT "%13.7" NUMBER 2 /end CHARACTERISTIC
/begin CHARACTERISTIC DINH_Lim.DFC_ComStatusEGSSig_FA_CA "DINH/Zugeordnete Verriegelungslimits für Verriegelungsquelle DFC_ComStatusEGSSig_FA" VAL_BLK 0x80026FAA ValA_Wu16 8192.00000000 DINH_LimDFCVerb 12079.0000000 20271.0000000 FORMAT "%13.7" NUMBER 2 /end CHARACTERISTIC
/begin CHARACTERISTIC DINH_Lim.DFC_ComStatusEGSTo_A_CA "DINH/Zugeordnete Verriegelungslimits für Verriegelungsquelle DFC_ComStatusEGSTo_A" VAL_BLK 0x80026FAE ValA_Wu16 8192.00000000 DINH_LimDFCVerb 12079.0000000 20271.0000000 FORMAT "%13.7" NUMBER 2 /end CHARACTERISTIC
/begin CHARACTERISTIC DINH_Lim.DFC_ComStatusEGSTo_FA_CA "DINH/Zugeordnete Verriegelungslimits für Verriegelungsquelle DFC_ComStatusEGSTo_FA" VAL_BLK 0x80026FB2 ValA_Wu16 8192.00000000 DINH_LimDFCVerb 12079.0000000 20271.0000000 FORMAT "%13.7" NUMBER 2 /end CHARACTERISTIC
/begin CHARACTERISTIC DINH_Lim.DFC_ComStatusEMFChk_CA "DINH/Zugeordnete Verriegelungslimits für Verriegelungsquelle DFC_ComStatusEMFChk" VAL_BLK 0x80026FB6 ValA_Wu16 8192.00000000 DINH_LimDFCVerb 12079.0000000 20271.0000000 FORMAT "%13.7" NUMBER 2 /end CHARACTERISTIC
/begin CHARACTERISTIC DINH_Lim.DFC_ComStatusEMFCtr_CA "DINH/Zugeordnete Verriegelungslimits für Verriegelungsquelle DFC_ComStatusEMFCtr" VAL_BLK 0x80026FBA ValA_Wu16 8192.00000000 DINH_LimDFCVerb 12079.0000000 20271.0000000 FORMAT "%13.7" NUMBER 2 /end CHARACTERISTIC
/begin CHARACTERISTIC DINH_Lim.DFC_ComStatusEMFSig_CA "DINH/Zugeordnete Verriegelungslimits für Verriegelungsquelle DFC_ComStatusEMFSig" VAL_BLK 0x80026FBE ValA_Wu16 8192.00000000 DINH_LimDFCVerb 12079.0000000 20271.0000000 FORMAT "%13.7" NUMBER 2 /end CHARACTERISTIC
/begin CHARACTERISTIC DINH_Lim.DFC_ComStatusEMFTo_CA "DINH/Zugeordnete Verriegelungslimits für Verriegelungsquelle DFC_ComStatusEMFTo" VAL_BLK 0x80026FC2 ValA_Wu16 8192.00000000 DINH_LimDFCVerb 12079.0000000 20271.0000000 FORMAT "%13.7" NUMBER 2 /end CHARACTERISTIC
/begin CHARACTERISTIC DINH_Lim.DFC_ComStatusRGangSig_CA "DINH/Zugeordnete Verriegelungslimits für Verriegelungsquelle DFC_ComStatusRGangSig" VAL_BLK 0x80026FC6 ValA_Wu16 8192.00000000 DINH_LimDFCVerb 12079.0000000 20271.0000000 FORMAT "%13.7" NUMBER 2 /end CHARACTERISTIC
/begin CHARACTERISTIC DINH_Lim.DFC_ComStatusRGangTo_CA "DINH/Zugeordnete Verriegelungslimits für Verriegelungsquelle DFC_ComStatusRGangTo" VAL_BLK 0x80026FCA ValA_Wu16 8192.00000000 DINH_LimDFCVerb 12079.0000000 20271.0000000 FORMAT "%13.7" NUMBER 2 /end CHARACTERISTIC
/begin CHARACTERISTIC DINH_Lim.DFC_ComSteeringAngleChk_FX_CA "DINH/Zugeordnete Verriegelungslimits für Verriegelungsquelle DFC_ComSteeringAngleChk_FX" VAL_BLK 0x80026FCE ValA_Wu16 8192.00000000 DINH_LimDFCVerb 12079.0000000 20271.0000000 FORMAT "%13.7" NUMBER 2 /end CHARACTERISTIC
/begin CHARACTERISTIC DINH_Lim.DFC_ComSteeringAngleCtr_FX_CA "DINH/Zugeordnete Verriegelungslimits für Verriegelungsquelle DFC_ComSteeringAngleCtr_FX" VAL_BLK 0x80026FD2 ValA_Wu16 8192.00000000 DINH_LimDFCVerb 12079.0000000 20271.0000000 FORMAT "%13.7" NUMBER 2 /end CHARACTERISTIC
/begin CHARACTERISTIC DINH_Lim.DFC_ComSteeringAngleTo_FX_CA "DINH/Zugeordnete Verriegelungslimits für Verriegelungsquelle DFC_ComSteeringAngleTo_FX" VAL_BLK 0x80026FD6 ValA_Wu16 8192.00000000 DINH_LimDFCVerb 12079.0000000 20271.0000000 FORMAT "%13.7" NUMBER 2 /end CHARACTERISTIC
/begin CHARACTERISTIC DINH_Lim.DFC_ComTerminalChk_CA "DINH/Zugeordnete Verriegelungslimits für Verriegelungsquelle DFC_ComTerminalChk" VAL_BLK 0x80026FDA ValA_Wu16 8192.00000000 DINH_LimDFCVerb 12079.0000000 20271.0000000 FORMAT "%13.7" NUMBER 2 /end CHARACTERISTIC
/begin CHARACTERISTIC DINH_Lim.DFC_ComTerminalCtr_CA "DINH/Zugeordnete Verriegelungslimits für Verriegelungsquelle DFC_ComTerminalCtr" VAL_BLK 0x80026FDE ValA_Wu16 8192.00000000 DINH_LimDFCVerb 12079.0000000 20271.0000000 FORMAT "%13.7" NUMBER 2 /end CHARACTERISTIC
/begin CHARACTERISTIC DINH_Lim.DFC_ComTerminalSig_CA "DINH/Zugeordnete Verriegelungslimits für Verriegelungsquelle DFC_ComTerminalSig" VAL_BLK 0x80026FE2 ValA_Wu16 8192.00000000 DINH_LimDFCVerb 12079.0000000 20271.0000000 FORMAT "%13.7" NUMBER 2 /end CHARACTERISTIC
/begin CHARACTERISTIC DINH_Lim.DFC_ComTerminalTo_CA "DINH/Zugeordnete Verriegelungslimits für Verriegelungsquelle DFC_ComTerminalTo" VAL_BLK 0x80026FE6 ValA_Wu16 8192.00000000 DINH_LimDFCVerb 12079.0000000 20271.0000000 FORMAT "%13.7" NUMBER 2 /end CHARACTERISTIC
/begin CHARACTERISTIC DINH_Lim.DFC_ComTimeDateSig_FA_CA "DINH/Zugeordnete Verriegelungslimits für Verriegelungsquelle DFC_ComTimeDateSig_FA" VAL_BLK 0x80026FEA ValA_Wu16 8192.00000000 DINH_LimDFCVerb 12079.0000000 20271.0000000 FORMAT "%13.7" NUMBER 2 /end CHARACTERISTIC
/begin CHARACTERISTIC DINH_Lim.DFC_ComTimeDateTo_FA_CA "DINH/Zugeordnete Verriegelungslimits für Verriegelungsquelle DFC_ComTimeDateTo_FA" VAL_BLK 0x80026FEE ValA_Wu16 8192.00000000 DINH_LimDFCVerb 12079.0000000 20271.0000000 FORMAT "%13.7" NUMBER 2 /end CHARACTERISTIC
/begin CHARACTERISTIC DINH_Lim.DFC_ComTrailerSig_CA "DINH/Zugeordnete Verriegelungslimits für Verriegelungsquelle DFC_ComTrailerSig" VAL_BLK 0x80026FF2 ValA_Wu16 8192.00000000 DINH_LimDFCVerb 12079.0000000 20271.0000000 FORMAT "%13.7" NUMBER 2 /end CHARACTERISTIC
/begin CHARACTERISTIC DINH_Lim.DFC_ComTrailerSig_FA_CA "DINH/Zugeordnete Verriegelungslimits für Verriegelungsquelle DFC_ComTrailerSig_FA" VAL_BLK 0x80026FF6 ValA_Wu16 8192.00000000 DINH_LimDFCVerb 12079.0000000 20271.0000000 FORMAT "%13.7" NUMBER 2 /end CHARACTERISTIC
/begin CHARACTERISTIC DINH_Lim.DFC_ComTrailerTo_CA "DINH/Zugeordnete Verriegelungslimits für Verriegelungsquelle DFC_ComTrailerTo" VAL_BLK 0x80026FFA ValA_Wu16 8192.00000000 DINH_LimDFCVerb 12079.0000000 20271.0000000 FORMAT "%13.7" NUMBER 2 /end CHARACTERISTIC
/begin CHARACTERISTIC DINH_Lim.DFC_ComTrailerTo_FA_CA "DINH/Zugeordnete Verriegelungslimits für Verriegelungsquelle DFC_ComTrailerTo_FA" VAL_BLK 0x80026FFE ValA_Wu16 8192.00000000 DINH_LimDFCVerb 12079.0000000 20271.0000000 FORMAT "%13.7" NUMBER 2 /end CHARACTERISTIC
/begin CHARACTERISTIC DINH_Lim.DFC_ComTrqDemCrshDrDyChk_FX_CA "DINH/Zugeordnete Verriegelungslimits für Verriegelungsquelle DFC_ComTrqDemCrshDrDyChk_FX" VAL_BLK 0x80027002 ValA_Wu16 8192.00000000 DINH_LimDFCVerb 12079.0000000 20271.0000000 FORMAT "%13.7" NUMBER 2 /end CHARACTERISTIC
/begin CHARACTERISTIC DINH_Lim.DFC_ComTrqDemCrshDrDyCtr_FX_CA "DINH/Zugeordnete Verriegelungslimits für Verriegelungsquelle DFC_ComTrqDemCrshDrDyCtr_FX" VAL_BLK 0x80027006 ValA_Wu16 8192.00000000 DINH_LimDFCVerb 12079.0000000 20271.0000000 FORMAT "%13.7" NUMBER 2 /end CHARACTERISTIC
/begin CHARACTERISTIC DINH_Lim.DFC_ComTrqDemCrshDrDyTo_FX_CA "DINH/Zugeordnete Verriegelungslimits für Verriegelungsquelle DFC_ComTrqDemCrshDrDyTo_FX" VAL_BLK 0x8002700A ValA_Wu16 8192.00000000 DINH_LimDFCVerb 12079.0000000 20271.0000000 FORMAT "%13.7" NUMBER 2 /end CHARACTERISTIC
/begin CHARACTERISTIC DINH_Lim.DFC_ComTrqDemandDesSig_CA "DINH/Zugeordnete Verriegelungslimits für Verriegelungsquelle DFC_ComTrqDemandDesSig" VAL_BLK 0x8002700E ValA_Wu16 8192.00000000 DINH_LimDFCVerb 12079.0000000 20271.0000000 FORMAT "%13.7" NUMBER 2 /end CHARACTERISTIC
/begin CHARACTERISTIC DINH_Lim.DFC_ComTrqDemandDesTo_CA "DINH/Zugeordnete Verriegelungslimits für Verriegelungsquelle DFC_ComTrqDemandDesTo" VAL_BLK 0x80027012 ValA_Wu16 8192.00000000 DINH_LimDFCVerb 12079.0000000 20271.0000000 FORMAT "%13.7" NUMBER 2 /end CHARACTERISTIC
/begin CHARACTERISTIC DINH_Lim.DFC_ComTrqDemandDscChk_CA "DINH/Zugeordnete Verriegelungslimits für Verriegelungsquelle DFC_ComTrqDemandDscChk" VAL_BLK 0x80027016 ValA_Wu16 8192.00000000 DINH_LimDFCVerb 12079.0000000 20271.0000000 FORMAT "%13.7" NUMBER 3 /end CHARACTERISTIC
/begin CHARACTERISTIC DINH_Lim.DFC_ComTrqDemandDscCtr_CA "DINH/Zugeordnete Verriegelungslimits für Verriegelungsquelle DFC_ComTrqDemandDscCtr" VAL_BLK 0x8002701C ValA_Wu16 8192.00000000 DINH_LimDFCVerb 12079.0000000 20271.0000000 FORMAT "%13.7" NUMBER 3 /end CHARACTERISTIC
/begin CHARACTERISTIC DINH_Lim.DFC_ComTrqDemandDscSig_CA "DINH/Zugeordnete Verriegelungslimits für Verriegelungsquelle DFC_ComTrqDemandDscSig" VAL_BLK 0x80027022 ValA_Wu16 8192.00000000 DINH_LimDFCVerb 12079.0000000 20271.0000000 FORMAT "%13.7" NUMBER 3 /end CHARACTERISTIC
/begin CHARACTERISTIC DINH_Lim.DFC_ComTrqDemandDscTo_CA "DINH/Zugeordnete Verriegelungslimits für Verriegelungsquelle DFC_ComTrqDemandDscTo" VAL_BLK 0x80027028 ValA_Wu16 8192.00000000 DINH_LimDFCVerb 12079.0000000 20271.0000000 FORMAT "%13.7" NUMBER 3 /end CHARACTERISTIC
/begin CHARACTERISTIC DINH_Lim.DFC_ComTrqDemandGbxChk_A_CA "DINH/Zugeordnete Verriegelungslimits für Verriegelungsquelle DFC_ComTrqDemandGbxChk_A" VAL_BLK 0x8002702E ValA_Wu16 8192.00000000 DINH_LimDFCVerb 12079.0000000 20271.0000000 FORMAT "%13.7" NUMBER 2 /end CHARACTERISTIC
/begin CHARACTERISTIC DINH_Lim.DFC_ComTrqDemandGbxChk_FA_CA "DINH/Zugeordnete Verriegelungslimits für Verriegelungsquelle DFC_ComTrqDemandGbxChk_FA" VAL_BLK 0x80027032 ValA_Wu16 8192.00000000 DINH_LimDFCVerb 12079.0000000 20271.0000000 FORMAT "%13.7" NUMBER 2 /end CHARACTERISTIC
/begin CHARACTERISTIC DINH_Lim.DFC_ComTrqDemandGbxCtr_A_CA "DINH/Zugeordnete Verriegelungslimits für Verriegelungsquelle DFC_ComTrqDemandGbxCtr_A" VAL_BLK 0x80027036 ValA_Wu16 8192.00000000 DINH_LimDFCVerb 12079.0000000 20271.0000000 FORMAT "%13.7" NUMBER 2 /end CHARACTERISTIC
/begin CHARACTERISTIC DINH_Lim.DFC_ComTrqDemandGbxCtr_FA_CA "DINH/Zugeordnete Verriegelungslimits für Verriegelungsquelle DFC_ComTrqDemandGbxCtr_FA" VAL_BLK 0x8002703A ValA_Wu16 8192.00000000 DINH_LimDFCVerb 12079.0000000 20271.0000000 FORMAT "%13.7" NUMBER 2 /end CHARACTERISTIC
/begin CHARACTERISTIC DINH_Lim.DFC_ComTrqDemandGbxSig_A_CA "DINH/Zugeordnete Verriegelungslimits für Verriegelungsquelle DFC_ComTrqDemandGbxSig_A" VAL_BLK 0x8002703E ValA_Wu16 8192.00000000 DINH_LimDFCVerb 12079.0000000 20271.0000000 FORMAT "%13.7" NUMBER 2 /end CHARACTERISTIC
/begin CHARACTERISTIC DINH_Lim.DFC_ComTrqDemandGbxSig_FA_CA "DINH/Zugeordnete Verriegelungslimits für Verriegelungsquelle DFC_ComTrqDemandGbxSig_FA" VAL_BLK 0x80027042 ValA_Wu16 8192.00000000 DINH_LimDFCVerb 12079.0000000 20271.0000000 FORMAT "%13.7" NUMBER 2 /end CHARACTERISTIC
/begin CHARACTERISTIC DINH_Lim.DFC_ComTrqDemandGbxTo_A_CA "DINH/Zugeordnete Verriegelungslimits für Verriegelungsquelle DFC_ComTrqDemandGbxTo_A" VAL_BLK 0x80027046 ValA_Wu16 8192.00000000 DINH_LimDFCVerb 12079.0000000 20271.0000000 FORMAT "%13.7" NUMBER 2 /end CHARACTERISTIC
/begin CHARACTERISTIC DINH_Lim.DFC_ComTrqDemandGbxTo_FA_CA "DINH/Zugeordnete Verriegelungslimits für Verriegelungsquelle DFC_ComTrqDemandGbxTo_FA" VAL_BLK 0x8002704A ValA_Wu16 8192.00000000 DINH_LimDFCVerb 12079.0000000 20271.0000000 FORMAT "%13.7" NUMBER 2 /end CHARACTERISTIC
/begin CHARACTERISTIC DINH_Lim.DFC_ComTrqWhlDemChk_CA "DINH/Zugeordnete Verriegelungslimits für Verriegelungsquelle DFC_ComTrqWhlDemChk" VAL_BLK 0x8002704E ValA_Wu16 8192.00000000 DINH_LimDFCVerb 12079.0000000 20271.0000000 FORMAT "%13.7" NUMBER 2 /end CHARACTERISTIC
/begin CHARACTERISTIC DINH_Lim.DFC_ComTrqWhlDemCtr_CA "DINH/Zugeordnete Verriegelungslimits für Verriegelungsquelle DFC_ComTrqWhlDemCtr" VAL_BLK 0x80027052 ValA_Wu16 8192.00000000 DINH_LimDFCVerb 12079.0000000 20271.0000000 FORMAT "%13.7" NUMBER 2 /end CHARACTERISTIC
/begin CHARACTERISTIC DINH_Lim.DFC_ComTrqWhlDemFASChk_FX_CA "DINH/Zugeordnete Verriegelungslimits für Verriegelungsquelle DFC_ComTrqWhlDemFASChk_FX" VAL_BLK 0x80027056 ValA_Wu16 8192.00000000 DINH_LimDFCVerb 12079.0000000 20271.0000000 FORMAT "%13.7" NUMBER 2 /end CHARACTERISTIC
/begin CHARACTERISTIC DINH_Lim.DFC_ComTrqWhlDemFASCtr_FX_CA "DINH/Zugeordnete Verriegelungslimits für Verriegelungsquelle DFC_ComTrqWhlDemFASCtr_FX" VAL_BLK 0x8002705A ValA_Wu16 8192.00000000 DINH_LimDFCVerb 12079.0000000 20271.0000000 FORMAT "%13.7" NUMBER 2 /end CHARACTERISTIC
/begin CHARACTERISTIC DINH_Lim.DFC_ComTrqWhlDemFASTo_FX_CA "DINH/Zugeordnete Verriegelungslimits für Verriegelungsquelle DFC_ComTrqWhlDemFASTo_FX" VAL_BLK 0x8002705E ValA_Wu16 8192.00000000 DINH_LimDFCVerb 12079.0000000 20271.0000000 FORMAT "%13.7" NUMBER 2 /end CHARACTERISTIC
/begin CHARACTERISTIC DINH_Lim.DFC_ComTrqWhlDemSig_CA "DINH/Zugeordnete Verriegelungslimits für Verriegelungsquelle DFC_ComTrqWhlDemSig" VAL_BLK 0x80027062 ValA_Wu16 8192.00000000 DINH_LimDFCVerb 12079.0000000 20271.0000000 FORMAT "%13.7" NUMBER 2 /end CHARACTERISTIC
/begin CHARACTERISTIC DINH_Lim.DFC_ComTrqWhlDemTo_CA "DINH/Zugeordnete Verriegelungslimits für Verriegelungsquelle DFC_ComTrqWhlDemTo" VAL_BLK 0x80027066 ValA_Wu16 8192.00000000 DINH_LimDFCVerb 12079.0000000 20271.0000000 FORMAT "%13.7" NUMBER 2 /end CHARACTERISTIC
/begin CHARACTERISTIC DINH_Lim.DFC_ComVelocityChk_FA_CA "DINH/Zugeordnete Verriegelungslimits für Verriegelungsquelle DFC_ComVelocityChk_FA" VAL_BLK 0x8002706A ValA_Wu16 8192.00000000 DINH_LimDFCVerb 12079.0000000 20271.0000000 FORMAT "%13.7" NUMBER 2 /end CHARACTERISTIC
/begin CHARACTERISTIC DINH_Lim.DFC_ComVelocityCtr_FA_CA "DINH/Zugeordnete Verriegelungslimits für Verriegelungsquelle DFC_ComVelocityCtr_FA" VAL_BLK 0x8002706E ValA_Wu16 8192.00000000 DINH_LimDFCVerb 12079.0000000 20271.0000000 FORMAT "%13.7" NUMBER 2 /end CHARACTERISTIC
/begin CHARACTERISTIC DINH_Lim.DFC_ComVelocitySig_CA "DINH/Zugeordnete Verriegelungslimits für Verriegelungsquelle DFC_ComVelocitySig" VAL_BLK 0x80027072 ValA_Wu16 8192.00000000 DINH_LimDFCVerb 12079.0000000 20271.0000000 FORMAT "%13.7" NUMBER 2 /end CHARACTERISTIC
/begin CHARACTERISTIC DINH_Lim.DFC_ComVelocitySig_FA_CA "DINH/Zugeordnete Verriegelungslimits für Verriegelungsquelle DFC_ComVelocitySig_FA" VAL_BLK 0x80027076 ValA_Wu16 8192.00000000 DINH_LimDFCVerb 12079.0000000 20271.0000000 FORMAT "%13.7" NUMBER 2 /end CHARACTERISTIC
/begin CHARACTERISTIC DINH_Lim.DFC_ComVelocityTo_CA "DINH/Zugeordnete Verriegelungslimits für Verriegelungsquelle DFC_ComVelocityTo" VAL_BLK 0x8002707A ValA_Wu16 8192.00000000 DINH_LimDFCVerb 12079.0000000 20271.0000000 FORMAT "%13.7" NUMBER 2 /end CHARACTERISTIC
/begin CHARACTERISTIC DINH_Lim.DFC_ComVelocityTo_FA_CA "DINH/Zugeordnete Verriegelungslimits für Verriegelungsquelle DFC_ComVelocityTo_FA" VAL_BLK 0x8002707E ValA_Wu16 8192.00000000 DINH_LimDFCVerb 12079.0000000 20271.0000000 FORMAT "%13.7" NUMBER 2 /end CHARACTERISTIC
/begin CHARACTERISTIC DINH_Lim.DFC_ComVerbraucherTo_CA "DINH/Zugeordnete Verriegelungslimits für Verriegelungsquelle DFC_ComVerbraucherTo" VAL_BLK 0x80027082 ValA_Wu16 8192.00000000 DINH_LimDFCVerb 12079.0000000 20271.0000000 FORMAT "%13.7" NUMBER 2 /end CHARACTERISTIC
/begin CHARACTERISTIC DINH_Lim.DFC_ComWMomPTStabChk_FX_CA "DINH/Zugeordnete Verriegelungslimits für Verriegelungsquelle DFC_ComWMomPTStabChk_FX" VAL_BLK 0x80027086 ValA_Wu16 8192.00000000 DINH_LimDFCVerb 12079.0000000 20271.0000000 FORMAT "%13.7" NUMBER 2 /end CHARACTERISTIC
/begin CHARACTERISTIC DINH_Lim.DFC_ComWMomPTStabCtr_FX_CA "DINH/Zugeordnete Verriegelungslimits für Verriegelungsquelle DFC_ComWMomPTStabCtr_FX" VAL_BLK 0x8002708A ValA_Wu16 8192.00000000 DINH_LimDFCVerb 12079.0000000 20271.0000000 FORMAT "%13.7" NUMBER 2 /end CHARACTERISTIC
/begin CHARACTERISTIC DINH_Lim.DFC_ComWMomPTStabTo_FX_CA "DINH/Zugeordnete Verriegelungslimits für Verriegelungsquelle DFC_ComWMomPTStabTo_FX" VAL_BLK 0x8002708E ValA_Wu16 8192.00000000 DINH_LimDFCVerb 12079.0000000 20271.0000000 FORMAT "%13.7" NUMBER 2 /end CHARACTERISTIC
/begin CHARACTERISTIC DINH_Lim.DFC_ComWheelSpeedSig_CA "DINH/Zugeordnete Verriegelungslimits für Verriegelungsquelle DFC_ComWheelSpeedSig" VAL_BLK 0x80027092 ValA_Wu16 8192.00000000 DINH_LimDFCVerb 12079.0000000 20271.0000000 FORMAT "%13.7" NUMBER 5 /end CHARACTERISTIC
/begin CHARACTERISTIC DINH_Lim.DFC_ComWheelSpeedTo_CA "DINH/Zugeordnete Verriegelungslimits für Verriegelungsquelle DFC_ComWheelSpeedTo" VAL_BLK 0x8002709C ValA_Wu16 8192.00000000 DINH_LimDFCVerb 12079.0000000 20271.0000000 FORMAT "%13.7" NUMBER 5 /end CHARACTERISTIC
/begin CHARACTERISTIC DINH_Lim.DFC_ComZvKlappenSig_CA "DINH/Zugeordnete Verriegelungslimits für Verriegelungsquelle DFC_ComZvKlappenSig" VAL_BLK 0x800270A6 ValA_Wu16 8192.00000000 DINH_LimDFCVerb 12079.0000000 20271.0000000 FORMAT "%13.7" NUMBER 2 /end CHARACTERISTIC
/begin CHARACTERISTIC DINH_Lim.DFC_ComZvKlappenTo_CA "DINH/Zugeordnete Verriegelungslimits für Verriegelungsquelle DFC_ComZvKlappenTo" VAL_BLK 0x800270AA ValA_Wu16 8192.00000000 DINH_LimDFCVerb 12079.0000000 20271.0000000 FORMAT "%13.7" NUMBER 2 /end CHARACTERISTIC
/begin CHARACTERISTIC DINH_Lim.DFC_ComaDirectChk_FX_CA "DINH/Zugeordnete Verriegelungslimits für Verriegelungsquelle DFC_ComaDirectChk_FX" VAL_BLK 0x800270AE ValA_Wu16 8192.00000000 DINH_LimDFCVerb 12079.0000000 20271.0000000 FORMAT "%13.7" NUMBER 2 /end CHARACTERISTIC
/begin CHARACTERISTIC DINH_Lim.DFC_ComaDirectCtr_FX_CA "DINH/Zugeordnete Verriegelungslimits für Verriegelungsquelle DFC_ComaDirectCtr_FX" VAL_BLK 0x800270B2 ValA_Wu16 8192.00000000 DINH_LimDFCVerb 12079.0000000 20271.0000000 FORMAT "%13.7" NUMBER 2 /end CHARACTERISTIC
/begin CHARACTERISTIC DINH_Lim.DFC_ComaDirectTo_FX_CA "DINH/Zugeordnete Verriegelungslimits für Verriegelungsquelle DFC_ComaDirectTo_FX" VAL_BLK 0x800270B6 ValA_Wu16 8192.00000000 DINH_LimDFCVerb 12079.0000000 20271.0000000 FORMAT "%13.7" NUMBER 2 /end CHARACTERISTIC
/begin CHARACTERISTIC DINH_Lim.DFC_ComaSideChk_FX_CA "DINH/Zugeordnete Verriegelungslimits für Verriegelungsquelle DFC_ComaSideChk_FX" VAL_BLK 0x800270BA ValA_Wu16 8192.00000000 DINH_LimDFCVerb 12079.0000000 20271.0000000 FORMAT "%13.7" NUMBER 2 /end CHARACTERISTIC
/begin CHARACTERISTIC DINH_Lim.DFC_ComaSideCtr_FX_CA "DINH/Zugeordnete Verriegelungslimits für Verriegelungsquelle DFC_ComaSideCtr_FX" VAL_BLK 0x800270BE ValA_Wu16 8192.00000000 DINH_LimDFCVerb 12079.0000000 20271.0000000 FORMAT "%13.7" NUMBER 2 /end CHARACTERISTIC
/begin CHARACTERISTIC DINH_Lim.DFC_ComaSideTo_FX_CA "DINH/Zugeordnete Verriegelungslimits für Verriegelungsquelle DFC_ComaSideTo_FX" VAL_BLK 0x800270C2 ValA_Wu16 8192.00000000 DINH_LimDFCVerb 12079.0000000 20271.0000000 FORMAT "%13.7" NUMBER 2 /end CHARACTERISTIC
/begin CHARACTERISTIC DINH_Lim.DFC_Cy320SpiCom_CA "DINH/Zugeordnete Verriegelungslimits für Verriegelungsquelle DFC_Cy320SpiCom" VAL_BLK 0x800270C6 ValA_Wu16 8192.00000000 DINH_LimDFCVerb 12079.0000000 20271.0000000 FORMAT "%13.7" NUMBER 2 /end CHARACTERISTIC
/begin CHARACTERISTIC DINH_Lim.DFC_ETCtlDvtInrMax_CA "DINH/Zugeordnete Verriegelungslimits für Verriegelungsquelle DFC_ETCtlDvtInrMax" VAL_BLK 0x800270CA ValA_Wu16 8192.00000000 DINH_LimDFCVerb 12079.0000000 20271.0000000 FORMAT "%13.7" NUMBER 2 /end CHARACTERISTIC
/begin CHARACTERISTIC DINH_Lim.DFC_ETCtlDvtInrMin_CA "DINH/Zugeordnete Verriegelungslimits für Verriegelungsquelle DFC_ETCtlDvtInrMin" VAL_BLK 0x800270CE ValA_Wu16 8192.00000000 DINH_LimDFCVerb 12079.0000000 20271.0000000 FORMAT "%13.7" NUMBER 2 /end CHARACTERISTIC
/begin CHARACTERISTIC DINH_Lim.DFC_ETCtlDvtOutrMax_CA "DINH/Zugeordnete Verriegelungslimits für Verriegelungsquelle DFC_ETCtlDvtOutrMax" VAL_BLK 0x800270D2 ValA_Wu16 8192.00000000 DINH_LimDFCVerb 12079.0000000 20271.0000000 FORMAT "%13.7" NUMBER 2 /end CHARACTERISTIC
/begin CHARACTERISTIC DINH_Lim.DFC_ETCtlDvtOutrMin_CA "DINH/Zugeordnete Verriegelungslimits für Verriegelungsquelle DFC_ETCtlDvtOutrMin" VAL_BLK 0x800270D6 ValA_Wu16 8192.00000000 DINH_LimDFCVerb 12079.0000000 20271.0000000 FORMAT "%13.7" NUMBER 2 /end CHARACTERISTIC
/begin CHARACTERISTIC DINH_Lim.DFC_FBCqDvtMax_CA "DINH/Zugeordnete Verriegelungslimits für Verriegelungsquelle DFC_FBCqDvtMax" VAL_BLK 0x800270DA ValA_Wu16 8192.00000000 DINH_LimDFCVerb 12079.0000000 20271.0000000 FORMAT "%13.7" NUMBER 2 /end CHARACTERISTIC
/begin CHARACTERISTIC DINH_Lim.DFC_FBCqDvtMin_CA "DINH/Zugeordnete Verriegelungslimits für Verriegelungsquelle DFC_FBCqDvtMin" VAL_BLK 0x800270DE ValA_Wu16 8192.00000000 DINH_LimDFCVerb 12079.0000000 20271.0000000 FORMAT "%13.7" NUMBER 2 /end CHARACTERISTIC
/begin CHARACTERISTIC DINH_Lim.DFC_Fan4WinErr1_CA "DINH/Zugeordnete Verriegelungslimits für Verriegelungsquelle DFC_Fan4WinErr1" VAL_BLK 0x800270E2 ValA_Wu16 8192.00000000 DINH_LimDFCVerb 12079.0000000 20271.0000000 FORMAT "%13.7" NUMBER 2 /end CHARACTERISTIC
/begin CHARACTERISTIC DINH_Lim.DFC_Fan4WinErr2_CA "DINH/Zugeordnete Verriegelungslimits für Verriegelungsquelle DFC_Fan4WinErr2" VAL_BLK 0x800270E6 ValA_Wu16 8192.00000000 DINH_LimDFCVerb 12079.0000000 20271.0000000 FORMAT "%13.7" NUMBER 2 /end CHARACTERISTIC
/begin CHARACTERISTIC DINH_Lim.DFC_Fan4WinErr3_CA "DINH/Zugeordnete Verriegelungslimits für Verriegelungsquelle DFC_Fan4WinErr3" VAL_BLK 0x800270EA ValA_Wu16 8192.00000000 DINH_LimDFCVerb 12079.0000000 20271.0000000 FORMAT "%13.7" NUMBER 2 /end CHARACTERISTIC
/begin CHARACTERISTIC DINH_Lim.DFC_Fan4WinErr4_CA "DINH/Zugeordnete Verriegelungslimits für Verriegelungsquelle DFC_Fan4WinErr4" VAL_BLK 0x800270EE ValA_Wu16 8192.00000000 DINH_LimDFCVerb 12079.0000000 20271.0000000 FORMAT "%13.7" NUMBER 2 /end CHARACTERISTIC
/begin CHARACTERISTIC DINH_Lim.DFC_FanSCG_CA "DINH/Zugeordnete Verriegelungslimits für Verriegelungsquelle DFC_FanSCG" VAL_BLK 0x800270F2 ValA_Wu16 8192.00000000 DINH_LimDFCVerb 12079.0000000 20271.0000000 FORMAT "%13.7" NUMBER 2 /end CHARACTERISTIC
/begin CHARACTERISTIC DINH_Lim.DFC_FlFCBS_CA "DINH/Zugeordnete Verriegelungslimits für Verriegelungsquelle DFC_FlFCBS" VAL_BLK 0x800270F6 ValA_Wu16 8192.00000000 DINH_LimDFCVerb 12079.0000000 20271.0000000 FORMAT "%13.7" NUMBER 2 /end CHARACTERISTIC
/begin CHARACTERISTIC DINH_Lim.DFC_GlwEcuConfigErr_CA "DINH/Zugeordnete Verriegelungslimits für Verriegelungsquelle DFC_GlwEcuConfigErr" VAL_BLK 0x800270FA ValA_Wu16 8192.00000000 DINH_LimDFCVerb 12079.0000000 20271.0000000 FORMAT "%13.7" NUMBER 2 /end CHARACTERISTIC
/begin CHARACTERISTIC DINH_Lim.DFC_GlwEcuEepErr_CA "DINH/Zugeordnete Verriegelungslimits für Verriegelungsquelle DFC_GlwEcuEepErr" VAL_BLK 0x800270FE ValA_Wu16 8192.00000000 DINH_LimDFCVerb 12079.0000000 20271.0000000 FORMAT "%13.7" NUMBER 2 /end CHARACTERISTIC
/begin CHARACTERISTIC DINH_Lim.DFC_GlwEcuFrmErr_CA "DINH/Zugeordnete Verriegelungslimits für Verriegelungsquelle DFC_GlwEcuFrmErr" VAL_BLK 0x80027102 ValA_Wu16 8192.00000000 DINH_LimDFCVerb 12079.0000000 20271.0000000 FORMAT "%13.7" NUMBER 2 /end CHARACTERISTIC
/begin CHARACTERISTIC DINH_Lim.DFC_GlwEcuGPCMFaultInfo_CA "DINH/Zugeordnete Verriegelungslimits für Verriegelungsquelle DFC_GlwEcuGPCMFaultInfo" VAL_BLK 0x80027106 ValA_Wu16 8192.00000000 DINH_LimDFCVerb 12079.0000000 20271.0000000 FORMAT "%13.7" NUMBER 3 /end CHARACTERISTIC
/begin CHARACTERISTIC DINH_Lim.DFC_GlwEcuGPCMInfo_CA "DINH/Zugeordnete Verriegelungslimits für Verriegelungsquelle DFC_GlwEcuGPCMInfo" VAL_BLK 0x8002710C ValA_Wu16 8192.00000000 DINH_LimDFCVerb 12079.0000000 20271.0000000 FORMAT "%13.7" NUMBER 4 /end CHARACTERISTIC
/begin CHARACTERISTIC DINH_Lim.DFC_GlwEcuGk1HSS_CA "DINH/Zugeordnete Verriegelungslimits für Verriegelungsquelle DFC_GlwEcuGk1HSS" VAL_BLK 0x80027114 ValA_Wu16 8192.00000000 DINH_LimDFCVerb 12079.0000000 20271.0000000 FORMAT "%13.7" NUMBER 2 /end CHARACTERISTIC
/begin CHARACTERISTIC DINH_Lim.DFC_GlwEcuGk1OL_CA "DINH/Zugeordnete Verriegelungslimits für Verriegelungsquelle DFC_GlwEcuGk1OL" VAL_BLK 0x80027118 ValA_Wu16 8192.00000000 DINH_LimDFCVerb 12079.0000000 20271.0000000 FORMAT "%13.7" NUMBER 2 /end CHARACTERISTIC
/begin CHARACTERISTIC DINH_Lim.DFC_GlwEcuGk1SC_CA "DINH/Zugeordnete Verriegelungslimits für Verriegelungsquelle DFC_GlwEcuGk1SC" VAL_BLK 0x8002711C ValA_Wu16 8192.00000000 DINH_LimDFCVerb 12079.0000000 20271.0000000 FORMAT "%13.7" NUMBER 2 /end CHARACTERISTIC
/begin CHARACTERISTIC DINH_Lim.DFC_GlwEcuGk1Wdst_CA "DINH/Zugeordnete Verriegelungslimits für Verriegelungsquelle DFC_GlwEcuGk1Wdst" VAL_BLK 0x80027120 ValA_Wu16 8192.00000000 DINH_LimDFCVerb 12079.0000000 20271.0000000 FORMAT "%13.7" NUMBER 2 /end CHARACTERISTIC
/begin CHARACTERISTIC DINH_Lim.DFC_GlwEcuGk2HSS_CA "DINH/Zugeordnete Verriegelungslimits für Verriegelungsquelle DFC_GlwEcuGk2HSS" VAL_BLK 0x80027124 ValA_Wu16 8192.00000000 DINH_LimDFCVerb 12079.0000000 20271.0000000 FORMAT "%13.7" NUMBER 2 /end CHARACTERISTIC
/begin CHARACTERISTIC DINH_Lim.DFC_GlwEcuGk2OL_CA "DINH/Zugeordnete Verriegelungslimits für Verriegelungsquelle DFC_GlwEcuGk2OL" VAL_BLK 0x80027128 ValA_Wu16 8192.00000000 DINH_LimDFCVerb 12079.0000000 20271.0000000 FORMAT "%13.7" NUMBER 2 /end CHARACTERISTIC
/begin CHARACTERISTIC DINH_Lim.DFC_GlwEcuGk2SC_CA "DINH/Zugeordnete Verriegelungslimits für Verriegelungsquelle DFC_GlwEcuGk2SC" VAL_BLK 0x8002712C ValA_Wu16 8192.00000000 DINH_LimDFCVerb 12079.0000000 20271.0000000 FORMAT "%13.7" NUMBER 2 /end CHARACTERISTIC
/begin CHARACTERISTIC DINH_Lim.DFC_GlwEcuGk2Wdst_CA "DINH/Zugeordnete Verriegelungslimits für Verriegelungsquelle DFC_GlwEcuGk2Wdst" VAL_BLK 0x80027130 ValA_Wu16 8192.00000000 DINH_LimDFCVerb 12079.0000000 20271.0000000 FORMAT "%13.7" NUMBER 2 /end CHARACTERISTIC
/begin CHARACTERISTIC DINH_Lim.DFC_GlwEcuGk3HSS_CA "DINH/Zugeordnete Verriegelungslimits für Verriegelungsquelle DFC_GlwEcuGk3HSS" VAL_BLK 0x80027134 ValA_Wu16 8192.00000000 DINH_LimDFCVerb 12079.0000000 20271.0000000 FORMAT "%13.7" NUMBER 2 /end CHARACTERISTIC
/begin CHARACTERISTIC DINH_Lim.DFC_GlwEcuGk3OL_CA "DINH/Zugeordnete Verriegelungslimits für Verriegelungsquelle DFC_GlwEcuGk3OL" VAL_BLK 0x80027138 ValA_Wu16 8192.00000000 DINH_LimDFCVerb 12079.0000000 20271.0000000 FORMAT "%13.7" NUMBER 2 /end CHARACTERISTIC
/begin CHARACTERISTIC DINH_Lim.DFC_GlwEcuGk3SC_CA "DINH/Zugeordnete Verriegelungslimits für Verriegelungsquelle DFC_GlwEcuGk3SC" VAL_BLK 0x8002713C ValA_Wu16 8192.00000000 DINH_LimDFCVerb 12079.0000000 20271.0000000 FORMAT "%13.7" NUMBER 2 /end CHARACTERISTIC
/begin CHARACTERISTIC DINH_Lim.DFC_GlwEcuGk3Wdst_CA "DINH/Zugeordnete Verriegelungslimits für Verriegelungsquelle DFC_GlwEcuGk3Wdst" VAL_BLK 0x80027140 ValA_Wu16 8192.00000000 DINH_LimDFCVerb 12079.0000000 20271.0000000 FORMAT "%13.7" NUMBER 2 /end CHARACTERISTIC
/begin CHARACTERISTIC DINH_Lim.DFC_GlwEcuGk4HSS_CA "DINH/Zugeordnete Verriegelungslimits für Verriegelungsquelle DFC_GlwEcuGk4HSS" VAL_BLK 0x80027144 ValA_Wu16 8192.00000000 DINH_LimDFCVerb 12079.0000000 20271.0000000 FORMAT "%13.7" NUMBER 2 /end CHARACTERISTIC
/begin CHARACTERISTIC DINH_Lim.DFC_GlwEcuGk4OL_CA "DINH/Zugeordnete Verriegelungslimits für Verriegelungsquelle DFC_GlwEcuGk4OL" VAL_BLK 0x80027148 ValA_Wu16 8192.00000000 DINH_LimDFCVerb 12079.0000000 20271.0000000 FORMAT "%13.7" NUMBER 2 /end CHARACTERISTIC
/begin CHARACTERISTIC DINH_Lim.DFC_GlwEcuGk4SC_CA "DINH/Zugeordnete Verriegelungslimits für Verriegelungsquelle DFC_GlwEcuGk4SC" VAL_BLK 0x8002714C ValA_Wu16 8192.00000000 DINH_LimDFCVerb 12079.0000000 20271.0000000 FORMAT "%13.7" NUMBER 2 /end CHARACTERISTIC
/begin CHARACTERISTIC DINH_Lim.DFC_GlwEcuGk4Wdst_CA "DINH/Zugeordnete Verriegelungslimits für Verriegelungsquelle DFC_GlwEcuGk4Wdst" VAL_BLK 0x80027150 ValA_Wu16 8192.00000000 DINH_LimDFCVerb 12079.0000000 20271.0000000 FORMAT "%13.7" NUMBER 2 /end CHARACTERISTIC
/begin CHARACTERISTIC DINH_Lim.DFC_GlwEcuGk5HSS_CA "DINH/Zugeordnete Verriegelungslimits für Verriegelungsquelle DFC_GlwEcuGk5HSS" VAL_BLK 0x80027154 ValA_Wu16 8192.00000000 DINH_LimDFCVerb 12079.0000000 20271.0000000 FORMAT "%13.7" NUMBER 2 /end CHARACTERISTIC
/begin CHARACTERISTIC DINH_Lim.DFC_GlwEcuGk5OL_CA "DINH/Zugeordnete Verriegelungslimits für Verriegelungsquelle DFC_GlwEcuGk5OL" VAL_BLK 0x80027158 ValA_Wu16 8192.00000000 DINH_LimDFCVerb 12079.0000000 20271.0000000 FORMAT "%13.7" NUMBER 2 /end CHARACTERISTIC
/begin CHARACTERISTIC DINH_Lim.DFC_GlwEcuGk5SC_CA "DINH/Zugeordnete Verriegelungslimits für Verriegelungsquelle DFC_GlwEcuGk5SC" VAL_BLK 0x8002715C ValA_Wu16 8192.00000000 DINH_LimDFCVerb 12079.0000000 20271.0000000 FORMAT "%13.7" NUMBER 2 /end CHARACTERISTIC
/begin CHARACTERISTIC DINH_Lim.DFC_GlwEcuGk5Wdst_CA "DINH/Zugeordnete Verriegelungslimits für Verriegelungsquelle DFC_GlwEcuGk5Wdst" VAL_BLK 0x80027160 ValA_Wu16 8192.00000000 DINH_LimDFCVerb 12079.0000000 20271.0000000 FORMAT "%13.7" NUMBER 2 /end CHARACTERISTIC
/begin CHARACTERISTIC DINH_Lim.DFC_GlwEcuGk6HSS_CA "DINH/Zugeordnete Verriegelungslimits für Verriegelungsquelle DFC_GlwEcuGk6HSS" VAL_BLK 0x80027164 ValA_Wu16 8192.00000000 DINH_LimDFCVerb 12079.0000000 20271.0000000 FORMAT "%13.7" NUMBER 2 /end CHARACTERISTIC
/begin CHARACTERISTIC DINH_Lim.DFC_GlwEcuGk6OL_CA "DINH/Zugeordnete Verriegelungslimits für Verriegelungsquelle DFC_GlwEcuGk6OL" VAL_BLK 0x80027168 ValA_Wu16 8192.00000000 DINH_LimDFCVerb 12079.0000000 20271.0000000 FORMAT "%13.7" NUMBER 2 /end CHARACTERISTIC
/begin CHARACTERISTIC DINH_Lim.DFC_GlwEcuGk6SC_CA "DINH/Zugeordnete Verriegelungslimits für Verriegelungsquelle DFC_GlwEcuGk6SC" VAL_BLK 0x8002716C ValA_Wu16 8192.00000000 DINH_LimDFCVerb 12079.0000000 20271.0000000 FORMAT "%13.7" NUMBER 2 /end CHARACTERISTIC
/begin CHARACTERISTIC DINH_Lim.DFC_GlwEcuGk6Wdst_CA "DINH/Zugeordnete Verriegelungslimits für Verriegelungsquelle DFC_GlwEcuGk6Wdst" VAL_BLK 0x80027170 ValA_Wu16 8192.00000000 DINH_LimDFCVerb 12079.0000000 20271.0000000 FORMAT "%13.7" NUMBER 2 /end CHARACTERISTIC
/begin CHARACTERISTIC DINH_Lim.DFC_GlwEcuGndErr_CA "DINH/Zugeordnete Verriegelungslimits für Verriegelungsquelle DFC_GlwEcuGndErr" VAL_BLK 0x80027174 ValA_Wu16 8192.00000000 DINH_LimDFCVerb 12079.0000000 20271.0000000 FORMAT "%13.7" NUMBER 2 /end CHARACTERISTIC
/begin CHARACTERISTIC DINH_Lim.DFC_GlwEcuIntErr_CA "DINH/Zugeordnete Verriegelungslimits für Verriegelungsquelle DFC_GlwEcuIntErr" VAL_BLK 0x80027178 ValA_Wu16 8192.00000000 DINH_LimDFCVerb 12079.0000000 20271.0000000 FORMAT "%13.7" NUMBER 2 /end CHARACTERISTIC
/begin CHARACTERISTIC DINH_Lim.DFC_GlwEcuMsgTimeout_CA "DINH/Zugeordnete Verriegelungslimits für Verriegelungsquelle DFC_GlwEcuMsgTimeout" VAL_BLK 0x8002717C ValA_Wu16 8192.00000000 DINH_LimDFCVerb 12079.0000000 20271.0000000 FORMAT "%13.7" NUMBER 2 /end CHARACTERISTIC
/begin CHARACTERISTIC DINH_Lim.DFC_GlwEcuT30Err_CA "DINH/Zugeordnete Verriegelungslimits für Verriegelungsquelle DFC_GlwEcuT30Err" VAL_BLK 0x80027180 ValA_Wu16 8192.00000000 DINH_LimDFCVerb 12079.0000000 20271.0000000 FORMAT "%13.7" NUMBER 2 /end CHARACTERISTIC
/begin CHARACTERISTIC DINH_Lim.DFC_GlwEcuTempErr_CA "DINH/Zugeordnete Verriegelungslimits für Verriegelungsquelle DFC_GlwEcuTempErr" VAL_BLK 0x80027184 ValA_Wu16 8192.00000000 DINH_LimDFCVerb 12079.0000000 20271.0000000 FORMAT "%13.7" NUMBER 2 /end CHARACTERISTIC
/begin CHARACTERISTIC DINH_Lim.DFC_GlwEcuUdiffT30_CA "DINH/Zugeordnete Verriegelungslimits für Verriegelungsquelle DFC_GlwEcuUdiffT30" VAL_BLK 0x80027188 ValA_Wu16 8192.00000000 DINH_LimDFCVerb 12079.0000000 20271.0000000 FORMAT "%13.7" NUMBER 2 /end CHARACTERISTIC
/begin CHARACTERISTIC DINH_Lim.DFC_IBSComErr_CA "DINH/Zugeordnete Verriegelungslimits für Verriegelungsquelle DFC_IBSComErr" VAL_BLK 0x8002718C ValA_Wu16 8192.00000000 DINH_LimDFCVerb 12079.0000000 20271.0000000 FORMAT "%13.7" NUMBER 3 /end CHARACTERISTIC
/begin CHARACTERISTIC DINH_Lim.DFC_LubSRCOilFldtCrit_CA "DINH/Zugeordnete Verriegelungslimits für Verriegelungsquelle DFC_LubSRCOilFldtCrit" VAL_BLK 0x80027192 ValA_Wu16 8192.00000000 DINH_LimDFCVerb 12079.0000000 20271.0000000 FORMAT "%13.7" NUMBER 3 /end CHARACTERISTIC
/begin CHARACTERISTIC DINH_Lim.DFC_LubSRCOilFldtCritDflMin_CA "DINH/Zugeordnete Verriegelungslimits für Verriegelungsquelle DFC_LubSRCOilFldtCritDflMin" VAL_BLK 0x80027198 ValA_Wu16 8192.00000000 DINH_LimDFCVerb 12079.0000000 20271.0000000 FORMAT "%13.7" NUMBER 2 /end CHARACTERISTIC
/begin CHARACTERISTIC DINH_Lim.DFC_LubSRCOilLvlCritMax_CA "DINH/Zugeordnete Verriegelungslimits für Verriegelungsquelle DFC_LubSRCOilLvlCritMax" VAL_BLK 0x8002719C ValA_Wu16 8192.00000000 DINH_LimDFCVerb 12079.0000000 20271.0000000 FORMAT "%13.7" NUMBER 2 /end CHARACTERISTIC
/begin CHARACTERISTIC DINH_Lim.DFC_LubSRCOilLvlCritMin_CA "DINH/Zugeordnete Verriegelungslimits für Verriegelungsquelle DFC_LubSRCOilLvlCritMin" VAL_BLK 0x800271A0 ValA_Wu16 8192.00000000 DINH_LimDFCVerb 12079.0000000 20271.0000000 FORMAT "%13.7" NUMBER 2 /end CHARACTERISTIC
/begin CHARACTERISTIC DINH_Lim.DFC_LubSRCTot_CA "DINH/Zugeordnete Verriegelungslimits für Verriegelungsquelle DFC_LubSRCTot" VAL_BLK 0x800271A4 ValA_Wu16 8192.00000000 DINH_LimDFCVerb 12079.0000000 20271.0000000 FORMAT "%13.7" NUMBER 2 /end CHARACTERISTIC
/begin CHARACTERISTIC DINH_Lim.DFC_MonUMaxSupply1_CA "DINH/Zugeordnete Verriegelungslimits für Verriegelungsquelle DFC_MonUMaxSupply1" VAL_BLK 0x800271A8 ValA_Wu16 8192.00000000 DINH_LimDFCVerb 12079.0000000 20271.0000000 FORMAT "%13.7" NUMBER 5 /end CHARACTERISTIC
/begin CHARACTERISTIC DINH_Lim.DFC_MonUMinSupply1_CA "DINH/Zugeordnete Verriegelungslimits für Verriegelungsquelle DFC_MonUMinSupply1" VAL_BLK 0x800271B2 ValA_Wu16 8192.00000000 DINH_LimDFCVerb 12079.0000000 20271.0000000 FORMAT "%13.7" NUMBER 5 /end CHARACTERISTIC
/begin CHARACTERISTIC DINH_Lim.DFC_OilComNpl_CA "DINH/Zugeordnete Verriegelungslimits für Verriegelungsquelle DFC_OilComNpl" VAL_BLK 0x800271BC ValA_Wu16 8192.00000000 DINH_LimDFCVerb 12079.0000000 20271.0000000 FORMAT "%13.7" NUMBER 2 /end CHARACTERISTIC
/begin CHARACTERISTIC DINH_Lim.DFC_PCBS_CA "DINH/Zugeordnete Verriegelungslimits für Verriegelungsquelle DFC_PCBS" VAL_BLK 0x800271C0 ValA_Wu16 8192.00000000 DINH_LimDFCVerb 12079.0000000 20271.0000000 FORMAT "%13.7" NUMBER 5 /end CHARACTERISTIC
/begin CHARACTERISTIC DINH_Lim.DFC_PCBSPFltChg_CA "DINH/Zugeordnete Verriegelungslimits für Verriegelungsquelle DFC_PCBSPFltChg" VAL_BLK 0x800271CA ValA_Wu16 8192.00000000 DINH_LimDFCVerb 12079.0000000 20271.0000000 FORMAT "%13.7" NUMBER 2 /end CHARACTERISTIC
/begin CHARACTERISTIC DINH_Lim.DFC_PCRGovDvtLPMax_CA "DINH/Zugeordnete Verriegelungslimits für Verriegelungsquelle DFC_PCRGovDvtLPMax" VAL_BLK 0x800271CE ValA_Wu16 8192.00000000 DINH_LimDFCVerb 12079.0000000 20271.0000000 FORMAT "%13.7" NUMBER 3 /end CHARACTERISTIC
/begin CHARACTERISTIC DINH_Lim.DFC_PCRGovDvtLPMin_CA "DINH/Zugeordnete Verriegelungslimits für Verriegelungsquelle DFC_PCRGovDvtLPMin" VAL_BLK 0x800271D4 ValA_Wu16 8192.00000000 DINH_LimDFCVerb 12079.0000000 20271.0000000 FORMAT "%13.7" NUMBER 3 /end CHARACTERISTIC
/begin CHARACTERISTIC DINH_Lim.DFC_PCRGovDvtMax_CA "DINH/Zugeordnete Verriegelungslimits für Verriegelungsquelle DFC_PCRGovDvtMax" VAL_BLK 0x800271DA ValA_Wu16 8192.00000000 DINH_LimDFCVerb 12079.0000000 20271.0000000 FORMAT "%13.7" NUMBER 6 /end CHARACTERISTIC
/begin CHARACTERISTIC DINH_Lim.DFC_PCRGovDvtMin_CA "DINH/Zugeordnete Verriegelungslimits für Verriegelungsquelle DFC_PCRGovDvtMin" VAL_BLK 0x800271E6 ValA_Wu16 8192.00000000 DINH_LimDFCVerb 12079.0000000 20271.0000000 FORMAT "%13.7" NUMBER 5 /end CHARACTERISTIC
/begin CHARACTERISTIC DINH_Lim.DFC_PFltAPSPlausMAX_CA "DINH/Zugeordnete Verriegelungslimits für Verriegelungsquelle DFC_PFltAPSPlausMAX" VAL_BLK 0x800271F0 ValA_Wu16 8192.00000000 DINH_LimDFCVerb 12079.0000000 20271.0000000 FORMAT "%13.7" NUMBER 8 /end CHARACTERISTIC
/begin CHARACTERISTIC DINH_Lim.DFC_PFltAPSPlausMIN_CA "DINH/Zugeordnete Verriegelungslimits für Verriegelungsquelle DFC_PFltAPSPlausMIN" VAL_BLK 0x80027200 ValA_Wu16 8192.00000000 DINH_LimDFCVerb 12079.0000000 20271.0000000 FORMAT "%13.7" NUMBER 8 /end CHARACTERISTIC
/begin CHARACTERISTIC DINH_Lim.DFC_PFltBPSPlausMAX_CA "DINH/Zugeordnete Verriegelungslimits für Verriegelungsquelle DFC_PFltBPSPlausMAX" VAL_BLK 0x80027210 ValA_Wu16 8192.00000000 DINH_LimDFCVerb 12079.0000000 20271.0000000 FORMAT "%13.7" NUMBER 8 /end CHARACTERISTIC
/begin CHARACTERISTIC DINH_Lim.DFC_PFltBPSPlausMIN_CA "DINH/Zugeordnete Verriegelungslimits für Verriegelungsquelle DFC_PFltBPSPlausMIN" VAL_BLK 0x80027220 ValA_Wu16 8192.00000000 DINH_LimDFCVerb 12079.0000000 20271.0000000 FORMAT "%13.7" NUMBER 8 /end CHARACTERISTIC
/begin CHARACTERISTIC DINH_Lim.DFC_PFltOvldInhRgn_CA "DINH/Zugeordnete Verriegelungslimits für Verriegelungsquelle DFC_PFltOvldInhRgn" VAL_BLK 0x80027230 ValA_Wu16 8192.00000000 DINH_LimDFCVerb 12079.0000000 20271.0000000 FORMAT "%13.7" NUMBER 7 /end CHARACTERISTIC
/begin CHARACTERISTIC DINH_Lim.DFC_PFltOvldTrqLim_CA "DINH/Zugeordnete Verriegelungslimits für Verriegelungsquelle DFC_PFltOvldTrqLim" VAL_BLK 0x8002723E ValA_Wu16 8192.00000000 DINH_LimDFCVerb 12079.0000000 20271.0000000 FORMAT "%13.7" NUMBER 7 /end CHARACTERISTIC
/begin CHARACTERISTIC DINH_Lim.DFC_PFltPresPlausMAX_CA "DINH/Zugeordnete Verriegelungslimits für Verriegelungsquelle DFC_PFltPresPlausMAX" VAL_BLK 0x8002724C ValA_Wu16 8192.00000000 DINH_LimDFCVerb 12079.0000000 20271.0000000 FORMAT "%13.7" NUMBER 7 /end CHARACTERISTIC
/begin CHARACTERISTIC DINH_Lim.DFC_PFltPresPlausMIN_CA "DINH/Zugeordnete Verriegelungslimits für Verriegelungsquelle DFC_PFltPresPlausMIN" VAL_BLK 0x8002725A ValA_Wu16 8192.00000000 DINH_LimDFCVerb 12079.0000000 20271.0000000 FORMAT "%13.7" NUMBER 7 /end CHARACTERISTIC
/begin CHARACTERISTIC DINH_Lim.DFC_PFltTraRpmRdc_CA "DINH/Zugeordnete Verriegelungslimits für Verriegelungsquelle DFC_PFltTraRpmRdc" VAL_BLK 0x80027268 ValA_Wu16 8192.00000000 DINH_LimDFCVerb 12079.0000000 20271.0000000 FORMAT "%13.7" NUMBER 7 /end CHARACTERISTIC
/begin CHARACTERISTIC DINH_Lim.DFC_PFlt_tOxiPreMax_CA "DINH/Zugeordnete Verriegelungslimits für Verriegelungsquelle DFC_PFlt_tOxiPreMax" VAL_BLK 0x80027276 ValA_Wu16 8192.00000000 DINH_LimDFCVerb 12079.0000000 20271.0000000 FORMAT "%13.7" NUMBER 7 /end CHARACTERISTIC
/begin CHARACTERISTIC DINH_Lim.DFC_PFlt_tOxiPreMaxRgn_CA "DINH/Zugeordnete Verriegelungslimits für Verriegelungsquelle DFC_PFlt_tOxiPreMaxRgn" VAL_BLK 0x80027284 ValA_Wu16 8192.00000000 DINH_LimDFCVerb 12079.0000000 20271.0000000 FORMAT "%13.7" NUMBER 7 /end CHARACTERISTIC
/begin CHARACTERISTIC DINH_Lim.DFC_PFlt_tOxiPreNpl_CA "DINH/Zugeordnete Verriegelungslimits für Verriegelungsquelle DFC_PFlt_tOxiPreNpl" VAL_BLK 0x80027292 ValA_Wu16 8192.00000000 DINH_LimDFCVerb 12079.0000000 20271.0000000 FORMAT "%13.7" NUMBER 7 /end CHARACTERISTIC
/begin CHARACTERISTIC DINH_Lim.DFC_PFlt_tPreMax_CA "DINH/Zugeordnete Verriegelungslimits für Verriegelungsquelle DFC_PFlt_tPreMax" VAL_BLK 0x800272A0 ValA_Wu16 8192.00000000 DINH_LimDFCVerb 12079.0000000 20271.0000000 FORMAT "%13.7" NUMBER 7 /end CHARACTERISTIC
/begin CHARACTERISTIC DINH_Lim.DFC_PFlt_tPreMaxRgn_CA "DINH/Zugeordnete Verriegelungslimits für Verriegelungsquelle DFC_PFlt_tPreMaxRgn" VAL_BLK 0x800272AE ValA_Wu16 8192.00000000 DINH_LimDFCVerb 12079.0000000 20271.0000000 FORMAT "%13.7" NUMBER 7 /end CHARACTERISTIC
/begin CHARACTERISTIC DINH_Lim.DFC_PFlt_tPreNpl_CA "DINH/Zugeordnete Verriegelungslimits für Verriegelungsquelle DFC_PFlt_tPreNpl" VAL_BLK 0x800272BC ValA_Wu16 8192.00000000 DINH_LimDFCVerb 12079.0000000 20271.0000000 FORMAT "%13.7" NUMBER 7 /end CHARACTERISTIC
/begin CHARACTERISTIC DINH_Lim.DFC_PFltmSotDiffMAX_CA "DINH/Zugeordnete Verriegelungslimits für Verriegelungsquelle DFC_PFltmSotDiffMAX" VAL_BLK 0x800272CA ValA_Wu16 8192.00000000 DINH_LimDFCVerb 12079.0000000 20271.0000000 FORMAT "%13.7" NUMBER 7 /end CHARACTERISTIC
/begin CHARACTERISTIC DINH_Lim.DFC_PFltmSotDiffMIN_CA "DINH/Zugeordnete Verriegelungslimits für Verriegelungsquelle DFC_PFltmSotDiffMIN" VAL_BLK 0x800272D8 ValA_Wu16 8192.00000000 DINH_LimDFCVerb 12079.0000000 20271.0000000 FORMAT "%13.7" NUMBER 7 /end CHARACTERISTIC
/begin CHARACTERISTIC DINH_Lim.DFC_PFltmSotDiffSIG_CA "DINH/Zugeordnete Verriegelungslimits für Verriegelungsquelle DFC_PFltmSotDiffSIG" VAL_BLK 0x800272E6 ValA_Wu16 8192.00000000 DINH_LimDFCVerb 12079.0000000 20271.0000000 FORMAT "%13.7" NUMBER 7 /end CHARACTERISTIC
/begin CHARACTERISTIC DINH_Lim.DFC_PIntkVUsEnvPPls_CA "DINH/Zugeordnete Verriegelungslimits für Verriegelungsquelle DFC_PIntkVUsEnvPPls" VAL_BLK 0x800272F4 ValA_Wu16 8192.00000000 DINH_LimDFCVerb 12079.0000000 20271.0000000 FORMAT "%13.7" NUMBER 2 /end CHARACTERISTIC
/begin CHARACTERISTIC DINH_Lim.DFC_PresPlausDblDef_CA "DINH/Zugeordnete Verriegelungslimits für Verriegelungsquelle DFC_PresPlausDblDef" VAL_BLK 0x800272F8 ValA_Wu16 8192.00000000 DINH_LimDFCVerb 12079.0000000 20271.0000000 FORMAT "%13.7" NUMBER 2 /end CHARACTERISTIC
/begin CHARACTERISTIC DINH_Lim.DFC_RailCPC1_CA "DINH/Zugeordnete Verriegelungslimits für Verriegelungsquelle DFC_RailCPC1" VAL_BLK 0x800272FC ValA_Wu16 8192.00000000 DINH_LimDFCVerb 12079.0000000 20271.0000000 FORMAT "%13.7" NUMBER 3 /end CHARACTERISTIC
/begin CHARACTERISTIC DINH_Lim.DFC_RailCPC3_CA "DINH/Zugeordnete Verriegelungslimits für Verriegelungsquelle DFC_RailCPC3" VAL_BLK 0x80027302 ValA_Wu16 8192.00000000 DINH_LimDFCVerb 12079.0000000 20271.0000000 FORMAT "%13.7" NUMBER 4 /end CHARACTERISTIC
/begin CHARACTERISTIC DINH_Lim.DFC_RailCPC4_CA "DINH/Zugeordnete Verriegelungslimits für Verriegelungsquelle DFC_RailCPC4" VAL_BLK 0x8002730A ValA_Wu16 8192.00000000 DINH_LimDFCVerb 12079.0000000 20271.0000000 FORMAT "%13.7" NUMBER 4 /end CHARACTERISTIC
/begin CHARACTERISTIC DINH_Lim.DFC_RailMeUn0_CA "DINH/Zugeordnete Verriegelungslimits für Verriegelungsquelle DFC_RailMeUn0" VAL_BLK 0x80027312 ValA_Wu16 8192.00000000 DINH_LimDFCVerb 12079.0000000 20271.0000000 FORMAT "%13.7" NUMBER 9 /end CHARACTERISTIC
/begin CHARACTERISTIC DINH_Lim.DFC_RailMeUn1_CA "DINH/Zugeordnete Verriegelungslimits für Verriegelungsquelle DFC_RailMeUn1" VAL_BLK 0x80027324 ValA_Wu16 8192.00000000 DINH_LimDFCVerb 12079.0000000 20271.0000000 FORMAT "%13.7" NUMBER 8 /end CHARACTERISTIC
/begin CHARACTERISTIC DINH_Lim.DFC_RailMeUn2_CA "DINH/Zugeordnete Verriegelungslimits für Verriegelungsquelle DFC_RailMeUn2" VAL_BLK 0x80027334 ValA_Wu16 8192.00000000 DINH_LimDFCVerb 12079.0000000 20271.0000000 FORMAT "%13.7" NUMBER 10 /end CHARACTERISTIC
/begin CHARACTERISTIC DINH_Lim.DFC_RailMeUn22_CA "DINH/Zugeordnete Verriegelungslimits für Verriegelungsquelle DFC_RailMeUn22" VAL_BLK 0x80027348 ValA_Wu16 8192.00000000 DINH_LimDFCVerb 12079.0000000 20271.0000000 FORMAT "%13.7" NUMBER 2 /end CHARACTERISTIC
/begin CHARACTERISTIC DINH_Lim.DFC_RailMeUn3_CA "DINH/Zugeordnete Verriegelungslimits für Verriegelungsquelle DFC_RailMeUn3" VAL_BLK 0x8002734C ValA_Wu16 8192.00000000 DINH_LimDFCVerb 12079.0000000 20271.0000000 FORMAT "%13.7" NUMBER 15 /end CHARACTERISTIC
/begin CHARACTERISTIC DINH_Lim.DFC_RailMeUn4_CA "DINH/Zugeordnete Verriegelungslimits für Verriegelungsquelle DFC_RailMeUn4" VAL_BLK 0x8002736A ValA_Wu16 8192.00000000 DINH_LimDFCVerb 12079.0000000 20271.0000000 FORMAT "%13.7" NUMBER 10 /end CHARACTERISTIC
/begin CHARACTERISTIC DINH_Lim.DFC_RailMeUn42_CA "DINH/Zugeordnete Verriegelungslimits für Verriegelungsquelle DFC_RailMeUn42" VAL_BLK 0x8002737E ValA_Wu16 8192.00000000 DINH_LimDFCVerb 12079.0000000 20271.0000000 FORMAT "%13.7" NUMBER 2 /end CHARACTERISTIC
/begin CHARACTERISTIC DINH_Lim.DFC_RailMeUn5_CA "DINH/Zugeordnete Verriegelungslimits für Verriegelungsquelle DFC_RailMeUn5" VAL_BLK 0x80027382 ValA_Wu16 8192.00000000 DINH_LimDFCVerb 12079.0000000 20271.0000000 FORMAT "%13.7" NUMBER 2 /end CHARACTERISTIC
/begin CHARACTERISTIC DINH_Lim.DFC_RailPCV0_CA "DINH/Zugeordnete Verriegelungslimits für Verriegelungsquelle DFC_RailPCV0" VAL_BLK 0x80027386 ValA_Wu16 8192.00000000 DINH_LimDFCVerb 12079.0000000 20271.0000000 FORMAT "%13.7" NUMBER 12 /end CHARACTERISTIC
/begin CHARACTERISTIC DINH_Lim.DFC_RailPCV1_CA "DINH/Zugeordnete Verriegelungslimits für Verriegelungsquelle DFC_RailPCV1" VAL_BLK 0x8002739E ValA_Wu16 8192.00000000 DINH_LimDFCVerb 12079.0000000 20271.0000000 FORMAT "%13.7" NUMBER 13 /end CHARACTERISTIC
/begin CHARACTERISTIC DINH_Lim.DFC_RailPCV2_CA "DINH/Zugeordnete Verriegelungslimits für Verriegelungsquelle DFC_RailPCV2" VAL_BLK 0x800273B8 ValA_Wu16 8192.00000000 DINH_LimDFCVerb 12079.0000000 20271.0000000 FORMAT "%13.7" NUMBER 9 /end CHARACTERISTIC
/begin CHARACTERISTIC DINH_Lim.DFC_RailPCV22_CA "DINH/Zugeordnete Verriegelungslimits für Verriegelungsquelle DFC_RailPCV22" VAL_BLK 0x800273CA ValA_Wu16 8192.00000000 DINH_LimDFCVerb 12079.0000000 20271.0000000 FORMAT "%13.7" NUMBER 2 /end CHARACTERISTIC
/begin CHARACTERISTIC DINH_Lim.DFC_RailPCV3_CA "DINH/Zugeordnete Verriegelungslimits für Verriegelungsquelle DFC_RailPCV3" VAL_BLK 0x800273CE ValA_Wu16 8192.00000000 DINH_LimDFCVerb 12079.0000000 20271.0000000 FORMAT "%13.7" NUMBER 15 /end CHARACTERISTIC
/begin CHARACTERISTIC DINH_Lim.DFC_RailPCV4_CA "DINH/Zugeordnete Verriegelungslimits für Verriegelungsquelle DFC_RailPCV4" VAL_BLK 0x800273EC ValA_Wu16 8192.00000000 DINH_LimDFCVerb 12079.0000000 20271.0000000 FORMAT "%13.7" NUMBER 9 /end CHARACTERISTIC
/begin CHARACTERISTIC DINH_Lim.DFC_RailPCV42_CA "DINH/Zugeordnete Verriegelungslimits für Verriegelungsquelle DFC_RailPCV42" VAL_BLK 0x800273FE ValA_Wu16 8192.00000000 DINH_LimDFCVerb 12079.0000000 20271.0000000 FORMAT "%13.7" NUMBER 2 /end CHARACTERISTIC
/begin CHARACTERISTIC DINH_Lim.DFC_RailPMonStrt_CA "DINH/Zugeordnete Verriegelungslimits für Verriegelungsquelle DFC_RailPMonStrt" VAL_BLK 0x80027402 ValA_Wu16 8192.00000000 DINH_LimDFCVerb 12079.0000000 20271.0000000 FORMAT "%13.7" NUMBER 2 /end CHARACTERISTIC
/begin CHARACTERISTIC DINH_Lim.DFC_SSpMon1_CA "DINH/Zugeordnete Verriegelungslimits für Verriegelungsquelle DFC_SSpMon1" VAL_BLK 0x80027406 ValA_Wu16 8192.00000000 DINH_LimDFCVerb 12079.0000000 20271.0000000 FORMAT "%13.7" NUMBER 10 /end CHARACTERISTIC
/begin CHARACTERISTIC DINH_Lim.DFC_SSpMon2_CA "DINH/Zugeordnete Verriegelungslimits für Verriegelungsquelle DFC_SSpMon2" VAL_BLK 0x8002741A ValA_Wu16 8192.00000000 DINH_LimDFCVerb 12079.0000000 20271.0000000 FORMAT "%13.7" NUMBER 9 /end CHARACTERISTIC
/begin CHARACTERISTIC DINH_Lim.DFC_SSpMon3_CA "DINH/Zugeordnete Verriegelungslimits für Verriegelungsquelle DFC_SSpMon3" VAL_BLK 0x8002742C ValA_Wu16 8192.00000000 DINH_LimDFCVerb 12079.0000000 20271.0000000 FORMAT "%13.7" NUMBER 8 /end CHARACTERISTIC
/begin CHARACTERISTIC DINH_Lim.DFC_ThrVlv4WinErr1_CA "DINH/Zugeordnete Verriegelungslimits für Verriegelungsquelle DFC_ThrVlv4WinErr1" VAL_BLK 0x8002743C ValA_Wu16 8192.00000000 DINH_LimDFCVerb 12079.0000000 20271.0000000 FORMAT "%13.7" NUMBER 2 /end CHARACTERISTIC
/begin CHARACTERISTIC DINH_Lim.DFC_ThrVlv4WinErr2_CA "DINH/Zugeordnete Verriegelungslimits für Verriegelungsquelle DFC_ThrVlv4WinErr2" VAL_BLK 0x80027440 ValA_Wu16 8192.00000000 DINH_LimDFCVerb 12079.0000000 20271.0000000 FORMAT "%13.7" NUMBER 2 /end CHARACTERISTIC
/begin CHARACTERISTIC DINH_Lim.DFC_ThrVlv4WinErr3_CA "DINH/Zugeordnete Verriegelungslimits für Verriegelungsquelle DFC_ThrVlv4WinErr3" VAL_BLK 0x80027444 ValA_Wu16 8192.00000000 DINH_LimDFCVerb 12079.0000000 20271.0000000 FORMAT "%13.7" NUMBER 2 /end CHARACTERISTIC
/begin CHARACTERISTIC DINH_Lim.DFC_ThrVlv4WinErr4_CA "DINH/Zugeordnete Verriegelungslimits für Verriegelungsquelle DFC_ThrVlv4WinErr4" VAL_BLK 0x80027448 ValA_Wu16 8192.00000000 DINH_LimDFCVerb 12079.0000000 20271.0000000 FORMAT "%13.7" NUMBER 2 /end CHARACTERISTIC
/begin CHARACTERISTIC DINH_Lim.DFC_ThrVlvSCG_CA "DINH/Zugeordnete Verriegelungslimits für Verriegelungsquelle DFC_ThrVlvSCG" VAL_BLK 0x8002744C ValA_Wu16 8192.00000000 DINH_LimDFCVerb 12079.0000000 20271.0000000 FORMAT "%13.7" NUMBER 9 /end CHARACTERISTIC
/begin CHARACTERISTIC DINH_Lim.DFC_Tle6232Spi1_CA "DINH/Zugeordnete Verriegelungslimits für Verriegelungsquelle DFC_Tle6232Spi1" VAL_BLK 0x8002745E ValA_Wu16 8192.00000000 DINH_LimDFCVerb 12079.0000000 20271.0000000 FORMAT "%13.7" NUMBER 2 /end CHARACTERISTIC
/begin CHARACTERISTIC DINH_Lim.DFC_TrbCh4WinErr1_CA "DINH/Zugeordnete Verriegelungslimits für Verriegelungsquelle DFC_TrbCh4WinErr1" VAL_BLK 0x80027462 ValA_Wu16 8192.00000000 DINH_LimDFCVerb 12079.0000000 20271.0000000 FORMAT "%13.7" NUMBER 2 /end CHARACTERISTIC
/begin CHARACTERISTIC DINH_Lim.DFC_TrbCh4WinErr2_CA "DINH/Zugeordnete Verriegelungslimits für Verriegelungsquelle DFC_TrbCh4WinErr2" VAL_BLK 0x80027466 ValA_Wu16 8192.00000000 DINH_LimDFCVerb 12079.0000000 20271.0000000 FORMAT "%13.7" NUMBER 2 /end CHARACTERISTIC
/begin CHARACTERISTIC DINH_Lim.DFC_TrbCh4WinErr3_CA "DINH/Zugeordnete Verriegelungslimits für Verriegelungsquelle DFC_TrbCh4WinErr3" VAL_BLK 0x8002746A ValA_Wu16 8192.00000000 DINH_LimDFCVerb 12079.0000000 20271.0000000 FORMAT "%13.7" NUMBER 2 /end CHARACTERISTIC
/begin CHARACTERISTIC DINH_Lim.DFC_TrbCh4WinErr4_CA "DINH/Zugeordnete Verriegelungslimits für Verriegelungsquelle DFC_TrbCh4WinErr4" VAL_BLK 0x8002746E ValA_Wu16 8192.00000000 DINH_LimDFCVerb 12079.0000000 20271.0000000 FORMAT "%13.7" NUMBER 2 /end CHARACTERISTIC
/begin CHARACTERISTIC DINH_Lim.DFC_TrbChSCG_CA "DINH/Zugeordnete Verriegelungslimits für Verriegelungsquelle DFC_TrbChSCG" VAL_BLK 0x80027472 ValA_Wu16 8192.00000000 DINH_LimDFCVerb 12079.0000000 20271.0000000 FORMAT "%13.7" NUMBER 9 /end CHARACTERISTIC
/begin CHARACTERISTIC DINH_Lim.DFC_TrbChSRCMax_CA "DINH/Zugeordnete Verriegelungslimits für Verriegelungsquelle DFC_TrbChSRCMax" VAL_BLK 0x80027484 ValA_Wu16 8192.00000000 DINH_LimDFCVerb 12079.0000000 20271.0000000 FORMAT "%13.7" NUMBER 5 /end CHARACTERISTIC
/begin CHARACTERISTIC DINH_Lim.DFC_TrbChSRCMin_CA "DINH/Zugeordnete Verriegelungslimits für Verriegelungsquelle DFC_TrbChSRCMin" VAL_BLK 0x8002748E ValA_Wu16 8192.00000000 DINH_LimDFCVerb 12079.0000000 20271.0000000 FORMAT "%13.7" NUMBER 5 /end CHARACTERISTIC
/begin CHARACTERISTIC DINH_Lim.DFC_WaHtEl4WinErr1_CA "DINH/Zugeordnete Verriegelungslimits für Verriegelungsquelle DFC_WaHtEl4WinErr1" VAL_BLK 0x80027498 ValA_Wu16 8192.00000000 DINH_LimDFCVerb 12079.0000000 20271.0000000 FORMAT "%13.7" NUMBER 2 /end CHARACTERISTIC
/begin CHARACTERISTIC DINH_Lim.DFC_WaHtEl4WinErr2_CA "DINH/Zugeordnete Verriegelungslimits für Verriegelungsquelle DFC_WaHtEl4WinErr2" VAL_BLK 0x8002749C ValA_Wu16 8192.00000000 DINH_LimDFCVerb 12079.0000000 20271.0000000 FORMAT "%13.7" NUMBER 2 /end CHARACTERISTIC
/begin CHARACTERISTIC DINH_Lim.DFC_WaHtEl4WinErr3_CA "DINH/Zugeordnete Verriegelungslimits für Verriegelungsquelle DFC_WaHtEl4WinErr3" VAL_BLK 0x800274A0 ValA_Wu16 8192.00000000 DINH_LimDFCVerb 12079.0000000 20271.0000000 FORMAT "%13.7" NUMBER 2 /end CHARACTERISTIC
/begin CHARACTERISTIC DINH_Lim.DFC_WaHtEl4WinErr4_CA "DINH/Zugeordnete Verriegelungslimits für Verriegelungsquelle DFC_WaHtEl4WinErr4" VAL_BLK 0x800274A4 ValA_Wu16 8192.00000000 DINH_LimDFCVerb 12079.0000000 20271.0000000 FORMAT "%13.7" NUMBER 2 /end CHARACTERISTIC
/begin CHARACTERISTIC DINH_Lim.DFC_WaHtElSCG_CA "DINH/Zugeordnete Verriegelungslimits für Verriegelungsquelle DFC_WaHtElSCG" VAL_BLK 0x800274A8 ValA_Wu16 8192.00000000 DINH_LimDFCVerb 12079.0000000 20271.0000000 FORMAT "%13.7" NUMBER 2 /end CHARACTERISTIC
/begin CHARACTERISTIC DINH_Lim.DFC_ETClbETFltMax_0_CA "DINH/Zugeordnete Verriegelungslimits für Verriegelungsquelle DFC_ETClbETFltMax_0" VAL_BLK 0x800274AC ValA_Wu16 8192.00000000 DINH_LimDFCVerb 12079.0000000 20271.0000000 FORMAT "%13.7" NUMBER 2 /end CHARACTERISTIC
/begin CHARACTERISTIC DINH_Lim.DFC_ETClbETFltMax_1_CA "DINH/Zugeordnete Verriegelungslimits für Verriegelungsquelle DFC_ETClbETFltMax_1" VAL_BLK 0x800274B0 ValA_Wu16 8192.00000000 DINH_LimDFCVerb 12079.0000000 20271.0000000 FORMAT "%13.7" NUMBER 2 /end CHARACTERISTIC
/begin CHARACTERISTIC DINH_Lim.DFC_ETClbETFltMax_2_CA "DINH/Zugeordnete Verriegelungslimits für Verriegelungsquelle DFC_ETClbETFltMax_2" VAL_BLK 0x800274B4 ValA_Wu16 8192.00000000 DINH_LimDFCVerb 12079.0000000 20271.0000000 FORMAT "%13.7" NUMBER 2 /end CHARACTERISTIC
/begin CHARACTERISTIC DINH_Lim.DFC_ETClbETFltMax_3_CA "DINH/Zugeordnete Verriegelungslimits für Verriegelungsquelle DFC_ETClbETFltMax_3" VAL_BLK 0x800274B8 ValA_Wu16 8192.00000000 DINH_LimDFCVerb 12079.0000000 20271.0000000 FORMAT "%13.7" NUMBER 2 /end CHARACTERISTIC
/begin CHARACTERISTIC DINH_Lim.DFC_ETClbETFltMax_4_CA "DINH/Zugeordnete Verriegelungslimits für Verriegelungsquelle DFC_ETClbETFltMax_4" VAL_BLK 0x800274BC ValA_Wu16 8192.00000000 DINH_LimDFCVerb 12079.0000000 20271.0000000 FORMAT "%13.7" NUMBER 2 /end CHARACTERISTIC
/begin CHARACTERISTIC DINH_Lim.DFC_ETClbETFltMax_5_CA "DINH/Zugeordnete Verriegelungslimits für Verriegelungsquelle DFC_ETClbETFltMax_5" VAL_BLK 0x800274C0 ValA_Wu16 8192.00000000 DINH_LimDFCVerb 12079.0000000 20271.0000000 FORMAT "%13.7" NUMBER 2 /end CHARACTERISTIC
/begin CHARACTERISTIC DINH_Lim.DFC_ETClbETFltMin_0_CA "DINH/Zugeordnete Verriegelungslimits für Verriegelungsquelle DFC_ETClbETFltMin_0" VAL_BLK 0x800274C4 ValA_Wu16 8192.00000000 DINH_LimDFCVerb 12079.0000000 20271.0000000 FORMAT "%13.7" NUMBER 2 /end CHARACTERISTIC
/begin CHARACTERISTIC DINH_Lim.DFC_ETClbETFltMin_1_CA "DINH/Zugeordnete Verriegelungslimits für Verriegelungsquelle DFC_ETClbETFltMin_1" VAL_BLK 0x800274C8 ValA_Wu16 8192.00000000 DINH_LimDFCVerb 12079.0000000 20271.0000000 FORMAT "%13.7" NUMBER 2 /end CHARACTERISTIC
/begin CHARACTERISTIC DINH_Lim.DFC_ETClbETFltMin_2_CA "DINH/Zugeordnete Verriegelungslimits für Verriegelungsquelle DFC_ETClbETFltMin_2" VAL_BLK 0x800274CC ValA_Wu16 8192.00000000 DINH_LimDFCVerb 12079.0000000 20271.0000000 FORMAT "%13.7" NUMBER 2 /end CHARACTERISTIC
/begin CHARACTERISTIC DINH_Lim.DFC_ETClbETFltMin_3_CA "DINH/Zugeordnete Verriegelungslimits für Verriegelungsquelle DFC_ETClbETFltMin_3" VAL_BLK 0x800274D0 ValA_Wu16 8192.00000000 DINH_LimDFCVerb 12079.0000000 20271.0000000 FORMAT "%13.7" NUMBER 2 /end CHARACTERISTIC
/begin CHARACTERISTIC DINH_Lim.DFC_ETClbETFltMin_4_CA "DINH/Zugeordnete Verriegelungslimits für Verriegelungsquelle DFC_ETClbETFltMin_4" VAL_BLK 0x800274D4 ValA_Wu16 8192.00000000 DINH_LimDFCVerb 12079.0000000 20271.0000000 FORMAT "%13.7" NUMBER 2 /end CHARACTERISTIC
/begin CHARACTERISTIC DINH_Lim.DFC_ETClbETFltMin_5_CA "DINH/Zugeordnete Verriegelungslimits für Verriegelungsquelle DFC_ETClbETFltMin_5" VAL_BLK 0x800274D8 ValA_Wu16 8192.00000000 DINH_LimDFCVerb 12079.0000000 20271.0000000 FORMAT "%13.7" NUMBER 2 /end CHARACTERISTIC
/begin CHARACTERISTIC DINH_Lim.DFC_InjCrvInjLimChrgBal_CA "DINH/Zugeordnete Verriegelungslimits für Verriegelungsquelle DFC_InjCrvInjLimChrgBal" VAL_BLK 0x800274DC ValA_Wu16 8192.00000000 DINH_LimDFCVerb 12079.0000000 20271.0000000 FORMAT "%13.7" NUMBER 2 /end CHARACTERISTIC
/begin CHARACTERISTIC DINH_Lim.DFC_InjCrvInjLimQntBal_CA "DINH/Zugeordnete Verriegelungslimits für Verriegelungsquelle DFC_InjCrvInjLimQntBal" VAL_BLK 0x800274E0 ValA_Wu16 8192.00000000 DINH_LimDFCVerb 12079.0000000 20271.0000000 FORMAT "%13.7" NUMBER 2 /end CHARACTERISTIC
/begin CHARACTERISTIC DINH_Lim.DFC_InjCrvInjLimSys_CA "DINH/Zugeordnete Verriegelungslimits für Verriegelungsquelle DFC_InjCrvInjLimSys" VAL_BLK 0x800274E4 ValA_Wu16 8192.00000000 DINH_LimDFCVerb 12079.0000000 20271.0000000 FORMAT "%13.7" NUMBER 2 /end CHARACTERISTIC
/begin CHARACTERISTIC DINH_Lim.DFC_InjCrvNumInjRtmLim_CA "DINH/Zugeordnete Verriegelungslimits für Verriegelungsquelle DFC_InjCrvNumInjRtmLim" VAL_BLK 0x800274E8 ValA_Wu16 8192.00000000 DINH_LimDFCVerb 12079.0000000 20271.0000000 FORMAT "%13.7" NUMBER 2 /end CHARACTERISTIC
/begin CHARACTERISTIC DINH_Lim.DFC_LSUHtCoupSig_CA "DINH/Zugeordnete Verriegelungslimits für Verriegelungsquelle DFC_LSUHtCoupSig" VAL_BLK 0x800274EC ValA_Wu16 8192.00000000 DINH_LimDFCVerb 12079.0000000 20271.0000000 FORMAT "%13.7" NUMBER 10 /end CHARACTERISTIC
/begin CHARACTERISTIC DINH_Lim.DFC_AFS_SSpShOffOL_CA "DINH/Zugeordnete Verriegelungslimits für Verriegelungsquelle DFC_AFS_SSpShOffOL" VAL_BLK 0x80027500 ValA_Wu16 8192.00000000 DINH_LimDFCVerb 12079.0000000 20271.0000000 FORMAT "%13.7" NUMBER 5 /end CHARACTERISTIC
/begin CHARACTERISTIC DINH_Lim.DFC_AFS_SSpShOffOvrTemp_CA "DINH/Zugeordnete Verriegelungslimits für Verriegelungsquelle DFC_AFS_SSpShOffOvrTemp" VAL_BLK 0x8002750A ValA_Wu16 8192.00000000 DINH_LimDFCVerb 12079.0000000 20271.0000000 FORMAT "%13.7" NUMBER 5 /end CHARACTERISTIC
/begin CHARACTERISTIC DINH_Lim.DFC_AFS_SSpShOffSCB_CA "DINH/Zugeordnete Verriegelungslimits für Verriegelungsquelle DFC_AFS_SSpShOffSCB" VAL_BLK 0x80027514 ValA_Wu16 8192.00000000 DINH_LimDFCVerb 12079.0000000 20271.0000000 FORMAT "%13.7" NUMBER 5 /end CHARACTERISTIC
/begin CHARACTERISTIC DINH_Lim.DFC_AFS_SSpShOffSCG_CA "DINH/Zugeordnete Verriegelungslimits für Verriegelungsquelle DFC_AFS_SSpShOffSCG" VAL_BLK 0x8002751E ValA_Wu16 8192.00000000 DINH_LimDFCVerb 12079.0000000 20271.0000000 FORMAT "%13.7" NUMBER 5 /end CHARACTERISTIC
/begin CHARACTERISTIC DINH_Lim.DFC_AirCCmprOL_CA "DINH/Zugeordnete Verriegelungslimits für Verriegelungsquelle DFC_AirCCmprOL" VAL_BLK 0x80027528 ValA_Wu16 8192.00000000 DINH_LimDFCVerb 12079.0000000 20271.0000000 FORMAT "%13.7" NUMBER 2 /end CHARACTERISTIC
/begin CHARACTERISTIC DINH_Lim.DFC_AirCCmprOvrTemp_CA "DINH/Zugeordnete Verriegelungslimits für Verriegelungsquelle DFC_AirCCmprOvrTemp" VAL_BLK 0x8002752C ValA_Wu16 8192.00000000 DINH_LimDFCVerb 12079.0000000 20271.0000000 FORMAT "%13.7" NUMBER 2 /end CHARACTERISTIC
/begin CHARACTERISTIC DINH_Lim.DFC_AirCCmprSCB_CA "DINH/Zugeordnete Verriegelungslimits für Verriegelungsquelle DFC_AirCCmprSCB" VAL_BLK 0x80027530 ValA_Wu16 8192.00000000 DINH_LimDFCVerb 12079.0000000 20271.0000000 FORMAT "%13.7" NUMBER 2 /end CHARACTERISTIC
/begin CHARACTERISTIC DINH_Lim.DFC_AirCCmprSCG_CA "DINH/Zugeordnete Verriegelungslimits für Verriegelungsquelle DFC_AirCCmprSCG" VAL_BLK 0x80027534 ValA_Wu16 8192.00000000 DINH_LimDFCVerb 12079.0000000 20271.0000000 FORMAT "%13.7" NUMBER 2 /end CHARACTERISTIC
/begin CHARACTERISTIC DINH_Lim.DFC_CByVlvOL_CA "DINH/Zugeordnete Verriegelungslimits für Verriegelungsquelle DFC_CByVlvOL" VAL_BLK 0x80027538 ValA_Wu16 8192.00000000 DINH_LimDFCVerb 12079.0000000 20271.0000000 FORMAT "%13.7" NUMBER 2 /end CHARACTERISTIC
/begin CHARACTERISTIC DINH_Lim.DFC_CByVlvOvrTemp_CA "DINH/Zugeordnete Verriegelungslimits für Verriegelungsquelle DFC_CByVlvOvrTemp" VAL_BLK 0x8002753C ValA_Wu16 8192.00000000 DINH_LimDFCVerb 12079.0000000 20271.0000000 FORMAT "%13.7" NUMBER 2 /end CHARACTERISTIC
/begin CHARACTERISTIC DINH_Lim.DFC_CByVlvSCB_CA "DINH/Zugeordnete Verriegelungslimits für Verriegelungsquelle DFC_CByVlvSCB" VAL_BLK 0x80027540 ValA_Wu16 8192.00000000 DINH_LimDFCVerb 12079.0000000 20271.0000000 FORMAT "%13.7" NUMBER 2 /end CHARACTERISTIC
/begin CHARACTERISTIC DINH_Lim.DFC_CByVlvSCG_CA "DINH/Zugeordnete Verriegelungslimits für Verriegelungsquelle DFC_CByVlvSCG" VAL_BLK 0x80027544 ValA_Wu16 8192.00000000 DINH_LimDFCVerb 12079.0000000 20271.0000000 FORMAT "%13.7" NUMBER 2 /end CHARACTERISTIC
/begin CHARACTERISTIC DINH_Lim.DFC_CThmstOL_CA "DINH/Zugeordnete Verriegelungslimits für Verriegelungsquelle DFC_CThmstOL" VAL_BLK 0x80027548 ValA_Wu16 8192.00000000 DINH_LimDFCVerb 12079.0000000 20271.0000000 FORMAT "%13.7" NUMBER 2 /end CHARACTERISTIC
/begin CHARACTERISTIC DINH_Lim.DFC_CThmstOvrTemp_CA "DINH/Zugeordnete Verriegelungslimits für Verriegelungsquelle DFC_CThmstOvrTemp" VAL_BLK 0x8002754C ValA_Wu16 8192.00000000 DINH_LimDFCVerb 12079.0000000 20271.0000000 FORMAT "%13.7" NUMBER 2 /end CHARACTERISTIC
/begin CHARACTERISTIC DINH_Lim.DFC_CThmstSCB_CA "DINH/Zugeordnete Verriegelungslimits für Verriegelungsquelle DFC_CThmstSCB" VAL_BLK 0x80027550 ValA_Wu16 8192.00000000 DINH_LimDFCVerb 12079.0000000 20271.0000000 FORMAT "%13.7" NUMBER 2 /end CHARACTERISTIC
/begin CHARACTERISTIC DINH_Lim.DFC_CThmstSCG_CA "DINH/Zugeordnete Verriegelungslimits für Verriegelungsquelle DFC_CThmstSCG" VAL_BLK 0x80027554 ValA_Wu16 8192.00000000 DINH_LimDFCVerb 12079.0000000 20271.0000000 FORMAT "%13.7" NUMBER 2 /end CHARACTERISTIC
/begin CHARACTERISTIC DINH_Lim.DFC_DSMDummy_CA "DINH/Zugeordnete Verriegelungslimits für Verriegelungsquelle DFC_DSMDummy" VAL_BLK 0x80027558 ValA_Wu16 8192.00000000 DINH_LimDFCVerb 12079.0000000 20271.0000000 FORMAT "%13.7" NUMBER 2 /end CHARACTERISTIC
/begin CHARACTERISTIC DINH_Lim.DFC_EBxFanOL_CA "DINH/Zugeordnete Verriegelungslimits für Verriegelungsquelle DFC_EBxFanOL" VAL_BLK 0x8002755C ValA_Wu16 8192.00000000 DINH_LimDFCVerb 12079.0000000 20271.0000000 FORMAT "%13.7" NUMBER 2 /end CHARACTERISTIC
/begin CHARACTERISTIC DINH_Lim.DFC_EBxFanOvrTemp_CA "DINH/Zugeordnete Verriegelungslimits für Verriegelungsquelle DFC_EBxFanOvrTemp" VAL_BLK 0x80027560 ValA_Wu16 8192.00000000 DINH_LimDFCVerb 12079.0000000 20271.0000000 FORMAT "%13.7" NUMBER 2 /end CHARACTERISTIC
/begin CHARACTERISTIC DINH_Lim.DFC_EBxFanSCB_CA "DINH/Zugeordnete Verriegelungslimits für Verriegelungsquelle DFC_EBxFanSCB" VAL_BLK 0x80027564 ValA_Wu16 8192.00000000 DINH_LimDFCVerb 12079.0000000 20271.0000000 FORMAT "%13.7" NUMBER 2 /end CHARACTERISTIC
/begin CHARACTERISTIC DINH_Lim.DFC_EBxFanSCG_CA "DINH/Zugeordnete Verriegelungslimits für Verriegelungsquelle DFC_EBxFanSCG" VAL_BLK 0x80027568 ValA_Wu16 8192.00000000 DINH_LimDFCVerb 12079.0000000 20271.0000000 FORMAT "%13.7" NUMBER 2 /end CHARACTERISTIC
/begin CHARACTERISTIC DINH_Lim.DFC_ECBVlvOL_CA "DINH/Zugeordnete Verriegelungslimits für Verriegelungsquelle DFC_ECBVlvOL" VAL_BLK 0x8002756C ValA_Wu16 8192.00000000 DINH_LimDFCVerb 12079.0000000 20271.0000000 FORMAT "%13.7" NUMBER 4 /end CHARACTERISTIC
/begin CHARACTERISTIC DINH_Lim.DFC_ECBVlvOvrTemp_CA "DINH/Zugeordnete Verriegelungslimits für Verriegelungsquelle DFC_ECBVlvOvrTemp" VAL_BLK 0x80027574 ValA_Wu16 8192.00000000 DINH_LimDFCVerb 12079.0000000 20271.0000000 FORMAT "%13.7" NUMBER 2 /end CHARACTERISTIC
/begin CHARACTERISTIC DINH_Lim.DFC_ECBVlvSCB_CA "DINH/Zugeordnete Verriegelungslimits für Verriegelungsquelle DFC_ECBVlvSCB" VAL_BLK 0x80027578 ValA_Wu16 8192.00000000 DINH_LimDFCVerb 12079.0000000 20271.0000000 FORMAT "%13.7" NUMBER 4 /end CHARACTERISTIC
/begin CHARACTERISTIC DINH_Lim.DFC_ECBVlvSCG_CA "DINH/Zugeordnete Verriegelungslimits für Verriegelungsquelle DFC_ECBVlvSCG" VAL_BLK 0x80027580 ValA_Wu16 8192.00000000 DINH_LimDFCVerb 12079.0000000 20271.0000000 FORMAT "%13.7" NUMBER 4 /end CHARACTERISTIC
/begin CHARACTERISTIC DINH_Lim.DFC_EMDmpOL_0_CA "DINH/Zugeordnete Verriegelungslimits für Verriegelungsquelle DFC_EMDmpOL_0" VAL_BLK 0x80027588 ValA_Wu16 8192.00000000 DINH_LimDFCVerb 12079.0000000 20271.0000000 FORMAT "%13.7" NUMBER 2 /end CHARACTERISTIC
/begin CHARACTERISTIC DINH_Lim.DFC_EMDmpOL_1_CA "DINH/Zugeordnete Verriegelungslimits für Verriegelungsquelle DFC_EMDmpOL_1" VAL_BLK 0x8002758C ValA_Wu16 8192.00000000 DINH_LimDFCVerb 12079.0000000 20271.0000000 FORMAT "%13.7" NUMBER 2 /end CHARACTERISTIC
/begin CHARACTERISTIC DINH_Lim.DFC_EMDmpOvrTemp_0_CA "DINH/Zugeordnete Verriegelungslimits für Verriegelungsquelle DFC_EMDmpOvrTemp_0" VAL_BLK 0x80027590 ValA_Wu16 8192.00000000 DINH_LimDFCVerb 12079.0000000 20271.0000000 FORMAT "%13.7" NUMBER 2 /end CHARACTERISTIC
/begin CHARACTERISTIC DINH_Lim.DFC_EMDmpOvrTemp_1_CA "DINH/Zugeordnete Verriegelungslimits für Verriegelungsquelle DFC_EMDmpOvrTemp_1" VAL_BLK 0x80027594 ValA_Wu16 8192.00000000 DINH_LimDFCVerb 12079.0000000 20271.0000000 FORMAT "%13.7" NUMBER 2 /end CHARACTERISTIC
/begin CHARACTERISTIC DINH_Lim.DFC_EMDmpSCB_0_CA "DINH/Zugeordnete Verriegelungslimits für Verriegelungsquelle DFC_EMDmpSCB_0" VAL_BLK 0x80027598 ValA_Wu16 8192.00000000 DINH_LimDFCVerb 12079.0000000 20271.0000000 FORMAT "%13.7" NUMBER 2 /end CHARACTERISTIC
/begin CHARACTERISTIC DINH_Lim.DFC_EMDmpSCB_1_CA "DINH/Zugeordnete Verriegelungslimits für Verriegelungsquelle DFC_EMDmpSCB_1" VAL_BLK 0x8002759C ValA_Wu16 8192.00000000 DINH_LimDFCVerb 12079.0000000 20271.0000000 FORMAT "%13.7" NUMBER 2 /end CHARACTERISTIC
/begin CHARACTERISTIC DINH_Lim.DFC_EMDmpSCG_0_CA "DINH/Zugeordnete Verriegelungslimits für Verriegelungsquelle DFC_EMDmpSCG_0" VAL_BLK 0x800275A0 ValA_Wu16 8192.00000000 DINH_LimDFCVerb 12079.0000000 20271.0000000 FORMAT "%13.7" NUMBER 2 /end CHARACTERISTIC
/begin CHARACTERISTIC DINH_Lim.DFC_EMDmpSCG_1_CA "DINH/Zugeordnete Verriegelungslimits für Verriegelungsquelle DFC_EMDmpSCG_1" VAL_BLK 0x800275A4 ValA_Wu16 8192.00000000 DINH_LimDFCVerb 12079.0000000 20271.0000000 FORMAT "%13.7" NUMBER 2 /end CHARACTERISTIC
/begin CHARACTERISTIC DINH_Lim.DFC_EngStAOL_CA "DINH/Zugeordnete Verriegelungslimits für Verriegelungsquelle DFC_EngStAOL" VAL_BLK 0x800275A8 ValA_Wu16 8192.00000000 DINH_LimDFCVerb 12079.0000000 20271.0000000 FORMAT "%13.7" NUMBER 2 /end CHARACTERISTIC
/begin CHARACTERISTIC DINH_Lim.DFC_EngStAOvrTemp_CA "DINH/Zugeordnete Verriegelungslimits für Verriegelungsquelle DFC_EngStAOvrTemp" VAL_BLK 0x800275AC ValA_Wu16 8192.00000000 DINH_LimDFCVerb 12079.0000000 20271.0000000 FORMAT "%13.7" NUMBER 2 /end CHARACTERISTIC
/begin CHARACTERISTIC DINH_Lim.DFC_EngStASCB_CA "DINH/Zugeordnete Verriegelungslimits für Verriegelungsquelle DFC_EngStASCB" VAL_BLK 0x800275B0 ValA_Wu16 8192.00000000 DINH_LimDFCVerb 12079.0000000 20271.0000000 FORMAT "%13.7" NUMBER 2 /end CHARACTERISTIC
/begin CHARACTERISTIC DINH_Lim.DFC_EngStASCG_CA "DINH/Zugeordnete Verriegelungslimits für Verriegelungsquelle DFC_EngStASCG" VAL_BLK 0x800275B4 ValA_Wu16 8192.00000000 DINH_LimDFCVerb 12079.0000000 20271.0000000 FORMAT "%13.7" NUMBER 2 /end CHARACTERISTIC
/begin CHARACTERISTIC DINH_Lim.DFC_FanOL_CA "DINH/Zugeordnete Verriegelungslimits für Verriegelungsquelle DFC_FanOL" VAL_BLK 0x800275B8 ValA_Wu16 8192.00000000 DINH_LimDFCVerb 12079.0000000 20271.0000000 FORMAT "%13.7" NUMBER 2 /end CHARACTERISTIC
/begin CHARACTERISTIC DINH_Lim.DFC_FanOvrTemp_CA "DINH/Zugeordnete Verriegelungslimits für Verriegelungsquelle DFC_FanOvrTemp" VAL_BLK 0x800275BC ValA_Wu16 8192.00000000 DINH_LimDFCVerb 12079.0000000 20271.0000000 FORMAT "%13.7" NUMBER 2 /end CHARACTERISTIC
/begin CHARACTERISTIC DINH_Lim.DFC_FanSCB_CA "DINH/Zugeordnete Verriegelungslimits für Verriegelungsquelle DFC_FanSCB" VAL_BLK 0x800275C0 ValA_Wu16 8192.00000000 DINH_LimDFCVerb 12079.0000000 20271.0000000 FORMAT "%13.7" NUMBER 2 /end CHARACTERISTIC
/begin CHARACTERISTIC DINH_Lim.DFC_FlFltHtOL_CA "DINH/Zugeordnete Verriegelungslimits für Verriegelungsquelle DFC_FlFltHtOL" VAL_BLK 0x800275C4 ValA_Wu16 8192.00000000 DINH_LimDFCVerb 12079.0000000 20271.0000000 FORMAT "%13.7" NUMBER 2 /end CHARACTERISTIC
/begin CHARACTERISTIC DINH_Lim.DFC_FlFltHtOvrTemp_CA "DINH/Zugeordnete Verriegelungslimits für Verriegelungsquelle DFC_FlFltHtOvrTemp" VAL_BLK 0x800275C8 ValA_Wu16 8192.00000000 DINH_LimDFCVerb 12079.0000000 20271.0000000 FORMAT "%13.7" NUMBER 2 /end CHARACTERISTIC
/begin CHARACTERISTIC DINH_Lim.DFC_FlFltHtSCB_CA "DINH/Zugeordnete Verriegelungslimits für Verriegelungsquelle DFC_FlFltHtSCB" VAL_BLK 0x800275CC ValA_Wu16 8192.00000000 DINH_LimDFCVerb 12079.0000000 20271.0000000 FORMAT "%13.7" NUMBER 2 /end CHARACTERISTIC
/begin CHARACTERISTIC DINH_Lim.DFC_FlFltHtSCG_CA "DINH/Zugeordnete Verriegelungslimits für Verriegelungsquelle DFC_FlFltHtSCG" VAL_BLK 0x800275D0 ValA_Wu16 8192.00000000 DINH_LimDFCVerb 12079.0000000 20271.0000000 FORMAT "%13.7" NUMBER 2 /end CHARACTERISTIC
/begin CHARACTERISTIC DINH_Lim.DFC_LSUHtrMax_CA "DINH/Zugeordnete Verriegelungslimits für Verriegelungsquelle DFC_LSUHtrMax" VAL_BLK 0x800275D4 ValA_Wu16 8192.00000000 DINH_LimDFCVerb 12079.0000000 20271.0000000 FORMAT "%13.7" NUMBER 13 /end CHARACTERISTIC
/begin CHARACTERISTIC DINH_Lim.DFC_LSUHtrMin_CA "DINH/Zugeordnete Verriegelungslimits für Verriegelungsquelle DFC_LSUHtrMin" VAL_BLK 0x800275EE ValA_Wu16 8192.00000000 DINH_LimDFCVerb 12079.0000000 20271.0000000 FORMAT "%13.7" NUMBER 13 /end CHARACTERISTIC
/begin CHARACTERISTIC DINH_Lim.DFC_LSUHtrNpl_CA "DINH/Zugeordnete Verriegelungslimits für Verriegelungsquelle DFC_LSUHtrNpl" VAL_BLK 0x80027608 ValA_Wu16 8192.00000000 DINH_LimDFCVerb 12079.0000000 20271.0000000 FORMAT "%13.7" NUMBER 13 /end CHARACTERISTIC
/begin CHARACTERISTIC DINH_Lim.DFC_LSUHtrSig_CA "DINH/Zugeordnete Verriegelungslimits für Verriegelungsquelle DFC_LSUHtrSig" VAL_BLK 0x80027622 ValA_Wu16 8192.00000000 DINH_LimDFCVerb 12079.0000000 20271.0000000 FORMAT "%13.7" NUMBER 13 /end CHARACTERISTIC
/begin CHARACTERISTIC DINH_Lim.DFC_LSUtExcMax_CA "DINH/Zugeordnete Verriegelungslimits für Verriegelungsquelle DFC_LSUtExcMax" VAL_BLK 0x8002763C ValA_Wu16 8192.00000000 DINH_LimDFCVerb 12079.0000000 20271.0000000 FORMAT "%13.7" NUMBER 12 /end CHARACTERISTIC
/begin CHARACTERISTIC DINH_Lim.DFC_LSUtExcMin_CA "DINH/Zugeordnete Verriegelungslimits für Verriegelungsquelle DFC_LSUtExcMin" VAL_BLK 0x80027654 ValA_Wu16 8192.00000000 DINH_LimDFCVerb 12079.0000000 20271.0000000 FORMAT "%13.7" NUMBER 12 /end CHARACTERISTIC
/begin CHARACTERISTIC DINH_Lim.DFC_MeUnOL_CA "DINH/Zugeordnete Verriegelungslimits für Verriegelungsquelle DFC_MeUnOL" VAL_BLK 0x8002766C ValA_Wu16 8192.00000000 DINH_LimDFCVerb 12079.0000000 20271.0000000 FORMAT "%13.7" NUMBER 12 /end CHARACTERISTIC
/begin CHARACTERISTIC DINH_Lim.DFC_MeUnSCB_CA "DINH/Zugeordnete Verriegelungslimits für Verriegelungsquelle DFC_MeUnSCB" VAL_BLK 0x80027684 ValA_Wu16 8192.00000000 DINH_LimDFCVerb 12079.0000000 20271.0000000 FORMAT "%13.7" NUMBER 12 /end CHARACTERISTIC
/begin CHARACTERISTIC DINH_Lim.DFC_MeUnSRCMax_CA "DINH/Zugeordnete Verriegelungslimits für Verriegelungsquelle DFC_MeUnSRCMax" VAL_BLK 0x8002769C ValA_Wu16 8192.00000000 DINH_LimDFCVerb 12079.0000000 20271.0000000 FORMAT "%13.7" NUMBER 4 /end CHARACTERISTIC
/begin CHARACTERISTIC DINH_Lim.DFC_MeUnSRCMin_CA "DINH/Zugeordnete Verriegelungslimits für Verriegelungsquelle DFC_MeUnSRCMin" VAL_BLK 0x800276A4 ValA_Wu16 8192.00000000 DINH_LimDFCVerb 12079.0000000 20271.0000000 FORMAT "%13.7" NUMBER 4 /end CHARACTERISTIC
/begin CHARACTERISTIC DINH_Lim.DFC_PCVOL_CA "DINH/Zugeordnete Verriegelungslimits für Verriegelungsquelle DFC_PCVOL" VAL_BLK 0x800276AC ValA_Wu16 8192.00000000 DINH_LimDFCVerb 12079.0000000 20271.0000000 FORMAT "%13.7" NUMBER 9 /end CHARACTERISTIC
/begin CHARACTERISTIC DINH_Lim.DFC_PCVSCB_CA "DINH/Zugeordnete Verriegelungslimits für Verriegelungsquelle DFC_PCVSCB" VAL_BLK 0x800276BE ValA_Wu16 8192.00000000 DINH_LimDFCVerb 12079.0000000 20271.0000000 FORMAT "%13.7" NUMBER 9 /end CHARACTERISTIC
/begin CHARACTERISTIC DINH_Lim.DFC_PCVSRCMax_CA "DINH/Zugeordnete Verriegelungslimits für Verriegelungsquelle DFC_PCVSRCMax" VAL_BLK 0x800276D0 ValA_Wu16 8192.00000000 DINH_LimDFCVerb 12079.0000000 20271.0000000 FORMAT "%13.7" NUMBER 3 /end CHARACTERISTIC
/begin CHARACTERISTIC DINH_Lim.DFC_PCVSRCMin_CA "DINH/Zugeordnete Verriegelungslimits für Verriegelungsquelle DFC_PCVSRCMin" VAL_BLK 0x800276D6 ValA_Wu16 8192.00000000 DINH_LimDFCVerb 12079.0000000 20271.0000000 FORMAT "%13.7" NUMBER 3 /end CHARACTERISTIC
/begin CHARACTERISTIC DINH_Lim.DFC_RailPSRCMax_CA "DINH/Zugeordnete Verriegelungslimits für Verriegelungsquelle DFC_RailPSRCMax" VAL_BLK 0x800276DC ValA_Wu16 8192.00000000 DINH_LimDFCVerb 12079.0000000 20271.0000000 FORMAT "%13.7" NUMBER 14 /end CHARACTERISTIC
/begin CHARACTERISTIC DINH_Lim.DFC_RailPSRCMin_CA "DINH/Zugeordnete Verriegelungslimits für Verriegelungsquelle DFC_RailPSRCMin" VAL_BLK 0x800276F8 ValA_Wu16 8192.00000000 DINH_LimDFCVerb 12079.0000000 20271.0000000 FORMAT "%13.7" NUMBER 14 /end CHARACTERISTIC
/begin CHARACTERISTIC DINH_Lim.DFC_ShtrOL_CA "DINH/Zugeordnete Verriegelungslimits für Verriegelungsquelle DFC_ShtrOL" VAL_BLK 0x80027714 ValA_Wu16 8192.00000000 DINH_LimDFCVerb 12079.0000000 20271.0000000 FORMAT "%13.7" NUMBER 2 /end CHARACTERISTIC
/begin CHARACTERISTIC DINH_Lim.DFC_ShtrOvrTemp_CA "DINH/Zugeordnete Verriegelungslimits für Verriegelungsquelle DFC_ShtrOvrTemp" VAL_BLK 0x80027718 ValA_Wu16 8192.00000000 DINH_LimDFCVerb 12079.0000000 20271.0000000 FORMAT "%13.7" NUMBER 2 /end CHARACTERISTIC
/begin CHARACTERISTIC DINH_Lim.DFC_ShtrSCB_CA "DINH/Zugeordnete Verriegelungslimits für Verriegelungsquelle DFC_ShtrSCB" VAL_BLK 0x8002771C ValA_Wu16 8192.00000000 DINH_LimDFCVerb 12079.0000000 20271.0000000 FORMAT "%13.7" NUMBER 2 /end CHARACTERISTIC
/begin CHARACTERISTIC DINH_Lim.DFC_ShtrSCG_CA "DINH/Zugeordnete Verriegelungslimits für Verriegelungsquelle DFC_ShtrSCG" VAL_BLK 0x80027720 ValA_Wu16 8192.00000000 DINH_LimDFCVerb 12079.0000000 20271.0000000 FORMAT "%13.7" NUMBER 2 /end CHARACTERISTIC
/begin CHARACTERISTIC DINH_Lim.DFC_StrtOL_CA "DINH/Zugeordnete Verriegelungslimits für Verriegelungsquelle DFC_StrtOL" VAL_BLK 0x80027724 ValA_Wu16 8192.00000000 DINH_LimDFCVerb 12079.0000000 20271.0000000 FORMAT "%13.7" NUMBER 2 /end CHARACTERISTIC
/begin CHARACTERISTIC DINH_Lim.DFC_StrtOvrTemp_CA "DINH/Zugeordnete Verriegelungslimits für Verriegelungsquelle DFC_StrtOvrTemp" VAL_BLK 0x80027728 ValA_Wu16 8192.00000000 DINH_LimDFCVerb 12079.0000000 20271.0000000 FORMAT "%13.7" NUMBER 2 /end CHARACTERISTIC
/begin CHARACTERISTIC DINH_Lim.DFC_StrtSCB_CA "DINH/Zugeordnete Verriegelungslimits für Verriegelungsquelle DFC_StrtSCB" VAL_BLK 0x8002772C ValA_Wu16 8192.00000000 DINH_LimDFCVerb 12079.0000000 20271.0000000 FORMAT "%13.7" NUMBER 2 /end CHARACTERISTIC
/begin CHARACTERISTIC DINH_Lim.DFC_StrtSCG_CA "DINH/Zugeordnete Verriegelungslimits für Verriegelungsquelle DFC_StrtSCG" VAL_BLK 0x80027730 ValA_Wu16 8192.00000000 DINH_LimDFCVerb 12079.0000000 20271.0000000 FORMAT "%13.7" NUMBER 2 /end CHARACTERISTIC
/begin CHARACTERISTIC DINH_Lim.DFC_ThrVlvOL_CA "DINH/Zugeordnete Verriegelungslimits für Verriegelungsquelle DFC_ThrVlvOL" VAL_BLK 0x80027734 ValA_Wu16 8192.00000000 DINH_LimDFCVerb 12079.0000000 20271.0000000 FORMAT "%13.7" NUMBER 8 /end CHARACTERISTIC
/begin CHARACTERISTIC DINH_Lim.DFC_ThrVlvOvrTemp_CA "DINH/Zugeordnete Verriegelungslimits für Verriegelungsquelle DFC_ThrVlvOvrTemp" VAL_BLK 0x80027744 ValA_Wu16 8192.00000000 DINH_LimDFCVerb 12079.0000000 20271.0000000 FORMAT "%13.7" NUMBER 2 /end CHARACTERISTIC
/begin CHARACTERISTIC DINH_Lim.DFC_ThrVlvSCB_CA "DINH/Zugeordnete Verriegelungslimits für Verriegelungsquelle DFC_ThrVlvSCB" VAL_BLK 0x80027748 ValA_Wu16 8192.00000000 DINH_LimDFCVerb 12079.0000000 20271.0000000 FORMAT "%13.7" NUMBER 8 /end CHARACTERISTIC
/begin CHARACTERISTIC DINH_Lim.DFC_TrbChOL_CA "DINH/Zugeordnete Verriegelungslimits für Verriegelungsquelle DFC_TrbChOL" VAL_BLK 0x80027758 ValA_Wu16 8192.00000000 DINH_LimDFCVerb 12079.0000000 20271.0000000 FORMAT "%13.7" NUMBER 9 /end CHARACTERISTIC
/begin CHARACTERISTIC DINH_Lim.DFC_TrbChOvrTemp_CA "DINH/Zugeordnete Verriegelungslimits für Verriegelungsquelle DFC_TrbChOvrTemp" VAL_BLK 0x8002776A ValA_Wu16 8192.00000000 DINH_LimDFCVerb 12079.0000000 20271.0000000 FORMAT "%13.7" NUMBER 2 /end CHARACTERISTIC
/begin CHARACTERISTIC DINH_Lim.DFC_TrbChSCB_CA "DINH/Zugeordnete Verriegelungslimits für Verriegelungsquelle DFC_TrbChSCB" VAL_BLK 0x8002776E ValA_Wu16 8192.00000000 DINH_LimDFCVerb 12079.0000000 20271.0000000 FORMAT "%13.7" NUMBER 8 /end CHARACTERISTIC
/begin CHARACTERISTIC DINH_Lim.DFC_UDosVlvOL_CA "DINH/Zugeordnete Verriegelungslimits für Verriegelungsquelle DFC_UDosVlvOL" VAL_BLK 0x8002777E ValA_Wu16 8192.00000000 DINH_LimDFCVerb 12079.0000000 20271.0000000 FORMAT "%13.7" NUMBER 12 /end CHARACTERISTIC
/begin CHARACTERISTIC DINH_Lim.DFC_UDosVlvOvrTemp_CA "DINH/Zugeordnete Verriegelungslimits für Verriegelungsquelle DFC_UDosVlvOvrTemp" VAL_BLK 0x80027796 ValA_Wu16 8192.00000000 DINH_LimDFCVerb 12079.0000000 20271.0000000 FORMAT "%13.7" NUMBER 2 /end CHARACTERISTIC
/begin CHARACTERISTIC DINH_Lim.DFC_UDosVlvSCB_CA "DINH/Zugeordnete Verriegelungslimits für Verriegelungsquelle DFC_UDosVlvSCB" VAL_BLK 0x8002779A ValA_Wu16 8192.00000000 DINH_LimDFCVerb 12079.0000000 20271.0000000 FORMAT "%13.7" NUMBER 12 /end CHARACTERISTIC
/begin CHARACTERISTIC DINH_Lim.DFC_UDosVlvSCG_CA "DINH/Zugeordnete Verriegelungslimits für Verriegelungsquelle DFC_UDosVlvSCG" VAL_BLK 0x800277B2 ValA_Wu16 8192.00000000 DINH_LimDFCVerb 12079.0000000 20271.0000000 FORMAT "%13.7" NUMBER 10 /end CHARACTERISTIC
/begin CHARACTERISTIC DINH_Lim.DFC_UPmpMotOL_CA "DINH/Zugeordnete Verriegelungslimits für Verriegelungsquelle DFC_UPmpMotOL" VAL_BLK 0x800277C6 ValA_Wu16 8192.00000000 DINH_LimDFCVerb 12079.0000000 20271.0000000 FORMAT "%13.7" NUMBER 11 /end CHARACTERISTIC
/begin CHARACTERISTIC DINH_Lim.DFC_UPmpMotOvrTemp_CA "DINH/Zugeordnete Verriegelungslimits für Verriegelungsquelle DFC_UPmpMotOvrTemp" VAL_BLK 0x800277DC ValA_Wu16 8192.00000000 DINH_LimDFCVerb 12079.0000000 20271.0000000 FORMAT "%13.7" NUMBER 2 /end CHARACTERISTIC
/begin CHARACTERISTIC DINH_Lim.DFC_UPmpMotSCB_CA "DINH/Zugeordnete Verriegelungslimits für Verriegelungsquelle DFC_UPmpMotSCB" VAL_BLK 0x800277E0 ValA_Wu16 8192.00000000 DINH_LimDFCVerb 12079.0000000 20271.0000000 FORMAT "%13.7" NUMBER 12 /end CHARACTERISTIC
/begin CHARACTERISTIC DINH_Lim.DFC_UPmpMotSCG_CA "DINH/Zugeordnete Verriegelungslimits für Verriegelungsquelle DFC_UPmpMotSCG" VAL_BLK 0x800277F8 ValA_Wu16 8192.00000000 DINH_LimDFCVerb 12079.0000000 20271.0000000 FORMAT "%13.7" NUMBER 3 /end CHARACTERISTIC
/begin CHARACTERISTIC DINH_Lim.DFC_WaHtElOL_CA "DINH/Zugeordnete Verriegelungslimits für Verriegelungsquelle DFC_WaHtElOL" VAL_BLK 0x800277FE ValA_Wu16 8192.00000000 DINH_LimDFCVerb 12079.0000000 20271.0000000 FORMAT "%13.7" NUMBER 2 /end CHARACTERISTIC
/begin CHARACTERISTIC DINH_Lim.DFC_WaHtElOvrTemp_CA "DINH/Zugeordnete Verriegelungslimits für Verriegelungsquelle DFC_WaHtElOvrTemp" VAL_BLK 0x80027802 ValA_Wu16 8192.00000000 DINH_LimDFCVerb 12079.0000000 20271.0000000 FORMAT "%13.7" NUMBER 2 /end CHARACTERISTIC
/begin CHARACTERISTIC DINH_Lim.DFC_WaHtElSCB_CA "DINH/Zugeordnete Verriegelungslimits für Verriegelungsquelle DFC_WaHtElSCB" VAL_BLK 0x80027806 ValA_Wu16 8192.00000000 DINH_LimDFCVerb 12079.0000000 20271.0000000 FORMAT "%13.7" NUMBER 2 /end CHARACTERISTIC
/begin CHARACTERISTIC DINH_Lim.DFC_IVActrUChSRCMax_CA "DINH/Zugeordnete Verriegelungslimits für Verriegelungsquelle DFC_IVActrUChSRCMax" VAL_BLK 0x8002780A ValA_Wu16 8192.00000000 DINH_LimDFCVerb 12079.0000000 20271.0000000 FORMAT "%13.7" NUMBER 2 /end CHARACTERISTIC
/begin CHARACTERISTIC DINH_Lim.DFC_IVActrUChSRCMin_CA "DINH/Zugeordnete Verriegelungslimits für Verriegelungsquelle DFC_IVActrUChSRCMin" VAL_BLK 0x8002780E ValA_Wu16 8192.00000000 DINH_LimDFCVerb 12079.0000000 20271.0000000 FORMAT "%13.7" NUMBER 2 /end CHARACTERISTIC
/begin CHARACTERISTIC DINH_Lim.DFC_IVActrVltgSRCMax_CA "DINH/Zugeordnete Verriegelungslimits für Verriegelungsquelle DFC_IVActrVltgSRCMax" VAL_BLK 0x80027812 ValA_Wu16 8192.00000000 DINH_LimDFCVerb 12079.0000000 20271.0000000 FORMAT "%13.7" NUMBER 2 /end CHARACTERISTIC
/begin CHARACTERISTIC DINH_Lim.DFC_IVActrVltgSRCMin_CA "DINH/Zugeordnete Verriegelungslimits für Verriegelungsquelle DFC_IVActrVltgSRCMin" VAL_BLK 0x80027816 ValA_Wu16 8192.00000000 DINH_LimDFCVerb 12079.0000000 20271.0000000 FORMAT "%13.7" NUMBER 2 /end CHARACTERISTIC
/begin CHARACTERISTIC DINH_Lim.DFC_IVDiaTunDet_CA "DINH/Zugeordnete Verriegelungslimits für Verriegelungsquelle DFC_IVDiaTunDet" VAL_BLK 0x8002781A ValA_Wu16 8192.00000000 DINH_LimDFCVerb 12079.0000000 20271.0000000 FORMAT "%13.7" NUMBER 2 /end CHARACTERISTIC
/begin CHARACTERISTIC DINH_Lim.DFC_IVPSplyStopDCDC_CA "DINH/Zugeordnete Verriegelungslimits für Verriegelungsquelle DFC_IVPSplyStopDCDC" VAL_BLK 0x8002781E ValA_Wu16 8192.00000000 DINH_LimDFCVerb 12079.0000000 20271.0000000 FORMAT "%13.7" NUMBER 2 /end CHARACTERISTIC
/begin CHARACTERISTIC DINH_Lim.DFC_IVPSplyVltgSRCMax_CA "DINH/Zugeordnete Verriegelungslimits für Verriegelungsquelle DFC_IVPSplyVltgSRCMax" VAL_BLK 0x80027822 ValA_Wu16 8192.00000000 DINH_LimDFCVerb 12079.0000000 20271.0000000 FORMAT "%13.7" NUMBER 2 /end CHARACTERISTIC
/begin CHARACTERISTIC DINH_Lim.DFC_IVPSplyVltgSRCMin_CA "DINH/Zugeordnete Verriegelungslimits für Verriegelungsquelle DFC_IVPSplyVltgSRCMin" VAL_BLK 0x80027826 ValA_Wu16 8192.00000000 DINH_LimDFCVerb 12079.0000000 20271.0000000 FORMAT "%13.7" NUMBER 2 /end CHARACTERISTIC
/begin CHARACTERISTIC DINH_Lim.DFC_SCREtaErr_CA "DINH/Zugeordnete Verriegelungslimits für Verriegelungsquelle DFC_SCREtaErr" VAL_BLK 0x8002782A ValA_Wu16 8192.00000000 DINH_LimDFCVerb 12079.0000000 20271.0000000 FORMAT "%13.7" NUMBER 2 /end CHARACTERISTIC
/begin CHARACTERISTIC DINH_Lim.DFC_SCREtaErr1_CA "DINH/Zugeordnete Verriegelungslimits für Verriegelungsquelle DFC_SCREtaErr1" VAL_BLK 0x8002782E ValA_Wu16 8192.00000000 DINH_LimDFCVerb 12079.0000000 20271.0000000 FORMAT "%13.7" NUMBER 2 /end CHARACTERISTIC
/begin CHARACTERISTIC DINH_Lim.DFC_SCREtaErr2_CA "DINH/Zugeordnete Verriegelungslimits für Verriegelungsquelle DFC_SCREtaErr2" VAL_BLK 0x80027832 ValA_Wu16 8192.00000000 DINH_LimDFCVerb 12079.0000000 20271.0000000 FORMAT "%13.7" NUMBER 2 /end CHARACTERISTIC
/begin CHARACTERISTIC DINH_Lim.DFC_SCRMonMetCtlPresErr_CA "DINH/Zugeordnete Verriegelungslimits für Verriegelungsquelle DFC_SCRMonMetCtlPresErr" VAL_BLK 0x80027836 ValA_Wu16 8192.00000000 DINH_LimDFCVerb 12079.0000000 20271.0000000 FORMAT "%13.7" NUMBER 2 /end CHARACTERISTIC
/begin CHARACTERISTIC DINH_Lim.DFC_SCRMonPresBuildUpErr_CA "DINH/Zugeordnete Verriegelungslimits für Verriegelungsquelle DFC_SCRMonPresBuildUpErr" VAL_BLK 0x8002783A ValA_Wu16 8192.00000000 DINH_LimDFCVerb 12079.0000000 20271.0000000 FORMAT "%13.7" NUMBER 2 /end CHARACTERISTIC
/begin CHARACTERISTIC DINH_Lim.DFC_SCRMonPresRdcErr_CA "DINH/Zugeordnete Verriegelungslimits für Verriegelungsquelle DFC_SCRMonPresRdcErr" VAL_BLK 0x8002783E ValA_Wu16 8192.00000000 DINH_LimDFCVerb 12079.0000000 20271.0000000 FORMAT "%13.7" NUMBER 4 /end CHARACTERISTIC
/begin CHARACTERISTIC DINH_Lim.DFC_AFSOffsDrftMax_CA "DINH/Zugeordnete Verriegelungslimits für Verriegelungsquelle DFC_AFSOffsDrftMax" VAL_BLK 0x80027846 ValA_Wu16 8192.00000000 DINH_LimDFCVerb 12079.0000000 20271.0000000 FORMAT "%13.7" NUMBER 19 /end CHARACTERISTIC
/begin CHARACTERISTIC DINH_Lim.DFC_AFSOffsDrftMin_CA "DINH/Zugeordnete Verriegelungslimits für Verriegelungsquelle DFC_AFSOffsDrftMin" VAL_BLK 0x8002786C ValA_Wu16 8192.00000000 DINH_LimDFCVerb 12079.0000000 20271.0000000 FORMAT "%13.7" NUMBER 18 /end CHARACTERISTIC
/begin CHARACTERISTIC DINH_Lim.DFC_AFSSRCCorMax_CA "DINH/Zugeordnete Verriegelungslimits für Verriegelungsquelle DFC_AFSSRCCorMax" VAL_BLK 0x80027890 ValA_Wu16 8192.00000000 DINH_LimDFCVerb 12079.0000000 20271.0000000 FORMAT "%13.7" NUMBER 10 /end CHARACTERISTIC
/begin CHARACTERISTIC DINH_Lim.DFC_AFSSRCCorMin_CA "DINH/Zugeordnete Verriegelungslimits für Verriegelungsquelle DFC_AFSSRCCorMin" VAL_BLK 0x800278A4 ValA_Wu16 8192.00000000 DINH_LimDFCVerb 12079.0000000 20271.0000000 FORMAT "%13.7" NUMBER 10 /end CHARACTERISTIC
/begin CHARACTERISTIC DINH_Lim.DFC_AFSSRCRawMax_CA "DINH/Zugeordnete Verriegelungslimits für Verriegelungsquelle DFC_AFSSRCRawMax" VAL_BLK 0x800278B8 ValA_Wu16 8192.00000000 DINH_LimDFCVerb 12079.0000000 20271.0000000 FORMAT "%13.7" NUMBER 10 /end CHARACTERISTIC
/begin CHARACTERISTIC DINH_Lim.DFC_AFSSRCRawMin_CA "DINH/Zugeordnete Verriegelungslimits für Verriegelungsquelle DFC_AFSSRCRawMin" VAL_BLK 0x800278CC ValA_Wu16 8192.00000000 DINH_LimDFCVerb 12079.0000000 20271.0000000 FORMAT "%13.7" NUMBER 10 /end CHARACTERISTIC
/begin CHARACTERISTIC DINH_Lim.DFC_AFSSetyDrftMax_CA "DINH/Zugeordnete Verriegelungslimits für Verriegelungsquelle DFC_AFSSetyDrftMax" VAL_BLK 0x800278E0 ValA_Wu16 8192.00000000 DINH_LimDFCVerb 12079.0000000 20271.0000000 FORMAT "%13.7" NUMBER 19 /end CHARACTERISTIC
/begin CHARACTERISTIC DINH_Lim.DFC_AFSSetyDrftMin_CA "DINH/Zugeordnete Verriegelungslimits für Verriegelungsquelle DFC_AFSSetyDrftMin" VAL_BLK 0x80027906 ValA_Wu16 8192.00000000 DINH_LimDFCVerb 12079.0000000 20271.0000000 FORMAT "%13.7" NUMBER 19 /end CHARACTERISTIC
/begin CHARACTERISTIC DINH_Lim.DFC_AirCSwtNpl_CA "DINH/Zugeordnete Verriegelungslimits für Verriegelungsquelle DFC_AirCSwtNpl" VAL_BLK 0x8002792C ValA_Wu16 8192.00000000 DINH_LimDFCVerb 12079.0000000 20271.0000000 FORMAT "%13.7" NUMBER 3 /end CHARACTERISTIC
/begin CHARACTERISTIC DINH_Lim.DFC_AirCSwtSig_CA "DINH/Zugeordnete Verriegelungslimits für Verriegelungsquelle DFC_AirCSwtSig" VAL_BLK 0x80027932 ValA_Wu16 8192.00000000 DINH_LimDFCVerb 12079.0000000 20271.0000000 FORMAT "%13.7" NUMBER 3 /end CHARACTERISTIC
/begin CHARACTERISTIC DINH_Lim.DFC_BattUSRCMax_CA "DINH/Zugeordnete Verriegelungslimits für Verriegelungsquelle DFC_BattUSRCMax" VAL_BLK 0x80027938 ValA_Wu16 8192.00000000 DINH_LimDFCVerb 12079.0000000 20271.0000000 FORMAT "%13.7" NUMBER 7 /end CHARACTERISTIC
/begin CHARACTERISTIC DINH_Lim.DFC_BattUSRCMin_CA "DINH/Zugeordnete Verriegelungslimits für Verriegelungsquelle DFC_BattUSRCMin" VAL_BLK 0x80027946 ValA_Wu16 8192.00000000 DINH_LimDFCVerb 12079.0000000 20271.0000000 FORMAT "%13.7" NUMBER 7 /end CHARACTERISTIC
/begin CHARACTERISTIC DINH_Lim.DFC_BrkNpl_CA "DINH/Zugeordnete Verriegelungslimits für Verriegelungsquelle DFC_BrkNpl" VAL_BLK 0x80027954 ValA_Wu16 8192.00000000 DINH_LimDFCVerb 12079.0000000 20271.0000000 FORMAT "%13.7" NUMBER 18 /end CHARACTERISTIC
/begin CHARACTERISTIC DINH_Lim.DFC_BrkPSRCMax_CA "DINH/Zugeordnete Verriegelungslimits für Verriegelungsquelle DFC_BrkPSRCMax" VAL_BLK 0x80027978 ValA_Wu16 8192.00000000 DINH_LimDFCVerb 12079.0000000 20271.0000000 FORMAT "%13.7" NUMBER 6 /end CHARACTERISTIC
/begin CHARACTERISTIC DINH_Lim.DFC_BrkPSRCMin_CA "DINH/Zugeordnete Verriegelungslimits für Verriegelungsquelle DFC_BrkPSRCMin" VAL_BLK 0x80027984 ValA_Wu16 8192.00000000 DINH_LimDFCVerb 12079.0000000 20271.0000000 FORMAT "%13.7" NUMBER 6 /end CHARACTERISTIC
/begin CHARACTERISTIC DINH_Lim.DFC_CEngDsTSRCMax_CA "DINH/Zugeordnete Verriegelungslimits für Verriegelungsquelle DFC_CEngDsTSRCMax" VAL_BLK 0x80027990 ValA_Wu16 8192.00000000 DINH_LimDFCVerb 12079.0000000 20271.0000000 FORMAT "%13.7" NUMBER 22 /end CHARACTERISTIC
/begin CHARACTERISTIC DINH_Lim.DFC_CEngDsTSRCMin_CA "DINH/Zugeordnete Verriegelungslimits für Verriegelungsquelle DFC_CEngDsTSRCMin" VAL_BLK 0x800279BC ValA_Wu16 8192.00000000 DINH_LimDFCVerb 12079.0000000 20271.0000000 FORMAT "%13.7" NUMBER 22 /end CHARACTERISTIC
/begin CHARACTERISTIC DINH_Lim.DFC_CrCUIDet_CA "DINH/Zugeordnete Verriegelungslimits für Verriegelungsquelle DFC_CrCUIDet" VAL_BLK 0x800279E8 ValA_Wu16 8192.00000000 DINH_LimDFCVerb 12079.0000000 20271.0000000 FORMAT "%13.7" NUMBER 2 /end CHARACTERISTIC
/begin CHARACTERISTIC DINH_Lim.DFC_ECBVlvSRCMax_CA "DINH/Zugeordnete Verriegelungslimits für Verriegelungsquelle DFC_ECBVlvSRCMax" VAL_BLK 0x800279EC ValA_Wu16 8192.00000000 DINH_LimDFCVerb 12079.0000000 20271.0000000 FORMAT "%13.7" NUMBER 4 /end CHARACTERISTIC
/begin CHARACTERISTIC DINH_Lim.DFC_ECBVlvSRCMin_CA "DINH/Zugeordnete Verriegelungslimits für Verriegelungsquelle DFC_ECBVlvSRCMin" VAL_BLK 0x800279F4 ValA_Wu16 8192.00000000 DINH_LimDFCVerb 12079.0000000 20271.0000000 FORMAT "%13.7" NUMBER 4 /end CHARACTERISTIC
/begin CHARACTERISTIC DINH_Lim.DFC_ECUOvrTemp_CA "DINH/Zugeordnete Verriegelungslimits für Verriegelungsquelle DFC_ECUOvrTemp" VAL_BLK 0x800279FC ValA_Wu16 8192.00000000 DINH_LimDFCVerb 12079.0000000 20271.0000000 FORMAT "%13.7" NUMBER 2 /end CHARACTERISTIC
/begin CHARACTERISTIC DINH_Lim.DFC_EGRVlvGovDvtMax_CA "DINH/Zugeordnete Verriegelungslimits für Verriegelungsquelle DFC_EGRVlvGovDvtMax" VAL_BLK 0x80027A00 ValA_Wu16 8192.00000000 DINH_LimDFCVerb 12079.0000000 20271.0000000 FORMAT "%13.7" NUMBER 2 /end CHARACTERISTIC
/begin CHARACTERISTIC DINH_Lim.DFC_EGRVlvGovDvtMin_CA "DINH/Zugeordnete Verriegelungslimits für Verriegelungsquelle DFC_EGRVlvGovDvtMin" VAL_BLK 0x80027A04 ValA_Wu16 8192.00000000 DINH_LimDFCVerb 12079.0000000 20271.0000000 FORMAT "%13.7" NUMBER 2 /end CHARACTERISTIC
/begin CHARACTERISTIC DINH_Lim.DFC_EGRVlvHBrgOpnLd_CA "DINH/Zugeordnete Verriegelungslimits für Verriegelungsquelle DFC_EGRVlvHBrgOpnLd" VAL_BLK 0x80027A08 ValA_Wu16 8192.00000000 DINH_LimDFCVerb 12079.0000000 20271.0000000 FORMAT "%13.7" NUMBER 2 /end CHARACTERISTIC
/begin CHARACTERISTIC DINH_Lim.DFC_EGRVlvHBrgOvrCurr_CA "DINH/Zugeordnete Verriegelungslimits für Verriegelungsquelle DFC_EGRVlvHBrgOvrCurr" VAL_BLK 0x80027A0C ValA_Wu16 8192.00000000 DINH_LimDFCVerb 12079.0000000 20271.0000000 FORMAT "%13.7" NUMBER 2 /end CHARACTERISTIC
/begin CHARACTERISTIC DINH_Lim.DFC_EGRVlvHBrgOvrTemp_CA "DINH/Zugeordnete Verriegelungslimits für Verriegelungsquelle DFC_EGRVlvHBrgOvrTemp" VAL_BLK 0x80027A10 ValA_Wu16 8192.00000000 DINH_LimDFCVerb 12079.0000000 20271.0000000 FORMAT "%13.7" NUMBER 2 /end CHARACTERISTIC
/begin CHARACTERISTIC DINH_Lim.DFC_EGRVlvHBrgShCirBatt1_CA "DINH/Zugeordnete Verriegelungslimits für Verriegelungsquelle DFC_EGRVlvHBrgShCirBatt1" VAL_BLK 0x80027A14 ValA_Wu16 8192.00000000 DINH_LimDFCVerb 12079.0000000 20271.0000000 FORMAT "%13.7" NUMBER 2 /end CHARACTERISTIC
/begin CHARACTERISTIC DINH_Lim.DFC_EGRVlvHBrgShCirBatt2_CA "DINH/Zugeordnete Verriegelungslimits für Verriegelungsquelle DFC_EGRVlvHBrgShCirBatt2" VAL_BLK 0x80027A18 ValA_Wu16 8192.00000000 DINH_LimDFCVerb 12079.0000000 20271.0000000 FORMAT "%13.7" NUMBER 2 /end CHARACTERISTIC
/begin CHARACTERISTIC DINH_Lim.DFC_EGRVlvHBrgShCirGnd1_CA "DINH/Zugeordnete Verriegelungslimits für Verriegelungsquelle DFC_EGRVlvHBrgShCirGnd1" VAL_BLK 0x80027A1C ValA_Wu16 8192.00000000 DINH_LimDFCVerb 12079.0000000 20271.0000000 FORMAT "%13.7" NUMBER 2 /end CHARACTERISTIC
/begin CHARACTERISTIC DINH_Lim.DFC_EGRVlvHBrgShCirGnd2_CA "DINH/Zugeordnete Verriegelungslimits für Verriegelungsquelle DFC_EGRVlvHBrgShCirGnd2" VAL_BLK 0x80027A20 ValA_Wu16 8192.00000000 DINH_LimDFCVerb 12079.0000000 20271.0000000 FORMAT "%13.7" NUMBER 2 /end CHARACTERISTIC
/begin CHARACTERISTIC DINH_Lim.DFC_EGRVlvHBrgShCirOvrLd_CA "DINH/Zugeordnete Verriegelungslimits für Verriegelungsquelle DFC_EGRVlvHBrgShCirOvrLd" VAL_BLK 0x80027A24 ValA_Wu16 8192.00000000 DINH_LimDFCVerb 12079.0000000 20271.0000000 FORMAT "%13.7" NUMBER 2 /end CHARACTERISTIC
/begin CHARACTERISTIC DINH_Lim.DFC_EGRVlvHBrgTempOvrCurr_CA "DINH/Zugeordnete Verriegelungslimits für Verriegelungsquelle DFC_EGRVlvHBrgTempOvrCurr" VAL_BLK 0x80027A28 ValA_Wu16 8192.00000000 DINH_LimDFCVerb 12079.0000000 20271.0000000 FORMAT "%13.7" NUMBER 2 /end CHARACTERISTIC
/begin CHARACTERISTIC DINH_Lim.DFC_EGRVlvHBrgUndrVltg_CA "DINH/Zugeordnete Verriegelungslimits für Verriegelungsquelle DFC_EGRVlvHBrgUndrVltg" VAL_BLK 0x80027A2C ValA_Wu16 8192.00000000 DINH_LimDFCVerb 12079.0000000 20271.0000000 FORMAT "%13.7" NUMBER 2 /end CHARACTERISTIC
/begin CHARACTERISTIC DINH_Lim.DFC_EGRVlvLPGovDvtMax_CA "DINH/Zugeordnete Verriegelungslimits für Verriegelungsquelle DFC_EGRVlvLPGovDvtMax" VAL_BLK 0x80027A30 ValA_Wu16 8192.00000000 DINH_LimDFCVerb 12079.0000000 20271.0000000 FORMAT "%13.7" NUMBER 2 /end CHARACTERISTIC
/begin CHARACTERISTIC DINH_Lim.DFC_EGRVlvLPGovDvtMin_CA "DINH/Zugeordnete Verriegelungslimits für Verriegelungsquelle DFC_EGRVlvLPGovDvtMin" VAL_BLK 0x80027A34 ValA_Wu16 8192.00000000 DINH_LimDFCVerb 12079.0000000 20271.0000000 FORMAT "%13.7" NUMBER 2 /end CHARACTERISTIC
/begin CHARACTERISTIC DINH_Lim.DFC_EGRVlvLPHBrgOpnLd_CA "DINH/Zugeordnete Verriegelungslimits für Verriegelungsquelle DFC_EGRVlvLPHBrgOpnLd" VAL_BLK 0x80027A38 ValA_Wu16 8192.00000000 DINH_LimDFCVerb 12079.0000000 20271.0000000 FORMAT "%13.7" NUMBER 2 /end CHARACTERISTIC
/begin CHARACTERISTIC DINH_Lim.DFC_EGRVlvLPHBrgOvrCurr_CA "DINH/Zugeordnete Verriegelungslimits für Verriegelungsquelle DFC_EGRVlvLPHBrgOvrCurr" VAL_BLK 0x80027A3C ValA_Wu16 8192.00000000 DINH_LimDFCVerb 12079.0000000 20271.0000000 FORMAT "%13.7" NUMBER 2 /end CHARACTERISTIC
/begin CHARACTERISTIC DINH_Lim.DFC_EGRVlvLPHBrgOvrTemp_CA "DINH/Zugeordnete Verriegelungslimits für Verriegelungsquelle DFC_EGRVlvLPHBrgOvrTemp" VAL_BLK 0x80027A40 ValA_Wu16 8192.00000000 DINH_LimDFCVerb 12079.0000000 20271.0000000 FORMAT "%13.7" NUMBER 2 /end CHARACTERISTIC
/begin CHARACTERISTIC DINH_Lim.DFC_EGRVlvLPHBrgShCirBatt1_CA "DINH/Zugeordnete Verriegelungslimits für Verriegelungsquelle DFC_EGRVlvLPHBrgShCirBatt1" VAL_BLK 0x80027A44 ValA_Wu16 8192.00000000 DINH_LimDFCVerb 12079.0000000 20271.0000000 FORMAT "%13.7" NUMBER 2 /end CHARACTERISTIC
/begin CHARACTERISTIC DINH_Lim.DFC_EGRVlvLPHBrgShCirBatt2_CA "DINH/Zugeordnete Verriegelungslimits für Verriegelungsquelle DFC_EGRVlvLPHBrgShCirBatt2" VAL_BLK 0x80027A48 ValA_Wu16 8192.00000000 DINH_LimDFCVerb 12079.0000000 20271.0000000 FORMAT "%13.7" NUMBER 2 /end CHARACTERISTIC
/begin CHARACTERISTIC DINH_Lim.DFC_EGRVlvLPHBrgShCirGnd1_CA "DINH/Zugeordnete Verriegelungslimits für Verriegelungsquelle DFC_EGRVlvLPHBrgShCirGnd1" VAL_BLK 0x80027A4C ValA_Wu16 8192.00000000 DINH_LimDFCVerb 12079.0000000 20271.0000000 FORMAT "%13.7" NUMBER 2 /end CHARACTERISTIC
/begin CHARACTERISTIC DINH_Lim.DFC_EGRVlvLPHBrgShCirGnd2_CA "DINH/Zugeordnete Verriegelungslimits für Verriegelungsquelle DFC_EGRVlvLPHBrgShCirGnd2" VAL_BLK 0x80027A50 ValA_Wu16 8192.00000000 DINH_LimDFCVerb 12079.0000000 20271.0000000 FORMAT "%13.7" NUMBER 2 /end CHARACTERISTIC
/begin CHARACTERISTIC DINH_Lim.DFC_EGRVlvLPHBrgShCirOvrLd_CA "DINH/Zugeordnete Verriegelungslimits für Verriegelungsquelle DFC_EGRVlvLPHBrgShCirOvrLd" VAL_BLK 0x80027A54 ValA_Wu16 8192.00000000 DINH_LimDFCVerb 12079.0000000 20271.0000000 FORMAT "%13.7" NUMBER 2 /end CHARACTERISTIC
/begin CHARACTERISTIC DINH_Lim.DFC_EGRVlvLPHBrgTempOvrCurr_CA "DINH/Zugeordnete Verriegelungslimits für Verriegelungsquelle DFC_EGRVlvLPHBrgTempOvrCurr" VAL_BLK 0x80027A58 ValA_Wu16 8192.00000000 DINH_LimDFCVerb 12079.0000000 20271.0000000 FORMAT "%13.7" NUMBER 2 /end CHARACTERISTIC
/begin CHARACTERISTIC DINH_Lim.DFC_EGRVlvLPHBrgUndrVltg_CA "DINH/Zugeordnete Verriegelungslimits für Verriegelungsquelle DFC_EGRVlvLPHBrgUndrVltg" VAL_BLK 0x80027A5C ValA_Wu16 8192.00000000 DINH_LimDFCVerb 12079.0000000 20271.0000000 FORMAT "%13.7" NUMBER 2 /end CHARACTERISTIC
/begin CHARACTERISTIC DINH_Lim.DFC_EGRVlvLPOL_CA "DINH/Zugeordnete Verriegelungslimits für Verriegelungsquelle DFC_EGRVlvLPOL" VAL_BLK 0x80027A60 ValA_Wu16 8192.00000000 DINH_LimDFCVerb 12079.0000000 20271.0000000 FORMAT "%13.7" NUMBER 5 /end CHARACTERISTIC
/begin CHARACTERISTIC DINH_Lim.DFC_EGRVlvLPSCB_CA "DINH/Zugeordnete Verriegelungslimits für Verriegelungsquelle DFC_EGRVlvLPSCB" VAL_BLK 0x80027A6A ValA_Wu16 8192.00000000 DINH_LimDFCVerb 12079.0000000 20271.0000000 FORMAT "%13.7" NUMBER 5 /end CHARACTERISTIC
/begin CHARACTERISTIC DINH_Lim.DFC_EGRVlvLPSCG_CA "DINH/Zugeordnete Verriegelungslimits für Verriegelungsquelle DFC_EGRVlvLPSCG" VAL_BLK 0x80027A74 ValA_Wu16 8192.00000000 DINH_LimDFCVerb 12079.0000000 20271.0000000 FORMAT "%13.7" NUMBER 5 /end CHARACTERISTIC
/begin CHARACTERISTIC DINH_Lim.DFC_EGRVlvLPSRCMax_CA "DINH/Zugeordnete Verriegelungslimits für Verriegelungsquelle DFC_EGRVlvLPSRCMax" VAL_BLK 0x80027A7E ValA_Wu16 8192.00000000 DINH_LimDFCVerb 12079.0000000 20271.0000000 FORMAT "%13.7" NUMBER 6 /end CHARACTERISTIC
/begin CHARACTERISTIC DINH_Lim.DFC_EGRVlvLPSRCMin_CA "DINH/Zugeordnete Verriegelungslimits für Verriegelungsquelle DFC_EGRVlvLPSRCMin" VAL_BLK 0x80027A8A ValA_Wu16 8192.00000000 DINH_LimDFCVerb 12079.0000000 20271.0000000 FORMAT "%13.7" NUMBER 6 /end CHARACTERISTIC
/begin CHARACTERISTIC DINH_Lim.DFC_EGRVlvOL_CA "DINH/Zugeordnete Verriegelungslimits für Verriegelungsquelle DFC_EGRVlvOL" VAL_BLK 0x80027A96 ValA_Wu16 8192.00000000 DINH_LimDFCVerb 12079.0000000 20271.0000000 FORMAT "%13.7" NUMBER 10 /end CHARACTERISTIC
/begin CHARACTERISTIC DINH_Lim.DFC_EGRVlvSCB_CA "DINH/Zugeordnete Verriegelungslimits für Verriegelungsquelle DFC_EGRVlvSCB" VAL_BLK 0x80027AAA ValA_Wu16 8192.00000000 DINH_LimDFCVerb 12079.0000000 20271.0000000 FORMAT "%13.7" NUMBER 11 /end CHARACTERISTIC
/begin CHARACTERISTIC DINH_Lim.DFC_EGRVlvSCG_CA "DINH/Zugeordnete Verriegelungslimits für Verriegelungsquelle DFC_EGRVlvSCG" VAL_BLK 0x80027AC0 ValA_Wu16 8192.00000000 DINH_LimDFCVerb 12079.0000000 20271.0000000 FORMAT "%13.7" NUMBER 14 /end CHARACTERISTIC
/begin CHARACTERISTIC DINH_Lim.DFC_EGRVlvSRCMax_CA "DINH/Zugeordnete Verriegelungslimits für Verriegelungsquelle DFC_EGRVlvSRCMax" VAL_BLK 0x80027ADC ValA_Wu16 8192.00000000 DINH_LimDFCVerb 12079.0000000 20271.0000000 FORMAT "%13.7" NUMBER 6 /end CHARACTERISTIC
/begin CHARACTERISTIC DINH_Lim.DFC_EGRVlvSRCMin_CA "DINH/Zugeordnete Verriegelungslimits für Verriegelungsquelle DFC_EGRVlvSRCMin" VAL_BLK 0x80027AE8 ValA_Wu16 8192.00000000 DINH_LimDFCVerb 12079.0000000 20271.0000000 FORMAT "%13.7" NUMBER 6 /end CHARACTERISTIC
/begin CHARACTERISTIC DINH_Lim.DFC_EngPrtOvrSpd_CA "DINH/Zugeordnete Verriegelungslimits für Verriegelungsquelle DFC_EngPrtOvrSpd" VAL_BLK 0x80027AF4 ValA_Wu16 8192.00000000 DINH_LimDFCVerb 12079.0000000 20271.0000000 FORMAT "%13.7" NUMBER 2 /end CHARACTERISTIC
/begin CHARACTERISTIC DINH_Lim.DFC_EngSpdOL_CA "DINH/Zugeordnete Verriegelungslimits für Verriegelungsquelle DFC_EngSpdOL" VAL_BLK 0x80027AF8 ValA_Wu16 8192.00000000 DINH_LimDFCVerb 12079.0000000 20271.0000000 FORMAT "%13.7" NUMBER 2 /end CHARACTERISTIC
/begin CHARACTERISTIC DINH_Lim.DFC_EngSpdSCB_CA "DINH/Zugeordnete Verriegelungslimits für Verriegelungsquelle DFC_EngSpdSCB" VAL_BLK 0x80027AFC ValA_Wu16 8192.00000000 DINH_LimDFCVerb 12079.0000000 20271.0000000 FORMAT "%13.7" NUMBER 2 /end CHARACTERISTIC
/begin CHARACTERISTIC DINH_Lim.DFC_EngSpdSCG_CA "DINH/Zugeordnete Verriegelungslimits für Verriegelungsquelle DFC_EngSpdSCG" VAL_BLK 0x80027B00 ValA_Wu16 8192.00000000 DINH_LimDFCVerb 12079.0000000 20271.0000000 FORMAT "%13.7" NUMBER 2 /end CHARACTERISTIC
/begin CHARACTERISTIC DINH_Lim.DFC_EnhSRCMaxPPFltDiff_CA "DINH/Zugeordnete Verriegelungslimits für Verriegelungsquelle DFC_EnhSRCMaxPPFltDiff" VAL_BLK 0x80027B04 ValA_Wu16 8192.00000000 DINH_LimDFCVerb 12079.0000000 20271.0000000 FORMAT "%13.7" NUMBER 8 /end CHARACTERISTIC
/begin CHARACTERISTIC DINH_Lim.DFC_EnhSRCMaxT1ExhTMon_CA "DINH/Zugeordnete Verriegelungslimits für Verriegelungsquelle DFC_EnhSRCMaxT1ExhTMon" VAL_BLK 0x80027B14 ValA_Wu16 8192.00000000 DINH_LimDFCVerb 12079.0000000 20271.0000000 FORMAT "%13.7" NUMBER 10 /end CHARACTERISTIC
/begin CHARACTERISTIC DINH_Lim.DFC_EnhSRCMaxT2ExhTMon_CA "DINH/Zugeordnete Verriegelungslimits für Verriegelungsquelle DFC_EnhSRCMaxT2ExhTMon" VAL_BLK 0x80027B28 ValA_Wu16 8192.00000000 DINH_LimDFCVerb 12079.0000000 20271.0000000 FORMAT "%13.7" NUMBER 10 /end CHARACTERISTIC
/begin CHARACTERISTIC DINH_Lim.DFC_EnhSRCMaxT3ExhTMon_CA "DINH/Zugeordnete Verriegelungslimits für Verriegelungsquelle DFC_EnhSRCMaxT3ExhTMon" VAL_BLK 0x80027B3C ValA_Wu16 8192.00000000 DINH_LimDFCVerb 12079.0000000 20271.0000000 FORMAT "%13.7" NUMBER 2 /end CHARACTERISTIC
/begin CHARACTERISTIC DINH_Lim.DFC_EnhSRCMinPPFltDiff_CA "DINH/Zugeordnete Verriegelungslimits für Verriegelungsquelle DFC_EnhSRCMinPPFltDiff" VAL_BLK 0x80027B40 ValA_Wu16 8192.00000000 DINH_LimDFCVerb 12079.0000000 20271.0000000 FORMAT "%13.7" NUMBER 8 /end CHARACTERISTIC
/begin CHARACTERISTIC DINH_Lim.DFC_EnhSRCMinT1ExhTMon_CA "DINH/Zugeordnete Verriegelungslimits für Verriegelungsquelle DFC_EnhSRCMinT1ExhTMon" VAL_BLK 0x80027B50 ValA_Wu16 8192.00000000 DINH_LimDFCVerb 12079.0000000 20271.0000000 FORMAT "%13.7" NUMBER 10 /end CHARACTERISTIC
/begin CHARACTERISTIC DINH_Lim.DFC_EnhSRCMinT2ExhTMon_CA "DINH/Zugeordnete Verriegelungslimits für Verriegelungsquelle DFC_EnhSRCMinT2ExhTMon" VAL_BLK 0x80027B64 ValA_Wu16 8192.00000000 DINH_LimDFCVerb 12079.0000000 20271.0000000 FORMAT "%13.7" NUMBER 10 /end CHARACTERISTIC
/begin CHARACTERISTIC DINH_Lim.DFC_EnhSRCMinT3ExhTMon_CA "DINH/Zugeordnete Verriegelungslimits für Verriegelungsquelle DFC_EnhSRCMinT3ExhTMon" VAL_BLK 0x80027B78 ValA_Wu16 8192.00000000 DINH_LimDFCVerb 12079.0000000 20271.0000000 FORMAT "%13.7" NUMBER 2 /end CHARACTERISTIC
/begin CHARACTERISTIC DINH_Lim.DFC_EnvPSRCMax_CA "DINH/Zugeordnete Verriegelungslimits für Verriegelungsquelle DFC_EnvPSRCMax" VAL_BLK 0x80027B7C ValA_Wu16 8192.00000000 DINH_LimDFCVerb 12079.0000000 20271.0000000 FORMAT "%13.7" NUMBER 18 /end CHARACTERISTIC
/begin CHARACTERISTIC DINH_Lim.DFC_EnvPSRCMin_CA "DINH/Zugeordnete Verriegelungslimits für Verriegelungsquelle DFC_EnvPSRCMin" VAL_BLK 0x80027BA0 ValA_Wu16 8192.00000000 DINH_LimDFCVerb 12079.0000000 20271.0000000 FORMAT "%13.7" NUMBER 18 /end CHARACTERISTIC
/begin CHARACTERISTIC DINH_Lim.DFC_ExhTMonPlaus_CA "DINH/Zugeordnete Verriegelungslimits für Verriegelungsquelle DFC_ExhTMonPlaus" VAL_BLK 0x80027BC4 ValA_Wu16 8192.00000000 DINH_LimDFCVerb 12079.0000000 20271.0000000 FORMAT "%13.7" NUMBER 5 /end CHARACTERISTIC
/begin CHARACTERISTIC DINH_Lim.DFC_ExhTMonPlausPos1_CA "DINH/Zugeordnete Verriegelungslimits für Verriegelungsquelle DFC_ExhTMonPlausPos1" VAL_BLK 0x80027BCE ValA_Wu16 8192.00000000 DINH_LimDFCVerb 12079.0000000 20271.0000000 FORMAT "%13.7" NUMBER 5 /end CHARACTERISTIC
/begin CHARACTERISTIC DINH_Lim.DFC_ExhTMonPlausPos2_CA "DINH/Zugeordnete Verriegelungslimits für Verriegelungsquelle DFC_ExhTMonPlausPos2" VAL_BLK 0x80027BD8 ValA_Wu16 8192.00000000 DINH_LimDFCVerb 12079.0000000 20271.0000000 FORMAT "%13.7" NUMBER 5 /end CHARACTERISTIC
/begin CHARACTERISTIC DINH_Lim.DFC_ExhTMonPlausPos3_CA "DINH/Zugeordnete Verriegelungslimits für Verriegelungsquelle DFC_ExhTMonPlausPos3" VAL_BLK 0x80027BE2 ValA_Wu16 8192.00000000 DINH_LimDFCVerb 12079.0000000 20271.0000000 FORMAT "%13.7" NUMBER 2 /end CHARACTERISTIC
/begin CHARACTERISTIC DINH_Lim.DFC_ExhTMonT1Plaus_CA "DINH/Zugeordnete Verriegelungslimits für Verriegelungsquelle DFC_ExhTMonT1Plaus" VAL_BLK 0x80027BE6 ValA_Wu16 8192.00000000 DINH_LimDFCVerb 12079.0000000 20271.0000000 FORMAT "%13.7" NUMBER 5 /end CHARACTERISTIC
/begin CHARACTERISTIC DINH_Lim.DFC_ExhTMonT2Plaus_CA "DINH/Zugeordnete Verriegelungslimits für Verriegelungsquelle DFC_ExhTMonT2Plaus" VAL_BLK 0x80027BF0 ValA_Wu16 8192.00000000 DINH_LimDFCVerb 12079.0000000 20271.0000000 FORMAT "%13.7" NUMBER 5 /end CHARACTERISTIC
/begin CHARACTERISTIC DINH_Lim.DFC_ExhTMonT3Plaus_CA "DINH/Zugeordnete Verriegelungslimits für Verriegelungsquelle DFC_ExhTMonT3Plaus" VAL_BLK 0x80027BFA ValA_Wu16 8192.00000000 DINH_LimDFCVerb 12079.0000000 20271.0000000 FORMAT "%13.7" NUMBER 2 /end CHARACTERISTIC
/begin CHARACTERISTIC DINH_Lim.DFC_FlFltDsPSRCMax_CA "DINH/Zugeordnete Verriegelungslimits für Verriegelungsquelle DFC_FlFltDsPSRCMax" VAL_BLK 0x80027BFE ValA_Wu16 8192.00000000 DINH_LimDFCVerb 12079.0000000 20271.0000000 FORMAT "%13.7" NUMBER 4 /end CHARACTERISTIC
/begin CHARACTERISTIC DINH_Lim.DFC_FlFltDsPSRCMin_CA "DINH/Zugeordnete Verriegelungslimits für Verriegelungsquelle DFC_FlFltDsPSRCMin" VAL_BLK 0x80027C06 ValA_Wu16 8192.00000000 DINH_LimDFCVerb 12079.0000000 20271.0000000 FORMAT "%13.7" NUMBER 4 /end CHARACTERISTIC
/begin CHARACTERISTIC DINH_Lim.DFC_FlFltSig_CA "DINH/Zugeordnete Verriegelungslimits für Verriegelungsquelle DFC_FlFltSig" VAL_BLK 0x80027C0E ValA_Wu16 8192.00000000 DINH_LimDFCVerb 12079.0000000 20271.0000000 FORMAT "%13.7" NUMBER 2 /end CHARACTERISTIC
/begin CHARACTERISTIC DINH_Lim.DFC_FlFltUsPSRCMax_CA "DINH/Zugeordnete Verriegelungslimits für Verriegelungsquelle DFC_FlFltUsPSRCMax" VAL_BLK 0x80027C12 ValA_Wu16 8192.00000000 DINH_LimDFCVerb 12079.0000000 20271.0000000 FORMAT "%13.7" NUMBER 4 /end CHARACTERISTIC
/begin CHARACTERISTIC DINH_Lim.DFC_FlFltUsPSRCMin_CA "DINH/Zugeordnete Verriegelungslimits für Verriegelungsquelle DFC_FlFltUsPSRCMin" VAL_BLK 0x80027C1A ValA_Wu16 8192.00000000 DINH_LimDFCVerb 12079.0000000 20271.0000000 FORMAT "%13.7" NUMBER 4 /end CHARACTERISTIC
/begin CHARACTERISTIC DINH_Lim.DFC_FuelTSRCMax_CA "DINH/Zugeordnete Verriegelungslimits für Verriegelungsquelle DFC_FuelTSRCMax" VAL_BLK 0x80027C22 ValA_Wu16 8192.00000000 DINH_LimDFCVerb 12079.0000000 20271.0000000 FORMAT "%13.7" NUMBER 8 /end CHARACTERISTIC
/begin CHARACTERISTIC DINH_Lim.DFC_FuelTSRCMin_CA "DINH/Zugeordnete Verriegelungslimits für Verriegelungsquelle DFC_FuelTSRCMin" VAL_BLK 0x80027C32 ValA_Wu16 8192.00000000 DINH_LimDFCVerb 12079.0000000 20271.0000000 FORMAT "%13.7" NUMBER 8 /end CHARACTERISTIC
/begin CHARACTERISTIC DINH_Lim.DFC_GbxNPosPPerSRCMax_CA "DINH/Zugeordnete Verriegelungslimits für Verriegelungsquelle DFC_GbxNPosPPerSRCMax" VAL_BLK 0x80027C42 ValA_Wu16 8192.00000000 DINH_LimDFCVerb 12079.0000000 20271.0000000 FORMAT "%13.7" NUMBER 3 /end CHARACTERISTIC
/begin CHARACTERISTIC DINH_Lim.DFC_GbxNPosPPerSRCMin_CA "DINH/Zugeordnete Verriegelungslimits für Verriegelungsquelle DFC_GbxNPosPPerSRCMin" VAL_BLK 0x80027C48 ValA_Wu16 8192.00000000 DINH_LimDFCVerb 12079.0000000 20271.0000000 FORMAT "%13.7" NUMBER 3 /end CHARACTERISTIC
/begin CHARACTERISTIC DINH_Lim.DFC_GbxNPosPdcycSRCMax_CA "DINH/Zugeordnete Verriegelungslimits für Verriegelungsquelle DFC_GbxNPosPdcycSRCMax" VAL_BLK 0x80027C4E ValA_Wu16 8192.00000000 DINH_LimDFCVerb 12079.0000000 20271.0000000 FORMAT "%13.7" NUMBER 3 /end CHARACTERISTIC
/begin CHARACTERISTIC DINH_Lim.DFC_GbxNPosPdcycSRCMin_CA "DINH/Zugeordnete Verriegelungslimits für Verriegelungsquelle DFC_GbxNPosPdcycSRCMin" VAL_BLK 0x80027C54 ValA_Wu16 8192.00000000 DINH_LimDFCVerb 12079.0000000 20271.0000000 FORMAT "%13.7" NUMBER 3 /end CHARACTERISTIC
/begin CHARACTERISTIC DINH_Lim.DFC_InjVlvPresMin_CA "DINH/Zugeordnete Verriegelungslimits für Verriegelungsquelle DFC_InjVlvPresMin" VAL_BLK 0x80027C5A ValA_Wu16 8192.00000000 DINH_LimDFCVerb 12079.0000000 20271.0000000 FORMAT "%13.7" NUMBER 2 /end CHARACTERISTIC
/begin CHARACTERISTIC DINH_Lim.DFC_LSUCircNernstSig_CA "DINH/Zugeordnete Verriegelungslimits für Verriegelungsquelle DFC_LSUCircNernstSig" VAL_BLK 0x80027C5E ValA_Wu16 8192.00000000 DINH_LimDFCVerb 12079.0000000 20271.0000000 FORMAT "%13.7" NUMBER 18 /end CHARACTERISTIC
/begin CHARACTERISTIC DINH_Lim.DFC_LSUCircPmpCurSig_CA "DINH/Zugeordnete Verriegelungslimits für Verriegelungsquelle DFC_LSUCircPmpCurSig" VAL_BLK 0x80027C82 ValA_Wu16 8192.00000000 DINH_LimDFCVerb 12079.0000000 20271.0000000 FORMAT "%13.7" NUMBER 14 /end CHARACTERISTIC
/begin CHARACTERISTIC DINH_Lim.DFC_LSUCircVirtGndSig_CA "DINH/Zugeordnete Verriegelungslimits für Verriegelungsquelle DFC_LSUCircVirtGndSig" VAL_BLK 0x80027C9E ValA_Wu16 8192.00000000 DINH_LimDFCVerb 12079.0000000 20271.0000000 FORMAT "%13.7" NUMBER 18 /end CHARACTERISTIC
/begin CHARACTERISTIC DINH_Lim.DFC_LSUO2Max_CA "DINH/Zugeordnete Verriegelungslimits für Verriegelungsquelle DFC_LSUO2Max" VAL_BLK 0x80027CC2 ValA_Wu16 8192.00000000 DINH_LimDFCVerb 12079.0000000 20271.0000000 FORMAT "%13.7" NUMBER 13 /end CHARACTERISTIC
/begin CHARACTERISTIC DINH_Lim.DFC_LSUO2Min_CA "DINH/Zugeordnete Verriegelungslimits für Verriegelungsquelle DFC_LSUO2Min" VAL_BLK 0x80027CDC ValA_Wu16 8192.00000000 DINH_LimDFCVerb 12079.0000000 20271.0000000 FORMAT "%13.7" NUMBER 13 /end CHARACTERISTIC
/begin CHARACTERISTIC DINH_Lim.DFC_LSUSPIBattLowMin_CA "DINH/Zugeordnete Verriegelungslimits für Verriegelungsquelle DFC_LSUSPIBattLowMin" VAL_BLK 0x80027CF6 ValA_Wu16 8192.00000000 DINH_LimDFCVerb 12079.0000000 20271.0000000 FORMAT "%13.7" NUMBER 19 /end CHARACTERISTIC
/begin CHARACTERISTIC DINH_Lim.DFC_LSUWireSCB_CA "DINH/Zugeordnete Verriegelungslimits für Verriegelungsquelle DFC_LSUWireSCB" VAL_BLK 0x80027D1C ValA_Wu16 8192.00000000 DINH_LimDFCVerb 12079.0000000 20271.0000000 FORMAT "%13.7" NUMBER 18 /end CHARACTERISTIC
/begin CHARACTERISTIC DINH_Lim.DFC_LSUWireSCG_CA "DINH/Zugeordnete Verriegelungslimits für Verriegelungsquelle DFC_LSUWireSCG" VAL_BLK 0x80027D40 ValA_Wu16 8192.00000000 DINH_LimDFCVerb 12079.0000000 20271.0000000 FORMAT "%13.7" NUMBER 18 /end CHARACTERISTIC
/begin CHARACTERISTIC DINH_Lim.DFC_MeUnSCG_CA "DINH/Zugeordnete Verriegelungslimits für Verriegelungsquelle DFC_MeUnSCG" VAL_BLK 0x80027D64 ValA_Wu16 8192.00000000 DINH_LimDFCVerb 12079.0000000 20271.0000000 FORMAT "%13.7" NUMBER 10 /end CHARACTERISTIC
/begin CHARACTERISTIC DINH_Lim.DFC_NSCDsCmpChk_CA "DINH/Zugeordnete Verriegelungslimits für Verriegelungsquelle DFC_NSCDsCmpChk" VAL_BLK 0x80027D78 ValA_Wu16 8192.00000000 DINH_LimDFCVerb 12079.0000000 20271.0000000 FORMAT "%13.7" NUMBER 2 /end CHARACTERISTIC
/begin CHARACTERISTIC DINH_Lim.DFC_NSCDsLamBinSRCMax_CA "DINH/Zugeordnete Verriegelungslimits für Verriegelungsquelle DFC_NSCDsLamBinSRCMax" VAL_BLK 0x80027D7C ValA_Wu16 8192.00000000 DINH_LimDFCVerb 12079.0000000 20271.0000000 FORMAT "%13.7" NUMBER 2 /end CHARACTERISTIC
/begin CHARACTERISTIC DINH_Lim.DFC_NSCDsLamBinSRCMin_CA "DINH/Zugeordnete Verriegelungslimits für Verriegelungsquelle DFC_NSCDsLamBinSRCMin" VAL_BLK 0x80027D80 ValA_Wu16 8192.00000000 DINH_LimDFCVerb 12079.0000000 20271.0000000 FORMAT "%13.7" NUMBER 2 /end CHARACTERISTIC
/begin CHARACTERISTIC DINH_Lim.DFC_NSCDsLamLinSRCMax_CA "DINH/Zugeordnete Verriegelungslimits für Verriegelungsquelle DFC_NSCDsLamLinSRCMax" VAL_BLK 0x80027D84 ValA_Wu16 8192.00000000 DINH_LimDFCVerb 12079.0000000 20271.0000000 FORMAT "%13.7" NUMBER 2 /end CHARACTERISTIC
/begin CHARACTERISTIC DINH_Lim.DFC_NSCDsLamLinSRCMin_CA "DINH/Zugeordnete Verriegelungslimits für Verriegelungsquelle DFC_NSCDsLamLinSRCMin" VAL_BLK 0x80027D88 ValA_Wu16 8192.00000000 DINH_LimDFCVerb 12079.0000000 20271.0000000 FORMAT "%13.7" NUMBER 2 /end CHARACTERISTIC
/begin CHARACTERISTIC DINH_Lim.DFC_NSCDsLamPlausMax_CA "DINH/Zugeordnete Verriegelungslimits für Verriegelungsquelle DFC_NSCDsLamPlausMax" VAL_BLK 0x80027D8C ValA_Wu16 8192.00000000 DINH_LimDFCVerb 12079.0000000 20271.0000000 FORMAT "%13.7" NUMBER 2 /end CHARACTERISTIC
/begin CHARACTERISTIC DINH_Lim.DFC_NSCDsLamPlausMin_CA "DINH/Zugeordnete Verriegelungslimits für Verriegelungsquelle DFC_NSCDsLamPlausMin" VAL_BLK 0x80027D90 ValA_Wu16 8192.00000000 DINH_LimDFCVerb 12079.0000000 20271.0000000 FORMAT "%13.7" NUMBER 2 /end CHARACTERISTIC
/begin CHARACTERISTIC DINH_Lim.DFC_NSCDsNOxSRCMax_CA "DINH/Zugeordnete Verriegelungslimits für Verriegelungsquelle DFC_NSCDsNOxSRCMax" VAL_BLK 0x80027D94 ValA_Wu16 8192.00000000 DINH_LimDFCVerb 12079.0000000 20271.0000000 FORMAT "%13.7" NUMBER 2 /end CHARACTERISTIC
/begin CHARACTERISTIC DINH_Lim.DFC_NSCDsNOxSRCMin_CA "DINH/Zugeordnete Verriegelungslimits für Verriegelungsquelle DFC_NSCDsNOxSRCMin" VAL_BLK 0x80027D98 ValA_Wu16 8192.00000000 DINH_LimDFCVerb 12079.0000000 20271.0000000 FORMAT "%13.7" NUMBER 2 /end CHARACTERISTIC
/begin CHARACTERISTIC DINH_Lim.DFC_NSCDsOpCir_CA "DINH/Zugeordnete Verriegelungslimits für Verriegelungsquelle DFC_NSCDsOpCir" VAL_BLK 0x80027D9C ValA_Wu16 8192.00000000 DINH_LimDFCVerb 12079.0000000 20271.0000000 FORMAT "%13.7" NUMBER 6 /end CHARACTERISTIC
/begin CHARACTERISTIC DINH_Lim.DFC_NSCDsShCir_CA "DINH/Zugeordnete Verriegelungslimits für Verriegelungsquelle DFC_NSCDsShCir" VAL_BLK 0x80027DA8 ValA_Wu16 8192.00000000 DINH_LimDFCVerb 12079.0000000 20271.0000000 FORMAT "%13.7" NUMBER 6 /end CHARACTERISTIC
/begin CHARACTERISTIC DINH_Lim.DFC_NoCat2DsCmpChk_CA "DINH/Zugeordnete Verriegelungslimits für Verriegelungsquelle DFC_NoCat2DsCmpChk" VAL_BLK 0x80027DB4 ValA_Wu16 8192.00000000 DINH_LimDFCVerb 12079.0000000 20271.0000000 FORMAT "%13.7" NUMBER 2 /end CHARACTERISTIC
/begin CHARACTERISTIC DINH_Lim.DFC_NoCat2DsLamBinSRCMax_CA "DINH/Zugeordnete Verriegelungslimits für Verriegelungsquelle DFC_NoCat2DsLamBinSRCMax" VAL_BLK 0x80027DB8 ValA_Wu16 8192.00000000 DINH_LimDFCVerb 12079.0000000 20271.0000000 FORMAT "%13.7" NUMBER 2 /end CHARACTERISTIC
/begin CHARACTERISTIC DINH_Lim.DFC_NoCat2DsLamBinSRCMin_CA "DINH/Zugeordnete Verriegelungslimits für Verriegelungsquelle DFC_NoCat2DsLamBinSRCMin" VAL_BLK 0x80027DBC ValA_Wu16 8192.00000000 DINH_LimDFCVerb 12079.0000000 20271.0000000 FORMAT "%13.7" NUMBER 2 /end CHARACTERISTIC
/begin CHARACTERISTIC DINH_Lim.DFC_NoCat2DsLamLinSRCMax_CA "DINH/Zugeordnete Verriegelungslimits für Verriegelungsquelle DFC_NoCat2DsLamLinSRCMax" VAL_BLK 0x80027DC0 ValA_Wu16 8192.00000000 DINH_LimDFCVerb 12079.0000000 20271.0000000 FORMAT "%13.7" NUMBER 2 /end CHARACTERISTIC
/begin CHARACTERISTIC DINH_Lim.DFC_NoCat2DsLamLinSRCMin_CA "DINH/Zugeordnete Verriegelungslimits für Verriegelungsquelle DFC_NoCat2DsLamLinSRCMin" VAL_BLK 0x80027DC4 ValA_Wu16 8192.00000000 DINH_LimDFCVerb 12079.0000000 20271.0000000 FORMAT "%13.7" NUMBER 2 /end CHARACTERISTIC
/begin CHARACTERISTIC DINH_Lim.DFC_NoCat2DsLamPlausMax_CA "DINH/Zugeordnete Verriegelungslimits für Verriegelungsquelle DFC_NoCat2DsLamPlausMax" VAL_BLK 0x80027DC8 ValA_Wu16 8192.00000000 DINH_LimDFCVerb 12079.0000000 20271.0000000 FORMAT "%13.7" NUMBER 2 /end CHARACTERISTIC
/begin CHARACTERISTIC DINH_Lim.DFC_NoCat2DsLamPlausMin_CA "DINH/Zugeordnete Verriegelungslimits für Verriegelungsquelle DFC_NoCat2DsLamPlausMin" VAL_BLK 0x80027DCC ValA_Wu16 8192.00000000 DINH_LimDFCVerb 12079.0000000 20271.0000000 FORMAT "%13.7" NUMBER 2 /end CHARACTERISTIC
/begin CHARACTERISTIC DINH_Lim.DFC_NoCat2DsNOxSRCMax_CA "DINH/Zugeordnete Verriegelungslimits für Verriegelungsquelle DFC_NoCat2DsNOxSRCMax" VAL_BLK 0x80027DD0 ValA_Wu16 8192.00000000 DINH_LimDFCVerb 12079.0000000 20271.0000000 FORMAT "%13.7" NUMBER 2 /end CHARACTERISTIC
/begin CHARACTERISTIC DINH_Lim.DFC_NoCat2DsNOxSRCMin_CA "DINH/Zugeordnete Verriegelungslimits für Verriegelungsquelle DFC_NoCat2DsNOxSRCMin" VAL_BLK 0x80027DD4 ValA_Wu16 8192.00000000 DINH_LimDFCVerb 12079.0000000 20271.0000000 FORMAT "%13.7" NUMBER 2 /end CHARACTERISTIC
/begin CHARACTERISTIC DINH_Lim.DFC_NoCat2DsOpCir_CA "DINH/Zugeordnete Verriegelungslimits für Verriegelungsquelle DFC_NoCat2DsOpCir" VAL_BLK 0x80027DD8 ValA_Wu16 8192.00000000 DINH_LimDFCVerb 12079.0000000 20271.0000000 FORMAT "%13.7" NUMBER 6 /end CHARACTERISTIC
/begin CHARACTERISTIC DINH_Lim.DFC_NoCat2DsShCir_CA "DINH/Zugeordnete Verriegelungslimits für Verriegelungsquelle DFC_NoCat2DsShCir" VAL_BLK 0x80027DE4 ValA_Wu16 8192.00000000 DINH_LimDFCVerb 12079.0000000 20271.0000000 FORMAT "%13.7" NUMBER 6 /end CHARACTERISTIC
/begin CHARACTERISTIC DINH_Lim.DFC_NplDynPPFltDiff_CA "DINH/Zugeordnete Verriegelungslimits für Verriegelungsquelle DFC_NplDynPPFltDiff" VAL_BLK 0x80027DF0 ValA_Wu16 8192.00000000 DINH_LimDFCVerb 12079.0000000 20271.0000000 FORMAT "%13.7" NUMBER 9 /end CHARACTERISTIC
/begin CHARACTERISTIC DINH_Lim.DFC_NplHsChngPPFltDiff_CA "DINH/Zugeordnete Verriegelungslimits für Verriegelungsquelle DFC_NplHsChngPPFltDiff" VAL_BLK 0x80027E02 ValA_Wu16 8192.00000000 DINH_LimDFCVerb 12079.0000000 20271.0000000 FORMAT "%13.7" NUMBER 7 /end CHARACTERISTIC
/begin CHARACTERISTIC DINH_Lim.DFC_NplHsLnPPFltDiff_CA "DINH/Zugeordnete Verriegelungslimits für Verriegelungsquelle DFC_NplHsLnPPFltDiff" VAL_BLK 0x80027E10 ValA_Wu16 8192.00000000 DINH_LimDFCVerb 12079.0000000 20271.0000000 FORMAT "%13.7" NUMBER 12 /end CHARACTERISTIC
/begin CHARACTERISTIC DINH_Lim.DFC_NplTOxiCatUs_CA "DINH/Zugeordnete Verriegelungslimits für Verriegelungsquelle DFC_NplTOxiCatUs" VAL_BLK 0x80027E28 ValA_Wu16 8192.00000000 DINH_LimDFCVerb 12079.0000000 20271.0000000 FORMAT "%13.7" NUMBER 10 /end CHARACTERISTIC
/begin CHARACTERISTIC DINH_Lim.DFC_NplTPFltUs_CA "DINH/Zugeordnete Verriegelungslimits für Verriegelungsquelle DFC_NplTPFltUs" VAL_BLK 0x80027E3C ValA_Wu16 8192.00000000 DINH_LimDFCVerb 12079.0000000 20271.0000000 FORMAT "%13.7" NUMBER 9 /end CHARACTERISTIC
/begin CHARACTERISTIC DINH_Lim.DFC_NplTTrbnUs_CA "DINH/Zugeordnete Verriegelungslimits für Verriegelungsquelle DFC_NplTTrbnUs" VAL_BLK 0x80027E4E ValA_Wu16 8192.00000000 DINH_LimDFCVerb 12079.0000000 20271.0000000 FORMAT "%13.7" NUMBER 4 /end CHARACTERISTIC
/begin CHARACTERISTIC DINH_Lim.DFC_OilPSwmpSRCMax_CA "DINH/Zugeordnete Verriegelungslimits für Verriegelungsquelle DFC_OilPSwmpSRCMax" VAL_BLK 0x80027E56 ValA_Wu16 8192.00000000 DINH_LimDFCVerb 12079.0000000 20271.0000000 FORMAT "%13.7" NUMBER 3 /end CHARACTERISTIC
/begin CHARACTERISTIC DINH_Lim.DFC_OilPSwmpSRCMin_CA "DINH/Zugeordnete Verriegelungslimits für Verriegelungsquelle DFC_OilPSwmpSRCMin" VAL_BLK 0x80027E5C ValA_Wu16 8192.00000000 DINH_LimDFCVerb 12079.0000000 20271.0000000 FORMAT "%13.7" NUMBER 3 /end CHARACTERISTIC
/begin CHARACTERISTIC DINH_Lim.DFC_PCVSCG_CA "DINH/Zugeordnete Verriegelungslimits für Verriegelungsquelle DFC_PCVSCG" VAL_BLK 0x80027E62 ValA_Wu16 8192.00000000 DINH_LimDFCVerb 12079.0000000 20271.0000000 FORMAT "%13.7" NUMBER 9 /end CHARACTERISTIC
/begin CHARACTERISTIC DINH_Lim.DFC_PFltCharPDiffMin_CA "DINH/Zugeordnete Verriegelungslimits für Verriegelungsquelle DFC_PFltCharPDiffMin" VAL_BLK 0x80027E74 ValA_Wu16 8192.00000000 DINH_LimDFCVerb 12079.0000000 20271.0000000 FORMAT "%13.7" NUMBER 7 /end CHARACTERISTIC
/begin CHARACTERISTIC DINH_Lim.DFC_PFltDstrMin_CA "DINH/Zugeordnete Verriegelungslimits für Verriegelungsquelle DFC_PFltDstrMin" VAL_BLK 0x80027E82 ValA_Wu16 8192.00000000 DINH_LimDFCVerb 12079.0000000 20271.0000000 FORMAT "%13.7" NUMBER 7 /end CHARACTERISTIC
/begin CHARACTERISTIC DINH_Lim.DFC_PFltEngPrt_CA "DINH/Zugeordnete Verriegelungslimits für Verriegelungsquelle DFC_PFltEngPrt" VAL_BLK 0x80027E90 ValA_Wu16 8192.00000000 DINH_LimDFCVerb 12079.0000000 20271.0000000 FORMAT "%13.7" NUMBER 7 /end CHARACTERISTIC
/begin CHARACTERISTIC DINH_Lim.DFC_PFltRgnPerm_CA "DINH/Zugeordnete Verriegelungslimits für Verriegelungsquelle DFC_PFltRgnPerm" VAL_BLK 0x80027E9E ValA_Wu16 8192.00000000 DINH_LimDFCVerb 12079.0000000 20271.0000000 FORMAT "%13.7" NUMBER 7 /end CHARACTERISTIC
/begin CHARACTERISTIC DINH_Lim.DFC_PFltSRCMaxFlwRstn_CA "DINH/Zugeordnete Verriegelungslimits für Verriegelungsquelle DFC_PFltSRCMaxFlwRstn" VAL_BLK 0x80027EAC ValA_Wu16 8192.00000000 DINH_LimDFCVerb 12079.0000000 20271.0000000 FORMAT "%13.7" NUMBER 8 /end CHARACTERISTIC
/begin CHARACTERISTIC DINH_Lim.DFC_PFltSRCMinFlwRstn_CA "DINH/Zugeordnete Verriegelungslimits für Verriegelungsquelle DFC_PFltSRCMinFlwRstn" VAL_BLK 0x80027EBC ValA_Wu16 8192.00000000 DINH_LimDFCVerb 12079.0000000 20271.0000000 FORMAT "%13.7" NUMBER 8 /end CHARACTERISTIC
/begin CHARACTERISTIC DINH_Lim.DFC_PFltSotMsDvtMax_CA "DINH/Zugeordnete Verriegelungslimits für Verriegelungsquelle DFC_PFltSotMsDvtMax" VAL_BLK 0x80027ECC ValA_Wu16 8192.00000000 DINH_LimDFCVerb 12079.0000000 20271.0000000 FORMAT "%13.7" NUMBER 7 /end CHARACTERISTIC
/begin CHARACTERISTIC DINH_Lim.DFC_PFltSotMsDvtMin_CA "DINH/Zugeordnete Verriegelungslimits für Verriegelungsquelle DFC_PFltSotMsDvtMin" VAL_BLK 0x80027EDA ValA_Wu16 8192.00000000 DINH_LimDFCVerb 12079.0000000 20271.0000000 FORMAT "%13.7" NUMBER 7 /end CHARACTERISTIC
/begin CHARACTERISTIC DINH_Lim.DFC_PFltSotMsMax_CA "DINH/Zugeordnete Verriegelungslimits für Verriegelungsquelle DFC_PFltSotMsMax" VAL_BLK 0x80027EE8 ValA_Wu16 8192.00000000 DINH_LimDFCVerb 12079.0000000 20271.0000000 FORMAT "%13.7" NUMBER 7 /end CHARACTERISTIC
/begin CHARACTERISTIC DINH_Lim.DFC_PIntkVUsSRCMax_CA "DINH/Zugeordnete Verriegelungslimits für Verriegelungsquelle DFC_PIntkVUsSRCMax" VAL_BLK 0x80027EF6 ValA_Wu16 8192.00000000 DINH_LimDFCVerb 12079.0000000 20271.0000000 FORMAT "%13.7" NUMBER 4 /end CHARACTERISTIC
/begin CHARACTERISTIC DINH_Lim.DFC_PIntkVUsSRCMin_CA "DINH/Zugeordnete Verriegelungslimits für Verriegelungsquelle DFC_PIntkVUsSRCMin" VAL_BLK 0x80027EFE ValA_Wu16 8192.00000000 DINH_LimDFCVerb 12079.0000000 20271.0000000 FORMAT "%13.7" NUMBER 4 /end CHARACTERISTIC
/begin CHARACTERISTIC DINH_Lim.DFC_SRCHighAPP1_CA "DINH/Zugeordnete Verriegelungslimits für Verriegelungsquelle DFC_SRCHighAPP1" VAL_BLK 0x80027F06 ValA_Wu16 8192.00000000 DINH_LimDFCVerb 12079.0000000 20271.0000000 FORMAT "%13.7" NUMBER 8 /end CHARACTERISTIC
/begin CHARACTERISTIC DINH_Lim.DFC_SRCHighAPP2_CA "DINH/Zugeordnete Verriegelungslimits für Verriegelungsquelle DFC_SRCHighAPP2" VAL_BLK 0x80027F16 ValA_Wu16 8192.00000000 DINH_LimDFCVerb 12079.0000000 20271.0000000 FORMAT "%13.7" NUMBER 8 /end CHARACTERISTIC
/begin CHARACTERISTIC DINH_Lim.DFC_SRCLowAPP1_CA "DINH/Zugeordnete Verriegelungslimits für Verriegelungsquelle DFC_SRCLowAPP1" VAL_BLK 0x80027F26 ValA_Wu16 8192.00000000 DINH_LimDFCVerb 12079.0000000 20271.0000000 FORMAT "%13.7" NUMBER 7 /end CHARACTERISTIC
/begin CHARACTERISTIC DINH_Lim.DFC_SRCLowAPP2_CA "DINH/Zugeordnete Verriegelungslimits für Verriegelungsquelle DFC_SRCLowAPP2" VAL_BLK 0x80027F34 ValA_Wu16 8192.00000000 DINH_LimDFCVerb 12079.0000000 20271.0000000 FORMAT "%13.7" NUMBER 7 /end CHARACTERISTIC
/begin CHARACTERISTIC DINH_Lim.DFC_SRCMaxPPFltDiff_CA "DINH/Zugeordnete Verriegelungslimits für Verriegelungsquelle DFC_SRCMaxPPFltDiff" VAL_BLK 0x80027F42 ValA_Wu16 8192.00000000 DINH_LimDFCVerb 12079.0000000 20271.0000000 FORMAT "%13.7" NUMBER 14 /end CHARACTERISTIC
/begin CHARACTERISTIC DINH_Lim.DFC_SRCMaxPPFltUs_CA "DINH/Zugeordnete Verriegelungslimits für Verriegelungsquelle DFC_SRCMaxPPFltUs" VAL_BLK 0x80027F5E ValA_Wu16 8192.00000000 DINH_LimDFCVerb 12079.0000000 20271.0000000 FORMAT "%13.7" NUMBER 14 /end CHARACTERISTIC
/begin CHARACTERISTIC DINH_Lim.DFC_SRCMaxTECU_CA "DINH/Zugeordnete Verriegelungslimits für Verriegelungsquelle DFC_SRCMaxTECU" VAL_BLK 0x80027F7A ValA_Wu16 8192.00000000 DINH_LimDFCVerb 12079.0000000 20271.0000000 FORMAT "%13.7" NUMBER 9 /end CHARACTERISTIC
/begin CHARACTERISTIC DINH_Lim.DFC_SRCMaxTOxiCatUs_CA "DINH/Zugeordnete Verriegelungslimits für Verriegelungsquelle DFC_SRCMaxTOxiCatUs" VAL_BLK 0x80027F8C ValA_Wu16 8192.00000000 DINH_LimDFCVerb 12079.0000000 20271.0000000 FORMAT "%13.7" NUMBER 12 /end CHARACTERISTIC
/begin CHARACTERISTIC DINH_Lim.DFC_SRCMaxTPFltUs_CA "DINH/Zugeordnete Verriegelungslimits für Verriegelungsquelle DFC_SRCMaxTPFltUs" VAL_BLK 0x80027FA4 ValA_Wu16 8192.00000000 DINH_LimDFCVerb 12079.0000000 20271.0000000 FORMAT "%13.7" NUMBER 18 /end CHARACTERISTIC
/begin CHARACTERISTIC DINH_Lim.DFC_SRCMaxTTrbnUs_CA "DINH/Zugeordnete Verriegelungslimits für Verriegelungsquelle DFC_SRCMaxTTrbnUs" VAL_BLK 0x80027FC8 ValA_Wu16 8192.00000000 DINH_LimDFCVerb 12079.0000000 20271.0000000 FORMAT "%13.7" NUMBER 6 /end CHARACTERISTIC
/begin CHARACTERISTIC DINH_Lim.DFC_SRCMaxUCatUsT_CA "DINH/Zugeordnete Verriegelungslimits für Verriegelungsquelle DFC_SRCMaxUCatUsT" VAL_BLK 0x80027FD4 ValA_Wu16 8192.00000000 DINH_LimDFCVerb 12079.0000000 20271.0000000 FORMAT "%13.7" NUMBER 5 /end CHARACTERISTIC
/begin CHARACTERISTIC DINH_Lim.DFC_SRCMaxUPmpP_CA "DINH/Zugeordnete Verriegelungslimits für Verriegelungsquelle DFC_SRCMaxUPmpP" VAL_BLK 0x80027FDE ValA_Wu16 8192.00000000 DINH_LimDFCVerb 12079.0000000 20271.0000000 FORMAT "%13.7" NUMBER 4 /end CHARACTERISTIC
/begin CHARACTERISTIC DINH_Lim.DFC_SRCMinPPFltDiff_CA "DINH/Zugeordnete Verriegelungslimits für Verriegelungsquelle DFC_SRCMinPPFltDiff" VAL_BLK 0x80027FE6 ValA_Wu16 8192.00000000 DINH_LimDFCVerb 12079.0000000 20271.0000000 FORMAT "%13.7" NUMBER 14 /end CHARACTERISTIC
/begin CHARACTERISTIC DINH_Lim.DFC_SRCMinPPFltUs_CA "DINH/Zugeordnete Verriegelungslimits für Verriegelungsquelle DFC_SRCMinPPFltUs" VAL_BLK 0x80028002 ValA_Wu16 8192.00000000 DINH_LimDFCVerb 12079.0000000 20271.0000000 FORMAT "%13.7" NUMBER 13 /end CHARACTERISTIC
/begin CHARACTERISTIC DINH_Lim.DFC_SRCMinTECU_CA "DINH/Zugeordnete Verriegelungslimits für Verriegelungsquelle DFC_SRCMinTECU" VAL_BLK 0x8002801C ValA_Wu16 8192.00000000 DINH_LimDFCVerb 12079.0000000 20271.0000000 FORMAT "%13.7" NUMBER 9 /end CHARACTERISTIC
/begin CHARACTERISTIC DINH_Lim.DFC_SRCMinTOxiCatUs_CA "DINH/Zugeordnete Verriegelungslimits für Verriegelungsquelle DFC_SRCMinTOxiCatUs" VAL_BLK 0x8002802E ValA_Wu16 8192.00000000 DINH_LimDFCVerb 12079.0000000 20271.0000000 FORMAT "%13.7" NUMBER 12 /end CHARACTERISTIC
/begin CHARACTERISTIC DINH_Lim.DFC_SRCMinTPFltUs_CA "DINH/Zugeordnete Verriegelungslimits für Verriegelungsquelle DFC_SRCMinTPFltUs" VAL_BLK 0x80028046 ValA_Wu16 8192.00000000 DINH_LimDFCVerb 12079.0000000 20271.0000000 FORMAT "%13.7" NUMBER 19 /end CHARACTERISTIC
/begin CHARACTERISTIC DINH_Lim.DFC_SRCMinTTrbnUs_CA "DINH/Zugeordnete Verriegelungslimits für Verriegelungsquelle DFC_SRCMinTTrbnUs" VAL_BLK 0x8002806C ValA_Wu16 8192.00000000 DINH_LimDFCVerb 12079.0000000 20271.0000000 FORMAT "%13.7" NUMBER 6 /end CHARACTERISTIC
/begin CHARACTERISTIC DINH_Lim.DFC_SRCMinUCatUsT_CA "DINH/Zugeordnete Verriegelungslimits für Verriegelungsquelle DFC_SRCMinUCatUsT" VAL_BLK 0x80028078 ValA_Wu16 8192.00000000 DINH_LimDFCVerb 12079.0000000 20271.0000000 FORMAT "%13.7" NUMBER 5 /end CHARACTERISTIC
/begin CHARACTERISTIC DINH_Lim.DFC_SRCMinUPmpP_CA "DINH/Zugeordnete Verriegelungslimits für Verriegelungsquelle DFC_SRCMinUPmpP" VAL_BLK 0x80028082 ValA_Wu16 8192.00000000 DINH_LimDFCVerb 12079.0000000 20271.0000000 FORMAT "%13.7" NUMBER 4 /end CHARACTERISTIC
/begin CHARACTERISTIC DINH_Lim.DFC_SigUCatUsT_CA "DINH/Zugeordnete Verriegelungslimits für Verriegelungsquelle DFC_SigUCatUsT" VAL_BLK 0x8002808A ValA_Wu16 8192.00000000 DINH_LimDFCVerb 12079.0000000 20271.0000000 FORMAT "%13.7" NUMBER 5 /end CHARACTERISTIC
/begin CHARACTERISTIC DINH_Lim.DFC_SigUPmpP_CA "DINH/Zugeordnete Verriegelungslimits für Verriegelungsquelle DFC_SigUPmpP" VAL_BLK 0x80028094 ValA_Wu16 8192.00000000 DINH_LimDFCVerb 12079.0000000 20271.0000000 FORMAT "%13.7" NUMBER 4 /end CHARACTERISTIC
/begin CHARACTERISTIC DINH_Lim.DFC_SyncAPP_CA "DINH/Zugeordnete Verriegelungslimits für Verriegelungsquelle DFC_SyncAPP" VAL_BLK 0x8002809C ValA_Wu16 8192.00000000 DINH_LimDFCVerb 12079.0000000 20271.0000000 FORMAT "%13.7" NUMBER 7 /end CHARACTERISTIC
/begin CHARACTERISTIC DINH_Lim.DFC_T15Npl_CA "DINH/Zugeordnete Verriegelungslimits für Verriegelungsquelle DFC_T15Npl" VAL_BLK 0x800280AA ValA_Wu16 8192.00000000 DINH_LimDFCVerb 12079.0000000 20271.0000000 FORMAT "%13.7" NUMBER 2 /end CHARACTERISTIC
/begin CHARACTERISTIC DINH_Lim.DFC_TAFSDtyCycHi_CA "DINH/Zugeordnete Verriegelungslimits für Verriegelungsquelle DFC_TAFSDtyCycHi" VAL_BLK 0x800280AE ValA_Wu16 8192.00000000 DINH_LimDFCVerb 12079.0000000 20271.0000000 FORMAT "%13.7" NUMBER 5 /end CHARACTERISTIC
/begin CHARACTERISTIC DINH_Lim.DFC_TAFSDtyCycLo_CA "DINH/Zugeordnete Verriegelungslimits für Verriegelungsquelle DFC_TAFSDtyCycLo" VAL_BLK 0x800280B8 ValA_Wu16 8192.00000000 DINH_LimDFCVerb 12079.0000000 20271.0000000 FORMAT "%13.7" NUMBER 5 /end CHARACTERISTIC
/begin CHARACTERISTIC DINH_Lim.DFC_TAFSPerHi_CA "DINH/Zugeordnete Verriegelungslimits für Verriegelungsquelle DFC_TAFSPerHi" VAL_BLK 0x800280C2 ValA_Wu16 8192.00000000 DINH_LimDFCVerb 12079.0000000 20271.0000000 FORMAT "%13.7" NUMBER 5 /end CHARACTERISTIC
/begin CHARACTERISTIC DINH_Lim.DFC_TAFSPerLo_CA "DINH/Zugeordnete Verriegelungslimits für Verriegelungsquelle DFC_TAFSPerLo" VAL_BLK 0x800280CC ValA_Wu16 8192.00000000 DINH_LimDFCVerb 12079.0000000 20271.0000000 FORMAT "%13.7" NUMBER 5 /end CHARACTERISTIC
/begin CHARACTERISTIC DINH_Lim.DFC_TCACDsSRCMax_CA "DINH/Zugeordnete Verriegelungslimits für Verriegelungsquelle DFC_TCACDsSRCMax" VAL_BLK 0x800280D6 ValA_Wu16 8192.00000000 DINH_LimDFCVerb 12079.0000000 20271.0000000 FORMAT "%13.7" NUMBER 11 /end CHARACTERISTIC
/begin CHARACTERISTIC DINH_Lim.DFC_TCACDsSRCMin_CA "DINH/Zugeordnete Verriegelungslimits für Verriegelungsquelle DFC_TCACDsSRCMin" VAL_BLK 0x800280EC ValA_Wu16 8192.00000000 DINH_LimDFCVerb 12079.0000000 20271.0000000 FORMAT "%13.7" NUMBER 11 /end CHARACTERISTIC
/begin CHARACTERISTIC DINH_Lim.DFC_ThrVlvSRCMax_CA "DINH/Zugeordnete Verriegelungslimits für Verriegelungsquelle DFC_ThrVlvSRCMax" VAL_BLK 0x80028102 ValA_Wu16 8192.00000000 DINH_LimDFCVerb 12079.0000000 20271.0000000 FORMAT "%13.7" NUMBER 8 /end CHARACTERISTIC
/begin CHARACTERISTIC DINH_Lim.DFC_ThrVlvSRCMin_CA "DINH/Zugeordnete Verriegelungslimits für Verriegelungsquelle DFC_ThrVlvSRCMin" VAL_BLK 0x80028112 ValA_Wu16 8192.00000000 DINH_LimDFCVerb 12079.0000000 20271.0000000 FORMAT "%13.7" NUMBER 8 /end CHARACTERISTIC
/begin CHARACTERISTIC DINH_Lim.DFC_TrbChLPOL_CA "DINH/Zugeordnete Verriegelungslimits für Verriegelungsquelle DFC_TrbChLPOL" VAL_BLK 0x80028122 ValA_Wu16 8192.00000000 DINH_LimDFCVerb 12079.0000000 20271.0000000 FORMAT "%13.7" NUMBER 2 /end CHARACTERISTIC
/begin CHARACTERISTIC DINH_Lim.DFC_TrbChLPSCB_CA "DINH/Zugeordnete Verriegelungslimits für Verriegelungsquelle DFC_TrbChLPSCB" VAL_BLK 0x80028126 ValA_Wu16 8192.00000000 DINH_LimDFCVerb 12079.0000000 20271.0000000 FORMAT "%13.7" NUMBER 2 /end CHARACTERISTIC
/begin CHARACTERISTIC DINH_Lim.DFC_TrbChLPSCG_CA "DINH/Zugeordnete Verriegelungslimits für Verriegelungsquelle DFC_TrbChLPSCG" VAL_BLK 0x8002812A ValA_Wu16 8192.00000000 DINH_LimDFCVerb 12079.0000000 20271.0000000 FORMAT "%13.7" NUMBER 2 /end CHARACTERISTIC
/begin CHARACTERISTIC DINH_Lim.DFC_UHtrPLOL_CA "DINH/Zugeordnete Verriegelungslimits für Verriegelungsquelle DFC_UHtrPLOL" VAL_BLK 0x8002812E ValA_Wu16 8192.00000000 DINH_LimDFCVerb 12079.0000000 20271.0000000 FORMAT "%13.7" NUMBER 3 /end CHARACTERISTIC
/begin CHARACTERISTIC DINH_Lim.DFC_UHtrPLSCB_CA "DINH/Zugeordnete Verriegelungslimits für Verriegelungsquelle DFC_UHtrPLSCB" VAL_BLK 0x80028134 ValA_Wu16 8192.00000000 DINH_LimDFCVerb 12079.0000000 20271.0000000 FORMAT "%13.7" NUMBER 3 /end CHARACTERISTIC
/begin CHARACTERISTIC DINH_Lim.DFC_UHtrPLSCG_CA "DINH/Zugeordnete Verriegelungslimits für Verriegelungsquelle DFC_UHtrPLSCG" VAL_BLK 0x8002813A ValA_Wu16 8192.00000000 DINH_LimDFCVerb 12079.0000000 20271.0000000 FORMAT "%13.7" NUMBER 3 /end CHARACTERISTIC
/begin CHARACTERISTIC DINH_Lim.DFC_UHtrPLSRCMaxDia_CA "DINH/Zugeordnete Verriegelungslimits für Verriegelungsquelle DFC_UHtrPLSRCMaxDia" VAL_BLK 0x80028140 ValA_Wu16 8192.00000000 DINH_LimDFCVerb 12079.0000000 20271.0000000 FORMAT "%13.7" NUMBER 4 /end CHARACTERISTIC
/begin CHARACTERISTIC DINH_Lim.DFC_UHtrPLSRCMinDia_CA "DINH/Zugeordnete Verriegelungslimits für Verriegelungsquelle DFC_UHtrPLSRCMinDia" VAL_BLK 0x80028148 ValA_Wu16 8192.00000000 DINH_LimDFCVerb 12079.0000000 20271.0000000 FORMAT "%13.7" NUMBER 4 /end CHARACTERISTIC
/begin CHARACTERISTIC DINH_Lim.DFC_UHtrTnkOL_CA "DINH/Zugeordnete Verriegelungslimits für Verriegelungsquelle DFC_UHtrTnkOL" VAL_BLK 0x80028150 ValA_Wu16 8192.00000000 DINH_LimDFCVerb 12079.0000000 20271.0000000 FORMAT "%13.7" NUMBER 3 /end CHARACTERISTIC
/begin CHARACTERISTIC DINH_Lim.DFC_UHtrTnkSCB_CA "DINH/Zugeordnete Verriegelungslimits für Verriegelungsquelle DFC_UHtrTnkSCB" VAL_BLK 0x80028156 ValA_Wu16 8192.00000000 DINH_LimDFCVerb 12079.0000000 20271.0000000 FORMAT "%13.7" NUMBER 3 /end CHARACTERISTIC
/begin CHARACTERISTIC DINH_Lim.DFC_UHtrTnkSCG_CA "DINH/Zugeordnete Verriegelungslimits für Verriegelungsquelle DFC_UHtrTnkSCG" VAL_BLK 0x8002815C ValA_Wu16 8192.00000000 DINH_LimDFCVerb 12079.0000000 20271.0000000 FORMAT "%13.7" NUMBER 3 /end CHARACTERISTIC
/begin CHARACTERISTIC DINH_Lim.DFC_UHtrTnkSRCMaxDia_CA "DINH/Zugeordnete Verriegelungslimits für Verriegelungsquelle DFC_UHtrTnkSRCMaxDia" VAL_BLK 0x80028162 ValA_Wu16 8192.00000000 DINH_LimDFCVerb 12079.0000000 20271.0000000 FORMAT "%13.7" NUMBER 4 /end CHARACTERISTIC
/begin CHARACTERISTIC DINH_Lim.DFC_UHtrTnkSRCMinDia_CA "DINH/Zugeordnete Verriegelungslimits für Verriegelungsquelle DFC_UHtrTnkSRCMinDia" VAL_BLK 0x8002816A ValA_Wu16 8192.00000000 DINH_LimDFCVerb 12079.0000000 20271.0000000 FORMAT "%13.7" NUMBER 4 /end CHARACTERISTIC
/begin CHARACTERISTIC DINH_Lim.DFC_URevVlvOL_CA "DINH/Zugeordnete Verriegelungslimits für Verriegelungsquelle DFC_URevVlvOL" VAL_BLK 0x80028172 ValA_Wu16 8192.00000000 DINH_LimDFCVerb 12079.0000000 20271.0000000 FORMAT "%13.7" NUMBER 6 /end CHARACTERISTIC
/begin CHARACTERISTIC DINH_Lim.DFC_URevVlvSCB_CA "DINH/Zugeordnete Verriegelungslimits für Verriegelungsquelle DFC_URevVlvSCB" VAL_BLK 0x8002817E ValA_Wu16 8192.00000000 DINH_LimDFCVerb 12079.0000000 20271.0000000 FORMAT "%13.7" NUMBER 6 /end CHARACTERISTIC
/begin CHARACTERISTIC DINH_Lim.DFC_URevVlvSCG_CA "DINH/Zugeordnete Verriegelungslimits für Verriegelungsquelle DFC_URevVlvSCG" VAL_BLK 0x8002818A ValA_Wu16 8192.00000000 DINH_LimDFCVerb 12079.0000000 20271.0000000 FORMAT "%13.7" NUMBER 10 /end CHARACTERISTIC
/begin CHARACTERISTIC DINH_Lim.DFC_UTnkTSRCMax_CA "DINH/Zugeordnete Verriegelungslimits für Verriegelungsquelle DFC_UTnkTSRCMax" VAL_BLK 0x8002819E ValA_Wu16 8192.00000000 DINH_LimDFCVerb 12079.0000000 20271.0000000 FORMAT "%13.7" NUMBER 4 /end CHARACTERISTIC
/begin CHARACTERISTIC DINH_Lim.DFC_UTnkTSRCMin_CA "DINH/Zugeordnete Verriegelungslimits für Verriegelungsquelle DFC_UTnkTSRCMin" VAL_BLK 0x800281A6 ValA_Wu16 8192.00000000 DINH_LimDFCVerb 12079.0000000 20271.0000000 FORMAT "%13.7" NUMBER 4 /end CHARACTERISTIC
/begin CHARACTERISTIC DINH_Lim.DFC_UTnkTSig_CA "DINH/Zugeordnete Verriegelungslimits für Verriegelungsquelle DFC_UTnkTSig" VAL_BLK 0x800281AE ValA_Wu16 8192.00000000 DINH_LimDFCVerb 12079.0000000 20271.0000000 FORMAT "%13.7" NUMBER 4 /end CHARACTERISTIC
/begin CHARACTERISTIC DINH_Lim.DFC_VSwVlvGovDvtMax_CA "DINH/Zugeordnete Verriegelungslimits für Verriegelungsquelle DFC_VSwVlvGovDvtMax" VAL_BLK 0x800281B6 ValA_Wu16 8192.00000000 DINH_LimDFCVerb 12079.0000000 20271.0000000 FORMAT "%13.7" NUMBER 2 /end CHARACTERISTIC
/begin CHARACTERISTIC DINH_Lim.DFC_VSwVlvGovDvtMin_CA "DINH/Zugeordnete Verriegelungslimits für Verriegelungsquelle DFC_VSwVlvGovDvtMin" VAL_BLK 0x800281BA ValA_Wu16 8192.00000000 DINH_LimDFCVerb 12079.0000000 20271.0000000 FORMAT "%13.7" NUMBER 2 /end CHARACTERISTIC
/begin CHARACTERISTIC DINH_Lim.DFC_VSwVlvHBrgOpnLd_CA "DINH/Zugeordnete Verriegelungslimits für Verriegelungsquelle DFC_VSwVlvHBrgOpnLd" VAL_BLK 0x800281BE ValA_Wu16 8192.00000000 DINH_LimDFCVerb 12079.0000000 20271.0000000 FORMAT "%13.7" NUMBER 2 /end CHARACTERISTIC
/begin CHARACTERISTIC DINH_Lim.DFC_VSwVlvHBrgOvrCurr_CA "DINH/Zugeordnete Verriegelungslimits für Verriegelungsquelle DFC_VSwVlvHBrgOvrCurr" VAL_BLK 0x800281C2 ValA_Wu16 8192.00000000 DINH_LimDFCVerb 12079.0000000 20271.0000000 FORMAT "%13.7" NUMBER 2 /end CHARACTERISTIC
/begin CHARACTERISTIC DINH_Lim.DFC_VSwVlvHBrgOvrTemp_CA "DINH/Zugeordnete Verriegelungslimits für Verriegelungsquelle DFC_VSwVlvHBrgOvrTemp" VAL_BLK 0x800281C6 ValA_Wu16 8192.00000000 DINH_LimDFCVerb 12079.0000000 20271.0000000 FORMAT "%13.7" NUMBER 2 /end CHARACTERISTIC
/begin CHARACTERISTIC DINH_Lim.DFC_VSwVlvHBrgShCirBatt1_CA "DINH/Zugeordnete Verriegelungslimits für Verriegelungsquelle DFC_VSwVlvHBrgShCirBatt1" VAL_BLK 0x800281CA ValA_Wu16 8192.00000000 DINH_LimDFCVerb 12079.0000000 20271.0000000 FORMAT "%13.7" NUMBER 2 /end CHARACTERISTIC
/begin CHARACTERISTIC DINH_Lim.DFC_VSwVlvHBrgShCirBatt2_CA "DINH/Zugeordnete Verriegelungslimits für Verriegelungsquelle DFC_VSwVlvHBrgShCirBatt2" VAL_BLK 0x800281CE ValA_Wu16 8192.00000000 DINH_LimDFCVerb 12079.0000000 20271.0000000 FORMAT "%13.7" NUMBER 2 /end CHARACTERISTIC
/begin CHARACTERISTIC DINH_Lim.DFC_VSwVlvHBrgShCirGnd1_CA "DINH/Zugeordnete Verriegelungslimits für Verriegelungsquelle DFC_VSwVlvHBrgShCirGnd1" VAL_BLK 0x800281D2 ValA_Wu16 8192.00000000 DINH_LimDFCVerb 12079.0000000 20271.0000000 FORMAT "%13.7" NUMBER 2 /end CHARACTERISTIC
/begin CHARACTERISTIC DINH_Lim.DFC_VSwVlvHBrgShCirGnd2_CA "DINH/Zugeordnete Verriegelungslimits für Verriegelungsquelle DFC_VSwVlvHBrgShCirGnd2" VAL_BLK 0x800281D6 ValA_Wu16 8192.00000000 DINH_LimDFCVerb 12079.0000000 20271.0000000 FORMAT "%13.7" NUMBER 2 /end CHARACTERISTIC
/begin CHARACTERISTIC DINH_Lim.DFC_VSwVlvHBrgShCirOvrLd_CA "DINH/Zugeordnete Verriegelungslimits für Verriegelungsquelle DFC_VSwVlvHBrgShCirOvrLd" VAL_BLK 0x800281DA ValA_Wu16 8192.00000000 DINH_LimDFCVerb 12079.0000000 20271.0000000 FORMAT "%13.7" NUMBER 2 /end CHARACTERISTIC
/begin CHARACTERISTIC DINH_Lim.DFC_VSwVlvHBrgTempOvrCurr_CA "DINH/Zugeordnete Verriegelungslimits für Verriegelungsquelle DFC_VSwVlvHBrgTempOvrCurr" VAL_BLK 0x800281DE ValA_Wu16 8192.00000000 DINH_LimDFCVerb 12079.0000000 20271.0000000 FORMAT "%13.7" NUMBER 2 /end CHARACTERISTIC
/begin CHARACTERISTIC DINH_Lim.DFC_VSwVlvHBrgUndrVltg_CA "DINH/Zugeordnete Verriegelungslimits für Verriegelungsquelle DFC_VSwVlvHBrgUndrVltg" VAL_BLK 0x800281E2 ValA_Wu16 8192.00000000 DINH_LimDFCVerb 12079.0000000 20271.0000000 FORMAT "%13.7" NUMBER 2 /end CHARACTERISTIC
/begin CHARACTERISTIC DINH_Lim.DFC_VSwVlvOL_CA "DINH/Zugeordnete Verriegelungslimits für Verriegelungsquelle DFC_VSwVlvOL" VAL_BLK 0x800281E6 ValA_Wu16 8192.00000000 DINH_LimDFCVerb 12079.0000000 20271.0000000 FORMAT "%13.7" NUMBER 8 /end CHARACTERISTIC
/begin CHARACTERISTIC DINH_Lim.DFC_VSwVlvSCB_CA "DINH/Zugeordnete Verriegelungslimits für Verriegelungsquelle DFC_VSwVlvSCB" VAL_BLK 0x800281F6 ValA_Wu16 8192.00000000 DINH_LimDFCVerb 12079.0000000 20271.0000000 FORMAT "%13.7" NUMBER 8 /end CHARACTERISTIC
/begin CHARACTERISTIC DINH_Lim.DFC_VSwVlvSCG_CA "DINH/Zugeordnete Verriegelungslimits für Verriegelungsquelle DFC_VSwVlvSCG" VAL_BLK 0x80028206 ValA_Wu16 8192.00000000 DINH_LimDFCVerb 12079.0000000 20271.0000000 FORMAT "%13.7" NUMBER 8 /end CHARACTERISTIC
/begin CHARACTERISTIC DINH_Lim.DFC_VSwVlvSRCMax_CA "DINH/Zugeordnete Verriegelungslimits für Verriegelungsquelle DFC_VSwVlvSRCMax" VAL_BLK 0x80028216 ValA_Wu16 8192.00000000 DINH_LimDFCVerb 12079.0000000 20271.0000000 FORMAT "%13.7" NUMBER 7 /end CHARACTERISTIC
/begin CHARACTERISTIC DINH_Lim.DFC_VSwVlvSRCMin_CA "DINH/Zugeordnete Verriegelungslimits für Verriegelungsquelle DFC_VSwVlvSRCMin" VAL_BLK 0x80028224 ValA_Wu16 8192.00000000 DINH_LimDFCVerb 12079.0000000 20271.0000000 FORMAT "%13.7" NUMBER 7 /end CHARACTERISTIC
/begin CHARACTERISTIC DINH_Lim.DFC_ClthNpl_CA "DINH/Zugeordnete Verriegelungslimits für Verriegelungsquelle DFC_ClthNpl" VAL_BLK 0x80028232 ValA_Wu16 8192.00000000 DINH_LimDFCVerb 12079.0000000 20271.0000000 FORMAT "%13.7" NUMBER 22 /end CHARACTERISTIC
/begin CHARACTERISTIC DINH_Lim.DFC_ETClbETMax_0_CA "DINH/Zugeordnete Verriegelungslimits für Verriegelungsquelle DFC_ETClbETMax_0" VAL_BLK 0x8002825E ValA_Wu16 8192.00000000 DINH_LimDFCVerb 12079.0000000 20271.0000000 FORMAT "%13.7" NUMBER 2 /end CHARACTERISTIC
/begin CHARACTERISTIC DINH_Lim.DFC_ETClbETMax_1_CA "DINH/Zugeordnete Verriegelungslimits für Verriegelungsquelle DFC_ETClbETMax_1" VAL_BLK 0x80028262 ValA_Wu16 8192.00000000 DINH_LimDFCVerb 12079.0000000 20271.0000000 FORMAT "%13.7" NUMBER 2 /end CHARACTERISTIC
/begin CHARACTERISTIC DINH_Lim.DFC_ETClbETMax_2_CA "DINH/Zugeordnete Verriegelungslimits für Verriegelungsquelle DFC_ETClbETMax_2" VAL_BLK 0x80028266 ValA_Wu16 8192.00000000 DINH_LimDFCVerb 12079.0000000 20271.0000000 FORMAT "%13.7" NUMBER 2 /end CHARACTERISTIC
/begin CHARACTERISTIC DINH_Lim.DFC_ETClbETMax_3_CA "DINH/Zugeordnete Verriegelungslimits für Verriegelungsquelle DFC_ETClbETMax_3" VAL_BLK 0x8002826A ValA_Wu16 8192.00000000 DINH_LimDFCVerb 12079.0000000 20271.0000000 FORMAT "%13.7" NUMBER 2 /end CHARACTERISTIC
/begin CHARACTERISTIC DINH_Lim.DFC_ETClbETMax_4_CA "DINH/Zugeordnete Verriegelungslimits für Verriegelungsquelle DFC_ETClbETMax_4" VAL_BLK 0x8002826E ValA_Wu16 8192.00000000 DINH_LimDFCVerb 12079.0000000 20271.0000000 FORMAT "%13.7" NUMBER 2 /end CHARACTERISTIC
/begin CHARACTERISTIC DINH_Lim.DFC_ETClbETMax_5_CA "DINH/Zugeordnete Verriegelungslimits für Verriegelungsquelle DFC_ETClbETMax_5" VAL_BLK 0x80028272 ValA_Wu16 8192.00000000 DINH_LimDFCVerb 12079.0000000 20271.0000000 FORMAT "%13.7" NUMBER 2 /end CHARACTERISTIC
/begin CHARACTERISTIC DINH_Lim.DFC_ETClbETMin_0_CA "DINH/Zugeordnete Verriegelungslimits für Verriegelungsquelle DFC_ETClbETMin_0" VAL_BLK 0x80028276 ValA_Wu16 8192.00000000 DINH_LimDFCVerb 12079.0000000 20271.0000000 FORMAT "%13.7" NUMBER 2 /end CHARACTERISTIC
/begin CHARACTERISTIC DINH_Lim.DFC_ETClbETMin_1_CA "DINH/Zugeordnete Verriegelungslimits für Verriegelungsquelle DFC_ETClbETMin_1" VAL_BLK 0x8002827A ValA_Wu16 8192.00000000 DINH_LimDFCVerb 12079.0000000 20271.0000000 FORMAT "%13.7" NUMBER 2 /end CHARACTERISTIC
/begin CHARACTERISTIC DINH_Lim.DFC_ETClbETMin_2_CA "DINH/Zugeordnete Verriegelungslimits für Verriegelungsquelle DFC_ETClbETMin_2" VAL_BLK 0x8002827E ValA_Wu16 8192.00000000 DINH_LimDFCVerb 12079.0000000 20271.0000000 FORMAT "%13.7" NUMBER 2 /end CHARACTERISTIC
/begin CHARACTERISTIC DINH_Lim.DFC_ETClbETMin_3_CA "DINH/Zugeordnete Verriegelungslimits für Verriegelungsquelle DFC_ETClbETMin_3" VAL_BLK 0x80028282 ValA_Wu16 8192.00000000 DINH_LimDFCVerb 12079.0000000 20271.0000000 FORMAT "%13.7" NUMBER 2 /end CHARACTERISTIC
/begin CHARACTERISTIC DINH_Lim.DFC_ETClbETMin_4_CA "DINH/Zugeordnete Verriegelungslimits für Verriegelungsquelle DFC_ETClbETMin_4" VAL_BLK 0x80028286 ValA_Wu16 8192.00000000 DINH_LimDFCVerb 12079.0000000 20271.0000000 FORMAT "%13.7" NUMBER 2 /end CHARACTERISTIC
/begin CHARACTERISTIC DINH_Lim.DFC_ETClbETMin_5_CA "DINH/Zugeordnete Verriegelungslimits für Verriegelungsquelle DFC_ETClbETMin_5" VAL_BLK 0x8002828A ValA_Wu16 8192.00000000 DINH_LimDFCVerb 12079.0000000 20271.0000000 FORMAT "%13.7" NUMBER 2 /end CHARACTERISTIC
/begin CHARACTERISTIC DINH_Lim.DFC_IVActrEnrgMax_0_CA "DINH/Zugeordnete Verriegelungslimits für Verriegelungsquelle DFC_IVActrEnrgMax_0" VAL_BLK 0x8002828E ValA_Wu16 8192.00000000 DINH_LimDFCVerb 12079.0000000 20271.0000000 FORMAT "%13.7" NUMBER 2 /end CHARACTERISTIC
/begin CHARACTERISTIC DINH_Lim.DFC_IVActrEnrgMax_1_CA "DINH/Zugeordnete Verriegelungslimits für Verriegelungsquelle DFC_IVActrEnrgMax_1" VAL_BLK 0x80028292 ValA_Wu16 8192.00000000 DINH_LimDFCVerb 12079.0000000 20271.0000000 FORMAT "%13.7" NUMBER 2 /end CHARACTERISTIC
/begin CHARACTERISTIC DINH_Lim.DFC_IVActrEnrgMax_2_CA "DINH/Zugeordnete Verriegelungslimits für Verriegelungsquelle DFC_IVActrEnrgMax_2" VAL_BLK 0x80028296 ValA_Wu16 8192.00000000 DINH_LimDFCVerb 12079.0000000 20271.0000000 FORMAT "%13.7" NUMBER 2 /end CHARACTERISTIC
/begin CHARACTERISTIC DINH_Lim.DFC_IVActrEnrgMax_3_CA "DINH/Zugeordnete Verriegelungslimits für Verriegelungsquelle DFC_IVActrEnrgMax_3" VAL_BLK 0x8002829A ValA_Wu16 8192.00000000 DINH_LimDFCVerb 12079.0000000 20271.0000000 FORMAT "%13.7" NUMBER 2 /end CHARACTERISTIC
/begin CHARACTERISTIC DINH_Lim.DFC_IVActrEnrgMax_4_CA "DINH/Zugeordnete Verriegelungslimits für Verriegelungsquelle DFC_IVActrEnrgMax_4" VAL_BLK 0x8002829E ValA_Wu16 8192.00000000 DINH_LimDFCVerb 12079.0000000 20271.0000000 FORMAT "%13.7" NUMBER 2 /end CHARACTERISTIC
/begin CHARACTERISTIC DINH_Lim.DFC_IVActrEnrgMax_5_CA "DINH/Zugeordnete Verriegelungslimits für Verriegelungsquelle DFC_IVActrEnrgMax_5" VAL_BLK 0x800282A2 ValA_Wu16 8192.00000000 DINH_LimDFCVerb 12079.0000000 20271.0000000 FORMAT "%13.7" NUMBER 2 /end CHARACTERISTIC
/begin CHARACTERISTIC DINH_Lim.DFC_IVActrEnrgMax_6_CA "DINH/Zugeordnete Verriegelungslimits für Verriegelungsquelle DFC_IVActrEnrgMax_6" VAL_BLK 0x800282A6 ValA_Wu16 8192.00000000 DINH_LimDFCVerb 12079.0000000 20271.0000000 FORMAT "%13.7" NUMBER 2 /end CHARACTERISTIC
/begin CHARACTERISTIC DINH_Lim.DFC_IVActrEnrgMax_7_CA "DINH/Zugeordnete Verriegelungslimits für Verriegelungsquelle DFC_IVActrEnrgMax_7" VAL_BLK 0x800282AA ValA_Wu16 8192.00000000 DINH_LimDFCVerb 12079.0000000 20271.0000000 FORMAT "%13.7" NUMBER 2 /end CHARACTERISTIC
/begin CHARACTERISTIC DINH_Lim.DFC_IVActrEnrgMin_0_CA "DINH/Zugeordnete Verriegelungslimits für Verriegelungsquelle DFC_IVActrEnrgMin_0" VAL_BLK 0x800282AE ValA_Wu16 8192.00000000 DINH_LimDFCVerb 12079.0000000 20271.0000000 FORMAT "%13.7" NUMBER 2 /end CHARACTERISTIC
/begin CHARACTERISTIC DINH_Lim.DFC_IVActrEnrgMin_1_CA "DINH/Zugeordnete Verriegelungslimits für Verriegelungsquelle DFC_IVActrEnrgMin_1" VAL_BLK 0x800282B2 ValA_Wu16 8192.00000000 DINH_LimDFCVerb 12079.0000000 20271.0000000 FORMAT "%13.7" NUMBER 2 /end CHARACTERISTIC
/begin CHARACTERISTIC DINH_Lim.DFC_IVActrEnrgMin_2_CA "DINH/Zugeordnete Verriegelungslimits für Verriegelungsquelle DFC_IVActrEnrgMin_2" VAL_BLK 0x800282B6 ValA_Wu16 8192.00000000 DINH_LimDFCVerb 12079.0000000 20271.0000000 FORMAT "%13.7" NUMBER 2 /end CHARACTERISTIC
/begin CHARACTERISTIC DINH_Lim.DFC_IVActrEnrgMin_3_CA "DINH/Zugeordnete Verriegelungslimits für Verriegelungsquelle DFC_IVActrEnrgMin_3" VAL_BLK 0x800282BA ValA_Wu16 8192.00000000 DINH_LimDFCVerb 12079.0000000 20271.0000000 FORMAT "%13.7" NUMBER 2 /end CHARACTERISTIC
/begin CHARACTERISTIC DINH_Lim.DFC_IVActrEnrgMin_4_CA "DINH/Zugeordnete Verriegelungslimits für Verriegelungsquelle DFC_IVActrEnrgMin_4" VAL_BLK 0x800282BE ValA_Wu16 8192.00000000 DINH_LimDFCVerb 12079.0000000 20271.0000000 FORMAT "%13.7" NUMBER 2 /end CHARACTERISTIC
/begin CHARACTERISTIC DINH_Lim.DFC_IVActrEnrgMin_5_CA "DINH/Zugeordnete Verriegelungslimits für Verriegelungsquelle DFC_IVActrEnrgMin_5" VAL_BLK 0x800282C2 ValA_Wu16 8192.00000000 DINH_LimDFCVerb 12079.0000000 20271.0000000 FORMAT "%13.7" NUMBER 2 /end CHARACTERISTIC
/begin CHARACTERISTIC DINH_Lim.DFC_IVActrEnrgMin_6_CA "DINH/Zugeordnete Verriegelungslimits für Verriegelungsquelle DFC_IVActrEnrgMin_6" VAL_BLK 0x800282C6 ValA_Wu16 8192.00000000 DINH_LimDFCVerb 12079.0000000 20271.0000000 FORMAT "%13.7" NUMBER 2 /end CHARACTERISTIC
/begin CHARACTERISTIC DINH_Lim.DFC_IVActrEnrgMin_7_CA "DINH/Zugeordnete Verriegelungslimits für Verriegelungsquelle DFC_IVActrEnrgMin_7" VAL_BLK 0x800282CA ValA_Wu16 8192.00000000 DINH_LimDFCVerb 12079.0000000 20271.0000000 FORMAT "%13.7" NUMBER 2 /end CHARACTERISTIC
/begin CHARACTERISTIC DINH_Lim.DFC_IVActrEnrgPlaus_0_CA "DINH/Zugeordnete Verriegelungslimits für Verriegelungsquelle DFC_IVActrEnrgPlaus_0" VAL_BLK 0x800282CE ValA_Wu16 8192.00000000 DINH_LimDFCVerb 12079.0000000 20271.0000000 FORMAT "%13.7" NUMBER 2 /end CHARACTERISTIC
/begin CHARACTERISTIC DINH_Lim.DFC_IVActrEnrgPlaus_1_CA "DINH/Zugeordnete Verriegelungslimits für Verriegelungsquelle DFC_IVActrEnrgPlaus_1" VAL_BLK 0x800282D2 ValA_Wu16 8192.00000000 DINH_LimDFCVerb 12079.0000000 20271.0000000 FORMAT "%13.7" NUMBER 2 /end CHARACTERISTIC
/begin CHARACTERISTIC DINH_Lim.DFC_IVActrEnrgPlaus_2_CA "DINH/Zugeordnete Verriegelungslimits für Verriegelungsquelle DFC_IVActrEnrgPlaus_2" VAL_BLK 0x800282D6 ValA_Wu16 8192.00000000 DINH_LimDFCVerb 12079.0000000 20271.0000000 FORMAT "%13.7" NUMBER 2 /end CHARACTERISTIC
/begin CHARACTERISTIC DINH_Lim.DFC_IVActrEnrgPlaus_3_CA "DINH/Zugeordnete Verriegelungslimits für Verriegelungsquelle DFC_IVActrEnrgPlaus_3" VAL_BLK 0x800282DA ValA_Wu16 8192.00000000 DINH_LimDFCVerb 12079.0000000 20271.0000000 FORMAT "%13.7" NUMBER 2 /end CHARACTERISTIC
/begin CHARACTERISTIC DINH_Lim.DFC_IVActrEnrgPlaus_4_CA "DINH/Zugeordnete Verriegelungslimits für Verriegelungsquelle DFC_IVActrEnrgPlaus_4" VAL_BLK 0x800282DE ValA_Wu16 8192.00000000 DINH_LimDFCVerb 12079.0000000 20271.0000000 FORMAT "%13.7" NUMBER 2 /end CHARACTERISTIC
/begin CHARACTERISTIC DINH_Lim.DFC_IVActrEnrgPlaus_5_CA "DINH/Zugeordnete Verriegelungslimits für Verriegelungsquelle DFC_IVActrEnrgPlaus_5" VAL_BLK 0x800282E2 ValA_Wu16 8192.00000000 DINH_LimDFCVerb 12079.0000000 20271.0000000 FORMAT "%13.7" NUMBER 2 /end CHARACTERISTIC
/begin CHARACTERISTIC DINH_Lim.DFC_IVActrEnrgPlaus_6_CA "DINH/Zugeordnete Verriegelungslimits für Verriegelungsquelle DFC_IVActrEnrgPlaus_6" VAL_BLK 0x800282E6 ValA_Wu16 8192.00000000 DINH_LimDFCVerb 12079.0000000 20271.0000000 FORMAT "%13.7" NUMBER 2 /end CHARACTERISTIC
/begin CHARACTERISTIC DINH_Lim.DFC_IVActrEnrgPlaus_7_CA "DINH/Zugeordnete Verriegelungslimits für Verriegelungsquelle DFC_IVActrEnrgPlaus_7" VAL_BLK 0x800282EA ValA_Wu16 8192.00000000 DINH_LimDFCVerb 12079.0000000 20271.0000000 FORMAT "%13.7" NUMBER 2 /end CHARACTERISTIC
/begin CHARACTERISTIC DINH_Lim.DFC_IVCtlTiDiff_0_CA "DINH/Zugeordnete Verriegelungslimits für Verriegelungsquelle DFC_IVCtlTiDiff_0" VAL_BLK 0x800282EE ValA_Wu16 8192.00000000 DINH_LimDFCVerb 12079.0000000 20271.0000000 FORMAT "%13.7" NUMBER 2 /end CHARACTERISTIC
/begin CHARACTERISTIC DINH_Lim.DFC_IVCtlTiDiff_1_CA "DINH/Zugeordnete Verriegelungslimits für Verriegelungsquelle DFC_IVCtlTiDiff_1" VAL_BLK 0x800282F2 ValA_Wu16 8192.00000000 DINH_LimDFCVerb 12079.0000000 20271.0000000 FORMAT "%13.7" NUMBER 2 /end CHARACTERISTIC
/begin CHARACTERISTIC DINH_Lim.DFC_IVCtlTiDiff_2_CA "DINH/Zugeordnete Verriegelungslimits für Verriegelungsquelle DFC_IVCtlTiDiff_2" VAL_BLK 0x800282F6 ValA_Wu16 8192.00000000 DINH_LimDFCVerb 12079.0000000 20271.0000000 FORMAT "%13.7" NUMBER 2 /end CHARACTERISTIC
/begin CHARACTERISTIC DINH_Lim.DFC_IVCtlTiDiff_3_CA "DINH/Zugeordnete Verriegelungslimits für Verriegelungsquelle DFC_IVCtlTiDiff_3" VAL_BLK 0x800282FA ValA_Wu16 8192.00000000 DINH_LimDFCVerb 12079.0000000 20271.0000000 FORMAT "%13.7" NUMBER 2 /end CHARACTERISTIC
/begin CHARACTERISTIC DINH_Lim.DFC_IVCtlTiDiff_4_CA "DINH/Zugeordnete Verriegelungslimits für Verriegelungsquelle DFC_IVCtlTiDiff_4" VAL_BLK 0x800282FE ValA_Wu16 8192.00000000 DINH_LimDFCVerb 12079.0000000 20271.0000000 FORMAT "%13.7" NUMBER 2 /end CHARACTERISTIC
/begin CHARACTERISTIC DINH_Lim.DFC_IVCtlTiDiff_5_CA "DINH/Zugeordnete Verriegelungslimits für Verriegelungsquelle DFC_IVCtlTiDiff_5" VAL_BLK 0x80028302 ValA_Wu16 8192.00000000 DINH_LimDFCVerb 12079.0000000 20271.0000000 FORMAT "%13.7" NUMBER 2 /end CHARACTERISTIC
/begin CHARACTERISTIC DINH_Lim.DFC_IVCtlUDiffUp_0_CA "DINH/Zugeordnete Verriegelungslimits für Verriegelungsquelle DFC_IVCtlUDiffUp_0" VAL_BLK 0x80028306 ValA_Wu16 8192.00000000 DINH_LimDFCVerb 12079.0000000 20271.0000000 FORMAT "%13.7" NUMBER 2 /end CHARACTERISTIC
/begin CHARACTERISTIC DINH_Lim.DFC_IVCtlUDiffUp_1_CA "DINH/Zugeordnete Verriegelungslimits für Verriegelungsquelle DFC_IVCtlUDiffUp_1" VAL_BLK 0x8002830A ValA_Wu16 8192.00000000 DINH_LimDFCVerb 12079.0000000 20271.0000000 FORMAT "%13.7" NUMBER 2 /end CHARACTERISTIC
/begin CHARACTERISTIC DINH_Lim.DFC_IVCtlUDiffUp_2_CA "DINH/Zugeordnete Verriegelungslimits für Verriegelungsquelle DFC_IVCtlUDiffUp_2" VAL_BLK 0x8002830E ValA_Wu16 8192.00000000 DINH_LimDFCVerb 12079.0000000 20271.0000000 FORMAT "%13.7" NUMBER 2 /end CHARACTERISTIC
/begin CHARACTERISTIC DINH_Lim.DFC_IVCtlUDiffUp_3_CA "DINH/Zugeordnete Verriegelungslimits für Verriegelungsquelle DFC_IVCtlUDiffUp_3" VAL_BLK 0x80028312 ValA_Wu16 8192.00000000 DINH_LimDFCVerb 12079.0000000 20271.0000000 FORMAT "%13.7" NUMBER 2 /end CHARACTERISTIC
/begin CHARACTERISTIC DINH_Lim.DFC_IVCtlUDiffUp_4_CA "DINH/Zugeordnete Verriegelungslimits für Verriegelungsquelle DFC_IVCtlUDiffUp_4" VAL_BLK 0x80028316 ValA_Wu16 8192.00000000 DINH_LimDFCVerb 12079.0000000 20271.0000000 FORMAT "%13.7" NUMBER 2 /end CHARACTERISTIC
/begin CHARACTERISTIC DINH_Lim.DFC_IVCtlUDiffUp_5_CA "DINH/Zugeordnete Verriegelungslimits für Verriegelungsquelle DFC_IVCtlUDiffUp_5" VAL_BLK 0x8002831A ValA_Wu16 8192.00000000 DINH_LimDFCVerb 12079.0000000 20271.0000000 FORMAT "%13.7" NUMBER 2 /end CHARACTERISTIC
/begin CHARACTERISTIC DINH_Lim.DFC_IVCtlUUp_0_CA "DINH/Zugeordnete Verriegelungslimits für Verriegelungsquelle DFC_IVCtlUUp_0" VAL_BLK 0x8002831E ValA_Wu16 8192.00000000 DINH_LimDFCVerb 12079.0000000 20271.0000000 FORMAT "%13.7" NUMBER 2 /end CHARACTERISTIC
/begin CHARACTERISTIC DINH_Lim.DFC_IVCtlUUp_1_CA "DINH/Zugeordnete Verriegelungslimits für Verriegelungsquelle DFC_IVCtlUUp_1" VAL_BLK 0x80028322 ValA_Wu16 8192.00000000 DINH_LimDFCVerb 12079.0000000 20271.0000000 FORMAT "%13.7" NUMBER 2 /end CHARACTERISTIC
/begin CHARACTERISTIC DINH_Lim.DFC_IVCtlUUp_2_CA "DINH/Zugeordnete Verriegelungslimits für Verriegelungsquelle DFC_IVCtlUUp_2" VAL_BLK 0x80028326 ValA_Wu16 8192.00000000 DINH_LimDFCVerb 12079.0000000 20271.0000000 FORMAT "%13.7" NUMBER 2 /end CHARACTERISTIC
/begin CHARACTERISTIC DINH_Lim.DFC_IVCtlUUp_3_CA "DINH/Zugeordnete Verriegelungslimits für Verriegelungsquelle DFC_IVCtlUUp_3" VAL_BLK 0x8002832A ValA_Wu16 8192.00000000 DINH_LimDFCVerb 12079.0000000 20271.0000000 FORMAT "%13.7" NUMBER 2 /end CHARACTERISTIC
/begin CHARACTERISTIC DINH_Lim.DFC_IVCtlUUp_4_CA "DINH/Zugeordnete Verriegelungslimits für Verriegelungsquelle DFC_IVCtlUUp_4" VAL_BLK 0x8002832E ValA_Wu16 8192.00000000 DINH_LimDFCVerb 12079.0000000 20271.0000000 FORMAT "%13.7" NUMBER 2 /end CHARACTERISTIC
/begin CHARACTERISTIC DINH_Lim.DFC_IVCtlUUp_5_CA "DINH/Zugeordnete Verriegelungslimits für Verriegelungsquelle DFC_IVCtlUUp_5" VAL_BLK 0x80028332 ValA_Wu16 8192.00000000 DINH_LimDFCVerb 12079.0000000 20271.0000000 FORMAT "%13.7" NUMBER 2 /end CHARACTERISTIC
/begin CHARACTERISTIC DINH_Lim.DFC_IVDiaBnkShCir_0_CA "DINH/Zugeordnete Verriegelungslimits für Verriegelungsquelle DFC_IVDiaBnkShCir_0" VAL_BLK 0x80028336 ValA_Wu16 8192.00000000 DINH_LimDFCVerb 12079.0000000 20271.0000000 FORMAT "%13.7" NUMBER 7 /end CHARACTERISTIC
/begin CHARACTERISTIC DINH_Lim.DFC_IVDiaBnkShCir_1_CA "DINH/Zugeordnete Verriegelungslimits für Verriegelungsquelle DFC_IVDiaBnkShCir_1" VAL_BLK 0x80028344 ValA_Wu16 8192.00000000 DINH_LimDFCVerb 12079.0000000 20271.0000000 FORMAT "%13.7" NUMBER 7 /end CHARACTERISTIC
/begin CHARACTERISTIC DINH_Lim.DFC_IVDiaBnkShCirChSwt_0_CA "DINH/Zugeordnete Verriegelungslimits für Verriegelungsquelle DFC_IVDiaBnkShCirChSwt_0" VAL_BLK 0x80028352 ValA_Wu16 8192.00000000 DINH_LimDFCVerb 12079.0000000 20271.0000000 FORMAT "%13.7" NUMBER 5 /end CHARACTERISTIC
/begin CHARACTERISTIC DINH_Lim.DFC_IVDiaBnkShCirChSwt_1_CA "DINH/Zugeordnete Verriegelungslimits für Verriegelungsquelle DFC_IVDiaBnkShCirChSwt_1" VAL_BLK 0x8002835C ValA_Wu16 8192.00000000 DINH_LimDFCVerb 12079.0000000 20271.0000000 FORMAT "%13.7" NUMBER 5 /end CHARACTERISTIC
/begin CHARACTERISTIC DINH_Lim.DFC_IVDiaChp_0_CA "DINH/Zugeordnete Verriegelungslimits für Verriegelungsquelle DFC_IVDiaChp_0" VAL_BLK 0x80028366 ValA_Wu16 8192.00000000 DINH_LimDFCVerb 12079.0000000 20271.0000000 FORMAT "%13.7" NUMBER 7 /end CHARACTERISTIC
/begin CHARACTERISTIC DINH_Lim.DFC_IVDiaChp_1_CA "DINH/Zugeordnete Verriegelungslimits für Verriegelungsquelle DFC_IVDiaChp_1" VAL_BLK 0x80028374 ValA_Wu16 8192.00000000 DINH_LimDFCVerb 12079.0000000 20271.0000000 FORMAT "%13.7" NUMBER 7 /end CHARACTERISTIC
/begin CHARACTERISTIC DINH_Lim.DFC_IVDiaCylNoCls_0_CA "DINH/Zugeordnete Verriegelungslimits für Verriegelungsquelle DFC_IVDiaCylNoCls_0" VAL_BLK 0x80028382 ValA_Wu16 8192.00000000 DINH_LimDFCVerb 12079.0000000 20271.0000000 FORMAT "%13.7" NUMBER 5 /end CHARACTERISTIC
/begin CHARACTERISTIC DINH_Lim.DFC_IVDiaCylNoCls_1_CA "DINH/Zugeordnete Verriegelungslimits für Verriegelungsquelle DFC_IVDiaCylNoCls_1" VAL_BLK 0x8002838C ValA_Wu16 8192.00000000 DINH_LimDFCVerb 12079.0000000 20271.0000000 FORMAT "%13.7" NUMBER 5 /end CHARACTERISTIC
/begin CHARACTERISTIC DINH_Lim.DFC_IVDiaCylNoCls_2_CA "DINH/Zugeordnete Verriegelungslimits für Verriegelungsquelle DFC_IVDiaCylNoCls_2" VAL_BLK 0x80028396 ValA_Wu16 8192.00000000 DINH_LimDFCVerb 12079.0000000 20271.0000000 FORMAT "%13.7" NUMBER 5 /end CHARACTERISTIC
/begin CHARACTERISTIC DINH_Lim.DFC_IVDiaCylNoCls_3_CA "DINH/Zugeordnete Verriegelungslimits für Verriegelungsquelle DFC_IVDiaCylNoCls_3" VAL_BLK 0x800283A0 ValA_Wu16 8192.00000000 DINH_LimDFCVerb 12079.0000000 20271.0000000 FORMAT "%13.7" NUMBER 5 /end CHARACTERISTIC
/begin CHARACTERISTIC DINH_Lim.DFC_IVDiaCylNoCls_4_CA "DINH/Zugeordnete Verriegelungslimits für Verriegelungsquelle DFC_IVDiaCylNoCls_4" VAL_BLK 0x800283AA ValA_Wu16 8192.00000000 DINH_LimDFCVerb 12079.0000000 20271.0000000 FORMAT "%13.7" NUMBER 5 /end CHARACTERISTIC
/begin CHARACTERISTIC DINH_Lim.DFC_IVDiaCylNoCls_5_CA "DINH/Zugeordnete Verriegelungslimits für Verriegelungsquelle DFC_IVDiaCylNoCls_5" VAL_BLK 0x800283B4 ValA_Wu16 8192.00000000 DINH_LimDFCVerb 12079.0000000 20271.0000000 FORMAT "%13.7" NUMBER 5 /end CHARACTERISTIC
/begin CHARACTERISTIC DINH_Lim.DFC_IVDiaCylNoLd_0_CA "DINH/Zugeordnete Verriegelungslimits für Verriegelungsquelle DFC_IVDiaCylNoLd_0" VAL_BLK 0x800283BE ValA_Wu16 8192.00000000 DINH_LimDFCVerb 12079.0000000 20271.0000000 FORMAT "%13.7" NUMBER 6 /end CHARACTERISTIC
/begin CHARACTERISTIC DINH_Lim.DFC_IVDiaCylNoLd_1_CA "DINH/Zugeordnete Verriegelungslimits für Verriegelungsquelle DFC_IVDiaCylNoLd_1" VAL_BLK 0x800283CA ValA_Wu16 8192.00000000 DINH_LimDFCVerb 12079.0000000 20271.0000000 FORMAT "%13.7" NUMBER 6 /end CHARACTERISTIC
/begin CHARACTERISTIC DINH_Lim.DFC_IVDiaCylNoLd_2_CA "DINH/Zugeordnete Verriegelungslimits für Verriegelungsquelle DFC_IVDiaCylNoLd_2" VAL_BLK 0x800283D6 ValA_Wu16 8192.00000000 DINH_LimDFCVerb 12079.0000000 20271.0000000 FORMAT "%13.7" NUMBER 6 /end CHARACTERISTIC
/begin CHARACTERISTIC DINH_Lim.DFC_IVDiaCylNoLd_3_CA "DINH/Zugeordnete Verriegelungslimits für Verriegelungsquelle DFC_IVDiaCylNoLd_3" VAL_BLK 0x800283E2 ValA_Wu16 8192.00000000 DINH_LimDFCVerb 12079.0000000 20271.0000000 FORMAT "%13.7" NUMBER 6 /end CHARACTERISTIC
/begin CHARACTERISTIC DINH_Lim.DFC_IVDiaCylNoLd_4_CA "DINH/Zugeordnete Verriegelungslimits für Verriegelungsquelle DFC_IVDiaCylNoLd_4" VAL_BLK 0x800283EE ValA_Wu16 8192.00000000 DINH_LimDFCVerb 12079.0000000 20271.0000000 FORMAT "%13.7" NUMBER 6 /end CHARACTERISTIC
/begin CHARACTERISTIC DINH_Lim.DFC_IVDiaCylNoLd_5_CA "DINH/Zugeordnete Verriegelungslimits für Verriegelungsquelle DFC_IVDiaCylNoLd_5" VAL_BLK 0x800283FA ValA_Wu16 8192.00000000 DINH_LimDFCVerb 12079.0000000 20271.0000000 FORMAT "%13.7" NUMBER 6 /end CHARACTERISTIC
/begin CHARACTERISTIC DINH_Lim.DFC_IVDiaCylShCir_0_CA "DINH/Zugeordnete Verriegelungslimits für Verriegelungsquelle DFC_IVDiaCylShCir_0" VAL_BLK 0x80028406 ValA_Wu16 8192.00000000 DINH_LimDFCVerb 12079.0000000 20271.0000000 FORMAT "%13.7" NUMBER 7 /end CHARACTERISTIC
/begin CHARACTERISTIC DINH_Lim.DFC_IVDiaCylShCir_1_CA "DINH/Zugeordnete Verriegelungslimits für Verriegelungsquelle DFC_IVDiaCylShCir_1" VAL_BLK 0x80028414 ValA_Wu16 8192.00000000 DINH_LimDFCVerb 12079.0000000 20271.0000000 FORMAT "%13.7" NUMBER 7 /end CHARACTERISTIC
/begin CHARACTERISTIC DINH_Lim.DFC_IVDiaCylShCir_2_CA "DINH/Zugeordnete Verriegelungslimits für Verriegelungsquelle DFC_IVDiaCylShCir_2" VAL_BLK 0x80028422 ValA_Wu16 8192.00000000 DINH_LimDFCVerb 12079.0000000 20271.0000000 FORMAT "%13.7" NUMBER 7 /end CHARACTERISTIC
/begin CHARACTERISTIC DINH_Lim.DFC_IVDiaCylShCir_3_CA "DINH/Zugeordnete Verriegelungslimits für Verriegelungsquelle DFC_IVDiaCylShCir_3" VAL_BLK 0x80028430 ValA_Wu16 8192.00000000 DINH_LimDFCVerb 12079.0000000 20271.0000000 FORMAT "%13.7" NUMBER 7 /end CHARACTERISTIC
/begin CHARACTERISTIC DINH_Lim.DFC_IVDiaCylShCir_4_CA "DINH/Zugeordnete Verriegelungslimits für Verriegelungsquelle DFC_IVDiaCylShCir_4" VAL_BLK 0x8002843E ValA_Wu16 8192.00000000 DINH_LimDFCVerb 12079.0000000 20271.0000000 FORMAT "%13.7" NUMBER 7 /end CHARACTERISTIC
/begin CHARACTERISTIC DINH_Lim.DFC_IVDiaCylShCir_5_CA "DINH/Zugeordnete Verriegelungslimits für Verriegelungsquelle DFC_IVDiaCylShCir_5" VAL_BLK 0x8002844C ValA_Wu16 8192.00000000 DINH_LimDFCVerb 12079.0000000 20271.0000000 FORMAT "%13.7" NUMBER 7 /end CHARACTERISTIC
/begin CHARACTERISTIC DINH_Lim.DFC_IVDiaCylShCirHSLS_0_CA "DINH/Zugeordnete Verriegelungslimits für Verriegelungsquelle DFC_IVDiaCylShCirHSLS_0" VAL_BLK 0x8002845A ValA_Wu16 8192.00000000 DINH_LimDFCVerb 12079.0000000 20271.0000000 FORMAT "%13.7" NUMBER 7 /end CHARACTERISTIC
/begin CHARACTERISTIC DINH_Lim.DFC_IVDiaCylShCirHSLS_1_CA "DINH/Zugeordnete Verriegelungslimits für Verriegelungsquelle DFC_IVDiaCylShCirHSLS_1" VAL_BLK 0x80028468 ValA_Wu16 8192.00000000 DINH_LimDFCVerb 12079.0000000 20271.0000000 FORMAT "%13.7" NUMBER 7 /end CHARACTERISTIC
/begin CHARACTERISTIC DINH_Lim.DFC_IVDiaCylShCirHSLS_2_CA "DINH/Zugeordnete Verriegelungslimits für Verriegelungsquelle DFC_IVDiaCylShCirHSLS_2" VAL_BLK 0x80028476 ValA_Wu16 8192.00000000 DINH_LimDFCVerb 12079.0000000 20271.0000000 FORMAT "%13.7" NUMBER 7 /end CHARACTERISTIC
/begin CHARACTERISTIC DINH_Lim.DFC_IVDiaCylShCirHSLS_3_CA "DINH/Zugeordnete Verriegelungslimits für Verriegelungsquelle DFC_IVDiaCylShCirHSLS_3" VAL_BLK 0x80028484 ValA_Wu16 8192.00000000 DINH_LimDFCVerb 12079.0000000 20271.0000000 FORMAT "%13.7" NUMBER 7 /end CHARACTERISTIC
/begin CHARACTERISTIC DINH_Lim.DFC_IVDiaCylShCirHSLS_4_CA "DINH/Zugeordnete Verriegelungslimits für Verriegelungsquelle DFC_IVDiaCylShCirHSLS_4" VAL_BLK 0x80028492 ValA_Wu16 8192.00000000 DINH_LimDFCVerb 12079.0000000 20271.0000000 FORMAT "%13.7" NUMBER 7 /end CHARACTERISTIC
/begin CHARACTERISTIC DINH_Lim.DFC_IVDiaCylShCirHSLS_5_CA "DINH/Zugeordnete Verriegelungslimits für Verriegelungsquelle DFC_IVDiaCylShCirHSLS_5" VAL_BLK 0x800284A0 ValA_Wu16 8192.00000000 DINH_LimDFCVerb 12079.0000000 20271.0000000 FORMAT "%13.7" NUMBER 7 /end CHARACTERISTIC
/begin CHARACTERISTIC DINH_Lim.DFC_IVDiaCylShCirMeas_0_CA "DINH/Zugeordnete Verriegelungslimits für Verriegelungsquelle DFC_IVDiaCylShCirMeas_0" VAL_BLK 0x800284AE ValA_Wu16 8192.00000000 DINH_LimDFCVerb 12079.0000000 20271.0000000 FORMAT "%13.7" NUMBER 5 /end CHARACTERISTIC
/begin CHARACTERISTIC DINH_Lim.DFC_IVDiaCylShCirMeas_1_CA "DINH/Zugeordnete Verriegelungslimits für Verriegelungsquelle DFC_IVDiaCylShCirMeas_1" VAL_BLK 0x800284B8 ValA_Wu16 8192.00000000 DINH_LimDFCVerb 12079.0000000 20271.0000000 FORMAT "%13.7" NUMBER 5 /end CHARACTERISTIC
/begin CHARACTERISTIC DINH_Lim.DFC_IVDiaCylShCirMeas_2_CA "DINH/Zugeordnete Verriegelungslimits für Verriegelungsquelle DFC_IVDiaCylShCirMeas_2" VAL_BLK 0x800284C2 ValA_Wu16 8192.00000000 DINH_LimDFCVerb 12079.0000000 20271.0000000 FORMAT "%13.7" NUMBER 5 /end CHARACTERISTIC
/begin CHARACTERISTIC DINH_Lim.DFC_IVDiaCylShCirMeas_3_CA "DINH/Zugeordnete Verriegelungslimits für Verriegelungsquelle DFC_IVDiaCylShCirMeas_3" VAL_BLK 0x800284CC ValA_Wu16 8192.00000000 DINH_LimDFCVerb 12079.0000000 20271.0000000 FORMAT "%13.7" NUMBER 5 /end CHARACTERISTIC
/begin CHARACTERISTIC DINH_Lim.DFC_IVDiaCylShCirMeas_4_CA "DINH/Zugeordnete Verriegelungslimits für Verriegelungsquelle DFC_IVDiaCylShCirMeas_4" VAL_BLK 0x800284D6 ValA_Wu16 8192.00000000 DINH_LimDFCVerb 12079.0000000 20271.0000000 FORMAT "%13.7" NUMBER 5 /end CHARACTERISTIC
/begin CHARACTERISTIC DINH_Lim.DFC_IVDiaCylShCirMeas_5_CA "DINH/Zugeordnete Verriegelungslimits für Verriegelungsquelle DFC_IVDiaCylShCirMeas_5" VAL_BLK 0x800284E0 ValA_Wu16 8192.00000000 DINH_LimDFCVerb 12079.0000000 20271.0000000 FORMAT "%13.7" NUMBER 5 /end CHARACTERISTIC
/begin CHARACTERISTIC DINH_Lim.DFC_LSUDynChk_CA "DINH/Zugeordnete Verriegelungslimits für Verriegelungsquelle DFC_LSUDynChk" VAL_BLK 0x800284EA ValA_Wu16 8192.00000000 DINH_LimDFCVerb 12079.0000000 20271.0000000 FORMAT "%13.7" NUMBER 6 /end CHARACTERISTIC
/begin CHARACTERISTIC DINH_Lim.DFC_LSUO2ClbMax_CA "DINH/Zugeordnete Verriegelungslimits für Verriegelungsquelle DFC_LSUO2ClbMax" VAL_BLK 0x800284F6 ValA_Wu16 8192.00000000 DINH_LimDFCVerb 12079.0000000 20271.0000000 FORMAT "%13.7" NUMBER 11 /end CHARACTERISTIC
/begin CHARACTERISTIC DINH_Lim.DFC_LSUO2ClbMin_CA "DINH/Zugeordnete Verriegelungslimits für Verriegelungsquelle DFC_LSUO2ClbMin" VAL_BLK 0x8002850C ValA_Wu16 8192.00000000 DINH_LimDFCVerb 12079.0000000 20271.0000000 FORMAT "%13.7" NUMBER 11 /end CHARACTERISTIC
/begin CHARACTERISTIC DINH_Lim.DFC_LSUO2PlausMaxFLd_CA "DINH/Zugeordnete Verriegelungslimits für Verriegelungsquelle DFC_LSUO2PlausMaxFLd" VAL_BLK 0x80028522 ValA_Wu16 8192.00000000 DINH_LimDFCVerb 12079.0000000 20271.0000000 FORMAT "%13.7" NUMBER 6 /end CHARACTERISTIC
/begin CHARACTERISTIC DINH_Lim.DFC_LSUO2PlausMaxOvrRun_CA "DINH/Zugeordnete Verriegelungslimits für Verriegelungsquelle DFC_LSUO2PlausMaxOvrRun" VAL_BLK 0x8002852E ValA_Wu16 8192.00000000 DINH_LimDFCVerb 12079.0000000 20271.0000000 FORMAT "%13.7" NUMBER 6 /end CHARACTERISTIC
/begin CHARACTERISTIC DINH_Lim.DFC_LSUO2PlausMaxPartLd_CA "DINH/Zugeordnete Verriegelungslimits für Verriegelungsquelle DFC_LSUO2PlausMaxPartLd" VAL_BLK 0x8002853A ValA_Wu16 8192.00000000 DINH_LimDFCVerb 12079.0000000 20271.0000000 FORMAT "%13.7" NUMBER 6 /end CHARACTERISTIC
/begin CHARACTERISTIC DINH_Lim.DFC_LSUO2PlausMinFLd_CA "DINH/Zugeordnete Verriegelungslimits für Verriegelungsquelle DFC_LSUO2PlausMinFLd" VAL_BLK 0x80028546 ValA_Wu16 8192.00000000 DINH_LimDFCVerb 12079.0000000 20271.0000000 FORMAT "%13.7" NUMBER 6 /end CHARACTERISTIC
/begin CHARACTERISTIC DINH_Lim.DFC_LSUO2PlausMinOvrRun_CA "DINH/Zugeordnete Verriegelungslimits für Verriegelungsquelle DFC_LSUO2PlausMinOvrRun" VAL_BLK 0x80028552 ValA_Wu16 8192.00000000 DINH_LimDFCVerb 12079.0000000 20271.0000000 FORMAT "%13.7" NUMBER 6 /end CHARACTERISTIC
/begin CHARACTERISTIC DINH_Lim.DFC_LSUO2PlausMinPartLd_CA "DINH/Zugeordnete Verriegelungslimits für Verriegelungsquelle DFC_LSUO2PlausMinPartLd" VAL_BLK 0x8002855E ValA_Wu16 8192.00000000 DINH_LimDFCVerb 12079.0000000 20271.0000000 FORMAT "%13.7" NUMBER 6 /end CHARACTERISTIC
/begin CHARACTERISTIC DINH_Lim.DFC_LSURiClbMax_CA "DINH/Zugeordnete Verriegelungslimits für Verriegelungsquelle DFC_LSURiClbMax" VAL_BLK 0x8002856A ValA_Wu16 8192.00000000 DINH_LimDFCVerb 12079.0000000 20271.0000000 FORMAT "%13.7" NUMBER 13 /end CHARACTERISTIC
/begin CHARACTERISTIC DINH_Lim.DFC_LSURiClbMin_CA "DINH/Zugeordnete Verriegelungslimits für Verriegelungsquelle DFC_LSURiClbMin" VAL_BLK 0x80028584 ValA_Wu16 8192.00000000 DINH_LimDFCVerb 12079.0000000 20271.0000000 FORMAT "%13.7" NUMBER 13 /end CHARACTERISTIC
/begin FUNCTION DINH ""
 /begin DEF_CHARACTERISTIC DINH_Lim.DFC_ComKlemmenChk_FA_CA DINH_Lim.DFC_ComKlemmenCtr_FA_CA DINH_Lim.DFC_ComKlemmenSig_FA_CA DINH_Lim.DFC_ComKlemmenTo_FA_CA DINH_Lim.DFC_ComLenkradwinkelSig_CA DINH_Lim.DFC_ComLenkradwinkelTo_CA DINH_Lim.DFC_ComMileageRangeSig_FA_CA DINH_Lim.DFC_ComMileageRangeTo_FA_CA DINH_Lim.DFC_ComPspSig_CA DINH_Lim.DFC_ComPspTo_CA DINH_Lim.DFC_ComRelTimeSig_FA_CA DINH_Lim.DFC_ComRelTimeTo_FA_CA DINH_Lim.DFC_ComRequestEMFChk_CA DINH_Lim.DFC_ComRequestEMFCtr_CA DINH_Lim.DFC_ComRequestEMFSig_CA DINH_Lim.DFC_ComRequestEMFTo_CA DINH_Lim.DFC_ComRpmWhlChk_FX_CA DINH_Lim.DFC_ComRpmWhlCtr_FX_CA DINH_Lim.DFC_ComRpmWhlTo_FX_CA DINH_Lim.DFC_ComSecCtrRelSig_FA_CA DINH_Lim.DFC_ComSecCtrRelTo_FA_CA DINH_Lim.DFC_ComSensNOxGndSig_CA DINH_Lim.DFC_ComSensNOxGndTo_CA DINH_Lim.DFC_ComSensNOxMode_CA DINH_Lim.DFC_ComSensNOxUbattSig_CA DINH_Lim.DFC_ComSensNOxUbattTo_CA DINH_Lim.DFC_ComShiftPaddleTo_FX_CA DINH_Lim.DFC_ComShutOffPSPSig_CA DINH_Lim.DFC_ComShutOffPSPTo_CA DINH_Lim.DFC_ComSlrdiGlbFZMTo_FA_CA DINH_Lim.DFC_ComSlrdiGlbFZMTo_FX_CA DINH_Lim.DFC_ComSpeedVehicleChk_FX_CA DINH_Lim.DFC_ComSpeedVehicleCtr_FX_CA DINH_Lim.DFC_ComSpeedVehicleTo_FX_CA DINH_Lim.DFC_ComStConintDSCChk_FX_CA DINH_Lim.DFC_ComStConintDSCCtr_FX_CA DINH_Lim.DFC_ComStConintDSCTo_FX_CA DINH_Lim.DFC_ComStatACFrontSig_FA_CA DINH_Lim.DFC_ComStatACFrontTo_FA_CA DINH_Lim.DFC_ComStatEkpSig_A_CA DINH_Lim.DFC_ComStatEkpTo_A_CA DINH_Lim.DFC_ComStatGearRevSig_FA_CA DINH_Lim.DFC_ComStatGearRevTo_FA_CA DINH_Lim.DFC_ComStatZVKlappenSig_FA_CA DINH_Lim.DFC_ComStatZVKlappenTo_FA_CA DINH_Lim.DFC_ComStateARSCtr_CA DINH_Lim.DFC_ComStateARSSig_CA DINH_Lim.DFC_ComStateARSTo_CA DINH_Lim.DFC_ComStateDscSig_CA DINH_Lim.DFC_ComStateDscTo_CA DINH_Lim.DFC_ComStateSeatSig_CA DINH_Lim.DFC_ComStateSeatSig_FA_CA DINH_Lim.DFC_ComStateSeatTo_CA DINH_Lim.DFC_ComStateSeatTo_FA_CA DINH_Lim.DFC_ComStatusEGSSig_A_CA DINH_Lim.DFC_ComStatusEGSSig_FA_CA DINH_Lim.DFC_ComStatusEGSTo_A_CA DINH_Lim.DFC_ComStatusEGSTo_FA_CA DINH_Lim.DFC_ComStatusEMFChk_CA DINH_Lim.DFC_ComStatusEMFCtr_CA DINH_Lim.DFC_ComStatusEMFSig_CA DINH_Lim.DFC_ComStatusEMFTo_CA DINH_Lim.DFC_ComStatusRGangSig_CA DINH_Lim.DFC_ComStatusRGangTo_CA DINH_Lim.DFC_ComSteeringAngleChk_FX_CA DINH_Lim.DFC_ComSteeringAngleCtr_FX_CA DINH_Lim.DFC_ComSteeringAngleTo_FX_CA DINH_Lim.DFC_ComTerminalChk_CA DINH_Lim.DFC_ComTerminalCtr_CA DINH_Lim.DFC_ComTerminalSig_CA DINH_Lim.DFC_ComTerminalTo_CA DINH_Lim.DFC_ComTimeDateSig_FA_CA DINH_Lim.DFC_ComTimeDateTo_FA_CA DINH_Lim.DFC_ComTrailerSig_CA DINH_Lim.DFC_ComTrailerSig_FA_CA DINH_Lim.DFC_ComTrailerTo_CA DINH_Lim.DFC_ComTrailerTo_FA_CA DINH_Lim.DFC_ComTrqDemCrshDrDyChk_FX_CA DINH_Lim.DFC_ComTrqDemCrshDrDyCtr_FX_CA DINH_Lim.DFC_ComTrqDemCrshDrDyTo_FX_CA DINH_Lim.DFC_ComTrqDemandDesSig_CA DINH_Lim.DFC_ComTrqDemandDesTo_CA DINH_Lim.DFC_ComTrqDemandDscChk_CA DINH_Lim.DFC_ComTrqDemandDscCtr_CA DINH_Lim.DFC_ComTrqDemandDscSig_CA DINH_Lim.DFC_ComTrqDemandDscTo_CA DINH_Lim.DFC_ComTrqDemandGbxChk_A_CA DINH_Lim.DFC_ComTrqDemandGbxChk_FA_CA DINH_Lim.DFC_ComTrqDemandGbxCtr_A_CA DINH_Lim.DFC_ComTrqDemandGbxCtr_FA_CA DINH_Lim.DFC_ComTrqDemandGbxSig_A_CA DINH_Lim.DFC_ComTrqDemandGbxSig_FA_CA DINH_Lim.DFC_ComTrqDemandGbxTo_A_CA DINH_Lim.DFC_ComTrqDemandGbxTo_FA_CA DINH_Lim.DFC_ComTrqWhlDemChk_CA DINH_Lim.DFC_ComTrqWhlDemCtr_CA DINH_Lim.DFC_ComTrqWhlDemFASChk_FX_CA DINH_Lim.DFC_ComTrqWhlDemFASCtr_FX_CA DINH_Lim.DFC_ComTrqWhlDemFASTo_FX_CA DINH_Lim.DFC_ComTrqWhlDemSig_CA DINH_Lim.DFC_ComTrqWhlDemTo_CA DINH_Lim.DFC_ComVelocityChk_FA_CA DINH_Lim.DFC_ComVelocityCtr_FA_CA DINH_Lim.DFC_ComVelocitySig_CA DINH_Lim.DFC_ComVelocitySig_FA_CA DINH_Lim.DFC_ComVelocityTo_CA DINH_Lim.DFC_ComVelocityTo_FA_CA DINH_Lim.DFC_ComVerbraucherTo_CA DINH_Lim.DFC_ComWMomPTStabChk_FX_CA DINH_Lim.DFC_ComWMomPTStabCtr_FX_CA DINH_Lim.DFC_ComWMomPTStabTo_FX_CA DINH_Lim.DFC_ComWheelSpeedSig_CA DINH_Lim.DFC_ComWheelSpeedTo_CA DINH_Lim.DFC_ComZvKlappenSig_CA DINH_Lim.DFC_ComZvKlappenTo_CA DINH_Lim.DFC_ComaDirectChk_FX_CA DINH_Lim.DFC_ComaDirectCtr_FX_CA DINH_Lim.DFC_ComaDirectTo_FX_CA DINH_Lim.DFC_ComaSideChk_FX_CA DINH_Lim.DFC_ComaSideCtr_FX_CA DINH_Lim.DFC_ComaSideTo_FX_CA DINH_Lim.DFC_Cy320SpiCom_CA DINH_Lim.DFC_ETCtlDvtInrMax_CA DINH_Lim.DFC_ETCtlDvtInrMin_CA DINH_Lim.DFC_ETCtlDvtOutrMax_CA DINH_Lim.DFC_ETCtlDvtOutrMin_CA DINH_Lim.DFC_FBCqDvtMax_CA DINH_Lim.DFC_FBCqDvtMin_CA DINH_Lim.DFC_Fan4WinErr1_CA DINH_Lim.DFC_Fan4WinErr2_CA DINH_Lim.DFC_Fan4WinErr3_CA DINH_Lim.DFC_Fan4WinErr4_CA DINH_Lim.DFC_FanSCG_CA DINH_Lim.DFC_FlFCBS_CA DINH_Lim.DFC_GlwEcuConfigErr_CA DINH_Lim.DFC_GlwEcuEepErr_CA DINH_Lim.DFC_GlwEcuFrmErr_CA DINH_Lim.DFC_GlwEcuGPCMFaultInfo_CA DINH_Lim.DFC_GlwEcuGPCMInfo_CA DINH_Lim.DFC_GlwEcuGk1HSS_CA DINH_Lim.DFC_GlwEcuGk1OL_CA DINH_Lim.DFC_GlwEcuGk1SC_CA DINH_Lim.DFC_GlwEcuGk1Wdst_CA DINH_Lim.DFC_GlwEcuGk2HSS_CA DINH_Lim.DFC_GlwEcuGk2OL_CA DINH_Lim.DFC_GlwEcuGk2SC_CA DINH_Lim.DFC_GlwEcuGk2Wdst_CA DINH_Lim.DFC_GlwEcuGk3HSS_CA DINH_Lim.DFC_GlwEcuGk3OL_CA DINH_Lim.DFC_GlwEcuGk3SC_CA DINH_Lim.DFC_GlwEcuGk3Wdst_CA DINH_Lim.DFC_GlwEcuGk4HSS_CA DINH_Lim.DFC_GlwEcuGk4OL_CA DINH_Lim.DFC_GlwEcuGk4SC_CA DINH_Lim.DFC_GlwEcuGk4Wdst_CA DINH_Lim.DFC_GlwEcuGk5HSS_CA DINH_Lim.DFC_GlwEcuGk5OL_CA DINH_Lim.DFC_GlwEcuGk5SC_CA DINH_Lim.DFC_GlwEcuGk5Wdst_CA DINH_Lim.DFC_GlwEcuGk6HSS_CA DINH_Lim.DFC_GlwEcuGk6OL_CA DINH_Lim.DFC_GlwEcuGk6SC_CA DINH_Lim.DFC_GlwEcuGk6Wdst_CA DINH_Lim.DFC_GlwEcuGndErr_CA DINH_Lim.DFC_GlwEcuIntErr_CA DINH_Lim.DFC_GlwEcuMsgTimeout_CA DINH_Lim.DFC_GlwEcuT30Err_CA DINH_Lim.DFC_GlwEcuTempErr_CA DINH_Lim.DFC_GlwEcuUdiffT30_CA DINH_Lim.DFC_IBSComErr_CA DINH_Lim.DFC_LubSRCOilFldtCrit_CA DINH_Lim.DFC_LubSRCOilFldtCritDflMin_CA DINH_Lim.DFC_LubSRCOilLvlCritMax_CA DINH_Lim.DFC_LubSRCOilLvlCritMin_CA DINH_Lim.DFC_LubSRCTot_CA DINH_Lim.DFC_MonUMaxSupply1_CA DINH_Lim.DFC_MonUMinSupply1_CA DINH_Lim.DFC_OilComNpl_CA DINH_Lim.DFC_PCBS_CA DINH_Lim.DFC_PCBSPFltChg_CA DINH_Lim.DFC_PCRGovDvtLPMax_CA DINH_Lim.DFC_PCRGovDvtLPMin_CA DINH_Lim.DFC_PCRGovDvtMax_CA DINH_Lim.DFC_PCRGovDvtMin_CA DINH_Lim.DFC_PFltAPSPlausMAX_CA DINH_Lim.DFC_PFltAPSPlausMIN_CA DINH_Lim.DFC_PFltBPSPlausMAX_CA DINH_Lim.DFC_PFltBPSPlausMIN_CA DINH_Lim.DFC_PFltOvldInhRgn_CA DINH_Lim.DFC_PFltOvldTrqLim_CA DINH_Lim.DFC_PFltPresPlausMAX_CA DINH_Lim.DFC_PFltPresPlausMIN_CA DINH_Lim.DFC_PFltTraRpmRdc_CA DINH_Lim.DFC_PFlt_tOxiPreMax_CA DINH_Lim.DFC_PFlt_tOxiPreMaxRgn_CA DINH_Lim.DFC_PFlt_tOxiPreNpl_CA DINH_Lim.DFC_PFlt_tPreMax_CA DINH_Lim.DFC_PFlt_tPreMaxRgn_CA DINH_Lim.DFC_PFlt_tPreNpl_CA DINH_Lim.DFC_PFltmSotDiffMAX_CA DINH_Lim.DFC_PFltmSotDiffMIN_CA DINH_Lim.DFC_PFltmSotDiffSIG_CA DINH_Lim.DFC_PIntkVUsEnvPPls_CA DINH_Lim.DFC_PresPlausDblDef_CA DINH_Lim.DFC_RailCPC1_CA DINH_Lim.DFC_RailCPC3_CA DINH_Lim.DFC_RailCPC4_CA DINH_Lim.DFC_RailMeUn0_CA DINH_Lim.DFC_RailMeUn1_CA DINH_Lim.DFC_RailMeUn2_CA DINH_Lim.DFC_RailMeUn22_CA DINH_Lim.DFC_RailMeUn3_CA DINH_Lim.DFC_RailMeUn4_CA DINH_Lim.DFC_RailMeUn42_CA DINH_Lim.DFC_RailMeUn5_CA DINH_Lim.DFC_RailPCV0_CA DINH_Lim.DFC_RailPCV1_CA DINH_Lim.DFC_RailPCV2_CA DINH_Lim.DFC_RailPCV22_CA DINH_Lim.DFC_RailPCV3_CA DINH_Lim.DFC_RailPCV4_CA DINH_Lim.DFC_RailPCV42_CA DINH_Lim.DFC_RailPMonStrt_CA DINH_Lim.DFC_SSpMon1_CA DINH_Lim.DFC_SSpMon2_CA DINH_Lim.DFC_SSpMon3_CA DINH_Lim.DFC_ThrVlv4WinErr1_CA DINH_Lim.DFC_ThrVlv4WinErr2_CA DINH_Lim.DFC_ThrVlv4WinErr3_CA DINH_Lim.DFC_ThrVlv4WinErr4_CA DINH_Lim.DFC_ThrVlvSCG_CA DINH_Lim.DFC_Tle6232Spi1_CA DINH_Lim.DFC_TrbCh4WinErr1_CA DINH_Lim.DFC_TrbCh4WinErr2_CA DINH_Lim.DFC_TrbCh4WinErr3_CA DINH_Lim.DFC_TrbCh4WinErr4_CA DINH_Lim.DFC_TrbChSCG_CA DINH_Lim.DFC_TrbChSRCMax_CA DINH_Lim.DFC_TrbChSRCMin_CA DINH_Lim.DFC_WaHtEl4WinErr1_CA DINH_Lim.DFC_WaHtEl4WinErr2_CA DINH_Lim.DFC_WaHtEl4WinErr3_CA DINH_Lim.DFC_WaHtEl4WinErr4_CA DINH_Lim.DFC_WaHtElSCG_CA DINH_Lim.DFC_ETClbETFltMax_0_CA DINH_Lim.DFC_ETClbETFltMax_1_CA DINH_Lim.DFC_ETClbETFltMax_2_CA DINH_Lim.DFC_ETClbETFltMax_3_CA DINH_Lim.DFC_ETClbETFltMax_4_CA DINH_Lim.DFC_ETClbETFltMax_5_CA DINH_Lim.DFC_ETClbETFltMin_0_CA DINH_Lim.DFC_ETClbETFltMin_1_CA DINH_Lim.DFC_ETClbETFltMin_2_CA DINH_Lim.DFC_ETClbETFltMin_3_CA DINH_Lim.DFC_ETClbETFltMin_4_CA DINH_Lim.DFC_ETClbETFltMin_5_CA DINH_Lim.DFC_InjCrvInjLimChrgBal_CA DINH_Lim.DFC_InjCrvInjLimQntBal_CA DINH_Lim.DFC_InjCrvInjLimSys_CA DINH_Lim.DFC_InjCrvNumInjRtmLim_CA DINH_Lim.DFC_LSUHtCoupSig_CA DINH_Lim.DFC_AFS_SSpShOffOL_CA DINH_Lim.DFC_AFS_SSpShOffOvrTemp_CA DINH_Lim.DFC_AFS_SSpShOffSCB_CA DINH_Lim.DFC_AFS_SSpShOffSCG_CA DINH_Lim.DFC_AirCCmprOL_CA DINH_Lim.DFC_AirCCmprOvrTemp_CA DINH_Lim.DFC_AirCCmprSCB_CA DINH_Lim.DFC_AirCCmprSCG_CA DINH_Lim.DFC_CByVlvOL_CA DINH_Lim.DFC_CByVlvOvrTemp_CA DINH_Lim.DFC_CByVlvSCB_CA DINH_Lim.DFC_CByVlvSCG_CA DINH_Lim.DFC_CThmstOL_CA DINH_Lim.DFC_CThmstOvrTemp_CA DINH_Lim.DFC_CThmstSCB_CA DINH_Lim.DFC_CThmstSCG_CA DINH_Lim.DFC_DSMDummy_CA DINH_Lim.DFC_EBxFanOL_CA DINH_Lim.DFC_EBxFanOvrTemp_CA DINH_Lim.DFC_EBxFanSCB_CA DINH_Lim.DFC_EBxFanSCG_CA DINH_Lim.DFC_ECBVlvOL_CA DINH_Lim.DFC_ECBVlvOvrTemp_CA DINH_Lim.DFC_ECBVlvSCB_CA DINH_Lim.DFC_ECBVlvSCG_CA DINH_Lim.DFC_EMDmpOL_0_CA DINH_Lim.DFC_EMDmpOL_1_CA DINH_Lim.DFC_EMDmpOvrTemp_0_CA DINH_Lim.DFC_EMDmpOvrTemp_1_CA DINH_Lim.DFC_EMDmpSCB_0_CA DINH_Lim.DFC_EMDmpSCB_1_CA DINH_Lim.DFC_EMDmpSCG_0_CA DINH_Lim.DFC_EMDmpSCG_1_CA DINH_Lim.DFC_EngStAOL_CA DINH_Lim.DFC_EngStAOvrTemp_CA DINH_Lim.DFC_EngStASCB_CA DINH_Lim.DFC_EngStASCG_CA DINH_Lim.DFC_FanOL_CA DINH_Lim.DFC_FanOvrTemp_CA DINH_Lim.DFC_FanSCB_CA DINH_Lim.DFC_FlFltHtOL_CA DINH_Lim.DFC_FlFltHtOvrTemp_CA DINH_Lim.DFC_FlFltHtSCB_CA DINH_Lim.DFC_FlFltHtSCG_CA DINH_Lim.DFC_LSUHtrMax_CA DINH_Lim.DFC_LSUHtrMin_CA DINH_Lim.DFC_LSUHtrNpl_CA DINH_Lim.DFC_LSUHtrSig_CA DINH_Lim.DFC_LSUtExcMax_CA DINH_Lim.DFC_LSUtExcMin_CA DINH_Lim.DFC_MeUnOL_CA DINH_Lim.DFC_MeUnSCB_CA DINH_Lim.DFC_MeUnSRCMax_CA DINH_Lim.DFC_MeUnSRCMin_CA DINH_Lim.DFC_PCVOL_CA DINH_Lim.DFC_PCVSCB_CA DINH_Lim.DFC_PCVSRCMax_CA DINH_Lim.DFC_PCVSRCMin_CA DINH_Lim.DFC_RailPSRCMax_CA DINH_Lim.DFC_RailPSRCMin_CA DINH_Lim.DFC_ShtrOL_CA DINH_Lim.DFC_ShtrOvrTemp_CA DINH_Lim.DFC_ShtrSCB_CA DINH_Lim.DFC_ShtrSCG_CA DINH_Lim.DFC_StrtOL_CA DINH_Lim.DFC_StrtOvrTemp_CA DINH_Lim.DFC_StrtSCB_CA DINH_Lim.DFC_StrtSCG_CA DINH_Lim.DFC_ThrVlvOL_CA DINH_Lim.DFC_ThrVlvOvrTemp_CA DINH_Lim.DFC_ThrVlvSCB_CA DINH_Lim.DFC_TrbChOL_CA DINH_Lim.DFC_TrbChOvrTemp_CA DINH_Lim.DFC_TrbChSCB_CA DINH_Lim.DFC_UDosVlvOL_CA DINH_Lim.DFC_UDosVlvOvrTemp_CA DINH_Lim.DFC_UDosVlvSCB_CA DINH_Lim.DFC_UDosVlvSCG_CA DINH_Lim.DFC_UPmpMotOL_CA DINH_Lim.DFC_UPmpMotOvrTemp_CA DINH_Lim.DFC_UPmpMotSCB_CA DINH_Lim.DFC_UPmpMotSCG_CA DINH_Lim.DFC_WaHtElOL_CA DINH_Lim.DFC_WaHtElOvrTemp_CA DINH_Lim.DFC_WaHtElSCB_CA DINH_Lim.DFC_IVActrUChSRCMax_CA DINH_Lim.DFC_IVActrUChSRCMin_CA DINH_Lim.DFC_IVActrVltgSRCMax_CA DINH_Lim.DFC_IVActrVltgSRCMin_CA DINH_Lim.DFC_IVDiaTunDet_CA DINH_Lim.DFC_IVPSplyStopDCDC_CA DINH_Lim.DFC_IVPSplyVltgSRCMax_CA DINH_Lim.DFC_IVPSplyVltgSRCMin_CA DINH_Lim.DFC_SCREtaErr_CA DINH_Lim.DFC_SCREtaErr1_CA DINH_Lim.DFC_SCREtaErr2_CA DINH_Lim.DFC_SCRMonMetCtlPresErr_CA DINH_Lim.DFC_SCRMonPresBuildUpErr_CA DINH_Lim.DFC_SCRMonPresRdcErr_CA DINH_Lim.DFC_AFSOffsDrftMax_CA DINH_Lim.DFC_AFSOffsDrftMin_CA DINH_Lim.DFC_AFSSRCCorMax_CA DINH_Lim.DFC_AFSSRCCorMin_CA DINH_Lim.DFC_AFSSRCRawMax_CA DINH_Lim.DFC_AFSSRCRawMin_CA DINH_Lim.DFC_AFSSetyDrftMax_CA DINH_Lim.DFC_AFSSetyDrftMin_CA DINH_Lim.DFC_AirCSwtNpl_CA DINH_Lim.DFC_AirCSwtSig_CA DINH_Lim.DFC_BattUSRCMax_CA DINH_Lim.DFC_BattUSRCMin_CA DINH_Lim.DFC_BrkNpl_CA DINH_Lim.DFC_BrkPSRCMax_CA DINH_Lim.DFC_BrkPSRCMin_CA DINH_Lim.DFC_CEngDsTSRCMax_CA DINH_Lim.DFC_CEngDsTSRCMin_CA DINH_Lim.DFC_CrCUIDet_CA DINH_Lim.DFC_ECBVlvSRCMax_CA DINH_Lim.DFC_ECBVlvSRCMin_CA DINH_Lim.DFC_ECUOvrTemp_CA DINH_Lim.DFC_EGRVlvGovDvtMax_CA DINH_Lim.DFC_EGRVlvGovDvtMin_CA DINH_Lim.DFC_EGRVlvHBrgOpnLd_CA DINH_Lim.DFC_EGRVlvHBrgOvrCurr_CA DINH_Lim.DFC_EGRVlvHBrgOvrTemp_CA DINH_Lim.DFC_EGRVlvHBrgShCirBatt1_CA DINH_Lim.DFC_EGRVlvHBrgShCirBatt2_CA DINH_Lim.DFC_EGRVlvHBrgShCirGnd1_CA DINH_Lim.DFC_EGRVlvHBrgShCirGnd2_CA DINH_Lim.DFC_EGRVlvHBrgShCirOvrLd_CA DINH_Lim.DFC_EGRVlvHBrgTempOvrCurr_CA DINH_Lim.DFC_EGRVlvHBrgUndrVltg_CA DINH_Lim.DFC_EGRVlvLPGovDvtMax_CA DINH_Lim.DFC_EGRVlvLPGovDvtMin_CA DINH_Lim.DFC_EGRVlvLPHBrgOpnLd_CA DINH_Lim.DFC_EGRVlvLPHBrgOvrCurr_CA DINH_Lim.DFC_EGRVlvLPHBrgOvrTemp_CA DINH_Lim.DFC_EGRVlvLPHBrgShCirBatt1_CA DINH_Lim.DFC_EGRVlvLPHBrgShCirBatt2_CA DINH_Lim.DFC_EGRVlvLPHBrgShCirGnd1_CA DINH_Lim.DFC_EGRVlvLPHBrgShCirGnd2_CA DINH_Lim.DFC_EGRVlvLPHBrgShCirOvrLd_CA DINH_Lim.DFC_EGRVlvLPHBrgTempOvrCurr_CA DINH_Lim.DFC_EGRVlvLPHBrgUndrVltg_CA DINH_Lim.DFC_EGRVlvLPOL_CA DINH_Lim.DFC_EGRVlvLPSCB_CA DINH_Lim.DFC_EGRVlvLPSCG_CA DINH_Lim.DFC_EGRVlvLPSRCMax_CA DINH_Lim.DFC_EGRVlvLPSRCMin_CA DINH_Lim.DFC_EGRVlvOL_CA DINH_Lim.DFC_EGRVlvSCB_CA DINH_Lim.DFC_EGRVlvSCG_CA DINH_Lim.DFC_EGRVlvSRCMax_CA DINH_Lim.DFC_EGRVlvSRCMin_CA DINH_Lim.DFC_EngPrtOvrSpd_CA DINH_Lim.DFC_EngSpdOL_CA DINH_Lim.DFC_EngSpdSCB_CA DINH_Lim.DFC_EngSpdSCG_CA DINH_Lim.DFC_EnhSRCMaxPPFltDiff_CA DINH_Lim.DFC_EnhSRCMaxT1ExhTMon_CA DINH_Lim.DFC_EnhSRCMaxT2ExhTMon_CA DINH_Lim.DFC_EnhSRCMaxT3ExhTMon_CA DINH_Lim.DFC_EnhSRCMinPPFltDiff_CA DINH_Lim.DFC_EnhSRCMinT1ExhTMon_CA DINH_Lim.DFC_EnhSRCMinT2ExhTMon_CA DINH_Lim.DFC_EnhSRCMinT3ExhTMon_CA DINH_Lim.DFC_EnvPSRCMax_CA DINH_Lim.DFC_EnvPSRCMin_CA DINH_Lim.DFC_ExhTMonPlaus_CA DINH_Lim.DFC_ExhTMonPlausPos1_CA DINH_Lim.DFC_ExhTMonPlausPos2_CA DINH_Lim.DFC_ExhTMonPlausPos3_CA DINH_Lim.DFC_ExhTMonT1Plaus_CA DINH_Lim.DFC_ExhTMonT2Plaus_CA DINH_Lim.DFC_ExhTMonT3Plaus_CA DINH_Lim.DFC_FlFltDsPSRCMax_CA DINH_Lim.DFC_FlFltDsPSRCMin_CA DINH_Lim.DFC_FlFltSig_CA DINH_Lim.DFC_FlFltUsPSRCMax_CA DINH_Lim.DFC_FlFltUsPSRCMin_CA DINH_Lim.DFC_FuelTSRCMax_CA DINH_Lim.DFC_FuelTSRCMin_CA DINH_Lim.DFC_GbxNPosPPerSRCMax_CA DINH_Lim.DFC_GbxNPosPPerSRCMin_CA DINH_Lim.DFC_GbxNPosPdcycSRCMax_CA DINH_Lim.DFC_GbxNPosPdcycSRCMin_CA DINH_Lim.DFC_InjVlvPresMin_CA DINH_Lim.DFC_LSUCircNernstSig_CA DINH_Lim.DFC_LSUCircPmpCurSig_CA DINH_Lim.DFC_LSUCircVirtGndSig_CA DINH_Lim.DFC_LSUO2Max_CA DINH_Lim.DFC_LSUO2Min_CA DINH_Lim.DFC_LSUSPIBattLowMin_CA DINH_Lim.DFC_LSUWireSCB_CA DINH_Lim.DFC_LSUWireSCG_CA DINH_Lim.DFC_MeUnSCG_CA DINH_Lim.DFC_NSCDsCmpChk_CA DINH_Lim.DFC_NSCDsLamBinSRCMax_CA DINH_Lim.DFC_NSCDsLamBinSRCMin_CA DINH_Lim.DFC_NSCDsLamLinSRCMax_CA DINH_Lim.DFC_NSCDsLamLinSRCMin_CA DINH_Lim.DFC_NSCDsLamPlausMax_CA DINH_Lim.DFC_NSCDsLamPlausMin_CA DINH_Lim.DFC_NSCDsNOxSRCMax_CA DINH_Lim.DFC_NSCDsNOxSRCMin_CA DINH_Lim.DFC_NSCDsOpCir_CA DINH_Lim.DFC_NSCDsShCir_CA DINH_Lim.DFC_NoCat2DsCmpChk_CA DINH_Lim.DFC_NoCat2DsLamBinSRCMax_CA DINH_Lim.DFC_NoCat2DsLamBinSRCMin_CA DINH_Lim.DFC_NoCat2DsLamLinSRCMax_CA DINH_Lim.DFC_NoCat2DsLamLinSRCMin_CA DINH_Lim.DFC_NoCat2DsLamPlausMax_CA DINH_Lim.DFC_NoCat2DsLamPlausMin_CA DINH_Lim.DFC_NoCat2DsNOxSRCMax_CA DINH_Lim.DFC_NoCat2DsNOxSRCMin_CA DINH_Lim.DFC_NoCat2DsOpCir_CA DINH_Lim.DFC_NoCat2DsShCir_CA DINH_Lim.DFC_NplDynPPFltDiff_CA DINH_Lim.DFC_NplHsChngPPFltDiff_CA DINH_Lim.DFC_NplHsLnPPFltDiff_CA DINH_Lim.DFC_NplTOxiCatUs_CA DINH_Lim.DFC_NplTPFltUs_CA DINH_Lim.DFC_NplTTrbnUs_CA DINH_Lim.DFC_OilPSwmpSRCMax_CA DINH_Lim.DFC_OilPSwmpSRCMin_CA DINH_Lim.DFC_PCVSCG_CA DINH_Lim.DFC_PFltCharPDiffMin_CA DINH_Lim.DFC_PFltDstrMin_CA DINH_Lim.DFC_PFltEngPrt_CA DINH_Lim.DFC_PFltRgnPerm_CA DINH_Lim.DFC_PFltSRCMaxFlwRstn_CA DINH_Lim.DFC_PFltSRCMinFlwRstn_CA DINH_Lim.DFC_PFltSotMsDvtMax_CA DINH_Lim.DFC_PFltSotMsDvtMin_CA DINH_Lim.DFC_PFltSotMsMax_CA DINH_Lim.DFC_PIntkVUsSRCMax_CA DINH_Lim.DFC_PIntkVUsSRCMin_CA DINH_Lim.DFC_SRCHighAPP1_CA DINH_Lim.DFC_SRCHighAPP2_CA DINH_Lim.DFC_SRCLowAPP1_CA DINH_Lim.DFC_SRCLowAPP2_CA DINH_Lim.DFC_SRCMaxPPFltDiff_CA DINH_Lim.DFC_SRCMaxPPFltUs_CA DINH_Lim.DFC_SRCMaxTECU_CA DINH_Lim.DFC_SRCMaxTOxiCatUs_CA DINH_Lim.DFC_SRCMaxTPFltUs_CA DINH_Lim.DFC_SRCMaxTTrbnUs_CA DINH_Lim.DFC_SRCMaxUCatUsT_CA DINH_Lim.DFC_SRCMaxUPmpP_CA DINH_Lim.DFC_SRCMinPPFltDiff_CA DINH_Lim.DFC_SRCMinPPFltUs_CA DINH_Lim.DFC_SRCMinTECU_CA DINH_Lim.DFC_SRCMinTOxiCatUs_CA DINH_Lim.DFC_SRCMinTPFltUs_CA DINH_Lim.DFC_SRCMinTTrbnUs_CA DINH_Lim.DFC_SRCMinUCatUsT_CA DINH_Lim.DFC_SRCMinUPmpP_CA DINH_Lim.DFC_SigUCatUsT_CA DINH_Lim.DFC_SigUPmpP_CA DINH_Lim.DFC_SyncAPP_CA DINH_Lim.DFC_T15Npl_CA DINH_Lim.DFC_TAFSDtyCycHi_CA DINH_Lim.DFC_TAFSDtyCycLo_CA DINH_Lim.DFC_TAFSPerHi_CA DINH_Lim.DFC_TAFSPerLo_CA DINH_Lim.DFC_TCACDsSRCMax_CA DINH_Lim.DFC_TCACDsSRCMin_CA DINH_Lim.DFC_ThrVlvSRCMax_CA DINH_Lim.DFC_ThrVlvSRCMin_CA DINH_Lim.DFC_TrbChLPOL_CA DINH_Lim.DFC_TrbChLPSCB_CA DINH_Lim.DFC_TrbChLPSCG_CA DINH_Lim.DFC_UHtrPLOL_CA DINH_Lim.DFC_UHtrPLSCB_CA DINH_Lim.DFC_UHtrPLSCG_CA DINH_Lim.DFC_UHtrPLSRCMaxDia_CA DINH_Lim.DFC_UHtrPLSRCMinDia_CA DINH_Lim.DFC_UHtrTnkOL_CA DINH_Lim.DFC_UHtrTnkSCB_CA DINH_Lim.DFC_UHtrTnkSCG_CA DINH_Lim.DFC_UHtrTnkSRCMaxDia_CA DINH_Lim.DFC_UHtrTnkSRCMinDia_CA DINH_Lim.DFC_URevVlvOL_CA DINH_Lim.DFC_URevVlvSCB_CA DINH_Lim.DFC_URevVlvSCG_CA DINH_Lim.DFC_UTnkTSRCMax_CA DINH_Lim.DFC_UTnkTSRCMin_CA DINH_Lim.DFC_UTnkTSig_CA DINH_Lim.DFC_VSwVlvGovDvtMax_CA DINH_Lim.DFC_VSwVlvGovDvtMin_CA DINH_Lim.DFC_VSwVlvHBrgOpnLd_CA DINH_Lim.DFC_VSwVlvHBrgOvrCurr_CA DINH_Lim.DFC_VSwVlvHBrgOvrTemp_CA DINH_Lim.DFC_VSwVlvHBrgShCirBatt1_CA DINH_Lim.DFC_VSwVlvHBrgShCirBatt2_CA DINH_Lim.DFC_VSwVlvHBrgShCirGnd1_CA DINH_Lim.DFC_VSwVlvHBrgShCirGnd2_CA DINH_Lim.DFC_VSwVlvHBrgShCirOvrLd_CA DINH_Lim.DFC_VSwVlvHBrgTempOvrCurr_CA DINH_Lim.DFC_VSwVlvHBrgUndrVltg_CA DINH_Lim.DFC_VSwVlvOL_CA DINH_Lim.DFC_VSwVlvSCB_CA DINH_Lim.DFC_VSwVlvSCG_CA DINH_Lim.DFC_VSwVlvSRCMax_CA DINH_Lim.DFC_VSwVlvSRCMin_CA DINH_Lim.DFC_ClthNpl_CA DINH_Lim.DFC_ETClbETMax_0_CA DINH_Lim.DFC_ETClbETMax_1_CA DINH_Lim.DFC_ETClbETMax_2_CA DINH_Lim.DFC_ETClbETMax_3_CA DINH_Lim.DFC_ETClbETMax_4_CA DINH_Lim.DFC_ETClbETMax_5_CA DINH_Lim.DFC_ETClbETMin_0_CA DINH_Lim.DFC_ETClbETMin_1_CA DINH_Lim.DFC_ETClbETMin_2_CA DINH_Lim.DFC_ETClbETMin_3_CA DINH_Lim.DFC_ETClbETMin_4_CA DINH_Lim.DFC_ETClbETMin_5_CA DINH_Lim.DFC_IVActrEnrgMax_0_CA DINH_Lim.DFC_IVActrEnrgMax_1_CA DINH_Lim.DFC_IVActrEnrgMax_2_CA DINH_Lim.DFC_IVActrEnrgMax_3_CA DINH_Lim.DFC_IVActrEnrgMax_4_CA DINH_Lim.DFC_IVActrEnrgMax_5_CA DINH_Lim.DFC_IVActrEnrgMax_6_CA DINH_Lim.DFC_IVActrEnrgMax_7_CA DINH_Lim.DFC_IVActrEnrgMin_0_CA DINH_Lim.DFC_IVActrEnrgMin_1_CA DINH_Lim.DFC_IVActrEnrgMin_2_CA DINH_Lim.DFC_IVActrEnrgMin_3_CA DINH_Lim.DFC_IVActrEnrgMin_4_CA DINH_Lim.DFC_IVActrEnrgMin_5_CA DINH_Lim.DFC_IVActrEnrgMin_6_CA DINH_Lim.DFC_IVActrEnrgMin_7_CA DINH_Lim.DFC_IVActrEnrgPlaus_0_CA DINH_Lim.DFC_IVActrEnrgPlaus_1_CA DINH_Lim.DFC_IVActrEnrgPlaus_2_CA DINH_Lim.DFC_IVActrEnrgPlaus_3_CA DINH_Lim.DFC_IVActrEnrgPlaus_4_CA DINH_Lim.DFC_IVActrEnrgPlaus_5_CA DINH_Lim.DFC_IVActrEnrgPlaus_6_CA DINH_Lim.DFC_IVActrEnrgPlaus_7_CA DINH_Lim.DFC_IVCtlTiDiff_0_CA DINH_Lim.DFC_IVCtlTiDiff_1_CA DINH_Lim.DFC_IVCtlTiDiff_2_CA DINH_Lim.DFC_IVCtlTiDiff_3_CA DINH_Lim.DFC_IVCtlTiDiff_4_CA DINH_Lim.DFC_IVCtlTiDiff_5_CA DINH_Lim.DFC_IVCtlUDiffUp_0_CA DINH_Lim.DFC_IVCtlUDiffUp_1_CA DINH_Lim.DFC_IVCtlUDiffUp_2_CA DINH_Lim.DFC_IVCtlUDiffUp_3_CA DINH_Lim.DFC_IVCtlUDiffUp_4_CA DINH_Lim.DFC_IVCtlUDiffUp_5_CA DINH_Lim.DFC_IVCtlUUp_0_CA DINH_Lim.DFC_IVCtlUUp_1_CA DINH_Lim.DFC_IVCtlUUp_2_CA DINH_Lim.DFC_IVCtlUUp_3_CA DINH_Lim.DFC_IVCtlUUp_4_CA DINH_Lim.DFC_IVCtlUUp_5_CA DINH_Lim.DFC_IVDiaBnkShCir_0_CA DINH_Lim.DFC_IVDiaBnkShCir_1_CA DINH_Lim.DFC_IVDiaBnkShCirChSwt_0_CA DINH_Lim.DFC_IVDiaBnkShCirChSwt_1_CA DINH_Lim.DFC_IVDiaChp_0_CA DINH_Lim.DFC_IVDiaChp_1_CA DINH_Lim.DFC_IVDiaCylNoCls_0_CA DINH_Lim.DFC_IVDiaCylNoCls_1_CA DINH_Lim.DFC_IVDiaCylNoCls_2_CA DINH_Lim.DFC_IVDiaCylNoCls_3_CA DINH_Lim.DFC_IVDiaCylNoCls_4_CA DINH_Lim.DFC_IVDiaCylNoCls_5_CA DINH_Lim.DFC_IVDiaCylNoLd_0_CA DINH_Lim.DFC_IVDiaCylNoLd_1_CA DINH_Lim.DFC_IVDiaCylNoLd_2_CA DINH_Lim.DFC_IVDiaCylNoLd_3_CA DINH_Lim.DFC_IVDiaCylNoLd_4_CA DINH_Lim.DFC_IVDiaCylNoLd_5_CA DINH_Lim.DFC_IVDiaCylShCir_0_CA DINH_Lim.DFC_IVDiaCylShCir_1_CA DINH_Lim.DFC_IVDiaCylShCir_2_CA DINH_Lim.DFC_IVDiaCylShCir_3_CA DINH_Lim.DFC_IVDiaCylShCir_4_CA DINH_Lim.DFC_IVDiaCylShCir_5_CA DINH_Lim.DFC_IVDiaCylShCirHSLS_0_CA DINH_Lim.DFC_IVDiaCylShCirHSLS_1_CA DINH_Lim.DFC_IVDiaCylShCirHSLS_2_CA DINH_Lim.DFC_IVDiaCylShCirHSLS_3_CA DINH_Lim.DFC_IVDiaCylShCirHSLS_4_CA DINH_Lim.DFC_IVDiaCylShCirHSLS_5_CA DINH_Lim.DFC_IVDiaCylShCirMeas_0_CA DINH_Lim.DFC_IVDiaCylShCirMeas_1_CA DINH_Lim.DFC_IVDiaCylShCirMeas_2_CA DINH_Lim.DFC_IVDiaCylShCirMeas_3_CA DINH_Lim.DFC_IVDiaCylShCirMeas_4_CA DINH_Lim.DFC_IVDiaCylShCirMeas_5_CA DINH_Lim.DFC_LSUDynChk_CA DINH_Lim.DFC_LSUO2ClbMax_CA DINH_Lim.DFC_LSUO2ClbMin_CA DINH_Lim.DFC_LSUO2PlausMaxFLd_CA DINH_Lim.DFC_LSUO2PlausMaxOvrRun_CA DINH_Lim.DFC_LSUO2PlausMaxPartLd_CA DINH_Lim.DFC_LSUO2PlausMinFLd_CA DINH_Lim.DFC_LSUO2PlausMinOvrRun_CA DINH_Lim.DFC_LSUO2PlausMinPartLd_CA DINH_Lim.DFC_LSURiClbMax_CA DINH_Lim.DFC_LSURiClbMin_CA /end DEF_CHARACTERISTIC
/end FUNCTION
/begin COMPU_METHOD DINH_LimDFCVerb "" TAB_VERB "%6.3" "-" COMPU_TAB_REF DINH_LimDFCVerb /end COMPU_METHOD
/begin COMPU_VTAB DINH_LimDFCVerb "" TAB_VERB 19 12079 "Def0_Deb0" 12083 "Def25_Deb0" 12087 "Def50_Deb0" 12091 "Def75_Deb0" 12094 "Def100_Deb0" 12111 "NotTested" 13111 "Def50_Deb25" 13115 "Def75_Deb25" 13118 "Def100_Deb25" 14135 "Def50_Deb50" 14139 "Def75_Deb50" 14142 "Def100_Deb50" 15159 "Def50_Deb75" 15163 "Def75_Deb75" 15166 "Def100_Deb75" 15927 "Def50_Deb100" 15931 "Def75_Deb100" 15934 "Def100_Deb100" 20271 "Tested" /end COMPU_VTAB
/begin RECORD_LAYOUT ValA_Wu16 FNC_VALUES 1 UWORD COLUMN_DIR DIRECT /end RECORD_LAYOUT
/end MODULE
/end PROJECT

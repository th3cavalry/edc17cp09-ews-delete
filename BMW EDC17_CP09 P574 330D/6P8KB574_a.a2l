ASAP2_VERSION 1 4
/begin PROJECT P_574 "EDC17_CP09"
/begin HEADER "" VERSION "V8KB" PROJECT_NO P_574 /end HEADER
/begin MODULE DIM ""
/begin MOD_COMMON "" BYTE_ORDER MSB_LAST ALIGNMENT_BYTE 1 ALIGNMENT_WORD 2 ALIGNMENT_LONG 4 ALIGNMENT_FLOAT32_IEEE 4 /end MOD_COMMON
/begin CHARACTERISTIC InjCrv_ctATSMISel_C "Selektionsparameter für Arrayelement Ansauglufttemperatur (EngDa_tFld) für die Haupteinspritzung" VALUE 0x80040A30 Val_Wu8 3.00000000000 AirTempFldSel 0.00 3.00000000000 FORMAT "%13.11" /end CHARACTERISTIC
/begin CHARACTERISTIC InjCrv_dfacCylOffs.Pos_C "Rampensteigung für die Rampung des Freigabestatus/" VALUE 0x8003E070 Kw_Ws32 3999.99999814 Rmp_Fact 0.00 3999.99999814 FORMAT "%13.8" EXTENDED_LIMITS -4000.00000000 3999.99999814 /end CHARACTERISTIC
/begin CHARACTERISTIC InjCrv_dfacCylOffs.Neg_C "Rampensteigung für die Rampung des Freigabestatus/" VALUE 0x8003E074 Kw_Ws32 3999.99999814 Rmp_Fact 0.00 3999.99999814 FORMAT "%13.8" EXTENDED_LIMITS -4000.00000000 3999.99999814 /end CHARACTERISTIC
/begin CHARACTERISTIC InjCrv_dphiMIDyn.Pos_C "/" VALUE 0x8003EFBC Kw_Ws32 719999.999665 RmpCrsAg_InjCrv 0.00 719999.999665 FORMAT "%13.6" EXTENDED_LIMITS -720000.000000 719999.999665 /end CHARACTERISTIC
/begin CHARACTERISTIC InjCrv_dphiMIDyn.Neg_C "/" VALUE 0x8003EFC0 Kw_Ws32 719999.999665 RmpCrsAg_InjCrv 0.00 719999.999665 FORMAT "%13.6" EXTENDED_LIMITS -720000.000000 719999.999665 /end CHARACTERISTIC
/begin CHARACTERISTIC InjCrv_dpMIDynCorDT1.T1_C "/" VALUE 0x8003EFC4 Kw_Ws32 4294.9672940 TimeDelay_s 0.000002000000001 4294.9672960 FORMAT "%12.7" /end CHARACTERISTIC
/begin CHARACTERISTIC InjCrv_dpMIDynCorDT1.Kd_C "/" VALUE 0x8003EFC8 Kw_Ws32 32767.9999924 Kd_Pres2dpdt -16384.0000000 16383.9999924 FORMAT "%13.7" /end CHARACTERISTIC
/begin CHARACTERISTIC InjCrv_dqFltLowNeg_C "niedriger Schwellwert für Neg. dq für Filter Parameter Auswahl" VALUE 0x8003EFCC Kw_Ws16 32767.50 InjMassPerSec_20ms -16384.00 16383.50 FORMAT "%8.2" /end CHARACTERISTIC
/begin CHARACTERISTIC InjCrv_dqFltLowPos_C "niedriger Schwellwert für Pos. dq für Filter Parameter Auswahl" VALUE 0x8003EFCE Kw_Ws16 32767.50 InjMassPerSec_20ms -16384.00 16383.50 FORMAT "%8.2" /end CHARACTERISTIC
/begin CHARACTERISTIC InjCrv_dqFltMidNeg_C "Mittel Schwellwert für Neg. dq für Filter Parameter Auswahl" VALUE 0x8003EFD0 Kw_Ws16 32767.50 InjMassPerSec_20ms -16384.00 16383.50 FORMAT "%8.2" /end CHARACTERISTIC
/begin CHARACTERISTIC InjCrv_dqFltMidPos_C "Mittel Schwellwert für Pos. dq für Filter Parameter Auswahl" VALUE 0x8003EFD2 Kw_Ws16 32767.50 InjMassPerSec_20ms -16384.00 16383.50 FORMAT "%8.2" /end CHARACTERISTIC
/begin CHARACTERISTIC InjCrv_dqSetUnBalMax_C "Obere Begrenzung für PT1 und DT1 filterte Einspritzungquantität" VALUE 0x8003EFD4 Kw_Ws16 32767.50 InjMassPerSec_20ms -16384.00 16383.50 FORMAT "%8.2" /end CHARACTERISTIC
/begin CHARACTERISTIC InjCrv_dqSetUnBalMin_C "Unterere Grenze für PT1 und DT1 filterte Einspritzungquantität" VALUE 0x8003EFD6 Kw_Ws16 32767.50 InjMassPerSec_20ms -16384.00 16383.50 FORMAT "%8.2" /end CHARACTERISTIC
/begin CHARACTERISTIC InjCrv_DT1DQMISOECor2.T1_C "/" VALUE 0x8003EFD8 Kw_Ws32 4294.9672940 TimeDelay_s 0.000002000000001 4294.9672960 FORMAT "%12.7" /end CHARACTERISTIC
/begin CHARACTERISTIC InjCrv_DT1DQMISOECor2.Kd_C "/" VALUE 0x8003EFDC Kw_Ws32 3276799.99924 Kd_PerSec_20ms -1638400.00000 1638399.99924 FORMAT "%13.5" /end CHARACTERISTIC
/begin CHARACTERISTIC InjCrv_facAPMIDynCor2_CUR "Gewichtungsfaktor von der atmosphärischen Druck für die MI SOE-Korrektur" CURVE 0x8003EFE0 Kl_Xs16_Ws16 7.999878 Fact -4.000000 3.999878
 /begin AXIS_DESCR STD_AXIS EnvP_p Pres_hPa 6 -32768.00 3500.00 EXTENDED_LIMITS -32768.00 32767.00 DEPOSIT ABSOLUTE /end AXIS_DESCR
/end CHARACTERISTIC
/begin CHARACTERISTIC InjCrv_facAPPrMI1DynCor2_CUR "Dynamikkorrekturkennlinie für MI abhängig vom PWG- Niveau" CURVE 0x8003EFFA Kl_Xs16_Ws16 4.000000 Fact -2.000000 2.000000 EXTENDED_LIMITS -4.000000 3.999878
 /begin AXIS_DESCR STD_AXIS APP_r Prc 6 0.00 100.0000 EXTENDED_LIMITS -400.0000 399.9878 DEPOSIT ABSOLUTE /end AXIS_DESCR
/end CHARACTERISTIC
/begin CHARACTERISTIC InjCrv_facDQMI1DynCor2_CUR "Gewichtungsfaktor der abgeleiteten Einspritzmenge for S0E Korrektur" CURVE 0x8003F014 Kl_Xs16_Ws16 4.000000 Fact -2.000000 2.000000 EXTENDED_LIMITS -4.000000 3.999878
 /begin AXIS_DESCR STD_AXIS InjCrv_dqSetUnBalFltLim InjMassPerSec_20ms 6 -16384.00 16383.50 FORMAT "%8.2" DEPOSIT ABSOLUTE /end AXIS_DESCR
/end CHARACTERISTIC
/begin CHARACTERISTIC InjCrv_facETMIDynCor2_CUR "weighting factor by engine temperature for SOE correction" CURVE 0x8003F02E Kl_Xs16_Ws16 7.999878 Fact -4.000000 3.999878
 /begin AXIS_DESCR STD_AXIS InjSys_tEng Temp_Cels 6 -3549.940 3003.560 DEPOSIT ABSOLUTE /end AXIS_DESCR
/end CHARACTERISTIC
/begin CHARACTERISTIC InjCrv_facIAMIDynCor2_CUR "weighting factor by intake air temperature for SOE correction" CURVE 0x8003F048 Kl_Xs16_Ws16 7.999878 Fact -4.000000 3.999878
 /begin AXIS_DESCR STD_AXIS InjCrv_tAirMI Temp_Cels 6 -3549.940 3003.560 DEPOSIT ABSOLUTE /end AXIS_DESCR
/end CHARACTERISTIC
/begin CHARACTERISTIC InjCrv_facMI1APSSOECor0Rgn_GCUR "Luftdruckabhängige Ansteuerbeginnkorrekturgruppenkennlinie 1 für MI1 im Regenerationsbetrieb" CURVE 0x80040AF4 CurG_Ws16 1.000000 Fact 0.00 1.000000 EXTENDED_LIMITS -4.000000 3.999878
 /begin AXIS_DESCR COM_AXIS EnvP_p Pres_hPa 10 0.00 3500.000 EXTENDED_LIMITS -32768.00 32767.00 AXIS_PTS_REF InjCrv_facMI1APSSOECorRgn_AXIS /end AXIS_DESCR
/end CHARACTERISTIC
/begin CHARACTERISTIC InjCrv_facMI1APSSOECor1Rgn_GCUR "Luftdruckabhängige Ansteuerbeginnkorrekturgruppenkennlinie 2 für MI1 im Regenerationsbetrieb" CURVE 0x80040B08 CurG_Ws16 1.000000 Fact 0.00 1.000000 EXTENDED_LIMITS -4.000000 3.999878
 /begin AXIS_DESCR COM_AXIS EnvP_p Pres_hPa 10 0.00 3500.000 EXTENDED_LIMITS -32768.00 32767.00 AXIS_PTS_REF InjCrv_facMI1APSSOECorRgn_AXIS /end AXIS_DESCR
/end CHARACTERISTIC
/begin AXIS_PTS InjCrv_facMI1APSSOECorRgn_AXIS "Stützstellenverteilung für die Gruppenkennlinien InjCrv_facMI1APSSOECor%Rgn_GCUR" 0x80040B1C EnvP_p Axis_Xs16 3500.000 Pres_hPa 10 0.00 3500.000 FORMAT "%8.3" EXTENDED_LIMITS -32768.00 32767.00 DEPOSIT ABSOLUTE /end AXIS_PTS
/begin CHARACTERISTIC InjCrv_facMI1ATSSOECor0Rgn_GCUR "ansauglufttemperaturabhängige Ansteuerbeginnkorrekturgruppenkennlinie 1 für MI1 im Regenerationsbetrieb" CURVE 0x80040B32 CurG_Ws16 1.000000 Fact 0.00 1.000000 EXTENDED_LIMITS -4.000000 3.999878
 /begin AXIS_DESCR COM_AXIS InjSys_tAirRgn Temp_Cels 6 -50.14000 199.8600 EXTENDED_LIMITS -3549.940 3003.560 AXIS_PTS_REF InjCrv_facMI1ATSSOECorRgn_AXIS /end AXIS_DESCR
/end CHARACTERISTIC
/begin CHARACTERISTIC InjCrv_facMI1ATSSOECor1Rgn_GCUR "ansauglufttemperaturabhängige Ansteuerbeginnkorrekturgruppenkennlinie 2 für MI1 im Regenerationsbetrieb" CURVE 0x80040B3E CurG_Ws16 1.000000 Fact 0.00 1.000000 EXTENDED_LIMITS -4.000000 3.999878
 /begin AXIS_DESCR COM_AXIS InjSys_tAirRgn Temp_Cels 6 -50.14000 199.8600 EXTENDED_LIMITS -3549.940 3003.560 AXIS_PTS_REF InjCrv_facMI1ATSSOECorRgn_AXIS /end AXIS_DESCR
/end CHARACTERISTIC
/begin AXIS_PTS InjCrv_facMI1ATSSOECorRgn_AXIS "Stützstellenverteilung für die Gruppenkennlinien InjCrv_facMI1ATSSOECor%Rgn_GCUR" 0x80040B4A InjSys_tAirRgn Axis_Xs16 250.0000 Temp_Cels 6 -50.14000 199.8600 FORMAT "%8.4" EXTENDED_LIMITS -3549.940 3003.560 DEPOSIT ABSOLUTE /end AXIS_PTS
/begin CHARACTERISTIC InjCrv_facMI1ETSSOECor0Rgn_GCUR "motortemperaturabhängige Ansteuerbeginnkorrekturgruppenkennlinie 1 für MI1 im Regenerationsbetrieb" CURVE 0x80040B58 CurG_Ws16 1.000000 Fact 0.00 1.000000 EXTENDED_LIMITS -4.000000 3.999878
 /begin AXIS_DESCR COM_AXIS InjSys_tEngRgn Temp_Cels 10 -50.14000 199.8600 EXTENDED_LIMITS -3549.940 3003.560 AXIS_PTS_REF InjCrv_facMI1ETSSOECorRgn_AXIS /end AXIS_DESCR
/end CHARACTERISTIC
/begin CHARACTERISTIC InjCrv_facMI1ETSSOECor1Rgn_GCUR "motortemperaturabhängige Ansteuerbeginnkorrekturgruppenkennlinie 2 für MI1 im Regenerationsbetrieb" CURVE 0x80040B6C CurG_Ws16 1.000000 Fact 0.00 1.000000 EXTENDED_LIMITS -4.000000 3.999878
 /begin AXIS_DESCR COM_AXIS InjSys_tEngRgn Temp_Cels 10 -50.14000 199.8600 EXTENDED_LIMITS -3549.940 3003.560 AXIS_PTS_REF InjCrv_facMI1ETSSOECorRgn_AXIS /end AXIS_DESCR
/end CHARACTERISTIC
/begin AXIS_PTS InjCrv_facMI1ETSSOECorRgn_AXIS "Stützstellenverteilung für die Gruppenkennlinien InjCrv_facMI1ETSSOECor%Rgn_GCUR" 0x80040B80 InjSys_tEngRgn Axis_Xs16 250.0000 Temp_Cels 10 -50.14000 199.8600 FORMAT "%8.4" EXTENDED_LIMITS -3549.940 3003.560 DEPOSIT ABSOLUTE /end AXIS_PTS
/begin CHARACTERISTIC InjCrv_facMI1QntRmp0Val_GCUR "Interpolationsfaktor für die Funktion CoEOM_OpModeSwtExtd bei Regeneration 0" CURVE 0x800416B0 CurG_Ws16 3.999939 CoEOMSwt_S16 -2.000000 1.999939 FORMAT "%8.6"
 /begin AXIS_DESCR COM_AXIS CoEOM_facRmpVal CoEOMSwt_S16 11 -2.000000 1.999939 FORMAT "%8.6" AXIS_PTS_REF InjCrv_facMI1QntRmpValX_AXIS /end AXIS_DESCR
/end CHARACTERISTIC
/begin CHARACTERISTIC InjCrv_facMI1QntRmp1Val_GCUR "Interpolationsfaktor für die Funktion CoEOM_OpModeSwtExtd bei Regeneration 1" CURVE 0x800416C6 CurG_Ws16 3.999939 CoEOMSwt_S16 -2.000000 1.999939 FORMAT "%8.6"
 /begin AXIS_DESCR COM_AXIS CoEOM_facRmpVal CoEOMSwt_S16 11 -2.000000 1.999939 FORMAT "%8.6" AXIS_PTS_REF InjCrv_facMI1QntRmpValX_AXIS /end AXIS_DESCR
/end CHARACTERISTIC
/begin AXIS_PTS InjCrv_facMI1QntRmpValX_AXIS "Gruppenkennlinien-Achse für die Gewichtung des Mengen-Faktors der MI1" 0x800416DC CoEOM_facRmpVal Axis_Xs16 3.999939 CoEOMSwt_S16 11 -2.000000 1.999939 FORMAT "%8.6" DEPOSIT ABSOLUTE /end AXIS_PTS
/begin CHARACTERISTIC InjCrv_facMI1SOERmp0Val_GCUR "Faktorisierungskennlinie für den Einspritzbeginn der MI1" CURVE 0x800416F4 CurG_Ws16 3.999939 CoEOMSwt_S16 -2.000000 1.999939 FORMAT "%8.6"
 /begin AXIS_DESCR COM_AXIS CoEOM_facRmpVal CoEOMSwt_S16 10 -2.000000 1.999939 FORMAT "%8.6" AXIS_PTS_REF InjCrv_facMI1SOERmpValX_AXIS /end AXIS_DESCR
/end CHARACTERISTIC
/begin CHARACTERISTIC InjCrv_facMI1SOERmp1Val_GCUR "Faktorisierungskennlinie für den Einspritzbeginn der MI1" CURVE 0x80041708 CurG_Ws16 3.999939 CoEOMSwt_S16 -2.000000 1.999939 FORMAT "%8.6"
 /begin AXIS_DESCR COM_AXIS CoEOM_facRmpVal CoEOMSwt_S16 10 -2.000000 1.999939 FORMAT "%8.6" AXIS_PTS_REF InjCrv_facMI1SOERmpValX_AXIS /end AXIS_DESCR
/end CHARACTERISTIC
/begin AXIS_PTS InjCrv_facMI1SOERmpValX_AXIS "Gruppenkennlinien-Achse für die Gewichtung des Einspritzbeginn-Faktors der MI1" 0x8004171C CoEOM_facRmpVal Axis_Xs16 3.999939 CoEOMSwt_S16 10 -2.000000 1.999939 FORMAT "%8.6" DEPOSIT ABSOLUTE /end AXIS_PTS
/begin CHARACTERISTIC InjCrv_facMIAPSPhiCor1_CUR "atmosphärendruckabhängige Korrekturkennlinie -1 für Ansteuerbeginn MI1" CURVE 0x80040A32 CurG_Ws16 1.000000 Fact 0.00 1.000000 EXTENDED_LIMITS -4.000000 3.999878
 /begin AXIS_DESCR COM_AXIS EnvP_p Pres_hPa 8 0.00 3500.000 EXTENDED_LIMITS -32768.00 32767.00 AXIS_PTS_REF InjCrv_facMIAPSPhiCor_AXIS /end AXIS_DESCR
/end CHARACTERISTIC
/begin CHARACTERISTIC InjCrv_facMIAPSPhiCor2_CUR "atmosphärendruckabhängige Korrekturkennlinie -2 für Ansteuerbeginn MI1" CURVE 0x80040A42 CurG_Ws16 1.000000 Fact 0.00 1.000000 EXTENDED_LIMITS -4.000000 3.999878
 /begin AXIS_DESCR COM_AXIS EnvP_p Pres_hPa 8 0.00 3500.000 EXTENDED_LIMITS -32768.00 32767.00 AXIS_PTS_REF InjCrv_facMIAPSPhiCor_AXIS /end AXIS_DESCR
/end CHARACTERISTIC
/begin CHARACTERISTIC InjCrv_facMIAPSPhiCorStrt_CUR "weighting factor by air pressure for SOE correction" CURVE 0x8003F9F0 Kl_Xs16_Ws16 7.999878 Fact -4.000000 3.999878
 /begin AXIS_DESCR STD_AXIS EnvP_p Pres_hPa 8 -32768.00 3500.00 EXTENDED_LIMITS -32768.00 32767.00 DEPOSIT ABSOLUTE /end AXIS_DESCR
/end CHARACTERISTIC
/begin AXIS_PTS InjCrv_facMIAPSPhiCor_AXIS "gemeinsame Stützstellen für atmosphärendruckabhängige Ansteuerbeginnkorrekturkennlinien für MI1" 0x80040A52 EnvP_p Axis_Xs16 4000.000 Pres_hPa 8 0.00 4000.000 FORMAT "%8.3" EXTENDED_LIMITS -32768.00 32767.00 DEPOSIT ABSOLUTE /end AXIS_PTS
/begin CHARACTERISTIC InjCrv_facMIATSDynCor_CUR "Korrekturkennline für Lufttemperaturkorrektur" CURVE 0x8003F062 Kl_Xs16_Ws16 7.999878 Fact -4.000000 3.999878
 /begin AXIS_DESCR STD_AXIS InjCrv_tAirMI Temp_Cels 6 -3549.940 3003.560 DEPOSIT ABSOLUTE /end AXIS_DESCR
/end CHARACTERISTIC
/begin CHARACTERISTIC InjCrv_facMIATSPhiCor1_CUR "ansauglufttemperaturabhängige Korrekturkennlinie -1 für Ansteuerbeginn MI1" CURVE 0x80040A64 CurG_Ws16 1.000000 Fact 0.00 1.000000 EXTENDED_LIMITS -4.000000 3.999878
 /begin AXIS_DESCR COM_AXIS InjCrv_tAirMI Temp_Cels 8 -50.14000 199.8600 EXTENDED_LIMITS -3549.940 3003.560 AXIS_PTS_REF InjCrv_facMIATSPhiCor_AXIS /end AXIS_DESCR
/end CHARACTERISTIC
/begin CHARACTERISTIC InjCrv_facMIATSPhiCor2_CUR "ansauglufttemperaturabhängige Korrekturkennlinie -2 für Ansteuerbeginn MI1" CURVE 0x80040A74 CurG_Ws16 1.000000 Fact 0.00 1.000000 EXTENDED_LIMITS -4.000000 3.999878
 /begin AXIS_DESCR COM_AXIS InjCrv_tAirMI Temp_Cels 8 -50.14000 199.8600 EXTENDED_LIMITS -3549.940 3003.560 AXIS_PTS_REF InjCrv_facMIATSPhiCor_AXIS /end AXIS_DESCR
/end CHARACTERISTIC
/begin CHARACTERISTIC InjCrv_facMIATSPhiCorStrt_CUR "weighting factor by intake air temperature for SOE correction" CURVE 0x8003FA12 Kl_Xs16_Ws16 7.999878 Fact -4.000000 3.999878
 /begin AXIS_DESCR STD_AXIS InjCrv_tAirMI Temp_Cels 8 -3549.940 3003.560 DEPOSIT ABSOLUTE /end AXIS_DESCR
/end CHARACTERISTIC
/begin AXIS_PTS InjCrv_facMIATSPhiCor_AXIS "gemeinsame Stützstellen für ansauglufttemperaturabhängige Ansteuerbeginnkorrekturkennlinien für MI1" 0x80040A84 InjCrv_tAirMI Axis_Xs16 250.0000 Temp_Cels 8 -50.14000 199.8600 FORMAT "%8.4" EXTENDED_LIMITS -3549.940 3003.560 DEPOSIT ABSOLUTE /end AXIS_PTS
/begin CHARACTERISTIC InjCrv_facMICTSDynCor_CUR "Korrekturkennlinie für Wassertemperaturkorrektur" CURVE 0x8003F07C Kl_Xs16_Ws16 7.999878 Fact -4.000000 3.999878
 /begin AXIS_DESCR STD_AXIS InjSys_tEng Temp_Cels 6 -3549.940 3003.560 DEPOSIT ABSOLUTE /end AXIS_DESCR
/end CHARACTERISTIC
/begin CHARACTERISTIC InjCrv_facMIEGRDynCor_CUR "" CURVE 0x8003F096 Kl_Xs16_Ws16 1.000000 Fact 0.00 1.000000 EXTENDED_LIMITS -4.000000 3.999878
 /begin AXIS_DESCR STD_AXIS AirCtl_mEGRDiff AirMassPerCyl 6 0.00 500.0000 EXTENDED_LIMITS -3276.800 3276.700 DEPOSIT ABSOLUTE /end AXIS_DESCR
/end CHARACTERISTIC
/begin CHARACTERISTIC InjCrv_facMIEGRPhiCor_CUR "" CURVE 0x8003F0B0 Kl_Xs16_Ws16 5.000000 Fact 0.00 5.000000 EXTENDED_LIMITS -4.000000 3.999878
 /begin AXIS_DESCR STD_AXIS ASMod_mEGRIntMnfDsCmb AirMassPerCyl 8 -3276.800 3276.700 DEPOSIT ABSOLUTE /end AXIS_DESCR
/end CHARACTERISTIC
/begin CHARACTERISTIC InjCrv_facMIETSPhiCor11_GCUR "motortemperaturabhängige Korrekturkennlinie -1 für Ansteuerbeginn MI1" CURVE 0x8003FA34 Gkl_Ws16 7.999878 Fact -4.000000 3.999878
 /begin AXIS_DESCR COM_AXIS InjSys_tEng Temp_Cels 8 -3549.940 3003.560 AXIS_PTS_REF InjCrv_facMIETSPhiCor1_AXIS /end AXIS_DESCR
/end CHARACTERISTIC
/begin CHARACTERISTIC InjCrv_facMIETSPhiCor12_GCUR "motortemperaturabhängige Korrekturkennlinie -2 für Ansteuerbeginn MI1" CURVE 0x8003FA44 Gkl_Ws16 7.999878 Fact -4.000000 3.999878
 /begin AXIS_DESCR COM_AXIS InjSys_tEng Temp_Cels 8 -3549.940 3003.560 AXIS_PTS_REF InjCrv_facMIETSPhiCor1_AXIS /end AXIS_DESCR
/end CHARACTERISTIC
/begin AXIS_PTS InjCrv_facMIETSPhiCor1_AXIS "" 0x8003FA54 InjSys_tEng GSst_Xs16 6553.500 Temp_Cels 8 -3549.940 3003.560 FORMAT "%8.3" DEPOSIT ABSOLUTE /end AXIS_PTS
/begin CHARACTERISTIC InjCrv_facMIETSPhiCor1_CUR "motortemperaturabhängige Korrekturkennlinie -1 für Ansteuerbeginn MI1" CURVE 0x80040A96 CurG_Ws16 1.000000 Fact 0.00 1.000000 EXTENDED_LIMITS -4.000000 3.999878
 /begin AXIS_DESCR COM_AXIS InjSys_tEng Temp_Cels 8 -50.14000 199.8600 EXTENDED_LIMITS -3549.940 3003.560 AXIS_PTS_REF InjCrv_facMIETSPhiCor_AXIS /end AXIS_DESCR
/end CHARACTERISTIC
/begin CHARACTERISTIC InjCrv_facMIETSPhiCor2_CUR "motortemperaturabhängige Korrekturkennlinie -2 für Ansteuerbeginn MI1" CURVE 0x80040AA6 CurG_Ws16 1.000000 Fact 0.00 1.000000 EXTENDED_LIMITS -4.000000 3.999878
 /begin AXIS_DESCR COM_AXIS InjSys_tEng Temp_Cels 8 -50.14000 199.8600 EXTENDED_LIMITS -3549.940 3003.560 AXIS_PTS_REF InjCrv_facMIETSPhiCor_AXIS /end AXIS_DESCR
/end CHARACTERISTIC
/begin CHARACTERISTIC InjCrv_facMIETSPhiCorStrt_CUR "weighting factor by engine temperature for SOE correction" CURVE 0x8003FA66 Kl_Xs16_Ws16 7.999878 Fact -4.000000 3.999878
 /begin AXIS_DESCR STD_AXIS InjSys_tEng Temp_Cels 8 -3549.940 3003.560 DEPOSIT ABSOLUTE /end AXIS_DESCR
/end CHARACTERISTIC
/begin AXIS_PTS InjCrv_facMIETSPhiCor_AXIS "gemeinsame Stützstellen für motortemperaturabhängige Ansteuerbeginnkorrekturkennlinien für MI1" 0x80040AB6 InjSys_tEng Axis_Xs16 250.0000 Temp_Cels 8 -50.14000 199.8600 FORMAT "%8.4" EXTENDED_LIMITS -3549.940 3003.560 DEPOSIT ABSOLUTE /end AXIS_PTS
/begin CHARACTERISTIC InjCrv_facMIFTSRailCorStrt_CUR "correction factor curve for the MI1, based on rail pressure" CURVE 0x8003FA88 Kl_Xs16_Ws16 7.999878 Fact -4.000000 3.999878
 /begin AXIS_DESCR STD_AXIS Rail_pSetPointFlTempCor Pres_Rail 2 -3276.800 2000.000 EXTENDED_LIMITS -3276.800 3276.700 DEPOSIT ABSOLUTE /end AXIS_DESCR
/end CHARACTERISTIC
/begin CHARACTERISTIC InjCrv_facMIFTSRailCor_CUR "Korrekturfaktorkennlinie für die MI1, abhängig von der kraftstofftemperaturabhängigen Raildruckkorrektur" CURVE 0x80040AC8 Cur_Xs16Ws16 1.000000 Fact 0.00 1.000000 EXTENDED_LIMITS -4.000000 3.999878
 /begin AXIS_DESCR STD_AXIS Rail_pSetPointFlTempCor Pres_Rail 8 -1800.000 2000.000 EXTENDED_LIMITS -3276.800 3276.700 DEPOSIT ABSOLUTE /end AXIS_DESCR
/end CHARACTERISTIC
/begin CHARACTERISTIC InjCrv_facMIIMTSPhiCor_CUR "" CURVE 0x8003FA92 Kl_Xs16_Ws16 5.000000 Fact 0.00 5.000000 EXTENDED_LIMITS -4.000000 3.999878
 /begin AXIS_DESCR STD_AXIS Air_tCACDs Temp_Cels 8 -3549.940 3003.560 DEPOSIT ABSOLUTE /end AXIS_DESCR
/end CHARACTERISTIC
/begin CHARACTERISTIC InjCrv_facMIPDynCor_CUR "Korrekturkennlinie für Faktor abhängig vom Raildruck" CURVE 0x8003F0D2 Kl_Xs16_Ws16 2.000000 Fact 0.00 2.000000 EXTENDED_LIMITS -4.000000 3.999878
 /begin AXIS_DESCR STD_AXIS InjCrv_pMIDynCor_mp Pres_Rail 8 -3276.800 2000.000 EXTENDED_LIMITS -3276.800 3276.700 DEPOSIT ABSOLUTE /end AXIS_DESCR
/end CHARACTERISTIC
/begin CHARACTERISTIC InjCrv_facMIPFltPhiCor_CUR "rußmassenabhängiger Korrekturfaktor des Partikelfilters" CURVE 0x80040AEA Cur_Xs16Ws16 1.000000 Fact 0.00 1.000000 EXTENDED_LIMITS -4.000000 3.999878
 /begin AXIS_DESCR STD_AXIS Exh_pFltPPFltUs Pres_hPa 2 -32768.00 3500.00 EXTENDED_LIMITS -32768.00 32767.00 DEPOSIT ABSOLUTE /end AXIS_DESCR
/end CHARACTERISTIC
/begin CHARACTERISTIC InjCrv_facphiMI1CylOffs.dfacCylOffs1_C "Multiplaktiver Faktor auf den Basiswert des Ansteuerbeginns Zyl/" VALUE 0x8003E078 Kw_Ws16 511.9922 Fact1 -256.0000 255.9922 /end CHARACTERISTIC
/begin CHARACTERISTIC InjCrv_facphiMI1CylOffs.dfacCylOffs2_C "Multiplaktiver Faktor auf den Basiswert des Ansteuerbeginns Zyl/" VALUE 0x8003E07A Kw_Ws16 511.9922 Fact1 -256.0000 255.9922 /end CHARACTERISTIC
/begin CHARACTERISTIC InjCrv_facphiMI1CylOffs.dfacCylOffs3_C "Multiplaktiver Faktor auf den Basiswert des Ansteuerbeginns Zyl/" VALUE 0x8003E07C Kw_Ws16 511.9922 Fact1 -256.0000 255.9922 /end CHARACTERISTIC
/begin CHARACTERISTIC InjCrv_facphiMI1CylOffs.dfacCylOffs4_C "Multiplaktiver Faktor auf den Basiswert des Ansteuerbeginns Zyl/" VALUE 0x8003E07E Kw_Ws16 511.9922 Fact1 -256.0000 255.9922 /end CHARACTERISTIC
/begin CHARACTERISTIC InjCrv_facphiMI1CylOffs.dfacCylOffs5_C "Multiplaktiver Faktor auf den Basiswert des Ansteuerbeginns Zyl/" VALUE 0x8003E080 Kw_Ws16 511.9922 Fact1 -256.0000 255.9922 /end CHARACTERISTIC
/begin CHARACTERISTIC InjCrv_facphiMI1CylOffs.dfacCylOffs6_C "Multiplaktiver Faktor auf den Basiswert des Ansteuerbeginns Zyl/" VALUE 0x8003E082 Kw_Ws16 511.9922 Fact1 -256.0000 255.9922 /end CHARACTERISTIC
/begin CHARACTERISTIC InjCrv_facphiMI1CylOffs.dfacCylOffs7_C "Multiplaktiver Faktor auf den Basiswert des Ansteuerbeginns Zyl/" VALUE 0x8003E084 Kw_Ws16 511.9922 Fact1 -256.0000 255.9922 /end CHARACTERISTIC
/begin CHARACTERISTIC InjCrv_facphiMI1CylOffs.dfacCylOffs8_C "Multiplaktiver Faktor auf den Basiswert des Ansteuerbeginns Zyl/" VALUE 0x8003E086 Kw_Ws16 511.9922 Fact1 -256.0000 255.9922 /end CHARACTERISTIC
/begin CHARACTERISTIC InjCrv_facphiMI1CylOffs2.dfacCylOffs1_C "Multiplaktiver Faktor auf den Basiswert des Ansteuerbeginns Zyl bei aktiver Pii2/" VALUE 0x8003E088 Kw_Ws16 511.9922 Fact1 -256.0000 255.9922 /end CHARACTERISTIC
/begin CHARACTERISTIC InjCrv_facphiMI1CylOffs2.dfacCylOffs2_C "Multiplaktiver Faktor auf den Basiswert des Ansteuerbeginns Zyl bei aktiver Pii2/" VALUE 0x8003E08A Kw_Ws16 511.9922 Fact1 -256.0000 255.9922 /end CHARACTERISTIC
/begin CHARACTERISTIC InjCrv_facphiMI1CylOffs2.dfacCylOffs3_C "Multiplaktiver Faktor auf den Basiswert des Ansteuerbeginns Zyl bei aktiver Pii2/" VALUE 0x8003E08C Kw_Ws16 511.9922 Fact1 -256.0000 255.9922 /end CHARACTERISTIC
/begin CHARACTERISTIC InjCrv_facphiMI1CylOffs2.dfacCylOffs4_C "Multiplaktiver Faktor auf den Basiswert des Ansteuerbeginns Zyl bei aktiver Pii2/" VALUE 0x8003E08E Kw_Ws16 511.9922 Fact1 -256.0000 255.9922 /end CHARACTERISTIC
/begin CHARACTERISTIC InjCrv_facphiMI1CylOffs2.dfacCylOffs5_C "Multiplaktiver Faktor auf den Basiswert des Ansteuerbeginns Zyl bei aktiver Pii2/" VALUE 0x8003E090 Kw_Ws16 511.9922 Fact1 -256.0000 255.9922 /end CHARACTERISTIC
/begin CHARACTERISTIC InjCrv_facphiMI1CylOffs2.dfacCylOffs6_C "Multiplaktiver Faktor auf den Basiswert des Ansteuerbeginns Zyl bei aktiver Pii2/" VALUE 0x8003E092 Kw_Ws16 511.9922 Fact1 -256.0000 255.9922 /end CHARACTERISTIC
/begin CHARACTERISTIC InjCrv_facphiMI1CylOffs2.dfacCylOffs7_C "Multiplaktiver Faktor auf den Basiswert des Ansteuerbeginns Zyl bei aktiver Pii2/" VALUE 0x8003E094 Kw_Ws16 511.9922 Fact1 -256.0000 255.9922 /end CHARACTERISTIC
/begin CHARACTERISTIC InjCrv_facphiMI1CylOffs2.dfacCylOffs8_C "Multiplaktiver Faktor auf den Basiswert des Ansteuerbeginns Zyl bei aktiver Pii2/" VALUE 0x8003E096 Kw_Ws16 511.9922 Fact1 -256.0000 255.9922 /end CHARACTERISTIC
/begin CHARACTERISTIC InjCrv_facPiI1QntMin_CUR "raildruckabhängige Kennlinie zur Ermittlung des Faktor fuer die Berechnung der Mindestmenge um die PiI1 abzuschalten" CURVE 0x800417D6 Cur_Xs16Ws16 1.000000 Fact1 0.00 1.000000 EXTENDED_LIMITS -256.0000 255.9922
 /begin AXIS_DESCR STD_AXIS RailP_pFlt Pres_Rail 8 0.00 2000.000 EXTENDED_LIMITS -3276.800 3276.700 DEPOSIT ABSOLUTE /end AXIS_DESCR
/end CHARACTERISTIC
/begin CHARACTERISTIC InjCrv_facqPiI1CylOffs.dfacCylOffs1_C "Multiplaktiver Faktor auf den Basiswert der Einspritzmenge für Zyl/" VALUE 0x8003E098 Kw_Ws16 511.9922 Fact1 -256.0000 255.9922 /end CHARACTERISTIC
/begin CHARACTERISTIC InjCrv_facqPiI1CylOffs.dfacCylOffs2_C "Multiplaktiver Faktor auf den Basiswert der Einspritzmenge für Zyl/" VALUE 0x8003E09A Kw_Ws16 511.9922 Fact1 -256.0000 255.9922 /end CHARACTERISTIC
/begin CHARACTERISTIC InjCrv_facqPiI1CylOffs.dfacCylOffs3_C "Multiplaktiver Faktor auf den Basiswert der Einspritzmenge für Zyl/" VALUE 0x8003E09C Kw_Ws16 511.9922 Fact1 -256.0000 255.9922 /end CHARACTERISTIC
/begin CHARACTERISTIC InjCrv_facqPiI1CylOffs.dfacCylOffs4_C "Multiplaktiver Faktor auf den Basiswert der Einspritzmenge für Zyl/" VALUE 0x8003E09E Kw_Ws16 511.9922 Fact1 -256.0000 255.9922 /end CHARACTERISTIC
/begin CHARACTERISTIC InjCrv_facqPiI1CylOffs.dfacCylOffs5_C "Multiplaktiver Faktor auf den Basiswert der Einspritzmenge für Zyl/" VALUE 0x8003E0A0 Kw_Ws16 511.9922 Fact1 -256.0000 255.9922 /end CHARACTERISTIC
/begin CHARACTERISTIC InjCrv_facqPiI1CylOffs.dfacCylOffs6_C "Multiplaktiver Faktor auf den Basiswert der Einspritzmenge für Zyl/" VALUE 0x8003E0A2 Kw_Ws16 511.9922 Fact1 -256.0000 255.9922 /end CHARACTERISTIC
/begin CHARACTERISTIC InjCrv_facqPiI1CylOffs.dfacCylOffs7_C "Multiplaktiver Faktor auf den Basiswert der Einspritzmenge für Zyl/" VALUE 0x8003E0A4 Kw_Ws16 511.9922 Fact1 -256.0000 255.9922 /end CHARACTERISTIC
/begin CHARACTERISTIC InjCrv_facqPiI1CylOffs.dfacCylOffs8_C "Multiplaktiver Faktor auf den Basiswert der Einspritzmenge für Zyl/" VALUE 0x8003E0A6 Kw_Ws16 511.9922 Fact1 -256.0000 255.9922 /end CHARACTERISTIC
/begin CHARACTERISTIC InjCrv_facqPiI1CylOffs2.dfacCylOffs1_C "Multiplaktiver Faktor auf den Basiswert der Einspritzmenge Zyl bei aktiver Pii2/" VALUE 0x8003E0A8 Kw_Ws16 511.9922 Fact1 -256.0000 255.9922 /end CHARACTERISTIC
/begin CHARACTERISTIC InjCrv_facqPiI1CylOffs2.dfacCylOffs2_C "Multiplaktiver Faktor auf den Basiswert der Einspritzmenge Zyl bei aktiver Pii2/" VALUE 0x8003E0AA Kw_Ws16 511.9922 Fact1 -256.0000 255.9922 /end CHARACTERISTIC
/begin CHARACTERISTIC InjCrv_facqPiI1CylOffs2.dfacCylOffs3_C "Multiplaktiver Faktor auf den Basiswert der Einspritzmenge Zyl bei aktiver Pii2/" VALUE 0x8003E0AC Kw_Ws16 511.9922 Fact1 -256.0000 255.9922 /end CHARACTERISTIC
/begin CHARACTERISTIC InjCrv_facqPiI1CylOffs2.dfacCylOffs4_C "Multiplaktiver Faktor auf den Basiswert der Einspritzmenge Zyl bei aktiver Pii2/" VALUE 0x8003E0AE Kw_Ws16 511.9922 Fact1 -256.0000 255.9922 /end CHARACTERISTIC
/begin CHARACTERISTIC InjCrv_facqPiI1CylOffs2.dfacCylOffs5_C "Multiplaktiver Faktor auf den Basiswert der Einspritzmenge Zyl bei aktiver Pii2/" VALUE 0x8003E0B0 Kw_Ws16 511.9922 Fact1 -256.0000 255.9922 /end CHARACTERISTIC
/begin CHARACTERISTIC InjCrv_facqPiI1CylOffs2.dfacCylOffs6_C "Multiplaktiver Faktor auf den Basiswert der Einspritzmenge Zyl bei aktiver Pii2/" VALUE 0x8003E0B2 Kw_Ws16 511.9922 Fact1 -256.0000 255.9922 /end CHARACTERISTIC
/begin CHARACTERISTIC InjCrv_facqPiI1CylOffs2.dfacCylOffs7_C "Multiplaktiver Faktor auf den Basiswert der Einspritzmenge Zyl bei aktiver Pii2/" VALUE 0x8003E0B4 Kw_Ws16 511.9922 Fact1 -256.0000 255.9922 /end CHARACTERISTIC
/begin CHARACTERISTIC InjCrv_facqPiI1CylOffs2.dfacCylOffs8_C "Multiplaktiver Faktor auf den Basiswert der Einspritzmenge Zyl bei aktiver Pii2/" VALUE 0x8003E0B6 Kw_Ws16 511.9922 Fact1 -256.0000 255.9922 /end CHARACTERISTIC
/begin CHARACTERISTIC InjCrv_factiPiI1CylOffs.dfacCylOffs1_C "Multiplaktiver Faktor auf den Basiswert des Ansteuerbeginns PiI1 für Zyl/" VALUE 0x8003E0B8 Kw_Ws16 511.9922 Fact1 -256.0000 255.9922 /end CHARACTERISTIC
/begin CHARACTERISTIC InjCrv_factiPiI1CylOffs.dfacCylOffs2_C "Multiplaktiver Faktor auf den Basiswert des Ansteuerbeginns PiI1 für Zyl/" VALUE 0x8003E0BA Kw_Ws16 511.9922 Fact1 -256.0000 255.9922 /end CHARACTERISTIC
/begin CHARACTERISTIC InjCrv_factiPiI1CylOffs.dfacCylOffs3_C "Multiplaktiver Faktor auf den Basiswert des Ansteuerbeginns PiI1 für Zyl/" VALUE 0x8003E0BC Kw_Ws16 511.9922 Fact1 -256.0000 255.9922 /end CHARACTERISTIC
/begin CHARACTERISTIC InjCrv_factiPiI1CylOffs.dfacCylOffs4_C "Multiplaktiver Faktor auf den Basiswert des Ansteuerbeginns PiI1 für Zyl/" VALUE 0x8003E0BE Kw_Ws16 511.9922 Fact1 -256.0000 255.9922 /end CHARACTERISTIC
/begin CHARACTERISTIC InjCrv_factiPiI1CylOffs.dfacCylOffs5_C "Multiplaktiver Faktor auf den Basiswert des Ansteuerbeginns PiI1 für Zyl/" VALUE 0x8003E0C0 Kw_Ws16 511.9922 Fact1 -256.0000 255.9922 /end CHARACTERISTIC
/begin CHARACTERISTIC InjCrv_factiPiI1CylOffs.dfacCylOffs6_C "Multiplaktiver Faktor auf den Basiswert des Ansteuerbeginns PiI1 für Zyl/" VALUE 0x8003E0C2 Kw_Ws16 511.9922 Fact1 -256.0000 255.9922 /end CHARACTERISTIC
/begin CHARACTERISTIC InjCrv_factiPiI1CylOffs.dfacCylOffs7_C "Multiplaktiver Faktor auf den Basiswert des Ansteuerbeginns PiI1 für Zyl/" VALUE 0x8003E0C4 Kw_Ws16 511.9922 Fact1 -256.0000 255.9922 /end CHARACTERISTIC
/begin CHARACTERISTIC InjCrv_factiPiI1CylOffs.dfacCylOffs8_C "Multiplaktiver Faktor auf den Basiswert des Ansteuerbeginns PiI1 für Zyl/" VALUE 0x8003E0C6 Kw_Ws16 511.9922 Fact1 -256.0000 255.9922 /end CHARACTERISTIC
/begin CHARACTERISTIC InjCrv_factiPiI1CylOffs2.dfacCylOffs1_C "Multiplaktiver Faktor auf den Basiswert des Ansteuerbeginns Zyl bei aktiver Pii2/" VALUE 0x8003E0C8 Kw_Ws16 511.9922 Fact1 -256.0000 255.9922 /end CHARACTERISTIC
/begin CHARACTERISTIC InjCrv_factiPiI1CylOffs2.dfacCylOffs2_C "Multiplaktiver Faktor auf den Basiswert des Ansteuerbeginns Zyl bei aktiver Pii2/" VALUE 0x8003E0CA Kw_Ws16 511.9922 Fact1 -256.0000 255.9922 /end CHARACTERISTIC
/begin CHARACTERISTIC InjCrv_factiPiI1CylOffs2.dfacCylOffs3_C "Multiplaktiver Faktor auf den Basiswert des Ansteuerbeginns Zyl bei aktiver Pii2/" VALUE 0x8003E0CC Kw_Ws16 511.9922 Fact1 -256.0000 255.9922 /end CHARACTERISTIC
/begin CHARACTERISTIC InjCrv_factiPiI1CylOffs2.dfacCylOffs4_C "Multiplaktiver Faktor auf den Basiswert des Ansteuerbeginns Zyl bei aktiver Pii2/" VALUE 0x8003E0CE Kw_Ws16 511.9922 Fact1 -256.0000 255.9922 /end CHARACTERISTIC
/begin CHARACTERISTIC InjCrv_factiPiI1CylOffs2.dfacCylOffs5_C "Multiplaktiver Faktor auf den Basiswert des Ansteuerbeginns Zyl bei aktiver Pii2/" VALUE 0x8003E0D0 Kw_Ws16 511.9922 Fact1 -256.0000 255.9922 /end CHARACTERISTIC
/begin CHARACTERISTIC InjCrv_factiPiI1CylOffs2.dfacCylOffs6_C "Multiplaktiver Faktor auf den Basiswert des Ansteuerbeginns Zyl bei aktiver Pii2/" VALUE 0x8003E0D2 Kw_Ws16 511.9922 Fact1 -256.0000 255.9922 /end CHARACTERISTIC
/begin CHARACTERISTIC InjCrv_factiPiI1CylOffs2.dfacCylOffs7_C "Multiplaktiver Faktor auf den Basiswert des Ansteuerbeginns Zyl bei aktiver Pii2/" VALUE 0x8003E0D4 Kw_Ws16 511.9922 Fact1 -256.0000 255.9922 /end CHARACTERISTIC
/begin CHARACTERISTIC InjCrv_factiPiI1CylOffs2.dfacCylOffs8_C "Multiplaktiver Faktor auf den Basiswert des Ansteuerbeginns Zyl bei aktiver Pii2/" VALUE 0x8003E0D6 Kw_Ws16 511.9922 Fact1 -256.0000 255.9922 /end CHARACTERISTIC
/begin CHARACTERISTIC InjCrv_factiPiI2CylOffs2.dfacCylOffs1_C "Multiplaktiver Faktor auf den Basiswert des Ansteuerbeginns Zyl bei aktiver Pii2/" VALUE 0x8003E0D8 Kw_Ws16 511.9922 Fact1 -256.0000 255.9922 /end CHARACTERISTIC
/begin CHARACTERISTIC InjCrv_factiPiI2CylOffs2.dfacCylOffs2_C "Multiplaktiver Faktor auf den Basiswert des Ansteuerbeginns Zyl bei aktiver Pii2/" VALUE 0x8003E0DA Kw_Ws16 511.9922 Fact1 -256.0000 255.9922 /end CHARACTERISTIC
/begin CHARACTERISTIC InjCrv_factiPiI2CylOffs2.dfacCylOffs3_C "Multiplaktiver Faktor auf den Basiswert des Ansteuerbeginns Zyl bei aktiver Pii2/" VALUE 0x8003E0DC Kw_Ws16 511.9922 Fact1 -256.0000 255.9922 /end CHARACTERISTIC
/begin CHARACTERISTIC InjCrv_factiPiI2CylOffs2.dfacCylOffs4_C "Multiplaktiver Faktor auf den Basiswert des Ansteuerbeginns Zyl bei aktiver Pii2/" VALUE 0x8003E0DE Kw_Ws16 511.9922 Fact1 -256.0000 255.9922 /end CHARACTERISTIC
/begin CHARACTERISTIC InjCrv_factiPiI2CylOffs2.dfacCylOffs5_C "Multiplaktiver Faktor auf den Basiswert des Ansteuerbeginns Zyl bei aktiver Pii2/" VALUE 0x8003E0E0 Kw_Ws16 511.9922 Fact1 -256.0000 255.9922 /end CHARACTERISTIC
/begin CHARACTERISTIC InjCrv_factiPiI2CylOffs2.dfacCylOffs6_C "Multiplaktiver Faktor auf den Basiswert des Ansteuerbeginns Zyl bei aktiver Pii2/" VALUE 0x8003E0E2 Kw_Ws16 511.9922 Fact1 -256.0000 255.9922 /end CHARACTERISTIC
/begin CHARACTERISTIC InjCrv_factiPiI2CylOffs2.dfacCylOffs7_C "Multiplaktiver Faktor auf den Basiswert des Ansteuerbeginns Zyl bei aktiver Pii2/" VALUE 0x8003E0E4 Kw_Ws16 511.9922 Fact1 -256.0000 255.9922 /end CHARACTERISTIC
/begin CHARACTERISTIC InjCrv_factiPiI2CylOffs2.dfacCylOffs8_C "Multiplaktiver Faktor auf den Basiswert des Ansteuerbeginns Zyl bei aktiver Pii2/" VALUE 0x8003E0E6 Kw_Ws16 511.9922 Fact1 -256.0000 255.9922 /end CHARACTERISTIC
/begin CHARACTERISTIC InjCrv_nMIDynMax_C "Drehzahlschwelle unter der die Korrektur erfolgt" VALUE 0x8003F0F4 Kw_Ws16 6000.000 EngN 0.00 6000.000 EXTENDED_LIMITS -16384.00 16383.50 /end CHARACTERISTIC
/begin CHARACTERISTIC InjCrv_nThreshDelta_C "" VALUE 0x8003DABC Val_Ws16 32767.50 EngN -16384.00 16383.50 /end CHARACTERISTIC
/begin CHARACTERISTIC InjCrv_nThreshLo1_C "" VALUE 0x8003DABE Val_Ws16 32767.50 EngN -16384.00 16383.50 /end CHARACTERISTIC
/begin CHARACTERISTIC InjCrv_nThreshLo2_C "" VALUE 0x8003DAC0 Val_Ws16 32767.50 EngN -16384.00 16383.50 /end CHARACTERISTIC
/begin CHARACTERISTIC InjCrv_nThreshLo3_C "" VALUE 0x8003DAC2 Val_Ws16 32767.50 EngN -16384.00 16383.50 /end CHARACTERISTIC
/begin CHARACTERISTIC InjCrv_nThreshLo4_C "" VALUE 0x8003DAC4 Val_Ws16 32767.50 EngN -16384.00 16383.50 /end CHARACTERISTIC
/begin CHARACTERISTIC InjCrv_nThreshLo5_C "" VALUE 0x8003DAC6 Val_Ws16 32767.50 EngN -16384.00 16383.50 /end CHARACTERISTIC
/begin CHARACTERISTIC InjCrv_nThreshLo6_C "" VALUE 0x8003DAC8 Val_Ws16 32767.50 EngN -16384.00 16383.50 /end CHARACTERISTIC
/begin CHARACTERISTIC InjCrv_nThreshLo7_C "" VALUE 0x8003DACA Val_Ws16 32767.50 EngN -16384.00 16383.50 /end CHARACTERISTIC
/begin CHARACTERISTIC InjCrv_nThreshLoNo_C "" VALUE 0x8003DACC Val_Ws16 32767.50 EngN -16384.00 16383.50 /end CHARACTERISTIC
/begin CHARACTERISTIC InjCrv_nThreshLoR_C "" VALUE 0x8003DACE Val_Ws16 32767.50 EngN -16384.00 16383.50 /end CHARACTERISTIC
/begin CHARACTERISTIC InjCrv_numInjMaxSys_C "Systembedingte maximal erlaubte Anzahl an Einspritzungen" VALUE 0x8003D470 Val_Wu8 6.000 OneToOne 0.00 6.000 EXTENDED_LIMITS 0.00 255.0 /end CHARACTERISTIC
/begin CHARACTERISTIC InjCrv_numInjRtmLim_CUR "Kennlinie für die Begrenzung der Anzahl der Einspritzungen in Abhängigkeit der Drehzahl" CURVE 0x8003D472 Cur_Xs16Ws16 4.000000 OneToOne 1.000000 5.000000 EXTENDED_LIMITS -32768.00 32767.00
 /begin AXIS_DESCR STD_AXIS Epm_nEng EngN 8 0.00 10000.00 EXTENDED_LIMITS -16384.00 16383.50 DEPOSIT ABSOLUTE /end AXIS_DESCR
/end CHARACTERISTIC
/begin CHARACTERISTIC InjCrv_numTraGear1_C "" VALUE 0x8003DAD0 Val_Ws8 255.0 OneToOne -128.0 127.0 /end CHARACTERISTIC
/begin CHARACTERISTIC InjCrv_numTraGear2_C "" VALUE 0x8003DAD1 Val_Ws8 255.0 OneToOne -128.0 127.0 /end CHARACTERISTIC
/begin CHARACTERISTIC InjCrv_numTraGear3_C "" VALUE 0x8003DAD2 Val_Ws8 255.0 OneToOne -128.0 127.0 /end CHARACTERISTIC
/begin CHARACTERISTIC InjCrv_numTraGear4_C "" VALUE 0x8003DAD3 Val_Ws8 255.0 OneToOne -128.0 127.0 /end CHARACTERISTIC
/begin CHARACTERISTIC InjCrv_numTraGear5_C "" VALUE 0x8003DAD4 Val_Ws8 255.0 OneToOne -128.0 127.0 /end CHARACTERISTIC
/begin CHARACTERISTIC InjCrv_numTraGear6_C "" VALUE 0x8003DAD5 Val_Ws8 255.0 OneToOne -128.0 127.0 /end CHARACTERISTIC
/begin CHARACTERISTIC InjCrv_numTraGear7_C "" VALUE 0x8003DAD6 Val_Ws8 255.0 OneToOne -128.0 127.0 /end CHARACTERISTIC
/begin CHARACTERISTIC InjCrv_numTraGearR_C "" VALUE 0x8003DAD7 Val_Ws8 255.0 OneToOne -128.0 127.0 /end CHARACTERISTIC
/begin CHARACTERISTIC InjCrv_numTraNoGear_C "" VALUE 0x8003DAD8 Val_Ws8 255.0 OneToOne -128.0 127.0 /end CHARACTERISTIC
/begin CHARACTERISTIC InjCrv_pAirCylOffsRlsHigh_C "Oberer Grenzwert Hysterese Luftdruck" VALUE 0x8003E0E8 Kw_Ws16 3500.000 Pres_hPa 0.00 3500.000 EXTENDED_LIMITS -32768.00 32767.00 /end CHARACTERISTIC
/begin CHARACTERISTIC InjCrv_pAirCylOffsRlsLow_C "Unterer Grenzwert Hysterese Luftdruck" VALUE 0x8003E0EA Kw_Ws16 3500.000 Pres_hPa 0.00 3500.000 EXTENDED_LIMITS -32768.00 32767.00 /end CHARACTERISTIC
/begin CHARACTERISTIC InjCrv_pAirPiIRlsHigh_C "obere Hystereseschwelle zur atmosphärendruckabhängigen PiI Freigabekorrektur" VALUE 0x8003DC40 Val_Ws16 3500.000 Pres_hPa 0.00 3500.000 EXTENDED_LIMITS -32768.00 32767.00 /end CHARACTERISTIC
/begin CHARACTERISTIC InjCrv_pAirPiIRlsLow_C "untere Hystereseschwelle zur atmosphärendruckabhängigen PiI Freigabekorrektur" VALUE 0x8003DC42 Val_Ws16 3500.000 Pres_hPa 0.00 3500.000 EXTENDED_LIMITS -32768.00 32767.00 /end CHARACTERISTIC
/begin CHARACTERISTIC InjCrv_phiMI1APSCor0Rgn_GMAP "Basis-Ansteuerbeginnkorrekturkennfeld 1 der MI1 abhängig vom Luftdruck im Regenerationsbetrieb" MAP 0x800407AC MapG_Ws16 1439.978 AngleCrS -720.0000 719.9780
 /begin AXIS_DESCR COM_AXIS Epm_nEng EngN 10 0.00 10000.00 EXTENDED_LIMITS -16384.00 16383.50 AXIS_PTS_REF InjCrv_phiMI1APSCorRgnX_AXIS /end AXIS_DESCR
 /begin AXIS_DESCR COM_AXIS InjCtl_qSetUnBal InjMass 10 0.00 327.6700 EXTENDED_LIMITS -327.6800 327.6700 AXIS_PTS_REF InjCrv_phiMI1APSCorRgnY_AXIS /end AXIS_DESCR
/end CHARACTERISTIC
/begin CHARACTERISTIC InjCrv_phiMI1APSCor1Rgn_GMAP "Basis-Ansteuerbeginnkorrekturkennfeld 2 der MI1 abhängig vom Luftdruck im Regenerationsbetrieb" MAP 0x80040874 MapG_Ws16 1439.978 AngleCrS -720.0000 719.9780
 /begin AXIS_DESCR COM_AXIS Epm_nEng EngN 10 0.00 10000.00 EXTENDED_LIMITS -16384.00 16383.50 AXIS_PTS_REF InjCrv_phiMI1APSCorRgnX_AXIS /end AXIS_DESCR
 /begin AXIS_DESCR COM_AXIS InjCtl_qSetUnBal InjMass 10 0.00 327.6700 EXTENDED_LIMITS -327.6800 327.6700 AXIS_PTS_REF InjCrv_phiMI1APSCorRgnY_AXIS /end AXIS_DESCR
/end CHARACTERISTIC
/begin AXIS_PTS InjCrv_phiMI1APSCorRgnX_AXIS "Stützstellenverteilung für die Gruppenkennfelder InjCrv_phiMi1APSCor%Rgn_GMAP abhängig von Epm_nEng" 0x8004093C Epm_nEng Axis_Xs16 10000.00 EngN 10 0.00 10000.00 FORMAT "%8.2" EXTENDED_LIMITS -16384.00 16383.50 DEPOSIT ABSOLUTE /end AXIS_PTS
/begin AXIS_PTS InjCrv_phiMI1APSCorRgnY_AXIS "Stützstellenverteilung für die Gruppenkennfelder InjCrv_phiMi1APSCor%Rgn_GMAP abhängig von InjCtl_qSetUnBal" 0x80040952 InjCtl_qSetUnBal Axis_Xs16 327.6700 InjMass 10 0.00 327.6700 FORMAT "%8.4" EXTENDED_LIMITS -327.6800 327.6700 DEPOSIT ABSOLUTE /end AXIS_PTS
/begin CHARACTERISTIC InjCrv_phiMI1ATSCor0Rgn_GMAP "Basis-Ansteuerbeginnkorrekturkennfeld 1 der MI1 abhängig von der Ansauglufttemperatur im Regenerationsbetrieb" MAP 0x80040968 MapG_Ws16 49.98779 AngleCrS -9.997559 39.99023 EXTENDED_LIMITS -720.0000 719.9780
 /begin AXIS_DESCR COM_AXIS Epm_nEng EngN 6 0.00 10000.00 EXTENDED_LIMITS -16384.00 16383.50 AXIS_PTS_REF InjCrv_phiMI1ATSCorRgnX_AXIS /end AXIS_DESCR
 /begin AXIS_DESCR COM_AXIS InjCtl_qSetUnBal InjMass 6 0.00 327.6700 EXTENDED_LIMITS -327.6800 327.6700 AXIS_PTS_REF InjCrv_phiMI1ATSCorRgnY_AXIS /end AXIS_DESCR
/end CHARACTERISTIC
/begin CHARACTERISTIC InjCrv_phiMI1ATSCor1Rgn_GMAP "Basis-Ansteuerbeginnkorrekturkennfeld 2 der MI1 abhängig von der Ansauglufttemperatur im Regenerationsbetrieb" MAP 0x800409B0 MapG_Ws16 49.98779 AngleCrS -9.997559 39.99023 EXTENDED_LIMITS -720.0000 719.9780
 /begin AXIS_DESCR COM_AXIS Epm_nEng EngN 6 0.00 10000.00 EXTENDED_LIMITS -16384.00 16383.50 AXIS_PTS_REF InjCrv_phiMI1ATSCorRgnX_AXIS /end AXIS_DESCR
 /begin AXIS_DESCR COM_AXIS InjCtl_qSetUnBal InjMass 6 0.00 327.6700 EXTENDED_LIMITS -327.6800 327.6700 AXIS_PTS_REF InjCrv_phiMI1ATSCorRgnY_AXIS /end AXIS_DESCR
/end CHARACTERISTIC
/begin AXIS_PTS InjCrv_phiMI1ATSCorRgnX_AXIS "Stützstellenverteilung für die Gruppenkennfelder InjCrv_phiMi1ATSCor%Rgn_GMAP abhängig von Epm_nEng" 0x800409F8 Epm_nEng Axis_Xs16 10000.00 EngN 6 0.00 10000.00 FORMAT "%8.2" EXTENDED_LIMITS -16384.00 16383.50 DEPOSIT ABSOLUTE /end AXIS_PTS
/begin AXIS_PTS InjCrv_phiMI1ATSCorRgnY_AXIS "Stützstellenverteilung für die Gruppenkennfelder InjCrv_phiMi1ATSCor%Rgn_GMAP abhängig von InjCtl_qSetUnBal" 0x80040A06 InjCtl_qSetUnBal Axis_Xs16 327.6700 InjMass 6 0.00 327.6700 FORMAT "%8.4" EXTENDED_LIMITS -327.6800 327.6700 DEPOSIT ABSOLUTE /end AXIS_PTS
/begin CHARACTERISTIC InjCrv_phiMI1Bas0Rgn1_GMAP "Basiskennfeld 1 für den Ansteuerwinkel der HE1 in Regenerationstufe 1" MAP 0x80040B98 MapG_Ws16 49.98779 AngleCrS -9.997559 39.99023 EXTENDED_LIMITS -720.0000 719.9780
 /begin AXIS_DESCR COM_AXIS Epm_nEng EngN 16 0.00 10000.00 EXTENDED_LIMITS -16384.00 16383.50 AXIS_PTS_REF InjCrv_phiMI1BasRgn1X_AXIS /end AXIS_DESCR
 /begin AXIS_DESCR COM_AXIS InjCtl_qSetUnBal InjMass 16 0.00 327.6700 EXTENDED_LIMITS -327.6800 327.6700 AXIS_PTS_REF InjCrv_phiMI1BasRgn1Y_AXIS /end AXIS_DESCR
/end CHARACTERISTIC
/begin CHARACTERISTIC InjCrv_phiMI1Bas0Rgn2_GMAP "Basiskennfeld 2 für den Ansteuerwinkel der HE1 in Regenerationstufe 1" MAP 0x80040D98 MapG_Ws16 49.98779 AngleCrS -9.997559 39.99023 EXTENDED_LIMITS -720.0000 719.9780
 /begin AXIS_DESCR COM_AXIS Epm_nEng EngN 16 0.00 10000.00 EXTENDED_LIMITS -16384.00 16383.50 AXIS_PTS_REF InjCrv_phiMI1BasRgn2X_AXIS /end AXIS_DESCR
 /begin AXIS_DESCR COM_AXIS InjCtl_qSetUnBal InjMass 16 0.00 327.6700 EXTENDED_LIMITS -327.6800 327.6700 AXIS_PTS_REF InjCrv_phiMI1BasRgn2Y_AXIS /end AXIS_DESCR
/end CHARACTERISTIC
/begin CHARACTERISTIC InjCrv_phiMI1Bas0Rgn3_GMAP "Basiskennfeld 3 für den Ansteuerwinkel der HE1 in Regenerationstufe 1" MAP 0x80040F98 MapG_Ws16 49.98779 AngleCrS -9.997559 39.99023 EXTENDED_LIMITS -720.0000 719.9780
 /begin AXIS_DESCR COM_AXIS Epm_nEng EngN 2 0.00 10000.00 EXTENDED_LIMITS -16384.00 16383.50 AXIS_PTS_REF InjCrv_phiMI1BasRgn3X_AXIS /end AXIS_DESCR
 /begin AXIS_DESCR COM_AXIS InjCtl_qSetUnBal InjMass 2 0.00 327.6700 EXTENDED_LIMITS -327.6800 327.6700 AXIS_PTS_REF InjCrv_phiMI1BasRgn3Y_AXIS /end AXIS_DESCR
/end CHARACTERISTIC
/begin CHARACTERISTIC InjCrv_phiMI1Bas1BstLP_MAP "" MAP 0x8003E228 Map_Xs16Ys16Ws16 1439.978 AngleCrS -720.0000 719.9780
 /begin AXIS_DESCR STD_AXIS Epm_nEng EngN 16 -16384.00 16383.50 DEPOSIT ABSOLUTE /end AXIS_DESCR
 /begin AXIS_DESCR STD_AXIS InjCtl_qSetUnBal InjMass 16 -327.6800 327.6700 DEPOSIT ABSOLUTE /end AXIS_DESCR
/end CHARACTERISTIC
/begin CHARACTERISTIC InjCrv_phiMI1Bas1Rgn1_GMAP "Basiswert für Ansteuerbeginn der MI1 im Regenerationsbetrieb und keiner Voreinspritzung" MAP 0x80040FA0 MapG_Ws16 49.98779 AngleCrS -9.997559 39.99023 EXTENDED_LIMITS -720.0000 719.9780
 /begin AXIS_DESCR COM_AXIS Epm_nEng EngN 16 0.00 10000.00 EXTENDED_LIMITS -16384.00 16383.50 AXIS_PTS_REF InjCrv_phiMI1BasRgn1X_AXIS /end AXIS_DESCR
 /begin AXIS_DESCR COM_AXIS InjCtl_qSetUnBal InjMass 16 0.00 327.6700 EXTENDED_LIMITS -327.6800 327.6700 AXIS_PTS_REF InjCrv_phiMI1BasRgn1Y_AXIS /end AXIS_DESCR
/end CHARACTERISTIC
/begin CHARACTERISTIC InjCrv_phiMI1Bas1Rgn2_GMAP "Basiswert für Ansteuerbeginn der MI1 im Regenerationsbetrieb bei eingeschalteter PiI1" MAP 0x800411A0 MapG_Ws16 49.98779 AngleCrS -9.997559 39.99023 EXTENDED_LIMITS -720.0000 719.9780
 /begin AXIS_DESCR COM_AXIS Epm_nEng EngN 16 0.00 10000.00 EXTENDED_LIMITS -16384.00 16383.50 AXIS_PTS_REF InjCrv_phiMI1BasRgn2X_AXIS /end AXIS_DESCR
 /begin AXIS_DESCR COM_AXIS InjCtl_qSetUnBal InjMass 16 0.00 327.6700 EXTENDED_LIMITS -327.6800 327.6700 AXIS_PTS_REF InjCrv_phiMI1BasRgn2Y_AXIS /end AXIS_DESCR
/end CHARACTERISTIC
/begin CHARACTERISTIC InjCrv_phiMI1Bas1Rgn3_GMAP "Basiswert für Ansteuerbeginn der MI1 im Regenerationsbetrieb bei eingeschalteter PiI1 & PiI2" MAP 0x800413A0 MapG_Ws16 49.98779 AngleCrS -9.997559 39.99023 EXTENDED_LIMITS -720.0000 719.9780
 /begin AXIS_DESCR COM_AXIS Epm_nEng EngN 2 0.00 10000.00 EXTENDED_LIMITS -16384.00 16383.50 AXIS_PTS_REF InjCrv_phiMI1BasRgn3X_AXIS /end AXIS_DESCR
 /begin AXIS_DESCR COM_AXIS InjCtl_qSetUnBal InjMass 2 0.00 327.6700 EXTENDED_LIMITS -327.6800 327.6700 AXIS_PTS_REF InjCrv_phiMI1BasRgn3Y_AXIS /end AXIS_DESCR
/end CHARACTERISTIC
/begin CHARACTERISTIC InjCrv_phiMI1Bas1_MAP "1. Grundwertekennfeld, Ansteuerbeginn MI1" MAP 0x8003E46C Map_Xs16Ys16Ws16 1439.978 AngleCrS -720.0000 719.9780
 /begin AXIS_DESCR STD_AXIS Epm_nEng EngN 16 0.00 10000.00 EXTENDED_LIMITS -16384.00 16383.50 DEPOSIT ABSOLUTE /end AXIS_DESCR
 /begin AXIS_DESCR STD_AXIS InjCtl_qSetUnBal InjMass 16 0.00 327.6700 EXTENDED_LIMITS -327.6800 327.6700 DEPOSIT ABSOLUTE /end AXIS_DESCR
/end CHARACTERISTIC
/begin CHARACTERISTIC InjCrv_phiMI1Bas2BstLP_MAP "" MAP 0x8003E6B0 Map_Xs16Ys16Ws16 1439.978 AngleCrS -720.0000 719.9780
 /begin AXIS_DESCR STD_AXIS Epm_nEng EngN 16 -16384.00 16383.50 DEPOSIT ABSOLUTE /end AXIS_DESCR
 /begin AXIS_DESCR STD_AXIS InjCtl_qSetUnBal InjMass 16 -327.6800 327.6700 DEPOSIT ABSOLUTE /end AXIS_DESCR
/end CHARACTERISTIC
/begin CHARACTERISTIC InjCrv_phiMI1Bas2_MAP "2. Grundwertekennfeld, Ansteuerbeginn MI1" MAP 0x8003E8F4 Map_Xs16Ys16Ws16 49.98779 AngleCrS -9.997559 39.99023 EXTENDED_LIMITS -720.0000 719.9780
 /begin AXIS_DESCR STD_AXIS Epm_nEng EngN 16 0.00 10000.00 EXTENDED_LIMITS -16384.00 16383.50 DEPOSIT ABSOLUTE /end AXIS_DESCR
 /begin AXIS_DESCR STD_AXIS InjCtl_qSetUnBal InjMass 16 0.00 327.6700 EXTENDED_LIMITS -327.6800 327.6700 DEPOSIT ABSOLUTE /end AXIS_DESCR
/end CHARACTERISTIC
/begin CHARACTERISTIC InjCrv_phiMI1Bas3_MAP "3. Grundwertekennfeld, Ansteuerbeginn MI1" MAP 0x8003EB38 Map_Xs16Ys16Ws16 49.98779 AngleCrS -9.997559 39.99023 EXTENDED_LIMITS -720.0000 719.9780
 /begin AXIS_DESCR STD_AXIS Epm_nEng EngN 16 0.00 10000.00 EXTENDED_LIMITS -16384.00 16383.50 DEPOSIT ABSOLUTE /end AXIS_DESCR
 /begin AXIS_DESCR STD_AXIS InjCtl_qSetUnBal InjMass 16 0.00 327.6700 EXTENDED_LIMITS -327.6800 327.6700 DEPOSIT ABSOLUTE /end AXIS_DESCR
/end CHARACTERISTIC
/begin CHARACTERISTIC InjCrv_phiMI1Bas4_MAP "4. Grundwertekennfeld, Ansteuerbeginn MI1" MAP 0x8003ED7C Map_Xs16Ys16Ws16 49.98779 AngleCrS -9.997559 39.99023 EXTENDED_LIMITS -720.0000 719.9780
 /begin AXIS_DESCR STD_AXIS Epm_nEng EngN 2 0.00 10000.00 EXTENDED_LIMITS -16384.00 16383.50 DEPOSIT ABSOLUTE /end AXIS_DESCR
 /begin AXIS_DESCR STD_AXIS InjCtl_qSetUnBal InjMass 2 0.00 327.6700 EXTENDED_LIMITS -327.6800 327.6700 DEPOSIT ABSOLUTE /end AXIS_DESCR
/end CHARACTERISTIC
/begin CHARACTERISTIC InjCrv_phiMI1Bas5_MAP "5. Grundwertekennfeld, Ansteuerbeginn MI1" MAP 0x8003ED90 Map_Xs16Ys16Ws16 49.98779 AngleCrS -9.997559 39.99023 EXTENDED_LIMITS -720.0000 719.9780
 /begin AXIS_DESCR STD_AXIS Epm_nEng EngN 2 0.00 10000.00 EXTENDED_LIMITS -16384.00 16383.50 DEPOSIT ABSOLUTE /end AXIS_DESCR
 /begin AXIS_DESCR STD_AXIS InjCtl_qSetUnBal InjMass 2 0.00 327.6700 EXTENDED_LIMITS -327.6800 327.6700 DEPOSIT ABSOLUTE /end AXIS_DESCR
/end CHARACTERISTIC
/begin CHARACTERISTIC InjCrv_phiMI1BasCylOffs_MAP "betriebspunktabhängige Berechnung des Offsets der MI1" MAP 0x8003E0EC Kf_Xs16_Ys16_Ws16 49.98779 AngleCrS -9.997559 39.99023 EXTENDED_LIMITS -720.0000 719.9780
 /begin AXIS_DESCR STD_AXIS Epm_nEng EngN 5 0.00 6000.000 EXTENDED_LIMITS -16384.00 16383.50 DEPOSIT ABSOLUTE /end AXIS_DESCR
 /begin AXIS_DESCR STD_AXIS InjCtl_qSetUnBal InjMass 5 0.00 327.6700 EXTENDED_LIMITS -327.6800 327.6700 DEPOSIT ABSOLUTE /end AXIS_DESCR
/end CHARACTERISTIC
/begin AXIS_PTS InjCrv_phiMI1BasRgn1X_AXIS "Stützstellenverteilung der Gruppenkennfelder InjCrv_phiMI1Bas%Rgn1_GMAP für die Eingangsgröße Eng_nAvrg" 0x800413A8 Epm_nEng Axis_Xs16 10000.00 EngN 16 0.00 10000.00 FORMAT "%8.2" EXTENDED_LIMITS -16384.00 16383.50 DEPOSIT ABSOLUTE /end AXIS_PTS
/begin AXIS_PTS InjCrv_phiMI1BasRgn1Y_AXIS "Stützstellenverteilung der Gruppenkennfelder InjCrv_phiMI1Bas%Rgn1_GMAP für die Eingangsgröße InjCtl_qSetUnBal" 0x800413CA InjCtl_qSetUnBal Axis_Xs16 327.6700 InjMass 16 0.00 327.6700 FORMAT "%8.4" EXTENDED_LIMITS -327.6800 327.6700 DEPOSIT ABSOLUTE /end AXIS_PTS
/begin AXIS_PTS InjCrv_phiMI1BasRgn2X_AXIS "Stützstellenverteilung der Gruppenkennfelder InjCrv_phiMI1Bas%Rgn1_GMAP für die Eingangsgröße Eng_nAvrg" 0x800413EC Epm_nEng Axis_Xs16 10000.00 EngN 16 0.00 10000.00 FORMAT "%8.2" EXTENDED_LIMITS -16384.00 16383.50 DEPOSIT ABSOLUTE /end AXIS_PTS
/begin AXIS_PTS InjCrv_phiMI1BasRgn2Y_AXIS "Stützstellenverteilung der Gruppenkennfelder InjCrv_phiMI1Bas%Rgn1_GMAP für die Eingangsgröße InjCtl_qSetUnBal" 0x8004140E InjCtl_qSetUnBal Axis_Xs16 327.6700 InjMass 16 0.00 327.6700 FORMAT "%8.4" EXTENDED_LIMITS -327.6800 327.6700 DEPOSIT ABSOLUTE /end AXIS_PTS
/begin AXIS_PTS InjCrv_phiMI1BasRgn3X_AXIS "Stützstellenverteilung der Gruppenkennfelder InjCrv_phiMI1Bas%Rgn1_GMAP für die Eingangsgröße Eng_nAvrg" 0x80041430 Epm_nEng Axis_Xs16 10000.00 EngN 2 0.00 10000.00 FORMAT "%8.2" EXTENDED_LIMITS -16384.00 16383.50 DEPOSIT ABSOLUTE /end AXIS_PTS
/begin AXIS_PTS InjCrv_phiMI1BasRgn3Y_AXIS "Stützstellenverteilung der Gruppenkennfelder InjCrv_phiMI1Bas%Rgn1_GMAP für die Eingangsgröße InjCtl_qSetUnBal" 0x80041436 InjCtl_qSetUnBal Axis_Xs16 327.6700 InjMass 2 0.00 327.6700 FORMAT "%8.4" EXTENDED_LIMITS -327.6800 327.6700 DEPOSIT ABSOLUTE /end AXIS_PTS
/begin CHARACTERISTIC InjCrv_phiMI1BasStrt_MAP "1st base map of MI1 SOE" MAP 0x80041732 Kf_Xs16_Ys16_Ws16 49.98779 AngleCrS -9.997559 39.99023 EXTENDED_LIMITS -720.0000 719.9780
 /begin AXIS_DESCR STD_AXIS Epm_nEng EngN 8 0.00 6000.000 EXTENDED_LIMITS -16384.00 16383.50 DEPOSIT ABSOLUTE /end AXIS_DESCR
 /begin AXIS_DESCR STD_AXIS InjCtl_qSetUnBal InjMass 8 0.00 327.6700 EXTENDED_LIMITS -327.6800 327.6700 DEPOSIT ABSOLUTE /end AXIS_DESCR
/end CHARACTERISTIC
/begin CHARACTERISTIC InjCrv_phiMI1DesCSCMax_MAP "Kennfeld zur Bestimmung der Maximalwinkels der MI1 nach CSC-Korrektur" MAP 0x8003EED2 Map_Xs16Ys16Ws16 49.98779 AngleCrS -9.997559 39.99023 EXTENDED_LIMITS -720.0000 719.9780
 /begin AXIS_DESCR STD_AXIS Epm_nEng EngN 2 0.00 10000.00 EXTENDED_LIMITS -16384.00 16383.50 DEPOSIT ABSOLUTE /end AXIS_DESCR
 /begin AXIS_DESCR STD_AXIS InjCtl_qSetUnBal InjMass 2 0.00 327.6700 EXTENDED_LIMITS -327.6800 327.6700 DEPOSIT ABSOLUTE /end AXIS_DESCR
/end CHARACTERISTIC
/begin CHARACTERISTIC InjCrv_phiMI1DesCSCMin_MAP "Kennfeld zur Bestimmung der Minimalwinkels der MI1 nach CSC-Korrektur" MAP 0x8003EEE6 Map_Xs16Ys16Ws16 49.98779 AngleCrS -9.997559 39.99023 EXTENDED_LIMITS -720.0000 719.9780
 /begin AXIS_DESCR STD_AXIS Epm_nEng EngN 2 0.00 10000.00 EXTENDED_LIMITS -16384.00 16383.50 DEPOSIT ABSOLUTE /end AXIS_DESCR
 /begin AXIS_DESCR STD_AXIS InjCtl_qSetUnBal InjMass 2 0.00 327.6700 EXTENDED_LIMITS -327.6800 327.6700 DEPOSIT ABSOLUTE /end AXIS_DESCR
/end CHARACTERISTIC
/begin CHARACTERISTIC InjCrv_phiMI1DesCSC_CUR "CSC-Winkelkorrektur für MI1" CURVE 0x8003EEFA Cur_Xs16Ws16 19.99512 AngleCrS -9.997559 9.997559 EXTENDED_LIMITS -720.0000 719.9780
 /begin AXIS_DESCR STD_AXIS InjCrv_rMI1DesCSC_mp Prc_Fact100 2 -50.00000 50.00000 FORMAT "%8.5" EXTENDED_LIMITS -327.6800 327.6700 DEPOSIT ABSOLUTE /end AXIS_DESCR
/end CHARACTERISTIC
/begin CHARACTERISTIC InjCrv_phiMI1Des_C "Fernsteuerwert des Ansteuerbeginns der MI" VALUE 0x8003EDA4 Val_Ws16 49.98779 AngleCrS -9.997559 39.99023 EXTENDED_LIMITS -720.0000 719.9780 /end CHARACTERISTIC
/begin CHARACTERISTIC InjCrv_phiMI1DynCor2_MAP "Basiskorrekturkennfeld für MI bei SOE Korrektur 2" MAP 0x8003F0F6 Kf_Xs16_Ys16_Ws16 50.00977 AngleCrS -25.00488 25.00488 EXTENDED_LIMITS -720.0000 719.9780
 /begin AXIS_DESCR STD_AXIS Epm_nEng EngN 16 0.00 6000.000 EXTENDED_LIMITS -16384.00 16383.50 DEPOSIT ABSOLUTE /end AXIS_DESCR
 /begin AXIS_DESCR STD_AXIS InjCtl_qSetUnBal InjMass 8 0.00 327.6700 EXTENDED_LIMITS -327.6800 327.6700 DEPOSIT ABSOLUTE /end AXIS_DESCR
/end CHARACTERISTIC
/begin CHARACTERISTIC InjCrv_phiMI1ETSCor0Rgn_GMAP "Basis-Ansteuerbeginnkorrekturkennfeld 1 der MI1 abhängig von der Motortemperatur im Regenerationsbetrieb" MAP 0x80040A14 MapG_Ws16 49.98779 AngleCrS -9.997559 39.99023 EXTENDED_LIMITS -720.0000 719.9780
 /begin AXIS_DESCR COM_AXIS Epm_nEng EngN 2 0.00 10000.00 EXTENDED_LIMITS -16384.00 16383.50 AXIS_PTS_REF InjCrv_phiMI1ETSCorRgnX_AXIS /end AXIS_DESCR
 /begin AXIS_DESCR COM_AXIS InjCtl_qSetUnBal InjMass 2 0.00 327.6700 EXTENDED_LIMITS -327.6800 327.6700 AXIS_PTS_REF InjCrv_phiMI1ETSCorRgnY_AXIS /end AXIS_DESCR
/end CHARACTERISTIC
/begin CHARACTERISTIC InjCrv_phiMI1ETSCor1Rgn_GMAP "Basis-Ansteuerbeginnkorrekturkennfeld 2 der MI1 abhängig von der Motortemperatur im Regenerationsbetrieb" MAP 0x80040A1C MapG_Ws16 49.98779 AngleCrS -9.997559 39.99023 EXTENDED_LIMITS -720.0000 719.9780
 /begin AXIS_DESCR COM_AXIS Epm_nEng EngN 2 0.00 10000.00 EXTENDED_LIMITS -16384.00 16383.50 AXIS_PTS_REF InjCrv_phiMI1ETSCorRgnX_AXIS /end AXIS_DESCR
 /begin AXIS_DESCR COM_AXIS InjCtl_qSetUnBal InjMass 2 0.00 327.6700 EXTENDED_LIMITS -327.6800 327.6700 AXIS_PTS_REF InjCrv_phiMI1ETSCorRgnY_AXIS /end AXIS_DESCR
/end CHARACTERISTIC
/begin AXIS_PTS InjCrv_phiMI1ETSCorRgnX_AXIS "Stützstellenverteilung für die Gruppenkennfelder InjCrv_phiMi1ETSCor%Rgn_GMAP abhängig von Epm_nEng" 0x80040A24 Epm_nEng Axis_Xs16 10000.00 EngN 2 0.00 10000.00 FORMAT "%8.2" EXTENDED_LIMITS -16384.00 16383.50 DEPOSIT ABSOLUTE /end AXIS_PTS
/begin AXIS_PTS InjCrv_phiMI1ETSCorRgnY_AXIS "Stützstellenverteilung für die Gruppenkennfelder InjCrv_phiMi1ETSCor%Rgn_GMAP abhängig von InjCtl_qSetUnBal" 0x80040A2A InjCtl_qSetUnBal Axis_Xs16 327.6700 InjMass 2 0.00 327.6700 FORMAT "%8.4" EXTENDED_LIMITS -327.6800 327.6700 DEPOSIT ABSOLUTE /end AXIS_PTS
/begin CHARACTERISTIC InjCrv_phiMI1Max1_MAP "Kennfeld 1 für frühesten Ansteuerbeginn MI1" MAP 0x8003EDA6 MapG_Ws16 49.98779 AngleCrS -9.997559 39.99023 EXTENDED_LIMITS -720.0000 719.9780
 /begin AXIS_DESCR COM_AXIS Epm_nEng EngN 8 0.00 10000.00 EXTENDED_LIMITS -16384.00 16383.50 AXIS_PTS_REF InjCrv_phiMI1Max_X_AXIS /end AXIS_DESCR
 /begin AXIS_DESCR COM_AXIS InjCtl_qSetUnBal InjMass 8 -327.6800 327.6700 AXIS_PTS_REF InjCrv_phiMI1Max_Y_AXIS /end AXIS_DESCR
/end CHARACTERISTIC
/begin CHARACTERISTIC InjCrv_phiMI1Max2_MAP "Kennfeld 2 für frühesten Ansteuerbeginn MI1" MAP 0x8003EE26 MapG_Ws16 49.98779 AngleCrS -9.997559 39.99023 EXTENDED_LIMITS -720.0000 719.9780
 /begin AXIS_DESCR COM_AXIS Epm_nEng EngN 8 0.00 10000.00 EXTENDED_LIMITS -16384.00 16383.50 AXIS_PTS_REF InjCrv_phiMI1Max_X_AXIS /end AXIS_DESCR
 /begin AXIS_DESCR COM_AXIS InjCtl_qSetUnBal InjMass 8 -327.6800 327.6700 AXIS_PTS_REF InjCrv_phiMI1Max_Y_AXIS /end AXIS_DESCR
/end CHARACTERISTIC
/begin CHARACTERISTIC InjCrv_phiMI1MaxRgn_MAP "Kennfeld zur Ermittlung des Maximalwinkels der MI1 im Regenerationsbetrieb" MAP 0x8004143C Map_Xs16Ys16Ws16 1439.978 AngleCrS -720.0000 719.9780
 /begin AXIS_DESCR STD_AXIS Epm_nEng EngN 8 -16384.00 16383.50 DEPOSIT ABSOLUTE /end AXIS_DESCR
 /begin AXIS_DESCR STD_AXIS InjCtl_qSetUnBal InjMass 8 0.00 327.6700 EXTENDED_LIMITS -327.6800 327.6700 DEPOSIT ABSOLUTE /end AXIS_DESCR
/end CHARACTERISTIC
/begin AXIS_PTS InjCrv_phiMI1Max_X_AXIS "gemeinsame X-Achse der Kennfelder für frühesten Ansteuerbeginn für MI" 0x8003EEA6 Epm_nEng Axis_Xs16 10000.00 EngN 8 0.00 10000.00 FORMAT "%8.2" EXTENDED_LIMITS -16384.00 16383.50 DEPOSIT ABSOLUTE /end AXIS_PTS
/begin AXIS_PTS InjCrv_phiMI1Max_Y_AXIS "gemeinsame Y-Achse der Kennfelder für frühesten Ansteuerbeginn für MI" 0x8003EEB8 InjCtl_qSetUnBal Axis_Xs16 655.3500 InjMass 8 -327.6800 327.6700 FORMAT "%8.4" DEPOSIT ABSOLUTE /end AXIS_PTS
/begin CHARACTERISTIC InjCrv_phiMI1MinRgn_C "Minimalwert für den Winkel der MI1 im Regenerationsbetrieb" VALUE 0x800414E0 Val_Ws16 1439.978 AngleCrS -720.0000 719.9780 /end CHARACTERISTIC
/begin CHARACTERISTIC InjCrv_phiMI1Min_C "spätester Ansteuerbeginn der MI1" VALUE 0x8003EECA Val_Ws16 49.98779 AngleCrS -9.997559 39.99023 EXTENDED_LIMITS -720.0000 719.9780 /end CHARACTERISTIC
/begin CHARACTERISTIC InjCrv_phiMIAPSCor1_MAP "atmosphärendruckabhängiges Korrekturkennfeld 1 für Ansteuerbeginn MI1" MAP 0x8003FAB4 MapG_Ws16 19.99512 AngleCrS -9.997559 9.997559 EXTENDED_LIMITS -720.0000 719.9780
 /begin AXIS_DESCR COM_AXIS Epm_nEng EngN 16 0.00 10000.00 EXTENDED_LIMITS -16384.00 16383.50 AXIS_PTS_REF InjCrv_phiMIAPSCor_X_AXIS /end AXIS_DESCR
 /begin AXIS_DESCR COM_AXIS InjCtl_qSetUnBal InjMass 16 0.00 327.6700 EXTENDED_LIMITS -327.6800 327.6700 AXIS_PTS_REF InjCrv_phiMIAPSCor_Y_AXIS /end AXIS_DESCR
/end CHARACTERISTIC
/begin CHARACTERISTIC InjCrv_phiMIAPSCor2_MAP "atmosphärendruckabhängiges Korrekturkennfeld 2 für Ansteuerbeginn MI1" MAP 0x8003FCB4 MapG_Ws16 19.99512 AngleCrS -9.997559 9.997559 EXTENDED_LIMITS -720.0000 719.9780
 /begin AXIS_DESCR COM_AXIS Epm_nEng EngN 16 0.00 10000.00 EXTENDED_LIMITS -16384.00 16383.50 AXIS_PTS_REF InjCrv_phiMIAPSCor_X_AXIS /end AXIS_DESCR
 /begin AXIS_DESCR COM_AXIS InjCtl_qSetUnBal InjMass 16 0.00 327.6700 EXTENDED_LIMITS -327.6800 327.6700 AXIS_PTS_REF InjCrv_phiMIAPSCor_Y_AXIS /end AXIS_DESCR
/end CHARACTERISTIC
/begin CHARACTERISTIC InjCrv_phiMIAPSCorStrt_MAP "base value for SOE correction to be weighted by air pressure" MAP 0x8003F22A Kf_Xs16_Ys16_Ws16 1439.978 AngleCrS -720.0000 719.9780
 /begin AXIS_DESCR STD_AXIS Epm_nEng EngN 8 -16384.00 16383.50 DEPOSIT ABSOLUTE /end AXIS_DESCR
 /begin AXIS_DESCR STD_AXIS InjCtl_qSetUnBal InjMass 8 -327.6800 327.6700 DEPOSIT ABSOLUTE /end AXIS_DESCR
/end CHARACTERISTIC
/begin AXIS_PTS InjCrv_phiMIAPSCor_X_AXIS "gemeinsame X-Achse für atmosphärendruckabhängige Ansteuerbeginnkorrekturkennfelder für MI" 0x8003FEB4 Epm_nEng Axis_Xs16 10000.00 EngN 16 0.00 10000.00 FORMAT "%8.2" EXTENDED_LIMITS -16384.00 16383.50 DEPOSIT ABSOLUTE /end AXIS_PTS
/begin AXIS_PTS InjCrv_phiMIAPSCor_Y_AXIS "gemeinsame Y-Achse für atmosphärendruckabhängige Ansteuerbeginnkorrekturkennfelder für MI" 0x8003FED6 InjCtl_qSetUnBal Axis_Xs16 327.6700 InjMass 16 0.00 327.6700 FORMAT "%8.4" EXTENDED_LIMITS -327.6800 327.6700 DEPOSIT ABSOLUTE /end AXIS_PTS
/begin CHARACTERISTIC InjCrv_phiMIAPSDynCor_MAP "Korrekturkennfeld für Ansteuerbeginn der Haupteinspritzung" MAP 0x8003F2CE Kf_Xs16_Ys16_Ws16 50.00977 AngleCrS -25.00488 25.00488 EXTENDED_LIMITS -720.0000 719.9780
 /begin AXIS_DESCR STD_AXIS Epm_nEng EngN 4 0.00 6000.000 EXTENDED_LIMITS -16384.00 16383.50 DEPOSIT ABSOLUTE /end AXIS_DESCR
 /begin AXIS_DESCR STD_AXIS InjCrv_dpMIDynCor_mp dp_dZ20 4 -1000.000 1000.000 FORMAT "%8.3" EXTENDED_LIMITS -327680.0 327670.0 DEPOSIT ABSOLUTE /end AXIS_DESCR
/end CHARACTERISTIC
/begin CHARACTERISTIC InjCrv_phiMIATSCor1_MAP "ansauglufttemperaturabhängiges Korrekturkennfeld 1 für Ansteuerbeginn MI1" MAP 0x8003FEF8 MapG_Ws16 19.99512 AngleCrS -9.997559 9.997559 EXTENDED_LIMITS -720.0000 719.9780
 /begin AXIS_DESCR COM_AXIS Epm_nEng EngN 16 0.00 10000.00 EXTENDED_LIMITS -16384.00 16383.50 AXIS_PTS_REF InjCrv_phiMIATSCor_X_AXIS /end AXIS_DESCR
 /begin AXIS_DESCR COM_AXIS InjCtl_qSetUnBal InjMass 16 0.00 327.6700 EXTENDED_LIMITS -327.6800 327.6700 AXIS_PTS_REF InjCrv_phiMIATSCor_Y_AXIS /end AXIS_DESCR
/end CHARACTERISTIC
/begin CHARACTERISTIC InjCrv_phiMIATSCor2_MAP "ansauglufttemperaturabhängiges Korrekturkennfeld 2 für Ansteuerbeginn MI1" MAP 0x800400F8 MapG_Ws16 19.99512 AngleCrS -9.997559 9.997559 EXTENDED_LIMITS -720.0000 719.9780
 /begin AXIS_DESCR COM_AXIS Epm_nEng EngN 16 0.00 10000.00 EXTENDED_LIMITS -16384.00 16383.50 AXIS_PTS_REF InjCrv_phiMIATSCor_X_AXIS /end AXIS_DESCR
 /begin AXIS_DESCR COM_AXIS InjCtl_qSetUnBal InjMass 16 0.00 327.6700 EXTENDED_LIMITS -327.6800 327.6700 AXIS_PTS_REF InjCrv_phiMIATSCor_Y_AXIS /end AXIS_DESCR
/end CHARACTERISTIC
/begin CHARACTERISTIC InjCrv_phiMIATSCorStrt_MAP "base value for SOE correction to be weighted by intake air temperature" MAP 0x8003F302 Kf_Xs16_Ys16_Ws16 1439.978 AngleCrS -720.0000 719.9780
 /begin AXIS_DESCR STD_AXIS Epm_nEng EngN 2 -16384.00 16383.50 DEPOSIT ABSOLUTE /end AXIS_DESCR
 /begin AXIS_DESCR STD_AXIS InjCtl_qSetUnBal InjMass 2 -327.6800 327.6700 DEPOSIT ABSOLUTE /end AXIS_DESCR
/end CHARACTERISTIC
/begin AXIS_PTS InjCrv_phiMIATSCor_X_AXIS "gemeinsame X-Achse für ansauglufttemperaturabhängige Ansteuerbeginnkorrekturkennfelder für MI" 0x800402F8 Epm_nEng Axis_Xs16 10000.00 EngN 16 0.00 10000.00 FORMAT "%8.2" EXTENDED_LIMITS -16384.00 16383.50 DEPOSIT ABSOLUTE /end AXIS_PTS
/begin AXIS_PTS InjCrv_phiMIATSCor_Y_AXIS "gemeinsame Y-Achse für ansauglufttemperaturabhängige Ansteuerbeginnkorrekturkennfelder für MI" 0x8004031A InjCtl_qSetUnBal Axis_Xs16 327.6700 InjMass 16 0.00 327.6700 FORMAT "%8.4" EXTENDED_LIMITS -327.6800 327.6700 DEPOSIT ABSOLUTE /end AXIS_PTS
/begin CHARACTERISTIC InjCrv_phiMIDynCor_MAP "Korrekturkennfeld für Ansteuerbeginn Haupteinspritzung" MAP 0x8003F316 Kf_Xs16_Ys16_Ws16 50.00977 AngleCrS -25.00488 25.00488 EXTENDED_LIMITS -720.0000 719.9780
 /begin AXIS_DESCR STD_AXIS Epm_nEng EngN 2 0.00 6000.000 EXTENDED_LIMITS -16384.00 16383.50 DEPOSIT ABSOLUTE /end AXIS_DESCR
 /begin AXIS_DESCR STD_AXIS InjCtl_qSetUnBal InjMass 2 0.00 327.6700 EXTENDED_LIMITS -327.6800 327.6700 DEPOSIT ABSOLUTE /end AXIS_DESCR
/end CHARACTERISTIC
/begin CHARACTERISTIC InjCrv_phiMIDynMax_C "Max. Grenze für Korrekturwert des Ansteuerbeginns der MI1" VALUE 0x8003F32A Kw_Ws16 50.00977 AngleCrS -25.00488 25.00488 EXTENDED_LIMITS -720.0000 719.9780 /end CHARACTERISTIC
/begin CHARACTERISTIC InjCrv_phiMIDynMin_C "Min. Grenze für Korrekturwert des Ansteuerbeginns der MI1" VALUE 0x8003F32C Kw_Ws16 50.00977 AngleCrS -25.00488 25.00488 EXTENDED_LIMITS -720.0000 719.9780 /end CHARACTERISTIC
/begin CHARACTERISTIC InjCrv_phiMIEGRDynCor_MAP "" MAP 0x8003F32E Kf_Xs16_Ys16_Ws16 50.00977 AngleCrS -25.00488 25.00488 EXTENDED_LIMITS -720.0000 719.9780
 /begin AXIS_DESCR STD_AXIS Epm_nEng EngN 10 0.00 6000.000 EXTENDED_LIMITS -16384.00 16383.50 DEPOSIT ABSOLUTE /end AXIS_DESCR
 /begin AXIS_DESCR STD_AXIS InjCtl_qSetUnBal InjMass 10 0.00 327.6700 EXTENDED_LIMITS -327.6800 327.6700 DEPOSIT ABSOLUTE /end AXIS_DESCR
/end CHARACTERISTIC
/begin CHARACTERISTIC InjCrv_phiMIEgrLPCor_MAP "" MAP 0x8003F422 Kf_Xs16_Ys16_Ws16 50.00977 AngleCrS -25.00488 25.00488 EXTENDED_LIMITS -720.0000 719.9780
 /begin AXIS_DESCR STD_AXIS Epm_nEng EngN 10 -16384.00 16383.50 DEPOSIT ABSOLUTE /end AXIS_DESCR
 /begin AXIS_DESCR STD_AXIS InjCtl_qCurr InjMass 8 -327.6800 327.6700 DEPOSIT ABSOLUTE /end AXIS_DESCR
/end CHARACTERISTIC
/begin CHARACTERISTIC InjCrv_phiMIETSCor11_GMAP "Motortemperaturabhängiges Ansteuerbeginnkorrekturkennfeld 1 für MI1" MAP 0x8003F4EA Gkf_Ws16 1439.978 AngleCrS -720.0000 719.9780
 /begin AXIS_DESCR COM_AXIS Epm_nEng EngN 16 0.00 6000.000 EXTENDED_LIMITS -16384.00 16383.50 AXIS_PTS_REF InjCrv_phiMIETSCor1_X_AXIS /end AXIS_DESCR
 /begin AXIS_DESCR COM_AXIS InjCtl_qSetUnBal InjMass 16 0.00 327.6700 EXTENDED_LIMITS -327.6800 327.6700 AXIS_PTS_REF InjCrv_phiMIETSCor1_Y_AXIS /end AXIS_DESCR
/end CHARACTERISTIC
/begin CHARACTERISTIC InjCrv_phiMIETSCor12_GMAP "Motortemperaturabhängiges Ansteuerbeginnkorrekturkennfeld 2 für MI1" MAP 0x8003F6EA Gkf_Ws16 1439.978 AngleCrS -720.0000 719.9780
 /begin AXIS_DESCR COM_AXIS Epm_nEng EngN 16 0.00 6000.000 EXTENDED_LIMITS -16384.00 16383.50 AXIS_PTS_REF InjCrv_phiMIETSCor1_X_AXIS /end AXIS_DESCR
 /begin AXIS_DESCR COM_AXIS InjCtl_qSetUnBal InjMass 16 0.00 327.6700 EXTENDED_LIMITS -327.6800 327.6700 AXIS_PTS_REF InjCrv_phiMIETSCor1_Y_AXIS /end AXIS_DESCR
/end CHARACTERISTIC
/begin CHARACTERISTIC InjCrv_phiMIETSCor1_MAP "motortemperaturabhängiges Korrekturkennfeld 1 für Ansteuerbeginn MI1" MAP 0x8004033C MapG_Ws16 19.99512 AngleCrS -9.997559 9.997559 EXTENDED_LIMITS -720.0000 719.9780
 /begin AXIS_DESCR COM_AXIS Epm_nEng EngN 16 0.00 10000.00 EXTENDED_LIMITS -16384.00 16383.50 AXIS_PTS_REF InjCrv_phiMIETSCor_X_AXIS /end AXIS_DESCR
 /begin AXIS_DESCR COM_AXIS InjCtl_qSetUnBal InjMass 16 0.00 327.6700 EXTENDED_LIMITS -327.6800 327.6700 AXIS_PTS_REF InjCrv_phiMIETSCor_Y_AXIS /end AXIS_DESCR
/end CHARACTERISTIC
/begin AXIS_PTS InjCrv_phiMIETSCor1_X_AXIS "" 0x8003F8EA Epm_nEng Axis_Xs16 6000.000 EngN 16 0.00 6000.000 FORMAT "%8.3" EXTENDED_LIMITS -16384.00 16383.50 DEPOSIT ABSOLUTE /end AXIS_PTS
/begin AXIS_PTS InjCrv_phiMIETSCor1_Y_AXIS "" 0x8003F90C InjCtl_qSetUnBal Axis_Xs16 327.6700 InjMass 16 0.00 327.6700 FORMAT "%8.4" EXTENDED_LIMITS -327.6800 327.6700 DEPOSIT ABSOLUTE /end AXIS_PTS
/begin CHARACTERISTIC InjCrv_phiMIETSCor2_MAP "motortemperaturabhängiges Korrekturkennfeld 2 für Ansteuerbeginn MI1" MAP 0x8004053C MapG_Ws16 19.99512 AngleCrS -9.997559 9.997559 EXTENDED_LIMITS -720.0000 719.9780
 /begin AXIS_DESCR COM_AXIS Epm_nEng EngN 16 0.00 10000.00 EXTENDED_LIMITS -16384.00 16383.50 AXIS_PTS_REF InjCrv_phiMIETSCor_X_AXIS /end AXIS_DESCR
 /begin AXIS_DESCR COM_AXIS InjCtl_qSetUnBal InjMass 16 0.00 327.6700 EXTENDED_LIMITS -327.6800 327.6700 AXIS_PTS_REF InjCrv_phiMIETSCor_Y_AXIS /end AXIS_DESCR
/end CHARACTERISTIC
/begin CHARACTERISTIC InjCrv_phiMIETSCorStrt_MAP "base value for SOE correction to be weighted by engine temperature" MAP 0x8003F92E Kf_Xs16_Ys16_Ws16 1439.978 AngleCrS -720.0000 719.9780
 /begin AXIS_DESCR STD_AXIS Epm_nEng EngN 8 -16384.00 16383.50 DEPOSIT ABSOLUTE /end AXIS_DESCR
 /begin AXIS_DESCR STD_AXIS InjCtl_qSetUnBal InjMass 8 -327.6800 327.6700 DEPOSIT ABSOLUTE /end AXIS_DESCR
/end CHARACTERISTIC
/begin AXIS_PTS InjCrv_phiMIETSCor_X_AXIS "gemeinsame X-Achse für motortemperaturabhängige Ansteuerbeginnkorrekturkennfelder für MI" 0x8004073C Epm_nEng Axis_Xs16 10000.00 EngN 16 0.00 10000.00 FORMAT "%8.2" EXTENDED_LIMITS -16384.00 16383.50 DEPOSIT ABSOLUTE /end AXIS_PTS
/begin AXIS_PTS InjCrv_phiMIETSCor_Y_AXIS "gemeinsame Y-Achse für motortemperaturabhängige Ansteuerbeginnkorrekturkennfelder für MI" 0x8004075E InjCtl_qSetUnBal Axis_Xs16 327.6700 InjMass 16 0.00 327.6700 FORMAT "%8.4" EXTENDED_LIMITS -327.6800 327.6700 DEPOSIT ABSOLUTE /end AXIS_PTS
/begin CHARACTERISTIC InjCrv_phiMIFTSRailCorMax_C "Maximaler Ansteuerbeginnkorrekturfaktor für MI1, abhängig von der kraftstofftemperaturabhängigen Raildruckkorrektur" VALUE 0x80040780 Val_Ws16 1439.978 AngleCrS -720.0000 719.9780 /end CHARACTERISTIC
/begin CHARACTERISTIC InjCrv_phiMIFTSRailCorMin_C "Minimaler Ansteuerbeginnkorrekturfaktor für MI1, abhängig von der kraftstofftemperaturabhängigen Raildruckkorrektur" VALUE 0x80040782 Val_Ws16 1439.978 AngleCrS -720.0000 719.9780 /end CHARACTERISTIC
/begin CHARACTERISTIC InjCrv_phiMIFTSRailCorStrtMax_C "Maximaler Ansteuerbeginnkorrekturfaktor für MI1, abhängig von der kraftstofftemperaturabhängigen Raildruckkorrektur" VALUE 0x8003F9D2 Kw_Ws16 1439.978 AngleCrS -720.0000 719.9780 /end CHARACTERISTIC
/begin CHARACTERISTIC InjCrv_phiMIFTSRailCorStrtMin_C "Minimaler Ansteuerbeginnkorrekturfaktor für MI1, abhängig von der kraftstofftemperaturabhängigen Raildruckkorrektur" VALUE 0x8003F9D4 Kw_Ws16 1439.978 AngleCrS -720.0000 719.9780 /end CHARACTERISTIC
/begin CHARACTERISTIC InjCrv_phiMIFTSRailCorStrt_MAP "map for correction factor of SOE for the MI1, based on rail pressure" MAP 0x8003F9D6 Kf_Xs16_Ys16_Ws16 1439.978 AngleCrS -720.0000 719.9780
 /begin AXIS_DESCR STD_AXIS Epm_nEng EngN 2 -16384.00 16383.50 DEPOSIT ABSOLUTE /end AXIS_DESCR
 /begin AXIS_DESCR STD_AXIS InjCtl_qSetUnBal InjMass 2 -327.6800 327.6700 DEPOSIT ABSOLUTE /end AXIS_DESCR
/end CHARACTERISTIC
/begin CHARACTERISTIC InjCrv_phiMIFTSRailCor_MAP "Korrekturfaktorkennfeld für die MI1, abhängig von der kraftstofftemperaturabhängigen Raildruckkorrektur" MAP 0x80040784 Map_Xs16Ys16Ws16 19.99512 AngleCrS -9.997559 9.997559 EXTENDED_LIMITS -720.0000 719.9780
 /begin AXIS_DESCR STD_AXIS Epm_nEng EngN 2 0.00 10000.00 EXTENDED_LIMITS -16384.00 16383.50 DEPOSIT ABSOLUTE /end AXIS_DESCR
 /begin AXIS_DESCR STD_AXIS InjCtl_qSetUnBal InjMass 2 0.00 327.6700 EXTENDED_LIMITS -327.6800 327.6700 DEPOSIT ABSOLUTE /end AXIS_DESCR
/end CHARACTERISTIC
/begin CHARACTERISTIC InjCrv_phiMIPFltCor_MAP "Kennfeld für die Ansteuerbeginnkorrektur der MI1 in Abhängigkeit der Partikelfilterbeladung" MAP 0x80040798 Map_Xs16Ys16Ws16 19.99512 AngleCrS -9.997559 9.997559 EXTENDED_LIMITS -720.0000 719.9780
 /begin AXIS_DESCR STD_AXIS Epm_nEng EngN 2 0.00 10000.00 EXTENDED_LIMITS -16384.00 16383.50 DEPOSIT ABSOLUTE /end AXIS_DESCR
 /begin AXIS_DESCR STD_AXIS InjCtl_qSetUnBal InjMass 2 0.00 327.6700 EXTENDED_LIMITS -327.6800 327.6700 DEPOSIT ABSOLUTE /end AXIS_DESCR
/end CHARACTERISTIC
/begin CHARACTERISTIC InjCrv_phiPiI1Des_C "Fernsteuerwert des Ansteuerbeginns (Winkelkomponente) der PiI1" VALUE 0x800417F8 Val_Ws16 720.0000 AngleCrS 0.00 720.0000 EXTENDED_LIMITS -720.0000 719.9780 /end CHARACTERISTIC
/begin CHARACTERISTIC InjCrv_phiPiIMax_C "frühester absoluter Ansteuerbeginn einer PiI" VALUE 0x800417FA Val_Ws16 99.99756 AngleCrS 0.00 99.99756 EXTENDED_LIMITS -720.0000 719.9780 /end CHARACTERISTIC
/begin CHARACTERISTIC InjCrv_pMIDynMax_C "Max. Grenze Raildruckdifferenz" VALUE 0x8003F9EA Kw_Ws16 2000.000 Pres_Rail 0.00 2000.000 EXTENDED_LIMITS -3276.800 3276.700 /end CHARACTERISTIC
/begin CHARACTERISTIC InjCrv_pMIDynMin_C "Min. Grenze Raildruckdifferenz" VALUE 0x8003F9EC Kw_Ws16 2000.000 Pres_Rail 0.00 2000.000 EXTENDED_LIMITS -3276.800 3276.700 /end CHARACTERISTIC
/begin CHARACTERISTIC InjCrv_qMI1Cor0Rgn_GMAP "Grundkennfeld der HE-Korrekturmenge bei Regeneration 0" MAP 0x800414E2 MapG_Ws16 327.6700 InjMass 0.00 327.6700 EXTENDED_LIMITS -327.6800 327.6700
 /begin AXIS_DESCR COM_AXIS Epm_nEng EngN 8 0.00 10000.00 EXTENDED_LIMITS -16384.00 16383.50 AXIS_PTS_REF InjCrv_qMI1CorX_AXIS /end AXIS_DESCR
 /begin AXIS_DESCR COM_AXIS InjCtl_qSetUnBal InjMass 8 0.00 327.6700 EXTENDED_LIMITS -327.6800 327.6700 AXIS_PTS_REF InjCrv_qMI1CorY_AXIS /end AXIS_DESCR
/end CHARACTERISTIC
/begin CHARACTERISTIC InjCrv_qMI1Cor1Rgn_GMAP "Grundkennfeld der HE-Korrekturmenge bei Regeneration 1" MAP 0x80041562 MapG_Ws16 327.6700 InjMass 0.00 327.6700 EXTENDED_LIMITS -327.6800 327.6700
 /begin AXIS_DESCR COM_AXIS Epm_nEng EngN 8 0.00 10000.00 EXTENDED_LIMITS -16384.00 16383.50 AXIS_PTS_REF InjCrv_qMI1CorX_AXIS /end AXIS_DESCR
 /begin AXIS_DESCR COM_AXIS InjCtl_qSetUnBal InjMass 8 0.00 327.6700 EXTENDED_LIMITS -327.6800 327.6700 AXIS_PTS_REF InjCrv_qMI1CorY_AXIS /end AXIS_DESCR
/end CHARACTERISTIC
/begin AXIS_PTS InjCrv_qMI1CorX_AXIS "Stützstellenverteilung der Gruppenkennfelder InjCrv_qMI1Cor%Rgn_GMAP und InjCrv_qMI1Cor_GMAP für die Eingangsgröße Epm_nEng" 0x800415E2 Epm_nEng Axis_Xs16 10000.00 EngN 8 0.00 10000.00 FORMAT "%8.2" EXTENDED_LIMITS -16384.00 16383.50 DEPOSIT ABSOLUTE /end AXIS_PTS
/begin AXIS_PTS InjCrv_qMI1CorY_AXIS "Stützstellenverteilung der Gruppenkennfelder InjCrv_qMI1Cor%Rgn_GMAP und InjCrv_qMI1Cor_GMAP für die Eingangsgröße InjCtl_qSetUnBal" 0x800415F4 InjCtl_qSetUnBal Axis_Xs16 327.6700 InjMass 8 0.00 327.6700 FORMAT "%8.4" EXTENDED_LIMITS -327.6800 327.6700 DEPOSIT ABSOLUTE /end AXIS_PTS
/begin CHARACTERISTIC InjCrv_qMI1Cor_MAP "Mengenkorrekturkennfeld der MI1" MAP 0x80041606 Kf_Xs16_Ys16_Ws16 327.6700 InjMass 0.00 327.6700 EXTENDED_LIMITS -327.6800 327.6700
 /begin AXIS_DESCR STD_AXIS Epm_nEng EngN 8 0.00 10000.00 EXTENDED_LIMITS -16384.00 16383.50 DEPOSIT ABSOLUTE /end AXIS_DESCR
 /begin AXIS_DESCR STD_AXIS InjCtl_qSetUnBal InjMass 8 0.00 327.6700 EXTENDED_LIMITS -327.6800 327.6700 DEPOSIT ABSOLUTE /end AXIS_DESCR
/end CHARACTERISTIC
/begin CHARACTERISTIC InjCrv_qMI1CSCMax_MAP "Kennfeld zur Bestimmung der Maximalmenge der MI1 nach CSC-Korrektur" MAP 0x8003EF04 Map_Xs16Ys16Ws16 327.6700 InjMass 0.00 327.6700 EXTENDED_LIMITS -327.6800 327.6700
 /begin AXIS_DESCR STD_AXIS Epm_nEng EngN 2 0.00 10000.00 EXTENDED_LIMITS -16384.00 16383.50 DEPOSIT ABSOLUTE /end AXIS_DESCR
 /begin AXIS_DESCR STD_AXIS InjCtl_qSetUnBal InjMass 2 0.00 327.6700 EXTENDED_LIMITS -327.6800 327.6700 DEPOSIT ABSOLUTE /end AXIS_DESCR
/end CHARACTERISTIC
/begin CHARACTERISTIC InjCrv_qMI1CSCMin_MAP "Kennfeld zur Bestimmung der Minimalmenge der MI1 nach CSC-Korrektur" MAP 0x8003EF18 Map_Xs16Ys16Ws16 327.6700 InjMass 0.00 327.6700 EXTENDED_LIMITS -327.6800 327.6700
 /begin AXIS_DESCR STD_AXIS Epm_nEng EngN 2 0.00 10000.00 EXTENDED_LIMITS -16384.00 16383.50 DEPOSIT ABSOLUTE /end AXIS_DESCR
 /begin AXIS_DESCR STD_AXIS InjCtl_qSetUnBal InjMass 2 0.00 327.6700 EXTENDED_LIMITS -327.6800 327.6700 DEPOSIT ABSOLUTE /end AXIS_DESCR
/end CHARACTERISTIC
/begin CHARACTERISTIC InjCrv_qMI1CSC_CUR "Kennlinie zur Umwandlung des CSC-Mengenkorrekturfaktors der MI1 in eine Menge" CURVE 0x8003EF2C Cur_Xs16Ws16 655.3400 InjMass -327.6700 327.6700 EXTENDED_LIMITS -327.6800 327.6700
 /begin AXIS_DESCR STD_AXIS InjCrv_rMI1QntCSC_mp Prc_Fact100 2 -50.00000 50.00000 FORMAT "%8.5" EXTENDED_LIMITS -327.6800 327.6700 DEPOSIT ABSOLUTE /end AXIS_DESCR
/end CHARACTERISTIC
/begin CHARACTERISTIC InjCrv_qMI1Des_C "Fernsteuerwert der Einspritzmenge der MI" VALUE 0x8003EECC Val_Ws16 100.0000 InjMass 0.00 100.0000 EXTENDED_LIMITS -327.6800 327.6700 /end CHARACTERISTIC
/begin CHARACTERISTIC InjCrv_qMI1MinPiI1DiffHys_C "Differenzmenge zwischen unterer und oberer Hystereseschwelle bei PiI1 für Freigabe PiI1 wenn genügend Menge für MI und PiI1" VALUE 0x800417FC Val_Ws16 10.00000 InjMass 0.00 10.00000 EXTENDED_LIMITS -327.6800 327.6700 /end CHARACTERISTIC
/begin CHARACTERISTIC InjCrv_qPiI1Bas1_MAP "Einspritzmenge PiI1 Grundwertekennfeld 1" MAP 0x800417FE MapG_Ws16 10.00000 InjMass 0.00 10.00000 EXTENDED_LIMITS -327.6800 327.6700
 /begin AXIS_DESCR COM_AXIS Epm_nEng EngN 16 0.00 10000.00 EXTENDED_LIMITS -16384.00 16383.50 AXIS_PTS_REF InjCrv_qPiI1Bas_X_AXIS /end AXIS_DESCR
 /begin AXIS_DESCR COM_AXIS InjCtl_qSetUnBal InjMass 16 0.00 327.6700 EXTENDED_LIMITS -327.6800 327.6700 AXIS_PTS_REF InjCrv_qPiI1Bas_Y_AXIS /end AXIS_DESCR
/end CHARACTERISTIC
/begin CHARACTERISTIC InjCrv_qPiI1Bas2_MAP "Einspritzmenge PiI1 Grundwertekennfeld 2" MAP 0x800419FE MapG_Ws16 10.00000 InjMass 0.00 10.00000 EXTENDED_LIMITS -327.6800 327.6700
 /begin AXIS_DESCR COM_AXIS Epm_nEng EngN 16 0.00 10000.00 EXTENDED_LIMITS -16384.00 16383.50 AXIS_PTS_REF InjCrv_qPiI1Bas_X_AXIS /end AXIS_DESCR
 /begin AXIS_DESCR COM_AXIS InjCtl_qSetUnBal InjMass 16 0.00 327.6700 EXTENDED_LIMITS -327.6800 327.6700 AXIS_PTS_REF InjCrv_qPiI1Bas_Y_AXIS /end AXIS_DESCR
/end CHARACTERISTIC
/begin CHARACTERISTIC InjCrv_qPiI1BasCylOffs_MAP "betriebspunktabhängige Berechnung des Offsets der PiI1" MAP 0x8003E136 Kf_Xs16_Ys16_Ws16 329.6700 InjMassInj -2.000000 327.6700 EXTENDED_LIMITS -327.6800 327.6700
 /begin AXIS_DESCR STD_AXIS Epm_nEng EngN 5 0.00 6000.000 EXTENDED_LIMITS -16384.00 16383.50 DEPOSIT ABSOLUTE /end AXIS_DESCR
 /begin AXIS_DESCR STD_AXIS InjCtl_qSetUnBal InjMass 5 0.00 327.6700 EXTENDED_LIMITS -327.6800 327.6700 DEPOSIT ABSOLUTE /end AXIS_DESCR
/end CHARACTERISTIC
/begin AXIS_PTS InjCrv_qPiI1Bas_X_AXIS "gemeinsame X-Achse für Einspritzmengengrundwertkennfelder für Voreinspritzung 1" 0x80041BFE Epm_nEng Axis_Xs16 10000.00 EngN 16 0.00 10000.00 FORMAT "%8.2" EXTENDED_LIMITS -16384.00 16383.50 DEPOSIT ABSOLUTE /end AXIS_PTS
/begin AXIS_PTS InjCrv_qPiI1Bas_Y_AXIS "gemeinsame Y-Achse für Einspritzmengegrundwertkennfelder für Voreinspritzung 1" 0x80041C20 InjCtl_qSetUnBal Axis_Xs16 327.6700 InjMass 16 0.00 327.6700 FORMAT "%8.4" EXTENDED_LIMITS -327.6800 327.6700 DEPOSIT ABSOLUTE /end AXIS_PTS
/begin CHARACTERISTIC InjCrv_qPiI1Des_C "Fernsteuerwert der Einspritzmenge von PiI1" VALUE 0x80041C42 Val_Ws16 100.0000 InjMass 0.00 100.0000 EXTENDED_LIMITS -327.6800 327.6700 /end CHARACTERISTIC
/begin CHARACTERISTIC InjCrv_qPiI1Max1_MAP "Einspritzmenge PiI1 Maximalwertekennfeld 1" MAP 0x80041C44 MapG_Ws16 10.00000 InjMass 0.00 10.00000 EXTENDED_LIMITS -327.6800 327.6700
 /begin AXIS_DESCR COM_AXIS Epm_nEng EngN 8 0.00 10000.00 EXTENDED_LIMITS -16384.00 16383.50 AXIS_PTS_REF InjCrv_qPiI1Max_X_AXIS /end AXIS_DESCR
 /begin AXIS_DESCR COM_AXIS InjCtl_qSetUnBal InjMass 16 0.00 327.6700 EXTENDED_LIMITS -327.6800 327.6700 AXIS_PTS_REF InjCrv_qPiI1Max_Y_AXIS /end AXIS_DESCR
/end CHARACTERISTIC
/begin CHARACTERISTIC InjCrv_qPiI1Max2_MAP "Einspritzmenge PiI1 Maximalwertekennfeld 2" MAP 0x80041D44 MapG_Ws16 10.00000 InjMass 0.00 10.00000 EXTENDED_LIMITS -327.6800 327.6700
 /begin AXIS_DESCR COM_AXIS Epm_nEng EngN 8 0.00 10000.00 EXTENDED_LIMITS -16384.00 16383.50 AXIS_PTS_REF InjCrv_qPiI1Max_X_AXIS /end AXIS_DESCR
 /begin AXIS_DESCR COM_AXIS InjCtl_qSetUnBal InjMass 16 0.00 327.6700 EXTENDED_LIMITS -327.6800 327.6700 AXIS_PTS_REF InjCrv_qPiI1Max_Y_AXIS /end AXIS_DESCR
/end CHARACTERISTIC
/begin AXIS_PTS InjCrv_qPiI1Max_X_AXIS "gemeinsame X-Achse für Einspritzmengenmaximalwertkennfelder für Voreinspritzung 1" 0x80041E44 Epm_nEng Axis_Xs16 10000.00 EngN 8 0.00 10000.00 FORMAT "%8.2" EXTENDED_LIMITS -16384.00 16383.50 DEPOSIT ABSOLUTE /end AXIS_PTS
/begin AXIS_PTS InjCrv_qPiI1Max_Y_AXIS "gemeinsame Y-Achse für Einspritzmengenmaximalwertkennfelder für Voreinspritzung 1" 0x80041E56 InjCtl_qSetUnBal Axis_Xs16 327.6700 InjMass 16 0.00 327.6700 FORMAT "%8.4" EXTENDED_LIMITS -327.6800 327.6700 DEPOSIT ABSOLUTE /end AXIS_PTS
/begin CHARACTERISTIC InjCrv_qPiI1MinDiff_C "Minimalmenge zwischen unteren und oberen Hystheresenschwelle für Voreinspritzung 1" VALUE 0x80041E78 Val_Ws16 10.00000 InjMass 0.00 10.00000 EXTENDED_LIMITS -327.6800 327.6700 /end CHARACTERISTIC
/begin CHARACTERISTIC InjCrv_rMI1DesCSC_CUR "Kennlinie zur Umwandlung des CSC-Korrekturwinkels der MI1 in einen Faktor" CURVE 0x8003EF36 Cur_Xs16Ws16 100.0000 Prc_Fact100 -50.00000 50.00000 FORMAT "%8.5" EXTENDED_LIMITS -327.6800 327.6700
 /begin AXIS_DESCR STD_AXIS InjCrv_phiMI1DesCSCMax_mp AngleCrS 16 -9.997559 9.997559 EXTENDED_LIMITS -720.0000 719.9780 DEPOSIT ABSOLUTE /end AXIS_DESCR
/end CHARACTERISTIC
/begin CHARACTERISTIC InjCrv_rMI1QntCSC_CUR "Kennlinie zur Umwandlung der CSC-Korrekturmenge der MI1 in einen Faktor" CURVE 0x8003EF78 Cur_Xs16Ws16 100.0000 Prc_Fact100 -50.00000 50.00000 FORMAT "%8.5" EXTENDED_LIMITS -327.6800 327.6700
 /begin AXIS_DESCR STD_AXIS InjCrv_qMI1CSCMax_mp InjMass 16 -327.6700 327.6700 EXTENDED_LIMITS -327.6800 327.6700 DEPOSIT ABSOLUTE /end AXIS_DESCR
/end CHARACTERISTIC
/begin CHARACTERISTIC InjCrv_rOpRngATSHys_C "Ansauglufttemperatur-Hystereseschwelle zur Bestimmung des Betriebsbereichs" VALUE 0x8003DC50 Val_Ws16 50.00000 Prc 0.00 50.00000 EXTENDED_LIMITS -400.0000 399.9878 /end CHARACTERISTIC
/begin CHARACTERISTIC InjCrv_rOpRngETSHys_C "Motortemperatur-Hystereseschwelle zur Bestimmung des Betriebsbereichs" VALUE 0x8003DC52 Val_Ws16 50.00000 Prc 0.00 50.00000 EXTENDED_LIMITS -400.0000 399.9878 /end CHARACTERISTIC
/begin CHARACTERISTIC InjCrv_rPiIRlsATSHys_C "" VALUE 0x8003DADA Val_Ws16 799.9878 Prc -400.0000 399.9878 /end CHARACTERISTIC
/begin CHARACTERISTIC InjCrv_rPiIRlsEngSpdHys_C "Drehzahl Hystereseschwelle für die Auswahl der Freigabestruktur der Voreinspritzungen" VALUE 0x8003D500 Val_Ws16 50.00000 Prc 0.00 50.00000 EXTENDED_LIMITS -400.0000 399.9878 /end CHARACTERISTIC
/begin CHARACTERISTIC InjCrv_rPiIRlsETSHys_C "" VALUE 0x8003DADC Val_Ws16 799.9878 Prc -400.0000 399.9878 /end CHARACTERISTIC
/begin CHARACTERISTIC InjCrv_rPiIRlsQntHys_C "Mengen-Hystereseschwelle zur Auswahl der Freigabestruktur der Voreinspritzungen" VALUE 0x8003D502 Val_Ws16 799.9878 Prc -400.0000 399.9878 /end CHARACTERISTIC
/begin CHARACTERISTIC InjCrv_rRtmLimEngSpdHys_C "Drehzahl-Hystereseschwelle zur Begrenzung der Anzahl der Einspritzungen bei hohen Drehzahlen" VALUE 0x8003D494 Val_Ws16 50.00000 Prc 0.00 50.00000 EXTENDED_LIMITS -400.0000 399.9878 /end CHARACTERISTIC
/begin CHARACTERISTIC InjCrv_stCylOffstAirInv_C "Schalter für Spitze-bit-coded Freigabestatus des Zylinders weg vom" VALUE 0x8003E180 Kw_Wu8 255.0 OneToOne 0.00 255.0 /end CHARACTERISTIC
/begin CHARACTERISTIC InjCrv_stCylOffstEngInv_C "Schalter für Spitze-bit-coded Freigabestatus des Zylinders weg vom" VALUE 0x8003E181 Kw_Wu8 255.0 OneToOne 0.00 255.0 /end CHARACTERISTIC
/begin CHARACTERISTIC InjCrv_stDumrgn_C "" VALUE 0x800416AC Val_Wu32 4294967295.00 OneToOne 0.00 4294967295.00 /end CHARACTERISTIC
/begin CHARACTERISTIC InjCrv_stInjCharActVal_C "Fernsteuerwert der Einspritzcharakteristik Istwert" VALUE 0x8003EECE Val_Wu8 255.0 OneToOne 0.00 255.0 /end CHARACTERISTIC
/begin CHARACTERISTIC InjCrv_stInjCharPrioRgn_C "Prioritätsstatus für die Abschaltung der Voreinspritzungen im Regenerationsbetrieb" VALUE 0x8003D498 Val_Wu32 4294967295.00 OneToOne 0.00 4294967295.00 /end CHARACTERISTIC
/begin CHARACTERISTIC InjCrv_stInjCharPrio_C "Prioritätsstatus für die Abschaltung der Voreinspritzungen" VALUE 0x8003D49C Val_Wu32 4294967295.00 OneToOne 0.00 4294967295.00 /end CHARACTERISTIC
/begin CHARACTERISTIC InjCrv_stInjDstSel_C "Status der Darstellung relativer Zeitabstände der Einspritzungen" VALUE 0x80041E7A Val_Wu8 255.0 OneToOne 0.00 255.0 /end CHARACTERISTIC
/begin CHARACTERISTIC InjCrv_stMI1RgnMsk_CA "Bitmaske für die Freigabe der einzelnen Regenerationsstufen" VAL_BLK 0x8003D4A0 ValA_Wu32 4294967295.00 OneToOne 0.00 4294967295.00 NUMBER 2 /end CHARACTERISTIC
/begin CHARACTERISTIC InjCrv_stMI1RmpSel_CA "Matrix für die Faktorisierungskennlinien der Umschaltrampe für MI1" MAP 0x8003D4A8 Map_Xu8Yu8Wu8 1.00000000000 INJCRV_RMP_VERB 1.00000000000 2.00000000000 FORMAT "%13.11" EXTENDED_LIMITS 1.00000000000 7.00000000000
 /begin AXIS_DESCR STD_AXIS InjCrv_stActValMI1_mp INJCRV_MSK_VERB 3 0.00 7.00000000000 FORMAT "%13.11" DEPOSIT ABSOLUTE /end AXIS_DESCR
 /begin AXIS_DESCR STD_AXIS InjCrv_stDesValMI1_mp INJCRV_MSK_VERB 3 0.00 7.00000000000 FORMAT "%13.11" DEPOSIT ABSOLUTE /end AXIS_DESCR
/end CHARACTERISTIC
/begin CHARACTERISTIC InjCrv_stPiI1RgnMsk_CA "Bitmaske für die Freigabe der einzelnen Regenerationsstufen" VAL_BLK 0x8003D4BC ValA_Wu32 4294967295.00 OneToOne 0.00 4294967295.00 NUMBER 2 /end CHARACTERISTIC
/begin CHARACTERISTIC InjCrv_stPiI1RmpSel_CA "Matrix für die Faktorisierungskennlinien der Umschaltrampe für PiI1" MAP 0x8003D4C4 Map_Xu8Yu8Wu8 1.00000000000 INJCRV_RMP_VERB 1.00000000000 2.00000000000 FORMAT "%13.11" EXTENDED_LIMITS 1.00000000000 7.00000000000
 /begin AXIS_DESCR STD_AXIS InjCrv_stActValPiI1_mp INJCRV_MSK_VERB 3 0.00 7.00000000000 FORMAT "%13.11" DEPOSIT ABSOLUTE /end AXIS_DESCR
 /begin AXIS_DESCR STD_AXIS InjCrv_stDesValPiI1_mp INJCRV_MSK_VERB 3 0.00 7.00000000000 FORMAT "%13.11" DEPOSIT ABSOLUTE /end AXIS_DESCR
/end CHARACTERISTIC
/begin CHARACTERISTIC InjCrv_stPiI2RgnMsk_CA "Bitmaske für die Freigabe der einzelnen Regenerationsstufen" VAL_BLK 0x8003D4D8 ValA_Wu32 4294967295.00 OneToOne 0.00 4294967295.00 NUMBER 2 /end CHARACTERISTIC
/begin CHARACTERISTIC InjCrv_stPiI2RmpSel_CA "Matrix für die Faktorisierungskennlinien der Umschaltrampe für PiI2" MAP 0x8003D4E0 Map_Xu8Yu8Wu8 1.00000000000 INJCRV_RMP_VERB 1.00000000000 2.00000000000 FORMAT "%13.11" EXTENDED_LIMITS 1.00000000000 7.00000000000
 /begin AXIS_DESCR STD_AXIS InjCrv_stActValPiI2_mp INJCRV_MSK_VERB 3 0.00 7.00000000000 FORMAT "%13.11" DEPOSIT ABSOLUTE /end AXIS_DESCR
 /begin AXIS_DESCR STD_AXIS InjCrv_stDesValPiI2_mp INJCRV_MSK_VERB 3 0.00 7.00000000000 FORMAT "%13.11" DEPOSIT ABSOLUTE /end AXIS_DESCR
/end CHARACTERISTIC
/begin CHARACTERISTIC InjCrv_stPiI3RgnMsk_CA "Bitmaske für die Freigabe der einzelnen Regenerationsstufen" VAL_BLK 0x8003D4F4 ValA_Wu32 4294967295.00 OneToOne 0.00 4294967295.00 NUMBER 2 /end CHARACTERISTIC
/begin CHARACTERISTIC InjCrv_stPiIRlsEOMMsk_C "" VALUE 0x8003DAE0 Val_Wu32 4294967295.00 OneToOne 0.00 4294967295.00 /end CHARACTERISTIC
/begin CHARACTERISTIC InjCrv_stPiIRlsGearCor_C "Korrekturwert zur gangabhängigen PiI Freigabekorrektur" VALUE 0x8003DC44 Val_Wu8 5.000 OneToOne 1.000 6.000 EXTENDED_LIMITS 0.00 255.0 /end CHARACTERISTIC
/begin CHARACTERISTIC InjCrv_stPiIRlsGearThres_C "Schwelle zur gangabhängigen PiI Freigabekorrektur" VALUE 0x8003DC45 Val_Ws8 6.000 OneToOne 0.00 6.000 EXTENDED_LIMITS -128.0 127.0 /end CHARACTERISTIC
/begin CHARACTERISTIC InjCrv_stPiIRlsGear_C "PiI Freigabestatus zur gangabhängigen PiI Freigabekorrektur" VALUE 0x8003DC46 Val_Wu8 5.000 OneToOne 1.000 6.000 EXTENDED_LIMITS 0.00 255.0 /end CHARACTERISTIC
/begin CHARACTERISTIC InjCrv_stPiIRlsN_MAP "" MAP 0x8003DAE4 Map_Xs16Ys16Ws16 1.000000 OneToOne 0.00 1.000000 EXTENDED_LIMITS -32768.00 32767.00
 /begin AXIS_DESCR STD_AXIS InjSys_tEngPiIRls Temp_Cels 8 -3549.940 3003.560 DEPOSIT ABSOLUTE /end AXIS_DESCR
 /begin AXIS_DESCR STD_AXIS InjSys_tAir Temp_Cels 8 -3549.940 3003.560 DEPOSIT ABSOLUTE /end AXIS_DESCR
/end CHARACTERISTIC
/begin CHARACTERISTIC InjCrv_stPiIRlsOpRgnMsk_CA "Bitmaske für die Freigabe der einzelnen Regenerationsstufen für die Freigabe der Voreinspritzungen" VAL_BLK 0x8003DC54 ValA_Wu32 4294967295.00 OneToOne 0.00 4294967295.00 NUMBER 2 /end CHARACTERISTIC
/begin CHARACTERISTIC InjCrv_stPiIRlsOpRng1_MAP "Freigabekennfeld im Betriebsbereich 1" MAP 0x8003D504 Map_Xs16Ys16Ws16 4.000000 OneToOne 1.000000 5.000000 EXTENDED_LIMITS -32768.00 32767.00
 /begin AXIS_DESCR STD_AXIS Epm_nEng EngN 10 0.00 10000.00 EXTENDED_LIMITS -16384.00 16383.50 DEPOSIT ABSOLUTE /end AXIS_DESCR
 /begin AXIS_DESCR STD_AXIS InjCtl_qSetUnBal InjMass 10 0.00 327.6700 EXTENDED_LIMITS -327.6800 327.6700 DEPOSIT ABSOLUTE /end AXIS_DESCR
/end CHARACTERISTIC
/begin CHARACTERISTIC InjCrv_stPiIRlsOpRng2_MAP "Freigabekennfeld im Betriebsbereich 2" MAP 0x8003D5F8 Map_Xs16Ys16Ws16 4.000000 OneToOne 1.000000 5.000000 EXTENDED_LIMITS -32768.00 32767.00
 /begin AXIS_DESCR STD_AXIS Epm_nEng EngN 10 0.00 10000.00 EXTENDED_LIMITS -16384.00 16383.50 DEPOSIT ABSOLUTE /end AXIS_DESCR
 /begin AXIS_DESCR STD_AXIS InjCtl_qSetUnBal InjMass 10 0.00 327.6700 EXTENDED_LIMITS -327.6800 327.6700 DEPOSIT ABSOLUTE /end AXIS_DESCR
/end CHARACTERISTIC
/begin CHARACTERISTIC InjCrv_stPiIRlsOpRng3_MAP "Freigabekennfeld im Betriebsbereich 3" MAP 0x8003D6EC Map_Xs16Ys16Ws16 4.000000 OneToOne 1.000000 5.000000 EXTENDED_LIMITS -32768.00 32767.00
 /begin AXIS_DESCR STD_AXIS Epm_nEng EngN 10 0.00 10000.00 EXTENDED_LIMITS -16384.00 16383.50 DEPOSIT ABSOLUTE /end AXIS_DESCR
 /begin AXIS_DESCR STD_AXIS InjCtl_qSetUnBal InjMass 10 0.00 327.6700 EXTENDED_LIMITS -327.6800 327.6700 DEPOSIT ABSOLUTE /end AXIS_DESCR
/end CHARACTERISTIC
/begin CHARACTERISTIC InjCrv_stPiIRlsOpRng4_MAP "Freigabekennfeld im Betriebsbereich 4" MAP 0x8003D7E0 Map_Xs16Ys16Ws16 4.000000 OneToOne 1.000000 5.000000 EXTENDED_LIMITS -32768.00 32767.00
 /begin AXIS_DESCR STD_AXIS Epm_nEng EngN 10 0.00 10000.00 EXTENDED_LIMITS -16384.00 16383.50 DEPOSIT ABSOLUTE /end AXIS_DESCR
 /begin AXIS_DESCR STD_AXIS InjCtl_qSetUnBal InjMass 10 0.00 327.6700 EXTENDED_LIMITS -327.6800 327.6700 DEPOSIT ABSOLUTE /end AXIS_DESCR
/end CHARACTERISTIC
/begin CHARACTERISTIC InjCrv_stPiIRlsOpRng5_MAP "Freigabekennfeld im Betriebsbereich 5" MAP 0x8003D8D4 Map_Xs16Ys16Ws16 4.000000 OneToOne 1.000000 5.000000 EXTENDED_LIMITS -32768.00 32767.00
 /begin AXIS_DESCR STD_AXIS Epm_nEng EngN 10 0.00 10000.00 EXTENDED_LIMITS -16384.00 16383.50 DEPOSIT ABSOLUTE /end AXIS_DESCR
 /begin AXIS_DESCR STD_AXIS InjCtl_qSetUnBal InjMass 10 0.00 327.6700 EXTENDED_LIMITS -327.6800 327.6700 DEPOSIT ABSOLUTE /end AXIS_DESCR
/end CHARACTERISTIC
/begin CHARACTERISTIC InjCrv_stPiIRlsOpRng6_MAP "Freigabekennfeld im Betriebsbereich 6" MAP 0x8003D9C8 Map_Xs16Ys16Ws16 4.000000 OneToOne 1.000000 5.000000 EXTENDED_LIMITS -32768.00 32767.00
 /begin AXIS_DESCR STD_AXIS Epm_nEng EngN 10 0.00 10000.00 EXTENDED_LIMITS -16384.00 16383.50 DEPOSIT ABSOLUTE /end AXIS_DESCR
 /begin AXIS_DESCR STD_AXIS InjCtl_qSetUnBal InjMass 10 0.00 327.6700 EXTENDED_LIMITS -327.6800 327.6700 DEPOSIT ABSOLUTE /end AXIS_DESCR
/end CHARACTERISTIC
/begin CHARACTERISTIC InjCrv_stPiIRlsOpRngSel_CA "Matrix zur Auswahl des Kennfeldes für die Freigabe der Voreinspritzungen" MAP 0x8003DC5C Map_Xu8Yu8Wu8 2.00000000000 INJCRV_RGN_VERB 0.00 2.00000000000 FORMAT "%13.11" EXTENDED_LIMITS 0.00 7.00000000000
 /begin AXIS_DESCR STD_AXIS InjCrv_stActValPiIRls_mp INJCRV_MSK_VERB 3 0.00 2.00000000000 FORMAT "%13.11" EXTENDED_LIMITS 0.00 7.00000000000 DEPOSIT ABSOLUTE /end AXIS_DESCR
 /begin AXIS_DESCR STD_AXIS InjCrv_stDesValPiIRls_mp INJCRV_MSK_VERB 3 0.00 2.00000000000 FORMAT "%13.11" EXTENDED_LIMITS 0.00 7.00000000000 DEPOSIT ABSOLUTE /end AXIS_DESCR
/end CHARACTERISTIC
/begin CHARACTERISTIC InjCrv_stPiIRlsPresAirCor_C "Korrekturwert zur atmosphärendruckabhängigen PiI Freigabekorrektur" VALUE 0x8003DC47 Val_Wu8 5.000 OneToOne 1.000 6.000 EXTENDED_LIMITS 0.00 255.0 /end CHARACTERISTIC
/begin CHARACTERISTIC InjCrv_stPiIRlsPresAir_C "PiI Freigabestatus zur atmosphärendruckabhängigen PiI Freigabekorrektur" VALUE 0x8003DC48 Val_Wu8 5.000 OneToOne 1.000 6.000 EXTENDED_LIMITS 0.00 255.0 /end CHARACTERISTIC
/begin CHARACTERISTIC InjCrv_stPiIRlsVehSpdCor_C "Korrekturwert zur fahrzeuggeschwindigkeitsabhängigen PiI Freigabekorrektur" VALUE 0x8003DC49 Val_Wu8 5.000 OneToOne 1.000 6.000 EXTENDED_LIMITS 0.00 255.0 /end CHARACTERISTIC
/begin CHARACTERISTIC InjCrv_stPiIRlsVehSpd_C "PiI Freigabestatus zur fahrzeuggeschwindigkeitsabhängigen PiI Freigabekorrektur" VALUE 0x8003DC4A Val_Wu8 5.000 OneToOne 1.000 6.000 EXTENDED_LIMITS 0.00 255.0 /end CHARACTERISTIC
/begin CHARACTERISTIC InjCrv_stPiIRlsV_MAP "" MAP 0x8003DB88 Map_Xs16Ys16Ws16 1.000000 OneToOne 0.00 1.000000 EXTENDED_LIMITS -32768.00 32767.00
 /begin AXIS_DESCR STD_AXIS InjSys_tEngPiIRls Temp_Cels 8 -3549.940 3003.560 DEPOSIT ABSOLUTE /end AXIS_DESCR
 /begin AXIS_DESCR STD_AXIS InjSys_tAir Temp_Cels 8 -3549.940 3003.560 DEPOSIT ABSOLUTE /end AXIS_DESCR
/end CHARACTERISTIC
/begin CHARACTERISTIC InjCrv_stPrioRgnMsk_C "Bitmaske für Aktivierung des Prioritätsstaus im Regenerationsbetrieb" VALUE 0x8003D4FC Val_Wu32 4294967295.00 OneToOne 0.00 4294967295.00 /end CHARACTERISTIC
/begin CHARACTERISTIC InjCrv_stRlsOpRngThres0Rgn_GMAP "Betriebsbereichsschwellen für die Freigabe der Voreinspritzungen im Regenerationsbetrieb, Modus 1" MAP 0x8003DC6E MapG_Ws16 4.00000000000 INJCRV_MAPRLS_VERB 1.00000000000 5.00000000000 FORMAT "%13.11" EXTENDED_LIMITS 1.00000000000 6.00000000000
 /begin AXIS_DESCR COM_AXIS InjSys_tEngRgnPiIRls Temp_Cels 10 -50.14000 199.8600 EXTENDED_LIMITS -3549.940 3003.560 AXIS_PTS_REF InjCrv_stRlsOpRngThresRgnX_AXIS /end AXIS_DESCR
 /begin AXIS_DESCR COM_AXIS InjSys_tAirRgn Temp_Cels 10 -50.14000 199.8600 EXTENDED_LIMITS -3549.940 3003.560 AXIS_PTS_REF InjCrv_stRlsOpRngThresRgnY_AXIS /end AXIS_DESCR
/end CHARACTERISTIC
/begin CHARACTERISTIC InjCrv_stRlsOpRngThres1Rgn_GMAP "Betriebsbereichsschwellen für die Freigabe der Voreinspritzungen im Regenerationsbetrieb, Modus 2" MAP 0x8003DD36 MapG_Ws16 4.00000000000 INJCRV_MAPRLS_VERB 1.00000000000 5.00000000000 FORMAT "%13.11" EXTENDED_LIMITS 1.00000000000 6.00000000000
 /begin AXIS_DESCR COM_AXIS InjSys_tEngRgnPiIRls Temp_Cels 10 -50.14000 199.8600 EXTENDED_LIMITS -3549.940 3003.560 AXIS_PTS_REF InjCrv_stRlsOpRngThresRgnX_AXIS /end AXIS_DESCR
 /begin AXIS_DESCR COM_AXIS InjSys_tAirRgn Temp_Cels 10 -50.14000 199.8600 EXTENDED_LIMITS -3549.940 3003.560 AXIS_PTS_REF InjCrv_stRlsOpRngThresRgnY_AXIS /end AXIS_DESCR
/end CHARACTERISTIC
/begin AXIS_PTS InjCrv_stRlsOpRngThresRgnX_AXIS "X-Gruppenstützstelle der Kennfelder für die Freigabe der Voreinspritzungen im Regenerationbetrieb" 0x8003DDFE InjSys_tEngRgnPiIRls Axis_Xs16 250.0000 Temp_Cels 10 -50.14000 199.8600 FORMAT "%8.4" EXTENDED_LIMITS -3549.940 3003.560 DEPOSIT ABSOLUTE /end AXIS_PTS
/begin AXIS_PTS InjCrv_stRlsOpRngThresRgnY_AXIS "Y-Gruppenstützstelle der Kennfelder für die Freigabe der Voreinspritzungen im Regenerationbetrieb" 0x8003DE14 InjSys_tAirRgn Axis_Xs16 250.0000 Temp_Cels 10 -50.14000 199.8600 FORMAT "%8.4" EXTENDED_LIMITS -3549.940 3003.560 DEPOSIT ABSOLUTE /end AXIS_PTS
/begin CHARACTERISTIC InjCrv_stRlsOpRngThres_MAP "Betriebsbereichsschwellen für die Freigabe der Voreinspritzungen" MAP 0x8003DE2A Map_Xs16Ys16Ws16 4.00000000000 INJCRV_MAPRLS_VERB 1.00000000000 5.00000000000 FORMAT "%13.11" EXTENDED_LIMITS 1.00000000000 6.00000000000
 /begin AXIS_DESCR STD_AXIS InjSys_tEngPiIRls Temp_Cels 16 -50.14000 199.8600 EXTENDED_LIMITS -3549.940 3003.560 DEPOSIT ABSOLUTE /end AXIS_DESCR
 /begin AXIS_DESCR STD_AXIS InjSys_tAir Temp_Cels 16 -50.14000 199.8600 EXTENDED_LIMITS -3549.940 3003.560 DEPOSIT ABSOLUTE /end AXIS_DESCR
/end CHARACTERISTIC
/begin CHARACTERISTIC InjCrv_swtMI1QntCSCCorActv_C "Schalter zur Auswahl der Art des CSC-Korrektureingriffs (0- Ansteuerdauer, 1- Menge) auf MI1" VALUE 0x8003EFBA Val_Wu8 1.000 OneToOne 0.00 1.000 EXTENDED_LIMITS 0.00 255.0 /end CHARACTERISTIC
/begin CHARACTERISTIC InjCrv_swtPhiMI1Des_C "Schalter des Fernsteuerwerts des Ansteuerbeginns der MI" VALUE 0x8003EECF Val_Wu8 1.000 OneToOne 0.00 1.000 EXTENDED_LIMITS 0.00 255.0 /end CHARACTERISTIC
/begin CHARACTERISTIC InjCrv_swtPhiPiI1Des_C "Schalter des Fernsteuerwerts des Ansteuerbeginns (Winkelkomponente) der PiI1" VALUE 0x80041E7B Val_Wu8 1.000 OneToOne 0.00 1.000 EXTENDED_LIMITS 0.00 255.0 /end CHARACTERISTIC
/begin CHARACTERISTIC InjCrv_swtQntMI1Des_C "Schalter des Fernsteuerwerts der Einspritzmenge der MI1" VALUE 0x8003EED0 Val_Wu8 1.000 OneToOne 0.00 1.000 EXTENDED_LIMITS 0.00 255.0 /end CHARACTERISTIC
/begin CHARACTERISTIC InjCrv_swtQntPiI1Des_C "Schalter des Fernsteuerwerts der Einspritzmenge der PiI1" VALUE 0x80041E7C Val_Wu8 1.000 OneToOne 0.00 1.000 EXTENDED_LIMITS 0.00 255.0 /end CHARACTERISTIC
/begin CHARACTERISTIC InjCrv_swtStInjCharActVal_C "Schalter des Fernsteuerwerts der Einspritzcharakteristik Istwert" VALUE 0x8003EED1 Val_Wu8 1.000 OneToOne 0.00 1.000 EXTENDED_LIMITS 0.00 255.0 /end CHARACTERISTIC
/begin CHARACTERISTIC InjCrv_swtTiPiI1Des_C "Schalter des Fernsteuerwerts des Ansteuerbeginns (Zeitkomponente) der PiI1" VALUE 0x80041E7D Val_Wu8 1.000 OneToOne 0.00 1.000 EXTENDED_LIMITS 0.00 255.0 /end CHARACTERISTIC
/begin CHARACTERISTIC InjCrv_tAirCylOffsRlsMaxHigh_C "Obere Grenze der Hystrerese tAir max" VALUE 0x8003E182 Kw_Ws16 250.0000 Temp_Cels -50.04000 199.9600 EXTENDED_LIMITS -3549.940 3003.560 /end CHARACTERISTIC
/begin CHARACTERISTIC InjCrv_tAirCylOffsRlsMaxLow_C "Obere Grenze der Hystrerese tAir min" VALUE 0x8003E184 Kw_Ws16 250.0000 Temp_Cels -50.04000 199.9600 EXTENDED_LIMITS -3549.940 3003.560 /end CHARACTERISTIC
/begin CHARACTERISTIC InjCrv_tAirCylOffsRlsMinHigh_C "Obere Grenze der Hystrerese tAir min" VALUE 0x8003E186 Kw_Ws16 250.0000 Temp_Cels -50.04000 199.9600 EXTENDED_LIMITS -3549.940 3003.560 /end CHARACTERISTIC
/begin CHARACTERISTIC InjCrv_tAirCylOffsRlsMinLow_C "Untere Grenze der Hystrerese tAir min" VALUE 0x8003E188 Kw_Ws16 250.0000 Temp_Cels -50.04000 199.9600 EXTENDED_LIMITS -3549.940 3003.560 /end CHARACTERISTIC
/begin CHARACTERISTIC InjCrv_tEngCylOffsRlsMaxHigh_C "Obere Grenze der Hystrerese tEng max" VALUE 0x8003E18A Kw_Ws16 250.0000 Temp_Cels -50.04000 199.9600 EXTENDED_LIMITS -3549.940 3003.560 /end CHARACTERISTIC
/begin CHARACTERISTIC InjCrv_tEngCylOffsRlsMaxLow_C "Untere Grenze der Hystrerese tEng max" VALUE 0x8003E18C Kw_Ws16 250.0000 Temp_Cels -50.04000 199.9600 EXTENDED_LIMITS -3549.940 3003.560 /end CHARACTERISTIC
/begin CHARACTERISTIC InjCrv_tEngCylOffsRlsMinHigh_C "Obere Grenze der Hystrerese tEng min" VALUE 0x8003E18E Kw_Ws16 250.0000 Temp_Cels -50.04000 199.9600 EXTENDED_LIMITS -3549.940 3003.560 /end CHARACTERISTIC
/begin CHARACTERISTIC InjCrv_tEngCylOffsRlsMinLow_C "Untere Grenze der Hystrerese tEng min" VALUE 0x8003E190 Kw_Ws16 250.0000 Temp_Cels -50.04000 199.9600 EXTENDED_LIMITS -3549.940 3003.560 /end CHARACTERISTIC
/begin CHARACTERISTIC InjCrv_tiLowNegPT1_C "dq filter time constant neg. slope low range" VALUE 0x80069924 Kw_Wu32 4294.9672950 TimeDelay_s 0.000001000000000 4294.9672960 FORMAT "%12.7" /end CHARACTERISTIC
/begin CHARACTERISTIC InjCrv_tiLowPosPT1_C "dq filter time constant pos. slope low range" VALUE 0x80069928 Kw_Wu32 4294.9672950 TimeDelay_s 0.000001000000000 4294.9672960 FORMAT "%12.7" /end CHARACTERISTIC
/begin CHARACTERISTIC InjCrv_tiMidNegPT1_C "dq filter time constant neg. slope medium range" VALUE 0x8006992C Kw_Wu32 4294.9672950 TimeDelay_s 0.000001000000000 4294.9672960 FORMAT "%12.7" /end CHARACTERISTIC
/begin CHARACTERISTIC InjCrv_tiMidPosPT1_C "dq filter time constant pos. slope medium range" VALUE 0x80069930 Kw_Wu32 4294.9672950 TimeDelay_s 0.000001000000000 4294.9672960 FORMAT "%12.7" /end CHARACTERISTIC
/begin CHARACTERISTIC InjCrv_tiPiI1BasCylOffs_MAP "Basiskennfeld des Offsets des Ansteueerbeginns der VE1" MAP 0x8003E192 Kf_Xs16_Ys16_Ws16 8000.000 InjTime_us -3000.000 5000.000 EXTENDED_LIMITS -13107.20 13106.80
 /begin AXIS_DESCR STD_AXIS Epm_nEng EngN 5 0.00 6000.000 EXTENDED_LIMITS -16384.00 16383.50 DEPOSIT ABSOLUTE /end AXIS_DESCR
 /begin AXIS_DESCR STD_AXIS InjCtl_qSetUnBal InjMass 5 0.00 327.6700 EXTENDED_LIMITS -327.6800 327.6700 DEPOSIT ABSOLUTE /end AXIS_DESCR
/end CHARACTERISTIC
/begin CHARACTERISTIC InjCrv_tiPiI1Des_C "Fernsteuerwert des Ansteuerbeginns (Zeitkomponente) der PiI1" VALUE 0x80041E7E Val_Ws16 5000.00 InjTime_us 0.00 5000.00 EXTENDED_LIMITS -13107.20 13106.80 /end CHARACTERISTIC
/begin CHARACTERISTIC InjCrv_tiPiI1Min2_MAP "Zeitkomponente PiI1 Minimalwertekennfeld bei aktiver PiI2" MAP 0x80041E80 Kf_Xs16_Ys16_Ws16 5000.00 InjTime_us 0.00 5000.00 EXTENDED_LIMITS -13107.20 13106.80
 /begin AXIS_DESCR STD_AXIS Epm_nEng EngN 10 0.00 6000.000 EXTENDED_LIMITS -16384.00 16383.50 DEPOSIT ABSOLUTE /end AXIS_DESCR
 /begin AXIS_DESCR STD_AXIS InjCtl_qSetUnBal InjMass 10 0.00 327.6700 EXTENDED_LIMITS -327.6800 327.6700 DEPOSIT ABSOLUTE /end AXIS_DESCR
/end CHARACTERISTIC
/begin CHARACTERISTIC InjCrv_tiPiI1MinRgn_MAP "Mappe des Pil1-Abstands im Fall der Regeneration" MAP 0x80041F74 Kf_Xs16_Ys16_Ws16 5000.00 InjTime_us 0.00 5000.00 EXTENDED_LIMITS -13107.20 13106.80
 /begin AXIS_DESCR STD_AXIS Epm_nEng EngN 10 0.00 6000.000 EXTENDED_LIMITS -16384.00 16383.50 DEPOSIT ABSOLUTE /end AXIS_DESCR
 /begin AXIS_DESCR STD_AXIS InjCtl_qSetUnBal InjMass 10 0.00 327.6700 EXTENDED_LIMITS -327.6800 327.6700 DEPOSIT ABSOLUTE /end AXIS_DESCR
/end CHARACTERISTIC
/begin CHARACTERISTIC InjCrv_tiPiI1Min_MAP "Kennfeld zur Ermittlung der minimalen Zeit der PiI1 relativ zur MI" MAP 0x80042068 Kf_Xs16_Ys16_Ws16 5000.00 InjTime_us 0.00 5000.00 EXTENDED_LIMITS -13107.20 13106.80
 /begin AXIS_DESCR STD_AXIS Epm_nEng EngN 10 0.00 6000.000 EXTENDED_LIMITS -16384.00 16383.50 DEPOSIT ABSOLUTE /end AXIS_DESCR
 /begin AXIS_DESCR STD_AXIS InjCtl_qSetUnBal InjMass 10 0.00 327.6700 EXTENDED_LIMITS -327.6800 327.6700 DEPOSIT ABSOLUTE /end AXIS_DESCR
/end CHARACTERISTIC
/begin CHARACTERISTIC InjCrv_tiPiI2BasCylOffs_MAP "" MAP 0x8003E1DC Kf_Xs16_Ys16_Ws16 8000.000 InjTime_us -3000.000 5000.000 EXTENDED_LIMITS -13107.20 13106.80
 /begin AXIS_DESCR STD_AXIS Epm_nEng EngN 5 0.00 6000.000 EXTENDED_LIMITS -16384.00 16383.50 DEPOSIT ABSOLUTE /end AXIS_DESCR
 /begin AXIS_DESCR STD_AXIS InjCtl_qSetUnBal InjMass 5 0.00 327.6700 EXTENDED_LIMITS -327.6800 327.6700 DEPOSIT ABSOLUTE /end AXIS_DESCR
/end CHARACTERISTIC
/begin CHARACTERISTIC InjCrv_tiPiIMax_C "maximale Zeitkomponente PiI, bedingt durch Hardware" VALUE 0x8004215C Val_Ws16 5000.00 InjTime_us 0.00 5000.00 EXTENDED_LIMITS -13107.20 13106.80 /end CHARACTERISTIC
/begin CHARACTERISTIC InjCrv_tiUppNegPT1_C "dq filter time constant neg. slope high range" VALUE 0x80069934 Kw_Wu32 4294.9672950 TimeDelay_s 0.000001000000000 4294.9672960 FORMAT "%12.7" /end CHARACTERISTIC
/begin CHARACTERISTIC InjCrv_tiUppPosPT1_C "dq filter time constant pos. slope high range" VALUE 0x80069938 Kw_Wu32 4294.9672950 TimeDelay_s 0.000001000000000 4294.9672960 FORMAT "%12.7" /end CHARACTERISTIC
/begin CHARACTERISTIC InjCrv_vThreshDelta_C "" VALUE 0x8003DC2C Val_Ws16 655.3500 Vel -327.6800 327.6700 /end CHARACTERISTIC
/begin CHARACTERISTIC InjCrv_vThreshLo1_C "" VALUE 0x8003DC2E Val_Ws16 655.3500 Vel -327.6800 327.6700 /end CHARACTERISTIC
/begin CHARACTERISTIC InjCrv_vThreshLo2_C "" VALUE 0x8003DC30 Val_Ws16 655.3500 Vel -327.6800 327.6700 /end CHARACTERISTIC
/begin CHARACTERISTIC InjCrv_vThreshLo3_C "" VALUE 0x8003DC32 Val_Ws16 655.3500 Vel -327.6800 327.6700 /end CHARACTERISTIC
/begin CHARACTERISTIC InjCrv_vThreshLo4_C "" VALUE 0x8003DC34 Val_Ws16 655.3500 Vel -327.6800 327.6700 /end CHARACTERISTIC
/begin CHARACTERISTIC InjCrv_vThreshLo5_C "" VALUE 0x8003DC36 Val_Ws16 655.3500 Vel -327.6800 327.6700 /end CHARACTERISTIC
/begin CHARACTERISTIC InjCrv_vThreshLo6_C "" VALUE 0x8003DC38 Val_Ws16 655.3500 Vel -327.6800 327.6700 /end CHARACTERISTIC
/begin CHARACTERISTIC InjCrv_vThreshLo7_C "" VALUE 0x8003DC3A Val_Ws16 655.3500 Vel -327.6800 327.6700 /end CHARACTERISTIC
/begin CHARACTERISTIC InjCrv_vThreshLoNo_C "" VALUE 0x8003DC3C Val_Ws16 655.3500 Vel -327.6800 327.6700 /end CHARACTERISTIC
/begin CHARACTERISTIC InjCrv_vThreshLoR_C "" VALUE 0x8003DC3E Val_Ws16 655.3500 Vel -327.6800 327.6700 /end CHARACTERISTIC
/begin CHARACTERISTIC InjCrv_vVehPiIRlsHigh_C "obere Hystereseschwelle zur fahrzeuggeschwindigkeitsabhängigen PiI Freigabekorrektur" VALUE 0x8003DC4C Val_Ws16 300.0000 Vel 0.00 300.0000 EXTENDED_LIMITS -327.6800 327.6700 /end CHARACTERISTIC
/begin CHARACTERISTIC InjCrv_vVehPiIRlsLow_C "untere Hystereseschwelle zur fahrzeuggeschwindigkeitsabhängigen PiI Freigabekorrektur" VALUE 0x8003DC4E Val_Ws16 300.0000 Vel 0.00 300.0000 EXTENDED_LIMITS -327.6800 327.6700 /end CHARACTERISTIC
/begin CHARACTERISTIC KF_GENTYP_NEU "Auswahlkennfeld Generatortyp" MAP 0x800641EA MapTKF_UB_UB_UB 6.0 Def_st_ub_q1 1.0 7.0 EXTENDED_LIMITS 0.00 255.
 /begin AXIS_DESCR STD_AXIS Gen_manufak Def_st_ub_q1 6 0.00 255. FORMAT "%3.0" DEPOSIT ABSOLUTE /end AXIS_DESCR
 /begin AXIS_DESCR STD_AXIS Gen_typkenn Def_st_ub_q1 32 0.00 255. FORMAT "%3.0" DEPOSIT ABSOLUTE /end AXIS_DESCR
/end CHARACTERISTIC
/begin CHARACTERISTIC KF_IU1T1_1 "Kennfeld Generatorstrommodell" MAP 0x800642D2 MapTKF_SW_SW_SW 2047.969 Def_i_sw_q0p03125 -1024.000 1023.969 FORMAT "%8.3"
 /begin AXIS_DESCR STD_AXIS X_KF_IU1T1_1_no_input_quantity Def_i_sw_q0p125 10 -4096.000 4095.875 FORMAT "%8.3" DEPOSIT ABSOLUTE /end AXIS_DESCR
 /begin AXIS_DESCR STD_AXIS N_gen Def_n_sw_q1p0 10 -32768. 32767. FORMAT "%5.0" DEPOSIT ABSOLUTE /end AXIS_DESCR
/end CHARACTERISTIC
/begin CHARACTERISTIC KF_IU1T2_1 "Kennfeld Generatorstrommodell" MAP 0x800643C4 MapTKF_SW_SW_SW 2047.969 Def_i_sw_q0p03125 -1024.000 1023.969 FORMAT "%8.3"
 /begin AXIS_DESCR STD_AXIS X_KF_IU1T2_1_no_input_quantity Def_i_sw_q0p125 10 -4096.000 4095.875 FORMAT "%8.3" DEPOSIT ABSOLUTE /end AXIS_DESCR
 /begin AXIS_DESCR STD_AXIS N_gen Def_n_sw_q1p0 10 -32768. 32767. FORMAT "%5.0" DEPOSIT ABSOLUTE /end AXIS_DESCR
/end CHARACTERISTIC
/begin CHARACTERISTIC KF_IU2T1_1 "Kennfeld Generatorstrommodell" MAP 0x800644B6 MapTKF_SW_SW_SW 2047.969 Def_i_sw_q0p03125 -1024.000 1023.969 FORMAT "%8.3"
 /begin AXIS_DESCR STD_AXIS X_KF_IU2T1_1_no_input_quantity Def_i_sw_q0p125 10 -4096.000 4095.875 FORMAT "%8.3" DEPOSIT ABSOLUTE /end AXIS_DESCR
 /begin AXIS_DESCR STD_AXIS N_gen Def_n_sw_q1p0 10 -32768. 32767. FORMAT "%5.0" DEPOSIT ABSOLUTE /end AXIS_DESCR
/end CHARACTERISTIC
/begin CHARACTERISTIC KF_MDGENFIL "Kennfeld Filterkonstante Generatormoment" MAP 0x800645A8 MapTKF_SW_UB_UW 0.9999847412109 Def_f_uw_b1 0.00 0.9999847412109 FORMAT "%15.13"
 /begin AXIS_DESCR STD_AXIS Dffgen_f Def_f_ub_b100 6 0.00 99.61 DEPOSIT ABSOLUTE /end AXIS_DESCR
 /begin AXIS_DESCR STD_AXIS Dffgen_dt Def_dt_sw_b4096 6 -4096.00 4095.88 FORMAT "%7.2" DEPOSIT ABSOLUTE /end AXIS_DESCR
/end CHARACTERISTIC
/begin CHARACTERISTIC KF_MU1T1_1 "Kennfeld Generatormomentenmodell" MAP 0x80064604 MapTKF_SW_SW_SW 6553.50 Def_m_sw_q0p1 -3276.80 3276.70 FORMAT "%7.2"
 /begin AXIS_DESCR STD_AXIS Ierr Def_i_ub_q0p125 10 -4096.0 4095.9 FORMAT "%6.1" EXTENDED_LIMITS 0.00 31.875 DEPOSIT ABSOLUTE /end AXIS_DESCR
 /begin AXIS_DESCR STD_AXIS N_gen Def_n_sw_q1p0 10 -32768. 32767. FORMAT "%5.0" DEPOSIT ABSOLUTE /end AXIS_DESCR
/end CHARACTERISTIC
/begin CHARACTERISTIC KF_MU1T2_1 "Kennfeld Generatormomentenmodell" MAP 0x800646F6 MapTKF_SW_SW_SW 6553.50 Def_m_sw_q0p1 -3276.80 3276.70 FORMAT "%7.2"
 /begin AXIS_DESCR STD_AXIS Ierr Def_i_ub_q0p125 10 -4096.0 4095.9 FORMAT "%6.1" EXTENDED_LIMITS 0.00 31.875 DEPOSIT ABSOLUTE /end AXIS_DESCR
 /begin AXIS_DESCR STD_AXIS N_gen Def_n_sw_q1p0 10 -32768. 32767. FORMAT "%5.0" DEPOSIT ABSOLUTE /end AXIS_DESCR
/end CHARACTERISTIC
/begin CHARACTERISTIC KF_MU2T1_1 "Kennfeld Generatormomentenmodell" MAP 0x800647E8 MapTKF_SW_SW_SW 6553.50 Def_m_sw_q0p1 -3276.80 3276.70 FORMAT "%7.2"
 /begin AXIS_DESCR STD_AXIS Ierr Def_i_ub_q0p125 10 -4096.0 4095.9 FORMAT "%6.1" EXTENDED_LIMITS 0.00 31.875 DEPOSIT ABSOLUTE /end AXIS_DESCR
 /begin AXIS_DESCR STD_AXIS N_gen Def_n_sw_q1p0 10 -32768. 32767. FORMAT "%5.0" DEPOSIT ABSOLUTE /end AXIS_DESCR
/end CHARACTERISTIC
/begin CHARACTERISTIC KL_GENUEBSETZ "Kennlinie für Generatoruebersetzung" CURVE 0x800648DA CurTKL_UB_VV_UB 3.969 Def_f_ub_b4 0.01563 3.984 EXTENDED_LIMITS 0.00 3.984
 /begin AXIS_DESCR STD_AXIS Gen_awnumm Def_st_ub_q1 8 0.00 255. FORMAT "%3.0" DEPOSIT ABSOLUTE /end AXIS_DESCR
/end CHARACTERISTIC
/begin CHARACTERISTIC KL_T_CHIP1 "Applikationskonstanten für Temperaturen Generatormodell" CURVE 0x800648EC CurTKL_UB_VV_SW 6553.5 Def_t_sw_q0p1 -3276.8 3276.7 FORMAT "%6.1"
 /begin AXIS_DESCR STD_AXIS Gen_awnumm Def_st_ub_q1 6 0.00 255. FORMAT "%3.0" DEPOSIT ABSOLUTE /end AXIS_DESCR
/end CHARACTERISTIC
/begin CHARACTERISTIC KL_T_CHIP2 "Applikationskonstanten für Temperaturen Generatormodell" CURVE 0x80064900 CurTKL_UB_VV_SW 6553.5 Def_t_sw_q0p1 -3276.8 3276.7 FORMAT "%6.1"
 /begin AXIS_DESCR STD_AXIS Gen_awnumm Def_st_ub_q1 6 0.00 255. FORMAT "%3.0" DEPOSIT ABSOLUTE /end AXIS_DESCR
/end CHARACTERISTIC
/begin CHARACTERISTIC K_DFFGENFIL "Filterkonstante Dffgen" VALUE 0x80064914 Val_Wu8 0.99609 Def_f_ub_b1 0.00 0.99609 FORMAT "%7.5" /end CHARACTERISTIC
/begin CHARACTERISTIC K_DF_DEAKAPP "Df-Schwelle für IG 0A Zwangssetzung" VALUE 0x80064915 Val_Wu8 99.61 Def_f_ub_b100 0.00 99.61 /end CHARACTERISTIC
/begin CHARACTERISTIC K_EN_MDGEN "Berechnung Generatormoment (in)aktiv" VALUE 0x80064916 Val_Wu8 255. Def_st_ub_q1 0.00 255. FORMAT "%3.0" /end CHARACTERISTIC
/begin CHARACTERISTIC K_GENMDNMOF "Offset des Generatormoments" VALUE 0x80064918 Val_Ws16 6553.50 Def_m_sw_q0p1 -3276.80 3276.70 FORMAT "%7.2" /end CHARACTERISTIC
/begin CHARACTERISTIC K_GEN_IGOF "Offsetwert Generatorstrom" VALUE 0x8006491A Val_Wu16 254.000 Def_f_uw_b2048 0.00 254.000 FORMAT "%7.3" EXTENDED_LIMITS 0.00 2047.97 /end CHARACTERISTIC
/begin CHARACTERISTIC K_IMDGENNRRW "Schwellwert zum Rechenrasterwechsel Momentenberechung" VALUE 0x8006491C Val_Ws16 65535. Def_n_sw_q1p0 -32768. 32767. FORMAT "%5.0" /end CHARACTERISTIC
/begin CHARACTERISTIC K_MANAWNUMM "Manuelle Vorgabe Generatortyp" VALUE 0x8006491E Val_Wu8 5.0 Def_st_ub_q1 1.0 6.0 EXTENDED_LIMITS 0.00 255. /end CHARACTERISTIC
/begin CHARACTERISTIC K_MDGENNL "Notlaufwert" VALUE 0x80064920 Val_Ws16 6553.50 Def_m_sw_q0p1 -3276.80 3276.70 FORMAT "%7.2" /end CHARACTERISTIC
/begin CHARACTERISTIC K_NSCHW_CALC "Drehzahlschwelle für Generator-Grenzmoment-Berechnung" VALUE 0x80064922 Val_Ws16 32767. Def_n_sw_q1p0 0.00 32767. FORMAT "%5.0" EXTENDED_LIMITS -32768. 32767. /end CHARACTERISTIC
/begin CHARACTERISTIC K_NSCHW_MD "Drehzahlschwelle fuer Aktivierung Generatormomentberechnung außerhalb BSD-Koordinator" VALUE 0x80064924 Val_Ws16 65535. Def_n_sw_q1p0 -32768. 32767. FORMAT "%5.0" /end CHARACTERISTIC
/begin CHARACTERISTIC K_R_LADLTG "Applikationskonstante für Widerstand Ladeleitung" VALUE 0x80064926 Val_Wu16 1024. Def_r_uw_b1024 0.00 1024. FORMAT "%5.0" /end CHARACTERISTIC
/begin CHARACTERISTIC K_TDFIERR "Filterzeit des Erregerstromes" VALUE 0x80064928 Val_Wu16 655.350 Def_td_uw_q0p01 0.00 655.350 FORMAT "%7.3" /end CHARACTERISTIC
/begin CHARACTERISTIC K_UBOFF "Spannungsoffset für ugen_calc" VALUE 0x8006492A Val_Wu16 6553.500 Def_u_uw_q0p1 0.00 6553.500 FORMAT "%8.3" /end CHARACTERISTIC
/begin CHARACTERISTIC K_ZMGENIG "Filterzeit der Generatorstromes" VALUE 0x8006492C Val_Wu16 6553.5 Def_td_uw_q0p1 0.00 6553.5 FORMAT "%6.1" /end CHARACTERISTIC
/begin CHARACTERISTIC S_RDGENTYP "Schalter Freigabe Manuelle Vorgabe Generatortyp" VALUE 0x8006492E Val_Wu8 255. Def_st_ub_q1 0.00 255. FORMAT "%3.0" /end CHARACTERISTIC
/begin MEASUREMENT Dffgen_dt "Ableitung Dffgensignal" SWORD Def_dt_sw_b4096 1 100 -4096.00 4095.88 FORMAT "%7.2" ECU_ADDRESS 0xC0009FCC /end MEASUREMENT
/begin MEASUREMENT Dffgen_f "Gefiltertes Dffgen" UBYTE Def_f_ub_b100 1 100 0.00 99.61 ECU_ADDRESS 0xC000B22D /end MEASUREMENT
/begin MEASUREMENT Gen_awnumm "Generatorkennfeldnummer" UBYTE Def_st_ub_q1 1 100 1.0 7.0 ECU_ADDRESS 0xC000B22E /end MEASUREMENT
/begin MEASUREMENT Gen_uebsetz "Generatoruebersetzung" UBYTE Def_f_ub_b4 1 100 0.01563 3.984 ECU_ADDRESS 0xC000B22F /end MEASUREMENT
/begin MEASUREMENT InjCrv_dpMIDynCor_mp "DT1 gefilterter Atmosphärendruck" SWORD dp_dZ20 1 100 -327680.0 327670.0 FORMAT "%8.1" ECU_ADDRESS 0xC000A042 /end MEASUREMENT
/begin MEASUREMENT InjCrv_dqSetUnBal "InjCrv_qSetUnBal DT1 filtered" SWORD InjMassPerSec_20ms 1 100 -16384.00 16383.50 FORMAT "%8.2" ECU_ADDRESS 0xD0000CF2 /end MEASUREMENT
/begin MEASUREMENT InjCrv_dqSetUnBalFltLim "Einspritzmengengradient (Dummy)" SWORD InjMassPerSec_20ms 1 100 -16384.00 16383.50 FORMAT "%8.2" ECU_ADDRESS 0xD0000CF4 /end MEASUREMENT
/begin MEASUREMENT InjCrv_dqSetUnBalFlt_mp "InjCrv_qSetUnBal DT1 und PT1 filtered" SWORD InjMassPerSec_20ms 1 100 -16384.00 16383.50 FORMAT "%8.2" ECU_ADDRESS 0xC000A02A /end MEASUREMENT
/begin MEASUREMENT InjCrv_facAPPrMI1DynCor2_mp "Dynamikkorrektur für MI1 abhängig vom PWG Niveau" SWORD Fact 1 100 -4.000000 3.999878 ECU_ADDRESS 0xC000A02C /end MEASUREMENT
/begin MEASUREMENT InjCrv_facMI1APSSOECorRgn "luftdruckabhängige Korrekturfaktoren der Ansaugluft für die MI1 im Regenerationsbetrieb" SWORD Fact 1 100 -4.000000 3.999878 ARRAY_SIZE 2 ECU_ADDRESS 0xD0000CF6 /end MEASUREMENT
/begin MEASUREMENT InjCrv_facMI1ATSSOECorRgn "temperaturabhängige Korrekturfaktoren der Ansaugluft für die MI1 im Regenerationsbetrieb" SWORD Fact 1 100 -4.000000 3.999878 ARRAY_SIZE 2 ECU_ADDRESS 0xD0000CFA /end MEASUREMENT
/begin MEASUREMENT InjCrv_facMI1DynCor2_mp "dq correction factor MI SOE customer correction II" SWORD Fact 1 100 -4.000000 3.999878 ECU_ADDRESS 0xC000A044 /end MEASUREMENT
/begin MEASUREMENT InjCrv_facMI1DynCorSlow2 "factor depending on atmospheric pressure" SWORD Fact 1 100 -4.000000 3.999878 ECU_ADDRESS 0xD0000CFE /end MEASUREMENT
/begin MEASUREMENT InjCrv_facMI1ETSSOECorRgn "motortemperaturabhängige Korrekturfaktoren für die MI1 im Regenerationsbetrieb" SWORD Fact 1 100 -4.000000 3.999878 ARRAY_SIZE 2 ECU_ADDRESS 0xD0000D00 /end MEASUREMENT
/begin MEASUREMENT InjCrv_facMI1QntRmpVal_mp "Interpolationsfaktor für die Funktion CoEOM_OpModeSwtExtd" SWORD CoEOMSwt_S16 1 100 -2.000000 1.999939 FORMAT "%8.6" ECU_ADDRESS 0xC000A06C /end MEASUREMENT
/begin MEASUREMENT InjCrv_facMI1SOERmpVal_mp "Interpolationsfaktor für die Funktion InjCrv_MIRgnSwtSOE" SWORD CoEOMSwt_S16 1 100 -2.000000 1.999939 FORMAT "%8.6" ECU_ADDRESS 0xC000A06E /end MEASUREMENT
/begin MEASUREMENT InjCrv_facMIAPSPhiCor1 "atmosphärendruckabhängiger Korrekturfaktor -1 für MI1" SWORD Fact 1 100 -4.000000 3.999878 ECU_ADDRESS 0xD0000D04 /end MEASUREMENT
/begin MEASUREMENT InjCrv_facMIAPSPhiCor2 "atmosphärendruckabhängiger Korrekturfaktor -2 für MI1" SWORD Fact 1 100 -4.000000 3.999878 ECU_ADDRESS 0xD0000D06 /end MEASUREMENT
/begin MEASUREMENT InjCrv_facMIAPSPhiCorStrt "Korrekturfaktur für Atmosphärendruck im Start" SWORD Fact 1 100 -4.000000 3.999878 ECU_ADDRESS 0xD0000D08 /end MEASUREMENT
/begin MEASUREMENT InjCrv_facMIATSPhiCor1 "ansauglufttemperaturabhängiger Korrekturfaktor -1 für MI1" SWORD Fact 1 100 -4.000000 3.999878 ECU_ADDRESS 0xD0000D0A /end MEASUREMENT
/begin MEASUREMENT InjCrv_facMIATSPhiCor2 "ansauglufttemperaturabhängiger Korrekturfaktor -2 für MI1" SWORD Fact 1 100 -4.000000 3.999878 ECU_ADDRESS 0xD0000D0C /end MEASUREMENT
/begin MEASUREMENT InjCrv_facMIATSPhiCorStrt "Korrekturfaktur für Umgebungstemperatur im Start" SWORD Fact 1 100 -4.000000 3.999878 ECU_ADDRESS 0xD0000D0E /end MEASUREMENT
/begin MEASUREMENT InjCrv_facMIDynCor_mp "resultierneder Faktor abhängig von Lufttemperatur und Wassertemperatur" SWORD Fact 1 100 -4.000000 3.999878 ECU_ADDRESS 0xC000A058 /end MEASUREMENT
/begin MEASUREMENT InjCrv_facMIEgrPhiCor_mp "" SWORD Fact 1 100 -4.000000 3.999878 ECU_ADDRESS 0xC000A02E /end MEASUREMENT
/begin MEASUREMENT InjCrv_facMIETSPhiCor1 "motortemperaturabhängiger Korrekturfaktor -1 für MI1" SWORD Fact 1 100 -4.000000 3.999878 ECU_ADDRESS 0xD0000D14 /end MEASUREMENT
/begin MEASUREMENT InjCrv_facMIETSPhiCor11 "motortemperaturabhängiger Korrekturfaktor -1 für MI1" SWORD Fact 1 100 -4.000000 3.999878 ECU_ADDRESS 0xD0000D10 /end MEASUREMENT
/begin MEASUREMENT InjCrv_facMIETSPhiCor12 """motortemperaturabhängiger Korrekturfaktor für MI1 bei inaktiver PiI2""" SWORD Fact 1 100 -4.000000 3.999878 ECU_ADDRESS 0xD0000D12 /end MEASUREMENT
/begin MEASUREMENT InjCrv_facMIETSPhiCor2 "motortemperaturabhängiger Korrekturfaktor -2 für MI1" SWORD Fact 1 100 -4.000000 3.999878 ECU_ADDRESS 0xD0000D16 /end MEASUREMENT
/begin MEASUREMENT InjCrv_facMIETSPhiCorStrt "Korrekturfaktur für Motortemperatur im Start" SWORD Fact 1 100 -4.000000 3.999878 ECU_ADDRESS 0xD0000D18 /end MEASUREMENT
/begin MEASUREMENT InjCrv_facMIFTSRailCor "Korrekturfaktor für die MI1, abhängig von der kraftstofftemperaturabhängigen Raildruckkorrektur" SWORD Fact 1 100 -4.000000 3.999878 ECU_ADDRESS 0xD0000D1A /end MEASUREMENT
/begin MEASUREMENT InjCrv_facMIFTSRailCorStrt "Korrekturfaktor für Kraftstofftemperatur im Start" SWORD Fact 1 100 -4.000000 3.999878 ECU_ADDRESS 0xD0000D1C /end MEASUREMENT
/begin MEASUREMENT InjCrv_facMIIMTSPhiCor "" SWORD Fact 1 100 -4.000000 3.999878 ECU_ADDRESS 0xD0000D1E /end MEASUREMENT
/begin MEASUREMENT InjCrv_facMIPDynCor_mp "Korrekturfaktor abhängig vom Raildruck" SWORD Fact 1 100 -4.000000 3.999878 ECU_ADDRESS 0xC000A046 /end MEASUREMENT
/begin MEASUREMENT InjCrv_facMIPFltPhiCor "Korrekturfaktor für MI1 in Abhängigkeit der Partikelfilterbeladung" SWORD Fact 1 100 -4.000000 3.999878 ECU_ADDRESS 0xD0000D20 /end MEASUREMENT
/begin MEASUREMENT InjCrv_facPiI1QntMin_mp "Wichtungsfaktor zum Abschalten der Berechnung Voreinspritzung 1" SWORD Fact1 1 100 -256.0000 255.9922 ECU_ADDRESS 0xC000A072 /end MEASUREMENT
/begin MEASUREMENT InjCrv_facRmpCylOffs_mp "Messpunkt gerampter Freigabestatus der Funktion cyloffs" SWORD Fact 1 100 -4.000000 3.999878 ECU_ADDRESS 0xC000A002 /end MEASUREMENT
/begin MEASUREMENT InjCrv_numInjDes_mp "gewünschte Anzahl an Einspritzungen pro Arbeitsspiel" UBYTE OneToOne 1 100 0.00 255.0 ECU_ADDRESS 0xC000B235 /end MEASUREMENT
/begin MEASUREMENT InjCrv_numInjLim_mp "Erlaubte Anzahl an Einspritzungen" UBYTE OneToOne 1 100 0.00 255.0 ECU_ADDRESS 0xC000B236 /end MEASUREMENT
/begin MEASUREMENT InjCrv_numInjMaxSys "Systembedingte maximal erlaubte Anzahl an Einspritzungen" UBYTE OneToOne 1 100 0.00 255.0 ECU_ADDRESS 0xD0001F02 /end MEASUREMENT
/begin MEASUREMENT InjCrv_numInjRtmLim_mp "Erlaubte Anzahl von Einspritzungen in Abhängigkeit der Drehzahl" UBYTE OneToOne 1 100 0.00 255.0 ECU_ADDRESS 0xC000B237 /end MEASUREMENT
/begin MEASUREMENT InjCrv_numMI1RgnStg_mp "Anzahl der eingestellten Regenerationsstufen für die MI1" UBYTE OneToOne 1 100 0.00 255.0 ECU_ADDRESS 0xC000B247 /end MEASUREMENT
/begin MEASUREMENT InjCrv_phiMI1AddCor1 "kundenspezifischer Korrekturwinkel für die MI bei inaktiver PiI2" SWORD AngleCrS 1 100 -720.0000 719.9780 ECU_ADDRESS 0xD0000E00 /end MEASUREMENT
/begin MEASUREMENT InjCrv_phiMI1AddCor2 "kundenspezifischer Korrekturwinkel für die MI bei aktiver PiI2" SWORD AngleCrS 1 100 -720.0000 719.9780 ECU_ADDRESS 0xD0000E02 /end MEASUREMENT
/begin MEASUREMENT InjCrv_phiMI1AddCorRgn "kundenspezificher Korrekturwert der Winkelkomponente für den Ansteuerbeginn der MI1 im Regenerationsbetrieb" SWORD AngleCrS 1 100 -720.0000 719.9780 ECU_ADDRESS 0xD0000E04 /end MEASUREMENT
/begin MEASUREMENT InjCrv_phiMI1AddCorStrt "correction angle value = f(n, qSetUnBal, ETS)" SWORD AngleCrS 1 100 -720.0000 719.9780 ECU_ADDRESS 0xD0000E06 /end MEASUREMENT
/begin MEASUREMENT InjCrv_phiMI1APSCorRgn_mp "Gewichtete Winkelkorrekturen abhängig von dem Umgebungsluftdruck für die MI1 im Regenerationsbetrieb" SWORD AngleCrS 1 100 -720.0000 719.9780 ARRAY_SIZE 2 ECU_ADDRESS 0xC000C004 /end MEASUREMENT
/begin MEASUREMENT InjCrv_phiMI1ATSCorRgn_mp "Gewichteter Korrekturwert abhängig von der Ansauglufttemperatur abhängig vom Ansteuerbeginn der MI1 im Regenerationsbetrieb" SWORD AngleCrS 1 100 -720.0000 719.9780 ARRAY_SIZE 2 ECU_ADDRESS 0xC000C008 /end MEASUREMENT
/begin MEASUREMENT InjCrv_phiMI1Bas "Grundwert Ansteuerbeginn MI1" SWORD AngleCrS 1 100 -720.0000 719.9780 ECU_ADDRESS 0xD0000E08 /end MEASUREMENT
/begin MEASUREMENT InjCrv_phiMI1BasCylOffs_mp "Messpunkt Basiswert des Offsets des Ansteuerbeginns der MI1" SWORD AngleCrS 1 100 -720.0000 719.9780 ECU_ADDRESS 0xC000A004 /end MEASUREMENT
/begin MEASUREMENT InjCrv_phiMI1BasRgn_mp "Regenerationswert für den Ansteuerbeginn der MI1" SWORD AngleCrS 1 100 -720.0000 719.9780 ARRAY_SIZE 2 ECU_ADDRESS 0xC000C010 /end MEASUREMENT
/begin MEASUREMENT InjCrv_phiMI1Cor "Korrigierter Grundwert Ansteuerbeginn MI1" SWORD AngleCrS 1 100 -720.0000 719.9780 ECU_ADDRESS 0xD0000E0A /end MEASUREMENT
/begin MEASUREMENT InjCrv_phiMI1CorAct "Vorliegender korrigierter Grundwert Ansteuerbeginn MI1 für aktuelle Motorbetriebsart" SWORD AngleCrS 1 100 -720.0000 719.9780 ECU_ADDRESS 0xD0000E0C /end MEASUREMENT
/begin MEASUREMENT InjCrv_phiMI1CorDes "Neuer, korrigierter Grundwert Ansteuerbeginn MI1 für neue Motorbetriebsart" SWORD AngleCrS 1 100 -720.0000 719.9780 ECU_ADDRESS 0xD0000E0E /end MEASUREMENT
/begin MEASUREMENT InjCrv_phiMI1CylOffs "Messpunkt Array Zyl[1-8] Offset Einspritzwinkel der MI1" SWORD AngleCrS 1 100 -720.0000 719.9780 ARRAY_SIZE 6 ECU_ADDRESS 0xD0000E10 /end MEASUREMENT
/begin MEASUREMENT InjCrv_phiMI1Des "gewünschter Bezugswinkel für Beginn der MI1" SWORD AngleCrS 1 100 -720.0000 719.9780 ECU_ADDRESS 0xD0000E1C /end MEASUREMENT
/begin MEASUREMENT InjCrv_phiMI1DesAddByp_mp "Wert des gewünschten Winkels für die Haupteinspritzung vor einem additiven Bypasseingriff" SWORD AngleCrS 1 100 -720.0000 719.9780 ECU_ADDRESS 0xC000A00C /end MEASUREMENT
/begin MEASUREMENT InjCrv_phiMI1DesAdd_mp "Additiver Bypasseingriff für gewünschten Winkel der Haupteinspritzung" SWORD AngleCrS 1 100 -720.0000 719.9780 ECU_ADDRESS 0xC000A00E /end MEASUREMENT
/begin MEASUREMENT InjCrv_phiMI1DesByp_mp "Bypass-Label, Kopie von InjCrv_phiMI1Des" SWORD AngleCrS 1 100 -720.0000 719.9780 ECU_ADDRESS 0xC000A010 /end MEASUREMENT
/begin MEASUREMENT InjCrv_phiMI1DesCSCCor "" SWORD AngleCrS 1 100 -720.0000 719.9780 ECU_ADDRESS 0xD0000E22 /end MEASUREMENT
/begin MEASUREMENT InjCrv_phiMI1DesCSCMax_mp "Maximaler CSC-Eingriffswinkel für FB MI1" SWORD AngleCrS 1 100 -720.0000 719.9780 ECU_ADDRESS 0xC000A01E /end MEASUREMENT
/begin MEASUREMENT InjCrv_phiMI1DesCSCMin_mp "Minimaler CSC-Eingriffswinkel für FB MI1" SWORD AngleCrS 1 100 -720.0000 719.9780 ECU_ADDRESS 0xC000A020 /end MEASUREMENT
/begin MEASUREMENT InjCrv_phiMI1DesS1 "FB-Sollwert der MI1 (vorläufiger Wert im S1 Interrupt)" SWORD AngleCrS 1 100 -720.0000 719.9780 ECU_ADDRESS 0xD0000E24 /end MEASUREMENT
/begin MEASUREMENT InjCrv_phiMI1DynCor1_mp "MI SOE customer correction 1" SWORD AngleCrS 1 100 -720.0000 719.9780 ECU_ADDRESS 0xC000A048 /end MEASUREMENT
/begin MEASUREMENT InjCrv_phiMI1DynCor2Bas_mp "MI SOE customer correction II, base value" SWORD AngleCrS 1 100 -720.0000 719.9780 ECU_ADDRESS 0xC000A04A /end MEASUREMENT
/begin MEASUREMENT InjCrv_phiMI1DynCor2_mp "Abschließender Wert MI1 SOE der dynamischen Korrektur des Winkels 2" SWORD AngleCrS 1 100 -720.0000 719.9780 ECU_ADDRESS 0xC000A04C /end MEASUREMENT
/begin MEASUREMENT InjCrv_phiMI1DynCor_mp "MI SOE customer correction 1" SWORD AngleCrS 1 100 -720.0000 719.9780 ECU_ADDRESS 0xC000A056 /end MEASUREMENT
/begin MEASUREMENT InjCrv_phiMI1EnvCor1 "Ansteuerbeginnkorrekturwert 1 für MI1 (n sync)" SWORD AngleCrS 1 100 -720.0000 719.9780 ECU_ADDRESS 0xD0000E26 /end MEASUREMENT
/begin MEASUREMENT InjCrv_phiMI1EnvCor2 "Ansteuerbeginnkorrekturwert 2 für MI1 (n sync)" SWORD AngleCrS 1 100 -720.0000 719.9780 ECU_ADDRESS 0xD0000E28 /end MEASUREMENT
/begin MEASUREMENT InjCrv_phiMI1EnvCorRgn "Ansteuerbeginn Korrekturwinkel für MI1 im Regenerationsbetrieb" SWORD AngleCrS 1 100 -720.0000 719.9780 ARRAY_SIZE 2 ECU_ADDRESS 0xD0000E2A /end MEASUREMENT
/begin MEASUREMENT InjCrv_phiMI1ETSCorRgn_mp "Gewichteter Korrekturwert abhängig von der Motortemperatur abhängig vom Ansteuerbeginn der MI1 im Regenerationsbetrieb" SWORD AngleCrS 1 100 -720.0000 719.9780 ARRAY_SIZE 2 ECU_ADDRESS 0xC000C00C /end MEASUREMENT
/begin MEASUREMENT InjCrv_phiMI1Lim_mp "begrenzter Sollwert Ansteuerbeginn MI1" SWORD AngleCrS 1 100 -720.0000 719.9780 ECU_ADDRESS 0xC000A012 /end MEASUREMENT
/begin MEASUREMENT InjCrv_phiMI1Max "Förderbeginn-Sollwert Begrenzungswert" SWORD AngleCrS 1 100 -720.0000 719.9780 ECU_ADDRESS 0xD0000E2E /end MEASUREMENT
/begin MEASUREMENT InjCrv_phiMI1MaxAct "Frühester Ansteuerbeginn der MI1 für aktuelle Motorbetriebsart" SWORD AngleCrS 1 100 -720.0000 719.9780 ECU_ADDRESS 0xD0000E30 /end MEASUREMENT
/begin MEASUREMENT InjCrv_phiMI1MaxDes "Neuer, frühester Ansteuerbeginn der MI1 für neue Motorbetriebsart" SWORD AngleCrS 1 100 -720.0000 719.9780 ECU_ADDRESS 0xD0000E32 /end MEASUREMENT
/begin MEASUREMENT InjCrv_phiMI1MaxRgn_mp "Maximalwinkel der MI1 im Regenerationsbetrieb" SWORD AngleCrS 1 100 -720.0000 719.9780 ECU_ADDRESS 0xC000A06A /end MEASUREMENT
/begin MEASUREMENT InjCrv_phiMI1Rgn "Regenerationswert für den Ansteuerbeginn der MI1" SWORD AngleCrS 1 100 -720.0000 719.9780 ARRAY_SIZE 2 ECU_ADDRESS 0xD0000E34 /end MEASUREMENT
/begin MEASUREMENT InjCrv_phiMI1RgnAdd_mp "Additiver Bypasseingrif für Winkel der Haupteinspritzung im Regenerationsbetrieb" SWORD AngleCrS 1 100 -720.0000 719.9780 ARRAY_SIZE 2 ECU_ADDRESS 0xC000C014 /end MEASUREMENT
/begin MEASUREMENT InjCrv_phiMI1StrtCor_mp "Korrekturwinkel der HE während des Starts" SWORD AngleCrS 1 100 -720.0000 719.9780 ECU_ADDRESS 0xC000A070 /end MEASUREMENT
/begin MEASUREMENT InjCrv_phiMIAPSCor1_mp "atmosphärendruckabhängiger Korrekturwinkel für den Ansteuerbeginn der MI1 bei inaktiver PiI2" SWORD AngleCrS 1 100 -720.0000 719.9780 ECU_ADDRESS 0xC000A05A /end MEASUREMENT
/begin MEASUREMENT InjCrv_phiMIAPSCor2_mp "atmosphärendruckabhängiger Korrekturwinkel für den Ansteuerbeginn der MI1 bei aktiver PiI2" SWORD AngleCrS 1 100 -720.0000 719.9780 ECU_ADDRESS 0xC000A05C /end MEASUREMENT
/begin MEASUREMENT InjCrv_phiMIAPSCorStrt_mp "Korrekturwert des Phasewinkels für Haupteinspritzung beim Motorstart" SWORD AngleCrS 1 100 -720.0000 719.9780 ECU_ADDRESS 0xC000A030 /end MEASUREMENT
/begin MEASUREMENT InjCrv_phiMIAPSDynCor_mp "Korrekturwert für Ansteuerbeginn der Haupteinspritzung" SWORD AngleCrS 1 100 -720.0000 719.9780 ECU_ADDRESS 0xC000A04E /end MEASUREMENT
/begin MEASUREMENT InjCrv_phiMIATSCor1_mp "ansauglufttemperaturabhängiger Korrekturwinkel für den Ansteuerbeginn der MI1 bei inaktiver PiI2" SWORD AngleCrS 1 100 -720.0000 719.9780 ECU_ADDRESS 0xC000A05E /end MEASUREMENT
/begin MEASUREMENT InjCrv_phiMIATSCor2_mp "ansauglufttemperaturabhängiger Korrekturwinkel für den Ansteuerbeginn der MI1 bei aktiver PiI2" SWORD AngleCrS 1 100 -720.0000 719.9780 ECU_ADDRESS 0xC000A060 /end MEASUREMENT
/begin MEASUREMENT InjCrv_phiMIATSCorStrt_mp "ansauglufttemperaturabhängiger Korrekturwert für den Ansteuerbeginn der MI1 im Startzustand" SWORD AngleCrS 1 100 -720.0000 719.9780 ECU_ADDRESS 0xC000A032 /end MEASUREMENT
/begin MEASUREMENT InjCrv_phiMIDynCor_mp "Korrekturwert für Ansteuerbeginn der Haupteinspritzung" SWORD AngleCrS 1 100 -720.0000 719.9780 ECU_ADDRESS 0xC000A050 /end MEASUREMENT
/begin MEASUREMENT InjCrv_phiMIEGRDynCor_mp "" SWORD AngleCrS 1 100 -720.0000 719.9780 ECU_ADDRESS 0xC000A034 /end MEASUREMENT
/begin MEASUREMENT InjCrv_phiMIEgrLPCorBas_mp "" SWORD AngleCrS 1 100 -720.0000 719.9780 ECU_ADDRESS 0xC000A036 /end MEASUREMENT
/begin MEASUREMENT InjCrv_phiMIEgrLPCor_mp "" SWORD AngleCrS 1 100 -720.0000 719.9780 ECU_ADDRESS 0xC000A038 /end MEASUREMENT
/begin MEASUREMENT InjCrv_phiMIETSCor11_mp "kühlmitteltemperaturabhängiger Korrekturwert für den Ansteuerbeginn der MI1" SWORD AngleCrS 1 100 -720.0000 719.9780 ECU_ADDRESS 0xC000A03A /end MEASUREMENT
/begin MEASUREMENT InjCrv_phiMIETSCor12_mp "kühlmitteltemperaturabhängiger Korrekturwert für den Ansteuerbeginn der MI1" SWORD AngleCrS 1 100 -720.0000 719.9780 ECU_ADDRESS 0xC000A03C /end MEASUREMENT
/begin MEASUREMENT InjCrv_phiMIETSCor1_mp "motortemperaturabhängiger Korrekturwert 1 für Ansteuerbeginn MI1" SWORD AngleCrS 1 100 -720.0000 719.9780 ECU_ADDRESS 0xC000A062 /end MEASUREMENT
/begin MEASUREMENT InjCrv_phiMIETSCor2_mp "motortemperaturabhängiger Korrekturwert 2 für Ansteuerbeginn MI1" SWORD AngleCrS 1 100 -720.0000 719.9780 ECU_ADDRESS 0xC000A064 /end MEASUREMENT
/begin MEASUREMENT InjCrv_phiMIETSCorStrt_mp "correction angle value = f(n, qSetUnBal, ETS)" SWORD AngleCrS 1 100 -720.0000 719.9780 ECU_ADDRESS 0xC000A03E /end MEASUREMENT
/begin MEASUREMENT InjCrv_phiMIFTSRailCorStrt_mp "correction angle value = f(n, qSetUnBal, FTS,InjCrv_phiMIFTSRailCor_Max, InjCrv_phiMIFTSRailCor_Min)" SWORD AngleCrS 1 100 -720.0000 719.9780 ECU_ADDRESS 0xC000A040 /end MEASUREMENT
/begin MEASUREMENT InjCrv_phiMIFTSRailCor_mp "Ansteuerbeginnkorrekturfaktor für MI1, abhängig von der kraftstofftemperaturabhängigen Raildruckkorrektur" SWORD AngleCrS 1 100 -720.0000 719.9780 ECU_ADDRESS 0xC000A066 /end MEASUREMENT
/begin MEASUREMENT InjCrv_phiMIPDynCor_mp "Korrekturwert für Ansteuerbeginn der Haupteinspritzung" SWORD AngleCrS 1 100 -720.0000 719.9780 ECU_ADDRESS 0xC000A052 /end MEASUREMENT
/begin MEASUREMENT InjCrv_phiMIPFltCor_mp "Korrekturwert für den Ansteuerbeginn der MI1 abhängig von der Partikelfilterbeladung" SWORD AngleCrS 1 100 -720.0000 719.9780 ECU_ADDRESS 0xC000A068 /end MEASUREMENT
/begin MEASUREMENT InjCrv_phiPiI1AbsTot_mp "absoluter Ansteuerbeginn PiI1 aus Winkel- und Zeitkomponente" SWORD AngleCrS 1 100 -720.0000 719.9780 ECU_ADDRESS 0xC000A074 /end MEASUREMENT
/begin MEASUREMENT InjCrv_phiPiI1Abs_mp "absolute Winkelkomponente Anteuerbeginn PiI1" SWORD AngleCrS 1 100 -720.0000 719.9780 ECU_ADDRESS 0xC000A076 /end MEASUREMENT
/begin MEASUREMENT InjCrv_phiPiI1Bas_mp "Winkelkomponente Ansteuerbeginn PiI1 Grundwert" SWORD AngleCrS 1 100 -720.0000 719.9780 ECU_ADDRESS 0xC000A078 /end MEASUREMENT
/begin MEASUREMENT InjCrv_phiPiI1Cor_mp "korrigierter Grundwert Winkelkomponente Ansteuerbeginn PiI1" SWORD AngleCrS 1 100 -720.0000 719.9780 ECU_ADDRESS 0xC000A07A /end MEASUREMENT
/begin MEASUREMENT InjCrv_phiPiI1Des "gewünschter Winkelkomponente Ansteuerbeginn PiI1" SWORD AngleCrS 1 100 -720.0000 719.9780 ECU_ADDRESS 0xD0000E3C /end MEASUREMENT
/begin MEASUREMENT InjCrv_phiPiI1DesAdd_mp "Additiver Bypasseingriff für gewünschten Winkel der Voreinspritzung 1 im Regenerationsbetrieb" SWORD AngleCrS 1 100 -720.0000 719.9780 ECU_ADDRESS 0xC000A07C /end MEASUREMENT
/begin MEASUREMENT InjCrv_phiPiI1DesByp_mp "Bypass-Label, Kopie von InjCrv_phiPiI1Des" SWORD AngleCrS 1 100 -720.0000 719.9780 ECU_ADDRESS 0xC000A07E /end MEASUREMENT
/begin MEASUREMENT InjCrv_phiPiI1Rel_mp "Winkelkomponente Ansteuerbeginn PiI1 relaitv zur MI" SWORD AngleCrS 1 100 -720.0000 719.9780 ECU_ADDRESS 0xC000A080 /end MEASUREMENT
/begin MEASUREMENT InjCrv_phiPiI2Des "gewünschte Winkelkomponente Ansteuerbeginn PiI2" SWORD AngleCrS 1 100 -720.0000 719.9780 ECU_ADDRESS 0xD0000E46 /end MEASUREMENT
/begin MEASUREMENT InjCrv_phiPiI2DesAdd_mp "Additiver Bypasseingriff für gewünschten Winkel der Voreinspritzung 2" SWORD AngleCrS 1 100 -720.0000 719.9780 ECU_ADDRESS 0xC000A082 /end MEASUREMENT
/begin MEASUREMENT InjCrv_phiPiI2DesByp_mp "Bypass-Label, Kopie von InjCrv_phiPiI2Des" SWORD AngleCrS 1 100 -720.0000 719.9780 ECU_ADDRESS 0xC000A084 /end MEASUREMENT
/begin MEASUREMENT InjCrv_phiPiI3Des "gewünschte Winkelkomponente Ansteuerbeginn PiI3" SWORD AngleCrS 1 100 -720.0000 719.9780 ECU_ADDRESS 0xD0000E4A /end MEASUREMENT
/begin MEASUREMENT InjCrv_phiPiI3DesAdd_mp "Additiver Bypasseingriff für gewünschten Winkel der Voreinspritzung 3" SWORD AngleCrS 1 100 -720.0000 719.9780 ECU_ADDRESS 0xC000A086 /end MEASUREMENT
/begin MEASUREMENT InjCrv_phiPiI3DesByp_mp "Bypass-Label, Kopie von InjCrv_phiPiI3Des" SWORD AngleCrS 1 100 -720.0000 719.9780 ECU_ADDRESS 0xC000A088 /end MEASUREMENT
/begin MEASUREMENT InjCrv_pMIDynCor_mp "begrenzte Raildruckdifferenz" SWORD Pres_Rail 1 100 -3276.800 2000.000 ECU_ADDRESS 0xC000A054 /end MEASUREMENT
/begin MEASUREMENT InjCrv_qMI1Cor "Korrekturwert für die Menge der MI1" SWORD InjMass 1 100 -327.6800 327.6700 ECU_ADDRESS 0xD0000E64 /end MEASUREMENT
/begin MEASUREMENT InjCrv_qMI1CorRgn "Regenerationskorrekturwert für die Menge der MI1" SWORD InjMass 1 100 -327.6800 327.6700 ARRAY_SIZE 2 ECU_ADDRESS 0xD0000E66 /end MEASUREMENT
/begin MEASUREMENT InjCrv_qMI1CSCCor "CSC-Mengenkorrektur für MI1" SWORD InjMass 1 100 -327.6800 327.6700 ECU_ADDRESS 0xD0000E62 /end MEASUREMENT
/begin MEASUREMENT InjCrv_qMI1CSCMax_mp "Maximalmenge der MI1 nach CSC-Korrektur" SWORD InjMass 1 100 -327.6800 327.6700 ECU_ADDRESS 0xC000A022 /end MEASUREMENT
/begin MEASUREMENT InjCrv_qMI1CSCMin_mp "Minimalmenge der MI1 nach CSC-Korrektur" SWORD InjMass 1 100 -327.6800 327.6700 ECU_ADDRESS 0xC000A024 /end MEASUREMENT
/begin MEASUREMENT InjCrv_qMI1Des "Wunschmenge Haupteinspritzung" SWORD InjMass 1 100 -327.6800 327.6700 ECU_ADDRESS 0xD0000E6A /end MEASUREMENT
/begin MEASUREMENT InjCrv_qMI1DesAddByp_mp "Wert der gewünschten Menge der Haupteinspritzung vor einem additiven Bypasseingriff" SWORD InjMass 1 100 -327.6800 327.6700 ECU_ADDRESS 0xC000A014 /end MEASUREMENT
/begin MEASUREMENT InjCrv_qMI1DesAdd_mp "Additiver Bypasseingriff für gewünschte Menge der Haupteinspritzung" SWORD InjMass 1 100 -327.6800 327.6700 ECU_ADDRESS 0xC000A016 /end MEASUREMENT
/begin MEASUREMENT InjCrv_qMI1DesByp_mp "Bypass-Label, Kopie von InjCrv_qMI1Des" SWORD InjMass 1 100 -327.6800 327.6700 ECU_ADDRESS 0xC000A018 /end MEASUREMENT
/begin MEASUREMENT InjCrv_qMI1Min "Minimale Einspritzmenge der Haupteinspritzung 1" SWORD InjMass 1 100 -327.6800 327.6700 ECU_ADDRESS 0xD0000E6C /end MEASUREMENT
/begin MEASUREMENT InjCrv_qMI1MinPiI1_mp "Minimalmenge der MI1 wenn nur PiI1 abgesetzt wird" SWORD InjMass 1 100 -327.6800 327.6700 ECU_ADDRESS 0xC000A08A /end MEASUREMENT
/begin MEASUREMENT InjCrv_qMI1Nrm_mp "Normalmenge der Einspritzung MI1" SWORD InjMass 1 100 -327.6800 327.6700 ECU_ADDRESS 0xC000A01A /end MEASUREMENT
/begin MEASUREMENT InjCrv_qMI1Set "Gestellte Kraftstoffmenge der Haupteinspritzung MI1" SWORD InjMass 1 100 -327.6800 327.6700 ECU_ADDRESS 0xD0000E6E /end MEASUREMENT
/begin MEASUREMENT InjCrv_qPiI1BasCylOffs_mp "Messpunkt Basiswert des Offsets der Menge PiI1" SWORD InjMassInj 1 100 -327.6800 327.6700 ECU_ADDRESS 0xC000A006 /end MEASUREMENT
/begin MEASUREMENT InjCrv_qPiI1Bas_mp "Einspritzmenge PiI1 Grundwert" SWORD InjMass 1 100 -327.6800 327.6700 ECU_ADDRESS 0xC000A08C /end MEASUREMENT
/begin MEASUREMENT InjCrv_qPiI1CylOffs "Messpunkt Array Zyl[1-8] Offset Einspritzmenge der PiI1" SWORD InjMassInj 1 100 -327.6800 327.6700 ARRAY_SIZE 6 ECU_ADDRESS 0xD0000E7A /end MEASUREMENT
/begin MEASUREMENT InjCrv_qPiI1Des "gewünschte Einspritzmenge PiI 1" SWORD InjMass 1 100 -327.6800 327.6700 ARRAY_SIZE 6 ECU_ADDRESS 0xD0000E86 /end MEASUREMENT
/begin MEASUREMENT InjCrv_qPiI1DesAdd_mp "Additiver Bypasseingriff für gewünschte Menge der Voreinspritzung 1" SWORD InjMass 1 100 -327.6800 327.6700 ARRAY_SIZE 6 ECU_ADDRESS 0xC000C018 /end MEASUREMENT
/begin MEASUREMENT InjCrv_qPiI1DesByp_mp "Bypass-Label, Kopie von InjCrv_qPiI1Des" SWORD InjMass 1 100 -327.6800 327.6700 ECU_ADDRESS 0xC000A08E /end MEASUREMENT
/begin MEASUREMENT InjCrv_qPiI1Des_mp "Sollwert der Einspritzmenge von PiI1" SWORD InjMass 1 100 -327.6800 327.6700 ECU_ADDRESS 0xC000A090 /end MEASUREMENT
/begin MEASUREMENT InjCrv_qPiI1Max_mp "maximale Einspritzmenge der PiI1" SWORD InjMass 1 100 -327.6800 327.6700 ECU_ADDRESS 0xC000A092 /end MEASUREMENT
/begin MEASUREMENT InjCrv_qPiI1SetLimMax_mp "begrenzte maximale Solleinspritzmenge PiI1" SWORD InjMass 1 100 -327.6800 327.6700 ECU_ADDRESS 0xC000A094 /end MEASUREMENT
/begin MEASUREMENT InjCrv_qPiI1SetLim_mp "begrenzte Solleinspritzmenge PiI1" SWORD InjMass 1 100 -327.6800 327.6700 ECU_ADDRESS 0xC000A096 /end MEASUREMENT
/begin MEASUREMENT InjCrv_qPiI1Set_mp "Sollwert der Einspritzmenge PiI1" SWORD InjMass 1 100 -327.6800 327.6700 ECU_ADDRESS 0xC000A098 /end MEASUREMENT
/begin MEASUREMENT InjCrv_qPiI2Des "gewünschte Einspritzmenge PiI 2" SWORD InjMass 1 100 -327.6800 327.6700 ARRAY_SIZE 6 ECU_ADDRESS 0xD0000EA8 /end MEASUREMENT
/begin MEASUREMENT InjCrv_qPiI2DesAdd_mp "Additiver Bypasseingriff für gewünschte Menge der Voreinspritzung 2" SWORD InjMass 1 100 -327.6800 327.6700 ARRAY_SIZE 6 ECU_ADDRESS 0xC000C024 /end MEASUREMENT
/begin MEASUREMENT InjCrv_qPiI2DesByp_mp "Bypass-Label, Kopie von InjCrv_qPiI2Des" SWORD InjMass 1 100 -327.6800 327.6700 ECU_ADDRESS 0xC000A09A /end MEASUREMENT
/begin MEASUREMENT InjCrv_qPiI2Des_mp "Sollwert der Einspritzmenge von PiI2" SWORD InjMass 1 100 -327.6800 327.6700 ECU_ADDRESS 0xC000A09C /end MEASUREMENT
/begin MEASUREMENT InjCrv_qPiI3Des "gewünschte Einspritzmenge PiI 3" SWORD InjMass 1 100 -327.6800 327.6700 ARRAY_SIZE 6 ECU_ADDRESS 0xD0000EBE /end MEASUREMENT
/begin MEASUREMENT InjCrv_qPiI3DesAdd_mp "Additiver Bypasseingriff für gewünschte Menge der Voreinspritzung 3" SWORD InjMass 1 100 -327.6800 327.6700 ARRAY_SIZE 6 ECU_ADDRESS 0xC000C030 /end MEASUREMENT
/begin MEASUREMENT InjCrv_qPiI3DesByp_mp "Bypass-Label, Kopie von InjCrv_qPiI3Des" SWORD InjMass 1 100 -327.6800 327.6700 ECU_ADDRESS 0xC000A09E /end MEASUREMENT
/begin MEASUREMENT InjCrv_qPiI3Des_mp "Sollwert der Einspritzmenge von PiI3" SWORD InjMass 1 100 -327.6800 327.6700 ECU_ADDRESS 0xC000A0A0 /end MEASUREMENT
/begin MEASUREMENT InjCrv_qPiIMin_mp "minimale Einspritzmenge einer Voreinspritzung, ohne Wellenkorrektur" SWORD InjMass 1 100 -327.6800 327.6700 ECU_ADDRESS 0xC000A0A2 /end MEASUREMENT
/begin MEASUREMENT InjCrv_rMI1DesCSC_mp "CSC-Winkelkorrekturfaktor für MI1" SWORD Prc_Fact100 1 100 -327.6800 327.6700 FORMAT "%8.4" ECU_ADDRESS 0xC000A026 /end MEASUREMENT
/begin MEASUREMENT InjCrv_rMI1QntCSC_mp "CSC-Mengenkorrekturfaktor für MI1" SWORD Prc_Fact100 1 100 -327.6800 327.6700 FORMAT "%8.4" ECU_ADDRESS 0xC000A028 /end MEASUREMENT
/begin MEASUREMENT InjCrv_rPosMCLimMax "Maximum-Begrenzung für CSC Eingriff auf FB MI1" SWORD Prc_Fact100 1 100 -327.6800 327.6700 FORMAT "%8.4" ECU_ADDRESS 0xD0000F1E /end MEASUREMENT
/begin MEASUREMENT InjCrv_rPosMCLimMin "Minimum-Begrenzung für CSC Eingriff auf FB MI1" SWORD Prc_Fact100 1 100 -327.6800 327.6700 FORMAT "%8.4" ECU_ADDRESS 0xD0000F20 /end MEASUREMENT
/begin MEASUREMENT InjCrv_rTrqInrLimMax "Maximum-Begrenzung für CSC Eingriff auf FD MI1" SWORD Prc_Fact100 1 100 -327.6800 327.6700 FORMAT "%8.4" ECU_ADDRESS 0xD0000F22 /end MEASUREMENT
/begin MEASUREMENT InjCrv_rTrqInrLimMin "Minimum-Begrenzung für CSC Eingriff auf FD MI1" SWORD Prc_Fact100 1 100 -327.6800 327.6700 FORMAT "%8.4" ECU_ADDRESS 0xD0000F24 /end MEASUREMENT
/begin MEASUREMENT InjCrv_stActValMI1_mp "Aktuelle Betriebsart der MI1" UBYTE INJCRV_MSK_VERB 1 100 0.00 7.00000000000 FORMAT "%13.11" ECU_ADDRESS 0xC000B238 /end MEASUREMENT
/begin MEASUREMENT InjCrv_stActValPiI1_mp "Aktueller Betriebsmodus der PiI1" UBYTE INJCRV_MSK_VERB 1 100 0.00 7.00000000000 FORMAT "%13.11" ECU_ADDRESS 0xC000B239 /end MEASUREMENT
/begin MEASUREMENT InjCrv_stActValPiI2_mp "Aktuelle Betriebsart der PiI2" UBYTE INJCRV_MSK_VERB 1 100 0.00 7.00000000000 FORMAT "%13.11" ECU_ADDRESS 0xC000B23A /end MEASUREMENT
/begin MEASUREMENT InjCrv_stActValPiIRls_mp "Aktuelle Betriebsart zur Auswahl des Freigabe-Kennfelds für die Voreinspritzungen" UBYTE INJCRV_MSK_VERB 1 100 0.00 7.00000000000 FORMAT "%13.11" ECU_ADDRESS 0xC000B243 /end MEASUREMENT
/begin MEASUREMENT InjCrv_stCylOffsRls_mp "Messpunkt Freigabestatus der Funktion Cyloffs" SBYTE OneToOne 1 100 -128.0 127.0 ECU_ADDRESS 0xC000B246 /end MEASUREMENT
/begin MEASUREMENT InjCrv_stDesValMI1_mp "Gewünschter Betriebsmodus der MI1" UBYTE INJCRV_MSK_VERB 1 100 0.00 7.00000000000 FORMAT "%13.11" ECU_ADDRESS 0xC000B23B /end MEASUREMENT
/begin MEASUREMENT InjCrv_stDesValPiI1_mp "Gewünschter Betriebsmodus der PiI1" UBYTE INJCRV_MSK_VERB 1 100 0.00 7.00000000000 FORMAT "%13.11" ECU_ADDRESS 0xC000B23C /end MEASUREMENT
/begin MEASUREMENT InjCrv_stDesValPiI2_mp "Gewünschter Betriebsmodus der PiI2" UBYTE INJCRV_MSK_VERB 1 100 0.00 7.00000000000 FORMAT "%13.11" ECU_ADDRESS 0xC000B23D /end MEASUREMENT
/begin MEASUREMENT InjCrv_stDesValPiIRls_mp "Gewünschte Betriebsart zur Auswahl des Freigabe-Kennfelds für die Voreinspritzungen" UBYTE INJCRV_MSK_VERB 1 100 0.00 7.00000000000 FORMAT "%13.11" ECU_ADDRESS 0xC000B244 /end MEASUREMENT
/begin MEASUREMENT InjCrv_stInjCharActVal "Einspritzfreigabestatus" UBYTE OneToOne 1 100 0.00 255.0 ECU_ADDRESS 0xD0001F03 /end MEASUREMENT
/begin MEASUREMENT InjCrv_stInjCharActValCyl "Zylinderspezifischer Einspritzfreigabestatus" UBYTE OneToOne 1 100 0.00 255.0 ARRAY_SIZE 6 ECU_ADDRESS 0xD0001F04 /end MEASUREMENT
/begin MEASUREMENT InjCrv_stInjCharActValPrg "Einspritzfreigabestatus mit Berücksichtigung eines Testereingriffs" UBYTE OneToOne 1 100 0.00 255.0 ECU_ADDRESS 0xD0001F0A /end MEASUREMENT
/begin MEASUREMENT InjCrv_stInjCharDes_mp "Wunscheinspritzverlauf" UBYTE OneToOne 1 100 0.00 255.0 ECU_ADDRESS 0xC000B23E /end MEASUREMENT
/begin MEASUREMENT InjCrv_stInjCharPrio "Prioritätenstatus zur Abschaltung der Einspritzung" ULONG OneToOne 1 100 0.00 4294967295.00 ECU_ADDRESS 0xD00031FC /end MEASUREMENT
/begin MEASUREMENT InjCrv_stInjCharPrioTSync "Prioritätenstatus zur Abschaltung von Einspritzungen (t sync)" ULONG OneToOne 1 100 0.00 4294967295.00 ECU_ADDRESS 0xD0003200 /end MEASUREMENT
/begin MEASUREMENT InjCrv_stInjCharRlsPrgVal "zur Programmierung freigegebene Einspritzungen" UBYTE OneToOne 1 100 0.00 255.0 ECU_ADDRESS 0xD0001F0C /end MEASUREMENT
/begin MEASUREMENT InjCrv_stInjCharSetVal "Einspritzverlauf Sollwert (drehzahlsynchron)" UBYTE OneToOne 1 100 0.00 255.0 ECU_ADDRESS 0xD0001F0D /end MEASUREMENT
/begin MEASUREMENT InjCrv_stInjCharSetValTSync "Einspritzverlauf Sollwert (zeitsynchron)" UBYTE OneToOne 1 100 0.00 255.0 ECU_ADDRESS 0xD0001F0E /end MEASUREMENT
/begin MEASUREMENT InjCrv_stInjCharSetVal_mp "Messpunkt vor dem Ascet Freischnitt" UBYTE OneToOne 1 100 0.00 255.0 ECU_ADDRESS 0xC000B23F /end MEASUREMENT
/begin MEASUREMENT InjCrv_stMI1DurCSCFrz "Status der CSC Ansteuerdauer-Korrektur für MI1" UBYTE OneToOne 1 100 0.00 255.0 ECU_ADDRESS 0xD0001F15 /end MEASUREMENT
/begin MEASUREMENT InjCrv_stMI1PosCSCFrz "Status der CSC-Mengenkorrektur für MI1" UBYTE OneToOne 1 100 0.00 255.0 ECU_ADDRESS 0xD0001F16 /end MEASUREMENT
/begin MEASUREMENT InjCrv_stMI1Rgn "Statusbotschaft für die Freigabe der einzelnen Regenerationsstufen (drehzahlsynchron)" ULONG OneToOne 1 100 0.00 4294967295.00 ECU_ADDRESS 0xD0003204 /end MEASUREMENT
/begin MEASUREMENT InjCrv_stMI1RgnTSync "Statusbotschaft für die Freigabe der einzelnen Regenerationsstufen (zeitsynchron)" ULONG OneToOne 1 100 0.00 4294967295.00 ECU_ADDRESS 0xD0003208 /end MEASUREMENT
/begin MEASUREMENT InjCrv_stMI1RmpSel "Botschaft für die Auswahl der Faktorisierungskennlinie des Rampenfaktors der MI1" UBYTE INJCRV_RMP_VERB 1 100 1.00000000000 7.00000000000 FORMAT "%13.11" ECU_ADDRESS 0xD0001F17 /end MEASUREMENT
/begin MEASUREMENT InjCrv_stMI1RmpSelTSync "zeitsynchrone Botschaft für die Auswahl der Faktorisirungskennlinie des Rampenfaktors der MI1" UBYTE INJCRV_RMP_VERB 1 100 1.00000000000 7.00000000000 FORMAT "%13.11" ECU_ADDRESS 0xD0001F18 /end MEASUREMENT
/begin MEASUREMENT InjCrv_stPiI1Rgn "Statusbotschaft für die Freigabe der einzelnen Regenerationsstufen (drehzahlsynchron)" ULONG OneToOne 1 100 0.00 4294967295.00 ECU_ADDRESS 0xD000320C /end MEASUREMENT
/begin MEASUREMENT InjCrv_stPiI1RgnTSync "Statusbotschaft für die Freigabe der einzelnen Regenerationsstufen der PiI1" ULONG OneToOne 1 100 0.00 4294967295.00 ECU_ADDRESS 0xD0003210 /end MEASUREMENT
/begin MEASUREMENT InjCrv_stPiI1RmpSel "Botschaft für die Auswahl der Faktorisierungskennlinie des Rampenfaktors der PiI1" UBYTE INJCRV_RMP_VERB 1 100 1.00000000000 7.00000000000 FORMAT "%13.11" ECU_ADDRESS 0xD0001F19 /end MEASUREMENT
/begin MEASUREMENT InjCrv_stPiI1RmpSelTSync "zeitsynchrone Botschaft für die Auswahl der Faktorisirungskennlinie des Rampenfaktors der PiI1" UBYTE INJCRV_RMP_VERB 1 100 1.00000000000 7.00000000000 FORMAT "%13.11" ECU_ADDRESS 0xD0001F1A /end MEASUREMENT
/begin MEASUREMENT InjCrv_stPiI1_mp "Freigabestatus PiI1" UBYTE OneToOne 1 100 0.00 255.0 ECU_ADDRESS 0xC000B248 /end MEASUREMENT
/begin MEASUREMENT InjCrv_stPiI2Rgn "Statusbotschaft für die Freigabe der einzelnen Regenerationsstufen (drehzahlsynchron)" ULONG OneToOne 1 100 0.00 4294967295.00 ECU_ADDRESS 0xD0003214 /end MEASUREMENT
/begin MEASUREMENT InjCrv_stPiI2RgnTSync "Statusbotschaft für die Freigabe der einzelnen Regenerationsstufen der PiI2" ULONG OneToOne 1 100 0.00 4294967295.00 ECU_ADDRESS 0xD0003218 /end MEASUREMENT
/begin MEASUREMENT InjCrv_stPiI2RmpSel "Botschaft für die Auswahl der Faktorisierungskennlinie des Rampenfaktors der PiI2" UBYTE INJCRV_RMP_VERB 1 100 1.00000000000 7.00000000000 FORMAT "%13.11" ECU_ADDRESS 0xD0001F1B /end MEASUREMENT
/begin MEASUREMENT InjCrv_stPiI2RmpSelTSync "zeitsynchrone Botschaft für die Auswahl der Faktorisirungskennlinie des Rampenfaktors der PiI2" UBYTE INJCRV_RMP_VERB 1 100 1.00000000000 7.00000000000 FORMAT "%13.11" ECU_ADDRESS 0xD0001F1C /end MEASUREMENT
/begin MEASUREMENT InjCrv_stPiI3Rgn "Statuswort für die Freigabe der einzelnen Regenerationsstufen für die PiI3" ULONG OneToOne 1 100 0.00 4294967295.00 ECU_ADDRESS 0xD000321C /end MEASUREMENT
/begin MEASUREMENT InjCrv_stPiI3RgnTSync "Statusbotschaft für die Freigabe der einzelnen Regenerationsstufen (zeitsynchron)" ULONG OneToOne 1 100 0.00 4294967295.00 ECU_ADDRESS 0xD0003220 /end MEASUREMENT
/begin MEASUREMENT InjCrv_stPiIRls "Status Freigabe der Voreinspritzungen" UBYTE OneToOne 1 100 0.00 255.0 ECU_ADDRESS 0xD0001F1D /end MEASUREMENT
/begin MEASUREMENT InjCrv_stPiIRlsCor_mp "Freigabestruktur der Voreinspritzung nach Korrekturen" UBYTE OneToOne 1 100 0.00 255.0 ECU_ADDRESS 0xC000B240 /end MEASUREMENT
/begin MEASUREMENT InjCrv_stPiIRlsGearCor_mp "Freigabestruktur der Voreinspritzung nach gangabhängigen Korrekturen" UBYTE OneToOne 1 100 0.00 255.0 ECU_ADDRESS 0xC000B241 /end MEASUREMENT
/begin MEASUREMENT InjCrv_stPiIRlsOpRngSel_mp "Ausgewähltes Kennfeld zur Freigabe der Voreinspritzungen" UBYTE INJCRV_RGN_VERB 1 100 0.00 7.00000000000 FORMAT "%13.11" ECU_ADDRESS 0xC000B245 /end MEASUREMENT
/begin MEASUREMENT InjCrv_stPiIRlsOpRng_mp "aktueller Betriebsbereich für die Freigabe der Voreinspritzungen" SWORD INJCRV_MAPRLS_VERB 1 100 1.00000000000 6.00000000000 FORMAT "%13.11" ECU_ADDRESS 0xC000A000 /end MEASUREMENT
/begin MEASUREMENT InjCrv_stPiIRlsRaw_mp "Freigabestruktur der Voreinspritzung vor zusätzlichen Korrekturen" SWORD OneToOne 1 100 -32768.00 32767.00 ECU_ADDRESS 0xC0009FFE /end MEASUREMENT
/begin MEASUREMENT InjCrv_stPiIRlsVehSpdCor_mp "Freigabestruktur der Voreinspritzung nach fahrzeuggeschwindigkeitsabhängigen Korrekturen" UBYTE OneToOne 1 100 0.00 255.0 ECU_ADDRESS 0xC000B242 /end MEASUREMENT
/begin MEASUREMENT InjCrv_stPoI1Rgn "Statusbotschaft für die Freigabe der einzelnen Regenerationsstufen (drehzahlsynchron)" ULONG OneToOne 1 100 0.00 4294967295.00 ECU_ADDRESS 0xD0003224 /end MEASUREMENT
/begin MEASUREMENT InjCrv_stPoI1RgnTSync "Statusbotschaft für die Freigabe der einzelnen Regenerationsstufen (zeitsynchron)" ULONG OneToOne 1 100 0.00 4294967295.00 ECU_ADDRESS 0xD0003228 /end MEASUREMENT
/begin MEASUREMENT InjCrv_stPoI1RmpSel "Botschaft für die Auswahl der Faktorisierungskennlinie des Rampenfaktors der PoI1" UBYTE INJCRV_RMP_VERB 1 100 1.00000000000 7.00000000000 FORMAT "%13.11" ECU_ADDRESS 0xD0001F1E /end MEASUREMENT
/begin MEASUREMENT InjCrv_stPoI2NrmMode "Status der betriebpunkabhängigen Freigabe der PoI2 im Normalbetrieb (drehzahlsynchron)" UBYTE OneToOne 1 100 0.00 255.0 ECU_ADDRESS 0xD0001F21 /end MEASUREMENT
/begin MEASUREMENT InjCrv_stPoI2NrmModeTSync "Status der betriebpunkabhängigen Freigabe der PoI2 im Normalbetrieb (zeitsynchron)" UBYTE OneToOne 1 100 0.00 255.0 ECU_ADDRESS 0xD0001F22 /end MEASUREMENT
/begin MEASUREMENT InjCrv_stPoI2Rgn "Statusbotschaft für die Freigabe der einzelnen Regenerationsstufen (drehzahlsynchron)" ULONG OneToOne 1 100 0.00 4294967295.00 ECU_ADDRESS 0xD000322C /end MEASUREMENT
/begin MEASUREMENT InjCrv_stPoI2RgnTSync "Statusbotschaft für die Freigabe der einzelnen Regenerationsstufen (zeitsynchron)" ULONG OneToOne 1 100 0.00 4294967295.00 ECU_ADDRESS 0xD0003230 /end MEASUREMENT
/begin MEASUREMENT InjCrv_stPoI2RmpSel "Botschaft für die Auswahl der Faktorisierungskennlinie des Rampenfaktors der PoI2" UBYTE INJCRV_RMP_VERB 1 100 1.00000000000 7.00000000000 FORMAT "%13.11" ECU_ADDRESS 0xD0001F23 /end MEASUREMENT
/begin MEASUREMENT InjCrv_swtMI1QntCSCCorActv "Art des CSC-Korrektureingriffs (0- Ansteuerdauer, 1- Menge) auf MI1" UBYTE OneToOne 1 100 0.00 255.0 ECU_ADDRESS 0xD0001F28 /end MEASUREMENT
/begin MEASUREMENT InjCrv_swtPiIDblCorMap "Schalter für PiI1-Korrekturberechnung mit verdoppeltem Kennfeldsatz" UBYTE OneToOne 1 100 0.00 255.0 ECU_ADDRESS 0xD0001F29 /end MEASUREMENT
/begin MEASUREMENT InjCrv_tAirMI "Selektierte Ansauglufttemperatur für die Haupteinspritzung" SWORD Temp_Cels 1 100 -3549.940 3003.560 ECU_ADDRESS 0xD0000F26 /end MEASUREMENT
/begin MEASUREMENT InjCrv_tiDQPT1AddCor2_mp "dq PT1 filter const. in MI SOE correction II" ULONG TimeDelay_s 1 100 0.000001000000000 4294.9672960 FORMAT "%12.7" ECU_ADDRESS 0xC0008FA0 /end MEASUREMENT
/begin MEASUREMENT InjCrv_tiMI1ET "geschätzte Ansteuerdauer MI1" SWORD InjTime_us 1 100 -13107.20 5000.00 ECU_ADDRESS 0xD0000F2C /end MEASUREMENT
/begin MEASUREMENT InjCrv_tiPiI1BasCylOffs_mp "Messpunkt betriebspunktabhängige Berechnung des Offsets der PiI1" SWORD InjTime_us 1 100 -13107.20 5000.00 ECU_ADDRESS 0xC000A008 /end MEASUREMENT
/begin MEASUREMENT InjCrv_tiPiI1Bas_mp "Zeitkomponente Ansteuerbeginn PiI1 Grundwert" SWORD InjTime_us 1 100 -13107.20 5000.00 ECU_ADDRESS 0xC000A0A4 /end MEASUREMENT
/begin MEASUREMENT InjCrv_tiPiI1Cor_mp "korrigierter Grundwert der Zeitkomponente Ansteuerbeginn PiI" SWORD InjTime_us 1 100 -13107.20 5000.00 ECU_ADDRESS 0xC000A0A6 /end MEASUREMENT
/begin MEASUREMENT InjCrv_tiPiI1CylOffs "Messpunkt Array Zyl[1-8] Offset Einspritzzeitpunkt der PiI1" SWORD InjTime_us 1 100 -13107.20 5000.00 ARRAY_SIZE 6 ECU_ADDRESS 0xD0000F38 /end MEASUREMENT
/begin MEASUREMENT InjCrv_tiPiI1Des "gewünschte Zeitkomponente Ansteuerbeginn PiI1" SWORD InjTime_us 1 100 -13107.20 5000.00 ECU_ADDRESS 0xD0000F44 /end MEASUREMENT
/begin MEASUREMENT InjCrv_tiPiI1DesAdd_mp "Additiver Bypasseingriff für gewünschte Zeit der Voreinspritzung 1" SWORD InjTime_us 1 100 -13107.20 5000.00 ECU_ADDRESS 0xC000A0A8 /end MEASUREMENT
/begin MEASUREMENT InjCrv_tiPiI1DesByp_mp "Bypass-Label, Kopie von InjCrv_tiPiI1Des" SWORD InjTime_us 1 100 -13107.20 5000.00 ECU_ADDRESS 0xC000A0AA /end MEASUREMENT
/begin MEASUREMENT InjCrv_tiPiI1ETNoCor_mp "geschätzte Ansteuerdauer der PiI1 ohne Korrekturen" SWORD InjTime_us 1 100 -13107.20 5000.00 ECU_ADDRESS 0xC000A0AC /end MEASUREMENT
/begin MEASUREMENT InjCrv_tiPiI1ET_mp "geschätzte Ansteuerdauer der PiI1" SWORD InjTime_us 1 100 -13107.20 5000.00 ECU_ADDRESS 0xC000A0AE /end MEASUREMENT
/begin MEASUREMENT InjCrv_tiPiI1Hyd_mp "Zeitkomponente Ansteuerbeginn PiI1 für die Berechnung des Ansteuerbeginns der PiI2" SWORD InjTime_us 1 100 -13107.20 5000.00 ECU_ADDRESS 0xC000A0B0 /end MEASUREMENT
/begin MEASUREMENT InjCrv_tiPiI1Min_mp "Minimaler Zeitanteil für PiI1 relativ zur MI" SWORD InjTime_us 1 100 -13107.20 5000.00 ECU_ADDRESS 0xC000A0B2 /end MEASUREMENT
/begin MEASUREMENT InjCrv_tiPiI1RelMI1_mp "Zeitkomponente Ansteuerbeginn PiI1 relativ zur MI1" SWORD InjTime_us 1 100 -13107.20 5000.00 ECU_ADDRESS 0xC000A0B4 /end MEASUREMENT
/begin MEASUREMENT InjCrv_tiPiI1RelTot_mp "Ansteuerbeginnabstand PiI1 aus Winkel- und Zeitkomponente" SWORD InjTime_us 1 100 -13107.20 5000.00 ECU_ADDRESS 0xC000A0B6 /end MEASUREMENT
/begin MEASUREMENT InjCrv_tiPiI1Rel_mp "Zeitkomponente Ansteuerbeginn PiI1 relativ zur MI" SWORD InjTime_us 1 100 -13107.20 5000.00 ECU_ADDRESS 0xC000A0B8 /end MEASUREMENT
/begin MEASUREMENT InjCrv_tiPiI1Tot_mp "gesamte Ansteuerdauer der Pil1" SWORD InjTime_us 1 100 -13107.20 5000.00 ECU_ADDRESS 0xC000A0BA /end MEASUREMENT
/begin MEASUREMENT InjCrv_tiPiI2BasCylOffs_mp "Messpunkt Basiswert des Offsets der Menge PiI2" SWORD InjTime_us 1 100 -13107.20 5000.00 ECU_ADDRESS 0xC000A00A /end MEASUREMENT
/begin MEASUREMENT InjCrv_tiPiI2CylOffs "Messpunkt Array Zyl[1-8] Offset Ansteuerbeginns der PiI2" SWORD InjTime_us 1 100 -13107.20 5000.00 ARRAY_SIZE 6 ECU_ADDRESS 0xD0000F5C /end MEASUREMENT
/begin MEASUREMENT InjCrv_tiPiI2Des "gewünschte Zeitkomponente für Ansteuerbeginn PiI2" SWORD InjTime_us 1 100 -13107.20 5000.00 ECU_ADDRESS 0xD0000F68 /end MEASUREMENT
/begin MEASUREMENT InjCrv_tiPiI2DesAdd_mp "Additiver Bypasseingriff für gewünschte Zeit der Voreinspritzung 2" SWORD InjTime_us 1 100 -13107.20 5000.00 ECU_ADDRESS 0xC000A0BC /end MEASUREMENT
/begin MEASUREMENT InjCrv_tiPiI2DesByp_mp "Bypass-Label, Kopie von InjCrv_tiPiI2Des" SWORD InjTime_us 1 100 -13107.20 5000.00 ECU_ADDRESS 0xC000A0BE /end MEASUREMENT
/begin MEASUREMENT InjCrv_trqFBC "FBC Moment" SWORD Trq 1 100 -3276.800 3276.700 ARRAY_SIZE 6 ECU_ADDRESS 0xD0000F90 /end MEASUREMENT
/begin MEASUREMENT InjCrv_trqInrActFBC "trqInrAct plus FBC-Moment" SWORD Trq 1 100 -3276.800 3276.700 ECU_ADDRESS 0xD0000F9C /end MEASUREMENT
/begin MEASUREMENT InjCrv_trqInrSetFBC "trqInrSet plus FBC-Moment" SWORD Trq 1 100 -3276.800 3276.700 ECU_ADDRESS 0xD0000F9E /end MEASUREMENT
/begin MEASUREMENT InjCrv_volMI1Cor "Einspritzvolumen MI1 mit Korrekturwerten" SWORD InjQntInj 1 100 -327.6800 327.6700 ECU_ADDRESS 0xD0000FA0 /end MEASUREMENT
/begin MEASUREMENT InjCrv_volMI1_mp "Einspritzvolumen MI1" SWORD InjQntInj 1 100 -327.6800 327.6700 ECU_ADDRESS 0xC000A01C /end MEASUREMENT
/begin MEASUREMENT InjCrv_volPiI1Cor_mp "korrigiertes Einspritzvolumen zur Ansteuerdauerabschätzung der PiI1" SWORD InjQntInj 1 100 -327.6800 327.6700 ECU_ADDRESS 0xC000A0C0 /end MEASUREMENT
/begin MEASUREMENT InjCrv_volPiI1NoCor_mp "Einspritzvolumen ohne Korrekturen zur Ansteuerdauerabschätzung der PiI1" SWORD InjQntInj 1 100 -327.6800 327.6700 ECU_ADDRESS 0xC000A0C2 /end MEASUREMENT
/begin MEASUREMENT InjCrv_volPiI1_mp "begrenztes Einspritzvolumen PiI1" SWORD InjQntInj 1 100 -327.6800 327.6700 ECU_ADDRESS 0xC000A0C4 /end MEASUREMENT
/begin MEASUREMENT I_gen "Generatorstrom" UBYTE Def_i_ub_q1 1 100 0.00 255.00 ECU_ADDRESS 0xC000B230 /end MEASUREMENT
/begin MEASUREMENT I_genmax "korrigiertes DF Signal ueber Temperatur, Generatordrehzahl, Generatorspannung" UBYTE Def_i_ub_q1 1 100 0.00 255.00 ECU_ADDRESS 0xC000B231 /end MEASUREMENT
/begin MEASUREMENT I_gentmp "Temporäre Größe zur Generatorstromberechnung" UWORD Def_i_uw_q0p03125 1 100 0.00 256.0000 FORMAT "%8.4" ECU_ADDRESS 0xC0009FCE /end MEASUREMENT
/begin MEASUREMENT I_gentp "Temporäre Größe zur Generatorstromberechnung" UWORD Def_i_uw_q0p03125 1 100 0.00 256.0000 FORMAT "%8.4" ECU_ADDRESS 0xC0009FD0 /end MEASUREMENT
/begin MEASUREMENT I_gen_g "Generatorstrom gesamt" UBYTE Def_i_ub_q1 1 100 0.00 255.00 ECU_ADDRESS 0xC000B232 /end MEASUREMENT
/begin MEASUREMENT I_gen_nafil "Generatorstrom nach Filter" UWORD Def_i_uw_q0p03125 1 100 0.00 256.0000 FORMAT "%8.4" ECU_ADDRESS 0xC0009FD2 /end MEASUREMENT
/begin MEASUREMENT I_gen_vorfil "Generatorstrom vor Filter" UWORD Def_i_uw_q0p03125 1 100 0.00 256.0000 FORMAT "%8.4" ECU_ADDRESS 0xC0009FD4 /end MEASUREMENT
/begin MEASUREMENT Kf_iu1 "Ausgang Kennfeldipol 1" SWORD Def_i_sw_q0p03125 1 100 -1024.000 1023.969 FORMAT "%8.3" ECU_ADDRESS 0xC0009FD6 /end MEASUREMENT
/begin MEASUREMENT Kf_iu2 "Ausgang Kennfeldipol 2" SWORD Def_i_sw_q0p03125 1 100 -1024.000 1023.969 FORMAT "%8.3" ECU_ADDRESS 0xC0009FD8 /end MEASUREMENT
/begin MEASUREMENT Kf_iu3 "Ausgang Kennfeldipol 3" SWORD Def_i_sw_q0p03125 1 100 -1024.000 1023.969 FORMAT "%8.3" ECU_ADDRESS 0xC0009FDA /end MEASUREMENT
/begin MEASUREMENT Md_genfil "gefiltertes Generatormoment absolut" SWORD Def_m_sw_q0p1 1 100 -3276.80 3276.70 FORMAT "%7.2" ECU_ADDRESS 0xC0009FDC /end MEASUREMENT
/begin MEASUREMENT Md_gennm "gefiltertes Generatormoment absolut Ausgang" SWORD Def_m_sw_q0p1 1 100 -3276.80 3276.70 FORMAT "%7.2" ECU_ADDRESS 0xC0009FDE /end MEASUREMENT
/begin MEASUREMENT Md_gennmtp "Ungefiltertes unkorrigiertes Generatormoment" SWORD Def_m_sw_q0p1 1 100 -3276.80 3276.70 FORMAT "%7.2" ECU_ADDRESS 0xC0009FE0 /end MEASUREMENT
/begin MEASUREMENT Md_gennm_end "temporäre Grösse Generatormomentberechnung" SWORD Def_m_sw_q0p1 1 100 -3276.80 3276.70 FORMAT "%7.2" ECU_ADDRESS 0xC0009FE2 /end MEASUREMENT
/begin MEASUREMENT Md_genrel "relatives Generatormoment Ausgang" UWORD Def_f_uw_b100 1 100 0.00 99.99847 ECU_ADDRESS 0xC0009FE4 /end MEASUREMENT
/begin MEASUREMENT Md_genvf "relatives Generatordrehmoment" UWORD Def_f_uw_b100 1 100 0.00 99.99847 ECU_ADDRESS 0xC0009FE6 /end MEASUREMENT
/begin MEASUREMENT Md_gen_roh "Rohwert Generatormoment vor Filterung" SWORD Def_m_sw_q0p1 1 100 -3276.80 3276.70 FORMAT "%7.2" ECU_ADDRESS 0xC0009FE8 /end MEASUREMENT
/begin MEASUREMENT N_gen "Generatordrehzahl" SWORD Def_n_sw_q1p0 1 100 0.00 32767. FORMAT "%5.0" ECU_ADDRESS 0xC0009FEA /end MEASUREMENT
/begin MEASUREMENT N_gen_tmp "Temporäre Generatordrehzahl" SWORD Def_n_sw_q1p0 1 100 0.00 32767. FORMAT "%5.0" ECU_ADDRESS 0xC0009FEC /end MEASUREMENT
/begin MEASUREMENT St_imdgen0 "Statuswort" UBYTE Def_st_ub_q1 1 100 0.00 255. FORMAT "%3.0" ECU_ADDRESS 0xC000B233 /end MEASUREMENT
/begin MEASUREMENT St_imdgen_nv0 "Statuswort" UBYTE Def_st_ub_q1 1 100 0.00 255. FORMAT "%3.0" ECU_ADDRESS 0xC000B234 /end MEASUREMENT
/begin MEASUREMENT Tchip_diff1 "Zwischengröße Generator-Chiptemperatur" SWORD Def_t_sw_q0p1 1 100 -3276.8 3276.7 FORMAT "%6.1" ECU_ADDRESS 0xC0009FEE /end MEASUREMENT
/begin MEASUREMENT Tchip_diff2 "Zwischengröße Generator-Chiptemperatur" SWORD Def_t_sw_q0p1 1 100 -3276.8 3276.7 FORMAT "%6.1" ECU_ADDRESS 0xC0009FF0 /end MEASUREMENT
/begin MEASUREMENT Tgen "Generatortemperatur" SWORD Def_t_sw_q0p1 1 100 -3276.8 3276.7 FORMAT "%6.1" ECU_ADDRESS 0xC0009FF2 /end MEASUREMENT
/begin MEASUREMENT Ugen_calc "Berechnete Generatorspannung" UWORD Def_u_uw_q0p1 1 100 0.00 6553.500 FORMAT "%8.3" ECU_ADDRESS 0xC0009FF4 /end MEASUREMENT
/begin MEASUREMENT U_ecu "Ersatzgroesse Ub mit 0.1V/Bit" UWORD Def_u_uw_q0p1 1 100 0.00 6553.500 FORMAT "%8.3" ECU_ADDRESS 0xC0009FF6 /end MEASUREMENT
/begin MEASUREMENT X_KF_IU1T1_1_no_input_quantity "This variable is artificially generated, since DAMOS does not (yet) support 'NO_INPUT_QUANTITY' references at PaVaSt files. It is exclusively referenced by the X axis of calibration parameter 'KF_IU1T1_1'." SWORD Def_i_sw_q0p125 1 100 -4096.000 4095.875 FORMAT "%8.3" ECU_ADDRESS 0xC0009FF8 /end MEASUREMENT
/begin MEASUREMENT X_KF_IU1T2_1_no_input_quantity "This variable is artificially generated, since DAMOS does not (yet) support 'NO_INPUT_QUANTITY' references at PaVaSt files. It is exclusively referenced by the X axis of calibration parameter 'KF_IU1T2_1'." SWORD Def_i_sw_q0p125 1 100 -4096.000 4095.875 FORMAT "%8.3" ECU_ADDRESS 0xC0009FFA /end MEASUREMENT
/begin MEASUREMENT X_KF_IU2T1_1_no_input_quantity "This variable is artificially generated, since DAMOS does not (yet) support 'NO_INPUT_QUANTITY' references at PaVaSt files. It is exclusively referenced by the X axis of calibration parameter 'KF_IU2T1_1'." SWORD Def_i_sw_q0p125 1 100 -4096.000 4095.875 FORMAT "%8.3" ECU_ADDRESS 0xC0009FFC /end MEASUREMENT
/begin FUNCTION imdgen ""
 /begin DEF_CHARACTERISTIC KF_GENTYP_NEU KF_IU1T1_1 KF_IU1T2_1 KF_IU2T1_1 KF_MDGENFIL KF_MU1T1_1 KF_MU1T2_1 KF_MU2T1_1 KL_GENUEBSETZ KL_T_CHIP1 KL_T_CHIP2 K_DFFGENFIL K_DF_DEAKAPP K_EN_MDGEN K_GENMDNMOF K_GEN_IGOF K_IMDGENNRRW K_MANAWNUMM K_MDGENNL K_NSCHW_CALC K_NSCHW_MD K_R_LADLTG K_TDFIERR K_UBOFF K_ZMGENIG S_RDGENTYP /end DEF_CHARACTERISTIC
 /begin IN_MEASUREMENT Gen_manufak Gen_typkenn Ierr /end IN_MEASUREMENT
 /begin OUT_MEASUREMENT Dffgen_dt Dffgen_f Gen_awnumm Gen_uebsetz I_gen I_genmax I_gentmp I_gentp I_gen_g I_gen_nafil I_gen_vorfil Kf_iu1 Kf_iu2 Kf_iu3 Md_genfil Md_gennm Md_gennmtp Md_gennm_end Md_genrel Md_genvf Md_gen_roh N_gen N_gen_tmp St_imdgen0 St_imdgen_nv0 Tchip_diff1 Tchip_diff2 Tgen Ugen_calc U_ecu X_KF_IU1T1_1_no_input_quantity X_KF_IU1T2_1_no_input_quantity X_KF_IU2T1_1_no_input_quantity /end OUT_MEASUREMENT
/end FUNCTION
/begin FUNCTION ImmoNC "" /end FUNCTION
/begin FUNCTION InjCrv_Co ""
 /begin DEF_CHARACTERISTIC InjCrv_numInjMaxSys_C InjCrv_numInjRtmLim_CUR InjCrv_rRtmLimEngSpdHys_C InjCrv_stInjCharPrioRgn_C InjCrv_stInjCharPrio_C InjCrv_stMI1RgnMsk_CA InjCrv_stMI1RmpSel_CA InjCrv_stPiI1RgnMsk_CA InjCrv_stPiI1RmpSel_CA InjCrv_stPiI2RgnMsk_CA InjCrv_stPiI2RmpSel_CA InjCrv_stPiI3RgnMsk_CA InjCrv_stPrioRgnMsk_C /end DEF_CHARACTERISTIC
 /begin IN_MEASUREMENT CoEng_stShutOffPath CoEOM_facRmpVal CoEOM_stOpModeActTSync CoEOM_stOpModeLckTSync Epm_ctCyl Epm_nEng Epm_stCmbTestReq Epm_stSync HPUn_numInjQntBal InjCrv_POpPoI1AddCor InjCrv_POpPoI1EnvCor InjCrv_POpPoI2AddCor InjCrv_POpPoI2EnvCor InjCrv_stPiIRls InjCrv_stPoI1RmpSelTSync InjCrv_stPoI2RmpSelTSync InjCtl_qSetUnBal InjVlv_stInjCharComp InjVlv_stInjRls /end IN_MEASUREMENT
 /begin OUT_MEASUREMENT InjCrv_numInjMaxSys InjCrv_stInjCharActVal InjCrv_stInjCharActValCyl InjCrv_stInjCharActValPrg InjCrv_stInjCharRlsPrgVal InjCrv_stInjCharSetVal InjCrv_stMI1Rgn InjCrv_stMI1RgnTSync InjCrv_stMI1RmpSel InjCrv_stPiI1Rgn InjCrv_stPiI1RgnTSync InjCrv_stPiI1RmpSel InjCrv_stPiI2Rgn InjCrv_stPiI2RgnTSync InjCrv_stPiI2RmpSel InjCrv_stPiI3Rgn InjCrv_stPiI3RgnTSync InjCrv_stPoI1Rgn InjCrv_stPoI1RgnTSync InjCrv_stPoI1RmpSel InjCrv_stPoI2NrmMode InjCrv_stPoI2Rgn InjCrv_stPoI2RgnTSync InjCrv_stPoI2RmpSel InjCrv_swtPiIDblCorMap /end OUT_MEASUREMENT
 /begin LOC_MEASUREMENT InjCrv_numInjDes_mp InjCrv_numInjLim_mp InjCrv_numInjRtmLim_mp InjCrv_stActValMI1_mp InjCrv_stActValPiI1_mp InjCrv_stActValPiI2_mp InjCrv_stDesValMI1_mp InjCrv_stDesValPiI1_mp InjCrv_stDesValPiI2_mp InjCrv_stInjCharDes_mp InjCrv_stInjCharPrio InjCrv_stInjCharPrioTSync InjCrv_stInjCharSetValTSync InjCrv_stInjCharSetVal_mp InjCrv_stMI1RmpSelTSync InjCrv_stPiI1RmpSelTSync InjCrv_stPiI2RmpSelTSync InjCrv_stPoI2NrmModeTSync /end LOC_MEASUREMENT
/end FUNCTION
/begin FUNCTION InjCrv_CoPiIRls ""
 /begin DEF_CHARACTERISTIC InjCrv_rPiIRlsEngSpdHys_C InjCrv_rPiIRlsQntHys_C InjCrv_stPiIRlsOpRng1_MAP InjCrv_stPiIRlsOpRng2_MAP InjCrv_stPiIRlsOpRng3_MAP InjCrv_stPiIRlsOpRng4_MAP InjCrv_stPiIRlsOpRng5_MAP InjCrv_stPiIRlsOpRng6_MAP /end DEF_CHARACTERISTIC
 /begin IN_MEASUREMENT Epm_nEng InjCtl_qSetUnBal /end IN_MEASUREMENT
 /begin OUT_MEASUREMENT InjCrv_stPiIRls /end OUT_MEASUREMENT
 /begin LOC_MEASUREMENT InjCrv_stPiIRlsRaw_mp /end LOC_MEASUREMENT
/end FUNCTION
/begin FUNCTION InjCrv_CoPiIRlsAddCor ""
 /begin DEF_CHARACTERISTIC InjCrv_nThreshDelta_C InjCrv_nThreshLo1_C InjCrv_nThreshLo2_C InjCrv_nThreshLo3_C InjCrv_nThreshLo4_C InjCrv_nThreshLo5_C InjCrv_nThreshLo6_C InjCrv_nThreshLo7_C InjCrv_nThreshLoNo_C InjCrv_nThreshLoR_C InjCrv_numTraGear1_C InjCrv_numTraGear2_C InjCrv_numTraGear3_C InjCrv_numTraGear4_C InjCrv_numTraGear5_C InjCrv_numTraGear6_C InjCrv_numTraGear7_C InjCrv_numTraGearR_C InjCrv_numTraNoGear_C InjCrv_rPiIRlsATSHys_C InjCrv_rPiIRlsETSHys_C InjCrv_stPiIRlsEOMMsk_C InjCrv_stPiIRlsN_MAP InjCrv_stPiIRlsV_MAP InjCrv_vThreshDelta_C InjCrv_vThreshLo1_C InjCrv_vThreshLo2_C InjCrv_vThreshLo3_C InjCrv_vThreshLo4_C InjCrv_vThreshLo5_C InjCrv_vThreshLo6_C InjCrv_vThreshLo7_C InjCrv_vThreshLoNo_C InjCrv_vThreshLoR_C /end DEF_CHARACTERISTIC
 /begin IN_MEASUREMENT CoEOM_stOpModeAct Epm_nEng InjSys_tAir InjSys_tEng InjSys_tEngPiIRls Tra_numGear VehV_v /end IN_MEASUREMENT
/end FUNCTION
/begin FUNCTION InjCrv_CoPiIRlsCor ""
 /begin DEF_CHARACTERISTIC InjCrv_pAirPiIRlsHigh_C InjCrv_pAirPiIRlsLow_C InjCrv_stPiIRlsGearCor_C InjCrv_stPiIRlsGearThres_C InjCrv_stPiIRlsGear_C InjCrv_stPiIRlsPresAirCor_C InjCrv_stPiIRlsPresAir_C InjCrv_stPiIRlsVehSpdCor_C InjCrv_stPiIRlsVehSpd_C InjCrv_vVehPiIRlsHigh_C InjCrv_vVehPiIRlsLow_C /end DEF_CHARACTERISTIC
 /begin IN_MEASUREMENT Clth_st EnvP_p Tra_numGear VehV_v /end IN_MEASUREMENT
 /begin LOC_MEASUREMENT InjCrv_stPiIRlsCor_mp InjCrv_stPiIRlsGearCor_mp InjCrv_stPiIRlsVehSpdCor_mp /end LOC_MEASUREMENT
/end FUNCTION
/begin FUNCTION InjCrv_CoPiIRlsOpRng ""
 /begin DEF_CHARACTERISTIC InjCrv_rOpRngATSHys_C InjCrv_rOpRngETSHys_C InjCrv_stPiIRlsOpRgnMsk_CA InjCrv_stPiIRlsOpRngSel_CA InjCrv_stRlsOpRngThres0Rgn_GMAP InjCrv_stRlsOpRngThres1Rgn_GMAP InjCrv_stRlsOpRngThresRgnX_AXIS InjCrv_stRlsOpRngThresRgnY_AXIS InjCrv_stRlsOpRngThres_MAP /end DEF_CHARACTERISTIC
 /begin IN_MEASUREMENT CoEOM_facRmpVal CoEOM_stOpModeActTSync InjSys_tAir InjSys_tAirRgn InjSys_tEngPiIRls InjSys_tEngRgnPiIRls /end IN_MEASUREMENT
 /begin LOC_MEASUREMENT InjCrv_stActValPiIRls_mp InjCrv_stDesValPiIRls_mp InjCrv_stPiIRlsOpRngSel_mp InjCrv_stPiIRlsOpRng_mp /end LOC_MEASUREMENT
/end FUNCTION
/begin FUNCTION InjCrv_CylOffs ""
 /begin DEF_CHARACTERISTIC InjCrv_dfacCylOffs.Pos_C InjCrv_dfacCylOffs.Neg_C InjCrv_facphiMI1CylOffs.dfacCylOffs1_C InjCrv_facphiMI1CylOffs.dfacCylOffs2_C InjCrv_facphiMI1CylOffs.dfacCylOffs3_C InjCrv_facphiMI1CylOffs.dfacCylOffs4_C InjCrv_facphiMI1CylOffs.dfacCylOffs5_C InjCrv_facphiMI1CylOffs.dfacCylOffs6_C InjCrv_facphiMI1CylOffs.dfacCylOffs7_C InjCrv_facphiMI1CylOffs.dfacCylOffs8_C InjCrv_facphiMI1CylOffs2.dfacCylOffs1_C InjCrv_facphiMI1CylOffs2.dfacCylOffs2_C InjCrv_facphiMI1CylOffs2.dfacCylOffs3_C InjCrv_facphiMI1CylOffs2.dfacCylOffs4_C InjCrv_facphiMI1CylOffs2.dfacCylOffs5_C InjCrv_facphiMI1CylOffs2.dfacCylOffs6_C InjCrv_facphiMI1CylOffs2.dfacCylOffs7_C InjCrv_facphiMI1CylOffs2.dfacCylOffs8_C InjCrv_facqPiI1CylOffs.dfacCylOffs1_C InjCrv_facqPiI1CylOffs.dfacCylOffs2_C InjCrv_facqPiI1CylOffs.dfacCylOffs3_C InjCrv_facqPiI1CylOffs.dfacCylOffs4_C InjCrv_facqPiI1CylOffs.dfacCylOffs5_C InjCrv_facqPiI1CylOffs.dfacCylOffs6_C InjCrv_facqPiI1CylOffs.dfacCylOffs7_C InjCrv_facqPiI1CylOffs.dfacCylOffs8_C InjCrv_facqPiI1CylOffs2.dfacCylOffs1_C InjCrv_facqPiI1CylOffs2.dfacCylOffs2_C InjCrv_facqPiI1CylOffs2.dfacCylOffs3_C InjCrv_facqPiI1CylOffs2.dfacCylOffs4_C InjCrv_facqPiI1CylOffs2.dfacCylOffs5_C InjCrv_facqPiI1CylOffs2.dfacCylOffs6_C InjCrv_facqPiI1CylOffs2.dfacCylOffs7_C InjCrv_facqPiI1CylOffs2.dfacCylOffs8_C InjCrv_factiPiI1CylOffs.dfacCylOffs1_C InjCrv_factiPiI1CylOffs.dfacCylOffs2_C InjCrv_factiPiI1CylOffs.dfacCylOffs3_C InjCrv_factiPiI1CylOffs.dfacCylOffs4_C InjCrv_factiPiI1CylOffs.dfacCylOffs5_C InjCrv_factiPiI1CylOffs.dfacCylOffs6_C InjCrv_factiPiI1CylOffs.dfacCylOffs7_C InjCrv_factiPiI1CylOffs.dfacCylOffs8_C InjCrv_factiPiI1CylOffs2.dfacCylOffs1_C InjCrv_factiPiI1CylOffs2.dfacCylOffs2_C InjCrv_factiPiI1CylOffs2.dfacCylOffs3_C InjCrv_factiPiI1CylOffs2.dfacCylOffs4_C InjCrv_factiPiI1CylOffs2.dfacCylOffs5_C InjCrv_factiPiI1CylOffs2.dfacCylOffs6_C InjCrv_factiPiI1CylOffs2.dfacCylOffs7_C InjCrv_factiPiI1CylOffs2.dfacCylOffs8_C InjCrv_factiPiI2CylOffs2.dfacCylOffs1_C InjCrv_factiPiI2CylOffs2.dfacCylOffs2_C InjCrv_factiPiI2CylOffs2.dfacCylOffs3_C InjCrv_factiPiI2CylOffs2.dfacCylOffs4_C InjCrv_factiPiI2CylOffs2.dfacCylOffs5_C InjCrv_factiPiI2CylOffs2.dfacCylOffs6_C InjCrv_factiPiI2CylOffs2.dfacCylOffs7_C InjCrv_factiPiI2CylOffs2.dfacCylOffs8_C InjCrv_pAirCylOffsRlsHigh_C InjCrv_pAirCylOffsRlsLow_C InjCrv_phiMI1BasCylOffs_MAP InjCrv_qPiI1BasCylOffs_MAP InjCrv_stCylOffstAirInv_C InjCrv_stCylOffstEngInv_C InjCrv_tAirCylOffsRlsMaxHigh_C InjCrv_tAirCylOffsRlsMaxLow_C InjCrv_tAirCylOffsRlsMinHigh_C InjCrv_tAirCylOffsRlsMinLow_C InjCrv_tEngCylOffsRlsMaxHigh_C InjCrv_tEngCylOffsRlsMaxLow_C InjCrv_tEngCylOffsRlsMinHigh_C InjCrv_tEngCylOffsRlsMinLow_C InjCrv_tiPiI1BasCylOffs_MAP InjCrv_tiPiI2BasCylOffs_MAP /end DEF_CHARACTERISTIC
 /begin IN_MEASUREMENT EnvP_p Epm_nEng InjCrv_stInjCharActVal InjCrv_tAirMI InjCtl_qSetUnBal InjSys_tEng /end IN_MEASUREMENT
 /begin OUT_MEASUREMENT InjCrv_phiMI1CylOffs InjCrv_qPiI1CylOffs InjCrv_tiPiI1CylOffs InjCrv_tiPiI2CylOffs /end OUT_MEASUREMENT
 /begin LOC_MEASUREMENT InjCrv_facRmpCylOffs_mp InjCrv_phiMI1BasCylOffs_mp InjCrv_qPiI1BasCylOffs_mp InjCrv_stCylOffsRls_mp InjCrv_tiPiI1BasCylOffs_mp InjCrv_tiPiI2BasCylOffs_mp /end LOC_MEASUREMENT
/end FUNCTION
/begin FUNCTION InjCrv_MI ""
 /begin DEF_CHARACTERISTIC InjCrv_phiMI1Bas1BstLP_MAP InjCrv_phiMI1Bas1_MAP InjCrv_phiMI1Bas2BstLP_MAP InjCrv_phiMI1Bas2_MAP InjCrv_phiMI1Bas3_MAP InjCrv_phiMI1Bas4_MAP InjCrv_phiMI1Bas5_MAP InjCrv_phiMI1Des_C InjCrv_phiMI1Max1_MAP InjCrv_phiMI1Max2_MAP InjCrv_phiMI1Max_X_AXIS InjCrv_phiMI1Max_Y_AXIS InjCrv_phiMI1Min_C InjCrv_qMI1Des_C InjCrv_stInjCharActVal_C InjCrv_swtPhiMI1Des_C InjCrv_swtQntMI1Des_C InjCrv_swtStInjCharActVal_C /end DEF_CHARACTERISTIC
 /begin IN_MEASUREMENT CoEng_stShutOffPath Epm_ctCyl Epm_nEng Epm_numCyl FlSys_rhoFl InjCrv_phiMI1AddCor1 InjCrv_phiMI1AddCor2 InjCrv_phiMI1CylOffs InjCrv_phiMI1EnvCor1 InjCrv_phiMI1EnvCor2 InjCrv_qPiI1Des InjCrv_qPiI2Des InjCrv_qPiI3Des InjCrv_qPoI1Eff InjCrv_qPoI2Eff InjCrv_stInjCharActVal InjCrv_stInjCharActValCyl InjCrv_stInjCharActValPrg InjCrv_stInjCharRlsPrgVal InjCrv_stInjCharSetVal InjCrv_stMI1Rgn InjCrv_trqFBC InjCtl_qSetUnBal InjVlv_volMI1CorCyc PCR_stCByVlvOpn RailP_pFlt /end IN_MEASUREMENT
 /begin OUT_MEASUREMENT InjCrv_phiMI1Bas InjCrv_phiMI1Cor InjCrv_phiMI1Des InjCrv_phiMI1DesS1 InjCrv_phiMI1Max InjCrv_qMI1Des InjCrv_qMI1Min InjCrv_qMI1Set InjCrv_tiMI1ET /end OUT_MEASUREMENT
 /begin LOC_MEASUREMENT InjCrv_phiMI1CorAct InjCrv_phiMI1CorDes InjCrv_phiMI1DesAddByp_mp InjCrv_phiMI1DesAdd_mp InjCrv_phiMI1DesByp_mp InjCrv_phiMI1Lim_mp InjCrv_phiMI1MaxAct InjCrv_phiMI1MaxDes InjCrv_qMI1DesAddByp_mp InjCrv_qMI1DesAdd_mp InjCrv_qMI1DesByp_mp InjCrv_qMI1Nrm_mp InjCrv_volMI1Cor InjCrv_volMI1_mp /end LOC_MEASUREMENT
/end FUNCTION
/begin FUNCTION InjCrv_MI1CSCCor ""
 /begin DEF_CHARACTERISTIC InjCrv_phiMI1DesCSCMax_MAP InjCrv_phiMI1DesCSCMin_MAP InjCrv_phiMI1DesCSC_CUR InjCrv_qMI1CSCMax_MAP InjCrv_qMI1CSCMin_MAP InjCrv_qMI1CSC_CUR InjCrv_rMI1DesCSC_CUR InjCrv_rMI1QntCSC_CUR InjCrv_swtMI1QntCSCCorActv_C /end DEF_CHARACTERISTIC
 /begin REF_CHARACTERISTIC InjCrv_phiMI1Min_C /end REF_CHARACTERISTIC
 /begin IN_MEASUREMENT CnvSet_etaCurr CoEng_stShutOffPath Epm_ctCyl Epm_nEng FBC_q InjCrv_phiMI1Cor InjCrv_phiMI1Max InjCrv_qMI1Min InjCrv_qMI1Set InjCrv_stInjCharActVal InjCtl_qSetUnBal InjVlv_rTrqInrLimMax InjVlv_rTrqInrLimMin PosMCCtl_r PthSet_trqInrSet TrqInrCtl_r /end IN_MEASUREMENT
 /begin OUT_MEASUREMENT InjCrv_phiMI1DesCSCCor InjCrv_qMI1CSCCor InjCrv_rPosMCLimMax InjCrv_rPosMCLimMin InjCrv_rTrqInrLimMax InjCrv_rTrqInrLimMin InjCrv_stMI1DurCSCFrz InjCrv_stMI1PosCSCFrz InjCrv_swtMI1QntCSCCorActv InjCrv_trqFBC InjCrv_trqInrActFBC InjCrv_trqInrSetFBC /end OUT_MEASUREMENT
 /begin LOC_MEASUREMENT InjCrv_phiMI1DesCSCMax_mp InjCrv_phiMI1DesCSCMin_mp InjCrv_qMI1CSCMax_mp InjCrv_qMI1CSCMin_mp InjCrv_rMI1DesCSC_mp InjCrv_rMI1QntCSC_mp /end LOC_MEASUREMENT
/end FUNCTION
/begin FUNCTION InjCrv_MIAddCor ""
 /begin DEF_CHARACTERISTIC InjCrv_dphiMIDyn.Pos_C InjCrv_dphiMIDyn.Neg_C InjCrv_dpMIDynCorDT1.T1_C InjCrv_dpMIDynCorDT1.Kd_C InjCrv_dqFltLowNeg_C InjCrv_dqFltLowPos_C InjCrv_dqFltMidNeg_C InjCrv_dqFltMidPos_C InjCrv_dqSetUnBalMax_C InjCrv_dqSetUnBalMin_C InjCrv_DT1DQMISOECor2.T1_C InjCrv_DT1DQMISOECor2.Kd_C InjCrv_facAPMIDynCor2_CUR InjCrv_facAPPrMI1DynCor2_CUR InjCrv_facDQMI1DynCor2_CUR InjCrv_facETMIDynCor2_CUR InjCrv_facIAMIDynCor2_CUR InjCrv_facMIATSDynCor_CUR InjCrv_facMICTSDynCor_CUR InjCrv_facMIEGRDynCor_CUR InjCrv_facMIEGRPhiCor_CUR InjCrv_facMIPDynCor_CUR InjCrv_nMIDynMax_C InjCrv_phiMI1DynCor2_MAP InjCrv_phiMIAPSCorStrt_MAP InjCrv_phiMIAPSDynCor_MAP InjCrv_phiMIATSCorStrt_MAP InjCrv_phiMIDynCor_MAP InjCrv_phiMIDynMax_C InjCrv_phiMIDynMin_C InjCrv_phiMIEGRDynCor_MAP InjCrv_phiMIEgrLPCor_MAP InjCrv_phiMIETSCor11_GMAP InjCrv_phiMIETSCor12_GMAP InjCrv_phiMIETSCor1_X_AXIS InjCrv_phiMIETSCor1_Y_AXIS InjCrv_phiMIETSCorStrt_MAP InjCrv_phiMIFTSRailCorStrtMax_C InjCrv_phiMIFTSRailCorStrtMin_C InjCrv_phiMIFTSRailCorStrt_MAP InjCrv_pMIDynMax_C InjCrv_pMIDynMin_C InjCrv_tiLowNegPT1_C InjCrv_tiLowPosPT1_C InjCrv_tiMidNegPT1_C InjCrv_tiMidPosPT1_C InjCrv_tiUppNegPT1_C InjCrv_tiUppPosPT1_C /end DEF_CHARACTERISTIC
 /begin IN_MEASUREMENT AirCtl_mEGRDiff Air_pIntkVUs APP_r ASMod_mEGRIntMnfDsCmb CoEng_st EnvP_p Epm_nEng InjCrv_facMIAPSPhiCorStrt InjCrv_facMIATSPhiCorStrt InjCrv_facMIETSPhiCor11 InjCrv_facMIETSPhiCor12 InjCrv_facMIETSPhiCorStrt InjCrv_facMIFTSRailCorStrt InjCrv_facMIIMTSPhiCor InjCrv_swtPiIDblCorMap InjCrv_tAirMI InjCtl_qCurr InjCtl_qSetUnBal InjSys_tEng Rail_pSetPointFlTempRedLim Rail_pSetPointFlTempUnLim /end IN_MEASUREMENT
 /begin OUT_MEASUREMENT InjCrv_dpMIDynCor_mp InjCrv_dqSetUnBal InjCrv_dqSetUnBalFltLim InjCrv_facMI1DynCor2_mp InjCrv_facMI1DynCorSlow2 InjCrv_facMIDynCor_mp InjCrv_facMIPDynCor_mp InjCrv_phiMI1AddCor1 InjCrv_phiMI1AddCor2 InjCrv_phiMI1AddCorStrt InjCrv_phiMI1DynCor1_mp InjCrv_phiMI1DynCor2Bas_mp InjCrv_phiMI1DynCor2_mp InjCrv_phiMIAPSDynCor_mp InjCrv_phiMIDynCor_mp InjCrv_phiMIPDynCor_mp InjCrv_pMIDynCor_mp InjCrv_tiDQPT1AddCor2_mp /end OUT_MEASUREMENT
 /begin LOC_MEASUREMENT InjCrv_dqSetUnBalFlt_mp InjCrv_facAPPrMI1DynCor2_mp InjCrv_facMIEgrPhiCor_mp InjCrv_phiMI1DynCor_mp InjCrv_phiMIAPSCorStrt_mp InjCrv_phiMIATSCorStrt_mp InjCrv_phiMIEGRDynCor_mp InjCrv_phiMIEgrLPCorBas_mp InjCrv_phiMIEgrLPCor_mp InjCrv_phiMIETSCor11_mp InjCrv_phiMIETSCor12_mp InjCrv_phiMIETSCorStrt_mp InjCrv_phiMIFTSRailCorStrt_mp /end LOC_MEASUREMENT
/end FUNCTION
/begin FUNCTION InjCrv_MIAddCorRgn "" /begin OUT_MEASUREMENT InjCrv_phiMI1AddCorRgn /end OUT_MEASUREMENT /end FUNCTION
/begin FUNCTION InjCrv_MIAddCorSlow ""
 /begin DEF_CHARACTERISTIC InjCrv_facMIAPSPhiCorStrt_CUR InjCrv_facMIATSPhiCorStrt_CUR InjCrv_facMIETSPhiCor11_GCUR InjCrv_facMIETSPhiCor12_GCUR InjCrv_facMIETSPhiCor1_AXIS InjCrv_facMIETSPhiCorStrt_CUR InjCrv_facMIFTSRailCorStrt_CUR InjCrv_facMIIMTSPhiCor_CUR /end DEF_CHARACTERISTIC
 /begin IN_MEASUREMENT Air_tCACDs CoEng_st EnvP_p InjCrv_swtPiIDblCorMap InjCrv_tAirMI InjSys_tEng Rail_pSetPointFlTempCor /end IN_MEASUREMENT
 /begin OUT_MEASUREMENT InjCrv_facMIAPSPhiCorStrt InjCrv_facMIATSPhiCorStrt InjCrv_facMIETSPhiCor11 InjCrv_facMIETSPhiCor12 InjCrv_facMIETSPhiCorStrt InjCrv_facMIFTSRailCorStrt InjCrv_facMIIMTSPhiCor /end OUT_MEASUREMENT
/end FUNCTION
/begin FUNCTION InjCrv_MIEnvCor ""
 /begin DEF_CHARACTERISTIC InjCrv_phiMIAPSCor1_MAP InjCrv_phiMIAPSCor2_MAP InjCrv_phiMIAPSCor_X_AXIS InjCrv_phiMIAPSCor_Y_AXIS InjCrv_phiMIATSCor1_MAP InjCrv_phiMIATSCor2_MAP InjCrv_phiMIATSCor_X_AXIS InjCrv_phiMIATSCor_Y_AXIS InjCrv_phiMIETSCor1_MAP InjCrv_phiMIETSCor2_MAP InjCrv_phiMIETSCor_X_AXIS InjCrv_phiMIETSCor_Y_AXIS InjCrv_phiMIFTSRailCorMax_C InjCrv_phiMIFTSRailCorMin_C InjCrv_phiMIFTSRailCor_MAP InjCrv_phiMIPFltCor_MAP /end DEF_CHARACTERISTIC
 /begin IN_MEASUREMENT Epm_nEng InjCrv_facMIAPSPhiCor1 InjCrv_facMIAPSPhiCor2 InjCrv_facMIATSPhiCor1 InjCrv_facMIATSPhiCor2 InjCrv_facMIETSPhiCor1 InjCrv_facMIETSPhiCor2 InjCrv_facMIFTSRailCor InjCrv_facMIPFltPhiCor InjCrv_stMI1RgnTSync InjCrv_swtPiIDblCorMap InjCtl_qSetUnBal /end IN_MEASUREMENT
 /begin OUT_MEASUREMENT InjCrv_phiMI1EnvCor1 InjCrv_phiMI1EnvCor2 /end OUT_MEASUREMENT
 /begin LOC_MEASUREMENT InjCrv_phiMIAPSCor1_mp InjCrv_phiMIAPSCor2_mp InjCrv_phiMIATSCor1_mp InjCrv_phiMIATSCor2_mp InjCrv_phiMIETSCor1_mp InjCrv_phiMIETSCor2_mp InjCrv_phiMIFTSRailCor_mp InjCrv_phiMIPFltCor_mp /end LOC_MEASUREMENT
/end FUNCTION
/begin FUNCTION InjCrv_MIEnvCorRgn ""
 /begin DEF_CHARACTERISTIC InjCrv_phiMI1APSCor0Rgn_GMAP InjCrv_phiMI1APSCor1Rgn_GMAP InjCrv_phiMI1APSCorRgnX_AXIS InjCrv_phiMI1APSCorRgnY_AXIS InjCrv_phiMI1ATSCor0Rgn_GMAP InjCrv_phiMI1ATSCor1Rgn_GMAP InjCrv_phiMI1ATSCorRgnX_AXIS InjCrv_phiMI1ATSCorRgnY_AXIS InjCrv_phiMI1ETSCor0Rgn_GMAP InjCrv_phiMI1ETSCor1Rgn_GMAP InjCrv_phiMI1ETSCorRgnX_AXIS InjCrv_phiMI1ETSCorRgnY_AXIS /end DEF_CHARACTERISTIC
 /begin IN_MEASUREMENT Epm_nEng InjCrv_facMI1APSSOECorRgn InjCrv_facMI1ATSSOECorRgn InjCrv_facMI1ETSSOECorRgn InjCrv_stMI1RgnTSync InjCtl_qSetUnBal /end IN_MEASUREMENT
 /begin OUT_MEASUREMENT InjCrv_phiMI1EnvCorRgn /end OUT_MEASUREMENT
 /begin LOC_MEASUREMENT InjCrv_phiMI1APSCorRgn_mp InjCrv_phiMI1ATSCorRgn_mp InjCrv_phiMI1ETSCorRgn_mp /end LOC_MEASUREMENT
/end FUNCTION
/begin FUNCTION InjCrv_MIEnvCorSlow ""
 /begin DEF_CHARACTERISTIC InjCrv_ctATSMISel_C InjCrv_facMIAPSPhiCor1_CUR InjCrv_facMIAPSPhiCor2_CUR InjCrv_facMIAPSPhiCor_AXIS InjCrv_facMIATSPhiCor1_CUR InjCrv_facMIATSPhiCor2_CUR InjCrv_facMIATSPhiCor_AXIS InjCrv_facMIETSPhiCor1_CUR InjCrv_facMIETSPhiCor2_CUR InjCrv_facMIETSPhiCor_AXIS InjCrv_facMIFTSRailCor_CUR InjCrv_facMIPFltPhiCor_CUR /end DEF_CHARACTERISTIC
 /begin IN_MEASUREMENT AirSys_tFld CACDsT_t EnvP_p Exh_pFltPPFltUs InjCrv_swtPiIDblCorMap InjSys_tEng Rail_pSetPointFlTempCor /end IN_MEASUREMENT
 /begin OUT_MEASUREMENT InjCrv_facMIAPSPhiCor1 InjCrv_facMIAPSPhiCor2 InjCrv_facMIATSPhiCor1 InjCrv_facMIATSPhiCor2 InjCrv_facMIETSPhiCor1 InjCrv_facMIETSPhiCor2 InjCrv_facMIFTSRailCor InjCrv_facMIPFltPhiCor /end OUT_MEASUREMENT
 /begin LOC_MEASUREMENT InjCrv_tAirMI /end LOC_MEASUREMENT
/end FUNCTION
/begin FUNCTION InjCrv_MIEnvCorSlowRgn ""
 /begin DEF_CHARACTERISTIC InjCrv_facMI1APSSOECor0Rgn_GCUR InjCrv_facMI1APSSOECor1Rgn_GCUR InjCrv_facMI1APSSOECorRgn_AXIS InjCrv_facMI1ATSSOECor0Rgn_GCUR InjCrv_facMI1ATSSOECor1Rgn_GCUR InjCrv_facMI1ATSSOECorRgn_AXIS InjCrv_facMI1ETSSOECor0Rgn_GCUR InjCrv_facMI1ETSSOECor1Rgn_GCUR InjCrv_facMI1ETSSOECorRgn_AXIS /end DEF_CHARACTERISTIC
 /begin IN_MEASUREMENT EnvP_p InjSys_tAirRgn InjSys_tEngRgn /end IN_MEASUREMENT
 /begin OUT_MEASUREMENT InjCrv_facMI1APSSOECorRgn InjCrv_facMI1ATSSOECorRgn InjCrv_facMI1ETSSOECorRgn /end OUT_MEASUREMENT
/end FUNCTION
/begin FUNCTION InjCrv_MIRgn ""
 /begin DEF_CHARACTERISTIC InjCrv_phiMI1Bas0Rgn1_GMAP InjCrv_phiMI1Bas0Rgn2_GMAP InjCrv_phiMI1Bas0Rgn3_GMAP InjCrv_phiMI1Bas1Rgn1_GMAP InjCrv_phiMI1Bas1Rgn2_GMAP InjCrv_phiMI1Bas1Rgn3_GMAP InjCrv_phiMI1BasRgn1X_AXIS InjCrv_phiMI1BasRgn1Y_AXIS InjCrv_phiMI1BasRgn2X_AXIS InjCrv_phiMI1BasRgn2Y_AXIS InjCrv_phiMI1BasRgn3X_AXIS InjCrv_phiMI1BasRgn3Y_AXIS InjCrv_phiMI1MaxRgn_MAP InjCrv_phiMI1MinRgn_C InjCrv_qMI1Cor0Rgn_GMAP InjCrv_qMI1Cor1Rgn_GMAP InjCrv_qMI1CorX_AXIS InjCrv_qMI1CorY_AXIS InjCrv_qMI1Cor_MAP InjCrv_stDumrgn_C /end DEF_CHARACTERISTIC
 /begin IN_MEASUREMENT Epm_nEng InjCrv_phiMI1AddCorRgn InjCrv_phiMI1EnvCorRgn InjCrv_stInjCharActVal InjCrv_stMI1Rgn InjCtl_qSetUnBal /end IN_MEASUREMENT
 /begin OUT_MEASUREMENT InjCrv_phiMI1Rgn InjCrv_qMI1Cor InjCrv_qMI1CorRgn /end OUT_MEASUREMENT
 /begin LOC_MEASUREMENT InjCrv_numMI1RgnStg_mp InjCrv_phiMI1BasRgn_mp InjCrv_phiMI1MaxRgn_mp InjCrv_phiMI1RgnAdd_mp /end LOC_MEASUREMENT
/end FUNCTION
/begin FUNCTION InjCrv_MIRgnLib ""
 /begin DEF_CHARACTERISTIC InjCrv_facMI1QntRmp0Val_GCUR InjCrv_facMI1QntRmp1Val_GCUR InjCrv_facMI1QntRmpValX_AXIS InjCrv_facMI1SOERmp0Val_GCUR InjCrv_facMI1SOERmp1Val_GCUR InjCrv_facMI1SOERmpValX_AXIS /end DEF_CHARACTERISTIC
 /begin IN_MEASUREMENT CoEOM_facRmpVal InjCrv_phiMI1Cor InjCrv_phiMI1CorAct InjCrv_phiMI1CorDes InjCrv_phiMI1Max InjCrv_phiMI1MaxAct InjCrv_phiMI1MaxDes InjCrv_phiMI1Rgn InjCrv_stMI1Rgn InjCrv_stMI1RmpSel /end IN_MEASUREMENT
 /begin LOC_MEASUREMENT InjCrv_facMI1QntRmpVal_mp InjCrv_facMI1SOERmpVal_mp /end LOC_MEASUREMENT
/end FUNCTION
/begin FUNCTION InjCrv_MISOERgn ""
 /begin IN_MEASUREMENT InjCrv_phiMI1Des InjCrv_phiMI1DesCSCCor InjCrv_stInjCharSetVal /end IN_MEASUREMENT
/end FUNCTION
/begin FUNCTION InjCrv_MIStrt "" /begin DEF_CHARACTERISTIC InjCrv_phiMI1BasStrt_MAP /end DEF_CHARACTERISTIC /begin IN_MEASUREMENT CoEng_st Epm_nEng InjCrv_phiMI1AddCorStrt InjCtl_qSetUnBal /end IN_MEASUREMENT /begin LOC_MEASUREMENT InjCrv_phiMI1StrtCor_mp /end LOC_MEASUREMENT /end FUNCTION
/begin FUNCTION InjCrv_PiI1 ""
 /begin DEF_CHARACTERISTIC InjCrv_facPiI1QntMin_CUR InjCrv_phiPiI1Des_C InjCrv_phiPiIMax_C InjCrv_qMI1MinPiI1DiffHys_C InjCrv_qPiI1Bas1_MAP InjCrv_qPiI1Bas2_MAP InjCrv_qPiI1Bas_X_AXIS InjCrv_qPiI1Bas_Y_AXIS InjCrv_qPiI1Des_C InjCrv_qPiI1Max1_MAP InjCrv_qPiI1Max2_MAP InjCrv_qPiI1Max_X_AXIS InjCrv_qPiI1Max_Y_AXIS InjCrv_qPiI1MinDiff_C InjCrv_stInjDstSel_C InjCrv_swtPhiPiI1Des_C InjCrv_swtQntPiI1Des_C InjCrv_swtTiPiI1Des_C InjCrv_tiPiI1Des_C InjCrv_tiPiI1Min2_MAP InjCrv_tiPiI1MinRgn_MAP InjCrv_tiPiI1Min_MAP InjCrv_tiPiIMax_C /end DEF_CHARACTERISTIC
 /begin REF_CHARACTERISTIC InjCrv_stInjCharActVal_C InjCrv_swtStInjCharActVal_C /end REF_CHARACTERISTIC
 /begin IN_MEASUREMENT CoEng_stShutOffPath Epm_ctCyl Epm_nEng Epm_numCyl FlSys_rhoFl InjCrv_phiMI1Des InjCrv_phiPiI1AddCor1 InjCrv_phiPiI1AddCor2 InjCrv_phiPiI1EnvCor1 InjCrv_phiPiI1EnvCor2 InjCrv_qPiI1AddCor1 InjCrv_qPiI1AddCor2 InjCrv_qPiI1CylOffs InjCrv_qPiI1EnvCor1 InjCrv_qPiI1EnvCor2 InjCrv_stInjCharActVal InjCrv_stInjCharActValCyl InjCrv_stInjCharActValPrg InjCrv_stInjCharRlsPrgVal InjCrv_stInjCharSetVal InjCrv_stPiI1Rgn InjCrv_tiPiI1AddCor1 InjCrv_tiPiI1AddCor2 InjCrv_tiPiI1CylOffs InjCrv_tiPiI1EnvCor1 InjCrv_tiPiI1EnvCor2 InjCtl_qSetUnBal InjVlv_tiPse InjVlv_volPiI1CorCyc PFltRgn_st QWC_st RailP_pFlt /end IN_MEASUREMENT
 /begin OUT_MEASUREMENT InjCrv_phiPiI1Des InjCrv_phiPiI2Des InjCrv_phiPiI3Des InjCrv_qPiI1Des InjCrv_qPiI2Des InjCrv_qPiI3Des InjCrv_tiPiI1Des InjCrv_tiPiI2Des /end OUT_MEASUREMENT
 /begin LOC_MEASUREMENT InjCrv_facPiI1QntMin_mp InjCrv_phiPiI1AbsTot_mp InjCrv_phiPiI1Abs_mp InjCrv_phiPiI1Bas_mp InjCrv_phiPiI1Cor_mp InjCrv_phiPiI1DesAdd_mp InjCrv_phiPiI1DesByp_mp InjCrv_phiPiI1Rel_mp InjCrv_phiPiI2DesAdd_mp InjCrv_phiPiI2DesByp_mp InjCrv_phiPiI3DesAdd_mp InjCrv_phiPiI3DesByp_mp InjCrv_qMI1MinPiI1_mp InjCrv_qPiI1Bas_mp InjCrv_qPiI1DesAdd_mp InjCrv_qPiI1DesByp_mp InjCrv_qPiI1Des_mp InjCrv_qPiI1Max_mp InjCrv_qPiI1SetLimMax_mp InjCrv_qPiI1SetLim_mp InjCrv_qPiI1Set_mp InjCrv_qPiI2DesAdd_mp InjCrv_qPiI2DesByp_mp InjCrv_qPiI2Des_mp InjCrv_qPiI3DesAdd_mp InjCrv_qPiI3DesByp_mp InjCrv_qPiI3Des_mp InjCrv_qPiIMin_mp InjCrv_stPiI1_mp InjCrv_tiPiI1Bas_mp InjCrv_tiPiI1Cor_mp InjCrv_tiPiI1DesAdd_mp InjCrv_tiPiI1DesByp_mp InjCrv_tiPiI1ETNoCor_mp InjCrv_tiPiI1ET_mp InjCrv_tiPiI1Hyd_mp InjCrv_tiPiI1Min_mp InjCrv_tiPiI1RelMI1_mp InjCrv_tiPiI1RelTot_mp InjCrv_tiPiI1Rel_mp InjCrv_tiPiI1Tot_mp InjCrv_tiPiI2DesAdd_mp InjCrv_tiPiI2DesByp_mp InjCrv_volPiI1Cor_mp InjCrv_volPiI1NoCor_mp InjCrv_volPiI1_mp /end LOC_MEASUREMENT
/end FUNCTION
/begin COMPU_METHOD AirMassPerCyl "" RAT_FUNC "%5.1" "mg/Hub" COEFFS 0 10 0 0 0 1 /end COMPU_METHOD
/begin COMPU_METHOD AirTempFldSel "" TAB_VERB "%6.3" "" COMPU_TAB_REF AirTempFldSel /end COMPU_METHOD
/begin COMPU_VTAB AirTempFldSel "" TAB_VERB 4 0 "Air_tCACDs" 1 "Air_tAFS" 2 "EnvT_t" 3 "Air_tAFSCorr" /end COMPU_VTAB
/begin COMPU_METHOD AngleCrS "" RAT_FUNC "%6.3" "deg CrS" COEFFS 0 45.5111111111 0 0 0 1 /end COMPU_METHOD
/begin COMPU_METHOD CAS_ADAP_SY_Compu "" TAB_VERB "%6.3" "" COMPU_TAB_REF CAS_ADAP_SY_Compu /end COMPU_METHOD
/begin COMPU_VTAB CAS_ADAP_SY_Compu "" TAB_VERB 2 0 "0" 1 "1" /end COMPU_VTAB
/begin COMPU_METHOD CoEOMSwt_S16 "" RAT_FUNC "%7.6" "-" COEFFS 0 16384 0 0 0 1 /end COMPU_METHOD
/begin COMPU_METHOD Def_dt_sw_b4096 "" RAT_FUNC "%7.3" "m/s" COEFFS 0 8 0 0 0 1 /end COMPU_METHOD
/begin COMPU_METHOD Def_f_ub_b1 "" RAT_FUNC "%6.4" "-" COEFFS 0 256 0 0 0 1 /end COMPU_METHOD
/begin COMPU_METHOD Def_f_ub_b100 "" RAT_FUNC "%5.2" "%" COEFFS 0 2.56 0 0 0 1 /end COMPU_METHOD
/begin COMPU_METHOD Def_f_ub_b4 "" RAT_FUNC "%5.3" "-" COEFFS 0 64 0 0 0 1 /end COMPU_METHOD
/begin COMPU_METHOD Def_f_uw_b1 "" RAT_FUNC "%14.10" "-" COEFFS 0 65536 0 0 0 1 /end COMPU_METHOD
/begin COMPU_METHOD Def_f_uw_b100 "" RAT_FUNC "%8.5" "%" COEFFS 0 655.36 0 0 0 1 /end COMPU_METHOD
/begin COMPU_METHOD Def_f_uw_b2048 "" RAT_FUNC "%7.4" "-" COEFFS 0 32 0 0 0 1 /end COMPU_METHOD
/begin COMPU_METHOD Def_i_sw_q0p03125 "" RAT_FUNC "%8.5" "A" COEFFS 0 32 0 0 0 1 /end COMPU_METHOD
/begin COMPU_METHOD Def_i_sw_q0p125 "" RAT_FUNC "%8.4" "A" COEFFS 0 8 0 0 0 1 /end COMPU_METHOD
/begin COMPU_METHOD Def_i_ub_q0p125 "" RAT_FUNC "%6.3" "A" COEFFS 0 8 0 0 0 1 /end COMPU_METHOD
/begin COMPU_METHOD Def_i_ub_q1 "" RAT_FUNC "%6.2" "" COEFFS 0 1 0 0 0 1 /end COMPU_METHOD
/begin COMPU_METHOD Def_i_uw_q0p03125 "" RAT_FUNC "%8.5" "A" COEFFS 0 32 0 0 0 1 /end COMPU_METHOD
/begin COMPU_METHOD Def_m_sw_q0p1 "" RAT_FUNC "%7.4" "Nm" COEFFS 0 10 0 0 0 1 /end COMPU_METHOD
/begin COMPU_METHOD Def_n_sw_q1p0 "" RAT_FUNC "%5.2" "Upm" COEFFS 0 1 0 0 0 1 /end COMPU_METHOD
/begin COMPU_METHOD Def_r_uw_b1024 "" RAT_FUNC "%5.3" "mOhm" COEFFS 0 64 0 0 0 1 /end COMPU_METHOD
/begin COMPU_METHOD Def_st_ub_q1 "" RAT_FUNC "%3.1" "-" COEFFS 0 1 0 0 0 1 /end COMPU_METHOD
/begin COMPU_METHOD Def_td_uw_q0p01 "" RAT_FUNC "%7.5" "s" COEFFS 0 100 0 0 0 1 /end COMPU_METHOD
/begin COMPU_METHOD Def_td_uw_q0p1 "" RAT_FUNC "%6.3" "s" COEFFS 0 10 0 0 0 1 /end COMPU_METHOD
/begin COMPU_METHOD Def_t_sw_q0p1 "" RAT_FUNC "%6.3" "°C" COEFFS 0 10 0 0 0 1 /end COMPU_METHOD
/begin COMPU_METHOD Def_u_uw_q0p1 "" RAT_FUNC "%8.4" "V" COEFFS 0 10 0 0 0 1 /end COMPU_METHOD
/begin COMPU_METHOD dp_dZ20 "" RAT_FUNC "%6.1" "hPa/s" COEFFS 0 0.1 0 0 0 1 /end COMPU_METHOD
/begin COMPU_METHOD EngN "" RAT_FUNC "%5.1" "rpm" COEFFS 0 2 0 0 0 1 /end COMPU_METHOD
/begin COMPU_METHOD Fact "" RAT_FUNC "%6.5" "-" COEFFS 0 8192 0 0 0 1 /end COMPU_METHOD
/begin COMPU_METHOD Fact1 "" RAT_FUNC "%6.4" "-" COEFFS 0 128 0 0 0 1 /end COMPU_METHOD
/begin COMPU_METHOD INJCRV_MAPRLS_VERB "" TAB_VERB "%6.3" "-" COMPU_TAB_REF INJCRV_MAPRLS_VERB /end COMPU_METHOD
/begin COMPU_VTAB INJCRV_MAPRLS_VERB "" TAB_VERB 6 1 "RLSMAP1" 2 "RLSMAP2" 3 "RLSMAP3" 4 "RLSMAP4" 5 "RLSMAP5" 6 "RLSMAP6" /end COMPU_VTAB
/begin COMPU_METHOD INJCRV_MSK_VERB "" TAB_VERB "%6.3" "-" COMPU_TAB_REF INJCRV_MSK_VERB /end COMPU_METHOD
/begin COMPU_VTAB INJCRV_MSK_VERB "" TAB_VERB 8 0 "NRM" 1 "MSK0" 2 "MSK1" 3 "MSK2" 4 "MSK3" 5 "MSK4" 6 "MSK5" 7 "MSK6" /end COMPU_VTAB
/begin COMPU_METHOD INJCRV_RGN_VERB "" TAB_VERB "%6.3" "-" COMPU_TAB_REF INJCRV_RGN_VERB /end COMPU_METHOD
/begin COMPU_VTAB INJCRV_RGN_VERB "" TAB_VERB 8 0 "NRM" 1 "0RGN" 2 "1RGN" 3 "2RGN" 4 "3RGN" 5 "4RGN" 6 "5RGN" 7 "6RGN" /end COMPU_VTAB
/begin COMPU_METHOD INJCRV_RMP_VERB "" TAB_VERB "%6.3" "-" COMPU_TAB_REF INJCRV_RMP_VERB /end COMPU_METHOD
/begin COMPU_VTAB INJCRV_RMP_VERB "" TAB_VERB 7 1 "RMP1" 2 "RMP2" 3 "RMP3" 4 "RMP4" 5 "RMP5" 6 "RMP6" 7 "RMP7" /end COMPU_VTAB
/begin COMPU_METHOD InjMass "" RAT_FUNC "%5.2" "mg/hub" COEFFS 0 100 0 0 0 1 /end COMPU_METHOD
/begin COMPU_METHOD InjMassInj "" RAT_FUNC "%5.2" "mg/inj" COEFFS 0 100 0 0 0 1 /end COMPU_METHOD
/begin COMPU_METHOD InjMassPerSec_20ms "" RAT_FUNC "%6.3" "mg/hub/s" COEFFS 0 2 0 0 0 1 /end COMPU_METHOD
/begin COMPU_METHOD InjQntInj "" RAT_FUNC "%5.2" "mm^3/inj" COEFFS 0 100 0 0 0 1 /end COMPU_METHOD
/begin COMPU_METHOD InjTime_us "" RAT_FUNC "%5.1" "us" COEFFS 0 2.5 0 0 0 1 /end COMPU_METHOD
/begin COMPU_METHOD Kd_PerSec_20ms "" RAT_FUNC "%6.5" "1/s" COEFFS 0 1310.72 0 0 0 1 /end COMPU_METHOD
/begin COMPU_METHOD Kd_Pres2dpdt "" RAT_FUNC "%8.7" "hPa/sec/hPa" COEFFS 0 131072 0 0 0 1 /end COMPU_METHOD
/begin COMPU_METHOD OneToOne "" RAT_FUNC "%6.0" "-" COEFFS 0 1 0 0 0 1 /end COMPU_METHOD
/begin COMPU_METHOD Prc "" RAT_FUNC "%6.4" "%" COEFFS 0 81.92 0 0 0 1 /end COMPU_METHOD
/begin COMPU_METHOD Prc_Fact100 "" RAT_FUNC "%6.4" "%" COEFFS 0 100 0 0 0 1 /end COMPU_METHOD
/begin COMPU_METHOD Pres_hPa "" RAT_FUNC "%5.1" "hPa" COEFFS 0 1 0 0 0 1 /end COMPU_METHOD
/begin COMPU_METHOD Pres_Rail "" RAT_FUNC "%5.1" "bar" COEFFS 0 10.000000 0 0 0 1 /end COMPU_METHOD
/begin COMPU_METHOD RmpCrsAg_InjCrv "" RAT_FUNC "%6.5" "deg CrS/s" COEFFS 0 2982.61617777705 0 0 0 1 /end COMPU_METHOD
/begin COMPU_METHOD Rmp_Fact "" RAT_FUNC "%8.7" "1/s" COEFFS 0 536870.912 0 0 0 1 /end COMPU_METHOD
/begin COMPU_METHOD Temp_Cels "" RAT_FUNC "%5.1" "deg C" COEFFS 0 10 2731.4 0 0 1 /end COMPU_METHOD
/begin COMPU_METHOD TimeDelay_s "" RAT_FUNC "%12.4" "s" COEFFS 0 0 1 0 0.00023283064365387 0 /end COMPU_METHOD
/begin COMPU_METHOD Trq "" RAT_FUNC "%5.1" "Nm" COEFFS 0 10 0 0 0 1 /end COMPU_METHOD
/begin COMPU_METHOD Vel "" RAT_FUNC "%5.2" "km/h" COEFFS 0 100 0 0 0 1 /end COMPU_METHOD
/begin RECORD_LAYOUT Axis_Xs16 NO_AXIS_PTS_X 1 SWORD AXIS_PTS_X 2 SWORD INDEX_INCR DIRECT /end RECORD_LAYOUT
/begin RECORD_LAYOUT CurG_Ws16 FNC_VALUES 1 SWORD COLUMN_DIR DIRECT /end RECORD_LAYOUT
/begin RECORD_LAYOUT CurTKL_UB_VV_SW NO_AXIS_PTS_X 1 UBYTE RESERVED 2 BYTE AXIS_PTS_X 3 UBYTE INDEX_INCR DIRECT FNC_VALUES 4 SWORD COLUMN_DIR DIRECT /end RECORD_LAYOUT
/begin RECORD_LAYOUT CurTKL_UB_VV_UB NO_AXIS_PTS_X 1 UBYTE RESERVED 2 BYTE AXIS_PTS_X 3 UBYTE INDEX_INCR DIRECT FNC_VALUES 4 UBYTE COLUMN_DIR DIRECT /end RECORD_LAYOUT
/begin RECORD_LAYOUT Cur_Xs16Ws16 NO_AXIS_PTS_X 1 SWORD AXIS_PTS_X 2 SWORD INDEX_INCR DIRECT FNC_VALUES 3 SWORD COLUMN_DIR DIRECT /end RECORD_LAYOUT
/begin RECORD_LAYOUT Gkf_Ws16 FNC_VALUES 1 SWORD COLUMN_DIR DIRECT /end RECORD_LAYOUT
/begin RECORD_LAYOUT Gkl_Ws16 FNC_VALUES 1 SWORD COLUMN_DIR DIRECT /end RECORD_LAYOUT
/begin RECORD_LAYOUT GSst_Xs16 NO_AXIS_PTS_X 1 SWORD AXIS_PTS_X 2 SWORD INDEX_INCR DIRECT /end RECORD_LAYOUT
/begin RECORD_LAYOUT Kf_Xs16_Ys16_Ws16 NO_AXIS_PTS_X 1 SWORD NO_AXIS_PTS_Y 2 SWORD AXIS_PTS_X 3 SWORD INDEX_INCR DIRECT AXIS_PTS_Y 4 SWORD INDEX_INCR DIRECT FNC_VALUES 5 SWORD COLUMN_DIR DIRECT /end RECORD_LAYOUT
/begin RECORD_LAYOUT Kl_Xs16_Ws16 NO_AXIS_PTS_X 1 SWORD AXIS_PTS_X 2 SWORD INDEX_INCR DIRECT FNC_VALUES 3 SWORD COLUMN_DIR DIRECT /end RECORD_LAYOUT
/begin RECORD_LAYOUT Kw_Ws16 FNC_VALUES 1 SWORD COLUMN_DIR DIRECT /end RECORD_LAYOUT
/begin RECORD_LAYOUT Kw_Ws32 FNC_VALUES 1 SLONG COLUMN_DIR DIRECT /end RECORD_LAYOUT
/begin RECORD_LAYOUT Kw_Wu32 FNC_VALUES 1 ULONG COLUMN_DIR DIRECT /end RECORD_LAYOUT
/begin RECORD_LAYOUT Kw_Wu8 FNC_VALUES 1 UBYTE COLUMN_DIR DIRECT /end RECORD_LAYOUT
/begin RECORD_LAYOUT MapG_Ws16 FNC_VALUES 1 SWORD COLUMN_DIR DIRECT /end RECORD_LAYOUT
/begin RECORD_LAYOUT MapTKF_SW_SW_SW NO_AXIS_PTS_X 1 UBYTE NO_AXIS_PTS_Y 2 UBYTE AXIS_PTS_X 3 SWORD INDEX_INCR DIRECT AXIS_PTS_Y 4 SWORD INDEX_INCR DIRECT FNC_VALUES 5 SWORD COLUMN_DIR DIRECT /end RECORD_LAYOUT
/begin RECORD_LAYOUT MapTKF_SW_UB_UW NO_AXIS_PTS_X 1 UBYTE NO_AXIS_PTS_Y 2 UBYTE AXIS_PTS_X 3 UBYTE INDEX_INCR DIRECT AXIS_PTS_Y 4 SWORD INDEX_INCR DIRECT FNC_VALUES 5 UWORD COLUMN_DIR DIRECT /end RECORD_LAYOUT
/begin RECORD_LAYOUT MapTKF_UB_UB_UB NO_AXIS_PTS_X 1 UBYTE NO_AXIS_PTS_Y 2 UBYTE AXIS_PTS_X 3 UBYTE INDEX_INCR DIRECT AXIS_PTS_Y 4 UBYTE INDEX_INCR DIRECT FNC_VALUES 5 UBYTE COLUMN_DIR DIRECT /end RECORD_LAYOUT
/begin RECORD_LAYOUT Map_Xs16Ys16Ws16 NO_AXIS_PTS_X 1 SWORD NO_AXIS_PTS_Y 2 SWORD AXIS_PTS_X 3 SWORD INDEX_INCR DIRECT AXIS_PTS_Y 4 SWORD INDEX_INCR DIRECT FNC_VALUES 5 SWORD COLUMN_DIR DIRECT /end RECORD_LAYOUT
/begin RECORD_LAYOUT Map_Xu8Yu8Wu8 NO_AXIS_PTS_X 1 UBYTE NO_AXIS_PTS_Y 2 UBYTE AXIS_PTS_X 3 UBYTE INDEX_INCR DIRECT AXIS_PTS_Y 4 UBYTE INDEX_INCR DIRECT FNC_VALUES 5 UBYTE COLUMN_DIR DIRECT /end RECORD_LAYOUT
/begin RECORD_LAYOUT ValA_Wu32 FNC_VALUES 1 ULONG COLUMN_DIR DIRECT /end RECORD_LAYOUT
/begin RECORD_LAYOUT Val_Ws16 FNC_VALUES 1 SWORD COLUMN_DIR DIRECT /end RECORD_LAYOUT
/begin RECORD_LAYOUT Val_Ws8 FNC_VALUES 1 SBYTE COLUMN_DIR DIRECT /end RECORD_LAYOUT
/begin RECORD_LAYOUT Val_Wu16 FNC_VALUES 1 UWORD COLUMN_DIR DIRECT /end RECORD_LAYOUT
/begin RECORD_LAYOUT Val_Wu32 FNC_VALUES 1 ULONG COLUMN_DIR DIRECT /end RECORD_LAYOUT
/begin RECORD_LAYOUT Val_Wu8 FNC_VALUES 1 UBYTE COLUMN_DIR DIRECT /end RECORD_LAYOUT
/end MODULE
/end PROJECT

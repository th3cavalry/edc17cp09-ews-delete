ASAP2_VERSION 1 4
/begin PROJECT P_574 "EDC17_CP09"
/begin HEADER "" VERSION "V8KB" PROJECT_NO P_574 /end HEADER
/begin MODULE DIM ""
/begin MOD_COMMON "" BYTE_ORDER MSB_LAST ALIGNMENT_BYTE 1 ALIGNMENT_WORD 2 ALIGNMENT_LONG 4 ALIGNMENT_FLOAT32_IEEE 4 /end MOD_COMMON
/begin CHARACTERISTIC DFC_CtlMsk.DFC_TCACDsSRCMax_C "DFC/Verhaltens Kontroll Maske für Prüfung DFC_TCACDsSRCMax" VALUE 0x8002316C Val_Wu16 65535.00 DFES_OneToOne 0.00 65535.00 /end CHARACTERISTIC
/begin CHARACTERISTIC DFC_CtlMsk.DFC_TCACDsSRCMin_C "DFC/Verhaltens Kontroll Maske für Prüfung DFC_TCACDsSRCMin" VALUE 0x8002316E Val_Wu16 65535.00 DFES_OneToOne 0.00 65535.00 /end CHARACTERISTIC
/begin CHARACTERISTIC DFC_CtlMsk.DFC_ThrVlvSRCMax_C "DFC/Verhaltens Kontroll Maske für Prüfung DFC_ThrVlvSRCMax" VALUE 0x80023170 Val_Wu16 65535.00 DFES_OneToOne 0.00 65535.00 /end CHARACTERISTIC
/begin CHARACTERISTIC DFC_CtlMsk.DFC_ThrVlvSRCMin_C "DFC/Verhaltens Kontroll Maske für Prüfung DFC_ThrVlvSRCMin" VALUE 0x80023172 Val_Wu16 65535.00 DFES_OneToOne 0.00 65535.00 /end CHARACTERISTIC
/begin CHARACTERISTIC DFC_CtlMsk.DFC_TrbChLPOL_C "DFC/Verhaltens Kontroll Maske für Prüfung DFC_TrbChLPOL" VALUE 0x80023174 Val_Wu16 65535.00 DFES_OneToOne 0.00 65535.00 /end CHARACTERISTIC
/begin CHARACTERISTIC DFC_CtlMsk.DFC_TrbChLPSCB_C "DFC/Verhaltens Kontroll Maske für Prüfung DFC_TrbChLPSCB" VALUE 0x80023176 Val_Wu16 65535.00 DFES_OneToOne 0.00 65535.00 /end CHARACTERISTIC
/begin CHARACTERISTIC DFC_CtlMsk.DFC_TrbChLPSCG_C "DFC/Verhaltens Kontroll Maske für Prüfung DFC_TrbChLPSCG" VALUE 0x80023178 Val_Wu16 65535.00 DFES_OneToOne 0.00 65535.00 /end CHARACTERISTIC
/begin CHARACTERISTIC DFC_CtlMsk.DFC_UHtrPLOL_C "DFC/Verhaltens Kontroll Maske für Prüfung DFC_UHtrPLOL" VALUE 0x8002317A Val_Wu16 65535.00 DFES_OneToOne 0.00 65535.00 /end CHARACTERISTIC
/begin CHARACTERISTIC DFC_CtlMsk.DFC_UHtrPLSCB_C "DFC/Verhaltens Kontroll Maske für Prüfung DFC_UHtrPLSCB" VALUE 0x8002317C Val_Wu16 65535.00 DFES_OneToOne 0.00 65535.00 /end CHARACTERISTIC
/begin CHARACTERISTIC DFC_CtlMsk.DFC_UHtrPLSCG_C "DFC/Verhaltens Kontroll Maske für Prüfung DFC_UHtrPLSCG" VALUE 0x8002317E Val_Wu16 65535.00 DFES_OneToOne 0.00 65535.00 /end CHARACTERISTIC
/begin CHARACTERISTIC DFC_CtlMsk.DFC_UHtrPLSRCMaxDia_C "DFC/Verhaltens Kontroll Maske für Prüfung DFC_UHtrPLSRCMaxDia" VALUE 0x80023180 Val_Wu16 65535.00 DFES_OneToOne 0.00 65535.00 /end CHARACTERISTIC
/begin CHARACTERISTIC DFC_CtlMsk.DFC_UHtrPLSRCMinDia_C "DFC/Verhaltens Kontroll Maske für Prüfung DFC_UHtrPLSRCMinDia" VALUE 0x80023182 Val_Wu16 65535.00 DFES_OneToOne 0.00 65535.00 /end CHARACTERISTIC
/begin CHARACTERISTIC DFC_CtlMsk.DFC_UHtrTnkOL_C "DFC/Verhaltens Kontroll Maske für Prüfung DFC_UHtrTnkOL" VALUE 0x80023184 Val_Wu16 65535.00 DFES_OneToOne 0.00 65535.00 /end CHARACTERISTIC
/begin CHARACTERISTIC DFC_CtlMsk.DFC_UHtrTnkSCB_C "DFC/Verhaltens Kontroll Maske für Prüfung DFC_UHtrTnkSCB" VALUE 0x80023186 Val_Wu16 65535.00 DFES_OneToOne 0.00 65535.00 /end CHARACTERISTIC
/begin CHARACTERISTIC DFC_CtlMsk.DFC_UHtrTnkSCG_C "DFC/Verhaltens Kontroll Maske für Prüfung DFC_UHtrTnkSCG" VALUE 0x80023188 Val_Wu16 65535.00 DFES_OneToOne 0.00 65535.00 /end CHARACTERISTIC
/begin CHARACTERISTIC DFC_CtlMsk.DFC_UHtrTnkSRCMaxDia_C "DFC/Verhaltens Kontroll Maske für Prüfung DFC_UHtrTnkSRCMaxDia" VALUE 0x8002318A Val_Wu16 65535.00 DFES_OneToOne 0.00 65535.00 /end CHARACTERISTIC
/begin CHARACTERISTIC DFC_CtlMsk.DFC_UHtrTnkSRCMinDia_C "DFC/Verhaltens Kontroll Maske für Prüfung DFC_UHtrTnkSRCMinDia" VALUE 0x8002318C Val_Wu16 65535.00 DFES_OneToOne 0.00 65535.00 /end CHARACTERISTIC
/begin CHARACTERISTIC DFC_CtlMsk.DFC_URevVlvOL_C "DFC/Verhaltens Kontroll Maske für Prüfung DFC_URevVlvOL" VALUE 0x8002318E Val_Wu16 65535.00 DFES_OneToOne 0.00 65535.00 /end CHARACTERISTIC
/begin CHARACTERISTIC DFC_CtlMsk.DFC_URevVlvSCB_C "DFC/Verhaltens Kontroll Maske für Prüfung DFC_URevVlvSCB" VALUE 0x80023190 Val_Wu16 65535.00 DFES_OneToOne 0.00 65535.00 /end CHARACTERISTIC
/begin CHARACTERISTIC DFC_CtlMsk.DFC_URevVlvSCG_C "DFC/Verhaltens Kontroll Maske für Prüfung DFC_URevVlvSCG" VALUE 0x80023192 Val_Wu16 65535.00 DFES_OneToOne 0.00 65535.00 /end CHARACTERISTIC
/begin CHARACTERISTIC DFC_CtlMsk.DFC_UTnkTSRCMax_C "DFC/Verhaltens Kontroll Maske für Prüfung DFC_UTnkTSRCMax" VALUE 0x80023194 Val_Wu16 65535.00 DFES_OneToOne 0.00 65535.00 /end CHARACTERISTIC
/begin CHARACTERISTIC DFC_CtlMsk.DFC_UTnkTSRCMin_C "DFC/Verhaltens Kontroll Maske für Prüfung DFC_UTnkTSRCMin" VALUE 0x80023196 Val_Wu16 65535.00 DFES_OneToOne 0.00 65535.00 /end CHARACTERISTIC
/begin CHARACTERISTIC DFC_CtlMsk.DFC_UTnkTSig_C "DFC/Verhaltens Kontroll Maske für Prüfung DFC_UTnkTSig" VALUE 0x80023198 Val_Wu16 65535.00 DFES_OneToOne 0.00 65535.00 /end CHARACTERISTIC
/begin CHARACTERISTIC DFC_CtlMsk.DFC_VSwVlvGovDvtMax_C "DFC/Verhaltens Kontroll Maske für Prüfung DFC_VSwVlvGovDvtMax" VALUE 0x8002319A Val_Wu16 65535.00 DFES_OneToOne 0.00 65535.00 /end CHARACTERISTIC
/begin CHARACTERISTIC DFC_CtlMsk.DFC_VSwVlvGovDvtMin_C "DFC/Verhaltens Kontroll Maske für Prüfung DFC_VSwVlvGovDvtMin" VALUE 0x8002319C Val_Wu16 65535.00 DFES_OneToOne 0.00 65535.00 /end CHARACTERISTIC
/begin CHARACTERISTIC DFC_CtlMsk.DFC_VSwVlvHBrgOpnLd_C "DFC/Verhaltens Kontroll Maske für Prüfung DFC_VSwVlvHBrgOpnLd" VALUE 0x8002319E Val_Wu16 65535.00 DFES_OneToOne 0.00 65535.00 /end CHARACTERISTIC
/begin CHARACTERISTIC DFC_CtlMsk.DFC_VSwVlvHBrgOvrCurr_C "DFC/Verhaltens Kontroll Maske für Prüfung DFC_VSwVlvHBrgOvrCurr" VALUE 0x800231A0 Val_Wu16 65535.00 DFES_OneToOne 0.00 65535.00 /end CHARACTERISTIC
/begin CHARACTERISTIC DFC_CtlMsk.DFC_VSwVlvHBrgOvrTemp_C "DFC/Verhaltens Kontroll Maske für Prüfung DFC_VSwVlvHBrgOvrTemp" VALUE 0x800231A2 Val_Wu16 65535.00 DFES_OneToOne 0.00 65535.00 /end CHARACTERISTIC
/begin CHARACTERISTIC DFC_CtlMsk.DFC_VSwVlvHBrgShCirBatt1_C "DFC/Verhaltens Kontroll Maske für Prüfung DFC_VSwVlvHBrgShCirBatt1" VALUE 0x800231A4 Val_Wu16 65535.00 DFES_OneToOne 0.00 65535.00 /end CHARACTERISTIC
/begin CHARACTERISTIC DFC_CtlMsk.DFC_VSwVlvHBrgShCirBatt2_C "DFC/Verhaltens Kontroll Maske für Prüfung DFC_VSwVlvHBrgShCirBatt2" VALUE 0x800231A6 Val_Wu16 65535.00 DFES_OneToOne 0.00 65535.00 /end CHARACTERISTIC
/begin CHARACTERISTIC DFC_CtlMsk.DFC_VSwVlvHBrgShCirGnd1_C "DFC/Verhaltens Kontroll Maske für Prüfung DFC_VSwVlvHBrgShCirGnd1" VALUE 0x800231A8 Val_Wu16 65535.00 DFES_OneToOne 0.00 65535.00 /end CHARACTERISTIC
/begin CHARACTERISTIC DFC_CtlMsk.DFC_VSwVlvHBrgShCirGnd2_C "DFC/Verhaltens Kontroll Maske für Prüfung DFC_VSwVlvHBrgShCirGnd2" VALUE 0x800231AA Val_Wu16 65535.00 DFES_OneToOne 0.00 65535.00 /end CHARACTERISTIC
/begin CHARACTERISTIC DFC_CtlMsk.DFC_VSwVlvHBrgShCirOvrLd_C "DFC/Verhaltens Kontroll Maske für Prüfung DFC_VSwVlvHBrgShCirOvrLd" VALUE 0x800231AC Val_Wu16 65535.00 DFES_OneToOne 0.00 65535.00 /end CHARACTERISTIC
/begin CHARACTERISTIC DFC_CtlMsk.DFC_VSwVlvHBrgTempOvrCurr_C "DFC/Verhaltens Kontroll Maske für Prüfung DFC_VSwVlvHBrgTempOvrCurr" VALUE 0x800231AE Val_Wu16 65535.00 DFES_OneToOne 0.00 65535.00 /end CHARACTERISTIC
/begin CHARACTERISTIC DFC_CtlMsk.DFC_VSwVlvHBrgUndrVltg_C "DFC/Verhaltens Kontroll Maske für Prüfung DFC_VSwVlvHBrgUndrVltg" VALUE 0x800231B0 Val_Wu16 65535.00 DFES_OneToOne 0.00 65535.00 /end CHARACTERISTIC
/begin CHARACTERISTIC DFC_CtlMsk.DFC_VSwVlvOL_C "DFC/Verhaltens Kontroll Maske für Prüfung DFC_VSwVlvOL" VALUE 0x800231B2 Val_Wu16 65535.00 DFES_OneToOne 0.00 65535.00 /end CHARACTERISTIC
/begin CHARACTERISTIC DFC_CtlMsk.DFC_VSwVlvSCB_C "DFC/Verhaltens Kontroll Maske für Prüfung DFC_VSwVlvSCB" VALUE 0x800231B4 Val_Wu16 65535.00 DFES_OneToOne 0.00 65535.00 /end CHARACTERISTIC
/begin CHARACTERISTIC DFC_CtlMsk.DFC_VSwVlvSCG_C "DFC/Verhaltens Kontroll Maske für Prüfung DFC_VSwVlvSCG" VALUE 0x800231B6 Val_Wu16 65535.00 DFES_OneToOne 0.00 65535.00 /end CHARACTERISTIC
/begin CHARACTERISTIC DFC_CtlMsk.DFC_VSwVlvSRCMax_C "DFC/Verhaltens Kontroll Maske für Prüfung DFC_VSwVlvSRCMax" VALUE 0x800231B8 Val_Wu16 65535.00 DFES_OneToOne 0.00 65535.00 /end CHARACTERISTIC
/begin CHARACTERISTIC DFC_CtlMsk.DFC_VSwVlvSRCMin_C "DFC/Verhaltens Kontroll Maske für Prüfung DFC_VSwVlvSRCMin" VALUE 0x800231BA Val_Wu16 65535.00 DFES_OneToOne 0.00 65535.00 /end CHARACTERISTIC
/begin CHARACTERISTIC DFC_CtlMsk.DFC_ClthNpl_C "DFC/Verhaltens Kontroll Maske für Prüfung DFC_ClthNpl" VALUE 0x800231BC Val_Wu16 65535.00 DFES_OneToOne 0.00 65535.00 /end CHARACTERISTIC
/begin CHARACTERISTIC DFC_CtlMsk.DFC_ETClbETMax_0_C "DFC/Verhaltens Kontroll Maske für Prüfung DFC_ETClbETMax_0" VALUE 0x800231BE Val_Wu16 65535.00 DFES_OneToOne 0.00 65535.00 /end CHARACTERISTIC
/begin CHARACTERISTIC DFC_CtlMsk.DFC_ETClbETMax_1_C "DFC/Verhaltens Kontroll Maske für Prüfung DFC_ETClbETMax_1" VALUE 0x800231C0 Val_Wu16 65535.00 DFES_OneToOne 0.00 65535.00 /end CHARACTERISTIC
/begin CHARACTERISTIC DFC_CtlMsk.DFC_ETClbETMax_2_C "DFC/Verhaltens Kontroll Maske für Prüfung DFC_ETClbETMax_2" VALUE 0x800231C2 Val_Wu16 65535.00 DFES_OneToOne 0.00 65535.00 /end CHARACTERISTIC
/begin CHARACTERISTIC DFC_CtlMsk.DFC_ETClbETMax_3_C "DFC/Verhaltens Kontroll Maske für Prüfung DFC_ETClbETMax_3" VALUE 0x800231C4 Val_Wu16 65535.00 DFES_OneToOne 0.00 65535.00 /end CHARACTERISTIC
/begin CHARACTERISTIC DFC_CtlMsk.DFC_ETClbETMax_4_C "DFC/Verhaltens Kontroll Maske für Prüfung DFC_ETClbETMax_4" VALUE 0x800231C6 Val_Wu16 65535.00 DFES_OneToOne 0.00 65535.00 /end CHARACTERISTIC
/begin CHARACTERISTIC DFC_CtlMsk.DFC_ETClbETMax_5_C "DFC/Verhaltens Kontroll Maske für Prüfung DFC_ETClbETMax_5" VALUE 0x800231C8 Val_Wu16 65535.00 DFES_OneToOne 0.00 65535.00 /end CHARACTERISTIC
/begin CHARACTERISTIC DFC_CtlMsk.DFC_ETClbETMin_0_C "DFC/Verhaltens Kontroll Maske für Prüfung DFC_ETClbETMin_0" VALUE 0x800231CA Val_Wu16 65535.00 DFES_OneToOne 0.00 65535.00 /end CHARACTERISTIC
/begin CHARACTERISTIC DFC_CtlMsk.DFC_ETClbETMin_1_C "DFC/Verhaltens Kontroll Maske für Prüfung DFC_ETClbETMin_1" VALUE 0x800231CC Val_Wu16 65535.00 DFES_OneToOne 0.00 65535.00 /end CHARACTERISTIC
/begin CHARACTERISTIC DFC_CtlMsk.DFC_ETClbETMin_2_C "DFC/Verhaltens Kontroll Maske für Prüfung DFC_ETClbETMin_2" VALUE 0x800231CE Val_Wu16 65535.00 DFES_OneToOne 0.00 65535.00 /end CHARACTERISTIC
/begin CHARACTERISTIC DFC_CtlMsk.DFC_ETClbETMin_3_C "DFC/Verhaltens Kontroll Maske für Prüfung DFC_ETClbETMin_3" VALUE 0x800231D0 Val_Wu16 65535.00 DFES_OneToOne 0.00 65535.00 /end CHARACTERISTIC
/begin CHARACTERISTIC DFC_CtlMsk.DFC_ETClbETMin_4_C "DFC/Verhaltens Kontroll Maske für Prüfung DFC_ETClbETMin_4" VALUE 0x800231D2 Val_Wu16 65535.00 DFES_OneToOne 0.00 65535.00 /end CHARACTERISTIC
/begin CHARACTERISTIC DFC_CtlMsk.DFC_ETClbETMin_5_C "DFC/Verhaltens Kontroll Maske für Prüfung DFC_ETClbETMin_5" VALUE 0x800231D4 Val_Wu16 65535.00 DFES_OneToOne 0.00 65535.00 /end CHARACTERISTIC
/begin CHARACTERISTIC DFC_CtlMsk.DFC_IVActrEnrgMax_0_C "DFC/Verhaltens Kontroll Maske für Prüfung DFC_IVActrEnrgMax_0" VALUE 0x800231D6 Val_Wu16 65535.00 DFES_OneToOne 0.00 65535.00 /end CHARACTERISTIC
/begin CHARACTERISTIC DFC_CtlMsk.DFC_IVActrEnrgMax_1_C "DFC/Verhaltens Kontroll Maske für Prüfung DFC_IVActrEnrgMax_1" VALUE 0x800231D8 Val_Wu16 65535.00 DFES_OneToOne 0.00 65535.00 /end CHARACTERISTIC
/begin CHARACTERISTIC DFC_CtlMsk.DFC_IVActrEnrgMax_2_C "DFC/Verhaltens Kontroll Maske für Prüfung DFC_IVActrEnrgMax_2" VALUE 0x800231DA Val_Wu16 65535.00 DFES_OneToOne 0.00 65535.00 /end CHARACTERISTIC
/begin CHARACTERISTIC DFC_CtlMsk.DFC_IVActrEnrgMax_3_C "DFC/Verhaltens Kontroll Maske für Prüfung DFC_IVActrEnrgMax_3" VALUE 0x800231DC Val_Wu16 65535.00 DFES_OneToOne 0.00 65535.00 /end CHARACTERISTIC
/begin CHARACTERISTIC DFC_CtlMsk.DFC_IVActrEnrgMax_4_C "DFC/Verhaltens Kontroll Maske für Prüfung DFC_IVActrEnrgMax_4" VALUE 0x800231DE Val_Wu16 65535.00 DFES_OneToOne 0.00 65535.00 /end CHARACTERISTIC
/begin CHARACTERISTIC DFC_CtlMsk.DFC_IVActrEnrgMax_5_C "DFC/Verhaltens Kontroll Maske für Prüfung DFC_IVActrEnrgMax_5" VALUE 0x800231E0 Val_Wu16 65535.00 DFES_OneToOne 0.00 65535.00 /end CHARACTERISTIC
/begin CHARACTERISTIC DFC_CtlMsk.DFC_IVActrEnrgMax_6_C "DFC/Verhaltens Kontroll Maske für Prüfung DFC_IVActrEnrgMax_6" VALUE 0x800231E2 Val_Wu16 65535.00 DFES_OneToOne 0.00 65535.00 /end CHARACTERISTIC
/begin CHARACTERISTIC DFC_CtlMsk.DFC_IVActrEnrgMax_7_C "DFC/Verhaltens Kontroll Maske für Prüfung DFC_IVActrEnrgMax_7" VALUE 0x800231E4 Val_Wu16 65535.00 DFES_OneToOne 0.00 65535.00 /end CHARACTERISTIC
/begin CHARACTERISTIC DFC_CtlMsk.DFC_IVActrEnrgMin_0_C "DFC/Verhaltens Kontroll Maske für Prüfung DFC_IVActrEnrgMin_0" VALUE 0x800231E6 Val_Wu16 65535.00 DFES_OneToOne 0.00 65535.00 /end CHARACTERISTIC
/begin CHARACTERISTIC DFC_CtlMsk.DFC_IVActrEnrgMin_1_C "DFC/Verhaltens Kontroll Maske für Prüfung DFC_IVActrEnrgMin_1" VALUE 0x800231E8 Val_Wu16 65535.00 DFES_OneToOne 0.00 65535.00 /end CHARACTERISTIC
/begin CHARACTERISTIC DFC_CtlMsk.DFC_IVActrEnrgMin_2_C "DFC/Verhaltens Kontroll Maske für Prüfung DFC_IVActrEnrgMin_2" VALUE 0x800231EA Val_Wu16 65535.00 DFES_OneToOne 0.00 65535.00 /end CHARACTERISTIC
/begin CHARACTERISTIC DFC_CtlMsk.DFC_IVActrEnrgMin_3_C "DFC/Verhaltens Kontroll Maske für Prüfung DFC_IVActrEnrgMin_3" VALUE 0x800231EC Val_Wu16 65535.00 DFES_OneToOne 0.00 65535.00 /end CHARACTERISTIC
/begin CHARACTERISTIC DFC_CtlMsk.DFC_IVActrEnrgMin_4_C "DFC/Verhaltens Kontroll Maske für Prüfung DFC_IVActrEnrgMin_4" VALUE 0x800231EE Val_Wu16 65535.00 DFES_OneToOne 0.00 65535.00 /end CHARACTERISTIC
/begin CHARACTERISTIC DFC_CtlMsk.DFC_IVActrEnrgMin_5_C "DFC/Verhaltens Kontroll Maske für Prüfung DFC_IVActrEnrgMin_5" VALUE 0x800231F0 Val_Wu16 65535.00 DFES_OneToOne 0.00 65535.00 /end CHARACTERISTIC
/begin CHARACTERISTIC DFC_CtlMsk.DFC_IVActrEnrgMin_6_C "DFC/Verhaltens Kontroll Maske für Prüfung DFC_IVActrEnrgMin_6" VALUE 0x800231F2 Val_Wu16 65535.00 DFES_OneToOne 0.00 65535.00 /end CHARACTERISTIC
/begin CHARACTERISTIC DFC_CtlMsk.DFC_IVActrEnrgMin_7_C "DFC/Verhaltens Kontroll Maske für Prüfung DFC_IVActrEnrgMin_7" VALUE 0x800231F4 Val_Wu16 65535.00 DFES_OneToOne 0.00 65535.00 /end CHARACTERISTIC
/begin CHARACTERISTIC DFC_CtlMsk.DFC_IVActrEnrgPlaus_0_C "DFC/Verhaltens Kontroll Maske für Prüfung DFC_IVActrEnrgPlaus_0" VALUE 0x800231F6 Val_Wu16 65535.00 DFES_OneToOne 0.00 65535.00 /end CHARACTERISTIC
/begin CHARACTERISTIC DFC_CtlMsk.DFC_IVActrEnrgPlaus_1_C "DFC/Verhaltens Kontroll Maske für Prüfung DFC_IVActrEnrgPlaus_1" VALUE 0x800231F8 Val_Wu16 65535.00 DFES_OneToOne 0.00 65535.00 /end CHARACTERISTIC
/begin CHARACTERISTIC DFC_CtlMsk.DFC_IVActrEnrgPlaus_2_C "DFC/Verhaltens Kontroll Maske für Prüfung DFC_IVActrEnrgPlaus_2" VALUE 0x800231FA Val_Wu16 65535.00 DFES_OneToOne 0.00 65535.00 /end CHARACTERISTIC
/begin CHARACTERISTIC DFC_CtlMsk.DFC_IVActrEnrgPlaus_3_C "DFC/Verhaltens Kontroll Maske für Prüfung DFC_IVActrEnrgPlaus_3" VALUE 0x800231FC Val_Wu16 65535.00 DFES_OneToOne 0.00 65535.00 /end CHARACTERISTIC
/begin CHARACTERISTIC DFC_CtlMsk.DFC_IVActrEnrgPlaus_4_C "DFC/Verhaltens Kontroll Maske für Prüfung DFC_IVActrEnrgPlaus_4" VALUE 0x800231FE Val_Wu16 65535.00 DFES_OneToOne 0.00 65535.00 /end CHARACTERISTIC
/begin CHARACTERISTIC DFC_CtlMsk.DFC_IVActrEnrgPlaus_5_C "DFC/Verhaltens Kontroll Maske für Prüfung DFC_IVActrEnrgPlaus_5" VALUE 0x80023200 Val_Wu16 65535.00 DFES_OneToOne 0.00 65535.00 /end CHARACTERISTIC
/begin CHARACTERISTIC DFC_CtlMsk.DFC_IVActrEnrgPlaus_6_C "DFC/Verhaltens Kontroll Maske für Prüfung DFC_IVActrEnrgPlaus_6" VALUE 0x80023202 Val_Wu16 65535.00 DFES_OneToOne 0.00 65535.00 /end CHARACTERISTIC
/begin CHARACTERISTIC DFC_CtlMsk.DFC_IVActrEnrgPlaus_7_C "DFC/Verhaltens Kontroll Maske für Prüfung DFC_IVActrEnrgPlaus_7" VALUE 0x80023204 Val_Wu16 65535.00 DFES_OneToOne 0.00 65535.00 /end CHARACTERISTIC
/begin CHARACTERISTIC DFC_CtlMsk.DFC_IVCtlTiDiff_0_C "DFC/Verhaltens Kontroll Maske für Prüfung DFC_IVCtlTiDiff_0" VALUE 0x80023206 Val_Wu16 65535.00 DFES_OneToOne 0.00 65535.00 /end CHARACTERISTIC
/begin CHARACTERISTIC DFC_CtlMsk.DFC_IVCtlTiDiff_1_C "DFC/Verhaltens Kontroll Maske für Prüfung DFC_IVCtlTiDiff_1" VALUE 0x80023208 Val_Wu16 65535.00 DFES_OneToOne 0.00 65535.00 /end CHARACTERISTIC
/begin CHARACTERISTIC DFC_CtlMsk.DFC_IVCtlTiDiff_2_C "DFC/Verhaltens Kontroll Maske für Prüfung DFC_IVCtlTiDiff_2" VALUE 0x8002320A Val_Wu16 65535.00 DFES_OneToOne 0.00 65535.00 /end CHARACTERISTIC
/begin CHARACTERISTIC DFC_CtlMsk.DFC_IVCtlTiDiff_3_C "DFC/Verhaltens Kontroll Maske für Prüfung DFC_IVCtlTiDiff_3" VALUE 0x8002320C Val_Wu16 65535.00 DFES_OneToOne 0.00 65535.00 /end CHARACTERISTIC
/begin CHARACTERISTIC DFC_CtlMsk.DFC_IVCtlTiDiff_4_C "DFC/Verhaltens Kontroll Maske für Prüfung DFC_IVCtlTiDiff_4" VALUE 0x8002320E Val_Wu16 65535.00 DFES_OneToOne 0.00 65535.00 /end CHARACTERISTIC
/begin CHARACTERISTIC DFC_CtlMsk.DFC_IVCtlTiDiff_5_C "DFC/Verhaltens Kontroll Maske für Prüfung DFC_IVCtlTiDiff_5" VALUE 0x80023210 Val_Wu16 65535.00 DFES_OneToOne 0.00 65535.00 /end CHARACTERISTIC
/begin CHARACTERISTIC DFC_CtlMsk.DFC_IVCtlUDiffUp_0_C "DFC/Verhaltens Kontroll Maske für Prüfung DFC_IVCtlUDiffUp_0" VALUE 0x80023212 Val_Wu16 65535.00 DFES_OneToOne 0.00 65535.00 /end CHARACTERISTIC
/begin CHARACTERISTIC DFC_CtlMsk.DFC_IVCtlUDiffUp_1_C "DFC/Verhaltens Kontroll Maske für Prüfung DFC_IVCtlUDiffUp_1" VALUE 0x80023214 Val_Wu16 65535.00 DFES_OneToOne 0.00 65535.00 /end CHARACTERISTIC
/begin CHARACTERISTIC DFC_CtlMsk.DFC_IVCtlUDiffUp_2_C "DFC/Verhaltens Kontroll Maske für Prüfung DFC_IVCtlUDiffUp_2" VALUE 0x80023216 Val_Wu16 65535.00 DFES_OneToOne 0.00 65535.00 /end CHARACTERISTIC
/begin CHARACTERISTIC DFC_CtlMsk.DFC_IVCtlUDiffUp_3_C "DFC/Verhaltens Kontroll Maske für Prüfung DFC_IVCtlUDiffUp_3" VALUE 0x80023218 Val_Wu16 65535.00 DFES_OneToOne 0.00 65535.00 /end CHARACTERISTIC
/begin CHARACTERISTIC DFC_CtlMsk.DFC_IVCtlUDiffUp_4_C "DFC/Verhaltens Kontroll Maske für Prüfung DFC_IVCtlUDiffUp_4" VALUE 0x8002321A Val_Wu16 65535.00 DFES_OneToOne 0.00 65535.00 /end CHARACTERISTIC
/begin CHARACTERISTIC DFC_CtlMsk.DFC_IVCtlUDiffUp_5_C "DFC/Verhaltens Kontroll Maske für Prüfung DFC_IVCtlUDiffUp_5" VALUE 0x8002321C Val_Wu16 65535.00 DFES_OneToOne 0.00 65535.00 /end CHARACTERISTIC
/begin CHARACTERISTIC DFC_CtlMsk.DFC_IVCtlUUp_0_C "DFC/Verhaltens Kontroll Maske für Prüfung DFC_IVCtlUUp_0" VALUE 0x8002321E Val_Wu16 65535.00 DFES_OneToOne 0.00 65535.00 /end CHARACTERISTIC
/begin CHARACTERISTIC DFC_CtlMsk.DFC_IVCtlUUp_1_C "DFC/Verhaltens Kontroll Maske für Prüfung DFC_IVCtlUUp_1" VALUE 0x80023220 Val_Wu16 65535.00 DFES_OneToOne 0.00 65535.00 /end CHARACTERISTIC
/begin CHARACTERISTIC DFC_CtlMsk.DFC_IVCtlUUp_2_C "DFC/Verhaltens Kontroll Maske für Prüfung DFC_IVCtlUUp_2" VALUE 0x80023222 Val_Wu16 65535.00 DFES_OneToOne 0.00 65535.00 /end CHARACTERISTIC
/begin CHARACTERISTIC DFC_CtlMsk.DFC_IVCtlUUp_3_C "DFC/Verhaltens Kontroll Maske für Prüfung DFC_IVCtlUUp_3" VALUE 0x80023224 Val_Wu16 65535.00 DFES_OneToOne 0.00 65535.00 /end CHARACTERISTIC
/begin CHARACTERISTIC DFC_CtlMsk.DFC_IVCtlUUp_4_C "DFC/Verhaltens Kontroll Maske für Prüfung DFC_IVCtlUUp_4" VALUE 0x80023226 Val_Wu16 65535.00 DFES_OneToOne 0.00 65535.00 /end CHARACTERISTIC
/begin CHARACTERISTIC DFC_CtlMsk.DFC_IVCtlUUp_5_C "DFC/Verhaltens Kontroll Maske für Prüfung DFC_IVCtlUUp_5" VALUE 0x80023228 Val_Wu16 65535.00 DFES_OneToOne 0.00 65535.00 /end CHARACTERISTIC
/begin CHARACTERISTIC DFC_CtlMsk.DFC_IVDiaBnkShCir_0_C "DFC/Verhaltens Kontroll Maske für Prüfung DFC_IVDiaBnkShCir_0" VALUE 0x8002322A Val_Wu16 65535.00 DFES_OneToOne 0.00 65535.00 /end CHARACTERISTIC
/begin CHARACTERISTIC DFC_CtlMsk.DFC_IVDiaBnkShCir_1_C "DFC/Verhaltens Kontroll Maske für Prüfung DFC_IVDiaBnkShCir_1" VALUE 0x8002322C Val_Wu16 65535.00 DFES_OneToOne 0.00 65535.00 /end CHARACTERISTIC
/begin CHARACTERISTIC DFC_CtlMsk.DFC_IVDiaBnkShCirChSwt_0_C "DFC/Verhaltens Kontroll Maske für Prüfung DFC_IVDiaBnkShCirChSwt_0" VALUE 0x8002322E Val_Wu16 65535.00 DFES_OneToOne 0.00 65535.00 /end CHARACTERISTIC
/begin CHARACTERISTIC DFC_CtlMsk.DFC_IVDiaBnkShCirChSwt_1_C "DFC/Verhaltens Kontroll Maske für Prüfung DFC_IVDiaBnkShCirChSwt_1" VALUE 0x80023230 Val_Wu16 65535.00 DFES_OneToOne 0.00 65535.00 /end CHARACTERISTIC
/begin CHARACTERISTIC DFC_CtlMsk.DFC_IVDiaChp_0_C "DFC/Verhaltens Kontroll Maske für Prüfung DFC_IVDiaChp_0" VALUE 0x80023232 Val_Wu16 65535.00 DFES_OneToOne 0.00 65535.00 /end CHARACTERISTIC
/begin CHARACTERISTIC DFC_CtlMsk.DFC_IVDiaChp_1_C "DFC/Verhaltens Kontroll Maske für Prüfung DFC_IVDiaChp_1" VALUE 0x80023234 Val_Wu16 65535.00 DFES_OneToOne 0.00 65535.00 /end CHARACTERISTIC
/begin CHARACTERISTIC DFC_CtlMsk.DFC_IVDiaCylNoCls_0_C "DFC/Verhaltens Kontroll Maske für Prüfung DFC_IVDiaCylNoCls_0" VALUE 0x80023236 Val_Wu16 65535.00 DFES_OneToOne 0.00 65535.00 /end CHARACTERISTIC
/begin CHARACTERISTIC DFC_CtlMsk.DFC_IVDiaCylNoCls_1_C "DFC/Verhaltens Kontroll Maske für Prüfung DFC_IVDiaCylNoCls_1" VALUE 0x80023238 Val_Wu16 65535.00 DFES_OneToOne 0.00 65535.00 /end CHARACTERISTIC
/begin CHARACTERISTIC DFC_CtlMsk.DFC_IVDiaCylNoCls_2_C "DFC/Verhaltens Kontroll Maske für Prüfung DFC_IVDiaCylNoCls_2" VALUE 0x8002323A Val_Wu16 65535.00 DFES_OneToOne 0.00 65535.00 /end CHARACTERISTIC
/begin CHARACTERISTIC DFC_CtlMsk.DFC_IVDiaCylNoCls_3_C "DFC/Verhaltens Kontroll Maske für Prüfung DFC_IVDiaCylNoCls_3" VALUE 0x8002323C Val_Wu16 65535.00 DFES_OneToOne 0.00 65535.00 /end CHARACTERISTIC
/begin CHARACTERISTIC DFC_CtlMsk.DFC_IVDiaCylNoCls_4_C "DFC/Verhaltens Kontroll Maske für Prüfung DFC_IVDiaCylNoCls_4" VALUE 0x8002323E Val_Wu16 65535.00 DFES_OneToOne 0.00 65535.00 /end CHARACTERISTIC
/begin CHARACTERISTIC DFC_CtlMsk.DFC_IVDiaCylNoCls_5_C "DFC/Verhaltens Kontroll Maske für Prüfung DFC_IVDiaCylNoCls_5" VALUE 0x80023240 Val_Wu16 65535.00 DFES_OneToOne 0.00 65535.00 /end CHARACTERISTIC
/begin CHARACTERISTIC DFC_CtlMsk.DFC_IVDiaCylNoLd_0_C "DFC/Verhaltens Kontroll Maske für Prüfung DFC_IVDiaCylNoLd_0" VALUE 0x80023242 Val_Wu16 65535.00 DFES_OneToOne 0.00 65535.00 /end CHARACTERISTIC
/begin CHARACTERISTIC DFC_CtlMsk.DFC_IVDiaCylNoLd_1_C "DFC/Verhaltens Kontroll Maske für Prüfung DFC_IVDiaCylNoLd_1" VALUE 0x80023244 Val_Wu16 65535.00 DFES_OneToOne 0.00 65535.00 /end CHARACTERISTIC
/begin CHARACTERISTIC DFC_CtlMsk.DFC_IVDiaCylNoLd_2_C "DFC/Verhaltens Kontroll Maske für Prüfung DFC_IVDiaCylNoLd_2" VALUE 0x80023246 Val_Wu16 65535.00 DFES_OneToOne 0.00 65535.00 /end CHARACTERISTIC
/begin CHARACTERISTIC DFC_CtlMsk.DFC_IVDiaCylNoLd_3_C "DFC/Verhaltens Kontroll Maske für Prüfung DFC_IVDiaCylNoLd_3" VALUE 0x80023248 Val_Wu16 65535.00 DFES_OneToOne 0.00 65535.00 /end CHARACTERISTIC
/begin CHARACTERISTIC DFC_CtlMsk.DFC_IVDiaCylNoLd_4_C "DFC/Verhaltens Kontroll Maske für Prüfung DFC_IVDiaCylNoLd_4" VALUE 0x8002324A Val_Wu16 65535.00 DFES_OneToOne 0.00 65535.00 /end CHARACTERISTIC
/begin CHARACTERISTIC DFC_CtlMsk.DFC_IVDiaCylNoLd_5_C "DFC/Verhaltens Kontroll Maske für Prüfung DFC_IVDiaCylNoLd_5" VALUE 0x8002324C Val_Wu16 65535.00 DFES_OneToOne 0.00 65535.00 /end CHARACTERISTIC
/begin CHARACTERISTIC DFC_CtlMsk.DFC_IVDiaCylShCir_0_C "DFC/Verhaltens Kontroll Maske für Prüfung DFC_IVDiaCylShCir_0" VALUE 0x8002324E Val_Wu16 65535.00 DFES_OneToOne 0.00 65535.00 /end CHARACTERISTIC
/begin CHARACTERISTIC DFC_CtlMsk.DFC_IVDiaCylShCir_1_C "DFC/Verhaltens Kontroll Maske für Prüfung DFC_IVDiaCylShCir_1" VALUE 0x80023250 Val_Wu16 65535.00 DFES_OneToOne 0.00 65535.00 /end CHARACTERISTIC
/begin CHARACTERISTIC DFC_CtlMsk.DFC_IVDiaCylShCir_2_C "DFC/Verhaltens Kontroll Maske für Prüfung DFC_IVDiaCylShCir_2" VALUE 0x80023252 Val_Wu16 65535.00 DFES_OneToOne 0.00 65535.00 /end CHARACTERISTIC
/begin CHARACTERISTIC DFC_CtlMsk.DFC_IVDiaCylShCir_3_C "DFC/Verhaltens Kontroll Maske für Prüfung DFC_IVDiaCylShCir_3" VALUE 0x80023254 Val_Wu16 65535.00 DFES_OneToOne 0.00 65535.00 /end CHARACTERISTIC
/begin CHARACTERISTIC DFC_CtlMsk.DFC_IVDiaCylShCir_4_C "DFC/Verhaltens Kontroll Maske für Prüfung DFC_IVDiaCylShCir_4" VALUE 0x80023256 Val_Wu16 65535.00 DFES_OneToOne 0.00 65535.00 /end CHARACTERISTIC
/begin CHARACTERISTIC DFC_CtlMsk.DFC_IVDiaCylShCir_5_C "DFC/Verhaltens Kontroll Maske für Prüfung DFC_IVDiaCylShCir_5" VALUE 0x80023258 Val_Wu16 65535.00 DFES_OneToOne 0.00 65535.00 /end CHARACTERISTIC
/begin CHARACTERISTIC DFC_CtlMsk.DFC_IVDiaCylShCirHSLS_0_C "DFC/Verhaltens Kontroll Maske für Prüfung DFC_IVDiaCylShCirHSLS_0" VALUE 0x8002325A Val_Wu16 65535.00 DFES_OneToOne 0.00 65535.00 /end CHARACTERISTIC
/begin CHARACTERISTIC DFC_CtlMsk.DFC_IVDiaCylShCirHSLS_1_C "DFC/Verhaltens Kontroll Maske für Prüfung DFC_IVDiaCylShCirHSLS_1" VALUE 0x8002325C Val_Wu16 65535.00 DFES_OneToOne 0.00 65535.00 /end CHARACTERISTIC
/begin CHARACTERISTIC DFC_CtlMsk.DFC_IVDiaCylShCirHSLS_2_C "DFC/Verhaltens Kontroll Maske für Prüfung DFC_IVDiaCylShCirHSLS_2" VALUE 0x8002325E Val_Wu16 65535.00 DFES_OneToOne 0.00 65535.00 /end CHARACTERISTIC
/begin CHARACTERISTIC DFC_CtlMsk.DFC_IVDiaCylShCirHSLS_3_C "DFC/Verhaltens Kontroll Maske für Prüfung DFC_IVDiaCylShCirHSLS_3" VALUE 0x80023260 Val_Wu16 65535.00 DFES_OneToOne 0.00 65535.00 /end CHARACTERISTIC
/begin CHARACTERISTIC DFC_CtlMsk.DFC_IVDiaCylShCirHSLS_4_C "DFC/Verhaltens Kontroll Maske für Prüfung DFC_IVDiaCylShCirHSLS_4" VALUE 0x80023262 Val_Wu16 65535.00 DFES_OneToOne 0.00 65535.00 /end CHARACTERISTIC
/begin CHARACTERISTIC DFC_CtlMsk.DFC_IVDiaCylShCirHSLS_5_C "DFC/Verhaltens Kontroll Maske für Prüfung DFC_IVDiaCylShCirHSLS_5" VALUE 0x80023264 Val_Wu16 65535.00 DFES_OneToOne 0.00 65535.00 /end CHARACTERISTIC
/begin CHARACTERISTIC DFC_CtlMsk.DFC_IVDiaCylShCirMeas_0_C "DFC/Verhaltens Kontroll Maske für Prüfung DFC_IVDiaCylShCirMeas_0" VALUE 0x80023266 Val_Wu16 65535.00 DFES_OneToOne 0.00 65535.00 /end CHARACTERISTIC
/begin CHARACTERISTIC DFC_CtlMsk.DFC_IVDiaCylShCirMeas_1_C "DFC/Verhaltens Kontroll Maske für Prüfung DFC_IVDiaCylShCirMeas_1" VALUE 0x80023268 Val_Wu16 65535.00 DFES_OneToOne 0.00 65535.00 /end CHARACTERISTIC
/begin CHARACTERISTIC DFC_CtlMsk.DFC_IVDiaCylShCirMeas_2_C "DFC/Verhaltens Kontroll Maske für Prüfung DFC_IVDiaCylShCirMeas_2" VALUE 0x8002326A Val_Wu16 65535.00 DFES_OneToOne 0.00 65535.00 /end CHARACTERISTIC
/begin CHARACTERISTIC DFC_CtlMsk.DFC_IVDiaCylShCirMeas_3_C "DFC/Verhaltens Kontroll Maske für Prüfung DFC_IVDiaCylShCirMeas_3" VALUE 0x8002326C Val_Wu16 65535.00 DFES_OneToOne 0.00 65535.00 /end CHARACTERISTIC
/begin CHARACTERISTIC DFC_CtlMsk.DFC_IVDiaCylShCirMeas_4_C "DFC/Verhaltens Kontroll Maske für Prüfung DFC_IVDiaCylShCirMeas_4" VALUE 0x8002326E Val_Wu16 65535.00 DFES_OneToOne 0.00 65535.00 /end CHARACTERISTIC
/begin CHARACTERISTIC DFC_CtlMsk.DFC_IVDiaCylShCirMeas_5_C "DFC/Verhaltens Kontroll Maske für Prüfung DFC_IVDiaCylShCirMeas_5" VALUE 0x80023270 Val_Wu16 65535.00 DFES_OneToOne 0.00 65535.00 /end CHARACTERISTIC
/begin CHARACTERISTIC DFC_CtlMsk.DFC_LSUDynChk_C "DFC/Verhaltens Kontroll Maske für Prüfung DFC_LSUDynChk" VALUE 0x80023272 Val_Wu16 65535.00 DFES_OneToOne 0.00 65535.00 /end CHARACTERISTIC
/begin CHARACTERISTIC DFC_CtlMsk.DFC_LSUO2ClbMax_C "DFC/Verhaltens Kontroll Maske für Prüfung DFC_LSUO2ClbMax" VALUE 0x80023274 Val_Wu16 65535.00 DFES_OneToOne 0.00 65535.00 /end CHARACTERISTIC
/begin CHARACTERISTIC DFC_CtlMsk.DFC_LSUO2ClbMin_C "DFC/Verhaltens Kontroll Maske für Prüfung DFC_LSUO2ClbMin" VALUE 0x80023276 Val_Wu16 65535.00 DFES_OneToOne 0.00 65535.00 /end CHARACTERISTIC
/begin CHARACTERISTIC DFC_CtlMsk.DFC_LSUO2PlausMaxFLd_C "DFC/Verhaltens Kontroll Maske für Prüfung DFC_LSUO2PlausMaxFLd" VALUE 0x80023278 Val_Wu16 65535.00 DFES_OneToOne 0.00 65535.00 /end CHARACTERISTIC
/begin CHARACTERISTIC DFC_CtlMsk.DFC_LSUO2PlausMaxOvrRun_C "DFC/Verhaltens Kontroll Maske für Prüfung DFC_LSUO2PlausMaxOvrRun" VALUE 0x8002327A Val_Wu16 65535.00 DFES_OneToOne 0.00 65535.00 /end CHARACTERISTIC
/begin CHARACTERISTIC DFC_CtlMsk.DFC_LSUO2PlausMaxPartLd_C "DFC/Verhaltens Kontroll Maske für Prüfung DFC_LSUO2PlausMaxPartLd" VALUE 0x8002327C Val_Wu16 65535.00 DFES_OneToOne 0.00 65535.00 /end CHARACTERISTIC
/begin CHARACTERISTIC DFC_CtlMsk.DFC_LSUO2PlausMinFLd_C "DFC/Verhaltens Kontroll Maske für Prüfung DFC_LSUO2PlausMinFLd" VALUE 0x8002327E Val_Wu16 65535.00 DFES_OneToOne 0.00 65535.00 /end CHARACTERISTIC
/begin CHARACTERISTIC DFC_CtlMsk.DFC_LSUO2PlausMinOvrRun_C "DFC/Verhaltens Kontroll Maske für Prüfung DFC_LSUO2PlausMinOvrRun" VALUE 0x80023280 Val_Wu16 65535.00 DFES_OneToOne 0.00 65535.00 /end CHARACTERISTIC
/begin CHARACTERISTIC DFC_CtlMsk.DFC_LSUO2PlausMinPartLd_C "DFC/Verhaltens Kontroll Maske für Prüfung DFC_LSUO2PlausMinPartLd" VALUE 0x80023282 Val_Wu16 65535.00 DFES_OneToOne 0.00 65535.00 /end CHARACTERISTIC
/begin CHARACTERISTIC DFC_CtlMsk.DFC_LSURiClbMax_C "DFC/Verhaltens Kontroll Maske für Prüfung DFC_LSURiClbMax" VALUE 0x80023284 Val_Wu16 65535.00 DFES_OneToOne 0.00 65535.00 /end CHARACTERISTIC
/begin CHARACTERISTIC DFC_CtlMsk.DFC_LSURiClbMin_C "DFC/Verhaltens Kontroll Maske für Prüfung DFC_LSURiClbMin" VALUE 0x80023286 Val_Wu16 65535.00 DFES_OneToOne 0.00 65535.00 /end CHARACTERISTIC
/begin CHARACTERISTIC DFC_CtlMsk.DFC_LSUWireIPSig_C "DFC/Verhaltens Kontroll Maske für Prüfung DFC_LSUWireIPSig" VALUE 0x80023288 Val_Wu16 65535.00 DFES_OneToOne 0.00 65535.00 /end CHARACTERISTIC
/begin CHARACTERISTIC DFC_CtlMsk.DFC_Layer_BSDMax_C "DFC/Verhaltens Kontroll Maske für Prüfung DFC_Layer_BSDMax" VALUE 0x8002328A Val_Wu16 65535.00 DFES_OneToOne 0.00 65535.00 /end CHARACTERISTIC
/begin CHARACTERISTIC DFC_CtlMsk.DFC_Layer_BSDMin_C "DFC/Verhaltens Kontroll Maske für Prüfung DFC_Layer_BSDMin" VALUE 0x8002328C Val_Wu16 65535.00 DFES_OneToOne 0.00 65535.00 /end CHARACTERISTIC
/begin CHARACTERISTIC DFC_CtlMsk.DFC_Layer_BSDNpl_C "DFC/Verhaltens Kontroll Maske für Prüfung DFC_Layer_BSDNpl" VALUE 0x8002328E Val_Wu16 65535.00 DFES_OneToOne 0.00 65535.00 /end CHARACTERISTIC
/begin CHARACTERISTIC DFC_CtlMsk.DFC_Layer_BSDSig_C "DFC/Verhaltens Kontroll Maske für Prüfung DFC_Layer_BSDSig" VALUE 0x80023290 Val_Wu16 65535.00 DFES_OneToOne 0.00 65535.00 /end CHARACTERISTIC
/begin CHARACTERISTIC DFC_CtlMsk.DFC_Layer_FltMngTstMax_C "DFC/Verhaltens Kontroll Maske für Prüfung DFC_Layer_FltMngTstMax" VALUE 0x80023292 Val_Wu16 65535.00 DFES_OneToOne 0.00 65535.00 /end CHARACTERISTIC
/begin CHARACTERISTIC DFC_CtlMsk.DFC_Layer_FltMngTstMin_C "DFC/Verhaltens Kontroll Maske für Prüfung DFC_Layer_FltMngTstMin" VALUE 0x80023294 Val_Wu16 65535.00 DFES_OneToOne 0.00 65535.00 /end CHARACTERISTIC
/begin CHARACTERISTIC DFC_CtlMsk.DFC_Layer_FltMngTstNpl_C "DFC/Verhaltens Kontroll Maske für Prüfung DFC_Layer_FltMngTstNpl" VALUE 0x80023296 Val_Wu16 65535.00 DFES_OneToOne 0.00 65535.00 /end CHARACTERISTIC
/begin CHARACTERISTIC DFC_CtlMsk.DFC_Layer_FltMngTstSig_C "DFC/Verhaltens Kontroll Maske für Prüfung DFC_Layer_FltMngTstSig" VALUE 0x80023298 Val_Wu16 65535.00 DFES_OneToOne 0.00 65535.00 /end CHARACTERISTIC
/begin CHARACTERISTIC DFC_CtlMsk.DFC_Layer_GENELBMax_C "DFC/Verhaltens Kontroll Maske für Prüfung DFC_Layer_GENELBMax" VALUE 0x8002329A Val_Wu16 65535.00 DFES_OneToOne 0.00 65535.00 /end CHARACTERISTIC
/begin CHARACTERISTIC DFC_CtlMsk.DFC_Layer_GENELBMin_C "DFC/Verhaltens Kontroll Maske für Prüfung DFC_Layer_GENELBMin" VALUE 0x8002329C Val_Wu16 65535.00 DFES_OneToOne 0.00 65535.00 /end CHARACTERISTIC
/begin CHARACTERISTIC DFC_CtlMsk.DFC_Layer_GENELBNpl_C "DFC/Verhaltens Kontroll Maske für Prüfung DFC_Layer_GENELBNpl" VALUE 0x8002329E Val_Wu16 65535.00 DFES_OneToOne 0.00 65535.00 /end CHARACTERISTIC
/begin CHARACTERISTIC DFC_CtlMsk.DFC_Layer_GENELBSig_C "DFC/Verhaltens Kontroll Maske für Prüfung DFC_Layer_GENELBSig" VALUE 0x800232A0 Val_Wu16 65535.00 DFES_OneToOne 0.00 65535.00 /end CHARACTERISTIC
/begin CHARACTERISTIC DFC_CtlMsk.DFC_Layer_GENELMax_C "DFC/Verhaltens Kontroll Maske für Prüfung DFC_Layer_GENELMax" VALUE 0x800232A2 Val_Wu16 65535.00 DFES_OneToOne 0.00 65535.00 /end CHARACTERISTIC
/begin CHARACTERISTIC DFC_CtlMsk.DFC_Layer_GENELMin_C "DFC/Verhaltens Kontroll Maske für Prüfung DFC_Layer_GENELMin" VALUE 0x800232A4 Val_Wu16 65535.00 DFES_OneToOne 0.00 65535.00 /end CHARACTERISTIC
/begin CHARACTERISTIC DFC_CtlMsk.DFC_Layer_GENELNpl_C "DFC/Verhaltens Kontroll Maske für Prüfung DFC_Layer_GENELNpl" VALUE 0x800232A6 Val_Wu16 65535.00 DFES_OneToOne 0.00 65535.00 /end CHARACTERISTIC
/begin CHARACTERISTIC DFC_CtlMsk.DFC_Layer_GENELSig_C "DFC/Verhaltens Kontroll Maske für Prüfung DFC_Layer_GENELSig" VALUE 0x800232A8 Val_Wu16 65535.00 DFES_OneToOne 0.00 65535.00 /end CHARACTERISTIC
/begin CHARACTERISTIC DFC_CtlMsk.DFC_Layer_GENHTBMax_C "DFC/Verhaltens Kontroll Maske für Prüfung DFC_Layer_GENHTBMax" VALUE 0x800232AA Val_Wu16 65535.00 DFES_OneToOne 0.00 65535.00 /end CHARACTERISTIC
/begin CHARACTERISTIC DFC_CtlMsk.DFC_Layer_GENHTBMin_C "DFC/Verhaltens Kontroll Maske für Prüfung DFC_Layer_GENHTBMin" VALUE 0x800232AC Val_Wu16 65535.00 DFES_OneToOne 0.00 65535.00 /end CHARACTERISTIC
/begin CHARACTERISTIC DFC_CtlMsk.DFC_Layer_GENHTBNpl_C "DFC/Verhaltens Kontroll Maske für Prüfung DFC_Layer_GENHTBNpl" VALUE 0x800232AE Val_Wu16 65535.00 DFES_OneToOne 0.00 65535.00 /end CHARACTERISTIC
/begin CHARACTERISTIC DFC_CtlMsk.DFC_Layer_GENHTBSig_C "DFC/Verhaltens Kontroll Maske für Prüfung DFC_Layer_GENHTBSig" VALUE 0x800232B0 Val_Wu16 65535.00 DFES_OneToOne 0.00 65535.00 /end CHARACTERISTIC
/begin CHARACTERISTIC DFC_CtlMsk.DFC_Layer_GENHTMax_C "DFC/Verhaltens Kontroll Maske für Prüfung DFC_Layer_GENHTMax" VALUE 0x800232B2 Val_Wu16 65535.00 DFES_OneToOne 0.00 65535.00 /end CHARACTERISTIC
/begin CHARACTERISTIC DFC_CtlMsk.DFC_Layer_GENHTMin_C "DFC/Verhaltens Kontroll Maske für Prüfung DFC_Layer_GENHTMin" VALUE 0x800232B4 Val_Wu16 65535.00 DFES_OneToOne 0.00 65535.00 /end CHARACTERISTIC
/begin CHARACTERISTIC DFC_CtlMsk.DFC_Layer_GENHTNpl_C "DFC/Verhaltens Kontroll Maske für Prüfung DFC_Layer_GENHTNpl" VALUE 0x800232B6 Val_Wu16 65535.00 DFES_OneToOne 0.00 65535.00 /end CHARACTERISTIC
/begin CHARACTERISTIC DFC_CtlMsk.DFC_Layer_GENHTSig_C "DFC/Verhaltens Kontroll Maske für Prüfung DFC_Layer_GENHTSig" VALUE 0x800232B8 Val_Wu16 65535.00 DFES_OneToOne 0.00 65535.00 /end CHARACTERISTIC
/begin CHARACTERISTIC DFC_CtlMsk.DFC_Layer_GENKOMMMax_C "DFC/Verhaltens Kontroll Maske für Prüfung DFC_Layer_GENKOMMMax" VALUE 0x800232BA Val_Wu16 65535.00 DFES_OneToOne 0.00 65535.00 /end CHARACTERISTIC
/begin CHARACTERISTIC DFC_CtlMsk.DFC_Layer_GENKOMMMin_C "DFC/Verhaltens Kontroll Maske für Prüfung DFC_Layer_GENKOMMMin" VALUE 0x800232BC Val_Wu16 65535.00 DFES_OneToOne 0.00 65535.00 /end CHARACTERISTIC
/begin CHARACTERISTIC DFC_CtlMsk.DFC_Layer_GENKOMMNpl_C "DFC/Verhaltens Kontroll Maske für Prüfung DFC_Layer_GENKOMMNpl" VALUE 0x800232BE Val_Wu16 65535.00 DFES_OneToOne 0.00 65535.00 /end CHARACTERISTIC
/begin CHARACTERISTIC DFC_CtlMsk.DFC_Layer_GENKOMMSig_C "DFC/Verhaltens Kontroll Maske für Prüfung DFC_Layer_GENKOMMSig" VALUE 0x800232C0 Val_Wu16 65535.00 DFES_OneToOne 0.00 65535.00 /end CHARACTERISTIC
/begin CHARACTERISTIC DFC_CtlMsk.DFC_Layer_GENMECHMax_C "DFC/Verhaltens Kontroll Maske für Prüfung DFC_Layer_GENMECHMax" VALUE 0x800232C2 Val_Wu16 65535.00 DFES_OneToOne 0.00 65535.00 /end CHARACTERISTIC
/begin CHARACTERISTIC DFC_CtlMsk.DFC_Layer_GENMECHMin_C "DFC/Verhaltens Kontroll Maske für Prüfung DFC_Layer_GENMECHMin" VALUE 0x800232C4 Val_Wu16 65535.00 DFES_OneToOne 0.00 65535.00 /end CHARACTERISTIC
/begin CHARACTERISTIC DFC_CtlMsk.DFC_Layer_GENMECHNpl_C "DFC/Verhaltens Kontroll Maske für Prüfung DFC_Layer_GENMECHNpl" VALUE 0x800232C6 Val_Wu16 65535.00 DFES_OneToOne 0.00 65535.00 /end CHARACTERISTIC
/begin CHARACTERISTIC DFC_CtlMsk.DFC_Layer_GENMECHSig_C "DFC/Verhaltens Kontroll Maske für Prüfung DFC_Layer_GENMECHSig" VALUE 0x800232C8 Val_Wu16 65535.00 DFES_OneToOne 0.00 65535.00 /end CHARACTERISTIC
/begin CHARACTERISTIC DFC_CtlMsk.DFC_Layer_GENMax_C "DFC/Verhaltens Kontroll Maske für Prüfung DFC_Layer_GENMax" VALUE 0x800232CA Val_Wu16 65535.00 DFES_OneToOne 0.00 65535.00 /end CHARACTERISTIC
/begin CHARACTERISTIC DFC_CtlMsk.DFC_Layer_GENMin_C "DFC/Verhaltens Kontroll Maske für Prüfung DFC_Layer_GENMin" VALUE 0x800232CC Val_Wu16 65535.00 DFES_OneToOne 0.00 65535.00 /end CHARACTERISTIC
/begin CHARACTERISTIC DFC_CtlMsk.DFC_Layer_GENNpl_C "DFC/Verhaltens Kontroll Maske für Prüfung DFC_Layer_GENNpl" VALUE 0x800232CE Val_Wu16 65535.00 DFES_OneToOne 0.00 65535.00 /end CHARACTERISTIC
/begin CHARACTERISTIC DFC_CtlMsk.DFC_Layer_GENREGUPLMax_C "DFC/Verhaltens Kontroll Maske für Prüfung DFC_Layer_GENREGUPLMax" VALUE 0x800232D0 Val_Wu16 65535.00 DFES_OneToOne 0.00 65535.00 /end CHARACTERISTIC
/begin CHARACTERISTIC DFC_CtlMsk.DFC_Layer_GENREGUPLMin_C "DFC/Verhaltens Kontroll Maske für Prüfung DFC_Layer_GENREGUPLMin" VALUE 0x800232D2 Val_Wu16 65535.00 DFES_OneToOne 0.00 65535.00 /end CHARACTERISTIC
/begin CHARACTERISTIC DFC_CtlMsk.DFC_Layer_GENREGUPLNpl_C "DFC/Verhaltens Kontroll Maske für Prüfung DFC_Layer_GENREGUPLNpl" VALUE 0x800232D4 Val_Wu16 65535.00 DFES_OneToOne 0.00 65535.00 /end CHARACTERISTIC
/begin CHARACTERISTIC DFC_CtlMsk.DFC_Layer_GENREGUPLSig_C "DFC/Verhaltens Kontroll Maske für Prüfung DFC_Layer_GENREGUPLSig" VALUE 0x800232D6 Val_Wu16 65535.00 DFES_OneToOne 0.00 65535.00 /end CHARACTERISTIC
/begin CHARACTERISTIC DFC_CtlMsk.DFC_Layer_GENSig_C "DFC/Verhaltens Kontroll Maske für Prüfung DFC_Layer_GENSig" VALUE 0x800232D8 Val_Wu16 65535.00 DFES_OneToOne 0.00 65535.00 /end CHARACTERISTIC
/begin CHARACTERISTIC DFC_CtlMsk.DFC_Layer_GENUPLMax_C "DFC/Verhaltens Kontroll Maske für Prüfung DFC_Layer_GENUPLMax" VALUE 0x800232DA Val_Wu16 65535.00 DFES_OneToOne 0.00 65535.00 /end CHARACTERISTIC
/begin CHARACTERISTIC DFC_CtlMsk.DFC_Layer_GENUPLMin_C "DFC/Verhaltens Kontroll Maske für Prüfung DFC_Layer_GENUPLMin" VALUE 0x800232DC Val_Wu16 65535.00 DFES_OneToOne 0.00 65535.00 /end CHARACTERISTIC
/begin CHARACTERISTIC DFC_CtlMsk.DFC_Layer_GENUPLNpl_C "DFC/Verhaltens Kontroll Maske für Prüfung DFC_Layer_GENUPLNpl" VALUE 0x800232DE Val_Wu16 65535.00 DFES_OneToOne 0.00 65535.00 /end CHARACTERISTIC
/begin CHARACTERISTIC DFC_CtlMsk.DFC_Layer_GENUPLSig_C "DFC/Verhaltens Kontroll Maske für Prüfung DFC_Layer_GENUPLSig" VALUE 0x800232E0 Val_Wu16 65535.00 DFES_OneToOne 0.00 65535.00 /end CHARACTERISTIC
/begin CHARACTERISTIC DFC_CtlMsk.DFC_Layer_IBS1Max_C "DFC/Verhaltens Kontroll Maske für Prüfung DFC_Layer_IBS1Max" VALUE 0x800232E2 Val_Wu16 65535.00 DFES_OneToOne 0.00 65535.00 /end CHARACTERISTIC
/begin CHARACTERISTIC DFC_CtlMsk.DFC_Layer_IBS1Min_C "DFC/Verhaltens Kontroll Maske für Prüfung DFC_Layer_IBS1Min" VALUE 0x800232E4 Val_Wu16 65535.00 DFES_OneToOne 0.00 65535.00 /end CHARACTERISTIC
/begin CHARACTERISTIC DFC_CtlMsk.DFC_Layer_IBS1Npl_C "DFC/Verhaltens Kontroll Maske für Prüfung DFC_Layer_IBS1Npl" VALUE 0x800232E6 Val_Wu16 65535.00 DFES_OneToOne 0.00 65535.00 /end CHARACTERISTIC
/begin CHARACTERISTIC DFC_CtlMsk.DFC_Layer_IBS1Sig_C "DFC/Verhaltens Kontroll Maske für Prüfung DFC_Layer_IBS1Sig" VALUE 0x800232E8 Val_Wu16 65535.00 DFES_OneToOne 0.00 65535.00 /end CHARACTERISTIC
/begin CHARACTERISTIC DFC_CtlMsk.DFC_Layer_IBS2Max_C "DFC/Verhaltens Kontroll Maske für Prüfung DFC_Layer_IBS2Max" VALUE 0x800232EA Val_Wu16 65535.00 DFES_OneToOne 0.00 65535.00 /end CHARACTERISTIC
/begin CHARACTERISTIC DFC_CtlMsk.DFC_Layer_IBS2Min_C "DFC/Verhaltens Kontroll Maske für Prüfung DFC_Layer_IBS2Min" VALUE 0x800232EC Val_Wu16 65535.00 DFES_OneToOne 0.00 65535.00 /end CHARACTERISTIC
/begin CHARACTERISTIC DFC_CtlMsk.DFC_Layer_IBS2Npl_C "DFC/Verhaltens Kontroll Maske für Prüfung DFC_Layer_IBS2Npl" VALUE 0x800232EE Val_Wu16 65535.00 DFES_OneToOne 0.00 65535.00 /end CHARACTERISTIC
/begin CHARACTERISTIC DFC_CtlMsk.DFC_Layer_IBS2Sig_C "DFC/Verhaltens Kontroll Maske für Prüfung DFC_Layer_IBS2Sig" VALUE 0x800232F0 Val_Wu16 65535.00 DFES_OneToOne 0.00 65535.00 /end CHARACTERISTIC
/begin CHARACTERISTIC DFC_CtlMsk.DFC_Layer_IBS3Max_C "DFC/Verhaltens Kontroll Maske für Prüfung DFC_Layer_IBS3Max" VALUE 0x800232F2 Val_Wu16 65535.00 DFES_OneToOne 0.00 65535.00 /end CHARACTERISTIC
/begin CHARACTERISTIC DFC_CtlMsk.DFC_Layer_IBS3Min_C "DFC/Verhaltens Kontroll Maske für Prüfung DFC_Layer_IBS3Min" VALUE 0x800232F4 Val_Wu16 65535.00 DFES_OneToOne 0.00 65535.00 /end CHARACTERISTIC
/begin CHARACTERISTIC DFC_CtlMsk.DFC_Layer_IBS3Npl_C "DFC/Verhaltens Kontroll Maske für Prüfung DFC_Layer_IBS3Npl" VALUE 0x800232F6 Val_Wu16 65535.00 DFES_OneToOne 0.00 65535.00 /end CHARACTERISTIC
/begin CHARACTERISTIC DFC_CtlMsk.DFC_Layer_IBS3Sig_C "DFC/Verhaltens Kontroll Maske für Prüfung DFC_Layer_IBS3Sig" VALUE 0x800232F8 Val_Wu16 65535.00 DFES_OneToOne 0.00 65535.00 /end CHARACTERISTIC
/begin CHARACTERISTIC DFC_CtlMsk.DFC_Layer_MANDETEKMax_C "DFC/Verhaltens Kontroll Maske für Prüfung DFC_Layer_MANDETEKMax" VALUE 0x800232FA Val_Wu16 65535.00 DFES_OneToOne 0.00 65535.00 /end CHARACTERISTIC
/begin CHARACTERISTIC DFC_CtlMsk.DFC_Layer_MANDETEKMin_C "DFC/Verhaltens Kontroll Maske für Prüfung DFC_Layer_MANDETEKMin" VALUE 0x800232FC Val_Wu16 65535.00 DFES_OneToOne 0.00 65535.00 /end CHARACTERISTIC
/begin CHARACTERISTIC DFC_CtlMsk.DFC_Layer_MANDETEKNpl_C "DFC/Verhaltens Kontroll Maske für Prüfung DFC_Layer_MANDETEKNpl" VALUE 0x800232FE Val_Wu16 65535.00 DFES_OneToOne 0.00 65535.00 /end CHARACTERISTIC
/begin CHARACTERISTIC DFC_CtlMsk.DFC_Layer_MANDETEKSig_C "DFC/Verhaltens Kontroll Maske für Prüfung DFC_Layer_MANDETEKSig" VALUE 0x80023300 Val_Wu16 65535.00 DFES_OneToOne 0.00 65535.00 /end CHARACTERISTIC
/begin CHARACTERISTIC DFC_CtlMsk.DFC_Layer_NDR1Max_C "DFC/Verhaltens Kontroll Maske für Prüfung DFC_Layer_NDR1Max" VALUE 0x80023302 Val_Wu16 65535.00 DFES_OneToOne 0.00 65535.00 /end CHARACTERISTIC
/begin CHARACTERISTIC DFC_CtlMsk.DFC_Layer_NDR1Min_C "DFC/Verhaltens Kontroll Maske für Prüfung DFC_Layer_NDR1Min" VALUE 0x80023304 Val_Wu16 65535.00 DFES_OneToOne 0.00 65535.00 /end CHARACTERISTIC
/begin CHARACTERISTIC DFC_CtlMsk.DFC_Layer_NDR1Npl_C "DFC/Verhaltens Kontroll Maske für Prüfung DFC_Layer_NDR1Npl" VALUE 0x80023306 Val_Wu16 65535.00 DFES_OneToOne 0.00 65535.00 /end CHARACTERISTIC
/begin CHARACTERISTIC DFC_CtlMsk.DFC_Layer_NDR1Sig_C "DFC/Verhaltens Kontroll Maske für Prüfung DFC_Layer_NDR1Sig" VALUE 0x80023308 Val_Wu16 65535.00 DFES_OneToOne 0.00 65535.00 /end CHARACTERISTIC
/begin CHARACTERISTIC DFC_CtlMsk.DFC_Layer_NDR2Max_C "DFC/Verhaltens Kontroll Maske für Prüfung DFC_Layer_NDR2Max" VALUE 0x8002330A Val_Wu16 65535.00 DFES_OneToOne 0.00 65535.00 /end CHARACTERISTIC
/begin CHARACTERISTIC DFC_CtlMsk.DFC_Layer_NDR2Min_C "DFC/Verhaltens Kontroll Maske für Prüfung DFC_Layer_NDR2Min" VALUE 0x8002330C Val_Wu16 65535.00 DFES_OneToOne 0.00 65535.00 /end CHARACTERISTIC
/begin CHARACTERISTIC DFC_CtlMsk.DFC_Layer_NDR2Npl_C "DFC/Verhaltens Kontroll Maske für Prüfung DFC_Layer_NDR2Npl" VALUE 0x8002330E Val_Wu16 65535.00 DFES_OneToOne 0.00 65535.00 /end CHARACTERISTIC
/begin CHARACTERISTIC DFC_CtlMsk.DFC_Layer_NDR2Sig_C "DFC/Verhaltens Kontroll Maske für Prüfung DFC_Layer_NDR2Sig" VALUE 0x80023310 Val_Wu16 65535.00 DFES_OneToOne 0.00 65535.00 /end CHARACTERISTIC
/begin CHARACTERISTIC DFC_CtlMsk.DFC_Layer_NGLERNMax_C "DFC/Verhaltens Kontroll Maske für Prüfung DFC_Layer_NGLERNMax" VALUE 0x80023312 Val_Wu16 65535.00 DFES_OneToOne 0.00 65535.00 /end CHARACTERISTIC
/begin CHARACTERISTIC DFC_CtlMsk.DFC_Layer_NGLERNMin_C "DFC/Verhaltens Kontroll Maske für Prüfung DFC_Layer_NGLERNMin" VALUE 0x80023314 Val_Wu16 65535.00 DFES_OneToOne 0.00 65535.00 /end CHARACTERISTIC
/begin CHARACTERISTIC DFC_CtlMsk.DFC_Layer_NGLERNNpl_C "DFC/Verhaltens Kontroll Maske für Prüfung DFC_Layer_NGLERNNpl" VALUE 0x80023316 Val_Wu16 65535.00 DFES_OneToOne 0.00 65535.00 /end CHARACTERISTIC
/begin CHARACTERISTIC DFC_CtlMsk.DFC_Layer_NGLERNSig_C "DFC/Verhaltens Kontroll Maske für Prüfung DFC_Layer_NGLERNSig" VALUE 0x80023318 Val_Wu16 65535.00 DFES_OneToOne 0.00 65535.00 /end CHARACTERISTIC
/begin CHARACTERISTIC DFC_CtlMsk.DFC_Layer_PMBATTMax_C "DFC/Verhaltens Kontroll Maske für Prüfung DFC_Layer_PMBATTMax" VALUE 0x8002331A Val_Wu16 65535.00 DFES_OneToOne 0.00 65535.00 /end CHARACTERISTIC
/begin CHARACTERISTIC DFC_CtlMsk.DFC_Layer_PMBATTMin_C "DFC/Verhaltens Kontroll Maske für Prüfung DFC_Layer_PMBATTMin" VALUE 0x8002331C Val_Wu16 65535.00 DFES_OneToOne 0.00 65535.00 /end CHARACTERISTIC
/begin CHARACTERISTIC DFC_CtlMsk.DFC_Layer_PMBATTNpl_C "DFC/Verhaltens Kontroll Maske für Prüfung DFC_Layer_PMBATTNpl" VALUE 0x8002331E Val_Wu16 65535.00 DFES_OneToOne 0.00 65535.00 /end CHARACTERISTIC
/begin CHARACTERISTIC DFC_CtlMsk.DFC_Layer_PMBATTSig_C "DFC/Verhaltens Kontroll Maske für Prüfung DFC_Layer_PMBATTSig" VALUE 0x80023320 Val_Wu16 65535.00 DFES_OneToOne 0.00 65535.00 /end CHARACTERISTIC
/begin CHARACTERISTIC DFC_CtlMsk.DFC_Layer_PMBNMax_C "DFC/Verhaltens Kontroll Maske für Prüfung DFC_Layer_PMBNMax" VALUE 0x80023322 Val_Wu16 65535.00 DFES_OneToOne 0.00 65535.00 /end CHARACTERISTIC
/begin CHARACTERISTIC DFC_CtlMsk.DFC_Layer_PMBNMin_C "DFC/Verhaltens Kontroll Maske für Prüfung DFC_Layer_PMBNMin" VALUE 0x80023324 Val_Wu16 65535.00 DFES_OneToOne 0.00 65535.00 /end CHARACTERISTIC
/begin CHARACTERISTIC DFC_CtlMsk.DFC_Layer_PMBNNpl_C "DFC/Verhaltens Kontroll Maske für Prüfung DFC_Layer_PMBNNpl" VALUE 0x80023326 Val_Wu16 65535.00 DFES_OneToOne 0.00 65535.00 /end CHARACTERISTIC
/begin CHARACTERISTIC DFC_CtlMsk.DFC_Layer_PMBNSig_C "DFC/Verhaltens Kontroll Maske für Prüfung DFC_Layer_PMBNSig" VALUE 0x80023328 Val_Wu16 65535.00 DFES_OneToOne 0.00 65535.00 /end CHARACTERISTIC
/begin CHARACTERISTIC DFC_CtlMsk.DFC_Layer_PMRUHVERLMax_C "DFC/Verhaltens Kontroll Maske für Prüfung DFC_Layer_PMRUHVERLMax" VALUE 0x8002332A Val_Wu16 65535.00 DFES_OneToOne 0.00 65535.00 /end CHARACTERISTIC
/begin CHARACTERISTIC DFC_CtlMsk.DFC_Layer_PMRUHVERLMin_C "DFC/Verhaltens Kontroll Maske für Prüfung DFC_Layer_PMRUHVERLMin" VALUE 0x8002332C Val_Wu16 65535.00 DFES_OneToOne 0.00 65535.00 /end CHARACTERISTIC
/begin CHARACTERISTIC DFC_CtlMsk.DFC_Layer_PMRUHVERLNpl_C "DFC/Verhaltens Kontroll Maske für Prüfung DFC_Layer_PMRUHVERLNpl" VALUE 0x8002332E Val_Wu16 65535.00 DFES_OneToOne 0.00 65535.00 /end CHARACTERISTIC
/begin CHARACTERISTIC DFC_CtlMsk.DFC_Layer_PMRUHVERLSig_C "DFC/Verhaltens Kontroll Maske für Prüfung DFC_Layer_PMRUHVERLSig" VALUE 0x80023330 Val_Wu16 65535.00 DFES_OneToOne 0.00 65535.00 /end CHARACTERISTIC
/begin CHARACTERISTIC DFC_CtlMsk.DFC_Layer_QLTMax_C "DFC/Verhaltens Kontroll Maske für Prüfung DFC_Layer_QLTMax" VALUE 0x80023332 Val_Wu16 65535.00 DFES_OneToOne 0.00 65535.00 /end CHARACTERISTIC
/begin CHARACTERISTIC DFC_CtlMsk.DFC_Layer_QLTMin_C "DFC/Verhaltens Kontroll Maske für Prüfung DFC_Layer_QLTMin" VALUE 0x80023334 Val_Wu16 65535.00 DFES_OneToOne 0.00 65535.00 /end CHARACTERISTIC
/begin CHARACTERISTIC DFC_CtlMsk.DFC_Layer_QLTNpl_C "DFC/Verhaltens Kontroll Maske für Prüfung DFC_Layer_QLTNpl" VALUE 0x80023336 Val_Wu16 65535.00 DFES_OneToOne 0.00 65535.00 /end CHARACTERISTIC
/begin CHARACTERISTIC DFC_CtlMsk.DFC_Layer_QLTSig_C "DFC/Verhaltens Kontroll Maske für Prüfung DFC_Layer_QLTSig" VALUE 0x80023338 Val_Wu16 65535.00 DFES_OneToOne 0.00 65535.00 /end CHARACTERISTIC
/begin CHARACTERISTIC DFC_CtlMsk.DFC_Layer_TOENSMax_C "DFC/Verhaltens Kontroll Maske für Prüfung DFC_Layer_TOENSMax" VALUE 0x8002333A Val_Wu16 65535.00 DFES_OneToOne 0.00 65535.00 /end CHARACTERISTIC
/begin CHARACTERISTIC DFC_CtlMsk.DFC_Layer_TOENSMin_C "DFC/Verhaltens Kontroll Maske für Prüfung DFC_Layer_TOENSMin" VALUE 0x8002333C Val_Wu16 65535.00 DFES_OneToOne 0.00 65535.00 /end CHARACTERISTIC
/begin CHARACTERISTIC DFC_CtlMsk.DFC_Layer_TOENSNpl_C "DFC/Verhaltens Kontroll Maske für Prüfung DFC_Layer_TOENSNpl" VALUE 0x8002333E Val_Wu16 65535.00 DFES_OneToOne 0.00 65535.00 /end CHARACTERISTIC
/begin CHARACTERISTIC DFC_CtlMsk.DFC_Layer_TOENSSig_C "DFC/Verhaltens Kontroll Maske für Prüfung DFC_Layer_TOENSSig" VALUE 0x80023340 Val_Wu16 65535.00 DFES_OneToOne 0.00 65535.00 /end CHARACTERISTIC
/begin CHARACTERISTIC DFC_CtlMsk.DFC_MonLimCurr_C "DFC/Verhaltens Kontroll Maske für Prüfung DFC_MonLimCurr" VALUE 0x80023342 Val_Wu16 65535.00 DFES_OneToOne 0.00 65535.00 /end CHARACTERISTIC
/begin CHARACTERISTIC DFC_CtlMsk.DFC_MonLimLead_C "DFC/Verhaltens Kontroll Maske für Prüfung DFC_MonLimLead" VALUE 0x80023344 Val_Wu16 65535.00 DFES_OneToOne 0.00 65535.00 /end CHARACTERISTIC
/begin CHARACTERISTIC DFC_CtlMsk.DFC_MonLimSet_C "DFC/Verhaltens Kontroll Maske für Prüfung DFC_MonLimSet" VALUE 0x80023346 Val_Wu16 65535.00 DFES_OneToOne 0.00 65535.00 /end CHARACTERISTIC
/begin CHARACTERISTIC DFC_CtlMsk.DFC_NSCDsNOxOfsMax_C "DFC/Verhaltens Kontroll Maske für Prüfung DFC_NSCDsNOxOfsMax" VALUE 0x80023348 Val_Wu16 65535.00 DFES_OneToOne 0.00 65535.00 /end CHARACTERISTIC
/begin CHARACTERISTIC DFC_CtlMsk.DFC_NSCDsNOxOfsMin_C "DFC/Verhaltens Kontroll Maske für Prüfung DFC_NSCDsNOxOfsMin" VALUE 0x8002334A Val_Wu16 65535.00 DFES_OneToOne 0.00 65535.00 /end CHARACTERISTIC
/begin CHARACTERISTIC DFC_CtlMsk.DFC_NSCDsNOxPlausMin_C "DFC/Verhaltens Kontroll Maske für Prüfung DFC_NSCDsNOxPlausMin" VALUE 0x8002334C Val_Wu16 65535.00 DFES_OneToOne 0.00 65535.00 /end CHARACTERISTIC
/begin CHARACTERISTIC DFC_CtlMsk.DFC_NoCat2DsNOxOfsMax_C "DFC/Verhaltens Kontroll Maske für Prüfung DFC_NoCat2DsNOxOfsMax" VALUE 0x8002334E Val_Wu16 65535.00 DFES_OneToOne 0.00 65535.00 /end CHARACTERISTIC
/begin CHARACTERISTIC DFC_CtlMsk.DFC_NoCat2DsNOxOfsMin_C "DFC/Verhaltens Kontroll Maske für Prüfung DFC_NoCat2DsNOxOfsMin" VALUE 0x80023350 Val_Wu16 65535.00 DFES_OneToOne 0.00 65535.00 /end CHARACTERISTIC
/begin CHARACTERISTIC DFC_CtlMsk.DFC_NoCat2DsNOxPlausMin_C "DFC/Verhaltens Kontroll Maske für Prüfung DFC_NoCat2DsNOxPlausMin" VALUE 0x80023352 Val_Wu16 65535.00 DFES_OneToOne 0.00 65535.00 /end CHARACTERISTIC
/begin CHARACTERISTIC DFC_CtlMsk.DFC_PCVNoStrt_C "DFC/Verhaltens Kontroll Maske für Prüfung DFC_PCVNoStrt" VALUE 0x80023354 Val_Wu16 65535.00 DFES_OneToOne 0.00 65535.00 /end CHARACTERISTIC
/begin CHARACTERISTIC DFC_CtlMsk.DFC_RailPGradMon_C "DFC/Verhaltens Kontroll Maske für Prüfung DFC_RailPGradMon" VALUE 0x80023356 Val_Wu16 65535.00 DFES_OneToOne 0.00 65535.00 /end CHARACTERISTIC
/begin CHARACTERISTIC DFC_CtlMsk.DFC_SCRPODPresBuildUp_C "DFC/Verhaltens Kontroll Maske für Prüfung DFC_SCRPODPresBuildUp" VALUE 0x80023358 Val_Wu16 65535.00 DFES_OneToOne 0.00 65535.00 /end CHARACTERISTIC
/begin CHARACTERISTIC DFC_CtlMsk.DFC_AFSDrftIdlAdjVal_C "DFC/Verhaltens Kontroll Maske für Prüfung DFC_AFSDrftIdlAdjVal" VALUE 0x8002335A Val_Wu16 65535.00 DFES_OneToOne 0.00 65535.00 /end CHARACTERISTIC
/begin CHARACTERISTIC DFC_CtlMsk.DFC_AFSDrftLdAdjVal_C "DFC/Verhaltens Kontroll Maske für Prüfung DFC_AFSDrftLdAdjVal" VALUE 0x8002335C Val_Wu16 65535.00 DFES_OneToOne 0.00 65535.00 /end CHARACTERISTIC
/begin CHARACTERISTIC DFC_CtlMsk.DFC_AdcIADC0Cal_C "DFC/Verhaltens Kontroll Maske für Prüfung DFC_AdcIADC0Cal" VALUE 0x8002335E Val_Wu16 65535.00 DFES_OneToOne 0.00 65535.00 /end CHARACTERISTIC
/begin CHARACTERISTIC DFC_CtlMsk.DFC_AdcIADC0Conv_C "DFC/Verhaltens Kontroll Maske für Prüfung DFC_AdcIADC0Conv" VALUE 0x80023360 Val_Wu16 65535.00 DFES_OneToOne 0.00 65535.00 /end CHARACTERISTIC
/begin CHARACTERISTIC DFC_CtlMsk.DFC_AdcIADC1Cal_C "DFC/Verhaltens Kontroll Maske für Prüfung DFC_AdcIADC1Cal" VALUE 0x80023362 Val_Wu16 65535.00 DFES_OneToOne 0.00 65535.00 /end CHARACTERISTIC
/begin CHARACTERISTIC DFC_CtlMsk.DFC_AdcIADC1Conv_C "DFC/Verhaltens Kontroll Maske für Prüfung DFC_AdcIADC1Conv" VALUE 0x80023364 Val_Wu16 65535.00 DFES_OneToOne 0.00 65535.00 /end CHARACTERISTIC
/begin CHARACTERISTIC DFC_CtlMsk.DFC_CmbChbMisfireMax_0_C "DFC/Verhaltens Kontroll Maske für Prüfung DFC_CmbChbMisfireMax_0" VALUE 0x80023366 Val_Wu16 65535.00 DFES_OneToOne 0.00 65535.00 /end CHARACTERISTIC
/begin CHARACTERISTIC DFC_CtlMsk.DFC_CmbChbMisfireMax_1_C "DFC/Verhaltens Kontroll Maske für Prüfung DFC_CmbChbMisfireMax_1" VALUE 0x80023368 Val_Wu16 65535.00 DFES_OneToOne 0.00 65535.00 /end CHARACTERISTIC
/begin CHARACTERISTIC DFC_CtlMsk.DFC_CmbChbMisfireMax_2_C "DFC/Verhaltens Kontroll Maske für Prüfung DFC_CmbChbMisfireMax_2" VALUE 0x8002336A Val_Wu16 65535.00 DFES_OneToOne 0.00 65535.00 /end CHARACTERISTIC
/begin CHARACTERISTIC DFC_CtlMsk.DFC_CmbChbMisfireMax_3_C "DFC/Verhaltens Kontroll Maske für Prüfung DFC_CmbChbMisfireMax_3" VALUE 0x8002336C Val_Wu16 65535.00 DFES_OneToOne 0.00 65535.00 /end CHARACTERISTIC
/begin CHARACTERISTIC DFC_CtlMsk.DFC_CmbChbMisfireMax_4_C "DFC/Verhaltens Kontroll Maske für Prüfung DFC_CmbChbMisfireMax_4" VALUE 0x8002336E Val_Wu16 65535.00 DFES_OneToOne 0.00 65535.00 /end CHARACTERISTIC
/begin CHARACTERISTIC DFC_CtlMsk.DFC_CmbChbMisfireMax_5_C "DFC/Verhaltens Kontroll Maske für Prüfung DFC_CmbChbMisfireMax_5" VALUE 0x80023370 Val_Wu16 65535.00 DFES_OneToOne 0.00 65535.00 /end CHARACTERISTIC
/begin CHARACTERISTIC DFC_CtlMsk.DFC_CmbChbMisfireMul_C "DFC/Verhaltens Kontroll Maske für Prüfung DFC_CmbChbMisfireMul" VALUE 0x80023372 Val_Wu16 65535.00 DFES_OneToOne 0.00 65535.00 /end CHARACTERISTIC
/begin CHARACTERISTIC DFC_CtlMsk.DFC_EGRVlvLPOfsNeutr_C "DFC/" VALUE 0x80023374 Val_Wu16 65535.00 DFES_OneToOne 0.00 65535.00 /end CHARACTERISTIC
/begin CHARACTERISTIC DFC_CtlMsk.DFC_EGRVlvOfsNeutr_C "DFC/Verhaltens Kontroll Maske für Prüfung DFC_EGRVlvOfsNeutr" VALUE 0x80023376 Val_Wu16 65535.00 DFES_OneToOne 0.00 65535.00 /end CHARACTERISTIC
/begin CHARACTERISTIC DFC_CtlMsk.DFC_FMAErrModMax_C "DFC/Verhaltens Kontroll Maske für Prüfung DFC_FMAErrModMax" VALUE 0x80023378 Val_Wu16 65535.00 DFES_OneToOne 0.00 65535.00 /end CHARACTERISTIC
/begin CHARACTERISTIC DFC_CtlMsk.DFC_FMAErrModMin_C "DFC/Verhaltens Kontroll Maske für Prüfung DFC_FMAErrModMin" VALUE 0x8002337A Val_Wu16 65535.00 DFES_OneToOne 0.00 65535.00 /end CHARACTERISTIC
/begin CHARACTERISTIC DFC_CtlMsk.DFC_FlSysTnkLo_C "DFC/Verhaltens Kontroll Maske für Prüfung DFC_FlSysTnkLo" VALUE 0x8002337C Val_Wu16 65535.00 DFES_OneToOne 0.00 65535.00 /end CHARACTERISTIC
/begin CHARACTERISTIC DFC_CtlMsk.DFC_GbxNPosPlaus_C "DFC/Verhaltens Kontroll Maske für Prüfung DFC_GbxNPosPlaus" VALUE 0x8002337E Val_Wu16 65535.00 DFES_OneToOne 0.00 65535.00 /end CHARACTERISTIC
/begin CHARACTERISTIC DFC_CtlMsk.DFC_I14229_ROETst_Appl_C "DFC/" VALUE 0x80023380 Val_Wu16 65535.00 DFES_OneToOne 0.00 65535.00 /end CHARACTERISTIC
/begin CHARACTERISTIC DFC_CtlMsk.DFC_I14229_ROETst_Netw_C "DFC/" VALUE 0x80023382 Val_Wu16 65535.00 DFES_OneToOne 0.00 65535.00 /end CHARACTERISTIC
/begin CHARACTERISTIC DFC_CtlMsk.DFC_I14229_ROE_BufFull_C "DFC/" VALUE 0x80023384 Val_Wu16 65535.00 DFES_OneToOne 0.00 65535.00 /end CHARACTERISTIC
/begin CHARACTERISTIC DFC_CtlMsk.DFC_IVAdjDiaIVAdj_C "DFC/Verhaltens Kontroll Maske für Prüfung DFC_IVAdjDiaIVAdj" VALUE 0x80023386 Val_Wu16 65535.00 DFES_OneToOne 0.00 65535.00 /end CHARACTERISTIC
/begin CHARACTERISTIC DFC_CtlMsk.DFC_IVAdjIVA_0_C "DFC/Verhaltens Kontroll Maske für Prüfung DFC_IVAdjIVA_0" VALUE 0x80023388 Val_Wu16 65535.00 DFES_OneToOne 0.00 65535.00 /end CHARACTERISTIC
/begin CHARACTERISTIC DFC_CtlMsk.DFC_IVAdjIVA_1_C "DFC/Verhaltens Kontroll Maske für Prüfung DFC_IVAdjIVA_1" VALUE 0x8002338A Val_Wu16 65535.00 DFES_OneToOne 0.00 65535.00 /end CHARACTERISTIC
/begin CHARACTERISTIC DFC_CtlMsk.DFC_IVAdjIVA_2_C "DFC/Verhaltens Kontroll Maske für Prüfung DFC_IVAdjIVA_2" VALUE 0x8002338C Val_Wu16 65535.00 DFES_OneToOne 0.00 65535.00 /end CHARACTERISTIC
/begin CHARACTERISTIC DFC_CtlMsk.DFC_IVAdjIVA_3_C "DFC/Verhaltens Kontroll Maske für Prüfung DFC_IVAdjIVA_3" VALUE 0x8002338E Val_Wu16 65535.00 DFES_OneToOne 0.00 65535.00 /end CHARACTERISTIC
/begin CHARACTERISTIC DFC_CtlMsk.DFC_IVAdjIVA_4_C "DFC/Verhaltens Kontroll Maske für Prüfung DFC_IVAdjIVA_4" VALUE 0x80023390 Val_Wu16 65535.00 DFES_OneToOne 0.00 65535.00 /end CHARACTERISTIC
/begin CHARACTERISTIC DFC_CtlMsk.DFC_IVAdjIVA_5_C "DFC/Verhaltens Kontroll Maske für Prüfung DFC_IVAdjIVA_5" VALUE 0x80023392 Val_Wu16 65535.00 DFES_OneToOne 0.00 65535.00 /end CHARACTERISTIC
/begin CHARACTERISTIC DFC_CtlMsk.DFC_IVPSplyDCDCOff_0_C "DFC/Verhaltens Kontroll Maske für Prüfung DFC_IVPSplyDCDCOff_0" VALUE 0x80023394 Val_Wu16 65535.00 DFES_OneToOne 0.00 65535.00 /end CHARACTERISTIC
/begin CHARACTERISTIC DFC_CtlMsk.DFC_IVPSplyDCDCOff_1_C "DFC/Verhaltens Kontroll Maske für Prüfung DFC_IVPSplyDCDCOff_1" VALUE 0x80023396 Val_Wu16 65535.00 DFES_OneToOne 0.00 65535.00 /end CHARACTERISTIC
/begin CHARACTERISTIC DFC_CtlMsk.DFC_IVPSplyDCDCOff_2_C "DFC/Verhaltens Kontroll Maske für Prüfung DFC_IVPSplyDCDCOff_2" VALUE 0x80023398 Val_Wu16 65535.00 DFES_OneToOne 0.00 65535.00 /end CHARACTERISTIC
/begin CHARACTERISTIC DFC_CtlMsk.DFC_IVPSplyDCDCOff_3_C "DFC/Verhaltens Kontroll Maske für Prüfung DFC_IVPSplyDCDCOff_3" VALUE 0x8002339A Val_Wu16 65535.00 DFES_OneToOne 0.00 65535.00 /end CHARACTERISTIC
/begin CHARACTERISTIC DFC_CtlMsk.DFC_InjCtlAdjQntEEPCS_C "DFC/Verhaltens Kontroll Maske für Prüfung DFC_InjCtlAdjQntEEPCS" VALUE 0x8002339C Val_Wu16 65535.00 DFES_OneToOne 0.00 65535.00 /end CHARACTERISTIC
/begin CHARACTERISTIC DFC_CtlMsk.DFC_LSUSPISig_C "DFC/Verhaltens Kontroll Maske für Prüfung DFC_LSUSPISig" VALUE 0x8002339E Val_Wu16 65535.00 DFES_OneToOne 0.00 65535.00 /end CHARACTERISTIC
/begin CHARACTERISTIC DFC_CtlMsk.DFC_Layer_Dummy_C "DFC/Verhaltens Kontroll Maske für Prüfung DFC_Layer_Dummy" VALUE 0x800233A0 Val_Wu16 65535.00 DFES_OneToOne 0.00 65535.00 /end CHARACTERISTIC
/begin CHARACTERISTIC DFC_CtlMsk.DFC_NplEnvPSensPPFltDiff_C "DFC/Verhaltens Kontroll Maske für Prüfung DFC_NplEnvPSensPPFltDiff" VALUE 0x800233A2 Val_Wu16 65535.00 DFES_OneToOne 0.00 65535.00 /end CHARACTERISTIC
/begin CHARACTERISTIC DFC_CtlMsk.DFC_NplPresSensPPFltDiff_C "DFC/Verhaltens Kontroll Maske für Prüfung DFC_NplPresSensPPFltDiff" VALUE 0x800233A4 Val_Wu16 65535.00 DFES_OneToOne 0.00 65535.00 /end CHARACTERISTIC
/begin CHARACTERISTIC DFC_CtlMsk.DFC_OilLvlPlaus_C "DFC/Verhaltens Kontroll Maske für Prüfung DFC_OilLvlPlaus" VALUE 0x800233A6 Val_Wu16 65535.00 DFES_OneToOne 0.00 65535.00 /end CHARACTERISTIC
/begin CHARACTERISTIC DFC_CtlMsk.DFC_OilTOutLvl_C "DFC/Verhaltens Kontroll Maske für Prüfung DFC_OilTOutLvl" VALUE 0x800233A8 Val_Wu16 65535.00 DFES_OneToOne 0.00 65535.00 /end CHARACTERISTIC
/begin CHARACTERISTIC DFC_CtlMsk.DFC_PCVfacAdaptMax_C "DFC/Verhaltens Kontroll Maske für Prüfung DFC_PCVfacAdaptMax" VALUE 0x800233AA Val_Wu16 65535.00 DFES_OneToOne 0.00 65535.00 /end CHARACTERISTIC
/begin CHARACTERISTIC DFC_CtlMsk.DFC_PCVfacAdaptMin_C "DFC/Verhaltens Kontroll Maske für Prüfung DFC_PCVfacAdaptMin" VALUE 0x800233AC Val_Wu16 65535.00 DFES_OneToOne 0.00 65535.00 /end CHARACTERISTIC
/begin CHARACTERISTIC DFC_CtlMsk.DFC_SensFrzPPFltUs_C "DFC/Verhaltens Kontroll Maske für Prüfung DFC_SensFrzPPFltUs" VALUE 0x800233AE Val_Wu16 65535.00 DFES_OneToOne 0.00 65535.00 /end CHARACTERISTIC
/begin CHARACTERISTIC DFC_CtlMsk.DFC_SensMonUTnkLvl_C "DFC/Verhaltens Kontroll Maske für Prüfung DFC_SensMonUTnkLvl" VALUE 0x800233B0 Val_Wu16 65535.00 DFES_OneToOne 0.00 65535.00 /end CHARACTERISTIC
/begin CHARACTERISTIC DFC_CtlMsk.DFC_T15Sig_C "DFC/Verhaltens Kontroll Maske für Prüfung DFC_T15Sig" VALUE 0x800233B2 Val_Wu16 65535.00 DFES_OneToOne 0.00 65535.00 /end CHARACTERISTIC
/begin CHARACTERISTIC DFC_CtlMsk.DFC_AirCtlRmpTOut_C "DFC/Verhaltens Kontroll Maske für Prüfung DFC_AirCtlRmpTOut" VALUE 0x800233B4 Val_Wu16 65535.00 DFES_OneToOne 0.00 65535.00 /end CHARACTERISTIC
/begin CHARACTERISTIC DFC_CtlMsk.DFC_BrkPPlaus_C "DFC/Verhaltens Kontroll Maske für Prüfung DFC_BrkPPlaus" VALUE 0x800233B6 Val_Wu16 65535.00 DFES_OneToOne 0.00 65535.00 /end CHARACTERISTIC
/begin CHARACTERISTIC DFC_CtlMsk.DFC_CEngDsTDynTst_C "DFC/Verhaltens Kontroll Maske für Prüfung DFC_CEngDsTDynTst" VALUE 0x800233B8 Val_Wu16 65535.00 DFES_OneToOne 0.00 65535.00 /end CHARACTERISTIC
/begin CHARACTERISTIC DFC_CtlMsk.DFC_EEPEraseErr_C "DFC/Verhaltens Kontroll Maske für Prüfung DFC_EEPEraseErr" VALUE 0x800233BA Val_Wu16 65535.00 DFES_OneToOne 0.00 65535.00 /end CHARACTERISTIC
/begin CHARACTERISTIC DFC_CtlMsk.DFC_EEPRdErr_C "DFC/Verhaltens Kontroll Maske für Prüfung DFC_EEPRdErr" VALUE 0x800233BC Val_Wu16 65535.00 DFES_OneToOne 0.00 65535.00 /end CHARACTERISTIC
/begin CHARACTERISTIC DFC_CtlMsk.DFC_EEPWrErr_C "DFC/Verhaltens Kontroll Maske für Prüfung DFC_EEPWrErr" VALUE 0x800233BE Val_Wu16 65535.00 DFES_OneToOne 0.00 65535.00 /end CHARACTERISTIC
/begin CHARACTERISTIC DFC_CtlMsk.DFC_EGRVlvJamVlvClsd_C "DFC/Verhaltens Kontroll Maske für Prüfung DFC_EGRVlvJamVlvClsd" VALUE 0x800233C0 Val_Wu16 65535.00 DFES_OneToOne 0.00 65535.00 /end CHARACTERISTIC
/begin CHARACTERISTIC DFC_CtlMsk.DFC_EGRVlvJamVlvOpn_C "DFC/Verhaltens Kontroll Maske für Prüfung DFC_EGRVlvJamVlvOpn" VALUE 0x800233C2 Val_Wu16 65535.00 DFES_OneToOne 0.00 65535.00 /end CHARACTERISTIC
/begin CHARACTERISTIC DFC_CtlMsk.DFC_EGRVlvLPJamVlvClsd_C "DFC/Verhaltens Kontroll Maske für Prüfung DFC_EGRVlvLPJamVlvClsd" VALUE 0x800233C4 Val_Wu16 65535.00 DFES_OneToOne 0.00 65535.00 /end CHARACTERISTIC
/begin CHARACTERISTIC DFC_CtlMsk.DFC_EGRVlvLPJamVlvOpn_C "DFC/Verhaltens Kontroll Maske für Prüfung DFC_EGRVlvLPJamVlvOpn" VALUE 0x800233C6 Val_Wu16 65535.00 DFES_OneToOne 0.00 65535.00 /end CHARACTERISTIC
/begin CHARACTERISTIC DFC_CtlMsk.DFC_EGRVlvLPLgTDrft_C "DFC/Verhaltens Kontroll Maske für Prüfung DFC_EGRVlvLPLgTDrft" VALUE 0x800233C8 Val_Wu16 65535.00 DFES_OneToOne 0.00 65535.00 /end CHARACTERISTIC
/begin CHARACTERISTIC DFC_CtlMsk.DFC_EGRVlvLPOfsLrnJamVlv_C "DFC/Verhaltens Kontroll Maske für Prüfung DFC_EGRVlvLPOfsLrnJamVlv" VALUE 0x800233CA Val_Wu16 65535.00 DFES_OneToOne 0.00 65535.00 /end CHARACTERISTIC
/begin CHARACTERISTIC DFC_CtlMsk.DFC_EGRVlvLPShTDrft_C "DFC/Verhaltens Kontroll Maske für Prüfung DFC_EGRVlvLPShTDrft" VALUE 0x800233CC Val_Wu16 65535.00 DFES_OneToOne 0.00 65535.00 /end CHARACTERISTIC
/begin CHARACTERISTIC DFC_CtlMsk.DFC_EGRVlvLgTDrft_C "DFC/Verhaltens Kontroll Maske für Prüfung DFC_EGRVlvLgTDrft" VALUE 0x800233CE Val_Wu16 65535.00 DFES_OneToOne 0.00 65535.00 /end CHARACTERISTIC
/begin CHARACTERISTIC DFC_CtlMsk.DFC_EGRVlvOfsLrnJamVlv_C "DFC/Verhaltens Kontroll Maske für Prüfung DFC_EGRVlvOfsLrnJamVlv" VALUE 0x800233D0 Val_Wu16 65535.00 DFES_OneToOne 0.00 65535.00 /end CHARACTERISTIC
/begin CHARACTERISTIC DFC_CtlMsk.DFC_EGRVlvShTDrft_C "DFC/Verhaltens Kontroll Maske für Prüfung DFC_EGRVlvShTDrft" VALUE 0x800233D2 Val_Wu16 65535.00 DFES_OneToOne 0.00 65535.00 /end CHARACTERISTIC
/begin CHARACTERISTIC DFC_CtlMsk.DFC_EngICO_C "DFC/Verhaltens Kontroll Maske für Prüfung DFC_EngICO" VALUE 0x800233D4 Val_Wu16 65535.00 DFES_OneToOne 0.00 65535.00 /end CHARACTERISTIC
/begin CHARACTERISTIC DFC_CtlMsk.DFC_EpmCaSI1ErrSig_C "DFC/Verhaltens Kontroll Maske für Prüfung DFC_EpmCaSI1ErrSig" VALUE 0x800233D6 Val_Wu16 65535.00 DFES_OneToOne 0.00 65535.00 /end CHARACTERISTIC
/begin CHARACTERISTIC DFC_CtlMsk.DFC_EpmCaSI1NoSig_C "DFC/Verhaltens Kontroll Maske für Prüfung DFC_EpmCaSI1NoSig" VALUE 0x800233D8 Val_Wu16 65535.00 DFES_OneToOne 0.00 65535.00 /end CHARACTERISTIC
/begin CHARACTERISTIC DFC_CtlMsk.DFC_EpmCaSI1OfsErr_C "DFC/Verhaltens Kontroll Maske für Prüfung DFC_EpmCaSI1OfsErr" VALUE 0x800233DA Val_Wu16 65535.00 DFES_OneToOne 0.00 65535.00 /end CHARACTERISTIC
/begin CHARACTERISTIC DFC_CtlMsk.DFC_EpmCrSErrSig_C "DFC/Verhaltens Kontroll Maske für Prüfung DFC_EpmCrSErrSig" VALUE 0x800233DC Val_Wu16 65535.00 DFES_OneToOne 0.00 65535.00 /end CHARACTERISTIC
/begin CHARACTERISTIC DFC_CtlMsk.DFC_EpmCrSNoSig_C "DFC/Verhaltens Kontroll Maske für Prüfung DFC_EpmCrSNoSig" VALUE 0x800233DE Val_Wu16 65535.00 DFES_OneToOne 0.00 65535.00 /end CHARACTERISTIC
/begin CHARACTERISTIC DFC_CtlMsk.DFC_IVPlausComprTst_C "DFC/Verhaltens Kontroll Maske für Prüfung DFC_IVPlausComprTst" VALUE 0x800233E0 Val_Wu16 65535.00 DFES_OneToOne 0.00 65535.00 /end CHARACTERISTIC
/begin CHARACTERISTIC DFC_CtlMsk.DFC_IVPlausRunUpTst_C "DFC/Verhaltens Kontroll Maske für Prüfung DFC_IVPlausRunUpTst" VALUE 0x800233E2 Val_Wu16 65535.00 DFES_OneToOne 0.00 65535.00 /end CHARACTERISTIC
/begin CHARACTERISTIC DFC_CtlMsk.DFC_InjCrvShOffTst_C "DFC/Verhaltens Kontroll Maske für Prüfung DFC_InjCrvShOffTst" VALUE 0x800233E4 Val_Wu16 65535.00 DFES_OneToOne 0.00 65535.00 /end CHARACTERISTIC
/begin CHARACTERISTIC DFC_CtlMsk.DFC_LayerEnSavModProd_C "DFC/Verhaltens Kontroll Maske für Prüfung DFC_LayerEnSavModProd" VALUE 0x800233E6 Val_Wu16 65535.00 DFES_OneToOne 0.00 65535.00 /end CHARACTERISTIC
/begin CHARACTERISTIC DFC_CtlMsk.DFC_LayerEnSavModRep_C "DFC/Verhaltens Kontroll Maske für Prüfung DFC_LayerEnSavModRep" VALUE 0x800233E8 Val_Wu16 65535.00 DFES_OneToOne 0.00 65535.00 /end CHARACTERISTIC
/begin CHARACTERISTIC DFC_CtlMsk.DFC_LayerEnSavModShip_C "DFC/Verhaltens Kontroll Maske für Prüfung DFC_LayerEnSavModShip" VALUE 0x800233EA Val_Wu16 65535.00 DFES_OneToOne 0.00 65535.00 /end CHARACTERISTIC
/begin CHARACTERISTIC DFC_CtlMsk.DFC_MRlyErlyOpng_C "DFC/Verhaltens Kontroll Maske für Prüfung DFC_MRlyErlyOpng" VALUE 0x800233EC Val_Wu16 65535.00 DFES_OneToOne 0.00 65535.00 /end CHARACTERISTIC
/begin CHARACTERISTIC DFC_CtlMsk.DFC_MRlyStk_C "DFC/Verhaltens Kontroll Maske für Prüfung DFC_MRlyStk" VALUE 0x800233EE Val_Wu16 65535.00 DFES_OneToOne 0.00 65535.00 /end CHARACTERISTIC
/begin CHARACTERISTIC DFC_CtlMsk.DFC_MeUnActrTst_C "DFC/Verhaltens Kontroll Maske für Prüfung DFC_MeUnActrTst" VALUE 0x800233F0 Val_Wu16 65535.00 DFES_OneToOne 0.00 65535.00 /end CHARACTERISTIC
/begin CHARACTERISTIC DFC_CtlMsk.DFC_MoCADCCmp_C "DFC/Verhaltens Kontroll Maske für Prüfung DFC_MoCADCCmp" VALUE 0x800233F2 Val_Wu16 65535.00 DFES_OneToOne 0.00 65535.00 /end CHARACTERISTIC
/begin CHARACTERISTIC DFC_CtlMsk.DFC_MoCADCTst_C "DFC/Verhaltens Kontroll Maske für Prüfung DFC_MoCADCTst" VALUE 0x800233F4 Val_Wu16 65535.00 DFES_OneToOne 0.00 65535.00 /end CHARACTERISTIC
/begin CHARACTERISTIC DFC_CtlMsk.DFC_MoCADCVltgRatio_C "DFC/Verhaltens Kontroll Maske für Prüfung DFC_MoCADCVltgRatio" VALUE 0x800233F6 Val_Wu16 65535.00 DFES_OneToOne 0.00 65535.00 /end CHARACTERISTIC
/begin CHARACTERISTIC DFC_CtlMsk.DFC_MoCComErrCnt_C "DFC/Verhaltens Kontroll Maske für Prüfung DFC_MoCComErrCnt" VALUE 0x800233F8 Val_Wu16 65535.00 DFES_OneToOne 0.00 65535.00 /end CHARACTERISTIC
/begin CHARACTERISTIC DFC_CtlMsk.DFC_MoCComSPI_C "DFC/Verhaltens Kontroll Maske für Prüfung DFC_MoCComSPI" VALUE 0x800233FA Val_Wu16 65535.00 DFES_OneToOne 0.00 65535.00 /end CHARACTERISTIC
/begin CHARACTERISTIC DFC_CtlMsk.DFC_MoCROMErrXPg_C "DFC/Verhaltens Kontroll Maske für Prüfung DFC_MoCROMErrXPg" VALUE 0x800233FC Val_Wu16 65535.00 DFES_OneToOne 0.00 65535.00 /end CHARACTERISTIC
/begin CHARACTERISTIC DFC_CtlMsk.DFC_MoCSOPHwNoRdy_C "DFC/Verhaltens Kontroll Maske für Prüfung DFC_MoCSOPHwNoRdy" VALUE 0x800233FE Val_Wu16 65535.00 DFES_OneToOne 0.00 65535.00 /end CHARACTERISTIC
/begin CHARACTERISTIC DFC_CtlMsk.DFC_MoCSOPLoLi_C "DFC/Verhaltens Kontroll Maske für Prüfung DFC_MoCSOPLoLi" VALUE 0x80023400 Val_Wu16 65535.00 DFES_OneToOne 0.00 65535.00 /end CHARACTERISTIC
/begin CHARACTERISTIC DFC_CtlMsk.DFC_MoCSOPMM_C "DFC/Verhaltens Kontroll Maske für Prüfung DFC_MoCSOPMM" VALUE 0x80023402 Val_Wu16 65535.00 DFES_OneToOne 0.00 65535.00 /end CHARACTERISTIC
/begin CHARACTERISTIC DFC_CtlMsk.DFC_MoCSOPTimeOut_C "DFC/Verhaltens Kontroll Maske für Prüfung DFC_MoCSOPTimeOut" VALUE 0x80023404 Val_Wu16 65535.00 DFES_OneToOne 0.00 65535.00 /end CHARACTERISTIC
/begin CHARACTERISTIC DFC_CtlMsk.DFC_MoCSOPUpLi_C "DFC/Verhaltens Kontroll Maske für Prüfung DFC_MoCSOPUpLi" VALUE 0x80023406 Val_Wu16 65535.00 DFES_OneToOne 0.00 65535.00 /end CHARACTERISTIC
/begin CHARACTERISTIC DFC_CtlMsk.DFC_MoFAPP_C "DFC/Verhaltens Kontroll Maske für Prüfung DFC_MoFAPP" VALUE 0x80023408 Val_Wu16 65535.00 DFES_OneToOne 0.00 65535.00 /end CHARACTERISTIC
/begin CHARACTERISTIC DFC_CtlMsk.DFC_MoFESpd_C "DFC/Verhaltens Kontroll Maske für Prüfung DFC_MoFESpd" VALUE 0x8002340A Val_Wu16 65535.00 DFES_OneToOne 0.00 65535.00 /end CHARACTERISTIC
/begin CHARACTERISTIC DFC_CtlMsk.DFC_MoFInjDatPhi_C "DFC/Verhaltens Kontroll Maske für Prüfung DFC_MoFInjDatPhi" VALUE 0x8002340C Val_Wu16 65535.00 DFES_OneToOne 0.00 65535.00 /end CHARACTERISTIC
/begin CHARACTERISTIC DFC_CtlMsk.DFC_MoFInjDatQnt_C "DFC/Verhaltens Kontroll Maske für Prüfung DFC_MoFInjDatQnt" VALUE 0x8002340E Val_Wu16 65535.00 DFES_OneToOne 0.00 65535.00 /end CHARACTERISTIC
/begin CHARACTERISTIC DFC_CtlMsk.DFC_MoFInjQnt_C "DFC/Verhaltens Kontroll Maske für Prüfung DFC_MoFInjQnt" VALUE 0x80023410 Val_Wu16 65535.00 DFES_OneToOne 0.00 65535.00 /end CHARACTERISTIC
/begin CHARACTERISTIC DFC_CtlMsk.DFC_MoFMode1PoI1_C "DFC/Verhaltens Kontroll Maske für Prüfung DFC_MoFMode1PoI1" VALUE 0x80023412 Val_Wu16 65535.00 DFES_OneToOne 0.00 65535.00 /end CHARACTERISTIC
/begin CHARACTERISTIC DFC_CtlMsk.DFC_MoFMode1PoI2_C "DFC/Verhaltens Kontroll Maske für Prüfung DFC_MoFMode1PoI2" VALUE 0x80023414 Val_Wu16 65535.00 DFES_OneToOne 0.00 65535.00 /end CHARACTERISTIC
/begin CHARACTERISTIC DFC_CtlMsk.DFC_MoFMode2PoI1_C "DFC/Verhaltens Kontroll Maske für Prüfung DFC_MoFMode2PoI1" VALUE 0x80023416 Val_Wu16 65535.00 DFES_OneToOne 0.00 65535.00 /end CHARACTERISTIC
/begin CHARACTERISTIC DFC_CtlMsk.DFC_MoFMode2PoI2_C "DFC/Verhaltens Kontroll Maske für Prüfung DFC_MoFMode2PoI2" VALUE 0x80023418 Val_Wu16 65535.00 DFES_OneToOne 0.00 65535.00 /end CHARACTERISTIC
/begin CHARACTERISTIC DFC_CtlMsk.DFC_MoFOvR_C "DFC/Verhaltens Kontroll Maske für Prüfung DFC_MoFOvR" VALUE 0x8002341A Val_Wu16 65535.00 DFES_OneToOne 0.00 65535.00 /end CHARACTERISTIC
/begin CHARACTERISTIC DFC_CtlMsk.DFC_MoFQntCor_C "DFC/Verhaltens Kontroll Maske für Prüfung DFC_MoFQntCor" VALUE 0x8002341C Val_Wu16 65535.00 DFES_OneToOne 0.00 65535.00 /end CHARACTERISTIC
/begin CHARACTERISTIC DFC_CtlMsk.DFC_MoFRailP_C "DFC/Verhaltens Kontroll Maske für Prüfung DFC_MoFRailP" VALUE 0x8002341E Val_Wu16 65535.00 DFES_OneToOne 0.00 65535.00 /end CHARACTERISTIC
/begin CHARACTERISTIC DFC_CtlMsk.DFC_MoFTrqCmp_C "DFC/Verhaltens Kontroll Maske für Prüfung DFC_MoFTrqCmp" VALUE 0x80023420 Val_Wu16 65535.00 DFES_OneToOne 0.00 65535.00 /end CHARACTERISTIC
/begin CHARACTERISTIC DFC_CtlMsk.DFC_NSCDsHtrSetP_C "DFC/Verhaltens Kontroll Maske für Prüfung DFC_NSCDsHtrSetP" VALUE 0x80023422 Val_Wu16 65535.00 DFES_OneToOne 0.00 65535.00 /end CHARACTERISTIC
/begin CHARACTERISTIC DFC_CtlMsk.DFC_NoCat2DsHtrSetP_C "DFC/Verhaltens Kontroll Maske für Prüfung DFC_NoCat2DsHtrSetP" VALUE 0x80023424 Val_Wu16 65535.00 DFES_OneToOne 0.00 65535.00 /end CHARACTERISTIC
/begin CHARACTERISTIC DFC_CtlMsk.DFC_PCVActrTst_C "DFC/Verhaltens Kontroll Maske für Prüfung DFC_PCVActrTst" VALUE 0x80023426 Val_Wu16 65535.00 DFES_OneToOne 0.00 65535.00 /end CHARACTERISTIC
/begin CHARACTERISTIC DFC_CtlMsk.DFC_PhyModNonMonMapNpl_C "DFC/Verhaltens Kontroll Maske für Prüfung DFC_PhyModNonMonMapNpl" VALUE 0x80023428 Val_Wu16 65535.00 DFES_OneToOne 0.00 65535.00 /end CHARACTERISTIC
/begin CHARACTERISTIC DFC_CtlMsk.DFC_RailHpTst_C "DFC/Verhaltens Kontroll Maske für Prüfung DFC_RailHpTst" VALUE 0x8002342A Val_Wu16 65535.00 DFES_OneToOne 0.00 65535.00 /end CHARACTERISTIC
/begin CHARACTERISTIC DFC_CtlMsk.DFC_RailPOfsTstMax_C "DFC/Verhaltens Kontroll Maske für Prüfung DFC_RailPOfsTstMax" VALUE 0x8002342C Val_Wu16 65535.00 DFES_OneToOne 0.00 65535.00 /end CHARACTERISTIC
/begin CHARACTERISTIC DFC_CtlMsk.DFC_RailPOfsTstMin_C "DFC/Verhaltens Kontroll Maske für Prüfung DFC_RailPOfsTstMin" VALUE 0x8002342E Val_Wu16 65535.00 DFES_OneToOne 0.00 65535.00 /end CHARACTERISTIC
/begin CHARACTERISTIC DFC_CtlMsk.DFC_SIA_E1max_C "DFC/Verhaltens Kontroll Maske für Prüfung DFC_SIA_E1max" VALUE 0x80023430 Val_Wu16 65535.00 DFES_OneToOne 0.00 65535.00 /end CHARACTERISTIC
/begin CHARACTERISTIC DFC_CtlMsk.DFC_SIA_E1min_C "DFC/Verhaltens Kontroll Maske für Prüfung DFC_SIA_E1min" VALUE 0x80023432 Val_Wu16 65535.00 DFES_OneToOne 0.00 65535.00 /end CHARACTERISTIC
/begin CHARACTERISTIC DFC_CtlMsk.DFC_SIA_E1npl_C "DFC/Verhaltens Kontroll Maske für Prüfung DFC_SIA_E1npl" VALUE 0x80023434 Val_Wu16 65535.00 DFES_OneToOne 0.00 65535.00 /end CHARACTERISTIC
/begin CHARACTERISTIC DFC_CtlMsk.DFC_SIA_E1sig_C "DFC/Verhaltens Kontroll Maske für Prüfung DFC_SIA_E1sig" VALUE 0x80023436 Val_Wu16 65535.00 DFES_OneToOne 0.00 65535.00 /end CHARACTERISTIC
/begin CHARACTERISTIC DFC_CtlMsk.DFC_SIA_E2max_C "DFC/Verhaltens Kontroll Maske für Prüfung DFC_SIA_E2max" VALUE 0x80023438 Val_Wu16 65535.00 DFES_OneToOne 0.00 65535.00 /end CHARACTERISTIC
/begin CHARACTERISTIC DFC_CtlMsk.DFC_SIA_E2min_C "DFC/Verhaltens Kontroll Maske für Prüfung DFC_SIA_E2min" VALUE 0x8002343A Val_Wu16 65535.00 DFES_OneToOne 0.00 65535.00 /end CHARACTERISTIC
/begin CHARACTERISTIC DFC_CtlMsk.DFC_SIA_E2npl_C "DFC/Verhaltens Kontroll Maske für Prüfung DFC_SIA_E2npl" VALUE 0x8002343C Val_Wu16 65535.00 DFES_OneToOne 0.00 65535.00 /end CHARACTERISTIC
/begin CHARACTERISTIC DFC_CtlMsk.DFC_SIA_E2sig_C "DFC/Verhaltens Kontroll Maske für Prüfung DFC_SIA_E2sig" VALUE 0x8002343E Val_Wu16 65535.00 DFES_OneToOne 0.00 65535.00 /end CHARACTERISTIC
/begin CHARACTERISTIC DFC_CtlMsk.DFC_SIA_E3max_C "DFC/Verhaltens Kontroll Maske für Prüfung DFC_SIA_E3max" VALUE 0x80023440 Val_Wu16 65535.00 DFES_OneToOne 0.00 65535.00 /end CHARACTERISTIC
/begin CHARACTERISTIC DFC_CtlMsk.DFC_SIA_E3min_C "DFC/Verhaltens Kontroll Maske für Prüfung DFC_SIA_E3min" VALUE 0x80023442 Val_Wu16 65535.00 DFES_OneToOne 0.00 65535.00 /end CHARACTERISTIC
/begin CHARACTERISTIC DFC_CtlMsk.DFC_SIA_E3npl_C "DFC/Verhaltens Kontroll Maske für Prüfung DFC_SIA_E3npl" VALUE 0x80023444 Val_Wu16 65535.00 DFES_OneToOne 0.00 65535.00 /end CHARACTERISTIC
/begin CHARACTERISTIC DFC_CtlMsk.DFC_SIA_E3sig_C "DFC/Verhaltens Kontroll Maske für Prüfung DFC_SIA_E3sig" VALUE 0x80023446 Val_Wu16 65535.00 DFES_OneToOne 0.00 65535.00 /end CHARACTERISTIC
/begin CHARACTERISTIC DFC_CtlMsk.DFC_SIA_E4max_C "DFC/Verhaltens Kontroll Maske für Prüfung DFC_SIA_E4max" VALUE 0x80023448 Val_Wu16 65535.00 DFES_OneToOne 0.00 65535.00 /end CHARACTERISTIC
/begin CHARACTERISTIC DFC_CtlMsk.DFC_SIA_E4min_C "DFC/Verhaltens Kontroll Maske für Prüfung DFC_SIA_E4min" VALUE 0x8002344A Val_Wu16 65535.00 DFES_OneToOne 0.00 65535.00 /end CHARACTERISTIC
/begin CHARACTERISTIC DFC_CtlMsk.DFC_SIA_E4npl_C "DFC/Verhaltens Kontroll Maske für Prüfung DFC_SIA_E4npl" VALUE 0x8002344C Val_Wu16 65535.00 DFES_OneToOne 0.00 65535.00 /end CHARACTERISTIC
/begin CHARACTERISTIC DFC_CtlMsk.DFC_SIA_E4sig_C "DFC/Verhaltens Kontroll Maske für Prüfung DFC_SIA_E4sig" VALUE 0x8002344E Val_Wu16 65535.00 DFES_OneToOne 0.00 65535.00 /end CHARACTERISTIC
/begin CHARACTERISTIC DFC_CtlMsk.DFC_SWReset_0_C "DFC/Verhaltens Kontroll Maske für Prüfung DFC_SWReset_0" VALUE 0x80023450 Val_Wu16 65535.00 DFES_OneToOne 0.00 65535.00 /end CHARACTERISTIC
/begin CHARACTERISTIC DFC_CtlMsk.DFC_SWReset_1_C "DFC/Verhaltens Kontroll Maske für Prüfung DFC_SWReset_1" VALUE 0x80023452 Val_Wu16 65535.00 DFES_OneToOne 0.00 65535.00 /end CHARACTERISTIC
/begin CHARACTERISTIC DFC_CtlMsk.DFC_SWReset_2_C "DFC/Verhaltens Kontroll Maske für Prüfung DFC_SWReset_2" VALUE 0x80023454 Val_Wu16 65535.00 DFES_OneToOne 0.00 65535.00 /end CHARACTERISTIC
/begin CHARACTERISTIC DFC_CtlMsk.DFC_ShtrAKKMax_C "DFC/Verhaltens Kontroll Maske für Prüfung DFC_ShtrAKKMax" VALUE 0x80023456 Val_Wu16 65535.00 DFES_OneToOne 0.00 65535.00 /end CHARACTERISTIC
/begin CHARACTERISTIC DFC_CtlMsk.DFC_ShtrAKKMin_C "DFC/Verhaltens Kontroll Maske für Prüfung DFC_ShtrAKKMin" VALUE 0x80023458 Val_Wu16 65535.00 DFES_OneToOne 0.00 65535.00 /end CHARACTERISTIC
/begin CHARACTERISTIC DFC_CtlMsk.DFC_ShtrAKKNpl_C "DFC/Verhaltens Kontroll Maske für Prüfung DFC_ShtrAKKNpl" VALUE 0x8002345A Val_Wu16 65535.00 DFES_OneToOne 0.00 65535.00 /end CHARACTERISTIC
/begin CHARACTERISTIC DFC_CtlMsk.DFC_ShtrPKKMax_C "DFC/Verhaltens Kontroll Maske für Prüfung DFC_ShtrPKKMax" VALUE 0x8002345C Val_Wu16 65535.00 DFES_OneToOne 0.00 65535.00 /end CHARACTERISTIC
/begin CHARACTERISTIC DFC_CtlMsk.DFC_StopCntTmr_C "DFC/Verhaltens Kontroll Maske für Prüfung DFC_StopCntTmr" VALUE 0x8002345E Val_Wu16 65535.00 DFES_OneToOne 0.00 65535.00 /end CHARACTERISTIC
/begin CHARACTERISTIC DFC_CtlMsk.DFC_ThrVlvMon_C "DFC/Verhaltens Kontroll Maske für Prüfung DFC_ThrVlvMon" VALUE 0x80023460 Val_Wu16 65535.00 DFES_OneToOne 0.00 65535.00 /end CHARACTERISTIC
/begin CHARACTERISTIC DFC_CtlMsk.DFC_VSwVlvJamVlv_C "DFC/Verhaltens Kontroll Maske für Prüfung DFC_VSwVlvJamVlv" VALUE 0x80023462 Val_Wu16 65535.00 DFES_OneToOne 0.00 65535.00 /end CHARACTERISTIC
/begin CHARACTERISTIC DFC_CtlMsk.DFC_VSwVlvLgTDrft_C "DFC/Verhaltens Kontroll Maske für Prüfung DFC_VSwVlvLgTDrft" VALUE 0x80023464 Val_Wu16 65535.00 DFES_OneToOne 0.00 65535.00 /end CHARACTERISTIC
/begin CHARACTERISTIC DFC_CtlMsk.DFC_VSwVlvOfsLrnJamVlv_C "DFC/Verhaltens Kontroll Maske für Prüfung DFC_VSwVlvOfsLrnJamVlv" VALUE 0x80023466 Val_Wu16 65535.00 DFES_OneToOne 0.00 65535.00 /end CHARACTERISTIC
/begin CHARACTERISTIC DFC_CtlMsk.DFC_VSwVlvOfsNeutr_C "DFC/Verhaltens Kontroll Maske für Prüfung DFC_VSwVlvOfsNeutr" VALUE 0x80023468 Val_Wu16 65535.00 DFES_OneToOne 0.00 65535.00 /end CHARACTERISTIC
/begin CHARACTERISTIC DFC_CtlMsk.DFC_VSwVlvShTDrft_C "DFC/Verhaltens Kontroll Maske für Prüfung DFC_VSwVlvShTDrft" VALUE 0x8002346A Val_Wu16 65535.00 DFES_OneToOne 0.00 65535.00 /end CHARACTERISTIC
/begin CHARACTERISTIC DFC_CtlMsk.DFC_VSwVlvSpgDef_C "DFC/Verhaltens Kontroll Maske für Prüfung DFC_VSwVlvSpgDef" VALUE 0x8002346C Val_Wu16 65535.00 DFES_OneToOne 0.00 65535.00 /end CHARACTERISTIC
/begin CHARACTERISTIC DFC_DisblMsk.DFC_Unused_C "DFC/intern benötigter Parameter für nicht existierende Fehlerprüfung DFC_Unused" VALUE 0x80025EC6 Val_Wu16 65535.00 DFES_OneToOne 0.00 65535.00 READ_ONLY /end CHARACTERISTIC
/begin CHARACTERISTIC DFC_DisblMsk.DFC_ACCIPlausDrvAst_C "DFC/Abschalt Maske für Prüfung DFC_ACCIPlausDrvAst" VALUE 0x80025EC8 Val_Wu16 65535.00 DFES_OneToOne 0.00 65535.00 /end CHARACTERISTIC
/begin CHARACTERISTIC DFC_DisblMsk.DFC_ACCIPlausTrqDes_C "DFC/Abschalt Maske für Prüfung DFC_ACCIPlausTrqDes" VALUE 0x80025ECA Val_Wu16 65535.00 DFES_OneToOne 0.00 65535.00 /end CHARACTERISTIC
/begin CHARACTERISTIC DFC_DisblMsk.DFC_AirCtlGovDvtEOMMax_C "DFC/Abschalt Maske für Prüfung DFC_AirCtlGovDvtEOMMax" VALUE 0x80025ECC Val_Wu16 65535.00 DFES_OneToOne 0.00 65535.00 /end CHARACTERISTIC
/begin CHARACTERISTIC DFC_DisblMsk.DFC_AirCtlGovDvtEOMMin_C "DFC/Abschalt Maske für Prüfung DFC_AirCtlGovDvtEOMMin" VALUE 0x80025ECE Val_Wu16 65535.00 DFES_OneToOne 0.00 65535.00 /end CHARACTERISTIC
/begin CHARACTERISTIC DFC_DisblMsk.DFC_AirCtlGovDvtMax_C "DFC/Abschalt Maske für Prüfung DFC_AirCtlGovDvtMax" VALUE 0x80025ED0 Val_Wu16 65535.00 DFES_OneToOne 0.00 65535.00 /end CHARACTERISTIC
/begin CHARACTERISTIC DFC_DisblMsk.DFC_AirCtlGovDvtMin_C "DFC/Abschalt Maske für Prüfung DFC_AirCtlGovDvtMin" VALUE 0x80025ED2 Val_Wu16 65535.00 DFES_OneToOne 0.00 65535.00 /end CHARACTERISTIC
/begin CHARACTERISTIC DFC_DisblMsk.DFC_AirCtlGovLPDvtMax_C "DFC/Abschalt Maske für Prüfung DFC_AirCtlGovLPDvtMax" VALUE 0x80025ED4 Val_Wu16 65535.00 DFES_OneToOne 0.00 65535.00 /end CHARACTERISTIC
/begin CHARACTERISTIC DFC_DisblMsk.DFC_AirCtlGovLPDvtMin_C "DFC/Abschalt Maske für Prüfung DFC_AirCtlGovLPDvtMin" VALUE 0x80025ED6 Val_Wu16 65535.00 DFES_OneToOne 0.00 65535.00 /end CHARACTERISTIC
/begin CHARACTERISTIC DFC_DisblMsk.DFC_AltIOComErr_C "DFC/Abschalt Maske für Prüfung DFC_AltIOComErr" VALUE 0x80025ED8 Val_Wu16 65535.00 DFES_OneToOne 0.00 65535.00 /end CHARACTERISTIC
/begin CHARACTERISTIC DFC_DisblMsk.DFC_AltIOComNpl_C "DFC/Abschalt Maske für Prüfung DFC_AltIOComNpl" VALUE 0x80025EDA Val_Wu16 65535.00 DFES_OneToOne 0.00 65535.00 /end CHARACTERISTIC
/begin CHARACTERISTIC DFC_DisblMsk.DFC_BusDiagBusOffFlexRay_C "DFC/" VALUE 0x80025EDC Val_Wu16 65535.00 DFES_OneToOne 0.00 65535.00 /end CHARACTERISTIC
/begin CHARACTERISTIC DFC_DisblMsk.DFC_BusDiagBusOffNodeA_C "DFC/Abschalt Maske für Prüfung DFC_BusDiagBusOffNodeA" VALUE 0x80025EDE Val_Wu16 65535.00 DFES_OneToOne 0.00 65535.00 /end CHARACTERISTIC
/begin CHARACTERISTIC DFC_DisblMsk.DFC_BusDiagBusOffNodeB_C "DFC/Abschalt Maske für Prüfung DFC_BusDiagBusOffNodeB" VALUE 0x80025EE0 Val_Wu16 65535.00 DFES_OneToOne 0.00 65535.00 /end CHARACTERISTIC
/begin CHARACTERISTIC DFC_DisblMsk.DFC_BusDiagBusOffNodeC_C "DFC/Abschalt Maske für Prüfung DFC_BusDiagBusOffNodeC" VALUE 0x80025EE2 Val_Wu16 65535.00 DFES_OneToOne 0.00 65535.00 /end CHARACTERISTIC
/begin CHARACTERISTIC DFC_DisblMsk.DFC_BusDiagHwFlexRay_C "DFC/" VALUE 0x80025EE4 Val_Wu16 65535.00 DFES_OneToOne 0.00 65535.00 /end CHARACTERISTIC
/begin CHARACTERISTIC DFC_DisblMsk.DFC_Cj945SpiCom1_C "DFC/Abschalt Maske für Prüfung DFC_Cj945SpiCom1" VALUE 0x80025EE6 Val_Wu16 65535.00 DFES_OneToOne 0.00 65535.00 /end CHARACTERISTIC
/begin CHARACTERISTIC DFC_DisblMsk.DFC_ComACDemandSig_FA_C "DFC/Abschalt Maske für Prüfung DFC_ComACDemandSig_FA" VALUE 0x80025EE8 Val_Wu16 65535.00 DFES_OneToOne 0.00 65535.00 /end CHARACTERISTIC
/begin CHARACTERISTIC DFC_DisblMsk.DFC_ComACDemandTo_FA_C "DFC/Abschalt Maske für Prüfung DFC_ComACDemandTo_FA" VALUE 0x80025EEA Val_Wu16 65535.00 DFES_OneToOne 0.00 65535.00 /end CHARACTERISTIC
/begin CHARACTERISTIC DFC_DisblMsk.DFC_ComATempSig_FA_C "DFC/Abschalt Maske für Prüfung DFC_ComATempSig_FA" VALUE 0x80025EEC Val_Wu16 65535.00 DFES_OneToOne 0.00 65535.00 /end CHARACTERISTIC
/begin CHARACTERISTIC DFC_DisblMsk.DFC_ComATempTo_FA_C "DFC/Abschalt Maske für Prüfung DFC_ComATempTo_FA" VALUE 0x80025EEE Val_Wu16 65535.00 DFES_OneToOne 0.00 65535.00 /end CHARACTERISTIC
/begin CHARACTERISTIC DFC_DisblMsk.DFC_ComATempTo_FX_C "DFC/Abschalt Maske für Prüfung DFC_ComATempTo_FX" VALUE 0x80025EF0 Val_Wu16 65535.00 DFES_OneToOne 0.00 65535.00 /end CHARACTERISTIC
/begin CHARACTERISTIC DFC_DisblMsk.DFC_ComBrkTrqSumChk_FX_C "DFC/Abschalt Maske für Prüfung DFC_ComBrkTrqSumChk_FX" VALUE 0x80025EF2 Val_Wu16 65535.00 DFES_OneToOne 0.00 65535.00 /end CHARACTERISTIC
/begin CHARACTERISTIC DFC_DisblMsk.DFC_ComBrkTrqSumCtr_FX_C "DFC/Abschalt Maske für Prüfung DFC_ComBrkTrqSumCtr_FX" VALUE 0x80025EF4 Val_Wu16 65535.00 DFES_OneToOne 0.00 65535.00 /end CHARACTERISTIC
/begin CHARACTERISTIC DFC_DisblMsk.DFC_ComBrkTrqSumTo_FX_C "DFC/Abschalt Maske für Prüfung DFC_ComBrkTrqSumTo_FX" VALUE 0x80025EF6 Val_Wu16 65535.00 DFES_OneToOne 0.00 65535.00 /end CHARACTERISTIC
/begin CHARACTERISTIC DFC_DisblMsk.DFC_ComBtnDrvDynChk_FX_C "DFC/Abschalt Maske für Prüfung DFC_ComBtnDrvDynChk_FX" VALUE 0x80025EF8 Val_Wu16 65535.00 DFES_OneToOne 0.00 65535.00 /end CHARACTERISTIC
/begin CHARACTERISTIC DFC_DisblMsk.DFC_ComBtnDrvDynCtr_FX_C "DFC/Abschalt Maske für Prüfung DFC_ComBtnDrvDynCtr_FX" VALUE 0x80025EFA Val_Wu16 65535.00 DFES_OneToOne 0.00 65535.00 /end CHARACTERISTIC
/begin CHARACTERISTIC DFC_DisblMsk.DFC_ComBtnDrvDynTo_FX_C "DFC/Abschalt Maske für Prüfung DFC_ComBtnDrvDynTo_FX" VALUE 0x80025EFC Val_Wu16 65535.00 DFES_OneToOne 0.00 65535.00 /end CHARACTERISTIC
/begin CHARACTERISTIC DFC_DisblMsk.DFC_ComButtonMSASig_C "DFC/Abschalt Maske für Prüfung DFC_ComButtonMSASig" VALUE 0x80025EFE Val_Wu16 65535.00 DFES_OneToOne 0.00 65535.00 /end CHARACTERISTIC
/begin CHARACTERISTIC DFC_DisblMsk.DFC_ComButtonMSATo_C "DFC/Abschalt Maske für Prüfung DFC_ComButtonMSATo" VALUE 0x80025F00 Val_Wu16 65535.00 DFES_OneToOne 0.00 65535.00 /end CHARACTERISTIC
/begin CHARACTERISTIC DFC_DisblMsk.DFC_ComCodierungPwrmngSig_C "DFC/Abschalt Maske für Prüfung DFC_ComCodierungPwrmngSig" VALUE 0x80025F02 Val_Wu16 65535.00 DFES_OneToOne 0.00 65535.00 /end CHARACTERISTIC
/begin CHARACTERISTIC DFC_DisblMsk.DFC_ComCodierungPwrmngSig_FA_C "DFC/Abschalt Maske für Prüfung DFC_ComCodierungPwrmngSig_FA" VALUE 0x80025F04 Val_Wu16 65535.00 DFES_OneToOne 0.00 65535.00 /end CHARACTERISTIC
/begin CHARACTERISTIC DFC_DisblMsk.DFC_ComCrCtlLvrChk_C "DFC/Abschalt Maske für Prüfung DFC_ComCrCtlLvrChk" VALUE 0x80025F06 Val_Wu16 65535.00 DFES_OneToOne 0.00 65535.00 /end CHARACTERISTIC
/begin CHARACTERISTIC DFC_DisblMsk.DFC_ComCrCtlLvrCtr_C "DFC/Abschalt Maske für Prüfung DFC_ComCrCtlLvrCtr" VALUE 0x80025F08 Val_Wu16 65535.00 DFES_OneToOne 0.00 65535.00 /end CHARACTERISTIC
/begin CHARACTERISTIC DFC_DisblMsk.DFC_ComCrCtlLvrSig_C "DFC/Abschalt Maske für Prüfung DFC_ComCrCtlLvrSig" VALUE 0x80025F0A Val_Wu16 65535.00 DFES_OneToOne 0.00 65535.00 /end CHARACTERISTIC
/begin CHARACTERISTIC DFC_DisblMsk.DFC_ComCrCtlLvrTo_C "DFC/Abschalt Maske für Prüfung DFC_ComCrCtlLvrTo" VALUE 0x80025F0C Val_Wu16 65535.00 DFES_OneToOne 0.00 65535.00 /end CHARACTERISTIC
/begin CHARACTERISTIC DFC_DisblMsk.DFC_ComCtrCrshSwoEkpSig_FA_C "DFC/Abschalt Maske für Prüfung DFC_ComCtrCrshSwoEkpSig_FA" VALUE 0x80025F0E Val_Wu16 65535.00 DFES_OneToOne 0.00 65535.00 /end CHARACTERISTIC
/begin CHARACTERISTIC DFC_DisblMsk.DFC_ComCtrCrshSwoEkpTo_FA_C "DFC/Abschalt Maske für Prüfung DFC_ComCtrCrshSwoEkpTo_FA" VALUE 0x80025F10 Val_Wu16 65535.00 DFES_OneToOne 0.00 65535.00 /end CHARACTERISTIC
/begin CHARACTERISTIC DFC_DisblMsk.DFC_ComCtrSecInt_C "DFC/Abschalt Maske für Prüfung DFC_ComCtrSecInt" VALUE 0x80025F12 Val_Wu16 65535.00 DFES_OneToOne 0.00 65535.00 /end CHARACTERISTIC
/begin CHARACTERISTIC DFC_DisblMsk.DFC_ComDiaOBDGbxSig_A_C "DFC/Abschalt Maske für Prüfung DFC_ComDiaOBDGbxSig_A" VALUE 0x80025F14 Val_Wu16 65535.00 DFES_OneToOne 0.00 65535.00 /end CHARACTERISTIC
/begin CHARACTERISTIC DFC_DisblMsk.DFC_ComDiaOBDGbxTo_A_C "DFC/Abschalt Maske für Prüfung DFC_ComDiaOBDGbxTo_A" VALUE 0x80025F16 Val_Wu16 65535.00 DFES_OneToOne 0.00 65535.00 /end CHARACTERISTIC
/begin CHARACTERISTIC DFC_DisblMsk.DFC_ComFahrzeugtypSig_C "DFC/Abschalt Maske für Prüfung DFC_ComFahrzeugtypSig" VALUE 0x80025F18 Val_Wu16 65535.00 DFES_OneToOne 0.00 65535.00 /end CHARACTERISTIC
/begin CHARACTERISTIC DFC_DisblMsk.DFC_ComFahrzeugtypSig_FA_C "DFC/Abschalt Maske für Prüfung DFC_ComFahrzeugtypSig_FA" VALUE 0x80025F1A Val_Wu16 65535.00 DFES_OneToOne 0.00 65535.00 /end CHARACTERISTIC
/begin CHARACTERISTIC DFC_DisblMsk.DFC_ComFllupGpwsupSig_FA_C "DFC/Abschalt Maske für Prüfung DFC_ComFllupGpwsupSig_FA" VALUE 0x80025F1C Val_Wu16 65535.00 DFES_OneToOne 0.00 65535.00 /end CHARACTERISTIC
/begin CHARACTERISTIC DFC_DisblMsk.DFC_ComFllupGpwsupTo_FA_C "DFC/Abschalt Maske für Prüfung DFC_ComFllupGpwsupTo_FA" VALUE 0x80025F1E Val_Wu16 65535.00 DFES_OneToOne 0.00 65535.00 /end CHARACTERISTIC
/begin CHARACTERISTIC DFC_DisblMsk.DFC_ComGbxDataChk_A_C "DFC/Abschalt Maske für Prüfung DFC_ComGbxDataChk_A" VALUE 0x80025F20 Val_Wu16 65535.00 DFES_OneToOne 0.00 65535.00 /end CHARACTERISTIC
/begin CHARACTERISTIC DFC_DisblMsk.DFC_ComGbxDataChk_FA_C "DFC/Abschalt Maske für Prüfung DFC_ComGbxDataChk_FA" VALUE 0x80025F22 Val_Wu16 65535.00 DFES_OneToOne 0.00 65535.00 /end CHARACTERISTIC
/begin CHARACTERISTIC DFC_DisblMsk.DFC_ComGbxDataCtr_A_C "DFC/Abschalt Maske für Prüfung DFC_ComGbxDataCtr_A" VALUE 0x80025F24 Val_Wu16 65535.00 DFES_OneToOne 0.00 65535.00 /end CHARACTERISTIC
/begin CHARACTERISTIC DFC_DisblMsk.DFC_ComGbxDataCtr_FA_C "DFC/Abschalt Maske für Prüfung DFC_ComGbxDataCtr_FA" VALUE 0x80025F26 Val_Wu16 65535.00 DFES_OneToOne 0.00 65535.00 /end CHARACTERISTIC
/begin CHARACTERISTIC DFC_DisblMsk.DFC_ComGbxDataSig_A_C "DFC/Abschalt Maske für Prüfung DFC_ComGbxDataSig_A" VALUE 0x80025F28 Val_Wu16 65535.00 DFES_OneToOne 0.00 65535.00 /end CHARACTERISTIC
/begin CHARACTERISTIC DFC_DisblMsk.DFC_ComGbxDataSig_FA_C "DFC/Abschalt Maske für Prüfung DFC_ComGbxDataSig_FA" VALUE 0x80025F2A Val_Wu16 65535.00 DFES_OneToOne 0.00 65535.00 /end CHARACTERISTIC
/begin CHARACTERISTIC DFC_DisblMsk.DFC_ComGbxDataTo_A_C "DFC/Abschalt Maske für Prüfung DFC_ComGbxDataTo_A" VALUE 0x80025F2C Val_Wu16 65535.00 DFES_OneToOne 0.00 65535.00 /end CHARACTERISTIC
/begin CHARACTERISTIC DFC_DisblMsk.DFC_ComGbxDataTo_FA_C "DFC/Abschalt Maske für Prüfung DFC_ComGbxDataTo_FA" VALUE 0x80025F2E Val_Wu16 65535.00 DFES_OneToOne 0.00 65535.00 /end CHARACTERISTIC
/begin CHARACTERISTIC DFC_DisblMsk.DFC_ComKlemmenChk_FA_C "DFC/Abschalt Maske für Prüfung DFC_ComKlemmenChk_FA" VALUE 0x80025F30 Val_Wu16 65535.00 DFES_OneToOne 0.00 65535.00 /end CHARACTERISTIC
/begin CHARACTERISTIC DFC_DisblMsk.DFC_ComKlemmenCtr_FA_C "DFC/Abschalt Maske für Prüfung DFC_ComKlemmenCtr_FA" VALUE 0x80025F32 Val_Wu16 65535.00 DFES_OneToOne 0.00 65535.00 /end CHARACTERISTIC
/begin CHARACTERISTIC DFC_DisblMsk.DFC_ComKlemmenSig_FA_C "DFC/Abschalt Maske für Prüfung DFC_ComKlemmenSig_FA" VALUE 0x80025F34 Val_Wu16 65535.00 DFES_OneToOne 0.00 65535.00 /end CHARACTERISTIC
/begin CHARACTERISTIC DFC_DisblMsk.DFC_ComKlemmenTo_FA_C "DFC/Abschalt Maske für Prüfung DFC_ComKlemmenTo_FA" VALUE 0x80025F36 Val_Wu16 65535.00 DFES_OneToOne 0.00 65535.00 /end CHARACTERISTIC
/begin CHARACTERISTIC DFC_DisblMsk.DFC_ComLenkradwinkelSig_C "DFC/Abschalt Maske für Prüfung DFC_ComLenkradwinkelSig" VALUE 0x80025F38 Val_Wu16 65535.00 DFES_OneToOne 0.00 65535.00 /end CHARACTERISTIC
/begin CHARACTERISTIC DFC_DisblMsk.DFC_ComLenkradwinkelTo_C "DFC/Abschalt Maske für Prüfung DFC_ComLenkradwinkelTo" VALUE 0x80025F3A Val_Wu16 65535.00 DFES_OneToOne 0.00 65535.00 /end CHARACTERISTIC
/begin CHARACTERISTIC DFC_DisblMsk.DFC_ComMileageRangeSig_FA_C "DFC/Abschalt Maske für Prüfung DFC_ComMileageRangeSig_FA" VALUE 0x80025F3C Val_Wu16 65535.00 DFES_OneToOne 0.00 65535.00 /end CHARACTERISTIC
/begin CHARACTERISTIC DFC_DisblMsk.DFC_ComMileageRangeTo_FA_C "DFC/Abschalt Maske für Prüfung DFC_ComMileageRangeTo_FA" VALUE 0x80025F3E Val_Wu16 65535.00 DFES_OneToOne 0.00 65535.00 /end CHARACTERISTIC
/begin CHARACTERISTIC DFC_DisblMsk.DFC_ComPspSig_C "DFC/Abschalt Maske für Prüfung DFC_ComPspSig" VALUE 0x80025F40 Val_Wu16 65535.00 DFES_OneToOne 0.00 65535.00 /end CHARACTERISTIC
/begin CHARACTERISTIC DFC_DisblMsk.DFC_ComPspTo_C "DFC/Abschalt Maske für Prüfung DFC_ComPspTo" VALUE 0x80025F42 Val_Wu16 65535.00 DFES_OneToOne 0.00 65535.00 /end CHARACTERISTIC
/begin CHARACTERISTIC DFC_DisblMsk.DFC_ComRelTimeSig_FA_C "DFC/Abschalt Maske für Prüfung DFC_ComRelTimeSig_FA" VALUE 0x80025F44 Val_Wu16 65535.00 DFES_OneToOne 0.00 65535.00 /end CHARACTERISTIC
/begin CHARACTERISTIC DFC_DisblMsk.DFC_ComRelTimeTo_FA_C "DFC/Abschalt Maske für Prüfung DFC_ComRelTimeTo_FA" VALUE 0x80025F46 Val_Wu16 65535.00 DFES_OneToOne 0.00 65535.00 /end CHARACTERISTIC
/begin CHARACTERISTIC DFC_DisblMsk.DFC_ComRequestEMFChk_C "DFC/Abschalt Maske für Prüfung DFC_ComRequestEMFChk" VALUE 0x80025F48 Val_Wu16 65535.00 DFES_OneToOne 0.00 65535.00 /end CHARACTERISTIC
/begin CHARACTERISTIC DFC_DisblMsk.DFC_ComRequestEMFCtr_C "DFC/Abschalt Maske für Prüfung DFC_ComRequestEMFCtr" VALUE 0x80025F4A Val_Wu16 65535.00 DFES_OneToOne 0.00 65535.00 /end CHARACTERISTIC
/begin CHARACTERISTIC DFC_DisblMsk.DFC_ComRequestEMFSig_C "DFC/Abschalt Maske für Prüfung DFC_ComRequestEMFSig" VALUE 0x80025F4C Val_Wu16 65535.00 DFES_OneToOne 0.00 65535.00 /end CHARACTERISTIC
/begin CHARACTERISTIC DFC_DisblMsk.DFC_ComRequestEMFTo_C "DFC/Abschalt Maske für Prüfung DFC_ComRequestEMFTo" VALUE 0x80025F4E Val_Wu16 65535.00 DFES_OneToOne 0.00 65535.00 /end CHARACTERISTIC
/begin CHARACTERISTIC DFC_DisblMsk.DFC_ComRpmWhlChk_FX_C "DFC/Abschalt Maske für Prüfung DFC_ComRpmWhlChk_FX" VALUE 0x80025F50 Val_Wu16 65535.00 DFES_OneToOne 0.00 65535.00 /end CHARACTERISTIC
/begin CHARACTERISTIC DFC_DisblMsk.DFC_ComRpmWhlCtr_FX_C "DFC/Abschalt Maske für Prüfung DFC_ComRpmWhlCtr_FX" VALUE 0x80025F52 Val_Wu16 65535.00 DFES_OneToOne 0.00 65535.00 /end CHARACTERISTIC
/begin CHARACTERISTIC DFC_DisblMsk.DFC_ComRpmWhlTo_FX_C "DFC/Abschalt Maske für Prüfung DFC_ComRpmWhlTo_FX" VALUE 0x80025F54 Val_Wu16 65535.00 DFES_OneToOne 0.00 65535.00 /end CHARACTERISTIC
/begin CHARACTERISTIC DFC_DisblMsk.DFC_ComSecCtrRelSig_FA_C "DFC/Abschalt Maske für Prüfung DFC_ComSecCtrRelSig_FA" VALUE 0x80025F56 Val_Wu16 65535.00 DFES_OneToOne 0.00 65535.00 /end CHARACTERISTIC
/begin CHARACTERISTIC DFC_DisblMsk.DFC_ComSecCtrRelTo_FA_C "DFC/Abschalt Maske für Prüfung DFC_ComSecCtrRelTo_FA" VALUE 0x80025F58 Val_Wu16 65535.00 DFES_OneToOne 0.00 65535.00 /end CHARACTERISTIC
/begin CHARACTERISTIC DFC_DisblMsk.DFC_ComSensNOxGndSig_C "DFC/Abschalt Maske für Prüfung DFC_ComSensNOxGndSig" VALUE 0x80025F5A Val_Wu16 65535.00 DFES_OneToOne 0.00 65535.00 /end CHARACTERISTIC
/begin CHARACTERISTIC DFC_DisblMsk.DFC_ComSensNOxGndTo_C "DFC/Abschalt Maske für Prüfung DFC_ComSensNOxGndTo" VALUE 0x80025F5C Val_Wu16 65535.00 DFES_OneToOne 0.00 65535.00 /end CHARACTERISTIC
/begin CHARACTERISTIC DFC_DisblMsk.DFC_ComSensNOxMode_C "DFC/Abschalt Maske für Prüfung DFC_ComSensNOxMode" VALUE 0x80025F5E Val_Wu16 65535.00 DFES_OneToOne 0.00 65535.00 /end CHARACTERISTIC
/begin CHARACTERISTIC DFC_DisblMsk.DFC_ComSensNOxUbattSig_C "DFC/Abschalt Maske für Prüfung DFC_ComSensNOxUbattSig" VALUE 0x80025F60 Val_Wu16 65535.00 DFES_OneToOne 0.00 65535.00 /end CHARACTERISTIC
/begin CHARACTERISTIC DFC_DisblMsk.DFC_ComSensNOxUbattTo_C "DFC/Abschalt Maske für Prüfung DFC_ComSensNOxUbattTo" VALUE 0x80025F62 Val_Wu16 65535.00 DFES_OneToOne 0.00 65535.00 /end CHARACTERISTIC
/begin CHARACTERISTIC DFC_DisblMsk.DFC_ComShiftPaddleTo_FX_C "DFC/Abschalt Maske für Prüfung DFC_ComShiftPaddleTo_FX" VALUE 0x80025F64 Val_Wu16 65535.00 DFES_OneToOne 0.00 65535.00 /end CHARACTERISTIC
/begin CHARACTERISTIC DFC_DisblMsk.DFC_ComShutOffPSPSig_C "DFC/Abschalt Maske für Prüfung DFC_ComShutOffPSPSig" VALUE 0x80025F66 Val_Wu16 65535.00 DFES_OneToOne 0.00 65535.00 /end CHARACTERISTIC
/begin CHARACTERISTIC DFC_DisblMsk.DFC_ComShutOffPSPTo_C "DFC/Abschalt Maske für Prüfung DFC_ComShutOffPSPTo" VALUE 0x80025F68 Val_Wu16 65535.00 DFES_OneToOne 0.00 65535.00 /end CHARACTERISTIC
/begin CHARACTERISTIC DFC_DisblMsk.DFC_ComSlrdiGlbFZMTo_FA_C "DFC/Abschalt Maske für Prüfung DFC_ComSlrdiGlbFZMTo_FA" VALUE 0x80025F6A Val_Wu16 65535.00 DFES_OneToOne 0.00 65535.00 /end CHARACTERISTIC
/begin CHARACTERISTIC DFC_DisblMsk.DFC_ComSlrdiGlbFZMTo_FX_C "DFC/Abschalt Maske für Prüfung DFC_ComSlrdiGlbFZMTo_FX" VALUE 0x80025F6C Val_Wu16 65535.00 DFES_OneToOne 0.00 65535.00 /end CHARACTERISTIC
/begin CHARACTERISTIC DFC_DisblMsk.DFC_ComSpeedVehicleChk_FX_C "DFC/Abschalt Maske für Prüfung DFC_ComSpeedVehicleChk_FX" VALUE 0x80025F6E Val_Wu16 65535.00 DFES_OneToOne 0.00 65535.00 /end CHARACTERISTIC
/begin CHARACTERISTIC DFC_DisblMsk.DFC_ComSpeedVehicleCtr_FX_C "DFC/Abschalt Maske für Prüfung DFC_ComSpeedVehicleCtr_FX" VALUE 0x80025F70 Val_Wu16 65535.00 DFES_OneToOne 0.00 65535.00 /end CHARACTERISTIC
/begin CHARACTERISTIC DFC_DisblMsk.DFC_ComSpeedVehicleTo_FX_C "DFC/Abschalt Maske für Prüfung DFC_ComSpeedVehicleTo_FX" VALUE 0x80025F72 Val_Wu16 65535.00 DFES_OneToOne 0.00 65535.00 /end CHARACTERISTIC
/begin CHARACTERISTIC DFC_DisblMsk.DFC_ComStConintDSCChk_FX_C "DFC/Abschalt Maske für Prüfung DFC_ComStConintDSCChk_FX" VALUE 0x80025F74 Val_Wu16 65535.00 DFES_OneToOne 0.00 65535.00 /end CHARACTERISTIC
/begin CHARACTERISTIC DFC_DisblMsk.DFC_ComStConintDSCCtr_FX_C "DFC/Abschalt Maske für Prüfung DFC_ComStConintDSCCtr_FX" VALUE 0x80025F76 Val_Wu16 65535.00 DFES_OneToOne 0.00 65535.00 /end CHARACTERISTIC
/begin CHARACTERISTIC DFC_DisblMsk.DFC_ComStConintDSCTo_FX_C "DFC/Abschalt Maske für Prüfung DFC_ComStConintDSCTo_FX" VALUE 0x80025F78 Val_Wu16 65535.00 DFES_OneToOne 0.00 65535.00 /end CHARACTERISTIC
/begin CHARACTERISTIC DFC_DisblMsk.DFC_ComStatACFrontSig_FA_C "DFC/Abschalt Maske für Prüfung DFC_ComStatACFrontSig_FA" VALUE 0x80025F7A Val_Wu16 65535.00 DFES_OneToOne 0.00 65535.00 /end CHARACTERISTIC
/begin CHARACTERISTIC DFC_DisblMsk.DFC_ComStatACFrontTo_FA_C "DFC/Abschalt Maske für Prüfung DFC_ComStatACFrontTo_FA" VALUE 0x80025F7C Val_Wu16 65535.00 DFES_OneToOne 0.00 65535.00 /end CHARACTERISTIC
/begin CHARACTERISTIC DFC_DisblMsk.DFC_ComStatEkpSig_A_C "DFC/Abschalt Maske für Prüfung DFC_ComStatEkpSig_A" VALUE 0x80025F7E Val_Wu16 65535.00 DFES_OneToOne 0.00 65535.00 /end CHARACTERISTIC
/begin CHARACTERISTIC DFC_DisblMsk.DFC_ComStatEkpTo_A_C "DFC/Abschalt Maske für Prüfung DFC_ComStatEkpTo_A" VALUE 0x80025F80 Val_Wu16 65535.00 DFES_OneToOne 0.00 65535.00 /end CHARACTERISTIC
/begin CHARACTERISTIC DFC_DisblMsk.DFC_ComStatGearRevSig_FA_C "DFC/Abschalt Maske für Prüfung DFC_ComStatGearRevSig_FA" VALUE 0x80025F82 Val_Wu16 65535.00 DFES_OneToOne 0.00 65535.00 /end CHARACTERISTIC
/begin CHARACTERISTIC DFC_DisblMsk.DFC_ComStatGearRevTo_FA_C "DFC/Abschalt Maske für Prüfung DFC_ComStatGearRevTo_FA" VALUE 0x80025F84 Val_Wu16 65535.00 DFES_OneToOne 0.00 65535.00 /end CHARACTERISTIC
/begin CHARACTERISTIC DFC_DisblMsk.DFC_ComStatZVKlappenSig_FA_C "DFC/Abschalt Maske für Prüfung DFC_ComStatZVKlappenSig_FA" VALUE 0x80025F86 Val_Wu16 65535.00 DFES_OneToOne 0.00 65535.00 /end CHARACTERISTIC
/begin CHARACTERISTIC DFC_DisblMsk.DFC_ComStatZVKlappenTo_FA_C "DFC/Abschalt Maske für Prüfung DFC_ComStatZVKlappenTo_FA" VALUE 0x80025F88 Val_Wu16 65535.00 DFES_OneToOne 0.00 65535.00 /end CHARACTERISTIC
/begin CHARACTERISTIC DFC_DisblMsk.DFC_ComStateARSCtr_C "DFC/Abschalt Maske für Prüfung DFC_ComStateARSCtr" VALUE 0x80025F8A Val_Wu16 65535.00 DFES_OneToOne 0.00 65535.00 /end CHARACTERISTIC
/begin CHARACTERISTIC DFC_DisblMsk.DFC_ComStateARSSig_C "DFC/Abschalt Maske für Prüfung DFC_ComStateARSSig" VALUE 0x80025F8C Val_Wu16 65535.00 DFES_OneToOne 0.00 65535.00 /end CHARACTERISTIC
/begin CHARACTERISTIC DFC_DisblMsk.DFC_ComStateARSTo_C "DFC/Abschalt Maske für Prüfung DFC_ComStateARSTo" VALUE 0x80025F8E Val_Wu16 65535.00 DFES_OneToOne 0.00 65535.00 /end CHARACTERISTIC
/begin CHARACTERISTIC DFC_DisblMsk.DFC_ComStateDscSig_C "DFC/Abschalt Maske für Prüfung DFC_ComStateDscSig" VALUE 0x80025F90 Val_Wu16 65535.00 DFES_OneToOne 0.00 65535.00 /end CHARACTERISTIC
/begin CHARACTERISTIC DFC_DisblMsk.DFC_ComStateDscTo_C "DFC/Abschalt Maske für Prüfung DFC_ComStateDscTo" VALUE 0x80025F92 Val_Wu16 65535.00 DFES_OneToOne 0.00 65535.00 /end CHARACTERISTIC
/begin CHARACTERISTIC DFC_DisblMsk.DFC_ComStateSeatSig_C "DFC/Abschalt Maske für Prüfung DFC_ComStateSeatSig" VALUE 0x80025F94 Val_Wu16 65535.00 DFES_OneToOne 0.00 65535.00 /end CHARACTERISTIC
/begin CHARACTERISTIC DFC_DisblMsk.DFC_ComStateSeatSig_FA_C "DFC/Abschalt Maske für Prüfung DFC_ComStateSeatSig_FA" VALUE 0x80025F96 Val_Wu16 65535.00 DFES_OneToOne 0.00 65535.00 /end CHARACTERISTIC
/begin CHARACTERISTIC DFC_DisblMsk.DFC_ComStateSeatTo_C "DFC/Abschalt Maske für Prüfung DFC_ComStateSeatTo" VALUE 0x80025F98 Val_Wu16 65535.00 DFES_OneToOne 0.00 65535.00 /end CHARACTERISTIC
/begin CHARACTERISTIC DFC_DisblMsk.DFC_ComStateSeatTo_FA_C "DFC/Abschalt Maske für Prüfung DFC_ComStateSeatTo_FA" VALUE 0x80025F9A Val_Wu16 65535.00 DFES_OneToOne 0.00 65535.00 /end CHARACTERISTIC
/begin CHARACTERISTIC DFC_DisblMsk.DFC_ComStatusEGSSig_A_C "DFC/Abschalt Maske für Prüfung DFC_ComStatusEGSSig_A" VALUE 0x80025F9C Val_Wu16 65535.00 DFES_OneToOne 0.00 65535.00 /end CHARACTERISTIC
/begin CHARACTERISTIC DFC_DisblMsk.DFC_ComStatusEGSSig_FA_C "DFC/Abschalt Maske für Prüfung DFC_ComStatusEGSSig_FA" VALUE 0x80025F9E Val_Wu16 65535.00 DFES_OneToOne 0.00 65535.00 /end CHARACTERISTIC
/begin CHARACTERISTIC DFC_DisblMsk.DFC_ComStatusEGSTo_A_C "DFC/Abschalt Maske für Prüfung DFC_ComStatusEGSTo_A" VALUE 0x80025FA0 Val_Wu16 65535.00 DFES_OneToOne 0.00 65535.00 /end CHARACTERISTIC
/begin CHARACTERISTIC DFC_DisblMsk.DFC_ComStatusEGSTo_FA_C "DFC/Abschalt Maske für Prüfung DFC_ComStatusEGSTo_FA" VALUE 0x80025FA2 Val_Wu16 65535.00 DFES_OneToOne 0.00 65535.00 /end CHARACTERISTIC
/begin CHARACTERISTIC DFC_DisblMsk.DFC_ComStatusEMFChk_C "DFC/Abschalt Maske für Prüfung DFC_ComStatusEMFChk" VALUE 0x80025FA4 Val_Wu16 65535.00 DFES_OneToOne 0.00 65535.00 /end CHARACTERISTIC
/begin CHARACTERISTIC DFC_DisblMsk.DFC_ComStatusEMFCtr_C "DFC/Abschalt Maske für Prüfung DFC_ComStatusEMFCtr" VALUE 0x80025FA6 Val_Wu16 65535.00 DFES_OneToOne 0.00 65535.00 /end CHARACTERISTIC
/begin CHARACTERISTIC DFC_DisblMsk.DFC_ComStatusEMFSig_C "DFC/Abschalt Maske für Prüfung DFC_ComStatusEMFSig" VALUE 0x80025FA8 Val_Wu16 65535.00 DFES_OneToOne 0.00 65535.00 /end CHARACTERISTIC
/begin CHARACTERISTIC DFC_DisblMsk.DFC_ComStatusEMFTo_C "DFC/Abschalt Maske für Prüfung DFC_ComStatusEMFTo" VALUE 0x80025FAA Val_Wu16 65535.00 DFES_OneToOne 0.00 65535.00 /end CHARACTERISTIC
/begin CHARACTERISTIC DFC_DisblMsk.DFC_ComStatusRGangSig_C "DFC/Abschalt Maske für Prüfung DFC_ComStatusRGangSig" VALUE 0x80025FAC Val_Wu16 65535.00 DFES_OneToOne 0.00 65535.00 /end CHARACTERISTIC
/begin CHARACTERISTIC DFC_DisblMsk.DFC_ComStatusRGangTo_C "DFC/Abschalt Maske für Prüfung DFC_ComStatusRGangTo" VALUE 0x80025FAE Val_Wu16 65535.00 DFES_OneToOne 0.00 65535.00 /end CHARACTERISTIC
/begin CHARACTERISTIC DFC_DisblMsk.DFC_ComSteeringAngleChk_FX_C "DFC/Abschalt Maske für Prüfung DFC_ComSteeringAngleChk_FX" VALUE 0x80025FB0 Val_Wu16 65535.00 DFES_OneToOne 0.00 65535.00 /end CHARACTERISTIC
/begin CHARACTERISTIC DFC_DisblMsk.DFC_ComSteeringAngleCtr_FX_C "DFC/Abschalt Maske für Prüfung DFC_ComSteeringAngleCtr_FX" VALUE 0x80025FB2 Val_Wu16 65535.00 DFES_OneToOne 0.00 65535.00 /end CHARACTERISTIC
/begin CHARACTERISTIC DFC_DisblMsk.DFC_ComSteeringAngleTo_FX_C "DFC/Abschalt Maske für Prüfung DFC_ComSteeringAngleTo_FX" VALUE 0x80025FB4 Val_Wu16 65535.00 DFES_OneToOne 0.00 65535.00 /end CHARACTERISTIC
/begin CHARACTERISTIC DFC_DisblMsk.DFC_ComTerminalChk_C "DFC/Abschalt Maske für Prüfung DFC_ComTerminalChk" VALUE 0x80025FB6 Val_Wu16 65535.00 DFES_OneToOne 0.00 65535.00 /end CHARACTERISTIC
/begin CHARACTERISTIC DFC_DisblMsk.DFC_ComTerminalCtr_C "DFC/Abschalt Maske für Prüfung DFC_ComTerminalCtr" VALUE 0x80025FB8 Val_Wu16 65535.00 DFES_OneToOne 0.00 65535.00 /end CHARACTERISTIC
/begin CHARACTERISTIC DFC_DisblMsk.DFC_ComTerminalSig_C "DFC/Abschalt Maske für Prüfung DFC_ComTerminalSig" VALUE 0x80025FBA Val_Wu16 65535.00 DFES_OneToOne 0.00 65535.00 /end CHARACTERISTIC
/begin CHARACTERISTIC DFC_DisblMsk.DFC_ComTerminalTo_C "DFC/Abschalt Maske für Prüfung DFC_ComTerminalTo" VALUE 0x80025FBC Val_Wu16 65535.00 DFES_OneToOne 0.00 65535.00 /end CHARACTERISTIC
/begin CHARACTERISTIC DFC_DisblMsk.DFC_ComTimeDateSig_FA_C "DFC/Abschalt Maske für Prüfung DFC_ComTimeDateSig_FA" VALUE 0x80025FBE Val_Wu16 65535.00 DFES_OneToOne 0.00 65535.00 /end CHARACTERISTIC
/begin CHARACTERISTIC DFC_DisblMsk.DFC_ComTimeDateTo_FA_C "DFC/Abschalt Maske für Prüfung DFC_ComTimeDateTo_FA" VALUE 0x80025FC0 Val_Wu16 65535.00 DFES_OneToOne 0.00 65535.00 /end CHARACTERISTIC
/begin CHARACTERISTIC DFC_DisblMsk.DFC_ComTrailerSig_C "DFC/Abschalt Maske für Prüfung DFC_ComTrailerSig" VALUE 0x80025FC2 Val_Wu16 65535.00 DFES_OneToOne 0.00 65535.00 /end CHARACTERISTIC
/begin CHARACTERISTIC DFC_DisblMsk.DFC_ComTrailerSig_FA_C "DFC/Abschalt Maske für Prüfung DFC_ComTrailerSig_FA" VALUE 0x80025FC4 Val_Wu16 65535.00 DFES_OneToOne 0.00 65535.00 /end CHARACTERISTIC
/begin CHARACTERISTIC DFC_DisblMsk.DFC_ComTrailerTo_C "DFC/Abschalt Maske für Prüfung DFC_ComTrailerTo" VALUE 0x80025FC6 Val_Wu16 65535.00 DFES_OneToOne 0.00 65535.00 /end CHARACTERISTIC
/begin CHARACTERISTIC DFC_DisblMsk.DFC_ComTrailerTo_FA_C "DFC/Abschalt Maske für Prüfung DFC_ComTrailerTo_FA" VALUE 0x80025FC8 Val_Wu16 65535.00 DFES_OneToOne 0.00 65535.00 /end CHARACTERISTIC
/begin CHARACTERISTIC DFC_DisblMsk.DFC_ComTrqDemCrshDrDyChk_FX_C "DFC/Abschalt Maske für Prüfung DFC_ComTrqDemCrshDrDyChk_FX" VALUE 0x80025FCA Val_Wu16 65535.00 DFES_OneToOne 0.00 65535.00 /end CHARACTERISTIC
/begin CHARACTERISTIC DFC_DisblMsk.DFC_ComTrqDemCrshDrDyCtr_FX_C "DFC/Abschalt Maske für Prüfung DFC_ComTrqDemCrshDrDyCtr_FX" VALUE 0x80025FCC Val_Wu16 65535.00 DFES_OneToOne 0.00 65535.00 /end CHARACTERISTIC
/begin CHARACTERISTIC DFC_DisblMsk.DFC_ComTrqDemCrshDrDyTo_FX_C "DFC/Abschalt Maske für Prüfung DFC_ComTrqDemCrshDrDyTo_FX" VALUE 0x80025FCE Val_Wu16 65535.00 DFES_OneToOne 0.00 65535.00 /end CHARACTERISTIC
/begin CHARACTERISTIC DFC_DisblMsk.DFC_ComTrqDemandDesSig_C "DFC/Abschalt Maske für Prüfung DFC_ComTrqDemandDesSig" VALUE 0x80025FD0 Val_Wu16 65535.00 DFES_OneToOne 0.00 65535.00 /end CHARACTERISTIC
/begin CHARACTERISTIC DFC_DisblMsk.DFC_ComTrqDemandDesTo_C "DFC/Abschalt Maske für Prüfung DFC_ComTrqDemandDesTo" VALUE 0x80025FD2 Val_Wu16 65535.00 DFES_OneToOne 0.00 65535.00 /end CHARACTERISTIC
/begin CHARACTERISTIC DFC_DisblMsk.DFC_ComTrqDemandDscChk_C "DFC/Abschalt Maske für Prüfung DFC_ComTrqDemandDscChk" VALUE 0x80025FD4 Val_Wu16 65535.00 DFES_OneToOne 0.00 65535.00 /end CHARACTERISTIC
/begin CHARACTERISTIC DFC_DisblMsk.DFC_ComTrqDemandDscCtr_C "DFC/Abschalt Maske für Prüfung DFC_ComTrqDemandDscCtr" VALUE 0x80025FD6 Val_Wu16 65535.00 DFES_OneToOne 0.00 65535.00 /end CHARACTERISTIC
/begin CHARACTERISTIC DFC_DisblMsk.DFC_ComTrqDemandDscSig_C "DFC/Abschalt Maske für Prüfung DFC_ComTrqDemandDscSig" VALUE 0x80025FD8 Val_Wu16 65535.00 DFES_OneToOne 0.00 65535.00 /end CHARACTERISTIC
/begin CHARACTERISTIC DFC_DisblMsk.DFC_ComTrqDemandDscTo_C "DFC/Abschalt Maske für Prüfung DFC_ComTrqDemandDscTo" VALUE 0x80025FDA Val_Wu16 65535.00 DFES_OneToOne 0.00 65535.00 /end CHARACTERISTIC
/begin CHARACTERISTIC DFC_DisblMsk.DFC_ComTrqDemandGbxChk_A_C "DFC/Abschalt Maske für Prüfung DFC_ComTrqDemandGbxChk_A" VALUE 0x80025FDC Val_Wu16 65535.00 DFES_OneToOne 0.00 65535.00 /end CHARACTERISTIC
/begin CHARACTERISTIC DFC_DisblMsk.DFC_ComTrqDemandGbxChk_FA_C "DFC/Abschalt Maske für Prüfung DFC_ComTrqDemandGbxChk_FA" VALUE 0x80025FDE Val_Wu16 65535.00 DFES_OneToOne 0.00 65535.00 /end CHARACTERISTIC
/begin CHARACTERISTIC DFC_DisblMsk.DFC_ComTrqDemandGbxCtr_A_C "DFC/Abschalt Maske für Prüfung DFC_ComTrqDemandGbxCtr_A" VALUE 0x80025FE0 Val_Wu16 65535.00 DFES_OneToOne 0.00 65535.00 /end CHARACTERISTIC
/begin CHARACTERISTIC DFC_DisblMsk.DFC_ComTrqDemandGbxCtr_FA_C "DFC/Abschalt Maske für Prüfung DFC_ComTrqDemandGbxCtr_FA" VALUE 0x80025FE2 Val_Wu16 65535.00 DFES_OneToOne 0.00 65535.00 /end CHARACTERISTIC
/begin CHARACTERISTIC DFC_DisblMsk.DFC_ComTrqDemandGbxSig_A_C "DFC/Abschalt Maske für Prüfung DFC_ComTrqDemandGbxSig_A" VALUE 0x80025FE4 Val_Wu16 65535.00 DFES_OneToOne 0.00 65535.00 /end CHARACTERISTIC
/begin CHARACTERISTIC DFC_DisblMsk.DFC_ComTrqDemandGbxSig_FA_C "DFC/Abschalt Maske für Prüfung DFC_ComTrqDemandGbxSig_FA" VALUE 0x80025FE6 Val_Wu16 65535.00 DFES_OneToOne 0.00 65535.00 /end CHARACTERISTIC
/begin CHARACTERISTIC DFC_DisblMsk.DFC_ComTrqDemandGbxTo_A_C "DFC/Abschalt Maske für Prüfung DFC_ComTrqDemandGbxTo_A" VALUE 0x80025FE8 Val_Wu16 65535.00 DFES_OneToOne 0.00 65535.00 /end CHARACTERISTIC
/begin CHARACTERISTIC DFC_DisblMsk.DFC_ComTrqDemandGbxTo_FA_C "DFC/Abschalt Maske für Prüfung DFC_ComTrqDemandGbxTo_FA" VALUE 0x80025FEA Val_Wu16 65535.00 DFES_OneToOne 0.00 65535.00 /end CHARACTERISTIC
/begin CHARACTERISTIC DFC_DisblMsk.DFC_ComTrqWhlDemChk_C "DFC/Abschalt Maske für Prüfung DFC_ComTrqWhlDemChk" VALUE 0x80025FEC Val_Wu16 65535.00 DFES_OneToOne 0.00 65535.00 /end CHARACTERISTIC
/begin CHARACTERISTIC DFC_DisblMsk.DFC_ComTrqWhlDemCtr_C "DFC/Abschalt Maske für Prüfung DFC_ComTrqWhlDemCtr" VALUE 0x80025FEE Val_Wu16 65535.00 DFES_OneToOne 0.00 65535.00 /end CHARACTERISTIC
/begin CHARACTERISTIC DFC_DisblMsk.DFC_ComTrqWhlDemFASChk_FX_C "DFC/Abschalt Maske für Prüfung DFC_ComTrqWhlDemFASChk_FX" VALUE 0x80025FF0 Val_Wu16 65535.00 DFES_OneToOne 0.00 65535.00 /end CHARACTERISTIC
/begin CHARACTERISTIC DFC_DisblMsk.DFC_ComTrqWhlDemFASCtr_FX_C "DFC/Abschalt Maske für Prüfung DFC_ComTrqWhlDemFASCtr_FX" VALUE 0x80025FF2 Val_Wu16 65535.00 DFES_OneToOne 0.00 65535.00 /end CHARACTERISTIC
/begin CHARACTERISTIC DFC_DisblMsk.DFC_ComTrqWhlDemFASTo_FX_C "DFC/Abschalt Maske für Prüfung DFC_ComTrqWhlDemFASTo_FX" VALUE 0x80025FF4 Val_Wu16 65535.00 DFES_OneToOne 0.00 65535.00 /end CHARACTERISTIC
/begin CHARACTERISTIC DFC_DisblMsk.DFC_ComTrqWhlDemSig_C "DFC/Abschalt Maske für Prüfung DFC_ComTrqWhlDemSig" VALUE 0x80025FF6 Val_Wu16 65535.00 DFES_OneToOne 0.00 65535.00 /end CHARACTERISTIC
/begin CHARACTERISTIC DFC_DisblMsk.DFC_ComTrqWhlDemTo_C "DFC/Abschalt Maske für Prüfung DFC_ComTrqWhlDemTo" VALUE 0x80025FF8 Val_Wu16 65535.00 DFES_OneToOne 0.00 65535.00 /end CHARACTERISTIC
/begin CHARACTERISTIC DFC_DisblMsk.DFC_ComVelocityChk_FA_C "DFC/Abschalt Maske für Prüfung DFC_ComVelocityChk_FA" VALUE 0x80025FFA Val_Wu16 65535.00 DFES_OneToOne 0.00 65535.00 /end CHARACTERISTIC
/begin CHARACTERISTIC DFC_DisblMsk.DFC_ComVelocityCtr_FA_C "DFC/Abschalt Maske für Prüfung DFC_ComVelocityCtr_FA" VALUE 0x80025FFC Val_Wu16 65535.00 DFES_OneToOne 0.00 65535.00 /end CHARACTERISTIC
/begin CHARACTERISTIC DFC_DisblMsk.DFC_ComVelocitySig_C "DFC/Abschalt Maske für Prüfung DFC_ComVelocitySig" VALUE 0x80025FFE Val_Wu16 65535.00 DFES_OneToOne 0.00 65535.00 /end CHARACTERISTIC
/begin CHARACTERISTIC DFC_DisblMsk.DFC_ComVelocitySig_FA_C "DFC/Abschalt Maske für Prüfung DFC_ComVelocitySig_FA" VALUE 0x80026000 Val_Wu16 65535.00 DFES_OneToOne 0.00 65535.00 /end CHARACTERISTIC
/begin CHARACTERISTIC DFC_DisblMsk.DFC_ComVelocityTo_C "DFC/Abschalt Maske für Prüfung DFC_ComVelocityTo" VALUE 0x80026002 Val_Wu16 65535.00 DFES_OneToOne 0.00 65535.00 /end CHARACTERISTIC
/begin CHARACTERISTIC DFC_DisblMsk.DFC_ComVelocityTo_FA_C "DFC/Abschalt Maske für Prüfung DFC_ComVelocityTo_FA" VALUE 0x80026004 Val_Wu16 65535.00 DFES_OneToOne 0.00 65535.00 /end CHARACTERISTIC
/begin CHARACTERISTIC DFC_DisblMsk.DFC_ComVerbraucherTo_C "DFC/Abschalt Maske für Prüfung DFC_ComVerbraucherTo" VALUE 0x80026006 Val_Wu16 65535.00 DFES_OneToOne 0.00 65535.00 /end CHARACTERISTIC
/begin CHARACTERISTIC DFC_DisblMsk.DFC_ComWMomPTStabChk_FX_C "DFC/Abschalt Maske für Prüfung DFC_ComWMomPTStabChk_FX" VALUE 0x80026008 Val_Wu16 65535.00 DFES_OneToOne 0.00 65535.00 /end CHARACTERISTIC
/begin CHARACTERISTIC DFC_DisblMsk.DFC_ComWMomPTStabCtr_FX_C "DFC/Abschalt Maske für Prüfung DFC_ComWMomPTStabCtr_FX" VALUE 0x8002600A Val_Wu16 65535.00 DFES_OneToOne 0.00 65535.00 /end CHARACTERISTIC
/begin CHARACTERISTIC DFC_DisblMsk.DFC_ComWMomPTStabTo_FX_C "DFC/Abschalt Maske für Prüfung DFC_ComWMomPTStabTo_FX" VALUE 0x8002600C Val_Wu16 65535.00 DFES_OneToOne 0.00 65535.00 /end CHARACTERISTIC
/begin CHARACTERISTIC DFC_DisblMsk.DFC_ComWheelSpeedSig_C "DFC/Abschalt Maske für Prüfung DFC_ComWheelSpeedSig" VALUE 0x8002600E Val_Wu16 65535.00 DFES_OneToOne 0.00 65535.00 /end CHARACTERISTIC
/begin CHARACTERISTIC DFC_DisblMsk.DFC_ComWheelSpeedTo_C "DFC/Abschalt Maske für Prüfung DFC_ComWheelSpeedTo" VALUE 0x80026010 Val_Wu16 65535.00 DFES_OneToOne 0.00 65535.00 /end CHARACTERISTIC
/begin CHARACTERISTIC DFC_DisblMsk.DFC_ComZvKlappenSig_C "DFC/Abschalt Maske für Prüfung DFC_ComZvKlappenSig" VALUE 0x80026012 Val_Wu16 65535.00 DFES_OneToOne 0.00 65535.00 /end CHARACTERISTIC
/begin CHARACTERISTIC DFC_DisblMsk.DFC_ComZvKlappenTo_C "DFC/Abschalt Maske für Prüfung DFC_ComZvKlappenTo" VALUE 0x80026014 Val_Wu16 65535.00 DFES_OneToOne 0.00 65535.00 /end CHARACTERISTIC
/begin CHARACTERISTIC DFC_DisblMsk.DFC_ComaDirectChk_FX_C "DFC/Abschalt Maske für Prüfung DFC_ComaDirectChk_FX" VALUE 0x80026016 Val_Wu16 65535.00 DFES_OneToOne 0.00 65535.00 /end CHARACTERISTIC
/begin CHARACTERISTIC DFC_DisblMsk.DFC_ComaDirectCtr_FX_C "DFC/Abschalt Maske für Prüfung DFC_ComaDirectCtr_FX" VALUE 0x80026018 Val_Wu16 65535.00 DFES_OneToOne 0.00 65535.00 /end CHARACTERISTIC
/begin CHARACTERISTIC DFC_DisblMsk.DFC_ComaDirectTo_FX_C "DFC/Abschalt Maske für Prüfung DFC_ComaDirectTo_FX" VALUE 0x8002601A Val_Wu16 65535.00 DFES_OneToOne 0.00 65535.00 /end CHARACTERISTIC
/begin CHARACTERISTIC DFC_DisblMsk.DFC_ComaSideChk_FX_C "DFC/Abschalt Maske für Prüfung DFC_ComaSideChk_FX" VALUE 0x8002601C Val_Wu16 65535.00 DFES_OneToOne 0.00 65535.00 /end CHARACTERISTIC
/begin CHARACTERISTIC DFC_DisblMsk.DFC_ComaSideCtr_FX_C "DFC/Abschalt Maske für Prüfung DFC_ComaSideCtr_FX" VALUE 0x8002601E Val_Wu16 65535.00 DFES_OneToOne 0.00 65535.00 /end CHARACTERISTIC
/begin CHARACTERISTIC DFC_DisblMsk.DFC_ComaSideTo_FX_C "DFC/Abschalt Maske für Prüfung DFC_ComaSideTo_FX" VALUE 0x80026020 Val_Wu16 65535.00 DFES_OneToOne 0.00 65535.00 /end CHARACTERISTIC
/begin CHARACTERISTIC DFC_DisblMsk.DFC_Cy320SpiCom_C "DFC/Abschalt Maske für Prüfung DFC_Cy320SpiCom" VALUE 0x80026022 Val_Wu16 65535.00 DFES_OneToOne 0.00 65535.00 /end CHARACTERISTIC
/begin CHARACTERISTIC DFC_DisblMsk.DFC_ETCtlDvtInrMax_C "DFC/Abschalt Maske für Prüfung DFC_ETCtlDvtInrMax" VALUE 0x80026024 Val_Wu16 65535.00 DFES_OneToOne 0.00 65535.00 /end CHARACTERISTIC
/begin CHARACTERISTIC DFC_DisblMsk.DFC_ETCtlDvtInrMin_C "DFC/Abschalt Maske für Prüfung DFC_ETCtlDvtInrMin" VALUE 0x80026026 Val_Wu16 65535.00 DFES_OneToOne 0.00 65535.00 /end CHARACTERISTIC
/begin CHARACTERISTIC DFC_DisblMsk.DFC_ETCtlDvtOutrMax_C "DFC/Abschalt Maske für Prüfung DFC_ETCtlDvtOutrMax" VALUE 0x80026028 Val_Wu16 65535.00 DFES_OneToOne 0.00 65535.00 /end CHARACTERISTIC
/begin CHARACTERISTIC DFC_DisblMsk.DFC_ETCtlDvtOutrMin_C "DFC/Abschalt Maske für Prüfung DFC_ETCtlDvtOutrMin" VALUE 0x8002602A Val_Wu16 65535.00 DFES_OneToOne 0.00 65535.00 /end CHARACTERISTIC
/begin CHARACTERISTIC DFC_DisblMsk.DFC_FBCqDvtMax_C "DFC/Abschalt Maske für Prüfung DFC_FBCqDvtMax" VALUE 0x8002602C Val_Wu16 65535.00 DFES_OneToOne 0.00 65535.00 /end CHARACTERISTIC
/begin CHARACTERISTIC DFC_DisblMsk.DFC_FBCqDvtMin_C "DFC/Abschalt Maske für Prüfung DFC_FBCqDvtMin" VALUE 0x8002602E Val_Wu16 65535.00 DFES_OneToOne 0.00 65535.00 /end CHARACTERISTIC
/begin CHARACTERISTIC DFC_DisblMsk.DFC_Fan4WinErr1_C "DFC/Abschalt Maske für Prüfung DFC_Fan4WinErr1" VALUE 0x80026030 Val_Wu16 65535.00 DFES_OneToOne 0.00 65535.00 /end CHARACTERISTIC
/begin CHARACTERISTIC DFC_DisblMsk.DFC_Fan4WinErr2_C "DFC/Abschalt Maske für Prüfung DFC_Fan4WinErr2" VALUE 0x80026032 Val_Wu16 65535.00 DFES_OneToOne 0.00 65535.00 /end CHARACTERISTIC
/begin CHARACTERISTIC DFC_DisblMsk.DFC_Fan4WinErr3_C "DFC/Abschalt Maske für Prüfung DFC_Fan4WinErr3" VALUE 0x80026034 Val_Wu16 65535.00 DFES_OneToOne 0.00 65535.00 /end CHARACTERISTIC
/begin CHARACTERISTIC DFC_DisblMsk.DFC_Fan4WinErr4_C "DFC/Abschalt Maske für Prüfung DFC_Fan4WinErr4" VALUE 0x80026036 Val_Wu16 65535.00 DFES_OneToOne 0.00 65535.00 /end CHARACTERISTIC
/begin CHARACTERISTIC DFC_DisblMsk.DFC_FanSCG_C "DFC/Abschalt Maske für Prüfung DFC_FanSCG" VALUE 0x80026038 Val_Wu16 65535.00 DFES_OneToOne 0.00 65535.00 /end CHARACTERISTIC
/begin CHARACTERISTIC DFC_DisblMsk.DFC_FlFCBS_C "DFC/Abschalt Maske für Prüfung DFC_FlFCBS" VALUE 0x8002603A Val_Wu16 65535.00 DFES_OneToOne 0.00 65535.00 /end CHARACTERISTIC
/begin CHARACTERISTIC DFC_DisblMsk.DFC_GlwEcuConfigErr_C "DFC/Abschalt Maske für Prüfung DFC_GlwEcuConfigErr" VALUE 0x8002603C Val_Wu16 65535.00 DFES_OneToOne 0.00 65535.00 /end CHARACTERISTIC
/begin CHARACTERISTIC DFC_DisblMsk.DFC_GlwEcuEepErr_C "DFC/Abschalt Maske für Prüfung DFC_GlwEcuEepErr" VALUE 0x8002603E Val_Wu16 65535.00 DFES_OneToOne 0.00 65535.00 /end CHARACTERISTIC
/begin CHARACTERISTIC DFC_DisblMsk.DFC_GlwEcuFrmErr_C "DFC/Abschalt Maske für Prüfung DFC_GlwEcuFrmErr" VALUE 0x80026040 Val_Wu16 65535.00 DFES_OneToOne 0.00 65535.00 /end CHARACTERISTIC
/begin CHARACTERISTIC DFC_DisblMsk.DFC_GlwEcuGPCMFaultInfo_C "DFC/Abschalt Maske für Prüfung DFC_GlwEcuGPCMFaultInfo" VALUE 0x80026042 Val_Wu16 65535.00 DFES_OneToOne 0.00 65535.00 /end CHARACTERISTIC
/begin CHARACTERISTIC DFC_DisblMsk.DFC_GlwEcuGPCMInfo_C "DFC/Abschalt Maske für Prüfung DFC_GlwEcuGPCMInfo" VALUE 0x80026044 Val_Wu16 65535.00 DFES_OneToOne 0.00 65535.00 /end CHARACTERISTIC
/begin CHARACTERISTIC DFC_DisblMsk.DFC_GlwEcuGk1HSS_C "DFC/Abschalt Maske für Prüfung DFC_GlwEcuGk1HSS" VALUE 0x80026046 Val_Wu16 65535.00 DFES_OneToOne 0.00 65535.00 /end CHARACTERISTIC
/begin CHARACTERISTIC DFC_DisblMsk.DFC_GlwEcuGk1OL_C "DFC/Abschalt Maske für Prüfung DFC_GlwEcuGk1OL" VALUE 0x80026048 Val_Wu16 65535.00 DFES_OneToOne 0.00 65535.00 /end CHARACTERISTIC
/begin CHARACTERISTIC DFC_DisblMsk.DFC_GlwEcuGk1SC_C "DFC/Abschalt Maske für Prüfung DFC_GlwEcuGk1SC" VALUE 0x8002604A Val_Wu16 65535.00 DFES_OneToOne 0.00 65535.00 /end CHARACTERISTIC
/begin CHARACTERISTIC DFC_DisblMsk.DFC_GlwEcuGk1Wdst_C "DFC/Abschalt Maske für Prüfung DFC_GlwEcuGk1Wdst" VALUE 0x8002604C Val_Wu16 65535.00 DFES_OneToOne 0.00 65535.00 /end CHARACTERISTIC
/begin CHARACTERISTIC DFC_DisblMsk.DFC_GlwEcuGk2HSS_C "DFC/Abschalt Maske für Prüfung DFC_GlwEcuGk2HSS" VALUE 0x8002604E Val_Wu16 65535.00 DFES_OneToOne 0.00 65535.00 /end CHARACTERISTIC
/begin CHARACTERISTIC DFC_DisblMsk.DFC_GlwEcuGk2OL_C "DFC/Abschalt Maske für Prüfung DFC_GlwEcuGk2OL" VALUE 0x80026050 Val_Wu16 65535.00 DFES_OneToOne 0.00 65535.00 /end CHARACTERISTIC
/begin CHARACTERISTIC DFC_DisblMsk.DFC_GlwEcuGk2SC_C "DFC/Abschalt Maske für Prüfung DFC_GlwEcuGk2SC" VALUE 0x80026052 Val_Wu16 65535.00 DFES_OneToOne 0.00 65535.00 /end CHARACTERISTIC
/begin CHARACTERISTIC DFC_DisblMsk.DFC_GlwEcuGk2Wdst_C "DFC/Abschalt Maske für Prüfung DFC_GlwEcuGk2Wdst" VALUE 0x80026054 Val_Wu16 65535.00 DFES_OneToOne 0.00 65535.00 /end CHARACTERISTIC
/begin CHARACTERISTIC DFC_DisblMsk.DFC_GlwEcuGk3HSS_C "DFC/Abschalt Maske für Prüfung DFC_GlwEcuGk3HSS" VALUE 0x80026056 Val_Wu16 65535.00 DFES_OneToOne 0.00 65535.00 /end CHARACTERISTIC
/begin CHARACTERISTIC DFC_DisblMsk.DFC_GlwEcuGk3OL_C "DFC/Abschalt Maske für Prüfung DFC_GlwEcuGk3OL" VALUE 0x80026058 Val_Wu16 65535.00 DFES_OneToOne 0.00 65535.00 /end CHARACTERISTIC
/begin CHARACTERISTIC DFC_DisblMsk.DFC_GlwEcuGk3SC_C "DFC/Abschalt Maske für Prüfung DFC_GlwEcuGk3SC" VALUE 0x8002605A Val_Wu16 65535.00 DFES_OneToOne 0.00 65535.00 /end CHARACTERISTIC
/begin CHARACTERISTIC DFC_DisblMsk.DFC_GlwEcuGk3Wdst_C "DFC/Abschalt Maske für Prüfung DFC_GlwEcuGk3Wdst" VALUE 0x8002605C Val_Wu16 65535.00 DFES_OneToOne 0.00 65535.00 /end CHARACTERISTIC
/begin CHARACTERISTIC DFC_DisblMsk.DFC_GlwEcuGk4HSS_C "DFC/Abschalt Maske für Prüfung DFC_GlwEcuGk4HSS" VALUE 0x8002605E Val_Wu16 65535.00 DFES_OneToOne 0.00 65535.00 /end CHARACTERISTIC
/begin CHARACTERISTIC DFC_DisblMsk.DFC_GlwEcuGk4OL_C "DFC/Abschalt Maske für Prüfung DFC_GlwEcuGk4OL" VALUE 0x80026060 Val_Wu16 65535.00 DFES_OneToOne 0.00 65535.00 /end CHARACTERISTIC
/begin CHARACTERISTIC DFC_DisblMsk.DFC_GlwEcuGk4SC_C "DFC/Abschalt Maske für Prüfung DFC_GlwEcuGk4SC" VALUE 0x80026062 Val_Wu16 65535.00 DFES_OneToOne 0.00 65535.00 /end CHARACTERISTIC
/begin CHARACTERISTIC DFC_DisblMsk.DFC_GlwEcuGk4Wdst_C "DFC/Abschalt Maske für Prüfung DFC_GlwEcuGk4Wdst" VALUE 0x80026064 Val_Wu16 65535.00 DFES_OneToOne 0.00 65535.00 /end CHARACTERISTIC
/begin CHARACTERISTIC DFC_DisblMsk.DFC_GlwEcuGk5HSS_C "DFC/Abschalt Maske für Prüfung DFC_GlwEcuGk5HSS" VALUE 0x80026066 Val_Wu16 65535.00 DFES_OneToOne 0.00 65535.00 /end CHARACTERISTIC
/begin CHARACTERISTIC DFC_DisblMsk.DFC_GlwEcuGk5OL_C "DFC/Abschalt Maske für Prüfung DFC_GlwEcuGk5OL" VALUE 0x80026068 Val_Wu16 65535.00 DFES_OneToOne 0.00 65535.00 /end CHARACTERISTIC
/begin CHARACTERISTIC DFC_DisblMsk.DFC_GlwEcuGk5SC_C "DFC/Abschalt Maske für Prüfung DFC_GlwEcuGk5SC" VALUE 0x8002606A Val_Wu16 65535.00 DFES_OneToOne 0.00 65535.00 /end CHARACTERISTIC
/begin CHARACTERISTIC DFC_DisblMsk.DFC_GlwEcuGk5Wdst_C "DFC/Abschalt Maske für Prüfung DFC_GlwEcuGk5Wdst" VALUE 0x8002606C Val_Wu16 65535.00 DFES_OneToOne 0.00 65535.00 /end CHARACTERISTIC
/begin CHARACTERISTIC DFC_DisblMsk.DFC_GlwEcuGk6HSS_C "DFC/Abschalt Maske für Prüfung DFC_GlwEcuGk6HSS" VALUE 0x8002606E Val_Wu16 65535.00 DFES_OneToOne 0.00 65535.00 /end CHARACTERISTIC
/begin CHARACTERISTIC DFC_DisblMsk.DFC_GlwEcuGk6OL_C "DFC/Abschalt Maske für Prüfung DFC_GlwEcuGk6OL" VALUE 0x80026070 Val_Wu16 65535.00 DFES_OneToOne 0.00 65535.00 /end CHARACTERISTIC
/begin CHARACTERISTIC DFC_DisblMsk.DFC_GlwEcuGk6SC_C "DFC/Abschalt Maske für Prüfung DFC_GlwEcuGk6SC" VALUE 0x80026072 Val_Wu16 65535.00 DFES_OneToOne 0.00 65535.00 /end CHARACTERISTIC
/begin CHARACTERISTIC DFC_DisblMsk.DFC_GlwEcuGk6Wdst_C "DFC/Abschalt Maske für Prüfung DFC_GlwEcuGk6Wdst" VALUE 0x80026074 Val_Wu16 65535.00 DFES_OneToOne 0.00 65535.00 /end CHARACTERISTIC
/begin CHARACTERISTIC DFC_DisblMsk.DFC_GlwEcuGndErr_C "DFC/Abschalt Maske für Prüfung DFC_GlwEcuGndErr" VALUE 0x80026076 Val_Wu16 65535.00 DFES_OneToOne 0.00 65535.00 /end CHARACTERISTIC
/begin CHARACTERISTIC DFC_DisblMsk.DFC_GlwEcuIntErr_C "DFC/Abschalt Maske für Prüfung DFC_GlwEcuIntErr" VALUE 0x80026078 Val_Wu16 65535.00 DFES_OneToOne 0.00 65535.00 /end CHARACTERISTIC
/begin CHARACTERISTIC DFC_DisblMsk.DFC_GlwEcuMsgTimeout_C "DFC/Abschalt Maske für Prüfung DFC_GlwEcuMsgTimeout" VALUE 0x8002607A Val_Wu16 65535.00 DFES_OneToOne 0.00 65535.00 /end CHARACTERISTIC
/begin CHARACTERISTIC DFC_DisblMsk.DFC_GlwEcuT30Err_C "DFC/Abschalt Maske für Prüfung DFC_GlwEcuT30Err" VALUE 0x8002607C Val_Wu16 65535.00 DFES_OneToOne 0.00 65535.00 /end CHARACTERISTIC
/begin CHARACTERISTIC DFC_DisblMsk.DFC_GlwEcuTempErr_C "DFC/Abschalt Maske für Prüfung DFC_GlwEcuTempErr" VALUE 0x8002607E Val_Wu16 65535.00 DFES_OneToOne 0.00 65535.00 /end CHARACTERISTIC
/begin CHARACTERISTIC DFC_DisblMsk.DFC_GlwEcuUdiffT30_C "DFC/Abschalt Maske für Prüfung DFC_GlwEcuUdiffT30" VALUE 0x80026080 Val_Wu16 65535.00 DFES_OneToOne 0.00 65535.00 /end CHARACTERISTIC
/begin CHARACTERISTIC DFC_DisblMsk.DFC_IBSComErr_C "DFC/Abschalt Maske für Prüfung DFC_IBSComErr" VALUE 0x80026082 Val_Wu16 65535.00 DFES_OneToOne 0.00 65535.00 /end CHARACTERISTIC
/begin CHARACTERISTIC DFC_DisblMsk.DFC_LubSRCOilFldtCrit_C "DFC/Abschalt Maske für Prüfung DFC_LubSRCOilFldtCrit" VALUE 0x80026084 Val_Wu16 65535.00 DFES_OneToOne 0.00 65535.00 /end CHARACTERISTIC
/begin CHARACTERISTIC DFC_DisblMsk.DFC_LubSRCOilFldtCritDflMin_C "DFC/Abschalt Maske für Prüfung DFC_LubSRCOilFldtCritDflMin" VALUE 0x80026086 Val_Wu16 65535.00 DFES_OneToOne 0.00 65535.00 /end CHARACTERISTIC
/begin CHARACTERISTIC DFC_DisblMsk.DFC_LubSRCOilLvlCritMax_C "DFC/Abschalt Maske für Prüfung DFC_LubSRCOilLvlCritMax" VALUE 0x80026088 Val_Wu16 65535.00 DFES_OneToOne 0.00 65535.00 /end CHARACTERISTIC
/begin CHARACTERISTIC DFC_DisblMsk.DFC_LubSRCOilLvlCritMin_C "DFC/Abschalt Maske für Prüfung DFC_LubSRCOilLvlCritMin" VALUE 0x8002608A Val_Wu16 65535.00 DFES_OneToOne 0.00 65535.00 /end CHARACTERISTIC
/begin CHARACTERISTIC DFC_DisblMsk.DFC_LubSRCTot_C "DFC/Abschalt Maske für Prüfung DFC_LubSRCTot" VALUE 0x8002608C Val_Wu16 65535.00 DFES_OneToOne 0.00 65535.00 /end CHARACTERISTIC
/begin CHARACTERISTIC DFC_DisblMsk.DFC_MonUMaxSupply1_C "DFC/Abschalt Maske für Prüfung DFC_MonUMaxSupply1" VALUE 0x8002608E Val_Wu16 65535.00 DFES_OneToOne 0.00 65535.00 /end CHARACTERISTIC
/begin CHARACTERISTIC DFC_DisblMsk.DFC_MonUMinSupply1_C "DFC/Abschalt Maske für Prüfung DFC_MonUMinSupply1" VALUE 0x80026090 Val_Wu16 65535.00 DFES_OneToOne 0.00 65535.00 /end CHARACTERISTIC
/begin CHARACTERISTIC DFC_DisblMsk.DFC_OilComNpl_C "DFC/Abschalt Maske für Prüfung DFC_OilComNpl" VALUE 0x80026092 Val_Wu16 65535.00 DFES_OneToOne 0.00 65535.00 /end CHARACTERISTIC
/begin CHARACTERISTIC DFC_DisblMsk.DFC_PCBS_C "DFC/Abschalt Maske für Prüfung DFC_PCBS" VALUE 0x80026094 Val_Wu16 65535.00 DFES_OneToOne 0.00 65535.00 /end CHARACTERISTIC
/begin CHARACTERISTIC DFC_DisblMsk.DFC_PCBSPFltChg_C "DFC/Abschalt Maske für Prüfung DFC_PCBSPFltChg" VALUE 0x80026096 Val_Wu16 65535.00 DFES_OneToOne 0.00 65535.00 /end CHARACTERISTIC
/begin CHARACTERISTIC DFC_DisblMsk.DFC_PCRGovDvtLPMax_C "DFC/Abschalt Maske für Prüfung DFC_PCRGovDvtLPMax" VALUE 0x80026098 Val_Wu16 65535.00 DFES_OneToOne 0.00 65535.00 /end CHARACTERISTIC
/begin CHARACTERISTIC DFC_DisblMsk.DFC_PCRGovDvtLPMin_C "DFC/Abschalt Maske für Prüfung DFC_PCRGovDvtLPMin" VALUE 0x8002609A Val_Wu16 65535.00 DFES_OneToOne 0.00 65535.00 /end CHARACTERISTIC
/begin CHARACTERISTIC DFC_DisblMsk.DFC_PCRGovDvtMax_C "DFC/Abschalt Maske für Prüfung DFC_PCRGovDvtMax" VALUE 0x8002609C Val_Wu16 65535.00 DFES_OneToOne 0.00 65535.00 /end CHARACTERISTIC
/begin CHARACTERISTIC DFC_DisblMsk.DFC_PCRGovDvtMin_C "DFC/Abschalt Maske für Prüfung DFC_PCRGovDvtMin" VALUE 0x8002609E Val_Wu16 65535.00 DFES_OneToOne 0.00 65535.00 /end CHARACTERISTIC
/begin CHARACTERISTIC DFC_DisblMsk.DFC_PFltAPSPlausMAX_C "DFC/Abschalt Maske für Prüfung DFC_PFltAPSPlausMAX" VALUE 0x800260A0 Val_Wu16 65535.00 DFES_OneToOne 0.00 65535.00 /end CHARACTERISTIC
/begin CHARACTERISTIC DFC_DisblMsk.DFC_PFltAPSPlausMIN_C "DFC/Abschalt Maske für Prüfung DFC_PFltAPSPlausMIN" VALUE 0x800260A2 Val_Wu16 65535.00 DFES_OneToOne 0.00 65535.00 /end CHARACTERISTIC
/begin CHARACTERISTIC DFC_DisblMsk.DFC_PFltBPSPlausMAX_C "DFC/Abschalt Maske für Prüfung DFC_PFltBPSPlausMAX" VALUE 0x800260A4 Val_Wu16 65535.00 DFES_OneToOne 0.00 65535.00 /end CHARACTERISTIC
/begin CHARACTERISTIC DFC_DisblMsk.DFC_PFltBPSPlausMIN_C "DFC/Abschalt Maske für Prüfung DFC_PFltBPSPlausMIN" VALUE 0x800260A6 Val_Wu16 65535.00 DFES_OneToOne 0.00 65535.00 /end CHARACTERISTIC
/begin CHARACTERISTIC DFC_DisblMsk.DFC_PFltOvldInhRgn_C "DFC/Abschalt Maske für Prüfung DFC_PFltOvldInhRgn" VALUE 0x800260A8 Val_Wu16 65535.00 DFES_OneToOne 0.00 65535.00 /end CHARACTERISTIC
/begin CHARACTERISTIC DFC_DisblMsk.DFC_PFltOvldTrqLim_C "DFC/Abschalt Maske für Prüfung DFC_PFltOvldTrqLim" VALUE 0x800260AA Val_Wu16 65535.00 DFES_OneToOne 0.00 65535.00 /end CHARACTERISTIC
/begin CHARACTERISTIC DFC_DisblMsk.DFC_PFltPresPlausMAX_C "DFC/Abschalt Maske für Prüfung DFC_PFltPresPlausMAX" VALUE 0x800260AC Val_Wu16 65535.00 DFES_OneToOne 0.00 65535.00 /end CHARACTERISTIC
/begin CHARACTERISTIC DFC_DisblMsk.DFC_PFltPresPlausMIN_C "DFC/Abschalt Maske für Prüfung DFC_PFltPresPlausMIN" VALUE 0x800260AE Val_Wu16 65535.00 DFES_OneToOne 0.00 65535.00 /end CHARACTERISTIC
/begin CHARACTERISTIC DFC_DisblMsk.DFC_PFltTraRpmRdc_C "DFC/Abschalt Maske für Prüfung DFC_PFltTraRpmRdc" VALUE 0x800260B0 Val_Wu16 65535.00 DFES_OneToOne 0.00 65535.00 /end CHARACTERISTIC
/begin CHARACTERISTIC DFC_DisblMsk.DFC_PFlt_tOxiPreMax_C "DFC/Abschalt Maske für Prüfung DFC_PFlt_tOxiPreMax" VALUE 0x800260B2 Val_Wu16 65535.00 DFES_OneToOne 0.00 65535.00 /end CHARACTERISTIC
/begin CHARACTERISTIC DFC_DisblMsk.DFC_PFlt_tOxiPreMaxRgn_C "DFC/Abschalt Maske für Prüfung DFC_PFlt_tOxiPreMaxRgn" VALUE 0x800260B4 Val_Wu16 65535.00 DFES_OneToOne 0.00 65535.00 /end CHARACTERISTIC
/begin CHARACTERISTIC DFC_DisblMsk.DFC_PFlt_tOxiPreNpl_C "DFC/Abschalt Maske für Prüfung DFC_PFlt_tOxiPreNpl" VALUE 0x800260B6 Val_Wu16 65535.00 DFES_OneToOne 0.00 65535.00 /end CHARACTERISTIC
/begin CHARACTERISTIC DFC_DisblMsk.DFC_PFlt_tPreMax_C "DFC/Abschalt Maske für Prüfung DFC_PFlt_tPreMax" VALUE 0x800260B8 Val_Wu16 65535.00 DFES_OneToOne 0.00 65535.00 /end CHARACTERISTIC
/begin CHARACTERISTIC DFC_DisblMsk.DFC_PFlt_tPreMaxRgn_C "DFC/Abschalt Maske für Prüfung DFC_PFlt_tPreMaxRgn" VALUE 0x800260BA Val_Wu16 65535.00 DFES_OneToOne 0.00 65535.00 /end CHARACTERISTIC
/begin CHARACTERISTIC DFC_DisblMsk.DFC_PFlt_tPreNpl_C "DFC/Abschalt Maske für Prüfung DFC_PFlt_tPreNpl" VALUE 0x800260BC Val_Wu16 65535.00 DFES_OneToOne 0.00 65535.00 /end CHARACTERISTIC
/begin CHARACTERISTIC DFC_DisblMsk.DFC_PFltmSotDiffMAX_C "DFC/Abschalt Maske für Prüfung DFC_PFltmSotDiffMAX" VALUE 0x800260BE Val_Wu16 65535.00 DFES_OneToOne 0.00 65535.00 /end CHARACTERISTIC
/begin CHARACTERISTIC DFC_DisblMsk.DFC_PFltmSotDiffMIN_C "DFC/Abschalt Maske für Prüfung DFC_PFltmSotDiffMIN" VALUE 0x800260C0 Val_Wu16 65535.00 DFES_OneToOne 0.00 65535.00 /end CHARACTERISTIC
/begin CHARACTERISTIC DFC_DisblMsk.DFC_PFltmSotDiffSIG_C "DFC/Abschalt Maske für Prüfung DFC_PFltmSotDiffSIG" VALUE 0x800260C2 Val_Wu16 65535.00 DFES_OneToOne 0.00 65535.00 /end CHARACTERISTIC
/begin CHARACTERISTIC DFC_DisblMsk.DFC_PIntkVUsEnvPPls_C "DFC/Abschalt Maske für Prüfung DFC_PIntkVUsEnvPPls" VALUE 0x800260C4 Val_Wu16 65535.00 DFES_OneToOne 0.00 65535.00 /end CHARACTERISTIC
/begin CHARACTERISTIC DFC_DisblMsk.DFC_PresPlausDblDef_C "DFC/Abschalt Maske für Prüfung DFC_PresPlausDblDef" VALUE 0x800260C6 Val_Wu16 65535.00 DFES_OneToOne 0.00 65535.00 /end CHARACTERISTIC
/begin CHARACTERISTIC DFC_DisblMsk.DFC_RailCPC1_C "DFC/Abschalt Maske für Prüfung DFC_RailCPC1" VALUE 0x800260C8 Val_Wu16 65535.00 DFES_OneToOne 0.00 65535.00 /end CHARACTERISTIC
/begin CHARACTERISTIC DFC_DisblMsk.DFC_RailCPC3_C "DFC/Abschalt Maske für Prüfung DFC_RailCPC3" VALUE 0x800260CA Val_Wu16 65535.00 DFES_OneToOne 0.00 65535.00 /end CHARACTERISTIC
/begin CHARACTERISTIC DFC_DisblMsk.DFC_RailCPC4_C "DFC/Abschalt Maske für Prüfung DFC_RailCPC4" VALUE 0x800260CC Val_Wu16 65535.00 DFES_OneToOne 0.00 65535.00 /end CHARACTERISTIC
/begin CHARACTERISTIC DFC_DisblMsk.DFC_RailMeUn0_C "DFC/Abschalt Maske für Prüfung DFC_RailMeUn0" VALUE 0x800260CE Val_Wu16 65535.00 DFES_OneToOne 0.00 65535.00 /end CHARACTERISTIC
/begin CHARACTERISTIC DFC_DisblMsk.DFC_RailMeUn1_C "DFC/Abschalt Maske für Prüfung DFC_RailMeUn1" VALUE 0x800260D0 Val_Wu16 65535.00 DFES_OneToOne 0.00 65535.00 /end CHARACTERISTIC
/begin CHARACTERISTIC DFC_DisblMsk.DFC_RailMeUn2_C "DFC/Abschalt Maske für Prüfung DFC_RailMeUn2" VALUE 0x800260D2 Val_Wu16 65535.00 DFES_OneToOne 0.00 65535.00 /end CHARACTERISTIC
/begin CHARACTERISTIC DFC_DisblMsk.DFC_RailMeUn22_C "DFC/Abschalt Maske für Prüfung DFC_RailMeUn22" VALUE 0x800260D4 Val_Wu16 65535.00 DFES_OneToOne 0.00 65535.00 /end CHARACTERISTIC
/begin CHARACTERISTIC DFC_DisblMsk.DFC_RailMeUn3_C "DFC/Abschalt Maske für Prüfung DFC_RailMeUn3" VALUE 0x800260D6 Val_Wu16 65535.00 DFES_OneToOne 0.00 65535.00 /end CHARACTERISTIC
/begin CHARACTERISTIC DFC_DisblMsk.DFC_RailMeUn4_C "DFC/Abschalt Maske für Prüfung DFC_RailMeUn4" VALUE 0x800260D8 Val_Wu16 65535.00 DFES_OneToOne 0.00 65535.00 /end CHARACTERISTIC
/begin CHARACTERISTIC DFC_DisblMsk.DFC_RailMeUn42_C "DFC/Abschalt Maske für Prüfung DFC_RailMeUn42" VALUE 0x800260DA Val_Wu16 65535.00 DFES_OneToOne 0.00 65535.00 /end CHARACTERISTIC
/begin CHARACTERISTIC DFC_DisblMsk.DFC_RailMeUn5_C "DFC/Abschalt Maske für Prüfung DFC_RailMeUn5" VALUE 0x800260DC Val_Wu16 65535.00 DFES_OneToOne 0.00 65535.00 /end CHARACTERISTIC
/begin CHARACTERISTIC DFC_DisblMsk.DFC_RailPCV0_C "DFC/Abschalt Maske für Prüfung DFC_RailPCV0" VALUE 0x800260DE Val_Wu16 65535.00 DFES_OneToOne 0.00 65535.00 /end CHARACTERISTIC
/begin CHARACTERISTIC DFC_DisblMsk.DFC_RailPCV1_C "DFC/Abschalt Maske für Prüfung DFC_RailPCV1" VALUE 0x800260E0 Val_Wu16 65535.00 DFES_OneToOne 0.00 65535.00 /end CHARACTERISTIC
/begin CHARACTERISTIC DFC_DisblMsk.DFC_RailPCV2_C "DFC/Abschalt Maske für Prüfung DFC_RailPCV2" VALUE 0x800260E2 Val_Wu16 65535.00 DFES_OneToOne 0.00 65535.00 /end CHARACTERISTIC
/begin CHARACTERISTIC DFC_DisblMsk.DFC_RailPCV22_C "DFC/Abschalt Maske für Prüfung DFC_RailPCV22" VALUE 0x800260E4 Val_Wu16 65535.00 DFES_OneToOne 0.00 65535.00 /end CHARACTERISTIC
/begin CHARACTERISTIC DFC_DisblMsk.DFC_RailPCV3_C "DFC/Abschalt Maske für Prüfung DFC_RailPCV3" VALUE 0x800260E6 Val_Wu16 65535.00 DFES_OneToOne 0.00 65535.00 /end CHARACTERISTIC
/begin CHARACTERISTIC DFC_DisblMsk.DFC_RailPCV4_C "DFC/Abschalt Maske für Prüfung DFC_RailPCV4" VALUE 0x800260E8 Val_Wu16 65535.00 DFES_OneToOne 0.00 65535.00 /end CHARACTERISTIC
/begin CHARACTERISTIC DFC_DisblMsk.DFC_RailPCV42_C "DFC/Abschalt Maske für Prüfung DFC_RailPCV42" VALUE 0x800260EA Val_Wu16 65535.00 DFES_OneToOne 0.00 65535.00 /end CHARACTERISTIC
/begin CHARACTERISTIC DFC_DisblMsk.DFC_RailPMonStrt_C "DFC/Abschalt Maske für Prüfung DFC_RailPMonStrt" VALUE 0x800260EC Val_Wu16 65535.00 DFES_OneToOne 0.00 65535.00 /end CHARACTERISTIC
/begin CHARACTERISTIC DFC_DisblMsk.DFC_SSpMon1_C "DFC/Abschalt Maske für Prüfung DFC_SSpMon1" VALUE 0x800260EE Val_Wu16 65535.00 DFES_OneToOne 0.00 65535.00 /end CHARACTERISTIC
/begin CHARACTERISTIC DFC_DisblMsk.DFC_SSpMon2_C "DFC/Abschalt Maske für Prüfung DFC_SSpMon2" VALUE 0x800260F0 Val_Wu16 65535.00 DFES_OneToOne 0.00 65535.00 /end CHARACTERISTIC
/begin CHARACTERISTIC DFC_DisblMsk.DFC_SSpMon3_C "DFC/Abschalt Maske für Prüfung DFC_SSpMon3" VALUE 0x800260F2 Val_Wu16 65535.00 DFES_OneToOne 0.00 65535.00 /end CHARACTERISTIC
/begin CHARACTERISTIC DFC_DisblMsk.DFC_ThrVlv4WinErr1_C "DFC/Abschalt Maske für Prüfung DFC_ThrVlv4WinErr1" VALUE 0x800260F4 Val_Wu16 65535.00 DFES_OneToOne 0.00 65535.00 /end CHARACTERISTIC
/begin CHARACTERISTIC DFC_DisblMsk.DFC_ThrVlv4WinErr2_C "DFC/Abschalt Maske für Prüfung DFC_ThrVlv4WinErr2" VALUE 0x800260F6 Val_Wu16 65535.00 DFES_OneToOne 0.00 65535.00 /end CHARACTERISTIC
/begin CHARACTERISTIC DFC_DisblMsk.DFC_ThrVlv4WinErr3_C "DFC/Abschalt Maske für Prüfung DFC_ThrVlv4WinErr3" VALUE 0x800260F8 Val_Wu16 65535.00 DFES_OneToOne 0.00 65535.00 /end CHARACTERISTIC
/begin CHARACTERISTIC DFC_DisblMsk.DFC_ThrVlv4WinErr4_C "DFC/Abschalt Maske für Prüfung DFC_ThrVlv4WinErr4" VALUE 0x800260FA Val_Wu16 65535.00 DFES_OneToOne 0.00 65535.00 /end CHARACTERISTIC
/begin CHARACTERISTIC DFC_DisblMsk.DFC_ThrVlvSCG_C "DFC/Abschalt Maske für Prüfung DFC_ThrVlvSCG" VALUE 0x800260FC Val_Wu16 65535.00 DFES_OneToOne 0.00 65535.00 /end CHARACTERISTIC
/begin CHARACTERISTIC DFC_DisblMsk.DFC_Tle6232Spi1_C "DFC/Abschalt Maske für Prüfung DFC_Tle6232Spi1" VALUE 0x800260FE Val_Wu16 65535.00 DFES_OneToOne 0.00 65535.00 /end CHARACTERISTIC
/begin CHARACTERISTIC DFC_DisblMsk.DFC_TrbCh4WinErr1_C "DFC/Abschalt Maske für Prüfung DFC_TrbCh4WinErr1" VALUE 0x80026100 Val_Wu16 65535.00 DFES_OneToOne 0.00 65535.00 /end CHARACTERISTIC
/begin CHARACTERISTIC DFC_DisblMsk.DFC_TrbCh4WinErr2_C "DFC/Abschalt Maske für Prüfung DFC_TrbCh4WinErr2" VALUE 0x80026102 Val_Wu16 65535.00 DFES_OneToOne 0.00 65535.00 /end CHARACTERISTIC
/begin CHARACTERISTIC DFC_DisblMsk.DFC_TrbCh4WinErr3_C "DFC/Abschalt Maske für Prüfung DFC_TrbCh4WinErr3" VALUE 0x80026104 Val_Wu16 65535.00 DFES_OneToOne 0.00 65535.00 /end CHARACTERISTIC
/begin CHARACTERISTIC DFC_DisblMsk.DFC_TrbCh4WinErr4_C "DFC/Abschalt Maske für Prüfung DFC_TrbCh4WinErr4" VALUE 0x80026106 Val_Wu16 65535.00 DFES_OneToOne 0.00 65535.00 /end CHARACTERISTIC
/begin CHARACTERISTIC DFC_DisblMsk.DFC_TrbChSCG_C "DFC/Abschalt Maske für Prüfung DFC_TrbChSCG" VALUE 0x80026108 Val_Wu16 65535.00 DFES_OneToOne 0.00 65535.00 /end CHARACTERISTIC
/begin CHARACTERISTIC DFC_DisblMsk.DFC_TrbChSRCMax_C "DFC/Abschalt Maske für Prüfung DFC_TrbChSRCMax" VALUE 0x8002610A Val_Wu16 65535.00 DFES_OneToOne 0.00 65535.00 /end CHARACTERISTIC
/begin CHARACTERISTIC DFC_DisblMsk.DFC_TrbChSRCMin_C "DFC/Abschalt Maske für Prüfung DFC_TrbChSRCMin" VALUE 0x8002610C Val_Wu16 65535.00 DFES_OneToOne 0.00 65535.00 /end CHARACTERISTIC
/begin CHARACTERISTIC DFC_DisblMsk.DFC_WaHtEl4WinErr1_C "DFC/Abschalt Maske für Prüfung DFC_WaHtEl4WinErr1" VALUE 0x8002610E Val_Wu16 65535.00 DFES_OneToOne 0.00 65535.00 /end CHARACTERISTIC
/begin CHARACTERISTIC DFC_DisblMsk.DFC_WaHtEl4WinErr2_C "DFC/Abschalt Maske für Prüfung DFC_WaHtEl4WinErr2" VALUE 0x80026110 Val_Wu16 65535.00 DFES_OneToOne 0.00 65535.00 /end CHARACTERISTIC
/begin CHARACTERISTIC DFC_DisblMsk.DFC_WaHtEl4WinErr3_C "DFC/Abschalt Maske für Prüfung DFC_WaHtEl4WinErr3" VALUE 0x80026112 Val_Wu16 65535.00 DFES_OneToOne 0.00 65535.00 /end CHARACTERISTIC
/begin CHARACTERISTIC DFC_DisblMsk.DFC_WaHtEl4WinErr4_C "DFC/Abschalt Maske für Prüfung DFC_WaHtEl4WinErr4" VALUE 0x80026114 Val_Wu16 65535.00 DFES_OneToOne 0.00 65535.00 /end CHARACTERISTIC
/begin CHARACTERISTIC DFC_DisblMsk.DFC_WaHtElSCG_C "DFC/Abschalt Maske für Prüfung DFC_WaHtElSCG" VALUE 0x80026116 Val_Wu16 65535.00 DFES_OneToOne 0.00 65535.00 /end CHARACTERISTIC
/begin CHARACTERISTIC DFC_DisblMsk.DFC_ETClbETFltMax_0_C "DFC/Abschalt Maske für Prüfung DFC_ETClbETFltMax_0" VALUE 0x80026118 Val_Wu16 65535.00 DFES_OneToOne 0.00 65535.00 /end CHARACTERISTIC
/begin CHARACTERISTIC DFC_DisblMsk.DFC_ETClbETFltMax_1_C "DFC/Abschalt Maske für Prüfung DFC_ETClbETFltMax_1" VALUE 0x8002611A Val_Wu16 65535.00 DFES_OneToOne 0.00 65535.00 /end CHARACTERISTIC
/begin CHARACTERISTIC DFC_DisblMsk.DFC_ETClbETFltMax_2_C "DFC/Abschalt Maske für Prüfung DFC_ETClbETFltMax_2" VALUE 0x8002611C Val_Wu16 65535.00 DFES_OneToOne 0.00 65535.00 /end CHARACTERISTIC
/begin CHARACTERISTIC DFC_DisblMsk.DFC_ETClbETFltMax_3_C "DFC/Abschalt Maske für Prüfung DFC_ETClbETFltMax_3" VALUE 0x8002611E Val_Wu16 65535.00 DFES_OneToOne 0.00 65535.00 /end CHARACTERISTIC
/begin CHARACTERISTIC DFC_DisblMsk.DFC_ETClbETFltMax_4_C "DFC/Abschalt Maske für Prüfung DFC_ETClbETFltMax_4" VALUE 0x80026120 Val_Wu16 65535.00 DFES_OneToOne 0.00 65535.00 /end CHARACTERISTIC
/begin CHARACTERISTIC DFC_DisblMsk.DFC_ETClbETFltMax_5_C "DFC/Abschalt Maske für Prüfung DFC_ETClbETFltMax_5" VALUE 0x80026122 Val_Wu16 65535.00 DFES_OneToOne 0.00 65535.00 /end CHARACTERISTIC
/begin CHARACTERISTIC DFC_DisblMsk.DFC_ETClbETFltMin_0_C "DFC/Abschalt Maske für Prüfung DFC_ETClbETFltMin_0" VALUE 0x80026124 Val_Wu16 65535.00 DFES_OneToOne 0.00 65535.00 /end CHARACTERISTIC
/begin CHARACTERISTIC DFC_DisblMsk.DFC_ETClbETFltMin_1_C "DFC/Abschalt Maske für Prüfung DFC_ETClbETFltMin_1" VALUE 0x80026126 Val_Wu16 65535.00 DFES_OneToOne 0.00 65535.00 /end CHARACTERISTIC
/begin CHARACTERISTIC DFC_DisblMsk.DFC_ETClbETFltMin_2_C "DFC/Abschalt Maske für Prüfung DFC_ETClbETFltMin_2" VALUE 0x80026128 Val_Wu16 65535.00 DFES_OneToOne 0.00 65535.00 /end CHARACTERISTIC
/begin CHARACTERISTIC DFC_DisblMsk.DFC_ETClbETFltMin_3_C "DFC/Abschalt Maske für Prüfung DFC_ETClbETFltMin_3" VALUE 0x8002612A Val_Wu16 65535.00 DFES_OneToOne 0.00 65535.00 /end CHARACTERISTIC
/begin CHARACTERISTIC DFC_DisblMsk.DFC_ETClbETFltMin_4_C "DFC/Abschalt Maske für Prüfung DFC_ETClbETFltMin_4" VALUE 0x8002612C Val_Wu16 65535.00 DFES_OneToOne 0.00 65535.00 /end CHARACTERISTIC
/begin CHARACTERISTIC DFC_DisblMsk.DFC_ETClbETFltMin_5_C "DFC/Abschalt Maske für Prüfung DFC_ETClbETFltMin_5" VALUE 0x8002612E Val_Wu16 65535.00 DFES_OneToOne 0.00 65535.00 /end CHARACTERISTIC
/begin CHARACTERISTIC DFC_DisblMsk.DFC_InjCrvInjLimChrgBal_C "DFC/Abschalt Maske für Prüfung DFC_InjCrvInjLimChrgBal" VALUE 0x80026130 Val_Wu16 65535.00 DFES_OneToOne 0.00 65535.00 /end CHARACTERISTIC
/begin CHARACTERISTIC DFC_DisblMsk.DFC_InjCrvInjLimQntBal_C "DFC/Abschalt Maske für Prüfung DFC_InjCrvInjLimQntBal" VALUE 0x80026132 Val_Wu16 65535.00 DFES_OneToOne 0.00 65535.00 /end CHARACTERISTIC
/begin CHARACTERISTIC DFC_DisblMsk.DFC_InjCrvInjLimSys_C "DFC/Abschalt Maske für Prüfung DFC_InjCrvInjLimSys" VALUE 0x80026134 Val_Wu16 65535.00 DFES_OneToOne 0.00 65535.00 /end CHARACTERISTIC
/begin CHARACTERISTIC DFC_DisblMsk.DFC_InjCrvNumInjRtmLim_C "DFC/Abschalt Maske für Prüfung DFC_InjCrvNumInjRtmLim" VALUE 0x80026136 Val_Wu16 65535.00 DFES_OneToOne 0.00 65535.00 /end CHARACTERISTIC
/begin CHARACTERISTIC DFC_DisblMsk.DFC_LSUHtCoupSig_C "DFC/Abschalt Maske für Prüfung DFC_LSUHtCoupSig" VALUE 0x80026138 Val_Wu16 65535.00 DFES_OneToOne 0.00 65535.00 /end CHARACTERISTIC
/begin CHARACTERISTIC DFC_DisblMsk.DFC_AFS_SSpShOffOL_C "DFC/Abschalt Maske für Prüfung DFC_AFS_SSpShOffOL" VALUE 0x8002613A Val_Wu16 65535.00 DFES_OneToOne 0.00 65535.00 /end CHARACTERISTIC
/begin CHARACTERISTIC DFC_DisblMsk.DFC_AFS_SSpShOffOvrTemp_C "DFC/Abschalt Maske für Prüfung DFC_AFS_SSpShOffOvrTemp" VALUE 0x8002613C Val_Wu16 65535.00 DFES_OneToOne 0.00 65535.00 /end CHARACTERISTIC
/begin CHARACTERISTIC DFC_DisblMsk.DFC_AFS_SSpShOffSCB_C "DFC/Abschalt Maske für Prüfung DFC_AFS_SSpShOffSCB" VALUE 0x8002613E Val_Wu16 65535.00 DFES_OneToOne 0.00 65535.00 /end CHARACTERISTIC
/begin CHARACTERISTIC DFC_DisblMsk.DFC_AFS_SSpShOffSCG_C "DFC/Abschalt Maske für Prüfung DFC_AFS_SSpShOffSCG" VALUE 0x80026140 Val_Wu16 65535.00 DFES_OneToOne 0.00 65535.00 /end CHARACTERISTIC
/begin CHARACTERISTIC DFC_DisblMsk.DFC_AirCCmprOL_C "DFC/Abschalt Maske für Prüfung DFC_AirCCmprOL" VALUE 0x80026142 Val_Wu16 65535.00 DFES_OneToOne 0.00 65535.00 /end CHARACTERISTIC
/begin CHARACTERISTIC DFC_DisblMsk.DFC_AirCCmprOvrTemp_C "DFC/Abschalt Maske für Prüfung DFC_AirCCmprOvrTemp" VALUE 0x80026144 Val_Wu16 65535.00 DFES_OneToOne 0.00 65535.00 /end CHARACTERISTIC
/begin CHARACTERISTIC DFC_DisblMsk.DFC_AirCCmprSCB_C "DFC/Abschalt Maske für Prüfung DFC_AirCCmprSCB" VALUE 0x80026146 Val_Wu16 65535.00 DFES_OneToOne 0.00 65535.00 /end CHARACTERISTIC
/begin CHARACTERISTIC DFC_DisblMsk.DFC_AirCCmprSCG_C "DFC/Abschalt Maske für Prüfung DFC_AirCCmprSCG" VALUE 0x80026148 Val_Wu16 65535.00 DFES_OneToOne 0.00 65535.00 /end CHARACTERISTIC
/begin CHARACTERISTIC DFC_DisblMsk.DFC_CByVlvOL_C "DFC/Abschalt Maske für Prüfung DFC_CByVlvOL" VALUE 0x8002614A Val_Wu16 65535.00 DFES_OneToOne 0.00 65535.00 /end CHARACTERISTIC
/begin CHARACTERISTIC DFC_DisblMsk.DFC_CByVlvOvrTemp_C "DFC/Abschalt Maske für Prüfung DFC_CByVlvOvrTemp" VALUE 0x8002614C Val_Wu16 65535.00 DFES_OneToOne 0.00 65535.00 /end CHARACTERISTIC
/begin CHARACTERISTIC DFC_DisblMsk.DFC_CByVlvSCB_C "DFC/Abschalt Maske für Prüfung DFC_CByVlvSCB" VALUE 0x8002614E Val_Wu16 65535.00 DFES_OneToOne 0.00 65535.00 /end CHARACTERISTIC
/begin CHARACTERISTIC DFC_DisblMsk.DFC_CByVlvSCG_C "DFC/Abschalt Maske für Prüfung DFC_CByVlvSCG" VALUE 0x80026150 Val_Wu16 65535.00 DFES_OneToOne 0.00 65535.00 /end CHARACTERISTIC
/begin CHARACTERISTIC DFC_DisblMsk.DFC_CThmstOL_C "DFC/Abschalt Maske für Prüfung DFC_CThmstOL" VALUE 0x80026152 Val_Wu16 65535.00 DFES_OneToOne 0.00 65535.00 /end CHARACTERISTIC
/begin CHARACTERISTIC DFC_DisblMsk.DFC_CThmstOvrTemp_C "DFC/Abschalt Maske für Prüfung DFC_CThmstOvrTemp" VALUE 0x80026154 Val_Wu16 65535.00 DFES_OneToOne 0.00 65535.00 /end CHARACTERISTIC
/begin CHARACTERISTIC DFC_DisblMsk.DFC_CThmstSCB_C "DFC/Abschalt Maske für Prüfung DFC_CThmstSCB" VALUE 0x80026156 Val_Wu16 65535.00 DFES_OneToOne 0.00 65535.00 /end CHARACTERISTIC
/begin CHARACTERISTIC DFC_DisblMsk.DFC_CThmstSCG_C "DFC/Abschalt Maske für Prüfung DFC_CThmstSCG" VALUE 0x80026158 Val_Wu16 65535.00 DFES_OneToOne 0.00 65535.00 /end CHARACTERISTIC
/begin CHARACTERISTIC DFC_DisblMsk.DFC_DSMDummy_C "DFC/Abschalt Maske für Prüfung DFC_DSMDummy" VALUE 0x8002615A Val_Wu16 65535.00 DFES_OneToOne 0.00 65535.00 /end CHARACTERISTIC
/begin CHARACTERISTIC DFC_DisblMsk.DFC_EBxFanOL_C "DFC/Abschalt Maske für Prüfung DFC_EBxFanOL" VALUE 0x8002615C Val_Wu16 65535.00 DFES_OneToOne 0.00 65535.00 /end CHARACTERISTIC
/begin CHARACTERISTIC DFC_DisblMsk.DFC_EBxFanOvrTemp_C "DFC/Abschalt Maske für Prüfung DFC_EBxFanOvrTemp" VALUE 0x8002615E Val_Wu16 65535.00 DFES_OneToOne 0.00 65535.00 /end CHARACTERISTIC
/begin CHARACTERISTIC DFC_DisblMsk.DFC_EBxFanSCB_C "DFC/Abschalt Maske für Prüfung DFC_EBxFanSCB" VALUE 0x80026160 Val_Wu16 65535.00 DFES_OneToOne 0.00 65535.00 /end CHARACTERISTIC
/begin CHARACTERISTIC DFC_DisblMsk.DFC_EBxFanSCG_C "DFC/Abschalt Maske für Prüfung DFC_EBxFanSCG" VALUE 0x80026162 Val_Wu16 65535.00 DFES_OneToOne 0.00 65535.00 /end CHARACTERISTIC
/begin CHARACTERISTIC DFC_DisblMsk.DFC_ECBVlvOL_C "DFC/Abschalt Maske für Prüfung DFC_ECBVlvOL" VALUE 0x80026164 Val_Wu16 65535.00 DFES_OneToOne 0.00 65535.00 /end CHARACTERISTIC
/begin CHARACTERISTIC DFC_DisblMsk.DFC_ECBVlvOvrTemp_C "DFC/Abschalt Maske für Prüfung DFC_ECBVlvOvrTemp" VALUE 0x80026166 Val_Wu16 65535.00 DFES_OneToOne 0.00 65535.00 /end CHARACTERISTIC
/begin CHARACTERISTIC DFC_DisblMsk.DFC_ECBVlvSCB_C "DFC/Abschalt Maske für Prüfung DFC_ECBVlvSCB" VALUE 0x80026168 Val_Wu16 65535.00 DFES_OneToOne 0.00 65535.00 /end CHARACTERISTIC
/begin CHARACTERISTIC DFC_DisblMsk.DFC_ECBVlvSCG_C "DFC/Abschalt Maske für Prüfung DFC_ECBVlvSCG" VALUE 0x8002616A Val_Wu16 65535.00 DFES_OneToOne 0.00 65535.00 /end CHARACTERISTIC
/begin CHARACTERISTIC DFC_DisblMsk.DFC_EMDmpOL_0_C "DFC/Abschalt Maske für Prüfung DFC_EMDmpOL_0" VALUE 0x8002616C Val_Wu16 65535.00 DFES_OneToOne 0.00 65535.00 /end CHARACTERISTIC
/begin CHARACTERISTIC DFC_DisblMsk.DFC_EMDmpOL_1_C "DFC/Abschalt Maske für Prüfung DFC_EMDmpOL_1" VALUE 0x8002616E Val_Wu16 65535.00 DFES_OneToOne 0.00 65535.00 /end CHARACTERISTIC
/begin CHARACTERISTIC DFC_DisblMsk.DFC_EMDmpOvrTemp_0_C "DFC/Abschalt Maske für Prüfung DFC_EMDmpOvrTemp_0" VALUE 0x80026170 Val_Wu16 65535.00 DFES_OneToOne 0.00 65535.00 /end CHARACTERISTIC
/begin CHARACTERISTIC DFC_DisblMsk.DFC_EMDmpOvrTemp_1_C "DFC/Abschalt Maske für Prüfung DFC_EMDmpOvrTemp_1" VALUE 0x80026172 Val_Wu16 65535.00 DFES_OneToOne 0.00 65535.00 /end CHARACTERISTIC
/begin CHARACTERISTIC DFC_DisblMsk.DFC_EMDmpSCB_0_C "DFC/Abschalt Maske für Prüfung DFC_EMDmpSCB_0" VALUE 0x80026174 Val_Wu16 65535.00 DFES_OneToOne 0.00 65535.00 /end CHARACTERISTIC
/begin CHARACTERISTIC DFC_DisblMsk.DFC_EMDmpSCB_1_C "DFC/Abschalt Maske für Prüfung DFC_EMDmpSCB_1" VALUE 0x80026176 Val_Wu16 65535.00 DFES_OneToOne 0.00 65535.00 /end CHARACTERISTIC
/begin CHARACTERISTIC DFC_DisblMsk.DFC_EMDmpSCG_0_C "DFC/Abschalt Maske für Prüfung DFC_EMDmpSCG_0" VALUE 0x80026178 Val_Wu16 65535.00 DFES_OneToOne 0.00 65535.00 /end CHARACTERISTIC
/begin CHARACTERISTIC DFC_DisblMsk.DFC_EMDmpSCG_1_C "DFC/Abschalt Maske für Prüfung DFC_EMDmpSCG_1" VALUE 0x8002617A Val_Wu16 65535.00 DFES_OneToOne 0.00 65535.00 /end CHARACTERISTIC
/begin CHARACTERISTIC DFC_DisblMsk.DFC_EngStAOL_C "DFC/Abschalt Maske für Prüfung DFC_EngStAOL" VALUE 0x8002617C Val_Wu16 65535.00 DFES_OneToOne 0.00 65535.00 /end CHARACTERISTIC
/begin CHARACTERISTIC DFC_DisblMsk.DFC_EngStAOvrTemp_C "DFC/Abschalt Maske für Prüfung DFC_EngStAOvrTemp" VALUE 0x8002617E Val_Wu16 65535.00 DFES_OneToOne 0.00 65535.00 /end CHARACTERISTIC
/begin CHARACTERISTIC DFC_DisblMsk.DFC_EngStASCB_C "DFC/Abschalt Maske für Prüfung DFC_EngStASCB" VALUE 0x80026180 Val_Wu16 65535.00 DFES_OneToOne 0.00 65535.00 /end CHARACTERISTIC
/begin CHARACTERISTIC DFC_DisblMsk.DFC_EngStASCG_C "DFC/Abschalt Maske für Prüfung DFC_EngStASCG" VALUE 0x80026182 Val_Wu16 65535.00 DFES_OneToOne 0.00 65535.00 /end CHARACTERISTIC
/begin CHARACTERISTIC DFC_DisblMsk.DFC_FanOL_C "DFC/Abschalt Maske für Prüfung DFC_FanOL" VALUE 0x80026184 Val_Wu16 65535.00 DFES_OneToOne 0.00 65535.00 /end CHARACTERISTIC
/begin CHARACTERISTIC DFC_DisblMsk.DFC_FanOvrTemp_C "DFC/Abschalt Maske für Prüfung DFC_FanOvrTemp" VALUE 0x80026186 Val_Wu16 65535.00 DFES_OneToOne 0.00 65535.00 /end CHARACTERISTIC
/begin CHARACTERISTIC DFC_DisblMsk.DFC_FanSCB_C "DFC/Abschalt Maske für Prüfung DFC_FanSCB" VALUE 0x80026188 Val_Wu16 65535.00 DFES_OneToOne 0.00 65535.00 /end CHARACTERISTIC
/begin CHARACTERISTIC DFC_DisblMsk.DFC_FlFltHtOL_C "DFC/Abschalt Maske für Prüfung DFC_FlFltHtOL" VALUE 0x8002618A Val_Wu16 65535.00 DFES_OneToOne 0.00 65535.00 /end CHARACTERISTIC
/begin CHARACTERISTIC DFC_DisblMsk.DFC_FlFltHtOvrTemp_C "DFC/Abschalt Maske für Prüfung DFC_FlFltHtOvrTemp" VALUE 0x8002618C Val_Wu16 65535.00 DFES_OneToOne 0.00 65535.00 /end CHARACTERISTIC
/begin CHARACTERISTIC DFC_DisblMsk.DFC_FlFltHtSCB_C "DFC/Abschalt Maske für Prüfung DFC_FlFltHtSCB" VALUE 0x8002618E Val_Wu16 65535.00 DFES_OneToOne 0.00 65535.00 /end CHARACTERISTIC
/begin CHARACTERISTIC DFC_DisblMsk.DFC_FlFltHtSCG_C "DFC/Abschalt Maske für Prüfung DFC_FlFltHtSCG" VALUE 0x80026190 Val_Wu16 65535.00 DFES_OneToOne 0.00 65535.00 /end CHARACTERISTIC
/begin CHARACTERISTIC DFC_DisblMsk.DFC_LSUHtrMax_C "DFC/Abschalt Maske für Prüfung DFC_LSUHtrMax" VALUE 0x80026192 Val_Wu16 65535.00 DFES_OneToOne 0.00 65535.00 /end CHARACTERISTIC
/begin CHARACTERISTIC DFC_DisblMsk.DFC_LSUHtrMin_C "DFC/Abschalt Maske für Prüfung DFC_LSUHtrMin" VALUE 0x80026194 Val_Wu16 65535.00 DFES_OneToOne 0.00 65535.00 /end CHARACTERISTIC
/begin CHARACTERISTIC DFC_DisblMsk.DFC_LSUHtrNpl_C "DFC/Abschalt Maske für Prüfung DFC_LSUHtrNpl" VALUE 0x80026196 Val_Wu16 65535.00 DFES_OneToOne 0.00 65535.00 /end CHARACTERISTIC
/begin CHARACTERISTIC DFC_DisblMsk.DFC_LSUHtrSig_C "DFC/Abschalt Maske für Prüfung DFC_LSUHtrSig" VALUE 0x80026198 Val_Wu16 65535.00 DFES_OneToOne 0.00 65535.00 /end CHARACTERISTIC
/begin CHARACTERISTIC DFC_DisblMsk.DFC_LSUtExcMax_C "DFC/Abschalt Maske für Prüfung DFC_LSUtExcMax" VALUE 0x8002619A Val_Wu16 65535.00 DFES_OneToOne 0.00 65535.00 /end CHARACTERISTIC
/begin CHARACTERISTIC DFC_DisblMsk.DFC_LSUtExcMin_C "DFC/Abschalt Maske für Prüfung DFC_LSUtExcMin" VALUE 0x8002619C Val_Wu16 65535.00 DFES_OneToOne 0.00 65535.00 /end CHARACTERISTIC
/begin CHARACTERISTIC DFC_DisblMsk.DFC_MeUnOL_C "DFC/Abschalt Maske für Prüfung DFC_MeUnOL" VALUE 0x8002619E Val_Wu16 65535.00 DFES_OneToOne 0.00 65535.00 /end CHARACTERISTIC
/begin CHARACTERISTIC DFC_DisblMsk.DFC_MeUnSCB_C "DFC/Abschalt Maske für Prüfung DFC_MeUnSCB" VALUE 0x800261A0 Val_Wu16 65535.00 DFES_OneToOne 0.00 65535.00 /end CHARACTERISTIC
/begin CHARACTERISTIC DFC_DisblMsk.DFC_MeUnSRCMax_C "DFC/Abschalt Maske für Prüfung DFC_MeUnSRCMax" VALUE 0x800261A2 Val_Wu16 65535.00 DFES_OneToOne 0.00 65535.00 /end CHARACTERISTIC
/begin CHARACTERISTIC DFC_DisblMsk.DFC_MeUnSRCMin_C "DFC/Abschalt Maske für Prüfung DFC_MeUnSRCMin" VALUE 0x800261A4 Val_Wu16 65535.00 DFES_OneToOne 0.00 65535.00 /end CHARACTERISTIC
/begin CHARACTERISTIC DFC_DisblMsk.DFC_PCVOL_C "DFC/Abschalt Maske für Prüfung DFC_PCVOL" VALUE 0x800261A6 Val_Wu16 65535.00 DFES_OneToOne 0.00 65535.00 /end CHARACTERISTIC
/begin CHARACTERISTIC DFC_DisblMsk.DFC_PCVSCB_C "DFC/Abschalt Maske für Prüfung DFC_PCVSCB" VALUE 0x800261A8 Val_Wu16 65535.00 DFES_OneToOne 0.00 65535.00 /end CHARACTERISTIC
/begin CHARACTERISTIC DFC_DisblMsk.DFC_PCVSRCMax_C "DFC/Abschalt Maske für Prüfung DFC_PCVSRCMax" VALUE 0x800261AA Val_Wu16 65535.00 DFES_OneToOne 0.00 65535.00 /end CHARACTERISTIC
/begin CHARACTERISTIC DFC_DisblMsk.DFC_PCVSRCMin_C "DFC/Abschalt Maske für Prüfung DFC_PCVSRCMin" VALUE 0x800261AC Val_Wu16 65535.00 DFES_OneToOne 0.00 65535.00 /end CHARACTERISTIC
/begin CHARACTERISTIC DFC_DisblMsk.DFC_RailPSRCMax_C "DFC/Abschalt Maske für Prüfung DFC_RailPSRCMax" VALUE 0x800261AE Val_Wu16 65535.00 DFES_OneToOne 0.00 65535.00 /end CHARACTERISTIC
/begin CHARACTERISTIC DFC_DisblMsk.DFC_RailPSRCMin_C "DFC/Abschalt Maske für Prüfung DFC_RailPSRCMin" VALUE 0x800261B0 Val_Wu16 65535.00 DFES_OneToOne 0.00 65535.00 /end CHARACTERISTIC
/begin CHARACTERISTIC DFC_DisblMsk.DFC_ShtrOL_C "DFC/Abschalt Maske für Prüfung DFC_ShtrOL" VALUE 0x800261B2 Val_Wu16 65535.00 DFES_OneToOne 0.00 65535.00 /end CHARACTERISTIC
/begin CHARACTERISTIC DFC_DisblMsk.DFC_ShtrOvrTemp_C "DFC/Abschalt Maske für Prüfung DFC_ShtrOvrTemp" VALUE 0x800261B4 Val_Wu16 65535.00 DFES_OneToOne 0.00 65535.00 /end CHARACTERISTIC
/begin CHARACTERISTIC DFC_DisblMsk.DFC_ShtrSCB_C "DFC/Abschalt Maske für Prüfung DFC_ShtrSCB" VALUE 0x800261B6 Val_Wu16 65535.00 DFES_OneToOne 0.00 65535.00 /end CHARACTERISTIC
/begin CHARACTERISTIC DFC_DisblMsk.DFC_ShtrSCG_C "DFC/Abschalt Maske für Prüfung DFC_ShtrSCG" VALUE 0x800261B8 Val_Wu16 65535.00 DFES_OneToOne 0.00 65535.00 /end CHARACTERISTIC
/begin CHARACTERISTIC DFC_DisblMsk.DFC_StrtOL_C "DFC/Abschalt Maske für Prüfung DFC_StrtOL" VALUE 0x800261BA Val_Wu16 65535.00 DFES_OneToOne 0.00 65535.00 /end CHARACTERISTIC
/begin CHARACTERISTIC DFC_DisblMsk.DFC_StrtOvrTemp_C "DFC/Abschalt Maske für Prüfung DFC_StrtOvrTemp" VALUE 0x800261BC Val_Wu16 65535.00 DFES_OneToOne 0.00 65535.00 /end CHARACTERISTIC
/begin CHARACTERISTIC DFC_DisblMsk.DFC_StrtSCB_C "DFC/Abschalt Maske für Prüfung DFC_StrtSCB" VALUE 0x800261BE Val_Wu16 65535.00 DFES_OneToOne 0.00 65535.00 /end CHARACTERISTIC
/begin CHARACTERISTIC DFC_DisblMsk.DFC_StrtSCG_C "DFC/Abschalt Maske für Prüfung DFC_StrtSCG" VALUE 0x800261C0 Val_Wu16 65535.00 DFES_OneToOne 0.00 65535.00 /end CHARACTERISTIC
/begin CHARACTERISTIC DFC_DisblMsk.DFC_ThrVlvOL_C "DFC/Abschalt Maske für Prüfung DFC_ThrVlvOL" VALUE 0x800261C2 Val_Wu16 65535.00 DFES_OneToOne 0.00 65535.00 /end CHARACTERISTIC
/begin CHARACTERISTIC DFC_DisblMsk.DFC_ThrVlvOvrTemp_C "DFC/Abschalt Maske für Prüfung DFC_ThrVlvOvrTemp" VALUE 0x800261C4 Val_Wu16 65535.00 DFES_OneToOne 0.00 65535.00 /end CHARACTERISTIC
/begin CHARACTERISTIC DFC_DisblMsk.DFC_ThrVlvSCB_C "DFC/Abschalt Maske für Prüfung DFC_ThrVlvSCB" VALUE 0x800261C6 Val_Wu16 65535.00 DFES_OneToOne 0.00 65535.00 /end CHARACTERISTIC
/begin CHARACTERISTIC DFC_DisblMsk.DFC_TrbChOL_C "DFC/Abschalt Maske für Prüfung DFC_TrbChOL" VALUE 0x800261C8 Val_Wu16 65535.00 DFES_OneToOne 0.00 65535.00 /end CHARACTERISTIC
/begin CHARACTERISTIC DFC_DisblMsk.DFC_TrbChOvrTemp_C "DFC/Abschalt Maske für Prüfung DFC_TrbChOvrTemp" VALUE 0x800261CA Val_Wu16 65535.00 DFES_OneToOne 0.00 65535.00 /end CHARACTERISTIC
/begin CHARACTERISTIC DFC_DisblMsk.DFC_TrbChSCB_C "DFC/Abschalt Maske für Prüfung DFC_TrbChSCB" VALUE 0x800261CC Val_Wu16 65535.00 DFES_OneToOne 0.00 65535.00 /end CHARACTERISTIC
/begin CHARACTERISTIC DFC_DisblMsk.DFC_UDosVlvOL_C "DFC/Abschalt Maske für Prüfung DFC_UDosVlvOL" VALUE 0x800261CE Val_Wu16 65535.00 DFES_OneToOne 0.00 65535.00 /end CHARACTERISTIC
/begin CHARACTERISTIC DFC_DisblMsk.DFC_UDosVlvOvrTemp_C "DFC/Abschalt Maske für Prüfung DFC_UDosVlvOvrTemp" VALUE 0x800261D0 Val_Wu16 65535.00 DFES_OneToOne 0.00 65535.00 /end CHARACTERISTIC
/begin CHARACTERISTIC DFC_DisblMsk.DFC_UDosVlvSCB_C "DFC/Abschalt Maske für Prüfung DFC_UDosVlvSCB" VALUE 0x800261D2 Val_Wu16 65535.00 DFES_OneToOne 0.00 65535.00 /end CHARACTERISTIC
/begin CHARACTERISTIC DFC_DisblMsk.DFC_UDosVlvSCG_C "DFC/Abschalt Maske für Prüfung DFC_UDosVlvSCG" VALUE 0x800261D4 Val_Wu16 65535.00 DFES_OneToOne 0.00 65535.00 /end CHARACTERISTIC
/begin CHARACTERISTIC DFC_DisblMsk.DFC_UPmpMotOL_C "DFC/Abschalt Maske für Prüfung DFC_UPmpMotOL" VALUE 0x800261D6 Val_Wu16 65535.00 DFES_OneToOne 0.00 65535.00 /end CHARACTERISTIC
/begin CHARACTERISTIC DFC_DisblMsk.DFC_UPmpMotOvrTemp_C "DFC/Abschalt Maske für Prüfung DFC_UPmpMotOvrTemp" VALUE 0x800261D8 Val_Wu16 65535.00 DFES_OneToOne 0.00 65535.00 /end CHARACTERISTIC
/begin CHARACTERISTIC DFC_DisblMsk.DFC_UPmpMotSCB_C "DFC/Abschalt Maske für Prüfung DFC_UPmpMotSCB" VALUE 0x800261DA Val_Wu16 65535.00 DFES_OneToOne 0.00 65535.00 /end CHARACTERISTIC
/begin CHARACTERISTIC DFC_DisblMsk.DFC_UPmpMotSCG_C "DFC/Abschalt Maske für Prüfung DFC_UPmpMotSCG" VALUE 0x800261DC Val_Wu16 65535.00 DFES_OneToOne 0.00 65535.00 /end CHARACTERISTIC
/begin CHARACTERISTIC DFC_DisblMsk.DFC_WaHtElOL_C "DFC/Abschalt Maske für Prüfung DFC_WaHtElOL" VALUE 0x800261DE Val_Wu16 65535.00 DFES_OneToOne 0.00 65535.00 /end CHARACTERISTIC
/begin CHARACTERISTIC DFC_DisblMsk.DFC_WaHtElOvrTemp_C "DFC/Abschalt Maske für Prüfung DFC_WaHtElOvrTemp" VALUE 0x800261E0 Val_Wu16 65535.00 DFES_OneToOne 0.00 65535.00 /end CHARACTERISTIC
/begin CHARACTERISTIC DFC_DisblMsk.DFC_WaHtElSCB_C "DFC/Abschalt Maske für Prüfung DFC_WaHtElSCB" VALUE 0x800261E2 Val_Wu16 65535.00 DFES_OneToOne 0.00 65535.00 /end CHARACTERISTIC
/begin CHARACTERISTIC DFC_DisblMsk.DFC_IVActrUChSRCMax_C "DFC/Abschalt Maske für Prüfung DFC_IVActrUChSRCMax" VALUE 0x800261E4 Val_Wu16 65535.00 DFES_OneToOne 0.00 65535.00 /end CHARACTERISTIC
/begin CHARACTERISTIC DFC_DisblMsk.DFC_IVActrUChSRCMin_C "DFC/Abschalt Maske für Prüfung DFC_IVActrUChSRCMin" VALUE 0x800261E6 Val_Wu16 65535.00 DFES_OneToOne 0.00 65535.00 /end CHARACTERISTIC
/begin CHARACTERISTIC DFC_DisblMsk.DFC_IVActrVltgSRCMax_C "DFC/Abschalt Maske für Prüfung DFC_IVActrVltgSRCMax" VALUE 0x800261E8 Val_Wu16 65535.00 DFES_OneToOne 0.00 65535.00 /end CHARACTERISTIC
/begin CHARACTERISTIC DFC_DisblMsk.DFC_IVActrVltgSRCMin_C "DFC/Abschalt Maske für Prüfung DFC_IVActrVltgSRCMin" VALUE 0x800261EA Val_Wu16 65535.00 DFES_OneToOne 0.00 65535.00 /end CHARACTERISTIC
/begin CHARACTERISTIC DFC_DisblMsk.DFC_IVDiaTunDet_C "DFC/Abschalt Maske für Prüfung DFC_IVDiaTunDet" VALUE 0x800261EC Val_Wu16 65535.00 DFES_OneToOne 0.00 65535.00 /end CHARACTERISTIC
/begin CHARACTERISTIC DFC_DisblMsk.DFC_IVPSplyStopDCDC_C "DFC/Abschalt Maske für Prüfung DFC_IVPSplyStopDCDC" VALUE 0x800261EE Val_Wu16 65535.00 DFES_OneToOne 0.00 65535.00 /end CHARACTERISTIC
/begin CHARACTERISTIC DFC_DisblMsk.DFC_IVPSplyVltgSRCMax_C "DFC/Abschalt Maske für Prüfung DFC_IVPSplyVltgSRCMax" VALUE 0x800261F0 Val_Wu16 65535.00 DFES_OneToOne 0.00 65535.00 /end CHARACTERISTIC
/begin CHARACTERISTIC DFC_DisblMsk.DFC_IVPSplyVltgSRCMin_C "DFC/Abschalt Maske für Prüfung DFC_IVPSplyVltgSRCMin" VALUE 0x800261F2 Val_Wu16 65535.00 DFES_OneToOne 0.00 65535.00 /end CHARACTERISTIC
/begin CHARACTERISTIC DFC_DisblMsk.DFC_SCREtaErr_C "DFC/Abschalt Maske für Prüfung DFC_SCREtaErr" VALUE 0x800261F4 Val_Wu16 65535.00 DFES_OneToOne 0.00 65535.00 /end CHARACTERISTIC
/begin CHARACTERISTIC DFC_DisblMsk.DFC_SCREtaErr1_C "DFC/Abschalt Maske für Prüfung DFC_SCREtaErr1" VALUE 0x800261F6 Val_Wu16 65535.00 DFES_OneToOne 0.00 65535.00 /end CHARACTERISTIC
/begin CHARACTERISTIC DFC_DisblMsk.DFC_SCREtaErr2_C "DFC/Abschalt Maske für Prüfung DFC_SCREtaErr2" VALUE 0x800261F8 Val_Wu16 65535.00 DFES_OneToOne 0.00 65535.00 /end CHARACTERISTIC
/begin CHARACTERISTIC DFC_DisblMsk.DFC_SCRMonMetCtlPresErr_C "DFC/Abschalt Maske für Prüfung DFC_SCRMonMetCtlPresErr" VALUE 0x800261FA Val_Wu16 65535.00 DFES_OneToOne 0.00 65535.00 /end CHARACTERISTIC
/begin CHARACTERISTIC DFC_DisblMsk.DFC_SCRMonPresBuildUpErr_C "DFC/Abschalt Maske für Prüfung DFC_SCRMonPresBuildUpErr" VALUE 0x800261FC Val_Wu16 65535.00 DFES_OneToOne 0.00 65535.00 /end CHARACTERISTIC
/begin CHARACTERISTIC DFC_DisblMsk.DFC_SCRMonPresRdcErr_C "DFC/Abschalt Maske für Prüfung DFC_SCRMonPresRdcErr" VALUE 0x800261FE Val_Wu16 65535.00 DFES_OneToOne 0.00 65535.00 /end CHARACTERISTIC
/begin CHARACTERISTIC DFC_DisblMsk.DFC_AFSOffsDrftMax_C "DFC/Abschalt Maske für Prüfung DFC_AFSOffsDrftMax" VALUE 0x80026200 Val_Wu16 65535.00 DFES_OneToOne 0.00 65535.00 /end CHARACTERISTIC
/begin CHARACTERISTIC DFC_DisblMsk.DFC_AFSOffsDrftMin_C "DFC/Abschalt Maske für Prüfung DFC_AFSOffsDrftMin" VALUE 0x80026202 Val_Wu16 65535.00 DFES_OneToOne 0.00 65535.00 /end CHARACTERISTIC
/begin CHARACTERISTIC DFC_DisblMsk.DFC_AFSSRCCorMax_C "DFC/Abschalt Maske für Prüfung DFC_AFSSRCCorMax" VALUE 0x80026204 Val_Wu16 65535.00 DFES_OneToOne 0.00 65535.00 /end CHARACTERISTIC
/begin CHARACTERISTIC DFC_DisblMsk.DFC_AFSSRCCorMin_C "DFC/Abschalt Maske für Prüfung DFC_AFSSRCCorMin" VALUE 0x80026206 Val_Wu16 65535.00 DFES_OneToOne 0.00 65535.00 /end CHARACTERISTIC
/begin CHARACTERISTIC DFC_DisblMsk.DFC_AFSSRCRawMax_C "DFC/Abschalt Maske für Prüfung DFC_AFSSRCRawMax" VALUE 0x80026208 Val_Wu16 65535.00 DFES_OneToOne 0.00 65535.00 /end CHARACTERISTIC
/begin CHARACTERISTIC DFC_DisblMsk.DFC_AFSSRCRawMin_C "DFC/Abschalt Maske für Prüfung DFC_AFSSRCRawMin" VALUE 0x8002620A Val_Wu16 65535.00 DFES_OneToOne 0.00 65535.00 /end CHARACTERISTIC
/begin CHARACTERISTIC DFC_DisblMsk.DFC_AFSSetyDrftMax_C "DFC/Abschalt Maske für Prüfung DFC_AFSSetyDrftMax" VALUE 0x8002620C Val_Wu16 65535.00 DFES_OneToOne 0.00 65535.00 /end CHARACTERISTIC
/begin CHARACTERISTIC DFC_DisblMsk.DFC_AFSSetyDrftMin_C "DFC/Abschalt Maske für Prüfung DFC_AFSSetyDrftMin" VALUE 0x8002620E Val_Wu16 65535.00 DFES_OneToOne 0.00 65535.00 /end CHARACTERISTIC
/begin CHARACTERISTIC DFC_DisblMsk.DFC_AirCSwtNpl_C "DFC/Abschalt Maske für Prüfung DFC_AirCSwtNpl" VALUE 0x80026210 Val_Wu16 65535.00 DFES_OneToOne 0.00 65535.00 /end CHARACTERISTIC
/begin CHARACTERISTIC DFC_DisblMsk.DFC_AirCSwtSig_C "DFC/Abschalt Maske für Prüfung DFC_AirCSwtSig" VALUE 0x80026212 Val_Wu16 65535.00 DFES_OneToOne 0.00 65535.00 /end CHARACTERISTIC
/begin CHARACTERISTIC DFC_DisblMsk.DFC_BattUSRCMax_C "DFC/Abschalt Maske für Prüfung DFC_BattUSRCMax" VALUE 0x80026214 Val_Wu16 65535.00 DFES_OneToOne 0.00 65535.00 /end CHARACTERISTIC
/begin CHARACTERISTIC DFC_DisblMsk.DFC_BattUSRCMin_C "DFC/Abschalt Maske für Prüfung DFC_BattUSRCMin" VALUE 0x80026216 Val_Wu16 65535.00 DFES_OneToOne 0.00 65535.00 /end CHARACTERISTIC
/begin CHARACTERISTIC DFC_DisblMsk.DFC_BrkNpl_C "DFC/Abschalt Maske für Prüfung DFC_BrkNpl" VALUE 0x80026218 Val_Wu16 65535.00 DFES_OneToOne 0.00 65535.00 /end CHARACTERISTIC
/begin CHARACTERISTIC DFC_DisblMsk.DFC_BrkPSRCMax_C "DFC/Abschalt Maske für Prüfung DFC_BrkPSRCMax" VALUE 0x8002621A Val_Wu16 65535.00 DFES_OneToOne 0.00 65535.00 /end CHARACTERISTIC
/begin CHARACTERISTIC DFC_DisblMsk.DFC_BrkPSRCMin_C "DFC/Abschalt Maske für Prüfung DFC_BrkPSRCMin" VALUE 0x8002621C Val_Wu16 65535.00 DFES_OneToOne 0.00 65535.00 /end CHARACTERISTIC
/begin CHARACTERISTIC DFC_DisblMsk.DFC_CEngDsTSRCMax_C "DFC/Abschalt Maske für Prüfung DFC_CEngDsTSRCMax" VALUE 0x8002621E Val_Wu16 65535.00 DFES_OneToOne 0.00 65535.00 /end CHARACTERISTIC
/begin CHARACTERISTIC DFC_DisblMsk.DFC_CEngDsTSRCMin_C "DFC/Abschalt Maske für Prüfung DFC_CEngDsTSRCMin" VALUE 0x80026220 Val_Wu16 65535.00 DFES_OneToOne 0.00 65535.00 /end CHARACTERISTIC
/begin CHARACTERISTIC DFC_DisblMsk.DFC_CrCUIDet_C "DFC/Abschalt Maske für Prüfung DFC_CrCUIDet" VALUE 0x80026222 Val_Wu16 65535.00 DFES_OneToOne 0.00 65535.00 /end CHARACTERISTIC
/begin CHARACTERISTIC DFC_DisblMsk.DFC_ECBVlvSRCMax_C "DFC/Abschalt Maske für Prüfung DFC_ECBVlvSRCMax" VALUE 0x80026224 Val_Wu16 65535.00 DFES_OneToOne 0.00 65535.00 /end CHARACTERISTIC
/begin CHARACTERISTIC DFC_DisblMsk.DFC_ECBVlvSRCMin_C "DFC/Abschalt Maske für Prüfung DFC_ECBVlvSRCMin" VALUE 0x80026226 Val_Wu16 65535.00 DFES_OneToOne 0.00 65535.00 /end CHARACTERISTIC
/begin CHARACTERISTIC DFC_DisblMsk.DFC_ECUOvrTemp_C "DFC/Abschalt Maske für Prüfung DFC_ECUOvrTemp" VALUE 0x80026228 Val_Wu16 65535.00 DFES_OneToOne 0.00 65535.00 /end CHARACTERISTIC
/begin CHARACTERISTIC DFC_DisblMsk.DFC_EGRVlvGovDvtMax_C "DFC/Abschalt Maske für Prüfung DFC_EGRVlvGovDvtMax" VALUE 0x8002622A Val_Wu16 65535.00 DFES_OneToOne 0.00 65535.00 /end CHARACTERISTIC
/begin CHARACTERISTIC DFC_DisblMsk.DFC_EGRVlvGovDvtMin_C "DFC/Abschalt Maske für Prüfung DFC_EGRVlvGovDvtMin" VALUE 0x8002622C Val_Wu16 65535.00 DFES_OneToOne 0.00 65535.00 /end CHARACTERISTIC
/begin CHARACTERISTIC DFC_DisblMsk.DFC_EGRVlvHBrgOpnLd_C "DFC/Abschalt Maske für Prüfung DFC_EGRVlvHBrgOpnLd" VALUE 0x8002622E Val_Wu16 65535.00 DFES_OneToOne 0.00 65535.00 /end CHARACTERISTIC
/begin CHARACTERISTIC DFC_DisblMsk.DFC_EGRVlvHBrgOvrCurr_C "DFC/Abschalt Maske für Prüfung DFC_EGRVlvHBrgOvrCurr" VALUE 0x80026230 Val_Wu16 65535.00 DFES_OneToOne 0.00 65535.00 /end CHARACTERISTIC
/begin CHARACTERISTIC DFC_DisblMsk.DFC_EGRVlvHBrgOvrTemp_C "DFC/Abschalt Maske für Prüfung DFC_EGRVlvHBrgOvrTemp" VALUE 0x80026232 Val_Wu16 65535.00 DFES_OneToOne 0.00 65535.00 /end CHARACTERISTIC
/begin CHARACTERISTIC DFC_DisblMsk.DFC_EGRVlvHBrgShCirBatt1_C "DFC/Abschalt Maske für Prüfung DFC_EGRVlvHBrgShCirBatt1" VALUE 0x80026234 Val_Wu16 65535.00 DFES_OneToOne 0.00 65535.00 /end CHARACTERISTIC
/begin CHARACTERISTIC DFC_DisblMsk.DFC_EGRVlvHBrgShCirBatt2_C "DFC/Abschalt Maske für Prüfung DFC_EGRVlvHBrgShCirBatt2" VALUE 0x80026236 Val_Wu16 65535.00 DFES_OneToOne 0.00 65535.00 /end CHARACTERISTIC
/begin CHARACTERISTIC DFC_DisblMsk.DFC_EGRVlvHBrgShCirGnd1_C "DFC/Abschalt Maske für Prüfung DFC_EGRVlvHBrgShCirGnd1" VALUE 0x80026238 Val_Wu16 65535.00 DFES_OneToOne 0.00 65535.00 /end CHARACTERISTIC
/begin CHARACTERISTIC DFC_DisblMsk.DFC_EGRVlvHBrgShCirGnd2_C "DFC/Abschalt Maske für Prüfung DFC_EGRVlvHBrgShCirGnd2" VALUE 0x8002623A Val_Wu16 65535.00 DFES_OneToOne 0.00 65535.00 /end CHARACTERISTIC
/begin CHARACTERISTIC DFC_DisblMsk.DFC_EGRVlvHBrgShCirOvrLd_C "DFC/Abschalt Maske für Prüfung DFC_EGRVlvHBrgShCirOvrLd" VALUE 0x8002623C Val_Wu16 65535.00 DFES_OneToOne 0.00 65535.00 /end CHARACTERISTIC
/begin CHARACTERISTIC DFC_DisblMsk.DFC_EGRVlvHBrgTempOvrCurr_C "DFC/Abschalt Maske für Prüfung DFC_EGRVlvHBrgTempOvrCurr" VALUE 0x8002623E Val_Wu16 65535.00 DFES_OneToOne 0.00 65535.00 /end CHARACTERISTIC
/begin CHARACTERISTIC DFC_DisblMsk.DFC_EGRVlvHBrgUndrVltg_C "DFC/Abschalt Maske für Prüfung DFC_EGRVlvHBrgUndrVltg" VALUE 0x80026240 Val_Wu16 65535.00 DFES_OneToOne 0.00 65535.00 /end CHARACTERISTIC
/begin CHARACTERISTIC DFC_DisblMsk.DFC_EGRVlvLPGovDvtMax_C "DFC/Abschalt Maske für Prüfung DFC_EGRVlvLPGovDvtMax" VALUE 0x80026242 Val_Wu16 65535.00 DFES_OneToOne 0.00 65535.00 /end CHARACTERISTIC
/begin CHARACTERISTIC DFC_DisblMsk.DFC_EGRVlvLPGovDvtMin_C "DFC/Abschalt Maske für Prüfung DFC_EGRVlvLPGovDvtMin" VALUE 0x80026244 Val_Wu16 65535.00 DFES_OneToOne 0.00 65535.00 /end CHARACTERISTIC
/begin CHARACTERISTIC DFC_DisblMsk.DFC_EGRVlvLPHBrgOpnLd_C "DFC/Abschalt Maske für Prüfung DFC_EGRVlvLPHBrgOpnLd" VALUE 0x80026246 Val_Wu16 65535.00 DFES_OneToOne 0.00 65535.00 /end CHARACTERISTIC
/begin CHARACTERISTIC DFC_DisblMsk.DFC_EGRVlvLPHBrgOvrCurr_C "DFC/Abschalt Maske für Prüfung DFC_EGRVlvLPHBrgOvrCurr" VALUE 0x80026248 Val_Wu16 65535.00 DFES_OneToOne 0.00 65535.00 /end CHARACTERISTIC
/begin CHARACTERISTIC DFC_DisblMsk.DFC_EGRVlvLPHBrgOvrTemp_C "DFC/Abschalt Maske für Prüfung DFC_EGRVlvLPHBrgOvrTemp" VALUE 0x8002624A Val_Wu16 65535.00 DFES_OneToOne 0.00 65535.00 /end CHARACTERISTIC
/begin CHARACTERISTIC DFC_DisblMsk.DFC_EGRVlvLPHBrgShCirBatt1_C "DFC/Abschalt Maske für Prüfung DFC_EGRVlvLPHBrgShCirBatt1" VALUE 0x8002624C Val_Wu16 65535.00 DFES_OneToOne 0.00 65535.00 /end CHARACTERISTIC
/begin CHARACTERISTIC DFC_DisblMsk.DFC_EGRVlvLPHBrgShCirBatt2_C "DFC/Abschalt Maske für Prüfung DFC_EGRVlvLPHBrgShCirBatt2" VALUE 0x8002624E Val_Wu16 65535.00 DFES_OneToOne 0.00 65535.00 /end CHARACTERISTIC
/begin CHARACTERISTIC DFC_DisblMsk.DFC_EGRVlvLPHBrgShCirGnd1_C "DFC/Abschalt Maske für Prüfung DFC_EGRVlvLPHBrgShCirGnd1" VALUE 0x80026250 Val_Wu16 65535.00 DFES_OneToOne 0.00 65535.00 /end CHARACTERISTIC
/begin CHARACTERISTIC DFC_DisblMsk.DFC_EGRVlvLPHBrgShCirGnd2_C "DFC/Abschalt Maske für Prüfung DFC_EGRVlvLPHBrgShCirGnd2" VALUE 0x80026252 Val_Wu16 65535.00 DFES_OneToOne 0.00 65535.00 /end CHARACTERISTIC
/begin CHARACTERISTIC DFC_DisblMsk.DFC_EGRVlvLPHBrgShCirOvrLd_C "DFC/Abschalt Maske für Prüfung DFC_EGRVlvLPHBrgShCirOvrLd" VALUE 0x80026254 Val_Wu16 65535.00 DFES_OneToOne 0.00 65535.00 /end CHARACTERISTIC
/begin CHARACTERISTIC DFC_DisblMsk.DFC_EGRVlvLPHBrgTempOvrCurr_C "DFC/Abschalt Maske für Prüfung DFC_EGRVlvLPHBrgTempOvrCurr" VALUE 0x80026256 Val_Wu16 65535.00 DFES_OneToOne 0.00 65535.00 /end CHARACTERISTIC
/begin CHARACTERISTIC DFC_DisblMsk.DFC_EGRVlvLPHBrgUndrVltg_C "DFC/Abschalt Maske für Prüfung DFC_EGRVlvLPHBrgUndrVltg" VALUE 0x80026258 Val_Wu16 65535.00 DFES_OneToOne 0.00 65535.00 /end CHARACTERISTIC
/begin CHARACTERISTIC DFC_DisblMsk.DFC_EGRVlvLPOL_C "DFC/Abschalt Maske für Prüfung DFC_EGRVlvLPOL" VALUE 0x8002625A Val_Wu16 65535.00 DFES_OneToOne 0.00 65535.00 /end CHARACTERISTIC
/begin CHARACTERISTIC DFC_DisblMsk.DFC_EGRVlvLPSCB_C "DFC/Abschalt Maske für Prüfung DFC_EGRVlvLPSCB" VALUE 0x8002625C Val_Wu16 65535.00 DFES_OneToOne 0.00 65535.00 /end CHARACTERISTIC
/begin CHARACTERISTIC DFC_DisblMsk.DFC_EGRVlvLPSCG_C "DFC/Abschalt Maske für Prüfung DFC_EGRVlvLPSCG" VALUE 0x8002625E Val_Wu16 65535.00 DFES_OneToOne 0.00 65535.00 /end CHARACTERISTIC
/begin CHARACTERISTIC DFC_DisblMsk.DFC_EGRVlvLPSRCMax_C "DFC/Abschalt Maske für Prüfung DFC_EGRVlvLPSRCMax" VALUE 0x80026260 Val_Wu16 65535.00 DFES_OneToOne 0.00 65535.00 /end CHARACTERISTIC
/begin CHARACTERISTIC DFC_DisblMsk.DFC_EGRVlvLPSRCMin_C "DFC/Abschalt Maske für Prüfung DFC_EGRVlvLPSRCMin" VALUE 0x80026262 Val_Wu16 65535.00 DFES_OneToOne 0.00 65535.00 /end CHARACTERISTIC
/begin CHARACTERISTIC DFC_DisblMsk.DFC_EGRVlvOL_C "DFC/Abschalt Maske für Prüfung DFC_EGRVlvOL" VALUE 0x80026264 Val_Wu16 65535.00 DFES_OneToOne 0.00 65535.00 /end CHARACTERISTIC
/begin CHARACTERISTIC DFC_DisblMsk.DFC_EGRVlvSCB_C "DFC/Abschalt Maske für Prüfung DFC_EGRVlvSCB" VALUE 0x80026266 Val_Wu16 65535.00 DFES_OneToOne 0.00 65535.00 /end CHARACTERISTIC
/begin CHARACTERISTIC DFC_DisblMsk.DFC_EGRVlvSCG_C "DFC/Abschalt Maske für Prüfung DFC_EGRVlvSCG" VALUE 0x80026268 Val_Wu16 65535.00 DFES_OneToOne 0.00 65535.00 /end CHARACTERISTIC
/begin CHARACTERISTIC DFC_DisblMsk.DFC_EGRVlvSRCMax_C "DFC/Abschalt Maske für Prüfung DFC_EGRVlvSRCMax" VALUE 0x8002626A Val_Wu16 65535.00 DFES_OneToOne 0.00 65535.00 /end CHARACTERISTIC
/begin CHARACTERISTIC DFC_DisblMsk.DFC_EGRVlvSRCMin_C "DFC/Abschalt Maske für Prüfung DFC_EGRVlvSRCMin" VALUE 0x8002626C Val_Wu16 65535.00 DFES_OneToOne 0.00 65535.00 /end CHARACTERISTIC
/begin CHARACTERISTIC DFC_DisblMsk.DFC_EngPrtOvrSpd_C "DFC/Abschalt Maske für Prüfung DFC_EngPrtOvrSpd" VALUE 0x8002626E Val_Wu16 65535.00 DFES_OneToOne 0.00 65535.00 /end CHARACTERISTIC
/begin CHARACTERISTIC DFC_DisblMsk.DFC_EngSpdOL_C "DFC/Abschalt Maske für Prüfung DFC_EngSpdOL" VALUE 0x80026270 Val_Wu16 65535.00 DFES_OneToOne 0.00 65535.00 /end CHARACTERISTIC
/begin CHARACTERISTIC DFC_DisblMsk.DFC_EngSpdSCB_C "DFC/Abschalt Maske für Prüfung DFC_EngSpdSCB" VALUE 0x80026272 Val_Wu16 65535.00 DFES_OneToOne 0.00 65535.00 /end CHARACTERISTIC
/begin CHARACTERISTIC DFC_DisblMsk.DFC_EngSpdSCG_C "DFC/Abschalt Maske für Prüfung DFC_EngSpdSCG" VALUE 0x80026274 Val_Wu16 65535.00 DFES_OneToOne 0.00 65535.00 /end CHARACTERISTIC
/begin CHARACTERISTIC DFC_DisblMsk.DFC_EnhSRCMaxPPFltDiff_C "DFC/Abschalt Maske für Prüfung DFC_EnhSRCMaxPPFltDiff" VALUE 0x80026276 Val_Wu16 65535.00 DFES_OneToOne 0.00 65535.00 /end CHARACTERISTIC
/begin CHARACTERISTIC DFC_DisblMsk.DFC_EnhSRCMaxT1ExhTMon_C "DFC/Abschalt Maske für Prüfung DFC_EnhSRCMaxT1ExhTMon" VALUE 0x80026278 Val_Wu16 65535.00 DFES_OneToOne 0.00 65535.00 /end CHARACTERISTIC
/begin CHARACTERISTIC DFC_DisblMsk.DFC_EnhSRCMaxT2ExhTMon_C "DFC/Abschalt Maske für Prüfung DFC_EnhSRCMaxT2ExhTMon" VALUE 0x8002627A Val_Wu16 65535.00 DFES_OneToOne 0.00 65535.00 /end CHARACTERISTIC
/begin CHARACTERISTIC DFC_DisblMsk.DFC_EnhSRCMaxT3ExhTMon_C "DFC/Abschalt Maske für Prüfung DFC_EnhSRCMaxT3ExhTMon" VALUE 0x8002627C Val_Wu16 65535.00 DFES_OneToOne 0.00 65535.00 /end CHARACTERISTIC
/begin CHARACTERISTIC DFC_DisblMsk.DFC_EnhSRCMinPPFltDiff_C "DFC/Abschalt Maske für Prüfung DFC_EnhSRCMinPPFltDiff" VALUE 0x8002627E Val_Wu16 65535.00 DFES_OneToOne 0.00 65535.00 /end CHARACTERISTIC
/begin CHARACTERISTIC DFC_DisblMsk.DFC_EnhSRCMinT1ExhTMon_C "DFC/Abschalt Maske für Prüfung DFC_EnhSRCMinT1ExhTMon" VALUE 0x80026280 Val_Wu16 65535.00 DFES_OneToOne 0.00 65535.00 /end CHARACTERISTIC
/begin CHARACTERISTIC DFC_DisblMsk.DFC_EnhSRCMinT2ExhTMon_C "DFC/Abschalt Maske für Prüfung DFC_EnhSRCMinT2ExhTMon" VALUE 0x80026282 Val_Wu16 65535.00 DFES_OneToOne 0.00 65535.00 /end CHARACTERISTIC
/begin CHARACTERISTIC DFC_DisblMsk.DFC_EnhSRCMinT3ExhTMon_C "DFC/Abschalt Maske für Prüfung DFC_EnhSRCMinT3ExhTMon" VALUE 0x80026284 Val_Wu16 65535.00 DFES_OneToOne 0.00 65535.00 /end CHARACTERISTIC
/begin CHARACTERISTIC DFC_DisblMsk.DFC_EnvPSRCMax_C "DFC/Abschalt Maske für Prüfung DFC_EnvPSRCMax" VALUE 0x80026286 Val_Wu16 65535.00 DFES_OneToOne 0.00 65535.00 /end CHARACTERISTIC
/begin CHARACTERISTIC DFC_DisblMsk.DFC_EnvPSRCMin_C "DFC/Abschalt Maske für Prüfung DFC_EnvPSRCMin" VALUE 0x80026288 Val_Wu16 65535.00 DFES_OneToOne 0.00 65535.00 /end CHARACTERISTIC
/begin CHARACTERISTIC DFC_DisblMsk.DFC_ExhTMonPlaus_C "DFC/Abschalt Maske für Prüfung DFC_ExhTMonPlaus" VALUE 0x8002628A Val_Wu16 65535.00 DFES_OneToOne 0.00 65535.00 /end CHARACTERISTIC
/begin CHARACTERISTIC DFC_DisblMsk.DFC_ExhTMonPlausPos1_C "DFC/Abschalt Maske für Prüfung DFC_ExhTMonPlausPos1" VALUE 0x8002628C Val_Wu16 65535.00 DFES_OneToOne 0.00 65535.00 /end CHARACTERISTIC
/begin CHARACTERISTIC DFC_DisblMsk.DFC_ExhTMonPlausPos2_C "DFC/Abschalt Maske für Prüfung DFC_ExhTMonPlausPos2" VALUE 0x8002628E Val_Wu16 65535.00 DFES_OneToOne 0.00 65535.00 /end CHARACTERISTIC
/begin CHARACTERISTIC DFC_DisblMsk.DFC_ExhTMonPlausPos3_C "DFC/Abschalt Maske für Prüfung DFC_ExhTMonPlausPos3" VALUE 0x80026290 Val_Wu16 65535.00 DFES_OneToOne 0.00 65535.00 /end CHARACTERISTIC
/begin CHARACTERISTIC DFC_DisblMsk.DFC_ExhTMonT1Plaus_C "DFC/Abschalt Maske für Prüfung DFC_ExhTMonT1Plaus" VALUE 0x80026292 Val_Wu16 65535.00 DFES_OneToOne 0.00 65535.00 /end CHARACTERISTIC
/begin CHARACTERISTIC DFC_DisblMsk.DFC_ExhTMonT2Plaus_C "DFC/Abschalt Maske für Prüfung DFC_ExhTMonT2Plaus" VALUE 0x80026294 Val_Wu16 65535.00 DFES_OneToOne 0.00 65535.00 /end CHARACTERISTIC
/begin CHARACTERISTIC DFC_DisblMsk.DFC_ExhTMonT3Plaus_C "DFC/Abschalt Maske für Prüfung DFC_ExhTMonT3Plaus" VALUE 0x80026296 Val_Wu16 65535.00 DFES_OneToOne 0.00 65535.00 /end CHARACTERISTIC
/begin CHARACTERISTIC DFC_DisblMsk.DFC_FlFltDsPSRCMax_C "DFC/Abschalt Maske für Prüfung DFC_FlFltDsPSRCMax" VALUE 0x80026298 Val_Wu16 65535.00 DFES_OneToOne 0.00 65535.00 /end CHARACTERISTIC
/begin FUNCTION DFC ""
 /begin DEF_CHARACTERISTIC DFC_CtlMsk.DFC_TCACDsSRCMax_C DFC_CtlMsk.DFC_TCACDsSRCMin_C DFC_CtlMsk.DFC_ThrVlvSRCMax_C DFC_CtlMsk.DFC_ThrVlvSRCMin_C DFC_CtlMsk.DFC_TrbChLPOL_C DFC_CtlMsk.DFC_TrbChLPSCB_C DFC_CtlMsk.DFC_TrbChLPSCG_C DFC_CtlMsk.DFC_UHtrPLOL_C DFC_CtlMsk.DFC_UHtrPLSCB_C DFC_CtlMsk.DFC_UHtrPLSCG_C DFC_CtlMsk.DFC_UHtrPLSRCMaxDia_C DFC_CtlMsk.DFC_UHtrPLSRCMinDia_C DFC_CtlMsk.DFC_UHtrTnkOL_C DFC_CtlMsk.DFC_UHtrTnkSCB_C DFC_CtlMsk.DFC_UHtrTnkSCG_C DFC_CtlMsk.DFC_UHtrTnkSRCMaxDia_C DFC_CtlMsk.DFC_UHtrTnkSRCMinDia_C DFC_CtlMsk.DFC_URevVlvOL_C DFC_CtlMsk.DFC_URevVlvSCB_C DFC_CtlMsk.DFC_URevVlvSCG_C DFC_CtlMsk.DFC_UTnkTSRCMax_C DFC_CtlMsk.DFC_UTnkTSRCMin_C DFC_CtlMsk.DFC_UTnkTSig_C DFC_CtlMsk.DFC_VSwVlvGovDvtMax_C DFC_CtlMsk.DFC_VSwVlvGovDvtMin_C DFC_CtlMsk.DFC_VSwVlvHBrgOpnLd_C DFC_CtlMsk.DFC_VSwVlvHBrgOvrCurr_C DFC_CtlMsk.DFC_VSwVlvHBrgOvrTemp_C DFC_CtlMsk.DFC_VSwVlvHBrgShCirBatt1_C DFC_CtlMsk.DFC_VSwVlvHBrgShCirBatt2_C DFC_CtlMsk.DFC_VSwVlvHBrgShCirGnd1_C DFC_CtlMsk.DFC_VSwVlvHBrgShCirGnd2_C DFC_CtlMsk.DFC_VSwVlvHBrgShCirOvrLd_C DFC_CtlMsk.DFC_VSwVlvHBrgTempOvrCurr_C DFC_CtlMsk.DFC_VSwVlvHBrgUndrVltg_C DFC_CtlMsk.DFC_VSwVlvOL_C DFC_CtlMsk.DFC_VSwVlvSCB_C DFC_CtlMsk.DFC_VSwVlvSCG_C DFC_CtlMsk.DFC_VSwVlvSRCMax_C DFC_CtlMsk.DFC_VSwVlvSRCMin_C DFC_CtlMsk.DFC_ClthNpl_C DFC_CtlMsk.DFC_ETClbETMax_0_C DFC_CtlMsk.DFC_ETClbETMax_1_C DFC_CtlMsk.DFC_ETClbETMax_2_C DFC_CtlMsk.DFC_ETClbETMax_3_C DFC_CtlMsk.DFC_ETClbETMax_4_C DFC_CtlMsk.DFC_ETClbETMax_5_C DFC_CtlMsk.DFC_ETClbETMin_0_C DFC_CtlMsk.DFC_ETClbETMin_1_C DFC_CtlMsk.DFC_ETClbETMin_2_C DFC_CtlMsk.DFC_ETClbETMin_3_C DFC_CtlMsk.DFC_ETClbETMin_4_C DFC_CtlMsk.DFC_ETClbETMin_5_C DFC_CtlMsk.DFC_IVActrEnrgMax_0_C DFC_CtlMsk.DFC_IVActrEnrgMax_1_C DFC_CtlMsk.DFC_IVActrEnrgMax_2_C DFC_CtlMsk.DFC_IVActrEnrgMax_3_C DFC_CtlMsk.DFC_IVActrEnrgMax_4_C DFC_CtlMsk.DFC_IVActrEnrgMax_5_C DFC_CtlMsk.DFC_IVActrEnrgMax_6_C DFC_CtlMsk.DFC_IVActrEnrgMax_7_C DFC_CtlMsk.DFC_IVActrEnrgMin_0_C DFC_CtlMsk.DFC_IVActrEnrgMin_1_C DFC_CtlMsk.DFC_IVActrEnrgMin_2_C DFC_CtlMsk.DFC_IVActrEnrgMin_3_C DFC_CtlMsk.DFC_IVActrEnrgMin_4_C DFC_CtlMsk.DFC_IVActrEnrgMin_5_C DFC_CtlMsk.DFC_IVActrEnrgMin_6_C DFC_CtlMsk.DFC_IVActrEnrgMin_7_C DFC_CtlMsk.DFC_IVActrEnrgPlaus_0_C DFC_CtlMsk.DFC_IVActrEnrgPlaus_1_C DFC_CtlMsk.DFC_IVActrEnrgPlaus_2_C DFC_CtlMsk.DFC_IVActrEnrgPlaus_3_C DFC_CtlMsk.DFC_IVActrEnrgPlaus_4_C DFC_CtlMsk.DFC_IVActrEnrgPlaus_5_C DFC_CtlMsk.DFC_IVActrEnrgPlaus_6_C DFC_CtlMsk.DFC_IVActrEnrgPlaus_7_C DFC_CtlMsk.DFC_IVCtlTiDiff_0_C DFC_CtlMsk.DFC_IVCtlTiDiff_1_C DFC_CtlMsk.DFC_IVCtlTiDiff_2_C DFC_CtlMsk.DFC_IVCtlTiDiff_3_C DFC_CtlMsk.DFC_IVCtlTiDiff_4_C DFC_CtlMsk.DFC_IVCtlTiDiff_5_C DFC_CtlMsk.DFC_IVCtlUDiffUp_0_C DFC_CtlMsk.DFC_IVCtlUDiffUp_1_C DFC_CtlMsk.DFC_IVCtlUDiffUp_2_C DFC_CtlMsk.DFC_IVCtlUDiffUp_3_C DFC_CtlMsk.DFC_IVCtlUDiffUp_4_C DFC_CtlMsk.DFC_IVCtlUDiffUp_5_C DFC_CtlMsk.DFC_IVCtlUUp_0_C DFC_CtlMsk.DFC_IVCtlUUp_1_C DFC_CtlMsk.DFC_IVCtlUUp_2_C DFC_CtlMsk.DFC_IVCtlUUp_3_C DFC_CtlMsk.DFC_IVCtlUUp_4_C DFC_CtlMsk.DFC_IVCtlUUp_5_C DFC_CtlMsk.DFC_IVDiaBnkShCir_0_C DFC_CtlMsk.DFC_IVDiaBnkShCir_1_C DFC_CtlMsk.DFC_IVDiaBnkShCirChSwt_0_C DFC_CtlMsk.DFC_IVDiaBnkShCirChSwt_1_C DFC_CtlMsk.DFC_IVDiaChp_0_C DFC_CtlMsk.DFC_IVDiaChp_1_C DFC_CtlMsk.DFC_IVDiaCylNoCls_0_C DFC_CtlMsk.DFC_IVDiaCylNoCls_1_C DFC_CtlMsk.DFC_IVDiaCylNoCls_2_C DFC_CtlMsk.DFC_IVDiaCylNoCls_3_C DFC_CtlMsk.DFC_IVDiaCylNoCls_4_C DFC_CtlMsk.DFC_IVDiaCylNoCls_5_C DFC_CtlMsk.DFC_IVDiaCylNoLd_0_C DFC_CtlMsk.DFC_IVDiaCylNoLd_1_C DFC_CtlMsk.DFC_IVDiaCylNoLd_2_C DFC_CtlMsk.DFC_IVDiaCylNoLd_3_C DFC_CtlMsk.DFC_IVDiaCylNoLd_4_C DFC_CtlMsk.DFC_IVDiaCylNoLd_5_C DFC_CtlMsk.DFC_IVDiaCylShCir_0_C DFC_CtlMsk.DFC_IVDiaCylShCir_1_C DFC_CtlMsk.DFC_IVDiaCylShCir_2_C DFC_CtlMsk.DFC_IVDiaCylShCir_3_C DFC_CtlMsk.DFC_IVDiaCylShCir_4_C DFC_CtlMsk.DFC_IVDiaCylShCir_5_C DFC_CtlMsk.DFC_IVDiaCylShCirHSLS_0_C DFC_CtlMsk.DFC_IVDiaCylShCirHSLS_1_C DFC_CtlMsk.DFC_IVDiaCylShCirHSLS_2_C DFC_CtlMsk.DFC_IVDiaCylShCirHSLS_3_C DFC_CtlMsk.DFC_IVDiaCylShCirHSLS_4_C DFC_CtlMsk.DFC_IVDiaCylShCirHSLS_5_C DFC_CtlMsk.DFC_IVDiaCylShCirMeas_0_C DFC_CtlMsk.DFC_IVDiaCylShCirMeas_1_C DFC_CtlMsk.DFC_IVDiaCylShCirMeas_2_C DFC_CtlMsk.DFC_IVDiaCylShCirMeas_3_C DFC_CtlMsk.DFC_IVDiaCylShCirMeas_4_C DFC_CtlMsk.DFC_IVDiaCylShCirMeas_5_C DFC_CtlMsk.DFC_LSUDynChk_C DFC_CtlMsk.DFC_LSUO2ClbMax_C DFC_CtlMsk.DFC_LSUO2ClbMin_C DFC_CtlMsk.DFC_LSUO2PlausMaxFLd_C DFC_CtlMsk.DFC_LSUO2PlausMaxOvrRun_C DFC_CtlMsk.DFC_LSUO2PlausMaxPartLd_C DFC_CtlMsk.DFC_LSUO2PlausMinFLd_C DFC_CtlMsk.DFC_LSUO2PlausMinOvrRun_C DFC_CtlMsk.DFC_LSUO2PlausMinPartLd_C DFC_CtlMsk.DFC_LSURiClbMax_C DFC_CtlMsk.DFC_LSURiClbMin_C DFC_CtlMsk.DFC_LSUWireIPSig_C DFC_CtlMsk.DFC_Layer_BSDMax_C DFC_CtlMsk.DFC_Layer_BSDMin_C DFC_CtlMsk.DFC_Layer_BSDNpl_C DFC_CtlMsk.DFC_Layer_BSDSig_C DFC_CtlMsk.DFC_Layer_FltMngTstMax_C DFC_CtlMsk.DFC_Layer_FltMngTstMin_C DFC_CtlMsk.DFC_Layer_FltMngTstNpl_C DFC_CtlMsk.DFC_Layer_FltMngTstSig_C DFC_CtlMsk.DFC_Layer_GENELBMax_C DFC_CtlMsk.DFC_Layer_GENELBMin_C DFC_CtlMsk.DFC_Layer_GENELBNpl_C DFC_CtlMsk.DFC_Layer_GENELBSig_C DFC_CtlMsk.DFC_Layer_GENELMax_C DFC_CtlMsk.DFC_Layer_GENELMin_C DFC_CtlMsk.DFC_Layer_GENELNpl_C DFC_CtlMsk.DFC_Layer_GENELSig_C DFC_CtlMsk.DFC_Layer_GENHTBMax_C DFC_CtlMsk.DFC_Layer_GENHTBMin_C DFC_CtlMsk.DFC_Layer_GENHTBNpl_C DFC_CtlMsk.DFC_Layer_GENHTBSig_C DFC_CtlMsk.DFC_Layer_GENHTMax_C DFC_CtlMsk.DFC_Layer_GENHTMin_C DFC_CtlMsk.DFC_Layer_GENHTNpl_C DFC_CtlMsk.DFC_Layer_GENHTSig_C DFC_CtlMsk.DFC_Layer_GENKOMMMax_C DFC_CtlMsk.DFC_Layer_GENKOMMMin_C DFC_CtlMsk.DFC_Layer_GENKOMMNpl_C DFC_CtlMsk.DFC_Layer_GENKOMMSig_C DFC_CtlMsk.DFC_Layer_GENMECHMax_C DFC_CtlMsk.DFC_Layer_GENMECHMin_C DFC_CtlMsk.DFC_Layer_GENMECHNpl_C DFC_CtlMsk.DFC_Layer_GENMECHSig_C DFC_CtlMsk.DFC_Layer_GENMax_C DFC_CtlMsk.DFC_Layer_GENMin_C DFC_CtlMsk.DFC_Layer_GENNpl_C DFC_CtlMsk.DFC_Layer_GENREGUPLMax_C DFC_CtlMsk.DFC_Layer_GENREGUPLMin_C DFC_CtlMsk.DFC_Layer_GENREGUPLNpl_C DFC_CtlMsk.DFC_Layer_GENREGUPLSig_C DFC_CtlMsk.DFC_Layer_GENSig_C DFC_CtlMsk.DFC_Layer_GENUPLMax_C DFC_CtlMsk.DFC_Layer_GENUPLMin_C DFC_CtlMsk.DFC_Layer_GENUPLNpl_C DFC_CtlMsk.DFC_Layer_GENUPLSig_C DFC_CtlMsk.DFC_Layer_IBS1Max_C DFC_CtlMsk.DFC_Layer_IBS1Min_C DFC_CtlMsk.DFC_Layer_IBS1Npl_C DFC_CtlMsk.DFC_Layer_IBS1Sig_C DFC_CtlMsk.DFC_Layer_IBS2Max_C DFC_CtlMsk.DFC_Layer_IBS2Min_C DFC_CtlMsk.DFC_Layer_IBS2Npl_C DFC_CtlMsk.DFC_Layer_IBS2Sig_C DFC_CtlMsk.DFC_Layer_IBS3Max_C DFC_CtlMsk.DFC_Layer_IBS3Min_C DFC_CtlMsk.DFC_Layer_IBS3Npl_C DFC_CtlMsk.DFC_Layer_IBS3Sig_C DFC_CtlMsk.DFC_Layer_MANDETEKMax_C DFC_CtlMsk.DFC_Layer_MANDETEKMin_C DFC_CtlMsk.DFC_Layer_MANDETEKNpl_C DFC_CtlMsk.DFC_Layer_MANDETEKSig_C DFC_CtlMsk.DFC_Layer_NDR1Max_C DFC_CtlMsk.DFC_Layer_NDR1Min_C DFC_CtlMsk.DFC_Layer_NDR1Npl_C DFC_CtlMsk.DFC_Layer_NDR1Sig_C DFC_CtlMsk.DFC_Layer_NDR2Max_C DFC_CtlMsk.DFC_Layer_NDR2Min_C DFC_CtlMsk.DFC_Layer_NDR2Npl_C DFC_CtlMsk.DFC_Layer_NDR2Sig_C DFC_CtlMsk.DFC_Layer_NGLERNMax_C DFC_CtlMsk.DFC_Layer_NGLERNMin_C DFC_CtlMsk.DFC_Layer_NGLERNNpl_C DFC_CtlMsk.DFC_Layer_NGLERNSig_C DFC_CtlMsk.DFC_Layer_PMBATTMax_C DFC_CtlMsk.DFC_Layer_PMBATTMin_C DFC_CtlMsk.DFC_Layer_PMBATTNpl_C DFC_CtlMsk.DFC_Layer_PMBATTSig_C DFC_CtlMsk.DFC_Layer_PMBNMax_C DFC_CtlMsk.DFC_Layer_PMBNMin_C DFC_CtlMsk.DFC_Layer_PMBNNpl_C DFC_CtlMsk.DFC_Layer_PMBNSig_C DFC_CtlMsk.DFC_Layer_PMRUHVERLMax_C DFC_CtlMsk.DFC_Layer_PMRUHVERLMin_C DFC_CtlMsk.DFC_Layer_PMRUHVERLNpl_C DFC_CtlMsk.DFC_Layer_PMRUHVERLSig_C DFC_CtlMsk.DFC_Layer_QLTMax_C DFC_CtlMsk.DFC_Layer_QLTMin_C DFC_CtlMsk.DFC_Layer_QLTNpl_C DFC_CtlMsk.DFC_Layer_QLTSig_C DFC_CtlMsk.DFC_Layer_TOENSMax_C DFC_CtlMsk.DFC_Layer_TOENSMin_C DFC_CtlMsk.DFC_Layer_TOENSNpl_C DFC_CtlMsk.DFC_Layer_TOENSSig_C DFC_CtlMsk.DFC_MonLimCurr_C DFC_CtlMsk.DFC_MonLimLead_C DFC_CtlMsk.DFC_MonLimSet_C DFC_CtlMsk.DFC_NSCDsNOxOfsMax_C DFC_CtlMsk.DFC_NSCDsNOxOfsMin_C DFC_CtlMsk.DFC_NSCDsNOxPlausMin_C DFC_CtlMsk.DFC_NoCat2DsNOxOfsMax_C DFC_CtlMsk.DFC_NoCat2DsNOxOfsMin_C DFC_CtlMsk.DFC_NoCat2DsNOxPlausMin_C DFC_CtlMsk.DFC_PCVNoStrt_C DFC_CtlMsk.DFC_RailPGradMon_C DFC_CtlMsk.DFC_SCRPODPresBuildUp_C DFC_CtlMsk.DFC_AFSDrftIdlAdjVal_C DFC_CtlMsk.DFC_AFSDrftLdAdjVal_C DFC_CtlMsk.DFC_AdcIADC0Cal_C DFC_CtlMsk.DFC_AdcIADC0Conv_C DFC_CtlMsk.DFC_AdcIADC1Cal_C DFC_CtlMsk.DFC_AdcIADC1Conv_C DFC_CtlMsk.DFC_CmbChbMisfireMax_0_C DFC_CtlMsk.DFC_CmbChbMisfireMax_1_C DFC_CtlMsk.DFC_CmbChbMisfireMax_2_C DFC_CtlMsk.DFC_CmbChbMisfireMax_3_C DFC_CtlMsk.DFC_CmbChbMisfireMax_4_C DFC_CtlMsk.DFC_CmbChbMisfireMax_5_C DFC_CtlMsk.DFC_CmbChbMisfireMul_C DFC_CtlMsk.DFC_EGRVlvLPOfsNeutr_C DFC_CtlMsk.DFC_EGRVlvOfsNeutr_C DFC_CtlMsk.DFC_FMAErrModMax_C DFC_CtlMsk.DFC_FMAErrModMin_C DFC_CtlMsk.DFC_FlSysTnkLo_C DFC_CtlMsk.DFC_GbxNPosPlaus_C DFC_CtlMsk.DFC_I14229_ROETst_Appl_C DFC_CtlMsk.DFC_I14229_ROETst_Netw_C DFC_CtlMsk.DFC_I14229_ROE_BufFull_C DFC_CtlMsk.DFC_IVAdjDiaIVAdj_C DFC_CtlMsk.DFC_IVAdjIVA_0_C DFC_CtlMsk.DFC_IVAdjIVA_1_C DFC_CtlMsk.DFC_IVAdjIVA_2_C DFC_CtlMsk.DFC_IVAdjIVA_3_C DFC_CtlMsk.DFC_IVAdjIVA_4_C DFC_CtlMsk.DFC_IVAdjIVA_5_C DFC_CtlMsk.DFC_IVPSplyDCDCOff_0_C DFC_CtlMsk.DFC_IVPSplyDCDCOff_1_C DFC_CtlMsk.DFC_IVPSplyDCDCOff_2_C DFC_CtlMsk.DFC_IVPSplyDCDCOff_3_C DFC_CtlMsk.DFC_InjCtlAdjQntEEPCS_C DFC_CtlMsk.DFC_LSUSPISig_C DFC_CtlMsk.DFC_Layer_Dummy_C DFC_CtlMsk.DFC_NplEnvPSensPPFltDiff_C DFC_CtlMsk.DFC_NplPresSensPPFltDiff_C DFC_CtlMsk.DFC_OilLvlPlaus_C DFC_CtlMsk.DFC_OilTOutLvl_C DFC_CtlMsk.DFC_PCVfacAdaptMax_C DFC_CtlMsk.DFC_PCVfacAdaptMin_C DFC_CtlMsk.DFC_SensFrzPPFltUs_C DFC_CtlMsk.DFC_SensMonUTnkLvl_C DFC_CtlMsk.DFC_T15Sig_C DFC_CtlMsk.DFC_AirCtlRmpTOut_C DFC_CtlMsk.DFC_BrkPPlaus_C DFC_CtlMsk.DFC_CEngDsTDynTst_C DFC_CtlMsk.DFC_EEPEraseErr_C DFC_CtlMsk.DFC_EEPRdErr_C DFC_CtlMsk.DFC_EEPWrErr_C DFC_CtlMsk.DFC_EGRVlvJamVlvClsd_C DFC_CtlMsk.DFC_EGRVlvJamVlvOpn_C DFC_CtlMsk.DFC_EGRVlvLPJamVlvClsd_C DFC_CtlMsk.DFC_EGRVlvLPJamVlvOpn_C DFC_CtlMsk.DFC_EGRVlvLPLgTDrft_C DFC_CtlMsk.DFC_EGRVlvLPOfsLrnJamVlv_C DFC_CtlMsk.DFC_EGRVlvLPShTDrft_C DFC_CtlMsk.DFC_EGRVlvLgTDrft_C DFC_CtlMsk.DFC_EGRVlvOfsLrnJamVlv_C DFC_CtlMsk.DFC_EGRVlvShTDrft_C DFC_CtlMsk.DFC_EngICO_C DFC_CtlMsk.DFC_EpmCaSI1ErrSig_C DFC_CtlMsk.DFC_EpmCaSI1NoSig_C DFC_CtlMsk.DFC_EpmCaSI1OfsErr_C DFC_CtlMsk.DFC_EpmCrSErrSig_C DFC_CtlMsk.DFC_EpmCrSNoSig_C DFC_CtlMsk.DFC_IVPlausComprTst_C DFC_CtlMsk.DFC_IVPlausRunUpTst_C DFC_CtlMsk.DFC_InjCrvShOffTst_C DFC_CtlMsk.DFC_LayerEnSavModProd_C DFC_CtlMsk.DFC_LayerEnSavModRep_C DFC_CtlMsk.DFC_LayerEnSavModShip_C DFC_CtlMsk.DFC_MRlyErlyOpng_C DFC_CtlMsk.DFC_MRlyStk_C DFC_CtlMsk.DFC_MeUnActrTst_C DFC_CtlMsk.DFC_MoCADCCmp_C DFC_CtlMsk.DFC_MoCADCTst_C DFC_CtlMsk.DFC_MoCADCVltgRatio_C DFC_CtlMsk.DFC_MoCComErrCnt_C DFC_CtlMsk.DFC_MoCComSPI_C DFC_CtlMsk.DFC_MoCROMErrXPg_C DFC_CtlMsk.DFC_MoCSOPHwNoRdy_C DFC_CtlMsk.DFC_MoCSOPLoLi_C DFC_CtlMsk.DFC_MoCSOPMM_C DFC_CtlMsk.DFC_MoCSOPTimeOut_C DFC_CtlMsk.DFC_MoCSOPUpLi_C DFC_CtlMsk.DFC_MoFAPP_C DFC_CtlMsk.DFC_MoFESpd_C DFC_CtlMsk.DFC_MoFInjDatPhi_C DFC_CtlMsk.DFC_MoFInjDatQnt_C DFC_CtlMsk.DFC_MoFInjQnt_C DFC_CtlMsk.DFC_MoFMode1PoI1_C DFC_CtlMsk.DFC_MoFMode1PoI2_C DFC_CtlMsk.DFC_MoFMode2PoI1_C DFC_CtlMsk.DFC_MoFMode2PoI2_C DFC_CtlMsk.DFC_MoFOvR_C DFC_CtlMsk.DFC_MoFQntCor_C DFC_CtlMsk.DFC_MoFRailP_C DFC_CtlMsk.DFC_MoFTrqCmp_C DFC_CtlMsk.DFC_NSCDsHtrSetP_C DFC_CtlMsk.DFC_NoCat2DsHtrSetP_C DFC_CtlMsk.DFC_PCVActrTst_C DFC_CtlMsk.DFC_PhyModNonMonMapNpl_C DFC_CtlMsk.DFC_RailHpTst_C DFC_CtlMsk.DFC_RailPOfsTstMax_C DFC_CtlMsk.DFC_RailPOfsTstMin_C DFC_CtlMsk.DFC_SIA_E1max_C DFC_CtlMsk.DFC_SIA_E1min_C DFC_CtlMsk.DFC_SIA_E1npl_C DFC_CtlMsk.DFC_SIA_E1sig_C DFC_CtlMsk.DFC_SIA_E2max_C DFC_CtlMsk.DFC_SIA_E2min_C DFC_CtlMsk.DFC_SIA_E2npl_C DFC_CtlMsk.DFC_SIA_E2sig_C DFC_CtlMsk.DFC_SIA_E3max_C DFC_CtlMsk.DFC_SIA_E3min_C DFC_CtlMsk.DFC_SIA_E3npl_C DFC_CtlMsk.DFC_SIA_E3sig_C DFC_CtlMsk.DFC_SIA_E4max_C DFC_CtlMsk.DFC_SIA_E4min_C DFC_CtlMsk.DFC_SIA_E4npl_C DFC_CtlMsk.DFC_SIA_E4sig_C DFC_CtlMsk.DFC_SWReset_0_C DFC_CtlMsk.DFC_SWReset_1_C DFC_CtlMsk.DFC_SWReset_2_C DFC_CtlMsk.DFC_ShtrAKKMax_C DFC_CtlMsk.DFC_ShtrAKKMin_C DFC_CtlMsk.DFC_ShtrAKKNpl_C DFC_CtlMsk.DFC_ShtrPKKMax_C DFC_CtlMsk.DFC_StopCntTmr_C DFC_CtlMsk.DFC_ThrVlvMon_C DFC_CtlMsk.DFC_VSwVlvJamVlv_C DFC_CtlMsk.DFC_VSwVlvLgTDrft_C DFC_CtlMsk.DFC_VSwVlvOfsLrnJamVlv_C DFC_CtlMsk.DFC_VSwVlvOfsNeutr_C DFC_CtlMsk.DFC_VSwVlvShTDrft_C DFC_CtlMsk.DFC_VSwVlvSpgDef_C DFC_DisblMsk.DFC_Unused_C DFC_DisblMsk.DFC_ACCIPlausDrvAst_C DFC_DisblMsk.DFC_ACCIPlausTrqDes_C DFC_DisblMsk.DFC_AirCtlGovDvtEOMMax_C DFC_DisblMsk.DFC_AirCtlGovDvtEOMMin_C DFC_DisblMsk.DFC_AirCtlGovDvtMax_C DFC_DisblMsk.DFC_AirCtlGovDvtMin_C DFC_DisblMsk.DFC_AirCtlGovLPDvtMax_C DFC_DisblMsk.DFC_AirCtlGovLPDvtMin_C DFC_DisblMsk.DFC_AltIOComErr_C DFC_DisblMsk.DFC_AltIOComNpl_C DFC_DisblMsk.DFC_BusDiagBusOffFlexRay_C DFC_DisblMsk.DFC_BusDiagBusOffNodeA_C DFC_DisblMsk.DFC_BusDiagBusOffNodeB_C DFC_DisblMsk.DFC_BusDiagBusOffNodeC_C DFC_DisblMsk.DFC_BusDiagHwFlexRay_C DFC_DisblMsk.DFC_Cj945SpiCom1_C DFC_DisblMsk.DFC_ComACDemandSig_FA_C DFC_DisblMsk.DFC_ComACDemandTo_FA_C DFC_DisblMsk.DFC_ComATempSig_FA_C DFC_DisblMsk.DFC_ComATempTo_FA_C DFC_DisblMsk.DFC_ComATempTo_FX_C DFC_DisblMsk.DFC_ComBrkTrqSumChk_FX_C DFC_DisblMsk.DFC_ComBrkTrqSumCtr_FX_C DFC_DisblMsk.DFC_ComBrkTrqSumTo_FX_C DFC_DisblMsk.DFC_ComBtnDrvDynChk_FX_C DFC_DisblMsk.DFC_ComBtnDrvDynCtr_FX_C DFC_DisblMsk.DFC_ComBtnDrvDynTo_FX_C DFC_DisblMsk.DFC_ComButtonMSASig_C DFC_DisblMsk.DFC_ComButtonMSATo_C DFC_DisblMsk.DFC_ComCodierungPwrmngSig_C DFC_DisblMsk.DFC_ComCodierungPwrmngSig_FA_C DFC_DisblMsk.DFC_ComCrCtlLvrChk_C DFC_DisblMsk.DFC_ComCrCtlLvrCtr_C DFC_DisblMsk.DFC_ComCrCtlLvrSig_C DFC_DisblMsk.DFC_ComCrCtlLvrTo_C DFC_DisblMsk.DFC_ComCtrCrshSwoEkpSig_FA_C DFC_DisblMsk.DFC_ComCtrCrshSwoEkpTo_FA_C DFC_DisblMsk.DFC_ComCtrSecInt_C DFC_DisblMsk.DFC_ComDiaOBDGbxSig_A_C DFC_DisblMsk.DFC_ComDiaOBDGbxTo_A_C DFC_DisblMsk.DFC_ComFahrzeugtypSig_C DFC_DisblMsk.DFC_ComFahrzeugtypSig_FA_C DFC_DisblMsk.DFC_ComFllupGpwsupSig_FA_C DFC_DisblMsk.DFC_ComFllupGpwsupTo_FA_C DFC_DisblMsk.DFC_ComGbxDataChk_A_C DFC_DisblMsk.DFC_ComGbxDataChk_FA_C DFC_DisblMsk.DFC_ComGbxDataCtr_A_C DFC_DisblMsk.DFC_ComGbxDataCtr_FA_C DFC_DisblMsk.DFC_ComGbxDataSig_A_C DFC_DisblMsk.DFC_ComGbxDataSig_FA_C DFC_DisblMsk.DFC_ComGbxDataTo_A_C DFC_DisblMsk.DFC_ComGbxDataTo_FA_C DFC_DisblMsk.DFC_ComKlemmenChk_FA_C DFC_DisblMsk.DFC_ComKlemmenCtr_FA_C DFC_DisblMsk.DFC_ComKlemmenSig_FA_C DFC_DisblMsk.DFC_ComKlemmenTo_FA_C DFC_DisblMsk.DFC_ComLenkradwinkelSig_C DFC_DisblMsk.DFC_ComLenkradwinkelTo_C DFC_DisblMsk.DFC_ComMileageRangeSig_FA_C DFC_DisblMsk.DFC_ComMileageRangeTo_FA_C DFC_DisblMsk.DFC_ComPspSig_C DFC_DisblMsk.DFC_ComPspTo_C DFC_DisblMsk.DFC_ComRelTimeSig_FA_C DFC_DisblMsk.DFC_ComRelTimeTo_FA_C DFC_DisblMsk.DFC_ComRequestEMFChk_C DFC_DisblMsk.DFC_ComRequestEMFCtr_C DFC_DisblMsk.DFC_ComRequestEMFSig_C DFC_DisblMsk.DFC_ComRequestEMFTo_C DFC_DisblMsk.DFC_ComRpmWhlChk_FX_C DFC_DisblMsk.DFC_ComRpmWhlCtr_FX_C DFC_DisblMsk.DFC_ComRpmWhlTo_FX_C DFC_DisblMsk.DFC_ComSecCtrRelSig_FA_C DFC_DisblMsk.DFC_ComSecCtrRelTo_FA_C DFC_DisblMsk.DFC_ComSensNOxGndSig_C DFC_DisblMsk.DFC_ComSensNOxGndTo_C DFC_DisblMsk.DFC_ComSensNOxMode_C DFC_DisblMsk.DFC_ComSensNOxUbattSig_C DFC_DisblMsk.DFC_ComSensNOxUbattTo_C DFC_DisblMsk.DFC_ComShiftPaddleTo_FX_C DFC_DisblMsk.DFC_ComShutOffPSPSig_C DFC_DisblMsk.DFC_ComShutOffPSPTo_C DFC_DisblMsk.DFC_ComSlrdiGlbFZMTo_FA_C DFC_DisblMsk.DFC_ComSlrdiGlbFZMTo_FX_C DFC_DisblMsk.DFC_ComSpeedVehicleChk_FX_C DFC_DisblMsk.DFC_ComSpeedVehicleCtr_FX_C DFC_DisblMsk.DFC_ComSpeedVehicleTo_FX_C DFC_DisblMsk.DFC_ComStConintDSCChk_FX_C DFC_DisblMsk.DFC_ComStConintDSCCtr_FX_C DFC_DisblMsk.DFC_ComStConintDSCTo_FX_C DFC_DisblMsk.DFC_ComStatACFrontSig_FA_C DFC_DisblMsk.DFC_ComStatACFrontTo_FA_C DFC_DisblMsk.DFC_ComStatEkpSig_A_C DFC_DisblMsk.DFC_ComStatEkpTo_A_C DFC_DisblMsk.DFC_ComStatGearRevSig_FA_C DFC_DisblMsk.DFC_ComStatGearRevTo_FA_C DFC_DisblMsk.DFC_ComStatZVKlappenSig_FA_C DFC_DisblMsk.DFC_ComStatZVKlappenTo_FA_C DFC_DisblMsk.DFC_ComStateARSCtr_C DFC_DisblMsk.DFC_ComStateARSSig_C DFC_DisblMsk.DFC_ComStateARSTo_C DFC_DisblMsk.DFC_ComStateDscSig_C DFC_DisblMsk.DFC_ComStateDscTo_C DFC_DisblMsk.DFC_ComStateSeatSig_C DFC_DisblMsk.DFC_ComStateSeatSig_FA_C DFC_DisblMsk.DFC_ComStateSeatTo_C DFC_DisblMsk.DFC_ComStateSeatTo_FA_C DFC_DisblMsk.DFC_ComStatusEGSSig_A_C DFC_DisblMsk.DFC_ComStatusEGSSig_FA_C DFC_DisblMsk.DFC_ComStatusEGSTo_A_C DFC_DisblMsk.DFC_ComStatusEGSTo_FA_C DFC_DisblMsk.DFC_ComStatusEMFChk_C DFC_DisblMsk.DFC_ComStatusEMFCtr_C DFC_DisblMsk.DFC_ComStatusEMFSig_C DFC_DisblMsk.DFC_ComStatusEMFTo_C DFC_DisblMsk.DFC_ComStatusRGangSig_C DFC_DisblMsk.DFC_ComStatusRGangTo_C DFC_DisblMsk.DFC_ComSteeringAngleChk_FX_C DFC_DisblMsk.DFC_ComSteeringAngleCtr_FX_C DFC_DisblMsk.DFC_ComSteeringAngleTo_FX_C DFC_DisblMsk.DFC_ComTerminalChk_C DFC_DisblMsk.DFC_ComTerminalCtr_C DFC_DisblMsk.DFC_ComTerminalSig_C DFC_DisblMsk.DFC_ComTerminalTo_C DFC_DisblMsk.DFC_ComTimeDateSig_FA_C DFC_DisblMsk.DFC_ComTimeDateTo_FA_C DFC_DisblMsk.DFC_ComTrailerSig_C DFC_DisblMsk.DFC_ComTrailerSig_FA_C DFC_DisblMsk.DFC_ComTrailerTo_C DFC_DisblMsk.DFC_ComTrailerTo_FA_C DFC_DisblMsk.DFC_ComTrqDemCrshDrDyChk_FX_C DFC_DisblMsk.DFC_ComTrqDemCrshDrDyCtr_FX_C DFC_DisblMsk.DFC_ComTrqDemCrshDrDyTo_FX_C DFC_DisblMsk.DFC_ComTrqDemandDesSig_C DFC_DisblMsk.DFC_ComTrqDemandDesTo_C DFC_DisblMsk.DFC_ComTrqDemandDscChk_C DFC_DisblMsk.DFC_ComTrqDemandDscCtr_C DFC_DisblMsk.DFC_ComTrqDemandDscSig_C DFC_DisblMsk.DFC_ComTrqDemandDscTo_C DFC_DisblMsk.DFC_ComTrqDemandGbxChk_A_C DFC_DisblMsk.DFC_ComTrqDemandGbxChk_FA_C DFC_DisblMsk.DFC_ComTrqDemandGbxCtr_A_C DFC_DisblMsk.DFC_ComTrqDemandGbxCtr_FA_C DFC_DisblMsk.DFC_ComTrqDemandGbxSig_A_C DFC_DisblMsk.DFC_ComTrqDemandGbxSig_FA_C DFC_DisblMsk.DFC_ComTrqDemandGbxTo_A_C DFC_DisblMsk.DFC_ComTrqDemandGbxTo_FA_C DFC_DisblMsk.DFC_ComTrqWhlDemChk_C DFC_DisblMsk.DFC_ComTrqWhlDemCtr_C DFC_DisblMsk.DFC_ComTrqWhlDemFASChk_FX_C DFC_DisblMsk.DFC_ComTrqWhlDemFASCtr_FX_C DFC_DisblMsk.DFC_ComTrqWhlDemFASTo_FX_C DFC_DisblMsk.DFC_ComTrqWhlDemSig_C DFC_DisblMsk.DFC_ComTrqWhlDemTo_C DFC_DisblMsk.DFC_ComVelocityChk_FA_C DFC_DisblMsk.DFC_ComVelocityCtr_FA_C DFC_DisblMsk.DFC_ComVelocitySig_C DFC_DisblMsk.DFC_ComVelocitySig_FA_C DFC_DisblMsk.DFC_ComVelocityTo_C DFC_DisblMsk.DFC_ComVelocityTo_FA_C DFC_DisblMsk.DFC_ComVerbraucherTo_C DFC_DisblMsk.DFC_ComWMomPTStabChk_FX_C DFC_DisblMsk.DFC_ComWMomPTStabCtr_FX_C DFC_DisblMsk.DFC_ComWMomPTStabTo_FX_C DFC_DisblMsk.DFC_ComWheelSpeedSig_C DFC_DisblMsk.DFC_ComWheelSpeedTo_C DFC_DisblMsk.DFC_ComZvKlappenSig_C DFC_DisblMsk.DFC_ComZvKlappenTo_C DFC_DisblMsk.DFC_ComaDirectChk_FX_C DFC_DisblMsk.DFC_ComaDirectCtr_FX_C DFC_DisblMsk.DFC_ComaDirectTo_FX_C DFC_DisblMsk.DFC_ComaSideChk_FX_C DFC_DisblMsk.DFC_ComaSideCtr_FX_C DFC_DisblMsk.DFC_ComaSideTo_FX_C DFC_DisblMsk.DFC_Cy320SpiCom_C DFC_DisblMsk.DFC_ETCtlDvtInrMax_C DFC_DisblMsk.DFC_ETCtlDvtInrMin_C DFC_DisblMsk.DFC_ETCtlDvtOutrMax_C DFC_DisblMsk.DFC_ETCtlDvtOutrMin_C DFC_DisblMsk.DFC_FBCqDvtMax_C DFC_DisblMsk.DFC_FBCqDvtMin_C DFC_DisblMsk.DFC_Fan4WinErr1_C DFC_DisblMsk.DFC_Fan4WinErr2_C DFC_DisblMsk.DFC_Fan4WinErr3_C DFC_DisblMsk.DFC_Fan4WinErr4_C DFC_DisblMsk.DFC_FanSCG_C DFC_DisblMsk.DFC_FlFCBS_C DFC_DisblMsk.DFC_GlwEcuConfigErr_C DFC_DisblMsk.DFC_GlwEcuEepErr_C DFC_DisblMsk.DFC_GlwEcuFrmErr_C DFC_DisblMsk.DFC_GlwEcuGPCMFaultInfo_C DFC_DisblMsk.DFC_GlwEcuGPCMInfo_C DFC_DisblMsk.DFC_GlwEcuGk1HSS_C DFC_DisblMsk.DFC_GlwEcuGk1OL_C DFC_DisblMsk.DFC_GlwEcuGk1SC_C DFC_DisblMsk.DFC_GlwEcuGk1Wdst_C DFC_DisblMsk.DFC_GlwEcuGk2HSS_C DFC_DisblMsk.DFC_GlwEcuGk2OL_C DFC_DisblMsk.DFC_GlwEcuGk2SC_C DFC_DisblMsk.DFC_GlwEcuGk2Wdst_C DFC_DisblMsk.DFC_GlwEcuGk3HSS_C DFC_DisblMsk.DFC_GlwEcuGk3OL_C DFC_DisblMsk.DFC_GlwEcuGk3SC_C DFC_DisblMsk.DFC_GlwEcuGk3Wdst_C DFC_DisblMsk.DFC_GlwEcuGk4HSS_C DFC_DisblMsk.DFC_GlwEcuGk4OL_C DFC_DisblMsk.DFC_GlwEcuGk4SC_C DFC_DisblMsk.DFC_GlwEcuGk4Wdst_C DFC_DisblMsk.DFC_GlwEcuGk5HSS_C DFC_DisblMsk.DFC_GlwEcuGk5OL_C DFC_DisblMsk.DFC_GlwEcuGk5SC_C DFC_DisblMsk.DFC_GlwEcuGk5Wdst_C DFC_DisblMsk.DFC_GlwEcuGk6HSS_C DFC_DisblMsk.DFC_GlwEcuGk6OL_C DFC_DisblMsk.DFC_GlwEcuGk6SC_C DFC_DisblMsk.DFC_GlwEcuGk6Wdst_C DFC_DisblMsk.DFC_GlwEcuGndErr_C DFC_DisblMsk.DFC_GlwEcuIntErr_C DFC_DisblMsk.DFC_GlwEcuMsgTimeout_C DFC_DisblMsk.DFC_GlwEcuT30Err_C DFC_DisblMsk.DFC_GlwEcuTempErr_C DFC_DisblMsk.DFC_GlwEcuUdiffT30_C DFC_DisblMsk.DFC_IBSComErr_C DFC_DisblMsk.DFC_LubSRCOilFldtCrit_C DFC_DisblMsk.DFC_LubSRCOilFldtCritDflMin_C DFC_DisblMsk.DFC_LubSRCOilLvlCritMax_C DFC_DisblMsk.DFC_LubSRCOilLvlCritMin_C DFC_DisblMsk.DFC_LubSRCTot_C DFC_DisblMsk.DFC_MonUMaxSupply1_C DFC_DisblMsk.DFC_MonUMinSupply1_C DFC_DisblMsk.DFC_OilComNpl_C DFC_DisblMsk.DFC_PCBS_C DFC_DisblMsk.DFC_PCBSPFltChg_C DFC_DisblMsk.DFC_PCRGovDvtLPMax_C DFC_DisblMsk.DFC_PCRGovDvtLPMin_C DFC_DisblMsk.DFC_PCRGovDvtMax_C DFC_DisblMsk.DFC_PCRGovDvtMin_C DFC_DisblMsk.DFC_PFltAPSPlausMAX_C DFC_DisblMsk.DFC_PFltAPSPlausMIN_C DFC_DisblMsk.DFC_PFltBPSPlausMAX_C DFC_DisblMsk.DFC_PFltBPSPlausMIN_C DFC_DisblMsk.DFC_PFltOvldInhRgn_C DFC_DisblMsk.DFC_PFltOvldTrqLim_C DFC_DisblMsk.DFC_PFltPresPlausMAX_C DFC_DisblMsk.DFC_PFltPresPlausMIN_C DFC_DisblMsk.DFC_PFltTraRpmRdc_C DFC_DisblMsk.DFC_PFlt_tOxiPreMax_C DFC_DisblMsk.DFC_PFlt_tOxiPreMaxRgn_C DFC_DisblMsk.DFC_PFlt_tOxiPreNpl_C DFC_DisblMsk.DFC_PFlt_tPreMax_C DFC_DisblMsk.DFC_PFlt_tPreMaxRgn_C DFC_DisblMsk.DFC_PFlt_tPreNpl_C DFC_DisblMsk.DFC_PFltmSotDiffMAX_C DFC_DisblMsk.DFC_PFltmSotDiffMIN_C DFC_DisblMsk.DFC_PFltmSotDiffSIG_C DFC_DisblMsk.DFC_PIntkVUsEnvPPls_C DFC_DisblMsk.DFC_PresPlausDblDef_C DFC_DisblMsk.DFC_RailCPC1_C DFC_DisblMsk.DFC_RailCPC3_C DFC_DisblMsk.DFC_RailCPC4_C DFC_DisblMsk.DFC_RailMeUn0_C DFC_DisblMsk.DFC_RailMeUn1_C DFC_DisblMsk.DFC_RailMeUn2_C DFC_DisblMsk.DFC_RailMeUn22_C DFC_DisblMsk.DFC_RailMeUn3_C DFC_DisblMsk.DFC_RailMeUn4_C DFC_DisblMsk.DFC_RailMeUn42_C DFC_DisblMsk.DFC_RailMeUn5_C DFC_DisblMsk.DFC_RailPCV0_C DFC_DisblMsk.DFC_RailPCV1_C DFC_DisblMsk.DFC_RailPCV2_C DFC_DisblMsk.DFC_RailPCV22_C DFC_DisblMsk.DFC_RailPCV3_C DFC_DisblMsk.DFC_RailPCV4_C DFC_DisblMsk.DFC_RailPCV42_C DFC_DisblMsk.DFC_RailPMonStrt_C DFC_DisblMsk.DFC_SSpMon1_C DFC_DisblMsk.DFC_SSpMon2_C DFC_DisblMsk.DFC_SSpMon3_C DFC_DisblMsk.DFC_ThrVlv4WinErr1_C DFC_DisblMsk.DFC_ThrVlv4WinErr2_C DFC_DisblMsk.DFC_ThrVlv4WinErr3_C DFC_DisblMsk.DFC_ThrVlv4WinErr4_C DFC_DisblMsk.DFC_ThrVlvSCG_C DFC_DisblMsk.DFC_Tle6232Spi1_C DFC_DisblMsk.DFC_TrbCh4WinErr1_C DFC_DisblMsk.DFC_TrbCh4WinErr2_C DFC_DisblMsk.DFC_TrbCh4WinErr3_C DFC_DisblMsk.DFC_TrbCh4WinErr4_C DFC_DisblMsk.DFC_TrbChSCG_C DFC_DisblMsk.DFC_TrbChSRCMax_C DFC_DisblMsk.DFC_TrbChSRCMin_C DFC_DisblMsk.DFC_WaHtEl4WinErr1_C DFC_DisblMsk.DFC_WaHtEl4WinErr2_C DFC_DisblMsk.DFC_WaHtEl4WinErr3_C DFC_DisblMsk.DFC_WaHtEl4WinErr4_C DFC_DisblMsk.DFC_WaHtElSCG_C DFC_DisblMsk.DFC_ETClbETFltMax_0_C DFC_DisblMsk.DFC_ETClbETFltMax_1_C DFC_DisblMsk.DFC_ETClbETFltMax_2_C DFC_DisblMsk.DFC_ETClbETFltMax_3_C DFC_DisblMsk.DFC_ETClbETFltMax_4_C DFC_DisblMsk.DFC_ETClbETFltMax_5_C DFC_DisblMsk.DFC_ETClbETFltMin_0_C DFC_DisblMsk.DFC_ETClbETFltMin_1_C DFC_DisblMsk.DFC_ETClbETFltMin_2_C DFC_DisblMsk.DFC_ETClbETFltMin_3_C DFC_DisblMsk.DFC_ETClbETFltMin_4_C DFC_DisblMsk.DFC_ETClbETFltMin_5_C DFC_DisblMsk.DFC_InjCrvInjLimChrgBal_C DFC_DisblMsk.DFC_InjCrvInjLimQntBal_C DFC_DisblMsk.DFC_InjCrvInjLimSys_C DFC_DisblMsk.DFC_InjCrvNumInjRtmLim_C DFC_DisblMsk.DFC_LSUHtCoupSig_C DFC_DisblMsk.DFC_AFS_SSpShOffOL_C DFC_DisblMsk.DFC_AFS_SSpShOffOvrTemp_C DFC_DisblMsk.DFC_AFS_SSpShOffSCB_C DFC_DisblMsk.DFC_AFS_SSpShOffSCG_C DFC_DisblMsk.DFC_AirCCmprOL_C DFC_DisblMsk.DFC_AirCCmprOvrTemp_C DFC_DisblMsk.DFC_AirCCmprSCB_C DFC_DisblMsk.DFC_AirCCmprSCG_C DFC_DisblMsk.DFC_CByVlvOL_C DFC_DisblMsk.DFC_CByVlvOvrTemp_C DFC_DisblMsk.DFC_CByVlvSCB_C DFC_DisblMsk.DFC_CByVlvSCG_C DFC_DisblMsk.DFC_CThmstOL_C DFC_DisblMsk.DFC_CThmstOvrTemp_C DFC_DisblMsk.DFC_CThmstSCB_C DFC_DisblMsk.DFC_CThmstSCG_C DFC_DisblMsk.DFC_DSMDummy_C DFC_DisblMsk.DFC_EBxFanOL_C DFC_DisblMsk.DFC_EBxFanOvrTemp_C DFC_DisblMsk.DFC_EBxFanSCB_C DFC_DisblMsk.DFC_EBxFanSCG_C DFC_DisblMsk.DFC_ECBVlvOL_C DFC_DisblMsk.DFC_ECBVlvOvrTemp_C DFC_DisblMsk.DFC_ECBVlvSCB_C DFC_DisblMsk.DFC_ECBVlvSCG_C DFC_DisblMsk.DFC_EMDmpOL_0_C DFC_DisblMsk.DFC_EMDmpOL_1_C DFC_DisblMsk.DFC_EMDmpOvrTemp_0_C DFC_DisblMsk.DFC_EMDmpOvrTemp_1_C DFC_DisblMsk.DFC_EMDmpSCB_0_C DFC_DisblMsk.DFC_EMDmpSCB_1_C DFC_DisblMsk.DFC_EMDmpSCG_0_C DFC_DisblMsk.DFC_EMDmpSCG_1_C DFC_DisblMsk.DFC_EngStAOL_C DFC_DisblMsk.DFC_EngStAOvrTemp_C DFC_DisblMsk.DFC_EngStASCB_C DFC_DisblMsk.DFC_EngStASCG_C DFC_DisblMsk.DFC_FanOL_C DFC_DisblMsk.DFC_FanOvrTemp_C DFC_DisblMsk.DFC_FanSCB_C DFC_DisblMsk.DFC_FlFltHtOL_C DFC_DisblMsk.DFC_FlFltHtOvrTemp_C DFC_DisblMsk.DFC_FlFltHtSCB_C DFC_DisblMsk.DFC_FlFltHtSCG_C DFC_DisblMsk.DFC_LSUHtrMax_C DFC_DisblMsk.DFC_LSUHtrMin_C DFC_DisblMsk.DFC_LSUHtrNpl_C DFC_DisblMsk.DFC_LSUHtrSig_C DFC_DisblMsk.DFC_LSUtExcMax_C DFC_DisblMsk.DFC_LSUtExcMin_C DFC_DisblMsk.DFC_MeUnOL_C DFC_DisblMsk.DFC_MeUnSCB_C DFC_DisblMsk.DFC_MeUnSRCMax_C DFC_DisblMsk.DFC_MeUnSRCMin_C DFC_DisblMsk.DFC_PCVOL_C DFC_DisblMsk.DFC_PCVSCB_C DFC_DisblMsk.DFC_PCVSRCMax_C DFC_DisblMsk.DFC_PCVSRCMin_C DFC_DisblMsk.DFC_RailPSRCMax_C DFC_DisblMsk.DFC_RailPSRCMin_C DFC_DisblMsk.DFC_ShtrOL_C DFC_DisblMsk.DFC_ShtrOvrTemp_C DFC_DisblMsk.DFC_ShtrSCB_C DFC_DisblMsk.DFC_ShtrSCG_C DFC_DisblMsk.DFC_StrtOL_C DFC_DisblMsk.DFC_StrtOvrTemp_C DFC_DisblMsk.DFC_StrtSCB_C DFC_DisblMsk.DFC_StrtSCG_C DFC_DisblMsk.DFC_ThrVlvOL_C DFC_DisblMsk.DFC_ThrVlvOvrTemp_C DFC_DisblMsk.DFC_ThrVlvSCB_C DFC_DisblMsk.DFC_TrbChOL_C DFC_DisblMsk.DFC_TrbChOvrTemp_C DFC_DisblMsk.DFC_TrbChSCB_C DFC_DisblMsk.DFC_UDosVlvOL_C DFC_DisblMsk.DFC_UDosVlvOvrTemp_C DFC_DisblMsk.DFC_UDosVlvSCB_C DFC_DisblMsk.DFC_UDosVlvSCG_C DFC_DisblMsk.DFC_UPmpMotOL_C DFC_DisblMsk.DFC_UPmpMotOvrTemp_C DFC_DisblMsk.DFC_UPmpMotSCB_C DFC_DisblMsk.DFC_UPmpMotSCG_C DFC_DisblMsk.DFC_WaHtElOL_C DFC_DisblMsk.DFC_WaHtElOvrTemp_C DFC_DisblMsk.DFC_WaHtElSCB_C DFC_DisblMsk.DFC_IVActrUChSRCMax_C DFC_DisblMsk.DFC_IVActrUChSRCMin_C DFC_DisblMsk.DFC_IVActrVltgSRCMax_C DFC_DisblMsk.DFC_IVActrVltgSRCMin_C DFC_DisblMsk.DFC_IVDiaTunDet_C DFC_DisblMsk.DFC_IVPSplyStopDCDC_C DFC_DisblMsk.DFC_IVPSplyVltgSRCMax_C DFC_DisblMsk.DFC_IVPSplyVltgSRCMin_C DFC_DisblMsk.DFC_SCREtaErr_C DFC_DisblMsk.DFC_SCREtaErr1_C DFC_DisblMsk.DFC_SCREtaErr2_C DFC_DisblMsk.DFC_SCRMonMetCtlPresErr_C DFC_DisblMsk.DFC_SCRMonPresBuildUpErr_C DFC_DisblMsk.DFC_SCRMonPresRdcErr_C DFC_DisblMsk.DFC_AFSOffsDrftMax_C DFC_DisblMsk.DFC_AFSOffsDrftMin_C DFC_DisblMsk.DFC_AFSSRCCorMax_C DFC_DisblMsk.DFC_AFSSRCCorMin_C DFC_DisblMsk.DFC_AFSSRCRawMax_C DFC_DisblMsk.DFC_AFSSRCRawMin_C DFC_DisblMsk.DFC_AFSSetyDrftMax_C DFC_DisblMsk.DFC_AFSSetyDrftMin_C DFC_DisblMsk.DFC_AirCSwtNpl_C DFC_DisblMsk.DFC_AirCSwtSig_C DFC_DisblMsk.DFC_BattUSRCMax_C DFC_DisblMsk.DFC_BattUSRCMin_C DFC_DisblMsk.DFC_BrkNpl_C DFC_DisblMsk.DFC_BrkPSRCMax_C DFC_DisblMsk.DFC_BrkPSRCMin_C DFC_DisblMsk.DFC_CEngDsTSRCMax_C DFC_DisblMsk.DFC_CEngDsTSRCMin_C DFC_DisblMsk.DFC_CrCUIDet_C DFC_DisblMsk.DFC_ECBVlvSRCMax_C DFC_DisblMsk.DFC_ECBVlvSRCMin_C DFC_DisblMsk.DFC_ECUOvrTemp_C DFC_DisblMsk.DFC_EGRVlvGovDvtMax_C DFC_DisblMsk.DFC_EGRVlvGovDvtMin_C DFC_DisblMsk.DFC_EGRVlvHBrgOpnLd_C DFC_DisblMsk.DFC_EGRVlvHBrgOvrCurr_C DFC_DisblMsk.DFC_EGRVlvHBrgOvrTemp_C DFC_DisblMsk.DFC_EGRVlvHBrgShCirBatt1_C DFC_DisblMsk.DFC_EGRVlvHBrgShCirBatt2_C DFC_DisblMsk.DFC_EGRVlvHBrgShCirGnd1_C DFC_DisblMsk.DFC_EGRVlvHBrgShCirGnd2_C DFC_DisblMsk.DFC_EGRVlvHBrgShCirOvrLd_C DFC_DisblMsk.DFC_EGRVlvHBrgTempOvrCurr_C DFC_DisblMsk.DFC_EGRVlvHBrgUndrVltg_C DFC_DisblMsk.DFC_EGRVlvLPGovDvtMax_C DFC_DisblMsk.DFC_EGRVlvLPGovDvtMin_C DFC_DisblMsk.DFC_EGRVlvLPHBrgOpnLd_C DFC_DisblMsk.DFC_EGRVlvLPHBrgOvrCurr_C DFC_DisblMsk.DFC_EGRVlvLPHBrgOvrTemp_C DFC_DisblMsk.DFC_EGRVlvLPHBrgShCirBatt1_C DFC_DisblMsk.DFC_EGRVlvLPHBrgShCirBatt2_C DFC_DisblMsk.DFC_EGRVlvLPHBrgShCirGnd1_C DFC_DisblMsk.DFC_EGRVlvLPHBrgShCirGnd2_C DFC_DisblMsk.DFC_EGRVlvLPHBrgShCirOvrLd_C DFC_DisblMsk.DFC_EGRVlvLPHBrgTempOvrCurr_C DFC_DisblMsk.DFC_EGRVlvLPHBrgUndrVltg_C DFC_DisblMsk.DFC_EGRVlvLPOL_C DFC_DisblMsk.DFC_EGRVlvLPSCB_C DFC_DisblMsk.DFC_EGRVlvLPSCG_C DFC_DisblMsk.DFC_EGRVlvLPSRCMax_C DFC_DisblMsk.DFC_EGRVlvLPSRCMin_C DFC_DisblMsk.DFC_EGRVlvOL_C DFC_DisblMsk.DFC_EGRVlvSCB_C DFC_DisblMsk.DFC_EGRVlvSCG_C DFC_DisblMsk.DFC_EGRVlvSRCMax_C DFC_DisblMsk.DFC_EGRVlvSRCMin_C DFC_DisblMsk.DFC_EngPrtOvrSpd_C DFC_DisblMsk.DFC_EngSpdOL_C DFC_DisblMsk.DFC_EngSpdSCB_C DFC_DisblMsk.DFC_EngSpdSCG_C DFC_DisblMsk.DFC_EnhSRCMaxPPFltDiff_C DFC_DisblMsk.DFC_EnhSRCMaxT1ExhTMon_C DFC_DisblMsk.DFC_EnhSRCMaxT2ExhTMon_C DFC_DisblMsk.DFC_EnhSRCMaxT3ExhTMon_C DFC_DisblMsk.DFC_EnhSRCMinPPFltDiff_C DFC_DisblMsk.DFC_EnhSRCMinT1ExhTMon_C DFC_DisblMsk.DFC_EnhSRCMinT2ExhTMon_C DFC_DisblMsk.DFC_EnhSRCMinT3ExhTMon_C DFC_DisblMsk.DFC_EnvPSRCMax_C DFC_DisblMsk.DFC_EnvPSRCMin_C DFC_DisblMsk.DFC_ExhTMonPlaus_C DFC_DisblMsk.DFC_ExhTMonPlausPos1_C DFC_DisblMsk.DFC_ExhTMonPlausPos2_C DFC_DisblMsk.DFC_ExhTMonPlausPos3_C DFC_DisblMsk.DFC_ExhTMonT1Plaus_C DFC_DisblMsk.DFC_ExhTMonT2Plaus_C DFC_DisblMsk.DFC_ExhTMonT3Plaus_C DFC_DisblMsk.DFC_FlFltDsPSRCMax_C /end DEF_CHARACTERISTIC
/end FUNCTION
/begin COMPU_METHOD DFES_OneToOne "" RAT_FUNC "%6.0" "-" COEFFS 0 1 0 0 0 1 /end COMPU_METHOD
/begin RECORD_LAYOUT Val_Wu16 FNC_VALUES 1 UWORD COLUMN_DIR DIRECT /end RECORD_LAYOUT
/end MODULE
/end PROJECT

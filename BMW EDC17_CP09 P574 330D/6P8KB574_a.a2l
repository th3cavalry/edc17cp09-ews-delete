ASAP2_VERSION 1 4
/begin PROJECT P_574 "EDC17_CP09"
/begin HEADER "" VERSION "V8KB" PROJECT_NO P_574 /end HEADER
/begin MODULE DIM ""
/begin MOD_COMMON "" BYTE_ORDER MSB_LAST ALIGNMENT_BYTE 1 ALIGNMENT_WORD 2 ALIGNMENT_LONG 4 ALIGNMENT_FLOAT32_IEEE 4 /end MOD_COMMON
/begin CHARACTERISTIC IVPlaus_cntSegDwnRunUpTst_C "Segmentanzahl für die Abfallphase des Hochlauftests" VALUE 0x8003D434 Val_Wu16 65535.00 OneToOne 0.00 65535.00 /end CHARACTERISTIC
/begin CHARACTERISTIC IVPlaus_cntSegUpRunUpTst_C "Segmentanzahl für die Hochlaufphase des Hochlauftests" VALUE 0x8003D436 Val_Wu16 65535.00 OneToOne 0.00 65535.00 /end CHARACTERISTIC
/begin CHARACTERISTIC IVPlaus_cntSegWaitRunUpTst_C "Anzahl von Segmenten die nach Erreichen der Segmentanzahl für den Hochlauf gewartet wird" VALUE 0x8003D438 Val_Wu16 65535.00 OneToOne 0.00 65535.00 /end CHARACTERISTIC
/begin CHARACTERISTIC IVPlaus_nMaxRunUpTst_C "Maximal zulässige Drehzahl für die Freigabe des Hochlauftests" VALUE 0x8003D43A Val_Ws16 9980.000 EngN 20.00000 10000.00 EXTENDED_LIMITS -16384.00 16383.50 /end CHARACTERISTIC
/begin CHARACTERISTIC IVPlaus_nMinRunUpTst_C "minimale Drehzahl für die Freigabe des Hochlauftests" VALUE 0x8003D43C Val_Ws16 9980.000 EngN 20.00000 10000.00 EXTENDED_LIMITS -16384.00 16383.50 /end CHARACTERISTIC
/begin CHARACTERISTIC IVPlaus_nStrtRunUpTst_C "Startdrehzahl für den Beginn der Hochlaufphase des Hochlauftests" VALUE 0x8003D43E Val_Ws16 9980.000 EngN 20.00000 10000.00 EXTENDED_LIMITS -16384.00 16383.50 /end CHARACTERISTIC
/begin CHARACTERISTIC IVPlaus_phiMI1DesRunUpTst_C "gewünschte SOE winkelbasiert der 1ten Haupteinspritzung während des Hochlauftests aus Datensatz" VALUE 0x8003D440 Val_Ws16 49.98779 AngleCrS -9.997559 39.99023 EXTENDED_LIMITS -720.0000 719.9780 /end CHARACTERISTIC
/begin CHARACTERISTIC IVPlaus_phiPiI1DesRunUpTst_C "gewünschte SOE winkelbasiert für Voreinspritzung 1 während des Hochlauftests" VALUE 0x8003D442 Val_Ws16 99.99756 AngleCrS 0.00 99.99756 EXTENDED_LIMITS -720.0000 719.9780 /end CHARACTERISTIC
/begin CHARACTERISTIC IVPlaus_phiPiI2DesRunUpTst_C "gewünschte SOE winkelbasiert der 2ten Voreinspritzung während des Hochlauftests aus Datensatz" VALUE 0x8003D444 Val_Ws16 99.99756 AngleCrS 0.00 99.99756 EXTENDED_LIMITS -720.0000 719.9780 /end CHARACTERISTIC
/begin CHARACTERISTIC IVPlaus_pSetPntRunUpTst_C "vorgegebener Raildruck während des Hochlauftests" VALUE 0x8003D446 Val_Ws16 2000.000 Pres_Rail 0.00 2000.000 EXTENDED_LIMITS -3276.800 3276.700 /end CHARACTERISTIC
/begin CHARACTERISTIC IVPlaus_qPiI1DesRunUpTst_C "gewünschte Einspritzmenge der Voreinspritzung 1 während des Hochlauftests" VALUE 0x8003D448 Val_Ws16 10.00000 InjMassInj 0.00 10.00000 EXTENDED_LIMITS -327.6800 327.6700 /end CHARACTERISTIC
/begin CHARACTERISTIC IVPlaus_qPiI2DesRunUpTst_C "gewünschte Einspritzmenge der 2ten Voreinspritzung während des Hochlauftests aus Datensatz" VALUE 0x8003D44A Val_Ws16 10.00000 InjMassInj 0.00 10.00000 EXTENDED_LIMITS -327.6800 327.6700 /end CHARACTERISTIC
/begin CHARACTERISTIC IVPlaus_qSetUnBalRunUpTst_C "EInspritzmenge ohne Mengenausgleich während des Hochlauftests aus dem Datensatz" VALUE 0x8003D44C Val_Ws16 327.6700 InjMassCyc 0.00 327.6700 EXTENDED_LIMITS -327.6800 327.6700 /end CHARACTERISTIC
/begin CHARACTERISTIC IVPlaus_rEGRVlvRunUpTst_C "PWM-Verhältnis des Abgasrückführstellers während des Hochlauftests" VALUE 0x8003D44E Val_Ws16 100.0000 DtyCyc 0.00 100.0000 EXTENDED_LIMITS -327.6800 327.6700 /end CHARACTERISTIC
/begin CHARACTERISTIC IVPlaus_rThrVlvRunUpTst_C "Ausgabeverhältnis an die Drosselklappe während des Hochlauftests aus Datensatz" VALUE 0x8003D450 Val_Ws16 100.0000 DtyCyc 0.00 100.0000 EXTENDED_LIMITS -327.6800 327.6700 /end CHARACTERISTIC
/begin CHARACTERISTIC IVPlaus_rTrbChRunUpTst_C "PWM-Verhältnis des Turbo während des Hochlauftests" VALUE 0x8003D452 Val_Ws16 100.0000 DtyCyc 0.00 100.0000 EXTENDED_LIMITS -327.6800 327.6700 /end CHARACTERISTIC
/begin CHARACTERISTIC IVPlaus_stInjCharRunUpTst_C "Einspritzverlauf während des Hochlauftests" VALUE 0x8003D454 Val_Wu8 255.0 OneToOne 0.00 255.0 /end CHARACTERISTIC
/begin CHARACTERISTIC IVPlaus_stMskCoEOMOpModeRunUpTst_C "Betriebsart während des Hochlauftests" VALUE 0x8003D456 Val_Wu16 65535.00 OneToOne 0.00 65535.00 /end CHARACTERISTIC
/begin CHARACTERISTIC IVPlaus_swtNoChkRefRunUpTst_C "Schalter für die Abschaltung diverser, überwachter Betriebsbedingungen" VALUE 0x8003D458 Val_Wu8 3.000 OneToOne 0.00 3.000 EXTENDED_LIMITS 0.00 255.0 /end CHARACTERISTIC
/begin CHARACTERISTIC IVPlaus_tiMaxRunUpTst_C "maximale Laufzeit für den Hochlauftest" VALUE 0x8003D45C Val_Ws32 65530.0000000 Time_ms 10.0000000000 65540.0000000 EXTENDED_LIMITS -21474836480.0 21474836470.0 /end CHARACTERISTIC
/begin CHARACTERISTIC IVPlaus_tiPiI1DesRunUpTst_C "gewünschte Ansteuerzeit der Voreinspritzung 1 während des Hochlauftests aus dem Datensatz" VALUE 0x8003D460 Val_Ws16 5000.00 InjTime_us 0.00 5000.00 EXTENDED_LIMITS -13107.20 13106.80 /end CHARACTERISTIC
/begin CHARACTERISTIC IVPlaus_tiPiI2DesRunUpTst_C "gewünschte Ansteuerzeit der Voreinspritzung 2 während des Hochlauftests aus dem Datensatz" VALUE 0x8003D462 Val_Ws16 5000.00 InjTime_us 0.00 5000.00 EXTENDED_LIMITS -13107.20 13106.80 /end CHARACTERISTIC
/begin CHARACTERISTIC IVPlaus_tiWaitRunUpTst_C "Zeit für die Stabilierung des Raildrucks während des Hochlauftests" VALUE 0x8003D464 Val_Ws16 65530.00 Time_ms 10.00000 65540.00 EXTENDED_LIMITS -327680.0 327670.0 /end CHARACTERISTIC
/begin CHARACTERISTIC IVPSIC_ctIntegAdjMax_C "Maximale Anzahl des Integratorabgleichs" VALUE 0x8003D3E8 Val_Wu8 254.0 OneToOne 1.000 255.0 EXTENDED_LIMITS 0.00 255.0 /end CHARACTERISTIC
/begin CHARACTERISTIC IVPSIC_uIntegLin_CUR "Linearisierungs-Kennline für Ausgangsspannung des Integrators" CURVE 0x8003D3EA Cur_Xs16Ws16 13107.00 Volt -6553.600 6553.400
 /begin AXIS_DESCR STD_AXIS IVPSIC_uRawIntegLin_mp Volt 2 0.00 5200.000 EXTENDED_LIMITS -6553.600 6553.400 DEPOSIT ABSOLUTE /end AXIS_DESCR
/end CHARACTERISTIC
/begin CHARACTERISTIC IVPSIC_Vltg_SRC.uMin_C "Klasseninstanz für Signal Range Check des Integratorabgleiches des Enstufenbausteins/" VALUE 0x8003D3F4 Kw_Ws16 13107.00 Volt -6553.600 6553.400 /end CHARACTERISTIC
/begin CHARACTERISTIC IVPSIC_Vltg_SRC.uMax_C "Klasseninstanz für Signal Range Check des Integratorabgleiches des Enstufenbausteins/" VALUE 0x8003D3F6 Kw_Ws16 13107.00 Volt -6553.600 6553.400 /end CHARACTERISTIC
/begin CHARACTERISTIC IVPSply_numIntrBufMeas_C "Max. Anzahl Interrups des gemessenen Einspritztyps zwischen Start und Auswertung der Bufferspannungsmessung" VALUE 0x8003D3F8 Val_Wu8 255.0 OneToOne 0.00 255.0 /end CHARACTERISTIC
/begin CHARACTERISTIC IVPSply_stBufErrRC_C "Remotewert für IVPSply_stBufErr" VALUE 0x8003D414 Val_Wu8 255.0 OneToOne 0.00 255.0 /end CHARACTERISTIC
/begin CHARACTERISTIC IVPSply_stDCDCCoRC_C "Remotewert für IVPSply_stDCDCCo" VALUE 0x8003D415 Val_Wu8 255.0 OneToOne 0.00 255.0 /end CHARACTERISTIC
/begin CHARACTERISTIC IVPSply_stUBufRC_C "Remote-Wert für Status der Bufferspannung" VALUE 0x8003D3F9 Val_Wu8 255.0 OneToOne 0.00 255.0 /end CHARACTERISTIC
/begin CHARACTERISTIC IVPSply_swtDCDCErrRC_C "Remote-Schalter: SPI-Fehler beim Starten der DC/DC-Wandler stimulieren" VALUE 0x8003D416 Val_Wu8 255.0 OneToOne 0.00 255.0 /end CHARACTERISTIC
/begin CHARACTERISTIC IVPSply_swtEnaBufVltg_C "Schalter für Freigabe der Bufferspannungsmessung" VALUE 0x8003D3FA Val_Wu8 255.0 OneToOne 0.00 255.0 /end CHARACTERISTIC
/begin CHARACTERISTIC IVPSply_swtEnaDfcChSwt_C "Aktivierung der Verriegelung des Startens der DC/DC-Wandler bei einem abgespeicherten Ladeschalterkurzschluß" VALUE 0x8003D417 Val_Wu8 1.000 OneToOne 0.00 1.000 EXTENDED_LIMITS 0.00 255.0 /end CHARACTERISTIC
/begin CHARACTERISTIC IVPSply_swtStBufErrRC_C "Schalter: IVPSply_stBufErr wird durch Remotewert IVPSply_stBufErrRC_C vorgegeben" VALUE 0x8003D418 Val_Wu8 1.000 OneToOne 0.00 1.000 EXTENDED_LIMITS 0.00 255.0 /end CHARACTERISTIC
/begin CHARACTERISTIC IVPSply_swtStDCDCCoRC_C "Schalter: IVPSply_stDCDCCo wird durch Remotewert IVPSpyly_stDCDCCoRC_C vorgegeben" VALUE 0x8003D419 Val_Wu8 1.000 OneToOne 0.00 1.000 EXTENDED_LIMITS 0.00 255.0 /end CHARACTERISTIC
/begin CHARACTERISTIC IVPSply_swtUBufRC_C "Remote-Schalter für Bufferspannung" VALUE 0x8003D3FB Val_Wu8 255.0 OneToOne 0.00 255.0 /end CHARACTERISTIC
/begin CHARACTERISTIC IVPSply_tiADCBusyMax_C "Max. ADC-Wandlungszeit aller piezospezifischen Messwerte" VALUE 0x8003D3FC Val_Wu16 5000.00 InjTime_us 0.00 5000.00 EXTENDED_LIMITS 0.00 26214.00 /end CHARACTERISTIC
/begin CHARACTERISTIC IVPSply_tiBufMeasChk_C "Max. Zeitdifferenz für Freigabeprüfung der Bufferspannungsmessung" VALUE 0x8003D400 Val_Wu32 234505214.307 Time_PzoMeas 0.00 234505214.307 FORMAT "%13.3" /end CHARACTERISTIC
/begin CHARACTERISTIC IVPSply_tiDCDCWait_C "Wartezeit für geladenen Bufferkondensator" VALUE 0x8003D41A Val_Ws16 1000.000 Time_ms 0.00 1000.000 EXTENDED_LIMITS -327680.0 327670.0 /end CHARACTERISTIC
/begin CHARACTERISTIC IVPSply_uBufLin_CUR "Linearisierungskurve für Bufferspannungsmessung" CURVE 0x8003D404 Cur_Xs16Ws16 655.3500 Vltg_PA -327.6800 327.6700
 /begin AXIS_DESCR STD_AXIS IVPSply_uBufRaw_mp Volt 2 0.00 5200.000 EXTENDED_LIMITS -6553.600 6553.400 DEPOSIT ABSOLUTE /end AXIS_DESCR
/end CHARACTERISTIC
/begin CHARACTERISTIC IVPSply_uBufRC_C "Remote-Wert für Bufferspannung" VALUE 0x8003D40E Val_Ws16 655.3500 Vltg_PA -327.6800 327.6700 /end CHARACTERISTIC
/begin CHARACTERISTIC IVPSply_Vltg_SRC.uMin_C "Klasseninstanz für Signal Range Check der Bufferspannungsmessung/" VALUE 0x8003D410 Kw_Ws16 5200.000 Volt 0.00 5200.000 EXTENDED_LIMITS -6553.600 6553.400 /end CHARACTERISTIC
/begin CHARACTERISTIC IVPSply_Vltg_SRC.uMax_C "Klasseninstanz für Signal Range Check der Bufferspannungsmessung/" VALUE 0x8003D412 Kw_Ws16 5200.000 Volt 0.00 5200.000 EXTENDED_LIMITS -6553.600 6553.400 /end CHARACTERISTIC
/begin CHARACTERISTIC KL_GENLDST "Auslastungsgrad Generator" CURVE 0x80064DE2 CurTKL_SW_VV_UB 99.61 Def_f_ub_b100 0.00 99.61
 /begin AXIS_DESCR STD_AXIS Tgen Def_t_sw_q0p1 6 -3276.8 3276.7 FORMAT "%6.1" DEPOSIT ABSOLUTE /end AXIS_DESCR
/end CHARACTERISTIC
/begin CHARACTERISTIC K_APPUPLLDST "Applikationswert St_ldstgen für Nachlauf" VALUE 0x80064DF6 Val_Wu8 255. Def_st_ub_q1 0.00 255. FORMAT "%3.0" /end CHARACTERISTIC
/begin CHARACTERISTIC K_DFMODE "DF-Mode-Schalter themermisch/elektrisch" VALUE 0x80064DF7 Val_Wu8 255. Def_st_ub_q1 0.00 255. FORMAT "%3.0" /end CHARACTERISTIC
/begin CHARACTERISTIC K_DFS_MAX "DF-Auslastung Maximalschwelle" VALUE 0x80064DF8 Val_Wu8 99.61 Def_f_ub_b100 0.00 99.61 /end CHARACTERISTIC
/begin CHARACTERISTIC K_DFS_MIN "DF-Auslastung Minimalschwelle" VALUE 0x80064DF9 Val_Wu8 99.61 Def_f_ub_b100 0.00 99.61 /end CHARACTERISTIC
/begin CHARACTERISTIC K_DFS_MITT "DF-Auslastung Mittelschwelle" VALUE 0x80064DFA Val_Wu8 99.61 Def_f_ub_b100 0.00 99.61 /end CHARACTERISTIC
/begin CHARACTERISTIC K_GENLDDFMAX "Schwell Anzeige maximaler Auslastungsgrad Generator" VALUE 0x80064DFB Val_Wu8 99.61 Def_f_ub_b100 0.00 99.61 /end CHARACTERISTIC
/begin CHARACTERISTIC K_IERRFIL "Filterkonstante für Filterung Erregerstrom" VALUE 0x80064DFC Val_Wu8 0.99219 Def_f_ub_b1 0.0039063 0.99609 FORMAT "%7.5" EXTENDED_LIMITS 0.00 0.99609 /end CHARACTERISTIC
/begin CHARACTERISTIC K_TNNSTART "Zeittriggerschwelle nach Motorstart" VALUE 0x80064DFE Val_Wu16 655.350 Def_td_uw_q0p01 0.00 655.350 FORMAT "%7.3" /end CHARACTERISTIC
/begin CHARACTERISTIC K_UB_GRENZST "Grenzwert Gradient d. Bordnetzspannung im Start" VALUE 0x80064E00 Val_Wu16 6173.4 Def_u_uw_q0p0942 0.00 6173.4 FORMAT "%6.1" /end CHARACTERISTIC
/begin CHARACTERISTIC LayerDiag_FltMng_TstCycleEn_C "" VALUE 0x8004DAD0 Val_Wu8 255.0 OneToOne 0.00 255.0 /end CHARACTERISTIC
/begin CHARACTERISTIC LayerDiag_FltMng_TstErrMask_C "" VALUE 0x8004DAD1 Val_Wu8 255.0 OneToOne 0.00 255.0 /end CHARACTERISTIC
/begin CHARACTERISTIC LayerDiag_FltMng_TstFIdx_C "" VALUE 0x8004DAD2 Val_Wu16 65535.00 OneToOne 0.00 65535.00 /end CHARACTERISTIC
/begin CHARACTERISTIC LayerDiag_FltMng_TstFId_C "" VALUE 0x8004DAD4 Val_Wu16 65535.00 OneToOne 0.00 65535.00 /end CHARACTERISTIC
/begin CHARACTERISTIC LayerDiag_tiChgBatt_C "" VALUE 0x8004DAC4 Val_Ws16 10000.00 Time_ms 0.00 10000.00 EXTENDED_LIMITS -327680.0 327670.0 /end CHARACTERISTIC
/begin CHARACTERISTIC LayerDiag_tiChkProgPwr_C "" VALUE 0x8004DACE Val_Ws16 10000.00 Time_ms 0.00 10000.00 EXTENDED_LIMITS -327680.0 327670.0 /end CHARACTERISTIC
/begin CHARACTERISTIC LayerDiag_tiHisRst_C "" VALUE 0x8004DAC6 Val_Ws16 10000.00 Time_ms 0.00 10000.00 EXTENDED_LIMITS -327680.0 327670.0 /end CHARACTERISTIC
/begin CHARACTERISTIC LayerDiag_tiNGLern_C "" VALUE 0x8004DAC8 Val_Ws16 10000.00 Time_ms 0.00 10000.00 EXTENDED_LIMITS -327680.0 327670.0 /end CHARACTERISTIC
/begin CHARACTERISTIC LayerDiag_tiWrPMRec_C "" VALUE 0x8004DACA Val_Ws16 10000.00 Time_ms 0.00 10000.00 EXTENDED_LIMITS -327680.0 327670.0 /end CHARACTERISTIC
/begin CHARACTERISTIC Layer_tiCBS4TimeOut_C "" VALUE 0x8004DACC Val_Ws16 10000.00 Time_ms 0.00 10000.00 EXTENDED_LIMITS -327680.0 327670.0 /end CHARACTERISTIC
/begin CHARACTERISTIC Layer_tiEngStA_C "" VALUE 0x80064DDC Val_Ws16 655350.0 Time_ms -327680.0 327670.0 /end CHARACTERISTIC
/begin CHARACTERISTIC Layer_trqAltMax_C "" VALUE 0x80064DDE Val_Ws16 6553.500 Trq -3276.800 3276.700 /end CHARACTERISTIC
/begin CHARACTERISTIC Layer_trqAltMin_C "" VALUE 0x80064DE0 Val_Ws16 6553.500 Trq -3276.800 3276.700 /end CHARACTERISTIC
/begin CHARACTERISTIC LLim_facSpdCorr_CA "GReihe Höchstgeschwindigkeit limitaion Korrekturwerte" VAL_BLK 0x8004D5C8 ValA_Ws16 63.99902 FactLow -32.00000 31.99902 FORMAT "%8.5" NUMBER 15 /end CHARACTERISTIC
/begin CHARACTERISTIC LLim_SpdLim4I.Ki_C "/" VALUE 0x8004D5E8 Kw_Ws32 319999999.925 Ki_Vel2TrqPrpHigh20 -160000000.000 159999999.925 FORMAT "%13.3" /end CHARACTERISTIC
/begin CHARACTERISTIC LLim_SpdLim4I.KiPos_C "/" VALUE 0x8004D5EC Kw_Ws32 319999999.925 Ki_Vel2TrqPrpHigh20 -160000000.000 159999999.925 FORMAT "%13.3" /end CHARACTERISTIC
/begin CHARACTERISTIC LLim_SpdLim4I.KiNeg_C "/" VALUE 0x8004D5F0 Kw_Ws32 319999999.925 Ki_Vel2TrqPrpHigh20 -160000000.000 159999999.925 FORMAT "%13.3" /end CHARACTERISTIC
/begin CHARACTERISTIC LLim_SpdLim4I.WinPos_C "/" VALUE 0x8004D5F4 Kw_Ws32 300.000000000 Vel 0.00 300.000000000 EXTENDED_LIMITS -21474836.4800 21474836.4700 /end CHARACTERISTIC
/begin CHARACTERISTIC LLim_SpdLim4I.WinNeg_C "/" VALUE 0x8004D5F8 Kw_Ws32 300.000000000 Vel -300.000000000 0.00 EXTENDED_LIMITS -21474836.4800 21474836.4700 /end CHARACTERISTIC
/begin CHARACTERISTIC LLim_SpdLim4P.Kp_C "/" VALUE 0x8004D5FC Kw_Ws32 10485759.9976 Kp_Vel2TrqPrpHigh -5242880.00000 5242879.99756 FORMAT "%13.5" /end CHARACTERISTIC
/begin CHARACTERISTIC LLim_SpdLim4P.KpPos_C "/" VALUE 0x8004D600 Kw_Ws32 10485759.9976 Kp_Vel2TrqPrpHigh -5242880.00000 5242879.99756 FORMAT "%13.5" /end CHARACTERISTIC
/begin CHARACTERISTIC LLim_SpdLim4P.KpNeg_C "/" VALUE 0x8004D604 Kw_Ws32 10485759.9976 Kp_Vel2TrqPrpHigh -5242880.00000 5242879.99756 FORMAT "%13.5" /end CHARACTERISTIC
/begin CHARACTERISTIC LLim_SpdLim4P.WinPos_C "/" VALUE 0x8004D608 Kw_Ws32 300.000000000 Vel 0.00 300.000000000 EXTENDED_LIMITS -21474836.4800 21474836.4700 /end CHARACTERISTIC
/begin CHARACTERISTIC LLim_SpdLim4P.WinNeg_C "/" VALUE 0x8004D60C Kw_Ws32 300.000000000 Vel -300.000000000 0.00 EXTENDED_LIMITS -21474836.4800 21474836.4700 /end CHARACTERISTIC
/begin CHARACTERISTIC LLim_SpdLim5I.Ki_C "/" VALUE 0x8004D610 Kw_Ws32 319999999.925 Ki_Vel2TrqPrpHigh20 -160000000.000 159999999.925 FORMAT "%13.3" /end CHARACTERISTIC
/begin CHARACTERISTIC LLim_SpdLim5I.KiPos_C "/" VALUE 0x8004D614 Kw_Ws32 319999999.925 Ki_Vel2TrqPrpHigh20 -160000000.000 159999999.925 FORMAT "%13.3" /end CHARACTERISTIC
/begin CHARACTERISTIC LLim_SpdLim5I.KiNeg_C "/" VALUE 0x8004D618 Kw_Ws32 319999999.925 Ki_Vel2TrqPrpHigh20 -160000000.000 159999999.925 FORMAT "%13.3" /end CHARACTERISTIC
/begin CHARACTERISTIC LLim_SpdLim5I.WinPos_C "/" VALUE 0x8004D61C Kw_Ws32 300.000000000 Vel 0.00 300.000000000 EXTENDED_LIMITS -21474836.4800 21474836.4700 /end CHARACTERISTIC
/begin CHARACTERISTIC LLim_SpdLim5I.WinNeg_C "/" VALUE 0x8004D620 Kw_Ws32 300.000000000 Vel -300.000000000 0.00 EXTENDED_LIMITS -21474836.4800 21474836.4700 /end CHARACTERISTIC
/begin CHARACTERISTIC LLim_SpdLim5P.Kp_C "/" VALUE 0x8004D624 Kw_Ws32 10485759.9976 Kp_Vel2TrqPrpHigh -5242880.00000 5242879.99756 FORMAT "%13.5" /end CHARACTERISTIC
/begin CHARACTERISTIC LLim_SpdLim5P.KpPos_C "/" VALUE 0x8004D628 Kw_Ws32 10485759.9976 Kp_Vel2TrqPrpHigh -5242880.00000 5242879.99756 FORMAT "%13.5" /end CHARACTERISTIC
/begin CHARACTERISTIC LLim_SpdLim5P.KpNeg_C "/" VALUE 0x8004D62C Kw_Ws32 10485759.9976 Kp_Vel2TrqPrpHigh -5242880.00000 5242879.99756 FORMAT "%13.5" /end CHARACTERISTIC
/begin CHARACTERISTIC LLim_SpdLim5P.WinPos_C "/" VALUE 0x8004D630 Kw_Ws32 300.000000000 Vel 0.00 300.000000000 EXTENDED_LIMITS -21474836.4800 21474836.4700 /end CHARACTERISTIC
/begin CHARACTERISTIC LLim_SpdLim5P.WinNeg_C "/" VALUE 0x8004D634 Kw_Ws32 300.000000000 Vel -300.000000000 0.00 EXTENDED_LIMITS -21474836.4800 21474836.4700 /end CHARACTERISTIC
/begin CHARACTERISTIC LLim_swtSpdLim_C "" VALUE 0x8004D638 Kw_Wu8 1.000 OneToOne 0.00 1.000 EXTENDED_LIMITS 0.00 255.0 /end CHARACTERISTIC
/begin CHARACTERISTIC LLim_tiEngOnMax_C "Maximale Zeit des Motors AN" VALUE 0x8004D63C Kw_Ws32 2147483647.00 TimeEngOn 0.00 2147483647.00 FORMAT "%13.2" EXTENDED_LIMITS -2147483648.00 2147483647.00 /end CHARACTERISTIC
/begin CHARACTERISTIC LLim_tiSpdLimPT1_C "Zeitkonstante PT1-Glied" VALUE 0x8004D640 Val_Ws32 4294.9672940 TimeDelay_s 0.000002000000001 4294.9672960 FORMAT "%12.7" /end CHARACTERISTIC
/begin CHARACTERISTIC LLim_vSpdLimMax_CA "Höchstgeschwindigkeitbegrenzung auf das Fahrzeug basiert auf Varianten" VAL_BLK 0x8004D644 ValA_Ws16 655.3500 Vel -327.6800 327.6700 NUMBER 15 /end CHARACTERISTIC
/begin CHARACTERISTIC LLim_vSpdLimThresFree_C "Schwellwert Sollwertnachführung frei laufend" VALUE 0x8004D662 Val_Ws16 300.0000 Vel 0.00 300.0000 EXTENDED_LIMITS -327.6800 327.6700 /end CHARACTERISTIC
/begin CHARACTERISTIC LLim_vSpdLimThresOff_C "Schwellwert Sollwertnachführung ausgeschalten" VALUE 0x8004D664 Val_Ws16 300.0000 Vel 0.00 300.0000 EXTENDED_LIMITS -327.6800 327.6700 /end CHARACTERISTIC
/begin CHARACTERISTIC LLim_vSpdLimThresOn_C "Schwellwert Sollwertnachführung eingeschalten" VALUE 0x8004D666 Val_Ws16 300.0000 Vel 0.00 300.0000 EXTENDED_LIMITS -327.6800 327.6700 /end CHARACTERISTIC
/begin CHARACTERISTIC LSU_AirPerTimeI.Ki_C "Struktur für Luftmassenintegration während der Schubphase/" VALUE 0x8004D7D8 Kw_Ws32 4.99980524182 Ki 0.00 4.99980524182 FORMAT "%13.11" EXTENDED_LIMITS -1000000.00000 999999.999534 /end CHARACTERISTIC
/begin CHARACTERISTIC LSU_AirPerTimeI.KiPos_C "Struktur für Luftmassenintegration während der Schubphase/" VALUE 0x8004D7DC Kw_Ws32 4.99980524182 Ki 0.00 4.99980524182 FORMAT "%13.11" EXTENDED_LIMITS -1000000.00000 999999.999534 /end CHARACTERISTIC
/begin CHARACTERISTIC LSU_AirPerTimeI.KiNeg_C "Struktur für Luftmassenintegration während der Schubphase/" VALUE 0x8004D7E0 Kw_Ws32 4.99980524182 Ki 0.00 4.99980524182 FORMAT "%13.11" EXTENDED_LIMITS -1000000.00000 999999.999534 /end CHARACTERISTIC
/begin CHARACTERISTIC LSU_AirPerTimeI.WinPos_C "Struktur für Luftmassenintegration während der Schubphase/" VALUE 0x8004D7E4 Kw_Ws32 250.000000000 AirMassPerTime 223.000000000 473.000000000 EXTENDED_LIMITS -214748364.800 214748364.700 /end CHARACTERISTIC
/begin CHARACTERISTIC LSU_AirPerTimeI.WinNeg_C "Struktur für Luftmassenintegration während der Schubphase/" VALUE 0x8004D7E8 Kw_Ws32 250.000000000 AirMassPerTime 223.000000000 473.000000000 EXTENDED_LIMITS -214748364.800 214748364.700 /end CHARACTERISTIC
/begin CHARACTERISTIC LSU_BattHiDeb.tiHiLo_C "Entprellstruktur für Prüfung hoher Batteriespannung/" VALUE 0x8004D668 Kw_Ws16 655350.0 TimeDeb -327680.0 327670.0 /end CHARACTERISTIC
/begin CHARACTERISTIC LSU_BattHiDeb.tiLoHi_C "Entprellstruktur für Prüfung hoher Batteriespannung/" VALUE 0x8004D66A Kw_Ws16 655350.0 TimeDeb -327680.0 327670.0 /end CHARACTERISTIC
/begin CHARACTERISTIC LSU_ctSclFacDynChk_C "Skalierungsparameter für Entprellzählerwert des O2-Dynamics-Plausibilitätsfehlers, wenn Kurzdiagnose für LSU aktiv ist." VALUE 0x8004D9FC Val_Wu8 99.00 OneToOne 1.000 100.0 EXTENDED_LIMITS 0.00 255.0 /end CHARACTERISTIC
/begin CHARACTERISTIC LSU_ctSclFacHtCoup_C "Skalierungsparameter für Entprellzählerwert des Heizerkopplungssfehlers, wenn Kurzdiagnose für LSU aktiv ist." VALUE 0x8004D7A0 Val_Wu8 99.00 OneToOne 1.000 100.0 EXTENDED_LIMITS 0.00 255.0 /end CHARACTERISTIC
/begin CHARACTERISTIC LSU_ctSclFacO2Clb_C "Skalierungsparameter für Entprellzählerwert des O2-Plausibilitätsfehlers, wenn Kurzdiagnose für LSU aktiv ist." VALUE 0x8004D6C0 Val_Wu8 99.00 OneToOne 1.000 100.0 EXTENDED_LIMITS 0.00 255.0 /end CHARACTERISTIC
/begin CHARACTERISTIC LSU_ctSclFacO2Plaus_C "Skalierungsparameter für Entprellzählerwert des O2-Plausibilitätsfehlers, wenn Kurzdiagnose für LSU aktiv ist." VALUE 0x8004D9FD Val_Wu8 99.00 OneToOne 1.000 100.0 EXTENDED_LIMITS 0.00 255.0 /end CHARACTERISTIC
/begin CHARACTERISTIC LSU_ctSclFacRiClb_C "Skalierungsparameter für Entprellzählerwert des Ri-Kalibrierungsfehlers, wenn Kurzdiagnose für LSU aktiv ist." VALUE 0x8004D738 Val_Wu8 99.00 OneToOne 1.000 100.0 EXTENDED_LIMITS 0.00 255.0 /end CHARACTERISTIC
/begin CHARACTERISTIC LSU_ctSclFacWireIP_C "Skalierungsparameter für Entprellzählerwert des Nebenschlussfehlers, wenn Kurzdiagnose für LSU aktiv ist." VALUE 0x8004D7A1 Val_Wu8 99.00 OneToOne 1.000 100.0 EXTENDED_LIMITS 0.00 255.0 /end CHARACTERISTIC
/begin CHARACTERISTIC LSU_d2rIni_C "Initialisierungswert des Auswertungsfilters" VALUE 0x8004D7EC Val_Ws16 0.6553500 O2 -0.3276800 0.3276700 /end CHARACTERISTIC
/begin CHARACTERISTIC LSU_dcycHtMin_C "Minimaler Wert des Heizertastverhältnisses" VALUE 0x8004D93C Val_Ws16 100.0000 DtyCyc 0.00 100.0000 EXTENDED_LIMITS -327.6800 327.6700 /end CHARACTERISTIC
/begin CHARACTERISTIC LSU_dcycMaxErr_C "Maximale Heizertastverhältnisbegrenzung im Fall eines Lastabfall- und 'Kurzschluss nach Masse'-Fehler einer Heizerendstufe" VALUE 0x8004D698 Val_Ws16 655.3500 DtyCyc -327.6800 327.6700 /end CHARACTERISTIC
/begin CHARACTERISTIC LSU_dcycMax_C "minimale Tastverhältnis-Änderung für Aktivierung Heizereinkopplungs-Diagnose" VALUE 0x8004D69A Val_Ws16 655.3500 DtyCyc -327.6800 327.6700 /end CHARACTERISTIC
/begin CHARACTERISTIC LSU_dcycMinGrad_C "minimale Tastverhältnis-Änderung für Aktivierung Heizereinkopplungs-Diagnose" VALUE 0x8004D7A2 Val_Ws16 655.3500 DtyCyc -327.6800 327.6700 /end CHARACTERISTIC
/begin CHARACTERISTIC LSU_DcycRmp.Pos_C "Tastverhältnis-Rampenstruktur für LSU-Heizer/" VALUE 0x8004D940 Kw_Ws32 327679.999847 RmpDtyCyc 0.00 327679.999847 FORMAT "%13.6" EXTENDED_LIMITS -327680.000000 327679.999847 /end CHARACTERISTIC
/begin CHARACTERISTIC LSU_DcycRmp.Neg_C "Tastverhältnis-Rampenstruktur für LSU-Heizer/" VALUE 0x8004D944 Kw_Ws32 327679.999847 RmpDtyCyc 0.00 327679.999847 FORMAT "%13.6" EXTENDED_LIMITS -327680.000000 327679.999847 /end CHARACTERISTIC
/begin CHARACTERISTIC LSU_dcycStrt_CUR "Kennlinie zur Konvertierung von Temperatur ins Tastverhältnis" CURVE 0x8004D948 Cur_Xs16Ws16 100.0000 DtyCyc 0.00 100.0000 EXTENDED_LIMITS -327.6800 327.6700
 /begin AXIS_DESCR STD_AXIS LSU_tAirStrt_mp Temp_Cels 5 -73.14000 126.8600 EXTENDED_LIMITS -3549.940 3003.560 DEPOSIT ABSOLUTE /end AXIS_DESCR
/end CHARACTERISTIC
/begin CHARACTERISTIC LSU_dcycTstImp_C "Der Test dutycycle" VALUE 0x8004D69C Val_Ws16 655.3500 DtyCyc -327.6800 327.6700 /end CHARACTERISTIC
/begin CHARACTERISTIC LSU_dmEGHtCoupActv_C "Schwelle zur Erkennung der Volllastbeschleunigung (wird zur Sperrung der Heizerkopplungsprüfung verwendet)" VALUE 0x8004D7A4 Val_Ws16 1000.000 AirMassPerTime 0.00 1000.000 EXTENDED_LIMITS -3276.800 3276.700 /end CHARACTERISTIC
/begin CHARACTERISTIC LSU_dNumHtCoup_C "Anzahl Aktivierungen der Heizereinkopplungs-Diagnose bis Ergebnis eindeutig" VALUE 0x8004D7A6 Val_Wu16 65535.00 OneToOne 0.00 65535.00 /end CHARACTERISTIC
/begin CHARACTERISTIC LSU_EvalMaxVal_C "Maximaler Sauerstoffwert" VALUE 0x8004D7EE Val_Ws16 0.6553500 O2 -0.3276800 0.3276700 /end CHARACTERISTIC
/begin CHARACTERISTIC LSU_EvalMinVal_C "Minimaler Sauerstoffwert" VALUE 0x8004D7F0 Val_Ws16 0.6553500 O2 -0.3276800 0.3276700 /end CHARACTERISTIC
/begin CHARACTERISTIC LSU_facPresCompLean_MAP "O2-Abgasdruckabgleichkennfeld für Mager" MAP 0x8004D7F2 Map_Xs16Ys16Ws16 7.999878 Fact -4.000000 3.999878
 /begin AXIS_DESCR STD_AXIS LSU_pExhGasLstVal_mp Pres_hPa 8 -32768.00 3500.00 EXTENDED_LIMITS -32768.00 32767.00 DEPOSIT ABSOLUTE /end AXIS_DESCR
 /begin AXIS_DESCR STD_AXIS LSU_tDvtPresComp_mp TempDiff_Kelv 5 -3276.800 3276.700 DEPOSIT ABSOLUTE /end AXIS_DESCR
/end CHARACTERISTIC
/begin CHARACTERISTIC LSU_facPresCompRich_MAP "O2-Abgasdruckabgleichkennfeld für Mager" MAP 0x8004D860 Map_Xs16Ys16Ws16 7.999878 Fact -4.000000 3.999878
 /begin AXIS_DESCR STD_AXIS LSU_pExhGasLstVal_mp Pres_hPa 8 -32768.00 3500.00 EXTENDED_LIMITS -32768.00 32767.00 DEPOSIT ABSOLUTE /end AXIS_DESCR
 /begin AXIS_DESCR STD_AXIS LSU_tDvtPresComp_mp TempDiff_Kelv 5 -3276.800 3276.700 DEPOSIT ABSOLUTE /end AXIS_DESCR
/end CHARACTERISTIC
/begin CHARACTERISTIC LSU_facSclFacTExcMax_C "Skalierungsparameter für die Entprellzeiten des MAX-Abweichungsfehlers der Heizerregelung bei aktiver Kurzdiagnose für LSU" VALUE 0x8004D95E Val_Wu16 7.000000 Fact 1.000000 8.000000 EXTENDED_LIMITS 0.00 7.999878 /end CHARACTERISTIC
/begin CHARACTERISTIC LSU_facSclFacTExcMin_C "Skalierungsparameter für die Entprellzeiten des MIN-Abweichungsfehlers der Heizerregelung bei aktiver Kurzdiagnose für LSU" VALUE 0x8004D960 Val_Wu16 7.000000 Fact 1.000000 8.000000 EXTENDED_LIMITS 0.00 7.999878 /end CHARACTERISTIC
/begin CHARACTERISTIC LSU_facUToRi_C "Faktor zur Konvertierung von u ins Ri" VALUE 0x8004D73A Val_Ws16 32.76750 VoltToRes -16.38400 16.38350 FORMAT "%8.5" /end CHARACTERISTIC
/begin CHARACTERISTIC LSU_mAirAdapActv_C "Minimaler Sauerstoffwert" VAL_BLK 0x8004D8CE ValA_Ws16 6553.500 AirMass_2 -3276.800 3276.700 FORMAT "%8.3" NUMBER 1 /end CHARACTERISTIC
/begin CHARACTERISTIC LSU_mAirMaxCmpChk_C "obere Luftmassenschwelle für Differenzprüfung" VALUE 0x8004D9FE Val_Ws16 6553.500 AirMassPerCyl -3276.800 3276.700 /end CHARACTERISTIC
/begin CHARACTERISTIC LSU_mAirMaxTst_C "Obere Luftmassenschwelle zur Freigabe der O2-Plausibilitätstest, wenn LSU-Servicetestdiagnose aktiv ist." VAL_BLK 0x8004DA00 ValA_Ws16 6553.500 AirMassPerCyl -3276.800 3276.700 NUMBER 3 /end CHARACTERISTIC
/begin CHARACTERISTIC LSU_mAirMax_C "obere Luftmassen-Schwelle für Plausibilitätscheck (0 - Vollast, 1 - Teillast, 2 - Schub)" VAL_BLK 0x8004DA06 ValA_Ws16 6553.500 AirMassPerCyl -3276.800 3276.700 NUMBER 3 /end CHARACTERISTIC
/begin CHARACTERISTIC LSU_mAirMinCmpChk_C "untere Luftmassenschwelle für Differenzprüfung" VALUE 0x8004DA0C Val_Ws16 6553.500 AirMassPerCyl -3276.800 3276.700 /end CHARACTERISTIC
/begin CHARACTERISTIC LSU_mAirMinTst_C "Untere Luftmassenschwelle zur Freigabe der O2-Plausibilitätstest, wenn LSU-Servicetest aktiv ist." VAL_BLK 0x8004DA0E ValA_Ws16 6553.500 AirMassPerCyl -3276.800 3276.700 NUMBER 3 /end CHARACTERISTIC
/begin CHARACTERISTIC LSU_mAirMin_C "untere Luftmassenschwelle für Plausibilitäts-Check (0 - Vollast, 1 - Teillast, 2 - Schub)" VAL_BLK 0x8004DA14 ValA_Ws16 6553.500 AirMassPerCyl -3276.800 3276.700 NUMBER 3 /end CHARACTERISTIC
/begin CHARACTERISTIC LSU_nHtCtlEna_C "Minimale Motordrehzahl zur Freigabe der Startup Rampe" VALUE 0x8004D962 Val_Ws16 16383.50 EngN 0.00 16383.50 EXTENDED_LIMITS -16384.00 16383.50 /end CHARACTERISTIC
/begin CHARACTERISTIC LSU_nMaxClb1_C "upper engine speed threshold for calibration/regeneration of CJ120/125 (for operating point1)" VALUE 0x8004D91C Val_Ws16 32767.50 EngN -16384.00 16383.50 /end CHARACTERISTIC
/begin CHARACTERISTIC LSU_nMaxClb2_C "lower engine speed threshold for calibration/regeneration of CJ120/125 (for operating point2)" VALUE 0x8004D91E Val_Ws16 32767.50 EngN -16384.00 16383.50 /end CHARACTERISTIC
/begin CHARACTERISTIC LSU_nMaxCmpChk_C "obere Drehzahlschwelle für für Differenzprüfung" VALUE 0x8004DA1A Val_Ws16 32767.50 EngN -16384.00 16383.50 /end CHARACTERISTIC
/begin CHARACTERISTIC LSU_nMaxTst_C "Obere Luftmassenschwelle zur Freigabe der O2-Plausibilitätstest, wenn LSU-Kurzdiagnose aktiv ist." VAL_BLK 0x8004DA1C ValA_Ws16 32767.50 EngN -16384.00 16383.50 NUMBER 3 /end CHARACTERISTIC
/begin CHARACTERISTIC LSU_nMax_C "obere Drehzahlschwelle für Plausibilitäts-Check (0 - Vollast, 1 - Teillast, 2 - Schub)" VAL_BLK 0x8004DA22 ValA_Ws16 32767.50 EngN -16384.00 16383.50 NUMBER 3 /end CHARACTERISTIC
/begin CHARACTERISTIC LSU_nMinChkDyn_C "minimale Drehzahl zur Aktivierung Dynamiküberwachung" VALUE 0x8004DA28 Val_Ws16 32767.50 EngN -16384.00 16383.50 /end CHARACTERISTIC
/begin CHARACTERISTIC LSU_nMinClb1_C "lower engine speed threshold for for calibration/regeneration of CJ120/125 (for operating point1)" VALUE 0x8004D920 Val_Ws16 32767.50 EngN -16384.00 16383.50 /end CHARACTERISTIC
/begin CHARACTERISTIC LSU_nMinClb2_C "lower engine speed threshold for for calibration/regeneration of CJ120/125 (for operating point2)" VALUE 0x8004D922 Val_Ws16 32767.50 EngN -16384.00 16383.50 /end CHARACTERISTIC
/begin CHARACTERISTIC LSU_nMinCmpChk_C "unter Drehzahlschwelle für Differenzprüfung" VALUE 0x8004DA2A Val_Ws16 32767.50 EngN -16384.00 16383.50 /end CHARACTERISTIC
/begin CHARACTERISTIC LSU_nMinTst_C "Untere Drehzahlschwelle zur Freigabe der O2-Plausibilitätstest, wenn LSU-Kurzdiagnose aktiv ist." VAL_BLK 0x8004DA2C ValA_Ws16 32767.50 EngN -16384.00 16383.50 NUMBER 3 /end CHARACTERISTIC
/begin CHARACTERISTIC LSU_nMin_C "untere Drehzahlschwelle für Plausibilitäts-Check (0 - Vollast, 1 - Teillast, 2 - Schub)" VAL_BLK 0x8004DA32 ValA_Ws16 32767.50 EngN -16384.00 16383.50 NUMBER 3 /end CHARACTERISTIC
/begin CHARACTERISTIC LSU_numEGFld_CA "Array zur Auswahl des modellierten Drucks für den zugehörigen Lambda-Sensor" VAL_BLK 0x8004D8D0 ValA_Wu8 255.0 OneToOne 0.00 255.0 NUMBER 1 /end CHARACTERISTIC
/begin CHARACTERISTIC LSU_numEGSel_CA "Array zur position des Abgaskrümmers zur Auswahl des Ablaufmodells" VAL_BLK 0x8004D7A8 ValA_Wu8 255.0 OneToOne 0.00 255.0 NUMBER 4 /end CHARACTERISTIC
/begin CHARACTERISTIC LSU_numSelDiffChk_C "Auswahl des Sondenpaars für Zuweisung zu Differenzprüfung" VALUE 0x8004DA38 Val_Wu8 32.00 OneToOne 0.00 32.00 EXTENDED_LIMITS 0.00 255.0 /end CHARACTERISTIC
/begin CHARACTERISTIC LSU_numSensCmpChk_CA "Matrix für Zuweisung eines Sondenpaars der Differenzprüfung" VAL_BLK 0x8004DA39 ValA_Wu8 255.0 OneToOne 0.00 255.0 READ_ONLY NUMBER 12 /end CHARACTERISTIC
/begin CHARACTERISTIC LSU_OvrRunDeb.tiHiLo_C "Entprellstruktur für Schubbedingung/" VALUE 0x8004D66C Kw_Ws16 655350.0 TimeDeb -327680.0 327670.0 /end CHARACTERISTIC
/begin CHARACTERISTIC LSU_OvrRunDeb.tiLoHi_C "Entprellstruktur für Schubbedingung/" VALUE 0x8004D66E Kw_Ws16 655350.0 TimeDeb -327680.0 327670.0 /end CHARACTERISTIC
/begin CHARACTERISTIC LSU_pExhO2MaxDiaDis_C "Aufblasdruck-Schwelle oben, den die Überwachung von O2 SRC Fehler von Max gestrichen wird" VALUE 0x8004D6C2 Val_Ws16 36268.00 Pres_hPa -32768.00 3500.00 EXTENDED_LIMITS -32768.00 32767.00 /end CHARACTERISTIC
/begin CHARACTERISTIC LSU_Pwm.tiPer_C "LSU-Heizer PWM-Signalstruktur/" VALUE 0x8004D69E Kw_Ws16 6553.500 Period -3276.800 3276.700 FORMAT "%8.3" /end CHARACTERISTIC
/begin CHARACTERISTIC LSU_Pwm.stLvl_C "LSU-Heizer PWM-Signalstruktur/" VALUE 0x8004D6A0 Kw_Wu8 1.00000000000 PwmOutLevel 0.00 1.00000000000 FORMAT "%13.11" /end CHARACTERISTIC
/begin CHARACTERISTIC LSU_Pwm.rMaxDty_C "LSU-Heizer PWM-Signalstruktur/" VALUE 0x8004D6A2 Kw_Ws16 655.3500 DtyCyc -327.6800 327.6700 /end CHARACTERISTIC
/begin CHARACTERISTIC LSU_Pwm.rPerUn_C "LSU-Heizer PWM-Signalstruktur/" VALUE 0x8004D6A4 Kw_Ws16 65535.00 OneToOne -32768.00 32767.00 /end CHARACTERISTIC
/begin CHARACTERISTIC LSU_Pwm.tiPh_C "LSU-Heizer PWM-Signalstruktur/" VALUE 0x8004D6A6 Kw_Ws16 65535.00 OneToOne -32768.00 32767.00 /end CHARACTERISTIC
/begin CHARACTERISTIC LSU_PwmOut.rMin_C "Struktur, welche die Kalibrierungsparameter für die Heizer-Endstufendiagnose enthält/" VALUE 0x8004D6A8 Kw_Ws16 100.0000 DtyCyc 0.00 100.0000 EXTENDED_LIMITS -327.6800 327.6700 /end CHARACTERISTIC
/begin CHARACTERISTIC LSU_PwmOut.rMax_C "Struktur, welche die Kalibrierungsparameter für die Heizer-Endstufendiagnose enthält/" VALUE 0x8004D6AA Kw_Ws16 100.0000 DtyCyc 0.00 100.0000 EXTENDED_LIMITS -327.6800 327.6700 /end CHARACTERISTIC
/begin CHARACTERISTIC LSU_PwmOut.tiBtwTstSCB_C "Struktur, welche die Kalibrierungsparameter für die Heizer-Endstufendiagnose enthält/" VALUE 0x8004D6AC Kw_Ws16 1000.000 Time_ms 0.00 1000.000 EXTENDED_LIMITS -327680.0 327670.0 /end CHARACTERISTIC
/begin CHARACTERISTIC LSU_PwmOut.tiBtwTstOT_C "Struktur, welche die Kalibrierungsparameter für die Heizer-Endstufendiagnose enthält/" VALUE 0x8004D6AE Kw_Ws16 327.6700 Time_s 0.00 327.6700 EXTENDED_LIMITS -327.6800 327.6700 /end CHARACTERISTIC
/begin CHARACTERISTIC LSU_PwmOut.numTstMax_C "Struktur, welche die Kalibrierungsparameter für die Heizer-Endstufendiagnose enthält/" VALUE 0x8004D6B0 Kw_Wu16 65535.00 OneToOne 0.00 65535.00 /end CHARACTERISTIC
/begin CHARACTERISTIC LSU_PwmOut.swtBattCor_C "Struktur, welche die Kalibrierungsparameter für die Heizer-Endstufendiagnose enthält/" VALUE 0x8004D6B2 Kw_Wu8 1.000 OneToOne 0.00 1.000 EXTENDED_LIMITS 0.00 255.0 /end CHARACTERISTIC
/begin CHARACTERISTIC LSU_PwmOut.swtPsInv_C "Struktur, welche die Kalibrierungsparameter für die Heizer-Endstufendiagnose enthält/" VALUE 0x8004D6B3 Kw_Wu8 255.0 OneToOne 0.00 255.0 /end CHARACTERISTIC
/begin CHARACTERISTIC LSU_qDiffMax_C "Toleranzband Einspritzmenge für Stationärerkennung" VALUE 0x8004DA46 Val_Ws16 655.3500 InjMass -327.6800 327.6700 /end CHARACTERISTIC
/begin CHARACTERISTIC LSU_qMaxClb1_C "upper fuel quantity threshold for calibration/regeneration of CJ120/125 (for operating point1)" VALUE 0x8004D924 Val_Ws16 655.3500 InjMass -327.6800 327.6700 /end CHARACTERISTIC
/begin CHARACTERISTIC LSU_qMaxClb2_C "upper fuel quantity threshold for calibration/regeneration of CJ120/125 (for operating point2)" VALUE 0x8004D926 Val_Ws16 655.3500 InjMass -327.6800 327.6700 /end CHARACTERISTIC
/begin CHARACTERISTIC LSU_qMaxCmpChk_C "obere Mengenschwelle für Differenzprüfung" VALUE 0x8004DA48 Val_Ws16 655.3500 InjMass -327.6800 327.6700 /end CHARACTERISTIC
/begin CHARACTERISTIC LSU_qMaxTst_C "Obere Einspritzmengenschwelle zur Freigabe der O2-Plausibilitätstest, wenn LSU-Kurzdiagnose aktiv ist." VAL_BLK 0x8004DA4A ValA_Ws16 655.3500 InjMass -327.6800 327.6700 NUMBER 3 /end CHARACTERISTIC
/begin CHARACTERISTIC LSU_qMax_C "obere Mengenschwelle für Plausibilitäts-Check (0 - Vollast, 1 - Teillast, 2 - Schub)" VAL_BLK 0x8004DA50 ValA_Ws16 655.3500 InjMass -327.6800 327.6700 NUMBER 3 /end CHARACTERISTIC
/begin CHARACTERISTIC LSU_qMinClb1_C "lower fuel quantity threshold for calibration/regeneration of CJ120/125 (for operating point1)" VALUE 0x8004D928 Val_Ws16 655.3500 InjMass -327.6800 327.6700 /end CHARACTERISTIC
/begin CHARACTERISTIC LSU_qMinClb2_C "lower fuel quantity threshold for calibration/regeneration of CJ120/125 (for operating point2)" VALUE 0x8004D92A Val_Ws16 655.3500 InjMass -327.6800 327.6700 /end CHARACTERISTIC
/begin CHARACTERISTIC LSU_qMinCmpChk_C "untere Mengenschwelle für Differenzprüfung" VALUE 0x8004DA56 Val_Ws16 655.3500 InjMass -327.6800 327.6700 /end CHARACTERISTIC
/begin CHARACTERISTIC LSU_qMinTst_C "Obere Einspritzmengenschwelle zur Freigabe der O2-Plausibilitätstest, wenn LSU-Kurzdiagnose aktiv ist." VAL_BLK 0x8004DA58 ValA_Ws16 655.3500 InjMass -327.6800 327.6700 NUMBER 3 /end CHARACTERISTIC
/begin CHARACTERISTIC LSU_qMin_C "untere Mengenschwelle für Plausibilitäts-Check (0 - Vollast, 1 - Teillast, 2 - Schub)" VAL_BLK 0x8004DA5E ValA_Ws16 655.3500 InjMass -327.6800 327.6700 NUMBER 3 /end CHARACTERISTIC
/begin CHARACTERISTIC LSU_qThresChkDyn_C "minimale Kraftstoffmenge für Aktivierung Dynamiküberwachung" VALUE 0x8004DA64 Val_Ws16 655.3500 InjMass -327.6800 327.6700 /end CHARACTERISTIC
/begin CHARACTERISTIC LSU_qThresOvrRun_C "Mengenschwelle zur Schuberkennung" VALUE 0x8004DA66 Val_Ws16 655.3500 InjMass -327.6800 327.6700 /end CHARACTERISTIC
/begin CHARACTERISTIC LSU_rEGRMaxCmpChk_C "obere Grenze der AGR-Stellung" VALUE 0x8004DA68 Val_Ws16 300.0000 Prc -100.0000 200.0000 EXTENDED_LIMITS -400.0000 399.9878 /end CHARACTERISTIC
/begin CHARACTERISTIC LSU_rEGRMinCmpChk_C "untere Grenze der AGR-Stellung" VALUE 0x8004DA6A Val_Ws16 300.0000 Prc -100.0000 200.0000 EXTENDED_LIMITS -400.0000 399.9878 /end CHARACTERISTIC
/begin CHARACTERISTIC LSU_resRiClbDvtMax_C "Begrenzte maximale Schwelle für LSU_resRiClbRaw_mp" VALUE 0x8004D73C Val_Ws16 6553.500 Resist -3276.800 3276.700 FORMAT "%8.3" /end CHARACTERISTIC
/begin CHARACTERISTIC LSU_resRiClbDvtMin_C "Begrenzte minimale Schwelle für LSU_resRiClbRaw_mp" VALUE 0x8004D73E Val_Ws16 6553.500 Resist -3276.800 3276.700 FORMAT "%8.3" /end CHARACTERISTIC
/begin CHARACTERISTIC LSU_resRiClbMax_C "Maximaler Korrekturwert für Ri-Kalibrierung" VALUE 0x8004D740 Val_Ws16 6553.500 Resist -3276.800 3276.700 FORMAT "%8.3" /end CHARACTERISTIC
/begin CHARACTERISTIC LSU_resRiClbMin_C "Minimaler Korrekturwert für Ri-Kalibrierung" VALUE 0x8004D742 Val_Ws16 6553.500 Resist -3276.800 3276.700 FORMAT "%8.3" /end CHARACTERISTIC
/begin CHARACTERISTIC LSU_resRiClbRef_C "also value of external calibration resistor" VALUE 0x8004D744 Val_Ws16 6553.500 Resist -3276.800 3276.700 FORMAT "%8.3" /end CHARACTERISTIC
/begin CHARACTERISTIC LSU_resRiMaxGrad_C "maximale Ri-Änderung für Aktivierung Heizereinkopplungs-Diagnose" VALUE 0x8004D7AC Val_Ws16 6553.500 Resist -3276.800 3276.700 FORMAT "%8.3" /end CHARACTERISTIC
/begin CHARACTERISTIC LSU_RiDeb.tiHiLo_C "Entprellstruktur für den Vergleich der Ri-Spannung mit der Schwelle für die Erkennung der Überlast an UN und VG/" VALUE 0x8004D670 Kw_Ws16 655350.0 TimeDeb -327680.0 327670.0 /end CHARACTERISTIC
/begin CHARACTERISTIC LSU_RiDeb.tiLoHi_C "Entprellstruktur für den Vergleich der Ri-Spannung mit der Schwelle für die Erkennung der Überlast an UN und VG/" VALUE 0x8004D672 Kw_Ws16 655350.0 TimeDeb -327680.0 327670.0 /end CHARACTERISTIC
/begin CHARACTERISTIC LSU_rLamRec_CUR "Kennlinie für Kehrwert von Lambda" CURVE 0x8004D8D2 Cur_Xs16Ws16 65.53500 lambdaRecVal -32.76800 32.76700 FORMAT "%8.5"
 /begin AXIS_DESCR STD_AXIS LSU_rO2AdptLastLSU_mp O2 12 -0.3276800 0.3276700 DEPOSIT ABSOLUTE /end AXIS_DESCR
/end CHARACTERISTIC
/begin CHARACTERISTIC LSU_rMaxDiff_CA "maximale Differenz zwischen gewählten LSU" VAL_BLK 0x8004DA6C ValA_Ws16 0.6553500 O2 -0.3276800 0.3276700 NUMBER 6 /end CHARACTERISTIC
/begin CHARACTERISTIC LSU_rO2IsolChkMax_C "maximal zulässige O2-Anzeige bei kalter Sonde" VALUE 0x8004D7AE Val_Ws16 0.6553500 O2 -0.3276800 0.3276700 /end CHARACTERISTIC
/begin CHARACTERISTIC LSU_rO2IsolChkMin_C "minimal zulässige O2-Anzeige bei kalter Sonde" VALUE 0x8004D7B0 Val_Ws16 0.6553500 O2 -0.3276800 0.3276700 /end CHARACTERISTIC
/begin CHARACTERISTIC LSU_rO2Lmbd1Thres_C "Toleranzband für Lambda-1-Erkennung" VALUE 0x8004D674 Val_Ws16 0.6553500 O2 -0.3276800 0.3276700 /end CHARACTERISTIC
/begin CHARACTERISTIC LSU_rO2MaxVar_C "Breite des Toleranzbands für O2-Stationärerkennung" VALUE 0x8004DA78 Val_Ws16 0.6553500 O2 -0.3276800 0.3276700 /end CHARACTERISTIC
/begin CHARACTERISTIC LSU_rO2Min_C "minimaler O2-Sollwert für Aktivierung der Lambda-1-Erkennung" VALUE 0x8004D676 Val_Ws16 0.6553500 O2 -0.3276800 0.3276700 /end CHARACTERISTIC
/begin CHARACTERISTIC LSU_rO2NegDvtTst_C "Erlaubte Negative-Abweichung aus der berechneten O2-Konzentration für O2-Plausibilitätstest, wenn LSU-Servicetest aktiv ist." VAL_BLK 0x8004DA7A ValA_Ws16 0.6553500 O2 -0.3276800 0.3276700 NUMBER 3 /end CHARACTERISTIC
/begin CHARACTERISTIC LSU_rO2NegDvt_C "negative O2-Toleranz (0 - Vollast, 1 - Teillast, 2 - Schub)" VAL_BLK 0x8004DA80 ValA_Ws16 0.6553500 O2 -0.3276800 0.3276700 NUMBER 3 /end CHARACTERISTIC
/begin CHARACTERISTIC LSU_rO2PosDvtTst_C "Erlaubte Positive-Abweichung aus der berechneten O2-Konzentration für O2-Plausibilitätstest, wenn LSU-Servicetestdiagnose aktiv ist." VAL_BLK 0x8004DA86 ValA_Ws16 0.6553500 O2 -0.3276800 0.3276700 NUMBER 3 /end CHARACTERISTIC
/begin CHARACTERISTIC LSU_rO2PosDvt_C "positive O2-Toleranz (0 - Vollast, 1 - Teillast, 2 - Schub)" VAL_BLK 0x8004DA8C ValA_Ws16 0.6553500 O2 -0.3276800 0.3276700 NUMBER 3 /end CHARACTERISTIC
/begin CHARACTERISTIC LSU_rO2SwtPresComp_C "O2-Schwelle des Schalters zwischen den zwei Druckkompensationskennlinien" VALUE 0x8004D904 Val_Ws16 0.6553500 O2 -0.3276800 0.3276700 /end CHARACTERISTIC
/begin CHARACTERISTIC LSU_rO2Transf_CUR "Kennlinie zur Konvertierung der Leiterspannung in den O2-Wert" CURVE 0x8004D6C4 Cur_Xs16Ws16 0.6250000 O2 -0.3000000 0.3250000 EXTENDED_LIMITS -0.3276800 0.3276700
 /begin AXIS_DESCR STD_AXIS LSU_uO2RawOfsCorLast_mp Volt 15 -1600.000 4000.000 EXTENDED_LIMITS -6553.600 6553.400 DEPOSIT ABSOLUTE /end AXIS_DESCR
/end CHARACTERISTIC
/begin CHARACTERISTIC LSU_Sens1DT1.T1_C "D-Struktur für Heizerregler des Sensors vor Katalysator/" VALUE 0x8004D964 Kw_Ws32 4294.9672940 TimeDelay_s 0.000002000000001 4294.9672960 FORMAT "%12.7" /end CHARACTERISTIC
/begin CHARACTERISTIC LSU_Sens1DT1.Kd_C "D-Struktur für Heizerregler des Sensors vor Katalysator/" VALUE 0x8004D968 Kw_Ws32 6553.59999847 Kd_Temp_Kelv2Dcyc -3276.80000000 3276.79999847 FORMAT "%13.8" /end CHARACTERISTIC
/begin CHARACTERISTIC LSU_Sens1I.Ki_C "I-Struktur für Heizerregler des Sensors vor Katalysator/" VALUE 0x8004D96C Kw_Ws32 199999.999953 Ki_Temp_Kelv2Dcyc -100000.000000 99999.9999534 FORMAT "%13.6" /end CHARACTERISTIC
/begin CHARACTERISTIC LSU_Sens1I.KiPos_C "I-Struktur für Heizerregler des Sensors vor Katalysator/" VALUE 0x8004D970 Kw_Ws32 199999.999953 Ki_Temp_Kelv2Dcyc -100000.000000 99999.9999534 FORMAT "%13.6" /end CHARACTERISTIC
/begin CHARACTERISTIC LSU_Sens1I.KiNeg_C "I-Struktur für Heizerregler des Sensors vor Katalysator/" VALUE 0x8004D974 Kw_Ws32 199999.999953 Ki_Temp_Kelv2Dcyc -100000.000000 99999.9999534 FORMAT "%13.6" /end CHARACTERISTIC
/begin CHARACTERISTIC LSU_Sens1I.WinPos_C "I-Struktur für Heizerregler des Sensors vor Katalysator/" VALUE 0x8004D978 Kw_Ws32 429496729.500 TempDiff_Kelv -214748364.800 214748364.700 /end CHARACTERISTIC
/begin CHARACTERISTIC LSU_Sens1I.WinNeg_C "I-Struktur für Heizerregler des Sensors vor Katalysator/" VALUE 0x8004D97C Kw_Ws32 429496729.500 TempDiff_Kelv -214748364.800 214748364.700 /end CHARACTERISTIC
/begin CHARACTERISTIC LSU_Sens1P.Kp_C "P-Struktur für Heizerregler des Sensors vor Katalysator/" VALUE 0x8004D980 Kw_Ws32 13107.1999969 Kp_Temp_Kelv2Dcyc -6553.60000000 6553.59999695 FORMAT "%13.8" /end CHARACTERISTIC
/begin CHARACTERISTIC LSU_Sens1P.KpPos_C "P-Struktur für Heizerregler des Sensors vor Katalysator/" VALUE 0x8004D984 Kw_Ws32 13107.1999969 Kp_Temp_Kelv2Dcyc -6553.60000000 6553.59999695 FORMAT "%13.8" /end CHARACTERISTIC
/begin CHARACTERISTIC LSU_Sens1P.KpNeg_C "P-Struktur für Heizerregler des Sensors vor Katalysator/" VALUE 0x8004D988 Kw_Ws32 13107.1999969 Kp_Temp_Kelv2Dcyc -6553.60000000 6553.59999695 FORMAT "%13.8" /end CHARACTERISTIC
/begin CHARACTERISTIC LSU_Sens1P.WinPos_C "P-Struktur für Heizerregler des Sensors vor Katalysator/" VALUE 0x8004D98C Kw_Ws32 429496729.500 TempDiff_Kelv -214748364.800 214748364.700 /end CHARACTERISTIC
/begin CHARACTERISTIC LSU_Sens1P.WinNeg_C "P-Struktur für Heizerregler des Sensors vor Katalysator/" VALUE 0x8004D990 Kw_Ws32 429496729.500 TempDiff_Kelv -214748364.800 214748364.700 /end CHARACTERISTIC
/begin CHARACTERISTIC LSU_Sens2DT1.T1_C "D-Struktur für Heizerregler des Sensors nach Katalysator/" VALUE 0x8004D994 Kw_Ws32 4294.9672940 TimeDelay_s 0.000002000000001 4294.9672960 FORMAT "%12.7" /end CHARACTERISTIC
/begin CHARACTERISTIC LSU_Sens2DT1.Kd_C "D-Struktur für Heizerregler des Sensors nach Katalysator/" VALUE 0x8004D998 Kw_Ws32 6553.59999847 Kd_Temp_Kelv2Dcyc -3276.80000000 3276.79999847 FORMAT "%13.8" /end CHARACTERISTIC
/begin CHARACTERISTIC LSU_Sens2I.Ki_C "I-Struktur für Heizerregler des Sensors nach Katalysator/" VALUE 0x8004D99C Kw_Ws32 199999.999953 Ki_Temp_Kelv2Dcyc -100000.000000 99999.9999534 FORMAT "%13.6" /end CHARACTERISTIC
/begin CHARACTERISTIC LSU_Sens2I.KiPos_C "I-Struktur für Heizerregler des Sensors nach Katalysator/" VALUE 0x8004D9A0 Kw_Ws32 199999.999953 Ki_Temp_Kelv2Dcyc -100000.000000 99999.9999534 FORMAT "%13.6" /end CHARACTERISTIC
/begin CHARACTERISTIC LSU_Sens2I.KiNeg_C "I-Struktur für Heizerregler des Sensors nach Katalysator/" VALUE 0x8004D9A4 Kw_Ws32 199999.999953 Ki_Temp_Kelv2Dcyc -100000.000000 99999.9999534 FORMAT "%13.6" /end CHARACTERISTIC
/begin CHARACTERISTIC LSU_Sens2I.WinPos_C "I-Struktur für Heizerregler des Sensors nach Katalysator/" VALUE 0x8004D9A8 Kw_Ws32 429496729.500 TempDiff_Kelv -214748364.800 214748364.700 /end CHARACTERISTIC
/begin CHARACTERISTIC LSU_Sens2I.WinNeg_C "I-Struktur für Heizerregler des Sensors nach Katalysator/" VALUE 0x8004D9AC Kw_Ws32 429496729.500 TempDiff_Kelv -214748364.800 214748364.700 /end CHARACTERISTIC
/begin CHARACTERISTIC LSU_Sens2P.Kp_C "P-Struktur für Heizerregler des Sensors nach Katalysator/" VALUE 0x8004D9B0 Kw_Ws32 13107.1999969 Kp_Temp_Kelv2Dcyc -6553.60000000 6553.59999695 FORMAT "%13.8" /end CHARACTERISTIC
/begin CHARACTERISTIC LSU_Sens2P.KpPos_C "P-Struktur für Heizerregler des Sensors nach Katalysator/" VALUE 0x8004D9B4 Kw_Ws32 13107.1999969 Kp_Temp_Kelv2Dcyc -6553.60000000 6553.59999695 FORMAT "%13.8" /end CHARACTERISTIC
/begin CHARACTERISTIC LSU_Sens2P.KpNeg_C "P-Struktur für Heizerregler des Sensors nach Katalysator/" VALUE 0x8004D9B8 Kw_Ws32 13107.1999969 Kp_Temp_Kelv2Dcyc -6553.60000000 6553.59999695 FORMAT "%13.8" /end CHARACTERISTIC
/begin CHARACTERISTIC LSU_Sens2P.WinPos_C "P-Struktur für Heizerregler des Sensors nach Katalysator/" VALUE 0x8004D9BC Kw_Ws32 429496729.500 TempDiff_Kelv -214748364.800 214748364.700 /end CHARACTERISTIC
/begin CHARACTERISTIC LSU_Sens2P.WinNeg_C "P-Struktur für Heizerregler des Sensors nach Katalysator/" VALUE 0x8004D9C0 Kw_Ws32 429496729.500 TempDiff_Kelv -214748364.800 214748364.700 /end CHARACTERISTIC
/begin CHARACTERISTIC LSU_stChpClbActv_C "Aktivierungsflags für O2- und Ri-Kalibrierung" VALUE 0x8004D92C Val_Wu8 3.000 OneToOne 0.00 3.000 EXTENDED_LIMITS 0.00 255.0 /end CHARACTERISTIC
/begin CHARACTERISTIC LSU_stEGTClbOff_C "Bitmaske zur Unterdrückung der CJ12x-Kalibrierung bei Regenerationsanforderung Abgasnachbehandlung" VALUE 0x8004D930 Val_Wu32 4294967295.00 OneToOne 0.00 4294967295.00 /end CHARACTERISTIC
/begin CHARACTERISTIC LSU_stHtDis_C "Applikationsparameter zur Abschaltung des Heizers in Abhängigkeit von" VALUE 0x8004D6B4 Val_Wu8 255.0 OneToOne 0.00 255.0 /end CHARACTERISTIC
/begin CHARACTERISTIC LSU_stHtrPwrStgSel_C "Statuswort" VALUE 0x8004D6B5 Val_Wu8 255.0 OneToOne 0.00 255.0 /end CHARACTERISTIC
/begin CHARACTERISTIC LSU_stLmbd1RgnMsk_C "Bitmaske zur Unterdrückung der Lambda = 1 Erkennung bei Regenerierungsanforderung des SOx-Katalysators" VALUE 0x8004D678 Val_Wu32 4294967295.00 OneToOne 0.00 4294967295.00 /end CHARACTERISTIC
/begin CHARACTERISTIC LSU_stMonActv_C "Aktivierungsflags für Diagnoseroutinen" VALUE 0x8004DA92 Val_Wu8 255.0 OneToOne 0.00 255.0 /end CHARACTERISTIC
/begin CHARACTERISTIC LSU_stMonCmpReqd_C "Bitmaske für Auswahl erfolgreich durchgeführter Einzeldiagnose" VALUE 0x8004DA93 Val_Wu8 32.00 OneToOne 0.00 32.00 EXTENDED_LIMITS 0.00 255.0 /end CHARACTERISTIC
/begin CHARACTERISTIC LSU_stMonMsk_C "Bitmaske zur Unterdrückung der Diagnosen im Fall einer Regenerationsanforderung der Abgasnachbehandlung" VALUE 0x8004DA94 Val_Wu32 4294967295.00 OneToOne 0.00 4294967295.00 /end CHARACTERISTIC
/begin CHARACTERISTIC LSU_stMskCmpChkO2_C "Bitmaske für Zustand der Abgasnachbehandlung für Freigabe der Differenzprüfung" VALUE 0x8004DA98 Val_Wu32 4294967295.00 OneToOne 0.00 4294967295.00 /end CHARACTERISTIC
/begin CHARACTERISTIC LSU_stO2Calc_C "Schalter, um Kraftstoffdichtekorrektur während der Berechnung der Sauerstoffkonzentration auszuwählen" VALUE 0x8004DA9C Val_Wu8 1.000 OneToOne 0.00 1.000 EXTENDED_LIMITS 0.00 255.0 /end CHARACTERISTIC
/begin CHARACTERISTIC LSU_stO2SRCMinMsk_C "Bitmaske zur Unterdrückung der O2-SRC-MIN-Fehlererkennung bei Regenerierungsanforderung des NOx-Katalysators" VALUE 0x8004D704 Val_Wu32 4294967295.00 OneToOne 0.00 4294967295.00 /end CHARACTERISTIC
/begin CHARACTERISTIC LSU_stPmpCtlDisbl_C "Masksperren für Motorbedingungen-abhängige Pumpenstromregelung" VALUE 0x8004DABC Val_Wu8 255.0 OneToOne 0.00 255.0 /end CHARACTERISTIC
/begin CHARACTERISTIC LSU_stPortSel_CA "Anwendung zum Austauschen (Swap) der Lambda-Sensorverbindungen zum SG" VAL_BLK 0x8004D6B6 ValA_Wu8 0.00 OneToOne 0.00 0.00 EXTENDED_LIMITS 0.00 255.0 NUMBER 1 /end CHARACTERISTIC
/begin CHARACTERISTIC LSU_stPsDiaDisbl_C "Statuswort zur Deaktiveirung der Heizerendstufediagnose unter Sondermotor- / Batteriebedingungen" VALUE 0x8004D6B7 Val_Wu8 255.0 OneToOne 0.00 255.0 /end CHARACTERISTIC
/begin CHARACTERISTIC LSU_stRefCurrHi_C "Applikationsparameter für höhen Referenzpumpenstrom" VALUE 0x8004D79C Val_Wu8 15.0000000000 CurRefPump 0.00 15.0000000000 FORMAT "%13.10" /end CHARACTERISTIC
/begin CHARACTERISTIC LSU_stRefCurrNrm_C "Applikationsparameter für normalen Referenzpumpenstrom" VALUE 0x8004D79D Val_Wu8 15.0000000000 CurRefPump 0.00 15.0000000000 FORMAT "%13.10" /end CHARACTERISTIC
/begin CHARACTERISTIC LSU_stRefPmpDisbl_C "Allgemeine Sperrbedingungen der Referenzpumpenströme" VALUE 0x8004DABE Val_Wu8 255.0 OneToOne 0.00 255.0 /end CHARACTERISTIC
/begin CHARACTERISTIC LSU_stSelPlausChkSig_C "Auswahl O2-Signal für Plausibilisierung" VALUE 0x8004DA9E Val_Wu16 65535.00 OneToOne 0.00 65535.00 /end CHARACTERISTIC
/begin CHARACTERISTIC LSU_stSrvTstEna_C "Bitkodierter Applikation zur Freigabe oder Verriegelung unterschiedlicher LSU-Diagnosekunktionen, wenn der Servicetest für LSU aktiv ist" VALUE 0x8004D7D4 Val_Wu16 65535.00 OneToOne 0.00 65535.00 /end CHARACTERISTIC
/begin CHARACTERISTIC LSU_stWireDiaActv_C "Aktivierungsflags für Diagnoseroutinen" VALUE 0x8004D7B2 Val_Wu16 65535.00 OneToOne 0.00 65535.00 /end CHARACTERISTIC
/begin CHARACTERISTIC LSU_swtAdap_C "Anpassungs-SW-Schalter" VALUE 0x8004D906 Val_Wu8 1.000 OneToOne 0.00 1.000 EXTENDED_LIMITS 0.00 255.0 /end CHARACTERISTIC
/begin CHARACTERISTIC LSU_swtCldSensDia_C "Status zur Freigabe / Sperrung der Kaltesonde-Diagnose für SCB an IA/IP" VALUE 0x8004D67C Val_Wu8 255.0 OneToOne 0.00 255.0 /end CHARACTERISTIC
/begin CHARACTERISTIC LSU_swtExhPresSel_C "Schalter zum Hinzufügen des PFlt-Differenzdrucks an der modellierten Abgasdruck während des Druckausgleiches des Sauerstoffsignals" VALUE 0x8004D907 Val_Wu8 1.000 OneToOne 0.00 1.000 EXTENDED_LIMITS 0.00 255.0 /end CHARACTERISTIC
/begin CHARACTERISTIC LSU_swtO2Flt_C "Schalter zur Freigabe der O2-Filterung" VALUE 0x8004D708 Val_Wu8 1.000 OneToOne 0.00 1.000 EXTENDED_LIMITS 0.00 255.0 /end CHARACTERISTIC
/begin CHARACTERISTIC LSU_swtSensPrs_C "Schalter zur Anzeige von dem Vorhandensein oder Nichtvorhandensein des LSU-Sensors." VALUE 0x8004D709 Val_Wu8 1.000 OneToOne 0.00 1.000 EXTENDED_LIMITS 0.00 255.0 /end CHARACTERISTIC
/begin CHARACTERISTIC LSU_tAirAdapActv_C "Lufttemperaturgrenze zur Aktivierung der Anpassung" VALUE 0x8004D908 Val_Ws16 6553.500 Temp_Cels -3549.940 3003.560 /end CHARACTERISTIC
/begin CHARACTERISTIC LSU_tExcMax_C "Maximale Temperatur für den Sensorbetrieb" VALUE 0x8004D9C4 Val_Ws16 1200.000 Temp_Cels 99.96000 1299.960 EXTENDED_LIMITS -3549.940 3003.560 /end CHARACTERISTIC
/begin CHARACTERISTIC LSU_tExcMin_C "Minimale Temperatur für den Sensorbetrieb" VALUE 0x8004D9C6 Val_Ws16 1200.000 Temp_Cels 99.96000 1299.960 EXTENDED_LIMITS -3549.940 3003.560 /end CHARACTERISTIC
/begin CHARACTERISTIC LSU_tHtCtlEna_C "Heizungsregelung-Freigabe" VALUE 0x8004D9C8 Val_Ws16 1200.000 Temp_Cels 99.96000 1299.960 EXTENDED_LIMITS -3549.940 3003.560 /end CHARACTERISTIC
/begin CHARACTERISTIC LSU_ti1stClb_C "Zeitdauer von SG-Start bis zu erster Kalibrierung CJ120" VALUE 0x8004D934 Val_Wu16 655.3500 Time_s 0.00 655.3500 /end CHARACTERISTIC
/begin CHARACTERISTIC LSU_tiAdapFltIni_C "Schnelle Filterzeitkonstante" VALUE 0x8004D90C Val_Ws32 4294.9672940 TimeDelay_s 0.000002000000001 4294.9672960 FORMAT "%12.7" /end CHARACTERISTIC
/begin CHARACTERISTIC LSU_tiAdapFlt_C "Langsame Filterzeitkonstante" VALUE 0x8004D910 Val_Ws32 4294.9672940 TimeDelay_s 0.000002000000001 4294.9672960 FORMAT "%12.7" /end CHARACTERISTIC
/begin CHARACTERISTIC LSU_tiCldTstActv_C "Verzögerungszeit nach SG-Start bis der kalte Sonde Test für SCB VON IA/IP freigegeben wird." VALUE 0x8004D67E Val_Ws16 655.3500 Time_s -327.6800 327.6700 /end CHARACTERISTIC
/begin CHARACTERISTIC LSU_tiClgLstRun_C "Minimumzeit zwischen aufeinanderfolgenden Fahrzyklen zur Freigabe der Nebenschlusserkennung bei Steuergerätestart" VALUE 0x8004D7B4 Val_Ws32 21474836.4700 Time_s 0.00 21474836.4700 EXTENDED_LIMITS -21474836.4800 21474836.4700 /end CHARACTERISTIC
/begin CHARACTERISTIC LSU_tiDelHtrTst_C "Zeit nach der Rampenfreigabe um dad Bit 3 von LSU_stHtCtl zu setzen" VALUE 0x8004D9CA Val_Ws16 655350.0 Time_ms -327680.0 327670.0 /end CHARACTERISTIC
/begin CHARACTERISTIC LSU_tiDelIniVal_C "Verzögerungszeit zur Abtastung der Anfangsansauglufttemperatur" VALUE 0x8004D9CC Val_Ws16 655350.0 Time_ms -327680.0 327670.0 /end CHARACTERISTIC
/begin CHARACTERISTIC LSU_tiDelO2Clb_C "Verzögerungszeit zur Kalibrierung" VALUE 0x8004D70A Val_Wu16 1000.000 Time_ms 0.00 1000.000 EXTENDED_LIMITS 0.00 655350.0 /end CHARACTERISTIC
/begin CHARACTERISTIC LSU_tiDelO2Val_C "Verzögerungszeit zur normalen Messung" VALUE 0x8004D70C Val_Wu16 1000.000 Time_ms 0.00 1000.000 EXTENDED_LIMITS 0.00 655350.0 /end CHARACTERISTIC
/begin CHARACTERISTIC LSU_tiDelRiClb_C "Verzögerungszeit zur Kalibrierung" VALUE 0x8004D746 Val_Wu16 1000.000 Time_ms 0.00 1000.000 EXTENDED_LIMITS 0.00 655350.0 /end CHARACTERISTIC
/begin CHARACTERISTIC LSU_tiDelRiVal_C "Verzögerungszeit zur normalen Messung" VALUE 0x8004D748 Val_Wu16 1000.000 Time_ms 0.00 1000.000 EXTENDED_LIMITS 0.00 655350.0 /end CHARACTERISTIC
/begin CHARACTERISTIC LSU_tiDlyCmpChkO2_C "Mindestverweildauer im gültigen EGR-Zustand für Freigabe der Differenzprüfung" VALUE 0x8004DAA0 Val_Wu16 655.3500 Time_s 0.00 655.3500 /end CHARACTERISTIC
/begin CHARACTERISTIC LSU_tiDvtFlt_C "Filterzeitkonstante Lambda-1-Erkennung" VALUE 0x8004D680 Val_Ws32 4294.9672940 TimeDelay_s 0.000002000000001 4294.9672960 FORMAT "%12.7" /end CHARACTERISTIC
/begin CHARACTERISTIC LSU_tiEvalFltIni_C "Schnelle Filterzeitkonstante" VALUE 0x8004D914 Val_Ws32 4294.9672940 TimeDelay_s 0.000002000000001 4294.9672960 FORMAT "%12.7" /end CHARACTERISTIC
/begin CHARACTERISTIC LSU_tiEvalFlt_C "Langsame Filterzeitkonstante" VALUE 0x8004D918 Val_Ws32 4294.9672940 TimeDelay_s 0.000002000000001 4294.9672960 FORMAT "%12.7" /end CHARACTERISTIC
/begin CHARACTERISTIC LSU_tiExhPresFlt_C "Filterzeitkonstante für filering der Abgas-Gegendruck an der Lambdasonde-Position, (erforderlich, um O2 SRC Fehler von Max) zu überwachen" VALUE 0x8004D710 Val_Ws32 4294967.2940 TimeDelay_ms 0.0020000000009 4294967.2960 FORMAT "%12.4" /end CHARACTERISTIC
/begin CHARACTERISTIC LSU_tiHtCoupChk_C "Zeitdauer Heizerabschaltung in Diagnose Heizereinkopplung" VALUE 0x8004D7B8 Val_Wu16 655.3500 Time_s 0.00 655.3500 /end CHARACTERISTIC
/begin CHARACTERISTIC LSU_tiHtCoupFltTst_C "Filterzeitkonstante zur Glättung der O2-Spannungsripple in Heizerkopplungsprüfung für Servicetest-Diagnose der LSU" VALUE 0x8004D7BC Val_Ws32 4294967.2940 TimeDelay_ms 0.0020000000009 4294967.2960 FORMAT "%12.4" /end CHARACTERISTIC
/begin CHARACTERISTIC LSU_tiHtCoupFlt_C "Zeitkonstante Glättungsfilter in Diagnose Heizereinkopplung" VALUE 0x8004D7C0 Val_Ws32 4294967.2940 TimeDelay_ms 0.0020000000009 4294967.2960 FORMAT "%12.4" /end CHARACTERISTIC
/begin CHARACTERISTIC LSU_tiHtCoupPerTst_C "Zeitdauer zur Aktivierung der Heizerkopplungsprüfung für Kurzdiagnose der LSU" VALUE 0x8004D7C4 Val_Wu16 655.3500 Time_s 0.00 655.3500 /end CHARACTERISTIC
/begin CHARACTERISTIC LSU_tiHtCoupPer_C "Periodendauer für Aktivierung Diagnose Heizereinkopplung" VALUE 0x8004D7C6 Val_Wu16 655.3500 Time_s 0.00 655.3500 /end CHARACTERISTIC
/begin CHARACTERISTIC LSU_tiIsolChkErr_C "maximale Auskühldauer Lamba-Sonde LSU" VALUE 0x8004D7C8 Val_Wu16 655.3500 Time_s 0.00 655.3500 /end CHARACTERISTIC
/begin CHARACTERISTIC LSU_tiIsolChkPer_C "Periodendauer Einschalten Pumpstrom zur Nebenschlußerkennung" VALUE 0x8004D7CA Val_Wu16 655.3500 Time_s 0.00 655.3500 /end CHARACTERISTIC
/begin CHARACTERISTIC LSU_tiIsolChkPmp_C "Pulsweite zur Aktivierung des Pumpenstroms bei der Nebenschlusserkennung" VALUE 0x8004D7CC Val_Wu16 655.3500 Time_s 0.00 655.3500 /end CHARACTERISTIC
/begin CHARACTERISTIC LSU_tiLmbd1RgnDly_C "Verzögerung nach dem Start der SOx-Regenerierung, um Lambda = 1 Erkennung zu sperren" VALUE 0x8004D684 Val_Ws16 655350.0 Time_ms -327680.0 327670.0 /end CHARACTERISTIC
/begin CHARACTERISTIC LSU_tiMaxDebVirtNernst_C "Entprellzeit für Nernst-Zelle" VALUE 0x8004D686 Val_Ws16 655350.0 Time_ms -327680.0 327670.0 /end CHARACTERISTIC
/begin CHARACTERISTIC LSU_tiO2CalcFltTst_C "Sensorlage spezifische Filterzeitkonstante zur Filterung der berechneten O2-Konzentration, wenn Kurzdiagnose aktiv ist." VAL_BLK 0x8004DAA4 ValA_Ws32 4294.9672940 TimeDelay_s 0.000002000000001 4294.9672960 FORMAT "%12.7" NUMBER 1 /end CHARACTERISTIC
/begin CHARACTERISTIC LSU_tiO2CalcFlt_C "Filterzeitkonstante für berechneten O2-Wert" VAL_BLK 0x8004DAA8 ValA_Ws32 4294.9672940 TimeDelay_s 0.000002000000001 4294.9672960 FORMAT "%12.7" NUMBER 1 /end CHARACTERISTIC
/begin CHARACTERISTIC LSU_tiO2ClbPT1_C "T1 zur Filterung des Kalibrierungswerts" VALUE 0x8004D714 Val_Ws32 4294967.2940 TimeDelay_ms 0.0020000000009 4294967.2960 FORMAT "%12.4" /end CHARACTERISTIC
/begin CHARACTERISTIC LSU_tiO2Clb_C "Kalibrierungszeit" VALUE 0x8004D718 Val_Wu16 100.0000 Time_ms 0.00 100.0000 EXTENDED_LIMITS 0.00 655350.0 /end CHARACTERISTIC
/begin CHARACTERISTIC LSU_tiO2EvalTst_C "Die Dauer für O2-Stationärerzustanderkennung beim Plausibilitätstest, wenn die Kurzdiagnose für LSU aktiviert wurde" VALUE 0x8004DAAC Val_Wu16 655.3500 Time_s 0.00 655.3500 /end CHARACTERISTIC
/begin CHARACTERISTIC LSU_tiO2Eval_C "erforderliche Dauer für O2-Stationärerkennung" VALUE 0x8004DAAE Val_Wu16 655.3500 Time_s 0.00 655.3500 /end CHARACTERISTIC
/begin CHARACTERISTIC LSU_tiO2PT1_C "T1 zur Filterung des O2-Werts" VALUE 0x8004D71C Val_Ws32 4294967.2940 TimeDelay_ms 0.0020000000009 4294967.2960 FORMAT "%12.4" /end CHARACTERISTIC
/begin CHARACTERISTIC LSU_tiO2SRCMinDly_C "Verzögerung nach dem Start der NSC-Regenerierung, um O2-SCR-MIN-Fehlererkennung zu sperren" VALUE 0x8004D720 Val_Ws16 655350.0 Time_ms -327680.0 327670.0 /end CHARACTERISTIC
/begin CHARACTERISTIC LSU_tiOpnLdTstActv_C "Zeitdauer zur Aktivierung des Lastabfalltests für Nernst-Pin und Pin der virtuellen Masse" VALUE 0x8004D688 Val_Ws16 655.3500 Time_s -327.6800 327.6700 /end CHARACTERISTIC
/begin CHARACTERISTIC LSU_tiPerClb_C "Periodendauer CJ120-Kalibrierung" VALUE 0x8004D936 Val_Wu16 655.3500 Time_s 0.00 655.3500 /end CHARACTERISTIC
/begin CHARACTERISTIC LSU_tiPT1FltO2Raw_C "Applizierbare Zeitkonstante der Filterung des O2-Signals" VALUE 0x8004D730 Val_Ws32 4294967.2940 TimeDelay_ms 0.0020000000009 4294967.2960 FORMAT "%12.4" /end CHARACTERISTIC
/begin CHARACTERISTIC LSU_tiPT1FltRiRaw_C "Applizierbare Zeitkonstante der Filterung des Ri-Signals" VALUE 0x8004D734 Val_Ws32 4294967.2940 TimeDelay_ms 0.0020000000009 4294967.2960 FORMAT "%12.4" /end CHARACTERISTIC
/begin CHARACTERISTIC LSU_tiRefPmpHi_C "Dauer des höheren Referenzpumpenstroms" VALUE 0x8004DAC0 Val_Wu16 655350.0 Time_ms 0.00 655350.0 /end CHARACTERISTIC
/begin CHARACTERISTIC LSU_tiRefTransLo_C "Erforderliche Zeit nach dem Übergang von High-Referenzpumpenstrom zu Low-Referenzpumpenstrom" VALUE 0x8004DAC2 Val_Wu16 655350.0 Time_ms 0.00 655350.0 /end CHARACTERISTIC
/begin CHARACTERISTIC LSU_tiRiClbPT1_C "T1 zur Filterung des Kalibrierungswerts" VALUE 0x8004D74C Val_Ws32 4294.9672940 TimeDelay_s 0.000002000000001 4294.9672960 FORMAT "%12.7" /end CHARACTERISTIC
/begin CHARACTERISTIC LSU_tiRiClb_C "Ri-Filterkalibrierungszeit" VALUE 0x8004D750 Val_Wu16 150.0000 Time_ms 0.00 150.0000 EXTENDED_LIMITS 0.00 655350.0 /end CHARACTERISTIC
/begin CHARACTERISTIC LSU_tiRiMeasDisa_C "Zeitdauer zur Ri-Messungsperrung des Lastabfalltests für Nernst-Pin und Pin der virtuellen Masse" VALUE 0x8004D68A Val_Ws16 655.3500 Time_s -327.6800 327.6700 /end CHARACTERISTIC
/begin CHARACTERISTIC LSU_tiRiPT1_C "T1 zur Filterung des Ri-Werts" VALUE 0x8004D754 Val_Ws32 4294.9672940 TimeDelay_s 0.000002000000001 4294.9672960 FORMAT "%12.7" /end CHARACTERISTIC
/begin CHARACTERISTIC LSU_tiSwt_CA "maximal zulässige Werte für Flankenzeit Last->Schub" VAL_BLK 0x8004DAB0 ValA_Wu16 655.3500 Time_s 0.00 655.3500 NUMBER 1 /end CHARACTERISTIC
/begin CHARACTERISTIC LSU_tiWait1_CA "Zeitdauer für Stationärerkennung Dynamiküberwachung" VAL_BLK 0x8004DAB2 ValA_Wu16 655.3500 Time_s 0.00 655.3500 NUMBER 1 /end CHARACTERISTIC
/begin CHARACTERISTIC LSU_tiWait2_CA "maximale Zeitdauer zum Erreichen der oberen O2-Schwelle in Dynamiküberwachung" VAL_BLK 0x8004DAB4 ValA_Wu16 655.3500 Time_s 0.00 655.3500 NUMBER 1 /end CHARACTERISTIC
/begin CHARACTERISTIC LSU_tiWait3_CA "maximale Zeitdauer zum Erreichen der oberen O2-Schwelle in Dynamiküberwachung" VAL_BLK 0x8004DAB6 ValA_Wu16 655.3500 Time_s 0.00 655.3500 NUMBER 1 /end CHARACTERISTIC
/begin CHARACTERISTIC LSU_tLowLim_CUR "Batteriespannung-abhängige Kennlinie zur Berechnung der unteren Grenze des Zeitfensters für einen gültigen Wert der Keramik-Temperatur" CURVE 0x8004D9CE Cur_Xs16Ws16 300.0000 Temp_Cels 499.9600 799.9600 EXTENDED_LIMITS -3549.940 3003.560
 /begin AXIS_DESCR STD_AXIS BattU_u Volt_Batt 5 0.00 15000.00 EXTENDED_LIMITS -655360.0 655340.0 DEPOSIT ABSOLUTE /end AXIS_DESCR
/end CHARACTERISTIC
/begin CHARACTERISTIC LSU_tRiSetP_C "Zielwert für Ri" VALUE 0x8004D9E4 Val_Ws16 1200.000 Temp_Cels 99.96000 1299.960 EXTENDED_LIMITS -3549.940 3003.560 /end CHARACTERISTIC
/begin CHARACTERISTIC LSU_tRi_CUR "Konvertierung des Widerstands in die Temp" CURVE 0x8004D758 Cur_Xs16Ws16 1200.000 Temp_Cels 99.96000 1299.960 EXTENDED_LIMITS -3549.940 3003.560
 /begin AXIS_DESCR STD_AXIS LSU_resRi_mp Resist 16 0.00 3000.000 FORMAT "%8.3" EXTENDED_LIMITS -3276.800 3276.700 DEPOSIT ABSOLUTE /end AXIS_DESCR
/end CHARACTERISTIC
/begin CHARACTERISTIC LSU_tUpLim_CUR "Batteriespannung-abhängige Kennlinie zur Berechnung der oberen Grenze des Zeitfensters für einen gültigen Wert der Keramik-Temperatur" CURVE 0x8004D9E6 Cur_Xs16Ws16 300.0000 Temp_Cels 499.9600 799.9600 EXTENDED_LIMITS -3549.940 3003.560
 /begin AXIS_DESCR STD_AXIS BattU_u Volt_Batt 5 0.00 15000.00 EXTENDED_LIMITS -655360.0 655340.0 DEPOSIT ABSOLUTE /end AXIS_DESCR
/end CHARACTERISTIC
/begin CHARACTERISTIC LSU_uBattMaxHigh_C "Spannung" VALUE 0x8004D6B8 Val_Ws16 680360.0 Volt_Batt -655360.0 25000.00 EXTENDED_LIMITS -655360.0 655340.0 /end CHARACTERISTIC
/begin CHARACTERISTIC LSU_uBattMaxLow_C "Spannung" VALUE 0x8004D6BA Val_Ws16 680360.0 Volt_Batt -655360.0 25000.00 EXTENDED_LIMITS -655360.0 655340.0 /end CHARACTERISTIC
/begin CHARACTERISTIC LSU_uBattMin_C "minimale Batteriespannung" VALUE 0x8004D68C Val_Ws16 12500.00 Volt_Batt -500.0000 12000.00 EXTENDED_LIMITS -655360.0 655340.0 /end CHARACTERISTIC
/begin CHARACTERISTIC LSU_uBattNominal_C "Nominale Batteriespannung = Spannungsschalter wird zur keinen pwm-Korrektur geleitet" VALUE 0x8004D6BC Val_Wu16 16000.00 Volt_Batt 0.00 16000.00 EXTENDED_LIMITS 0.00 1310700. /end CHARACTERISTIC
/begin CHARACTERISTIC LSU_uMinClb_C "Minimalwert zur Erkennung einer niedrigen Batteriespannung" VALUE 0x8004D938 Val_Wu16 16000.00 Volt_Batt 0.00 16000.00 EXTENDED_LIMITS 0.00 1310700. /end CHARACTERISTIC
/begin CHARACTERISTIC LSU_uO2ClbDvtMax_C "Maximaler Begrenzungswert der Spannung für O2-Kalibrierung" VALUE 0x8004D722 Val_Ws16 13107.00 Volt -6553.600 6553.400 /end CHARACTERISTIC
/begin CHARACTERISTIC LSU_uO2ClbDvtMin_C "Minimaler Begrenzungswert der Spannung für O2-Kalibrierung" VALUE 0x8004D724 Val_Ws16 13107.00 Volt -6553.600 6553.400 /end CHARACTERISTIC
/begin CHARACTERISTIC LSU_uO2ClbMax_C "Referenzwert für O2-Kalibrierung" VALUE 0x8004D726 Val_Ws16 13107.00 Volt -6553.600 6553.400 /end CHARACTERISTIC
/begin CHARACTERISTIC LSU_uO2ClbMin_C "Referenzwert für O2-Kalibrierung" VALUE 0x8004D728 Val_Ws16 13107.00 Volt -6553.600 6553.400 /end CHARACTERISTIC
/begin CHARACTERISTIC LSU_uO2MaxGrad_C "maximale U_O2-Änderung für Aktivierung Heizereinkopplungs-Diagnose" VALUE 0x8004D7CE Val_Ws16 13107.00 Volt -6553.600 6553.400 /end CHARACTERISTIC
/begin CHARACTERISTIC LSU_uO2MaxRippel_C "maximal zulässige U_O2-Änderung beim Abschalten des Heizers" VALUE 0x8004D7D0 Val_Ws16 13107.00 Volt -6553.600 6553.400 /end CHARACTERISTIC
/begin CHARACTERISTIC LSU_uO2Max_C "Obere SRC-Grenze für O2-Spannung mit normaler Empfindlichkeit" VALUE 0x8004D72A Val_Ws16 5000.000 Volt 0.00 5000.000 EXTENDED_LIMITS -6553.600 6553.400 /end CHARACTERISTIC
/begin CHARACTERISTIC LSU_uO2Min_C "Untere SRC-Grenze für O2-Spannung mit normaler Empfindlichkeit" VALUE 0x8004D72C Val_Ws16 5000.000 Volt 0.00 5000.000 EXTENDED_LIMITS -6553.600 6553.400 /end CHARACTERISTIC
/begin CHARACTERISTIC LSU_uO2OpnLdNernstMax_C "Maximale Schwelle für Lastabfallfehler des Nernst-Pins" VALUE 0x8004D68E Val_Ws16 5000.000 Volt 0.00 5000.000 EXTENDED_LIMITS -6553.600 6553.400 /end CHARACTERISTIC
/begin CHARACTERISTIC LSU_uO2OpnLdNernstMin_C "Maximale Schwelle für Lastabfallfehler des Nernst-Pins" VALUE 0x8004D690 Val_Ws16 7000.000 Volt -2000.000 5000.000 EXTENDED_LIMITS -6553.600 6553.400 /end CHARACTERISTIC
/begin CHARACTERISTIC LSU_uO2OpnLdVirtGndMax_C "Maximale Schwelle für Lastabfallfehler des Nernst-Pins" VALUE 0x8004D692 Val_Ws16 5100.000 Volt -100.0000 5000.000 EXTENDED_LIMITS -6553.600 6553.400 /end CHARACTERISTIC
/begin CHARACTERISTIC LSU_uO2OpnLdVirtGndMin_C "Maximale Schwelle für Lastabfallfehler des Nernst-Pins" VALUE 0x8004D694 Val_Ws16 5500.000 Volt -500.0000 5000.000 EXTENDED_LIMITS -6553.600 6553.400 /end CHARACTERISTIC
/begin CHARACTERISTIC LSU_uO2Ref_C "Spannung" VALUE 0x8004D72E Val_Ws16 5000.000 Volt 0.00 5000.000 EXTENDED_LIMITS -6553.600 6553.400 /end CHARACTERISTIC
/begin CHARACTERISTIC LSU_uRiOfs_C "Offset-Spannung für Ri = 0" VALUE 0x8004D79A Val_Ws16 5000.000 Volt 0.00 5000.000 EXTENDED_LIMITS -6553.600 6553.400 /end CHARACTERISTIC
/begin CHARACTERISTIC LSU_uRiOpnLdTstMax_C "Minimaler Spannung-Ri-Schwellenwert für Lastabfalltest" VALUE 0x8004D696 Val_Ws16 5200.000 Volt 0.00 5200.000 EXTENDED_LIMITS -6553.600 6553.400 /end CHARACTERISTIC
/begin CHARACTERISTIC LSU_volMinFl_C "Minimales Kraftstoffvolumen im Tank" VALUE 0x8004DAB8 Val_Ws16 300.0000 Fl_Vol_q0p05 0.00 300.0000 FORMAT "%8.4" EXTENDED_LIMITS -1638.400 1638.350 /end CHARACTERISTIC
/begin CHARACTERISTIC S_PMSTRTMOD "Startnkw aufgrund B_sta || Spgseinbruch" VALUE 0x80064E02 Val_Wu8 255. Def_dez_ub_q1 0.00 255. FORMAT "%3.0" /end CHARACTERISTIC
/begin CHARACTERISTIC S_STRTNKWMOD "Schalter N oder Nkw_zahn" VALUE 0x80064E03 Val_Wu8 255. Def_dez_ub_q1 0.00 255. FORMAT "%3.0" /end CHARACTERISTIC
/begin MEASUREMENT Acfzgl "Fahrzeuglängsbeschleunigung" SBYTE Def_ac_sb_q0p25 1 100 -32.0 31.8 FORMAT "%4.1" ECU_ADDRESS 0xC000B2B3 /end MEASUREMENT
/begin MEASUREMENT Acfzgq "Fahrzeugquerbeschleunigung" SBYTE Def_ac_sb_q0p25 1 100 -32.0 31.8 FORMAT "%4.1" ECU_ADDRESS 0xC000B2B4 /end MEASUREMENT
/begin MEASUREMENT Alt_trqDes "" SWORD Trq 1 100 -3276.800 3276.700 ECU_ADDRESS 0xD0000662 /end MEASUREMENT
/begin MEASUREMENT Alt_trqResv "" SWORD Trq 1 100 -3276.800 3276.700 ECU_ADDRESS 0xD0000664 /end MEASUREMENT
/begin MEASUREMENT A_quer_abs "Absolutwert Querbeschleunigung" SWORD Def_a_sw_b64 1 100 -64.0000 63.9980 FORMAT "%7.4" ECU_ADDRESS 0xC000A3AE /end MEASUREMENT
/begin MEASUREMENT Batt_class "Klassifizierung der in diesem Fzg. eingebauten Batterie" UBYTE Def_dez_ub_q1 1 100 0.00 255. FORMAT "%3.0" ECU_ADDRESS 0xC000B2B5 /end MEASUREMENT
/begin MEASUREMENT Bnsctr "Counter" UBYTE Def_dez_ub_q1 1 100 0.00 255. FORMAT "%3.0" ECU_ADDRESS 0xC000B2B6 /end MEASUREMENT
/begin MEASUREMENT Bnsctrant0 "Counter" ULONG Def_dez_ul_q1 1 100 0.00 4294967295. FORMAT "%7.0" ECU_ADDRESS 0xC00090BC /end MEASUREMENT
/begin MEASUREMENT Bnsctrant1 "Counter" UWORD Def_dez_uw_q1 1 100 0.00 65535. FORMAT "%5.0" ECU_ADDRESS 0xC000A3B0 /end MEASUREMENT
/begin MEASUREMENT Bnsctrant2 "Counter" UWORD Def_dez_uw_q1 1 100 0.00 65535. FORMAT "%5.0" ECU_ADDRESS 0xC000A3B2 /end MEASUREMENT
/begin MEASUREMENT Bnsctrant3 "Counter" UWORD Def_dez_uw_q1 1 100 0.00 65535. FORMAT "%5.0" ECU_ADDRESS 0xC000A3B4 /end MEASUREMENT
/begin MEASUREMENT Bordnetz "ausgewähltes Bordnetz(0x01 => CAN11H, 0x02 => CAN12H(BN2000))" UBYTE Def_st_ub_q1 1 100 0.00 255. FORMAT "%3.0" ECU_ADDRESS 0xC000B2B7 /end MEASUREMENT
/begin MEASUREMENT Bosanfsgbd "BOS-Lesen-Anforderung vom Tester: 0 = keine Anforderung 1 = OZ soll senden, wird erst dann zurückgesetzt, wenn Bostoken = 1 8 = PM soll senden, wird erst dann zurückgsetetzt wenn Bostoken = 8" UBYTE Def_dez_ub_q1 1 100 0.00 255. FORMAT "%3.0" ECU_ADDRESS 0xC000B2B8 /end MEASUREMENT
/begin MEASUREMENT Bosbtvfbkt "Verfügbarkeit vom Tester" UBYTE Def_dez_ub_q1 1 100 0.00 255. FORMAT "%3.0" ECU_ADDRESS 0xC000B2B9 /end MEASUREMENT
/begin MEASUREMENT Bosfxid2r "ID_Funktion_BOS_Rückstellung_2" UWORD Def_dez_uw_q1 1 100 0.00 65535. FORMAT "%5.0" ECU_ADDRESS 0xC000A3B6 /end MEASUREMENT
/begin MEASUREMENT Bosid2r "ID_2_BOS_Rückstellung_2" UBYTE Def_dez_ub_q1 1 100 0.00 255. FORMAT "%3.0" ECU_ADDRESS 0xC000B2BA /end MEASUREMENT
/begin MEASUREMENT Bosjzielr "Zieltermin_Jahr_BOS_Rückstellung_2" UBYTE Def_dez_ub_q1 1 100 0.00 255. FORMAT "%3.0" ECU_ADDRESS 0xC000B2BB /end MEASUREMENT
/begin MEASUREMENT Bosjzielt "Zieltermin_Jahr vom Tester" UBYTE Def_dez_ub_q1 1 100 0.00 255. FORMAT "%3.0" ECU_ADDRESS 0xC000B2BC /end MEASUREMENT
/begin MEASUREMENT Bosmzielr "Zieltermin_Monat_BOS_Rückstellung_2" UBYTE Def_dez_ub_q1 1 100 0.00 255. FORMAT "%3.0" ECU_ADDRESS 0xC000B2BD /end MEASUREMENT
/begin MEASUREMENT Bosmzielt "Zieltermin_Monat vom Tester" UBYTE Def_dez_ub_q1 1 100 0.00 255. FORMAT "%3.0" ECU_ADDRESS 0xC000B2BE /end MEASUREMENT
/begin MEASUREMENT Bosprog2r "Prognose_Intervall_Zeit_BOS_Rückstellung_2" UBYTE Def_dez_ub_q1 1 100 0.00 255. FORMAT "%3.0" ECU_ADDRESS 0xC000B2BF /end MEASUREMENT
/begin MEASUREMENT Bosprog2t "Prognose_Intervall_Zeit vom Tester" UBYTE Def_dez_ub_q1 1 100 0.00 255. FORMAT "%3.0" ECU_ADDRESS 0xC000B2C0 /end MEASUREMENT
/begin MEASUREMENT Bosrlsmr "Restlaufleistung vom Kombi" SWORD Def_dez_sw_q1 1 100 -32768. 32767. FORMAT "%5.0" ECU_ADDRESS 0xC000A3B8 /end MEASUREMENT
/begin MEASUREMENT Bosrlsmt "Restlaufstrecke vom Tester" SWORD Def_dez_sw_q1 1 100 -32768. 32767. FORMAT "%5.0" ECU_ADDRESS 0xC000A3BA /end MEASUREMENT
/begin MEASUREMENT Bosrw2r "Prognose_Intervall_Weg_BOS_Rückstellung_2" UBYTE Def_km_ub_q1000 1 100 0.00 255000. FORMAT "%3.0" ECU_ADDRESS 0xC000B2C1 /end MEASUREMENT
/begin MEASUREMENT Bosrw2t "Prognose_Intervall_Weg vom Tester" UBYTE Def_km_ub_q1000 1 100 0.00 255000. FORMAT "%3.0" ECU_ADDRESS 0xC000B2C2 /end MEASUREMENT
/begin MEASUREMENT Bosun "Einheit für Bosrlsmr" UBYTE Def_dez_ub_q1 1 100 0.00 255. FORMAT "%3.0" ECU_ADDRESS 0xC000B2C3 /end MEASUREMENT
/begin MEASUREMENT Bosunt "Einheit für Bosrlsmt" UBYTE Def_dez_ub_q1 1 100 0.00 255. FORMAT "%3.0" ECU_ADDRESS 0xC000B2C4 /end MEASUREMENT
/begin MEASUREMENT Bosv "Verfügbarkeit vom Kombi" UBYTE Def_dez_ub_q1 1 100 0.00 255. FORMAT "%3.0" ECU_ADDRESS 0xC000B2C5 /end MEASUREMENT
/begin MEASUREMENT Bsdcontrol "3 Byte Schnittstelle für kt_ibs" UBYTE Def_dez_ub_q1 1 100 0.00 255. FORMAT "%3.0" ECU_ADDRESS 0xC000B2C6 /end MEASUREMENT
/begin MEASUREMENT Bsddata "3 Byte Schnittstelle kt_ibs" UBYTE Def_dez_ub_q1 1 100 0.00 255. FORMAT "%3.0" ECU_ADDRESS 0xC000B2C7 /end MEASUREMENT
/begin MEASUREMENT Bsdgencv "Chipversion Generator 1" UBYTE Def_st_ub_q1 1 100 0.00 255. FORMAT "%3.0" ECU_ADDRESS 0xC000B2C8 /end MEASUREMENT
/begin MEASUREMENT Bsdgenregv "Reglerversion Generator 1" UBYTE Def_st_ub_q1 1 100 0.00 255. FORMAT "%3.0" ECU_ADDRESS 0xC000B2C9 /end MEASUREMENT
/begin MEASUREMENT Bsdregadr "3 Byte Schnittstelle für kt_ibs" UBYTE Def_dez_ub_q1 1 100 0.00 255. FORMAT "%3.0" ECU_ADDRESS 0xC000B2CA /end MEASUREMENT
/begin MEASUREMENT CoVeh_trqDesComp "Zu kompensierendes Verlustmoment" SWORD Trq 1 100 -3276.800 3276.700 ECU_ADDRESS 0xD000074E /end MEASUREMENT
/begin MEASUREMENT CoVeh_trqResv "Zu kompensierende Momentenreserve" SWORD Trq 1 100 -3276.800 3276.700 ECU_ADDRESS 0xD0000750 /end MEASUREMENT
/begin MEASUREMENT CW_NA "Codewort Nebenaggregate" UBYTE Def_dez_ub_q1 1 100 0.00 255. FORMAT "%3.0" ECU_ADDRESS 0xC000B2CB /end MEASUREMENT
/begin MEASUREMENT Dffgen "ss_msv.dat" UBYTE Def_f_ub_b100 1 100 0.00 99.61 ECU_ADDRESS 0xC000B34A /end MEASUREMENT
/begin MEASUREMENT Dfgrob "Grobwert Auslastungsgrad Generator 1" UBYTE Def_st_ub_q1 1 100 0.00 255. FORMAT "%3.0" ECU_ADDRESS 0xC000B2CC /end MEASUREMENT
/begin MEASUREMENT Dfh_nekpfilt "Drehzahl EKP filtriert" SWORD Def_n_sw_q1p0 1 100 -32768. 32767. FORMAT "%5.0" ECU_ADDRESS 0xC000A3BC /end MEASUREMENT
/begin MEASUREMENT Dfpropval "Verhältnis ierr zu dfsiggen für Generator-dffgen-Berechnung" UWORD Def_f_uw_b32 1 100 0.00 31.999512 FORMAT "%9.6" ECU_ADDRESS 0xC000A488 /end MEASUREMENT
/begin MEASUREMENT Dfsiggen "Auslastungsgrad Generator 1" UBYTE Def_f_ub_b100 1 100 0.00 99.61 ECU_ADDRESS 0xC000B2CD /end MEASUREMENT
/begin MEASUREMENT Dpfregst "--" ULONG Def_dez_ul_q1 1 100 0.00 4294967295. FORMAT "%7.0" ECU_ADDRESS 0xC00090C0 /end MEASUREMENT
/begin MEASUREMENT Dzw_krann_vl "Klopfregeladaptionswert unter Vollastbedingungen" SWORD Def_zw_sw_q0p1 1 100 -50.000 60.000 ECU_ADDRESS 0xC000A3BE /end MEASUREMENT
/begin MEASUREMENT Dzw_mkr "Mittlere Spätstellung Klopfregelung" SWORD Def_zw_sw_q0p1 1 100 -50.000 60.000 ECU_ADDRESS 0xC000A3C0 /end MEASUREMENT
/begin MEASUREMENT Eco_max_i "Max. Ruhestromschwelle" UBYTE Def_i_ub_q0p00125 1 100 0.00 0.31875 FORMAT "%7.5" ECU_ADDRESS 0xC000B2CE /end MEASUREMENT
/begin MEASUREMENT Eco_msb "Ecos Messtartbedingung" UBYTE Def_td_ub_q0p05 1 100 0.00 12.75 FORMAT "%5.2" ECU_ADDRESS 0xC000B2CF /end MEASUREMENT
/begin MEASUREMENT Eco_mz "Dauer Mittelwertmessung" UBYTE Def_td_ub_q0p05 1 100 0.00 12.75 FORMAT "%5.2" ECU_ADDRESS 0xC000B2D0 /end MEASUREMENT
/begin MEASUREMENT Eco_timo "Ecos Messung Timeout" UBYTE Def_td_ub_q1 1 100 0.00 255.0 FORMAT "%5.1" ECU_ADDRESS 0xC000B2D1 /end MEASUREMENT
/begin MEASUREMENT Fahrzeug "Fahrzeugtypbezeichnung (E60 = 60, E65 = 65, E46 = 46, E70 = 70)" UBYTE Def_dez_ub_q1 1 100 0.00 255. FORMAT "%3.0" ECU_ADDRESS 0xC000B2D2 /end MEASUREMENT
/begin MEASUREMENT Fakf "Beladung des Aktivkohlefilters" SWORD Def_f_sw_b100 1 100 -100.0000 99.99695 FORMAT "%8.4" ECU_ADDRESS 0xC000A3C2 /end MEASUREMENT
/begin MEASUREMENT Fetrawe "Implementierung Fertigungs-, Transport- und Werkstattmodus mit Tester auslesen" UBYTE Def_dez_ub_q1 1 100 0.00 255. FORMAT "%3.0" ECU_ADDRESS 0xC000B2D3 /end MEASUREMENT
/begin MEASUREMENT Fho "Korrekturfaktor Höhe" UWORD Def_f_uw_b2 1 100 0.00 1.999908447266 FORMAT "%14.12" ECU_ADDRESS 0xC000A3C4 /end MEASUREMENT
/begin MEASUREMENT Fid_manhydr "Funktionsidentifier Mandetek Hydraulikpfad" UBYTE Def_dez_ub_q1 1 100 0.00 255. FORMAT "%3.0" ECU_ADDRESS 0xC000B2D4 /end MEASUREMENT
/begin MEASUREMENT Fid_manluft "Funktionsidentifier Mandetek Luftpfad" UBYTE Def_dez_ub_q1 1 100 0.00 255. FORMAT "%3.0" ECU_ADDRESS 0xC000B2D5 /end MEASUREMENT
/begin MEASUREMENT Flashdurin "Anforderung Dauer Flashen" UWORD Def_dez_uw_q1 1 100 0.00 65535. FORMAT "%5.0" ECU_ADDRESS 0xC000A3C6 /end MEASUREMENT
/begin MEASUREMENT Flashstatin "Flashstatus der von der Flashkonsole geschickt wird" UBYTE Def_dez_ub_q1 1 100 0.00 255. FORMAT "%3.0" ECU_ADDRESS 0xC000B2D6 /end MEASUREMENT
/begin MEASUREMENT F_md_fhot "Korrekturfaktor für Moment/Füllung aus Höhe und Temperatur" UWORD Def_f_uw_b2 1 100 0.00 1.999908447266 FORMAT "%14.12" ECU_ADDRESS 0xC000A3C8 /end MEASUREMENT
/begin MEASUREMENT Gangi "Aktueller Gang intern" UBYTE Def_dez_ub_q1 1 100 0.00 255. FORMAT "%3.0" ECU_ADDRESS 0xC000B2D7 /end MEASUREMENT
/begin MEASUREMENT Gangi_entpr "Entprellter Gang" UBYTE Def_dez_ub_q1 1 100 0.00 255. FORMAT "%3.0" ECU_ADDRESS 0xC000B2D8 /end MEASUREMENT
/begin MEASUREMENT Gen_manufak "Herstellercode Generator 1" UBYTE Def_st_ub_q1 1 100 0.00 255. FORMAT "%3.0" ECU_ADDRESS 0xC000B2D9 /end MEASUREMENT
/begin MEASUREMENT Gen_typkenn "Kennung Generatortyp Generator 1" UBYTE Def_st_ub_q1 1 100 0.00 255. FORMAT "%3.0" ECU_ADDRESS 0xC000B2DA /end MEASUREMENT
/begin MEASUREMENT Ibsl_status "IBS status" UBYTE Def_dez_ub_q1 1 100 0.00 255. FORMAT "%3.0" ECU_ADDRESS 0xC000B2DB /end MEASUREMENT
/begin MEASUREMENT Id_bosrst "Kennung vom Tester für Ölservice" UBYTE Def_dez_ub_q1 1 100 0.00 255. FORMAT "%3.0" ECU_ADDRESS 0xC000B2DC /end MEASUREMENT
/begin MEASUREMENT Id_bosrtt "ID f. BOS-Reset v. Tester" UBYTE Def_dez_ub_q1 1 100 0.00 255. FORMAT "%3.0" ECU_ADDRESS 0xC000B2DD /end MEASUREMENT
/begin MEASUREMENT Id_bosrtw "ID f. Motoröl v. Kombi" UWORD Def_dez_uw_q1 1 100 0.00 65535. FORMAT "%5.0" ECU_ADDRESS 0xC000A3CA /end MEASUREMENT
/begin MEASUREMENT Iekp "Strom EKP" UBYTE Def_i_ub_q0p1 1 100 0.00 25.5 FORMAT "%4.1" ECU_ADDRESS 0xC000B2DE /end MEASUREMENT
/begin MEASUREMENT Ierr "Erregerstrom Generator 1" UBYTE Def_i_ub_q0p125 1 100 0.00 31.875 ECU_ADDRESS 0xC000B2DF /end MEASUREMENT
/begin MEASUREMENT Ierrfgrenz "Kopie begrenzter Erregerstrom Generator 1" UBYTE Def_i_ub_q0p125 1 100 0.00 31.875 ECU_ADDRESS 0xC000B2E0 /end MEASUREMENT
/begin MEASUREMENT Ierr_fil "Gefilterter Erregerstrom" UBYTE Def_i_ub_q0p125 1 100 0.00 31.875 ECU_ADDRESS 0xC000B34B /end MEASUREMENT
/begin MEASUREMENT Ierr_grenz_ext "Grenzerregerstrom vom Tester" UBYTE Def_i_ub_q0p125 1 100 0.00 31.875 ECU_ADDRESS 0xC000B2E1 /end MEASUREMENT
/begin MEASUREMENT Ikurz_ogr "obere Grenze Kurzschlussstrom vom CAS" UBYTE Def_i_ub_q10 1 100 0.00 2550. FORMAT "%5.0" ECU_ADDRESS 0xC000B2E2 /end MEASUREMENT
/begin MEASUREMENT Ikurz_ugr "untere Grenze Kurzschlussstrom vom CAS" UBYTE Def_i_ub_q10 1 100 0.00 2550. FORMAT "%5.0" ECU_ADDRESS 0xC000B2E3 /end MEASUREMENT
/begin MEASUREMENT IVPlaus_cntSegDwnRunUpTst "Segmentanzahl für die Abfalllphase des Hochlauftests" UWORD OneToOne 1 100 0.00 65535.00 ECU_ADDRESS 0xD00015D6 /end MEASUREMENT
/begin MEASUREMENT IVPlaus_cntSegUpRunUpTst "Segmentanzahl für die Hochlaufphase des Hochlauftests" UWORD OneToOne 1 100 0.00 65535.00 ECU_ADDRESS 0xD00015D8 /end MEASUREMENT
/begin MEASUREMENT IVPlaus_cntSeg_mp "Messpunkt des Segmentzählers des Hochlauftests" UWORD OneToOne 1 100 0.00 65535.00 ECU_ADDRESS 0xC000A392 /end MEASUREMENT
/begin MEASUREMENT IVPlaus_nHiDwnRunUpTst "Drehzahl zu Begin der Herablaufphase des Hochlauftests" SWORD EngN 1 100 -16384.00 16383.50 ECU_ADDRESS 0xD0000CB4 /end MEASUREMENT
/begin MEASUREMENT IVPlaus_nHiUpRunUpTst "Drehzahl am Ende der Hochlaufphase des Hochlauftests" SWORD EngN 1 100 -16384.00 16383.50 ECU_ADDRESS 0xD0000CB6 /end MEASUREMENT
/begin MEASUREMENT IVPlaus_nLoDwnRunUpTst "Drehzahl am Ende der Herablaufphase des Hochlauftests" SWORD EngN 1 100 -16384.00 16383.50 ECU_ADDRESS 0xD0000CB8 /end MEASUREMENT
/begin MEASUREMENT IVPlaus_nLoUpRunUpTst "Drehzahl zu Begin der Hochlaufphase des Hochlauftests" SWORD EngN 1 100 -16384.00 16383.50 ECU_ADDRESS 0xD0000CBA /end MEASUREMENT
/begin MEASUREMENT IVPlaus_nMinRunUpTst "minimale Motordrehzahl für die Freigabe des Hochlauftests" SWORD EngN 1 100 -16384.00 16383.50 ECU_ADDRESS 0xD0000CBE /end MEASUREMENT
/begin MEASUREMENT IVPlaus_nStrtRunUpTst "Drehzahlschwelle ab der die Hochlaufphase des Hochlauftests gestartet wird" SWORD EngN 1 100 -16384.00 16383.50 ECU_ADDRESS 0xD0000CC0 /end MEASUREMENT
/begin MEASUREMENT IVPlaus_numShOffCyl "Nummer des abzuschaltenden Zylinders" UBYTE OneToOne 1 100 0.00 255.0 ECU_ADDRESS 0xD0001EF8 /end MEASUREMENT
/begin MEASUREMENT IVPlaus_phiMI1DesRunUpTst "gewünschte SOE winkelbasiert der 1ten Haupteinspritzung während des Hochlauftests" SWORD AngleCrS 1 100 -720.0000 719.9780 ECU_ADDRESS 0xD0000CC4 /end MEASUREMENT
/begin MEASUREMENT IVPlaus_phiPiI1DesRunUpTst "gewünschte SOE winkelbasiert der 1ten Voreinspritzung während des Hochlauftests" SWORD AngleCrS 1 100 -720.0000 719.9780 ECU_ADDRESS 0xD0000CC6 /end MEASUREMENT
/begin MEASUREMENT IVPlaus_phiPiI2DesRunUpTst "gewünschte SOE winkelbasiert der 2ten Voreinspritzung während des Hochlauftests" SWORD AngleCrS 1 100 -720.0000 719.9780 ECU_ADDRESS 0xD0000CC8 /end MEASUREMENT
/begin MEASUREMENT IVPlaus_pSetPntRunUpTst "Raildruck während des Hochlauftests" SWORD Pres_Rail 1 100 -3276.800 2000.000 ECU_ADDRESS 0xD0000CC2 /end MEASUREMENT
/begin MEASUREMENT IVPlaus_qPiI1DesRunUpTst "gewünschte Einspritzmenge der 1ten Voreinspritzung während des Hochlauftests" SWORD InjMassInj 1 100 -327.6800 327.6700 ECU_ADDRESS 0xD0000CDE /end MEASUREMENT
/begin MEASUREMENT IVPlaus_qPiI2DesRunUpTst "gewünschte Einspritzmenge der 2ten Voreinspritzung während des Hochlauftests" SWORD InjMassInj 1 100 -327.6800 327.6700 ECU_ADDRESS 0xD0000CE0 /end MEASUREMENT
/begin MEASUREMENT IVPlaus_qSetUnBalRunUpTst "Einspritzmenge ohne Mengenausgleich während des Hochlauftests" SWORD InjMassCyc 1 100 -327.6800 327.6700 ECU_ADDRESS 0xD0000CE2 /end MEASUREMENT
/begin MEASUREMENT IVPlaus_rEGRVlvRunUpTst_mp "Messpunkt für das Ausgabeverhältnis an das EGR während des Hochlauftests" SWORD DtyCyc 1 100 -327.6800 327.6700 ECU_ADDRESS 0xC000A394 /end MEASUREMENT
/begin MEASUREMENT IVPlaus_rThrVlvRunUpTst_mp "Messpunkt für das Ausgabeverhältnis an die Drosselklappe während des Hochlauftests" SWORD DtyCyc 1 100 -327.6800 327.6700 ECU_ADDRESS 0xC000A396 /end MEASUREMENT
/begin MEASUREMENT IVPlaus_rTrbChRunUpTst_mp "Messpunkt für das Ausgabeverhältnis an den Turbo während des Hochlauftests" SWORD DtyCyc 1 100 -327.6800 327.6700 ECU_ADDRESS 0xC000A398 /end MEASUREMENT
/begin MEASUREMENT IVPlaus_stEffectRunUpTst "Bitleiste für den Eingriff in andere Module während des Hochlauftests" UWORD OneToOne 1 100 0.00 65535.00 ECU_ADDRESS 0xD00015DA /end MEASUREMENT
/begin MEASUREMENT IVPlaus_stInjCharRunUpTst "status der Einspritzcharakteristik während des Hochlauftests" UBYTE OneToOne 1 100 0.00 255.0 ECU_ADDRESS 0xD0001EFA /end MEASUREMENT
/begin MEASUREMENT IVPlaus_stModeRunUpTst_mp "zeigt den aktuellen Modus des Hochlauftests an (0:bisheriger Test 1:neuer Test)" UBYTE OneToOne 1 100 0.00 255.0 ECU_ADDRESS 0xC000B2AF /end MEASUREMENT
/begin MEASUREMENT IVPlaus_stRefRunUpTst "Status bei Abbruch des Hochlauftests" UWORD OneToOne 1 100 0.00 65535.00 ECU_ADDRESS 0xD00015DE /end MEASUREMENT
/begin MEASUREMENT IVPlaus_stStMRunUpTst "Zustand des Zustandsautomaten des Hochlauftests" UBYTE OneToOne 1 100 0.00 255.0 ECU_ADDRESS 0xD0001EFC /end MEASUREMENT
/begin MEASUREMENT IVPlaus_swtSrcPSRunUpTst_mp "Messpunkt für die Anzeige aus welcher Quelle die Parameter für den Hochlauftest entnommen werden" UBYTE OneToOne 1 100 0.00 255.0 ECU_ADDRESS 0xC000B2B0 /end MEASUREMENT
/begin MEASUREMENT IVPlaus_tiDwnRunUpTst "Zeit für die Herablaufphase des Hochlauftests" ULONG InjTime_us 1 100 0.00 5000.00 ECU_ADDRESS 0xD00031F4 /end MEASUREMENT
/begin MEASUREMENT IVPlaus_tiEvalRunUpTst_mp "Messpunkt für die Anzeige der verstrichenen Zeit während des Hochlauftests" SLONG Time_ms 1 100 -21474836480.0 21474836470.0 ECU_ADDRESS 0xC00090B8 /end MEASUREMENT
/begin MEASUREMENT IVPlaus_tiPiI1DesRunUpTst "gewünschte Ansteuerzeit der Voreinspritzung 1 während des Hochlauftests" SWORD InjTime_us 1 100 -13107.20 5000.00 ECU_ADDRESS 0xD0000CE4 /end MEASUREMENT
/begin MEASUREMENT IVPlaus_tiPiI2DesRunUpTst "gewünschte Ansteuerzeit der Voreinspritzung 2 während des Hochlauftests" SWORD InjTime_us 1 100 -13107.20 5000.00 ECU_ADDRESS 0xD0000CE6 /end MEASUREMENT
/begin MEASUREMENT IVPlaus_tiUpRunUpTst "Zeit für die Hochlaufphase des Hochlauftests" ULONG InjTime_us 1 100 0.00 5000.00 ECU_ADDRESS 0xD00031F8 /end MEASUREMENT
/begin MEASUREMENT IVPlaus_tiWaitRunUpTst_mp "Messpunkt für die Wartezeit bis sich der für den Hochlauftest vorgegebene Raildruck eingeschwungen hat" SWORD Time_ms 1 100 -327680.0 327670.0 ECU_ADDRESS 0xC000A39A /end MEASUREMENT
/begin MEASUREMENT IVPSIC_stIntegAdjRet "Rückgeben Status des Integratorabgleichs" UBYTE OneToOne 1 100 0.00 255.0 ARRAY_SIZE 1 ECU_ADDRESS 0xD0001EE6 /end MEASUREMENT
/begin MEASUREMENT IVPSIC_stIntegAdjStM "Status des Statmachine des integratorabgleichs" UBYTE OneToOne 1 100 0.00 255.0 ECU_ADDRESS 0xD0001EE7 /end MEASUREMENT
/begin MEASUREMENT IVPSIC_stIntegAdjVld "Gültigstatus des Integratorabgleichs" UBYTE OneToOne 1 100 0.00 255.0 ARRAY_SIZE 1 ECU_ADDRESS 0xD0001EE8 /end MEASUREMENT
/begin MEASUREMENT IVPSIC_tiIntegAdj "Zeitstempel des Integratorabgleichs" ULONG Time_PzoMeas 1 100 0.00 234505214.307 FORMAT "%13.3" ARRAY_SIZE 1 ECU_ADDRESS 0xD00031EC /end MEASUREMENT
/begin MEASUREMENT IVPSIC_tiIntegRC "RC Zeitkonstant für Ladungsmessung" SWORD InjTime_us 1 100 -13107.20 5000.00 ARRAY_SIZE 1 ECU_ADDRESS 0xD0000C9E /end MEASUREMENT
/begin MEASUREMENT IVPSIC_uIntegOfs "Offset-Spannung des Integrators" SWORD Volt 1 100 -6553.600 6553.400 ARRAY_SIZE 1 ECU_ADDRESS 0xD0000CA0 /end MEASUREMENT
/begin MEASUREMENT IVPSIC_uIntegWrkPnt "Arbeitpunktspannung des Integrators" SWORD Volt 1 100 -6553.600 6553.400 ARRAY_SIZE 1 ECU_ADDRESS 0xD0000CA2 /end MEASUREMENT
/begin MEASUREMENT IVPSIC_uRawIntegClb_mp "Rohwerte der Eichspannung des Integrators" SWORD Volt 1 100 -6553.600 6553.400 ARRAY_SIZE 1 ECU_ADDRESS 0xC000C2F6 /end MEASUREMENT
/begin MEASUREMENT IVPSIC_uRawIntegLin_mp "Angangspunkt der Applikationskennlinie" SWORD Volt 1 100 -6553.600 6553.400 ECU_ADDRESS 0xC000A39C /end MEASUREMENT
/begin MEASUREMENT IVPSIC_uRawIntegWrkPnt_mp "Rohwerte des Arbeitspunkt des Integrators" SWORD Volt 1 100 -6553.600 6553.400 ARRAY_SIZE 1 ECU_ADDRESS 0xC000C2F8 /end MEASUREMENT
/begin MEASUREMENT IVPSIC_uRawIntegZr_mp "Rohwerte des Nullstromniveau des Integrators" SWORD Volt 1 100 -6553.600 6553.400 ARRAY_SIZE 1 ECU_ADDRESS 0xC000C2FA /end MEASUREMENT
/begin MEASUREMENT IVPSply_ctIntrBufMeas "Anzahl Interrups des gemessenen Einspritztyps zwischen Start und Auswertung der Bufferspannungsmessung" UBYTE OneToOne 1 100 0.00 255.0 ARRAY_SIZE 6 ECU_ADDRESS 0xD0001EE9 /end MEASUREMENT
/begin MEASUREMENT IVPSply_stBufErr "Zustand: Bufferkondensator der bank nicht geladen (bitcodiert)" UBYTE OneToOne 1 100 0.00 255.0 ECU_ADDRESS 0xD0001EEF /end MEASUREMENT
/begin MEASUREMENT IVPSply_stDCDCCo "Zustand: Laden der DC/DC-Wandler" UBYTE OneToOne 1 100 0.00 255.0 ECU_ADDRESS 0xD0001EF0 /end MEASUREMENT
/begin MEASUREMENT IVPSply_stGetBufVltg "Status der Bufferspannungsmessung" UBYTE OneToOne 1 100 0.00 255.0 ARRAY_SIZE 6 ECU_ADDRESS 0xD0001EF1 /end MEASUREMENT
/begin MEASUREMENT IVPSply_stUBuf "Bufferspannungs-Status" UBYTE OneToOne 1 100 0.00 255.0 ARRAY_SIZE 1 ECU_ADDRESS 0xD0001EF7 /end MEASUREMENT
/begin MEASUREMENT IVPSply_tiBufMeasCurr "Zeitstempel der aktuellen Bufferspannungsmessung" ULONG Time_PzoMeas 1 100 0.00 234505214.307 FORMAT "%13.3" ARRAY_SIZE 1 ECU_ADDRESS 0xD00031F0 /end MEASUREMENT
/begin MEASUREMENT IVPSply_tiDCDCChrg_mp "Gemessene Ladezeit der Bufferkondensatoren" SWORD Time_ms 1 100 -327680.0 327670.0 ECU_ADDRESS 0xC000A3A0 /end MEASUREMENT
/begin MEASUREMENT IVPSply_uBuf "Bufferspannung" SWORD Vltg_PA 1 100 -327.6800 327.6700 ARRAY_SIZE 1 ECU_ADDRESS 0xD0000CA4 /end MEASUREMENT
/begin MEASUREMENT IVPSply_uBufRaw_mp "ADC Bufferspannungs-Rohwert für IVPSply_uBufLin_CUR" SWORD Volt 1 100 -6553.600 6553.400 ECU_ADDRESS 0xC000A39E /end MEASUREMENT
/begin MEASUREMENT Iwakeupgr "Fahrzeugspezifischer Ruhestrom" UBYTE Def_i_ub_q0p001 1 100 0.00 0.25500 FORMAT "%7.5" ECU_ADDRESS 0xC000B2E4 /end MEASUREMENT
/begin MEASUREMENT I_ha "Übersetzung Hinterachse" UWORD Def_f_uw_b64 1 100 0.00 63.999023 ECU_ADDRESS 0xC000A3CC /end MEASUREMENT
/begin MEASUREMENT I_ibsl "Batteriestrom von IBS" UWORD Def_i_uw_q0p02o200 1 100 -200.0000 1110.700 FORMAT "%8.3" ECU_ADDRESS 0xC000A3CE /end MEASUREMENT
/begin MEASUREMENT I_pregelv "Strom Raildruckregelventil" SWORD Def_i_sw_q0p001 1 100 -32.76800 32.76700 FORMAT "%8.5" ECU_ADDRESS 0xC000A3D0 /end MEASUREMENT
/begin MEASUREMENT I_zme "Strom Zumesseinheit" SWORD Def_i_sw_q0p001 1 100 -32.76800 32.76700 FORMAT "%8.5" ECU_ADDRESS 0xC000A3D2 /end MEASUREMENT
/begin MEASUREMENT Km_st "Kilometerstand" UWORD Def_km_uw_q10 1 100 0.00 655350. FORMAT "%5.0" ECU_ADDRESS 0xC000A3D4 /end MEASUREMENT
/begin MEASUREMENT Km_st_1 "Wegstrecke_km auf 1km genau" ULONG Def_dez_ul_q1 1 100 0.00 4294967295. FORMAT "%7.0" ECU_ADDRESS 0xC00090C4 /end MEASUREMENT
/begin MEASUREMENT Kvaverbr "Kraftstoffverbrauch" UWORD Def_dez_uw_q1 1 100 0.00 65535. FORMAT "%5.0" ECU_ADDRESS 0xC000A3D6 /end MEASUREMENT
/begin MEASUREMENT LayerDiag_FltMng_errMask_mp "" UBYTE OneToOne 1 100 0.00 255.0 ECU_ADDRESS 0xC000B2B1 /end MEASUREMENT
/begin MEASUREMENT LayerDiag_FltMng_FIdxEdPermission_mp "" UWORD OneToOne 1 100 0.00 65535.00 ECU_ADDRESS 0xC000A3A2 /end MEASUREMENT
/begin MEASUREMENT LayerDiag_FltMng_FIdxEdReport_mp "" UWORD OneToOne 1 100 0.00 65535.00 ECU_ADDRESS 0xC000A3A4 /end MEASUREMENT
/begin MEASUREMENT LayerDiag_FltMng_FIdxEdStatus_mp "" UWORD OneToOne 1 100 0.00 65535.00 ECU_ADDRESS 0xC000A3A6 /end MEASUREMENT
/begin MEASUREMENT LayerDiag_FltMng_retValEdPermission_mp "" UBYTE OneToOne 1 100 0.00 255.0 ECU_ADDRESS 0xC000B2B2 /end MEASUREMENT
/begin MEASUREMENT LayerDiag_FltMng_stEdPermission_mp "" UWORD OneToOne 1 100 0.00 65535.00 ECU_ADDRESS 0xC000A3A8 /end MEASUREMENT
/begin MEASUREMENT LayerDiag_FltMng_stEdReport_mp "" UWORD OneToOne 1 100 0.00 65535.00 ECU_ADDRESS 0xC000A3AA /end MEASUREMENT
/begin MEASUREMENT LayerDiag_FltMng_stEdStatus_mp "" UWORD OneToOne 1 100 0.00 65535.00 ECU_ADDRESS 0xC000A3AC /end MEASUREMENT
/begin MEASUREMENT Layer_bRecMSA "" UBYTE OneToOne 1 100 0.00 255.0 ECU_ADDRESS 0xD0001F5B /end MEASUREMENT
/begin MEASUREMENT Layer_ctBOS "" UBYTE OneToOne 1 100 0.00 255.0 ECU_ADDRESS 0xD0001F5C /end MEASUREMENT
/begin MEASUREMENT Layer_dAnz "" UBYTE OneToOne 1 100 0.00 255.0 ECU_ADDRESS 0xD0001F5D /end MEASUREMENT
/begin MEASUREMENT Layer_dIntrvTimeBOS2 "" UBYTE OneToOne 1 100 0.00 255.0 ECU_ADDRESS 0xD0001F5E /end MEASUREMENT
/begin MEASUREMENT Layer_dMonthBOS2 "" UBYTE OneToOne 1 100 0.00 255.0 ECU_ADDRESS 0xD0001F5F /end MEASUREMENT
/begin MEASUREMENT Layer_dRmnMlgBOS "" SWORD OneToOne 1 100 -32768.00 32767.00 ECU_ADDRESS 0xD00010A4 /end MEASUREMENT
/begin MEASUREMENT Layer_dvolLPCOut "" SWORD FlConsum_l_h 1 100 -327.6800 327.6700 FORMAT "%8.4" ECU_ADDRESS 0xD00010A6 /end MEASUREMENT
/begin MEASUREMENT Layer_dYearBOS2 "" UBYTE OneToOne 1 100 0.00 255.0 ECU_ADDRESS 0xD0001F60 /end MEASUREMENT
/begin MEASUREMENT Layer_facFrcCBS "" SWORD Prc 1 100 -400.0000 399.9878 ECU_ADDRESS 0xD00010A8 /end MEASUREMENT
/begin MEASUREMENT Layer_idBOS "" UWORD OneToOne 1 100 0.00 65535.00 ECU_ADDRESS 0xD00015F0 /end MEASUREMENT
/begin MEASUREMENT Layer_idBOS2 "" UWORD OneToOne 1 100 0.00 65535.00 ECU_ADDRESS 0xD00015EE /end MEASUREMENT
/begin MEASUREMENT Layer_lIntrvWayBOS2 "" SWORD OneToOne_km 1 100 -32768.00 32767.00 FORMAT "%8.2" ECU_ADDRESS 0xD00010AC /end MEASUREMENT
/begin MEASUREMENT Layer_lRwAnz "" SWORD km_sw_q10 1 100 -327680.0 327670.0 FORMAT "%8.1" ECU_ADDRESS 0xD00010AE /end MEASUREMENT
/begin MEASUREMENT Layer_lRwKvb "" SWORD km_sw_q10 1 100 -327680.0 327670.0 FORMAT "%8.1" ECU_ADDRESS 0xD00010B0 /end MEASUREMENT
/begin MEASUREMENT Layer_lRwProg "" UWORD km_sw_q10 1 100 0.00 655350.0 FORMAT "%8.1" ECU_ADDRESS 0xD00015F2 /end MEASUREMENT
/begin MEASUREMENT Layer_nStart "" SWORD EngN 1 100 -16384.00 16383.50 ECU_ADDRESS 0xD00010B2 /end MEASUREMENT
/begin MEASUREMENT Layer_numBattCond "" SBYTE OneToOne 1 100 -128.0 127.0 ECU_ADDRESS 0xD0001BCC /end MEASUREMENT
/begin MEASUREMENT Layer_numGearDsplTar "" UBYTE OneToOne 1 100 0.00 255.0 ECU_ADDRESS 0xD0001F91 /end MEASUREMENT
/begin MEASUREMENT Layer_qKvbmw "" ULONG Fuel_Cons 1 100 0.00 524287.999878 FORMAT "%13.6" ECU_ADDRESS 0xD0003238 /end MEASUREMENT
/begin MEASUREMENT Layer_rAvlBOS "" SWORD Prc 1 100 -400.0000 399.9878 ECU_ADDRESS 0xD00010B4 /end MEASUREMENT
/begin MEASUREMENT Layer_rBattCond "" SWORD Prc 1 100 -400.0000 399.9878 ECU_ADDRESS 0xD00010B6 /end MEASUREMENT
/begin MEASUREMENT Layer_rBattCondTolc "" SWORD Prc 1 100 -400.0000 399.9878 ECU_ADDRESS 0xD00010B8 /end MEASUREMENT
/begin MEASUREMENT Layer_rGovHPEGR "" SWORD Prc 1 100 -400.0000 399.9878 ECU_ADDRESS 0xD00010BC /end MEASUREMENT
/begin MEASUREMENT Layer_rGovLPEGR "" SWORD Prc 1 100 -400.0000 399.9878 ECU_ADDRESS 0xD00010BE /end MEASUREMENT
/begin MEASUREMENT Layer_rlf1t "" UBYTE OneToOne 1 100 0.00 255.0 ECU_ADDRESS 0xD0001F92 /end MEASUREMENT
/begin MEASUREMENT Layer_stAKK "" UBYTE OneToOne 1 100 0.00 255.0 ECU_ADDRESS 0xD0001F93 /end MEASUREMENT
/begin MEASUREMENT Layer_stBattCond "" UBYTE OneToOne 1 100 0.00 255.0 ECU_ADDRESS 0xD0001F9B /end MEASUREMENT
/begin MEASUREMENT Layer_stB_ccbtnach "" UBYTE OneToOne 1 100 0.00 255.0 ECU_ADDRESS 0xD0001F94 /end MEASUREMENT
/begin MEASUREMENT Layer_stB_ccbttdfk "" UBYTE OneToOne 1 100 0.00 255.0 ECU_ADDRESS 0xD0001F95 /end MEASUREMENT
/begin MEASUREMENT Layer_stB_ccbttknt "" UBYTE OneToOne 1 100 0.00 255.0 ECU_ADDRESS 0xD0001F96 /end MEASUREMENT
/begin MEASUREMENT Layer_stB_ccpmerr "" UBYTE OneToOne 1 100 0.00 255.0 ECU_ADDRESS 0xD0001F97 /end MEASUREMENT
/begin MEASUREMENT Layer_stB_ccprio "" UBYTE OneToOne 1 100 0.00 255.0 ECU_ADDRESS 0xD0001F98 /end MEASUREMENT
/begin MEASUREMENT Layer_stB_ccruhver "" UBYTE OneToOne 1 100 0.00 255.0 ECU_ADDRESS 0xD0001F99 /end MEASUREMENT
/begin MEASUREMENT Layer_stB_codierpm "" UBYTE OneToOne 1 100 0.00 255.0 ECU_ADDRESS 0xD0001F9A /end MEASUREMENT
/begin MEASUREMENT Layer_stCCLPC "" UBYTE OneToOne 1 100 0.00 255.0 ECU_ADDRESS 0xD0001F9C /end MEASUREMENT
/begin MEASUREMENT Layer_stCCMSAErr "" UBYTE OneToOne 1 100 0.00 255.0 ECU_ADDRESS 0xD0001F9D /end MEASUREMENT
/begin MEASUREMENT Layer_stCCMSAInactv "" UBYTE OneToOne 1 100 0.00 255.0 ECU_ADDRESS 0xD0001F9E /end MEASUREMENT
/begin MEASUREMENT Layer_stCCOilCons "" UBYTE OneToOne 1 100 0.00 255.0 ECU_ADDRESS 0xD0001F9F /end MEASUREMENT
/begin MEASUREMENT Layer_stCCOilLos "" UBYTE OneToOne 1 100 0.00 255.0 ECU_ADDRESS 0xD0001FA0 /end MEASUREMENT
/begin MEASUREMENT Layer_stCCOilSensErr "" UBYTE OneToOne 1 100 0.00 255.0 ECU_ADDRESS 0xD0001FA1 /end MEASUREMENT
/begin MEASUREMENT Layer_stEnrgPwrMnmt "" UBYTE OneToOne 1 100 0.00 255.0 ECU_ADDRESS 0xD0001FA4 /end MEASUREMENT
/begin MEASUREMENT Layer_stFlFltHtg "" UBYTE OneToOne 1 100 0.00 255.0 ECU_ADDRESS 0xD0001FA5 /end MEASUREMENT
/begin MEASUREMENT Layer_stGearShftIdctr "" UBYTE OneToOne 1 100 0.00 255.0 ECU_ADDRESS 0xD0001FA7 /end MEASUREMENT
/begin MEASUREMENT Layer_stInfoEnv "" UBYTE OneToOne 1 100 0.00 255.0 ARRAY_SIZE 4 ECU_ADDRESS 0xD0001FA9 /end MEASUREMENT
/begin MEASUREMENT Layer_stLayer "" UWORD OneToOne 1 100 0.00 65535.00 ECU_ADDRESS 0xD00015F6 /end MEASUREMENT
/begin MEASUREMENT Layer_stLPCOff "" UBYTE OneToOne 1 100 0.00 255.0 ECU_ADDRESS 0xD0001FAD /end MEASUREMENT
/begin MEASUREMENT Layer_stNdStrtUpSupp "" UBYTE OneToOne 1 100 0.00 255.0 ECU_ADDRESS 0xD0001FAF /end MEASUREMENT
/begin MEASUREMENT Layer_stNewReqIbs "" UBYTE OneToOne 1 100 0.00 1.000 BIT_MASK 0x4 ECU_ADDRESS 0xD00003C3 /end MEASUREMENT
/begin MEASUREMENT Layer_stPKK "" UBYTE OneToOne 1 100 0.00 255.0 ECU_ADDRESS 0xD0001FB0 /end MEASUREMENT
/begin MEASUREMENT Layer_stRelVal "" UBYTE OneToOne 1 100 0.00 255.0 ECU_ADDRESS 0xD0001FB1 /end MEASUREMENT
/begin MEASUREMENT Layer_stSpaAct "" UBYTE OneToOne 1 100 0.00 255.0 ECU_ADDRESS 0xD0001FB4 /end MEASUREMENT
/begin MEASUREMENT Layer_stUnBOS "" UBYTE OneToOne 1 100 0.00 255.0 ECU_ADDRESS 0xD0001FB5 /end MEASUREMENT
/begin MEASUREMENT Layer_tChamWll "" SWORD Temp_Cels 1 100 -3549.940 3003.560 ECU_ADDRESS 0xD00003E4 /end MEASUREMENT
/begin MEASUREMENT Layer_tiBattCond "" SWORD Time_Hr 1 100 -16384.00 16383.50 FORMAT "%8.2" ECU_ADDRESS 0xD00010C6 /end MEASUREMENT
/begin MEASUREMENT Layer_tOilEng "" SWORD Temp_Cels 1 100 -3549.940 3003.560 ECU_ADDRESS 0xD00010C4 /end MEASUREMENT
/begin MEASUREMENT Layer_trqLimRaw "" SWORD Trq 1 100 -3276.800 3276.700 ECU_ADDRESS 0xD00010C8 /end MEASUREMENT
/begin MEASUREMENT La_ist1 "Lambdaistwert" UWORD Def_f_uw_b16 1 100 0.00 15.999756 FORMAT "%9.6" ECU_ADDRESS 0xC000A3D8 /end MEASUREMENT
/begin MEASUREMENT Lin_cntErr_mp "" UBYTE OneToOne 1 100 0.00 255.0 ECU_ADDRESS 0xC000B34E /end MEASUREMENT
/begin MEASUREMENT Lin_cntRx_mp "" UBYTE OneToOne 1 100 0.00 255.0 ECU_ADDRESS 0xC000B34F /end MEASUREMENT
/begin MEASUREMENT Lin_cntTx_mp "" UBYTE OneToOne 1 100 0.00 255.0 ECU_ADDRESS 0xC000B350 /end MEASUREMENT
/begin MEASUREMENT Lin_Ibsl_buffer_mp "" UBYTE OneToOne 1 100 0.00 255.0 ARRAY_SIZE 8 ECU_ADDRESS 0xC000C31C /end MEASUREMENT
/begin MEASUREMENT Lin_Ibsl_message_mp "" UBYTE OneToOne 1 100 0.00 255.0 ECU_ADDRESS 0xC000B351 /end MEASUREMENT
/begin MEASUREMENT Lin_Ibsl_status_mp "" UBYTE OneToOne 1 100 0.00 255.0 ECU_ADDRESS 0xC000B352 /end MEASUREMENT
/begin MEASUREMENT Lin_numMsgIdOld_mp "" UBYTE OneToOne 1 100 0.00 255.0 ECU_ADDRESS 0xC000B353 /end MEASUREMENT
/begin MEASUREMENT Lin_stConnect_mp "" UBYTE OneToOne 1 100 0.00 255.0 ECU_ADDRESS 0xC000B354 /end MEASUREMENT
/begin MEASUREMENT Lin_stLinCoord_mp "" UBYTE OneToOne 1 100 0.00 255.0 ECU_ADDRESS 0xC000B355 /end MEASUREMENT
/begin MEASUREMENT Lin_stRXLin_mp "" UWORD OneToOne 1 100 0.00 65535.00 ECU_ADDRESS 0xC000A48E /end MEASUREMENT
/begin MEASUREMENT LLim_stSPTrack_mp "Messpunkt Status Sollwertnachführung" UBYTE OneToOne 1 100 0.00 255.0 ECU_ADDRESS 0xC000B356 /end MEASUREMENT
/begin MEASUREMENT LLim_swtSpdCorr "Zustand der EEPROM-Variantencodierung der Höchstgeschwindigkeitsvariante." UBYTE OneToOne 1 100 0.00 255.0 ECU_ADDRESS 0xD0001F35 /end MEASUREMENT
/begin MEASUREMENT LLim_swtSpdLim "SW-Schalter Aktivierung Geschwindigkeitsbegrenzung (0: deaktiviert, 1 aktiviert)" UBYTE OneToOne 1 100 0.00 255.0 ECU_ADDRESS 0xD0001F36 /end MEASUREMENT
/begin MEASUREMENT LLim_trqGbxMax_mp "Max. Wert des Gouverneurs." SLONG TrqPrpHigh 1 100 -214748364.800 214748364.700 ECU_ADDRESS 0xC00090D8 /end MEASUREMENT
/begin MEASUREMENT LLim_trqGbxMin_mp "Min. Wert des Gouverneurs." SLONG TrqPrpHigh 1 100 -214748364.800 214748364.700 ECU_ADDRESS 0xC00090DC /end MEASUREMENT
/begin MEASUREMENT LLim_trqI_mp "Status I-Anteil" SLONG TrqPrpHigh 1 100 -214748364.800 214748364.700 ECU_ADDRESS 0xC00090E0 /end MEASUREMENT
/begin MEASUREMENT LLim_trqPISpdLim_mp "begrenztes Moment für Höchstgeschwindigkeitsbegrenzung" SLONG TrqPrpHigh 1 100 -214748364.800 214748364.700 ECU_ADDRESS 0xC00090E4 /end MEASUREMENT
/begin MEASUREMENT LLim_trqPI_mp "Status PI-Anteil" SLONG TrqPrpHigh 1 100 -214748364.800 214748364.700 ECU_ADDRESS 0xC00090E8 /end MEASUREMENT
/begin MEASUREMENT LLim_trqP_mp "Status P-Anteil" SLONG TrqPrpHigh 1 100 -214748364.800 214748364.700 ECU_ADDRESS 0xC00090EC /end MEASUREMENT
/begin MEASUREMENT LLim_trqSpdLim "begrenztes Moment für Höchstgeschwindigkeitsbegrenzung" SLONG TrqPrpHigh 1 100 -214748364.800 214748364.700 ECU_ADDRESS 0xD0002F20 /end MEASUREMENT
/begin MEASUREMENT LLim_vCurrTrack_mp "Messpunkt des nachgeführten Geschwindigkeitssollwertes" SWORD Vel 1 100 -327.6800 327.6700 ECU_ADDRESS 0xC000A490 /end MEASUREMENT
/begin MEASUREMENT LLim_vSpdCorr_mp "Fahrzeuggeschwindigkeit nach Multiplikation mit Korrekturfaktor" SWORD Vel 1 100 -327.6800 327.6700 ECU_ADDRESS 0xC000A492 /end MEASUREMENT
/begin MEASUREMENT LSU_bpPlausSetPoint_mp "Bitposition für Zugriff auf LSU_stO2Err_mp" UBYTE OneToOne 1 100 0.00 255.0 ECU_ADDRESS 0xC000B35E /end MEASUREMENT
/begin MEASUREMENT LSU_ctHtCoup "Anzahl Aktivierungen Diagnose Heizereinkopplung LSU" UWORD OneToOne 1 100 0.00 65535.00 ARRAY_SIZE 1 ECU_ADDRESS 0xD00015E2 /end MEASUREMENT
/begin MEASUREMENT LSU_d2rO2Eval_mp "Maximum des Auswertungsfilterausgangs wird gespeichert" SWORD O2 1 100 -0.3276800 0.3276700 ARRAY_SIZE 1 ECU_ADDRESS 0xC000C340 /end MEASUREMENT
/begin MEASUREMENT LSU_d2rO2_mp "Ausgewerteter Filtereingang wird gespeichert" SWORD O2 1 100 -0.3276800 0.3276700 ARRAY_SIZE 1 ECU_ADDRESS 0xC000C342 /end MEASUREMENT
/begin MEASUREMENT LSU_dcycDT1_mp "Messpunkt zum Speichern des Pufferwerts des DT1-Ergebnisses" SWORD DtyCyc 1 100 -327.6800 327.6700 ARRAY_SIZE 1 ECU_ADDRESS 0xC000C34C /end MEASUREMENT
/begin MEASUREMENT LSU_dcycHt "Aus Steuerungsmodul gesetzter Wert" SWORD DtyCyc 1 100 -327.6800 327.6700 ARRAY_SIZE 1 ECU_ADDRESS 0xD0001068 /end MEASUREMENT
/begin MEASUREMENT LSU_dcycHtCor "Korrigierter Sollwert für Endstufe" SWORD DtyCyc 1 100 -327.6800 327.6700 ARRAY_SIZE 1 ECU_ADDRESS 0xD000105E /end MEASUREMENT
/begin MEASUREMENT LSU_dcycHtCoupStp1 "Heizertastverhältnis LSU (erste Datenerfassung in Diagnose Heizereinkopplung)" SWORD DtyCyc 1 100 -327.6800 327.6700 ARRAY_SIZE 1 ECU_ADDRESS 0xD0001060 /end MEASUREMENT
/begin MEASUREMENT LSU_dcycHtCoupStp2 "Heizertastverhältnis LSU (zweite Datenerfassung in Diagnose Heizereinkopplung)" SWORD DtyCyc 1 100 -327.6800 327.6700 ARRAY_SIZE 1 ECU_ADDRESS 0xD0001062 /end MEASUREMENT
/begin MEASUREMENT LSU_dcycHtIniRmp "Später zu entfernen" SWORD DtyCyc 1 100 -327.6800 327.6700 ECU_ADDRESS 0xD0001064 /end MEASUREMENT
/begin MEASUREMENT LSU_dcycHtStrt "Startup-Wert des Heizertastverhältnisses" SWORD DtyCyc 1 100 -327.6800 327.6700 ARRAY_SIZE 1 ECU_ADDRESS 0xD0001066 /end MEASUREMENT
/begin MEASUREMENT LSU_dcycI_mp "Aktualisierung des Tastverhältnisses aus dem I-Anteil" SWORD DtyCyc 1 100 -327.6800 327.6700 ARRAY_SIZE 1 ECU_ADDRESS 0xC000C34E /end MEASUREMENT
/begin MEASUREMENT LSU_dcycLimActHt "Tatsächliche Begrenzung des Tastverhältnisses wegen Batteriespannungskorrektur" SWORD DtyCyc 1 100 -327.6800 327.6700 ARRAY_SIZE 1 ECU_ADDRESS 0xD000106A /end MEASUREMENT
/begin MEASUREMENT LSU_dcycP_mp "Aktualisierung des Tastverhältnisses aus dem P-Anteil" SWORD DtyCyc 1 100 -327.6800 327.6700 ARRAY_SIZE 1 ECU_ADDRESS 0xC000C350 /end MEASUREMENT
/begin MEASUREMENT LSU_dcycRippel_mp "Änderung Heizer-Tastverhältnis LSU bei Diagnose Heizereinkopplung" SWORD DtyCyc 1 100 -327.6800 327.6700 ARRAY_SIZE 1 ECU_ADDRESS 0xC000C332 /end MEASUREMENT
/begin MEASUREMENT LSU_dHtCoupStepLast "voriger Wert des Schieberegisters LSU_dHtCoupStp" UBYTE OneToOne 1 100 0.00 255.0 ECU_ADDRESS 0xD0001F37 /end MEASUREMENT
/begin MEASUREMENT LSU_dHtCoupStp "Schieberegister (zur Datenerfassung Diagnose Heizereinkopplung)" UBYTE OneToOne 1 100 0.00 255.0 ECU_ADDRESS 0xD0001F38 /end MEASUREMENT
/begin MEASUREMENT LSU_drO2Adap "Gefilterter Sauerstoffwert" SWORD O2 1 100 -0.3276800 0.3276700 ARRAY_SIZE 1 ECU_ADDRESS 0xD000106C /end MEASUREMENT
/begin MEASUREMENT LSU_drO2Flt_mp "Anpassungsfilterausgang" SWORD O2 1 100 -0.3276800 0.3276700 ARRAY_SIZE 1 ECU_ADDRESS 0xC000C344 /end MEASUREMENT
/begin MEASUREMENT LSU_facO2Corr_mp "Korrekturfaktor der Anpassung" SWORD Fact 1 100 -4.000000 3.999878 ARRAY_SIZE 1 ECU_ADDRESS 0xC000C346 /end MEASUREMENT
/begin MEASUREMENT LSU_facPresComp_mp "Messpunkt des Kompensationsfaktors" SWORD Fact 1 100 -4.000000 3.999878 ARRAY_SIZE 1 ECU_ADDRESS 0xC000C348 /end MEASUREMENT
/begin MEASUREMENT LSU_facUCor_mp "Batteriespannungskorrekturfaktor für Heizertastverhältnis" SWORD Fact 1 100 -4.000000 3.999878 ECU_ADDRESS 0xC000A494 /end MEASUREMENT
/begin MEASUREMENT LSU_mAirAftOvrRun "Luftmasse, die während einer Anpassung aufsummiert wird" SWORD AirMass_2 1 100 -3276.800 3276.700 FORMAT "%8.3" ECU_ADDRESS 0xD000106E /end MEASUREMENT
/begin MEASUREMENT LSU_numMaxCmpChk_mp "Anzahl möglicher Differenzprüfungen" UBYTE OneToOne 1 100 0.00 255.0 ECU_ADDRESS 0xC000B35F /end MEASUREMENT
/begin MEASUREMENT LSU_qStrt_mp "anfängliche Kraftstoffmenge in Dynamik-Überwachung" SWORD InjMass 1 100 -327.6800 327.6700 ECU_ADDRESS 0xC000A4A6 /end MEASUREMENT
/begin MEASUREMENT LSU_resRi "Korrekturwert des Ri-Kalibrierwiderstands" SWORD Resist 1 100 -3276.800 3276.700 FORMAT "%8.3" ARRAY_SIZE 1 ECU_ADDRESS 0xD0001088 /end MEASUREMENT
/begin MEASUREMENT LSU_resRiClb "Korrekturwert des Ri-Kalibrierwiderstands" SWORD Resist 1 100 -3276.800 3276.700 FORMAT "%8.3" ARRAY_SIZE 1 ECU_ADDRESS 0xD000107E /end MEASUREMENT
/begin MEASUREMENT LSU_resRiClbRaw_mp "Roh Ri-Korrekturwert" SWORD Resist 1 100 -3276.800 3276.700 FORMAT "%8.3" ARRAY_SIZE 1 ECU_ADDRESS 0xC000C32C /end MEASUREMENT
/begin MEASUREMENT LSU_resRiDvt "Ri-Kalibrierungswert nach Begrenzung und Filterung" SWORD Resist 1 100 -3276.800 3276.700 FORMAT "%8.3" ARRAY_SIZE 1 ECU_ADDRESS 0xD0001080 /end MEASUREMENT
/begin MEASUREMENT LSU_resRiHtCoupStp1 "Innenwiderstand LSU (erste Datenerfassung in Diagnose Heizereinkopplung)" SWORD Resist 1 100 -3276.800 3276.700 FORMAT "%8.3" ARRAY_SIZE 1 ECU_ADDRESS 0xD0001082 /end MEASUREMENT
/begin MEASUREMENT LSU_resRiHtCoupStp2 "Innenwiderstand LSU (zweite Datenerfassung in Diagnose Heizereinkopplung)" SWORD Resist 1 100 -3276.800 3276.700 FORMAT "%8.3" ARRAY_SIZE 1 ECU_ADDRESS 0xD0001084 /end MEASUREMENT
/begin MEASUREMENT LSU_resRiRaw "Rohwiderstand der Ri-Auswertung, inklusiv Kalibrierwerte!" SWORD Resist 1 100 -3276.800 3276.700 FORMAT "%8.3" ARRAY_SIZE 1 ECU_ADDRESS 0xD0001086 /end MEASUREMENT
/begin MEASUREMENT LSU_resRiRippel_mp "Innenwiderstands-Änderung beim Abschalten Heizung LSU" SWORD Resist 1 100 -3276.800 3276.700 FORMAT "%8.3" ARRAY_SIZE 1 ECU_ADDRESS 0xC000C334 /end MEASUREMENT
/begin MEASUREMENT LSU_rLam "Der aus LSU gemessene Lambdawert" SWORD lambda 1 100 -32.76800 32.76700 ARRAY_SIZE 1 ECU_ADDRESS 0xD0001072 /end MEASUREMENT
/begin MEASUREMENT LSU_rLamRec "Reziprokale Lambda-Botschaft" SWORD lambdaRecVal 1 100 -32.76800 32.76700 FORMAT "%8.5" ARRAY_SIZE 1 ECU_ADDRESS 0xD0001070 /end MEASUREMENT
/begin MEASUREMENT LSU_rO2Act "Sauerstoffrohwert ohne Filter und ohne Freeze, nur Offset-kompensiert" SWORD O2 1 100 -0.3276800 0.3276700 ARRAY_SIZE 1 ECU_ADDRESS 0xD0001074 /end MEASUREMENT
/begin MEASUREMENT LSU_rO2Adap "Adaptierte Sauerstoffkonzentration die an externe Module übertragen wird" SWORD O2 1 100 -0.3276800 0.3276700 ARRAY_SIZE 1 ECU_ADDRESS 0xD0001076 /end MEASUREMENT
/begin MEASUREMENT LSU_rO2Calc_mp "aktuelle O2-Konzentration aus Luftmasse und Einspritzmenge" SWORD O2 1 100 -0.3276800 0.3276700 ECU_ADDRESS 0xC000A4A8 /end MEASUREMENT
/begin MEASUREMENT LSU_rO2DiffCmpChk_mp "O2-Unterschied eines Sondenpaars" SWORD O2 1 100 -0.3276800 0.3276700 ARRAY_SIZE 1 ECU_ADDRESS 0xC000C352 /end MEASUREMENT
/begin MEASUREMENT LSU_rO2DvtNeg_mp "Minustoleranz für Plausibilisierung O2-Signal LSU" SWORD O2 1 100 -0.3276800 0.3276700 ECU_ADDRESS 0xC000A4AA /end MEASUREMENT
/begin MEASUREMENT LSU_rO2DvtPos_mp "Plustoleranz für Plausibilisierung O2-Signal LSU" SWORD O2 1 100 -0.3276800 0.3276700 ECU_ADDRESS 0xC000A4AC /end MEASUREMENT
/begin MEASUREMENT LSU_rO2FrstValCmpChk_mp "O2-Konzentration der ersten Sonde der Differenzprüfung" SWORD O2 1 100 -0.3276800 0.3276700 ARRAY_SIZE 1 ECU_ADDRESS 0xC000C354 /end MEASUREMENT
/begin MEASUREMENT LSU_rO2PresComp "Druck-korrigierter Sauerstoffwert" SWORD O2 1 100 -0.3276800 0.3276700 ARRAY_SIZE 1 ECU_ADDRESS 0xD0001078 /end MEASUREMENT
/begin MEASUREMENT LSU_rO2Raw "Sauerstoffrohwert, nur Offset-kompensiert" SWORD O2 1 100 -0.3276800 0.3276700 ARRAY_SIZE 1 ECU_ADDRESS 0xD000107A /end MEASUREMENT
/begin MEASUREMENT LSU_rO2RawFlt_mp "Gefilterter Wert des LSU_rO2Rau, der in Erkennung Lambda=1 Bedingung verwendet wird." SWORD O2 1 100 -0.3276800 0.3276700 ARRAY_SIZE 1 ECU_ADDRESS 0xC000C324 /end MEASUREMENT
/begin MEASUREMENT LSU_rO2SecValCmpChk_mp "O2-Konzentration der zweiten Sonde der Differenzprüfung" SWORD O2 1 100 -0.3276800 0.3276700 ARRAY_SIZE 1 ECU_ADDRESS 0xC000C356 /end MEASUREMENT
/begin MEASUREMENT LSU_rO2Stat "Die durch PT1-Filter gefilterte O2-Konzentration" SWORD O2 1 100 -0.3276800 0.3276700 ARRAY_SIZE 1 ECU_ADDRESS 0xD000107C /end MEASUREMENT
/begin MEASUREMENT LSU_rO2Thres1_mp "untere O2-Schwelle für Messung der Anstiegszeit" SWORD O2 1 100 -0.3276800 0.3276700 ARRAY_SIZE 1 ECU_ADDRESS 0xC000C358 /end MEASUREMENT
/begin MEASUREMENT LSU_rO2Thres2_mp "obere O2-Schwelle für Messung der Anstiegszeit" SWORD O2 1 100 -0.3276800 0.3276700 ARRAY_SIZE 1 ECU_ADDRESS 0xC000C35A /end MEASUREMENT
/begin MEASUREMENT LSU_rOutHWE_mp "Tastverhältnis für HWE inklusiv Testeranforderung" SWORD DtyCyc 1 100 -327.6800 327.6700 ARRAY_SIZE 1 ECU_ADDRESS 0xC000C328 /end MEASUREMENT
/begin MEASUREMENT LSU_stActv_mp "LSU-Aktivierungszustandinformation wird gespeichert" UBYTE OneToOne 1 100 0.00 255.0 ECU_ADDRESS 0xC000B35A /end MEASUREMENT
/begin MEASUREMENT LSU_stAdap "Gefilterter Sauerstoffwert" UBYTE OneToOne 1 100 0.00 255.0 ARRAY_SIZE 1 ECU_ADDRESS 0xD0001F39 /end MEASUREMENT
/begin MEASUREMENT LSU_stAdapActv_mp "Status der Anpassungsaktivierung" UBYTE OneToOne 1 100 0.00 255.0 ARRAY_SIZE 1 ECU_ADDRESS 0xC000C34A /end MEASUREMENT
/begin MEASUREMENT LSU_stChkDyn_mp "Nummer der zuletzt erreichten O2-Schwelle" UBYTE OneToOne 1 100 0.00 255.0 ARRAY_SIZE 1 ECU_ADDRESS 0xC000C35C /end MEASUREMENT
/begin MEASUREMENT LSU_stChng "Status, ob im aktuellen Fahrzyklus bereits ein neues Lernergebnis erzeugt wurde." UBYTE OneToOne 1 100 0.00 255.0 ARRAY_SIZE 1 ECU_ADDRESS 0xD0001F3A /end MEASUREMENT
/begin MEASUREMENT LSU_stCirModeNew "Letzter CJ125 Modusstatus der auf INIT1/INIT2 Register geschrieben wird." UWORD OneToOne 1 100 0.00 65535.00 ARRAY_SIZE 1 ECU_ADDRESS 0xD00015E4 /end MEASUREMENT
/begin MEASUREMENT LSU_stClbTrg_mp "CJ125-Kalibrierung bzw. Pumpstromumkehr ist freigegeben" UBYTE OneToOne 1 100 0.00 255.0 ECU_ADDRESS 0xC000B35B /end MEASUREMENT
/begin MEASUREMENT LSU_stCldSensDiaActv "Status zur Freigabe der SCB-Prüfung an IA/IP für kalte Sonde" UBYTE OneToOne 1 100 0.00 255.0 ARRAY_SIZE 1 ECU_ADDRESS 0xD0001F3B /end MEASUREMENT
/begin MEASUREMENT LSU_stCmpChkCon_mp "Statuswort Zustand der Voraussetzungen der Differenzprüfung" UBYTE OneToOne 1 100 0.00 255.0 ARRAY_SIZE 1 ECU_ADDRESS 0xC000C35D /end MEASUREMENT
/begin MEASUREMENT LSU_stCmpChk_mp "Statuswort Zustand der Differenzprüfung" UBYTE OneToOne 1 100 0.00 255.0 ARRAY_SIZE 1 ECU_ADDRESS 0xC000C35E /end MEASUREMENT
/begin MEASUREMENT LSU_stCmpErr_mp "Statusbit Ergebnis der Differenzprüfung" UBYTE OneToOne 1 100 0.00 255.0 ARRAY_SIZE 1 ECU_ADDRESS 0xC000C35F /end MEASUREMENT
/begin MEASUREMENT LSU_stDebBattHi_mp "Messpunkt für entprellter Zustand der Batterie über Schwellentest" UBYTE OneToOne 1 100 0.00 255.0 ECU_ADDRESS 0xC000B357 /end MEASUREMENT
/begin MEASUREMENT LSU_stDebOvrRun_mp "Entprellter Zustand für Nachlauf-Zustand des Fahrzeuges" UBYTE OneToOne 1 100 0.00 255.0 ECU_ADDRESS 0xC000B358 /end MEASUREMENT
/begin MEASUREMENT LSU_stDiaIAEna "Statusvariable zur Initialisierung des CJ125-Registers" UBYTE OneToOne 1 100 0.00 255.0 ARRAY_SIZE 1 ECU_ADDRESS 0xD0001F3C /end MEASUREMENT
/begin MEASUREMENT LSU_stDiaReg_mp "Inhalt des Diagnoseregister des CJ125" UWORD OneToOne 1 100 0.00 65535.00 ARRAY_SIZE 1 ECU_ADDRESS 0xC000C326 /end MEASUREMENT
/begin MEASUREMENT LSU_stDynState "Dynamische Plausibilitätstest Zustandsautomatgröße" UBYTE OneToOne 1 100 0.00 255.0 ARRAY_SIZE 1 ECU_ADDRESS 0xD0001F3D /end MEASUREMENT
/begin MEASUREMENT LSU_stErr "Die bitkodierte Größe zeigt verschiedene Fehler an, die aktuell in LSU gesetzt werden" UWORD OneToOne 1 100 0.00 65535.00 ARRAY_SIZE 1 ECU_ADDRESS 0xD00015E6 /end MEASUREMENT
/begin MEASUREMENT LSU_stHold_mp "Anpassungsstatus" UBYTE OneToOne 1 100 0.00 255.0 ARRAY_SIZE 1 ECU_ADDRESS 0xC000C34B /end MEASUREMENT
/begin MEASUREMENT LSU_stHtCoupActv "Status :: Diagnose Heizereinkopplung getriggert" UBYTE OneToOne 1 100 0.00 255.0 ECU_ADDRESS 0xD0001F3E /end MEASUREMENT
/begin MEASUREMENT LSU_stHtCtl "Status der Heizerregelung" UBYTE OneToOne 1 100 0.00 255.0 ARRAY_SIZE 1 ECU_ADDRESS 0xD0001F3F /end MEASUREMENT
/begin MEASUREMENT LSU_stHtDis "Heizer-ausgeschalteter-Status" UBYTE OneToOne 1 100 0.00 255.0 ARRAY_SIZE 1 ECU_ADDRESS 0xD0001F40 /end MEASUREMENT
/begin MEASUREMENT LSU_stHtDisbl "Heizersperrungs-Anforderung" UBYTE OneToOne 1 100 0.00 255.0 ARRAY_SIZE 1 ECU_ADDRESS 0xD0001F41 /end MEASUREMENT
/begin MEASUREMENT LSU_stIniClb "Status:: erste CJ120-Kalibrierung angefordert" UBYTE OneToOne 1 100 0.00 255.0 ECU_ADDRESS 0xD0001F42 /end MEASUREMENT
/begin MEASUREMENT LSU_stIpHiCurrEna "Statusbit zum Setzen 40uA EIN" UBYTE OneToOne 1 100 0.00 255.0 ARRAY_SIZE 1 ECU_ADDRESS 0xD0001F43 /end MEASUREMENT
/begin MEASUREMENT LSU_stIpNrmCurrEna "Statusbit zum Setzen 20uA EIN ) , CType(uint8[ctNumberOfSensors]" UBYTE OneToOne 1 100 0.00 255.0 ARRAY_SIZE 1 ECU_ADDRESS 0xD0001F44 /end MEASUREMENT
/begin MEASUREMENT LSU_stIsolChkActv "Status:: Nebsnschlußerkennung ist momentan aktiv" UBYTE OneToOne 1 100 0.00 255.0 ARRAY_SIZE 1 ECU_ADDRESS 0xD0001F45 /end MEASUREMENT
/begin MEASUREMENT LSU_stIsolChkO2Last "Status:: O2-Signal im Fenster der Nebenschlußerkennung" UBYTE OneToOne 1 100 0.00 255.0 ARRAY_SIZE 1 ECU_ADDRESS 0xD0001F46 /end MEASUREMENT
/begin MEASUREMENT LSU_stNotOpPoint1_mp "Messen des Punktes für Status des Betriebsgebiets 1" UBYTE OneToOne 1 100 0.00 255.0 ECU_ADDRESS 0xC000B35C /end MEASUREMENT
/begin MEASUREMENT LSU_stNotOpPoint2_mp "Messen des Punktes für Status des Betriebsgebiets 2" UBYTE OneToOne 1 100 0.00 255.0 ECU_ADDRESS 0xC000B35D /end MEASUREMENT
/begin MEASUREMENT LSU_stO2Act_mp "Status der O2-Gültigkeit, der durch O2-Kalibrierungsstatus und LSU-Fehler beeinflußt wird" UBYTE OneToOne 1 100 0.00 255.0 ARRAY_SIZE 1 ECU_ADDRESS 0xC000C32A /end MEASUREMENT
/begin MEASUREMENT LSU_stO2Chk "Statusmeldung anzuzeigen, ob eine bestimmte Diagnoseroutine durchgeführt wurde oder nicht" UWORD OneToOne 1 100 0.00 65535.00 ARRAY_SIZE 1 ECU_ADDRESS 0xD00015E8 /end MEASUREMENT
/begin MEASUREMENT LSU_stO2ClbEna "Freigabestatus der O2-Kalibrierung" UBYTE OneToOne 1 100 0.00 255.0 ECU_ADDRESS 0xD0001F47 /end MEASUREMENT
/begin MEASUREMENT LSU_stO2Clb_mp "Ausgangszustand der Kalibrierungssequenz zum Messpunkt" UBYTE OneToOne 1 100 0.00 255.0 ECU_ADDRESS 0xC000B359 /end MEASUREMENT
/begin MEASUREMENT LSU_stO2Err "Statusmeldung zur Anzeige des Ergebnisses der Diagnoseroutine - Fehler/ kein Fehler" UWORD OneToOne 1 100 0.00 65535.00 ARRAY_SIZE 1 ECU_ADDRESS 0xD00015EA /end MEASUREMENT
/begin MEASUREMENT LSU_stO2IntValid "O2-Signal gültig (Intern)" UBYTE OneToOne 1 100 0.00 255.0 ARRAY_SIZE 1 ECU_ADDRESS 0xD0001F48 /end MEASUREMENT
/begin MEASUREMENT LSU_stO2SPICalDem "Freigabestatus des Kalibriermodus des Lambda-Signals" UBYTE OneToOne 1 100 0.00 255.0 ECU_ADDRESS 0xD0001F49 /end MEASUREMENT
/begin MEASUREMENT LSU_stOpnErrIP "Lastabfallfehlerbotschaft für Pumpen-Pin (Ip)" UBYTE OneToOne 1 100 0.00 255.0 ARRAY_SIZE 1 ECU_ADDRESS 0xD0001F4A /end MEASUREMENT
/begin MEASUREMENT LSU_stOpnLdTstActv "Status bei aktivem Lastabfalltest" UBYTE OneToOne 1 100 0.00 255.0 ARRAY_SIZE 1 ECU_ADDRESS 0xD0001F4B /end MEASUREMENT
/begin MEASUREMENT LSU_stPlausChk "Ergebnis der O2-Plausibilitätsprüfung in dem aktuellen Betriebspunkt" UBYTE OneToOne 1 100 0.00 255.0 ARRAY_SIZE 1 ECU_ADDRESS 0xD0001F4D /end MEASUREMENT
/begin MEASUREMENT LSU_stPlausChkCon "Statuswortzustand der Voraussetzungen für Plausibilitätsprüfung" UBYTE OneToOne 1 100 0.00 255.0 ECU_ADDRESS 0xD0001F4C /end MEASUREMENT
/begin MEASUREMENT LSU_stPmpCtl "Status des Sauerstoffpumpenstroms" UBYTE OneToOne 1 100 0.00 255.0 ARRAY_SIZE 1 ECU_ADDRESS 0xD0001F4E /end MEASUREMENT
/begin MEASUREMENT LSU_stPmpEna "Triggerbotschaft zur Freigabe des Pumpenstroms" UBYTE OneToOne 1 100 0.00 255.0 ARRAY_SIZE 1 ECU_ADDRESS 0xD0001F4F /end MEASUREMENT
/begin MEASUREMENT LSU_stPOpCmpChk_mp "Statusbit Betriebspunkt der Differenzprüfung erreicht" UBYTE OneToOne 1 100 0.00 255.0 ECU_ADDRESS 0xC000B360 /end MEASUREMENT
/begin MEASUREMENT LSU_stRecValEval_mp "Messpunkt zur Überwachung des Status zur Anzeige, ob aufgenommene Werte bewertet werden sollen" UBYTE OneToOne 1 100 0.00 255.0 ARRAY_SIZE 1 ECU_ADDRESS 0xC000C336 /end MEASUREMENT
/begin MEASUREMENT LSU_stRefCurrTrans_mp "Instrument für LSU-Referenzpumpenstrom -Statusübergang (von hohem Strom zu niedrigem Strom und umgekehrt)" UBYTE OneToOne 1 100 0.00 255.0 ARRAY_SIZE 1 ECU_ADDRESS 0xC000C366 /end MEASUREMENT
/begin MEASUREMENT LSU_stRefPmp "Status der Referenzpumpströme" UBYTE OneToOne 1 100 0.00 255.0 ARRAY_SIZE 1 ECU_ADDRESS 0xD0001F51 /end MEASUREMENT
/begin MEASUREMENT LSU_stRefPmpDis "Statusvariable zur Sperrung des Referenzpumpenstroms bei SCG der Sondenleitungen" UBYTE OneToOne 1 100 0.00 255.0 ARRAY_SIZE 1 ECU_ADDRESS 0xD0001F50 /end MEASUREMENT
/begin MEASUREMENT LSU_stRiClb "Trigger von Ri-Kalibrierungssequenz" UBYTE OneToOne 1 100 0.00 255.0 ECU_ADDRESS 0xD0001F52 /end MEASUREMENT
/begin MEASUREMENT LSU_stRiClbEna "Freigabestatus der Ri-Kalibrierung" UBYTE OneToOne 1 100 0.00 255.0 ECU_ADDRESS 0xD0001F53 /end MEASUREMENT
/begin MEASUREMENT LSU_stRiSPICalDem "Status der SPI-Anforderung für Ri-Auswertung" UBYTE OneToOne 1 100 0.00 255.0 ECU_ADDRESS 0xD0001F54 /end MEASUREMENT
/begin MEASUREMENT LSU_stRiValid "Gültiger Status der Innenwiderstandsmessung" UBYTE OneToOne 1 100 0.00 255.0 ARRAY_SIZE 1 ECU_ADDRESS 0xD0001F55 /end MEASUREMENT
/begin MEASUREMENT LSU_stRmp "message zum Speichern des Rampenstatus" UBYTE OneToOne 1 100 0.00 255.0 ARRAY_SIZE 1 ECU_ADDRESS 0xD0001F56 /end MEASUREMENT
/begin MEASUREMENT LSU_stSCUNEna "Status des Tests KurzschlussnachBatterie für UN" UBYTE OneToOne 1 100 0.00 255.0 ARRAY_SIZE 1 ECU_ADDRESS 0xD0001F57 /end MEASUREMENT
/begin MEASUREMENT LSU_stSPIIniVal_mp "Der aus den CJ125 INIT1/INIT2 -Register gelesene Wert" UWORD OneToOne 1 100 0.00 65535.00 ARRAY_SIZE 1 ECU_ADDRESS 0xC000C330 /end MEASUREMENT
/begin MEASUREMENT LSU_stSrvTstDem "Bitkodierter Status für LSU-Servicetest-Diagnose aktiv" UWORD OneToOne 1 100 0.00 65535.00 ECU_ADDRESS 0xD00015EC /end MEASUREMENT
/begin MEASUREMENT LSU_stTmrClbPerRun "Status des Kalibrier-Timers" UBYTE OneToOne 1 100 0.00 255.0 ECU_ADDRESS 0xD0001F58 /end MEASUREMENT
/begin MEASUREMENT LSU_stTstTrigger_mp "Messpunkt zur Überwachung der Variable, die der Trigger-Status der Nebenschlusserkennung anzeigt" UBYTE OneToOne 1 100 0.00 255.0 ARRAY_SIZE 1 ECU_ADDRESS 0xC000C337 /end MEASUREMENT
/begin MEASUREMENT LSU_stWireDiaChk_mp "Messpunkt, der anzeigt, welche Diagnoseroutine mit einiger bedeutungsvoller Ergebnisse durchgeführt wurden. Es ist bitcodiert. Wird das Bit gesetzt, bedeutet das, dass die bestimmte Routine durchgeführt wird." UBYTE OneToOne 1 100 0.00 255.0 ARRAY_SIZE 1 ECU_ADDRESS 0xC000C338 /end MEASUREMENT
/begin MEASUREMENT LSU_stWireDiaErr_mp "Messpunkt zur Anzeige der Diagnosenprüfungsergebnisse" UBYTE OneToOne 1 100 0.00 255.0 ARRAY_SIZE 1 ECU_ADDRESS 0xC000C339 /end MEASUREMENT
/begin MEASUREMENT LSU_swtAdap "LSU Anpassungsschalterwert" UBYTE OneToOne 1 100 0.00 255.0 ECU_ADDRESS 0xD0001F59 /end MEASUREMENT
/begin MEASUREMENT LSU_swtEna "Status-Message zu Freigabe oder Sperren der gesamten LSU-Funktionen" UBYTE OneToOne 1 100 0.00 255.0 ECU_ADDRESS 0xD0001F5A /end MEASUREMENT
/begin MEASUREMENT LSU_tAirStrt_mp "Messpunkt zum Speichern der Lufttemperatur beim Start" SWORD Temp_Cels 1 100 -3549.940 3003.560 ECU_ADDRESS 0xC000A4A0 /end MEASUREMENT
/begin MEASUREMENT LSU_tDvt "Abweichung von Sensortemperatur aus dem Sollwert" SWORD TempDiff_Kelv 1 100 -3276.800 3276.700 ARRAY_SIZE 1 ECU_ADDRESS 0xD000108A /end MEASUREMENT
/begin MEASUREMENT LSU_tiState1_mp "Timervariable: Kraftstoffmenge liegt innerhalb Toleranzband" UWORD Time_s 1 100 0.00 655.3500 ARRAY_SIZE 1 ECU_ADDRESS 0xC000C360 /end MEASUREMENT
/begin MEASUREMENT LSU_tiState2_mp "Anstiegszeit O2-Signal beim Übergang Last-Schub" UWORD Time_s 1 100 0.00 655.3500 ARRAY_SIZE 1 ECU_ADDRESS 0xC000C362 /end MEASUREMENT
/begin MEASUREMENT LSU_tiState3_mp "Zeitdauer bis zum Erreichen des Schubs (Kraftstoffmenge kleiner als Schwellwert)" UWORD Time_s 1 100 0.00 655.3500 ARRAY_SIZE 1 ECU_ADDRESS 0xC000C364 /end MEASUREMENT
/begin MEASUREMENT LSU_tLowLim_mp "Obere Temperaturgrenze aus der batteriespannungabhängige Kennlinie" SWORD Temp_Cels 1 100 -3549.940 3003.560 ECU_ADDRESS 0xC000A4A2 /end MEASUREMENT
/begin MEASUREMENT LSU_tRi "Äquivalenztemperatur für Ri" SWORD Temp_Cels 1 100 -3549.940 3003.560 ARRAY_SIZE 1 ECU_ADDRESS 0xD000108C /end MEASUREMENT
/begin MEASUREMENT LSU_tUpLim_mp "Obere Temperaturgrenze aus der batteriespannungabhängige Kennlinie" SWORD Temp_Cels 1 100 -3549.940 3003.560 ECU_ADDRESS 0xC000A4A4 /end MEASUREMENT
/begin MEASUREMENT LSU_uO2Clb "Korrekturwert der Sauerstoffkalibrierung" SWORD Volt 1 100 -6553.600 6553.400 ARRAY_SIZE 1 ECU_ADDRESS 0xD000108E /end MEASUREMENT
/begin MEASUREMENT LSU_uO2Dvt "Begrenzter und gefilterter Kalibrierungswert" SWORD Volt 1 100 -6553.600 6553.400 ARRAY_SIZE 1 ECU_ADDRESS 0xD0001090 /end MEASUREMENT
/begin MEASUREMENT LSU_uO2Flt "Gefilterter Wert des O2-Rohsignals" SWORD Volt 1 100 -6553.600 6553.400 ARRAY_SIZE 1 ECU_ADDRESS 0xD0001092 /end MEASUREMENT
/begin MEASUREMENT LSU_uO2FltRippel_mp "gefilterter Spannungsrippel in Diagnose Heizereinkopplung" SWORD Volt 1 100 -6553.600 6553.400 ARRAY_SIZE 1 ECU_ADDRESS 0xC000C33A /end MEASUREMENT
/begin MEASUREMENT LSU_uO2FltSegOld_mp "Messpunkt zum Speichern des alten Segmentwerts" SLONG Volt 1 100 -429496729.600 429496729.400 ECU_ADDRESS 0xC00090F0 /end MEASUREMENT
/begin MEASUREMENT LSU_uO2Grad_mp "Gradient des O2-Signals während Diagnose Heizereinkopplung" SWORD Volt 1 100 -6553.600 6553.400 ARRAY_SIZE 1 ECU_ADDRESS 0xC000C33C /end MEASUREMENT
/begin MEASUREMENT LSU_uO2HtCoupStp1 "O2-Spannungssignal (erste Datenerfassung in Diagnose Heizereinkopplung)" SWORD Volt 1 100 -6553.600 6553.400 ARRAY_SIZE 1 ECU_ADDRESS 0xD0001094 /end MEASUREMENT
/begin MEASUREMENT LSU_uO2HtCoupStp2 "O2-Spannungssignal (zweite Datenerfassung in Diagnose Heizereinkopplung)" SWORD Volt 1 100 -6553.600 6553.400 ARRAY_SIZE 1 ECU_ADDRESS 0xD0001096 /end MEASUREMENT
/begin MEASUREMENT LSU_uO2HtCoupStp3 "O2-Spannungssignal (dritte Datenerfassung in Diagnose Heizereinkopplung)" SWORD Volt 1 100 -6553.600 6553.400 ARRAY_SIZE 1 ECU_ADDRESS 0xD0001098 /end MEASUREMENT
/begin MEASUREMENT LSU_uO2Raw "Spannungsrohwert des Lambda-Signals nach Abzug der Referenz" SWORD Volt 1 100 -6553.600 6553.400 ARRAY_SIZE 1 ECU_ADDRESS 0xD000109E /end MEASUREMENT
/begin MEASUREMENT LSU_uO2RawAdcDirect "Direkter O2-Signalwert aus dem ADC (vor Segmentfilterung)" SWORD Volt 1 100 -6553.600 6553.400 ARRAY_SIZE 1 ECU_ADDRESS 0xD000109A /end MEASUREMENT
/begin MEASUREMENT LSU_uO2RawOfsCor "Für Offset-Spannung korrigiertes O2-Spannungssignal" SWORD Volt 1 100 -6553.600 6553.400 ARRAY_SIZE 1 ECU_ADDRESS 0xD000109C /end MEASUREMENT
/begin MEASUREMENT LSU_uO2Rippel_mp "Spannungsänderung O2-Signal beim Abschalten Heizer LSU" SWORD Volt 1 100 -6553.600 6553.400 ARRAY_SIZE 1 ECU_ADDRESS 0xC000C33E /end MEASUREMENT
/begin MEASUREMENT LSU_uRiFlt "Gefilterter Wert des Ri-Signals" SWORD Volt 1 100 -6553.600 6553.400 ARRAY_SIZE 1 ECU_ADDRESS 0xD00010A0 /end MEASUREMENT
/begin MEASUREMENT LSU_uRiRawOfsCor "Ri-Spannung nach Offset-Korrektur" SWORD Volt 1 100 -6553.600 6553.400 ARRAY_SIZE 1 ECU_ADDRESS 0xD00010A2 /end MEASUREMENT
/begin MEASUREMENT LSU_uRiRaw_mp "Messpunkt zum Speichern des gefilterten Werts" SWORD Volt 1 100 -6553.600 6553.400 ARRAY_SIZE 1 ECU_ADDRESS 0xC000C32E /end MEASUREMENT
/begin MEASUREMENT L_pwmout "Tastverhältnis E-Lüfter" UBYTE Def_tv_ub_q0p390625 1 100 0.00 99.61 ECU_ADDRESS 0xC000B2E5 /end MEASUREMENT
/begin MEASUREMENT Mdi_bas "aktuelles inneres Ist-Moment" SWORD Def_m_sw_q0p1 1 100 -3276.80 3276.70 FORMAT "%7.2" ECU_ADDRESS 0xC000A3DA /end MEASUREMENT
/begin MEASUREMENT Mdi_ist_m "Über alle Zylinder gemittelte innere Motormoment" SWORD Def_m_sw_q0p1 1 100 -3276.80 3276.70 FORMAT "%7.2" ECU_ADDRESS 0xC000A3DC /end MEASUREMENT
/begin MEASUREMENT Mdi_llri "I-Anteil Leerlaufregler" SWORD Def_m_sw_q0p1 1 100 -3276.80 3276.70 FORMAT "%7.2" ECU_ADDRESS 0xC000A3DE /end MEASUREMENT
/begin MEASUREMENT Mdk_ist "Kupplungsistmoment" SWORD Def_m_sw_q0p1 1 100 -3276.80 3276.70 FORMAT "%7.2" ECU_ADDRESS 0xC000A3E0 /end MEASUREMENT
/begin MEASUREMENT Mdk_max_real "Maximales Drehmoment an der Kupplung" SWORD Def_m_sw_q0p1 1 100 -3276.80 3276.70 FORMAT "%7.2" ECU_ADDRESS 0xC000A3E2 /end MEASUREMENT
/begin MEASUREMENT Mdk_wunsch "Wunschkupplungsmoment vor Fahrdynamikfilterung" SWORD Def_m_sw_q0p1 1 100 -3276.80 3276.70 FORMAT "%7.2" ECU_ADDRESS 0xC000A3E4 /end MEASUREMENT
/begin MEASUREMENT Md_getriebe "Eingangsmoment Getriebe" SWORD Def_m_sw_q0p1 1 100 -3276.80 3276.70 FORMAT "%7.2" ECU_ADDRESS 0xC000A3E6 /end MEASUREMENT
/begin MEASUREMENT Md_max_acwm "max. Begrenzungsmoment Klimaanlage" SWORD Def_m_sw_q0p1 1 100 -3276.80 3276.70 FORMAT "%7.2" ECU_ADDRESS 0xC000A3E8 /end MEASUREMENT
/begin MEASUREMENT Md_mgmax "maximalmoment Generator" SWORD Def_m_sw_q0p1 1 100 -3276.80 3276.70 FORMAT "%7.2" ECU_ADDRESS 0xC000A3EA /end MEASUREMENT
/begin MEASUREMENT Md_na_ac "Verlustmoment Klimakompressor" SWORD Def_m_sw_q0p1 1 100 -3276.80 3276.70 FORMAT "%7.2" ECU_ADDRESS 0xC000A3EC /end MEASUREMENT
/begin MEASUREMENT Md_na_ars "Verlustmoment aktive Rollstabilisierung" SWORD Def_m_sw_q0p1 1 100 -3276.80 3276.70 FORMAT "%7.2" ECU_ADDRESS 0xC000A3EE /end MEASUREMENT
/begin MEASUREMENT Md_na_ef "iCM Verbraucher" SWORD Def_m_sw_q0p1 1 100 -3276.80 3276.70 FORMAT "%7.2" ECU_ADDRESS 0xC000A3F0 /end MEASUREMENT
/begin MEASUREMENT Md_na_efmax "iCM Verbraucher" SWORD Def_m_sw_q0p1 1 100 -3276.80 3276.70 FORMAT "%7.2" ECU_ADDRESS 0xC000A3F2 /end MEASUREMENT
/begin MEASUREMENT Md_na_efprae "" SWORD Def_m_sw_q0p1 1 100 -3276.80 3276.70 FORMAT "%7.2" ECU_ADDRESS 0xC000A3F4 /end MEASUREMENT
/begin MEASUREMENT Md_na_sl "Verlustmoment Servopumpe" SWORD Def_m_sw_q0p1 1 100 -3276.80 3276.70 FORMAT "%7.2" ECU_ADDRESS 0xC000A3F6 /end MEASUREMENT
/begin MEASUREMENT Md_rad_ist "Ist-Moment an den Antriebsrädern" SLONG Def_m_sl_q0p1 1 100 -214748365. 214748365. FORMAT "%9.0" ECU_ADDRESS 0xC00090C8 /end MEASUREMENT
/begin MEASUREMENT Me_ist "Einspritzmasse aktuell" SWORD Def_me_sw_q0p01 1 100 -327.6800 327.6700 FORMAT "%8.4" ECU_ADDRESS 0xC000A3F8 /end MEASUREMENT
/begin MEASUREMENT Mk_soll_omar "Soll-Einspritzmenge ohne Mengenausgleichsregelung" SWORD Def_me_sw_q0p01 1 100 -327.6800 327.6700 FORMAT "%8.4" ECU_ADDRESS 0xC000A3FA /end MEASUREMENT
/begin MEASUREMENT Ml "Luftmasse pro Zylinder" SWORD Def_ml_sw_q0p1 1 100 -3276.80 3276.70 FORMAT "%7.2" ECU_ADDRESS 0xC000A3FC /end MEASUREMENT
/begin MEASUREMENT Mslui "integrierte Luftmasse" UWORD Def_lm_uw_q0p000444 1 100 0.00 29.126667 FORMAT "%9.6" ECU_ADDRESS 0xC000A3FE /end MEASUREMENT
/begin MEASUREMENT Na_bnanteil "Bordnetzanteil Nebebaggregate" UBYTE Def_f_ub_b2 1 100 0.00 1.9922 ECU_ADDRESS 0xC000B2E6 /end MEASUREMENT
/begin MEASUREMENT Newp_soll "Solldrehzahl elektrische Wasserpumpe" UBYTE Def_dez_ub_q1 1 100 0.00 255. FORMAT "%3.0" ECU_ADDRESS 0xC000B2E7 /end MEASUREMENT
/begin MEASUREMENT Nkw "Motordrehzahl an der Kurbelwelle" SWORD Def_n_sw_q1p0 1 100 -32768. 32767. FORMAT "%5.0" ECU_ADDRESS 0xC000A400 /end MEASUREMENT
/begin MEASUREMENT Nkw_grad "Drehzahlgradient" SBYTE Def_ngrd_sb_q32p0 1 100 -4096. 4064. FORMAT "%5.0" ECU_ADDRESS 0xC000B2E8 /end MEASUREMENT
/begin MEASUREMENT Nkw_grad_fpt1 "Gradient Drehzahl gefiltert über PT1" SBYTE Def_ngrd_sb_q32p0 1 100 -4096. 4064. FORMAT "%5.0" ECU_ADDRESS 0xC000B2E9 /end MEASUREMENT
/begin MEASUREMENT Nkw_zahn "Drehzahl aus KW-Zähnen" SWORD Def_n_sw_q1p0 1 100 -32768. 32767. FORMAT "%5.0" ECU_ADDRESS 0xC000A402 /end MEASUREMENT
/begin MEASUREMENT Nmax_var "roter Drehzahlbereich" SWORD Def_n_sw_q1p0 1 100 -32768. 32767. FORMAT "%5.0" ECU_ADDRESS 0xC000A404 /end MEASUREMENT
/begin MEASUREMENT NSCDsRLam_rLam "Reziproke Lambdawert aus dem Sensor nach NSC" SWORD lambda 1 100 -32.76800 32.76700 ECU_ADDRESS 0xD00010FE /end MEASUREMENT
/begin MEASUREMENT NSCDsRLam_rLamRec "Reziproke Lambdawert aus dem Sensor nach Turbine" SWORD lambdaRecVal 1 100 -32.76800 32.76700 FORMAT "%8.5" ECU_ADDRESS 0xD0001100 /end MEASUREMENT
/begin MEASUREMENT Nsllm "Solldrehzahl im Leerlauf ohne Fahrstufe" SWORD Def_n_sw_q1p0 1 100 -32768. 32767. FORMAT "%5.0" ECU_ADDRESS 0xC000A406 /end MEASUREMENT
/begin MEASUREMENT Nsllm2 "Solldrehzahl im Leerlauf ohne Fahrstufe" SWORD Def_n_sw_q1p0 1 100 -32768. 32767. FORMAT "%5.0" ECU_ADDRESS 0xC000A408 /end MEASUREMENT
/begin MEASUREMENT Nstat "Solldrehzahl ohne Nachführung" SWORD Def_n_sw_q1p0 1 100 -32768. 32767. FORMAT "%5.0" ECU_ADDRESS 0xC000A40A /end MEASUREMENT
/begin MEASUREMENT Nturb "Drehzahl Getriebeeingang" SWORD Def_n_sw_q1p0 1 100 -32768. 32767. FORMAT "%5.0" ECU_ADDRESS 0xC000A40C /end MEASUREMENT
/begin MEASUREMENT N_ab "Abtriebsdrehzahl" SWORD Def_n_sw_q1p0 1 100 -32768. 32767. FORMAT "%5.0" ECU_ADDRESS 0xC000A40E /end MEASUREMENT
/begin MEASUREMENT N_nstart "Motordrehzahl nach Motorstart" SWORD Def_n_sw_q1p0 1 100 -32768. 32767. FORMAT "%5.0" ECU_ADDRESS 0xC000A48A /end MEASUREMENT
/begin MEASUREMENT Oz_datstat "Status Anzeige Uhrzeit Datum" UBYTE Def_dez_ub_q1 1 100 0.00 255. FORMAT "%3.0" ECU_ADDRESS 0xC000B2EA /end MEASUREMENT
/begin MEASUREMENT Oz_dieselein "Dieseleintrag in Liter" UWORD Def_dez_uw_q0p01 1 100 0.00 655.3500 FORMAT "%8.4" ECU_ADDRESS 0xC000A410 /end MEASUREMENT
/begin MEASUREMENT Oz_lf1c "Länderfaktor 1 codiert" UBYTE Def_lf_ub_q0p01 1 100 0.00 2.550 FORMAT "%5.3" ECU_ADDRESS 0xC000B2EB /end MEASUREMENT
/begin MEASUREMENT Oz_lf2c "Länderfaktor 2 codiert" UBYTE Def_lf_ub_q0p01 1 100 0.00 2.550 FORMAT "%5.3" ECU_ADDRESS 0xC000B2EC /end MEASUREMENT
/begin MEASUREMENT Oz_nivr "Rohwert Ölniveau vom Sensor" UBYTE Def_dez_ub_q1 1 100 0.00 255. FORMAT "%3.0" ECU_ADDRESS 0xC000B2ED /end MEASUREMENT
/begin MEASUREMENT Oz_permr "Rohwert Permittivität v. Sensor" UWORD Def_dez_uw_q1 1 100 0.00 65535. FORMAT "%5.0" ECU_ADDRESS 0xC000A412 /end MEASUREMENT
/begin MEASUREMENT Oz_resetr "Status der Resetart vom Kombi" UBYTE Def_dez_ub_q1 1 100 0.00 255. FORMAT "%3.0" ECU_ADDRESS 0xC000B2EE /end MEASUREMENT
/begin MEASUREMENT Oz_status "Statusinfo vom Sensor" UBYTE Def_dez_ub_q1 1 100 0.00 255. FORMAT "%3.0" ECU_ADDRESS 0xC000B2EF /end MEASUREMENT
/begin MEASUREMENT Oz_tempr "Rohwert Öltemperatur v. Sensor" UBYTE Def_dez_ub_q1 1 100 0.00 255. FORMAT "%3.0" ECU_ADDRESS 0xC000B2F0 /end MEASUREMENT
/begin MEASUREMENT Pbremsu "Bremskraftverstärkerunterdruck in hPa" UWORD Def_p_uw_q1 1 100 0.00 65535. FORMAT "%6.0" ECU_ADDRESS 0xC000A414 /end MEASUREMENT
/begin MEASUREMENT Phdp "Druck für HDP" UWORD Def_p_uw_q0p001 1 100 0.00 65.53500 FORMAT "%8.5" ECU_ADDRESS 0xC000A416 /end MEASUREMENT
/begin MEASUREMENT Pkstvf "Kraftstoffdruck vor Filter" UWORD Def_p_uw_q0p001 1 100 0.00 65.53500 FORMAT "%8.5" ECU_ADDRESS 0xC000A418 /end MEASUREMENT
/begin MEASUREMENT Pld "Ladedruck" SWORD Def_p_sw_q1 1 100 -32768. 32767. FORMAT "%6.0" ECU_ADDRESS 0xC000A41A /end MEASUREMENT
/begin MEASUREMENT Pmrestore "Restorespeicher" UBYTE Def_dez_ub_q1 1 100 0.00 255. FORMAT "%3.0" ARRAY_SIZE 7 ECU_ADDRESS 0xC000C2FC /end MEASUREMENT
/begin MEASUREMENT Pmsv "angemeldete Powermanagment Standverbraucher" UBYTE Def_dez_ub_q1 1 100 0.00 255. FORMAT "%3.0" ARRAY_SIZE 15 ECU_ADDRESS 0xC000C303 /end MEASUREMENT
/begin MEASUREMENT Pu "Umgebungsluftdruck" UWORD Def_p_uw_q0p039 1 100 0.00 2559.96 FORMAT "%7.2" ECU_ADDRESS 0xC000A41C /end MEASUREMENT
/begin MEASUREMENT Pwg_grad "Delta Pedalwertgeber im 10ms_Raster gerechnet" SWORD Def_pwggrd_sw_b2500 1 100 -20000.00 19999.39 FORMAT "%8.2" ECU_ADDRESS 0xC000A41E /end MEASUREMENT
/begin MEASUREMENT Pwg_ist "Pedalwert Fahrerwunsch in %" SWORD Def_wdk_sw_q0p0244 1 100 -800.000 799.976 FORMAT "%7.3" ECU_ADDRESS 0xC000A420 /end MEASUREMENT
/begin MEASUREMENT Pwg_max "max(Pwg_virt,Pwg_ist)" SWORD Def_wdk_sw_q0p0244 1 100 -800.000 799.976 FORMAT "%7.3" ECU_ADDRESS 0xC000A422 /end MEASUREMENT
/begin MEASUREMENT PwrMng_nMin "" SWORD EngN 1 100 -16384.00 16383.50 ECU_ADDRESS 0xD0001274 /end MEASUREMENT
/begin MEASUREMENT P_gle "Glühleistung" UWORD Def_p_uw_q0p039 1 100 0.00 2559.96 FORMAT "%7.2" ECU_ADDRESS 0xC000A424 /end MEASUREMENT
/begin MEASUREMENT Qelad_ibsl "" UWORD Def_ql_uw_q0p0182 1 100 0.00 1192.750 FORMAT "%8.3" ECU_ADDRESS 0xC000A426 /end MEASUREMENT
/begin MEASUREMENT Qlad_ibsl "Zähler Batterieladung" UWORD Def_ql_uw_q0p0182 1 100 0.00 1192.750 FORMAT "%8.3" ECU_ADDRESS 0xC000A428 /end MEASUREMENT
/begin MEASUREMENT Qv_cdherst_1 "Codierung Hersteller 1" UBYTE Def_dez_ub_q1 1 100 0.00 255. FORMAT "%3.0" ECU_ADDRESS 0xC000B2F1 /end MEASUREMENT
/begin MEASUREMENT Qv_cdherst_2 "Codierung Hersteller 2" UBYTE Def_dez_ub_q1 1 100 0.00 255. FORMAT "%3.0" ECU_ADDRESS 0xC000B2F2 /end MEASUREMENT
/begin MEASUREMENT Qv_cdherst_3 "Codierung Hersteller 3" UBYTE Def_dez_ub_q1 1 100 0.00 255. FORMAT "%3.0" ECU_ADDRESS 0xC000B2F3 /end MEASUREMENT
/begin MEASUREMENT Qv_cdherst_4 "Codierung Hersteller 4" UBYTE Def_dez_ub_q1 1 100 0.00 255. FORMAT "%3.0" ECU_ADDRESS 0xC000B2F4 /end MEASUREMENT
/begin MEASUREMENT Qv_cdherst_5 "Codierung Hersteller 5" UBYTE Def_dez_ub_q1 1 100 0.00 255. FORMAT "%3.0" ECU_ADDRESS 0xC000B2F5 /end MEASUREMENT
/begin MEASUREMENT Qv_cdherst_6 "Codierung Hersteller 6" UBYTE Def_dez_ub_q1 1 100 0.00 255. FORMAT "%3.0" ECU_ADDRESS 0xC000B2F6 /end MEASUREMENT
/begin MEASUREMENT Qv_cdherst_7 "Codierung Hersteller 7" UBYTE Def_dez_ub_q1 1 100 0.00 255. FORMAT "%3.0" ECU_ADDRESS 0xC000B2F7 /end MEASUREMENT
/begin MEASUREMENT Qv_cdherst_8 "Codierung Hersteller 8" UBYTE Def_dez_ub_q1 1 100 0.00 255. FORMAT "%3.0" ECU_ADDRESS 0xC000B2F8 /end MEASUREMENT
/begin MEASUREMENT Qv_nv_rc "Fit Parameter Batterie" SLONG Def_u_sl_b131072 1 100 -131072.00 131072.00 FORMAT "%9.2" ECU_ADDRESS 0xC00090CC /end MEASUREMENT
/begin MEASUREMENT Rf "relative Füllung" SWORD Def_rf_sw_q0p01 1 100 -327.68000 327.67000 FORMAT "%9.5" ECU_ADDRESS 0xC000A42A /end MEASUREMENT
/begin MEASUREMENT St_aepflasholin "Statuswort AEPFLASHOL (Eingang)" UBYTE Def_dez_ub_q1 1 100 0.00 255. FORMAT "%3.0" ECU_ADDRESS 0xC000B2F9 /end MEASUREMENT
/begin MEASUREMENT St_agr "Statusbyte agr" UBYTE Def_st_ub_q1 1 100 0.00 255. FORMAT "%3.0" ECU_ADDRESS 0xC000B2FA /end MEASUREMENT
/begin MEASUREMENT St_anman1 "Status ANMAN" UBYTE Def_st_ub_q1 1 100 0.00 255. FORMAT "%3.0" ECU_ADDRESS 0xC000B2FB /end MEASUREMENT
/begin MEASUREMENT St_antrieb "Statuswort Schaltpunktanzeige" UBYTE Def_st_ub_q1 1 100 0.00 255. FORMAT "%3.0" ECU_ADDRESS 0xC000B2FC /end MEASUREMENT
/begin MEASUREMENT St_bgkuppl "Statusbyte bgkuppl" UBYTE Def_st_ub_q1 1 100 0.00 255. FORMAT "%3.0" ECU_ADDRESS 0xC000B2FD /end MEASUREMENT
/begin MEASUREMENT St_bldstg "Statuswort" UBYTE Def_st_ub_q1 1 100 0.00 255. FORMAT "%3.0" ECU_ADDRESS 0xC000B34C /end MEASUREMENT
/begin MEASUREMENT St_bls "Statuswort Bremslichtschalter" UBYTE Def_st_ub_q1 1 100 0.00 255. FORMAT "%3.0" ECU_ADDRESS 0xC000B2FE /end MEASUREMENT
/begin MEASUREMENT St_ckl15 "Statusbyte Klemmensignale vom CAN" UBYTE Def_st_ub_q1 1 100 0.00 255. FORMAT "%3.0" ECU_ADDRESS 0xC000B2FF /end MEASUREMENT
/begin MEASUREMENT St_devxdetec "Ergebnis BSD-Lernfunktion" UBYTE Def_dez_ub_q1 1 100 0.00 255. FORMAT "%3.0" ECU_ADDRESS 0xC000B300 /end MEASUREMENT
/begin MEASUREMENT St_ecostat1 "Ecos Statusbyte 1" UBYTE Def_st_ub_q1 1 100 0.00 255. FORMAT "%3.0" ECU_ADDRESS 0xC000B301 /end MEASUREMENT
/begin MEASUREMENT St_egs "Statusbyte Automatikgetriebe" UBYTE Def_st_ub_q1 1 100 0.00 255. FORMAT "%3.0" ECU_ADDRESS 0xC000B302 /end MEASUREMENT
/begin MEASUREMENT St_fgr "Status FGR" UBYTE Def_st_ub_q1 1 100 0.00 255. FORMAT "%3.0" ECU_ADDRESS 0xC000B303 /end MEASUREMENT
/begin MEASUREMENT St_fw "Statuswort mdfw" UBYTE Def_st_ub_q1 1 100 0.00 255. FORMAT "%3.0" ECU_ADDRESS 0xC000B304 /end MEASUREMENT
/begin MEASUREMENT St_fzg_1 "Variante Fzg" ULONG Def_dez_ul_q1 1 100 0.00 4294967295. FORMAT "%7.0" ECU_ADDRESS 0xC00090D0 /end MEASUREMENT
/begin MEASUREMENT St_fzg_variante "Statusbyte Fzg" UBYTE Def_st_ub_q1 1 100 0.00 255. FORMAT "%3.0" ECU_ADDRESS 0xC000B305 /end MEASUREMENT
/begin MEASUREMENT St_gang "Status Rückwärtsgang" UBYTE Def_st_ub_q1 1 100 0.00 255. FORMAT "%3.0" ECU_ADDRESS 0xC000B306 /end MEASUREMENT
/begin MEASUREMENT St_genallg "Statusbyte Generator allgemein" UBYTE Def_st_ub_q1 1 100 0.00 255. FORMAT "%3.0" ECU_ADDRESS 0xC000B307 /end MEASUREMENT
/begin MEASUREMENT St_generator "Statusbyte Generator" UBYTE Def_st_ub_q1 1 100 0.00 255. FORMAT "%3.0" ECU_ADDRESS 0xC000B308 /end MEASUREMENT
/begin MEASUREMENT St_geniutest_def "--" UBYTE Def_st_ub_q1 1 100 0.00 255. FORMAT "%3.0" ECU_ADDRESS 0xC000B309 /end MEASUREMENT
/begin MEASUREMENT St_genll "Statusbyte LR-Eingänge Generator" UBYTE Def_st_ub_q1 1 100 0.00 255. FORMAT "%3.0" ECU_ADDRESS 0xC000B30A /end MEASUREMENT
/begin MEASUREMENT St_gen_ext "Statusbyte Generator extern" UBYTE Def_st_ub_q1 1 100 0.00 255. FORMAT "%3.0" ECU_ADDRESS 0xC000B30B /end MEASUREMENT
/begin MEASUREMENT St_getriebe "Statusbyte Getriebe" UBYTE Def_st_ub_q1 1 100 0.00 255. FORMAT "%3.0" ECU_ADDRESS 0xC000B30C /end MEASUREMENT
/begin MEASUREMENT St_ibs "Statusbyte IBS" UBYTE Def_st_ub_q1 1 100 0.00 255. FORMAT "%3.0" ECU_ADDRESS 0xC000B30D /end MEASUREMENT
/begin MEASUREMENT St_ibsl_chg "4. Byte Ladezustand_Status_IBS_LIN" UBYTE Def_st_ub_q1 1 100 0.00 255. FORMAT "%3.0" ECU_ADDRESS 0xC000B30E /end MEASUREMENT
/begin MEASUREMENT St_ibsl_diag0 "IBS Status-/Fehlerbyte" UBYTE Def_st_ub_q1 1 100 0.00 255. FORMAT "%3.0" ECU_ADDRESS 0xC000B30F /end MEASUREMENT
/begin MEASUREMENT St_ibsl_diag1 "IBS Status-/Fehlerbyte" UBYTE Def_st_ub_q1 1 100 0.00 255. FORMAT "%3.0" ECU_ADDRESS 0xC000B310 /end MEASUREMENT
/begin MEASUREMENT St_ibsl_diag2 "IBS Staus-/Fehlerbyte" UBYTE Def_st_ub_q1 1 100 0.00 255. FORMAT "%3.0" ECU_ADDRESS 0xC000B311 /end MEASUREMENT
/begin MEASUREMENT St_ibsl_diag3 "IBS Staus-/Fehlerbyte" UBYTE Def_st_ub_q1 1 100 0.00 255. FORMAT "%3.0" ECU_ADDRESS 0xC000B312 /end MEASUREMENT
/begin MEASUREMENT St_ibsl_stat0 "IBS-Statusbyte" UBYTE Def_st_ub_q1 1 100 0.00 255. FORMAT "%3.0" ECU_ADDRESS 0xC000B313 /end MEASUREMENT
/begin MEASUREMENT St_ibsl_stat1 "IBS Statusbyte" UBYTE Def_st_ub_q1 1 100 0.00 255. FORMAT "%3.0" ECU_ADDRESS 0xC000B314 /end MEASUREMENT
/begin MEASUREMENT St_ibsl_stat2 "IBS Statusbyte" UBYTE Def_st_ub_q1 1 100 0.00 255. FORMAT "%3.0" ECU_ADDRESS 0xC000B315 /end MEASUREMENT
/begin MEASUREMENT St_igrin "Statuswort St_igrin" UBYTE Def_dez_ub_q1 1 100 0.00 255. FORMAT "%3.0" ECU_ADDRESS 0xC000B316 /end MEASUREMENT
/begin MEASUREMENT St_igrinnv "Statuswort St_igrinnv" UBYTE Def_dez_ub_q1 1 100 0.00 255. FORMAT "%3.0" ECU_ADDRESS 0xC000B317 /end MEASUREMENT
/begin MEASUREMENT St_imdgen_1s "Statusbyte imdgen_1s" UBYTE Def_st_ub_q1 1 100 0.00 255. FORMAT "%3.0" ECU_ADDRESS 0xC000B318 /end MEASUREMENT
/begin MEASUREMENT St_instr3_1 "Statusbyte CAN Botschaft Instr3" UBYTE Def_st_ub_q1 1 100 0.00 255. FORMAT "%3.0" ECU_ADDRESS 0xC000B319 /end MEASUREMENT
/begin MEASUREMENT St_kat "Statuswort Kat" UBYTE Def_st_ub_q1 1 100 0.00 255. FORMAT "%3.0" ECU_ADDRESS 0xC000B31A /end MEASUREMENT
/begin MEASUREMENT St_kl15 "Statusbyte Klemme 15" UBYTE Def_st_ub_q1 1 100 0.00 255. FORMAT "%3.0" ECU_ADDRESS 0xC000B31B /end MEASUREMENT
/begin MEASUREMENT St_ldstgen "Lastzustand Generator elektrisch/thermisch" UBYTE Def_st_ub_q1 1 100 0.00 255. FORMAT "%3.0" ECU_ADDRESS 0xC000B34D /end MEASUREMENT
/begin MEASUREMENT St_llr "Statusword Leerlaufregler" UWORD Def_st_uw_q1 1 100 0.00 65535. FORMAT "%5.0" ECU_ADDRESS 0xC000A42C /end MEASUREMENT
/begin MEASUREMENT St_lsu "Statusbyte lsu" UBYTE Def_st_ub_q1 1 100 0.00 255. FORMAT "%3.0" ECU_ADDRESS 0xC000B31C /end MEASUREMENT
/begin MEASUREMENT St_master "Statusbyte Master" UBYTE Def_st_ub_q1 1 100 0.00 255. FORMAT "%3.0" ECU_ADDRESS 0xC000B31D /end MEASUREMENT
/begin MEASUREMENT St_mdaddon "vorübergehende additive Momenterhöhung des Bergrenzungsmomentes" UBYTE Def_st_ub_q1 1 100 0.00 255. FORMAT "%3.0" ECU_ADDRESS 0xC000B31E /end MEASUREMENT
/begin MEASUREMENT St_mdinfo_s "Status Momenteneingriff" UWORD Def_st_uw_q1 1 100 0.00 65535. FORMAT "%5.0" ECU_ADDRESS 0xC000A42E /end MEASUREMENT
/begin MEASUREMENT St_mdna "Statusbyte Momentenaufnahme der Nebenaggregate" UBYTE Def_st_ub_q1 1 100 0.00 255. FORMAT "%3.0" ECU_ADDRESS 0xC000B31F /end MEASUREMENT
/begin MEASUREMENT St_mdssm "Statuswort mdssm" UBYTE Def_st_ub_q1 1 100 0.00 255. FORMAT "%3.0" ECU_ADDRESS 0xC000B320 /end MEASUREMENT
/begin MEASUREMENT St_mkwchn "Statusbyte Masterkurbelwelle" UBYTE Def_st_ub_q1 1 100 0.00 255. FORMAT "%3.0" ECU_ADDRESS 0xC000B321 /end MEASUREMENT
/begin MEASUREMENT St_motzustd "Statuswort Motorzustand" UWORD Def_st_uw_q1 1 100 0.00 65535. FORMAT "%5.0" ECU_ADDRESS 0xC000A430 /end MEASUREMENT
/begin MEASUREMENT St_msae "Statusword msae" UWORD Def_st_uw_q1 1 100 0.00 65535. FORMAT "%5.0" ECU_ADDRESS 0xC000A432 /end MEASUREMENT
/begin MEASUREMENT St_msaklima "Statusbyte Klima" UBYTE Def_dez_ub_q1 1 100 0.00 255. FORMAT "%3.0" ECU_ADDRESS 0xC000B322 /end MEASUREMENT
/begin MEASUREMENT St_nwf "-" UBYTE Def_st_ub_q1 1 100 0.00 255. FORMAT "%3.0" ECU_ADDRESS 0xC000B323 /end MEASUREMENT
/begin MEASUREMENT St_oz "Statuswort Eingangsgröáen Ölzustandssensor" UBYTE Def_dez_ub_q1 1 100 0.00 255. FORMAT "%3.0" ECU_ADDRESS 0xC000B324 /end MEASUREMENT
/begin MEASUREMENT St_oz_i "Statusbyte für Eingang OZ" UBYTE Def_dez_ub_q1 1 100 0.00 255. FORMAT "%3.0" ECU_ADDRESS 0xC000B325 /end MEASUREMENT
/begin MEASUREMENT St_phdp "Status Niederdrucksensor" UBYTE Def_dez_ub_q1 1 100 0.00 255. FORMAT "%3.0" ECU_ADDRESS 0xC000B326 /end MEASUREMENT
/begin MEASUREMENT St_pld "Statusbyte pld" UBYTE Def_st_ub_q1 1 100 0.00 255. FORMAT "%3.0" ECU_ADDRESS 0xC000B327 /end MEASUREMENT
/begin MEASUREMENT St_pmcbsin "--" UBYTE Def_st_ub_q1 1 100 0.00 255. FORMAT "%3.0" ECU_ADDRESS 0xC000B328 /end MEASUREMENT
/begin MEASUREMENT St_pmi "Statusbyte LCP-Eingänge" UBYTE Def_st_ub_q1 1 100 0.00 255. FORMAT "%3.0" ECU_ADDRESS 0xC000B329 /end MEASUREMENT
/begin MEASUREMENT St_pmi_nv "Statusbyte LCP-Eingänge nv" UBYTE Def_st_ub_q1 1 100 0.00 255. FORMAT "%3.0" ECU_ADDRESS 0xC000B32A /end MEASUREMENT
/begin MEASUREMENT St_pmprsv_nv "!!! DUMMY !!!" UBYTE Def_st_ub_q1 1 100 0.00 255. FORMAT "%3.0" ECU_ADDRESS 0xC000B32B /end MEASUREMENT
/begin MEASUREMENT St_ptc_pwr "Statusrückmeldung für individuelle Ansteuerung für einen Sonderverbraucher (PTC)" UBYTE Def_f_ub_b127p5 1 100 0.00 127.5 FORMAT "%5.1" ECU_ADDRESS 0xC000B32C /end MEASUREMENT
/begin MEASUREMENT St_pwf "Statusbyte Powerfail" UBYTE Def_st_ub_q1 1 100 0.00 255. FORMAT "%3.0" ECU_ADDRESS 0xC000B32D /end MEASUREMENT
/begin MEASUREMENT St_sawe "Statusbyte Schubabschaltung(Wiedereinsetzen" UBYTE Def_st_ub_q1 1 100 0.00 255. FORMAT "%3.0" ECU_ADDRESS 0xC000B32E /end MEASUREMENT
/begin MEASUREMENT St_slp "Statusbyte Sekundärluftpumpe" UBYTE Def_st_ub_q1 1 100 0.00 255. FORMAT "%3.0" ECU_ADDRESS 0xC000B32F /end MEASUREMENT
/begin MEASUREMENT St_spa_in "Statuswort Schaltpunktanzeige" UBYTE Def_st_ub_q1 1 100 0.00 255. FORMAT "%3.0" ECU_ADDRESS 0xC000B330 /end MEASUREMENT
/begin MEASUREMENT St_start "Status Start" UBYTE Def_st_ub_q1 1 100 0.00 255. FORMAT "%3.0" ECU_ADDRESS 0xC000B331 /end MEASUREMENT
/begin MEASUREMENT St_stat "Statusbyte Statemachine DFH" UBYTE Def_dez_ub_q1 1 100 0.00 255. FORMAT "%3.0" ECU_ADDRESS 0xC000B332 /end MEASUREMENT
/begin MEASUREMENT St_tum "Statusbyte Umgebungstemperatur" UBYTE Def_st_ub_q1 1 100 0.00 255. FORMAT "%3.0" ECU_ADDRESS 0xC000B333 /end MEASUREMENT
/begin MEASUREMENT St_ubw "" UBYTE Def_dez_ub_q1 1 100 0.00 255. FORMAT "%3.0" ECU_ADDRESS 0xC000B334 /end MEASUREMENT
/begin MEASUREMENT St_verbentl "Status PMVERBENTL" UBYTE Def_dez_ub_q1 1 100 0.00 255. FORMAT "%3.0" ECU_ADDRESS 0xC000B335 /end MEASUREMENT
/begin MEASUREMENT St_wk "Statusbyte WK" UBYTE Def_dez_ub_q1 1 100 0.00 255. FORMAT "%3.0" ECU_ADDRESS 0xC000B336 /end MEASUREMENT
/begin MEASUREMENT St_wm "Statusbyte wm" UBYTE Def_st_ub_q1 1 100 0.00 255. FORMAT "%3.0" ECU_ADDRESS 0xC000B337 /end MEASUREMENT
/begin MEASUREMENT St_zwktibs "Statusbyte Zwktibs" UBYTE Def_st_ub_q1 1 100 0.00 255. FORMAT "%3.0" ECU_ADDRESS 0xC000B338 /end MEASUREMENT
/begin MEASUREMENT Swmsaav "Selektive temporäre Deaktivierung AVs bis zum nächsten Zündungswechsel" ULONG Def_dez_ul_q1 1 100 0.00 4294967295. FORMAT "%7.0" ECU_ADDRESS 0xC00090D4 /end MEASUREMENT
/begin MEASUREMENT Tans "Ansauglufttemperatur" SWORD Def_t_sw_q0p1 1 100 -3276.8 3276.7 FORMAT "%6.1" ECU_ADDRESS 0xC000A434 /end MEASUREMENT
/begin MEASUREMENT Tchip "Chiptemperatur Generator 1" SWORD Def_t_sw_q0p1 1 100 -3276.8 3276.7 FORMAT "%6.1" ECU_ADDRESS 0xC000A436 /end MEASUREMENT
/begin MEASUREMENT Td_kl30b_off "verbleibende Zeit bis Abschalten Stromversorgung" UWORD Def_dez_uw_q1 1 100 0.00 65535. FORMAT "%5.0" ECU_ADDRESS 0xC000A438 /end MEASUREMENT
/begin MEASUREMENT Td_og_cnt "Zähler für fallende Flanken im TÖNS_Signal" UBYTE Def_dez_ub_q1 1 100 0.00 255. FORMAT "%3.0" ECU_ADDRESS 0xC000B339 /end MEASUREMENT
/begin MEASUREMENT Td_og_icnt "Zeit zwischen 2 Fallenden Flanken" UWORD Def_td_uw_q0p01 1 100 0.00 655.350 FORMAT "%7.3" ECU_ADDRESS 0xC000A43A /end MEASUREMENT
/begin MEASUREMENT Td_og_tk "Abkühlzeit von TÖNS" UWORD Def_td_uw_q0p1 1 100 0.00 6553.5 FORMAT "%6.1" ECU_ADDRESS 0xC000A43C /end MEASUREMENT
/begin MEASUREMENT Td_og_tr "Referntzeit" UWORD Def_td_uw_q0p1 1 100 0.00 6553.5 FORMAT "%6.1" ECU_ADDRESS 0xC000A43E /end MEASUREMENT
/begin MEASUREMENT Td_og_tv "Temperaturzeit von TÖNS" UWORD Def_td_uw_q0p1 1 100 0.00 6553.5 FORMAT "%6.1" ECU_ADDRESS 0xC000A440 /end MEASUREMENT
/begin MEASUREMENT Td_og_uplcnt "Zähler für unplausible signale" UBYTE Def_dez_ub_q1 1 100 0.00 255. FORMAT "%3.0" ECU_ADDRESS 0xC000B33A /end MEASUREMENT
/begin MEASUREMENT Td_rdgenreg2 "Auslesezeit für DF-Signal und Diagnose" UBYTE Def_td_ub_q0p1 1 100 0.00 25.5 FORMAT "%4.1" ECU_ADDRESS 0xC000B33B /end MEASUREMENT
/begin MEASUREMENT Tgen_ab "Abstelltemperatur Generator" SWORD Def_t_sw_q0p1 1 100 -3276.8 3276.7 FORMAT "%6.1" ECU_ADDRESS 0xC000A442 /end MEASUREMENT
/begin MEASUREMENT Tget "Getriebetemperatur" SWORD Def_t_sw_q0p01 1 100 -327.680 327.670 FORMAT "%7.3" ECU_ADDRESS 0xC000A444 /end MEASUREMENT
/begin MEASUREMENT Tkat_mod "modellierte Katalysatortemperatur" SWORD Def_t_sw_q0p1 1 100 -3276.8 3276.7 FORMAT "%6.1" ECU_ADDRESS 0xC000A446 /end MEASUREMENT
/begin MEASUREMENT Tkst "Kraftstofftemperatur" SWORD Def_t_sw_q0p01 1 100 -327.680 327.670 FORMAT "%7.3" ECU_ADDRESS 0xC000A448 /end MEASUREMENT
/begin MEASUREMENT Tlrfgen "Kopie Generator1 LR Vorgabe auf Bus gelegt" UBYTE Def_td_ub_q0p1 1 100 0.00 25.5 FORMAT "%4.1" ECU_ADDRESS 0xC000B33C /end MEASUREMENT
/begin MEASUREMENT Tlrgen_ext "Loadresponse vom Tester" UBYTE Def_td_ub_q0p1 1 100 0.00 25.5 FORMAT "%4.1" ECU_ADDRESS 0xC000B33D /end MEASUREMENT
/begin MEASUREMENT Tluft "Lufttemperatur" SWORD Def_t_sw_q0p01 1 100 -327.680 327.670 FORMAT "%7.3" ECU_ADDRESS 0xC000A44A /end MEASUREMENT
/begin MEASUREMENT Tluft_pf "Temperatur Luft vor Partikelfilter" SWORD Def_t_sw_q0p1 1 100 -3276.8 3276.7 FORMAT "%6.1" ECU_ADDRESS 0xC000A44C /end MEASUREMENT
/begin MEASUREMENT Tmot "Kühlwassertemperatur" SWORD Def_t_sw_q0p01 1 100 -327.680 327.670 FORMAT "%7.3" ECU_ADDRESS 0xC000A44E /end MEASUREMENT
/begin MEASUREMENT Tmot_abstell "Motorabstelltemperatur" SWORD Def_t_sw_q0p01 1 100 -327.680 327.670 FORMAT "%7.3" ECU_ADDRESS 0xC000A450 /end MEASUREMENT
/begin MEASUREMENT Tmot_start "Motorstarttemperatur" SWORD Def_t_sw_q0p01 1 100 -327.680 327.670 FORMAT "%7.3" ECU_ADDRESS 0xC000A452 /end MEASUREMENT
/begin MEASUREMENT Tn_abstell "Abstellzeit" UWORD Def_dez_uw_q1 1 100 0.00 65535. FORMAT "%5.0" ECU_ADDRESS 0xC000A454 /end MEASUREMENT
/begin MEASUREMENT Tn_abstellm "Abstellzeit in Minuten" UWORD Def_tn_uw_q1 1 100 0.00 65535.0 FORMAT "%7.1" ECU_ADDRESS 0xC000A456 /end MEASUREMENT
/begin MEASUREMENT Tn_start_10 "Zeit nach Startende in 10ms aufgelöst" UWORD Def_td_uw_q0p01 1 100 0.00 655.350 FORMAT "%7.3" ECU_ADDRESS 0xC000A458 /end MEASUREMENT
/begin MEASUREMENT Toel_mdl "Modelltemperatur Motoröl" SWORD Def_t_sw_q0p1 1 100 -3276.8 3276.7 FORMAT "%6.1" ECU_ADDRESS 0xC000A45A /end MEASUREMENT
/begin MEASUREMENT TrbnDsRLam_rLam "Lambdawert aus dem Sensor nach Turbine" SWORD lambda 1 100 -32.76800 32.76700 ECU_ADDRESS 0xD0001430 /end MEASUREMENT
/begin MEASUREMENT TrbnDsRLam_rLamRec "Schittstellenbotschaft" SWORD lambdaRecVal 1 100 -32.76800 32.76700 FORMAT "%8.5" ECU_ADDRESS 0xD0001432 /end MEASUREMENT
/begin MEASUREMENT TrbnDsRLam_rO2PresComp "Schittstellenbotschaft" SWORD O2 1 100 -0.3276800 0.3276700 ECU_ADDRESS 0xD0001434 /end MEASUREMENT
/begin MEASUREMENT Tumg "Umgebungstemperatur" SWORD Def_t_sw_q0p1 1 100 -3276.8 3276.7 FORMAT "%6.1" ECU_ADDRESS 0xC000A45C /end MEASUREMENT
/begin MEASUREMENT Tumg_can "Umgebungstemperatur" SWORD Def_t_sw_q0p1 1 100 -3276.8 3276.7 FORMAT "%6.1" ECU_ADDRESS 0xC000A45E /end MEASUREMENT
/begin MEASUREMENT Tvngang "Tastverhältnis Nullgangsensor" UWORD Def_tv_uw_q0p01 1 100 0.00 655.350 FORMAT "%7.3" ECU_ADDRESS 0xC000A460 /end MEASUREMENT
/begin MEASUREMENT Tv_agr "Tastverhältnis AGR-Steller" SWORD Def_tv_sw_q0p01 1 100 -327.6800 327.6700 FORMAT "%8.4" ECU_ADDRESS 0xC000A462 /end MEASUREMENT
/begin MEASUREMENT Tv_pld "Tastverhältnis Ladedrucksteller" SWORD Def_tv_sw_q0p01 1 100 -327.6800 327.6700 FORMAT "%8.4" ECU_ADDRESS 0xC000A464 /end MEASUREMENT
/begin MEASUREMENT Tv_pldl "Tastverhältnis Ladedrucksteller low" SWORD Def_tv_sw_q0p01 1 100 -327.6800 327.6700 FORMAT "%8.4" ECU_ADDRESS 0xC000A466 /end MEASUREMENT
/begin MEASUREMENT Twasser "Wassertemperatur" SWORD Def_t_sw_q0p01 1 100 -327.680 327.670 FORMAT "%7.3" ECU_ADDRESS 0xC000A468 /end MEASUREMENT
/begin MEASUREMENT T_ibsl "BattTemp von IBS" UBYTE Def_t_ub_q0p75_o48 1 100 48.000 239.25 ECU_ADDRESS 0xC000B33E /end MEASUREMENT
/begin MEASUREMENT T_jahr "Borddatum" UWORD Def_dez_uw_q1 1 100 0.00 65535. FORMAT "%5.0" ECU_ADDRESS 0xC000A46A /end MEASUREMENT
/begin MEASUREMENT T_monate "Borddatum" UBYTE Def_dez_ub_q1 1 100 0.00 255. FORMAT "%3.0" ECU_ADDRESS 0xC000B33F /end MEASUREMENT
/begin MEASUREMENT T_tag "Borddatum" UBYTE Def_dez_ub_q1 1 100 0.00 255. FORMAT "%3.0" ECU_ADDRESS 0xC000B340 /end MEASUREMENT
/begin MEASUREMENT Ub "Bordnetzspannung" UWORD Def_u_uw_q0p0942 1 100 0.00 6173.4 FORMAT "%6.1" ECU_ADDRESS 0xC000A46C /end MEASUREMENT
/begin MEASUREMENT Ub_old_st "letzter Wert Batteriespannung für Starterkennung" UWORD Def_u_uw_q0p0942 1 100 0.00 6173.4 FORMAT "%6.1" ECU_ADDRESS 0xC000A48C /end MEASUREMENT
/begin MEASUREMENT Uekp "Spannung EKP" UBYTE Def_u_ub_q0p1 1 100 0.00 25.50 FORMAT "%5.2" ECU_ADDRESS 0xC000B341 /end MEASUREMENT
/begin MEASUREMENT Uregnom "Nominalspannung Regler Generator 1" UWORD Def_u_uw_q0p1 1 100 0.00 6553.500 FORMAT "%8.3" ECU_ADDRESS 0xC000A46E /end MEASUREMENT
/begin MEASUREMENT U_abgasvoxi "Spannungsrohwert der Abgastemperatur vor Oxi-Kat V" SWORD Def_u_sw_q0p00488 1 100 -5.000000 4.995117 FORMAT "%8.6" ECU_ADDRESS 0xC000A470 /end MEASUREMENT
/begin MEASUREMENT U_fgen "kopierter Wert von zum Generator gesendeter Sollspannung Generator 1" UWORD Def_u_uw_q0p1 1 100 0.00 6553.500 FORMAT "%8.3" ECU_ADDRESS 0xC000A472 /end MEASUREMENT
/begin MEASUREMENT U_gen_ext "physikalischer Wert Generatorsollspannung für Generator 1 vom Tester" UWORD Def_u_uw_q0p1 1 100 0.00 6553.500 FORMAT "%8.3" ECU_ADDRESS 0xC000A474 /end MEASUREMENT
/begin MEASUREMENT U_gen_slp "Spannungsanforderung Sekundärluftpumpe" UWORD Def_u_uw_q0p1 1 100 0.00 6553.500 FORMAT "%8.3" ECU_ADDRESS 0xC000A476 /end MEASUREMENT
/begin MEASUREMENT U_ibsl "BattSpannung von IBS" UWORD Def_u_uw_q0p001 1 100 0.00 65.53500 FORMAT "%8.5" ECU_ADDRESS 0xC000A478 /end MEASUREMENT
/begin MEASUREMENT V "Fahrzeuggeschwindigkeit" UWORD Def_v_uw_q1p0 1 100 0.00 360.0 FORMAT "%5.1" ECU_ADDRESS 0xC000A47A /end MEASUREMENT
/begin MEASUREMENT Var_at "Automatikgetriebe verbaut" UBYTE Def_dez_ub_q1 1 100 0.00 255. FORMAT "%3.0" ECU_ADDRESS 0xC000B342 /end MEASUREMENT
/begin MEASUREMENT Var_dkg "Variante DKG" UBYTE Def_dez_ub_q1 1 100 0.00 255. FORMAT "%3.0" ECU_ADDRESS 0xC000B343 /end MEASUREMENT
/begin MEASUREMENT Var_hs "Variante Handschalter erkannt" UBYTE Def_dez_ub_q1 1 100 0.00 255. FORMAT "%3.0" ECU_ADDRESS 0xC000B344 /end MEASUREMENT
/begin MEASUREMENT Var_ldm "Veariante LDM erkannt" UBYTE Def_dez_ub_q1 1 100 0.00 255. FORMAT "%3.0" ECU_ADDRESS 0xC000B345 /end MEASUREMENT
/begin MEASUREMENT Verbstatus "Verbraucherstatus" UBYTE Def_dez_ub_q1 1 100 0.00 255. FORMAT "%3.0" ARRAY_SIZE 10 ECU_ADDRESS 0xC000C312 /end MEASUREMENT
/begin MEASUREMENT Voltank "Tankinhalt" UWORD Def_vol_uw_q0p1 1 100 0.00 6553.500 FORMAT "%8.3" ECU_ADDRESS 0xC000A47C /end MEASUREMENT
/begin MEASUREMENT V_can "Fahrzeuggeschwindigkeit vom DSC" UWORD Def_v_uw_q0p1 1 100 0.00 6553.50 FORMAT "%7.2" ECU_ADDRESS 0xC000A47E /end MEASUREMENT
/begin MEASUREMENT V_krapu "Gewünschte Fördermenge der Kraftstoffpumpe in l/h" UBYTE Def_dez_ub_q1 1 100 0.00 255. FORMAT "%3.0" ECU_ADDRESS 0xC000B346 /end MEASUREMENT
/begin MEASUREMENT Wped "Pedalwertgeberposition" SWORD Def_tv_sw_q0p0244 1 100 -800.000 799.976 FORMAT "%7.3" ECU_ADDRESS 0xC000A480 /end MEASUREMENT
/begin MEASUREMENT W_afs "Lenkradwinkel" SWORD Def_wdk_sw_q0p1 1 100 -3276.80 3276.70 FORMAT "%7.2" ECU_ADDRESS 0xC000A482 /end MEASUREMENT
/begin MEASUREMENT W_dafs "Geschwindigkeit Lenkradwinkel" SWORD Def_wdk_sw_q0p1 1 100 -3276.80 3276.70 FORMAT "%7.2" ECU_ADDRESS 0xC000A484 /end MEASUREMENT
/begin MEASUREMENT W_ub "ungefilterte Bordnetzspannung" UBYTE Def_u_ub_q0p0942 1 100 0.00 24.0210 ECU_ADDRESS 0xC000B347 /end MEASUREMENT
/begin MEASUREMENT Zrbosr "Servicezähler vom Kombi" UBYTE Def_dez_ub_q1 1 100 0.00 255. FORMAT "%3.0" ECU_ADDRESS 0xC000B348 /end MEASUREMENT
/begin MEASUREMENT Zrbosrt "Servicezählerstand v. Tester" UBYTE Def_dez_ub_q1 1 100 0.00 255. FORMAT "%3.0" ECU_ADDRESS 0xC000B349 /end MEASUREMENT
/begin MEASUREMENT Ztageabs "Tagezähler vom Kombi" UWORD Def_dez_uw_q1 1 100 0.00 65535. FORMAT "%5.0" ECU_ADDRESS 0xC000A486 /end MEASUREMENT
/begin FUNCTION IVPlaus_RunUpTst ""
 /begin DEF_CHARACTERISTIC IVPlaus_cntSegDwnRunUpTst_C IVPlaus_cntSegUpRunUpTst_C IVPlaus_cntSegWaitRunUpTst_C IVPlaus_nMaxRunUpTst_C IVPlaus_nMinRunUpTst_C IVPlaus_nStrtRunUpTst_C IVPlaus_phiMI1DesRunUpTst_C IVPlaus_phiPiI1DesRunUpTst_C IVPlaus_phiPiI2DesRunUpTst_C IVPlaus_pSetPntRunUpTst_C IVPlaus_qPiI1DesRunUpTst_C IVPlaus_qPiI2DesRunUpTst_C IVPlaus_qSetUnBalRunUpTst_C IVPlaus_rEGRVlvRunUpTst_C IVPlaus_rThrVlvRunUpTst_C IVPlaus_rTrbChRunUpTst_C IVPlaus_stInjCharRunUpTst_C IVPlaus_stMskCoEOMOpModeRunUpTst_C IVPlaus_swtNoChkRefRunUpTst_C IVPlaus_tiMaxRunUpTst_C IVPlaus_tiPiI1DesRunUpTst_C IVPlaus_tiPiI2DesRunUpTst_C IVPlaus_tiWaitRunUpTst_C /end DEF_CHARACTERISTIC
 /begin IN_MEASUREMENT Brk_st Clth_st CoEOM_stOpModeAct EpmSeq_numInt Epm_ctCyl Epm_nEng Epm_numCyl Epm_stSync PT_stTraType VehV_v /end IN_MEASUREMENT
 /begin OUT_MEASUREMENT IVPlaus_cntSegDwnRunUpTst IVPlaus_cntSegUpRunUpTst IVPlaus_nHiDwnRunUpTst IVPlaus_nHiUpRunUpTst IVPlaus_nLoDwnRunUpTst IVPlaus_nLoUpRunUpTst IVPlaus_nMinRunUpTst IVPlaus_nStrtRunUpTst IVPlaus_numShOffCyl IVPlaus_phiMI1DesRunUpTst IVPlaus_phiPiI1DesRunUpTst IVPlaus_phiPiI2DesRunUpTst IVPlaus_pSetPntRunUpTst IVPlaus_qPiI1DesRunUpTst IVPlaus_qPiI2DesRunUpTst IVPlaus_qSetUnBalRunUpTst IVPlaus_stEffectRunUpTst IVPlaus_stInjCharRunUpTst IVPlaus_stRefRunUpTst IVPlaus_stStMRunUpTst IVPlaus_tiDwnRunUpTst IVPlaus_tiPiI1DesRunUpTst IVPlaus_tiPiI2DesRunUpTst IVPlaus_tiUpRunUpTst /end OUT_MEASUREMENT
 /begin LOC_MEASUREMENT IVPlaus_cntSeg_mp IVPlaus_rEGRVlvRunUpTst_mp IVPlaus_rThrVlvRunUpTst_mp IVPlaus_rTrbChRunUpTst_mp IVPlaus_stModeRunUpTst_mp IVPlaus_swtSrcPSRunUpTst_mp IVPlaus_tiEvalRunUpTst_mp IVPlaus_tiWaitRunUpTst_mp /end LOC_MEASUREMENT
/end FUNCTION
/begin FUNCTION IVPSIC_IntegAdj ""
 /begin DEF_CHARACTERISTIC IVPSIC_ctIntegAdjMax_C IVPSIC_uIntegLin_CUR IVPSIC_Vltg_SRC.uMin_C IVPSIC_Vltg_SRC.uMax_C /end DEF_CHARACTERISTIC
 /begin OUT_MEASUREMENT IVPSIC_stIntegAdjRet IVPSIC_stIntegAdjStM IVPSIC_stIntegAdjVld IVPSIC_tiIntegAdj IVPSIC_tiIntegRC IVPSIC_uIntegOfs IVPSIC_uIntegWrkPnt /end OUT_MEASUREMENT
 /begin LOC_MEASUREMENT IVPSIC_uRawIntegClb_mp IVPSIC_uRawIntegLin_mp IVPSIC_uRawIntegWrkPnt_mp IVPSIC_uRawIntegZr_mp /end LOC_MEASUREMENT
/end FUNCTION
/begin FUNCTION IVPSply_BufVltg ""
 /begin DEF_CHARACTERISTIC IVPSply_numIntrBufMeas_C IVPSply_stUBufRC_C IVPSply_swtEnaBufVltg_C IVPSply_swtUBufRC_C IVPSply_tiADCBusyMax_C IVPSply_tiBufMeasChk_C IVPSply_uBufLin_CUR IVPSply_uBufRC_C IVPSply_Vltg_SRC.uMin_C IVPSply_Vltg_SRC.uMax_C /end DEF_CHARACTERISTIC
 /begin REF_CHARACTERISTIC InjVlv_numBnkTDC_CA /end REF_CHARACTERISTIC
 /begin IN_MEASUREMENT IVActr_numCylMeasNxt IVActr_stMeasEna /end IN_MEASUREMENT
 /begin OUT_MEASUREMENT IVPSply_ctIntrBufMeas IVPSply_stGetBufVltg IVPSply_stUBuf IVPSply_tiBufMeasCurr IVPSply_uBuf /end OUT_MEASUREMENT
 /begin LOC_MEASUREMENT IVPSply_uBufRaw_mp /end LOC_MEASUREMENT
/end FUNCTION
/begin FUNCTION IVPSply_DCDC ""
 /begin DEF_CHARACTERISTIC IVPSply_stBufErrRC_C IVPSply_stDCDCCoRC_C IVPSply_swtDCDCErrRC_C IVPSply_swtEnaDfcChSwt_C IVPSply_swtStBufErrRC_C IVPSply_swtStDCDCCoRC_C IVPSply_tiDCDCWait_C /end DEF_CHARACTERISTIC
 /begin IN_MEASUREMENT InjVlv_PsIcStIniTrans InjVlv_stInjCo IVDia_stShCirChSwt SyC_stSub /end IN_MEASUREMENT
 /begin OUT_MEASUREMENT IVPSply_stBufErr IVPSply_stDCDCCo /end OUT_MEASUREMENT
 /begin LOC_MEASUREMENT IVPSply_tiDCDCChrg_mp /end LOC_MEASUREMENT
/end FUNCTION
/begin FUNCTION layer2edc_adap "" /begin DEF_CHARACTERISTIC Layer_tiEngStA_C Layer_trqAltMax_C Layer_trqAltMin_C /end DEF_CHARACTERISTIC /begin REF_CHARACTERISTIC Shtr_stPKKActv_C /end REF_CHARACTERISTIC
 /begin IN_MEASUREMENT AltIO_swtAltTyp AltIO_tiLRAlt AltIO_uAltDes CoEng_stMSAStp Com_numGearDsplTar Com_stAckReqT15 Com_stClthOpenPlaus Com_stGearShftIdctr Com_stMSAFct Com_stMSAStart Com_stMSAStop EngStA_st Layer_iGen Layer_rCtrPwrSpCos Layer_rLoadGen Layer_rPTC Layer_stCtrCbr Layer_stCtrPCos Layer_stCtrPwrCos Layer_stFldLvlEngOil Layer_stGen Layer_stLoadGen Layer_stRqPCos Layer_stSelSpCos Layer_stVolEngOil Layer_stVoltageLevel Layer_uBatt Shtr_st /end IN_MEASUREMENT
 /begin OUT_MEASUREMENT Alt_trqDes Alt_trqResv Layer_bRecMSA Layer_ctBOS Layer_dAnz Layer_dIntrvTimeBOS2 Layer_dMonthBOS2 Layer_dRmnMlgBOS Layer_dvolLPCOut Layer_dYearBOS2 Layer_facFrcCBS Layer_idBOS Layer_idBOS2 Layer_lIntrvWayBOS2 Layer_lRwAnz Layer_lRwKvb Layer_lRwProg Layer_numBattCond Layer_numGearDsplTar Layer_qKvbmw Layer_rAvlBOS Layer_rBattCond Layer_rBattCondTolc Layer_rGovHPEGR Layer_rGovLPEGR Layer_rlf1t Layer_stAKK Layer_stBattCond Layer_stB_ccbtnach Layer_stB_ccbttdfk Layer_stB_ccbttknt Layer_stB_ccpmerr Layer_stB_ccprio Layer_stB_ccruhver Layer_stB_codierpm Layer_stCCLPC Layer_stCCMSAErr Layer_stCCMSAInactv Layer_stCCOilCons Layer_stCCOilLos Layer_stCCOilSensErr Layer_stEnrgPwrMnmt Layer_stFlFltHtg Layer_stGearShftIdctr Layer_stInfoEnv Layer_stLPCOff Layer_stNdStrtUpSupp Layer_stNewReqIbs Layer_stPKK Layer_stRelVal Layer_stSpaAct Layer_stUnBOS Layer_tChamWll Layer_tiBattCond Layer_tOilEng Layer_trqLimRaw PwrMng_nMin /end OUT_MEASUREMENT
 /begin LOC_MEASUREMENT Layer_nStart /end LOC_MEASUREMENT
/end FUNCTION
/begin FUNCTION LayerDiag_Adapt ""
 /begin DEF_CHARACTERISTIC LayerDiag_tiChgBatt_C LayerDiag_tiHisRst_C LayerDiag_tiNGLern_C LayerDiag_tiWrPMRec_C Layer_tiCBS4TimeOut_C /end DEF_CHARACTERISTIC
/end FUNCTION
/begin FUNCTION LayerDiag_Adapt_Prj "" /begin DEF_CHARACTERISTIC LayerDiag_tiChkProgPwr_C /end DEF_CHARACTERISTIC /end FUNCTION
/begin FUNCTION LayerDiag_FltMng ""
 /begin DEF_CHARACTERISTIC LayerDiag_FltMng_TstCycleEn_C LayerDiag_FltMng_TstErrMask_C LayerDiag_FltMng_TstFIdx_C LayerDiag_FltMng_TstFId_C /end DEF_CHARACTERISTIC
 /begin LOC_MEASUREMENT LayerDiag_FltMng_errMask_mp LayerDiag_FltMng_FIdxEdPermission_mp LayerDiag_FltMng_FIdxEdReport_mp LayerDiag_FltMng_FIdxEdStatus_mp LayerDiag_FltMng_retValEdPermission_mp LayerDiag_FltMng_stEdPermission_mp LayerDiag_FltMng_stEdReport_mp LayerDiag_FltMng_stEdStatus_mp /end LOC_MEASUREMENT
/end FUNCTION
/begin FUNCTION layer_dde ""
 /begin OUT_MEASUREMENT Acfzgl Acfzgq A_quer_abs Batt_class Bnsctr Bnsctrant0 Bnsctrant1 Bnsctrant2 Bnsctrant3 Bordnetz Bosanfsgbd Bosbtvfbkt Bosfxid2r Bosid2r Bosjzielr Bosjzielt Bosmzielr Bosmzielt Bosprog2r Bosprog2t Bosrlsmr Bosrlsmt Bosrw2r Bosrw2t Bosun Bosunt Bosv Bsdcontrol Bsddata Bsdgencv Bsdgenregv Bsdregadr CW_NA Dfgrob Dfh_nekpfilt Dfsiggen Dpfregst Dzw_krann_vl Dzw_mkr Eco_max_i Eco_msb Eco_mz Eco_timo Fahrzeug Fakf Fetrawe Fho Fid_manhydr Fid_manluft Flashdurin Flashstatin F_md_fhot Gangi Gangi_entpr Gen_manufak Gen_typkenn Ibsl_status Id_bosrst Id_bosrtt Id_bosrtw Iekp Ierr Ierrfgrenz Ierr_grenz_ext Ikurz_ogr Ikurz_ugr Iwakeupgr I_ha I_ibsl I_pregelv I_zme Km_st Km_st_1 Kvaverbr La_ist1 L_pwmout Mdi_bas Mdi_ist_m Mdi_llri Mdk_ist Mdk_max_real Mdk_wunsch Md_getriebe Md_max_acwm Md_mgmax Md_na_ac Md_na_ars Md_na_ef Md_na_efmax Md_na_efprae Md_na_sl Md_rad_ist Me_ist Mk_soll_omar Ml Mslui Na_bnanteil Newp_soll Nkw Nkw_grad Nkw_grad_fpt1 Nkw_zahn Nmax_var Nsllm Nsllm2 Nstat Nturb N_ab Oz_datstat Oz_dieselein Oz_lf1c Oz_lf2c Oz_nivr Oz_permr Oz_resetr Oz_status Oz_tempr Pbremsu Phdp Pkstvf Pld Pmrestore Pmsv Pu Pwg_grad Pwg_ist Pwg_max P_gle Qelad_ibsl Qlad_ibsl Qv_cdherst_1 Qv_cdherst_2 Qv_cdherst_3 Qv_cdherst_4 Qv_cdherst_5 Qv_cdherst_6 Qv_cdherst_7 Qv_cdherst_8 Qv_nv_rc Rf St_aepflasholin St_agr St_anman1 St_antrieb St_bgkuppl St_bls St_ckl15 St_devxdetec St_ecostat1 St_egs St_fgr St_fw St_fzg_1 St_fzg_variante St_gang St_genallg St_generator St_geniutest_def St_genll St_gen_ext St_getriebe St_ibs St_ibsl_chg St_ibsl_diag0 St_ibsl_diag1 St_ibsl_diag2 St_ibsl_diag3 St_ibsl_stat0 St_ibsl_stat1 St_ibsl_stat2 St_igrin St_igrinnv St_imdgen_1s St_instr3_1 St_kat St_kl15 St_llr St_lsu St_master St_mdaddon St_mdinfo_s St_mdna St_mdssm St_mkwchn St_motzustd St_msae St_msaklima St_nwf St_oz St_oz_i St_phdp St_pld St_pmcbsin St_pmi St_pmi_nv St_pmprsv_nv St_ptc_pwr St_pwf St_sawe St_slp St_spa_in St_start St_stat St_tum St_ubw St_verbentl St_wk St_wm St_zwktibs Swmsaav Tans Tchip Td_kl30b_off Td_og_cnt Td_og_icnt Td_og_tk Td_og_tr Td_og_tv Td_og_uplcnt Td_rdgenreg2 Tgen_ab Tget Tkat_mod Tkst Tlrfgen Tlrgen_ext Tluft Tluft_pf Tmot Tmot_abstell Tmot_start Tn_abstell Tn_abstellm Tn_start_10 Toel_mdl Tumg Tumg_can Tvngang Tv_agr Tv_pld Tv_pldl Twasser T_ibsl T_jahr T_monate T_tag Ub Uekp Uregnom U_abgasvoxi U_fgen U_gen_ext U_gen_slp U_ibsl V Var_at Var_dkg Var_hs Var_ldm Verbstatus Voltank V_can V_krapu Wped W_afs W_dafs W_ub Zrbosr Zrbosrt Ztageabs /end OUT_MEASUREMENT
/end FUNCTION
/begin FUNCTION Layer_Proc "" /begin IN_MEASUREMENT SyC_stPreDrv /end IN_MEASUREMENT /begin OUT_MEASUREMENT Layer_stLayer /end OUT_MEASUREMENT /end FUNCTION
/begin FUNCTION Layer_Proc_Compu "" /end FUNCTION
/begin FUNCTION ldstgen ""
 /begin DEF_CHARACTERISTIC KL_GENLDST K_APPUPLLDST K_DFMODE K_DFS_MAX K_DFS_MIN K_DFS_MITT K_GENLDDFMAX K_IERRFIL K_TNNSTART K_UB_GRENZST S_PMSTRTMOD S_STRTNKWMOD /end DEF_CHARACTERISTIC
 /begin IN_MEASUREMENT Tgen /end IN_MEASUREMENT
 /begin OUT_MEASUREMENT Dffgen Dfpropval Ierr_fil N_nstart St_bldstg St_ldstgen Ub_old_st /end OUT_MEASUREMENT
/end FUNCTION
/begin FUNCTION LinAppl_Std "" /end FUNCTION
/begin FUNCTION LinNC "" /end FUNCTION
/begin FUNCTION Lin_coord "" /begin IN_MEASUREMENT Layer_stNewReqIbs /end IN_MEASUREMENT
 /begin LOC_MEASUREMENT Lin_cntErr_mp Lin_cntRx_mp Lin_cntTx_mp Lin_Ibsl_buffer_mp Lin_Ibsl_message_mp Lin_Ibsl_status_mp Lin_numMsgIdOld_mp Lin_stConnect_mp Lin_stLinCoord_mp Lin_stRXLin_mp /end LOC_MEASUREMENT
/end FUNCTION
/begin FUNCTION Lin_Std "" /end FUNCTION
/begin FUNCTION LLim_calcLim ""
 /begin DEF_CHARACTERISTIC LLim_facSpdCorr_CA LLim_SpdLim4I.Ki_C LLim_SpdLim4I.KiPos_C LLim_SpdLim4I.KiNeg_C LLim_SpdLim4I.WinPos_C LLim_SpdLim4I.WinNeg_C LLim_SpdLim4P.Kp_C LLim_SpdLim4P.KpPos_C LLim_SpdLim4P.KpNeg_C LLim_SpdLim4P.WinPos_C LLim_SpdLim4P.WinNeg_C LLim_SpdLim5I.Ki_C LLim_SpdLim5I.KiPos_C LLim_SpdLim5I.KiNeg_C LLim_SpdLim5I.WinPos_C LLim_SpdLim5I.WinNeg_C LLim_SpdLim5P.Kp_C LLim_SpdLim5P.KpPos_C LLim_SpdLim5P.KpNeg_C LLim_SpdLim5P.WinPos_C LLim_SpdLim5P.WinNeg_C LLim_swtSpdLim_C LLim_tiEngOnMax_C LLim_tiSpdLimPT1_C LLim_vSpdLimMax_CA LLim_vSpdLimThresFree_C LLim_vSpdLimThresOff_C LLim_vSpdLimThresOn_C /end DEF_CHARACTERISTIC
 /begin IN_MEASUREMENT EngDa_tiEngOn PT_trqWhlMaxEng PT_trqWhlMinEng Tra_numGear VehMot_rTrqDfftl VehV_v VMD_trqDes /end IN_MEASUREMENT
 /begin OUT_MEASUREMENT LLim_swtSpdCorr LLim_swtSpdLim LLim_trqSpdLim /end OUT_MEASUREMENT
 /begin LOC_MEASUREMENT LLim_stSPTrack_mp LLim_trqGbxMax_mp LLim_trqGbxMin_mp LLim_trqI_mp LLim_trqPISpdLim_mp LLim_trqPI_mp LLim_trqP_mp LLim_vCurrTrack_mp LLim_vSpdCorr_mp /end LOC_MEASUREMENT
/end FUNCTION
/begin FUNCTION LsComp_TrqCalc "" /begin IN_MEASUREMENT CoME_trqResv /end IN_MEASUREMENT /begin OUT_MEASUREMENT CoVeh_trqDesComp CoVeh_trqResv /end OUT_MEASUREMENT /end FUNCTION
/begin FUNCTION LsmHal "" /end FUNCTION
/begin FUNCTION LSU_DDElecDia ""
 /begin DEF_CHARACTERISTIC LSU_BattHiDeb.tiHiLo_C LSU_BattHiDeb.tiLoHi_C LSU_OvrRunDeb.tiHiLo_C LSU_OvrRunDeb.tiLoHi_C LSU_RiDeb.tiHiLo_C LSU_RiDeb.tiLoHi_C LSU_rO2Lmbd1Thres_C LSU_rO2Min_C LSU_stLmbd1RgnMsk_C LSU_swtCldSensDia_C LSU_tiCldTstActv_C LSU_tiDvtFlt_C LSU_tiLmbd1RgnDly_C LSU_tiMaxDebVirtNernst_C LSU_tiOpnLdTstActv_C LSU_tiRiMeasDisa_C LSU_uBattMin_C LSU_uO2OpnLdNernstMax_C LSU_uO2OpnLdNernstMin_C LSU_uO2OpnLdVirtGndMax_C LSU_uO2OpnLdVirtGndMin_C LSU_uRiOpnLdTstMax_C /end DEF_CHARACTERISTIC
 /begin REF_CHARACTERISTIC LSU_tHtCtlEna_C /end REF_CHARACTERISTIC
 /begin IN_MEASUREMENT BattU_u CoEng_st CoEOM_stOpModeAct HESrv_stMSid LSU_rO2Raw LSU_rO2Stat LSU_stErr LSU_stHtCtl LSU_stO2IntValid LSU_stSCUNEna LSU_swtEna LSU_tRi LSU_uO2Raw LSU_uRiFlt PthSet_stOvrRunCoord /end IN_MEASUREMENT
 /begin OUT_MEASUREMENT LSU_stCldSensDiaActv LSU_stDiaIAEna LSU_stOpnLdTstActv LSU_stRefPmpDis /end OUT_MEASUREMENT
 /begin LOC_MEASUREMENT LSU_rO2RawFlt_mp LSU_stDebBattHi_mp LSU_stDebOvrRun_mp LSU_stDiaReg_mp LSU_stOpnErrIP /end LOC_MEASUREMENT
/end FUNCTION
/begin FUNCTION LSU_DDHtr ""
 /begin DEF_CHARACTERISTIC LSU_dcycMaxErr_C LSU_dcycMax_C LSU_dcycTstImp_C LSU_Pwm.tiPer_C LSU_Pwm.stLvl_C LSU_Pwm.rMaxDty_C LSU_Pwm.rPerUn_C LSU_Pwm.tiPh_C LSU_PwmOut.rMin_C LSU_PwmOut.rMax_C LSU_PwmOut.tiBtwTstSCB_C LSU_PwmOut.tiBtwTstOT_C LSU_PwmOut.numTstMax_C LSU_PwmOut.swtBattCor_C LSU_PwmOut.swtPsInv_C LSU_stHtDis_C LSU_stHtrPwrStgSel_C LSU_stPortSel_CA LSU_stPsDiaDisbl_C LSU_uBattMaxHigh_C LSU_uBattMaxLow_C LSU_uBattNominal_C /end DEF_CHARACTERISTIC
 /begin REF_CHARACTERISTIC LSU_dcycHtMin_C LSU_uBattMin_C /end REF_CHARACTERISTIC
 /begin IN_MEASUREMENT BattU_u DevLib_stPwrStgEnaCond HESrv_stMSid LSU_dcycHt LSU_stErr LSU_stHtCtl LSU_stRmp LSU_swtEna /end IN_MEASUREMENT
 /begin OUT_MEASUREMENT LSU_dcycHtCor LSU_dcycLimActHt LSU_stHtDis /end OUT_MEASUREMENT
 /begin LOC_MEASUREMENT LSU_facUCor_mp LSU_rOutHWE_mp /end LOC_MEASUREMENT
/end FUNCTION
/begin FUNCTION LSU_DDO2Raw ""
 /begin DEF_CHARACTERISTIC LSU_ctSclFacO2Clb_C LSU_pExhO2MaxDiaDis_C LSU_rO2Transf_CUR LSU_stO2SRCMinMsk_C LSU_swtO2Flt_C LSU_swtSensPrs_C LSU_tiDelO2Clb_C LSU_tiDelO2Val_C LSU_tiExhPresFlt_C LSU_tiO2ClbPT1_C LSU_tiO2Clb_C LSU_tiO2PT1_C LSU_tiO2SRCMinDly_C LSU_uO2ClbDvtMax_C LSU_uO2ClbDvtMin_C LSU_uO2ClbMax_C LSU_uO2ClbMin_C LSU_uO2Max_C LSU_uO2Min_C LSU_uO2Ref_C /end DEF_CHARACTERISTIC
 /begin REF_CHARACTERISTIC LSU_numEGFld_CA LSU_uBattMin_C /end REF_CHARACTERISTIC
 /begin IN_MEASUREMENT ASMod_pEGFld BattU_u CoEOM_stOpModeAct HESrv_stMSid LSU_stAdap LSU_stErr LSU_stHtCtl LSU_stO2ClbEna LSU_stPmpCtl LSU_stRefPmp LSU_stRiClb LSU_stSrvTstDem PthSet_stOvrRunCoord /end IN_MEASUREMENT
 /begin OUT_MEASUREMENT LSU_rO2Act LSU_rO2Raw LSU_stO2IntValid LSU_stO2SPICalDem LSU_swtEna LSU_uO2Raw /end OUT_MEASUREMENT
 /begin LOC_MEASUREMENT LSU_stO2Act_mp LSU_stO2Clb_mp LSU_uO2Clb LSU_uO2Dvt LSU_uO2RawOfsCor /end LOC_MEASUREMENT
/end FUNCTION
/begin FUNCTION LSU_DDO2RawFlt "" /begin IN_MEASUREMENT EpmCrS_numSeg HESrv_stMSid /end IN_MEASUREMENT /begin OUT_MEASUREMENT LSU_uO2Flt LSU_uO2RawAdcDirect /end OUT_MEASUREMENT /begin LOC_MEASUREMENT LSU_uO2FltSegOld_mp /end LOC_MEASUREMENT /end FUNCTION
/begin FUNCTION LSU_DDPT1FltConstCalc "" /begin DEF_CHARACTERISTIC LSU_tiPT1FltO2Raw_C LSU_tiPT1FltRiRaw_C /end DEF_CHARACTERISTIC /end FUNCTION
/begin FUNCTION LSU_DDRiRaw ""
 /begin DEF_CHARACTERISTIC LSU_ctSclFacRiClb_C LSU_facUToRi_C LSU_resRiClbDvtMax_C LSU_resRiClbDvtMin_C LSU_resRiClbMax_C LSU_resRiClbMin_C LSU_resRiClbRef_C LSU_tiDelRiClb_C LSU_tiDelRiVal_C LSU_tiRiClbPT1_C LSU_tiRiClb_C LSU_tiRiPT1_C LSU_tRi_CUR LSU_uRiOfs_C /end DEF_CHARACTERISTIC
 /begin IN_MEASUREMENT HESrv_stMSid LSU_stErr LSU_stOpnLdTstActv LSU_stRiClbEna LSU_stSrvTstDem LSU_swtEna LSU_uRiFlt /end IN_MEASUREMENT
 /begin OUT_MEASUREMENT LSU_resRi LSU_stRiClb LSU_stRiSPICalDem LSU_stRiValid LSU_tRi /end OUT_MEASUREMENT
 /begin LOC_MEASUREMENT LSU_resRiClb LSU_resRiClbRaw_mp LSU_resRiDvt LSU_resRiRaw LSU_uRiRawOfsCor /end LOC_MEASUREMENT
/end FUNCTION
/begin FUNCTION LSU_DDRiRawFlt "" /begin IN_MEASUREMENT HESrv_stMSid /end IN_MEASUREMENT /begin OUT_MEASUREMENT LSU_uRiFlt /end OUT_MEASUREMENT /begin LOC_MEASUREMENT LSU_uRiRaw_mp /end LOC_MEASUREMENT /end FUNCTION
/begin FUNCTION LSU_DDSPI "" /begin DEF_CHARACTERISTIC LSU_stRefCurrHi_C LSU_stRefCurrNrm_C /end DEF_CHARACTERISTIC
 /begin IN_MEASUREMENT HESrv_stMSid LSU_stDiaIAEna LSU_stErr LSU_stIpHiCurrEna LSU_stIpNrmCurrEna LSU_stO2SPICalDem LSU_stOpnLdTstActv LSU_stPmpCtl LSU_stRiSPICalDem LSU_stSCUNEna LSU_swtEna /end IN_MEASUREMENT
 /begin OUT_MEASUREMENT LSU_stCirModeNew /end OUT_MEASUREMENT
 /begin LOC_MEASUREMENT LSU_stSPIIniVal_mp /end LOC_MEASUREMENT
/end FUNCTION
/begin FUNCTION LSU_DDWireDia ""
 /begin DEF_CHARACTERISTIC LSU_ctSclFacHtCoup_C LSU_ctSclFacWireIP_C LSU_dcycMinGrad_C LSU_dmEGHtCoupActv_C LSU_dNumHtCoup_C LSU_numEGSel_CA LSU_resRiMaxGrad_C LSU_rO2IsolChkMax_C LSU_rO2IsolChkMin_C LSU_stWireDiaActv_C LSU_tiClgLstRun_C LSU_tiHtCoupChk_C LSU_tiHtCoupFltTst_C LSU_tiHtCoupFlt_C LSU_tiHtCoupPerTst_C LSU_tiHtCoupPer_C LSU_tiIsolChkErr_C LSU_tiIsolChkPer_C LSU_tiIsolChkPmp_C LSU_uO2MaxGrad_C LSU_uO2MaxRippel_C /end DEF_CHARACTERISTIC
 /begin IN_MEASUREMENT ASMod_dmEGFld ASMod_tiClg CoEng_st HESrv_stMSid LSU_dcycHtCor LSU_resRi LSU_rO2Act LSU_stErr LSU_stHtCtl LSU_stIniClb LSU_stO2ClbEna LSU_stO2IntValid LSU_stSrvTstDem LSU_swtEna LSU_uO2Raw /end IN_MEASUREMENT
 /begin OUT_MEASUREMENT LSU_stHtDisbl LSU_stIsolChkActv LSU_stPmpEna /end OUT_MEASUREMENT
 /begin LOC_MEASUREMENT LSU_ctHtCoup LSU_dcycHtCoupStp1 LSU_dcycHtCoupStp2 LSU_dcycRippel_mp LSU_dHtCoupStepLast LSU_dHtCoupStp LSU_resRiHtCoupStp1 LSU_resRiHtCoupStp2 LSU_resRiRippel_mp LSU_stHtCoupActv LSU_stIsolChkO2Last LSU_stRecValEval_mp LSU_stTstTrigger_mp LSU_stWireDiaChk_mp LSU_stWireDiaErr_mp LSU_uO2FltRippel_mp LSU_uO2Grad_mp LSU_uO2HtCoupStp1 LSU_uO2HtCoupStp2 LSU_uO2HtCoupStp3 LSU_uO2Rippel_mp /end LOC_MEASUREMENT
/end FUNCTION
/begin FUNCTION LSU_DiaOvrvw "" /end FUNCTION
/begin FUNCTION LSU_IntfcDia "" /begin DEF_CHARACTERISTIC LSU_stSrvTstEna_C /end DEF_CHARACTERISTIC /begin OUT_MEASUREMENT LSU_stSrvTstDem /end OUT_MEASUREMENT /end FUNCTION
/begin FUNCTION LSU_VDAdap ""
 /begin DEF_CHARACTERISTIC LSU_AirPerTimeI.Ki_C LSU_AirPerTimeI.KiPos_C LSU_AirPerTimeI.KiNeg_C LSU_AirPerTimeI.WinPos_C LSU_AirPerTimeI.WinNeg_C LSU_d2rIni_C LSU_EvalMaxVal_C LSU_EvalMinVal_C LSU_facPresCompLean_MAP LSU_facPresCompRich_MAP LSU_mAirAdapActv_C LSU_numEGFld_CA LSU_rLamRec_CUR LSU_rO2SwtPresComp_C LSU_swtAdap_C LSU_swtExhPresSel_C LSU_tAirAdapActv_C LSU_tiAdapFltIni_C LSU_tiAdapFlt_C LSU_tiEvalFltIni_C LSU_tiEvalFlt_C /end DEF_CHARACTERISTIC
 /begin IN_MEASUREMENT AFS_dm ASMod_pEGFld ASMod_rLamRecExhMnfDs CoEng_st EnvT_t Exh_pPFltDiff HESrv_stMSid LSU_rO2Raw LSU_stErr LSU_stO2IntValid LSU_swtEna LSU_tDvt PthSet_stOvrRunCoord /end IN_MEASUREMENT
 /begin OUT_MEASUREMENT LSU_rLam LSU_rLamRec LSU_rO2Adap LSU_rO2PresComp LSU_stAdap LSU_stChng NSCDsRLam_rLam NSCDsRLam_rLamRec TrbnDsRLam_rLam TrbnDsRLam_rLamRec TrbnDsRLam_rO2PresComp /end OUT_MEASUREMENT
 /begin LOC_MEASUREMENT LSU_d2rO2Eval_mp LSU_d2rO2_mp LSU_drO2Adap LSU_drO2Flt_mp LSU_facO2Corr_mp LSU_facPresComp_mp LSU_mAirAftOvrRun LSU_stActv_mp LSU_stAdapActv_mp LSU_stHold_mp LSU_swtAdap /end LOC_MEASUREMENT
/end FUNCTION
/begin FUNCTION LSU_VDClbSched ""
 /begin DEF_CHARACTERISTIC LSU_nMaxClb1_C LSU_nMaxClb2_C LSU_nMinClb1_C LSU_nMinClb2_C LSU_qMaxClb1_C LSU_qMaxClb2_C LSU_qMinClb1_C LSU_qMinClb2_C LSU_stChpClbActv_C LSU_stEGTClbOff_C LSU_ti1stClb_C LSU_tiPerClb_C LSU_uMinClb_C /end DEF_CHARACTERISTIC
 /begin IN_MEASUREMENT CoEng_st CoEOM_stOpModeAct Epm_ctCyl Epm_nEng InjSys_qInrCmb LSU_stIsolChkActv LSU_stSrvTstDem LSU_swtEna /end IN_MEASUREMENT
 /begin OUT_MEASUREMENT LSU_stErr LSU_stIniClb LSU_stO2ClbEna LSU_stRiClbEna /end OUT_MEASUREMENT
 /begin LOC_MEASUREMENT LSU_stClbTrg_mp LSU_stNotOpPoint1_mp LSU_stNotOpPoint2_mp LSU_stTmrClbPerRun /end LOC_MEASUREMENT
/end FUNCTION
/begin FUNCTION LSU_VDHtrCtl ""
 /begin DEF_CHARACTERISTIC LSU_dcycHtMin_C LSU_DcycRmp.Pos_C LSU_DcycRmp.Neg_C LSU_dcycStrt_CUR LSU_facSclFacTExcMax_C LSU_facSclFacTExcMin_C LSU_nHtCtlEna_C LSU_Sens1DT1.T1_C LSU_Sens1DT1.Kd_C LSU_Sens1I.Ki_C LSU_Sens1I.KiPos_C LSU_Sens1I.KiNeg_C LSU_Sens1I.WinPos_C LSU_Sens1I.WinNeg_C LSU_Sens1P.Kp_C LSU_Sens1P.KpPos_C LSU_Sens1P.KpNeg_C LSU_Sens1P.WinPos_C LSU_Sens1P.WinNeg_C LSU_Sens2DT1.T1_C LSU_Sens2DT1.Kd_C LSU_Sens2I.Ki_C LSU_Sens2I.KiPos_C LSU_Sens2I.KiNeg_C LSU_Sens2I.WinPos_C LSU_Sens2I.WinNeg_C LSU_Sens2P.Kp_C LSU_Sens2P.KpPos_C LSU_Sens2P.KpNeg_C LSU_Sens2P.WinPos_C LSU_Sens2P.WinNeg_C LSU_tExcMax_C LSU_tExcMin_C LSU_tHtCtlEna_C LSU_tiDelHtrTst_C LSU_tiDelIniVal_C LSU_tLowLim_CUR LSU_tRiSetP_C LSU_tUpLim_CUR /end DEF_CHARACTERISTIC
 /begin REF_CHARACTERISTIC LSU_dcycMax_C LSU_uBattMin_C /end REF_CHARACTERISTIC
 /begin IN_MEASUREMENT Air_tCACDs BattU_u Epm_nEng HESrv_stMSid LSU_dcycLimActHt LSU_stErr LSU_stHtDis LSU_stHtDisbl LSU_stRiValid LSU_stSrvTstDem LSU_swtEna LSU_tRi PthSet_stOvrRunCoord /end IN_MEASUREMENT
 /begin OUT_MEASUREMENT LSU_dcycHt LSU_stHtCtl LSU_stRmp LSU_stSCUNEna LSU_tDvt /end OUT_MEASUREMENT
 /begin LOC_MEASUREMENT LSU_dcycDT1_mp LSU_dcycHtIniRmp LSU_dcycHtStrt LSU_dcycI_mp LSU_dcycP_mp LSU_tAirStrt_mp LSU_tLowLim_mp LSU_tUpLim_mp /end LOC_MEASUREMENT
/end FUNCTION
/begin FUNCTION LSU_VDMon ""
 /begin DEF_CHARACTERISTIC LSU_ctSclFacDynChk_C LSU_ctSclFacO2Plaus_C LSU_mAirMaxCmpChk_C LSU_mAirMaxTst_C LSU_mAirMax_C LSU_mAirMinCmpChk_C LSU_mAirMinTst_C LSU_mAirMin_C LSU_nMaxCmpChk_C LSU_nMaxTst_C LSU_nMax_C LSU_nMinChkDyn_C LSU_nMinCmpChk_C LSU_nMinTst_C LSU_nMin_C LSU_numSelDiffChk_C LSU_numSensCmpChk_CA LSU_qDiffMax_C LSU_qMaxCmpChk_C LSU_qMaxTst_C LSU_qMax_C LSU_qMinCmpChk_C LSU_qMinTst_C LSU_qMin_C LSU_qThresChkDyn_C LSU_qThresOvrRun_C LSU_rEGRMaxCmpChk_C LSU_rEGRMinCmpChk_C LSU_rMaxDiff_CA LSU_rO2MaxVar_C LSU_rO2NegDvtTst_C LSU_rO2NegDvt_C LSU_rO2PosDvtTst_C LSU_rO2PosDvt_C LSU_stMonActv_C LSU_stMonCmpReqd_C LSU_stMonMsk_C LSU_stMskCmpChkO2_C LSU_stO2Calc_C LSU_stSelPlausChkSig_C LSU_tiDlyCmpChkO2_C LSU_tiO2CalcFltTst_C LSU_tiO2CalcFlt_C LSU_tiO2EvalTst_C LSU_tiO2Eval_C LSU_tiSwt_CA LSU_tiWait1_CA LSU_tiWait2_CA LSU_tiWait3_CA LSU_volMinFl_C /end DEF_CHARACTERISTIC
 /begin REF_CHARACTERISTIC LSU_uBattMin_C /end REF_CHARACTERISTIC
 /begin IN_MEASUREMENT AFS_mAirPerCyl BattU_u CoEOM_stOpModeAct EGRVlv_r Epm_ctCyl Epm_nEng FlSys_facStoich FlSys_rhoFl Fl_volTnkQnt HESrv_stMSid InjSys_qInrCmb InjSys_stCtlQnt LSU_rO2Adap LSU_rO2PresComp LSU_rO2Raw LSU_stAdap LSU_stErr LSU_stO2IntValid LSU_stSrvTstDem LSU_swtEna /end IN_MEASUREMENT
 /begin OUT_MEASUREMENT LSU_rO2Stat /end OUT_MEASUREMENT
 /begin LOC_MEASUREMENT LSU_bpPlausSetPoint_mp LSU_numMaxCmpChk_mp LSU_qStrt_mp LSU_rO2Calc_mp LSU_rO2DiffCmpChk_mp LSU_rO2DvtNeg_mp LSU_rO2DvtPos_mp LSU_rO2FrstValCmpChk_mp LSU_rO2SecValCmpChk_mp LSU_rO2Thres1_mp LSU_rO2Thres2_mp LSU_stChkDyn_mp LSU_stCmpChkCon_mp LSU_stCmpChk_mp LSU_stCmpErr_mp LSU_stDynState LSU_stO2Chk LSU_stO2Err LSU_stPlausChk LSU_stPlausChkCon LSU_stPOpCmpChk_mp LSU_tiState1_mp LSU_tiState2_mp LSU_tiState3_mp /end LOC_MEASUREMENT
/end FUNCTION
/begin FUNCTION LSU_VDPmpCtl "" /begin DEF_CHARACTERISTIC LSU_stPmpCtlDisbl_C /end DEF_CHARACTERISTIC
 /begin IN_MEASUREMENT DevLib_stPwrStgEnaCond HESrv_stMSid LSU_stCldSensDiaActv LSU_stErr LSU_stHtCtl LSU_stOpnLdTstActv LSU_stPmpEna LSU_stRiClb LSU_swtEna /end IN_MEASUREMENT
 /begin OUT_MEASUREMENT LSU_stPmpCtl /end OUT_MEASUREMENT
/end FUNCTION
/begin FUNCTION LSU_VDRefPmp "" /begin DEF_CHARACTERISTIC LSU_stRefPmpDisbl_C LSU_tiRefPmpHi_C LSU_tiRefTransLo_C /end DEF_CHARACTERISTIC
 /begin IN_MEASUREMENT DevLib_stPwrStgEnaCond HESrv_stMSid LSU_stHtCtl LSU_stOpnLdTstActv LSU_stRefPmpDis LSU_stRiClb LSU_swtEna /end IN_MEASUREMENT
 /begin OUT_MEASUREMENT LSU_stIpHiCurrEna LSU_stIpNrmCurrEna LSU_stRefPmp /end OUT_MEASUREMENT
 /begin LOC_MEASUREMENT LSU_stRefCurrTrans_mp /end LOC_MEASUREMENT
/end FUNCTION
/begin COMPU_METHOD AirMassPerCyl "" RAT_FUNC "%5.1" "mg/Hub" COEFFS 0 10 0 0 0 1 /end COMPU_METHOD
/begin COMPU_METHOD AirMassPerTime "" RAT_FUNC "%5.1" "Kg/h" COEFFS 0 10 0 0 0 1 /end COMPU_METHOD
/begin COMPU_METHOD AirMass_2 "" RAT_FUNC "%6.3" "g" COEFFS 0 10 0 0 0 1 /end COMPU_METHOD
/begin COMPU_METHOD AngleCrS "" RAT_FUNC "%6.3" "deg CrS" COEFFS 0 45.5111111111 0 0 0 1 /end COMPU_METHOD
/begin COMPU_METHOD CoeffA "" RAT_FUNC "%6.4" "1/(s*Nm)" COEFFS 0 204.8 0 0 0 1 /end COMPU_METHOD
/begin COMPU_METHOD CurRefPump "" TAB_VERB "%6.3" "-" COMPU_TAB_REF CurRefPump /end COMPU_METHOD
/begin COMPU_VTAB CurRefPump "" TAB_VERB 16 0 "0 uA" 1 "10 uA" 2 "20 uA" 3 "30 uA" 4 "40 uA" 5 "50 uA" 6 "60 uA" 7 "70 uA" 8 "80 uA" 9 "90 uA" 10 "100 uA" 11 "110 uA" 12 "120 uA" 13 "130 uA" 14 "140 uA" 15 "150 uA" /end COMPU_VTAB
/begin COMPU_METHOD Def_ac_sb_q0p25 "" RAT_FUNC "%4.2" "-" COEFFS 0 4 0 0 0 1 /end COMPU_METHOD
/begin COMPU_METHOD Def_a_sw_b64 "" RAT_FUNC "%7.5" "m/s²" COEFFS 0 512 0 0 0 1 /end COMPU_METHOD
/begin COMPU_METHOD Def_dez_sw_q1 "" RAT_FUNC "%5.2" "-" COEFFS 0 1 0 0 0 1 /end COMPU_METHOD
/begin COMPU_METHOD Def_dez_ub_q1 "" RAT_FUNC "%3.1" "-" COEFFS 0 1 0 0 0 1 /end COMPU_METHOD
/begin COMPU_METHOD Def_dez_ul_q1 "" RAT_FUNC "%7.3" "-" COEFFS 0 1 0 0 0 1 /end COMPU_METHOD
/begin COMPU_METHOD Def_dez_uw_q0p01 "" RAT_FUNC "%8.5" "-" COEFFS 0 100 0 0 0 1 /end COMPU_METHOD
/begin COMPU_METHOD Def_dez_uw_q1 "" RAT_FUNC "%5.2" "-" COEFFS 0 1 0 0 0 1 /end COMPU_METHOD
/begin COMPU_METHOD Def_f_sw_b100 "" RAT_FUNC "%8.5" "-" COEFFS 0 327.68 0 0 0 1 /end COMPU_METHOD
/begin COMPU_METHOD Def_f_ub_b1 "" RAT_FUNC "%6.4" "-" COEFFS 0 256 0 0 0 1 /end COMPU_METHOD
/begin COMPU_METHOD Def_f_ub_b100 "" RAT_FUNC "%5.2" "%" COEFFS 0 2.56 0 0 0 1 /end COMPU_METHOD
/begin COMPU_METHOD Def_f_ub_b127p5 "" RAT_FUNC "%5.2" "%" COEFFS 0 2 0 0 0 1 /end COMPU_METHOD
/begin COMPU_METHOD Def_f_ub_b2 "" RAT_FUNC "%6.4" "-" COEFFS 0 128 0 0 0 1 /end COMPU_METHOD
/begin COMPU_METHOD Def_f_uw_b16 "" RAT_FUNC "%9.7" "-" COEFFS 0 4096 0 0 0 1 /end COMPU_METHOD
/begin COMPU_METHOD Def_f_uw_b2 "" RAT_FUNC "%14.10" "-" COEFFS 0 32768 0 0 0 1 /end COMPU_METHOD
/begin COMPU_METHOD Def_f_uw_b32 "" RAT_FUNC "%9.7" "-" COEFFS 0 2048 0 0 0 1 /end COMPU_METHOD
/begin COMPU_METHOD Def_f_uw_b64 "" RAT_FUNC "%9.6" "-" COEFFS 0 1024 0 0 0 1 /end COMPU_METHOD
/begin COMPU_METHOD Def_i_sw_q0p001 "" RAT_FUNC "%8.6" "A" COEFFS 0 1000 0 0 0 1 /end COMPU_METHOD
/begin COMPU_METHOD Def_i_ub_q0p001 "" RAT_FUNC "%6.5" "A" COEFFS 0 1000 0 0 0 1 /end COMPU_METHOD
/begin COMPU_METHOD Def_i_ub_q0p00125 "" RAT_FUNC "%6.4" "" COEFFS 0 800 0 0 0 1 /end COMPU_METHOD
/begin COMPU_METHOD Def_i_ub_q0p1 "" RAT_FUNC "%4.2" "A" COEFFS 0 10 0 0 0 1 /end COMPU_METHOD
/begin COMPU_METHOD Def_i_ub_q0p125 "" RAT_FUNC "%6.3" "A" COEFFS 0 8 0 0 0 1 /end COMPU_METHOD
/begin COMPU_METHOD Def_i_ub_q10 "" RAT_FUNC "%5.1" "A" COEFFS 0 0.1 0 0 0 1 /end COMPU_METHOD
/begin COMPU_METHOD Def_i_uw_q0p02o200 "" RAT_FUNC "%8.2" "A" COEFFS 0 50 10000 0 0 1 /end COMPU_METHOD
/begin COMPU_METHOD Def_km_ub_q1000 "" RAT_FUNC "%5.0" "km" COEFFS 0 0.001 0 0 0 1 /end COMPU_METHOD
/begin COMPU_METHOD Def_km_uw_q10 "" RAT_FUNC "%5.1" "km" COEFFS 0 0.1 0 0 0 1 /end COMPU_METHOD
/begin COMPU_METHOD Def_lf_ub_q0p01 "" RAT_FUNC "%5.4" "-" COEFFS 0 100 0 0 0 1 /end COMPU_METHOD
/begin COMPU_METHOD Def_lm_uw_q0p000444 "" RAT_FUNC "%9.7" "kg" COEFFS 0 2250 0 0 0 1 /end COMPU_METHOD
/begin COMPU_METHOD Def_me_sw_q0p01 "" RAT_FUNC "%8.5" "mg/cyc" COEFFS 0 100 0 0 0 1 /end COMPU_METHOD
/begin COMPU_METHOD Def_ml_sw_q0p1 "" RAT_FUNC "%7.4" "mg/Hub" COEFFS 0 10 0 0 0 1 /end COMPU_METHOD
/begin COMPU_METHOD Def_m_sl_q0p1 "" RAT_FUNC "%9.5" "Nm" COEFFS 0 10 0 0 0 1 /end COMPU_METHOD
/begin COMPU_METHOD Def_m_sw_q0p1 "" RAT_FUNC "%7.4" "Nm" COEFFS 0 10 0 0 0 1 /end COMPU_METHOD
/begin COMPU_METHOD Def_ngrd_sb_q32p0 "" RAT_FUNC "%5.1" "Upm/s" COEFFS 0 0.03125 0 0 0 1 /end COMPU_METHOD
/begin COMPU_METHOD Def_n_sw_q1p0 "" RAT_FUNC "%5.2" "Upm" COEFFS 0 1 0 0 0 1 /end COMPU_METHOD
/begin COMPU_METHOD Def_pwggrd_sw_b2500 "" RAT_FUNC "%8.4" "%/s" COEFFS 0 1.6384 0 0 0 1 /end COMPU_METHOD
/begin COMPU_METHOD Def_p_sw_q1 "" RAT_FUNC "%6.2" "hPa" COEFFS 0 1 0 0 0 1 /end COMPU_METHOD
/begin COMPU_METHOD Def_p_uw_q0p001 "" RAT_FUNC "%8.6" "Bar" COEFFS 0 1000 0 0 0 1 /end COMPU_METHOD
/begin COMPU_METHOD Def_p_uw_q0p039 "" RAT_FUNC "%7.4" "hPa" COEFFS 0 25.6 0 0 0 1 /end COMPU_METHOD
/begin COMPU_METHOD Def_p_uw_q1 "" RAT_FUNC "%6.2" "hPa" COEFFS 0 1 0 0 0 1 /end COMPU_METHOD
/begin COMPU_METHOD Def_ql_uw_q0p0182 "" RAT_FUNC "%8.5" "Ah" COEFFS 0 54.9444444444444 0 0 0 1 /end COMPU_METHOD
/begin COMPU_METHOD Def_rf_sw_q0p01 "" RAT_FUNC "%9.6" "%" COEFFS 0 100 0 0 0 1 /end COMPU_METHOD
/begin COMPU_METHOD Def_st_ub_q1 "" RAT_FUNC "%3.1" "-" COEFFS 0 1 0 0 0 1 /end COMPU_METHOD
/begin COMPU_METHOD Def_st_uw_q1 "" RAT_FUNC "%5.2" "-" COEFFS 0 1 0 0 0 1 /end COMPU_METHOD
/begin COMPU_METHOD Def_td_ub_q0p05 "" RAT_FUNC "%5.3" "s" COEFFS 0 20 0 0 0 1 /end COMPU_METHOD
/begin COMPU_METHOD Def_td_ub_q0p1 "" RAT_FUNC "%4.2" "s" COEFFS 0 10 0 0 0 1 /end COMPU_METHOD
/begin COMPU_METHOD Def_td_ub_q1 "" RAT_FUNC "%5.2" "s" COEFFS 0 1 0 0 0 1 /end COMPU_METHOD
/begin COMPU_METHOD Def_td_uw_q0p01 "" RAT_FUNC "%7.5" "s" COEFFS 0 100 0 0 0 1 /end COMPU_METHOD
/begin COMPU_METHOD Def_td_uw_q0p1 "" RAT_FUNC "%6.3" "s" COEFFS 0 10 0 0 0 1 /end COMPU_METHOD
/begin COMPU_METHOD Def_tn_uw_q1 "" RAT_FUNC "%7.3" "min" COEFFS 0 1 0 0 0 1 /end COMPU_METHOD
/begin COMPU_METHOD Def_tv_sw_q0p01 "" RAT_FUNC "%8.5" "%" COEFFS 0 100 0 0 0 1 /end COMPU_METHOD
/begin COMPU_METHOD Def_tv_sw_q0p0244 "" RAT_FUNC "%7.4" "%" COEFFS 0 40.96 0 0 0 1 /end COMPU_METHOD
/begin COMPU_METHOD Def_tv_ub_q0p390625 "" RAT_FUNC "%5.2" "%" COEFFS 0 2.56 0 0 0 1 /end COMPU_METHOD
/begin COMPU_METHOD Def_tv_uw_q0p01 "" RAT_FUNC "%7.5" "%" COEFFS 0 100 0 0 0 1 /end COMPU_METHOD
/begin COMPU_METHOD Def_t_sw_q0p01 "" RAT_FUNC "%7.5" "°C" COEFFS 0 100 0 0 0 1 /end COMPU_METHOD
/begin COMPU_METHOD Def_t_sw_q0p1 "" RAT_FUNC "%6.3" "°C" COEFFS 0 10 0 0 0 1 /end COMPU_METHOD
/begin COMPU_METHOD Def_t_ub_q0p75_o48 "" RAT_FUNC "%6.2" "°C" COEFFS 0 1.33333333333333 -64 0 0 1 /end COMPU_METHOD
/begin COMPU_METHOD Def_u_sl_b131072 "" RAT_FUNC "%9.8" "-" COEFFS 0 16384 0 0 0 1 /end COMPU_METHOD
/begin COMPU_METHOD Def_u_sw_q0p00488 "" RAT_FUNC "%8.5" "V" COEFFS 0 204.8 0 0 0 1 /end COMPU_METHOD
/begin COMPU_METHOD Def_u_ub_q0p0942 "" RAT_FUNC "%7.4" "V" COEFFS 0 10.6157112526539 0 0 0 1 /end COMPU_METHOD
/begin COMPU_METHOD Def_u_ub_q0p1 "" RAT_FUNC "%5.3" "V" COEFFS 0 10 0 0 0 1 /end COMPU_METHOD
/begin COMPU_METHOD Def_u_uw_q0p001 "" RAT_FUNC "%8.6" "mV" COEFFS 0 1000 0 0 0 1 /end COMPU_METHOD
/begin COMPU_METHOD Def_u_uw_q0p0942 "" RAT_FUNC "%6.3" "V" COEFFS 0 10.6157112526539 0 0 0 1 /end COMPU_METHOD
/begin COMPU_METHOD Def_u_uw_q0p1 "" RAT_FUNC "%8.4" "V" COEFFS 0 10 0 0 0 1 /end COMPU_METHOD
/begin COMPU_METHOD Def_vol_uw_q0p1 "" RAT_FUNC "%8.4" "l" COEFFS 0 10 0 0 0 1 /end COMPU_METHOD
/begin COMPU_METHOD Def_v_uw_q0p1 "" RAT_FUNC "%7.4" "km/h" COEFFS 0 10 0 0 0 1 /end COMPU_METHOD
/begin COMPU_METHOD Def_v_uw_q1p0 "" RAT_FUNC "%5.2" "km/h" COEFFS 0 1 0 0 0 1 /end COMPU_METHOD
/begin COMPU_METHOD Def_wdk_sw_q0p0244 "" RAT_FUNC "%7.4" "%" COEFFS 0 40.96 0 0 0 1 /end COMPU_METHOD
/begin COMPU_METHOD Def_wdk_sw_q0p1 "" RAT_FUNC "%7.4" "-" COEFFS 0 10 0 0 0 1 /end COMPU_METHOD
/begin COMPU_METHOD Def_zw_sw_q0p1 "" RAT_FUNC "%6.3" "°" COEFFS 0 10 0 0 0 1 /end COMPU_METHOD
/begin COMPU_METHOD DtyCyc "" RAT_FUNC "%5.2" "%" COEFFS 0 100 0 0 0 1 /end COMPU_METHOD
/begin COMPU_METHOD EngN "" RAT_FUNC "%5.1" "rpm" COEFFS 0 2 0 0 0 1 /end COMPU_METHOD
/begin COMPU_METHOD Fact "" RAT_FUNC "%6.5" "-" COEFFS 0 8192 0 0 0 1 /end COMPU_METHOD
/begin COMPU_METHOD FactLow "" RAT_FUNC "%6.5" "-" COEFFS 0 1024 0 0 0 1 /end COMPU_METHOD
/begin COMPU_METHOD FlConsum_l_h "" RAT_FUNC "%6.4" "l/h" COEFFS 0 100 0 0 0 1 /end COMPU_METHOD
/begin COMPU_METHOD Fl_Vol_q0p05 "" RAT_FUNC "%6.4" "l" COEFFS 0 20 0 0 0 1 /end COMPU_METHOD
/begin COMPU_METHOD Fuel_Cons "" RAT_FUNC "%6.5" "l/100km" COEFFS 0 8192 0 0 0 1 /end COMPU_METHOD
/begin COMPU_METHOD InjMass "" RAT_FUNC "%5.2" "mg/hub" COEFFS 0 100 0 0 0 1 /end COMPU_METHOD
/begin COMPU_METHOD InjMassCyc "" RAT_FUNC "%5.2" "mg/cyc" COEFFS 0 100 0 0 0 1 /end COMPU_METHOD
/begin COMPU_METHOD InjMassInj "" RAT_FUNC "%5.2" "mg/inj" COEFFS 0 100 0 0 0 1 /end COMPU_METHOD
/begin COMPU_METHOD InjTime_us "" RAT_FUNC "%5.1" "us" COEFFS 0 2.5 0 0 0 1 /end COMPU_METHOD
/begin COMPU_METHOD Kd_Temp_Kelv2Dcyc "" RAT_FUNC "%8.7" "%/K" COEFFS 0 655360 0 0 0 1 /end COMPU_METHOD
/begin COMPU_METHOD Ki "" RAT_FUNC "%6.5" "1/s" COEFFS 0 2147.483648 0 0 0 1 /end COMPU_METHOD
/begin COMPU_METHOD Ki_Temp_Kelv2Dcyc "" RAT_FUNC "%7.6" "%/(K*s)" COEFFS 0 21474.83648 0 0 0 1 /end COMPU_METHOD
/begin COMPU_METHOD Ki_Vel2TrqPrpHigh20 "" RAT_FUNC "%6.4" "Nm/(km/h)/s" COEFFS 0 13.4217728 0 0 0 1 /end COMPU_METHOD
/begin COMPU_METHOD km_sw_q10 "" RAT_FUNC "%6.1" "km" COEFFS 0 0.1 0 0 0 1 /end COMPU_METHOD
/begin COMPU_METHOD Kp_Temp_Kelv2Dcyc "" RAT_FUNC "%8.7" "%/K" COEFFS 0 327680 0 0 0 1 /end COMPU_METHOD
/begin COMPU_METHOD Kp_Vel2TrqPrpHigh "" RAT_FUNC "%6.4" "Nm/(km/h)" COEFFS 0 409.6 0 0 0 1 /end COMPU_METHOD
/begin COMPU_METHOD lambda "" RAT_FUNC "%4.3" "-" COEFFS 0 1000 0 0 0 1 /end COMPU_METHOD
/begin COMPU_METHOD lambdaRecVal "" RAT_FUNC "%6.5" "-" COEFFS 0 1000 0 0 0 1 /end COMPU_METHOD
/begin COMPU_METHOD O2 "" RAT_FUNC "%6.5" "-" COEFFS 0 100000 0 0 0 1 /end COMPU_METHOD
/begin COMPU_METHOD OneToOne "" RAT_FUNC "%6.0" "-" COEFFS 0 1 0 0 0 1 /end COMPU_METHOD
/begin COMPU_METHOD OneToOne_km "" RAT_FUNC "%6.2" "km" COEFFS 0 1 0 0 0 1 /end COMPU_METHOD
/begin COMPU_METHOD Period "" RAT_FUNC "%6.3" "ms" COEFFS 0 10 0 0 0 1 /end COMPU_METHOD
/begin COMPU_METHOD Prc "" RAT_FUNC "%6.4" "%" COEFFS 0 81.92 0 0 0 1 /end COMPU_METHOD
/begin COMPU_METHOD Pres_hPa "" RAT_FUNC "%5.1" "hPa" COEFFS 0 1 0 0 0 1 /end COMPU_METHOD
/begin COMPU_METHOD Pres_Rail "" RAT_FUNC "%5.1" "bar" COEFFS 0 10.000000 0 0 0 1 /end COMPU_METHOD
/begin COMPU_METHOD PwmOutLevel "" TAB_VERB "%6.3" "" COMPU_TAB_REF PwmOutLevel /end COMPU_METHOD
/begin COMPU_VTAB PwmOutLevel "" TAB_VERB 2 0 "Lo" 1 "Hi" /end COMPU_VTAB
/begin COMPU_METHOD Resist "" RAT_FUNC "%6.3" "Ohm" COEFFS 0 10 0 0 0 1 /end COMPU_METHOD
/begin COMPU_METHOD RmpDtyCyc "" RAT_FUNC "%6.5" "%/s" COEFFS 0 6553.6 0 0 0 1 /end COMPU_METHOD
/begin COMPU_METHOD TempDiff_Kelv "" RAT_FUNC "%4.1" "K" COEFFS 0 10 0 0 0 1 /end COMPU_METHOD
/begin COMPU_METHOD Temp_Cels "" RAT_FUNC "%5.1" "deg C" COEFFS 0 10 2731.4 0 0 1 /end COMPU_METHOD
/begin COMPU_METHOD TimeDeb "" RAT_FUNC "%5.0" "ms" COEFFS 0 0.1 0 0 0 1 /end COMPU_METHOD
/begin COMPU_METHOD TimeDelay_ms "" RAT_FUNC "%12.1" "ms" COEFFS 0 0 1 0 2.3283064365387e-007 0 /end COMPU_METHOD
/begin COMPU_METHOD TimeDelay_s "" RAT_FUNC "%12.4" "s" COEFFS 0 0 1 0 0.00023283064365387 0 /end COMPU_METHOD
/begin COMPU_METHOD TimeEngOn "" RAT_FUNC "%6.2" "s" COEFFS 0 1 0 0 0 1 /end COMPU_METHOD
/begin COMPU_METHOD Time_Hr "" RAT_FUNC "%6.3" "h" COEFFS 0 2 0 0 0 1 /end COMPU_METHOD
/begin COMPU_METHOD Time_ms "" RAT_FUNC "%5.0" "ms" COEFFS 0 0.1 0 0 0 1 /end COMPU_METHOD
/begin COMPU_METHOD Time_PzoMeas "" RAT_FUNC "%6.4" "ms" COEFFS 0 18.3150183150183 0 0 0 1 /end COMPU_METHOD
/begin COMPU_METHOD Time_s "" RAT_FUNC "%5.2" "s" COEFFS 0 100 0 0 0 1 /end COMPU_METHOD
/begin COMPU_METHOD Trq "" RAT_FUNC "%5.1" "Nm" COEFFS 0 10 0 0 0 1 /end COMPU_METHOD
/begin COMPU_METHOD TrqPrpHigh "" RAT_FUNC "%5.1" "Nm" COEFFS 0 10 0 0 0 1 /end COMPU_METHOD
/begin COMPU_METHOD Vel "" RAT_FUNC "%5.2" "km/h" COEFFS 0 100 0 0 0 1 /end COMPU_METHOD
/begin COMPU_METHOD Vltg_PA "" RAT_FUNC "%4.2" "V" COEFFS 0 100 0 0 0 1 /end COMPU_METHOD
/begin COMPU_METHOD Volt "" RAT_FUNC "%6.1" "mV" COEFFS 0 5 0 0 0 1 /end COMPU_METHOD
/begin COMPU_METHOD VoltToRes "" RAT_FUNC "%6.5" "Ohm/mV" COEFFS 0 2000 0 0 0 1 /end COMPU_METHOD
/begin COMPU_METHOD Volt_Batt "" RAT_FUNC "%5.0" "mV" COEFFS 0 0.05 0 0 0 1 /end COMPU_METHOD
/begin RECORD_LAYOUT CurTKL_SW_VV_UB NO_AXIS_PTS_X 1 UBYTE RESERVED 2 BYTE AXIS_PTS_X 3 SWORD INDEX_INCR DIRECT FNC_VALUES 4 UBYTE COLUMN_DIR DIRECT /end RECORD_LAYOUT
/begin RECORD_LAYOUT Cur_Xs16Ws16 NO_AXIS_PTS_X 1 SWORD AXIS_PTS_X 2 SWORD INDEX_INCR DIRECT FNC_VALUES 3 SWORD COLUMN_DIR DIRECT /end RECORD_LAYOUT
/begin RECORD_LAYOUT Kw_Ws16 FNC_VALUES 1 SWORD COLUMN_DIR DIRECT /end RECORD_LAYOUT
/begin RECORD_LAYOUT Kw_Ws32 FNC_VALUES 1 SLONG COLUMN_DIR DIRECT /end RECORD_LAYOUT
/begin RECORD_LAYOUT Kw_Wu16 FNC_VALUES 1 UWORD COLUMN_DIR DIRECT /end RECORD_LAYOUT
/begin RECORD_LAYOUT Kw_Wu8 FNC_VALUES 1 UBYTE COLUMN_DIR DIRECT /end RECORD_LAYOUT
/begin RECORD_LAYOUT Map_Xs16Ys16Ws16 NO_AXIS_PTS_X 1 SWORD NO_AXIS_PTS_Y 2 SWORD AXIS_PTS_X 3 SWORD INDEX_INCR DIRECT AXIS_PTS_Y 4 SWORD INDEX_INCR DIRECT FNC_VALUES 5 SWORD COLUMN_DIR DIRECT /end RECORD_LAYOUT
/begin RECORD_LAYOUT ValA_Ws16 FNC_VALUES 1 SWORD COLUMN_DIR DIRECT /end RECORD_LAYOUT
/begin RECORD_LAYOUT ValA_Ws32 FNC_VALUES 1 SLONG COLUMN_DIR DIRECT /end RECORD_LAYOUT
/begin RECORD_LAYOUT ValA_Wu16 FNC_VALUES 1 UWORD COLUMN_DIR DIRECT /end RECORD_LAYOUT
/begin RECORD_LAYOUT ValA_Wu8 FNC_VALUES 1 UBYTE COLUMN_DIR DIRECT /end RECORD_LAYOUT
/begin RECORD_LAYOUT Val_Ws16 FNC_VALUES 1 SWORD COLUMN_DIR DIRECT /end RECORD_LAYOUT
/begin RECORD_LAYOUT Val_Ws32 FNC_VALUES 1 SLONG COLUMN_DIR DIRECT /end RECORD_LAYOUT
/begin RECORD_LAYOUT Val_Wu16 FNC_VALUES 1 UWORD COLUMN_DIR DIRECT /end RECORD_LAYOUT
/begin RECORD_LAYOUT Val_Wu32 FNC_VALUES 1 ULONG COLUMN_DIR DIRECT /end RECORD_LAYOUT
/begin RECORD_LAYOUT Val_Wu8 FNC_VALUES 1 UBYTE COLUMN_DIR DIRECT /end RECORD_LAYOUT
/end MODULE
/end PROJECT

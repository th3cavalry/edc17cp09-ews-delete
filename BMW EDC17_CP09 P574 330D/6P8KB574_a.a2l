ASAP2_VERSION 1 4
/begin PROJECT P_574 "EDC17_CP09"
/begin HEADER "" VERSION "V8KB" PROJECT_NO P_574 /end HEADER
/begin MODULE DIM ""
/begin MOD_COMMON "" BYTE_ORDER MSB_LAST ALIGNMENT_BYTE 1 ALIGNMENT_WORD 2 ALIGNMENT_LONG 4 ALIGNMENT_FLOAT32_IEEE 4 /end MOD_COMMON
/begin CHARACTERISTIC DewDet_cpGs_C "Spezifische Wärmekapazität vom Abgas" VALUE 0x80038AD4 Val_Ws16 2.000000 SpecificHeat 0.00 2.000000 FORMAT "%8.6" EXTENDED_LIMITS -3.276800 3.276700 /end CHARACTERISTIC
/begin CHARACTERISTIC DewDet_dmPlsThresLSUSrvTst_CA "Minimaler Massenstrom für gültigen Gasstoß im Servicetest-Modus" VAL_BLK 0x80038AD6 Kwb_Ws16 1000.000 AirMassPerTime 0.00 1000.000 EXTENDED_LIMITS -3276.800 3276.700 NUMBER 2 /end CHARACTERISTIC
/begin CHARACTERISTIC DewDet_dmPlsThresLSU_CA "Minimaler Massenstrom für gültigen Gasstoß im Normalbetrieb" VAL_BLK 0x80038ADA Kwb_Ws16 1000.000 AirMassPerTime 0.00 1000.000 EXTENDED_LIMITS -3276.800 3276.700 NUMBER 2 /end CHARACTERISTIC
/begin CHARACTERISTIC DewDet_facCldStrtLSU_CA "Faktor für Schwellwerterhöhung bei wiederholtem Kaltstart" VAL_BLK 0x80038ADE Kwb_Ws16 1.000000 Fact 0.00 1.000000 EXTENDED_LIMITS -4.000000 3.999878 NUMBER 2 /end CHARACTERISTIC
/begin CHARACTERISTIC DewDet_facPlsLSUSrvTst_CA "Faktor für Abnahme der Wärmeschwelle bei gültigem Gasstoß im Servicetest-Modus" VAL_BLK 0x80038AE2 Kwb_Ws16 1.000000 Fact 0.00 1.000000 EXTENDED_LIMITS -4.000000 3.999878 NUMBER 2 /end CHARACTERISTIC
/begin CHARACTERISTIC DewDet_facPlsLSU_CA "Faktor für Abnahme der Wärmeschwelle bei gültigem Gasstoß im Normalbetrieb" VAL_BLK 0x80038AE6 Kwb_Ws16 1.000000 Fact 0.00 1.000000 EXTENDED_LIMITS -4.000000 3.999878 NUMBER 2 /end CHARACTERISTIC
/begin CHARACTERISTIC DewDet_facPlsThresLSU_CA "minimaler Wärmemengenschwellwert zur Aktivierung der Gasstoß-Erkennung" VAL_BLK 0x80038AEA Kwb_Ws16 1.000000 Fact 0.00 1.000000 EXTENDED_LIMITS -4.000000 3.999878 NUMBER 2 /end CHARACTERISTIC
/begin CHARACTERISTIC DewDet_facThresNoSftyFac_CA "Faktor zur Schwellwerterniedrigung im Servicetest-Modus" VAL_BLK 0x80038AEE Kwb_Ws16 1.000000 Fact 0.00 1.000000 EXTENDED_LIMITS -4.000000 3.999878 NUMBER 2 /end CHARACTERISTIC
/begin CHARACTERISTIC DewDet_numEngTempStrt_C "Parameter zum Auswählen einer Motortemperatur aus dem Feld EngDa_tFld" VALUE 0x80038AF2 Kw_Wu8 3.00000000000 EngTempFldSel 0.00 3.00000000000 FORMAT "%13.11" /end CHARACTERISTIC
/begin CHARACTERISTIC DewDet_numLSU_CA "Parameterfeld zum Auswählen der Abgas- bzw. Wandtemperatur am Sondeneinbauort aus den Feldern ASMod_tEGFld bzw. ASMod_tWallFld" VAL_BLK 0x80038AF3 Kwb_Wu8 6.000 OneToOne 0.00 6.000 EXTENDED_LIMITS 0.00 255.0 NUMBER 2 /end CHARACTERISTIC
/begin CHARACTERISTIC DewDet_numMaxCldStrt_CA "Maximale Anzahl der zu zählenden Kaltstarts" VAL_BLK 0x80038AF5 Kwb_Wu8 10.00 OneToOne 0.00 10.00 EXTENDED_LIMITS 0.00 255.0 NUMBER 2 /end CHARACTERISTIC
/begin CHARACTERISTIC DewDet_numPlsSrvTst_CA "Anzahl der Gasstöße zur verkürzten Heizungsfreigabe im Servicetest-Modus" VAL_BLK 0x80038AF7 Kwb_Wu8 10.00 OneToOne 0.00 10.00 EXTENDED_LIMITS 0.00 255.0 NUMBER 2 /end CHARACTERISTIC
/begin CHARACTERISTIC DewDet_numTempThresLSU_CA "" VAL_BLK 0x80038AF9 Kwb_Wu8 10.00 OneToOne 0.00 10.00 EXTENDED_LIMITS 0.00 255.0 NUMBER 2 /end CHARACTERISTIC
/begin CHARACTERISTIC DewDet_swtDewDetShOff_CA "Umschalter für Ersatzfunktion (Zeitapplikation)" VAL_BLK 0x80038AFB Kwb_Wu8 1.000 OneToOne 0.00 1.000 EXTENDED_LIMITS 0.00 255.0 NUMBER 2 /end CHARACTERISTIC
/begin CHARACTERISTIC DewDet_tiDebLSU_CA "Entprellzeit Heizungsfreigabe Lambdasonde 0" VAL_BLK 0x80038AFE Kwb_Ws16 20.00000 Time_s 0.00 20.00000 EXTENDED_LIMITS -327.6800 327.6700 NUMBER 2 /end CHARACTERISTIC
/begin CHARACTERISTIC DewDet_tiDebRunTransOk_C "Entprellzeit zur Verzögerung der Berechnungen nach Start bis gültige Temperaturen anliegen" VALUE 0x80038B02 Kw_Ws16 1000.000 TimeDeb 0.00 1000.000 EXTENDED_LIMITS -327680.0 327670.0 /end CHARACTERISTIC
/begin CHARACTERISTIC DewDet_tiHtgDelLSU_CA "Verzögerung der Heizungsfreigabe im Fehlerfall" VAL_BLK 0x80038B04 Kwb_Ws32 600.000000000 Time_s 0.00 600.000000000 EXTENDED_LIMITS -21474836.4800 21474836.4700 NUMBER 2 /end CHARACTERISTIC
/begin CHARACTERISTIC DewDet_tiMSAStop_C "" VALUE 0x80038B0C Val_Ws16 25000.00 TimeDeb 0.00 25000.00 EXTENDED_LIMITS -327680.0 327670.0 /end CHARACTERISTIC
/begin CHARACTERISTIC DewDet_tIntegIniSrvTst_CA "Temperaturschwellwert für die Aktivierung des Wärmemengenintegrators im Servicetest-Modus" VAL_BLK 0x80038B0E Kwb_Ws16 100.0000 Temp_Cels -0.04000000 99.96000 EXTENDED_LIMITS -3549.940 3003.560 NUMBER 2 /end CHARACTERISTIC
/begin CHARACTERISTIC DewDet_tIntegIni_CA "Temperaturschwellwert für die Aktivierung des Wärmemengenintegrators im Normalbetrieb" VAL_BLK 0x80038B12 Kwb_Ws16 100.0000 Temp_Cels -0.04000000 99.96000 EXTENDED_LIMITS -3549.940 3003.560 NUMBER 2 /end CHARACTERISTIC
/begin CHARACTERISTIC DewDet_tiPlsLSUSrvTst_CA "Minimale Dauer für gültigen Gaspuls im Servicetest-Modus" VAL_BLK 0x80038B16 Kwb_Ws16 20.00000 Time_s 0.00 20.00000 EXTENDED_LIMITS -327.6800 327.6700 NUMBER 2 /end CHARACTERISTIC
/begin CHARACTERISTIC DewDet_tiPlsLSU_CA "Minimale Dauer für gültigen Gaspuls im Normalbetrieb" VAL_BLK 0x80038B1A Kwb_Ws16 20.00000 Time_s 0.00 20.00000 EXTENDED_LIMITS -327.6800 327.6700 NUMBER 2 /end CHARACTERISTIC
/begin CHARACTERISTIC DewDet_tThresLSUActSrvTst_CA "Temperaturschwellwert für reversible TPE im Servicetest-Modus" VAL_BLK 0x80038B1E Kwb_Ws16 100.0000 Temp_Cels -0.04000000 99.96000 EXTENDED_LIMITS -3549.940 3003.560 NUMBER 2 /end CHARACTERISTIC
/begin CHARACTERISTIC DewDet_tThresLSUAct_CA "Temperaturschwellwert für reversible TPE im Normalbetrieb" VAL_BLK 0x80038B22 Kwb_Ws16 100.0000 Temp_Cels -0.04000000 99.96000 EXTENDED_LIMITS -3549.940 3003.560 NUMBER 2 /end CHARACTERISTIC
/begin CHARACTERISTIC DewDet_tThresLSU_C "" VALUE 0x80038B26 Val_Ws16 100.0000 Temp_Cels -0.04000000 99.96000 EXTENDED_LIMITS -3549.940 3003.560 /end CHARACTERISTIC
/begin CHARACTERISTIC DewDet_tWtEquiv_CA "äquivalente Wassertemperatur beim Verdampfen" VAL_BLK 0x80038B28 Kwb_Ws16 1095.000 Temp_Cels -45.04000 1049.960 EXTENDED_LIMITS -3549.940 3003.560 NUMBER 2 /end CHARACTERISTIC
/begin CHARACTERISTIC DewDet_wLSUIKi_CA "Verstärkung des Integrators" VAL_BLK 0x80038B2C Kwb_Ws16 5.000000 OneToOne 0.00 5.000000 EXTENDED_LIMITS -32768.00 32767.00 NUMBER 2 /end CHARACTERISTIC
/begin CHARACTERISTIC DewDet_wThresLSU0_MAP "Wärmeschwellen Grundkennfeld Lambdasonde 0" MAP 0x80038B30 Kf_Xs16_Ys16_Ws16 6000.000 Energy 0.00 6000.000 FORMAT "%8.3" EXTENDED_LIMITS -32768.00 32767.00
 /begin AXIS_DESCR STD_AXIS DewDet_tEGLSUInpCrv0_mp Temp_Cels 10 -45.04000 1049.960 EXTENDED_LIMITS -3549.940 3003.560 DEPOSIT ABSOLUTE /end AXIS_DESCR
 /begin AXIS_DESCR STD_AXIS DewDet_tEngStrt_mp Temp_Cels 10 -45.04000 1049.960 EXTENDED_LIMITS -3549.940 3003.560 DEPOSIT ABSOLUTE /end AXIS_DESCR
/end CHARACTERISTIC
/begin CHARACTERISTIC DewDet_wThresLSU1_MAP "Wärmeschwellen Grundkennfeld Lambdasonde 1" MAP 0x80038C24 Kf_Xs16_Ys16_Ws16 6000.000 Energy 0.00 6000.000 FORMAT "%8.3" EXTENDED_LIMITS -32768.00 32767.00
 /begin AXIS_DESCR STD_AXIS DewDet_tEGLSUInpCrv1_mp Temp_Cels 10 -45.04000 1049.960 EXTENDED_LIMITS -3549.940 3003.560 DEPOSIT ABSOLUTE /end AXIS_DESCR
 /begin AXIS_DESCR STD_AXIS DewDet_tEngStrt_mp Temp_Cels 10 -45.04000 1049.960 EXTENDED_LIMITS -3549.940 3003.560 DEPOSIT ABSOLUTE /end AXIS_DESCR
/end CHARACTERISTIC
/begin MEASUREMENT AFST_t "" SWORD Temp_Cels 1 100 -3549.940 3003.560 ECU_ADDRESS 0xD00003FE /end MEASUREMENT
/begin MEASUREMENT AFS_stDrftB1 "Status der Driftkompensation, Bank 1" UBYTE default 1 100 0.00 255.0 FORMAT "%5.1" ECU_ADDRESS 0xD0001BE1 /end MEASUREMENT
/begin MEASUREMENT AFS_stDrftB2 "Status der Driftkompensation, Bank 2" UBYTE default 1 100 0.00 255.0 FORMAT "%5.1" ECU_ADDRESS 0xD0001BE2 /end MEASUREMENT
/begin MEASUREMENT AirC_pClnt "" SWORD PresAC_hPa 1 100 -65536.00 65534.00 FORMAT "%8.2" ECU_ADDRESS 0xD0000590 /end MEASUREMENT
/begin MEASUREMENT AirC_rClgDem "" SWORD Prc 1 100 -400.0000 399.9878 ECU_ADDRESS 0xD0000592 /end MEASUREMENT
/begin MEASUREMENT AirC_stHtrSwt "" UBYTE OneToOne 1 100 0.00 255.0 ECU_ADDRESS 0xD0001BF5 /end MEASUREMENT
/begin MEASUREMENT ASMod_qCor "Korrekturmenge für Mengensignal" SWORD InjMass 1 100 -327.6800 327.6700 ECU_ADDRESS 0xD00004B6 /end MEASUREMENT
/begin MEASUREMENT CACDsT_dt "" SWORD Temp_Cels 1 100 -3549.940 3003.560 ECU_ADDRESS 0xD000067C /end MEASUREMENT
/begin MEASUREMENT CACDsT_t "" SWORD Temp_Cels 1 100 -3549.940 3003.560 ECU_ADDRESS 0xD000067E /end MEASUREMENT
/begin MEASUREMENT CEngUsT_t "" SWORD Temp_Cels 1 100 -3549.940 3003.560 ECU_ADDRESS 0xD0000688 /end MEASUREMENT
/begin MEASUREMENT Com_pAbsUPmpP "" SWORD nox 1 100 -32768.00 32767.00 FORMAT "%8.2" ECU_ADDRESS 0xD00007AC /end MEASUREMENT
/begin MEASUREMENT Com_rUTnkLvl "" SWORD OneToOne 1 100 -32768.00 32767.00 ECU_ADDRESS 0xD00007EE /end MEASUREMENT
/begin MEASUREMENT Com_stSVSReq "" UBYTE OneToOne 1 100 0.00 255.0 ECU_ADDRESS 0xD0001D5A /end MEASUREMENT
/begin MEASUREMENT Com_tUCatDsT "" SWORD nox 1 100 -32768.00 32767.00 FORMAT "%8.2" ECU_ADDRESS 0xD0000806 /end MEASUREMENT
/begin MEASUREMENT Com_tUCatUsT "" SWORD nox 1 100 -32768.00 32767.00 FORMAT "%8.2" ECU_ADDRESS 0xD0000808 /end MEASUREMENT
/begin MEASUREMENT Com_tUTnkT "" SWORD Temp_Cels 1 100 -3549.940 3003.560 ECU_ADDRESS 0xD000080A /end MEASUREMENT
/begin MEASUREMENT DewDet_ctCldStrtLSU_mp "Zähler für wiederholte Kaltstarts" UBYTE OneToOne 1 100 0.00 255.0 ARRAY_SIZE 2 ECU_ADDRESS 0xC000B954 /end MEASUREMENT
/begin MEASUREMENT DewDet_ctPlsLSUSrvTst_mp "Anzahl der gültigen Gasstöße im Servicetest-Modus" UBYTE OneToOne 1 100 0.00 255.0 ARRAY_SIZE 2 ECU_ADDRESS 0xC000B956 /end MEASUREMENT
/begin MEASUREMENT DewDet_dwLSU_mp "Abgaswärmestrom an Sondenposition" SWORD Pwr_kW_Sec 1 100 -327.6800 327.6700 FORMAT "%8.4" ARRAY_SIZE 2 ECU_ADDRESS 0xC000B958 /end MEASUREMENT
/begin MEASUREMENT DewDet_stDewDetTstDem_mp "Status des Servicetest-Modus" UBYTE OneToOne 1 100 0.00 255.0 ECU_ADDRESS 0xC000B0FC /end MEASUREMENT
/begin MEASUREMENT DewDet_stEEPWrite_mp "Statusanzeige für den Schreibprozess in den RAM-Spiegel für Heizungsfreigabe LSU" UBYTE OneToOne 1 100 0.00 255.0 ECU_ADDRESS 0xC000B0FD /end MEASUREMENT
/begin MEASUREMENT DewDet_stHtgLSU "Statusbit Freigabe Sensor-Heizung" UBYTE OneToOne 1 100 0.00 255.0 ARRAY_SIZE 2 ECU_ADDRESS 0xD0001DD4 /end MEASUREMENT
/begin MEASUREMENT DewDet_stHtgLSULstTrp_mp "Status der Taupunktfreigabe des letzten Fahrzyklus" UBYTE OneToOne 1 100 0.00 255.0 ARRAY_SIZE 2 ECU_ADDRESS 0xC000B95C /end MEASUREMENT
/begin MEASUREMENT DewDet_stHtgThresLSUHit_mp "Status für Überschreiten des Wärmemengenschwellwertes" UBYTE OneToOne 1 100 0.00 255.0 ARRAY_SIZE 2 ECU_ADDRESS 0xC000B95E /end MEASUREMENT
/begin MEASUREMENT DewDet_stIntegIni_mp "Status Integrator Initialisierung" UBYTE OneToOne 1 100 0.00 255.0 ARRAY_SIZE 2 ECU_ADDRESS 0xC000B960 /end MEASUREMENT
/begin MEASUREMENT DewDet_stMSAStopActv_mp "" UBYTE OneToOne 1 100 0.00 255.0 ECU_ADDRESS 0xC000B0FE /end MEASUREMENT
/begin MEASUREMENT DewDet_stPlsLSU_mp "Status-Bit gültiger Gasstösse" UBYTE OneToOne 1 100 0.00 255.0 ARRAY_SIZE 2 ECU_ADDRESS 0xC000B962 /end MEASUREMENT
/begin MEASUREMENT DewDet_tEGLSUInpCrv0_mp "Messpunkt Eingang des Kennfeldes DewDet_wThresLSU0_MAP" SWORD Temp_Cels 1 100 -3549.940 3003.560 ECU_ADDRESS 0xC0009C24 /end MEASUREMENT
/begin MEASUREMENT DewDet_tEGLSUInpCrv1_mp "Messpunkt Eingang des Kennfeldes DewDet_wTresLSU1_MAP" SWORD Temp_Cels 1 100 -3549.940 3003.560 ECU_ADDRESS 0xC0009C26 /end MEASUREMENT
/begin MEASUREMENT DewDet_tEG_mp "Gewählte Abgastemperatur am jeweiligen Sondeneinbauort" SWORD Temp_Cels 1 100 -3549.940 3003.560 ARRAY_SIZE 2 ECU_ADDRESS 0xC000B964 /end MEASUREMENT
/begin MEASUREMENT DewDet_tEngStrt_mp "Gewählte Motortemperatur" SWORD Temp_Cels 1 100 -3549.940 3003.560 ECU_ADDRESS 0xC0009C28 /end MEASUREMENT
/begin MEASUREMENT DewDet_tWall_mp "Gewählte Rohrwandtemperatur am jeweiligen Sondeneinbauort" SWORD Temp_Cels 1 100 -3549.940 3003.560 ARRAY_SIZE 2 ECU_ADDRESS 0xC000B968 /end MEASUREMENT
/begin MEASUREMENT DewDet_wLSU_mp "integrierte Wärmemenge an Sensor-Position." SWORD Energy 1 100 -32768.00 32767.00 FORMAT "%8.2" ARRAY_SIZE 2 ECU_ADDRESS 0xC000B96C /end MEASUREMENT
/begin MEASUREMENT DewDet_wThresLSUAct_mp "aktueller Wärmeschwellwert an Sensorposition." SWORD Energy 1 100 -32768.00 32767.00 FORMAT "%8.2" ARRAY_SIZE 2 ECU_ADDRESS 0xC000B970 /end MEASUREMENT
/begin MEASUREMENT DewDet_wThresLSUNoPls_mp "Wärmeschwelle ohne gültigen Gasstoss." SWORD Energy 1 100 -32768.00 32767.00 FORMAT "%8.2" ARRAY_SIZE 2 ECU_ADDRESS 0xC000B974 /end MEASUREMENT
/begin MEASUREMENT DewDet_wThresLSUPls_mp "Hitzeschwelle für gültigen Gaspuls" SWORD Energy 1 100 -32768.00 32767.00 FORMAT "%8.2" ARRAY_SIZE 2 ECU_ADDRESS 0xC000B978 /end MEASUREMENT
/begin MEASUREMENT DewDet_wThresLSU_mp "Schwellwert Wärmemenge" SWORD Energy 1 100 -32768.00 32767.00 FORMAT "%8.2" ARRAY_SIZE 2 ECU_ADDRESS 0xC000B97C /end MEASUREMENT
/begin MEASUREMENT DFC_st.DFC_Unused "DFC/intern benötigte Message für nicht existierende Fehlerprüfung DFC_Unused" UWORD DFC_OneToOne 1 100 0.00 65535.00 ECU_ADDRESS 0xD00084B2 /end MEASUREMENT
/begin MEASUREMENT DFC_st.DFC_ACCIPlausDrvAst "DFC/Status der Fehlerprüfung DFC_ACCIPlausDrvAst" UWORD DFC_OneToOne 1 100 0.00 65535.00 ECU_ADDRESS 0xD00084B4 /end MEASUREMENT
/begin MEASUREMENT DFC_st.DFC_ACCIPlausTrqDes "DFC/Status der Fehlerprüfung DFC_ACCIPlausTrqDes" UWORD DFC_OneToOne 1 100 0.00 65535.00 ECU_ADDRESS 0xD00084B6 /end MEASUREMENT
/begin MEASUREMENT DFC_st.DFC_AirCtlGovDvtEOMMax "DFC/Status der Fehlerprüfung DFC_AirCtlGovDvtEOMMax" UWORD DFC_OneToOne 1 100 0.00 65535.00 ECU_ADDRESS 0xD00084B8 /end MEASUREMENT
/begin MEASUREMENT DFC_st.DFC_AirCtlGovDvtEOMMin "DFC/Status der Fehlerprüfung DFC_AirCtlGovDvtEOMMin" UWORD DFC_OneToOne 1 100 0.00 65535.00 ECU_ADDRESS 0xD00084BA /end MEASUREMENT
/begin MEASUREMENT DFC_st.DFC_AirCtlGovDvtMax "DFC/Status der Fehlerprüfung DFC_AirCtlGovDvtMax" UWORD DFC_OneToOne 1 100 0.00 65535.00 ECU_ADDRESS 0xD00084BC /end MEASUREMENT
/begin MEASUREMENT DFC_st.DFC_AirCtlGovDvtMin "DFC/Status der Fehlerprüfung DFC_AirCtlGovDvtMin" UWORD DFC_OneToOne 1 100 0.00 65535.00 ECU_ADDRESS 0xD00084BE /end MEASUREMENT
/begin MEASUREMENT DFC_st.DFC_AirCtlGovLPDvtMax "DFC/Status der Fehlerprüfung DFC_AirCtlGovLPDvtMax" UWORD DFC_OneToOne 1 100 0.00 65535.00 ECU_ADDRESS 0xD00084C0 /end MEASUREMENT
/begin MEASUREMENT DFC_st.DFC_AirCtlGovLPDvtMin "DFC/Status der Fehlerprüfung DFC_AirCtlGovLPDvtMin" UWORD DFC_OneToOne 1 100 0.00 65535.00 ECU_ADDRESS 0xD00084C2 /end MEASUREMENT
/begin MEASUREMENT DFC_st.DFC_AltIOComErr "DFC/Status der Fehlerprüfung DFC_AltIOComErr" UWORD DFC_OneToOne 1 100 0.00 65535.00 ECU_ADDRESS 0xD00084C4 /end MEASUREMENT
/begin MEASUREMENT DFC_st.DFC_AltIOComNpl "DFC/Status der Fehlerprüfung DFC_AltIOComNpl" UWORD DFC_OneToOne 1 100 0.00 65535.00 ECU_ADDRESS 0xD00084C6 /end MEASUREMENT
/begin MEASUREMENT DFC_st.DFC_BusDiagBusOffFlexRay "" UWORD DFC_OneToOne 1 100 0.00 65535.00 ECU_ADDRESS 0xD00084C8 /end MEASUREMENT
/begin MEASUREMENT DFC_st.DFC_BusDiagBusOffNodeA "DFC/Status der Fehlerprüfung DFC_BusDiagBusOffNodeA" UWORD DFC_OneToOne 1 100 0.00 65535.00 ECU_ADDRESS 0xD00084CA /end MEASUREMENT
/begin MEASUREMENT DFC_st.DFC_BusDiagBusOffNodeB "DFC/Status der Fehlerprüfung DFC_BusDiagBusOffNodeB" UWORD DFC_OneToOne 1 100 0.00 65535.00 ECU_ADDRESS 0xD00084CC /end MEASUREMENT
/begin MEASUREMENT DFC_st.DFC_BusDiagBusOffNodeC "DFC/Status der Fehlerprüfung DFC_BusDiagBusOffNodeC" UWORD DFC_OneToOne 1 100 0.00 65535.00 ECU_ADDRESS 0xD00084CE /end MEASUREMENT
/begin MEASUREMENT DFC_st.DFC_BusDiagHwFlexRay "" UWORD DFC_OneToOne 1 100 0.00 65535.00 ECU_ADDRESS 0xD00084D0 /end MEASUREMENT
/begin MEASUREMENT DFC_st.DFC_Cj945SpiCom1 "DFC/Status der Fehlerprüfung DFC_Cj945SpiCom1" UWORD DFC_OneToOne 1 100 0.00 65535.00 ECU_ADDRESS 0xD00084D2 /end MEASUREMENT
/begin MEASUREMENT DFC_st.DFC_ComACDemandSig_FA "DFC/Status der Fehlerprüfung DFC_ComACDemandSig_FA" UWORD DFC_OneToOne 1 100 0.00 65535.00 ECU_ADDRESS 0xD00084D4 /end MEASUREMENT
/begin MEASUREMENT DFC_st.DFC_ComACDemandTo_FA "DFC/Status der Fehlerprüfung DFC_ComACDemandTo_FA" UWORD DFC_OneToOne 1 100 0.00 65535.00 ECU_ADDRESS 0xD00084D6 /end MEASUREMENT
/begin MEASUREMENT DFC_st.DFC_ComATempSig_FA "DFC/Status der Fehlerprüfung DFC_ComATempSig_FA" UWORD DFC_OneToOne 1 100 0.00 65535.00 ECU_ADDRESS 0xD00084D8 /end MEASUREMENT
/begin MEASUREMENT DFC_st.DFC_ComATempTo_FA "DFC/Status der Fehlerprüfung DFC_ComATempTo_FA" UWORD DFC_OneToOne 1 100 0.00 65535.00 ECU_ADDRESS 0xD00084DA /end MEASUREMENT
/begin MEASUREMENT DFC_st.DFC_ComATempTo_FX "DFC/Status der Fehlerprüfung DFC_ComATempTo_FX" UWORD DFC_OneToOne 1 100 0.00 65535.00 ECU_ADDRESS 0xD00084DC /end MEASUREMENT
/begin MEASUREMENT DFC_st.DFC_ComBrkTrqSumChk_FX "DFC/Status der Fehlerprüfung DFC_ComBrkTrqSumChk_FX" UWORD DFC_OneToOne 1 100 0.00 65535.00 ECU_ADDRESS 0xD00084DE /end MEASUREMENT
/begin MEASUREMENT DFC_st.DFC_ComBrkTrqSumCtr_FX "DFC/Status der Fehlerprüfung DFC_ComBrkTrqSumCtr_FX" UWORD DFC_OneToOne 1 100 0.00 65535.00 ECU_ADDRESS 0xD00084E0 /end MEASUREMENT
/begin MEASUREMENT DFC_st.DFC_ComBrkTrqSumTo_FX "DFC/Status der Fehlerprüfung DFC_ComBrkTrqSumTo_FX" UWORD DFC_OneToOne 1 100 0.00 65535.00 ECU_ADDRESS 0xD00084E2 /end MEASUREMENT
/begin MEASUREMENT DFC_st.DFC_ComBtnDrvDynChk_FX "DFC/Status der Fehlerprüfung DFC_ComBtnDrvDynChk_FX" UWORD DFC_OneToOne 1 100 0.00 65535.00 ECU_ADDRESS 0xD00084E4 /end MEASUREMENT
/begin MEASUREMENT DFC_st.DFC_ComBtnDrvDynCtr_FX "DFC/Status der Fehlerprüfung DFC_ComBtnDrvDynCtr_FX" UWORD DFC_OneToOne 1 100 0.00 65535.00 ECU_ADDRESS 0xD00084E6 /end MEASUREMENT
/begin MEASUREMENT DFC_st.DFC_ComBtnDrvDynTo_FX "DFC/Status der Fehlerprüfung DFC_ComBtnDrvDynTo_FX" UWORD DFC_OneToOne 1 100 0.00 65535.00 ECU_ADDRESS 0xD00084E8 /end MEASUREMENT
/begin MEASUREMENT DFC_st.DFC_ComButtonMSASig "DFC/Status der Fehlerprüfung DFC_ComButtonMSASig" UWORD DFC_OneToOne 1 100 0.00 65535.00 ECU_ADDRESS 0xD00084EA /end MEASUREMENT
/begin MEASUREMENT DFC_st.DFC_ComButtonMSATo "DFC/Status der Fehlerprüfung DFC_ComButtonMSATo" UWORD DFC_OneToOne 1 100 0.00 65535.00 ECU_ADDRESS 0xD00084EC /end MEASUREMENT
/begin MEASUREMENT DFC_st.DFC_ComCodierungPwrmngSig "DFC/Status der Fehlerprüfung DFC_ComCodierungPwrmngSig" UWORD DFC_OneToOne 1 100 0.00 65535.00 ECU_ADDRESS 0xD00084EE /end MEASUREMENT
/begin MEASUREMENT DFC_st.DFC_ComCodierungPwrmngSig_FA "DFC/Status der Fehlerprüfung DFC_ComCodierungPwrmngSig_FA" UWORD DFC_OneToOne 1 100 0.00 65535.00 ECU_ADDRESS 0xD00084F0 /end MEASUREMENT
/begin MEASUREMENT DFC_st.DFC_ComCrCtlLvrChk "DFC/Status der Fehlerprüfung DFC_ComCrCtlLvrChk" UWORD DFC_OneToOne 1 100 0.00 65535.00 ECU_ADDRESS 0xD00084F2 /end MEASUREMENT
/begin MEASUREMENT DFC_st.DFC_ComCrCtlLvrCtr "DFC/Status der Fehlerprüfung DFC_ComCrCtlLvrCtr" UWORD DFC_OneToOne 1 100 0.00 65535.00 ECU_ADDRESS 0xD00084F4 /end MEASUREMENT
/begin MEASUREMENT DFC_st.DFC_ComCrCtlLvrSig "DFC/Status der Fehlerprüfung DFC_ComCrCtlLvrSig" UWORD DFC_OneToOne 1 100 0.00 65535.00 ECU_ADDRESS 0xD00084F6 /end MEASUREMENT
/begin MEASUREMENT DFC_st.DFC_ComCrCtlLvrTo "DFC/Status der Fehlerprüfung DFC_ComCrCtlLvrTo" UWORD DFC_OneToOne 1 100 0.00 65535.00 ECU_ADDRESS 0xD00084F8 /end MEASUREMENT
/begin MEASUREMENT DFC_st.DFC_ComCtrCrshSwoEkpSig_FA "DFC/Status der Fehlerprüfung DFC_ComCtrCrshSwoEkpSig_FA" UWORD DFC_OneToOne 1 100 0.00 65535.00 ECU_ADDRESS 0xD00084FA /end MEASUREMENT
/begin MEASUREMENT DFC_st.DFC_ComCtrCrshSwoEkpTo_FA "DFC/Status der Fehlerprüfung DFC_ComCtrCrshSwoEkpTo_FA" UWORD DFC_OneToOne 1 100 0.00 65535.00 ECU_ADDRESS 0xD00084FC /end MEASUREMENT
/begin MEASUREMENT DFC_st.DFC_ComCtrSecInt "DFC/Status der Fehlerprüfung DFC_ComCtrSecInt" UWORD DFC_OneToOne 1 100 0.00 65535.00 ECU_ADDRESS 0xD00084FE /end MEASUREMENT
/begin MEASUREMENT DFC_st.DFC_ComDiaOBDGbxSig_A "DFC/Status der Fehlerprüfung DFC_ComDiaOBDGbxSig_A" UWORD DFC_OneToOne 1 100 0.00 65535.00 ECU_ADDRESS 0xD0008500 /end MEASUREMENT
/begin MEASUREMENT DFC_st.DFC_ComDiaOBDGbxTo_A "DFC/Status der Fehlerprüfung DFC_ComDiaOBDGbxTo_A" UWORD DFC_OneToOne 1 100 0.00 65535.00 ECU_ADDRESS 0xD0008502 /end MEASUREMENT
/begin MEASUREMENT DFC_st.DFC_ComFahrzeugtypSig "DFC/Status der Fehlerprüfung DFC_ComFahrzeugtypSig" UWORD DFC_OneToOne 1 100 0.00 65535.00 ECU_ADDRESS 0xD0008504 /end MEASUREMENT
/begin MEASUREMENT DFC_st.DFC_ComFahrzeugtypSig_FA "DFC/Status der Fehlerprüfung DFC_ComFahrzeugtypSig_FA" UWORD DFC_OneToOne 1 100 0.00 65535.00 ECU_ADDRESS 0xD0008506 /end MEASUREMENT
/begin MEASUREMENT DFC_st.DFC_ComFllupGpwsupSig_FA "DFC/Status der Fehlerprüfung DFC_ComFllupGpwsupSig_FA" UWORD DFC_OneToOne 1 100 0.00 65535.00 ECU_ADDRESS 0xD0008508 /end MEASUREMENT
/begin MEASUREMENT DFC_st.DFC_ComFllupGpwsupTo_FA "DFC/Status der Fehlerprüfung DFC_ComFllupGpwsupTo_FA" UWORD DFC_OneToOne 1 100 0.00 65535.00 ECU_ADDRESS 0xD000850A /end MEASUREMENT
/begin MEASUREMENT DFC_st.DFC_ComGbxDataChk_A "DFC/Status der Fehlerprüfung DFC_ComGbxDataChk_A" UWORD DFC_OneToOne 1 100 0.00 65535.00 ECU_ADDRESS 0xD000850C /end MEASUREMENT
/begin MEASUREMENT DFC_st.DFC_ComGbxDataChk_FA "DFC/Status der Fehlerprüfung DFC_ComGbxDataChk_FA" UWORD DFC_OneToOne 1 100 0.00 65535.00 ECU_ADDRESS 0xD000850E /end MEASUREMENT
/begin MEASUREMENT DFC_st.DFC_ComGbxDataCtr_A "DFC/Status der Fehlerprüfung DFC_ComGbxDataCtr_A" UWORD DFC_OneToOne 1 100 0.00 65535.00 ECU_ADDRESS 0xD0008510 /end MEASUREMENT
/begin MEASUREMENT DFC_st.DFC_ComGbxDataCtr_FA "DFC/Status der Fehlerprüfung DFC_ComGbxDataCtr_FA" UWORD DFC_OneToOne 1 100 0.00 65535.00 ECU_ADDRESS 0xD0008512 /end MEASUREMENT
/begin MEASUREMENT DFC_st.DFC_ComGbxDataSig_A "DFC/Status der Fehlerprüfung DFC_ComGbxDataSig_A" UWORD DFC_OneToOne 1 100 0.00 65535.00 ECU_ADDRESS 0xD0008514 /end MEASUREMENT
/begin MEASUREMENT DFC_st.DFC_ComGbxDataSig_FA "DFC/Status der Fehlerprüfung DFC_ComGbxDataSig_FA" UWORD DFC_OneToOne 1 100 0.00 65535.00 ECU_ADDRESS 0xD0008516 /end MEASUREMENT
/begin MEASUREMENT DFC_st.DFC_ComGbxDataTo_A "DFC/Status der Fehlerprüfung DFC_ComGbxDataTo_A" UWORD DFC_OneToOne 1 100 0.00 65535.00 ECU_ADDRESS 0xD0008518 /end MEASUREMENT
/begin MEASUREMENT DFC_st.DFC_ComGbxDataTo_FA "DFC/Status der Fehlerprüfung DFC_ComGbxDataTo_FA" UWORD DFC_OneToOne 1 100 0.00 65535.00 ECU_ADDRESS 0xD000851A /end MEASUREMENT
/begin MEASUREMENT DFC_st.DFC_ComKlemmenChk_FA "DFC/Status der Fehlerprüfung DFC_ComKlemmenChk_FA" UWORD DFC_OneToOne 1 100 0.00 65535.00 ECU_ADDRESS 0xD000851C /end MEASUREMENT
/begin MEASUREMENT DFC_st.DFC_ComKlemmenCtr_FA "DFC/Status der Fehlerprüfung DFC_ComKlemmenCtr_FA" UWORD DFC_OneToOne 1 100 0.00 65535.00 ECU_ADDRESS 0xD000851E /end MEASUREMENT
/begin MEASUREMENT DFC_st.DFC_ComKlemmenSig_FA "DFC/Status der Fehlerprüfung DFC_ComKlemmenSig_FA" UWORD DFC_OneToOne 1 100 0.00 65535.00 ECU_ADDRESS 0xD0008520 /end MEASUREMENT
/begin MEASUREMENT DFC_st.DFC_ComKlemmenTo_FA "DFC/Status der Fehlerprüfung DFC_ComKlemmenTo_FA" UWORD DFC_OneToOne 1 100 0.00 65535.00 ECU_ADDRESS 0xD0008522 /end MEASUREMENT
/begin MEASUREMENT DFC_st.DFC_ComLenkradwinkelSig "DFC/Status der Fehlerprüfung DFC_ComLenkradwinkelSig" UWORD DFC_OneToOne 1 100 0.00 65535.00 ECU_ADDRESS 0xD0008524 /end MEASUREMENT
/begin MEASUREMENT DFC_st.DFC_ComLenkradwinkelTo "DFC/Status der Fehlerprüfung DFC_ComLenkradwinkelTo" UWORD DFC_OneToOne 1 100 0.00 65535.00 ECU_ADDRESS 0xD0008526 /end MEASUREMENT
/begin MEASUREMENT DFC_st.DFC_ComMileageRangeSig_FA "DFC/Status der Fehlerprüfung DFC_ComMileageRangeSig_FA" UWORD DFC_OneToOne 1 100 0.00 65535.00 ECU_ADDRESS 0xD0008528 /end MEASUREMENT
/begin MEASUREMENT DFC_st.DFC_ComMileageRangeTo_FA "DFC/Status der Fehlerprüfung DFC_ComMileageRangeTo_FA" UWORD DFC_OneToOne 1 100 0.00 65535.00 ECU_ADDRESS 0xD000852A /end MEASUREMENT
/begin MEASUREMENT DFC_st.DFC_ComPspSig "DFC/Status der Fehlerprüfung DFC_ComPspSig" UWORD DFC_OneToOne 1 100 0.00 65535.00 ECU_ADDRESS 0xD000852C /end MEASUREMENT
/begin MEASUREMENT DFC_st.DFC_ComPspTo "DFC/Status der Fehlerprüfung DFC_ComPspTo" UWORD DFC_OneToOne 1 100 0.00 65535.00 ECU_ADDRESS 0xD000852E /end MEASUREMENT
/begin MEASUREMENT DFC_st.DFC_ComRelTimeSig_FA "DFC/Status der Fehlerprüfung DFC_ComRelTimeSig_FA" UWORD DFC_OneToOne 1 100 0.00 65535.00 ECU_ADDRESS 0xD0008530 /end MEASUREMENT
/begin MEASUREMENT DFC_st.DFC_ComRelTimeTo_FA "DFC/Status der Fehlerprüfung DFC_ComRelTimeTo_FA" UWORD DFC_OneToOne 1 100 0.00 65535.00 ECU_ADDRESS 0xD0008532 /end MEASUREMENT
/begin MEASUREMENT DFC_st.DFC_ComRequestEMFChk "DFC/Status der Fehlerprüfung DFC_ComRequestEMFChk" UWORD DFC_OneToOne 1 100 0.00 65535.00 ECU_ADDRESS 0xD0008534 /end MEASUREMENT
/begin MEASUREMENT DFC_st.DFC_ComRequestEMFCtr "DFC/Status der Fehlerprüfung DFC_ComRequestEMFCtr" UWORD DFC_OneToOne 1 100 0.00 65535.00 ECU_ADDRESS 0xD0008536 /end MEASUREMENT
/begin MEASUREMENT DFC_st.DFC_ComRequestEMFSig "DFC/Status der Fehlerprüfung DFC_ComRequestEMFSig" UWORD DFC_OneToOne 1 100 0.00 65535.00 ECU_ADDRESS 0xD0008538 /end MEASUREMENT
/begin MEASUREMENT DFC_st.DFC_ComRequestEMFTo "DFC/Status der Fehlerprüfung DFC_ComRequestEMFTo" UWORD DFC_OneToOne 1 100 0.00 65535.00 ECU_ADDRESS 0xD000853A /end MEASUREMENT
/begin MEASUREMENT DFC_st.DFC_ComRpmWhlChk_FX "DFC/Status der Fehlerprüfung DFC_ComRpmWhlChk_FX" UWORD DFC_OneToOne 1 100 0.00 65535.00 ECU_ADDRESS 0xD000853C /end MEASUREMENT
/begin MEASUREMENT DFC_st.DFC_ComRpmWhlCtr_FX "DFC/Status der Fehlerprüfung DFC_ComRpmWhlCtr_FX" UWORD DFC_OneToOne 1 100 0.00 65535.00 ECU_ADDRESS 0xD000853E /end MEASUREMENT
/begin MEASUREMENT DFC_st.DFC_ComRpmWhlTo_FX "DFC/Status der Fehlerprüfung DFC_ComRpmWhlTo_FX" UWORD DFC_OneToOne 1 100 0.00 65535.00 ECU_ADDRESS 0xD0008540 /end MEASUREMENT
/begin MEASUREMENT DFC_st.DFC_ComSecCtrRelSig_FA "DFC/Status der Fehlerprüfung DFC_ComSecCtrRelSig_FA" UWORD DFC_OneToOne 1 100 0.00 65535.00 ECU_ADDRESS 0xD0008542 /end MEASUREMENT
/begin MEASUREMENT DFC_st.DFC_ComSecCtrRelTo_FA "DFC/Status der Fehlerprüfung DFC_ComSecCtrRelTo_FA" UWORD DFC_OneToOne 1 100 0.00 65535.00 ECU_ADDRESS 0xD0008544 /end MEASUREMENT
/begin MEASUREMENT DFC_st.DFC_ComSensNOxGndSig "DFC/Status der Fehlerprüfung DFC_ComSensNOxGndSig" UWORD DFC_OneToOne 1 100 0.00 65535.00 ECU_ADDRESS 0xD0008546 /end MEASUREMENT
/begin MEASUREMENT DFC_st.DFC_ComSensNOxGndTo "DFC/Status der Fehlerprüfung DFC_ComSensNOxGndTo" UWORD DFC_OneToOne 1 100 0.00 65535.00 ECU_ADDRESS 0xD0008548 /end MEASUREMENT
/begin MEASUREMENT DFC_st.DFC_ComSensNOxMode "DFC/Status der Fehlerprüfung DFC_ComSensNOxMode" UWORD DFC_OneToOne 1 100 0.00 65535.00 ECU_ADDRESS 0xD000854A /end MEASUREMENT
/begin MEASUREMENT DFC_st.DFC_ComSensNOxUbattSig "DFC/Status der Fehlerprüfung DFC_ComSensNOxUbattSig" UWORD DFC_OneToOne 1 100 0.00 65535.00 ECU_ADDRESS 0xD000854C /end MEASUREMENT
/begin MEASUREMENT DFC_st.DFC_ComSensNOxUbattTo "DFC/Status der Fehlerprüfung DFC_ComSensNOxUbattTo" UWORD DFC_OneToOne 1 100 0.00 65535.00 ECU_ADDRESS 0xD000854E /end MEASUREMENT
/begin MEASUREMENT DFC_st.DFC_ComShiftPaddleTo_FX "DFC/Status der Fehlerprüfung DFC_ComShiftPaddleTo_FX" UWORD DFC_OneToOne 1 100 0.00 65535.00 ECU_ADDRESS 0xD0008550 /end MEASUREMENT
/begin MEASUREMENT DFC_st.DFC_ComShutOffPSPSig "DFC/Status der Fehlerprüfung DFC_ComShutOffPSPSig" UWORD DFC_OneToOne 1 100 0.00 65535.00 ECU_ADDRESS 0xD0008552 /end MEASUREMENT
/begin MEASUREMENT DFC_st.DFC_ComShutOffPSPTo "DFC/Status der Fehlerprüfung DFC_ComShutOffPSPTo" UWORD DFC_OneToOne 1 100 0.00 65535.00 ECU_ADDRESS 0xD0008554 /end MEASUREMENT
/begin MEASUREMENT DFC_st.DFC_ComSlrdiGlbFZMTo_FA "DFC/Status der Fehlerprüfung DFC_ComSlrdiGlbFZMTo_FA" UWORD DFC_OneToOne 1 100 0.00 65535.00 ECU_ADDRESS 0xD0008556 /end MEASUREMENT
/begin MEASUREMENT DFC_st.DFC_ComSlrdiGlbFZMTo_FX "DFC/Status der Fehlerprüfung DFC_ComSlrdiGlbFZMTo_FX" UWORD DFC_OneToOne 1 100 0.00 65535.00 ECU_ADDRESS 0xD0008558 /end MEASUREMENT
/begin MEASUREMENT DFC_st.DFC_ComSpeedVehicleChk_FX "DFC/Status der Fehlerprüfung DFC_ComSpeedVehicleChk_FX" UWORD DFC_OneToOne 1 100 0.00 65535.00 ECU_ADDRESS 0xD000855A /end MEASUREMENT
/begin MEASUREMENT DFC_st.DFC_ComSpeedVehicleCtr_FX "DFC/Status der Fehlerprüfung DFC_ComSpeedVehicleCtr_FX" UWORD DFC_OneToOne 1 100 0.00 65535.00 ECU_ADDRESS 0xD000855C /end MEASUREMENT
/begin MEASUREMENT DFC_st.DFC_ComSpeedVehicleTo_FX "DFC/Status der Fehlerprüfung DFC_ComSpeedVehicleTo_FX" UWORD DFC_OneToOne 1 100 0.00 65535.00 ECU_ADDRESS 0xD000855E /end MEASUREMENT
/begin MEASUREMENT DFC_st.DFC_ComStConintDSCChk_FX "DFC/Status der Fehlerprüfung DFC_ComStConintDSCChk_FX" UWORD DFC_OneToOne 1 100 0.00 65535.00 ECU_ADDRESS 0xD0008560 /end MEASUREMENT
/begin MEASUREMENT DFC_st.DFC_ComStConintDSCCtr_FX "DFC/Status der Fehlerprüfung DFC_ComStConintDSCCtr_FX" UWORD DFC_OneToOne 1 100 0.00 65535.00 ECU_ADDRESS 0xD0008562 /end MEASUREMENT
/begin MEASUREMENT DFC_st.DFC_ComStConintDSCTo_FX "DFC/Status der Fehlerprüfung DFC_ComStConintDSCTo_FX" UWORD DFC_OneToOne 1 100 0.00 65535.00 ECU_ADDRESS 0xD0008564 /end MEASUREMENT
/begin MEASUREMENT DFC_st.DFC_ComStatACFrontSig_FA "DFC/Status der Fehlerprüfung DFC_ComStatACFrontSig_FA" UWORD DFC_OneToOne 1 100 0.00 65535.00 ECU_ADDRESS 0xD0008566 /end MEASUREMENT
/begin MEASUREMENT DFC_st.DFC_ComStatACFrontTo_FA "DFC/Status der Fehlerprüfung DFC_ComStatACFrontTo_FA" UWORD DFC_OneToOne 1 100 0.00 65535.00 ECU_ADDRESS 0xD0008568 /end MEASUREMENT
/begin MEASUREMENT DFC_st.DFC_ComStatEkpSig_A "DFC/Status der Fehlerprüfung DFC_ComStatEkpSig_A" UWORD DFC_OneToOne 1 100 0.00 65535.00 ECU_ADDRESS 0xD000856A /end MEASUREMENT
/begin MEASUREMENT DFC_st.DFC_ComStatEkpTo_A "DFC/Status der Fehlerprüfung DFC_ComStatEkpTo_A" UWORD DFC_OneToOne 1 100 0.00 65535.00 ECU_ADDRESS 0xD000856C /end MEASUREMENT
/begin MEASUREMENT DFC_st.DFC_ComStatGearRevSig_FA "DFC/Status der Fehlerprüfung DFC_ComStatGearRevSig_FA" UWORD DFC_OneToOne 1 100 0.00 65535.00 ECU_ADDRESS 0xD000856E /end MEASUREMENT
/begin MEASUREMENT DFC_st.DFC_ComStatGearRevTo_FA "DFC/Status der Fehlerprüfung DFC_ComStatGearRevTo_FA" UWORD DFC_OneToOne 1 100 0.00 65535.00 ECU_ADDRESS 0xD0008570 /end MEASUREMENT
/begin MEASUREMENT DFC_st.DFC_ComStatZVKlappenSig_FA "DFC/Status der Fehlerprüfung DFC_ComStatZVKlappenSig_FA" UWORD DFC_OneToOne 1 100 0.00 65535.00 ECU_ADDRESS 0xD0008572 /end MEASUREMENT
/begin MEASUREMENT DFC_st.DFC_ComStatZVKlappenTo_FA "DFC/Status der Fehlerprüfung DFC_ComStatZVKlappenTo_FA" UWORD DFC_OneToOne 1 100 0.00 65535.00 ECU_ADDRESS 0xD0008574 /end MEASUREMENT
/begin MEASUREMENT DFC_st.DFC_ComStateARSCtr "DFC/Status der Fehlerprüfung DFC_ComStateARSCtr" UWORD DFC_OneToOne 1 100 0.00 65535.00 ECU_ADDRESS 0xD0008576 /end MEASUREMENT
/begin MEASUREMENT DFC_st.DFC_ComStateARSSig "DFC/Status der Fehlerprüfung DFC_ComStateARSSig" UWORD DFC_OneToOne 1 100 0.00 65535.00 ECU_ADDRESS 0xD0008578 /end MEASUREMENT
/begin MEASUREMENT DFC_st.DFC_ComStateARSTo "DFC/Status der Fehlerprüfung DFC_ComStateARSTo" UWORD DFC_OneToOne 1 100 0.00 65535.00 ECU_ADDRESS 0xD000857A /end MEASUREMENT
/begin MEASUREMENT DFC_st.DFC_ComStateDscSig "DFC/Status der Fehlerprüfung DFC_ComStateDscSig" UWORD DFC_OneToOne 1 100 0.00 65535.00 ECU_ADDRESS 0xD000857C /end MEASUREMENT
/begin MEASUREMENT DFC_st.DFC_ComStateDscTo "DFC/Status der Fehlerprüfung DFC_ComStateDscTo" UWORD DFC_OneToOne 1 100 0.00 65535.00 ECU_ADDRESS 0xD000857E /end MEASUREMENT
/begin MEASUREMENT DFC_st.DFC_ComStateSeatSig "DFC/Status der Fehlerprüfung DFC_ComStateSeatSig" UWORD DFC_OneToOne 1 100 0.00 65535.00 ECU_ADDRESS 0xD0008580 /end MEASUREMENT
/begin MEASUREMENT DFC_st.DFC_ComStateSeatSig_FA "DFC/Status der Fehlerprüfung DFC_ComStateSeatSig_FA" UWORD DFC_OneToOne 1 100 0.00 65535.00 ECU_ADDRESS 0xD0008582 /end MEASUREMENT
/begin MEASUREMENT DFC_st.DFC_ComStateSeatTo "DFC/Status der Fehlerprüfung DFC_ComStateSeatTo" UWORD DFC_OneToOne 1 100 0.00 65535.00 ECU_ADDRESS 0xD0008584 /end MEASUREMENT
/begin MEASUREMENT DFC_st.DFC_ComStateSeatTo_FA "DFC/Status der Fehlerprüfung DFC_ComStateSeatTo_FA" UWORD DFC_OneToOne 1 100 0.00 65535.00 ECU_ADDRESS 0xD0008586 /end MEASUREMENT
/begin MEASUREMENT DFC_st.DFC_ComStatusEGSSig_A "DFC/Status der Fehlerprüfung DFC_ComStatusEGSSig_A" UWORD DFC_OneToOne 1 100 0.00 65535.00 ECU_ADDRESS 0xD0008588 /end MEASUREMENT
/begin MEASUREMENT DFC_st.DFC_ComStatusEGSSig_FA "DFC/Status der Fehlerprüfung DFC_ComStatusEGSSig_FA" UWORD DFC_OneToOne 1 100 0.00 65535.00 ECU_ADDRESS 0xD000858A /end MEASUREMENT
/begin MEASUREMENT DFC_st.DFC_ComStatusEGSTo_A "DFC/Status der Fehlerprüfung DFC_ComStatusEGSTo_A" UWORD DFC_OneToOne 1 100 0.00 65535.00 ECU_ADDRESS 0xD000858C /end MEASUREMENT
/begin MEASUREMENT DFC_st.DFC_ComStatusEGSTo_FA "DFC/Status der Fehlerprüfung DFC_ComStatusEGSTo_FA" UWORD DFC_OneToOne 1 100 0.00 65535.00 ECU_ADDRESS 0xD000858E /end MEASUREMENT
/begin MEASUREMENT DFC_st.DFC_ComStatusEMFChk "DFC/Status der Fehlerprüfung DFC_ComStatusEMFChk" UWORD DFC_OneToOne 1 100 0.00 65535.00 ECU_ADDRESS 0xD0008590 /end MEASUREMENT
/begin MEASUREMENT DFC_st.DFC_ComStatusEMFCtr "DFC/Status der Fehlerprüfung DFC_ComStatusEMFCtr" UWORD DFC_OneToOne 1 100 0.00 65535.00 ECU_ADDRESS 0xD0008592 /end MEASUREMENT
/begin MEASUREMENT DFC_st.DFC_ComStatusEMFSig "DFC/Status der Fehlerprüfung DFC_ComStatusEMFSig" UWORD DFC_OneToOne 1 100 0.00 65535.00 ECU_ADDRESS 0xD0008594 /end MEASUREMENT
/begin MEASUREMENT DFC_st.DFC_ComStatusEMFTo "DFC/Status der Fehlerprüfung DFC_ComStatusEMFTo" UWORD DFC_OneToOne 1 100 0.00 65535.00 ECU_ADDRESS 0xD0008596 /end MEASUREMENT
/begin MEASUREMENT DFC_st.DFC_ComStatusRGangSig "DFC/Status der Fehlerprüfung DFC_ComStatusRGangSig" UWORD DFC_OneToOne 1 100 0.00 65535.00 ECU_ADDRESS 0xD0008598 /end MEASUREMENT
/begin MEASUREMENT DFC_st.DFC_ComStatusRGangTo "DFC/Status der Fehlerprüfung DFC_ComStatusRGangTo" UWORD DFC_OneToOne 1 100 0.00 65535.00 ECU_ADDRESS 0xD000859A /end MEASUREMENT
/begin MEASUREMENT DFC_st.DFC_ComSteeringAngleChk_FX "DFC/Status der Fehlerprüfung DFC_ComSteeringAngleChk_FX" UWORD DFC_OneToOne 1 100 0.00 65535.00 ECU_ADDRESS 0xD000859C /end MEASUREMENT
/begin MEASUREMENT DFC_st.DFC_ComSteeringAngleCtr_FX "DFC/Status der Fehlerprüfung DFC_ComSteeringAngleCtr_FX" UWORD DFC_OneToOne 1 100 0.00 65535.00 ECU_ADDRESS 0xD000859E /end MEASUREMENT
/begin MEASUREMENT DFC_st.DFC_ComSteeringAngleTo_FX "DFC/Status der Fehlerprüfung DFC_ComSteeringAngleTo_FX" UWORD DFC_OneToOne 1 100 0.00 65535.00 ECU_ADDRESS 0xD00085A0 /end MEASUREMENT
/begin MEASUREMENT DFC_st.DFC_ComTerminalChk "DFC/Status der Fehlerprüfung DFC_ComTerminalChk" UWORD DFC_OneToOne 1 100 0.00 65535.00 ECU_ADDRESS 0xD00085A2 /end MEASUREMENT
/begin MEASUREMENT DFC_st.DFC_ComTerminalCtr "DFC/Status der Fehlerprüfung DFC_ComTerminalCtr" UWORD DFC_OneToOne 1 100 0.00 65535.00 ECU_ADDRESS 0xD00085A4 /end MEASUREMENT
/begin MEASUREMENT DFC_st.DFC_ComTerminalSig "DFC/Status der Fehlerprüfung DFC_ComTerminalSig" UWORD DFC_OneToOne 1 100 0.00 65535.00 ECU_ADDRESS 0xD00085A6 /end MEASUREMENT
/begin MEASUREMENT DFC_st.DFC_ComTerminalTo "DFC/Status der Fehlerprüfung DFC_ComTerminalTo" UWORD DFC_OneToOne 1 100 0.00 65535.00 ECU_ADDRESS 0xD00085A8 /end MEASUREMENT
/begin MEASUREMENT DFC_st.DFC_ComTimeDateSig_FA "DFC/Status der Fehlerprüfung DFC_ComTimeDateSig_FA" UWORD DFC_OneToOne 1 100 0.00 65535.00 ECU_ADDRESS 0xD00085AA /end MEASUREMENT
/begin MEASUREMENT DFC_st.DFC_ComTimeDateTo_FA "DFC/Status der Fehlerprüfung DFC_ComTimeDateTo_FA" UWORD DFC_OneToOne 1 100 0.00 65535.00 ECU_ADDRESS 0xD00085AC /end MEASUREMENT
/begin MEASUREMENT DFC_st.DFC_ComTrailerSig "DFC/Status der Fehlerprüfung DFC_ComTrailerSig" UWORD DFC_OneToOne 1 100 0.00 65535.00 ECU_ADDRESS 0xD00085AE /end MEASUREMENT
/begin MEASUREMENT DFC_st.DFC_ComTrailerSig_FA "DFC/Status der Fehlerprüfung DFC_ComTrailerSig_FA" UWORD DFC_OneToOne 1 100 0.00 65535.00 ECU_ADDRESS 0xD00085B0 /end MEASUREMENT
/begin MEASUREMENT DFC_st.DFC_ComTrailerTo "DFC/Status der Fehlerprüfung DFC_ComTrailerTo" UWORD DFC_OneToOne 1 100 0.00 65535.00 ECU_ADDRESS 0xD00085B2 /end MEASUREMENT
/begin MEASUREMENT DFC_st.DFC_ComTrailerTo_FA "DFC/Status der Fehlerprüfung DFC_ComTrailerTo_FA" UWORD DFC_OneToOne 1 100 0.00 65535.00 ECU_ADDRESS 0xD00085B4 /end MEASUREMENT
/begin MEASUREMENT DFC_st.DFC_ComTrqDemCrshDrDyChk_FX "DFC/Status der Fehlerprüfung DFC_ComTrqDemCrshDrDyChk_FX" UWORD DFC_OneToOne 1 100 0.00 65535.00 ECU_ADDRESS 0xD00085B6 /end MEASUREMENT
/begin MEASUREMENT DFC_st.DFC_ComTrqDemCrshDrDyCtr_FX "DFC/Status der Fehlerprüfung DFC_ComTrqDemCrshDrDyCtr_FX" UWORD DFC_OneToOne 1 100 0.00 65535.00 ECU_ADDRESS 0xD00085B8 /end MEASUREMENT
/begin MEASUREMENT DFC_st.DFC_ComTrqDemCrshDrDyTo_FX "DFC/Status der Fehlerprüfung DFC_ComTrqDemCrshDrDyTo_FX" UWORD DFC_OneToOne 1 100 0.00 65535.00 ECU_ADDRESS 0xD00085BA /end MEASUREMENT
/begin MEASUREMENT DFC_st.DFC_ComTrqDemandDesSig "DFC/Status der Fehlerprüfung DFC_ComTrqDemandDesSig" UWORD DFC_OneToOne 1 100 0.00 65535.00 ECU_ADDRESS 0xD00085BC /end MEASUREMENT
/begin MEASUREMENT DFC_st.DFC_ComTrqDemandDesTo "DFC/Status der Fehlerprüfung DFC_ComTrqDemandDesTo" UWORD DFC_OneToOne 1 100 0.00 65535.00 ECU_ADDRESS 0xD00085BE /end MEASUREMENT
/begin MEASUREMENT DFC_st.DFC_ComTrqDemandDscChk "DFC/Status der Fehlerprüfung DFC_ComTrqDemandDscChk" UWORD DFC_OneToOne 1 100 0.00 65535.00 ECU_ADDRESS 0xD00085C0 /end MEASUREMENT
/begin MEASUREMENT DFC_st.DFC_ComTrqDemandDscCtr "DFC/Status der Fehlerprüfung DFC_ComTrqDemandDscCtr" UWORD DFC_OneToOne 1 100 0.00 65535.00 ECU_ADDRESS 0xD00085C2 /end MEASUREMENT
/begin MEASUREMENT DFC_st.DFC_ComTrqDemandDscSig "DFC/Status der Fehlerprüfung DFC_ComTrqDemandDscSig" UWORD DFC_OneToOne 1 100 0.00 65535.00 ECU_ADDRESS 0xD00085C4 /end MEASUREMENT
/begin MEASUREMENT DFC_st.DFC_ComTrqDemandDscTo "DFC/Status der Fehlerprüfung DFC_ComTrqDemandDscTo" UWORD DFC_OneToOne 1 100 0.00 65535.00 ECU_ADDRESS 0xD00085C6 /end MEASUREMENT
/begin MEASUREMENT DFC_st.DFC_ComTrqDemandGbxChk_A "DFC/Status der Fehlerprüfung DFC_ComTrqDemandGbxChk_A" UWORD DFC_OneToOne 1 100 0.00 65535.00 ECU_ADDRESS 0xD00085C8 /end MEASUREMENT
/begin MEASUREMENT DFC_st.DFC_ComTrqDemandGbxChk_FA "DFC/Status der Fehlerprüfung DFC_ComTrqDemandGbxChk_FA" UWORD DFC_OneToOne 1 100 0.00 65535.00 ECU_ADDRESS 0xD00085CA /end MEASUREMENT
/begin MEASUREMENT DFC_st.DFC_ComTrqDemandGbxCtr_A "DFC/Status der Fehlerprüfung DFC_ComTrqDemandGbxCtr_A" UWORD DFC_OneToOne 1 100 0.00 65535.00 ECU_ADDRESS 0xD00085CC /end MEASUREMENT
/begin MEASUREMENT DFC_st.DFC_ComTrqDemandGbxCtr_FA "DFC/Status der Fehlerprüfung DFC_ComTrqDemandGbxCtr_FA" UWORD DFC_OneToOne 1 100 0.00 65535.00 ECU_ADDRESS 0xD00085CE /end MEASUREMENT
/begin MEASUREMENT DFC_st.DFC_ComTrqDemandGbxSig_A "DFC/Status der Fehlerprüfung DFC_ComTrqDemandGbxSig_A" UWORD DFC_OneToOne 1 100 0.00 65535.00 ECU_ADDRESS 0xD00085D0 /end MEASUREMENT
/begin MEASUREMENT DFC_st.DFC_ComTrqDemandGbxSig_FA "DFC/Status der Fehlerprüfung DFC_ComTrqDemandGbxSig_FA" UWORD DFC_OneToOne 1 100 0.00 65535.00 ECU_ADDRESS 0xD00085D2 /end MEASUREMENT
/begin MEASUREMENT DFC_st.DFC_ComTrqDemandGbxTo_A "DFC/Status der Fehlerprüfung DFC_ComTrqDemandGbxTo_A" UWORD DFC_OneToOne 1 100 0.00 65535.00 ECU_ADDRESS 0xD00085D4 /end MEASUREMENT
/begin MEASUREMENT DFC_st.DFC_ComTrqDemandGbxTo_FA "DFC/Status der Fehlerprüfung DFC_ComTrqDemandGbxTo_FA" UWORD DFC_OneToOne 1 100 0.00 65535.00 ECU_ADDRESS 0xD00085D6 /end MEASUREMENT
/begin MEASUREMENT DFC_st.DFC_ComTrqWhlDemChk "DFC/Status der Fehlerprüfung DFC_ComTrqWhlDemChk" UWORD DFC_OneToOne 1 100 0.00 65535.00 ECU_ADDRESS 0xD00085D8 /end MEASUREMENT
/begin MEASUREMENT DFC_st.DFC_ComTrqWhlDemCtr "DFC/Status der Fehlerprüfung DFC_ComTrqWhlDemCtr" UWORD DFC_OneToOne 1 100 0.00 65535.00 ECU_ADDRESS 0xD00085DA /end MEASUREMENT
/begin MEASUREMENT DFC_st.DFC_ComTrqWhlDemFASChk_FX "DFC/Status der Fehlerprüfung DFC_ComTrqWhlDemFASChk_FX" UWORD DFC_OneToOne 1 100 0.00 65535.00 ECU_ADDRESS 0xD00085DC /end MEASUREMENT
/begin MEASUREMENT DFC_st.DFC_ComTrqWhlDemFASCtr_FX "DFC/Status der Fehlerprüfung DFC_ComTrqWhlDemFASCtr_FX" UWORD DFC_OneToOne 1 100 0.00 65535.00 ECU_ADDRESS 0xD00085DE /end MEASUREMENT
/begin MEASUREMENT DFC_st.DFC_ComTrqWhlDemFASTo_FX "DFC/Status der Fehlerprüfung DFC_ComTrqWhlDemFASTo_FX" UWORD DFC_OneToOne 1 100 0.00 65535.00 ECU_ADDRESS 0xD00085E0 /end MEASUREMENT
/begin MEASUREMENT DFC_st.DFC_ComTrqWhlDemSig "DFC/Status der Fehlerprüfung DFC_ComTrqWhlDemSig" UWORD DFC_OneToOne 1 100 0.00 65535.00 ECU_ADDRESS 0xD00085E2 /end MEASUREMENT
/begin MEASUREMENT DFC_st.DFC_ComTrqWhlDemTo "DFC/Status der Fehlerprüfung DFC_ComTrqWhlDemTo" UWORD DFC_OneToOne 1 100 0.00 65535.00 ECU_ADDRESS 0xD00085E4 /end MEASUREMENT
/begin MEASUREMENT DFC_st.DFC_ComVelocityChk_FA "DFC/Status der Fehlerprüfung DFC_ComVelocityChk_FA" UWORD DFC_OneToOne 1 100 0.00 65535.00 ECU_ADDRESS 0xD00085E6 /end MEASUREMENT
/begin MEASUREMENT DFC_st.DFC_ComVelocityCtr_FA "DFC/Status der Fehlerprüfung DFC_ComVelocityCtr_FA" UWORD DFC_OneToOne 1 100 0.00 65535.00 ECU_ADDRESS 0xD00085E8 /end MEASUREMENT
/begin MEASUREMENT DFC_st.DFC_ComVelocitySig "DFC/Status der Fehlerprüfung DFC_ComVelocitySig" UWORD DFC_OneToOne 1 100 0.00 65535.00 ECU_ADDRESS 0xD00085EA /end MEASUREMENT
/begin MEASUREMENT DFC_st.DFC_ComVelocitySig_FA "DFC/Status der Fehlerprüfung DFC_ComVelocitySig_FA" UWORD DFC_OneToOne 1 100 0.00 65535.00 ECU_ADDRESS 0xD00085EC /end MEASUREMENT
/begin MEASUREMENT DFC_st.DFC_ComVelocityTo "DFC/Status der Fehlerprüfung DFC_ComVelocityTo" UWORD DFC_OneToOne 1 100 0.00 65535.00 ECU_ADDRESS 0xD00085EE /end MEASUREMENT
/begin MEASUREMENT DFC_st.DFC_ComVelocityTo_FA "DFC/Status der Fehlerprüfung DFC_ComVelocityTo_FA" UWORD DFC_OneToOne 1 100 0.00 65535.00 ECU_ADDRESS 0xD00085F0 /end MEASUREMENT
/begin MEASUREMENT DFC_st.DFC_ComVerbraucherTo "DFC/Status der Fehlerprüfung DFC_ComVerbraucherTo" UWORD DFC_OneToOne 1 100 0.00 65535.00 ECU_ADDRESS 0xD00085F2 /end MEASUREMENT
/begin MEASUREMENT DFC_st.DFC_ComWMomPTStabChk_FX "DFC/Status der Fehlerprüfung DFC_ComWMomPTStabChk_FX" UWORD DFC_OneToOne 1 100 0.00 65535.00 ECU_ADDRESS 0xD00085F4 /end MEASUREMENT
/begin MEASUREMENT DFC_st.DFC_ComWMomPTStabCtr_FX "DFC/Status der Fehlerprüfung DFC_ComWMomPTStabCtr_FX" UWORD DFC_OneToOne 1 100 0.00 65535.00 ECU_ADDRESS 0xD00085F6 /end MEASUREMENT
/begin MEASUREMENT DFC_st.DFC_ComWMomPTStabTo_FX "DFC/Status der Fehlerprüfung DFC_ComWMomPTStabTo_FX" UWORD DFC_OneToOne 1 100 0.00 65535.00 ECU_ADDRESS 0xD00085F8 /end MEASUREMENT
/begin MEASUREMENT DFC_st.DFC_ComWheelSpeedSig "DFC/Status der Fehlerprüfung DFC_ComWheelSpeedSig" UWORD DFC_OneToOne 1 100 0.00 65535.00 ECU_ADDRESS 0xD00085FA /end MEASUREMENT
/begin MEASUREMENT DFC_st.DFC_ComWheelSpeedTo "DFC/Status der Fehlerprüfung DFC_ComWheelSpeedTo" UWORD DFC_OneToOne 1 100 0.00 65535.00 ECU_ADDRESS 0xD00085FC /end MEASUREMENT
/begin MEASUREMENT DFC_st.DFC_ComZvKlappenSig "DFC/Status der Fehlerprüfung DFC_ComZvKlappenSig" UWORD DFC_OneToOne 1 100 0.00 65535.00 ECU_ADDRESS 0xD00085FE /end MEASUREMENT
/begin MEASUREMENT DFC_st.DFC_ComZvKlappenTo "DFC/Status der Fehlerprüfung DFC_ComZvKlappenTo" UWORD DFC_OneToOne 1 100 0.00 65535.00 ECU_ADDRESS 0xD0008600 /end MEASUREMENT
/begin MEASUREMENT DFC_st.DFC_ComaDirectChk_FX "DFC/Status der Fehlerprüfung DFC_ComaDirectChk_FX" UWORD DFC_OneToOne 1 100 0.00 65535.00 ECU_ADDRESS 0xD0008602 /end MEASUREMENT
/begin MEASUREMENT DFC_st.DFC_ComaDirectCtr_FX "DFC/Status der Fehlerprüfung DFC_ComaDirectCtr_FX" UWORD DFC_OneToOne 1 100 0.00 65535.00 ECU_ADDRESS 0xD0008604 /end MEASUREMENT
/begin MEASUREMENT DFC_st.DFC_ComaDirectTo_FX "DFC/Status der Fehlerprüfung DFC_ComaDirectTo_FX" UWORD DFC_OneToOne 1 100 0.00 65535.00 ECU_ADDRESS 0xD0008606 /end MEASUREMENT
/begin MEASUREMENT DFC_st.DFC_ComaSideChk_FX "DFC/Status der Fehlerprüfung DFC_ComaSideChk_FX" UWORD DFC_OneToOne 1 100 0.00 65535.00 ECU_ADDRESS 0xD0008608 /end MEASUREMENT
/begin MEASUREMENT DFC_st.DFC_ComaSideCtr_FX "DFC/Status der Fehlerprüfung DFC_ComaSideCtr_FX" UWORD DFC_OneToOne 1 100 0.00 65535.00 ECU_ADDRESS 0xD000860A /end MEASUREMENT
/begin MEASUREMENT DFC_st.DFC_ComaSideTo_FX "DFC/Status der Fehlerprüfung DFC_ComaSideTo_FX" UWORD DFC_OneToOne 1 100 0.00 65535.00 ECU_ADDRESS 0xD000860C /end MEASUREMENT
/begin MEASUREMENT DFC_st.DFC_Cy320SpiCom "DFC/Status der Fehlerprüfung DFC_Cy320SpiCom" UWORD DFC_OneToOne 1 100 0.00 65535.00 ECU_ADDRESS 0xD000860E /end MEASUREMENT
/begin MEASUREMENT DFC_st.DFC_ETCtlDvtInrMax "DFC/Status der Fehlerprüfung DFC_ETCtlDvtInrMax" UWORD DFC_OneToOne 1 100 0.00 65535.00 ECU_ADDRESS 0xD0008610 /end MEASUREMENT
/begin MEASUREMENT DFC_st.DFC_ETCtlDvtInrMin "DFC/Status der Fehlerprüfung DFC_ETCtlDvtInrMin" UWORD DFC_OneToOne 1 100 0.00 65535.00 ECU_ADDRESS 0xD0008612 /end MEASUREMENT
/begin MEASUREMENT DFC_st.DFC_ETCtlDvtOutrMax "DFC/Status der Fehlerprüfung DFC_ETCtlDvtOutrMax" UWORD DFC_OneToOne 1 100 0.00 65535.00 ECU_ADDRESS 0xD0008614 /end MEASUREMENT
/begin MEASUREMENT DFC_st.DFC_ETCtlDvtOutrMin "DFC/Status der Fehlerprüfung DFC_ETCtlDvtOutrMin" UWORD DFC_OneToOne 1 100 0.00 65535.00 ECU_ADDRESS 0xD0008616 /end MEASUREMENT
/begin MEASUREMENT DFC_st.DFC_FBCqDvtMax "DFC/Status der Fehlerprüfung DFC_FBCqDvtMax" UWORD DFC_OneToOne 1 100 0.00 65535.00 ECU_ADDRESS 0xD0008618 /end MEASUREMENT
/begin MEASUREMENT DFC_st.DFC_FBCqDvtMin "DFC/Status der Fehlerprüfung DFC_FBCqDvtMin" UWORD DFC_OneToOne 1 100 0.00 65535.00 ECU_ADDRESS 0xD000861A /end MEASUREMENT
/begin MEASUREMENT DFC_st.DFC_Fan4WinErr1 "DFC/Status der Fehlerprüfung DFC_Fan4WinErr1" UWORD DFC_OneToOne 1 100 0.00 65535.00 ECU_ADDRESS 0xD000861C /end MEASUREMENT
/begin MEASUREMENT DFC_st.DFC_Fan4WinErr2 "DFC/Status der Fehlerprüfung DFC_Fan4WinErr2" UWORD DFC_OneToOne 1 100 0.00 65535.00 ECU_ADDRESS 0xD000861E /end MEASUREMENT
/begin MEASUREMENT DFC_st.DFC_Fan4WinErr3 "DFC/Status der Fehlerprüfung DFC_Fan4WinErr3" UWORD DFC_OneToOne 1 100 0.00 65535.00 ECU_ADDRESS 0xD0008620 /end MEASUREMENT
/begin MEASUREMENT DFC_st.DFC_Fan4WinErr4 "DFC/Status der Fehlerprüfung DFC_Fan4WinErr4" UWORD DFC_OneToOne 1 100 0.00 65535.00 ECU_ADDRESS 0xD0008622 /end MEASUREMENT
/begin MEASUREMENT DFC_st.DFC_FanSCG "DFC/Status der Fehlerprüfung DFC_FanSCG" UWORD DFC_OneToOne 1 100 0.00 65535.00 ECU_ADDRESS 0xD0008624 /end MEASUREMENT
/begin MEASUREMENT DFC_st.DFC_FlFCBS "DFC/Status der Fehlerprüfung DFC_FlFCBS" UWORD DFC_OneToOne 1 100 0.00 65535.00 ECU_ADDRESS 0xD0008626 /end MEASUREMENT
/begin MEASUREMENT DFC_st.DFC_GlwEcuConfigErr "DFC/Status der Fehlerprüfung DFC_GlwEcuConfigErr" UWORD DFC_OneToOne 1 100 0.00 65535.00 ECU_ADDRESS 0xD0008628 /end MEASUREMENT
/begin MEASUREMENT DFC_st.DFC_GlwEcuEepErr "DFC/Status der Fehlerprüfung DFC_GlwEcuEepErr" UWORD DFC_OneToOne 1 100 0.00 65535.00 ECU_ADDRESS 0xD000862A /end MEASUREMENT
/begin MEASUREMENT DFC_st.DFC_GlwEcuFrmErr "DFC/Status der Fehlerprüfung DFC_GlwEcuFrmErr" UWORD DFC_OneToOne 1 100 0.00 65535.00 ECU_ADDRESS 0xD000862C /end MEASUREMENT
/begin MEASUREMENT DFC_st.DFC_GlwEcuGPCMFaultInfo "DFC/Status der Fehlerprüfung DFC_GlwEcuGPCMFaultInfo" UWORD DFC_OneToOne 1 100 0.00 65535.00 ECU_ADDRESS 0xD000862E /end MEASUREMENT
/begin MEASUREMENT DFC_st.DFC_GlwEcuGPCMInfo "DFC/Status der Fehlerprüfung DFC_GlwEcuGPCMInfo" UWORD DFC_OneToOne 1 100 0.00 65535.00 ECU_ADDRESS 0xD0008630 /end MEASUREMENT
/begin MEASUREMENT DFC_st.DFC_GlwEcuGk1HSS "DFC/Status der Fehlerprüfung DFC_GlwEcuGk1HSS" UWORD DFC_OneToOne 1 100 0.00 65535.00 ECU_ADDRESS 0xD0008632 /end MEASUREMENT
/begin MEASUREMENT DFC_st.DFC_GlwEcuGk1OL "DFC/Status der Fehlerprüfung DFC_GlwEcuGk1OL" UWORD DFC_OneToOne 1 100 0.00 65535.00 ECU_ADDRESS 0xD0008634 /end MEASUREMENT
/begin MEASUREMENT DFC_st.DFC_GlwEcuGk1SC "DFC/Status der Fehlerprüfung DFC_GlwEcuGk1SC" UWORD DFC_OneToOne 1 100 0.00 65535.00 ECU_ADDRESS 0xD0008636 /end MEASUREMENT
/begin MEASUREMENT DFC_st.DFC_GlwEcuGk1Wdst "DFC/Status der Fehlerprüfung DFC_GlwEcuGk1Wdst" UWORD DFC_OneToOne 1 100 0.00 65535.00 ECU_ADDRESS 0xD0008638 /end MEASUREMENT
/begin MEASUREMENT DFC_st.DFC_GlwEcuGk2HSS "DFC/Status der Fehlerprüfung DFC_GlwEcuGk2HSS" UWORD DFC_OneToOne 1 100 0.00 65535.00 ECU_ADDRESS 0xD000863A /end MEASUREMENT
/begin MEASUREMENT DFC_st.DFC_GlwEcuGk2OL "DFC/Status der Fehlerprüfung DFC_GlwEcuGk2OL" UWORD DFC_OneToOne 1 100 0.00 65535.00 ECU_ADDRESS 0xD000863C /end MEASUREMENT
/begin MEASUREMENT DFC_st.DFC_GlwEcuGk2SC "DFC/Status der Fehlerprüfung DFC_GlwEcuGk2SC" UWORD DFC_OneToOne 1 100 0.00 65535.00 ECU_ADDRESS 0xD000863E /end MEASUREMENT
/begin MEASUREMENT DFC_st.DFC_GlwEcuGk2Wdst "DFC/Status der Fehlerprüfung DFC_GlwEcuGk2Wdst" UWORD DFC_OneToOne 1 100 0.00 65535.00 ECU_ADDRESS 0xD0008640 /end MEASUREMENT
/begin MEASUREMENT DFC_st.DFC_GlwEcuGk3HSS "DFC/Status der Fehlerprüfung DFC_GlwEcuGk3HSS" UWORD DFC_OneToOne 1 100 0.00 65535.00 ECU_ADDRESS 0xD0008642 /end MEASUREMENT
/begin MEASUREMENT DFC_st.DFC_GlwEcuGk3OL "DFC/Status der Fehlerprüfung DFC_GlwEcuGk3OL" UWORD DFC_OneToOne 1 100 0.00 65535.00 ECU_ADDRESS 0xD0008644 /end MEASUREMENT
/begin MEASUREMENT DFC_st.DFC_GlwEcuGk3SC "DFC/Status der Fehlerprüfung DFC_GlwEcuGk3SC" UWORD DFC_OneToOne 1 100 0.00 65535.00 ECU_ADDRESS 0xD0008646 /end MEASUREMENT
/begin MEASUREMENT DFC_st.DFC_GlwEcuGk3Wdst "DFC/Status der Fehlerprüfung DFC_GlwEcuGk3Wdst" UWORD DFC_OneToOne 1 100 0.00 65535.00 ECU_ADDRESS 0xD0008648 /end MEASUREMENT
/begin MEASUREMENT DFC_st.DFC_GlwEcuGk4HSS "DFC/Status der Fehlerprüfung DFC_GlwEcuGk4HSS" UWORD DFC_OneToOne 1 100 0.00 65535.00 ECU_ADDRESS 0xD000864A /end MEASUREMENT
/begin MEASUREMENT DFC_st.DFC_GlwEcuGk4OL "DFC/Status der Fehlerprüfung DFC_GlwEcuGk4OL" UWORD DFC_OneToOne 1 100 0.00 65535.00 ECU_ADDRESS 0xD000864C /end MEASUREMENT
/begin MEASUREMENT DFC_st.DFC_GlwEcuGk4SC "DFC/Status der Fehlerprüfung DFC_GlwEcuGk4SC" UWORD DFC_OneToOne 1 100 0.00 65535.00 ECU_ADDRESS 0xD000864E /end MEASUREMENT
/begin MEASUREMENT DFC_st.DFC_GlwEcuGk4Wdst "DFC/Status der Fehlerprüfung DFC_GlwEcuGk4Wdst" UWORD DFC_OneToOne 1 100 0.00 65535.00 ECU_ADDRESS 0xD0008650 /end MEASUREMENT
/begin MEASUREMENT DFC_st.DFC_GlwEcuGk5HSS "DFC/Status der Fehlerprüfung DFC_GlwEcuGk5HSS" UWORD DFC_OneToOne 1 100 0.00 65535.00 ECU_ADDRESS 0xD0008652 /end MEASUREMENT
/begin MEASUREMENT DFC_st.DFC_GlwEcuGk5OL "DFC/Status der Fehlerprüfung DFC_GlwEcuGk5OL" UWORD DFC_OneToOne 1 100 0.00 65535.00 ECU_ADDRESS 0xD0008654 /end MEASUREMENT
/begin MEASUREMENT DFC_st.DFC_GlwEcuGk5SC "DFC/Status der Fehlerprüfung DFC_GlwEcuGk5SC" UWORD DFC_OneToOne 1 100 0.00 65535.00 ECU_ADDRESS 0xD0008656 /end MEASUREMENT
/begin MEASUREMENT DFC_st.DFC_GlwEcuGk5Wdst "DFC/Status der Fehlerprüfung DFC_GlwEcuGk5Wdst" UWORD DFC_OneToOne 1 100 0.00 65535.00 ECU_ADDRESS 0xD0008658 /end MEASUREMENT
/begin MEASUREMENT DFC_st.DFC_GlwEcuGk6HSS "DFC/Status der Fehlerprüfung DFC_GlwEcuGk6HSS" UWORD DFC_OneToOne 1 100 0.00 65535.00 ECU_ADDRESS 0xD000865A /end MEASUREMENT
/begin MEASUREMENT DFC_st.DFC_GlwEcuGk6OL "DFC/Status der Fehlerprüfung DFC_GlwEcuGk6OL" UWORD DFC_OneToOne 1 100 0.00 65535.00 ECU_ADDRESS 0xD000865C /end MEASUREMENT
/begin MEASUREMENT DFC_st.DFC_GlwEcuGk6SC "DFC/Status der Fehlerprüfung DFC_GlwEcuGk6SC" UWORD DFC_OneToOne 1 100 0.00 65535.00 ECU_ADDRESS 0xD000865E /end MEASUREMENT
/begin MEASUREMENT DFC_st.DFC_GlwEcuGk6Wdst "DFC/Status der Fehlerprüfung DFC_GlwEcuGk6Wdst" UWORD DFC_OneToOne 1 100 0.00 65535.00 ECU_ADDRESS 0xD0008660 /end MEASUREMENT
/begin MEASUREMENT DFC_st.DFC_GlwEcuGndErr "DFC/Status der Fehlerprüfung DFC_GlwEcuGndErr" UWORD DFC_OneToOne 1 100 0.00 65535.00 ECU_ADDRESS 0xD0008662 /end MEASUREMENT
/begin MEASUREMENT DFC_st.DFC_GlwEcuIntErr "DFC/Status der Fehlerprüfung DFC_GlwEcuIntErr" UWORD DFC_OneToOne 1 100 0.00 65535.00 ECU_ADDRESS 0xD0008664 /end MEASUREMENT
/begin MEASUREMENT DFC_st.DFC_GlwEcuMsgTimeout "DFC/Status der Fehlerprüfung DFC_GlwEcuMsgTimeout" UWORD DFC_OneToOne 1 100 0.00 65535.00 ECU_ADDRESS 0xD0008666 /end MEASUREMENT
/begin MEASUREMENT DFC_st.DFC_GlwEcuT30Err "DFC/Status der Fehlerprüfung DFC_GlwEcuT30Err" UWORD DFC_OneToOne 1 100 0.00 65535.00 ECU_ADDRESS 0xD0008668 /end MEASUREMENT
/begin MEASUREMENT DFC_st.DFC_GlwEcuTempErr "DFC/Status der Fehlerprüfung DFC_GlwEcuTempErr" UWORD DFC_OneToOne 1 100 0.00 65535.00 ECU_ADDRESS 0xD000866A /end MEASUREMENT
/begin MEASUREMENT DFC_st.DFC_GlwEcuUdiffT30 "DFC/Status der Fehlerprüfung DFC_GlwEcuUdiffT30" UWORD DFC_OneToOne 1 100 0.00 65535.00 ECU_ADDRESS 0xD000866C /end MEASUREMENT
/begin MEASUREMENT DFC_st.DFC_IBSComErr "DFC/Status der Fehlerprüfung DFC_IBSComErr" UWORD DFC_OneToOne 1 100 0.00 65535.00 ECU_ADDRESS 0xD000866E /end MEASUREMENT
/begin MEASUREMENT DFC_st.DFC_LubSRCOilFldtCrit "DFC/Status der Fehlerprüfung DFC_LubSRCOilFldtCrit" UWORD DFC_OneToOne 1 100 0.00 65535.00 ECU_ADDRESS 0xD0008670 /end MEASUREMENT
/begin MEASUREMENT DFC_st.DFC_LubSRCOilFldtCritDflMin "DFC/Status der Fehlerprüfung DFC_LubSRCOilFldtCritDflMin" UWORD DFC_OneToOne 1 100 0.00 65535.00 ECU_ADDRESS 0xD0008672 /end MEASUREMENT
/begin MEASUREMENT DFC_st.DFC_LubSRCOilLvlCritMax "DFC/Status der Fehlerprüfung DFC_LubSRCOilLvlCritMax" UWORD DFC_OneToOne 1 100 0.00 65535.00 ECU_ADDRESS 0xD0008674 /end MEASUREMENT
/begin MEASUREMENT DFC_st.DFC_LubSRCOilLvlCritMin "DFC/Status der Fehlerprüfung DFC_LubSRCOilLvlCritMin" UWORD DFC_OneToOne 1 100 0.00 65535.00 ECU_ADDRESS 0xD0008676 /end MEASUREMENT
/begin MEASUREMENT DFC_st.DFC_LubSRCTot "DFC/Status der Fehlerprüfung DFC_LubSRCTot" UWORD DFC_OneToOne 1 100 0.00 65535.00 ECU_ADDRESS 0xD0008678 /end MEASUREMENT
/begin MEASUREMENT DFC_st.DFC_MonUMaxSupply1 "DFC/Status der Fehlerprüfung DFC_MonUMaxSupply1" UWORD DFC_OneToOne 1 100 0.00 65535.00 ECU_ADDRESS 0xD000867A /end MEASUREMENT
/begin MEASUREMENT DFC_st.DFC_MonUMinSupply1 "DFC/Status der Fehlerprüfung DFC_MonUMinSupply1" UWORD DFC_OneToOne 1 100 0.00 65535.00 ECU_ADDRESS 0xD000867C /end MEASUREMENT
/begin MEASUREMENT DFC_st.DFC_OilComNpl "DFC/Status der Fehlerprüfung DFC_OilComNpl" UWORD DFC_OneToOne 1 100 0.00 65535.00 ECU_ADDRESS 0xD000867E /end MEASUREMENT
/begin MEASUREMENT DFC_st.DFC_PCBS "DFC/Status der Fehlerprüfung DFC_PCBS" UWORD DFC_OneToOne 1 100 0.00 65535.00 ECU_ADDRESS 0xD0008680 /end MEASUREMENT
/begin MEASUREMENT DFC_st.DFC_PCBSPFltChg "DFC/Status der Fehlerprüfung DFC_PCBSPFltChg" UWORD DFC_OneToOne 1 100 0.00 65535.00 ECU_ADDRESS 0xD0008682 /end MEASUREMENT
/begin MEASUREMENT DFC_st.DFC_PCRGovDvtLPMax "DFC/Status der Fehlerprüfung DFC_PCRGovDvtLPMax" UWORD DFC_OneToOne 1 100 0.00 65535.00 ECU_ADDRESS 0xD0008684 /end MEASUREMENT
/begin MEASUREMENT DFC_st.DFC_PCRGovDvtLPMin "DFC/Status der Fehlerprüfung DFC_PCRGovDvtLPMin" UWORD DFC_OneToOne 1 100 0.00 65535.00 ECU_ADDRESS 0xD0008686 /end MEASUREMENT
/begin MEASUREMENT DFC_st.DFC_PCRGovDvtMax "DFC/Status der Fehlerprüfung DFC_PCRGovDvtMax" UWORD DFC_OneToOne 1 100 0.00 65535.00 ECU_ADDRESS 0xD0008688 /end MEASUREMENT
/begin MEASUREMENT DFC_st.DFC_PCRGovDvtMin "DFC/Status der Fehlerprüfung DFC_PCRGovDvtMin" UWORD DFC_OneToOne 1 100 0.00 65535.00 ECU_ADDRESS 0xD000868A /end MEASUREMENT
/begin MEASUREMENT DFC_st.DFC_PFltAPSPlausMAX "DFC/Status der Fehlerprüfung DFC_PFltAPSPlausMAX" UWORD DFC_OneToOne 1 100 0.00 65535.00 ECU_ADDRESS 0xD000868C /end MEASUREMENT
/begin MEASUREMENT DFC_st.DFC_PFltAPSPlausMIN "DFC/Status der Fehlerprüfung DFC_PFltAPSPlausMIN" UWORD DFC_OneToOne 1 100 0.00 65535.00 ECU_ADDRESS 0xD000868E /end MEASUREMENT
/begin MEASUREMENT DFC_st.DFC_PFltBPSPlausMAX "DFC/Status der Fehlerprüfung DFC_PFltBPSPlausMAX" UWORD DFC_OneToOne 1 100 0.00 65535.00 ECU_ADDRESS 0xD0008690 /end MEASUREMENT
/begin MEASUREMENT DFC_st.DFC_PFltBPSPlausMIN "DFC/Status der Fehlerprüfung DFC_PFltBPSPlausMIN" UWORD DFC_OneToOne 1 100 0.00 65535.00 ECU_ADDRESS 0xD0008692 /end MEASUREMENT
/begin MEASUREMENT DFC_st.DFC_PFltOvldInhRgn "DFC/Status der Fehlerprüfung DFC_PFltOvldInhRgn" UWORD DFC_OneToOne 1 100 0.00 65535.00 ECU_ADDRESS 0xD0008694 /end MEASUREMENT
/begin MEASUREMENT DFC_st.DFC_PFltOvldTrqLim "DFC/Status der Fehlerprüfung DFC_PFltOvldTrqLim" UWORD DFC_OneToOne 1 100 0.00 65535.00 ECU_ADDRESS 0xD0008696 /end MEASUREMENT
/begin MEASUREMENT DFC_st.DFC_PFltPresPlausMAX "DFC/Status der Fehlerprüfung DFC_PFltPresPlausMAX" UWORD DFC_OneToOne 1 100 0.00 65535.00 ECU_ADDRESS 0xD0008698 /end MEASUREMENT
/begin MEASUREMENT DFC_st.DFC_PFltPresPlausMIN "DFC/Status der Fehlerprüfung DFC_PFltPresPlausMIN" UWORD DFC_OneToOne 1 100 0.00 65535.00 ECU_ADDRESS 0xD000869A /end MEASUREMENT
/begin MEASUREMENT DFC_st.DFC_PFltTraRpmRdc "DFC/Status der Fehlerprüfung DFC_PFltTraRpmRdc" UWORD DFC_OneToOne 1 100 0.00 65535.00 ECU_ADDRESS 0xD000869C /end MEASUREMENT
/begin MEASUREMENT DFC_st.DFC_PFlt_tOxiPreMax "DFC/Status der Fehlerprüfung DFC_PFlt_tOxiPreMax" UWORD DFC_OneToOne 1 100 0.00 65535.00 ECU_ADDRESS 0xD000869E /end MEASUREMENT
/begin MEASUREMENT DFC_st.DFC_PFlt_tOxiPreMaxRgn "DFC/Status der Fehlerprüfung DFC_PFlt_tOxiPreMaxRgn" UWORD DFC_OneToOne 1 100 0.00 65535.00 ECU_ADDRESS 0xD00086A0 /end MEASUREMENT
/begin MEASUREMENT DFC_st.DFC_PFlt_tOxiPreNpl "DFC/Status der Fehlerprüfung DFC_PFlt_tOxiPreNpl" UWORD DFC_OneToOne 1 100 0.00 65535.00 ECU_ADDRESS 0xD00086A2 /end MEASUREMENT
/begin MEASUREMENT DFC_st.DFC_PFlt_tPreMax "DFC/Status der Fehlerprüfung DFC_PFlt_tPreMax" UWORD DFC_OneToOne 1 100 0.00 65535.00 ECU_ADDRESS 0xD00086A4 /end MEASUREMENT
/begin MEASUREMENT DFC_st.DFC_PFlt_tPreMaxRgn "DFC/Status der Fehlerprüfung DFC_PFlt_tPreMaxRgn" UWORD DFC_OneToOne 1 100 0.00 65535.00 ECU_ADDRESS 0xD00086A6 /end MEASUREMENT
/begin MEASUREMENT DFC_st.DFC_PFlt_tPreNpl "DFC/Status der Fehlerprüfung DFC_PFlt_tPreNpl" UWORD DFC_OneToOne 1 100 0.00 65535.00 ECU_ADDRESS 0xD00086A8 /end MEASUREMENT
/begin MEASUREMENT DFC_st.DFC_PFltmSotDiffMAX "DFC/Status der Fehlerprüfung DFC_PFltmSotDiffMAX" UWORD DFC_OneToOne 1 100 0.00 65535.00 ECU_ADDRESS 0xD00086AA /end MEASUREMENT
/begin MEASUREMENT DFC_st.DFC_PFltmSotDiffMIN "DFC/Status der Fehlerprüfung DFC_PFltmSotDiffMIN" UWORD DFC_OneToOne 1 100 0.00 65535.00 ECU_ADDRESS 0xD00086AC /end MEASUREMENT
/begin MEASUREMENT DFC_st.DFC_PFltmSotDiffSIG "DFC/Status der Fehlerprüfung DFC_PFltmSotDiffSIG" UWORD DFC_OneToOne 1 100 0.00 65535.00 ECU_ADDRESS 0xD00086AE /end MEASUREMENT
/begin MEASUREMENT DFC_st.DFC_PIntkVUsEnvPPls "DFC/Status der Fehlerprüfung DFC_PIntkVUsEnvPPls" UWORD DFC_OneToOne 1 100 0.00 65535.00 ECU_ADDRESS 0xD00086B0 /end MEASUREMENT
/begin MEASUREMENT DFC_st.DFC_PresPlausDblDef "DFC/Status der Fehlerprüfung DFC_PresPlausDblDef" UWORD DFC_OneToOne 1 100 0.00 65535.00 ECU_ADDRESS 0xD00086B2 /end MEASUREMENT
/begin MEASUREMENT DFC_st.DFC_RailCPC1 "DFC/Status der Fehlerprüfung für Überwachung auf Stellgröße des Druckregelventils" UWORD DFC_OneToOne 1 100 0.00 65535.00 ECU_ADDRESS 0xD00086B4 /end MEASUREMENT
/begin MEASUREMENT DFC_st.DFC_RailCPC3 "DFC/Status der Fehlerprüfung für Überwachung auf min. Raildruck" UWORD DFC_OneToOne 1 100 0.00 65535.00 ECU_ADDRESS 0xD00086B6 /end MEASUREMENT
/begin MEASUREMENT DFC_st.DFC_RailCPC4 "DFC/Status der Fehlerprüfung für Überwachung auf max. Raildruck" UWORD DFC_OneToOne 1 100 0.00 65535.00 ECU_ADDRESS 0xD00086B8 /end MEASUREMENT
/begin MEASUREMENT DFC_st.DFC_RailMeUn0 "DFC/Status der Fehlerprüfung für positive Regelabweichung" UWORD DFC_OneToOne 1 100 0.00 65535.00 ECU_ADDRESS 0xD00086BA /end MEASUREMENT
/begin MEASUREMENT DFC_st.DFC_RailMeUn1 "DFC/Status der Fehlerprüfung für positive Regelabweichung und Sollwert des Volumenstroms durch die Zumesseinheit" UWORD DFC_OneToOne 1 100 0.00 65535.00 ECU_ADDRESS 0xD00086BC /end MEASUREMENT
/begin MEASUREMENT DFC_st.DFC_RailMeUn2 "DFC/Status der Fehlerprüfung für negative Regelabweichung bei Nullförderung" UWORD DFC_OneToOne 1 100 0.00 65535.00 ECU_ADDRESS 0xD00086BE /end MEASUREMENT
/begin MEASUREMENT DFC_st.DFC_RailMeUn22 "DFC/Status der Fehlerprüfung für negative Regelabweichung bei Nullförderung (2. Stufe)" UWORD DFC_OneToOne 1 100 0.00 65535.00 ECU_ADDRESS 0xD00086C0 /end MEASUREMENT
/begin MEASUREMENT DFC_st.DFC_RailMeUn3 "DFC/Status der Fehlerprüfung für Überwachung auf min. Raildruck" UWORD DFC_OneToOne 1 100 0.00 65535.00 ECU_ADDRESS 0xD00086C2 /end MEASUREMENT
/begin MEASUREMENT DFC_st.DFC_RailMeUn4 "DFC/Status der Fehlerprüfung für Überwachung auf max. Raildruck" UWORD DFC_OneToOne 1 100 0.00 65535.00 ECU_ADDRESS 0xD00086C4 /end MEASUREMENT
/begin MEASUREMENT DFC_st.DFC_RailMeUn42 "DFC/Status der Fehlerprüfung für Überwachung auf max. Raildruck (2. Stufe)" UWORD DFC_OneToOne 1 100 0.00 65535.00 ECU_ADDRESS 0xD00086C6 /end MEASUREMENT
/begin MEASUREMENT DFC_st.DFC_RailMeUn5 "DFC/Status der Fehlerprüfung für positive Regelabweichung des Raildrucks (schnellerer Pfad)" UWORD DFC_OneToOne 1 100 0.00 65535.00 ECU_ADDRESS 0xD00086C8 /end MEASUREMENT
/begin MEASUREMENT DFC_st.DFC_RailPCV0 "DFC/Status der Fehlerprüfung für positive Regelabweichung" UWORD DFC_OneToOne 1 100 0.00 65535.00 ECU_ADDRESS 0xD00086CA /end MEASUREMENT
/begin MEASUREMENT DFC_st.DFC_RailPCV1 "DFC/Status der Fehlerprüfung für positivee Regelabweichung des Raildrucks kombiniert mit der Stellgröße des Druckregelventils" UWORD DFC_OneToOne 1 100 0.00 65535.00 ECU_ADDRESS 0xD00086CC /end MEASUREMENT
/begin MEASUREMENT DFC_st.DFC_RailPCV2 "DFC/Status der Fehlerprüfung für negative Regelabweichung des Raildrucks kombiniert mit der Stellgröße des Druckregelventils" UWORD DFC_OneToOne 1 100 0.00 65535.00 ECU_ADDRESS 0xD00086CE /end MEASUREMENT
/begin MEASUREMENT DFC_st.DFC_RailPCV22 "DFC/Status der Fehlerprüfung für negative Regelabweichung des Raildrucks kombiniert mit der Stellgröße des Druckregelventils (2. Stufe)" UWORD DFC_OneToOne 1 100 0.00 65535.00 ECU_ADDRESS 0xD00086D0 /end MEASUREMENT
/begin MEASUREMENT DFC_st.DFC_RailPCV3 "DFC/Status der Fehlerprüfung für Überwachung auf min. Raildruck" UWORD DFC_OneToOne 1 100 0.00 65535.00 ECU_ADDRESS 0xD00086D2 /end MEASUREMENT
/begin MEASUREMENT DFC_st.DFC_RailPCV4 "DFC/Status der Fehlerprüfung für Überwachung auf max. Raildruck" UWORD DFC_OneToOne 1 100 0.00 65535.00 ECU_ADDRESS 0xD00086D4 /end MEASUREMENT
/begin MEASUREMENT DFC_st.DFC_RailPCV42 "DFC/Status der Fehlerprüfung für Überwachung auf max. Raildruck (2. Stufe)" UWORD DFC_OneToOne 1 100 0.00 65535.00 ECU_ADDRESS 0xD00086D6 /end MEASUREMENT
/begin MEASUREMENT DFC_st.DFC_RailPMonStrt "DFC/Status der Fehlerprüfung DFC_RailPMonStrt" UWORD DFC_OneToOne 1 100 0.00 65535.00 ECU_ADDRESS 0xD00086D8 /end MEASUREMENT
/begin MEASUREMENT DFC_st.DFC_SSpMon1 "DFC/Status der Fehlerprüfung DFC_SSpMon1" UWORD DFC_OneToOne 1 100 0.00 65535.00 ECU_ADDRESS 0xD00086DA /end MEASUREMENT
/begin MEASUREMENT DFC_st.DFC_SSpMon2 "DFC/Status der Fehlerprüfung DFC_SSpMon2" UWORD DFC_OneToOne 1 100 0.00 65535.00 ECU_ADDRESS 0xD00086DC /end MEASUREMENT
/begin MEASUREMENT DFC_st.DFC_SSpMon3 "DFC/Status der Fehlerprüfung DFC_SSpMon3" UWORD DFC_OneToOne 1 100 0.00 65535.00 ECU_ADDRESS 0xD00086DE /end MEASUREMENT
/begin MEASUREMENT DFC_st.DFC_ThrVlv4WinErr1 "DFC/Status der Fehlerprüfung DFC_ThrVlv4WinErr1" UWORD DFC_OneToOne 1 100 0.00 65535.00 ECU_ADDRESS 0xD00086E0 /end MEASUREMENT
/begin MEASUREMENT DFC_st.DFC_ThrVlv4WinErr2 "DFC/Status der Fehlerprüfung DFC_ThrVlv4WinErr2" UWORD DFC_OneToOne 1 100 0.00 65535.00 ECU_ADDRESS 0xD00086E2 /end MEASUREMENT
/begin MEASUREMENT DFC_st.DFC_ThrVlv4WinErr3 "DFC/Status der Fehlerprüfung DFC_ThrVlv4WinErr3" UWORD DFC_OneToOne 1 100 0.00 65535.00 ECU_ADDRESS 0xD00086E4 /end MEASUREMENT
/begin MEASUREMENT DFC_st.DFC_ThrVlv4WinErr4 "DFC/Status der Fehlerprüfung DFC_ThrVlv4WinErr4" UWORD DFC_OneToOne 1 100 0.00 65535.00 ECU_ADDRESS 0xD00086E6 /end MEASUREMENT
/begin MEASUREMENT DFC_st.DFC_ThrVlvSCG "DFC/Status der Fehlerprüfung DFC_ThrVlvSCG" UWORD DFC_OneToOne 1 100 0.00 65535.00 ECU_ADDRESS 0xD00086E8 /end MEASUREMENT
/begin MEASUREMENT DFC_st.DFC_Tle6232Spi1 "DFC/Status der Fehlerprüfung DFC_Tle6232Spi1" UWORD DFC_OneToOne 1 100 0.00 65535.00 ECU_ADDRESS 0xD00086EA /end MEASUREMENT
/begin MEASUREMENT DFC_st.DFC_TrbCh4WinErr1 "DFC/Status der Fehlerprüfung DFC_TrbCh4WinErr1" UWORD DFC_OneToOne 1 100 0.00 65535.00 ECU_ADDRESS 0xD00086EC /end MEASUREMENT
/begin MEASUREMENT DFC_st.DFC_TrbCh4WinErr2 "DFC/Status der Fehlerprüfung DFC_TrbCh4WinErr2" UWORD DFC_OneToOne 1 100 0.00 65535.00 ECU_ADDRESS 0xD00086EE /end MEASUREMENT
/begin MEASUREMENT DFC_st.DFC_TrbCh4WinErr3 "DFC/Status der Fehlerprüfung DFC_TrbCh4WinErr3" UWORD DFC_OneToOne 1 100 0.00 65535.00 ECU_ADDRESS 0xD00086F0 /end MEASUREMENT
/begin MEASUREMENT DFC_st.DFC_TrbCh4WinErr4 "DFC/Status der Fehlerprüfung DFC_TrbCh4WinErr4" UWORD DFC_OneToOne 1 100 0.00 65535.00 ECU_ADDRESS 0xD00086F2 /end MEASUREMENT
/begin MEASUREMENT DFC_st.DFC_TrbChSCG "DFC/Status der Fehlerprüfung DFC_TrbChSCG" UWORD DFC_OneToOne 1 100 0.00 65535.00 ECU_ADDRESS 0xD00086F4 /end MEASUREMENT
/begin MEASUREMENT DFC_st.DFC_TrbChSRCMax "DFC/Status der Fehlerprüfung DFC_TrbChSRCMax" UWORD DFC_OneToOne 1 100 0.00 65535.00 ECU_ADDRESS 0xD00086F6 /end MEASUREMENT
/begin MEASUREMENT DFC_st.DFC_TrbChSRCMin "DFC/Status der Fehlerprüfung DFC_TrbChSRCMin" UWORD DFC_OneToOne 1 100 0.00 65535.00 ECU_ADDRESS 0xD00086F8 /end MEASUREMENT
/begin MEASUREMENT DFC_st.DFC_WaHtEl4WinErr1 "DFC/Status der Fehlerprüfung DFC_WaHtEl4WinErr1" UWORD DFC_OneToOne 1 100 0.00 65535.00 ECU_ADDRESS 0xD00086FA /end MEASUREMENT
/begin MEASUREMENT DFC_st.DFC_WaHtEl4WinErr2 "DFC/Status der Fehlerprüfung DFC_WaHtEl4WinErr2" UWORD DFC_OneToOne 1 100 0.00 65535.00 ECU_ADDRESS 0xD00086FC /end MEASUREMENT
/begin MEASUREMENT DFC_st.DFC_WaHtEl4WinErr3 "DFC/Status der Fehlerprüfung DFC_WaHtEl4WinErr3" UWORD DFC_OneToOne 1 100 0.00 65535.00 ECU_ADDRESS 0xD00086FE /end MEASUREMENT
/begin MEASUREMENT DFC_st.DFC_WaHtEl4WinErr4 "DFC/Status der Fehlerprüfung DFC_WaHtEl4WinErr4" UWORD DFC_OneToOne 1 100 0.00 65535.00 ECU_ADDRESS 0xD0008700 /end MEASUREMENT
/begin MEASUREMENT DFC_st.DFC_WaHtElSCG "DFC/Status der Fehlerprüfung DFC_WaHtElSCG" UWORD DFC_OneToOne 1 100 0.00 65535.00 ECU_ADDRESS 0xD0008702 /end MEASUREMENT
/begin MEASUREMENT DFC_st.DFC_ETClbETFltMax_0 "DFC/Status der Fehlerprüfung DFC_ETClbETFltMax_0" UWORD DFC_OneToOne 1 100 0.00 65535.00 ECU_ADDRESS 0xD0008704 /end MEASUREMENT
/begin MEASUREMENT DFC_st.DFC_ETClbETFltMax_1 "DFC/Status der Fehlerprüfung DFC_ETClbETFltMax_1" UWORD DFC_OneToOne 1 100 0.00 65535.00 ECU_ADDRESS 0xD0008706 /end MEASUREMENT
/begin MEASUREMENT DFC_st.DFC_ETClbETFltMax_2 "DFC/Status der Fehlerprüfung DFC_ETClbETFltMax_2" UWORD DFC_OneToOne 1 100 0.00 65535.00 ECU_ADDRESS 0xD0008708 /end MEASUREMENT
/begin MEASUREMENT DFC_st.DFC_ETClbETFltMax_3 "DFC/Status der Fehlerprüfung DFC_ETClbETFltMax_3" UWORD DFC_OneToOne 1 100 0.00 65535.00 ECU_ADDRESS 0xD000870A /end MEASUREMENT
/begin MEASUREMENT DFC_st.DFC_ETClbETFltMax_4 "DFC/Status der Fehlerprüfung DFC_ETClbETFltMax_4" UWORD DFC_OneToOne 1 100 0.00 65535.00 ECU_ADDRESS 0xD000870C /end MEASUREMENT
/begin MEASUREMENT DFC_st.DFC_ETClbETFltMax_5 "DFC/Status der Fehlerprüfung DFC_ETClbETFltMax_5" UWORD DFC_OneToOne 1 100 0.00 65535.00 ECU_ADDRESS 0xD000870E /end MEASUREMENT
/begin MEASUREMENT DFC_st.DFC_ETClbETFltMin_0 "DFC/Status der Fehlerprüfung DFC_ETClbETFltMin_0" UWORD DFC_OneToOne 1 100 0.00 65535.00 ECU_ADDRESS 0xD0008710 /end MEASUREMENT
/begin MEASUREMENT DFC_st.DFC_ETClbETFltMin_1 "DFC/Status der Fehlerprüfung DFC_ETClbETFltMin_1" UWORD DFC_OneToOne 1 100 0.00 65535.00 ECU_ADDRESS 0xD0008712 /end MEASUREMENT
/begin MEASUREMENT DFC_st.DFC_ETClbETFltMin_2 "DFC/Status der Fehlerprüfung DFC_ETClbETFltMin_2" UWORD DFC_OneToOne 1 100 0.00 65535.00 ECU_ADDRESS 0xD0008714 /end MEASUREMENT
/begin MEASUREMENT DFC_st.DFC_ETClbETFltMin_3 "DFC/Status der Fehlerprüfung DFC_ETClbETFltMin_3" UWORD DFC_OneToOne 1 100 0.00 65535.00 ECU_ADDRESS 0xD0008716 /end MEASUREMENT
/begin MEASUREMENT DFC_st.DFC_ETClbETFltMin_4 "DFC/Status der Fehlerprüfung DFC_ETClbETFltMin_4" UWORD DFC_OneToOne 1 100 0.00 65535.00 ECU_ADDRESS 0xD0008718 /end MEASUREMENT
/begin MEASUREMENT DFC_st.DFC_ETClbETFltMin_5 "DFC/Status der Fehlerprüfung DFC_ETClbETFltMin_5" UWORD DFC_OneToOne 1 100 0.00 65535.00 ECU_ADDRESS 0xD000871A /end MEASUREMENT
/begin MEASUREMENT DFC_st.DFC_InjCrvInjLimChrgBal "DFC/Status der Fehlerprüfung DFC_InjCrvInjLimChrgBal" UWORD DFC_OneToOne 1 100 0.00 65535.00 ECU_ADDRESS 0xD000871C /end MEASUREMENT
/begin MEASUREMENT DFC_st.DFC_InjCrvInjLimQntBal "DFC/Status der Fehlerprüfung DFC_InjCrvInjLimQntBal" UWORD DFC_OneToOne 1 100 0.00 65535.00 ECU_ADDRESS 0xD000871E /end MEASUREMENT
/begin MEASUREMENT DFC_st.DFC_InjCrvInjLimSys "DFC/Status der Fehlerprüfung DFC_InjCrvInjLimSys" UWORD DFC_OneToOne 1 100 0.00 65535.00 ECU_ADDRESS 0xD0008720 /end MEASUREMENT
/begin MEASUREMENT DFC_st.DFC_InjCrvNumInjRtmLim "DFC/Status der Fehlerprüfung DFC_InjCrvNumInjRtmLim" UWORD DFC_OneToOne 1 100 0.00 65535.00 ECU_ADDRESS 0xD0008722 /end MEASUREMENT
/begin MEASUREMENT DFC_st.DFC_LSUHtCoupSig "DFC/Status der Fehlerprüfung DFC_LSUHtCoupSig" UWORD DFC_OneToOne 1 100 0.00 65535.00 ECU_ADDRESS 0xD0008724 /end MEASUREMENT
/begin MEASUREMENT DFC_st.DFC_AFS_SSpShOffOL "DFC/Status der Fehlerprüfung DFC_AFS_SSpShOffOL" UWORD DFC_OneToOne 1 100 0.00 65535.00 ECU_ADDRESS 0xD0008726 /end MEASUREMENT
/begin MEASUREMENT DFC_st.DFC_AFS_SSpShOffOvrTemp "DFC/Status der Fehlerprüfung DFC_AFS_SSpShOffOvrTemp" UWORD DFC_OneToOne 1 100 0.00 65535.00 ECU_ADDRESS 0xD0008728 /end MEASUREMENT
/begin MEASUREMENT DFC_st.DFC_AFS_SSpShOffSCB "DFC/Status der Fehlerprüfung DFC_AFS_SSpShOffSCB" UWORD DFC_OneToOne 1 100 0.00 65535.00 ECU_ADDRESS 0xD000872A /end MEASUREMENT
/begin MEASUREMENT DFC_st.DFC_AFS_SSpShOffSCG "DFC/Status der Fehlerprüfung DFC_AFS_SSpShOffSCG" UWORD DFC_OneToOne 1 100 0.00 65535.00 ECU_ADDRESS 0xD000872C /end MEASUREMENT
/begin MEASUREMENT DFC_st.DFC_AirCCmprOL "DFC/Status der Fehlerprüfung DFC_AirCCmprOL" UWORD DFC_OneToOne 1 100 0.00 65535.00 ECU_ADDRESS 0xD000872E /end MEASUREMENT
/begin MEASUREMENT DFC_st.DFC_AirCCmprOvrTemp "DFC/Status der Fehlerprüfung DFC_AirCCmprOvrTemp" UWORD DFC_OneToOne 1 100 0.00 65535.00 ECU_ADDRESS 0xD0008730 /end MEASUREMENT
/begin MEASUREMENT DFC_st.DFC_AirCCmprSCB "DFC/Status der Fehlerprüfung DFC_AirCCmprSCB" UWORD DFC_OneToOne 1 100 0.00 65535.00 ECU_ADDRESS 0xD0008732 /end MEASUREMENT
/begin MEASUREMENT DFC_st.DFC_AirCCmprSCG "DFC/Status der Fehlerprüfung DFC_AirCCmprSCG" UWORD DFC_OneToOne 1 100 0.00 65535.00 ECU_ADDRESS 0xD0008734 /end MEASUREMENT
/begin MEASUREMENT DFC_st.DFC_CByVlvOL "DFC/Status der Fehlerprüfung DFC_CByVlvOL" UWORD DFC_OneToOne 1 100 0.00 65535.00 ECU_ADDRESS 0xD0008736 /end MEASUREMENT
/begin MEASUREMENT DFC_st.DFC_CByVlvOvrTemp "DFC/Status der Fehlerprüfung DFC_CByVlvOvrTemp" UWORD DFC_OneToOne 1 100 0.00 65535.00 ECU_ADDRESS 0xD0008738 /end MEASUREMENT
/begin MEASUREMENT DFC_st.DFC_CByVlvSCB "DFC/Status der Fehlerprüfung DFC_CByVlvSCB" UWORD DFC_OneToOne 1 100 0.00 65535.00 ECU_ADDRESS 0xD000873A /end MEASUREMENT
/begin MEASUREMENT DFC_st.DFC_CByVlvSCG "DFC/Status der Fehlerprüfung DFC_CByVlvSCG" UWORD DFC_OneToOne 1 100 0.00 65535.00 ECU_ADDRESS 0xD000873C /end MEASUREMENT
/begin MEASUREMENT DFC_st.DFC_CThmstOL "DFC/Status der Fehlerprüfung DFC_CThmstOL" UWORD DFC_OneToOne 1 100 0.00 65535.00 ECU_ADDRESS 0xD000873E /end MEASUREMENT
/begin MEASUREMENT DFC_st.DFC_CThmstOvrTemp "DFC/Status der Fehlerprüfung DFC_CThmstOvrTemp" UWORD DFC_OneToOne 1 100 0.00 65535.00 ECU_ADDRESS 0xD0008740 /end MEASUREMENT
/begin MEASUREMENT DFC_st.DFC_CThmstSCB "DFC/Status der Fehlerprüfung DFC_CThmstSCB" UWORD DFC_OneToOne 1 100 0.00 65535.00 ECU_ADDRESS 0xD0008742 /end MEASUREMENT
/begin MEASUREMENT DFC_st.DFC_CThmstSCG "DFC/Status der Fehlerprüfung DFC_CThmstSCG" UWORD DFC_OneToOne 1 100 0.00 65535.00 ECU_ADDRESS 0xD0008744 /end MEASUREMENT
/begin MEASUREMENT DFC_st.DFC_DSMDummy "DFC/Status der Fehlerprüfung DFC_DSMDummy" UWORD DFC_OneToOne 1 100 0.00 65535.00 ECU_ADDRESS 0xD0008746 /end MEASUREMENT
/begin MEASUREMENT DFC_st.DFC_EBxFanOL "DFC/Status der Fehlerprüfung DFC_EBxFanOL" UWORD DFC_OneToOne 1 100 0.00 65535.00 ECU_ADDRESS 0xD0008748 /end MEASUREMENT
/begin MEASUREMENT DFC_st.DFC_EBxFanOvrTemp "DFC/Status der Fehlerprüfung DFC_EBxFanOvrTemp" UWORD DFC_OneToOne 1 100 0.00 65535.00 ECU_ADDRESS 0xD000874A /end MEASUREMENT
/begin MEASUREMENT DFC_st.DFC_EBxFanSCB "DFC/Status der Fehlerprüfung DFC_EBxFanSCB" UWORD DFC_OneToOne 1 100 0.00 65535.00 ECU_ADDRESS 0xD000874C /end MEASUREMENT
/begin MEASUREMENT DFC_st.DFC_EBxFanSCG "DFC/Status der Fehlerprüfung DFC_EBxFanSCG" UWORD DFC_OneToOne 1 100 0.00 65535.00 ECU_ADDRESS 0xD000874E /end MEASUREMENT
/begin MEASUREMENT DFC_st.DFC_ECBVlvOL "DFC/Status der Fehlerprüfung DFC_ECBVlvOL" UWORD DFC_OneToOne 1 100 0.00 65535.00 ECU_ADDRESS 0xD0008750 /end MEASUREMENT
/begin MEASUREMENT DFC_st.DFC_ECBVlvOvrTemp "DFC/Status der Fehlerprüfung DFC_ECBVlvOvrTemp" UWORD DFC_OneToOne 1 100 0.00 65535.00 ECU_ADDRESS 0xD0008752 /end MEASUREMENT
/begin MEASUREMENT DFC_st.DFC_ECBVlvSCB "DFC/Status der Fehlerprüfung DFC_ECBVlvSCB" UWORD DFC_OneToOne 1 100 0.00 65535.00 ECU_ADDRESS 0xD0008754 /end MEASUREMENT
/begin MEASUREMENT DFC_st.DFC_ECBVlvSCG "DFC/Status der Fehlerprüfung DFC_ECBVlvSCG" UWORD DFC_OneToOne 1 100 0.00 65535.00 ECU_ADDRESS 0xD0008756 /end MEASUREMENT
/begin MEASUREMENT DFC_st.DFC_EMDmpOL_0 "DFC/Status der Fehlerprüfung DFC_EMDmpOL_0" UWORD DFC_OneToOne 1 100 0.00 65535.00 ECU_ADDRESS 0xD0008758 /end MEASUREMENT
/begin MEASUREMENT DFC_st.DFC_EMDmpOL_1 "DFC/Status der Fehlerprüfung DFC_EMDmpOL_1" UWORD DFC_OneToOne 1 100 0.00 65535.00 ECU_ADDRESS 0xD000875A /end MEASUREMENT
/begin MEASUREMENT DFC_st.DFC_EMDmpOvrTemp_0 "DFC/Status der Fehlerprüfung DFC_EMDmpOvrTemp_0" UWORD DFC_OneToOne 1 100 0.00 65535.00 ECU_ADDRESS 0xD000875C /end MEASUREMENT
/begin MEASUREMENT DFC_st.DFC_EMDmpOvrTemp_1 "DFC/Status der Fehlerprüfung DFC_EMDmpOvrTemp_1" UWORD DFC_OneToOne 1 100 0.00 65535.00 ECU_ADDRESS 0xD000875E /end MEASUREMENT
/begin MEASUREMENT DFC_st.DFC_EMDmpSCB_0 "DFC/Status der Fehlerprüfung DFC_EMDmpSCB_0" UWORD DFC_OneToOne 1 100 0.00 65535.00 ECU_ADDRESS 0xD0008760 /end MEASUREMENT
/begin MEASUREMENT DFC_st.DFC_EMDmpSCB_1 "DFC/Status der Fehlerprüfung DFC_EMDmpSCB_1" UWORD DFC_OneToOne 1 100 0.00 65535.00 ECU_ADDRESS 0xD0008762 /end MEASUREMENT
/begin MEASUREMENT DFC_st.DFC_EMDmpSCG_0 "DFC/Status der Fehlerprüfung DFC_EMDmpSCG_0" UWORD DFC_OneToOne 1 100 0.00 65535.00 ECU_ADDRESS 0xD0008764 /end MEASUREMENT
/begin MEASUREMENT DFC_st.DFC_EMDmpSCG_1 "DFC/Status der Fehlerprüfung DFC_EMDmpSCG_1" UWORD DFC_OneToOne 1 100 0.00 65535.00 ECU_ADDRESS 0xD0008766 /end MEASUREMENT
/begin MEASUREMENT DFC_st.DFC_EngStAOL "DFC/Status der Fehlerprüfung DFC_EngStAOL" UWORD DFC_OneToOne 1 100 0.00 65535.00 ECU_ADDRESS 0xD0008768 /end MEASUREMENT
/begin MEASUREMENT DFC_st.DFC_EngStAOvrTemp "DFC/Status der Fehlerprüfung DFC_EngStAOvrTemp" UWORD DFC_OneToOne 1 100 0.00 65535.00 ECU_ADDRESS 0xD000876A /end MEASUREMENT
/begin MEASUREMENT DFC_st.DFC_EngStASCB "DFC/Status der Fehlerprüfung DFC_EngStASCB" UWORD DFC_OneToOne 1 100 0.00 65535.00 ECU_ADDRESS 0xD000876C /end MEASUREMENT
/begin MEASUREMENT DFC_st.DFC_EngStASCG "DFC/Status der Fehlerprüfung DFC_EngStASCG" UWORD DFC_OneToOne 1 100 0.00 65535.00 ECU_ADDRESS 0xD000876E /end MEASUREMENT
/begin MEASUREMENT DFC_st.DFC_FanOL "DFC/Status der Fehlerprüfung DFC_FanOL" UWORD DFC_OneToOne 1 100 0.00 65535.00 ECU_ADDRESS 0xD0008770 /end MEASUREMENT
/begin MEASUREMENT DFC_st.DFC_FanOvrTemp "DFC/Status der Fehlerprüfung DFC_FanOvrTemp" UWORD DFC_OneToOne 1 100 0.00 65535.00 ECU_ADDRESS 0xD0008772 /end MEASUREMENT
/begin MEASUREMENT DFC_st.DFC_FanSCB "DFC/Status der Fehlerprüfung DFC_FanSCB" UWORD DFC_OneToOne 1 100 0.00 65535.00 ECU_ADDRESS 0xD0008774 /end MEASUREMENT
/begin MEASUREMENT DFC_st.DFC_FlFltHtOL "DFC/Status der Fehlerprüfung DFC_FlFltHtOL" UWORD DFC_OneToOne 1 100 0.00 65535.00 ECU_ADDRESS 0xD0008776 /end MEASUREMENT
/begin MEASUREMENT DFC_st.DFC_FlFltHtOvrTemp "DFC/Status der Fehlerprüfung DFC_FlFltHtOvrTemp" UWORD DFC_OneToOne 1 100 0.00 65535.00 ECU_ADDRESS 0xD0008778 /end MEASUREMENT
/begin MEASUREMENT DFC_st.DFC_FlFltHtSCB "DFC/Status der Fehlerprüfung DFC_FlFltHtSCB" UWORD DFC_OneToOne 1 100 0.00 65535.00 ECU_ADDRESS 0xD000877A /end MEASUREMENT
/begin MEASUREMENT DFC_st.DFC_FlFltHtSCG "DFC/Status der Fehlerprüfung DFC_FlFltHtSCG" UWORD DFC_OneToOne 1 100 0.00 65535.00 ECU_ADDRESS 0xD000877C /end MEASUREMENT
/begin MEASUREMENT DFC_st.DFC_LSUHtrMax "DFC/Status der Fehlerprüfung DFC_LSUHtrMax" UWORD DFC_OneToOne 1 100 0.00 65535.00 ECU_ADDRESS 0xD000877E /end MEASUREMENT
/begin MEASUREMENT DFC_st.DFC_LSUHtrMin "DFC/Status der Fehlerprüfung DFC_LSUHtrMin" UWORD DFC_OneToOne 1 100 0.00 65535.00 ECU_ADDRESS 0xD0008780 /end MEASUREMENT
/begin MEASUREMENT DFC_st.DFC_LSUHtrNpl "DFC/Status der Fehlerprüfung DFC_LSUHtrNpl" UWORD DFC_OneToOne 1 100 0.00 65535.00 ECU_ADDRESS 0xD0008782 /end MEASUREMENT
/begin MEASUREMENT DFC_st.DFC_LSUHtrSig "DFC/Status der Fehlerprüfung DFC_LSUHtrSig" UWORD DFC_OneToOne 1 100 0.00 65535.00 ECU_ADDRESS 0xD0008784 /end MEASUREMENT
/begin MEASUREMENT DFC_st.DFC_LSUtExcMax "DFC/Status der Fehlerprüfung DFC_LSUtExcMax" UWORD DFC_OneToOne 1 100 0.00 65535.00 ECU_ADDRESS 0xD0008786 /end MEASUREMENT
/begin MEASUREMENT DFC_st.DFC_LSUtExcMin "DFC/Status der Fehlerprüfung DFC_LSUtExcMin" UWORD DFC_OneToOne 1 100 0.00 65535.00 ECU_ADDRESS 0xD0008788 /end MEASUREMENT
/begin MEASUREMENT DFC_st.DFC_MeUnOL "DFC/Status der Fehlerprüfung DFC_MeUnOL" UWORD DFC_OneToOne 1 100 0.00 65535.00 ECU_ADDRESS 0xD000878A /end MEASUREMENT
/begin MEASUREMENT DFC_st.DFC_MeUnSCB "DFC/Status der Fehlerprüfung DFC_MeUnSCB" UWORD DFC_OneToOne 1 100 0.00 65535.00 ECU_ADDRESS 0xD000878C /end MEASUREMENT
/begin MEASUREMENT DFC_st.DFC_MeUnSRCMax "DFC/Status der Fehlerprüfung DFC_MeUnSRCMax" UWORD DFC_OneToOne 1 100 0.00 65535.00 ECU_ADDRESS 0xD000878E /end MEASUREMENT
/begin MEASUREMENT DFC_st.DFC_MeUnSRCMin "DFC/Status der Fehlerprüfung DFC_MeUnSRCMin" UWORD DFC_OneToOne 1 100 0.00 65535.00 ECU_ADDRESS 0xD0008790 /end MEASUREMENT
/begin MEASUREMENT DFC_st.DFC_PCVOL "DFC/Status der Fehlerprüfung DFC_PCVOL" UWORD DFC_OneToOne 1 100 0.00 65535.00 ECU_ADDRESS 0xD0008792 /end MEASUREMENT
/begin MEASUREMENT DFC_st.DFC_PCVSCB "DFC/Status der Fehlerprüfung DFC_PCVSCB" UWORD DFC_OneToOne 1 100 0.00 65535.00 ECU_ADDRESS 0xD0008794 /end MEASUREMENT
/begin MEASUREMENT DFC_st.DFC_PCVSRCMax "DFC/Status der Fehlerprüfung DFC_PCVSRCMax" UWORD DFC_OneToOne 1 100 0.00 65535.00 ECU_ADDRESS 0xD0008796 /end MEASUREMENT
/begin MEASUREMENT DFC_st.DFC_PCVSRCMin "DFC/Status der Fehlerprüfung DFC_PCVSRCMin" UWORD DFC_OneToOne 1 100 0.00 65535.00 ECU_ADDRESS 0xD0008798 /end MEASUREMENT
/begin MEASUREMENT DFC_st.DFC_RailPSRCMax "DFC/Status der Fehlerprüfung DFC_RailPSRCMax" UWORD DFC_OneToOne 1 100 0.00 65535.00 ECU_ADDRESS 0xD000879A /end MEASUREMENT
/begin MEASUREMENT DFC_st.DFC_RailPSRCMin "DFC/Status der Fehlerprüfung DFC_RailPSRCMin" UWORD DFC_OneToOne 1 100 0.00 65535.00 ECU_ADDRESS 0xD000879C /end MEASUREMENT
/begin MEASUREMENT DFC_st.DFC_ShtrOL "DFC/Status der Fehlerprüfung DFC_ShtrOL" UWORD DFC_OneToOne 1 100 0.00 65535.00 ECU_ADDRESS 0xD000879E /end MEASUREMENT
/begin MEASUREMENT DFC_st.DFC_ShtrOvrTemp "DFC/Status der Fehlerprüfung DFC_ShtrOvrTemp" UWORD DFC_OneToOne 1 100 0.00 65535.00 ECU_ADDRESS 0xD00087A0 /end MEASUREMENT
/begin MEASUREMENT DFC_st.DFC_ShtrSCB "DFC/Status der Fehlerprüfung DFC_ShtrSCB" UWORD DFC_OneToOne 1 100 0.00 65535.00 ECU_ADDRESS 0xD00087A2 /end MEASUREMENT
/begin MEASUREMENT DFC_st.DFC_ShtrSCG "DFC/Status der Fehlerprüfung DFC_ShtrSCG" UWORD DFC_OneToOne 1 100 0.00 65535.00 ECU_ADDRESS 0xD00087A4 /end MEASUREMENT
/begin MEASUREMENT DFC_st.DFC_StrtOL "DFC/Status der Fehlerprüfung DFC_StrtOL" UWORD DFC_OneToOne 1 100 0.00 65535.00 ECU_ADDRESS 0xD00087A6 /end MEASUREMENT
/begin MEASUREMENT DFC_st.DFC_StrtOvrTemp "DFC/Status der Fehlerprüfung DFC_StrtOvrTemp" UWORD DFC_OneToOne 1 100 0.00 65535.00 ECU_ADDRESS 0xD00087A8 /end MEASUREMENT
/begin MEASUREMENT DFC_st.DFC_StrtSCB "DFC/Status der Fehlerprüfung DFC_StrtSCB" UWORD DFC_OneToOne 1 100 0.00 65535.00 ECU_ADDRESS 0xD00087AA /end MEASUREMENT
/begin MEASUREMENT DFC_st.DFC_StrtSCG "DFC/Status der Fehlerprüfung DFC_StrtSCG" UWORD DFC_OneToOne 1 100 0.00 65535.00 ECU_ADDRESS 0xD00087AC /end MEASUREMENT
/begin MEASUREMENT DFC_st.DFC_ThrVlvOL "DFC/Status der Fehlerprüfung DFC_ThrVlvOL" UWORD DFC_OneToOne 1 100 0.00 65535.00 ECU_ADDRESS 0xD00087AE /end MEASUREMENT
/begin MEASUREMENT DFC_st.DFC_ThrVlvOvrTemp "DFC/Status der Fehlerprüfung DFC_ThrVlvOvrTemp" UWORD DFC_OneToOne 1 100 0.00 65535.00 ECU_ADDRESS 0xD00087B0 /end MEASUREMENT
/begin MEASUREMENT DFC_st.DFC_ThrVlvSCB "DFC/Status der Fehlerprüfung DFC_ThrVlvSCB" UWORD DFC_OneToOne 1 100 0.00 65535.00 ECU_ADDRESS 0xD00087B2 /end MEASUREMENT
/begin MEASUREMENT DFC_st.DFC_TrbChOL "DFC/Status der Fehlerprüfung DFC_TrbChOL" UWORD DFC_OneToOne 1 100 0.00 65535.00 ECU_ADDRESS 0xD00087B4 /end MEASUREMENT
/begin MEASUREMENT DFC_st.DFC_TrbChOvrTemp "DFC/Status der Fehlerprüfung DFC_TrbChOvrTemp" UWORD DFC_OneToOne 1 100 0.00 65535.00 ECU_ADDRESS 0xD00087B6 /end MEASUREMENT
/begin MEASUREMENT DFC_st.DFC_TrbChSCB "DFC/Status der Fehlerprüfung DFC_TrbChSCB" UWORD DFC_OneToOne 1 100 0.00 65535.00 ECU_ADDRESS 0xD00087B8 /end MEASUREMENT
/begin MEASUREMENT DFC_st.DFC_UDosVlvOL "DFC/Status der Fehlerprüfung DFC_UDosVlvOL" UWORD DFC_OneToOne 1 100 0.00 65535.00 ECU_ADDRESS 0xD00087BA /end MEASUREMENT
/begin MEASUREMENT DFC_st.DFC_UDosVlvOvrTemp "DFC/Status der Fehlerprüfung DFC_UDosVlvOvrTemp" UWORD DFC_OneToOne 1 100 0.00 65535.00 ECU_ADDRESS 0xD00087BC /end MEASUREMENT
/begin MEASUREMENT DFC_st.DFC_UDosVlvSCB "DFC/Status der Fehlerprüfung DFC_UDosVlvSCB" UWORD DFC_OneToOne 1 100 0.00 65535.00 ECU_ADDRESS 0xD00087BE /end MEASUREMENT
/begin MEASUREMENT DFC_st.DFC_UDosVlvSCG "DFC/Status der Fehlerprüfung DFC_UDosVlvSCG" UWORD DFC_OneToOne 1 100 0.00 65535.00 ECU_ADDRESS 0xD00087C0 /end MEASUREMENT
/begin MEASUREMENT DFC_st.DFC_UPmpMotOL "DFC/Status der Fehlerprüfung DFC_UPmpMotOL" UWORD DFC_OneToOne 1 100 0.00 65535.00 ECU_ADDRESS 0xD00087C2 /end MEASUREMENT
/begin MEASUREMENT DFC_st.DFC_UPmpMotOvrTemp "DFC/Status der Fehlerprüfung DFC_UPmpMotOvrTemp" UWORD DFC_OneToOne 1 100 0.00 65535.00 ECU_ADDRESS 0xD00087C4 /end MEASUREMENT
/begin MEASUREMENT DFC_st.DFC_UPmpMotSCB "DFC/Status der Fehlerprüfung DFC_UPmpMotSCB" UWORD DFC_OneToOne 1 100 0.00 65535.00 ECU_ADDRESS 0xD00087C6 /end MEASUREMENT
/begin MEASUREMENT DFC_st.DFC_UPmpMotSCG "DFC/Status der Fehlerprüfung DFC_UPmpMotSCG" UWORD DFC_OneToOne 1 100 0.00 65535.00 ECU_ADDRESS 0xD00087C8 /end MEASUREMENT
/begin MEASUREMENT DFC_st.DFC_WaHtElOL "DFC/Status der Fehlerprüfung DFC_WaHtElOL" UWORD DFC_OneToOne 1 100 0.00 65535.00 ECU_ADDRESS 0xD00087CA /end MEASUREMENT
/begin MEASUREMENT DFC_st.DFC_WaHtElOvrTemp "DFC/Status der Fehlerprüfung DFC_WaHtElOvrTemp" UWORD DFC_OneToOne 1 100 0.00 65535.00 ECU_ADDRESS 0xD00087CC /end MEASUREMENT
/begin MEASUREMENT DFC_st.DFC_WaHtElSCB "DFC/Status der Fehlerprüfung DFC_WaHtElSCB" UWORD DFC_OneToOne 1 100 0.00 65535.00 ECU_ADDRESS 0xD00087CE /end MEASUREMENT
/begin MEASUREMENT DFC_st.DFC_IVActrUChSRCMax "DFC/Status der Fehlerprüfung DFC_IVActrUChSRCMax" UWORD DFC_OneToOne 1 100 0.00 65535.00 ECU_ADDRESS 0xD00087D0 /end MEASUREMENT
/begin MEASUREMENT DFC_st.DFC_IVActrUChSRCMin "DFC/Status der Fehlerprüfung DFC_IVActrUChSRCMin" UWORD DFC_OneToOne 1 100 0.00 65535.00 ECU_ADDRESS 0xD00087D2 /end MEASUREMENT
/begin MEASUREMENT DFC_st.DFC_IVActrVltgSRCMax "DFC/Status der Fehlerprüfung DFC_IVActrVltgSRCMax" UWORD DFC_OneToOne 1 100 0.00 65535.00 ECU_ADDRESS 0xD00087D4 /end MEASUREMENT
/begin MEASUREMENT DFC_st.DFC_IVActrVltgSRCMin "DFC/Status der Fehlerprüfung DFC_IVActrVltgSRCMin" UWORD DFC_OneToOne 1 100 0.00 65535.00 ECU_ADDRESS 0xD00087D6 /end MEASUREMENT
/begin MEASUREMENT DFC_st.DFC_IVDiaTunDet "DFC/Status der Fehlerprüfung DFC_IVDiaTunDet" UWORD DFC_OneToOne 1 100 0.00 65535.00 ECU_ADDRESS 0xD00087D8 /end MEASUREMENT
/begin MEASUREMENT DFC_st.DFC_IVPSplyStopDCDC "DFC/Status der Fehlerprüfung DFC_IVPSplyStopDCDC" UWORD DFC_OneToOne 1 100 0.00 65535.00 ECU_ADDRESS 0xD00087DA /end MEASUREMENT
/begin MEASUREMENT DFC_st.DFC_IVPSplyVltgSRCMax "DFC/Status der Fehlerprüfung DFC_IVPSplyVltgSRCMax" UWORD DFC_OneToOne 1 100 0.00 65535.00 ECU_ADDRESS 0xD00087DC /end MEASUREMENT
/begin MEASUREMENT DFC_st.DFC_IVPSplyVltgSRCMin "DFC/Status der Fehlerprüfung DFC_IVPSplyVltgSRCMin" UWORD DFC_OneToOne 1 100 0.00 65535.00 ECU_ADDRESS 0xD00087DE /end MEASUREMENT
/begin MEASUREMENT DFC_st.DFC_SCREtaErr "DFC/Status der Fehlerprüfung DFC_SCREtaErr" UWORD DFC_OneToOne 1 100 0.00 65535.00 ECU_ADDRESS 0xD00087E0 /end MEASUREMENT
/begin MEASUREMENT DFC_st.DFC_SCREtaErr1 "DFC/Status der Fehlerprüfung DFC_SCREtaErr1" UWORD DFC_OneToOne 1 100 0.00 65535.00 ECU_ADDRESS 0xD00087E2 /end MEASUREMENT
/begin MEASUREMENT DFC_st.DFC_SCREtaErr2 "DFC/Status der Fehlerprüfung DFC_SCREtaErr2" UWORD DFC_OneToOne 1 100 0.00 65535.00 ECU_ADDRESS 0xD00087E4 /end MEASUREMENT
/begin MEASUREMENT DFC_st.DFC_SCRMonMetCtlPresErr "DFC/Status der Fehlerprüfung DFC_SCRMonMetCtlPresErr" UWORD DFC_OneToOne 1 100 0.00 65535.00 ECU_ADDRESS 0xD00087E6 /end MEASUREMENT
/begin MEASUREMENT DFC_st.DFC_SCRMonPresBuildUpErr "DFC/Status der Fehlerprüfung DFC_SCRMonPresBuildUpErr" UWORD DFC_OneToOne 1 100 0.00 65535.00 ECU_ADDRESS 0xD00087E8 /end MEASUREMENT
/begin MEASUREMENT DFC_st.DFC_SCRMonPresRdcErr "DFC/Status der Fehlerprüfung DFC_SCRMonPresRdcErr" UWORD DFC_OneToOne 1 100 0.00 65535.00 ECU_ADDRESS 0xD00087EA /end MEASUREMENT
/begin MEASUREMENT DFC_st.DFC_AFSOffsDrftMax "DFC/Status der Fehlerprüfung DFC_AFSOffsDrftMax" UWORD DFC_OneToOne 1 100 0.00 65535.00 ECU_ADDRESS 0xD00087EC /end MEASUREMENT
/begin MEASUREMENT DFC_st.DFC_AFSOffsDrftMin "DFC/Status der Fehlerprüfung DFC_AFSOffsDrftMin" UWORD DFC_OneToOne 1 100 0.00 65535.00 ECU_ADDRESS 0xD00087EE /end MEASUREMENT
/begin MEASUREMENT DFC_st.DFC_AFSSRCCorMax "DFC/Status der Fehlerprüfung DFC_AFSSRCCorMax" UWORD DFC_OneToOne 1 100 0.00 65535.00 ECU_ADDRESS 0xD00087F0 /end MEASUREMENT
/begin MEASUREMENT DFC_st.DFC_AFSSRCCorMin "DFC/Status der Fehlerprüfung DFC_AFSSRCCorMin" UWORD DFC_OneToOne 1 100 0.00 65535.00 ECU_ADDRESS 0xD00087F2 /end MEASUREMENT
/begin MEASUREMENT DFC_st.DFC_AFSSRCRawMax "DFC/Status der Fehlerprüfung DFC_AFSSRCRawMax" UWORD DFC_OneToOne 1 100 0.00 65535.00 ECU_ADDRESS 0xD00087F4 /end MEASUREMENT
/begin MEASUREMENT DFC_st.DFC_AFSSRCRawMin "DFC/Status der Fehlerprüfung DFC_AFSSRCRawMin" UWORD DFC_OneToOne 1 100 0.00 65535.00 ECU_ADDRESS 0xD00087F6 /end MEASUREMENT
/begin MEASUREMENT DFC_st.DFC_AFSSetyDrftMax "DFC/Status der Fehlerprüfung DFC_AFSSetyDrftMax" UWORD DFC_OneToOne 1 100 0.00 65535.00 ECU_ADDRESS 0xD00087F8 /end MEASUREMENT
/begin MEASUREMENT DFC_st.DFC_AFSSetyDrftMin "DFC/Status der Fehlerprüfung DFC_AFSSetyDrftMin" UWORD DFC_OneToOne 1 100 0.00 65535.00 ECU_ADDRESS 0xD00087FA /end MEASUREMENT
/begin MEASUREMENT DFC_st.DFC_AirCSwtNpl "DFC/Status der Fehlerprüfung DFC_AirCSwtNpl" UWORD DFC_OneToOne 1 100 0.00 65535.00 ECU_ADDRESS 0xD00087FC /end MEASUREMENT
/begin MEASUREMENT DFC_st.DFC_AirCSwtSig "DFC/Status der Fehlerprüfung DFC_AirCSwtSig" UWORD DFC_OneToOne 1 100 0.00 65535.00 ECU_ADDRESS 0xD00087FE /end MEASUREMENT
/begin MEASUREMENT DFC_st.DFC_BattUSRCMax "DFC/Status der Fehlerprüfung DFC_BattUSRCMax" UWORD DFC_OneToOne 1 100 0.00 65535.00 ECU_ADDRESS 0xD0008800 /end MEASUREMENT
/begin MEASUREMENT DFC_st.DFC_BattUSRCMin "DFC/Status der Fehlerprüfung DFC_BattUSRCMin" UWORD DFC_OneToOne 1 100 0.00 65535.00 ECU_ADDRESS 0xD0008802 /end MEASUREMENT
/begin MEASUREMENT DFC_st.DFC_BrkNpl "DFC/Status der Fehlerprüfung DFC_BrkNpl" UWORD DFC_OneToOne 1 100 0.00 65535.00 ECU_ADDRESS 0xD0008804 /end MEASUREMENT
/begin MEASUREMENT DFC_st.DFC_BrkPSRCMax "DFC/Status der Fehlerprüfung DFC_BrkPSRCMax" UWORD DFC_OneToOne 1 100 0.00 65535.00 ECU_ADDRESS 0xD0008806 /end MEASUREMENT
/begin MEASUREMENT DFC_st.DFC_BrkPSRCMin "DFC/Status der Fehlerprüfung DFC_BrkPSRCMin" UWORD DFC_OneToOne 1 100 0.00 65535.00 ECU_ADDRESS 0xD0008808 /end MEASUREMENT
/begin MEASUREMENT DFC_st.DFC_CEngDsTSRCMax "DFC/Status der Fehlerprüfung DFC_CEngDsTSRCMax" UWORD DFC_OneToOne 1 100 0.00 65535.00 ECU_ADDRESS 0xD000880A /end MEASUREMENT
/begin MEASUREMENT DFC_st.DFC_CEngDsTSRCMin "DFC/Status der Fehlerprüfung DFC_CEngDsTSRCMin" UWORD DFC_OneToOne 1 100 0.00 65535.00 ECU_ADDRESS 0xD000880C /end MEASUREMENT
/begin MEASUREMENT DFC_st.DFC_CrCUIDet "DFC/Status der Fehlerprüfung DFC_CrCUIDet" UWORD DFC_OneToOne 1 100 0.00 65535.00 ECU_ADDRESS 0xD000880E /end MEASUREMENT
/begin MEASUREMENT DFC_st.DFC_ECBVlvSRCMax "DFC/Status der Fehlerprüfung DFC_ECBVlvSRCMax" UWORD DFC_OneToOne 1 100 0.00 65535.00 ECU_ADDRESS 0xD0008810 /end MEASUREMENT
/begin MEASUREMENT DFC_st.DFC_ECBVlvSRCMin "DFC/Status der Fehlerprüfung DFC_ECBVlvSRCMin" UWORD DFC_OneToOne 1 100 0.00 65535.00 ECU_ADDRESS 0xD0008812 /end MEASUREMENT
/begin MEASUREMENT DFC_st.DFC_ECUOvrTemp "DFC/Status der Fehlerprüfung DFC_ECUOvrTemp" UWORD DFC_OneToOne 1 100 0.00 65535.00 ECU_ADDRESS 0xD0008814 /end MEASUREMENT
/begin MEASUREMENT DFC_st.DFC_EGRVlvGovDvtMax "DFC/Status der Fehlerprüfung DFC_EGRVlvGovDvtMax" UWORD DFC_OneToOne 1 100 0.00 65535.00 ECU_ADDRESS 0xD0008816 /end MEASUREMENT
/begin MEASUREMENT DFC_st.DFC_EGRVlvGovDvtMin "DFC/Status der Fehlerprüfung DFC_EGRVlvGovDvtMin" UWORD DFC_OneToOne 1 100 0.00 65535.00 ECU_ADDRESS 0xD0008818 /end MEASUREMENT
/begin MEASUREMENT DFC_st.DFC_EGRVlvHBrgOpnLd "DFC/Status der Fehlerprüfung DFC_EGRVlvHBrgOpnLd" UWORD DFC_OneToOne 1 100 0.00 65535.00 ECU_ADDRESS 0xD000881A /end MEASUREMENT
/begin MEASUREMENT DFC_st.DFC_EGRVlvHBrgOvrCurr "DFC/Status der Fehlerprüfung DFC_EGRVlvHBrgOvrCurr" UWORD DFC_OneToOne 1 100 0.00 65535.00 ECU_ADDRESS 0xD000881C /end MEASUREMENT
/begin MEASUREMENT DFC_st.DFC_EGRVlvHBrgOvrTemp "DFC/Status der Fehlerprüfung DFC_EGRVlvHBrgOvrTemp" UWORD DFC_OneToOne 1 100 0.00 65535.00 ECU_ADDRESS 0xD000881E /end MEASUREMENT
/begin MEASUREMENT DFC_st.DFC_EGRVlvHBrgShCirBatt1 "DFC/Status der Fehlerprüfung DFC_EGRVlvHBrgShCirBatt1" UWORD DFC_OneToOne 1 100 0.00 65535.00 ECU_ADDRESS 0xD0008820 /end MEASUREMENT
/begin MEASUREMENT DFC_st.DFC_EGRVlvHBrgShCirBatt2 "DFC/Status der Fehlerprüfung DFC_EGRVlvHBrgShCirBatt2" UWORD DFC_OneToOne 1 100 0.00 65535.00 ECU_ADDRESS 0xD0008822 /end MEASUREMENT
/begin MEASUREMENT DFC_st.DFC_EGRVlvHBrgShCirGnd1 "DFC/Status der Fehlerprüfung DFC_EGRVlvHBrgShCirGnd1" UWORD DFC_OneToOne 1 100 0.00 65535.00 ECU_ADDRESS 0xD0008824 /end MEASUREMENT
/begin MEASUREMENT DFC_st.DFC_EGRVlvHBrgShCirGnd2 "DFC/Status der Fehlerprüfung DFC_EGRVlvHBrgShCirGnd2" UWORD DFC_OneToOne 1 100 0.00 65535.00 ECU_ADDRESS 0xD0008826 /end MEASUREMENT
/begin MEASUREMENT DFC_st.DFC_EGRVlvHBrgShCirOvrLd "DFC/Status der Fehlerprüfung DFC_EGRVlvHBrgShCirOvrLd" UWORD DFC_OneToOne 1 100 0.00 65535.00 ECU_ADDRESS 0xD0008828 /end MEASUREMENT
/begin MEASUREMENT DFC_st.DFC_EGRVlvHBrgTempOvrCurr "DFC/Status der Fehlerprüfung DFC_EGRVlvHBrgTempOvrCurr" UWORD DFC_OneToOne 1 100 0.00 65535.00 ECU_ADDRESS 0xD000882A /end MEASUREMENT
/begin MEASUREMENT DFC_st.DFC_EGRVlvHBrgUndrVltg "DFC/Status der Fehlerprüfung DFC_EGRVlvHBrgUndrVltg" UWORD DFC_OneToOne 1 100 0.00 65535.00 ECU_ADDRESS 0xD000882C /end MEASUREMENT
/begin MEASUREMENT DFC_st.DFC_EGRVlvLPGovDvtMax "DFC/Status der Fehlerprüfung DFC_EGRVlvLPGovDvtMax" UWORD DFC_OneToOne 1 100 0.00 65535.00 ECU_ADDRESS 0xD000882E /end MEASUREMENT
/begin MEASUREMENT DFC_st.DFC_EGRVlvLPGovDvtMin "DFC/Status der Fehlerprüfung DFC_EGRVlvLPGovDvtMin" UWORD DFC_OneToOne 1 100 0.00 65535.00 ECU_ADDRESS 0xD0008830 /end MEASUREMENT
/begin MEASUREMENT DFC_st.DFC_EGRVlvLPHBrgOpnLd "DFC/Status der Fehlerprüfung DFC_EGRVlvLPHBrgOpnLd" UWORD DFC_OneToOne 1 100 0.00 65535.00 ECU_ADDRESS 0xD0008832 /end MEASUREMENT
/begin MEASUREMENT DFC_st.DFC_EGRVlvLPHBrgOvrCurr "DFC/Status der Fehlerprüfung DFC_EGRVlvLPHBrgOvrCurr" UWORD DFC_OneToOne 1 100 0.00 65535.00 ECU_ADDRESS 0xD0008834 /end MEASUREMENT
/begin MEASUREMENT DFC_st.DFC_EGRVlvLPHBrgOvrTemp "DFC/Status der Fehlerprüfung DFC_EGRVlvLPHBrgOvrTemp" UWORD DFC_OneToOne 1 100 0.00 65535.00 ECU_ADDRESS 0xD0008836 /end MEASUREMENT
/begin MEASUREMENT DFC_st.DFC_EGRVlvLPHBrgShCirBatt1 "DFC/Status der Fehlerprüfung DFC_EGRVlvLPHBrgShCirBatt1" UWORD DFC_OneToOne 1 100 0.00 65535.00 ECU_ADDRESS 0xD0008838 /end MEASUREMENT
/begin MEASUREMENT DFC_st.DFC_EGRVlvLPHBrgShCirBatt2 "DFC/Status der Fehlerprüfung DFC_EGRVlvLPHBrgShCirBatt2" UWORD DFC_OneToOne 1 100 0.00 65535.00 ECU_ADDRESS 0xD000883A /end MEASUREMENT
/begin MEASUREMENT DFC_st.DFC_EGRVlvLPHBrgShCirGnd1 "DFC/Status der Fehlerprüfung DFC_EGRVlvLPHBrgShCirGnd1" UWORD DFC_OneToOne 1 100 0.00 65535.00 ECU_ADDRESS 0xD000883C /end MEASUREMENT
/begin MEASUREMENT DFC_st.DFC_EGRVlvLPHBrgShCirGnd2 "DFC/Status der Fehlerprüfung DFC_EGRVlvLPHBrgShCirGnd2" UWORD DFC_OneToOne 1 100 0.00 65535.00 ECU_ADDRESS 0xD000883E /end MEASUREMENT
/begin MEASUREMENT DFC_st.DFC_EGRVlvLPHBrgShCirOvrLd "DFC/Status der Fehlerprüfung DFC_EGRVlvLPHBrgShCirOvrLd" UWORD DFC_OneToOne 1 100 0.00 65535.00 ECU_ADDRESS 0xD0008840 /end MEASUREMENT
/begin MEASUREMENT DFC_st.DFC_EGRVlvLPHBrgTempOvrCurr "DFC/Status der Fehlerprüfung DFC_EGRVlvLPHBrgTempOvrCurr" UWORD DFC_OneToOne 1 100 0.00 65535.00 ECU_ADDRESS 0xD0008842 /end MEASUREMENT
/begin MEASUREMENT DFC_st.DFC_EGRVlvLPHBrgUndrVltg "DFC/Status der Fehlerprüfung DFC_EGRVlvLPHBrgUndrVltg" UWORD DFC_OneToOne 1 100 0.00 65535.00 ECU_ADDRESS 0xD0008844 /end MEASUREMENT
/begin MEASUREMENT DFC_st.DFC_EGRVlvLPOL "DFC/Status der Fehlerprüfung DFC_EGRVlvLPOL" UWORD DFC_OneToOne 1 100 0.00 65535.00 ECU_ADDRESS 0xD0008846 /end MEASUREMENT
/begin MEASUREMENT DFC_st.DFC_EGRVlvLPSCB "DFC/Status der Fehlerprüfung DFC_EGRVlvLPSCB" UWORD DFC_OneToOne 1 100 0.00 65535.00 ECU_ADDRESS 0xD0008848 /end MEASUREMENT
/begin MEASUREMENT DFC_st.DFC_EGRVlvLPSCG "DFC/Status der Fehlerprüfung DFC_EGRVlvLPSCG" UWORD DFC_OneToOne 1 100 0.00 65535.00 ECU_ADDRESS 0xD000884A /end MEASUREMENT
/begin MEASUREMENT DFC_st.DFC_EGRVlvLPSRCMax "DFC/Status der Fehlerprüfung DFC_EGRVlvLPSRCMax" UWORD DFC_OneToOne 1 100 0.00 65535.00 ECU_ADDRESS 0xD000884C /end MEASUREMENT
/begin MEASUREMENT DFC_st.DFC_EGRVlvLPSRCMin "DFC/Status der Fehlerprüfung DFC_EGRVlvLPSRCMin" UWORD DFC_OneToOne 1 100 0.00 65535.00 ECU_ADDRESS 0xD000884E /end MEASUREMENT
/begin MEASUREMENT DFC_st.DFC_EGRVlvOL "DFC/Status der Fehlerprüfung DFC_EGRVlvOL" UWORD DFC_OneToOne 1 100 0.00 65535.00 ECU_ADDRESS 0xD0008850 /end MEASUREMENT
/begin MEASUREMENT DFC_st.DFC_EGRVlvSCB "DFC/Status der Fehlerprüfung DFC_EGRVlvSCB" UWORD DFC_OneToOne 1 100 0.00 65535.00 ECU_ADDRESS 0xD0008852 /end MEASUREMENT
/begin MEASUREMENT DFC_st.DFC_EGRVlvSCG "DFC/Status der Fehlerprüfung DFC_EGRVlvSCG" UWORD DFC_OneToOne 1 100 0.00 65535.00 ECU_ADDRESS 0xD0008854 /end MEASUREMENT
/begin MEASUREMENT DFC_st.DFC_EGRVlvSRCMax "DFC/Status der Fehlerprüfung DFC_EGRVlvSRCMax" UWORD DFC_OneToOne 1 100 0.00 65535.00 ECU_ADDRESS 0xD0008856 /end MEASUREMENT
/begin MEASUREMENT DFC_st.DFC_EGRVlvSRCMin "DFC/Status der Fehlerprüfung DFC_EGRVlvSRCMin" UWORD DFC_OneToOne 1 100 0.00 65535.00 ECU_ADDRESS 0xD0008858 /end MEASUREMENT
/begin MEASUREMENT DFC_st.DFC_EngPrtOvrSpd "DFC/Status der Fehlerprüfung DFC_EngPrtOvrSpd" UWORD DFC_OneToOne 1 100 0.00 65535.00 ECU_ADDRESS 0xD000885A /end MEASUREMENT
/begin MEASUREMENT DFC_st.DFC_EngSpdOL "DFC/Status der Fehlerprüfung DFC_EngSpdOL" UWORD DFC_OneToOne 1 100 0.00 65535.00 ECU_ADDRESS 0xD000885C /end MEASUREMENT
/begin MEASUREMENT DFC_st.DFC_EngSpdSCB "DFC/Status der Fehlerprüfung DFC_EngSpdSCB" UWORD DFC_OneToOne 1 100 0.00 65535.00 ECU_ADDRESS 0xD000885E /end MEASUREMENT
/begin MEASUREMENT DFC_st.DFC_EngSpdSCG "DFC/Status der Fehlerprüfung DFC_EngSpdSCG" UWORD DFC_OneToOne 1 100 0.00 65535.00 ECU_ADDRESS 0xD0008860 /end MEASUREMENT
/begin MEASUREMENT DFC_st.DFC_EnhSRCMaxPPFltDiff "DFC/Status der Fehlerprüfung DFC_EnhSRCMaxPPFltDiff" UWORD DFC_OneToOne 1 100 0.00 65535.00 ECU_ADDRESS 0xD0008862 /end MEASUREMENT
/begin MEASUREMENT DFC_st.DFC_EnhSRCMaxT1ExhTMon "DFC/Status der Fehlerprüfung DFC_EnhSRCMaxT1ExhTMon" UWORD DFC_OneToOne 1 100 0.00 65535.00 ECU_ADDRESS 0xD0008864 /end MEASUREMENT
/begin MEASUREMENT DFC_st.DFC_EnhSRCMaxT2ExhTMon "DFC/Status der Fehlerprüfung DFC_EnhSRCMaxT2ExhTMon" UWORD DFC_OneToOne 1 100 0.00 65535.00 ECU_ADDRESS 0xD0008866 /end MEASUREMENT
/begin MEASUREMENT DFC_st.DFC_EnhSRCMaxT3ExhTMon "DFC/Status der Fehlerprüfung DFC_EnhSRCMaxT3ExhTMon" UWORD DFC_OneToOne 1 100 0.00 65535.00 ECU_ADDRESS 0xD0008868 /end MEASUREMENT
/begin MEASUREMENT DFC_st.DFC_EnhSRCMinPPFltDiff "DFC/Status der Fehlerprüfung DFC_EnhSRCMinPPFltDiff" UWORD DFC_OneToOne 1 100 0.00 65535.00 ECU_ADDRESS 0xD000886A /end MEASUREMENT
/begin MEASUREMENT DFC_st.DFC_EnhSRCMinT1ExhTMon "DFC/Status der Fehlerprüfung DFC_EnhSRCMinT1ExhTMon" UWORD DFC_OneToOne 1 100 0.00 65535.00 ECU_ADDRESS 0xD000886C /end MEASUREMENT
/begin MEASUREMENT DFC_st.DFC_EnhSRCMinT2ExhTMon "DFC/Status der Fehlerprüfung DFC_EnhSRCMinT2ExhTMon" UWORD DFC_OneToOne 1 100 0.00 65535.00 ECU_ADDRESS 0xD000886E /end MEASUREMENT
/begin MEASUREMENT DFC_st.DFC_EnhSRCMinT3ExhTMon "DFC/Status der Fehlerprüfung DFC_EnhSRCMinT3ExhTMon" UWORD DFC_OneToOne 1 100 0.00 65535.00 ECU_ADDRESS 0xD0008870 /end MEASUREMENT
/begin MEASUREMENT DFC_st.DFC_EnvPSRCMax "DFC/Status der Fehlerprüfung DFC_EnvPSRCMax" UWORD DFC_OneToOne 1 100 0.00 65535.00 ECU_ADDRESS 0xD0008872 /end MEASUREMENT
/begin MEASUREMENT DFC_st.DFC_EnvPSRCMin "DFC/Status der Fehlerprüfung DFC_EnvPSRCMin" UWORD DFC_OneToOne 1 100 0.00 65535.00 ECU_ADDRESS 0xD0008874 /end MEASUREMENT
/begin MEASUREMENT DFC_st.DFC_ExhTMonPlaus "DFC/Status der Fehlerprüfung DFC_ExhTMonPlaus" UWORD DFC_OneToOne 1 100 0.00 65535.00 ECU_ADDRESS 0xD0008876 /end MEASUREMENT
/begin MEASUREMENT DFC_st.DFC_ExhTMonPlausPos1 "DFC/Status der Fehlerprüfung DFC_ExhTMonPlausPos1" UWORD DFC_OneToOne 1 100 0.00 65535.00 ECU_ADDRESS 0xD0008878 /end MEASUREMENT
/begin MEASUREMENT DFC_st.DFC_ExhTMonPlausPos2 "DFC/Status der Fehlerprüfung DFC_ExhTMonPlausPos2" UWORD DFC_OneToOne 1 100 0.00 65535.00 ECU_ADDRESS 0xD000887A /end MEASUREMENT
/begin MEASUREMENT DFC_st.DFC_ExhTMonPlausPos3 "DFC/Status der Fehlerprüfung DFC_ExhTMonPlausPos3" UWORD DFC_OneToOne 1 100 0.00 65535.00 ECU_ADDRESS 0xD000887C /end MEASUREMENT
/begin MEASUREMENT DFC_st.DFC_ExhTMonT1Plaus "DFC/Status der Fehlerprüfung DFC_ExhTMonT1Plaus" UWORD DFC_OneToOne 1 100 0.00 65535.00 ECU_ADDRESS 0xD000887E /end MEASUREMENT
/begin MEASUREMENT DFC_st.DFC_ExhTMonT2Plaus "DFC/Status der Fehlerprüfung DFC_ExhTMonT2Plaus" UWORD DFC_OneToOne 1 100 0.00 65535.00 ECU_ADDRESS 0xD0008880 /end MEASUREMENT
/begin MEASUREMENT DFC_st.DFC_ExhTMonT3Plaus "DFC/Status der Fehlerprüfung DFC_ExhTMonT3Plaus" UWORD DFC_OneToOne 1 100 0.00 65535.00 ECU_ADDRESS 0xD0008882 /end MEASUREMENT
/begin MEASUREMENT DFC_st.DFC_FlFltDsPSRCMax "DFC/Status der Fehlerprüfung DFC_FlFltDsPSRCMax" UWORD DFC_OneToOne 1 100 0.00 65535.00 ECU_ADDRESS 0xD0008884 /end MEASUREMENT
/begin MEASUREMENT DFC_st.DFC_FlFltDsPSRCMin "DFC/Status der Fehlerprüfung DFC_FlFltDsPSRCMin" UWORD DFC_OneToOne 1 100 0.00 65535.00 ECU_ADDRESS 0xD0008886 /end MEASUREMENT
/begin MEASUREMENT DFC_st.DFC_FlFltSig "DFC/Status der Fehlerprüfung DFC_FlFltSig" UWORD DFC_OneToOne 1 100 0.00 65535.00 ECU_ADDRESS 0xD0008888 /end MEASUREMENT
/begin MEASUREMENT DFC_st.DFC_FlFltUsPSRCMax "DFC/Status der Fehlerprüfung DFC_FlFltUsPSRCMax" UWORD DFC_OneToOne 1 100 0.00 65535.00 ECU_ADDRESS 0xD000888A /end MEASUREMENT
/begin MEASUREMENT DFC_st.DFC_FlFltUsPSRCMin "DFC/Status der Fehlerprüfung DFC_FlFltUsPSRCMin" UWORD DFC_OneToOne 1 100 0.00 65535.00 ECU_ADDRESS 0xD000888C /end MEASUREMENT
/begin MEASUREMENT DFC_st.DFC_FuelTSRCMax "DFC/Status der Fehlerprüfung DFC_FuelTSRCMax" UWORD DFC_OneToOne 1 100 0.00 65535.00 ECU_ADDRESS 0xD000888E /end MEASUREMENT
/begin MEASUREMENT DFC_st.DFC_FuelTSRCMin "DFC/Status der Fehlerprüfung DFC_FuelTSRCMin" UWORD DFC_OneToOne 1 100 0.00 65535.00 ECU_ADDRESS 0xD0008890 /end MEASUREMENT
/begin MEASUREMENT DFC_st.DFC_GbxNPosPPerSRCMax "DFC/Status der Fehlerprüfung DFC_GbxNPosPPerSRCMax" UWORD DFC_OneToOne 1 100 0.00 65535.00 ECU_ADDRESS 0xD0008892 /end MEASUREMENT
/begin MEASUREMENT DFC_st.DFC_GbxNPosPPerSRCMin "DFC/Status der Fehlerprüfung DFC_GbxNPosPPerSRCMin" UWORD DFC_OneToOne 1 100 0.00 65535.00 ECU_ADDRESS 0xD0008894 /end MEASUREMENT
/begin MEASUREMENT DFC_st.DFC_GbxNPosPdcycSRCMax "DFC/Status der Fehlerprüfung DFC_GbxNPosPdcycSRCMax" UWORD DFC_OneToOne 1 100 0.00 65535.00 ECU_ADDRESS 0xD0008896 /end MEASUREMENT
/begin MEASUREMENT DFC_st.DFC_GbxNPosPdcycSRCMin "DFC/Status der Fehlerprüfung DFC_GbxNPosPdcycSRCMin" UWORD DFC_OneToOne 1 100 0.00 65535.00 ECU_ADDRESS 0xD0008898 /end MEASUREMENT
/begin MEASUREMENT DFC_st.DFC_InjVlvPresMin "DFC/Status der Fehlerprüfung DFC_InjVlvPresMin" UWORD DFC_OneToOne 1 100 0.00 65535.00 ECU_ADDRESS 0xD000889A /end MEASUREMENT
/begin MEASUREMENT DFC_st.DFC_LSUCircNernstSig "DFC/Status der Fehlerprüfung DFC_LSUCircNernstSig" UWORD DFC_OneToOne 1 100 0.00 65535.00 ECU_ADDRESS 0xD000889C /end MEASUREMENT
/begin MEASUREMENT DFC_st.DFC_LSUCircPmpCurSig "DFC/Status der Fehlerprüfung DFC_LSUCircPmpCurSig" UWORD DFC_OneToOne 1 100 0.00 65535.00 ECU_ADDRESS 0xD000889E /end MEASUREMENT
/begin MEASUREMENT DFC_st.DFC_LSUCircVirtGndSig "DFC/Status der Fehlerprüfung DFC_LSUCircVirtGndSig" UWORD DFC_OneToOne 1 100 0.00 65535.00 ECU_ADDRESS 0xD00088A0 /end MEASUREMENT
/begin MEASUREMENT DFC_st.DFC_LSUO2Max "DFC/Status der Fehlerprüfung DFC_LSUO2Max" UWORD DFC_OneToOne 1 100 0.00 65535.00 ECU_ADDRESS 0xD00088A2 /end MEASUREMENT
/begin MEASUREMENT DFC_st.DFC_LSUO2Min "DFC/Status der Fehlerprüfung DFC_LSUO2Min" UWORD DFC_OneToOne 1 100 0.00 65535.00 ECU_ADDRESS 0xD00088A4 /end MEASUREMENT
/begin MEASUREMENT DFC_st.DFC_LSUSPIBattLowMin "DFC/Status der Fehlerprüfung DFC_LSUSPIBattLowMin" UWORD DFC_OneToOne 1 100 0.00 65535.00 ECU_ADDRESS 0xD00088A6 /end MEASUREMENT
/begin MEASUREMENT DFC_st.DFC_LSUWireSCB "DFC/Status der Fehlerprüfung DFC_LSUWireSCB" UWORD DFC_OneToOne 1 100 0.00 65535.00 ECU_ADDRESS 0xD00088A8 /end MEASUREMENT
/begin MEASUREMENT DFC_st.DFC_LSUWireSCG "DFC/Status der Fehlerprüfung DFC_LSUWireSCG" UWORD DFC_OneToOne 1 100 0.00 65535.00 ECU_ADDRESS 0xD00088AA /end MEASUREMENT
/begin MEASUREMENT DFC_st.DFC_MeUnSCG "DFC/Status der Fehlerprüfung DFC_MeUnSCG" UWORD DFC_OneToOne 1 100 0.00 65535.00 ECU_ADDRESS 0xD00088AC /end MEASUREMENT
/begin MEASUREMENT DFC_st.DFC_NSCDsCmpChk "DFC/Status der Fehlerprüfung DFC_NSCDsCmpChk" UWORD DFC_OneToOne 1 100 0.00 65535.00 ECU_ADDRESS 0xD00088AE /end MEASUREMENT
/begin MEASUREMENT DFC_st.DFC_NSCDsLamBinSRCMax "DFC/Status der Fehlerprüfung DFC_NSCDsLamBinSRCMax" UWORD DFC_OneToOne 1 100 0.00 65535.00 ECU_ADDRESS 0xD00088B0 /end MEASUREMENT
/begin MEASUREMENT DFC_st.DFC_NSCDsLamBinSRCMin "DFC/Status der Fehlerprüfung DFC_NSCDsLamBinSRCMin" UWORD DFC_OneToOne 1 100 0.00 65535.00 ECU_ADDRESS 0xD00088B2 /end MEASUREMENT
/begin MEASUREMENT DFC_st.DFC_NSCDsLamLinSRCMax "DFC/Status der Fehlerprüfung DFC_NSCDsLamLinSRCMax" UWORD DFC_OneToOne 1 100 0.00 65535.00 ECU_ADDRESS 0xD00088B4 /end MEASUREMENT
/begin MEASUREMENT DFC_st.DFC_NSCDsLamLinSRCMin "DFC/Status der Fehlerprüfung DFC_NSCDsLamLinSRCMin" UWORD DFC_OneToOne 1 100 0.00 65535.00 ECU_ADDRESS 0xD00088B6 /end MEASUREMENT
/begin MEASUREMENT DFC_st.DFC_NSCDsLamPlausMax "DFC/Status der Fehlerprüfung DFC_NSCDsLamPlausMax" UWORD DFC_OneToOne 1 100 0.00 65535.00 ECU_ADDRESS 0xD00088B8 /end MEASUREMENT
/begin MEASUREMENT DFC_st.DFC_NSCDsLamPlausMin "DFC/Status der Fehlerprüfung DFC_NSCDsLamPlausMin" UWORD DFC_OneToOne 1 100 0.00 65535.00 ECU_ADDRESS 0xD00088BA /end MEASUREMENT
/begin MEASUREMENT DFC_st.DFC_NSCDsNOxSRCMax "DFC/Status der Fehlerprüfung DFC_NSCDsNOxSRCMax" UWORD DFC_OneToOne 1 100 0.00 65535.00 ECU_ADDRESS 0xD00088BC /end MEASUREMENT
/begin MEASUREMENT DFC_st.DFC_NSCDsNOxSRCMin "DFC/Status der Fehlerprüfung DFC_NSCDsNOxSRCMin" UWORD DFC_OneToOne 1 100 0.00 65535.00 ECU_ADDRESS 0xD00088BE /end MEASUREMENT
/begin MEASUREMENT DFC_st.DFC_NSCDsOpCir "DFC/Status der Fehlerprüfung DFC_NSCDsOpCir" UWORD DFC_OneToOne 1 100 0.00 65535.00 ECU_ADDRESS 0xD00088C0 /end MEASUREMENT
/begin MEASUREMENT DFC_st.DFC_NSCDsShCir "DFC/Status der Fehlerprüfung DFC_NSCDsShCir" UWORD DFC_OneToOne 1 100 0.00 65535.00 ECU_ADDRESS 0xD00088C2 /end MEASUREMENT
/begin MEASUREMENT DFC_st.DFC_NoCat2DsCmpChk "DFC/Status der Fehlerprüfung DFC_NoCat2DsCmpChk" UWORD DFC_OneToOne 1 100 0.00 65535.00 ECU_ADDRESS 0xD00088C4 /end MEASUREMENT
/begin MEASUREMENT DFC_st.DFC_NoCat2DsLamBinSRCMax "DFC/Status der Fehlerprüfung DFC_NoCat2DsLamBinSRCMax" UWORD DFC_OneToOne 1 100 0.00 65535.00 ECU_ADDRESS 0xD00088C6 /end MEASUREMENT
/begin MEASUREMENT DFC_st.DFC_NoCat2DsLamBinSRCMin "DFC/Status der Fehlerprüfung DFC_NoCat2DsLamBinSRCMin" UWORD DFC_OneToOne 1 100 0.00 65535.00 ECU_ADDRESS 0xD00088C8 /end MEASUREMENT
/begin MEASUREMENT DFC_st.DFC_NoCat2DsLamLinSRCMax "DFC/Status der Fehlerprüfung DFC_NoCat2DsLamLinSRCMax" UWORD DFC_OneToOne 1 100 0.00 65535.00 ECU_ADDRESS 0xD00088CA /end MEASUREMENT
/begin MEASUREMENT DFC_st.DFC_NoCat2DsLamLinSRCMin "DFC/Status der Fehlerprüfung DFC_NoCat2DsLamLinSRCMin" UWORD DFC_OneToOne 1 100 0.00 65535.00 ECU_ADDRESS 0xD00088CC /end MEASUREMENT
/begin MEASUREMENT DFC_st.DFC_NoCat2DsLamPlausMax "DFC/Status der Fehlerprüfung DFC_NoCat2DsLamPlausMax" UWORD DFC_OneToOne 1 100 0.00 65535.00 ECU_ADDRESS 0xD00088CE /end MEASUREMENT
/begin MEASUREMENT DFC_st.DFC_NoCat2DsLamPlausMin "DFC/Status der Fehlerprüfung DFC_NoCat2DsLamPlausMin" UWORD DFC_OneToOne 1 100 0.00 65535.00 ECU_ADDRESS 0xD00088D0 /end MEASUREMENT
/begin MEASUREMENT DFC_st.DFC_NoCat2DsNOxSRCMax "DFC/Status der Fehlerprüfung DFC_NoCat2DsNOxSRCMax" UWORD DFC_OneToOne 1 100 0.00 65535.00 ECU_ADDRESS 0xD00088D2 /end MEASUREMENT
/begin MEASUREMENT DFC_st.DFC_NoCat2DsNOxSRCMin "DFC/Status der Fehlerprüfung DFC_NoCat2DsNOxSRCMin" UWORD DFC_OneToOne 1 100 0.00 65535.00 ECU_ADDRESS 0xD00088D4 /end MEASUREMENT
/begin MEASUREMENT DFC_st.DFC_NoCat2DsOpCir "DFC/Status der Fehlerprüfung DFC_NoCat2DsOpCir" UWORD DFC_OneToOne 1 100 0.00 65535.00 ECU_ADDRESS 0xD00088D6 /end MEASUREMENT
/begin MEASUREMENT DFC_st.DFC_NoCat2DsShCir "DFC/Status der Fehlerprüfung DFC_NoCat2DsShCir" UWORD DFC_OneToOne 1 100 0.00 65535.00 ECU_ADDRESS 0xD00088D8 /end MEASUREMENT
/begin MEASUREMENT DFC_st.DFC_NplDynPPFltDiff "DFC/Status der Fehlerprüfung DFC_NplDynPPFltDiff" UWORD DFC_OneToOne 1 100 0.00 65535.00 ECU_ADDRESS 0xD00088DA /end MEASUREMENT
/begin MEASUREMENT DFC_st.DFC_NplHsChngPPFltDiff "DFC/Status der Fehlerprüfung DFC_NplHsChngPPFltDiff" UWORD DFC_OneToOne 1 100 0.00 65535.00 ECU_ADDRESS 0xD00088DC /end MEASUREMENT
/begin MEASUREMENT DFC_st.DFC_NplHsLnPPFltDiff "DFC/Status der Fehlerprüfung DFC_NplHsLnPPFltDiff" UWORD DFC_OneToOne 1 100 0.00 65535.00 ECU_ADDRESS 0xD00088DE /end MEASUREMENT
/begin MEASUREMENT DFC_st.DFC_NplTOxiCatUs "DFC/Status der Fehlerprüfung DFC_NplTOxiCatUs" UWORD DFC_OneToOne 1 100 0.00 65535.00 ECU_ADDRESS 0xD00088E0 /end MEASUREMENT
/begin MEASUREMENT DFC_st.DFC_NplTPFltUs "DFC/Status der Fehlerprüfung DFC_NplTPFltUs" UWORD DFC_OneToOne 1 100 0.00 65535.00 ECU_ADDRESS 0xD00088E2 /end MEASUREMENT
/begin MEASUREMENT DFC_st.DFC_NplTTrbnUs "DFC/Status der Fehlerprüfung DFC_NplTTrbnUs" UWORD DFC_OneToOne 1 100 0.00 65535.00 ECU_ADDRESS 0xD00088E4 /end MEASUREMENT
/begin MEASUREMENT DFC_st.DFC_OilPSwmpSRCMax "DFC/Status der Fehlerprüfung DFC_OilPSwmpSRCMax" UWORD DFC_OneToOne 1 100 0.00 65535.00 ECU_ADDRESS 0xD00088E6 /end MEASUREMENT
/begin MEASUREMENT DFC_st.DFC_OilPSwmpSRCMin "DFC/Status der Fehlerprüfung DFC_OilPSwmpSRCMin" UWORD DFC_OneToOne 1 100 0.00 65535.00 ECU_ADDRESS 0xD00088E8 /end MEASUREMENT
/begin MEASUREMENT DFC_st.DFC_PCVSCG "DFC/Status der Fehlerprüfung DFC_PCVSCG" UWORD DFC_OneToOne 1 100 0.00 65535.00 ECU_ADDRESS 0xD00088EA /end MEASUREMENT
/begin MEASUREMENT DFC_st.DFC_PFltCharPDiffMin "DFC/Status der Fehlerprüfung DFC_PFltCharPDiffMin" UWORD DFC_OneToOne 1 100 0.00 65535.00 ECU_ADDRESS 0xD00088EC /end MEASUREMENT
/begin MEASUREMENT DFC_st.DFC_PFltDstrMin "DFC/Status der Fehlerprüfung DFC_PFltDstrMin" UWORD DFC_OneToOne 1 100 0.00 65535.00 ECU_ADDRESS 0xD00088EE /end MEASUREMENT
/begin MEASUREMENT DFC_st.DFC_PFltEngPrt "DFC/Status der Fehlerprüfung DFC_PFltEngPrt" UWORD DFC_OneToOne 1 100 0.00 65535.00 ECU_ADDRESS 0xD00088F0 /end MEASUREMENT
/begin MEASUREMENT DFC_st.DFC_PFltRgnPerm "DFC/Status der Fehlerprüfung DFC_PFltRgnPerm" UWORD DFC_OneToOne 1 100 0.00 65535.00 ECU_ADDRESS 0xD00088F2 /end MEASUREMENT
/begin MEASUREMENT DFC_st.DFC_PFltSRCMaxFlwRstn "DFC/Status der Fehlerprüfung DFC_PFltSRCMaxFlwRstn" UWORD DFC_OneToOne 1 100 0.00 65535.00 ECU_ADDRESS 0xD00088F4 /end MEASUREMENT
/begin MEASUREMENT DFC_st.DFC_PFltSRCMinFlwRstn "DFC/Status der Fehlerprüfung DFC_PFltSRCMinFlwRstn" UWORD DFC_OneToOne 1 100 0.00 65535.00 ECU_ADDRESS 0xD00088F6 /end MEASUREMENT
/begin MEASUREMENT DFC_st.DFC_PFltSotMsDvtMax "DFC/Status der Fehlerprüfung DFC_PFltSotMsDvtMax" UWORD DFC_OneToOne 1 100 0.00 65535.00 ECU_ADDRESS 0xD00088F8 /end MEASUREMENT
/begin MEASUREMENT DFC_st.DFC_PFltSotMsDvtMin "DFC/Status der Fehlerprüfung DFC_PFltSotMsDvtMin" UWORD DFC_OneToOne 1 100 0.00 65535.00 ECU_ADDRESS 0xD00088FA /end MEASUREMENT
/begin MEASUREMENT DFC_st.DFC_PFltSotMsMax "DFC/Status der Fehlerprüfung DFC_PFltSotMsMax" UWORD DFC_OneToOne 1 100 0.00 65535.00 ECU_ADDRESS 0xD00088FC /end MEASUREMENT
/begin MEASUREMENT DFC_st.DFC_PIntkVUsSRCMax "DFC/Status der Fehlerprüfung DFC_PIntkVUsSRCMax" UWORD DFC_OneToOne 1 100 0.00 65535.00 ECU_ADDRESS 0xD00088FE /end MEASUREMENT
/begin MEASUREMENT DFC_st.DFC_PIntkVUsSRCMin "DFC/Status der Fehlerprüfung DFC_PIntkVUsSRCMin" UWORD DFC_OneToOne 1 100 0.00 65535.00 ECU_ADDRESS 0xD0008900 /end MEASUREMENT
/begin MEASUREMENT DFC_st.DFC_SRCHighAPP1 "DFC/Status der Fehlerprüfung DFC_SRCHighAPP1" UWORD DFC_OneToOne 1 100 0.00 65535.00 ECU_ADDRESS 0xD0008902 /end MEASUREMENT
/begin MEASUREMENT DFC_st.DFC_SRCHighAPP2 "DFC/Status der Fehlerprüfung DFC_SRCHighAPP2" UWORD DFC_OneToOne 1 100 0.00 65535.00 ECU_ADDRESS 0xD0008904 /end MEASUREMENT
/begin MEASUREMENT DFC_st.DFC_SRCLowAPP1 "DFC/Status der Fehlerprüfung DFC_SRCLowAPP1" UWORD DFC_OneToOne 1 100 0.00 65535.00 ECU_ADDRESS 0xD0008906 /end MEASUREMENT
/begin MEASUREMENT DFC_st.DFC_SRCLowAPP2 "DFC/Status der Fehlerprüfung DFC_SRCLowAPP2" UWORD DFC_OneToOne 1 100 0.00 65535.00 ECU_ADDRESS 0xD0008908 /end MEASUREMENT
/begin MEASUREMENT DFC_st.DFC_SRCMaxPPFltDiff "DFC/Status der Fehlerprüfung DFC_SRCMaxPPFltDiff" UWORD DFC_OneToOne 1 100 0.00 65535.00 ECU_ADDRESS 0xD000890A /end MEASUREMENT
/begin MEASUREMENT DFC_st.DFC_SRCMaxPPFltUs "DFC/Status der Fehlerprüfung DFC_SRCMaxPPFltUs" UWORD DFC_OneToOne 1 100 0.00 65535.00 ECU_ADDRESS 0xD000890C /end MEASUREMENT
/begin MEASUREMENT DFC_st.DFC_SRCMaxTECU "DFC/Status der Fehlerprüfung DFC_SRCMaxTECU" UWORD DFC_OneToOne 1 100 0.00 65535.00 ECU_ADDRESS 0xD000890E /end MEASUREMENT
/begin MEASUREMENT DFC_st.DFC_SRCMaxTOxiCatUs "DFC/Status der Fehlerprüfung DFC_SRCMaxTOxiCatUs" UWORD DFC_OneToOne 1 100 0.00 65535.00 ECU_ADDRESS 0xD0008910 /end MEASUREMENT
/begin MEASUREMENT DFC_st.DFC_SRCMaxTPFltUs "DFC/Status der Fehlerprüfung DFC_SRCMaxTPFltUs" UWORD DFC_OneToOne 1 100 0.00 65535.00 ECU_ADDRESS 0xD0008912 /end MEASUREMENT
/begin MEASUREMENT DFC_st.DFC_SRCMaxTTrbnUs "DFC/Status der Fehlerprüfung DFC_SRCMaxTTrbnUs" UWORD DFC_OneToOne 1 100 0.00 65535.00 ECU_ADDRESS 0xD0008914 /end MEASUREMENT
/begin MEASUREMENT DFC_st.DFC_SRCMaxUCatUsT "DFC/Status der Fehlerprüfung DFC_SRCMaxUCatUsT" UWORD DFC_OneToOne 1 100 0.00 65535.00 ECU_ADDRESS 0xD0008916 /end MEASUREMENT
/begin MEASUREMENT DFC_st.DFC_SRCMaxUPmpP "DFC/Status der Fehlerprüfung DFC_SRCMaxUPmpP" UWORD DFC_OneToOne 1 100 0.00 65535.00 ECU_ADDRESS 0xD0008918 /end MEASUREMENT
/begin MEASUREMENT DFC_st.DFC_SRCMinPPFltDiff "DFC/Status der Fehlerprüfung DFC_SRCMinPPFltDiff" UWORD DFC_OneToOne 1 100 0.00 65535.00 ECU_ADDRESS 0xD000891A /end MEASUREMENT
/begin MEASUREMENT DFC_st.DFC_SRCMinPPFltUs "DFC/Status der Fehlerprüfung DFC_SRCMinPPFltUs" UWORD DFC_OneToOne 1 100 0.00 65535.00 ECU_ADDRESS 0xD000891C /end MEASUREMENT
/begin MEASUREMENT DFC_st.DFC_SRCMinTECU "DFC/Status der Fehlerprüfung DFC_SRCMinTECU" UWORD DFC_OneToOne 1 100 0.00 65535.00 ECU_ADDRESS 0xD000891E /end MEASUREMENT
/begin MEASUREMENT DFC_st.DFC_SRCMinTOxiCatUs "DFC/Status der Fehlerprüfung DFC_SRCMinTOxiCatUs" UWORD DFC_OneToOne 1 100 0.00 65535.00 ECU_ADDRESS 0xD0008920 /end MEASUREMENT
/begin MEASUREMENT DFC_st.DFC_SRCMinTPFltUs "DFC/Status der Fehlerprüfung DFC_SRCMinTPFltUs" UWORD DFC_OneToOne 1 100 0.00 65535.00 ECU_ADDRESS 0xD0008922 /end MEASUREMENT
/begin MEASUREMENT DFC_st.DFC_SRCMinTTrbnUs "DFC/Status der Fehlerprüfung DFC_SRCMinTTrbnUs" UWORD DFC_OneToOne 1 100 0.00 65535.00 ECU_ADDRESS 0xD0008924 /end MEASUREMENT
/begin MEASUREMENT DFC_st.DFC_SRCMinUCatUsT "DFC/Status der Fehlerprüfung DFC_SRCMinUCatUsT" UWORD DFC_OneToOne 1 100 0.00 65535.00 ECU_ADDRESS 0xD0008926 /end MEASUREMENT
/begin MEASUREMENT DFC_st.DFC_SRCMinUPmpP "DFC/Status der Fehlerprüfung DFC_SRCMinUPmpP" UWORD DFC_OneToOne 1 100 0.00 65535.00 ECU_ADDRESS 0xD0008928 /end MEASUREMENT
/begin MEASUREMENT DFC_st.DFC_SigUCatUsT "DFC/Status der Fehlerprüfung DFC_SigUCatUsT" UWORD DFC_OneToOne 1 100 0.00 65535.00 ECU_ADDRESS 0xD000892A /end MEASUREMENT
/begin MEASUREMENT DFC_st.DFC_SigUPmpP "DFC/Status der Fehlerprüfung DFC_SigUPmpP" UWORD DFC_OneToOne 1 100 0.00 65535.00 ECU_ADDRESS 0xD000892C /end MEASUREMENT
/begin MEASUREMENT DFC_st.DFC_SyncAPP "DFC/Status der Fehlerprüfung DFC_SyncAPP" UWORD DFC_OneToOne 1 100 0.00 65535.00 ECU_ADDRESS 0xD000892E /end MEASUREMENT
/begin MEASUREMENT DFC_st.DFC_T15Npl "DFC/Status der Fehlerprüfung DFC_T15Npl" UWORD DFC_OneToOne 1 100 0.00 65535.00 ECU_ADDRESS 0xD0008930 /end MEASUREMENT
/begin MEASUREMENT DFC_st.DFC_TAFSDtyCycHi "DFC/Status der Fehlerprüfung DFC_TAFSDtyCycHi" UWORD DFC_OneToOne 1 100 0.00 65535.00 ECU_ADDRESS 0xD0008932 /end MEASUREMENT
/begin MEASUREMENT DFC_st.DFC_TAFSDtyCycLo "DFC/Status der Fehlerprüfung DFC_TAFSDtyCycLo" UWORD DFC_OneToOne 1 100 0.00 65535.00 ECU_ADDRESS 0xD0008934 /end MEASUREMENT
/begin MEASUREMENT DFC_st.DFC_TAFSPerHi "DFC/Status der Fehlerprüfung DFC_TAFSPerHi" UWORD DFC_OneToOne 1 100 0.00 65535.00 ECU_ADDRESS 0xD0008936 /end MEASUREMENT
/begin MEASUREMENT DFC_st.DFC_TAFSPerLo "DFC/Status der Fehlerprüfung DFC_TAFSPerLo" UWORD DFC_OneToOne 1 100 0.00 65535.00 ECU_ADDRESS 0xD0008938 /end MEASUREMENT
/begin MEASUREMENT DFC_st.DFC_TCACDsSRCMax "DFC/Status der Fehlerprüfung DFC_TCACDsSRCMax" UWORD DFC_OneToOne 1 100 0.00 65535.00 ECU_ADDRESS 0xD000893A /end MEASUREMENT
/begin MEASUREMENT DFC_st.DFC_TCACDsSRCMin "DFC/Status der Fehlerprüfung DFC_TCACDsSRCMin" UWORD DFC_OneToOne 1 100 0.00 65535.00 ECU_ADDRESS 0xD000893C /end MEASUREMENT
/begin MEASUREMENT DFC_st.DFC_ThrVlvSRCMax "DFC/Status der Fehlerprüfung DFC_ThrVlvSRCMax" UWORD DFC_OneToOne 1 100 0.00 65535.00 ECU_ADDRESS 0xD000893E /end MEASUREMENT
/begin MEASUREMENT DFC_st.DFC_ThrVlvSRCMin "DFC/Status der Fehlerprüfung DFC_ThrVlvSRCMin" UWORD DFC_OneToOne 1 100 0.00 65535.00 ECU_ADDRESS 0xD0008940 /end MEASUREMENT
/begin MEASUREMENT DFC_st.DFC_TrbChLPOL "DFC/Status der Fehlerprüfung DFC_TrbChLPOL" UWORD DFC_OneToOne 1 100 0.00 65535.00 ECU_ADDRESS 0xD0008942 /end MEASUREMENT
/begin MEASUREMENT DFC_st.DFC_TrbChLPSCB "DFC/Status der Fehlerprüfung DFC_TrbChLPSCB" UWORD DFC_OneToOne 1 100 0.00 65535.00 ECU_ADDRESS 0xD0008944 /end MEASUREMENT
/begin MEASUREMENT DFC_st.DFC_TrbChLPSCG "DFC/Status der Fehlerprüfung DFC_TrbChLPSCG" UWORD DFC_OneToOne 1 100 0.00 65535.00 ECU_ADDRESS 0xD0008946 /end MEASUREMENT
/begin MEASUREMENT DFC_st.DFC_UHtrPLOL "DFC/Status der Fehlerprüfung DFC_UHtrPLOL" UWORD DFC_OneToOne 1 100 0.00 65535.00 ECU_ADDRESS 0xD0008948 /end MEASUREMENT
/begin MEASUREMENT DFC_st.DFC_UHtrPLSCB "DFC/Status der Fehlerprüfung DFC_UHtrPLSCB" UWORD DFC_OneToOne 1 100 0.00 65535.00 ECU_ADDRESS 0xD000894A /end MEASUREMENT
/begin MEASUREMENT DFC_st.DFC_UHtrPLSCG "DFC/Status der Fehlerprüfung DFC_UHtrPLSCG" UWORD DFC_OneToOne 1 100 0.00 65535.00 ECU_ADDRESS 0xD000894C /end MEASUREMENT
/begin MEASUREMENT DFC_st.DFC_UHtrPLSRCMaxDia "DFC/Status der Fehlerprüfung DFC_UHtrPLSRCMaxDia" UWORD DFC_OneToOne 1 100 0.00 65535.00 ECU_ADDRESS 0xD000894E /end MEASUREMENT
/begin MEASUREMENT DFC_st.DFC_UHtrPLSRCMinDia "DFC/Status der Fehlerprüfung DFC_UHtrPLSRCMinDia" UWORD DFC_OneToOne 1 100 0.00 65535.00 ECU_ADDRESS 0xD0008950 /end MEASUREMENT
/begin MEASUREMENT DFC_st.DFC_UHtrTnkOL "DFC/Status der Fehlerprüfung DFC_UHtrTnkOL" UWORD DFC_OneToOne 1 100 0.00 65535.00 ECU_ADDRESS 0xD0008952 /end MEASUREMENT
/begin MEASUREMENT DFC_st.DFC_UHtrTnkSCB "DFC/Status der Fehlerprüfung DFC_UHtrTnkSCB" UWORD DFC_OneToOne 1 100 0.00 65535.00 ECU_ADDRESS 0xD0008954 /end MEASUREMENT
/begin MEASUREMENT DFC_st.DFC_UHtrTnkSCG "DFC/Status der Fehlerprüfung DFC_UHtrTnkSCG" UWORD DFC_OneToOne 1 100 0.00 65535.00 ECU_ADDRESS 0xD0008956 /end MEASUREMENT
/begin MEASUREMENT DFC_st.DFC_UHtrTnkSRCMaxDia "DFC/Status der Fehlerprüfung DFC_UHtrTnkSRCMaxDia" UWORD DFC_OneToOne 1 100 0.00 65535.00 ECU_ADDRESS 0xD0008958 /end MEASUREMENT
/begin MEASUREMENT DFC_st.DFC_UHtrTnkSRCMinDia "DFC/Status der Fehlerprüfung DFC_UHtrTnkSRCMinDia" UWORD DFC_OneToOne 1 100 0.00 65535.00 ECU_ADDRESS 0xD000895A /end MEASUREMENT
/begin MEASUREMENT DFC_st.DFC_URevVlvOL "DFC/Status der Fehlerprüfung DFC_URevVlvOL" UWORD DFC_OneToOne 1 100 0.00 65535.00 ECU_ADDRESS 0xD000895C /end MEASUREMENT
/begin MEASUREMENT DFC_st.DFC_URevVlvSCB "DFC/Status der Fehlerprüfung DFC_URevVlvSCB" UWORD DFC_OneToOne 1 100 0.00 65535.00 ECU_ADDRESS 0xD000895E /end MEASUREMENT
/begin MEASUREMENT DFC_st.DFC_URevVlvSCG "DFC/Status der Fehlerprüfung DFC_URevVlvSCG" UWORD DFC_OneToOne 1 100 0.00 65535.00 ECU_ADDRESS 0xD0008960 /end MEASUREMENT
/begin MEASUREMENT DFC_st.DFC_UTnkTSRCMax "DFC/Status der Fehlerprüfung DFC_UTnkTSRCMax" UWORD DFC_OneToOne 1 100 0.00 65535.00 ECU_ADDRESS 0xD0008962 /end MEASUREMENT
/begin MEASUREMENT DFC_st.DFC_UTnkTSRCMin "DFC/Status der Fehlerprüfung DFC_UTnkTSRCMin" UWORD DFC_OneToOne 1 100 0.00 65535.00 ECU_ADDRESS 0xD0008964 /end MEASUREMENT
/begin MEASUREMENT DFC_st.DFC_UTnkTSig "DFC/Status der Fehlerprüfung DFC_UTnkTSig" UWORD DFC_OneToOne 1 100 0.00 65535.00 ECU_ADDRESS 0xD0008966 /end MEASUREMENT
/begin MEASUREMENT DFC_st.DFC_VSwVlvGovDvtMax "DFC/Status der Fehlerprüfung DFC_VSwVlvGovDvtMax" UWORD DFC_OneToOne 1 100 0.00 65535.00 ECU_ADDRESS 0xD0008968 /end MEASUREMENT
/begin MEASUREMENT DFC_st.DFC_VSwVlvGovDvtMin "DFC/Status der Fehlerprüfung DFC_VSwVlvGovDvtMin" UWORD DFC_OneToOne 1 100 0.00 65535.00 ECU_ADDRESS 0xD000896A /end MEASUREMENT
/begin MEASUREMENT DFC_st.DFC_VSwVlvHBrgOpnLd "DFC/Status der Fehlerprüfung DFC_VSwVlvHBrgOpnLd" UWORD DFC_OneToOne 1 100 0.00 65535.00 ECU_ADDRESS 0xD000896C /end MEASUREMENT
/begin MEASUREMENT DFC_st.DFC_VSwVlvHBrgOvrCurr "DFC/Status der Fehlerprüfung DFC_VSwVlvHBrgOvrCurr" UWORD DFC_OneToOne 1 100 0.00 65535.00 ECU_ADDRESS 0xD000896E /end MEASUREMENT
/begin MEASUREMENT DFC_st.DFC_VSwVlvHBrgOvrTemp "DFC/Status der Fehlerprüfung DFC_VSwVlvHBrgOvrTemp" UWORD DFC_OneToOne 1 100 0.00 65535.00 ECU_ADDRESS 0xD0008970 /end MEASUREMENT
/begin MEASUREMENT DFC_st.DFC_VSwVlvHBrgShCirBatt1 "DFC/Status der Fehlerprüfung DFC_VSwVlvHBrgShCirBatt1" UWORD DFC_OneToOne 1 100 0.00 65535.00 ECU_ADDRESS 0xD0008972 /end MEASUREMENT
/begin MEASUREMENT DFC_st.DFC_VSwVlvHBrgShCirBatt2 "DFC/Status der Fehlerprüfung DFC_VSwVlvHBrgShCirBatt2" UWORD DFC_OneToOne 1 100 0.00 65535.00 ECU_ADDRESS 0xD0008974 /end MEASUREMENT
/begin MEASUREMENT DFC_st.DFC_VSwVlvHBrgShCirGnd1 "DFC/Status der Fehlerprüfung DFC_VSwVlvHBrgShCirGnd1" UWORD DFC_OneToOne 1 100 0.00 65535.00 ECU_ADDRESS 0xD0008976 /end MEASUREMENT
/begin MEASUREMENT DFC_st.DFC_VSwVlvHBrgShCirGnd2 "DFC/Status der Fehlerprüfung DFC_VSwVlvHBrgShCirGnd2" UWORD DFC_OneToOne 1 100 0.00 65535.00 ECU_ADDRESS 0xD0008978 /end MEASUREMENT
/begin MEASUREMENT DFC_st.DFC_VSwVlvHBrgShCirOvrLd "DFC/Status der Fehlerprüfung DFC_VSwVlvHBrgShCirOvrLd" UWORD DFC_OneToOne 1 100 0.00 65535.00 ECU_ADDRESS 0xD000897A /end MEASUREMENT
/begin MEASUREMENT DFC_st.DFC_VSwVlvHBrgTempOvrCurr "DFC/Status der Fehlerprüfung DFC_VSwVlvHBrgTempOvrCurr" UWORD DFC_OneToOne 1 100 0.00 65535.00 ECU_ADDRESS 0xD000897C /end MEASUREMENT
/begin MEASUREMENT DFC_st.DFC_VSwVlvHBrgUndrVltg "DFC/Status der Fehlerprüfung DFC_VSwVlvHBrgUndrVltg" UWORD DFC_OneToOne 1 100 0.00 65535.00 ECU_ADDRESS 0xD000897E /end MEASUREMENT
/begin MEASUREMENT DFC_st.DFC_VSwVlvOL "DFC/Status der Fehlerprüfung DFC_VSwVlvOL" UWORD DFC_OneToOne 1 100 0.00 65535.00 ECU_ADDRESS 0xD0008980 /end MEASUREMENT
/begin MEASUREMENT DFC_st.DFC_VSwVlvSCB "DFC/Status der Fehlerprüfung DFC_VSwVlvSCB" UWORD DFC_OneToOne 1 100 0.00 65535.00 ECU_ADDRESS 0xD0008982 /end MEASUREMENT
/begin MEASUREMENT DFC_st.DFC_VSwVlvSCG "DFC/Status der Fehlerprüfung DFC_VSwVlvSCG" UWORD DFC_OneToOne 1 100 0.00 65535.00 ECU_ADDRESS 0xD0008984 /end MEASUREMENT
/begin MEASUREMENT DFC_st.DFC_VSwVlvSRCMax "DFC/Status der Fehlerprüfung DFC_VSwVlvSRCMax" UWORD DFC_OneToOne 1 100 0.00 65535.00 ECU_ADDRESS 0xD0008986 /end MEASUREMENT
/begin MEASUREMENT DFC_st.DFC_VSwVlvSRCMin "DFC/Status der Fehlerprüfung DFC_VSwVlvSRCMin" UWORD DFC_OneToOne 1 100 0.00 65535.00 ECU_ADDRESS 0xD0008988 /end MEASUREMENT
/begin MEASUREMENT DFC_st.DFC_ClthNpl "DFC/Status der Fehlerprüfung DFC_ClthNpl" UWORD DFC_OneToOne 1 100 0.00 65535.00 ECU_ADDRESS 0xD000898A /end MEASUREMENT
/begin MEASUREMENT DFC_st.DFC_ETClbETMax_0 "DFC/Status der Fehlerprüfung DFC_ETClbETMax_0" UWORD DFC_OneToOne 1 100 0.00 65535.00 ECU_ADDRESS 0xD000898C /end MEASUREMENT
/begin MEASUREMENT DFC_st.DFC_ETClbETMax_1 "DFC/Status der Fehlerprüfung DFC_ETClbETMax_1" UWORD DFC_OneToOne 1 100 0.00 65535.00 ECU_ADDRESS 0xD000898E /end MEASUREMENT
/begin MEASUREMENT DFC_st.DFC_ETClbETMax_2 "DFC/Status der Fehlerprüfung DFC_ETClbETMax_2" UWORD DFC_OneToOne 1 100 0.00 65535.00 ECU_ADDRESS 0xD0008990 /end MEASUREMENT
/begin MEASUREMENT DFC_st.DFC_ETClbETMax_3 "DFC/Status der Fehlerprüfung DFC_ETClbETMax_3" UWORD DFC_OneToOne 1 100 0.00 65535.00 ECU_ADDRESS 0xD0008992 /end MEASUREMENT
/begin MEASUREMENT DFC_st.DFC_ETClbETMax_4 "DFC/Status der Fehlerprüfung DFC_ETClbETMax_4" UWORD DFC_OneToOne 1 100 0.00 65535.00 ECU_ADDRESS 0xD0008994 /end MEASUREMENT
/begin MEASUREMENT DFC_st.DFC_ETClbETMax_5 "DFC/Status der Fehlerprüfung DFC_ETClbETMax_5" UWORD DFC_OneToOne 1 100 0.00 65535.00 ECU_ADDRESS 0xD0008996 /end MEASUREMENT
/begin MEASUREMENT DFC_st.DFC_ETClbETMin_0 "DFC/Status der Fehlerprüfung DFC_ETClbETMin_0" UWORD DFC_OneToOne 1 100 0.00 65535.00 ECU_ADDRESS 0xD0008998 /end MEASUREMENT
/begin MEASUREMENT DFC_st.DFC_ETClbETMin_1 "DFC/Status der Fehlerprüfung DFC_ETClbETMin_1" UWORD DFC_OneToOne 1 100 0.00 65535.00 ECU_ADDRESS 0xD000899A /end MEASUREMENT
/begin MEASUREMENT DFC_st.DFC_ETClbETMin_2 "DFC/Status der Fehlerprüfung DFC_ETClbETMin_2" UWORD DFC_OneToOne 1 100 0.00 65535.00 ECU_ADDRESS 0xD000899C /end MEASUREMENT
/begin MEASUREMENT DFC_st.DFC_ETClbETMin_3 "DFC/Status der Fehlerprüfung DFC_ETClbETMin_3" UWORD DFC_OneToOne 1 100 0.00 65535.00 ECU_ADDRESS 0xD000899E /end MEASUREMENT
/begin MEASUREMENT DFC_st.DFC_ETClbETMin_4 "DFC/Status der Fehlerprüfung DFC_ETClbETMin_4" UWORD DFC_OneToOne 1 100 0.00 65535.00 ECU_ADDRESS 0xD00089A0 /end MEASUREMENT
/begin MEASUREMENT DFC_st.DFC_ETClbETMin_5 "DFC/Status der Fehlerprüfung DFC_ETClbETMin_5" UWORD DFC_OneToOne 1 100 0.00 65535.00 ECU_ADDRESS 0xD00089A2 /end MEASUREMENT
/begin MEASUREMENT DFC_st.DFC_IVActrEnrgMax_0 "DFC/Status der Fehlerprüfung DFC_IVActrEnrgMax_0" UWORD DFC_OneToOne 1 100 0.00 65535.00 ECU_ADDRESS 0xD00089A4 /end MEASUREMENT
/begin MEASUREMENT DFC_st.DFC_IVActrEnrgMax_1 "DFC/Status der Fehlerprüfung DFC_IVActrEnrgMax_1" UWORD DFC_OneToOne 1 100 0.00 65535.00 ECU_ADDRESS 0xD00089A6 /end MEASUREMENT
/begin MEASUREMENT DFC_st.DFC_IVActrEnrgMax_2 "DFC/Status der Fehlerprüfung DFC_IVActrEnrgMax_2" UWORD DFC_OneToOne 1 100 0.00 65535.00 ECU_ADDRESS 0xD00089A8 /end MEASUREMENT
/begin MEASUREMENT DFC_st.DFC_IVActrEnrgMax_3 "DFC/Status der Fehlerprüfung DFC_IVActrEnrgMax_3" UWORD DFC_OneToOne 1 100 0.00 65535.00 ECU_ADDRESS 0xD00089AA /end MEASUREMENT
/begin MEASUREMENT DFC_st.DFC_IVActrEnrgMax_4 "DFC/Status der Fehlerprüfung DFC_IVActrEnrgMax_4" UWORD DFC_OneToOne 1 100 0.00 65535.00 ECU_ADDRESS 0xD00089AC /end MEASUREMENT
/begin MEASUREMENT DFC_st.DFC_IVActrEnrgMax_5 "DFC/Status der Fehlerprüfung DFC_IVActrEnrgMax_5" UWORD DFC_OneToOne 1 100 0.00 65535.00 ECU_ADDRESS 0xD00089AE /end MEASUREMENT
/begin MEASUREMENT DFC_st.DFC_IVActrEnrgMax_6 "DFC/Status der Fehlerprüfung DFC_IVActrEnrgMax_6" UWORD DFC_OneToOne 1 100 0.00 65535.00 ECU_ADDRESS 0xD00089B0 /end MEASUREMENT
/begin MEASUREMENT DFC_st.DFC_IVActrEnrgMax_7 "DFC/Status der Fehlerprüfung DFC_IVActrEnrgMax_7" UWORD DFC_OneToOne 1 100 0.00 65535.00 ECU_ADDRESS 0xD00089B2 /end MEASUREMENT
/begin MEASUREMENT DFC_st.DFC_IVActrEnrgMin_0 "DFC/Status der Fehlerprüfung DFC_IVActrEnrgMin_0" UWORD DFC_OneToOne 1 100 0.00 65535.00 ECU_ADDRESS 0xD00089B4 /end MEASUREMENT
/begin MEASUREMENT DFC_st.DFC_IVActrEnrgMin_1 "DFC/Status der Fehlerprüfung DFC_IVActrEnrgMin_1" UWORD DFC_OneToOne 1 100 0.00 65535.00 ECU_ADDRESS 0xD00089B6 /end MEASUREMENT
/begin MEASUREMENT DFC_st.DFC_IVActrEnrgMin_2 "DFC/Status der Fehlerprüfung DFC_IVActrEnrgMin_2" UWORD DFC_OneToOne 1 100 0.00 65535.00 ECU_ADDRESS 0xD00089B8 /end MEASUREMENT
/begin MEASUREMENT DFC_st.DFC_IVActrEnrgMin_3 "DFC/Status der Fehlerprüfung DFC_IVActrEnrgMin_3" UWORD DFC_OneToOne 1 100 0.00 65535.00 ECU_ADDRESS 0xD00089BA /end MEASUREMENT
/begin MEASUREMENT DFC_st.DFC_IVActrEnrgMin_4 "DFC/Status der Fehlerprüfung DFC_IVActrEnrgMin_4" UWORD DFC_OneToOne 1 100 0.00 65535.00 ECU_ADDRESS 0xD00089BC /end MEASUREMENT
/begin MEASUREMENT DFC_st.DFC_IVActrEnrgMin_5 "DFC/Status der Fehlerprüfung DFC_IVActrEnrgMin_5" UWORD DFC_OneToOne 1 100 0.00 65535.00 ECU_ADDRESS 0xD00089BE /end MEASUREMENT
/begin MEASUREMENT DFC_st.DFC_IVActrEnrgMin_6 "DFC/Status der Fehlerprüfung DFC_IVActrEnrgMin_6" UWORD DFC_OneToOne 1 100 0.00 65535.00 ECU_ADDRESS 0xD00089C0 /end MEASUREMENT
/begin MEASUREMENT DFC_st.DFC_IVActrEnrgMin_7 "DFC/Status der Fehlerprüfung DFC_IVActrEnrgMin_7" UWORD DFC_OneToOne 1 100 0.00 65535.00 ECU_ADDRESS 0xD00089C2 /end MEASUREMENT
/begin MEASUREMENT DFC_st.DFC_IVActrEnrgPlaus_0 "DFC/Status der Fehlerprüfung DFC_IVActrEnrgPlaus_0" UWORD DFC_OneToOne 1 100 0.00 65535.00 ECU_ADDRESS 0xD00089C4 /end MEASUREMENT
/begin MEASUREMENT DFC_st.DFC_IVActrEnrgPlaus_1 "DFC/Status der Fehlerprüfung DFC_IVActrEnrgPlaus_1" UWORD DFC_OneToOne 1 100 0.00 65535.00 ECU_ADDRESS 0xD00089C6 /end MEASUREMENT
/begin MEASUREMENT DFC_st.DFC_IVActrEnrgPlaus_2 "DFC/Status der Fehlerprüfung DFC_IVActrEnrgPlaus_2" UWORD DFC_OneToOne 1 100 0.00 65535.00 ECU_ADDRESS 0xD00089C8 /end MEASUREMENT
/begin MEASUREMENT DFC_st.DFC_IVActrEnrgPlaus_3 "DFC/Status der Fehlerprüfung DFC_IVActrEnrgPlaus_3" UWORD DFC_OneToOne 1 100 0.00 65535.00 ECU_ADDRESS 0xD00089CA /end MEASUREMENT
/begin MEASUREMENT DFC_st.DFC_IVActrEnrgPlaus_4 "DFC/Status der Fehlerprüfung DFC_IVActrEnrgPlaus_4" UWORD DFC_OneToOne 1 100 0.00 65535.00 ECU_ADDRESS 0xD00089CC /end MEASUREMENT
/begin MEASUREMENT DFC_st.DFC_IVActrEnrgPlaus_5 "DFC/Status der Fehlerprüfung DFC_IVActrEnrgPlaus_5" UWORD DFC_OneToOne 1 100 0.00 65535.00 ECU_ADDRESS 0xD00089CE /end MEASUREMENT
/begin MEASUREMENT DFC_st.DFC_IVActrEnrgPlaus_6 "DFC/Status der Fehlerprüfung DFC_IVActrEnrgPlaus_6" UWORD DFC_OneToOne 1 100 0.00 65535.00 ECU_ADDRESS 0xD00089D0 /end MEASUREMENT
/begin MEASUREMENT DFC_st.DFC_IVActrEnrgPlaus_7 "DFC/Status der Fehlerprüfung DFC_IVActrEnrgPlaus_7" UWORD DFC_OneToOne 1 100 0.00 65535.00 ECU_ADDRESS 0xD00089D2 /end MEASUREMENT
/begin MEASUREMENT DFC_st.DFC_IVCtlTiDiff_0 "DFC/Status der Fehlerprüfung DFC_IVCtlTiDiff_0" UWORD DFC_OneToOne 1 100 0.00 65535.00 ECU_ADDRESS 0xD00089D4 /end MEASUREMENT
/begin MEASUREMENT DFC_st.DFC_IVCtlTiDiff_1 "DFC/Status der Fehlerprüfung DFC_IVCtlTiDiff_1" UWORD DFC_OneToOne 1 100 0.00 65535.00 ECU_ADDRESS 0xD00089D6 /end MEASUREMENT
/begin MEASUREMENT DFC_st.DFC_IVCtlTiDiff_2 "DFC/Status der Fehlerprüfung DFC_IVCtlTiDiff_2" UWORD DFC_OneToOne 1 100 0.00 65535.00 ECU_ADDRESS 0xD00089D8 /end MEASUREMENT
/begin MEASUREMENT DFC_st.DFC_IVCtlTiDiff_3 "DFC/Status der Fehlerprüfung DFC_IVCtlTiDiff_3" UWORD DFC_OneToOne 1 100 0.00 65535.00 ECU_ADDRESS 0xD00089DA /end MEASUREMENT
/begin MEASUREMENT DFC_st.DFC_IVCtlTiDiff_4 "DFC/Status der Fehlerprüfung DFC_IVCtlTiDiff_4" UWORD DFC_OneToOne 1 100 0.00 65535.00 ECU_ADDRESS 0xD00089DC /end MEASUREMENT
/begin MEASUREMENT DFC_st.DFC_IVCtlTiDiff_5 "DFC/Status der Fehlerprüfung DFC_IVCtlTiDiff_5" UWORD DFC_OneToOne 1 100 0.00 65535.00 ECU_ADDRESS 0xD00089DE /end MEASUREMENT
/begin MEASUREMENT DFC_st.DFC_IVCtlUDiffUp_0 "DFC/Status der Fehlerprüfung DFC_IVCtlUDiffUp_0" UWORD DFC_OneToOne 1 100 0.00 65535.00 ECU_ADDRESS 0xD00089E0 /end MEASUREMENT
/begin MEASUREMENT DFC_st.DFC_IVCtlUDiffUp_1 "DFC/Status der Fehlerprüfung DFC_IVCtlUDiffUp_1" UWORD DFC_OneToOne 1 100 0.00 65535.00 ECU_ADDRESS 0xD00089E2 /end MEASUREMENT
/begin MEASUREMENT DFC_st.DFC_IVCtlUDiffUp_2 "DFC/Status der Fehlerprüfung DFC_IVCtlUDiffUp_2" UWORD DFC_OneToOne 1 100 0.00 65535.00 ECU_ADDRESS 0xD00089E4 /end MEASUREMENT
/begin MEASUREMENT DFC_st.DFC_IVCtlUDiffUp_3 "DFC/Status der Fehlerprüfung DFC_IVCtlUDiffUp_3" UWORD DFC_OneToOne 1 100 0.00 65535.00 ECU_ADDRESS 0xD00089E6 /end MEASUREMENT
/begin MEASUREMENT DFC_st.DFC_IVCtlUDiffUp_4 "DFC/Status der Fehlerprüfung DFC_IVCtlUDiffUp_4" UWORD DFC_OneToOne 1 100 0.00 65535.00 ECU_ADDRESS 0xD00089E8 /end MEASUREMENT
/begin MEASUREMENT DFC_st.DFC_IVCtlUDiffUp_5 "DFC/Status der Fehlerprüfung DFC_IVCtlUDiffUp_5" UWORD DFC_OneToOne 1 100 0.00 65535.00 ECU_ADDRESS 0xD00089EA /end MEASUREMENT
/begin MEASUREMENT DFC_st.DFC_IVCtlUUp_0 "DFC/Status der Fehlerprüfung DFC_IVCtlUUp_0" UWORD DFC_OneToOne 1 100 0.00 65535.00 ECU_ADDRESS 0xD00089EC /end MEASUREMENT
/begin MEASUREMENT DFC_st.DFC_IVCtlUUp_1 "DFC/Status der Fehlerprüfung DFC_IVCtlUUp_1" UWORD DFC_OneToOne 1 100 0.00 65535.00 ECU_ADDRESS 0xD00089EE /end MEASUREMENT
/begin MEASUREMENT DFC_st.DFC_IVCtlUUp_2 "DFC/Status der Fehlerprüfung DFC_IVCtlUUp_2" UWORD DFC_OneToOne 1 100 0.00 65535.00 ECU_ADDRESS 0xD00089F0 /end MEASUREMENT
/begin MEASUREMENT DFC_st.DFC_IVCtlUUp_3 "DFC/Status der Fehlerprüfung DFC_IVCtlUUp_3" UWORD DFC_OneToOne 1 100 0.00 65535.00 ECU_ADDRESS 0xD00089F2 /end MEASUREMENT
/begin MEASUREMENT DFC_st.DFC_IVCtlUUp_4 "DFC/Status der Fehlerprüfung DFC_IVCtlUUp_4" UWORD DFC_OneToOne 1 100 0.00 65535.00 ECU_ADDRESS 0xD00089F4 /end MEASUREMENT
/begin MEASUREMENT DFC_st.DFC_IVCtlUUp_5 "DFC/Status der Fehlerprüfung DFC_IVCtlUUp_5" UWORD DFC_OneToOne 1 100 0.00 65535.00 ECU_ADDRESS 0xD00089F6 /end MEASUREMENT
/begin MEASUREMENT DFC_st.DFC_IVDiaBnkShCir_0 "DFC/Status der Fehlerprüfung DFC_IVDiaBnkShCir_0" UWORD DFC_OneToOne 1 100 0.00 65535.00 ECU_ADDRESS 0xD00089F8 /end MEASUREMENT
/begin MEASUREMENT DFC_st.DFC_IVDiaBnkShCir_1 "DFC/Status der Fehlerprüfung DFC_IVDiaBnkShCir_1" UWORD DFC_OneToOne 1 100 0.00 65535.00 ECU_ADDRESS 0xD00089FA /end MEASUREMENT
/begin MEASUREMENT DFC_st.DFC_IVDiaBnkShCirChSwt_0 "DFC/Status der Fehlerprüfung DFC_IVDiaBnkShCirChSwt_0" UWORD DFC_OneToOne 1 100 0.00 65535.00 ECU_ADDRESS 0xD00089FC /end MEASUREMENT
/begin MEASUREMENT DFC_st.DFC_IVDiaBnkShCirChSwt_1 "DFC/Status der Fehlerprüfung DFC_IVDiaBnkShCirChSwt_1" UWORD DFC_OneToOne 1 100 0.00 65535.00 ECU_ADDRESS 0xD00089FE /end MEASUREMENT
/begin MEASUREMENT DFC_st.DFC_IVDiaChp_0 "DFC/Status der Fehlerprüfung DFC_IVDiaChp_0" UWORD DFC_OneToOne 1 100 0.00 65535.00 ECU_ADDRESS 0xD0008A00 /end MEASUREMENT
/begin MEASUREMENT DFC_st.DFC_IVDiaChp_1 "DFC/Status der Fehlerprüfung DFC_IVDiaChp_1" UWORD DFC_OneToOne 1 100 0.00 65535.00 ECU_ADDRESS 0xD0008A02 /end MEASUREMENT
/begin MEASUREMENT DFC_st.DFC_IVDiaCylNoCls_0 "DFC/Status der Fehlerprüfung DFC_IVDiaCylNoCls_0" UWORD DFC_OneToOne 1 100 0.00 65535.00 ECU_ADDRESS 0xD0008A04 /end MEASUREMENT
/begin MEASUREMENT DFC_st.DFC_IVDiaCylNoCls_1 "DFC/Status der Fehlerprüfung DFC_IVDiaCylNoCls_1" UWORD DFC_OneToOne 1 100 0.00 65535.00 ECU_ADDRESS 0xD0008A06 /end MEASUREMENT
/begin MEASUREMENT DFC_st.DFC_IVDiaCylNoCls_2 "DFC/Status der Fehlerprüfung DFC_IVDiaCylNoCls_2" UWORD DFC_OneToOne 1 100 0.00 65535.00 ECU_ADDRESS 0xD0008A08 /end MEASUREMENT
/begin MEASUREMENT DFC_st.DFC_IVDiaCylNoCls_3 "DFC/Status der Fehlerprüfung DFC_IVDiaCylNoCls_3" UWORD DFC_OneToOne 1 100 0.00 65535.00 ECU_ADDRESS 0xD0008A0A /end MEASUREMENT
/begin MEASUREMENT DFC_st.DFC_IVDiaCylNoCls_4 "DFC/Status der Fehlerprüfung DFC_IVDiaCylNoCls_4" UWORD DFC_OneToOne 1 100 0.00 65535.00 ECU_ADDRESS 0xD0008A0C /end MEASUREMENT
/begin MEASUREMENT DFC_st.DFC_IVDiaCylNoCls_5 "DFC/Status der Fehlerprüfung DFC_IVDiaCylNoCls_5" UWORD DFC_OneToOne 1 100 0.00 65535.00 ECU_ADDRESS 0xD0008A0E /end MEASUREMENT
/begin MEASUREMENT DFC_st.DFC_IVDiaCylNoLd_0 "DFC/Status der Fehlerprüfung DFC_IVDiaCylNoLd_0" UWORD DFC_OneToOne 1 100 0.00 65535.00 ECU_ADDRESS 0xD0008A10 /end MEASUREMENT
/begin MEASUREMENT DFC_st.DFC_IVDiaCylNoLd_1 "DFC/Status der Fehlerprüfung DFC_IVDiaCylNoLd_1" UWORD DFC_OneToOne 1 100 0.00 65535.00 ECU_ADDRESS 0xD0008A12 /end MEASUREMENT
/begin MEASUREMENT DFC_st.DFC_IVDiaCylNoLd_2 "DFC/Status der Fehlerprüfung DFC_IVDiaCylNoLd_2" UWORD DFC_OneToOne 1 100 0.00 65535.00 ECU_ADDRESS 0xD0008A14 /end MEASUREMENT
/begin MEASUREMENT DFC_st.DFC_IVDiaCylNoLd_3 "DFC/Status der Fehlerprüfung DFC_IVDiaCylNoLd_3" UWORD DFC_OneToOne 1 100 0.00 65535.00 ECU_ADDRESS 0xD0008A16 /end MEASUREMENT
/begin MEASUREMENT DFC_st.DFC_IVDiaCylNoLd_4 "DFC/Status der Fehlerprüfung DFC_IVDiaCylNoLd_4" UWORD DFC_OneToOne 1 100 0.00 65535.00 ECU_ADDRESS 0xD0008A18 /end MEASUREMENT
/begin MEASUREMENT DFC_st.DFC_IVDiaCylNoLd_5 "DFC/Status der Fehlerprüfung DFC_IVDiaCylNoLd_5" UWORD DFC_OneToOne 1 100 0.00 65535.00 ECU_ADDRESS 0xD0008A1A /end MEASUREMENT
/begin MEASUREMENT DFC_st.DFC_IVDiaCylShCir_0 "DFC/Status der Fehlerprüfung DFC_IVDiaCylShCir_0" UWORD DFC_OneToOne 1 100 0.00 65535.00 ECU_ADDRESS 0xD0008A1C /end MEASUREMENT
/begin MEASUREMENT DFC_st.DFC_IVDiaCylShCir_1 "DFC/Status der Fehlerprüfung DFC_IVDiaCylShCir_1" UWORD DFC_OneToOne 1 100 0.00 65535.00 ECU_ADDRESS 0xD0008A1E /end MEASUREMENT
/begin MEASUREMENT DFC_st.DFC_IVDiaCylShCir_2 "DFC/Status der Fehlerprüfung DFC_IVDiaCylShCir_2" UWORD DFC_OneToOne 1 100 0.00 65535.00 ECU_ADDRESS 0xD0008A20 /end MEASUREMENT
/begin MEASUREMENT DFC_st.DFC_IVDiaCylShCir_3 "DFC/Status der Fehlerprüfung DFC_IVDiaCylShCir_3" UWORD DFC_OneToOne 1 100 0.00 65535.00 ECU_ADDRESS 0xD0008A22 /end MEASUREMENT
/begin MEASUREMENT DFC_st.DFC_IVDiaCylShCir_4 "DFC/Status der Fehlerprüfung DFC_IVDiaCylShCir_4" UWORD DFC_OneToOne 1 100 0.00 65535.00 ECU_ADDRESS 0xD0008A24 /end MEASUREMENT
/begin MEASUREMENT DFC_st.DFC_IVDiaCylShCir_5 "DFC/Status der Fehlerprüfung DFC_IVDiaCylShCir_5" UWORD DFC_OneToOne 1 100 0.00 65535.00 ECU_ADDRESS 0xD0008A26 /end MEASUREMENT
/begin MEASUREMENT DFC_st.DFC_IVDiaCylShCirHSLS_0 "DFC/Status der Fehlerprüfung DFC_IVDiaCylShCirHSLS_0" UWORD DFC_OneToOne 1 100 0.00 65535.00 ECU_ADDRESS 0xD0008A28 /end MEASUREMENT
/begin MEASUREMENT DFC_st.DFC_IVDiaCylShCirHSLS_1 "DFC/Status der Fehlerprüfung DFC_IVDiaCylShCirHSLS_1" UWORD DFC_OneToOne 1 100 0.00 65535.00 ECU_ADDRESS 0xD0008A2A /end MEASUREMENT
/begin MEASUREMENT DFC_st.DFC_IVDiaCylShCirHSLS_2 "DFC/Status der Fehlerprüfung DFC_IVDiaCylShCirHSLS_2" UWORD DFC_OneToOne 1 100 0.00 65535.00 ECU_ADDRESS 0xD0008A2C /end MEASUREMENT
/begin MEASUREMENT DFC_st.DFC_IVDiaCylShCirHSLS_3 "DFC/Status der Fehlerprüfung DFC_IVDiaCylShCirHSLS_3" UWORD DFC_OneToOne 1 100 0.00 65535.00 ECU_ADDRESS 0xD0008A2E /end MEASUREMENT
/begin MEASUREMENT DFC_st.DFC_IVDiaCylShCirHSLS_4 "DFC/Status der Fehlerprüfung DFC_IVDiaCylShCirHSLS_4" UWORD DFC_OneToOne 1 100 0.00 65535.00 ECU_ADDRESS 0xD0008A30 /end MEASUREMENT
/begin MEASUREMENT DFC_st.DFC_IVDiaCylShCirHSLS_5 "DFC/Status der Fehlerprüfung DFC_IVDiaCylShCirHSLS_5" UWORD DFC_OneToOne 1 100 0.00 65535.00 ECU_ADDRESS 0xD0008A32 /end MEASUREMENT
/begin MEASUREMENT DFC_st.DFC_IVDiaCylShCirMeas_0 "DFC/Status der Fehlerprüfung DFC_IVDiaCylShCirMeas_0" UWORD DFC_OneToOne 1 100 0.00 65535.00 ECU_ADDRESS 0xD0008A34 /end MEASUREMENT
/begin MEASUREMENT DFC_st.DFC_IVDiaCylShCirMeas_1 "DFC/Status der Fehlerprüfung DFC_IVDiaCylShCirMeas_1" UWORD DFC_OneToOne 1 100 0.00 65535.00 ECU_ADDRESS 0xD0008A36 /end MEASUREMENT
/begin MEASUREMENT DFC_st.DFC_IVDiaCylShCirMeas_2 "DFC/Status der Fehlerprüfung DFC_IVDiaCylShCirMeas_2" UWORD DFC_OneToOne 1 100 0.00 65535.00 ECU_ADDRESS 0xD0008A38 /end MEASUREMENT
/begin MEASUREMENT DFC_st.DFC_IVDiaCylShCirMeas_3 "DFC/Status der Fehlerprüfung DFC_IVDiaCylShCirMeas_3" UWORD DFC_OneToOne 1 100 0.00 65535.00 ECU_ADDRESS 0xD0008A3A /end MEASUREMENT
/begin MEASUREMENT DFC_st.DFC_IVDiaCylShCirMeas_4 "DFC/Status der Fehlerprüfung DFC_IVDiaCylShCirMeas_4" UWORD DFC_OneToOne 1 100 0.00 65535.00 ECU_ADDRESS 0xD0008A3C /end MEASUREMENT
/begin MEASUREMENT DFC_st.DFC_IVDiaCylShCirMeas_5 "DFC/Status der Fehlerprüfung DFC_IVDiaCylShCirMeas_5" UWORD DFC_OneToOne 1 100 0.00 65535.00 ECU_ADDRESS 0xD0008A3E /end MEASUREMENT
/begin MEASUREMENT DFC_st.DFC_LSUDynChk "DFC/Status der Fehlerprüfung DFC_LSUDynChk" UWORD DFC_OneToOne 1 100 0.00 65535.00 ECU_ADDRESS 0xD0008A40 /end MEASUREMENT
/begin MEASUREMENT DFC_st.DFC_LSUO2ClbMax "DFC/Status der Fehlerprüfung DFC_LSUO2ClbMax" UWORD DFC_OneToOne 1 100 0.00 65535.00 ECU_ADDRESS 0xD0008A42 /end MEASUREMENT
/begin MEASUREMENT DFC_st.DFC_LSUO2ClbMin "DFC/Status der Fehlerprüfung DFC_LSUO2ClbMin" UWORD DFC_OneToOne 1 100 0.00 65535.00 ECU_ADDRESS 0xD0008A44 /end MEASUREMENT
/begin MEASUREMENT DFC_st.DFC_LSUO2PlausMaxFLd "DFC/Status der Fehlerprüfung DFC_LSUO2PlausMaxFLd" UWORD DFC_OneToOne 1 100 0.00 65535.00 ECU_ADDRESS 0xD0008A46 /end MEASUREMENT
/begin MEASUREMENT DFC_st.DFC_LSUO2PlausMaxOvrRun "DFC/Status der Fehlerprüfung DFC_LSUO2PlausMaxOvrRun" UWORD DFC_OneToOne 1 100 0.00 65535.00 ECU_ADDRESS 0xD0008A48 /end MEASUREMENT
/begin MEASUREMENT DFC_st.DFC_LSUO2PlausMaxPartLd "DFC/Status der Fehlerprüfung DFC_LSUO2PlausMaxPartLd" UWORD DFC_OneToOne 1 100 0.00 65535.00 ECU_ADDRESS 0xD0008A4A /end MEASUREMENT
/begin MEASUREMENT DFC_st.DFC_LSUO2PlausMinFLd "DFC/Status der Fehlerprüfung DFC_LSUO2PlausMinFLd" UWORD DFC_OneToOne 1 100 0.00 65535.00 ECU_ADDRESS 0xD0008A4C /end MEASUREMENT
/begin MEASUREMENT DFC_st.DFC_LSUO2PlausMinOvrRun "DFC/Status der Fehlerprüfung DFC_LSUO2PlausMinOvrRun" UWORD DFC_OneToOne 1 100 0.00 65535.00 ECU_ADDRESS 0xD0008A4E /end MEASUREMENT
/begin MEASUREMENT DFC_st.DFC_LSUO2PlausMinPartLd "DFC/Status der Fehlerprüfung DFC_LSUO2PlausMinPartLd" UWORD DFC_OneToOne 1 100 0.00 65535.00 ECU_ADDRESS 0xD0008A50 /end MEASUREMENT
/begin MEASUREMENT DFC_st.DFC_LSURiClbMax "DFC/Status der Fehlerprüfung DFC_LSURiClbMax" UWORD DFC_OneToOne 1 100 0.00 65535.00 ECU_ADDRESS 0xD0008A52 /end MEASUREMENT
/begin MEASUREMENT DFC_st.DFC_LSURiClbMin "DFC/Status der Fehlerprüfung DFC_LSURiClbMin" UWORD DFC_OneToOne 1 100 0.00 65535.00 ECU_ADDRESS 0xD0008A54 /end MEASUREMENT
/begin MEASUREMENT DFC_st.DFC_LSUWireIPSig "DFC/Status der Fehlerprüfung DFC_LSUWireIPSig" UWORD DFC_OneToOne 1 100 0.00 65535.00 ECU_ADDRESS 0xD0008A56 /end MEASUREMENT
/begin MEASUREMENT DFC_st.DFC_Layer_BSDMax "DFC/Status der Fehlerprüfung DFC_Layer_BSDMax" UWORD DFC_OneToOne 1 100 0.00 65535.00 ECU_ADDRESS 0xD0008A58 /end MEASUREMENT
/begin MEASUREMENT DFC_st.DFC_Layer_BSDMin "DFC/Status der Fehlerprüfung DFC_Layer_BSDMin" UWORD DFC_OneToOne 1 100 0.00 65535.00 ECU_ADDRESS 0xD0008A5A /end MEASUREMENT
/begin MEASUREMENT DFC_st.DFC_Layer_BSDNpl "DFC/Status der Fehlerprüfung DFC_Layer_BSDNpl" UWORD DFC_OneToOne 1 100 0.00 65535.00 ECU_ADDRESS 0xD0008A5C /end MEASUREMENT
/begin MEASUREMENT DFC_st.DFC_Layer_BSDSig "DFC/Status der Fehlerprüfung DFC_Layer_BSDSig" UWORD DFC_OneToOne 1 100 0.00 65535.00 ECU_ADDRESS 0xD0008A5E /end MEASUREMENT
/begin MEASUREMENT DFC_st.DFC_Layer_FltMngTstMax "DFC/Status der Fehlerprüfung DFC_Layer_FltMngTstMax" UWORD DFC_OneToOne 1 100 0.00 65535.00 ECU_ADDRESS 0xD0008A60 /end MEASUREMENT
/begin MEASUREMENT DFC_st.DFC_Layer_FltMngTstMin "DFC/Status der Fehlerprüfung DFC_Layer_FltMngTstMin" UWORD DFC_OneToOne 1 100 0.00 65535.00 ECU_ADDRESS 0xD0008A62 /end MEASUREMENT
/begin MEASUREMENT DFC_st.DFC_Layer_FltMngTstNpl "DFC/Status der Fehlerprüfung DFC_Layer_FltMngTstNpl" UWORD DFC_OneToOne 1 100 0.00 65535.00 ECU_ADDRESS 0xD0008A64 /end MEASUREMENT
/begin MEASUREMENT DFC_st.DFC_Layer_FltMngTstSig "DFC/Status der Fehlerprüfung DFC_Layer_FltMngTstSig" UWORD DFC_OneToOne 1 100 0.00 65535.00 ECU_ADDRESS 0xD0008A66 /end MEASUREMENT
/begin MEASUREMENT DFC_st.DFC_Layer_GENELBMax "DFC/Status der Fehlerprüfung DFC_Layer_GENELBMax" UWORD DFC_OneToOne 1 100 0.00 65535.00 ECU_ADDRESS 0xD0008A68 /end MEASUREMENT
/begin MEASUREMENT DFC_st.DFC_Layer_GENELBMin "DFC/Status der Fehlerprüfung DFC_Layer_GENELBMin" UWORD DFC_OneToOne 1 100 0.00 65535.00 ECU_ADDRESS 0xD0008A6A /end MEASUREMENT
/begin MEASUREMENT DFC_st.DFC_Layer_GENELBNpl "DFC/Status der Fehlerprüfung DFC_Layer_GENELBNpl" UWORD DFC_OneToOne 1 100 0.00 65535.00 ECU_ADDRESS 0xD0008A6C /end MEASUREMENT
/begin MEASUREMENT DFC_st.DFC_Layer_GENELBSig "DFC/Status der Fehlerprüfung DFC_Layer_GENELBSig" UWORD DFC_OneToOne 1 100 0.00 65535.00 ECU_ADDRESS 0xD0008A6E /end MEASUREMENT
/begin MEASUREMENT DFC_st.DFC_Layer_GENELMax "DFC/Status der Fehlerprüfung DFC_Layer_GENELMax" UWORD DFC_OneToOne 1 100 0.00 65535.00 ECU_ADDRESS 0xD0008A70 /end MEASUREMENT
/begin MEASUREMENT DFC_st.DFC_Layer_GENELMin "DFC/Status der Fehlerprüfung DFC_Layer_GENELMin" UWORD DFC_OneToOne 1 100 0.00 65535.00 ECU_ADDRESS 0xD0008A72 /end MEASUREMENT
/begin MEASUREMENT DFC_st.DFC_Layer_GENELNpl "DFC/Status der Fehlerprüfung DFC_Layer_GENELNpl" UWORD DFC_OneToOne 1 100 0.00 65535.00 ECU_ADDRESS 0xD0008A74 /end MEASUREMENT
/begin MEASUREMENT DFC_st.DFC_Layer_GENELSig "DFC/Status der Fehlerprüfung DFC_Layer_GENELSig" UWORD DFC_OneToOne 1 100 0.00 65535.00 ECU_ADDRESS 0xD0008A76 /end MEASUREMENT
/begin MEASUREMENT DFC_st.DFC_Layer_GENHTBMax "DFC/Status der Fehlerprüfung DFC_Layer_GENHTBMax" UWORD DFC_OneToOne 1 100 0.00 65535.00 ECU_ADDRESS 0xD0008A78 /end MEASUREMENT
/begin MEASUREMENT DFC_st.DFC_Layer_GENHTBMin "DFC/Status der Fehlerprüfung DFC_Layer_GENHTBMin" UWORD DFC_OneToOne 1 100 0.00 65535.00 ECU_ADDRESS 0xD0008A7A /end MEASUREMENT
/begin MEASUREMENT DFC_st.DFC_Layer_GENHTBNpl "DFC/Status der Fehlerprüfung DFC_Layer_GENHTBNpl" UWORD DFC_OneToOne 1 100 0.00 65535.00 ECU_ADDRESS 0xD0008A7C /end MEASUREMENT
/begin MEASUREMENT DFC_st.DFC_Layer_GENHTBSig "DFC/Status der Fehlerprüfung DFC_Layer_GENHTBSig" UWORD DFC_OneToOne 1 100 0.00 65535.00 ECU_ADDRESS 0xD0008A7E /end MEASUREMENT
/begin MEASUREMENT DFC_st.DFC_Layer_GENHTMax "DFC/Status der Fehlerprüfung DFC_Layer_GENHTMax" UWORD DFC_OneToOne 1 100 0.00 65535.00 ECU_ADDRESS 0xD0008A80 /end MEASUREMENT
/begin MEASUREMENT DFC_st.DFC_Layer_GENHTMin "DFC/Status der Fehlerprüfung DFC_Layer_GENHTMin" UWORD DFC_OneToOne 1 100 0.00 65535.00 ECU_ADDRESS 0xD0008A82 /end MEASUREMENT
/begin MEASUREMENT DFC_st.DFC_Layer_GENHTNpl "DFC/Status der Fehlerprüfung DFC_Layer_GENHTNpl" UWORD DFC_OneToOne 1 100 0.00 65535.00 ECU_ADDRESS 0xD0008A84 /end MEASUREMENT
/begin MEASUREMENT DFC_st.DFC_Layer_GENHTSig "DFC/Status der Fehlerprüfung DFC_Layer_GENHTSig" UWORD DFC_OneToOne 1 100 0.00 65535.00 ECU_ADDRESS 0xD0008A86 /end MEASUREMENT
/begin MEASUREMENT DFC_st.DFC_Layer_GENKOMMMax "DFC/Status der Fehlerprüfung DFC_Layer_GENKOMMMax" UWORD DFC_OneToOne 1 100 0.00 65535.00 ECU_ADDRESS 0xD0008A88 /end MEASUREMENT
/begin MEASUREMENT DFC_st.DFC_Layer_GENKOMMMin "DFC/Status der Fehlerprüfung DFC_Layer_GENKOMMMin" UWORD DFC_OneToOne 1 100 0.00 65535.00 ECU_ADDRESS 0xD0008A8A /end MEASUREMENT
/begin MEASUREMENT DFC_st.DFC_Layer_GENKOMMNpl "DFC/Status der Fehlerprüfung DFC_Layer_GENKOMMNpl" UWORD DFC_OneToOne 1 100 0.00 65535.00 ECU_ADDRESS 0xD0008A8C /end MEASUREMENT
/begin MEASUREMENT DFC_st.DFC_Layer_GENKOMMSig "DFC/Status der Fehlerprüfung DFC_Layer_GENKOMMSig" UWORD DFC_OneToOne 1 100 0.00 65535.00 ECU_ADDRESS 0xD0008A8E /end MEASUREMENT
/begin MEASUREMENT DFC_st.DFC_Layer_GENMECHMax "DFC/Status der Fehlerprüfung DFC_Layer_GENMECHMax" UWORD DFC_OneToOne 1 100 0.00 65535.00 ECU_ADDRESS 0xD0008A90 /end MEASUREMENT
/begin MEASUREMENT DFC_st.DFC_Layer_GENMECHMin "DFC/Status der Fehlerprüfung DFC_Layer_GENMECHMin" UWORD DFC_OneToOne 1 100 0.00 65535.00 ECU_ADDRESS 0xD0008A92 /end MEASUREMENT
/begin MEASUREMENT DFC_st.DFC_Layer_GENMECHNpl "DFC/Status der Fehlerprüfung DFC_Layer_GENMECHNpl" UWORD DFC_OneToOne 1 100 0.00 65535.00 ECU_ADDRESS 0xD0008A94 /end MEASUREMENT
/begin MEASUREMENT DFC_st.DFC_Layer_GENMECHSig "DFC/Status der Fehlerprüfung DFC_Layer_GENMECHSig" UWORD DFC_OneToOne 1 100 0.00 65535.00 ECU_ADDRESS 0xD0008A96 /end MEASUREMENT
/begin MEASUREMENT DFC_st.DFC_Layer_GENMax "DFC/Status der Fehlerprüfung DFC_Layer_GENMax" UWORD DFC_OneToOne 1 100 0.00 65535.00 ECU_ADDRESS 0xD0008A98 /end MEASUREMENT
/begin MEASUREMENT DFC_st.DFC_Layer_GENMin "DFC/Status der Fehlerprüfung DFC_Layer_GENMin" UWORD DFC_OneToOne 1 100 0.00 65535.00 ECU_ADDRESS 0xD0008A9A /end MEASUREMENT
/begin MEASUREMENT DFC_st.DFC_Layer_GENNpl "DFC/Status der Fehlerprüfung DFC_Layer_GENNpl" UWORD DFC_OneToOne 1 100 0.00 65535.00 ECU_ADDRESS 0xD0008A9C /end MEASUREMENT
/begin MEASUREMENT DFC_st.DFC_Layer_GENREGUPLMax "DFC/Status der Fehlerprüfung DFC_Layer_GENREGUPLMax" UWORD DFC_OneToOne 1 100 0.00 65535.00 ECU_ADDRESS 0xD0008A9E /end MEASUREMENT
/begin MEASUREMENT DFC_st.DFC_Layer_GENREGUPLMin "DFC/Status der Fehlerprüfung DFC_Layer_GENREGUPLMin" UWORD DFC_OneToOne 1 100 0.00 65535.00 ECU_ADDRESS 0xD0008AA0 /end MEASUREMENT
/begin MEASUREMENT DFC_st.DFC_Layer_GENREGUPLNpl "DFC/Status der Fehlerprüfung DFC_Layer_GENREGUPLNpl" UWORD DFC_OneToOne 1 100 0.00 65535.00 ECU_ADDRESS 0xD0008AA2 /end MEASUREMENT
/begin MEASUREMENT DFC_st.DFC_Layer_GENREGUPLSig "DFC/Status der Fehlerprüfung DFC_Layer_GENREGUPLSig" UWORD DFC_OneToOne 1 100 0.00 65535.00 ECU_ADDRESS 0xD0008AA4 /end MEASUREMENT
/begin MEASUREMENT DFC_st.DFC_Layer_GENSig "DFC/Status der Fehlerprüfung DFC_Layer_GENSig" UWORD DFC_OneToOne 1 100 0.00 65535.00 ECU_ADDRESS 0xD0008AA6 /end MEASUREMENT
/begin MEASUREMENT DFC_st.DFC_Layer_GENUPLMax "DFC/Status der Fehlerprüfung DFC_Layer_GENUPLMax" UWORD DFC_OneToOne 1 100 0.00 65535.00 ECU_ADDRESS 0xD0008AA8 /end MEASUREMENT
/begin MEASUREMENT DFC_st.DFC_Layer_GENUPLMin "DFC/Status der Fehlerprüfung DFC_Layer_GENUPLMin" UWORD DFC_OneToOne 1 100 0.00 65535.00 ECU_ADDRESS 0xD0008AAA /end MEASUREMENT
/begin MEASUREMENT DFC_st.DFC_Layer_GENUPLNpl "DFC/Status der Fehlerprüfung DFC_Layer_GENUPLNpl" UWORD DFC_OneToOne 1 100 0.00 65535.00 ECU_ADDRESS 0xD0008AAC /end MEASUREMENT
/begin MEASUREMENT DFC_st.DFC_Layer_GENUPLSig "DFC/Status der Fehlerprüfung DFC_Layer_GENUPLSig" UWORD DFC_OneToOne 1 100 0.00 65535.00 ECU_ADDRESS 0xD0008AAE /end MEASUREMENT
/begin MEASUREMENT DFC_st.DFC_Layer_IBS1Max "DFC/Status der Fehlerprüfung DFC_Layer_IBS1Max" UWORD DFC_OneToOne 1 100 0.00 65535.00 ECU_ADDRESS 0xD0008AB0 /end MEASUREMENT
/begin MEASUREMENT DFC_st.DFC_Layer_IBS1Min "DFC/Status der Fehlerprüfung DFC_Layer_IBS1Min" UWORD DFC_OneToOne 1 100 0.00 65535.00 ECU_ADDRESS 0xD0008AB2 /end MEASUREMENT
/begin MEASUREMENT DFC_st.DFC_Layer_IBS1Npl "DFC/Status der Fehlerprüfung DFC_Layer_IBS1Npl" UWORD DFC_OneToOne 1 100 0.00 65535.00 ECU_ADDRESS 0xD0008AB4 /end MEASUREMENT
/begin MEASUREMENT DFC_st.DFC_Layer_IBS1Sig "DFC/Status der Fehlerprüfung DFC_Layer_IBS1Sig" UWORD DFC_OneToOne 1 100 0.00 65535.00 ECU_ADDRESS 0xD0008AB6 /end MEASUREMENT
/begin MEASUREMENT DFC_st.DFC_Layer_IBS2Max "DFC/Status der Fehlerprüfung DFC_Layer_IBS2Max" UWORD DFC_OneToOne 1 100 0.00 65535.00 ECU_ADDRESS 0xD0008AB8 /end MEASUREMENT
/begin MEASUREMENT DFC_st.DFC_Layer_IBS2Min "DFC/Status der Fehlerprüfung DFC_Layer_IBS2Min" UWORD DFC_OneToOne 1 100 0.00 65535.00 ECU_ADDRESS 0xD0008ABA /end MEASUREMENT
/begin MEASUREMENT DFC_st.DFC_Layer_IBS2Npl "DFC/Status der Fehlerprüfung DFC_Layer_IBS2Npl" UWORD DFC_OneToOne 1 100 0.00 65535.00 ECU_ADDRESS 0xD0008ABC /end MEASUREMENT
/begin MEASUREMENT DFC_st.DFC_Layer_IBS2Sig "DFC/Status der Fehlerprüfung DFC_Layer_IBS2Sig" UWORD DFC_OneToOne 1 100 0.00 65535.00 ECU_ADDRESS 0xD0008ABE /end MEASUREMENT
/begin MEASUREMENT DFC_st.DFC_Layer_IBS3Max "DFC/Status der Fehlerprüfung DFC_Layer_IBS3Max" UWORD DFC_OneToOne 1 100 0.00 65535.00 ECU_ADDRESS 0xD0008AC0 /end MEASUREMENT
/begin MEASUREMENT DFC_st.DFC_Layer_IBS3Min "DFC/Status der Fehlerprüfung DFC_Layer_IBS3Min" UWORD DFC_OneToOne 1 100 0.00 65535.00 ECU_ADDRESS 0xD0008AC2 /end MEASUREMENT
/begin MEASUREMENT DFC_st.DFC_Layer_IBS3Npl "DFC/Status der Fehlerprüfung DFC_Layer_IBS3Npl" UWORD DFC_OneToOne 1 100 0.00 65535.00 ECU_ADDRESS 0xD0008AC4 /end MEASUREMENT
/begin MEASUREMENT DFC_st.DFC_Layer_IBS3Sig "DFC/Status der Fehlerprüfung DFC_Layer_IBS3Sig" UWORD DFC_OneToOne 1 100 0.00 65535.00 ECU_ADDRESS 0xD0008AC6 /end MEASUREMENT
/begin MEASUREMENT DFC_st.DFC_Layer_MANDETEKMax "DFC/Status der Fehlerprüfung DFC_Layer_MANDETEKMax" UWORD DFC_OneToOne 1 100 0.00 65535.00 ECU_ADDRESS 0xD0008AC8 /end MEASUREMENT
/begin MEASUREMENT DFC_st.DFC_Layer_MANDETEKMin "DFC/Status der Fehlerprüfung DFC_Layer_MANDETEKMin" UWORD DFC_OneToOne 1 100 0.00 65535.00 ECU_ADDRESS 0xD0008ACA /end MEASUREMENT
/begin MEASUREMENT DFC_st.DFC_Layer_MANDETEKNpl "DFC/Status der Fehlerprüfung DFC_Layer_MANDETEKNpl" UWORD DFC_OneToOne 1 100 0.00 65535.00 ECU_ADDRESS 0xD0008ACC /end MEASUREMENT
/begin MEASUREMENT DFC_st.DFC_Layer_MANDETEKSig "DFC/Status der Fehlerprüfung DFC_Layer_MANDETEKSig" UWORD DFC_OneToOne 1 100 0.00 65535.00 ECU_ADDRESS 0xD0008ACE /end MEASUREMENT
/begin MEASUREMENT DFC_st.DFC_Layer_NDR1Max "DFC/Status der Fehlerprüfung DFC_Layer_NDR1Max" UWORD DFC_OneToOne 1 100 0.00 65535.00 ECU_ADDRESS 0xD0008AD0 /end MEASUREMENT
/begin MEASUREMENT DFC_st.DFC_Layer_NDR1Min "DFC/Status der Fehlerprüfung DFC_Layer_NDR1Min" UWORD DFC_OneToOne 1 100 0.00 65535.00 ECU_ADDRESS 0xD0008AD2 /end MEASUREMENT
/begin MEASUREMENT DFC_st.DFC_Layer_NDR1Npl "DFC/Status der Fehlerprüfung DFC_Layer_NDR1Npl" UWORD DFC_OneToOne 1 100 0.00 65535.00 ECU_ADDRESS 0xD0008AD4 /end MEASUREMENT
/begin MEASUREMENT DFC_st.DFC_Layer_NDR1Sig "DFC/Status der Fehlerprüfung DFC_Layer_NDR1Sig" UWORD DFC_OneToOne 1 100 0.00 65535.00 ECU_ADDRESS 0xD0008AD6 /end MEASUREMENT
/begin MEASUREMENT DFC_st.DFC_Layer_NDR2Max "DFC/Status der Fehlerprüfung DFC_Layer_NDR2Max" UWORD DFC_OneToOne 1 100 0.00 65535.00 ECU_ADDRESS 0xD0008AD8 /end MEASUREMENT
/begin MEASUREMENT DFC_st.DFC_Layer_NDR2Min "DFC/Status der Fehlerprüfung DFC_Layer_NDR2Min" UWORD DFC_OneToOne 1 100 0.00 65535.00 ECU_ADDRESS 0xD0008ADA /end MEASUREMENT
/begin MEASUREMENT DFC_st.DFC_Layer_NDR2Npl "DFC/Status der Fehlerprüfung DFC_Layer_NDR2Npl" UWORD DFC_OneToOne 1 100 0.00 65535.00 ECU_ADDRESS 0xD0008ADC /end MEASUREMENT
/begin MEASUREMENT DFC_st.DFC_Layer_NDR2Sig "DFC/Status der Fehlerprüfung DFC_Layer_NDR2Sig" UWORD DFC_OneToOne 1 100 0.00 65535.00 ECU_ADDRESS 0xD0008ADE /end MEASUREMENT
/begin MEASUREMENT DFC_st.DFC_Layer_NGLERNMax "DFC/Status der Fehlerprüfung DFC_Layer_NGLERNMax" UWORD DFC_OneToOne 1 100 0.00 65535.00 ECU_ADDRESS 0xD0008AE0 /end MEASUREMENT
/begin MEASUREMENT DFC_st.DFC_Layer_NGLERNMin "DFC/Status der Fehlerprüfung DFC_Layer_NGLERNMin" UWORD DFC_OneToOne 1 100 0.00 65535.00 ECU_ADDRESS 0xD0008AE2 /end MEASUREMENT
/begin MEASUREMENT DFC_st.DFC_Layer_NGLERNNpl "DFC/Status der Fehlerprüfung DFC_Layer_NGLERNNpl" UWORD DFC_OneToOne 1 100 0.00 65535.00 ECU_ADDRESS 0xD0008AE4 /end MEASUREMENT
/begin MEASUREMENT DFC_st.DFC_Layer_NGLERNSig "DFC/Status der Fehlerprüfung DFC_Layer_NGLERNSig" UWORD DFC_OneToOne 1 100 0.00 65535.00 ECU_ADDRESS 0xD0008AE6 /end MEASUREMENT
/begin MEASUREMENT DFC_st.DFC_Layer_PMBATTMax "DFC/Status der Fehlerprüfung DFC_Layer_PMBATTMax" UWORD DFC_OneToOne 1 100 0.00 65535.00 ECU_ADDRESS 0xD0008AE8 /end MEASUREMENT
/begin MEASUREMENT DFC_st.DFC_Layer_PMBATTMin "DFC/Status der Fehlerprüfung DFC_Layer_PMBATTMin" UWORD DFC_OneToOne 1 100 0.00 65535.00 ECU_ADDRESS 0xD0008AEA /end MEASUREMENT
/begin MEASUREMENT DFC_st.DFC_Layer_PMBATTNpl "DFC/Status der Fehlerprüfung DFC_Layer_PMBATTNpl" UWORD DFC_OneToOne 1 100 0.00 65535.00 ECU_ADDRESS 0xD0008AEC /end MEASUREMENT
/begin MEASUREMENT DFC_st.DFC_Layer_PMBATTSig "DFC/Status der Fehlerprüfung DFC_Layer_PMBATTSig" UWORD DFC_OneToOne 1 100 0.00 65535.00 ECU_ADDRESS 0xD0008AEE /end MEASUREMENT
/begin MEASUREMENT DFC_st.DFC_Layer_PMBNMax "DFC/Status der Fehlerprüfung DFC_Layer_PMBNMax" UWORD DFC_OneToOne 1 100 0.00 65535.00 ECU_ADDRESS 0xD0008AF0 /end MEASUREMENT
/begin MEASUREMENT DFC_st.DFC_Layer_PMBNMin "DFC/Status der Fehlerprüfung DFC_Layer_PMBNMin" UWORD DFC_OneToOne 1 100 0.00 65535.00 ECU_ADDRESS 0xD0008AF2 /end MEASUREMENT
/begin MEASUREMENT DFC_st.DFC_Layer_PMBNNpl "DFC/Status der Fehlerprüfung DFC_Layer_PMBNNpl" UWORD DFC_OneToOne 1 100 0.00 65535.00 ECU_ADDRESS 0xD0008AF4 /end MEASUREMENT
/begin MEASUREMENT DFC_st.DFC_Layer_PMBNSig "DFC/Status der Fehlerprüfung DFC_Layer_PMBNSig" UWORD DFC_OneToOne 1 100 0.00 65535.00 ECU_ADDRESS 0xD0008AF6 /end MEASUREMENT
/begin MEASUREMENT DFC_st.DFC_Layer_PMRUHVERLMax "DFC/Status der Fehlerprüfung DFC_Layer_PMRUHVERLMax" UWORD DFC_OneToOne 1 100 0.00 65535.00 ECU_ADDRESS 0xD0008AF8 /end MEASUREMENT
/begin MEASUREMENT DFC_st.DFC_Layer_PMRUHVERLMin "DFC/Status der Fehlerprüfung DFC_Layer_PMRUHVERLMin" UWORD DFC_OneToOne 1 100 0.00 65535.00 ECU_ADDRESS 0xD0008AFA /end MEASUREMENT
/begin MEASUREMENT DFC_st.DFC_Layer_PMRUHVERLNpl "DFC/Status der Fehlerprüfung DFC_Layer_PMRUHVERLNpl" UWORD DFC_OneToOne 1 100 0.00 65535.00 ECU_ADDRESS 0xD0008AFC /end MEASUREMENT
/begin MEASUREMENT DFC_st.DFC_Layer_PMRUHVERLSig "DFC/Status der Fehlerprüfung DFC_Layer_PMRUHVERLSig" UWORD DFC_OneToOne 1 100 0.00 65535.00 ECU_ADDRESS 0xD0008AFE /end MEASUREMENT
/begin MEASUREMENT DFC_st.DFC_Layer_QLTMax "DFC/Status der Fehlerprüfung DFC_Layer_QLTMax" UWORD DFC_OneToOne 1 100 0.00 65535.00 ECU_ADDRESS 0xD0008B00 /end MEASUREMENT
/begin MEASUREMENT DFC_st.DFC_Layer_QLTMin "DFC/Status der Fehlerprüfung DFC_Layer_QLTMin" UWORD DFC_OneToOne 1 100 0.00 65535.00 ECU_ADDRESS 0xD0008B02 /end MEASUREMENT
/begin MEASUREMENT DFC_st.DFC_Layer_QLTNpl "DFC/Status der Fehlerprüfung DFC_Layer_QLTNpl" UWORD DFC_OneToOne 1 100 0.00 65535.00 ECU_ADDRESS 0xD0008B04 /end MEASUREMENT
/begin MEASUREMENT DFC_st.DFC_Layer_QLTSig "DFC/Status der Fehlerprüfung DFC_Layer_QLTSig" UWORD DFC_OneToOne 1 100 0.00 65535.00 ECU_ADDRESS 0xD0008B06 /end MEASUREMENT
/begin MEASUREMENT DFC_st.DFC_Layer_TOENSMax "DFC/Status der Fehlerprüfung DFC_Layer_TOENSMax" UWORD DFC_OneToOne 1 100 0.00 65535.00 ECU_ADDRESS 0xD0008B08 /end MEASUREMENT
/begin MEASUREMENT DFC_st.DFC_Layer_TOENSMin "DFC/Status der Fehlerprüfung DFC_Layer_TOENSMin" UWORD DFC_OneToOne 1 100 0.00 65535.00 ECU_ADDRESS 0xD0008B0A /end MEASUREMENT
/begin MEASUREMENT DFC_st.DFC_Layer_TOENSNpl "DFC/Status der Fehlerprüfung DFC_Layer_TOENSNpl" UWORD DFC_OneToOne 1 100 0.00 65535.00 ECU_ADDRESS 0xD0008B0C /end MEASUREMENT
/begin MEASUREMENT DFC_st.DFC_Layer_TOENSSig "DFC/Status der Fehlerprüfung DFC_Layer_TOENSSig" UWORD DFC_OneToOne 1 100 0.00 65535.00 ECU_ADDRESS 0xD0008B0E /end MEASUREMENT
/begin MEASUREMENT DFC_st.DFC_MonLimCurr "DFC/Status der Fehlerprüfung DFC_MonLimCurr" UWORD DFC_OneToOne 1 100 0.00 65535.00 ECU_ADDRESS 0xD0008B10 /end MEASUREMENT
/begin MEASUREMENT DFC_st.DFC_MonLimLead "DFC/Status der Fehlerprüfung DFC_MonLimLead" UWORD DFC_OneToOne 1 100 0.00 65535.00 ECU_ADDRESS 0xD0008B12 /end MEASUREMENT
/begin MEASUREMENT DFC_st.DFC_MonLimSet "DFC/Status der Fehlerprüfung DFC_MonLimSet" UWORD DFC_OneToOne 1 100 0.00 65535.00 ECU_ADDRESS 0xD0008B14 /end MEASUREMENT
/begin MEASUREMENT DFC_st.DFC_NSCDsNOxOfsMax "DFC/Status der Fehlerprüfung DFC_NSCDsNOxOfsMax" UWORD DFC_OneToOne 1 100 0.00 65535.00 ECU_ADDRESS 0xD0008B16 /end MEASUREMENT
/begin MEASUREMENT DFC_st.DFC_NSCDsNOxOfsMin "DFC/Status der Fehlerprüfung DFC_NSCDsNOxOfsMin" UWORD DFC_OneToOne 1 100 0.00 65535.00 ECU_ADDRESS 0xD0008B18 /end MEASUREMENT
/begin MEASUREMENT DFC_st.DFC_NSCDsNOxPlausMin "DFC/Status der Fehlerprüfung DFC_NSCDsNOxPlausMin" UWORD DFC_OneToOne 1 100 0.00 65535.00 ECU_ADDRESS 0xD0008B1A /end MEASUREMENT
/begin MEASUREMENT DFC_st.DFC_NoCat2DsNOxOfsMax "DFC/Status der Fehlerprüfung DFC_NoCat2DsNOxOfsMax" UWORD DFC_OneToOne 1 100 0.00 65535.00 ECU_ADDRESS 0xD0008B1C /end MEASUREMENT
/begin MEASUREMENT DFC_st.DFC_NoCat2DsNOxOfsMin "DFC/Status der Fehlerprüfung DFC_NoCat2DsNOxOfsMin" UWORD DFC_OneToOne 1 100 0.00 65535.00 ECU_ADDRESS 0xD0008B1E /end MEASUREMENT
/begin MEASUREMENT DFC_st.DFC_NoCat2DsNOxPlausMin "DFC/Status der Fehlerprüfung DFC_NoCat2DsNOxPlausMin" UWORD DFC_OneToOne 1 100 0.00 65535.00 ECU_ADDRESS 0xD0008B20 /end MEASUREMENT
/begin MEASUREMENT DFC_st.DFC_PCVNoStrt "DFC/Status der Fehlerprüfung DFC_PCVNoStrt" UWORD DFC_OneToOne 1 100 0.00 65535.00 ECU_ADDRESS 0xD0008B22 /end MEASUREMENT
/begin MEASUREMENT DFC_st.DFC_RailPGradMon "DFC/Status der Fehlerprüfung DFC_RailPGradMon" UWORD DFC_OneToOne 1 100 0.00 65535.00 ECU_ADDRESS 0xD0008B24 /end MEASUREMENT
/begin MEASUREMENT DFC_st.DFC_SCRPODPresBuildUp "DFC/Status der Fehlerprüfung DFC_SCRPODPresBuildUp" UWORD DFC_OneToOne 1 100 0.00 65535.00 ECU_ADDRESS 0xD0008B26 /end MEASUREMENT
/begin MEASUREMENT DFC_st.DFC_AFSDrftIdlAdjVal "DFC/Status der Fehlerprüfung DFC_AFSDrftIdlAdjVal" UWORD DFC_OneToOne 1 100 0.00 65535.00 ECU_ADDRESS 0xD0008B28 /end MEASUREMENT
/begin MEASUREMENT DFC_st.DFC_AFSDrftLdAdjVal "DFC/Status der Fehlerprüfung DFC_AFSDrftLdAdjVal" UWORD DFC_OneToOne 1 100 0.00 65535.00 ECU_ADDRESS 0xD0008B2A /end MEASUREMENT
/begin MEASUREMENT DFC_st.DFC_AdcIADC0Cal "DFC/Status der Fehlerprüfung DFC_AdcIADC0Cal" UWORD DFC_OneToOne 1 100 0.00 65535.00 ECU_ADDRESS 0xD0008B2C /end MEASUREMENT
/begin MEASUREMENT DFC_st.DFC_AdcIADC0Conv "DFC/Status der Fehlerprüfung DFC_AdcIADC0Conv" UWORD DFC_OneToOne 1 100 0.00 65535.00 ECU_ADDRESS 0xD0008B2E /end MEASUREMENT
/begin MEASUREMENT DFC_st.DFC_AdcIADC1Cal "DFC/Status der Fehlerprüfung DFC_AdcIADC1Cal" UWORD DFC_OneToOne 1 100 0.00 65535.00 ECU_ADDRESS 0xD0008B30 /end MEASUREMENT
/begin MEASUREMENT DFC_st.DFC_AdcIADC1Conv "DFC/Status der Fehlerprüfung DFC_AdcIADC1Conv" UWORD DFC_OneToOne 1 100 0.00 65535.00 ECU_ADDRESS 0xD0008B32 /end MEASUREMENT
/begin MEASUREMENT DFC_st.DFC_CmbChbMisfireMax_0 "DFC/Status der Fehlerprüfung DFC_CmbChbMisfireMax_0" UWORD DFC_OneToOne 1 100 0.00 65535.00 ECU_ADDRESS 0xD0008B34 /end MEASUREMENT
/begin MEASUREMENT DFC_st.DFC_CmbChbMisfireMax_1 "DFC/Status der Fehlerprüfung DFC_CmbChbMisfireMax_1" UWORD DFC_OneToOne 1 100 0.00 65535.00 ECU_ADDRESS 0xD0008B36 /end MEASUREMENT
/begin MEASUREMENT DFC_st.DFC_CmbChbMisfireMax_2 "DFC/Status der Fehlerprüfung DFC_CmbChbMisfireMax_2" UWORD DFC_OneToOne 1 100 0.00 65535.00 ECU_ADDRESS 0xD0008B38 /end MEASUREMENT
/begin MEASUREMENT DFC_st.DFC_CmbChbMisfireMax_3 "DFC/Status der Fehlerprüfung DFC_CmbChbMisfireMax_3" UWORD DFC_OneToOne 1 100 0.00 65535.00 ECU_ADDRESS 0xD0008B3A /end MEASUREMENT
/begin MEASUREMENT DFC_st.DFC_CmbChbMisfireMax_4 "DFC/Status der Fehlerprüfung DFC_CmbChbMisfireMax_4" UWORD DFC_OneToOne 1 100 0.00 65535.00 ECU_ADDRESS 0xD0008B3C /end MEASUREMENT
/begin MEASUREMENT DFC_st.DFC_CmbChbMisfireMax_5 "DFC/Status der Fehlerprüfung DFC_CmbChbMisfireMax_5" UWORD DFC_OneToOne 1 100 0.00 65535.00 ECU_ADDRESS 0xD0008B3E /end MEASUREMENT
/begin MEASUREMENT DFC_st.DFC_CmbChbMisfireMul "DFC/Status der Fehlerprüfung DFC_CmbChbMisfireMul" UWORD DFC_OneToOne 1 100 0.00 65535.00 ECU_ADDRESS 0xD0008B40 /end MEASUREMENT
/begin MEASUREMENT DFC_st.DFC_EGRVlvLPOfsNeutr "" UWORD DFC_OneToOne 1 100 0.00 65535.00 ECU_ADDRESS 0xD0008B42 /end MEASUREMENT
/begin MEASUREMENT DFC_st.DFC_EGRVlvOfsNeutr "DFC/Status der Fehlerprüfung DFC_EGRVlvOfsNeutr" UWORD DFC_OneToOne 1 100 0.00 65535.00 ECU_ADDRESS 0xD0008B44 /end MEASUREMENT
/begin MEASUREMENT DFC_st.DFC_FMAErrModMax "DFC/Status der Fehlerprüfung DFC_FMAErrModMax" UWORD DFC_OneToOne 1 100 0.00 65535.00 ECU_ADDRESS 0xD0008B46 /end MEASUREMENT
/begin MEASUREMENT DFC_st.DFC_FMAErrModMin "DFC/Status der Fehlerprüfung DFC_FMAErrModMin" UWORD DFC_OneToOne 1 100 0.00 65535.00 ECU_ADDRESS 0xD0008B48 /end MEASUREMENT
/begin MEASUREMENT DFC_st.DFC_FlSysTnkLo "DFC/Status der Fehlerprüfung DFC_FlSysTnkLo" UWORD DFC_OneToOne 1 100 0.00 65535.00 ECU_ADDRESS 0xD0008B4A /end MEASUREMENT
/begin MEASUREMENT DFC_st.DFC_GbxNPosPlaus "DFC/Status der Fehlerprüfung DFC_GbxNPosPlaus" UWORD DFC_OneToOne 1 100 0.00 65535.00 ECU_ADDRESS 0xD0008B4C /end MEASUREMENT
/begin MEASUREMENT DFC_st.DFC_I14229_ROETst_Appl "" UWORD DFC_OneToOne 1 100 0.00 65535.00 ECU_ADDRESS 0xD0008B4E /end MEASUREMENT
/begin MEASUREMENT DFC_st.DFC_I14229_ROETst_Netw "" UWORD DFC_OneToOne 1 100 0.00 65535.00 ECU_ADDRESS 0xD0008B50 /end MEASUREMENT
/begin MEASUREMENT DFC_st.DFC_I14229_ROE_BufFull "" UWORD DFC_OneToOne 1 100 0.00 65535.00 ECU_ADDRESS 0xD0008B52 /end MEASUREMENT
/begin MEASUREMENT DFC_st.DFC_IVAdjDiaIVAdj "DFC/Status der Fehlerprüfung DFC_IVAdjDiaIVAdj" UWORD DFC_OneToOne 1 100 0.00 65535.00 ECU_ADDRESS 0xD0008B54 /end MEASUREMENT
/begin MEASUREMENT DFC_st.DFC_IVAdjIVA_0 "DFC/Status der Fehlerprüfung DFC_IVAdjIVA_0" UWORD DFC_OneToOne 1 100 0.00 65535.00 ECU_ADDRESS 0xD0008B56 /end MEASUREMENT
/begin MEASUREMENT DFC_st.DFC_IVAdjIVA_1 "DFC/Status der Fehlerprüfung DFC_IVAdjIVA_1" UWORD DFC_OneToOne 1 100 0.00 65535.00 ECU_ADDRESS 0xD0008B58 /end MEASUREMENT
/begin MEASUREMENT DFC_st.DFC_IVAdjIVA_2 "DFC/Status der Fehlerprüfung DFC_IVAdjIVA_2" UWORD DFC_OneToOne 1 100 0.00 65535.00 ECU_ADDRESS 0xD0008B5A /end MEASUREMENT
/begin MEASUREMENT DFC_st.DFC_IVAdjIVA_3 "DFC/Status der Fehlerprüfung DFC_IVAdjIVA_3" UWORD DFC_OneToOne 1 100 0.00 65535.00 ECU_ADDRESS 0xD0008B5C /end MEASUREMENT
/begin MEASUREMENT DFC_st.DFC_IVAdjIVA_4 "DFC/Status der Fehlerprüfung DFC_IVAdjIVA_4" UWORD DFC_OneToOne 1 100 0.00 65535.00 ECU_ADDRESS 0xD0008B5E /end MEASUREMENT
/begin MEASUREMENT DFC_st.DFC_IVAdjIVA_5 "DFC/Status der Fehlerprüfung DFC_IVAdjIVA_5" UWORD DFC_OneToOne 1 100 0.00 65535.00 ECU_ADDRESS 0xD0008B60 /end MEASUREMENT
/begin MEASUREMENT DFC_st.DFC_IVPSplyDCDCOff_0 "DFC/Status der Fehlerprüfung DFC_IVPSplyDCDCOff_0" UWORD DFC_OneToOne 1 100 0.00 65535.00 ECU_ADDRESS 0xD0008B62 /end MEASUREMENT
/begin MEASUREMENT DFC_st.DFC_IVPSplyDCDCOff_1 "DFC/Status der Fehlerprüfung DFC_IVPSplyDCDCOff_1" UWORD DFC_OneToOne 1 100 0.00 65535.00 ECU_ADDRESS 0xD0008B64 /end MEASUREMENT
/begin MEASUREMENT DFC_st.DFC_IVPSplyDCDCOff_2 "DFC/Status der Fehlerprüfung DFC_IVPSplyDCDCOff_2" UWORD DFC_OneToOne 1 100 0.00 65535.00 ECU_ADDRESS 0xD0008B66 /end MEASUREMENT
/begin MEASUREMENT DFC_st.DFC_IVPSplyDCDCOff_3 "DFC/Status der Fehlerprüfung DFC_IVPSplyDCDCOff_3" UWORD DFC_OneToOne 1 100 0.00 65535.00 ECU_ADDRESS 0xD0008B68 /end MEASUREMENT
/begin MEASUREMENT DFC_st.DFC_InjCtlAdjQntEEPCS "DFC/Status der Fehlerprüfung DFC_InjCtlAdjQntEEPCS" UWORD DFC_OneToOne 1 100 0.00 65535.00 ECU_ADDRESS 0xD0008B6A /end MEASUREMENT
/begin MEASUREMENT DFC_st.DFC_LSUSPISig "DFC/Status der Fehlerprüfung DFC_LSUSPISig" UWORD DFC_OneToOne 1 100 0.00 65535.00 ECU_ADDRESS 0xD0008B6C /end MEASUREMENT
/begin MEASUREMENT DFC_st.DFC_Layer_Dummy "DFC/Status der Fehlerprüfung DFC_Layer_Dummy" UWORD DFC_OneToOne 1 100 0.00 65535.00 ECU_ADDRESS 0xD0008B6E /end MEASUREMENT
/begin MEASUREMENT DFC_st.DFC_NplEnvPSensPPFltDiff "DFC/Status der Fehlerprüfung DFC_NplEnvPSensPPFltDiff" UWORD DFC_OneToOne 1 100 0.00 65535.00 ECU_ADDRESS 0xD0008B70 /end MEASUREMENT
/begin MEASUREMENT DFC_st.DFC_NplPresSensPPFltDiff "DFC/Status der Fehlerprüfung DFC_NplPresSensPPFltDiff" UWORD DFC_OneToOne 1 100 0.00 65535.00 ECU_ADDRESS 0xD0008B72 /end MEASUREMENT
/begin MEASUREMENT DFC_st.DFC_OilLvlPlaus "DFC/Status der Fehlerprüfung DFC_OilLvlPlaus" UWORD DFC_OneToOne 1 100 0.00 65535.00 ECU_ADDRESS 0xD0008B74 /end MEASUREMENT
/begin MEASUREMENT DFC_st.DFC_OilTOutLvl "DFC/Status der Fehlerprüfung DFC_OilTOutLvl" UWORD DFC_OneToOne 1 100 0.00 65535.00 ECU_ADDRESS 0xD0008B76 /end MEASUREMENT
/begin MEASUREMENT DFC_st.DFC_PCVfacAdaptMax "DFC/Status der Fehlerprüfung DFC_PCVfacAdaptMax" UWORD DFC_OneToOne 1 100 0.00 65535.00 ECU_ADDRESS 0xD0008B78 /end MEASUREMENT
/begin MEASUREMENT DFC_st.DFC_PCVfacAdaptMin "DFC/Status der Fehlerprüfung DFC_PCVfacAdaptMin" UWORD DFC_OneToOne 1 100 0.00 65535.00 ECU_ADDRESS 0xD0008B7A /end MEASUREMENT
/begin MEASUREMENT DFC_st.DFC_SensFrzPPFltUs "DFC/Status der Fehlerprüfung DFC_SensFrzPPFltUs" UWORD DFC_OneToOne 1 100 0.00 65535.00 ECU_ADDRESS 0xD0008B7C /end MEASUREMENT
/begin MEASUREMENT DFC_st.DFC_SensMonUTnkLvl "DFC/Status der Fehlerprüfung DFC_SensMonUTnkLvl" UWORD DFC_OneToOne 1 100 0.00 65535.00 ECU_ADDRESS 0xD0008B7E /end MEASUREMENT
/begin MEASUREMENT DFC_st.DFC_T15Sig "DFC/Status der Fehlerprüfung DFC_T15Sig" UWORD DFC_OneToOne 1 100 0.00 65535.00 ECU_ADDRESS 0xD0008B80 /end MEASUREMENT
/begin MEASUREMENT DFC_st.DFC_AirCtlRmpTOut "DFC/Status der Fehlerprüfung DFC_AirCtlRmpTOut" UWORD DFC_OneToOne 1 100 0.00 65535.00 ECU_ADDRESS 0xD0008B82 /end MEASUREMENT
/begin MEASUREMENT DFC_st.DFC_BrkPPlaus "DFC/Status der Fehlerprüfung DFC_BrkPPlaus" UWORD DFC_OneToOne 1 100 0.00 65535.00 ECU_ADDRESS 0xD0008B84 /end MEASUREMENT
/begin MEASUREMENT DFC_st.DFC_CEngDsTDynTst "DFC/Status der Fehlerprüfung DFC_CEngDsTDynTst" UWORD DFC_OneToOne 1 100 0.00 65535.00 ECU_ADDRESS 0xD0008B86 /end MEASUREMENT
/begin MEASUREMENT DFC_st.DFC_EEPEraseErr "DFC/Status der Fehlerprüfung DFC_EEPEraseErr" UWORD DFC_OneToOne 1 100 0.00 65535.00 ECU_ADDRESS 0xD0008B88 /end MEASUREMENT
/begin MEASUREMENT DFC_st.DFC_EEPRdErr "DFC/Status der Fehlerprüfung DFC_EEPRdErr" UWORD DFC_OneToOne 1 100 0.00 65535.00 ECU_ADDRESS 0xD0008B8A /end MEASUREMENT
/begin MEASUREMENT DFC_st.DFC_EEPWrErr "DFC/Status der Fehlerprüfung DFC_EEPWrErr" UWORD DFC_OneToOne 1 100 0.00 65535.00 ECU_ADDRESS 0xD0008B8C /end MEASUREMENT
/begin MEASUREMENT DFC_st.DFC_EGRVlvJamVlvClsd "DFC/Status der Fehlerprüfung DFC_EGRVlvJamVlvClsd" UWORD DFC_OneToOne 1 100 0.00 65535.00 ECU_ADDRESS 0xD0008B8E /end MEASUREMENT
/begin MEASUREMENT DFC_st.DFC_EGRVlvJamVlvOpn "DFC/Status der Fehlerprüfung DFC_EGRVlvJamVlvOpn" UWORD DFC_OneToOne 1 100 0.00 65535.00 ECU_ADDRESS 0xD0008B90 /end MEASUREMENT
/begin MEASUREMENT DFC_st.DFC_EGRVlvLPJamVlvClsd "DFC/Status der Fehlerprüfung DFC_EGRVlvLPJamVlvClsd" UWORD DFC_OneToOne 1 100 0.00 65535.00 ECU_ADDRESS 0xD0008B92 /end MEASUREMENT
/begin MEASUREMENT DFC_st.DFC_EGRVlvLPJamVlvOpn "DFC/Status der Fehlerprüfung DFC_EGRVlvLPJamVlvOpn" UWORD DFC_OneToOne 1 100 0.00 65535.00 ECU_ADDRESS 0xD0008B94 /end MEASUREMENT
/begin MEASUREMENT DFC_st.DFC_EGRVlvLPLgTDrft "DFC/Status der Fehlerprüfung DFC_EGRVlvLPLgTDrft" UWORD DFC_OneToOne 1 100 0.00 65535.00 ECU_ADDRESS 0xD0008B96 /end MEASUREMENT
/begin MEASUREMENT DFC_st.DFC_EGRVlvLPOfsLrnJamVlv "DFC/Status der Fehlerprüfung DFC_EGRVlvLPOfsLrnJamVlv" UWORD DFC_OneToOne 1 100 0.00 65535.00 ECU_ADDRESS 0xD0008B98 /end MEASUREMENT
/begin MEASUREMENT DSM_stMIL "" SWORD TrqPrp 1 100 -52428.80 52427.20 ECU_ADDRESS 0xD00008C0 /end MEASUREMENT
/begin MEASUREMENT DSM_stRdyAB "" UBYTE OneToOne 1 100 0.00 255.0 ECU_ADDRESS 0xD0001DCE /end MEASUREMENT
/begin MEASUREMENT DSM_stRdyCD "" UBYTE OneToOne 1 100 0.00 255.0 ECU_ADDRESS 0xD0001DCF /end MEASUREMENT
/begin MEASUREMENT DSM_stSVS "" SWORD TrqPrp 1 100 -52428.80 52427.20 ECU_ADDRESS 0xD00008C2 /end MEASUREMENT
/begin MEASUREMENT EGRVlv_rB1 "Sollwert aus dem ASW ( fÃ¿r Bank1 in zweiflutigem System)." UBYTE default 1 100 0.00 255.0 FORMAT "%5.1" ECU_ADDRESS 0xD0000912 /end MEASUREMENT
/begin MEASUREMENT EGRVlv_rB2 "Sollwert aus dem ASW ( fÃ¿r Bank2 in zweiflutigem System)." UBYTE default 1 100 0.00 255.0 FORMAT "%5.1" ECU_ADDRESS 0xD0000914 /end MEASUREMENT
/begin MEASUREMENT Exh_pAdapPPFltUsB1 "" UBYTE default 1 100 0.00 255.0 FORMAT "%5.1" ECU_ADDRESS 0xD0000A0C /end MEASUREMENT
/begin MEASUREMENT Exh_pAdapPPFltUsB2 "" UBYTE default 1 100 0.00 255.0 FORMAT "%5.1" ECU_ADDRESS 0xD0000A0E /end MEASUREMENT
/begin MEASUREMENT Exh_pTrbnUs "" SWORD Pres_hPa 1 100 -32768.00 3500.00 ECU_ADDRESS 0xD0000A40 /end MEASUREMENT
/begin MEASUREMENT Exh_tAdapTOxiCatDs "" SWORD Temp_Cels 1 100 -3549.940 3003.560 ECU_ADDRESS 0xD0000A76 /end MEASUREMENT
/begin MEASUREMENT Exh_tNoCat2Ds "" SWORD nox 1 100 -32768.00 32767.00 FORMAT "%8.2" ECU_ADDRESS 0xD0000A9A /end MEASUREMENT
/begin MEASUREMENT Exh_tNSCDs "" SWORD nox 1 100 -32768.00 32767.00 FORMAT "%8.2" ECU_ADDRESS 0xD0000A98 /end MEASUREMENT
/begin MEASUREMENT Exh_tOxiCatDs "" SWORD Temp_Cels 1 100 -3549.940 3003.560 ECU_ADDRESS 0xD0000A9C /end MEASUREMENT
/begin MEASUREMENT Exh_tPFltDs "" SWORD Temp_Cels 1 100 -3549.940 3003.560 ECU_ADDRESS 0xD0000AA0 /end MEASUREMENT
/begin MEASUREMENT FlFCBS_mskFlLPCSelfRec "" UBYTE OneToOne 1 100 0.00 255.0 ECU_ADDRESS 0xD0001E3D /end MEASUREMENT
/begin MEASUREMENT Fl_volTnkQnt "" SWORD Fl_Half_L 1 100 -16384.00 16383.50 FORMAT "%8.2" ECU_ADDRESS 0xD0000B20 /end MEASUREMENT
/begin MEASUREMENT GlwLmp_st "Glühlampenansteuerung" UBYTE OneToOne 1 100 0.00 255.0 ECU_ADDRESS 0xD0001E70 /end MEASUREMENT
/begin MEASUREMENT NSCLd_mNOxFld "" SLONG Ms_SOxNOx 1 100 -21474.8364800 21474.8364700 FORMAT "%13.7" ARRAY_SIZE 10 ECU_ADDRESS 0xD0002F38 /end MEASUREMENT
/begin MEASUREMENT Oil_lSwmp "Ölstand" SWORD OneToOne 1 100 -32768.00 32767.00 ECU_ADDRESS 0xD0001106 /end MEASUREMENT
/begin MEASUREMENT Oil_tSwmp "Öltemperatur" SWORD Temp_Cels 1 100 -3549.940 3003.560 ECU_ADDRESS 0xD00003E6 /end MEASUREMENT
/begin MEASUREMENT PCBS_stPFltActv "" UBYTE OneToOne 1 100 0.00 255.0 ECU_ADDRESS 0xD0001FFB /end MEASUREMENT
/begin MEASUREMENT PFltLd_stAshCorRgnMax "" UBYTE OneToOne 1 100 0.00 255.0 ECU_ADDRESS 0xD000202F /end MEASUREMENT
/begin MEASUREMENT SCR_tUPmpT "" SWORD Temp_Cels 1 100 -3549.940 3003.560 ECU_ADDRESS 0xD000136C /end MEASUREMENT
/begin MEASUREMENT SilFlp_st "" UBYTE OneToOne 1 100 0.00 255.0 ECU_ADDRESS 0xD0002569 /end MEASUREMENT
/begin MEASUREMENT SilFlp_stPs "" UBYTE OneToOne 1 100 0.00 255.0 ECU_ADDRESS 0xD000256A /end MEASUREMENT
/begin MEASUREMENT Sil_stLogic "" UWORD OneToOne 1 100 0.00 65535.00 ECU_ADDRESS 0xD0001658 /end MEASUREMENT
/begin MEASUREMENT ThrVlv_rB1 "" UBYTE default 1 100 0.00 255.0 FORMAT "%5.1" ECU_ADDRESS 0xD00013F0 /end MEASUREMENT
/begin MEASUREMENT ThrVlv_rB2 "" UBYTE default 1 100 0.00 255.0 FORMAT "%5.1" ECU_ADDRESS 0xD00013F2 /end MEASUREMENT
/begin MEASUREMENT TrbCh_rB1 "" UBYTE default 1 100 0.00 255.0 FORMAT "%5.1" ECU_ADDRESS 0xD0001426 /end MEASUREMENT
/begin MEASUREMENT TrbCh_rB2 "" UBYTE default 1 100 0.00 255.0 FORMAT "%5.1" ECU_ADDRESS 0xD0001428 /end MEASUREMENT
/begin MEASUREMENT WaHtEl_st "" UBYTE OneToOne 1 100 0.00 255.0 ARRAY_SIZE 2 ECU_ADDRESS 0xD00025BF /end MEASUREMENT
/begin MEASUREMENT WaHtFl_st "" UBYTE OneToOne 1 100 0.00 255.0 ECU_ADDRESS 0xD00025C1 /end MEASUREMENT
/begin FUNCTION DewDet_HtrRls ""
 /begin DEF_CHARACTERISTIC DewDet_cpGs_C DewDet_dmPlsThresLSUSrvTst_CA DewDet_dmPlsThresLSU_CA DewDet_facCldStrtLSU_CA DewDet_facPlsLSUSrvTst_CA DewDet_facPlsLSU_CA DewDet_facPlsThresLSU_CA DewDet_facThresNoSftyFac_CA DewDet_numEngTempStrt_C DewDet_numLSU_CA DewDet_numMaxCldStrt_CA DewDet_numPlsSrvTst_CA DewDet_numTempThresLSU_CA DewDet_swtDewDetShOff_CA DewDet_tiDebLSU_CA DewDet_tiDebRunTransOk_C DewDet_tiHtgDelLSU_CA DewDet_tiMSAStop_C DewDet_tIntegIniSrvTst_CA DewDet_tIntegIni_CA DewDet_tiPlsLSUSrvTst_CA DewDet_tiPlsLSU_CA DewDet_tThresLSUActSrvTst_CA DewDet_tThresLSUAct_CA DewDet_tThresLSU_C DewDet_tWtEquiv_CA DewDet_wLSUIKi_CA DewDet_wThresLSU0_MAP DewDet_wThresLSU1_MAP /end DEF_CHARACTERISTIC
 /begin IN_MEASUREMENT Air_tAFS ASMod_dmExhMnfDs ASMod_tEGFld ASMod_tWallFld CoEng_st CoES_stAVSCoLSU EngDa_tFld EnvT_t /end IN_MEASUREMENT
 /begin OUT_MEASUREMENT DewDet_stHtgLSU /end OUT_MEASUREMENT
 /begin LOC_MEASUREMENT DewDet_ctCldStrtLSU_mp DewDet_ctPlsLSUSrvTst_mp DewDet_dwLSU_mp DewDet_stDewDetTstDem_mp DewDet_stEEPWrite_mp DewDet_stHtgLSULstTrp_mp DewDet_stHtgThresLSUHit_mp DewDet_stIntegIni_mp DewDet_stMSAStopActv_mp DewDet_stPlsLSU_mp DewDet_tEGLSUInpCrv0_mp DewDet_tEGLSUInpCrv1_mp DewDet_tEG_mp DewDet_tEngStrt_mp DewDet_tWall_mp DewDet_wLSU_mp DewDet_wThresLSUAct_mp DewDet_wThresLSUNoPls_mp DewDet_wThresLSUPls_mp DewDet_wThresLSU_mp /end LOC_MEASUREMENT
/end FUNCTION
/begin FUNCTION DE_Adapt "" /begin IN_MEASUREMENT Air_dtTCACDs Air_tAFS Air_tCACDs /end IN_MEASUREMENT
 /begin OUT_MEASUREMENT AFST_t AFS_stDrftB1 AFS_stDrftB2 AirC_pClnt AirC_rClgDem AirC_stHtrSwt ASMod_qCor CACDsT_dt CACDsT_t CEngUsT_t Com_pAbsUPmpP Com_rUTnkLvl Com_stSVSReq Com_tUCatDsT Com_tUCatUsT Com_tUTnkT DSM_stMIL DSM_stRdyAB DSM_stRdyCD DSM_stSVS EGRVlv_rB1 EGRVlv_rB2 Exh_pAdapPPFltUsB1 Exh_pAdapPPFltUsB2 Exh_pTrbnUs Exh_tAdapTOxiCatDs Exh_tNoCat2Ds Exh_tNSCDs Exh_tOxiCatDs Exh_tPFltDs FlFCBS_mskFlLPCSelfRec GlwLmp_st NSCLd_mNOxFld Oil_lSwmp Oil_tSwmp PCBS_stPFltActv PFltLd_stAshCorRgnMax SCR_tUPmpT SilFlp_st SilFlp_stPs Sil_stLogic ThrVlv_rB1 ThrVlv_rB2 TrbCh_rB1 TrbCh_rB2 WaHtEl_st WaHtFl_st /end OUT_MEASUREMENT
 /begin LOC_MEASUREMENT Fl_volTnkQnt /end LOC_MEASUREMENT
/end FUNCTION
/begin FUNCTION DFC ""
 /begin OUT_MEASUREMENT DFC_st.DFC_Unused DFC_st.DFC_ACCIPlausDrvAst DFC_st.DFC_ACCIPlausTrqDes DFC_st.DFC_AirCtlGovDvtEOMMax DFC_st.DFC_AirCtlGovDvtEOMMin DFC_st.DFC_AirCtlGovDvtMax DFC_st.DFC_AirCtlGovDvtMin DFC_st.DFC_AirCtlGovLPDvtMax DFC_st.DFC_AirCtlGovLPDvtMin DFC_st.DFC_AltIOComErr DFC_st.DFC_AltIOComNpl DFC_st.DFC_BusDiagBusOffFlexRay DFC_st.DFC_BusDiagBusOffNodeA DFC_st.DFC_BusDiagBusOffNodeB DFC_st.DFC_BusDiagBusOffNodeC DFC_st.DFC_BusDiagHwFlexRay DFC_st.DFC_Cj945SpiCom1 DFC_st.DFC_ComACDemandSig_FA DFC_st.DFC_ComACDemandTo_FA DFC_st.DFC_ComATempSig_FA DFC_st.DFC_ComATempTo_FA DFC_st.DFC_ComATempTo_FX DFC_st.DFC_ComBrkTrqSumChk_FX DFC_st.DFC_ComBrkTrqSumCtr_FX DFC_st.DFC_ComBrkTrqSumTo_FX DFC_st.DFC_ComBtnDrvDynChk_FX DFC_st.DFC_ComBtnDrvDynCtr_FX DFC_st.DFC_ComBtnDrvDynTo_FX DFC_st.DFC_ComButtonMSASig DFC_st.DFC_ComButtonMSATo DFC_st.DFC_ComCodierungPwrmngSig DFC_st.DFC_ComCodierungPwrmngSig_FA DFC_st.DFC_ComCrCtlLvrChk DFC_st.DFC_ComCrCtlLvrCtr DFC_st.DFC_ComCrCtlLvrSig DFC_st.DFC_ComCrCtlLvrTo DFC_st.DFC_ComCtrCrshSwoEkpSig_FA DFC_st.DFC_ComCtrCrshSwoEkpTo_FA DFC_st.DFC_ComCtrSecInt DFC_st.DFC_ComDiaOBDGbxSig_A DFC_st.DFC_ComDiaOBDGbxTo_A DFC_st.DFC_ComFahrzeugtypSig DFC_st.DFC_ComFahrzeugtypSig_FA DFC_st.DFC_ComFllupGpwsupSig_FA DFC_st.DFC_ComFllupGpwsupTo_FA DFC_st.DFC_ComGbxDataChk_A DFC_st.DFC_ComGbxDataChk_FA DFC_st.DFC_ComGbxDataCtr_A DFC_st.DFC_ComGbxDataCtr_FA DFC_st.DFC_ComGbxDataSig_A DFC_st.DFC_ComGbxDataSig_FA DFC_st.DFC_ComGbxDataTo_A DFC_st.DFC_ComGbxDataTo_FA DFC_st.DFC_ComKlemmenChk_FA DFC_st.DFC_ComKlemmenCtr_FA DFC_st.DFC_ComKlemmenSig_FA DFC_st.DFC_ComKlemmenTo_FA DFC_st.DFC_ComLenkradwinkelSig DFC_st.DFC_ComLenkradwinkelTo DFC_st.DFC_ComMileageRangeSig_FA DFC_st.DFC_ComMileageRangeTo_FA DFC_st.DFC_ComPspSig DFC_st.DFC_ComPspTo DFC_st.DFC_ComRelTimeSig_FA DFC_st.DFC_ComRelTimeTo_FA DFC_st.DFC_ComRequestEMFChk DFC_st.DFC_ComRequestEMFCtr DFC_st.DFC_ComRequestEMFSig DFC_st.DFC_ComRequestEMFTo DFC_st.DFC_ComRpmWhlChk_FX DFC_st.DFC_ComRpmWhlCtr_FX DFC_st.DFC_ComRpmWhlTo_FX DFC_st.DFC_ComSecCtrRelSig_FA DFC_st.DFC_ComSecCtrRelTo_FA DFC_st.DFC_ComSensNOxGndSig DFC_st.DFC_ComSensNOxGndTo DFC_st.DFC_ComSensNOxMode DFC_st.DFC_ComSensNOxUbattSig DFC_st.DFC_ComSensNOxUbattTo DFC_st.DFC_ComShiftPaddleTo_FX DFC_st.DFC_ComShutOffPSPSig DFC_st.DFC_ComShutOffPSPTo DFC_st.DFC_ComSlrdiGlbFZMTo_FA DFC_st.DFC_ComSlrdiGlbFZMTo_FX DFC_st.DFC_ComSpeedVehicleChk_FX DFC_st.DFC_ComSpeedVehicleCtr_FX DFC_st.DFC_ComSpeedVehicleTo_FX DFC_st.DFC_ComStConintDSCChk_FX DFC_st.DFC_ComStConintDSCCtr_FX DFC_st.DFC_ComStConintDSCTo_FX DFC_st.DFC_ComStatACFrontSig_FA DFC_st.DFC_ComStatACFrontTo_FA DFC_st.DFC_ComStatEkpSig_A DFC_st.DFC_ComStatEkpTo_A DFC_st.DFC_ComStatGearRevSig_FA DFC_st.DFC_ComStatGearRevTo_FA DFC_st.DFC_ComStatZVKlappenSig_FA DFC_st.DFC_ComStatZVKlappenTo_FA DFC_st.DFC_ComStateARSCtr DFC_st.DFC_ComStateARSSig DFC_st.DFC_ComStateARSTo DFC_st.DFC_ComStateDscSig DFC_st.DFC_ComStateDscTo DFC_st.DFC_ComStateSeatSig DFC_st.DFC_ComStateSeatSig_FA DFC_st.DFC_ComStateSeatTo DFC_st.DFC_ComStateSeatTo_FA DFC_st.DFC_ComStatusEGSSig_A DFC_st.DFC_ComStatusEGSSig_FA DFC_st.DFC_ComStatusEGSTo_A DFC_st.DFC_ComStatusEGSTo_FA DFC_st.DFC_ComStatusEMFChk DFC_st.DFC_ComStatusEMFCtr DFC_st.DFC_ComStatusEMFSig DFC_st.DFC_ComStatusEMFTo DFC_st.DFC_ComStatusRGangSig DFC_st.DFC_ComStatusRGangTo DFC_st.DFC_ComSteeringAngleChk_FX DFC_st.DFC_ComSteeringAngleCtr_FX DFC_st.DFC_ComSteeringAngleTo_FX DFC_st.DFC_ComTerminalChk DFC_st.DFC_ComTerminalCtr DFC_st.DFC_ComTerminalSig DFC_st.DFC_ComTerminalTo DFC_st.DFC_ComTimeDateSig_FA DFC_st.DFC_ComTimeDateTo_FA DFC_st.DFC_ComTrailerSig DFC_st.DFC_ComTrailerSig_FA DFC_st.DFC_ComTrailerTo DFC_st.DFC_ComTrailerTo_FA DFC_st.DFC_ComTrqDemCrshDrDyChk_FX DFC_st.DFC_ComTrqDemCrshDrDyCtr_FX DFC_st.DFC_ComTrqDemCrshDrDyTo_FX DFC_st.DFC_ComTrqDemandDesSig DFC_st.DFC_ComTrqDemandDesTo DFC_st.DFC_ComTrqDemandDscChk DFC_st.DFC_ComTrqDemandDscCtr DFC_st.DFC_ComTrqDemandDscSig DFC_st.DFC_ComTrqDemandDscTo DFC_st.DFC_ComTrqDemandGbxChk_A DFC_st.DFC_ComTrqDemandGbxChk_FA DFC_st.DFC_ComTrqDemandGbxCtr_A DFC_st.DFC_ComTrqDemandGbxCtr_FA DFC_st.DFC_ComTrqDemandGbxSig_A DFC_st.DFC_ComTrqDemandGbxSig_FA DFC_st.DFC_ComTrqDemandGbxTo_A DFC_st.DFC_ComTrqDemandGbxTo_FA DFC_st.DFC_ComTrqWhlDemChk DFC_st.DFC_ComTrqWhlDemCtr DFC_st.DFC_ComTrqWhlDemFASChk_FX DFC_st.DFC_ComTrqWhlDemFASCtr_FX DFC_st.DFC_ComTrqWhlDemFASTo_FX DFC_st.DFC_ComTrqWhlDemSig DFC_st.DFC_ComTrqWhlDemTo DFC_st.DFC_ComVelocityChk_FA DFC_st.DFC_ComVelocityCtr_FA DFC_st.DFC_ComVelocitySig DFC_st.DFC_ComVelocitySig_FA DFC_st.DFC_ComVelocityTo DFC_st.DFC_ComVelocityTo_FA DFC_st.DFC_ComVerbraucherTo DFC_st.DFC_ComWMomPTStabChk_FX DFC_st.DFC_ComWMomPTStabCtr_FX DFC_st.DFC_ComWMomPTStabTo_FX DFC_st.DFC_ComWheelSpeedSig DFC_st.DFC_ComWheelSpeedTo DFC_st.DFC_ComZvKlappenSig DFC_st.DFC_ComZvKlappenTo DFC_st.DFC_ComaDirectChk_FX DFC_st.DFC_ComaDirectCtr_FX DFC_st.DFC_ComaDirectTo_FX DFC_st.DFC_ComaSideChk_FX DFC_st.DFC_ComaSideCtr_FX DFC_st.DFC_ComaSideTo_FX DFC_st.DFC_Cy320SpiCom DFC_st.DFC_ETCtlDvtInrMax DFC_st.DFC_ETCtlDvtInrMin DFC_st.DFC_ETCtlDvtOutrMax DFC_st.DFC_ETCtlDvtOutrMin DFC_st.DFC_FBCqDvtMax DFC_st.DFC_FBCqDvtMin DFC_st.DFC_Fan4WinErr1 DFC_st.DFC_Fan4WinErr2 DFC_st.DFC_Fan4WinErr3 DFC_st.DFC_Fan4WinErr4 DFC_st.DFC_FanSCG DFC_st.DFC_FlFCBS DFC_st.DFC_GlwEcuConfigErr DFC_st.DFC_GlwEcuEepErr DFC_st.DFC_GlwEcuFrmErr DFC_st.DFC_GlwEcuGPCMFaultInfo DFC_st.DFC_GlwEcuGPCMInfo DFC_st.DFC_GlwEcuGk1HSS DFC_st.DFC_GlwEcuGk1OL DFC_st.DFC_GlwEcuGk1SC DFC_st.DFC_GlwEcuGk1Wdst DFC_st.DFC_GlwEcuGk2HSS DFC_st.DFC_GlwEcuGk2OL DFC_st.DFC_GlwEcuGk2SC DFC_st.DFC_GlwEcuGk2Wdst DFC_st.DFC_GlwEcuGk3HSS DFC_st.DFC_GlwEcuGk3OL DFC_st.DFC_GlwEcuGk3SC DFC_st.DFC_GlwEcuGk3Wdst DFC_st.DFC_GlwEcuGk4HSS DFC_st.DFC_GlwEcuGk4OL DFC_st.DFC_GlwEcuGk4SC DFC_st.DFC_GlwEcuGk4Wdst DFC_st.DFC_GlwEcuGk5HSS DFC_st.DFC_GlwEcuGk5OL DFC_st.DFC_GlwEcuGk5SC DFC_st.DFC_GlwEcuGk5Wdst DFC_st.DFC_GlwEcuGk6HSS DFC_st.DFC_GlwEcuGk6OL DFC_st.DFC_GlwEcuGk6SC DFC_st.DFC_GlwEcuGk6Wdst DFC_st.DFC_GlwEcuGndErr DFC_st.DFC_GlwEcuIntErr DFC_st.DFC_GlwEcuMsgTimeout DFC_st.DFC_GlwEcuT30Err DFC_st.DFC_GlwEcuTempErr DFC_st.DFC_GlwEcuUdiffT30 DFC_st.DFC_IBSComErr DFC_st.DFC_LubSRCOilFldtCrit DFC_st.DFC_LubSRCOilFldtCritDflMin DFC_st.DFC_LubSRCOilLvlCritMax DFC_st.DFC_LubSRCOilLvlCritMin DFC_st.DFC_LubSRCTot DFC_st.DFC_MonUMaxSupply1 DFC_st.DFC_MonUMinSupply1 DFC_st.DFC_OilComNpl DFC_st.DFC_PCBS DFC_st.DFC_PCBSPFltChg DFC_st.DFC_PCRGovDvtLPMax DFC_st.DFC_PCRGovDvtLPMin DFC_st.DFC_PCRGovDvtMax DFC_st.DFC_PCRGovDvtMin DFC_st.DFC_PFltAPSPlausMAX DFC_st.DFC_PFltAPSPlausMIN DFC_st.DFC_PFltBPSPlausMAX DFC_st.DFC_PFltBPSPlausMIN DFC_st.DFC_PFltOvldInhRgn DFC_st.DFC_PFltOvldTrqLim DFC_st.DFC_PFltPresPlausMAX DFC_st.DFC_PFltPresPlausMIN DFC_st.DFC_PFltTraRpmRdc DFC_st.DFC_PFlt_tOxiPreMax DFC_st.DFC_PFlt_tOxiPreMaxRgn DFC_st.DFC_PFlt_tOxiPreNpl DFC_st.DFC_PFlt_tPreMax DFC_st.DFC_PFlt_tPreMaxRgn DFC_st.DFC_PFlt_tPreNpl DFC_st.DFC_PFltmSotDiffMAX DFC_st.DFC_PFltmSotDiffMIN DFC_st.DFC_PFltmSotDiffSIG DFC_st.DFC_PIntkVUsEnvPPls DFC_st.DFC_PresPlausDblDef DFC_st.DFC_RailCPC1 DFC_st.DFC_RailCPC3 DFC_st.DFC_RailCPC4 DFC_st.DFC_RailMeUn0 DFC_st.DFC_RailMeUn1 DFC_st.DFC_RailMeUn2 DFC_st.DFC_RailMeUn22 DFC_st.DFC_RailMeUn3 DFC_st.DFC_RailMeUn4 DFC_st.DFC_RailMeUn42 DFC_st.DFC_RailMeUn5 DFC_st.DFC_RailPCV0 DFC_st.DFC_RailPCV1 DFC_st.DFC_RailPCV2 DFC_st.DFC_RailPCV22 DFC_st.DFC_RailPCV3 DFC_st.DFC_RailPCV4 DFC_st.DFC_RailPCV42 DFC_st.DFC_RailPMonStrt DFC_st.DFC_SSpMon1 DFC_st.DFC_SSpMon2 DFC_st.DFC_SSpMon3 DFC_st.DFC_ThrVlv4WinErr1 DFC_st.DFC_ThrVlv4WinErr2 DFC_st.DFC_ThrVlv4WinErr3 DFC_st.DFC_ThrVlv4WinErr4 DFC_st.DFC_ThrVlvSCG DFC_st.DFC_Tle6232Spi1 DFC_st.DFC_TrbCh4WinErr1 DFC_st.DFC_TrbCh4WinErr2 DFC_st.DFC_TrbCh4WinErr3 DFC_st.DFC_TrbCh4WinErr4 DFC_st.DFC_TrbChSCG DFC_st.DFC_TrbChSRCMax DFC_st.DFC_TrbChSRCMin DFC_st.DFC_WaHtEl4WinErr1 DFC_st.DFC_WaHtEl4WinErr2 DFC_st.DFC_WaHtEl4WinErr3 DFC_st.DFC_WaHtEl4WinErr4 DFC_st.DFC_WaHtElSCG DFC_st.DFC_ETClbETFltMax_0 DFC_st.DFC_ETClbETFltMax_1 DFC_st.DFC_ETClbETFltMax_2 DFC_st.DFC_ETClbETFltMax_3 DFC_st.DFC_ETClbETFltMax_4 DFC_st.DFC_ETClbETFltMax_5 DFC_st.DFC_ETClbETFltMin_0 DFC_st.DFC_ETClbETFltMin_1 DFC_st.DFC_ETClbETFltMin_2 DFC_st.DFC_ETClbETFltMin_3 DFC_st.DFC_ETClbETFltMin_4 DFC_st.DFC_ETClbETFltMin_5 DFC_st.DFC_InjCrvInjLimChrgBal DFC_st.DFC_InjCrvInjLimQntBal DFC_st.DFC_InjCrvInjLimSys DFC_st.DFC_InjCrvNumInjRtmLim DFC_st.DFC_LSUHtCoupSig DFC_st.DFC_AFS_SSpShOffOL DFC_st.DFC_AFS_SSpShOffOvrTemp DFC_st.DFC_AFS_SSpShOffSCB DFC_st.DFC_AFS_SSpShOffSCG DFC_st.DFC_AirCCmprOL DFC_st.DFC_AirCCmprOvrTemp DFC_st.DFC_AirCCmprSCB DFC_st.DFC_AirCCmprSCG DFC_st.DFC_CByVlvOL DFC_st.DFC_CByVlvOvrTemp DFC_st.DFC_CByVlvSCB DFC_st.DFC_CByVlvSCG DFC_st.DFC_CThmstOL DFC_st.DFC_CThmstOvrTemp DFC_st.DFC_CThmstSCB DFC_st.DFC_CThmstSCG DFC_st.DFC_DSMDummy DFC_st.DFC_EBxFanOL DFC_st.DFC_EBxFanOvrTemp DFC_st.DFC_EBxFanSCB DFC_st.DFC_EBxFanSCG DFC_st.DFC_ECBVlvOL DFC_st.DFC_ECBVlvOvrTemp DFC_st.DFC_ECBVlvSCB DFC_st.DFC_ECBVlvSCG DFC_st.DFC_EMDmpOL_0 DFC_st.DFC_EMDmpOL_1 DFC_st.DFC_EMDmpOvrTemp_0 DFC_st.DFC_EMDmpOvrTemp_1 DFC_st.DFC_EMDmpSCB_0 DFC_st.DFC_EMDmpSCB_1 DFC_st.DFC_EMDmpSCG_0 DFC_st.DFC_EMDmpSCG_1 DFC_st.DFC_EngStAOL DFC_st.DFC_EngStAOvrTemp DFC_st.DFC_EngStASCB DFC_st.DFC_EngStASCG DFC_st.DFC_FanOL DFC_st.DFC_FanOvrTemp DFC_st.DFC_FanSCB DFC_st.DFC_FlFltHtOL DFC_st.DFC_FlFltHtOvrTemp DFC_st.DFC_FlFltHtSCB DFC_st.DFC_FlFltHtSCG DFC_st.DFC_LSUHtrMax DFC_st.DFC_LSUHtrMin DFC_st.DFC_LSUHtrNpl DFC_st.DFC_LSUHtrSig DFC_st.DFC_LSUtExcMax DFC_st.DFC_LSUtExcMin DFC_st.DFC_MeUnOL DFC_st.DFC_MeUnSCB DFC_st.DFC_MeUnSRCMax DFC_st.DFC_MeUnSRCMin DFC_st.DFC_PCVOL DFC_st.DFC_PCVSCB DFC_st.DFC_PCVSRCMax DFC_st.DFC_PCVSRCMin DFC_st.DFC_RailPSRCMax DFC_st.DFC_RailPSRCMin DFC_st.DFC_ShtrOL DFC_st.DFC_ShtrOvrTemp DFC_st.DFC_ShtrSCB DFC_st.DFC_ShtrSCG DFC_st.DFC_StrtOL DFC_st.DFC_StrtOvrTemp DFC_st.DFC_StrtSCB DFC_st.DFC_StrtSCG DFC_st.DFC_ThrVlvOL DFC_st.DFC_ThrVlvOvrTemp DFC_st.DFC_ThrVlvSCB DFC_st.DFC_TrbChOL DFC_st.DFC_TrbChOvrTemp DFC_st.DFC_TrbChSCB DFC_st.DFC_UDosVlvOL DFC_st.DFC_UDosVlvOvrTemp DFC_st.DFC_UDosVlvSCB DFC_st.DFC_UDosVlvSCG DFC_st.DFC_UPmpMotOL DFC_st.DFC_UPmpMotOvrTemp DFC_st.DFC_UPmpMotSCB DFC_st.DFC_UPmpMotSCG DFC_st.DFC_WaHtElOL DFC_st.DFC_WaHtElOvrTemp DFC_st.DFC_WaHtElSCB DFC_st.DFC_IVActrUChSRCMax DFC_st.DFC_IVActrUChSRCMin DFC_st.DFC_IVActrVltgSRCMax DFC_st.DFC_IVActrVltgSRCMin DFC_st.DFC_IVDiaTunDet DFC_st.DFC_IVPSplyStopDCDC DFC_st.DFC_IVPSplyVltgSRCMax DFC_st.DFC_IVPSplyVltgSRCMin DFC_st.DFC_SCREtaErr DFC_st.DFC_SCREtaErr1 DFC_st.DFC_SCREtaErr2 DFC_st.DFC_SCRMonMetCtlPresErr DFC_st.DFC_SCRMonPresBuildUpErr DFC_st.DFC_SCRMonPresRdcErr DFC_st.DFC_AFSOffsDrftMax DFC_st.DFC_AFSOffsDrftMin DFC_st.DFC_AFSSRCCorMax DFC_st.DFC_AFSSRCCorMin DFC_st.DFC_AFSSRCRawMax DFC_st.DFC_AFSSRCRawMin DFC_st.DFC_AFSSetyDrftMax DFC_st.DFC_AFSSetyDrftMin DFC_st.DFC_AirCSwtNpl DFC_st.DFC_AirCSwtSig DFC_st.DFC_BattUSRCMax DFC_st.DFC_BattUSRCMin DFC_st.DFC_BrkNpl DFC_st.DFC_BrkPSRCMax DFC_st.DFC_BrkPSRCMin DFC_st.DFC_CEngDsTSRCMax DFC_st.DFC_CEngDsTSRCMin DFC_st.DFC_CrCUIDet DFC_st.DFC_ECBVlvSRCMax DFC_st.DFC_ECBVlvSRCMin DFC_st.DFC_ECUOvrTemp DFC_st.DFC_EGRVlvGovDvtMax DFC_st.DFC_EGRVlvGovDvtMin DFC_st.DFC_EGRVlvHBrgOpnLd DFC_st.DFC_EGRVlvHBrgOvrCurr DFC_st.DFC_EGRVlvHBrgOvrTemp DFC_st.DFC_EGRVlvHBrgShCirBatt1 DFC_st.DFC_EGRVlvHBrgShCirBatt2 DFC_st.DFC_EGRVlvHBrgShCirGnd1 DFC_st.DFC_EGRVlvHBrgShCirGnd2 DFC_st.DFC_EGRVlvHBrgShCirOvrLd DFC_st.DFC_EGRVlvHBrgTempOvrCurr DFC_st.DFC_EGRVlvHBrgUndrVltg DFC_st.DFC_EGRVlvLPGovDvtMax DFC_st.DFC_EGRVlvLPGovDvtMin DFC_st.DFC_EGRVlvLPHBrgOpnLd DFC_st.DFC_EGRVlvLPHBrgOvrCurr DFC_st.DFC_EGRVlvLPHBrgOvrTemp DFC_st.DFC_EGRVlvLPHBrgShCirBatt1 DFC_st.DFC_EGRVlvLPHBrgShCirBatt2 DFC_st.DFC_EGRVlvLPHBrgShCirGnd1 DFC_st.DFC_EGRVlvLPHBrgShCirGnd2 DFC_st.DFC_EGRVlvLPHBrgShCirOvrLd DFC_st.DFC_EGRVlvLPHBrgTempOvrCurr DFC_st.DFC_EGRVlvLPHBrgUndrVltg DFC_st.DFC_EGRVlvLPOL DFC_st.DFC_EGRVlvLPSCB DFC_st.DFC_EGRVlvLPSCG DFC_st.DFC_EGRVlvLPSRCMax DFC_st.DFC_EGRVlvLPSRCMin DFC_st.DFC_EGRVlvOL DFC_st.DFC_EGRVlvSCB DFC_st.DFC_EGRVlvSCG DFC_st.DFC_EGRVlvSRCMax DFC_st.DFC_EGRVlvSRCMin DFC_st.DFC_EngPrtOvrSpd DFC_st.DFC_EngSpdOL DFC_st.DFC_EngSpdSCB DFC_st.DFC_EngSpdSCG DFC_st.DFC_EnhSRCMaxPPFltDiff DFC_st.DFC_EnhSRCMaxT1ExhTMon DFC_st.DFC_EnhSRCMaxT2ExhTMon DFC_st.DFC_EnhSRCMaxT3ExhTMon DFC_st.DFC_EnhSRCMinPPFltDiff DFC_st.DFC_EnhSRCMinT1ExhTMon DFC_st.DFC_EnhSRCMinT2ExhTMon DFC_st.DFC_EnhSRCMinT3ExhTMon DFC_st.DFC_EnvPSRCMax DFC_st.DFC_EnvPSRCMin DFC_st.DFC_ExhTMonPlaus DFC_st.DFC_ExhTMonPlausPos1 DFC_st.DFC_ExhTMonPlausPos2 DFC_st.DFC_ExhTMonPlausPos3 DFC_st.DFC_ExhTMonT1Plaus DFC_st.DFC_ExhTMonT2Plaus DFC_st.DFC_ExhTMonT3Plaus DFC_st.DFC_FlFltDsPSRCMax DFC_st.DFC_FlFltDsPSRCMin DFC_st.DFC_FlFltSig DFC_st.DFC_FlFltUsPSRCMax DFC_st.DFC_FlFltUsPSRCMin DFC_st.DFC_FuelTSRCMax DFC_st.DFC_FuelTSRCMin DFC_st.DFC_GbxNPosPPerSRCMax DFC_st.DFC_GbxNPosPPerSRCMin DFC_st.DFC_GbxNPosPdcycSRCMax DFC_st.DFC_GbxNPosPdcycSRCMin DFC_st.DFC_InjVlvPresMin DFC_st.DFC_LSUCircNernstSig DFC_st.DFC_LSUCircPmpCurSig DFC_st.DFC_LSUCircVirtGndSig DFC_st.DFC_LSUO2Max DFC_st.DFC_LSUO2Min DFC_st.DFC_LSUSPIBattLowMin DFC_st.DFC_LSUWireSCB DFC_st.DFC_LSUWireSCG DFC_st.DFC_MeUnSCG DFC_st.DFC_NSCDsCmpChk DFC_st.DFC_NSCDsLamBinSRCMax DFC_st.DFC_NSCDsLamBinSRCMin DFC_st.DFC_NSCDsLamLinSRCMax DFC_st.DFC_NSCDsLamLinSRCMin DFC_st.DFC_NSCDsLamPlausMax DFC_st.DFC_NSCDsLamPlausMin DFC_st.DFC_NSCDsNOxSRCMax DFC_st.DFC_NSCDsNOxSRCMin DFC_st.DFC_NSCDsOpCir DFC_st.DFC_NSCDsShCir DFC_st.DFC_NoCat2DsCmpChk DFC_st.DFC_NoCat2DsLamBinSRCMax DFC_st.DFC_NoCat2DsLamBinSRCMin DFC_st.DFC_NoCat2DsLamLinSRCMax DFC_st.DFC_NoCat2DsLamLinSRCMin DFC_st.DFC_NoCat2DsLamPlausMax DFC_st.DFC_NoCat2DsLamPlausMin DFC_st.DFC_NoCat2DsNOxSRCMax DFC_st.DFC_NoCat2DsNOxSRCMin DFC_st.DFC_NoCat2DsOpCir DFC_st.DFC_NoCat2DsShCir DFC_st.DFC_NplDynPPFltDiff DFC_st.DFC_NplHsChngPPFltDiff DFC_st.DFC_NplHsLnPPFltDiff DFC_st.DFC_NplTOxiCatUs DFC_st.DFC_NplTPFltUs DFC_st.DFC_NplTTrbnUs DFC_st.DFC_OilPSwmpSRCMax DFC_st.DFC_OilPSwmpSRCMin DFC_st.DFC_PCVSCG DFC_st.DFC_PFltCharPDiffMin DFC_st.DFC_PFltDstrMin DFC_st.DFC_PFltEngPrt DFC_st.DFC_PFltRgnPerm DFC_st.DFC_PFltSRCMaxFlwRstn DFC_st.DFC_PFltSRCMinFlwRstn DFC_st.DFC_PFltSotMsDvtMax DFC_st.DFC_PFltSotMsDvtMin DFC_st.DFC_PFltSotMsMax DFC_st.DFC_PIntkVUsSRCMax DFC_st.DFC_PIntkVUsSRCMin DFC_st.DFC_SRCHighAPP1 DFC_st.DFC_SRCHighAPP2 DFC_st.DFC_SRCLowAPP1 DFC_st.DFC_SRCLowAPP2 DFC_st.DFC_SRCMaxPPFltDiff DFC_st.DFC_SRCMaxPPFltUs DFC_st.DFC_SRCMaxTECU DFC_st.DFC_SRCMaxTOxiCatUs DFC_st.DFC_SRCMaxTPFltUs DFC_st.DFC_SRCMaxTTrbnUs DFC_st.DFC_SRCMaxUCatUsT DFC_st.DFC_SRCMaxUPmpP DFC_st.DFC_SRCMinPPFltDiff DFC_st.DFC_SRCMinPPFltUs DFC_st.DFC_SRCMinTECU DFC_st.DFC_SRCMinTOxiCatUs DFC_st.DFC_SRCMinTPFltUs DFC_st.DFC_SRCMinTTrbnUs DFC_st.DFC_SRCMinUCatUsT DFC_st.DFC_SRCMinUPmpP DFC_st.DFC_SigUCatUsT DFC_st.DFC_SigUPmpP DFC_st.DFC_SyncAPP DFC_st.DFC_T15Npl DFC_st.DFC_TAFSDtyCycHi DFC_st.DFC_TAFSDtyCycLo DFC_st.DFC_TAFSPerHi DFC_st.DFC_TAFSPerLo DFC_st.DFC_TCACDsSRCMax DFC_st.DFC_TCACDsSRCMin DFC_st.DFC_ThrVlvSRCMax DFC_st.DFC_ThrVlvSRCMin DFC_st.DFC_TrbChLPOL DFC_st.DFC_TrbChLPSCB DFC_st.DFC_TrbChLPSCG DFC_st.DFC_UHtrPLOL DFC_st.DFC_UHtrPLSCB DFC_st.DFC_UHtrPLSCG DFC_st.DFC_UHtrPLSRCMaxDia DFC_st.DFC_UHtrPLSRCMinDia DFC_st.DFC_UHtrTnkOL DFC_st.DFC_UHtrTnkSCB DFC_st.DFC_UHtrTnkSCG DFC_st.DFC_UHtrTnkSRCMaxDia DFC_st.DFC_UHtrTnkSRCMinDia DFC_st.DFC_URevVlvOL DFC_st.DFC_URevVlvSCB DFC_st.DFC_URevVlvSCG DFC_st.DFC_UTnkTSRCMax DFC_st.DFC_UTnkTSRCMin DFC_st.DFC_UTnkTSig DFC_st.DFC_VSwVlvGovDvtMax DFC_st.DFC_VSwVlvGovDvtMin DFC_st.DFC_VSwVlvHBrgOpnLd DFC_st.DFC_VSwVlvHBrgOvrCurr DFC_st.DFC_VSwVlvHBrgOvrTemp DFC_st.DFC_VSwVlvHBrgShCirBatt1 DFC_st.DFC_VSwVlvHBrgShCirBatt2 DFC_st.DFC_VSwVlvHBrgShCirGnd1 DFC_st.DFC_VSwVlvHBrgShCirGnd2 DFC_st.DFC_VSwVlvHBrgShCirOvrLd DFC_st.DFC_VSwVlvHBrgTempOvrCurr DFC_st.DFC_VSwVlvHBrgUndrVltg DFC_st.DFC_VSwVlvOL DFC_st.DFC_VSwVlvSCB DFC_st.DFC_VSwVlvSCG DFC_st.DFC_VSwVlvSRCMax DFC_st.DFC_VSwVlvSRCMin DFC_st.DFC_ClthNpl DFC_st.DFC_ETClbETMax_0 DFC_st.DFC_ETClbETMax_1 DFC_st.DFC_ETClbETMax_2 DFC_st.DFC_ETClbETMax_3 DFC_st.DFC_ETClbETMax_4 DFC_st.DFC_ETClbETMax_5 DFC_st.DFC_ETClbETMin_0 DFC_st.DFC_ETClbETMin_1 DFC_st.DFC_ETClbETMin_2 DFC_st.DFC_ETClbETMin_3 DFC_st.DFC_ETClbETMin_4 DFC_st.DFC_ETClbETMin_5 DFC_st.DFC_IVActrEnrgMax_0 DFC_st.DFC_IVActrEnrgMax_1 DFC_st.DFC_IVActrEnrgMax_2 DFC_st.DFC_IVActrEnrgMax_3 DFC_st.DFC_IVActrEnrgMax_4 DFC_st.DFC_IVActrEnrgMax_5 DFC_st.DFC_IVActrEnrgMax_6 DFC_st.DFC_IVActrEnrgMax_7 DFC_st.DFC_IVActrEnrgMin_0 DFC_st.DFC_IVActrEnrgMin_1 DFC_st.DFC_IVActrEnrgMin_2 DFC_st.DFC_IVActrEnrgMin_3 DFC_st.DFC_IVActrEnrgMin_4 DFC_st.DFC_IVActrEnrgMin_5 DFC_st.DFC_IVActrEnrgMin_6 DFC_st.DFC_IVActrEnrgMin_7 DFC_st.DFC_IVActrEnrgPlaus_0 DFC_st.DFC_IVActrEnrgPlaus_1 DFC_st.DFC_IVActrEnrgPlaus_2 DFC_st.DFC_IVActrEnrgPlaus_3 DFC_st.DFC_IVActrEnrgPlaus_4 DFC_st.DFC_IVActrEnrgPlaus_5 DFC_st.DFC_IVActrEnrgPlaus_6 DFC_st.DFC_IVActrEnrgPlaus_7 DFC_st.DFC_IVCtlTiDiff_0 DFC_st.DFC_IVCtlTiDiff_1 DFC_st.DFC_IVCtlTiDiff_2 DFC_st.DFC_IVCtlTiDiff_3 DFC_st.DFC_IVCtlTiDiff_4 DFC_st.DFC_IVCtlTiDiff_5 DFC_st.DFC_IVCtlUDiffUp_0 DFC_st.DFC_IVCtlUDiffUp_1 DFC_st.DFC_IVCtlUDiffUp_2 DFC_st.DFC_IVCtlUDiffUp_3 DFC_st.DFC_IVCtlUDiffUp_4 DFC_st.DFC_IVCtlUDiffUp_5 DFC_st.DFC_IVCtlUUp_0 DFC_st.DFC_IVCtlUUp_1 DFC_st.DFC_IVCtlUUp_2 DFC_st.DFC_IVCtlUUp_3 DFC_st.DFC_IVCtlUUp_4 DFC_st.DFC_IVCtlUUp_5 DFC_st.DFC_IVDiaBnkShCir_0 DFC_st.DFC_IVDiaBnkShCir_1 DFC_st.DFC_IVDiaBnkShCirChSwt_0 DFC_st.DFC_IVDiaBnkShCirChSwt_1 DFC_st.DFC_IVDiaChp_0 DFC_st.DFC_IVDiaChp_1 DFC_st.DFC_IVDiaCylNoCls_0 DFC_st.DFC_IVDiaCylNoCls_1 DFC_st.DFC_IVDiaCylNoCls_2 DFC_st.DFC_IVDiaCylNoCls_3 DFC_st.DFC_IVDiaCylNoCls_4 DFC_st.DFC_IVDiaCylNoCls_5 DFC_st.DFC_IVDiaCylNoLd_0 DFC_st.DFC_IVDiaCylNoLd_1 DFC_st.DFC_IVDiaCylNoLd_2 DFC_st.DFC_IVDiaCylNoLd_3 DFC_st.DFC_IVDiaCylNoLd_4 DFC_st.DFC_IVDiaCylNoLd_5 DFC_st.DFC_IVDiaCylShCir_0 DFC_st.DFC_IVDiaCylShCir_1 DFC_st.DFC_IVDiaCylShCir_2 DFC_st.DFC_IVDiaCylShCir_3 DFC_st.DFC_IVDiaCylShCir_4 DFC_st.DFC_IVDiaCylShCir_5 DFC_st.DFC_IVDiaCylShCirHSLS_0 DFC_st.DFC_IVDiaCylShCirHSLS_1 DFC_st.DFC_IVDiaCylShCirHSLS_2 DFC_st.DFC_IVDiaCylShCirHSLS_3 DFC_st.DFC_IVDiaCylShCirHSLS_4 DFC_st.DFC_IVDiaCylShCirHSLS_5 DFC_st.DFC_IVDiaCylShCirMeas_0 DFC_st.DFC_IVDiaCylShCirMeas_1 DFC_st.DFC_IVDiaCylShCirMeas_2 DFC_st.DFC_IVDiaCylShCirMeas_3 DFC_st.DFC_IVDiaCylShCirMeas_4 DFC_st.DFC_IVDiaCylShCirMeas_5 DFC_st.DFC_LSUDynChk DFC_st.DFC_LSUO2ClbMax DFC_st.DFC_LSUO2ClbMin DFC_st.DFC_LSUO2PlausMaxFLd DFC_st.DFC_LSUO2PlausMaxOvrRun DFC_st.DFC_LSUO2PlausMaxPartLd DFC_st.DFC_LSUO2PlausMinFLd DFC_st.DFC_LSUO2PlausMinOvrRun DFC_st.DFC_LSUO2PlausMinPartLd DFC_st.DFC_LSURiClbMax DFC_st.DFC_LSURiClbMin DFC_st.DFC_LSUWireIPSig DFC_st.DFC_Layer_BSDMax DFC_st.DFC_Layer_BSDMin DFC_st.DFC_Layer_BSDNpl DFC_st.DFC_Layer_BSDSig DFC_st.DFC_Layer_FltMngTstMax DFC_st.DFC_Layer_FltMngTstMin DFC_st.DFC_Layer_FltMngTstNpl DFC_st.DFC_Layer_FltMngTstSig DFC_st.DFC_Layer_GENELBMax DFC_st.DFC_Layer_GENELBMin DFC_st.DFC_Layer_GENELBNpl DFC_st.DFC_Layer_GENELBSig DFC_st.DFC_Layer_GENELMax DFC_st.DFC_Layer_GENELMin DFC_st.DFC_Layer_GENELNpl DFC_st.DFC_Layer_GENELSig DFC_st.DFC_Layer_GENHTBMax DFC_st.DFC_Layer_GENHTBMin DFC_st.DFC_Layer_GENHTBNpl DFC_st.DFC_Layer_GENHTBSig DFC_st.DFC_Layer_GENHTMax DFC_st.DFC_Layer_GENHTMin DFC_st.DFC_Layer_GENHTNpl DFC_st.DFC_Layer_GENHTSig DFC_st.DFC_Layer_GENKOMMMax DFC_st.DFC_Layer_GENKOMMMin DFC_st.DFC_Layer_GENKOMMNpl DFC_st.DFC_Layer_GENKOMMSig DFC_st.DFC_Layer_GENMECHMax DFC_st.DFC_Layer_GENMECHMin DFC_st.DFC_Layer_GENMECHNpl DFC_st.DFC_Layer_GENMECHSig DFC_st.DFC_Layer_GENMax DFC_st.DFC_Layer_GENMin DFC_st.DFC_Layer_GENNpl DFC_st.DFC_Layer_GENREGUPLMax DFC_st.DFC_Layer_GENREGUPLMin DFC_st.DFC_Layer_GENREGUPLNpl DFC_st.DFC_Layer_GENREGUPLSig DFC_st.DFC_Layer_GENSig DFC_st.DFC_Layer_GENUPLMax DFC_st.DFC_Layer_GENUPLMin DFC_st.DFC_Layer_GENUPLNpl DFC_st.DFC_Layer_GENUPLSig DFC_st.DFC_Layer_IBS1Max DFC_st.DFC_Layer_IBS1Min DFC_st.DFC_Layer_IBS1Npl DFC_st.DFC_Layer_IBS1Sig DFC_st.DFC_Layer_IBS2Max DFC_st.DFC_Layer_IBS2Min DFC_st.DFC_Layer_IBS2Npl DFC_st.DFC_Layer_IBS2Sig DFC_st.DFC_Layer_IBS3Max DFC_st.DFC_Layer_IBS3Min DFC_st.DFC_Layer_IBS3Npl DFC_st.DFC_Layer_IBS3Sig DFC_st.DFC_Layer_MANDETEKMax DFC_st.DFC_Layer_MANDETEKMin DFC_st.DFC_Layer_MANDETEKNpl DFC_st.DFC_Layer_MANDETEKSig DFC_st.DFC_Layer_NDR1Max DFC_st.DFC_Layer_NDR1Min DFC_st.DFC_Layer_NDR1Npl DFC_st.DFC_Layer_NDR1Sig DFC_st.DFC_Layer_NDR2Max DFC_st.DFC_Layer_NDR2Min DFC_st.DFC_Layer_NDR2Npl DFC_st.DFC_Layer_NDR2Sig DFC_st.DFC_Layer_NGLERNMax DFC_st.DFC_Layer_NGLERNMin DFC_st.DFC_Layer_NGLERNNpl DFC_st.DFC_Layer_NGLERNSig DFC_st.DFC_Layer_PMBATTMax DFC_st.DFC_Layer_PMBATTMin DFC_st.DFC_Layer_PMBATTNpl DFC_st.DFC_Layer_PMBATTSig DFC_st.DFC_Layer_PMBNMax DFC_st.DFC_Layer_PMBNMin DFC_st.DFC_Layer_PMBNNpl DFC_st.DFC_Layer_PMBNSig DFC_st.DFC_Layer_PMRUHVERLMax DFC_st.DFC_Layer_PMRUHVERLMin DFC_st.DFC_Layer_PMRUHVERLNpl DFC_st.DFC_Layer_PMRUHVERLSig DFC_st.DFC_Layer_QLTMax DFC_st.DFC_Layer_QLTMin DFC_st.DFC_Layer_QLTNpl DFC_st.DFC_Layer_QLTSig DFC_st.DFC_Layer_TOENSMax DFC_st.DFC_Layer_TOENSMin DFC_st.DFC_Layer_TOENSNpl DFC_st.DFC_Layer_TOENSSig DFC_st.DFC_MonLimCurr DFC_st.DFC_MonLimLead DFC_st.DFC_MonLimSet DFC_st.DFC_NSCDsNOxOfsMax DFC_st.DFC_NSCDsNOxOfsMin DFC_st.DFC_NSCDsNOxPlausMin DFC_st.DFC_NoCat2DsNOxOfsMax DFC_st.DFC_NoCat2DsNOxOfsMin DFC_st.DFC_NoCat2DsNOxPlausMin DFC_st.DFC_PCVNoStrt DFC_st.DFC_RailPGradMon DFC_st.DFC_SCRPODPresBuildUp DFC_st.DFC_AFSDrftIdlAdjVal DFC_st.DFC_AFSDrftLdAdjVal DFC_st.DFC_AdcIADC0Cal DFC_st.DFC_AdcIADC0Conv DFC_st.DFC_AdcIADC1Cal DFC_st.DFC_AdcIADC1Conv DFC_st.DFC_CmbChbMisfireMax_0 DFC_st.DFC_CmbChbMisfireMax_1 DFC_st.DFC_CmbChbMisfireMax_2 DFC_st.DFC_CmbChbMisfireMax_3 DFC_st.DFC_CmbChbMisfireMax_4 DFC_st.DFC_CmbChbMisfireMax_5 DFC_st.DFC_CmbChbMisfireMul DFC_st.DFC_EGRVlvLPOfsNeutr DFC_st.DFC_EGRVlvOfsNeutr DFC_st.DFC_FMAErrModMax DFC_st.DFC_FMAErrModMin DFC_st.DFC_FlSysTnkLo DFC_st.DFC_GbxNPosPlaus DFC_st.DFC_I14229_ROETst_Appl DFC_st.DFC_I14229_ROETst_Netw DFC_st.DFC_I14229_ROE_BufFull DFC_st.DFC_IVAdjDiaIVAdj DFC_st.DFC_IVAdjIVA_0 DFC_st.DFC_IVAdjIVA_1 DFC_st.DFC_IVAdjIVA_2 DFC_st.DFC_IVAdjIVA_3 DFC_st.DFC_IVAdjIVA_4 DFC_st.DFC_IVAdjIVA_5 DFC_st.DFC_IVPSplyDCDCOff_0 DFC_st.DFC_IVPSplyDCDCOff_1 DFC_st.DFC_IVPSplyDCDCOff_2 DFC_st.DFC_IVPSplyDCDCOff_3 DFC_st.DFC_InjCtlAdjQntEEPCS DFC_st.DFC_LSUSPISig DFC_st.DFC_Layer_Dummy DFC_st.DFC_NplEnvPSensPPFltDiff DFC_st.DFC_NplPresSensPPFltDiff DFC_st.DFC_OilLvlPlaus DFC_st.DFC_OilTOutLvl DFC_st.DFC_PCVfacAdaptMax DFC_st.DFC_PCVfacAdaptMin DFC_st.DFC_SensFrzPPFltUs DFC_st.DFC_SensMonUTnkLvl DFC_st.DFC_T15Sig DFC_st.DFC_AirCtlRmpTOut DFC_st.DFC_BrkPPlaus DFC_st.DFC_CEngDsTDynTst DFC_st.DFC_EEPEraseErr DFC_st.DFC_EEPRdErr DFC_st.DFC_EEPWrErr DFC_st.DFC_EGRVlvJamVlvClsd DFC_st.DFC_EGRVlvJamVlvOpn DFC_st.DFC_EGRVlvLPJamVlvClsd DFC_st.DFC_EGRVlvLPJamVlvOpn DFC_st.DFC_EGRVlvLPLgTDrft DFC_st.DFC_EGRVlvLPOfsLrnJamVlv /end OUT_MEASUREMENT
/end FUNCTION
/begin COMPU_METHOD AirMassPerTime "" RAT_FUNC "%5.1" "Kg/h" COEFFS 0 10 0 0 0 1 /end COMPU_METHOD
/begin COMPU_METHOD DFC_OneToOne "" RAT_FUNC "%6.0" "-" COEFFS 0 1 0 0 0 1 /end COMPU_METHOD
/begin COMPU_METHOD Energy "" RAT_FUNC "%6.2" "kJ" COEFFS 0 1 0 0 0 1 /end COMPU_METHOD
/begin COMPU_METHOD EngTempFldSel "" TAB_VERB "%6.3" "" COMPU_TAB_REF EngTempFldSel /end COMPU_METHOD
/begin COMPU_VTAB EngTempFldSel "" TAB_VERB 4 0 "Coolant_Temperature" 1 "Oil_Temperature" 2 "EngDa_tEng" 3 "Chamberwall_Temperature" /end COMPU_VTAB
/begin COMPU_METHOD Fact "" RAT_FUNC "%6.5" "-" COEFFS 0 8192 0 0 0 1 /end COMPU_METHOD
/begin COMPU_METHOD Fl_Half_L "" RAT_FUNC "%6.3" "l" COEFFS 0 2 0 0 0 1 /end COMPU_METHOD
/begin COMPU_METHOD InjMass "" RAT_FUNC "%5.2" "mg/hub" COEFFS 0 100 0 0 0 1 /end COMPU_METHOD
/begin COMPU_METHOD Ms_SOxNOx "" RAT_FUNC "%8.7" "g" COEFFS 0 100000 0 0 0 1 /end COMPU_METHOD
/begin COMPU_METHOD nox "" RAT_FUNC "%6.2" "ppm" COEFFS 0 1 0 0 0 1 /end COMPU_METHOD
/begin COMPU_METHOD OneToOne "" RAT_FUNC "%6.0" "-" COEFFS 0 1 0 0 0 1 /end COMPU_METHOD
/begin COMPU_METHOD Prc "" RAT_FUNC "%6.4" "%" COEFFS 0 81.92 0 0 0 1 /end COMPU_METHOD
/begin COMPU_METHOD PresAC_hPa "" RAT_FUNC "%6.2" "hPa" COEFFS 0 0.5 0 0 0 1 /end COMPU_METHOD
/begin COMPU_METHOD Pres_hPa "" RAT_FUNC "%5.1" "hPa" COEFFS 0 1 0 0 0 1 /end COMPU_METHOD
/begin COMPU_METHOD Pwr_kW_Sec "" RAT_FUNC "%6.4" "kW/s" COEFFS 0 100 0 0 0 1 /end COMPU_METHOD
/begin COMPU_METHOD SpecificHeat "" RAT_FUNC "%7.6" "J/g/K" COEFFS 0 10000 0 0 0 1 /end COMPU_METHOD
/begin COMPU_METHOD Temp_Cels "" RAT_FUNC "%5.1" "deg C" COEFFS 0 10 2731.4 0 0 1 /end COMPU_METHOD
/begin COMPU_METHOD TimeDeb "" RAT_FUNC "%5.0" "ms" COEFFS 0 0.1 0 0 0 1 /end COMPU_METHOD
/begin COMPU_METHOD Time_s "" RAT_FUNC "%5.2" "s" COEFFS 0 100 0 0 0 1 /end COMPU_METHOD
/begin COMPU_METHOD TrqPrp "" RAT_FUNC "%5.1" "Nm" COEFFS 0 0.625 0 0 0 1 /end COMPU_METHOD
/begin COMPU_METHOD default "" RAT_FUNC "%6.2" "" COEFFS 0 1 0 0 0 1 /end COMPU_METHOD
/begin RECORD_LAYOUT Kf_Xs16_Ys16_Ws16 NO_AXIS_PTS_X 1 SWORD NO_AXIS_PTS_Y 2 SWORD AXIS_PTS_X 3 SWORD INDEX_INCR DIRECT AXIS_PTS_Y 4 SWORD INDEX_INCR DIRECT FNC_VALUES 5 SWORD COLUMN_DIR DIRECT /end RECORD_LAYOUT
/begin RECORD_LAYOUT Kwb_Ws16 FNC_VALUES 1 SWORD COLUMN_DIR DIRECT /end RECORD_LAYOUT
/begin RECORD_LAYOUT Kwb_Ws32 FNC_VALUES 1 SLONG COLUMN_DIR DIRECT /end RECORD_LAYOUT
/begin RECORD_LAYOUT Kwb_Wu8 FNC_VALUES 1 UBYTE COLUMN_DIR DIRECT /end RECORD_LAYOUT
/begin RECORD_LAYOUT Kw_Ws16 FNC_VALUES 1 SWORD COLUMN_DIR DIRECT /end RECORD_LAYOUT
/begin RECORD_LAYOUT Kw_Wu8 FNC_VALUES 1 UBYTE COLUMN_DIR DIRECT /end RECORD_LAYOUT
/begin RECORD_LAYOUT Val_Ws16 FNC_VALUES 1 SWORD COLUMN_DIR DIRECT /end RECORD_LAYOUT
/end MODULE
/end PROJECT

ASAP2_VERSION 1 4
/begin PROJECT P_574 "EDC17_CP09"
/begin HEADER "" VERSION "V8KB" PROJECT_NO P_574 /end HEADER
/begin MODULE DIM ""
/begin MOD_COMMON "" BYTE_ORDER MSB_LAST ALIGNMENT_BYTE 1 ALIGNMENT_WORD 2 ALIGNMENT_LONG 4 ALIGNMENT_FLOAT32_IEEE 4 /end MOD_COMMON
/begin MEASUREMENT DFES_EnvBlock1026 "vollständige Umweldaten alle Fehlerspeichereinträge" UBYTE DFES_OneToOne 1 100 0.00 255.0 ECU_ADDRESS 0xD0009284 /end MEASUREMENT
/begin MEASUREMENT DFES_EnvBlock1027 "vollständige Umweldaten alle Fehlerspeichereinträge" UBYTE DFES_OneToOne 1 100 0.00 255.0 ECU_ADDRESS 0xD0009285 /end MEASUREMENT
/begin MEASUREMENT DFES_EnvBlock1028 "vollständige Umweldaten alle Fehlerspeichereinträge" UBYTE DFES_OneToOne 1 100 0.00 255.0 ECU_ADDRESS 0xD0009286 /end MEASUREMENT
/begin MEASUREMENT DFES_EnvBlock1029 "vollständige Umweldaten alle Fehlerspeichereinträge" UBYTE DFES_OneToOne 1 100 0.00 255.0 ECU_ADDRESS 0xD0009287 /end MEASUREMENT
/begin MEASUREMENT DFES_EnvBlock1030 "vollständige Umweldaten alle Fehlerspeichereinträge" UBYTE DFES_OneToOne 1 100 0.00 255.0 ECU_ADDRESS 0xD0009288 /end MEASUREMENT
/begin MEASUREMENT DFES_EnvBlock1031 "vollständige Umweldaten alle Fehlerspeichereinträge" UBYTE DFES_OneToOne 1 100 0.00 255.0 ECU_ADDRESS 0xD0009289 /end MEASUREMENT
/begin MEASUREMENT DFES_EnvBlock1032 "vollständige Umweldaten alle Fehlerspeichereinträge" UBYTE DFES_OneToOne 1 100 0.00 255.0 ECU_ADDRESS 0xD000928A /end MEASUREMENT
/begin MEASUREMENT DFES_EnvBlock1033 "vollständige Umweldaten alle Fehlerspeichereinträge" UBYTE DFES_OneToOne 1 100 0.00 255.0 ECU_ADDRESS 0xD000928B /end MEASUREMENT
/begin MEASUREMENT DFES_EnvBlock1034 "vollständige Umweldaten alle Fehlerspeichereinträge" UBYTE DFES_OneToOne 1 100 0.00 255.0 ECU_ADDRESS 0xD000928C /end MEASUREMENT
/begin MEASUREMENT DFES_EnvBlock1035 "vollständige Umweldaten alle Fehlerspeichereinträge" UBYTE DFES_OneToOne 1 100 0.00 255.0 ECU_ADDRESS 0xD000928D /end MEASUREMENT
/begin MEASUREMENT DFES_EnvBlock1036 "vollständige Umweldaten alle Fehlerspeichereinträge" UBYTE DFES_OneToOne 1 100 0.00 255.0 ECU_ADDRESS 0xD000928E /end MEASUREMENT
/begin MEASUREMENT DFES_EnvBlock1037 "vollständige Umweldaten alle Fehlerspeichereinträge" UBYTE DFES_OneToOne 1 100 0.00 255.0 ECU_ADDRESS 0xD000928F /end MEASUREMENT
/begin MEASUREMENT DFES_EnvBlock1038 "vollständige Umweldaten alle Fehlerspeichereinträge" UBYTE DFES_OneToOne 1 100 0.00 255.0 ECU_ADDRESS 0xD0009290 /end MEASUREMENT
/begin MEASUREMENT DFES_EnvBlock1039 "vollständige Umweldaten alle Fehlerspeichereinträge" UBYTE DFES_OneToOne 1 100 0.00 255.0 ECU_ADDRESS 0xD0009291 /end MEASUREMENT
/begin MEASUREMENT DFES_EnvBlock1040 "vollständige Umweldaten alle Fehlerspeichereinträge" UBYTE DFES_OneToOne 1 100 0.00 255.0 ECU_ADDRESS 0xD0009292 /end MEASUREMENT
/begin MEASUREMENT DFES_EnvBlock1041 "vollständige Umweldaten alle Fehlerspeichereinträge" UBYTE DFES_OneToOne 1 100 0.00 255.0 ECU_ADDRESS 0xD0009293 /end MEASUREMENT
/begin MEASUREMENT DFES_EnvBlock1042 "vollständige Umweldaten alle Fehlerspeichereinträge" UBYTE DFES_OneToOne 1 100 0.00 255.0 ECU_ADDRESS 0xD0009294 /end MEASUREMENT
/begin MEASUREMENT DFES_EnvBlock1043 "vollständige Umweldaten alle Fehlerspeichereinträge" UBYTE DFES_OneToOne 1 100 0.00 255.0 ECU_ADDRESS 0xD0009295 /end MEASUREMENT
/begin MEASUREMENT DFES_EnvBlock1044 "vollständige Umweldaten alle Fehlerspeichereinträge" UBYTE DFES_OneToOne 1 100 0.00 255.0 ECU_ADDRESS 0xD0009296 /end MEASUREMENT
/begin MEASUREMENT DFES_EnvBlock1045 "vollständige Umweldaten alle Fehlerspeichereinträge" UBYTE DFES_OneToOne 1 100 0.00 255.0 ECU_ADDRESS 0xD0009297 /end MEASUREMENT
/begin MEASUREMENT DFES_EnvBlock1046 "vollständige Umweldaten alle Fehlerspeichereinträge" UBYTE DFES_OneToOne 1 100 0.00 255.0 ECU_ADDRESS 0xD0009298 /end MEASUREMENT
/begin MEASUREMENT DFES_EnvBlock1047 "vollständige Umweldaten alle Fehlerspeichereinträge" UBYTE DFES_OneToOne 1 100 0.00 255.0 ECU_ADDRESS 0xD0009299 /end MEASUREMENT
/begin MEASUREMENT DFES_EnvBlock1048 "vollständige Umweldaten alle Fehlerspeichereinträge" UBYTE DFES_OneToOne 1 100 0.00 255.0 ECU_ADDRESS 0xD000929A /end MEASUREMENT
/begin MEASUREMENT DFES_EnvBlock1049 "vollständige Umweldaten alle Fehlerspeichereinträge" UBYTE DFES_OneToOne 1 100 0.00 255.0 ECU_ADDRESS 0xD000929B /end MEASUREMENT
/begin MEASUREMENT DFES_EnvBlock1050 "vollständige Umweldaten alle Fehlerspeichereinträge" UBYTE DFES_OneToOne 1 100 0.00 255.0 ECU_ADDRESS 0xD000929C /end MEASUREMENT
/begin MEASUREMENT DFES_EnvBlock1051 "vollständige Umweldaten alle Fehlerspeichereinträge" UBYTE DFES_OneToOne 1 100 0.00 255.0 ECU_ADDRESS 0xD000929D /end MEASUREMENT
/begin MEASUREMENT DFES_EnvBlock1052 "vollständige Umweldaten alle Fehlerspeichereinträge" UBYTE DFES_OneToOne 1 100 0.00 255.0 ECU_ADDRESS 0xD000929E /end MEASUREMENT
/begin MEASUREMENT DFES_EnvBlock1053 "vollständige Umweldaten alle Fehlerspeichereinträge" UBYTE DFES_OneToOne 1 100 0.00 255.0 ECU_ADDRESS 0xD000929F /end MEASUREMENT
/begin MEASUREMENT DFES_EnvBlock1054 "vollständige Umweldaten alle Fehlerspeichereinträge" UBYTE DFES_OneToOne 1 100 0.00 255.0 ECU_ADDRESS 0xD00092A0 /end MEASUREMENT
/begin MEASUREMENT DFES_EnvBlock1055 "vollständige Umweldaten alle Fehlerspeichereinträge" UBYTE DFES_OneToOne 1 100 0.00 255.0 ECU_ADDRESS 0xD00092A1 /end MEASUREMENT
/begin MEASUREMENT DFES_EnvBlock1056 "vollständige Umweldaten alle Fehlerspeichereinträge" UBYTE DFES_OneToOne 1 100 0.00 255.0 ECU_ADDRESS 0xD00092A2 /end MEASUREMENT
/begin MEASUREMENT DFES_EnvBlock1057 "vollständige Umweldaten alle Fehlerspeichereinträge" UBYTE DFES_OneToOne 1 100 0.00 255.0 ECU_ADDRESS 0xD00092A3 /end MEASUREMENT
/begin MEASUREMENT DFES_EnvBlock1058 "vollständige Umweldaten alle Fehlerspeichereinträge" UBYTE DFES_OneToOne 1 100 0.00 255.0 ECU_ADDRESS 0xD00092A4 /end MEASUREMENT
/begin MEASUREMENT DFES_EnvBlock1059 "vollständige Umweldaten alle Fehlerspeichereinträge" UBYTE DFES_OneToOne 1 100 0.00 255.0 ECU_ADDRESS 0xD00092A5 /end MEASUREMENT
/begin MEASUREMENT DFES_EnvBlock1060 "vollständige Umweldaten alle Fehlerspeichereinträge" UBYTE DFES_OneToOne 1 100 0.00 255.0 ECU_ADDRESS 0xD00092A6 /end MEASUREMENT
/begin MEASUREMENT DFES_EnvBlock1061 "vollständige Umweldaten alle Fehlerspeichereinträge" UBYTE DFES_OneToOne 1 100 0.00 255.0 ECU_ADDRESS 0xD00092A7 /end MEASUREMENT
/begin MEASUREMENT DFES_EnvBlock1062 "vollständige Umweldaten alle Fehlerspeichereinträge" UBYTE DFES_OneToOne 1 100 0.00 255.0 ECU_ADDRESS 0xD00092A8 /end MEASUREMENT
/begin MEASUREMENT DFES_EnvBlock1063 "vollständige Umweldaten alle Fehlerspeichereinträge" UBYTE DFES_OneToOne 1 100 0.00 255.0 ECU_ADDRESS 0xD00092A9 /end MEASUREMENT
/begin MEASUREMENT DFES_EnvBlock1064 "vollständige Umweldaten alle Fehlerspeichereinträge" UBYTE DFES_OneToOne 1 100 0.00 255.0 ECU_ADDRESS 0xD00092AA /end MEASUREMENT
/begin MEASUREMENT DFES_EnvBlock1065 "vollständige Umweldaten alle Fehlerspeichereinträge" UBYTE DFES_OneToOne 1 100 0.00 255.0 ECU_ADDRESS 0xD00092AB /end MEASUREMENT
/begin MEASUREMENT DFES_EnvBlock1066 "vollständige Umweldaten alle Fehlerspeichereinträge" UBYTE DFES_OneToOne 1 100 0.00 255.0 ECU_ADDRESS 0xD00092AC /end MEASUREMENT
/begin MEASUREMENT DFES_EnvBlock1067 "vollständige Umweldaten alle Fehlerspeichereinträge" UBYTE DFES_OneToOne 1 100 0.00 255.0 ECU_ADDRESS 0xD00092AD /end MEASUREMENT
/begin MEASUREMENT DFES_EnvBlock1068 "vollständige Umweldaten alle Fehlerspeichereinträge" UBYTE DFES_OneToOne 1 100 0.00 255.0 ECU_ADDRESS 0xD00092AE /end MEASUREMENT
/begin MEASUREMENT DFES_EnvBlock1069 "vollständige Umweldaten alle Fehlerspeichereinträge" UBYTE DFES_OneToOne 1 100 0.00 255.0 ECU_ADDRESS 0xD00092AF /end MEASUREMENT
/begin MEASUREMENT DFES_EnvBlock1070 "vollständige Umweldaten alle Fehlerspeichereinträge" UBYTE DFES_OneToOne 1 100 0.00 255.0 ECU_ADDRESS 0xD00092B0 /end MEASUREMENT
/begin MEASUREMENT DFES_EnvBlock1071 "vollständige Umweldaten alle Fehlerspeichereinträge" UBYTE DFES_OneToOne 1 100 0.00 255.0 ECU_ADDRESS 0xD00092B1 /end MEASUREMENT
/begin MEASUREMENT DFES_EnvBlock1072 "vollständige Umweldaten alle Fehlerspeichereinträge" UBYTE DFES_OneToOne 1 100 0.00 255.0 ECU_ADDRESS 0xD00092B2 /end MEASUREMENT
/begin MEASUREMENT DFES_EnvBlock1073 "vollständige Umweldaten alle Fehlerspeichereinträge" UBYTE DFES_OneToOne 1 100 0.00 255.0 ECU_ADDRESS 0xD00092B3 /end MEASUREMENT
/begin MEASUREMENT DFES_EnvBlock1074 "vollständige Umweldaten alle Fehlerspeichereinträge" UBYTE DFES_OneToOne 1 100 0.00 255.0 ECU_ADDRESS 0xD00092B4 /end MEASUREMENT
/begin MEASUREMENT DFES_EnvBlock1075 "vollständige Umweldaten alle Fehlerspeichereinträge" UBYTE DFES_OneToOne 1 100 0.00 255.0 ECU_ADDRESS 0xD00092B5 /end MEASUREMENT
/begin MEASUREMENT DFES_EnvBlock1076 "vollständige Umweldaten alle Fehlerspeichereinträge" UBYTE DFES_OneToOne 1 100 0.00 255.0 ECU_ADDRESS 0xD00092B6 /end MEASUREMENT
/begin MEASUREMENT DFES_EnvBlock1077 "vollständige Umweldaten alle Fehlerspeichereinträge" UBYTE DFES_OneToOne 1 100 0.00 255.0 ECU_ADDRESS 0xD00092B7 /end MEASUREMENT
/begin MEASUREMENT DFES_EnvBlock1078 "vollständige Umweldaten alle Fehlerspeichereinträge" UBYTE DFES_OneToOne 1 100 0.00 255.0 ECU_ADDRESS 0xD00092B8 /end MEASUREMENT
/begin MEASUREMENT DFES_EnvBlock1079 "vollständige Umweldaten alle Fehlerspeichereinträge" UBYTE DFES_OneToOne 1 100 0.00 255.0 ECU_ADDRESS 0xD00092B9 /end MEASUREMENT
/begin MEASUREMENT DFES_EnvBlock1080 "vollständige Umweldaten alle Fehlerspeichereinträge" UBYTE DFES_OneToOne 1 100 0.00 255.0 ECU_ADDRESS 0xD00092BA /end MEASUREMENT
/begin MEASUREMENT DFES_EnvBlock1081 "vollständige Umweldaten alle Fehlerspeichereinträge" UBYTE DFES_OneToOne 1 100 0.00 255.0 ECU_ADDRESS 0xD00092BB /end MEASUREMENT
/begin MEASUREMENT DFES_EnvBlock1082 "vollständige Umweldaten alle Fehlerspeichereinträge" UBYTE DFES_OneToOne 1 100 0.00 255.0 ECU_ADDRESS 0xD00092BC /end MEASUREMENT
/begin MEASUREMENT DFES_EnvBlock1083 "vollständige Umweldaten alle Fehlerspeichereinträge" UBYTE DFES_OneToOne 1 100 0.00 255.0 ECU_ADDRESS 0xD00092BD /end MEASUREMENT
/begin MEASUREMENT DFES_EnvBlock1084 "vollständige Umweldaten alle Fehlerspeichereinträge" UBYTE DFES_OneToOne 1 100 0.00 255.0 ECU_ADDRESS 0xD00092BE /end MEASUREMENT
/begin MEASUREMENT DFES_EnvBlock1085 "vollständige Umweldaten alle Fehlerspeichereinträge" UBYTE DFES_OneToOne 1 100 0.00 255.0 ECU_ADDRESS 0xD00092BF /end MEASUREMENT
/begin MEASUREMENT DFES_EnvBlock1086 "vollständige Umweldaten alle Fehlerspeichereinträge" UBYTE DFES_OneToOne 1 100 0.00 255.0 ECU_ADDRESS 0xD00092C0 /end MEASUREMENT
/begin MEASUREMENT DFES_EnvBlock1087 "vollständige Umweldaten alle Fehlerspeichereinträge" UBYTE DFES_OneToOne 1 100 0.00 255.0 ECU_ADDRESS 0xD00092C1 /end MEASUREMENT
/begin MEASUREMENT DFES_EnvBlock1088 "vollständige Umweldaten alle Fehlerspeichereinträge" UBYTE DFES_OneToOne 1 100 0.00 255.0 ECU_ADDRESS 0xD00092C2 /end MEASUREMENT
/begin MEASUREMENT DFES_EnvBlock1089 "vollständige Umweldaten alle Fehlerspeichereinträge" UBYTE DFES_OneToOne 1 100 0.00 255.0 ECU_ADDRESS 0xD00092C3 /end MEASUREMENT
/begin MEASUREMENT DFES_EnvBlock1090 "vollständige Umweldaten alle Fehlerspeichereinträge" UBYTE DFES_OneToOne 1 100 0.00 255.0 ECU_ADDRESS 0xD00092C4 /end MEASUREMENT
/begin MEASUREMENT DFES_EnvBlock1091 "vollständige Umweldaten alle Fehlerspeichereinträge" UBYTE DFES_OneToOne 1 100 0.00 255.0 ECU_ADDRESS 0xD00092C5 /end MEASUREMENT
/begin MEASUREMENT DFES_EnvBlock1092 "vollständige Umweldaten alle Fehlerspeichereinträge" UBYTE DFES_OneToOne 1 100 0.00 255.0 ECU_ADDRESS 0xD00092C6 /end MEASUREMENT
/begin MEASUREMENT DFES_EnvBlock1093 "vollständige Umweldaten alle Fehlerspeichereinträge" UBYTE DFES_OneToOne 1 100 0.00 255.0 ECU_ADDRESS 0xD00092C7 /end MEASUREMENT
/begin MEASUREMENT DFES_EnvBlock1094 "vollständige Umweldaten alle Fehlerspeichereinträge" UBYTE DFES_OneToOne 1 100 0.00 255.0 ECU_ADDRESS 0xD00092C8 /end MEASUREMENT
/begin MEASUREMENT DFES_EnvBlock1095 "vollständige Umweldaten alle Fehlerspeichereinträge" UBYTE DFES_OneToOne 1 100 0.00 255.0 ECU_ADDRESS 0xD00092C9 /end MEASUREMENT
/begin MEASUREMENT DFES_EnvBlock1096 "vollständige Umweldaten alle Fehlerspeichereinträge" UBYTE DFES_OneToOne 1 100 0.00 255.0 ECU_ADDRESS 0xD00092CA /end MEASUREMENT
/begin MEASUREMENT DFES_EnvBlock1097 "vollständige Umweldaten alle Fehlerspeichereinträge" UBYTE DFES_OneToOne 1 100 0.00 255.0 ECU_ADDRESS 0xD00092CB /end MEASUREMENT
/begin MEASUREMENT DFES_EnvBlock1098 "vollständige Umweldaten alle Fehlerspeichereinträge" UBYTE DFES_OneToOne 1 100 0.00 255.0 ECU_ADDRESS 0xD00092CC /end MEASUREMENT
/begin MEASUREMENT DFES_EnvBlock1099 "vollständige Umweldaten alle Fehlerspeichereinträge" UBYTE DFES_OneToOne 1 100 0.00 255.0 ECU_ADDRESS 0xD00092CD /end MEASUREMENT
/begin MEASUREMENT DFES_EnvBlock1100 "vollständige Umweldaten alle Fehlerspeichereinträge" UBYTE DFES_OneToOne 1 100 0.00 255.0 ECU_ADDRESS 0xD00092CE /end MEASUREMENT
/begin MEASUREMENT DFES_EnvBlock1101 "vollständige Umweldaten alle Fehlerspeichereinträge" UBYTE DFES_OneToOne 1 100 0.00 255.0 ECU_ADDRESS 0xD00092CF /end MEASUREMENT
/begin MEASUREMENT DFES_EnvBlock1102 "vollständige Umweldaten alle Fehlerspeichereinträge" UBYTE DFES_OneToOne 1 100 0.00 255.0 ECU_ADDRESS 0xD00092D0 /end MEASUREMENT
/begin MEASUREMENT DFES_EnvBlock1103 "vollständige Umweldaten alle Fehlerspeichereinträge" UBYTE DFES_OneToOne 1 100 0.00 255.0 ECU_ADDRESS 0xD00092D1 /end MEASUREMENT
/begin MEASUREMENT DFES_EnvBlock1104 "vollständige Umweldaten alle Fehlerspeichereinträge" UBYTE DFES_OneToOne 1 100 0.00 255.0 ECU_ADDRESS 0xD00092D2 /end MEASUREMENT
/begin MEASUREMENT DFES_EnvBlock1105 "vollständige Umweldaten alle Fehlerspeichereinträge" UBYTE DFES_OneToOne 1 100 0.00 255.0 ECU_ADDRESS 0xD00092D3 /end MEASUREMENT
/begin MEASUREMENT DFES_EnvBlock1106 "vollständige Umweldaten alle Fehlerspeichereinträge" UBYTE DFES_OneToOne 1 100 0.00 255.0 ECU_ADDRESS 0xD00092D4 /end MEASUREMENT
/begin MEASUREMENT DFES_EnvBlock1107 "vollständige Umweldaten alle Fehlerspeichereinträge" UBYTE DFES_OneToOne 1 100 0.00 255.0 ECU_ADDRESS 0xD00092D5 /end MEASUREMENT
/begin MEASUREMENT DFES_EnvBlock1108 "vollständige Umweldaten alle Fehlerspeichereinträge" UBYTE DFES_OneToOne 1 100 0.00 255.0 ECU_ADDRESS 0xD00092D6 /end MEASUREMENT
/begin MEASUREMENT DFES_EnvBlock1109 "vollständige Umweldaten alle Fehlerspeichereinträge" UBYTE DFES_OneToOne 1 100 0.00 255.0 ECU_ADDRESS 0xD00092D7 /end MEASUREMENT
/begin MEASUREMENT DFES_EnvBlock1110 "vollständige Umweldaten alle Fehlerspeichereinträge" UBYTE DFES_OneToOne 1 100 0.00 255.0 ECU_ADDRESS 0xD00092D8 /end MEASUREMENT
/begin MEASUREMENT DFES_EnvBlock1111 "vollständige Umweldaten alle Fehlerspeichereinträge" UBYTE DFES_OneToOne 1 100 0.00 255.0 ECU_ADDRESS 0xD00092D9 /end MEASUREMENT
/begin MEASUREMENT DFES_EnvBlock1112 "vollständige Umweldaten alle Fehlerspeichereinträge" UBYTE DFES_OneToOne 1 100 0.00 255.0 ECU_ADDRESS 0xD00092DA /end MEASUREMENT
/begin MEASUREMENT DFES_EnvBlock1113 "vollständige Umweldaten alle Fehlerspeichereinträge" UBYTE DFES_OneToOne 1 100 0.00 255.0 ECU_ADDRESS 0xD00092DB /end MEASUREMENT
/begin MEASUREMENT DFES_EnvBlock1114 "vollständige Umweldaten alle Fehlerspeichereinträge" UBYTE DFES_OneToOne 1 100 0.00 255.0 ECU_ADDRESS 0xD00092DC /end MEASUREMENT
/begin MEASUREMENT DFES_EnvBlock1115 "vollständige Umweldaten alle Fehlerspeichereinträge" UBYTE DFES_OneToOne 1 100 0.00 255.0 ECU_ADDRESS 0xD00092DD /end MEASUREMENT
/begin MEASUREMENT DFES_EnvBlock1116 "vollständige Umweldaten alle Fehlerspeichereinträge" UBYTE DFES_OneToOne 1 100 0.00 255.0 ECU_ADDRESS 0xD00092DE /end MEASUREMENT
/begin MEASUREMENT DFES_EnvBlock1117 "vollständige Umweldaten alle Fehlerspeichereinträge" UBYTE DFES_OneToOne 1 100 0.00 255.0 ECU_ADDRESS 0xD00092DF /end MEASUREMENT
/begin MEASUREMENT DFES_EnvBlock1118 "vollständige Umweldaten alle Fehlerspeichereinträge" UBYTE DFES_OneToOne 1 100 0.00 255.0 ECU_ADDRESS 0xD00092E0 /end MEASUREMENT
/begin MEASUREMENT DFES_EnvBlock1119 "vollständige Umweldaten alle Fehlerspeichereinträge" UBYTE DFES_OneToOne 1 100 0.00 255.0 ECU_ADDRESS 0xD00092E1 /end MEASUREMENT
/begin MEASUREMENT DFES_EnvBlock1120 "vollständige Umweldaten alle Fehlerspeichereinträge" UBYTE DFES_OneToOne 1 100 0.00 255.0 ECU_ADDRESS 0xD00092E2 /end MEASUREMENT
/begin MEASUREMENT DFES_EnvBlock1121 "vollständige Umweldaten alle Fehlerspeichereinträge" UBYTE DFES_OneToOne 1 100 0.00 255.0 ECU_ADDRESS 0xD00092E3 /end MEASUREMENT
/begin MEASUREMENT DFES_EnvBlock1122 "vollständige Umweldaten alle Fehlerspeichereinträge" UBYTE DFES_OneToOne 1 100 0.00 255.0 ECU_ADDRESS 0xD00092E4 /end MEASUREMENT
/begin MEASUREMENT DFES_EnvBlock1123 "vollständige Umweldaten alle Fehlerspeichereinträge" UBYTE DFES_OneToOne 1 100 0.00 255.0 ECU_ADDRESS 0xD00092E5 /end MEASUREMENT
/begin MEASUREMENT DFES_EnvBlock1124 "vollständige Umweldaten alle Fehlerspeichereinträge" UBYTE DFES_OneToOne 1 100 0.00 255.0 ECU_ADDRESS 0xD00092E6 /end MEASUREMENT
/begin MEASUREMENT DFES_EnvBlock1125 "vollständige Umweldaten alle Fehlerspeichereinträge" UBYTE DFES_OneToOne 1 100 0.00 255.0 ECU_ADDRESS 0xD00092E7 /end MEASUREMENT
/begin MEASUREMENT DFES_EnvBlock1126 "vollständige Umweldaten alle Fehlerspeichereinträge" UBYTE DFES_OneToOne 1 100 0.00 255.0 ECU_ADDRESS 0xD00092E8 /end MEASUREMENT
/begin MEASUREMENT DFES_EnvBlock1127 "vollständige Umweldaten alle Fehlerspeichereinträge" UBYTE DFES_OneToOne 1 100 0.00 255.0 ECU_ADDRESS 0xD00092E9 /end MEASUREMENT
/begin MEASUREMENT DFES_EnvBlock1128 "vollständige Umweldaten alle Fehlerspeichereinträge" UBYTE DFES_OneToOne 1 100 0.00 255.0 ECU_ADDRESS 0xD00092EA /end MEASUREMENT
/begin MEASUREMENT DFES_EnvBlock1129 "vollständige Umweldaten alle Fehlerspeichereinträge" UBYTE DFES_OneToOne 1 100 0.00 255.0 ECU_ADDRESS 0xD00092EB /end MEASUREMENT
/begin MEASUREMENT DFES_EnvBlock1130 "vollständige Umweldaten alle Fehlerspeichereinträge" UBYTE DFES_OneToOne 1 100 0.00 255.0 ECU_ADDRESS 0xD00092EC /end MEASUREMENT
/begin MEASUREMENT DFES_EnvBlock1131 "vollständige Umweldaten alle Fehlerspeichereinträge" UBYTE DFES_OneToOne 1 100 0.00 255.0 ECU_ADDRESS 0xD00092ED /end MEASUREMENT
/begin MEASUREMENT DFES_EnvBlock1132 "vollständige Umweldaten alle Fehlerspeichereinträge" UBYTE DFES_OneToOne 1 100 0.00 255.0 ECU_ADDRESS 0xD00092EE /end MEASUREMENT
/begin MEASUREMENT DFES_EnvBlock1133 "vollständige Umweldaten alle Fehlerspeichereinträge" UBYTE DFES_OneToOne 1 100 0.00 255.0 ECU_ADDRESS 0xD00092EF /end MEASUREMENT
/begin MEASUREMENT DFES_EnvBlock1134 "vollständige Umweldaten alle Fehlerspeichereinträge" UBYTE DFES_OneToOne 1 100 0.00 255.0 ECU_ADDRESS 0xD00092F0 /end MEASUREMENT
/begin MEASUREMENT DFES_EnvBlock1135 "vollständige Umweldaten alle Fehlerspeichereinträge" UBYTE DFES_OneToOne 1 100 0.00 255.0 ECU_ADDRESS 0xD00092F1 /end MEASUREMENT
/begin MEASUREMENT DFES_EnvBlock1136 "vollständige Umweldaten alle Fehlerspeichereinträge" UBYTE DFES_OneToOne 1 100 0.00 255.0 ECU_ADDRESS 0xD00092F2 /end MEASUREMENT
/begin MEASUREMENT DFES_EnvBlock1137 "vollständige Umweldaten alle Fehlerspeichereinträge" UBYTE DFES_OneToOne 1 100 0.00 255.0 ECU_ADDRESS 0xD00092F3 /end MEASUREMENT
/begin MEASUREMENT DFES_EnvBlock1138 "vollständige Umweldaten alle Fehlerspeichereinträge" UBYTE DFES_OneToOne 1 100 0.00 255.0 ECU_ADDRESS 0xD00092F4 /end MEASUREMENT
/begin MEASUREMENT DFES_EnvBlock1139 "vollständige Umweldaten alle Fehlerspeichereinträge" UBYTE DFES_OneToOne 1 100 0.00 255.0 ECU_ADDRESS 0xD00092F5 /end MEASUREMENT
/begin MEASUREMENT DFES_EnvBlock1140 "vollständige Umweldaten alle Fehlerspeichereinträge" UBYTE DFES_OneToOne 1 100 0.00 255.0 ECU_ADDRESS 0xD00092F6 /end MEASUREMENT
/begin MEASUREMENT DFES_EnvBlock1141 "vollständige Umweldaten alle Fehlerspeichereinträge" UBYTE DFES_OneToOne 1 100 0.00 255.0 ECU_ADDRESS 0xD00092F7 /end MEASUREMENT
/begin MEASUREMENT DFES_EnvBlock1142 "vollständige Umweldaten alle Fehlerspeichereinträge" UBYTE DFES_OneToOne 1 100 0.00 255.0 ECU_ADDRESS 0xD00092F8 /end MEASUREMENT
/begin MEASUREMENT DFES_EnvBlock1143 "vollständige Umweldaten alle Fehlerspeichereinträge" UBYTE DFES_OneToOne 1 100 0.00 255.0 ECU_ADDRESS 0xD00092F9 /end MEASUREMENT
/begin MEASUREMENT DFES_EnvBlock1144 "vollständige Umweldaten alle Fehlerspeichereinträge" UBYTE DFES_OneToOne 1 100 0.00 255.0 ECU_ADDRESS 0xD00092FA /end MEASUREMENT
/begin MEASUREMENT DFES_EnvBlock1145 "vollständige Umweldaten alle Fehlerspeichereinträge" UBYTE DFES_OneToOne 1 100 0.00 255.0 ECU_ADDRESS 0xD00092FB /end MEASUREMENT
/begin MEASUREMENT DFES_EnvBlock1146 "vollständige Umweldaten alle Fehlerspeichereinträge" UBYTE DFES_OneToOne 1 100 0.00 255.0 ECU_ADDRESS 0xD00092FC /end MEASUREMENT
/begin MEASUREMENT DFES_EnvBlock1147 "vollständige Umweldaten alle Fehlerspeichereinträge" UBYTE DFES_OneToOne 1 100 0.00 255.0 ECU_ADDRESS 0xD00092FD /end MEASUREMENT
/begin MEASUREMENT DFES_EnvBlock1148 "vollständige Umweldaten alle Fehlerspeichereinträge" UBYTE DFES_OneToOne 1 100 0.00 255.0 ECU_ADDRESS 0xD00092FE /end MEASUREMENT
/begin MEASUREMENT DFES_EnvBlock1149 "vollständige Umweldaten alle Fehlerspeichereinträge" UBYTE DFES_OneToOne 1 100 0.00 255.0 ECU_ADDRESS 0xD00092FF /end MEASUREMENT
/begin MEASUREMENT DFES_EnvBlock1150 "vollständige Umweldaten alle Fehlerspeichereinträge" UBYTE DFES_OneToOne 1 100 0.00 255.0 ECU_ADDRESS 0xD0009300 /end MEASUREMENT
/begin MEASUREMENT DFES_EnvBlock1151 "vollständige Umweldaten alle Fehlerspeichereinträge" UBYTE DFES_OneToOne 1 100 0.00 255.0 ECU_ADDRESS 0xD0009301 /end MEASUREMENT
/begin MEASUREMENT DFES_EnvBlock1152 "vollständige Umweldaten alle Fehlerspeichereinträge" UBYTE DFES_OneToOne 1 100 0.00 255.0 ECU_ADDRESS 0xD0009302 /end MEASUREMENT
/begin MEASUREMENT DFES_EnvBlock1153 "vollständige Umweldaten alle Fehlerspeichereinträge" UBYTE DFES_OneToOne 1 100 0.00 255.0 ECU_ADDRESS 0xD0009303 /end MEASUREMENT
/begin MEASUREMENT DFES_EnvBlock1154 "vollständige Umweldaten alle Fehlerspeichereinträge" UBYTE DFES_OneToOne 1 100 0.00 255.0 ECU_ADDRESS 0xD0009304 /end MEASUREMENT
/begin MEASUREMENT DFES_EnvBlock1155 "vollständige Umweldaten alle Fehlerspeichereinträge" UBYTE DFES_OneToOne 1 100 0.00 255.0 ECU_ADDRESS 0xD0009305 /end MEASUREMENT
/begin MEASUREMENT DFES_EnvBlock1156 "vollständige Umweldaten alle Fehlerspeichereinträge" UBYTE DFES_OneToOne 1 100 0.00 255.0 ECU_ADDRESS 0xD0009306 /end MEASUREMENT
/begin MEASUREMENT DFES_EnvBlock1157 "vollständige Umweldaten alle Fehlerspeichereinträge" UBYTE DFES_OneToOne 1 100 0.00 255.0 ECU_ADDRESS 0xD0009307 /end MEASUREMENT
/begin MEASUREMENT DFES_EnvBlock1158 "vollständige Umweldaten alle Fehlerspeichereinträge" UBYTE DFES_OneToOne 1 100 0.00 255.0 ECU_ADDRESS 0xD0009308 /end MEASUREMENT
/begin MEASUREMENT DFES_EnvBlock1159 "vollständige Umweldaten alle Fehlerspeichereinträge" UBYTE DFES_OneToOne 1 100 0.00 255.0 ECU_ADDRESS 0xD0009309 /end MEASUREMENT
/begin MEASUREMENT DFES_EnvBlock1160 "vollständige Umweldaten alle Fehlerspeichereinträge" UBYTE DFES_OneToOne 1 100 0.00 255.0 ECU_ADDRESS 0xD000930A /end MEASUREMENT
/begin MEASUREMENT DFES_EnvBlock1161 "vollständige Umweldaten alle Fehlerspeichereinträge" UBYTE DFES_OneToOne 1 100 0.00 255.0 ECU_ADDRESS 0xD000930B /end MEASUREMENT
/begin MEASUREMENT DFES_EnvBlock1162 "vollständige Umweldaten alle Fehlerspeichereinträge" UBYTE DFES_OneToOne 1 100 0.00 255.0 ECU_ADDRESS 0xD000930C /end MEASUREMENT
/begin MEASUREMENT DFES_EnvBlock1163 "vollständige Umweldaten alle Fehlerspeichereinträge" UBYTE DFES_OneToOne 1 100 0.00 255.0 ECU_ADDRESS 0xD000930D /end MEASUREMENT
/begin MEASUREMENT DFES_EnvBlock1164 "vollständige Umweldaten alle Fehlerspeichereinträge" UBYTE DFES_OneToOne 1 100 0.00 255.0 ECU_ADDRESS 0xD000930E /end MEASUREMENT
/begin MEASUREMENT DFES_EnvBlock1165 "vollständige Umweldaten alle Fehlerspeichereinträge" UBYTE DFES_OneToOne 1 100 0.00 255.0 ECU_ADDRESS 0xD000930F /end MEASUREMENT
/begin MEASUREMENT DFES_EnvBlock1166 "vollständige Umweldaten alle Fehlerspeichereinträge" UBYTE DFES_OneToOne 1 100 0.00 255.0 ECU_ADDRESS 0xD0009310 /end MEASUREMENT
/begin MEASUREMENT DFES_EnvBlock1167 "vollständige Umweldaten alle Fehlerspeichereinträge" UBYTE DFES_OneToOne 1 100 0.00 255.0 ECU_ADDRESS 0xD0009311 /end MEASUREMENT
/begin MEASUREMENT DFES_EnvBlock1168 "vollständige Umweldaten alle Fehlerspeichereinträge" UBYTE DFES_OneToOne 1 100 0.00 255.0 ECU_ADDRESS 0xD0009312 /end MEASUREMENT
/begin MEASUREMENT DFES_EnvBlock1169 "vollständige Umweldaten alle Fehlerspeichereinträge" UBYTE DFES_OneToOne 1 100 0.00 255.0 ECU_ADDRESS 0xD0009313 /end MEASUREMENT
/begin MEASUREMENT DFES_EnvBlock1170 "vollständige Umweldaten alle Fehlerspeichereinträge" UBYTE DFES_OneToOne 1 100 0.00 255.0 ECU_ADDRESS 0xD0009314 /end MEASUREMENT
/begin MEASUREMENT DFES_EnvBlock1171 "vollständige Umweldaten alle Fehlerspeichereinträge" UBYTE DFES_OneToOne 1 100 0.00 255.0 ECU_ADDRESS 0xD0009315 /end MEASUREMENT
/begin MEASUREMENT DFES_EnvBlock1172 "vollständige Umweldaten alle Fehlerspeichereinträge" UBYTE DFES_OneToOne 1 100 0.00 255.0 ECU_ADDRESS 0xD0009316 /end MEASUREMENT
/begin MEASUREMENT DFES_EnvBlock1173 "vollständige Umweldaten alle Fehlerspeichereinträge" UBYTE DFES_OneToOne 1 100 0.00 255.0 ECU_ADDRESS 0xD0009317 /end MEASUREMENT
/begin MEASUREMENT DFES_EnvBlock1174 "vollständige Umweldaten alle Fehlerspeichereinträge" UBYTE DFES_OneToOne 1 100 0.00 255.0 ECU_ADDRESS 0xD0009318 /end MEASUREMENT
/begin MEASUREMENT DFES_EnvBlock1175 "vollständige Umweldaten alle Fehlerspeichereinträge" UBYTE DFES_OneToOne 1 100 0.00 255.0 ECU_ADDRESS 0xD0009319 /end MEASUREMENT
/begin MEASUREMENT DFES_EnvBlock1176 "vollständige Umweldaten alle Fehlerspeichereinträge" UBYTE DFES_OneToOne 1 100 0.00 255.0 ECU_ADDRESS 0xD000931A /end MEASUREMENT
/begin MEASUREMENT DFES_EnvBlock1177 "vollständige Umweldaten alle Fehlerspeichereinträge" UBYTE DFES_OneToOne 1 100 0.00 255.0 ECU_ADDRESS 0xD000931B /end MEASUREMENT
/begin MEASUREMENT DFES_EnvBlock1178 "vollständige Umweldaten alle Fehlerspeichereinträge" UBYTE DFES_OneToOne 1 100 0.00 255.0 ECU_ADDRESS 0xD000931C /end MEASUREMENT
/begin MEASUREMENT DFES_EnvBlock1179 "vollständige Umweldaten alle Fehlerspeichereinträge" UBYTE DFES_OneToOne 1 100 0.00 255.0 ECU_ADDRESS 0xD000931D /end MEASUREMENT
/begin MEASUREMENT DFES_EnvBlock1180 "vollständige Umweldaten alle Fehlerspeichereinträge" UBYTE DFES_OneToOne 1 100 0.00 255.0 ECU_ADDRESS 0xD000931E /end MEASUREMENT
/begin MEASUREMENT DFES_EnvBlock1181 "vollständige Umweldaten alle Fehlerspeichereinträge" UBYTE DFES_OneToOne 1 100 0.00 255.0 ECU_ADDRESS 0xD000931F /end MEASUREMENT
/begin MEASUREMENT DFES_EnvBlock1182 "vollständige Umweldaten alle Fehlerspeichereinträge" UBYTE DFES_OneToOne 1 100 0.00 255.0 ECU_ADDRESS 0xD0009320 /end MEASUREMENT
/begin MEASUREMENT DFES_EnvBlock1183 "vollständige Umweldaten alle Fehlerspeichereinträge" UBYTE DFES_OneToOne 1 100 0.00 255.0 ECU_ADDRESS 0xD0009321 /end MEASUREMENT
/begin MEASUREMENT DFES_EnvBlock1184 "vollständige Umweldaten alle Fehlerspeichereinträge" UBYTE DFES_OneToOne 1 100 0.00 255.0 ECU_ADDRESS 0xD0009322 /end MEASUREMENT
/begin MEASUREMENT DFES_EnvBlock1185 "vollständige Umweldaten alle Fehlerspeichereinträge" UBYTE DFES_OneToOne 1 100 0.00 255.0 ECU_ADDRESS 0xD0009323 /end MEASUREMENT
/begin MEASUREMENT DFES_EnvBlock1186 "vollständige Umweldaten alle Fehlerspeichereinträge" UBYTE DFES_OneToOne 1 100 0.00 255.0 ECU_ADDRESS 0xD0009324 /end MEASUREMENT
/begin MEASUREMENT DFES_EnvBlock1187 "vollständige Umweldaten alle Fehlerspeichereinträge" UBYTE DFES_OneToOne 1 100 0.00 255.0 ECU_ADDRESS 0xD0009325 /end MEASUREMENT
/begin MEASUREMENT DFES_EnvBlock1188 "vollständige Umweldaten alle Fehlerspeichereinträge" UBYTE DFES_OneToOne 1 100 0.00 255.0 ECU_ADDRESS 0xD0009326 /end MEASUREMENT
/begin MEASUREMENT DFES_EnvBlock1189 "vollständige Umweldaten alle Fehlerspeichereinträge" UBYTE DFES_OneToOne 1 100 0.00 255.0 ECU_ADDRESS 0xD0009327 /end MEASUREMENT
/begin MEASUREMENT DFES_EnvBlock1190 "vollständige Umweldaten alle Fehlerspeichereinträge" UBYTE DFES_OneToOne 1 100 0.00 255.0 ECU_ADDRESS 0xD0009328 /end MEASUREMENT
/begin MEASUREMENT DFES_EnvBlock1191 "vollständige Umweldaten alle Fehlerspeichereinträge" UBYTE DFES_OneToOne 1 100 0.00 255.0 ECU_ADDRESS 0xD0009329 /end MEASUREMENT
/begin MEASUREMENT DFES_EnvBlock1192 "vollständige Umweldaten alle Fehlerspeichereinträge" UBYTE DFES_OneToOne 1 100 0.00 255.0 ECU_ADDRESS 0xD000932A /end MEASUREMENT
/begin MEASUREMENT DFES_EnvBlock1193 "vollständige Umweldaten alle Fehlerspeichereinträge" UBYTE DFES_OneToOne 1 100 0.00 255.0 ECU_ADDRESS 0xD000932B /end MEASUREMENT
/begin MEASUREMENT DFES_EnvBlock1194 "vollständige Umweldaten alle Fehlerspeichereinträge" UBYTE DFES_OneToOne 1 100 0.00 255.0 ECU_ADDRESS 0xD000932C /end MEASUREMENT
/begin MEASUREMENT DFES_EnvBlock1195 "vollständige Umweldaten alle Fehlerspeichereinträge" UBYTE DFES_OneToOne 1 100 0.00 255.0 ECU_ADDRESS 0xD000932D /end MEASUREMENT
/begin MEASUREMENT DFES_EnvBlock1196 "vollständige Umweldaten alle Fehlerspeichereinträge" UBYTE DFES_OneToOne 1 100 0.00 255.0 ECU_ADDRESS 0xD000932E /end MEASUREMENT
/begin MEASUREMENT DFES_EnvBlock1197 "vollständige Umweldaten alle Fehlerspeichereinträge" UBYTE DFES_OneToOne 1 100 0.00 255.0 ECU_ADDRESS 0xD000932F /end MEASUREMENT
/begin MEASUREMENT DFES_EnvBlock1198 "vollständige Umweldaten alle Fehlerspeichereinträge" UBYTE DFES_OneToOne 1 100 0.00 255.0 ECU_ADDRESS 0xD0009330 /end MEASUREMENT
/begin MEASUREMENT DFES_EnvBlock1199 "vollständige Umweldaten alle Fehlerspeichereinträge" UBYTE DFES_OneToOne 1 100 0.00 255.0 ECU_ADDRESS 0xD0009331 /end MEASUREMENT
/begin MEASUREMENT DFES_EnvBlock1200 "vollständige Umweldaten alle Fehlerspeichereinträge" UBYTE DFES_OneToOne 1 100 0.00 255.0 ECU_ADDRESS 0xD0009332 /end MEASUREMENT
/begin MEASUREMENT DFES_EnvBlock1201 "vollständige Umweldaten alle Fehlerspeichereinträge" UBYTE DFES_OneToOne 1 100 0.00 255.0 ECU_ADDRESS 0xD0009333 /end MEASUREMENT
/begin MEASUREMENT DFES_EnvBlock1202 "vollständige Umweldaten alle Fehlerspeichereinträge" UBYTE DFES_OneToOne 1 100 0.00 255.0 ECU_ADDRESS 0xD0009334 /end MEASUREMENT
/begin MEASUREMENT DFES_EnvBlock1203 "vollständige Umweldaten alle Fehlerspeichereinträge" UBYTE DFES_OneToOne 1 100 0.00 255.0 ECU_ADDRESS 0xD0009335 /end MEASUREMENT
/begin MEASUREMENT DFES_EnvBlock1204 "vollständige Umweldaten alle Fehlerspeichereinträge" UBYTE DFES_OneToOne 1 100 0.00 255.0 ECU_ADDRESS 0xD0009336 /end MEASUREMENT
/begin MEASUREMENT DFES_EnvBlock1205 "vollständige Umweldaten alle Fehlerspeichereinträge" UBYTE DFES_OneToOne 1 100 0.00 255.0 ECU_ADDRESS 0xD0009337 /end MEASUREMENT
/begin MEASUREMENT DFES_EnvBlock1206 "vollständige Umweldaten alle Fehlerspeichereinträge" UBYTE DFES_OneToOne 1 100 0.00 255.0 ECU_ADDRESS 0xD0009338 /end MEASUREMENT
/begin MEASUREMENT DFES_EnvBlock1207 "vollständige Umweldaten alle Fehlerspeichereinträge" UBYTE DFES_OneToOne 1 100 0.00 255.0 ECU_ADDRESS 0xD0009339 /end MEASUREMENT
/begin MEASUREMENT DFES_EnvBlock1208 "vollständige Umweldaten alle Fehlerspeichereinträge" UBYTE DFES_OneToOne 1 100 0.00 255.0 ECU_ADDRESS 0xD000933A /end MEASUREMENT
/begin MEASUREMENT DFES_EnvBlock1209 "vollständige Umweldaten alle Fehlerspeichereinträge" UBYTE DFES_OneToOne 1 100 0.00 255.0 ECU_ADDRESS 0xD000933B /end MEASUREMENT
/begin MEASUREMENT DFES_EnvBlock1210 "vollständige Umweldaten alle Fehlerspeichereinträge" UBYTE DFES_OneToOne 1 100 0.00 255.0 ECU_ADDRESS 0xD000933C /end MEASUREMENT
/begin MEASUREMENT DFES_EnvBlock1211 "vollständige Umweldaten alle Fehlerspeichereinträge" UBYTE DFES_OneToOne 1 100 0.00 255.0 ECU_ADDRESS 0xD000933D /end MEASUREMENT
/begin MEASUREMENT DFES_EnvBlock1212 "vollständige Umweldaten alle Fehlerspeichereinträge" UBYTE DFES_OneToOne 1 100 0.00 255.0 ECU_ADDRESS 0xD000933E /end MEASUREMENT
/begin MEASUREMENT DFES_EnvBlock1213 "vollständige Umweldaten alle Fehlerspeichereinträge" UBYTE DFES_OneToOne 1 100 0.00 255.0 ECU_ADDRESS 0xD000933F /end MEASUREMENT
/begin MEASUREMENT DFES_EnvBlock1214 "vollständige Umweldaten alle Fehlerspeichereinträge" UBYTE DFES_OneToOne 1 100 0.00 255.0 ECU_ADDRESS 0xD0009340 /end MEASUREMENT
/begin MEASUREMENT DFES_EnvBlock1215 "vollständige Umweldaten alle Fehlerspeichereinträge" UBYTE DFES_OneToOne 1 100 0.00 255.0 ECU_ADDRESS 0xD0009341 /end MEASUREMENT
/begin MEASUREMENT DFES_EnvBlock1216 "vollständige Umweldaten alle Fehlerspeichereinträge" UBYTE DFES_OneToOne 1 100 0.00 255.0 ECU_ADDRESS 0xD0009342 /end MEASUREMENT
/begin MEASUREMENT DFES_EnvBlock1217 "vollständige Umweldaten alle Fehlerspeichereinträge" UBYTE DFES_OneToOne 1 100 0.00 255.0 ECU_ADDRESS 0xD0009343 /end MEASUREMENT
/begin MEASUREMENT DFES_EnvBlock1218 "vollständige Umweldaten alle Fehlerspeichereinträge" UBYTE DFES_OneToOne 1 100 0.00 255.0 ECU_ADDRESS 0xD0009344 /end MEASUREMENT
/begin MEASUREMENT DFES_EnvBlock1219 "vollständige Umweldaten alle Fehlerspeichereinträge" UBYTE DFES_OneToOne 1 100 0.00 255.0 ECU_ADDRESS 0xD0009345 /end MEASUREMENT
/begin MEASUREMENT DFES_EnvBlock1220 "vollständige Umweldaten alle Fehlerspeichereinträge" UBYTE DFES_OneToOne 1 100 0.00 255.0 ECU_ADDRESS 0xD0009346 /end MEASUREMENT
/begin MEASUREMENT DFES_EnvBlock1221 "vollständige Umweldaten alle Fehlerspeichereinträge" UBYTE DFES_OneToOne 1 100 0.00 255.0 ECU_ADDRESS 0xD0009347 /end MEASUREMENT
/begin MEASUREMENT DFES_EnvBlock1222 "vollständige Umweldaten alle Fehlerspeichereinträge" UBYTE DFES_OneToOne 1 100 0.00 255.0 ECU_ADDRESS 0xD0009348 /end MEASUREMENT
/begin MEASUREMENT DFES_EnvBlock1223 "vollständige Umweldaten alle Fehlerspeichereinträge" UBYTE DFES_OneToOne 1 100 0.00 255.0 ECU_ADDRESS 0xD0009349 /end MEASUREMENT
/begin MEASUREMENT DFES_EnvBlock1224 "vollständige Umweldaten alle Fehlerspeichereinträge" UBYTE DFES_OneToOne 1 100 0.00 255.0 ECU_ADDRESS 0xD000934A /end MEASUREMENT
/begin MEASUREMENT DFES_EnvBlock1225 "vollständige Umweldaten alle Fehlerspeichereinträge" UBYTE DFES_OneToOne 1 100 0.00 255.0 ECU_ADDRESS 0xD000934B /end MEASUREMENT
/begin MEASUREMENT DFES_EnvBlock1226 "vollständige Umweldaten alle Fehlerspeichereinträge" UBYTE DFES_OneToOne 1 100 0.00 255.0 ECU_ADDRESS 0xD000934C /end MEASUREMENT
/begin MEASUREMENT DFES_EnvBlock1227 "vollständige Umweldaten alle Fehlerspeichereinträge" UBYTE DFES_OneToOne 1 100 0.00 255.0 ECU_ADDRESS 0xD000934D /end MEASUREMENT
/begin MEASUREMENT DFES_EnvBlock1228 "vollständige Umweldaten alle Fehlerspeichereinträge" UBYTE DFES_OneToOne 1 100 0.00 255.0 ECU_ADDRESS 0xD000934E /end MEASUREMENT
/begin MEASUREMENT DFES_EnvBlock1229 "vollständige Umweldaten alle Fehlerspeichereinträge" UBYTE DFES_OneToOne 1 100 0.00 255.0 ECU_ADDRESS 0xD000934F /end MEASUREMENT
/begin MEASUREMENT DFES_EnvBlock1230 "vollständige Umweldaten alle Fehlerspeichereinträge" UBYTE DFES_OneToOne 1 100 0.00 255.0 ECU_ADDRESS 0xD0009350 /end MEASUREMENT
/begin MEASUREMENT DFES_EnvBlock1231 "vollständige Umweldaten alle Fehlerspeichereinträge" UBYTE DFES_OneToOne 1 100 0.00 255.0 ECU_ADDRESS 0xD0009351 /end MEASUREMENT
/begin MEASUREMENT DFES_EnvBlock1232 "vollständige Umweldaten alle Fehlerspeichereinträge" UBYTE DFES_OneToOne 1 100 0.00 255.0 ECU_ADDRESS 0xD0009352 /end MEASUREMENT
/begin MEASUREMENT DFES_EnvBlock1233 "vollständige Umweldaten alle Fehlerspeichereinträge" UBYTE DFES_OneToOne 1 100 0.00 255.0 ECU_ADDRESS 0xD0009353 /end MEASUREMENT
/begin MEASUREMENT DFES_EnvBlock1234 "vollständige Umweldaten alle Fehlerspeichereinträge" UBYTE DFES_OneToOne 1 100 0.00 255.0 ECU_ADDRESS 0xD0009354 /end MEASUREMENT
/begin MEASUREMENT DFES_EnvBlock1235 "vollständige Umweldaten alle Fehlerspeichereinträge" UBYTE DFES_OneToOne 1 100 0.00 255.0 ECU_ADDRESS 0xD0009355 /end MEASUREMENT
/begin MEASUREMENT DFES_EnvBlock1236 "vollständige Umweldaten alle Fehlerspeichereinträge" UBYTE DFES_OneToOne 1 100 0.00 255.0 ECU_ADDRESS 0xD0009356 /end MEASUREMENT
/begin MEASUREMENT DFES_EnvBlock1237 "vollständige Umweldaten alle Fehlerspeichereinträge" UBYTE DFES_OneToOne 1 100 0.00 255.0 ECU_ADDRESS 0xD0009357 /end MEASUREMENT
/begin MEASUREMENT DFES_EnvBlock1238 "vollständige Umweldaten alle Fehlerspeichereinträge" UBYTE DFES_OneToOne 1 100 0.00 255.0 ECU_ADDRESS 0xD0009358 /end MEASUREMENT
/begin MEASUREMENT DFES_EnvBlock1239 "vollständige Umweldaten alle Fehlerspeichereinträge" UBYTE DFES_OneToOne 1 100 0.00 255.0 ECU_ADDRESS 0xD0009359 /end MEASUREMENT
/begin MEASUREMENT DFES_EnvBlock1240 "vollständige Umweldaten alle Fehlerspeichereinträge" UBYTE DFES_OneToOne 1 100 0.00 255.0 ECU_ADDRESS 0xD000935A /end MEASUREMENT
/begin MEASUREMENT DFES_EnvBlock1241 "vollständige Umweldaten alle Fehlerspeichereinträge" UBYTE DFES_OneToOne 1 100 0.00 255.0 ECU_ADDRESS 0xD000935B /end MEASUREMENT
/begin MEASUREMENT DFES_EnvBlock1242 "vollständige Umweldaten alle Fehlerspeichereinträge" UBYTE DFES_OneToOne 1 100 0.00 255.0 ECU_ADDRESS 0xD000935C /end MEASUREMENT
/begin MEASUREMENT DFES_EnvBlock1243 "vollständige Umweldaten alle Fehlerspeichereinträge" UBYTE DFES_OneToOne 1 100 0.00 255.0 ECU_ADDRESS 0xD000935D /end MEASUREMENT
/begin MEASUREMENT DFES_EnvBlock1244 "vollständige Umweldaten alle Fehlerspeichereinträge" UBYTE DFES_OneToOne 1 100 0.00 255.0 ECU_ADDRESS 0xD000935E /end MEASUREMENT
/begin MEASUREMENT DFES_EnvBlock1245 "vollständige Umweldaten alle Fehlerspeichereinträge" UBYTE DFES_OneToOne 1 100 0.00 255.0 ECU_ADDRESS 0xD000935F /end MEASUREMENT
/begin MEASUREMENT DFES_EnvBlock1246 "vollständige Umweldaten alle Fehlerspeichereinträge" UBYTE DFES_OneToOne 1 100 0.00 255.0 ECU_ADDRESS 0xD0009360 /end MEASUREMENT
/begin MEASUREMENT DFES_EnvBlock1247 "vollständige Umweldaten alle Fehlerspeichereinträge" UBYTE DFES_OneToOne 1 100 0.00 255.0 ECU_ADDRESS 0xD0009361 /end MEASUREMENT
/begin MEASUREMENT DFES_EnvBlock1248 "vollständige Umweldaten alle Fehlerspeichereinträge" UBYTE DFES_OneToOne 1 100 0.00 255.0 ECU_ADDRESS 0xD0009362 /end MEASUREMENT
/begin MEASUREMENT DFES_EnvBlock1249 "vollständige Umweldaten alle Fehlerspeichereinträge" UBYTE DFES_OneToOne 1 100 0.00 255.0 ECU_ADDRESS 0xD0009363 /end MEASUREMENT
/begin MEASUREMENT DFES_EnvBlock1250 "vollständige Umweldaten alle Fehlerspeichereinträge" UBYTE DFES_OneToOne 1 100 0.00 255.0 ECU_ADDRESS 0xD0009364 /end MEASUREMENT
/begin MEASUREMENT DFES_EnvBlock1251 "vollständige Umweldaten alle Fehlerspeichereinträge" UBYTE DFES_OneToOne 1 100 0.00 255.0 ECU_ADDRESS 0xD0009365 /end MEASUREMENT
/begin MEASUREMENT DFES_EnvBlock1252 "vollständige Umweldaten alle Fehlerspeichereinträge" UBYTE DFES_OneToOne 1 100 0.00 255.0 ECU_ADDRESS 0xD0009366 /end MEASUREMENT
/begin MEASUREMENT DFES_EnvBlock1253 "vollständige Umweldaten alle Fehlerspeichereinträge" UBYTE DFES_OneToOne 1 100 0.00 255.0 ECU_ADDRESS 0xD0009367 /end MEASUREMENT
/begin MEASUREMENT DFES_EnvBlock1254 "vollständige Umweldaten alle Fehlerspeichereinträge" UBYTE DFES_OneToOne 1 100 0.00 255.0 ECU_ADDRESS 0xD0009368 /end MEASUREMENT
/begin MEASUREMENT DFES_EnvBlock1255 "vollständige Umweldaten alle Fehlerspeichereinträge" UBYTE DFES_OneToOne 1 100 0.00 255.0 ECU_ADDRESS 0xD0009369 /end MEASUREMENT
/begin MEASUREMENT DFES_EnvBlock1256 "vollständige Umweldaten alle Fehlerspeichereinträge" UBYTE DFES_OneToOne 1 100 0.00 255.0 ECU_ADDRESS 0xD000936A /end MEASUREMENT
/begin MEASUREMENT DFES_EnvBlock1257 "vollständige Umweldaten alle Fehlerspeichereinträge" UBYTE DFES_OneToOne 1 100 0.00 255.0 ECU_ADDRESS 0xD000936B /end MEASUREMENT
/begin MEASUREMENT DFES_EnvBlock1258 "vollständige Umweldaten alle Fehlerspeichereinträge" UBYTE DFES_OneToOne 1 100 0.00 255.0 ECU_ADDRESS 0xD000936C /end MEASUREMENT
/begin MEASUREMENT DFES_EnvBlock1259 "vollständige Umweldaten alle Fehlerspeichereinträge" UBYTE DFES_OneToOne 1 100 0.00 255.0 ECU_ADDRESS 0xD000936D /end MEASUREMENT
/begin MEASUREMENT DFES_EnvBlock1260 "vollständige Umweldaten alle Fehlerspeichereinträge" UBYTE DFES_OneToOne 1 100 0.00 255.0 ECU_ADDRESS 0xD000936E /end MEASUREMENT
/begin MEASUREMENT DFES_EnvBlock1261 "vollständige Umweldaten alle Fehlerspeichereinträge" UBYTE DFES_OneToOne 1 100 0.00 255.0 ECU_ADDRESS 0xD000936F /end MEASUREMENT
/begin MEASUREMENT DFES_EnvBlock1262 "vollständige Umweldaten alle Fehlerspeichereinträge" UBYTE DFES_OneToOne 1 100 0.00 255.0 ECU_ADDRESS 0xD0009370 /end MEASUREMENT
/begin MEASUREMENT DFES_EnvBlock1263 "vollständige Umweldaten alle Fehlerspeichereinträge" UBYTE DFES_OneToOne 1 100 0.00 255.0 ECU_ADDRESS 0xD0009371 /end MEASUREMENT
/begin MEASUREMENT DFES_EnvBlock1264 "vollständige Umweldaten alle Fehlerspeichereinträge" UBYTE DFES_OneToOne 1 100 0.00 255.0 ECU_ADDRESS 0xD0009372 /end MEASUREMENT
/begin MEASUREMENT DFES_EnvBlock1265 "vollständige Umweldaten alle Fehlerspeichereinträge" UBYTE DFES_OneToOne 1 100 0.00 255.0 ECU_ADDRESS 0xD0009373 /end MEASUREMENT
/begin MEASUREMENT DFES_EnvBlock1266 "vollständige Umweldaten alle Fehlerspeichereinträge" UBYTE DFES_OneToOne 1 100 0.00 255.0 ECU_ADDRESS 0xD0009374 /end MEASUREMENT
/begin MEASUREMENT DFES_EnvBlock1267 "vollständige Umweldaten alle Fehlerspeichereinträge" UBYTE DFES_OneToOne 1 100 0.00 255.0 ECU_ADDRESS 0xD0009375 /end MEASUREMENT
/begin MEASUREMENT DFES_EnvBlock1268 "vollständige Umweldaten alle Fehlerspeichereinträge" UBYTE DFES_OneToOne 1 100 0.00 255.0 ECU_ADDRESS 0xD0009376 /end MEASUREMENT
/begin MEASUREMENT DFES_EnvBlock1269 "vollständige Umweldaten alle Fehlerspeichereinträge" UBYTE DFES_OneToOne 1 100 0.00 255.0 ECU_ADDRESS 0xD0009377 /end MEASUREMENT
/begin MEASUREMENT DFES_EnvBlock1270 "vollständige Umweldaten alle Fehlerspeichereinträge" UBYTE DFES_OneToOne 1 100 0.00 255.0 ECU_ADDRESS 0xD0009378 /end MEASUREMENT
/begin MEASUREMENT DFES_EnvBlock1271 "vollständige Umweldaten alle Fehlerspeichereinträge" UBYTE DFES_OneToOne 1 100 0.00 255.0 ECU_ADDRESS 0xD0009379 /end MEASUREMENT
/begin MEASUREMENT DFES_EnvBlock1272 "vollständige Umweldaten alle Fehlerspeichereinträge" UBYTE DFES_OneToOne 1 100 0.00 255.0 ECU_ADDRESS 0xD000937A /end MEASUREMENT
/begin MEASUREMENT DFES_EnvBlock1273 "vollständige Umweldaten alle Fehlerspeichereinträge" UBYTE DFES_OneToOne 1 100 0.00 255.0 ECU_ADDRESS 0xD000937B /end MEASUREMENT
/begin MEASUREMENT DFES_EnvBlock1274 "vollständige Umweldaten alle Fehlerspeichereinträge" UBYTE DFES_OneToOne 1 100 0.00 255.0 ECU_ADDRESS 0xD000937C /end MEASUREMENT
/begin MEASUREMENT DFES_EnvBlock1275 "vollständige Umweldaten alle Fehlerspeichereinträge" UBYTE DFES_OneToOne 1 100 0.00 255.0 ECU_ADDRESS 0xD000937D /end MEASUREMENT
/begin MEASUREMENT DFES_EnvBlock1276 "vollständige Umweldaten alle Fehlerspeichereinträge" UBYTE DFES_OneToOne 1 100 0.00 255.0 ECU_ADDRESS 0xD000937E /end MEASUREMENT
/begin MEASUREMENT DFES_EnvBlock1277 "vollständige Umweldaten alle Fehlerspeichereinträge" UBYTE DFES_OneToOne 1 100 0.00 255.0 ECU_ADDRESS 0xD000937F /end MEASUREMENT
/begin MEASUREMENT DFES_EnvBlock1278 "vollständige Umweldaten alle Fehlerspeichereinträge" UBYTE DFES_OneToOne 1 100 0.00 255.0 ECU_ADDRESS 0xD0009380 /end MEASUREMENT
/begin MEASUREMENT DFES_EnvBlock1279 "vollständige Umweldaten alle Fehlerspeichereinträge" UBYTE DFES_OneToOne 1 100 0.00 255.0 ECU_ADDRESS 0xD0009381 /end MEASUREMENT
/begin MEASUREMENT DFES_EnvBlock1280 "vollständige Umweldaten alle Fehlerspeichereinträge" UBYTE DFES_OneToOne 1 100 0.00 255.0 ECU_ADDRESS 0xD0009382 /end MEASUREMENT
/begin MEASUREMENT DFES_EnvBlock1281 "vollständige Umweldaten alle Fehlerspeichereinträge" UBYTE DFES_OneToOne 1 100 0.00 255.0 ECU_ADDRESS 0xD0009383 /end MEASUREMENT
/begin MEASUREMENT DFES_EnvBlock1282 "vollständige Umweldaten alle Fehlerspeichereinträge" UBYTE DFES_OneToOne 1 100 0.00 255.0 ECU_ADDRESS 0xD0009384 /end MEASUREMENT
/begin MEASUREMENT DFES_EnvBlock1283 "vollständige Umweldaten alle Fehlerspeichereinträge" UBYTE DFES_OneToOne 1 100 0.00 255.0 ECU_ADDRESS 0xD0009385 /end MEASUREMENT
/begin MEASUREMENT DFES_EnvBlock1284 "vollständige Umweldaten alle Fehlerspeichereinträge" UBYTE DFES_OneToOne 1 100 0.00 255.0 ECU_ADDRESS 0xD0009386 /end MEASUREMENT
/begin MEASUREMENT DFES_EnvBlock1285 "vollständige Umweldaten alle Fehlerspeichereinträge" UBYTE DFES_OneToOne 1 100 0.00 255.0 ECU_ADDRESS 0xD0009387 /end MEASUREMENT
/begin MEASUREMENT DFES_EnvBlock1286 "vollständige Umweldaten alle Fehlerspeichereinträge" UBYTE DFES_OneToOne 1 100 0.00 255.0 ECU_ADDRESS 0xD0009388 /end MEASUREMENT
/begin MEASUREMENT DFES_EnvBlock1287 "vollständige Umweldaten alle Fehlerspeichereinträge" UBYTE DFES_OneToOne 1 100 0.00 255.0 ECU_ADDRESS 0xD0009389 /end MEASUREMENT
/begin MEASUREMENT DFES_EnvBlock1288 "vollständige Umweldaten alle Fehlerspeichereinträge" UBYTE DFES_OneToOne 1 100 0.00 255.0 ECU_ADDRESS 0xD000938A /end MEASUREMENT
/begin MEASUREMENT DFES_EnvBlock1289 "vollständige Umweldaten alle Fehlerspeichereinträge" UBYTE DFES_OneToOne 1 100 0.00 255.0 ECU_ADDRESS 0xD000938B /end MEASUREMENT
/begin MEASUREMENT DFES_EnvBlock1290 "vollständige Umweldaten alle Fehlerspeichereinträge" UBYTE DFES_OneToOne 1 100 0.00 255.0 ECU_ADDRESS 0xD000938C /end MEASUREMENT
/begin MEASUREMENT DFES_EnvBlock1291 "vollständige Umweldaten alle Fehlerspeichereinträge" UBYTE DFES_OneToOne 1 100 0.00 255.0 ECU_ADDRESS 0xD000938D /end MEASUREMENT
/begin MEASUREMENT DFES_EnvBlock1292 "vollständige Umweldaten alle Fehlerspeichereinträge" UBYTE DFES_OneToOne 1 100 0.00 255.0 ECU_ADDRESS 0xD000938E /end MEASUREMENT
/begin MEASUREMENT DFES_EnvBlock1293 "vollständige Umweldaten alle Fehlerspeichereinträge" UBYTE DFES_OneToOne 1 100 0.00 255.0 ECU_ADDRESS 0xD000938F /end MEASUREMENT
/begin MEASUREMENT DFES_EnvBlock1294 "vollständige Umweldaten alle Fehlerspeichereinträge" UBYTE DFES_OneToOne 1 100 0.00 255.0 ECU_ADDRESS 0xD0009390 /end MEASUREMENT
/begin MEASUREMENT DFES_EnvBlock1295 "vollständige Umweldaten alle Fehlerspeichereinträge" UBYTE DFES_OneToOne 1 100 0.00 255.0 ECU_ADDRESS 0xD0009391 /end MEASUREMENT
/begin MEASUREMENT DFES_EnvBlock1296 "vollständige Umweldaten alle Fehlerspeichereinträge" UBYTE DFES_OneToOne 1 100 0.00 255.0 ECU_ADDRESS 0xD0009392 /end MEASUREMENT
/begin MEASUREMENT DFES_EnvBlock1297 "vollständige Umweldaten alle Fehlerspeichereinträge" UBYTE DFES_OneToOne 1 100 0.00 255.0 ECU_ADDRESS 0xD0009393 /end MEASUREMENT
/begin MEASUREMENT DFES_EnvBlock1298 "vollständige Umweldaten alle Fehlerspeichereinträge" UBYTE DFES_OneToOne 1 100 0.00 255.0 ECU_ADDRESS 0xD0009394 /end MEASUREMENT
/begin MEASUREMENT DFES_EnvBlock1299 "vollständige Umweldaten alle Fehlerspeichereinträge" UBYTE DFES_OneToOne 1 100 0.00 255.0 ECU_ADDRESS 0xD0009395 /end MEASUREMENT
/begin MEASUREMENT DFES_EnvBlock1300 "vollständige Umweldaten alle Fehlerspeichereinträge" UBYTE DFES_OneToOne 1 100 0.00 255.0 ECU_ADDRESS 0xD0009396 /end MEASUREMENT
/begin MEASUREMENT DFES_EnvBlock1301 "vollständige Umweldaten alle Fehlerspeichereinträge" UBYTE DFES_OneToOne 1 100 0.00 255.0 ECU_ADDRESS 0xD0009397 /end MEASUREMENT
/begin MEASUREMENT DFES_EnvBlock1302 "vollständige Umweldaten alle Fehlerspeichereinträge" UBYTE DFES_OneToOne 1 100 0.00 255.0 ECU_ADDRESS 0xD0009398 /end MEASUREMENT
/begin MEASUREMENT DFES_EnvBlock1303 "vollständige Umweldaten alle Fehlerspeichereinträge" UBYTE DFES_OneToOne 1 100 0.00 255.0 ECU_ADDRESS 0xD0009399 /end MEASUREMENT
/begin MEASUREMENT DFES_EnvBlock1304 "vollständige Umweldaten alle Fehlerspeichereinträge" UBYTE DFES_OneToOne 1 100 0.00 255.0 ECU_ADDRESS 0xD000939A /end MEASUREMENT
/begin MEASUREMENT DFES_EnvBlock1305 "vollständige Umweldaten alle Fehlerspeichereinträge" UBYTE DFES_OneToOne 1 100 0.00 255.0 ECU_ADDRESS 0xD000939B /end MEASUREMENT
/begin MEASUREMENT DFES_EnvBlock1306 "vollständige Umweldaten alle Fehlerspeichereinträge" UBYTE DFES_OneToOne 1 100 0.00 255.0 ECU_ADDRESS 0xD000939C /end MEASUREMENT
/begin MEASUREMENT DFES_EnvBlock1307 "vollständige Umweldaten alle Fehlerspeichereinträge" UBYTE DFES_OneToOne 1 100 0.00 255.0 ECU_ADDRESS 0xD000939D /end MEASUREMENT
/begin MEASUREMENT DFES_EnvBlock1308 "vollständige Umweldaten alle Fehlerspeichereinträge" UBYTE DFES_OneToOne 1 100 0.00 255.0 ECU_ADDRESS 0xD000939E /end MEASUREMENT
/begin MEASUREMENT DFES_EnvBlock1309 "vollständige Umweldaten alle Fehlerspeichereinträge" UBYTE DFES_OneToOne 1 100 0.00 255.0 ECU_ADDRESS 0xD000939F /end MEASUREMENT
/begin MEASUREMENT DFES_EnvBlock1310 "vollständige Umweldaten alle Fehlerspeichereinträge" UBYTE DFES_OneToOne 1 100 0.00 255.0 ECU_ADDRESS 0xD00093A0 /end MEASUREMENT
/begin MEASUREMENT DFES_EnvBlock1311 "vollständige Umweldaten alle Fehlerspeichereinträge" UBYTE DFES_OneToOne 1 100 0.00 255.0 ECU_ADDRESS 0xD00093A1 /end MEASUREMENT
/begin MEASUREMENT DFES_EnvBlock1312 "vollständige Umweldaten alle Fehlerspeichereinträge" UBYTE DFES_OneToOne 1 100 0.00 255.0 ECU_ADDRESS 0xD00093A2 /end MEASUREMENT
/begin MEASUREMENT DFES_EnvBlock1313 "vollständige Umweldaten alle Fehlerspeichereinträge" UBYTE DFES_OneToOne 1 100 0.00 255.0 ECU_ADDRESS 0xD00093A3 /end MEASUREMENT
/begin MEASUREMENT DFES_EnvBlock1314 "vollständige Umweldaten alle Fehlerspeichereinträge" UBYTE DFES_OneToOne 1 100 0.00 255.0 ECU_ADDRESS 0xD00093A4 /end MEASUREMENT
/begin MEASUREMENT DFES_EnvBlock1315 "vollständige Umweldaten alle Fehlerspeichereinträge" UBYTE DFES_OneToOne 1 100 0.00 255.0 ECU_ADDRESS 0xD00093A5 /end MEASUREMENT
/begin MEASUREMENT DFES_EnvBlock1316 "vollständige Umweldaten alle Fehlerspeichereinträge" UBYTE DFES_OneToOne 1 100 0.00 255.0 ECU_ADDRESS 0xD00093A6 /end MEASUREMENT
/begin MEASUREMENT DFES_EnvBlock1317 "vollständige Umweldaten alle Fehlerspeichereinträge" UBYTE DFES_OneToOne 1 100 0.00 255.0 ECU_ADDRESS 0xD00093A7 /end MEASUREMENT
/begin MEASUREMENT DFES_EnvBlock1318 "vollständige Umweldaten alle Fehlerspeichereinträge" UBYTE DFES_OneToOne 1 100 0.00 255.0 ECU_ADDRESS 0xD00093A8 /end MEASUREMENT
/begin MEASUREMENT DFES_EnvBlock1319 "vollständige Umweldaten alle Fehlerspeichereinträge" UBYTE DFES_OneToOne 1 100 0.00 255.0 ECU_ADDRESS 0xD00093A9 /end MEASUREMENT
/begin MEASUREMENT DFES_EnvBlock1320 "vollständige Umweldaten alle Fehlerspeichereinträge" UBYTE DFES_OneToOne 1 100 0.00 255.0 ECU_ADDRESS 0xD00093AA /end MEASUREMENT
/begin MEASUREMENT DFES_EnvBlock1321 "vollständige Umweldaten alle Fehlerspeichereinträge" UBYTE DFES_OneToOne 1 100 0.00 255.0 ECU_ADDRESS 0xD00093AB /end MEASUREMENT
/begin MEASUREMENT DFES_EnvBlock1322 "vollständige Umweldaten alle Fehlerspeichereinträge" UBYTE DFES_OneToOne 1 100 0.00 255.0 ECU_ADDRESS 0xD00093AC /end MEASUREMENT
/begin MEASUREMENT DFES_EnvBlock1323 "vollständige Umweldaten alle Fehlerspeichereinträge" UBYTE DFES_OneToOne 1 100 0.00 255.0 ECU_ADDRESS 0xD00093AD /end MEASUREMENT
/begin MEASUREMENT DFES_EnvBlock1324 "vollständige Umweldaten alle Fehlerspeichereinträge" UBYTE DFES_OneToOne 1 100 0.00 255.0 ECU_ADDRESS 0xD00093AE /end MEASUREMENT
/begin MEASUREMENT DFES_EnvBlock1325 "vollständige Umweldaten alle Fehlerspeichereinträge" UBYTE DFES_OneToOne 1 100 0.00 255.0 ECU_ADDRESS 0xD00093AF /end MEASUREMENT
/begin MEASUREMENT DFES_EnvBlock1326 "vollständige Umweldaten alle Fehlerspeichereinträge" UBYTE DFES_OneToOne 1 100 0.00 255.0 ECU_ADDRESS 0xD00093B0 /end MEASUREMENT
/begin MEASUREMENT DFES_EnvBlock1327 "vollständige Umweldaten alle Fehlerspeichereinträge" UBYTE DFES_OneToOne 1 100 0.00 255.0 ECU_ADDRESS 0xD00093B1 /end MEASUREMENT
/begin MEASUREMENT DFES_EnvBlock1328 "vollständige Umweldaten alle Fehlerspeichereinträge" UBYTE DFES_OneToOne 1 100 0.00 255.0 ECU_ADDRESS 0xD00093B2 /end MEASUREMENT
/begin MEASUREMENT DFES_EnvBlock1329 "vollständige Umweldaten alle Fehlerspeichereinträge" UBYTE DFES_OneToOne 1 100 0.00 255.0 ECU_ADDRESS 0xD00093B3 /end MEASUREMENT
/begin MEASUREMENT DFES_EnvBlock1330 "vollständige Umweldaten alle Fehlerspeichereinträge" UBYTE DFES_OneToOne 1 100 0.00 255.0 ECU_ADDRESS 0xD00093B4 /end MEASUREMENT
/begin MEASUREMENT DFES_EnvBlock1331 "vollständige Umweldaten alle Fehlerspeichereinträge" UBYTE DFES_OneToOne 1 100 0.00 255.0 ECU_ADDRESS 0xD00093B5 /end MEASUREMENT
/begin MEASUREMENT DFES_EnvBlock1332 "vollständige Umweldaten alle Fehlerspeichereinträge" UBYTE DFES_OneToOne 1 100 0.00 255.0 ECU_ADDRESS 0xD00093B6 /end MEASUREMENT
/begin MEASUREMENT DFES_EnvBlock1333 "vollständige Umweldaten alle Fehlerspeichereinträge" UBYTE DFES_OneToOne 1 100 0.00 255.0 ECU_ADDRESS 0xD00093B7 /end MEASUREMENT
/begin MEASUREMENT DFES_EnvBlock1334 "vollständige Umweldaten alle Fehlerspeichereinträge" UBYTE DFES_OneToOne 1 100 0.00 255.0 ECU_ADDRESS 0xD00093B8 /end MEASUREMENT
/begin MEASUREMENT DFES_EnvBlock1335 "vollständige Umweldaten alle Fehlerspeichereinträge" UBYTE DFES_OneToOne 1 100 0.00 255.0 ECU_ADDRESS 0xD00093B9 /end MEASUREMENT
/begin MEASUREMENT DFES_EnvBlock1336 "vollständige Umweldaten alle Fehlerspeichereinträge" UBYTE DFES_OneToOne 1 100 0.00 255.0 ECU_ADDRESS 0xD00093BA /end MEASUREMENT
/begin MEASUREMENT DFES_EnvBlock1337 "vollständige Umweldaten alle Fehlerspeichereinträge" UBYTE DFES_OneToOne 1 100 0.00 255.0 ECU_ADDRESS 0xD00093BB /end MEASUREMENT
/begin MEASUREMENT DFES_EnvBlock1338 "vollständige Umweldaten alle Fehlerspeichereinträge" UBYTE DFES_OneToOne 1 100 0.00 255.0 ECU_ADDRESS 0xD00093BC /end MEASUREMENT
/begin MEASUREMENT DFES_EnvBlock1339 "vollständige Umweldaten alle Fehlerspeichereinträge" UBYTE DFES_OneToOne 1 100 0.00 255.0 ECU_ADDRESS 0xD00093BD /end MEASUREMENT
/begin MEASUREMENT DFES_EnvBlock1340 "vollständige Umweldaten alle Fehlerspeichereinträge" UBYTE DFES_OneToOne 1 100 0.00 255.0 ECU_ADDRESS 0xD00093BE /end MEASUREMENT
/begin MEASUREMENT DFES_EnvBlock1341 "vollständige Umweldaten alle Fehlerspeichereinträge" UBYTE DFES_OneToOne 1 100 0.00 255.0 ECU_ADDRESS 0xD00093BF /end MEASUREMENT
/begin MEASUREMENT DFES_EnvBlock1342 "vollständige Umweldaten alle Fehlerspeichereinträge" UBYTE DFES_OneToOne 1 100 0.00 255.0 ECU_ADDRESS 0xD00093C0 /end MEASUREMENT
/begin MEASUREMENT DFES_EnvBlock1343 "vollständige Umweldaten alle Fehlerspeichereinträge" UBYTE DFES_OneToOne 1 100 0.00 255.0 ECU_ADDRESS 0xD00093C1 /end MEASUREMENT
/begin MEASUREMENT DFES_EnvBlock1344 "vollständige Umweldaten alle Fehlerspeichereinträge" UBYTE DFES_OneToOne 1 100 0.00 255.0 ECU_ADDRESS 0xD00093C2 /end MEASUREMENT
/begin MEASUREMENT DFES_EnvBlock1345 "vollständige Umweldaten alle Fehlerspeichereinträge" UBYTE DFES_OneToOne 1 100 0.00 255.0 ECU_ADDRESS 0xD00093C3 /end MEASUREMENT
/begin MEASUREMENT DFES_EnvBlock1346 "vollständige Umweldaten alle Fehlerspeichereinträge" UBYTE DFES_OneToOne 1 100 0.00 255.0 ECU_ADDRESS 0xD00093C4 /end MEASUREMENT
/begin MEASUREMENT DFES_EnvBlock1347 "vollständige Umweldaten alle Fehlerspeichereinträge" UBYTE DFES_OneToOne 1 100 0.00 255.0 ECU_ADDRESS 0xD00093C5 /end MEASUREMENT
/begin MEASUREMENT DFES_EnvBlock1348 "vollständige Umweldaten alle Fehlerspeichereinträge" UBYTE DFES_OneToOne 1 100 0.00 255.0 ECU_ADDRESS 0xD00093C6 /end MEASUREMENT
/begin MEASUREMENT DFES_EnvBlock1349 "vollständige Umweldaten alle Fehlerspeichereinträge" UBYTE DFES_OneToOne 1 100 0.00 255.0 ECU_ADDRESS 0xD00093C7 /end MEASUREMENT
/begin MEASUREMENT DFES_EnvBlock1350 "vollständige Umweldaten alle Fehlerspeichereinträge" UBYTE DFES_OneToOne 1 100 0.00 255.0 ECU_ADDRESS 0xD00093C8 /end MEASUREMENT
/begin MEASUREMENT DFES_EnvBlock1351 "vollständige Umweldaten alle Fehlerspeichereinträge" UBYTE DFES_OneToOne 1 100 0.00 255.0 ECU_ADDRESS 0xD00093C9 /end MEASUREMENT
/begin MEASUREMENT DFES_EnvBlock1352 "vollständige Umweldaten alle Fehlerspeichereinträge" UBYTE DFES_OneToOne 1 100 0.00 255.0 ECU_ADDRESS 0xD00093CA /end MEASUREMENT
/begin MEASUREMENT DFES_EnvBlock1353 "vollständige Umweldaten alle Fehlerspeichereinträge" UBYTE DFES_OneToOne 1 100 0.00 255.0 ECU_ADDRESS 0xD00093CB /end MEASUREMENT
/begin MEASUREMENT DFES_EnvBlock1354 "vollständige Umweldaten alle Fehlerspeichereinträge" UBYTE DFES_OneToOne 1 100 0.00 255.0 ECU_ADDRESS 0xD00093CC /end MEASUREMENT
/begin MEASUREMENT DFES_EnvBlock1355 "vollständige Umweldaten alle Fehlerspeichereinträge" UBYTE DFES_OneToOne 1 100 0.00 255.0 ECU_ADDRESS 0xD00093CD /end MEASUREMENT
/begin MEASUREMENT DFES_EnvBlock1356 "vollständige Umweldaten alle Fehlerspeichereinträge" UBYTE DFES_OneToOne 1 100 0.00 255.0 ECU_ADDRESS 0xD00093CE /end MEASUREMENT
/begin MEASUREMENT DFES_EnvBlock1357 "vollständige Umweldaten alle Fehlerspeichereinträge" UBYTE DFES_OneToOne 1 100 0.00 255.0 ECU_ADDRESS 0xD00093CF /end MEASUREMENT
/begin MEASUREMENT DFES_EnvBlock1358 "vollständige Umweldaten alle Fehlerspeichereinträge" UBYTE DFES_OneToOne 1 100 0.00 255.0 ECU_ADDRESS 0xD00093D0 /end MEASUREMENT
/begin MEASUREMENT DFES_EnvBlock1359 "vollständige Umweldaten alle Fehlerspeichereinträge" UBYTE DFES_OneToOne 1 100 0.00 255.0 ECU_ADDRESS 0xD00093D1 /end MEASUREMENT
/begin MEASUREMENT DFES_EnvBlock1360 "vollständige Umweldaten alle Fehlerspeichereinträge" UBYTE DFES_OneToOne 1 100 0.00 255.0 ECU_ADDRESS 0xD00093D2 /end MEASUREMENT
/begin MEASUREMENT DFES_EnvBlock1361 "vollständige Umweldaten alle Fehlerspeichereinträge" UBYTE DFES_OneToOne 1 100 0.00 255.0 ECU_ADDRESS 0xD00093D3 /end MEASUREMENT
/begin MEASUREMENT DFES_EnvBlock1362 "vollständige Umweldaten alle Fehlerspeichereinträge" UBYTE DFES_OneToOne 1 100 0.00 255.0 ECU_ADDRESS 0xD00093D4 /end MEASUREMENT
/begin MEASUREMENT DFES_EnvBlock1363 "vollständige Umweldaten alle Fehlerspeichereinträge" UBYTE DFES_OneToOne 1 100 0.00 255.0 ECU_ADDRESS 0xD00093D5 /end MEASUREMENT
/begin MEASUREMENT DFES_EnvBlock1364 "vollständige Umweldaten alle Fehlerspeichereinträge" UBYTE DFES_OneToOne 1 100 0.00 255.0 ECU_ADDRESS 0xD00093D6 /end MEASUREMENT
/begin MEASUREMENT DFES_EnvBlock1365 "vollständige Umweldaten alle Fehlerspeichereinträge" UBYTE DFES_OneToOne 1 100 0.00 255.0 ECU_ADDRESS 0xD00093D7 /end MEASUREMENT
/begin MEASUREMENT DFES_EnvBlock1366 "vollständige Umweldaten alle Fehlerspeichereinträge" UBYTE DFES_OneToOne 1 100 0.00 255.0 ECU_ADDRESS 0xD00093D8 /end MEASUREMENT
/begin MEASUREMENT DFES_EnvBlock1367 "vollständige Umweldaten alle Fehlerspeichereinträge" UBYTE DFES_OneToOne 1 100 0.00 255.0 ECU_ADDRESS 0xD00093D9 /end MEASUREMENT
/begin MEASUREMENT DFES_EnvBlock1368 "vollständige Umweldaten alle Fehlerspeichereinträge" UBYTE DFES_OneToOne 1 100 0.00 255.0 ECU_ADDRESS 0xD00093DA /end MEASUREMENT
/begin MEASUREMENT DFES_EnvBlock1369 "vollständige Umweldaten alle Fehlerspeichereinträge" UBYTE DFES_OneToOne 1 100 0.00 255.0 ECU_ADDRESS 0xD00093DB /end MEASUREMENT
/begin MEASUREMENT DFES_EnvBlock1370 "vollständige Umweldaten alle Fehlerspeichereinträge" UBYTE DFES_OneToOne 1 100 0.00 255.0 ECU_ADDRESS 0xD00093DC /end MEASUREMENT
/begin MEASUREMENT DFES_EnvBlock1371 "vollständige Umweldaten alle Fehlerspeichereinträge" UBYTE DFES_OneToOne 1 100 0.00 255.0 ECU_ADDRESS 0xD00093DD /end MEASUREMENT
/begin MEASUREMENT DFES_EnvBlock1372 "vollständige Umweldaten alle Fehlerspeichereinträge" UBYTE DFES_OneToOne 1 100 0.00 255.0 ECU_ADDRESS 0xD00093DE /end MEASUREMENT
/begin MEASUREMENT DFES_EnvBlock1373 "vollständige Umweldaten alle Fehlerspeichereinträge" UBYTE DFES_OneToOne 1 100 0.00 255.0 ECU_ADDRESS 0xD00093DF /end MEASUREMENT
/begin MEASUREMENT DFES_EnvBlock1374 "vollständige Umweldaten alle Fehlerspeichereinträge" UBYTE DFES_OneToOne 1 100 0.00 255.0 ECU_ADDRESS 0xD00093E0 /end MEASUREMENT
/begin MEASUREMENT DFES_EnvBlock1375 "vollständige Umweldaten alle Fehlerspeichereinträge" UBYTE DFES_OneToOne 1 100 0.00 255.0 ECU_ADDRESS 0xD00093E1 /end MEASUREMENT
/begin MEASUREMENT DFES_EnvBlock1376 "vollständige Umweldaten alle Fehlerspeichereinträge" UBYTE DFES_OneToOne 1 100 0.00 255.0 ECU_ADDRESS 0xD00093E2 /end MEASUREMENT
/begin MEASUREMENT DFES_EnvBlock1377 "vollständige Umweldaten alle Fehlerspeichereinträge" UBYTE DFES_OneToOne 1 100 0.00 255.0 ECU_ADDRESS 0xD00093E3 /end MEASUREMENT
/begin MEASUREMENT DFES_EnvBlock1378 "vollständige Umweldaten alle Fehlerspeichereinträge" UBYTE DFES_OneToOne 1 100 0.00 255.0 ECU_ADDRESS 0xD00093E4 /end MEASUREMENT
/begin MEASUREMENT DFES_EnvBlock1379 "vollständige Umweldaten alle Fehlerspeichereinträge" UBYTE DFES_OneToOne 1 100 0.00 255.0 ECU_ADDRESS 0xD00093E5 /end MEASUREMENT
/begin MEASUREMENT DFES_EnvBlock1380 "vollständige Umweldaten alle Fehlerspeichereinträge" UBYTE DFES_OneToOne 1 100 0.00 255.0 ECU_ADDRESS 0xD00093E6 /end MEASUREMENT
/begin MEASUREMENT DFES_EnvBlock1381 "vollständige Umweldaten alle Fehlerspeichereinträge" UBYTE DFES_OneToOne 1 100 0.00 255.0 ECU_ADDRESS 0xD00093E7 /end MEASUREMENT
/begin MEASUREMENT DFES_EnvBlock1382 "vollständige Umweldaten alle Fehlerspeichereinträge" UBYTE DFES_OneToOne 1 100 0.00 255.0 ECU_ADDRESS 0xD00093E8 /end MEASUREMENT
/begin MEASUREMENT DFES_EnvBlock1383 "vollständige Umweldaten alle Fehlerspeichereinträge" UBYTE DFES_OneToOne 1 100 0.00 255.0 ECU_ADDRESS 0xD00093E9 /end MEASUREMENT
/begin MEASUREMENT DFES_EnvBlock1384 "vollständige Umweldaten alle Fehlerspeichereinträge" UBYTE DFES_OneToOne 1 100 0.00 255.0 ECU_ADDRESS 0xD00093EA /end MEASUREMENT
/begin MEASUREMENT DFES_EnvBlock1385 "vollständige Umweldaten alle Fehlerspeichereinträge" UBYTE DFES_OneToOne 1 100 0.00 255.0 ECU_ADDRESS 0xD00093EB /end MEASUREMENT
/begin MEASUREMENT DFES_EnvBlock1386 "vollständige Umweldaten alle Fehlerspeichereinträge" UBYTE DFES_OneToOne 1 100 0.00 255.0 ECU_ADDRESS 0xD00093EC /end MEASUREMENT
/begin MEASUREMENT DFES_EnvBlock1387 "vollständige Umweldaten alle Fehlerspeichereinträge" UBYTE DFES_OneToOne 1 100 0.00 255.0 ECU_ADDRESS 0xD00093ED /end MEASUREMENT
/begin MEASUREMENT DFES_EnvBlock1388 "vollständige Umweldaten alle Fehlerspeichereinträge" UBYTE DFES_OneToOne 1 100 0.00 255.0 ECU_ADDRESS 0xD00093EE /end MEASUREMENT
/begin MEASUREMENT DFES_EnvBlock1389 "vollständige Umweldaten alle Fehlerspeichereinträge" UBYTE DFES_OneToOne 1 100 0.00 255.0 ECU_ADDRESS 0xD00093EF /end MEASUREMENT
/begin MEASUREMENT DFES_EnvBlock1390 "vollständige Umweldaten alle Fehlerspeichereinträge" UBYTE DFES_OneToOne 1 100 0.00 255.0 ECU_ADDRESS 0xD00093F0 /end MEASUREMENT
/begin MEASUREMENT DFES_EnvBlock1391 "vollständige Umweldaten alle Fehlerspeichereinträge" UBYTE DFES_OneToOne 1 100 0.00 255.0 ECU_ADDRESS 0xD00093F1 /end MEASUREMENT
/begin MEASUREMENT DFES_EnvBlock1392 "vollständige Umweldaten alle Fehlerspeichereinträge" UBYTE DFES_OneToOne 1 100 0.00 255.0 ECU_ADDRESS 0xD00093F2 /end MEASUREMENT
/begin MEASUREMENT DFES_EnvBlock1393 "vollständige Umweldaten alle Fehlerspeichereinträge" UBYTE DFES_OneToOne 1 100 0.00 255.0 ECU_ADDRESS 0xD00093F3 /end MEASUREMENT
/begin MEASUREMENT DFES_EnvBlock1394 "vollständige Umweldaten alle Fehlerspeichereinträge" UBYTE DFES_OneToOne 1 100 0.00 255.0 ECU_ADDRESS 0xD00093F4 /end MEASUREMENT
/begin MEASUREMENT DFES_EnvBlock1395 "vollständige Umweldaten alle Fehlerspeichereinträge" UBYTE DFES_OneToOne 1 100 0.00 255.0 ECU_ADDRESS 0xD00093F5 /end MEASUREMENT
/begin MEASUREMENT DFES_EnvBlock1396 "vollständige Umweldaten alle Fehlerspeichereinträge" UBYTE DFES_OneToOne 1 100 0.00 255.0 ECU_ADDRESS 0xD00093F6 /end MEASUREMENT
/begin MEASUREMENT DFES_EnvBlock1397 "vollständige Umweldaten alle Fehlerspeichereinträge" UBYTE DFES_OneToOne 1 100 0.00 255.0 ECU_ADDRESS 0xD00093F7 /end MEASUREMENT
/begin MEASUREMENT DFES_EnvBlock1398 "vollständige Umweldaten alle Fehlerspeichereinträge" UBYTE DFES_OneToOne 1 100 0.00 255.0 ECU_ADDRESS 0xD00093F8 /end MEASUREMENT
/begin MEASUREMENT DFES_EnvBlock1399 "vollständige Umweldaten alle Fehlerspeichereinträge" UBYTE DFES_OneToOne 1 100 0.00 255.0 ECU_ADDRESS 0xD00093F9 /end MEASUREMENT
/begin MEASUREMENT DFES_EnvBlock1400 "vollständige Umweldaten alle Fehlerspeichereinträge" UBYTE DFES_OneToOne 1 100 0.00 255.0 ECU_ADDRESS 0xD00093FA /end MEASUREMENT
/begin MEASUREMENT DFES_EnvBlock1401 "vollständige Umweldaten alle Fehlerspeichereinträge" UBYTE DFES_OneToOne 1 100 0.00 255.0 ECU_ADDRESS 0xD00093FB /end MEASUREMENT
/begin MEASUREMENT DFES_EnvBlock1402 "vollständige Umweldaten alle Fehlerspeichereinträge" UBYTE DFES_OneToOne 1 100 0.00 255.0 ECU_ADDRESS 0xD00093FC /end MEASUREMENT
/begin MEASUREMENT DFES_EnvBlock1403 "vollständige Umweldaten alle Fehlerspeichereinträge" UBYTE DFES_OneToOne 1 100 0.00 255.0 ECU_ADDRESS 0xD00093FD /end MEASUREMENT
/begin MEASUREMENT DFES_EnvBlock1404 "vollständige Umweldaten alle Fehlerspeichereinträge" UBYTE DFES_OneToOne 1 100 0.00 255.0 ECU_ADDRESS 0xD00093FE /end MEASUREMENT
/begin MEASUREMENT DFES_EnvBlock1405 "vollständige Umweldaten alle Fehlerspeichereinträge" UBYTE DFES_OneToOne 1 100 0.00 255.0 ECU_ADDRESS 0xD00093FF /end MEASUREMENT
/begin MEASUREMENT DFES_EnvBlock1406 "vollständige Umweldaten alle Fehlerspeichereinträge" UBYTE DFES_OneToOne 1 100 0.00 255.0 ECU_ADDRESS 0xD0009400 /end MEASUREMENT
/begin MEASUREMENT DFES_EnvBlock1407 "vollständige Umweldaten alle Fehlerspeichereinträge" UBYTE DFES_OneToOne 1 100 0.00 255.0 ECU_ADDRESS 0xD0009401 /end MEASUREMENT
/begin MEASUREMENT DFES_EnvBlock1408 "vollständige Umweldaten alle Fehlerspeichereinträge" UBYTE DFES_OneToOne 1 100 0.00 255.0 ECU_ADDRESS 0xD0009402 /end MEASUREMENT
/begin MEASUREMENT DFES_EnvBlock1409 "vollständige Umweldaten alle Fehlerspeichereinträge" UBYTE DFES_OneToOne 1 100 0.00 255.0 ECU_ADDRESS 0xD0009403 /end MEASUREMENT
/begin MEASUREMENT DFES_EnvBlock1410 "vollständige Umweldaten alle Fehlerspeichereinträge" UBYTE DFES_OneToOne 1 100 0.00 255.0 ECU_ADDRESS 0xD0009404 /end MEASUREMENT
/begin MEASUREMENT DFES_EnvBlock1411 "vollständige Umweldaten alle Fehlerspeichereinträge" UBYTE DFES_OneToOne 1 100 0.00 255.0 ECU_ADDRESS 0xD0009405 /end MEASUREMENT
/begin MEASUREMENT DFES_EnvBlock1412 "vollständige Umweldaten alle Fehlerspeichereinträge" UBYTE DFES_OneToOne 1 100 0.00 255.0 ECU_ADDRESS 0xD0009406 /end MEASUREMENT
/begin MEASUREMENT DFES_EnvBlock1413 "vollständige Umweldaten alle Fehlerspeichereinträge" UBYTE DFES_OneToOne 1 100 0.00 255.0 ECU_ADDRESS 0xD0009407 /end MEASUREMENT
/begin MEASUREMENT DFES_EnvBlock1414 "vollständige Umweldaten alle Fehlerspeichereinträge" UBYTE DFES_OneToOne 1 100 0.00 255.0 ECU_ADDRESS 0xD0009408 /end MEASUREMENT
/begin MEASUREMENT DFES_EnvBlock1415 "vollständige Umweldaten alle Fehlerspeichereinträge" UBYTE DFES_OneToOne 1 100 0.00 255.0 ECU_ADDRESS 0xD0009409 /end MEASUREMENT
/begin MEASUREMENT DFES_EnvBlock1416 "vollständige Umweldaten alle Fehlerspeichereinträge" UBYTE DFES_OneToOne 1 100 0.00 255.0 ECU_ADDRESS 0xD000940A /end MEASUREMENT
/begin MEASUREMENT DFES_EnvBlock1417 "vollständige Umweldaten alle Fehlerspeichereinträge" UBYTE DFES_OneToOne 1 100 0.00 255.0 ECU_ADDRESS 0xD000940B /end MEASUREMENT
/begin MEASUREMENT DFES_EnvBlock1418 "vollständige Umweldaten alle Fehlerspeichereinträge" UBYTE DFES_OneToOne 1 100 0.00 255.0 ECU_ADDRESS 0xD000940C /end MEASUREMENT
/begin MEASUREMENT DFES_EnvBlock1419 "vollständige Umweldaten alle Fehlerspeichereinträge" UBYTE DFES_OneToOne 1 100 0.00 255.0 ECU_ADDRESS 0xD000940D /end MEASUREMENT
/begin MEASUREMENT DFES_EnvBlock1420 "vollständige Umweldaten alle Fehlerspeichereinträge" UBYTE DFES_OneToOne 1 100 0.00 255.0 ECU_ADDRESS 0xD000940E /end MEASUREMENT
/begin MEASUREMENT DFES_EnvBlock1421 "vollständige Umweldaten alle Fehlerspeichereinträge" UBYTE DFES_OneToOne 1 100 0.00 255.0 ECU_ADDRESS 0xD000940F /end MEASUREMENT
/begin MEASUREMENT DFES_EnvBlock1422 "vollständige Umweldaten alle Fehlerspeichereinträge" UBYTE DFES_OneToOne 1 100 0.00 255.0 ECU_ADDRESS 0xD0009410 /end MEASUREMENT
/begin MEASUREMENT DFES_EnvBlock1423 "vollständige Umweldaten alle Fehlerspeichereinträge" UBYTE DFES_OneToOne 1 100 0.00 255.0 ECU_ADDRESS 0xD0009411 /end MEASUREMENT
/begin MEASUREMENT DFES_EnvBlock1424 "vollständige Umweldaten alle Fehlerspeichereinträge" UBYTE DFES_OneToOne 1 100 0.00 255.0 ECU_ADDRESS 0xD0009412 /end MEASUREMENT
/begin MEASUREMENT DFES_EnvBlock1425 "vollständige Umweldaten alle Fehlerspeichereinträge" UBYTE DFES_OneToOne 1 100 0.00 255.0 ECU_ADDRESS 0xD0009413 /end MEASUREMENT
/begin MEASUREMENT DFES_EnvBlock1426 "vollständige Umweldaten alle Fehlerspeichereinträge" UBYTE DFES_OneToOne 1 100 0.00 255.0 ECU_ADDRESS 0xD0009414 /end MEASUREMENT
/begin MEASUREMENT DFES_EnvBlock1427 "vollständige Umweldaten alle Fehlerspeichereinträge" UBYTE DFES_OneToOne 1 100 0.00 255.0 ECU_ADDRESS 0xD0009415 /end MEASUREMENT
/begin MEASUREMENT DFES_EnvBlock1428 "vollständige Umweldaten alle Fehlerspeichereinträge" UBYTE DFES_OneToOne 1 100 0.00 255.0 ECU_ADDRESS 0xD0009416 /end MEASUREMENT
/begin MEASUREMENT DFES_EnvBlock1429 "vollständige Umweldaten alle Fehlerspeichereinträge" UBYTE DFES_OneToOne 1 100 0.00 255.0 ECU_ADDRESS 0xD0009417 /end MEASUREMENT
/begin MEASUREMENT DFES_EnvBlock1430 "vollständige Umweldaten alle Fehlerspeichereinträge" UBYTE DFES_OneToOne 1 100 0.00 255.0 ECU_ADDRESS 0xD0009418 /end MEASUREMENT
/begin MEASUREMENT DFES_EnvBlock1431 "vollständige Umweldaten alle Fehlerspeichereinträge" UBYTE DFES_OneToOne 1 100 0.00 255.0 ECU_ADDRESS 0xD0009419 /end MEASUREMENT
/begin MEASUREMENT DFES_EnvBlock1432 "vollständige Umweldaten alle Fehlerspeichereinträge" UBYTE DFES_OneToOne 1 100 0.00 255.0 ECU_ADDRESS 0xD000941A /end MEASUREMENT
/begin MEASUREMENT DFES_EnvBlock1433 "vollständige Umweldaten alle Fehlerspeichereinträge" UBYTE DFES_OneToOne 1 100 0.00 255.0 ECU_ADDRESS 0xD000941B /end MEASUREMENT
/begin MEASUREMENT DFES_EnvBlock1434 "vollständige Umweldaten alle Fehlerspeichereinträge" UBYTE DFES_OneToOne 1 100 0.00 255.0 ECU_ADDRESS 0xD000941C /end MEASUREMENT
/begin MEASUREMENT DFES_EnvBlock1435 "vollständige Umweldaten alle Fehlerspeichereinträge" UBYTE DFES_OneToOne 1 100 0.00 255.0 ECU_ADDRESS 0xD000941D /end MEASUREMENT
/begin MEASUREMENT DFES_EnvBlock1436 "vollständige Umweldaten alle Fehlerspeichereinträge" UBYTE DFES_OneToOne 1 100 0.00 255.0 ECU_ADDRESS 0xD000941E /end MEASUREMENT
/begin MEASUREMENT DFES_EnvBlock1437 "vollständige Umweldaten alle Fehlerspeichereinträge" UBYTE DFES_OneToOne 1 100 0.00 255.0 ECU_ADDRESS 0xD000941F /end MEASUREMENT
/begin MEASUREMENT DFES_EnvBlock1438 "vollständige Umweldaten alle Fehlerspeichereinträge" UBYTE DFES_OneToOne 1 100 0.00 255.0 ECU_ADDRESS 0xD0009420 /end MEASUREMENT
/begin MEASUREMENT DFES_EnvBlock1439 "vollständige Umweldaten alle Fehlerspeichereinträge" UBYTE DFES_OneToOne 1 100 0.00 255.0 ECU_ADDRESS 0xD0009421 /end MEASUREMENT
/begin MEASUREMENT DFES_EnvBlock1440 "vollständige Umweldaten alle Fehlerspeichereinträge" UBYTE DFES_OneToOne 1 100 0.00 255.0 ECU_ADDRESS 0xD0009422 /end MEASUREMENT
/begin MEASUREMENT DFES_EnvBlock1441 "vollständige Umweldaten alle Fehlerspeichereinträge" UBYTE DFES_OneToOne 1 100 0.00 255.0 ECU_ADDRESS 0xD0009423 /end MEASUREMENT
/begin MEASUREMENT DFES_EnvBlock1442 "vollständige Umweldaten alle Fehlerspeichereinträge" UBYTE DFES_OneToOne 1 100 0.00 255.0 ECU_ADDRESS 0xD0009424 /end MEASUREMENT
/begin MEASUREMENT DFES_EnvBlock1443 "vollständige Umweldaten alle Fehlerspeichereinträge" UBYTE DFES_OneToOne 1 100 0.00 255.0 ECU_ADDRESS 0xD0009425 /end MEASUREMENT
/begin MEASUREMENT DFES_EnvBlock1444 "vollständige Umweldaten alle Fehlerspeichereinträge" UBYTE DFES_OneToOne 1 100 0.00 255.0 ECU_ADDRESS 0xD0009426 /end MEASUREMENT
/begin MEASUREMENT DFES_EnvBlock1445 "vollständige Umweldaten alle Fehlerspeichereinträge" UBYTE DFES_OneToOne 1 100 0.00 255.0 ECU_ADDRESS 0xD0009427 /end MEASUREMENT
/begin MEASUREMENT DFES_EnvBlock1446 "vollständige Umweldaten alle Fehlerspeichereinträge" UBYTE DFES_OneToOne 1 100 0.00 255.0 ECU_ADDRESS 0xD0009428 /end MEASUREMENT
/begin MEASUREMENT DFES_EnvBlock1447 "vollständige Umweldaten alle Fehlerspeichereinträge" UBYTE DFES_OneToOne 1 100 0.00 255.0 ECU_ADDRESS 0xD0009429 /end MEASUREMENT
/begin MEASUREMENT DFES_EnvBlock1448 "vollständige Umweldaten alle Fehlerspeichereinträge" UBYTE DFES_OneToOne 1 100 0.00 255.0 ECU_ADDRESS 0xD000942A /end MEASUREMENT
/begin MEASUREMENT DFES_EnvBlock1449 "vollständige Umweldaten alle Fehlerspeichereinträge" UBYTE DFES_OneToOne 1 100 0.00 255.0 ECU_ADDRESS 0xD000942B /end MEASUREMENT
/begin MEASUREMENT DFES_EnvBlock1450 "vollständige Umweldaten alle Fehlerspeichereinträge" UBYTE DFES_OneToOne 1 100 0.00 255.0 ECU_ADDRESS 0xD000942C /end MEASUREMENT
/begin MEASUREMENT DFES_EnvBlock1451 "vollständige Umweldaten alle Fehlerspeichereinträge" UBYTE DFES_OneToOne 1 100 0.00 255.0 ECU_ADDRESS 0xD000942D /end MEASUREMENT
/begin MEASUREMENT DFES_EnvBlock1452 "vollständige Umweldaten alle Fehlerspeichereinträge" UBYTE DFES_OneToOne 1 100 0.00 255.0 ECU_ADDRESS 0xD000942E /end MEASUREMENT
/begin MEASUREMENT DFES_EnvBlock1453 "vollständige Umweldaten alle Fehlerspeichereinträge" UBYTE DFES_OneToOne 1 100 0.00 255.0 ECU_ADDRESS 0xD000942F /end MEASUREMENT
/begin MEASUREMENT DFES_EnvBlock1454 "vollständige Umweldaten alle Fehlerspeichereinträge" UBYTE DFES_OneToOne 1 100 0.00 255.0 ECU_ADDRESS 0xD0009430 /end MEASUREMENT
/begin MEASUREMENT DFES_EnvBlock1455 "vollständige Umweldaten alle Fehlerspeichereinträge" UBYTE DFES_OneToOne 1 100 0.00 255.0 ECU_ADDRESS 0xD0009431 /end MEASUREMENT
/begin MEASUREMENT DFES_EnvBlock1456 "vollständige Umweldaten alle Fehlerspeichereinträge" UBYTE DFES_OneToOne 1 100 0.00 255.0 ECU_ADDRESS 0xD0009432 /end MEASUREMENT
/begin MEASUREMENT DFES_EnvBlock1457 "vollständige Umweldaten alle Fehlerspeichereinträge" UBYTE DFES_OneToOne 1 100 0.00 255.0 ECU_ADDRESS 0xD0009433 /end MEASUREMENT
/begin MEASUREMENT DFES_EnvBlock1458 "vollständige Umweldaten alle Fehlerspeichereinträge" UBYTE DFES_OneToOne 1 100 0.00 255.0 ECU_ADDRESS 0xD0009434 /end MEASUREMENT
/begin MEASUREMENT DFES_EnvBlock1459 "vollständige Umweldaten alle Fehlerspeichereinträge" UBYTE DFES_OneToOne 1 100 0.00 255.0 ECU_ADDRESS 0xD0009435 /end MEASUREMENT
/begin MEASUREMENT DFES_EnvBlock1460 "vollständige Umweldaten alle Fehlerspeichereinträge" UBYTE DFES_OneToOne 1 100 0.00 255.0 ECU_ADDRESS 0xD0009436 /end MEASUREMENT
/begin MEASUREMENT DFES_EnvBlock1461 "vollständige Umweldaten alle Fehlerspeichereinträge" UBYTE DFES_OneToOne 1 100 0.00 255.0 ECU_ADDRESS 0xD0009437 /end MEASUREMENT
/begin MEASUREMENT DFES_EnvBlock1462 "vollständige Umweldaten alle Fehlerspeichereinträge" UBYTE DFES_OneToOne 1 100 0.00 255.0 ECU_ADDRESS 0xD0009438 /end MEASUREMENT
/begin MEASUREMENT DFES_EnvBlock1463 "vollständige Umweldaten alle Fehlerspeichereinträge" UBYTE DFES_OneToOne 1 100 0.00 255.0 ECU_ADDRESS 0xD0009439 /end MEASUREMENT
/begin MEASUREMENT DFES_EnvBlock1464 "vollständige Umweldaten alle Fehlerspeichereinträge" UBYTE DFES_OneToOne 1 100 0.00 255.0 ECU_ADDRESS 0xD000943A /end MEASUREMENT
/begin MEASUREMENT DFES_EnvBlock1465 "vollständige Umweldaten alle Fehlerspeichereinträge" UBYTE DFES_OneToOne 1 100 0.00 255.0 ECU_ADDRESS 0xD000943B /end MEASUREMENT
/begin MEASUREMENT DFES_EnvBlock1466 "vollständige Umweldaten alle Fehlerspeichereinträge" UBYTE DFES_OneToOne 1 100 0.00 255.0 ECU_ADDRESS 0xD000943C /end MEASUREMENT
/begin MEASUREMENT DFES_EnvBlock1467 "vollständige Umweldaten alle Fehlerspeichereinträge" UBYTE DFES_OneToOne 1 100 0.00 255.0 ECU_ADDRESS 0xD000943D /end MEASUREMENT
/begin MEASUREMENT DFES_EnvBlock1468 "vollständige Umweldaten alle Fehlerspeichereinträge" UBYTE DFES_OneToOne 1 100 0.00 255.0 ECU_ADDRESS 0xD000943E /end MEASUREMENT
/begin MEASUREMENT DFES_EnvBlock1469 "vollständige Umweldaten alle Fehlerspeichereinträge" UBYTE DFES_OneToOne 1 100 0.00 255.0 ECU_ADDRESS 0xD000943F /end MEASUREMENT
/begin MEASUREMENT DFES_EnvBlock1470 "vollständige Umweldaten alle Fehlerspeichereinträge" UBYTE DFES_OneToOne 1 100 0.00 255.0 ECU_ADDRESS 0xD0009440 /end MEASUREMENT
/begin MEASUREMENT DFES_EnvBlock1471 "vollständige Umweldaten alle Fehlerspeichereinträge" UBYTE DFES_OneToOne 1 100 0.00 255.0 ECU_ADDRESS 0xD0009441 /end MEASUREMENT
/begin MEASUREMENT DFES_EnvBlock1472 "vollständige Umweldaten alle Fehlerspeichereinträge" UBYTE DFES_OneToOne 1 100 0.00 255.0 ECU_ADDRESS 0xD0009442 /end MEASUREMENT
/begin MEASUREMENT DFES_EnvBlock1473 "vollständige Umweldaten alle Fehlerspeichereinträge" UBYTE DFES_OneToOne 1 100 0.00 255.0 ECU_ADDRESS 0xD0009443 /end MEASUREMENT
/begin MEASUREMENT DFES_EnvBlock1474 "vollständige Umweldaten alle Fehlerspeichereinträge" UBYTE DFES_OneToOne 1 100 0.00 255.0 ECU_ADDRESS 0xD0009444 /end MEASUREMENT
/begin MEASUREMENT DFES_EnvBlock1475 "vollständige Umweldaten alle Fehlerspeichereinträge" UBYTE DFES_OneToOne 1 100 0.00 255.0 ECU_ADDRESS 0xD0009445 /end MEASUREMENT
/begin MEASUREMENT DFES_EnvBlock1476 "vollständige Umweldaten alle Fehlerspeichereinträge" UBYTE DFES_OneToOne 1 100 0.00 255.0 ECU_ADDRESS 0xD0009446 /end MEASUREMENT
/begin MEASUREMENT DFES_EnvBlock1477 "vollständige Umweldaten alle Fehlerspeichereinträge" UBYTE DFES_OneToOne 1 100 0.00 255.0 ECU_ADDRESS 0xD0009447 /end MEASUREMENT
/begin MEASUREMENT DFES_EnvBlock1478 "vollständige Umweldaten alle Fehlerspeichereinträge" UBYTE DFES_OneToOne 1 100 0.00 255.0 ECU_ADDRESS 0xD0009448 /end MEASUREMENT
/begin MEASUREMENT DFES_EnvBlock1479 "vollständige Umweldaten alle Fehlerspeichereinträge" UBYTE DFES_OneToOne 1 100 0.00 255.0 ECU_ADDRESS 0xD0009449 /end MEASUREMENT
/begin MEASUREMENT DFES_EnvBlock1480 "vollständige Umweldaten alle Fehlerspeichereinträge" UBYTE DFES_OneToOne 1 100 0.00 255.0 ECU_ADDRESS 0xD000944A /end MEASUREMENT
/begin MEASUREMENT DFES_EnvBlock1481 "vollständige Umweldaten alle Fehlerspeichereinträge" UBYTE DFES_OneToOne 1 100 0.00 255.0 ECU_ADDRESS 0xD000944B /end MEASUREMENT
/begin MEASUREMENT DFES_EnvBlock1482 "vollständige Umweldaten alle Fehlerspeichereinträge" UBYTE DFES_OneToOne 1 100 0.00 255.0 ECU_ADDRESS 0xD000944C /end MEASUREMENT
/begin MEASUREMENT DFES_EnvBlock1483 "vollständige Umweldaten alle Fehlerspeichereinträge" UBYTE DFES_OneToOne 1 100 0.00 255.0 ECU_ADDRESS 0xD000944D /end MEASUREMENT
/begin MEASUREMENT DFES_EnvBlock1484 "vollständige Umweldaten alle Fehlerspeichereinträge" UBYTE DFES_OneToOne 1 100 0.00 255.0 ECU_ADDRESS 0xD000944E /end MEASUREMENT
/begin MEASUREMENT DFES_EnvBlock1485 "vollständige Umweldaten alle Fehlerspeichereinträge" UBYTE DFES_OneToOne 1 100 0.00 255.0 ECU_ADDRESS 0xD000944F /end MEASUREMENT
/begin MEASUREMENT DFES_EnvBlock1486 "vollständige Umweldaten alle Fehlerspeichereinträge" UBYTE DFES_OneToOne 1 100 0.00 255.0 ECU_ADDRESS 0xD0009450 /end MEASUREMENT
/begin MEASUREMENT DFES_EnvBlock1487 "vollständige Umweldaten alle Fehlerspeichereinträge" UBYTE DFES_OneToOne 1 100 0.00 255.0 ECU_ADDRESS 0xD0009451 /end MEASUREMENT
/begin MEASUREMENT DFES_EnvBlock1488 "vollständige Umweldaten alle Fehlerspeichereinträge" UBYTE DFES_OneToOne 1 100 0.00 255.0 ECU_ADDRESS 0xD0009452 /end MEASUREMENT
/begin MEASUREMENT DFES_EnvBlock1489 "vollständige Umweldaten alle Fehlerspeichereinträge" UBYTE DFES_OneToOne 1 100 0.00 255.0 ECU_ADDRESS 0xD0009453 /end MEASUREMENT
/begin MEASUREMENT DFES_EnvBlock1490 "vollständige Umweldaten alle Fehlerspeichereinträge" UBYTE DFES_OneToOne 1 100 0.00 255.0 ECU_ADDRESS 0xD0009454 /end MEASUREMENT
/begin MEASUREMENT DFES_EnvBlock1491 "vollständige Umweldaten alle Fehlerspeichereinträge" UBYTE DFES_OneToOne 1 100 0.00 255.0 ECU_ADDRESS 0xD0009455 /end MEASUREMENT
/begin MEASUREMENT DFES_EnvBlock1492 "vollständige Umweldaten alle Fehlerspeichereinträge" UBYTE DFES_OneToOne 1 100 0.00 255.0 ECU_ADDRESS 0xD0009456 /end MEASUREMENT
/begin MEASUREMENT DFES_EnvBlock1493 "vollständige Umweldaten alle Fehlerspeichereinträge" UBYTE DFES_OneToOne 1 100 0.00 255.0 ECU_ADDRESS 0xD0009457 /end MEASUREMENT
/begin MEASUREMENT DFES_EnvBlock1494 "vollständige Umweldaten alle Fehlerspeichereinträge" UBYTE DFES_OneToOne 1 100 0.00 255.0 ECU_ADDRESS 0xD0009458 /end MEASUREMENT
/begin MEASUREMENT DFES_EnvBlock1495 "vollständige Umweldaten alle Fehlerspeichereinträge" UBYTE DFES_OneToOne 1 100 0.00 255.0 ECU_ADDRESS 0xD0009459 /end MEASUREMENT
/begin MEASUREMENT DFES_EnvBlock1496 "vollständige Umweldaten alle Fehlerspeichereinträge" UBYTE DFES_OneToOne 1 100 0.00 255.0 ECU_ADDRESS 0xD000945A /end MEASUREMENT
/begin MEASUREMENT DFES_EnvBlock1497 "vollständige Umweldaten alle Fehlerspeichereinträge" UBYTE DFES_OneToOne 1 100 0.00 255.0 ECU_ADDRESS 0xD000945B /end MEASUREMENT
/begin MEASUREMENT DFES_EnvBlock1498 "vollständige Umweldaten alle Fehlerspeichereinträge" UBYTE DFES_OneToOne 1 100 0.00 255.0 ECU_ADDRESS 0xD000945C /end MEASUREMENT
/begin MEASUREMENT DFES_EnvBlock1499 "vollständige Umweldaten alle Fehlerspeichereinträge" UBYTE DFES_OneToOne 1 100 0.00 255.0 ECU_ADDRESS 0xD000945D /end MEASUREMENT
/begin MEASUREMENT DFES_EnvBlock1500 "vollständige Umweldaten alle Fehlerspeichereinträge" UBYTE DFES_OneToOne 1 100 0.00 255.0 ECU_ADDRESS 0xD000945E /end MEASUREMENT
/begin MEASUREMENT DFES_EnvBlock1501 "vollständige Umweldaten alle Fehlerspeichereinträge" UBYTE DFES_OneToOne 1 100 0.00 255.0 ECU_ADDRESS 0xD000945F /end MEASUREMENT
/begin MEASUREMENT DFES_EnvBlock1502 "vollständige Umweldaten alle Fehlerspeichereinträge" UBYTE DFES_OneToOne 1 100 0.00 255.0 ECU_ADDRESS 0xD0009460 /end MEASUREMENT
/begin MEASUREMENT DFES_EnvBlock1503 "vollständige Umweldaten alle Fehlerspeichereinträge" UBYTE DFES_OneToOne 1 100 0.00 255.0 ECU_ADDRESS 0xD0009461 /end MEASUREMENT
/begin MEASUREMENT DFES_EnvBlock1504 "vollständige Umweldaten alle Fehlerspeichereinträge" UBYTE DFES_OneToOne 1 100 0.00 255.0 ECU_ADDRESS 0xD0009462 /end MEASUREMENT
/begin MEASUREMENT DFES_EnvBlock1505 "vollständige Umweldaten alle Fehlerspeichereinträge" UBYTE DFES_OneToOne 1 100 0.00 255.0 ECU_ADDRESS 0xD0009463 /end MEASUREMENT
/begin MEASUREMENT DFES_EnvBlock1506 "vollständige Umweldaten alle Fehlerspeichereinträge" UBYTE DFES_OneToOne 1 100 0.00 255.0 ECU_ADDRESS 0xD0009464 /end MEASUREMENT
/begin MEASUREMENT DFES_EnvBlock1507 "vollständige Umweldaten alle Fehlerspeichereinträge" UBYTE DFES_OneToOne 1 100 0.00 255.0 ECU_ADDRESS 0xD0009465 /end MEASUREMENT
/begin MEASUREMENT DFES_EnvBlock1508 "vollständige Umweldaten alle Fehlerspeichereinträge" UBYTE DFES_OneToOne 1 100 0.00 255.0 ECU_ADDRESS 0xD0009466 /end MEASUREMENT
/begin MEASUREMENT DFES_EnvBlock1509 "vollständige Umweldaten alle Fehlerspeichereinträge" UBYTE DFES_OneToOne 1 100 0.00 255.0 ECU_ADDRESS 0xD0009467 /end MEASUREMENT
/begin MEASUREMENT DFES_EnvBlock1510 "vollständige Umweldaten alle Fehlerspeichereinträge" UBYTE DFES_OneToOne 1 100 0.00 255.0 ECU_ADDRESS 0xD0009468 /end MEASUREMENT
/begin MEASUREMENT DFES_EnvBlock1511 "vollständige Umweldaten alle Fehlerspeichereinträge" UBYTE DFES_OneToOne 1 100 0.00 255.0 ECU_ADDRESS 0xD0009469 /end MEASUREMENT
/begin MEASUREMENT DFES_EnvBlock1512 "vollständige Umweldaten alle Fehlerspeichereinträge" UBYTE DFES_OneToOne 1 100 0.00 255.0 ECU_ADDRESS 0xD000946A /end MEASUREMENT
/begin MEASUREMENT DFES_EnvBlock1513 "vollständige Umweldaten alle Fehlerspeichereinträge" UBYTE DFES_OneToOne 1 100 0.00 255.0 ECU_ADDRESS 0xD000946B /end MEASUREMENT
/begin MEASUREMENT DFES_EnvBlock1514 "vollständige Umweldaten alle Fehlerspeichereinträge" UBYTE DFES_OneToOne 1 100 0.00 255.0 ECU_ADDRESS 0xD000946C /end MEASUREMENT
/begin MEASUREMENT DFES_EnvBlock1515 "vollständige Umweldaten alle Fehlerspeichereinträge" UBYTE DFES_OneToOne 1 100 0.00 255.0 ECU_ADDRESS 0xD000946D /end MEASUREMENT
/begin MEASUREMENT DFES_EnvBlock1516 "vollständige Umweldaten alle Fehlerspeichereinträge" UBYTE DFES_OneToOne 1 100 0.00 255.0 ECU_ADDRESS 0xD000946E /end MEASUREMENT
/begin MEASUREMENT DFES_EnvBlock1517 "vollständige Umweldaten alle Fehlerspeichereinträge" UBYTE DFES_OneToOne 1 100 0.00 255.0 ECU_ADDRESS 0xD000946F /end MEASUREMENT
/begin MEASUREMENT DFES_EnvBlock1518 "vollständige Umweldaten alle Fehlerspeichereinträge" UBYTE DFES_OneToOne 1 100 0.00 255.0 ECU_ADDRESS 0xD0009470 /end MEASUREMENT
/begin MEASUREMENT DFES_EnvBlock1519 "vollständige Umweldaten alle Fehlerspeichereinträge" UBYTE DFES_OneToOne 1 100 0.00 255.0 ECU_ADDRESS 0xD0009471 /end MEASUREMENT
/begin MEASUREMENT DFES_EnvBlock1520 "vollständige Umweldaten alle Fehlerspeichereinträge" UBYTE DFES_OneToOne 1 100 0.00 255.0 ECU_ADDRESS 0xD0009472 /end MEASUREMENT
/begin MEASUREMENT DFES_EnvBlock1521 "vollständige Umweldaten alle Fehlerspeichereinträge" UBYTE DFES_OneToOne 1 100 0.00 255.0 ECU_ADDRESS 0xD0009473 /end MEASUREMENT
/begin MEASUREMENT DFES_EnvBlock1522 "vollständige Umweldaten alle Fehlerspeichereinträge" UBYTE DFES_OneToOne 1 100 0.00 255.0 ECU_ADDRESS 0xD0009474 /end MEASUREMENT
/begin MEASUREMENT DFES_EnvBlock1523 "vollständige Umweldaten alle Fehlerspeichereinträge" UBYTE DFES_OneToOne 1 100 0.00 255.0 ECU_ADDRESS 0xD0009475 /end MEASUREMENT
/begin MEASUREMENT DFES_EnvBlock1524 "vollständige Umweldaten alle Fehlerspeichereinträge" UBYTE DFES_OneToOne 1 100 0.00 255.0 ECU_ADDRESS 0xD0009476 /end MEASUREMENT
/begin MEASUREMENT DFES_EnvBlock1525 "vollständige Umweldaten alle Fehlerspeichereinträge" UBYTE DFES_OneToOne 1 100 0.00 255.0 ECU_ADDRESS 0xD0009477 /end MEASUREMENT
/begin MEASUREMENT DFES_EnvBlock1526 "vollständige Umweldaten alle Fehlerspeichereinträge" UBYTE DFES_OneToOne 1 100 0.00 255.0 ECU_ADDRESS 0xD0009478 /end MEASUREMENT
/begin MEASUREMENT DFES_EnvBlock1527 "vollständige Umweldaten alle Fehlerspeichereinträge" UBYTE DFES_OneToOne 1 100 0.00 255.0 ECU_ADDRESS 0xD0009479 /end MEASUREMENT
/begin MEASUREMENT DFES_EnvBlock1528 "vollständige Umweldaten alle Fehlerspeichereinträge" UBYTE DFES_OneToOne 1 100 0.00 255.0 ECU_ADDRESS 0xD000947A /end MEASUREMENT
/begin MEASUREMENT DFES_EnvBlock1529 "vollständige Umweldaten alle Fehlerspeichereinträge" UBYTE DFES_OneToOne 1 100 0.00 255.0 ECU_ADDRESS 0xD000947B /end MEASUREMENT
/begin MEASUREMENT DFES_EnvBlock1530 "vollständige Umweldaten alle Fehlerspeichereinträge" UBYTE DFES_OneToOne 1 100 0.00 255.0 ECU_ADDRESS 0xD000947C /end MEASUREMENT
/begin MEASUREMENT DFES_EnvBlock1531 "vollständige Umweldaten alle Fehlerspeichereinträge" UBYTE DFES_OneToOne 1 100 0.00 255.0 ECU_ADDRESS 0xD000947D /end MEASUREMENT
/begin MEASUREMENT DFES_EnvBlock1532 "vollständige Umweldaten alle Fehlerspeichereinträge" UBYTE DFES_OneToOne 1 100 0.00 255.0 ECU_ADDRESS 0xD000947E /end MEASUREMENT
/begin MEASUREMENT DFES_EnvBlock1533 "vollständige Umweldaten alle Fehlerspeichereinträge" UBYTE DFES_OneToOne 1 100 0.00 255.0 ECU_ADDRESS 0xD000947F /end MEASUREMENT
/begin MEASUREMENT DFES_EnvBlock1534 "vollständige Umweldaten alle Fehlerspeichereinträge" UBYTE DFES_OneToOne 1 100 0.00 255.0 ECU_ADDRESS 0xD0009480 /end MEASUREMENT
/begin MEASUREMENT DFES_EnvBlock1535 "vollständige Umweldaten alle Fehlerspeichereinträge" UBYTE DFES_OneToOne 1 100 0.00 255.0 ECU_ADDRESS 0xD0009481 /end MEASUREMENT
/begin MEASUREMENT DFES_EnvBlock1536 "vollständige Umweldaten alle Fehlerspeichereinträge" UBYTE DFES_OneToOne 1 100 0.00 255.0 ECU_ADDRESS 0xD0009482 /end MEASUREMENT
/begin MEASUREMENT DFES_EnvBlock1537 "vollständige Umweldaten alle Fehlerspeichereinträge" UBYTE DFES_OneToOne 1 100 0.00 255.0 ECU_ADDRESS 0xD0009483 /end MEASUREMENT
/begin MEASUREMENT DFES_EnvBlock1538 "vollständige Umweldaten alle Fehlerspeichereinträge" UBYTE DFES_OneToOne 1 100 0.00 255.0 ECU_ADDRESS 0xD0009484 /end MEASUREMENT
/begin MEASUREMENT DFES_EnvBlock1539 "vollständige Umweldaten alle Fehlerspeichereinträge" UBYTE DFES_OneToOne 1 100 0.00 255.0 ECU_ADDRESS 0xD0009485 /end MEASUREMENT
/begin MEASUREMENT DFES_EnvBlock1540 "vollständige Umweldaten alle Fehlerspeichereinträge" UBYTE DFES_OneToOne 1 100 0.00 255.0 ECU_ADDRESS 0xD0009486 /end MEASUREMENT
/begin MEASUREMENT DFES_EnvBlock1541 "vollständige Umweldaten alle Fehlerspeichereinträge" UBYTE DFES_OneToOne 1 100 0.00 255.0 ECU_ADDRESS 0xD0009487 /end MEASUREMENT
/begin MEASUREMENT DFES_EnvBlock1542 "vollständige Umweldaten alle Fehlerspeichereinträge" UBYTE DFES_OneToOne 1 100 0.00 255.0 ECU_ADDRESS 0xD0009488 /end MEASUREMENT
/begin MEASUREMENT DFES_EnvBlock1543 "vollständige Umweldaten alle Fehlerspeichereinträge" UBYTE DFES_OneToOne 1 100 0.00 255.0 ECU_ADDRESS 0xD0009489 /end MEASUREMENT
/begin MEASUREMENT DFES_EnvBlock1544 "vollständige Umweldaten alle Fehlerspeichereinträge" UBYTE DFES_OneToOne 1 100 0.00 255.0 ECU_ADDRESS 0xD000948A /end MEASUREMENT
/begin MEASUREMENT DFES_EnvBlock1545 "vollständige Umweldaten alle Fehlerspeichereinträge" UBYTE DFES_OneToOne 1 100 0.00 255.0 ECU_ADDRESS 0xD000948B /end MEASUREMENT
/begin MEASUREMENT DFES_EnvBlock1546 "vollständige Umweldaten alle Fehlerspeichereinträge" UBYTE DFES_OneToOne 1 100 0.00 255.0 ECU_ADDRESS 0xD000948C /end MEASUREMENT
/begin MEASUREMENT DFES_EnvBlock1547 "vollständige Umweldaten alle Fehlerspeichereinträge" UBYTE DFES_OneToOne 1 100 0.00 255.0 ECU_ADDRESS 0xD000948D /end MEASUREMENT
/begin MEASUREMENT DFES_EnvBlock1548 "vollständige Umweldaten alle Fehlerspeichereinträge" UBYTE DFES_OneToOne 1 100 0.00 255.0 ECU_ADDRESS 0xD000948E /end MEASUREMENT
/begin MEASUREMENT DFES_EnvBlock1549 "vollständige Umweldaten alle Fehlerspeichereinträge" UBYTE DFES_OneToOne 1 100 0.00 255.0 ECU_ADDRESS 0xD000948F /end MEASUREMENT
/begin MEASUREMENT DFES_EnvBlock1550 "vollständige Umweldaten alle Fehlerspeichereinträge" UBYTE DFES_OneToOne 1 100 0.00 255.0 ECU_ADDRESS 0xD0009490 /end MEASUREMENT
/begin MEASUREMENT DFES_EnvBlock1551 "vollständige Umweldaten alle Fehlerspeichereinträge" UBYTE DFES_OneToOne 1 100 0.00 255.0 ECU_ADDRESS 0xD0009491 /end MEASUREMENT
/begin MEASUREMENT DFES_EnvBlock1552 "vollständige Umweldaten alle Fehlerspeichereinträge" UBYTE DFES_OneToOne 1 100 0.00 255.0 ECU_ADDRESS 0xD0009492 /end MEASUREMENT
/begin MEASUREMENT DFES_EnvBlock1553 "vollständige Umweldaten alle Fehlerspeichereinträge" UBYTE DFES_OneToOne 1 100 0.00 255.0 ECU_ADDRESS 0xD0009493 /end MEASUREMENT
/begin MEASUREMENT DFES_EnvBlock1554 "vollständige Umweldaten alle Fehlerspeichereinträge" UBYTE DFES_OneToOne 1 100 0.00 255.0 ECU_ADDRESS 0xD0009494 /end MEASUREMENT
/begin MEASUREMENT DFES_EnvBlock1555 "vollständige Umweldaten alle Fehlerspeichereinträge" UBYTE DFES_OneToOne 1 100 0.00 255.0 ECU_ADDRESS 0xD0009495 /end MEASUREMENT
/begin MEASUREMENT DFES_EnvBlock1556 "vollständige Umweldaten alle Fehlerspeichereinträge" UBYTE DFES_OneToOne 1 100 0.00 255.0 ECU_ADDRESS 0xD0009496 /end MEASUREMENT
/begin MEASUREMENT DFES_EnvBlock1557 "vollständige Umweldaten alle Fehlerspeichereinträge" UBYTE DFES_OneToOne 1 100 0.00 255.0 ECU_ADDRESS 0xD0009497 /end MEASUREMENT
/begin MEASUREMENT DFES_EnvBlock1558 "vollständige Umweldaten alle Fehlerspeichereinträge" UBYTE DFES_OneToOne 1 100 0.00 255.0 ECU_ADDRESS 0xD0009498 /end MEASUREMENT
/begin MEASUREMENT DFES_EnvBlock1559 "vollständige Umweldaten alle Fehlerspeichereinträge" UBYTE DFES_OneToOne 1 100 0.00 255.0 ECU_ADDRESS 0xD0009499 /end MEASUREMENT
/begin MEASUREMENT DFES_EnvBlock1560 "vollständige Umweldaten alle Fehlerspeichereinträge" UBYTE DFES_OneToOne 1 100 0.00 255.0 ECU_ADDRESS 0xD000949A /end MEASUREMENT
/begin MEASUREMENT DFES_EnvBlock1561 "vollständige Umweldaten alle Fehlerspeichereinträge" UBYTE DFES_OneToOne 1 100 0.00 255.0 ECU_ADDRESS 0xD000949B /end MEASUREMENT
/begin MEASUREMENT DFES_EnvBlock1562 "vollständige Umweldaten alle Fehlerspeichereinträge" UBYTE DFES_OneToOne 1 100 0.00 255.0 ECU_ADDRESS 0xD000949C /end MEASUREMENT
/begin MEASUREMENT DFES_EnvBlock1563 "vollständige Umweldaten alle Fehlerspeichereinträge" UBYTE DFES_OneToOne 1 100 0.00 255.0 ECU_ADDRESS 0xD000949D /end MEASUREMENT
/begin MEASUREMENT DFES_EnvBlock1564 "vollständige Umweldaten alle Fehlerspeichereinträge" UBYTE DFES_OneToOne 1 100 0.00 255.0 ECU_ADDRESS 0xD000949E /end MEASUREMENT
/begin MEASUREMENT DFES_EnvBlock1565 "vollständige Umweldaten alle Fehlerspeichereinträge" UBYTE DFES_OneToOne 1 100 0.00 255.0 ECU_ADDRESS 0xD000949F /end MEASUREMENT
/begin MEASUREMENT DFES_EnvBlock1566 "vollständige Umweldaten alle Fehlerspeichereinträge" UBYTE DFES_OneToOne 1 100 0.00 255.0 ECU_ADDRESS 0xD00094A0 /end MEASUREMENT
/begin MEASUREMENT DFES_EnvBlock1567 "vollständige Umweldaten alle Fehlerspeichereinträge" UBYTE DFES_OneToOne 1 100 0.00 255.0 ECU_ADDRESS 0xD00094A1 /end MEASUREMENT
/begin MEASUREMENT DFES_EnvBlock1568 "vollständige Umweldaten alle Fehlerspeichereinträge" UBYTE DFES_OneToOne 1 100 0.00 255.0 ECU_ADDRESS 0xD00094A2 /end MEASUREMENT
/begin MEASUREMENT DFES_EnvBlock1569 "vollständige Umweldaten alle Fehlerspeichereinträge" UBYTE DFES_OneToOne 1 100 0.00 255.0 ECU_ADDRESS 0xD00094A3 /end MEASUREMENT
/begin MEASUREMENT DFES_EnvBlock1570 "vollständige Umweldaten alle Fehlerspeichereinträge" UBYTE DFES_OneToOne 1 100 0.00 255.0 ECU_ADDRESS 0xD00094A4 /end MEASUREMENT
/begin MEASUREMENT DFES_EnvBlock1571 "vollständige Umweldaten alle Fehlerspeichereinträge" UBYTE DFES_OneToOne 1 100 0.00 255.0 ECU_ADDRESS 0xD00094A5 /end MEASUREMENT
/begin MEASUREMENT DFES_EnvBlock1572 "vollständige Umweldaten alle Fehlerspeichereinträge" UBYTE DFES_OneToOne 1 100 0.00 255.0 ECU_ADDRESS 0xD00094A6 /end MEASUREMENT
/begin MEASUREMENT DFES_EnvBlock1573 "vollständige Umweldaten alle Fehlerspeichereinträge" UBYTE DFES_OneToOne 1 100 0.00 255.0 ECU_ADDRESS 0xD00094A7 /end MEASUREMENT
/begin MEASUREMENT DFES_EnvBlock1574 "vollständige Umweldaten alle Fehlerspeichereinträge" UBYTE DFES_OneToOne 1 100 0.00 255.0 ECU_ADDRESS 0xD00094A8 /end MEASUREMENT
/begin MEASUREMENT DFES_EnvBlock1575 "vollständige Umweldaten alle Fehlerspeichereinträge" UBYTE DFES_OneToOne 1 100 0.00 255.0 ECU_ADDRESS 0xD00094A9 /end MEASUREMENT
/begin MEASUREMENT DFES_EnvBlock1576 "vollständige Umweldaten alle Fehlerspeichereinträge" UBYTE DFES_OneToOne 1 100 0.00 255.0 ECU_ADDRESS 0xD00094AA /end MEASUREMENT
/begin MEASUREMENT DFES_EnvBlock1577 "vollständige Umweldaten alle Fehlerspeichereinträge" UBYTE DFES_OneToOne 1 100 0.00 255.0 ECU_ADDRESS 0xD00094AB /end MEASUREMENT
/begin MEASUREMENT DFES_EnvBlock1578 "vollständige Umweldaten alle Fehlerspeichereinträge" UBYTE DFES_OneToOne 1 100 0.00 255.0 ECU_ADDRESS 0xD00094AC /end MEASUREMENT
/begin MEASUREMENT DFES_EnvBlock1579 "vollständige Umweldaten alle Fehlerspeichereinträge" UBYTE DFES_OneToOne 1 100 0.00 255.0 ECU_ADDRESS 0xD00094AD /end MEASUREMENT
/begin MEASUREMENT DFES_EnvBlock1580 "vollständige Umweldaten alle Fehlerspeichereinträge" UBYTE DFES_OneToOne 1 100 0.00 255.0 ECU_ADDRESS 0xD00094AE /end MEASUREMENT
/begin MEASUREMENT DFES_EnvBlock1581 "vollständige Umweldaten alle Fehlerspeichereinträge" UBYTE DFES_OneToOne 1 100 0.00 255.0 ECU_ADDRESS 0xD00094AF /end MEASUREMENT
/begin MEASUREMENT DFES_EnvBlock1582 "vollständige Umweldaten alle Fehlerspeichereinträge" UBYTE DFES_OneToOne 1 100 0.00 255.0 ECU_ADDRESS 0xD00094B0 /end MEASUREMENT
/begin MEASUREMENT DFES_EnvBlock1583 "vollständige Umweldaten alle Fehlerspeichereinträge" UBYTE DFES_OneToOne 1 100 0.00 255.0 ECU_ADDRESS 0xD00094B1 /end MEASUREMENT
/begin MEASUREMENT DFES_EnvBlock1584 "vollständige Umweldaten alle Fehlerspeichereinträge" UBYTE DFES_OneToOne 1 100 0.00 255.0 ECU_ADDRESS 0xD00094B2 /end MEASUREMENT
/begin MEASUREMENT DFES_EnvBlock1585 "vollständige Umweldaten alle Fehlerspeichereinträge" UBYTE DFES_OneToOne 1 100 0.00 255.0 ECU_ADDRESS 0xD00094B3 /end MEASUREMENT
/begin MEASUREMENT DFES_EnvBlock1586 "vollständige Umweldaten alle Fehlerspeichereinträge" UBYTE DFES_OneToOne 1 100 0.00 255.0 ECU_ADDRESS 0xD00094B4 /end MEASUREMENT
/begin MEASUREMENT DFES_EnvBlock1587 "vollständige Umweldaten alle Fehlerspeichereinträge" UBYTE DFES_OneToOne 1 100 0.00 255.0 ECU_ADDRESS 0xD00094B5 /end MEASUREMENT
/begin MEASUREMENT DFES_EnvBlock1588 "vollständige Umweldaten alle Fehlerspeichereinträge" UBYTE DFES_OneToOne 1 100 0.00 255.0 ECU_ADDRESS 0xD00094B6 /end MEASUREMENT
/begin MEASUREMENT DFES_EnvBlock1589 "vollständige Umweldaten alle Fehlerspeichereinträge" UBYTE DFES_OneToOne 1 100 0.00 255.0 ECU_ADDRESS 0xD00094B7 /end MEASUREMENT
/begin MEASUREMENT DFES_EnvBlock1590 "vollständige Umweldaten alle Fehlerspeichereinträge" UBYTE DFES_OneToOne 1 100 0.00 255.0 ECU_ADDRESS 0xD00094B8 /end MEASUREMENT
/begin MEASUREMENT DFES_EnvBlock1591 "vollständige Umweldaten alle Fehlerspeichereinträge" UBYTE DFES_OneToOne 1 100 0.00 255.0 ECU_ADDRESS 0xD00094B9 /end MEASUREMENT
/begin MEASUREMENT DFES_EnvBlock1592 "vollständige Umweldaten alle Fehlerspeichereinträge" UBYTE DFES_OneToOne 1 100 0.00 255.0 ECU_ADDRESS 0xD00094BA /end MEASUREMENT
/begin MEASUREMENT DFES_EnvBlock1593 "vollständige Umweldaten alle Fehlerspeichereinträge" UBYTE DFES_OneToOne 1 100 0.00 255.0 ECU_ADDRESS 0xD00094BB /end MEASUREMENT
/begin MEASUREMENT DFES_EnvBlock1594 "vollständige Umweldaten alle Fehlerspeichereinträge" UBYTE DFES_OneToOne 1 100 0.00 255.0 ECU_ADDRESS 0xD00094BC /end MEASUREMENT
/begin MEASUREMENT DFES_EnvBlock1595 "vollständige Umweldaten alle Fehlerspeichereinträge" UBYTE DFES_OneToOne 1 100 0.00 255.0 ECU_ADDRESS 0xD00094BD /end MEASUREMENT
/begin MEASUREMENT DFES_EnvBlock1596 "vollständige Umweldaten alle Fehlerspeichereinträge" UBYTE DFES_OneToOne 1 100 0.00 255.0 ECU_ADDRESS 0xD00094BE /end MEASUREMENT
/begin MEASUREMENT DFES_EnvBlock1597 "vollständige Umweldaten alle Fehlerspeichereinträge" UBYTE DFES_OneToOne 1 100 0.00 255.0 ECU_ADDRESS 0xD00094BF /end MEASUREMENT
/begin MEASUREMENT DFES_EnvBlock1598 "vollständige Umweldaten alle Fehlerspeichereinträge" UBYTE DFES_OneToOne 1 100 0.00 255.0 ECU_ADDRESS 0xD00094C0 /end MEASUREMENT
/begin MEASUREMENT DFES_EnvBlock1599 "vollständige Umweldaten alle Fehlerspeichereinträge" UBYTE DFES_OneToOne 1 100 0.00 255.0 ECU_ADDRESS 0xD00094C1 /end MEASUREMENT
/begin MEASUREMENT DFES_FrzFrVal00 "freeze frame Daten aller Fehlerspeichereinträge" UBYTE DFES_OneToOne 1 100 0.00 255.0 ECU_ADDRESS 0xD0008D42 /end MEASUREMENT
/begin MEASUREMENT DFES_FrzFrVal01 "freeze frame Daten aller Fehlerspeichereinträge" UBYTE DFES_OneToOne 1 100 0.00 255.0 ECU_ADDRESS 0xD0008D43 /end MEASUREMENT
/begin MEASUREMENT DFES_FrzFrVal02 "freeze frame Daten aller Fehlerspeichereinträge" UBYTE DFES_OneToOne 1 100 0.00 255.0 ECU_ADDRESS 0xD0008D44 /end MEASUREMENT
/begin MEASUREMENT DFES_FrzFrVal03 "freeze frame Daten aller Fehlerspeichereinträge" UBYTE DFES_OneToOne 1 100 0.00 255.0 ECU_ADDRESS 0xD0008D45 /end MEASUREMENT
/begin MEASUREMENT DFES_FrzFrVal04 "freeze frame Daten aller Fehlerspeichereinträge" UBYTE DFES_OneToOne 1 100 0.00 255.0 ECU_ADDRESS 0xD0008D46 /end MEASUREMENT
/begin MEASUREMENT DFES_FrzFrVal05 "freeze frame Daten aller Fehlerspeichereinträge" UBYTE DFES_OneToOne 1 100 0.00 255.0 ECU_ADDRESS 0xD0008D47 /end MEASUREMENT
/begin MEASUREMENT DFES_FrzFrVal06 "freeze frame Daten aller Fehlerspeichereinträge" UBYTE DFES_OneToOne 1 100 0.00 255.0 ECU_ADDRESS 0xD0008D48 /end MEASUREMENT
/begin MEASUREMENT DFES_FrzFrVal07 "freeze frame Daten aller Fehlerspeichereinträge" UBYTE DFES_OneToOne 1 100 0.00 255.0 ECU_ADDRESS 0xD0008D49 /end MEASUREMENT
/begin MEASUREMENT DFES_FrzFrVal08 "freeze frame Daten aller Fehlerspeichereinträge" UBYTE DFES_OneToOne 1 100 0.00 255.0 ECU_ADDRESS 0xD0008D4A /end MEASUREMENT
/begin MEASUREMENT DFES_FrzFrVal09 "freeze frame Daten aller Fehlerspeichereinträge" UBYTE DFES_OneToOne 1 100 0.00 255.0 ECU_ADDRESS 0xD0008D4B /end MEASUREMENT
/begin MEASUREMENT DFES_FrzFrVal10 "freeze frame Daten aller Fehlerspeichereinträge" UBYTE DFES_OneToOne 1 100 0.00 255.0 ECU_ADDRESS 0xD0008D4C /end MEASUREMENT
/begin MEASUREMENT DFES_FrzFrVal11 "freeze frame Daten aller Fehlerspeichereinträge" UBYTE DFES_OneToOne 1 100 0.00 255.0 ECU_ADDRESS 0xD0008D4D /end MEASUREMENT
/begin MEASUREMENT DFES_FrzFrVal12 "freeze frame Daten aller Fehlerspeichereinträge" UBYTE DFES_OneToOne 1 100 0.00 255.0 ECU_ADDRESS 0xD0008D4E /end MEASUREMENT
/begin MEASUREMENT DFES_FrzFrVal13 "freeze frame Daten aller Fehlerspeichereinträge" UBYTE DFES_OneToOne 1 100 0.00 255.0 ECU_ADDRESS 0xD0008D4F /end MEASUREMENT
/begin MEASUREMENT DFES_FrzFrVal14 "freeze frame Daten aller Fehlerspeichereinträge" UBYTE DFES_OneToOne 1 100 0.00 255.0 ECU_ADDRESS 0xD0008D50 /end MEASUREMENT
/begin MEASUREMENT DFES_FrzFrVal15 "freeze frame Daten aller Fehlerspeichereinträge" UBYTE DFES_OneToOne 1 100 0.00 255.0 ECU_ADDRESS 0xD0008D51 /end MEASUREMENT
/begin MEASUREMENT DFES_FrzFrVal16 "freeze frame Daten aller Fehlerspeichereinträge" UBYTE DFES_OneToOne 1 100 0.00 255.0 ECU_ADDRESS 0xD0008D52 /end MEASUREMENT
/begin MEASUREMENT DFES_FrzFrVal17 "freeze frame Daten aller Fehlerspeichereinträge" UBYTE DFES_OneToOne 1 100 0.00 255.0 ECU_ADDRESS 0xD0008D53 /end MEASUREMENT
/begin MEASUREMENT DFES_FrzFrVal18 "freeze frame Daten aller Fehlerspeichereinträge" UBYTE DFES_OneToOne 1 100 0.00 255.0 ECU_ADDRESS 0xD0008D54 /end MEASUREMENT
/begin MEASUREMENT DFES_FrzFrVal19 "freeze frame Daten aller Fehlerspeichereinträge" UBYTE DFES_OneToOne 1 100 0.00 255.0 ECU_ADDRESS 0xD0008D55 /end MEASUREMENT
/begin MEASUREMENT DFES_FrzFrVal20 "freeze frame Daten aller Fehlerspeichereinträge" UBYTE DFES_OneToOne 1 100 0.00 255.0 ECU_ADDRESS 0xD0008D56 /end MEASUREMENT
/begin MEASUREMENT DFES_FrzFrVal21 "freeze frame Daten aller Fehlerspeichereinträge" UBYTE DFES_OneToOne 1 100 0.00 255.0 ECU_ADDRESS 0xD0008D57 /end MEASUREMENT
/begin MEASUREMENT DFES_FrzFrVal22 "freeze frame Daten aller Fehlerspeichereinträge" UBYTE DFES_OneToOne 1 100 0.00 255.0 ECU_ADDRESS 0xD0008D58 /end MEASUREMENT
/begin MEASUREMENT DFES_FrzFrVal23 "freeze frame Daten aller Fehlerspeichereinträge" UBYTE DFES_OneToOne 1 100 0.00 255.0 ECU_ADDRESS 0xD0008D59 /end MEASUREMENT
/begin MEASUREMENT DFES_FrzFrVal24 "freeze frame Daten aller Fehlerspeichereinträge" UBYTE DFES_OneToOne 1 100 0.00 255.0 ECU_ADDRESS 0xD0008D5A /end MEASUREMENT
/begin MEASUREMENT DFES_FrzFrVal25 "freeze frame Daten aller Fehlerspeichereinträge" UBYTE DFES_OneToOne 1 100 0.00 255.0 ECU_ADDRESS 0xD0008D5B /end MEASUREMENT
/begin MEASUREMENT DFES_FrzFrVal26 "freeze frame Daten aller Fehlerspeichereinträge" UBYTE DFES_OneToOne 1 100 0.00 255.0 ECU_ADDRESS 0xD0008D5C /end MEASUREMENT
/begin MEASUREMENT DFES_FrzFrVal27 "freeze frame Daten aller Fehlerspeichereinträge" UBYTE DFES_OneToOne 1 100 0.00 255.0 ECU_ADDRESS 0xD0008D5D /end MEASUREMENT
/begin MEASUREMENT DFES_FrzFrVal28 "freeze frame Daten aller Fehlerspeichereinträge" UBYTE DFES_OneToOne 1 100 0.00 255.0 ECU_ADDRESS 0xD0008D5E /end MEASUREMENT
/begin MEASUREMENT DFES_FrzFrVal29 "freeze frame Daten aller Fehlerspeichereinträge" UBYTE DFES_OneToOne 1 100 0.00 255.0 ECU_ADDRESS 0xD0008D5F /end MEASUREMENT
/begin MEASUREMENT DFES_FrzFrVal30 "freeze frame Daten aller Fehlerspeichereinträge" UBYTE DFES_OneToOne 1 100 0.00 255.0 ECU_ADDRESS 0xD0008D60 /end MEASUREMENT
/begin MEASUREMENT DFES_FrzFrVal31 "freeze frame Daten aller Fehlerspeichereinträge" UBYTE DFES_OneToOne 1 100 0.00 255.0 ECU_ADDRESS 0xD0008D61 /end MEASUREMENT
/begin MEASUREMENT DFES_FrzFrVal32 "freeze frame Daten aller Fehlerspeichereinträge" UBYTE DFES_OneToOne 1 100 0.00 255.0 ECU_ADDRESS 0xD0008D62 /end MEASUREMENT
/begin MEASUREMENT DFES_FrzFrVal33 "freeze frame Daten aller Fehlerspeichereinträge" UBYTE DFES_OneToOne 1 100 0.00 255.0 ECU_ADDRESS 0xD0008D63 /end MEASUREMENT
/begin MEASUREMENT DFES_FrzFrVal34 "freeze frame Daten aller Fehlerspeichereinträge" UBYTE DFES_OneToOne 1 100 0.00 255.0 ECU_ADDRESS 0xD0008D64 /end MEASUREMENT
/begin MEASUREMENT DFES_FrzFrVal35 "freeze frame Daten aller Fehlerspeichereinträge" UBYTE DFES_OneToOne 1 100 0.00 255.0 ECU_ADDRESS 0xD0008D65 /end MEASUREMENT
/begin MEASUREMENT DFES_FrzFrVal36 "freeze frame Daten aller Fehlerspeichereinträge" UBYTE DFES_OneToOne 1 100 0.00 255.0 ECU_ADDRESS 0xD0008D66 /end MEASUREMENT
/begin MEASUREMENT DFES_FrzFrVal37 "freeze frame Daten aller Fehlerspeichereinträge" UBYTE DFES_OneToOne 1 100 0.00 255.0 ECU_ADDRESS 0xD0008D67 /end MEASUREMENT
/begin MEASUREMENT DFES_FrzFrVal38 "freeze frame Daten aller Fehlerspeichereinträge" UBYTE DFES_OneToOne 1 100 0.00 255.0 ECU_ADDRESS 0xD0008D68 /end MEASUREMENT
/begin MEASUREMENT DFES_FrzFrVal39 "freeze frame Daten aller Fehlerspeichereinträge" UBYTE DFES_OneToOne 1 100 0.00 255.0 ECU_ADDRESS 0xD0008D69 /end MEASUREMENT
/begin MEASUREMENT DFES_FrzFrVal40 "freeze frame Daten aller Fehlerspeichereinträge" UBYTE DFES_OneToOne 1 100 0.00 255.0 ECU_ADDRESS 0xD0008D6A /end MEASUREMENT
/begin MEASUREMENT DFES_FrzFrVal41 "freeze frame Daten aller Fehlerspeichereinträge" UBYTE DFES_OneToOne 1 100 0.00 255.0 ECU_ADDRESS 0xD0008D6B /end MEASUREMENT
/begin MEASUREMENT DFES_FrzFrVal42 "freeze frame Daten aller Fehlerspeichereinträge" UBYTE DFES_OneToOne 1 100 0.00 255.0 ECU_ADDRESS 0xD0008D6C /end MEASUREMENT
/begin MEASUREMENT DFES_FrzFrVal43 "freeze frame Daten aller Fehlerspeichereinträge" UBYTE DFES_OneToOne 1 100 0.00 255.0 ECU_ADDRESS 0xD0008D6D /end MEASUREMENT
/begin MEASUREMENT DFES_FrzFrVal44 "freeze frame Daten aller Fehlerspeichereinträge" UBYTE DFES_OneToOne 1 100 0.00 255.0 ECU_ADDRESS 0xD0008D6E /end MEASUREMENT
/begin MEASUREMENT DFES_FrzFrVal45 "freeze frame Daten aller Fehlerspeichereinträge" UBYTE DFES_OneToOne 1 100 0.00 255.0 ECU_ADDRESS 0xD0008D6F /end MEASUREMENT
/begin MEASUREMENT DFES_FrzFrVal46 "freeze frame Daten aller Fehlerspeichereinträge" UBYTE DFES_OneToOne 1 100 0.00 255.0 ECU_ADDRESS 0xD0008D70 /end MEASUREMENT
/begin MEASUREMENT DFES_FrzFrVal47 "freeze frame Daten aller Fehlerspeichereinträge" UBYTE DFES_OneToOne 1 100 0.00 255.0 ECU_ADDRESS 0xD0008D71 /end MEASUREMENT
/begin MEASUREMENT DFES_FrzFrVal48 "freeze frame Daten aller Fehlerspeichereinträge" UBYTE DFES_OneToOne 1 100 0.00 255.0 ECU_ADDRESS 0xD0008D72 /end MEASUREMENT
/begin MEASUREMENT DFES_FrzFrVal49 "freeze frame Daten aller Fehlerspeichereinträge" UBYTE DFES_OneToOne 1 100 0.00 255.0 ECU_ADDRESS 0xD0008D73 /end MEASUREMENT
/begin MEASUREMENT DFES_FrzFrVal50 "freeze frame Daten aller Fehlerspeichereinträge" UBYTE DFES_OneToOne 1 100 0.00 255.0 ECU_ADDRESS 0xD0008D74 /end MEASUREMENT
/begin MEASUREMENT DFES_FrzFrVal51 "freeze frame Daten aller Fehlerspeichereinträge" UBYTE DFES_OneToOne 1 100 0.00 255.0 ECU_ADDRESS 0xD0008D75 /end MEASUREMENT
/begin MEASUREMENT DFES_FrzFrVal52 "freeze frame Daten aller Fehlerspeichereinträge" UBYTE DFES_OneToOne 1 100 0.00 255.0 ECU_ADDRESS 0xD0008D76 /end MEASUREMENT
/begin MEASUREMENT DFES_FrzFrVal53 "freeze frame Daten aller Fehlerspeichereinträge" UBYTE DFES_OneToOne 1 100 0.00 255.0 ECU_ADDRESS 0xD0008D77 /end MEASUREMENT
/begin MEASUREMENT DFES_FrzFrVal54 "freeze frame Daten aller Fehlerspeichereinträge" UBYTE DFES_OneToOne 1 100 0.00 255.0 ECU_ADDRESS 0xD0008D78 /end MEASUREMENT
/begin MEASUREMENT DFES_FrzFrVal55 "freeze frame Daten aller Fehlerspeichereinträge" UBYTE DFES_OneToOne 1 100 0.00 255.0 ECU_ADDRESS 0xD0008D79 /end MEASUREMENT
/begin MEASUREMENT DFES_FrzFrVal56 "freeze frame Daten aller Fehlerspeichereinträge" UBYTE DFES_OneToOne 1 100 0.00 255.0 ECU_ADDRESS 0xD0008D7A /end MEASUREMENT
/begin MEASUREMENT DFES_FrzFrVal57 "freeze frame Daten aller Fehlerspeichereinträge" UBYTE DFES_OneToOne 1 100 0.00 255.0 ECU_ADDRESS 0xD0008D7B /end MEASUREMENT
/begin MEASUREMENT DFES_FrzFrVal58 "freeze frame Daten aller Fehlerspeichereinträge" UBYTE DFES_OneToOne 1 100 0.00 255.0 ECU_ADDRESS 0xD0008D7C /end MEASUREMENT
/begin MEASUREMENT DFES_FrzFrVal59 "freeze frame Daten aller Fehlerspeichereinträge" UBYTE DFES_OneToOne 1 100 0.00 255.0 ECU_ADDRESS 0xD0008D7D /end MEASUREMENT
/begin MEASUREMENT DFES_FrzFrVal60 "freeze frame Daten aller Fehlerspeichereinträge" UBYTE DFES_OneToOne 1 100 0.00 255.0 ECU_ADDRESS 0xD0008D7E /end MEASUREMENT
/begin MEASUREMENT DFES_FrzFrVal61 "freeze frame Daten aller Fehlerspeichereinträge" UBYTE DFES_OneToOne 1 100 0.00 255.0 ECU_ADDRESS 0xD0008D7F /end MEASUREMENT
/begin MEASUREMENT DFES_FrzFrVal62 "freeze frame Daten aller Fehlerspeichereinträge" UBYTE DFES_OneToOne 1 100 0.00 255.0 ECU_ADDRESS 0xD0008D80 /end MEASUREMENT
/begin MEASUREMENT DFES_FrzFrVal63 "freeze frame Daten aller Fehlerspeichereinträge" UBYTE DFES_OneToOne 1 100 0.00 255.0 ECU_ADDRESS 0xD0008D81 /end MEASUREMENT
/begin MEASUREMENT DFES_FrzFrVal64 "freeze frame Daten aller Fehlerspeichereinträge" UBYTE DFES_OneToOne 1 100 0.00 255.0 ECU_ADDRESS 0xD0008D82 /end MEASUREMENT
/begin MEASUREMENT DFES_FrzFrVal65 "freeze frame Daten aller Fehlerspeichereinträge" UBYTE DFES_OneToOne 1 100 0.00 255.0 ECU_ADDRESS 0xD0008D83 /end MEASUREMENT
/begin MEASUREMENT DFES_FrzFrVal66 "freeze frame Daten aller Fehlerspeichereinträge" UBYTE DFES_OneToOne 1 100 0.00 255.0 ECU_ADDRESS 0xD0008D84 /end MEASUREMENT
/begin MEASUREMENT DFES_FrzFrVal67 "freeze frame Daten aller Fehlerspeichereinträge" UBYTE DFES_OneToOne 1 100 0.00 255.0 ECU_ADDRESS 0xD0008D85 /end MEASUREMENT
/begin MEASUREMENT DFES_FrzFrVal68 "freeze frame Daten aller Fehlerspeichereinträge" UBYTE DFES_OneToOne 1 100 0.00 255.0 ECU_ADDRESS 0xD0008D86 /end MEASUREMENT
/begin MEASUREMENT DFES_FrzFrVal69 "freeze frame Daten aller Fehlerspeichereinträge" UBYTE DFES_OneToOne 1 100 0.00 255.0 ECU_ADDRESS 0xD0008D87 /end MEASUREMENT
/begin MEASUREMENT DFES_FrzFrVal70 "freeze frame Daten aller Fehlerspeichereinträge" UBYTE DFES_OneToOne 1 100 0.00 255.0 ECU_ADDRESS 0xD0008D88 /end MEASUREMENT
/begin MEASUREMENT DFES_FrzFrVal71 "freeze frame Daten aller Fehlerspeichereinträge" UBYTE DFES_OneToOne 1 100 0.00 255.0 ECU_ADDRESS 0xD0008D89 /end MEASUREMENT
/begin MEASUREMENT DFES_FrzFrVal72 "freeze frame Daten aller Fehlerspeichereinträge" UBYTE DFES_OneToOne 1 100 0.00 255.0 ECU_ADDRESS 0xD0008D8A /end MEASUREMENT
/begin MEASUREMENT DFES_FrzFrVal73 "freeze frame Daten aller Fehlerspeichereinträge" UBYTE DFES_OneToOne 1 100 0.00 255.0 ECU_ADDRESS 0xD0008D8B /end MEASUREMENT
/begin MEASUREMENT DFES_FrzFrVal74 "freeze frame Daten aller Fehlerspeichereinträge" UBYTE DFES_OneToOne 1 100 0.00 255.0 ECU_ADDRESS 0xD0008D8C /end MEASUREMENT
/begin MEASUREMENT DFES_FrzFrVal75 "freeze frame Daten aller Fehlerspeichereinträge" UBYTE DFES_OneToOne 1 100 0.00 255.0 ECU_ADDRESS 0xD0008D8D /end MEASUREMENT
/begin MEASUREMENT DFES_FrzFrVal76 "freeze frame Daten aller Fehlerspeichereinträge" UBYTE DFES_OneToOne 1 100 0.00 255.0 ECU_ADDRESS 0xD0008D8E /end MEASUREMENT
/begin MEASUREMENT DFES_FrzFrVal77 "freeze frame Daten aller Fehlerspeichereinträge" UBYTE DFES_OneToOne 1 100 0.00 255.0 ECU_ADDRESS 0xD0008D8F /end MEASUREMENT
/begin MEASUREMENT DFES_FrzFrVal78 "freeze frame Daten aller Fehlerspeichereinträge" UBYTE DFES_OneToOne 1 100 0.00 255.0 ECU_ADDRESS 0xD0008D90 /end MEASUREMENT
/begin MEASUREMENT DFES_FrzFrVal79 "freeze frame Daten aller Fehlerspeichereinträge" UBYTE DFES_OneToOne 1 100 0.00 255.0 ECU_ADDRESS 0xD0008D91 /end MEASUREMENT
/begin MEASUREMENT DFES_FrzFrVal80 "freeze frame Daten aller Fehlerspeichereinträge" UBYTE DFES_OneToOne 1 100 0.00 255.0 ECU_ADDRESS 0xD0008D92 /end MEASUREMENT
/begin MEASUREMENT DFES_FrzFrVal81 "freeze frame Daten aller Fehlerspeichereinträge" UBYTE DFES_OneToOne 1 100 0.00 255.0 ECU_ADDRESS 0xD0008D93 /end MEASUREMENT
/begin MEASUREMENT DFES_FrzFrVal82 "freeze frame Daten aller Fehlerspeichereinträge" UBYTE DFES_OneToOne 1 100 0.00 255.0 ECU_ADDRESS 0xD0008D94 /end MEASUREMENT
/begin MEASUREMENT DFES_FrzFrVal83 "freeze frame Daten aller Fehlerspeichereinträge" UBYTE DFES_OneToOne 1 100 0.00 255.0 ECU_ADDRESS 0xD0008D95 /end MEASUREMENT
/begin MEASUREMENT DFES_FrzFrVal84 "freeze frame Daten aller Fehlerspeichereinträge" UBYTE DFES_OneToOne 1 100 0.00 255.0 ECU_ADDRESS 0xD0008D96 /end MEASUREMENT
/begin MEASUREMENT DFES_FrzFrVal85 "freeze frame Daten aller Fehlerspeichereinträge" UBYTE DFES_OneToOne 1 100 0.00 255.0 ECU_ADDRESS 0xD0008D97 /end MEASUREMENT
/begin MEASUREMENT DFES_FrzFrVal86 "freeze frame Daten aller Fehlerspeichereinträge" UBYTE DFES_OneToOne 1 100 0.00 255.0 ECU_ADDRESS 0xD0008D98 /end MEASUREMENT
/begin MEASUREMENT DFES_FrzFrVal87 "freeze frame Daten aller Fehlerspeichereinträge" UBYTE DFES_OneToOne 1 100 0.00 255.0 ECU_ADDRESS 0xD0008D99 /end MEASUREMENT
/begin MEASUREMENT DFES_FrzFrVal88 "freeze frame Daten aller Fehlerspeichereinträge" UBYTE DFES_OneToOne 1 100 0.00 255.0 ECU_ADDRESS 0xD0008D9A /end MEASUREMENT
/begin MEASUREMENT DFES_FrzFrVal89 "freeze frame Daten aller Fehlerspeichereinträge" UBYTE DFES_OneToOne 1 100 0.00 255.0 ECU_ADDRESS 0xD0008D9B /end MEASUREMENT
/begin MEASUREMENT DFES_FrzFrVal90 "freeze frame Daten aller Fehlerspeichereinträge" UBYTE DFES_OneToOne 1 100 0.00 255.0 ECU_ADDRESS 0xD0008D9C /end MEASUREMENT
/begin MEASUREMENT DFES_FrzFrVal91 "freeze frame Daten aller Fehlerspeichereinträge" UBYTE DFES_OneToOne 1 100 0.00 255.0 ECU_ADDRESS 0xD0008D9D /end MEASUREMENT
/begin MEASUREMENT DFES_FrzFrVal92 "freeze frame Daten aller Fehlerspeichereinträge" UBYTE DFES_OneToOne 1 100 0.00 255.0 ECU_ADDRESS 0xD0008D9E /end MEASUREMENT
/begin MEASUREMENT DFES_FrzFrVal93 "freeze frame Daten aller Fehlerspeichereinträge" UBYTE DFES_OneToOne 1 100 0.00 255.0 ECU_ADDRESS 0xD0008D9F /end MEASUREMENT
/begin MEASUREMENT DFES_FrzFrVal94 "freeze frame Daten aller Fehlerspeichereinträge" UBYTE DFES_OneToOne 1 100 0.00 255.0 ECU_ADDRESS 0xD0008DA0 /end MEASUREMENT
/begin MEASUREMENT DFES_FrzFrVal95 "freeze frame Daten aller Fehlerspeichereinträge" UBYTE DFES_OneToOne 1 100 0.00 255.0 ECU_ADDRESS 0xD0008DA1 /end MEASUREMENT
/begin MEASUREMENT DFES_FrzFrVal96 "freeze frame Daten aller Fehlerspeichereinträge" UBYTE DFES_OneToOne 1 100 0.00 255.0 ECU_ADDRESS 0xD0008DA2 /end MEASUREMENT
/begin MEASUREMENT DFES_FrzFrVal97 "freeze frame Daten aller Fehlerspeichereinträge" UBYTE DFES_OneToOne 1 100 0.00 255.0 ECU_ADDRESS 0xD0008DA3 /end MEASUREMENT
/begin MEASUREMENT DFES_FrzFrVal98 "freeze frame Daten aller Fehlerspeichereinträge" UBYTE DFES_OneToOne 1 100 0.00 255.0 ECU_ADDRESS 0xD0008DA4 /end MEASUREMENT
/begin MEASUREMENT DFES_FrzFrVal99 "freeze frame Daten aller Fehlerspeichereinträge" UBYTE DFES_OneToOne 1 100 0.00 255.0 ECU_ADDRESS 0xD0008DA5 /end MEASUREMENT
/begin MEASUREMENT DFES_FrzFrVal100 "freeze frame Daten aller Fehlerspeichereinträge" UBYTE DFES_OneToOne 1 100 0.00 255.0 ECU_ADDRESS 0xD0008DA6 /end MEASUREMENT
/begin MEASUREMENT DFES_FrzFrVal101 "freeze frame Daten aller Fehlerspeichereinträge" UBYTE DFES_OneToOne 1 100 0.00 255.0 ECU_ADDRESS 0xD0008DA7 /end MEASUREMENT
/begin MEASUREMENT DFES_FrzFrVal102 "freeze frame Daten aller Fehlerspeichereinträge" UBYTE DFES_OneToOne 1 100 0.00 255.0 ECU_ADDRESS 0xD0008DA8 /end MEASUREMENT
/begin MEASUREMENT DFES_FrzFrVal103 "freeze frame Daten aller Fehlerspeichereinträge" UBYTE DFES_OneToOne 1 100 0.00 255.0 ECU_ADDRESS 0xD0008DA9 /end MEASUREMENT
/begin MEASUREMENT DFES_FrzFrVal104 "freeze frame Daten aller Fehlerspeichereinträge" UBYTE DFES_OneToOne 1 100 0.00 255.0 ECU_ADDRESS 0xD0008DAA /end MEASUREMENT
/begin MEASUREMENT DFES_FrzFrVal105 "freeze frame Daten aller Fehlerspeichereinträge" UBYTE DFES_OneToOne 1 100 0.00 255.0 ECU_ADDRESS 0xD0008DAB /end MEASUREMENT
/begin MEASUREMENT DFES_FrzFrVal106 "freeze frame Daten aller Fehlerspeichereinträge" UBYTE DFES_OneToOne 1 100 0.00 255.0 ECU_ADDRESS 0xD0008DAC /end MEASUREMENT
/begin MEASUREMENT DFES_FrzFrVal107 "freeze frame Daten aller Fehlerspeichereinträge" UBYTE DFES_OneToOne 1 100 0.00 255.0 ECU_ADDRESS 0xD0008DAD /end MEASUREMENT
/begin MEASUREMENT DFES_FrzFrVal108 "freeze frame Daten aller Fehlerspeichereinträge" UBYTE DFES_OneToOne 1 100 0.00 255.0 ECU_ADDRESS 0xD0008DAE /end MEASUREMENT
/begin MEASUREMENT DFES_FrzFrVal109 "freeze frame Daten aller Fehlerspeichereinträge" UBYTE DFES_OneToOne 1 100 0.00 255.0 ECU_ADDRESS 0xD0008DAF /end MEASUREMENT
/begin MEASUREMENT DFES_FrzFrVal110 "freeze frame Daten aller Fehlerspeichereinträge" UBYTE DFES_OneToOne 1 100 0.00 255.0 ECU_ADDRESS 0xD0008DB0 /end MEASUREMENT
/begin MEASUREMENT DFES_FrzFrVal111 "freeze frame Daten aller Fehlerspeichereinträge" UBYTE DFES_OneToOne 1 100 0.00 255.0 ECU_ADDRESS 0xD0008DB1 /end MEASUREMENT
/begin MEASUREMENT DFES_FrzFrVal112 "freeze frame Daten aller Fehlerspeichereinträge" UBYTE DFES_OneToOne 1 100 0.00 255.0 ECU_ADDRESS 0xD0008DB2 /end MEASUREMENT
/begin MEASUREMENT DFES_FrzFrVal113 "freeze frame Daten aller Fehlerspeichereinträge" UBYTE DFES_OneToOne 1 100 0.00 255.0 ECU_ADDRESS 0xD0008DB3 /end MEASUREMENT
/begin MEASUREMENT DFES_FrzFrVal114 "freeze frame Daten aller Fehlerspeichereinträge" UBYTE DFES_OneToOne 1 100 0.00 255.0 ECU_ADDRESS 0xD0008DB4 /end MEASUREMENT
/begin MEASUREMENT DFES_FrzFrVal115 "freeze frame Daten aller Fehlerspeichereinträge" UBYTE DFES_OneToOne 1 100 0.00 255.0 ECU_ADDRESS 0xD0008DB5 /end MEASUREMENT
/begin MEASUREMENT DFES_FrzFrVal116 "freeze frame Daten aller Fehlerspeichereinträge" UBYTE DFES_OneToOne 1 100 0.00 255.0 ECU_ADDRESS 0xD0008DB6 /end MEASUREMENT
/begin MEASUREMENT DFES_FrzFrVal117 "freeze frame Daten aller Fehlerspeichereinträge" UBYTE DFES_OneToOne 1 100 0.00 255.0 ECU_ADDRESS 0xD0008DB7 /end MEASUREMENT
/begin MEASUREMENT DFES_FrzFrVal118 "freeze frame Daten aller Fehlerspeichereinträge" UBYTE DFES_OneToOne 1 100 0.00 255.0 ECU_ADDRESS 0xD0008DB8 /end MEASUREMENT
/begin MEASUREMENT DFES_FrzFrVal119 "freeze frame Daten aller Fehlerspeichereinträge" UBYTE DFES_OneToOne 1 100 0.00 255.0 ECU_ADDRESS 0xD0008DB9 /end MEASUREMENT
/begin MEASUREMENT DFES_FrzFrVal120 "freeze frame Daten aller Fehlerspeichereinträge" UBYTE DFES_OneToOne 1 100 0.00 255.0 ECU_ADDRESS 0xD0008DBA /end MEASUREMENT
/begin MEASUREMENT DFES_FrzFrVal121 "freeze frame Daten aller Fehlerspeichereinträge" UBYTE DFES_OneToOne 1 100 0.00 255.0 ECU_ADDRESS 0xD0008DBB /end MEASUREMENT
/begin MEASUREMENT DFES_FrzFrVal122 "freeze frame Daten aller Fehlerspeichereinträge" UBYTE DFES_OneToOne 1 100 0.00 255.0 ECU_ADDRESS 0xD0008DBC /end MEASUREMENT
/begin MEASUREMENT DFES_FrzFrVal123 "freeze frame Daten aller Fehlerspeichereinträge" UBYTE DFES_OneToOne 1 100 0.00 255.0 ECU_ADDRESS 0xD0008DBD /end MEASUREMENT
/begin MEASUREMENT DFES_FrzFrVal124 "freeze frame Daten aller Fehlerspeichereinträge" UBYTE DFES_OneToOne 1 100 0.00 255.0 ECU_ADDRESS 0xD0008DBE /end MEASUREMENT
/begin MEASUREMENT DFES_FrzFrVal125 "freeze frame Daten aller Fehlerspeichereinträge" UBYTE DFES_OneToOne 1 100 0.00 255.0 ECU_ADDRESS 0xD0008DBF /end MEASUREMENT
/begin MEASUREMENT DFES_FrzFrVal126 "freeze frame Daten aller Fehlerspeichereinträge" UBYTE DFES_OneToOne 1 100 0.00 255.0 ECU_ADDRESS 0xD0008DC0 /end MEASUREMENT
/begin MEASUREMENT DFES_FrzFrVal127 "freeze frame Daten aller Fehlerspeichereinträge" UBYTE DFES_OneToOne 1 100 0.00 255.0 ECU_ADDRESS 0xD0008DC1 /end MEASUREMENT
/begin MEASUREMENT DFES_FrzFrVal128 "freeze frame Daten aller Fehlerspeichereinträge" UBYTE DFES_OneToOne 1 100 0.00 255.0 ECU_ADDRESS 0xD0008DC2 /end MEASUREMENT
/begin MEASUREMENT DFES_FrzFrVal129 "freeze frame Daten aller Fehlerspeichereinträge" UBYTE DFES_OneToOne 1 100 0.00 255.0 ECU_ADDRESS 0xD0008DC3 /end MEASUREMENT
/begin MEASUREMENT DFES_FrzFrVal130 "freeze frame Daten aller Fehlerspeichereinträge" UBYTE DFES_OneToOne 1 100 0.00 255.0 ECU_ADDRESS 0xD0008DC4 /end MEASUREMENT
/begin MEASUREMENT DFES_FrzFrVal131 "freeze frame Daten aller Fehlerspeichereinträge" UBYTE DFES_OneToOne 1 100 0.00 255.0 ECU_ADDRESS 0xD0008DC5 /end MEASUREMENT
/begin MEASUREMENT DFES_FrzFrVal132 "freeze frame Daten aller Fehlerspeichereinträge" UBYTE DFES_OneToOne 1 100 0.00 255.0 ECU_ADDRESS 0xD0008DC6 /end MEASUREMENT
/begin MEASUREMENT DFES_FrzFrVal133 "freeze frame Daten aller Fehlerspeichereinträge" UBYTE DFES_OneToOne 1 100 0.00 255.0 ECU_ADDRESS 0xD0008DC7 /end MEASUREMENT
/begin MEASUREMENT DFES_FrzFrVal134 "freeze frame Daten aller Fehlerspeichereinträge" UBYTE DFES_OneToOne 1 100 0.00 255.0 ECU_ADDRESS 0xD0008DC8 /end MEASUREMENT
/begin MEASUREMENT DFES_FrzFrVal135 "freeze frame Daten aller Fehlerspeichereinträge" UBYTE DFES_OneToOne 1 100 0.00 255.0 ECU_ADDRESS 0xD0008DC9 /end MEASUREMENT
/begin MEASUREMENT DFES_FrzFrVal136 "freeze frame Daten aller Fehlerspeichereinträge" UBYTE DFES_OneToOne 1 100 0.00 255.0 ECU_ADDRESS 0xD0008DCA /end MEASUREMENT
/begin MEASUREMENT DFES_FrzFrVal137 "freeze frame Daten aller Fehlerspeichereinträge" UBYTE DFES_OneToOne 1 100 0.00 255.0 ECU_ADDRESS 0xD0008DCB /end MEASUREMENT
/begin MEASUREMENT DFES_FrzFrVal138 "freeze frame Daten aller Fehlerspeichereinträge" UBYTE DFES_OneToOne 1 100 0.00 255.0 ECU_ADDRESS 0xD0008DCC /end MEASUREMENT
/begin MEASUREMENT DFES_FrzFrVal139 "freeze frame Daten aller Fehlerspeichereinträge" UBYTE DFES_OneToOne 1 100 0.00 255.0 ECU_ADDRESS 0xD0008DCD /end MEASUREMENT
/begin MEASUREMENT DFES_FrzFrVal140 "freeze frame Daten aller Fehlerspeichereinträge" UBYTE DFES_OneToOne 1 100 0.00 255.0 ECU_ADDRESS 0xD0008DCE /end MEASUREMENT
/begin MEASUREMENT DFES_FrzFrVal141 "freeze frame Daten aller Fehlerspeichereinträge" UBYTE DFES_OneToOne 1 100 0.00 255.0 ECU_ADDRESS 0xD0008DCF /end MEASUREMENT
/begin MEASUREMENT DFES_FrzFrVal142 "freeze frame Daten aller Fehlerspeichereinträge" UBYTE DFES_OneToOne 1 100 0.00 255.0 ECU_ADDRESS 0xD0008DD0 /end MEASUREMENT
/begin MEASUREMENT DFES_FrzFrVal143 "freeze frame Daten aller Fehlerspeichereinträge" UBYTE DFES_OneToOne 1 100 0.00 255.0 ECU_ADDRESS 0xD0008DD1 /end MEASUREMENT
/begin MEASUREMENT DFES_FrzFrVal144 "freeze frame Daten aller Fehlerspeichereinträge" UBYTE DFES_OneToOne 1 100 0.00 255.0 ECU_ADDRESS 0xD0008DD2 /end MEASUREMENT
/begin MEASUREMENT DFES_FrzFrVal145 "freeze frame Daten aller Fehlerspeichereinträge" UBYTE DFES_OneToOne 1 100 0.00 255.0 ECU_ADDRESS 0xD0008DD3 /end MEASUREMENT
/begin MEASUREMENT DFES_FrzFrVal146 "freeze frame Daten aller Fehlerspeichereinträge" UBYTE DFES_OneToOne 1 100 0.00 255.0 ECU_ADDRESS 0xD0008DD4 /end MEASUREMENT
/begin MEASUREMENT DFES_FrzFrVal147 "freeze frame Daten aller Fehlerspeichereinträge" UBYTE DFES_OneToOne 1 100 0.00 255.0 ECU_ADDRESS 0xD0008DD5 /end MEASUREMENT
/begin MEASUREMENT DFES_FrzFrVal148 "freeze frame Daten aller Fehlerspeichereinträge" UBYTE DFES_OneToOne 1 100 0.00 255.0 ECU_ADDRESS 0xD0008DD6 /end MEASUREMENT
/begin MEASUREMENT DFES_FrzFrVal149 "freeze frame Daten aller Fehlerspeichereinträge" UBYTE DFES_OneToOne 1 100 0.00 255.0 ECU_ADDRESS 0xD0008DD7 /end MEASUREMENT
/begin MEASUREMENT DFES_FrzFrVal150 "freeze frame Daten aller Fehlerspeichereinträge" UBYTE DFES_OneToOne 1 100 0.00 255.0 ECU_ADDRESS 0xD0008DD8 /end MEASUREMENT
/begin MEASUREMENT DFES_FrzFrVal151 "freeze frame Daten aller Fehlerspeichereinträge" UBYTE DFES_OneToOne 1 100 0.00 255.0 ECU_ADDRESS 0xD0008DD9 /end MEASUREMENT
/begin MEASUREMENT DFES_FrzFrVal152 "freeze frame Daten aller Fehlerspeichereinträge" UBYTE DFES_OneToOne 1 100 0.00 255.0 ECU_ADDRESS 0xD0008DDA /end MEASUREMENT
/begin MEASUREMENT DFES_FrzFrVal153 "freeze frame Daten aller Fehlerspeichereinträge" UBYTE DFES_OneToOne 1 100 0.00 255.0 ECU_ADDRESS 0xD0008DDB /end MEASUREMENT
/begin MEASUREMENT DFES_FrzFrVal154 "freeze frame Daten aller Fehlerspeichereinträge" UBYTE DFES_OneToOne 1 100 0.00 255.0 ECU_ADDRESS 0xD0008DDC /end MEASUREMENT
/begin MEASUREMENT DFES_FrzFrVal155 "freeze frame Daten aller Fehlerspeichereinträge" UBYTE DFES_OneToOne 1 100 0.00 255.0 ECU_ADDRESS 0xD0008DDD /end MEASUREMENT
/begin MEASUREMENT DFES_FrzFrVal156 "freeze frame Daten aller Fehlerspeichereinträge" UBYTE DFES_OneToOne 1 100 0.00 255.0 ECU_ADDRESS 0xD0008DDE /end MEASUREMENT
/begin MEASUREMENT DFES_FrzFrVal157 "freeze frame Daten aller Fehlerspeichereinträge" UBYTE DFES_OneToOne 1 100 0.00 255.0 ECU_ADDRESS 0xD0008DDF /end MEASUREMENT
/begin MEASUREMENT DFES_FrzFrVal158 "freeze frame Daten aller Fehlerspeichereinträge" UBYTE DFES_OneToOne 1 100 0.00 255.0 ECU_ADDRESS 0xD0008DE0 /end MEASUREMENT
/begin MEASUREMENT DFES_FrzFrVal159 "freeze frame Daten aller Fehlerspeichereinträge" UBYTE DFES_OneToOne 1 100 0.00 255.0 ECU_ADDRESS 0xD0008DE1 /end MEASUREMENT
/begin MEASUREMENT DFES_FrzFrVal160 "freeze frame Daten aller Fehlerspeichereinträge" UBYTE DFES_OneToOne 1 100 0.00 255.0 ECU_ADDRESS 0xD0008DE2 /end MEASUREMENT
/begin MEASUREMENT DFES_FrzFrVal161 "freeze frame Daten aller Fehlerspeichereinträge" UBYTE DFES_OneToOne 1 100 0.00 255.0 ECU_ADDRESS 0xD0008DE3 /end MEASUREMENT
/begin MEASUREMENT DFES_FrzFrVal162 "freeze frame Daten aller Fehlerspeichereinträge" UBYTE DFES_OneToOne 1 100 0.00 255.0 ECU_ADDRESS 0xD0008DE4 /end MEASUREMENT
/begin MEASUREMENT DFES_FrzFrVal163 "freeze frame Daten aller Fehlerspeichereinträge" UBYTE DFES_OneToOne 1 100 0.00 255.0 ECU_ADDRESS 0xD0008DE5 /end MEASUREMENT
/begin MEASUREMENT DFES_FrzFrVal164 "freeze frame Daten aller Fehlerspeichereinträge" UBYTE DFES_OneToOne 1 100 0.00 255.0 ECU_ADDRESS 0xD0008DE6 /end MEASUREMENT
/begin MEASUREMENT DFES_FrzFrVal165 "freeze frame Daten aller Fehlerspeichereinträge" UBYTE DFES_OneToOne 1 100 0.00 255.0 ECU_ADDRESS 0xD0008DE7 /end MEASUREMENT
/begin MEASUREMENT DFES_FrzFrVal166 "freeze frame Daten aller Fehlerspeichereinträge" UBYTE DFES_OneToOne 1 100 0.00 255.0 ECU_ADDRESS 0xD0008DE8 /end MEASUREMENT
/begin MEASUREMENT DFES_FrzFrVal167 "freeze frame Daten aller Fehlerspeichereinträge" UBYTE DFES_OneToOne 1 100 0.00 255.0 ECU_ADDRESS 0xD0008DE9 /end MEASUREMENT
/begin MEASUREMENT DFES_FrzFrVal168 "freeze frame Daten aller Fehlerspeichereinträge" UBYTE DFES_OneToOne 1 100 0.00 255.0 ECU_ADDRESS 0xD0008DEA /end MEASUREMENT
/begin MEASUREMENT DFES_FrzFrVal169 "freeze frame Daten aller Fehlerspeichereinträge" UBYTE DFES_OneToOne 1 100 0.00 255.0 ECU_ADDRESS 0xD0008DEB /end MEASUREMENT
/begin MEASUREMENT DFES_FrzFrVal170 "freeze frame Daten aller Fehlerspeichereinträge" UBYTE DFES_OneToOne 1 100 0.00 255.0 ECU_ADDRESS 0xD0008DEC /end MEASUREMENT
/begin MEASUREMENT DFES_FrzFrVal171 "freeze frame Daten aller Fehlerspeichereinträge" UBYTE DFES_OneToOne 1 100 0.00 255.0 ECU_ADDRESS 0xD0008DED /end MEASUREMENT
/begin MEASUREMENT DFES_FrzFrVal172 "freeze frame Daten aller Fehlerspeichereinträge" UBYTE DFES_OneToOne 1 100 0.00 255.0 ECU_ADDRESS 0xD0008DEE /end MEASUREMENT
/begin MEASUREMENT DFES_FrzFrVal173 "freeze frame Daten aller Fehlerspeichereinträge" UBYTE DFES_OneToOne 1 100 0.00 255.0 ECU_ADDRESS 0xD0008DEF /end MEASUREMENT
/begin MEASUREMENT DFES_FrzFrVal174 "freeze frame Daten aller Fehlerspeichereinträge" UBYTE DFES_OneToOne 1 100 0.00 255.0 ECU_ADDRESS 0xD0008DF0 /end MEASUREMENT
/begin MEASUREMENT DFES_FrzFrVal175 "freeze frame Daten aller Fehlerspeichereinträge" UBYTE DFES_OneToOne 1 100 0.00 255.0 ECU_ADDRESS 0xD0008DF1 /end MEASUREMENT
/begin MEASUREMENT DFES_FrzFrVal176 "freeze frame Daten aller Fehlerspeichereinträge" UBYTE DFES_OneToOne 1 100 0.00 255.0 ECU_ADDRESS 0xD0008DF2 /end MEASUREMENT
/begin MEASUREMENT DFES_FrzFrVal177 "freeze frame Daten aller Fehlerspeichereinträge" UBYTE DFES_OneToOne 1 100 0.00 255.0 ECU_ADDRESS 0xD0008DF3 /end MEASUREMENT
/begin MEASUREMENT DFES_FrzFrVal178 "freeze frame Daten aller Fehlerspeichereinträge" UBYTE DFES_OneToOne 1 100 0.00 255.0 ECU_ADDRESS 0xD0008DF4 /end MEASUREMENT
/begin MEASUREMENT DFES_FrzFrVal179 "freeze frame Daten aller Fehlerspeichereinträge" UBYTE DFES_OneToOne 1 100 0.00 255.0 ECU_ADDRESS 0xD0008DF5 /end MEASUREMENT
/begin MEASUREMENT DFES_FrzFrVal180 "freeze frame Daten aller Fehlerspeichereinträge" UBYTE DFES_OneToOne 1 100 0.00 255.0 ECU_ADDRESS 0xD0008DF6 /end MEASUREMENT
/begin MEASUREMENT DFES_FrzFrVal181 "freeze frame Daten aller Fehlerspeichereinträge" UBYTE DFES_OneToOne 1 100 0.00 255.0 ECU_ADDRESS 0xD0008DF7 /end MEASUREMENT
/begin MEASUREMENT DFES_FrzFrVal182 "freeze frame Daten aller Fehlerspeichereinträge" UBYTE DFES_OneToOne 1 100 0.00 255.0 ECU_ADDRESS 0xD0008DF8 /end MEASUREMENT
/begin MEASUREMENT DFES_FrzFrVal183 "freeze frame Daten aller Fehlerspeichereinträge" UBYTE DFES_OneToOne 1 100 0.00 255.0 ECU_ADDRESS 0xD0008DF9 /end MEASUREMENT
/begin MEASUREMENT DFES_FrzFrVal184 "freeze frame Daten aller Fehlerspeichereinträge" UBYTE DFES_OneToOne 1 100 0.00 255.0 ECU_ADDRESS 0xD0008DFA /end MEASUREMENT
/begin MEASUREMENT DFES_FrzFrVal185 "freeze frame Daten aller Fehlerspeichereinträge" UBYTE DFES_OneToOne 1 100 0.00 255.0 ECU_ADDRESS 0xD0008DFB /end MEASUREMENT
/begin MEASUREMENT DFES_FrzFrVal186 "freeze frame Daten aller Fehlerspeichereinträge" UBYTE DFES_OneToOne 1 100 0.00 255.0 ECU_ADDRESS 0xD0008DFC /end MEASUREMENT
/begin MEASUREMENT DFES_FrzFrVal187 "freeze frame Daten aller Fehlerspeichereinträge" UBYTE DFES_OneToOne 1 100 0.00 255.0 ECU_ADDRESS 0xD0008DFD /end MEASUREMENT
/begin MEASUREMENT DFES_FrzFrVal188 "freeze frame Daten aller Fehlerspeichereinträge" UBYTE DFES_OneToOne 1 100 0.00 255.0 ECU_ADDRESS 0xD0008DFE /end MEASUREMENT
/begin MEASUREMENT DFES_FrzFrVal189 "freeze frame Daten aller Fehlerspeichereinträge" UBYTE DFES_OneToOne 1 100 0.00 255.0 ECU_ADDRESS 0xD0008DFF /end MEASUREMENT
/begin MEASUREMENT DFES_FrzFrVal190 "freeze frame Daten aller Fehlerspeichereinträge" UBYTE DFES_OneToOne 1 100 0.00 255.0 ECU_ADDRESS 0xD0008E00 /end MEASUREMENT
/begin MEASUREMENT DFES_FrzFrVal191 "freeze frame Daten aller Fehlerspeichereinträge" UBYTE DFES_OneToOne 1 100 0.00 255.0 ECU_ADDRESS 0xD0008E01 /end MEASUREMENT
/begin MEASUREMENT DFES_FrzFrVal192 "freeze frame Daten aller Fehlerspeichereinträge" UBYTE DFES_OneToOne 1 100 0.00 255.0 ECU_ADDRESS 0xD0008E02 /end MEASUREMENT
/begin MEASUREMENT DFES_FrzFrVal193 "freeze frame Daten aller Fehlerspeichereinträge" UBYTE DFES_OneToOne 1 100 0.00 255.0 ECU_ADDRESS 0xD0008E03 /end MEASUREMENT
/begin MEASUREMENT DFES_FrzFrVal194 "freeze frame Daten aller Fehlerspeichereinträge" UBYTE DFES_OneToOne 1 100 0.00 255.0 ECU_ADDRESS 0xD0008E04 /end MEASUREMENT
/begin MEASUREMENT DFES_FrzFrVal195 "freeze frame Daten aller Fehlerspeichereinträge" UBYTE DFES_OneToOne 1 100 0.00 255.0 ECU_ADDRESS 0xD0008E05 /end MEASUREMENT
/begin MEASUREMENT DFES_FrzFrVal196 "freeze frame Daten aller Fehlerspeichereinträge" UBYTE DFES_OneToOne 1 100 0.00 255.0 ECU_ADDRESS 0xD0008E06 /end MEASUREMENT
/begin MEASUREMENT DFES_FrzFrVal197 "freeze frame Daten aller Fehlerspeichereinträge" UBYTE DFES_OneToOne 1 100 0.00 255.0 ECU_ADDRESS 0xD0008E07 /end MEASUREMENT
/begin MEASUREMENT DFES_FrzFrVal198 "freeze frame Daten aller Fehlerspeichereinträge" UBYTE DFES_OneToOne 1 100 0.00 255.0 ECU_ADDRESS 0xD0008E08 /end MEASUREMENT
/begin MEASUREMENT DFES_FrzFrVal199 "freeze frame Daten aller Fehlerspeichereinträge" UBYTE DFES_OneToOne 1 100 0.00 255.0 ECU_ADDRESS 0xD0008E09 /end MEASUREMENT
/begin MEASUREMENT DFES_FrzFrVal200 "freeze frame Daten aller Fehlerspeichereinträge" UBYTE DFES_OneToOne 1 100 0.00 255.0 ECU_ADDRESS 0xD0008E0A /end MEASUREMENT
/begin MEASUREMENT DFES_FrzFrVal201 "freeze frame Daten aller Fehlerspeichereinträge" UBYTE DFES_OneToOne 1 100 0.00 255.0 ECU_ADDRESS 0xD0008E0B /end MEASUREMENT
/begin MEASUREMENT DFES_FrzFrVal202 "freeze frame Daten aller Fehlerspeichereinträge" UBYTE DFES_OneToOne 1 100 0.00 255.0 ECU_ADDRESS 0xD0008E0C /end MEASUREMENT
/begin MEASUREMENT DFES_FrzFrVal203 "freeze frame Daten aller Fehlerspeichereinträge" UBYTE DFES_OneToOne 1 100 0.00 255.0 ECU_ADDRESS 0xD0008E0D /end MEASUREMENT
/begin MEASUREMENT DFES_FrzFrVal204 "freeze frame Daten aller Fehlerspeichereinträge" UBYTE DFES_OneToOne 1 100 0.00 255.0 ECU_ADDRESS 0xD0008E0E /end MEASUREMENT
/begin MEASUREMENT DFES_FrzFrVal205 "freeze frame Daten aller Fehlerspeichereinträge" UBYTE DFES_OneToOne 1 100 0.00 255.0 ECU_ADDRESS 0xD0008E0F /end MEASUREMENT
/begin MEASUREMENT DFES_FrzFrVal206 "freeze frame Daten aller Fehlerspeichereinträge" UBYTE DFES_OneToOne 1 100 0.00 255.0 ECU_ADDRESS 0xD0008E10 /end MEASUREMENT
/begin MEASUREMENT DFES_FrzFrVal207 "freeze frame Daten aller Fehlerspeichereinträge" UBYTE DFES_OneToOne 1 100 0.00 255.0 ECU_ADDRESS 0xD0008E11 /end MEASUREMENT
/begin MEASUREMENT DFES_FrzFrVal208 "freeze frame Daten aller Fehlerspeichereinträge" UBYTE DFES_OneToOne 1 100 0.00 255.0 ECU_ADDRESS 0xD0008E12 /end MEASUREMENT
/begin MEASUREMENT DFES_FrzFrVal209 "freeze frame Daten aller Fehlerspeichereinträge" UBYTE DFES_OneToOne 1 100 0.00 255.0 ECU_ADDRESS 0xD0008E13 /end MEASUREMENT
/begin MEASUREMENT DFES_FrzFrVal210 "freeze frame Daten aller Fehlerspeichereinträge" UBYTE DFES_OneToOne 1 100 0.00 255.0 ECU_ADDRESS 0xD0008E14 /end MEASUREMENT
/begin MEASUREMENT DFES_FrzFrVal211 "freeze frame Daten aller Fehlerspeichereinträge" UBYTE DFES_OneToOne 1 100 0.00 255.0 ECU_ADDRESS 0xD0008E15 /end MEASUREMENT
/begin MEASUREMENT DFES_FrzFrVal212 "freeze frame Daten aller Fehlerspeichereinträge" UBYTE DFES_OneToOne 1 100 0.00 255.0 ECU_ADDRESS 0xD0008E16 /end MEASUREMENT
/begin MEASUREMENT DFES_FrzFrVal213 "freeze frame Daten aller Fehlerspeichereinträge" UBYTE DFES_OneToOne 1 100 0.00 255.0 ECU_ADDRESS 0xD0008E17 /end MEASUREMENT
/begin MEASUREMENT DFES_FrzFrVal214 "freeze frame Daten aller Fehlerspeichereinträge" UBYTE DFES_OneToOne 1 100 0.00 255.0 ECU_ADDRESS 0xD0008E18 /end MEASUREMENT
/begin MEASUREMENT DFES_FrzFrVal215 "freeze frame Daten aller Fehlerspeichereinträge" UBYTE DFES_OneToOne 1 100 0.00 255.0 ECU_ADDRESS 0xD0008E19 /end MEASUREMENT
/begin MEASUREMENT DFES_FrzFrVal216 "freeze frame Daten aller Fehlerspeichereinträge" UBYTE DFES_OneToOne 1 100 0.00 255.0 ECU_ADDRESS 0xD0008E1A /end MEASUREMENT
/begin MEASUREMENT DFES_FrzFrVal217 "freeze frame Daten aller Fehlerspeichereinträge" UBYTE DFES_OneToOne 1 100 0.00 255.0 ECU_ADDRESS 0xD0008E1B /end MEASUREMENT
/begin MEASUREMENT DFES_FrzFrVal218 "freeze frame Daten aller Fehlerspeichereinträge" UBYTE DFES_OneToOne 1 100 0.00 255.0 ECU_ADDRESS 0xD0008E1C /end MEASUREMENT
/begin MEASUREMENT DFES_FrzFrVal219 "freeze frame Daten aller Fehlerspeichereinträge" UBYTE DFES_OneToOne 1 100 0.00 255.0 ECU_ADDRESS 0xD0008E1D /end MEASUREMENT
/begin MEASUREMENT DFES_FrzFrVal220 "freeze frame Daten aller Fehlerspeichereinträge" UBYTE DFES_OneToOne 1 100 0.00 255.0 ECU_ADDRESS 0xD0008E1E /end MEASUREMENT
/begin MEASUREMENT DFES_FrzFrVal221 "freeze frame Daten aller Fehlerspeichereinträge" UBYTE DFES_OneToOne 1 100 0.00 255.0 ECU_ADDRESS 0xD0008E1F /end MEASUREMENT
/begin MEASUREMENT DFES_FrzFrVal222 "freeze frame Daten aller Fehlerspeichereinträge" UBYTE DFES_OneToOne 1 100 0.00 255.0 ECU_ADDRESS 0xD0008E20 /end MEASUREMENT
/begin MEASUREMENT DFES_FrzFrVal223 "freeze frame Daten aller Fehlerspeichereinträge" UBYTE DFES_OneToOne 1 100 0.00 255.0 ECU_ADDRESS 0xD0008E21 /end MEASUREMENT
/begin MEASUREMENT DFES_FrzFrVal224 "freeze frame Daten aller Fehlerspeichereinträge" UBYTE DFES_OneToOne 1 100 0.00 255.0 ECU_ADDRESS 0xD0008E22 /end MEASUREMENT
/begin MEASUREMENT DFES_FrzFrVal225 "freeze frame Daten aller Fehlerspeichereinträge" UBYTE DFES_OneToOne 1 100 0.00 255.0 ECU_ADDRESS 0xD0008E23 /end MEASUREMENT
/begin MEASUREMENT DFES_FrzFrVal226 "freeze frame Daten aller Fehlerspeichereinträge" UBYTE DFES_OneToOne 1 100 0.00 255.0 ECU_ADDRESS 0xD0008E24 /end MEASUREMENT
/begin MEASUREMENT DFES_FrzFrVal227 "freeze frame Daten aller Fehlerspeichereinträge" UBYTE DFES_OneToOne 1 100 0.00 255.0 ECU_ADDRESS 0xD0008E25 /end MEASUREMENT
/begin MEASUREMENT DFES_FrzFrVal228 "freeze frame Daten aller Fehlerspeichereinträge" UBYTE DFES_OneToOne 1 100 0.00 255.0 ECU_ADDRESS 0xD0008E26 /end MEASUREMENT
/begin MEASUREMENT DFES_FrzFrVal229 "freeze frame Daten aller Fehlerspeichereinträge" UBYTE DFES_OneToOne 1 100 0.00 255.0 ECU_ADDRESS 0xD0008E27 /end MEASUREMENT
/begin MEASUREMENT DFES_FrzFrVal230 "freeze frame Daten aller Fehlerspeichereinträge" UBYTE DFES_OneToOne 1 100 0.00 255.0 ECU_ADDRESS 0xD0008E28 /end MEASUREMENT
/begin MEASUREMENT DFES_FrzFrVal231 "freeze frame Daten aller Fehlerspeichereinträge" UBYTE DFES_OneToOne 1 100 0.00 255.0 ECU_ADDRESS 0xD0008E29 /end MEASUREMENT
/begin MEASUREMENT DFES_FrzFrVal232 "freeze frame Daten aller Fehlerspeichereinträge" UBYTE DFES_OneToOne 1 100 0.00 255.0 ECU_ADDRESS 0xD0008E2A /end MEASUREMENT
/begin MEASUREMENT DFES_FrzFrVal233 "freeze frame Daten aller Fehlerspeichereinträge" UBYTE DFES_OneToOne 1 100 0.00 255.0 ECU_ADDRESS 0xD0008E2B /end MEASUREMENT
/begin MEASUREMENT DFES_FrzFrVal234 "freeze frame Daten aller Fehlerspeichereinträge" UBYTE DFES_OneToOne 1 100 0.00 255.0 ECU_ADDRESS 0xD0008E2C /end MEASUREMENT
/begin MEASUREMENT DFES_FrzFrVal235 "freeze frame Daten aller Fehlerspeichereinträge" UBYTE DFES_OneToOne 1 100 0.00 255.0 ECU_ADDRESS 0xD0008E2D /end MEASUREMENT
/begin MEASUREMENT DFES_FrzFrVal236 "freeze frame Daten aller Fehlerspeichereinträge" UBYTE DFES_OneToOne 1 100 0.00 255.0 ECU_ADDRESS 0xD0008E2E /end MEASUREMENT
/begin MEASUREMENT DFES_FrzFrVal237 "freeze frame Daten aller Fehlerspeichereinträge" UBYTE DFES_OneToOne 1 100 0.00 255.0 ECU_ADDRESS 0xD0008E2F /end MEASUREMENT
/begin MEASUREMENT DFES_FrzFrVal238 "freeze frame Daten aller Fehlerspeichereinträge" UBYTE DFES_OneToOne 1 100 0.00 255.0 ECU_ADDRESS 0xD0008E30 /end MEASUREMENT
/begin MEASUREMENT DFES_FrzFrVal239 "freeze frame Daten aller Fehlerspeichereinträge" UBYTE DFES_OneToOne 1 100 0.00 255.0 ECU_ADDRESS 0xD0008E31 /end MEASUREMENT
/begin MEASUREMENT DFES_FrzFrVal240 "freeze frame Daten aller Fehlerspeichereinträge" UBYTE DFES_OneToOne 1 100 0.00 255.0 ECU_ADDRESS 0xD0008E32 /end MEASUREMENT
/begin MEASUREMENT DFES_FrzFrVal241 "freeze frame Daten aller Fehlerspeichereinträge" UBYTE DFES_OneToOne 1 100 0.00 255.0 ECU_ADDRESS 0xD0008E33 /end MEASUREMENT
/begin MEASUREMENT DFES_FrzFrVal242 "freeze frame Daten aller Fehlerspeichereinträge" UBYTE DFES_OneToOne 1 100 0.00 255.0 ECU_ADDRESS 0xD0008E34 /end MEASUREMENT
/begin MEASUREMENT DFES_FrzFrVal243 "freeze frame Daten aller Fehlerspeichereinträge" UBYTE DFES_OneToOne 1 100 0.00 255.0 ECU_ADDRESS 0xD0008E35 /end MEASUREMENT
/begin MEASUREMENT DFES_FrzFrVal244 "freeze frame Daten aller Fehlerspeichereinträge" UBYTE DFES_OneToOne 1 100 0.00 255.0 ECU_ADDRESS 0xD0008E36 /end MEASUREMENT
/begin MEASUREMENT DFES_FrzFrVal245 "freeze frame Daten aller Fehlerspeichereinträge" UBYTE DFES_OneToOne 1 100 0.00 255.0 ECU_ADDRESS 0xD0008E37 /end MEASUREMENT
/begin MEASUREMENT DFES_FrzFrVal246 "freeze frame Daten aller Fehlerspeichereinträge" UBYTE DFES_OneToOne 1 100 0.00 255.0 ECU_ADDRESS 0xD0008E38 /end MEASUREMENT
/begin MEASUREMENT DFES_FrzFrVal247 "freeze frame Daten aller Fehlerspeichereinträge" UBYTE DFES_OneToOne 1 100 0.00 255.0 ECU_ADDRESS 0xD0008E39 /end MEASUREMENT
/begin MEASUREMENT DFES_FrzFrVal248 "freeze frame Daten aller Fehlerspeichereinträge" UBYTE DFES_OneToOne 1 100 0.00 255.0 ECU_ADDRESS 0xD0008E3A /end MEASUREMENT
/begin MEASUREMENT DFES_FrzFrVal249 "freeze frame Daten aller Fehlerspeichereinträge" UBYTE DFES_OneToOne 1 100 0.00 255.0 ECU_ADDRESS 0xD0008E3B /end MEASUREMENT
/begin MEASUREMENT DFES_FrzFrVal250 "freeze frame Daten aller Fehlerspeichereinträge" UBYTE DFES_OneToOne 1 100 0.00 255.0 ECU_ADDRESS 0xD0008E3C /end MEASUREMENT
/begin MEASUREMENT DFES_FrzFrVal251 "freeze frame Daten aller Fehlerspeichereinträge" UBYTE DFES_OneToOne 1 100 0.00 255.0 ECU_ADDRESS 0xD0008E3D /end MEASUREMENT
/begin MEASUREMENT DFES_FrzFrVal252 "freeze frame Daten aller Fehlerspeichereinträge" UBYTE DFES_OneToOne 1 100 0.00 255.0 ECU_ADDRESS 0xD0008E3E /end MEASUREMENT
/begin MEASUREMENT DFES_FrzFrVal253 "freeze frame Daten aller Fehlerspeichereinträge" UBYTE DFES_OneToOne 1 100 0.00 255.0 ECU_ADDRESS 0xD0008E3F /end MEASUREMENT
/begin MEASUREMENT DFES_FrzFrVal254 "freeze frame Daten aller Fehlerspeichereinträge" UBYTE DFES_OneToOne 1 100 0.00 255.0 ECU_ADDRESS 0xD0008E40 /end MEASUREMENT
/begin MEASUREMENT DFES_FrzFrVal255 "freeze frame Daten aller Fehlerspeichereinträge" UBYTE DFES_OneToOne 1 100 0.00 255.0 ECU_ADDRESS 0xD0008E41 /end MEASUREMENT
/begin MEASUREMENT DFES_FrzFrVal256 "freeze frame Daten aller Fehlerspeichereinträge" UBYTE DFES_OneToOne 1 100 0.00 255.0 ECU_ADDRESS 0xD0008E42 /end MEASUREMENT
/begin MEASUREMENT DFES_FrzFrVal257 "freeze frame Daten aller Fehlerspeichereinträge" UBYTE DFES_OneToOne 1 100 0.00 255.0 ECU_ADDRESS 0xD0008E43 /end MEASUREMENT
/begin MEASUREMENT DFES_FrzFrVal258 "freeze frame Daten aller Fehlerspeichereinträge" UBYTE DFES_OneToOne 1 100 0.00 255.0 ECU_ADDRESS 0xD0008E44 /end MEASUREMENT
/begin MEASUREMENT DFES_FrzFrVal259 "freeze frame Daten aller Fehlerspeichereinträge" UBYTE DFES_OneToOne 1 100 0.00 255.0 ECU_ADDRESS 0xD0008E45 /end MEASUREMENT
/begin MEASUREMENT DFES_FrzFrVal260 "freeze frame Daten aller Fehlerspeichereinträge" UBYTE DFES_OneToOne 1 100 0.00 255.0 ECU_ADDRESS 0xD0008E46 /end MEASUREMENT
/begin MEASUREMENT DFES_FrzFrVal261 "freeze frame Daten aller Fehlerspeichereinträge" UBYTE DFES_OneToOne 1 100 0.00 255.0 ECU_ADDRESS 0xD0008E47 /end MEASUREMENT
/begin MEASUREMENT DFES_FrzFrVal262 "freeze frame Daten aller Fehlerspeichereinträge" UBYTE DFES_OneToOne 1 100 0.00 255.0 ECU_ADDRESS 0xD0008E48 /end MEASUREMENT
/begin MEASUREMENT DFES_FrzFrVal263 "freeze frame Daten aller Fehlerspeichereinträge" UBYTE DFES_OneToOne 1 100 0.00 255.0 ECU_ADDRESS 0xD0008E49 /end MEASUREMENT
/begin MEASUREMENT DFES_FrzFrVal264 "freeze frame Daten aller Fehlerspeichereinträge" UBYTE DFES_OneToOne 1 100 0.00 255.0 ECU_ADDRESS 0xD0008E4A /end MEASUREMENT
/begin MEASUREMENT DFES_FrzFrVal265 "freeze frame Daten aller Fehlerspeichereinträge" UBYTE DFES_OneToOne 1 100 0.00 255.0 ECU_ADDRESS 0xD0008E4B /end MEASUREMENT
/begin MEASUREMENT DFES_FrzFrVal266 "freeze frame Daten aller Fehlerspeichereinträge" UBYTE DFES_OneToOne 1 100 0.00 255.0 ECU_ADDRESS 0xD0008E4C /end MEASUREMENT
/begin MEASUREMENT DFES_FrzFrVal267 "freeze frame Daten aller Fehlerspeichereinträge" UBYTE DFES_OneToOne 1 100 0.00 255.0 ECU_ADDRESS 0xD0008E4D /end MEASUREMENT
/begin MEASUREMENT DFES_FrzFrVal268 "freeze frame Daten aller Fehlerspeichereinträge" UBYTE DFES_OneToOne 1 100 0.00 255.0 ECU_ADDRESS 0xD0008E4E /end MEASUREMENT
/begin MEASUREMENT DFES_FrzFrVal269 "freeze frame Daten aller Fehlerspeichereinträge" UBYTE DFES_OneToOne 1 100 0.00 255.0 ECU_ADDRESS 0xD0008E4F /end MEASUREMENT
/begin MEASUREMENT DFES_FrzFrVal270 "freeze frame Daten aller Fehlerspeichereinträge" UBYTE DFES_OneToOne 1 100 0.00 255.0 ECU_ADDRESS 0xD0008E50 /end MEASUREMENT
/begin MEASUREMENT DFES_FrzFrVal271 "freeze frame Daten aller Fehlerspeichereinträge" UBYTE DFES_OneToOne 1 100 0.00 255.0 ECU_ADDRESS 0xD0008E51 /end MEASUREMENT
/begin MEASUREMENT DFES_FrzFrVal272 "freeze frame Daten aller Fehlerspeichereinträge" UBYTE DFES_OneToOne 1 100 0.00 255.0 ECU_ADDRESS 0xD0008E52 /end MEASUREMENT
/begin MEASUREMENT DFES_FrzFrVal273 "freeze frame Daten aller Fehlerspeichereinträge" UBYTE DFES_OneToOne 1 100 0.00 255.0 ECU_ADDRESS 0xD0008E53 /end MEASUREMENT
/begin MEASUREMENT DFES_FrzFrVal274 "freeze frame Daten aller Fehlerspeichereinträge" UBYTE DFES_OneToOne 1 100 0.00 255.0 ECU_ADDRESS 0xD0008E54 /end MEASUREMENT
/begin MEASUREMENT DFES_FrzFrVal275 "freeze frame Daten aller Fehlerspeichereinträge" UBYTE DFES_OneToOne 1 100 0.00 255.0 ECU_ADDRESS 0xD0008E55 /end MEASUREMENT
/begin MEASUREMENT DFES_FrzFrVal276 "freeze frame Daten aller Fehlerspeichereinträge" UBYTE DFES_OneToOne 1 100 0.00 255.0 ECU_ADDRESS 0xD0008E56 /end MEASUREMENT
/begin MEASUREMENT DFES_FrzFrVal277 "freeze frame Daten aller Fehlerspeichereinträge" UBYTE DFES_OneToOne 1 100 0.00 255.0 ECU_ADDRESS 0xD0008E57 /end MEASUREMENT
/begin MEASUREMENT DFES_FrzFrVal278 "freeze frame Daten aller Fehlerspeichereinträge" UBYTE DFES_OneToOne 1 100 0.00 255.0 ECU_ADDRESS 0xD0008E58 /end MEASUREMENT
/begin MEASUREMENT DFES_FrzFrVal279 "freeze frame Daten aller Fehlerspeichereinträge" UBYTE DFES_OneToOne 1 100 0.00 255.0 ECU_ADDRESS 0xD0008E59 /end MEASUREMENT
/begin MEASUREMENT DFES_FrzFrVal280 "freeze frame Daten aller Fehlerspeichereinträge" UBYTE DFES_OneToOne 1 100 0.00 255.0 ECU_ADDRESS 0xD0008E5A /end MEASUREMENT
/begin MEASUREMENT DFES_FrzFrVal281 "freeze frame Daten aller Fehlerspeichereinträge" UBYTE DFES_OneToOne 1 100 0.00 255.0 ECU_ADDRESS 0xD0008E5B /end MEASUREMENT
/begin MEASUREMENT DFES_FrzFrVal282 "freeze frame Daten aller Fehlerspeichereinträge" UBYTE DFES_OneToOne 1 100 0.00 255.0 ECU_ADDRESS 0xD0008E5C /end MEASUREMENT
/begin MEASUREMENT DFES_FrzFrVal283 "freeze frame Daten aller Fehlerspeichereinträge" UBYTE DFES_OneToOne 1 100 0.00 255.0 ECU_ADDRESS 0xD0008E5D /end MEASUREMENT
/begin MEASUREMENT DFES_FrzFrVal284 "freeze frame Daten aller Fehlerspeichereinträge" UBYTE DFES_OneToOne 1 100 0.00 255.0 ECU_ADDRESS 0xD0008E5E /end MEASUREMENT
/begin MEASUREMENT DFES_FrzFrVal285 "freeze frame Daten aller Fehlerspeichereinträge" UBYTE DFES_OneToOne 1 100 0.00 255.0 ECU_ADDRESS 0xD0008E5F /end MEASUREMENT
/begin MEASUREMENT DFES_FrzFrVal286 "freeze frame Daten aller Fehlerspeichereinträge" UBYTE DFES_OneToOne 1 100 0.00 255.0 ECU_ADDRESS 0xD0008E60 /end MEASUREMENT
/begin MEASUREMENT DFES_FrzFrVal287 "freeze frame Daten aller Fehlerspeichereinträge" UBYTE DFES_OneToOne 1 100 0.00 255.0 ECU_ADDRESS 0xD0008E61 /end MEASUREMENT
/begin MEASUREMENT DFES_FrzFrVal288 "freeze frame Daten aller Fehlerspeichereinträge" UBYTE DFES_OneToOne 1 100 0.00 255.0 ECU_ADDRESS 0xD0008E62 /end MEASUREMENT
/begin MEASUREMENT DFES_FrzFrVal289 "freeze frame Daten aller Fehlerspeichereinträge" UBYTE DFES_OneToOne 1 100 0.00 255.0 ECU_ADDRESS 0xD0008E63 /end MEASUREMENT
/begin MEASUREMENT DFES_FrzFrVal290 "freeze frame Daten aller Fehlerspeichereinträge" UBYTE DFES_OneToOne 1 100 0.00 255.0 ECU_ADDRESS 0xD0008E64 /end MEASUREMENT
/begin MEASUREMENT DFES_FrzFrVal291 "freeze frame Daten aller Fehlerspeichereinträge" UBYTE DFES_OneToOne 1 100 0.00 255.0 ECU_ADDRESS 0xD0008E65 /end MEASUREMENT
/begin MEASUREMENT DFES_FrzFrVal292 "freeze frame Daten aller Fehlerspeichereinträge" UBYTE DFES_OneToOne 1 100 0.00 255.0 ECU_ADDRESS 0xD0008E66 /end MEASUREMENT
/begin MEASUREMENT DFES_FrzFrVal293 "freeze frame Daten aller Fehlerspeichereinträge" UBYTE DFES_OneToOne 1 100 0.00 255.0 ECU_ADDRESS 0xD0008E67 /end MEASUREMENT
/begin MEASUREMENT DFES_FrzFrVal294 "freeze frame Daten aller Fehlerspeichereinträge" UBYTE DFES_OneToOne 1 100 0.00 255.0 ECU_ADDRESS 0xD0008E68 /end MEASUREMENT
/begin MEASUREMENT DFES_FrzFrVal295 "freeze frame Daten aller Fehlerspeichereinträge" UBYTE DFES_OneToOne 1 100 0.00 255.0 ECU_ADDRESS 0xD0008E69 /end MEASUREMENT
/begin MEASUREMENT DFES_FrzFrVal296 "freeze frame Daten aller Fehlerspeichereinträge" UBYTE DFES_OneToOne 1 100 0.00 255.0 ECU_ADDRESS 0xD0008E6A /end MEASUREMENT
/begin MEASUREMENT DFES_FrzFrVal297 "freeze frame Daten aller Fehlerspeichereinträge" UBYTE DFES_OneToOne 1 100 0.00 255.0 ECU_ADDRESS 0xD0008E6B /end MEASUREMENT
/begin MEASUREMENT DFES_FrzFrVal298 "freeze frame Daten aller Fehlerspeichereinträge" UBYTE DFES_OneToOne 1 100 0.00 255.0 ECU_ADDRESS 0xD0008E6C /end MEASUREMENT
/begin MEASUREMENT DFES_FrzFrVal299 "freeze frame Daten aller Fehlerspeichereinträge" UBYTE DFES_OneToOne 1 100 0.00 255.0 ECU_ADDRESS 0xD0008E6D /end MEASUREMENT
/begin MEASUREMENT DFES_FrzFrVal300 "freeze frame Daten aller Fehlerspeichereinträge" UBYTE DFES_OneToOne 1 100 0.00 255.0 ECU_ADDRESS 0xD0008E6E /end MEASUREMENT
/begin MEASUREMENT DFES_FrzFrVal301 "freeze frame Daten aller Fehlerspeichereinträge" UBYTE DFES_OneToOne 1 100 0.00 255.0 ECU_ADDRESS 0xD0008E6F /end MEASUREMENT
/begin MEASUREMENT DFES_FrzFrVal302 "freeze frame Daten aller Fehlerspeichereinträge" UBYTE DFES_OneToOne 1 100 0.00 255.0 ECU_ADDRESS 0xD0008E70 /end MEASUREMENT
/begin MEASUREMENT DFES_FrzFrVal303 "freeze frame Daten aller Fehlerspeichereinträge" UBYTE DFES_OneToOne 1 100 0.00 255.0 ECU_ADDRESS 0xD0008E71 /end MEASUREMENT
/begin MEASUREMENT DFES_FrzFrVal304 "freeze frame Daten aller Fehlerspeichereinträge" UBYTE DFES_OneToOne 1 100 0.00 255.0 ECU_ADDRESS 0xD0008E72 /end MEASUREMENT
/begin MEASUREMENT DFES_FrzFrVal305 "freeze frame Daten aller Fehlerspeichereinträge" UBYTE DFES_OneToOne 1 100 0.00 255.0 ECU_ADDRESS 0xD0008E73 /end MEASUREMENT
/begin MEASUREMENT DFES_FrzFrVal306 "freeze frame Daten aller Fehlerspeichereinträge" UBYTE DFES_OneToOne 1 100 0.00 255.0 ECU_ADDRESS 0xD0008E74 /end MEASUREMENT
/begin MEASUREMENT DFES_FrzFrVal307 "freeze frame Daten aller Fehlerspeichereinträge" UBYTE DFES_OneToOne 1 100 0.00 255.0 ECU_ADDRESS 0xD0008E75 /end MEASUREMENT
/begin MEASUREMENT DFES_FrzFrVal308 "freeze frame Daten aller Fehlerspeichereinträge" UBYTE DFES_OneToOne 1 100 0.00 255.0 ECU_ADDRESS 0xD0008E76 /end MEASUREMENT
/begin MEASUREMENT DFES_FrzFrVal309 "freeze frame Daten aller Fehlerspeichereinträge" UBYTE DFES_OneToOne 1 100 0.00 255.0 ECU_ADDRESS 0xD0008E77 /end MEASUREMENT
/begin MEASUREMENT DFES_FrzFrVal310 "freeze frame Daten aller Fehlerspeichereinträge" UBYTE DFES_OneToOne 1 100 0.00 255.0 ECU_ADDRESS 0xD0008E78 /end MEASUREMENT
/begin MEASUREMENT DFES_FrzFrVal311 "freeze frame Daten aller Fehlerspeichereinträge" UBYTE DFES_OneToOne 1 100 0.00 255.0 ECU_ADDRESS 0xD0008E79 /end MEASUREMENT
/begin MEASUREMENT DFES_FrzFrVal312 "freeze frame Daten aller Fehlerspeichereinträge" UBYTE DFES_OneToOne 1 100 0.00 255.0 ECU_ADDRESS 0xD0008E7A /end MEASUREMENT
/begin MEASUREMENT DFES_FrzFrVal313 "freeze frame Daten aller Fehlerspeichereinträge" UBYTE DFES_OneToOne 1 100 0.00 255.0 ECU_ADDRESS 0xD0008E7B /end MEASUREMENT
/begin MEASUREMENT DFES_FrzFrVal314 "freeze frame Daten aller Fehlerspeichereinträge" UBYTE DFES_OneToOne 1 100 0.00 255.0 ECU_ADDRESS 0xD0008E7C /end MEASUREMENT
/begin MEASUREMENT DFES_FrzFrVal315 "freeze frame Daten aller Fehlerspeichereinträge" UBYTE DFES_OneToOne 1 100 0.00 255.0 ECU_ADDRESS 0xD0008E7D /end MEASUREMENT
/begin MEASUREMENT DFES_FrzFrVal316 "freeze frame Daten aller Fehlerspeichereinträge" UBYTE DFES_OneToOne 1 100 0.00 255.0 ECU_ADDRESS 0xD0008E7E /end MEASUREMENT
/begin MEASUREMENT DFES_FrzFrVal317 "freeze frame Daten aller Fehlerspeichereinträge" UBYTE DFES_OneToOne 1 100 0.00 255.0 ECU_ADDRESS 0xD0008E7F /end MEASUREMENT
/begin MEASUREMENT DFES_FrzFrVal318 "freeze frame Daten aller Fehlerspeichereinträge" UBYTE DFES_OneToOne 1 100 0.00 255.0 ECU_ADDRESS 0xD0008E80 /end MEASUREMENT
/begin MEASUREMENT DFES_FrzFrVal319 "freeze frame Daten aller Fehlerspeichereinträge" UBYTE DFES_OneToOne 1 100 0.00 255.0 ECU_ADDRESS 0xD0008E81 /end MEASUREMENT
/begin MEASUREMENT DFES_idxHash00 "DSM interne Hash-Tabelle für optimierten DFC basierten Fehlerspeicherzugriff" UBYTE DFES_OneToOne 1 100 0.00 255.0 ECU_ADDRESS 0xD000395C /end MEASUREMENT
/begin MEASUREMENT DFES_idxHash01 "DSM interne Hash-Tabelle für optimierten DFC basierten Fehlerspeicherzugriff" UBYTE DFES_OneToOne 1 100 0.00 255.0 ECU_ADDRESS 0xD000395D /end MEASUREMENT
/begin MEASUREMENT DFES_idxHash02 "DSM interne Hash-Tabelle für optimierten DFC basierten Fehlerspeicherzugriff" UBYTE DFES_OneToOne 1 100 0.00 255.0 ECU_ADDRESS 0xD000395E /end MEASUREMENT
/begin MEASUREMENT DFES_idxHash03 "DSM interne Hash-Tabelle für optimierten DFC basierten Fehlerspeicherzugriff" UBYTE DFES_OneToOne 1 100 0.00 255.0 ECU_ADDRESS 0xD000395F /end MEASUREMENT
/begin MEASUREMENT DFES_idxHash04 "DSM interne Hash-Tabelle für optimierten DFC basierten Fehlerspeicherzugriff" UBYTE DFES_OneToOne 1 100 0.00 255.0 ECU_ADDRESS 0xD0003960 /end MEASUREMENT
/begin MEASUREMENT DFES_idxHash05 "DSM interne Hash-Tabelle für optimierten DFC basierten Fehlerspeicherzugriff" UBYTE DFES_OneToOne 1 100 0.00 255.0 ECU_ADDRESS 0xD0003961 /end MEASUREMENT
/begin MEASUREMENT DFES_idxHash06 "DSM interne Hash-Tabelle für optimierten DFC basierten Fehlerspeicherzugriff" UBYTE DFES_OneToOne 1 100 0.00 255.0 ECU_ADDRESS 0xD0003962 /end MEASUREMENT
/begin MEASUREMENT DFES_idxHash07 "DSM interne Hash-Tabelle für optimierten DFC basierten Fehlerspeicherzugriff" UBYTE DFES_OneToOne 1 100 0.00 255.0 ECU_ADDRESS 0xD0003963 /end MEASUREMENT
/begin MEASUREMENT DFES_idxHash08 "DSM interne Hash-Tabelle für optimierten DFC basierten Fehlerspeicherzugriff" UBYTE DFES_OneToOne 1 100 0.00 255.0 ECU_ADDRESS 0xD0003964 /end MEASUREMENT
/begin MEASUREMENT DFES_idxHash09 "DSM interne Hash-Tabelle für optimierten DFC basierten Fehlerspeicherzugriff" UBYTE DFES_OneToOne 1 100 0.00 255.0 ECU_ADDRESS 0xD0003965 /end MEASUREMENT
/begin MEASUREMENT DFES_idxHash10 "DSM interne Hash-Tabelle für optimierten DFC basierten Fehlerspeicherzugriff" UBYTE DFES_OneToOne 1 100 0.00 255.0 ECU_ADDRESS 0xD0003966 /end MEASUREMENT
/begin MEASUREMENT DFES_idxHash11 "DSM interne Hash-Tabelle für optimierten DFC basierten Fehlerspeicherzugriff" UBYTE DFES_OneToOne 1 100 0.00 255.0 ECU_ADDRESS 0xD0003967 /end MEASUREMENT
/begin MEASUREMENT DFES_idxHash12 "DSM interne Hash-Tabelle für optimierten DFC basierten Fehlerspeicherzugriff" UBYTE DFES_OneToOne 1 100 0.00 255.0 ECU_ADDRESS 0xD0003968 /end MEASUREMENT
/begin MEASUREMENT DFES_idxHash13 "DSM interne Hash-Tabelle für optimierten DFC basierten Fehlerspeicherzugriff" UBYTE DFES_OneToOne 1 100 0.00 255.0 ECU_ADDRESS 0xD0003969 /end MEASUREMENT
/begin MEASUREMENT DFES_idxHash14 "DSM interne Hash-Tabelle für optimierten DFC basierten Fehlerspeicherzugriff" UBYTE DFES_OneToOne 1 100 0.00 255.0 ECU_ADDRESS 0xD000396A /end MEASUREMENT
/begin MEASUREMENT DFES_idxHash15 "DSM interne Hash-Tabelle für optimierten DFC basierten Fehlerspeicherzugriff" UBYTE DFES_OneToOne 1 100 0.00 255.0 ECU_ADDRESS 0xD000396B /end MEASUREMENT
/begin MEASUREMENT DFES_idxHash16 "DSM interne Hash-Tabelle für optimierten DFC basierten Fehlerspeicherzugriff" UBYTE DFES_OneToOne 1 100 0.00 255.0 ECU_ADDRESS 0xD000396C /end MEASUREMENT
/begin MEASUREMENT DFES_idxHash17 "DSM interne Hash-Tabelle für optimierten DFC basierten Fehlerspeicherzugriff" UBYTE DFES_OneToOne 1 100 0.00 255.0 ECU_ADDRESS 0xD000396D /end MEASUREMENT
/begin MEASUREMENT DFES_idxHash18 "DSM interne Hash-Tabelle für optimierten DFC basierten Fehlerspeicherzugriff" UBYTE DFES_OneToOne 1 100 0.00 255.0 ECU_ADDRESS 0xD000396E /end MEASUREMENT
/begin MEASUREMENT DFES_idxHash19 "DSM interne Hash-Tabelle für optimierten DFC basierten Fehlerspeicherzugriff" UBYTE DFES_OneToOne 1 100 0.00 255.0 ECU_ADDRESS 0xD000396F /end MEASUREMENT
/begin MEASUREMENT DFES_idxLink00 "DSM interne Link-Tabelle für optimierten DFC basierten Fehlerspeicherzugriff" UBYTE DFES_OneToOne 1 100 0.00 255.0 ECU_ADDRESS 0xD0003934 /end MEASUREMENT
/begin MEASUREMENT DFES_idxLink01 "DSM interne Link-Tabelle für optimierten DFC basierten Fehlerspeicherzugriff" UBYTE DFES_OneToOne 1 100 0.00 255.0 ECU_ADDRESS 0xD0003935 /end MEASUREMENT
/begin MEASUREMENT DFES_idxLink02 "DSM interne Link-Tabelle für optimierten DFC basierten Fehlerspeicherzugriff" UBYTE DFES_OneToOne 1 100 0.00 255.0 ECU_ADDRESS 0xD0003936 /end MEASUREMENT
/begin MEASUREMENT DFES_idxLink03 "DSM interne Link-Tabelle für optimierten DFC basierten Fehlerspeicherzugriff" UBYTE DFES_OneToOne 1 100 0.00 255.0 ECU_ADDRESS 0xD0003937 /end MEASUREMENT
/begin MEASUREMENT DFES_idxLink04 "DSM interne Link-Tabelle für optimierten DFC basierten Fehlerspeicherzugriff" UBYTE DFES_OneToOne 1 100 0.00 255.0 ECU_ADDRESS 0xD0003938 /end MEASUREMENT
/begin MEASUREMENT DFES_idxLink05 "DSM interne Link-Tabelle für optimierten DFC basierten Fehlerspeicherzugriff" UBYTE DFES_OneToOne 1 100 0.00 255.0 ECU_ADDRESS 0xD0003939 /end MEASUREMENT
/begin MEASUREMENT DFES_idxLink06 "DSM interne Link-Tabelle für optimierten DFC basierten Fehlerspeicherzugriff" UBYTE DFES_OneToOne 1 100 0.00 255.0 ECU_ADDRESS 0xD000393A /end MEASUREMENT
/begin MEASUREMENT DFES_idxLink07 "DSM interne Link-Tabelle für optimierten DFC basierten Fehlerspeicherzugriff" UBYTE DFES_OneToOne 1 100 0.00 255.0 ECU_ADDRESS 0xD000393B /end MEASUREMENT
/begin MEASUREMENT DFES_idxLink08 "DSM interne Link-Tabelle für optimierten DFC basierten Fehlerspeicherzugriff" UBYTE DFES_OneToOne 1 100 0.00 255.0 ECU_ADDRESS 0xD000393C /end MEASUREMENT
/begin MEASUREMENT DFES_idxLink09 "DSM interne Link-Tabelle für optimierten DFC basierten Fehlerspeicherzugriff" UBYTE DFES_OneToOne 1 100 0.00 255.0 ECU_ADDRESS 0xD000393D /end MEASUREMENT
/begin MEASUREMENT DFES_idxLink10 "DSM interne Link-Tabelle für optimierten DFC basierten Fehlerspeicherzugriff" UBYTE DFES_OneToOne 1 100 0.00 255.0 ECU_ADDRESS 0xD000393E /end MEASUREMENT
/begin MEASUREMENT DFES_idxLink11 "DSM interne Link-Tabelle für optimierten DFC basierten Fehlerspeicherzugriff" UBYTE DFES_OneToOne 1 100 0.00 255.0 ECU_ADDRESS 0xD000393F /end MEASUREMENT
/begin MEASUREMENT DFES_idxLink12 "DSM interne Link-Tabelle für optimierten DFC basierten Fehlerspeicherzugriff" UBYTE DFES_OneToOne 1 100 0.00 255.0 ECU_ADDRESS 0xD0003940 /end MEASUREMENT
/begin MEASUREMENT DFES_idxLink13 "DSM interne Link-Tabelle für optimierten DFC basierten Fehlerspeicherzugriff" UBYTE DFES_OneToOne 1 100 0.00 255.0 ECU_ADDRESS 0xD0003941 /end MEASUREMENT
/begin MEASUREMENT DFES_idxLink14 "DSM interne Link-Tabelle für optimierten DFC basierten Fehlerspeicherzugriff" UBYTE DFES_OneToOne 1 100 0.00 255.0 ECU_ADDRESS 0xD0003942 /end MEASUREMENT
/begin MEASUREMENT DFES_idxLink15 "DSM interne Link-Tabelle für optimierten DFC basierten Fehlerspeicherzugriff" UBYTE DFES_OneToOne 1 100 0.00 255.0 ECU_ADDRESS 0xD0003943 /end MEASUREMENT
/begin MEASUREMENT DFES_idxLink16 "DSM interne Link-Tabelle für optimierten DFC basierten Fehlerspeicherzugriff" UBYTE DFES_OneToOne 1 100 0.00 255.0 ECU_ADDRESS 0xD0003944 /end MEASUREMENT
/begin MEASUREMENT DFES_idxLink17 "DSM interne Link-Tabelle für optimierten DFC basierten Fehlerspeicherzugriff" UBYTE DFES_OneToOne 1 100 0.00 255.0 ECU_ADDRESS 0xD0003945 /end MEASUREMENT
/begin MEASUREMENT DFES_idxLink18 "DSM interne Link-Tabelle für optimierten DFC basierten Fehlerspeicherzugriff" UBYTE DFES_OneToOne 1 100 0.00 255.0 ECU_ADDRESS 0xD0003946 /end MEASUREMENT
/begin MEASUREMENT DFES_idxLink19 "DSM interne Link-Tabelle für optimierten DFC basierten Fehlerspeicherzugriff" UBYTE DFES_OneToOne 1 100 0.00 255.0 ECU_ADDRESS 0xD0003947 /end MEASUREMENT
/begin MEASUREMENT DFES_idxPrioQueue00 "DSM interne Prioritätsreihenfolge aller Fehlerspeichereinträge" UBYTE DFES_OneToOne 1 100 0.00 255.0 ECU_ADDRESS 0xD0003948 /end MEASUREMENT
/begin MEASUREMENT DFES_idxPrioQueue01 "DSM interne Prioritätsreihenfolge aller Fehlerspeichereinträge" UBYTE DFES_OneToOne 1 100 0.00 255.0 ECU_ADDRESS 0xD0003949 /end MEASUREMENT
/begin MEASUREMENT DFES_idxPrioQueue02 "DSM interne Prioritätsreihenfolge aller Fehlerspeichereinträge" UBYTE DFES_OneToOne 1 100 0.00 255.0 ECU_ADDRESS 0xD000394A /end MEASUREMENT
/begin MEASUREMENT DFES_idxPrioQueue03 "DSM interne Prioritätsreihenfolge aller Fehlerspeichereinträge" UBYTE DFES_OneToOne 1 100 0.00 255.0 ECU_ADDRESS 0xD000394B /end MEASUREMENT
/begin MEASUREMENT DFES_idxPrioQueue04 "DSM interne Prioritätsreihenfolge aller Fehlerspeichereinträge" UBYTE DFES_OneToOne 1 100 0.00 255.0 ECU_ADDRESS 0xD000394C /end MEASUREMENT
/begin MEASUREMENT DFES_idxPrioQueue05 "DSM interne Prioritätsreihenfolge aller Fehlerspeichereinträge" UBYTE DFES_OneToOne 1 100 0.00 255.0 ECU_ADDRESS 0xD000394D /end MEASUREMENT
/begin MEASUREMENT DFES_idxPrioQueue06 "DSM interne Prioritätsreihenfolge aller Fehlerspeichereinträge" UBYTE DFES_OneToOne 1 100 0.00 255.0 ECU_ADDRESS 0xD000394E /end MEASUREMENT
/begin MEASUREMENT DFES_idxPrioQueue07 "DSM interne Prioritätsreihenfolge aller Fehlerspeichereinträge" UBYTE DFES_OneToOne 1 100 0.00 255.0 ECU_ADDRESS 0xD000394F /end MEASUREMENT
/begin MEASUREMENT DFES_idxPrioQueue08 "DSM interne Prioritätsreihenfolge aller Fehlerspeichereinträge" UBYTE DFES_OneToOne 1 100 0.00 255.0 ECU_ADDRESS 0xD0003950 /end MEASUREMENT
/begin MEASUREMENT DFES_idxPrioQueue09 "DSM interne Prioritätsreihenfolge aller Fehlerspeichereinträge" UBYTE DFES_OneToOne 1 100 0.00 255.0 ECU_ADDRESS 0xD0003951 /end MEASUREMENT
/begin MEASUREMENT DFES_idxPrioQueue10 "DSM interne Prioritätsreihenfolge aller Fehlerspeichereinträge" UBYTE DFES_OneToOne 1 100 0.00 255.0 ECU_ADDRESS 0xD0003952 /end MEASUREMENT
/begin MEASUREMENT DFES_idxPrioQueue11 "DSM interne Prioritätsreihenfolge aller Fehlerspeichereinträge" UBYTE DFES_OneToOne 1 100 0.00 255.0 ECU_ADDRESS 0xD0003953 /end MEASUREMENT
/begin MEASUREMENT DFES_idxPrioQueue12 "DSM interne Prioritätsreihenfolge aller Fehlerspeichereinträge" UBYTE DFES_OneToOne 1 100 0.00 255.0 ECU_ADDRESS 0xD0003954 /end MEASUREMENT
/begin MEASUREMENT DFES_idxPrioQueue13 "DSM interne Prioritätsreihenfolge aller Fehlerspeichereinträge" UBYTE DFES_OneToOne 1 100 0.00 255.0 ECU_ADDRESS 0xD0003955 /end MEASUREMENT
/begin MEASUREMENT DFES_idxPrioQueue14 "DSM interne Prioritätsreihenfolge aller Fehlerspeichereinträge" UBYTE DFES_OneToOne 1 100 0.00 255.0 ECU_ADDRESS 0xD0003956 /end MEASUREMENT
/begin MEASUREMENT DFES_idxPrioQueue15 "DSM interne Prioritätsreihenfolge aller Fehlerspeichereinträge" UBYTE DFES_OneToOne 1 100 0.00 255.0 ECU_ADDRESS 0xD0003957 /end MEASUREMENT
/begin MEASUREMENT DFES_idxPrioQueue16 "DSM interne Prioritätsreihenfolge aller Fehlerspeichereinträge" UBYTE DFES_OneToOne 1 100 0.00 255.0 ECU_ADDRESS 0xD0003958 /end MEASUREMENT
/begin MEASUREMENT DFES_idxPrioQueue17 "DSM interne Prioritätsreihenfolge aller Fehlerspeichereinträge" UBYTE DFES_OneToOne 1 100 0.00 255.0 ECU_ADDRESS 0xD0003959 /end MEASUREMENT
/begin MEASUREMENT DFES_idxPrioQueue18 "DSM interne Prioritätsreihenfolge aller Fehlerspeichereinträge" UBYTE DFES_OneToOne 1 100 0.00 255.0 ECU_ADDRESS 0xD000395A /end MEASUREMENT
/begin MEASUREMENT DFES_idxPrioQueue19 "DSM interne Prioritätsreihenfolge aller Fehlerspeichereinträge" UBYTE DFES_OneToOne 1 100 0.00 255.0 ECU_ADDRESS 0xD000395B /end MEASUREMENT
/begin MEASUREMENT DFES_idxSequence00 "DSM interne Eintragsreihenfolge, um die historische Reihenfolge aller Einträge zu erhalten" UBYTE DFES_OneToOne 1 100 0.00 255.0 ECU_ADDRESS 0xC000C8BC /end MEASUREMENT
/begin MEASUREMENT DFES_idxSequence01 "DSM interne Eintragsreihenfolge, um die historische Reihenfolge aller Einträge zu erhalten" UBYTE DFES_OneToOne 1 100 0.00 255.0 ECU_ADDRESS 0xC000C8BD /end MEASUREMENT
/begin MEASUREMENT DFES_idxSequence02 "DSM interne Eintragsreihenfolge, um die historische Reihenfolge aller Einträge zu erhalten" UBYTE DFES_OneToOne 1 100 0.00 255.0 ECU_ADDRESS 0xC000C8BE /end MEASUREMENT
/begin MEASUREMENT DFES_idxSequence03 "DSM interne Eintragsreihenfolge, um die historische Reihenfolge aller Einträge zu erhalten" UBYTE DFES_OneToOne 1 100 0.00 255.0 ECU_ADDRESS 0xC000C8BF /end MEASUREMENT
/begin MEASUREMENT DFES_idxSequence04 "DSM interne Eintragsreihenfolge, um die historische Reihenfolge aller Einträge zu erhalten" UBYTE DFES_OneToOne 1 100 0.00 255.0 ECU_ADDRESS 0xC000C8C0 /end MEASUREMENT
/begin MEASUREMENT DFES_idxSequence05 "DSM interne Eintragsreihenfolge, um die historische Reihenfolge aller Einträge zu erhalten" UBYTE DFES_OneToOne 1 100 0.00 255.0 ECU_ADDRESS 0xC000C8C1 /end MEASUREMENT
/begin MEASUREMENT DFES_idxSequence06 "DSM interne Eintragsreihenfolge, um die historische Reihenfolge aller Einträge zu erhalten" UBYTE DFES_OneToOne 1 100 0.00 255.0 ECU_ADDRESS 0xC000C8C2 /end MEASUREMENT
/begin MEASUREMENT DFES_idxSequence07 "DSM interne Eintragsreihenfolge, um die historische Reihenfolge aller Einträge zu erhalten" UBYTE DFES_OneToOne 1 100 0.00 255.0 ECU_ADDRESS 0xC000C8C3 /end MEASUREMENT
/begin MEASUREMENT DFES_idxSequence08 "DSM interne Eintragsreihenfolge, um die historische Reihenfolge aller Einträge zu erhalten" UBYTE DFES_OneToOne 1 100 0.00 255.0 ECU_ADDRESS 0xC000C8C4 /end MEASUREMENT
/begin MEASUREMENT DFES_idxSequence09 "DSM interne Eintragsreihenfolge, um die historische Reihenfolge aller Einträge zu erhalten" UBYTE DFES_OneToOne 1 100 0.00 255.0 ECU_ADDRESS 0xC000C8C5 /end MEASUREMENT
/begin MEASUREMENT DFES_idxSequence10 "DSM interne Eintragsreihenfolge, um die historische Reihenfolge aller Einträge zu erhalten" UBYTE DFES_OneToOne 1 100 0.00 255.0 ECU_ADDRESS 0xC000C8C6 /end MEASUREMENT
/begin MEASUREMENT DFES_idxSequence11 "DSM interne Eintragsreihenfolge, um die historische Reihenfolge aller Einträge zu erhalten" UBYTE DFES_OneToOne 1 100 0.00 255.0 ECU_ADDRESS 0xC000C8C7 /end MEASUREMENT
/begin MEASUREMENT DFES_idxSequence12 "DSM interne Eintragsreihenfolge, um die historische Reihenfolge aller Einträge zu erhalten" UBYTE DFES_OneToOne 1 100 0.00 255.0 ECU_ADDRESS 0xC000C8C8 /end MEASUREMENT
/begin MEASUREMENT DFES_idxSequence13 "DSM interne Eintragsreihenfolge, um die historische Reihenfolge aller Einträge zu erhalten" UBYTE DFES_OneToOne 1 100 0.00 255.0 ECU_ADDRESS 0xC000C8C9 /end MEASUREMENT
/begin MEASUREMENT DFES_idxSequence14 "DSM interne Eintragsreihenfolge, um die historische Reihenfolge aller Einträge zu erhalten" UBYTE DFES_OneToOne 1 100 0.00 255.0 ECU_ADDRESS 0xC000C8CA /end MEASUREMENT
/begin MEASUREMENT DFES_idxSequence15 "DSM interne Eintragsreihenfolge, um die historische Reihenfolge aller Einträge zu erhalten" UBYTE DFES_OneToOne 1 100 0.00 255.0 ECU_ADDRESS 0xC000C8CB /end MEASUREMENT
/begin MEASUREMENT DFES_idxSequence16 "DSM interne Eintragsreihenfolge, um die historische Reihenfolge aller Einträge zu erhalten" UBYTE DFES_OneToOne 1 100 0.00 255.0 ECU_ADDRESS 0xC000C8CC /end MEASUREMENT
/begin MEASUREMENT DFES_idxSequence17 "DSM interne Eintragsreihenfolge, um die historische Reihenfolge aller Einträge zu erhalten" UBYTE DFES_OneToOne 1 100 0.00 255.0 ECU_ADDRESS 0xC000C8CD /end MEASUREMENT
/begin MEASUREMENT DFES_idxSequence18 "DSM interne Eintragsreihenfolge, um die historische Reihenfolge aller Einträge zu erhalten" UBYTE DFES_OneToOne 1 100 0.00 255.0 ECU_ADDRESS 0xC000C8CE /end MEASUREMENT
/begin MEASUREMENT DFES_idxSequence19 "DSM interne Eintragsreihenfolge, um die historische Reihenfolge aller Einträge zu erhalten" UBYTE DFES_OneToOne 1 100 0.00 255.0 ECU_ADDRESS 0xC000C8CF /end MEASUREMENT
/begin MEASUREMENT DFES_idxVisible00 "Sichtbarkeit aller Fehlerspeichereinträge" UBYTE DFES_OneToOne 1 100 0.00 255.0 ECU_ADDRESS 0xC0006AF3 /end MEASUREMENT
/begin MEASUREMENT DFES_idxVisible01 "Sichtbarkeit aller Fehlerspeichereinträge" UBYTE DFES_OneToOne 1 100 0.00 255.0 ECU_ADDRESS 0xC0006AF4 /end MEASUREMENT
/begin MEASUREMENT DFES_idxVisible02 "Sichtbarkeit aller Fehlerspeichereinträge" UBYTE DFES_OneToOne 1 100 0.00 255.0 ECU_ADDRESS 0xC0006AF5 /end MEASUREMENT
/begin MEASUREMENT DFES_idxVisible03 "Sichtbarkeit aller Fehlerspeichereinträge" UBYTE DFES_OneToOne 1 100 0.00 255.0 ECU_ADDRESS 0xC0006AF6 /end MEASUREMENT
/begin MEASUREMENT DFES_idxVisible04 "Sichtbarkeit aller Fehlerspeichereinträge" UBYTE DFES_OneToOne 1 100 0.00 255.0 ECU_ADDRESS 0xC0006AF7 /end MEASUREMENT
/begin MEASUREMENT DFES_idxVisible05 "Sichtbarkeit aller Fehlerspeichereinträge" UBYTE DFES_OneToOne 1 100 0.00 255.0 ECU_ADDRESS 0xC0006AF8 /end MEASUREMENT
/begin MEASUREMENT DFES_idxVisible06 "Sichtbarkeit aller Fehlerspeichereinträge" UBYTE DFES_OneToOne 1 100 0.00 255.0 ECU_ADDRESS 0xC0006AF9 /end MEASUREMENT
/begin MEASUREMENT DFES_idxVisible07 "Sichtbarkeit aller Fehlerspeichereinträge" UBYTE DFES_OneToOne 1 100 0.00 255.0 ECU_ADDRESS 0xC0006AFA /end MEASUREMENT
/begin MEASUREMENT DFES_idxVisible08 "Sichtbarkeit aller Fehlerspeichereinträge" UBYTE DFES_OneToOne 1 100 0.00 255.0 ECU_ADDRESS 0xC0006AFB /end MEASUREMENT
/begin MEASUREMENT DFES_idxVisible09 "Sichtbarkeit aller Fehlerspeichereinträge" UBYTE DFES_OneToOne 1 100 0.00 255.0 ECU_ADDRESS 0xC0006AFC /end MEASUREMENT
/begin MEASUREMENT DFES_idxVisible10 "Sichtbarkeit aller Fehlerspeichereinträge" UBYTE DFES_OneToOne 1 100 0.00 255.0 ECU_ADDRESS 0xC0006AFD /end MEASUREMENT
/begin MEASUREMENT DFES_idxVisible11 "Sichtbarkeit aller Fehlerspeichereinträge" UBYTE DFES_OneToOne 1 100 0.00 255.0 ECU_ADDRESS 0xC0006AFE /end MEASUREMENT
/begin MEASUREMENT DFES_idxVisible12 "Sichtbarkeit aller Fehlerspeichereinträge" UBYTE DFES_OneToOne 1 100 0.00 255.0 ECU_ADDRESS 0xC0006AFF /end MEASUREMENT
/begin MEASUREMENT DFES_idxVisible13 "Sichtbarkeit aller Fehlerspeichereinträge" UBYTE DFES_OneToOne 1 100 0.00 255.0 ECU_ADDRESS 0xC0006B00 /end MEASUREMENT
/begin MEASUREMENT DFES_idxVisible14 "Sichtbarkeit aller Fehlerspeichereinträge" UBYTE DFES_OneToOne 1 100 0.00 255.0 ECU_ADDRESS 0xC0006B01 /end MEASUREMENT
/begin MEASUREMENT DFES_idxVisible15 "Sichtbarkeit aller Fehlerspeichereinträge" UBYTE DFES_OneToOne 1 100 0.00 255.0 ECU_ADDRESS 0xC0006B02 /end MEASUREMENT
/begin MEASUREMENT DFES_idxVisible16 "Sichtbarkeit aller Fehlerspeichereinträge" UBYTE DFES_OneToOne 1 100 0.00 255.0 ECU_ADDRESS 0xC0006B03 /end MEASUREMENT
/begin MEASUREMENT DFES_idxVisible17 "Sichtbarkeit aller Fehlerspeichereinträge" UBYTE DFES_OneToOne 1 100 0.00 255.0 ECU_ADDRESS 0xC0006B04 /end MEASUREMENT
/begin MEASUREMENT DFES_idxVisible18 "Sichtbarkeit aller Fehlerspeichereinträge" UBYTE DFES_OneToOne 1 100 0.00 255.0 ECU_ADDRESS 0xC0006B05 /end MEASUREMENT
/begin MEASUREMENT DFES_idxVisible19 "Sichtbarkeit aller Fehlerspeichereinträge" UBYTE DFES_OneToOne 1 100 0.00 255.0 ECU_ADDRESS 0xC0006B06 /end MEASUREMENT
/begin MEASUREMENT DFES_MonEvnt00 "Fehlerspeicherüberwachung: Event Id" UWORD DFES_Mon_Verb 1 100 0.00 32783.0000000 FORMAT "%13.7" ECU_ADDRESS 0xD00094C6 /end MEASUREMENT
/begin MEASUREMENT DFES_MonEvnt01 "Fehlerspeicherüberwachung: Event Id" UWORD DFES_Mon_Verb 1 100 0.00 32783.0000000 FORMAT "%13.7" ECU_ADDRESS 0xD00094C8 /end MEASUREMENT
/begin MEASUREMENT DFES_MonEvnt02 "Fehlerspeicherüberwachung: Event Id" UWORD DFES_Mon_Verb 1 100 0.00 32783.0000000 FORMAT "%13.7" ECU_ADDRESS 0xD00094CA /end MEASUREMENT
/begin MEASUREMENT DFES_MonEvnt03 "Fehlerspeicherüberwachung: Event Id" UWORD DFES_Mon_Verb 1 100 0.00 32783.0000000 FORMAT "%13.7" ECU_ADDRESS 0xD00094CC /end MEASUREMENT
/begin MEASUREMENT DFES_MonObjt00 "Fehlerspeicherüberwachung: Object Id" UWORD OneToOne 1 100 0.00 65535.00 ECU_ADDRESS 0xD00094CE /end MEASUREMENT
/begin MEASUREMENT DFES_MonObjt01 "Fehlerspeicherüberwachung: Object Id" UWORD OneToOne 1 100 0.00 65535.00 ECU_ADDRESS 0xD00094D0 /end MEASUREMENT
/begin MEASUREMENT DFES_MonObjt02 "Fehlerspeicherüberwachung: Object Id" UWORD OneToOne 1 100 0.00 65535.00 ECU_ADDRESS 0xD00094D2 /end MEASUREMENT
/begin MEASUREMENT DFES_MonObjt03 "Fehlerspeicherüberwachung: Object Id" UWORD OneToOne 1 100 0.00 65535.00 ECU_ADDRESS 0xD00094D4 /end MEASUREMENT
/begin MEASUREMENT DFES_MonParm00 "Fehlerspeicherüberwachung: parameter" UWORD OneToOne 1 100 0.00 65535.00 ECU_ADDRESS 0xD00094D6 /end MEASUREMENT
/begin MEASUREMENT DFES_MonParm01 "Fehlerspeicherüberwachung: parameter" UWORD OneToOne 1 100 0.00 65535.00 ECU_ADDRESS 0xD00094D8 /end MEASUREMENT
/begin MEASUREMENT DFES_MonParm02 "Fehlerspeicherüberwachung: parameter" UWORD OneToOne 1 100 0.00 65535.00 ECU_ADDRESS 0xD00094DA /end MEASUREMENT
/begin MEASUREMENT DFES_MonParm03 "Fehlerspeicherüberwachung: parameter" UWORD OneToOne 1 100 0.00 65535.00 ECU_ADDRESS 0xD00094DC /end MEASUREMENT
/begin COMPU_METHOD DFES_Mon_Verb "" TAB_VERB "%6.3" "-" COMPU_TAB_REF DFES_Mon_Verb /end COMPU_METHOD
/begin COMPU_VTAB DFES_Mon_Verb "" TAB_VERB 30 0 "-----" 4097 "entry_rejected" 4098 "entry_preempted" 4099 "del_mismatch" 8196 "double entry" 8197 "no hash entry" 8198 "ok no tst - inkonsist" 8199 "ok tsted - inkonsist" 8200 "def tsted - inkonsist" 8201 "Counter exceeds" 8202 "MEM missing" 8203 "Hash 2 empty line" 8204 "retry entry" 8205 "Hash link exceeds" 8453 "invalid hash" 8454 "def no tst - inkonsist" 8457 "DEL Counter Serv ex" 8458 "MEM no Hash" 8461 "min hash line" 8709 "missing hash entry" 8713 "DEL Counter Pend ex" 8714 "Deb ok missing" 8717 "MIS MOD hashkey" 8969 "DEL Counter OBD ex" 8970 "Deb def missing" 8973 "insert line 2 hash" 16399 "pot_sus_ffr" 16655 "used_sus_ffr" 32782 "miss diumpr Fid" 32783 "miss dfc DFP" /end COMPU_VTAB
/begin COMPU_METHOD DFES_OneToOne "" RAT_FUNC "%6.0" "-" COEFFS 0 1 0 0 0 1 /end COMPU_METHOD
/begin COMPU_METHOD Eep_PostDrvState_Verb "" TAB_VERB "%6.3" "" COMPU_TAB_REF Eep_PostDrvState_Verb /end COMPU_METHOD
/begin COMPU_VTAB Eep_PostDrvState_Verb "" TAB_VERB 5 0 "EEP_POSTDRV_INI" 1 "EEP_POSTDRV_SEARCHBLKIDX" 2 "EEP_POEEP_POSTDRV_SAVEBLK" 3 "EEP_POSTDRV_SAVEBLK_PENDING" 4 "EEP_POSTDRV_WAIT" /end COMPU_VTAB
/begin COMPU_METHOD EGTFact "" RAT_FUNC "%6.5" "-" COEFFS 0 1000 0 0 0 1 /end COMPU_METHOD
/begin COMPU_METHOD EGTSwt "" RAT_FUNC "%10.9" "-" COEFFS 0 16384000 0 0 0 1 /end COMPU_METHOD
/begin COMPU_METHOD EMDMP_ATSINTVMOD_SY_Compu "" TAB_VERB "%6.3" "" COMPU_TAB_REF EMDMP_ATSINTVMOD_SY_Compu /end COMPU_METHOD
/begin COMPU_VTAB EMDMP_ATSINTVMOD_SY_Compu "" TAB_VERB 2 0 "False" 1 "True" /end COMPU_VTAB
/begin COMPU_METHOD EnergyPerMolHigh "" RAT_FUNC "%6.2" "J/mol" COEFFS 0 0.5 0 0 0 1 /end COMPU_METHOD
/begin COMPU_METHOD EnergyPerMolLow "" RAT_FUNC "%6.1" "J/mol" COEFFS 0 0.1 0 0 0 1 /end COMPU_METHOD
/begin COMPU_METHOD EngN_HiRes "" RAT_FUNC "%6.4" "rpm" COEFFS 0 32 0 0 0 1 /end COMPU_METHOD
/begin COMPU_METHOD ENGRESTRT_SY_Compu "" TAB_VERB "%6.3" "" COMPU_TAB_REF ENGRESTRT_SY_Compu /end COMPU_METHOD
/begin COMPU_VTAB ENGRESTRT_SY_Compu "" TAB_VERB 2 0 "0" 1 "1" /end COMPU_VTAB
/begin COMPU_METHOD EnrgPerMass "" RAT_FUNC "%6.3" "MJ/Kg" COEFFS 0 10 0 0 0 1 /end COMPU_METHOD
/begin COMPU_METHOD EPMRRS_SY_Compu "" TAB_VERB "%6.3" "" COMPU_TAB_REF EPMRRS_SY_Compu /end COMPU_METHOD
/begin COMPU_VTAB EPMRRS_SY_Compu "" TAB_VERB 5 0 "0" 1 "1" 2 "2" 3 "3" 4 "4" /end COMPU_VTAB
/begin COMPU_METHOD EPM_SYNCSLV_SY_Compu "" TAB_VERB "%6.3" "" COMPU_TAB_REF EPM_SYNCSLV_SY_Compu /end COMPU_METHOD
/begin COMPU_VTAB EPM_SYNCSLV_SY_Compu "" TAB_VERB 2 0 "0" 1 "1" /end COMPU_VTAB
/begin COMPU_METHOD Eta "" RAT_FUNC "%6.4" "Nm/(mg/cyc)" COEFFS 0 128 0 0 0 1 /end COMPU_METHOD
/begin COMPU_METHOD Eta2 "" RAT_FUNC "%6.4" "" COEFFS 0 128 0 0 0 1 /end COMPU_METHOD
/begin COMPU_METHOD ETCLB_NUMRAILPCLBPNT_SY_Compu "" TAB_VERB "%6.3" "" COMPU_TAB_REF ETCLB_NUMRAILPCLBPNT_SY_Compu /end COMPU_METHOD
/begin COMPU_VTAB ETCLB_NUMRAILPCLBPNT_SY_Compu "" TAB_VERB 7 1 "1" 2 "2" 3 "3" 4 "4" 5 "5" 6 "6" 7 "7" /end COMPU_VTAB
/begin COMPU_METHOD Exh_dmNOx_mg_p_s "" RAT_FUNC "%6.5" "mg/s" COEFFS 0 1000 0 0 0 1 /end COMPU_METHOD
/begin COMPU_METHOD Fact256 "" RAT_FUNC "%6.4" "-" COEFFS 0 256 0 0 0 1 /end COMPU_METHOD
/begin COMPU_METHOD Fact26 "" RAT_FUNC "%10.9" "-" COEFFS 0 67108864 0 0 0 1 /end COMPU_METHOD
/begin COMPU_METHOD Fact3 "" RAT_FUNC "%6.4" "-" COEFFS 0 100 0 0 0 1 /end COMPU_METHOD
/begin COMPU_METHOD Fact5 "" RAT_FUNC "%6.3" "-" COEFFS 0 2 0 0 0 1 /end COMPU_METHOD
/begin COMPU_METHOD Fact6 "" RAT_FUNC "%6.4" "-" COEFFS 0 500 0 0 0 1 /end COMPU_METHOD
/begin COMPU_METHOD Fact9 "" RAT_FUNC "%6.5" "-" COEFFS 0 5000 0 0 0 1 /end COMPU_METHOD
/begin COMPU_METHOD FactFine "" RAT_FUNC "%9.8" "-" COEFFS 0 1000000 0 0 0 1 /end COMPU_METHOD
/begin COMPU_METHOD FactLow1 "" RAT_FUNC "%6.4" "-" COEFFS 0 25 0 0 0 1 /end COMPU_METHOD
/begin COMPU_METHOD FactR "" RAT_FUNC "%6.1" "-" COEFFS 0 0.1 0 0 0 1 /end COMPU_METHOD
/begin COMPU_METHOD FactRev "" RAT_FUNC "%6.3" "-" COEFFS 0 10 0 0 0 1 /end COMPU_METHOD
/begin COMPU_METHOD OneToOne "" RAT_FUNC "%6.0" "-" COEFFS 0 1 0 0 0 1 /end COMPU_METHOD
/end MODULE
/end PROJECT

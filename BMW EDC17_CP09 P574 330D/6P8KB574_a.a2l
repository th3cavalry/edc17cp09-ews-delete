ASAP2_VERSION 1 4
/begin PROJECT P_574 "EDC17_CP09"
/begin HEADER "" VERSION "V8KB" PROJECT_NO P_574 /end HEADER
/begin MODULE DIM ""
/begin MOD_COMMON "" BYTE_ORDER MSB_LAST ALIGNMENT_BYTE 1 ALIGNMENT_WORD 2 ALIGNMENT_LONG 4 ALIGNMENT_FLOAT32_IEEE 4 /end MOD_COMMON
/begin CHARACTERISTIC KF_OZDREHKOR "Drehzahlkorrektur Niveau" MAP 0x80065554 MapTKF_UW_SW_SW 75.0000 Def_niv_sw_q0p146 -37.5000 37.5000 FORMAT "%7.4" EXTENDED_LIMITS -4800.00 4799.85
 /begin AXIS_DESCR STD_AXIS N_ozmw Def_n_sw_q1p0 16 -32768. 32767. FORMAT "%5.0" DEPOSIT ABSOLUTE /end AXIS_DESCR
 /begin AXIS_DESCR STD_AXIS Y_KF_OZDREHKOR_no_input_quantity Def_niv_uw_q0p293 3 0.00 19199.7 FORMAT "%7.1" DEPOSIT ABSOLUTE /end AXIS_DESCR
/end CHARACTERISTIC
/begin CHARACTERISTIC KF_OZKORRNIV "Niveaukorrektur nach Startzeit und Temperatur" MAP 0x800655DC MapTKF_UW_SW_SW 75.0000 Def_niv_sw_q0p293 -37.5000 37.5000 FORMAT "%7.4" EXTENDED_LIMITS -9600.00 9599.71
 /begin AXIS_DESCR STD_AXIS Oz_tempf Def_t_sw_q0p1 6 -3276.8 3276.7 FORMAT "%6.1" DEPOSIT ABSOLUTE /end AXIS_DESCR
 /begin AXIS_DESCR STD_AXIS Oz_nivzeit Def_td_uw_q0p01 6 0.00 655.350 FORMAT "%7.3" DEPOSIT ABSOLUTE /end AXIS_DESCR
/end CHARACTERISTIC
/begin CHARACTERISTIC KF_OZKORRORI "Kennfeld für die Korrektur des OriMw mit Abstellzeit und Öltemperatur" MAP 0x8006563E MapTKF_UW_SW_SW 75.0000 Def_niv_sw_q0p293 -37.5000 37.5000 FORMAT "%7.4" EXTENDED_LIMITS -9600.00 9599.71
 /begin AXIS_DESCR STD_AXIS Oz_tkorrori Def_t_sw_q0p1 4 -3276.8 3276.7 FORMAT "%6.1" DEPOSIT ABSOLUTE /end AXIS_DESCR
 /begin AXIS_DESCR STD_AXIS Tn_abstellm Def_tn_uw_q1 4 0.00 65535.0 FORMAT "%7.1" DEPOSIT ABSOLUTE /end AXIS_DESCR
/end CHARACTERISTIC
/begin CHARACTERISTIC KF_OZTEMPMDL "Öl-Modelltemperatur" MAP 0x800657C2 MapTKF_SW_SW_SW 6553.5 Def_t_sw_q0p1 -3276.8 3276.7 FORMAT "%6.1"
 /begin AXIS_DESCR STD_AXIS Tmot Def_t_sw_q0p01 4 -327.680 327.670 FORMAT "%7.3" DEPOSIT ABSOLUTE /end AXIS_DESCR
 /begin AXIS_DESCR STD_AXIS Nkw Def_n_sw_q1p0 4 -32768. 32767. FORMAT "%5.0" DEPOSIT ABSOLUTE /end AXIS_DESCR
/end CHARACTERISTIC
/begin CHARACTERISTIC KF_OZZEIT "Zusammenführüng Abstellzeit und Startzeit" MAP 0x80065670 MapTKF_UW_UW_UW 655.350 Def_td_uw_q0p01 0.00 655.350 FORMAT "%7.3"
 /begin AXIS_DESCR STD_AXIS Tn_start_10 Def_td_uw_q0p01 6 0.00 655.350 FORMAT "%7.3" DEPOSIT ABSOLUTE /end AXIS_DESCR
 /begin AXIS_DESCR STD_AXIS Oz_abstellm Def_tn_uw_q1 4 0.00 65535.0 FORMAT "%7.1" DEPOSIT ABSOLUTE /end AXIS_DESCR
/end CHARACTERISTIC
/begin CHARACTERISTIC KL_OZDREHKORI "Drehzahlkorrektur wärend der Orientierung" CURVE 0x800656B6 CurTKL_SW_VV_SW 75.0000 Def_niv_sw_q0p146 -37.5000 37.5000 FORMAT "%7.4" EXTENDED_LIMITS -4800.00 4799.85
 /begin AXIS_DESCR STD_AXIS N_ozmw Def_n_sw_q1p0 8 -32768. 32767. FORMAT "%5.0" DEPOSIT ABSOLUTE /end AXIS_DESCR
/end CHARACTERISTIC
/begin CHARACTERISTIC KL_OZKRZMW2 "Anzahl 10er Pakete für Steigungsberechnung in Abhängigkeit von der gefahrenen Strecke" CURVE 0x800656D8 CurTKL_UW_VV_UB 255. Def_dez_ub_q1 0.00 255. FORMAT "%3.0"
 /begin AXIS_DESCR STD_AXIS Oz_dkm Def_f_uw_b10 4 0.00 9.9998474 DEPOSIT ABSOLUTE /end AXIS_DESCR
/end CHARACTERISTIC
/begin CHARACTERISTIC KL_OZLBNIV "Korrektur der Längbeschleunigungseffekte beim 10er Paket QLT" CURVE 0x800656E6 CurTKL_SB_VV_SB 74.71 Def_niv_sb_b37p5 -37.50 37.21
 /begin AXIS_DESCR STD_AXIS Oz_lbmw Def_f_sb_b2 8 -2.000 1.984 DEPOSIT ABSOLUTE /end AXIS_DESCR
/end CHARACTERISTIC
/begin CHARACTERISTIC KL_OZLN "y = ln x" CURVE 0x800656F8 CurTKL_UW_VV_SW 1.999969482422 Def_f_sw_b1 -1.000000000000 0.9999694824219 FORMAT "%14.12"
 /begin AXIS_DESCR STD_AXIS Oz_pzdivp Def_f_uw_b2 6 0.00 1.999908447266 FORMAT "%14.12" EXTENDED_LIMITS 0.00 1.999969482422 DEPOSIT ABSOLUTE /end AXIS_DESCR
/end CHARACTERISTIC
/begin CHARACTERISTIC KL_OZNFDELTA "Delta für die Nachfüllerkennung" CURVE 0x80065712 CurTKL_UB_VV_UB 74.71 Def_niv_ub_b75 0.00 74.71
 /begin AXIS_DESCR STD_AXIS Oz_peillang Def_niv_ub_b75 6 0.00 74.71 DEPOSIT ABSOLUTE /end AXIS_DESCR
/end CHARACTERISTIC
/begin CHARACTERISTIC KL_OZNIV "Umwandlung dez-Wert in mm" CURVE 0x800654D4 CurTKL_UB_VV_UB 74.71 Def_niv_ub_b75 0.00 74.71
 /begin AXIS_DESCR STD_AXIS Oz_nivt Def_dez_ub_q1 6 0.00 255. FORMAT "%3.0" DEPOSIT ABSOLUTE /end AXIS_DESCR
/end CHARACTERISTIC
/begin CHARACTERISTIC KL_OZORBERO "Toleranz für Orientierungsmessung nach oben in mm" CURVE 0x80065720 CurTKL_UB_VV_UB 74.71 Def_niv_ub_b75 0.00 74.71
 /begin AXIS_DESCR STD_AXIS Oz_peillang Def_niv_ub_b75 6 0.00 74.71 DEPOSIT ABSOLUTE /end AXIS_DESCR
/end CHARACTERISTIC
/begin CHARACTERISTIC KL_OZPERMKL "Skalierungskennlinie Permittivität" CURVE 0x800654E2 CurTKL_UW_VV_UW 5.999908447266 Def_perm_uw_b6 0.00 5.999908447266 FORMAT "%14.12"
 /begin AXIS_DESCR STD_AXIS Oz_permt Def_dez_uw_q1 2 0.00 65535. FORMAT "%5.0" DEPOSIT ABSOLUTE /end AXIS_DESCR
/end CHARACTERISTIC
/begin CHARACTERISTIC KL_OZQBNIV "Korrektur der Querbeschleunigungseffekte beim 10er Paket QLT" CURVE 0x8006572E CurTKL_SB_VV_SB 74.71 Def_niv_sb_b37p5 -37.50 37.21
 /begin AXIS_DESCR STD_AXIS Oz_qbmw Def_f_sb_b2 8 -2.000 1.984 DEPOSIT ABSOLUTE /end AXIS_DESCR
/end CHARACTERISTIC
/begin CHARACTERISTIC KL_OZSTNIV "Korrektur der Steigungseffekte beim 20er Paket QLT" CURVE 0x80065740 CurTKL_SW_VV_SW 75.0000 Def_niv_sw_q0p293 -37.5000 37.5000 FORMAT "%7.4" EXTENDED_LIMITS -9600.00 9599.71
 /begin AXIS_DESCR STD_AXIS Oz_steigung Def_f_sw_b64 8 -64.00000 63.99805 DEPOSIT ABSOLUTE /end AXIS_DESCR
/end CHARACTERISTIC
/begin CHARACTERISTIC KL_OZTEMPKL "Für die Öltemperatur-Berechnung QLT" CURVE 0x800654EC CurTKL_UW_VV_SW 6553.5 Def_t_sw_q0p1 -3276.8 3276.7 FORMAT "%6.1"
 /begin AXIS_DESCR STD_AXIS Oz_tempt Def_dez_uw_q1 6 0.00 65535. FORMAT "%5.0" DEPOSIT ABSOLUTE /end AXIS_DESCR
/end CHARACTERISTIC
/begin CHARACTERISTIC KL_TKTOENIV "Umsetzung Tk -> Oelnivau" CURVE 0x80065506 CurTKL_UW_VV_UW 75.000 Def_td_uw_q0p1 0.00 75.000 EXTENDED_LIMITS 0.00 6553.5
 /begin AXIS_DESCR STD_AXIS Td_og_tk Def_td_uw_q0p1 8 0.00 6553.5 FORMAT "%6.1" DEPOSIT ABSOLUTE /end AXIS_DESCR
/end CHARACTERISTIC
/begin CHARACTERISTIC KL_TVTOEL "Für die Öltemperatur-Berechnung Töns" CURVE 0x80065528 CurTKL_UW_VV_SW 6553.5 Def_t_sw_q0p1 -3276.8 3276.7 FORMAT "%6.1"
 /begin AXIS_DESCR STD_AXIS X_KL_TVTOEL_no_input_quantity Def_td_uw_q0p1 8 0.00 6553.5 FORMAT "%6.1" DEPOSIT ABSOLUTE /end AXIS_DESCR
/end CHARACTERISTIC
/begin CHARACTERISTIC K_CW_OZ "Codeword OZ 1" VALUE 0x80065762 Val_Wu16 65535. Def_dez_uw_q1 0.00 65535. FORMAT "%5.0" /end CHARACTERISTIC
/begin CHARACTERISTIC K_NACHFUELL12 "Nachfüll Erste Balken von Peistab" VALUE 0x80065764 Val_Wu8 255. Def_dez_ub_q1 0.00 255. FORMAT "%3.0" /end CHARACTERISTIC
/begin CHARACTERISTIC K_NACHFUELL25 "Nachfüll Zweite Balken von Peistab" VALUE 0x80065765 Val_Wu8 255. Def_dez_ub_q1 0.00 255. FORMAT "%3.0" /end CHARACTERISTIC
/begin CHARACTERISTIC K_NACHFUELL38 "Nachfüll Dritte Balken von Peistab" VALUE 0x80065766 Val_Wu8 255. Def_dez_ub_q1 0.00 255. FORMAT "%3.0" /end CHARACTERISTIC
/begin CHARACTERISTIC K_NACHFUELL53 "Nachfüll Vierte Balken von Peistab" VALUE 0x80065767 Val_Wu8 255. Def_dez_ub_q1 0.00 255. FORMAT "%3.0" /end CHARACTERISTIC
/begin CHARACTERISTIC K_NACHFUELL69 "Nachfüll Fünfte Balken von Peistab" VALUE 0x80065768 Val_Wu8 255. Def_dez_ub_q1 0.00 255. FORMAT "%3.0" /end CHARACTERISTIC
/begin CHARACTERISTIC K_NACHFUELL85 "Nachfüll Sechte Balken von Peistab" VALUE 0x80065769 Val_Wu8 255. Def_dez_ub_q1 0.00 255. FORMAT "%3.0" /end CHARACTERISTIC
/begin CHARACTERISTIC K_NACHFUELL95 "Nachfüll Siebte Balken von Peistab" VALUE 0x8006576A Val_Wu8 255. Def_dez_ub_q1 0.00 255. FORMAT "%3.0" /end CHARACTERISTIC
/begin CHARACTERISTIC K_OZABSTELL "Mindestwert für die Übernahme der Abstellzeit" VALUE 0x8006576C Val_Wu16 65535.0 Def_tn_uw_q1 0.00 65535.0 FORMAT "%7.1" /end CHARACTERISTIC
/begin CHARACTERISTIC K_OZABZORIVL "Mindest Abstellzeit für die Freigabe Ölverlustanzeige nach der Orientierung" VALUE 0x8006576E Val_Wu16 65535.0 Def_tn_uw_q1 0.00 65535.0 FORMAT "%7.1" /end CHARACTERISTIC
/begin CHARACTERISTIC K_OZALTANZABZ "Abstellzeit für die Ausgabe der letzten Anzeige nach dem Ölcheck" VALUE 0x80065770 Val_Wu16 65535.0 Def_tn_uw_q1 0.00 65535.0 FORMAT "%7.1" /end CHARACTERISTIC
/begin CHARACTERISTIC K_OZBESCHAUS "Zahl Ausgeblendet bei Lengsbescheunigung" VALUE 0x80065772 Val_Wu8 255. Def_dez_ub_q1 0.00 255. FORMAT "%3.0" /end CHARACTERISTIC
/begin CHARACTERISTIC K_OZDKNIVN "Ersatzwert für die Drehzahlkorrektur bei Oz_peilaltanz = 0" VALUE 0x80065773 Val_Wu8 74.71 Def_niv_ub_b75 0.00 74.71 /end CHARACTERISTIC
/begin CHARACTERISTIC K_OZFAKTORI "Faktor für die Gewichtung von Tmot/Toel bei der Ori-Korrektur" VALUE 0x80065774 Val_Wu8 0.99609 Def_f_ub_b1 0.00 0.99609 FORMAT "%7.5" /end CHARACTERISTIC
/begin CHARACTERISTIC K_OZLBESCHN "Negative Längsbeschleunigung Ausblendung-Schwelle" VALUE 0x80065775 Val_Ws8 63.8 Def_ac_sb_q0p25 -32.0 31.8 FORMAT "%4.1" /end CHARACTERISTIC
/begin CHARACTERISTIC K_OZLBESCHORI "Längsbeschleunigung Ausblendung-Schwelle beim OriMw" VALUE 0x80065776 Val_Ws8 63.8 Def_ac_sb_q0p25 -32.0 31.8 FORMAT "%4.1" /end CHARACTERISTIC
/begin CHARACTERISTIC K_OZLBESCHP "Positive Längsbeschleunigung Ausblendung-Schwelle" VALUE 0x80065777 Val_Ws8 63.8 Def_ac_sb_q0p25 -32.0 31.8 FORMAT "%4.1" /end CHARACTERISTIC
/begin CHARACTERISTIC K_OZLBESCHST "Längsbeschleunigung Ausblendung-Schwelle im Stand" VALUE 0x80065778 Val_Ws8 63.8 Def_ac_sb_q0p25 -32.0 31.8 FORMAT "%4.1" /end CHARACTERISTIC
/begin CHARACTERISTIC K_OZLUFTMAX "Plausibel max luftsprung" VALUE 0x8006577A Val_Wu16 2559.961 Def_p_uw_q039 0.00 2559.961 FORMAT "%8.3" /end CHARACTERISTIC
/begin CHARACTERISTIC K_OZMAXSLOPE "Maximale erlaubte Steigung" VALUE 0x8006577C Val_Ws16 127.9980 Def_f_sw_b64 -64.00000 63.99805 /end CHARACTERISTIC
/begin CHARACTERISTIC K_OZMINSLOPE "Kleinste erlaubte Steigung (<0)" VALUE 0x8006577E Val_Ws16 127.9980 Def_f_sw_b64 -64.00000 63.99805 /end CHARACTERISTIC
/begin CHARACTERISTIC K_OZMWK "Anzahl der Messwerte für Kurzzeit-Mittelwert Niveau" VALUE 0x80065780 Val_Wu8 255. Def_dez_ub_q1 0.00 255. FORMAT "%3.0" /end CHARACTERISTIC
/begin CHARACTERISTIC K_OZMWL "Anzahl der Messwerte für Langzeit-Mittelwert Niveau" VALUE 0x80065782 Val_Wu16 65535. Def_dez_uw_q1 0.00 65535. FORMAT "%5.0" /end CHARACTERISTIC
/begin CHARACTERISTIC K_OZMWOR "Anzahl der Messwerte für Orientierungsmessung" VALUE 0x80065784 Val_Wu16 65535. Def_dez_uw_q1 0.00 65535. FORMAT "%5.0" /end CHARACTERISTIC
/begin CHARACTERISTIC K_OZMWV "Anzahl der Messwerte für vorgezogenen Mittelwert Niveau" VALUE 0x80065786 Val_Wu16 65535. Def_dez_uw_q1 0.00 65535. FORMAT "%5.0" /end CHARACTERISTIC
/begin CHARACTERISTIC K_OZNFERR "Nachfüllmengenanzeige bei PreCheck OK" VALUE 0x80065788 Val_Wu8 255. Def_dez_ub_q1 0.00 255. FORMAT "%3.0" /end CHARACTERISTIC
/begin CHARACTERISTIC K_OZNFML "Nachfüllmengenanzeige bei Messung läuft" VALUE 0x80065789 Val_Wu8 255. Def_dez_ub_q1 0.00 255. FORMAT "%3.0" /end CHARACTERISTIC
/begin CHARACTERISTIC K_OZNFOELCKO "Nachfüllmengenanzeige bei PreCheck KO" VALUE 0x8006578A Val_Wu8 255. Def_dez_ub_q1 0.00 255. FORMAT "%3.0" /end CHARACTERISTIC
/begin CHARACTERISTIC K_OZNFOELCOK "Nachfüllmengenanzeige bei PreCheck OK" VALUE 0x8006578B Val_Wu8 255. Def_dez_ub_q1 0.00 255. FORMAT "%3.0" /end CHARACTERISTIC
/begin CHARACTERISTIC K_OZNMOTMAX "obere Drehzahlgrenze für drehzahlkorrigierten Niveaumittelwert" VALUE 0x8006578C Val_Ws16 65535. Def_n_sw_q1p0 -32768. 32767. FORMAT "%5.0" /end CHARACTERISTIC
/begin CHARACTERISTIC K_OZNMOTMIN "untere Drehzahlgrenze für drehzahlkorrigierten Niveaumittelwert" VALUE 0x8006578E Val_Ws16 65535. Def_n_sw_q1p0 -32768. 32767. FORMAT "%5.0" /end CHARACTERISTIC
/begin CHARACTERISTIC K_OZOELCABZ "Minimale Abstellzeit für den ÖlCheck" VALUE 0x80065790 Val_Wu16 65535.0 Def_tn_uw_q1 0.00 65535.0 FORMAT "%7.1" /end CHARACTERISTIC
/begin CHARACTERISTIC K_OZOELCOK "PreDriveCheck-Schwelle" VALUE 0x80065792 Val_Wu8 74.71 Def_niv_ub_b75 0.00 74.71 /end CHARACTERISTIC
/begin CHARACTERISTIC K_OZOELCVERZ "Verzögerung für den Ölcheck" VALUE 0x80065793 Val_Wu8 255.0 Def_td_ub_q1 0.00 255.0 FORMAT "%5.1" /end CHARACTERISTIC
/begin CHARACTERISTIC K_OZOELVERB "Ölverbrauch" VALUE 0x80065794 Val_Wu16 65535. Def_dez_uw_q1 0.00 65535. FORMAT "%5.0" /end CHARACTERISTIC
/begin CHARACTERISTIC K_OZORIPEILTZO "Ausgabeniveau für die tote Zone Orientierung-Check Peilstab mit alter Anzeige >= Mitte" VALUE 0x80065796 Val_Wu8 74.71 Def_niv_ub_b75 0.00 74.71 /end CHARACTERISTIC
/begin CHARACTERISTIC K_OZORIPEILTZU "Ausgabeniveau für die tote Zone Orientierung-Check Peilstab mit alter Anzeige < Mitte" VALUE 0x80065797 Val_Wu8 74.71 Def_niv_ub_b75 0.00 74.71 /end CHARACTERISTIC
/begin CHARACTERISTIC K_OZPEIL12 "Erste Balken von Peistab" VALUE 0x80065798 Val_Wu8 74.71 Def_niv_ub_b75 0.00 74.71 /end CHARACTERISTIC
/begin CHARACTERISTIC K_OZPEIL25 "Zweite Balken von Peistab" VALUE 0x80065799 Val_Wu8 74.71 Def_niv_ub_b75 0.00 74.71 /end CHARACTERISTIC
/begin CHARACTERISTIC K_OZPEIL38 "Dritte Balken von Peistab" VALUE 0x8006579A Val_Wu8 74.71 Def_niv_ub_b75 0.00 74.71 /end CHARACTERISTIC
/begin CHARACTERISTIC K_OZPEIL53 "Vierte Balken von Peistab" VALUE 0x8006579B Val_Wu8 74.71 Def_niv_ub_b75 0.00 74.71 /end CHARACTERISTIC
/begin CHARACTERISTIC K_OZPEIL69 "Fünfte Balken von Peistab" VALUE 0x8006579C Val_Wu8 74.71 Def_niv_ub_b75 0.00 74.71 /end CHARACTERISTIC
/begin CHARACTERISTIC K_OZPEIL85 "Sechte Balken von Peistab" VALUE 0x8006579D Val_Wu8 74.71 Def_niv_ub_b75 0.00 74.71 /end CHARACTERISTIC
/begin CHARACTERISTIC K_OZPEILDO "Delta + Hysterese Peilstab" VALUE 0x8006579E Val_Wu8 74.71 Def_niv_ub_b75 0.00 74.71 /end CHARACTERISTIC
/begin CHARACTERISTIC K_OZPEILDOMIN "Delta + Hysterese Peilstab bei Min" VALUE 0x8006579F Val_Wu8 74.71 Def_niv_ub_b75 0.00 74.71 /end CHARACTERISTIC
/begin CHARACTERISTIC K_OZPEILDU "Delta - Hysterese Peilstab" VALUE 0x800657A0 Val_Wu8 74.71 Def_niv_ub_b75 0.00 74.71 /end CHARACTERISTIC
/begin CHARACTERISTIC K_OZPEILDU38 "Delta - Hysterese Peilstab bei 1/4" VALUE 0x800657A1 Val_Wu8 74.71 Def_niv_ub_b75 0.00 74.71 /end CHARACTERISTIC
/begin CHARACTERISTIC K_OZPEILERR "Balkenanzeige im Fehlerfall" VALUE 0x800657A2 Val_Wu8 255. Def_dez_ub_q1 0.00 255. FORMAT "%3.0" /end CHARACTERISTIC
/begin CHARACTERISTIC K_OZPEILKSPR "Max zulässiger Niveau-Unterschied zwischen alten Anzeige und VorMw" VALUE 0x800657A3 Val_Wu8 74.71 Def_niv_ub_b75 0.00 74.71 /end CHARACTERISTIC
/begin CHARACTERISTIC K_OZPEILLP85 "Bankenanzeige für Niveau bei 85%" VALUE 0x800657A4 Val_Wu8 255. Def_dez_ub_q1 0.00 255. FORMAT "%3.0" /end CHARACTERISTIC
/begin CHARACTERISTIC K_OZPEILML "Balkenanzeige bei Messung läuft" VALUE 0x800657A5 Val_Wu8 255. Def_dez_ub_q1 0.00 255. FORMAT "%3.0" /end CHARACTERISTIC
/begin CHARACTERISTIC K_OZPEILOELCKO "Balkenanzeige bei ÖlCheck KO" VALUE 0x800657A6 Val_Wu8 255. Def_dez_ub_q1 0.00 255. FORMAT "%3.0" /end CHARACTERISTIC
/begin CHARACTERISTIC K_OZPEILOELCOK "Balkenanzeige bei ÖlCheck OK" VALUE 0x800657A7 Val_Wu8 255. Def_dez_ub_q1 0.00 255. FORMAT "%3.0" /end CHARACTERISTIC
/begin CHARACTERISTIC K_OZPEILSPRUNG "Max zulässiger Niveau-Unterschied zwischen LangMw" VALUE 0x800657A8 Val_Wu8 74.71 Def_niv_ub_b75 0.00 74.71 /end CHARACTERISTIC
/begin CHARACTERISTIC K_OZPERMRMIN "Grenze für Niveauberechnung aus Permittivität" VALUE 0x8006554A Val_Wu16 65535. Def_dez_uw_q1 0.00 65535. FORMAT "%5.0" /end CHARACTERISTIC
/begin CHARACTERISTIC K_OZPRREFMAX "Maximum für Referenzpermittivität" VALUE 0x8006554C Val_Wu16 1024. Def_dez_uw_q1 0.00 1024. FORMAT "%5.0" EXTENDED_LIMITS 0.00 65535. /end CHARACTERISTIC
/begin CHARACTERISTIC K_OZPRREFMIN "Minimum für Referenzpermittivität" VALUE 0x8006554E Val_Wu16 1024. Def_dez_uw_q1 0.00 1024. FORMAT "%5.0" EXTENDED_LIMITS 0.00 65535. /end CHARACTERISTIC
/begin CHARACTERISTIC K_OZQBESCHN "Negative Querbeschleunigung Ausblendung-Schwelle" VALUE 0x800657A9 Val_Ws8 63.8 Def_ac_sb_q0p25 -32.0 31.8 FORMAT "%4.1" /end CHARACTERISTIC
/begin CHARACTERISTIC K_OZQBESCHORI "Querbeschleunigung Ausblendung-Schwelle Beim OriMw" VALUE 0x800657AA Val_Ws8 63.8 Def_ac_sb_q0p25 -32.0 31.8 FORMAT "%4.1" /end CHARACTERISTIC
/begin CHARACTERISTIC K_OZQBESCHP "Positive Querbeschleunigung Ausblendung-Schwelle" VALUE 0x800657AB Val_Ws8 63.8 Def_ac_sb_q0p25 -32.0 31.8 FORMAT "%4.1" /end CHARACTERISTIC
/begin CHARACTERISTIC K_OZQBESCHST "Querbeschleunigung Ausblendung-Schwelle im Stand" VALUE 0x800657AC Val_Ws8 63.8 Def_ac_sb_q0p25 -32.0 31.8 FORMAT "%4.1" /end CHARACTERISTIC
/begin CHARACTERISTIC K_OZSTANDVERZ "Verzögerung für Fahrzeug steht" VALUE 0x800657AD Val_Wu8 255.0 Def_td_ub_q1 0.00 255.0 FORMAT "%5.1" /end CHARACTERISTIC
/begin CHARACTERISTIC K_OZSTARTABZ "Mindestlaufzeit für die Übernahme der Abstellzeit" VALUE 0x800657AE Val_Wu16 655.350 Def_td_uw_q0p01 0.00 655.350 FORMAT "%7.3" /end CHARACTERISTIC
/begin CHARACTERISTIC K_OZSTARTVERZ "QLT Start Verzögerung nach Drehzal" VALUE 0x800657B0 Val_Wu8 255.0 Def_td_ub_q1 0.00 255.0 FORMAT "%5.1" /end CHARACTERISTIC
/begin CHARACTERISTIC K_OZSTMINW "Minimale Strecke für die Steigungserkennung" VALUE 0x800657B2 Val_Wu16 9.9998474 Def_f_uw_b10 0.00 9.9998474 /end CHARACTERISTIC
/begin CHARACTERISTIC K_OZSTZYK "Max Permittivitätsfahler für die Niveau-Freigabe" VALUE 0x80065550 Val_Wu8 255. Def_dez_ub_q1 0.00 255. FORMAT "%3.0" /end CHARACTERISTIC
/begin CHARACTERISTIC K_OZTEMPBW "Temperaturschwelle Öltemperatur Motor betriebswarm" VALUE 0x800657B4 Val_Ws16 6553.5 Def_t_sw_q0p1 -3276.8 3276.7 FORMAT "%6.1" /end CHARACTERISTIC
/begin CHARACTERISTIC K_OZTLPF "Faktor für den LowPass-Filter Öltemperatur" VALUE 0x800657F4 Val_Wu16 99.99847 Def_f_uw_b100 0.00 99.99847 /end CHARACTERISTIC
/begin CHARACTERISTIC K_OZTLPFMDL "Faktor für den LowPass-Filter Öltemperatur beim Modelltemperatur" VALUE 0x800657F6 Val_Wu16 99.99847 Def_f_uw_b100 0.00 99.99847 /end CHARACTERISTIC
/begin CHARACTERISTIC K_OZTORMIN "Mindest Temperatur für OrientierungMw QLT" VALUE 0x800657B6 Val_Ws16 655.350 Def_t_sw_q0p01 -327.680 327.670 FORMAT "%7.3" /end CHARACTERISTIC
/begin CHARACTERISTIC K_OZTORMINF "Mindest Temperatur für OrientierungMw QLT während der Fahrt" VALUE 0x800657B8 Val_Ws16 655.350 Def_t_sw_q0p01 -327.680 327.670 FORMAT "%7.3" /end CHARACTERISTIC
/begin CHARACTERISTIC K_OZVERBFAK "Faktor für die Anpassung des Ölverbrauches" VALUE 0x800657BA Val_Wu8 7.969 Def_f_ub_b8 0.00 7.969 /end CHARACTERISTIC
/begin CHARACTERISTIC K_OZVERLORI "Schwelle für Orientierungswert Ölniveau (Verlustwarnung)" VALUE 0x800657BB Val_Wu8 74.71 Def_niv_ub_b75 0.00 74.71 /end CHARACTERISTIC
/begin CHARACTERISTIC K_OZVERZERRBSD "Verzögerung für Peilstab-Fehlerfall beim BSD-Fehler" VALUE 0x800657BC Val_Wu8 255.0 Def_td_ub_q1 0.00 255.0 FORMAT "%5.1" /end CHARACTERISTIC
/begin CHARACTERISTIC K_OZVORMV "Korrektur von Vormw für Peilstab" VALUE 0x800657BE Val_Ws16 63.999023 Def_f_sw_b32 -32.000000 31.999023 /end CHARACTERISTIC
/begin CHARACTERISTIC K_OZVORPEILMIN "Niveau Ausgabe (für die Peilstabanzeige) bei VorMw auf min und LangMw über 1/4" VALUE 0x800657C0 Val_Wu8 74.71 Def_niv_ub_b75 0.00 74.71 /end CHARACTERISTIC
/begin CHARACTERISTIC K_OZZINI "Zeit nach dem Abwürgen für den Aufruf des ini2-Prozess" VALUE 0x800657C1 Val_Wu8 255.0 Def_td_ub_q1 0.00 255.0 FORMAT "%5.1" /end CHARACTERISTIC
/begin CHARACTERISTIC K_TOGVERZOEG "Für das Überspringen der ersten Messungen Töns" VALUE 0x80065551 Val_Wu8 255. Def_dez_ub_q1 0.00 255. FORMAT "%3.0" /end CHARACTERISTIC
/begin CHARACTERISTIC K_TRTYP "Faktor für die Berechnung Öl-Temperatur Töns" VALUE 0x80065552 Val_Wu16 655.350 Def_td_uw_q0p01 0.00 655.350 FORMAT "%7.3" /end CHARACTERISTIC
/begin CHARACTERISTIC PCBS_dAvaiThres_C "" VALUE 0x8004EA20 Val_Wu8 255.0 OneToOne 0.00 255.0 /end CHARACTERISTIC
/begin CHARACTERISTIC PCBS_facCalcDistHighTrm_C "" VALUE 0x8004EA22 Val_Ws16 7.999878 Fact -4.000000 3.999878 /end CHARACTERISTIC
/begin CHARACTERISTIC PCBS_facCalcDistLowTrm_C "" VALUE 0x8004EA24 Val_Ws16 7.999878 Fact -4.000000 3.999878 /end CHARACTERISTIC
/begin CHARACTERISTIC PCBS_facFlTotDMEChg_C "" VALUE 0x8004EA26 Val_Ws16 65535.00 OneToOne -32768.00 32767.00 /end CHARACTERISTIC
/begin CHARACTERISTIC PCBS_kvbmwAux_C "" VALUE 0x8004EA28 Val_Wu32 524287.999878 Fuel_Cons 0.00 524287.999878 FORMAT "%13.6" /end CHARACTERISTIC
/begin CHARACTERISTIC PCBS_lAddThres_C "" VALUE 0x8004EA2C Val_Ws16 655350.0 km_sw_q10 -327680.0 327670.0 FORMAT "%8.1" /end CHARACTERISTIC
/begin CHARACTERISTIC PCBS_lCalcDistance_CUR "" CURVE 0x8004EA2E Cur_Xs16Ws16 305000.0 km_sw_q10 -5000.000 300000.0 FORMAT "%8.1" EXTENDED_LIMITS -327680.0 327670.0
 /begin AXIS_DESCR STD_AXIS PFltLd_mAshOilEG mSoot_g 8 -327.6800 327.6700 FORMAT "%8.4" DEPOSIT ABSOLUTE /end AXIS_DESCR
/end CHARACTERISTIC
/begin CHARACTERISTIC PCBS_lCalcProgWay_CUR "" CURVE 0x8004EA50 Cur_Xs16Ws16 256000.0 km_sw_q10 0.00 256000.0 FORMAT "%8.1" EXTENDED_LIMITS -327680.0 327670.0
 /begin AXIS_DESCR STD_AXIS PCBS_lSum1000_mp lProgWay 8 0.00 1000000. FORMAT "%8.0" EXTENDED_LIMITS 0.00 65535000. DEPOSIT ABSOLUTE /end AXIS_DESCR
/end CHARACTERISTIC
/begin CHARACTERISTIC PCBS_lDistCC_C "" VALUE 0x8004EA72 Val_Ws16 65535.00 OneToOne -32768.00 32767.00 /end CHARACTERISTIC
/begin CHARACTERISTIC PCBS_lDistInt_C "" VALUE 0x8004EA74 Val_Wu8 255000. lProgWay 0.00 255000. FORMAT "%5.0" /end CHARACTERISTIC
/begin CHARACTERISTIC PCBS_lDistMax_C "" VALUE 0x8004EA76 Val_Ws16 655350.0 km_sw_q10 -327680.0 327670.0 FORMAT "%8.1" /end CHARACTERISTIC
/begin CHARACTERISTIC PCBS_lDistMin_C "" VALUE 0x8004EA78 Val_Ws16 655350.0 km_sw_q10 -327680.0 327670.0 FORMAT "%8.1" /end CHARACTERISTIC
/begin CHARACTERISTIC PCBS_lDistMin_CUR "" CURVE 0x8004EA7A Cur_Xs16Ws16 300000.0 lProgWay 0.00 300000.0 FORMAT "%8.1" EXTENDED_LIMITS -32768000. 32767000.
 /begin AXIS_DESCR STD_AXIS PCBS_lDistDiff_mp lProgWay 8 -32768000. 32767000. FORMAT "%8.0" DEPOSIT ABSOLUTE /end AXIS_DESCR
/end CHARACTERISTIC
/begin CHARACTERISTIC PCBS_lf1tAux_C "" VALUE 0x8004EA9C Val_Wu8 2.550 Fact_PCBS 0.00 2.550 FORMAT "%5.3" /end CHARACTERISTIC
/begin CHARACTERISTIC PCBS_lJmpMax_C "" VALUE 0x8004EA9E Val_Ws16 655350.0 km_sw_q10 -327680.0 327670.0 FORMAT "%8.1" /end CHARACTERISTIC
/begin CHARACTERISTIC PCBS_lPFltDef_C "" VALUE 0x8004EAA0 Val_Ws16 655350.0 km_sw_q10 -327680.0 327670.0 FORMAT "%8.1" /end CHARACTERISTIC
/begin CHARACTERISTIC PCBS_lSumAux_C "" VALUE 0x8004EAA4 Val_Wu32 4294967295.00 OneToOne_km 0.00 4294967295.00 FORMAT "%13.2" /end CHARACTERISTIC
/begin CHARACTERISTIC PCBS_lSumDPFChngPred_CUR "" CURVE 0x8004EAA8 Cur_Xs16Ws16 2000000. km_sw_q100 0.00 2000000. FORMAT "%8.0" EXTENDED_LIMITS -3276800. 3276700.
 /begin AXIS_DESCR STD_AXIS PCBS_lSum1000_mp lProgWay 8 0.00 800000.0 FORMAT "%8.1" EXTENDED_LIMITS 0.00 65535000. DEPOSIT ABSOLUTE /end AXIS_DESCR
/end CHARACTERISTIC
/begin CHARACTERISTIC PCBS_lThresOut_C "" VALUE 0x8004EACA Val_Ws16 655350.0 km_sw_q10 -327680.0 327670.0 FORMAT "%8.1" /end CHARACTERISTIC
/begin CHARACTERISTIC PCBS_mAshOilDiff_C "" VALUE 0x8004EACC Val_Ws16 655.3500 mSoot_g -327.6800 327.6700 FORMAT "%8.4" /end CHARACTERISTIC
/begin CHARACTERISTIC PCBS_mAshOil_CUR "" CURVE 0x8004EACE Cur_Xs16Ws16 300.0000 mSoot_g 0.00 300.0000 FORMAT "%8.4" EXTENDED_LIMITS -327.6800 327.6700
 /begin AXIS_DESCR STD_AXIS PCBS_qFlTotDMEChg_mp Fl_2 6 -327680.0 327670.0 FORMAT "%8.1" DEPOSIT ABSOLUTE /end AXIS_DESCR
/end CHARACTERISTIC
/begin CHARACTERISTIC PCBS_qCalcFlTot_CUR "" CURVE 0x8004EAE8 Cur_Xs16Ws16 655350.0 Fl_2 -327680.0 327670.0 FORMAT "%8.1"
 /begin AXIS_DESCR STD_AXIS PCBS_dAvaiDMEChg_mp OneToOne 8 0.00 100.0 EXTENDED_LIMITS 0.00 255.0 DEPOSIT ABSOLUTE /end AXIS_DESCR
/end CHARACTERISTIC
/begin CHARACTERISTIC PCBS_qFlTotCorAux_C "" VALUE 0x8004EB0A Val_Ws16 655350.0 Fl_2 -327680.0 327670.0 FORMAT "%8.1" /end CHARACTERISTIC
/begin CHARACTERISTIC PCBS_qKvb_C "" VALUE 0x8004EB0C Val_Wu32 524287.999878 Fuel_Cons 0.00 524287.999878 FORMAT "%13.6" /end CHARACTERISTIC
/begin CHARACTERISTIC PCBS_rwanzAux_C "" VALUE 0x8004EB10 Val_Ws16 655350.0 km_sw_q10 -327680.0 327670.0 FORMAT "%8.1" /end CHARACTERISTIC
/begin CHARACTERISTIC PCBS_rwprogAux_C "" VALUE 0x8004EB12 Val_Wu16 655350.0 km_sw_q10 0.00 655350.0 FORMAT "%8.1" /end CHARACTERISTIC
/begin CHARACTERISTIC PCBS_swtAux_C "" VALUE 0x8004EB14 Val_Wu8 255.0 OneToOne 0.00 255.0 /end CHARACTERISTIC
/begin CHARACTERISTIC PCBS_swtSyncOff_C "" VALUE 0x8004EB15 Val_Wu8 255.0 OneToOne 0.00 255.0 /end CHARACTERISTIC
/begin CHARACTERISTIC PCBS_vfanzAux_C "" VALUE 0x8004EB16 Val_Wu8 255.0 OneToOne 0.00 255.0 /end CHARACTERISTIC
/begin CHARACTERISTIC PCR_APPDT1.T1_C "/" VALUE 0x80050C28 Kw_Ws32 4294.9672940 TimeDelay_s 0.000002000000001 4294.9672960 FORMAT "%12.7" /end CHARACTERISTIC
/begin CHARACTERISTIC PCR_APPDT1.Kd_C "/" VALUE 0x80050C2C Kw_Ws32 65535.9999847 Kd -32768.0000000 32767.9999847 FORMAT "%13.7" /end CHARACTERISTIC
/begin CHARACTERISTIC PCR_CldDT1Win.T1_C "Parameter für DT1-Glied bei kaltem Motor/" VALUE 0x80050C30 Kw_Ws32 4294.9662960 TimeDelay_s 0.0010000000689 4294.9672960 FORMAT "%12.7" EXTENDED_LIMITS 0.000002000000001 4294.9672960 /end CHARACTERISTIC
/begin CHARACTERISTIC PCR_CldDT1Win.Kd_C "Parameter für DT1-Glied bei kaltem Motor/" VALUE 0x80050C34 Kw_Ws32 65535.9999847 Kd -32768.0000000 32767.9999847 FORMAT "%13.7" /end CHARACTERISTIC
/begin CHARACTERISTIC PCR_CldDT1Win.KdPos_C "Parameter für DT1-Glied bei kaltem Motor/" VALUE 0x80050C38 Kw_Ws32 65535.9999847 Kd -32768.0000000 32767.9999847 FORMAT "%13.7" /end CHARACTERISTIC
/begin CHARACTERISTIC PCR_CldDT1Win.KdNeg_C "Parameter für DT1-Glied bei kaltem Motor/" VALUE 0x80050C3C Kw_Ws32 65535.9999847 Kd -32768.0000000 32767.9999847 FORMAT "%13.7" /end CHARACTERISTIC
/begin CHARACTERISTIC PCR_CldDT1Win.WinPos_C "Parameter für DT1-Glied bei kaltem Motor/" VALUE 0x80050C40 Kw_Ws32 2147487148.00 Pres_hPa -2147483648.00 3500.00 EXTENDED_LIMITS -2147483648.00 2147483647.00 /end CHARACTERISTIC
/begin CHARACTERISTIC PCR_CldDT1Win.WinNeg_C "Parameter für DT1-Glied bei kaltem Motor/" VALUE 0x80050C44 Kw_Ws32 2147487148.00 Pres_hPa -2147483648.00 3500.00 EXTENDED_LIMITS -2147483648.00 2147483647.00 /end CHARACTERISTIC
/begin CHARACTERISTIC PCR_DpCorrDT1.T1_C "/" VALUE 0x80053510 Kw_Ws32 4294.9672940 TimeDelay_s 0.000002000000001 4294.9672960 FORMAT "%12.7" /end CHARACTERISTIC
/begin CHARACTERISTIC PCR_DpCorrDT1.Kd_C "/" VALUE 0x80053514 Kw_Ws32 32767.9999924 Kd_Pres2dpdt -16384.0000000 16383.9999924 FORMAT "%13.7" /end CHARACTERISTIC
/begin CHARACTERISTIC PCR_dpDesAirCtlOff.Pos_C "/" VALUE 0x80050C48 Kw_Ws32 3949.99694824 RmpPres_hPa 50.0030517578 4000.00000000 FORMAT "%13.8" EXTENDED_LIMITS -32768000.0000 32767999.9847 /end CHARACTERISTIC
/begin CHARACTERISTIC PCR_dpDesAirCtlOff.Neg_C "/" VALUE 0x80050C4C Kw_Ws32 3949.99694824 RmpPres_hPa 50.0030517578 4000.00000000 FORMAT "%13.8" EXTENDED_LIMITS -32768000.0000 32767999.9847 /end CHARACTERISTIC
/begin CHARACTERISTIC PCR_dpDesT20Cor.Pos_C "/" VALUE 0x80050C50 Kw_Ws32 8000.00000000 RmpPres_hPa -4000.00000000 4000.00000000 FORMAT "%13.8" EXTENDED_LIMITS -32768000.0000 32767999.9847 /end CHARACTERISTIC
/begin CHARACTERISTIC PCR_dpDesT20Cor.Neg_C "/" VALUE 0x80050C54 Kw_Ws32 8000.00000000 RmpPres_hPa -4000.00000000 4000.00000000 FORMAT "%13.8" EXTENDED_LIMITS -32768000.0000 32767999.9847 /end CHARACTERISTIC
/begin CHARACTERISTIC PCR_dpDesTrbChPrtCor.Pos_C "/" VALUE 0x80050C58 Kw_Ws32 8000.00000000 RmpPres_hPa -4000.00000000 4000.00000000 FORMAT "%13.8" EXTENDED_LIMITS -32768000.0000 32767999.9847 /end CHARACTERISTIC
/begin CHARACTERISTIC PCR_dpDesTrbChPrtCor.Neg_C "/" VALUE 0x80050C5C Kw_Ws32 8000.00000000 RmpPres_hPa -4000.00000000 4000.00000000 FORMAT "%13.8" EXTENDED_LIMITS -32768000.0000 32767999.9847 /end CHARACTERISTIC
/begin CHARACTERISTIC PCR_dpDesValCalcLPLim.Pos_C "/" VALUE 0x80052758 Kw_Ws32 32767999.9847 RmpPres_hPa 0.00 32767999.9847 FORMAT "%13.4" EXTENDED_LIMITS -32768000.0000 32767999.9847 /end CHARACTERISTIC
/begin CHARACTERISTIC PCR_dpDesValCalcLPLim.Neg_C "/" VALUE 0x8005275C Kw_Ws32 32767999.9847 RmpPres_hPa 0.00 32767999.9847 FORMAT "%13.4" EXTENDED_LIMITS -32768000.0000 32767999.9847 /end CHARACTERISTIC
/begin CHARACTERISTIC PCR_dpMinGov_C "Untere Grenze des stationären Ladedruck-Sollwertgradient" VALUE 0x80053518 Val_Ws16 65535.00 PreshPa_sec -32768.00 32767.00 FORMAT "%8.2" /end CHARACTERISTIC
/begin CHARACTERISTIC PCR_dpSlpLimRmp.Pos_C "/" VALUE 0x80050C60 Kw_Ws32 32767999.9847 RmpPres_hPa 0.00 32767999.9847 FORMAT "%13.4" EXTENDED_LIMITS -32768000.0000 32767999.9847 /end CHARACTERISTIC
/begin CHARACTERISTIC PCR_dpSlpLimRmp.Neg_C "/" VALUE 0x80050C64 Kw_Ws32 32767999.9847 RmpPres_hPa 0.00 32767999.9847 FORMAT "%13.4" EXTENDED_LIMITS -32768000.0000 32767999.9847 /end CHARACTERISTIC
/begin CHARACTERISTIC PCR_drAirCtlOff.Pos_C "/" VALUE 0x8004EB20 Kw_Ws32 3000.00011921 RmpPrc -1500.00005960 1500.00005960 FORMAT "%13.8" EXTENDED_LIMITS -400000.000000 399999.999814 /end CHARACTERISTIC
/begin CHARACTERISTIC PCR_drAirCtlOff.Neg_C "/" VALUE 0x8004EB24 Kw_Ws32 3000.00011921 RmpPrc -1500.00005960 1500.00005960 FORMAT "%13.8" EXTENDED_LIMITS -400000.000000 399999.999814 /end CHARACTERISTIC
/begin CHARACTERISTIC PCR_drAPPUnFltPCRLP_C "" VALUE 0x80052760 Kw_Ws16 200.1953 PrcPerSec -100.0977 100.0977 FORMAT "%8.4" EXTENDED_LIMITS -20000.00 19999.39 /end CHARACTERISTIC
/begin CHARACTERISTIC PCR_drAPPUnFlt_C "Schwelle gefilterter PWG-Gradient für Sollwert-Abfallbegrenzung" VALUE 0x80050C68 Kw_Ws16 39999.39 PrcPerSec -20000.00 19999.39 FORMAT "%8.2" /end CHARACTERISTIC
/begin CHARACTERISTIC PCR_drChrgPmpCtlRmp.Pos_C "/" VALUE 0x8005351C Kw_Ws32 399999.999814 RmpPrc 0.00 399999.999814 FORMAT "%13.6" EXTENDED_LIMITS -400000.000000 399999.999814 /end CHARACTERISTIC
/begin CHARACTERISTIC PCR_drChrgPmpCtlRmp.Neg_C "/" VALUE 0x80053520 Kw_Ws32 399999.999814 RmpPrc 0.00 399999.999814 FORMAT "%13.6" EXTENDED_LIMITS -400000.000000 399999.999814 /end CHARACTERISTIC
/begin CHARACTERISTIC PCR_drGovMaxDyn.Pos_C "/" VALUE 0x80053524 Kw_Ws32 399999.999814 RmpPrc 0.00 399999.999814 FORMAT "%13.6" EXTENDED_LIMITS -400000.000000 399999.999814 /end CHARACTERISTIC
/begin CHARACTERISTIC PCR_drGovMaxDyn.Neg_C "/" VALUE 0x80053528 Kw_Ws32 399999.999814 RmpPrc 0.00 399999.999814 FORMAT "%13.6" EXTENDED_LIMITS -400000.000000 399999.999814 /end CHARACTERISTIC
/begin CHARACTERISTIC PCR_DT1Win.T1_C "Parameter für DT1-Glied/" VALUE 0x8005352C Kw_Ws32 4294.9662960 TimeDelay_s 0.0010000000689 4294.9672960 FORMAT "%12.7" EXTENDED_LIMITS 0.000002000000001 4294.9672960 /end CHARACTERISTIC
/begin CHARACTERISTIC PCR_DT1Win.Kd_C "Parameter für DT1-Glied/" VALUE 0x80053530 Kw_Ws32 9.99999996275 Kd_Pres_hPa2Prc 0.00 9.99999996275 FORMAT "%13.10" EXTENDED_LIMITS -400.000000000 399.999999814 /end CHARACTERISTIC
/begin CHARACTERISTIC PCR_DT1Win.KdPos_C "Parameter für DT1-Glied/" VALUE 0x80053534 Kw_Ws32 9.99999996275 Kd_Pres_hPa2Prc 0.00 9.99999996275 FORMAT "%13.10" EXTENDED_LIMITS -400.000000000 399.999999814 /end CHARACTERISTIC
/begin CHARACTERISTIC PCR_DT1Win.KdNeg_C "Parameter für DT1-Glied/" VALUE 0x80053538 Kw_Ws32 9.99999996275 Kd_Pres_hPa2Prc 0.00 9.99999996275 FORMAT "%13.10" EXTENDED_LIMITS -400.000000000 399.999999814 /end CHARACTERISTIC
/begin CHARACTERISTIC PCR_DT1Win.WinPos_C "Parameter für DT1-Glied/" VALUE 0x8005353C Kw_Ws32 8500.00000000 Pres_hPa -5000.00000000 3500.00000000 EXTENDED_LIMITS -2147483648.00 2147483647.00 /end CHARACTERISTIC
/begin CHARACTERISTIC PCR_DT1Win.WinNeg_C "Parameter für DT1-Glied/" VALUE 0x80053540 Kw_Ws32 8500.00000000 Pres_hPa -5000.00000000 3500.00000000 EXTENDED_LIMITS -2147483648.00 2147483647.00 /end CHARACTERISTIC
/begin CHARACTERISTIC PCR_facAirCtlCorNeg_MAP "" MAP 0x80053544 Kf_Xs16_Ys16_Ws16 4.000000 Fact 0.00 4.000000 EXTENDED_LIMITS -4.000000 3.999878
 /begin AXIS_DESCR STD_AXIS Epm_nEng EngN 8 20.00000 10000.00 EXTENDED_LIMITS -16384.00 16383.50 DEPOSIT ABSOLUTE /end AXIS_DESCR
 /begin AXIS_DESCR STD_AXIS PCR_qGov InjMass 8 0.00 327.6700 EXTENDED_LIMITS -327.6800 327.6700 DEPOSIT ABSOLUTE /end AXIS_DESCR
/end CHARACTERISTIC
/begin CHARACTERISTIC PCR_facAirCtlCorPos_MAP "" MAP 0x800535E8 Kf_Xs16_Ys16_Ws16 4.000000 Fact 0.00 4.000000 EXTENDED_LIMITS -4.000000 3.999878
 /begin AXIS_DESCR STD_AXIS Epm_nEng EngN 8 20.00000 10000.00 EXTENDED_LIMITS -16384.00 16383.50 DEPOSIT ABSOLUTE /end AXIS_DESCR
 /begin AXIS_DESCR STD_AXIS PCR_qGov InjMass 8 0.00 327.6700 EXTENDED_LIMITS -327.6800 327.6700 DEPOSIT ABSOLUTE /end AXIS_DESCR
/end CHARACTERISTIC
/begin CHARACTERISTIC PCR_facAirTempCtlACorLPEOM_CUR "" CURVE 0x80050298 Cur_Xs16Ws16 3.000000 Fact 0.00 3.000000 EXTENDED_LIMITS -4.000000 3.999878
 /begin AXIS_DESCR STD_AXIS PCR_tAirDesValLP Temp_Cels 8 -100.1400 199.8600 EXTENDED_LIMITS -3549.940 3003.560 DEPOSIT ABSOLUTE /end AXIS_DESCR
/end CHARACTERISTIC
/begin CHARACTERISTIC PCR_facAirTempCtlAutLPCor_CUR "" CURVE 0x800502BA Cur_Xs16Ws16 3.000000 Fact 0.00 3.000000 EXTENDED_LIMITS -4.000000 3.999878
 /begin AXIS_DESCR STD_AXIS PCR_tAirDesValLP Temp_Cels 8 -100.1400 199.8600 EXTENDED_LIMITS -3549.940 3003.560 DEPOSIT ABSOLUTE /end AXIS_DESCR
/end CHARACTERISTIC
/begin CHARACTERISTIC PCR_facAirTempCtlCorEOM_CUR "Faktor lufttemperaturabhängige Korrektur Vorsteuerung Betriebsart Rgn" CURVE 0x8004EB28 Cur_Xs16Ws16 3.000000 Fact 0.00 3.000000 EXTENDED_LIMITS -4.000000 3.999878
 /begin AXIS_DESCR STD_AXIS PCR_tAirCtlVal_mp Temp_Cels 8 -100.1400 199.8600 EXTENDED_LIMITS -3549.940 3003.560 DEPOSIT ABSOLUTE /end AXIS_DESCR
/end CHARACTERISTIC
/begin CHARACTERISTIC PCR_facAirTempCtlCor_CUR "Kennlinie: Lufttemperaturabhängiger Korrekturfaktor für den Ladedruck-Steueranteil" CURVE 0x8004EB4A Cur_Xs16Ws16 3.000000 Fact 0.00 3.000000 EXTENDED_LIMITS -4.000000 3.999878
 /begin AXIS_DESCR STD_AXIS PCR_tAirCtlVal_mp Temp_Cels 8 -100.1400 199.8600 EXTENDED_LIMITS -3549.940 3003.560 DEPOSIT ABSOLUTE /end AXIS_DESCR
/end CHARACTERISTIC
/begin CHARACTERISTIC PCR_facAirTempDesCorEOM_CUR "Kennlinie für den Temperatur-Korrekturfaktor des Ladedruck-Sollwertes bei alternativer Betriebsart" CURVE 0x80050C6A Cur_Xs16Ws16 3.000000 Fact 0.00 3.000000 EXTENDED_LIMITS -4.000000 3.999878
 /begin AXIS_DESCR STD_AXIS PCR_tAirDesVal_mp Temp_Cels 4 -100.1400 199.8600 EXTENDED_LIMITS -3549.940 3003.560 DEPOSIT ABSOLUTE /end AXIS_DESCR
/end CHARACTERISTIC
/begin CHARACTERISTIC PCR_facAirTempDesCorLPEOMQnt1_CUR "" CURVE 0x80052762 Cur_Xs16Ws16 3.000000 Fact 0.00 3.000000 EXTENDED_LIMITS -4.000000 3.999878
 /begin AXIS_DESCR STD_AXIS PCR_tAirDesValLP Temp_Cels 4 -100.1400 199.8600 EXTENDED_LIMITS -3549.940 3003.560 DEPOSIT ABSOLUTE /end AXIS_DESCR
/end CHARACTERISTIC
/begin CHARACTERISTIC PCR_facAirTempDesCorLPEOMQnt2_CUR "" CURVE 0x80052774 Cur_Xs16Ws16 3.000000 Fact 0.00 3.000000 EXTENDED_LIMITS -4.000000 3.999878
 /begin AXIS_DESCR STD_AXIS PCR_tAirDesValLP Temp_Cels 4 -100.1400 199.8600 EXTENDED_LIMITS -3549.940 3003.560 DEPOSIT ABSOLUTE /end AXIS_DESCR
/end CHARACTERISTIC
/begin CHARACTERISTIC PCR_facAirTempDesCorLP_CUR "" CURVE 0x80052786 Cur_Xs16Ws16 3.000000 Fact 0.00 3.000000 EXTENDED_LIMITS -4.000000 3.999878
 /begin AXIS_DESCR STD_AXIS PCR_tAirDesValLP Temp_Cels 4 -100.0400 199.8600 EXTENDED_LIMITS -3549.940 3003.560 DEPOSIT ABSOLUTE /end AXIS_DESCR
/end CHARACTERISTIC
/begin CHARACTERISTIC PCR_facAirTempDesCor_CUR "Kennlinie: Lufttemperaturabhängiger Korrekturfaktor für den Ladedruck-Sollwert" CURVE 0x80050C7C Cur_Xs16Ws16 3.000000 Fact 0.00 3.000000 EXTENDED_LIMITS -4.000000 3.999878
 /begin AXIS_DESCR STD_AXIS PCR_tAirDesVal_mp Temp_Cels 4 -100.1400 199.8600 EXTENDED_LIMITS -3549.940 3003.560 DEPOSIT ABSOLUTE /end AXIS_DESCR
/end CHARACTERISTIC
/begin CHARACTERISTIC PCR_facCByVlvRmp_CUR "" CURVE 0x800657F8 Cur_Xs16Ws16 3.000000 CoEOMSwt_S16 0.00 3.000000 FORMAT "%8.6" EXTENDED_LIMITS -2.000000 1.999939
 /begin AXIS_DESCR STD_AXIS CoEOM_facRmpVal CoEOMSwt_S16 8 -100.1400 199.8600 FORMAT "%8.4" EXTENDED_LIMITS -2.000000 1.999939 DEPOSIT ABSOLUTE /end AXIS_DESCR
/end CHARACTERISTIC
/begin CHARACTERISTIC PCR_facDpCorr_CUR "Kennlinie für Korrektur Adaptionsfaktor der D-Verstärkung" CURVE 0x8005368C Kl_Xs16_Ws16 511.9922 Fact1 -256.0000 255.9922
 /begin AXIS_DESCR STD_AXIS PCR_dpBGDev_mp dp_dZ20 10 -350000.0 350000.0 FORMAT "%8.1" EXTENDED_LIMITS -327680.0 327670.0 DEPOSIT ABSOLUTE /end AXIS_DESCR
/end CHARACTERISTIC
/begin CHARACTERISTIC PCR_facD_MAP "Adaptionsfaktor der D-Verstärkung des Ladedruckreglers" MAP 0x800536B6 Map_Xs16Ys16Ws16 50.00000 Fact1 0.00 50.00000 EXTENDED_LIMITS -256.0000 255.9922
 /begin AXIS_DESCR STD_AXIS Epm_nEng EngN 10 0.00 8000.000 EXTENDED_LIMITS -16384.00 16383.50 DEPOSIT ABSOLUTE /end AXIS_DESCR
 /begin AXIS_DESCR STD_AXIS PCR_qGov_mp InjMass 4 0.00 327.6700 EXTENDED_LIMITS -327.6800 327.6700 DEPOSIT ABSOLUTE /end AXIS_DESCR
/end CHARACTERISTIC
/begin CHARACTERISTIC PCR_facEngTempCtlCorLP_CUR "" CURVE 0x800502DC Cur_Xs16Ws16 300.0000 Fact -100.0000 200.0000 EXTENDED_LIMITS -4.000000 3.999878
 /begin AXIS_DESCR STD_AXIS PCR_tEngDesValLP Temp_Cels 6 -100.0400 7999.960 EXTENDED_LIMITS -3549.940 3003.560 DEPOSIT ABSOLUTE /end AXIS_DESCR
/end CHARACTERISTIC
/begin CHARACTERISTIC PCR_facEngTempCtlCor_MAP "Motortemperaturabhängiger Korrekturfaktor für den Ladedruck-Steueranteil" MAP 0x8004EB6C Kf_Xs16_Ys16_Ws16 300.0000 Fact -100.0000 200.0000 EXTENDED_LIMITS -4.000000 3.999878
 /begin AXIS_DESCR STD_AXIS PCR_tEngCtlVal_mp Temp_Cels 10 -100.0400 7999.960 EXTENDED_LIMITS -3549.940 3003.560 DEPOSIT ABSOLUTE /end AXIS_DESCR
 /begin AXIS_DESCR STD_AXIS PCR_qCtlVal_mp InjMass 10 0.00 327.6700 EXTENDED_LIMITS -327.6800 327.6700 DEPOSIT ABSOLUTE /end AXIS_DESCR
/end CHARACTERISTIC
/begin CHARACTERISTIC PCR_facEnvPresCtlAirCtlCor_CUR "" CURVE 0x8004EC60 Cur_Xs16Ws16 2.000000 Fact 0.00 2.000000 EXTENDED_LIMITS -4.000000 3.999878
 /begin AXIS_DESCR STD_AXIS EnvP_p Pres_hPa 8 0.00 3500.000 EXTENDED_LIMITS -32768.00 32767.00 DEPOSIT ABSOLUTE /end AXIS_DESCR
/end CHARACTERISTIC
/begin CHARACTERISTIC PCR_facEnvPresCtlCorAutLPEOMQnt1_CUR "" CURVE 0x800502F6 Cur_Xs16Ws16 2.000000 Fact -0.5000000 1.500000 EXTENDED_LIMITS -4.000000 3.999878
 /begin AXIS_DESCR STD_AXIS EnvP_p Pres_hPa 8 0.00 3500.000 EXTENDED_LIMITS -32768.00 32767.00 DEPOSIT ABSOLUTE /end AXIS_DESCR
/end CHARACTERISTIC
/begin CHARACTERISTIC PCR_facEnvPresCtlCorAutLP_CUR "" CURVE 0x80050318 Cur_Xs16Ws16 2.000000 Fact -0.5000000 1.500000 EXTENDED_LIMITS -4.000000 3.999878
 /begin AXIS_DESCR STD_AXIS EnvP_p Pres_hPa 8 0.00 3500.000 EXTENDED_LIMITS -32768.00 32767.00 DEPOSIT ABSOLUTE /end AXIS_DESCR
/end CHARACTERISTIC
/begin CHARACTERISTIC PCR_facEnvPresCtlCorEOMQnt1_CUR "Kennlinie: Atmosphärendruckabhängiger Korrekturfaktor für die Ladedruck-Steuerung für die erste auf Einspritzmenge basierte Betriebsart" CURVE 0x8004EC82 Cur_Xs16Ws16 2.000000 Fact -0.5000000 1.500000 EXTENDED_LIMITS -4.000000 3.999878
 /begin AXIS_DESCR STD_AXIS EnvP_p Pres_hPa 8 0.00 3500.000 EXTENDED_LIMITS -32768.00 32767.00 DEPOSIT ABSOLUTE /end AXIS_DESCR
/end CHARACTERISTIC
/begin CHARACTERISTIC PCR_facEnvPresCtlCorEOMQnt2_CUR "Kennlinie: Atmosphärendruckabhängiger Korrekturfaktor für die Ladedruck-Steuerung für die zweite auf Einspritzmenge basierte Betriebsart" CURVE 0x8004ECA4 Cur_Xs16Ws16 2.000000 Fact -0.5000000 1.500000 EXTENDED_LIMITS -4.000000 3.999878
 /begin AXIS_DESCR STD_AXIS EnvP_p Pres_hPa 8 0.00 3500.000 EXTENDED_LIMITS -32768.00 32767.00 DEPOSIT ABSOLUTE /end AXIS_DESCR
/end CHARACTERISTIC
/begin CHARACTERISTIC PCR_facEnvPresCtlCorLPEOMQnt1_CUR "" CURVE 0x8005033A Cur_Xs16Ws16 2.000000 Fact -0.5000000 1.500000 EXTENDED_LIMITS -4.000000 3.999878
 /begin AXIS_DESCR STD_AXIS EnvP_p Pres_hPa 8 0.00 3500.000 EXTENDED_LIMITS -32768.00 32767.00 DEPOSIT ABSOLUTE /end AXIS_DESCR
/end CHARACTERISTIC
/begin CHARACTERISTIC PCR_facEnvPresCtlCorLP_CUR "" CURVE 0x8005035C Cur_Xs16Ws16 2.000000 Fact -0.5000000 1.500000 EXTENDED_LIMITS -4.000000 3.999878
 /begin AXIS_DESCR STD_AXIS EnvP_p Pres_hPa 8 0.00 3500.000 EXTENDED_LIMITS -32768.00 32767.00 DEPOSIT ABSOLUTE /end AXIS_DESCR
/end CHARACTERISTIC
/begin CHARACTERISTIC PCR_facEnvPresCtlCor_CUR "Kennlinie: Atmosphärendruckabhängiger Korrekturfaktor für die Ladedruck-Steuerung" CURVE 0x8004ECC6 Cur_Xs16Ws16 2.000000 Fact -0.5000000 1.500000 EXTENDED_LIMITS -4.000000 3.999878
 /begin AXIS_DESCR STD_AXIS EnvP_p Pres_hPa 8 0.00 3500.000 EXTENDED_LIMITS -32768.00 32767.00 DEPOSIT ABSOLUTE /end AXIS_DESCR
/end CHARACTERISTIC
/begin CHARACTERISTIC PCR_facEnvPresDesAirCtlCor_CUR "" CURVE 0x80050C8E Cur_Xs16Ws16 4.000000 Fact 0.00 4.000000 EXTENDED_LIMITS -4.000000 3.999878
 /begin AXIS_DESCR STD_AXIS EnvP_p Pres_hPa 8 0.00 3500.000 EXTENDED_LIMITS -32768.00 32767.00 DEPOSIT ABSOLUTE /end AXIS_DESCR
/end CHARACTERISTIC
/begin CHARACTERISTIC PCR_facEnvPresDesCorEOMQnt1_CUR "Kennlinie: Atmosphärendruckabhängiger Korrekturfaktor für den Ladedruck-Sollwert bei der ersten auf Einspritzmenge basierten Betriebsart" CURVE 0x80050CB0 Cur_Xs16Ws16 2.000000 Fact -0.5000000 1.500000 EXTENDED_LIMITS -4.000000 3.999878
 /begin AXIS_DESCR STD_AXIS EnvP_p Pres_hPa 16 0.00 3500.000 EXTENDED_LIMITS -32768.00 32767.00 DEPOSIT ABSOLUTE /end AXIS_DESCR
/end CHARACTERISTIC
/begin CHARACTERISTIC PCR_facEnvPresDesCorEOMQnt2_CUR "Kennlinie: Atmosphärendruckabhängiger Korrekturfaktor für den Ladedruck-Sollwert bei der zweiten auf Einspritzmenge basierten Betriebsart" CURVE 0x80050CF2 Cur_Xs16Ws16 2.000000 Fact -0.5000000 1.500000 EXTENDED_LIMITS -4.000000 3.999878
 /begin AXIS_DESCR STD_AXIS EnvP_p Pres_hPa 16 0.00 3500.000 EXTENDED_LIMITS -32768.00 32767.00 DEPOSIT ABSOLUTE /end AXIS_DESCR
/end CHARACTERISTIC
/begin CHARACTERISTIC PCR_facEnvPresDesCorLPEOMQnt1_CUR "" CURVE 0x80052798 Cur_Xs16Ws16 2.000000 Fact -0.5000000 1.500000 EXTENDED_LIMITS -4.000000 3.999878
 /begin AXIS_DESCR STD_AXIS EnvP_p Pres_hPa 4 0.00 3500.000 EXTENDED_LIMITS -32768.00 32767.00 DEPOSIT ABSOLUTE /end AXIS_DESCR
/end CHARACTERISTIC
/begin CHARACTERISTIC PCR_facEnvPresDesCorLPEOMQnt2_CUR "" CURVE 0x800527AA Cur_Xs16Ws16 2.000000 Fact -0.5000000 1.500000 EXTENDED_LIMITS -4.000000 3.999878
 /begin AXIS_DESCR STD_AXIS EnvP_p Pres_hPa 4 0.00 3500.000 EXTENDED_LIMITS -32768.00 32767.00 DEPOSIT ABSOLUTE /end AXIS_DESCR
/end CHARACTERISTIC
/begin CHARACTERISTIC PCR_facEnvPresDesCorLP_CUR "" CURVE 0x800527BC Cur_Xs16Ws16 2.000000 Fact -0.5000000 1.500000 EXTENDED_LIMITS -4.000000 3.999878
 /begin AXIS_DESCR STD_AXIS EnvP_p Pres_hPa 8 0.00 3500.000 EXTENDED_LIMITS -32768.00 32767.00 DEPOSIT ABSOLUTE /end AXIS_DESCR
/end CHARACTERISTIC
/begin CHARACTERISTIC PCR_facEnvPresDesCor_CUR "Kennlinie: Atmosphärendruckabhängiger Korrekturfaktor für den Ladedruck-Sollwert" CURVE 0x80050D34 Cur_Xs16Ws16 2.000000 Fact -0.5000000 1.500000 EXTENDED_LIMITS -4.000000 3.999878
 /begin AXIS_DESCR STD_AXIS EnvP_p Pres_hPa 8 0.00 3500.000 EXTENDED_LIMITS -32768.00 32767.00 DEPOSIT ABSOLUTE /end AXIS_DESCR
/end CHARACTERISTIC
/begin CHARACTERISTIC PCR_facGovMaxCorr_CUR "Kennlinie zur Bestimmung eines zusätzlichen Einflußfaktors (abhängig von der Rußmasse im Partikelfilter) zur Beeinflussung der maximal zulässigen Stellgröße." CURVE 0x80053726 Kl_Xs16_Ws16 5.000000 Fact1 0.00 5.000000 EXTENDED_LIMITS -256.0000 255.9922
 /begin AXIS_DESCR STD_AXIS PFltLd_resFlwFltAbs Res_hPaHrPerCM 8 -3.276800 3.276700 FORMAT "%8.6" DEPOSIT ABSOLUTE /end AXIS_DESCR
/end CHARACTERISTIC
/begin CHARACTERISTIC PCR_facI_MAP "Kennfeld: Adaptionsfaktor der I-Verstärkung des Ladedruckreglers" MAP 0x80053748 Map_Xs16Ys16Ws16 0.3984375 Fact1 0.00 0.3984375 EXTENDED_LIMITS -256.0000 255.9922
 /begin AXIS_DESCR STD_AXIS Epm_nEng EngN 10 0.00 8000.000 EXTENDED_LIMITS -16384.00 16383.50 DEPOSIT ABSOLUTE /end AXIS_DESCR
 /begin AXIS_DESCR STD_AXIS PCR_qGov_mp InjMass 4 0.00 327.6700 EXTENDED_LIMITS -327.6800 327.6700 DEPOSIT ABSOLUTE /end AXIS_DESCR
/end CHARACTERISTIC
/begin CHARACTERISTIC PCR_facPFltLdCtlVal_CUR "Kennlinie für den Partikelfilterbeladungs-Korrekturfaktor des Ladedruck-Steuerwertes" CURVE 0x8004ECE8 Cur_Xs16Ws16 1.000000 Fact1 0.00 1.000000 EXTENDED_LIMITS -256.0000 255.9922
 /begin AXIS_DESCR STD_AXIS PFltLd_resFlwFltAbs Res_hPaHrPerCM 12 0.00 3.000000 FORMAT "%8.6" EXTENDED_LIMITS -3.276800 3.276700 DEPOSIT ABSOLUTE /end AXIS_DESCR
/end CHARACTERISTIC
/begin CHARACTERISTIC PCR_facPresPFltMax_CUR "Korrektur der Obergrenze der Ladedruckreglerstellgröße in Abhängigkeit vom Adaptierten Druck vor Partikelfilter" CURVE 0x800537B8 Cur_Xs16Ws16 7.999878 Fact -4.000000 3.999878
 /begin AXIS_DESCR STD_AXIS Exh_pAdapPPFltUs Pres_hPa 12 -32768.00 3500.00 EXTENDED_LIMITS -32768.00 32767.00 DEPOSIT ABSOLUTE /end AXIS_DESCR
/end CHARACTERISTIC
/begin CHARACTERISTIC PCR_facPresPFltMin_CUR "Korrektur der Untergrenze der Ladedruckreglerstellgröße in Abhängigkeit vom Adaptierten Druck vor Partikelfilte" CURVE 0x800537EA Cur_Xs16Ws16 7.999878 Fact -4.000000 3.999878
 /begin AXIS_DESCR STD_AXIS Exh_pAdapPPFltUs Pres_hPa 2 -32768.00 3500.00 EXTENDED_LIMITS -32768.00 32767.00 DEPOSIT ABSOLUTE /end AXIS_DESCR
/end CHARACTERISTIC
/begin CHARACTERISTIC PCR_facP_MAP "Kennfeld: Adaptionsfaktor der P-Verstärkung des Ladedruckreglers" MAP 0x800537F4 Map_Xs16Ys16Ws16 50.00000 Fact1 0.00 50.00000 EXTENDED_LIMITS -256.0000 255.9922
 /begin AXIS_DESCR STD_AXIS Epm_nEng EngN 10 0.00 8000.000 EXTENDED_LIMITS -16384.00 16383.50 DEPOSIT ABSOLUTE /end AXIS_DESCR
 /begin AXIS_DESCR STD_AXIS PCR_qGov_mp InjMass 4 0.00 327.6700 EXTENDED_LIMITS -327.6800 327.6700 DEPOSIT ABSOLUTE /end AXIS_DESCR
/end CHARACTERISTIC
/begin CHARACTERISTIC PCR_facResFlw_MAP "" MAP 0x80053864 Kf_Xs16_Ys16_Ws16 5.000000 Fact1 0.00 5.000000 EXTENDED_LIMITS -256.0000 255.9922
 /begin AXIS_DESCR STD_AXIS Epm_nEng EngN 10 0.00 8000.000 EXTENDED_LIMITS -16384.00 16383.50 DEPOSIT ABSOLUTE /end AXIS_DESCR
 /begin AXIS_DESCR STD_AXIS PFltLd_resFlwFltAbs Res_hPaHrPerCM 8 0.00 300.0000 FORMAT "%8.4" EXTENDED_LIMITS -3.276800 3.276700 DEPOSIT ABSOLUTE /end AXIS_DESCR
/end CHARACTERISTIC
/begin CHARACTERISTIC PCR_facRmpValCtlCorAutLP_CUR "" CURVE 0x8005037E Cur_Xs16Ws16 3.000000 CoEOMSwt_S16 0.00 3.000000 FORMAT "%8.6" EXTENDED_LIMITS -2.000000 1.999939
 /begin AXIS_DESCR STD_AXIS CoEOM_facRmpVal CoEOMSwt_S16 8 -100.1400 199.8600 FORMAT "%8.4" EXTENDED_LIMITS -2.000000 1.999939 DEPOSIT ABSOLUTE /end AXIS_DESCR
/end CHARACTERISTIC
/begin CHARACTERISTIC PCR_facRmpValCtlCorLP_CUR "" CURVE 0x800503A0 Cur_Xs16Ws16 3.000000 CoEOMSwt_S16 0.00 3.000000 FORMAT "%8.6" EXTENDED_LIMITS -2.000000 1.999939
 /begin AXIS_DESCR STD_AXIS CoEOM_facRmpVal CoEOMSwt_S16 8 -100.1400 199.8600 FORMAT "%8.4" EXTENDED_LIMITS -2.000000 1.999939 DEPOSIT ABSOLUTE /end AXIS_DESCR
/end CHARACTERISTIC
/begin CHARACTERISTIC PCR_facRmpValCtlCorQnt1_CUR "Kennlinie Rampesteigung der erste auf Einspritzmenge basierte Betriebsart des Ladedrucksteuerwert" CURVE 0x8004ED1A Cur_Xs16Ws16 3.000000 CoEOMSwt_S16 0.00 3.000000 FORMAT "%8.6" EXTENDED_LIMITS -2.000000 1.999939
 /begin AXIS_DESCR STD_AXIS PCR_facRmpCtlCor_mp CoEOMSwt_S16 10 0.00 3.000000 FORMAT "%8.6" EXTENDED_LIMITS -2.000000 1.999939 DEPOSIT ABSOLUTE /end AXIS_DESCR
/end CHARACTERISTIC
/begin CHARACTERISTIC PCR_facRmpValCtlCorQnt2_CUR "Kennlinie Rampesteigung der zweite auf Einspritzmenge basierte Betriebsart des Ladedrucksteuerwert" CURVE 0x8004ED44 Cur_Xs16Ws16 3.000000 CoEOMSwt_S16 0.00 3.000000 FORMAT "%8.6" EXTENDED_LIMITS -2.000000 1.999939
 /begin AXIS_DESCR STD_AXIS PCR_facRmpCtlCor_mp CoEOMSwt_S16 13 0.00 3.000000 FORMAT "%8.6" EXTENDED_LIMITS -2.000000 1.999939 DEPOSIT ABSOLUTE /end AXIS_DESCR
/end CHARACTERISTIC
/begin CHARACTERISTIC PCR_facRmpValDesCorLP_CUR "" CURVE 0x800527DE Cur_Xs16Ws16 3.000000 CoEOMSwt_S16 0.00 3.000000 FORMAT "%8.6" EXTENDED_LIMITS -2.000000 1.999939
 /begin AXIS_DESCR STD_AXIS CoEOM_facRmpVal CoEOMSwt_S16 10 -100.0000 199.0000 FORMAT "%8.4" EXTENDED_LIMITS -2.000000 1.999939 DEPOSIT ABSOLUTE /end AXIS_DESCR
/end CHARACTERISTIC
/begin CHARACTERISTIC PCR_facRmpValDesCorQnt1_CUR "Kennlinie Rampesteigung der erste auf Einspritzmenge basierte Betriebsart des Ladedrucksollwert" CURVE 0x80050D56 Cur_Xs16Ws16 3.000000 CoEOMSwt_S16 0.00 3.000000 FORMAT "%8.6" EXTENDED_LIMITS -2.000000 1.999939
 /begin AXIS_DESCR STD_AXIS PCR_facRmpDesCor_mp CoEOMSwt_S16 13 0.00 3.000000 FORMAT "%8.6" EXTENDED_LIMITS -2.000000 1.999939 DEPOSIT ABSOLUTE /end AXIS_DESCR
/end CHARACTERISTIC
/begin CHARACTERISTIC PCR_facRmpValDesCorQnt2_CUR "Kennlinie Rampesteigung der zweite auf Einspritzmenge basierte Betriebsart des Ladedrucksollwert" CURVE 0x80050D8C Cur_Xs16Ws16 3.000000 CoEOMSwt_S16 0.00 3.000000 FORMAT "%8.6" EXTENDED_LIMITS -2.000000 1.999939
 /begin AXIS_DESCR STD_AXIS PCR_facRmpDesCor_mp CoEOMSwt_S16 13 0.00 3.000000 FORMAT "%8.6" EXTENDED_LIMITS -2.000000 1.999939 DEPOSIT ABSOLUTE /end AXIS_DESCR
/end CHARACTERISTIC
/begin CHARACTERISTIC PCR_facRmpValDesCor_CUR "Korrekturkennlinie des zentralen EOM-Rampenwerts für die Sollwertberechnung" CURVE 0x80050DC2 Cur_Xs16Ws16 3.000000 CoEOMSwt_S16 0.00 3.000000 FORMAT "%8.6" EXTENDED_LIMITS -2.000000 1.999939
 /begin AXIS_DESCR STD_AXIS CoEOM_facRmpVal CoEOMSwt_S16 5 -100.0000 199.0000 FORMAT "%8.4" EXTENDED_LIMITS -2.000000 1.999939 DEPOSIT ABSOLUTE /end AXIS_DESCR
/end CHARACTERISTIC
/begin CHARACTERISTIC PCR_facT1_MAP "Adaptionsfaktor für Verzögerungszeit des DT1-Gliedes" MAP 0x8005392C Map_Xs16Ys16Ws16 50.00000 Fact1 0.00 50.00000 EXTENDED_LIMITS -256.0000 255.9922
 /begin AXIS_DESCR STD_AXIS Epm_nEng EngN 10 0.00 8000.000 EXTENDED_LIMITS -16384.00 16383.50 DEPOSIT ABSOLUTE /end AXIS_DESCR
 /begin AXIS_DESCR STD_AXIS PCR_qGov_mp InjMass 10 -327.6800 327.6700 DEPOSIT ABSOLUTE /end AXIS_DESCR
/end CHARACTERISTIC
/begin CHARACTERISTIC PCR_facTempDesCorEOMQnt1_MAP "Kennfeld: Motortemperaturabhängiger Korrekturfaktor für den Ladedruck-Sollwert für die erste auf Einspritzmenge basierte Betriebsart" MAP 0x80050DD8 Map_Xs16Ys16Ws16 4000.000 Fact 0.00 4000.000 EXTENDED_LIMITS -4.000000 3.999878
 /begin AXIS_DESCR STD_AXIS PCR_tDesVal_mp Temp_Cels 10 -100.1400 199.8600 EXTENDED_LIMITS -3549.940 3003.560 DEPOSIT ABSOLUTE /end AXIS_DESCR
 /begin AXIS_DESCR STD_AXIS PCR_qDesValInl_mp InjMass 2 0.00 200.0000 EXTENDED_LIMITS -327.6800 327.6700 DEPOSIT ABSOLUTE /end AXIS_DESCR
/end CHARACTERISTIC
/begin CHARACTERISTIC PCR_facTempDesCorEOMQnt2_MAP "Kennfeld: Motortemperaturabhängiger Korrekturfaktor für den Ladedruck-Sollwert für die zweite auf Einspritzmenge basierte Betriebsart" MAP 0x80050E1C Map_Xs16Ys16Ws16 4000.000 Fact 0.00 4000.000 EXTENDED_LIMITS -4.000000 3.999878
 /begin AXIS_DESCR STD_AXIS PCR_tDesVal_mp Temp_Cels 10 -100.1400 199.8600 EXTENDED_LIMITS -3549.940 3003.560 DEPOSIT ABSOLUTE /end AXIS_DESCR
 /begin AXIS_DESCR STD_AXIS PCR_qDesValInl_mp InjMass 2 0.00 200.0000 EXTENDED_LIMITS -327.6800 327.6700 DEPOSIT ABSOLUTE /end AXIS_DESCR
/end CHARACTERISTIC
/begin CHARACTERISTIC PCR_facTempDesCorLPEOMQnt1_CUR "" CURVE 0x80052808 Cur_Xs16Ws16 4000.000 Fact 0.00 4000.000 EXTENDED_LIMITS -4.000000 3.999878
 /begin AXIS_DESCR STD_AXIS PCR_tDesValLP_mp Temp_Cels 4 -100.1400 199.8600 EXTENDED_LIMITS -3549.940 3003.560 DEPOSIT ABSOLUTE /end AXIS_DESCR
/end CHARACTERISTIC
/begin CHARACTERISTIC PCR_facTempDesCorLPEOMQnt2_CUR "" CURVE 0x8005281A Cur_Xs16Ws16 4000.000 Fact 0.00 4000.000 EXTENDED_LIMITS -4.000000 3.999878
 /begin AXIS_DESCR STD_AXIS PCR_tDesValLP_mp Temp_Cels 4 -100.1400 199.8600 EXTENDED_LIMITS -3549.940 3003.560 DEPOSIT ABSOLUTE /end AXIS_DESCR
/end CHARACTERISTIC
/begin CHARACTERISTIC PCR_facTempDesCorLP_CUR "Kennfeld für temperaturabhängiges Korrekturverhalten für Ladedruck-Sollwert der Niederdruckstufe" CURVE 0x8005282C Cur_Xs16Ws16 100.0000 Fact 0.00 100.0000 EXTENDED_LIMITS -4.000000 3.999878
 /begin AXIS_DESCR STD_AXIS PCR_tDesValLP_mp Temp_Cels 4 -100.1400 199.8600 EXTENDED_LIMITS -3549.940 3003.560 DEPOSIT ABSOLUTE /end AXIS_DESCR
/end CHARACTERISTIC
/begin CHARACTERISTIC PCR_facTempDesCor_MAP "Kennfeld: Motortemperaturabhängiger Korrekturfaktor für den Ladedruck-Sollwert" MAP 0x80050E60 Kf_Xs16_Ys16_Ws16 7.999878 Fact -4.000000 3.999878
 /begin AXIS_DESCR STD_AXIS PCR_tDesVal_mp Temp_Cels 10 -100.1400 199.8600 EXTENDED_LIMITS -3549.940 3003.560 DEPOSIT ABSOLUTE /end AXIS_DESCR
 /begin AXIS_DESCR STD_AXIS PCR_qDesVal_mp InjMass 2 0.00 200.0000 EXTENDED_LIMITS -327.6800 327.6700 DEPOSIT ABSOLUTE /end AXIS_DESCR
/end CHARACTERISTIC
/begin CHARACTERISTIC PCR_GovMin_CUR "Kennlinie für minimalen Schwellwert der Einspritzmenge bzw. inneres Drehmoment" CURVE 0x80053A20 Cur_Xs16Ws16 200.0000 InjMass 0.00 200.0000 EXTENDED_LIMITS -327.6800 327.6700
 /begin AXIS_DESCR STD_AXIS Epm_nEng EngN 16 0.00 8000.000 EXTENDED_LIMITS -16384.00 16383.50 DEPOSIT ABSOLUTE /end AXIS_DESCR
/end CHARACTERISTIC
/begin CHARACTERISTIC PCR_GovOffAirMsTst_CUR "" CURVE 0x80053A62 Cur_Xs16Ws16 327.6700 InjMass 0.00 327.6700 EXTENDED_LIMITS -327.6800 327.6700
 /begin AXIS_DESCR STD_AXIS Epm_nEng EngN 16 0.00 8000.000 EXTENDED_LIMITS -16384.00 16383.50 DEPOSIT ABSOLUTE /end AXIS_DESCR
/end CHARACTERISTIC
/begin CHARACTERISTIC PCR_GovOffEOM_CUR "Kennlinie für untere Grenze der Einspritzmenge bzw. des inneren Drehmoments im Betriebsartmodus" CURVE 0x80053AA4 Cur_Xs16Ws16 327.6700 InjMass 0.00 327.6700 EXTENDED_LIMITS -327.6800 327.6700
 /begin AXIS_DESCR STD_AXIS Epm_nEng EngN 16 0.00 8000.000 EXTENDED_LIMITS -16384.00 16383.50 DEPOSIT ABSOLUTE /end AXIS_DESCR
/end CHARACTERISTIC
/begin CHARACTERISTIC PCR_GovOff_CUR "Kennlinie für untere Grenze der Einspritzmenge bzw. des inneren Drehmoments im Normalbetrieb" CURVE 0x80053AE6 Cur_Xs16Ws16 327.6700 InjMass 0.00 327.6700 EXTENDED_LIMITS -327.6800 327.6700
 /begin AXIS_DESCR STD_AXIS Epm_nEng EngN 16 0.00 8000.000 EXTENDED_LIMITS -16384.00 16383.50 DEPOSIT ABSOLUTE /end AXIS_DESCR
/end CHARACTERISTIC
/begin CHARACTERISTIC PCR_GovOnAirMsTst_CUR "" CURVE 0x80053B28 Cur_Xs16Ws16 327.6700 InjMass 0.00 327.6700 EXTENDED_LIMITS -327.6800 327.6700
 /begin AXIS_DESCR STD_AXIS Epm_nEng EngN 16 0.00 8000.000 EXTENDED_LIMITS -16384.00 16383.50 DEPOSIT ABSOLUTE /end AXIS_DESCR
/end CHARACTERISTIC
/begin CHARACTERISTIC PCR_GovOnEOM_CUR "Kennlinie für obere Grenze der Einspritzmenge bzw. des inneren Drehmoments im Betriebsartmodus" CURVE 0x80053B6A Cur_Xs16Ws16 327.6700 InjMass 0.00 327.6700 EXTENDED_LIMITS -327.6800 327.6700
 /begin AXIS_DESCR STD_AXIS Epm_nEng EngN 16 0.00 8000.000 EXTENDED_LIMITS -16384.00 16383.50 DEPOSIT ABSOLUTE /end AXIS_DESCR
/end CHARACTERISTIC
/begin CHARACTERISTIC PCR_GovOn_CUR "Kennlinie für obere Grenze der Einspritzmenge bzw. des inneren Drehmoments im Normalbetrieb" CURVE 0x80053BAC Cur_Xs16Ws16 327.6700 InjMass 0.00 327.6700 EXTENDED_LIMITS -327.6800 327.6700
 /begin AXIS_DESCR STD_AXIS Epm_nEng EngN 16 0.00 8000.000 EXTENDED_LIMITS -16384.00 16383.50 DEPOSIT ABSOLUTE /end AXIS_DESCR
/end CHARACTERISTIC
/begin CHARACTERISTIC PCR_GradPID.T1_C "/" VALUE 0x80053BF0 Kw_Ws32 3998.9384507 TimeDelay_ms 0.099999999907 3999.0384507 FORMAT "%12.7" EXTENDED_LIMITS 0.0020000000009 4294967.2960 /end CHARACTERISTIC
/begin CHARACTERISTIC PCR_GradPID.Kd_C "/" VALUE 0x80053BF4 Kw_Ws32 4.00000000000 Kd -2.00000000000 2.00000000000 FORMAT "%13.11" EXTENDED_LIMITS -32768.0000000 32767.9999847 /end CHARACTERISTIC
/begin CHARACTERISTIC PCR_I.Ki_C "Parameter für I-Regler/" VALUE 0x80053BF8 Kw_Ws32 1.50000118992 Ki_Pres_hPa2Prc 0.00 1.50000118992 FORMAT "%13.11" EXTENDED_LIMITS -12207.0312500 12207.0312443 /end CHARACTERISTIC
/begin CHARACTERISTIC PCR_I.KiPos_C "Parameter für I-Regler/" VALUE 0x80053BFC Kw_Ws32 1.50000118992 Ki_Pres_hPa2Prc 0.00 1.50000118992 FORMAT "%13.11" EXTENDED_LIMITS -12207.0312500 12207.0312443 /end CHARACTERISTIC
/begin CHARACTERISTIC PCR_I.KiNeg_C "Parameter für I-Regler/" VALUE 0x80053C00 Kw_Ws32 1.50000118992 Ki_Pres_hPa2Prc 0.00 1.50000118992 FORMAT "%13.11" EXTENDED_LIMITS -12207.0312500 12207.0312443 /end CHARACTERISTIC
/begin CHARACTERISTIC PCR_I.WinPos_C "Parameter für I-Regler/" VALUE 0x80053C04 Kw_Ws32 2147487148.00 Pres_hPa -2147483648.00 3500.00 EXTENDED_LIMITS -2147483648.00 2147483647.00 /end CHARACTERISTIC
/begin CHARACTERISTIC PCR_I.WinNeg_C "Parameter für I-Regler/" VALUE 0x80053C08 Kw_Ws32 2147487148.00 Pres_hPa -2147483648.00 3500.00 EXTENDED_LIMITS -2147483648.00 2147483647.00 /end CHARACTERISTIC
/begin CHARACTERISTIC PCR_IT20CorKiNeg_C "" VALUE 0x80050EA4 Val_Ws32 9999999.99534 Ki_Temp2Pres 0.00 9999999.99534 FORMAT "%13.5" EXTENDED_LIMITS -10000000.0000 9999999.99534 /end CHARACTERISTIC
/begin CHARACTERISTIC PCR_IT20CorKiPos_C "" VALUE 0x80050EA8 Val_Ws32 9999999.99534 Ki_Temp2Pres 0.00 9999999.99534 FORMAT "%13.5" EXTENDED_LIMITS -10000000.0000 9999999.99534 /end CHARACTERISTIC
/begin CHARACTERISTIC PCR_IT20CorKi_C "" VALUE 0x80050EAC Val_Ws32 9999999.99534 Ki_Temp2Pres 0.00 9999999.99534 FORMAT "%13.5" EXTENDED_LIMITS -10000000.0000 9999999.99534 /end CHARACTERISTIC
/begin CHARACTERISTIC PCR_ITrbChKiNeg_C "" VALUE 0x80050EB0 Val_Ws32 99999.9999534 Ki_TurboN2Pres 0.00 99999.9999534 FORMAT "%13.7" EXTENDED_LIMITS -100000.000000 99999.9999534 /end CHARACTERISTIC
/begin CHARACTERISTIC PCR_ITrbChKiPos_C "" VALUE 0x80050EB4 Val_Ws32 99999.9999534 Ki_TurboN2Pres 0.00 99999.9999534 FORMAT "%13.7" EXTENDED_LIMITS -100000.000000 99999.9999534 /end CHARACTERISTIC
/begin CHARACTERISTIC PCR_ITrbChKi_C "" VALUE 0x80050EB8 Val_Ws32 99999.9999534 Ki_TurboN2Pres 0.00 99999.9999534 FORMAT "%13.7" EXTENDED_LIMITS -100000.000000 99999.9999534 /end CHARACTERISTIC
/begin CHARACTERISTIC PCR_nLimMaxLP_C "" VALUE 0x8005283E Val_Ws16 6000.000 EngN 0.00 6000.000 EXTENDED_LIMITS -16384.00 16383.50 /end CHARACTERISTIC
/begin CHARACTERISTIC PCR_nLimMax_C "oberer Grenzwert für Motordrehzahl" VALUE 0x80050EBC Kw_Ws16 6000.000 EngN 0.00 6000.000 EXTENDED_LIMITS -16384.00 16383.50 /end CHARACTERISTIC
/begin CHARACTERISTIC PCR_nLimMinLP_C "" VALUE 0x80052840 Val_Ws16 6000.000 EngN 0.00 6000.000 EXTENDED_LIMITS -16384.00 16383.50 /end CHARACTERISTIC
/begin CHARACTERISTIC PCR_nLimMin_C "unterer Grenzwert für M otordrehzahl" VALUE 0x80050EBE Kw_Ws16 6000.000 EngN 0.00 6000.000 EXTENDED_LIMITS -16384.00 16383.50 /end CHARACTERISTIC
/begin CHARACTERISTIC PCR_nTrbChIWinNeg_C "" VALUE 0x80050EC0 Val_Ws32 300000.000000 TurboN 0.00 300000.000000 FORMAT "%13.6" EXTENDED_LIMITS -21474836480.0 21474836470.0 /end CHARACTERISTIC
/begin CHARACTERISTIC PCR_nTrbChIWinPos_C "" VALUE 0x80050EC4 Val_Ws32 300000.000000 TurboN 0.00 300000.000000 FORMAT "%13.6" EXTENDED_LIMITS -21474836480.0 21474836470.0 /end CHARACTERISTIC
/begin CHARACTERISTIC PCR_nTrbChPrtOfs_CUR "" CURVE 0x80050EC8 Cur_Xs16Ws16 200000.0 TurboN 0.00 200000.0 FORMAT "%8.1" EXTENDED_LIMITS -327680.0 327670.0
 /begin AXIS_DESCR STD_AXIS EnvP_p Pres_hPa 4 0.00 3500.000 EXTENDED_LIMITS -32768.00 32767.00 DEPOSIT ABSOLUTE /end AXIS_DESCR
/end CHARACTERISTIC
/begin CHARACTERISTIC PCR_nTrbChPrt_C "" VALUE 0x80050EDA Val_Ws16 300000.0 TurboN 0.00 300000.0 FORMAT "%8.1" EXTENDED_LIMITS -327680.0 327670.0 /end CHARACTERISTIC
/begin CHARACTERISTIC PCR_nTrbChPWinNeg_C "" VALUE 0x80050EDC Val_Ws32 300000.000000 TurboN 0.00 300000.000000 FORMAT "%13.6" EXTENDED_LIMITS -21474836480.0 21474836470.0 /end CHARACTERISTIC
/begin CHARACTERISTIC PCR_nTrbChPWinPos_C "" VALUE 0x80050EE0 Val_Ws32 300000.000000 TurboN 0.00 300000.000000 FORMAT "%13.6" EXTENDED_LIMITS -21474836480.0 21474836470.0 /end CHARACTERISTIC
/begin CHARACTERISTIC PCR_numAirTempCtlVal_C "Index zur Auswahl der Lufttemperatur für den Ladedruck-Steuranteil" VALUE 0x8004ED7A Val_Wu8 2.00000000000 AirTempFldSel 0.00 2.00000000000 FORMAT "%13.11" EXTENDED_LIMITS 0.00 3.00000000000 /end CHARACTERISTIC
/begin CHARACTERISTIC PCR_numAirTempDesValLP_C "" VALUE 0x80052842 Val_Wu8 2.00000000000 AirTempFldSel 0.00 2.00000000000 FORMAT "%13.11" EXTENDED_LIMITS 0.00 3.00000000000 /end CHARACTERISTIC
/begin CHARACTERISTIC PCR_numAirTempDesVal_C "Index zur Auswahl der Lufttemperatur für die Ladedruck-Sollwertberechnung" VALUE 0x80050EE4 Val_Wu8 2.00000000000 AirTempFldSel 0.00 2.00000000000 FORMAT "%13.11" EXTENDED_LIMITS 0.00 3.00000000000 /end CHARACTERISTIC
/begin CHARACTERISTIC PCR_numEngTempCtlVal_C "Index zur Auswahl der Motortemperatur für den Ladedruck-Steuranteil" VALUE 0x8004ED7B Val_Wu8 2.00000000000 EngTempFldSel 0.00 2.00000000000 FORMAT "%13.11" EXTENDED_LIMITS 0.00 3.00000000000 /end CHARACTERISTIC
/begin CHARACTERISTIC PCR_numEngTempDesValLP_C "" VALUE 0x80052843 Val_Wu8 2.00000000000 EngTempFldSel 0.00 2.00000000000 FORMAT "%13.11" EXTENDED_LIMITS 0.00 3.00000000000 /end CHARACTERISTIC
/begin CHARACTERISTIC PCR_numEngTempDesVal_C "Index zur Auswahl der Motortemperatur für die Ladedruck-Sollwertberechnung" VALUE 0x80050EE5 Val_Wu8 2.00000000000 EngTempFldSel 0.00 2.00000000000 FORMAT "%13.11" EXTENDED_LIMITS 0.00 3.00000000000 /end CHARACTERISTIC
/begin CHARACTERISTIC PCR_numEOMStgCtlCalc_MAP "Kennfeld zur Umschaltung der Rampenfaktorkennfelderder Steuerwertberechnung abhängig von der Betriebsart" MAP 0x8004ED7C Map_Xs16Ys16Ws16 65535.00 OneToOne -32768.00 32767.00
 /begin AXIS_DESCR STD_AXIS PCR_ActModeCtlCalc_mp OneToOne 3 0.00 255.0 DEPOSIT ABSOLUTE /end AXIS_DESCR
 /begin AXIS_DESCR STD_AXIS PCR_DesModeCtlCalc_mp OneToOne 3 0.00 255.0 DEPOSIT ABSOLUTE /end AXIS_DESCR
/end CHARACTERISTIC
/begin CHARACTERISTIC PCR_numEOMStgDesCalc_MAP "Kennfeld zur Umschaltung der Rampenfaktorkennfelderder Steuerwertberechnung abhängig von der Betriebsart" MAP 0x80050EE6 Map_Xs16Ys16Ws16 16.00000 OneToOne 0.00 16.00000 EXTENDED_LIMITS -32768.00 32767.00
 /begin AXIS_DESCR STD_AXIS PCR_ActModeDesCalc_mp OneToOne 3 0.00 16.00 EXTENDED_LIMITS 0.00 255.0 DEPOSIT ABSOLUTE /end AXIS_DESCR
 /begin AXIS_DESCR STD_AXIS PCR_DesModeDesCalc_mp OneToOne 3 0.00 16.00 EXTENDED_LIMITS 0.00 255.0 DEPOSIT ABSOLUTE /end AXIS_DESCR
/end CHARACTERISTIC
/begin CHARACTERISTIC PCR_numGearCByVlv_C "" VALUE 0x8006581A Val_Wu8 127.0 OneToOne 0.00 127.0 EXTENDED_LIMITS 0.00 255.0 /end CHARACTERISTIC
/begin CHARACTERISTIC PCR_P.Kp_C "Parameter für P-Regler/" VALUE 0x80053C0C Kw_Ws32 1599.99999963 Kp_Pres_hPa2Prc -800.000000000 799.999999627 FORMAT "%13.9" /end CHARACTERISTIC
/begin CHARACTERISTIC PCR_P.KpPos_C "Parameter für P-Regler/" VALUE 0x80053C10 Kw_Ws32 1599.99999963 Kp_Pres_hPa2Prc -800.000000000 799.999999627 FORMAT "%13.9" /end CHARACTERISTIC
/begin CHARACTERISTIC PCR_P.KpNeg_C "Parameter für P-Regler/" VALUE 0x80053C14 Kw_Ws32 1599.99999963 Kp_Pres_hPa2Prc -800.000000000 799.999999627 FORMAT "%13.9" /end CHARACTERISTIC
/begin CHARACTERISTIC PCR_P.WinPos_C "Parameter für P-Regler/" VALUE 0x80053C18 Kw_Ws32 2147487148.00 Pres_hPa -2147483648.00 3500.00 EXTENDED_LIMITS -2147483648.00 2147483647.00 /end CHARACTERISTIC
/begin CHARACTERISTIC PCR_P.WinNeg_C "Parameter für P-Regler/" VALUE 0x80053C1C Kw_Ws32 2147487148.00 Pres_hPa -2147483648.00 3500.00 EXTENDED_LIMITS -2147483648.00 2147483647.00 /end CHARACTERISTIC
/begin CHARACTERISTIC PCR_pDesBasAirCtlOffHiAltd_MAP "" MAP 0x80050F08 Map_Xs16Ys16Ws16 3500.000 Pres_hPa 0.00 3500.000 EXTENDED_LIMITS -32768.00 32767.00
 /begin AXIS_DESCR STD_AXIS Epm_nEng EngN 16 0.00 10000.00 EXTENDED_LIMITS -16384.00 16383.50 DEPOSIT ABSOLUTE /end AXIS_DESCR
 /begin AXIS_DESCR STD_AXIS PCR_qDesVal InjMass 16 0.00 327.6700 EXTENDED_LIMITS -327.6800 327.6700 DEPOSIT ABSOLUTE /end AXIS_DESCR
/end CHARACTERISTIC
/begin CHARACTERISTIC PCR_pDesBasAirCtlOff_MAP "" MAP 0x8005114C Map_Xs16Ys16Ws16 3500.000 Pres_hPa 0.00 3500.000 EXTENDED_LIMITS -32768.00 32767.00
 /begin AXIS_DESCR STD_AXIS Epm_nEng EngN 16 0.00 10000.00 EXTENDED_LIMITS -16384.00 16383.50 DEPOSIT ABSOLUTE /end AXIS_DESCR
 /begin AXIS_DESCR STD_AXIS PCR_qDesVal InjMass 16 0.00 327.6700 EXTENDED_LIMITS -327.6800 327.6700 DEPOSIT ABSOLUTE /end AXIS_DESCR
/end CHARACTERISTIC
/begin CHARACTERISTIC PCR_pDesBasEOMQnt1_MAP "Kennfeld: Basis-Ladedruck-Sollwert für die erste auf Einspritzmenge basierte Betriebsart" MAP 0x80051390 Map_Xs16Ys16Ws16 3500.000 Pres_hPa 0.00 3500.000 EXTENDED_LIMITS -32768.00 32767.00
 /begin AXIS_DESCR STD_AXIS Epm_nEng EngN 16 0.00 8000.000 EXTENDED_LIMITS -16384.00 16383.50 DEPOSIT ABSOLUTE /end AXIS_DESCR
 /begin AXIS_DESCR STD_AXIS PCR_qDesValInl_mp InjMass 16 0.00 200.0000 EXTENDED_LIMITS -327.6800 327.6700 DEPOSIT ABSOLUTE /end AXIS_DESCR
/end CHARACTERISTIC
/begin CHARACTERISTIC PCR_pDesBasEOMQnt2_MAP "Kennfeld: Basis-Ladedruck-Sollwert für die zweite auf Einspritzmenge basierte Betriebsart" MAP 0x800515D4 Map_Xs16Ys16Ws16 3500.000 Pres_hPa 0.00 3500.000 EXTENDED_LIMITS -32768.00 32767.00
 /begin AXIS_DESCR STD_AXIS Epm_nEng EngN 16 0.00 8000.000 EXTENDED_LIMITS -16384.00 16383.50 DEPOSIT ABSOLUTE /end AXIS_DESCR
 /begin AXIS_DESCR STD_AXIS PCR_qDesValInl_mp InjMass 16 0.00 200.0000 EXTENDED_LIMITS -327.6800 327.6700 DEPOSIT ABSOLUTE /end AXIS_DESCR
/end CHARACTERISTIC
/begin CHARACTERISTIC PCR_pDesBasHiAltdEOMQnt1_MAP "Kennfeld: höhenabhängiger Basis-Ladedruck-Sollwert für die erste auf Einspritzmenge basierte Betriebsart" MAP 0x80051818 Map_Xs16Ys16Ws16 3500.000 Pres_hPa 0.00 3500.000 EXTENDED_LIMITS -32768.00 32767.00
 /begin AXIS_DESCR STD_AXIS Epm_nEng EngN 16 0.00 8000.000 EXTENDED_LIMITS -16384.00 16383.50 DEPOSIT ABSOLUTE /end AXIS_DESCR
 /begin AXIS_DESCR STD_AXIS PCR_qDesValInl_mp InjMass 16 0.00 200.0000 EXTENDED_LIMITS -327.6800 327.6700 DEPOSIT ABSOLUTE /end AXIS_DESCR
/end CHARACTERISTIC
/begin CHARACTERISTIC PCR_pDesBasHiAltdEOMQnt2_MAP "Kennfeld: höhenabhängiger Basis-Ladedruck-Sollwert für die zweite auf Einspritzmenge basierte Betriebsart" MAP 0x80051A5C Map_Xs16Ys16Ws16 3500.000 Pres_hPa 0.00 3500.000 EXTENDED_LIMITS -32768.00 32767.00
 /begin AXIS_DESCR STD_AXIS Epm_nEng EngN 16 0.00 8000.000 EXTENDED_LIMITS -16384.00 16383.50 DEPOSIT ABSOLUTE /end AXIS_DESCR
 /begin AXIS_DESCR STD_AXIS PCR_qDesValInl_mp InjMass 16 0.00 200.0000 EXTENDED_LIMITS -327.6800 327.6700 DEPOSIT ABSOLUTE /end AXIS_DESCR
/end CHARACTERISTIC
/begin CHARACTERISTIC PCR_pDesBasHiAltd_MAP "Kennfeld: höhenabhängiger Basis-Ladedruck-Sollwert" MAP 0x80051CA0 Kf_Xs16_Ys16_Ws16 3500.000 Pres_hPa 0.00 3500.000 EXTENDED_LIMITS -32768.00 32767.00
 /begin AXIS_DESCR STD_AXIS Epm_nEng EngN 16 0.00 8000.000 EXTENDED_LIMITS -16384.00 16383.50 DEPOSIT ABSOLUTE /end AXIS_DESCR
 /begin AXIS_DESCR STD_AXIS PCR_qDesVal_mp InjMass 16 0.00 200.0000 EXTENDED_LIMITS -327.6800 327.6700 DEPOSIT ABSOLUTE /end AXIS_DESCR
/end CHARACTERISTIC
/begin CHARACTERISTIC PCR_pDesBasLPEOMQnt1_MAP "" MAP 0x80052844 Map_Xs16Ys16Ws16 36268.00 Pres_hPa -32768.00 3500.00 EXTENDED_LIMITS -32768.00 32767.00
 /begin AXIS_DESCR STD_AXIS Epm_nEng EngN 12 0.00 8000.000 EXTENDED_LIMITS -16384.00 16383.50 DEPOSIT ABSOLUTE /end AXIS_DESCR
 /begin AXIS_DESCR STD_AXIS PCR_qDesValInlLP_mp InjMass 12 0.00 200.0000 EXTENDED_LIMITS -327.6800 327.6700 DEPOSIT ABSOLUTE /end AXIS_DESCR
/end CHARACTERISTIC
/begin CHARACTERISTIC PCR_pDesBasLPEOMQnt2_MAP "" MAP 0x80052998 Map_Xs16Ys16Ws16 3500.000 Pres_hPa 0.00 3500.000 EXTENDED_LIMITS -32768.00 32767.00
 /begin AXIS_DESCR STD_AXIS Epm_nEng EngN 12 0.00 8000.000 EXTENDED_LIMITS -16384.00 16383.50 DEPOSIT ABSOLUTE /end AXIS_DESCR
 /begin AXIS_DESCR STD_AXIS PCR_qDesValInlLP_mp InjMass 12 0.00 200.0000 EXTENDED_LIMITS -327.6800 327.6700 DEPOSIT ABSOLUTE /end AXIS_DESCR
/end CHARACTERISTIC
/begin CHARACTERISTIC PCR_pDesBasLPHiAltdEOMQnt1_MAP "" MAP 0x80052AEC Map_Xs16Ys16Ws16 3500.000 Pres_hPa 0.00 3500.000 EXTENDED_LIMITS -32768.00 32767.00
 /begin AXIS_DESCR STD_AXIS Epm_nEng EngN 12 0.00 8000.000 EXTENDED_LIMITS -16384.00 16383.50 DEPOSIT ABSOLUTE /end AXIS_DESCR
 /begin AXIS_DESCR STD_AXIS PCR_qDesValInlLP_mp InjMass 12 0.00 200.0000 EXTENDED_LIMITS -327.6800 327.6700 DEPOSIT ABSOLUTE /end AXIS_DESCR
/end CHARACTERISTIC
/begin CHARACTERISTIC PCR_pDesBasLPHiAltdEOMQnt2_MAP "" MAP 0x80052C40 Map_Xs16Ys16Ws16 36268.00 Pres_hPa -32768.00 3500.00 EXTENDED_LIMITS -32768.00 32767.00
 /begin AXIS_DESCR STD_AXIS Epm_nEng EngN 12 0.00 8000.000 EXTENDED_LIMITS -16384.00 16383.50 DEPOSIT ABSOLUTE /end AXIS_DESCR
 /begin AXIS_DESCR STD_AXIS PCR_qDesValInlLP_mp InjMass 12 0.00 200.0000 EXTENDED_LIMITS -327.6800 327.6700 DEPOSIT ABSOLUTE /end AXIS_DESCR
/end CHARACTERISTIC
/begin CHARACTERISTIC PCR_pDesBasLPHiAltd_MAP "" MAP 0x80052D94 Kf_Xs16_Ys16_Ws16 3500.000 Pres_hPa 0.00 3500.000 EXTENDED_LIMITS -32768.00 32767.00
 /begin AXIS_DESCR STD_AXIS Epm_nEng EngN 16 0.00 8000.000 EXTENDED_LIMITS -16384.00 16383.50 DEPOSIT ABSOLUTE /end AXIS_DESCR
 /begin AXIS_DESCR STD_AXIS PCR_qDesValLP_mp InjMass 16 0.00 200.0000 EXTENDED_LIMITS -327.6800 327.6700 DEPOSIT ABSOLUTE /end AXIS_DESCR
/end CHARACTERISTIC
/begin CHARACTERISTIC PCR_pDesBasLP_MAP "" MAP 0x80052FD8 Kf_Xs16_Ys16_Ws16 3500.000 Pres_hPa 0.00 3500.000 EXTENDED_LIMITS -32768.00 32767.00
 /begin AXIS_DESCR STD_AXIS Epm_nEng EngN 16 0.00 8000.000 EXTENDED_LIMITS -16384.00 16383.50 DEPOSIT ABSOLUTE /end AXIS_DESCR
 /begin AXIS_DESCR STD_AXIS PCR_qDesValLP_mp InjMass 16 0.00 200.0000 EXTENDED_LIMITS -327.6800 327.6700 DEPOSIT ABSOLUTE /end AXIS_DESCR
/end CHARACTERISTIC
/begin CHARACTERISTIC PCR_pDesBas_MAP "Kennfeld: Basis-Ladedruck-Sollwert" MAP 0x80051EE4 Kf_Xs16_Ys16_Ws16 3500.000 Pres_hPa 0.00 3500.000 EXTENDED_LIMITS -32768.00 32767.00
 /begin AXIS_DESCR STD_AXIS Epm_nEng EngN 16 0.00 8000.000 EXTENDED_LIMITS -16384.00 16383.50 DEPOSIT ABSOLUTE /end AXIS_DESCR
 /begin AXIS_DESCR STD_AXIS PCR_qDesVal_mp InjMass 16 0.00 200.0000 EXTENDED_LIMITS -327.6800 327.6700 DEPOSIT ABSOLUTE /end AXIS_DESCR
/end CHARACTERISTIC
/begin CHARACTERISTIC PCR_pDesMonHiAltd_MAP "" MAP 0x80052128 Map_Xs16Ys16Ws16 3500.000 Pres_hPa 0.00 3500.000 EXTENDED_LIMITS -32768.00 32767.00
 /begin AXIS_DESCR STD_AXIS Epm_nEng EngN 8 0.00 10000.00 EXTENDED_LIMITS -16384.00 16383.50 DEPOSIT ABSOLUTE /end AXIS_DESCR
 /begin AXIS_DESCR STD_AXIS EnvP_p Pres_hPa 6 0.00 3500.000 EXTENDED_LIMITS -32768.00 32767.00 DEPOSIT ABSOLUTE /end AXIS_DESCR
/end CHARACTERISTIC
/begin CHARACTERISTIC PCR_pDesT20CorMin_C "" VALUE 0x800521A8 Val_Ws16 5500.000 Pres_hPa -2000.000 3500.000 EXTENDED_LIMITS -32768.00 32767.00 /end CHARACTERISTIC
/begin CHARACTERISTIC PCR_pDesTrbChPrtCorMin_C "" VALUE 0x800521AA Val_Ws16 5500.000 Pres_hPa -2000.000 3500.000 EXTENDED_LIMITS -32768.00 32767.00 /end CHARACTERISTIC
/begin CHARACTERISTIC PCR_pDesValCalcLPRmpInit_C "" VALUE 0x8005321C Val_Ws16 3500.000 Pres_hPa 0.00 3500.000 EXTENDED_LIMITS -32768.00 32767.00 /end CHARACTERISTIC
/begin CHARACTERISTIC PCR_pMaxDesValLP_MAP "" MAP 0x8005321E Map_Xs16Ys16Ws16 3500.000 Pres_hPa 0.00 3500.000 EXTENDED_LIMITS -32768.00 32767.00
 /begin AXIS_DESCR STD_AXIS Epm_nEng EngN 16 0.00 8000.000 EXTENDED_LIMITS -16384.00 16383.50 DEPOSIT ABSOLUTE /end AXIS_DESCR
 /begin AXIS_DESCR STD_AXIS EnvP_p Pres_hPa 16 0.00 3500.000 EXTENDED_LIMITS -32768.00 32767.00 DEPOSIT ABSOLUTE /end AXIS_DESCR
/end CHARACTERISTIC
/begin CHARACTERISTIC PCR_pMaxDesVal_MAP "Kennfeld für die obere Grenze des Ladedruck-Sollwerts" MAP 0x800521AC Map_Xs16Ys16Ws16 3500.000 Pres_hPa 0.00 3500.000 EXTENDED_LIMITS -32768.00 32767.00
 /begin AXIS_DESCR STD_AXIS Epm_nEng EngN 16 0.00 8000.000 EXTENDED_LIMITS -16384.00 16383.50 DEPOSIT ABSOLUTE /end AXIS_DESCR
 /begin AXIS_DESCR STD_AXIS EnvP_p Pres_hPa 16 0.00 3500.000 EXTENDED_LIMITS -32768.00 32767.00 DEPOSIT ABSOLUTE /end AXIS_DESCR
/end CHARACTERISTIC
/begin CHARACTERISTIC PCR_pMinDesValLP_C "" VALUE 0x80053462 Val_Ws16 3500.000 Pres_hPa 0.00 3500.000 EXTENDED_LIMITS -32768.00 32767.00 /end CHARACTERISTIC
/begin CHARACTERISTIC PCR_pMinDesVal_C "untere Grenze des Ladedruck-Sollwerts" VALUE 0x800523F0 Val_Ws16 3500.000 Pres_hPa 0.00 3500.000 EXTENDED_LIMITS -32768.00 32767.00 /end CHARACTERISTIC
/begin CHARACTERISTIC PCR_PT20CorKpNeg_C "" VALUE 0x800523F4 Val_Ws32 655359.999695 Kp_Temp2Pres 0.00 655359.999695 FORMAT "%13.6" EXTENDED_LIMITS -655360.000000 655359.999695 /end CHARACTERISTIC
/begin CHARACTERISTIC PCR_PT20CorKpPos_C "" VALUE 0x800523F8 Val_Ws32 655359.999695 Kp_Temp2Pres 0.00 655359.999695 FORMAT "%13.6" EXTENDED_LIMITS -655360.000000 655359.999695 /end CHARACTERISTIC
/begin CHARACTERISTIC PCR_PT20CorKp_C "" VALUE 0x800523FC Val_Ws32 655359.999695 Kp_Temp2Pres 0.00 655359.999695 FORMAT "%13.6" EXTENDED_LIMITS -655360.000000 655359.999695 /end CHARACTERISTIC
/begin CHARACTERISTIC PCR_pTempCorBasEOMQnt1_MAP "Kennfeld: Basis-Ladedruck-Sollwert der Motortemperaturkorrektur für die erste auf Einspritzmenge basierte Betriebsart" MAP 0x80052400 Map_Xs16Ys16Ws16 3500.000 Pres_hPa 0.00 3500.000 EXTENDED_LIMITS -32768.00 32767.00
 /begin AXIS_DESCR STD_AXIS Epm_nEng EngN 10 0.00 8000.000 EXTENDED_LIMITS -16384.00 16383.50 DEPOSIT ABSOLUTE /end AXIS_DESCR
 /begin AXIS_DESCR STD_AXIS PCR_qDesValInl_mp InjMass 10 0.00 200.0000 EXTENDED_LIMITS -327.6800 327.6700 DEPOSIT ABSOLUTE /end AXIS_DESCR
/end CHARACTERISTIC
/begin CHARACTERISTIC PCR_pTempCorBasEOMQnt2_MAP "Kennfeld: Basis-Ladedruck-Sollwert der Motortemperaturkorrektur für die zweite auf Einspritzmenge basierte Betriebsart" MAP 0x800524F4 Map_Xs16Ys16Ws16 3500.000 Pres_hPa 0.00 3500.000 EXTENDED_LIMITS -32768.00 32767.00
 /begin AXIS_DESCR STD_AXIS Epm_nEng EngN 10 0.00 8000.000 EXTENDED_LIMITS -16384.00 16383.50 DEPOSIT ABSOLUTE /end AXIS_DESCR
 /begin AXIS_DESCR STD_AXIS PCR_qDesValInl_mp InjMass 10 0.00 200.0000 EXTENDED_LIMITS -327.6800 327.6700 DEPOSIT ABSOLUTE /end AXIS_DESCR
/end CHARACTERISTIC
/begin CHARACTERISTIC PCR_pTempCorBasLPEOMQnt1_MAP "" MAP 0x80053464 Map_Xs16Ys16Ws16 3500.000 Pres_hPa 0.00 3500.000 EXTENDED_LIMITS -32768.00 32767.00
 /begin AXIS_DESCR STD_AXIS Epm_nEng EngN 4 0.00 8000.000 EXTENDED_LIMITS -16384.00 16383.50 DEPOSIT ABSOLUTE /end AXIS_DESCR
 /begin AXIS_DESCR STD_AXIS PCR_qDesValInlLP_mp InjMass 4 0.00 200.0000 EXTENDED_LIMITS -327.6800 327.6700 DEPOSIT ABSOLUTE /end AXIS_DESCR
/end CHARACTERISTIC
/begin CHARACTERISTIC PCR_pTempCorBasLPEOMQnt2_MAP "" MAP 0x80053498 Map_Xs16Ys16Ws16 3500.000 Pres_hPa 0.00 3500.000 EXTENDED_LIMITS -32768.00 32767.00
 /begin AXIS_DESCR STD_AXIS Epm_nEng EngN 4 0.00 8000.000 EXTENDED_LIMITS -16384.00 16383.50 DEPOSIT ABSOLUTE /end AXIS_DESCR
 /begin AXIS_DESCR STD_AXIS PCR_qDesValInlLP_mp InjMass 4 0.00 200.0000 EXTENDED_LIMITS -327.6800 327.6700 DEPOSIT ABSOLUTE /end AXIS_DESCR
/end CHARACTERISTIC
/begin CHARACTERISTIC PCR_pTempCorBasLP_MAP "" MAP 0x800534CC Map_Xs16Ys16Ws16 4000.000 default 0.00 4000.000 FORMAT "%8.3" EXTENDED_LIMITS -32768.00 32767.00
 /begin AXIS_DESCR STD_AXIS Epm_nEng EngN 4 0.00 8000.000 EXTENDED_LIMITS -16384.00 16383.50 DEPOSIT ABSOLUTE /end AXIS_DESCR
 /begin AXIS_DESCR STD_AXIS PCR_qDesVal InjMass 4 0.00 200.0000 EXTENDED_LIMITS -327.6800 327.6700 DEPOSIT ABSOLUTE /end AXIS_DESCR
/end CHARACTERISTIC
/begin CHARACTERISTIC PCR_pTempCorBas_MAP "Kennfeld: Basis-Ladedruck-Sollwert der Motortemperaturkorrektur" MAP 0x800525E8 Kf_Xs16_Ys16_Ws16 3500.000 Pres_hPa 0.00 3500.000 EXTENDED_LIMITS -32768.00 32767.00
 /begin AXIS_DESCR STD_AXIS Epm_nEng EngN 10 0.00 8000.000 EXTENDED_LIMITS -16384.00 16383.50 DEPOSIT ABSOLUTE /end AXIS_DESCR
 /begin AXIS_DESCR STD_AXIS PCR_qDesVal_mp InjMass 10 0.00 200.0000 EXTENDED_LIMITS -327.6800 327.6700 DEPOSIT ABSOLUTE /end AXIS_DESCR
/end CHARACTERISTIC
/begin CHARACTERISTIC PCR_PTrbChKpNeg_C "" VALUE 0x800526DC Val_Ws32 6553.59999695 Kp_TurboN2Pres 0.00 6553.59999695 FORMAT "%13.8" EXTENDED_LIMITS -6553.60000000 6553.59999695 /end CHARACTERISTIC
/begin CHARACTERISTIC PCR_PTrbChKpPos_C "" VALUE 0x800526E0 Val_Ws32 6553.59999695 Kp_TurboN2Pres 0.00 6553.59999695 FORMAT "%13.8" EXTENDED_LIMITS -6553.60000000 6553.59999695 /end CHARACTERISTIC
/begin CHARACTERISTIC PCR_PTrbChKp_C "" VALUE 0x800526E4 Val_Ws32 6553.59999695 Kp_TurboN2Pres 0.00 6553.59999695 FORMAT "%13.8" EXTENDED_LIMITS -6553.60000000 6553.59999695 /end CHARACTERISTIC
/begin CHARACTERISTIC PCR_qCByVlvCloseEOM1_MAP "" MAP 0x8006581C Map_Xs16Ys16Ws16 327.6700 InjMass 0.00 327.6700 EXTENDED_LIMITS -327.6800 327.6700
 /begin AXIS_DESCR STD_AXIS Epm_nEng EngN 12 0.00 6000.000 EXTENDED_LIMITS -16384.00 16383.50 DEPOSIT ABSOLUTE /end AXIS_DESCR
 /begin AXIS_DESCR STD_AXIS EnvP_p Pres_hPa 6 0.00 3500.000 EXTENDED_LIMITS -32768.00 32767.00 DEPOSIT ABSOLUTE /end AXIS_DESCR
/end CHARACTERISTIC
/begin CHARACTERISTIC PCR_qCByVlvClose_MAP "" MAP 0x800658D4 Map_Xs16Ys16Ws16 327.6700 InjMass 0.00 327.6700 EXTENDED_LIMITS -327.6800 327.6700
 /begin AXIS_DESCR STD_AXIS Epm_nEng EngN 12 0.00 6000.000 EXTENDED_LIMITS -16384.00 16383.50 DEPOSIT ABSOLUTE /end AXIS_DESCR
 /begin AXIS_DESCR STD_AXIS EnvP_p Pres_hPa 6 0.00 3500.000 EXTENDED_LIMITS -32768.00 32767.00 DEPOSIT ABSOLUTE /end AXIS_DESCR
/end CHARACTERISTIC
/begin CHARACTERISTIC PCR_qCByVlvOpnEOM1_MAP "" MAP 0x8006598C Map_Xs16Ys16Ws16 327.6700 InjMass 0.00 327.6700 EXTENDED_LIMITS -327.6800 327.6700
 /begin AXIS_DESCR STD_AXIS Epm_nEng EngN 12 0.00 6000.000 EXTENDED_LIMITS -16384.00 16383.50 DEPOSIT ABSOLUTE /end AXIS_DESCR
 /begin AXIS_DESCR STD_AXIS EnvP_p Pres_hPa 6 0.00 3500.000 EXTENDED_LIMITS -32768.00 32767.00 DEPOSIT ABSOLUTE /end AXIS_DESCR
/end CHARACTERISTIC
/begin CHARACTERISTIC PCR_qCByVlvOpn_MAP "" MAP 0x80065A44 Map_Xs16Ys16Ws16 327.6700 InjMass 0.00 327.6700 EXTENDED_LIMITS -327.6800 327.6700
 /begin AXIS_DESCR STD_AXIS Epm_nEng EngN 12 0.00 6000.000 EXTENDED_LIMITS -16384.00 16383.50 DEPOSIT ABSOLUTE /end AXIS_DESCR
 /begin AXIS_DESCR STD_AXIS EnvP_p Pres_hPa 6 0.00 3500.000 EXTENDED_LIMITS -32768.00 32767.00 DEPOSIT ABSOLUTE /end AXIS_DESCR
/end CHARACTERISTIC
/begin CHARACTERISTIC PCR_QntCByVlv.xVal_C "/" VALUE 0x80065AFC Kw_Wu8 1.000 OneToOne 0.00 1.000 EXTENDED_LIMITS 0.00 255.0 /end CHARACTERISTIC
/begin CHARACTERISTIC PCR_QntCByVlv.xTyp_C "/" VALUE 0x80065AFD Kw_Wu8 1.000 OneToOne 1.000 2.000 EXTENDED_LIMITS 0.00 255.0 /end CHARACTERISTIC
/begin CHARACTERISTIC PCR_rAirCtlCorDiff_CUR "" CURVE 0x80053C20 Cur_Xs16Ws16 200.0000 Prc -100.0000 100.0000 EXTENDED_LIMITS -400.0000 399.9878
 /begin AXIS_DESCR STD_AXIS PCR_drPID_mp PrcPerSec 12 0.00 100.0977 FORMAT "%8.4" EXTENDED_LIMITS -20000.00 19999.39 DEPOSIT ABSOLUTE /end AXIS_DESCR
/end CHARACTERISTIC
/begin CHARACTERISTIC PCR_rAirTempCtlACorBasLPEOM_MAP "" MAP 0x800503C2 Kf_Xs16_Ys16_Ws16 150.0000 Prc -50.00000 100.0000 EXTENDED_LIMITS -400.0000 399.9878
 /begin AXIS_DESCR STD_AXIS Epm_nEng EngN 8 20.00000 10000.00 EXTENDED_LIMITS -16384.00 16383.50 DEPOSIT ABSOLUTE /end AXIS_DESCR
 /begin AXIS_DESCR STD_AXIS PCR_qCtlVal InjMass 8 0.00 327.6700 EXTENDED_LIMITS -327.6800 327.6700 DEPOSIT ABSOLUTE /end AXIS_DESCR
/end CHARACTERISTIC
/begin CHARACTERISTIC PCR_rAirTempCtlAutLPCorBas_MAP "" MAP 0x80050466 Kf_Xs16_Ys16_Ws16 150.0000 Prc -50.00000 100.0000 EXTENDED_LIMITS -400.0000 399.9878
 /begin AXIS_DESCR STD_AXIS Epm_nEng EngN 8 20.00000 10000.00 EXTENDED_LIMITS -16384.00 16383.50 DEPOSIT ABSOLUTE /end AXIS_DESCR
 /begin AXIS_DESCR STD_AXIS PCR_qCtlVal InjMass 8 0.00 327.6700 EXTENDED_LIMITS -327.6800 327.6700 DEPOSIT ABSOLUTE /end AXIS_DESCR
/end CHARACTERISTIC
/begin CHARACTERISTIC PCR_rAirTempCtlCorBasEOM_MAP "" MAP 0x8004ED9E Kf_Xs16_Ys16_Ws16 150.0000 Prc -50.00000 100.0000 EXTENDED_LIMITS -400.0000 399.9878
 /begin AXIS_DESCR STD_AXIS Epm_nEng EngN 8 20.00000 10000.00 EXTENDED_LIMITS -16384.00 16383.50 DEPOSIT ABSOLUTE /end AXIS_DESCR
 /begin AXIS_DESCR STD_AXIS PCR_qCtlVal InjMass 8 0.00 327.6700 EXTENDED_LIMITS -327.6800 327.6700 DEPOSIT ABSOLUTE /end AXIS_DESCR
/end CHARACTERISTIC
/begin CHARACTERISTIC PCR_rAirTempCtlCorBas_MAP "Kennfeld für lufttemperaturabhängige Korrektur Vorsteuerung NormalMode" MAP 0x8004EE42 Kf_Xs16_Ys16_Ws16 799.9878 Prc -400.0000 399.9878
 /begin AXIS_DESCR STD_AXIS Epm_nEng EngN 8 0.00 6000.000 EXTENDED_LIMITS -16384.00 16383.50 DEPOSIT ABSOLUTE /end AXIS_DESCR
 /begin AXIS_DESCR STD_AXIS PCR_qCtlVal InjMass 8 0.00 100.0000 EXTENDED_LIMITS -327.6800 327.6700 DEPOSIT ABSOLUTE /end AXIS_DESCR
/end CHARACTERISTIC
/begin CHARACTERISTIC PCR_rCtlBasAirCtlOffHiAltd_MAP "" MAP 0x8004EEE6 Kf_Xs16_Ys16_Ws16 100.0000 Prc 0.00 100.0000 EXTENDED_LIMITS -400.0000 399.9878
 /begin AXIS_DESCR STD_AXIS Epm_nEng EngN 16 0.00 10000.00 EXTENDED_LIMITS -16384.00 16383.50 DEPOSIT ABSOLUTE /end AXIS_DESCR
 /begin AXIS_DESCR STD_AXIS PCR_qCtlVal InjMass 16 0.00 327.6700 EXTENDED_LIMITS -327.6800 327.6700 DEPOSIT ABSOLUTE /end AXIS_DESCR
/end CHARACTERISTIC
/begin CHARACTERISTIC PCR_rCtlBasAirCtlOff_MAP "" MAP 0x8004F12A Kf_Xs16_Ys16_Ws16 100.0000 Prc 0.00 100.0000 EXTENDED_LIMITS -400.0000 399.9878
 /begin AXIS_DESCR STD_AXIS Epm_nEng EngN 16 0.00 10000.00 EXTENDED_LIMITS -16384.00 16383.50 DEPOSIT ABSOLUTE /end AXIS_DESCR
 /begin AXIS_DESCR STD_AXIS PCR_qCtlVal InjMass 16 0.00 327.6700 EXTENDED_LIMITS -327.6800 327.6700 DEPOSIT ABSOLUTE /end AXIS_DESCR
/end CHARACTERISTIC
/begin CHARACTERISTIC PCR_rCtlBasAutLPEOMQnt1_MAP "" MAP 0x8005050A Map_Xs16Ys16Ws16 300.0000 Prc -100.0000 200.0000 EXTENDED_LIMITS -400.0000 399.9878
 /begin AXIS_DESCR STD_AXIS Epm_nEng EngN 12 0.00 8000.000 EXTENDED_LIMITS -16384.00 16383.50 DEPOSIT ABSOLUTE /end AXIS_DESCR
 /begin AXIS_DESCR STD_AXIS PCR_qCtlValInlAutLP_mp InjMass 12 0.00 200.0000 EXTENDED_LIMITS -327.6800 327.6700 DEPOSIT ABSOLUTE /end AXIS_DESCR
/end CHARACTERISTIC
/begin CHARACTERISTIC PCR_rCtlBasAutLPHiAltdEOMQnt1_MAP "" MAP 0x8005065E Map_Xs16Ys16Ws16 300.0000 Prc -100.0000 200.0000 EXTENDED_LIMITS -400.0000 399.9878
 /begin AXIS_DESCR STD_AXIS Epm_nEng EngN 6 0.00 8000.000 EXTENDED_LIMITS -16384.00 16383.50 DEPOSIT ABSOLUTE /end AXIS_DESCR
 /begin AXIS_DESCR STD_AXIS PCR_qCtlValInlAutLP_mp InjMass 6 0.00 200.0000 EXTENDED_LIMITS -327.6800 327.6700 DEPOSIT ABSOLUTE /end AXIS_DESCR
/end CHARACTERISTIC
/begin CHARACTERISTIC PCR_rCtlBasAutLPHiAltd_MAP "" MAP 0x800506C2 Kf_Xs16_Ys16_Ws16 300.0000 Prc -100.0000 200.0000 EXTENDED_LIMITS -400.0000 399.9878
 /begin AXIS_DESCR STD_AXIS Epm_nEng EngN 6 0.00 8000.000 EXTENDED_LIMITS -16384.00 16383.50 DEPOSIT ABSOLUTE /end AXIS_DESCR
 /begin AXIS_DESCR STD_AXIS PCR_qCtlValLP_mp InjMass 6 0.00 327.6700 EXTENDED_LIMITS -327.6800 327.6700 DEPOSIT ABSOLUTE /end AXIS_DESCR
/end CHARACTERISTIC
/begin CHARACTERISTIC PCR_rCtlBasAutLP_MAP "" MAP 0x80050726 Kf_Xs16_Ys16_Ws16 300.0000 Prc -100.0000 200.0000 EXTENDED_LIMITS -400.0000 399.9878
 /begin AXIS_DESCR STD_AXIS Epm_nEng EngN 6 0.00 8000.000 EXTENDED_LIMITS -16384.00 16383.50 DEPOSIT ABSOLUTE /end AXIS_DESCR
 /begin AXIS_DESCR STD_AXIS PCR_qCtlValLP_mp InjMass 6 0.00 327.6700 EXTENDED_LIMITS -327.6800 327.6700 DEPOSIT ABSOLUTE /end AXIS_DESCR
/end CHARACTERISTIC
/begin CHARACTERISTIC PCR_rCtlBasEOMQnt1_MAP "Kennfeld: Basiswert für den Ladedruck-Steueranteil für die erste auf Einspritzmenge basierte Betriebsart" MAP 0x8004F36E Map_Xs16Ys16Ws16 300.0000 Prc -100.0000 200.0000 EXTENDED_LIMITS -400.0000 399.9878
 /begin AXIS_DESCR STD_AXIS Epm_nEng EngN 16 0.00 8000.000 EXTENDED_LIMITS -16384.00 16383.50 DEPOSIT ABSOLUTE /end AXIS_DESCR
 /begin AXIS_DESCR STD_AXIS PCR_qCtlValInl_mp InjMass 16 0.00 200.0000 EXTENDED_LIMITS -327.6800 327.6700 DEPOSIT ABSOLUTE /end AXIS_DESCR
/end CHARACTERISTIC
/begin CHARACTERISTIC PCR_rCtlBasEOMQnt2_MAP "Kennfeld: Basiswert für den Ladedruck-Steueranteil für die zweite auf Einspritzmenge basierte Betriebsart" MAP 0x8004F5B2 Map_Xs16Ys16Ws16 300.0000 Prc -100.0000 200.0000 EXTENDED_LIMITS -400.0000 399.9878
 /begin AXIS_DESCR STD_AXIS Epm_nEng EngN 16 0.00 8000.000 EXTENDED_LIMITS -16384.00 16383.50 DEPOSIT ABSOLUTE /end AXIS_DESCR
 /begin AXIS_DESCR STD_AXIS PCR_qCtlValInl_mp InjMass 16 0.00 200.0000 EXTENDED_LIMITS -327.6800 327.6700 DEPOSIT ABSOLUTE /end AXIS_DESCR
/end CHARACTERISTIC
/begin CHARACTERISTIC PCR_rCtlBasHiAltdEOMQnt1_MAP "Kennfeld: Höhenbasiswert des Ladedruck-Steueranteils für die erste auf Einspritzmenge basierte Betriebsart" MAP 0x8004F7F6 Map_Xs16Ys16Ws16 300.0000 Prc -100.0000 200.0000 EXTENDED_LIMITS -400.0000 399.9878
 /begin AXIS_DESCR STD_AXIS Epm_nEng EngN 16 0.00 8000.000 EXTENDED_LIMITS -16384.00 16383.50 DEPOSIT ABSOLUTE /end AXIS_DESCR
 /begin AXIS_DESCR STD_AXIS PCR_qCtlValInl_mp InjMass 16 0.00 200.0000 EXTENDED_LIMITS -327.6800 327.6700 DEPOSIT ABSOLUTE /end AXIS_DESCR
/end CHARACTERISTIC
/begin CHARACTERISTIC PCR_rCtlBasHiAltdEOMQnt2_MAP "Kennfeld: Höhenbasiswert des Ladedruck-Steueranteils für die zweite auf Einspritzmenge basierte Betriebsart" MAP 0x8004FA3A Map_Xs16Ys16Ws16 300.0000 Prc -100.0000 200.0000 EXTENDED_LIMITS -400.0000 399.9878
 /begin AXIS_DESCR STD_AXIS Epm_nEng EngN 16 0.00 8000.000 EXTENDED_LIMITS -16384.00 16383.50 DEPOSIT ABSOLUTE /end AXIS_DESCR
 /begin AXIS_DESCR STD_AXIS PCR_qCtlValInl_mp InjMass 16 0.00 200.0000 EXTENDED_LIMITS -327.6800 327.6700 DEPOSIT ABSOLUTE /end AXIS_DESCR
/end CHARACTERISTIC
/begin CHARACTERISTIC PCR_rCtlBasHiAltd_MAP "Kennfeld: Höhenbasiswert des Ladedruck-Steueranteils" MAP 0x8004FC7E Kf_Xs16_Ys16_Ws16 300.0000 Prc -100.0000 200.0000 EXTENDED_LIMITS -400.0000 399.9878
 /begin AXIS_DESCR STD_AXIS Epm_nEng EngN 16 0.00 8000.000 EXTENDED_LIMITS -16384.00 16383.50 DEPOSIT ABSOLUTE /end AXIS_DESCR
 /begin AXIS_DESCR STD_AXIS PCR_qCtlVal_mp InjMass 16 0.00 327.6700 EXTENDED_LIMITS -327.6800 327.6700 DEPOSIT ABSOLUTE /end AXIS_DESCR
/end CHARACTERISTIC
/begin CHARACTERISTIC PCR_rCtlBasLPEOMQnt1_MAP "" MAP 0x8005078A Map_Xs16Ys16Ws16 300.0000 Prc -100.0000 200.0000 EXTENDED_LIMITS -400.0000 399.9878
 /begin AXIS_DESCR STD_AXIS Epm_nEng EngN 12 0.00 8000.000 EXTENDED_LIMITS -16384.00 16383.50 DEPOSIT ABSOLUTE /end AXIS_DESCR
 /begin AXIS_DESCR STD_AXIS PCR_qCtlValInlLP_mp InjMass 12 0.00 200.0000 EXTENDED_LIMITS -327.6800 327.6700 DEPOSIT ABSOLUTE /end AXIS_DESCR
/end CHARACTERISTIC
/begin CHARACTERISTIC PCR_rCtlBasLPHiAltdEOMQnt1_MAP "" MAP 0x800508DE Map_Xs16Ys16Ws16 300.0000 Prc -100.0000 200.0000 EXTENDED_LIMITS -400.0000 399.9878
 /begin AXIS_DESCR STD_AXIS Epm_nEng EngN 6 0.00 8000.000 EXTENDED_LIMITS -16384.00 16383.50 DEPOSIT ABSOLUTE /end AXIS_DESCR
 /begin AXIS_DESCR STD_AXIS PCR_qCtlValInlLP_mp InjMass 6 0.00 200.0000 EXTENDED_LIMITS -327.6800 327.6700 DEPOSIT ABSOLUTE /end AXIS_DESCR
/end CHARACTERISTIC
/begin CHARACTERISTIC PCR_rCtlBasLPHiAltd_MAP "" MAP 0x80050942 Kf_Xs16_Ys16_Ws16 300.0000 Prc -100.0000 200.0000 EXTENDED_LIMITS -400.0000 399.9878
 /begin AXIS_DESCR STD_AXIS Epm_nEng EngN 12 0.00 8000.000 EXTENDED_LIMITS -16384.00 16383.50 DEPOSIT ABSOLUTE /end AXIS_DESCR
 /begin AXIS_DESCR STD_AXIS PCR_qCtlValLP_mp InjMass 12 0.00 327.6700 EXTENDED_LIMITS -327.6800 327.6700 DEPOSIT ABSOLUTE /end AXIS_DESCR
/end CHARACTERISTIC
/begin CHARACTERISTIC PCR_rCtlBasLP_MAP "" MAP 0x80050A96 Kf_Xs16_Ys16_Ws16 300.0000 Prc -100.0000 200.0000 EXTENDED_LIMITS -400.0000 399.9878
 /begin AXIS_DESCR STD_AXIS Epm_nEng EngN 12 0.00 8000.000 EXTENDED_LIMITS -16384.00 16383.50 DEPOSIT ABSOLUTE /end AXIS_DESCR
 /begin AXIS_DESCR STD_AXIS PCR_qCtlValLP_mp InjMass 12 0.00 327.6700 EXTENDED_LIMITS -327.6800 327.6700 DEPOSIT ABSOLUTE /end AXIS_DESCR
/end CHARACTERISTIC
/begin CHARACTERISTIC PCR_rCtlBas_MAP "Basissteuerkennfeld für Ladedruck" MAP 0x8004FEC2 Kf_Xs16_Ys16_Ws16 300.0000 Prc -100.0000 200.0000 EXTENDED_LIMITS -400.0000 399.9878
 /begin AXIS_DESCR STD_AXIS Epm_nEng EngN 16 0.00 8000.000 EXTENDED_LIMITS -16384.00 16383.50 DEPOSIT ABSOLUTE /end AXIS_DESCR
 /begin AXIS_DESCR STD_AXIS PCR_qCtlVal_mp InjMass 16 0.00 327.6700 EXTENDED_LIMITS -327.6800 327.6700 DEPOSIT ABSOLUTE /end AXIS_DESCR
/end CHARACTERISTIC
/begin CHARACTERISTIC PCR_rCtlValPFltLd_MAP "Kennfled für betriebspunktabhängigen Korrekturwert zur Partikelfilterbeladungskorrektur für den Ladedruck-Steuerwert" MAP 0x80050106 Kf_Xs16_Ys16_Ws16 100.0000 Prc 0.00 100.0000 EXTENDED_LIMITS -400.0000 399.9878
 /begin AXIS_DESCR STD_AXIS Epm_nEng EngN 4 0.00 6000.000 EXTENDED_LIMITS -16384.00 16383.50 DEPOSIT ABSOLUTE /end AXIS_DESCR
 /begin AXIS_DESCR STD_AXIS PCR_qCtlVal_mp InjMass 4 -327.6800 327.6700 DEPOSIT ABSOLUTE /end AXIS_DESCR
/end CHARACTERISTIC
/begin CHARACTERISTIC PCR_RelAbs.xVal_C "Schalter zur Auswahl Absolutdruck oder Relativdruck für die Ladedruckregelung/" VALUE 0x80053C52 Kw_Wu8 1.000 OneToOne 0.00 1.000 EXTENDED_LIMITS 0.00 255.0 /end CHARACTERISTIC
/begin CHARACTERISTIC PCR_RelAbs.xTyp_C "Schalter zur Auswahl Absolutdruck oder Relativdruck für die Ladedruckregelung/" VALUE 0x80053C53 Kw_Wu8 1.000 OneToOne 1.000 2.000 EXTENDED_LIMITS 0.00 255.0 /end CHARACTERISTIC
/begin CHARACTERISTIC PCR_rEngTempCorBasLP_MAP "" MAP 0x80050BEA Kf_Xs16_Ys16_Ws16 300.0000 Prc -100.0000 200.0000 EXTENDED_LIMITS -400.0000 399.9878
 /begin AXIS_DESCR STD_AXIS Epm_nEng EngN 4 0.00 8000.000 EXTENDED_LIMITS -16384.00 16383.50 DEPOSIT ABSOLUTE /end AXIS_DESCR
 /begin AXIS_DESCR STD_AXIS PCR_qCtlValLP_mp InjMass 4 0.00 327.6700 EXTENDED_LIMITS -327.6800 327.6700 DEPOSIT ABSOLUTE /end AXIS_DESCR
/end CHARACTERISTIC
/begin CHARACTERISTIC PCR_rEngTempCorBas_MAP "Basiswert der Motortemperaturkorrektur des Ladedruck-Steueranteils" MAP 0x8005013A Kf_Xs16_Ys16_Ws16 300.0000 Prc -100.0000 200.0000 EXTENDED_LIMITS -400.0000 399.9878
 /begin AXIS_DESCR STD_AXIS Epm_nEng EngN 12 0.00 8000.000 EXTENDED_LIMITS -16384.00 16383.50 DEPOSIT ABSOLUTE /end AXIS_DESCR
 /begin AXIS_DESCR STD_AXIS PCR_qCtlVal_mp InjMass 12 0.00 327.6700 EXTENDED_LIMITS -327.6800 327.6700 DEPOSIT ABSOLUTE /end AXIS_DESCR
/end CHARACTERISTIC
/begin CHARACTERISTIC PCR_rGovMaxCorr_MAP "Kennfeld zur Korrektur der maximal zulässigen Stellgröße aus dem Verbrauch" MAP 0x80053C54 Kf_Xs16_Ys16_Ws16 100.0000 Prc 0.00 100.0000 EXTENDED_LIMITS -400.0000 399.9878
 /begin AXIS_DESCR STD_AXIS Epm_nEng EngN 14 0.00 8000.000 EXTENDED_LIMITS -16384.00 16383.50 DEPOSIT ABSOLUTE /end AXIS_DESCR
 /begin AXIS_DESCR STD_AXIS PCR_qGov InjMass 12 0.00 100.0000 EXTENDED_LIMITS -327.6800 327.6700 DEPOSIT ABSOLUTE /end AXIS_DESCR
/end CHARACTERISTIC
/begin CHARACTERISTIC PCR_rGovMaxDynCorr_MAP "Korrektur dynamisches Max-Stellgrößenlimit über Höhe" MAP 0x80053DDC Kf_Xs16_Ys16_Ws16 100.0000 Prc 0.00 100.0000 EXTENDED_LIMITS -400.0000 399.9878
 /begin AXIS_DESCR STD_AXIS EnvP_p Pres_hPa 10 0.00 3500.000 EXTENDED_LIMITS -32768.00 32767.00 DEPOSIT ABSOLUTE /end AXIS_DESCR
 /begin AXIS_DESCR STD_AXIS Epm_nEng EngN 12 40.00000 6000.000 EXTENDED_LIMITS -16384.00 16383.50 DEPOSIT ABSOLUTE /end AXIS_DESCR
/end CHARACTERISTIC
/begin CHARACTERISTIC PCR_rGovMaxDynEnd_C "Rampen-Endwert" VALUE 0x80053EFC Kw_Ws16 100.0000 Prc 0.00 100.0000 EXTENDED_LIMITS -400.0000 399.9878 /end CHARACTERISTIC
/begin CHARACTERISTIC PCR_rGovMaxDynStrt_C "Rampen-Startwert" VALUE 0x80053EFE Kw_Ws16 100.0000 Prc 0.00 100.0000 EXTENDED_LIMITS -400.0000 399.9878 /end CHARACTERISTIC
/begin CHARACTERISTIC PCR_rGovMaxDyn_MAP "Kennfeld zur Bestimmung der maximal zulässigen Stellgröße aus Drehzahl und Einspritzmenge" MAP 0x80053F00 Kf_Xs16_Ys16_Ws16 100.0000 Prc 0.00 100.0000 EXTENDED_LIMITS -400.0000 399.9878
 /begin AXIS_DESCR STD_AXIS Epm_nEng EngN 16 40.00000 6000.000 EXTENDED_LIMITS -16384.00 16383.50 DEPOSIT ABSOLUTE /end AXIS_DESCR
 /begin AXIS_DESCR STD_AXIS PCR_qGov InjMass 16 0.00 100.0000 EXTENDED_LIMITS -327.6800 327.6700 DEPOSIT ABSOLUTE /end AXIS_DESCR
/end CHARACTERISTIC
/begin CHARACTERISTIC PCR_rGovMax_MAP "Obergrenze der Reglerstellgröße des Ladedrucks" MAP 0x80054144 Map_Xs16Ys16Ws16 300.0000 Prc -100.0000 200.0000 EXTENDED_LIMITS -400.0000 399.9878
 /begin AXIS_DESCR STD_AXIS Epm_nEng EngN 16 0.00 8000.000 EXTENDED_LIMITS -16384.00 16383.50 DEPOSIT ABSOLUTE /end AXIS_DESCR
 /begin AXIS_DESCR STD_AXIS PCR_qGov_mp InjMass 16 0.00 327.6700 EXTENDED_LIMITS -327.6800 327.6700 DEPOSIT ABSOLUTE /end AXIS_DESCR
/end CHARACTERISTIC
/begin CHARACTERISTIC PCR_rGovMin_MAP "Untergrenze der Reglerstellgröße des Ladedrucks" MAP 0x80054388 Map_Xs16Ys16Ws16 300.0000 Prc -100.0000 200.0000 EXTENDED_LIMITS -400.0000 399.9878
 /begin AXIS_DESCR STD_AXIS Epm_nEng EngN 2 0.00 8000.000 EXTENDED_LIMITS -16384.00 16383.50 DEPOSIT ABSOLUTE /end AXIS_DESCR
 /begin AXIS_DESCR STD_AXIS PCR_qGov_mp InjMass 2 0.00 327.6700 EXTENDED_LIMITS -327.6800 327.6700 DEPOSIT ABSOLUTE /end AXIS_DESCR
/end CHARACTERISTIC
/begin CHARACTERISTIC PCR_rOutIMaxAirMsTst_MAP "" MAP 0x8005439C Map_Xs16Ys16Ws16 100.0000 Prc 0.00 100.0000 EXTENDED_LIMITS -400.0000 399.9878
 /begin AXIS_DESCR STD_AXIS Air_dpFltIntkVUs PreshPa_sec 8 -5000.000 5500.000 FORMAT "%8.3" EXTENDED_LIMITS -32768.00 32767.00 DEPOSIT ABSOLUTE /end AXIS_DESCR
 /begin AXIS_DESCR STD_AXIS PCR_qGov InjMass 8 0.00 200.0000 EXTENDED_LIMITS -327.6800 327.6700 DEPOSIT ABSOLUTE /end AXIS_DESCR
/end CHARACTERISTIC
/begin CHARACTERISTIC PCR_rOutIMax_MAP "" MAP 0x80054440 Kf_Xs16_Ys16_Ws16 5.004883 Prc 0.00 5.004883 EXTENDED_LIMITS -400.0000 399.9878
 /begin AXIS_DESCR STD_AXIS Air_dpFltIntkVUs PreshPa_sec 8 -350000.0 350000.0 FORMAT "%8.1" EXTENDED_LIMITS -32768.00 32767.00 DEPOSIT ABSOLUTE /end AXIS_DESCR
 /begin AXIS_DESCR STD_AXIS PCR_qGov InjMass 8 0.00 200.0000 EXTENDED_LIMITS -327.6800 327.6700 DEPOSIT ABSOLUTE /end AXIS_DESCR
/end CHARACTERISTIC
/begin CHARACTERISTIC PCR_rOutIMin_MAP "" MAP 0x800544E4 Kf_Xs16_Ys16_Ws16 5.004883 Prc 0.00 5.004883 EXTENDED_LIMITS -400.0000 399.9878
 /begin AXIS_DESCR STD_AXIS Air_dpFltIntkVUs PreshPa_sec 8 -350000.0 350000.0 FORMAT "%8.1" EXTENDED_LIMITS -32768.00 32767.00 DEPOSIT ABSOLUTE /end AXIS_DESCR
 /begin AXIS_DESCR STD_AXIS PCR_qGov InjMass 8 0.00 200.0000 EXTENDED_LIMITS -327.6800 327.6700 DEPOSIT ABSOLUTE /end AXIS_DESCR
/end CHARACTERISTIC
/begin CHARACTERISTIC PCR_stCByVlvBitMsk_C "" VALUE 0x80065AFE Val_Wu8 255.0 OneToOne 0.00 255.0 /end CHARACTERISTIC
/begin CHARACTERISTIC PCR_stCByVlvClose_C "" VALUE 0x80065AFF Val_Wu8 1.000 OneToOne 0.00 1.000 EXTENDED_LIMITS 0.00 255.0 /end CHARACTERISTIC
/begin CHARACTERISTIC PCR_stCByVlvEOMMsk_CA "" VAL_BLK 0x80065B00 ValA_Wu32 4294967295.00 OneToOne 0.00 4294967295.00 NUMBER 1 /end CHARACTERISTIC
/begin CHARACTERISTIC PCR_stCByVlvOpn_C "" VALUE 0x80065B04 Val_Wu8 1.000 OneToOne 0.00 1.000 EXTENDED_LIMITS 0.00 255.0 /end CHARACTERISTIC
/begin CHARACTERISTIC PCR_stCtlValAutLPEOMMsk_CA "" VAL_BLK 0x80050C20 ValA_Wu32 4294967295.00 OneToOne 0.00 4294967295.00 NUMBER 1 /end CHARACTERISTIC
/begin CHARACTERISTIC PCR_stCtlValEOMMsk_CA "Bitmaske zum Selektieren der relevanten Regenerationsanforderungen für die Ladedruck-Steuerung" VAL_BLK 0x80050290 ValA_Wu32 4294967295.00 OneToOne 0.00 4294967295.00 NUMBER 2 /end CHARACTERISTIC
/begin CHARACTERISTIC PCR_stCtlValLPEOMMsk_CA "" VAL_BLK 0x80050C24 ValA_Wu32 4294967295.00 OneToOne 0.00 4294967295.00 NUMBER 1 /end CHARACTERISTIC
/begin CHARACTERISTIC PCR_stDesMonEOMMsk_CA "" VAL_BLK 0x800526E8 ValA_Wu32 4294967295.00 OneToOne 0.00 4294967295.00 NUMBER 2 /end CHARACTERISTIC
/begin CHARACTERISTIC PCR_stDesValEOMMsk_CA "Bitmaske zum Selektieren der relevanten Regenerationsanforderungen für die Sollwertberechnung" VAL_BLK 0x800526F0 ValA_Wu32 4294967295.00 OneToOne 0.00 4294967295.00 NUMBER 2 /end CHARACTERISTIC
/begin CHARACTERISTIC PCR_stDesValLPEOMMsk_CA "" VAL_BLK 0x80053500 ValA_Wu32 4294967295.00 OneToOne 0.00 4294967295.00 NUMBER 2 /end CHARACTERISTIC
/begin CHARACTERISTIC PCR_stDflValCByVlv_C "" VALUE 0x80065B05 Val_Wu8 1.000 OneToOne 0.00 1.000 EXTENDED_LIMITS 0.00 255.0 /end CHARACTERISTIC
/begin CHARACTERISTIC PCR_stMskGovOffEOM_C "Bitmaske zur Umschaltung zwischen Hysteriesengrenzen im normalen Betrieb und der im Regenerationsbetrieb" VALUE 0x80054588 Val_Wu32 4294967295.00 OneToOne 0.00 4294967295.00 /end CHARACTERISTIC
/begin CHARACTERISTIC PCR_swtBstLPActv_C "" VALUE 0x80065B06 Val_Wu8 1.000 OneToOne 0.00 1.000 EXTENDED_LIMITS 0.00 255.0 /end CHARACTERISTIC
/begin CHARACTERISTIC PCR_swtCByVlvClthOffCond_C "" VALUE 0x80065B07 Val_Wu8 1.000 OneToOne 0.00 1.000 EXTENDED_LIMITS 0.00 255.0 /end CHARACTERISTIC
/begin CHARACTERISTIC PCR_swtQntCtl_C "Schalter für Einspritzmenge (PCR_CtlValCalc)" VALUE 0x8004EB18 Val_Wu8 1.000 OneToOne 0.00 1.000 EXTENDED_LIMITS 0.00 255.0 /end CHARACTERISTIC
/begin CHARACTERISTIC PCR_swtQntDes_C "Schalter für Einspritzmenge(PCR_DesValCalc)" VALUE 0x8004EB19 Val_Wu8 1.000 OneToOne 0.00 1.000 EXTENDED_LIMITS 0.00 255.0 /end CHARACTERISTIC
/begin CHARACTERISTIC PCR_swtQntGov_C "Schalter für Einspritzmenge (PCR_Governer)" VALUE 0x8004EB1A Val_Wu8 1.000 OneToOne 0.00 1.000 EXTENDED_LIMITS 0.00 255.0 /end CHARACTERISTIC
/begin CHARACTERISTIC PCR_swtQntMon_C "Schalter für Einspritzmenge(PCR_Mon)" VALUE 0x8004EB1B Val_Wu8 1.000 OneToOne 0.00 1.000 EXTENDED_LIMITS 0.00 255.0 /end CHARACTERISTIC
/begin CHARACTERISTIC PCR_swtT20Prt_C "" VALUE 0x800526F8 Val_Wu8 1.000 OneToOne 0.00 1.000 EXTENDED_LIMITS 0.00 255.0 /end CHARACTERISTIC
/begin CHARACTERISTIC PCR_swtT20_C "" VALUE 0x800526F9 Val_Wu8 1.000 OneToOne 0.00 1.000 EXTENDED_LIMITS 0.00 255.0 /end CHARACTERISTIC
/begin CHARACTERISTIC PCR_swtTrbChPrt_C "" VALUE 0x800526FA Val_Wu8 1.000 OneToOne 0.00 1.000 EXTENDED_LIMITS 0.00 255.0 /end CHARACTERISTIC
/begin CHARACTERISTIC PCR_swtTrqInrCtl_C "Schalter für inneres Drehmoment(PCR_CtlValCalc)" VALUE 0x8004EB1C Val_Wu8 1.000 OneToOne 0.00 1.000 EXTENDED_LIMITS 0.00 255.0 /end CHARACTERISTIC
/begin CHARACTERISTIC PCR_swtTrqInrDes_C "Schalter für inneres Drehmoment(PCR_DesValCalc)" VALUE 0x8004EB1D Val_Wu8 1.000 OneToOne 0.00 1.000 EXTENDED_LIMITS 0.00 255.0 /end CHARACTERISTIC
/begin CHARACTERISTIC PCR_swtTrqInrGov_C "Schalter für inneres Drehmoment (PCR_Governor)" VALUE 0x8004EB1E Val_Wu8 1.000 OneToOne 0.00 1.000 EXTENDED_LIMITS 0.00 255.0 /end CHARACTERISTIC
/begin CHARACTERISTIC PCR_swtTrqInrMon_C "Schalter für inneres Drehmoment (PCR_Mon)" VALUE 0x8004EB1F Val_Wu8 1.000 OneToOne 0.00 1.000 EXTENDED_LIMITS 0.00 255.0 /end CHARACTERISTIC
/begin CHARACTERISTIC PCR_tClntThres_C "Kühlwassertemperaturschwelle zur Parametersatzumschaltung des dynamischen Sollwertanteils" VALUE 0x800526FC Val_Ws16 6553.500 Temp_Cels -3549.940 3003.560 /end CHARACTERISTIC
/begin CHARACTERISTIC PCR_tCmprDsOfs_CUR "" CURVE 0x800526FE Cur_Xs16Ws16 130.0000 TempDiff_Cels -30.00000 100.0000 FORMAT "%8.4" EXTENDED_LIMITS -3276.800 3276.700
 /begin AXIS_DESCR STD_AXIS EnvP_p Pres_hPa 4 0.00 3500.000 EXTENDED_LIMITS -32768.00 32767.00 DEPOSIT ABSOLUTE /end AXIS_DESCR
/end CHARACTERISTIC
/begin CHARACTERISTIC PCR_TempCor.xVal_C "Schalter zur Auswahl Motortemperatur oder Lufttemperatur für die Ladedruck-Sollwertberechnung/" VALUE 0x80052710 Kw_Wu8 1.000 OneToOne 0.00 1.000 EXTENDED_LIMITS 0.00 255.0 /end CHARACTERISTIC
/begin CHARACTERISTIC PCR_TempCor.xTyp_C "Schalter zur Auswahl Motortemperatur oder Lufttemperatur für die Ladedruck-Sollwertberechnung/" VALUE 0x80052711 Kw_Wu8 1.000 OneToOne 1.000 2.000 EXTENDED_LIMITS 0.00 255.0 /end CHARACTERISTIC
/begin CHARACTERISTIC PCR_TempCorLP.xVal_C "/" VALUE 0x80053508 Kw_Wu8 1.000 OneToOne 0.00 1.000 EXTENDED_LIMITS 0.00 255.0 /end CHARACTERISTIC
/begin CHARACTERISTIC PCR_TempCorLP.xTyp_C "/" VALUE 0x80053509 Kw_Wu8 1.000 OneToOne 1.000 2.000 EXTENDED_LIMITS 0.00 255.0 /end CHARACTERISTIC
/begin CHARACTERISTIC PCR_tiDebCByVlvClth.tiHiLo_C "/" VALUE 0x80065B08 Kw_Ws16 655350.0 TimeDeb -327680.0 327670.0 /end CHARACTERISTIC
/begin CHARACTERISTIC PCR_tiDebCByVlvClth.tiLoHi_C "/" VALUE 0x80065B0A Kw_Ws16 655350.0 TimeDeb -327680.0 327670.0 /end CHARACTERISTIC
/begin CHARACTERISTIC PCR_tiDelGov_C "Ausschaltverzögerung zur Aktivierung der dynamik Begrenzung" VALUE 0x8005458C Val_Ws16 655.3500 Time_s -327.6800 327.6700 /end CHARACTERISTIC
/begin CHARACTERISTIC PCR_tiDelPT1_C "PT1-Zeitkonstante der Dynamik-Begrenzung" VALUE 0x80054590 Val_Ws32 4294.9662960 TimeDelay_s 0.0010000000689 4294.9672960 FORMAT "%12.7" EXTENDED_LIMITS 0.000002000000001 4294.9672960 /end CHARACTERISTIC
/begin CHARACTERISTIC PCR_tiDelT20Prt_C "" VALUE 0x80052714 Val_Ws32 14017.375782 TimeDelay_ms 999.99238556 15017.368168 FORMAT "%12.6" EXTENDED_LIMITS 0.0020000000009 4294967.2960 /end CHARACTERISTIC
/begin CHARACTERISTIC PCR_tiDesSlpLim_C "" VALUE 0x80052718 Kw_Wu16 65535.00 Time_s 0.00 65535.00 EXTENDED_LIMITS 0.00 655.3500 /end CHARACTERISTIC
/begin CHARACTERISTIC PCR_tiDesValCalcLPLim.tiHiLo_C "/" VALUE 0x8005350A Kw_Ws16 655350.0 TimeDeb -327680.0 327670.0 /end CHARACTERISTIC
/begin CHARACTERISTIC PCR_tiDesValCalcLPLim.tiLoHi_C "/" VALUE 0x8005350C Kw_Ws16 655350.0 TimeDeb -327680.0 327670.0 /end CHARACTERISTIC
/begin CHARACTERISTIC PCR_tiGovOffDel_CUR "Kennlinie: Abschaltverzögerung des Reglers zur Vermeidung des Verdichter-Pumpens" CURVE 0x80054594 Cur_Xs16Ws16 20.00000 Time_s 0.00 20.00000 EXTENDED_LIMITS -327.6800 327.6700
 /begin AXIS_DESCR STD_AXIS Epm_nEng EngN 6 0.00 8000.000 EXTENDED_LIMITS -16384.00 16383.50 DEPOSIT ABSOLUTE /end AXIS_DESCR
/end CHARACTERISTIC
/begin CHARACTERISTIC PCR_tiPT1_C "PT1-Zeitkonstante zur Sollwertfilterung für den I-Anteil" VALUE 0x800545B0 Val_Ws32 4294.9662960 TimeDelay_s 0.0010000000689 4294.9672960 FORMAT "%12.7" EXTENDED_LIMITS 0.000002000000001 4294.9672960 /end CHARACTERISTIC
/begin CHARACTERISTIC PCR_tiRmp_C "Über die Zeit vorgegebene Rampensteigung" VALUE 0x800545B4 Val_Wu32 65.535999984741210 TimeCoEOMRmp 0.000000015258789 65.536000000000001 FORMAT "%19.16" /end CHARACTERISTIC
/begin CHARACTERISTIC PCR_tiT20PT1_C "" VALUE 0x8005271C Val_Ws32 14017.375782 TimeDelay_ms 999.99238556 15017.368168 FORMAT "%12.6" EXTENDED_LIMITS 0.0020000000009 4294967.2960 /end CHARACTERISTIC
/begin CHARACTERISTIC PCR_tiT20ThresPT1_C "" VALUE 0x80052720 Val_Ws32 14017.375782 TimeDelay_ms 999.99238556 15017.368168 FORMAT "%12.6" EXTENDED_LIMITS 0.0020000000009 4294967.2960 /end CHARACTERISTIC
/begin CHARACTERISTIC PCR_tiTrbChPT1_C "" VALUE 0x80052724 Val_Ws32 14017.375782 TimeDelay_ms 999.99238556 15017.368168 FORMAT "%12.6" EXTENDED_LIMITS 0.0020000000009 4294967.2960 /end CHARACTERISTIC
/begin CHARACTERISTIC PCR_tiTrbChThresPT1_C "" VALUE 0x80052728 Val_Ws32 14017.375782 TimeDelay_ms 999.99238556 15017.368168 FORMAT "%12.6" EXTENDED_LIMITS 0.0020000000009 4294967.2960 /end CHARACTERISTIC
/begin CHARACTERISTIC PCR_tT20CorIWinNeg_C "" VALUE 0x8005272C Val_Ws32 30.0000000000 TempDiff_Cels -30.0000000000 0.00 FORMAT "%13.10" EXTENDED_LIMITS -214748364.800 214748364.700 /end CHARACTERISTIC
/begin CHARACTERISTIC PCR_tT20CorIWinPos_C "" VALUE 0x80052730 Val_Ws32 100.000000000 TempDiff_Cels 0.00 100.000000000 FORMAT "%13.9" EXTENDED_LIMITS -214748364.800 214748364.700 /end CHARACTERISTIC
/begin CHARACTERISTIC PCR_tT20CorPWinNeg_C "" VALUE 0x80052734 Val_Ws32 30.0000000000 TempDiff_Cels -30.0000000000 0.00 FORMAT "%13.10" EXTENDED_LIMITS -214748364.800 214748364.700 /end CHARACTERISTIC
/begin CHARACTERISTIC PCR_tT20CorPWinPos_C "" VALUE 0x80052738 Val_Ws32 100.000000000 TempDiff_Cels 0.00 100.000000000 FORMAT "%13.9" EXTENDED_LIMITS -214748364.800 214748364.700 /end CHARACTERISTIC
/begin CHARACTERISTIC PCR_tT20Lim_C "" VALUE 0x8005273C Val_Ws16 130.0000 Temp_Cels -30.04000 99.96000 EXTENDED_LIMITS -3549.940 3003.560 /end CHARACTERISTIC
/begin CHARACTERISTIC PCR_WrmDT1Win.T1_C "Parameter für DT1-Glied bei warmem Motor/" VALUE 0x80052740 Kw_Ws32 4294.9662960 TimeDelay_s 0.0010000000689 4294.9672960 FORMAT "%12.7" EXTENDED_LIMITS 0.000002000000001 4294.9672960 /end CHARACTERISTIC
/begin CHARACTERISTIC PCR_WrmDT1Win.Kd_C "Parameter für DT1-Glied bei warmem Motor/" VALUE 0x80052744 Kw_Ws32 65535.9999847 Kd -32768.0000000 32767.9999847 FORMAT "%13.7" /end CHARACTERISTIC
/begin CHARACTERISTIC PCR_WrmDT1Win.KdPos_C "Parameter für DT1-Glied bei warmem Motor/" VALUE 0x80052748 Kw_Ws32 65535.9999847 Kd -32768.0000000 32767.9999847 FORMAT "%13.7" /end CHARACTERISTIC
/begin CHARACTERISTIC PCR_WrmDT1Win.KdNeg_C "Parameter für DT1-Glied bei warmem Motor/" VALUE 0x8005274C Kw_Ws32 65535.9999847 Kd -32768.0000000 32767.9999847 FORMAT "%13.7" /end CHARACTERISTIC
/begin CHARACTERISTIC PCR_WrmDT1Win.WinPos_C "Parameter für DT1-Glied bei warmem Motor/" VALUE 0x80052750 Kw_Ws32 2147487148.00 Pres_hPa -2147483648.00 3500.00 EXTENDED_LIMITS -2147483648.00 2147483647.00 /end CHARACTERISTIC
/begin CHARACTERISTIC PCR_WrmDT1Win.WinNeg_C "Parameter für DT1-Glied bei warmem Motor/" VALUE 0x80052754 Kw_Ws32 2147487148.00 Pres_hPa -2147483648.00 3500.00 EXTENDED_LIMITS -2147483648.00 2147483647.00 /end CHARACTERISTIC
/begin MEASUREMENT N_ozmw "kurzzeitiger Mittelwert Drehzahl" SWORD Def_n_sw_q1p0 1 100 -32767. 32767. FORMAT "%5.0" ECU_ADDRESS 0xC000A61C /end MEASUREMENT
/begin MEASUREMENT Oz_abstellm "Abstellzeit für OZ" UWORD Def_tn_uw_q1 1 100 0.00 65535.0 FORMAT "%7.1" ECU_ADDRESS 0xC000A61E /end MEASUREMENT
/begin MEASUREMENT Oz_anztoe "Anzahl Werte von Töns in der Sekunde" UBYTE Def_dez_ub_q1 1 100 0.00 255. FORMAT "%3.0" ECU_ADDRESS 0xC000B3C9 /end MEASUREMENT
/begin MEASUREMENT Oz_beschcnt "Zähler Beschleunigungsausblendung" UBYTE Def_dez_ub_q1 1 100 0.00 255. FORMAT "%3.0" ECU_ADDRESS 0xC000B3D0 /end MEASUREMENT
/begin MEASUREMENT Oz_dkm "Gefahrene Strecke für die Steigungsberechnung" UWORD Def_f_uw_b10 1 100 0.00 9.9998474 ECU_ADDRESS 0xC000A620 /end MEASUREMENT
/begin MEASUREMENT Oz_hoehe "Gefahrene Höhe für die Steigungserkennung" SWORD Def_f_sw_b8 1 100 -8.0000000 7.9997559 ECU_ADDRESS 0xC000A622 /end MEASUREMENT
/begin MEASUREMENT Oz_krz2cnt "KurzMw 2 Zähler" UBYTE Def_dez_ub_q1 1 100 0.00 255. FORMAT "%3.0" ECU_ADDRESS 0xC000B3D1 /end MEASUREMENT
/begin MEASUREMENT Oz_krzcnt "10er Packet Zähler" UBYTE Def_dez_ub_q1 1 100 0.00 255. FORMAT "%3.0" ECU_ADDRESS 0xC000B3D2 /end MEASUREMENT
/begin MEASUREMENT Oz_krzkor2 "Mittelwert von zwei KurzMw" UBYTE Def_niv_ub_b75 1 100 0.00 74.71 ECU_ADDRESS 0xC000B3D3 /end MEASUREMENT
/begin MEASUREMENT Oz_krzkor2k "Mittelwert von zwei KurzMw Steigungs korrigiert" UBYTE Def_niv_ub_b75 1 100 0.00 74.71 ECU_ADDRESS 0xC000B3D4 /end MEASUREMENT
/begin MEASUREMENT Oz_krzmw "10er Packet" UBYTE Def_niv_ub_b75 1 100 0.00 74.71 ECU_ADDRESS 0xC000B3D5 /end MEASUREMENT
/begin MEASUREMENT Oz_krzmwkor "10er Packet drehzahl korrigiert" UBYTE Def_niv_ub_b75 1 100 0.00 74.71 ECU_ADDRESS 0xC000B3D6 /end MEASUREMENT
/begin MEASUREMENT Oz_krzor "kurzzeitiger Mittelwert Orientierungsmessung Niveau" UBYTE Def_niv_ub_b75 1 100 0.00 74.71 ECU_ADDRESS 0xC000B3D7 /end MEASUREMENT
/begin MEASUREMENT Oz_langmw "Langzeitmittelwert berechnet" UBYTE Def_niv_ub_b75 1 100 0.00 74.71 ECU_ADDRESS 0xC000B3D8 /end MEASUREMENT
/begin MEASUREMENT Oz_lbmw "Längsbeschleunigungs Mittelwert für die Niveau-Korrektur" SBYTE Def_f_sb_b2 1 100 -2.000 1.984 ECU_ADDRESS 0xC000B3D9 /end MEASUREMENT
/begin MEASUREMENT Oz_lgmwcnt "LangzeitMw Zähler" UBYTE Def_dez_ub_q1 1 100 0.00 255. FORMAT "%3.0" ECU_ADDRESS 0xC000B3DA /end MEASUREMENT
/begin MEASUREMENT Oz_lp "oz level picture" UBYTE Def_dez_ub_q1 1 100 0.00 255. FORMAT "%3.0" ECU_ADDRESS 0xC000B3DB /end MEASUREMENT
/begin MEASUREMENT Oz_lv "oz level value" UBYTE Def_dez_ub_q1 1 100 0.00 255. FORMAT "%3.0" ECU_ADDRESS 0xC000B3DC /end MEASUREMENT
/begin MEASUREMENT Oz_niv "Ölniveau ungefiltert" UBYTE Def_niv_ub_b75 1 100 0.00 74.71 ECU_ADDRESS 0xC000B3CA /end MEASUREMENT
/begin MEASUREMENT Oz_nivakt "Aktuelles Niveau für den Tester" UBYTE Def_niv_ub_b75 1 100 0.00 74.71 ECU_ADDRESS 0xC000B3DD /end MEASUREMENT
/begin MEASUREMENT Oz_nivkomp "Temperatur- und Zeitkompensation" UBYTE Def_niv_ub_b75 1 100 0.00 74.71 ECU_ADDRESS 0xC000B3DE /end MEASUREMENT
/begin MEASUREMENT Oz_nivkor "Aktuelles Niveau Temperatur korrigiert" UBYTE Def_niv_ub_b75 1 100 0.00 74.71 ECU_ADDRESS 0xC000B3DF /end MEASUREMENT
/begin MEASUREMENT Oz_nivkrzt "Kurzmittelwert-Niveau für den Tester" UBYTE Def_niv_ub_b75 1 100 0.00 74.71 ECU_ADDRESS 0xC000B3E0 /end MEASUREMENT
/begin MEASUREMENT Oz_nivlit "Ölniveau in Liter" UBYTE Def_niv_ub_q0p1 1 100 0.00 25.50 FORMAT "%5.2" ECU_ADDRESS 0xC000B3E1 /end MEASUREMENT
/begin MEASUREMENT Oz_nivqlt "Ölniveau QLT ungefiltert" UBYTE Def_niv_ub_b75 1 100 0.00 74.71 ECU_ADDRESS 0xC000B3CB /end MEASUREMENT
/begin MEASUREMENT Oz_nivrers "Ersatzniveau-Rohwert" UBYTE Def_dez_ub_q1 1 100 0.00 255. FORMAT "%3.0" ECU_ADDRESS 0xC000B3CC /end MEASUREMENT
/begin MEASUREMENT Oz_nivt "begrenzter Niveau-Rohwert" UBYTE Def_dez_ub_q1 1 100 0.00 255. FORMAT "%3.0" ECU_ADDRESS 0xC000B3CD /end MEASUREMENT
/begin MEASUREMENT Oz_nivtoe "Ölniveau Töns ungefiltert" UBYTE Def_niv_ub_b75 1 100 0.00 74.71 ECU_ADDRESS 0xC000B3CE /end MEASUREMENT
/begin MEASUREMENT Oz_nivzeit "Zeit nach dem KF_OZZEIT" UWORD Def_td_uw_q0p01 1 100 0.00 655.350 FORMAT "%7.3" ECU_ADDRESS 0xC000A624 /end MEASUREMENT
/begin MEASUREMENT Oz_oricnt "Orientierungszähler" UBYTE Def_dez_ub_q1 1 100 0.00 255. FORMAT "%3.0" ECU_ADDRESS 0xC000B3E2 /end MEASUREMENT
/begin MEASUREMENT Oz_orikor "OriMw korrigiert" UBYTE Def_niv_ub_b75 1 100 0.00 74.71 ECU_ADDRESS 0xC000B3E3 /end MEASUREMENT
/begin MEASUREMENT Oz_peil "Ölniveau für die Peilstabanzeige" UBYTE Def_niv_ub_b75 1 100 0.00 74.71 ECU_ADDRESS 0xC000B3E4 /end MEASUREMENT
/begin MEASUREMENT Oz_peilaltanz "Letzter Wert, der die Anzeige geändert hat" UBYTE Def_niv_ub_b75 1 100 0.00 74.71 ECU_ADDRESS 0xC000B3E5 /end MEASUREMENT
/begin MEASUREMENT Oz_peilkm "Max Ziel km im Fehlerfall" UWORD Def_km_uw_q10 1 100 0.00 655350. FORMAT "%5.0" ECU_ADDRESS 0xC000A626 /end MEASUREMENT
/begin MEASUREMENT Oz_peilkmalt "Km Stand beim 1. Sensorfehler" UWORD Def_km_uw_q10 1 100 0.00 655350. FORMAT "%5.0" ECU_ADDRESS 0xC000A628 /end MEASUREMENT
/begin MEASUREMENT Oz_peillang "Letzter angeforderter Wert für die Peilstabanzeige" UBYTE Def_niv_ub_b75 1 100 0.00 74.71 ECU_ADDRESS 0xC000B3E6 /end MEASUREMENT
/begin MEASUREMENT Oz_peiloben "Obere Grenze aktuelles Balkens" UBYTE Def_niv_ub_b75 1 100 0.00 74.71 ECU_ADDRESS 0xC000B3E7 /end MEASUREMENT
/begin MEASUREMENT Oz_peilunten "Obere Grenze aktuelles Balkens" UBYTE Def_niv_ub_b75 1 100 0.00 74.71 ECU_ADDRESS 0xC000B3E8 /end MEASUREMENT
/begin MEASUREMENT Oz_perm "Permittivität ungefiltert" UWORD Def_perm_uw_b6 1 100 0.00 5.999908447266 FORMAT "%14.12" ECU_ADDRESS 0xC000A60A /end MEASUREMENT
/begin MEASUREMENT Oz_permakt "Permittivität für den Tester" UWORD Def_perm_uw_b6 1 100 0.00 5.999908447266 FORMAT "%14.12" ECU_ADDRESS 0xC000A60C /end MEASUREMENT
/begin MEASUREMENT Oz_permt "begrenzter Permittivitäts-Rohwert" UWORD Def_dez_uw_q1 1 100 0.00 1024. FORMAT "%5.0" ECU_ADDRESS 0xC000A60E /end MEASUREMENT
/begin MEASUREMENT Oz_perref "Ersatzpermittivität" UWORD Def_dez_uw_q1 1 100 0.00 1024. FORMAT "%5.0" ECU_ADDRESS 0xC000A610 /end MEASUREMENT
/begin MEASUREMENT Oz_pzdivp "Verhältnis oz_luftalt/oz_luftneu" UWORD Def_f_uw_b2 1 100 0.00 1.999908447266 FORMAT "%14.12" ECU_ADDRESS 0xC000A62A /end MEASUREMENT
/begin MEASUREMENT Oz_qbmw "Querbeschleunigungs Mittelwert für die Niveau-Korrektur" SBYTE Def_f_sb_b2 1 100 -2.000 1.984 ECU_ADDRESS 0xC000B3E9 /end MEASUREMENT
/begin MEASUREMENT Oz_steigung "Berechnete Steigung" SWORD Def_f_sw_b64 1 100 -64.00000 63.99805 ECU_ADDRESS 0xC000A62C /end MEASUREMENT
/begin MEASUREMENT Oz_temp "Öltemperatur ungefiltert" SWORD Def_t_sw_q0p1 1 100 -3276.8 3276.7 FORMAT "%6.1" ECU_ADDRESS 0xC000A612 /end MEASUREMENT
/begin MEASUREMENT Oz_tempf "Gefilterte Öltemperatur" SWORD Def_t_sw_q0p1 1 100 -3276.8 3276.7 FORMAT "%6.1" ECU_ADDRESS 0xC000A632 /end MEASUREMENT
/begin MEASUREMENT Oz_tempmdl "Interne Modelltemperatur (NG6)" SWORD Def_t_sw_q0p1 1 100 -3276.8 3276.7 FORMAT "%6.1" ECU_ADDRESS 0xC000A634 /end MEASUREMENT
/begin MEASUREMENT Oz_tempqlt "Öltemperatur qlt ungefiltert" SWORD Def_t_sw_q0p1 1 100 -3276.8 3276.7 FORMAT "%6.1" ECU_ADDRESS 0xC000A614 /end MEASUREMENT
/begin MEASUREMENT Oz_tempt "begrenzter Temperatur-Rohwert" UWORD Def_dez_uw_q1 1 100 0.00 65535. FORMAT "%5.0" ECU_ADDRESS 0xC000A616 /end MEASUREMENT
/begin MEASUREMENT Oz_temptoe "Öltemperatur Töns ungefiltert" SWORD Def_t_sw_q0p1 1 100 -3276.8 3276.7 FORMAT "%6.1" ECU_ADDRESS 0xC000A618 /end MEASUREMENT
/begin MEASUREMENT Oz_tkorrori "Temperatur für die Korrektur der Orientierung" SWORD Def_t_sw_q0p1 1 100 -3276.8 3276.7 FORMAT "%6.1" ECU_ADDRESS 0xC000A62E /end MEASUREMENT
/begin MEASUREMENT Oz_vormw "vorgezogener Mittelwert Niveau" UBYTE Def_niv_ub_b75 1 100 0.00 74.71 ECU_ADDRESS 0xC000B3EA /end MEASUREMENT
/begin MEASUREMENT Oz_vormwcnt "VorMw Zähler" UBYTE Def_dez_ub_q1 1 100 0.00 255. FORMAT "%3.0" ECU_ADDRESS 0xC000B3EB /end MEASUREMENT
/begin MEASUREMENT PCBS_cntChng_mp "" UBYTE OneToOne 1 100 0.00 255.0 ECU_ADDRESS 0xC000B3EF /end MEASUREMENT
/begin MEASUREMENT PCBS_cntOilChng_mp "" UBYTE OneToOne 1 100 0.00 255.0 ECU_ADDRESS 0xC000B3F0 /end MEASUREMENT
/begin MEASUREMENT PCBS_dAvaiDMEChg_mp "" UBYTE OneToOne 1 100 0.00 255.0 ECU_ADDRESS 0xC000B3F1 /end MEASUREMENT
/begin MEASUREMENT PCBS_dAvaiOut "" UBYTE OneToOne 1 100 0.00 255.0 ECU_ADDRESS 0xD0001FF4 /end MEASUREMENT
/begin MEASUREMENT PCBS_facCalcDistTrm_mp "" SWORD Fact 1 100 -4.000000 3.999878 ECU_ADDRESS 0xC000A636 /end MEASUREMENT
/begin MEASUREMENT PCBS_facCalcDistUnlim_mp "" SWORD Fact 1 100 -4.000000 3.999878 ECU_ADDRESS 0xC000A638 /end MEASUREMENT
/begin MEASUREMENT PCBS_facCor_mp "" UBYTE Fact_CBS 1 100 0.00 2.550 FORMAT "%5.3" ECU_ADDRESS 0xC000B3F2 /end MEASUREMENT
/begin MEASUREMENT PCBS_facKvb_mp "" UBYTE Fact_PCBS 1 100 0.00 2.550 FORMAT "%5.3" ECU_ADDRESS 0xC000B3F3 /end MEASUREMENT
/begin MEASUREMENT PCBS_facTot_mp "" UBYTE Fact_PCBS 1 100 0.00 2.550 FORMAT "%5.3" ECU_ADDRESS 0xC000B3F4 /end MEASUREMENT
/begin MEASUREMENT PCBS_kvbmwIn_mp "" ULONG Fuel_Cons 1 100 0.00 524287.999878 FORMAT "%13.6" ECU_ADDRESS 0xC000913C /end MEASUREMENT
/begin MEASUREMENT PCBS_lChngPred_mp "" SLONG km_sw_q10 1 100 -21474836480.0 21474836470.0 FORMAT "%13.1" ECU_ADDRESS 0xC0009140 /end MEASUREMENT
/begin MEASUREMENT PCBS_lDist1_mp "" SWORD km_sw_q10 1 100 -327680.0 327670.0 FORMAT "%8.1" ECU_ADDRESS 0xC000A63A /end MEASUREMENT
/begin MEASUREMENT PCBS_lDist3_mp "" SWORD km_sw_q10 1 100 -327680.0 327670.0 FORMAT "%8.1" ECU_ADDRESS 0xC000A63C /end MEASUREMENT
/begin MEASUREMENT PCBS_lDist4_mp "" SWORD km_sw_q10 1 100 -327680.0 327670.0 FORMAT "%8.1" ECU_ADDRESS 0xC000A63E /end MEASUREMENT
/begin MEASUREMENT PCBS_lDistanceOut "" SWORD km_sw_q10 1 100 -327680.0 327670.0 FORMAT "%8.1" ECU_ADDRESS 0xD000110A /end MEASUREMENT
/begin MEASUREMENT PCBS_lDistance_mp "" SWORD km_sw_q10 1 100 -327680.0 327670.0 FORMAT "%8.1" ECU_ADDRESS 0xC000A640 /end MEASUREMENT
/begin MEASUREMENT PCBS_lDistComp_mp "" SWORD km_sw_q10 1 100 -327680.0 327670.0 FORMAT "%8.1" ECU_ADDRESS 0xC0009144 /end MEASUREMENT
/begin MEASUREMENT PCBS_lDistCom_mp "" SLONG km_sw_q10 1 100 -21474836480.0 21474836470.0 FORMAT "%13.1" ECU_ADDRESS 0xC0009148 /end MEASUREMENT
/begin MEASUREMENT PCBS_lDistDiff_mp "" SWORD lProgWay 1 100 -32768000. 32767000. FORMAT "%8.0" ECU_ADDRESS 0xC000A642 /end MEASUREMENT
/begin MEASUREMENT PCBS_lDistMin_mp "" SLONG km_sw_q10 1 100 -21474836480.0 21474836470.0 FORMAT "%13.1" ECU_ADDRESS 0xC000914C /end MEASUREMENT
/begin MEASUREMENT PCBS_lDistSyncDiff_mp "" SWORD km_sw_q10 1 100 -327680.0 327670.0 FORMAT "%8.1" ECU_ADDRESS 0xC000A644 /end MEASUREMENT
/begin MEASUREMENT PCBS_lDistSync_mp "" SWORD km_sw_q10 1 100 -327680.0 327670.0 FORMAT "%8.1" ECU_ADDRESS 0xC000A646 /end MEASUREMENT
/begin MEASUREMENT PCBS_lDist_mp "" SLONG km_sw_q10 1 100 -21474836480.0 21474836470.0 FORMAT "%13.1" ECU_ADDRESS 0xC0009150 /end MEASUREMENT
/begin MEASUREMENT PCBS_lf1tIn_mp "" UBYTE Fact_PCBS 1 100 0.00 2.550 FORMAT "%5.3" ECU_ADDRESS 0xC000B3F5 /end MEASUREMENT
/begin MEASUREMENT PCBS_lJmpMax_mp "" SWORD km_sw_q10 1 100 -327680.0 327670.0 FORMAT "%8.1" ECU_ADDRESS 0xC000A648 /end MEASUREMENT
/begin MEASUREMENT PCBS_lMaxDistance_mp "" SWORD km_sw_q10 1 100 -327680.0 327670.0 FORMAT "%8.1" ECU_ADDRESS 0xC000A64A /end MEASUREMENT
/begin MEASUREMENT PCBS_lProgWay "" UBYTE lProgWay 1 100 0.00 255000. FORMAT "%5.0" ECU_ADDRESS 0xD0001FF5 /end MEASUREMENT
/begin MEASUREMENT PCBS_lProgWayInt "" SWORD km_sw_q10 1 100 -327680.0 327670.0 FORMAT "%8.1" ECU_ADDRESS 0xD000110C /end MEASUREMENT
/begin MEASUREMENT PCBS_lRwKvbOverlay "" SLONG km_sw_q10 1 100 -21474836480.0 21474836470.0 FORMAT "%13.1" ECU_ADDRESS 0xD0002F64 /end MEASUREMENT
/begin MEASUREMENT PCBS_lSum "" UWORD lProgWay 1 100 0.00 65535000. FORMAT "%8.0" ECU_ADDRESS 0xD000160A /end MEASUREMENT
/begin MEASUREMENT PCBS_lSum1000_mp "" UWORD lProgWay 1 100 0.00 65535000. FORMAT "%8.0" ECU_ADDRESS 0xC000A64C /end MEASUREMENT
/begin MEASUREMENT PCBS_lSum10_mp "" ULONG km_sw_q10 1 100 0.00 42949672950.0 FORMAT "%13.1" ECU_ADDRESS 0xC0009154 /end MEASUREMENT
/begin MEASUREMENT PCBS_lSumDPFChng "" ULONG km_sw_q10 1 100 0.00 42949672950.0 FORMAT "%13.1" ECU_ADDRESS 0xD0003250 /end MEASUREMENT
/begin MEASUREMENT PCBS_lSumIn_mp "" ULONG OneToOne_km 1 100 0.00 4294967295.00 FORMAT "%13.2" ECU_ADDRESS 0xC0009158 /end MEASUREMENT
/begin MEASUREMENT PCBS_lSumOverlay "" ULONG km_sw_q10 1 100 0.00 42949672950.0 FORMAT "%13.1" ECU_ADDRESS 0xD0003254 /end MEASUREMENT
/begin MEASUREMENT PCBS_lSyncCalc1_mp "" SLONG km_sw_q10 1 100 -21474836480.0 21474836470.0 FORMAT "%13.1" ECU_ADDRESS 0xC000915C /end MEASUREMENT
/begin MEASUREMENT PCBS_lSyncCalc2_mp "" SLONG km_sw_q10 1 100 -21474836480.0 21474836470.0 FORMAT "%13.1" ECU_ADDRESS 0xC0009160 /end MEASUREMENT
/begin MEASUREMENT PCBS_lSyncCalc3_mp "" SLONG km_sw_q10 1 100 -21474836480.0 21474836470.0 FORMAT "%13.1" ECU_ADDRESS 0xC0009164 /end MEASUREMENT
/begin MEASUREMENT PCBS_lSyncCalc4_mp "" SLONG km_sw_q10 1 100 -21474836480.0 21474836470.0 FORMAT "%13.1" ECU_ADDRESS 0xC0009168 /end MEASUREMENT
/begin MEASUREMENT PCBS_lSyncChng1_mp "" SLONG km_sw_q10 1 100 -21474836480.0 21474836470.0 FORMAT "%13.1" ECU_ADDRESS 0xC000916C /end MEASUREMENT
/begin MEASUREMENT PCBS_lSyncChng2_mp "" SLONG km_sw_q10 1 100 -21474836480.0 21474836470.0 FORMAT "%13.1" ECU_ADDRESS 0xC0009170 /end MEASUREMENT
/begin MEASUREMENT PCBS_lSyncChng_mp "" SLONG km_sw_q10 1 100 -21474836480.0 21474836470.0 FORMAT "%13.1" ECU_ADDRESS 0xC0009174 /end MEASUREMENT
/begin MEASUREMENT PCBS_numTrack_mp "" UBYTE OneToOne 1 100 0.00 255.0 ECU_ADDRESS 0xC000B3F6 /end MEASUREMENT
/begin MEASUREMENT PCBS_qFlTotCorIn_mp "" SWORD Fl_2 1 100 -327680.0 327670.0 FORMAT "%8.1" ECU_ADDRESS 0xC000A64E /end MEASUREMENT
/begin MEASUREMENT PCBS_qFlTotDMEChg "" SLONG Fl_L 1 100 -21474836.4800 21474836.4700 FORMAT "%13.4" ECU_ADDRESS 0xD0002F68 /end MEASUREMENT
/begin MEASUREMENT PCBS_qFlTotDMEChg_mp "" SWORD Fl_2 1 100 -327680.0 327670.0 FORMAT "%8.1" ECU_ADDRESS 0xC000A650 /end MEASUREMENT
/begin MEASUREMENT PCBS_qFl_mp "" SLONG Fl_2 1 100 -21474836480.0 21474836470.0 FORMAT "%13.1" ECU_ADDRESS 0xC0009178 /end MEASUREMENT
/begin MEASUREMENT PCBS_rFl_mp "" UBYTE Fact_PCBS 1 100 0.00 2.550 FORMAT "%5.3" ECU_ADDRESS 0xC000B3F7 /end MEASUREMENT
/begin MEASUREMENT PCBS_rKvb_mp "" UBYTE Fact_PCBS 1 100 0.00 2.550 FORMAT "%5.3" ECU_ADDRESS 0xC000B3F8 /end MEASUREMENT
/begin MEASUREMENT PCBS_rPFlt_mp "" UBYTE Fact_PCBS 1 100 0.00 2.550 FORMAT "%5.3" ECU_ADDRESS 0xC000B3F9 /end MEASUREMENT
/begin MEASUREMENT PCBS_rwanzIn_mp "" SWORD km_sw_q10 1 100 -327680.0 327670.0 FORMAT "%8.1" ECU_ADDRESS 0xC000A652 /end MEASUREMENT
/begin MEASUREMENT PCBS_rwprogIn_mp "" UWORD km_sw_q10 1 100 0.00 655350.0 FORMAT "%8.1" ECU_ADDRESS 0xC000A654 /end MEASUREMENT
/begin MEASUREMENT PCBS_stCalc "" UWORD OneToOne 1 100 0.00 65535.00 ECU_ADDRESS 0xD000160C /end MEASUREMENT
/begin MEASUREMENT PCBS_stCBSMsg "" UBYTE OneToOne 1 100 0.00 255.0 ECU_ADDRESS 0xD0001FF6 /end MEASUREMENT
/begin MEASUREMENT PCBS_stCntValOut "" UBYTE OneToOne 1 100 0.00 255.0 ECU_ADDRESS 0xD0001FF7 /end MEASUREMENT
/begin MEASUREMENT PCBS_stDMEChg "" UBYTE OneToOne 1 100 0.00 255.0 ECU_ADDRESS 0xD0001FF8 /end MEASUREMENT
/begin MEASUREMENT PCBS_stDMEIni "" UBYTE OneToOne 1 100 0.00 255.0 ECU_ADDRESS 0xD0001FF9 /end MEASUREMENT
/begin MEASUREMENT PCBS_stDMEIni_mp "" UBYTE OneToOne 1 100 0.00 255.0 ECU_ADDRESS 0xC000B3FA /end MEASUREMENT
/begin MEASUREMENT PCBS_stIdCBS4 "" UBYTE OneToOne 1 100 0.00 255.0 ECU_ADDRESS 0xD0001FFA /end MEASUREMENT
/begin MEASUREMENT PCBS_stIdFnCBS4 "" UWORD OneToOne 1 100 0.00 65535.00 ECU_ADDRESS 0xD0001610 /end MEASUREMENT
/begin MEASUREMENT PCBS_stIDMsg "" UWORD OneToOne 1 100 0.00 65535.00 ECU_ADDRESS 0xD000160E /end MEASUREMENT
/begin MEASUREMENT PCBS_stManip_mp "" UBYTE OneToOne 1 100 0.00 255.0 ECU_ADDRESS 0xC000B3FB /end MEASUREMENT
/begin MEASUREMENT PCBS_stOilReset_mp "" UBYTE OneToOne 1 100 0.00 255.0 ECU_ADDRESS 0xC000B3FC /end MEASUREMENT
/begin MEASUREMENT PCBS_stPFltChg "" UBYTE OneToOne 1 100 0.00 255.0 ECU_ADDRESS 0xD0001FFC /end MEASUREMENT
/begin MEASUREMENT PCBS_stProgMon "" UBYTE OneToOne 1 100 0.00 255.0 ECU_ADDRESS 0xD0001FFD /end MEASUREMENT
/begin MEASUREMENT PCBS_stProgTime "" UBYTE OneToOne 1 100 0.00 255.0 ECU_ADDRESS 0xD0001FFE /end MEASUREMENT
/begin MEASUREMENT PCBS_stProgYr "" UBYTE OneToOne 1 100 0.00 255.0 ECU_ADDRESS 0xD0001FFF /end MEASUREMENT
/begin MEASUREMENT PCBS_stRequest_mp "" UBYTE OneToOne 1 100 0.00 255.0 ECU_ADDRESS 0xC000B3FD /end MEASUREMENT
/begin MEASUREMENT PCBS_stSyncCalc_mp "" UWORD OneToOne 1 100 0.00 65535.00 ECU_ADDRESS 0xC000A656 /end MEASUREMENT
/begin MEASUREMENT PCBS_stSyncOld_mp "" UBYTE OneToOne 1 100 0.00 255.0 ECU_ADDRESS 0xC000B3FE /end MEASUREMENT
/begin MEASUREMENT PCBS_stSync_mp "" UBYTE OneToOne 1 100 0.00 255.0 ECU_ADDRESS 0xC000B3FF /end MEASUREMENT
/begin MEASUREMENT PCBS_stTrack_mp "" UWORD OneToOne 1 100 0.00 65535.00 ECU_ADDRESS 0xC000A658 /end MEASUREMENT
/begin MEASUREMENT PCBS_stUnit "" UBYTE OneToOne 1 100 0.00 255.0 ECU_ADDRESS 0xD0002000 /end MEASUREMENT
/begin MEASUREMENT PCBS_vfanzIn_mp "" UBYTE OneToOne 1 100 0.00 255.0 ECU_ADDRESS 0xC000B400 /end MEASUREMENT
/begin MEASUREMENT PCR_ActModeCtlCalc_mp "Messpunkt zur Anzeige der aktuellen Betriebsart" UBYTE OneToOne 1 100 0.00 255.0 ECU_ADDRESS 0xC000B407 /end MEASUREMENT
/begin MEASUREMENT PCR_ActModeDesCalc_mp "Messpunkt zur Anzeige der aktuellen Betriebsart" UBYTE OneToOne 1 100 0.00 255.0 ECU_ADDRESS 0xC000B40A /end MEASUREMENT
/begin MEASUREMENT PCR_DesModeCtlCalc_mp "Messpunkt zur Anzeige der gewünschten Betriebsart" UBYTE OneToOne 1 100 0.00 255.0 ECU_ADDRESS 0xC000B408 /end MEASUREMENT
/begin MEASUREMENT PCR_DesModeDesCalc_mp "Messpunkt zur Anzeige der gewünschten Betriebsart" UBYTE OneToOne 1 100 0.00 255.0 ECU_ADDRESS 0xC000B40B /end MEASUREMENT
/begin MEASUREMENT PCR_dpBGDev_mp "Ladedruckgradient Basis für Korrektur D-Verstärkung" SWORD dp_dZ20 1 100 -327680.0 327670.0 FORMAT "%8.1" ECU_ADDRESS 0xC000A7CE /end MEASUREMENT
/begin MEASUREMENT PCR_drAPPUnFlt "" SWORD PrcPerSec 1 100 -20000.00 19999.39 FORMAT "%8.2" ECU_ADDRESS 0xD0001112 /end MEASUREMENT
/begin MEASUREMENT PCR_drPID_mp "" SWORD PrcPerSec 1 100 -20000.00 19999.39 FORMAT "%8.2" ECU_ADDRESS 0xC000A7D0 /end MEASUREMENT
/begin MEASUREMENT PCR_facAirCtlCorNeg_mp "" SWORD Fact 1 100 -4.000000 3.999878 ECU_ADDRESS 0xC000A7D2 /end MEASUREMENT
/begin MEASUREMENT PCR_facAirCtlCorPos_mp "" SWORD Fact 1 100 -4.000000 3.999878 ECU_ADDRESS 0xC000A7D4 /end MEASUREMENT
/begin MEASUREMENT PCR_facAirTempCtlACorLPEOM_mp "" SWORD Fact 1 100 -4.000000 3.999878 ECU_ADDRESS 0xC000A6B4 /end MEASUREMENT
/begin MEASUREMENT PCR_facAirTempCtlAutLPCor_mp "" SWORD Fact 1 100 -4.000000 3.999878 ECU_ADDRESS 0xC000A6B6 /end MEASUREMENT
/begin MEASUREMENT PCR_facAirTempCtlCorEOM_mp "Temperatur-Korrekturfaktor für den Ladedruck-Steuerwert bei alternativer Betriebsart" SWORD Fact 1 100 -4.000000 3.999878 ECU_ADDRESS 0xC000A65E /end MEASUREMENT
/begin MEASUREMENT PCR_facAirTempCtlCor_mp "Lufttemperaturabhängiger Korrekturfaktor für den Ladedruck-Steueranteil im Normalbetrieb" SWORD Fact 1 100 -4.000000 3.999878 ECU_ADDRESS 0xC000A660 /end MEASUREMENT
/begin MEASUREMENT PCR_facAirTempDesCorEOM_mp "Temperatur-Korrekturfaktor für den Ladedruck-Sollwert bei alternativer Betriebsart" SWORD Fact 1 100 -4.000000 3.999878 ECU_ADDRESS 0xC000A6FA /end MEASUREMENT
/begin MEASUREMENT PCR_facAirTempDesCorLPEOMQnt1_mp "" SWORD Fact 1 100 -4.000000 3.999878 ECU_ADDRESS 0xC000A782 /end MEASUREMENT
/begin MEASUREMENT PCR_facAirTempDesCorLPEOMQnt2_mp "" SWORD Fact 1 100 -4.000000 3.999878 ECU_ADDRESS 0xC000A784 /end MEASUREMENT
/begin MEASUREMENT PCR_facAirTempDesCorLP_mp "" SWORD Fact 1 100 -4.000000 3.999878 ECU_ADDRESS 0xC000A786 /end MEASUREMENT
/begin MEASUREMENT PCR_facAirTempDesCor_mp "Lufttemperaturabhängiger Korrekturfaktor für den Ladedruck-Sollwert" SWORD Fact 1 100 -4.000000 3.999878 ECU_ADDRESS 0xC000A6FC /end MEASUREMENT
/begin MEASUREMENT PCR_facD1_mp "Adaptionsfaktor Grundwert für Regler D-Verstärkung" SWORD Fact1 1 100 -256.0000 255.9922 ECU_ADDRESS 0xC000A7D6 /end MEASUREMENT
/begin MEASUREMENT PCR_facD2_mp "Adaptionsfaktor Grundwert für Regler D-Verstärkung" SWORD Fact1 1 100 -256.0000 255.9922 ECU_ADDRESS 0xC000A7D8 /end MEASUREMENT
/begin MEASUREMENT PCR_facdpCorr_mp "Korrekturfaktor aus Ladedruckgradient für D-Verstärkung" SWORD Fact1 1 100 -256.0000 255.9922 ECU_ADDRESS 0xC000A7DA /end MEASUREMENT
/begin MEASUREMENT PCR_facD_mp "Adaptionsfaktor für die D-Verstärkung des Reglers" SWORD Fact1 1 100 -256.0000 255.9922 ECU_ADDRESS 0xC000A7DC /end MEASUREMENT
/begin MEASUREMENT PCR_facEngTempCtlCorLP_mp "" SWORD Fact 1 100 -4.000000 3.999878 ECU_ADDRESS 0xC000A6B8 /end MEASUREMENT
/begin MEASUREMENT PCR_facEngTempCtlCor_mp "Motortemperaturabhängiger Korrekturfaktor für den Ladedruck-Steueranteil" SWORD Fact 1 100 -4.000000 3.999878 ECU_ADDRESS 0xC000A662 /end MEASUREMENT
/begin MEASUREMENT PCR_facEnvPresCtlAirCtlCor_mp "" SWORD Fact 1 100 -4.000000 3.999878 ECU_ADDRESS 0xC000A664 /end MEASUREMENT
/begin MEASUREMENT PCR_facEnvPresCtlCorAutLPEOMQnt1_mp "" SWORD Fact 1 100 -4.000000 3.999878 ECU_ADDRESS 0xC000A6BA /end MEASUREMENT
/begin MEASUREMENT PCR_facEnvPresCtlCorAutLP_mp "" SWORD Fact 1 100 -4.000000 3.999878 ECU_ADDRESS 0xC000A6BC /end MEASUREMENT
/begin MEASUREMENT PCR_facEnvPresCtlCorEOMQnt1_mp "Atmosphärendruckabhängiger Korrekturfaktor für die Ladedruck-Steuerung für die erste auf Einspritzmenge basierte Betriebsart" SWORD Fact 1 100 -4.000000 3.999878 ECU_ADDRESS 0xC000A666 /end MEASUREMENT
/begin MEASUREMENT PCR_facEnvPresCtlCorEOMQnt2_mp "Atmosphärendruckabhängiger Korrekturfaktor für die Ladedruck-Steuerung für die zweite auf Einspritzmenge basierte Betriebsart" SWORD Fact 1 100 -4.000000 3.999878 ECU_ADDRESS 0xC000A668 /end MEASUREMENT
/begin MEASUREMENT PCR_facEnvPresCtlCorLPEOMQnt1_mp "" SWORD Fact 1 100 -4.000000 3.999878 ECU_ADDRESS 0xC000A6BE /end MEASUREMENT
/begin MEASUREMENT PCR_facEnvPresCtlCorLP_mp "" SWORD Fact 1 100 -4.000000 3.999878 ECU_ADDRESS 0xC000A6C0 /end MEASUREMENT
/begin MEASUREMENT PCR_facEnvPresCtlCor_mp "Atmosphärendruckabhängiger Korrekturfaktor für die Ladedruck-Steuerung" SWORD Fact 1 100 -4.000000 3.999878 ECU_ADDRESS 0xC000A66A /end MEASUREMENT
/begin MEASUREMENT PCR_facEnvPresDesAirCtlCor_mp "" SWORD Fact 1 100 -4.000000 3.999878 ECU_ADDRESS 0xC000A6FE /end MEASUREMENT
/begin MEASUREMENT PCR_facEnvPresDesCorEOMQnt1_mp "Atmosphärendruckabhängiger Korrekturfaktor für den Ladedruck-Sollwert die erste auf Einspritzmenge basierte Betriebsart für Ladedruck" SWORD Fact 1 100 -4.000000 3.999878 ECU_ADDRESS 0xC000A700 /end MEASUREMENT
/begin MEASUREMENT PCR_facEnvPresDesCorEOMQnt2_mp "Atmosphärendruckabhängiger Korrekturfaktor für den Ladedruck-Sollwert die zweite auf Einspritzmenge basierte Betriebsart für Ladedruck" SWORD Fact 1 100 -4.000000 3.999878 ECU_ADDRESS 0xC000A702 /end MEASUREMENT
/begin MEASUREMENT PCR_facEnvPresDesCorLPEOMQnt1_mp "" SWORD Fact 1 100 -4.000000 3.999878 ECU_ADDRESS 0xC000A788 /end MEASUREMENT
/begin MEASUREMENT PCR_facEnvPresDesCorLPEOMQnt2_mp "" SWORD Fact 1 100 -4.000000 3.999878 ECU_ADDRESS 0xC000A78A /end MEASUREMENT
/begin MEASUREMENT PCR_facEnvPresDesCorLP_mp "" SWORD Fact 1 100 -4.000000 3.999878 ECU_ADDRESS 0xC000A78C /end MEASUREMENT
/begin MEASUREMENT PCR_facEnvPresDesCor_mp "Atmosphärendruckabhängiger Korrekturfaktor für den Ladedruck-Sollwert" SWORD Fact 1 100 -4.000000 3.999878 ECU_ADDRESS 0xC000A704 /end MEASUREMENT
/begin MEASUREMENT PCR_facI_mp "Adaptionsfaktor für Regler-I-Verstärkung" SWORD Fact1 1 100 -256.0000 255.9922 ECU_ADDRESS 0xC000A7DE /end MEASUREMENT
/begin MEASUREMENT PCR_facPFltLdCtlVal_mp "Partikelfilterbeladungs-Korrekturfaktor für den Ladedruck-Steuerwert" SWORD Fact1 1 100 -256.0000 255.9922 ECU_ADDRESS 0xC000A66C /end MEASUREMENT
/begin MEASUREMENT PCR_facP_mp "Adaptionsfaktor für Regler-P-Verstärkung" SWORD Fact1 1 100 -256.0000 255.9922 ECU_ADDRESS 0xC000A7E0 /end MEASUREMENT
/begin MEASUREMENT PCR_facResFlwCorr_mp "" SWORD Fact1 1 100 -256.0000 255.9922 ECU_ADDRESS 0xC000A7E2 /end MEASUREMENT
/begin MEASUREMENT PCR_facRmpCtlCor_mp "Messpunkt zur Betriebspunktanzeige der Kennlinien für den Rampenfaktor" SWORD CoEOMSwt_S16 1 100 -2.000000 1.999939 FORMAT "%8.6" ECU_ADDRESS 0xC000A66E /end MEASUREMENT
/begin MEASUREMENT PCR_facRmpDesCor_mp "Messpunkt zur Betriebspunktanzeige der Kennlinien für den Rampenfaktor" SWORD CoEOMSwt_S16 1 100 -2.000000 1.999939 FORMAT "%8.6" ECU_ADDRESS 0xC000A706 /end MEASUREMENT
/begin MEASUREMENT PCR_facRmpVal "EOM-Rampenwert zur Umschaltung Steuerung/Regelung" SLONG AirSysSwt 1 100 -131.072000000 131.071999939 FORMAT "%13.9" ECU_ADDRESS 0xD0002F6C /end MEASUREMENT
/begin MEASUREMENT PCR_facRmpValCtlCorAutLP_mp "" SWORD CoEOMSwt_S16 1 100 -2.000000 1.999939 FORMAT "%8.6" ECU_ADDRESS 0xC000A6C2 /end MEASUREMENT
/begin MEASUREMENT PCR_facRmpValCtlCorLP_mp "" SWORD CoEOMSwt_S16 1 100 -2.000000 1.999939 FORMAT "%8.6" ECU_ADDRESS 0xC000A6C4 /end MEASUREMENT
/begin MEASUREMENT PCR_facRmpValCtlCorQnt1_mp "Rampesteigung der erste auf Einspritzmenge basierte Betriebsart des Ladedrucksteuerwert" SWORD CoEOMSwt_S16 1 100 -2.000000 1.999939 FORMAT "%8.6" ECU_ADDRESS 0xC000A670 /end MEASUREMENT
/begin MEASUREMENT PCR_facRmpValCtlCorQnt2_mp "Rampesteigung der zweite auf Einspritzmenge basierte Betriebsart des Ladedrucksteuerwert" SWORD CoEOMSwt_S16 1 100 -2.000000 1.999939 FORMAT "%8.6" ECU_ADDRESS 0xC000A672 /end MEASUREMENT
/begin MEASUREMENT PCR_facRmpValCtlCor_mp "korrigierter EOM-Rampenwert für die Ladedruck-Steuerung" SWORD CoEOMSwt_S16 1 100 -2.000000 1.999939 FORMAT "%8.6" ECU_ADDRESS 0xC000A674 /end MEASUREMENT
/begin MEASUREMENT PCR_facRmpValDesCorLP_mp "" SWORD CoEOMSwt_S16 1 100 -2.000000 1.999939 FORMAT "%8.6" ECU_ADDRESS 0xC000A78E /end MEASUREMENT
/begin MEASUREMENT PCR_facRmpValDesCorQnt1_mp "Rampesteigung der erste auf Einspritzmenge basierte Betriebsart des Ladedrucksollwert" SWORD CoEOMSwt_S16 1 100 -2.000000 1.999939 FORMAT "%8.6" ECU_ADDRESS 0xC000A708 /end MEASUREMENT
/begin MEASUREMENT PCR_facRmpValDesCorQnt2_mp "Rampesteigung der zweite auf Einspritzmenge basierte Betriebsart des Ladedrucksollwert" SWORD CoEOMSwt_S16 1 100 -2.000000 1.999939 FORMAT "%8.6" ECU_ADDRESS 0xC000A70A /end MEASUREMENT
/begin MEASUREMENT PCR_facRmpValDesCor_mp "korrigierter EOM-Rampenwert für die Ladedrucksollwertberechnung" SWORD CoEOMSwt_S16 1 100 -2.000000 1.999939 FORMAT "%8.6" ECU_ADDRESS 0xC000A70C /end MEASUREMENT
/begin MEASUREMENT PCR_facRmpValDesLP_mp "" SWORD CoEOMSwt_S16 1 100 -2.000000 1.999939 FORMAT "%8.6" ECU_ADDRESS 0xC000A790 /end MEASUREMENT
/begin MEASUREMENT PCR_facT1_mp "Adaptionsfaktor für Verzögerungszeit des DT1-Gliedes" SWORD Fact1 1 100 -256.0000 255.9922 ECU_ADDRESS 0xC000A7E4 /end MEASUREMENT
/begin MEASUREMENT PCR_facTempDesCorEOMQnt1_mp "Temperaturabhängiger Korrekturfaktor für den Ladedruck-Sollwert für die erste auf Einspritzmenge basierte Betriebsart für die Ladedrucksollwertberechnung" SWORD Fact 1 100 -4.000000 3.999878 ECU_ADDRESS 0xC000A70E /end MEASUREMENT
/begin MEASUREMENT PCR_facTempDesCorEOMQnt2_mp "Temperaturabhängiger Korrekturfaktor für den Ladedruck-Sollwert für die zweite auf Einspritzmenge basierte Betriebsart für die Ladedrucksollwertberechnung" SWORD Fact 1 100 -4.000000 3.999878 ECU_ADDRESS 0xC000A710 /end MEASUREMENT
/begin MEASUREMENT PCR_facTempDesCorLPEOMQnt1_mp "" SWORD Fact 1 100 -4.000000 3.999878 ECU_ADDRESS 0xC000A792 /end MEASUREMENT
/begin MEASUREMENT PCR_facTempDesCorLPEOMQnt2_mp "" SWORD Fact 1 100 -4.000000 3.999878 ECU_ADDRESS 0xC000A794 /end MEASUREMENT
/begin MEASUREMENT PCR_facTempDesCorLP_mp "" SWORD Fact 1 100 -4.000000 3.999878 ECU_ADDRESS 0xC000A796 /end MEASUREMENT
/begin MEASUREMENT PCR_facTempDesCor_mp "Temperaturabhängiger Korrekturfaktor für den Ladedruck-Sollwert" SWORD Fact 1 100 -4.000000 3.999878 ECU_ADDRESS 0xC000A712 /end MEASUREMENT
/begin MEASUREMENT PCR_GovOff_mp "Untere Begrenzung der Einspritzmenge oder des Inneren Drehmoments für das Ausschalten des Reglers" SWORD InjMass 1 100 -327.6800 327.6700 ECU_ADDRESS 0xC000A7E6 /end MEASUREMENT
/begin MEASUREMENT PCR_GovOn_mp "resp." SWORD InjMass 1 100 -327.6800 327.6700 ECU_ADDRESS 0xC000A7E8 /end MEASUREMENT
/begin MEASUREMENT PCR_nTrbChDev_mp "" SWORD TurboN 1 100 -327680.0 327670.0 FORMAT "%8.1" ECU_ADDRESS 0xC000A714 /end MEASUREMENT
/begin MEASUREMENT PCR_nTrbChFlt_mp "" SWORD TurboN 1 100 -327680.0 327670.0 FORMAT "%8.1" ECU_ADDRESS 0xC000A716 /end MEASUREMENT
/begin MEASUREMENT PCR_nTrbChPrtOfs_mp "" SWORD TurboN 1 100 -327680.0 327670.0 FORMAT "%8.1" ECU_ADDRESS 0xC000A718 /end MEASUREMENT
/begin MEASUREMENT PCR_nTrbChSetPoint_mp "" SWORD TurboN 1 100 -327680.0 327670.0 FORMAT "%8.1" ECU_ADDRESS 0xC000A71A /end MEASUREMENT
/begin MEASUREMENT PCR_nTrbChThres_mp "" SWORD TurboN 1 100 -327680.0 327670.0 FORMAT "%8.1" ECU_ADDRESS 0xC000A71C /end MEASUREMENT
/begin MEASUREMENT PCR_pActVal_mp "Ist-Wert des Ladedrucks" SWORD Pres_hPa 1 100 -32768.00 3500.00 ECU_ADDRESS 0xC000A7EA /end MEASUREMENT
/begin MEASUREMENT PCR_pAdapPPFltUs_mp "Messpunkt zur Betriebspunktanzeige der Kennlinien für Partikelfiltergegendruck-Korrektur" SWORD Pres_hPa 1 100 -32768.00 3500.00 ECU_ADDRESS 0xC000A7EC /end MEASUREMENT
/begin MEASUREMENT PCR_pDesAirCtlOff_mp "" SWORD Pres_hPa 1 100 -32768.00 3500.00 ECU_ADDRESS 0xC000A71E /end MEASUREMENT
/begin MEASUREMENT PCR_pDesBasAirCtlOffHiAltd_mp "" SWORD Pres_hPa 1 100 -32768.00 3500.00 ECU_ADDRESS 0xC000A720 /end MEASUREMENT
/begin MEASUREMENT PCR_pDesBasAirCtlOff_mp "" SWORD Pres_hPa 1 100 -32768.00 3500.00 ECU_ADDRESS 0xC000A722 /end MEASUREMENT
/begin MEASUREMENT PCR_pDesBasEOMQnt1_mp "Basis-Ladedruck-Sollwert für die erste auf Einspritzmenge basierte Betriebsart" SWORD Pres_hPa 1 100 -32768.00 3500.00 ECU_ADDRESS 0xC000A724 /end MEASUREMENT
/begin MEASUREMENT PCR_pDesBasEOMQnt2_mp "Basis-Ladedruck-Sollwert für die zweite auf Einspritzmenge basierte Betriebsart" SWORD Pres_hPa 1 100 -32768.00 3500.00 ECU_ADDRESS 0xC000A726 /end MEASUREMENT
/begin MEASUREMENT PCR_pDesBasHiAltdEOMQnt1_mp "höhenabhängiger Basis-Ladedruck-Sollwert für die erste auf Einspritzmenge basierte Betriebsart" SWORD Pres_hPa 1 100 -32768.00 3500.00 ECU_ADDRESS 0xC000A728 /end MEASUREMENT
/begin MEASUREMENT PCR_pDesBasHiAltdEOMQnt2_mp "höhenabhängiger Basis-Ladedruck-Sollwert für die zweite auf Einspritzmenge basierte Betriebsart" SWORD Pres_hPa 1 100 -32768.00 3500.00 ECU_ADDRESS 0xC000A72A /end MEASUREMENT
/begin MEASUREMENT PCR_pDesBasHiAltd_mp "höhenabhängiger Basis-Ladedruck-Sollwert" SWORD Pres_hPa 1 100 -32768.00 3500.00 ECU_ADDRESS 0xC000A72C /end MEASUREMENT
/begin MEASUREMENT PCR_pDesBasLPEOMQnt1_mp "" SWORD Pres_hPa 1 100 -32768.00 3500.00 ECU_ADDRESS 0xC000A798 /end MEASUREMENT
/begin MEASUREMENT PCR_pDesBasLPEOMQnt2_mp "" SWORD Pres_hPa 1 100 -32768.00 3500.00 ECU_ADDRESS 0xC000A79A /end MEASUREMENT
/begin MEASUREMENT PCR_pDesBasLPHiAltdEOMQnt1_mp "" SWORD Pres_hPa 1 100 -32768.00 3500.00 ECU_ADDRESS 0xC000A79C /end MEASUREMENT
/begin MEASUREMENT PCR_pDesBasLPHiAltdEOMQnt2_mp "" SWORD Pres_hPa 1 100 -32768.00 3500.00 ECU_ADDRESS 0xC000A79E /end MEASUREMENT
/begin MEASUREMENT PCR_pDesBasLPHiAltd_mp "" SWORD Pres_hPa 1 100 -32768.00 3500.00 ECU_ADDRESS 0xC000A7A0 /end MEASUREMENT
/begin MEASUREMENT PCR_pDesBasLP_mp "" SWORD Pres_hPa 1 100 -32768.00 3500.00 ECU_ADDRESS 0xC000A7A2 /end MEASUREMENT
/begin MEASUREMENT PCR_pDesBas_mp "Basis-Ladedruck-Sollwert" SWORD Pres_hPa 1 100 -32768.00 3500.00 ECU_ADDRESS 0xC000A72E /end MEASUREMENT
/begin MEASUREMENT PCR_pDesDyn_mp "dynamischer Anteil des Ladedruck-Sollwerts" SWORD Pres_hPa 1 100 -32768.00 3500.00 ECU_ADDRESS 0xC000A730 /end MEASUREMENT
/begin MEASUREMENT PCR_pDesLimVal2_mp "unbegrenzter Ladedrucksollwert 2 (nach Abfallbegrenzung)" SWORD Pres_hPa 1 100 -32768.00 3500.00 ECU_ADDRESS 0xC000A732 /end MEASUREMENT
/begin MEASUREMENT PCR_pDesLim_mp "begrenzter Ladedruck-Sollwert" SWORD Pres_hPa 1 100 -32768.00 3500.00 ECU_ADDRESS 0xC000A734 /end MEASUREMENT
/begin MEASUREMENT PCR_pDesMonHiAltd_mp "" SWORD Pres_hPa 1 100 -32768.00 3500.00 ECU_ADDRESS 0xC000A736 /end MEASUREMENT
/begin MEASUREMENT PCR_pDesRawCor_mp "" SWORD Pres_hPa 1 100 -32768.00 3500.00 ECU_ADDRESS 0xC000A738 /end MEASUREMENT
/begin MEASUREMENT PCR_pDesRaw_mp "unbegrenzter Ladedruck-Sollwert" SWORD Pres_hPa 1 100 -32768.00 3500.00 ECU_ADDRESS 0xC000A73A /end MEASUREMENT
/begin MEASUREMENT PCR_pDesStat "stationärer Ladedruck-Sollwert" SWORD Pres_hPa 1 100 -32768.00 3500.00 ECU_ADDRESS 0xD0001114 /end MEASUREMENT
/begin MEASUREMENT PCR_pDesStatLP_mp "" SWORD Pres_hPa 1 100 -32768.00 3500.00 ECU_ADDRESS 0xC000A7A4 /end MEASUREMENT
/begin MEASUREMENT PCR_pDesStatVal1Cor_mp "korrigierter stationärer Ladedruck-Sollwert" SWORD Pres_hPa 1 100 -32768.00 3500.00 ECU_ADDRESS 0xC000A73C /end MEASUREMENT
/begin MEASUREMENT PCR_pDesStatVal2Cor_mp "" SWORD Pres_hPa 1 100 -32768.00 3500.00 ECU_ADDRESS 0xC000A73E /end MEASUREMENT
/begin MEASUREMENT PCR_pDesT20Cor "" SWORD Pres_hPa 1 100 -32768.00 3500.00 ECU_ADDRESS 0xD000111A /end MEASUREMENT
/begin MEASUREMENT PCR_pDesT20CorRaw_mp "" SWORD Pres_hPa 1 100 -32768.00 3500.00 ECU_ADDRESS 0xC000A740 /end MEASUREMENT
/begin MEASUREMENT PCR_pDesTrbChPrtCor "" SWORD Pres_hPa 1 100 -32768.00 3500.00 ECU_ADDRESS 0xD0001120 /end MEASUREMENT
/begin MEASUREMENT PCR_pDesTrbChPrtCorRaw_mp "" SWORD Pres_hPa 1 100 -32768.00 3500.00 ECU_ADDRESS 0xC000A742 /end MEASUREMENT
/begin MEASUREMENT PCR_pDesVal "Ladedruck-Sollwert" SWORD Pres_hPa 1 100 -32768.00 3500.00 ECU_ADDRESS 0xD0001126 /end MEASUREMENT
/begin MEASUREMENT PCR_pDesVal1EOMQnt1_mp "Luftdruckkorrigierter Basis-Ladedruck-Sollwert für die erste auf Einspritzmenge basierte Betriebsart" SWORD Pres_hPa 1 100 -32768.00 3500.00 ECU_ADDRESS 0xC000A744 /end MEASUREMENT
/begin MEASUREMENT PCR_pDesVal1EOMQnt2_mp "Luftdruckkorrigierter Basis-Ladedruck-Sollwert für die zweite auf Einspritzmenge basierte Betriebsart" SWORD Pres_hPa 1 100 -32768.00 3500.00 ECU_ADDRESS 0xC000A746 /end MEASUREMENT
/begin MEASUREMENT PCR_pDesVal1LPEOMQnt1_mp "" SWORD Pres_hPa 1 100 -32768.00 3500.00 ECU_ADDRESS 0xC000A7A6 /end MEASUREMENT
/begin MEASUREMENT PCR_pDesVal1LPEOMQnt2_mp "" SWORD Pres_hPa 1 100 -32768.00 3500.00 ECU_ADDRESS 0xC000A7A8 /end MEASUREMENT
/begin MEASUREMENT PCR_pDesVal1LP_mp "" SWORD Pres_hPa 1 100 -32768.00 3500.00 ECU_ADDRESS 0xC000A7AA /end MEASUREMENT
/begin MEASUREMENT PCR_pDesVal1_mp "Luftdruckkorrigierter Basis-Ladedruck-Sollwert" SWORD Pres_hPa 1 100 -32768.00 3500.00 ECU_ADDRESS 0xC000A748 /end MEASUREMENT
/begin MEASUREMENT PCR_pDesVal2Cor_mp "Ladedruck-Sollwert nach Druck-Korrektur" SWORD Pres_hPa 1 100 -32768.00 3500.00 ECU_ADDRESS 0xC000A74A /end MEASUREMENT
/begin MEASUREMENT PCR_pDesVal2EOMQnt1_mp "Ladedruck-Sollwert nach Motortemperaturkorrektur für die erste auf Einspritzmenge basierte Betriebsart" SWORD Pres_hPa 1 100 -32768.00 3500.00 ECU_ADDRESS 0xC000A74C /end MEASUREMENT
/begin MEASUREMENT PCR_pDesVal2EOMQnt2_mp "Ladedruck-Sollwert nach Motortemperaturkorrektur für die zweite auf Einspritzmenge basierte Betriebsart" SWORD Pres_hPa 1 100 -32768.00 3500.00 ECU_ADDRESS 0xC000A74E /end MEASUREMENT
/begin MEASUREMENT PCR_pDesVal2LPEOMQnt1_mp "" SWORD Pres_hPa 1 100 -32768.00 3500.00 ECU_ADDRESS 0xC000A7AC /end MEASUREMENT
/begin MEASUREMENT PCR_pDesVal2LPEOMQnt2_mp "" SWORD Pres_hPa 1 100 -32768.00 3500.00 ECU_ADDRESS 0xC000A7AE /end MEASUREMENT
/begin MEASUREMENT PCR_pDesVal2LP_mp "" SWORD Pres_hPa 1 100 -32768.00 3500.00 ECU_ADDRESS 0xC000A7B0 /end MEASUREMENT
/begin MEASUREMENT PCR_pDesVal2_mp "Ladedruck-Sollwert nach Motortemperaturkorrektur" SWORD Pres_hPa 1 100 -32768.00 3500.00 ECU_ADDRESS 0xC000A750 /end MEASUREMENT
/begin MEASUREMENT PCR_pDesVal3EOM_mp "Um die Temperatur korrigierte Ladedruck-Sollwerte für die vierte alternative Betriebsart" SWORD Pres_hPa 1 100 -32768.00 3500.00 ARRAY_SIZE 2 ECU_ADDRESS 0xC000C428 /end MEASUREMENT
/begin MEASUREMENT PCR_pDesVal3LPEOMQnt1_mp "" SWORD Pres_hPa 1 100 -32768.00 3500.00 ECU_ADDRESS 0xC000A7B2 /end MEASUREMENT
/begin MEASUREMENT PCR_pDesVal3LPEOMQnt2_mp "" SWORD Pres_hPa 1 100 -32768.00 3500.00 ECU_ADDRESS 0xC000A7B4 /end MEASUREMENT
/begin MEASUREMENT PCR_pDesVal3_mp "Ladedruck-Sollwert nach Lufttemperaturkorrektur" SWORD Pres_hPa 1 100 -32768.00 3500.00 ECU_ADDRESS 0xC000A752 /end MEASUREMENT
/begin MEASUREMENT PCR_pDesValLP "" SWORD Pres_hPa 1 100 -32768.00 3500.00 ECU_ADDRESS 0xD000112C /end MEASUREMENT
/begin MEASUREMENT PCR_pDesValLPUnLim_mp "" SWORD Pres_hPa 1 100 -32768.00 3500.00 ECU_ADDRESS 0xC000A7B6 /end MEASUREMENT
/begin MEASUREMENT PCR_pDesValMon "" SWORD Pres_hPa 1 100 -32768.00 3500.00 ECU_ADDRESS 0xD0001132 /end MEASUREMENT
/begin MEASUREMENT PCR_pDesValMonUnCor_mp "" SWORD Pres_hPa 1 100 -32768.00 3500.00 ECU_ADDRESS 0xC000A754 /end MEASUREMENT
/begin MEASUREMENT PCR_pDesValNrmLP_mp "" SWORD Pres_hPa 1 100 -32768.00 3500.00 ECU_ADDRESS 0xC000A7B8 /end MEASUREMENT
/begin MEASUREMENT PCR_pDesValNrm_mp "stationärer Ladedruck-Sollwert im Normalbetreib" SWORD Pres_hPa 1 100 -32768.00 3500.00 ECU_ADDRESS 0xC000A756 /end MEASUREMENT
/begin MEASUREMENT PCR_pGovDvt "Regelabweichung des Ladedruckreglers" SWORD Pres_hPa 1 100 -32768.00 3500.00 ECU_ADDRESS 0xD0001134 /end MEASUREMENT
/begin MEASUREMENT PCR_pGovDvtI_mp "Regelabweichung für I-Anteil des Ladedruckreglers" SWORD Pres_hPa 1 100 -32768.00 3500.00 ECU_ADDRESS 0xC000A7EE /end MEASUREMENT
/begin MEASUREMENT PCR_pIOutT20_mp "" SWORD Pres_hPa 1 100 -32768.00 3500.00 ECU_ADDRESS 0xC000A758 /end MEASUREMENT
/begin MEASUREMENT PCR_pIOut_mp "" SWORD Pres_hPa 1 100 -32768.00 3500.00 ECU_ADDRESS 0xC000A75A /end MEASUREMENT
/begin MEASUREMENT PCR_pMaxDesValLP_mp "" SWORD Pres_hPa 1 100 -32768.00 3500.00 ECU_ADDRESS 0xC000A7BA /end MEASUREMENT
/begin MEASUREMENT PCR_pMaxDesVal_mp "obere Grenze des Ladedruck-Sollwerts" SWORD Pres_hPa 1 100 -32768.00 3500.00 ECU_ADDRESS 0xC000A75C /end MEASUREMENT
/begin MEASUREMENT PCR_pPOutT20_mp "" SWORD Pres_hPa 1 100 -32768.00 3500.00 ECU_ADDRESS 0xC000A75E /end MEASUREMENT
/begin MEASUREMENT PCR_pPOut_mp "" SWORD Pres_hPa 1 100 -32768.00 3500.00 ECU_ADDRESS 0xC000A760 /end MEASUREMENT
/begin MEASUREMENT PCR_pTempCorBasEOMQnt1_mp "Basis-Ladedruck-Sollwert der Motortemperaturkorrektur für die erste auf Einspritzmenge basierte Betriebsart" SWORD Pres_hPa 1 100 -32768.00 3500.00 ECU_ADDRESS 0xC000A762 /end MEASUREMENT
/begin MEASUREMENT PCR_pTempCorBasEOMQnt2_mp "Basis-Ladedruck-Sollwert der Motortemperaturkorrektur für die zweite auf Einspritzmenge basierte Betriebsart" SWORD Pres_hPa 1 100 -32768.00 3500.00 ECU_ADDRESS 0xC000A764 /end MEASUREMENT
/begin MEASUREMENT PCR_pTempCorBasLPEOMQnt1_mp "" SWORD Pres_hPa 1 100 -32768.00 3500.00 ECU_ADDRESS 0xC000A7BC /end MEASUREMENT
/begin MEASUREMENT PCR_pTempCorBasLPEOMQnt2_mp "" SWORD Pres_hPa 1 100 -32768.00 3500.00 ECU_ADDRESS 0xC000A7BE /end MEASUREMENT
/begin MEASUREMENT PCR_pTempCorBasLP_mp "" SWORD Pres_hPa 1 100 -32768.00 3500.00 ECU_ADDRESS 0xC000A7C0 /end MEASUREMENT
/begin MEASUREMENT PCR_pTempCorBas_mp "Basis-Ladedruck-Sollwert der Motortemperaturkorrektur" SWORD Pres_hPa 1 100 -32768.00 3500.00 ECU_ADDRESS 0xC000A766 /end MEASUREMENT
/begin MEASUREMENT PCR_pTempCorEOMQnt1_mp "Temperaturkorrekturwert für Sollwertberechnung der Ladedruckregelung für die erste auf Einspritzmenge basierte Betriebsart" SWORD Pres_hPa 1 100 -32768.00 3500.00 ECU_ADDRESS 0xC000A768 /end MEASUREMENT
/begin MEASUREMENT PCR_pTempCorEOMQnt2_mp "Temperaturkorrekturwert für Sollwertberechnung der Ladedruckregelung für die zweite auf Einspritzmenge basierte Betriebsart" SWORD Pres_hPa 1 100 -32768.00 3500.00 ECU_ADDRESS 0xC000A76A /end MEASUREMENT
/begin MEASUREMENT PCR_pTempCorLPEOMQnt1_mp "" SWORD Pres_hPa 1 100 -32768.00 3500.00 ECU_ADDRESS 0xC000A7C2 /end MEASUREMENT
/begin MEASUREMENT PCR_pTempCorLPEOMQnt2_mp "" SWORD Pres_hPa 1 100 -32768.00 3500.00 ECU_ADDRESS 0xC000A7C4 /end MEASUREMENT
/begin MEASUREMENT PCR_pTempCorLP_mp "" SWORD Pres_hPa 1 100 -32768.00 3500.00 ECU_ADDRESS 0xC000A7C6 /end MEASUREMENT
/begin MEASUREMENT PCR_pTempCor_mp "Temperaturkorrekturwert für Sollwertberechnung der Ladedruckregelung" SWORD Pres_hPa 1 100 -32768.00 3500.00 ECU_ADDRESS 0xC000A76C /end MEASUREMENT
/begin MEASUREMENT PCR_qCByVlvClose_mp "" SWORD InjMass 1 100 -327.6800 327.6700 ECU_ADDRESS 0xC000A65A /end MEASUREMENT
/begin MEASUREMENT PCR_qCByVlvOpn_mp "" SWORD InjMass 1 100 -327.6800 327.6700 ECU_ADDRESS 0xC000A65C /end MEASUREMENT
/begin MEASUREMENT PCR_qCtlVal "Einspritzmenge für die Steuerung der Ladedruckregelung" SWORD InjMass 1 100 -327.6800 327.6700 ECU_ADDRESS 0xD0001140 /end MEASUREMENT
/begin MEASUREMENT PCR_qCtlValInlAutLP_mp "" SWORD InjMass 1 100 -327.6800 327.6700 ECU_ADDRESS 0xC000A6C6 /end MEASUREMENT
/begin MEASUREMENT PCR_qCtlValInlLP_mp "" SWORD InjMass 1 100 -327.6800 327.6700 ECU_ADDRESS 0xC000A6C8 /end MEASUREMENT
/begin MEASUREMENT PCR_qCtlValInl_mp "Einspritzmenge für die Steuerung der Ladedruckregelung" SWORD InjMass 1 100 -327.6800 327.6700 ECU_ADDRESS 0xC000A676 /end MEASUREMENT
/begin MEASUREMENT PCR_qCtlValLP_mp "" SWORD InjMass 1 100 -327.6800 327.6700 ECU_ADDRESS 0xC000A6CA /end MEASUREMENT
/begin MEASUREMENT PCR_qCtlVal_mp "Einspritzmenge für die Steuerung der Ladedruckregelung" SWORD InjMass 1 100 -327.6800 327.6700 ECU_ADDRESS 0xC000A678 /end MEASUREMENT
/begin MEASUREMENT PCR_qDesMon "" SWORD InjMass 1 100 -327.6800 327.6700 ECU_ADDRESS 0xD0001146 /end MEASUREMENT
/begin MEASUREMENT PCR_qDesVal "Einspritzmenge für die Sollwertbildung der Ladedruckregelung" SWORD InjMass 1 100 -327.6800 327.6700 ECU_ADDRESS 0xD0001148 /end MEASUREMENT
/begin MEASUREMENT PCR_qDesValInlLP_mp "" SWORD InjMass 1 100 -327.6800 327.6700 ECU_ADDRESS 0xC000A7C8 /end MEASUREMENT
/begin MEASUREMENT PCR_qDesValInl_mp "Einspritzmenge für die Sollwertbildung der Ladedruckregelung" SWORD InjMass 1 100 -327.6800 327.6700 ECU_ADDRESS 0xC000A76E /end MEASUREMENT
/begin MEASUREMENT PCR_qDesValLP_mp "" SWORD InjMass 1 100 -327.6800 327.6700 ECU_ADDRESS 0xC000A7CA /end MEASUREMENT
/begin MEASUREMENT PCR_qDesVal_mp "Einspritzmenge für die Sollwertbildung der Ladedruckregelung" SWORD InjMass 1 100 -327.6800 327.6700 ECU_ADDRESS 0xC000A770 /end MEASUREMENT
/begin MEASUREMENT PCR_qGov "Einspritzmenge für die Ladedruckregelung" SWORD InjMass 1 100 -327.6800 327.6700 ECU_ADDRESS 0xD000114E /end MEASUREMENT
/begin MEASUREMENT PCR_qGov_mp "Einspritzmenge für die Ladedruckregelung" SWORD InjMass 1 100 -327.6800 327.6700 ECU_ADDRESS 0xC000A7F0 /end MEASUREMENT
/begin MEASUREMENT PCR_qLeadDiff "" SWORD InjMass 1 100 -327.6800 327.6700 ECU_ADDRESS 0xD0001154 /end MEASUREMENT
/begin MEASUREMENT PCR_qMon "Einspritzmenge für die Überwachung der Ladedruckregelung" SWORD InjMass 1 100 -327.6800 327.6700 ECU_ADDRESS 0xD0001156 /end MEASUREMENT
/begin MEASUREMENT PCR_rAirCtlCorDiff_mp "" SWORD Prc 1 100 -400.0000 399.9878 ECU_ADDRESS 0xC000A7F2 /end MEASUREMENT
/begin MEASUREMENT PCR_rAirCtlDiffCoupling "" SWORD Prc 1 100 -400.0000 399.9878 ECU_ADDRESS 0xD000115C /end MEASUREMENT
/begin MEASUREMENT PCR_rAirTempCtlACorBasLPEOM_mp "" SWORD Prc 1 100 -400.0000 399.9878 ECU_ADDRESS 0xC000A6CC /end MEASUREMENT
/begin MEASUREMENT PCR_rAirTempCtlACorLPEOM_mp "" SWORD Prc 1 100 -400.0000 399.9878 ECU_ADDRESS 0xC000A6CE /end MEASUREMENT
/begin MEASUREMENT PCR_rAirTempCtlAutLPCorBas_mp "" SWORD Prc 1 100 -400.0000 399.9878 ECU_ADDRESS 0xC000A6D0 /end MEASUREMENT
/begin MEASUREMENT PCR_rAirTempCtlAutLPCor_mp "" SWORD Prc 1 100 -400.0000 399.9878 ECU_ADDRESS 0xC000A6D2 /end MEASUREMENT
/begin MEASUREMENT PCR_rAirTempCtlCorBasEOM_mp "" SWORD Prc 1 100 -400.0000 399.9878 ECU_ADDRESS 0xC000A67A /end MEASUREMENT
/begin MEASUREMENT PCR_rAirTempCtlCorBas_mp "lufttemperaturabhängige Korrektur Vorsteuerung NormalMode" SWORD Prc 1 100 -400.0000 399.9878 ECU_ADDRESS 0xC000A67C /end MEASUREMENT
/begin MEASUREMENT PCR_rAirTempCtlCorEOM_mp "mp lufttemperaturabhängige Korrektur Vorsteuerung Betriebsart Rgn" SWORD Prc 1 100 -400.0000 399.9878 ECU_ADDRESS 0xC000A67E /end MEASUREMENT
/begin MEASUREMENT PCR_rAirTempCtlCor_mp "mp lufttemperaturabhängige Korrektur Vorsteuerung NormalMode" SWORD Prc 1 100 -400.0000 399.9878 ECU_ADDRESS 0xC000A680 /end MEASUREMENT
/begin MEASUREMENT PCR_rCtlAirCtlOff_mp "" SWORD Prc 1 100 -400.0000 399.9878 ECU_ADDRESS 0xC000A682 /end MEASUREMENT
/begin MEASUREMENT PCR_rCtlBasAirCtlOffHiAltd_mp "" SWORD Prc 1 100 -400.0000 399.9878 ECU_ADDRESS 0xC000A684 /end MEASUREMENT
/begin MEASUREMENT PCR_rCtlBasAirCtlOff_mp "" SWORD Prc 1 100 -400.0000 399.9878 ECU_ADDRESS 0xC000A686 /end MEASUREMENT
/begin MEASUREMENT PCR_rCtlBasAutLPEOMQnt1_mp "" SWORD Prc 1 100 -400.0000 399.9878 ECU_ADDRESS 0xC000A6D4 /end MEASUREMENT
/begin MEASUREMENT PCR_rCtlBasAutLPHiAltdEOMQnt1_mp "" SWORD Prc 1 100 -400.0000 399.9878 ECU_ADDRESS 0xC000A6D6 /end MEASUREMENT
/begin MEASUREMENT PCR_rCtlBasAutLPHiAltd_mp "" SWORD Prc 1 100 -400.0000 399.9878 ECU_ADDRESS 0xC000A6D8 /end MEASUREMENT
/begin MEASUREMENT PCR_rCtlBasAutLP_mp "" SWORD Prc 1 100 -400.0000 399.9878 ECU_ADDRESS 0xC000A6DA /end MEASUREMENT
/begin MEASUREMENT PCR_rCtlBasEOMQnt1_mp "Basiswert für den Ladedruck-Steueranteil für die erste auf Einspritzmenge basierte Betriebsart" SWORD Prc 1 100 -400.0000 399.9878 ECU_ADDRESS 0xC000A688 /end MEASUREMENT
/begin MEASUREMENT PCR_rCtlBasEOMQnt2_mp "Basiswert für den Ladedruck-Steueranteil für die zweite auf Einspritzmenge basierte Betriebsart" SWORD Prc 1 100 -400.0000 399.9878 ECU_ADDRESS 0xC000A68A /end MEASUREMENT
/begin MEASUREMENT PCR_rCtlBasHiAltdEOMQnt1_mp "Höhenbasiswert des Ladedruck-Steueranteils für die erste auf Einspritzmenge basierte Betriebsart" SWORD Prc 1 100 -400.0000 399.9878 ECU_ADDRESS 0xC000A68C /end MEASUREMENT
/begin MEASUREMENT PCR_rCtlBasHiAltdEOMQnt2_mp "Höhenbasiswert des Ladedruck-Steueranteils für die zweite auf Einspritzmenge basierte Betriebsart" SWORD Prc 1 100 -400.0000 399.9878 ECU_ADDRESS 0xC000A68E /end MEASUREMENT
/begin MEASUREMENT PCR_rCtlBasHiAltd_mp "Höhenbasiswert des Ladedruck-Steueranteils" SWORD Prc 1 100 -400.0000 399.9878 ECU_ADDRESS 0xC000A690 /end MEASUREMENT
/begin MEASUREMENT PCR_rCtlBasLPEOMQnt1_mp "" SWORD Prc 1 100 -400.0000 399.9878 ECU_ADDRESS 0xC000A6DC /end MEASUREMENT
/begin MEASUREMENT PCR_rCtlBasLPHiAltdEOMQnt1_mp "" SWORD Prc 1 100 -400.0000 399.9878 ECU_ADDRESS 0xC000A6DE /end MEASUREMENT
/begin MEASUREMENT PCR_rCtlBasLPHiAltd_mp "" SWORD Prc 1 100 -400.0000 399.9878 ECU_ADDRESS 0xC000A6E0 /end MEASUREMENT
/begin MEASUREMENT PCR_rCtlBasLP_mp "" SWORD Prc 1 100 -400.0000 399.9878 ECU_ADDRESS 0xC000A6E2 /end MEASUREMENT
/begin MEASUREMENT PCR_rCtlBas_mp "Basissteuerwert für Ladedruck" SWORD Prc 1 100 -400.0000 399.9878 ECU_ADDRESS 0xC000A692 /end MEASUREMENT
/begin MEASUREMENT PCR_rCtlCor_mp "korrigiertes Steuertastverhältnis" SWORD Prc 1 100 -400.0000 399.9878 ECU_ADDRESS 0xC000A694 /end MEASUREMENT
/begin MEASUREMENT PCR_rCtlPFltLdCor_mp "Von der Partikelfilterbeladung abhängiger Anteil des Ladedruck-Steuerwertes" SWORD Prc 1 100 -400.0000 399.9878 ECU_ADDRESS 0xC000A696 /end MEASUREMENT
/begin MEASUREMENT PCR_rCtlVal "PCR_CtlValCalc" SWORD Prc 1 100 -400.0000 399.9878 ECU_ADDRESS 0xD000115E /end MEASUREMENT
/begin MEASUREMENT PCR_rCtlVal1AutLPEOMQnt1_mp "" SWORD Prc 1 100 -400.0000 399.9878 ECU_ADDRESS 0xC000A6E4 /end MEASUREMENT
/begin MEASUREMENT PCR_rCtlVal1AutLP_mp "" SWORD Prc 1 100 -400.0000 399.9878 ECU_ADDRESS 0xC000A6E6 /end MEASUREMENT
/begin MEASUREMENT PCR_rCtlVal1Cor_mp "Korrektur nach der Atmosphärendruck abhängiger Korrektur des Ladedruck-Steueranteil" SWORD Prc 1 100 -400.0000 399.9878 ECU_ADDRESS 0xC000A698 /end MEASUREMENT
/begin MEASUREMENT PCR_rCtlVal1EOMQnt1_mp "Atmosphärendruck abhängige Korrektur des Ladedruck-Steueranteil für die erste auf Einspritzmenge basierte Betriebsart" SWORD Prc 1 100 -400.0000 399.9878 ECU_ADDRESS 0xC000A69A /end MEASUREMENT
/begin MEASUREMENT PCR_rCtlVal1EOMQnt2_mp "Atmosphärendruck abhängige Korrektur des Ladedruck-Steueranteil für die zweite auf Einspritzmenge basierte Betriebsart" SWORD Prc 1 100 -400.0000 399.9878 ECU_ADDRESS 0xC000A69C /end MEASUREMENT
/begin MEASUREMENT PCR_rCtlVal1LPEOMQnt1_mp "" SWORD Prc 1 100 -400.0000 399.9878 ECU_ADDRESS 0xC000A6E8 /end MEASUREMENT
/begin MEASUREMENT PCR_rCtlVal1LP_mp "" SWORD Prc 1 100 -400.0000 399.9878 ECU_ADDRESS 0xC000A6EA /end MEASUREMENT
/begin MEASUREMENT PCR_rCtlVal1_mp "Atmosphärendruck abhängige Korrektur des Ladedruck-Steueranteil" SWORD Prc 1 100 -400.0000 399.9878 ECU_ADDRESS 0xC000A69E /end MEASUREMENT
/begin MEASUREMENT PCR_rCtlVal2EOM_mp "Um die Temperatur korrigierte Ladedruck-Steuerwerte für die vierte alternative Betriebsart" SWORD Prc 1 100 -400.0000 399.9878 ARRAY_SIZE 2 ECU_ADDRESS 0xC000C424 /end MEASUREMENT
/begin MEASUREMENT PCR_rCtlVal2LP_mp "" SWORD Prc 1 100 -400.0000 399.9878 ECU_ADDRESS 0xC000A6EC /end MEASUREMENT
/begin MEASUREMENT PCR_rCtlVal2_mp "Ladedruck-Steueranteil nach der Motortemperaturkorrektur" SWORD Prc 1 100 -400.0000 399.9878 ECU_ADDRESS 0xC000A6A0 /end MEASUREMENT
/begin MEASUREMENT PCR_rCtlVal3_mp "Über die Partikelfilterbeladung korrigierter Ladedruck-Steuerwert" SWORD Prc 1 100 -400.0000 399.9878 ECU_ADDRESS 0xC000A6A2 /end MEASUREMENT
/begin MEASUREMENT PCR_rCtlValAutLP "" SWORD Prc 1 100 -400.0000 399.9878 ECU_ADDRESS 0xD0001160 /end MEASUREMENT
/begin MEASUREMENT PCR_rCtlValCorrChrgPmp_mp "" SWORD Prc 1 100 -400.0000 399.9878 ECU_ADDRESS 0xC000A7F4 /end MEASUREMENT
/begin MEASUREMENT PCR_rCtlValCorr_mp "Ladedrucksteuersignal" SWORD Prc 1 100 -400.0000 399.9878 ECU_ADDRESS 0xC000A7F6 /end MEASUREMENT
/begin MEASUREMENT PCR_rCtlValCor_mp "korrigierter Ladedruck-Steueranteil der Stellgrösse" SWORD Prc 1 100 -400.0000 399.9878 ECU_ADDRESS 0xC000A7F8 /end MEASUREMENT
/begin MEASUREMENT PCR_rCtlValLP "" SWORD Prc 1 100 -400.0000 399.9878 ECU_ADDRESS 0xD000116A /end MEASUREMENT
/begin MEASUREMENT PCR_rCtlValNrmAutLP_mp "" SWORD Prc 1 100 -400.0000 399.9878 ECU_ADDRESS 0xC000A6EE /end MEASUREMENT
/begin MEASUREMENT PCR_rCtlValNrmLP_mp "" SWORD Prc 1 100 -400.0000 399.9878 ECU_ADDRESS 0xC000A6F0 /end MEASUREMENT
/begin MEASUREMENT PCR_rCtlValNrm_mp "Steuertastverhältnis im Normalbetrieb" SWORD Prc 1 100 -400.0000 399.9878 ECU_ADDRESS 0xC000A6A4 /end MEASUREMENT
/begin MEASUREMENT PCR_rCtlValPFltLd_mp "Betriebspunktabhängiger Korrekturwert zur Partikelfilterbeladungskorrektur für den Ladedruck-Steuerwert" SWORD Prc 1 100 -400.0000 399.9878 ECU_ADDRESS 0xC000A6A6 /end MEASUREMENT
/begin MEASUREMENT PCR_rEngTempCorBasLP_mp "" SWORD Prc 1 100 -400.0000 399.9878 ECU_ADDRESS 0xC000A6F2 /end MEASUREMENT
/begin MEASUREMENT PCR_rEngTempCorBas_mp "Basiswert der Motortemperaturkorrektur des Ladedruck-Steueranteils" SWORD Prc 1 100 -400.0000 399.9878 ECU_ADDRESS 0xC000A6A8 /end MEASUREMENT
/begin MEASUREMENT PCR_rEngTempCorLP_mp "" SWORD Prc 1 100 -400.0000 399.9878 ECU_ADDRESS 0xC000A6F4 /end MEASUREMENT
/begin MEASUREMENT PCR_rEngTempCor_mp "Motortemperaturabhängiger Korrekturwert für den Ladedruck-Steueranteil" SWORD Prc 1 100 -400.0000 399.9878 ECU_ADDRESS 0xC000A6AA /end MEASUREMENT
/begin MEASUREMENT PCR_resFlwUnCor_mp "Messpunkt zur Betriebspunktanzeige der Kennlinie für die Strömungswiderstand-Korrektur" SWORD Res_hPaHrPerCM 1 100 -3.276800 3.276700 FORMAT "%8.6" ECU_ADDRESS 0xC000A6AC /end MEASUREMENT
/begin MEASUREMENT PCR_rGov "PCR_Gov" SWORD Prc 1 100 -400.0000 399.9878 ECU_ADDRESS 0xD0001172 /end MEASUREMENT
/begin MEASUREMENT PCR_rGovMax1_mp "maximal zulässige Reglerstellgröße" SWORD Prc 1 100 -400.0000 399.9878 ECU_ADDRESS 0xC000A826 /end MEASUREMENT
/begin MEASUREMENT PCR_rGovMax2_mp "Korrektur LDR-TV aus Strömungswiderstand PFlt" SWORD Prc 1 100 -400.0000 399.9878 ECU_ADDRESS 0xC000A828 /end MEASUREMENT
/begin MEASUREMENT PCR_rGovMaxCor "Maximale Grenze des Stellgrößenbereichs der Ladedruckregelung" SWORD Prc 1 100 -400.0000 399.9878 ECU_ADDRESS 0xD000117E /end MEASUREMENT
/begin MEASUREMENT PCR_rGovMaxDynRamp_mp "Rampenwert zur maximal zulässige Reglerstellgröße" SWORD Prc 1 100 -400.0000 399.9878 ECU_ADDRESS 0xC000A7FA /end MEASUREMENT
/begin MEASUREMENT PCR_rGovMaxDyn_mp "maximal zulässige Reglerstellgröße" SWORD Prc 1 100 -400.0000 399.9878 ECU_ADDRESS 0xC000A7FC /end MEASUREMENT
/begin MEASUREMENT PCR_rGovMaxNrm_mp "maximal zulässige Reglerstellgröße für den Ladedruck im Normalbetrieb" SWORD Prc 1 100 -400.0000 399.9878 ECU_ADDRESS 0xC000A7FE /end MEASUREMENT
/begin MEASUREMENT PCR_rGovMaxVal1_mp "maximal zulässige Reglerstellgröße" SWORD Prc 1 100 -400.0000 399.9878 ECU_ADDRESS 0xC000A800 /end MEASUREMENT
/begin MEASUREMENT PCR_rGovMaxVal2_mp "maximal zulässige Reglerstellgröße" SWORD Prc 1 100 -400.0000 399.9878 ECU_ADDRESS 0xC000A802 /end MEASUREMENT
/begin MEASUREMENT PCR_rGovMax_mp "Obergrenze der Reglerstellgröße des Ladedrucks" SWORD Prc 1 100 -400.0000 399.9878 ECU_ADDRESS 0xC000A804 /end MEASUREMENT
/begin MEASUREMENT PCR_rGovMinCor "Minimale Grenze des Stellgrößenbereichs der Ladedruckregelung" SWORD Prc 1 100 -400.0000 399.9878 ECU_ADDRESS 0xD0001184 /end MEASUREMENT
/begin MEASUREMENT PCR_rGovMinNrm_mp "minimal zulässige Reglerstellgröße für den Ladedruck im Normalbetrieb" SWORD Prc 1 100 -400.0000 399.9878 ECU_ADDRESS 0xC000A806 /end MEASUREMENT
/begin MEASUREMENT PCR_rGovMin_mp "korrigierte Untergrenze der Reglerstellgröße des Ladedrucks" SWORD Prc 1 100 -400.0000 399.9878 ECU_ADDRESS 0xC000A808 /end MEASUREMENT
/begin MEASUREMENT PCR_rGovOutUnLim "Unbegrenzte Reglerstellgröße für den Ladedruck" SWORD Prc 1 100 -400.0000 399.9878 ECU_ADDRESS 0xD000118A /end MEASUREMENT
/begin MEASUREMENT PCR_rGovOut_mp "begrenzter Regelausgang des Ladedruckreglers" SWORD Prc 1 100 -400.0000 399.9878 ECU_ADDRESS 0xC000A80A /end MEASUREMENT
/begin MEASUREMENT PCR_rOutDT1_mp "DT1-Anteil des PIDT1-Ladedruckreglers" SWORD Prc 1 100 -400.0000 399.9878 ECU_ADDRESS 0xC000A80C /end MEASUREMENT
/begin MEASUREMENT PCR_rOutI "I-Anteil des PIDT1-Ladedruckreglers" SWORD Prc 1 100 -400.0000 399.9878 ECU_ADDRESS 0xD0001190 /end MEASUREMENT
/begin MEASUREMENT PCR_rOutIMax_mp "" SWORD Prc 1 100 -400.0000 399.9878 ECU_ADDRESS 0xC000A80E /end MEASUREMENT
/begin MEASUREMENT PCR_rOutIMin_mp "" SWORD Prc 1 100 -400.0000 399.9878 ECU_ADDRESS 0xC000A810 /end MEASUREMENT
/begin MEASUREMENT PCR_rOutIValInit1_mp "" SWORD Prc 1 100 -400.0000 399.9878 ECU_ADDRESS 0xC000A812 /end MEASUREMENT
/begin MEASUREMENT PCR_rOutIValInitFinal_mp "" SWORD Prc 1 100 -400.0000 399.9878 ECU_ADDRESS 0xC000A814 /end MEASUREMENT
/begin MEASUREMENT PCR_rOutIValInit_mp "" SWORD Prc 1 100 -400.0000 399.9878 ECU_ADDRESS 0xC000A816 /end MEASUREMENT
/begin MEASUREMENT PCR_rOutP_mp "P-Anteil des PIDT1-Ladedruckreglers" SWORD Prc 1 100 -400.0000 399.9878 ECU_ADDRESS 0xC000A818 /end MEASUREMENT
/begin MEASUREMENT PCR_rPIDCor_mp "Korregierter Ausgang des PIDT1-Reglers" SWORD Prc 1 100 -400.0000 399.9878 ECU_ADDRESS 0xC000A81A /end MEASUREMENT
/begin MEASUREMENT PCR_rPIDCtl_mp "Regel- und Steueranteil der Stellgrösse des Ladedruckreglers" SWORD Prc 1 100 -400.0000 399.9878 ECU_ADDRESS 0xC000A81C /end MEASUREMENT
/begin MEASUREMENT PCR_rPID_mp "unbegrenzte Stellgröße" SWORD Prc 1 100 -400.0000 399.9878 ECU_ADDRESS 0xC000A81E /end MEASUREMENT
/begin MEASUREMENT PCR_stARW "Status des Antiresetwindups der Ladedruckregelung" UBYTE OneToOne 1 100 0.00 255.0 ECU_ADDRESS 0xD0002001 /end MEASUREMENT
/begin MEASUREMENT PCR_stCByVlvActv_mp "" UBYTE OneToOne 1 100 0.00 255.0 ECU_ADDRESS 0xC000B401 /end MEASUREMENT
/begin MEASUREMENT PCR_stCByVlvBits_mp "" UBYTE OneToOne 1 100 0.00 255.0 ECU_ADDRESS 0xC000B402 /end MEASUREMENT
/begin MEASUREMENT PCR_stCByVlvCtlValBits_mp "" UBYTE OneToOne 1 100 0.00 255.0 ECU_ADDRESS 0xC000B403 /end MEASUREMENT
/begin MEASUREMENT PCR_stCByVlvCtlValNrm_mp "" UBYTE OneToOne 1 100 0.00 255.0 ECU_ADDRESS 0xC000B404 /end MEASUREMENT
/begin MEASUREMENT PCR_stCByVlvCtlValOpn_mp "" UBYTE OneToOne 1 100 0.00 255.0 ECU_ADDRESS 0xC000B405 /end MEASUREMENT
/begin MEASUREMENT PCR_stCByVlvOpn "" UBYTE OneToOne 1 100 0.00 255.0 ECU_ADDRESS 0xD0002007 /end MEASUREMENT
/begin MEASUREMENT PCR_stDesLogic_mp "Status der Logik Sollwert Abfallbegrenzung" UBYTE OneToOne 1 100 0.00 255.0 ECU_ADDRESS 0xC000B40C /end MEASUREMENT
/begin MEASUREMENT PCR_stDesValLimLP_mp "" UBYTE OneToOne 1 100 0.00 255.0 ECU_ADDRESS 0xC000B40E /end MEASUREMENT
/begin MEASUREMENT PCR_stDynLimOn_mp "Aktivierung der dynamik Begrenzung" SWORD OneToOne 1 100 -32768.00 32767.00 ECU_ADDRESS 0xC000A820 /end MEASUREMENT
/begin MEASUREMENT PCR_stEOMCtlValAutLP_mp "" ULONG OneToOne 1 100 0.00 4294967295.00 ECU_ADDRESS 0xC0009180 /end MEASUREMENT
/begin MEASUREMENT PCR_stEOMCtlValLP_mp "Neuer und alter Zustand aus Auswahlmaske" ULONG OneToOne 1 100 0.00 4294967295.00 ECU_ADDRESS 0xC0009184 /end MEASUREMENT
/begin MEASUREMENT PCR_stEOMCtlVal_mp "Status über den Wechsel in eine andere Betriebsart" ULONG OneToOne 1 100 0.00 4294967295.00 ECU_ADDRESS 0xC000917C /end MEASUREMENT
/begin MEASUREMENT PCR_stEOMDesValLP_mp "" ULONG OneToOne 1 100 0.00 4294967295.00 ECU_ADDRESS 0xC000918C /end MEASUREMENT
/begin MEASUREMENT PCR_stEOMDesVal_mp "Status über den Wechsel in eine andere Betriebsart" ULONG OneToOne 1 100 0.00 4294967295.00 ECU_ADDRESS 0xC0009188 /end MEASUREMENT
/begin MEASUREMENT PCR_stEOMGov_mp "Status des Betriebsartmodus" UWORD OneToOne 1 100 0.00 65535.00 ECU_ADDRESS 0xC000A822 /end MEASUREMENT
/begin MEASUREMENT PCR_stMonCByVlv_mp "" UBYTE OneToOne 1 100 0.00 255.0 ECU_ADDRESS 0xC000B406 /end MEASUREMENT
/begin MEASUREMENT PCR_stRmpSelCtlCor_mp "aktuell verwendeter Rampenfaktor des Ladedruck-Steuerwertes" UBYTE OneToOne 1 100 0.00 255.0 ECU_ADDRESS 0xC000B409 /end MEASUREMENT
/begin MEASUREMENT PCR_stRmpSelDesCor_mp "aktuell verwendeter Rampenfaktor des des Ladedruck-Sollwertes" UBYTE OneToOne 1 100 0.00 255.0 ECU_ADDRESS 0xC000B40D /end MEASUREMENT
/begin MEASUREMENT PCR_stSwtGovMaxDyn_mp "Status Rampenschalter dynamisches Max-Stellgrößenlimit" UBYTE OneToOne 1 100 0.00 255.0 ECU_ADDRESS 0xC000B40F /end MEASUREMENT
/begin MEASUREMENT PCR_stT20PrtAct "" UBYTE OneToOne 1 100 0.00 255.0 ECU_ADDRESS 0xD000200E /end MEASUREMENT
/begin MEASUREMENT PCR_swtBstLPActv "" UBYTE OneToOne 1 100 0.00 255.0 ECU_ADDRESS 0xD0002017 /end MEASUREMENT
/begin MEASUREMENT PCR_swtGov "Regler EIN/AUS" UBYTE OneToOne 1 100 0.00 255.0 ECU_ADDRESS 0xD0002018 /end MEASUREMENT
/begin MEASUREMENT PCR_swtGovNoDeb_mp "Schalterwert Regler ein/aus vor der Ausschaltverzögerung" UBYTE OneToOne 1 100 0.00 255.0 ECU_ADDRESS 0xC000B410 /end MEASUREMENT
/begin MEASUREMENT PCR_swtQntCByVlv "" UBYTE OneToOne 1 100 0.00 255.0 ECU_ADDRESS 0xD000201E /end MEASUREMENT
/begin MEASUREMENT PCR_swtRelAbs "Schalterwert zur Auswahl zwischen Absolut- und Relativdruckregelung" UBYTE OneToOne 1 100 0.00 255.0 ECU_ADDRESS 0xD000201F /end MEASUREMENT
/begin MEASUREMENT PCR_swtTempCor "Schalter zwischen Motortemperatur und der Temperatur des Ansaugtrakts" UBYTE OneToOne 1 100 0.00 255.0 ECU_ADDRESS 0xD0002021 /end MEASUREMENT
/begin MEASUREMENT PCR_swtTempCorLP "" UBYTE OneToOne 1 100 0.00 255.0 ECU_ADDRESS 0xD0002022 /end MEASUREMENT
/begin MEASUREMENT PCR_tAirCtlVal_mp "ausgewählte Lufttemperatur für die Steuerung der Ladedruckregelung" SWORD Temp_Cels 1 100 -3549.940 3003.560 ECU_ADDRESS 0xC000A6AE /end MEASUREMENT
/begin MEASUREMENT PCR_tAirDesValLP "" SWORD Temp_Cels 1 100 -3549.940 3003.560 ECU_ADDRESS 0xD000119C /end MEASUREMENT
/begin MEASUREMENT PCR_tAirDesVal_mp "ausgewählte Lufttemperatur für die Sollwertbildung der Ladedruckregelung" SWORD Temp_Cels 1 100 -3549.940 3003.560 ECU_ADDRESS 0xC000A772 /end MEASUREMENT
/begin MEASUREMENT PCR_tCmprDsOvhtDvt_mp "" SWORD TempDiff_Cels 1 100 -3276.800 3276.700 FORMAT "%8.3" ECU_ADDRESS 0xC000A774 /end MEASUREMENT
/begin MEASUREMENT PCR_tDesValLP_mp "" SWORD Temp_Cels 1 100 -3549.940 3003.560 ECU_ADDRESS 0xC000A7CC /end MEASUREMENT
/begin MEASUREMENT PCR_tDesVal_mp "ausgewählte Temperatur für die Sollwertbildung der Ladedruckregelung" SWORD Temp_Cels 1 100 -3549.940 3003.560 ECU_ADDRESS 0xC000A776 /end MEASUREMENT
/begin MEASUREMENT PCR_tEngCtlVal_mp "ausgewählte Motortemperatur für die Steuerung der Ladedruckregelung" SWORD Temp_Cels 1 100 -3549.940 3003.560 ECU_ADDRESS 0xC000A6B0 /end MEASUREMENT
/begin MEASUREMENT PCR_tEngDesValLP "" SWORD Temp_Cels 1 100 -3549.940 3003.560 ECU_ADDRESS 0xD000119E /end MEASUREMENT
/begin MEASUREMENT PCR_tEngDesVal_mp "ausgewählte Motortemperatur für die Sollwertbildung der Ladedruckregelung" SWORD Temp_Cels 1 100 -3549.940 3003.560 ECU_ADDRESS 0xC000A778 /end MEASUREMENT
/begin MEASUREMENT PCR_tiGovOffDel_mp "Verzögerungszeit bei Abschaltung der Ladedruckregelung auf reine Steuerung" SWORD Time_s 1 100 -327.6800 327.6700 ECU_ADDRESS 0xC000A824 /end MEASUREMENT
/begin MEASUREMENT PCR_trqCtlVal "inneres Drehmoment für die Steuerung der Ladedruckregelung" SWORD Trq 1 100 -3276.800 3276.700 ECU_ADDRESS 0xD00011A0 /end MEASUREMENT
/begin MEASUREMENT PCR_trqCtlValInlAutLP_mp "" SWORD Trq 1 100 -3276.800 3276.700 ECU_ADDRESS 0xC000A6F6 /end MEASUREMENT
/begin MEASUREMENT PCR_trqCtlValInlLP_mp "" SWORD Trq 1 100 -3276.800 3276.700 ECU_ADDRESS 0xC000A6F8 /end MEASUREMENT
/begin MEASUREMENT PCR_trqCtlValInl_mp "inneres Drehmoment für die Steuerung der Ladedruckregelung" SWORD Trq 1 100 -3276.800 3276.700 ECU_ADDRESS 0xC000A6B2 /end MEASUREMENT
/begin MEASUREMENT PCR_trqDesVal "inneres Drehmoment für die Sollwertbildung der Ladedruckregelung" SWORD Trq 1 100 -3276.800 3276.700 ECU_ADDRESS 0xD00011A2 /end MEASUREMENT
/begin MEASUREMENT PCR_trqDesValInl_mp "inneres Drehmoment für die Sollwertbildung der Ladedruckregelung" SWORD Trq 1 100 -3276.800 3276.700 ECU_ADDRESS 0xC000A77A /end MEASUREMENT
/begin MEASUREMENT PCR_trqGov "inneres Drehmoment für die Ladedruckregelung" SWORD Trq 1 100 -3276.800 3276.700 ECU_ADDRESS 0xD00011A4 /end MEASUREMENT
/begin MEASUREMENT PCR_trqMon "inneres Drehmoment für die Überwachung der Ladedruckregelung" SWORD Trq 1 100 -3276.800 3276.700 ECU_ADDRESS 0xD00011A6 /end MEASUREMENT
/begin MEASUREMENT PCR_tT20Flt_mp "" SWORD Temp_Cels 1 100 -3549.940 3003.560 ECU_ADDRESS 0xC000A77C /end MEASUREMENT
/begin MEASUREMENT PCR_tT20LimSetPoint_mp "" SWORD Temp_Cels 1 100 -3549.940 3003.560 ECU_ADDRESS 0xC000A77E /end MEASUREMENT
/begin MEASUREMENT PCR_tT20Thres_mp "" SWORD Temp_Cels 1 100 -3549.940 3003.560 ECU_ADDRESS 0xC000A780 /end MEASUREMENT
/begin MEASUREMENT St_ozgg0 "Statuswort" UBYTE Def_st_ub_q1 1 100 0.00 255. FORMAT "%3.0" ECU_ADDRESS 0xC000B3CF /end MEASUREMENT
/begin MEASUREMENT St_oznivdl0 "Statuswort" UBYTE Def_st_ub_q1 1 100 0.00 255. FORMAT "%3.0" ECU_ADDRESS 0xC000B3EC /end MEASUREMENT
/begin MEASUREMENT St_oznivdl1 "Statuswort" UBYTE Def_st_ub_q1 1 100 0.00 255. FORMAT "%3.0" ECU_ADDRESS 0xC000B3ED /end MEASUREMENT
/begin MEASUREMENT St_oznivdl_nv0 "Statuswort" UBYTE Def_st_ub_q1 1 100 0.00 255. FORMAT "%3.0" ECU_ADDRESS 0xC000B3EE /end MEASUREMENT
/begin MEASUREMENT X_KL_TVTOEL_no_input_quantity "This variable is artificially generated, since DAMOS does not (yet) support 'NO_INPUT_QUANTITY' references at PaVaSt files. It is exclusively referenced by the X axis of calibration parameter 'KL_TVTOEL'." UWORD Def_td_uw_q0p1 1 100 0.00 6553.5 FORMAT "%6.1" ECU_ADDRESS 0xC000A61A /end MEASUREMENT
/begin MEASUREMENT Y_KF_OZDREHKOR_no_input_quantity "This variable is artificially generated, since DAMOS does not (yet) support 'NO_INPUT_QUANTITY' references at PaVaSt files. It is exclusively referenced by the Y axis of calibration parameter 'KF_OZDREHKOR'." UWORD Def_niv_uw_q0p293 1 100 0.00 19199.7 FORMAT "%7.1" ECU_ADDRESS 0xC000A630 /end MEASUREMENT
/begin FUNCTION ozgg ""
 /begin DEF_CHARACTERISTIC KL_OZNIV KL_OZPERMKL KL_OZTEMPKL KL_TKTOENIV KL_TVTOEL K_OZPERMRMIN K_OZPRREFMAX K_OZPRREFMIN K_OZSTZYK K_TOGVERZOEG K_TRTYP /end DEF_CHARACTERISTIC
 /begin IN_MEASUREMENT Td_og_tk /end IN_MEASUREMENT
 /begin OUT_MEASUREMENT Oz_anztoe Oz_niv Oz_nivqlt Oz_nivrers Oz_nivt Oz_nivtoe Oz_perm Oz_permakt Oz_permt Oz_perref Oz_temp Oz_tempqlt Oz_tempt Oz_temptoe St_ozgg0 X_KL_TVTOEL_no_input_quantity /end OUT_MEASUREMENT
/end FUNCTION
/begin FUNCTION oznivdl ""
 /begin DEF_CHARACTERISTIC KF_OZDREHKOR KF_OZKORRNIV KF_OZKORRORI KF_OZZEIT KL_OZDREHKORI KL_OZKRZMW2 KL_OZLBNIV KL_OZLN KL_OZNFDELTA KL_OZORBERO KL_OZQBNIV KL_OZSTNIV K_CW_OZ K_NACHFUELL12 K_NACHFUELL25 K_NACHFUELL38 K_NACHFUELL53 K_NACHFUELL69 K_NACHFUELL85 K_NACHFUELL95 K_OZABSTELL K_OZABZORIVL K_OZALTANZABZ K_OZBESCHAUS K_OZDKNIVN K_OZFAKTORI K_OZLBESCHN K_OZLBESCHORI K_OZLBESCHP K_OZLBESCHST K_OZLUFTMAX K_OZMAXSLOPE K_OZMINSLOPE K_OZMWK K_OZMWL K_OZMWOR K_OZMWV K_OZNFERR K_OZNFML K_OZNFOELCKO K_OZNFOELCOK K_OZNMOTMAX K_OZNMOTMIN K_OZOELCABZ K_OZOELCOK K_OZOELCVERZ K_OZOELVERB K_OZORIPEILTZO K_OZORIPEILTZU K_OZPEIL12 K_OZPEIL25 K_OZPEIL38 K_OZPEIL53 K_OZPEIL69 K_OZPEIL85 K_OZPEILDO K_OZPEILDOMIN K_OZPEILDU K_OZPEILDU38 K_OZPEILERR K_OZPEILKSPR K_OZPEILLP85 K_OZPEILML K_OZPEILOELCKO K_OZPEILOELCOK K_OZPEILSPRUNG K_OZQBESCHN K_OZQBESCHORI K_OZQBESCHP K_OZQBESCHST K_OZSTANDVERZ K_OZSTARTABZ K_OZSTARTVERZ K_OZSTMINW K_OZTEMPBW K_OZTORMIN K_OZTORMINF K_OZVERBFAK K_OZVERLORI K_OZVERZERRBSD K_OZVORMV K_OZVORPEILMIN K_OZZINI /end DEF_CHARACTERISTIC
 /begin IN_MEASUREMENT Oz_tempf Tn_abstellm Tn_start_10 /end IN_MEASUREMENT
 /begin OUT_MEASUREMENT N_ozmw Oz_abstellm Oz_beschcnt Oz_dkm Oz_hoehe Oz_krz2cnt Oz_krzcnt Oz_krzkor2 Oz_krzkor2k Oz_krzmw Oz_krzmwkor Oz_krzor Oz_langmw Oz_lbmw Oz_lgmwcnt Oz_lp Oz_lv Oz_nivakt Oz_nivkomp Oz_nivkor Oz_nivkrzt Oz_nivlit Oz_nivzeit Oz_oricnt Oz_orikor Oz_peil Oz_peilaltanz Oz_peilkm Oz_peilkmalt Oz_peillang Oz_peiloben Oz_peilunten Oz_pzdivp Oz_qbmw Oz_steigung Oz_tkorrori Oz_vormw Oz_vormwcnt St_oznivdl0 St_oznivdl1 St_oznivdl_nv0 Y_KF_OZDREHKOR_no_input_quantity /end OUT_MEASUREMENT
/end FUNCTION
/begin FUNCTION oztemp "" /begin DEF_CHARACTERISTIC KF_OZTEMPMDL K_OZTLPF K_OZTLPFMDL /end DEF_CHARACTERISTIC /begin IN_MEASUREMENT Nkw Tmot /end IN_MEASUREMENT /begin OUT_MEASUREMENT Oz_tempf Oz_tempmdl /end OUT_MEASUREMENT /end FUNCTION
/begin FUNCTION PCBS "" /begin SUB_FUNCTION PCBS_CalcCBS /end SUB_FUNCTION /end FUNCTION
/begin FUNCTION PCBS_CalcCBS ""
 /begin DEF_CHARACTERISTIC PCBS_dAvaiThres_C PCBS_facCalcDistHighTrm_C PCBS_facCalcDistLowTrm_C PCBS_facFlTotDMEChg_C PCBS_kvbmwAux_C PCBS_lAddThres_C PCBS_lCalcDistance_CUR PCBS_lCalcProgWay_CUR PCBS_lDistCC_C PCBS_lDistInt_C PCBS_lDistMax_C PCBS_lDistMin_C PCBS_lDistMin_CUR PCBS_lf1tAux_C PCBS_lJmpMax_C PCBS_lPFltDef_C PCBS_lSumAux_C PCBS_lSumDPFChngPred_CUR PCBS_lThresOut_C PCBS_mAshOilDiff_C PCBS_mAshOil_CUR PCBS_qCalcFlTot_CUR PCBS_qFlTotCorAux_C PCBS_qKvb_C PCBS_rwanzAux_C PCBS_rwprogAux_C PCBS_swtAux_C PCBS_swtSyncOff_C PCBS_vfanzAux_C /end DEF_CHARACTERISTIC
 /begin IN_MEASUREMENT Com_ctCBSRstPFlt Com_lSum Com_rAvlCBSRstPFlt Layer_dAnz Layer_lRwAnz Layer_lRwProg Layer_qKvbmw Layer_rlf1t PCBS_stPFltActv PFltLd_mAshOilEG PFltLd_qFlTotCor T15_st /end IN_MEASUREMENT
 /begin OUT_MEASUREMENT PCBS_dAvaiOut PCBS_lDistanceOut PCBS_lProgWay PCBS_lRwKvbOverlay PCBS_lSum PCBS_lSumDPFChng PCBS_lSumOverlay PCBS_qFlTotDMEChg PCBS_stCalc PCBS_stCBSMsg PCBS_stCntValOut PCBS_stDMEChg PCBS_stDMEIni PCBS_stIdCBS4 PCBS_stIdFnCBS4 PCBS_stIDMsg PCBS_stPFltChg PCBS_stProgMon PCBS_stProgTime PCBS_stProgYr PCBS_stUnit /end OUT_MEASUREMENT
 /begin LOC_MEASUREMENT PCBS_cntChng_mp PCBS_cntOilChng_mp PCBS_dAvaiDMEChg_mp PCBS_facCalcDistTrm_mp PCBS_facCalcDistUnlim_mp PCBS_facCor_mp PCBS_facKvb_mp PCBS_facTot_mp PCBS_kvbmwIn_mp PCBS_lChngPred_mp PCBS_lDist1_mp PCBS_lDist3_mp PCBS_lDist4_mp PCBS_lDistance_mp PCBS_lDistComp_mp PCBS_lDistCom_mp PCBS_lDistDiff_mp PCBS_lDistMin_mp PCBS_lDistSyncDiff_mp PCBS_lDistSync_mp PCBS_lDist_mp PCBS_lf1tIn_mp PCBS_lJmpMax_mp PCBS_lMaxDistance_mp PCBS_lProgWayInt PCBS_lSum1000_mp PCBS_lSum10_mp PCBS_lSumIn_mp PCBS_lSyncCalc1_mp PCBS_lSyncCalc2_mp PCBS_lSyncCalc3_mp PCBS_lSyncCalc4_mp PCBS_lSyncChng1_mp PCBS_lSyncChng2_mp PCBS_lSyncChng_mp PCBS_numTrack_mp PCBS_qFlTotCorIn_mp PCBS_qFlTotDMEChg_mp PCBS_qFl_mp PCBS_rFl_mp PCBS_rKvb_mp PCBS_rPFlt_mp PCBS_rwanzIn_mp PCBS_rwprogIn_mp PCBS_stDMEIni_mp PCBS_stManip_mp PCBS_stOilReset_mp PCBS_stRequest_mp PCBS_stSyncCalc_mp PCBS_stSyncOld_mp PCBS_stSync_mp PCBS_stTrack_mp PCBS_vfanzIn_mp /end LOC_MEASUREMENT
/end FUNCTION
/begin FUNCTION Pcp "" /end FUNCTION
/begin FUNCTION pcr_cmprbypctlvalcalc ""
 /begin DEF_CHARACTERISTIC PCR_facCByVlvRmp_CUR PCR_numGearCByVlv_C PCR_qCByVlvCloseEOM1_MAP PCR_qCByVlvClose_MAP PCR_qCByVlvOpnEOM1_MAP PCR_qCByVlvOpn_MAP PCR_QntCByVlv.xVal_C PCR_QntCByVlv.xTyp_C PCR_stCByVlvBitMsk_C PCR_stCByVlvClose_C PCR_stCByVlvEOMMsk_CA PCR_stCByVlvOpn_C PCR_stDflValCByVlv_C PCR_swtBstLPActv_C PCR_swtCByVlvClthOffCond_C PCR_tiDebCByVlvClth.tiHiLo_C PCR_tiDebCByVlvClth.tiLoHi_C /end DEF_CHARACTERISTIC
 /begin IN_MEASUREMENT CByVlv_st Clth_st CoEOM_facRmpVal CoEOM_stOpModeAct EnvP_p Epm_nEng InjCtl_qCurr InjCtl_qRaw PCR_stMon PCR_stMonLP Tra_numGearDes /end IN_MEASUREMENT
 /begin OUT_MEASUREMENT PCR_stCByVlvOpn PCR_swtBstLPActv PCR_swtQntCByVlv /end OUT_MEASUREMENT
 /begin LOC_MEASUREMENT PCR_qCByVlvClose_mp PCR_qCByVlvOpn_mp PCR_stCByVlvActv_mp PCR_stCByVlvBits_mp PCR_stCByVlvCtlValBits_mp PCR_stCByVlvCtlValNrm_mp PCR_stCByVlvCtlValOpn_mp PCR_stMonCByVlv_mp /end LOC_MEASUREMENT
/end FUNCTION
/begin FUNCTION PCR_Co ""
 /begin DEF_CHARACTERISTIC PCR_swtQntCtl_C PCR_swtQntDes_C PCR_swtQntGov_C PCR_swtQntMon_C PCR_swtTrqInrCtl_C PCR_swtTrqInrDes_C PCR_swtTrqInrGov_C PCR_swtTrqInrMon_C /end DEF_CHARACTERISTIC
 /begin REF_CHARACTERISTIC HESrv_swtScndFlwActv_C /end REF_CHARACTERISTIC
 /begin OUT_MEASUREMENT PCR_qCtlVal PCR_qDesMon PCR_qDesVal PCR_qGov PCR_qLeadDiff PCR_qMon PCR_trqCtlVal PCR_trqDesVal PCR_trqGov PCR_trqMon /end OUT_MEASUREMENT
/end FUNCTION
/begin FUNCTION PCR_CtlValCalc ""
 /begin DEF_CHARACTERISTIC PCR_drAirCtlOff.Pos_C PCR_drAirCtlOff.Neg_C PCR_facAirTempCtlCorEOM_CUR PCR_facAirTempCtlCor_CUR PCR_facEngTempCtlCor_MAP PCR_facEnvPresCtlAirCtlCor_CUR PCR_facEnvPresCtlCorEOMQnt1_CUR PCR_facEnvPresCtlCorEOMQnt2_CUR PCR_facEnvPresCtlCor_CUR PCR_facPFltLdCtlVal_CUR PCR_facRmpValCtlCorQnt1_CUR PCR_facRmpValCtlCorQnt2_CUR PCR_numAirTempCtlVal_C PCR_numEngTempCtlVal_C PCR_numEOMStgCtlCalc_MAP PCR_rAirTempCtlCorBasEOM_MAP PCR_rAirTempCtlCorBas_MAP PCR_rCtlBasAirCtlOffHiAltd_MAP PCR_rCtlBasAirCtlOff_MAP PCR_rCtlBasEOMQnt1_MAP PCR_rCtlBasEOMQnt2_MAP PCR_rCtlBasHiAltdEOMQnt1_MAP PCR_rCtlBasHiAltdEOMQnt2_MAP PCR_rCtlBasHiAltd_MAP PCR_rCtlBas_MAP PCR_rCtlValPFltLd_MAP PCR_rEngTempCorBas_MAP PCR_stCtlValEOMMsk_CA /end DEF_CHARACTERISTIC
 /begin REF_CHARACTERISTIC HESrv_swtScndFlwActv_C /end REF_CHARACTERISTIC
 /begin IN_MEASUREMENT AirCtl_stMon AirSys_tFld Air_pIntkVUs CoEOM_facRmpVal CoEOM_stOpModeAct EngDa_tFld EnvP_p Epm_nEng PCR_qCtlVal PCR_trqCtlVal PFltLd_resFlwFltAbs /end IN_MEASUREMENT
 /begin OUT_MEASUREMENT PCR_rCtlVal /end OUT_MEASUREMENT
 /begin LOC_MEASUREMENT PCR_ActModeCtlCalc_mp PCR_DesModeCtlCalc_mp PCR_facAirTempCtlCorEOM_mp PCR_facAirTempCtlCor_mp PCR_facEngTempCtlCor_mp PCR_facEnvPresCtlAirCtlCor_mp PCR_facEnvPresCtlCorEOMQnt1_mp PCR_facEnvPresCtlCorEOMQnt2_mp PCR_facEnvPresCtlCor_mp PCR_facPFltLdCtlVal_mp PCR_facRmpCtlCor_mp PCR_facRmpValCtlCorQnt1_mp PCR_facRmpValCtlCorQnt2_mp PCR_facRmpValCtlCor_mp PCR_qCtlValInl_mp PCR_qCtlVal_mp PCR_rAirTempCtlCorBasEOM_mp PCR_rAirTempCtlCorBas_mp PCR_rAirTempCtlCorEOM_mp PCR_rAirTempCtlCor_mp PCR_rCtlAirCtlOff_mp PCR_rCtlBasAirCtlOffHiAltd_mp PCR_rCtlBasAirCtlOff_mp PCR_rCtlBasEOMQnt1_mp PCR_rCtlBasEOMQnt2_mp PCR_rCtlBasHiAltdEOMQnt1_mp PCR_rCtlBasHiAltdEOMQnt2_mp PCR_rCtlBasHiAltd_mp PCR_rCtlBas_mp PCR_rCtlCor_mp PCR_rCtlPFltLdCor_mp PCR_rCtlVal1Cor_mp PCR_rCtlVal1EOMQnt1_mp PCR_rCtlVal1EOMQnt2_mp PCR_rCtlVal1_mp PCR_rCtlVal2EOM_mp PCR_rCtlVal2_mp PCR_rCtlVal3_mp PCR_rCtlValNrm_mp PCR_rCtlValPFltLd_mp PCR_rEngTempCorBas_mp PCR_rEngTempCor_mp PCR_resFlwUnCor_mp PCR_stEOMCtlVal_mp PCR_stRmpSelCtlCor_mp PCR_tAirCtlVal_mp PCR_tEngCtlVal_mp PCR_trqCtlValInl_mp /end LOC_MEASUREMENT
/end FUNCTION
/begin FUNCTION PCR_CtlValCalcLP ""
 /begin DEF_CHARACTERISTIC PCR_facAirTempCtlACorLPEOM_CUR PCR_facAirTempCtlAutLPCor_CUR PCR_facEngTempCtlCorLP_CUR PCR_facEnvPresCtlCorAutLPEOMQnt1_CUR PCR_facEnvPresCtlCorAutLP_CUR PCR_facEnvPresCtlCorLPEOMQnt1_CUR PCR_facEnvPresCtlCorLP_CUR PCR_facRmpValCtlCorAutLP_CUR PCR_facRmpValCtlCorLP_CUR PCR_rAirTempCtlACorBasLPEOM_MAP PCR_rAirTempCtlAutLPCorBas_MAP PCR_rCtlBasAutLPEOMQnt1_MAP PCR_rCtlBasAutLPHiAltdEOMQnt1_MAP PCR_rCtlBasAutLPHiAltd_MAP PCR_rCtlBasAutLP_MAP PCR_rCtlBasLPEOMQnt1_MAP PCR_rCtlBasLPHiAltdEOMQnt1_MAP PCR_rCtlBasLPHiAltd_MAP PCR_rCtlBasLP_MAP PCR_rEngTempCorBasLP_MAP PCR_stCtlValAutLPEOMMsk_CA PCR_stCtlValLPEOMMsk_CA /end DEF_CHARACTERISTIC
 /begin IN_MEASUREMENT CoEOM_facRmpVal CoEOM_stOpModeAct EnvP_p Epm_nEng PCR_qCtlVal PCR_swtBstLPActv PCR_tAirDesValLP PCR_tEngDesValLP PCR_trqCtlVal /end IN_MEASUREMENT
 /begin OUT_MEASUREMENT PCR_rCtlValAutLP PCR_rCtlValLP /end OUT_MEASUREMENT
 /begin LOC_MEASUREMENT PCR_facAirTempCtlACorLPEOM_mp PCR_facAirTempCtlAutLPCor_mp PCR_facEngTempCtlCorLP_mp PCR_facEnvPresCtlCorAutLPEOMQnt1_mp PCR_facEnvPresCtlCorAutLP_mp PCR_facEnvPresCtlCorLPEOMQnt1_mp PCR_facEnvPresCtlCorLP_mp PCR_facRmpValCtlCorAutLP_mp PCR_facRmpValCtlCorLP_mp PCR_qCtlValInlAutLP_mp PCR_qCtlValInlLP_mp PCR_qCtlValLP_mp PCR_rAirTempCtlACorBasLPEOM_mp PCR_rAirTempCtlACorLPEOM_mp PCR_rAirTempCtlAutLPCorBas_mp PCR_rAirTempCtlAutLPCor_mp PCR_rCtlBasAutLPEOMQnt1_mp PCR_rCtlBasAutLPHiAltdEOMQnt1_mp PCR_rCtlBasAutLPHiAltd_mp PCR_rCtlBasAutLP_mp PCR_rCtlBasLPEOMQnt1_mp PCR_rCtlBasLPHiAltdEOMQnt1_mp PCR_rCtlBasLPHiAltd_mp PCR_rCtlBasLP_mp PCR_rCtlVal1AutLPEOMQnt1_mp PCR_rCtlVal1AutLP_mp PCR_rCtlVal1LPEOMQnt1_mp PCR_rCtlVal1LP_mp PCR_rCtlVal2LP_mp PCR_rCtlValNrmAutLP_mp PCR_rCtlValNrmLP_mp PCR_rEngTempCorBasLP_mp PCR_rEngTempCorLP_mp PCR_stEOMCtlValAutLP_mp PCR_stEOMCtlValLP_mp PCR_trqCtlValInlAutLP_mp PCR_trqCtlValInlLP_mp /end LOC_MEASUREMENT
/end FUNCTION
/begin FUNCTION PCR_DesValCalc ""
 /begin DEF_CHARACTERISTIC PCR_APPDT1.T1_C PCR_APPDT1.Kd_C PCR_CldDT1Win.T1_C PCR_CldDT1Win.Kd_C PCR_CldDT1Win.KdPos_C PCR_CldDT1Win.KdNeg_C PCR_CldDT1Win.WinPos_C PCR_CldDT1Win.WinNeg_C PCR_dpDesAirCtlOff.Pos_C PCR_dpDesAirCtlOff.Neg_C PCR_dpDesT20Cor.Pos_C PCR_dpDesT20Cor.Neg_C PCR_dpDesTrbChPrtCor.Pos_C PCR_dpDesTrbChPrtCor.Neg_C PCR_dpSlpLimRmp.Pos_C PCR_dpSlpLimRmp.Neg_C PCR_drAPPUnFlt_C PCR_facAirTempDesCorEOM_CUR PCR_facAirTempDesCor_CUR PCR_facEnvPresDesAirCtlCor_CUR PCR_facEnvPresDesCorEOMQnt1_CUR PCR_facEnvPresDesCorEOMQnt2_CUR PCR_facEnvPresDesCor_CUR PCR_facRmpValDesCorQnt1_CUR PCR_facRmpValDesCorQnt2_CUR PCR_facRmpValDesCor_CUR PCR_facTempDesCorEOMQnt1_MAP PCR_facTempDesCorEOMQnt2_MAP PCR_facTempDesCor_MAP PCR_IT20CorKiNeg_C PCR_IT20CorKiPos_C PCR_IT20CorKi_C PCR_ITrbChKiNeg_C PCR_ITrbChKiPos_C PCR_ITrbChKi_C PCR_nLimMax_C PCR_nLimMin_C PCR_nTrbChIWinNeg_C PCR_nTrbChIWinPos_C PCR_nTrbChPrtOfs_CUR PCR_nTrbChPrt_C PCR_nTrbChPWinNeg_C PCR_nTrbChPWinPos_C PCR_numAirTempDesVal_C PCR_numEngTempDesVal_C PCR_numEOMStgDesCalc_MAP PCR_pDesBasAirCtlOffHiAltd_MAP PCR_pDesBasAirCtlOff_MAP PCR_pDesBasEOMQnt1_MAP PCR_pDesBasEOMQnt2_MAP PCR_pDesBasHiAltdEOMQnt1_MAP PCR_pDesBasHiAltdEOMQnt2_MAP PCR_pDesBasHiAltd_MAP PCR_pDesBas_MAP PCR_pDesMonHiAltd_MAP PCR_pDesT20CorMin_C PCR_pDesTrbChPrtCorMin_C PCR_pMaxDesVal_MAP PCR_pMinDesVal_C PCR_PT20CorKpNeg_C PCR_PT20CorKpPos_C PCR_PT20CorKp_C PCR_pTempCorBasEOMQnt1_MAP PCR_pTempCorBasEOMQnt2_MAP PCR_pTempCorBas_MAP PCR_PTrbChKpNeg_C PCR_PTrbChKpPos_C PCR_PTrbChKp_C PCR_stDesMonEOMMsk_CA PCR_stDesValEOMMsk_CA PCR_swtT20Prt_C PCR_swtT20_C PCR_swtTrbChPrt_C PCR_tClntThres_C PCR_tCmprDsOfs_CUR PCR_TempCor.xVal_C PCR_TempCor.xTyp_C PCR_tiDelT20Prt_C PCR_tiDesSlpLim_C PCR_tiT20PT1_C PCR_tiT20ThresPT1_C PCR_tiTrbChPT1_C PCR_tiTrbChThresPT1_C PCR_tT20CorIWinNeg_C PCR_tT20CorIWinPos_C PCR_tT20CorPWinNeg_C PCR_tT20CorPWinPos_C PCR_tT20Lim_C PCR_WrmDT1Win.T1_C PCR_WrmDT1Win.Kd_C PCR_WrmDT1Win.KdPos_C PCR_WrmDT1Win.KdNeg_C PCR_WrmDT1Win.WinPos_C PCR_WrmDT1Win.WinNeg_C /end DEF_CHARACTERISTIC
 /begin REF_CHARACTERISTIC ASMod_tInit_C HESrv_swtPOpVis_C HESrv_swtScndFlwActv_C /end REF_CHARACTERISTIC
 /begin IN_MEASUREMENT AirCtl_stMon AirSys_pDesValTst AirSys_stpDesValSysTst Air_tCACDs APP_rUnFlt ASMod_nTrbCh ASMod_tCmprDs CoEOM_facRmpVal CoEOM_stOpModeAct EngDa_tFld EnvP_p Epm_nEng PCR_qDesMon PCR_qDesVal PCR_trqDesVal /end IN_MEASUREMENT
 /begin OUT_MEASUREMENT PCR_drAPPUnFlt PCR_pDesStat PCR_pDesT20Cor PCR_pDesVal PCR_pDesValMon PCR_stT20PrtAct PCR_swtTempCor /end OUT_MEASUREMENT
 /begin LOC_MEASUREMENT PCR_ActModeDesCalc_mp PCR_DesModeDesCalc_mp PCR_facAirTempDesCorEOM_mp PCR_facAirTempDesCor_mp PCR_facEnvPresDesAirCtlCor_mp PCR_facEnvPresDesCorEOMQnt1_mp PCR_facEnvPresDesCorEOMQnt2_mp PCR_facEnvPresDesCor_mp PCR_facRmpDesCor_mp PCR_facRmpValDesCorQnt1_mp PCR_facRmpValDesCorQnt2_mp PCR_facRmpValDesCor_mp PCR_facTempDesCorEOMQnt1_mp PCR_facTempDesCorEOMQnt2_mp PCR_facTempDesCor_mp PCR_nTrbChDev_mp PCR_nTrbChFlt_mp PCR_nTrbChPrtOfs_mp PCR_nTrbChSetPoint_mp PCR_nTrbChThres_mp PCR_pDesAirCtlOff_mp PCR_pDesBasAirCtlOffHiAltd_mp PCR_pDesBasAirCtlOff_mp PCR_pDesBasEOMQnt1_mp PCR_pDesBasEOMQnt2_mp PCR_pDesBasHiAltdEOMQnt1_mp PCR_pDesBasHiAltdEOMQnt2_mp PCR_pDesBasHiAltd_mp PCR_pDesBas_mp PCR_pDesDyn_mp PCR_pDesLimVal2_mp PCR_pDesLim_mp PCR_pDesMonHiAltd_mp PCR_pDesRawCor_mp PCR_pDesRaw_mp PCR_pDesStatVal1Cor_mp PCR_pDesStatVal2Cor_mp PCR_pDesT20CorRaw_mp PCR_pDesTrbChPrtCor PCR_pDesTrbChPrtCorRaw_mp PCR_pDesVal1EOMQnt1_mp PCR_pDesVal1EOMQnt2_mp PCR_pDesVal1_mp PCR_pDesVal2Cor_mp PCR_pDesVal2EOMQnt1_mp PCR_pDesVal2EOMQnt2_mp PCR_pDesVal2_mp PCR_pDesVal3EOM_mp PCR_pDesVal3_mp PCR_pDesValMonUnCor_mp PCR_pDesValNrm_mp PCR_pIOutT20_mp PCR_pIOut_mp PCR_pMaxDesVal_mp PCR_pPOutT20_mp PCR_pPOut_mp PCR_pTempCorBasEOMQnt1_mp PCR_pTempCorBasEOMQnt2_mp PCR_pTempCorBas_mp PCR_pTempCorEOMQnt1_mp PCR_pTempCorEOMQnt2_mp PCR_pTempCor_mp PCR_qDesValInl_mp PCR_qDesVal_mp PCR_stDesLogic_mp PCR_stEOMDesVal_mp PCR_stRmpSelDesCor_mp PCR_tAirDesVal_mp PCR_tCmprDsOvhtDvt_mp PCR_tDesVal_mp PCR_tEngDesVal_mp PCR_trqDesValInl_mp PCR_tT20Flt_mp PCR_tT20LimSetPoint_mp PCR_tT20Thres_mp /end LOC_MEASUREMENT
/end FUNCTION
/begin FUNCTION PCR_DesValCalcLP ""
 /begin DEF_CHARACTERISTIC PCR_dpDesValCalcLPLim.Pos_C PCR_dpDesValCalcLPLim.Neg_C PCR_drAPPUnFltPCRLP_C PCR_facAirTempDesCorLPEOMQnt1_CUR PCR_facAirTempDesCorLPEOMQnt2_CUR PCR_facAirTempDesCorLP_CUR PCR_facEnvPresDesCorLPEOMQnt1_CUR PCR_facEnvPresDesCorLPEOMQnt2_CUR PCR_facEnvPresDesCorLP_CUR PCR_facRmpValDesCorLP_CUR PCR_facTempDesCorLPEOMQnt1_CUR PCR_facTempDesCorLPEOMQnt2_CUR PCR_facTempDesCorLP_CUR PCR_nLimMaxLP_C PCR_nLimMinLP_C PCR_numAirTempDesValLP_C PCR_numEngTempDesValLP_C PCR_pDesBasLPEOMQnt1_MAP PCR_pDesBasLPEOMQnt2_MAP PCR_pDesBasLPHiAltdEOMQnt1_MAP PCR_pDesBasLPHiAltdEOMQnt2_MAP PCR_pDesBasLPHiAltd_MAP PCR_pDesBasLP_MAP PCR_pDesValCalcLPRmpInit_C PCR_pMaxDesValLP_MAP PCR_pMinDesValLP_C PCR_pTempCorBasLPEOMQnt1_MAP PCR_pTempCorBasLPEOMQnt2_MAP PCR_pTempCorBasLP_MAP PCR_stDesValLPEOMMsk_CA PCR_TempCorLP.xVal_C PCR_TempCorLP.xTyp_C PCR_tiDesValCalcLPLim.tiHiLo_C PCR_tiDesValCalcLPLim.tiLoHi_C /end DEF_CHARACTERISTIC
 /begin REF_CHARACTERISTIC HESrv_swtPOpVis_C HESrv_swtScndFlwActv_C /end REF_CHARACTERISTIC
 /begin IN_MEASUREMENT CoEOM_facRmpVal CoEOM_stOpModeAct EngDa_tFld EnvP_p Epm_nEng PCR_drAPPUnFlt PCR_qDesVal PCR_swtBstLPActv PCR_swtTempCor PCR_tDesVal_mp /end IN_MEASUREMENT
 /begin OUT_MEASUREMENT PCR_pDesValLP PCR_swtTempCorLP PCR_tAirDesValLP PCR_tDesValLP_mp PCR_tEngDesValLP /end OUT_MEASUREMENT
 /begin LOC_MEASUREMENT PCR_facAirTempDesCorLPEOMQnt1_mp PCR_facAirTempDesCorLPEOMQnt2_mp PCR_facAirTempDesCorLP_mp PCR_facEnvPresDesCorLPEOMQnt1_mp PCR_facEnvPresDesCorLPEOMQnt2_mp PCR_facEnvPresDesCorLP_mp PCR_facRmpValDesCorLP_mp PCR_facRmpValDesLP_mp PCR_facTempDesCorLPEOMQnt1_mp PCR_facTempDesCorLPEOMQnt2_mp PCR_facTempDesCorLP_mp PCR_pDesBasLPEOMQnt1_mp PCR_pDesBasLPEOMQnt2_mp PCR_pDesBasLPHiAltdEOMQnt1_mp PCR_pDesBasLPHiAltdEOMQnt2_mp PCR_pDesBasLPHiAltd_mp PCR_pDesBasLP_mp PCR_pDesStatLP_mp PCR_pDesVal1LPEOMQnt1_mp PCR_pDesVal1LPEOMQnt2_mp PCR_pDesVal1LP_mp PCR_pDesVal2LPEOMQnt1_mp PCR_pDesVal2LPEOMQnt2_mp PCR_pDesVal2LP_mp PCR_pDesVal3LPEOMQnt1_mp PCR_pDesVal3LPEOMQnt2_mp PCR_pDesValLPUnLim_mp PCR_pDesValNrmLP_mp PCR_pMaxDesValLP_mp PCR_pTempCorBasLPEOMQnt1_mp PCR_pTempCorBasLPEOMQnt2_mp PCR_pTempCorBasLP_mp PCR_pTempCorLPEOMQnt1_mp PCR_pTempCorLPEOMQnt2_mp PCR_pTempCorLP_mp PCR_qDesValInlLP_mp PCR_qDesValLP_mp PCR_stDesValLimLP_mp PCR_stEOMDesValLP_mp /end LOC_MEASUREMENT
/end FUNCTION
/begin FUNCTION PCR_Gov ""
 /begin DEF_CHARACTERISTIC PCR_DpCorrDT1.T1_C PCR_DpCorrDT1.Kd_C PCR_dpMinGov_C PCR_drChrgPmpCtlRmp.Pos_C PCR_drChrgPmpCtlRmp.Neg_C PCR_drGovMaxDyn.Pos_C PCR_drGovMaxDyn.Neg_C PCR_DT1Win.T1_C PCR_DT1Win.Kd_C PCR_DT1Win.KdPos_C PCR_DT1Win.KdNeg_C PCR_DT1Win.WinPos_C PCR_DT1Win.WinNeg_C PCR_facAirCtlCorNeg_MAP PCR_facAirCtlCorPos_MAP PCR_facDpCorr_CUR PCR_facD_MAP PCR_facGovMaxCorr_CUR PCR_facI_MAP PCR_facPresPFltMax_CUR PCR_facPresPFltMin_CUR PCR_facP_MAP PCR_facResFlw_MAP PCR_facT1_MAP PCR_GovMin_CUR PCR_GovOffAirMsTst_CUR PCR_GovOffEOM_CUR PCR_GovOff_CUR PCR_GovOnAirMsTst_CUR PCR_GovOnEOM_CUR PCR_GovOn_CUR PCR_GradPID.T1_C PCR_GradPID.Kd_C PCR_I.Ki_C PCR_I.KiPos_C PCR_I.KiNeg_C PCR_I.WinPos_C PCR_I.WinNeg_C PCR_P.Kp_C PCR_P.KpPos_C PCR_P.KpNeg_C PCR_P.WinPos_C PCR_P.WinNeg_C PCR_rAirCtlCorDiff_CUR PCR_RelAbs.xVal_C PCR_RelAbs.xTyp_C PCR_rGovMaxCorr_MAP PCR_rGovMaxDynCorr_MAP PCR_rGovMaxDynEnd_C PCR_rGovMaxDynStrt_C PCR_rGovMaxDyn_MAP PCR_rGovMax_MAP PCR_rGovMin_MAP PCR_rOutIMaxAirMsTst_MAP PCR_rOutIMax_MAP PCR_rOutIMin_MAP PCR_stMskGovOffEOM_C PCR_tiDelGov_C PCR_tiDelPT1_C PCR_tiGovOffDel_CUR PCR_tiPT1_C PCR_tiRmp_C /end DEF_CHARACTERISTIC
 /begin IN_MEASUREMENT AirCtl_rPCRDiffCoupling AirSys_stpDesValSysTst Air_dpFltIntkVUs Air_pIntkVUs CoEOM_stOpModeAct EnvP_p Epm_nEng Exh_pAdapPPFltUs InjCtl_qRaw PCR_pDesStat PCR_pDesVal PCR_qGov PCR_rCtlVal PCR_stMon PCR_stTrans PCR_trqGov PFltLd_resFlwFltAbs TCPrt_rChrgPmpCtlVal TCPrt_rChrgPmpGov TCPrt_stChrgPmpCtl /end IN_MEASUREMENT
 /begin OUT_MEASUREMENT PCR_facRmpVal PCR_pGovDvt PCR_rAirCtlDiffCoupling PCR_rGov PCR_rGovMaxCor PCR_rGovMinCor PCR_rGovOutUnLim PCR_rOutI PCR_stARW PCR_swtGov PCR_swtRelAbs /end OUT_MEASUREMENT
 /begin LOC_MEASUREMENT PCR_dpBGDev_mp PCR_drPID_mp PCR_facAirCtlCorNeg_mp PCR_facAirCtlCorPos_mp PCR_facD1_mp PCR_facD2_mp PCR_facdpCorr_mp PCR_facD_mp PCR_facI_mp PCR_facP_mp PCR_facResFlwCorr_mp PCR_facT1_mp PCR_GovOff_mp PCR_GovOn_mp PCR_pActVal_mp PCR_pAdapPPFltUs_mp PCR_pGovDvtI_mp PCR_qGov_mp PCR_rAirCtlCorDiff_mp PCR_rCtlValCorrChrgPmp_mp PCR_rCtlValCorr_mp PCR_rCtlValCor_mp PCR_rGovMax1_mp PCR_rGovMax2_mp PCR_rGovMaxDynRamp_mp PCR_rGovMaxDyn_mp PCR_rGovMaxNrm_mp PCR_rGovMaxVal1_mp PCR_rGovMaxVal2_mp PCR_rGovMax_mp PCR_rGovMinNrm_mp PCR_rGovMin_mp PCR_rGovOut_mp PCR_rOutDT1_mp PCR_rOutIMax_mp PCR_rOutIMin_mp PCR_rOutIValInit1_mp PCR_rOutIValInitFinal_mp PCR_rOutIValInit_mp PCR_rOutP_mp PCR_rPIDCor_mp PCR_rPIDCtl_mp PCR_rPID_mp PCR_stDynLimOn_mp PCR_stEOMGov_mp PCR_stSwtGovMaxDyn_mp PCR_swtGovNoDeb_mp PCR_tiGovOffDel_mp /end LOC_MEASUREMENT
/end FUNCTION
/begin COMPU_METHOD AirSysSwt "" RAT_FUNC "%10.9" "-" COEFFS 0 16384000 0 0 0 1 /end COMPU_METHOD
/begin COMPU_METHOD AirTempFldSel "" TAB_VERB "%6.3" "" COMPU_TAB_REF AirTempFldSel /end COMPU_METHOD
/begin COMPU_VTAB AirTempFldSel "" TAB_VERB 4 0 "Air_tCACDs" 1 "Air_tAFS" 2 "EnvT_t" 3 "Air_tAFSCorr" /end COMPU_VTAB
/begin COMPU_METHOD CoEOMSwt_S16 "" RAT_FUNC "%7.6" "-" COEFFS 0 16384 0 0 0 1 /end COMPU_METHOD
/begin COMPU_METHOD Def_ac_sb_q0p25 "" RAT_FUNC "%4.2" "-" COEFFS 0 4 0 0 0 1 /end COMPU_METHOD
/begin COMPU_METHOD Def_dez_ub_q1 "" RAT_FUNC "%3.1" "-" COEFFS 0 1 0 0 0 1 /end COMPU_METHOD
/begin COMPU_METHOD Def_dez_uw_q1 "" RAT_FUNC "%5.2" "-" COEFFS 0 1 0 0 0 1 /end COMPU_METHOD
/begin COMPU_METHOD Def_f_sb_b2 "" RAT_FUNC "%5.3" "-" COEFFS 0 64 0 0 0 1 /end COMPU_METHOD
/begin COMPU_METHOD Def_f_sw_b1 "" RAT_FUNC "%14.10" "-" COEFFS 0 32768 0 0 0 1 /end COMPU_METHOD
/begin COMPU_METHOD Def_f_sw_b32 "" RAT_FUNC "%9.6" "-" COEFFS 0 1024 0 0 0 1 /end COMPU_METHOD
/begin COMPU_METHOD Def_f_sw_b64 "" RAT_FUNC "%8.5" "-" COEFFS 0 512 0 0 0 1 /end COMPU_METHOD
/begin COMPU_METHOD Def_f_sw_b8 "" RAT_FUNC "%9.7" "-" COEFFS 0 4096 0 0 0 1 /end COMPU_METHOD
/begin COMPU_METHOD Def_f_ub_b1 "" RAT_FUNC "%6.4" "-" COEFFS 0 256 0 0 0 1 /end COMPU_METHOD
/begin COMPU_METHOD Def_f_ub_b8 "" RAT_FUNC "%5.3" "-" COEFFS 0 32 0 0 0 1 /end COMPU_METHOD
/begin COMPU_METHOD Def_f_uw_b10 "" RAT_FUNC "%9.7" "%" COEFFS 0 6553.6 0 0 0 1 /end COMPU_METHOD
/begin COMPU_METHOD Def_f_uw_b100 "" RAT_FUNC "%8.5" "%" COEFFS 0 655.36 0 0 0 1 /end COMPU_METHOD
/begin COMPU_METHOD Def_f_uw_b2 "" RAT_FUNC "%14.10" "-" COEFFS 0 32768 0 0 0 1 /end COMPU_METHOD
/begin COMPU_METHOD Def_km_uw_q10 "" RAT_FUNC "%5.1" "km" COEFFS 0 0.1 0 0 0 1 /end COMPU_METHOD
/begin COMPU_METHOD Def_niv_sb_b37p5 "" RAT_FUNC "%5.2" "mm" COEFFS 0 3.41333333333333 0 0 0 1 /end COMPU_METHOD
/begin COMPU_METHOD Def_niv_sw_q0p146 "" RAT_FUNC "%7.3" "mm" COEFFS 0 6.82666666666667 0 0 0 1 /end COMPU_METHOD
/begin COMPU_METHOD Def_niv_sw_q0p293 "" RAT_FUNC "%7.3" "mm" COEFFS 0 3.41333333333333 0 0 0 1 /end COMPU_METHOD
/begin COMPU_METHOD Def_niv_ub_b75 "" RAT_FUNC "%5.2" "mm" COEFFS 0 3.41333333333333 0 0 0 1 /end COMPU_METHOD
/begin COMPU_METHOD Def_niv_ub_q0p1 "" RAT_FUNC "%5.3" "l" COEFFS 0 10 0 0 0 1 /end COMPU_METHOD
/begin COMPU_METHOD Def_niv_uw_q0p293 "" RAT_FUNC "%7.3" "mm" COEFFS 0 3.41333333333333 0 0 0 1 /end COMPU_METHOD
/begin COMPU_METHOD Def_n_sw_q1p0 "" RAT_FUNC "%5.2" "Upm" COEFFS 0 1 0 0 0 1 /end COMPU_METHOD
/begin COMPU_METHOD Def_perm_uw_b6 "" RAT_FUNC "%14.10" "-" COEFFS 0 10922.6666666667 0 0 0 1 /end COMPU_METHOD
/begin COMPU_METHOD Def_p_uw_q039 "" RAT_FUNC "%8.5" "hPa" COEFFS 0 25.6 0 0 0 1 /end COMPU_METHOD
/begin COMPU_METHOD Def_st_ub_q1 "" RAT_FUNC "%3.1" "-" COEFFS 0 1 0 0 0 1 /end COMPU_METHOD
/begin COMPU_METHOD Def_td_ub_q1 "" RAT_FUNC "%5.2" "s" COEFFS 0 1 0 0 0 1 /end COMPU_METHOD
/begin COMPU_METHOD Def_td_uw_q0p01 "" RAT_FUNC "%7.5" "s" COEFFS 0 100 0 0 0 1 /end COMPU_METHOD
/begin COMPU_METHOD Def_td_uw_q0p1 "" RAT_FUNC "%6.3" "s" COEFFS 0 10 0 0 0 1 /end COMPU_METHOD
/begin COMPU_METHOD Def_tn_uw_q1 "" RAT_FUNC "%7.3" "min" COEFFS 0 1 0 0 0 1 /end COMPU_METHOD
/begin COMPU_METHOD Def_t_sw_q0p01 "" RAT_FUNC "%7.5" "°C" COEFFS 0 100 0 0 0 1 /end COMPU_METHOD
/begin COMPU_METHOD Def_t_sw_q0p1 "" RAT_FUNC "%6.3" "°C" COEFFS 0 10 0 0 0 1 /end COMPU_METHOD
/begin COMPU_METHOD dp_dZ20 "" RAT_FUNC "%6.1" "hPa/s" COEFFS 0 0.1 0 0 0 1 /end COMPU_METHOD
/begin COMPU_METHOD EngN "" RAT_FUNC "%5.1" "rpm" COEFFS 0 2 0 0 0 1 /end COMPU_METHOD
/begin COMPU_METHOD EngTempFldSel "" TAB_VERB "%6.3" "" COMPU_TAB_REF EngTempFldSel /end COMPU_METHOD
/begin COMPU_VTAB EngTempFldSel "" TAB_VERB 4 0 "Coolant_Temperature" 1 "Oil_Temperature" 2 "EngDa_tEng" 3 "Chamberwall_Temperature" /end COMPU_VTAB
/begin COMPU_METHOD Fact "" RAT_FUNC "%6.5" "-" COEFFS 0 8192 0 0 0 1 /end COMPU_METHOD
/begin COMPU_METHOD Fact1 "" RAT_FUNC "%6.4" "-" COEFFS 0 128 0 0 0 1 /end COMPU_METHOD
/begin COMPU_METHOD Fact_CBS "" RAT_FUNC "%6.4" "-" COEFFS 0 100 0 0 0 1 /end COMPU_METHOD
/begin COMPU_METHOD Fact_PCBS "" RAT_FUNC "%6.4" "%" COEFFS 0 100 0 0 0 1 /end COMPU_METHOD
/begin COMPU_METHOD Fl_2 "" RAT_FUNC "%6.1" "l" COEFFS 0 0.1 0 0 0 1 /end COMPU_METHOD
/begin COMPU_METHOD Fl_L "" RAT_FUNC "%6.4" "l" COEFFS 0 100 0 0 0 1 /end COMPU_METHOD
/begin COMPU_METHOD Fuel_Cons "" RAT_FUNC "%6.5" "l/100km" COEFFS 0 8192 0 0 0 1 /end COMPU_METHOD
/begin COMPU_METHOD InjMass "" RAT_FUNC "%5.2" "mg/hub" COEFFS 0 100 0 0 0 1 /end COMPU_METHOD
/begin COMPU_METHOD Kd "" RAT_FUNC "%7.6" "1/1" COEFFS 0 65536 0 0 0 1 /end COMPU_METHOD
/begin COMPU_METHOD Kd_Pres2dpdt "" RAT_FUNC "%8.7" "hPa/sec/hPa" COEFFS 0 131072 0 0 0 1 /end COMPU_METHOD
/begin COMPU_METHOD Kd_Pres_hPa2Prc "" RAT_FUNC "%9.8" "%/hPa" COEFFS 0 5368709.12 0 0 0 1 /end COMPU_METHOD
/begin COMPU_METHOD Ki_Pres_hPa2Prc "" RAT_FUNC "%8.7" "%/(hPa*s)" COEFFS 0 175921.86044416 0 0 0 1 /end COMPU_METHOD
/begin COMPU_METHOD Ki_Temp2Pres "" RAT_FUNC "%6.4" "hpa/_deg C/s" COEFFS 0 214.7483648 0 0 0 1 /end COMPU_METHOD
/begin COMPU_METHOD Ki_TurboN2Pres "" RAT_FUNC "%7.6" "hpa/_rpm/s" COEFFS 0 21474.83648 0 0 0 1 /end COMPU_METHOD
/begin COMPU_METHOD km_sw_q10 "" RAT_FUNC "%6.1" "km" COEFFS 0 0.1 0 0 0 1 /end COMPU_METHOD
/begin COMPU_METHOD km_sw_q100 "" RAT_FUNC "%6.0" "km" COEFFS 0 0.01 0 0 0 1 /end COMPU_METHOD
/begin COMPU_METHOD Kp_Pres_hPa2Prc "" RAT_FUNC "%9.8" "%/hPa" COEFFS 0 2684354.56 0 0 0 1 /end COMPU_METHOD
/begin COMPU_METHOD Kp_Temp2Pres "" RAT_FUNC "%6.5" "hpa/_deg C" COEFFS 0 3276.8 0 0 0 1 /end COMPU_METHOD
/begin COMPU_METHOD Kp_TurboN2Pres "" RAT_FUNC "%8.7" "hpa/_rpm" COEFFS 0 327680 0 0 0 1 /end COMPU_METHOD
/begin COMPU_METHOD lProgWay "" RAT_FUNC "%7.0" "km" COEFFS 0 0.001 0 0 0 1 /end COMPU_METHOD
/begin COMPU_METHOD mSoot_g "" RAT_FUNC "%6.4" "g" COEFFS 0 100 0 0 0 1 /end COMPU_METHOD
/begin COMPU_METHOD OneToOne "" RAT_FUNC "%6.0" "-" COEFFS 0 1 0 0 0 1 /end COMPU_METHOD
/begin COMPU_METHOD OneToOne_km "" RAT_FUNC "%6.2" "km" COEFFS 0 1 0 0 0 1 /end COMPU_METHOD
/begin COMPU_METHOD Prc "" RAT_FUNC "%6.4" "%" COEFFS 0 81.92 0 0 0 1 /end COMPU_METHOD
/begin COMPU_METHOD PrcPerSec "" RAT_FUNC "%6.3" "%/s" COEFFS 0 1.6384 0 0 0 1 /end COMPU_METHOD
/begin COMPU_METHOD PreshPa_sec "" RAT_FUNC "%6.2" "hPa/s" COEFFS 0 1 0 0 0 1 /end COMPU_METHOD
/begin COMPU_METHOD Pres_hPa "" RAT_FUNC "%5.1" "hPa" COEFFS 0 1 0 0 0 1 /end COMPU_METHOD
/begin COMPU_METHOD Res_hPaHrPerCM "" RAT_FUNC "%7.6" "hPa/(m^3/h)" COEFFS 0 10000 0 0 0 1 /end COMPU_METHOD
/begin COMPU_METHOD RmpPrc "" RAT_FUNC "%6.5" "%/s" COEFFS 0 5368.70912 0 0 0 1 /end COMPU_METHOD
/begin COMPU_METHOD RmpPres_hPa "" RAT_FUNC "%6.4" "hPa/s" COEFFS 0 65.536 0 0 0 1 /end COMPU_METHOD
/begin COMPU_METHOD TempDiff_Cels "" RAT_FUNC "%6.3" "deg C" COEFFS 0 10 0 0 0 1 /end COMPU_METHOD
/begin COMPU_METHOD Temp_Cels "" RAT_FUNC "%5.1" "deg C" COEFFS 0 10 2731.4 0 0 1 /end COMPU_METHOD
/begin COMPU_METHOD TimeCoEOMRmp "" RAT_FUNC "%6.3" "s" COEFFS 0 0 1 0 0.0152587890625 0 /end COMPU_METHOD
/begin COMPU_METHOD TimeDeb "" RAT_FUNC "%5.0" "ms" COEFFS 0 0.1 0 0 0 1 /end COMPU_METHOD
/begin COMPU_METHOD TimeDelay_ms "" RAT_FUNC "%12.1" "ms" COEFFS 0 0 1 0 2.3283064365387e-007 0 /end COMPU_METHOD
/begin COMPU_METHOD TimeDelay_s "" RAT_FUNC "%12.4" "s" COEFFS 0 0 1 0 0.00023283064365387 0 /end COMPU_METHOD
/begin COMPU_METHOD Time_s "" RAT_FUNC "%5.2" "s" COEFFS 0 100 0 0 0 1 /end COMPU_METHOD
/begin COMPU_METHOD Trq "" RAT_FUNC "%5.1" "Nm" COEFFS 0 10 0 0 0 1 /end COMPU_METHOD
/begin COMPU_METHOD TurboN "" RAT_FUNC "%6.1" "rpm" COEFFS 0 0.1 0 0 0 1 /end COMPU_METHOD
/begin COMPU_METHOD default "" RAT_FUNC "%6.2" "" COEFFS 0 1 0 0 0 1 /end COMPU_METHOD
/begin RECORD_LAYOUT CurTKL_SB_VV_SB NO_AXIS_PTS_X 1 UBYTE RESERVED 2 BYTE AXIS_PTS_X 3 SBYTE INDEX_INCR DIRECT FNC_VALUES 4 SBYTE COLUMN_DIR DIRECT /end RECORD_LAYOUT
/begin RECORD_LAYOUT CurTKL_SW_VV_SW NO_AXIS_PTS_X 1 UBYTE RESERVED 2 BYTE AXIS_PTS_X 3 SWORD INDEX_INCR DIRECT FNC_VALUES 4 SWORD COLUMN_DIR DIRECT /end RECORD_LAYOUT
/begin RECORD_LAYOUT CurTKL_UB_VV_UB NO_AXIS_PTS_X 1 UBYTE RESERVED 2 BYTE AXIS_PTS_X 3 UBYTE INDEX_INCR DIRECT FNC_VALUES 4 UBYTE COLUMN_DIR DIRECT /end RECORD_LAYOUT
/begin RECORD_LAYOUT CurTKL_UW_VV_SW NO_AXIS_PTS_X 1 UBYTE RESERVED 2 BYTE AXIS_PTS_X 3 UWORD INDEX_INCR DIRECT FNC_VALUES 4 SWORD COLUMN_DIR DIRECT /end RECORD_LAYOUT
/begin RECORD_LAYOUT CurTKL_UW_VV_UB NO_AXIS_PTS_X 1 UBYTE RESERVED 2 BYTE AXIS_PTS_X 3 UWORD INDEX_INCR DIRECT FNC_VALUES 4 UBYTE COLUMN_DIR DIRECT /end RECORD_LAYOUT
/begin RECORD_LAYOUT CurTKL_UW_VV_UW NO_AXIS_PTS_X 1 UBYTE RESERVED 2 BYTE AXIS_PTS_X 3 UWORD INDEX_INCR DIRECT FNC_VALUES 4 UWORD COLUMN_DIR DIRECT /end RECORD_LAYOUT
/begin RECORD_LAYOUT Cur_Xs16Ws16 NO_AXIS_PTS_X 1 SWORD AXIS_PTS_X 2 SWORD INDEX_INCR DIRECT FNC_VALUES 3 SWORD COLUMN_DIR DIRECT /end RECORD_LAYOUT
/begin RECORD_LAYOUT Kf_Xs16_Ys16_Ws16 NO_AXIS_PTS_X 1 SWORD NO_AXIS_PTS_Y 2 SWORD AXIS_PTS_X 3 SWORD INDEX_INCR DIRECT AXIS_PTS_Y 4 SWORD INDEX_INCR DIRECT FNC_VALUES 5 SWORD COLUMN_DIR DIRECT /end RECORD_LAYOUT
/begin RECORD_LAYOUT Kl_Xs16_Ws16 NO_AXIS_PTS_X 1 SWORD AXIS_PTS_X 2 SWORD INDEX_INCR DIRECT FNC_VALUES 3 SWORD COLUMN_DIR DIRECT /end RECORD_LAYOUT
/begin RECORD_LAYOUT Kw_Ws16 FNC_VALUES 1 SWORD COLUMN_DIR DIRECT /end RECORD_LAYOUT
/begin RECORD_LAYOUT Kw_Ws32 FNC_VALUES 1 SLONG COLUMN_DIR DIRECT /end RECORD_LAYOUT
/begin RECORD_LAYOUT Kw_Wu16 FNC_VALUES 1 UWORD COLUMN_DIR DIRECT /end RECORD_LAYOUT
/begin RECORD_LAYOUT Kw_Wu8 FNC_VALUES 1 UBYTE COLUMN_DIR DIRECT /end RECORD_LAYOUT
/begin RECORD_LAYOUT MapTKF_SW_SW_SW NO_AXIS_PTS_X 1 UBYTE NO_AXIS_PTS_Y 2 UBYTE AXIS_PTS_X 3 SWORD INDEX_INCR DIRECT AXIS_PTS_Y 4 SWORD INDEX_INCR DIRECT FNC_VALUES 5 SWORD COLUMN_DIR DIRECT /end RECORD_LAYOUT
/begin RECORD_LAYOUT MapTKF_UW_SW_SW NO_AXIS_PTS_X 1 UBYTE NO_AXIS_PTS_Y 2 UBYTE AXIS_PTS_X 3 SWORD INDEX_INCR DIRECT AXIS_PTS_Y 4 UWORD INDEX_INCR DIRECT FNC_VALUES 5 SWORD COLUMN_DIR DIRECT /end RECORD_LAYOUT
/begin RECORD_LAYOUT MapTKF_UW_UW_UW NO_AXIS_PTS_X 1 UBYTE NO_AXIS_PTS_Y 2 UBYTE AXIS_PTS_X 3 UWORD INDEX_INCR DIRECT AXIS_PTS_Y 4 UWORD INDEX_INCR DIRECT FNC_VALUES 5 UWORD COLUMN_DIR DIRECT /end RECORD_LAYOUT
/begin RECORD_LAYOUT Map_Xs16Ys16Ws16 NO_AXIS_PTS_X 1 SWORD NO_AXIS_PTS_Y 2 SWORD AXIS_PTS_X 3 SWORD INDEX_INCR DIRECT AXIS_PTS_Y 4 SWORD INDEX_INCR DIRECT FNC_VALUES 5 SWORD COLUMN_DIR DIRECT /end RECORD_LAYOUT
/begin RECORD_LAYOUT ValA_Wu32 FNC_VALUES 1 ULONG COLUMN_DIR DIRECT /end RECORD_LAYOUT
/begin RECORD_LAYOUT Val_Ws16 FNC_VALUES 1 SWORD COLUMN_DIR DIRECT /end RECORD_LAYOUT
/begin RECORD_LAYOUT Val_Ws32 FNC_VALUES 1 SLONG COLUMN_DIR DIRECT /end RECORD_LAYOUT
/begin RECORD_LAYOUT Val_Ws8 FNC_VALUES 1 SBYTE COLUMN_DIR DIRECT /end RECORD_LAYOUT
/begin RECORD_LAYOUT Val_Wu16 FNC_VALUES 1 UWORD COLUMN_DIR DIRECT /end RECORD_LAYOUT
/begin RECORD_LAYOUT Val_Wu32 FNC_VALUES 1 ULONG COLUMN_DIR DIRECT /end RECORD_LAYOUT
/begin RECORD_LAYOUT Val_Wu8 FNC_VALUES 1 UBYTE COLUMN_DIR DIRECT /end RECORD_LAYOUT
/end MODULE
/end PROJECT

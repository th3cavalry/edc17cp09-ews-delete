ASAP2_VERSION 1 4
/begin PROJECT P_574 "EDC17_CP09"
/begin HEADER "" VERSION "V8KB" PROJECT_NO P_574 /end HEADER
/begin MODULE DIM ""
/begin MOD_COMMON "" BYTE_ORDER MSB_LAST ALIGNMENT_BYTE 1 ALIGNMENT_WORD 2 ALIGNMENT_LONG 4 ALIGNMENT_FLOAT32_IEEE 4 /end MOD_COMMON
/begin CHARACTERISTIC DFC_DisblMsk.DFC_FlFltDsPSRCMin_C "DFC/Abschalt Maske für Prüfung DFC_FlFltDsPSRCMin" VALUE 0x8002629A Val_Wu16 65535.00 DFES_OneToOne 0.00 65535.00 /end CHARACTERISTIC
/begin CHARACTERISTIC DFC_DisblMsk.DFC_FlFltSig_C "DFC/Abschalt Maske für Prüfung DFC_FlFltSig" VALUE 0x8002629C Val_Wu16 65535.00 DFES_OneToOne 0.00 65535.00 /end CHARACTERISTIC
/begin CHARACTERISTIC DFC_DisblMsk.DFC_FlFltUsPSRCMax_C "DFC/Abschalt Maske für Prüfung DFC_FlFltUsPSRCMax" VALUE 0x8002629E Val_Wu16 65535.00 DFES_OneToOne 0.00 65535.00 /end CHARACTERISTIC
/begin CHARACTERISTIC DFC_DisblMsk.DFC_FlFltUsPSRCMin_C "DFC/Abschalt Maske für Prüfung DFC_FlFltUsPSRCMin" VALUE 0x800262A0 Val_Wu16 65535.00 DFES_OneToOne 0.00 65535.00 /end CHARACTERISTIC
/begin CHARACTERISTIC DFC_DisblMsk.DFC_FuelTSRCMax_C "DFC/Abschalt Maske für Prüfung DFC_FuelTSRCMax" VALUE 0x800262A2 Val_Wu16 65535.00 DFES_OneToOne 0.00 65535.00 /end CHARACTERISTIC
/begin CHARACTERISTIC DFC_DisblMsk.DFC_FuelTSRCMin_C "DFC/Abschalt Maske für Prüfung DFC_FuelTSRCMin" VALUE 0x800262A4 Val_Wu16 65535.00 DFES_OneToOne 0.00 65535.00 /end CHARACTERISTIC
/begin CHARACTERISTIC DFC_DisblMsk.DFC_GbxNPosPPerSRCMax_C "DFC/Abschalt Maske für Prüfung DFC_GbxNPosPPerSRCMax" VALUE 0x800262A6 Val_Wu16 65535.00 DFES_OneToOne 0.00 65535.00 /end CHARACTERISTIC
/begin CHARACTERISTIC DFC_DisblMsk.DFC_GbxNPosPPerSRCMin_C "DFC/Abschalt Maske für Prüfung DFC_GbxNPosPPerSRCMin" VALUE 0x800262A8 Val_Wu16 65535.00 DFES_OneToOne 0.00 65535.00 /end CHARACTERISTIC
/begin CHARACTERISTIC DFC_DisblMsk.DFC_GbxNPosPdcycSRCMax_C "DFC/Abschalt Maske für Prüfung DFC_GbxNPosPdcycSRCMax" VALUE 0x800262AA Val_Wu16 65535.00 DFES_OneToOne 0.00 65535.00 /end CHARACTERISTIC
/begin CHARACTERISTIC DFC_DisblMsk.DFC_GbxNPosPdcycSRCMin_C "DFC/Abschalt Maske für Prüfung DFC_GbxNPosPdcycSRCMin" VALUE 0x800262AC Val_Wu16 65535.00 DFES_OneToOne 0.00 65535.00 /end CHARACTERISTIC
/begin CHARACTERISTIC DFC_DisblMsk.DFC_InjVlvPresMin_C "DFC/Abschalt Maske für Prüfung DFC_InjVlvPresMin" VALUE 0x800262AE Val_Wu16 65535.00 DFES_OneToOne 0.00 65535.00 /end CHARACTERISTIC
/begin CHARACTERISTIC DFC_DisblMsk.DFC_LSUCircNernstSig_C "DFC/Abschalt Maske für Prüfung DFC_LSUCircNernstSig" VALUE 0x800262B0 Val_Wu16 65535.00 DFES_OneToOne 0.00 65535.00 /end CHARACTERISTIC
/begin CHARACTERISTIC DFC_DisblMsk.DFC_LSUCircPmpCurSig_C "DFC/Abschalt Maske für Prüfung DFC_LSUCircPmpCurSig" VALUE 0x800262B2 Val_Wu16 65535.00 DFES_OneToOne 0.00 65535.00 /end CHARACTERISTIC
/begin CHARACTERISTIC DFC_DisblMsk.DFC_LSUCircVirtGndSig_C "DFC/Abschalt Maske für Prüfung DFC_LSUCircVirtGndSig" VALUE 0x800262B4 Val_Wu16 65535.00 DFES_OneToOne 0.00 65535.00 /end CHARACTERISTIC
/begin CHARACTERISTIC DFC_DisblMsk.DFC_LSUO2Max_C "DFC/Abschalt Maske für Prüfung DFC_LSUO2Max" VALUE 0x800262B6 Val_Wu16 65535.00 DFES_OneToOne 0.00 65535.00 /end CHARACTERISTIC
/begin CHARACTERISTIC DFC_DisblMsk.DFC_LSUO2Min_C "DFC/Abschalt Maske für Prüfung DFC_LSUO2Min" VALUE 0x800262B8 Val_Wu16 65535.00 DFES_OneToOne 0.00 65535.00 /end CHARACTERISTIC
/begin CHARACTERISTIC DFC_DisblMsk.DFC_LSUSPIBattLowMin_C "DFC/Abschalt Maske für Prüfung DFC_LSUSPIBattLowMin" VALUE 0x800262BA Val_Wu16 65535.00 DFES_OneToOne 0.00 65535.00 /end CHARACTERISTIC
/begin CHARACTERISTIC DFC_DisblMsk.DFC_LSUWireSCB_C "DFC/Abschalt Maske für Prüfung DFC_LSUWireSCB" VALUE 0x800262BC Val_Wu16 65535.00 DFES_OneToOne 0.00 65535.00 /end CHARACTERISTIC
/begin CHARACTERISTIC DFC_DisblMsk.DFC_LSUWireSCG_C "DFC/Abschalt Maske für Prüfung DFC_LSUWireSCG" VALUE 0x800262BE Val_Wu16 65535.00 DFES_OneToOne 0.00 65535.00 /end CHARACTERISTIC
/begin CHARACTERISTIC DFC_DisblMsk.DFC_MeUnSCG_C "DFC/Abschalt Maske für Prüfung DFC_MeUnSCG" VALUE 0x800262C0 Val_Wu16 65535.00 DFES_OneToOne 0.00 65535.00 /end CHARACTERISTIC
/begin CHARACTERISTIC DFC_DisblMsk.DFC_NSCDsCmpChk_C "DFC/Abschalt Maske für Prüfung DFC_NSCDsCmpChk" VALUE 0x800262C2 Val_Wu16 65535.00 DFES_OneToOne 0.00 65535.00 /end CHARACTERISTIC
/begin CHARACTERISTIC DFC_DisblMsk.DFC_NSCDsLamBinSRCMax_C "DFC/Abschalt Maske für Prüfung DFC_NSCDsLamBinSRCMax" VALUE 0x800262C4 Val_Wu16 65535.00 DFES_OneToOne 0.00 65535.00 /end CHARACTERISTIC
/begin CHARACTERISTIC DFC_DisblMsk.DFC_NSCDsLamBinSRCMin_C "DFC/Abschalt Maske für Prüfung DFC_NSCDsLamBinSRCMin" VALUE 0x800262C6 Val_Wu16 65535.00 DFES_OneToOne 0.00 65535.00 /end CHARACTERISTIC
/begin CHARACTERISTIC DFC_DisblMsk.DFC_NSCDsLamLinSRCMax_C "DFC/Abschalt Maske für Prüfung DFC_NSCDsLamLinSRCMax" VALUE 0x800262C8 Val_Wu16 65535.00 DFES_OneToOne 0.00 65535.00 /end CHARACTERISTIC
/begin CHARACTERISTIC DFC_DisblMsk.DFC_NSCDsLamLinSRCMin_C "DFC/Abschalt Maske für Prüfung DFC_NSCDsLamLinSRCMin" VALUE 0x800262CA Val_Wu16 65535.00 DFES_OneToOne 0.00 65535.00 /end CHARACTERISTIC
/begin CHARACTERISTIC DFC_DisblMsk.DFC_NSCDsLamPlausMax_C "DFC/Abschalt Maske für Prüfung DFC_NSCDsLamPlausMax" VALUE 0x800262CC Val_Wu16 65535.00 DFES_OneToOne 0.00 65535.00 /end CHARACTERISTIC
/begin CHARACTERISTIC DFC_DisblMsk.DFC_NSCDsLamPlausMin_C "DFC/Abschalt Maske für Prüfung DFC_NSCDsLamPlausMin" VALUE 0x800262CE Val_Wu16 65535.00 DFES_OneToOne 0.00 65535.00 /end CHARACTERISTIC
/begin CHARACTERISTIC DFC_DisblMsk.DFC_NSCDsNOxSRCMax_C "DFC/Abschalt Maske für Prüfung DFC_NSCDsNOxSRCMax" VALUE 0x800262D0 Val_Wu16 65535.00 DFES_OneToOne 0.00 65535.00 /end CHARACTERISTIC
/begin CHARACTERISTIC DFC_DisblMsk.DFC_NSCDsNOxSRCMin_C "DFC/Abschalt Maske für Prüfung DFC_NSCDsNOxSRCMin" VALUE 0x800262D2 Val_Wu16 65535.00 DFES_OneToOne 0.00 65535.00 /end CHARACTERISTIC
/begin CHARACTERISTIC DFC_DisblMsk.DFC_NSCDsOpCir_C "DFC/Abschalt Maske für Prüfung DFC_NSCDsOpCir" VALUE 0x800262D4 Val_Wu16 65535.00 DFES_OneToOne 0.00 65535.00 /end CHARACTERISTIC
/begin CHARACTERISTIC DFC_DisblMsk.DFC_NSCDsShCir_C "DFC/Abschalt Maske für Prüfung DFC_NSCDsShCir" VALUE 0x800262D6 Val_Wu16 65535.00 DFES_OneToOne 0.00 65535.00 /end CHARACTERISTIC
/begin CHARACTERISTIC DFC_DisblMsk.DFC_NoCat2DsCmpChk_C "DFC/Abschalt Maske für Prüfung DFC_NoCat2DsCmpChk" VALUE 0x800262D8 Val_Wu16 65535.00 DFES_OneToOne 0.00 65535.00 /end CHARACTERISTIC
/begin CHARACTERISTIC DFC_DisblMsk.DFC_NoCat2DsLamBinSRCMax_C "DFC/Abschalt Maske für Prüfung DFC_NoCat2DsLamBinSRCMax" VALUE 0x800262DA Val_Wu16 65535.00 DFES_OneToOne 0.00 65535.00 /end CHARACTERISTIC
/begin CHARACTERISTIC DFC_DisblMsk.DFC_NoCat2DsLamBinSRCMin_C "DFC/Abschalt Maske für Prüfung DFC_NoCat2DsLamBinSRCMin" VALUE 0x800262DC Val_Wu16 65535.00 DFES_OneToOne 0.00 65535.00 /end CHARACTERISTIC
/begin CHARACTERISTIC DFC_DisblMsk.DFC_NoCat2DsLamLinSRCMax_C "DFC/Abschalt Maske für Prüfung DFC_NoCat2DsLamLinSRCMax" VALUE 0x800262DE Val_Wu16 65535.00 DFES_OneToOne 0.00 65535.00 /end CHARACTERISTIC
/begin CHARACTERISTIC DFC_DisblMsk.DFC_NoCat2DsLamLinSRCMin_C "DFC/Abschalt Maske für Prüfung DFC_NoCat2DsLamLinSRCMin" VALUE 0x800262E0 Val_Wu16 65535.00 DFES_OneToOne 0.00 65535.00 /end CHARACTERISTIC
/begin CHARACTERISTIC DFC_DisblMsk.DFC_NoCat2DsLamPlausMax_C "DFC/Abschalt Maske für Prüfung DFC_NoCat2DsLamPlausMax" VALUE 0x800262E2 Val_Wu16 65535.00 DFES_OneToOne 0.00 65535.00 /end CHARACTERISTIC
/begin CHARACTERISTIC DFC_DisblMsk.DFC_NoCat2DsLamPlausMin_C "DFC/Abschalt Maske für Prüfung DFC_NoCat2DsLamPlausMin" VALUE 0x800262E4 Val_Wu16 65535.00 DFES_OneToOne 0.00 65535.00 /end CHARACTERISTIC
/begin CHARACTERISTIC DFC_DisblMsk.DFC_NoCat2DsNOxSRCMax_C "DFC/Abschalt Maske für Prüfung DFC_NoCat2DsNOxSRCMax" VALUE 0x800262E6 Val_Wu16 65535.00 DFES_OneToOne 0.00 65535.00 /end CHARACTERISTIC
/begin CHARACTERISTIC DFC_DisblMsk.DFC_NoCat2DsNOxSRCMin_C "DFC/Abschalt Maske für Prüfung DFC_NoCat2DsNOxSRCMin" VALUE 0x800262E8 Val_Wu16 65535.00 DFES_OneToOne 0.00 65535.00 /end CHARACTERISTIC
/begin CHARACTERISTIC DFC_DisblMsk.DFC_NoCat2DsOpCir_C "DFC/Abschalt Maske für Prüfung DFC_NoCat2DsOpCir" VALUE 0x800262EA Val_Wu16 65535.00 DFES_OneToOne 0.00 65535.00 /end CHARACTERISTIC
/begin CHARACTERISTIC DFC_DisblMsk.DFC_NoCat2DsShCir_C "DFC/Abschalt Maske für Prüfung DFC_NoCat2DsShCir" VALUE 0x800262EC Val_Wu16 65535.00 DFES_OneToOne 0.00 65535.00 /end CHARACTERISTIC
/begin CHARACTERISTIC DFC_DisblMsk.DFC_NplDynPPFltDiff_C "DFC/Abschalt Maske für Prüfung DFC_NplDynPPFltDiff" VALUE 0x800262EE Val_Wu16 65535.00 DFES_OneToOne 0.00 65535.00 /end CHARACTERISTIC
/begin CHARACTERISTIC DFC_DisblMsk.DFC_NplHsChngPPFltDiff_C "DFC/Abschalt Maske für Prüfung DFC_NplHsChngPPFltDiff" VALUE 0x800262F0 Val_Wu16 65535.00 DFES_OneToOne 0.00 65535.00 /end CHARACTERISTIC
/begin CHARACTERISTIC DFC_DisblMsk.DFC_NplHsLnPPFltDiff_C "DFC/Abschalt Maske für Prüfung DFC_NplHsLnPPFltDiff" VALUE 0x800262F2 Val_Wu16 65535.00 DFES_OneToOne 0.00 65535.00 /end CHARACTERISTIC
/begin CHARACTERISTIC DFC_DisblMsk.DFC_NplTOxiCatUs_C "DFC/Abschalt Maske für Prüfung DFC_NplTOxiCatUs" VALUE 0x800262F4 Val_Wu16 65535.00 DFES_OneToOne 0.00 65535.00 /end CHARACTERISTIC
/begin CHARACTERISTIC DFC_DisblMsk.DFC_NplTPFltUs_C "DFC/Abschalt Maske für Prüfung DFC_NplTPFltUs" VALUE 0x800262F6 Val_Wu16 65535.00 DFES_OneToOne 0.00 65535.00 /end CHARACTERISTIC
/begin CHARACTERISTIC DFC_DisblMsk.DFC_NplTTrbnUs_C "DFC/Abschalt Maske für Prüfung DFC_NplTTrbnUs" VALUE 0x800262F8 Val_Wu16 65535.00 DFES_OneToOne 0.00 65535.00 /end CHARACTERISTIC
/begin CHARACTERISTIC DFC_DisblMsk.DFC_OilPSwmpSRCMax_C "DFC/Abschalt Maske für Prüfung DFC_OilPSwmpSRCMax" VALUE 0x800262FA Val_Wu16 65535.00 DFES_OneToOne 0.00 65535.00 /end CHARACTERISTIC
/begin CHARACTERISTIC DFC_DisblMsk.DFC_OilPSwmpSRCMin_C "DFC/Abschalt Maske für Prüfung DFC_OilPSwmpSRCMin" VALUE 0x800262FC Val_Wu16 65535.00 DFES_OneToOne 0.00 65535.00 /end CHARACTERISTIC
/begin CHARACTERISTIC DFC_DisblMsk.DFC_PCVSCG_C "DFC/Abschalt Maske für Prüfung DFC_PCVSCG" VALUE 0x800262FE Val_Wu16 65535.00 DFES_OneToOne 0.00 65535.00 /end CHARACTERISTIC
/begin CHARACTERISTIC DFC_DisblMsk.DFC_PFltCharPDiffMin_C "DFC/Abschalt Maske für Prüfung DFC_PFltCharPDiffMin" VALUE 0x80026300 Val_Wu16 65535.00 DFES_OneToOne 0.00 65535.00 /end CHARACTERISTIC
/begin CHARACTERISTIC DFC_DisblMsk.DFC_PFltDstrMin_C "DFC/Abschalt Maske für Prüfung DFC_PFltDstrMin" VALUE 0x80026302 Val_Wu16 65535.00 DFES_OneToOne 0.00 65535.00 /end CHARACTERISTIC
/begin CHARACTERISTIC DFC_DisblMsk.DFC_PFltEngPrt_C "DFC/Abschalt Maske für Prüfung DFC_PFltEngPrt" VALUE 0x80026304 Val_Wu16 65535.00 DFES_OneToOne 0.00 65535.00 /end CHARACTERISTIC
/begin CHARACTERISTIC DFC_DisblMsk.DFC_PFltRgnPerm_C "DFC/Abschalt Maske für Prüfung DFC_PFltRgnPerm" VALUE 0x80026306 Val_Wu16 65535.00 DFES_OneToOne 0.00 65535.00 /end CHARACTERISTIC
/begin CHARACTERISTIC DFC_DisblMsk.DFC_PFltSRCMaxFlwRstn_C "DFC/Abschalt Maske für Prüfung DFC_PFltSRCMaxFlwRstn" VALUE 0x80026308 Val_Wu16 65535.00 DFES_OneToOne 0.00 65535.00 /end CHARACTERISTIC
/begin CHARACTERISTIC DFC_DisblMsk.DFC_PFltSRCMinFlwRstn_C "DFC/Abschalt Maske für Prüfung DFC_PFltSRCMinFlwRstn" VALUE 0x8002630A Val_Wu16 65535.00 DFES_OneToOne 0.00 65535.00 /end CHARACTERISTIC
/begin CHARACTERISTIC DFC_DisblMsk.DFC_PFltSotMsDvtMax_C "DFC/Abschalt Maske für Prüfung DFC_PFltSotMsDvtMax" VALUE 0x8002630C Val_Wu16 65535.00 DFES_OneToOne 0.00 65535.00 /end CHARACTERISTIC
/begin CHARACTERISTIC DFC_DisblMsk.DFC_PFltSotMsDvtMin_C "DFC/Abschalt Maske für Prüfung DFC_PFltSotMsDvtMin" VALUE 0x8002630E Val_Wu16 65535.00 DFES_OneToOne 0.00 65535.00 /end CHARACTERISTIC
/begin CHARACTERISTIC DFC_DisblMsk.DFC_PFltSotMsMax_C "DFC/Abschalt Maske für Prüfung DFC_PFltSotMsMax" VALUE 0x80026310 Val_Wu16 65535.00 DFES_OneToOne 0.00 65535.00 /end CHARACTERISTIC
/begin CHARACTERISTIC DFC_DisblMsk.DFC_PIntkVUsSRCMax_C "DFC/Abschalt Maske für Prüfung DFC_PIntkVUsSRCMax" VALUE 0x80026312 Val_Wu16 65535.00 DFES_OneToOne 0.00 65535.00 /end CHARACTERISTIC
/begin CHARACTERISTIC DFC_DisblMsk.DFC_PIntkVUsSRCMin_C "DFC/Abschalt Maske für Prüfung DFC_PIntkVUsSRCMin" VALUE 0x80026314 Val_Wu16 65535.00 DFES_OneToOne 0.00 65535.00 /end CHARACTERISTIC
/begin CHARACTERISTIC DFC_DisblMsk.DFC_SRCHighAPP1_C "DFC/Abschalt Maske für Prüfung DFC_SRCHighAPP1" VALUE 0x80026316 Val_Wu16 65535.00 DFES_OneToOne 0.00 65535.00 /end CHARACTERISTIC
/begin CHARACTERISTIC DFC_DisblMsk.DFC_SRCHighAPP2_C "DFC/Abschalt Maske für Prüfung DFC_SRCHighAPP2" VALUE 0x80026318 Val_Wu16 65535.00 DFES_OneToOne 0.00 65535.00 /end CHARACTERISTIC
/begin CHARACTERISTIC DFC_DisblMsk.DFC_SRCLowAPP1_C "DFC/Abschalt Maske für Prüfung DFC_SRCLowAPP1" VALUE 0x8002631A Val_Wu16 65535.00 DFES_OneToOne 0.00 65535.00 /end CHARACTERISTIC
/begin CHARACTERISTIC DFC_DisblMsk.DFC_SRCLowAPP2_C "DFC/Abschalt Maske für Prüfung DFC_SRCLowAPP2" VALUE 0x8002631C Val_Wu16 65535.00 DFES_OneToOne 0.00 65535.00 /end CHARACTERISTIC
/begin CHARACTERISTIC DFC_DisblMsk.DFC_SRCMaxPPFltDiff_C "DFC/Abschalt Maske für Prüfung DFC_SRCMaxPPFltDiff" VALUE 0x8002631E Val_Wu16 65535.00 DFES_OneToOne 0.00 65535.00 /end CHARACTERISTIC
/begin CHARACTERISTIC DFC_DisblMsk.DFC_SRCMaxPPFltUs_C "DFC/Abschalt Maske für Prüfung DFC_SRCMaxPPFltUs" VALUE 0x80026320 Val_Wu16 65535.00 DFES_OneToOne 0.00 65535.00 /end CHARACTERISTIC
/begin CHARACTERISTIC DFC_DisblMsk.DFC_SRCMaxTECU_C "DFC/Abschalt Maske für Prüfung DFC_SRCMaxTECU" VALUE 0x80026322 Val_Wu16 65535.00 DFES_OneToOne 0.00 65535.00 /end CHARACTERISTIC
/begin CHARACTERISTIC DFC_DisblMsk.DFC_SRCMaxTOxiCatUs_C "DFC/Abschalt Maske für Prüfung DFC_SRCMaxTOxiCatUs" VALUE 0x80026324 Val_Wu16 65535.00 DFES_OneToOne 0.00 65535.00 /end CHARACTERISTIC
/begin CHARACTERISTIC DFC_DisblMsk.DFC_SRCMaxTPFltUs_C "DFC/Abschalt Maske für Prüfung DFC_SRCMaxTPFltUs" VALUE 0x80026326 Val_Wu16 65535.00 DFES_OneToOne 0.00 65535.00 /end CHARACTERISTIC
/begin CHARACTERISTIC DFC_DisblMsk.DFC_SRCMaxTTrbnUs_C "DFC/Abschalt Maske für Prüfung DFC_SRCMaxTTrbnUs" VALUE 0x80026328 Val_Wu16 65535.00 DFES_OneToOne 0.00 65535.00 /end CHARACTERISTIC
/begin CHARACTERISTIC DFC_DisblMsk.DFC_SRCMaxUCatUsT_C "DFC/Abschalt Maske für Prüfung DFC_SRCMaxUCatUsT" VALUE 0x8002632A Val_Wu16 65535.00 DFES_OneToOne 0.00 65535.00 /end CHARACTERISTIC
/begin CHARACTERISTIC DFC_DisblMsk.DFC_SRCMaxUPmpP_C "DFC/Abschalt Maske für Prüfung DFC_SRCMaxUPmpP" VALUE 0x8002632C Val_Wu16 65535.00 DFES_OneToOne 0.00 65535.00 /end CHARACTERISTIC
/begin CHARACTERISTIC DFC_DisblMsk.DFC_SRCMinPPFltDiff_C "DFC/Abschalt Maske für Prüfung DFC_SRCMinPPFltDiff" VALUE 0x8002632E Val_Wu16 65535.00 DFES_OneToOne 0.00 65535.00 /end CHARACTERISTIC
/begin CHARACTERISTIC DFC_DisblMsk.DFC_SRCMinPPFltUs_C "DFC/Abschalt Maske für Prüfung DFC_SRCMinPPFltUs" VALUE 0x80026330 Val_Wu16 65535.00 DFES_OneToOne 0.00 65535.00 /end CHARACTERISTIC
/begin CHARACTERISTIC DFC_DisblMsk.DFC_SRCMinTECU_C "DFC/Abschalt Maske für Prüfung DFC_SRCMinTECU" VALUE 0x80026332 Val_Wu16 65535.00 DFES_OneToOne 0.00 65535.00 /end CHARACTERISTIC
/begin CHARACTERISTIC DFC_DisblMsk.DFC_SRCMinTOxiCatUs_C "DFC/Abschalt Maske für Prüfung DFC_SRCMinTOxiCatUs" VALUE 0x80026334 Val_Wu16 65535.00 DFES_OneToOne 0.00 65535.00 /end CHARACTERISTIC
/begin CHARACTERISTIC DFC_DisblMsk.DFC_SRCMinTPFltUs_C "DFC/Abschalt Maske für Prüfung DFC_SRCMinTPFltUs" VALUE 0x80026336 Val_Wu16 65535.00 DFES_OneToOne 0.00 65535.00 /end CHARACTERISTIC
/begin CHARACTERISTIC DFC_DisblMsk.DFC_SRCMinTTrbnUs_C "DFC/Abschalt Maske für Prüfung DFC_SRCMinTTrbnUs" VALUE 0x80026338 Val_Wu16 65535.00 DFES_OneToOne 0.00 65535.00 /end CHARACTERISTIC
/begin CHARACTERISTIC DFC_DisblMsk.DFC_SRCMinUCatUsT_C "DFC/Abschalt Maske für Prüfung DFC_SRCMinUCatUsT" VALUE 0x8002633A Val_Wu16 65535.00 DFES_OneToOne 0.00 65535.00 /end CHARACTERISTIC
/begin CHARACTERISTIC DFC_DisblMsk.DFC_SRCMinUPmpP_C "DFC/Abschalt Maske für Prüfung DFC_SRCMinUPmpP" VALUE 0x8002633C Val_Wu16 65535.00 DFES_OneToOne 0.00 65535.00 /end CHARACTERISTIC
/begin CHARACTERISTIC DFC_DisblMsk.DFC_SigUCatUsT_C "DFC/Abschalt Maske für Prüfung DFC_SigUCatUsT" VALUE 0x8002633E Val_Wu16 65535.00 DFES_OneToOne 0.00 65535.00 /end CHARACTERISTIC
/begin CHARACTERISTIC DFC_DisblMsk.DFC_SigUPmpP_C "DFC/Abschalt Maske für Prüfung DFC_SigUPmpP" VALUE 0x80026340 Val_Wu16 65535.00 DFES_OneToOne 0.00 65535.00 /end CHARACTERISTIC
/begin CHARACTERISTIC DFC_DisblMsk.DFC_SyncAPP_C "DFC/Abschalt Maske für Prüfung DFC_SyncAPP" VALUE 0x80026342 Val_Wu16 65535.00 DFES_OneToOne 0.00 65535.00 /end CHARACTERISTIC
/begin CHARACTERISTIC DFC_DisblMsk.DFC_T15Npl_C "DFC/Abschalt Maske für Prüfung DFC_T15Npl" VALUE 0x80026344 Val_Wu16 65535.00 DFES_OneToOne 0.00 65535.00 /end CHARACTERISTIC
/begin CHARACTERISTIC DFC_DisblMsk.DFC_TAFSDtyCycHi_C "DFC/Abschalt Maske für Prüfung DFC_TAFSDtyCycHi" VALUE 0x80026346 Val_Wu16 65535.00 DFES_OneToOne 0.00 65535.00 /end CHARACTERISTIC
/begin CHARACTERISTIC DFC_DisblMsk.DFC_TAFSDtyCycLo_C "DFC/Abschalt Maske für Prüfung DFC_TAFSDtyCycLo" VALUE 0x80026348 Val_Wu16 65535.00 DFES_OneToOne 0.00 65535.00 /end CHARACTERISTIC
/begin CHARACTERISTIC DFC_DisblMsk.DFC_TAFSPerHi_C "DFC/Abschalt Maske für Prüfung DFC_TAFSPerHi" VALUE 0x8002634A Val_Wu16 65535.00 DFES_OneToOne 0.00 65535.00 /end CHARACTERISTIC
/begin CHARACTERISTIC DFC_DisblMsk.DFC_TAFSPerLo_C "DFC/Abschalt Maske für Prüfung DFC_TAFSPerLo" VALUE 0x8002634C Val_Wu16 65535.00 DFES_OneToOne 0.00 65535.00 /end CHARACTERISTIC
/begin CHARACTERISTIC DFC_DisblMsk.DFC_TCACDsSRCMax_C "DFC/Abschalt Maske für Prüfung DFC_TCACDsSRCMax" VALUE 0x8002634E Val_Wu16 65535.00 DFES_OneToOne 0.00 65535.00 /end CHARACTERISTIC
/begin CHARACTERISTIC DFC_DisblMsk.DFC_TCACDsSRCMin_C "DFC/Abschalt Maske für Prüfung DFC_TCACDsSRCMin" VALUE 0x80026350 Val_Wu16 65535.00 DFES_OneToOne 0.00 65535.00 /end CHARACTERISTIC
/begin CHARACTERISTIC DFC_DisblMsk.DFC_ThrVlvSRCMax_C "DFC/Abschalt Maske für Prüfung DFC_ThrVlvSRCMax" VALUE 0x80026352 Val_Wu16 65535.00 DFES_OneToOne 0.00 65535.00 /end CHARACTERISTIC
/begin CHARACTERISTIC DFC_DisblMsk.DFC_ThrVlvSRCMin_C "DFC/Abschalt Maske für Prüfung DFC_ThrVlvSRCMin" VALUE 0x80026354 Val_Wu16 65535.00 DFES_OneToOne 0.00 65535.00 /end CHARACTERISTIC
/begin CHARACTERISTIC DFC_DisblMsk.DFC_TrbChLPOL_C "DFC/Abschalt Maske für Prüfung DFC_TrbChLPOL" VALUE 0x80026356 Val_Wu16 65535.00 DFES_OneToOne 0.00 65535.00 /end CHARACTERISTIC
/begin CHARACTERISTIC DFC_DisblMsk.DFC_TrbChLPSCB_C "DFC/Abschalt Maske für Prüfung DFC_TrbChLPSCB" VALUE 0x80026358 Val_Wu16 65535.00 DFES_OneToOne 0.00 65535.00 /end CHARACTERISTIC
/begin CHARACTERISTIC DFC_DisblMsk.DFC_TrbChLPSCG_C "DFC/Abschalt Maske für Prüfung DFC_TrbChLPSCG" VALUE 0x8002635A Val_Wu16 65535.00 DFES_OneToOne 0.00 65535.00 /end CHARACTERISTIC
/begin CHARACTERISTIC DFC_DisblMsk.DFC_UHtrPLOL_C "DFC/Abschalt Maske für Prüfung DFC_UHtrPLOL" VALUE 0x8002635C Val_Wu16 65535.00 DFES_OneToOne 0.00 65535.00 /end CHARACTERISTIC
/begin CHARACTERISTIC DFC_DisblMsk.DFC_UHtrPLSCB_C "DFC/Abschalt Maske für Prüfung DFC_UHtrPLSCB" VALUE 0x8002635E Val_Wu16 65535.00 DFES_OneToOne 0.00 65535.00 /end CHARACTERISTIC
/begin CHARACTERISTIC DFC_DisblMsk.DFC_UHtrPLSCG_C "DFC/Abschalt Maske für Prüfung DFC_UHtrPLSCG" VALUE 0x80026360 Val_Wu16 65535.00 DFES_OneToOne 0.00 65535.00 /end CHARACTERISTIC
/begin CHARACTERISTIC DFC_DisblMsk.DFC_UHtrPLSRCMaxDia_C "DFC/Abschalt Maske für Prüfung DFC_UHtrPLSRCMaxDia" VALUE 0x80026362 Val_Wu16 65535.00 DFES_OneToOne 0.00 65535.00 /end CHARACTERISTIC
/begin CHARACTERISTIC DFC_DisblMsk.DFC_UHtrPLSRCMinDia_C "DFC/Abschalt Maske für Prüfung DFC_UHtrPLSRCMinDia" VALUE 0x80026364 Val_Wu16 65535.00 DFES_OneToOne 0.00 65535.00 /end CHARACTERISTIC
/begin CHARACTERISTIC DFC_DisblMsk.DFC_UHtrTnkOL_C "DFC/Abschalt Maske für Prüfung DFC_UHtrTnkOL" VALUE 0x80026366 Val_Wu16 65535.00 DFES_OneToOne 0.00 65535.00 /end CHARACTERISTIC
/begin CHARACTERISTIC DFC_DisblMsk.DFC_UHtrTnkSCB_C "DFC/Abschalt Maske für Prüfung DFC_UHtrTnkSCB" VALUE 0x80026368 Val_Wu16 65535.00 DFES_OneToOne 0.00 65535.00 /end CHARACTERISTIC
/begin CHARACTERISTIC DFC_DisblMsk.DFC_UHtrTnkSCG_C "DFC/Abschalt Maske für Prüfung DFC_UHtrTnkSCG" VALUE 0x8002636A Val_Wu16 65535.00 DFES_OneToOne 0.00 65535.00 /end CHARACTERISTIC
/begin CHARACTERISTIC DFC_DisblMsk.DFC_UHtrTnkSRCMaxDia_C "DFC/Abschalt Maske für Prüfung DFC_UHtrTnkSRCMaxDia" VALUE 0x8002636C Val_Wu16 65535.00 DFES_OneToOne 0.00 65535.00 /end CHARACTERISTIC
/begin CHARACTERISTIC DFC_DisblMsk.DFC_UHtrTnkSRCMinDia_C "DFC/Abschalt Maske für Prüfung DFC_UHtrTnkSRCMinDia" VALUE 0x8002636E Val_Wu16 65535.00 DFES_OneToOne 0.00 65535.00 /end CHARACTERISTIC
/begin CHARACTERISTIC DFC_DisblMsk.DFC_URevVlvOL_C "DFC/Abschalt Maske für Prüfung DFC_URevVlvOL" VALUE 0x80026370 Val_Wu16 65535.00 DFES_OneToOne 0.00 65535.00 /end CHARACTERISTIC
/begin CHARACTERISTIC DFC_DisblMsk.DFC_URevVlvSCB_C "DFC/Abschalt Maske für Prüfung DFC_URevVlvSCB" VALUE 0x80026372 Val_Wu16 65535.00 DFES_OneToOne 0.00 65535.00 /end CHARACTERISTIC
/begin CHARACTERISTIC DFC_DisblMsk.DFC_URevVlvSCG_C "DFC/Abschalt Maske für Prüfung DFC_URevVlvSCG" VALUE 0x80026374 Val_Wu16 65535.00 DFES_OneToOne 0.00 65535.00 /end CHARACTERISTIC
/begin CHARACTERISTIC DFC_DisblMsk.DFC_UTnkTSRCMax_C "DFC/Abschalt Maske für Prüfung DFC_UTnkTSRCMax" VALUE 0x80026376 Val_Wu16 65535.00 DFES_OneToOne 0.00 65535.00 /end CHARACTERISTIC
/begin CHARACTERISTIC DFC_DisblMsk.DFC_UTnkTSRCMin_C "DFC/Abschalt Maske für Prüfung DFC_UTnkTSRCMin" VALUE 0x80026378 Val_Wu16 65535.00 DFES_OneToOne 0.00 65535.00 /end CHARACTERISTIC
/begin CHARACTERISTIC DFC_DisblMsk.DFC_UTnkTSig_C "DFC/Abschalt Maske für Prüfung DFC_UTnkTSig" VALUE 0x8002637A Val_Wu16 65535.00 DFES_OneToOne 0.00 65535.00 /end CHARACTERISTIC
/begin CHARACTERISTIC DFC_DisblMsk.DFC_VSwVlvGovDvtMax_C "DFC/Abschalt Maske für Prüfung DFC_VSwVlvGovDvtMax" VALUE 0x8002637C Val_Wu16 65535.00 DFES_OneToOne 0.00 65535.00 /end CHARACTERISTIC
/begin CHARACTERISTIC DFC_DisblMsk.DFC_VSwVlvGovDvtMin_C "DFC/Abschalt Maske für Prüfung DFC_VSwVlvGovDvtMin" VALUE 0x8002637E Val_Wu16 65535.00 DFES_OneToOne 0.00 65535.00 /end CHARACTERISTIC
/begin CHARACTERISTIC DFC_DisblMsk.DFC_VSwVlvHBrgOpnLd_C "DFC/Abschalt Maske für Prüfung DFC_VSwVlvHBrgOpnLd" VALUE 0x80026380 Val_Wu16 65535.00 DFES_OneToOne 0.00 65535.00 /end CHARACTERISTIC
/begin CHARACTERISTIC DFC_DisblMsk.DFC_VSwVlvHBrgOvrCurr_C "DFC/Abschalt Maske für Prüfung DFC_VSwVlvHBrgOvrCurr" VALUE 0x80026382 Val_Wu16 65535.00 DFES_OneToOne 0.00 65535.00 /end CHARACTERISTIC
/begin CHARACTERISTIC DFC_DisblMsk.DFC_VSwVlvHBrgOvrTemp_C "DFC/Abschalt Maske für Prüfung DFC_VSwVlvHBrgOvrTemp" VALUE 0x80026384 Val_Wu16 65535.00 DFES_OneToOne 0.00 65535.00 /end CHARACTERISTIC
/begin CHARACTERISTIC DFC_DisblMsk.DFC_VSwVlvHBrgShCirBatt1_C "DFC/Abschalt Maske für Prüfung DFC_VSwVlvHBrgShCirBatt1" VALUE 0x80026386 Val_Wu16 65535.00 DFES_OneToOne 0.00 65535.00 /end CHARACTERISTIC
/begin CHARACTERISTIC DFC_DisblMsk.DFC_VSwVlvHBrgShCirBatt2_C "DFC/Abschalt Maske für Prüfung DFC_VSwVlvHBrgShCirBatt2" VALUE 0x80026388 Val_Wu16 65535.00 DFES_OneToOne 0.00 65535.00 /end CHARACTERISTIC
/begin CHARACTERISTIC DFC_DisblMsk.DFC_VSwVlvHBrgShCirGnd1_C "DFC/Abschalt Maske für Prüfung DFC_VSwVlvHBrgShCirGnd1" VALUE 0x8002638A Val_Wu16 65535.00 DFES_OneToOne 0.00 65535.00 /end CHARACTERISTIC
/begin CHARACTERISTIC DFC_DisblMsk.DFC_VSwVlvHBrgShCirGnd2_C "DFC/Abschalt Maske für Prüfung DFC_VSwVlvHBrgShCirGnd2" VALUE 0x8002638C Val_Wu16 65535.00 DFES_OneToOne 0.00 65535.00 /end CHARACTERISTIC
/begin CHARACTERISTIC DFC_DisblMsk.DFC_VSwVlvHBrgShCirOvrLd_C "DFC/Abschalt Maske für Prüfung DFC_VSwVlvHBrgShCirOvrLd" VALUE 0x8002638E Val_Wu16 65535.00 DFES_OneToOne 0.00 65535.00 /end CHARACTERISTIC
/begin CHARACTERISTIC DFC_DisblMsk.DFC_VSwVlvHBrgTempOvrCurr_C "DFC/Abschalt Maske für Prüfung DFC_VSwVlvHBrgTempOvrCurr" VALUE 0x80026390 Val_Wu16 65535.00 DFES_OneToOne 0.00 65535.00 /end CHARACTERISTIC
/begin CHARACTERISTIC DFC_DisblMsk.DFC_VSwVlvHBrgUndrVltg_C "DFC/Abschalt Maske für Prüfung DFC_VSwVlvHBrgUndrVltg" VALUE 0x80026392 Val_Wu16 65535.00 DFES_OneToOne 0.00 65535.00 /end CHARACTERISTIC
/begin CHARACTERISTIC DFC_DisblMsk.DFC_VSwVlvOL_C "DFC/Abschalt Maske für Prüfung DFC_VSwVlvOL" VALUE 0x80026394 Val_Wu16 65535.00 DFES_OneToOne 0.00 65535.00 /end CHARACTERISTIC
/begin CHARACTERISTIC DFC_DisblMsk.DFC_VSwVlvSCB_C "DFC/Abschalt Maske für Prüfung DFC_VSwVlvSCB" VALUE 0x80026396 Val_Wu16 65535.00 DFES_OneToOne 0.00 65535.00 /end CHARACTERISTIC
/begin CHARACTERISTIC DFC_DisblMsk.DFC_VSwVlvSCG_C "DFC/Abschalt Maske für Prüfung DFC_VSwVlvSCG" VALUE 0x80026398 Val_Wu16 65535.00 DFES_OneToOne 0.00 65535.00 /end CHARACTERISTIC
/begin CHARACTERISTIC DFC_DisblMsk.DFC_VSwVlvSRCMax_C "DFC/Abschalt Maske für Prüfung DFC_VSwVlvSRCMax" VALUE 0x8002639A Val_Wu16 65535.00 DFES_OneToOne 0.00 65535.00 /end CHARACTERISTIC
/begin CHARACTERISTIC DFC_DisblMsk.DFC_VSwVlvSRCMin_C "DFC/Abschalt Maske für Prüfung DFC_VSwVlvSRCMin" VALUE 0x8002639C Val_Wu16 65535.00 DFES_OneToOne 0.00 65535.00 /end CHARACTERISTIC
/begin CHARACTERISTIC DFC_DisblMsk.DFC_ClthNpl_C "DFC/Abschalt Maske für Prüfung DFC_ClthNpl" VALUE 0x8002639E Val_Wu16 65535.00 DFES_OneToOne 0.00 65535.00 /end CHARACTERISTIC
/begin CHARACTERISTIC DFC_DisblMsk.DFC_ETClbETMax_0_C "DFC/Abschalt Maske für Prüfung DFC_ETClbETMax_0" VALUE 0x800263A0 Val_Wu16 65535.00 DFES_OneToOne 0.00 65535.00 /end CHARACTERISTIC
/begin CHARACTERISTIC DFC_DisblMsk.DFC_ETClbETMax_1_C "DFC/Abschalt Maske für Prüfung DFC_ETClbETMax_1" VALUE 0x800263A2 Val_Wu16 65535.00 DFES_OneToOne 0.00 65535.00 /end CHARACTERISTIC
/begin CHARACTERISTIC DFC_DisblMsk.DFC_ETClbETMax_2_C "DFC/Abschalt Maske für Prüfung DFC_ETClbETMax_2" VALUE 0x800263A4 Val_Wu16 65535.00 DFES_OneToOne 0.00 65535.00 /end CHARACTERISTIC
/begin CHARACTERISTIC DFC_DisblMsk.DFC_ETClbETMax_3_C "DFC/Abschalt Maske für Prüfung DFC_ETClbETMax_3" VALUE 0x800263A6 Val_Wu16 65535.00 DFES_OneToOne 0.00 65535.00 /end CHARACTERISTIC
/begin CHARACTERISTIC DFC_DisblMsk.DFC_ETClbETMax_4_C "DFC/Abschalt Maske für Prüfung DFC_ETClbETMax_4" VALUE 0x800263A8 Val_Wu16 65535.00 DFES_OneToOne 0.00 65535.00 /end CHARACTERISTIC
/begin CHARACTERISTIC DFC_DisblMsk.DFC_ETClbETMax_5_C "DFC/Abschalt Maske für Prüfung DFC_ETClbETMax_5" VALUE 0x800263AA Val_Wu16 65535.00 DFES_OneToOne 0.00 65535.00 /end CHARACTERISTIC
/begin CHARACTERISTIC DFC_DisblMsk.DFC_ETClbETMin_0_C "DFC/Abschalt Maske für Prüfung DFC_ETClbETMin_0" VALUE 0x800263AC Val_Wu16 65535.00 DFES_OneToOne 0.00 65535.00 /end CHARACTERISTIC
/begin CHARACTERISTIC DFC_DisblMsk.DFC_ETClbETMin_1_C "DFC/Abschalt Maske für Prüfung DFC_ETClbETMin_1" VALUE 0x800263AE Val_Wu16 65535.00 DFES_OneToOne 0.00 65535.00 /end CHARACTERISTIC
/begin CHARACTERISTIC DFC_DisblMsk.DFC_ETClbETMin_2_C "DFC/Abschalt Maske für Prüfung DFC_ETClbETMin_2" VALUE 0x800263B0 Val_Wu16 65535.00 DFES_OneToOne 0.00 65535.00 /end CHARACTERISTIC
/begin CHARACTERISTIC DFC_DisblMsk.DFC_ETClbETMin_3_C "DFC/Abschalt Maske für Prüfung DFC_ETClbETMin_3" VALUE 0x800263B2 Val_Wu16 65535.00 DFES_OneToOne 0.00 65535.00 /end CHARACTERISTIC
/begin CHARACTERISTIC DFC_DisblMsk.DFC_ETClbETMin_4_C "DFC/Abschalt Maske für Prüfung DFC_ETClbETMin_4" VALUE 0x800263B4 Val_Wu16 65535.00 DFES_OneToOne 0.00 65535.00 /end CHARACTERISTIC
/begin CHARACTERISTIC DFC_DisblMsk.DFC_ETClbETMin_5_C "DFC/Abschalt Maske für Prüfung DFC_ETClbETMin_5" VALUE 0x800263B6 Val_Wu16 65535.00 DFES_OneToOne 0.00 65535.00 /end CHARACTERISTIC
/begin CHARACTERISTIC DFC_DisblMsk.DFC_IVActrEnrgMax_0_C "DFC/Abschalt Maske für Prüfung DFC_IVActrEnrgMax_0" VALUE 0x800263B8 Val_Wu16 65535.00 DFES_OneToOne 0.00 65535.00 /end CHARACTERISTIC
/begin CHARACTERISTIC DFC_DisblMsk.DFC_IVActrEnrgMax_1_C "DFC/Abschalt Maske für Prüfung DFC_IVActrEnrgMax_1" VALUE 0x800263BA Val_Wu16 65535.00 DFES_OneToOne 0.00 65535.00 /end CHARACTERISTIC
/begin CHARACTERISTIC DFC_DisblMsk.DFC_IVActrEnrgMax_2_C "DFC/Abschalt Maske für Prüfung DFC_IVActrEnrgMax_2" VALUE 0x800263BC Val_Wu16 65535.00 DFES_OneToOne 0.00 65535.00 /end CHARACTERISTIC
/begin CHARACTERISTIC DFC_DisblMsk.DFC_IVActrEnrgMax_3_C "DFC/Abschalt Maske für Prüfung DFC_IVActrEnrgMax_3" VALUE 0x800263BE Val_Wu16 65535.00 DFES_OneToOne 0.00 65535.00 /end CHARACTERISTIC
/begin CHARACTERISTIC DFC_DisblMsk.DFC_IVActrEnrgMax_4_C "DFC/Abschalt Maske für Prüfung DFC_IVActrEnrgMax_4" VALUE 0x800263C0 Val_Wu16 65535.00 DFES_OneToOne 0.00 65535.00 /end CHARACTERISTIC
/begin CHARACTERISTIC DFC_DisblMsk.DFC_IVActrEnrgMax_5_C "DFC/Abschalt Maske für Prüfung DFC_IVActrEnrgMax_5" VALUE 0x800263C2 Val_Wu16 65535.00 DFES_OneToOne 0.00 65535.00 /end CHARACTERISTIC
/begin CHARACTERISTIC DFC_DisblMsk.DFC_IVActrEnrgMax_6_C "DFC/Abschalt Maske für Prüfung DFC_IVActrEnrgMax_6" VALUE 0x800263C4 Val_Wu16 65535.00 DFES_OneToOne 0.00 65535.00 /end CHARACTERISTIC
/begin CHARACTERISTIC DFC_DisblMsk.DFC_IVActrEnrgMax_7_C "DFC/Abschalt Maske für Prüfung DFC_IVActrEnrgMax_7" VALUE 0x800263C6 Val_Wu16 65535.00 DFES_OneToOne 0.00 65535.00 /end CHARACTERISTIC
/begin CHARACTERISTIC DFC_DisblMsk.DFC_IVActrEnrgMin_0_C "DFC/Abschalt Maske für Prüfung DFC_IVActrEnrgMin_0" VALUE 0x800263C8 Val_Wu16 65535.00 DFES_OneToOne 0.00 65535.00 /end CHARACTERISTIC
/begin CHARACTERISTIC DFC_DisblMsk.DFC_IVActrEnrgMin_1_C "DFC/Abschalt Maske für Prüfung DFC_IVActrEnrgMin_1" VALUE 0x800263CA Val_Wu16 65535.00 DFES_OneToOne 0.00 65535.00 /end CHARACTERISTIC
/begin CHARACTERISTIC DFC_DisblMsk.DFC_IVActrEnrgMin_2_C "DFC/Abschalt Maske für Prüfung DFC_IVActrEnrgMin_2" VALUE 0x800263CC Val_Wu16 65535.00 DFES_OneToOne 0.00 65535.00 /end CHARACTERISTIC
/begin CHARACTERISTIC DFC_DisblMsk.DFC_IVActrEnrgMin_3_C "DFC/Abschalt Maske für Prüfung DFC_IVActrEnrgMin_3" VALUE 0x800263CE Val_Wu16 65535.00 DFES_OneToOne 0.00 65535.00 /end CHARACTERISTIC
/begin CHARACTERISTIC DFC_DisblMsk.DFC_IVActrEnrgMin_4_C "DFC/Abschalt Maske für Prüfung DFC_IVActrEnrgMin_4" VALUE 0x800263D0 Val_Wu16 65535.00 DFES_OneToOne 0.00 65535.00 /end CHARACTERISTIC
/begin CHARACTERISTIC DFC_DisblMsk.DFC_IVActrEnrgMin_5_C "DFC/Abschalt Maske für Prüfung DFC_IVActrEnrgMin_5" VALUE 0x800263D2 Val_Wu16 65535.00 DFES_OneToOne 0.00 65535.00 /end CHARACTERISTIC
/begin CHARACTERISTIC DFC_DisblMsk.DFC_IVActrEnrgMin_6_C "DFC/Abschalt Maske für Prüfung DFC_IVActrEnrgMin_6" VALUE 0x800263D4 Val_Wu16 65535.00 DFES_OneToOne 0.00 65535.00 /end CHARACTERISTIC
/begin CHARACTERISTIC DFC_DisblMsk.DFC_IVActrEnrgMin_7_C "DFC/Abschalt Maske für Prüfung DFC_IVActrEnrgMin_7" VALUE 0x800263D6 Val_Wu16 65535.00 DFES_OneToOne 0.00 65535.00 /end CHARACTERISTIC
/begin CHARACTERISTIC DFC_DisblMsk.DFC_IVActrEnrgPlaus_0_C "DFC/Abschalt Maske für Prüfung DFC_IVActrEnrgPlaus_0" VALUE 0x800263D8 Val_Wu16 65535.00 DFES_OneToOne 0.00 65535.00 /end CHARACTERISTIC
/begin CHARACTERISTIC DFC_DisblMsk.DFC_IVActrEnrgPlaus_1_C "DFC/Abschalt Maske für Prüfung DFC_IVActrEnrgPlaus_1" VALUE 0x800263DA Val_Wu16 65535.00 DFES_OneToOne 0.00 65535.00 /end CHARACTERISTIC
/begin CHARACTERISTIC DFC_DisblMsk.DFC_IVActrEnrgPlaus_2_C "DFC/Abschalt Maske für Prüfung DFC_IVActrEnrgPlaus_2" VALUE 0x800263DC Val_Wu16 65535.00 DFES_OneToOne 0.00 65535.00 /end CHARACTERISTIC
/begin CHARACTERISTIC DFC_DisblMsk.DFC_IVActrEnrgPlaus_3_C "DFC/Abschalt Maske für Prüfung DFC_IVActrEnrgPlaus_3" VALUE 0x800263DE Val_Wu16 65535.00 DFES_OneToOne 0.00 65535.00 /end CHARACTERISTIC
/begin CHARACTERISTIC DFC_DisblMsk.DFC_IVActrEnrgPlaus_4_C "DFC/Abschalt Maske für Prüfung DFC_IVActrEnrgPlaus_4" VALUE 0x800263E0 Val_Wu16 65535.00 DFES_OneToOne 0.00 65535.00 /end CHARACTERISTIC
/begin CHARACTERISTIC DFC_DisblMsk.DFC_IVActrEnrgPlaus_5_C "DFC/Abschalt Maske für Prüfung DFC_IVActrEnrgPlaus_5" VALUE 0x800263E2 Val_Wu16 65535.00 DFES_OneToOne 0.00 65535.00 /end CHARACTERISTIC
/begin CHARACTERISTIC DFC_DisblMsk.DFC_IVActrEnrgPlaus_6_C "DFC/Abschalt Maske für Prüfung DFC_IVActrEnrgPlaus_6" VALUE 0x800263E4 Val_Wu16 65535.00 DFES_OneToOne 0.00 65535.00 /end CHARACTERISTIC
/begin CHARACTERISTIC DFC_DisblMsk.DFC_IVActrEnrgPlaus_7_C "DFC/Abschalt Maske für Prüfung DFC_IVActrEnrgPlaus_7" VALUE 0x800263E6 Val_Wu16 65535.00 DFES_OneToOne 0.00 65535.00 /end CHARACTERISTIC
/begin CHARACTERISTIC DFC_DisblMsk.DFC_IVCtlTiDiff_0_C "DFC/Abschalt Maske für Prüfung DFC_IVCtlTiDiff_0" VALUE 0x800263E8 Val_Wu16 65535.00 DFES_OneToOne 0.00 65535.00 /end CHARACTERISTIC
/begin CHARACTERISTIC DFC_DisblMsk.DFC_IVCtlTiDiff_1_C "DFC/Abschalt Maske für Prüfung DFC_IVCtlTiDiff_1" VALUE 0x800263EA Val_Wu16 65535.00 DFES_OneToOne 0.00 65535.00 /end CHARACTERISTIC
/begin CHARACTERISTIC DFC_DisblMsk.DFC_IVCtlTiDiff_2_C "DFC/Abschalt Maske für Prüfung DFC_IVCtlTiDiff_2" VALUE 0x800263EC Val_Wu16 65535.00 DFES_OneToOne 0.00 65535.00 /end CHARACTERISTIC
/begin CHARACTERISTIC DFC_DisblMsk.DFC_IVCtlTiDiff_3_C "DFC/Abschalt Maske für Prüfung DFC_IVCtlTiDiff_3" VALUE 0x800263EE Val_Wu16 65535.00 DFES_OneToOne 0.00 65535.00 /end CHARACTERISTIC
/begin CHARACTERISTIC DFC_DisblMsk.DFC_IVCtlTiDiff_4_C "DFC/Abschalt Maske für Prüfung DFC_IVCtlTiDiff_4" VALUE 0x800263F0 Val_Wu16 65535.00 DFES_OneToOne 0.00 65535.00 /end CHARACTERISTIC
/begin CHARACTERISTIC DFC_DisblMsk.DFC_IVCtlTiDiff_5_C "DFC/Abschalt Maske für Prüfung DFC_IVCtlTiDiff_5" VALUE 0x800263F2 Val_Wu16 65535.00 DFES_OneToOne 0.00 65535.00 /end CHARACTERISTIC
/begin CHARACTERISTIC DFC_DisblMsk.DFC_IVCtlUDiffUp_0_C "DFC/Abschalt Maske für Prüfung DFC_IVCtlUDiffUp_0" VALUE 0x800263F4 Val_Wu16 65535.00 DFES_OneToOne 0.00 65535.00 /end CHARACTERISTIC
/begin CHARACTERISTIC DFC_DisblMsk.DFC_IVCtlUDiffUp_1_C "DFC/Abschalt Maske für Prüfung DFC_IVCtlUDiffUp_1" VALUE 0x800263F6 Val_Wu16 65535.00 DFES_OneToOne 0.00 65535.00 /end CHARACTERISTIC
/begin CHARACTERISTIC DFC_DisblMsk.DFC_IVCtlUDiffUp_2_C "DFC/Abschalt Maske für Prüfung DFC_IVCtlUDiffUp_2" VALUE 0x800263F8 Val_Wu16 65535.00 DFES_OneToOne 0.00 65535.00 /end CHARACTERISTIC
/begin CHARACTERISTIC DFC_DisblMsk.DFC_IVCtlUDiffUp_3_C "DFC/Abschalt Maske für Prüfung DFC_IVCtlUDiffUp_3" VALUE 0x800263FA Val_Wu16 65535.00 DFES_OneToOne 0.00 65535.00 /end CHARACTERISTIC
/begin CHARACTERISTIC DFC_DisblMsk.DFC_IVCtlUDiffUp_4_C "DFC/Abschalt Maske für Prüfung DFC_IVCtlUDiffUp_4" VALUE 0x800263FC Val_Wu16 65535.00 DFES_OneToOne 0.00 65535.00 /end CHARACTERISTIC
/begin CHARACTERISTIC DFC_DisblMsk.DFC_IVCtlUDiffUp_5_C "DFC/Abschalt Maske für Prüfung DFC_IVCtlUDiffUp_5" VALUE 0x800263FE Val_Wu16 65535.00 DFES_OneToOne 0.00 65535.00 /end CHARACTERISTIC
/begin CHARACTERISTIC DFC_DisblMsk.DFC_IVCtlUUp_0_C "DFC/Abschalt Maske für Prüfung DFC_IVCtlUUp_0" VALUE 0x80026400 Val_Wu16 65535.00 DFES_OneToOne 0.00 65535.00 /end CHARACTERISTIC
/begin CHARACTERISTIC DFC_DisblMsk.DFC_IVCtlUUp_1_C "DFC/Abschalt Maske für Prüfung DFC_IVCtlUUp_1" VALUE 0x80026402 Val_Wu16 65535.00 DFES_OneToOne 0.00 65535.00 /end CHARACTERISTIC
/begin CHARACTERISTIC DFC_DisblMsk.DFC_IVCtlUUp_2_C "DFC/Abschalt Maske für Prüfung DFC_IVCtlUUp_2" VALUE 0x80026404 Val_Wu16 65535.00 DFES_OneToOne 0.00 65535.00 /end CHARACTERISTIC
/begin CHARACTERISTIC DFC_DisblMsk.DFC_IVCtlUUp_3_C "DFC/Abschalt Maske für Prüfung DFC_IVCtlUUp_3" VALUE 0x80026406 Val_Wu16 65535.00 DFES_OneToOne 0.00 65535.00 /end CHARACTERISTIC
/begin CHARACTERISTIC DFC_DisblMsk.DFC_IVCtlUUp_4_C "DFC/Abschalt Maske für Prüfung DFC_IVCtlUUp_4" VALUE 0x80026408 Val_Wu16 65535.00 DFES_OneToOne 0.00 65535.00 /end CHARACTERISTIC
/begin CHARACTERISTIC DFC_DisblMsk.DFC_IVCtlUUp_5_C "DFC/Abschalt Maske für Prüfung DFC_IVCtlUUp_5" VALUE 0x8002640A Val_Wu16 65535.00 DFES_OneToOne 0.00 65535.00 /end CHARACTERISTIC
/begin CHARACTERISTIC DFC_DisblMsk.DFC_IVDiaBnkShCir_0_C "DFC/Abschalt Maske für Prüfung DFC_IVDiaBnkShCir_0" VALUE 0x8002640C Val_Wu16 65535.00 DFES_OneToOne 0.00 65535.00 /end CHARACTERISTIC
/begin CHARACTERISTIC DFC_DisblMsk.DFC_IVDiaBnkShCir_1_C "DFC/Abschalt Maske für Prüfung DFC_IVDiaBnkShCir_1" VALUE 0x8002640E Val_Wu16 65535.00 DFES_OneToOne 0.00 65535.00 /end CHARACTERISTIC
/begin CHARACTERISTIC DFC_DisblMsk.DFC_IVDiaBnkShCirChSwt_0_C "DFC/Abschalt Maske für Prüfung DFC_IVDiaBnkShCirChSwt_0" VALUE 0x80026410 Val_Wu16 65535.00 DFES_OneToOne 0.00 65535.00 /end CHARACTERISTIC
/begin CHARACTERISTIC DFC_DisblMsk.DFC_IVDiaBnkShCirChSwt_1_C "DFC/Abschalt Maske für Prüfung DFC_IVDiaBnkShCirChSwt_1" VALUE 0x80026412 Val_Wu16 65535.00 DFES_OneToOne 0.00 65535.00 /end CHARACTERISTIC
/begin CHARACTERISTIC DFC_DisblMsk.DFC_IVDiaChp_0_C "DFC/Abschalt Maske für Prüfung DFC_IVDiaChp_0" VALUE 0x80026414 Val_Wu16 65535.00 DFES_OneToOne 0.00 65535.00 /end CHARACTERISTIC
/begin CHARACTERISTIC DFC_DisblMsk.DFC_IVDiaChp_1_C "DFC/Abschalt Maske für Prüfung DFC_IVDiaChp_1" VALUE 0x80026416 Val_Wu16 65535.00 DFES_OneToOne 0.00 65535.00 /end CHARACTERISTIC
/begin CHARACTERISTIC DFC_DisblMsk.DFC_IVDiaCylNoCls_0_C "DFC/Abschalt Maske für Prüfung DFC_IVDiaCylNoCls_0" VALUE 0x80026418 Val_Wu16 65535.00 DFES_OneToOne 0.00 65535.00 /end CHARACTERISTIC
/begin CHARACTERISTIC DFC_DisblMsk.DFC_IVDiaCylNoCls_1_C "DFC/Abschalt Maske für Prüfung DFC_IVDiaCylNoCls_1" VALUE 0x8002641A Val_Wu16 65535.00 DFES_OneToOne 0.00 65535.00 /end CHARACTERISTIC
/begin CHARACTERISTIC DFC_DisblMsk.DFC_IVDiaCylNoCls_2_C "DFC/Abschalt Maske für Prüfung DFC_IVDiaCylNoCls_2" VALUE 0x8002641C Val_Wu16 65535.00 DFES_OneToOne 0.00 65535.00 /end CHARACTERISTIC
/begin CHARACTERISTIC DFC_DisblMsk.DFC_IVDiaCylNoCls_3_C "DFC/Abschalt Maske für Prüfung DFC_IVDiaCylNoCls_3" VALUE 0x8002641E Val_Wu16 65535.00 DFES_OneToOne 0.00 65535.00 /end CHARACTERISTIC
/begin CHARACTERISTIC DFC_DisblMsk.DFC_IVDiaCylNoCls_4_C "DFC/Abschalt Maske für Prüfung DFC_IVDiaCylNoCls_4" VALUE 0x80026420 Val_Wu16 65535.00 DFES_OneToOne 0.00 65535.00 /end CHARACTERISTIC
/begin CHARACTERISTIC DFC_DisblMsk.DFC_IVDiaCylNoCls_5_C "DFC/Abschalt Maske für Prüfung DFC_IVDiaCylNoCls_5" VALUE 0x80026422 Val_Wu16 65535.00 DFES_OneToOne 0.00 65535.00 /end CHARACTERISTIC
/begin CHARACTERISTIC DFC_DisblMsk.DFC_IVDiaCylNoLd_0_C "DFC/Abschalt Maske für Prüfung DFC_IVDiaCylNoLd_0" VALUE 0x80026424 Val_Wu16 65535.00 DFES_OneToOne 0.00 65535.00 /end CHARACTERISTIC
/begin CHARACTERISTIC DFC_DisblMsk.DFC_IVDiaCylNoLd_1_C "DFC/Abschalt Maske für Prüfung DFC_IVDiaCylNoLd_1" VALUE 0x80026426 Val_Wu16 65535.00 DFES_OneToOne 0.00 65535.00 /end CHARACTERISTIC
/begin CHARACTERISTIC DFC_DisblMsk.DFC_IVDiaCylNoLd_2_C "DFC/Abschalt Maske für Prüfung DFC_IVDiaCylNoLd_2" VALUE 0x80026428 Val_Wu16 65535.00 DFES_OneToOne 0.00 65535.00 /end CHARACTERISTIC
/begin CHARACTERISTIC DFC_DisblMsk.DFC_IVDiaCylNoLd_3_C "DFC/Abschalt Maske für Prüfung DFC_IVDiaCylNoLd_3" VALUE 0x8002642A Val_Wu16 65535.00 DFES_OneToOne 0.00 65535.00 /end CHARACTERISTIC
/begin CHARACTERISTIC DFC_DisblMsk.DFC_IVDiaCylNoLd_4_C "DFC/Abschalt Maske für Prüfung DFC_IVDiaCylNoLd_4" VALUE 0x8002642C Val_Wu16 65535.00 DFES_OneToOne 0.00 65535.00 /end CHARACTERISTIC
/begin CHARACTERISTIC DFC_DisblMsk.DFC_IVDiaCylNoLd_5_C "DFC/Abschalt Maske für Prüfung DFC_IVDiaCylNoLd_5" VALUE 0x8002642E Val_Wu16 65535.00 DFES_OneToOne 0.00 65535.00 /end CHARACTERISTIC
/begin CHARACTERISTIC DFC_DisblMsk.DFC_IVDiaCylShCir_0_C "DFC/Abschalt Maske für Prüfung DFC_IVDiaCylShCir_0" VALUE 0x80026430 Val_Wu16 65535.00 DFES_OneToOne 0.00 65535.00 /end CHARACTERISTIC
/begin CHARACTERISTIC DFC_DisblMsk.DFC_IVDiaCylShCir_1_C "DFC/Abschalt Maske für Prüfung DFC_IVDiaCylShCir_1" VALUE 0x80026432 Val_Wu16 65535.00 DFES_OneToOne 0.00 65535.00 /end CHARACTERISTIC
/begin CHARACTERISTIC DFC_DisblMsk.DFC_IVDiaCylShCir_2_C "DFC/Abschalt Maske für Prüfung DFC_IVDiaCylShCir_2" VALUE 0x80026434 Val_Wu16 65535.00 DFES_OneToOne 0.00 65535.00 /end CHARACTERISTIC
/begin CHARACTERISTIC DFC_DisblMsk.DFC_IVDiaCylShCir_3_C "DFC/Abschalt Maske für Prüfung DFC_IVDiaCylShCir_3" VALUE 0x80026436 Val_Wu16 65535.00 DFES_OneToOne 0.00 65535.00 /end CHARACTERISTIC
/begin CHARACTERISTIC DFC_DisblMsk.DFC_IVDiaCylShCir_4_C "DFC/Abschalt Maske für Prüfung DFC_IVDiaCylShCir_4" VALUE 0x80026438 Val_Wu16 65535.00 DFES_OneToOne 0.00 65535.00 /end CHARACTERISTIC
/begin CHARACTERISTIC DFC_DisblMsk.DFC_IVDiaCylShCir_5_C "DFC/Abschalt Maske für Prüfung DFC_IVDiaCylShCir_5" VALUE 0x8002643A Val_Wu16 65535.00 DFES_OneToOne 0.00 65535.00 /end CHARACTERISTIC
/begin CHARACTERISTIC DFC_DisblMsk.DFC_IVDiaCylShCirHSLS_0_C "DFC/Abschalt Maske für Prüfung DFC_IVDiaCylShCirHSLS_0" VALUE 0x8002643C Val_Wu16 65535.00 DFES_OneToOne 0.00 65535.00 /end CHARACTERISTIC
/begin CHARACTERISTIC DFC_DisblMsk.DFC_IVDiaCylShCirHSLS_1_C "DFC/Abschalt Maske für Prüfung DFC_IVDiaCylShCirHSLS_1" VALUE 0x8002643E Val_Wu16 65535.00 DFES_OneToOne 0.00 65535.00 /end CHARACTERISTIC
/begin CHARACTERISTIC DFC_DisblMsk.DFC_IVDiaCylShCirHSLS_2_C "DFC/Abschalt Maske für Prüfung DFC_IVDiaCylShCirHSLS_2" VALUE 0x80026440 Val_Wu16 65535.00 DFES_OneToOne 0.00 65535.00 /end CHARACTERISTIC
/begin CHARACTERISTIC DFC_DisblMsk.DFC_IVDiaCylShCirHSLS_3_C "DFC/Abschalt Maske für Prüfung DFC_IVDiaCylShCirHSLS_3" VALUE 0x80026442 Val_Wu16 65535.00 DFES_OneToOne 0.00 65535.00 /end CHARACTERISTIC
/begin CHARACTERISTIC DFC_DisblMsk.DFC_IVDiaCylShCirHSLS_4_C "DFC/Abschalt Maske für Prüfung DFC_IVDiaCylShCirHSLS_4" VALUE 0x80026444 Val_Wu16 65535.00 DFES_OneToOne 0.00 65535.00 /end CHARACTERISTIC
/begin CHARACTERISTIC DFC_DisblMsk.DFC_IVDiaCylShCirHSLS_5_C "DFC/Abschalt Maske für Prüfung DFC_IVDiaCylShCirHSLS_5" VALUE 0x80026446 Val_Wu16 65535.00 DFES_OneToOne 0.00 65535.00 /end CHARACTERISTIC
/begin CHARACTERISTIC DFC_DisblMsk.DFC_IVDiaCylShCirMeas_0_C "DFC/Abschalt Maske für Prüfung DFC_IVDiaCylShCirMeas_0" VALUE 0x80026448 Val_Wu16 65535.00 DFES_OneToOne 0.00 65535.00 /end CHARACTERISTIC
/begin CHARACTERISTIC DFC_DisblMsk.DFC_IVDiaCylShCirMeas_1_C "DFC/Abschalt Maske für Prüfung DFC_IVDiaCylShCirMeas_1" VALUE 0x8002644A Val_Wu16 65535.00 DFES_OneToOne 0.00 65535.00 /end CHARACTERISTIC
/begin CHARACTERISTIC DFC_DisblMsk.DFC_IVDiaCylShCirMeas_2_C "DFC/Abschalt Maske für Prüfung DFC_IVDiaCylShCirMeas_2" VALUE 0x8002644C Val_Wu16 65535.00 DFES_OneToOne 0.00 65535.00 /end CHARACTERISTIC
/begin CHARACTERISTIC DFC_DisblMsk.DFC_IVDiaCylShCirMeas_3_C "DFC/Abschalt Maske für Prüfung DFC_IVDiaCylShCirMeas_3" VALUE 0x8002644E Val_Wu16 65535.00 DFES_OneToOne 0.00 65535.00 /end CHARACTERISTIC
/begin CHARACTERISTIC DFC_DisblMsk.DFC_IVDiaCylShCirMeas_4_C "DFC/Abschalt Maske für Prüfung DFC_IVDiaCylShCirMeas_4" VALUE 0x80026450 Val_Wu16 65535.00 DFES_OneToOne 0.00 65535.00 /end CHARACTERISTIC
/begin CHARACTERISTIC DFC_DisblMsk.DFC_IVDiaCylShCirMeas_5_C "DFC/Abschalt Maske für Prüfung DFC_IVDiaCylShCirMeas_5" VALUE 0x80026452 Val_Wu16 65535.00 DFES_OneToOne 0.00 65535.00 /end CHARACTERISTIC
/begin CHARACTERISTIC DFC_DisblMsk.DFC_LSUDynChk_C "DFC/Abschalt Maske für Prüfung DFC_LSUDynChk" VALUE 0x80026454 Val_Wu16 65535.00 DFES_OneToOne 0.00 65535.00 /end CHARACTERISTIC
/begin CHARACTERISTIC DFC_DisblMsk.DFC_LSUO2ClbMax_C "DFC/Abschalt Maske für Prüfung DFC_LSUO2ClbMax" VALUE 0x80026456 Val_Wu16 65535.00 DFES_OneToOne 0.00 65535.00 /end CHARACTERISTIC
/begin CHARACTERISTIC DFC_DisblMsk.DFC_LSUO2ClbMin_C "DFC/Abschalt Maske für Prüfung DFC_LSUO2ClbMin" VALUE 0x80026458 Val_Wu16 65535.00 DFES_OneToOne 0.00 65535.00 /end CHARACTERISTIC
/begin CHARACTERISTIC DFC_DisblMsk.DFC_LSUO2PlausMaxFLd_C "DFC/Abschalt Maske für Prüfung DFC_LSUO2PlausMaxFLd" VALUE 0x8002645A Val_Wu16 65535.00 DFES_OneToOne 0.00 65535.00 /end CHARACTERISTIC
/begin CHARACTERISTIC DFC_DisblMsk.DFC_LSUO2PlausMaxOvrRun_C "DFC/Abschalt Maske für Prüfung DFC_LSUO2PlausMaxOvrRun" VALUE 0x8002645C Val_Wu16 65535.00 DFES_OneToOne 0.00 65535.00 /end CHARACTERISTIC
/begin CHARACTERISTIC DFC_DisblMsk.DFC_LSUO2PlausMaxPartLd_C "DFC/Abschalt Maske für Prüfung DFC_LSUO2PlausMaxPartLd" VALUE 0x8002645E Val_Wu16 65535.00 DFES_OneToOne 0.00 65535.00 /end CHARACTERISTIC
/begin CHARACTERISTIC DFC_DisblMsk.DFC_LSUO2PlausMinFLd_C "DFC/Abschalt Maske für Prüfung DFC_LSUO2PlausMinFLd" VALUE 0x80026460 Val_Wu16 65535.00 DFES_OneToOne 0.00 65535.00 /end CHARACTERISTIC
/begin CHARACTERISTIC DFC_DisblMsk.DFC_LSUO2PlausMinOvrRun_C "DFC/Abschalt Maske für Prüfung DFC_LSUO2PlausMinOvrRun" VALUE 0x80026462 Val_Wu16 65535.00 DFES_OneToOne 0.00 65535.00 /end CHARACTERISTIC
/begin CHARACTERISTIC DFC_DisblMsk.DFC_LSUO2PlausMinPartLd_C "DFC/Abschalt Maske für Prüfung DFC_LSUO2PlausMinPartLd" VALUE 0x80026464 Val_Wu16 65535.00 DFES_OneToOne 0.00 65535.00 /end CHARACTERISTIC
/begin CHARACTERISTIC DFC_DisblMsk.DFC_LSURiClbMax_C "DFC/Abschalt Maske für Prüfung DFC_LSURiClbMax" VALUE 0x80026466 Val_Wu16 65535.00 DFES_OneToOne 0.00 65535.00 /end CHARACTERISTIC
/begin CHARACTERISTIC DFC_DisblMsk.DFC_LSURiClbMin_C "DFC/Abschalt Maske für Prüfung DFC_LSURiClbMin" VALUE 0x80026468 Val_Wu16 65535.00 DFES_OneToOne 0.00 65535.00 /end CHARACTERISTIC
/begin CHARACTERISTIC DFC_DisblMsk.DFC_LSUWireIPSig_C "DFC/Abschalt Maske für Prüfung DFC_LSUWireIPSig" VALUE 0x8002646A Val_Wu16 65535.00 DFES_OneToOne 0.00 65535.00 /end CHARACTERISTIC
/begin CHARACTERISTIC DFC_DisblMsk.DFC_Layer_BSDMax_C "DFC/Abschalt Maske für Prüfung DFC_Layer_BSDMax" VALUE 0x8002646C Val_Wu16 65535.00 DFES_OneToOne 0.00 65535.00 /end CHARACTERISTIC
/begin CHARACTERISTIC DFC_DisblMsk.DFC_Layer_BSDMin_C "DFC/Abschalt Maske für Prüfung DFC_Layer_BSDMin" VALUE 0x8002646E Val_Wu16 65535.00 DFES_OneToOne 0.00 65535.00 /end CHARACTERISTIC
/begin CHARACTERISTIC DFC_DisblMsk.DFC_Layer_BSDNpl_C "DFC/Abschalt Maske für Prüfung DFC_Layer_BSDNpl" VALUE 0x80026470 Val_Wu16 65535.00 DFES_OneToOne 0.00 65535.00 /end CHARACTERISTIC
/begin CHARACTERISTIC DFC_DisblMsk.DFC_Layer_BSDSig_C "DFC/Abschalt Maske für Prüfung DFC_Layer_BSDSig" VALUE 0x80026472 Val_Wu16 65535.00 DFES_OneToOne 0.00 65535.00 /end CHARACTERISTIC
/begin CHARACTERISTIC DFC_DisblMsk.DFC_Layer_FltMngTstMax_C "DFC/Abschalt Maske für Prüfung DFC_Layer_FltMngTstMax" VALUE 0x80026474 Val_Wu16 65535.00 DFES_OneToOne 0.00 65535.00 /end CHARACTERISTIC
/begin CHARACTERISTIC DFC_DisblMsk.DFC_Layer_FltMngTstMin_C "DFC/Abschalt Maske für Prüfung DFC_Layer_FltMngTstMin" VALUE 0x80026476 Val_Wu16 65535.00 DFES_OneToOne 0.00 65535.00 /end CHARACTERISTIC
/begin CHARACTERISTIC DFC_DisblMsk.DFC_Layer_FltMngTstNpl_C "DFC/Abschalt Maske für Prüfung DFC_Layer_FltMngTstNpl" VALUE 0x80026478 Val_Wu16 65535.00 DFES_OneToOne 0.00 65535.00 /end CHARACTERISTIC
/begin CHARACTERISTIC DFC_DisblMsk.DFC_Layer_FltMngTstSig_C "DFC/Abschalt Maske für Prüfung DFC_Layer_FltMngTstSig" VALUE 0x8002647A Val_Wu16 65535.00 DFES_OneToOne 0.00 65535.00 /end CHARACTERISTIC
/begin CHARACTERISTIC DFC_DisblMsk.DFC_Layer_GENELBMax_C "DFC/Abschalt Maske für Prüfung DFC_Layer_GENELBMax" VALUE 0x8002647C Val_Wu16 65535.00 DFES_OneToOne 0.00 65535.00 /end CHARACTERISTIC
/begin CHARACTERISTIC DFC_DisblMsk.DFC_Layer_GENELBMin_C "DFC/Abschalt Maske für Prüfung DFC_Layer_GENELBMin" VALUE 0x8002647E Val_Wu16 65535.00 DFES_OneToOne 0.00 65535.00 /end CHARACTERISTIC
/begin CHARACTERISTIC DFC_DisblMsk.DFC_Layer_GENELBNpl_C "DFC/Abschalt Maske für Prüfung DFC_Layer_GENELBNpl" VALUE 0x80026480 Val_Wu16 65535.00 DFES_OneToOne 0.00 65535.00 /end CHARACTERISTIC
/begin CHARACTERISTIC DFC_DisblMsk.DFC_Layer_GENELBSig_C "DFC/Abschalt Maske für Prüfung DFC_Layer_GENELBSig" VALUE 0x80026482 Val_Wu16 65535.00 DFES_OneToOne 0.00 65535.00 /end CHARACTERISTIC
/begin CHARACTERISTIC DFC_DisblMsk.DFC_Layer_GENELMax_C "DFC/Abschalt Maske für Prüfung DFC_Layer_GENELMax" VALUE 0x80026484 Val_Wu16 65535.00 DFES_OneToOne 0.00 65535.00 /end CHARACTERISTIC
/begin CHARACTERISTIC DFC_DisblMsk.DFC_Layer_GENELMin_C "DFC/Abschalt Maske für Prüfung DFC_Layer_GENELMin" VALUE 0x80026486 Val_Wu16 65535.00 DFES_OneToOne 0.00 65535.00 /end CHARACTERISTIC
/begin CHARACTERISTIC DFC_DisblMsk.DFC_Layer_GENELNpl_C "DFC/Abschalt Maske für Prüfung DFC_Layer_GENELNpl" VALUE 0x80026488 Val_Wu16 65535.00 DFES_OneToOne 0.00 65535.00 /end CHARACTERISTIC
/begin CHARACTERISTIC DFC_DisblMsk.DFC_Layer_GENELSig_C "DFC/Abschalt Maske für Prüfung DFC_Layer_GENELSig" VALUE 0x8002648A Val_Wu16 65535.00 DFES_OneToOne 0.00 65535.00 /end CHARACTERISTIC
/begin CHARACTERISTIC DFC_DisblMsk.DFC_Layer_GENHTBMax_C "DFC/Abschalt Maske für Prüfung DFC_Layer_GENHTBMax" VALUE 0x8002648C Val_Wu16 65535.00 DFES_OneToOne 0.00 65535.00 /end CHARACTERISTIC
/begin CHARACTERISTIC DFC_DisblMsk.DFC_Layer_GENHTBMin_C "DFC/Abschalt Maske für Prüfung DFC_Layer_GENHTBMin" VALUE 0x8002648E Val_Wu16 65535.00 DFES_OneToOne 0.00 65535.00 /end CHARACTERISTIC
/begin CHARACTERISTIC DFC_DisblMsk.DFC_Layer_GENHTBNpl_C "DFC/Abschalt Maske für Prüfung DFC_Layer_GENHTBNpl" VALUE 0x80026490 Val_Wu16 65535.00 DFES_OneToOne 0.00 65535.00 /end CHARACTERISTIC
/begin CHARACTERISTIC DFC_DisblMsk.DFC_Layer_GENHTBSig_C "DFC/Abschalt Maske für Prüfung DFC_Layer_GENHTBSig" VALUE 0x80026492 Val_Wu16 65535.00 DFES_OneToOne 0.00 65535.00 /end CHARACTERISTIC
/begin CHARACTERISTIC DFC_DisblMsk.DFC_Layer_GENHTMax_C "DFC/Abschalt Maske für Prüfung DFC_Layer_GENHTMax" VALUE 0x80026494 Val_Wu16 65535.00 DFES_OneToOne 0.00 65535.00 /end CHARACTERISTIC
/begin CHARACTERISTIC DFC_DisblMsk.DFC_Layer_GENHTMin_C "DFC/Abschalt Maske für Prüfung DFC_Layer_GENHTMin" VALUE 0x80026496 Val_Wu16 65535.00 DFES_OneToOne 0.00 65535.00 /end CHARACTERISTIC
/begin CHARACTERISTIC DFC_DisblMsk.DFC_Layer_GENHTNpl_C "DFC/Abschalt Maske für Prüfung DFC_Layer_GENHTNpl" VALUE 0x80026498 Val_Wu16 65535.00 DFES_OneToOne 0.00 65535.00 /end CHARACTERISTIC
/begin CHARACTERISTIC DFC_DisblMsk.DFC_Layer_GENHTSig_C "DFC/Abschalt Maske für Prüfung DFC_Layer_GENHTSig" VALUE 0x8002649A Val_Wu16 65535.00 DFES_OneToOne 0.00 65535.00 /end CHARACTERISTIC
/begin CHARACTERISTIC DFC_DisblMsk.DFC_Layer_GENKOMMMax_C "DFC/Abschalt Maske für Prüfung DFC_Layer_GENKOMMMax" VALUE 0x8002649C Val_Wu16 65535.00 DFES_OneToOne 0.00 65535.00 /end CHARACTERISTIC
/begin CHARACTERISTIC DFC_DisblMsk.DFC_Layer_GENKOMMMin_C "DFC/Abschalt Maske für Prüfung DFC_Layer_GENKOMMMin" VALUE 0x8002649E Val_Wu16 65535.00 DFES_OneToOne 0.00 65535.00 /end CHARACTERISTIC
/begin CHARACTERISTIC DFC_DisblMsk.DFC_Layer_GENKOMMNpl_C "DFC/Abschalt Maske für Prüfung DFC_Layer_GENKOMMNpl" VALUE 0x800264A0 Val_Wu16 65535.00 DFES_OneToOne 0.00 65535.00 /end CHARACTERISTIC
/begin CHARACTERISTIC DFC_DisblMsk.DFC_Layer_GENKOMMSig_C "DFC/Abschalt Maske für Prüfung DFC_Layer_GENKOMMSig" VALUE 0x800264A2 Val_Wu16 65535.00 DFES_OneToOne 0.00 65535.00 /end CHARACTERISTIC
/begin CHARACTERISTIC DFC_DisblMsk.DFC_Layer_GENMECHMax_C "DFC/Abschalt Maske für Prüfung DFC_Layer_GENMECHMax" VALUE 0x800264A4 Val_Wu16 65535.00 DFES_OneToOne 0.00 65535.00 /end CHARACTERISTIC
/begin CHARACTERISTIC DFC_DisblMsk.DFC_Layer_GENMECHMin_C "DFC/Abschalt Maske für Prüfung DFC_Layer_GENMECHMin" VALUE 0x800264A6 Val_Wu16 65535.00 DFES_OneToOne 0.00 65535.00 /end CHARACTERISTIC
/begin CHARACTERISTIC DFC_DisblMsk.DFC_Layer_GENMECHNpl_C "DFC/Abschalt Maske für Prüfung DFC_Layer_GENMECHNpl" VALUE 0x800264A8 Val_Wu16 65535.00 DFES_OneToOne 0.00 65535.00 /end CHARACTERISTIC
/begin CHARACTERISTIC DFC_DisblMsk.DFC_Layer_GENMECHSig_C "DFC/Abschalt Maske für Prüfung DFC_Layer_GENMECHSig" VALUE 0x800264AA Val_Wu16 65535.00 DFES_OneToOne 0.00 65535.00 /end CHARACTERISTIC
/begin CHARACTERISTIC DFC_DisblMsk.DFC_Layer_GENMax_C "DFC/Abschalt Maske für Prüfung DFC_Layer_GENMax" VALUE 0x800264AC Val_Wu16 65535.00 DFES_OneToOne 0.00 65535.00 /end CHARACTERISTIC
/begin CHARACTERISTIC DFC_DisblMsk.DFC_Layer_GENMin_C "DFC/Abschalt Maske für Prüfung DFC_Layer_GENMin" VALUE 0x800264AE Val_Wu16 65535.00 DFES_OneToOne 0.00 65535.00 /end CHARACTERISTIC
/begin CHARACTERISTIC DFC_DisblMsk.DFC_Layer_GENNpl_C "DFC/Abschalt Maske für Prüfung DFC_Layer_GENNpl" VALUE 0x800264B0 Val_Wu16 65535.00 DFES_OneToOne 0.00 65535.00 /end CHARACTERISTIC
/begin CHARACTERISTIC DFC_DisblMsk.DFC_Layer_GENREGUPLMax_C "DFC/Abschalt Maske für Prüfung DFC_Layer_GENREGUPLMax" VALUE 0x800264B2 Val_Wu16 65535.00 DFES_OneToOne 0.00 65535.00 /end CHARACTERISTIC
/begin CHARACTERISTIC DFC_DisblMsk.DFC_Layer_GENREGUPLMin_C "DFC/Abschalt Maske für Prüfung DFC_Layer_GENREGUPLMin" VALUE 0x800264B4 Val_Wu16 65535.00 DFES_OneToOne 0.00 65535.00 /end CHARACTERISTIC
/begin CHARACTERISTIC DFC_DisblMsk.DFC_Layer_GENREGUPLNpl_C "DFC/Abschalt Maske für Prüfung DFC_Layer_GENREGUPLNpl" VALUE 0x800264B6 Val_Wu16 65535.00 DFES_OneToOne 0.00 65535.00 /end CHARACTERISTIC
/begin CHARACTERISTIC DFC_DisblMsk.DFC_Layer_GENREGUPLSig_C "DFC/Abschalt Maske für Prüfung DFC_Layer_GENREGUPLSig" VALUE 0x800264B8 Val_Wu16 65535.00 DFES_OneToOne 0.00 65535.00 /end CHARACTERISTIC
/begin CHARACTERISTIC DFC_DisblMsk.DFC_Layer_GENSig_C "DFC/Abschalt Maske für Prüfung DFC_Layer_GENSig" VALUE 0x800264BA Val_Wu16 65535.00 DFES_OneToOne 0.00 65535.00 /end CHARACTERISTIC
/begin CHARACTERISTIC DFC_DisblMsk.DFC_Layer_GENUPLMax_C "DFC/Abschalt Maske für Prüfung DFC_Layer_GENUPLMax" VALUE 0x800264BC Val_Wu16 65535.00 DFES_OneToOne 0.00 65535.00 /end CHARACTERISTIC
/begin CHARACTERISTIC DFC_DisblMsk.DFC_Layer_GENUPLMin_C "DFC/Abschalt Maske für Prüfung DFC_Layer_GENUPLMin" VALUE 0x800264BE Val_Wu16 65535.00 DFES_OneToOne 0.00 65535.00 /end CHARACTERISTIC
/begin CHARACTERISTIC DFC_DisblMsk.DFC_Layer_GENUPLNpl_C "DFC/Abschalt Maske für Prüfung DFC_Layer_GENUPLNpl" VALUE 0x800264C0 Val_Wu16 65535.00 DFES_OneToOne 0.00 65535.00 /end CHARACTERISTIC
/begin CHARACTERISTIC DFC_DisblMsk.DFC_Layer_GENUPLSig_C "DFC/Abschalt Maske für Prüfung DFC_Layer_GENUPLSig" VALUE 0x800264C2 Val_Wu16 65535.00 DFES_OneToOne 0.00 65535.00 /end CHARACTERISTIC
/begin CHARACTERISTIC DFC_DisblMsk.DFC_Layer_IBS1Max_C "DFC/Abschalt Maske für Prüfung DFC_Layer_IBS1Max" VALUE 0x800264C4 Val_Wu16 65535.00 DFES_OneToOne 0.00 65535.00 /end CHARACTERISTIC
/begin CHARACTERISTIC DFC_DisblMsk.DFC_Layer_IBS1Min_C "DFC/Abschalt Maske für Prüfung DFC_Layer_IBS1Min" VALUE 0x800264C6 Val_Wu16 65535.00 DFES_OneToOne 0.00 65535.00 /end CHARACTERISTIC
/begin CHARACTERISTIC DFC_DisblMsk.DFC_Layer_IBS1Npl_C "DFC/Abschalt Maske für Prüfung DFC_Layer_IBS1Npl" VALUE 0x800264C8 Val_Wu16 65535.00 DFES_OneToOne 0.00 65535.00 /end CHARACTERISTIC
/begin CHARACTERISTIC DFC_DisblMsk.DFC_Layer_IBS1Sig_C "DFC/Abschalt Maske für Prüfung DFC_Layer_IBS1Sig" VALUE 0x800264CA Val_Wu16 65535.00 DFES_OneToOne 0.00 65535.00 /end CHARACTERISTIC
/begin CHARACTERISTIC DFC_DisblMsk.DFC_Layer_IBS2Max_C "DFC/Abschalt Maske für Prüfung DFC_Layer_IBS2Max" VALUE 0x800264CC Val_Wu16 65535.00 DFES_OneToOne 0.00 65535.00 /end CHARACTERISTIC
/begin CHARACTERISTIC DFC_DisblMsk.DFC_Layer_IBS2Min_C "DFC/Abschalt Maske für Prüfung DFC_Layer_IBS2Min" VALUE 0x800264CE Val_Wu16 65535.00 DFES_OneToOne 0.00 65535.00 /end CHARACTERISTIC
/begin CHARACTERISTIC DFC_DisblMsk.DFC_Layer_IBS2Npl_C "DFC/Abschalt Maske für Prüfung DFC_Layer_IBS2Npl" VALUE 0x800264D0 Val_Wu16 65535.00 DFES_OneToOne 0.00 65535.00 /end CHARACTERISTIC
/begin CHARACTERISTIC DFC_DisblMsk.DFC_Layer_IBS2Sig_C "DFC/Abschalt Maske für Prüfung DFC_Layer_IBS2Sig" VALUE 0x800264D2 Val_Wu16 65535.00 DFES_OneToOne 0.00 65535.00 /end CHARACTERISTIC
/begin CHARACTERISTIC DFC_DisblMsk.DFC_Layer_IBS3Max_C "DFC/Abschalt Maske für Prüfung DFC_Layer_IBS3Max" VALUE 0x800264D4 Val_Wu16 65535.00 DFES_OneToOne 0.00 65535.00 /end CHARACTERISTIC
/begin CHARACTERISTIC DFC_DisblMsk.DFC_Layer_IBS3Min_C "DFC/Abschalt Maske für Prüfung DFC_Layer_IBS3Min" VALUE 0x800264D6 Val_Wu16 65535.00 DFES_OneToOne 0.00 65535.00 /end CHARACTERISTIC
/begin CHARACTERISTIC DFC_DisblMsk.DFC_Layer_IBS3Npl_C "DFC/Abschalt Maske für Prüfung DFC_Layer_IBS3Npl" VALUE 0x800264D8 Val_Wu16 65535.00 DFES_OneToOne 0.00 65535.00 /end CHARACTERISTIC
/begin CHARACTERISTIC DFC_DisblMsk.DFC_Layer_IBS3Sig_C "DFC/Abschalt Maske für Prüfung DFC_Layer_IBS3Sig" VALUE 0x800264DA Val_Wu16 65535.00 DFES_OneToOne 0.00 65535.00 /end CHARACTERISTIC
/begin CHARACTERISTIC DFC_DisblMsk.DFC_Layer_MANDETEKMax_C "DFC/Abschalt Maske für Prüfung DFC_Layer_MANDETEKMax" VALUE 0x800264DC Val_Wu16 65535.00 DFES_OneToOne 0.00 65535.00 /end CHARACTERISTIC
/begin CHARACTERISTIC DFC_DisblMsk.DFC_Layer_MANDETEKMin_C "DFC/Abschalt Maske für Prüfung DFC_Layer_MANDETEKMin" VALUE 0x800264DE Val_Wu16 65535.00 DFES_OneToOne 0.00 65535.00 /end CHARACTERISTIC
/begin CHARACTERISTIC DFC_DisblMsk.DFC_Layer_MANDETEKNpl_C "DFC/Abschalt Maske für Prüfung DFC_Layer_MANDETEKNpl" VALUE 0x800264E0 Val_Wu16 65535.00 DFES_OneToOne 0.00 65535.00 /end CHARACTERISTIC
/begin CHARACTERISTIC DFC_DisblMsk.DFC_Layer_MANDETEKSig_C "DFC/Abschalt Maske für Prüfung DFC_Layer_MANDETEKSig" VALUE 0x800264E2 Val_Wu16 65535.00 DFES_OneToOne 0.00 65535.00 /end CHARACTERISTIC
/begin CHARACTERISTIC DFC_DisblMsk.DFC_Layer_NDR1Max_C "DFC/Abschalt Maske für Prüfung DFC_Layer_NDR1Max" VALUE 0x800264E4 Val_Wu16 65535.00 DFES_OneToOne 0.00 65535.00 /end CHARACTERISTIC
/begin CHARACTERISTIC DFC_DisblMsk.DFC_Layer_NDR1Min_C "DFC/Abschalt Maske für Prüfung DFC_Layer_NDR1Min" VALUE 0x800264E6 Val_Wu16 65535.00 DFES_OneToOne 0.00 65535.00 /end CHARACTERISTIC
/begin CHARACTERISTIC DFC_DisblMsk.DFC_Layer_NDR1Npl_C "DFC/Abschalt Maske für Prüfung DFC_Layer_NDR1Npl" VALUE 0x800264E8 Val_Wu16 65535.00 DFES_OneToOne 0.00 65535.00 /end CHARACTERISTIC
/begin CHARACTERISTIC DFC_DisblMsk.DFC_Layer_NDR1Sig_C "DFC/Abschalt Maske für Prüfung DFC_Layer_NDR1Sig" VALUE 0x800264EA Val_Wu16 65535.00 DFES_OneToOne 0.00 65535.00 /end CHARACTERISTIC
/begin CHARACTERISTIC DFC_DisblMsk.DFC_Layer_NDR2Max_C "DFC/Abschalt Maske für Prüfung DFC_Layer_NDR2Max" VALUE 0x800264EC Val_Wu16 65535.00 DFES_OneToOne 0.00 65535.00 /end CHARACTERISTIC
/begin CHARACTERISTIC DFC_DisblMsk.DFC_Layer_NDR2Min_C "DFC/Abschalt Maske für Prüfung DFC_Layer_NDR2Min" VALUE 0x800264EE Val_Wu16 65535.00 DFES_OneToOne 0.00 65535.00 /end CHARACTERISTIC
/begin CHARACTERISTIC DFC_DisblMsk.DFC_Layer_NDR2Npl_C "DFC/Abschalt Maske für Prüfung DFC_Layer_NDR2Npl" VALUE 0x800264F0 Val_Wu16 65535.00 DFES_OneToOne 0.00 65535.00 /end CHARACTERISTIC
/begin CHARACTERISTIC DFC_DisblMsk.DFC_Layer_NDR2Sig_C "DFC/Abschalt Maske für Prüfung DFC_Layer_NDR2Sig" VALUE 0x800264F2 Val_Wu16 65535.00 DFES_OneToOne 0.00 65535.00 /end CHARACTERISTIC
/begin CHARACTERISTIC DFC_DisblMsk.DFC_Layer_NGLERNMax_C "DFC/Abschalt Maske für Prüfung DFC_Layer_NGLERNMax" VALUE 0x800264F4 Val_Wu16 65535.00 DFES_OneToOne 0.00 65535.00 /end CHARACTERISTIC
/begin CHARACTERISTIC DFC_DisblMsk.DFC_Layer_NGLERNMin_C "DFC/Abschalt Maske für Prüfung DFC_Layer_NGLERNMin" VALUE 0x800264F6 Val_Wu16 65535.00 DFES_OneToOne 0.00 65535.00 /end CHARACTERISTIC
/begin CHARACTERISTIC DFC_DisblMsk.DFC_Layer_NGLERNNpl_C "DFC/Abschalt Maske für Prüfung DFC_Layer_NGLERNNpl" VALUE 0x800264F8 Val_Wu16 65535.00 DFES_OneToOne 0.00 65535.00 /end CHARACTERISTIC
/begin CHARACTERISTIC DFC_DisblMsk.DFC_Layer_NGLERNSig_C "DFC/Abschalt Maske für Prüfung DFC_Layer_NGLERNSig" VALUE 0x800264FA Val_Wu16 65535.00 DFES_OneToOne 0.00 65535.00 /end CHARACTERISTIC
/begin CHARACTERISTIC DFC_DisblMsk.DFC_Layer_PMBATTMax_C "DFC/Abschalt Maske für Prüfung DFC_Layer_PMBATTMax" VALUE 0x800264FC Val_Wu16 65535.00 DFES_OneToOne 0.00 65535.00 /end CHARACTERISTIC
/begin CHARACTERISTIC DFC_DisblMsk.DFC_Layer_PMBATTMin_C "DFC/Abschalt Maske für Prüfung DFC_Layer_PMBATTMin" VALUE 0x800264FE Val_Wu16 65535.00 DFES_OneToOne 0.00 65535.00 /end CHARACTERISTIC
/begin CHARACTERISTIC DFC_DisblMsk.DFC_Layer_PMBATTNpl_C "DFC/Abschalt Maske für Prüfung DFC_Layer_PMBATTNpl" VALUE 0x80026500 Val_Wu16 65535.00 DFES_OneToOne 0.00 65535.00 /end CHARACTERISTIC
/begin CHARACTERISTIC DFC_DisblMsk.DFC_Layer_PMBATTSig_C "DFC/Abschalt Maske für Prüfung DFC_Layer_PMBATTSig" VALUE 0x80026502 Val_Wu16 65535.00 DFES_OneToOne 0.00 65535.00 /end CHARACTERISTIC
/begin CHARACTERISTIC DFC_DisblMsk.DFC_Layer_PMBNMax_C "DFC/Abschalt Maske für Prüfung DFC_Layer_PMBNMax" VALUE 0x80026504 Val_Wu16 65535.00 DFES_OneToOne 0.00 65535.00 /end CHARACTERISTIC
/begin CHARACTERISTIC DFC_DisblMsk.DFC_Layer_PMBNMin_C "DFC/Abschalt Maske für Prüfung DFC_Layer_PMBNMin" VALUE 0x80026506 Val_Wu16 65535.00 DFES_OneToOne 0.00 65535.00 /end CHARACTERISTIC
/begin CHARACTERISTIC DFC_DisblMsk.DFC_Layer_PMBNNpl_C "DFC/Abschalt Maske für Prüfung DFC_Layer_PMBNNpl" VALUE 0x80026508 Val_Wu16 65535.00 DFES_OneToOne 0.00 65535.00 /end CHARACTERISTIC
/begin CHARACTERISTIC DFC_DisblMsk.DFC_Layer_PMBNSig_C "DFC/Abschalt Maske für Prüfung DFC_Layer_PMBNSig" VALUE 0x8002650A Val_Wu16 65535.00 DFES_OneToOne 0.00 65535.00 /end CHARACTERISTIC
/begin CHARACTERISTIC DFC_DisblMsk.DFC_Layer_PMRUHVERLMax_C "DFC/Abschalt Maske für Prüfung DFC_Layer_PMRUHVERLMax" VALUE 0x8002650C Val_Wu16 65535.00 DFES_OneToOne 0.00 65535.00 /end CHARACTERISTIC
/begin CHARACTERISTIC DFC_DisblMsk.DFC_Layer_PMRUHVERLMin_C "DFC/Abschalt Maske für Prüfung DFC_Layer_PMRUHVERLMin" VALUE 0x8002650E Val_Wu16 65535.00 DFES_OneToOne 0.00 65535.00 /end CHARACTERISTIC
/begin CHARACTERISTIC DFC_DisblMsk.DFC_Layer_PMRUHVERLNpl_C "DFC/Abschalt Maske für Prüfung DFC_Layer_PMRUHVERLNpl" VALUE 0x80026510 Val_Wu16 65535.00 DFES_OneToOne 0.00 65535.00 /end CHARACTERISTIC
/begin CHARACTERISTIC DFC_DisblMsk.DFC_Layer_PMRUHVERLSig_C "DFC/Abschalt Maske für Prüfung DFC_Layer_PMRUHVERLSig" VALUE 0x80026512 Val_Wu16 65535.00 DFES_OneToOne 0.00 65535.00 /end CHARACTERISTIC
/begin CHARACTERISTIC DFC_DisblMsk.DFC_Layer_QLTMax_C "DFC/Abschalt Maske für Prüfung DFC_Layer_QLTMax" VALUE 0x80026514 Val_Wu16 65535.00 DFES_OneToOne 0.00 65535.00 /end CHARACTERISTIC
/begin CHARACTERISTIC DFC_DisblMsk.DFC_Layer_QLTMin_C "DFC/Abschalt Maske für Prüfung DFC_Layer_QLTMin" VALUE 0x80026516 Val_Wu16 65535.00 DFES_OneToOne 0.00 65535.00 /end CHARACTERISTIC
/begin CHARACTERISTIC DFC_DisblMsk.DFC_Layer_QLTNpl_C "DFC/Abschalt Maske für Prüfung DFC_Layer_QLTNpl" VALUE 0x80026518 Val_Wu16 65535.00 DFES_OneToOne 0.00 65535.00 /end CHARACTERISTIC
/begin CHARACTERISTIC DFC_DisblMsk.DFC_Layer_QLTSig_C "DFC/Abschalt Maske für Prüfung DFC_Layer_QLTSig" VALUE 0x8002651A Val_Wu16 65535.00 DFES_OneToOne 0.00 65535.00 /end CHARACTERISTIC
/begin CHARACTERISTIC DFC_DisblMsk.DFC_Layer_TOENSMax_C "DFC/Abschalt Maske für Prüfung DFC_Layer_TOENSMax" VALUE 0x8002651C Val_Wu16 65535.00 DFES_OneToOne 0.00 65535.00 /end CHARACTERISTIC
/begin CHARACTERISTIC DFC_DisblMsk.DFC_Layer_TOENSMin_C "DFC/Abschalt Maske für Prüfung DFC_Layer_TOENSMin" VALUE 0x8002651E Val_Wu16 65535.00 DFES_OneToOne 0.00 65535.00 /end CHARACTERISTIC
/begin CHARACTERISTIC DFC_DisblMsk.DFC_Layer_TOENSNpl_C "DFC/Abschalt Maske für Prüfung DFC_Layer_TOENSNpl" VALUE 0x80026520 Val_Wu16 65535.00 DFES_OneToOne 0.00 65535.00 /end CHARACTERISTIC
/begin CHARACTERISTIC DFC_DisblMsk.DFC_Layer_TOENSSig_C "DFC/Abschalt Maske für Prüfung DFC_Layer_TOENSSig" VALUE 0x80026522 Val_Wu16 65535.00 DFES_OneToOne 0.00 65535.00 /end CHARACTERISTIC
/begin CHARACTERISTIC DFC_DisblMsk.DFC_MonLimCurr_C "DFC/Abschalt Maske für Prüfung DFC_MonLimCurr" VALUE 0x80026524 Val_Wu16 65535.00 DFES_OneToOne 0.00 65535.00 /end CHARACTERISTIC
/begin CHARACTERISTIC DFC_DisblMsk.DFC_MonLimLead_C "DFC/Abschalt Maske für Prüfung DFC_MonLimLead" VALUE 0x80026526 Val_Wu16 65535.00 DFES_OneToOne 0.00 65535.00 /end CHARACTERISTIC
/begin CHARACTERISTIC DFC_DisblMsk.DFC_MonLimSet_C "DFC/Abschalt Maske für Prüfung DFC_MonLimSet" VALUE 0x80026528 Val_Wu16 65535.00 DFES_OneToOne 0.00 65535.00 /end CHARACTERISTIC
/begin CHARACTERISTIC DFC_DisblMsk.DFC_NSCDsNOxOfsMax_C "DFC/Abschalt Maske für Prüfung DFC_NSCDsNOxOfsMax" VALUE 0x8002652A Val_Wu16 65535.00 DFES_OneToOne 0.00 65535.00 /end CHARACTERISTIC
/begin CHARACTERISTIC DFC_DisblMsk.DFC_NSCDsNOxOfsMin_C "DFC/Abschalt Maske für Prüfung DFC_NSCDsNOxOfsMin" VALUE 0x8002652C Val_Wu16 65535.00 DFES_OneToOne 0.00 65535.00 /end CHARACTERISTIC
/begin CHARACTERISTIC DFC_DisblMsk.DFC_NSCDsNOxPlausMin_C "DFC/Abschalt Maske für Prüfung DFC_NSCDsNOxPlausMin" VALUE 0x8002652E Val_Wu16 65535.00 DFES_OneToOne 0.00 65535.00 /end CHARACTERISTIC
/begin CHARACTERISTIC DFC_DisblMsk.DFC_NoCat2DsNOxOfsMax_C "DFC/Abschalt Maske für Prüfung DFC_NoCat2DsNOxOfsMax" VALUE 0x80026530 Val_Wu16 65535.00 DFES_OneToOne 0.00 65535.00 /end CHARACTERISTIC
/begin CHARACTERISTIC DFC_DisblMsk.DFC_NoCat2DsNOxOfsMin_C "DFC/Abschalt Maske für Prüfung DFC_NoCat2DsNOxOfsMin" VALUE 0x80026532 Val_Wu16 65535.00 DFES_OneToOne 0.00 65535.00 /end CHARACTERISTIC
/begin CHARACTERISTIC DFC_DisblMsk.DFC_NoCat2DsNOxPlausMin_C "DFC/Abschalt Maske für Prüfung DFC_NoCat2DsNOxPlausMin" VALUE 0x80026534 Val_Wu16 65535.00 DFES_OneToOne 0.00 65535.00 /end CHARACTERISTIC
/begin CHARACTERISTIC DFC_DisblMsk.DFC_PCVNoStrt_C "DFC/Abschalt Maske für Prüfung DFC_PCVNoStrt" VALUE 0x80026536 Val_Wu16 65535.00 DFES_OneToOne 0.00 65535.00 /end CHARACTERISTIC
/begin CHARACTERISTIC DFC_DisblMsk.DFC_RailPGradMon_C "DFC/Abschalt Maske für Prüfung DFC_RailPGradMon" VALUE 0x80026538 Val_Wu16 65535.00 DFES_OneToOne 0.00 65535.00 /end CHARACTERISTIC
/begin CHARACTERISTIC DFC_DisblMsk.DFC_SCRPODPresBuildUp_C "DFC/Abschalt Maske für Prüfung DFC_SCRPODPresBuildUp" VALUE 0x8002653A Val_Wu16 65535.00 DFES_OneToOne 0.00 65535.00 /end CHARACTERISTIC
/begin CHARACTERISTIC DFC_DisblMsk.DFC_AFSDrftIdlAdjVal_C "DFC/Abschalt Maske für Prüfung DFC_AFSDrftIdlAdjVal" VALUE 0x8002653C Val_Wu16 65535.00 DFES_OneToOne 0.00 65535.00 /end CHARACTERISTIC
/begin CHARACTERISTIC DFC_DisblMsk.DFC_AFSDrftLdAdjVal_C "DFC/Abschalt Maske für Prüfung DFC_AFSDrftLdAdjVal" VALUE 0x8002653E Val_Wu16 65535.00 DFES_OneToOne 0.00 65535.00 /end CHARACTERISTIC
/begin CHARACTERISTIC DFC_DisblMsk.DFC_AdcIADC0Cal_C "DFC/Abschalt Maske für Prüfung DFC_AdcIADC0Cal" VALUE 0x80026540 Val_Wu16 65535.00 DFES_OneToOne 0.00 65535.00 /end CHARACTERISTIC
/begin CHARACTERISTIC DFC_DisblMsk.DFC_AdcIADC0Conv_C "DFC/Abschalt Maske für Prüfung DFC_AdcIADC0Conv" VALUE 0x80026542 Val_Wu16 65535.00 DFES_OneToOne 0.00 65535.00 /end CHARACTERISTIC
/begin CHARACTERISTIC DFC_DisblMsk.DFC_AdcIADC1Cal_C "DFC/Abschalt Maske für Prüfung DFC_AdcIADC1Cal" VALUE 0x80026544 Val_Wu16 65535.00 DFES_OneToOne 0.00 65535.00 /end CHARACTERISTIC
/begin CHARACTERISTIC DFC_DisblMsk.DFC_AdcIADC1Conv_C "DFC/Abschalt Maske für Prüfung DFC_AdcIADC1Conv" VALUE 0x80026546 Val_Wu16 65535.00 DFES_OneToOne 0.00 65535.00 /end CHARACTERISTIC
/begin CHARACTERISTIC DFC_DisblMsk.DFC_CmbChbMisfireMax_0_C "DFC/Abschalt Maske für Prüfung DFC_CmbChbMisfireMax_0" VALUE 0x80026548 Val_Wu16 65535.00 DFES_OneToOne 0.00 65535.00 /end CHARACTERISTIC
/begin CHARACTERISTIC DFC_DisblMsk.DFC_CmbChbMisfireMax_1_C "DFC/Abschalt Maske für Prüfung DFC_CmbChbMisfireMax_1" VALUE 0x8002654A Val_Wu16 65535.00 DFES_OneToOne 0.00 65535.00 /end CHARACTERISTIC
/begin CHARACTERISTIC DFC_DisblMsk.DFC_CmbChbMisfireMax_2_C "DFC/Abschalt Maske für Prüfung DFC_CmbChbMisfireMax_2" VALUE 0x8002654C Val_Wu16 65535.00 DFES_OneToOne 0.00 65535.00 /end CHARACTERISTIC
/begin CHARACTERISTIC DFC_DisblMsk.DFC_CmbChbMisfireMax_3_C "DFC/Abschalt Maske für Prüfung DFC_CmbChbMisfireMax_3" VALUE 0x8002654E Val_Wu16 65535.00 DFES_OneToOne 0.00 65535.00 /end CHARACTERISTIC
/begin CHARACTERISTIC DFC_DisblMsk.DFC_CmbChbMisfireMax_4_C "DFC/Abschalt Maske für Prüfung DFC_CmbChbMisfireMax_4" VALUE 0x80026550 Val_Wu16 65535.00 DFES_OneToOne 0.00 65535.00 /end CHARACTERISTIC
/begin CHARACTERISTIC DFC_DisblMsk.DFC_CmbChbMisfireMax_5_C "DFC/Abschalt Maske für Prüfung DFC_CmbChbMisfireMax_5" VALUE 0x80026552 Val_Wu16 65535.00 DFES_OneToOne 0.00 65535.00 /end CHARACTERISTIC
/begin CHARACTERISTIC DFC_DisblMsk.DFC_CmbChbMisfireMul_C "DFC/Abschalt Maske für Prüfung DFC_CmbChbMisfireMul" VALUE 0x80026554 Val_Wu16 65535.00 DFES_OneToOne 0.00 65535.00 /end CHARACTERISTIC
/begin CHARACTERISTIC DFC_DisblMsk.DFC_EGRVlvLPOfsNeutr_C "DFC/" VALUE 0x80026556 Val_Wu16 65535.00 DFES_OneToOne 0.00 65535.00 /end CHARACTERISTIC
/begin CHARACTERISTIC DFC_DisblMsk.DFC_EGRVlvOfsNeutr_C "DFC/Abschalt Maske für Prüfung DFC_EGRVlvOfsNeutr" VALUE 0x80026558 Val_Wu16 65535.00 DFES_OneToOne 0.00 65535.00 /end CHARACTERISTIC
/begin CHARACTERISTIC DFC_DisblMsk.DFC_FMAErrModMax_C "DFC/Abschalt Maske für Prüfung DFC_FMAErrModMax" VALUE 0x8002655A Val_Wu16 65535.00 DFES_OneToOne 0.00 65535.00 /end CHARACTERISTIC
/begin CHARACTERISTIC DFC_DisblMsk.DFC_FMAErrModMin_C "DFC/Abschalt Maske für Prüfung DFC_FMAErrModMin" VALUE 0x8002655C Val_Wu16 65535.00 DFES_OneToOne 0.00 65535.00 /end CHARACTERISTIC
/begin CHARACTERISTIC DFC_DisblMsk.DFC_FlSysTnkLo_C "DFC/Abschalt Maske für Prüfung DFC_FlSysTnkLo" VALUE 0x8002655E Val_Wu16 65535.00 DFES_OneToOne 0.00 65535.00 /end CHARACTERISTIC
/begin CHARACTERISTIC DFC_DisblMsk.DFC_GbxNPosPlaus_C "DFC/Abschalt Maske für Prüfung DFC_GbxNPosPlaus" VALUE 0x80026560 Val_Wu16 65535.00 DFES_OneToOne 0.00 65535.00 /end CHARACTERISTIC
/begin CHARACTERISTIC DFC_DisblMsk.DFC_I14229_ROETst_Appl_C "DFC/" VALUE 0x80026562 Val_Wu16 65535.00 DFES_OneToOne 0.00 65535.00 /end CHARACTERISTIC
/begin CHARACTERISTIC DFC_DisblMsk.DFC_I14229_ROETst_Netw_C "DFC/" VALUE 0x80026564 Val_Wu16 65535.00 DFES_OneToOne 0.00 65535.00 /end CHARACTERISTIC
/begin CHARACTERISTIC DFC_DisblMsk.DFC_I14229_ROE_BufFull_C "DFC/" VALUE 0x80026566 Val_Wu16 65535.00 DFES_OneToOne 0.00 65535.00 /end CHARACTERISTIC
/begin CHARACTERISTIC DFC_DisblMsk.DFC_IVAdjDiaIVAdj_C "DFC/Abschalt Maske für Prüfung DFC_IVAdjDiaIVAdj" VALUE 0x80026568 Val_Wu16 65535.00 DFES_OneToOne 0.00 65535.00 /end CHARACTERISTIC
/begin CHARACTERISTIC DFC_DisblMsk.DFC_IVAdjIVA_0_C "DFC/Abschalt Maske für Prüfung DFC_IVAdjIVA_0" VALUE 0x8002656A Val_Wu16 65535.00 DFES_OneToOne 0.00 65535.00 /end CHARACTERISTIC
/begin CHARACTERISTIC DFC_DisblMsk.DFC_IVAdjIVA_1_C "DFC/Abschalt Maske für Prüfung DFC_IVAdjIVA_1" VALUE 0x8002656C Val_Wu16 65535.00 DFES_OneToOne 0.00 65535.00 /end CHARACTERISTIC
/begin CHARACTERISTIC DFC_DisblMsk.DFC_IVAdjIVA_2_C "DFC/Abschalt Maske für Prüfung DFC_IVAdjIVA_2" VALUE 0x8002656E Val_Wu16 65535.00 DFES_OneToOne 0.00 65535.00 /end CHARACTERISTIC
/begin CHARACTERISTIC DFC_DisblMsk.DFC_IVAdjIVA_3_C "DFC/Abschalt Maske für Prüfung DFC_IVAdjIVA_3" VALUE 0x80026570 Val_Wu16 65535.00 DFES_OneToOne 0.00 65535.00 /end CHARACTERISTIC
/begin CHARACTERISTIC DFC_DisblMsk.DFC_IVAdjIVA_4_C "DFC/Abschalt Maske für Prüfung DFC_IVAdjIVA_4" VALUE 0x80026572 Val_Wu16 65535.00 DFES_OneToOne 0.00 65535.00 /end CHARACTERISTIC
/begin CHARACTERISTIC DFC_DisblMsk.DFC_IVAdjIVA_5_C "DFC/Abschalt Maske für Prüfung DFC_IVAdjIVA_5" VALUE 0x80026574 Val_Wu16 65535.00 DFES_OneToOne 0.00 65535.00 /end CHARACTERISTIC
/begin CHARACTERISTIC DFC_DisblMsk.DFC_IVPSplyDCDCOff_0_C "DFC/Abschalt Maske für Prüfung DFC_IVPSplyDCDCOff_0" VALUE 0x80026576 Val_Wu16 65535.00 DFES_OneToOne 0.00 65535.00 /end CHARACTERISTIC
/begin CHARACTERISTIC DFC_DisblMsk.DFC_IVPSplyDCDCOff_1_C "DFC/Abschalt Maske für Prüfung DFC_IVPSplyDCDCOff_1" VALUE 0x80026578 Val_Wu16 65535.00 DFES_OneToOne 0.00 65535.00 /end CHARACTERISTIC
/begin CHARACTERISTIC DFC_DisblMsk.DFC_IVPSplyDCDCOff_2_C "DFC/Abschalt Maske für Prüfung DFC_IVPSplyDCDCOff_2" VALUE 0x8002657A Val_Wu16 65535.00 DFES_OneToOne 0.00 65535.00 /end CHARACTERISTIC
/begin CHARACTERISTIC DFC_DisblMsk.DFC_IVPSplyDCDCOff_3_C "DFC/Abschalt Maske für Prüfung DFC_IVPSplyDCDCOff_3" VALUE 0x8002657C Val_Wu16 65535.00 DFES_OneToOne 0.00 65535.00 /end CHARACTERISTIC
/begin CHARACTERISTIC DFC_DisblMsk.DFC_InjCtlAdjQntEEPCS_C "DFC/Abschalt Maske für Prüfung DFC_InjCtlAdjQntEEPCS" VALUE 0x8002657E Val_Wu16 65535.00 DFES_OneToOne 0.00 65535.00 /end CHARACTERISTIC
/begin CHARACTERISTIC DFC_DisblMsk.DFC_LSUSPISig_C "DFC/Abschalt Maske für Prüfung DFC_LSUSPISig" VALUE 0x80026580 Val_Wu16 65535.00 DFES_OneToOne 0.00 65535.00 /end CHARACTERISTIC
/begin CHARACTERISTIC DFC_DisblMsk.DFC_Layer_Dummy_C "DFC/Abschalt Maske für Prüfung DFC_Layer_Dummy" VALUE 0x80026582 Val_Wu16 65535.00 DFES_OneToOne 0.00 65535.00 /end CHARACTERISTIC
/begin CHARACTERISTIC DFC_DisblMsk.DFC_NplEnvPSensPPFltDiff_C "DFC/Abschalt Maske für Prüfung DFC_NplEnvPSensPPFltDiff" VALUE 0x80026584 Val_Wu16 65535.00 DFES_OneToOne 0.00 65535.00 /end CHARACTERISTIC
/begin CHARACTERISTIC DFC_DisblMsk.DFC_NplPresSensPPFltDiff_C "DFC/Abschalt Maske für Prüfung DFC_NplPresSensPPFltDiff" VALUE 0x80026586 Val_Wu16 65535.00 DFES_OneToOne 0.00 65535.00 /end CHARACTERISTIC
/begin CHARACTERISTIC DFC_DisblMsk.DFC_OilLvlPlaus_C "DFC/Abschalt Maske für Prüfung DFC_OilLvlPlaus" VALUE 0x80026588 Val_Wu16 65535.00 DFES_OneToOne 0.00 65535.00 /end CHARACTERISTIC
/begin CHARACTERISTIC DFC_DisblMsk.DFC_OilTOutLvl_C "DFC/Abschalt Maske für Prüfung DFC_OilTOutLvl" VALUE 0x8002658A Val_Wu16 65535.00 DFES_OneToOne 0.00 65535.00 /end CHARACTERISTIC
/begin CHARACTERISTIC DFC_DisblMsk.DFC_PCVfacAdaptMax_C "DFC/Abschalt Maske für Prüfung DFC_PCVfacAdaptMax" VALUE 0x8002658C Val_Wu16 65535.00 DFES_OneToOne 0.00 65535.00 /end CHARACTERISTIC
/begin CHARACTERISTIC DFC_DisblMsk.DFC_PCVfacAdaptMin_C "DFC/Abschalt Maske für Prüfung DFC_PCVfacAdaptMin" VALUE 0x8002658E Val_Wu16 65535.00 DFES_OneToOne 0.00 65535.00 /end CHARACTERISTIC
/begin CHARACTERISTIC DFC_DisblMsk.DFC_SensFrzPPFltUs_C "DFC/Abschalt Maske für Prüfung DFC_SensFrzPPFltUs" VALUE 0x80026590 Val_Wu16 65535.00 DFES_OneToOne 0.00 65535.00 /end CHARACTERISTIC
/begin CHARACTERISTIC DFC_DisblMsk.DFC_SensMonUTnkLvl_C "DFC/Abschalt Maske für Prüfung DFC_SensMonUTnkLvl" VALUE 0x80026592 Val_Wu16 65535.00 DFES_OneToOne 0.00 65535.00 /end CHARACTERISTIC
/begin CHARACTERISTIC DFC_DisblMsk.DFC_T15Sig_C "DFC/Abschalt Maske für Prüfung DFC_T15Sig" VALUE 0x80026594 Val_Wu16 65535.00 DFES_OneToOne 0.00 65535.00 /end CHARACTERISTIC
/begin CHARACTERISTIC DFC_DisblMsk.DFC_AirCtlRmpTOut_C "DFC/Abschalt Maske für Prüfung DFC_AirCtlRmpTOut" VALUE 0x80026596 Val_Wu16 65535.00 DFES_OneToOne 0.00 65535.00 /end CHARACTERISTIC
/begin CHARACTERISTIC DFC_DisblMsk.DFC_BrkPPlaus_C "DFC/Abschalt Maske für Prüfung DFC_BrkPPlaus" VALUE 0x80026598 Val_Wu16 65535.00 DFES_OneToOne 0.00 65535.00 /end CHARACTERISTIC
/begin CHARACTERISTIC DFC_DisblMsk.DFC_CEngDsTDynTst_C "DFC/Abschalt Maske für Prüfung DFC_CEngDsTDynTst" VALUE 0x8002659A Val_Wu16 65535.00 DFES_OneToOne 0.00 65535.00 /end CHARACTERISTIC
/begin CHARACTERISTIC DFC_DisblMsk.DFC_EEPEraseErr_C "DFC/Abschalt Maske für Prüfung DFC_EEPEraseErr" VALUE 0x8002659C Val_Wu16 65535.00 DFES_OneToOne 0.00 65535.00 /end CHARACTERISTIC
/begin CHARACTERISTIC DFC_DisblMsk.DFC_EEPRdErr_C "DFC/Abschalt Maske für Prüfung DFC_EEPRdErr" VALUE 0x8002659E Val_Wu16 65535.00 DFES_OneToOne 0.00 65535.00 /end CHARACTERISTIC
/begin CHARACTERISTIC DFC_DisblMsk.DFC_EEPWrErr_C "DFC/Abschalt Maske für Prüfung DFC_EEPWrErr" VALUE 0x800265A0 Val_Wu16 65535.00 DFES_OneToOne 0.00 65535.00 /end CHARACTERISTIC
/begin CHARACTERISTIC DFC_DisblMsk.DFC_EGRVlvJamVlvClsd_C "DFC/Abschalt Maske für Prüfung DFC_EGRVlvJamVlvClsd" VALUE 0x800265A2 Val_Wu16 65535.00 DFES_OneToOne 0.00 65535.00 /end CHARACTERISTIC
/begin CHARACTERISTIC DFC_DisblMsk.DFC_EGRVlvJamVlvOpn_C "DFC/Abschalt Maske für Prüfung DFC_EGRVlvJamVlvOpn" VALUE 0x800265A4 Val_Wu16 65535.00 DFES_OneToOne 0.00 65535.00 /end CHARACTERISTIC
/begin CHARACTERISTIC DFC_DisblMsk.DFC_EGRVlvLPJamVlvClsd_C "DFC/Abschalt Maske für Prüfung DFC_EGRVlvLPJamVlvClsd" VALUE 0x800265A6 Val_Wu16 65535.00 DFES_OneToOne 0.00 65535.00 /end CHARACTERISTIC
/begin CHARACTERISTIC DFC_DisblMsk.DFC_EGRVlvLPJamVlvOpn_C "DFC/Abschalt Maske für Prüfung DFC_EGRVlvLPJamVlvOpn" VALUE 0x800265A8 Val_Wu16 65535.00 DFES_OneToOne 0.00 65535.00 /end CHARACTERISTIC
/begin CHARACTERISTIC DFC_DisblMsk.DFC_EGRVlvLPLgTDrft_C "DFC/Abschalt Maske für Prüfung DFC_EGRVlvLPLgTDrft" VALUE 0x800265AA Val_Wu16 65535.00 DFES_OneToOne 0.00 65535.00 /end CHARACTERISTIC
/begin CHARACTERISTIC DFC_DisblMsk.DFC_EGRVlvLPOfsLrnJamVlv_C "DFC/Abschalt Maske für Prüfung DFC_EGRVlvLPOfsLrnJamVlv" VALUE 0x800265AC Val_Wu16 65535.00 DFES_OneToOne 0.00 65535.00 /end CHARACTERISTIC
/begin CHARACTERISTIC DFC_DisblMsk.DFC_EGRVlvLPShTDrft_C "DFC/Abschalt Maske für Prüfung DFC_EGRVlvLPShTDrft" VALUE 0x800265AE Val_Wu16 65535.00 DFES_OneToOne 0.00 65535.00 /end CHARACTERISTIC
/begin CHARACTERISTIC DFC_DisblMsk.DFC_EGRVlvLgTDrft_C "DFC/Abschalt Maske für Prüfung DFC_EGRVlvLgTDrft" VALUE 0x800265B0 Val_Wu16 65535.00 DFES_OneToOne 0.00 65535.00 /end CHARACTERISTIC
/begin CHARACTERISTIC DFC_DisblMsk.DFC_EGRVlvOfsLrnJamVlv_C "DFC/Abschalt Maske für Prüfung DFC_EGRVlvOfsLrnJamVlv" VALUE 0x800265B2 Val_Wu16 65535.00 DFES_OneToOne 0.00 65535.00 /end CHARACTERISTIC
/begin CHARACTERISTIC DFC_DisblMsk.DFC_EGRVlvShTDrft_C "DFC/Abschalt Maske für Prüfung DFC_EGRVlvShTDrft" VALUE 0x800265B4 Val_Wu16 65535.00 DFES_OneToOne 0.00 65535.00 /end CHARACTERISTIC
/begin CHARACTERISTIC DFC_DisblMsk.DFC_EngICO_C "DFC/Abschalt Maske für Prüfung DFC_EngICO" VALUE 0x800265B6 Val_Wu16 65535.00 DFES_OneToOne 0.00 65535.00 /end CHARACTERISTIC
/begin CHARACTERISTIC DFC_DisblMsk.DFC_EpmCaSI1ErrSig_C "DFC/Abschalt Maske für Prüfung DFC_EpmCaSI1ErrSig" VALUE 0x800265B8 Val_Wu16 65535.00 DFES_OneToOne 0.00 65535.00 /end CHARACTERISTIC
/begin CHARACTERISTIC DFC_DisblMsk.DFC_EpmCaSI1NoSig_C "DFC/Abschalt Maske für Prüfung DFC_EpmCaSI1NoSig" VALUE 0x800265BA Val_Wu16 65535.00 DFES_OneToOne 0.00 65535.00 /end CHARACTERISTIC
/begin CHARACTERISTIC DFC_DisblMsk.DFC_EpmCaSI1OfsErr_C "DFC/Abschalt Maske für Prüfung DFC_EpmCaSI1OfsErr" VALUE 0x800265BC Val_Wu16 65535.00 DFES_OneToOne 0.00 65535.00 /end CHARACTERISTIC
/begin CHARACTERISTIC DFC_DisblMsk.DFC_EpmCrSErrSig_C "DFC/Abschalt Maske für Prüfung DFC_EpmCrSErrSig" VALUE 0x800265BE Val_Wu16 65535.00 DFES_OneToOne 0.00 65535.00 /end CHARACTERISTIC
/begin CHARACTERISTIC DFC_DisblMsk.DFC_EpmCrSNoSig_C "DFC/Abschalt Maske für Prüfung DFC_EpmCrSNoSig" VALUE 0x800265C0 Val_Wu16 65535.00 DFES_OneToOne 0.00 65535.00 /end CHARACTERISTIC
/begin CHARACTERISTIC DFC_DisblMsk.DFC_IVPlausComprTst_C "DFC/Abschalt Maske für Prüfung DFC_IVPlausComprTst" VALUE 0x800265C2 Val_Wu16 65535.00 DFES_OneToOne 0.00 65535.00 /end CHARACTERISTIC
/begin CHARACTERISTIC DFC_DisblMsk.DFC_IVPlausRunUpTst_C "DFC/Abschalt Maske für Prüfung DFC_IVPlausRunUpTst" VALUE 0x800265C4 Val_Wu16 65535.00 DFES_OneToOne 0.00 65535.00 /end CHARACTERISTIC
/begin CHARACTERISTIC DFC_DisblMsk.DFC_InjCrvShOffTst_C "DFC/Abschalt Maske für Prüfung DFC_InjCrvShOffTst" VALUE 0x800265C6 Val_Wu16 65535.00 DFES_OneToOne 0.00 65535.00 /end CHARACTERISTIC
/begin CHARACTERISTIC DFC_DisblMsk.DFC_LayerEnSavModProd_C "DFC/Abschalt Maske für Prüfung DFC_LayerEnSavModProd" VALUE 0x800265C8 Val_Wu16 65535.00 DFES_OneToOne 0.00 65535.00 /end CHARACTERISTIC
/begin CHARACTERISTIC DFC_DisblMsk.DFC_LayerEnSavModRep_C "DFC/Abschalt Maske für Prüfung DFC_LayerEnSavModRep" VALUE 0x800265CA Val_Wu16 65535.00 DFES_OneToOne 0.00 65535.00 /end CHARACTERISTIC
/begin CHARACTERISTIC DFC_DisblMsk.DFC_LayerEnSavModShip_C "DFC/Abschalt Maske für Prüfung DFC_LayerEnSavModShip" VALUE 0x800265CC Val_Wu16 65535.00 DFES_OneToOne 0.00 65535.00 /end CHARACTERISTIC
/begin CHARACTERISTIC DFC_DisblMsk.DFC_MRlyErlyOpng_C "DFC/Abschalt Maske für Prüfung DFC_MRlyErlyOpng" VALUE 0x800265CE Val_Wu16 65535.00 DFES_OneToOne 0.00 65535.00 /end CHARACTERISTIC
/begin CHARACTERISTIC DFC_DisblMsk.DFC_MRlyStk_C "DFC/Abschalt Maske für Prüfung DFC_MRlyStk" VALUE 0x800265D0 Val_Wu16 65535.00 DFES_OneToOne 0.00 65535.00 /end CHARACTERISTIC
/begin CHARACTERISTIC DFC_DisblMsk.DFC_MeUnActrTst_C "DFC/Abschalt Maske für Prüfung DFC_MeUnActrTst" VALUE 0x800265D2 Val_Wu16 65535.00 DFES_OneToOne 0.00 65535.00 /end CHARACTERISTIC
/begin CHARACTERISTIC DFC_DisblMsk.DFC_MoCADCCmp_C "DFC/Abschalt Maske für Prüfung DFC_MoCADCCmp" VALUE 0x800265D4 Val_Wu16 65535.00 DFES_OneToOne 0.00 65535.00 /end CHARACTERISTIC
/begin CHARACTERISTIC DFC_DisblMsk.DFC_MoCADCTst_C "DFC/Abschalt Maske für Prüfung DFC_MoCADCTst" VALUE 0x800265D6 Val_Wu16 65535.00 DFES_OneToOne 0.00 65535.00 /end CHARACTERISTIC
/begin CHARACTERISTIC DFC_DisblMsk.DFC_MoCADCVltgRatio_C "DFC/Abschalt Maske für Prüfung DFC_MoCADCVltgRatio" VALUE 0x800265D8 Val_Wu16 65535.00 DFES_OneToOne 0.00 65535.00 /end CHARACTERISTIC
/begin CHARACTERISTIC DFC_DisblMsk.DFC_MoCComErrCnt_C "DFC/Abschalt Maske für Prüfung DFC_MoCComErrCnt" VALUE 0x800265DA Val_Wu16 65535.00 DFES_OneToOne 0.00 65535.00 /end CHARACTERISTIC
/begin CHARACTERISTIC DFC_DisblMsk.DFC_MoCComSPI_C "DFC/Abschalt Maske für Prüfung DFC_MoCComSPI" VALUE 0x800265DC Val_Wu16 65535.00 DFES_OneToOne 0.00 65535.00 /end CHARACTERISTIC
/begin CHARACTERISTIC DFC_DisblMsk.DFC_MoCROMErrXPg_C "DFC/Abschalt Maske für Prüfung DFC_MoCROMErrXPg" VALUE 0x800265DE Val_Wu16 65535.00 DFES_OneToOne 0.00 65535.00 /end CHARACTERISTIC
/begin CHARACTERISTIC DFC_DisblMsk.DFC_MoCSOPHwNoRdy_C "DFC/Abschalt Maske für Prüfung DFC_MoCSOPHwNoRdy" VALUE 0x800265E0 Val_Wu16 65535.00 DFES_OneToOne 0.00 65535.00 /end CHARACTERISTIC
/begin CHARACTERISTIC DFC_DisblMsk.DFC_MoCSOPLoLi_C "DFC/Abschalt Maske für Prüfung DFC_MoCSOPLoLi" VALUE 0x800265E2 Val_Wu16 65535.00 DFES_OneToOne 0.00 65535.00 /end CHARACTERISTIC
/begin CHARACTERISTIC DFC_DisblMsk.DFC_MoCSOPMM_C "DFC/Abschalt Maske für Prüfung DFC_MoCSOPMM" VALUE 0x800265E4 Val_Wu16 65535.00 DFES_OneToOne 0.00 65535.00 /end CHARACTERISTIC
/begin CHARACTERISTIC DFC_DisblMsk.DFC_MoCSOPTimeOut_C "DFC/Abschalt Maske für Prüfung DFC_MoCSOPTimeOut" VALUE 0x800265E6 Val_Wu16 65535.00 DFES_OneToOne 0.00 65535.00 /end CHARACTERISTIC
/begin CHARACTERISTIC DFC_DisblMsk.DFC_MoCSOPUpLi_C "DFC/Abschalt Maske für Prüfung DFC_MoCSOPUpLi" VALUE 0x800265E8 Val_Wu16 65535.00 DFES_OneToOne 0.00 65535.00 /end CHARACTERISTIC
/begin CHARACTERISTIC DFC_DisblMsk.DFC_MoFAPP_C "DFC/Abschalt Maske für Prüfung DFC_MoFAPP" VALUE 0x800265EA Val_Wu16 65535.00 DFES_OneToOne 0.00 65535.00 /end CHARACTERISTIC
/begin CHARACTERISTIC DFC_DisblMsk.DFC_MoFESpd_C "DFC/Abschalt Maske für Prüfung DFC_MoFESpd" VALUE 0x800265EC Val_Wu16 65535.00 DFES_OneToOne 0.00 65535.00 /end CHARACTERISTIC
/begin CHARACTERISTIC DFC_DisblMsk.DFC_MoFInjDatPhi_C "DFC/Abschalt Maske für Prüfung DFC_MoFInjDatPhi" VALUE 0x800265EE Val_Wu16 65535.00 DFES_OneToOne 0.00 65535.00 /end CHARACTERISTIC
/begin CHARACTERISTIC DFC_DisblMsk.DFC_MoFInjDatQnt_C "DFC/Abschalt Maske für Prüfung DFC_MoFInjDatQnt" VALUE 0x800265F0 Val_Wu16 65535.00 DFES_OneToOne 0.00 65535.00 /end CHARACTERISTIC
/begin CHARACTERISTIC DFC_DisblMsk.DFC_MoFInjQnt_C "DFC/Abschalt Maske für Prüfung DFC_MoFInjQnt" VALUE 0x800265F2 Val_Wu16 65535.00 DFES_OneToOne 0.00 65535.00 /end CHARACTERISTIC
/begin CHARACTERISTIC DFC_DisblMsk.DFC_MoFMode1PoI1_C "DFC/Abschalt Maske für Prüfung DFC_MoFMode1PoI1" VALUE 0x800265F4 Val_Wu16 65535.00 DFES_OneToOne 0.00 65535.00 /end CHARACTERISTIC
/begin CHARACTERISTIC DFC_DisblMsk.DFC_MoFMode1PoI2_C "DFC/Abschalt Maske für Prüfung DFC_MoFMode1PoI2" VALUE 0x800265F6 Val_Wu16 65535.00 DFES_OneToOne 0.00 65535.00 /end CHARACTERISTIC
/begin CHARACTERISTIC DFC_DisblMsk.DFC_MoFMode2PoI1_C "DFC/Abschalt Maske für Prüfung DFC_MoFMode2PoI1" VALUE 0x800265F8 Val_Wu16 65535.00 DFES_OneToOne 0.00 65535.00 /end CHARACTERISTIC
/begin CHARACTERISTIC DFC_DisblMsk.DFC_MoFMode2PoI2_C "DFC/Abschalt Maske für Prüfung DFC_MoFMode2PoI2" VALUE 0x800265FA Val_Wu16 65535.00 DFES_OneToOne 0.00 65535.00 /end CHARACTERISTIC
/begin CHARACTERISTIC DFC_DisblMsk.DFC_MoFOvR_C "DFC/Abschalt Maske für Prüfung DFC_MoFOvR" VALUE 0x800265FC Val_Wu16 65535.00 DFES_OneToOne 0.00 65535.00 /end CHARACTERISTIC
/begin CHARACTERISTIC DFC_DisblMsk.DFC_MoFQntCor_C "DFC/Abschalt Maske für Prüfung DFC_MoFQntCor" VALUE 0x800265FE Val_Wu16 65535.00 DFES_OneToOne 0.00 65535.00 /end CHARACTERISTIC
/begin CHARACTERISTIC DFC_DisblMsk.DFC_MoFRailP_C "DFC/Abschalt Maske für Prüfung DFC_MoFRailP" VALUE 0x80026600 Val_Wu16 65535.00 DFES_OneToOne 0.00 65535.00 /end CHARACTERISTIC
/begin CHARACTERISTIC DFC_DisblMsk.DFC_MoFTrqCmp_C "DFC/Abschalt Maske für Prüfung DFC_MoFTrqCmp" VALUE 0x80026602 Val_Wu16 65535.00 DFES_OneToOne 0.00 65535.00 /end CHARACTERISTIC
/begin CHARACTERISTIC DFC_DisblMsk.DFC_NSCDsHtrSetP_C "DFC/Abschalt Maske für Prüfung DFC_NSCDsHtrSetP" VALUE 0x80026604 Val_Wu16 65535.00 DFES_OneToOne 0.00 65535.00 /end CHARACTERISTIC
/begin CHARACTERISTIC DFC_DisblMsk.DFC_NoCat2DsHtrSetP_C "DFC/Abschalt Maske für Prüfung DFC_NoCat2DsHtrSetP" VALUE 0x80026606 Val_Wu16 65535.00 DFES_OneToOne 0.00 65535.00 /end CHARACTERISTIC
/begin CHARACTERISTIC DFC_DisblMsk.DFC_PCVActrTst_C "DFC/Abschalt Maske für Prüfung DFC_PCVActrTst" VALUE 0x80026608 Val_Wu16 65535.00 DFES_OneToOne 0.00 65535.00 /end CHARACTERISTIC
/begin CHARACTERISTIC DFC_DisblMsk.DFC_PhyModNonMonMapNpl_C "DFC/Abschalt Maske für Prüfung DFC_PhyModNonMonMapNpl" VALUE 0x8002660A Val_Wu16 65535.00 DFES_OneToOne 0.00 65535.00 /end CHARACTERISTIC
/begin CHARACTERISTIC DFC_DisblMsk.DFC_RailHpTst_C "DFC/Abschalt Maske für Prüfung DFC_RailHpTst" VALUE 0x8002660C Val_Wu16 65535.00 DFES_OneToOne 0.00 65535.00 /end CHARACTERISTIC
/begin CHARACTERISTIC DFC_DisblMsk.DFC_RailPOfsTstMax_C "DFC/Abschalt Maske für Prüfung DFC_RailPOfsTstMax" VALUE 0x8002660E Val_Wu16 65535.00 DFES_OneToOne 0.00 65535.00 /end CHARACTERISTIC
/begin CHARACTERISTIC DFC_DisblMsk.DFC_RailPOfsTstMin_C "DFC/Abschalt Maske für Prüfung DFC_RailPOfsTstMin" VALUE 0x80026610 Val_Wu16 65535.00 DFES_OneToOne 0.00 65535.00 /end CHARACTERISTIC
/begin CHARACTERISTIC DFC_DisblMsk.DFC_SIA_E1max_C "DFC/Abschalt Maske für Prüfung DFC_SIA_E1max" VALUE 0x80026612 Val_Wu16 65535.00 DFES_OneToOne 0.00 65535.00 /end CHARACTERISTIC
/begin CHARACTERISTIC DFC_DisblMsk.DFC_SIA_E1min_C "DFC/Abschalt Maske für Prüfung DFC_SIA_E1min" VALUE 0x80026614 Val_Wu16 65535.00 DFES_OneToOne 0.00 65535.00 /end CHARACTERISTIC
/begin CHARACTERISTIC DFC_DisblMsk.DFC_SIA_E1npl_C "DFC/Abschalt Maske für Prüfung DFC_SIA_E1npl" VALUE 0x80026616 Val_Wu16 65535.00 DFES_OneToOne 0.00 65535.00 /end CHARACTERISTIC
/begin CHARACTERISTIC DFC_DisblMsk.DFC_SIA_E1sig_C "DFC/Abschalt Maske für Prüfung DFC_SIA_E1sig" VALUE 0x80026618 Val_Wu16 65535.00 DFES_OneToOne 0.00 65535.00 /end CHARACTERISTIC
/begin CHARACTERISTIC DFC_DisblMsk.DFC_SIA_E2max_C "DFC/Abschalt Maske für Prüfung DFC_SIA_E2max" VALUE 0x8002661A Val_Wu16 65535.00 DFES_OneToOne 0.00 65535.00 /end CHARACTERISTIC
/begin CHARACTERISTIC DFC_DisblMsk.DFC_SIA_E2min_C "DFC/Abschalt Maske für Prüfung DFC_SIA_E2min" VALUE 0x8002661C Val_Wu16 65535.00 DFES_OneToOne 0.00 65535.00 /end CHARACTERISTIC
/begin CHARACTERISTIC DFC_DisblMsk.DFC_SIA_E2npl_C "DFC/Abschalt Maske für Prüfung DFC_SIA_E2npl" VALUE 0x8002661E Val_Wu16 65535.00 DFES_OneToOne 0.00 65535.00 /end CHARACTERISTIC
/begin CHARACTERISTIC DFC_DisblMsk.DFC_SIA_E2sig_C "DFC/Abschalt Maske für Prüfung DFC_SIA_E2sig" VALUE 0x80026620 Val_Wu16 65535.00 DFES_OneToOne 0.00 65535.00 /end CHARACTERISTIC
/begin CHARACTERISTIC DFC_DisblMsk.DFC_SIA_E3max_C "DFC/Abschalt Maske für Prüfung DFC_SIA_E3max" VALUE 0x80026622 Val_Wu16 65535.00 DFES_OneToOne 0.00 65535.00 /end CHARACTERISTIC
/begin CHARACTERISTIC DFC_DisblMsk.DFC_SIA_E3min_C "DFC/Abschalt Maske für Prüfung DFC_SIA_E3min" VALUE 0x80026624 Val_Wu16 65535.00 DFES_OneToOne 0.00 65535.00 /end CHARACTERISTIC
/begin CHARACTERISTIC DFC_DisblMsk.DFC_SIA_E3npl_C "DFC/Abschalt Maske für Prüfung DFC_SIA_E3npl" VALUE 0x80026626 Val_Wu16 65535.00 DFES_OneToOne 0.00 65535.00 /end CHARACTERISTIC
/begin CHARACTERISTIC DFC_DisblMsk.DFC_SIA_E3sig_C "DFC/Abschalt Maske für Prüfung DFC_SIA_E3sig" VALUE 0x80026628 Val_Wu16 65535.00 DFES_OneToOne 0.00 65535.00 /end CHARACTERISTIC
/begin CHARACTERISTIC DFC_DisblMsk.DFC_SIA_E4max_C "DFC/Abschalt Maske für Prüfung DFC_SIA_E4max" VALUE 0x8002662A Val_Wu16 65535.00 DFES_OneToOne 0.00 65535.00 /end CHARACTERISTIC
/begin CHARACTERISTIC DFC_DisblMsk.DFC_SIA_E4min_C "DFC/Abschalt Maske für Prüfung DFC_SIA_E4min" VALUE 0x8002662C Val_Wu16 65535.00 DFES_OneToOne 0.00 65535.00 /end CHARACTERISTIC
/begin CHARACTERISTIC DFC_DisblMsk.DFC_SIA_E4npl_C "DFC/Abschalt Maske für Prüfung DFC_SIA_E4npl" VALUE 0x8002662E Val_Wu16 65535.00 DFES_OneToOne 0.00 65535.00 /end CHARACTERISTIC
/begin CHARACTERISTIC DFC_DisblMsk.DFC_SIA_E4sig_C "DFC/Abschalt Maske für Prüfung DFC_SIA_E4sig" VALUE 0x80026630 Val_Wu16 65535.00 DFES_OneToOne 0.00 65535.00 /end CHARACTERISTIC
/begin CHARACTERISTIC DFC_DisblMsk.DFC_SWReset_0_C "DFC/Abschalt Maske für Prüfung DFC_SWReset_0" VALUE 0x80026632 Val_Wu16 65535.00 DFES_OneToOne 0.00 65535.00 /end CHARACTERISTIC
/begin CHARACTERISTIC DFC_DisblMsk.DFC_SWReset_1_C "DFC/Abschalt Maske für Prüfung DFC_SWReset_1" VALUE 0x80026634 Val_Wu16 65535.00 DFES_OneToOne 0.00 65535.00 /end CHARACTERISTIC
/begin CHARACTERISTIC DFC_DisblMsk.DFC_SWReset_2_C "DFC/Abschalt Maske für Prüfung DFC_SWReset_2" VALUE 0x80026636 Val_Wu16 65535.00 DFES_OneToOne 0.00 65535.00 /end CHARACTERISTIC
/begin CHARACTERISTIC DFC_DisblMsk.DFC_ShtrAKKMax_C "DFC/Abschalt Maske für Prüfung DFC_ShtrAKKMax" VALUE 0x80026638 Val_Wu16 65535.00 DFES_OneToOne 0.00 65535.00 /end CHARACTERISTIC
/begin CHARACTERISTIC DFC_DisblMsk.DFC_ShtrAKKMin_C "DFC/Abschalt Maske für Prüfung DFC_ShtrAKKMin" VALUE 0x8002663A Val_Wu16 65535.00 DFES_OneToOne 0.00 65535.00 /end CHARACTERISTIC
/begin CHARACTERISTIC DFC_DisblMsk.DFC_ShtrAKKNpl_C "DFC/Abschalt Maske für Prüfung DFC_ShtrAKKNpl" VALUE 0x8002663C Val_Wu16 65535.00 DFES_OneToOne 0.00 65535.00 /end CHARACTERISTIC
/begin CHARACTERISTIC DFC_DisblMsk.DFC_ShtrPKKMax_C "DFC/Abschalt Maske für Prüfung DFC_ShtrPKKMax" VALUE 0x8002663E Val_Wu16 65535.00 DFES_OneToOne 0.00 65535.00 /end CHARACTERISTIC
/begin CHARACTERISTIC DFC_DisblMsk.DFC_StopCntTmr_C "DFC/Abschalt Maske für Prüfung DFC_StopCntTmr" VALUE 0x80026640 Val_Wu16 65535.00 DFES_OneToOne 0.00 65535.00 /end CHARACTERISTIC
/begin CHARACTERISTIC DFC_DisblMsk.DFC_ThrVlvMon_C "DFC/Abschalt Maske für Prüfung DFC_ThrVlvMon" VALUE 0x80026642 Val_Wu16 65535.00 DFES_OneToOne 0.00 65535.00 /end CHARACTERISTIC
/begin CHARACTERISTIC DFC_DisblMsk.DFC_VSwVlvJamVlv_C "DFC/Abschalt Maske für Prüfung DFC_VSwVlvJamVlv" VALUE 0x80026644 Val_Wu16 65535.00 DFES_OneToOne 0.00 65535.00 /end CHARACTERISTIC
/begin CHARACTERISTIC DFC_DisblMsk.DFC_VSwVlvLgTDrft_C "DFC/Abschalt Maske für Prüfung DFC_VSwVlvLgTDrft" VALUE 0x80026646 Val_Wu16 65535.00 DFES_OneToOne 0.00 65535.00 /end CHARACTERISTIC
/begin CHARACTERISTIC DFC_DisblMsk.DFC_VSwVlvOfsLrnJamVlv_C "DFC/Abschalt Maske für Prüfung DFC_VSwVlvOfsLrnJamVlv" VALUE 0x80026648 Val_Wu16 65535.00 DFES_OneToOne 0.00 65535.00 /end CHARACTERISTIC
/begin CHARACTERISTIC DFC_DisblMsk.DFC_VSwVlvOfsNeutr_C "DFC/Abschalt Maske für Prüfung DFC_VSwVlvOfsNeutr" VALUE 0x8002664A Val_Wu16 65535.00 DFES_OneToOne 0.00 65535.00 /end CHARACTERISTIC
/begin CHARACTERISTIC DFC_DisblMsk.DFC_VSwVlvShTDrft_C "DFC/Abschalt Maske für Prüfung DFC_VSwVlvShTDrft" VALUE 0x8002664C Val_Wu16 65535.00 DFES_OneToOne 0.00 65535.00 /end CHARACTERISTIC
/begin CHARACTERISTIC DFC_DisblMsk.DFC_VSwVlvSpgDef_C "DFC/Abschalt Maske für Prüfung DFC_VSwVlvSpgDef" VALUE 0x8002664E Val_Wu16 65535.00 DFES_OneToOne 0.00 65535.00 /end CHARACTERISTIC
/begin CHARACTERISTIC DFES_Cls.DFC_Unused_C "DFES/intern benötigter Parameter für nicht existierende Fehlerprüfung DFC_Unused" VALUE 0x8002346E Val_Wu8 29.00 DFES_OneToOne 0.00 29.00 EXTENDED_LIMITS 0.00 255.0 READ_ONLY /end CHARACTERISTIC
/begin CHARACTERISTIC DFES_Cls.DFC_ACCIPlausDrvAst_C "DFES/Fehlerklasse für Prüfung DFC_ACCIPlausDrvAst" VALUE 0x8002346F Val_Wu8 29.00 DFES_OneToOne 0.00 29.00 EXTENDED_LIMITS 0.00 255.0 /end CHARACTERISTIC
/begin CHARACTERISTIC DFES_Cls.DFC_ACCIPlausTrqDes_C "DFES/Fehlerklasse für Prüfung DFC_ACCIPlausTrqDes" VALUE 0x80023470 Val_Wu8 29.00 DFES_OneToOne 0.00 29.00 EXTENDED_LIMITS 0.00 255.0 /end CHARACTERISTIC
/begin CHARACTERISTIC DFES_Cls.DFC_AirCtlGovDvtEOMMax_C "DFES/Fehlerklasse für Prüfung DFC_AirCtlGovDvtEOMMax" VALUE 0x80023471 Val_Wu8 29.00 DFES_OneToOne 0.00 29.00 EXTENDED_LIMITS 0.00 255.0 /end CHARACTERISTIC
/begin CHARACTERISTIC DFES_Cls.DFC_AirCtlGovDvtEOMMin_C "DFES/Fehlerklasse für Prüfung DFC_AirCtlGovDvtEOMMin" VALUE 0x80023472 Val_Wu8 29.00 DFES_OneToOne 0.00 29.00 EXTENDED_LIMITS 0.00 255.0 /end CHARACTERISTIC
/begin CHARACTERISTIC DFES_Cls.DFC_AirCtlGovDvtMax_C "DFES/Fehlerklasse für Prüfung DFC_AirCtlGovDvtMax" VALUE 0x80023473 Val_Wu8 29.00 DFES_OneToOne 0.00 29.00 EXTENDED_LIMITS 0.00 255.0 /end CHARACTERISTIC
/begin CHARACTERISTIC DFES_Cls.DFC_AirCtlGovDvtMin_C "DFES/Fehlerklasse für Prüfung DFC_AirCtlGovDvtMin" VALUE 0x80023474 Val_Wu8 29.00 DFES_OneToOne 0.00 29.00 EXTENDED_LIMITS 0.00 255.0 /end CHARACTERISTIC
/begin CHARACTERISTIC DFES_Cls.DFC_AirCtlGovLPDvtMax_C "DFES/Fehlerklasse für Prüfung DFC_AirCtlGovLPDvtMax" VALUE 0x80023475 Val_Wu8 29.00 DFES_OneToOne 0.00 29.00 EXTENDED_LIMITS 0.00 255.0 /end CHARACTERISTIC
/begin CHARACTERISTIC DFES_Cls.DFC_AirCtlGovLPDvtMin_C "DFES/Fehlerklasse für Prüfung DFC_AirCtlGovLPDvtMin" VALUE 0x80023476 Val_Wu8 29.00 DFES_OneToOne 0.00 29.00 EXTENDED_LIMITS 0.00 255.0 /end CHARACTERISTIC
/begin CHARACTERISTIC DFES_Cls.DFC_AltIOComErr_C "DFES/Fehlerklasse für Prüfung DFC_AltIOComErr" VALUE 0x80023477 Val_Wu8 29.00 DFES_OneToOne 0.00 29.00 EXTENDED_LIMITS 0.00 255.0 /end CHARACTERISTIC
/begin CHARACTERISTIC DFES_Cls.DFC_AltIOComNpl_C "DFES/Fehlerklasse für Prüfung DFC_AltIOComNpl" VALUE 0x80023478 Val_Wu8 29.00 DFES_OneToOne 0.00 29.00 EXTENDED_LIMITS 0.00 255.0 /end CHARACTERISTIC
/begin CHARACTERISTIC DFES_Cls.DFC_BusDiagBusOffFlexRay_C "DFES/" VALUE 0x80023479 Val_Wu8 29.00 DFES_OneToOne 0.00 29.00 EXTENDED_LIMITS 0.00 255.0 /end CHARACTERISTIC
/begin CHARACTERISTIC DFES_Cls.DFC_BusDiagBusOffNodeA_C "DFES/Fehlerklasse für Prüfung DFC_BusDiagBusOffNodeA" VALUE 0x8002347A Val_Wu8 29.00 DFES_OneToOne 0.00 29.00 EXTENDED_LIMITS 0.00 255.0 /end CHARACTERISTIC
/begin CHARACTERISTIC DFES_Cls.DFC_BusDiagBusOffNodeB_C "DFES/Fehlerklasse für Prüfung DFC_BusDiagBusOffNodeB" VALUE 0x8002347B Val_Wu8 29.00 DFES_OneToOne 0.00 29.00 EXTENDED_LIMITS 0.00 255.0 /end CHARACTERISTIC
/begin CHARACTERISTIC DFES_Cls.DFC_BusDiagBusOffNodeC_C "DFES/Fehlerklasse für Prüfung DFC_BusDiagBusOffNodeC" VALUE 0x8002347C Val_Wu8 29.00 DFES_OneToOne 0.00 29.00 EXTENDED_LIMITS 0.00 255.0 /end CHARACTERISTIC
/begin CHARACTERISTIC DFES_Cls.DFC_BusDiagHwFlexRay_C "DFES/" VALUE 0x8002347D Val_Wu8 29.00 DFES_OneToOne 0.00 29.00 EXTENDED_LIMITS 0.00 255.0 /end CHARACTERISTIC
/begin CHARACTERISTIC DFES_Cls.DFC_Cj945SpiCom1_C "DFES/Fehlerklasse für Prüfung DFC_Cj945SpiCom1" VALUE 0x8002347E Val_Wu8 29.00 DFES_OneToOne 0.00 29.00 EXTENDED_LIMITS 0.00 255.0 /end CHARACTERISTIC
/begin CHARACTERISTIC DFES_Cls.DFC_ComACDemandSig_FA_C "DFES/Fehlerklasse für Prüfung DFC_ComACDemandSig_FA" VALUE 0x8002347F Val_Wu8 29.00 DFES_OneToOne 0.00 29.00 EXTENDED_LIMITS 0.00 255.0 /end CHARACTERISTIC
/begin CHARACTERISTIC DFES_Cls.DFC_ComACDemandTo_FA_C "DFES/Fehlerklasse für Prüfung DFC_ComACDemandTo_FA" VALUE 0x80023480 Val_Wu8 29.00 DFES_OneToOne 0.00 29.00 EXTENDED_LIMITS 0.00 255.0 /end CHARACTERISTIC
/begin CHARACTERISTIC DFES_Cls.DFC_ComATempSig_FA_C "DFES/Fehlerklasse für Prüfung DFC_ComATempSig_FA" VALUE 0x80023481 Val_Wu8 29.00 DFES_OneToOne 0.00 29.00 EXTENDED_LIMITS 0.00 255.0 /end CHARACTERISTIC
/begin CHARACTERISTIC DFES_Cls.DFC_ComATempTo_FA_C "DFES/Fehlerklasse für Prüfung DFC_ComATempTo_FA" VALUE 0x80023482 Val_Wu8 29.00 DFES_OneToOne 0.00 29.00 EXTENDED_LIMITS 0.00 255.0 /end CHARACTERISTIC
/begin CHARACTERISTIC DFES_Cls.DFC_ComATempTo_FX_C "DFES/Fehlerklasse für Prüfung DFC_ComATempTo_FX" VALUE 0x80023483 Val_Wu8 29.00 DFES_OneToOne 0.00 29.00 EXTENDED_LIMITS 0.00 255.0 /end CHARACTERISTIC
/begin CHARACTERISTIC DFES_Cls.DFC_ComBrkTrqSumChk_FX_C "DFES/Fehlerklasse für Prüfung DFC_ComBrkTrqSumChk_FX" VALUE 0x80023484 Val_Wu8 29.00 DFES_OneToOne 0.00 29.00 EXTENDED_LIMITS 0.00 255.0 /end CHARACTERISTIC
/begin CHARACTERISTIC DFES_Cls.DFC_ComBrkTrqSumCtr_FX_C "DFES/Fehlerklasse für Prüfung DFC_ComBrkTrqSumCtr_FX" VALUE 0x80023485 Val_Wu8 29.00 DFES_OneToOne 0.00 29.00 EXTENDED_LIMITS 0.00 255.0 /end CHARACTERISTIC
/begin CHARACTERISTIC DFES_Cls.DFC_ComBrkTrqSumTo_FX_C "DFES/Fehlerklasse für Prüfung DFC_ComBrkTrqSumTo_FX" VALUE 0x80023486 Val_Wu8 29.00 DFES_OneToOne 0.00 29.00 EXTENDED_LIMITS 0.00 255.0 /end CHARACTERISTIC
/begin CHARACTERISTIC DFES_Cls.DFC_ComBtnDrvDynChk_FX_C "DFES/Fehlerklasse für Prüfung DFC_ComBtnDrvDynChk_FX" VALUE 0x80023487 Val_Wu8 29.00 DFES_OneToOne 0.00 29.00 EXTENDED_LIMITS 0.00 255.0 /end CHARACTERISTIC
/begin CHARACTERISTIC DFES_Cls.DFC_ComBtnDrvDynCtr_FX_C "DFES/Fehlerklasse für Prüfung DFC_ComBtnDrvDynCtr_FX" VALUE 0x80023488 Val_Wu8 29.00 DFES_OneToOne 0.00 29.00 EXTENDED_LIMITS 0.00 255.0 /end CHARACTERISTIC
/begin CHARACTERISTIC DFES_Cls.DFC_ComBtnDrvDynTo_FX_C "DFES/Fehlerklasse für Prüfung DFC_ComBtnDrvDynTo_FX" VALUE 0x80023489 Val_Wu8 29.00 DFES_OneToOne 0.00 29.00 EXTENDED_LIMITS 0.00 255.0 /end CHARACTERISTIC
/begin CHARACTERISTIC DFES_Cls.DFC_ComButtonMSASig_C "DFES/Fehlerklasse für Prüfung DFC_ComButtonMSASig" VALUE 0x8002348A Val_Wu8 29.00 DFES_OneToOne 0.00 29.00 EXTENDED_LIMITS 0.00 255.0 /end CHARACTERISTIC
/begin CHARACTERISTIC DFES_Cls.DFC_ComButtonMSATo_C "DFES/Fehlerklasse für Prüfung DFC_ComButtonMSATo" VALUE 0x8002348B Val_Wu8 29.00 DFES_OneToOne 0.00 29.00 EXTENDED_LIMITS 0.00 255.0 /end CHARACTERISTIC
/begin CHARACTERISTIC DFES_Cls.DFC_ComCodierungPwrmngSig_C "DFES/Fehlerklasse für Prüfung DFC_ComCodierungPwrmngSig" VALUE 0x8002348C Val_Wu8 29.00 DFES_OneToOne 0.00 29.00 EXTENDED_LIMITS 0.00 255.0 /end CHARACTERISTIC
/begin CHARACTERISTIC DFES_Cls.DFC_ComCodierungPwrmngSig_FA_C "DFES/Fehlerklasse für Prüfung DFC_ComCodierungPwrmngSig_FA" VALUE 0x8002348D Val_Wu8 29.00 DFES_OneToOne 0.00 29.00 EXTENDED_LIMITS 0.00 255.0 /end CHARACTERISTIC
/begin CHARACTERISTIC DFES_Cls.DFC_ComCrCtlLvrChk_C "DFES/Fehlerklasse für Prüfung DFC_ComCrCtlLvrChk" VALUE 0x8002348E Val_Wu8 29.00 DFES_OneToOne 0.00 29.00 EXTENDED_LIMITS 0.00 255.0 /end CHARACTERISTIC
/begin CHARACTERISTIC DFES_Cls.DFC_ComCrCtlLvrCtr_C "DFES/Fehlerklasse für Prüfung DFC_ComCrCtlLvrCtr" VALUE 0x8002348F Val_Wu8 29.00 DFES_OneToOne 0.00 29.00 EXTENDED_LIMITS 0.00 255.0 /end CHARACTERISTIC
/begin CHARACTERISTIC DFES_Cls.DFC_ComCrCtlLvrSig_C "DFES/Fehlerklasse für Prüfung DFC_ComCrCtlLvrSig" VALUE 0x80023490 Val_Wu8 29.00 DFES_OneToOne 0.00 29.00 EXTENDED_LIMITS 0.00 255.0 /end CHARACTERISTIC
/begin CHARACTERISTIC DFES_Cls.DFC_ComCrCtlLvrTo_C "DFES/Fehlerklasse für Prüfung DFC_ComCrCtlLvrTo" VALUE 0x80023491 Val_Wu8 29.00 DFES_OneToOne 0.00 29.00 EXTENDED_LIMITS 0.00 255.0 /end CHARACTERISTIC
/begin CHARACTERISTIC DFES_Cls.DFC_ComCtrCrshSwoEkpSig_FA_C "DFES/Fehlerklasse für Prüfung DFC_ComCtrCrshSwoEkpSig_FA" VALUE 0x80023492 Val_Wu8 29.00 DFES_OneToOne 0.00 29.00 EXTENDED_LIMITS 0.00 255.0 /end CHARACTERISTIC
/begin CHARACTERISTIC DFES_Cls.DFC_ComCtrCrshSwoEkpTo_FA_C "DFES/Fehlerklasse für Prüfung DFC_ComCtrCrshSwoEkpTo_FA" VALUE 0x80023493 Val_Wu8 29.00 DFES_OneToOne 0.00 29.00 EXTENDED_LIMITS 0.00 255.0 /end CHARACTERISTIC
/begin CHARACTERISTIC DFES_Cls.DFC_ComCtrSecInt_C "DFES/Fehlerklasse für Prüfung DFC_ComCtrSecInt" VALUE 0x80023494 Val_Wu8 29.00 DFES_OneToOne 0.00 29.00 EXTENDED_LIMITS 0.00 255.0 /end CHARACTERISTIC
/begin CHARACTERISTIC DFES_Cls.DFC_ComDiaOBDGbxSig_A_C "DFES/Fehlerklasse für Prüfung DFC_ComDiaOBDGbxSig_A" VALUE 0x80023495 Val_Wu8 29.00 DFES_OneToOne 0.00 29.00 EXTENDED_LIMITS 0.00 255.0 /end CHARACTERISTIC
/begin CHARACTERISTIC DFES_Cls.DFC_ComDiaOBDGbxTo_A_C "DFES/Fehlerklasse für Prüfung DFC_ComDiaOBDGbxTo_A" VALUE 0x80023496 Val_Wu8 29.00 DFES_OneToOne 0.00 29.00 EXTENDED_LIMITS 0.00 255.0 /end CHARACTERISTIC
/begin CHARACTERISTIC DFES_Cls.DFC_ComFahrzeugtypSig_C "DFES/Fehlerklasse für Prüfung DFC_ComFahrzeugtypSig" VALUE 0x80023497 Val_Wu8 29.00 DFES_OneToOne 0.00 29.00 EXTENDED_LIMITS 0.00 255.0 /end CHARACTERISTIC
/begin CHARACTERISTIC DFES_Cls.DFC_ComFahrzeugtypSig_FA_C "DFES/Fehlerklasse für Prüfung DFC_ComFahrzeugtypSig_FA" VALUE 0x80023498 Val_Wu8 29.00 DFES_OneToOne 0.00 29.00 EXTENDED_LIMITS 0.00 255.0 /end CHARACTERISTIC
/begin CHARACTERISTIC DFES_Cls.DFC_ComFllupGpwsupSig_FA_C "DFES/Fehlerklasse für Prüfung DFC_ComFllupGpwsupSig_FA" VALUE 0x80023499 Val_Wu8 29.00 DFES_OneToOne 0.00 29.00 EXTENDED_LIMITS 0.00 255.0 /end CHARACTERISTIC
/begin CHARACTERISTIC DFES_Cls.DFC_ComFllupGpwsupTo_FA_C "DFES/Fehlerklasse für Prüfung DFC_ComFllupGpwsupTo_FA" VALUE 0x8002349A Val_Wu8 29.00 DFES_OneToOne 0.00 29.00 EXTENDED_LIMITS 0.00 255.0 /end CHARACTERISTIC
/begin CHARACTERISTIC DFES_Cls.DFC_ComGbxDataChk_A_C "DFES/Fehlerklasse für Prüfung DFC_ComGbxDataChk_A" VALUE 0x8002349B Val_Wu8 29.00 DFES_OneToOne 0.00 29.00 EXTENDED_LIMITS 0.00 255.0 /end CHARACTERISTIC
/begin CHARACTERISTIC DFES_Cls.DFC_ComGbxDataChk_FA_C "DFES/Fehlerklasse für Prüfung DFC_ComGbxDataChk_FA" VALUE 0x8002349C Val_Wu8 29.00 DFES_OneToOne 0.00 29.00 EXTENDED_LIMITS 0.00 255.0 /end CHARACTERISTIC
/begin CHARACTERISTIC DFES_Cls.DFC_ComGbxDataCtr_A_C "DFES/Fehlerklasse für Prüfung DFC_ComGbxDataCtr_A" VALUE 0x8002349D Val_Wu8 29.00 DFES_OneToOne 0.00 29.00 EXTENDED_LIMITS 0.00 255.0 /end CHARACTERISTIC
/begin CHARACTERISTIC DFES_Cls.DFC_ComGbxDataCtr_FA_C "DFES/Fehlerklasse für Prüfung DFC_ComGbxDataCtr_FA" VALUE 0x8002349E Val_Wu8 29.00 DFES_OneToOne 0.00 29.00 EXTENDED_LIMITS 0.00 255.0 /end CHARACTERISTIC
/begin CHARACTERISTIC DFES_Cls.DFC_ComGbxDataSig_A_C "DFES/Fehlerklasse für Prüfung DFC_ComGbxDataSig_A" VALUE 0x8002349F Val_Wu8 29.00 DFES_OneToOne 0.00 29.00 EXTENDED_LIMITS 0.00 255.0 /end CHARACTERISTIC
/begin CHARACTERISTIC DFES_Cls.DFC_ComGbxDataSig_FA_C "DFES/Fehlerklasse für Prüfung DFC_ComGbxDataSig_FA" VALUE 0x800234A0 Val_Wu8 29.00 DFES_OneToOne 0.00 29.00 EXTENDED_LIMITS 0.00 255.0 /end CHARACTERISTIC
/begin CHARACTERISTIC DFES_Cls.DFC_ComGbxDataTo_A_C "DFES/Fehlerklasse für Prüfung DFC_ComGbxDataTo_A" VALUE 0x800234A1 Val_Wu8 29.00 DFES_OneToOne 0.00 29.00 EXTENDED_LIMITS 0.00 255.0 /end CHARACTERISTIC
/begin CHARACTERISTIC DFES_Cls.DFC_ComGbxDataTo_FA_C "DFES/Fehlerklasse für Prüfung DFC_ComGbxDataTo_FA" VALUE 0x800234A2 Val_Wu8 29.00 DFES_OneToOne 0.00 29.00 EXTENDED_LIMITS 0.00 255.0 /end CHARACTERISTIC
/begin CHARACTERISTIC DFES_Cls.DFC_ComKlemmenChk_FA_C "DFES/Fehlerklasse für Prüfung DFC_ComKlemmenChk_FA" VALUE 0x800234A3 Val_Wu8 29.00 DFES_OneToOne 0.00 29.00 EXTENDED_LIMITS 0.00 255.0 /end CHARACTERISTIC
/begin CHARACTERISTIC DFES_Cls.DFC_ComKlemmenCtr_FA_C "DFES/Fehlerklasse für Prüfung DFC_ComKlemmenCtr_FA" VALUE 0x800234A4 Val_Wu8 29.00 DFES_OneToOne 0.00 29.00 EXTENDED_LIMITS 0.00 255.0 /end CHARACTERISTIC
/begin CHARACTERISTIC DFES_Cls.DFC_ComKlemmenSig_FA_C "DFES/Fehlerklasse für Prüfung DFC_ComKlemmenSig_FA" VALUE 0x800234A5 Val_Wu8 29.00 DFES_OneToOne 0.00 29.00 EXTENDED_LIMITS 0.00 255.0 /end CHARACTERISTIC
/begin CHARACTERISTIC DFES_Cls.DFC_ComKlemmenTo_FA_C "DFES/Fehlerklasse für Prüfung DFC_ComKlemmenTo_FA" VALUE 0x800234A6 Val_Wu8 29.00 DFES_OneToOne 0.00 29.00 EXTENDED_LIMITS 0.00 255.0 /end CHARACTERISTIC
/begin CHARACTERISTIC DFES_Cls.DFC_ComLenkradwinkelSig_C "DFES/Fehlerklasse für Prüfung DFC_ComLenkradwinkelSig" VALUE 0x800234A7 Val_Wu8 29.00 DFES_OneToOne 0.00 29.00 EXTENDED_LIMITS 0.00 255.0 /end CHARACTERISTIC
/begin CHARACTERISTIC DFES_Cls.DFC_ComLenkradwinkelTo_C "DFES/Fehlerklasse für Prüfung DFC_ComLenkradwinkelTo" VALUE 0x800234A8 Val_Wu8 29.00 DFES_OneToOne 0.00 29.00 EXTENDED_LIMITS 0.00 255.0 /end CHARACTERISTIC
/begin CHARACTERISTIC DFES_Cls.DFC_ComMileageRangeSig_FA_C "DFES/Fehlerklasse für Prüfung DFC_ComMileageRangeSig_FA" VALUE 0x800234A9 Val_Wu8 29.00 DFES_OneToOne 0.00 29.00 EXTENDED_LIMITS 0.00 255.0 /end CHARACTERISTIC
/begin CHARACTERISTIC DFES_Cls.DFC_ComMileageRangeTo_FA_C "DFES/Fehlerklasse für Prüfung DFC_ComMileageRangeTo_FA" VALUE 0x800234AA Val_Wu8 29.00 DFES_OneToOne 0.00 29.00 EXTENDED_LIMITS 0.00 255.0 /end CHARACTERISTIC
/begin CHARACTERISTIC DFES_Cls.DFC_ComPspSig_C "DFES/Fehlerklasse für Prüfung DFC_ComPspSig" VALUE 0x800234AB Val_Wu8 29.00 DFES_OneToOne 0.00 29.00 EXTENDED_LIMITS 0.00 255.0 /end CHARACTERISTIC
/begin CHARACTERISTIC DFES_Cls.DFC_ComPspTo_C "DFES/Fehlerklasse für Prüfung DFC_ComPspTo" VALUE 0x800234AC Val_Wu8 29.00 DFES_OneToOne 0.00 29.00 EXTENDED_LIMITS 0.00 255.0 /end CHARACTERISTIC
/begin CHARACTERISTIC DFES_Cls.DFC_ComRelTimeSig_FA_C "DFES/Fehlerklasse für Prüfung DFC_ComRelTimeSig_FA" VALUE 0x800234AD Val_Wu8 29.00 DFES_OneToOne 0.00 29.00 EXTENDED_LIMITS 0.00 255.0 /end CHARACTERISTIC
/begin CHARACTERISTIC DFES_Cls.DFC_ComRelTimeTo_FA_C "DFES/Fehlerklasse für Prüfung DFC_ComRelTimeTo_FA" VALUE 0x800234AE Val_Wu8 29.00 DFES_OneToOne 0.00 29.00 EXTENDED_LIMITS 0.00 255.0 /end CHARACTERISTIC
/begin CHARACTERISTIC DFES_Cls.DFC_ComRequestEMFChk_C "DFES/Fehlerklasse für Prüfung DFC_ComRequestEMFChk" VALUE 0x800234AF Val_Wu8 29.00 DFES_OneToOne 0.00 29.00 EXTENDED_LIMITS 0.00 255.0 /end CHARACTERISTIC
/begin CHARACTERISTIC DFES_Cls.DFC_ComRequestEMFCtr_C "DFES/Fehlerklasse für Prüfung DFC_ComRequestEMFCtr" VALUE 0x800234B0 Val_Wu8 29.00 DFES_OneToOne 0.00 29.00 EXTENDED_LIMITS 0.00 255.0 /end CHARACTERISTIC
/begin CHARACTERISTIC DFES_Cls.DFC_ComRequestEMFSig_C "DFES/Fehlerklasse für Prüfung DFC_ComRequestEMFSig" VALUE 0x800234B1 Val_Wu8 29.00 DFES_OneToOne 0.00 29.00 EXTENDED_LIMITS 0.00 255.0 /end CHARACTERISTIC
/begin CHARACTERISTIC DFES_Cls.DFC_ComRequestEMFTo_C "DFES/Fehlerklasse für Prüfung DFC_ComRequestEMFTo" VALUE 0x800234B2 Val_Wu8 29.00 DFES_OneToOne 0.00 29.00 EXTENDED_LIMITS 0.00 255.0 /end CHARACTERISTIC
/begin CHARACTERISTIC DFES_Cls.DFC_ComRpmWhlChk_FX_C "DFES/Fehlerklasse für Prüfung DFC_ComRpmWhlChk_FX" VALUE 0x800234B3 Val_Wu8 29.00 DFES_OneToOne 0.00 29.00 EXTENDED_LIMITS 0.00 255.0 /end CHARACTERISTIC
/begin CHARACTERISTIC DFES_Cls.DFC_ComRpmWhlCtr_FX_C "DFES/Fehlerklasse für Prüfung DFC_ComRpmWhlCtr_FX" VALUE 0x800234B4 Val_Wu8 29.00 DFES_OneToOne 0.00 29.00 EXTENDED_LIMITS 0.00 255.0 /end CHARACTERISTIC
/begin CHARACTERISTIC DFES_Cls.DFC_ComRpmWhlTo_FX_C "DFES/Fehlerklasse für Prüfung DFC_ComRpmWhlTo_FX" VALUE 0x800234B5 Val_Wu8 29.00 DFES_OneToOne 0.00 29.00 EXTENDED_LIMITS 0.00 255.0 /end CHARACTERISTIC
/begin CHARACTERISTIC DFES_Cls.DFC_ComSecCtrRelSig_FA_C "DFES/Fehlerklasse für Prüfung DFC_ComSecCtrRelSig_FA" VALUE 0x800234B6 Val_Wu8 29.00 DFES_OneToOne 0.00 29.00 EXTENDED_LIMITS 0.00 255.0 /end CHARACTERISTIC
/begin CHARACTERISTIC DFES_Cls.DFC_ComSecCtrRelTo_FA_C "DFES/Fehlerklasse für Prüfung DFC_ComSecCtrRelTo_FA" VALUE 0x800234B7 Val_Wu8 29.00 DFES_OneToOne 0.00 29.00 EXTENDED_LIMITS 0.00 255.0 /end CHARACTERISTIC
/begin CHARACTERISTIC DFES_Cls.DFC_ComSensNOxGndSig_C "DFES/Fehlerklasse für Prüfung DFC_ComSensNOxGndSig" VALUE 0x800234B8 Val_Wu8 29.00 DFES_OneToOne 0.00 29.00 EXTENDED_LIMITS 0.00 255.0 /end CHARACTERISTIC
/begin CHARACTERISTIC DFES_Cls.DFC_ComSensNOxGndTo_C "DFES/Fehlerklasse für Prüfung DFC_ComSensNOxGndTo" VALUE 0x800234B9 Val_Wu8 29.00 DFES_OneToOne 0.00 29.00 EXTENDED_LIMITS 0.00 255.0 /end CHARACTERISTIC
/begin CHARACTERISTIC DFES_Cls.DFC_ComSensNOxMode_C "DFES/Fehlerklasse für Prüfung DFC_ComSensNOxMode" VALUE 0x800234BA Val_Wu8 29.00 DFES_OneToOne 0.00 29.00 EXTENDED_LIMITS 0.00 255.0 /end CHARACTERISTIC
/begin CHARACTERISTIC DFES_Cls.DFC_ComSensNOxUbattSig_C "DFES/Fehlerklasse für Prüfung DFC_ComSensNOxUbattSig" VALUE 0x800234BB Val_Wu8 29.00 DFES_OneToOne 0.00 29.00 EXTENDED_LIMITS 0.00 255.0 /end CHARACTERISTIC
/begin CHARACTERISTIC DFES_Cls.DFC_ComSensNOxUbattTo_C "DFES/Fehlerklasse für Prüfung DFC_ComSensNOxUbattTo" VALUE 0x800234BC Val_Wu8 29.00 DFES_OneToOne 0.00 29.00 EXTENDED_LIMITS 0.00 255.0 /end CHARACTERISTIC
/begin CHARACTERISTIC DFES_Cls.DFC_ComShiftPaddleTo_FX_C "DFES/Fehlerklasse für Prüfung DFC_ComShiftPaddleTo_FX" VALUE 0x800234BD Val_Wu8 29.00 DFES_OneToOne 0.00 29.00 EXTENDED_LIMITS 0.00 255.0 /end CHARACTERISTIC
/begin CHARACTERISTIC DFES_Cls.DFC_ComShutOffPSPSig_C "DFES/Fehlerklasse für Prüfung DFC_ComShutOffPSPSig" VALUE 0x800234BE Val_Wu8 29.00 DFES_OneToOne 0.00 29.00 EXTENDED_LIMITS 0.00 255.0 /end CHARACTERISTIC
/begin CHARACTERISTIC DFES_Cls.DFC_ComShutOffPSPTo_C "DFES/Fehlerklasse für Prüfung DFC_ComShutOffPSPTo" VALUE 0x800234BF Val_Wu8 29.00 DFES_OneToOne 0.00 29.00 EXTENDED_LIMITS 0.00 255.0 /end CHARACTERISTIC
/begin CHARACTERISTIC DFES_Cls.DFC_ComSlrdiGlbFZMTo_FA_C "DFES/Fehlerklasse für Prüfung DFC_ComSlrdiGlbFZMTo_FA" VALUE 0x800234C0 Val_Wu8 29.00 DFES_OneToOne 0.00 29.00 EXTENDED_LIMITS 0.00 255.0 /end CHARACTERISTIC
/begin CHARACTERISTIC DFES_Cls.DFC_ComSlrdiGlbFZMTo_FX_C "DFES/Fehlerklasse für Prüfung DFC_ComSlrdiGlbFZMTo_FX" VALUE 0x800234C1 Val_Wu8 29.00 DFES_OneToOne 0.00 29.00 EXTENDED_LIMITS 0.00 255.0 /end CHARACTERISTIC
/begin CHARACTERISTIC DFES_Cls.DFC_ComSpeedVehicleChk_FX_C "DFES/Fehlerklasse für Prüfung DFC_ComSpeedVehicleChk_FX" VALUE 0x800234C2 Val_Wu8 29.00 DFES_OneToOne 0.00 29.00 EXTENDED_LIMITS 0.00 255.0 /end CHARACTERISTIC
/begin CHARACTERISTIC DFES_Cls.DFC_ComSpeedVehicleCtr_FX_C "DFES/Fehlerklasse für Prüfung DFC_ComSpeedVehicleCtr_FX" VALUE 0x800234C3 Val_Wu8 29.00 DFES_OneToOne 0.00 29.00 EXTENDED_LIMITS 0.00 255.0 /end CHARACTERISTIC
/begin CHARACTERISTIC DFES_Cls.DFC_ComSpeedVehicleTo_FX_C "DFES/Fehlerklasse für Prüfung DFC_ComSpeedVehicleTo_FX" VALUE 0x800234C4 Val_Wu8 29.00 DFES_OneToOne 0.00 29.00 EXTENDED_LIMITS 0.00 255.0 /end CHARACTERISTIC
/begin CHARACTERISTIC DFES_Cls.DFC_ComStConintDSCChk_FX_C "DFES/Fehlerklasse für Prüfung DFC_ComStConintDSCChk_FX" VALUE 0x800234C5 Val_Wu8 29.00 DFES_OneToOne 0.00 29.00 EXTENDED_LIMITS 0.00 255.0 /end CHARACTERISTIC
/begin CHARACTERISTIC DFES_Cls.DFC_ComStConintDSCCtr_FX_C "DFES/Fehlerklasse für Prüfung DFC_ComStConintDSCCtr_FX" VALUE 0x800234C6 Val_Wu8 29.00 DFES_OneToOne 0.00 29.00 EXTENDED_LIMITS 0.00 255.0 /end CHARACTERISTIC
/begin CHARACTERISTIC DFES_Cls.DFC_ComStConintDSCTo_FX_C "DFES/Fehlerklasse für Prüfung DFC_ComStConintDSCTo_FX" VALUE 0x800234C7 Val_Wu8 29.00 DFES_OneToOne 0.00 29.00 EXTENDED_LIMITS 0.00 255.0 /end CHARACTERISTIC
/begin CHARACTERISTIC DFES_Cls.DFC_ComStatACFrontSig_FA_C "DFES/Fehlerklasse für Prüfung DFC_ComStatACFrontSig_FA" VALUE 0x800234C8 Val_Wu8 29.00 DFES_OneToOne 0.00 29.00 EXTENDED_LIMITS 0.00 255.0 /end CHARACTERISTIC
/begin CHARACTERISTIC DFES_Cls.DFC_ComStatACFrontTo_FA_C "DFES/Fehlerklasse für Prüfung DFC_ComStatACFrontTo_FA" VALUE 0x800234C9 Val_Wu8 29.00 DFES_OneToOne 0.00 29.00 EXTENDED_LIMITS 0.00 255.0 /end CHARACTERISTIC
/begin CHARACTERISTIC DFES_Cls.DFC_ComStatEkpSig_A_C "DFES/Fehlerklasse für Prüfung DFC_ComStatEkpSig_A" VALUE 0x800234CA Val_Wu8 29.00 DFES_OneToOne 0.00 29.00 EXTENDED_LIMITS 0.00 255.0 /end CHARACTERISTIC
/begin CHARACTERISTIC DFES_Cls.DFC_ComStatEkpTo_A_C "DFES/Fehlerklasse für Prüfung DFC_ComStatEkpTo_A" VALUE 0x800234CB Val_Wu8 29.00 DFES_OneToOne 0.00 29.00 EXTENDED_LIMITS 0.00 255.0 /end CHARACTERISTIC
/begin CHARACTERISTIC DFES_Cls.DFC_ComStatGearRevSig_FA_C "DFES/Fehlerklasse für Prüfung DFC_ComStatGearRevSig_FA" VALUE 0x800234CC Val_Wu8 29.00 DFES_OneToOne 0.00 29.00 EXTENDED_LIMITS 0.00 255.0 /end CHARACTERISTIC
/begin CHARACTERISTIC DFES_Cls.DFC_ComStatGearRevTo_FA_C "DFES/Fehlerklasse für Prüfung DFC_ComStatGearRevTo_FA" VALUE 0x800234CD Val_Wu8 29.00 DFES_OneToOne 0.00 29.00 EXTENDED_LIMITS 0.00 255.0 /end CHARACTERISTIC
/begin CHARACTERISTIC DFES_Cls.DFC_ComStatZVKlappenSig_FA_C "DFES/Fehlerklasse für Prüfung DFC_ComStatZVKlappenSig_FA" VALUE 0x800234CE Val_Wu8 29.00 DFES_OneToOne 0.00 29.00 EXTENDED_LIMITS 0.00 255.0 /end CHARACTERISTIC
/begin CHARACTERISTIC DFES_Cls.DFC_ComStatZVKlappenTo_FA_C "DFES/Fehlerklasse für Prüfung DFC_ComStatZVKlappenTo_FA" VALUE 0x800234CF Val_Wu8 29.00 DFES_OneToOne 0.00 29.00 EXTENDED_LIMITS 0.00 255.0 /end CHARACTERISTIC
/begin CHARACTERISTIC DFES_Cls.DFC_ComStateARSCtr_C "DFES/Fehlerklasse für Prüfung DFC_ComStateARSCtr" VALUE 0x800234D0 Val_Wu8 29.00 DFES_OneToOne 0.00 29.00 EXTENDED_LIMITS 0.00 255.0 /end CHARACTERISTIC
/begin CHARACTERISTIC DFES_Cls.DFC_ComStateARSSig_C "DFES/Fehlerklasse für Prüfung DFC_ComStateARSSig" VALUE 0x800234D1 Val_Wu8 29.00 DFES_OneToOne 0.00 29.00 EXTENDED_LIMITS 0.00 255.0 /end CHARACTERISTIC
/begin CHARACTERISTIC DFES_Cls.DFC_ComStateARSTo_C "DFES/Fehlerklasse für Prüfung DFC_ComStateARSTo" VALUE 0x800234D2 Val_Wu8 29.00 DFES_OneToOne 0.00 29.00 EXTENDED_LIMITS 0.00 255.0 /end CHARACTERISTIC
/begin CHARACTERISTIC DFES_Cls.DFC_ComStateDscSig_C "DFES/Fehlerklasse für Prüfung DFC_ComStateDscSig" VALUE 0x800234D3 Val_Wu8 29.00 DFES_OneToOne 0.00 29.00 EXTENDED_LIMITS 0.00 255.0 /end CHARACTERISTIC
/begin CHARACTERISTIC DFES_Cls.DFC_ComStateDscTo_C "DFES/Fehlerklasse für Prüfung DFC_ComStateDscTo" VALUE 0x800234D4 Val_Wu8 29.00 DFES_OneToOne 0.00 29.00 EXTENDED_LIMITS 0.00 255.0 /end CHARACTERISTIC
/begin CHARACTERISTIC DFES_Cls.DFC_ComStateSeatSig_C "DFES/Fehlerklasse für Prüfung DFC_ComStateSeatSig" VALUE 0x800234D5 Val_Wu8 29.00 DFES_OneToOne 0.00 29.00 EXTENDED_LIMITS 0.00 255.0 /end CHARACTERISTIC
/begin CHARACTERISTIC DFES_Cls.DFC_ComStateSeatSig_FA_C "DFES/Fehlerklasse für Prüfung DFC_ComStateSeatSig_FA" VALUE 0x800234D6 Val_Wu8 29.00 DFES_OneToOne 0.00 29.00 EXTENDED_LIMITS 0.00 255.0 /end CHARACTERISTIC
/begin CHARACTERISTIC DFES_Cls.DFC_ComStateSeatTo_C "DFES/Fehlerklasse für Prüfung DFC_ComStateSeatTo" VALUE 0x800234D7 Val_Wu8 29.00 DFES_OneToOne 0.00 29.00 EXTENDED_LIMITS 0.00 255.0 /end CHARACTERISTIC
/begin CHARACTERISTIC DFES_Cls.DFC_ComStateSeatTo_FA_C "DFES/Fehlerklasse für Prüfung DFC_ComStateSeatTo_FA" VALUE 0x800234D8 Val_Wu8 29.00 DFES_OneToOne 0.00 29.00 EXTENDED_LIMITS 0.00 255.0 /end CHARACTERISTIC
/begin CHARACTERISTIC DFES_Cls.DFC_ComStatusEGSSig_A_C "DFES/Fehlerklasse für Prüfung DFC_ComStatusEGSSig_A" VALUE 0x800234D9 Val_Wu8 29.00 DFES_OneToOne 0.00 29.00 EXTENDED_LIMITS 0.00 255.0 /end CHARACTERISTIC
/begin CHARACTERISTIC DFES_Cls.DFC_ComStatusEGSSig_FA_C "DFES/Fehlerklasse für Prüfung DFC_ComStatusEGSSig_FA" VALUE 0x800234DA Val_Wu8 29.00 DFES_OneToOne 0.00 29.00 EXTENDED_LIMITS 0.00 255.0 /end CHARACTERISTIC
/begin CHARACTERISTIC DFES_Cls.DFC_ComStatusEGSTo_A_C "DFES/Fehlerklasse für Prüfung DFC_ComStatusEGSTo_A" VALUE 0x800234DB Val_Wu8 29.00 DFES_OneToOne 0.00 29.00 EXTENDED_LIMITS 0.00 255.0 /end CHARACTERISTIC
/begin CHARACTERISTIC DFES_Cls.DFC_ComStatusEGSTo_FA_C "DFES/Fehlerklasse für Prüfung DFC_ComStatusEGSTo_FA" VALUE 0x800234DC Val_Wu8 29.00 DFES_OneToOne 0.00 29.00 EXTENDED_LIMITS 0.00 255.0 /end CHARACTERISTIC
/begin CHARACTERISTIC DFES_Cls.DFC_ComStatusEMFChk_C "DFES/Fehlerklasse für Prüfung DFC_ComStatusEMFChk" VALUE 0x800234DD Val_Wu8 29.00 DFES_OneToOne 0.00 29.00 EXTENDED_LIMITS 0.00 255.0 /end CHARACTERISTIC
/begin CHARACTERISTIC DFES_Cls.DFC_ComStatusEMFCtr_C "DFES/Fehlerklasse für Prüfung DFC_ComStatusEMFCtr" VALUE 0x800234DE Val_Wu8 29.00 DFES_OneToOne 0.00 29.00 EXTENDED_LIMITS 0.00 255.0 /end CHARACTERISTIC
/begin CHARACTERISTIC DFES_Cls.DFC_ComStatusEMFSig_C "DFES/Fehlerklasse für Prüfung DFC_ComStatusEMFSig" VALUE 0x800234DF Val_Wu8 29.00 DFES_OneToOne 0.00 29.00 EXTENDED_LIMITS 0.00 255.0 /end CHARACTERISTIC
/begin CHARACTERISTIC DFES_Cls.DFC_ComStatusEMFTo_C "DFES/Fehlerklasse für Prüfung DFC_ComStatusEMFTo" VALUE 0x800234E0 Val_Wu8 29.00 DFES_OneToOne 0.00 29.00 EXTENDED_LIMITS 0.00 255.0 /end CHARACTERISTIC
/begin CHARACTERISTIC DFES_Cls.DFC_ComStatusRGangSig_C "DFES/Fehlerklasse für Prüfung DFC_ComStatusRGangSig" VALUE 0x800234E1 Val_Wu8 29.00 DFES_OneToOne 0.00 29.00 EXTENDED_LIMITS 0.00 255.0 /end CHARACTERISTIC
/begin CHARACTERISTIC DFES_Cls.DFC_ComStatusRGangTo_C "DFES/Fehlerklasse für Prüfung DFC_ComStatusRGangTo" VALUE 0x800234E2 Val_Wu8 29.00 DFES_OneToOne 0.00 29.00 EXTENDED_LIMITS 0.00 255.0 /end CHARACTERISTIC
/begin CHARACTERISTIC DFES_Cls.DFC_ComSteeringAngleChk_FX_C "DFES/Fehlerklasse für Prüfung DFC_ComSteeringAngleChk_FX" VALUE 0x800234E3 Val_Wu8 29.00 DFES_OneToOne 0.00 29.00 EXTENDED_LIMITS 0.00 255.0 /end CHARACTERISTIC
/begin CHARACTERISTIC DFES_Cls.DFC_ComSteeringAngleCtr_FX_C "DFES/Fehlerklasse für Prüfung DFC_ComSteeringAngleCtr_FX" VALUE 0x800234E4 Val_Wu8 29.00 DFES_OneToOne 0.00 29.00 EXTENDED_LIMITS 0.00 255.0 /end CHARACTERISTIC
/begin CHARACTERISTIC DFES_Cls.DFC_ComSteeringAngleTo_FX_C "DFES/Fehlerklasse für Prüfung DFC_ComSteeringAngleTo_FX" VALUE 0x800234E5 Val_Wu8 29.00 DFES_OneToOne 0.00 29.00 EXTENDED_LIMITS 0.00 255.0 /end CHARACTERISTIC
/begin CHARACTERISTIC DFES_Cls.DFC_ComTerminalChk_C "DFES/Fehlerklasse für Prüfung DFC_ComTerminalChk" VALUE 0x800234E6 Val_Wu8 29.00 DFES_OneToOne 0.00 29.00 EXTENDED_LIMITS 0.00 255.0 /end CHARACTERISTIC
/begin CHARACTERISTIC DFES_Cls.DFC_ComTerminalCtr_C "DFES/Fehlerklasse für Prüfung DFC_ComTerminalCtr" VALUE 0x800234E7 Val_Wu8 29.00 DFES_OneToOne 0.00 29.00 EXTENDED_LIMITS 0.00 255.0 /end CHARACTERISTIC
/begin CHARACTERISTIC DFES_Cls.DFC_ComTerminalSig_C "DFES/Fehlerklasse für Prüfung DFC_ComTerminalSig" VALUE 0x800234E8 Val_Wu8 29.00 DFES_OneToOne 0.00 29.00 EXTENDED_LIMITS 0.00 255.0 /end CHARACTERISTIC
/begin CHARACTERISTIC DFES_Cls.DFC_ComTerminalTo_C "DFES/Fehlerklasse für Prüfung DFC_ComTerminalTo" VALUE 0x800234E9 Val_Wu8 29.00 DFES_OneToOne 0.00 29.00 EXTENDED_LIMITS 0.00 255.0 /end CHARACTERISTIC
/begin CHARACTERISTIC DFES_Cls.DFC_ComTimeDateSig_FA_C "DFES/Fehlerklasse für Prüfung DFC_ComTimeDateSig_FA" VALUE 0x800234EA Val_Wu8 29.00 DFES_OneToOne 0.00 29.00 EXTENDED_LIMITS 0.00 255.0 /end CHARACTERISTIC
/begin CHARACTERISTIC DFES_Cls.DFC_ComTimeDateTo_FA_C "DFES/Fehlerklasse für Prüfung DFC_ComTimeDateTo_FA" VALUE 0x800234EB Val_Wu8 29.00 DFES_OneToOne 0.00 29.00 EXTENDED_LIMITS 0.00 255.0 /end CHARACTERISTIC
/begin CHARACTERISTIC DFES_Cls.DFC_ComTrailerSig_C "DFES/Fehlerklasse für Prüfung DFC_ComTrailerSig" VALUE 0x800234EC Val_Wu8 29.00 DFES_OneToOne 0.00 29.00 EXTENDED_LIMITS 0.00 255.0 /end CHARACTERISTIC
/begin CHARACTERISTIC DFES_Cls.DFC_ComTrailerSig_FA_C "DFES/Fehlerklasse für Prüfung DFC_ComTrailerSig_FA" VALUE 0x800234ED Val_Wu8 29.00 DFES_OneToOne 0.00 29.00 EXTENDED_LIMITS 0.00 255.0 /end CHARACTERISTIC
/begin CHARACTERISTIC DFES_Cls.DFC_ComTrailerTo_C "DFES/Fehlerklasse für Prüfung DFC_ComTrailerTo" VALUE 0x800234EE Val_Wu8 29.00 DFES_OneToOne 0.00 29.00 EXTENDED_LIMITS 0.00 255.0 /end CHARACTERISTIC
/begin CHARACTERISTIC DFES_Cls.DFC_ComTrailerTo_FA_C "DFES/Fehlerklasse für Prüfung DFC_ComTrailerTo_FA" VALUE 0x800234EF Val_Wu8 29.00 DFES_OneToOne 0.00 29.00 EXTENDED_LIMITS 0.00 255.0 /end CHARACTERISTIC
/begin CHARACTERISTIC DFES_Cls.DFC_ComTrqDemCrshDrDyChk_FX_C "DFES/Fehlerklasse für Prüfung DFC_ComTrqDemCrshDrDyChk_FX" VALUE 0x800234F0 Val_Wu8 29.00 DFES_OneToOne 0.00 29.00 EXTENDED_LIMITS 0.00 255.0 /end CHARACTERISTIC
/begin CHARACTERISTIC DFES_Cls.DFC_ComTrqDemCrshDrDyCtr_FX_C "DFES/Fehlerklasse für Prüfung DFC_ComTrqDemCrshDrDyCtr_FX" VALUE 0x800234F1 Val_Wu8 29.00 DFES_OneToOne 0.00 29.00 EXTENDED_LIMITS 0.00 255.0 /end CHARACTERISTIC
/begin CHARACTERISTIC DFES_Cls.DFC_ComTrqDemCrshDrDyTo_FX_C "DFES/Fehlerklasse für Prüfung DFC_ComTrqDemCrshDrDyTo_FX" VALUE 0x800234F2 Val_Wu8 29.00 DFES_OneToOne 0.00 29.00 EXTENDED_LIMITS 0.00 255.0 /end CHARACTERISTIC
/begin CHARACTERISTIC DFES_Cls.DFC_ComTrqDemandDesSig_C "DFES/Fehlerklasse für Prüfung DFC_ComTrqDemandDesSig" VALUE 0x800234F3 Val_Wu8 29.00 DFES_OneToOne 0.00 29.00 EXTENDED_LIMITS 0.00 255.0 /end CHARACTERISTIC
/begin CHARACTERISTIC DFES_Cls.DFC_ComTrqDemandDesTo_C "DFES/Fehlerklasse für Prüfung DFC_ComTrqDemandDesTo" VALUE 0x800234F4 Val_Wu8 29.00 DFES_OneToOne 0.00 29.00 EXTENDED_LIMITS 0.00 255.0 /end CHARACTERISTIC
/begin CHARACTERISTIC DFES_Cls.DFC_ComTrqDemandDscChk_C "DFES/Fehlerklasse für Prüfung DFC_ComTrqDemandDscChk" VALUE 0x800234F5 Val_Wu8 29.00 DFES_OneToOne 0.00 29.00 EXTENDED_LIMITS 0.00 255.0 /end CHARACTERISTIC
/begin CHARACTERISTIC DFES_Cls.DFC_ComTrqDemandDscCtr_C "DFES/Fehlerklasse für Prüfung DFC_ComTrqDemandDscCtr" VALUE 0x800234F6 Val_Wu8 29.00 DFES_OneToOne 0.00 29.00 EXTENDED_LIMITS 0.00 255.0 /end CHARACTERISTIC
/begin CHARACTERISTIC DFES_Cls.DFC_ComTrqDemandDscSig_C "DFES/Fehlerklasse für Prüfung DFC_ComTrqDemandDscSig" VALUE 0x800234F7 Val_Wu8 29.00 DFES_OneToOne 0.00 29.00 EXTENDED_LIMITS 0.00 255.0 /end CHARACTERISTIC
/begin CHARACTERISTIC DFES_Cls.DFC_ComTrqDemandDscTo_C "DFES/Fehlerklasse für Prüfung DFC_ComTrqDemandDscTo" VALUE 0x800234F8 Val_Wu8 29.00 DFES_OneToOne 0.00 29.00 EXTENDED_LIMITS 0.00 255.0 /end CHARACTERISTIC
/begin CHARACTERISTIC DFES_Cls.DFC_ComTrqDemandGbxChk_A_C "DFES/Fehlerklasse für Prüfung DFC_ComTrqDemandGbxChk_A" VALUE 0x800234F9 Val_Wu8 29.00 DFES_OneToOne 0.00 29.00 EXTENDED_LIMITS 0.00 255.0 /end CHARACTERISTIC
/begin CHARACTERISTIC DFES_Cls.DFC_ComTrqDemandGbxChk_FA_C "DFES/Fehlerklasse für Prüfung DFC_ComTrqDemandGbxChk_FA" VALUE 0x800234FA Val_Wu8 29.00 DFES_OneToOne 0.00 29.00 EXTENDED_LIMITS 0.00 255.0 /end CHARACTERISTIC
/begin CHARACTERISTIC DFES_Cls.DFC_ComTrqDemandGbxCtr_A_C "DFES/Fehlerklasse für Prüfung DFC_ComTrqDemandGbxCtr_A" VALUE 0x800234FB Val_Wu8 29.00 DFES_OneToOne 0.00 29.00 EXTENDED_LIMITS 0.00 255.0 /end CHARACTERISTIC
/begin CHARACTERISTIC DFES_Cls.DFC_ComTrqDemandGbxCtr_FA_C "DFES/Fehlerklasse für Prüfung DFC_ComTrqDemandGbxCtr_FA" VALUE 0x800234FC Val_Wu8 29.00 DFES_OneToOne 0.00 29.00 EXTENDED_LIMITS 0.00 255.0 /end CHARACTERISTIC
/begin CHARACTERISTIC DFES_Cls.DFC_ComTrqDemandGbxSig_A_C "DFES/Fehlerklasse für Prüfung DFC_ComTrqDemandGbxSig_A" VALUE 0x800234FD Val_Wu8 29.00 DFES_OneToOne 0.00 29.00 EXTENDED_LIMITS 0.00 255.0 /end CHARACTERISTIC
/begin CHARACTERISTIC DFES_Cls.DFC_ComTrqDemandGbxSig_FA_C "DFES/Fehlerklasse für Prüfung DFC_ComTrqDemandGbxSig_FA" VALUE 0x800234FE Val_Wu8 29.00 DFES_OneToOne 0.00 29.00 EXTENDED_LIMITS 0.00 255.0 /end CHARACTERISTIC
/begin CHARACTERISTIC DFES_Cls.DFC_ComTrqDemandGbxTo_A_C "DFES/Fehlerklasse für Prüfung DFC_ComTrqDemandGbxTo_A" VALUE 0x800234FF Val_Wu8 29.00 DFES_OneToOne 0.00 29.00 EXTENDED_LIMITS 0.00 255.0 /end CHARACTERISTIC
/begin CHARACTERISTIC DFES_Cls.DFC_ComTrqDemandGbxTo_FA_C "DFES/Fehlerklasse für Prüfung DFC_ComTrqDemandGbxTo_FA" VALUE 0x80023500 Val_Wu8 29.00 DFES_OneToOne 0.00 29.00 EXTENDED_LIMITS 0.00 255.0 /end CHARACTERISTIC
/begin CHARACTERISTIC DFES_Cls.DFC_ComTrqWhlDemChk_C "DFES/Fehlerklasse für Prüfung DFC_ComTrqWhlDemChk" VALUE 0x80023501 Val_Wu8 29.00 DFES_OneToOne 0.00 29.00 EXTENDED_LIMITS 0.00 255.0 /end CHARACTERISTIC
/begin CHARACTERISTIC DFES_Cls.DFC_ComTrqWhlDemCtr_C "DFES/Fehlerklasse für Prüfung DFC_ComTrqWhlDemCtr" VALUE 0x80023502 Val_Wu8 29.00 DFES_OneToOne 0.00 29.00 EXTENDED_LIMITS 0.00 255.0 /end CHARACTERISTIC
/begin CHARACTERISTIC DFES_Cls.DFC_ComTrqWhlDemFASChk_FX_C "DFES/Fehlerklasse für Prüfung DFC_ComTrqWhlDemFASChk_FX" VALUE 0x80023503 Val_Wu8 29.00 DFES_OneToOne 0.00 29.00 EXTENDED_LIMITS 0.00 255.0 /end CHARACTERISTIC
/begin CHARACTERISTIC DFES_Cls.DFC_ComTrqWhlDemFASCtr_FX_C "DFES/Fehlerklasse für Prüfung DFC_ComTrqWhlDemFASCtr_FX" VALUE 0x80023504 Val_Wu8 29.00 DFES_OneToOne 0.00 29.00 EXTENDED_LIMITS 0.00 255.0 /end CHARACTERISTIC
/begin CHARACTERISTIC DFES_Cls.DFC_ComTrqWhlDemFASTo_FX_C "DFES/Fehlerklasse für Prüfung DFC_ComTrqWhlDemFASTo_FX" VALUE 0x80023505 Val_Wu8 29.00 DFES_OneToOne 0.00 29.00 EXTENDED_LIMITS 0.00 255.0 /end CHARACTERISTIC
/begin CHARACTERISTIC DFES_Cls.DFC_ComTrqWhlDemSig_C "DFES/Fehlerklasse für Prüfung DFC_ComTrqWhlDemSig" VALUE 0x80023506 Val_Wu8 29.00 DFES_OneToOne 0.00 29.00 EXTENDED_LIMITS 0.00 255.0 /end CHARACTERISTIC
/begin CHARACTERISTIC DFES_Cls.DFC_ComTrqWhlDemTo_C "DFES/Fehlerklasse für Prüfung DFC_ComTrqWhlDemTo" VALUE 0x80023507 Val_Wu8 29.00 DFES_OneToOne 0.00 29.00 EXTENDED_LIMITS 0.00 255.0 /end CHARACTERISTIC
/begin CHARACTERISTIC DFES_Cls.DFC_ComVelocityChk_FA_C "DFES/Fehlerklasse für Prüfung DFC_ComVelocityChk_FA" VALUE 0x80023508 Val_Wu8 29.00 DFES_OneToOne 0.00 29.00 EXTENDED_LIMITS 0.00 255.0 /end CHARACTERISTIC
/begin CHARACTERISTIC DFES_Cls.DFC_ComVelocityCtr_FA_C "DFES/Fehlerklasse für Prüfung DFC_ComVelocityCtr_FA" VALUE 0x80023509 Val_Wu8 29.00 DFES_OneToOne 0.00 29.00 EXTENDED_LIMITS 0.00 255.0 /end CHARACTERISTIC
/begin CHARACTERISTIC DFES_Cls.DFC_ComVelocitySig_C "DFES/Fehlerklasse für Prüfung DFC_ComVelocitySig" VALUE 0x8002350A Val_Wu8 29.00 DFES_OneToOne 0.00 29.00 EXTENDED_LIMITS 0.00 255.0 /end CHARACTERISTIC
/begin CHARACTERISTIC DFES_Cls.DFC_ComVelocitySig_FA_C "DFES/Fehlerklasse für Prüfung DFC_ComVelocitySig_FA" VALUE 0x8002350B Val_Wu8 29.00 DFES_OneToOne 0.00 29.00 EXTENDED_LIMITS 0.00 255.0 /end CHARACTERISTIC
/begin CHARACTERISTIC DFES_Cls.DFC_ComVelocityTo_C "DFES/Fehlerklasse für Prüfung DFC_ComVelocityTo" VALUE 0x8002350C Val_Wu8 29.00 DFES_OneToOne 0.00 29.00 EXTENDED_LIMITS 0.00 255.0 /end CHARACTERISTIC
/begin CHARACTERISTIC DFES_Cls.DFC_ComVelocityTo_FA_C "DFES/Fehlerklasse für Prüfung DFC_ComVelocityTo_FA" VALUE 0x8002350D Val_Wu8 29.00 DFES_OneToOne 0.00 29.00 EXTENDED_LIMITS 0.00 255.0 /end CHARACTERISTIC
/begin CHARACTERISTIC DFES_Cls.DFC_ComVerbraucherTo_C "DFES/Fehlerklasse für Prüfung DFC_ComVerbraucherTo" VALUE 0x8002350E Val_Wu8 29.00 DFES_OneToOne 0.00 29.00 EXTENDED_LIMITS 0.00 255.0 /end CHARACTERISTIC
/begin CHARACTERISTIC DFES_Cls.DFC_ComWMomPTStabChk_FX_C "DFES/Fehlerklasse für Prüfung DFC_ComWMomPTStabChk_FX" VALUE 0x8002350F Val_Wu8 29.00 DFES_OneToOne 0.00 29.00 EXTENDED_LIMITS 0.00 255.0 /end CHARACTERISTIC
/begin CHARACTERISTIC DFES_Cls.DFC_ComWMomPTStabCtr_FX_C "DFES/Fehlerklasse für Prüfung DFC_ComWMomPTStabCtr_FX" VALUE 0x80023510 Val_Wu8 29.00 DFES_OneToOne 0.00 29.00 EXTENDED_LIMITS 0.00 255.0 /end CHARACTERISTIC
/begin CHARACTERISTIC DFES_Cls.DFC_ComWMomPTStabTo_FX_C "DFES/Fehlerklasse für Prüfung DFC_ComWMomPTStabTo_FX" VALUE 0x80023511 Val_Wu8 29.00 DFES_OneToOne 0.00 29.00 EXTENDED_LIMITS 0.00 255.0 /end CHARACTERISTIC
/begin CHARACTERISTIC DFES_Cls.DFC_ComWheelSpeedSig_C "DFES/Fehlerklasse für Prüfung DFC_ComWheelSpeedSig" VALUE 0x80023512 Val_Wu8 29.00 DFES_OneToOne 0.00 29.00 EXTENDED_LIMITS 0.00 255.0 /end CHARACTERISTIC
/begin CHARACTERISTIC DFES_Cls.DFC_ComWheelSpeedTo_C "DFES/Fehlerklasse für Prüfung DFC_ComWheelSpeedTo" VALUE 0x80023513 Val_Wu8 29.00 DFES_OneToOne 0.00 29.00 EXTENDED_LIMITS 0.00 255.0 /end CHARACTERISTIC
/begin CHARACTERISTIC DFES_Cls.DFC_ComZvKlappenSig_C "DFES/Fehlerklasse für Prüfung DFC_ComZvKlappenSig" VALUE 0x80023514 Val_Wu8 29.00 DFES_OneToOne 0.00 29.00 EXTENDED_LIMITS 0.00 255.0 /end CHARACTERISTIC
/begin CHARACTERISTIC DFES_Cls.DFC_ComZvKlappenTo_C "DFES/Fehlerklasse für Prüfung DFC_ComZvKlappenTo" VALUE 0x80023515 Val_Wu8 29.00 DFES_OneToOne 0.00 29.00 EXTENDED_LIMITS 0.00 255.0 /end CHARACTERISTIC
/begin CHARACTERISTIC DFES_Cls.DFC_ComaDirectChk_FX_C "DFES/Fehlerklasse für Prüfung DFC_ComaDirectChk_FX" VALUE 0x80023516 Val_Wu8 29.00 DFES_OneToOne 0.00 29.00 EXTENDED_LIMITS 0.00 255.0 /end CHARACTERISTIC
/begin CHARACTERISTIC DFES_Cls.DFC_ComaDirectCtr_FX_C "DFES/Fehlerklasse für Prüfung DFC_ComaDirectCtr_FX" VALUE 0x80023517 Val_Wu8 29.00 DFES_OneToOne 0.00 29.00 EXTENDED_LIMITS 0.00 255.0 /end CHARACTERISTIC
/begin CHARACTERISTIC DFES_Cls.DFC_ComaDirectTo_FX_C "DFES/Fehlerklasse für Prüfung DFC_ComaDirectTo_FX" VALUE 0x80023518 Val_Wu8 29.00 DFES_OneToOne 0.00 29.00 EXTENDED_LIMITS 0.00 255.0 /end CHARACTERISTIC
/begin CHARACTERISTIC DFES_Cls.DFC_ComaSideChk_FX_C "DFES/Fehlerklasse für Prüfung DFC_ComaSideChk_FX" VALUE 0x80023519 Val_Wu8 29.00 DFES_OneToOne 0.00 29.00 EXTENDED_LIMITS 0.00 255.0 /end CHARACTERISTIC
/begin CHARACTERISTIC DFES_Cls.DFC_ComaSideCtr_FX_C "DFES/Fehlerklasse für Prüfung DFC_ComaSideCtr_FX" VALUE 0x8002351A Val_Wu8 29.00 DFES_OneToOne 0.00 29.00 EXTENDED_LIMITS 0.00 255.0 /end CHARACTERISTIC
/begin CHARACTERISTIC DFES_Cls.DFC_ComaSideTo_FX_C "DFES/Fehlerklasse für Prüfung DFC_ComaSideTo_FX" VALUE 0x8002351B Val_Wu8 29.00 DFES_OneToOne 0.00 29.00 EXTENDED_LIMITS 0.00 255.0 /end CHARACTERISTIC
/begin CHARACTERISTIC DFES_Cls.DFC_Cy320SpiCom_C "DFES/Fehlerklasse für Prüfung DFC_Cy320SpiCom" VALUE 0x8002351C Val_Wu8 29.00 DFES_OneToOne 0.00 29.00 EXTENDED_LIMITS 0.00 255.0 /end CHARACTERISTIC
/begin CHARACTERISTIC DFES_Cls.DFC_ETCtlDvtInrMax_C "DFES/Fehlerklasse für Prüfung DFC_ETCtlDvtInrMax" VALUE 0x8002351D Val_Wu8 29.00 DFES_OneToOne 0.00 29.00 EXTENDED_LIMITS 0.00 255.0 /end CHARACTERISTIC
/begin CHARACTERISTIC DFES_Cls.DFC_ETCtlDvtInrMin_C "DFES/Fehlerklasse für Prüfung DFC_ETCtlDvtInrMin" VALUE 0x8002351E Val_Wu8 29.00 DFES_OneToOne 0.00 29.00 EXTENDED_LIMITS 0.00 255.0 /end CHARACTERISTIC
/begin CHARACTERISTIC DFES_Cls.DFC_ETCtlDvtOutrMax_C "DFES/Fehlerklasse für Prüfung DFC_ETCtlDvtOutrMax" VALUE 0x8002351F Val_Wu8 29.00 DFES_OneToOne 0.00 29.00 EXTENDED_LIMITS 0.00 255.0 /end CHARACTERISTIC
/begin CHARACTERISTIC DFES_Cls.DFC_ETCtlDvtOutrMin_C "DFES/Fehlerklasse für Prüfung DFC_ETCtlDvtOutrMin" VALUE 0x80023520 Val_Wu8 29.00 DFES_OneToOne 0.00 29.00 EXTENDED_LIMITS 0.00 255.0 /end CHARACTERISTIC
/begin CHARACTERISTIC DFES_Cls.DFC_FBCqDvtMax_C "DFES/Fehlerklasse für Prüfung DFC_FBCqDvtMax" VALUE 0x80023521 Val_Wu8 29.00 DFES_OneToOne 0.00 29.00 EXTENDED_LIMITS 0.00 255.0 /end CHARACTERISTIC
/begin CHARACTERISTIC DFES_Cls.DFC_FBCqDvtMin_C "DFES/Fehlerklasse für Prüfung DFC_FBCqDvtMin" VALUE 0x80023522 Val_Wu8 29.00 DFES_OneToOne 0.00 29.00 EXTENDED_LIMITS 0.00 255.0 /end CHARACTERISTIC
/begin CHARACTERISTIC DFES_Cls.DFC_Fan4WinErr1_C "DFES/Fehlerklasse für Prüfung DFC_Fan4WinErr1" VALUE 0x80023523 Val_Wu8 29.00 DFES_OneToOne 0.00 29.00 EXTENDED_LIMITS 0.00 255.0 /end CHARACTERISTIC
/begin CHARACTERISTIC DFES_Cls.DFC_Fan4WinErr2_C "DFES/Fehlerklasse für Prüfung DFC_Fan4WinErr2" VALUE 0x80023524 Val_Wu8 29.00 DFES_OneToOne 0.00 29.00 EXTENDED_LIMITS 0.00 255.0 /end CHARACTERISTIC
/begin CHARACTERISTIC DFES_Cls.DFC_Fan4WinErr3_C "DFES/Fehlerklasse für Prüfung DFC_Fan4WinErr3" VALUE 0x80023525 Val_Wu8 29.00 DFES_OneToOne 0.00 29.00 EXTENDED_LIMITS 0.00 255.0 /end CHARACTERISTIC
/begin CHARACTERISTIC DFES_Cls.DFC_Fan4WinErr4_C "DFES/Fehlerklasse für Prüfung DFC_Fan4WinErr4" VALUE 0x80023526 Val_Wu8 29.00 DFES_OneToOne 0.00 29.00 EXTENDED_LIMITS 0.00 255.0 /end CHARACTERISTIC
/begin CHARACTERISTIC DFES_Cls.DFC_FanSCG_C "DFES/Fehlerklasse für Prüfung DFC_FanSCG" VALUE 0x80023527 Val_Wu8 29.00 DFES_OneToOne 0.00 29.00 EXTENDED_LIMITS 0.00 255.0 /end CHARACTERISTIC
/begin CHARACTERISTIC DFES_Cls.DFC_FlFCBS_C "DFES/Fehlerklasse für Prüfung DFC_FlFCBS" VALUE 0x80023528 Val_Wu8 29.00 DFES_OneToOne 0.00 29.00 EXTENDED_LIMITS 0.00 255.0 /end CHARACTERISTIC
/begin CHARACTERISTIC DFES_Cls.DFC_GlwEcuConfigErr_C "DFES/Fehlerklasse für Prüfung DFC_GlwEcuConfigErr" VALUE 0x80023529 Val_Wu8 29.00 DFES_OneToOne 0.00 29.00 EXTENDED_LIMITS 0.00 255.0 /end CHARACTERISTIC
/begin CHARACTERISTIC DFES_Cls.DFC_GlwEcuEepErr_C "DFES/Fehlerklasse für Prüfung DFC_GlwEcuEepErr" VALUE 0x8002352A Val_Wu8 29.00 DFES_OneToOne 0.00 29.00 EXTENDED_LIMITS 0.00 255.0 /end CHARACTERISTIC
/begin CHARACTERISTIC DFES_Cls.DFC_GlwEcuFrmErr_C "DFES/Fehlerklasse für Prüfung DFC_GlwEcuFrmErr" VALUE 0x8002352B Val_Wu8 29.00 DFES_OneToOne 0.00 29.00 EXTENDED_LIMITS 0.00 255.0 /end CHARACTERISTIC
/begin CHARACTERISTIC DFES_Cls.DFC_GlwEcuGPCMFaultInfo_C "DFES/Fehlerklasse für Prüfung DFC_GlwEcuGPCMFaultInfo" VALUE 0x8002352C Val_Wu8 29.00 DFES_OneToOne 0.00 29.00 EXTENDED_LIMITS 0.00 255.0 /end CHARACTERISTIC
/begin CHARACTERISTIC DFES_Cls.DFC_GlwEcuGPCMInfo_C "DFES/Fehlerklasse für Prüfung DFC_GlwEcuGPCMInfo" VALUE 0x8002352D Val_Wu8 29.00 DFES_OneToOne 0.00 29.00 EXTENDED_LIMITS 0.00 255.0 /end CHARACTERISTIC
/begin CHARACTERISTIC DFES_Cls.DFC_GlwEcuGk1HSS_C "DFES/Fehlerklasse für Prüfung DFC_GlwEcuGk1HSS" VALUE 0x8002352E Val_Wu8 29.00 DFES_OneToOne 0.00 29.00 EXTENDED_LIMITS 0.00 255.0 /end CHARACTERISTIC
/begin CHARACTERISTIC DFES_Cls.DFC_GlwEcuGk1OL_C "DFES/Fehlerklasse für Prüfung DFC_GlwEcuGk1OL" VALUE 0x8002352F Val_Wu8 29.00 DFES_OneToOne 0.00 29.00 EXTENDED_LIMITS 0.00 255.0 /end CHARACTERISTIC
/begin CHARACTERISTIC DFES_Cls.DFC_GlwEcuGk1SC_C "DFES/Fehlerklasse für Prüfung DFC_GlwEcuGk1SC" VALUE 0x80023530 Val_Wu8 29.00 DFES_OneToOne 0.00 29.00 EXTENDED_LIMITS 0.00 255.0 /end CHARACTERISTIC
/begin CHARACTERISTIC DFES_Cls.DFC_GlwEcuGk1Wdst_C "DFES/Fehlerklasse für Prüfung DFC_GlwEcuGk1Wdst" VALUE 0x80023531 Val_Wu8 29.00 DFES_OneToOne 0.00 29.00 EXTENDED_LIMITS 0.00 255.0 /end CHARACTERISTIC
/begin CHARACTERISTIC DFES_Cls.DFC_GlwEcuGk2HSS_C "DFES/Fehlerklasse für Prüfung DFC_GlwEcuGk2HSS" VALUE 0x80023532 Val_Wu8 29.00 DFES_OneToOne 0.00 29.00 EXTENDED_LIMITS 0.00 255.0 /end CHARACTERISTIC
/begin CHARACTERISTIC DFES_Cls.DFC_GlwEcuGk2OL_C "DFES/Fehlerklasse für Prüfung DFC_GlwEcuGk2OL" VALUE 0x80023533 Val_Wu8 29.00 DFES_OneToOne 0.00 29.00 EXTENDED_LIMITS 0.00 255.0 /end CHARACTERISTIC
/begin MEASUREMENT DFES_ChkLstDltDemExCond_mp "Status der letzten Überprüfung der Löschanförderung während der Initialisierung" UBYTE OneToOne 1 100 0.00 255.0 ECU_ADDRESS 0xC000B0FF /end MEASUREMENT
/begin MEASUREMENT DFES_ctDef "Fehlerzähler (FLC) aller Fehlerspeichereinträge" UBYTE DFES_OneToOne 1 100 0.00 255.0 ARRAY_SIZE 20 ECU_ADDRESS 0xD0008CB6 /end MEASUREMENT
/begin MEASUREMENT DFES_ctDel "Löschzähler (DLC) aller Fehlerspeichereinträge" UBYTE DFES_OneToOne 1 100 0.00 255.0 ARRAY_SIZE 20 ECU_ADDRESS 0xD0008D06 /end MEASUREMENT
/begin MEASUREMENT DFES_ctEntry "Anzahl der belegten Fehlerspeichereintraege" UBYTE DFES_OneToOne 1 100 0.00 255.0 ECU_ADDRESS 0xC0006B4D /end MEASUREMENT
/begin MEASUREMENT DFES_ctFrq "Häufigkeitszähler aller Fehlerspeichereinträge" UBYTE DFES_OneToOne 1 100 0.00 255.0 ARRAY_SIZE 20 ECU_ADDRESS 0xD0008D1A /end MEASUREMENT
/begin MEASUREMENT DFES_ctManuDef "kundenspezifischer Fehlerzähler (SVS-FLC) aller Fehlerspeichereinträge" UBYTE DFES_OneToOne 1 100 0.00 255.0 ARRAY_SIZE 20 ECU_ADDRESS 0xD0008CDE /end MEASUREMENT
/begin MEASUREMENT DFES_ctManuOk "kundenspezifischer Heilungszähler (SVS-HLC) aller Fehlerspeichereinträge" UBYTE DFES_OneToOne 1 100 0.00 255.0 ARRAY_SIZE 20 ECU_ADDRESS 0xD0008CF2 /end MEASUREMENT
/begin MEASUREMENT DFES_ctMIL "Anzahl der MIL ansteuernden Fehlerspeichereintraege" UBYTE DFES_OneToOne 1 100 0.00 255.0 ECU_ADDRESS 0xC0006B4B /end MEASUREMENT
/begin MEASUREMENT DFES_ctOBD "Anzahl der in Mode 3 sichtbaren Fehlerspeichereintraege" UBYTE DFES_OneToOne 1 100 0.00 255.0 ECU_ADDRESS 0xC0006B49 /end MEASUREMENT
/begin MEASUREMENT DFES_ctOBDPend "Anzahl der in Mode 7 (pending) sichtbaren Fehlerspeichereintraege" UBYTE DFES_OneToOne 1 100 0.00 255.0 ECU_ADDRESS 0xC0006B4A /end MEASUREMENT
/begin MEASUREMENT DFES_ctOk "Heilungszähler (HLC) aller Fehlerspeichereinträge" UBYTE DFES_OneToOne 1 100 0.00 255.0 ARRAY_SIZE 20 ECU_ADDRESS 0xD0008CCA /end MEASUREMENT
/begin MEASUREMENT DFES_ctSrv "Anzahl der für einen Service Tester sichtbaren Fehlerspeichereintraege" UBYTE DFES_OneToOne 1 100 0.00 255.0 ECU_ADDRESS 0xC0006B4C /end MEASUREMENT
/begin MEASUREMENT DFES_DltDemMnmtExCond_mp "Status der letzten Löschzählerbearbeitung" UBYTE OneToOne 1 100 0.00 255.0 ECU_ADDRESS 0xC000B100 /end MEASUREMENT
/begin MEASUREMENT DFES_EnvBlock "vollständige Umweldaten alle Fehlerspeichereinträge" UBYTE DFES_OneToOne 1 100 0.00 255.0 ARRAY_SIZE 1600 ECU_ADDRESS 0xD0008E82 /end MEASUREMENT
/begin MEASUREMENT DFES_FrzFrVal "freeze frame Daten aller Fehlerspeichereinträge" UBYTE DFES_OneToOne 1 100 0.00 255.0 ARRAY_SIZE 320 ECU_ADDRESS 0xD0008D42 /end MEASUREMENT
/begin MEASUREMENT DFES_idxHash "DSM interne Hash-Tabelle für optimierten DFC basierten Fehlerspeicherzugriff" UBYTE DFES_OneToOne 1 100 0.00 255.0 ARRAY_SIZE 20 ECU_ADDRESS 0xD000395C /end MEASUREMENT
/begin MEASUREMENT DFES_idxLink "DSM interne Link-Tabelle für optimierten DFC basierten Fehlerspeicherzugriff" UBYTE DFES_OneToOne 1 100 0.00 255.0 ARRAY_SIZE 20 ECU_ADDRESS 0xD0003934 /end MEASUREMENT
/begin MEASUREMENT DFES_idxPrioQueue "DSM interne Prioritätsreihenfolge aller Fehlerspeichereinträge" UBYTE DFES_OneToOne 1 100 0.00 255.0 ARRAY_SIZE 20 ECU_ADDRESS 0xD0003948 /end MEASUREMENT
/begin MEASUREMENT DFES_idxSequence "DSM interne Eintragsreihenfolge, um die historische Reihenfolge aller Einträge zu erhalten" UBYTE DFES_OneToOne 1 100 0.00 255.0 ARRAY_SIZE 20 ECU_ADDRESS 0xC000C8BC /end MEASUREMENT
/begin MEASUREMENT DFES_idxVisible "Sichtbarkeit aller Fehlerspeichereinträge" UBYTE DFES_OneToOne 1 100 0.00 255.0 ARRAY_SIZE 20 ECU_ADDRESS 0xC0006AF3 /end MEASUREMENT
/begin MEASUREMENT DFES_MonClct "interner Überwachungszustand des Fehlerspeichers" UWORD DFES_OneToOne 1 100 0.00 65535.00 ECU_ADDRESS 0xD00094C4 /end MEASUREMENT
/begin MEASUREMENT DFES_MonEvnt "Fehlerspeicherüberwachung: Event Id" UWORD DFES_Mon_Verb 1 100 0.00 32783.0000000 FORMAT "%13.7" ARRAY_SIZE 4 ECU_ADDRESS 0xD00094C6 /end MEASUREMENT
/begin MEASUREMENT DFES_MonObjt "Fehlerspeicherüberwachung: Object Id" UWORD OneToOne 1 100 0.00 65535.00 ARRAY_SIZE 4 ECU_ADDRESS 0xD00094CE /end MEASUREMENT
/begin MEASUREMENT DFES_MonParm "Fehlerspeicherüberwachung: parameter" UWORD OneToOne 1 100 0.00 65535.00 ARRAY_SIZE 4 ECU_ADDRESS 0xD00094D6 /end MEASUREMENT
/begin MEASUREMENT DFES_MonPtr "DSM interner Zeiger der Fehlerspeicherüberwachung" UBYTE DFES_OneToOne 1 100 0.00 255.0 ECU_ADDRESS 0xD00094C2 /end MEASUREMENT
/begin MEASUREMENT DFES_numDFC "Namen der im Fehlerspeicher eingetragenen Fehlerprüfungen" UWORD DFCDSQ_Verb 1 100 0.00 1213. FORMAT "%2.0" ARRAY_SIZE 20 ECU_ADDRESS 0xD0008C3E /end MEASUREMENT
/begin MEASUREMENT DFES_numEntryAvl "Anzahl der möglichen Fehlerspeichereintraege" UBYTE DFES_OneToOne 1 100 0.00 255.0 ECU_ADDRESS 0xC0006B4E /end MEASUREMENT
/begin MEASUREMENT DFES_numEnvSize "Anzahl der Bytes in einem Umweltdatenblock" UBYTE DFES_OneToOne 1 100 0.00 255.0 ECU_ADDRESS 0xC0006B51 /end MEASUREMENT
/begin MEASUREMENT DFES_numExtdFrzFrmSize "Größe des extended freeze frame" UBYTE DFES_OneToOne 1 100 0.00 255.0 ECU_ADDRESS 0xC0006B50 /end MEASUREMENT
/begin MEASUREMENT DFES_numFrzFrmSize "Anzahl der Bytes im Freeze Frame" UBYTE DFES_OneToOne 1 100 0.00 255.0 ECU_ADDRESS 0xC0006B4F /end MEASUREMENT
/begin MEASUREMENT DFES_Order "Auftragsstatus aller Fehlerspeichereinträge" UWORD DFES_OneToOne 1 100 0.00 65535.00 ARRAY_SIZE 20 ECU_ADDRESS 0xD00038CC /end MEASUREMENT
/begin MEASUREMENT DFES_OutLamps "Fehlerlampenzustand aller Fehlerspeichereinträge" UBYTE DFES_OneToOne 1 100 0.00 255.0 ARRAY_SIZE 20 ECU_ADDRESS 0xC0006B07 /end MEASUREMENT
/begin MEASUREMENT DFES_OutTester "Testersichtbarkeit aller Fehlerspeichereinträge" UBYTE DFES_OneToOne 1 100 0.00 255.0 ARRAY_SIZE 20 ECU_ADDRESS 0xC0006B1B /end MEASUREMENT
/begin MEASUREMENT DFES_stChk "Prüfungsstatus aller im Fehlerspeicher eingetragenen DFCs" UBYTE DFES_stCheck_Verb 1 100 0.00 247.000000000 FORMAT "%13.9" ARRAY_SIZE 20 ECU_ADDRESS 0xD0008C7A /end MEASUREMENT
/begin MEASUREMENT DFES_stChkFault "DSM interner Fehlerstatus aller im Fehlerspeicher eingetragenen DFCs" UBYTE DFES_OneToOne 1 100 0.00 255.0 ARRAY_SIZE 20 ECU_ADDRESS 0xD0008C8E /end MEASUREMENT
/begin MEASUREMENT DFES_stCounters "Zählerstatus aller im Fehlerspeicher eingetragenen DFCs" UBYTE DFES_stCnt_Verb 1 100 0.00 85.0000000000 FORMAT "%13.10" ARRAY_SIZE 20 ECU_ADDRESS 0xD0008CA2 /end MEASUREMENT
/begin MEASUREMENT DFES_stEntry "Eintragsstatus aller im Fehlerspeicher eingetragenen DFCs" UBYTE DFES_stEntry_Verb 1 100 0.00 158.000000000 FORMAT "%13.9" ARRAY_SIZE 20 ECU_ADDRESS 0xD0008C66 /end MEASUREMENT
/begin MEASUREMENT DFES_stErrDia "DSM interne Testersichtbarkeit aller im Fehlerspeicher eingetragenen DFCs" UBYTE DFES_OneToOne 1 100 0.00 255.0 ECU_ADDRESS 0xC0006B48 /end MEASUREMENT
/begin MEASUREMENT DFES_stErrLamp "DFES Lampenstatus" UBYTE DFES_OneToOne 1 100 0.00 255.0 ECU_ADDRESS 0xC0006B47 /end MEASUREMENT
/begin MEASUREMENT DFES_stOutstate "DSM interner Validierungszustand der berechneten Testersichtbarkeiten und Lampenansteuerung" UBYTE DFES_OneToOne 1 100 0.00 255.0 ECU_ADDRESS 0xC0006B52 /end MEASUREMENT
/begin FUNCTION DFC ""
 /begin DEF_CHARACTERISTIC DFC_DisblMsk.DFC_FlFltDsPSRCMin_C DFC_DisblMsk.DFC_FlFltSig_C DFC_DisblMsk.DFC_FlFltUsPSRCMax_C DFC_DisblMsk.DFC_FlFltUsPSRCMin_C DFC_DisblMsk.DFC_FuelTSRCMax_C DFC_DisblMsk.DFC_FuelTSRCMin_C DFC_DisblMsk.DFC_GbxNPosPPerSRCMax_C DFC_DisblMsk.DFC_GbxNPosPPerSRCMin_C DFC_DisblMsk.DFC_GbxNPosPdcycSRCMax_C DFC_DisblMsk.DFC_GbxNPosPdcycSRCMin_C DFC_DisblMsk.DFC_InjVlvPresMin_C DFC_DisblMsk.DFC_LSUCircNernstSig_C DFC_DisblMsk.DFC_LSUCircPmpCurSig_C DFC_DisblMsk.DFC_LSUCircVirtGndSig_C DFC_DisblMsk.DFC_LSUO2Max_C DFC_DisblMsk.DFC_LSUO2Min_C DFC_DisblMsk.DFC_LSUSPIBattLowMin_C DFC_DisblMsk.DFC_LSUWireSCB_C DFC_DisblMsk.DFC_LSUWireSCG_C DFC_DisblMsk.DFC_MeUnSCG_C DFC_DisblMsk.DFC_NSCDsCmpChk_C DFC_DisblMsk.DFC_NSCDsLamBinSRCMax_C DFC_DisblMsk.DFC_NSCDsLamBinSRCMin_C DFC_DisblMsk.DFC_NSCDsLamLinSRCMax_C DFC_DisblMsk.DFC_NSCDsLamLinSRCMin_C DFC_DisblMsk.DFC_NSCDsLamPlausMax_C DFC_DisblMsk.DFC_NSCDsLamPlausMin_C DFC_DisblMsk.DFC_NSCDsNOxSRCMax_C DFC_DisblMsk.DFC_NSCDsNOxSRCMin_C DFC_DisblMsk.DFC_NSCDsOpCir_C DFC_DisblMsk.DFC_NSCDsShCir_C DFC_DisblMsk.DFC_NoCat2DsCmpChk_C DFC_DisblMsk.DFC_NoCat2DsLamBinSRCMax_C DFC_DisblMsk.DFC_NoCat2DsLamBinSRCMin_C DFC_DisblMsk.DFC_NoCat2DsLamLinSRCMax_C DFC_DisblMsk.DFC_NoCat2DsLamLinSRCMin_C DFC_DisblMsk.DFC_NoCat2DsLamPlausMax_C DFC_DisblMsk.DFC_NoCat2DsLamPlausMin_C DFC_DisblMsk.DFC_NoCat2DsNOxSRCMax_C DFC_DisblMsk.DFC_NoCat2DsNOxSRCMin_C DFC_DisblMsk.DFC_NoCat2DsOpCir_C DFC_DisblMsk.DFC_NoCat2DsShCir_C DFC_DisblMsk.DFC_NplDynPPFltDiff_C DFC_DisblMsk.DFC_NplHsChngPPFltDiff_C DFC_DisblMsk.DFC_NplHsLnPPFltDiff_C DFC_DisblMsk.DFC_NplTOxiCatUs_C DFC_DisblMsk.DFC_NplTPFltUs_C DFC_DisblMsk.DFC_NplTTrbnUs_C DFC_DisblMsk.DFC_OilPSwmpSRCMax_C DFC_DisblMsk.DFC_OilPSwmpSRCMin_C DFC_DisblMsk.DFC_PCVSCG_C DFC_DisblMsk.DFC_PFltCharPDiffMin_C DFC_DisblMsk.DFC_PFltDstrMin_C DFC_DisblMsk.DFC_PFltEngPrt_C DFC_DisblMsk.DFC_PFltRgnPerm_C DFC_DisblMsk.DFC_PFltSRCMaxFlwRstn_C DFC_DisblMsk.DFC_PFltSRCMinFlwRstn_C DFC_DisblMsk.DFC_PFltSotMsDvtMax_C DFC_DisblMsk.DFC_PFltSotMsDvtMin_C DFC_DisblMsk.DFC_PFltSotMsMax_C DFC_DisblMsk.DFC_PIntkVUsSRCMax_C DFC_DisblMsk.DFC_PIntkVUsSRCMin_C DFC_DisblMsk.DFC_SRCHighAPP1_C DFC_DisblMsk.DFC_SRCHighAPP2_C DFC_DisblMsk.DFC_SRCLowAPP1_C DFC_DisblMsk.DFC_SRCLowAPP2_C DFC_DisblMsk.DFC_SRCMaxPPFltDiff_C DFC_DisblMsk.DFC_SRCMaxPPFltUs_C DFC_DisblMsk.DFC_SRCMaxTECU_C DFC_DisblMsk.DFC_SRCMaxTOxiCatUs_C DFC_DisblMsk.DFC_SRCMaxTPFltUs_C DFC_DisblMsk.DFC_SRCMaxTTrbnUs_C DFC_DisblMsk.DFC_SRCMaxUCatUsT_C DFC_DisblMsk.DFC_SRCMaxUPmpP_C DFC_DisblMsk.DFC_SRCMinPPFltDiff_C DFC_DisblMsk.DFC_SRCMinPPFltUs_C DFC_DisblMsk.DFC_SRCMinTECU_C DFC_DisblMsk.DFC_SRCMinTOxiCatUs_C DFC_DisblMsk.DFC_SRCMinTPFltUs_C DFC_DisblMsk.DFC_SRCMinTTrbnUs_C DFC_DisblMsk.DFC_SRCMinUCatUsT_C DFC_DisblMsk.DFC_SRCMinUPmpP_C DFC_DisblMsk.DFC_SigUCatUsT_C DFC_DisblMsk.DFC_SigUPmpP_C DFC_DisblMsk.DFC_SyncAPP_C DFC_DisblMsk.DFC_T15Npl_C DFC_DisblMsk.DFC_TAFSDtyCycHi_C DFC_DisblMsk.DFC_TAFSDtyCycLo_C DFC_DisblMsk.DFC_TAFSPerHi_C DFC_DisblMsk.DFC_TAFSPerLo_C DFC_DisblMsk.DFC_TCACDsSRCMax_C DFC_DisblMsk.DFC_TCACDsSRCMin_C DFC_DisblMsk.DFC_ThrVlvSRCMax_C DFC_DisblMsk.DFC_ThrVlvSRCMin_C DFC_DisblMsk.DFC_TrbChLPOL_C DFC_DisblMsk.DFC_TrbChLPSCB_C DFC_DisblMsk.DFC_TrbChLPSCG_C DFC_DisblMsk.DFC_UHtrPLOL_C DFC_DisblMsk.DFC_UHtrPLSCB_C DFC_DisblMsk.DFC_UHtrPLSCG_C DFC_DisblMsk.DFC_UHtrPLSRCMaxDia_C DFC_DisblMsk.DFC_UHtrPLSRCMinDia_C DFC_DisblMsk.DFC_UHtrTnkOL_C DFC_DisblMsk.DFC_UHtrTnkSCB_C DFC_DisblMsk.DFC_UHtrTnkSCG_C DFC_DisblMsk.DFC_UHtrTnkSRCMaxDia_C DFC_DisblMsk.DFC_UHtrTnkSRCMinDia_C DFC_DisblMsk.DFC_URevVlvOL_C DFC_DisblMsk.DFC_URevVlvSCB_C DFC_DisblMsk.DFC_URevVlvSCG_C DFC_DisblMsk.DFC_UTnkTSRCMax_C DFC_DisblMsk.DFC_UTnkTSRCMin_C DFC_DisblMsk.DFC_UTnkTSig_C DFC_DisblMsk.DFC_VSwVlvGovDvtMax_C DFC_DisblMsk.DFC_VSwVlvGovDvtMin_C DFC_DisblMsk.DFC_VSwVlvHBrgOpnLd_C DFC_DisblMsk.DFC_VSwVlvHBrgOvrCurr_C DFC_DisblMsk.DFC_VSwVlvHBrgOvrTemp_C DFC_DisblMsk.DFC_VSwVlvHBrgShCirBatt1_C DFC_DisblMsk.DFC_VSwVlvHBrgShCirBatt2_C DFC_DisblMsk.DFC_VSwVlvHBrgShCirGnd1_C DFC_DisblMsk.DFC_VSwVlvHBrgShCirGnd2_C DFC_DisblMsk.DFC_VSwVlvHBrgShCirOvrLd_C DFC_DisblMsk.DFC_VSwVlvHBrgTempOvrCurr_C DFC_DisblMsk.DFC_VSwVlvHBrgUndrVltg_C DFC_DisblMsk.DFC_VSwVlvOL_C DFC_DisblMsk.DFC_VSwVlvSCB_C DFC_DisblMsk.DFC_VSwVlvSCG_C DFC_DisblMsk.DFC_VSwVlvSRCMax_C DFC_DisblMsk.DFC_VSwVlvSRCMin_C DFC_DisblMsk.DFC_ClthNpl_C DFC_DisblMsk.DFC_ETClbETMax_0_C DFC_DisblMsk.DFC_ETClbETMax_1_C DFC_DisblMsk.DFC_ETClbETMax_2_C DFC_DisblMsk.DFC_ETClbETMax_3_C DFC_DisblMsk.DFC_ETClbETMax_4_C DFC_DisblMsk.DFC_ETClbETMax_5_C DFC_DisblMsk.DFC_ETClbETMin_0_C DFC_DisblMsk.DFC_ETClbETMin_1_C DFC_DisblMsk.DFC_ETClbETMin_2_C DFC_DisblMsk.DFC_ETClbETMin_3_C DFC_DisblMsk.DFC_ETClbETMin_4_C DFC_DisblMsk.DFC_ETClbETMin_5_C DFC_DisblMsk.DFC_IVActrEnrgMax_0_C DFC_DisblMsk.DFC_IVActrEnrgMax_1_C DFC_DisblMsk.DFC_IVActrEnrgMax_2_C DFC_DisblMsk.DFC_IVActrEnrgMax_3_C DFC_DisblMsk.DFC_IVActrEnrgMax_4_C DFC_DisblMsk.DFC_IVActrEnrgMax_5_C DFC_DisblMsk.DFC_IVActrEnrgMax_6_C DFC_DisblMsk.DFC_IVActrEnrgMax_7_C DFC_DisblMsk.DFC_IVActrEnrgMin_0_C DFC_DisblMsk.DFC_IVActrEnrgMin_1_C DFC_DisblMsk.DFC_IVActrEnrgMin_2_C DFC_DisblMsk.DFC_IVActrEnrgMin_3_C DFC_DisblMsk.DFC_IVActrEnrgMin_4_C DFC_DisblMsk.DFC_IVActrEnrgMin_5_C DFC_DisblMsk.DFC_IVActrEnrgMin_6_C DFC_DisblMsk.DFC_IVActrEnrgMin_7_C DFC_DisblMsk.DFC_IVActrEnrgPlaus_0_C DFC_DisblMsk.DFC_IVActrEnrgPlaus_1_C DFC_DisblMsk.DFC_IVActrEnrgPlaus_2_C DFC_DisblMsk.DFC_IVActrEnrgPlaus_3_C DFC_DisblMsk.DFC_IVActrEnrgPlaus_4_C DFC_DisblMsk.DFC_IVActrEnrgPlaus_5_C DFC_DisblMsk.DFC_IVActrEnrgPlaus_6_C DFC_DisblMsk.DFC_IVActrEnrgPlaus_7_C DFC_DisblMsk.DFC_IVCtlTiDiff_0_C DFC_DisblMsk.DFC_IVCtlTiDiff_1_C DFC_DisblMsk.DFC_IVCtlTiDiff_2_C DFC_DisblMsk.DFC_IVCtlTiDiff_3_C DFC_DisblMsk.DFC_IVCtlTiDiff_4_C DFC_DisblMsk.DFC_IVCtlTiDiff_5_C DFC_DisblMsk.DFC_IVCtlUDiffUp_0_C DFC_DisblMsk.DFC_IVCtlUDiffUp_1_C DFC_DisblMsk.DFC_IVCtlUDiffUp_2_C DFC_DisblMsk.DFC_IVCtlUDiffUp_3_C DFC_DisblMsk.DFC_IVCtlUDiffUp_4_C DFC_DisblMsk.DFC_IVCtlUDiffUp_5_C DFC_DisblMsk.DFC_IVCtlUUp_0_C DFC_DisblMsk.DFC_IVCtlUUp_1_C DFC_DisblMsk.DFC_IVCtlUUp_2_C DFC_DisblMsk.DFC_IVCtlUUp_3_C DFC_DisblMsk.DFC_IVCtlUUp_4_C DFC_DisblMsk.DFC_IVCtlUUp_5_C DFC_DisblMsk.DFC_IVDiaBnkShCir_0_C DFC_DisblMsk.DFC_IVDiaBnkShCir_1_C DFC_DisblMsk.DFC_IVDiaBnkShCirChSwt_0_C DFC_DisblMsk.DFC_IVDiaBnkShCirChSwt_1_C DFC_DisblMsk.DFC_IVDiaChp_0_C DFC_DisblMsk.DFC_IVDiaChp_1_C DFC_DisblMsk.DFC_IVDiaCylNoCls_0_C DFC_DisblMsk.DFC_IVDiaCylNoCls_1_C DFC_DisblMsk.DFC_IVDiaCylNoCls_2_C DFC_DisblMsk.DFC_IVDiaCylNoCls_3_C DFC_DisblMsk.DFC_IVDiaCylNoCls_4_C DFC_DisblMsk.DFC_IVDiaCylNoCls_5_C DFC_DisblMsk.DFC_IVDiaCylNoLd_0_C DFC_DisblMsk.DFC_IVDiaCylNoLd_1_C DFC_DisblMsk.DFC_IVDiaCylNoLd_2_C DFC_DisblMsk.DFC_IVDiaCylNoLd_3_C DFC_DisblMsk.DFC_IVDiaCylNoLd_4_C DFC_DisblMsk.DFC_IVDiaCylNoLd_5_C DFC_DisblMsk.DFC_IVDiaCylShCir_0_C DFC_DisblMsk.DFC_IVDiaCylShCir_1_C DFC_DisblMsk.DFC_IVDiaCylShCir_2_C DFC_DisblMsk.DFC_IVDiaCylShCir_3_C DFC_DisblMsk.DFC_IVDiaCylShCir_4_C DFC_DisblMsk.DFC_IVDiaCylShCir_5_C DFC_DisblMsk.DFC_IVDiaCylShCirHSLS_0_C DFC_DisblMsk.DFC_IVDiaCylShCirHSLS_1_C DFC_DisblMsk.DFC_IVDiaCylShCirHSLS_2_C DFC_DisblMsk.DFC_IVDiaCylShCirHSLS_3_C DFC_DisblMsk.DFC_IVDiaCylShCirHSLS_4_C DFC_DisblMsk.DFC_IVDiaCylShCirHSLS_5_C DFC_DisblMsk.DFC_IVDiaCylShCirMeas_0_C DFC_DisblMsk.DFC_IVDiaCylShCirMeas_1_C DFC_DisblMsk.DFC_IVDiaCylShCirMeas_2_C DFC_DisblMsk.DFC_IVDiaCylShCirMeas_3_C DFC_DisblMsk.DFC_IVDiaCylShCirMeas_4_C DFC_DisblMsk.DFC_IVDiaCylShCirMeas_5_C DFC_DisblMsk.DFC_LSUDynChk_C DFC_DisblMsk.DFC_LSUO2ClbMax_C DFC_DisblMsk.DFC_LSUO2ClbMin_C DFC_DisblMsk.DFC_LSUO2PlausMaxFLd_C DFC_DisblMsk.DFC_LSUO2PlausMaxOvrRun_C DFC_DisblMsk.DFC_LSUO2PlausMaxPartLd_C DFC_DisblMsk.DFC_LSUO2PlausMinFLd_C DFC_DisblMsk.DFC_LSUO2PlausMinOvrRun_C DFC_DisblMsk.DFC_LSUO2PlausMinPartLd_C DFC_DisblMsk.DFC_LSURiClbMax_C DFC_DisblMsk.DFC_LSURiClbMin_C DFC_DisblMsk.DFC_LSUWireIPSig_C DFC_DisblMsk.DFC_Layer_BSDMax_C DFC_DisblMsk.DFC_Layer_BSDMin_C DFC_DisblMsk.DFC_Layer_BSDNpl_C DFC_DisblMsk.DFC_Layer_BSDSig_C DFC_DisblMsk.DFC_Layer_FltMngTstMax_C DFC_DisblMsk.DFC_Layer_FltMngTstMin_C DFC_DisblMsk.DFC_Layer_FltMngTstNpl_C DFC_DisblMsk.DFC_Layer_FltMngTstSig_C DFC_DisblMsk.DFC_Layer_GENELBMax_C DFC_DisblMsk.DFC_Layer_GENELBMin_C DFC_DisblMsk.DFC_Layer_GENELBNpl_C DFC_DisblMsk.DFC_Layer_GENELBSig_C DFC_DisblMsk.DFC_Layer_GENELMax_C DFC_DisblMsk.DFC_Layer_GENELMin_C DFC_DisblMsk.DFC_Layer_GENELNpl_C DFC_DisblMsk.DFC_Layer_GENELSig_C DFC_DisblMsk.DFC_Layer_GENHTBMax_C DFC_DisblMsk.DFC_Layer_GENHTBMin_C DFC_DisblMsk.DFC_Layer_GENHTBNpl_C DFC_DisblMsk.DFC_Layer_GENHTBSig_C DFC_DisblMsk.DFC_Layer_GENHTMax_C DFC_DisblMsk.DFC_Layer_GENHTMin_C DFC_DisblMsk.DFC_Layer_GENHTNpl_C DFC_DisblMsk.DFC_Layer_GENHTSig_C DFC_DisblMsk.DFC_Layer_GENKOMMMax_C DFC_DisblMsk.DFC_Layer_GENKOMMMin_C DFC_DisblMsk.DFC_Layer_GENKOMMNpl_C DFC_DisblMsk.DFC_Layer_GENKOMMSig_C DFC_DisblMsk.DFC_Layer_GENMECHMax_C DFC_DisblMsk.DFC_Layer_GENMECHMin_C DFC_DisblMsk.DFC_Layer_GENMECHNpl_C DFC_DisblMsk.DFC_Layer_GENMECHSig_C DFC_DisblMsk.DFC_Layer_GENMax_C DFC_DisblMsk.DFC_Layer_GENMin_C DFC_DisblMsk.DFC_Layer_GENNpl_C DFC_DisblMsk.DFC_Layer_GENREGUPLMax_C DFC_DisblMsk.DFC_Layer_GENREGUPLMin_C DFC_DisblMsk.DFC_Layer_GENREGUPLNpl_C DFC_DisblMsk.DFC_Layer_GENREGUPLSig_C DFC_DisblMsk.DFC_Layer_GENSig_C DFC_DisblMsk.DFC_Layer_GENUPLMax_C DFC_DisblMsk.DFC_Layer_GENUPLMin_C DFC_DisblMsk.DFC_Layer_GENUPLNpl_C DFC_DisblMsk.DFC_Layer_GENUPLSig_C DFC_DisblMsk.DFC_Layer_IBS1Max_C DFC_DisblMsk.DFC_Layer_IBS1Min_C DFC_DisblMsk.DFC_Layer_IBS1Npl_C DFC_DisblMsk.DFC_Layer_IBS1Sig_C DFC_DisblMsk.DFC_Layer_IBS2Max_C DFC_DisblMsk.DFC_Layer_IBS2Min_C DFC_DisblMsk.DFC_Layer_IBS2Npl_C DFC_DisblMsk.DFC_Layer_IBS2Sig_C DFC_DisblMsk.DFC_Layer_IBS3Max_C DFC_DisblMsk.DFC_Layer_IBS3Min_C DFC_DisblMsk.DFC_Layer_IBS3Npl_C DFC_DisblMsk.DFC_Layer_IBS3Sig_C DFC_DisblMsk.DFC_Layer_MANDETEKMax_C DFC_DisblMsk.DFC_Layer_MANDETEKMin_C DFC_DisblMsk.DFC_Layer_MANDETEKNpl_C DFC_DisblMsk.DFC_Layer_MANDETEKSig_C DFC_DisblMsk.DFC_Layer_NDR1Max_C DFC_DisblMsk.DFC_Layer_NDR1Min_C DFC_DisblMsk.DFC_Layer_NDR1Npl_C DFC_DisblMsk.DFC_Layer_NDR1Sig_C DFC_DisblMsk.DFC_Layer_NDR2Max_C DFC_DisblMsk.DFC_Layer_NDR2Min_C DFC_DisblMsk.DFC_Layer_NDR2Npl_C DFC_DisblMsk.DFC_Layer_NDR2Sig_C DFC_DisblMsk.DFC_Layer_NGLERNMax_C DFC_DisblMsk.DFC_Layer_NGLERNMin_C DFC_DisblMsk.DFC_Layer_NGLERNNpl_C DFC_DisblMsk.DFC_Layer_NGLERNSig_C DFC_DisblMsk.DFC_Layer_PMBATTMax_C DFC_DisblMsk.DFC_Layer_PMBATTMin_C DFC_DisblMsk.DFC_Layer_PMBATTNpl_C DFC_DisblMsk.DFC_Layer_PMBATTSig_C DFC_DisblMsk.DFC_Layer_PMBNMax_C DFC_DisblMsk.DFC_Layer_PMBNMin_C DFC_DisblMsk.DFC_Layer_PMBNNpl_C DFC_DisblMsk.DFC_Layer_PMBNSig_C DFC_DisblMsk.DFC_Layer_PMRUHVERLMax_C DFC_DisblMsk.DFC_Layer_PMRUHVERLMin_C DFC_DisblMsk.DFC_Layer_PMRUHVERLNpl_C DFC_DisblMsk.DFC_Layer_PMRUHVERLSig_C DFC_DisblMsk.DFC_Layer_QLTMax_C DFC_DisblMsk.DFC_Layer_QLTMin_C DFC_DisblMsk.DFC_Layer_QLTNpl_C DFC_DisblMsk.DFC_Layer_QLTSig_C DFC_DisblMsk.DFC_Layer_TOENSMax_C DFC_DisblMsk.DFC_Layer_TOENSMin_C DFC_DisblMsk.DFC_Layer_TOENSNpl_C DFC_DisblMsk.DFC_Layer_TOENSSig_C DFC_DisblMsk.DFC_MonLimCurr_C DFC_DisblMsk.DFC_MonLimLead_C DFC_DisblMsk.DFC_MonLimSet_C DFC_DisblMsk.DFC_NSCDsNOxOfsMax_C DFC_DisblMsk.DFC_NSCDsNOxOfsMin_C DFC_DisblMsk.DFC_NSCDsNOxPlausMin_C DFC_DisblMsk.DFC_NoCat2DsNOxOfsMax_C DFC_DisblMsk.DFC_NoCat2DsNOxOfsMin_C DFC_DisblMsk.DFC_NoCat2DsNOxPlausMin_C DFC_DisblMsk.DFC_PCVNoStrt_C DFC_DisblMsk.DFC_RailPGradMon_C DFC_DisblMsk.DFC_SCRPODPresBuildUp_C DFC_DisblMsk.DFC_AFSDrftIdlAdjVal_C DFC_DisblMsk.DFC_AFSDrftLdAdjVal_C DFC_DisblMsk.DFC_AdcIADC0Cal_C DFC_DisblMsk.DFC_AdcIADC0Conv_C DFC_DisblMsk.DFC_AdcIADC1Cal_C DFC_DisblMsk.DFC_AdcIADC1Conv_C DFC_DisblMsk.DFC_CmbChbMisfireMax_0_C DFC_DisblMsk.DFC_CmbChbMisfireMax_1_C DFC_DisblMsk.DFC_CmbChbMisfireMax_2_C DFC_DisblMsk.DFC_CmbChbMisfireMax_3_C DFC_DisblMsk.DFC_CmbChbMisfireMax_4_C DFC_DisblMsk.DFC_CmbChbMisfireMax_5_C DFC_DisblMsk.DFC_CmbChbMisfireMul_C DFC_DisblMsk.DFC_EGRVlvLPOfsNeutr_C DFC_DisblMsk.DFC_EGRVlvOfsNeutr_C DFC_DisblMsk.DFC_FMAErrModMax_C DFC_DisblMsk.DFC_FMAErrModMin_C DFC_DisblMsk.DFC_FlSysTnkLo_C DFC_DisblMsk.DFC_GbxNPosPlaus_C DFC_DisblMsk.DFC_I14229_ROETst_Appl_C DFC_DisblMsk.DFC_I14229_ROETst_Netw_C DFC_DisblMsk.DFC_I14229_ROE_BufFull_C DFC_DisblMsk.DFC_IVAdjDiaIVAdj_C DFC_DisblMsk.DFC_IVAdjIVA_0_C DFC_DisblMsk.DFC_IVAdjIVA_1_C DFC_DisblMsk.DFC_IVAdjIVA_2_C DFC_DisblMsk.DFC_IVAdjIVA_3_C DFC_DisblMsk.DFC_IVAdjIVA_4_C DFC_DisblMsk.DFC_IVAdjIVA_5_C DFC_DisblMsk.DFC_IVPSplyDCDCOff_0_C DFC_DisblMsk.DFC_IVPSplyDCDCOff_1_C DFC_DisblMsk.DFC_IVPSplyDCDCOff_2_C DFC_DisblMsk.DFC_IVPSplyDCDCOff_3_C DFC_DisblMsk.DFC_InjCtlAdjQntEEPCS_C DFC_DisblMsk.DFC_LSUSPISig_C DFC_DisblMsk.DFC_Layer_Dummy_C DFC_DisblMsk.DFC_NplEnvPSensPPFltDiff_C DFC_DisblMsk.DFC_NplPresSensPPFltDiff_C DFC_DisblMsk.DFC_OilLvlPlaus_C DFC_DisblMsk.DFC_OilTOutLvl_C DFC_DisblMsk.DFC_PCVfacAdaptMax_C DFC_DisblMsk.DFC_PCVfacAdaptMin_C DFC_DisblMsk.DFC_SensFrzPPFltUs_C DFC_DisblMsk.DFC_SensMonUTnkLvl_C DFC_DisblMsk.DFC_T15Sig_C DFC_DisblMsk.DFC_AirCtlRmpTOut_C DFC_DisblMsk.DFC_BrkPPlaus_C DFC_DisblMsk.DFC_CEngDsTDynTst_C DFC_DisblMsk.DFC_EEPEraseErr_C DFC_DisblMsk.DFC_EEPRdErr_C DFC_DisblMsk.DFC_EEPWrErr_C DFC_DisblMsk.DFC_EGRVlvJamVlvClsd_C DFC_DisblMsk.DFC_EGRVlvJamVlvOpn_C DFC_DisblMsk.DFC_EGRVlvLPJamVlvClsd_C DFC_DisblMsk.DFC_EGRVlvLPJamVlvOpn_C DFC_DisblMsk.DFC_EGRVlvLPLgTDrft_C DFC_DisblMsk.DFC_EGRVlvLPOfsLrnJamVlv_C DFC_DisblMsk.DFC_EGRVlvLPShTDrft_C DFC_DisblMsk.DFC_EGRVlvLgTDrft_C DFC_DisblMsk.DFC_EGRVlvOfsLrnJamVlv_C DFC_DisblMsk.DFC_EGRVlvShTDrft_C DFC_DisblMsk.DFC_EngICO_C DFC_DisblMsk.DFC_EpmCaSI1ErrSig_C DFC_DisblMsk.DFC_EpmCaSI1NoSig_C DFC_DisblMsk.DFC_EpmCaSI1OfsErr_C DFC_DisblMsk.DFC_EpmCrSErrSig_C DFC_DisblMsk.DFC_EpmCrSNoSig_C DFC_DisblMsk.DFC_IVPlausComprTst_C DFC_DisblMsk.DFC_IVPlausRunUpTst_C DFC_DisblMsk.DFC_InjCrvShOffTst_C DFC_DisblMsk.DFC_LayerEnSavModProd_C DFC_DisblMsk.DFC_LayerEnSavModRep_C DFC_DisblMsk.DFC_LayerEnSavModShip_C DFC_DisblMsk.DFC_MRlyErlyOpng_C DFC_DisblMsk.DFC_MRlyStk_C DFC_DisblMsk.DFC_MeUnActrTst_C DFC_DisblMsk.DFC_MoCADCCmp_C DFC_DisblMsk.DFC_MoCADCTst_C DFC_DisblMsk.DFC_MoCADCVltgRatio_C DFC_DisblMsk.DFC_MoCComErrCnt_C DFC_DisblMsk.DFC_MoCComSPI_C DFC_DisblMsk.DFC_MoCROMErrXPg_C DFC_DisblMsk.DFC_MoCSOPHwNoRdy_C DFC_DisblMsk.DFC_MoCSOPLoLi_C DFC_DisblMsk.DFC_MoCSOPMM_C DFC_DisblMsk.DFC_MoCSOPTimeOut_C DFC_DisblMsk.DFC_MoCSOPUpLi_C DFC_DisblMsk.DFC_MoFAPP_C DFC_DisblMsk.DFC_MoFESpd_C DFC_DisblMsk.DFC_MoFInjDatPhi_C DFC_DisblMsk.DFC_MoFInjDatQnt_C DFC_DisblMsk.DFC_MoFInjQnt_C DFC_DisblMsk.DFC_MoFMode1PoI1_C DFC_DisblMsk.DFC_MoFMode1PoI2_C DFC_DisblMsk.DFC_MoFMode2PoI1_C DFC_DisblMsk.DFC_MoFMode2PoI2_C DFC_DisblMsk.DFC_MoFOvR_C DFC_DisblMsk.DFC_MoFQntCor_C DFC_DisblMsk.DFC_MoFRailP_C DFC_DisblMsk.DFC_MoFTrqCmp_C DFC_DisblMsk.DFC_NSCDsHtrSetP_C DFC_DisblMsk.DFC_NoCat2DsHtrSetP_C DFC_DisblMsk.DFC_PCVActrTst_C DFC_DisblMsk.DFC_PhyModNonMonMapNpl_C DFC_DisblMsk.DFC_RailHpTst_C DFC_DisblMsk.DFC_RailPOfsTstMax_C DFC_DisblMsk.DFC_RailPOfsTstMin_C DFC_DisblMsk.DFC_SIA_E1max_C DFC_DisblMsk.DFC_SIA_E1min_C DFC_DisblMsk.DFC_SIA_E1npl_C DFC_DisblMsk.DFC_SIA_E1sig_C DFC_DisblMsk.DFC_SIA_E2max_C DFC_DisblMsk.DFC_SIA_E2min_C DFC_DisblMsk.DFC_SIA_E2npl_C DFC_DisblMsk.DFC_SIA_E2sig_C DFC_DisblMsk.DFC_SIA_E3max_C DFC_DisblMsk.DFC_SIA_E3min_C DFC_DisblMsk.DFC_SIA_E3npl_C DFC_DisblMsk.DFC_SIA_E3sig_C DFC_DisblMsk.DFC_SIA_E4max_C DFC_DisblMsk.DFC_SIA_E4min_C DFC_DisblMsk.DFC_SIA_E4npl_C DFC_DisblMsk.DFC_SIA_E4sig_C DFC_DisblMsk.DFC_SWReset_0_C DFC_DisblMsk.DFC_SWReset_1_C DFC_DisblMsk.DFC_SWReset_2_C DFC_DisblMsk.DFC_ShtrAKKMax_C DFC_DisblMsk.DFC_ShtrAKKMin_C DFC_DisblMsk.DFC_ShtrAKKNpl_C DFC_DisblMsk.DFC_ShtrPKKMax_C DFC_DisblMsk.DFC_StopCntTmr_C DFC_DisblMsk.DFC_ThrVlvMon_C DFC_DisblMsk.DFC_VSwVlvJamVlv_C DFC_DisblMsk.DFC_VSwVlvLgTDrft_C DFC_DisblMsk.DFC_VSwVlvOfsLrnJamVlv_C DFC_DisblMsk.DFC_VSwVlvOfsNeutr_C DFC_DisblMsk.DFC_VSwVlvShTDrft_C DFC_DisblMsk.DFC_VSwVlvSpgDef_C /end DEF_CHARACTERISTIC
/end FUNCTION
/begin FUNCTION DFES ""
 /begin DEF_CHARACTERISTIC DFES_Cls.DFC_Unused_C DFES_Cls.DFC_ACCIPlausDrvAst_C DFES_Cls.DFC_ACCIPlausTrqDes_C DFES_Cls.DFC_AirCtlGovDvtEOMMax_C DFES_Cls.DFC_AirCtlGovDvtEOMMin_C DFES_Cls.DFC_AirCtlGovDvtMax_C DFES_Cls.DFC_AirCtlGovDvtMin_C DFES_Cls.DFC_AirCtlGovLPDvtMax_C DFES_Cls.DFC_AirCtlGovLPDvtMin_C DFES_Cls.DFC_AltIOComErr_C DFES_Cls.DFC_AltIOComNpl_C DFES_Cls.DFC_BusDiagBusOffFlexRay_C DFES_Cls.DFC_BusDiagBusOffNodeA_C DFES_Cls.DFC_BusDiagBusOffNodeB_C DFES_Cls.DFC_BusDiagBusOffNodeC_C DFES_Cls.DFC_BusDiagHwFlexRay_C DFES_Cls.DFC_Cj945SpiCom1_C DFES_Cls.DFC_ComACDemandSig_FA_C DFES_Cls.DFC_ComACDemandTo_FA_C DFES_Cls.DFC_ComATempSig_FA_C DFES_Cls.DFC_ComATempTo_FA_C DFES_Cls.DFC_ComATempTo_FX_C DFES_Cls.DFC_ComBrkTrqSumChk_FX_C DFES_Cls.DFC_ComBrkTrqSumCtr_FX_C DFES_Cls.DFC_ComBrkTrqSumTo_FX_C DFES_Cls.DFC_ComBtnDrvDynChk_FX_C DFES_Cls.DFC_ComBtnDrvDynCtr_FX_C DFES_Cls.DFC_ComBtnDrvDynTo_FX_C DFES_Cls.DFC_ComButtonMSASig_C DFES_Cls.DFC_ComButtonMSATo_C DFES_Cls.DFC_ComCodierungPwrmngSig_C DFES_Cls.DFC_ComCodierungPwrmngSig_FA_C DFES_Cls.DFC_ComCrCtlLvrChk_C DFES_Cls.DFC_ComCrCtlLvrCtr_C DFES_Cls.DFC_ComCrCtlLvrSig_C DFES_Cls.DFC_ComCrCtlLvrTo_C DFES_Cls.DFC_ComCtrCrshSwoEkpSig_FA_C DFES_Cls.DFC_ComCtrCrshSwoEkpTo_FA_C DFES_Cls.DFC_ComCtrSecInt_C DFES_Cls.DFC_ComDiaOBDGbxSig_A_C DFES_Cls.DFC_ComDiaOBDGbxTo_A_C DFES_Cls.DFC_ComFahrzeugtypSig_C DFES_Cls.DFC_ComFahrzeugtypSig_FA_C DFES_Cls.DFC_ComFllupGpwsupSig_FA_C DFES_Cls.DFC_ComFllupGpwsupTo_FA_C DFES_Cls.DFC_ComGbxDataChk_A_C DFES_Cls.DFC_ComGbxDataChk_FA_C DFES_Cls.DFC_ComGbxDataCtr_A_C DFES_Cls.DFC_ComGbxDataCtr_FA_C DFES_Cls.DFC_ComGbxDataSig_A_C DFES_Cls.DFC_ComGbxDataSig_FA_C DFES_Cls.DFC_ComGbxDataTo_A_C DFES_Cls.DFC_ComGbxDataTo_FA_C DFES_Cls.DFC_ComKlemmenChk_FA_C DFES_Cls.DFC_ComKlemmenCtr_FA_C DFES_Cls.DFC_ComKlemmenSig_FA_C DFES_Cls.DFC_ComKlemmenTo_FA_C DFES_Cls.DFC_ComLenkradwinkelSig_C DFES_Cls.DFC_ComLenkradwinkelTo_C DFES_Cls.DFC_ComMileageRangeSig_FA_C DFES_Cls.DFC_ComMileageRangeTo_FA_C DFES_Cls.DFC_ComPspSig_C DFES_Cls.DFC_ComPspTo_C DFES_Cls.DFC_ComRelTimeSig_FA_C DFES_Cls.DFC_ComRelTimeTo_FA_C DFES_Cls.DFC_ComRequestEMFChk_C DFES_Cls.DFC_ComRequestEMFCtr_C DFES_Cls.DFC_ComRequestEMFSig_C DFES_Cls.DFC_ComRequestEMFTo_C DFES_Cls.DFC_ComRpmWhlChk_FX_C DFES_Cls.DFC_ComRpmWhlCtr_FX_C DFES_Cls.DFC_ComRpmWhlTo_FX_C DFES_Cls.DFC_ComSecCtrRelSig_FA_C DFES_Cls.DFC_ComSecCtrRelTo_FA_C DFES_Cls.DFC_ComSensNOxGndSig_C DFES_Cls.DFC_ComSensNOxGndTo_C DFES_Cls.DFC_ComSensNOxMode_C DFES_Cls.DFC_ComSensNOxUbattSig_C DFES_Cls.DFC_ComSensNOxUbattTo_C DFES_Cls.DFC_ComShiftPaddleTo_FX_C DFES_Cls.DFC_ComShutOffPSPSig_C DFES_Cls.DFC_ComShutOffPSPTo_C DFES_Cls.DFC_ComSlrdiGlbFZMTo_FA_C DFES_Cls.DFC_ComSlrdiGlbFZMTo_FX_C DFES_Cls.DFC_ComSpeedVehicleChk_FX_C DFES_Cls.DFC_ComSpeedVehicleCtr_FX_C DFES_Cls.DFC_ComSpeedVehicleTo_FX_C DFES_Cls.DFC_ComStConintDSCChk_FX_C DFES_Cls.DFC_ComStConintDSCCtr_FX_C DFES_Cls.DFC_ComStConintDSCTo_FX_C DFES_Cls.DFC_ComStatACFrontSig_FA_C DFES_Cls.DFC_ComStatACFrontTo_FA_C DFES_Cls.DFC_ComStatEkpSig_A_C DFES_Cls.DFC_ComStatEkpTo_A_C DFES_Cls.DFC_ComStatGearRevSig_FA_C DFES_Cls.DFC_ComStatGearRevTo_FA_C DFES_Cls.DFC_ComStatZVKlappenSig_FA_C DFES_Cls.DFC_ComStatZVKlappenTo_FA_C DFES_Cls.DFC_ComStateARSCtr_C DFES_Cls.DFC_ComStateARSSig_C DFES_Cls.DFC_ComStateARSTo_C DFES_Cls.DFC_ComStateDscSig_C DFES_Cls.DFC_ComStateDscTo_C DFES_Cls.DFC_ComStateSeatSig_C DFES_Cls.DFC_ComStateSeatSig_FA_C DFES_Cls.DFC_ComStateSeatTo_C DFES_Cls.DFC_ComStateSeatTo_FA_C DFES_Cls.DFC_ComStatusEGSSig_A_C DFES_Cls.DFC_ComStatusEGSSig_FA_C DFES_Cls.DFC_ComStatusEGSTo_A_C DFES_Cls.DFC_ComStatusEGSTo_FA_C DFES_Cls.DFC_ComStatusEMFChk_C DFES_Cls.DFC_ComStatusEMFCtr_C DFES_Cls.DFC_ComStatusEMFSig_C DFES_Cls.DFC_ComStatusEMFTo_C DFES_Cls.DFC_ComStatusRGangSig_C DFES_Cls.DFC_ComStatusRGangTo_C DFES_Cls.DFC_ComSteeringAngleChk_FX_C DFES_Cls.DFC_ComSteeringAngleCtr_FX_C DFES_Cls.DFC_ComSteeringAngleTo_FX_C DFES_Cls.DFC_ComTerminalChk_C DFES_Cls.DFC_ComTerminalCtr_C DFES_Cls.DFC_ComTerminalSig_C DFES_Cls.DFC_ComTerminalTo_C DFES_Cls.DFC_ComTimeDateSig_FA_C DFES_Cls.DFC_ComTimeDateTo_FA_C DFES_Cls.DFC_ComTrailerSig_C DFES_Cls.DFC_ComTrailerSig_FA_C DFES_Cls.DFC_ComTrailerTo_C DFES_Cls.DFC_ComTrailerTo_FA_C DFES_Cls.DFC_ComTrqDemCrshDrDyChk_FX_C DFES_Cls.DFC_ComTrqDemCrshDrDyCtr_FX_C DFES_Cls.DFC_ComTrqDemCrshDrDyTo_FX_C DFES_Cls.DFC_ComTrqDemandDesSig_C DFES_Cls.DFC_ComTrqDemandDesTo_C DFES_Cls.DFC_ComTrqDemandDscChk_C DFES_Cls.DFC_ComTrqDemandDscCtr_C DFES_Cls.DFC_ComTrqDemandDscSig_C DFES_Cls.DFC_ComTrqDemandDscTo_C DFES_Cls.DFC_ComTrqDemandGbxChk_A_C DFES_Cls.DFC_ComTrqDemandGbxChk_FA_C DFES_Cls.DFC_ComTrqDemandGbxCtr_A_C DFES_Cls.DFC_ComTrqDemandGbxCtr_FA_C DFES_Cls.DFC_ComTrqDemandGbxSig_A_C DFES_Cls.DFC_ComTrqDemandGbxSig_FA_C DFES_Cls.DFC_ComTrqDemandGbxTo_A_C DFES_Cls.DFC_ComTrqDemandGbxTo_FA_C DFES_Cls.DFC_ComTrqWhlDemChk_C DFES_Cls.DFC_ComTrqWhlDemCtr_C DFES_Cls.DFC_ComTrqWhlDemFASChk_FX_C DFES_Cls.DFC_ComTrqWhlDemFASCtr_FX_C DFES_Cls.DFC_ComTrqWhlDemFASTo_FX_C DFES_Cls.DFC_ComTrqWhlDemSig_C DFES_Cls.DFC_ComTrqWhlDemTo_C DFES_Cls.DFC_ComVelocityChk_FA_C DFES_Cls.DFC_ComVelocityCtr_FA_C DFES_Cls.DFC_ComVelocitySig_C DFES_Cls.DFC_ComVelocitySig_FA_C DFES_Cls.DFC_ComVelocityTo_C DFES_Cls.DFC_ComVelocityTo_FA_C DFES_Cls.DFC_ComVerbraucherTo_C DFES_Cls.DFC_ComWMomPTStabChk_FX_C DFES_Cls.DFC_ComWMomPTStabCtr_FX_C DFES_Cls.DFC_ComWMomPTStabTo_FX_C DFES_Cls.DFC_ComWheelSpeedSig_C DFES_Cls.DFC_ComWheelSpeedTo_C DFES_Cls.DFC_ComZvKlappenSig_C DFES_Cls.DFC_ComZvKlappenTo_C DFES_Cls.DFC_ComaDirectChk_FX_C DFES_Cls.DFC_ComaDirectCtr_FX_C DFES_Cls.DFC_ComaDirectTo_FX_C DFES_Cls.DFC_ComaSideChk_FX_C DFES_Cls.DFC_ComaSideCtr_FX_C DFES_Cls.DFC_ComaSideTo_FX_C DFES_Cls.DFC_Cy320SpiCom_C DFES_Cls.DFC_ETCtlDvtInrMax_C DFES_Cls.DFC_ETCtlDvtInrMin_C DFES_Cls.DFC_ETCtlDvtOutrMax_C DFES_Cls.DFC_ETCtlDvtOutrMin_C DFES_Cls.DFC_FBCqDvtMax_C DFES_Cls.DFC_FBCqDvtMin_C DFES_Cls.DFC_Fan4WinErr1_C DFES_Cls.DFC_Fan4WinErr2_C DFES_Cls.DFC_Fan4WinErr3_C DFES_Cls.DFC_Fan4WinErr4_C DFES_Cls.DFC_FanSCG_C DFES_Cls.DFC_FlFCBS_C DFES_Cls.DFC_GlwEcuConfigErr_C DFES_Cls.DFC_GlwEcuEepErr_C DFES_Cls.DFC_GlwEcuFrmErr_C DFES_Cls.DFC_GlwEcuGPCMFaultInfo_C DFES_Cls.DFC_GlwEcuGPCMInfo_C DFES_Cls.DFC_GlwEcuGk1HSS_C DFES_Cls.DFC_GlwEcuGk1OL_C DFES_Cls.DFC_GlwEcuGk1SC_C DFES_Cls.DFC_GlwEcuGk1Wdst_C DFES_Cls.DFC_GlwEcuGk2HSS_C DFES_Cls.DFC_GlwEcuGk2OL_C /end DEF_CHARACTERISTIC
 /begin LOC_MEASUREMENT DFES_ChkLstDltDemExCond_mp DFES_ctDef DFES_ctDel DFES_ctEntry DFES_ctFrq DFES_ctManuDef DFES_ctManuOk DFES_ctMIL DFES_ctOBD DFES_ctOBDPend DFES_ctOk DFES_ctSrv DFES_DltDemMnmtExCond_mp DFES_EnvBlock DFES_FrzFrVal DFES_idxHash DFES_idxLink DFES_idxPrioQueue DFES_idxSequence DFES_idxVisible DFES_MonClct DFES_MonEvnt DFES_MonObjt DFES_MonParm DFES_MonPtr DFES_numDFC DFES_numEntryAvl DFES_numEnvSize DFES_numExtdFrzFrmSize DFES_numFrzFrmSize DFES_Order DFES_OutLamps DFES_OutTester DFES_stChk DFES_stChkFault DFES_stCounters DFES_stEntry DFES_stErrDia DFES_stErrLamp DFES_stOutstate /end LOC_MEASUREMENT
/end FUNCTION
/begin COMPU_METHOD DFCDSQ_Verb "" TAB_VERB "%2.1" "-" COMPU_TAB_REF DFCDSQ_Verb /end COMPU_METHOD
/begin COMPU_VTAB DFCDSQ_Verb "" TAB_VERB 1214 0 "NoInhibit" 1 "DFC_ACCIPlausDrvAst" 2 "DFC_ACCIPlausTrqDes" 3 "DFC_AirCtlGovDvtEOMMax" 4 "DFC_AirCtlGovDvtEOMMin" 5 "DFC_AirCtlGovDvtMax" 6 "DFC_AirCtlGovDvtMin" 7 "DFC_AirCtlGovLPDvtMax" 8 "DFC_AirCtlGovLPDvtMin" 9 "DFC_AltIOComErr" 10 "DFC_AltIOComNpl" 11 "DFC_BusDiagBusOffFlexRay" 12 "DFC_BusDiagBusOffNodeA" 13 "DFC_BusDiagBusOffNodeB" 14 "DFC_BusDiagBusOffNodeC" 15 "DFC_BusDiagHwFlexRay" 16 "DFC_Cj945SpiCom1" 17 "DFC_ComACDemandSig_FA" 18 "DFC_ComACDemandTo_FA" 19 "DFC_ComATempSig_FA" 20 "DFC_ComATempTo_FA" 21 "DFC_ComATempTo_FX" 22 "DFC_ComBrkTrqSumChk_FX" 23 "DFC_ComBrkTrqSumCtr_FX" 24 "DFC_ComBrkTrqSumTo_FX" 25 "DFC_ComBtnDrvDynChk_FX" 26 "DFC_ComBtnDrvDynCtr_FX" 27 "DFC_ComBtnDrvDynTo_FX" 28 "DFC_ComButtonMSASig" 29 "DFC_ComButtonMSATo" 30 "DFC_ComCodierungPwrmngSig" 31 "DFC_ComCodierungPwrmngSig_FA" 32 "DFC_ComCrCtlLvrChk" 33 "DFC_ComCrCtlLvrCtr" 34 "DFC_ComCrCtlLvrSig" 35 "DFC_ComCrCtlLvrTo" 36 "DFC_ComCtrCrshSwoEkpSig_FA" 37 "DFC_ComCtrCrshSwoEkpTo_FA" 38 "DFC_ComCtrSecInt" 39 "DFC_ComDiaOBDGbxSig_A" 40 "DFC_ComDiaOBDGbxTo_A" 41 "DFC_ComFahrzeugtypSig" 42 "DFC_ComFahrzeugtypSig_FA" 43 "DFC_ComFllupGpwsupSig_FA" 44 "DFC_ComFllupGpwsupTo_FA" 45 "DFC_ComGbxDataChk_A" 46 "DFC_ComGbxDataChk_FA" 47 "DFC_ComGbxDataCtr_A" 48 "DFC_ComGbxDataCtr_FA" 49 "DFC_ComGbxDataSig_A" 50 "DFC_ComGbxDataSig_FA" 51 "DFC_ComGbxDataTo_A" 52 "DFC_ComGbxDataTo_FA" 53 "DFC_ComKlemmenChk_FA" 54 "DFC_ComKlemmenCtr_FA" 55 "DFC_ComKlemmenSig_FA" 56 "DFC_ComKlemmenTo_FA" 57 "DFC_ComLenkradwinkelSig" 58 "DFC_ComLenkradwinkelTo" 59 "DFC_ComMileageRangeSig_FA" 60 "DFC_ComMileageRangeTo_FA" 61 "DFC_ComPspSig" 62 "DFC_ComPspTo" 63 "DFC_ComRelTimeSig_FA" 64 "DFC_ComRelTimeTo_FA" 65 "DFC_ComRequestEMFChk" 66 "DFC_ComRequestEMFCtr" 67 "DFC_ComRequestEMFSig" 68 "DFC_ComRequestEMFTo" 69 "DFC_ComRpmWhlChk_FX" 70 "DFC_ComRpmWhlCtr_FX" 71 "DFC_ComRpmWhlTo_FX" 72 "DFC_ComSecCtrRelSig_FA" 73 "DFC_ComSecCtrRelTo_FA" 74 "DFC_ComSensNOxGndSig" 75 "DFC_ComSensNOxGndTo" 76 "DFC_ComSensNOxMode" 77 "DFC_ComSensNOxUbattSig" 78 "DFC_ComSensNOxUbattTo" 79 "DFC_ComShiftPaddleTo_FX" 80 "DFC_ComShutOffPSPSig" 81 "DFC_ComShutOffPSPTo" 82 "DFC_ComSlrdiGlbFZMTo_FA" 83 "DFC_ComSlrdiGlbFZMTo_FX" 84 "DFC_ComSpeedVehicleChk_FX" 85 "DFC_ComSpeedVehicleCtr_FX" 86 "DFC_ComSpeedVehicleTo_FX" 87 "DFC_ComStConintDSCChk_FX" 88 "DFC_ComStConintDSCCtr_FX" 89 "DFC_ComStConintDSCTo_FX" 90 "DFC_ComStatACFrontSig_FA" 91 "DFC_ComStatACFrontTo_FA" 92 "DFC_ComStatEkpSig_A" 93 "DFC_ComStatEkpTo_A" 94 "DFC_ComStatGearRevSig_FA" 95 "DFC_ComStatGearRevTo_FA" 96 "DFC_ComStatZVKlappenSig_FA" 97 "DFC_ComStatZVKlappenTo_FA" 98 "DFC_ComStateARSCtr" 99 "DFC_ComStateARSSig" 100 "DFC_ComStateARSTo" 101 "DFC_ComStateDscSig" 102 "DFC_ComStateDscTo" 103 "DFC_ComStateSeatSig" 104 "DFC_ComStateSeatSig_FA" 105 "DFC_ComStateSeatTo" 106 "DFC_ComStateSeatTo_FA" 107 "DFC_ComStatusEGSSig_A" 108 "DFC_ComStatusEGSSig_FA" 109 "DFC_ComStatusEGSTo_A" 110 "DFC_ComStatusEGSTo_FA" 111 "DFC_ComStatusEMFChk" 112 "DFC_ComStatusEMFCtr" 113 "DFC_ComStatusEMFSig" 114 "DFC_ComStatusEMFTo" 115 "DFC_ComStatusRGangSig" 116 "DFC_ComStatusRGangTo" 117 "DFC_ComSteeringAngleChk_FX" 118 "DFC_ComSteeringAngleCtr_FX" 119 "DFC_ComSteeringAngleTo_FX" 120 "DFC_ComTerminalChk" 121 "DFC_ComTerminalCtr" 122 "DFC_ComTerminalSig" 123 "DFC_ComTerminalTo" 124 "DFC_ComTimeDateSig_FA" 125 "DFC_ComTimeDateTo_FA" 126 "DFC_ComTrailerSig" 127 "DFC_ComTrailerSig_FA" 128 "DFC_ComTrailerTo" 129 "DFC_ComTrailerTo_FA" 130 "DFC_ComTrqDemCrshDrDyChk_FX" 131 "DFC_ComTrqDemCrshDrDyCtr_FX" 132 "DFC_ComTrqDemCrshDrDyTo_FX" 133 "DFC_ComTrqDemandDesSig" 134 "DFC_ComTrqDemandDesTo" 135 "DFC_ComTrqDemandDscChk" 136 "DFC_ComTrqDemandDscCtr" 137 "DFC_ComTrqDemandDscSig" 138 "DFC_ComTrqDemandDscTo" 139 "DFC_ComTrqDemandGbxChk_A" 140 "DFC_ComTrqDemandGbxChk_FA" 141 "DFC_ComTrqDemandGbxCtr_A" 142 "DFC_ComTrqDemandGbxCtr_FA" 143 "DFC_ComTrqDemandGbxSig_A" 144 "DFC_ComTrqDemandGbxSig_FA" 145 "DFC_ComTrqDemandGbxTo_A" 146 "DFC_ComTrqDemandGbxTo_FA" 147 "DFC_ComTrqWhlDemChk" 148 "DFC_ComTrqWhlDemCtr" 149 "DFC_ComTrqWhlDemFASChk_FX" 150 "DFC_ComTrqWhlDemFASCtr_FX" 151 "DFC_ComTrqWhlDemFASTo_FX" 152 "DFC_ComTrqWhlDemSig" 153 "DFC_ComTrqWhlDemTo" 154 "DFC_ComVelocityChk_FA" 155 "DFC_ComVelocityCtr_FA" 156 "DFC_ComVelocitySig" 157 "DFC_ComVelocitySig_FA" 158 "DFC_ComVelocityTo" 159 "DFC_ComVelocityTo_FA" 160 "DFC_ComVerbraucherTo" 161 "DFC_ComWMomPTStabChk_FX" 162 "DFC_ComWMomPTStabCtr_FX" 163 "DFC_ComWMomPTStabTo_FX" 164 "DFC_ComWheelSpeedSig" 165 "DFC_ComWheelSpeedTo" 166 "DFC_ComZvKlappenSig" 167 "DFC_ComZvKlappenTo" 168 "DFC_ComaDirectChk_FX" 169 "DFC_ComaDirectCtr_FX" 170 "DFC_ComaDirectTo_FX" 171 "DFC_ComaSideChk_FX" 172 "DFC_ComaSideCtr_FX" 173 "DFC_ComaSideTo_FX" 174 "DFC_Cy320SpiCom" 175 "DFC_ETCtlDvtInrMax" 176 "DFC_ETCtlDvtInrMin" 177 "DFC_ETCtlDvtOutrMax" 178 "DFC_ETCtlDvtOutrMin" 179 "DFC_FBCqDvtMax" 180 "DFC_FBCqDvtMin" 181 "DFC_Fan4WinErr1" 182 "DFC_Fan4WinErr2" 183 "DFC_Fan4WinErr3" 184 "DFC_Fan4WinErr4" 185 "DFC_FanSCG" 186 "DFC_FlFCBS" 187 "DFC_GlwEcuConfigErr" 188 "DFC_GlwEcuEepErr" 189 "DFC_GlwEcuFrmErr" 190 "DFC_GlwEcuGPCMFaultInfo" 191 "DFC_GlwEcuGPCMInfo" 192 "DFC_GlwEcuGk1HSS" 193 "DFC_GlwEcuGk1OL" 194 "DFC_GlwEcuGk1SC" 195 "DFC_GlwEcuGk1Wdst" 196 "DFC_GlwEcuGk2HSS" 197 "DFC_GlwEcuGk2OL" 198 "DFC_GlwEcuGk2SC" 199 "DFC_GlwEcuGk2Wdst" 200 "DFC_GlwEcuGk3HSS" 201 "DFC_GlwEcuGk3OL" 202 "DFC_GlwEcuGk3SC" 203 "DFC_GlwEcuGk3Wdst" 204 "DFC_GlwEcuGk4HSS" 205 "DFC_GlwEcuGk4OL" 206 "DFC_GlwEcuGk4SC" 207 "DFC_GlwEcuGk4Wdst" 208 "DFC_GlwEcuGk5HSS" 209 "DFC_GlwEcuGk5OL" 210 "DFC_GlwEcuGk5SC" 211 "DFC_GlwEcuGk5Wdst" 212 "DFC_GlwEcuGk6HSS" 213 "DFC_GlwEcuGk6OL" 214 "DFC_GlwEcuGk6SC" 215 "DFC_GlwEcuGk6Wdst" 216 "DFC_GlwEcuGndErr" 217 "DFC_GlwEcuIntErr" 218 "DFC_GlwEcuMsgTimeout" 219 "DFC_GlwEcuT30Err" 220 "DFC_GlwEcuTempErr" 221 "DFC_GlwEcuUdiffT30" 222 "DFC_IBSComErr" 223 "DFC_LubSRCOilFldtCrit" 224 "DFC_LubSRCOilFldtCritDflMin" 225 "DFC_LubSRCOilLvlCritMax" 226 "DFC_LubSRCOilLvlCritMin" 227 "DFC_LubSRCTot" 228 "DFC_MonUMaxSupply1" 229 "DFC_MonUMinSupply1" 230 "DFC_OilComNpl" 231 "DFC_PCBS" 232 "DFC_PCBSPFltChg" 233 "DFC_PCRGovDvtLPMax" 234 "DFC_PCRGovDvtLPMin" 235 "DFC_PCRGovDvtMax" 236 "DFC_PCRGovDvtMin" 237 "DFC_PFltAPSPlausMAX" 238 "DFC_PFltAPSPlausMIN" 239 "DFC_PFltBPSPlausMAX" 240 "DFC_PFltBPSPlausMIN" 241 "DFC_PFltOvldInhRgn" 242 "DFC_PFltOvldTrqLim" 243 "DFC_PFltPresPlausMAX" 244 "DFC_PFltPresPlausMIN" 245 "DFC_PFltTraRpmRdc" 246 "DFC_PFlt_tOxiPreMax" 247 "DFC_PFlt_tOxiPreMaxRgn" 248 "DFC_PFlt_tOxiPreNpl" 249 "DFC_PFlt_tPreMax" 250 "DFC_PFlt_tPreMaxRgn" 251 "DFC_PFlt_tPreNpl" 252 "DFC_PFltmSotDiffMAX" 253 "DFC_PFltmSotDiffMIN" 254 "DFC_PFltmSotDiffSIG" 255 "DFC_PIntkVUsEnvPPls" 256 "DFC_PresPlausDblDef" 257 "DFC_RailCPC1" 258 "DFC_RailCPC3" 259 "DFC_RailCPC4" 260 "DFC_RailMeUn0" 261 "DFC_RailMeUn1" 262 "DFC_RailMeUn2" 263 "DFC_RailMeUn22" 264 "DFC_RailMeUn3" 265 "DFC_RailMeUn4" 266 "DFC_RailMeUn42" 267 "DFC_RailMeUn5" 268 "DFC_RailPCV0" 269 "DFC_RailPCV1" 270 "DFC_RailPCV2" 271 "DFC_RailPCV22" 272 "DFC_RailPCV3" 273 "DFC_RailPCV4" 274 "DFC_RailPCV42" 275 "DFC_RailPMonStrt" 276 "DFC_SSpMon1" 277 "DFC_SSpMon2" 278 "DFC_SSpMon3" 279 "DFC_ThrVlv4WinErr1" 280 "DFC_ThrVlv4WinErr2" 281 "DFC_ThrVlv4WinErr3" 282 "DFC_ThrVlv4WinErr4" 283 "DFC_ThrVlvSCG" 284 "DFC_Tle6232Spi1" 285 "DFC_TrbCh4WinErr1" 286 "DFC_TrbCh4WinErr2" 287 "DFC_TrbCh4WinErr3" 288 "DFC_TrbCh4WinErr4" 289 "DFC_TrbChSCG" 290 "DFC_TrbChSRCMax" 291 "DFC_TrbChSRCMin" 292 "DFC_WaHtEl4WinErr1" 293 "DFC_WaHtEl4WinErr2" 294 "DFC_WaHtEl4WinErr3" 295 "DFC_WaHtEl4WinErr4" 296 "DFC_WaHtElSCG" 297 "DFC_ETClbETFltMax_0" 298 "DFC_ETClbETFltMax_1" 299 "DFC_ETClbETFltMax_2" 300 "DFC_ETClbETFltMax_3" 301 "DFC_ETClbETFltMax_4" 302 "DFC_ETClbETFltMax_5" 303 "DFC_ETClbETFltMin_0" 304 "DFC_ETClbETFltMin_1" 305 "DFC_ETClbETFltMin_2" 306 "DFC_ETClbETFltMin_3" 307 "DFC_ETClbETFltMin_4" 308 "DFC_ETClbETFltMin_5" 309 "DFC_InjCrvInjLimChrgBal" 310 "DFC_InjCrvInjLimQntBal" 311 "DFC_InjCrvInjLimSys" 312 "DFC_InjCrvNumInjRtmLim" 313 "DFC_LSUHtCoupSig" 314 "DFC_AFS_SSpShOffOL" 315 "DFC_AFS_SSpShOffOvrTemp" 316 "DFC_AFS_SSpShOffSCB" 317 "DFC_AFS_SSpShOffSCG" 318 "DFC_AirCCmprOL" 319 "DFC_AirCCmprOvrTemp" 320 "DFC_AirCCmprSCB" 321 "DFC_AirCCmprSCG" 322 "DFC_CByVlvOL" 323 "DFC_CByVlvOvrTemp" 324 "DFC_CByVlvSCB" 325 "DFC_CByVlvSCG" 326 "DFC_CThmstOL" 327 "DFC_CThmstOvrTemp" 328 "DFC_CThmstSCB" 329 "DFC_CThmstSCG" 330 "DFC_DSMDummy" 331 "DFC_EBxFanOL" 332 "DFC_EBxFanOvrTemp" 333 "DFC_EBxFanSCB" 334 "DFC_EBxFanSCG" 335 "DFC_ECBVlvOL" 336 "DFC_ECBVlvOvrTemp" 337 "DFC_ECBVlvSCB" 338 "DFC_ECBVlvSCG" 339 "DFC_EMDmpOL_0" 340 "DFC_EMDmpOL_1" 341 "DFC_EMDmpOvrTemp_0" 342 "DFC_EMDmpOvrTemp_1" 343 "DFC_EMDmpSCB_0" 344 "DFC_EMDmpSCB_1" 345 "DFC_EMDmpSCG_0" 346 "DFC_EMDmpSCG_1" 347 "DFC_EngStAOL" 348 "DFC_EngStAOvrTemp" 349 "DFC_EngStASCB" 350 "DFC_EngStASCG" 351 "DFC_FanOL" 352 "DFC_FanOvrTemp" 353 "DFC_FanSCB" 354 "DFC_FlFltHtOL" 355 "DFC_FlFltHtOvrTemp" 356 "DFC_FlFltHtSCB" 357 "DFC_FlFltHtSCG" 358 "DFC_LSUHtrMax" 359 "DFC_LSUHtrMin" 360 "DFC_LSUHtrNpl" 361 "DFC_LSUHtrSig" 362 "DFC_LSUtExcMax" 363 "DFC_LSUtExcMin" 364 "DFC_MeUnOL" 365 "DFC_MeUnSCB" 366 "DFC_MeUnSRCMax" 367 "DFC_MeUnSRCMin" 368 "DFC_PCVOL" 369 "DFC_PCVSCB" 370 "DFC_PCVSRCMax" 371 "DFC_PCVSRCMin" 372 "DFC_RailPSRCMax" 373 "DFC_RailPSRCMin" 374 "DFC_ShtrOL" 375 "DFC_ShtrOvrTemp" 376 "DFC_ShtrSCB" 377 "DFC_ShtrSCG" 378 "DFC_StrtOL" 379 "DFC_StrtOvrTemp" 380 "DFC_StrtSCB" 381 "DFC_StrtSCG" 382 "DFC_ThrVlvOL" 383 "DFC_ThrVlvOvrTemp" 384 "DFC_ThrVlvSCB" 385 "DFC_TrbChOL" 386 "DFC_TrbChOvrTemp" 387 "DFC_TrbChSCB" 388 "DFC_UDosVlvOL" 389 "DFC_UDosVlvOvrTemp" 390 "DFC_UDosVlvSCB" 391 "DFC_UDosVlvSCG" 392 "DFC_UPmpMotOL" 393 "DFC_UPmpMotOvrTemp" 394 "DFC_UPmpMotSCB" 395 "DFC_UPmpMotSCG" 396 "DFC_WaHtElOL" 397 "DFC_WaHtElOvrTemp" 398 "DFC_WaHtElSCB" 399 "DFC_IVActrUChSRCMax" 400 "DFC_IVActrUChSRCMin" 401 "DFC_IVActrVltgSRCMax" 402 "DFC_IVActrVltgSRCMin" 403 "DFC_IVDiaTunDet" 404 "DFC_IVPSplyStopDCDC" 405 "DFC_IVPSplyVltgSRCMax" 406 "DFC_IVPSplyVltgSRCMin" 407 "DFC_SCREtaErr" 408 "DFC_SCREtaErr1" 409 "DFC_SCREtaErr2" 410 "DFC_SCRMonMetCtlPresErr" 411 "DFC_SCRMonPresBuildUpErr" 412 "DFC_SCRMonPresRdcErr" 413 "DFC_AFSOffsDrftMax" 414 "DFC_AFSOffsDrftMin" 415 "DFC_AFSSRCCorMax" 416 "DFC_AFSSRCCorMin" 417 "DFC_AFSSRCRawMax" 418 "DFC_AFSSRCRawMin" 419 "DFC_AFSSetyDrftMax" 420 "DFC_AFSSetyDrftMin" 421 "DFC_AirCSwtNpl" 422 "DFC_AirCSwtSig" 423 "DFC_BattUSRCMax" 424 "DFC_BattUSRCMin" 425 "DFC_BrkNpl" 426 "DFC_BrkPSRCMax" 427 "DFC_BrkPSRCMin" 428 "DFC_CEngDsTSRCMax" 429 "DFC_CEngDsTSRCMin" 430 "DFC_CrCUIDet" 431 "DFC_ECBVlvSRCMax" 432 "DFC_ECBVlvSRCMin" 433 "DFC_ECUOvrTemp" 434 "DFC_EGRVlvGovDvtMax" 435 "DFC_EGRVlvGovDvtMin" 436 "DFC_EGRVlvHBrgOpnLd" 437 "DFC_EGRVlvHBrgOvrCurr" 438 "DFC_EGRVlvHBrgOvrTemp" 439 "DFC_EGRVlvHBrgShCirBatt1" 440 "DFC_EGRVlvHBrgShCirBatt2" 441 "DFC_EGRVlvHBrgShCirGnd1" 442 "DFC_EGRVlvHBrgShCirGnd2" 443 "DFC_EGRVlvHBrgShCirOvrLd" 444 "DFC_EGRVlvHBrgTempOvrCurr" 445 "DFC_EGRVlvHBrgUndrVltg" 446 "DFC_EGRVlvLPGovDvtMax" 447 "DFC_EGRVlvLPGovDvtMin" 448 "DFC_EGRVlvLPHBrgOpnLd" 449 "DFC_EGRVlvLPHBrgOvrCurr" 450 "DFC_EGRVlvLPHBrgOvrTemp" 451 "DFC_EGRVlvLPHBrgShCirBatt1" 452 "DFC_EGRVlvLPHBrgShCirBatt2" 453 "DFC_EGRVlvLPHBrgShCirGnd1" 454 "DFC_EGRVlvLPHBrgShCirGnd2" 455 "DFC_EGRVlvLPHBrgShCirOvrLd" 456 "DFC_EGRVlvLPHBrgTempOvrCurr" 457 "DFC_EGRVlvLPHBrgUndrVltg" 458 "DFC_EGRVlvLPOL" 459 "DFC_EGRVlvLPSCB" 460 "DFC_EGRVlvLPSCG" 461 "DFC_EGRVlvLPSRCMax" 462 "DFC_EGRVlvLPSRCMin" 463 "DFC_EGRVlvOL" 464 "DFC_EGRVlvSCB" 465 "DFC_EGRVlvSCG" 466 "DFC_EGRVlvSRCMax" 467 "DFC_EGRVlvSRCMin" 468 "DFC_EngPrtOvrSpd" 469 "DFC_EngSpdOL" 470 "DFC_EngSpdSCB" 471 "DFC_EngSpdSCG" 472 "DFC_EnhSRCMaxPPFltDiff" 473 "DFC_EnhSRCMaxT1ExhTMon" 474 "DFC_EnhSRCMaxT2ExhTMon" 475 "DFC_EnhSRCMaxT3ExhTMon" 476 "DFC_EnhSRCMinPPFltDiff" 477 "DFC_EnhSRCMinT1ExhTMon" 478 "DFC_EnhSRCMinT2ExhTMon" 479 "DFC_EnhSRCMinT3ExhTMon" 480 "DFC_EnvPSRCMax" 481 "DFC_EnvPSRCMin" 482 "DFC_ExhTMonPlaus" 483 "DFC_ExhTMonPlausPos1" 484 "DFC_ExhTMonPlausPos2" 485 "DFC_ExhTMonPlausPos3" 486 "DFC_ExhTMonT1Plaus" 487 "DFC_ExhTMonT2Plaus" 488 "DFC_ExhTMonT3Plaus" 489 "DFC_FlFltDsPSRCMax" 490 "DFC_FlFltDsPSRCMin" 491 "DFC_FlFltSig" 492 "DFC_FlFltUsPSRCMax" 493 "DFC_FlFltUsPSRCMin" 494 "DFC_FuelTSRCMax" 495 "DFC_FuelTSRCMin" 496 "DFC_GbxNPosPPerSRCMax" 497 "DFC_GbxNPosPPerSRCMin" 498 "DFC_GbxNPosPdcycSRCMax" 499 "DFC_GbxNPosPdcycSRCMin" 500 "DFC_InjVlvPresMin" 501 "DFC_LSUCircNernstSig" 502 "DFC_LSUCircPmpCurSig" 503 "DFC_LSUCircVirtGndSig" 504 "DFC_LSUO2Max" 505 "DFC_LSUO2Min" 506 "DFC_LSUSPIBattLowMin" 507 "DFC_LSUWireSCB" 508 "DFC_LSUWireSCG" 509 "DFC_MeUnSCG" 510 "DFC_NSCDsCmpChk" 511 "DFC_NSCDsLamBinSRCMax" 512 "DFC_NSCDsLamBinSRCMin" 513 "DFC_NSCDsLamLinSRCMax" 514 "DFC_NSCDsLamLinSRCMin" 515 "DFC_NSCDsLamPlausMax" 516 "DFC_NSCDsLamPlausMin" 517 "DFC_NSCDsNOxSRCMax" 518 "DFC_NSCDsNOxSRCMin" 519 "DFC_NSCDsOpCir" 520 "DFC_NSCDsShCir" 521 "DFC_NoCat2DsCmpChk" 522 "DFC_NoCat2DsLamBinSRCMax" 523 "DFC_NoCat2DsLamBinSRCMin" 524 "DFC_NoCat2DsLamLinSRCMax" 525 "DFC_NoCat2DsLamLinSRCMin" 526 "DFC_NoCat2DsLamPlausMax" 527 "DFC_NoCat2DsLamPlausMin" 528 "DFC_NoCat2DsNOxSRCMax" 529 "DFC_NoCat2DsNOxSRCMin" 530 "DFC_NoCat2DsOpCir" 531 "DFC_NoCat2DsShCir" 532 "DFC_NplDynPPFltDiff" 533 "DFC_NplHsChngPPFltDiff" 534 "DFC_NplHsLnPPFltDiff" 535 "DFC_NplTOxiCatUs" 536 "DFC_NplTPFltUs" 537 "DFC_NplTTrbnUs" 538 "DFC_OilPSwmpSRCMax" 539 "DFC_OilPSwmpSRCMin" 540 "DFC_PCVSCG" 541 "DFC_PFltCharPDiffMin" 542 "DFC_PFltDstrMin" 543 "DFC_PFltEngPrt" 544 "DFC_PFltRgnPerm" 545 "DFC_PFltSRCMaxFlwRstn" 546 "DFC_PFltSRCMinFlwRstn" 547 "DFC_PFltSotMsDvtMax" 548 "DFC_PFltSotMsDvtMin" 549 "DFC_PFltSotMsMax" 550 "DFC_PIntkVUsSRCMax" 551 "DFC_PIntkVUsSRCMin" 552 "DFC_SRCHighAPP1" 553 "DFC_SRCHighAPP2" 554 "DFC_SRCLowAPP1" 555 "DFC_SRCLowAPP2" 556 "DFC_SRCMaxPPFltDiff" 557 "DFC_SRCMaxPPFltUs" 558 "DFC_SRCMaxTECU" 559 "DFC_SRCMaxTOxiCatUs" 560 "DFC_SRCMaxTPFltUs" 561 "DFC_SRCMaxTTrbnUs" 562 "DFC_SRCMaxUCatUsT" 563 "DFC_SRCMaxUPmpP" 564 "DFC_SRCMinPPFltDiff" 565 "DFC_SRCMinPPFltUs" 566 "DFC_SRCMinTECU" 567 "DFC_SRCMinTOxiCatUs" 568 "DFC_SRCMinTPFltUs" 569 "DFC_SRCMinTTrbnUs" 570 "DFC_SRCMinUCatUsT" 571 "DFC_SRCMinUPmpP" 572 "DFC_SigUCatUsT" 573 "DFC_SigUPmpP" 574 "DFC_SyncAPP" 575 "DFC_T15Npl" 576 "DFC_TAFSDtyCycHi" 577 "DFC_TAFSDtyCycLo" 578 "DFC_TAFSPerHi" 579 "DFC_TAFSPerLo" 580 "DFC_TCACDsSRCMax" 581 "DFC_TCACDsSRCMin" 582 "DFC_ThrVlvSRCMax" 583 "DFC_ThrVlvSRCMin" 584 "DFC_TrbChLPOL" 585 "DFC_TrbChLPSCB" 586 "DFC_TrbChLPSCG" 587 "DFC_UHtrPLOL" 588 "DFC_UHtrPLSCB" 589 "DFC_UHtrPLSCG" 590 "DFC_UHtrPLSRCMaxDia" 591 "DFC_UHtrPLSRCMinDia" 592 "DFC_UHtrTnkOL" 593 "DFC_UHtrTnkSCB" 594 "DFC_UHtrTnkSCG" 595 "DFC_UHtrTnkSRCMaxDia" 596 "DFC_UHtrTnkSRCMinDia" 597 "DFC_URevVlvOL" 598 "DFC_URevVlvSCB" 599 "DFC_URevVlvSCG" 600 "DFC_UTnkTSRCMax" 601 "DFC_UTnkTSRCMin" 602 "DFC_UTnkTSig" 603 "DFC_VSwVlvGovDvtMax" 604 "DFC_VSwVlvGovDvtMin" 605 "DFC_VSwVlvHBrgOpnLd" 606 "DFC_VSwVlvHBrgOvrCurr" 607 "DFC_VSwVlvHBrgOvrTemp" 608 "DFC_VSwVlvHBrgShCirBatt1" 609 "DFC_VSwVlvHBrgShCirBatt2" 610 "DFC_VSwVlvHBrgShCirGnd1" 611 "DFC_VSwVlvHBrgShCirGnd2" 612 "DFC_VSwVlvHBrgShCirOvrLd" 613 "DFC_VSwVlvHBrgTempOvrCurr" 614 "DFC_VSwVlvHBrgUndrVltg" 615 "DFC_VSwVlvOL" 616 "DFC_VSwVlvSCB" 617 "DFC_VSwVlvSCG" 618 "DFC_VSwVlvSRCMax" 619 "DFC_VSwVlvSRCMin" 620 "DFC_ClthNpl" 621 "DFC_ETClbETMax_0" 622 "DFC_ETClbETMax_1" 623 "DFC_ETClbETMax_2" 624 "DFC_ETClbETMax_3" 625 "DFC_ETClbETMax_4" 626 "DFC_ETClbETMax_5" 627 "DFC_ETClbETMin_0" 628 "DFC_ETClbETMin_1" 629 "DFC_ETClbETMin_2" 630 "DFC_ETClbETMin_3" 631 "DFC_ETClbETMin_4" 632 "DFC_ETClbETMin_5" 633 "DFC_IVActrEnrgMax_0" 634 "DFC_IVActrEnrgMax_1" 635 "DFC_IVActrEnrgMax_2" 636 "DFC_IVActrEnrgMax_3" 637 "DFC_IVActrEnrgMax_4" 638 "DFC_IVActrEnrgMax_5" 639 "DFC_IVActrEnrgMax_6" 640 "DFC_IVActrEnrgMax_7" 641 "DFC_IVActrEnrgMin_0" 642 "DFC_IVActrEnrgMin_1" 643 "DFC_IVActrEnrgMin_2" 644 "DFC_IVActrEnrgMin_3" 645 "DFC_IVActrEnrgMin_4" 646 "DFC_IVActrEnrgMin_5" 647 "DFC_IVActrEnrgMin_6" 648 "DFC_IVActrEnrgMin_7" 649 "DFC_IVActrEnrgPlaus_0" 650 "DFC_IVActrEnrgPlaus_1" 651 "DFC_IVActrEnrgPlaus_2" 652 "DFC_IVActrEnrgPlaus_3" 653 "DFC_IVActrEnrgPlaus_4" 654 "DFC_IVActrEnrgPlaus_5" 655 "DFC_IVActrEnrgPlaus_6" 656 "DFC_IVActrEnrgPlaus_7" 657 "DFC_IVCtlTiDiff_0" 658 "DFC_IVCtlTiDiff_1" 659 "DFC_IVCtlTiDiff_2" 660 "DFC_IVCtlTiDiff_3" 661 "DFC_IVCtlTiDiff_4" 662 "DFC_IVCtlTiDiff_5" 663 "DFC_IVCtlUDiffUp_0" 664 "DFC_IVCtlUDiffUp_1" 665 "DFC_IVCtlUDiffUp_2" 666 "DFC_IVCtlUDiffUp_3" 667 "DFC_IVCtlUDiffUp_4" 668 "DFC_IVCtlUDiffUp_5" 669 "DFC_IVCtlUUp_0" 670 "DFC_IVCtlUUp_1" 671 "DFC_IVCtlUUp_2" 672 "DFC_IVCtlUUp_3" 673 "DFC_IVCtlUUp_4" 674 "DFC_IVCtlUUp_5" 675 "DFC_IVDiaBnkShCir_0" 676 "DFC_IVDiaBnkShCir_1" 677 "DFC_IVDiaBnkShCirChSwt_0" 678 "DFC_IVDiaBnkShCirChSwt_1" 679 "DFC_IVDiaChp_0" 680 "DFC_IVDiaChp_1" 681 "DFC_IVDiaCylNoCls_0" 682 "DFC_IVDiaCylNoCls_1" 683 "DFC_IVDiaCylNoCls_2" 684 "DFC_IVDiaCylNoCls_3" 685 "DFC_IVDiaCylNoCls_4" 686 "DFC_IVDiaCylNoCls_5" 687 "DFC_IVDiaCylNoLd_0" 688 "DFC_IVDiaCylNoLd_1" 689 "DFC_IVDiaCylNoLd_2" 690 "DFC_IVDiaCylNoLd_3" 691 "DFC_IVDiaCylNoLd_4" 692 "DFC_IVDiaCylNoLd_5" 693 "DFC_IVDiaCylShCir_0" 694 "DFC_IVDiaCylShCir_1" 695 "DFC_IVDiaCylShCir_2" 696 "DFC_IVDiaCylShCir_3" 697 "DFC_IVDiaCylShCir_4" 698 "DFC_IVDiaCylShCir_5" 699 "DFC_IVDiaCylShCirHSLS_0" 700 "DFC_IVDiaCylShCirHSLS_1" 701 "DFC_IVDiaCylShCirHSLS_2" 702 "DFC_IVDiaCylShCirHSLS_3" 703 "DFC_IVDiaCylShCirHSLS_4" 704 "DFC_IVDiaCylShCirHSLS_5" 705 "DFC_IVDiaCylShCirMeas_0" 706 "DFC_IVDiaCylShCirMeas_1" 707 "DFC_IVDiaCylShCirMeas_2" 708 "DFC_IVDiaCylShCirMeas_3" 709 "DFC_IVDiaCylShCirMeas_4" 710 "DFC_IVDiaCylShCirMeas_5" 711 "DFC_LSUDynChk" 712 "DFC_LSUO2ClbMax" 713 "DFC_LSUO2ClbMin" 714 "DFC_LSUO2PlausMaxFLd" 715 "DFC_LSUO2PlausMaxOvrRun" 716 "DFC_LSUO2PlausMaxPartLd" 717 "DFC_LSUO2PlausMinFLd" 718 "DFC_LSUO2PlausMinOvrRun" 719 "DFC_LSUO2PlausMinPartLd" 720 "DFC_LSURiClbMax" 721 "DFC_LSURiClbMin" 722 "DFC_LSUWireIPSig" 723 "DFC_Layer_BSDMax" 724 "DFC_Layer_BSDMin" 725 "DFC_Layer_BSDNpl" 726 "DFC_Layer_BSDSig" 727 "DFC_Layer_FltMngTstMax" 728 "DFC_Layer_FltMngTstMin" 729 "DFC_Layer_FltMngTstNpl" 730 "DFC_Layer_FltMngTstSig" 731 "DFC_Layer_GENELBMax" 732 "DFC_Layer_GENELBMin" 733 "DFC_Layer_GENELBNpl" 734 "DFC_Layer_GENELBSig" 735 "DFC_Layer_GENELMax" 736 "DFC_Layer_GENELMin" 737 "DFC_Layer_GENELNpl" 738 "DFC_Layer_GENELSig" 739 "DFC_Layer_GENHTBMax" 740 "DFC_Layer_GENHTBMin" 741 "DFC_Layer_GENHTBNpl" 742 "DFC_Layer_GENHTBSig" 743 "DFC_Layer_GENHTMax" 744 "DFC_Layer_GENHTMin" 745 "DFC_Layer_GENHTNpl" 746 "DFC_Layer_GENHTSig" 747 "DFC_Layer_GENKOMMMax" 748 "DFC_Layer_GENKOMMMin" 749 "DFC_Layer_GENKOMMNpl" 750 "DFC_Layer_GENKOMMSig" 751 "DFC_Layer_GENMECHMax" 752 "DFC_Layer_GENMECHMin" 753 "DFC_Layer_GENMECHNpl" 754 "DFC_Layer_GENMECHSig" 755 "DFC_Layer_GENMax" 756 "DFC_Layer_GENMin" 757 "DFC_Layer_GENNpl" 758 "DFC_Layer_GENREGUPLMax" 759 "DFC_Layer_GENREGUPLMin" 760 "DFC_Layer_GENREGUPLNpl" 761 "DFC_Layer_GENREGUPLSig" 762 "DFC_Layer_GENSig" 763 "DFC_Layer_GENUPLMax" 764 "DFC_Layer_GENUPLMin" 765 "DFC_Layer_GENUPLNpl" 766 "DFC_Layer_GENUPLSig" 767 "DFC_Layer_IBS1Max" 768 "DFC_Layer_IBS1Min" 769 "DFC_Layer_IBS1Npl" 770 "DFC_Layer_IBS1Sig" 771 "DFC_Layer_IBS2Max" 772 "DFC_Layer_IBS2Min" 773 "DFC_Layer_IBS2Npl" 774 "DFC_Layer_IBS2Sig" 775 "DFC_Layer_IBS3Max" 776 "DFC_Layer_IBS3Min" 777 "DFC_Layer_IBS3Npl" 778 "DFC_Layer_IBS3Sig" 779 "DFC_Layer_MANDETEKMax" 780 "DFC_Layer_MANDETEKMin" 781 "DFC_Layer_MANDETEKNpl" 782 "DFC_Layer_MANDETEKSig" 783 "DFC_Layer_NDR1Max" 784 "DFC_Layer_NDR1Min" 785 "DFC_Layer_NDR1Npl" 786 "DFC_Layer_NDR1Sig" 787 "DFC_Layer_NDR2Max" 788 "DFC_Layer_NDR2Min" 789 "DFC_Layer_NDR2Npl" 790 "DFC_Layer_NDR2Sig" 791 "DFC_Layer_NGLERNMax" 792 "DFC_Layer_NGLERNMin" 793 "DFC_Layer_NGLERNNpl" 794 "DFC_Layer_NGLERNSig" 795 "DFC_Layer_PMBATTMax" 796 "DFC_Layer_PMBATTMin" 797 "DFC_Layer_PMBATTNpl" 798 "DFC_Layer_PMBATTSig" 799 "DFC_Layer_PMBNMax" 800 "DFC_Layer_PMBNMin" 801 "DFC_Layer_PMBNNpl" 802 "DFC_Layer_PMBNSig" 803 "DFC_Layer_PMRUHVERLMax" 804 "DFC_Layer_PMRUHVERLMin" 805 "DFC_Layer_PMRUHVERLNpl" 806 "DFC_Layer_PMRUHVERLSig" 807 "DFC_Layer_QLTMax" 808 "DFC_Layer_QLTMin" 809 "DFC_Layer_QLTNpl" 810 "DFC_Layer_QLTSig" 811 "DFC_Layer_TOENSMax" 812 "DFC_Layer_TOENSMin" 813 "DFC_Layer_TOENSNpl" 814 "DFC_Layer_TOENSSig" 815 "DFC_MonLimCurr" 816 "DFC_MonLimLead" 817 "DFC_MonLimSet" 818 "DFC_NSCDsNOxOfsMax" 819 "DFC_NSCDsNOxOfsMin" 820 "DFC_NSCDsNOxPlausMin" 821 "DFC_NoCat2DsNOxOfsMax" 822 "DFC_NoCat2DsNOxOfsMin" 823 "DFC_NoCat2DsNOxPlausMin" 824 "DFC_PCVNoStrt" 825 "DFC_RailPGradMon" 826 "DFC_SCRPODPresBuildUp" 827 "DFC_AFSDrftIdlAdjVal" 828 "DFC_AFSDrftLdAdjVal" 829 "DFC_AdcIADC0Cal" 830 "DFC_AdcIADC0Conv" 831 "DFC_AdcIADC1Cal" 832 "DFC_AdcIADC1Conv" 833 "DFC_CmbChbMisfireMax_0" 834 "DFC_CmbChbMisfireMax_1" 835 "DFC_CmbChbMisfireMax_2" 836 "DFC_CmbChbMisfireMax_3" 837 "DFC_CmbChbMisfireMax_4" 838 "DFC_CmbChbMisfireMax_5" 839 "DFC_CmbChbMisfireMul" 840 "DFC_EGRVlvLPOfsNeutr" 841 "DFC_EGRVlvOfsNeutr" 842 "DFC_FMAErrModMax" 843 "DFC_FMAErrModMin" 844 "DFC_FlSysTnkLo" 845 "DFC_GbxNPosPlaus" 846 "DFC_I14229_ROETst_Appl" 847 "DFC_I14229_ROETst_Netw" 848 "DFC_I14229_ROE_BufFull" 849 "DFC_IVAdjDiaIVAdj" 850 "DFC_IVAdjIVA_0" 851 "DFC_IVAdjIVA_1" 852 "DFC_IVAdjIVA_2" 853 "DFC_IVAdjIVA_3" 854 "DFC_IVAdjIVA_4" 855 "DFC_IVAdjIVA_5" 856 "DFC_IVPSplyDCDCOff_0" 857 "DFC_IVPSplyDCDCOff_1" 858 "DFC_IVPSplyDCDCOff_2" 859 "DFC_IVPSplyDCDCOff_3" 860 "DFC_InjCtlAdjQntEEPCS" 861 "DFC_LSUSPISig" 862 "DFC_Layer_Dummy" 863 "DFC_NplEnvPSensPPFltDiff" 864 "DFC_NplPresSensPPFltDiff" 865 "DFC_OilLvlPlaus" 866 "DFC_OilTOutLvl" 867 "DFC_PCVfacAdaptMax" 868 "DFC_PCVfacAdaptMin" 869 "DFC_SensFrzPPFltUs" 870 "DFC_SensMonUTnkLvl" 871 "DFC_T15Sig" 872 "DFC_AirCtlRmpTOut" 873 "DFC_BrkPPlaus" 874 "DFC_CEngDsTDynTst" 875 "DFC_EEPEraseErr" 876 "DFC_EEPRdErr" 877 "DFC_EEPWrErr" 878 "DFC_EGRVlvJamVlvClsd" 879 "DFC_EGRVlvJamVlvOpn" 880 "DFC_EGRVlvLPJamVlvClsd" 881 "DFC_EGRVlvLPJamVlvOpn" 882 "DFC_EGRVlvLPLgTDrft" 883 "DFC_EGRVlvLPOfsLrnJamVlv" 884 "DFC_EGRVlvLPShTDrft" 885 "DFC_EGRVlvLgTDrft" 886 "DFC_EGRVlvOfsLrnJamVlv" 887 "DFC_EGRVlvShTDrft" 888 "DFC_EngICO" 889 "DFC_EpmCaSI1ErrSig" 890 "DFC_EpmCaSI1NoSig" 891 "DFC_EpmCaSI1OfsErr" 892 "DFC_EpmCrSErrSig" 893 "DFC_EpmCrSNoSig" 894 "DFC_IVPlausComprTst" 895 "DFC_IVPlausRunUpTst" 896 "DFC_InjCrvShOffTst" 897 "DFC_LayerEnSavModProd" 898 "DFC_LayerEnSavModRep" 899 "DFC_LayerEnSavModShip" 900 "DFC_MRlyErlyOpng" 901 "DFC_MRlyStk" 902 "DFC_MeUnActrTst" 903 "DFC_MoCADCCmp" 904 "DFC_MoCADCTst" 905 "DFC_MoCADCVltgRatio" 906 "DFC_MoCComErrCnt" 907 "DFC_MoCComSPI" 908 "DFC_MoCROMErrXPg" 909 "DFC_MoCSOPHwNoRdy" 910 "DFC_MoCSOPLoLi" 911 "DFC_MoCSOPMM" 912 "DFC_MoCSOPTimeOut" 913 "DFC_MoCSOPUpLi" 914 "DFC_MoFAPP" 915 "DFC_MoFESpd" 916 "DFC_MoFInjDatPhi" 917 "DFC_MoFInjDatQnt" 918 "DFC_MoFInjQnt" 919 "DFC_MoFMode1PoI1" 920 "DFC_MoFMode1PoI2" 921 "DFC_MoFMode2PoI1" 922 "DFC_MoFMode2PoI2" 923 "DFC_MoFOvR" 924 "DFC_MoFQntCor" 925 "DFC_MoFRailP" 926 "DFC_MoFTrqCmp" 927 "DFC_NSCDsHtrSetP" 928 "DFC_NoCat2DsHtrSetP" 929 "DFC_PCVActrTst" 930 "DFC_PhyModNonMonMapNpl" 931 "DFC_RailHpTst" 932 "DFC_RailPOfsTstMax" 933 "DFC_RailPOfsTstMin" 934 "DFC_SIA_E1max" 935 "DFC_SIA_E1min" 936 "DFC_SIA_E1npl" 937 "DFC_SIA_E1sig" 938 "DFC_SIA_E2max" 939 "DFC_SIA_E2min" 940 "DFC_SIA_E2npl" 941 "DFC_SIA_E2sig" 942 "DFC_SIA_E3max" 943 "DFC_SIA_E3min" 944 "DFC_SIA_E3npl" 945 "DFC_SIA_E3sig" 946 "DFC_SIA_E4max" 947 "DFC_SIA_E4min" 948 "DFC_SIA_E4npl" 949 "DFC_SIA_E4sig" 950 "DFC_SWReset_0" 951 "DFC_SWReset_1" 952 "DFC_SWReset_2" 953 "DFC_ShtrAKKMax" 954 "DFC_ShtrAKKMin" 955 "DFC_ShtrAKKNpl" 956 "DFC_ShtrPKKMax" 957 "DFC_StopCntTmr" 958 "DFC_ThrVlvMon" 959 "DFC_VSwVlvJamVlv" 960 "DFC_VSwVlvLgTDrft" 961 "DFC_VSwVlvOfsLrnJamVlv" 962 "DFC_VSwVlvOfsNeutr" 963 "DFC_VSwVlvShTDrft" 964 "DFC_VSwVlvSpgDef" 965 "DSQ_AFS" 966 "DSQ_AFS_SSpShOffActr" 967 "DSQ_AirCCmprActr" 968 "DSQ_BattU" 969 "DSQ_BrkP" 970 "DSQ_CByVlvActr" 971 "DSQ_CEngDsT" 972 "DSQ_CThmstActr" 973 "DSQ_Com_aDirect" 974 "DSQ_Com_aSide" 975 "DSQ_Com_ctrDay" 976 "DSQ_Com_ctrSec" 977 "DSQ_Com_ctrSecAbs" 978 "DSQ_Com_dDay" 979 "DSQ_Com_dMonth" 980 "DSQ_Com_dYear" 981 "DSQ_Com_dphiStWhlAg" 982 "DSQ_Com_dvolPspDes" 983 "DSQ_Com_iHiLimCurr" 984 "DSQ_Com_iLoLimCurr" 985 "DSQ_Com_iPsp" 986 "DSQ_Com_iZrLimCurr" 987 "DSQ_Com_idParkConsumer" 988 "DSQ_Com_idVerbraucher" 989 "DSQ_Com_lFlTnkQntLow" 990 "DSQ_Com_lSum" 991 "DSQ_Com_nDKG" 992 "DSQ_Com_nGbxOut" 993 "DSQ_Com_nPsp" 994 "DSQ_Com_nRqIdlg" 995 "DSQ_Com_nTSC" 996 "DSQ_Com_nWhl" 997 "DSQ_Com_nWhlFL" 998 "DSQ_Com_nWhlFR" 999 "DSQ_Com_nWhlRL" 1000 "DSQ_Com_nWhlRR" 1001 "DSQ_Com_pBrkSys" 1002 "DSQ_Com_phiStWhlAg" 1003 "DSQ_Com_rACFanDem" 1004 "DSQ_Com_rHtFlowReq" 1005 "DSQ_Com_rLamLinRecGndRaw" 1006 "DSQ_Com_rLamLinRecUbattRaw" 1007 "DSQ_Com_rNOxCat2DsGndRaw" 1008 "DSQ_Com_rNOxCat2DsUbattRaw" 1009 "DSQ_Com_rPspSetPoint" 1010 "DSQ_Com_rPwrSpCons" 1011 "DSQ_Com_rTrq" 1012 "DSQ_Com_stAC" 1013 "DSQ_Com_stACEFan" 1014 "DSQ_Com_stARS" 1015 "DSQ_Com_stAcpd" 1016 "DSQ_Com_stBattClass" 1017 "DSQ_Com_stBonnet" 1018 "DSQ_Com_stBrkTrqDVCHQl" 1019 "DSQ_Com_stButtonMSA" 1020 "DSQ_Com_stCat2DsGndRaw" 1021 "DSQ_Com_stCat2DsUbattRaw" 1022 "DSQ_Com_stClCtr" 1023 "DSQ_Com_stClassPwr" 1024 "DSQ_Com_stClth" 1025 "DSQ_Com_stClthOpen" 1026 "DSQ_Com_stClthRaw" 1027 "DSQ_Com_stCrCtlKombi" 1028 "DSQ_Com_stCrCtlLvr" 1029 "DSQ_Com_stDSC" 1030 "DSQ_Com_stDecellDSC" 1031 "DSQ_Com_stDiagPsp" 1032 "DSQ_Com_stDoorDriver" 1033 "DSQ_Com_stDrWghSeat" 1034 "DSQ_Com_stDrvAssist" 1035 "DSQ_Com_stDrvDyn" 1036 "DSQ_Com_stDrvPrgQl" 1037 "DSQ_Com_stDynDisp" 1038 "DSQ_Com_stEngStop" 1039 "DSQ_Com_stErrAFS" 1040 "DSQ_Com_stErrStrg" 1041 "DSQ_Com_stFlTnkQntRes" 1042 "DSQ_Com_stFolDyn" 1043 "DSQ_Com_stGbxOBD" 1044 "DSQ_Com_stGear" 1045 "DSQ_Com_stGearBck" 1046 "DSQ_Com_stHDC" 1047 "DSQ_Com_stKeyVld" 1048 "DSQ_Com_stLckGbxDemQl" 1049 "DSQ_Com_stLmpPrkBrk" 1050 "DSQ_Com_stMSALmp" 1051 "DSQ_Com_stModDKG" 1052 "DSQ_Com_stNOxErrGndRaw" 1053 "DSQ_Com_stNOxErrUbattRaw" 1054 "DSQ_Com_stPBrComf" 1055 "DSQ_Com_stPBrHold" 1056 "DSQ_Com_stPBrHyd" 1057 "DSQ_Com_stPBrkSysQl" 1058 "DSQ_Com_stPHtr" 1059 "DSQ_Com_stParkConsumer" 1060 "DSQ_Com_stPsp" 1061 "DSQ_Com_stPspCntr" 1062 "DSQ_Com_stRaceStrt" 1063 "DSQ_Com_stReqMSA" 1064 "DSQ_Com_stRevGear" 1065 "DSQ_Com_stSTEQl" 1066 "DSQ_Com_stSeason" 1067 "DSQ_Com_stShftIdctrDemRglX" 1068 "DSQ_Com_stShiftPdl" 1069 "DSQ_Com_stShutOffPSP" 1070 "DSQ_Com_stSleepBus" 1071 "DSQ_Com_stSleepConst" 1072 "DSQ_Com_stSleepDest" 1073 "DSQ_Com_stSleepRdy" 1074 "DSQ_Com_stStrg" 1075 "DSQ_Com_stStrtClth" 1076 "DSQ_Com_stStrtLck" 1077 "DSQ_Com_stT15" 1078 "DSQ_Com_stT15Hw" 1079 "DSQ_Com_stT50" 1080 "DSQ_Com_stTRadio" 1081 "DSQ_Com_stTSC" 1082 "DSQ_Com_stTerminal" 1083 "DSQ_Com_stTrailer" 1084 "DSQ_Com_stTrqAFS" 1085 "DSQ_Com_stTrqDSCDes" 1086 "DSQ_Com_stTrqFil" 1087 "DSQ_Com_stTrqGbxDes" 1088 "DSQ_Com_stTrqGbxLim" 1089 "DSQ_Com_stTrqStbDesQl" 1090 "DSQ_Com_stTrqStrg" 1091 "DSQ_Com_stTrqWhl" 1092 "DSQ_Com_stTrqWhlDemFASQl" 1093 "DSQ_Com_stTrqWhlDesQl" 1094 "DSQ_Com_stTypBody" 1095 "DSQ_Com_stUnVel" 1096 "DSQ_Com_stVehCond" 1097 "DSQ_Com_stVehDrvCond" 1098 "DSQ_Com_stVerbraucher" 1099 "DSQ_Com_stphiStWhlAg" 1100 "DSQ_Com_swtAC" 1101 "DSQ_Com_swtDrBltb" 1102 "DSQ_Com_tEnvT" 1103 "DSQ_Com_tGbxOil" 1104 "DSQ_Com_tiPostRunPwrSpl" 1105 "DSQ_Com_trqAC" 1106 "DSQ_Com_trqAFS" 1107 "DSQ_Com_trqAFSDes" 1108 "DSQ_Com_trqARSCur" 1109 "DSQ_Com_trqARSDes" 1110 "DSQ_Com_trqAdjrDKG" 1111 "DSQ_Com_trqBrkDVCH" 1112 "DSQ_Com_trqClthDKG" 1113 "DSQ_Com_trqDSCDes" 1114 "DSQ_Com_trqDVCHRise" 1115 "DSQ_Com_trqGbxDes" 1116 "DSQ_Com_trqGbxFrc" 1117 "DSQ_Com_trqGbxMax" 1118 "DSQ_Com_trqGbxMaxRaw" 1119 "DSQ_Com_trqStbDes" 1120 "DSQ_Com_trqStrg" 1121 "DSQ_Com_trqStrgDes" 1122 "DSQ_Com_trqTarDKG" 1123 "DSQ_Com_trqTarDrvDyn" 1124 "DSQ_Com_trqTarDrvDynDes" 1125 "DSQ_Com_trqTarDrvDynMax" 1126 "DSQ_Com_trqWhlDes" 1127 "DSQ_Com_uLamBinGndRaw" 1128 "DSQ_Com_uLamBinUbattRaw" 1129 "DSQ_Com_uPsp" 1130 "DSQ_Com_uT30Psp" 1131 "DSQ_Com_v" 1132 "DSQ_Com_vBd" 1133 "DSQ_Com_vDspl" 1134 "DSQ_Com_vVeh" 1135 "DSQ_Com_volFlTnkQnt" 1136 "DSQ_Com_volFlTnkQntLH" 1137 "DSQ_Com_volFlTnkQntRH" 1138 "DSQ_DSMInhibitAlways" 1139 "DSQ_EBxFan" 1140 "DSQ_ECBVlvActr" 1141 "DSQ_ECBVlvSens" 1142 "DSQ_EGRVlvActr" 1143 "DSQ_EGRVlvLPActr" 1144 "DSQ_EGRVlvLPSens" 1145 "DSQ_EGRVlvSens" 1146 "DSQ_EMDmp_0" 1147 "DSQ_EMDmp_1" 1148 "DSQ_EngPrtFWOsc" 1149 "DSQ_EngStAActr" 1150 "DSQ_EnvP" 1151 "DSQ_EnvT" 1152 "DSQ_ErrLmpActrMIL" 1153 "DSQ_ErrLmpActrSVS" 1154 "DSQ_FanActr" 1155 "DSQ_FlFltDsP" 1156 "DSQ_FlFltHtActr" 1157 "DSQ_FlFltUsP" 1158 "DSQ_FuelLvl_vol" 1159 "DSQ_FuelT" 1160 "DSQ_GbxNPosPls" 1161 "DSQ_IVDiast" 1162 "DSQ_InjVlvInjCo" 1163 "DSQ_InjVlvPresMin" 1164 "DSQ_LAYER2EDCMSAStp" 1165 "DSQ_LSUO2" 1166 "DSQ_Layer_rCtrPwrSpCos" 1167 "DSQ_MRly" 1168 "DSQ_MeUnActr" 1169 "DSQ_NSCDsRLamO2" 1170 "DSQ_NoCat2DsO2Val" 1171 "DSQ_O2ValNSCDs" 1172 "DSQ_O2ValNoCat2Ds" 1173 "DSQ_OilPSwmp" 1174 "DSQ_PCVActr" 1175 "DSQ_PIntkVUs" 1176 "DSQ_PPFltDiff" 1177 "DSQ_PPFltUs" 1178 "DSQ_RailShutOffDblCtl" 1179 "DSQ_RailShutOffMeUnCtl" 1180 "DSQ_SOPTstInjShOff" 1181 "DSQ_ShtrActr" 1182 "DSQ_StrtActr" 1183 "DSQ_TAFS" 1184 "DSQ_TCACDs" 1185 "DSQ_TECU" 1186 "DSQ_TOxiCatUs" 1187 "DSQ_TPFltUs" 1188 "DSQ_TTrbnUs" 1189 "DSQ_ThrVlvActr" 1190 "DSQ_ThrVlvSens" 1191 "DSQ_TrbChActr" 1192 "DSQ_TrbChLPActr" 1193 "DSQ_TrbChSens" 1194 "DSQ_TrbnDsRLamO2" 1195 "DSQ_UCatUsT" 1196 "DSQ_UDosVlvActr" 1197 "DSQ_UHtrPL" 1198 "DSQ_UHtrPLDia" 1199 "DSQ_UHtrTnk" 1200 "DSQ_UHtrTnkDia" 1201 "DSQ_UPmpMotActr" 1202 "DSQ_UPmpP" 1203 "DSQ_URevVlv" 1204 "DSQ_UTnkLvl" 1205 "DSQ_UTnkT" 1206 "DSQ_VSwVlvActr" 1207 "DSQ_VSwVlvSens" 1208 "DSQ_WaHtElActr" 1209 "DSQ_stAPP" 1210 "DSQ_stAPP1" 1211 "DSQ_stAPP2" 1212 "DSQ_stLSUSrvTstDem" 1213 "DSQ_stSrvOpLSUAdap" DEFAULT_VALUE "---" /end COMPU_VTAB
/begin COMPU_METHOD DFES_Mon_Verb "" TAB_VERB "%6.3" "-" COMPU_TAB_REF DFES_Mon_Verb /end COMPU_METHOD
/begin COMPU_VTAB DFES_Mon_Verb "" TAB_VERB 30 0 "-----" 4097 "entry_rejected" 4098 "entry_preempted" 4099 "del_mismatch" 8196 "double entry" 8197 "no hash entry" 8198 "ok no tst - inkonsist" 8199 "ok tsted - inkonsist" 8200 "def tsted - inkonsist" 8201 "Counter exceeds" 8202 "MEM missing" 8203 "Hash 2 empty line" 8204 "retry entry" 8205 "Hash link exceeds" 8453 "invalid hash" 8454 "def no tst - inkonsist" 8457 "DEL Counter Serv ex" 8458 "MEM no Hash" 8461 "min hash line" 8709 "missing hash entry" 8713 "DEL Counter Pend ex" 8714 "Deb ok missing" 8717 "MIS MOD hashkey" 8969 "DEL Counter OBD ex" 8970 "Deb def missing" 8973 "insert line 2 hash" 16399 "pot_sus_ffr" 16655 "used_sus_ffr" 32782 "miss diumpr Fid" 32783 "miss dfc DFP" /end COMPU_VTAB
/begin COMPU_METHOD DFES_OneToOne "" RAT_FUNC "%6.0" "-" COEFFS 0 1 0 0 0 1 /end COMPU_METHOD
/begin COMPU_METHOD DFES_stCheck_Verb "" TAB_VERB "%6.3" "-" COMPU_TAB_REF DFES_stCheck_Verb /end COMPU_METHOD
/begin COMPU_VTAB DFES_stCheck_Verb "" TAB_VERB 128 0 "OkNoTst" 1 "OkTested" 2 "OkHealed" 3 "OkRstNoTst" 4 "DefectNoTst" 5 "DefectDelay" 6 "Defect" 7 "DefectRstNoTst" 16 "SC_OkNoTst" 17 "SC_OkTested" 18 "SC_OkHealed" 19 "SC_OkRstNoTst" 20 "SC_DefectNoTst" 21 "SC_DefectDelay" 22 "SC_Defect" 23 "SC_DefectRstNoTst" 32 "FC_OkNoTst" 33 "FC_OkTested" 34 "FC_OkHealed" 35 "FC_OkRstNoTst" 36 "FC_DefectNoTst" 37 "FC_DefectDelay" 38 "FC_Defect" 39 "FC_DefectRstNoTst" 48 "FC_SC_OkNoTst" 49 "FC_SC_OkTested" 50 "FC_SC_OkHealed" 51 "FC_SC_OkRstNoTst" 52 "FC_SC_DefectNoTst" 53 "FC_SC_DefectDelay" 54 "FC_SC_Defect" 55 "FC_SC_DefectRstNoTst" 64 "_OkNoTst" 65 "_OkTested" 66 "_OkHealed" 67 "_OkRstNoTst" 68 "_DefectNoTst" 69 "_DefectDelay" 70 "_Defect" 71 "_DefectRstNoTst" 80 "_SC_OkNoTst" 81 "_SC_OkTested" 82 "_SC_OkHealed" 83 "_SC_OkRstNoTst" 84 "_SC_DefectNoTst" 85 "_SC_DefectDelay" 86 "_SC_Defect" 87 "_SC_DefectRstNoTst" 96 "_FC_OkNoTst" 97 "_FC_OkTested" 98 "_FC_OkHealed" 99 "_FC_OkRstNoTst" 100 "_FC_DefectNoTst" 101 "_FC_DefectDelay" 102 "_FC_Defect" 103 "_FC_DefectRstNoTst" 112 "_FC_SC_OkNoTst" 113 "_FC_SC_OkTested" 114 "_FC_SC_OkHealed" 115 "_FC_SC_OkRstNoTst" 116 "_FC_SC_DefectNoTst" 117 "_FC_SC_DefectDelay" 118 "_FC_SC_Defect" 119 "_FC_SC_DefectRstNoTst" 128 "-OkNoTst" 129 "-OkTested" 130 "-OkHealed" 131 "-OkRstNoTst" 132 "-DefectNoTst" 133 "-DefectDelay" 134 "-Defect" 135 "-DefectRstNoTst" 144 "-SC_OkNoTst" 145 "-SC_OkTested" 146 "-SC_OkHealed" 147 "-SC_OkRstNoTst" 148 "-SC_DefectNoTst" 149 "-SC_DefectDelay" 150 "-SC_Defect" 151 "-SC_DefectRstNoTst" 160 "-FC_OkNoTst" 161 "-FC_OkTested" 162 "-FC_OkHealed" 163 "-FC_OkRstNoTst" 164 "-FC_DefectNoTst" 165 "-FC_DefectDelay" 166 "-FC_Defect" 167 "-FC_DefectRstNoTst" 176 "-FC_SC_OkNoTst" 177 "-FC_SC_OkTested" 178 "-FC_SC_OkHealed" 179 "-FC_SC_OkRstNoTst" 180 "-FC_SC_DefectNoTst" 181 "-FC_SC_DefectDelay" 182 "-FC_SC_Defect" 183 "-FC_SC_DefectRstNoTst" 192 "-_OkNoTst" 193 "-_OkTested" 194 "-_OkHealed" 195 "-_OkRstNoTst" 196 "-_DefectNoTst" 197 "-_DefectDelay" 198 "-_Defect" 199 "-_DefectRstNoTst" 208 "-_SC_OkNoTst" 209 "-_SC_OkTested" 210 "-_SC_OkHealed" 211 "-_SC_OkRstNoTst" 212 "-_SC_DefectNoTst" 213 "-_SC_DefectDelay" 214 "-_SC_Defect" 215 "-_SC_DefectRstNoTst" 224 "-_FC_OkNoTst" 225 "-_FC_OkTested" 226 "-_FC_OkHealed" 227 "-_FC_OkRstNoTst" 228 "-_FC_DefectNoTst" 229 "-_FC_DefectDelay" 230 "-_FC_Defect" 231 "-_FC_DefectRstNoTst" 240 "-_FC_SC_OkNoTst" 241 "-_FC_SC_OkTested" 242 "-_FC_SC_OkHealed" 243 "-_FC_SC_OkRstNoTst" 244 "-_FC_SC_DefectNoTst" 245 "-_FC_SC_DefectDelay" 246 "-_FC_SC_Defect" 247 "-_FC_SC_DefectRstNoTst" /end COMPU_VTAB
/begin COMPU_METHOD DFES_stCnt_Verb "" TAB_VERB "%6.3" "-" COMPU_TAB_REF DFES_stCnt_Verb /end COMPU_METHOD
/begin COMPU_VTAB DFES_stCnt_Verb "" TAB_VERB 36 0 "SVS_NONE__MIL_NONE" 1 "SVS_NONE__MIL_HLC_TRG" 2 "SVS_NONE__MIL_HLC_ELAP" 3 "SVS_NONE__MIL_FLC_CNT" 4 "SVS_NONE__MIL_FLC_TIME" 5 "SVS_NONE__MIL_HLC_TIME" 16 "SVS_HLC_TRG__MIL_NONE" 17 "SVS_HLC_TRG__MIL_HLC_TRG" 18 "SVS_HLC_TRG__MIL_HLC_ELAP" 19 "SVS_HLC_TRG__MIL_FLC_CNT" 20 "SVS_HLC_TRG__MIL_FLC_TIME" 21 "SVS_HLC_TRG__MIL_HLC_TIME" 32 "SVS_HLC_ELAP__MIL_NONE" 33 "SVS_HLC_ELAP__MIL_HLC_TRG" 34 "SVS_HLC_ELAP__MIL_HLC_ELAP" 35 "SVS_HLC_ELAP__MIL_FLC_CNT" 36 "SVS_HLC_ELAP__MIL_FLC_TIME" 37 "SVS_HLC_ELAP__MIL_HLC_TIME" 48 "SVS_FLC_CNT__MIL_NONE" 49 "SVS_FLC_CNT__MIL_HLC_TRG" 50 "SVS_FLC_CNT__MIL_HLC_ELAP" 51 "SVS_FLC_CNT__MIL_FLC_CNT" 52 "SVS_FLC_CNT__MIL_FLC_TIME" 53 "SVS_FLC_CNT__MIL_HLC_TIME" 64 "SVS_FLC_TIME__MIL_NONE" 65 "SVS_FLC_TIME__MIL_HLC_TRG" 66 "SVS_FLC_TIME__MIL_HLC_ELAP" 67 "SVS_FLC_TIME__MIL_FLC_CNT" 68 "SVS_FLC_TIME__MIL_FLC_TIME" 69 "SVS_FLC_TIME__MIL_HLC_TIME" 80 "SVS_HLC_TIME__MIL_NONE" 81 "SVS_HLC_TIME__MIL_HLC_TRG" 82 "SVS_HLC_TIME__MIL_HLC_ELAP" 83 "SVS_HLC_TIME__MIL_FLC_CNT" 84 "SVS_HLC_TIME__MIL_FLC_TIME" 85 "SVS_HLC_TIME__MIL_HLC_TIME" /end COMPU_VTAB
/begin COMPU_METHOD DFES_stEntry_Verb "" TAB_VERB "%6.3" "-" COMPU_TAB_REF DFES_stEntry_Verb /end COMPU_METHOD
/begin COMPU_VTAB DFES_stEntry_Verb "" TAB_VERB 60 0 "NoEntry" 1 "Erased" 2 "PrivateTemporary" 3 "SVSOff_FreezeFrameOnly" 4 "SVSOff_DelayActiveDefect" 5 "SVSOff_ServiceNoDefect" 6 "SVSOff_ServiceDefect" 7 "SVSOff_ServiceHistoryDefect" 8 "SVSOff_ServiceHistoryNoDefect" 9 "SVSOff_DelayActiveNoDefect" 10 "SVSOff_PendingDefect" 11 "SVSOff_DebouncedDefect" 12 "SVSOff_HistoryPendingDefect" 13 "SVSOff_HealingNoDefect" 14 "SVSOff_HistoryNoDefect" 16 "DelD_NoEntry" 17 "DelD_Erased" 18 "DelD_PrivateTemporary" 19 "SVSOff_DelD_FreezeFrameOnly" 20 "SVSOff_DelD_DelayActiveDefect" 21 "SVSOff_DelD_ServiceNoDefect" 22 "SVSOff_DelD_ServiceDefect" 23 "SVSOff_DelD_ServiceHistoryDefect" 24 "SVSOff_DelD_ServiceHistoryNoDefect" 25 "SVSOff_DelD_DelayActiveNoDefect" 26 "SVSOff_DelD_PendingDefect" 27 "SVSOff_DelD_DebouncedDefect" 28 "SVSOff_DelD_HistoryPendingDefect" 29 "SVSOff_DelD_HealingNoDefect" 30 "SVSOff_DelD_HistoryNoDefect" 128 "SVSOn_NoEntry" 129 "SVSOn_Erased" 130 "SVSOn_PrivateTemporary" 131 "SVSOn_FreezeFrameOnly" 132 "SVSOn_DelayActiveDefect" 133 "SVSOn_ServiceNoDefect" 134 "SVSOn_ServiceDefect" 135 "SVSOn_ServiceHistoryDefect" 136 "SVSOn_ServiceHistoryNoDefect" 137 "SVSOn_DelayActiveNoDefect" 138 "SVSOn_PendingDefect" 139 "SVSOn_DebouncedDefect" 140 "SVSOn_HistoryPendingDefect" 141 "SVSOn_HealingNoDefect" 142 "HistoryNoDefect" 144 "SVSOn_DelD_NoEntry" 145 "SVSOn_DelD_Erased" 146 "SVSOn_DelD_PrivateTemporary" 147 "SVSOn_DelD_FreezeFrameOnly" 148 "SVSOn_DelD_DelayActiveDefect" 149 "SVSOn_DelD_ServiceNoDefect" 150 "SVSOn_DelD_ServiceDefect" 151 "SVSOn_DelD_ServiceHistoryDefect" 152 "SVSOn_DelD_ServiceHistoryNoDefect" 153 "SVSOn_DelD_DelayActiveNoDefect" 154 "SVSOn_DelD_PendingDefect" 155 "SVSOn_DelD_DebouncedDefect" 156 "SVSOn_DelD_HistoryPendingDefect" 157 "SVSOn_DelD_HealingNoDefect" 158 "DelD_HistoryNoDefect" /end COMPU_VTAB
/begin COMPU_METHOD OneToOne "" RAT_FUNC "%6.0" "-" COEFFS 0 1 0 0 0 1 /end COMPU_METHOD
/begin RECORD_LAYOUT Val_Wu16 FNC_VALUES 1 UWORD COLUMN_DIR DIRECT /end RECORD_LAYOUT
/begin RECORD_LAYOUT Val_Wu8 FNC_VALUES 1 UBYTE COLUMN_DIR DIRECT /end RECORD_LAYOUT
/end MODULE
/end PROJECT

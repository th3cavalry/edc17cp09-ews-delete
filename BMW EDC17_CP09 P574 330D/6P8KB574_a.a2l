ASAP2_VERSION 1 4
/begin PROJECT P_574 "EDC17_CP09"
/begin HEADER "" VERSION "V8KB" PROJECT_NO P_574 /end HEADER
/begin MODULE DIM ""
/begin MOD_COMMON "" BYTE_ORDER MSB_LAST ALIGNMENT_BYTE 1 ALIGNMENT_WORD 2 ALIGNMENT_LONG 4 ALIGNMENT_FLOAT32_IEEE 4 /end MOD_COMMON
/begin CHARACTERISTIC DFES_DTCM.DFC_IVActrEnrgMax_6_C "DFES/Hersteller spezifischer Fehlercode für Prüfung DFC_IVActrEnrgMax_6" VALUE 0x80026B4E Val_Wu16 65535.00 DFES_OneToOne 0.00 65535.00 /end CHARACTERISTIC
/begin CHARACTERISTIC DFES_DTCM.DFC_IVActrEnrgMax_7_C "DFES/Hersteller spezifischer Fehlercode für Prüfung DFC_IVActrEnrgMax_7" VALUE 0x80026B50 Val_Wu16 65535.00 DFES_OneToOne 0.00 65535.00 /end CHARACTERISTIC
/begin CHARACTERISTIC DFES_DTCM.DFC_IVActrEnrgMin_0_C "DFES/Hersteller spezifischer Fehlercode für Prüfung DFC_IVActrEnrgMin_0" VALUE 0x80026B52 Val_Wu16 65535.00 DFES_OneToOne 0.00 65535.00 /end CHARACTERISTIC
/begin CHARACTERISTIC DFES_DTCM.DFC_IVActrEnrgMin_1_C "DFES/Hersteller spezifischer Fehlercode für Prüfung DFC_IVActrEnrgMin_1" VALUE 0x80026B54 Val_Wu16 65535.00 DFES_OneToOne 0.00 65535.00 /end CHARACTERISTIC
/begin CHARACTERISTIC DFES_DTCM.DFC_IVActrEnrgMin_2_C "DFES/Hersteller spezifischer Fehlercode für Prüfung DFC_IVActrEnrgMin_2" VALUE 0x80026B56 Val_Wu16 65535.00 DFES_OneToOne 0.00 65535.00 /end CHARACTERISTIC
/begin CHARACTERISTIC DFES_DTCM.DFC_IVActrEnrgMin_3_C "DFES/Hersteller spezifischer Fehlercode für Prüfung DFC_IVActrEnrgMin_3" VALUE 0x80026B58 Val_Wu16 65535.00 DFES_OneToOne 0.00 65535.00 /end CHARACTERISTIC
/begin CHARACTERISTIC DFES_DTCM.DFC_IVActrEnrgMin_4_C "DFES/Hersteller spezifischer Fehlercode für Prüfung DFC_IVActrEnrgMin_4" VALUE 0x80026B5A Val_Wu16 65535.00 DFES_OneToOne 0.00 65535.00 /end CHARACTERISTIC
/begin CHARACTERISTIC DFES_DTCM.DFC_IVActrEnrgMin_5_C "DFES/Hersteller spezifischer Fehlercode für Prüfung DFC_IVActrEnrgMin_5" VALUE 0x80026B5C Val_Wu16 65535.00 DFES_OneToOne 0.00 65535.00 /end CHARACTERISTIC
/begin CHARACTERISTIC DFES_DTCM.DFC_IVActrEnrgMin_6_C "DFES/Hersteller spezifischer Fehlercode für Prüfung DFC_IVActrEnrgMin_6" VALUE 0x80026B5E Val_Wu16 65535.00 DFES_OneToOne 0.00 65535.00 /end CHARACTERISTIC
/begin CHARACTERISTIC DFES_DTCM.DFC_IVActrEnrgMin_7_C "DFES/Hersteller spezifischer Fehlercode für Prüfung DFC_IVActrEnrgMin_7" VALUE 0x80026B60 Val_Wu16 65535.00 DFES_OneToOne 0.00 65535.00 /end CHARACTERISTIC
/begin CHARACTERISTIC DFES_DTCM.DFC_IVActrEnrgPlaus_0_C "DFES/Hersteller spezifischer Fehlercode für Prüfung DFC_IVActrEnrgPlaus_0" VALUE 0x80026B62 Val_Wu16 65535.00 DFES_OneToOne 0.00 65535.00 /end CHARACTERISTIC
/begin CHARACTERISTIC DFES_DTCM.DFC_IVActrEnrgPlaus_1_C "DFES/Hersteller spezifischer Fehlercode für Prüfung DFC_IVActrEnrgPlaus_1" VALUE 0x80026B64 Val_Wu16 65535.00 DFES_OneToOne 0.00 65535.00 /end CHARACTERISTIC
/begin CHARACTERISTIC DFES_DTCM.DFC_IVActrEnrgPlaus_2_C "DFES/Hersteller spezifischer Fehlercode für Prüfung DFC_IVActrEnrgPlaus_2" VALUE 0x80026B66 Val_Wu16 65535.00 DFES_OneToOne 0.00 65535.00 /end CHARACTERISTIC
/begin CHARACTERISTIC DFES_DTCM.DFC_IVActrEnrgPlaus_3_C "DFES/Hersteller spezifischer Fehlercode für Prüfung DFC_IVActrEnrgPlaus_3" VALUE 0x80026B68 Val_Wu16 65535.00 DFES_OneToOne 0.00 65535.00 /end CHARACTERISTIC
/begin CHARACTERISTIC DFES_DTCM.DFC_IVActrEnrgPlaus_4_C "DFES/Hersteller spezifischer Fehlercode für Prüfung DFC_IVActrEnrgPlaus_4" VALUE 0x80026B6A Val_Wu16 65535.00 DFES_OneToOne 0.00 65535.00 /end CHARACTERISTIC
/begin CHARACTERISTIC DFES_DTCM.DFC_IVActrEnrgPlaus_5_C "DFES/Hersteller spezifischer Fehlercode für Prüfung DFC_IVActrEnrgPlaus_5" VALUE 0x80026B6C Val_Wu16 65535.00 DFES_OneToOne 0.00 65535.00 /end CHARACTERISTIC
/begin CHARACTERISTIC DFES_DTCM.DFC_IVActrEnrgPlaus_6_C "DFES/Hersteller spezifischer Fehlercode für Prüfung DFC_IVActrEnrgPlaus_6" VALUE 0x80026B6E Val_Wu16 65535.00 DFES_OneToOne 0.00 65535.00 /end CHARACTERISTIC
/begin CHARACTERISTIC DFES_DTCM.DFC_IVActrEnrgPlaus_7_C "DFES/Hersteller spezifischer Fehlercode für Prüfung DFC_IVActrEnrgPlaus_7" VALUE 0x80026B70 Val_Wu16 65535.00 DFES_OneToOne 0.00 65535.00 /end CHARACTERISTIC
/begin CHARACTERISTIC DFES_DTCM.DFC_IVCtlTiDiff_0_C "DFES/Hersteller spezifischer Fehlercode für Prüfung DFC_IVCtlTiDiff_0" VALUE 0x80026B72 Val_Wu16 65535.00 DFES_OneToOne 0.00 65535.00 /end CHARACTERISTIC
/begin CHARACTERISTIC DFES_DTCM.DFC_IVCtlTiDiff_1_C "DFES/Hersteller spezifischer Fehlercode für Prüfung DFC_IVCtlTiDiff_1" VALUE 0x80026B74 Val_Wu16 65535.00 DFES_OneToOne 0.00 65535.00 /end CHARACTERISTIC
/begin CHARACTERISTIC DFES_DTCM.DFC_IVCtlTiDiff_2_C "DFES/Hersteller spezifischer Fehlercode für Prüfung DFC_IVCtlTiDiff_2" VALUE 0x80026B76 Val_Wu16 65535.00 DFES_OneToOne 0.00 65535.00 /end CHARACTERISTIC
/begin CHARACTERISTIC DFES_DTCM.DFC_IVCtlTiDiff_3_C "DFES/Hersteller spezifischer Fehlercode für Prüfung DFC_IVCtlTiDiff_3" VALUE 0x80026B78 Val_Wu16 65535.00 DFES_OneToOne 0.00 65535.00 /end CHARACTERISTIC
/begin CHARACTERISTIC DFES_DTCM.DFC_IVCtlTiDiff_4_C "DFES/Hersteller spezifischer Fehlercode für Prüfung DFC_IVCtlTiDiff_4" VALUE 0x80026B7A Val_Wu16 65535.00 DFES_OneToOne 0.00 65535.00 /end CHARACTERISTIC
/begin CHARACTERISTIC DFES_DTCM.DFC_IVCtlTiDiff_5_C "DFES/Hersteller spezifischer Fehlercode für Prüfung DFC_IVCtlTiDiff_5" VALUE 0x80026B7C Val_Wu16 65535.00 DFES_OneToOne 0.00 65535.00 /end CHARACTERISTIC
/begin CHARACTERISTIC DFES_DTCM.DFC_IVCtlUDiffUp_0_C "DFES/Hersteller spezifischer Fehlercode für Prüfung DFC_IVCtlUDiffUp_0" VALUE 0x80026B7E Val_Wu16 65535.00 DFES_OneToOne 0.00 65535.00 /end CHARACTERISTIC
/begin CHARACTERISTIC DFES_DTCM.DFC_IVCtlUDiffUp_1_C "DFES/Hersteller spezifischer Fehlercode für Prüfung DFC_IVCtlUDiffUp_1" VALUE 0x80026B80 Val_Wu16 65535.00 DFES_OneToOne 0.00 65535.00 /end CHARACTERISTIC
/begin CHARACTERISTIC DFES_DTCM.DFC_IVCtlUDiffUp_2_C "DFES/Hersteller spezifischer Fehlercode für Prüfung DFC_IVCtlUDiffUp_2" VALUE 0x80026B82 Val_Wu16 65535.00 DFES_OneToOne 0.00 65535.00 /end CHARACTERISTIC
/begin CHARACTERISTIC DFES_DTCM.DFC_IVCtlUDiffUp_3_C "DFES/Hersteller spezifischer Fehlercode für Prüfung DFC_IVCtlUDiffUp_3" VALUE 0x80026B84 Val_Wu16 65535.00 DFES_OneToOne 0.00 65535.00 /end CHARACTERISTIC
/begin CHARACTERISTIC DFES_DTCM.DFC_IVCtlUDiffUp_4_C "DFES/Hersteller spezifischer Fehlercode für Prüfung DFC_IVCtlUDiffUp_4" VALUE 0x80026B86 Val_Wu16 65535.00 DFES_OneToOne 0.00 65535.00 /end CHARACTERISTIC
/begin CHARACTERISTIC DFES_DTCM.DFC_IVCtlUDiffUp_5_C "DFES/Hersteller spezifischer Fehlercode für Prüfung DFC_IVCtlUDiffUp_5" VALUE 0x80026B88 Val_Wu16 65535.00 DFES_OneToOne 0.00 65535.00 /end CHARACTERISTIC
/begin CHARACTERISTIC DFES_DTCM.DFC_IVCtlUUp_0_C "DFES/Hersteller spezifischer Fehlercode für Prüfung DFC_IVCtlUUp_0" VALUE 0x80026B8A Val_Wu16 65535.00 DFES_OneToOne 0.00 65535.00 /end CHARACTERISTIC
/begin CHARACTERISTIC DFES_DTCM.DFC_IVCtlUUp_1_C "DFES/Hersteller spezifischer Fehlercode für Prüfung DFC_IVCtlUUp_1" VALUE 0x80026B8C Val_Wu16 65535.00 DFES_OneToOne 0.00 65535.00 /end CHARACTERISTIC
/begin CHARACTERISTIC DFES_DTCM.DFC_IVCtlUUp_2_C "DFES/Hersteller spezifischer Fehlercode für Prüfung DFC_IVCtlUUp_2" VALUE 0x80026B8E Val_Wu16 65535.00 DFES_OneToOne 0.00 65535.00 /end CHARACTERISTIC
/begin CHARACTERISTIC DFES_DTCM.DFC_IVCtlUUp_3_C "DFES/Hersteller spezifischer Fehlercode für Prüfung DFC_IVCtlUUp_3" VALUE 0x80026B90 Val_Wu16 65535.00 DFES_OneToOne 0.00 65535.00 /end CHARACTERISTIC
/begin CHARACTERISTIC DFES_DTCM.DFC_IVCtlUUp_4_C "DFES/Hersteller spezifischer Fehlercode für Prüfung DFC_IVCtlUUp_4" VALUE 0x80026B92 Val_Wu16 65535.00 DFES_OneToOne 0.00 65535.00 /end CHARACTERISTIC
/begin CHARACTERISTIC DFES_DTCM.DFC_IVCtlUUp_5_C "DFES/Hersteller spezifischer Fehlercode für Prüfung DFC_IVCtlUUp_5" VALUE 0x80026B94 Val_Wu16 65535.00 DFES_OneToOne 0.00 65535.00 /end CHARACTERISTIC
/begin CHARACTERISTIC DFES_DTCM.DFC_IVDiaBnkShCir_0_C "DFES/Hersteller spezifischer Fehlercode für Prüfung DFC_IVDiaBnkShCir_0" VALUE 0x80026B96 Val_Wu16 65535.00 DFES_OneToOne 0.00 65535.00 /end CHARACTERISTIC
/begin CHARACTERISTIC DFES_DTCM.DFC_IVDiaBnkShCir_1_C "DFES/Hersteller spezifischer Fehlercode für Prüfung DFC_IVDiaBnkShCir_1" VALUE 0x80026B98 Val_Wu16 65535.00 DFES_OneToOne 0.00 65535.00 /end CHARACTERISTIC
/begin CHARACTERISTIC DFES_DTCM.DFC_IVDiaBnkShCirChSwt_0_C "DFES/Hersteller spezifischer Fehlercode für Prüfung DFC_IVDiaBnkShCirChSwt_0" VALUE 0x80026B9A Val_Wu16 65535.00 DFES_OneToOne 0.00 65535.00 /end CHARACTERISTIC
/begin CHARACTERISTIC DFES_DTCM.DFC_IVDiaBnkShCirChSwt_1_C "DFES/Hersteller spezifischer Fehlercode für Prüfung DFC_IVDiaBnkShCirChSwt_1" VALUE 0x80026B9C Val_Wu16 65535.00 DFES_OneToOne 0.00 65535.00 /end CHARACTERISTIC
/begin CHARACTERISTIC DFES_DTCM.DFC_IVDiaChp_0_C "DFES/Hersteller spezifischer Fehlercode für Prüfung DFC_IVDiaChp_0" VALUE 0x80026B9E Val_Wu16 65535.00 DFES_OneToOne 0.00 65535.00 /end CHARACTERISTIC
/begin CHARACTERISTIC DFES_DTCM.DFC_IVDiaChp_1_C "DFES/Hersteller spezifischer Fehlercode für Prüfung DFC_IVDiaChp_1" VALUE 0x80026BA0 Val_Wu16 65535.00 DFES_OneToOne 0.00 65535.00 /end CHARACTERISTIC
/begin CHARACTERISTIC DFES_DTCM.DFC_IVDiaCylNoCls_0_C "DFES/Hersteller spezifischer Fehlercode für Prüfung DFC_IVDiaCylNoCls_0" VALUE 0x80026BA2 Val_Wu16 65535.00 DFES_OneToOne 0.00 65535.00 /end CHARACTERISTIC
/begin CHARACTERISTIC DFES_DTCM.DFC_IVDiaCylNoCls_1_C "DFES/Hersteller spezifischer Fehlercode für Prüfung DFC_IVDiaCylNoCls_1" VALUE 0x80026BA4 Val_Wu16 65535.00 DFES_OneToOne 0.00 65535.00 /end CHARACTERISTIC
/begin CHARACTERISTIC DFES_DTCM.DFC_IVDiaCylNoCls_2_C "DFES/Hersteller spezifischer Fehlercode für Prüfung DFC_IVDiaCylNoCls_2" VALUE 0x80026BA6 Val_Wu16 65535.00 DFES_OneToOne 0.00 65535.00 /end CHARACTERISTIC
/begin CHARACTERISTIC DFES_DTCM.DFC_IVDiaCylNoCls_3_C "DFES/Hersteller spezifischer Fehlercode für Prüfung DFC_IVDiaCylNoCls_3" VALUE 0x80026BA8 Val_Wu16 65535.00 DFES_OneToOne 0.00 65535.00 /end CHARACTERISTIC
/begin CHARACTERISTIC DFES_DTCM.DFC_IVDiaCylNoCls_4_C "DFES/Hersteller spezifischer Fehlercode für Prüfung DFC_IVDiaCylNoCls_4" VALUE 0x80026BAA Val_Wu16 65535.00 DFES_OneToOne 0.00 65535.00 /end CHARACTERISTIC
/begin CHARACTERISTIC DFES_DTCM.DFC_IVDiaCylNoCls_5_C "DFES/Hersteller spezifischer Fehlercode für Prüfung DFC_IVDiaCylNoCls_5" VALUE 0x80026BAC Val_Wu16 65535.00 DFES_OneToOne 0.00 65535.00 /end CHARACTERISTIC
/begin CHARACTERISTIC DFES_DTCM.DFC_IVDiaCylNoLd_0_C "DFES/Hersteller spezifischer Fehlercode für Prüfung DFC_IVDiaCylNoLd_0" VALUE 0x80026BAE Val_Wu16 65535.00 DFES_OneToOne 0.00 65535.00 /end CHARACTERISTIC
/begin CHARACTERISTIC DFES_DTCM.DFC_IVDiaCylNoLd_1_C "DFES/Hersteller spezifischer Fehlercode für Prüfung DFC_IVDiaCylNoLd_1" VALUE 0x80026BB0 Val_Wu16 65535.00 DFES_OneToOne 0.00 65535.00 /end CHARACTERISTIC
/begin CHARACTERISTIC DFES_DTCM.DFC_IVDiaCylNoLd_2_C "DFES/Hersteller spezifischer Fehlercode für Prüfung DFC_IVDiaCylNoLd_2" VALUE 0x80026BB2 Val_Wu16 65535.00 DFES_OneToOne 0.00 65535.00 /end CHARACTERISTIC
/begin CHARACTERISTIC DFES_DTCM.DFC_IVDiaCylNoLd_3_C "DFES/Hersteller spezifischer Fehlercode für Prüfung DFC_IVDiaCylNoLd_3" VALUE 0x80026BB4 Val_Wu16 65535.00 DFES_OneToOne 0.00 65535.00 /end CHARACTERISTIC
/begin CHARACTERISTIC DFES_DTCM.DFC_IVDiaCylNoLd_4_C "DFES/Hersteller spezifischer Fehlercode für Prüfung DFC_IVDiaCylNoLd_4" VALUE 0x80026BB6 Val_Wu16 65535.00 DFES_OneToOne 0.00 65535.00 /end CHARACTERISTIC
/begin CHARACTERISTIC DFES_DTCM.DFC_IVDiaCylNoLd_5_C "DFES/Hersteller spezifischer Fehlercode für Prüfung DFC_IVDiaCylNoLd_5" VALUE 0x80026BB8 Val_Wu16 65535.00 DFES_OneToOne 0.00 65535.00 /end CHARACTERISTIC
/begin CHARACTERISTIC DFES_DTCM.DFC_IVDiaCylShCir_0_C "DFES/Hersteller spezifischer Fehlercode für Prüfung DFC_IVDiaCylShCir_0" VALUE 0x80026BBA Val_Wu16 65535.00 DFES_OneToOne 0.00 65535.00 /end CHARACTERISTIC
/begin CHARACTERISTIC DFES_DTCM.DFC_IVDiaCylShCir_1_C "DFES/Hersteller spezifischer Fehlercode für Prüfung DFC_IVDiaCylShCir_1" VALUE 0x80026BBC Val_Wu16 65535.00 DFES_OneToOne 0.00 65535.00 /end CHARACTERISTIC
/begin CHARACTERISTIC DFES_DTCM.DFC_IVDiaCylShCir_2_C "DFES/Hersteller spezifischer Fehlercode für Prüfung DFC_IVDiaCylShCir_2" VALUE 0x80026BBE Val_Wu16 65535.00 DFES_OneToOne 0.00 65535.00 /end CHARACTERISTIC
/begin CHARACTERISTIC DFES_DTCM.DFC_IVDiaCylShCir_3_C "DFES/Hersteller spezifischer Fehlercode für Prüfung DFC_IVDiaCylShCir_3" VALUE 0x80026BC0 Val_Wu16 65535.00 DFES_OneToOne 0.00 65535.00 /end CHARACTERISTIC
/begin CHARACTERISTIC DFES_DTCM.DFC_IVDiaCylShCir_4_C "DFES/Hersteller spezifischer Fehlercode für Prüfung DFC_IVDiaCylShCir_4" VALUE 0x80026BC2 Val_Wu16 65535.00 DFES_OneToOne 0.00 65535.00 /end CHARACTERISTIC
/begin CHARACTERISTIC DFES_DTCM.DFC_IVDiaCylShCir_5_C "DFES/Hersteller spezifischer Fehlercode für Prüfung DFC_IVDiaCylShCir_5" VALUE 0x80026BC4 Val_Wu16 65535.00 DFES_OneToOne 0.00 65535.00 /end CHARACTERISTIC
/begin CHARACTERISTIC DFES_DTCM.DFC_IVDiaCylShCirHSLS_0_C "DFES/Hersteller spezifischer Fehlercode für Prüfung DFC_IVDiaCylShCirHSLS_0" VALUE 0x80026BC6 Val_Wu16 65535.00 DFES_OneToOne 0.00 65535.00 /end CHARACTERISTIC
/begin CHARACTERISTIC DFES_DTCM.DFC_IVDiaCylShCirHSLS_1_C "DFES/Hersteller spezifischer Fehlercode für Prüfung DFC_IVDiaCylShCirHSLS_1" VALUE 0x80026BC8 Val_Wu16 65535.00 DFES_OneToOne 0.00 65535.00 /end CHARACTERISTIC
/begin CHARACTERISTIC DFES_DTCM.DFC_IVDiaCylShCirHSLS_2_C "DFES/Hersteller spezifischer Fehlercode für Prüfung DFC_IVDiaCylShCirHSLS_2" VALUE 0x80026BCA Val_Wu16 65535.00 DFES_OneToOne 0.00 65535.00 /end CHARACTERISTIC
/begin CHARACTERISTIC DFES_DTCM.DFC_IVDiaCylShCirHSLS_3_C "DFES/Hersteller spezifischer Fehlercode für Prüfung DFC_IVDiaCylShCirHSLS_3" VALUE 0x80026BCC Val_Wu16 65535.00 DFES_OneToOne 0.00 65535.00 /end CHARACTERISTIC
/begin CHARACTERISTIC DFES_DTCM.DFC_IVDiaCylShCirHSLS_4_C "DFES/Hersteller spezifischer Fehlercode für Prüfung DFC_IVDiaCylShCirHSLS_4" VALUE 0x80026BCE Val_Wu16 65535.00 DFES_OneToOne 0.00 65535.00 /end CHARACTERISTIC
/begin CHARACTERISTIC DFES_DTCM.DFC_IVDiaCylShCirHSLS_5_C "DFES/Hersteller spezifischer Fehlercode für Prüfung DFC_IVDiaCylShCirHSLS_5" VALUE 0x80026BD0 Val_Wu16 65535.00 DFES_OneToOne 0.00 65535.00 /end CHARACTERISTIC
/begin CHARACTERISTIC DFES_DTCM.DFC_IVDiaCylShCirMeas_0_C "DFES/Hersteller spezifischer Fehlercode für Prüfung DFC_IVDiaCylShCirMeas_0" VALUE 0x80026BD2 Val_Wu16 65535.00 DFES_OneToOne 0.00 65535.00 /end CHARACTERISTIC
/begin CHARACTERISTIC DFES_DTCM.DFC_IVDiaCylShCirMeas_1_C "DFES/Hersteller spezifischer Fehlercode für Prüfung DFC_IVDiaCylShCirMeas_1" VALUE 0x80026BD4 Val_Wu16 65535.00 DFES_OneToOne 0.00 65535.00 /end CHARACTERISTIC
/begin CHARACTERISTIC DFES_DTCM.DFC_IVDiaCylShCirMeas_2_C "DFES/Hersteller spezifischer Fehlercode für Prüfung DFC_IVDiaCylShCirMeas_2" VALUE 0x80026BD6 Val_Wu16 65535.00 DFES_OneToOne 0.00 65535.00 /end CHARACTERISTIC
/begin CHARACTERISTIC DFES_DTCM.DFC_IVDiaCylShCirMeas_3_C "DFES/Hersteller spezifischer Fehlercode für Prüfung DFC_IVDiaCylShCirMeas_3" VALUE 0x80026BD8 Val_Wu16 65535.00 DFES_OneToOne 0.00 65535.00 /end CHARACTERISTIC
/begin CHARACTERISTIC DFES_DTCM.DFC_IVDiaCylShCirMeas_4_C "DFES/Hersteller spezifischer Fehlercode für Prüfung DFC_IVDiaCylShCirMeas_4" VALUE 0x80026BDA Val_Wu16 65535.00 DFES_OneToOne 0.00 65535.00 /end CHARACTERISTIC
/begin CHARACTERISTIC DFES_DTCM.DFC_IVDiaCylShCirMeas_5_C "DFES/Hersteller spezifischer Fehlercode für Prüfung DFC_IVDiaCylShCirMeas_5" VALUE 0x80026BDC Val_Wu16 65535.00 DFES_OneToOne 0.00 65535.00 /end CHARACTERISTIC
/begin CHARACTERISTIC DFES_DTCM.DFC_LSUDynChk_C "DFES/Hersteller spezifischer Fehlercode für Prüfung DFC_LSUDynChk" VALUE 0x80026BDE Val_Wu16 65535.00 DFES_OneToOne 0.00 65535.00 /end CHARACTERISTIC
/begin CHARACTERISTIC DFES_DTCM.DFC_LSUO2ClbMax_C "DFES/Hersteller spezifischer Fehlercode für Prüfung DFC_LSUO2ClbMax" VALUE 0x80026BE0 Val_Wu16 65535.00 DFES_OneToOne 0.00 65535.00 /end CHARACTERISTIC
/begin CHARACTERISTIC DFES_DTCM.DFC_LSUO2ClbMin_C "DFES/Hersteller spezifischer Fehlercode für Prüfung DFC_LSUO2ClbMin" VALUE 0x80026BE2 Val_Wu16 65535.00 DFES_OneToOne 0.00 65535.00 /end CHARACTERISTIC
/begin CHARACTERISTIC DFES_DTCM.DFC_LSUO2PlausMaxFLd_C "DFES/Hersteller spezifischer Fehlercode für Prüfung DFC_LSUO2PlausMaxFLd" VALUE 0x80026BE4 Val_Wu16 65535.00 DFES_OneToOne 0.00 65535.00 /end CHARACTERISTIC
/begin CHARACTERISTIC DFES_DTCM.DFC_LSUO2PlausMaxOvrRun_C "DFES/Hersteller spezifischer Fehlercode für Prüfung DFC_LSUO2PlausMaxOvrRun" VALUE 0x80026BE6 Val_Wu16 65535.00 DFES_OneToOne 0.00 65535.00 /end CHARACTERISTIC
/begin CHARACTERISTIC DFES_DTCM.DFC_LSUO2PlausMaxPartLd_C "DFES/Hersteller spezifischer Fehlercode für Prüfung DFC_LSUO2PlausMaxPartLd" VALUE 0x80026BE8 Val_Wu16 65535.00 DFES_OneToOne 0.00 65535.00 /end CHARACTERISTIC
/begin CHARACTERISTIC DFES_DTCM.DFC_LSUO2PlausMinFLd_C "DFES/Hersteller spezifischer Fehlercode für Prüfung DFC_LSUO2PlausMinFLd" VALUE 0x80026BEA Val_Wu16 65535.00 DFES_OneToOne 0.00 65535.00 /end CHARACTERISTIC
/begin CHARACTERISTIC DFES_DTCM.DFC_LSUO2PlausMinOvrRun_C "DFES/Hersteller spezifischer Fehlercode für Prüfung DFC_LSUO2PlausMinOvrRun" VALUE 0x80026BEC Val_Wu16 65535.00 DFES_OneToOne 0.00 65535.00 /end CHARACTERISTIC
/begin CHARACTERISTIC DFES_DTCM.DFC_LSUO2PlausMinPartLd_C "DFES/Hersteller spezifischer Fehlercode für Prüfung DFC_LSUO2PlausMinPartLd" VALUE 0x80026BEE Val_Wu16 65535.00 DFES_OneToOne 0.00 65535.00 /end CHARACTERISTIC
/begin CHARACTERISTIC DFES_DTCM.DFC_LSURiClbMax_C "DFES/Hersteller spezifischer Fehlercode für Prüfung DFC_LSURiClbMax" VALUE 0x80026BF0 Val_Wu16 65535.00 DFES_OneToOne 0.00 65535.00 /end CHARACTERISTIC
/begin CHARACTERISTIC DFES_DTCM.DFC_LSURiClbMin_C "DFES/Hersteller spezifischer Fehlercode für Prüfung DFC_LSURiClbMin" VALUE 0x80026BF2 Val_Wu16 65535.00 DFES_OneToOne 0.00 65535.00 /end CHARACTERISTIC
/begin CHARACTERISTIC DFES_DTCM.DFC_LSUWireIPSig_C "DFES/Hersteller spezifischer Fehlercode für Prüfung DFC_LSUWireIPSig" VALUE 0x80026BF4 Val_Wu16 65535.00 DFES_OneToOne 0.00 65535.00 /end CHARACTERISTIC
/begin CHARACTERISTIC DFES_DTCM.DFC_Layer_BSDMax_C "DFES/Hersteller spezifischer Fehlercode für Prüfung DFC_Layer_BSDMax" VALUE 0x80026BF6 Val_Wu16 65535.00 DFES_OneToOne 0.00 65535.00 /end CHARACTERISTIC
/begin CHARACTERISTIC DFES_DTCM.DFC_Layer_BSDMin_C "DFES/Hersteller spezifischer Fehlercode für Prüfung DFC_Layer_BSDMin" VALUE 0x80026BF8 Val_Wu16 65535.00 DFES_OneToOne 0.00 65535.00 /end CHARACTERISTIC
/begin CHARACTERISTIC DFES_DTCM.DFC_Layer_BSDNpl_C "DFES/Hersteller spezifischer Fehlercode für Prüfung DFC_Layer_BSDNpl" VALUE 0x80026BFA Val_Wu16 65535.00 DFES_OneToOne 0.00 65535.00 /end CHARACTERISTIC
/begin CHARACTERISTIC DFES_DTCM.DFC_Layer_BSDSig_C "DFES/Hersteller spezifischer Fehlercode für Prüfung DFC_Layer_BSDSig" VALUE 0x80026BFC Val_Wu16 65535.00 DFES_OneToOne 0.00 65535.00 /end CHARACTERISTIC
/begin CHARACTERISTIC DFES_DTCM.DFC_Layer_FltMngTstMax_C "DFES/Hersteller spezifischer Fehlercode für Prüfung DFC_Layer_FltMngTstMax" VALUE 0x80026BFE Val_Wu16 65535.00 DFES_OneToOne 0.00 65535.00 /end CHARACTERISTIC
/begin CHARACTERISTIC DFES_DTCM.DFC_Layer_FltMngTstMin_C "DFES/Hersteller spezifischer Fehlercode für Prüfung DFC_Layer_FltMngTstMin" VALUE 0x80026C00 Val_Wu16 65535.00 DFES_OneToOne 0.00 65535.00 /end CHARACTERISTIC
/begin CHARACTERISTIC DFES_DTCM.DFC_Layer_FltMngTstNpl_C "DFES/Hersteller spezifischer Fehlercode für Prüfung DFC_Layer_FltMngTstNpl" VALUE 0x80026C02 Val_Wu16 65535.00 DFES_OneToOne 0.00 65535.00 /end CHARACTERISTIC
/begin CHARACTERISTIC DFES_DTCM.DFC_Layer_FltMngTstSig_C "DFES/Hersteller spezifischer Fehlercode für Prüfung DFC_Layer_FltMngTstSig" VALUE 0x80026C04 Val_Wu16 65535.00 DFES_OneToOne 0.00 65535.00 /end CHARACTERISTIC
/begin CHARACTERISTIC DFES_DTCM.DFC_Layer_GENELBMax_C "DFES/Hersteller spezifischer Fehlercode für Prüfung DFC_Layer_GENELBMax" VALUE 0x80026C06 Val_Wu16 65535.00 DFES_OneToOne 0.00 65535.00 /end CHARACTERISTIC
/begin CHARACTERISTIC DFES_DTCM.DFC_Layer_GENELBMin_C "DFES/Hersteller spezifischer Fehlercode für Prüfung DFC_Layer_GENELBMin" VALUE 0x80026C08 Val_Wu16 65535.00 DFES_OneToOne 0.00 65535.00 /end CHARACTERISTIC
/begin CHARACTERISTIC DFES_DTCM.DFC_Layer_GENELBNpl_C "DFES/Hersteller spezifischer Fehlercode für Prüfung DFC_Layer_GENELBNpl" VALUE 0x80026C0A Val_Wu16 65535.00 DFES_OneToOne 0.00 65535.00 /end CHARACTERISTIC
/begin CHARACTERISTIC DFES_DTCM.DFC_Layer_GENELBSig_C "DFES/Hersteller spezifischer Fehlercode für Prüfung DFC_Layer_GENELBSig" VALUE 0x80026C0C Val_Wu16 65535.00 DFES_OneToOne 0.00 65535.00 /end CHARACTERISTIC
/begin CHARACTERISTIC DFES_DTCM.DFC_Layer_GENELMax_C "DFES/Hersteller spezifischer Fehlercode für Prüfung DFC_Layer_GENELMax" VALUE 0x80026C0E Val_Wu16 65535.00 DFES_OneToOne 0.00 65535.00 /end CHARACTERISTIC
/begin CHARACTERISTIC DFES_DTCM.DFC_Layer_GENELMin_C "DFES/Hersteller spezifischer Fehlercode für Prüfung DFC_Layer_GENELMin" VALUE 0x80026C10 Val_Wu16 65535.00 DFES_OneToOne 0.00 65535.00 /end CHARACTERISTIC
/begin CHARACTERISTIC DFES_DTCM.DFC_Layer_GENELNpl_C "DFES/Hersteller spezifischer Fehlercode für Prüfung DFC_Layer_GENELNpl" VALUE 0x80026C12 Val_Wu16 65535.00 DFES_OneToOne 0.00 65535.00 /end CHARACTERISTIC
/begin CHARACTERISTIC DFES_DTCM.DFC_Layer_GENELSig_C "DFES/Hersteller spezifischer Fehlercode für Prüfung DFC_Layer_GENELSig" VALUE 0x80026C14 Val_Wu16 65535.00 DFES_OneToOne 0.00 65535.00 /end CHARACTERISTIC
/begin CHARACTERISTIC DFES_DTCM.DFC_Layer_GENHTBMax_C "DFES/Hersteller spezifischer Fehlercode für Prüfung DFC_Layer_GENHTBMax" VALUE 0x80026C16 Val_Wu16 65535.00 DFES_OneToOne 0.00 65535.00 /end CHARACTERISTIC
/begin CHARACTERISTIC DFES_DTCM.DFC_Layer_GENHTBMin_C "DFES/Hersteller spezifischer Fehlercode für Prüfung DFC_Layer_GENHTBMin" VALUE 0x80026C18 Val_Wu16 65535.00 DFES_OneToOne 0.00 65535.00 /end CHARACTERISTIC
/begin CHARACTERISTIC DFES_DTCM.DFC_Layer_GENHTBNpl_C "DFES/Hersteller spezifischer Fehlercode für Prüfung DFC_Layer_GENHTBNpl" VALUE 0x80026C1A Val_Wu16 65535.00 DFES_OneToOne 0.00 65535.00 /end CHARACTERISTIC
/begin CHARACTERISTIC DFES_DTCM.DFC_Layer_GENHTBSig_C "DFES/Hersteller spezifischer Fehlercode für Prüfung DFC_Layer_GENHTBSig" VALUE 0x80026C1C Val_Wu16 65535.00 DFES_OneToOne 0.00 65535.00 /end CHARACTERISTIC
/begin CHARACTERISTIC DFES_DTCM.DFC_Layer_GENHTMax_C "DFES/Hersteller spezifischer Fehlercode für Prüfung DFC_Layer_GENHTMax" VALUE 0x80026C1E Val_Wu16 65535.00 DFES_OneToOne 0.00 65535.00 /end CHARACTERISTIC
/begin CHARACTERISTIC DFES_DTCM.DFC_Layer_GENHTMin_C "DFES/Hersteller spezifischer Fehlercode für Prüfung DFC_Layer_GENHTMin" VALUE 0x80026C20 Val_Wu16 65535.00 DFES_OneToOne 0.00 65535.00 /end CHARACTERISTIC
/begin CHARACTERISTIC DFES_DTCM.DFC_Layer_GENHTNpl_C "DFES/Hersteller spezifischer Fehlercode für Prüfung DFC_Layer_GENHTNpl" VALUE 0x80026C22 Val_Wu16 65535.00 DFES_OneToOne 0.00 65535.00 /end CHARACTERISTIC
/begin CHARACTERISTIC DFES_DTCM.DFC_Layer_GENHTSig_C "DFES/Hersteller spezifischer Fehlercode für Prüfung DFC_Layer_GENHTSig" VALUE 0x80026C24 Val_Wu16 65535.00 DFES_OneToOne 0.00 65535.00 /end CHARACTERISTIC
/begin CHARACTERISTIC DFES_DTCM.DFC_Layer_GENKOMMMax_C "DFES/Hersteller spezifischer Fehlercode für Prüfung DFC_Layer_GENKOMMMax" VALUE 0x80026C26 Val_Wu16 65535.00 DFES_OneToOne 0.00 65535.00 /end CHARACTERISTIC
/begin CHARACTERISTIC DFES_DTCM.DFC_Layer_GENKOMMMin_C "DFES/Hersteller spezifischer Fehlercode für Prüfung DFC_Layer_GENKOMMMin" VALUE 0x80026C28 Val_Wu16 65535.00 DFES_OneToOne 0.00 65535.00 /end CHARACTERISTIC
/begin CHARACTERISTIC DFES_DTCM.DFC_Layer_GENKOMMNpl_C "DFES/Hersteller spezifischer Fehlercode für Prüfung DFC_Layer_GENKOMMNpl" VALUE 0x80026C2A Val_Wu16 65535.00 DFES_OneToOne 0.00 65535.00 /end CHARACTERISTIC
/begin CHARACTERISTIC DFES_DTCM.DFC_Layer_GENKOMMSig_C "DFES/Hersteller spezifischer Fehlercode für Prüfung DFC_Layer_GENKOMMSig" VALUE 0x80026C2C Val_Wu16 65535.00 DFES_OneToOne 0.00 65535.00 /end CHARACTERISTIC
/begin CHARACTERISTIC DFES_DTCM.DFC_Layer_GENMECHMax_C "DFES/Hersteller spezifischer Fehlercode für Prüfung DFC_Layer_GENMECHMax" VALUE 0x80026C2E Val_Wu16 65535.00 DFES_OneToOne 0.00 65535.00 /end CHARACTERISTIC
/begin CHARACTERISTIC DFES_DTCM.DFC_Layer_GENMECHMin_C "DFES/Hersteller spezifischer Fehlercode für Prüfung DFC_Layer_GENMECHMin" VALUE 0x80026C30 Val_Wu16 65535.00 DFES_OneToOne 0.00 65535.00 /end CHARACTERISTIC
/begin CHARACTERISTIC DFES_DTCM.DFC_Layer_GENMECHNpl_C "DFES/Hersteller spezifischer Fehlercode für Prüfung DFC_Layer_GENMECHNpl" VALUE 0x80026C32 Val_Wu16 65535.00 DFES_OneToOne 0.00 65535.00 /end CHARACTERISTIC
/begin CHARACTERISTIC DFES_DTCM.DFC_Layer_GENMECHSig_C "DFES/Hersteller spezifischer Fehlercode für Prüfung DFC_Layer_GENMECHSig" VALUE 0x80026C34 Val_Wu16 65535.00 DFES_OneToOne 0.00 65535.00 /end CHARACTERISTIC
/begin CHARACTERISTIC DFES_DTCM.DFC_Layer_GENMax_C "DFES/Hersteller spezifischer Fehlercode für Prüfung DFC_Layer_GENMax" VALUE 0x80026C36 Val_Wu16 65535.00 DFES_OneToOne 0.00 65535.00 /end CHARACTERISTIC
/begin CHARACTERISTIC DFES_DTCM.DFC_Layer_GENMin_C "DFES/Hersteller spezifischer Fehlercode für Prüfung DFC_Layer_GENMin" VALUE 0x80026C38 Val_Wu16 65535.00 DFES_OneToOne 0.00 65535.00 /end CHARACTERISTIC
/begin CHARACTERISTIC DFES_DTCM.DFC_Layer_GENNpl_C "DFES/Hersteller spezifischer Fehlercode für Prüfung DFC_Layer_GENNpl" VALUE 0x80026C3A Val_Wu16 65535.00 DFES_OneToOne 0.00 65535.00 /end CHARACTERISTIC
/begin CHARACTERISTIC DFES_DTCM.DFC_Layer_GENREGUPLMax_C "DFES/Hersteller spezifischer Fehlercode für Prüfung DFC_Layer_GENREGUPLMax" VALUE 0x80026C3C Val_Wu16 65535.00 DFES_OneToOne 0.00 65535.00 /end CHARACTERISTIC
/begin CHARACTERISTIC DFES_DTCM.DFC_Layer_GENREGUPLMin_C "DFES/Hersteller spezifischer Fehlercode für Prüfung DFC_Layer_GENREGUPLMin" VALUE 0x80026C3E Val_Wu16 65535.00 DFES_OneToOne 0.00 65535.00 /end CHARACTERISTIC
/begin CHARACTERISTIC DFES_DTCM.DFC_Layer_GENREGUPLNpl_C "DFES/Hersteller spezifischer Fehlercode für Prüfung DFC_Layer_GENREGUPLNpl" VALUE 0x80026C40 Val_Wu16 65535.00 DFES_OneToOne 0.00 65535.00 /end CHARACTERISTIC
/begin CHARACTERISTIC DFES_DTCM.DFC_Layer_GENREGUPLSig_C "DFES/Hersteller spezifischer Fehlercode für Prüfung DFC_Layer_GENREGUPLSig" VALUE 0x80026C42 Val_Wu16 65535.00 DFES_OneToOne 0.00 65535.00 /end CHARACTERISTIC
/begin CHARACTERISTIC DFES_DTCM.DFC_Layer_GENSig_C "DFES/Hersteller spezifischer Fehlercode für Prüfung DFC_Layer_GENSig" VALUE 0x80026C44 Val_Wu16 65535.00 DFES_OneToOne 0.00 65535.00 /end CHARACTERISTIC
/begin CHARACTERISTIC DFES_DTCM.DFC_Layer_GENUPLMax_C "DFES/Hersteller spezifischer Fehlercode für Prüfung DFC_Layer_GENUPLMax" VALUE 0x80026C46 Val_Wu16 65535.00 DFES_OneToOne 0.00 65535.00 /end CHARACTERISTIC
/begin CHARACTERISTIC DFES_DTCM.DFC_Layer_GENUPLMin_C "DFES/Hersteller spezifischer Fehlercode für Prüfung DFC_Layer_GENUPLMin" VALUE 0x80026C48 Val_Wu16 65535.00 DFES_OneToOne 0.00 65535.00 /end CHARACTERISTIC
/begin CHARACTERISTIC DFES_DTCM.DFC_Layer_GENUPLNpl_C "DFES/Hersteller spezifischer Fehlercode für Prüfung DFC_Layer_GENUPLNpl" VALUE 0x80026C4A Val_Wu16 65535.00 DFES_OneToOne 0.00 65535.00 /end CHARACTERISTIC
/begin CHARACTERISTIC DFES_DTCM.DFC_Layer_GENUPLSig_C "DFES/Hersteller spezifischer Fehlercode für Prüfung DFC_Layer_GENUPLSig" VALUE 0x80026C4C Val_Wu16 65535.00 DFES_OneToOne 0.00 65535.00 /end CHARACTERISTIC
/begin CHARACTERISTIC DFES_DTCM.DFC_Layer_IBS1Max_C "DFES/Hersteller spezifischer Fehlercode für Prüfung DFC_Layer_IBS1Max" VALUE 0x80026C4E Val_Wu16 65535.00 DFES_OneToOne 0.00 65535.00 /end CHARACTERISTIC
/begin CHARACTERISTIC DFES_DTCM.DFC_Layer_IBS1Min_C "DFES/Hersteller spezifischer Fehlercode für Prüfung DFC_Layer_IBS1Min" VALUE 0x80026C50 Val_Wu16 65535.00 DFES_OneToOne 0.00 65535.00 /end CHARACTERISTIC
/begin CHARACTERISTIC DFES_DTCM.DFC_Layer_IBS1Npl_C "DFES/Hersteller spezifischer Fehlercode für Prüfung DFC_Layer_IBS1Npl" VALUE 0x80026C52 Val_Wu16 65535.00 DFES_OneToOne 0.00 65535.00 /end CHARACTERISTIC
/begin CHARACTERISTIC DFES_DTCM.DFC_Layer_IBS1Sig_C "DFES/Hersteller spezifischer Fehlercode für Prüfung DFC_Layer_IBS1Sig" VALUE 0x80026C54 Val_Wu16 65535.00 DFES_OneToOne 0.00 65535.00 /end CHARACTERISTIC
/begin CHARACTERISTIC DFES_DTCM.DFC_Layer_IBS2Max_C "DFES/Hersteller spezifischer Fehlercode für Prüfung DFC_Layer_IBS2Max" VALUE 0x80026C56 Val_Wu16 65535.00 DFES_OneToOne 0.00 65535.00 /end CHARACTERISTIC
/begin CHARACTERISTIC DFES_DTCM.DFC_Layer_IBS2Min_C "DFES/Hersteller spezifischer Fehlercode für Prüfung DFC_Layer_IBS2Min" VALUE 0x80026C58 Val_Wu16 65535.00 DFES_OneToOne 0.00 65535.00 /end CHARACTERISTIC
/begin CHARACTERISTIC DFES_DTCM.DFC_Layer_IBS2Npl_C "DFES/Hersteller spezifischer Fehlercode für Prüfung DFC_Layer_IBS2Npl" VALUE 0x80026C5A Val_Wu16 65535.00 DFES_OneToOne 0.00 65535.00 /end CHARACTERISTIC
/begin CHARACTERISTIC DFES_DTCM.DFC_Layer_IBS2Sig_C "DFES/Hersteller spezifischer Fehlercode für Prüfung DFC_Layer_IBS2Sig" VALUE 0x80026C5C Val_Wu16 65535.00 DFES_OneToOne 0.00 65535.00 /end CHARACTERISTIC
/begin CHARACTERISTIC DFES_DTCM.DFC_Layer_IBS3Max_C "DFES/Hersteller spezifischer Fehlercode für Prüfung DFC_Layer_IBS3Max" VALUE 0x80026C5E Val_Wu16 65535.00 DFES_OneToOne 0.00 65535.00 /end CHARACTERISTIC
/begin CHARACTERISTIC DFES_DTCM.DFC_Layer_IBS3Min_C "DFES/Hersteller spezifischer Fehlercode für Prüfung DFC_Layer_IBS3Min" VALUE 0x80026C60 Val_Wu16 65535.00 DFES_OneToOne 0.00 65535.00 /end CHARACTERISTIC
/begin CHARACTERISTIC DFES_DTCM.DFC_Layer_IBS3Npl_C "DFES/Hersteller spezifischer Fehlercode für Prüfung DFC_Layer_IBS3Npl" VALUE 0x80026C62 Val_Wu16 65535.00 DFES_OneToOne 0.00 65535.00 /end CHARACTERISTIC
/begin CHARACTERISTIC DFES_DTCM.DFC_Layer_IBS3Sig_C "DFES/Hersteller spezifischer Fehlercode für Prüfung DFC_Layer_IBS3Sig" VALUE 0x80026C64 Val_Wu16 65535.00 DFES_OneToOne 0.00 65535.00 /end CHARACTERISTIC
/begin CHARACTERISTIC DFES_DTCM.DFC_Layer_MANDETEKMax_C "DFES/Hersteller spezifischer Fehlercode für Prüfung DFC_Layer_MANDETEKMax" VALUE 0x80026C66 Val_Wu16 65535.00 DFES_OneToOne 0.00 65535.00 /end CHARACTERISTIC
/begin CHARACTERISTIC DFES_DTCM.DFC_Layer_MANDETEKMin_C "DFES/Hersteller spezifischer Fehlercode für Prüfung DFC_Layer_MANDETEKMin" VALUE 0x80026C68 Val_Wu16 65535.00 DFES_OneToOne 0.00 65535.00 /end CHARACTERISTIC
/begin CHARACTERISTIC DFES_DTCM.DFC_Layer_MANDETEKNpl_C "DFES/Hersteller spezifischer Fehlercode für Prüfung DFC_Layer_MANDETEKNpl" VALUE 0x80026C6A Val_Wu16 65535.00 DFES_OneToOne 0.00 65535.00 /end CHARACTERISTIC
/begin CHARACTERISTIC DFES_DTCM.DFC_Layer_MANDETEKSig_C "DFES/Hersteller spezifischer Fehlercode für Prüfung DFC_Layer_MANDETEKSig" VALUE 0x80026C6C Val_Wu16 65535.00 DFES_OneToOne 0.00 65535.00 /end CHARACTERISTIC
/begin CHARACTERISTIC DFES_DTCM.DFC_Layer_NDR1Max_C "DFES/Hersteller spezifischer Fehlercode für Prüfung DFC_Layer_NDR1Max" VALUE 0x80026C6E Val_Wu16 65535.00 DFES_OneToOne 0.00 65535.00 /end CHARACTERISTIC
/begin CHARACTERISTIC DFES_DTCM.DFC_Layer_NDR1Min_C "DFES/Hersteller spezifischer Fehlercode für Prüfung DFC_Layer_NDR1Min" VALUE 0x80026C70 Val_Wu16 65535.00 DFES_OneToOne 0.00 65535.00 /end CHARACTERISTIC
/begin CHARACTERISTIC DFES_DTCM.DFC_Layer_NDR1Npl_C "DFES/Hersteller spezifischer Fehlercode für Prüfung DFC_Layer_NDR1Npl" VALUE 0x80026C72 Val_Wu16 65535.00 DFES_OneToOne 0.00 65535.00 /end CHARACTERISTIC
/begin CHARACTERISTIC DFES_DTCM.DFC_Layer_NDR1Sig_C "DFES/Hersteller spezifischer Fehlercode für Prüfung DFC_Layer_NDR1Sig" VALUE 0x80026C74 Val_Wu16 65535.00 DFES_OneToOne 0.00 65535.00 /end CHARACTERISTIC
/begin CHARACTERISTIC DFES_DTCM.DFC_Layer_NDR2Max_C "DFES/Hersteller spezifischer Fehlercode für Prüfung DFC_Layer_NDR2Max" VALUE 0x80026C76 Val_Wu16 65535.00 DFES_OneToOne 0.00 65535.00 /end CHARACTERISTIC
/begin CHARACTERISTIC DFES_DTCM.DFC_Layer_NDR2Min_C "DFES/Hersteller spezifischer Fehlercode für Prüfung DFC_Layer_NDR2Min" VALUE 0x80026C78 Val_Wu16 65535.00 DFES_OneToOne 0.00 65535.00 /end CHARACTERISTIC
/begin CHARACTERISTIC DFES_DTCM.DFC_Layer_NDR2Npl_C "DFES/Hersteller spezifischer Fehlercode für Prüfung DFC_Layer_NDR2Npl" VALUE 0x80026C7A Val_Wu16 65535.00 DFES_OneToOne 0.00 65535.00 /end CHARACTERISTIC
/begin CHARACTERISTIC DFES_DTCM.DFC_Layer_NDR2Sig_C "DFES/Hersteller spezifischer Fehlercode für Prüfung DFC_Layer_NDR2Sig" VALUE 0x80026C7C Val_Wu16 65535.00 DFES_OneToOne 0.00 65535.00 /end CHARACTERISTIC
/begin CHARACTERISTIC DFES_DTCM.DFC_Layer_NGLERNMax_C "DFES/Hersteller spezifischer Fehlercode für Prüfung DFC_Layer_NGLERNMax" VALUE 0x80026C7E Val_Wu16 65535.00 DFES_OneToOne 0.00 65535.00 /end CHARACTERISTIC
/begin CHARACTERISTIC DFES_DTCM.DFC_Layer_NGLERNMin_C "DFES/Hersteller spezifischer Fehlercode für Prüfung DFC_Layer_NGLERNMin" VALUE 0x80026C80 Val_Wu16 65535.00 DFES_OneToOne 0.00 65535.00 /end CHARACTERISTIC
/begin CHARACTERISTIC DFES_DTCM.DFC_Layer_NGLERNNpl_C "DFES/Hersteller spezifischer Fehlercode für Prüfung DFC_Layer_NGLERNNpl" VALUE 0x80026C82 Val_Wu16 65535.00 DFES_OneToOne 0.00 65535.00 /end CHARACTERISTIC
/begin CHARACTERISTIC DFES_DTCM.DFC_Layer_NGLERNSig_C "DFES/Hersteller spezifischer Fehlercode für Prüfung DFC_Layer_NGLERNSig" VALUE 0x80026C84 Val_Wu16 65535.00 DFES_OneToOne 0.00 65535.00 /end CHARACTERISTIC
/begin CHARACTERISTIC DFES_DTCM.DFC_Layer_PMBATTMax_C "DFES/Hersteller spezifischer Fehlercode für Prüfung DFC_Layer_PMBATTMax" VALUE 0x80026C86 Val_Wu16 65535.00 DFES_OneToOne 0.00 65535.00 /end CHARACTERISTIC
/begin CHARACTERISTIC DFES_DTCM.DFC_Layer_PMBATTMin_C "DFES/Hersteller spezifischer Fehlercode für Prüfung DFC_Layer_PMBATTMin" VALUE 0x80026C88 Val_Wu16 65535.00 DFES_OneToOne 0.00 65535.00 /end CHARACTERISTIC
/begin CHARACTERISTIC DFES_DTCM.DFC_Layer_PMBATTNpl_C "DFES/Hersteller spezifischer Fehlercode für Prüfung DFC_Layer_PMBATTNpl" VALUE 0x80026C8A Val_Wu16 65535.00 DFES_OneToOne 0.00 65535.00 /end CHARACTERISTIC
/begin CHARACTERISTIC DFES_DTCM.DFC_Layer_PMBATTSig_C "DFES/Hersteller spezifischer Fehlercode für Prüfung DFC_Layer_PMBATTSig" VALUE 0x80026C8C Val_Wu16 65535.00 DFES_OneToOne 0.00 65535.00 /end CHARACTERISTIC
/begin CHARACTERISTIC DFES_DTCM.DFC_Layer_PMBNMax_C "DFES/Hersteller spezifischer Fehlercode für Prüfung DFC_Layer_PMBNMax" VALUE 0x80026C8E Val_Wu16 65535.00 DFES_OneToOne 0.00 65535.00 /end CHARACTERISTIC
/begin CHARACTERISTIC DFES_DTCM.DFC_Layer_PMBNMin_C "DFES/Hersteller spezifischer Fehlercode für Prüfung DFC_Layer_PMBNMin" VALUE 0x80026C90 Val_Wu16 65535.00 DFES_OneToOne 0.00 65535.00 /end CHARACTERISTIC
/begin CHARACTERISTIC DFES_DTCM.DFC_Layer_PMBNNpl_C "DFES/Hersteller spezifischer Fehlercode für Prüfung DFC_Layer_PMBNNpl" VALUE 0x80026C92 Val_Wu16 65535.00 DFES_OneToOne 0.00 65535.00 /end CHARACTERISTIC
/begin CHARACTERISTIC DFES_DTCM.DFC_Layer_PMBNSig_C "DFES/Hersteller spezifischer Fehlercode für Prüfung DFC_Layer_PMBNSig" VALUE 0x80026C94 Val_Wu16 65535.00 DFES_OneToOne 0.00 65535.00 /end CHARACTERISTIC
/begin CHARACTERISTIC DFES_DTCM.DFC_Layer_PMRUHVERLMax_C "DFES/Hersteller spezifischer Fehlercode für Prüfung DFC_Layer_PMRUHVERLMax" VALUE 0x80026C96 Val_Wu16 65535.00 DFES_OneToOne 0.00 65535.00 /end CHARACTERISTIC
/begin CHARACTERISTIC DFES_DTCM.DFC_Layer_PMRUHVERLMin_C "DFES/Hersteller spezifischer Fehlercode für Prüfung DFC_Layer_PMRUHVERLMin" VALUE 0x80026C98 Val_Wu16 65535.00 DFES_OneToOne 0.00 65535.00 /end CHARACTERISTIC
/begin CHARACTERISTIC DFES_DTCM.DFC_Layer_PMRUHVERLNpl_C "DFES/Hersteller spezifischer Fehlercode für Prüfung DFC_Layer_PMRUHVERLNpl" VALUE 0x80026C9A Val_Wu16 65535.00 DFES_OneToOne 0.00 65535.00 /end CHARACTERISTIC
/begin CHARACTERISTIC DFES_DTCM.DFC_Layer_PMRUHVERLSig_C "DFES/Hersteller spezifischer Fehlercode für Prüfung DFC_Layer_PMRUHVERLSig" VALUE 0x80026C9C Val_Wu16 65535.00 DFES_OneToOne 0.00 65535.00 /end CHARACTERISTIC
/begin CHARACTERISTIC DFES_DTCM.DFC_Layer_QLTMax_C "DFES/Hersteller spezifischer Fehlercode für Prüfung DFC_Layer_QLTMax" VALUE 0x80026C9E Val_Wu16 65535.00 DFES_OneToOne 0.00 65535.00 /end CHARACTERISTIC
/begin CHARACTERISTIC DFES_DTCM.DFC_Layer_QLTMin_C "DFES/Hersteller spezifischer Fehlercode für Prüfung DFC_Layer_QLTMin" VALUE 0x80026CA0 Val_Wu16 65535.00 DFES_OneToOne 0.00 65535.00 /end CHARACTERISTIC
/begin CHARACTERISTIC DFES_DTCM.DFC_Layer_QLTNpl_C "DFES/Hersteller spezifischer Fehlercode für Prüfung DFC_Layer_QLTNpl" VALUE 0x80026CA2 Val_Wu16 65535.00 DFES_OneToOne 0.00 65535.00 /end CHARACTERISTIC
/begin CHARACTERISTIC DFES_DTCM.DFC_Layer_QLTSig_C "DFES/Hersteller spezifischer Fehlercode für Prüfung DFC_Layer_QLTSig" VALUE 0x80026CA4 Val_Wu16 65535.00 DFES_OneToOne 0.00 65535.00 /end CHARACTERISTIC
/begin CHARACTERISTIC DFES_DTCM.DFC_Layer_TOENSMax_C "DFES/Hersteller spezifischer Fehlercode für Prüfung DFC_Layer_TOENSMax" VALUE 0x80026CA6 Val_Wu16 65535.00 DFES_OneToOne 0.00 65535.00 /end CHARACTERISTIC
/begin CHARACTERISTIC DFES_DTCM.DFC_Layer_TOENSMin_C "DFES/Hersteller spezifischer Fehlercode für Prüfung DFC_Layer_TOENSMin" VALUE 0x80026CA8 Val_Wu16 65535.00 DFES_OneToOne 0.00 65535.00 /end CHARACTERISTIC
/begin CHARACTERISTIC DFES_DTCM.DFC_Layer_TOENSNpl_C "DFES/Hersteller spezifischer Fehlercode für Prüfung DFC_Layer_TOENSNpl" VALUE 0x80026CAA Val_Wu16 65535.00 DFES_OneToOne 0.00 65535.00 /end CHARACTERISTIC
/begin CHARACTERISTIC DFES_DTCM.DFC_Layer_TOENSSig_C "DFES/Hersteller spezifischer Fehlercode für Prüfung DFC_Layer_TOENSSig" VALUE 0x80026CAC Val_Wu16 65535.00 DFES_OneToOne 0.00 65535.00 /end CHARACTERISTIC
/begin CHARACTERISTIC DFES_DTCM.DFC_MonLimCurr_C "DFES/Hersteller spezifischer Fehlercode für Prüfung DFC_MonLimCurr" VALUE 0x80026CAE Val_Wu16 65535.00 DFES_OneToOne 0.00 65535.00 /end CHARACTERISTIC
/begin CHARACTERISTIC DFES_DTCM.DFC_MonLimLead_C "DFES/Hersteller spezifischer Fehlercode für Prüfung DFC_MonLimLead" VALUE 0x80026CB0 Val_Wu16 65535.00 DFES_OneToOne 0.00 65535.00 /end CHARACTERISTIC
/begin CHARACTERISTIC DFES_DTCM.DFC_MonLimSet_C "DFES/Hersteller spezifischer Fehlercode für Prüfung DFC_MonLimSet" VALUE 0x80026CB2 Val_Wu16 65535.00 DFES_OneToOne 0.00 65535.00 /end CHARACTERISTIC
/begin CHARACTERISTIC DFES_DTCM.DFC_NSCDsNOxOfsMax_C "DFES/Hersteller spezifischer Fehlercode für Prüfung DFC_NSCDsNOxOfsMax" VALUE 0x80026CB4 Val_Wu16 65535.00 DFES_OneToOne 0.00 65535.00 /end CHARACTERISTIC
/begin CHARACTERISTIC DFES_DTCM.DFC_NSCDsNOxOfsMin_C "DFES/Hersteller spezifischer Fehlercode für Prüfung DFC_NSCDsNOxOfsMin" VALUE 0x80026CB6 Val_Wu16 65535.00 DFES_OneToOne 0.00 65535.00 /end CHARACTERISTIC
/begin CHARACTERISTIC DFES_DTCM.DFC_NSCDsNOxPlausMin_C "DFES/Hersteller spezifischer Fehlercode für Prüfung DFC_NSCDsNOxPlausMin" VALUE 0x80026CB8 Val_Wu16 65535.00 DFES_OneToOne 0.00 65535.00 /end CHARACTERISTIC
/begin CHARACTERISTIC DFES_DTCM.DFC_NoCat2DsNOxOfsMax_C "DFES/Hersteller spezifischer Fehlercode für Prüfung DFC_NoCat2DsNOxOfsMax" VALUE 0x80026CBA Val_Wu16 65535.00 DFES_OneToOne 0.00 65535.00 /end CHARACTERISTIC
/begin CHARACTERISTIC DFES_DTCM.DFC_NoCat2DsNOxOfsMin_C "DFES/Hersteller spezifischer Fehlercode für Prüfung DFC_NoCat2DsNOxOfsMin" VALUE 0x80026CBC Val_Wu16 65535.00 DFES_OneToOne 0.00 65535.00 /end CHARACTERISTIC
/begin CHARACTERISTIC DFES_DTCM.DFC_NoCat2DsNOxPlausMin_C "DFES/Hersteller spezifischer Fehlercode für Prüfung DFC_NoCat2DsNOxPlausMin" VALUE 0x80026CBE Val_Wu16 65535.00 DFES_OneToOne 0.00 65535.00 /end CHARACTERISTIC
/begin CHARACTERISTIC DFES_DTCM.DFC_PCVNoStrt_C "DFES/Hersteller spezifischer Fehlercode für Prüfung DFC_PCVNoStrt" VALUE 0x80026CC0 Val_Wu16 65535.00 DFES_OneToOne 0.00 65535.00 /end CHARACTERISTIC
/begin CHARACTERISTIC DFES_DTCM.DFC_RailPGradMon_C "DFES/Hersteller spezifischer Fehlercode für Prüfung DFC_RailPGradMon" VALUE 0x80026CC2 Val_Wu16 65535.00 DFES_OneToOne 0.00 65535.00 /end CHARACTERISTIC
/begin CHARACTERISTIC DFES_DTCM.DFC_SCRPODPresBuildUp_C "DFES/Hersteller spezifischer Fehlercode für Prüfung DFC_SCRPODPresBuildUp" VALUE 0x80026CC4 Val_Wu16 65535.00 DFES_OneToOne 0.00 65535.00 /end CHARACTERISTIC
/begin CHARACTERISTIC DFES_DTCM.DFC_AFSDrftIdlAdjVal_C "DFES/Hersteller spezifischer Fehlercode für Prüfung DFC_AFSDrftIdlAdjVal" VALUE 0x80026CC6 Val_Wu16 65535.00 DFES_OneToOne 0.00 65535.00 /end CHARACTERISTIC
/begin CHARACTERISTIC DFES_DTCM.DFC_AFSDrftLdAdjVal_C "DFES/Hersteller spezifischer Fehlercode für Prüfung DFC_AFSDrftLdAdjVal" VALUE 0x80026CC8 Val_Wu16 65535.00 DFES_OneToOne 0.00 65535.00 /end CHARACTERISTIC
/begin CHARACTERISTIC DFES_DTCM.DFC_AdcIADC0Cal_C "DFES/Hersteller spezifischer Fehlercode für Prüfung DFC_AdcIADC0Cal" VALUE 0x80026CCA Val_Wu16 65535.00 DFES_OneToOne 0.00 65535.00 /end CHARACTERISTIC
/begin CHARACTERISTIC DFES_DTCM.DFC_AdcIADC0Conv_C "DFES/Hersteller spezifischer Fehlercode für Prüfung DFC_AdcIADC0Conv" VALUE 0x80026CCC Val_Wu16 65535.00 DFES_OneToOne 0.00 65535.00 /end CHARACTERISTIC
/begin CHARACTERISTIC DFES_DTCM.DFC_AdcIADC1Cal_C "DFES/Hersteller spezifischer Fehlercode für Prüfung DFC_AdcIADC1Cal" VALUE 0x80026CCE Val_Wu16 65535.00 DFES_OneToOne 0.00 65535.00 /end CHARACTERISTIC
/begin CHARACTERISTIC DFES_DTCM.DFC_AdcIADC1Conv_C "DFES/Hersteller spezifischer Fehlercode für Prüfung DFC_AdcIADC1Conv" VALUE 0x80026CD0 Val_Wu16 65535.00 DFES_OneToOne 0.00 65535.00 /end CHARACTERISTIC
/begin CHARACTERISTIC DFES_DTCM.DFC_CmbChbMisfireMax_0_C "DFES/Hersteller spezifischer Fehlercode für Prüfung DFC_CmbChbMisfireMax_0" VALUE 0x80026CD2 Val_Wu16 65535.00 DFES_OneToOne 0.00 65535.00 /end CHARACTERISTIC
/begin CHARACTERISTIC DFES_DTCM.DFC_CmbChbMisfireMax_1_C "DFES/Hersteller spezifischer Fehlercode für Prüfung DFC_CmbChbMisfireMax_1" VALUE 0x80026CD4 Val_Wu16 65535.00 DFES_OneToOne 0.00 65535.00 /end CHARACTERISTIC
/begin CHARACTERISTIC DFES_DTCM.DFC_CmbChbMisfireMax_2_C "DFES/Hersteller spezifischer Fehlercode für Prüfung DFC_CmbChbMisfireMax_2" VALUE 0x80026CD6 Val_Wu16 65535.00 DFES_OneToOne 0.00 65535.00 /end CHARACTERISTIC
/begin CHARACTERISTIC DFES_DTCM.DFC_CmbChbMisfireMax_3_C "DFES/Hersteller spezifischer Fehlercode für Prüfung DFC_CmbChbMisfireMax_3" VALUE 0x80026CD8 Val_Wu16 65535.00 DFES_OneToOne 0.00 65535.00 /end CHARACTERISTIC
/begin CHARACTERISTIC DFES_DTCM.DFC_CmbChbMisfireMax_4_C "DFES/Hersteller spezifischer Fehlercode für Prüfung DFC_CmbChbMisfireMax_4" VALUE 0x80026CDA Val_Wu16 65535.00 DFES_OneToOne 0.00 65535.00 /end CHARACTERISTIC
/begin CHARACTERISTIC DFES_DTCM.DFC_CmbChbMisfireMax_5_C "DFES/Hersteller spezifischer Fehlercode für Prüfung DFC_CmbChbMisfireMax_5" VALUE 0x80026CDC Val_Wu16 65535.00 DFES_OneToOne 0.00 65535.00 /end CHARACTERISTIC
/begin CHARACTERISTIC DFES_DTCM.DFC_CmbChbMisfireMul_C "DFES/Hersteller spezifischer Fehlercode für Prüfung DFC_CmbChbMisfireMul" VALUE 0x80026CDE Val_Wu16 65535.00 DFES_OneToOne 0.00 65535.00 /end CHARACTERISTIC
/begin CHARACTERISTIC DFES_DTCM.DFC_EGRVlvLPOfsNeutr_C "DFES/" VALUE 0x80026CE0 Val_Wu16 65535.00 DFES_OneToOne 0.00 65535.00 /end CHARACTERISTIC
/begin CHARACTERISTIC DFES_DTCM.DFC_EGRVlvOfsNeutr_C "DFES/Hersteller spezifischer Fehlercode für Prüfung DFC_EGRVlvOfsNeutr" VALUE 0x80026CE2 Val_Wu16 65535.00 DFES_OneToOne 0.00 65535.00 /end CHARACTERISTIC
/begin CHARACTERISTIC DFES_DTCM.DFC_FMAErrModMax_C "DFES/Hersteller spezifischer Fehlercode für Prüfung DFC_FMAErrModMax" VALUE 0x80026CE4 Val_Wu16 65535.00 DFES_OneToOne 0.00 65535.00 /end CHARACTERISTIC
/begin CHARACTERISTIC DFES_DTCM.DFC_FMAErrModMin_C "DFES/Hersteller spezifischer Fehlercode für Prüfung DFC_FMAErrModMin" VALUE 0x80026CE6 Val_Wu16 65535.00 DFES_OneToOne 0.00 65535.00 /end CHARACTERISTIC
/begin CHARACTERISTIC DFES_DTCM.DFC_FlSysTnkLo_C "DFES/Hersteller spezifischer Fehlercode für Prüfung DFC_FlSysTnkLo" VALUE 0x80026CE8 Val_Wu16 65535.00 DFES_OneToOne 0.00 65535.00 /end CHARACTERISTIC
/begin CHARACTERISTIC DFES_DTCM.DFC_GbxNPosPlaus_C "DFES/Hersteller spezifischer Fehlercode für Prüfung DFC_GbxNPosPlaus" VALUE 0x80026CEA Val_Wu16 65535.00 DFES_OneToOne 0.00 65535.00 /end CHARACTERISTIC
/begin CHARACTERISTIC DFES_DTCM.DFC_I14229_ROETst_Appl_C "DFES/" VALUE 0x80026CEC Val_Wu16 65535.00 DFES_OneToOne 0.00 65535.00 /end CHARACTERISTIC
/begin CHARACTERISTIC DFES_DTCM.DFC_I14229_ROETst_Netw_C "DFES/" VALUE 0x80026CEE Val_Wu16 65535.00 DFES_OneToOne 0.00 65535.00 /end CHARACTERISTIC
/begin CHARACTERISTIC DFES_DTCM.DFC_I14229_ROE_BufFull_C "DFES/" VALUE 0x80026CF0 Val_Wu16 65535.00 DFES_OneToOne 0.00 65535.00 /end CHARACTERISTIC
/begin CHARACTERISTIC DFES_DTCM.DFC_IVAdjDiaIVAdj_C "DFES/Hersteller spezifischer Fehlercode für Prüfung DFC_IVAdjDiaIVAdj" VALUE 0x80026CF2 Val_Wu16 65535.00 DFES_OneToOne 0.00 65535.00 /end CHARACTERISTIC
/begin CHARACTERISTIC DFES_DTCM.DFC_IVAdjIVA_0_C "DFES/Hersteller spezifischer Fehlercode für Prüfung DFC_IVAdjIVA_0" VALUE 0x80026CF4 Val_Wu16 65535.00 DFES_OneToOne 0.00 65535.00 /end CHARACTERISTIC
/begin CHARACTERISTIC DFES_DTCM.DFC_IVAdjIVA_1_C "DFES/Hersteller spezifischer Fehlercode für Prüfung DFC_IVAdjIVA_1" VALUE 0x80026CF6 Val_Wu16 65535.00 DFES_OneToOne 0.00 65535.00 /end CHARACTERISTIC
/begin CHARACTERISTIC DFES_DTCM.DFC_IVAdjIVA_2_C "DFES/Hersteller spezifischer Fehlercode für Prüfung DFC_IVAdjIVA_2" VALUE 0x80026CF8 Val_Wu16 65535.00 DFES_OneToOne 0.00 65535.00 /end CHARACTERISTIC
/begin CHARACTERISTIC DFES_DTCM.DFC_IVAdjIVA_3_C "DFES/Hersteller spezifischer Fehlercode für Prüfung DFC_IVAdjIVA_3" VALUE 0x80026CFA Val_Wu16 65535.00 DFES_OneToOne 0.00 65535.00 /end CHARACTERISTIC
/begin CHARACTERISTIC DFES_DTCM.DFC_IVAdjIVA_4_C "DFES/Hersteller spezifischer Fehlercode für Prüfung DFC_IVAdjIVA_4" VALUE 0x80026CFC Val_Wu16 65535.00 DFES_OneToOne 0.00 65535.00 /end CHARACTERISTIC
/begin CHARACTERISTIC DFES_DTCM.DFC_IVAdjIVA_5_C "DFES/Hersteller spezifischer Fehlercode für Prüfung DFC_IVAdjIVA_5" VALUE 0x80026CFE Val_Wu16 65535.00 DFES_OneToOne 0.00 65535.00 /end CHARACTERISTIC
/begin CHARACTERISTIC DFES_DTCM.DFC_IVPSplyDCDCOff_0_C "DFES/Hersteller spezifischer Fehlercode für Prüfung DFC_IVPSplyDCDCOff_0" VALUE 0x80026D00 Val_Wu16 65535.00 DFES_OneToOne 0.00 65535.00 /end CHARACTERISTIC
/begin CHARACTERISTIC DFES_DTCM.DFC_IVPSplyDCDCOff_1_C "DFES/Hersteller spezifischer Fehlercode für Prüfung DFC_IVPSplyDCDCOff_1" VALUE 0x80026D02 Val_Wu16 65535.00 DFES_OneToOne 0.00 65535.00 /end CHARACTERISTIC
/begin CHARACTERISTIC DFES_DTCM.DFC_IVPSplyDCDCOff_2_C "DFES/Hersteller spezifischer Fehlercode für Prüfung DFC_IVPSplyDCDCOff_2" VALUE 0x80026D04 Val_Wu16 65535.00 DFES_OneToOne 0.00 65535.00 /end CHARACTERISTIC
/begin CHARACTERISTIC DFES_DTCM.DFC_IVPSplyDCDCOff_3_C "DFES/Hersteller spezifischer Fehlercode für Prüfung DFC_IVPSplyDCDCOff_3" VALUE 0x80026D06 Val_Wu16 65535.00 DFES_OneToOne 0.00 65535.00 /end CHARACTERISTIC
/begin CHARACTERISTIC DFES_DTCM.DFC_InjCtlAdjQntEEPCS_C "DFES/Hersteller spezifischer Fehlercode für Prüfung DFC_InjCtlAdjQntEEPCS" VALUE 0x80026D08 Val_Wu16 65535.00 DFES_OneToOne 0.00 65535.00 /end CHARACTERISTIC
/begin CHARACTERISTIC DFES_DTCM.DFC_LSUSPISig_C "DFES/Hersteller spezifischer Fehlercode für Prüfung DFC_LSUSPISig" VALUE 0x80026D0A Val_Wu16 65535.00 DFES_OneToOne 0.00 65535.00 /end CHARACTERISTIC
/begin CHARACTERISTIC DFES_DTCM.DFC_Layer_Dummy_C "DFES/Hersteller spezifischer Fehlercode für Prüfung DFC_Layer_Dummy" VALUE 0x80026D0C Val_Wu16 65535.00 DFES_OneToOne 0.00 65535.00 /end CHARACTERISTIC
/begin CHARACTERISTIC DFES_DTCM.DFC_NplEnvPSensPPFltDiff_C "DFES/Hersteller spezifischer Fehlercode für Prüfung DFC_NplEnvPSensPPFltDiff" VALUE 0x80026D0E Val_Wu16 65535.00 DFES_OneToOne 0.00 65535.00 /end CHARACTERISTIC
/begin CHARACTERISTIC DFES_DTCM.DFC_NplPresSensPPFltDiff_C "DFES/Hersteller spezifischer Fehlercode für Prüfung DFC_NplPresSensPPFltDiff" VALUE 0x80026D10 Val_Wu16 65535.00 DFES_OneToOne 0.00 65535.00 /end CHARACTERISTIC
/begin CHARACTERISTIC DFES_DTCM.DFC_OilLvlPlaus_C "DFES/Hersteller spezifischer Fehlercode für Prüfung DFC_OilLvlPlaus" VALUE 0x80026D12 Val_Wu16 65535.00 DFES_OneToOne 0.00 65535.00 /end CHARACTERISTIC
/begin CHARACTERISTIC DFES_DTCM.DFC_OilTOutLvl_C "DFES/Hersteller spezifischer Fehlercode für Prüfung DFC_OilTOutLvl" VALUE 0x80026D14 Val_Wu16 65535.00 DFES_OneToOne 0.00 65535.00 /end CHARACTERISTIC
/begin CHARACTERISTIC DFES_DTCM.DFC_PCVfacAdaptMax_C "DFES/Hersteller spezifischer Fehlercode für Prüfung DFC_PCVfacAdaptMax" VALUE 0x80026D16 Val_Wu16 65535.00 DFES_OneToOne 0.00 65535.00 /end CHARACTERISTIC
/begin CHARACTERISTIC DFES_DTCM.DFC_PCVfacAdaptMin_C "DFES/Hersteller spezifischer Fehlercode für Prüfung DFC_PCVfacAdaptMin" VALUE 0x80026D18 Val_Wu16 65535.00 DFES_OneToOne 0.00 65535.00 /end CHARACTERISTIC
/begin CHARACTERISTIC DFES_DTCM.DFC_SensFrzPPFltUs_C "DFES/Hersteller spezifischer Fehlercode für Prüfung DFC_SensFrzPPFltUs" VALUE 0x80026D1A Val_Wu16 65535.00 DFES_OneToOne 0.00 65535.00 /end CHARACTERISTIC
/begin CHARACTERISTIC DFES_DTCM.DFC_SensMonUTnkLvl_C "DFES/Hersteller spezifischer Fehlercode für Prüfung DFC_SensMonUTnkLvl" VALUE 0x80026D1C Val_Wu16 65535.00 DFES_OneToOne 0.00 65535.00 /end CHARACTERISTIC
/begin CHARACTERISTIC DFES_DTCM.DFC_T15Sig_C "DFES/Hersteller spezifischer Fehlercode für Prüfung DFC_T15Sig" VALUE 0x80026D1E Val_Wu16 65535.00 DFES_OneToOne 0.00 65535.00 /end CHARACTERISTIC
/begin CHARACTERISTIC DFES_DTCM.DFC_AirCtlRmpTOut_C "DFES/Hersteller spezifischer Fehlercode für Prüfung DFC_AirCtlRmpTOut" VALUE 0x80026D20 Val_Wu16 65535.00 DFES_OneToOne 0.00 65535.00 /end CHARACTERISTIC
/begin CHARACTERISTIC DFES_DTCM.DFC_BrkPPlaus_C "DFES/Hersteller spezifischer Fehlercode für Prüfung DFC_BrkPPlaus" VALUE 0x80026D22 Val_Wu16 65535.00 DFES_OneToOne 0.00 65535.00 /end CHARACTERISTIC
/begin CHARACTERISTIC DFES_DTCM.DFC_CEngDsTDynTst_C "DFES/Hersteller spezifischer Fehlercode für Prüfung DFC_CEngDsTDynTst" VALUE 0x80026D24 Val_Wu16 65535.00 DFES_OneToOne 0.00 65535.00 /end CHARACTERISTIC
/begin CHARACTERISTIC DFES_DTCM.DFC_EEPEraseErr_C "DFES/Hersteller spezifischer Fehlercode für Prüfung DFC_EEPEraseErr" VALUE 0x80026D26 Val_Wu16 65535.00 DFES_OneToOne 0.00 65535.00 /end CHARACTERISTIC
/begin CHARACTERISTIC DFES_DTCM.DFC_EEPRdErr_C "DFES/Hersteller spezifischer Fehlercode für Prüfung DFC_EEPRdErr" VALUE 0x80026D28 Val_Wu16 65535.00 DFES_OneToOne 0.00 65535.00 /end CHARACTERISTIC
/begin CHARACTERISTIC DFES_DTCM.DFC_EEPWrErr_C "DFES/Hersteller spezifischer Fehlercode für Prüfung DFC_EEPWrErr" VALUE 0x80026D2A Val_Wu16 65535.00 DFES_OneToOne 0.00 65535.00 /end CHARACTERISTIC
/begin CHARACTERISTIC DFES_DTCM.DFC_EGRVlvJamVlvClsd_C "DFES/Hersteller spezifischer Fehlercode für Prüfung DFC_EGRVlvJamVlvClsd" VALUE 0x80026D2C Val_Wu16 65535.00 DFES_OneToOne 0.00 65535.00 /end CHARACTERISTIC
/begin CHARACTERISTIC DFES_DTCM.DFC_EGRVlvJamVlvOpn_C "DFES/Hersteller spezifischer Fehlercode für Prüfung DFC_EGRVlvJamVlvOpn" VALUE 0x80026D2E Val_Wu16 65535.00 DFES_OneToOne 0.00 65535.00 /end CHARACTERISTIC
/begin CHARACTERISTIC DFES_DTCM.DFC_EGRVlvLPJamVlvClsd_C "DFES/Hersteller spezifischer Fehlercode für Prüfung DFC_EGRVlvLPJamVlvClsd" VALUE 0x80026D30 Val_Wu16 65535.00 DFES_OneToOne 0.00 65535.00 /end CHARACTERISTIC
/begin CHARACTERISTIC DFES_DTCM.DFC_EGRVlvLPJamVlvOpn_C "DFES/Hersteller spezifischer Fehlercode für Prüfung DFC_EGRVlvLPJamVlvOpn" VALUE 0x80026D32 Val_Wu16 65535.00 DFES_OneToOne 0.00 65535.00 /end CHARACTERISTIC
/begin CHARACTERISTIC DFES_DTCM.DFC_EGRVlvLPLgTDrft_C "DFES/Hersteller spezifischer Fehlercode für Prüfung DFC_EGRVlvLPLgTDrft" VALUE 0x80026D34 Val_Wu16 65535.00 DFES_OneToOne 0.00 65535.00 /end CHARACTERISTIC
/begin CHARACTERISTIC DFES_DTCM.DFC_EGRVlvLPOfsLrnJamVlv_C "DFES/Hersteller spezifischer Fehlercode für Prüfung DFC_EGRVlvLPOfsLrnJamVlv" VALUE 0x80026D36 Val_Wu16 65535.00 DFES_OneToOne 0.00 65535.00 /end CHARACTERISTIC
/begin CHARACTERISTIC DFES_DTCM.DFC_EGRVlvLPShTDrft_C "DFES/Hersteller spezifischer Fehlercode für Prüfung DFC_EGRVlvLPShTDrft" VALUE 0x80026D38 Val_Wu16 65535.00 DFES_OneToOne 0.00 65535.00 /end CHARACTERISTIC
/begin CHARACTERISTIC DFES_DTCM.DFC_EGRVlvLgTDrft_C "DFES/Hersteller spezifischer Fehlercode für Prüfung DFC_EGRVlvLgTDrft" VALUE 0x80026D3A Val_Wu16 65535.00 DFES_OneToOne 0.00 65535.00 /end CHARACTERISTIC
/begin CHARACTERISTIC DFES_DTCM.DFC_EGRVlvOfsLrnJamVlv_C "DFES/Hersteller spezifischer Fehlercode für Prüfung DFC_EGRVlvOfsLrnJamVlv" VALUE 0x80026D3C Val_Wu16 65535.00 DFES_OneToOne 0.00 65535.00 /end CHARACTERISTIC
/begin CHARACTERISTIC DFES_DTCM.DFC_EGRVlvShTDrft_C "DFES/Hersteller spezifischer Fehlercode für Prüfung DFC_EGRVlvShTDrft" VALUE 0x80026D3E Val_Wu16 65535.00 DFES_OneToOne 0.00 65535.00 /end CHARACTERISTIC
/begin CHARACTERISTIC DFES_DTCM.DFC_EngICO_C "DFES/Hersteller spezifischer Fehlercode für Prüfung DFC_EngICO" VALUE 0x80026D40 Val_Wu16 65535.00 DFES_OneToOne 0.00 65535.00 /end CHARACTERISTIC
/begin CHARACTERISTIC DFES_DTCM.DFC_EpmCaSI1ErrSig_C "DFES/Hersteller spezifischer Fehlercode für Prüfung DFC_EpmCaSI1ErrSig" VALUE 0x80026D42 Val_Wu16 65535.00 DFES_OneToOne 0.00 65535.00 /end CHARACTERISTIC
/begin CHARACTERISTIC DFES_DTCM.DFC_EpmCaSI1NoSig_C "DFES/Hersteller spezifischer Fehlercode für Prüfung DFC_EpmCaSI1NoSig" VALUE 0x80026D44 Val_Wu16 65535.00 DFES_OneToOne 0.00 65535.00 /end CHARACTERISTIC
/begin CHARACTERISTIC DFES_DTCM.DFC_EpmCaSI1OfsErr_C "DFES/Hersteller spezifischer Fehlercode für Prüfung DFC_EpmCaSI1OfsErr" VALUE 0x80026D46 Val_Wu16 65535.00 DFES_OneToOne 0.00 65535.00 /end CHARACTERISTIC
/begin CHARACTERISTIC DFES_DTCM.DFC_EpmCrSErrSig_C "DFES/Hersteller spezifischer Fehlercode für Prüfung DFC_EpmCrSErrSig" VALUE 0x80026D48 Val_Wu16 65535.00 DFES_OneToOne 0.00 65535.00 /end CHARACTERISTIC
/begin CHARACTERISTIC DFES_DTCM.DFC_EpmCrSNoSig_C "DFES/Hersteller spezifischer Fehlercode für Prüfung DFC_EpmCrSNoSig" VALUE 0x80026D4A Val_Wu16 65535.00 DFES_OneToOne 0.00 65535.00 /end CHARACTERISTIC
/begin CHARACTERISTIC DFES_DTCM.DFC_IVPlausComprTst_C "DFES/Hersteller spezifischer Fehlercode für Prüfung DFC_IVPlausComprTst" VALUE 0x80026D4C Val_Wu16 65535.00 DFES_OneToOne 0.00 65535.00 /end CHARACTERISTIC
/begin CHARACTERISTIC DFES_DTCM.DFC_IVPlausRunUpTst_C "DFES/Hersteller spezifischer Fehlercode für Prüfung DFC_IVPlausRunUpTst" VALUE 0x80026D4E Val_Wu16 65535.00 DFES_OneToOne 0.00 65535.00 /end CHARACTERISTIC
/begin CHARACTERISTIC DFES_DTCM.DFC_InjCrvShOffTst_C "DFES/Hersteller spezifischer Fehlercode für Prüfung DFC_InjCrvShOffTst" VALUE 0x80026D50 Val_Wu16 65535.00 DFES_OneToOne 0.00 65535.00 /end CHARACTERISTIC
/begin CHARACTERISTIC DFES_DTCM.DFC_LayerEnSavModProd_C "DFES/Hersteller spezifischer Fehlercode für Prüfung DFC_LayerEnSavModProd" VALUE 0x80026D52 Val_Wu16 65535.00 DFES_OneToOne 0.00 65535.00 /end CHARACTERISTIC
/begin CHARACTERISTIC DFES_DTCM.DFC_LayerEnSavModRep_C "DFES/Hersteller spezifischer Fehlercode für Prüfung DFC_LayerEnSavModRep" VALUE 0x80026D54 Val_Wu16 65535.00 DFES_OneToOne 0.00 65535.00 /end CHARACTERISTIC
/begin CHARACTERISTIC DFES_DTCM.DFC_LayerEnSavModShip_C "DFES/Hersteller spezifischer Fehlercode für Prüfung DFC_LayerEnSavModShip" VALUE 0x80026D56 Val_Wu16 65535.00 DFES_OneToOne 0.00 65535.00 /end CHARACTERISTIC
/begin CHARACTERISTIC DFES_DTCM.DFC_MRlyErlyOpng_C "DFES/Hersteller spezifischer Fehlercode für Prüfung DFC_MRlyErlyOpng" VALUE 0x80026D58 Val_Wu16 65535.00 DFES_OneToOne 0.00 65535.00 /end CHARACTERISTIC
/begin CHARACTERISTIC DFES_DTCM.DFC_MRlyStk_C "DFES/Hersteller spezifischer Fehlercode für Prüfung DFC_MRlyStk" VALUE 0x80026D5A Val_Wu16 65535.00 DFES_OneToOne 0.00 65535.00 /end CHARACTERISTIC
/begin CHARACTERISTIC DFES_DTCM.DFC_MeUnActrTst_C "DFES/Hersteller spezifischer Fehlercode für Prüfung DFC_MeUnActrTst" VALUE 0x80026D5C Val_Wu16 65535.00 DFES_OneToOne 0.00 65535.00 /end CHARACTERISTIC
/begin CHARACTERISTIC DFES_DTCM.DFC_MoCADCCmp_C "DFES/Hersteller spezifischer Fehlercode für Prüfung DFC_MoCADCCmp" VALUE 0x80026D5E Val_Wu16 65535.00 DFES_OneToOne 0.00 65535.00 /end CHARACTERISTIC
/begin CHARACTERISTIC DFES_DTCM.DFC_MoCADCTst_C "DFES/Hersteller spezifischer Fehlercode für Prüfung DFC_MoCADCTst" VALUE 0x80026D60 Val_Wu16 65535.00 DFES_OneToOne 0.00 65535.00 /end CHARACTERISTIC
/begin CHARACTERISTIC DFES_DTCM.DFC_MoCADCVltgRatio_C "DFES/Hersteller spezifischer Fehlercode für Prüfung DFC_MoCADCVltgRatio" VALUE 0x80026D62 Val_Wu16 65535.00 DFES_OneToOne 0.00 65535.00 /end CHARACTERISTIC
/begin CHARACTERISTIC DFES_DTCM.DFC_MoCComErrCnt_C "DFES/Hersteller spezifischer Fehlercode für Prüfung DFC_MoCComErrCnt" VALUE 0x80026D64 Val_Wu16 65535.00 DFES_OneToOne 0.00 65535.00 /end CHARACTERISTIC
/begin CHARACTERISTIC DFES_DTCM.DFC_MoCComSPI_C "DFES/Hersteller spezifischer Fehlercode für Prüfung DFC_MoCComSPI" VALUE 0x80026D66 Val_Wu16 65535.00 DFES_OneToOne 0.00 65535.00 /end CHARACTERISTIC
/begin CHARACTERISTIC DFES_DTCM.DFC_MoCROMErrXPg_C "DFES/Hersteller spezifischer Fehlercode für Prüfung DFC_MoCROMErrXPg" VALUE 0x80026D68 Val_Wu16 65535.00 DFES_OneToOne 0.00 65535.00 /end CHARACTERISTIC
/begin CHARACTERISTIC DFES_DTCM.DFC_MoCSOPHwNoRdy_C "DFES/Hersteller spezifischer Fehlercode für Prüfung DFC_MoCSOPHwNoRdy" VALUE 0x80026D6A Val_Wu16 65535.00 DFES_OneToOne 0.00 65535.00 /end CHARACTERISTIC
/begin CHARACTERISTIC DFES_DTCM.DFC_MoCSOPLoLi_C "DFES/Hersteller spezifischer Fehlercode für Prüfung DFC_MoCSOPLoLi" VALUE 0x80026D6C Val_Wu16 65535.00 DFES_OneToOne 0.00 65535.00 /end CHARACTERISTIC
/begin CHARACTERISTIC DFES_DTCM.DFC_MoCSOPMM_C "DFES/Hersteller spezifischer Fehlercode für Prüfung DFC_MoCSOPMM" VALUE 0x80026D6E Val_Wu16 65535.00 DFES_OneToOne 0.00 65535.00 /end CHARACTERISTIC
/begin CHARACTERISTIC DFES_DTCM.DFC_MoCSOPTimeOut_C "DFES/Hersteller spezifischer Fehlercode für Prüfung DFC_MoCSOPTimeOut" VALUE 0x80026D70 Val_Wu16 65535.00 DFES_OneToOne 0.00 65535.00 /end CHARACTERISTIC
/begin CHARACTERISTIC DFES_DTCM.DFC_MoCSOPUpLi_C "DFES/Hersteller spezifischer Fehlercode für Prüfung DFC_MoCSOPUpLi" VALUE 0x80026D72 Val_Wu16 65535.00 DFES_OneToOne 0.00 65535.00 /end CHARACTERISTIC
/begin CHARACTERISTIC DFES_DTCM.DFC_MoFAPP_C "DFES/Hersteller spezifischer Fehlercode für Prüfung DFC_MoFAPP" VALUE 0x80026D74 Val_Wu16 65535.00 DFES_OneToOne 0.00 65535.00 /end CHARACTERISTIC
/begin CHARACTERISTIC DFES_DTCM.DFC_MoFESpd_C "DFES/Hersteller spezifischer Fehlercode für Prüfung DFC_MoFESpd" VALUE 0x80026D76 Val_Wu16 65535.00 DFES_OneToOne 0.00 65535.00 /end CHARACTERISTIC
/begin CHARACTERISTIC DFES_DTCM.DFC_MoFInjDatPhi_C "DFES/Hersteller spezifischer Fehlercode für Prüfung DFC_MoFInjDatPhi" VALUE 0x80026D78 Val_Wu16 65535.00 DFES_OneToOne 0.00 65535.00 /end CHARACTERISTIC
/begin CHARACTERISTIC DFES_DTCM.DFC_MoFInjDatQnt_C "DFES/Hersteller spezifischer Fehlercode für Prüfung DFC_MoFInjDatQnt" VALUE 0x80026D7A Val_Wu16 65535.00 DFES_OneToOne 0.00 65535.00 /end CHARACTERISTIC
/begin CHARACTERISTIC DFES_DTCM.DFC_MoFInjQnt_C "DFES/Hersteller spezifischer Fehlercode für Prüfung DFC_MoFInjQnt" VALUE 0x80026D7C Val_Wu16 65535.00 DFES_OneToOne 0.00 65535.00 /end CHARACTERISTIC
/begin CHARACTERISTIC DFES_DTCM.DFC_MoFMode1PoI1_C "DFES/Hersteller spezifischer Fehlercode für Prüfung DFC_MoFMode1PoI1" VALUE 0x80026D7E Val_Wu16 65535.00 DFES_OneToOne 0.00 65535.00 /end CHARACTERISTIC
/begin CHARACTERISTIC DFES_DTCM.DFC_MoFMode1PoI2_C "DFES/Hersteller spezifischer Fehlercode für Prüfung DFC_MoFMode1PoI2" VALUE 0x80026D80 Val_Wu16 65535.00 DFES_OneToOne 0.00 65535.00 /end CHARACTERISTIC
/begin CHARACTERISTIC DFES_DTCM.DFC_MoFMode2PoI1_C "DFES/Hersteller spezifischer Fehlercode für Prüfung DFC_MoFMode2PoI1" VALUE 0x80026D82 Val_Wu16 65535.00 DFES_OneToOne 0.00 65535.00 /end CHARACTERISTIC
/begin CHARACTERISTIC DFES_DTCM.DFC_MoFMode2PoI2_C "DFES/Hersteller spezifischer Fehlercode für Prüfung DFC_MoFMode2PoI2" VALUE 0x80026D84 Val_Wu16 65535.00 DFES_OneToOne 0.00 65535.00 /end CHARACTERISTIC
/begin CHARACTERISTIC DFES_DTCM.DFC_MoFOvR_C "DFES/Hersteller spezifischer Fehlercode für Prüfung DFC_MoFOvR" VALUE 0x80026D86 Val_Wu16 65535.00 DFES_OneToOne 0.00 65535.00 /end CHARACTERISTIC
/begin CHARACTERISTIC DFES_DTCM.DFC_MoFQntCor_C "DFES/Hersteller spezifischer Fehlercode für Prüfung DFC_MoFQntCor" VALUE 0x80026D88 Val_Wu16 65535.00 DFES_OneToOne 0.00 65535.00 /end CHARACTERISTIC
/begin CHARACTERISTIC DFES_DTCM.DFC_MoFRailP_C "DFES/Hersteller spezifischer Fehlercode für Prüfung DFC_MoFRailP" VALUE 0x80026D8A Val_Wu16 65535.00 DFES_OneToOne 0.00 65535.00 /end CHARACTERISTIC
/begin CHARACTERISTIC DFES_DTCM.DFC_MoFTrqCmp_C "DFES/Hersteller spezifischer Fehlercode für Prüfung DFC_MoFTrqCmp" VALUE 0x80026D8C Val_Wu16 65535.00 DFES_OneToOne 0.00 65535.00 /end CHARACTERISTIC
/begin CHARACTERISTIC DFES_DTCM.DFC_NSCDsHtrSetP_C "DFES/Hersteller spezifischer Fehlercode für Prüfung DFC_NSCDsHtrSetP" VALUE 0x80026D8E Val_Wu16 65535.00 DFES_OneToOne 0.00 65535.00 /end CHARACTERISTIC
/begin CHARACTERISTIC DFES_DTCM.DFC_NoCat2DsHtrSetP_C "DFES/Hersteller spezifischer Fehlercode für Prüfung DFC_NoCat2DsHtrSetP" VALUE 0x80026D90 Val_Wu16 65535.00 DFES_OneToOne 0.00 65535.00 /end CHARACTERISTIC
/begin CHARACTERISTIC DFES_DTCM.DFC_PCVActrTst_C "DFES/Hersteller spezifischer Fehlercode für Prüfung DFC_PCVActrTst" VALUE 0x80026D92 Val_Wu16 65535.00 DFES_OneToOne 0.00 65535.00 /end CHARACTERISTIC
/begin CHARACTERISTIC DFES_DTCM.DFC_PhyModNonMonMapNpl_C "DFES/Hersteller spezifischer Fehlercode für Prüfung DFC_PhyModNonMonMapNpl" VALUE 0x80026D94 Val_Wu16 65535.00 DFES_OneToOne 0.00 65535.00 /end CHARACTERISTIC
/begin CHARACTERISTIC DFES_DTCM.DFC_RailHpTst_C "DFES/Hersteller spezifischer Fehlercode für Prüfung DFC_RailHpTst" VALUE 0x80026D96 Val_Wu16 65535.00 DFES_OneToOne 0.00 65535.00 /end CHARACTERISTIC
/begin CHARACTERISTIC DFES_DTCM.DFC_RailPOfsTstMax_C "DFES/Hersteller spezifischer Fehlercode für Prüfung DFC_RailPOfsTstMax" VALUE 0x80026D98 Val_Wu16 65535.00 DFES_OneToOne 0.00 65535.00 /end CHARACTERISTIC
/begin CHARACTERISTIC DFES_DTCM.DFC_RailPOfsTstMin_C "DFES/Hersteller spezifischer Fehlercode für Prüfung DFC_RailPOfsTstMin" VALUE 0x80026D9A Val_Wu16 65535.00 DFES_OneToOne 0.00 65535.00 /end CHARACTERISTIC
/begin CHARACTERISTIC DFES_DTCM.DFC_SIA_E1max_C "DFES/Hersteller spezifischer Fehlercode für Prüfung DFC_SIA_E1max" VALUE 0x80026D9C Val_Wu16 65535.00 DFES_OneToOne 0.00 65535.00 /end CHARACTERISTIC
/begin CHARACTERISTIC DFES_DTCM.DFC_SIA_E1min_C "DFES/Hersteller spezifischer Fehlercode für Prüfung DFC_SIA_E1min" VALUE 0x80026D9E Val_Wu16 65535.00 DFES_OneToOne 0.00 65535.00 /end CHARACTERISTIC
/begin CHARACTERISTIC DFES_DTCM.DFC_SIA_E1npl_C "DFES/Hersteller spezifischer Fehlercode für Prüfung DFC_SIA_E1npl" VALUE 0x80026DA0 Val_Wu16 65535.00 DFES_OneToOne 0.00 65535.00 /end CHARACTERISTIC
/begin CHARACTERISTIC DFES_DTCM.DFC_SIA_E1sig_C "DFES/Hersteller spezifischer Fehlercode für Prüfung DFC_SIA_E1sig" VALUE 0x80026DA2 Val_Wu16 65535.00 DFES_OneToOne 0.00 65535.00 /end CHARACTERISTIC
/begin CHARACTERISTIC DFES_DTCM.DFC_SIA_E2max_C "DFES/Hersteller spezifischer Fehlercode für Prüfung DFC_SIA_E2max" VALUE 0x80026DA4 Val_Wu16 65535.00 DFES_OneToOne 0.00 65535.00 /end CHARACTERISTIC
/begin CHARACTERISTIC DFES_DTCM.DFC_SIA_E2min_C "DFES/Hersteller spezifischer Fehlercode für Prüfung DFC_SIA_E2min" VALUE 0x80026DA6 Val_Wu16 65535.00 DFES_OneToOne 0.00 65535.00 /end CHARACTERISTIC
/begin CHARACTERISTIC DFES_DTCM.DFC_SIA_E2npl_C "DFES/Hersteller spezifischer Fehlercode für Prüfung DFC_SIA_E2npl" VALUE 0x80026DA8 Val_Wu16 65535.00 DFES_OneToOne 0.00 65535.00 /end CHARACTERISTIC
/begin CHARACTERISTIC DFES_DTCM.DFC_SIA_E2sig_C "DFES/Hersteller spezifischer Fehlercode für Prüfung DFC_SIA_E2sig" VALUE 0x80026DAA Val_Wu16 65535.00 DFES_OneToOne 0.00 65535.00 /end CHARACTERISTIC
/begin CHARACTERISTIC DFES_DTCM.DFC_SIA_E3max_C "DFES/Hersteller spezifischer Fehlercode für Prüfung DFC_SIA_E3max" VALUE 0x80026DAC Val_Wu16 65535.00 DFES_OneToOne 0.00 65535.00 /end CHARACTERISTIC
/begin CHARACTERISTIC DFES_DTCM.DFC_SIA_E3min_C "DFES/Hersteller spezifischer Fehlercode für Prüfung DFC_SIA_E3min" VALUE 0x80026DAE Val_Wu16 65535.00 DFES_OneToOne 0.00 65535.00 /end CHARACTERISTIC
/begin CHARACTERISTIC DFES_DTCM.DFC_SIA_E3npl_C "DFES/Hersteller spezifischer Fehlercode für Prüfung DFC_SIA_E3npl" VALUE 0x80026DB0 Val_Wu16 65535.00 DFES_OneToOne 0.00 65535.00 /end CHARACTERISTIC
/begin CHARACTERISTIC DFES_DTCM.DFC_SIA_E3sig_C "DFES/Hersteller spezifischer Fehlercode für Prüfung DFC_SIA_E3sig" VALUE 0x80026DB2 Val_Wu16 65535.00 DFES_OneToOne 0.00 65535.00 /end CHARACTERISTIC
/begin CHARACTERISTIC DFES_DTCM.DFC_SIA_E4max_C "DFES/Hersteller spezifischer Fehlercode für Prüfung DFC_SIA_E4max" VALUE 0x80026DB4 Val_Wu16 65535.00 DFES_OneToOne 0.00 65535.00 /end CHARACTERISTIC
/begin CHARACTERISTIC DFES_DTCM.DFC_SIA_E4min_C "DFES/Hersteller spezifischer Fehlercode für Prüfung DFC_SIA_E4min" VALUE 0x80026DB6 Val_Wu16 65535.00 DFES_OneToOne 0.00 65535.00 /end CHARACTERISTIC
/begin CHARACTERISTIC DFES_DTCM.DFC_SIA_E4npl_C "DFES/Hersteller spezifischer Fehlercode für Prüfung DFC_SIA_E4npl" VALUE 0x80026DB8 Val_Wu16 65535.00 DFES_OneToOne 0.00 65535.00 /end CHARACTERISTIC
/begin CHARACTERISTIC DFES_DTCM.DFC_SIA_E4sig_C "DFES/Hersteller spezifischer Fehlercode für Prüfung DFC_SIA_E4sig" VALUE 0x80026DBA Val_Wu16 65535.00 DFES_OneToOne 0.00 65535.00 /end CHARACTERISTIC
/begin CHARACTERISTIC DFES_DTCM.DFC_SWReset_0_C "DFES/Hersteller spezifischer Fehlercode für Prüfung DFC_SWReset_0" VALUE 0x80026DBC Val_Wu16 65535.00 DFES_OneToOne 0.00 65535.00 /end CHARACTERISTIC
/begin CHARACTERISTIC DFES_DTCM.DFC_SWReset_1_C "DFES/Hersteller spezifischer Fehlercode für Prüfung DFC_SWReset_1" VALUE 0x80026DBE Val_Wu16 65535.00 DFES_OneToOne 0.00 65535.00 /end CHARACTERISTIC
/begin CHARACTERISTIC DFES_DTCM.DFC_SWReset_2_C "DFES/Hersteller spezifischer Fehlercode für Prüfung DFC_SWReset_2" VALUE 0x80026DC0 Val_Wu16 65535.00 DFES_OneToOne 0.00 65535.00 /end CHARACTERISTIC
/begin CHARACTERISTIC DFES_DTCM.DFC_ShtrAKKMax_C "DFES/Hersteller spezifischer Fehlercode für Prüfung DFC_ShtrAKKMax" VALUE 0x80026DC2 Val_Wu16 65535.00 DFES_OneToOne 0.00 65535.00 /end CHARACTERISTIC
/begin CHARACTERISTIC DFES_DTCM.DFC_ShtrAKKMin_C "DFES/Hersteller spezifischer Fehlercode für Prüfung DFC_ShtrAKKMin" VALUE 0x80026DC4 Val_Wu16 65535.00 DFES_OneToOne 0.00 65535.00 /end CHARACTERISTIC
/begin CHARACTERISTIC DFES_DTCM.DFC_ShtrAKKNpl_C "DFES/Hersteller spezifischer Fehlercode für Prüfung DFC_ShtrAKKNpl" VALUE 0x80026DC6 Val_Wu16 65535.00 DFES_OneToOne 0.00 65535.00 /end CHARACTERISTIC
/begin CHARACTERISTIC DFES_DTCM.DFC_ShtrPKKMax_C "DFES/Hersteller spezifischer Fehlercode für Prüfung DFC_ShtrPKKMax" VALUE 0x80026DC8 Val_Wu16 65535.00 DFES_OneToOne 0.00 65535.00 /end CHARACTERISTIC
/begin CHARACTERISTIC DFES_DTCM.DFC_StopCntTmr_C "DFES/Hersteller spezifischer Fehlercode für Prüfung DFC_StopCntTmr" VALUE 0x80026DCA Val_Wu16 65535.00 DFES_OneToOne 0.00 65535.00 /end CHARACTERISTIC
/begin CHARACTERISTIC DFES_DTCM.DFC_ThrVlvMon_C "DFES/Hersteller spezifischer Fehlercode für Prüfung DFC_ThrVlvMon" VALUE 0x80026DCC Val_Wu16 65535.00 DFES_OneToOne 0.00 65535.00 /end CHARACTERISTIC
/begin CHARACTERISTIC DFES_DTCM.DFC_VSwVlvJamVlv_C "DFES/Hersteller spezifischer Fehlercode für Prüfung DFC_VSwVlvJamVlv" VALUE 0x80026DCE Val_Wu16 65535.00 DFES_OneToOne 0.00 65535.00 /end CHARACTERISTIC
/begin CHARACTERISTIC DFES_DTCM.DFC_VSwVlvLgTDrft_C "DFES/Hersteller spezifischer Fehlercode für Prüfung DFC_VSwVlvLgTDrft" VALUE 0x80026DD0 Val_Wu16 65535.00 DFES_OneToOne 0.00 65535.00 /end CHARACTERISTIC
/begin CHARACTERISTIC DFES_DTCM.DFC_VSwVlvOfsLrnJamVlv_C "DFES/Hersteller spezifischer Fehlercode für Prüfung DFC_VSwVlvOfsLrnJamVlv" VALUE 0x80026DD2 Val_Wu16 65535.00 DFES_OneToOne 0.00 65535.00 /end CHARACTERISTIC
/begin CHARACTERISTIC DFES_DTCM.DFC_VSwVlvOfsNeutr_C "DFES/Hersteller spezifischer Fehlercode für Prüfung DFC_VSwVlvOfsNeutr" VALUE 0x80026DD4 Val_Wu16 65535.00 DFES_OneToOne 0.00 65535.00 /end CHARACTERISTIC
/begin CHARACTERISTIC DFES_DTCM.DFC_VSwVlvShTDrft_C "DFES/Hersteller spezifischer Fehlercode für Prüfung DFC_VSwVlvShTDrft" VALUE 0x80026DD6 Val_Wu16 65535.00 DFES_OneToOne 0.00 65535.00 /end CHARACTERISTIC
/begin CHARACTERISTIC DFES_DTCM.DFC_VSwVlvSpgDef_C "DFES/Hersteller spezifischer Fehlercode für Prüfung DFC_VSwVlvSpgDef" VALUE 0x80026DD8 Val_Wu16 65535.00 DFES_OneToOne 0.00 65535.00 /end CHARACTERISTIC
/begin CHARACTERISTIC DFES_DTCO.DFC_Unused_C "DFES/intern benötigter Parameter für nicht existierende Fehlerprüfung DFC_Unused" VALUE 0x800291C4 Val_Wu16 65535.00 DFES_OneToOne 0.00 65535.00 READ_ONLY /end CHARACTERISTIC
/begin CHARACTERISTIC DFES_DTCO.DFC_ACCIPlausDrvAst_C "DFES/OBD spezifischer Fehlercode für Prüfung DFC_ACCIPlausDrvAst" VALUE 0x800291C6 Val_Wu16 65535.00 DFES_OneToOne 0.00 65535.00 /end CHARACTERISTIC
/begin CHARACTERISTIC DFES_DTCO.DFC_ACCIPlausTrqDes_C "DFES/OBD spezifischer Fehlercode für Prüfung DFC_ACCIPlausTrqDes" VALUE 0x800291C8 Val_Wu16 65535.00 DFES_OneToOne 0.00 65535.00 /end CHARACTERISTIC
/begin CHARACTERISTIC DFES_DTCO.DFC_AirCtlGovDvtEOMMax_C "DFES/OBD spezifischer Fehlercode für Prüfung DFC_AirCtlGovDvtEOMMax" VALUE 0x800291CA Val_Wu16 65535.00 DFES_OneToOne 0.00 65535.00 /end CHARACTERISTIC
/begin CHARACTERISTIC DFES_DTCO.DFC_AirCtlGovDvtEOMMin_C "DFES/OBD spezifischer Fehlercode für Prüfung DFC_AirCtlGovDvtEOMMin" VALUE 0x800291CC Val_Wu16 65535.00 DFES_OneToOne 0.00 65535.00 /end CHARACTERISTIC
/begin CHARACTERISTIC DFES_DTCO.DFC_AirCtlGovDvtMax_C "DFES/OBD spezifischer Fehlercode für Prüfung DFC_AirCtlGovDvtMax" VALUE 0x800291CE Val_Wu16 65535.00 DFES_OneToOne 0.00 65535.00 /end CHARACTERISTIC
/begin CHARACTERISTIC DFES_DTCO.DFC_AirCtlGovDvtMin_C "DFES/OBD spezifischer Fehlercode für Prüfung DFC_AirCtlGovDvtMin" VALUE 0x800291D0 Val_Wu16 65535.00 DFES_OneToOne 0.00 65535.00 /end CHARACTERISTIC
/begin CHARACTERISTIC DFES_DTCO.DFC_AirCtlGovLPDvtMax_C "DFES/OBD spezifischer Fehlercode für Prüfung DFC_AirCtlGovLPDvtMax" VALUE 0x800291D2 Val_Wu16 65535.00 DFES_OneToOne 0.00 65535.00 /end CHARACTERISTIC
/begin CHARACTERISTIC DFES_DTCO.DFC_AirCtlGovLPDvtMin_C "DFES/OBD spezifischer Fehlercode für Prüfung DFC_AirCtlGovLPDvtMin" VALUE 0x800291D4 Val_Wu16 65535.00 DFES_OneToOne 0.00 65535.00 /end CHARACTERISTIC
/begin CHARACTERISTIC DFES_DTCO.DFC_AltIOComErr_C "DFES/OBD spezifischer Fehlercode für Prüfung DFC_AltIOComErr" VALUE 0x800291D6 Val_Wu16 65535.00 DFES_OneToOne 0.00 65535.00 /end CHARACTERISTIC
/begin CHARACTERISTIC DFES_DTCO.DFC_AltIOComNpl_C "DFES/OBD spezifischer Fehlercode für Prüfung DFC_AltIOComNpl" VALUE 0x800291D8 Val_Wu16 65535.00 DFES_OneToOne 0.00 65535.00 /end CHARACTERISTIC
/begin CHARACTERISTIC DFES_DTCO.DFC_BusDiagBusOffFlexRay_C "DFES/" VALUE 0x800291DA Val_Wu16 65535.00 DFES_OneToOne 0.00 65535.00 /end CHARACTERISTIC
/begin CHARACTERISTIC DFES_DTCO.DFC_BusDiagBusOffNodeA_C "DFES/OBD spezifischer Fehlercode für Prüfung DFC_BusDiagBusOffNodeA" VALUE 0x800291DC Val_Wu16 65535.00 DFES_OneToOne 0.00 65535.00 /end CHARACTERISTIC
/begin CHARACTERISTIC DFES_DTCO.DFC_BusDiagBusOffNodeB_C "DFES/OBD spezifischer Fehlercode für Prüfung DFC_BusDiagBusOffNodeB" VALUE 0x800291DE Val_Wu16 65535.00 DFES_OneToOne 0.00 65535.00 /end CHARACTERISTIC
/begin CHARACTERISTIC DFES_DTCO.DFC_BusDiagBusOffNodeC_C "DFES/OBD spezifischer Fehlercode für Prüfung DFC_BusDiagBusOffNodeC" VALUE 0x800291E0 Val_Wu16 65535.00 DFES_OneToOne 0.00 65535.00 /end CHARACTERISTIC
/begin CHARACTERISTIC DFES_DTCO.DFC_BusDiagHwFlexRay_C "DFES/" VALUE 0x800291E2 Val_Wu16 65535.00 DFES_OneToOne 0.00 65535.00 /end CHARACTERISTIC
/begin CHARACTERISTIC DFES_DTCO.DFC_Cj945SpiCom1_C "DFES/OBD spezifischer Fehlercode für Prüfung DFC_Cj945SpiCom1" VALUE 0x800291E4 Val_Wu16 65535.00 DFES_OneToOne 0.00 65535.00 /end CHARACTERISTIC
/begin CHARACTERISTIC DFES_DTCO.DFC_ComACDemandSig_FA_C "DFES/OBD spezifischer Fehlercode für Prüfung DFC_ComACDemandSig_FA" VALUE 0x800291E6 Val_Wu16 65535.00 DFES_OneToOne 0.00 65535.00 /end CHARACTERISTIC
/begin CHARACTERISTIC DFES_DTCO.DFC_ComACDemandTo_FA_C "DFES/OBD spezifischer Fehlercode für Prüfung DFC_ComACDemandTo_FA" VALUE 0x800291E8 Val_Wu16 65535.00 DFES_OneToOne 0.00 65535.00 /end CHARACTERISTIC
/begin CHARACTERISTIC DFES_DTCO.DFC_ComATempSig_FA_C "DFES/OBD spezifischer Fehlercode für Prüfung DFC_ComATempSig_FA" VALUE 0x800291EA Val_Wu16 65535.00 DFES_OneToOne 0.00 65535.00 /end CHARACTERISTIC
/begin CHARACTERISTIC DFES_DTCO.DFC_ComATempTo_FA_C "DFES/OBD spezifischer Fehlercode für Prüfung DFC_ComATempTo_FA" VALUE 0x800291EC Val_Wu16 65535.00 DFES_OneToOne 0.00 65535.00 /end CHARACTERISTIC
/begin CHARACTERISTIC DFES_DTCO.DFC_ComATempTo_FX_C "DFES/OBD spezifischer Fehlercode für Prüfung DFC_ComATempTo_FX" VALUE 0x800291EE Val_Wu16 65535.00 DFES_OneToOne 0.00 65535.00 /end CHARACTERISTIC
/begin CHARACTERISTIC DFES_DTCO.DFC_ComBrkTrqSumChk_FX_C "DFES/OBD spezifischer Fehlercode für Prüfung DFC_ComBrkTrqSumChk_FX" VALUE 0x800291F0 Val_Wu16 65535.00 DFES_OneToOne 0.00 65535.00 /end CHARACTERISTIC
/begin CHARACTERISTIC DFES_DTCO.DFC_ComBrkTrqSumCtr_FX_C "DFES/OBD spezifischer Fehlercode für Prüfung DFC_ComBrkTrqSumCtr_FX" VALUE 0x800291F2 Val_Wu16 65535.00 DFES_OneToOne 0.00 65535.00 /end CHARACTERISTIC
/begin CHARACTERISTIC DFES_DTCO.DFC_ComBrkTrqSumTo_FX_C "DFES/OBD spezifischer Fehlercode für Prüfung DFC_ComBrkTrqSumTo_FX" VALUE 0x800291F4 Val_Wu16 65535.00 DFES_OneToOne 0.00 65535.00 /end CHARACTERISTIC
/begin CHARACTERISTIC DFES_DTCO.DFC_ComBtnDrvDynChk_FX_C "DFES/OBD spezifischer Fehlercode für Prüfung DFC_ComBtnDrvDynChk_FX" VALUE 0x800291F6 Val_Wu16 65535.00 DFES_OneToOne 0.00 65535.00 /end CHARACTERISTIC
/begin CHARACTERISTIC DFES_DTCO.DFC_ComBtnDrvDynCtr_FX_C "DFES/OBD spezifischer Fehlercode für Prüfung DFC_ComBtnDrvDynCtr_FX" VALUE 0x800291F8 Val_Wu16 65535.00 DFES_OneToOne 0.00 65535.00 /end CHARACTERISTIC
/begin CHARACTERISTIC DFES_DTCO.DFC_ComBtnDrvDynTo_FX_C "DFES/OBD spezifischer Fehlercode für Prüfung DFC_ComBtnDrvDynTo_FX" VALUE 0x800291FA Val_Wu16 65535.00 DFES_OneToOne 0.00 65535.00 /end CHARACTERISTIC
/begin CHARACTERISTIC DFES_DTCO.DFC_ComButtonMSASig_C "DFES/OBD spezifischer Fehlercode für Prüfung DFC_ComButtonMSASig" VALUE 0x800291FC Val_Wu16 65535.00 DFES_OneToOne 0.00 65535.00 /end CHARACTERISTIC
/begin CHARACTERISTIC DFES_DTCO.DFC_ComButtonMSATo_C "DFES/OBD spezifischer Fehlercode für Prüfung DFC_ComButtonMSATo" VALUE 0x800291FE Val_Wu16 65535.00 DFES_OneToOne 0.00 65535.00 /end CHARACTERISTIC
/begin CHARACTERISTIC DFES_DTCO.DFC_ComCodierungPwrmngSig_C "DFES/OBD spezifischer Fehlercode für Prüfung DFC_ComCodierungPwrmngSig" VALUE 0x80029200 Val_Wu16 65535.00 DFES_OneToOne 0.00 65535.00 /end CHARACTERISTIC
/begin CHARACTERISTIC DFES_DTCO.DFC_ComCodierungPwrmngSig_FA_C "DFES/OBD spezifischer Fehlercode für Prüfung DFC_ComCodierungPwrmngSig_FA" VALUE 0x80029202 Val_Wu16 65535.00 DFES_OneToOne 0.00 65535.00 /end CHARACTERISTIC
/begin CHARACTERISTIC DFES_DTCO.DFC_ComCrCtlLvrChk_C "DFES/OBD spezifischer Fehlercode für Prüfung DFC_ComCrCtlLvrChk" VALUE 0x80029204 Val_Wu16 65535.00 DFES_OneToOne 0.00 65535.00 /end CHARACTERISTIC
/begin CHARACTERISTIC DFES_DTCO.DFC_ComCrCtlLvrCtr_C "DFES/OBD spezifischer Fehlercode für Prüfung DFC_ComCrCtlLvrCtr" VALUE 0x80029206 Val_Wu16 65535.00 DFES_OneToOne 0.00 65535.00 /end CHARACTERISTIC
/begin CHARACTERISTIC DFES_DTCO.DFC_ComCrCtlLvrSig_C "DFES/OBD spezifischer Fehlercode für Prüfung DFC_ComCrCtlLvrSig" VALUE 0x80029208 Val_Wu16 65535.00 DFES_OneToOne 0.00 65535.00 /end CHARACTERISTIC
/begin CHARACTERISTIC DFES_DTCO.DFC_ComCrCtlLvrTo_C "DFES/OBD spezifischer Fehlercode für Prüfung DFC_ComCrCtlLvrTo" VALUE 0x8002920A Val_Wu16 65535.00 DFES_OneToOne 0.00 65535.00 /end CHARACTERISTIC
/begin CHARACTERISTIC DFES_DTCO.DFC_ComCtrCrshSwoEkpSig_FA_C "DFES/OBD spezifischer Fehlercode für Prüfung DFC_ComCtrCrshSwoEkpSig_FA" VALUE 0x8002920C Val_Wu16 65535.00 DFES_OneToOne 0.00 65535.00 /end CHARACTERISTIC
/begin CHARACTERISTIC DFES_DTCO.DFC_ComCtrCrshSwoEkpTo_FA_C "DFES/OBD spezifischer Fehlercode für Prüfung DFC_ComCtrCrshSwoEkpTo_FA" VALUE 0x8002920E Val_Wu16 65535.00 DFES_OneToOne 0.00 65535.00 /end CHARACTERISTIC
/begin CHARACTERISTIC DFES_DTCO.DFC_ComCtrSecInt_C "DFES/OBD spezifischer Fehlercode für Prüfung DFC_ComCtrSecInt" VALUE 0x80029210 Val_Wu16 65535.00 DFES_OneToOne 0.00 65535.00 /end CHARACTERISTIC
/begin CHARACTERISTIC DFES_DTCO.DFC_ComDiaOBDGbxSig_A_C "DFES/OBD spezifischer Fehlercode für Prüfung DFC_ComDiaOBDGbxSig_A" VALUE 0x80029212 Val_Wu16 65535.00 DFES_OneToOne 0.00 65535.00 /end CHARACTERISTIC
/begin CHARACTERISTIC DFES_DTCO.DFC_ComDiaOBDGbxTo_A_C "DFES/OBD spezifischer Fehlercode für Prüfung DFC_ComDiaOBDGbxTo_A" VALUE 0x80029214 Val_Wu16 65535.00 DFES_OneToOne 0.00 65535.00 /end CHARACTERISTIC
/begin CHARACTERISTIC DFES_DTCO.DFC_ComFahrzeugtypSig_C "DFES/OBD spezifischer Fehlercode für Prüfung DFC_ComFahrzeugtypSig" VALUE 0x80029216 Val_Wu16 65535.00 DFES_OneToOne 0.00 65535.00 /end CHARACTERISTIC
/begin CHARACTERISTIC DFES_DTCO.DFC_ComFahrzeugtypSig_FA_C "DFES/OBD spezifischer Fehlercode für Prüfung DFC_ComFahrzeugtypSig_FA" VALUE 0x80029218 Val_Wu16 65535.00 DFES_OneToOne 0.00 65535.00 /end CHARACTERISTIC
/begin CHARACTERISTIC DFES_DTCO.DFC_ComFllupGpwsupSig_FA_C "DFES/OBD spezifischer Fehlercode für Prüfung DFC_ComFllupGpwsupSig_FA" VALUE 0x8002921A Val_Wu16 65535.00 DFES_OneToOne 0.00 65535.00 /end CHARACTERISTIC
/begin CHARACTERISTIC DFES_DTCO.DFC_ComFllupGpwsupTo_FA_C "DFES/OBD spezifischer Fehlercode für Prüfung DFC_ComFllupGpwsupTo_FA" VALUE 0x8002921C Val_Wu16 65535.00 DFES_OneToOne 0.00 65535.00 /end CHARACTERISTIC
/begin CHARACTERISTIC DFES_DTCO.DFC_ComGbxDataChk_A_C "DFES/OBD spezifischer Fehlercode für Prüfung DFC_ComGbxDataChk_A" VALUE 0x8002921E Val_Wu16 65535.00 DFES_OneToOne 0.00 65535.00 /end CHARACTERISTIC
/begin CHARACTERISTIC DFES_DTCO.DFC_ComGbxDataChk_FA_C "DFES/OBD spezifischer Fehlercode für Prüfung DFC_ComGbxDataChk_FA" VALUE 0x80029220 Val_Wu16 65535.00 DFES_OneToOne 0.00 65535.00 /end CHARACTERISTIC
/begin CHARACTERISTIC DFES_DTCO.DFC_ComGbxDataCtr_A_C "DFES/OBD spezifischer Fehlercode für Prüfung DFC_ComGbxDataCtr_A" VALUE 0x80029222 Val_Wu16 65535.00 DFES_OneToOne 0.00 65535.00 /end CHARACTERISTIC
/begin CHARACTERISTIC DFES_DTCO.DFC_ComGbxDataCtr_FA_C "DFES/OBD spezifischer Fehlercode für Prüfung DFC_ComGbxDataCtr_FA" VALUE 0x80029224 Val_Wu16 65535.00 DFES_OneToOne 0.00 65535.00 /end CHARACTERISTIC
/begin CHARACTERISTIC DFES_DTCO.DFC_ComGbxDataSig_A_C "DFES/OBD spezifischer Fehlercode für Prüfung DFC_ComGbxDataSig_A" VALUE 0x80029226 Val_Wu16 65535.00 DFES_OneToOne 0.00 65535.00 /end CHARACTERISTIC
/begin CHARACTERISTIC DFES_DTCO.DFC_ComGbxDataSig_FA_C "DFES/OBD spezifischer Fehlercode für Prüfung DFC_ComGbxDataSig_FA" VALUE 0x80029228 Val_Wu16 65535.00 DFES_OneToOne 0.00 65535.00 /end CHARACTERISTIC
/begin CHARACTERISTIC DFES_DTCO.DFC_ComGbxDataTo_A_C "DFES/OBD spezifischer Fehlercode für Prüfung DFC_ComGbxDataTo_A" VALUE 0x8002922A Val_Wu16 65535.00 DFES_OneToOne 0.00 65535.00 /end CHARACTERISTIC
/begin CHARACTERISTIC DFES_DTCO.DFC_ComGbxDataTo_FA_C "DFES/OBD spezifischer Fehlercode für Prüfung DFC_ComGbxDataTo_FA" VALUE 0x8002922C Val_Wu16 65535.00 DFES_OneToOne 0.00 65535.00 /end CHARACTERISTIC
/begin CHARACTERISTIC DFES_DTCO.DFC_ComKlemmenChk_FA_C "DFES/OBD spezifischer Fehlercode für Prüfung DFC_ComKlemmenChk_FA" VALUE 0x8002922E Val_Wu16 65535.00 DFES_OneToOne 0.00 65535.00 /end CHARACTERISTIC
/begin CHARACTERISTIC DFES_DTCO.DFC_ComKlemmenCtr_FA_C "DFES/OBD spezifischer Fehlercode für Prüfung DFC_ComKlemmenCtr_FA" VALUE 0x80029230 Val_Wu16 65535.00 DFES_OneToOne 0.00 65535.00 /end CHARACTERISTIC
/begin CHARACTERISTIC DFES_DTCO.DFC_ComKlemmenSig_FA_C "DFES/OBD spezifischer Fehlercode für Prüfung DFC_ComKlemmenSig_FA" VALUE 0x80029232 Val_Wu16 65535.00 DFES_OneToOne 0.00 65535.00 /end CHARACTERISTIC
/begin CHARACTERISTIC DFES_DTCO.DFC_ComKlemmenTo_FA_C "DFES/OBD spezifischer Fehlercode für Prüfung DFC_ComKlemmenTo_FA" VALUE 0x80029234 Val_Wu16 65535.00 DFES_OneToOne 0.00 65535.00 /end CHARACTERISTIC
/begin CHARACTERISTIC DFES_DTCO.DFC_ComLenkradwinkelSig_C "DFES/OBD spezifischer Fehlercode für Prüfung DFC_ComLenkradwinkelSig" VALUE 0x80029236 Val_Wu16 65535.00 DFES_OneToOne 0.00 65535.00 /end CHARACTERISTIC
/begin CHARACTERISTIC DFES_DTCO.DFC_ComLenkradwinkelTo_C "DFES/OBD spezifischer Fehlercode für Prüfung DFC_ComLenkradwinkelTo" VALUE 0x80029238 Val_Wu16 65535.00 DFES_OneToOne 0.00 65535.00 /end CHARACTERISTIC
/begin CHARACTERISTIC DFES_DTCO.DFC_ComMileageRangeSig_FA_C "DFES/OBD spezifischer Fehlercode für Prüfung DFC_ComMileageRangeSig_FA" VALUE 0x8002923A Val_Wu16 65535.00 DFES_OneToOne 0.00 65535.00 /end CHARACTERISTIC
/begin CHARACTERISTIC DFES_DTCO.DFC_ComMileageRangeTo_FA_C "DFES/OBD spezifischer Fehlercode für Prüfung DFC_ComMileageRangeTo_FA" VALUE 0x8002923C Val_Wu16 65535.00 DFES_OneToOne 0.00 65535.00 /end CHARACTERISTIC
/begin CHARACTERISTIC DFES_DTCO.DFC_ComPspSig_C "DFES/OBD spezifischer Fehlercode für Prüfung DFC_ComPspSig" VALUE 0x8002923E Val_Wu16 65535.00 DFES_OneToOne 0.00 65535.00 /end CHARACTERISTIC
/begin CHARACTERISTIC DFES_DTCO.DFC_ComPspTo_C "DFES/OBD spezifischer Fehlercode für Prüfung DFC_ComPspTo" VALUE 0x80029240 Val_Wu16 65535.00 DFES_OneToOne 0.00 65535.00 /end CHARACTERISTIC
/begin CHARACTERISTIC DFES_DTCO.DFC_ComRelTimeSig_FA_C "DFES/OBD spezifischer Fehlercode für Prüfung DFC_ComRelTimeSig_FA" VALUE 0x80029242 Val_Wu16 65535.00 DFES_OneToOne 0.00 65535.00 /end CHARACTERISTIC
/begin CHARACTERISTIC DFES_DTCO.DFC_ComRelTimeTo_FA_C "DFES/OBD spezifischer Fehlercode für Prüfung DFC_ComRelTimeTo_FA" VALUE 0x80029244 Val_Wu16 65535.00 DFES_OneToOne 0.00 65535.00 /end CHARACTERISTIC
/begin CHARACTERISTIC DFES_DTCO.DFC_ComRequestEMFChk_C "DFES/OBD spezifischer Fehlercode für Prüfung DFC_ComRequestEMFChk" VALUE 0x80029246 Val_Wu16 65535.00 DFES_OneToOne 0.00 65535.00 /end CHARACTERISTIC
/begin CHARACTERISTIC DFES_DTCO.DFC_ComRequestEMFCtr_C "DFES/OBD spezifischer Fehlercode für Prüfung DFC_ComRequestEMFCtr" VALUE 0x80029248 Val_Wu16 65535.00 DFES_OneToOne 0.00 65535.00 /end CHARACTERISTIC
/begin CHARACTERISTIC DFES_DTCO.DFC_ComRequestEMFSig_C "DFES/OBD spezifischer Fehlercode für Prüfung DFC_ComRequestEMFSig" VALUE 0x8002924A Val_Wu16 65535.00 DFES_OneToOne 0.00 65535.00 /end CHARACTERISTIC
/begin CHARACTERISTIC DFES_DTCO.DFC_ComRequestEMFTo_C "DFES/OBD spezifischer Fehlercode für Prüfung DFC_ComRequestEMFTo" VALUE 0x8002924C Val_Wu16 65535.00 DFES_OneToOne 0.00 65535.00 /end CHARACTERISTIC
/begin CHARACTERISTIC DFES_DTCO.DFC_ComRpmWhlChk_FX_C "DFES/OBD spezifischer Fehlercode für Prüfung DFC_ComRpmWhlChk_FX" VALUE 0x8002924E Val_Wu16 65535.00 DFES_OneToOne 0.00 65535.00 /end CHARACTERISTIC
/begin CHARACTERISTIC DFES_DTCO.DFC_ComRpmWhlCtr_FX_C "DFES/OBD spezifischer Fehlercode für Prüfung DFC_ComRpmWhlCtr_FX" VALUE 0x80029250 Val_Wu16 65535.00 DFES_OneToOne 0.00 65535.00 /end CHARACTERISTIC
/begin CHARACTERISTIC DFES_DTCO.DFC_ComRpmWhlTo_FX_C "DFES/OBD spezifischer Fehlercode für Prüfung DFC_ComRpmWhlTo_FX" VALUE 0x80029252 Val_Wu16 65535.00 DFES_OneToOne 0.00 65535.00 /end CHARACTERISTIC
/begin CHARACTERISTIC DFES_DTCO.DFC_ComSecCtrRelSig_FA_C "DFES/OBD spezifischer Fehlercode für Prüfung DFC_ComSecCtrRelSig_FA" VALUE 0x80029254 Val_Wu16 65535.00 DFES_OneToOne 0.00 65535.00 /end CHARACTERISTIC
/begin CHARACTERISTIC DFES_DTCO.DFC_ComSecCtrRelTo_FA_C "DFES/OBD spezifischer Fehlercode für Prüfung DFC_ComSecCtrRelTo_FA" VALUE 0x80029256 Val_Wu16 65535.00 DFES_OneToOne 0.00 65535.00 /end CHARACTERISTIC
/begin CHARACTERISTIC DFES_DTCO.DFC_ComSensNOxGndSig_C "DFES/OBD spezifischer Fehlercode für Prüfung DFC_ComSensNOxGndSig" VALUE 0x80029258 Val_Wu16 65535.00 DFES_OneToOne 0.00 65535.00 /end CHARACTERISTIC
/begin CHARACTERISTIC DFES_DTCO.DFC_ComSensNOxGndTo_C "DFES/OBD spezifischer Fehlercode für Prüfung DFC_ComSensNOxGndTo" VALUE 0x8002925A Val_Wu16 65535.00 DFES_OneToOne 0.00 65535.00 /end CHARACTERISTIC
/begin CHARACTERISTIC DFES_DTCO.DFC_ComSensNOxMode_C "DFES/OBD spezifischer Fehlercode für Prüfung DFC_ComSensNOxMode" VALUE 0x8002925C Val_Wu16 65535.00 DFES_OneToOne 0.00 65535.00 /end CHARACTERISTIC
/begin CHARACTERISTIC DFES_DTCO.DFC_ComSensNOxUbattSig_C "DFES/OBD spezifischer Fehlercode für Prüfung DFC_ComSensNOxUbattSig" VALUE 0x8002925E Val_Wu16 65535.00 DFES_OneToOne 0.00 65535.00 /end CHARACTERISTIC
/begin CHARACTERISTIC DFES_DTCO.DFC_ComSensNOxUbattTo_C "DFES/OBD spezifischer Fehlercode für Prüfung DFC_ComSensNOxUbattTo" VALUE 0x80029260 Val_Wu16 65535.00 DFES_OneToOne 0.00 65535.00 /end CHARACTERISTIC
/begin CHARACTERISTIC DFES_DTCO.DFC_ComShiftPaddleTo_FX_C "DFES/OBD spezifischer Fehlercode für Prüfung DFC_ComShiftPaddleTo_FX" VALUE 0x80029262 Val_Wu16 65535.00 DFES_OneToOne 0.00 65535.00 /end CHARACTERISTIC
/begin CHARACTERISTIC DFES_DTCO.DFC_ComShutOffPSPSig_C "DFES/OBD spezifischer Fehlercode für Prüfung DFC_ComShutOffPSPSig" VALUE 0x80029264 Val_Wu16 65535.00 DFES_OneToOne 0.00 65535.00 /end CHARACTERISTIC
/begin CHARACTERISTIC DFES_DTCO.DFC_ComShutOffPSPTo_C "DFES/OBD spezifischer Fehlercode für Prüfung DFC_ComShutOffPSPTo" VALUE 0x80029266 Val_Wu16 65535.00 DFES_OneToOne 0.00 65535.00 /end CHARACTERISTIC
/begin CHARACTERISTIC DFES_DTCO.DFC_ComSlrdiGlbFZMTo_FA_C "DFES/OBD spezifischer Fehlercode für Prüfung DFC_ComSlrdiGlbFZMTo_FA" VALUE 0x80029268 Val_Wu16 65535.00 DFES_OneToOne 0.00 65535.00 /end CHARACTERISTIC
/begin CHARACTERISTIC DFES_DTCO.DFC_ComSlrdiGlbFZMTo_FX_C "DFES/OBD spezifischer Fehlercode für Prüfung DFC_ComSlrdiGlbFZMTo_FX" VALUE 0x8002926A Val_Wu16 65535.00 DFES_OneToOne 0.00 65535.00 /end CHARACTERISTIC
/begin CHARACTERISTIC DFES_DTCO.DFC_ComSpeedVehicleChk_FX_C "DFES/OBD spezifischer Fehlercode für Prüfung DFC_ComSpeedVehicleChk_FX" VALUE 0x8002926C Val_Wu16 65535.00 DFES_OneToOne 0.00 65535.00 /end CHARACTERISTIC
/begin CHARACTERISTIC DFES_DTCO.DFC_ComSpeedVehicleCtr_FX_C "DFES/OBD spezifischer Fehlercode für Prüfung DFC_ComSpeedVehicleCtr_FX" VALUE 0x8002926E Val_Wu16 65535.00 DFES_OneToOne 0.00 65535.00 /end CHARACTERISTIC
/begin CHARACTERISTIC DFES_DTCO.DFC_ComSpeedVehicleTo_FX_C "DFES/OBD spezifischer Fehlercode für Prüfung DFC_ComSpeedVehicleTo_FX" VALUE 0x80029270 Val_Wu16 65535.00 DFES_OneToOne 0.00 65535.00 /end CHARACTERISTIC
/begin CHARACTERISTIC DFES_DTCO.DFC_ComStConintDSCChk_FX_C "DFES/OBD spezifischer Fehlercode für Prüfung DFC_ComStConintDSCChk_FX" VALUE 0x80029272 Val_Wu16 65535.00 DFES_OneToOne 0.00 65535.00 /end CHARACTERISTIC
/begin CHARACTERISTIC DFES_DTCO.DFC_ComStConintDSCCtr_FX_C "DFES/OBD spezifischer Fehlercode für Prüfung DFC_ComStConintDSCCtr_FX" VALUE 0x80029274 Val_Wu16 65535.00 DFES_OneToOne 0.00 65535.00 /end CHARACTERISTIC
/begin CHARACTERISTIC DFES_DTCO.DFC_ComStConintDSCTo_FX_C "DFES/OBD spezifischer Fehlercode für Prüfung DFC_ComStConintDSCTo_FX" VALUE 0x80029276 Val_Wu16 65535.00 DFES_OneToOne 0.00 65535.00 /end CHARACTERISTIC
/begin CHARACTERISTIC DFES_DTCO.DFC_ComStatACFrontSig_FA_C "DFES/OBD spezifischer Fehlercode für Prüfung DFC_ComStatACFrontSig_FA" VALUE 0x80029278 Val_Wu16 65535.00 DFES_OneToOne 0.00 65535.00 /end CHARACTERISTIC
/begin CHARACTERISTIC DFES_DTCO.DFC_ComStatACFrontTo_FA_C "DFES/OBD spezifischer Fehlercode für Prüfung DFC_ComStatACFrontTo_FA" VALUE 0x8002927A Val_Wu16 65535.00 DFES_OneToOne 0.00 65535.00 /end CHARACTERISTIC
/begin CHARACTERISTIC DFES_DTCO.DFC_ComStatEkpSig_A_C "DFES/OBD spezifischer Fehlercode für Prüfung DFC_ComStatEkpSig_A" VALUE 0x8002927C Val_Wu16 65535.00 DFES_OneToOne 0.00 65535.00 /end CHARACTERISTIC
/begin CHARACTERISTIC DFES_DTCO.DFC_ComStatEkpTo_A_C "DFES/OBD spezifischer Fehlercode für Prüfung DFC_ComStatEkpTo_A" VALUE 0x8002927E Val_Wu16 65535.00 DFES_OneToOne 0.00 65535.00 /end CHARACTERISTIC
/begin CHARACTERISTIC DFES_DTCO.DFC_ComStatGearRevSig_FA_C "DFES/OBD spezifischer Fehlercode für Prüfung DFC_ComStatGearRevSig_FA" VALUE 0x80029280 Val_Wu16 65535.00 DFES_OneToOne 0.00 65535.00 /end CHARACTERISTIC
/begin CHARACTERISTIC DFES_DTCO.DFC_ComStatGearRevTo_FA_C "DFES/OBD spezifischer Fehlercode für Prüfung DFC_ComStatGearRevTo_FA" VALUE 0x80029282 Val_Wu16 65535.00 DFES_OneToOne 0.00 65535.00 /end CHARACTERISTIC
/begin CHARACTERISTIC DFES_DTCO.DFC_ComStatZVKlappenSig_FA_C "DFES/OBD spezifischer Fehlercode für Prüfung DFC_ComStatZVKlappenSig_FA" VALUE 0x80029284 Val_Wu16 65535.00 DFES_OneToOne 0.00 65535.00 /end CHARACTERISTIC
/begin CHARACTERISTIC DFES_DTCO.DFC_ComStatZVKlappenTo_FA_C "DFES/OBD spezifischer Fehlercode für Prüfung DFC_ComStatZVKlappenTo_FA" VALUE 0x80029286 Val_Wu16 65535.00 DFES_OneToOne 0.00 65535.00 /end CHARACTERISTIC
/begin CHARACTERISTIC DFES_DTCO.DFC_ComStateARSCtr_C "DFES/OBD spezifischer Fehlercode für Prüfung DFC_ComStateARSCtr" VALUE 0x80029288 Val_Wu16 65535.00 DFES_OneToOne 0.00 65535.00 /end CHARACTERISTIC
/begin CHARACTERISTIC DFES_DTCO.DFC_ComStateARSSig_C "DFES/OBD spezifischer Fehlercode für Prüfung DFC_ComStateARSSig" VALUE 0x8002928A Val_Wu16 65535.00 DFES_OneToOne 0.00 65535.00 /end CHARACTERISTIC
/begin CHARACTERISTIC DFES_DTCO.DFC_ComStateARSTo_C "DFES/OBD spezifischer Fehlercode für Prüfung DFC_ComStateARSTo" VALUE 0x8002928C Val_Wu16 65535.00 DFES_OneToOne 0.00 65535.00 /end CHARACTERISTIC
/begin CHARACTERISTIC DFES_DTCO.DFC_ComStateDscSig_C "DFES/OBD spezifischer Fehlercode für Prüfung DFC_ComStateDscSig" VALUE 0x8002928E Val_Wu16 65535.00 DFES_OneToOne 0.00 65535.00 /end CHARACTERISTIC
/begin CHARACTERISTIC DFES_DTCO.DFC_ComStateDscTo_C "DFES/OBD spezifischer Fehlercode für Prüfung DFC_ComStateDscTo" VALUE 0x80029290 Val_Wu16 65535.00 DFES_OneToOne 0.00 65535.00 /end CHARACTERISTIC
/begin CHARACTERISTIC DFES_DTCO.DFC_ComStateSeatSig_C "DFES/OBD spezifischer Fehlercode für Prüfung DFC_ComStateSeatSig" VALUE 0x80029292 Val_Wu16 65535.00 DFES_OneToOne 0.00 65535.00 /end CHARACTERISTIC
/begin CHARACTERISTIC DFES_DTCO.DFC_ComStateSeatSig_FA_C "DFES/OBD spezifischer Fehlercode für Prüfung DFC_ComStateSeatSig_FA" VALUE 0x80029294 Val_Wu16 65535.00 DFES_OneToOne 0.00 65535.00 /end CHARACTERISTIC
/begin CHARACTERISTIC DFES_DTCO.DFC_ComStateSeatTo_C "DFES/OBD spezifischer Fehlercode für Prüfung DFC_ComStateSeatTo" VALUE 0x80029296 Val_Wu16 65535.00 DFES_OneToOne 0.00 65535.00 /end CHARACTERISTIC
/begin CHARACTERISTIC DFES_DTCO.DFC_ComStateSeatTo_FA_C "DFES/OBD spezifischer Fehlercode für Prüfung DFC_ComStateSeatTo_FA" VALUE 0x80029298 Val_Wu16 65535.00 DFES_OneToOne 0.00 65535.00 /end CHARACTERISTIC
/begin CHARACTERISTIC DFES_DTCO.DFC_ComStatusEGSSig_A_C "DFES/OBD spezifischer Fehlercode für Prüfung DFC_ComStatusEGSSig_A" VALUE 0x8002929A Val_Wu16 65535.00 DFES_OneToOne 0.00 65535.00 /end CHARACTERISTIC
/begin CHARACTERISTIC DFES_DTCO.DFC_ComStatusEGSSig_FA_C "DFES/OBD spezifischer Fehlercode für Prüfung DFC_ComStatusEGSSig_FA" VALUE 0x8002929C Val_Wu16 65535.00 DFES_OneToOne 0.00 65535.00 /end CHARACTERISTIC
/begin CHARACTERISTIC DFES_DTCO.DFC_ComStatusEGSTo_A_C "DFES/OBD spezifischer Fehlercode für Prüfung DFC_ComStatusEGSTo_A" VALUE 0x8002929E Val_Wu16 65535.00 DFES_OneToOne 0.00 65535.00 /end CHARACTERISTIC
/begin CHARACTERISTIC DFES_DTCO.DFC_ComStatusEGSTo_FA_C "DFES/OBD spezifischer Fehlercode für Prüfung DFC_ComStatusEGSTo_FA" VALUE 0x800292A0 Val_Wu16 65535.00 DFES_OneToOne 0.00 65535.00 /end CHARACTERISTIC
/begin CHARACTERISTIC DFES_DTCO.DFC_ComStatusEMFChk_C "DFES/OBD spezifischer Fehlercode für Prüfung DFC_ComStatusEMFChk" VALUE 0x800292A2 Val_Wu16 65535.00 DFES_OneToOne 0.00 65535.00 /end CHARACTERISTIC
/begin CHARACTERISTIC DFES_DTCO.DFC_ComStatusEMFCtr_C "DFES/OBD spezifischer Fehlercode für Prüfung DFC_ComStatusEMFCtr" VALUE 0x800292A4 Val_Wu16 65535.00 DFES_OneToOne 0.00 65535.00 /end CHARACTERISTIC
/begin CHARACTERISTIC DFES_DTCO.DFC_ComStatusEMFSig_C "DFES/OBD spezifischer Fehlercode für Prüfung DFC_ComStatusEMFSig" VALUE 0x800292A6 Val_Wu16 65535.00 DFES_OneToOne 0.00 65535.00 /end CHARACTERISTIC
/begin CHARACTERISTIC DFES_DTCO.DFC_ComStatusEMFTo_C "DFES/OBD spezifischer Fehlercode für Prüfung DFC_ComStatusEMFTo" VALUE 0x800292A8 Val_Wu16 65535.00 DFES_OneToOne 0.00 65535.00 /end CHARACTERISTIC
/begin CHARACTERISTIC DFES_DTCO.DFC_ComStatusRGangSig_C "DFES/OBD spezifischer Fehlercode für Prüfung DFC_ComStatusRGangSig" VALUE 0x800292AA Val_Wu16 65535.00 DFES_OneToOne 0.00 65535.00 /end CHARACTERISTIC
/begin CHARACTERISTIC DFES_DTCO.DFC_ComStatusRGangTo_C "DFES/OBD spezifischer Fehlercode für Prüfung DFC_ComStatusRGangTo" VALUE 0x800292AC Val_Wu16 65535.00 DFES_OneToOne 0.00 65535.00 /end CHARACTERISTIC
/begin CHARACTERISTIC DFES_DTCO.DFC_ComSteeringAngleChk_FX_C "DFES/OBD spezifischer Fehlercode für Prüfung DFC_ComSteeringAngleChk_FX" VALUE 0x800292AE Val_Wu16 65535.00 DFES_OneToOne 0.00 65535.00 /end CHARACTERISTIC
/begin CHARACTERISTIC DFES_DTCO.DFC_ComSteeringAngleCtr_FX_C "DFES/OBD spezifischer Fehlercode für Prüfung DFC_ComSteeringAngleCtr_FX" VALUE 0x800292B0 Val_Wu16 65535.00 DFES_OneToOne 0.00 65535.00 /end CHARACTERISTIC
/begin CHARACTERISTIC DFES_DTCO.DFC_ComSteeringAngleTo_FX_C "DFES/OBD spezifischer Fehlercode für Prüfung DFC_ComSteeringAngleTo_FX" VALUE 0x800292B2 Val_Wu16 65535.00 DFES_OneToOne 0.00 65535.00 /end CHARACTERISTIC
/begin CHARACTERISTIC DFES_DTCO.DFC_ComTerminalChk_C "DFES/OBD spezifischer Fehlercode für Prüfung DFC_ComTerminalChk" VALUE 0x800292B4 Val_Wu16 65535.00 DFES_OneToOne 0.00 65535.00 /end CHARACTERISTIC
/begin CHARACTERISTIC DFES_DTCO.DFC_ComTerminalCtr_C "DFES/OBD spezifischer Fehlercode für Prüfung DFC_ComTerminalCtr" VALUE 0x800292B6 Val_Wu16 65535.00 DFES_OneToOne 0.00 65535.00 /end CHARACTERISTIC
/begin CHARACTERISTIC DFES_DTCO.DFC_ComTerminalSig_C "DFES/OBD spezifischer Fehlercode für Prüfung DFC_ComTerminalSig" VALUE 0x800292B8 Val_Wu16 65535.00 DFES_OneToOne 0.00 65535.00 /end CHARACTERISTIC
/begin CHARACTERISTIC DFES_DTCO.DFC_ComTerminalTo_C "DFES/OBD spezifischer Fehlercode für Prüfung DFC_ComTerminalTo" VALUE 0x800292BA Val_Wu16 65535.00 DFES_OneToOne 0.00 65535.00 /end CHARACTERISTIC
/begin CHARACTERISTIC DFES_DTCO.DFC_ComTimeDateSig_FA_C "DFES/OBD spezifischer Fehlercode für Prüfung DFC_ComTimeDateSig_FA" VALUE 0x800292BC Val_Wu16 65535.00 DFES_OneToOne 0.00 65535.00 /end CHARACTERISTIC
/begin CHARACTERISTIC DFES_DTCO.DFC_ComTimeDateTo_FA_C "DFES/OBD spezifischer Fehlercode für Prüfung DFC_ComTimeDateTo_FA" VALUE 0x800292BE Val_Wu16 65535.00 DFES_OneToOne 0.00 65535.00 /end CHARACTERISTIC
/begin CHARACTERISTIC DFES_DTCO.DFC_ComTrailerSig_C "DFES/OBD spezifischer Fehlercode für Prüfung DFC_ComTrailerSig" VALUE 0x800292C0 Val_Wu16 65535.00 DFES_OneToOne 0.00 65535.00 /end CHARACTERISTIC
/begin CHARACTERISTIC DFES_DTCO.DFC_ComTrailerSig_FA_C "DFES/OBD spezifischer Fehlercode für Prüfung DFC_ComTrailerSig_FA" VALUE 0x800292C2 Val_Wu16 65535.00 DFES_OneToOne 0.00 65535.00 /end CHARACTERISTIC
/begin CHARACTERISTIC DFES_DTCO.DFC_ComTrailerTo_C "DFES/OBD spezifischer Fehlercode für Prüfung DFC_ComTrailerTo" VALUE 0x800292C4 Val_Wu16 65535.00 DFES_OneToOne 0.00 65535.00 /end CHARACTERISTIC
/begin CHARACTERISTIC DFES_DTCO.DFC_ComTrailerTo_FA_C "DFES/OBD spezifischer Fehlercode für Prüfung DFC_ComTrailerTo_FA" VALUE 0x800292C6 Val_Wu16 65535.00 DFES_OneToOne 0.00 65535.00 /end CHARACTERISTIC
/begin CHARACTERISTIC DFES_DTCO.DFC_ComTrqDemCrshDrDyChk_FX_C "DFES/OBD spezifischer Fehlercode für Prüfung DFC_ComTrqDemCrshDrDyChk_FX" VALUE 0x800292C8 Val_Wu16 65535.00 DFES_OneToOne 0.00 65535.00 /end CHARACTERISTIC
/begin CHARACTERISTIC DFES_DTCO.DFC_ComTrqDemCrshDrDyCtr_FX_C "DFES/OBD spezifischer Fehlercode für Prüfung DFC_ComTrqDemCrshDrDyCtr_FX" VALUE 0x800292CA Val_Wu16 65535.00 DFES_OneToOne 0.00 65535.00 /end CHARACTERISTIC
/begin CHARACTERISTIC DFES_DTCO.DFC_ComTrqDemCrshDrDyTo_FX_C "DFES/OBD spezifischer Fehlercode für Prüfung DFC_ComTrqDemCrshDrDyTo_FX" VALUE 0x800292CC Val_Wu16 65535.00 DFES_OneToOne 0.00 65535.00 /end CHARACTERISTIC
/begin CHARACTERISTIC DFES_DTCO.DFC_ComTrqDemandDesSig_C "DFES/OBD spezifischer Fehlercode für Prüfung DFC_ComTrqDemandDesSig" VALUE 0x800292CE Val_Wu16 65535.00 DFES_OneToOne 0.00 65535.00 /end CHARACTERISTIC
/begin CHARACTERISTIC DFES_DTCO.DFC_ComTrqDemandDesTo_C "DFES/OBD spezifischer Fehlercode für Prüfung DFC_ComTrqDemandDesTo" VALUE 0x800292D0 Val_Wu16 65535.00 DFES_OneToOne 0.00 65535.00 /end CHARACTERISTIC
/begin CHARACTERISTIC DFES_DTCO.DFC_ComTrqDemandDscChk_C "DFES/OBD spezifischer Fehlercode für Prüfung DFC_ComTrqDemandDscChk" VALUE 0x800292D2 Val_Wu16 65535.00 DFES_OneToOne 0.00 65535.00 /end CHARACTERISTIC
/begin CHARACTERISTIC DFES_DTCO.DFC_ComTrqDemandDscCtr_C "DFES/OBD spezifischer Fehlercode für Prüfung DFC_ComTrqDemandDscCtr" VALUE 0x800292D4 Val_Wu16 65535.00 DFES_OneToOne 0.00 65535.00 /end CHARACTERISTIC
/begin CHARACTERISTIC DFES_DTCO.DFC_ComTrqDemandDscSig_C "DFES/OBD spezifischer Fehlercode für Prüfung DFC_ComTrqDemandDscSig" VALUE 0x800292D6 Val_Wu16 65535.00 DFES_OneToOne 0.00 65535.00 /end CHARACTERISTIC
/begin CHARACTERISTIC DFES_DTCO.DFC_ComTrqDemandDscTo_C "DFES/OBD spezifischer Fehlercode für Prüfung DFC_ComTrqDemandDscTo" VALUE 0x800292D8 Val_Wu16 65535.00 DFES_OneToOne 0.00 65535.00 /end CHARACTERISTIC
/begin CHARACTERISTIC DFES_DTCO.DFC_ComTrqDemandGbxChk_A_C "DFES/OBD spezifischer Fehlercode für Prüfung DFC_ComTrqDemandGbxChk_A" VALUE 0x800292DA Val_Wu16 65535.00 DFES_OneToOne 0.00 65535.00 /end CHARACTERISTIC
/begin CHARACTERISTIC DFES_DTCO.DFC_ComTrqDemandGbxChk_FA_C "DFES/OBD spezifischer Fehlercode für Prüfung DFC_ComTrqDemandGbxChk_FA" VALUE 0x800292DC Val_Wu16 65535.00 DFES_OneToOne 0.00 65535.00 /end CHARACTERISTIC
/begin CHARACTERISTIC DFES_DTCO.DFC_ComTrqDemandGbxCtr_A_C "DFES/OBD spezifischer Fehlercode für Prüfung DFC_ComTrqDemandGbxCtr_A" VALUE 0x800292DE Val_Wu16 65535.00 DFES_OneToOne 0.00 65535.00 /end CHARACTERISTIC
/begin CHARACTERISTIC DFES_DTCO.DFC_ComTrqDemandGbxCtr_FA_C "DFES/OBD spezifischer Fehlercode für Prüfung DFC_ComTrqDemandGbxCtr_FA" VALUE 0x800292E0 Val_Wu16 65535.00 DFES_OneToOne 0.00 65535.00 /end CHARACTERISTIC
/begin CHARACTERISTIC DFES_DTCO.DFC_ComTrqDemandGbxSig_A_C "DFES/OBD spezifischer Fehlercode für Prüfung DFC_ComTrqDemandGbxSig_A" VALUE 0x800292E2 Val_Wu16 65535.00 DFES_OneToOne 0.00 65535.00 /end CHARACTERISTIC
/begin CHARACTERISTIC DFES_DTCO.DFC_ComTrqDemandGbxSig_FA_C "DFES/OBD spezifischer Fehlercode für Prüfung DFC_ComTrqDemandGbxSig_FA" VALUE 0x800292E4 Val_Wu16 65535.00 DFES_OneToOne 0.00 65535.00 /end CHARACTERISTIC
/begin CHARACTERISTIC DFES_DTCO.DFC_ComTrqDemandGbxTo_A_C "DFES/OBD spezifischer Fehlercode für Prüfung DFC_ComTrqDemandGbxTo_A" VALUE 0x800292E6 Val_Wu16 65535.00 DFES_OneToOne 0.00 65535.00 /end CHARACTERISTIC
/begin CHARACTERISTIC DFES_DTCO.DFC_ComTrqDemandGbxTo_FA_C "DFES/OBD spezifischer Fehlercode für Prüfung DFC_ComTrqDemandGbxTo_FA" VALUE 0x800292E8 Val_Wu16 65535.00 DFES_OneToOne 0.00 65535.00 /end CHARACTERISTIC
/begin CHARACTERISTIC DFES_DTCO.DFC_ComTrqWhlDemChk_C "DFES/OBD spezifischer Fehlercode für Prüfung DFC_ComTrqWhlDemChk" VALUE 0x800292EA Val_Wu16 65535.00 DFES_OneToOne 0.00 65535.00 /end CHARACTERISTIC
/begin CHARACTERISTIC DFES_DTCO.DFC_ComTrqWhlDemCtr_C "DFES/OBD spezifischer Fehlercode für Prüfung DFC_ComTrqWhlDemCtr" VALUE 0x800292EC Val_Wu16 65535.00 DFES_OneToOne 0.00 65535.00 /end CHARACTERISTIC
/begin CHARACTERISTIC DFES_DTCO.DFC_ComTrqWhlDemFASChk_FX_C "DFES/OBD spezifischer Fehlercode für Prüfung DFC_ComTrqWhlDemFASChk_FX" VALUE 0x800292EE Val_Wu16 65535.00 DFES_OneToOne 0.00 65535.00 /end CHARACTERISTIC
/begin CHARACTERISTIC DFES_DTCO.DFC_ComTrqWhlDemFASCtr_FX_C "DFES/OBD spezifischer Fehlercode für Prüfung DFC_ComTrqWhlDemFASCtr_FX" VALUE 0x800292F0 Val_Wu16 65535.00 DFES_OneToOne 0.00 65535.00 /end CHARACTERISTIC
/begin CHARACTERISTIC DFES_DTCO.DFC_ComTrqWhlDemFASTo_FX_C "DFES/OBD spezifischer Fehlercode für Prüfung DFC_ComTrqWhlDemFASTo_FX" VALUE 0x800292F2 Val_Wu16 65535.00 DFES_OneToOne 0.00 65535.00 /end CHARACTERISTIC
/begin CHARACTERISTIC DFES_DTCO.DFC_ComTrqWhlDemSig_C "DFES/OBD spezifischer Fehlercode für Prüfung DFC_ComTrqWhlDemSig" VALUE 0x800292F4 Val_Wu16 65535.00 DFES_OneToOne 0.00 65535.00 /end CHARACTERISTIC
/begin CHARACTERISTIC DFES_DTCO.DFC_ComTrqWhlDemTo_C "DFES/OBD spezifischer Fehlercode für Prüfung DFC_ComTrqWhlDemTo" VALUE 0x800292F6 Val_Wu16 65535.00 DFES_OneToOne 0.00 65535.00 /end CHARACTERISTIC
/begin CHARACTERISTIC DFES_DTCO.DFC_ComVelocityChk_FA_C "DFES/OBD spezifischer Fehlercode für Prüfung DFC_ComVelocityChk_FA" VALUE 0x800292F8 Val_Wu16 65535.00 DFES_OneToOne 0.00 65535.00 /end CHARACTERISTIC
/begin CHARACTERISTIC DFES_DTCO.DFC_ComVelocityCtr_FA_C "DFES/OBD spezifischer Fehlercode für Prüfung DFC_ComVelocityCtr_FA" VALUE 0x800292FA Val_Wu16 65535.00 DFES_OneToOne 0.00 65535.00 /end CHARACTERISTIC
/begin CHARACTERISTIC DFES_DTCO.DFC_ComVelocitySig_C "DFES/OBD spezifischer Fehlercode für Prüfung DFC_ComVelocitySig" VALUE 0x800292FC Val_Wu16 65535.00 DFES_OneToOne 0.00 65535.00 /end CHARACTERISTIC
/begin CHARACTERISTIC DFES_DTCO.DFC_ComVelocitySig_FA_C "DFES/OBD spezifischer Fehlercode für Prüfung DFC_ComVelocitySig_FA" VALUE 0x800292FE Val_Wu16 65535.00 DFES_OneToOne 0.00 65535.00 /end CHARACTERISTIC
/begin CHARACTERISTIC DFES_DTCO.DFC_ComVelocityTo_C "DFES/OBD spezifischer Fehlercode für Prüfung DFC_ComVelocityTo" VALUE 0x80029300 Val_Wu16 65535.00 DFES_OneToOne 0.00 65535.00 /end CHARACTERISTIC
/begin CHARACTERISTIC DFES_DTCO.DFC_ComVelocityTo_FA_C "DFES/OBD spezifischer Fehlercode für Prüfung DFC_ComVelocityTo_FA" VALUE 0x80029302 Val_Wu16 65535.00 DFES_OneToOne 0.00 65535.00 /end CHARACTERISTIC
/begin CHARACTERISTIC DFES_DTCO.DFC_ComVerbraucherTo_C "DFES/OBD spezifischer Fehlercode für Prüfung DFC_ComVerbraucherTo" VALUE 0x80029304 Val_Wu16 65535.00 DFES_OneToOne 0.00 65535.00 /end CHARACTERISTIC
/begin CHARACTERISTIC DFES_DTCO.DFC_ComWMomPTStabChk_FX_C "DFES/OBD spezifischer Fehlercode für Prüfung DFC_ComWMomPTStabChk_FX" VALUE 0x80029306 Val_Wu16 65535.00 DFES_OneToOne 0.00 65535.00 /end CHARACTERISTIC
/begin CHARACTERISTIC DFES_DTCO.DFC_ComWMomPTStabCtr_FX_C "DFES/OBD spezifischer Fehlercode für Prüfung DFC_ComWMomPTStabCtr_FX" VALUE 0x80029308 Val_Wu16 65535.00 DFES_OneToOne 0.00 65535.00 /end CHARACTERISTIC
/begin CHARACTERISTIC DFES_DTCO.DFC_ComWMomPTStabTo_FX_C "DFES/OBD spezifischer Fehlercode für Prüfung DFC_ComWMomPTStabTo_FX" VALUE 0x8002930A Val_Wu16 65535.00 DFES_OneToOne 0.00 65535.00 /end CHARACTERISTIC
/begin CHARACTERISTIC DFES_DTCO.DFC_ComWheelSpeedSig_C "DFES/OBD spezifischer Fehlercode für Prüfung DFC_ComWheelSpeedSig" VALUE 0x8002930C Val_Wu16 65535.00 DFES_OneToOne 0.00 65535.00 /end CHARACTERISTIC
/begin CHARACTERISTIC DFES_DTCO.DFC_ComWheelSpeedTo_C "DFES/OBD spezifischer Fehlercode für Prüfung DFC_ComWheelSpeedTo" VALUE 0x8002930E Val_Wu16 65535.00 DFES_OneToOne 0.00 65535.00 /end CHARACTERISTIC
/begin CHARACTERISTIC DFES_DTCO.DFC_ComZvKlappenSig_C "DFES/OBD spezifischer Fehlercode für Prüfung DFC_ComZvKlappenSig" VALUE 0x80029310 Val_Wu16 65535.00 DFES_OneToOne 0.00 65535.00 /end CHARACTERISTIC
/begin CHARACTERISTIC DFES_DTCO.DFC_ComZvKlappenTo_C "DFES/OBD spezifischer Fehlercode für Prüfung DFC_ComZvKlappenTo" VALUE 0x80029312 Val_Wu16 65535.00 DFES_OneToOne 0.00 65535.00 /end CHARACTERISTIC
/begin CHARACTERISTIC DFES_DTCO.DFC_ComaDirectChk_FX_C "DFES/OBD spezifischer Fehlercode für Prüfung DFC_ComaDirectChk_FX" VALUE 0x80029314 Val_Wu16 65535.00 DFES_OneToOne 0.00 65535.00 /end CHARACTERISTIC
/begin CHARACTERISTIC DFES_DTCO.DFC_ComaDirectCtr_FX_C "DFES/OBD spezifischer Fehlercode für Prüfung DFC_ComaDirectCtr_FX" VALUE 0x80029316 Val_Wu16 65535.00 DFES_OneToOne 0.00 65535.00 /end CHARACTERISTIC
/begin CHARACTERISTIC DFES_DTCO.DFC_ComaDirectTo_FX_C "DFES/OBD spezifischer Fehlercode für Prüfung DFC_ComaDirectTo_FX" VALUE 0x80029318 Val_Wu16 65535.00 DFES_OneToOne 0.00 65535.00 /end CHARACTERISTIC
/begin CHARACTERISTIC DFES_DTCO.DFC_ComaSideChk_FX_C "DFES/OBD spezifischer Fehlercode für Prüfung DFC_ComaSideChk_FX" VALUE 0x8002931A Val_Wu16 65535.00 DFES_OneToOne 0.00 65535.00 /end CHARACTERISTIC
/begin CHARACTERISTIC DFES_DTCO.DFC_ComaSideCtr_FX_C "DFES/OBD spezifischer Fehlercode für Prüfung DFC_ComaSideCtr_FX" VALUE 0x8002931C Val_Wu16 65535.00 DFES_OneToOne 0.00 65535.00 /end CHARACTERISTIC
/begin CHARACTERISTIC DFES_DTCO.DFC_ComaSideTo_FX_C "DFES/OBD spezifischer Fehlercode für Prüfung DFC_ComaSideTo_FX" VALUE 0x8002931E Val_Wu16 65535.00 DFES_OneToOne 0.00 65535.00 /end CHARACTERISTIC
/begin CHARACTERISTIC DFES_DTCO.DFC_Cy320SpiCom_C "DFES/OBD spezifischer Fehlercode für Prüfung DFC_Cy320SpiCom" VALUE 0x80029320 Val_Wu16 65535.00 DFES_OneToOne 0.00 65535.00 /end CHARACTERISTIC
/begin CHARACTERISTIC DFES_DTCO.DFC_ETCtlDvtInrMax_C "DFES/OBD spezifischer Fehlercode für Prüfung DFC_ETCtlDvtInrMax" VALUE 0x80029322 Val_Wu16 65535.00 DFES_OneToOne 0.00 65535.00 /end CHARACTERISTIC
/begin CHARACTERISTIC DFES_DTCO.DFC_ETCtlDvtInrMin_C "DFES/OBD spezifischer Fehlercode für Prüfung DFC_ETCtlDvtInrMin" VALUE 0x80029324 Val_Wu16 65535.00 DFES_OneToOne 0.00 65535.00 /end CHARACTERISTIC
/begin CHARACTERISTIC DFES_DTCO.DFC_ETCtlDvtOutrMax_C "DFES/OBD spezifischer Fehlercode für Prüfung DFC_ETCtlDvtOutrMax" VALUE 0x80029326 Val_Wu16 65535.00 DFES_OneToOne 0.00 65535.00 /end CHARACTERISTIC
/begin CHARACTERISTIC DFES_DTCO.DFC_ETCtlDvtOutrMin_C "DFES/OBD spezifischer Fehlercode für Prüfung DFC_ETCtlDvtOutrMin" VALUE 0x80029328 Val_Wu16 65535.00 DFES_OneToOne 0.00 65535.00 /end CHARACTERISTIC
/begin CHARACTERISTIC DFES_DTCO.DFC_FBCqDvtMax_C "DFES/OBD spezifischer Fehlercode für Prüfung DFC_FBCqDvtMax" VALUE 0x8002932A Val_Wu16 65535.00 DFES_OneToOne 0.00 65535.00 /end CHARACTERISTIC
/begin CHARACTERISTIC DFES_DTCO.DFC_FBCqDvtMin_C "DFES/OBD spezifischer Fehlercode für Prüfung DFC_FBCqDvtMin" VALUE 0x8002932C Val_Wu16 65535.00 DFES_OneToOne 0.00 65535.00 /end CHARACTERISTIC
/begin CHARACTERISTIC DFES_DTCO.DFC_Fan4WinErr1_C "DFES/OBD spezifischer Fehlercode für Prüfung DFC_Fan4WinErr1" VALUE 0x8002932E Val_Wu16 65535.00 DFES_OneToOne 0.00 65535.00 /end CHARACTERISTIC
/begin CHARACTERISTIC DFES_DTCO.DFC_Fan4WinErr2_C "DFES/OBD spezifischer Fehlercode für Prüfung DFC_Fan4WinErr2" VALUE 0x80029330 Val_Wu16 65535.00 DFES_OneToOne 0.00 65535.00 /end CHARACTERISTIC
/begin CHARACTERISTIC DFES_DTCO.DFC_Fan4WinErr3_C "DFES/OBD spezifischer Fehlercode für Prüfung DFC_Fan4WinErr3" VALUE 0x80029332 Val_Wu16 65535.00 DFES_OneToOne 0.00 65535.00 /end CHARACTERISTIC
/begin CHARACTERISTIC DFES_DTCO.DFC_Fan4WinErr4_C "DFES/OBD spezifischer Fehlercode für Prüfung DFC_Fan4WinErr4" VALUE 0x80029334 Val_Wu16 65535.00 DFES_OneToOne 0.00 65535.00 /end CHARACTERISTIC
/begin CHARACTERISTIC DFES_DTCO.DFC_FanSCG_C "DFES/OBD spezifischer Fehlercode für Prüfung DFC_FanSCG" VALUE 0x80029336 Val_Wu16 65535.00 DFES_OneToOne 0.00 65535.00 /end CHARACTERISTIC
/begin CHARACTERISTIC DFES_DTCO.DFC_FlFCBS_C "DFES/OBD spezifischer Fehlercode für Prüfung DFC_FlFCBS" VALUE 0x80029338 Val_Wu16 65535.00 DFES_OneToOne 0.00 65535.00 /end CHARACTERISTIC
/begin CHARACTERISTIC DFES_DTCO.DFC_GlwEcuConfigErr_C "DFES/OBD spezifischer Fehlercode für Prüfung DFC_GlwEcuConfigErr" VALUE 0x8002933A Val_Wu16 65535.00 DFES_OneToOne 0.00 65535.00 /end CHARACTERISTIC
/begin CHARACTERISTIC DFES_DTCO.DFC_GlwEcuEepErr_C "DFES/OBD spezifischer Fehlercode für Prüfung DFC_GlwEcuEepErr" VALUE 0x8002933C Val_Wu16 65535.00 DFES_OneToOne 0.00 65535.00 /end CHARACTERISTIC
/begin CHARACTERISTIC DFES_DTCO.DFC_GlwEcuFrmErr_C "DFES/OBD spezifischer Fehlercode für Prüfung DFC_GlwEcuFrmErr" VALUE 0x8002933E Val_Wu16 65535.00 DFES_OneToOne 0.00 65535.00 /end CHARACTERISTIC
/begin CHARACTERISTIC DFES_DTCO.DFC_GlwEcuGPCMFaultInfo_C "DFES/OBD spezifischer Fehlercode für Prüfung DFC_GlwEcuGPCMFaultInfo" VALUE 0x80029340 Val_Wu16 65535.00 DFES_OneToOne 0.00 65535.00 /end CHARACTERISTIC
/begin CHARACTERISTIC DFES_DTCO.DFC_GlwEcuGPCMInfo_C "DFES/OBD spezifischer Fehlercode für Prüfung DFC_GlwEcuGPCMInfo" VALUE 0x80029342 Val_Wu16 65535.00 DFES_OneToOne 0.00 65535.00 /end CHARACTERISTIC
/begin CHARACTERISTIC DFES_DTCO.DFC_GlwEcuGk1HSS_C "DFES/OBD spezifischer Fehlercode für Prüfung DFC_GlwEcuGk1HSS" VALUE 0x80029344 Val_Wu16 65535.00 DFES_OneToOne 0.00 65535.00 /end CHARACTERISTIC
/begin CHARACTERISTIC DFES_DTCO.DFC_GlwEcuGk1OL_C "DFES/OBD spezifischer Fehlercode für Prüfung DFC_GlwEcuGk1OL" VALUE 0x80029346 Val_Wu16 65535.00 DFES_OneToOne 0.00 65535.00 /end CHARACTERISTIC
/begin CHARACTERISTIC DFES_DTCO.DFC_GlwEcuGk1SC_C "DFES/OBD spezifischer Fehlercode für Prüfung DFC_GlwEcuGk1SC" VALUE 0x80029348 Val_Wu16 65535.00 DFES_OneToOne 0.00 65535.00 /end CHARACTERISTIC
/begin CHARACTERISTIC DFES_DTCO.DFC_GlwEcuGk1Wdst_C "DFES/OBD spezifischer Fehlercode für Prüfung DFC_GlwEcuGk1Wdst" VALUE 0x8002934A Val_Wu16 65535.00 DFES_OneToOne 0.00 65535.00 /end CHARACTERISTIC
/begin CHARACTERISTIC DFES_DTCO.DFC_GlwEcuGk2HSS_C "DFES/OBD spezifischer Fehlercode für Prüfung DFC_GlwEcuGk2HSS" VALUE 0x8002934C Val_Wu16 65535.00 DFES_OneToOne 0.00 65535.00 /end CHARACTERISTIC
/begin CHARACTERISTIC DFES_DTCO.DFC_GlwEcuGk2OL_C "DFES/OBD spezifischer Fehlercode für Prüfung DFC_GlwEcuGk2OL" VALUE 0x8002934E Val_Wu16 65535.00 DFES_OneToOne 0.00 65535.00 /end CHARACTERISTIC
/begin CHARACTERISTIC DFES_DTCO.DFC_GlwEcuGk2SC_C "DFES/OBD spezifischer Fehlercode für Prüfung DFC_GlwEcuGk2SC" VALUE 0x80029350 Val_Wu16 65535.00 DFES_OneToOne 0.00 65535.00 /end CHARACTERISTIC
/begin CHARACTERISTIC DFES_DTCO.DFC_GlwEcuGk2Wdst_C "DFES/OBD spezifischer Fehlercode für Prüfung DFC_GlwEcuGk2Wdst" VALUE 0x80029352 Val_Wu16 65535.00 DFES_OneToOne 0.00 65535.00 /end CHARACTERISTIC
/begin CHARACTERISTIC DFES_DTCO.DFC_GlwEcuGk3HSS_C "DFES/OBD spezifischer Fehlercode für Prüfung DFC_GlwEcuGk3HSS" VALUE 0x80029354 Val_Wu16 65535.00 DFES_OneToOne 0.00 65535.00 /end CHARACTERISTIC
/begin CHARACTERISTIC DFES_DTCO.DFC_GlwEcuGk3OL_C "DFES/OBD spezifischer Fehlercode für Prüfung DFC_GlwEcuGk3OL" VALUE 0x80029356 Val_Wu16 65535.00 DFES_OneToOne 0.00 65535.00 /end CHARACTERISTIC
/begin CHARACTERISTIC DFES_DTCO.DFC_GlwEcuGk3SC_C "DFES/OBD spezifischer Fehlercode für Prüfung DFC_GlwEcuGk3SC" VALUE 0x80029358 Val_Wu16 65535.00 DFES_OneToOne 0.00 65535.00 /end CHARACTERISTIC
/begin CHARACTERISTIC DFES_DTCO.DFC_GlwEcuGk3Wdst_C "DFES/OBD spezifischer Fehlercode für Prüfung DFC_GlwEcuGk3Wdst" VALUE 0x8002935A Val_Wu16 65535.00 DFES_OneToOne 0.00 65535.00 /end CHARACTERISTIC
/begin CHARACTERISTIC DFES_DTCO.DFC_GlwEcuGk4HSS_C "DFES/OBD spezifischer Fehlercode für Prüfung DFC_GlwEcuGk4HSS" VALUE 0x8002935C Val_Wu16 65535.00 DFES_OneToOne 0.00 65535.00 /end CHARACTERISTIC
/begin CHARACTERISTIC DFES_DTCO.DFC_GlwEcuGk4OL_C "DFES/OBD spezifischer Fehlercode für Prüfung DFC_GlwEcuGk4OL" VALUE 0x8002935E Val_Wu16 65535.00 DFES_OneToOne 0.00 65535.00 /end CHARACTERISTIC
/begin CHARACTERISTIC DFES_DTCO.DFC_GlwEcuGk4SC_C "DFES/OBD spezifischer Fehlercode für Prüfung DFC_GlwEcuGk4SC" VALUE 0x80029360 Val_Wu16 65535.00 DFES_OneToOne 0.00 65535.00 /end CHARACTERISTIC
/begin CHARACTERISTIC DFES_DTCO.DFC_GlwEcuGk4Wdst_C "DFES/OBD spezifischer Fehlercode für Prüfung DFC_GlwEcuGk4Wdst" VALUE 0x80029362 Val_Wu16 65535.00 DFES_OneToOne 0.00 65535.00 /end CHARACTERISTIC
/begin CHARACTERISTIC DFES_DTCO.DFC_GlwEcuGk5HSS_C "DFES/OBD spezifischer Fehlercode für Prüfung DFC_GlwEcuGk5HSS" VALUE 0x80029364 Val_Wu16 65535.00 DFES_OneToOne 0.00 65535.00 /end CHARACTERISTIC
/begin CHARACTERISTIC DFES_DTCO.DFC_GlwEcuGk5OL_C "DFES/OBD spezifischer Fehlercode für Prüfung DFC_GlwEcuGk5OL" VALUE 0x80029366 Val_Wu16 65535.00 DFES_OneToOne 0.00 65535.00 /end CHARACTERISTIC
/begin CHARACTERISTIC DFES_DTCO.DFC_GlwEcuGk5SC_C "DFES/OBD spezifischer Fehlercode für Prüfung DFC_GlwEcuGk5SC" VALUE 0x80029368 Val_Wu16 65535.00 DFES_OneToOne 0.00 65535.00 /end CHARACTERISTIC
/begin CHARACTERISTIC DFES_DTCO.DFC_GlwEcuGk5Wdst_C "DFES/OBD spezifischer Fehlercode für Prüfung DFC_GlwEcuGk5Wdst" VALUE 0x8002936A Val_Wu16 65535.00 DFES_OneToOne 0.00 65535.00 /end CHARACTERISTIC
/begin CHARACTERISTIC DFES_DTCO.DFC_GlwEcuGk6HSS_C "DFES/OBD spezifischer Fehlercode für Prüfung DFC_GlwEcuGk6HSS" VALUE 0x8002936C Val_Wu16 65535.00 DFES_OneToOne 0.00 65535.00 /end CHARACTERISTIC
/begin CHARACTERISTIC DFES_DTCO.DFC_GlwEcuGk6OL_C "DFES/OBD spezifischer Fehlercode für Prüfung DFC_GlwEcuGk6OL" VALUE 0x8002936E Val_Wu16 65535.00 DFES_OneToOne 0.00 65535.00 /end CHARACTERISTIC
/begin CHARACTERISTIC DFES_DTCO.DFC_GlwEcuGk6SC_C "DFES/OBD spezifischer Fehlercode für Prüfung DFC_GlwEcuGk6SC" VALUE 0x80029370 Val_Wu16 65535.00 DFES_OneToOne 0.00 65535.00 /end CHARACTERISTIC
/begin CHARACTERISTIC DFES_DTCO.DFC_GlwEcuGk6Wdst_C "DFES/OBD spezifischer Fehlercode für Prüfung DFC_GlwEcuGk6Wdst" VALUE 0x80029372 Val_Wu16 65535.00 DFES_OneToOne 0.00 65535.00 /end CHARACTERISTIC
/begin CHARACTERISTIC DFES_DTCO.DFC_GlwEcuGndErr_C "DFES/OBD spezifischer Fehlercode für Prüfung DFC_GlwEcuGndErr" VALUE 0x80029374 Val_Wu16 65535.00 DFES_OneToOne 0.00 65535.00 /end CHARACTERISTIC
/begin CHARACTERISTIC DFES_DTCO.DFC_GlwEcuIntErr_C "DFES/OBD spezifischer Fehlercode für Prüfung DFC_GlwEcuIntErr" VALUE 0x80029376 Val_Wu16 65535.00 DFES_OneToOne 0.00 65535.00 /end CHARACTERISTIC
/begin CHARACTERISTIC DFES_DTCO.DFC_GlwEcuMsgTimeout_C "DFES/OBD spezifischer Fehlercode für Prüfung DFC_GlwEcuMsgTimeout" VALUE 0x80029378 Val_Wu16 65535.00 DFES_OneToOne 0.00 65535.00 /end CHARACTERISTIC
/begin CHARACTERISTIC DFES_DTCO.DFC_GlwEcuT30Err_C "DFES/OBD spezifischer Fehlercode für Prüfung DFC_GlwEcuT30Err" VALUE 0x8002937A Val_Wu16 65535.00 DFES_OneToOne 0.00 65535.00 /end CHARACTERISTIC
/begin CHARACTERISTIC DFES_DTCO.DFC_GlwEcuTempErr_C "DFES/OBD spezifischer Fehlercode für Prüfung DFC_GlwEcuTempErr" VALUE 0x8002937C Val_Wu16 65535.00 DFES_OneToOne 0.00 65535.00 /end CHARACTERISTIC
/begin CHARACTERISTIC DFES_DTCO.DFC_GlwEcuUdiffT30_C "DFES/OBD spezifischer Fehlercode für Prüfung DFC_GlwEcuUdiffT30" VALUE 0x8002937E Val_Wu16 65535.00 DFES_OneToOne 0.00 65535.00 /end CHARACTERISTIC
/begin CHARACTERISTIC DFES_DTCO.DFC_IBSComErr_C "DFES/OBD spezifischer Fehlercode für Prüfung DFC_IBSComErr" VALUE 0x80029380 Val_Wu16 65535.00 DFES_OneToOne 0.00 65535.00 /end CHARACTERISTIC
/begin CHARACTERISTIC DFES_DTCO.DFC_LubSRCOilFldtCrit_C "DFES/OBD spezifischer Fehlercode für Prüfung DFC_LubSRCOilFldtCrit" VALUE 0x80029382 Val_Wu16 65535.00 DFES_OneToOne 0.00 65535.00 /end CHARACTERISTIC
/begin CHARACTERISTIC DFES_DTCO.DFC_LubSRCOilFldtCritDflMin_C "DFES/OBD spezifischer Fehlercode für Prüfung DFC_LubSRCOilFldtCritDflMin" VALUE 0x80029384 Val_Wu16 65535.00 DFES_OneToOne 0.00 65535.00 /end CHARACTERISTIC
/begin CHARACTERISTIC DFES_DTCO.DFC_LubSRCOilLvlCritMax_C "DFES/OBD spezifischer Fehlercode für Prüfung DFC_LubSRCOilLvlCritMax" VALUE 0x80029386 Val_Wu16 65535.00 DFES_OneToOne 0.00 65535.00 /end CHARACTERISTIC
/begin CHARACTERISTIC DFES_DTCO.DFC_LubSRCOilLvlCritMin_C "DFES/OBD spezifischer Fehlercode für Prüfung DFC_LubSRCOilLvlCritMin" VALUE 0x80029388 Val_Wu16 65535.00 DFES_OneToOne 0.00 65535.00 /end CHARACTERISTIC
/begin CHARACTERISTIC DFES_DTCO.DFC_LubSRCTot_C "DFES/OBD spezifischer Fehlercode für Prüfung DFC_LubSRCTot" VALUE 0x8002938A Val_Wu16 65535.00 DFES_OneToOne 0.00 65535.00 /end CHARACTERISTIC
/begin CHARACTERISTIC DFES_DTCO.DFC_MonUMaxSupply1_C "DFES/OBD spezifischer Fehlercode für Prüfung DFC_MonUMaxSupply1" VALUE 0x8002938C Val_Wu16 65535.00 DFES_OneToOne 0.00 65535.00 /end CHARACTERISTIC
/begin CHARACTERISTIC DFES_DTCO.DFC_MonUMinSupply1_C "DFES/OBD spezifischer Fehlercode für Prüfung DFC_MonUMinSupply1" VALUE 0x8002938E Val_Wu16 65535.00 DFES_OneToOne 0.00 65535.00 /end CHARACTERISTIC
/begin CHARACTERISTIC DFES_DTCO.DFC_OilComNpl_C "DFES/OBD spezifischer Fehlercode für Prüfung DFC_OilComNpl" VALUE 0x80029390 Val_Wu16 65535.00 DFES_OneToOne 0.00 65535.00 /end CHARACTERISTIC
/begin CHARACTERISTIC DFES_DTCO.DFC_PCBS_C "DFES/OBD spezifischer Fehlercode für Prüfung DFC_PCBS" VALUE 0x80029392 Val_Wu16 65535.00 DFES_OneToOne 0.00 65535.00 /end CHARACTERISTIC
/begin CHARACTERISTIC DFES_DTCO.DFC_PCBSPFltChg_C "DFES/OBD spezifischer Fehlercode für Prüfung DFC_PCBSPFltChg" VALUE 0x80029394 Val_Wu16 65535.00 DFES_OneToOne 0.00 65535.00 /end CHARACTERISTIC
/begin CHARACTERISTIC DFES_DTCO.DFC_PCRGovDvtLPMax_C "DFES/OBD spezifischer Fehlercode für Prüfung DFC_PCRGovDvtLPMax" VALUE 0x80029396 Val_Wu16 65535.00 DFES_OneToOne 0.00 65535.00 /end CHARACTERISTIC
/begin CHARACTERISTIC DFES_DTCO.DFC_PCRGovDvtLPMin_C "DFES/OBD spezifischer Fehlercode für Prüfung DFC_PCRGovDvtLPMin" VALUE 0x80029398 Val_Wu16 65535.00 DFES_OneToOne 0.00 65535.00 /end CHARACTERISTIC
/begin CHARACTERISTIC DFES_DTCO.DFC_PCRGovDvtMax_C "DFES/OBD spezifischer Fehlercode für Prüfung DFC_PCRGovDvtMax" VALUE 0x8002939A Val_Wu16 65535.00 DFES_OneToOne 0.00 65535.00 /end CHARACTERISTIC
/begin CHARACTERISTIC DFES_DTCO.DFC_PCRGovDvtMin_C "DFES/OBD spezifischer Fehlercode für Prüfung DFC_PCRGovDvtMin" VALUE 0x8002939C Val_Wu16 65535.00 DFES_OneToOne 0.00 65535.00 /end CHARACTERISTIC
/begin CHARACTERISTIC DFES_DTCO.DFC_PFltAPSPlausMAX_C "DFES/OBD spezifischer Fehlercode für Prüfung DFC_PFltAPSPlausMAX" VALUE 0x8002939E Val_Wu16 65535.00 DFES_OneToOne 0.00 65535.00 /end CHARACTERISTIC
/begin CHARACTERISTIC DFES_DTCO.DFC_PFltAPSPlausMIN_C "DFES/OBD spezifischer Fehlercode für Prüfung DFC_PFltAPSPlausMIN" VALUE 0x800293A0 Val_Wu16 65535.00 DFES_OneToOne 0.00 65535.00 /end CHARACTERISTIC
/begin CHARACTERISTIC DFES_DTCO.DFC_PFltBPSPlausMAX_C "DFES/OBD spezifischer Fehlercode für Prüfung DFC_PFltBPSPlausMAX" VALUE 0x800293A2 Val_Wu16 65535.00 DFES_OneToOne 0.00 65535.00 /end CHARACTERISTIC
/begin CHARACTERISTIC DFES_DTCO.DFC_PFltBPSPlausMIN_C "DFES/OBD spezifischer Fehlercode für Prüfung DFC_PFltBPSPlausMIN" VALUE 0x800293A4 Val_Wu16 65535.00 DFES_OneToOne 0.00 65535.00 /end CHARACTERISTIC
/begin CHARACTERISTIC DFES_DTCO.DFC_PFltOvldInhRgn_C "DFES/OBD spezifischer Fehlercode für Prüfung DFC_PFltOvldInhRgn" VALUE 0x800293A6 Val_Wu16 65535.00 DFES_OneToOne 0.00 65535.00 /end CHARACTERISTIC
/begin CHARACTERISTIC DFES_DTCO.DFC_PFltOvldTrqLim_C "DFES/OBD spezifischer Fehlercode für Prüfung DFC_PFltOvldTrqLim" VALUE 0x800293A8 Val_Wu16 65535.00 DFES_OneToOne 0.00 65535.00 /end CHARACTERISTIC
/begin CHARACTERISTIC DFES_DTCO.DFC_PFltPresPlausMAX_C "DFES/OBD spezifischer Fehlercode für Prüfung DFC_PFltPresPlausMAX" VALUE 0x800293AA Val_Wu16 65535.00 DFES_OneToOne 0.00 65535.00 /end CHARACTERISTIC
/begin CHARACTERISTIC DFES_DTCO.DFC_PFltPresPlausMIN_C "DFES/OBD spezifischer Fehlercode für Prüfung DFC_PFltPresPlausMIN" VALUE 0x800293AC Val_Wu16 65535.00 DFES_OneToOne 0.00 65535.00 /end CHARACTERISTIC
/begin CHARACTERISTIC DFES_DTCO.DFC_PFltTraRpmRdc_C "DFES/OBD spezifischer Fehlercode für Prüfung DFC_PFltTraRpmRdc" VALUE 0x800293AE Val_Wu16 65535.00 DFES_OneToOne 0.00 65535.00 /end CHARACTERISTIC
/begin CHARACTERISTIC DFES_DTCO.DFC_PFlt_tOxiPreMax_C "DFES/OBD spezifischer Fehlercode für Prüfung DFC_PFlt_tOxiPreMax" VALUE 0x800293B0 Val_Wu16 65535.00 DFES_OneToOne 0.00 65535.00 /end CHARACTERISTIC
/begin CHARACTERISTIC DFES_DTCO.DFC_PFlt_tOxiPreMaxRgn_C "DFES/OBD spezifischer Fehlercode für Prüfung DFC_PFlt_tOxiPreMaxRgn" VALUE 0x800293B2 Val_Wu16 65535.00 DFES_OneToOne 0.00 65535.00 /end CHARACTERISTIC
/begin CHARACTERISTIC DFES_DTCO.DFC_PFlt_tOxiPreNpl_C "DFES/OBD spezifischer Fehlercode für Prüfung DFC_PFlt_tOxiPreNpl" VALUE 0x800293B4 Val_Wu16 65535.00 DFES_OneToOne 0.00 65535.00 /end CHARACTERISTIC
/begin CHARACTERISTIC DFES_DTCO.DFC_PFlt_tPreMax_C "DFES/OBD spezifischer Fehlercode für Prüfung DFC_PFlt_tPreMax" VALUE 0x800293B6 Val_Wu16 65535.00 DFES_OneToOne 0.00 65535.00 /end CHARACTERISTIC
/begin CHARACTERISTIC DFES_DTCO.DFC_PFlt_tPreMaxRgn_C "DFES/OBD spezifischer Fehlercode für Prüfung DFC_PFlt_tPreMaxRgn" VALUE 0x800293B8 Val_Wu16 65535.00 DFES_OneToOne 0.00 65535.00 /end CHARACTERISTIC
/begin CHARACTERISTIC DFES_DTCO.DFC_PFlt_tPreNpl_C "DFES/OBD spezifischer Fehlercode für Prüfung DFC_PFlt_tPreNpl" VALUE 0x800293BA Val_Wu16 65535.00 DFES_OneToOne 0.00 65535.00 /end CHARACTERISTIC
/begin CHARACTERISTIC DFES_DTCO.DFC_PFltmSotDiffMAX_C "DFES/OBD spezifischer Fehlercode für Prüfung DFC_PFltmSotDiffMAX" VALUE 0x800293BC Val_Wu16 65535.00 DFES_OneToOne 0.00 65535.00 /end CHARACTERISTIC
/begin CHARACTERISTIC DFES_DTCO.DFC_PFltmSotDiffMIN_C "DFES/OBD spezifischer Fehlercode für Prüfung DFC_PFltmSotDiffMIN" VALUE 0x800293BE Val_Wu16 65535.00 DFES_OneToOne 0.00 65535.00 /end CHARACTERISTIC
/begin CHARACTERISTIC DFES_DTCO.DFC_PFltmSotDiffSIG_C "DFES/OBD spezifischer Fehlercode für Prüfung DFC_PFltmSotDiffSIG" VALUE 0x800293C0 Val_Wu16 65535.00 DFES_OneToOne 0.00 65535.00 /end CHARACTERISTIC
/begin CHARACTERISTIC DFES_DTCO.DFC_PIntkVUsEnvPPls_C "DFES/OBD spezifischer Fehlercode für Prüfung DFC_PIntkVUsEnvPPls" VALUE 0x800293C2 Val_Wu16 65535.00 DFES_OneToOne 0.00 65535.00 /end CHARACTERISTIC
/begin CHARACTERISTIC DFES_DTCO.DFC_PresPlausDblDef_C "DFES/OBD spezifischer Fehlercode für Prüfung DFC_PresPlausDblDef" VALUE 0x800293C4 Val_Wu16 65535.00 DFES_OneToOne 0.00 65535.00 /end CHARACTERISTIC
/begin CHARACTERISTIC DFES_DTCO.DFC_RailCPC1_C "DFES/OBD spezifischer Fehlercode für Prüfung DFC_RailCPC1" VALUE 0x800293C6 Val_Wu16 65535.00 DFES_OneToOne 0.00 65535.00 /end CHARACTERISTIC
/begin CHARACTERISTIC DFES_DTCO.DFC_RailCPC3_C "DFES/OBD spezifischer Fehlercode für Prüfung DFC_RailCPC3" VALUE 0x800293C8 Val_Wu16 65535.00 DFES_OneToOne 0.00 65535.00 /end CHARACTERISTIC
/begin CHARACTERISTIC DFES_DTCO.DFC_RailCPC4_C "DFES/OBD spezifischer Fehlercode für Prüfung DFC_RailCPC4" VALUE 0x800293CA Val_Wu16 65535.00 DFES_OneToOne 0.00 65535.00 /end CHARACTERISTIC
/begin CHARACTERISTIC DFES_DTCO.DFC_RailMeUn0_C "DFES/OBD spezifischer Fehlercode für Prüfung DFC_RailMeUn0" VALUE 0x800293CC Val_Wu16 65535.00 DFES_OneToOne 0.00 65535.00 /end CHARACTERISTIC
/begin CHARACTERISTIC DFES_DTCO.DFC_RailMeUn1_C "DFES/OBD spezifischer Fehlercode für Prüfung DFC_RailMeUn1" VALUE 0x800293CE Val_Wu16 65535.00 DFES_OneToOne 0.00 65535.00 /end CHARACTERISTIC
/begin CHARACTERISTIC DFES_DTCO.DFC_RailMeUn2_C "DFES/OBD spezifischer Fehlercode für Prüfung DFC_RailMeUn2" VALUE 0x800293D0 Val_Wu16 65535.00 DFES_OneToOne 0.00 65535.00 /end CHARACTERISTIC
/begin CHARACTERISTIC DFES_DTCO.DFC_RailMeUn22_C "DFES/OBD spezifischer Fehlercode für Prüfung DFC_RailMeUn22" VALUE 0x800293D2 Val_Wu16 65535.00 DFES_OneToOne 0.00 65535.00 /end CHARACTERISTIC
/begin CHARACTERISTIC DFES_DTCO.DFC_RailMeUn3_C "DFES/OBD spezifischer Fehlercode für Prüfung DFC_RailMeUn3" VALUE 0x800293D4 Val_Wu16 65535.00 DFES_OneToOne 0.00 65535.00 /end CHARACTERISTIC
/begin CHARACTERISTIC DFES_DTCO.DFC_RailMeUn4_C "DFES/OBD spezifischer Fehlercode für Prüfung DFC_RailMeUn4" VALUE 0x800293D6 Val_Wu16 65535.00 DFES_OneToOne 0.00 65535.00 /end CHARACTERISTIC
/begin CHARACTERISTIC DFES_DTCO.DFC_RailMeUn42_C "DFES/OBD spezifischer Fehlercode für Prüfung DFC_RailMeUn42" VALUE 0x800293D8 Val_Wu16 65535.00 DFES_OneToOne 0.00 65535.00 /end CHARACTERISTIC
/begin CHARACTERISTIC DFES_DTCO.DFC_RailMeUn5_C "DFES/OBD spezifischer Fehlercode für Prüfung DFC_RailMeUn5" VALUE 0x800293DA Val_Wu16 65535.00 DFES_OneToOne 0.00 65535.00 /end CHARACTERISTIC
/begin CHARACTERISTIC DFES_DTCO.DFC_RailPCV0_C "DFES/OBD spezifischer Fehlercode für Prüfung DFC_RailPCV0" VALUE 0x800293DC Val_Wu16 65535.00 DFES_OneToOne 0.00 65535.00 /end CHARACTERISTIC
/begin CHARACTERISTIC DFES_DTCO.DFC_RailPCV1_C "DFES/OBD spezifischer Fehlercode für Prüfung DFC_RailPCV1" VALUE 0x800293DE Val_Wu16 65535.00 DFES_OneToOne 0.00 65535.00 /end CHARACTERISTIC
/begin CHARACTERISTIC DFES_DTCO.DFC_RailPCV2_C "DFES/OBD spezifischer Fehlercode für Prüfung DFC_RailPCV2" VALUE 0x800293E0 Val_Wu16 65535.00 DFES_OneToOne 0.00 65535.00 /end CHARACTERISTIC
/begin CHARACTERISTIC DFES_DTCO.DFC_RailPCV22_C "DFES/OBD spezifischer Fehlercode für Prüfung DFC_RailPCV22" VALUE 0x800293E2 Val_Wu16 65535.00 DFES_OneToOne 0.00 65535.00 /end CHARACTERISTIC
/begin CHARACTERISTIC DFES_DTCO.DFC_RailPCV3_C "DFES/OBD spezifischer Fehlercode für Prüfung DFC_RailPCV3" VALUE 0x800293E4 Val_Wu16 65535.00 DFES_OneToOne 0.00 65535.00 /end CHARACTERISTIC
/begin CHARACTERISTIC DFES_DTCO.DFC_RailPCV4_C "DFES/OBD spezifischer Fehlercode für Prüfung DFC_RailPCV4" VALUE 0x800293E6 Val_Wu16 65535.00 DFES_OneToOne 0.00 65535.00 /end CHARACTERISTIC
/begin CHARACTERISTIC DFES_DTCO.DFC_RailPCV42_C "DFES/OBD spezifischer Fehlercode für Prüfung DFC_RailPCV42" VALUE 0x800293E8 Val_Wu16 65535.00 DFES_OneToOne 0.00 65535.00 /end CHARACTERISTIC
/begin CHARACTERISTIC DFES_DTCO.DFC_RailPMonStrt_C "DFES/OBD spezifischer Fehlercode für Prüfung DFC_RailPMonStrt" VALUE 0x800293EA Val_Wu16 65535.00 DFES_OneToOne 0.00 65535.00 /end CHARACTERISTIC
/begin CHARACTERISTIC DFES_DTCO.DFC_SSpMon1_C "DFES/OBD spezifischer Fehlercode für Prüfung DFC_SSpMon1" VALUE 0x800293EC Val_Wu16 65535.00 DFES_OneToOne 0.00 65535.00 /end CHARACTERISTIC
/begin CHARACTERISTIC DFES_DTCO.DFC_SSpMon2_C "DFES/OBD spezifischer Fehlercode für Prüfung DFC_SSpMon2" VALUE 0x800293EE Val_Wu16 65535.00 DFES_OneToOne 0.00 65535.00 /end CHARACTERISTIC
/begin CHARACTERISTIC DFES_DTCO.DFC_SSpMon3_C "DFES/OBD spezifischer Fehlercode für Prüfung DFC_SSpMon3" VALUE 0x800293F0 Val_Wu16 65535.00 DFES_OneToOne 0.00 65535.00 /end CHARACTERISTIC
/begin CHARACTERISTIC DFES_DTCO.DFC_ThrVlv4WinErr1_C "DFES/OBD spezifischer Fehlercode für Prüfung DFC_ThrVlv4WinErr1" VALUE 0x800293F2 Val_Wu16 65535.00 DFES_OneToOne 0.00 65535.00 /end CHARACTERISTIC
/begin CHARACTERISTIC DFES_DTCO.DFC_ThrVlv4WinErr2_C "DFES/OBD spezifischer Fehlercode für Prüfung DFC_ThrVlv4WinErr2" VALUE 0x800293F4 Val_Wu16 65535.00 DFES_OneToOne 0.00 65535.00 /end CHARACTERISTIC
/begin CHARACTERISTIC DFES_DTCO.DFC_ThrVlv4WinErr3_C "DFES/OBD spezifischer Fehlercode für Prüfung DFC_ThrVlv4WinErr3" VALUE 0x800293F6 Val_Wu16 65535.00 DFES_OneToOne 0.00 65535.00 /end CHARACTERISTIC
/begin CHARACTERISTIC DFES_DTCO.DFC_ThrVlv4WinErr4_C "DFES/OBD spezifischer Fehlercode für Prüfung DFC_ThrVlv4WinErr4" VALUE 0x800293F8 Val_Wu16 65535.00 DFES_OneToOne 0.00 65535.00 /end CHARACTERISTIC
/begin CHARACTERISTIC DFES_DTCO.DFC_ThrVlvSCG_C "DFES/OBD spezifischer Fehlercode für Prüfung DFC_ThrVlvSCG" VALUE 0x800293FA Val_Wu16 65535.00 DFES_OneToOne 0.00 65535.00 /end CHARACTERISTIC
/begin CHARACTERISTIC DFES_DTCO.DFC_Tle6232Spi1_C "DFES/OBD spezifischer Fehlercode für Prüfung DFC_Tle6232Spi1" VALUE 0x800293FC Val_Wu16 65535.00 DFES_OneToOne 0.00 65535.00 /end CHARACTERISTIC
/begin CHARACTERISTIC DFES_DTCO.DFC_TrbCh4WinErr1_C "DFES/OBD spezifischer Fehlercode für Prüfung DFC_TrbCh4WinErr1" VALUE 0x800293FE Val_Wu16 65535.00 DFES_OneToOne 0.00 65535.00 /end CHARACTERISTIC
/begin CHARACTERISTIC DFES_DTCO.DFC_TrbCh4WinErr2_C "DFES/OBD spezifischer Fehlercode für Prüfung DFC_TrbCh4WinErr2" VALUE 0x80029400 Val_Wu16 65535.00 DFES_OneToOne 0.00 65535.00 /end CHARACTERISTIC
/begin CHARACTERISTIC DFES_DTCO.DFC_TrbCh4WinErr3_C "DFES/OBD spezifischer Fehlercode für Prüfung DFC_TrbCh4WinErr3" VALUE 0x80029402 Val_Wu16 65535.00 DFES_OneToOne 0.00 65535.00 /end CHARACTERISTIC
/begin CHARACTERISTIC DFES_DTCO.DFC_TrbCh4WinErr4_C "DFES/OBD spezifischer Fehlercode für Prüfung DFC_TrbCh4WinErr4" VALUE 0x80029404 Val_Wu16 65535.00 DFES_OneToOne 0.00 65535.00 /end CHARACTERISTIC
/begin CHARACTERISTIC DFES_DTCO.DFC_TrbChSCG_C "DFES/OBD spezifischer Fehlercode für Prüfung DFC_TrbChSCG" VALUE 0x80029406 Val_Wu16 65535.00 DFES_OneToOne 0.00 65535.00 /end CHARACTERISTIC
/begin CHARACTERISTIC DFES_DTCO.DFC_TrbChSRCMax_C "DFES/OBD spezifischer Fehlercode für Prüfung DFC_TrbChSRCMax" VALUE 0x80029408 Val_Wu16 65535.00 DFES_OneToOne 0.00 65535.00 /end CHARACTERISTIC
/begin CHARACTERISTIC DFES_DTCO.DFC_TrbChSRCMin_C "DFES/OBD spezifischer Fehlercode für Prüfung DFC_TrbChSRCMin" VALUE 0x8002940A Val_Wu16 65535.00 DFES_OneToOne 0.00 65535.00 /end CHARACTERISTIC
/begin CHARACTERISTIC DFES_DTCO.DFC_WaHtEl4WinErr1_C "DFES/OBD spezifischer Fehlercode für Prüfung DFC_WaHtEl4WinErr1" VALUE 0x8002940C Val_Wu16 65535.00 DFES_OneToOne 0.00 65535.00 /end CHARACTERISTIC
/begin CHARACTERISTIC DFES_DTCO.DFC_WaHtEl4WinErr2_C "DFES/OBD spezifischer Fehlercode für Prüfung DFC_WaHtEl4WinErr2" VALUE 0x8002940E Val_Wu16 65535.00 DFES_OneToOne 0.00 65535.00 /end CHARACTERISTIC
/begin CHARACTERISTIC DFES_DTCO.DFC_WaHtEl4WinErr3_C "DFES/OBD spezifischer Fehlercode für Prüfung DFC_WaHtEl4WinErr3" VALUE 0x80029410 Val_Wu16 65535.00 DFES_OneToOne 0.00 65535.00 /end CHARACTERISTIC
/begin CHARACTERISTIC DFES_DTCO.DFC_WaHtEl4WinErr4_C "DFES/OBD spezifischer Fehlercode für Prüfung DFC_WaHtEl4WinErr4" VALUE 0x80029412 Val_Wu16 65535.00 DFES_OneToOne 0.00 65535.00 /end CHARACTERISTIC
/begin CHARACTERISTIC DFES_DTCO.DFC_WaHtElSCG_C "DFES/OBD spezifischer Fehlercode für Prüfung DFC_WaHtElSCG" VALUE 0x80029414 Val_Wu16 65535.00 DFES_OneToOne 0.00 65535.00 /end CHARACTERISTIC
/begin CHARACTERISTIC DFES_DTCO.DFC_ETClbETFltMax_0_C "DFES/OBD spezifischer Fehlercode für Prüfung DFC_ETClbETFltMax_0" VALUE 0x80029416 Val_Wu16 65535.00 DFES_OneToOne 0.00 65535.00 /end CHARACTERISTIC
/begin CHARACTERISTIC DFES_DTCO.DFC_ETClbETFltMax_1_C "DFES/OBD spezifischer Fehlercode für Prüfung DFC_ETClbETFltMax_1" VALUE 0x80029418 Val_Wu16 65535.00 DFES_OneToOne 0.00 65535.00 /end CHARACTERISTIC
/begin CHARACTERISTIC DFES_DTCO.DFC_ETClbETFltMax_2_C "DFES/OBD spezifischer Fehlercode für Prüfung DFC_ETClbETFltMax_2" VALUE 0x8002941A Val_Wu16 65535.00 DFES_OneToOne 0.00 65535.00 /end CHARACTERISTIC
/begin CHARACTERISTIC DFES_DTCO.DFC_ETClbETFltMax_3_C "DFES/OBD spezifischer Fehlercode für Prüfung DFC_ETClbETFltMax_3" VALUE 0x8002941C Val_Wu16 65535.00 DFES_OneToOne 0.00 65535.00 /end CHARACTERISTIC
/begin CHARACTERISTIC DFES_DTCO.DFC_ETClbETFltMax_4_C "DFES/OBD spezifischer Fehlercode für Prüfung DFC_ETClbETFltMax_4" VALUE 0x8002941E Val_Wu16 65535.00 DFES_OneToOne 0.00 65535.00 /end CHARACTERISTIC
/begin CHARACTERISTIC DFES_DTCO.DFC_ETClbETFltMax_5_C "DFES/OBD spezifischer Fehlercode für Prüfung DFC_ETClbETFltMax_5" VALUE 0x80029420 Val_Wu16 65535.00 DFES_OneToOne 0.00 65535.00 /end CHARACTERISTIC
/begin CHARACTERISTIC DFES_DTCO.DFC_ETClbETFltMin_0_C "DFES/OBD spezifischer Fehlercode für Prüfung DFC_ETClbETFltMin_0" VALUE 0x80029422 Val_Wu16 65535.00 DFES_OneToOne 0.00 65535.00 /end CHARACTERISTIC
/begin CHARACTERISTIC DFES_DTCO.DFC_ETClbETFltMin_1_C "DFES/OBD spezifischer Fehlercode für Prüfung DFC_ETClbETFltMin_1" VALUE 0x80029424 Val_Wu16 65535.00 DFES_OneToOne 0.00 65535.00 /end CHARACTERISTIC
/begin CHARACTERISTIC DFES_DTCO.DFC_ETClbETFltMin_2_C "DFES/OBD spezifischer Fehlercode für Prüfung DFC_ETClbETFltMin_2" VALUE 0x80029426 Val_Wu16 65535.00 DFES_OneToOne 0.00 65535.00 /end CHARACTERISTIC
/begin CHARACTERISTIC DFES_DTCO.DFC_ETClbETFltMin_3_C "DFES/OBD spezifischer Fehlercode für Prüfung DFC_ETClbETFltMin_3" VALUE 0x80029428 Val_Wu16 65535.00 DFES_OneToOne 0.00 65535.00 /end CHARACTERISTIC
/begin CHARACTERISTIC DFES_DTCO.DFC_ETClbETFltMin_4_C "DFES/OBD spezifischer Fehlercode für Prüfung DFC_ETClbETFltMin_4" VALUE 0x8002942A Val_Wu16 65535.00 DFES_OneToOne 0.00 65535.00 /end CHARACTERISTIC
/begin CHARACTERISTIC DFES_DTCO.DFC_ETClbETFltMin_5_C "DFES/OBD spezifischer Fehlercode für Prüfung DFC_ETClbETFltMin_5" VALUE 0x8002942C Val_Wu16 65535.00 DFES_OneToOne 0.00 65535.00 /end CHARACTERISTIC
/begin CHARACTERISTIC DFES_DTCO.DFC_InjCrvInjLimChrgBal_C "DFES/OBD spezifischer Fehlercode für Prüfung DFC_InjCrvInjLimChrgBal" VALUE 0x8002942E Val_Wu16 65535.00 DFES_OneToOne 0.00 65535.00 /end CHARACTERISTIC
/begin CHARACTERISTIC DFES_DTCO.DFC_InjCrvInjLimQntBal_C "DFES/OBD spezifischer Fehlercode für Prüfung DFC_InjCrvInjLimQntBal" VALUE 0x80029430 Val_Wu16 65535.00 DFES_OneToOne 0.00 65535.00 /end CHARACTERISTIC
/begin CHARACTERISTIC DFES_DTCO.DFC_InjCrvInjLimSys_C "DFES/OBD spezifischer Fehlercode für Prüfung DFC_InjCrvInjLimSys" VALUE 0x80029432 Val_Wu16 65535.00 DFES_OneToOne 0.00 65535.00 /end CHARACTERISTIC
/begin CHARACTERISTIC DFES_DTCO.DFC_InjCrvNumInjRtmLim_C "DFES/OBD spezifischer Fehlercode für Prüfung DFC_InjCrvNumInjRtmLim" VALUE 0x80029434 Val_Wu16 65535.00 DFES_OneToOne 0.00 65535.00 /end CHARACTERISTIC
/begin CHARACTERISTIC DFES_DTCO.DFC_LSUHtCoupSig_C "DFES/OBD spezifischer Fehlercode für Prüfung DFC_LSUHtCoupSig" VALUE 0x80029436 Val_Wu16 65535.00 DFES_OneToOne 0.00 65535.00 /end CHARACTERISTIC
/begin CHARACTERISTIC DFES_DTCO.DFC_AFS_SSpShOffOL_C "DFES/OBD spezifischer Fehlercode für Prüfung DFC_AFS_SSpShOffOL" VALUE 0x80029438 Val_Wu16 65535.00 DFES_OneToOne 0.00 65535.00 /end CHARACTERISTIC
/begin CHARACTERISTIC DFES_DTCO.DFC_AFS_SSpShOffOvrTemp_C "DFES/OBD spezifischer Fehlercode für Prüfung DFC_AFS_SSpShOffOvrTemp" VALUE 0x8002943A Val_Wu16 65535.00 DFES_OneToOne 0.00 65535.00 /end CHARACTERISTIC
/begin CHARACTERISTIC DFES_DTCO.DFC_AFS_SSpShOffSCB_C "DFES/OBD spezifischer Fehlercode für Prüfung DFC_AFS_SSpShOffSCB" VALUE 0x8002943C Val_Wu16 65535.00 DFES_OneToOne 0.00 65535.00 /end CHARACTERISTIC
/begin CHARACTERISTIC DFES_DTCO.DFC_AFS_SSpShOffSCG_C "DFES/OBD spezifischer Fehlercode für Prüfung DFC_AFS_SSpShOffSCG" VALUE 0x8002943E Val_Wu16 65535.00 DFES_OneToOne 0.00 65535.00 /end CHARACTERISTIC
/begin CHARACTERISTIC DFES_DTCO.DFC_AirCCmprOL_C "DFES/OBD spezifischer Fehlercode für Prüfung DFC_AirCCmprOL" VALUE 0x80029440 Val_Wu16 65535.00 DFES_OneToOne 0.00 65535.00 /end CHARACTERISTIC
/begin CHARACTERISTIC DFES_DTCO.DFC_AirCCmprOvrTemp_C "DFES/OBD spezifischer Fehlercode für Prüfung DFC_AirCCmprOvrTemp" VALUE 0x80029442 Val_Wu16 65535.00 DFES_OneToOne 0.00 65535.00 /end CHARACTERISTIC
/begin CHARACTERISTIC DFES_DTCO.DFC_AirCCmprSCB_C "DFES/OBD spezifischer Fehlercode für Prüfung DFC_AirCCmprSCB" VALUE 0x80029444 Val_Wu16 65535.00 DFES_OneToOne 0.00 65535.00 /end CHARACTERISTIC
/begin CHARACTERISTIC DFES_DTCO.DFC_AirCCmprSCG_C "DFES/OBD spezifischer Fehlercode für Prüfung DFC_AirCCmprSCG" VALUE 0x80029446 Val_Wu16 65535.00 DFES_OneToOne 0.00 65535.00 /end CHARACTERISTIC
/begin CHARACTERISTIC DFES_DTCO.DFC_CByVlvOL_C "DFES/OBD spezifischer Fehlercode für Prüfung DFC_CByVlvOL" VALUE 0x80029448 Val_Wu16 65535.00 DFES_OneToOne 0.00 65535.00 /end CHARACTERISTIC
/begin CHARACTERISTIC DFES_DTCO.DFC_CByVlvOvrTemp_C "DFES/OBD spezifischer Fehlercode für Prüfung DFC_CByVlvOvrTemp" VALUE 0x8002944A Val_Wu16 65535.00 DFES_OneToOne 0.00 65535.00 /end CHARACTERISTIC
/begin CHARACTERISTIC DFES_DTCO.DFC_CByVlvSCB_C "DFES/OBD spezifischer Fehlercode für Prüfung DFC_CByVlvSCB" VALUE 0x8002944C Val_Wu16 65535.00 DFES_OneToOne 0.00 65535.00 /end CHARACTERISTIC
/begin CHARACTERISTIC DFES_DTCO.DFC_CByVlvSCG_C "DFES/OBD spezifischer Fehlercode für Prüfung DFC_CByVlvSCG" VALUE 0x8002944E Val_Wu16 65535.00 DFES_OneToOne 0.00 65535.00 /end CHARACTERISTIC
/begin CHARACTERISTIC DFES_DTCO.DFC_CThmstOL_C "DFES/OBD spezifischer Fehlercode für Prüfung DFC_CThmstOL" VALUE 0x80029450 Val_Wu16 65535.00 DFES_OneToOne 0.00 65535.00 /end CHARACTERISTIC
/begin CHARACTERISTIC DFES_DTCO.DFC_CThmstOvrTemp_C "DFES/OBD spezifischer Fehlercode für Prüfung DFC_CThmstOvrTemp" VALUE 0x80029452 Val_Wu16 65535.00 DFES_OneToOne 0.00 65535.00 /end CHARACTERISTIC
/begin CHARACTERISTIC DFES_DTCO.DFC_CThmstSCB_C "DFES/OBD spezifischer Fehlercode für Prüfung DFC_CThmstSCB" VALUE 0x80029454 Val_Wu16 65535.00 DFES_OneToOne 0.00 65535.00 /end CHARACTERISTIC
/begin CHARACTERISTIC DFES_DTCO.DFC_CThmstSCG_C "DFES/OBD spezifischer Fehlercode für Prüfung DFC_CThmstSCG" VALUE 0x80029456 Val_Wu16 65535.00 DFES_OneToOne 0.00 65535.00 /end CHARACTERISTIC
/begin CHARACTERISTIC DFES_DTCO.DFC_DSMDummy_C "DFES/OBD spezifischer Fehlercode für Prüfung DFC_DSMDummy" VALUE 0x80029458 Val_Wu16 65535.00 DFES_OneToOne 0.00 65535.00 /end CHARACTERISTIC
/begin CHARACTERISTIC DFES_DTCO.DFC_EBxFanOL_C "DFES/OBD spezifischer Fehlercode für Prüfung DFC_EBxFanOL" VALUE 0x8002945A Val_Wu16 65535.00 DFES_OneToOne 0.00 65535.00 /end CHARACTERISTIC
/begin CHARACTERISTIC DFES_DTCO.DFC_EBxFanOvrTemp_C "DFES/OBD spezifischer Fehlercode für Prüfung DFC_EBxFanOvrTemp" VALUE 0x8002945C Val_Wu16 65535.00 DFES_OneToOne 0.00 65535.00 /end CHARACTERISTIC
/begin CHARACTERISTIC DFES_DTCO.DFC_EBxFanSCB_C "DFES/OBD spezifischer Fehlercode für Prüfung DFC_EBxFanSCB" VALUE 0x8002945E Val_Wu16 65535.00 DFES_OneToOne 0.00 65535.00 /end CHARACTERISTIC
/begin CHARACTERISTIC DFES_DTCO.DFC_EBxFanSCG_C "DFES/OBD spezifischer Fehlercode für Prüfung DFC_EBxFanSCG" VALUE 0x80029460 Val_Wu16 65535.00 DFES_OneToOne 0.00 65535.00 /end CHARACTERISTIC
/begin CHARACTERISTIC DFES_DTCO.DFC_ECBVlvOL_C "DFES/OBD spezifischer Fehlercode für Prüfung DFC_ECBVlvOL" VALUE 0x80029462 Val_Wu16 65535.00 DFES_OneToOne 0.00 65535.00 /end CHARACTERISTIC
/begin CHARACTERISTIC DFES_DTCO.DFC_ECBVlvOvrTemp_C "DFES/OBD spezifischer Fehlercode für Prüfung DFC_ECBVlvOvrTemp" VALUE 0x80029464 Val_Wu16 65535.00 DFES_OneToOne 0.00 65535.00 /end CHARACTERISTIC
/begin CHARACTERISTIC DFES_DTCO.DFC_ECBVlvSCB_C "DFES/OBD spezifischer Fehlercode für Prüfung DFC_ECBVlvSCB" VALUE 0x80029466 Val_Wu16 65535.00 DFES_OneToOne 0.00 65535.00 /end CHARACTERISTIC
/begin CHARACTERISTIC DFES_DTCO.DFC_ECBVlvSCG_C "DFES/OBD spezifischer Fehlercode für Prüfung DFC_ECBVlvSCG" VALUE 0x80029468 Val_Wu16 65535.00 DFES_OneToOne 0.00 65535.00 /end CHARACTERISTIC
/begin CHARACTERISTIC DFES_DTCO.DFC_EMDmpOL_0_C "DFES/OBD spezifischer Fehlercode für Prüfung DFC_EMDmpOL_0" VALUE 0x8002946A Val_Wu16 65535.00 DFES_OneToOne 0.00 65535.00 /end CHARACTERISTIC
/begin CHARACTERISTIC DFES_DTCO.DFC_EMDmpOL_1_C "DFES/OBD spezifischer Fehlercode für Prüfung DFC_EMDmpOL_1" VALUE 0x8002946C Val_Wu16 65535.00 DFES_OneToOne 0.00 65535.00 /end CHARACTERISTIC
/begin CHARACTERISTIC DFES_DTCO.DFC_EMDmpOvrTemp_0_C "DFES/OBD spezifischer Fehlercode für Prüfung DFC_EMDmpOvrTemp_0" VALUE 0x8002946E Val_Wu16 65535.00 DFES_OneToOne 0.00 65535.00 /end CHARACTERISTIC
/begin CHARACTERISTIC DFES_DTCO.DFC_EMDmpOvrTemp_1_C "DFES/OBD spezifischer Fehlercode für Prüfung DFC_EMDmpOvrTemp_1" VALUE 0x80029470 Val_Wu16 65535.00 DFES_OneToOne 0.00 65535.00 /end CHARACTERISTIC
/begin CHARACTERISTIC DFES_DTCO.DFC_EMDmpSCB_0_C "DFES/OBD spezifischer Fehlercode für Prüfung DFC_EMDmpSCB_0" VALUE 0x80029472 Val_Wu16 65535.00 DFES_OneToOne 0.00 65535.00 /end CHARACTERISTIC
/begin CHARACTERISTIC DFES_DTCO.DFC_EMDmpSCB_1_C "DFES/OBD spezifischer Fehlercode für Prüfung DFC_EMDmpSCB_1" VALUE 0x80029474 Val_Wu16 65535.00 DFES_OneToOne 0.00 65535.00 /end CHARACTERISTIC
/begin CHARACTERISTIC DFES_DTCO.DFC_EMDmpSCG_0_C "DFES/OBD spezifischer Fehlercode für Prüfung DFC_EMDmpSCG_0" VALUE 0x80029476 Val_Wu16 65535.00 DFES_OneToOne 0.00 65535.00 /end CHARACTERISTIC
/begin CHARACTERISTIC DFES_DTCO.DFC_EMDmpSCG_1_C "DFES/OBD spezifischer Fehlercode für Prüfung DFC_EMDmpSCG_1" VALUE 0x80029478 Val_Wu16 65535.00 DFES_OneToOne 0.00 65535.00 /end CHARACTERISTIC
/begin CHARACTERISTIC DFES_DTCO.DFC_EngStAOL_C "DFES/OBD spezifischer Fehlercode für Prüfung DFC_EngStAOL" VALUE 0x8002947A Val_Wu16 65535.00 DFES_OneToOne 0.00 65535.00 /end CHARACTERISTIC
/begin CHARACTERISTIC DFES_DTCO.DFC_EngStAOvrTemp_C "DFES/OBD spezifischer Fehlercode für Prüfung DFC_EngStAOvrTemp" VALUE 0x8002947C Val_Wu16 65535.00 DFES_OneToOne 0.00 65535.00 /end CHARACTERISTIC
/begin CHARACTERISTIC DFES_DTCO.DFC_EngStASCB_C "DFES/OBD spezifischer Fehlercode für Prüfung DFC_EngStASCB" VALUE 0x8002947E Val_Wu16 65535.00 DFES_OneToOne 0.00 65535.00 /end CHARACTERISTIC
/begin CHARACTERISTIC DFES_DTCO.DFC_EngStASCG_C "DFES/OBD spezifischer Fehlercode für Prüfung DFC_EngStASCG" VALUE 0x80029480 Val_Wu16 65535.00 DFES_OneToOne 0.00 65535.00 /end CHARACTERISTIC
/begin CHARACTERISTIC DFES_DTCO.DFC_FanOL_C "DFES/OBD spezifischer Fehlercode für Prüfung DFC_FanOL" VALUE 0x80029482 Val_Wu16 65535.00 DFES_OneToOne 0.00 65535.00 /end CHARACTERISTIC
/begin CHARACTERISTIC DFES_DTCO.DFC_FanOvrTemp_C "DFES/OBD spezifischer Fehlercode für Prüfung DFC_FanOvrTemp" VALUE 0x80029484 Val_Wu16 65535.00 DFES_OneToOne 0.00 65535.00 /end CHARACTERISTIC
/begin CHARACTERISTIC DFES_DTCO.DFC_FanSCB_C "DFES/OBD spezifischer Fehlercode für Prüfung DFC_FanSCB" VALUE 0x80029486 Val_Wu16 65535.00 DFES_OneToOne 0.00 65535.00 /end CHARACTERISTIC
/begin CHARACTERISTIC DFES_DTCO.DFC_FlFltHtOL_C "DFES/OBD spezifischer Fehlercode für Prüfung DFC_FlFltHtOL" VALUE 0x80029488 Val_Wu16 65535.00 DFES_OneToOne 0.00 65535.00 /end CHARACTERISTIC
/begin CHARACTERISTIC DFES_DTCO.DFC_FlFltHtOvrTemp_C "DFES/OBD spezifischer Fehlercode für Prüfung DFC_FlFltHtOvrTemp" VALUE 0x8002948A Val_Wu16 65535.00 DFES_OneToOne 0.00 65535.00 /end CHARACTERISTIC
/begin CHARACTERISTIC DFES_DTCO.DFC_FlFltHtSCB_C "DFES/OBD spezifischer Fehlercode für Prüfung DFC_FlFltHtSCB" VALUE 0x8002948C Val_Wu16 65535.00 DFES_OneToOne 0.00 65535.00 /end CHARACTERISTIC
/begin CHARACTERISTIC DFES_DTCO.DFC_FlFltHtSCG_C "DFES/OBD spezifischer Fehlercode für Prüfung DFC_FlFltHtSCG" VALUE 0x8002948E Val_Wu16 65535.00 DFES_OneToOne 0.00 65535.00 /end CHARACTERISTIC
/begin CHARACTERISTIC DFES_DTCO.DFC_LSUHtrMax_C "DFES/OBD spezifischer Fehlercode für Prüfung DFC_LSUHtrMax" VALUE 0x80029490 Val_Wu16 65535.00 DFES_OneToOne 0.00 65535.00 /end CHARACTERISTIC
/begin CHARACTERISTIC DFES_DTCO.DFC_LSUHtrMin_C "DFES/OBD spezifischer Fehlercode für Prüfung DFC_LSUHtrMin" VALUE 0x80029492 Val_Wu16 65535.00 DFES_OneToOne 0.00 65535.00 /end CHARACTERISTIC
/begin CHARACTERISTIC DFES_DTCO.DFC_LSUHtrNpl_C "DFES/OBD spezifischer Fehlercode für Prüfung DFC_LSUHtrNpl" VALUE 0x80029494 Val_Wu16 65535.00 DFES_OneToOne 0.00 65535.00 /end CHARACTERISTIC
/begin CHARACTERISTIC DFES_DTCO.DFC_LSUHtrSig_C "DFES/OBD spezifischer Fehlercode für Prüfung DFC_LSUHtrSig" VALUE 0x80029496 Val_Wu16 65535.00 DFES_OneToOne 0.00 65535.00 /end CHARACTERISTIC
/begin CHARACTERISTIC DFES_DTCO.DFC_LSUtExcMax_C "DFES/OBD spezifischer Fehlercode für Prüfung DFC_LSUtExcMax" VALUE 0x80029498 Val_Wu16 65535.00 DFES_OneToOne 0.00 65535.00 /end CHARACTERISTIC
/begin CHARACTERISTIC DFES_DTCO.DFC_LSUtExcMin_C "DFES/OBD spezifischer Fehlercode für Prüfung DFC_LSUtExcMin" VALUE 0x8002949A Val_Wu16 65535.00 DFES_OneToOne 0.00 65535.00 /end CHARACTERISTIC
/begin CHARACTERISTIC DFES_DTCO.DFC_MeUnOL_C "DFES/OBD spezifischer Fehlercode für Prüfung DFC_MeUnOL" VALUE 0x8002949C Val_Wu16 65535.00 DFES_OneToOne 0.00 65535.00 /end CHARACTERISTIC
/begin CHARACTERISTIC DFES_DTCO.DFC_MeUnSCB_C "DFES/OBD spezifischer Fehlercode für Prüfung DFC_MeUnSCB" VALUE 0x8002949E Val_Wu16 65535.00 DFES_OneToOne 0.00 65535.00 /end CHARACTERISTIC
/begin CHARACTERISTIC DFES_DTCO.DFC_MeUnSRCMax_C "DFES/OBD spezifischer Fehlercode für Prüfung DFC_MeUnSRCMax" VALUE 0x800294A0 Val_Wu16 65535.00 DFES_OneToOne 0.00 65535.00 /end CHARACTERISTIC
/begin CHARACTERISTIC DFES_DTCO.DFC_MeUnSRCMin_C "DFES/OBD spezifischer Fehlercode für Prüfung DFC_MeUnSRCMin" VALUE 0x800294A2 Val_Wu16 65535.00 DFES_OneToOne 0.00 65535.00 /end CHARACTERISTIC
/begin CHARACTERISTIC DFES_DTCO.DFC_PCVOL_C "DFES/OBD spezifischer Fehlercode für Prüfung DFC_PCVOL" VALUE 0x800294A4 Val_Wu16 65535.00 DFES_OneToOne 0.00 65535.00 /end CHARACTERISTIC
/begin CHARACTERISTIC DFES_DTCO.DFC_PCVSCB_C "DFES/OBD spezifischer Fehlercode für Prüfung DFC_PCVSCB" VALUE 0x800294A6 Val_Wu16 65535.00 DFES_OneToOne 0.00 65535.00 /end CHARACTERISTIC
/begin CHARACTERISTIC DFES_DTCO.DFC_PCVSRCMax_C "DFES/OBD spezifischer Fehlercode für Prüfung DFC_PCVSRCMax" VALUE 0x800294A8 Val_Wu16 65535.00 DFES_OneToOne 0.00 65535.00 /end CHARACTERISTIC
/begin CHARACTERISTIC DFES_DTCO.DFC_PCVSRCMin_C "DFES/OBD spezifischer Fehlercode für Prüfung DFC_PCVSRCMin" VALUE 0x800294AA Val_Wu16 65535.00 DFES_OneToOne 0.00 65535.00 /end CHARACTERISTIC
/begin CHARACTERISTIC DFES_DTCO.DFC_RailPSRCMax_C "DFES/OBD spezifischer Fehlercode für Prüfung DFC_RailPSRCMax" VALUE 0x800294AC Val_Wu16 65535.00 DFES_OneToOne 0.00 65535.00 /end CHARACTERISTIC
/begin CHARACTERISTIC DFES_DTCO.DFC_RailPSRCMin_C "DFES/OBD spezifischer Fehlercode für Prüfung DFC_RailPSRCMin" VALUE 0x800294AE Val_Wu16 65535.00 DFES_OneToOne 0.00 65535.00 /end CHARACTERISTIC
/begin CHARACTERISTIC DFES_DTCO.DFC_ShtrOL_C "DFES/OBD spezifischer Fehlercode für Prüfung DFC_ShtrOL" VALUE 0x800294B0 Val_Wu16 65535.00 DFES_OneToOne 0.00 65535.00 /end CHARACTERISTIC
/begin CHARACTERISTIC DFES_DTCO.DFC_ShtrOvrTemp_C "DFES/OBD spezifischer Fehlercode für Prüfung DFC_ShtrOvrTemp" VALUE 0x800294B2 Val_Wu16 65535.00 DFES_OneToOne 0.00 65535.00 /end CHARACTERISTIC
/begin CHARACTERISTIC DFES_DTCO.DFC_ShtrSCB_C "DFES/OBD spezifischer Fehlercode für Prüfung DFC_ShtrSCB" VALUE 0x800294B4 Val_Wu16 65535.00 DFES_OneToOne 0.00 65535.00 /end CHARACTERISTIC
/begin CHARACTERISTIC DFES_DTCO.DFC_ShtrSCG_C "DFES/OBD spezifischer Fehlercode für Prüfung DFC_ShtrSCG" VALUE 0x800294B6 Val_Wu16 65535.00 DFES_OneToOne 0.00 65535.00 /end CHARACTERISTIC
/begin CHARACTERISTIC DFES_DTCO.DFC_StrtOL_C "DFES/OBD spezifischer Fehlercode für Prüfung DFC_StrtOL" VALUE 0x800294B8 Val_Wu16 65535.00 DFES_OneToOne 0.00 65535.00 /end CHARACTERISTIC
/begin CHARACTERISTIC DFES_DTCO.DFC_StrtOvrTemp_C "DFES/OBD spezifischer Fehlercode für Prüfung DFC_StrtOvrTemp" VALUE 0x800294BA Val_Wu16 65535.00 DFES_OneToOne 0.00 65535.00 /end CHARACTERISTIC
/begin CHARACTERISTIC DFES_DTCO.DFC_StrtSCB_C "DFES/OBD spezifischer Fehlercode für Prüfung DFC_StrtSCB" VALUE 0x800294BC Val_Wu16 65535.00 DFES_OneToOne 0.00 65535.00 /end CHARACTERISTIC
/begin CHARACTERISTIC DFES_DTCO.DFC_StrtSCG_C "DFES/OBD spezifischer Fehlercode für Prüfung DFC_StrtSCG" VALUE 0x800294BE Val_Wu16 65535.00 DFES_OneToOne 0.00 65535.00 /end CHARACTERISTIC
/begin CHARACTERISTIC DFES_DTCO.DFC_ThrVlvOL_C "DFES/OBD spezifischer Fehlercode für Prüfung DFC_ThrVlvOL" VALUE 0x800294C0 Val_Wu16 65535.00 DFES_OneToOne 0.00 65535.00 /end CHARACTERISTIC
/begin CHARACTERISTIC DFES_DTCO.DFC_ThrVlvOvrTemp_C "DFES/OBD spezifischer Fehlercode für Prüfung DFC_ThrVlvOvrTemp" VALUE 0x800294C2 Val_Wu16 65535.00 DFES_OneToOne 0.00 65535.00 /end CHARACTERISTIC
/begin CHARACTERISTIC DFES_DTCO.DFC_ThrVlvSCB_C "DFES/OBD spezifischer Fehlercode für Prüfung DFC_ThrVlvSCB" VALUE 0x800294C4 Val_Wu16 65535.00 DFES_OneToOne 0.00 65535.00 /end CHARACTERISTIC
/begin CHARACTERISTIC DFES_DTCO.DFC_TrbChOL_C "DFES/OBD spezifischer Fehlercode für Prüfung DFC_TrbChOL" VALUE 0x800294C6 Val_Wu16 65535.00 DFES_OneToOne 0.00 65535.00 /end CHARACTERISTIC
/begin CHARACTERISTIC DFES_DTCO.DFC_TrbChOvrTemp_C "DFES/OBD spezifischer Fehlercode für Prüfung DFC_TrbChOvrTemp" VALUE 0x800294C8 Val_Wu16 65535.00 DFES_OneToOne 0.00 65535.00 /end CHARACTERISTIC
/begin CHARACTERISTIC DFES_DTCO.DFC_TrbChSCB_C "DFES/OBD spezifischer Fehlercode für Prüfung DFC_TrbChSCB" VALUE 0x800294CA Val_Wu16 65535.00 DFES_OneToOne 0.00 65535.00 /end CHARACTERISTIC
/begin CHARACTERISTIC DFES_DTCO.DFC_UDosVlvOL_C "DFES/OBD spezifischer Fehlercode für Prüfung DFC_UDosVlvOL" VALUE 0x800294CC Val_Wu16 65535.00 DFES_OneToOne 0.00 65535.00 /end CHARACTERISTIC
/begin CHARACTERISTIC DFES_DTCO.DFC_UDosVlvOvrTemp_C "DFES/OBD spezifischer Fehlercode für Prüfung DFC_UDosVlvOvrTemp" VALUE 0x800294CE Val_Wu16 65535.00 DFES_OneToOne 0.00 65535.00 /end CHARACTERISTIC
/begin CHARACTERISTIC DFES_DTCO.DFC_UDosVlvSCB_C "DFES/OBD spezifischer Fehlercode für Prüfung DFC_UDosVlvSCB" VALUE 0x800294D0 Val_Wu16 65535.00 DFES_OneToOne 0.00 65535.00 /end CHARACTERISTIC
/begin CHARACTERISTIC DFES_DTCO.DFC_UDosVlvSCG_C "DFES/OBD spezifischer Fehlercode für Prüfung DFC_UDosVlvSCG" VALUE 0x800294D2 Val_Wu16 65535.00 DFES_OneToOne 0.00 65535.00 /end CHARACTERISTIC
/begin CHARACTERISTIC DFES_DTCO.DFC_UPmpMotOL_C "DFES/OBD spezifischer Fehlercode für Prüfung DFC_UPmpMotOL" VALUE 0x800294D4 Val_Wu16 65535.00 DFES_OneToOne 0.00 65535.00 /end CHARACTERISTIC
/begin CHARACTERISTIC DFES_DTCO.DFC_UPmpMotOvrTemp_C "DFES/OBD spezifischer Fehlercode für Prüfung DFC_UPmpMotOvrTemp" VALUE 0x800294D6 Val_Wu16 65535.00 DFES_OneToOne 0.00 65535.00 /end CHARACTERISTIC
/begin CHARACTERISTIC DFES_DTCO.DFC_UPmpMotSCB_C "DFES/OBD spezifischer Fehlercode für Prüfung DFC_UPmpMotSCB" VALUE 0x800294D8 Val_Wu16 65535.00 DFES_OneToOne 0.00 65535.00 /end CHARACTERISTIC
/begin CHARACTERISTIC DFES_DTCO.DFC_UPmpMotSCG_C "DFES/OBD spezifischer Fehlercode für Prüfung DFC_UPmpMotSCG" VALUE 0x800294DA Val_Wu16 65535.00 DFES_OneToOne 0.00 65535.00 /end CHARACTERISTIC
/begin CHARACTERISTIC DFES_DTCO.DFC_WaHtElOL_C "DFES/OBD spezifischer Fehlercode für Prüfung DFC_WaHtElOL" VALUE 0x800294DC Val_Wu16 65535.00 DFES_OneToOne 0.00 65535.00 /end CHARACTERISTIC
/begin CHARACTERISTIC DFES_DTCO.DFC_WaHtElOvrTemp_C "DFES/OBD spezifischer Fehlercode für Prüfung DFC_WaHtElOvrTemp" VALUE 0x800294DE Val_Wu16 65535.00 DFES_OneToOne 0.00 65535.00 /end CHARACTERISTIC
/begin CHARACTERISTIC DFES_DTCO.DFC_WaHtElSCB_C "DFES/OBD spezifischer Fehlercode für Prüfung DFC_WaHtElSCB" VALUE 0x800294E0 Val_Wu16 65535.00 DFES_OneToOne 0.00 65535.00 /end CHARACTERISTIC
/begin CHARACTERISTIC DFES_DTCO.DFC_IVActrUChSRCMax_C "DFES/OBD spezifischer Fehlercode für Prüfung DFC_IVActrUChSRCMax" VALUE 0x800294E2 Val_Wu16 65535.00 DFES_OneToOne 0.00 65535.00 /end CHARACTERISTIC
/begin CHARACTERISTIC DFES_DTCO.DFC_IVActrUChSRCMin_C "DFES/OBD spezifischer Fehlercode für Prüfung DFC_IVActrUChSRCMin" VALUE 0x800294E4 Val_Wu16 65535.00 DFES_OneToOne 0.00 65535.00 /end CHARACTERISTIC
/begin CHARACTERISTIC DFES_DTCO.DFC_IVActrVltgSRCMax_C "DFES/OBD spezifischer Fehlercode für Prüfung DFC_IVActrVltgSRCMax" VALUE 0x800294E6 Val_Wu16 65535.00 DFES_OneToOne 0.00 65535.00 /end CHARACTERISTIC
/begin CHARACTERISTIC DFES_DTCO.DFC_IVActrVltgSRCMin_C "DFES/OBD spezifischer Fehlercode für Prüfung DFC_IVActrVltgSRCMin" VALUE 0x800294E8 Val_Wu16 65535.00 DFES_OneToOne 0.00 65535.00 /end CHARACTERISTIC
/begin CHARACTERISTIC DFES_DTCO.DFC_IVDiaTunDet_C "DFES/OBD spezifischer Fehlercode für Prüfung DFC_IVDiaTunDet" VALUE 0x800294EA Val_Wu16 65535.00 DFES_OneToOne 0.00 65535.00 /end CHARACTERISTIC
/begin CHARACTERISTIC DFES_DTCO.DFC_IVPSplyStopDCDC_C "DFES/OBD spezifischer Fehlercode für Prüfung DFC_IVPSplyStopDCDC" VALUE 0x800294EC Val_Wu16 65535.00 DFES_OneToOne 0.00 65535.00 /end CHARACTERISTIC
/begin CHARACTERISTIC DFES_DTCO.DFC_IVPSplyVltgSRCMax_C "DFES/OBD spezifischer Fehlercode für Prüfung DFC_IVPSplyVltgSRCMax" VALUE 0x800294EE Val_Wu16 65535.00 DFES_OneToOne 0.00 65535.00 /end CHARACTERISTIC
/begin CHARACTERISTIC DFES_DTCO.DFC_IVPSplyVltgSRCMin_C "DFES/OBD spezifischer Fehlercode für Prüfung DFC_IVPSplyVltgSRCMin" VALUE 0x800294F0 Val_Wu16 65535.00 DFES_OneToOne 0.00 65535.00 /end CHARACTERISTIC
/begin CHARACTERISTIC DFES_DTCO.DFC_SCREtaErr_C "DFES/OBD spezifischer Fehlercode für Prüfung DFC_SCREtaErr" VALUE 0x800294F2 Val_Wu16 65535.00 DFES_OneToOne 0.00 65535.00 /end CHARACTERISTIC
/begin CHARACTERISTIC DFES_DTCO.DFC_SCREtaErr1_C "DFES/OBD spezifischer Fehlercode für Prüfung DFC_SCREtaErr1" VALUE 0x800294F4 Val_Wu16 65535.00 DFES_OneToOne 0.00 65535.00 /end CHARACTERISTIC
/begin CHARACTERISTIC DFES_DTCO.DFC_SCREtaErr2_C "DFES/OBD spezifischer Fehlercode für Prüfung DFC_SCREtaErr2" VALUE 0x800294F6 Val_Wu16 65535.00 DFES_OneToOne 0.00 65535.00 /end CHARACTERISTIC
/begin CHARACTERISTIC DFES_DTCO.DFC_SCRMonMetCtlPresErr_C "DFES/OBD spezifischer Fehlercode für Prüfung DFC_SCRMonMetCtlPresErr" VALUE 0x800294F8 Val_Wu16 65535.00 DFES_OneToOne 0.00 65535.00 /end CHARACTERISTIC
/begin CHARACTERISTIC DFES_DTCO.DFC_SCRMonPresBuildUpErr_C "DFES/OBD spezifischer Fehlercode für Prüfung DFC_SCRMonPresBuildUpErr" VALUE 0x800294FA Val_Wu16 65535.00 DFES_OneToOne 0.00 65535.00 /end CHARACTERISTIC
/begin CHARACTERISTIC DFES_DTCO.DFC_SCRMonPresRdcErr_C "DFES/OBD spezifischer Fehlercode für Prüfung DFC_SCRMonPresRdcErr" VALUE 0x800294FC Val_Wu16 65535.00 DFES_OneToOne 0.00 65535.00 /end CHARACTERISTIC
/begin CHARACTERISTIC DFES_DTCO.DFC_AFSOffsDrftMax_C "DFES/OBD spezifischer Fehlercode für Prüfung DFC_AFSOffsDrftMax" VALUE 0x800294FE Val_Wu16 65535.00 DFES_OneToOne 0.00 65535.00 /end CHARACTERISTIC
/begin CHARACTERISTIC DFES_DTCO.DFC_AFSOffsDrftMin_C "DFES/OBD spezifischer Fehlercode für Prüfung DFC_AFSOffsDrftMin" VALUE 0x80029500 Val_Wu16 65535.00 DFES_OneToOne 0.00 65535.00 /end CHARACTERISTIC
/begin CHARACTERISTIC DFES_DTCO.DFC_AFSSRCCorMax_C "DFES/OBD spezifischer Fehlercode für Prüfung DFC_AFSSRCCorMax" VALUE 0x80029502 Val_Wu16 65535.00 DFES_OneToOne 0.00 65535.00 /end CHARACTERISTIC
/begin CHARACTERISTIC DFES_DTCO.DFC_AFSSRCCorMin_C "DFES/OBD spezifischer Fehlercode für Prüfung DFC_AFSSRCCorMin" VALUE 0x80029504 Val_Wu16 65535.00 DFES_OneToOne 0.00 65535.00 /end CHARACTERISTIC
/begin CHARACTERISTIC DFES_DTCO.DFC_AFSSRCRawMax_C "DFES/OBD spezifischer Fehlercode für Prüfung DFC_AFSSRCRawMax" VALUE 0x80029506 Val_Wu16 65535.00 DFES_OneToOne 0.00 65535.00 /end CHARACTERISTIC
/begin CHARACTERISTIC DFES_DTCO.DFC_AFSSRCRawMin_C "DFES/OBD spezifischer Fehlercode für Prüfung DFC_AFSSRCRawMin" VALUE 0x80029508 Val_Wu16 65535.00 DFES_OneToOne 0.00 65535.00 /end CHARACTERISTIC
/begin CHARACTERISTIC DFES_DTCO.DFC_AFSSetyDrftMax_C "DFES/OBD spezifischer Fehlercode für Prüfung DFC_AFSSetyDrftMax" VALUE 0x8002950A Val_Wu16 65535.00 DFES_OneToOne 0.00 65535.00 /end CHARACTERISTIC
/begin CHARACTERISTIC DFES_DTCO.DFC_AFSSetyDrftMin_C "DFES/OBD spezifischer Fehlercode für Prüfung DFC_AFSSetyDrftMin" VALUE 0x8002950C Val_Wu16 65535.00 DFES_OneToOne 0.00 65535.00 /end CHARACTERISTIC
/begin CHARACTERISTIC DFES_DTCO.DFC_AirCSwtNpl_C "DFES/OBD spezifischer Fehlercode für Prüfung DFC_AirCSwtNpl" VALUE 0x8002950E Val_Wu16 65535.00 DFES_OneToOne 0.00 65535.00 /end CHARACTERISTIC
/begin CHARACTERISTIC DFES_DTCO.DFC_AirCSwtSig_C "DFES/OBD spezifischer Fehlercode für Prüfung DFC_AirCSwtSig" VALUE 0x80029510 Val_Wu16 65535.00 DFES_OneToOne 0.00 65535.00 /end CHARACTERISTIC
/begin CHARACTERISTIC DFES_DTCO.DFC_BattUSRCMax_C "DFES/OBD spezifischer Fehlercode für Prüfung DFC_BattUSRCMax" VALUE 0x80029512 Val_Wu16 65535.00 DFES_OneToOne 0.00 65535.00 /end CHARACTERISTIC
/begin CHARACTERISTIC DFES_DTCO.DFC_BattUSRCMin_C "DFES/OBD spezifischer Fehlercode für Prüfung DFC_BattUSRCMin" VALUE 0x80029514 Val_Wu16 65535.00 DFES_OneToOne 0.00 65535.00 /end CHARACTERISTIC
/begin CHARACTERISTIC DFES_DTCO.DFC_BrkNpl_C "DFES/OBD spezifischer Fehlercode für Prüfung DFC_BrkNpl" VALUE 0x80029516 Val_Wu16 65535.00 DFES_OneToOne 0.00 65535.00 /end CHARACTERISTIC
/begin CHARACTERISTIC DFES_DTCO.DFC_BrkPSRCMax_C "DFES/OBD spezifischer Fehlercode für Prüfung DFC_BrkPSRCMax" VALUE 0x80029518 Val_Wu16 65535.00 DFES_OneToOne 0.00 65535.00 /end CHARACTERISTIC
/begin CHARACTERISTIC DFES_DTCO.DFC_BrkPSRCMin_C "DFES/OBD spezifischer Fehlercode für Prüfung DFC_BrkPSRCMin" VALUE 0x8002951A Val_Wu16 65535.00 DFES_OneToOne 0.00 65535.00 /end CHARACTERISTIC
/begin CHARACTERISTIC DFES_DTCO.DFC_CEngDsTSRCMax_C "DFES/OBD spezifischer Fehlercode für Prüfung DFC_CEngDsTSRCMax" VALUE 0x8002951C Val_Wu16 65535.00 DFES_OneToOne 0.00 65535.00 /end CHARACTERISTIC
/begin CHARACTERISTIC DFES_DTCO.DFC_CEngDsTSRCMin_C "DFES/OBD spezifischer Fehlercode für Prüfung DFC_CEngDsTSRCMin" VALUE 0x8002951E Val_Wu16 65535.00 DFES_OneToOne 0.00 65535.00 /end CHARACTERISTIC
/begin CHARACTERISTIC DFES_DTCO.DFC_CrCUIDet_C "DFES/OBD spezifischer Fehlercode für Prüfung DFC_CrCUIDet" VALUE 0x80029520 Val_Wu16 65535.00 DFES_OneToOne 0.00 65535.00 /end CHARACTERISTIC
/begin CHARACTERISTIC DFES_DTCO.DFC_ECBVlvSRCMax_C "DFES/OBD spezifischer Fehlercode für Prüfung DFC_ECBVlvSRCMax" VALUE 0x80029522 Val_Wu16 65535.00 DFES_OneToOne 0.00 65535.00 /end CHARACTERISTIC
/begin CHARACTERISTIC DFES_DTCO.DFC_ECBVlvSRCMin_C "DFES/OBD spezifischer Fehlercode für Prüfung DFC_ECBVlvSRCMin" VALUE 0x80029524 Val_Wu16 65535.00 DFES_OneToOne 0.00 65535.00 /end CHARACTERISTIC
/begin CHARACTERISTIC DFES_DTCO.DFC_ECUOvrTemp_C "DFES/OBD spezifischer Fehlercode für Prüfung DFC_ECUOvrTemp" VALUE 0x80029526 Val_Wu16 65535.00 DFES_OneToOne 0.00 65535.00 /end CHARACTERISTIC
/begin CHARACTERISTIC DFES_DTCO.DFC_EGRVlvGovDvtMax_C "DFES/OBD spezifischer Fehlercode für Prüfung DFC_EGRVlvGovDvtMax" VALUE 0x80029528 Val_Wu16 65535.00 DFES_OneToOne 0.00 65535.00 /end CHARACTERISTIC
/begin CHARACTERISTIC DFES_DTCO.DFC_EGRVlvGovDvtMin_C "DFES/OBD spezifischer Fehlercode für Prüfung DFC_EGRVlvGovDvtMin" VALUE 0x8002952A Val_Wu16 65535.00 DFES_OneToOne 0.00 65535.00 /end CHARACTERISTIC
/begin CHARACTERISTIC DFES_DTCO.DFC_EGRVlvHBrgOpnLd_C "DFES/OBD spezifischer Fehlercode für Prüfung DFC_EGRVlvHBrgOpnLd" VALUE 0x8002952C Val_Wu16 65535.00 DFES_OneToOne 0.00 65535.00 /end CHARACTERISTIC
/begin CHARACTERISTIC DFES_DTCO.DFC_EGRVlvHBrgOvrCurr_C "DFES/OBD spezifischer Fehlercode für Prüfung DFC_EGRVlvHBrgOvrCurr" VALUE 0x8002952E Val_Wu16 65535.00 DFES_OneToOne 0.00 65535.00 /end CHARACTERISTIC
/begin CHARACTERISTIC DFES_DTCO.DFC_EGRVlvHBrgOvrTemp_C "DFES/OBD spezifischer Fehlercode für Prüfung DFC_EGRVlvHBrgOvrTemp" VALUE 0x80029530 Val_Wu16 65535.00 DFES_OneToOne 0.00 65535.00 /end CHARACTERISTIC
/begin CHARACTERISTIC DFES_DTCO.DFC_EGRVlvHBrgShCirBatt1_C "DFES/OBD spezifischer Fehlercode für Prüfung DFC_EGRVlvHBrgShCirBatt1" VALUE 0x80029532 Val_Wu16 65535.00 DFES_OneToOne 0.00 65535.00 /end CHARACTERISTIC
/begin CHARACTERISTIC DFES_DTCO.DFC_EGRVlvHBrgShCirBatt2_C "DFES/OBD spezifischer Fehlercode für Prüfung DFC_EGRVlvHBrgShCirBatt2" VALUE 0x80029534 Val_Wu16 65535.00 DFES_OneToOne 0.00 65535.00 /end CHARACTERISTIC
/begin CHARACTERISTIC DFES_DTCO.DFC_EGRVlvHBrgShCirGnd1_C "DFES/OBD spezifischer Fehlercode für Prüfung DFC_EGRVlvHBrgShCirGnd1" VALUE 0x80029536 Val_Wu16 65535.00 DFES_OneToOne 0.00 65535.00 /end CHARACTERISTIC
/begin CHARACTERISTIC DFES_DTCO.DFC_EGRVlvHBrgShCirGnd2_C "DFES/OBD spezifischer Fehlercode für Prüfung DFC_EGRVlvHBrgShCirGnd2" VALUE 0x80029538 Val_Wu16 65535.00 DFES_OneToOne 0.00 65535.00 /end CHARACTERISTIC
/begin CHARACTERISTIC DFES_DTCO.DFC_EGRVlvHBrgShCirOvrLd_C "DFES/OBD spezifischer Fehlercode für Prüfung DFC_EGRVlvHBrgShCirOvrLd" VALUE 0x8002953A Val_Wu16 65535.00 DFES_OneToOne 0.00 65535.00 /end CHARACTERISTIC
/begin CHARACTERISTIC DFES_DTCO.DFC_EGRVlvHBrgTempOvrCurr_C "DFES/OBD spezifischer Fehlercode für Prüfung DFC_EGRVlvHBrgTempOvrCurr" VALUE 0x8002953C Val_Wu16 65535.00 DFES_OneToOne 0.00 65535.00 /end CHARACTERISTIC
/begin CHARACTERISTIC DFES_DTCO.DFC_EGRVlvHBrgUndrVltg_C "DFES/OBD spezifischer Fehlercode für Prüfung DFC_EGRVlvHBrgUndrVltg" VALUE 0x8002953E Val_Wu16 65535.00 DFES_OneToOne 0.00 65535.00 /end CHARACTERISTIC
/begin CHARACTERISTIC DFES_DTCO.DFC_EGRVlvLPGovDvtMax_C "DFES/OBD spezifischer Fehlercode für Prüfung DFC_EGRVlvLPGovDvtMax" VALUE 0x80029540 Val_Wu16 65535.00 DFES_OneToOne 0.00 65535.00 /end CHARACTERISTIC
/begin CHARACTERISTIC DFES_DTCO.DFC_EGRVlvLPGovDvtMin_C "DFES/OBD spezifischer Fehlercode für Prüfung DFC_EGRVlvLPGovDvtMin" VALUE 0x80029542 Val_Wu16 65535.00 DFES_OneToOne 0.00 65535.00 /end CHARACTERISTIC
/begin CHARACTERISTIC DFES_DTCO.DFC_EGRVlvLPHBrgOpnLd_C "DFES/OBD spezifischer Fehlercode für Prüfung DFC_EGRVlvLPHBrgOpnLd" VALUE 0x80029544 Val_Wu16 65535.00 DFES_OneToOne 0.00 65535.00 /end CHARACTERISTIC
/begin CHARACTERISTIC DFES_DTCO.DFC_EGRVlvLPHBrgOvrCurr_C "DFES/OBD spezifischer Fehlercode für Prüfung DFC_EGRVlvLPHBrgOvrCurr" VALUE 0x80029546 Val_Wu16 65535.00 DFES_OneToOne 0.00 65535.00 /end CHARACTERISTIC
/begin CHARACTERISTIC DFES_DTCO.DFC_EGRVlvLPHBrgOvrTemp_C "DFES/OBD spezifischer Fehlercode für Prüfung DFC_EGRVlvLPHBrgOvrTemp" VALUE 0x80029548 Val_Wu16 65535.00 DFES_OneToOne 0.00 65535.00 /end CHARACTERISTIC
/begin CHARACTERISTIC DFES_DTCO.DFC_EGRVlvLPHBrgShCirBatt1_C "DFES/OBD spezifischer Fehlercode für Prüfung DFC_EGRVlvLPHBrgShCirBatt1" VALUE 0x8002954A Val_Wu16 65535.00 DFES_OneToOne 0.00 65535.00 /end CHARACTERISTIC
/begin CHARACTERISTIC DFES_DTCO.DFC_EGRVlvLPHBrgShCirBatt2_C "DFES/OBD spezifischer Fehlercode für Prüfung DFC_EGRVlvLPHBrgShCirBatt2" VALUE 0x8002954C Val_Wu16 65535.00 DFES_OneToOne 0.00 65535.00 /end CHARACTERISTIC
/begin CHARACTERISTIC DFES_DTCO.DFC_EGRVlvLPHBrgShCirGnd1_C "DFES/OBD spezifischer Fehlercode für Prüfung DFC_EGRVlvLPHBrgShCirGnd1" VALUE 0x8002954E Val_Wu16 65535.00 DFES_OneToOne 0.00 65535.00 /end CHARACTERISTIC
/begin CHARACTERISTIC DFES_DTCO.DFC_EGRVlvLPHBrgShCirGnd2_C "DFES/OBD spezifischer Fehlercode für Prüfung DFC_EGRVlvLPHBrgShCirGnd2" VALUE 0x80029550 Val_Wu16 65535.00 DFES_OneToOne 0.00 65535.00 /end CHARACTERISTIC
/begin CHARACTERISTIC DFES_DTCO.DFC_EGRVlvLPHBrgShCirOvrLd_C "DFES/OBD spezifischer Fehlercode für Prüfung DFC_EGRVlvLPHBrgShCirOvrLd" VALUE 0x80029552 Val_Wu16 65535.00 DFES_OneToOne 0.00 65535.00 /end CHARACTERISTIC
/begin CHARACTERISTIC DFES_DTCO.DFC_EGRVlvLPHBrgTempOvrCurr_C "DFES/OBD spezifischer Fehlercode für Prüfung DFC_EGRVlvLPHBrgTempOvrCurr" VALUE 0x80029554 Val_Wu16 65535.00 DFES_OneToOne 0.00 65535.00 /end CHARACTERISTIC
/begin CHARACTERISTIC DFES_DTCO.DFC_EGRVlvLPHBrgUndrVltg_C "DFES/OBD spezifischer Fehlercode für Prüfung DFC_EGRVlvLPHBrgUndrVltg" VALUE 0x80029556 Val_Wu16 65535.00 DFES_OneToOne 0.00 65535.00 /end CHARACTERISTIC
/begin CHARACTERISTIC DFES_DTCO.DFC_EGRVlvLPOL_C "DFES/OBD spezifischer Fehlercode für Prüfung DFC_EGRVlvLPOL" VALUE 0x80029558 Val_Wu16 65535.00 DFES_OneToOne 0.00 65535.00 /end CHARACTERISTIC
/begin CHARACTERISTIC DFES_DTCO.DFC_EGRVlvLPSCB_C "DFES/OBD spezifischer Fehlercode für Prüfung DFC_EGRVlvLPSCB" VALUE 0x8002955A Val_Wu16 65535.00 DFES_OneToOne 0.00 65535.00 /end CHARACTERISTIC
/begin CHARACTERISTIC DFES_DTCO.DFC_EGRVlvLPSCG_C "DFES/OBD spezifischer Fehlercode für Prüfung DFC_EGRVlvLPSCG" VALUE 0x8002955C Val_Wu16 65535.00 DFES_OneToOne 0.00 65535.00 /end CHARACTERISTIC
/begin CHARACTERISTIC DFES_DTCO.DFC_EGRVlvLPSRCMax_C "DFES/OBD spezifischer Fehlercode für Prüfung DFC_EGRVlvLPSRCMax" VALUE 0x8002955E Val_Wu16 65535.00 DFES_OneToOne 0.00 65535.00 /end CHARACTERISTIC
/begin CHARACTERISTIC DFES_DTCO.DFC_EGRVlvLPSRCMin_C "DFES/OBD spezifischer Fehlercode für Prüfung DFC_EGRVlvLPSRCMin" VALUE 0x80029560 Val_Wu16 65535.00 DFES_OneToOne 0.00 65535.00 /end CHARACTERISTIC
/begin CHARACTERISTIC DFES_DTCO.DFC_EGRVlvOL_C "DFES/OBD spezifischer Fehlercode für Prüfung DFC_EGRVlvOL" VALUE 0x80029562 Val_Wu16 65535.00 DFES_OneToOne 0.00 65535.00 /end CHARACTERISTIC
/begin CHARACTERISTIC DFES_DTCO.DFC_EGRVlvSCB_C "DFES/OBD spezifischer Fehlercode für Prüfung DFC_EGRVlvSCB" VALUE 0x80029564 Val_Wu16 65535.00 DFES_OneToOne 0.00 65535.00 /end CHARACTERISTIC
/begin CHARACTERISTIC DFES_DTCO.DFC_EGRVlvSCG_C "DFES/OBD spezifischer Fehlercode für Prüfung DFC_EGRVlvSCG" VALUE 0x80029566 Val_Wu16 65535.00 DFES_OneToOne 0.00 65535.00 /end CHARACTERISTIC
/begin CHARACTERISTIC DFES_DTCO.DFC_EGRVlvSRCMax_C "DFES/OBD spezifischer Fehlercode für Prüfung DFC_EGRVlvSRCMax" VALUE 0x80029568 Val_Wu16 65535.00 DFES_OneToOne 0.00 65535.00 /end CHARACTERISTIC
/begin CHARACTERISTIC DFES_DTCO.DFC_EGRVlvSRCMin_C "DFES/OBD spezifischer Fehlercode für Prüfung DFC_EGRVlvSRCMin" VALUE 0x8002956A Val_Wu16 65535.00 DFES_OneToOne 0.00 65535.00 /end CHARACTERISTIC
/begin CHARACTERISTIC DFES_DTCO.DFC_EngPrtOvrSpd_C "DFES/OBD spezifischer Fehlercode für Prüfung DFC_EngPrtOvrSpd" VALUE 0x8002956C Val_Wu16 65535.00 DFES_OneToOne 0.00 65535.00 /end CHARACTERISTIC
/begin CHARACTERISTIC DFES_DTCO.DFC_EngSpdOL_C "DFES/OBD spezifischer Fehlercode für Prüfung DFC_EngSpdOL" VALUE 0x8002956E Val_Wu16 65535.00 DFES_OneToOne 0.00 65535.00 /end CHARACTERISTIC
/begin CHARACTERISTIC DFES_DTCO.DFC_EngSpdSCB_C "DFES/OBD spezifischer Fehlercode für Prüfung DFC_EngSpdSCB" VALUE 0x80029570 Val_Wu16 65535.00 DFES_OneToOne 0.00 65535.00 /end CHARACTERISTIC
/begin CHARACTERISTIC DFES_DTCO.DFC_EngSpdSCG_C "DFES/OBD spezifischer Fehlercode für Prüfung DFC_EngSpdSCG" VALUE 0x80029572 Val_Wu16 65535.00 DFES_OneToOne 0.00 65535.00 /end CHARACTERISTIC
/begin CHARACTERISTIC DFES_DTCO.DFC_EnhSRCMaxPPFltDiff_C "DFES/OBD spezifischer Fehlercode für Prüfung DFC_EnhSRCMaxPPFltDiff" VALUE 0x80029574 Val_Wu16 65535.00 DFES_OneToOne 0.00 65535.00 /end CHARACTERISTIC
/begin CHARACTERISTIC DFES_DTCO.DFC_EnhSRCMaxT1ExhTMon_C "DFES/OBD spezifischer Fehlercode für Prüfung DFC_EnhSRCMaxT1ExhTMon" VALUE 0x80029576 Val_Wu16 65535.00 DFES_OneToOne 0.00 65535.00 /end CHARACTERISTIC
/begin CHARACTERISTIC DFES_DTCO.DFC_EnhSRCMaxT2ExhTMon_C "DFES/OBD spezifischer Fehlercode für Prüfung DFC_EnhSRCMaxT2ExhTMon" VALUE 0x80029578 Val_Wu16 65535.00 DFES_OneToOne 0.00 65535.00 /end CHARACTERISTIC
/begin CHARACTERISTIC DFES_DTCO.DFC_EnhSRCMaxT3ExhTMon_C "DFES/OBD spezifischer Fehlercode für Prüfung DFC_EnhSRCMaxT3ExhTMon" VALUE 0x8002957A Val_Wu16 65535.00 DFES_OneToOne 0.00 65535.00 /end CHARACTERISTIC
/begin CHARACTERISTIC DFES_DTCO.DFC_EnhSRCMinPPFltDiff_C "DFES/OBD spezifischer Fehlercode für Prüfung DFC_EnhSRCMinPPFltDiff" VALUE 0x8002957C Val_Wu16 65535.00 DFES_OneToOne 0.00 65535.00 /end CHARACTERISTIC
/begin CHARACTERISTIC DFES_DTCO.DFC_EnhSRCMinT1ExhTMon_C "DFES/OBD spezifischer Fehlercode für Prüfung DFC_EnhSRCMinT1ExhTMon" VALUE 0x8002957E Val_Wu16 65535.00 DFES_OneToOne 0.00 65535.00 /end CHARACTERISTIC
/begin CHARACTERISTIC DFES_DTCO.DFC_EnhSRCMinT2ExhTMon_C "DFES/OBD spezifischer Fehlercode für Prüfung DFC_EnhSRCMinT2ExhTMon" VALUE 0x80029580 Val_Wu16 65535.00 DFES_OneToOne 0.00 65535.00 /end CHARACTERISTIC
/begin CHARACTERISTIC DFES_DTCO.DFC_EnhSRCMinT3ExhTMon_C "DFES/OBD spezifischer Fehlercode für Prüfung DFC_EnhSRCMinT3ExhTMon" VALUE 0x80029582 Val_Wu16 65535.00 DFES_OneToOne 0.00 65535.00 /end CHARACTERISTIC
/begin CHARACTERISTIC DFES_DTCO.DFC_EnvPSRCMax_C "DFES/OBD spezifischer Fehlercode für Prüfung DFC_EnvPSRCMax" VALUE 0x80029584 Val_Wu16 65535.00 DFES_OneToOne 0.00 65535.00 /end CHARACTERISTIC
/begin CHARACTERISTIC DFES_DTCO.DFC_EnvPSRCMin_C "DFES/OBD spezifischer Fehlercode für Prüfung DFC_EnvPSRCMin" VALUE 0x80029586 Val_Wu16 65535.00 DFES_OneToOne 0.00 65535.00 /end CHARACTERISTIC
/begin CHARACTERISTIC DFES_DTCO.DFC_ExhTMonPlaus_C "DFES/OBD spezifischer Fehlercode für Prüfung DFC_ExhTMonPlaus" VALUE 0x80029588 Val_Wu16 65535.00 DFES_OneToOne 0.00 65535.00 /end CHARACTERISTIC
/begin CHARACTERISTIC DFES_DTCO.DFC_ExhTMonPlausPos1_C "DFES/OBD spezifischer Fehlercode für Prüfung DFC_ExhTMonPlausPos1" VALUE 0x8002958A Val_Wu16 65535.00 DFES_OneToOne 0.00 65535.00 /end CHARACTERISTIC
/begin CHARACTERISTIC DFES_DTCO.DFC_ExhTMonPlausPos2_C "DFES/OBD spezifischer Fehlercode für Prüfung DFC_ExhTMonPlausPos2" VALUE 0x8002958C Val_Wu16 65535.00 DFES_OneToOne 0.00 65535.00 /end CHARACTERISTIC
/begin CHARACTERISTIC DFES_DTCO.DFC_ExhTMonPlausPos3_C "DFES/OBD spezifischer Fehlercode für Prüfung DFC_ExhTMonPlausPos3" VALUE 0x8002958E Val_Wu16 65535.00 DFES_OneToOne 0.00 65535.00 /end CHARACTERISTIC
/begin CHARACTERISTIC DFES_DTCO.DFC_ExhTMonT1Plaus_C "DFES/OBD spezifischer Fehlercode für Prüfung DFC_ExhTMonT1Plaus" VALUE 0x80029590 Val_Wu16 65535.00 DFES_OneToOne 0.00 65535.00 /end CHARACTERISTIC
/begin CHARACTERISTIC DFES_DTCO.DFC_ExhTMonT2Plaus_C "DFES/OBD spezifischer Fehlercode für Prüfung DFC_ExhTMonT2Plaus" VALUE 0x80029592 Val_Wu16 65535.00 DFES_OneToOne 0.00 65535.00 /end CHARACTERISTIC
/begin CHARACTERISTIC DFES_DTCO.DFC_ExhTMonT3Plaus_C "DFES/OBD spezifischer Fehlercode für Prüfung DFC_ExhTMonT3Plaus" VALUE 0x80029594 Val_Wu16 65535.00 DFES_OneToOne 0.00 65535.00 /end CHARACTERISTIC
/begin CHARACTERISTIC DFES_DTCO.DFC_FlFltDsPSRCMax_C "DFES/OBD spezifischer Fehlercode für Prüfung DFC_FlFltDsPSRCMax" VALUE 0x80029596 Val_Wu16 65535.00 DFES_OneToOne 0.00 65535.00 /end CHARACTERISTIC
/begin CHARACTERISTIC DFES_DTCO.DFC_FlFltDsPSRCMin_C "DFES/OBD spezifischer Fehlercode für Prüfung DFC_FlFltDsPSRCMin" VALUE 0x80029598 Val_Wu16 65535.00 DFES_OneToOne 0.00 65535.00 /end CHARACTERISTIC
/begin CHARACTERISTIC DFES_DTCO.DFC_FlFltSig_C "DFES/OBD spezifischer Fehlercode für Prüfung DFC_FlFltSig" VALUE 0x8002959A Val_Wu16 65535.00 DFES_OneToOne 0.00 65535.00 /end CHARACTERISTIC
/begin CHARACTERISTIC DFES_DTCO.DFC_FlFltUsPSRCMax_C "DFES/OBD spezifischer Fehlercode für Prüfung DFC_FlFltUsPSRCMax" VALUE 0x8002959C Val_Wu16 65535.00 DFES_OneToOne 0.00 65535.00 /end CHARACTERISTIC
/begin CHARACTERISTIC DFES_DTCO.DFC_FlFltUsPSRCMin_C "DFES/OBD spezifischer Fehlercode für Prüfung DFC_FlFltUsPSRCMin" VALUE 0x8002959E Val_Wu16 65535.00 DFES_OneToOne 0.00 65535.00 /end CHARACTERISTIC
/begin CHARACTERISTIC DFES_DTCO.DFC_FuelTSRCMax_C "DFES/OBD spezifischer Fehlercode für Prüfung DFC_FuelTSRCMax" VALUE 0x800295A0 Val_Wu16 65535.00 DFES_OneToOne 0.00 65535.00 /end CHARACTERISTIC
/begin CHARACTERISTIC DFES_DTCO.DFC_FuelTSRCMin_C "DFES/OBD spezifischer Fehlercode für Prüfung DFC_FuelTSRCMin" VALUE 0x800295A2 Val_Wu16 65535.00 DFES_OneToOne 0.00 65535.00 /end CHARACTERISTIC
/begin CHARACTERISTIC DFES_DTCO.DFC_GbxNPosPPerSRCMax_C "DFES/OBD spezifischer Fehlercode für Prüfung DFC_GbxNPosPPerSRCMax" VALUE 0x800295A4 Val_Wu16 65535.00 DFES_OneToOne 0.00 65535.00 /end CHARACTERISTIC
/begin CHARACTERISTIC DFES_DTCO.DFC_GbxNPosPPerSRCMin_C "DFES/OBD spezifischer Fehlercode für Prüfung DFC_GbxNPosPPerSRCMin" VALUE 0x800295A6 Val_Wu16 65535.00 DFES_OneToOne 0.00 65535.00 /end CHARACTERISTIC
/begin CHARACTERISTIC DFES_DTCO.DFC_GbxNPosPdcycSRCMax_C "DFES/OBD spezifischer Fehlercode für Prüfung DFC_GbxNPosPdcycSRCMax" VALUE 0x800295A8 Val_Wu16 65535.00 DFES_OneToOne 0.00 65535.00 /end CHARACTERISTIC
/begin CHARACTERISTIC DFES_DTCO.DFC_GbxNPosPdcycSRCMin_C "DFES/OBD spezifischer Fehlercode für Prüfung DFC_GbxNPosPdcycSRCMin" VALUE 0x800295AA Val_Wu16 65535.00 DFES_OneToOne 0.00 65535.00 /end CHARACTERISTIC
/begin CHARACTERISTIC DFES_DTCO.DFC_InjVlvPresMin_C "DFES/OBD spezifischer Fehlercode für Prüfung DFC_InjVlvPresMin" VALUE 0x800295AC Val_Wu16 65535.00 DFES_OneToOne 0.00 65535.00 /end CHARACTERISTIC
/begin CHARACTERISTIC DFES_DTCO.DFC_LSUCircNernstSig_C "DFES/OBD spezifischer Fehlercode für Prüfung DFC_LSUCircNernstSig" VALUE 0x800295AE Val_Wu16 65535.00 DFES_OneToOne 0.00 65535.00 /end CHARACTERISTIC
/begin CHARACTERISTIC DFES_DTCO.DFC_LSUCircPmpCurSig_C "DFES/OBD spezifischer Fehlercode für Prüfung DFC_LSUCircPmpCurSig" VALUE 0x800295B0 Val_Wu16 65535.00 DFES_OneToOne 0.00 65535.00 /end CHARACTERISTIC
/begin CHARACTERISTIC DFES_DTCO.DFC_LSUCircVirtGndSig_C "DFES/OBD spezifischer Fehlercode für Prüfung DFC_LSUCircVirtGndSig" VALUE 0x800295B2 Val_Wu16 65535.00 DFES_OneToOne 0.00 65535.00 /end CHARACTERISTIC
/begin CHARACTERISTIC DFES_DTCO.DFC_LSUO2Max_C "DFES/OBD spezifischer Fehlercode für Prüfung DFC_LSUO2Max" VALUE 0x800295B4 Val_Wu16 65535.00 DFES_OneToOne 0.00 65535.00 /end CHARACTERISTIC
/begin CHARACTERISTIC DFES_DTCO.DFC_LSUO2Min_C "DFES/OBD spezifischer Fehlercode für Prüfung DFC_LSUO2Min" VALUE 0x800295B6 Val_Wu16 65535.00 DFES_OneToOne 0.00 65535.00 /end CHARACTERISTIC
/begin CHARACTERISTIC DFES_DTCO.DFC_LSUSPIBattLowMin_C "DFES/OBD spezifischer Fehlercode für Prüfung DFC_LSUSPIBattLowMin" VALUE 0x800295B8 Val_Wu16 65535.00 DFES_OneToOne 0.00 65535.00 /end CHARACTERISTIC
/begin CHARACTERISTIC DFES_DTCO.DFC_LSUWireSCB_C "DFES/OBD spezifischer Fehlercode für Prüfung DFC_LSUWireSCB" VALUE 0x800295BA Val_Wu16 65535.00 DFES_OneToOne 0.00 65535.00 /end CHARACTERISTIC
/begin CHARACTERISTIC DFES_DTCO.DFC_LSUWireSCG_C "DFES/OBD spezifischer Fehlercode für Prüfung DFC_LSUWireSCG" VALUE 0x800295BC Val_Wu16 65535.00 DFES_OneToOne 0.00 65535.00 /end CHARACTERISTIC
/begin CHARACTERISTIC DFES_DTCO.DFC_MeUnSCG_C "DFES/OBD spezifischer Fehlercode für Prüfung DFC_MeUnSCG" VALUE 0x800295BE Val_Wu16 65535.00 DFES_OneToOne 0.00 65535.00 /end CHARACTERISTIC
/begin CHARACTERISTIC DFES_DTCO.DFC_NSCDsCmpChk_C "DFES/OBD spezifischer Fehlercode für Prüfung DFC_NSCDsCmpChk" VALUE 0x800295C0 Val_Wu16 65535.00 DFES_OneToOne 0.00 65535.00 /end CHARACTERISTIC
/begin CHARACTERISTIC DFES_DTCO.DFC_NSCDsLamBinSRCMax_C "DFES/OBD spezifischer Fehlercode für Prüfung DFC_NSCDsLamBinSRCMax" VALUE 0x800295C2 Val_Wu16 65535.00 DFES_OneToOne 0.00 65535.00 /end CHARACTERISTIC
/begin CHARACTERISTIC DFES_DTCO.DFC_NSCDsLamBinSRCMin_C "DFES/OBD spezifischer Fehlercode für Prüfung DFC_NSCDsLamBinSRCMin" VALUE 0x800295C4 Val_Wu16 65535.00 DFES_OneToOne 0.00 65535.00 /end CHARACTERISTIC
/begin CHARACTERISTIC DFES_DTCO.DFC_NSCDsLamLinSRCMax_C "DFES/OBD spezifischer Fehlercode für Prüfung DFC_NSCDsLamLinSRCMax" VALUE 0x800295C6 Val_Wu16 65535.00 DFES_OneToOne 0.00 65535.00 /end CHARACTERISTIC
/begin CHARACTERISTIC DFES_DTCO.DFC_NSCDsLamLinSRCMin_C "DFES/OBD spezifischer Fehlercode für Prüfung DFC_NSCDsLamLinSRCMin" VALUE 0x800295C8 Val_Wu16 65535.00 DFES_OneToOne 0.00 65535.00 /end CHARACTERISTIC
/begin CHARACTERISTIC DFES_DTCO.DFC_NSCDsLamPlausMax_C "DFES/OBD spezifischer Fehlercode für Prüfung DFC_NSCDsLamPlausMax" VALUE 0x800295CA Val_Wu16 65535.00 DFES_OneToOne 0.00 65535.00 /end CHARACTERISTIC
/begin CHARACTERISTIC DFES_DTCO.DFC_NSCDsLamPlausMin_C "DFES/OBD spezifischer Fehlercode für Prüfung DFC_NSCDsLamPlausMin" VALUE 0x800295CC Val_Wu16 65535.00 DFES_OneToOne 0.00 65535.00 /end CHARACTERISTIC
/begin CHARACTERISTIC DFES_DTCO.DFC_NSCDsNOxSRCMax_C "DFES/OBD spezifischer Fehlercode für Prüfung DFC_NSCDsNOxSRCMax" VALUE 0x800295CE Val_Wu16 65535.00 DFES_OneToOne 0.00 65535.00 /end CHARACTERISTIC
/begin CHARACTERISTIC DFES_DTCO.DFC_NSCDsNOxSRCMin_C "DFES/OBD spezifischer Fehlercode für Prüfung DFC_NSCDsNOxSRCMin" VALUE 0x800295D0 Val_Wu16 65535.00 DFES_OneToOne 0.00 65535.00 /end CHARACTERISTIC
/begin CHARACTERISTIC DFES_DTCO.DFC_NSCDsOpCir_C "DFES/OBD spezifischer Fehlercode für Prüfung DFC_NSCDsOpCir" VALUE 0x800295D2 Val_Wu16 65535.00 DFES_OneToOne 0.00 65535.00 /end CHARACTERISTIC
/begin FUNCTION DFES ""
 /begin DEF_CHARACTERISTIC DFES_DTCM.DFC_IVActrEnrgMax_6_C DFES_DTCM.DFC_IVActrEnrgMax_7_C DFES_DTCM.DFC_IVActrEnrgMin_0_C DFES_DTCM.DFC_IVActrEnrgMin_1_C DFES_DTCM.DFC_IVActrEnrgMin_2_C DFES_DTCM.DFC_IVActrEnrgMin_3_C DFES_DTCM.DFC_IVActrEnrgMin_4_C DFES_DTCM.DFC_IVActrEnrgMin_5_C DFES_DTCM.DFC_IVActrEnrgMin_6_C DFES_DTCM.DFC_IVActrEnrgMin_7_C DFES_DTCM.DFC_IVActrEnrgPlaus_0_C DFES_DTCM.DFC_IVActrEnrgPlaus_1_C DFES_DTCM.DFC_IVActrEnrgPlaus_2_C DFES_DTCM.DFC_IVActrEnrgPlaus_3_C DFES_DTCM.DFC_IVActrEnrgPlaus_4_C DFES_DTCM.DFC_IVActrEnrgPlaus_5_C DFES_DTCM.DFC_IVActrEnrgPlaus_6_C DFES_DTCM.DFC_IVActrEnrgPlaus_7_C DFES_DTCM.DFC_IVCtlTiDiff_0_C DFES_DTCM.DFC_IVCtlTiDiff_1_C DFES_DTCM.DFC_IVCtlTiDiff_2_C DFES_DTCM.DFC_IVCtlTiDiff_3_C DFES_DTCM.DFC_IVCtlTiDiff_4_C DFES_DTCM.DFC_IVCtlTiDiff_5_C DFES_DTCM.DFC_IVCtlUDiffUp_0_C DFES_DTCM.DFC_IVCtlUDiffUp_1_C DFES_DTCM.DFC_IVCtlUDiffUp_2_C DFES_DTCM.DFC_IVCtlUDiffUp_3_C DFES_DTCM.DFC_IVCtlUDiffUp_4_C DFES_DTCM.DFC_IVCtlUDiffUp_5_C DFES_DTCM.DFC_IVCtlUUp_0_C DFES_DTCM.DFC_IVCtlUUp_1_C DFES_DTCM.DFC_IVCtlUUp_2_C DFES_DTCM.DFC_IVCtlUUp_3_C DFES_DTCM.DFC_IVCtlUUp_4_C DFES_DTCM.DFC_IVCtlUUp_5_C DFES_DTCM.DFC_IVDiaBnkShCir_0_C DFES_DTCM.DFC_IVDiaBnkShCir_1_C DFES_DTCM.DFC_IVDiaBnkShCirChSwt_0_C DFES_DTCM.DFC_IVDiaBnkShCirChSwt_1_C DFES_DTCM.DFC_IVDiaChp_0_C DFES_DTCM.DFC_IVDiaChp_1_C DFES_DTCM.DFC_IVDiaCylNoCls_0_C DFES_DTCM.DFC_IVDiaCylNoCls_1_C DFES_DTCM.DFC_IVDiaCylNoCls_2_C DFES_DTCM.DFC_IVDiaCylNoCls_3_C DFES_DTCM.DFC_IVDiaCylNoCls_4_C DFES_DTCM.DFC_IVDiaCylNoCls_5_C DFES_DTCM.DFC_IVDiaCylNoLd_0_C DFES_DTCM.DFC_IVDiaCylNoLd_1_C DFES_DTCM.DFC_IVDiaCylNoLd_2_C DFES_DTCM.DFC_IVDiaCylNoLd_3_C DFES_DTCM.DFC_IVDiaCylNoLd_4_C DFES_DTCM.DFC_IVDiaCylNoLd_5_C DFES_DTCM.DFC_IVDiaCylShCir_0_C DFES_DTCM.DFC_IVDiaCylShCir_1_C DFES_DTCM.DFC_IVDiaCylShCir_2_C DFES_DTCM.DFC_IVDiaCylShCir_3_C DFES_DTCM.DFC_IVDiaCylShCir_4_C DFES_DTCM.DFC_IVDiaCylShCir_5_C DFES_DTCM.DFC_IVDiaCylShCirHSLS_0_C DFES_DTCM.DFC_IVDiaCylShCirHSLS_1_C DFES_DTCM.DFC_IVDiaCylShCirHSLS_2_C DFES_DTCM.DFC_IVDiaCylShCirHSLS_3_C DFES_DTCM.DFC_IVDiaCylShCirHSLS_4_C DFES_DTCM.DFC_IVDiaCylShCirHSLS_5_C DFES_DTCM.DFC_IVDiaCylShCirMeas_0_C DFES_DTCM.DFC_IVDiaCylShCirMeas_1_C DFES_DTCM.DFC_IVDiaCylShCirMeas_2_C DFES_DTCM.DFC_IVDiaCylShCirMeas_3_C DFES_DTCM.DFC_IVDiaCylShCirMeas_4_C DFES_DTCM.DFC_IVDiaCylShCirMeas_5_C DFES_DTCM.DFC_LSUDynChk_C DFES_DTCM.DFC_LSUO2ClbMax_C DFES_DTCM.DFC_LSUO2ClbMin_C DFES_DTCM.DFC_LSUO2PlausMaxFLd_C DFES_DTCM.DFC_LSUO2PlausMaxOvrRun_C DFES_DTCM.DFC_LSUO2PlausMaxPartLd_C DFES_DTCM.DFC_LSUO2PlausMinFLd_C DFES_DTCM.DFC_LSUO2PlausMinOvrRun_C DFES_DTCM.DFC_LSUO2PlausMinPartLd_C DFES_DTCM.DFC_LSURiClbMax_C DFES_DTCM.DFC_LSURiClbMin_C DFES_DTCM.DFC_LSUWireIPSig_C DFES_DTCM.DFC_Layer_BSDMax_C DFES_DTCM.DFC_Layer_BSDMin_C DFES_DTCM.DFC_Layer_BSDNpl_C DFES_DTCM.DFC_Layer_BSDSig_C DFES_DTCM.DFC_Layer_FltMngTstMax_C DFES_DTCM.DFC_Layer_FltMngTstMin_C DFES_DTCM.DFC_Layer_FltMngTstNpl_C DFES_DTCM.DFC_Layer_FltMngTstSig_C DFES_DTCM.DFC_Layer_GENELBMax_C DFES_DTCM.DFC_Layer_GENELBMin_C DFES_DTCM.DFC_Layer_GENELBNpl_C DFES_DTCM.DFC_Layer_GENELBSig_C DFES_DTCM.DFC_Layer_GENELMax_C DFES_DTCM.DFC_Layer_GENELMin_C DFES_DTCM.DFC_Layer_GENELNpl_C DFES_DTCM.DFC_Layer_GENELSig_C DFES_DTCM.DFC_Layer_GENHTBMax_C DFES_DTCM.DFC_Layer_GENHTBMin_C DFES_DTCM.DFC_Layer_GENHTBNpl_C DFES_DTCM.DFC_Layer_GENHTBSig_C DFES_DTCM.DFC_Layer_GENHTMax_C DFES_DTCM.DFC_Layer_GENHTMin_C DFES_DTCM.DFC_Layer_GENHTNpl_C DFES_DTCM.DFC_Layer_GENHTSig_C DFES_DTCM.DFC_Layer_GENKOMMMax_C DFES_DTCM.DFC_Layer_GENKOMMMin_C DFES_DTCM.DFC_Layer_GENKOMMNpl_C DFES_DTCM.DFC_Layer_GENKOMMSig_C DFES_DTCM.DFC_Layer_GENMECHMax_C DFES_DTCM.DFC_Layer_GENMECHMin_C DFES_DTCM.DFC_Layer_GENMECHNpl_C DFES_DTCM.DFC_Layer_GENMECHSig_C DFES_DTCM.DFC_Layer_GENMax_C DFES_DTCM.DFC_Layer_GENMin_C DFES_DTCM.DFC_Layer_GENNpl_C DFES_DTCM.DFC_Layer_GENREGUPLMax_C DFES_DTCM.DFC_Layer_GENREGUPLMin_C DFES_DTCM.DFC_Layer_GENREGUPLNpl_C DFES_DTCM.DFC_Layer_GENREGUPLSig_C DFES_DTCM.DFC_Layer_GENSig_C DFES_DTCM.DFC_Layer_GENUPLMax_C DFES_DTCM.DFC_Layer_GENUPLMin_C DFES_DTCM.DFC_Layer_GENUPLNpl_C DFES_DTCM.DFC_Layer_GENUPLSig_C DFES_DTCM.DFC_Layer_IBS1Max_C DFES_DTCM.DFC_Layer_IBS1Min_C DFES_DTCM.DFC_Layer_IBS1Npl_C DFES_DTCM.DFC_Layer_IBS1Sig_C DFES_DTCM.DFC_Layer_IBS2Max_C DFES_DTCM.DFC_Layer_IBS2Min_C DFES_DTCM.DFC_Layer_IBS2Npl_C DFES_DTCM.DFC_Layer_IBS2Sig_C DFES_DTCM.DFC_Layer_IBS3Max_C DFES_DTCM.DFC_Layer_IBS3Min_C DFES_DTCM.DFC_Layer_IBS3Npl_C DFES_DTCM.DFC_Layer_IBS3Sig_C DFES_DTCM.DFC_Layer_MANDETEKMax_C DFES_DTCM.DFC_Layer_MANDETEKMin_C DFES_DTCM.DFC_Layer_MANDETEKNpl_C DFES_DTCM.DFC_Layer_MANDETEKSig_C DFES_DTCM.DFC_Layer_NDR1Max_C DFES_DTCM.DFC_Layer_NDR1Min_C DFES_DTCM.DFC_Layer_NDR1Npl_C DFES_DTCM.DFC_Layer_NDR1Sig_C DFES_DTCM.DFC_Layer_NDR2Max_C DFES_DTCM.DFC_Layer_NDR2Min_C DFES_DTCM.DFC_Layer_NDR2Npl_C DFES_DTCM.DFC_Layer_NDR2Sig_C DFES_DTCM.DFC_Layer_NGLERNMax_C DFES_DTCM.DFC_Layer_NGLERNMin_C DFES_DTCM.DFC_Layer_NGLERNNpl_C DFES_DTCM.DFC_Layer_NGLERNSig_C DFES_DTCM.DFC_Layer_PMBATTMax_C DFES_DTCM.DFC_Layer_PMBATTMin_C DFES_DTCM.DFC_Layer_PMBATTNpl_C DFES_DTCM.DFC_Layer_PMBATTSig_C DFES_DTCM.DFC_Layer_PMBNMax_C DFES_DTCM.DFC_Layer_PMBNMin_C DFES_DTCM.DFC_Layer_PMBNNpl_C DFES_DTCM.DFC_Layer_PMBNSig_C DFES_DTCM.DFC_Layer_PMRUHVERLMax_C DFES_DTCM.DFC_Layer_PMRUHVERLMin_C DFES_DTCM.DFC_Layer_PMRUHVERLNpl_C DFES_DTCM.DFC_Layer_PMRUHVERLSig_C DFES_DTCM.DFC_Layer_QLTMax_C DFES_DTCM.DFC_Layer_QLTMin_C DFES_DTCM.DFC_Layer_QLTNpl_C DFES_DTCM.DFC_Layer_QLTSig_C DFES_DTCM.DFC_Layer_TOENSMax_C DFES_DTCM.DFC_Layer_TOENSMin_C DFES_DTCM.DFC_Layer_TOENSNpl_C DFES_DTCM.DFC_Layer_TOENSSig_C DFES_DTCM.DFC_MonLimCurr_C DFES_DTCM.DFC_MonLimLead_C DFES_DTCM.DFC_MonLimSet_C DFES_DTCM.DFC_NSCDsNOxOfsMax_C DFES_DTCM.DFC_NSCDsNOxOfsMin_C DFES_DTCM.DFC_NSCDsNOxPlausMin_C DFES_DTCM.DFC_NoCat2DsNOxOfsMax_C DFES_DTCM.DFC_NoCat2DsNOxOfsMin_C DFES_DTCM.DFC_NoCat2DsNOxPlausMin_C DFES_DTCM.DFC_PCVNoStrt_C DFES_DTCM.DFC_RailPGradMon_C DFES_DTCM.DFC_SCRPODPresBuildUp_C DFES_DTCM.DFC_AFSDrftIdlAdjVal_C DFES_DTCM.DFC_AFSDrftLdAdjVal_C DFES_DTCM.DFC_AdcIADC0Cal_C DFES_DTCM.DFC_AdcIADC0Conv_C DFES_DTCM.DFC_AdcIADC1Cal_C DFES_DTCM.DFC_AdcIADC1Conv_C DFES_DTCM.DFC_CmbChbMisfireMax_0_C DFES_DTCM.DFC_CmbChbMisfireMax_1_C DFES_DTCM.DFC_CmbChbMisfireMax_2_C DFES_DTCM.DFC_CmbChbMisfireMax_3_C DFES_DTCM.DFC_CmbChbMisfireMax_4_C DFES_DTCM.DFC_CmbChbMisfireMax_5_C DFES_DTCM.DFC_CmbChbMisfireMul_C DFES_DTCM.DFC_EGRVlvLPOfsNeutr_C DFES_DTCM.DFC_EGRVlvOfsNeutr_C DFES_DTCM.DFC_FMAErrModMax_C DFES_DTCM.DFC_FMAErrModMin_C DFES_DTCM.DFC_FlSysTnkLo_C DFES_DTCM.DFC_GbxNPosPlaus_C DFES_DTCM.DFC_I14229_ROETst_Appl_C DFES_DTCM.DFC_I14229_ROETst_Netw_C DFES_DTCM.DFC_I14229_ROE_BufFull_C DFES_DTCM.DFC_IVAdjDiaIVAdj_C DFES_DTCM.DFC_IVAdjIVA_0_C DFES_DTCM.DFC_IVAdjIVA_1_C DFES_DTCM.DFC_IVAdjIVA_2_C DFES_DTCM.DFC_IVAdjIVA_3_C DFES_DTCM.DFC_IVAdjIVA_4_C DFES_DTCM.DFC_IVAdjIVA_5_C DFES_DTCM.DFC_IVPSplyDCDCOff_0_C DFES_DTCM.DFC_IVPSplyDCDCOff_1_C DFES_DTCM.DFC_IVPSplyDCDCOff_2_C DFES_DTCM.DFC_IVPSplyDCDCOff_3_C DFES_DTCM.DFC_InjCtlAdjQntEEPCS_C DFES_DTCM.DFC_LSUSPISig_C DFES_DTCM.DFC_Layer_Dummy_C DFES_DTCM.DFC_NplEnvPSensPPFltDiff_C DFES_DTCM.DFC_NplPresSensPPFltDiff_C DFES_DTCM.DFC_OilLvlPlaus_C DFES_DTCM.DFC_OilTOutLvl_C DFES_DTCM.DFC_PCVfacAdaptMax_C DFES_DTCM.DFC_PCVfacAdaptMin_C DFES_DTCM.DFC_SensFrzPPFltUs_C DFES_DTCM.DFC_SensMonUTnkLvl_C DFES_DTCM.DFC_T15Sig_C DFES_DTCM.DFC_AirCtlRmpTOut_C DFES_DTCM.DFC_BrkPPlaus_C DFES_DTCM.DFC_CEngDsTDynTst_C DFES_DTCM.DFC_EEPEraseErr_C DFES_DTCM.DFC_EEPRdErr_C DFES_DTCM.DFC_EEPWrErr_C DFES_DTCM.DFC_EGRVlvJamVlvClsd_C DFES_DTCM.DFC_EGRVlvJamVlvOpn_C DFES_DTCM.DFC_EGRVlvLPJamVlvClsd_C DFES_DTCM.DFC_EGRVlvLPJamVlvOpn_C DFES_DTCM.DFC_EGRVlvLPLgTDrft_C DFES_DTCM.DFC_EGRVlvLPOfsLrnJamVlv_C DFES_DTCM.DFC_EGRVlvLPShTDrft_C DFES_DTCM.DFC_EGRVlvLgTDrft_C DFES_DTCM.DFC_EGRVlvOfsLrnJamVlv_C DFES_DTCM.DFC_EGRVlvShTDrft_C DFES_DTCM.DFC_EngICO_C DFES_DTCM.DFC_EpmCaSI1ErrSig_C DFES_DTCM.DFC_EpmCaSI1NoSig_C DFES_DTCM.DFC_EpmCaSI1OfsErr_C DFES_DTCM.DFC_EpmCrSErrSig_C DFES_DTCM.DFC_EpmCrSNoSig_C DFES_DTCM.DFC_IVPlausComprTst_C DFES_DTCM.DFC_IVPlausRunUpTst_C DFES_DTCM.DFC_InjCrvShOffTst_C DFES_DTCM.DFC_LayerEnSavModProd_C DFES_DTCM.DFC_LayerEnSavModRep_C DFES_DTCM.DFC_LayerEnSavModShip_C DFES_DTCM.DFC_MRlyErlyOpng_C DFES_DTCM.DFC_MRlyStk_C DFES_DTCM.DFC_MeUnActrTst_C DFES_DTCM.DFC_MoCADCCmp_C DFES_DTCM.DFC_MoCADCTst_C DFES_DTCM.DFC_MoCADCVltgRatio_C DFES_DTCM.DFC_MoCComErrCnt_C DFES_DTCM.DFC_MoCComSPI_C DFES_DTCM.DFC_MoCROMErrXPg_C DFES_DTCM.DFC_MoCSOPHwNoRdy_C DFES_DTCM.DFC_MoCSOPLoLi_C DFES_DTCM.DFC_MoCSOPMM_C DFES_DTCM.DFC_MoCSOPTimeOut_C DFES_DTCM.DFC_MoCSOPUpLi_C DFES_DTCM.DFC_MoFAPP_C DFES_DTCM.DFC_MoFESpd_C DFES_DTCM.DFC_MoFInjDatPhi_C DFES_DTCM.DFC_MoFInjDatQnt_C DFES_DTCM.DFC_MoFInjQnt_C DFES_DTCM.DFC_MoFMode1PoI1_C DFES_DTCM.DFC_MoFMode1PoI2_C DFES_DTCM.DFC_MoFMode2PoI1_C DFES_DTCM.DFC_MoFMode2PoI2_C DFES_DTCM.DFC_MoFOvR_C DFES_DTCM.DFC_MoFQntCor_C DFES_DTCM.DFC_MoFRailP_C DFES_DTCM.DFC_MoFTrqCmp_C DFES_DTCM.DFC_NSCDsHtrSetP_C DFES_DTCM.DFC_NoCat2DsHtrSetP_C DFES_DTCM.DFC_PCVActrTst_C DFES_DTCM.DFC_PhyModNonMonMapNpl_C DFES_DTCM.DFC_RailHpTst_C DFES_DTCM.DFC_RailPOfsTstMax_C DFES_DTCM.DFC_RailPOfsTstMin_C DFES_DTCM.DFC_SIA_E1max_C DFES_DTCM.DFC_SIA_E1min_C DFES_DTCM.DFC_SIA_E1npl_C DFES_DTCM.DFC_SIA_E1sig_C DFES_DTCM.DFC_SIA_E2max_C DFES_DTCM.DFC_SIA_E2min_C DFES_DTCM.DFC_SIA_E2npl_C DFES_DTCM.DFC_SIA_E2sig_C DFES_DTCM.DFC_SIA_E3max_C DFES_DTCM.DFC_SIA_E3min_C DFES_DTCM.DFC_SIA_E3npl_C DFES_DTCM.DFC_SIA_E3sig_C DFES_DTCM.DFC_SIA_E4max_C DFES_DTCM.DFC_SIA_E4min_C DFES_DTCM.DFC_SIA_E4npl_C DFES_DTCM.DFC_SIA_E4sig_C DFES_DTCM.DFC_SWReset_0_C DFES_DTCM.DFC_SWReset_1_C DFES_DTCM.DFC_SWReset_2_C DFES_DTCM.DFC_ShtrAKKMax_C DFES_DTCM.DFC_ShtrAKKMin_C DFES_DTCM.DFC_ShtrAKKNpl_C DFES_DTCM.DFC_ShtrPKKMax_C DFES_DTCM.DFC_StopCntTmr_C DFES_DTCM.DFC_ThrVlvMon_C DFES_DTCM.DFC_VSwVlvJamVlv_C DFES_DTCM.DFC_VSwVlvLgTDrft_C DFES_DTCM.DFC_VSwVlvOfsLrnJamVlv_C DFES_DTCM.DFC_VSwVlvOfsNeutr_C DFES_DTCM.DFC_VSwVlvShTDrft_C DFES_DTCM.DFC_VSwVlvSpgDef_C DFES_DTCO.DFC_Unused_C DFES_DTCO.DFC_ACCIPlausDrvAst_C DFES_DTCO.DFC_ACCIPlausTrqDes_C DFES_DTCO.DFC_AirCtlGovDvtEOMMax_C DFES_DTCO.DFC_AirCtlGovDvtEOMMin_C DFES_DTCO.DFC_AirCtlGovDvtMax_C DFES_DTCO.DFC_AirCtlGovDvtMin_C DFES_DTCO.DFC_AirCtlGovLPDvtMax_C DFES_DTCO.DFC_AirCtlGovLPDvtMin_C DFES_DTCO.DFC_AltIOComErr_C DFES_DTCO.DFC_AltIOComNpl_C DFES_DTCO.DFC_BusDiagBusOffFlexRay_C DFES_DTCO.DFC_BusDiagBusOffNodeA_C DFES_DTCO.DFC_BusDiagBusOffNodeB_C DFES_DTCO.DFC_BusDiagBusOffNodeC_C DFES_DTCO.DFC_BusDiagHwFlexRay_C DFES_DTCO.DFC_Cj945SpiCom1_C DFES_DTCO.DFC_ComACDemandSig_FA_C DFES_DTCO.DFC_ComACDemandTo_FA_C DFES_DTCO.DFC_ComATempSig_FA_C DFES_DTCO.DFC_ComATempTo_FA_C DFES_DTCO.DFC_ComATempTo_FX_C DFES_DTCO.DFC_ComBrkTrqSumChk_FX_C DFES_DTCO.DFC_ComBrkTrqSumCtr_FX_C DFES_DTCO.DFC_ComBrkTrqSumTo_FX_C DFES_DTCO.DFC_ComBtnDrvDynChk_FX_C DFES_DTCO.DFC_ComBtnDrvDynCtr_FX_C DFES_DTCO.DFC_ComBtnDrvDynTo_FX_C DFES_DTCO.DFC_ComButtonMSASig_C DFES_DTCO.DFC_ComButtonMSATo_C DFES_DTCO.DFC_ComCodierungPwrmngSig_C DFES_DTCO.DFC_ComCodierungPwrmngSig_FA_C DFES_DTCO.DFC_ComCrCtlLvrChk_C DFES_DTCO.DFC_ComCrCtlLvrCtr_C DFES_DTCO.DFC_ComCrCtlLvrSig_C DFES_DTCO.DFC_ComCrCtlLvrTo_C DFES_DTCO.DFC_ComCtrCrshSwoEkpSig_FA_C DFES_DTCO.DFC_ComCtrCrshSwoEkpTo_FA_C DFES_DTCO.DFC_ComCtrSecInt_C DFES_DTCO.DFC_ComDiaOBDGbxSig_A_C DFES_DTCO.DFC_ComDiaOBDGbxTo_A_C DFES_DTCO.DFC_ComFahrzeugtypSig_C DFES_DTCO.DFC_ComFahrzeugtypSig_FA_C DFES_DTCO.DFC_ComFllupGpwsupSig_FA_C DFES_DTCO.DFC_ComFllupGpwsupTo_FA_C DFES_DTCO.DFC_ComGbxDataChk_A_C DFES_DTCO.DFC_ComGbxDataChk_FA_C DFES_DTCO.DFC_ComGbxDataCtr_A_C DFES_DTCO.DFC_ComGbxDataCtr_FA_C DFES_DTCO.DFC_ComGbxDataSig_A_C DFES_DTCO.DFC_ComGbxDataSig_FA_C DFES_DTCO.DFC_ComGbxDataTo_A_C DFES_DTCO.DFC_ComGbxDataTo_FA_C DFES_DTCO.DFC_ComKlemmenChk_FA_C DFES_DTCO.DFC_ComKlemmenCtr_FA_C DFES_DTCO.DFC_ComKlemmenSig_FA_C DFES_DTCO.DFC_ComKlemmenTo_FA_C DFES_DTCO.DFC_ComLenkradwinkelSig_C DFES_DTCO.DFC_ComLenkradwinkelTo_C DFES_DTCO.DFC_ComMileageRangeSig_FA_C DFES_DTCO.DFC_ComMileageRangeTo_FA_C DFES_DTCO.DFC_ComPspSig_C DFES_DTCO.DFC_ComPspTo_C DFES_DTCO.DFC_ComRelTimeSig_FA_C DFES_DTCO.DFC_ComRelTimeTo_FA_C DFES_DTCO.DFC_ComRequestEMFChk_C DFES_DTCO.DFC_ComRequestEMFCtr_C DFES_DTCO.DFC_ComRequestEMFSig_C DFES_DTCO.DFC_ComRequestEMFTo_C DFES_DTCO.DFC_ComRpmWhlChk_FX_C DFES_DTCO.DFC_ComRpmWhlCtr_FX_C DFES_DTCO.DFC_ComRpmWhlTo_FX_C DFES_DTCO.DFC_ComSecCtrRelSig_FA_C DFES_DTCO.DFC_ComSecCtrRelTo_FA_C DFES_DTCO.DFC_ComSensNOxGndSig_C DFES_DTCO.DFC_ComSensNOxGndTo_C DFES_DTCO.DFC_ComSensNOxMode_C DFES_DTCO.DFC_ComSensNOxUbattSig_C DFES_DTCO.DFC_ComSensNOxUbattTo_C DFES_DTCO.DFC_ComShiftPaddleTo_FX_C DFES_DTCO.DFC_ComShutOffPSPSig_C DFES_DTCO.DFC_ComShutOffPSPTo_C DFES_DTCO.DFC_ComSlrdiGlbFZMTo_FA_C DFES_DTCO.DFC_ComSlrdiGlbFZMTo_FX_C DFES_DTCO.DFC_ComSpeedVehicleChk_FX_C DFES_DTCO.DFC_ComSpeedVehicleCtr_FX_C DFES_DTCO.DFC_ComSpeedVehicleTo_FX_C DFES_DTCO.DFC_ComStConintDSCChk_FX_C DFES_DTCO.DFC_ComStConintDSCCtr_FX_C DFES_DTCO.DFC_ComStConintDSCTo_FX_C DFES_DTCO.DFC_ComStatACFrontSig_FA_C DFES_DTCO.DFC_ComStatACFrontTo_FA_C DFES_DTCO.DFC_ComStatEkpSig_A_C DFES_DTCO.DFC_ComStatEkpTo_A_C DFES_DTCO.DFC_ComStatGearRevSig_FA_C DFES_DTCO.DFC_ComStatGearRevTo_FA_C DFES_DTCO.DFC_ComStatZVKlappenSig_FA_C DFES_DTCO.DFC_ComStatZVKlappenTo_FA_C DFES_DTCO.DFC_ComStateARSCtr_C DFES_DTCO.DFC_ComStateARSSig_C DFES_DTCO.DFC_ComStateARSTo_C DFES_DTCO.DFC_ComStateDscSig_C DFES_DTCO.DFC_ComStateDscTo_C DFES_DTCO.DFC_ComStateSeatSig_C DFES_DTCO.DFC_ComStateSeatSig_FA_C DFES_DTCO.DFC_ComStateSeatTo_C DFES_DTCO.DFC_ComStateSeatTo_FA_C DFES_DTCO.DFC_ComStatusEGSSig_A_C DFES_DTCO.DFC_ComStatusEGSSig_FA_C DFES_DTCO.DFC_ComStatusEGSTo_A_C DFES_DTCO.DFC_ComStatusEGSTo_FA_C DFES_DTCO.DFC_ComStatusEMFChk_C DFES_DTCO.DFC_ComStatusEMFCtr_C DFES_DTCO.DFC_ComStatusEMFSig_C DFES_DTCO.DFC_ComStatusEMFTo_C DFES_DTCO.DFC_ComStatusRGangSig_C DFES_DTCO.DFC_ComStatusRGangTo_C DFES_DTCO.DFC_ComSteeringAngleChk_FX_C DFES_DTCO.DFC_ComSteeringAngleCtr_FX_C DFES_DTCO.DFC_ComSteeringAngleTo_FX_C DFES_DTCO.DFC_ComTerminalChk_C DFES_DTCO.DFC_ComTerminalCtr_C DFES_DTCO.DFC_ComTerminalSig_C DFES_DTCO.DFC_ComTerminalTo_C DFES_DTCO.DFC_ComTimeDateSig_FA_C DFES_DTCO.DFC_ComTimeDateTo_FA_C DFES_DTCO.DFC_ComTrailerSig_C DFES_DTCO.DFC_ComTrailerSig_FA_C DFES_DTCO.DFC_ComTrailerTo_C DFES_DTCO.DFC_ComTrailerTo_FA_C DFES_DTCO.DFC_ComTrqDemCrshDrDyChk_FX_C DFES_DTCO.DFC_ComTrqDemCrshDrDyCtr_FX_C DFES_DTCO.DFC_ComTrqDemCrshDrDyTo_FX_C DFES_DTCO.DFC_ComTrqDemandDesSig_C DFES_DTCO.DFC_ComTrqDemandDesTo_C DFES_DTCO.DFC_ComTrqDemandDscChk_C DFES_DTCO.DFC_ComTrqDemandDscCtr_C DFES_DTCO.DFC_ComTrqDemandDscSig_C DFES_DTCO.DFC_ComTrqDemandDscTo_C DFES_DTCO.DFC_ComTrqDemandGbxChk_A_C DFES_DTCO.DFC_ComTrqDemandGbxChk_FA_C DFES_DTCO.DFC_ComTrqDemandGbxCtr_A_C DFES_DTCO.DFC_ComTrqDemandGbxCtr_FA_C DFES_DTCO.DFC_ComTrqDemandGbxSig_A_C DFES_DTCO.DFC_ComTrqDemandGbxSig_FA_C DFES_DTCO.DFC_ComTrqDemandGbxTo_A_C DFES_DTCO.DFC_ComTrqDemandGbxTo_FA_C DFES_DTCO.DFC_ComTrqWhlDemChk_C DFES_DTCO.DFC_ComTrqWhlDemCtr_C DFES_DTCO.DFC_ComTrqWhlDemFASChk_FX_C DFES_DTCO.DFC_ComTrqWhlDemFASCtr_FX_C DFES_DTCO.DFC_ComTrqWhlDemFASTo_FX_C DFES_DTCO.DFC_ComTrqWhlDemSig_C DFES_DTCO.DFC_ComTrqWhlDemTo_C DFES_DTCO.DFC_ComVelocityChk_FA_C DFES_DTCO.DFC_ComVelocityCtr_FA_C DFES_DTCO.DFC_ComVelocitySig_C DFES_DTCO.DFC_ComVelocitySig_FA_C DFES_DTCO.DFC_ComVelocityTo_C DFES_DTCO.DFC_ComVelocityTo_FA_C DFES_DTCO.DFC_ComVerbraucherTo_C DFES_DTCO.DFC_ComWMomPTStabChk_FX_C DFES_DTCO.DFC_ComWMomPTStabCtr_FX_C DFES_DTCO.DFC_ComWMomPTStabTo_FX_C DFES_DTCO.DFC_ComWheelSpeedSig_C DFES_DTCO.DFC_ComWheelSpeedTo_C DFES_DTCO.DFC_ComZvKlappenSig_C DFES_DTCO.DFC_ComZvKlappenTo_C DFES_DTCO.DFC_ComaDirectChk_FX_C DFES_DTCO.DFC_ComaDirectCtr_FX_C DFES_DTCO.DFC_ComaDirectTo_FX_C DFES_DTCO.DFC_ComaSideChk_FX_C DFES_DTCO.DFC_ComaSideCtr_FX_C DFES_DTCO.DFC_ComaSideTo_FX_C DFES_DTCO.DFC_Cy320SpiCom_C DFES_DTCO.DFC_ETCtlDvtInrMax_C DFES_DTCO.DFC_ETCtlDvtInrMin_C DFES_DTCO.DFC_ETCtlDvtOutrMax_C DFES_DTCO.DFC_ETCtlDvtOutrMin_C DFES_DTCO.DFC_FBCqDvtMax_C DFES_DTCO.DFC_FBCqDvtMin_C DFES_DTCO.DFC_Fan4WinErr1_C DFES_DTCO.DFC_Fan4WinErr2_C DFES_DTCO.DFC_Fan4WinErr3_C DFES_DTCO.DFC_Fan4WinErr4_C DFES_DTCO.DFC_FanSCG_C DFES_DTCO.DFC_FlFCBS_C DFES_DTCO.DFC_GlwEcuConfigErr_C DFES_DTCO.DFC_GlwEcuEepErr_C DFES_DTCO.DFC_GlwEcuFrmErr_C DFES_DTCO.DFC_GlwEcuGPCMFaultInfo_C DFES_DTCO.DFC_GlwEcuGPCMInfo_C DFES_DTCO.DFC_GlwEcuGk1HSS_C DFES_DTCO.DFC_GlwEcuGk1OL_C DFES_DTCO.DFC_GlwEcuGk1SC_C DFES_DTCO.DFC_GlwEcuGk1Wdst_C DFES_DTCO.DFC_GlwEcuGk2HSS_C DFES_DTCO.DFC_GlwEcuGk2OL_C DFES_DTCO.DFC_GlwEcuGk2SC_C DFES_DTCO.DFC_GlwEcuGk2Wdst_C DFES_DTCO.DFC_GlwEcuGk3HSS_C DFES_DTCO.DFC_GlwEcuGk3OL_C DFES_DTCO.DFC_GlwEcuGk3SC_C DFES_DTCO.DFC_GlwEcuGk3Wdst_C DFES_DTCO.DFC_GlwEcuGk4HSS_C DFES_DTCO.DFC_GlwEcuGk4OL_C DFES_DTCO.DFC_GlwEcuGk4SC_C DFES_DTCO.DFC_GlwEcuGk4Wdst_C DFES_DTCO.DFC_GlwEcuGk5HSS_C DFES_DTCO.DFC_GlwEcuGk5OL_C DFES_DTCO.DFC_GlwEcuGk5SC_C DFES_DTCO.DFC_GlwEcuGk5Wdst_C DFES_DTCO.DFC_GlwEcuGk6HSS_C DFES_DTCO.DFC_GlwEcuGk6OL_C DFES_DTCO.DFC_GlwEcuGk6SC_C DFES_DTCO.DFC_GlwEcuGk6Wdst_C DFES_DTCO.DFC_GlwEcuGndErr_C DFES_DTCO.DFC_GlwEcuIntErr_C DFES_DTCO.DFC_GlwEcuMsgTimeout_C DFES_DTCO.DFC_GlwEcuT30Err_C DFES_DTCO.DFC_GlwEcuTempErr_C DFES_DTCO.DFC_GlwEcuUdiffT30_C DFES_DTCO.DFC_IBSComErr_C DFES_DTCO.DFC_LubSRCOilFldtCrit_C DFES_DTCO.DFC_LubSRCOilFldtCritDflMin_C DFES_DTCO.DFC_LubSRCOilLvlCritMax_C DFES_DTCO.DFC_LubSRCOilLvlCritMin_C DFES_DTCO.DFC_LubSRCTot_C DFES_DTCO.DFC_MonUMaxSupply1_C DFES_DTCO.DFC_MonUMinSupply1_C DFES_DTCO.DFC_OilComNpl_C DFES_DTCO.DFC_PCBS_C DFES_DTCO.DFC_PCBSPFltChg_C DFES_DTCO.DFC_PCRGovDvtLPMax_C DFES_DTCO.DFC_PCRGovDvtLPMin_C DFES_DTCO.DFC_PCRGovDvtMax_C DFES_DTCO.DFC_PCRGovDvtMin_C DFES_DTCO.DFC_PFltAPSPlausMAX_C DFES_DTCO.DFC_PFltAPSPlausMIN_C DFES_DTCO.DFC_PFltBPSPlausMAX_C DFES_DTCO.DFC_PFltBPSPlausMIN_C DFES_DTCO.DFC_PFltOvldInhRgn_C DFES_DTCO.DFC_PFltOvldTrqLim_C DFES_DTCO.DFC_PFltPresPlausMAX_C DFES_DTCO.DFC_PFltPresPlausMIN_C DFES_DTCO.DFC_PFltTraRpmRdc_C DFES_DTCO.DFC_PFlt_tOxiPreMax_C DFES_DTCO.DFC_PFlt_tOxiPreMaxRgn_C DFES_DTCO.DFC_PFlt_tOxiPreNpl_C DFES_DTCO.DFC_PFlt_tPreMax_C DFES_DTCO.DFC_PFlt_tPreMaxRgn_C DFES_DTCO.DFC_PFlt_tPreNpl_C DFES_DTCO.DFC_PFltmSotDiffMAX_C DFES_DTCO.DFC_PFltmSotDiffMIN_C DFES_DTCO.DFC_PFltmSotDiffSIG_C DFES_DTCO.DFC_PIntkVUsEnvPPls_C DFES_DTCO.DFC_PresPlausDblDef_C DFES_DTCO.DFC_RailCPC1_C DFES_DTCO.DFC_RailCPC3_C DFES_DTCO.DFC_RailCPC4_C DFES_DTCO.DFC_RailMeUn0_C DFES_DTCO.DFC_RailMeUn1_C DFES_DTCO.DFC_RailMeUn2_C DFES_DTCO.DFC_RailMeUn22_C DFES_DTCO.DFC_RailMeUn3_C DFES_DTCO.DFC_RailMeUn4_C DFES_DTCO.DFC_RailMeUn42_C DFES_DTCO.DFC_RailMeUn5_C DFES_DTCO.DFC_RailPCV0_C DFES_DTCO.DFC_RailPCV1_C DFES_DTCO.DFC_RailPCV2_C DFES_DTCO.DFC_RailPCV22_C DFES_DTCO.DFC_RailPCV3_C DFES_DTCO.DFC_RailPCV4_C DFES_DTCO.DFC_RailPCV42_C DFES_DTCO.DFC_RailPMonStrt_C DFES_DTCO.DFC_SSpMon1_C DFES_DTCO.DFC_SSpMon2_C DFES_DTCO.DFC_SSpMon3_C DFES_DTCO.DFC_ThrVlv4WinErr1_C DFES_DTCO.DFC_ThrVlv4WinErr2_C DFES_DTCO.DFC_ThrVlv4WinErr3_C DFES_DTCO.DFC_ThrVlv4WinErr4_C DFES_DTCO.DFC_ThrVlvSCG_C DFES_DTCO.DFC_Tle6232Spi1_C DFES_DTCO.DFC_TrbCh4WinErr1_C DFES_DTCO.DFC_TrbCh4WinErr2_C DFES_DTCO.DFC_TrbCh4WinErr3_C DFES_DTCO.DFC_TrbCh4WinErr4_C DFES_DTCO.DFC_TrbChSCG_C DFES_DTCO.DFC_TrbChSRCMax_C DFES_DTCO.DFC_TrbChSRCMin_C DFES_DTCO.DFC_WaHtEl4WinErr1_C DFES_DTCO.DFC_WaHtEl4WinErr2_C DFES_DTCO.DFC_WaHtEl4WinErr3_C DFES_DTCO.DFC_WaHtEl4WinErr4_C DFES_DTCO.DFC_WaHtElSCG_C DFES_DTCO.DFC_ETClbETFltMax_0_C DFES_DTCO.DFC_ETClbETFltMax_1_C DFES_DTCO.DFC_ETClbETFltMax_2_C DFES_DTCO.DFC_ETClbETFltMax_3_C DFES_DTCO.DFC_ETClbETFltMax_4_C DFES_DTCO.DFC_ETClbETFltMax_5_C DFES_DTCO.DFC_ETClbETFltMin_0_C DFES_DTCO.DFC_ETClbETFltMin_1_C DFES_DTCO.DFC_ETClbETFltMin_2_C DFES_DTCO.DFC_ETClbETFltMin_3_C DFES_DTCO.DFC_ETClbETFltMin_4_C DFES_DTCO.DFC_ETClbETFltMin_5_C DFES_DTCO.DFC_InjCrvInjLimChrgBal_C DFES_DTCO.DFC_InjCrvInjLimQntBal_C DFES_DTCO.DFC_InjCrvInjLimSys_C DFES_DTCO.DFC_InjCrvNumInjRtmLim_C DFES_DTCO.DFC_LSUHtCoupSig_C DFES_DTCO.DFC_AFS_SSpShOffOL_C DFES_DTCO.DFC_AFS_SSpShOffOvrTemp_C DFES_DTCO.DFC_AFS_SSpShOffSCB_C DFES_DTCO.DFC_AFS_SSpShOffSCG_C DFES_DTCO.DFC_AirCCmprOL_C DFES_DTCO.DFC_AirCCmprOvrTemp_C DFES_DTCO.DFC_AirCCmprSCB_C DFES_DTCO.DFC_AirCCmprSCG_C DFES_DTCO.DFC_CByVlvOL_C DFES_DTCO.DFC_CByVlvOvrTemp_C DFES_DTCO.DFC_CByVlvSCB_C DFES_DTCO.DFC_CByVlvSCG_C DFES_DTCO.DFC_CThmstOL_C DFES_DTCO.DFC_CThmstOvrTemp_C DFES_DTCO.DFC_CThmstSCB_C DFES_DTCO.DFC_CThmstSCG_C DFES_DTCO.DFC_DSMDummy_C DFES_DTCO.DFC_EBxFanOL_C DFES_DTCO.DFC_EBxFanOvrTemp_C DFES_DTCO.DFC_EBxFanSCB_C DFES_DTCO.DFC_EBxFanSCG_C DFES_DTCO.DFC_ECBVlvOL_C DFES_DTCO.DFC_ECBVlvOvrTemp_C DFES_DTCO.DFC_ECBVlvSCB_C DFES_DTCO.DFC_ECBVlvSCG_C DFES_DTCO.DFC_EMDmpOL_0_C DFES_DTCO.DFC_EMDmpOL_1_C DFES_DTCO.DFC_EMDmpOvrTemp_0_C DFES_DTCO.DFC_EMDmpOvrTemp_1_C DFES_DTCO.DFC_EMDmpSCB_0_C DFES_DTCO.DFC_EMDmpSCB_1_C DFES_DTCO.DFC_EMDmpSCG_0_C DFES_DTCO.DFC_EMDmpSCG_1_C DFES_DTCO.DFC_EngStAOL_C DFES_DTCO.DFC_EngStAOvrTemp_C DFES_DTCO.DFC_EngStASCB_C DFES_DTCO.DFC_EngStASCG_C DFES_DTCO.DFC_FanOL_C DFES_DTCO.DFC_FanOvrTemp_C DFES_DTCO.DFC_FanSCB_C DFES_DTCO.DFC_FlFltHtOL_C DFES_DTCO.DFC_FlFltHtOvrTemp_C DFES_DTCO.DFC_FlFltHtSCB_C DFES_DTCO.DFC_FlFltHtSCG_C DFES_DTCO.DFC_LSUHtrMax_C DFES_DTCO.DFC_LSUHtrMin_C DFES_DTCO.DFC_LSUHtrNpl_C DFES_DTCO.DFC_LSUHtrSig_C DFES_DTCO.DFC_LSUtExcMax_C DFES_DTCO.DFC_LSUtExcMin_C DFES_DTCO.DFC_MeUnOL_C DFES_DTCO.DFC_MeUnSCB_C DFES_DTCO.DFC_MeUnSRCMax_C DFES_DTCO.DFC_MeUnSRCMin_C DFES_DTCO.DFC_PCVOL_C DFES_DTCO.DFC_PCVSCB_C DFES_DTCO.DFC_PCVSRCMax_C DFES_DTCO.DFC_PCVSRCMin_C DFES_DTCO.DFC_RailPSRCMax_C DFES_DTCO.DFC_RailPSRCMin_C DFES_DTCO.DFC_ShtrOL_C DFES_DTCO.DFC_ShtrOvrTemp_C DFES_DTCO.DFC_ShtrSCB_C DFES_DTCO.DFC_ShtrSCG_C DFES_DTCO.DFC_StrtOL_C DFES_DTCO.DFC_StrtOvrTemp_C DFES_DTCO.DFC_StrtSCB_C DFES_DTCO.DFC_StrtSCG_C DFES_DTCO.DFC_ThrVlvOL_C DFES_DTCO.DFC_ThrVlvOvrTemp_C DFES_DTCO.DFC_ThrVlvSCB_C DFES_DTCO.DFC_TrbChOL_C DFES_DTCO.DFC_TrbChOvrTemp_C DFES_DTCO.DFC_TrbChSCB_C DFES_DTCO.DFC_UDosVlvOL_C DFES_DTCO.DFC_UDosVlvOvrTemp_C DFES_DTCO.DFC_UDosVlvSCB_C DFES_DTCO.DFC_UDosVlvSCG_C DFES_DTCO.DFC_UPmpMotOL_C DFES_DTCO.DFC_UPmpMotOvrTemp_C DFES_DTCO.DFC_UPmpMotSCB_C DFES_DTCO.DFC_UPmpMotSCG_C DFES_DTCO.DFC_WaHtElOL_C DFES_DTCO.DFC_WaHtElOvrTemp_C DFES_DTCO.DFC_WaHtElSCB_C DFES_DTCO.DFC_IVActrUChSRCMax_C DFES_DTCO.DFC_IVActrUChSRCMin_C DFES_DTCO.DFC_IVActrVltgSRCMax_C DFES_DTCO.DFC_IVActrVltgSRCMin_C DFES_DTCO.DFC_IVDiaTunDet_C DFES_DTCO.DFC_IVPSplyStopDCDC_C DFES_DTCO.DFC_IVPSplyVltgSRCMax_C DFES_DTCO.DFC_IVPSplyVltgSRCMin_C DFES_DTCO.DFC_SCREtaErr_C DFES_DTCO.DFC_SCREtaErr1_C DFES_DTCO.DFC_SCREtaErr2_C DFES_DTCO.DFC_SCRMonMetCtlPresErr_C DFES_DTCO.DFC_SCRMonPresBuildUpErr_C DFES_DTCO.DFC_SCRMonPresRdcErr_C DFES_DTCO.DFC_AFSOffsDrftMax_C DFES_DTCO.DFC_AFSOffsDrftMin_C DFES_DTCO.DFC_AFSSRCCorMax_C DFES_DTCO.DFC_AFSSRCCorMin_C DFES_DTCO.DFC_AFSSRCRawMax_C DFES_DTCO.DFC_AFSSRCRawMin_C DFES_DTCO.DFC_AFSSetyDrftMax_C DFES_DTCO.DFC_AFSSetyDrftMin_C DFES_DTCO.DFC_AirCSwtNpl_C DFES_DTCO.DFC_AirCSwtSig_C DFES_DTCO.DFC_BattUSRCMax_C DFES_DTCO.DFC_BattUSRCMin_C DFES_DTCO.DFC_BrkNpl_C DFES_DTCO.DFC_BrkPSRCMax_C DFES_DTCO.DFC_BrkPSRCMin_C DFES_DTCO.DFC_CEngDsTSRCMax_C DFES_DTCO.DFC_CEngDsTSRCMin_C DFES_DTCO.DFC_CrCUIDet_C DFES_DTCO.DFC_ECBVlvSRCMax_C DFES_DTCO.DFC_ECBVlvSRCMin_C DFES_DTCO.DFC_ECUOvrTemp_C DFES_DTCO.DFC_EGRVlvGovDvtMax_C DFES_DTCO.DFC_EGRVlvGovDvtMin_C DFES_DTCO.DFC_EGRVlvHBrgOpnLd_C DFES_DTCO.DFC_EGRVlvHBrgOvrCurr_C DFES_DTCO.DFC_EGRVlvHBrgOvrTemp_C DFES_DTCO.DFC_EGRVlvHBrgShCirBatt1_C DFES_DTCO.DFC_EGRVlvHBrgShCirBatt2_C DFES_DTCO.DFC_EGRVlvHBrgShCirGnd1_C DFES_DTCO.DFC_EGRVlvHBrgShCirGnd2_C DFES_DTCO.DFC_EGRVlvHBrgShCirOvrLd_C DFES_DTCO.DFC_EGRVlvHBrgTempOvrCurr_C DFES_DTCO.DFC_EGRVlvHBrgUndrVltg_C DFES_DTCO.DFC_EGRVlvLPGovDvtMax_C DFES_DTCO.DFC_EGRVlvLPGovDvtMin_C DFES_DTCO.DFC_EGRVlvLPHBrgOpnLd_C DFES_DTCO.DFC_EGRVlvLPHBrgOvrCurr_C DFES_DTCO.DFC_EGRVlvLPHBrgOvrTemp_C DFES_DTCO.DFC_EGRVlvLPHBrgShCirBatt1_C DFES_DTCO.DFC_EGRVlvLPHBrgShCirBatt2_C DFES_DTCO.DFC_EGRVlvLPHBrgShCirGnd1_C DFES_DTCO.DFC_EGRVlvLPHBrgShCirGnd2_C DFES_DTCO.DFC_EGRVlvLPHBrgShCirOvrLd_C DFES_DTCO.DFC_EGRVlvLPHBrgTempOvrCurr_C DFES_DTCO.DFC_EGRVlvLPHBrgUndrVltg_C DFES_DTCO.DFC_EGRVlvLPOL_C DFES_DTCO.DFC_EGRVlvLPSCB_C DFES_DTCO.DFC_EGRVlvLPSCG_C DFES_DTCO.DFC_EGRVlvLPSRCMax_C DFES_DTCO.DFC_EGRVlvLPSRCMin_C DFES_DTCO.DFC_EGRVlvOL_C DFES_DTCO.DFC_EGRVlvSCB_C DFES_DTCO.DFC_EGRVlvSCG_C DFES_DTCO.DFC_EGRVlvSRCMax_C DFES_DTCO.DFC_EGRVlvSRCMin_C DFES_DTCO.DFC_EngPrtOvrSpd_C DFES_DTCO.DFC_EngSpdOL_C DFES_DTCO.DFC_EngSpdSCB_C DFES_DTCO.DFC_EngSpdSCG_C DFES_DTCO.DFC_EnhSRCMaxPPFltDiff_C DFES_DTCO.DFC_EnhSRCMaxT1ExhTMon_C DFES_DTCO.DFC_EnhSRCMaxT2ExhTMon_C DFES_DTCO.DFC_EnhSRCMaxT3ExhTMon_C DFES_DTCO.DFC_EnhSRCMinPPFltDiff_C DFES_DTCO.DFC_EnhSRCMinT1ExhTMon_C DFES_DTCO.DFC_EnhSRCMinT2ExhTMon_C DFES_DTCO.DFC_EnhSRCMinT3ExhTMon_C DFES_DTCO.DFC_EnvPSRCMax_C DFES_DTCO.DFC_EnvPSRCMin_C DFES_DTCO.DFC_ExhTMonPlaus_C DFES_DTCO.DFC_ExhTMonPlausPos1_C DFES_DTCO.DFC_ExhTMonPlausPos2_C DFES_DTCO.DFC_ExhTMonPlausPos3_C DFES_DTCO.DFC_ExhTMonT1Plaus_C DFES_DTCO.DFC_ExhTMonT2Plaus_C DFES_DTCO.DFC_ExhTMonT3Plaus_C DFES_DTCO.DFC_FlFltDsPSRCMax_C DFES_DTCO.DFC_FlFltDsPSRCMin_C DFES_DTCO.DFC_FlFltSig_C DFES_DTCO.DFC_FlFltUsPSRCMax_C DFES_DTCO.DFC_FlFltUsPSRCMin_C DFES_DTCO.DFC_FuelTSRCMax_C DFES_DTCO.DFC_FuelTSRCMin_C DFES_DTCO.DFC_GbxNPosPPerSRCMax_C DFES_DTCO.DFC_GbxNPosPPerSRCMin_C DFES_DTCO.DFC_GbxNPosPdcycSRCMax_C DFES_DTCO.DFC_GbxNPosPdcycSRCMin_C DFES_DTCO.DFC_InjVlvPresMin_C DFES_DTCO.DFC_LSUCircNernstSig_C DFES_DTCO.DFC_LSUCircPmpCurSig_C DFES_DTCO.DFC_LSUCircVirtGndSig_C DFES_DTCO.DFC_LSUO2Max_C DFES_DTCO.DFC_LSUO2Min_C DFES_DTCO.DFC_LSUSPIBattLowMin_C DFES_DTCO.DFC_LSUWireSCB_C DFES_DTCO.DFC_LSUWireSCG_C DFES_DTCO.DFC_MeUnSCG_C DFES_DTCO.DFC_NSCDsCmpChk_C DFES_DTCO.DFC_NSCDsLamBinSRCMax_C DFES_DTCO.DFC_NSCDsLamBinSRCMin_C DFES_DTCO.DFC_NSCDsLamLinSRCMax_C DFES_DTCO.DFC_NSCDsLamLinSRCMin_C DFES_DTCO.DFC_NSCDsLamPlausMax_C DFES_DTCO.DFC_NSCDsLamPlausMin_C DFES_DTCO.DFC_NSCDsNOxSRCMax_C DFES_DTCO.DFC_NSCDsNOxSRCMin_C DFES_DTCO.DFC_NSCDsOpCir_C /end DEF_CHARACTERISTIC
/end FUNCTION
/begin COMPU_METHOD DFES_OneToOne "" RAT_FUNC "%6.0" "-" COEFFS 0 1 0 0 0 1 /end COMPU_METHOD
/begin RECORD_LAYOUT Val_Wu16 FNC_VALUES 1 UWORD COLUMN_DIR DIRECT /end RECORD_LAYOUT
/end MODULE
/end PROJECT

ASAP2_VERSION 1 4
/begin PROJECT P_574 "EDC17_CP09"
/begin HEADER "" VERSION "V8KB" PROJECT_NO P_574 /end HEADER
/begin MODULE DIM ""
/begin MOD_COMMON "" BYTE_ORDER MSB_LAST ALIGNMENT_BYTE 1 ALIGNMENT_WORD 2 ALIGNMENT_LONG 4 ALIGNMENT_FLOAT32_IEEE 4 /end MOD_COMMON
/begin CHARACTERISTIC InjCrv_ctATSPiISel_C "Selektionsparameter für Arrayelement Ansauglufttemperatur (EngDa_tFld) für die Voreinspritzungen" VALUE 0x80044C9C Val_Wu8 3.00000000000 AirTempFldSel 0.00 3.00000000000 FORMAT "%13.11" /end CHARACTERISTIC
/begin CHARACTERISTIC InjCrv_ctCylPoI1Clsn_C "Nummer des kollidierenden Zylinders" VALUE 0x800489C2 Val_Wu8 255.0 OneToOne 0.00 255.0 /end CHARACTERISTIC
/begin CHARACTERISTIC InjCrv_facAPPiI1DynCorRgn_CUR "" CURVE 0x800436CC Kl_Xs16_Ws16 2.000000 Fact 0.00 2.000000 EXTENDED_LIMITS -4.000000 3.999878
 /begin AXIS_DESCR STD_AXIS EnvP_p Pres_hPa 6 0.00 3500.000 EXTENDED_LIMITS -32768.00 32767.00 DEPOSIT ABSOLUTE /end AXIS_DESCR
/end CHARACTERISTIC
/begin CHARACTERISTIC InjCrv_facAPPiI1DynCor_CUR "Kennlinie für atmosphärendruckabhängigen Gewichtungsfaktor der Voreinspritzung Pil1" CURVE 0x8004351A Kl_Xs16_Ws16 2.000000 Fact 0.00 2.000000 EXTENDED_LIMITS -4.000000 3.999878
 /begin AXIS_DESCR STD_AXIS EnvP_p Pres_hPa 8 0.00 3500.000 EXTENDED_LIMITS -32768.00 32767.00 DEPOSIT ABSOLUTE /end AXIS_DESCR
/end CHARACTERISTIC
/begin CHARACTERISTIC InjCrv_facAPPiI1DynQCorRgn_CUR "" CURVE 0x800436E6 Kl_Xs16_Ws16 2.000000 Fact 0.00 2.000000 EXTENDED_LIMITS -4.000000 3.999878
 /begin AXIS_DESCR STD_AXIS EnvP_p Pres_hPa 2 0.00 3500.000 EXTENDED_LIMITS -32768.00 32767.00 DEPOSIT ABSOLUTE /end AXIS_DESCR
/end CHARACTERISTIC
/begin CHARACTERISTIC InjCrv_facAPPiI1DynQCor_CUR "atmosphärendruckabhängiger Gewichtungsfaktor" CURVE 0x8004353C Kl_Xs16_Ws16 2.000000 Fact 0.00 2.000000 EXTENDED_LIMITS -4.000000 3.999878
 /begin AXIS_DESCR STD_AXIS EnvP_p Pres_hPa 8 0.00 3500.000 EXTENDED_LIMITS -32768.00 32767.00 DEPOSIT ABSOLUTE /end AXIS_DESCR
/end CHARACTERISTIC
/begin CHARACTERISTIC InjCrv_facAPPrPiI1DynCor_CUR "Dynamikkorrekturkennlinie für Pilotabstand PiI1 abhängig vom PWG Niveau" CURVE 0x8004215E Kl_Xs16_Ws16 4.000000 Fact -2.000000 2.000000 EXTENDED_LIMITS -4.000000 3.999878
 /begin AXIS_DESCR STD_AXIS APP_r Prc 8 0.00 100.0000 EXTENDED_LIMITS -400.0000 399.9878 DEPOSIT ABSOLUTE /end AXIS_DESCR
/end CHARACTERISTIC
/begin CHARACTERISTIC InjCrv_facAPPrPiI1DynQCor_CUR "Dynamikkorrekturkennlinie für Pilotmenge PiI1 abhängig vom PWG Niveau" CURVE 0x80042180 Kl_Xs16_Ws16 4.000000 Fact -2.000000 2.000000 EXTENDED_LIMITS -4.000000 3.999878
 /begin AXIS_DESCR STD_AXIS APP_r Prc 8 0.00 100.0000 EXTENDED_LIMITS -400.0000 399.9878 DEPOSIT ABSOLUTE /end AXIS_DESCR
/end CHARACTERISTIC
/begin CHARACTERISTIC InjCrv_facDQPiI1DynCorRgn_CUR "Kennlinie fuer Einspritzmengengradientenabhängiger Gewichtungsfaktor für Voreinspritzzeitkorrektur während Regeneration" CURVE 0x8004314A Kl_Xs16_Ws16 4.000000 Fact -2.000000 2.000000 EXTENDED_LIMITS -4.000000 3.999878
 /begin AXIS_DESCR STD_AXIS InjCrv_dqSetUnBalFltLim InjMassPerSec_20ms 6 -16384.00 16383.50 FORMAT "%8.2" DEPOSIT ABSOLUTE /end AXIS_DESCR
/end CHARACTERISTIC
/begin CHARACTERISTIC InjCrv_facDQPiI1DynCor_CUR "Gewichtungskennlinie, abhängig vom Einspritzmengengradianten" CURVE 0x800421A2 Kl_Xs16_Ws16 4.000000 Fact -2.000000 2.000000 EXTENDED_LIMITS -4.000000 3.999878
 /begin AXIS_DESCR STD_AXIS InjCrv_dqSetUnBalFltLim InjMassPerSec_20ms 8 -16384.00 16383.50 FORMAT "%8.2" DEPOSIT ABSOLUTE /end AXIS_DESCR
/end CHARACTERISTIC
/begin CHARACTERISTIC InjCrv_facDQPiI1DynQCorRgn_CUR "Kennlinie fuer einspritzmengengradientenabhängiger Gewichtungsfaktor für Voreinspitzmengenkorrektur" CURVE 0x80043164 Kl_Xs16_Ws16 4.000000 Fact -2.000000 2.000000 EXTENDED_LIMITS -4.000000 3.999878
 /begin AXIS_DESCR STD_AXIS InjCrv_dqSetUnBalFltLim InjMassPerSec_20ms 6 -16384.00 16383.50 FORMAT "%8.2" DEPOSIT ABSOLUTE /end AXIS_DESCR
/end CHARACTERISTIC
/begin CHARACTERISTIC InjCrv_facDQPiI1DynQCor_CUR "Korrekturfaktor für dynamische Korrektur der Quantität der Einspritzung PII1" CURVE 0x800421C4 Kl_Xs16_Ws16 4.000000 Fact -2.000000 2.000000 EXTENDED_LIMITS -4.000000 3.999878
 /begin AXIS_DESCR STD_AXIS InjCrv_dqSetUnBalFltLim InjMassPerSec_20ms 6 -16384.00 16383.50 FORMAT "%8.2" DEPOSIT ABSOLUTE /end AXIS_DESCR
/end CHARACTERISTIC
/begin CHARACTERISTIC InjCrv_facETPiI1DynCorRgn_CUR "" CURVE 0x800436F0 Kl_Xs16_Ws16 2.000000 Fact 0.00 2.000000 EXTENDED_LIMITS -4.000000 3.999878
 /begin AXIS_DESCR STD_AXIS InjSys_tEng Temp_Cels 6 -50.14000 199.8600 EXTENDED_LIMITS -3549.940 3003.560 DEPOSIT ABSOLUTE /end AXIS_DESCR
/end CHARACTERISTIC
/begin CHARACTERISTIC InjCrv_facETPiI1DynCor_CUR "Kennlinie für motortemperaturabhängigen Gewichtungsfaktor der Voreinspritzung Pil1" CURVE 0x8004355E Kl_Xs16_Ws16 2.000000 Fact 0.00 2.000000 EXTENDED_LIMITS -4.000000 3.999878
 /begin AXIS_DESCR STD_AXIS InjSys_tEng Temp_Cels 8 -50.14000 199.8600 EXTENDED_LIMITS -3549.940 3003.560 DEPOSIT ABSOLUTE /end AXIS_DESCR
/end CHARACTERISTIC
/begin CHARACTERISTIC InjCrv_facETPiI1DynQCorRgn_CUR "" CURVE 0x8004370A Kl_Xs16_Ws16 2.000000 Fact 0.00 2.000000 EXTENDED_LIMITS -4.000000 3.999878
 /begin AXIS_DESCR STD_AXIS InjSys_tEng Temp_Cels 6 -50.14000 199.8600 EXTENDED_LIMITS -3549.940 3003.560 DEPOSIT ABSOLUTE /end AXIS_DESCR
/end CHARACTERISTIC
/begin CHARACTERISTIC InjCrv_facETPiI1DynQCor_CUR "Kennlinie für motortemperaturabhängigen Gewichtungsfaktor" CURVE 0x80043580 Kl_Xs16_Ws16 2.000000 Fact 0.00 2.000000 EXTENDED_LIMITS -4.000000 3.999878
 /begin AXIS_DESCR STD_AXIS InjSys_tEng Temp_Cels 8 -50.14000 199.8600 EXTENDED_LIMITS -3549.940 3003.560 DEPOSIT ABSOLUTE /end AXIS_DESCR
/end CHARACTERISTIC
/begin CHARACTERISTIC InjCrv_facIAPiI1DynCorRgn_CUR "" CURVE 0x80043724 Kl_Xs16_Ws16 2.000000 Fact 0.00 2.000000 EXTENDED_LIMITS -4.000000 3.999878
 /begin AXIS_DESCR STD_AXIS InjCrv_tAirPiI Temp_Cels 6 -50.14000 199.8600 EXTENDED_LIMITS -3549.940 3003.560 DEPOSIT ABSOLUTE /end AXIS_DESCR
/end CHARACTERISTIC
/begin CHARACTERISTIC InjCrv_facIAPiI1DynCor_CUR "Kennlinie für ansauglufttemperaturabhängigen Gewichtungsfaktor der Voreinspritzung PiI1" CURVE 0x800435A2 Kl_Xs16_Ws16 2.000000 Fact 0.00 2.000000 EXTENDED_LIMITS -4.000000 3.999878
 /begin AXIS_DESCR STD_AXIS InjCrv_tAirPiI Temp_Cels 6 -50.14000 199.8600 EXTENDED_LIMITS -3549.940 3003.560 DEPOSIT ABSOLUTE /end AXIS_DESCR
/end CHARACTERISTIC
/begin CHARACTERISTIC InjCrv_facPiI1APSQCor0Rgn1_GCUR "atmosphärendruckabhängige Mengenkorrekturkennlinie 1 für PiI1 für die Regenerationsstufe 1" CURVE 0x80044DCA CurG_Ws16 1.000000 Fact 0.00 1.000000 EXTENDED_LIMITS -4.000000 3.999878
 /begin AXIS_DESCR COM_AXIS EnvP_p Pres_hPa 10 0.00 3500.000 EXTENDED_LIMITS -32768.00 32767.00 AXIS_PTS_REF InjCrv_facPiI1APSQCorRgn_AXIS /end AXIS_DESCR
/end CHARACTERISTIC
/begin CHARACTERISTIC InjCrv_facPiI1APSQCor0Rgn2_GCUR "atmosphärendruckabhängige Mengenkorrekturkennlinie 2 für PiI1 für die Regenerationsstufe 1" CURVE 0x80044DDE CurG_Ws16 1.000000 Fact 0.00 1.000000 EXTENDED_LIMITS -4.000000 3.999878
 /begin AXIS_DESCR COM_AXIS EnvP_p Pres_hPa 10 0.00 3500.000 EXTENDED_LIMITS -32768.00 32767.00 AXIS_PTS_REF InjCrv_facPiI1APSQCorRgn_AXIS /end AXIS_DESCR
/end CHARACTERISTIC
/begin CHARACTERISTIC InjCrv_facPiI1APSQCor1Rgn1_GCUR "atmosphärendruckabhängige Mengenkorrekturkennlinie 1 für PiI1 für die Regenerationsstufe 2" CURVE 0x80044DF2 CurG_Ws16 1.000000 Fact 0.00 1.000000 EXTENDED_LIMITS -4.000000 3.999878
 /begin AXIS_DESCR COM_AXIS EnvP_p Pres_hPa 10 0.00 3500.000 EXTENDED_LIMITS -32768.00 32767.00 AXIS_PTS_REF InjCrv_facPiI1APSQCorRgn_AXIS /end AXIS_DESCR
/end CHARACTERISTIC
/begin CHARACTERISTIC InjCrv_facPiI1APSQCor1Rgn2_GCUR "atmosphärendruckabhängige Mengenkorrekturkennlinie 2 für PiI1 für die Regenerationsstufe 2" CURVE 0x80044E06 CurG_Ws16 1.000000 Fact 0.00 1.000000 EXTENDED_LIMITS -4.000000 3.999878
 /begin AXIS_DESCR COM_AXIS EnvP_p Pres_hPa 10 0.00 3500.000 EXTENDED_LIMITS -32768.00 32767.00 AXIS_PTS_REF InjCrv_facPiI1APSQCorRgn_AXIS /end AXIS_DESCR
/end CHARACTERISTIC
/begin CHARACTERISTIC InjCrv_facPiI1APSQCor1_CUR "atmosphärendruckabhängige Mengenkorrekturkennlinie 1 für PiI 1" CURVE 0x80044C9E CurG_Ws16 1.000000 Fact 0.00 1.000000 EXTENDED_LIMITS -4.000000 3.999878
 /begin AXIS_DESCR COM_AXIS EnvP_p Pres_hPa 8 0.00 3500.000 EXTENDED_LIMITS -32768.00 32767.00 AXIS_PTS_REF InjCrv_facPiI1APSQCor_AXIS /end AXIS_DESCR
/end CHARACTERISTIC
/begin CHARACTERISTIC InjCrv_facPiI1APSQCor2_CUR "atmosphärendruckabhängige Mengenkorrekturkennlinie für PiI 1 wenn PiI2 oder PiI3 aktiv ist" CURVE 0x80044CAE CurG_Ws16 1.000000 Fact 0.00 1.000000 EXTENDED_LIMITS -4.000000 3.999878
 /begin AXIS_DESCR COM_AXIS EnvP_p Pres_hPa 8 0.00 3500.000 EXTENDED_LIMITS -32768.00 32767.00 AXIS_PTS_REF InjCrv_facPiI1APSQCor_AXIS /end AXIS_DESCR
/end CHARACTERISTIC
/begin AXIS_PTS InjCrv_facPiI1APSQCorRgn_AXIS "gemeinsame Stützstellen für atmosphärendruckabhängige Mengenkorrekturkennlinien für PiI1 für die Regeneration" 0x80044E1A EnvP_p Axis_Xs16 3500.000 Pres_hPa 10 0.00 3500.000 FORMAT "%8.3" EXTENDED_LIMITS -32768.00 32767.00 DEPOSIT ABSOLUTE /end AXIS_PTS
/begin CHARACTERISTIC InjCrv_facPiI1APSQCorStrt_CUR "weighting factor of atmospheric pressure for pilot injections quantity correction" CURVE 0x800435BC Kl_Xs16_Ws16 7.999878 Fact -4.000000 3.999878
 /begin AXIS_DESCR STD_AXIS EnvP_p Pres_hPa 8 -32768.00 3500.00 EXTENDED_LIMITS -32768.00 32767.00 DEPOSIT ABSOLUTE /end AXIS_DESCR
/end CHARACTERISTIC
/begin AXIS_PTS InjCrv_facPiI1APSQCor_AXIS "gemeinsame Stützstellen für atmosphärendruckabhängige Mengenkorrekturkennlinien für PiI1" 0x80044CBE EnvP_p Axis_Xs16 3500.000 Pres_hPa 8 0.00 3500.000 FORMAT "%8.3" EXTENDED_LIMITS -32768.00 32767.00 DEPOSIT ABSOLUTE /end AXIS_PTS
/begin CHARACTERISTIC InjCrv_facPiI1APSSOECor0Rgn1_CUR "Luftdruckabhängige Ansteuerbeginnkorrekturkennlinie 1 für PiI1 für die Regenerationsstufe 1" CURVE 0x80044E30 CurG_Ws16 1.000000 Fact 0.00 1.000000 EXTENDED_LIMITS -4.000000 3.999878
 /begin AXIS_DESCR COM_AXIS EnvP_p Pres_hPa 10 0.00 3500.000 EXTENDED_LIMITS -32768.00 32767.00 AXIS_PTS_REF InjCrv_facPiI1APSSOECorRgn_AXIS /end AXIS_DESCR
/end CHARACTERISTIC
/begin CHARACTERISTIC InjCrv_facPiI1APSSOECor0Rgn2_CUR "Luftdruckabhängige Ansteuerbeginnkorrekturkennlinie 2 für PiI1 für die Regenerationsstufe 1" CURVE 0x80044E44 CurG_Ws16 1.000000 Fact 0.00 1.000000 EXTENDED_LIMITS -4.000000 3.999878
 /begin AXIS_DESCR COM_AXIS EnvP_p Pres_hPa 10 0.00 3500.000 EXTENDED_LIMITS -32768.00 32767.00 AXIS_PTS_REF InjCrv_facPiI1APSSOECorRgn_AXIS /end AXIS_DESCR
/end CHARACTERISTIC
/begin CHARACTERISTIC InjCrv_facPiI1APSSOECor1Rgn1_CUR "Luftdruckabhängige Ansteuerbeginnkorrekturkennlinie 1 für PiI1 für die Regenerationsstufe 2" CURVE 0x80044E58 CurG_Ws16 1.000000 Fact 0.00 1.000000 EXTENDED_LIMITS -4.000000 3.999878
 /begin AXIS_DESCR COM_AXIS EnvP_p Pres_hPa 10 0.00 3500.000 EXTENDED_LIMITS -32768.00 32767.00 AXIS_PTS_REF InjCrv_facPiI1APSSOECorRgn_AXIS /end AXIS_DESCR
/end CHARACTERISTIC
/begin CHARACTERISTIC InjCrv_facPiI1APSSOECor1Rgn2_CUR "Luftdruckabhängige Ansteuerbeginnkorrekturkennlinie 2 für PiI1 für die Regenerationsstufe 2" CURVE 0x80044E6C CurG_Ws16 1.000000 Fact 0.00 1.000000 EXTENDED_LIMITS -4.000000 3.999878
 /begin AXIS_DESCR COM_AXIS EnvP_p Pres_hPa 10 0.00 3500.000 EXTENDED_LIMITS -32768.00 32767.00 AXIS_PTS_REF InjCrv_facPiI1APSSOECorRgn_AXIS /end AXIS_DESCR
/end CHARACTERISTIC
/begin CHARACTERISTIC InjCrv_facPiI1APSSOECor1_CUR "Luftdruckabhängige Ansteuerbeginnkorrekturkennlinie für PiI1 bei inaktiver PiI2" CURVE 0x80044CD0 CurG_Ws16 1.000000 Fact 0.00 1.000000 EXTENDED_LIMITS -4.000000 3.999878
 /begin AXIS_DESCR COM_AXIS EnvP_p Pres_hPa 8 0.00 3500.000 EXTENDED_LIMITS -32768.00 32767.00 AXIS_PTS_REF InjCrv_facPiI1APSSOECor_AXIS /end AXIS_DESCR
/end CHARACTERISTIC
/begin CHARACTERISTIC InjCrv_facPiI1APSSOECor2_CUR "Luftdruckabhängige Ansteuerbeginnkorrekturkennlinie für PiI1 bei aktiver PiI2" CURVE 0x80044CE0 CurG_Ws16 1.000000 Fact 0.00 1.000000 EXTENDED_LIMITS -4.000000 3.999878
 /begin AXIS_DESCR COM_AXIS EnvP_p Pres_hPa 8 0.00 3500.000 EXTENDED_LIMITS -32768.00 32767.00 AXIS_PTS_REF InjCrv_facPiI1APSSOECor_AXIS /end AXIS_DESCR
/end CHARACTERISTIC
/begin AXIS_PTS InjCrv_facPiI1APSSOECorRgn_AXIS "gemeinsame Stützstellen für luftdruckabhängigen Ansteuerbeginnkorrekturkennlinien für PiI1 für die Regeneration" 0x80044E80 EnvP_p Axis_Xs16 3500.000 Pres_hPa 10 0.00 3500.000 FORMAT "%8.3" EXTENDED_LIMITS -32768.00 32767.00 DEPOSIT ABSOLUTE /end AXIS_PTS
/begin AXIS_PTS InjCrv_facPiI1APSSOECor_AXIS "" 0x80044CF0 EnvP_p Axis_Xs16 3500.000 Pres_hPa 8 0.00 3500.000 FORMAT "%8.3" EXTENDED_LIMITS -32768.00 32767.00 DEPOSIT ABSOLUTE /end AXIS_PTS
/begin CHARACTERISTIC InjCrv_facPiI1ATSQCor0Rgn1_GCUR "umgebungsluftabhängige Mengenkorrekturkennlinie 1 für PiI1 für die Regenerationsstufe 1" CURVE 0x80044E96 CurG_Ws16 1.000000 Fact 0.00 1.000000 EXTENDED_LIMITS -4.000000 3.999878
 /begin AXIS_DESCR COM_AXIS InjSys_tAirRgn Temp_Cels 6 -50.14000 199.8600 EXTENDED_LIMITS -3549.940 3003.560 AXIS_PTS_REF InjCrv_facPiI1ATSQCorRgn_AXIS /end AXIS_DESCR
/end CHARACTERISTIC
/begin CHARACTERISTIC InjCrv_facPiI1ATSQCor0Rgn2_GCUR "umgebungsluftabhängige Mengenkorrekturkennlinie 2 für PiI1 für die Regenerationsstufe 1" CURVE 0x80044EA2 CurG_Ws16 1.000000 Fact 0.00 1.000000 EXTENDED_LIMITS -4.000000 3.999878
 /begin AXIS_DESCR COM_AXIS InjSys_tAirRgn Temp_Cels 6 -50.14000 199.8600 EXTENDED_LIMITS -3549.940 3003.560 AXIS_PTS_REF InjCrv_facPiI1ATSQCorRgn_AXIS /end AXIS_DESCR
/end CHARACTERISTIC
/begin CHARACTERISTIC InjCrv_facPiI1ATSQCor1Rgn1_GCUR "umgebungsluftabhängige Mengenkorrekturkennlinie 1 für PiI1 für die Regenerationsstufe 2" CURVE 0x80044EAE CurG_Ws16 1.000000 Fact 0.00 1.000000 EXTENDED_LIMITS -4.000000 3.999878
 /begin AXIS_DESCR COM_AXIS InjSys_tAirRgn Temp_Cels 6 -50.14000 199.8600 EXTENDED_LIMITS -3549.940 3003.560 AXIS_PTS_REF InjCrv_facPiI1ATSQCorRgn_AXIS /end AXIS_DESCR
/end CHARACTERISTIC
/begin CHARACTERISTIC InjCrv_facPiI1ATSQCor1Rgn2_GCUR "umgebungsluftabhängige Mengenkorrekturkennlinie 2 für PiI1 für die Regenerationsstufe 2" CURVE 0x80044EBA CurG_Ws16 1.000000 Fact 0.00 1.000000 EXTENDED_LIMITS -4.000000 3.999878
 /begin AXIS_DESCR COM_AXIS InjSys_tAirRgn Temp_Cels 6 -50.14000 199.8600 EXTENDED_LIMITS -3549.940 3003.560 AXIS_PTS_REF InjCrv_facPiI1ATSQCorRgn_AXIS /end AXIS_DESCR
/end CHARACTERISTIC
/begin CHARACTERISTIC InjCrv_facPiI1ATSQCor1_CUR "ansauglufttemperaturabhängige Mengenkorrekturkennlinie 1 für PiI1" CURVE 0x80044D02 CurG_Ws16 1.000000 Fact 0.00 1.000000 EXTENDED_LIMITS -4.000000 3.999878
 /begin AXIS_DESCR COM_AXIS InjCrv_tAirPiI Temp_Cels 8 -50.14000 199.8600 EXTENDED_LIMITS -3549.940 3003.560 AXIS_PTS_REF InjCrv_facPiI1ATSQCor_AXIS /end AXIS_DESCR
/end CHARACTERISTIC
/begin CHARACTERISTIC InjCrv_facPiI1ATSQCor2_CUR "ansauglufttemperaturabhängige Mengenkorrekturkennlinie für PiI1 wenn PiI2 oder PiI3 aktiv ist" CURVE 0x80044D12 CurG_Ws16 1.000000 Fact 0.00 1.000000 EXTENDED_LIMITS -4.000000 3.999878
 /begin AXIS_DESCR COM_AXIS InjCrv_tAirPiI Temp_Cels 8 -50.14000 199.8600 EXTENDED_LIMITS -3549.940 3003.560 AXIS_PTS_REF InjCrv_facPiI1ATSQCor_AXIS /end AXIS_DESCR
/end CHARACTERISTIC
/begin AXIS_PTS InjCrv_facPiI1ATSQCorRgn_AXIS "gemeinsame Stützstellen für umgebungstemperaturabhängige Mengenkorrekturkennlinien für PiI1 für die Regeneration" 0x80044EC6 InjSys_tAirRgn Axis_Xs16 250.0000 Temp_Cels 6 -50.14000 199.8600 FORMAT "%8.4" EXTENDED_LIMITS -3549.940 3003.560 DEPOSIT ABSOLUTE /end AXIS_PTS
/begin CHARACTERISTIC InjCrv_facPiI1ATSQCorStrt_CUR "weighting factor of intake air temperature for pilot injections quantity correction" CURVE 0x800435DE Kl_Xs16_Ws16 7.999878 Fact -4.000000 3.999878
 /begin AXIS_DESCR STD_AXIS InjCrv_tAirPiI Temp_Cels 8 -3549.940 3003.560 DEPOSIT ABSOLUTE /end AXIS_DESCR
/end CHARACTERISTIC
/begin AXIS_PTS InjCrv_facPiI1ATSQCor_AXIS "gemeinsame Stützstellen für ansauglufttemperaturabhängige Mengenkorrekturkennlinien für PiI1" 0x80044D22 InjCrv_tAirPiI Axis_Xs16 250.0000 Temp_Cels 8 -50.14000 199.8600 FORMAT "%8.4" EXTENDED_LIMITS -3549.940 3003.560 DEPOSIT ABSOLUTE /end AXIS_PTS
/begin CHARACTERISTIC InjCrv_facPiI1ATSSOECor0Rgn1_CUR "umgebungstemperaturabhängige Ansteuerbeginnkorrekturkennlinie 1 für PiI1 für die Regenerationsstufe 1" CURVE 0x80044ED4 CurG_Ws16 1.000000 Fact 0.00 1.000000 EXTENDED_LIMITS -4.000000 3.999878
 /begin AXIS_DESCR COM_AXIS InjSys_tAirRgn Temp_Cels 6 -50.14000 199.8600 EXTENDED_LIMITS -3549.940 3003.560 AXIS_PTS_REF InjCrv_facPiI1ATSSOECorRgn_AXIS /end AXIS_DESCR
/end CHARACTERISTIC
/begin CHARACTERISTIC InjCrv_facPiI1ATSSOECor0Rgn2_CUR "umgebungstemperaturabhängige Ansteuerbeginnkorrekturkennlinie 2 für PiI1 für die Regenerationsstufe 1" CURVE 0x80044EE0 CurG_Ws16 1.000000 Fact 0.00 1.000000 EXTENDED_LIMITS -4.000000 3.999878
 /begin AXIS_DESCR COM_AXIS InjSys_tAirRgn Temp_Cels 6 -50.14000 199.8600 EXTENDED_LIMITS -3549.940 3003.560 AXIS_PTS_REF InjCrv_facPiI1ATSSOECorRgn_AXIS /end AXIS_DESCR
/end CHARACTERISTIC
/begin CHARACTERISTIC InjCrv_facPiI1ATSSOECor1Rgn1_CUR "umgebungstemperaturabhängige Ansteuerbeginnkorrekturkennlinie 1 für PiI1 für die Regenerationsstufe 2" CURVE 0x80044EEC CurG_Ws16 1.000000 Fact 0.00 1.000000 EXTENDED_LIMITS -4.000000 3.999878
 /begin AXIS_DESCR COM_AXIS InjSys_tAirRgn Temp_Cels 6 -50.14000 199.8600 EXTENDED_LIMITS -3549.940 3003.560 AXIS_PTS_REF InjCrv_facPiI1ATSSOECorRgn_AXIS /end AXIS_DESCR
/end CHARACTERISTIC
/begin CHARACTERISTIC InjCrv_facPiI1ATSSOECor1Rgn2_CUR "umgebungstemperaturabhängige Ansteuerbeginnkorrekturkennlinie 2 für PiI1 für die Regenerationsstufe 2" CURVE 0x80044EF8 CurG_Ws16 1.000000 Fact 0.00 1.000000 EXTENDED_LIMITS -4.000000 3.999878
 /begin AXIS_DESCR COM_AXIS InjSys_tAirRgn Temp_Cels 6 -50.14000 199.8600 EXTENDED_LIMITS -3549.940 3003.560 AXIS_PTS_REF InjCrv_facPiI1ATSSOECorRgn_AXIS /end AXIS_DESCR
/end CHARACTERISTIC
/begin CHARACTERISTIC InjCrv_facPiI1ATSSOECor1_CUR "Ansauglufttemperaturabhängige Ansteuerbeginnkorrekturkennlinie für PiI1 bei inaktiver PiI2" CURVE 0x80044D34 CurG_Ws16 1.000000 Fact 0.00 1.000000 EXTENDED_LIMITS -4.000000 3.999878
 /begin AXIS_DESCR COM_AXIS InjCrv_tAirPiI Temp_Cels 8 -50.14000 199.8600 EXTENDED_LIMITS -3549.940 3003.560 AXIS_PTS_REF InjCrv_facPiI1ATSSOECor_AXIS /end AXIS_DESCR
/end CHARACTERISTIC
/begin CHARACTERISTIC InjCrv_facPiI1ATSSOECor2_CUR "Ansauglufttemperaturabhängige Ansteuerbeginnkorrekturkennlinie für PiI1 bei aktiver PiI2" CURVE 0x80044D44 CurG_Ws16 1.000000 Fact 0.00 1.000000 EXTENDED_LIMITS -4.000000 3.999878
 /begin AXIS_DESCR COM_AXIS InjCrv_tAirPiI Temp_Cels 8 -50.14000 199.8600 EXTENDED_LIMITS -3549.940 3003.560 AXIS_PTS_REF InjCrv_facPiI1ATSSOECor_AXIS /end AXIS_DESCR
/end CHARACTERISTIC
/begin AXIS_PTS InjCrv_facPiI1ATSSOECorRgn_AXIS "gemeinsame Stützstellen für umgebungstemperaturabhängige Ansteuerbeginnkorrekturkennlinien für PiI1 für die Regeneration" 0x80044F04 InjSys_tAirRgn Axis_Xs16 250.0000 Temp_Cels 6 -50.14000 199.8600 FORMAT "%8.4" EXTENDED_LIMITS -3549.940 3003.560 DEPOSIT ABSOLUTE /end AXIS_PTS
/begin CHARACTERISTIC InjCrv_facPiI1ATSSOECorRgn_CUR "" CURVE 0x8004373E Kl_Xs16_Ws16 2.000000 Fact 0.00 2.000000 EXTENDED_LIMITS -4.000000 3.999878
 /begin AXIS_DESCR STD_AXIS InjCrv_tAirPiI Temp_Cels 6 -50.14000 199.8600 EXTENDED_LIMITS -3549.940 3003.560 DEPOSIT ABSOLUTE /end AXIS_DESCR
/end CHARACTERISTIC
/begin AXIS_PTS InjCrv_facPiI1ATSSOECor_AXIS "gemeinsame Stützstellen für ansauglufttemperaturabhängige Ansteuerbeginnkorrekturkennlinien für PiI1 bei aktiver/inaktiver PiI 2" 0x80044D54 InjCrv_tAirPiI Axis_Xs16 250.0000 Temp_Cels 8 -50.14000 199.8600 FORMAT "%8.4" EXTENDED_LIMITS -3549.940 3003.560 DEPOSIT ABSOLUTE /end AXIS_PTS
/begin CHARACTERISTIC InjCrv_facPiI1ETSQCor0Rgn1_GCUR "motortemperaturabhängige Mengenkorrekturkennlinie 1 für PiI1 für die Regenerationsstufe 1" CURVE 0x80044F12 CurG_Ws16 1.000000 Fact 0.00 1.000000 EXTENDED_LIMITS -4.000000 3.999878
 /begin AXIS_DESCR COM_AXIS InjSys_tEngRgn Temp_Cels 10 -50.14000 199.8600 EXTENDED_LIMITS -3549.940 3003.560 AXIS_PTS_REF InjCrv_facPiI1ETSQCorRgn_AXIS /end AXIS_DESCR
/end CHARACTERISTIC
/begin CHARACTERISTIC InjCrv_facPiI1ETSQCor0Rgn2_GCUR "motortemperaturabhängige Mengenkorrekturkennlinie 2 für PiI1 für die Regenerationsstufe 1" CURVE 0x80044F26 CurG_Ws16 1.000000 Fact 0.00 1.000000 EXTENDED_LIMITS -4.000000 3.999878
 /begin AXIS_DESCR COM_AXIS InjSys_tEngRgn Temp_Cels 10 -50.14000 199.8600 EXTENDED_LIMITS -3549.940 3003.560 AXIS_PTS_REF InjCrv_facPiI1ETSQCorRgn_AXIS /end AXIS_DESCR
/end CHARACTERISTIC
/begin CHARACTERISTIC InjCrv_facPiI1ETSQCor11_CUR "motortemperaturabhängige Mengenkorrekturkennlinie -1 für Voreinspritzung 1" CURVE 0x80043600 Kl_Xs16_Ws16 7.999878 Fact -4.000000 3.999878
 /begin AXIS_DESCR STD_AXIS InjSys_tEng Temp_Cels 8 -3549.940 3003.560 DEPOSIT ABSOLUTE /end AXIS_DESCR
/end CHARACTERISTIC
/begin CHARACTERISTIC InjCrv_facPiI1ETSQCor12_CUR "motortemperaturabhängige Mengenkorrekturkennlinie für Voreinspritzung 1 bei aktiver Voreinspritzung 2" CURVE 0x80043622 Kl_Xs16_Ws16 7.999878 Fact -4.000000 3.999878
 /begin AXIS_DESCR STD_AXIS InjSys_tEng Temp_Cels 8 -3549.940 3003.560 DEPOSIT ABSOLUTE /end AXIS_DESCR
/end CHARACTERISTIC
/begin CHARACTERISTIC InjCrv_facPiI1ETSQCor1Rgn1_GCUR "motortemperaturabhängige Mengenkorrekturkennlinie 1 für PiI1 für die Regenerationsstufe 2" CURVE 0x80044F3A CurG_Ws16 1.000000 Fact 0.00 1.000000 EXTENDED_LIMITS -4.000000 3.999878
 /begin AXIS_DESCR COM_AXIS InjSys_tEngRgn Temp_Cels 10 -50.14000 199.8600 EXTENDED_LIMITS -3549.940 3003.560 AXIS_PTS_REF InjCrv_facPiI1ETSQCorRgn_AXIS /end AXIS_DESCR
/end CHARACTERISTIC
/begin CHARACTERISTIC InjCrv_facPiI1ETSQCor1Rgn2_GCUR "motortemperaturabhängige Mengenkorrekturkennlinie 2 für PiI1 für die Regenerationsstufe 2" CURVE 0x80044F4E CurG_Ws16 1.000000 Fact 0.00 1.000000 EXTENDED_LIMITS -4.000000 3.999878
 /begin AXIS_DESCR COM_AXIS InjSys_tEngRgn Temp_Cels 10 -50.14000 199.8600 EXTENDED_LIMITS -3549.940 3003.560 AXIS_PTS_REF InjCrv_facPiI1ETSQCorRgn_AXIS /end AXIS_DESCR
/end CHARACTERISTIC
/begin CHARACTERISTIC InjCrv_facPiI1ETSQCor1_CUR "motortemperaturabhängige Mengenkorrekturkennlinie 1 für PiI1" CURVE 0x80044D66 CurG_Ws16 1.000000 Fact 0.00 1.000000 EXTENDED_LIMITS -4.000000 3.999878
 /begin AXIS_DESCR COM_AXIS InjSys_tEng Temp_Cels 8 -50.14000 199.8600 EXTENDED_LIMITS -3549.940 3003.560 AXIS_PTS_REF InjCrv_facPiI1ETSQCor_AXIS /end AXIS_DESCR
/end CHARACTERISTIC
/begin CHARACTERISTIC InjCrv_facPiI1ETSQCor2_CUR "motortemperaturabhängige Mengenkorrekturkennlinie für PiI1 wenn PiI2 oder PiI3 aktiv ist" CURVE 0x80044D76 CurG_Ws16 1.000000 Fact 0.00 1.000000 EXTENDED_LIMITS -4.000000 3.999878
 /begin AXIS_DESCR COM_AXIS InjSys_tEng Temp_Cels 8 -50.14000 199.8600 EXTENDED_LIMITS -3549.940 3003.560 AXIS_PTS_REF InjCrv_facPiI1ETSQCor_AXIS /end AXIS_DESCR
/end CHARACTERISTIC
/begin AXIS_PTS InjCrv_facPiI1ETSQCorRgn_AXIS "gemeinsame Stützstellen für motortemperaturabhängige Mengenkorrekturkennlinien für PiI1 für die Regeneration" 0x80044F62 InjSys_tEngRgn Axis_Xs16 250.0000 Temp_Cels 10 -50.14000 199.8600 FORMAT "%8.4" EXTENDED_LIMITS -3549.940 3003.560 DEPOSIT ABSOLUTE /end AXIS_PTS
/begin CHARACTERISTIC InjCrv_facPiI1ETSQCorStrt_CUR "weighting factor of engine temperature for pilot injection quantity correction" CURVE 0x80043644 Kl_Xs16_Ws16 7.999878 Fact -4.000000 3.999878
 /begin AXIS_DESCR STD_AXIS InjSys_tEng Temp_Cels 8 -3549.940 3003.560 DEPOSIT ABSOLUTE /end AXIS_DESCR
/end CHARACTERISTIC
/begin AXIS_PTS InjCrv_facPiI1ETSQCor_AXIS "gemeinsame Stützstellen für motortemperaturabhängige Mengenkorrekturkennlinien für PiI1" 0x80044D86 InjSys_tEng Axis_Xs16 250.0000 Temp_Cels 8 -50.14000 199.8600 FORMAT "%8.4" EXTENDED_LIMITS -3549.940 3003.560 DEPOSIT ABSOLUTE /end AXIS_PTS
/begin CHARACTERISTIC InjCrv_facPiI1ETSSOECor0Rgn1_CUR "motortemperaturabhängige Ansteuerbeginnkorrekturkennlinie 1 für die PiI1 für die Regenerationsstufe 1" CURVE 0x80044F78 CurG_Ws16 1.000000 Fact 0.00 1.000000 EXTENDED_LIMITS -4.000000 3.999878
 /begin AXIS_DESCR COM_AXIS InjSys_tEngRgn Temp_Cels 10 -50.14000 199.8600 EXTENDED_LIMITS -3549.940 3003.560 AXIS_PTS_REF InjCrv_facPiI1ETSSOECorRgn_AXIS /end AXIS_DESCR
/end CHARACTERISTIC
/begin CHARACTERISTIC InjCrv_facPiI1ETSSOECor0Rgn2_CUR "motortemperaturabhängige Ansteuerbeginnkorrekturkennlinie 2 für die PiI1 für die Regenerationsstufe 1" CURVE 0x80044F8C CurG_Ws16 1.000000 Fact 0.00 1.000000 EXTENDED_LIMITS -4.000000 3.999878
 /begin AXIS_DESCR COM_AXIS InjSys_tEngRgn Temp_Cels 10 -50.14000 199.8600 EXTENDED_LIMITS -3549.940 3003.560 AXIS_PTS_REF InjCrv_facPiI1ETSSOECorRgn_AXIS /end AXIS_DESCR
/end CHARACTERISTIC
/begin CHARACTERISTIC InjCrv_facPiI1ETSSOECor11_CUR "motortemperaturabhängige Ansteuerbeginnkorrekturkennlinie -1 für Voreinspritzung 1" CURVE 0x80043666 Kl_Xs16_Ws16 7.999878 Fact -4.000000 3.999878
 /begin AXIS_DESCR STD_AXIS InjSys_tEng Temp_Cels 8 -3549.940 3003.560 DEPOSIT ABSOLUTE /end AXIS_DESCR
/end CHARACTERISTIC
/begin CHARACTERISTIC InjCrv_facPiI1ETSSOECor12_CUR "motortemperaturabhängige Ansteuerbeginnkorrekturkennlinie für Voreinspritzung 1 bei aktiver Voreinspritzung 2" CURVE 0x80043688 Kl_Xs16_Ws16 7.999878 Fact -4.000000 3.999878
 /begin AXIS_DESCR STD_AXIS InjSys_tEng Temp_Cels 8 -3549.940 3003.560 DEPOSIT ABSOLUTE /end AXIS_DESCR
/end CHARACTERISTIC
/begin CHARACTERISTIC InjCrv_facPiI1ETSSOECor1Rgn1_CUR "motortemperaturabhängige Ansteuerbeginnkorrekturkennlinie 1 für die PiI1 für die Regenerationsstufe 2" CURVE 0x80044FA0 CurG_Ws16 1.000000 Fact 0.00 1.000000 EXTENDED_LIMITS -4.000000 3.999878
 /begin AXIS_DESCR COM_AXIS InjSys_tEngRgn Temp_Cels 10 -50.14000 199.8600 EXTENDED_LIMITS -3549.940 3003.560 AXIS_PTS_REF InjCrv_facPiI1ETSSOECorRgn_AXIS /end AXIS_DESCR
/end CHARACTERISTIC
/begin CHARACTERISTIC InjCrv_facPiI1ETSSOECor1Rgn2_CUR "motortemperaturabhängige Ansteuerbeginnkorrekturkennlinie 2 für die PiI1 für die Regenerationsstufe 2" CURVE 0x80044FB4 CurG_Ws16 1.000000 Fact 0.00 1.000000 EXTENDED_LIMITS -4.000000 3.999878
 /begin AXIS_DESCR COM_AXIS InjSys_tEngRgn Temp_Cels 10 -50.14000 199.8600 EXTENDED_LIMITS -3549.940 3003.560 AXIS_PTS_REF InjCrv_facPiI1ETSSOECorRgn_AXIS /end AXIS_DESCR
/end CHARACTERISTIC
/begin CHARACTERISTIC InjCrv_facPiI1ETSSOECor1_CUR "motortemperaturabhängige Ansteuerbeginnkorrekturkennlinie 1 für PiI1" CURVE 0x80044D98 CurG_Ws16 1.000000 Fact 0.00 1.000000 EXTENDED_LIMITS -4.000000 3.999878
 /begin AXIS_DESCR COM_AXIS InjSys_tEng Temp_Cels 8 -50.14000 199.8600 EXTENDED_LIMITS -3549.940 3003.560 AXIS_PTS_REF InjCrv_facPiI1ETSSOECor_AXIS /end AXIS_DESCR
/end CHARACTERISTIC
/begin CHARACTERISTIC InjCrv_facPiI1ETSSOECor2_CUR "motortemperaturabhängige Ansteuerbeginnkorrekturkennlinie 2 für PiI1" CURVE 0x80044DA8 CurG_Ws16 1.000000 Fact 0.00 1.000000 EXTENDED_LIMITS -4.000000 3.999878
 /begin AXIS_DESCR COM_AXIS InjSys_tEng Temp_Cels 8 -50.14000 199.8600 EXTENDED_LIMITS -3549.940 3003.560 AXIS_PTS_REF InjCrv_facPiI1ETSSOECor_AXIS /end AXIS_DESCR
/end CHARACTERISTIC
/begin AXIS_PTS InjCrv_facPiI1ETSSOECorRgn_AXIS "gemeinsame Stützstellen für motortemperaturabhängige Ansteuerbeginnkorrekturkennlinien für PiI1 für die Regeneration" 0x80044FC8 InjSys_tEngRgn Axis_Xs16 250.0000 Temp_Cels 10 -50.14000 199.8600 FORMAT "%8.4" EXTENDED_LIMITS -3549.940 3003.560 DEPOSIT ABSOLUTE /end AXIS_PTS
/begin CHARACTERISTIC InjCrv_facPiI1ETSSOECorStrt_CUR "motortemperaturabhängige Ansteuerbeginnkorrekturkennlinie für Voreinspritzung 1 im Startfall" CURVE 0x800436AA Kl_Xs16_Ws16 7.999878 Fact -4.000000 3.999878
 /begin AXIS_DESCR STD_AXIS InjSys_tEng Temp_Cels 8 -3549.940 3003.560 DEPOSIT ABSOLUTE /end AXIS_DESCR
/end CHARACTERISTIC
/begin AXIS_PTS InjCrv_facPiI1ETSSOECor_AXIS "gemeinsame Stützstellen für motortemperaturabhängige Ansteuerbeginnkorrekturkennlinien für PiI1" 0x80044DB8 InjSys_tEng Axis_Xs16 250.0000 Temp_Cels 8 -50.14000 199.8600 FORMAT "%8.4" EXTENDED_LIMITS -3549.940 3003.560 DEPOSIT ABSOLUTE /end AXIS_PTS
/begin CHARACTERISTIC InjCrv_facPiI1QntMax_C "Wichtungsfaktor für die berechnete Sollmenge der Voreinspritzung 1" VALUE 0x8004687E Val_Ws16 1.000000 Fact1 0.00 1.000000 EXTENDED_LIMITS -256.0000 255.9922 /end CHARACTERISTIC
/begin CHARACTERISTIC InjCrv_facPiI1QntRmp0Val_GCUR "Faktorisierungskennlinie für die Menge der PiI1" CURVE 0x8004621E CurG_Ws16 3.999939 CoEOMSwt_S16 -2.000000 1.999939 FORMAT "%8.6"
 /begin AXIS_DESCR COM_AXIS CoEOM_facRmpVal CoEOMSwt_S16 10 -2.000000 1.999939 FORMAT "%8.6" AXIS_PTS_REF InjCrv_facPiI1QntRmpValX_AXIS /end AXIS_DESCR
/end CHARACTERISTIC
/begin CHARACTERISTIC InjCrv_facPiI1QntRmp1Val_GCUR "Faktorisierungskennlinie für die Menge der PiI1" CURVE 0x80046232 CurG_Ws16 3.999939 CoEOMSwt_S16 -2.000000 1.999939 FORMAT "%8.6"
 /begin AXIS_DESCR COM_AXIS CoEOM_facRmpVal CoEOMSwt_S16 10 -2.000000 1.999939 FORMAT "%8.6" AXIS_PTS_REF InjCrv_facPiI1QntRmpValX_AXIS /end AXIS_DESCR
/end CHARACTERISTIC
/begin AXIS_PTS InjCrv_facPiI1QntRmpValX_AXIS "Gruppenkennlinien-Achse für die Gewichtung des Mengen-Faktors der PiI1" 0x80046246 CoEOM_facRmpVal Axis_Xs16 3.999939 CoEOMSwt_S16 10 -2.000000 1.999939 FORMAT "%8.6" DEPOSIT ABSOLUTE /end AXIS_PTS
/begin CHARACTERISTIC InjCrv_facPiI1SOERmp0Val_GCUR "Faktorisierungskennlinie für den Einspritzbeginn der PiI1" CURVE 0x8004625C CurG_Ws16 3.999939 CoEOMSwt_S16 -2.000000 1.999939 FORMAT "%8.6"
 /begin AXIS_DESCR COM_AXIS CoEOM_facRmpVal CoEOMSwt_S16 10 -2.000000 1.999939 FORMAT "%8.6" AXIS_PTS_REF InjCrv_facPiI1SOERmpValX_AXIS /end AXIS_DESCR
/end CHARACTERISTIC
/begin CHARACTERISTIC InjCrv_facPiI1SOERmp1Val_GCUR "Faktorisierungskennlinie für den Einspritzbeginn der PiI1" CURVE 0x80046270 CurG_Ws16 3.999939 CoEOMSwt_S16 -2.000000 1.999939 FORMAT "%8.6"
 /begin AXIS_DESCR COM_AXIS CoEOM_facRmpVal CoEOMSwt_S16 10 -2.000000 1.999939 FORMAT "%8.6" AXIS_PTS_REF InjCrv_facPiI1SOERmpValX_AXIS /end AXIS_DESCR
/end CHARACTERISTIC
/begin AXIS_PTS InjCrv_facPiI1SOERmpValX_AXIS "Gruppenkennlinien-Achse für die Gewichtung des Einspritzbeginn-Faktors der PiI1" 0x80046284 CoEOM_facRmpVal Axis_Xs16 3.999939 CoEOMSwt_S16 10 -2.000000 1.999939 FORMAT "%8.6" DEPOSIT ABSOLUTE /end AXIS_PTS
/begin CHARACTERISTIC InjCrv_facPiI1VehCor2_CUR "" CURVE 0x800421DE Kl_Xs16_Ws16 100.0000 Fact 0.00 100.0000 EXTENDED_LIMITS -4.000000 3.999878 /begin AXIS_DESCR STD_AXIS VehV_v Vel 4 -327.6800 327.6700 DEPOSIT ABSOLUTE /end AXIS_DESCR /end CHARACTERISTIC
/begin CHARACTERISTIC InjCrv_facPiI1VehCor_CUR "" CURVE 0x800421F0 Kl_Xs16_Ws16 100.0000 Fact 0.00 100.0000 EXTENDED_LIMITS -4.000000 3.999878 /begin AXIS_DESCR STD_AXIS VehV_v Vel 4 -327.6800 327.6700 DEPOSIT ABSOLUTE /end AXIS_DESCR /end CHARACTERISTIC
/begin CHARACTERISTIC InjCrv_facPiI1VehTempCor2_CUR "" CURVE 0x80042202 Kl_Xs16_Ws16 100.0000 Fact 0.00 100.0000 EXTENDED_LIMITS -4.000000 3.999878
 /begin AXIS_DESCR STD_AXIS CEngDsT_t Temp_Cels 8 -3549.940 3003.560 DEPOSIT ABSOLUTE /end AXIS_DESCR
/end CHARACTERISTIC
/begin CHARACTERISTIC InjCrv_facPiI1VehTempCor_CUR "" CURVE 0x80042224 Kl_Xs16_Ws16 100.0000 Fact 0.00 100.0000 EXTENDED_LIMITS -4.000000 3.999878
 /begin AXIS_DESCR STD_AXIS CEngDsT_t Temp_Cels 8 -3549.940 3003.560 DEPOSIT ABSOLUTE /end AXIS_DESCR
/end CHARACTERISTIC
/begin CHARACTERISTIC InjCrv_facPiI2APSQCor0Rgn_GCUR "atmosphärendruckabhängige Mengenkorrekturkennlinie für PiI2 für die Regenerationsstufe 1" CURVE 0x80047E3A CurG_Ws16 1.000000 Fact 0.00 1.000000 EXTENDED_LIMITS -4.000000 3.999878
 /begin AXIS_DESCR COM_AXIS EnvP_p Pres_hPa 10 0.00 3500.000 EXTENDED_LIMITS -32768.00 32767.00 AXIS_PTS_REF InjCrv_facPiI2APSQCorRgn_AXIS /end AXIS_DESCR
/end CHARACTERISTIC
/begin CHARACTERISTIC InjCrv_facPiI2APSQCor1Rgn_GCUR "atmosphärendruckabhängige Mengenkorrekturkennlinie für PiI2 für die Regenerationsstufe 2" CURVE 0x80047E4E CurG_Ws16 1.000000 Fact 0.00 1.000000 EXTENDED_LIMITS -4.000000 3.999878
 /begin AXIS_DESCR COM_AXIS EnvP_p Pres_hPa 10 0.00 3500.000 EXTENDED_LIMITS -32768.00 32767.00 AXIS_PTS_REF InjCrv_facPiI2APSQCorRgn_AXIS /end AXIS_DESCR
/end CHARACTERISTIC
/begin AXIS_PTS InjCrv_facPiI2APSQCorRgn_AXIS "gemeinsame Stützstellen für atmosphärendruckabhängige Mengenkorrekturkennlinien für PiI2 für die Regeneration" 0x80047E62 EnvP_p Axis_Xs16 3500.000 Pres_hPa 10 0.00 3500.000 FORMAT "%8.3" EXTENDED_LIMITS -32768.00 32767.00 DEPOSIT ABSOLUTE /end AXIS_PTS
/begin CHARACTERISTIC InjCrv_facPiI2APSQCorStrt_CUR "weighting factor of atmospheric pressure for PiI2 quantity correction" CURVE 0x80046F26 Kl_Xs16_Ws16 1.000000 Fact 0.00 1.000000 EXTENDED_LIMITS -4.000000 3.999878
 /begin AXIS_DESCR STD_AXIS EnvP_p Pres_hPa 2 0.00 3500.000 EXTENDED_LIMITS -32768.00 32767.00 DEPOSIT ABSOLUTE /end AXIS_DESCR
/end CHARACTERISTIC
/begin CHARACTERISTIC InjCrv_facPiI2APSQCor_CUR "atmosphärendruckabhängige Mengenkorrekturkennlinie für PiI 2" CURVE 0x80047D6E Cur_Xs16Ws16 1.000000 Fact 0.00 1.000000 EXTENDED_LIMITS -4.000000 3.999878
 /begin AXIS_DESCR STD_AXIS EnvP_p Pres_hPa 8 0.00 3500.000 EXTENDED_LIMITS -32768.00 32767.00 DEPOSIT ABSOLUTE /end AXIS_DESCR
/end CHARACTERISTIC
/begin CHARACTERISTIC InjCrv_facPiI2APSSOECor0Rgn_GCUR "Luftdruckabhängige Ansteuerbeginnkorrekturkennlinie für PiI2 für die Regenerationsstufe 1" CURVE 0x80047E78 CurG_Ws16 1.000000 Fact 0.00 1.000000 EXTENDED_LIMITS -4.000000 3.999878
 /begin AXIS_DESCR COM_AXIS EnvP_p Pres_hPa 10 0.00 3500.000 EXTENDED_LIMITS -32768.00 32767.00 AXIS_PTS_REF InjCrv_facPiI2APSSOECorRgn_AXIS /end AXIS_DESCR
/end CHARACTERISTIC
/begin CHARACTERISTIC InjCrv_facPiI2APSSOECor1Rgn_GCUR "Luftdruckabhängige Ansteuerbeginnkorrekturkennlinie für PiI2 für die Regenerationsstufe 2" CURVE 0x80047E8C CurG_Ws16 1.000000 Fact 0.00 1.000000 EXTENDED_LIMITS -4.000000 3.999878
 /begin AXIS_DESCR COM_AXIS EnvP_p Pres_hPa 10 0.00 3500.000 EXTENDED_LIMITS -32768.00 32767.00 AXIS_PTS_REF InjCrv_facPiI2APSSOECorRgn_AXIS /end AXIS_DESCR
/end CHARACTERISTIC
/begin AXIS_PTS InjCrv_facPiI2APSSOECorRgn_AXIS "gemeinsame Stützstellen für luftdruckabhängigen Ansteuerbeginnkorrekturkennlinien für PiI2 für die Regeneration" 0x80047EA0 EnvP_p Axis_Xs16 3500.000 Pres_hPa 10 0.00 3500.000 FORMAT "%8.3" EXTENDED_LIMITS -32768.00 32767.00 DEPOSIT ABSOLUTE /end AXIS_PTS
/begin CHARACTERISTIC InjCrv_facPiI2APSSOECorStrt_CUR "Korrekturkennlinie für das Timing der 2. Voreinspritzung während des Startvorganges" CURVE 0x80046F30 Kl_Xs16_Ws16 1.000000 Fact 0.00 1.000000 EXTENDED_LIMITS -4.000000 3.999878
 /begin AXIS_DESCR STD_AXIS EnvP_p Pres_hPa 2 0.00 3500.000 EXTENDED_LIMITS -32768.00 32767.00 DEPOSIT ABSOLUTE /end AXIS_DESCR
/end CHARACTERISTIC
/begin CHARACTERISTIC InjCrv_facPiI2APSSOECor_CUR "Luftdruckabhängiger Gewichtungsfaktor für PiI2" CURVE 0x80047D90 Cur_Xs16Ws16 1.000000 Fact 0.00 1.000000 EXTENDED_LIMITS -4.000000 3.999878
 /begin AXIS_DESCR STD_AXIS EnvP_p Pres_hPa 8 0.00 3500.000 EXTENDED_LIMITS -32768.00 32767.00 DEPOSIT ABSOLUTE /end AXIS_DESCR
/end CHARACTERISTIC
/begin CHARACTERISTIC InjCrv_facPiI2ATSQCor0Rgn_GCUR "umgebungsluftabhängige Mengenkorrekturkennlinie für PiI2 für die Regenerationsstufe 1" CURVE 0x80047EB6 CurG_Ws16 1.000000 Fact 0.00 1.000000 EXTENDED_LIMITS -4.000000 3.999878
 /begin AXIS_DESCR COM_AXIS InjSys_tAirRgn Temp_Cels 6 -50.14000 199.8600 EXTENDED_LIMITS -3549.940 3003.560 AXIS_PTS_REF InjCrv_facPiI2ATSQCorRgn_AXIS /end AXIS_DESCR
/end CHARACTERISTIC
/begin CHARACTERISTIC InjCrv_facPiI2ATSQCor1Rgn_GCUR "umgebungsluftabhängige Mengenkorrekturkennlinie für PiI2 für die Regenerationsstufe 2" CURVE 0x80047EC2 CurG_Ws16 1.000000 Fact 0.00 1.000000 EXTENDED_LIMITS -4.000000 3.999878
 /begin AXIS_DESCR COM_AXIS InjSys_tAirRgn Temp_Cels 6 -50.14000 199.8600 EXTENDED_LIMITS -3549.940 3003.560 AXIS_PTS_REF InjCrv_facPiI2ATSQCorRgn_AXIS /end AXIS_DESCR
/end CHARACTERISTIC
/begin AXIS_PTS InjCrv_facPiI2ATSQCorRgn_AXIS "gemeinsame Stützstellen für umgebungstemperaturabhängige Mengenkorrekturkennlinien für PiI2 für die Regeneration" 0x80047ECE InjSys_tAirRgn Axis_Xs16 250.0000 Temp_Cels 6 -50.14000 199.8600 FORMAT "%8.4" EXTENDED_LIMITS -3549.940 3003.560 DEPOSIT ABSOLUTE /end AXIS_PTS
/begin CHARACTERISTIC InjCrv_facPiI2ATSQCorStrt_CUR "weighting factor of intake air temperature for PiI2 quantity correction" CURVE 0x80046F3A Kl_Xs16_Ws16 1.000000 Fact 0.00 1.000000 EXTENDED_LIMITS -4.000000 3.999878
 /begin AXIS_DESCR STD_AXIS InjCrv_tAirPiI Temp_Cels 2 -50.14000 199.8600 EXTENDED_LIMITS -3549.940 3003.560 DEPOSIT ABSOLUTE /end AXIS_DESCR
/end CHARACTERISTIC
/begin CHARACTERISTIC InjCrv_facPiI2ATSQCor_CUR "ansauglufttemperaturabhängige Mengenkorrekturkennlinie für PiI2" CURVE 0x80047DB2 Cur_Xs16Ws16 1.000000 Fact 0.00 1.000000 EXTENDED_LIMITS -4.000000 3.999878
 /begin AXIS_DESCR STD_AXIS InjCrv_tAirPiI Temp_Cels 8 -50.14000 199.8600 EXTENDED_LIMITS -3549.940 3003.560 DEPOSIT ABSOLUTE /end AXIS_DESCR
/end CHARACTERISTIC
/begin CHARACTERISTIC InjCrv_facPiI2ATSSOECor0Rgn_GCUR "umgebungstemperaturabhängige Ansteuerbeginnkorrekturkennlinie für PiI2 für die Regenerationsstufe 1" CURVE 0x80047EDC CurG_Ws16 1.000000 Fact 0.00 1.000000 EXTENDED_LIMITS -4.000000 3.999878
 /begin AXIS_DESCR COM_AXIS InjSys_tAirRgn Temp_Cels 6 -50.14000 199.8600 EXTENDED_LIMITS -3549.940 3003.560 AXIS_PTS_REF InjCrv_facPiI2ATSSOECorRgn_AXIS /end AXIS_DESCR
/end CHARACTERISTIC
/begin CHARACTERISTIC InjCrv_facPiI2ATSSOECor1Rgn_GCUR "umgebungstemperaturabhängige Ansteuerbeginnkorrekturkennlinie für PiI2 für die Regenerationsstufe 2" CURVE 0x80047EE8 CurG_Ws16 1.000000 Fact 0.00 1.000000 EXTENDED_LIMITS -4.000000 3.999878
 /begin AXIS_DESCR COM_AXIS InjSys_tAirRgn Temp_Cels 6 -50.14000 199.8600 EXTENDED_LIMITS -3549.940 3003.560 AXIS_PTS_REF InjCrv_facPiI2ATSSOECorRgn_AXIS /end AXIS_DESCR
/end CHARACTERISTIC
/begin AXIS_PTS InjCrv_facPiI2ATSSOECorRgn_AXIS "gemeinsame Stützstellen für umgebungstemperaturabhängige Ansteuerbeginnkorrekturkennlinien für PiI2 für die Regeneration" 0x80047EF4 InjSys_tAirRgn Axis_Xs16 250.0000 Temp_Cels 6 -50.14000 199.8600 FORMAT "%8.4" EXTENDED_LIMITS -3549.940 3003.560 DEPOSIT ABSOLUTE /end AXIS_PTS
/begin CHARACTERISTIC InjCrv_facPiI2ATSSOECor_CUR "Ansauglufttemperaturspezifischer Gewichtungsfaktor für PiI2" CURVE 0x80047DD4 Cur_Xs16Ws16 1.000000 Fact 0.00 1.000000 EXTENDED_LIMITS -4.000000 3.999878
 /begin AXIS_DESCR STD_AXIS InjCrv_tAirPiI Temp_Cels 8 -50.14000 199.8600 EXTENDED_LIMITS -3549.940 3003.560 DEPOSIT ABSOLUTE /end AXIS_DESCR
/end CHARACTERISTIC
/begin CHARACTERISTIC InjCrv_facPiI2ETSQCor0Rgn_GCUR "motortemperaturabhängige Mengenkorrekturkennlinie für PiI2 für die Regenerationsstufe 1" CURVE 0x80047F02 CurG_Ws16 1.000000 Fact 0.00 1.000000 EXTENDED_LIMITS -4.000000 3.999878
 /begin AXIS_DESCR COM_AXIS InjSys_tEngRgn Temp_Cels 10 -3549.940 3003.560 AXIS_PTS_REF InjCrv_facPiI2ETSQCorRgn_AXIS /end AXIS_DESCR
/end CHARACTERISTIC
/begin CHARACTERISTIC InjCrv_facPiI2ETSQCor11_CUR "" CURVE 0x80046F44 Kl_Xs16_Ws16 1.000000 Fact 0.00 1.000000 EXTENDED_LIMITS -4.000000 3.999878
 /begin AXIS_DESCR STD_AXIS InjSys_tEng Temp_Cels 8 -50.14000 199.8600 EXTENDED_LIMITS -3549.940 3003.560 DEPOSIT ABSOLUTE /end AXIS_DESCR
/end CHARACTERISTIC
/begin CHARACTERISTIC InjCrv_facPiI2ETSQCor1Rgn_GCUR "motortemperaturabhängige Mengenkorrekturkennlinie für PiI2 für die Regenerationsstufe 2" CURVE 0x80047F16 CurG_Ws16 1.000000 Fact 0.00 1.000000 EXTENDED_LIMITS -4.000000 3.999878
 /begin AXIS_DESCR COM_AXIS InjSys_tEngRgn Temp_Cels 10 -3549.940 3003.560 AXIS_PTS_REF InjCrv_facPiI2ETSQCorRgn_AXIS /end AXIS_DESCR
/end CHARACTERISTIC
/begin AXIS_PTS InjCrv_facPiI2ETSQCorRgn_AXIS "gemeinsame Stützstellen für motortemperaturabhängige Mengenkorrekturkennlinien für PiI2 für die Regeneration" 0x80047F2A InjSys_tEngRgn Axis_Xs16 6553.500 Temp_Cels 10 -3549.940 3003.560 FORMAT "%8.3" DEPOSIT ABSOLUTE /end AXIS_PTS
/begin CHARACTERISTIC InjCrv_facPiI2ETSQCorStrt_CUR "weighting factor of engine temperature for PiI2 quantity correction" CURVE 0x80046F66 Kl_Xs16_Ws16 1.000000 Fact 0.00 1.000000 EXTENDED_LIMITS -4.000000 3.999878
 /begin AXIS_DESCR STD_AXIS InjSys_tEng Temp_Cels 2 -50.14000 199.8600 EXTENDED_LIMITS -3549.940 3003.560 DEPOSIT ABSOLUTE /end AXIS_DESCR
/end CHARACTERISTIC
/begin CHARACTERISTIC InjCrv_facPiI2ETSQCor_CUR "motortemperaturabhängige Mengenkorrekturkennlinie für PiI2" CURVE 0x80047DF6 Cur_Xs16Ws16 1.000000 Fact 0.00 1.000000 EXTENDED_LIMITS -4.000000 3.999878
 /begin AXIS_DESCR STD_AXIS InjSys_tEng Temp_Cels 8 -50.14000 199.8600 EXTENDED_LIMITS -3549.940 3003.560 DEPOSIT ABSOLUTE /end AXIS_DESCR
/end CHARACTERISTIC
/begin CHARACTERISTIC InjCrv_facPiI2ETSSOECor0Rgn_GCUR "motortemperaturabhängige Ansteuerbeginnkorrekturkennlinie für die PiI2 für die Regenerationsstufe 1" CURVE 0x80047F40 CurG_Ws16 1.000000 Fact 0.00 1.000000 EXTENDED_LIMITS -4.000000 3.999878
 /begin AXIS_DESCR COM_AXIS InjSys_tEngRgn Temp_Cels 10 -50.14000 199.8600 EXTENDED_LIMITS -3549.940 3003.560 AXIS_PTS_REF InjCrv_facPiI2ETSSOECorRgn_AXIS /end AXIS_DESCR
/end CHARACTERISTIC
/begin CHARACTERISTIC InjCrv_facPiI2ETSSOECor1Rgn_GCUR "motortemperaturabhängige Ansteuerbeginnkorrekturkennlinie für die PiI2 für die Regenerationsstufe 2" CURVE 0x80047F54 CurG_Ws16 1.000000 Fact 0.00 1.000000 EXTENDED_LIMITS -4.000000 3.999878
 /begin AXIS_DESCR COM_AXIS InjSys_tEngRgn Temp_Cels 10 -50.14000 199.8600 EXTENDED_LIMITS -3549.940 3003.560 AXIS_PTS_REF InjCrv_facPiI2ETSSOECorRgn_AXIS /end AXIS_DESCR
/end CHARACTERISTIC
/begin AXIS_PTS InjCrv_facPiI2ETSSOECorRgn_AXIS "gemeinsame Stützstellen für motortemperaturabhängige Ansteuerbeginnkorrekturkennlinien für PiI2 für die Regeneration" 0x80047F68 InjSys_tEngRgn Axis_Xs16 250.0000 Temp_Cels 10 -50.14000 199.8600 FORMAT "%8.4" EXTENDED_LIMITS -3549.940 3003.560 DEPOSIT ABSOLUTE /end AXIS_PTS
/begin CHARACTERISTIC InjCrv_facPiI2ETSSOECorStrt_CUR "motortemperaturabhängige Ansteuerbeginnkorrekturkennlinie für Voreinspritzung 2 im Startfall" CURVE 0x80046F70 Kl_Xs16_Ws16 1.000000 Fact 0.00 1.000000 EXTENDED_LIMITS -4.000000 3.999878
 /begin AXIS_DESCR STD_AXIS InjSys_tEng Temp_Cels 2 -50.14000 199.8600 EXTENDED_LIMITS -3549.940 3003.560 DEPOSIT ABSOLUTE /end AXIS_DESCR
/end CHARACTERISTIC
/begin CHARACTERISTIC InjCrv_facPiI2ETSSOECor_CUR "motortemperaturabhängige Ansteuerbeginnkorrekturkennlinie für PiI2" CURVE 0x80047E18 Cur_Xs16Ws16 1.000000 Fact 0.00 1.000000 EXTENDED_LIMITS -4.000000 3.999878
 /begin AXIS_DESCR STD_AXIS InjSys_tEng Temp_Cels 8 -50.14000 199.8600 EXTENDED_LIMITS -3549.940 3003.560 DEPOSIT ABSOLUTE /end AXIS_DESCR
/end CHARACTERISTIC
/begin CHARACTERISTIC InjCrv_facPiI2QntMin_CUR "Faktor zur Berechnung der Mindestmenge für die Abschaltung der Voreinspritzung PiI2" CURVE 0x80046880 Cur_Xs16Ws16 1.000000 Fact1 0.00 1.000000 EXTENDED_LIMITS -256.0000 255.9922
 /begin AXIS_DESCR STD_AXIS RailP_pFlt Pres_Rail 8 0.00 2000.000 EXTENDED_LIMITS -3276.800 3276.700 DEPOSIT ABSOLUTE /end AXIS_DESCR
/end CHARACTERISTIC
/begin CHARACTERISTIC InjCrv_facPiI2QntRmp0Val_GCUR "Faktorisierungskennlinie für die Menge der PiI2" CURVE 0x80048816 CurG_Ws16 3.999939 CoEOMSwt_S16 -2.000000 1.999939 FORMAT "%8.6"
 /begin AXIS_DESCR COM_AXIS CoEOM_facRmpVal CoEOMSwt_S16 10 -2.000000 1.999939 FORMAT "%8.6" AXIS_PTS_REF InjCrv_facPiI2QntRmpValX_AXIS /end AXIS_DESCR
/end CHARACTERISTIC
/begin CHARACTERISTIC InjCrv_facPiI2QntRmp1Val_GCUR "Faktorisierungskennlinie für die Menge der PiI2" CURVE 0x8004882A CurG_Ws16 3.999939 CoEOMSwt_S16 -2.000000 1.999939 FORMAT "%8.6"
 /begin AXIS_DESCR COM_AXIS CoEOM_facRmpVal CoEOMSwt_S16 10 -2.000000 1.999939 FORMAT "%8.6" AXIS_PTS_REF InjCrv_facPiI2QntRmpValX_AXIS /end AXIS_DESCR
/end CHARACTERISTIC
/begin AXIS_PTS InjCrv_facPiI2QntRmpValX_AXIS "Gruppenkennlinien-Achse für die Gewichtung des Mengen-Faktors der PiI2" 0x8004883E CoEOM_facRmpVal Axis_Xs16 3.999939 CoEOMSwt_S16 10 -2.000000 1.999939 FORMAT "%8.6" DEPOSIT ABSOLUTE /end AXIS_PTS
/begin CHARACTERISTIC InjCrv_facPiI2SOERmp0Val_GCUR "Faktorisierungskennlinie für den Einspritzbeginn der PiI2" CURVE 0x80048854 CurG_Ws16 3.999939 CoEOMSwt_S16 -2.000000 1.999939 FORMAT "%8.6"
 /begin AXIS_DESCR COM_AXIS CoEOM_facRmpVal CoEOMSwt_S16 10 -2.000000 1.999939 FORMAT "%8.6" AXIS_PTS_REF InjCrv_facPiI2SOERmpValX_AXIS /end AXIS_DESCR
/end CHARACTERISTIC
/begin CHARACTERISTIC InjCrv_facPiI2SOERmp1Val_GCUR "Faktorisierungskennlinie für den Einspritzbeginn der PiI2" CURVE 0x80048868 CurG_Ws16 3.999939 CoEOMSwt_S16 -2.000000 1.999939 FORMAT "%8.6"
 /begin AXIS_DESCR COM_AXIS CoEOM_facRmpVal CoEOMSwt_S16 10 -2.000000 1.999939 FORMAT "%8.6" AXIS_PTS_REF InjCrv_facPiI2SOERmpValX_AXIS /end AXIS_DESCR
/end CHARACTERISTIC
/begin AXIS_PTS InjCrv_facPiI2SOERmpValX_AXIS "Gruppenkennlinien-Achse für die Gewichtung des Einspritzbeginn-Faktors der PiI2" 0x8004887C CoEOM_facRmpVal Axis_Xs16 3.999939 CoEOMSwt_S16 10 -2.000000 1.999939 FORMAT "%8.6" DEPOSIT ABSOLUTE /end AXIS_PTS
/begin CHARACTERISTIC InjCrv_facPiI2VehCor_CUR "" CURVE 0x80046C92 Kl_Xs16_Ws16 100.0000 Fact 0.00 100.0000 EXTENDED_LIMITS -4.000000 3.999878 /begin AXIS_DESCR STD_AXIS VehV_v Vel 4 -327.6800 327.6700 DEPOSIT ABSOLUTE /end AXIS_DESCR /end CHARACTERISTIC
/begin CHARACTERISTIC InjCrv_facPiI2VehTempCor_CUR "" CURVE 0x80046CA4 Kl_Xs16_Ws16 100.0000 Fact 0.00 100.0000 EXTENDED_LIMITS -4.000000 3.999878
 /begin AXIS_DESCR STD_AXIS CEngDsT_t Temp_Cels 8 -3549.940 3003.560 DEPOSIT ABSOLUTE /end AXIS_DESCR
/end CHARACTERISTIC
/begin CHARACTERISTIC InjCrv_facPoI1Eff_MAP "" MAP 0x800489C4 Map_Xs16Ys16Ws16 1.000000 Fact 0.00 1.000000 EXTENDED_LIMITS -4.000000 3.999878
 /begin AXIS_DESCR STD_AXIS Epm_nEng EngN 8 0.00 10000.00 EXTENDED_LIMITS -16384.00 16383.50 DEPOSIT ABSOLUTE /end AXIS_DESCR
 /begin AXIS_DESCR STD_AXIS InjCtl_qSetUnBal InjMass 8 0.00 327.6700 EXTENDED_LIMITS -327.6800 327.6700 DEPOSIT ABSOLUTE /end AXIS_DESCR
/end CHARACTERISTIC
/begin CHARACTERISTIC InjCrv_facPoI1QntMin_C "Faktor zum Umrechnen der nach unten begrenzenden Menge der PoI1" VALUE 0x80048A68 Val_Ws16 1.000000 Fact1 0.00 1.000000 EXTENDED_LIMITS -256.0000 255.9922 /end CHARACTERISTIC
/begin CHARACTERISTIC InjCrv_facPoI1RgnAPSQCor_CUR "" CURVE 0x80048C08 Cur_Xs16Ws16 1.000000 Fact 0.00 1.000000 EXTENDED_LIMITS -4.000000 3.999878
 /begin AXIS_DESCR STD_AXIS EnvP_p Pres_hPa 16 0.00 3500.000 EXTENDED_LIMITS -32768.00 32767.00 DEPOSIT ABSOLUTE /end AXIS_DESCR
/end CHARACTERISTIC
/begin CHARACTERISTIC InjCrv_nDiffMin_C "Minimaler Drehzahlunterschied für die Freigabe der Voreinspritzung 2" VALUE 0x800468A2 Val_Ws16 10000.00 EngN 0.00 10000.00 EXTENDED_LIMITS -16384.00 16383.50 /end CHARACTERISTIC
/begin CHARACTERISTIC InjCrv_phiDynOfs_CUR "Winkelvorhaltkennfeld für schnelle dynamische Vorgänge" CURVE 0x80048A6A Cur_Xs16Ws16 719.9780 AngleCrS 0.00 719.9780 EXTENDED_LIMITS -720.0000 719.9780
 /begin AXIS_DESCR STD_AXIS Epm_nEng EngN 8 0.00 10000.00 EXTENDED_LIMITS -16384.00 16383.50 DEPOSIT ABSOLUTE /end AXIS_DESCR
/end CHARACTERISTIC
/begin CHARACTERISTIC InjCrv_phiPiI2BasStrt_MAP "niedriger Wert des SOE Winkels für PII2 während des Motor Start State" MAP 0x80048986 Kf_Xs16_Ys16_Ws16 50.00977 AngleCrS -25.00488 25.00488 EXTENDED_LIMITS -720.0000 719.9780
 /begin AXIS_DESCR STD_AXIS Epm_nEng EngN 2 0.00 6000.000 EXTENDED_LIMITS -16384.00 16383.50 DEPOSIT ABSOLUTE /end AXIS_DESCR
 /begin AXIS_DESCR STD_AXIS InjCtl_qSetUnBal InjMass 2 0.00 327.6700 EXTENDED_LIMITS -327.6800 327.6700 DEPOSIT ABSOLUTE /end AXIS_DESCR
/end CHARACTERISTIC
/begin CHARACTERISTIC InjCrv_phiPiI2Des_C "Fernsteuerwert des Ansteuerbeginns (Winkelkomponente) der PiI2" VALUE 0x800468A4 Val_Ws16 720.0000 AngleCrS 0.00 720.0000 EXTENDED_LIMITS -720.0000 719.9780 /end CHARACTERISTIC
/begin CHARACTERISTIC InjCrv_phiPiI2ETSCorStrt_MAP "base correction map for angle-component of SOE of PiI2" MAP 0x80046CC6 Kf_Xs16_Ys16_Ws16 50.00977 AngleCrS -25.00488 25.00488 EXTENDED_LIMITS -720.0000 719.9780
 /begin AXIS_DESCR STD_AXIS Epm_nEng EngN 2 0.00 6000.000 EXTENDED_LIMITS -16384.00 16383.50 DEPOSIT ABSOLUTE /end AXIS_DESCR
 /begin AXIS_DESCR STD_AXIS InjCtl_qSetUnBal InjMass 2 0.00 327.6700 EXTENDED_LIMITS -327.6800 327.6700 DEPOSIT ABSOLUTE /end AXIS_DESCR
/end CHARACTERISTIC
/begin CHARACTERISTIC InjCrv_phiPoI1Des_C "Fernsteuerwert des Ansteuerwinkels der PoI1" VALUE 0x80048A8C Val_Ws16 99.99756 AngleCrS -99.99756 0.00 EXTENDED_LIMITS -720.0000 719.9780 /end CHARACTERISTIC
/begin CHARACTERISTIC InjCrv_phiPoI1Max_MAP "Maximaler Ansteuerbeginnwinkel PoI1" MAP 0x80048A8E Map_Xs16Ys16Ws16 60.00732 AngleCrS -99.99756 -39.99023 EXTENDED_LIMITS -720.0000 719.9780
 /begin AXIS_DESCR STD_AXIS Epm_nEng EngN 8 0.00 10000.00 EXTENDED_LIMITS -16384.00 16383.50 DEPOSIT ABSOLUTE /end AXIS_DESCR
 /begin AXIS_DESCR STD_AXIS InjCtl_qSetUnBal InjMass 8 0.00 327.6700 EXTENDED_LIMITS -327.6800 327.6700 DEPOSIT ABSOLUTE /end AXIS_DESCR
/end CHARACTERISTIC
/begin CHARACTERISTIC InjCrv_phiPoI1Min_C "" VALUE 0x80048B32 Val_Ws16 99.99756 AngleCrS -99.99756 0.00 EXTENDED_LIMITS -720.0000 719.9780 /end CHARACTERISTIC
/begin CHARACTERISTIC InjCrv_qDiffMin_C "Minimale positive Mengendifferenz für Freigabe Voreinspritzung 2" VALUE 0x800468A6 Val_Ws16 327.6700 InjMassInj 0.00 327.6700 EXTENDED_LIMITS -327.6800 327.6700 /end CHARACTERISTIC
/begin CHARACTERISTIC InjCrv_qMI1MinPiI2DiffHys_C "Differenzmenge zwischen unterer und oberer Hystereseschwelle bei PiI2 für Freigabe PiI2 wenn genügend Menge für MI und PiI2" VALUE 0x800468A8 Val_Ws16 10.00000 InjMass 0.00 10.00000 EXTENDED_LIMITS -327.6800 327.6700 /end CHARACTERISTIC
/begin CHARACTERISTIC InjCrv_qPiI1APSCor0Rgn1_GMAP "Druckabhängiger Basiswert für die Mengenkorrektur 1 der PiI1 für die Regenerationsstufe 1" MAP 0x80043F14 MapG_Ws16 10.00000 InjMass 0.00 10.00000 EXTENDED_LIMITS -327.6800 327.6700
 /begin AXIS_DESCR COM_AXIS Epm_nEng EngN 10 0.00 10000.00 EXTENDED_LIMITS -16384.00 16383.50 AXIS_PTS_REF InjCrv_qPiI1APSCorRgnX_AXIS /end AXIS_DESCR
 /begin AXIS_DESCR COM_AXIS InjCtl_qSetUnBal InjMass 10 0.00 327.6700 EXTENDED_LIMITS -327.6800 327.6700 AXIS_PTS_REF InjCrv_qPiI1APSCorRgnY_AXIS /end AXIS_DESCR
/end CHARACTERISTIC
/begin CHARACTERISTIC InjCrv_qPiI1APSCor0Rgn2_GMAP "Druckabhängiger Basiswert für die Mengenkorrektur 2 der PiI1 für die Regenerationsstufe 1" MAP 0x80043FDC MapG_Ws16 10.00000 InjMass 0.00 10.00000 EXTENDED_LIMITS -327.6800 327.6700
 /begin AXIS_DESCR COM_AXIS Epm_nEng EngN 10 0.00 10000.00 EXTENDED_LIMITS -16384.00 16383.50 AXIS_PTS_REF InjCrv_qPiI1APSCorRgnX_AXIS /end AXIS_DESCR
 /begin AXIS_DESCR COM_AXIS InjCtl_qSetUnBal InjMass 10 0.00 327.6700 EXTENDED_LIMITS -327.6800 327.6700 AXIS_PTS_REF InjCrv_qPiI1APSCorRgnY_AXIS /end AXIS_DESCR
/end CHARACTERISTIC
/begin CHARACTERISTIC InjCrv_qPiI1APSCor1Rgn1_GMAP "Druckabhängiger Basiswert für die Mengenkorrektur 1 der PiI1 für die Regenerationsstufe 2" MAP 0x800440A4 MapG_Ws16 10.00000 InjMass 0.00 10.00000 EXTENDED_LIMITS -327.6800 327.6700
 /begin AXIS_DESCR COM_AXIS Epm_nEng EngN 10 0.00 10000.00 EXTENDED_LIMITS -16384.00 16383.50 AXIS_PTS_REF InjCrv_qPiI1APSCorRgnX_AXIS /end AXIS_DESCR
 /begin AXIS_DESCR COM_AXIS InjCtl_qSetUnBal InjMass 10 0.00 327.6700 EXTENDED_LIMITS -327.6800 327.6700 AXIS_PTS_REF InjCrv_qPiI1APSCorRgnY_AXIS /end AXIS_DESCR
/end CHARACTERISTIC
/begin CHARACTERISTIC InjCrv_qPiI1APSCor1Rgn2_GMAP "Druckabhängiger Basiswert für die Mengenkorrektur 2 der PiI1 für die Regenerationsstufe 2" MAP 0x8004416C MapG_Ws16 10.00000 InjMass 0.00 10.00000 EXTENDED_LIMITS -327.6800 327.6700
 /begin AXIS_DESCR COM_AXIS Epm_nEng EngN 10 0.00 10000.00 EXTENDED_LIMITS -16384.00 16383.50 AXIS_PTS_REF InjCrv_qPiI1APSCorRgnX_AXIS /end AXIS_DESCR
 /begin AXIS_DESCR COM_AXIS InjCtl_qSetUnBal InjMass 10 0.00 327.6700 EXTENDED_LIMITS -327.6800 327.6700 AXIS_PTS_REF InjCrv_qPiI1APSCorRgnY_AXIS /end AXIS_DESCR
/end CHARACTERISTIC
/begin CHARACTERISTIC InjCrv_qPiI1APSCor1_MAP "atmosphärendruckabhängiges Einspritzmengenkorrekturkennfeld 1 für PiI1" MAP 0x80043758 MapG_Ws16 10.00000 InjMass 0.00 10.00000 EXTENDED_LIMITS -327.6800 327.6700
 /begin AXIS_DESCR COM_AXIS Epm_nEng EngN 10 0.00 10000.00 EXTENDED_LIMITS -16384.00 16383.50 AXIS_PTS_REF InjCrv_qPiI1APSCor_X_AXIS /end AXIS_DESCR
 /begin AXIS_DESCR COM_AXIS InjCtl_qSetUnBal InjMass 10 0.00 327.6700 EXTENDED_LIMITS -327.6800 327.6700 AXIS_PTS_REF InjCrv_qPiI1APSCor_Y_AXIS /end AXIS_DESCR
/end CHARACTERISTIC
/begin CHARACTERISTIC InjCrv_qPiI1APSCor2_MAP "atmosphärendruckabhängiges Einspritzmengenkorrekturkennfeld 2 für PiI1 und PiI2" MAP 0x80043820 MapG_Ws16 10.00000 InjMass 0.00 10.00000 EXTENDED_LIMITS -327.6800 327.6700
 /begin AXIS_DESCR COM_AXIS Epm_nEng EngN 10 0.00 10000.00 EXTENDED_LIMITS -16384.00 16383.50 AXIS_PTS_REF InjCrv_qPiI1APSCor_X_AXIS /end AXIS_DESCR
 /begin AXIS_DESCR COM_AXIS InjCtl_qSetUnBal InjMass 10 0.00 327.6700 EXTENDED_LIMITS -327.6800 327.6700 AXIS_PTS_REF InjCrv_qPiI1APSCor_Y_AXIS /end AXIS_DESCR
/end CHARACTERISTIC
/begin AXIS_PTS InjCrv_qPiI1APSCorRgnX_AXIS "Stützstellenverteilung für das druckabhängige Mengenkorrekturkennfeld InjCrv_qPiI1APSCor%Rgn%_GMAP" 0x80044234 Epm_nEng Axis_Xs16 10000.00 EngN 10 0.00 10000.00 FORMAT "%8.2" EXTENDED_LIMITS -16384.00 16383.50 DEPOSIT ABSOLUTE /end AXIS_PTS
/begin AXIS_PTS InjCrv_qPiI1APSCorRgnY_AXIS "Stützstellenverteilung für das druckabhängige Mengenkorrekturkennfeld InjCrv_qPiI1APSCor%Rgn%_GMAP" 0x8004424A InjCtl_qSetUnBal Axis_Xs16 327.6700 InjMass 10 0.00 327.6700 FORMAT "%8.4" EXTENDED_LIMITS -327.6800 327.6700 DEPOSIT ABSOLUTE /end AXIS_PTS
/begin CHARACTERISTIC InjCrv_qPiI1APSCorStrt_MAP "Korrekturwert für atmosphärendruckabhängige Mengenkorrektur für pilot injection." MAP 0x80042246 Kf_Xs16_Ys16_Ws16 655.3500 InjMassInj -327.6800 327.6700
 /begin AXIS_DESCR STD_AXIS Epm_nEng EngN 2 -16384.00 16383.50 DEPOSIT ABSOLUTE /end AXIS_DESCR
 /begin AXIS_DESCR STD_AXIS InjCtl_qSetUnBal InjMass 8 -327.6800 327.6700 DEPOSIT ABSOLUTE /end AXIS_DESCR
/end CHARACTERISTIC
/begin AXIS_PTS InjCrv_qPiI1APSCor_X_AXIS "gemeinsame X-Achse für atmosphärendruckabhängige Mengenkorrekturkennfelder für PiI 1" 0x800438E8 Epm_nEng Axis_Xs16 10000.00 EngN 10 0.00 10000.00 FORMAT "%8.2" EXTENDED_LIMITS -16384.00 16383.50 DEPOSIT ABSOLUTE /end AXIS_PTS
/begin AXIS_PTS InjCrv_qPiI1APSCor_Y_AXIS "gemeinsame Y-Achse für atmosphärendruckabhängige Mengenkorrekturkennfelder für PiI 1" 0x800438FE InjCtl_qSetUnBal Axis_Xs16 327.6700 InjMass 10 0.00 327.6700 FORMAT "%8.4" EXTENDED_LIMITS -327.6800 327.6700 DEPOSIT ABSOLUTE /end AXIS_PTS
/begin CHARACTERISTIC InjCrv_qPiI1ATSCor0Rgn1_GMAP "Lufttemperaturabhängiger Basiswert für die Mengenkorrektur 1 der PiI1 für die Regenerationsstufe 1" MAP 0x80044260 MapG_Ws16 10.00000 InjMass 0.00 10.00000 EXTENDED_LIMITS -327.6800 327.6700
 /begin AXIS_DESCR COM_AXIS Epm_nEng EngN 10 0.00 10000.00 EXTENDED_LIMITS -16384.00 16383.50 AXIS_PTS_REF InjCrv_qPiI1ATSCorRgnX_AXIS /end AXIS_DESCR
 /begin AXIS_DESCR COM_AXIS InjCtl_qSetUnBal InjMass 10 0.00 327.6700 EXTENDED_LIMITS -327.6800 327.6700 AXIS_PTS_REF InjCrv_qPiI1ATSCorRgnY_AXIS /end AXIS_DESCR
/end CHARACTERISTIC
/begin CHARACTERISTIC InjCrv_qPiI1ATSCor0Rgn2_GMAP "Lufttemperaturabhängiger Basiswert für die Mengenkorrektur 2 der PiI1 für die Regenerationsstufe 1" MAP 0x80044328 MapG_Ws16 10.00000 InjMass 0.00 10.00000 EXTENDED_LIMITS -327.6800 327.6700
 /begin AXIS_DESCR COM_AXIS Epm_nEng EngN 10 0.00 10000.00 EXTENDED_LIMITS -16384.00 16383.50 AXIS_PTS_REF InjCrv_qPiI1ATSCorRgnX_AXIS /end AXIS_DESCR
 /begin AXIS_DESCR COM_AXIS InjCtl_qSetUnBal InjMass 10 0.00 327.6700 EXTENDED_LIMITS -327.6800 327.6700 AXIS_PTS_REF InjCrv_qPiI1ATSCorRgnY_AXIS /end AXIS_DESCR
/end CHARACTERISTIC
/begin CHARACTERISTIC InjCrv_qPiI1ATSCor1Rgn1_GMAP "Lufttemperaturabhängiger Basiswert für die Mengenkorrektur 1 der PiI1 für die Regenerationsstufe 2" MAP 0x800443F0 MapG_Ws16 10.00000 InjMass 0.00 10.00000 EXTENDED_LIMITS -327.6800 327.6700
 /begin AXIS_DESCR COM_AXIS Epm_nEng EngN 10 0.00 10000.00 EXTENDED_LIMITS -16384.00 16383.50 AXIS_PTS_REF InjCrv_qPiI1ATSCorRgnX_AXIS /end AXIS_DESCR
 /begin AXIS_DESCR COM_AXIS InjCtl_qSetUnBal InjMass 10 0.00 327.6700 EXTENDED_LIMITS -327.6800 327.6700 AXIS_PTS_REF InjCrv_qPiI1ATSCorRgnY_AXIS /end AXIS_DESCR
/end CHARACTERISTIC
/begin CHARACTERISTIC InjCrv_qPiI1ATSCor1Rgn2_GMAP "Lufttemperaturabhängiger Basiswert für die Mengenkorrektur 2 der PiI1 für die Regenerationsstufe 2" MAP 0x800444B8 MapG_Ws16 10.00000 InjMass 0.00 10.00000 EXTENDED_LIMITS -327.6800 327.6700
 /begin AXIS_DESCR COM_AXIS Epm_nEng EngN 10 0.00 10000.00 EXTENDED_LIMITS -16384.00 16383.50 AXIS_PTS_REF InjCrv_qPiI1ATSCorRgnX_AXIS /end AXIS_DESCR
 /begin AXIS_DESCR COM_AXIS InjCtl_qSetUnBal InjMass 10 0.00 327.6700 EXTENDED_LIMITS -327.6800 327.6700 AXIS_PTS_REF InjCrv_qPiI1ATSCorRgnY_AXIS /end AXIS_DESCR
/end CHARACTERISTIC
/begin CHARACTERISTIC InjCrv_qPiI1ATSCor1_MAP "ansauglufttemperaturabhängiges Einspritzmengenkorrekturkennfeld 1 für PiI1" MAP 0x80043914 MapG_Ws16 10.00000 InjMass 0.00 10.00000 EXTENDED_LIMITS -327.6800 327.6700
 /begin AXIS_DESCR COM_AXIS Epm_nEng EngN 10 0.00 10000.00 EXTENDED_LIMITS -16384.00 16383.50 AXIS_PTS_REF InjCrv_qPiI1ATSCor_X_AXIS /end AXIS_DESCR
 /begin AXIS_DESCR COM_AXIS InjCtl_qSetUnBal InjMass 10 0.00 327.6700 EXTENDED_LIMITS -327.6800 327.6700 AXIS_PTS_REF InjCrv_qPiI1ATSCor_Y_AXIS /end AXIS_DESCR
/end CHARACTERISTIC
/begin CHARACTERISTIC InjCrv_qPiI1ATSCor2_MAP "ansauglufttemperaturabhängiges Einspritzmengenkorrekturkennfeld 2 für PiI1 und PiI2" MAP 0x800439DC MapG_Ws16 10.00000 InjMass 0.00 10.00000 EXTENDED_LIMITS -327.6800 327.6700
 /begin AXIS_DESCR COM_AXIS Epm_nEng EngN 10 0.00 10000.00 EXTENDED_LIMITS -16384.00 16383.50 AXIS_PTS_REF InjCrv_qPiI1ATSCor_X_AXIS /end AXIS_DESCR
 /begin AXIS_DESCR COM_AXIS InjCtl_qSetUnBal InjMass 10 0.00 327.6700 EXTENDED_LIMITS -327.6800 327.6700 AXIS_PTS_REF InjCrv_qPiI1ATSCor_Y_AXIS /end AXIS_DESCR
/end CHARACTERISTIC
/begin AXIS_PTS InjCrv_qPiI1ATSCorRgnX_AXIS "Stützstellenverteilung für das lufttemperaturabhängige Mengenkorrekturkennfeld InjCrv_qPiI1ATSCor%Rgn%_GMAP" 0x80044580 Epm_nEng Axis_Xs16 10000.00 EngN 10 0.00 10000.00 FORMAT "%8.2" EXTENDED_LIMITS -16384.00 16383.50 DEPOSIT ABSOLUTE /end AXIS_PTS
/begin AXIS_PTS InjCrv_qPiI1ATSCorRgnY_AXIS "Stützstellenverteilung für das lufttemperaturabhängige Mengenkorrekturkennfeld InjCrv_qPiI1ATSCor%Rgn%_GMAP" 0x80044596 InjCtl_qSetUnBal Axis_Xs16 327.6700 InjMass 10 0.00 327.6700 FORMAT "%8.4" EXTENDED_LIMITS -327.6800 327.6700 DEPOSIT ABSOLUTE /end AXIS_PTS
/begin CHARACTERISTIC InjCrv_qPiI1ATSCorStrt_MAP "correction value for intake air temperature dependent pilot injections quantity correction" MAP 0x8004227E Kf_Xs16_Ys16_Ws16 655.3500 InjMassInj -327.6800 327.6700
 /begin AXIS_DESCR STD_AXIS Epm_nEng EngN 2 -16384.00 16383.50 DEPOSIT ABSOLUTE /end AXIS_DESCR
 /begin AXIS_DESCR STD_AXIS InjCtl_qSetUnBal InjMass 2 -327.6800 327.6700 DEPOSIT ABSOLUTE /end AXIS_DESCR
/end CHARACTERISTIC
/begin AXIS_PTS InjCrv_qPiI1ATSCor_X_AXIS "gemeinsame X-Achse für ansauglufttemperaturabhängige Mengenkennfelder für PiI 1" 0x80043AA4 Epm_nEng Axis_Xs16 10000.00 EngN 10 0.00 10000.00 FORMAT "%8.2" EXTENDED_LIMITS -16384.00 16383.50 DEPOSIT ABSOLUTE /end AXIS_PTS
/begin AXIS_PTS InjCrv_qPiI1ATSCor_Y_AXIS "gemeinsame Y-Achse für ansauglufttemperaturabhängige Mengenkennfelder für PiI 1" 0x80043ABA InjCtl_qSetUnBal Axis_Xs16 327.6700 InjMass 10 0.00 327.6700 FORMAT "%8.4" EXTENDED_LIMITS -327.6800 327.6700 DEPOSIT ABSOLUTE /end AXIS_PTS
/begin CHARACTERISTIC InjCrv_qPiI1Bas0Rgn1_GMAP "Kennfeld für Basiswert für die Basismenge der PiI1 für die Regenerationsstufe 1 bei inaktiver PiI2" MAP 0x800457F2 MapG_Ws16 10.00000 InjMass 0.00 10.00000 EXTENDED_LIMITS -327.6800 327.6700
 /begin AXIS_DESCR COM_AXIS Epm_nEng EngN 10 0.00 10000.00 EXTENDED_LIMITS -16384.00 16383.50 AXIS_PTS_REF InjCrv_qPiI1BasRgnX_AXIS /end AXIS_DESCR
 /begin AXIS_DESCR COM_AXIS InjCtl_qSetUnBal InjMass 10 0.00 327.6700 EXTENDED_LIMITS -327.6800 327.6700 AXIS_PTS_REF InjCrv_qPiI1BasRgnY_AXIS /end AXIS_DESCR
/end CHARACTERISTIC
/begin CHARACTERISTIC InjCrv_qPiI1Bas0Rgn2_GMAP "Kennfeld für Basiswert für die Basismenge der PiI1 für die Regenerationsstufe 1 bei aktiver PiI2" MAP 0x800458BA MapG_Ws16 10.00000 InjMass 0.00 10.00000 EXTENDED_LIMITS -327.6800 327.6700
 /begin AXIS_DESCR COM_AXIS Epm_nEng EngN 10 0.00 10000.00 EXTENDED_LIMITS -16384.00 16383.50 AXIS_PTS_REF InjCrv_qPiI1BasRgnX_AXIS /end AXIS_DESCR
 /begin AXIS_DESCR COM_AXIS InjCtl_qSetUnBal InjMass 10 0.00 327.6700 EXTENDED_LIMITS -327.6800 327.6700 AXIS_PTS_REF InjCrv_qPiI1BasRgnY_AXIS /end AXIS_DESCR
/end CHARACTERISTIC
/begin CHARACTERISTIC InjCrv_qPiI1Bas1Rgn1_GMAP "Kennfeld für Basiswert für die Basismenge der PiI1 für die Regenerationsstufe 2 bei inaktiver PiI2" MAP 0x80045982 MapG_Ws16 10.00000 InjMass 0.00 10.00000 EXTENDED_LIMITS -327.6800 327.6700
 /begin AXIS_DESCR COM_AXIS Epm_nEng EngN 10 0.00 10000.00 EXTENDED_LIMITS -16384.00 16383.50 AXIS_PTS_REF InjCrv_qPiI1BasRgnX_AXIS /end AXIS_DESCR
 /begin AXIS_DESCR COM_AXIS InjCtl_qSetUnBal InjMass 10 0.00 327.6700 EXTENDED_LIMITS -327.6800 327.6700 AXIS_PTS_REF InjCrv_qPiI1BasRgnY_AXIS /end AXIS_DESCR
/end CHARACTERISTIC
/begin CHARACTERISTIC InjCrv_qPiI1Bas1Rgn2_GMAP "Kennfeld für Basiswert für die Basismenge der PiI1 für die Regenerationsstufe 2 bei aktiver PiI2" MAP 0x80045A4A MapG_Ws16 10.00000 InjMass 0.00 10.00000 EXTENDED_LIMITS -327.6800 327.6700
 /begin AXIS_DESCR COM_AXIS Epm_nEng EngN 10 0.00 10000.00 EXTENDED_LIMITS -16384.00 16383.50 AXIS_PTS_REF InjCrv_qPiI1BasRgnX_AXIS /end AXIS_DESCR
 /begin AXIS_DESCR COM_AXIS InjCtl_qSetUnBal InjMass 10 0.00 327.6700 EXTENDED_LIMITS -327.6800 327.6700 AXIS_PTS_REF InjCrv_qPiI1BasRgnY_AXIS /end AXIS_DESCR
/end CHARACTERISTIC
/begin AXIS_PTS InjCrv_qPiI1BasRgnX_AXIS "Stützstellenverteilung für das Basismengenkennfeld InjCrv_qPiI1Bas%Rgn%_GMAP" 0x80045B12 Epm_nEng Axis_Xs16 10000.00 EngN 10 0.00 10000.00 FORMAT "%8.2" EXTENDED_LIMITS -16384.00 16383.50 DEPOSIT ABSOLUTE /end AXIS_PTS
/begin AXIS_PTS InjCrv_qPiI1BasRgnY_AXIS "Stützstellenverteilung für das Basismengenkennfeld InjCrv_qPiI1Bas%Rgn%_GMAP" 0x80045B28 InjCtl_qSetUnBal Axis_Xs16 327.6700 InjMass 10 0.00 327.6700 FORMAT "%8.4" EXTENDED_LIMITS -327.6800 327.6700 DEPOSIT ABSOLUTE /end AXIS_PTS
/begin CHARACTERISTIC InjCrv_qPiI1BasStrt_MAP "Grundwertkennlinie start" MAP 0x80046736 Kf_Xs16_Ys16_Ws16 10.00000 InjMassInj 0.00 10.00000 EXTENDED_LIMITS -327.6800 327.6700
 /begin AXIS_DESCR STD_AXIS Epm_nEng EngN 8 0.00 6000.000 EXTENDED_LIMITS -16384.00 16383.50 DEPOSIT ABSOLUTE /end AXIS_DESCR
 /begin AXIS_DESCR STD_AXIS InjCtl_qSetUnBal InjMass 8 0.00 327.6700 EXTENDED_LIMITS -327.6800 327.6700 DEPOSIT ABSOLUTE /end AXIS_DESCR
/end CHARACTERISTIC
/begin CHARACTERISTIC InjCrv_qPiI1DynQCorRgn_MAP "Kennfeld für dynamische Voreinspritzmengenkorrektur wahrend Regeneration" MAP 0x8004317E Kf_Xs16_Ys16_Ws16 327.6700 InjMassInj 0.00 327.6700 EXTENDED_LIMITS -327.6800 327.6700
 /begin AXIS_DESCR STD_AXIS Epm_nEng EngN 16 0.00 6000.000 EXTENDED_LIMITS -16384.00 16383.50 DEPOSIT ABSOLUTE /end AXIS_DESCR
 /begin AXIS_DESCR STD_AXIS InjCtl_qSetUnBal InjMass 8 0.00 327.6700 EXTENDED_LIMITS -327.6800 327.6700 DEPOSIT ABSOLUTE /end AXIS_DESCR
/end CHARACTERISTIC
/begin CHARACTERISTIC InjCrv_qPiI1DynQCor_MAP "Kennfeld für drehzahlabhängige Mengenkorrektur der Voreinspritzung PiI1" MAP 0x80042292 Kf_Xs16_Ys16_Ws16 327.6700 InjMassInj 0.00 327.6700 EXTENDED_LIMITS -327.6800 327.6700
 /begin AXIS_DESCR STD_AXIS Epm_nEng EngN 10 0.00 6000.000 EXTENDED_LIMITS -16384.00 16383.50 DEPOSIT ABSOLUTE /end AXIS_DESCR
 /begin AXIS_DESCR STD_AXIS InjCtl_qSetUnBal InjMass 10 0.00 327.6700 EXTENDED_LIMITS -327.6800 327.6700 DEPOSIT ABSOLUTE /end AXIS_DESCR
/end CHARACTERISTIC
/begin CHARACTERISTIC InjCrv_qPiI1ETSCor0Rgn1_GMAP "Motortemperaturabhängiger Basiswert für die Mengenkorrektur 1 der PiI1 für die Regenerationsstufe 1" MAP 0x800445AC MapG_Ws16 10.00000 InjMass 0.00 10.00000 EXTENDED_LIMITS -327.6800 327.6700
 /begin AXIS_DESCR COM_AXIS Epm_nEng EngN 2 0.00 10000.00 EXTENDED_LIMITS -16384.00 16383.50 AXIS_PTS_REF InjCrv_qPiI1ETSCorRgnX_AXIS /end AXIS_DESCR
 /begin AXIS_DESCR COM_AXIS InjCtl_qSetUnBal InjMass 2 0.00 327.6700 EXTENDED_LIMITS -327.6800 327.6700 AXIS_PTS_REF InjCrv_qPiI1ETSCorRgnY_AXIS /end AXIS_DESCR
/end CHARACTERISTIC
/begin CHARACTERISTIC InjCrv_qPiI1ETSCor0Rgn2_GMAP "Motortemperaturabhängiger Basiswert für die Mengenkorrektur 2 der PiI1 für die Regenerationsstufe 1" MAP 0x800445B4 MapG_Ws16 10.00000 InjMass 0.00 10.00000 EXTENDED_LIMITS -327.6800 327.6700
 /begin AXIS_DESCR COM_AXIS Epm_nEng EngN 2 0.00 10000.00 EXTENDED_LIMITS -16384.00 16383.50 AXIS_PTS_REF InjCrv_qPiI1ETSCorRgnX_AXIS /end AXIS_DESCR
 /begin AXIS_DESCR COM_AXIS InjCtl_qSetUnBal InjMass 2 0.00 327.6700 EXTENDED_LIMITS -327.6800 327.6700 AXIS_PTS_REF InjCrv_qPiI1ETSCorRgnY_AXIS /end AXIS_DESCR
/end CHARACTERISTIC
/begin CHARACTERISTIC InjCrv_qPiI1ETSCor11_MAP "motortemperaturabhängiges Einspritzmengenkorrekturkennfeld 2 für PiI1" MAP 0x80042386 Kf_Xs16_Ys16_Ws16 655.3500 InjMassInj -327.6800 327.6700
 /begin AXIS_DESCR STD_AXIS Epm_nEng EngN 16 -16384.00 16383.50 DEPOSIT ABSOLUTE /end AXIS_DESCR
 /begin AXIS_DESCR STD_AXIS InjCtl_qSetUnBal InjMass 16 -327.6800 327.6700 DEPOSIT ABSOLUTE /end AXIS_DESCR
/end CHARACTERISTIC
/begin CHARACTERISTIC InjCrv_qPiI1ETSCor12_MAP "motortemperaturabhängiges Einspritzmengenkorrekturkennfeld 2 für PiI1 bei aktiver PiI2" MAP 0x800425CA Kf_Xs16_Ys16_Ws16 655.3500 InjMassInj -327.6800 327.6700
 /begin AXIS_DESCR STD_AXIS Epm_nEng EngN 16 -16384.00 16383.50 DEPOSIT ABSOLUTE /end AXIS_DESCR
 /begin AXIS_DESCR STD_AXIS InjCtl_qSetUnBal InjMass 16 -327.6800 327.6700 DEPOSIT ABSOLUTE /end AXIS_DESCR
/end CHARACTERISTIC
/begin CHARACTERISTIC InjCrv_qPiI1ETSCor1Rgn1_GMAP "Motortemperaturabhängiger Basiswert für die Mengenkorrektur 1 der PiI1 für die Regenerationsstufe 2" MAP 0x800445BC MapG_Ws16 10.00000 InjMass 0.00 10.00000 EXTENDED_LIMITS -327.6800 327.6700
 /begin AXIS_DESCR COM_AXIS Epm_nEng EngN 2 0.00 10000.00 EXTENDED_LIMITS -16384.00 16383.50 AXIS_PTS_REF InjCrv_qPiI1ETSCorRgnX_AXIS /end AXIS_DESCR
 /begin AXIS_DESCR COM_AXIS InjCtl_qSetUnBal InjMass 2 0.00 327.6700 EXTENDED_LIMITS -327.6800 327.6700 AXIS_PTS_REF InjCrv_qPiI1ETSCorRgnY_AXIS /end AXIS_DESCR
/end CHARACTERISTIC
/begin CHARACTERISTIC InjCrv_qPiI1ETSCor1Rgn2_GMAP "Motortemperaturabhängiger Basiswert für die Mengenkorrektur 2 der PiI1 für die Regenerationsstufe 2" MAP 0x800445C4 MapG_Ws16 10.00000 InjMass 0.00 10.00000 EXTENDED_LIMITS -327.6800 327.6700
 /begin AXIS_DESCR COM_AXIS Epm_nEng EngN 2 0.00 10000.00 EXTENDED_LIMITS -16384.00 16383.50 AXIS_PTS_REF InjCrv_qPiI1ETSCorRgnX_AXIS /end AXIS_DESCR
 /begin AXIS_DESCR COM_AXIS InjCtl_qSetUnBal InjMass 2 0.00 327.6700 EXTENDED_LIMITS -327.6800 327.6700 AXIS_PTS_REF InjCrv_qPiI1ETSCorRgnY_AXIS /end AXIS_DESCR
/end CHARACTERISTIC
/begin CHARACTERISTIC InjCrv_qPiI1ETSCor1_MAP "motortemperaturabhängiges Einspritzmengenkorrekturkennfeld 1 für PiI1" MAP 0x80043AD0 MapG_Ws16 10.00000 InjMass 0.00 10.00000 EXTENDED_LIMITS -327.6800 327.6700
 /begin AXIS_DESCR COM_AXIS Epm_nEng EngN 16 0.00 10000.00 EXTENDED_LIMITS -16384.00 16383.50 AXIS_PTS_REF InjCrv_qPiI1ETSCor_X_AXIS /end AXIS_DESCR
 /begin AXIS_DESCR COM_AXIS InjCtl_qSetUnBal InjMass 16 0.00 327.6700 EXTENDED_LIMITS -327.6800 327.6700 AXIS_PTS_REF InjCrv_qPiI1ETSCor_Y_AXIS /end AXIS_DESCR
/end CHARACTERISTIC
/begin CHARACTERISTIC InjCrv_qPiI1ETSCor2_MAP "motortemperaturabhängiges Einspritzmengenkorrekturkennfeld 1 für PiI1 bei aktiver PiI2" MAP 0x80043CD0 MapG_Ws16 10.00000 InjMass 0.00 10.00000 EXTENDED_LIMITS -327.6800 327.6700
 /begin AXIS_DESCR COM_AXIS Epm_nEng EngN 16 0.00 10000.00 EXTENDED_LIMITS -16384.00 16383.50 AXIS_PTS_REF InjCrv_qPiI1ETSCor_X_AXIS /end AXIS_DESCR
 /begin AXIS_DESCR COM_AXIS InjCtl_qSetUnBal InjMass 16 0.00 327.6700 EXTENDED_LIMITS -327.6800 327.6700 AXIS_PTS_REF InjCrv_qPiI1ETSCor_Y_AXIS /end AXIS_DESCR
/end CHARACTERISTIC
/begin AXIS_PTS InjCrv_qPiI1ETSCorRgnX_AXIS "Stützstellenverteilung für das lufttemperaturabhängige Mengenkorrekturkennfeld InjCrv_qPiI1ETSCor%Rgn%_GMAP" 0x800445CC Epm_nEng Axis_Xs16 10000.00 EngN 2 0.00 10000.00 FORMAT "%8.2" EXTENDED_LIMITS -16384.00 16383.50 DEPOSIT ABSOLUTE /end AXIS_PTS
/begin AXIS_PTS InjCrv_qPiI1ETSCorRgnY_AXIS "Stützstellenverteilung für das lufttemperaturabhängige Mengenkorrekturkennfeld InjCrv_qPiI1ETSCor%Rgn%_GMAP" 0x800445D2 InjCtl_qSetUnBal Axis_Xs16 327.6700 InjMass 2 0.00 327.6700 FORMAT "%8.4" EXTENDED_LIMITS -327.6800 327.6700 DEPOSIT ABSOLUTE /end AXIS_PTS
/begin CHARACTERISTIC InjCrv_qPiI1ETSCorStrt_MAP "correction value for engine temperature dependent pilot injections quantity correction" MAP 0x8004280E Kf_Xs16_Ys16_Ws16 655.3500 InjMassInj -327.6800 327.6700
 /begin AXIS_DESCR STD_AXIS Epm_nEng EngN 8 -16384.00 16383.50 DEPOSIT ABSOLUTE /end AXIS_DESCR
 /begin AXIS_DESCR STD_AXIS InjCtl_qSetUnBal InjMass 8 -327.6800 327.6700 DEPOSIT ABSOLUTE /end AXIS_DESCR
/end CHARACTERISTIC
/begin AXIS_PTS InjCrv_qPiI1ETSCor_X_AXIS "gemeinsame X-Achse für motortemperaturabhängige Mengenkorrekturkennfelder für PiI 1" 0x80043ED0 Epm_nEng Axis_Xs16 10000.00 EngN 16 0.00 10000.00 FORMAT "%8.2" EXTENDED_LIMITS -16384.00 16383.50 DEPOSIT ABSOLUTE /end AXIS_PTS
/begin AXIS_PTS InjCrv_qPiI1ETSCor_Y_AXIS "gemeinsame Y-Achse für motortemperaturabhängige Mengenkorrekturkennfelder für PiI 1" 0x80043EF2 InjCtl_qSetUnBal Axis_Xs16 327.6700 InjMass 16 0.00 327.6700 FORMAT "%8.4" EXTENDED_LIMITS -327.6800 327.6700 DEPOSIT ABSOLUTE /end AXIS_PTS
/begin CHARACTERISTIC InjCrv_qPiI1MaxRgn_MAP "Einspritzmenge PiI1 Maximalwertekennfeld im Regenerationsbetrieb" MAP 0x80045B3E Map_Xs16Ys16Ws16 10.00000 InjMass 0.00 10.00000 EXTENDED_LIMITS -327.6800 327.6700
 /begin AXIS_DESCR STD_AXIS Epm_nEng EngN 8 0.00 10000.00 EXTENDED_LIMITS -16384.00 16383.50 DEPOSIT ABSOLUTE /end AXIS_DESCR
 /begin AXIS_DESCR STD_AXIS InjCtl_qSetUnBal InjMass 8 0.00 327.6700 EXTENDED_LIMITS -327.6800 327.6700 DEPOSIT ABSOLUTE /end AXIS_DESCR
/end CHARACTERISTIC
/begin CHARACTERISTIC InjCrv_qPiI1WvCorMax_C "Schwelle zur Abschaltung der PiI2 bei Unterschreiten der Mindesteinspritzmenge durch PiI1 bei aktiver Wellenkorrektur" VALUE 0x800468AA Val_Ws16 3.000000 InjMass -3.000000 0.00 EXTENDED_LIMITS -327.6800 327.6700 /end CHARACTERISTIC
/begin CHARACTERISTIC InjCrv_qPiI2APSCor0Rgn_GMAP "Druckabhängiger Basiswert für die Mengenkorrektur der PiI2 für die Regenerationsstufe 1" MAP 0x80047646 MapG_Ws16 10.00000 InjMass 0.00 10.00000 EXTENDED_LIMITS -327.6800 327.6700
 /begin AXIS_DESCR COM_AXIS Epm_nEng EngN 10 0.00 10000.00 EXTENDED_LIMITS -16384.00 16383.50 AXIS_PTS_REF InjCrv_qPiI2APSCorRgnX_AXIS /end AXIS_DESCR
 /begin AXIS_DESCR COM_AXIS InjCtl_qSetUnBal InjMass 10 0.00 327.6700 EXTENDED_LIMITS -327.6800 327.6700 AXIS_PTS_REF InjCrv_qPiI2APSCorRgnY_AXIS /end AXIS_DESCR
/end CHARACTERISTIC
/begin CHARACTERISTIC InjCrv_qPiI2APSCor1Rgn_GMAP "Druckabhängiger Basiswert für die Mengenkorrektur der PiI2 für die Regenerationsstufe 2" MAP 0x8004770E MapG_Ws16 10.00000 InjMass 0.00 10.00000 EXTENDED_LIMITS -327.6800 327.6700
 /begin AXIS_DESCR COM_AXIS Epm_nEng EngN 10 0.00 10000.00 EXTENDED_LIMITS -16384.00 16383.50 AXIS_PTS_REF InjCrv_qPiI2APSCorRgnX_AXIS /end AXIS_DESCR
 /begin AXIS_DESCR COM_AXIS InjCtl_qSetUnBal InjMass 10 0.00 327.6700 EXTENDED_LIMITS -327.6800 327.6700 AXIS_PTS_REF InjCrv_qPiI2APSCorRgnY_AXIS /end AXIS_DESCR
/end CHARACTERISTIC
/begin AXIS_PTS InjCrv_qPiI2APSCorRgnX_AXIS "Stützstellenverteilung für das druckabhängige Mengenkorrekturkennfeld InjCrv_qPiI2APSCor%Rgn_GMAP" 0x800477D6 Epm_nEng Axis_Xs16 10000.00 EngN 10 0.00 10000.00 FORMAT "%8.2" EXTENDED_LIMITS -16384.00 16383.50 DEPOSIT ABSOLUTE /end AXIS_PTS
/begin AXIS_PTS InjCrv_qPiI2APSCorRgnY_AXIS "Stützstellenverteilung für das druckabhängige Mengenkorrekturkennfeld InjCrv_qPiI2APSCor%Rgn_GMAP" 0x800477EC InjCtl_qSetUnBal Axis_Xs16 327.6700 InjMass 10 0.00 327.6700 FORMAT "%8.4" EXTENDED_LIMITS -327.6800 327.6700 DEPOSIT ABSOLUTE /end AXIS_PTS
/begin CHARACTERISTIC InjCrv_qPiI2APSCorStrt_MAP "correction value for atmospheric pressure dependent PiI2 quantity correction" MAP 0x80046CDA Kf_Xs16_Ys16_Ws16 10.00000 InjMassInj 0.00 10.00000 EXTENDED_LIMITS -327.6800 327.6700
 /begin AXIS_DESCR STD_AXIS Epm_nEng EngN 2 0.00 6000.000 EXTENDED_LIMITS -16384.00 16383.50 DEPOSIT ABSOLUTE /end AXIS_DESCR
 /begin AXIS_DESCR STD_AXIS InjCtl_qSetUnBal InjMass 2 0.00 327.6700 EXTENDED_LIMITS -327.6800 327.6700 DEPOSIT ABSOLUTE /end AXIS_DESCR
/end CHARACTERISTIC
/begin CHARACTERISTIC InjCrv_qPiI2APSCor_MAP "atmosphärendruckabhängiges Mengenkorrekturkennfeld für Voreinspritzung 2" MAP 0x80046F7A Map_Xs16Ys16Ws16 10.00000 InjMass 0.00 10.00000 EXTENDED_LIMITS -327.6800 327.6700
 /begin AXIS_DESCR STD_AXIS Epm_nEng EngN 16 0.00 10000.00 EXTENDED_LIMITS -16384.00 16383.50 DEPOSIT ABSOLUTE /end AXIS_DESCR
 /begin AXIS_DESCR STD_AXIS InjCtl_qSetUnBal InjMass 16 0.00 327.6700 EXTENDED_LIMITS -327.6800 327.6700 DEPOSIT ABSOLUTE /end AXIS_DESCR
/end CHARACTERISTIC
/begin CHARACTERISTIC InjCrv_qPiI2ATSCor0Rgn_GMAP "Ansauglufttemperaturabhängiger Basiswert für die Mengenkorrektur der PiI2 für die Regenerationsstufe 1" MAP 0x80047802 MapG_Ws16 10.00000 InjMass 0.00 10.00000 EXTENDED_LIMITS -327.6800 327.6700
 /begin AXIS_DESCR COM_AXIS Epm_nEng EngN 10 0.00 10000.00 EXTENDED_LIMITS -16384.00 16383.50 AXIS_PTS_REF InjCrv_qPiI2ATSCorRgnX_AXIS /end AXIS_DESCR
 /begin AXIS_DESCR COM_AXIS InjCtl_qSetUnBal InjMass 10 0.00 327.6700 EXTENDED_LIMITS -327.6800 327.6700 AXIS_PTS_REF InjCrv_qPiI2ATSCorRgnY_AXIS /end AXIS_DESCR
/end CHARACTERISTIC
/begin CHARACTERISTIC InjCrv_qPiI2ATSCor1Rgn_GMAP "Ansauglufttemperaturabhängiger Basiswert für die Mengenkorrektur der PiI2 für die Regenerationsstufe 2" MAP 0x800478CA MapG_Ws16 10.00000 InjMass 0.00 10.00000 EXTENDED_LIMITS -327.6800 327.6700
 /begin AXIS_DESCR COM_AXIS Epm_nEng EngN 10 0.00 10000.00 EXTENDED_LIMITS -16384.00 16383.50 AXIS_PTS_REF InjCrv_qPiI2ATSCorRgnX_AXIS /end AXIS_DESCR
 /begin AXIS_DESCR COM_AXIS InjCtl_qSetUnBal InjMass 10 0.00 327.6700 EXTENDED_LIMITS -327.6800 327.6700 AXIS_PTS_REF InjCrv_qPiI2ATSCorRgnY_AXIS /end AXIS_DESCR
/end CHARACTERISTIC
/begin AXIS_PTS InjCrv_qPiI2ATSCorRgnX_AXIS "Stützstellenverteilung für das ansauglufttemperaturabhängige Mengenkorrekturkennfeld InjCrv_qPiI2ATSCor%Rgn_GMAP" 0x80047992 Epm_nEng Axis_Xs16 10000.00 EngN 10 0.00 10000.00 FORMAT "%8.2" EXTENDED_LIMITS -16384.00 16383.50 DEPOSIT ABSOLUTE /end AXIS_PTS
/begin AXIS_PTS InjCrv_qPiI2ATSCorRgnY_AXIS "Stützstellenverteilung für das ansauglufttemperaturabhängige Mengenkorrekturkennfeld InjCrv_qPiI2ATSCor%Rgn_GMAP" 0x800479A8 InjCtl_qSetUnBal Axis_Xs16 327.6700 InjMass 10 0.00 327.6700 FORMAT "%8.4" EXTENDED_LIMITS -327.6800 327.6700 DEPOSIT ABSOLUTE /end AXIS_PTS
/begin CHARACTERISTIC InjCrv_qPiI2ATSCorStrt_MAP "correction value for intake air temperature dependent PiI2 quantity correction" MAP 0x80046CEE Kf_Xs16_Ys16_Ws16 10.00000 InjMassInj 0.00 10.00000 EXTENDED_LIMITS -327.6800 327.6700
 /begin AXIS_DESCR STD_AXIS Epm_nEng EngN 2 0.00 6000.000 EXTENDED_LIMITS -16384.00 16383.50 DEPOSIT ABSOLUTE /end AXIS_DESCR
 /begin AXIS_DESCR STD_AXIS InjCtl_qSetUnBal InjMass 2 0.00 327.6700 EXTENDED_LIMITS -327.6800 327.6700 DEPOSIT ABSOLUTE /end AXIS_DESCR
/end CHARACTERISTIC
/begin CHARACTERISTIC InjCrv_qPiI2ATSCor_MAP "ansauglufttemperaturabhängiges Mengenkorrekturkennfeld für Voreinspritzung 2" MAP 0x800471BE Map_Xs16Ys16Ws16 10.00000 InjMass 0.00 10.00000 EXTENDED_LIMITS -327.6800 327.6700
 /begin AXIS_DESCR STD_AXIS Epm_nEng EngN 16 0.00 10000.00 EXTENDED_LIMITS -16384.00 16383.50 DEPOSIT ABSOLUTE /end AXIS_DESCR
 /begin AXIS_DESCR STD_AXIS InjCtl_qSetUnBal InjMass 16 0.00 327.6700 EXTENDED_LIMITS -327.6800 327.6700 DEPOSIT ABSOLUTE /end AXIS_DESCR
/end CHARACTERISTIC
/begin CHARACTERISTIC InjCrv_qPiI2Bas0Rgn_GMAP "Kennfeld für Basiswert für die Mengenkorrektur der PiI2 für die Regenerationsstufe 1" MAP 0x800483AA MapG_Ws16 655.3500 InjMass -327.6800 327.6700
 /begin AXIS_DESCR COM_AXIS Epm_nEng EngN 10 0.00 10000.00 EXTENDED_LIMITS -16384.00 16383.50 AXIS_PTS_REF InjCrv_qPiI2BasRgnX_AXIS /end AXIS_DESCR
 /begin AXIS_DESCR COM_AXIS InjCtl_qSetUnBal InjMass 10 0.00 327.6700 EXTENDED_LIMITS -327.6800 327.6700 AXIS_PTS_REF InjCrv_qPiI2BasRgnY_AXIS /end AXIS_DESCR
/end CHARACTERISTIC
/begin CHARACTERISTIC InjCrv_qPiI2Bas1Rgn_GMAP "Kennfeld für Basiswert für die Mengenkorrektur der PiI2 für die Regenerationsstufe 2" MAP 0x80048472 MapG_Ws16 655.3500 InjMass -327.6800 327.6700
 /begin AXIS_DESCR COM_AXIS Epm_nEng EngN 10 0.00 10000.00 EXTENDED_LIMITS -16384.00 16383.50 AXIS_PTS_REF InjCrv_qPiI2BasRgnX_AXIS /end AXIS_DESCR
 /begin AXIS_DESCR COM_AXIS InjCtl_qSetUnBal InjMass 10 0.00 327.6700 EXTENDED_LIMITS -327.6800 327.6700 AXIS_PTS_REF InjCrv_qPiI2BasRgnY_AXIS /end AXIS_DESCR
/end CHARACTERISTIC
/begin AXIS_PTS InjCrv_qPiI2BasRgnX_AXIS "Stützstellenverteilung für das Basismengenkennfeld InjCrv_qPiI2Bas%Rgn_GMAP" 0x8004853A Epm_nEng Axis_Xs16 10000.00 EngN 10 0.00 10000.00 FORMAT "%8.2" EXTENDED_LIMITS -16384.00 16383.50 DEPOSIT ABSOLUTE /end AXIS_PTS
/begin AXIS_PTS InjCrv_qPiI2BasRgnY_AXIS "Stützstellenverteilung für das Basismengenkennfeld InjCrv_qPiI2Bas%Rgn_GMAP" 0x80048550 InjCtl_qSetUnBal Axis_Xs16 327.6700 InjMass 10 0.00 327.6700 FORMAT "%8.4" EXTENDED_LIMITS -327.6800 327.6700 DEPOSIT ABSOLUTE /end AXIS_PTS
/begin CHARACTERISTIC InjCrv_qPiI2BasStrt_MAP "Einspritzmenge PiI2 Grundwertekennfeld start" MAP 0x8004899A Kf_Xs16_Ys16_Ws16 10.00000 InjMassInj 0.00 10.00000 EXTENDED_LIMITS -327.6800 327.6700
 /begin AXIS_DESCR STD_AXIS Epm_nEng EngN 2 0.00 6000.000 EXTENDED_LIMITS -16384.00 16383.50 DEPOSIT ABSOLUTE /end AXIS_DESCR
 /begin AXIS_DESCR STD_AXIS InjCtl_qSetUnBal InjMass 2 0.00 327.6700 EXTENDED_LIMITS -327.6800 327.6700 DEPOSIT ABSOLUTE /end AXIS_DESCR
/end CHARACTERISTIC
/begin CHARACTERISTIC InjCrv_qPiI2Bas_MAP "Einspritzmenge PiI2 Grundwertekennfeld" MAP 0x800468AC Map_Xs16Ys16Ws16 10.00000 InjMass 0.00 10.00000 EXTENDED_LIMITS -327.6800 327.6700
 /begin AXIS_DESCR STD_AXIS Epm_nEng EngN 16 0.00 10000.00 EXTENDED_LIMITS -16384.00 16383.50 DEPOSIT ABSOLUTE /end AXIS_DESCR
 /begin AXIS_DESCR STD_AXIS InjCtl_qSetUnBal InjMass 16 0.00 327.6700 EXTENDED_LIMITS -327.6800 327.6700 DEPOSIT ABSOLUTE /end AXIS_DESCR
/end CHARACTERISTIC
/begin CHARACTERISTIC InjCrv_qPiI2Des_C "Fernsteuerwert der Einspritzmenge der PiI2" VALUE 0x80046AF0 Val_Ws16 100.0000 InjMass 0.00 100.0000 EXTENDED_LIMITS -327.6800 327.6700 /end CHARACTERISTIC
/begin CHARACTERISTIC InjCrv_qPiI2ETSCor0Rgn_GMAP "Motortemperaturabhängiger Basiswert für die Mengenkorrektur der PiI2 für die Regenerationsstufe 1" MAP 0x800479BE MapG_Ws16 10.00000 InjMass 0.00 10.00000 EXTENDED_LIMITS -327.6800 327.6700
 /begin AXIS_DESCR COM_AXIS Epm_nEng EngN 2 0.00 10000.00 EXTENDED_LIMITS -16384.00 16383.50 AXIS_PTS_REF InjCrv_qPiI2ETSCorRgnX_AXIS /end AXIS_DESCR
 /begin AXIS_DESCR COM_AXIS InjCtl_qSetUnBal InjMass 2 0.00 327.6700 EXTENDED_LIMITS -327.6800 327.6700 AXIS_PTS_REF InjCrv_qPiI2ETSCorRgnY_AXIS /end AXIS_DESCR
/end CHARACTERISTIC
/begin CHARACTERISTIC InjCrv_qPiI2ETSCor11_MAP "Motortemparatur korrektur für Voreinspritzung" MAP 0x80046D02 Map_Xs16Ys16Ws16 10.00000 InjMass 0.00 10.00000 EXTENDED_LIMITS -327.6800 327.6700
 /begin AXIS_DESCR STD_AXIS Epm_nEng EngN 10 0.00 10000.00 EXTENDED_LIMITS -16384.00 16383.50 DEPOSIT ABSOLUTE /end AXIS_DESCR
 /begin AXIS_DESCR STD_AXIS InjCtl_qSetUnBal InjMass 10 0.00 327.6700 EXTENDED_LIMITS -327.6800 327.6700 DEPOSIT ABSOLUTE /end AXIS_DESCR
/end CHARACTERISTIC
/begin CHARACTERISTIC InjCrv_qPiI2ETSCor1Rgn_GMAP "Motortemperaturabhängiger Basiswert für die Mengenkorrektur der PiI2 für die Regenerationsstufe 2" MAP 0x800479C6 MapG_Ws16 10.00000 InjMass 0.00 10.00000 EXTENDED_LIMITS -327.6800 327.6700
 /begin AXIS_DESCR COM_AXIS Epm_nEng EngN 2 0.00 10000.00 EXTENDED_LIMITS -16384.00 16383.50 AXIS_PTS_REF InjCrv_qPiI2ETSCorRgnX_AXIS /end AXIS_DESCR
 /begin AXIS_DESCR COM_AXIS InjCtl_qSetUnBal InjMass 2 0.00 327.6700 EXTENDED_LIMITS -327.6800 327.6700 AXIS_PTS_REF InjCrv_qPiI2ETSCorRgnY_AXIS /end AXIS_DESCR
/end CHARACTERISTIC
/begin AXIS_PTS InjCrv_qPiI2ETSCorRgnX_AXIS "Stützstellenverteilung für das motortemperaturabhängige Mengenkorrekturkennfeld InjCrv_qPiI2ETSCor%Rgn_GMAP" 0x800479CE Epm_nEng Axis_Xs16 10000.00 EngN 2 0.00 10000.00 FORMAT "%8.2" EXTENDED_LIMITS -16384.00 16383.50 DEPOSIT ABSOLUTE /end AXIS_PTS
/begin AXIS_PTS InjCrv_qPiI2ETSCorRgnY_AXIS "Stützstellenverteilung für das ansauglufttemperaturabhängige Mengenkorrekturkennfeld InjCrv_qPiI2ETSCor%Rgn_GMAP" 0x800479D4 InjCtl_qSetUnBal Axis_Xs16 327.6700 InjMass 2 0.00 327.6700 FORMAT "%8.4" EXTENDED_LIMITS -327.6800 327.6700 DEPOSIT ABSOLUTE /end AXIS_PTS
/begin CHARACTERISTIC InjCrv_qPiI2ETSCorStrt_MAP "correction value for engine temperature dependent PiI2 quantity correction" MAP 0x80046DF6 Kf_Xs16_Ys16_Ws16 10.00000 InjMassInj 0.00 10.00000 EXTENDED_LIMITS -327.6800 327.6700
 /begin AXIS_DESCR STD_AXIS Epm_nEng EngN 2 0.00 6000.000 EXTENDED_LIMITS -16384.00 16383.50 DEPOSIT ABSOLUTE /end AXIS_DESCR
 /begin AXIS_DESCR STD_AXIS InjCtl_qSetUnBal InjMass 2 0.00 327.6700 EXTENDED_LIMITS -327.6800 327.6700 DEPOSIT ABSOLUTE /end AXIS_DESCR
/end CHARACTERISTIC
/begin CHARACTERISTIC InjCrv_qPiI2ETSCor_MAP "motortemperaturabhängiges Mengenkorrekturkennfeld für Voreinspritzung 2" MAP 0x80047402 Map_Xs16Ys16Ws16 10.00000 InjMass 0.00 10.00000 EXTENDED_LIMITS -327.6800 327.6700
 /begin AXIS_DESCR STD_AXIS Epm_nEng EngN 16 0.00 10000.00 EXTENDED_LIMITS -16384.00 16383.50 DEPOSIT ABSOLUTE /end AXIS_DESCR
 /begin AXIS_DESCR STD_AXIS InjCtl_qSetUnBal InjMass 16 0.00 327.6700 EXTENDED_LIMITS -327.6800 327.6700 DEPOSIT ABSOLUTE /end AXIS_DESCR
/end CHARACTERISTIC
/begin CHARACTERISTIC InjCrv_qPiI2MaxRgn_MAP "Einspritzmenge PiI2 Maximalwertekennfeld im Regenerationsbetrieb" MAP 0x80048566 Map_Xs16Ys16Ws16 10.00000 InjMass 0.00 10.00000 EXTENDED_LIMITS -327.6800 327.6700
 /begin AXIS_DESCR STD_AXIS Epm_nEng EngN 10 0.00 10000.00 EXTENDED_LIMITS -16384.00 16383.50 DEPOSIT ABSOLUTE /end AXIS_DESCR
 /begin AXIS_DESCR STD_AXIS InjCtl_qSetUnBal InjMass 10 0.00 327.6700 EXTENDED_LIMITS -327.6800 327.6700 DEPOSIT ABSOLUTE /end AXIS_DESCR
/end CHARACTERISTIC
/begin CHARACTERISTIC InjCrv_qPiI2Max_MAP "Einspritzmenge PiI2 Maximalwertekennfeld" MAP 0x80046AF2 Map_Xs16Ys16Ws16 10.00000 InjMass 0.00 10.00000 EXTENDED_LIMITS -327.6800 327.6700
 /begin AXIS_DESCR STD_AXIS Epm_nEng EngN 8 0.00 10000.00 EXTENDED_LIMITS -16384.00 16383.50 DEPOSIT ABSOLUTE /end AXIS_DESCR
 /begin AXIS_DESCR STD_AXIS InjCtl_qSetUnBal InjMass 8 0.00 327.6700 EXTENDED_LIMITS -327.6800 327.6700 DEPOSIT ABSOLUTE /end AXIS_DESCR
/end CHARACTERISTIC
/begin CHARACTERISTIC InjCrv_qPiI2MinDiff_C "Minimalmenge zwischen unteren und oberen Hysteresenschwelle für Voreinspritzung 2" VALUE 0x80046B96 Val_Ws16 10.00000 InjMass 0.00 10.00000 EXTENDED_LIMITS -327.6800 327.6700 /end CHARACTERISTIC
/begin CHARACTERISTIC InjCrv_qPoI1Bas_MAP "Grundwert der Einspritzmenge PoI1" MAP 0x80048B34 Map_Xs16Ys16Ws16 10.00000 InjMass 0.00 10.00000 EXTENDED_LIMITS -327.6800 327.6700
 /begin AXIS_DESCR STD_AXIS Epm_nEng EngN 2 -16384.00 16383.50 DEPOSIT ABSOLUTE /end AXIS_DESCR
 /begin AXIS_DESCR STD_AXIS InjCtl_qSetUnBal InjMass 2 0.00 327.6700 EXTENDED_LIMITS -327.6800 327.6700 DEPOSIT ABSOLUTE /end AXIS_DESCR
/end CHARACTERISTIC
/begin CHARACTERISTIC InjCrv_qPoI1Des_C "Fernsteuerwert der Einspritzmenge der PoI1" VALUE 0x80048B48 Val_Ws16 100.0000 InjMass 0.00 100.0000 EXTENDED_LIMITS -327.6800 327.6700 /end CHARACTERISTIC
/begin CHARACTERISTIC InjCrv_qPoI1RgnAPSCor_MAP "Mengenkorrekturfeld der PoI1 in der Regeneration zur Korrektur über den Luftdruck" MAP 0x80048C4A Map_Xs16Ys16Ws16 10.00000 InjMass 0.00 10.00000 EXTENDED_LIMITS -327.6800 327.6700
 /begin AXIS_DESCR STD_AXIS Epm_nEng EngN 16 0.00 10000.00 EXTENDED_LIMITS -16384.00 16383.50 DEPOSIT ABSOLUTE /end AXIS_DESCR
 /begin AXIS_DESCR STD_AXIS InjCtl_qSetUnBal InjMass 16 0.00 327.6700 EXTENDED_LIMITS -327.6800 327.6700 DEPOSIT ABSOLUTE /end AXIS_DESCR
/end CHARACTERISTIC
/begin CHARACTERISTIC InjCrv_qPoI1SetLim_C "" VALUE 0x80048B4A Val_Ws16 100.0000 InjMass -100.0000 0.00 EXTENDED_LIMITS -327.6800 327.6700 /end CHARACTERISTIC
/begin CHARACTERISTIC InjCrv_swtPhiPiI2Des_C "Schalter des Fernsteuerwerts des Ansteuerbeginns (Winkelkomponente) der PiI2" VALUE 0x80046B98 Val_Wu8 1.000 OneToOne 0.00 1.000 EXTENDED_LIMITS 0.00 255.0 /end CHARACTERISTIC
/begin CHARACTERISTIC InjCrv_swtPhiPoI1Des_C "Schalter des Fernsteuerwerts des Ansteuerwinkels der PoI1" VALUE 0x80048B4C Val_Wu8 1.000 OneToOne 0.00 1.000 EXTENDED_LIMITS 0.00 255.0 /end CHARACTERISTIC
/begin CHARACTERISTIC InjCrv_swtPoI1Clsn_C "Auswahlschalter zur Behandlung der PoI1 im Kollisionsfall" VALUE 0x80048B4D Val_Wu8 255.0 OneToOne 0.00 255.0 /end CHARACTERISTIC
/begin CHARACTERISTIC InjCrv_swtPoI1ShOff_C "" VALUE 0x80048B4E Val_Wu8 255.0 OneToOne 0.00 255.0 /end CHARACTERISTIC
/begin CHARACTERISTIC InjCrv_swtQntPiI2Des_C "Schalter des Fernsteuerwerts der Einspritzmenge der PiI2" VALUE 0x80046B99 Val_Wu8 1.000 OneToOne 0.00 1.000 EXTENDED_LIMITS 0.00 255.0 /end CHARACTERISTIC
/begin CHARACTERISTIC InjCrv_swtQntPoI1Des_C "Schalter des Fernsteuerwerts der Einspritzmenge der PoI1" VALUE 0x80048B4F Val_Wu8 1.000 OneToOne 0.00 1.000 EXTENDED_LIMITS 0.00 255.0 /end CHARACTERISTIC
/begin CHARACTERISTIC InjCrv_swtTiPiI2Des_C "Schalter des Fernsteuerwerts des Ansteuerbeginns (Zeitkomponente) der PiI2" VALUE 0x80046B9A Val_Wu8 1.000 OneToOne 0.00 1.000 EXTENDED_LIMITS 0.00 255.0 /end CHARACTERISTIC
/begin CHARACTERISTIC InjCrv_tiPiI1APSCor0Rgn1_GMAP "Luftdruckabhängiger Basiswert für Ansteuerbeginnkorrektur 1 für die PiI1 für die Regenerationsstufe 1" MAP 0x800445D8 MapG_Ws16 18000.00 InjTime_us -13000.00 5000.00 EXTENDED_LIMITS -13107.20 13106.80
 /begin AXIS_DESCR COM_AXIS Epm_nEng EngN 10 0.00 10000.00 EXTENDED_LIMITS -16384.00 16383.50 AXIS_PTS_REF InjCrv_tiPiI1APSCorRgnX_AXIS /end AXIS_DESCR
 /begin AXIS_DESCR COM_AXIS InjCtl_qSetUnBal InjMass 10 0.00 327.6700 EXTENDED_LIMITS -327.6800 327.6700 AXIS_PTS_REF InjCrv_tiPiI1APSCorRgnY_AXIS /end AXIS_DESCR
/end CHARACTERISTIC
/begin CHARACTERISTIC InjCrv_tiPiI1APSCor0Rgn2_GMAP "Luftdruckabhängiger Basiswert für Ansteuerbeginnkorrektur 2 für die PiI1 für die Regenerationsstufe 1" MAP 0x800446A0 MapG_Ws16 18000.00 InjTime_us -13000.00 5000.00 EXTENDED_LIMITS -13107.20 13106.80
 /begin AXIS_DESCR COM_AXIS Epm_nEng EngN 10 0.00 10000.00 EXTENDED_LIMITS -16384.00 16383.50 AXIS_PTS_REF InjCrv_tiPiI1APSCorRgnX_AXIS /end AXIS_DESCR
 /begin AXIS_DESCR COM_AXIS InjCtl_qSetUnBal InjMass 10 0.00 327.6700 EXTENDED_LIMITS -327.6800 327.6700 AXIS_PTS_REF InjCrv_tiPiI1APSCorRgnY_AXIS /end AXIS_DESCR
/end CHARACTERISTIC
/begin CHARACTERISTIC InjCrv_tiPiI1APSCor1Rgn1_GMAP "Luftdruckabhängiger Basiswert für Ansteuerbeginnkorrektur 1 für die PiI1 für die Regenerationsstufe 2" MAP 0x80044768 MapG_Ws16 18000.00 InjTime_us -13000.00 5000.00 EXTENDED_LIMITS -13107.20 13106.80
 /begin AXIS_DESCR COM_AXIS Epm_nEng EngN 10 0.00 10000.00 EXTENDED_LIMITS -16384.00 16383.50 AXIS_PTS_REF InjCrv_tiPiI1APSCorRgnX_AXIS /end AXIS_DESCR
 /begin AXIS_DESCR COM_AXIS InjCtl_qSetUnBal InjMass 10 0.00 327.6700 EXTENDED_LIMITS -327.6800 327.6700 AXIS_PTS_REF InjCrv_tiPiI1APSCorRgnY_AXIS /end AXIS_DESCR
/end CHARACTERISTIC
/begin CHARACTERISTIC InjCrv_tiPiI1APSCor1Rgn2_GMAP "Luftdruckabhängiger Basiswert für Ansteuerbeginnkorrektur 2 für die PiI1 für die Regenerationsstufe 2" MAP 0x80044830 MapG_Ws16 18000.00 InjTime_us -13000.00 5000.00 EXTENDED_LIMITS -13107.20 13106.80
 /begin AXIS_DESCR COM_AXIS Epm_nEng EngN 10 0.00 10000.00 EXTENDED_LIMITS -16384.00 16383.50 AXIS_PTS_REF InjCrv_tiPiI1APSCorRgnX_AXIS /end AXIS_DESCR
 /begin AXIS_DESCR COM_AXIS InjCtl_qSetUnBal InjMass 10 0.00 327.6700 EXTENDED_LIMITS -327.6800 327.6700 AXIS_PTS_REF InjCrv_tiPiI1APSCorRgnY_AXIS /end AXIS_DESCR
/end CHARACTERISTIC
/begin CHARACTERISTIC InjCrv_tiPiI1APSCor1_MAP "Lufdruckabhängiges Korrekturgrundwertekennfeld für die Zeitkomponente des Ansteuerbeginns der PiI1 bei inaktiver PiI2" MAP 0x80044FDE Map_Xs16Ys16Ws16 18000.00 InjTime_us -13000.00 5000.00 EXTENDED_LIMITS -13107.20 13106.80
 /begin AXIS_DESCR STD_AXIS Epm_nEng EngN 10 0.00 10000.00 EXTENDED_LIMITS -16384.00 16383.50 DEPOSIT ABSOLUTE /end AXIS_DESCR
 /begin AXIS_DESCR STD_AXIS InjCtl_qSetUnBal InjMass 8 0.00 327.6700 EXTENDED_LIMITS -327.6800 327.6700 DEPOSIT ABSOLUTE /end AXIS_DESCR
/end CHARACTERISTIC
/begin CHARACTERISTIC InjCrv_tiPiI1APSCor2_MAP "Luftdruckabhängiges Korrekturgrundwertekennfeld für die Zeitkomponente des Ansteuerbeginns der PiI1 bei aktiver PiI2" MAP 0x800450A6 Map_Xs16Ys16Ws16 18000.00 InjTime_us -13000.00 5000.00 EXTENDED_LIMITS -13107.20 13106.80
 /begin AXIS_DESCR STD_AXIS Epm_nEng EngN 10 0.00 10000.00 EXTENDED_LIMITS -16384.00 16383.50 DEPOSIT ABSOLUTE /end AXIS_DESCR
 /begin AXIS_DESCR STD_AXIS InjCtl_qSetUnBal InjMass 8 0.00 327.6700 EXTENDED_LIMITS -327.6800 327.6700 DEPOSIT ABSOLUTE /end AXIS_DESCR
/end CHARACTERISTIC
/begin AXIS_PTS InjCrv_tiPiI1APSCorRgnX_AXIS "Stützstellenverteilung für das Ansteuerbeginnkorrekturkennfeld InjCrv_tiPiI1APSCor%Rgn%_GMAP" 0x800448F8 Epm_nEng Axis_Xs16 10000.00 EngN 10 0.00 10000.00 FORMAT "%8.2" EXTENDED_LIMITS -16384.00 16383.50 DEPOSIT ABSOLUTE /end AXIS_PTS
/begin AXIS_PTS InjCrv_tiPiI1APSCorRgnY_AXIS "Stützstellenverteilung für das Ansteuerbeginnkorrekturkennfeld InjCrv_tiPiI1APSCor%Rgn%_GMAP" 0x8004490E InjCtl_qSetUnBal Axis_Xs16 327.6700 InjMass 10 0.00 327.6700 FORMAT "%8.4" EXTENDED_LIMITS -327.6800 327.6700 DEPOSIT ABSOLUTE /end AXIS_PTS
/begin CHARACTERISTIC InjCrv_tiPiI1ATSCor0Rgn1_GMAP "Lufttemperaturabhängiger Basiswert für Ansteuerbeginnkorrektur 1 für die PiI1 für die Regenerationsstufe 1" MAP 0x80044924 MapG_Ws16 18000.00 InjTime_us -13000.00 5000.00 EXTENDED_LIMITS -13107.20 13106.80
 /begin AXIS_DESCR COM_AXIS Epm_nEng EngN 10 0.00 10000.00 EXTENDED_LIMITS -16384.00 16383.50 AXIS_PTS_REF InjCrv_tiPiI1ATSCorRgnX_AXIS /end AXIS_DESCR
 /begin AXIS_DESCR COM_AXIS InjCtl_qSetUnBal InjMass 10 0.00 327.6700 EXTENDED_LIMITS -327.6800 327.6700 AXIS_PTS_REF InjCrv_tiPiI1ATSCorRgnY_AXIS /end AXIS_DESCR
/end CHARACTERISTIC
/begin CHARACTERISTIC InjCrv_tiPiI1ATSCor0Rgn2_GMAP "Lufttemperaturabhängiger Basiswert für Ansteuerbeginnkorrektur 2 für die PiI1 für die Regenerationsstufe 1" MAP 0x800449EC MapG_Ws16 18000.00 InjTime_us -13000.00 5000.00 EXTENDED_LIMITS -13107.20 13106.80
 /begin AXIS_DESCR COM_AXIS Epm_nEng EngN 10 0.00 10000.00 EXTENDED_LIMITS -16384.00 16383.50 AXIS_PTS_REF InjCrv_tiPiI1ATSCorRgnX_AXIS /end AXIS_DESCR
 /begin AXIS_DESCR COM_AXIS InjCtl_qSetUnBal InjMass 10 0.00 327.6700 EXTENDED_LIMITS -327.6800 327.6700 AXIS_PTS_REF InjCrv_tiPiI1ATSCorRgnY_AXIS /end AXIS_DESCR
/end CHARACTERISTIC
/begin CHARACTERISTIC InjCrv_tiPiI1ATSCor1Rgn1_GMAP "Lufttemperaturabhängiger Basiswert für Ansteuerbeginnkorrektur 1 für die PiI1 für die Regenerationsstufe 2" MAP 0x80044AB4 MapG_Ws16 18000.00 InjTime_us -13000.00 5000.00 EXTENDED_LIMITS -13107.20 13106.80
 /begin AXIS_DESCR COM_AXIS Epm_nEng EngN 10 0.00 10000.00 EXTENDED_LIMITS -16384.00 16383.50 AXIS_PTS_REF InjCrv_tiPiI1ATSCorRgnX_AXIS /end AXIS_DESCR
 /begin AXIS_DESCR COM_AXIS InjCtl_qSetUnBal InjMass 10 0.00 327.6700 EXTENDED_LIMITS -327.6800 327.6700 AXIS_PTS_REF InjCrv_tiPiI1ATSCorRgnY_AXIS /end AXIS_DESCR
/end CHARACTERISTIC
/begin CHARACTERISTIC InjCrv_tiPiI1ATSCor1Rgn2_GMAP "Lufttemperaturabhängiger Basiswert für Ansteuerbeginnkorrektur 2 für die PiI1 für die Regenerationsstufe 2" MAP 0x80044B7C MapG_Ws16 18000.00 InjTime_us -13000.00 5000.00 EXTENDED_LIMITS -13107.20 13106.80
 /begin AXIS_DESCR COM_AXIS Epm_nEng EngN 10 0.00 10000.00 EXTENDED_LIMITS -16384.00 16383.50 AXIS_PTS_REF InjCrv_tiPiI1ATSCorRgnX_AXIS /end AXIS_DESCR
 /begin AXIS_DESCR COM_AXIS InjCtl_qSetUnBal InjMass 10 0.00 327.6700 EXTENDED_LIMITS -327.6800 327.6700 AXIS_PTS_REF InjCrv_tiPiI1ATSCorRgnY_AXIS /end AXIS_DESCR
/end CHARACTERISTIC
/begin CHARACTERISTIC InjCrv_tiPiI1ATSCor1_MAP "Ansauglufttemperaturabhängiges Korrekturgrundwertekennfeld für die Zeitkomponente des Ansteuerbeginns der PiI1 bei inaktiver PiI2" MAP 0x8004516E Map_Xs16Ys16Ws16 18000.00 InjTime_us -13000.00 5000.00 EXTENDED_LIMITS -13107.20 13106.80
 /begin AXIS_DESCR STD_AXIS Epm_nEng EngN 16 0.00 10000.00 EXTENDED_LIMITS -16384.00 16383.50 DEPOSIT ABSOLUTE /end AXIS_DESCR
 /begin AXIS_DESCR STD_AXIS InjCtl_qSetUnBal InjMass 8 0.00 327.6700 EXTENDED_LIMITS -327.6800 327.6700 DEPOSIT ABSOLUTE /end AXIS_DESCR
/end CHARACTERISTIC
/begin CHARACTERISTIC InjCrv_tiPiI1ATSCor2_MAP "Ansauglufttemperaturabhängiges Korrekturgrundwertekennfeld für die Zeitkomponente des Ansteuerbeginns der PiI1 bei aktiver PiI2" MAP 0x800452A2 Map_Xs16Ys16Ws16 18000.00 InjTime_us -13000.00 5000.00 EXTENDED_LIMITS -13107.20 13106.80
 /begin AXIS_DESCR STD_AXIS Epm_nEng EngN 10 0.00 10000.00 EXTENDED_LIMITS -16384.00 16383.50 DEPOSIT ABSOLUTE /end AXIS_DESCR
 /begin AXIS_DESCR STD_AXIS InjCtl_qSetUnBal InjMass 8 0.00 327.6700 EXTENDED_LIMITS -327.6800 327.6700 DEPOSIT ABSOLUTE /end AXIS_DESCR
/end CHARACTERISTIC
/begin AXIS_PTS InjCrv_tiPiI1ATSCorRgnX_AXIS "Stützstellenverteilung für das Ansteuerbeginnkorrekturkennfeld InjCrv_tiPiI1ATSCor%Rgn%_GMAP" 0x80044C44 Epm_nEng Axis_Xs16 10000.00 EngN 10 0.00 10000.00 FORMAT "%8.2" EXTENDED_LIMITS -16384.00 16383.50 DEPOSIT ABSOLUTE /end AXIS_PTS
/begin AXIS_PTS InjCrv_tiPiI1ATSCorRgnY_AXIS "Stützstellenverteilung für das Ansteuerbeginnkorrekturkennfeld InjCrv_tiPiI1ATSCor%Rgn%_GMAP" 0x80044C5A InjCtl_qSetUnBal Axis_Xs16 327.6700 InjMass 10 0.00 327.6700 FORMAT "%8.4" EXTENDED_LIMITS -327.6800 327.6700 DEPOSIT ABSOLUTE /end AXIS_PTS
/begin CHARACTERISTIC InjCrv_tiPiI1ATSCorRgn_MAP "" MAP 0x800432B2 Kf_Xs16_Ys16_Ws16 18000.00 InjTime_us -13000.00 5000.00 EXTENDED_LIMITS -13107.20 13106.80
 /begin AXIS_DESCR STD_AXIS Epm_nEng EngN 16 0.00 6000.000 EXTENDED_LIMITS -16384.00 16383.50 DEPOSIT ABSOLUTE /end AXIS_DESCR
 /begin AXIS_DESCR STD_AXIS InjCtl_qSetUnBal InjMass 8 0.00 327.6700 EXTENDED_LIMITS -327.6800 327.6700 DEPOSIT ABSOLUTE /end AXIS_DESCR
/end CHARACTERISTIC
/begin CHARACTERISTIC InjCrv_tiPiI1Bas0Rgn1_GMAP "Basiskennfeld für die Zeitkomponente des Ansteuerbeginns der PiI1 für die Regenerationsstufe 1 bei inaktiver PiI2" MAP 0x80045BE2 MapG_Ws16 5000.00 InjTime_us 0.00 5000.00 EXTENDED_LIMITS -13107.20 13106.80
 /begin AXIS_DESCR COM_AXIS Epm_nEng EngN 12 0.00 10000.00 EXTENDED_LIMITS -16384.00 16383.50 AXIS_PTS_REF InjCrv_tiPiI1BasRgnX_AXIS /end AXIS_DESCR
 /begin AXIS_DESCR COM_AXIS InjCtl_qSetUnBal InjMass 16 0.00 327.6700 EXTENDED_LIMITS -327.6800 327.6700 AXIS_PTS_REF InjCrv_tiPiI1BasRgnY_AXIS /end AXIS_DESCR
/end CHARACTERISTIC
/begin CHARACTERISTIC InjCrv_tiPiI1Bas0Rgn2_GMAP "Basiskennfeld für die Zeitkomponente des Ansteuerbeginns der PiI1 für die Regenerationsstufe 1 bei aktiver PiI2" MAP 0x80045D62 MapG_Ws16 5000.00 InjTime_us 0.00 5000.00 EXTENDED_LIMITS -13107.20 13106.80
 /begin AXIS_DESCR COM_AXIS Epm_nEng EngN 12 0.00 10000.00 EXTENDED_LIMITS -16384.00 16383.50 AXIS_PTS_REF InjCrv_tiPiI1BasRgnX_AXIS /end AXIS_DESCR
 /begin AXIS_DESCR COM_AXIS InjCtl_qSetUnBal InjMass 16 0.00 327.6700 EXTENDED_LIMITS -327.6800 327.6700 AXIS_PTS_REF InjCrv_tiPiI1BasRgnY_AXIS /end AXIS_DESCR
/end CHARACTERISTIC
/begin CHARACTERISTIC InjCrv_tiPiI1Bas1Rgn1_GMAP "Basiskennfeld für die Zeitkomponente des Ansteuerbeginns der PiI1 für die Regenerationsstufe 2 bei inaktiver PiI2" MAP 0x80045EE2 MapG_Ws16 5000.00 InjTime_us 0.00 5000.00 EXTENDED_LIMITS -13107.20 13106.80
 /begin AXIS_DESCR COM_AXIS Epm_nEng EngN 12 0.00 10000.00 EXTENDED_LIMITS -16384.00 16383.50 AXIS_PTS_REF InjCrv_tiPiI1BasRgnX_AXIS /end AXIS_DESCR
 /begin AXIS_DESCR COM_AXIS InjCtl_qSetUnBal InjMass 16 0.00 327.6700 EXTENDED_LIMITS -327.6800 327.6700 AXIS_PTS_REF InjCrv_tiPiI1BasRgnY_AXIS /end AXIS_DESCR
/end CHARACTERISTIC
/begin CHARACTERISTIC InjCrv_tiPiI1Bas1Rgn2_GMAP "Basiskennfeld für die Zeitkomponente des Ansteuerbeginns der PiI1 für die Regenerationsstufe 2 bei aktiver PiI2" MAP 0x80046062 MapG_Ws16 5000.00 InjTime_us 0.00 5000.00 EXTENDED_LIMITS -13107.20 13106.80
 /begin AXIS_DESCR COM_AXIS Epm_nEng EngN 12 0.00 10000.00 EXTENDED_LIMITS -16384.00 16383.50 AXIS_PTS_REF InjCrv_tiPiI1BasRgnX_AXIS /end AXIS_DESCR
 /begin AXIS_DESCR COM_AXIS InjCtl_qSetUnBal InjMass 16 0.00 327.6700 EXTENDED_LIMITS -327.6800 327.6700 AXIS_PTS_REF InjCrv_tiPiI1BasRgnY_AXIS /end AXIS_DESCR
/end CHARACTERISTIC
/begin CHARACTERISTIC InjCrv_tiPiI1Bas1_MAP "Zeitkomponente Ansteuerbeginn Grundwertekennfeld PiI1 ohne Freigabe PiI2" MAP 0x8004629A Map_Xs16Ys16Ws16 5000.00 InjTime_us 0.00 5000.00 EXTENDED_LIMITS -13107.20 13106.80
 /begin AXIS_DESCR STD_AXIS Epm_nEng EngN 16 0.00 10000.00 EXTENDED_LIMITS -16384.00 16383.50 DEPOSIT ABSOLUTE /end AXIS_DESCR
 /begin AXIS_DESCR STD_AXIS InjCtl_qSetUnBal InjMass 16 0.00 327.6700 EXTENDED_LIMITS -327.6800 327.6700 DEPOSIT ABSOLUTE /end AXIS_DESCR
/end CHARACTERISTIC
/begin CHARACTERISTIC InjCrv_tiPiI1Bas2_MAP "Zeitkomponente Ansteuerbeginn Grundwertekennfeld PiI1 mit Freigabe PiI2" MAP 0x800464DE Map_Xs16Ys16Ws16 5000.00 InjTime_us 0.00 5000.00 EXTENDED_LIMITS -13107.20 13106.80
 /begin AXIS_DESCR STD_AXIS Epm_nEng EngN 16 0.00 10000.00 EXTENDED_LIMITS -16384.00 16383.50 DEPOSIT ABSOLUTE /end AXIS_DESCR
 /begin AXIS_DESCR STD_AXIS InjCtl_qSetUnBal InjMass 16 0.00 327.6700 EXTENDED_LIMITS -327.6800 327.6700 DEPOSIT ABSOLUTE /end AXIS_DESCR
/end CHARACTERISTIC
/begin CHARACTERISTIC InjCrv_tiPiI1Bas3_MAP "Zeitkomponente Ansteuerbeginn Grundwertekennfeld PiI1 mit Freigabe PiI3" MAP 0x80046722 Map_Xs16Ys16Ws16 5000.00 InjTime_us 0.00 5000.00 EXTENDED_LIMITS -13107.20 13106.80
 /begin AXIS_DESCR STD_AXIS Epm_nEng EngN 2 0.00 10000.00 EXTENDED_LIMITS -16384.00 16383.50 DEPOSIT ABSOLUTE /end AXIS_DESCR
 /begin AXIS_DESCR STD_AXIS InjCtl_qSetUnBal InjMass 2 0.00 327.6700 EXTENDED_LIMITS -327.6800 327.6700 DEPOSIT ABSOLUTE /end AXIS_DESCR
/end CHARACTERISTIC
/begin AXIS_PTS InjCrv_tiPiI1BasRgnX_AXIS "Stützstellenverteilung für das Basisansteuerbeginnkennfeld InjCrv_tiPiI1Bas%Rgn%_GMAP" 0x800461E2 Epm_nEng Axis_Xs16 10000.00 EngN 12 0.00 10000.00 FORMAT "%8.2" EXTENDED_LIMITS -16384.00 16383.50 DEPOSIT ABSOLUTE /end AXIS_PTS
/begin AXIS_PTS InjCrv_tiPiI1BasRgnY_AXIS "Stützstellenverteilung für das Basisansteuerbeginnkennfeld InjCrv_tiPiI1Bas%Rgn%_GMAP" 0x800461FC InjCtl_qSetUnBal Axis_Xs16 327.6700 InjMass 16 0.00 327.6700 FORMAT "%8.4" EXTENDED_LIMITS -327.6800 327.6700 DEPOSIT ABSOLUTE /end AXIS_PTS
/begin CHARACTERISTIC InjCrv_tiPiI1BasStrt_MAP "base map of PiI1 SOE time calculation, if PiI3 is active" MAP 0x800467DA Kf_Xs16_Ys16_Ws16 5000.00 InjTime_us 0.00 5000.00 EXTENDED_LIMITS -13107.20 13106.80
 /begin AXIS_DESCR STD_AXIS Epm_nEng EngN 8 0.00 6000.000 EXTENDED_LIMITS -16384.00 16383.50 DEPOSIT ABSOLUTE /end AXIS_DESCR
 /begin AXIS_DESCR STD_AXIS InjCtl_qSetUnBal InjMass 8 0.00 327.6700 EXTENDED_LIMITS -327.6800 327.6700 DEPOSIT ABSOLUTE /end AXIS_DESCR
/end CHARACTERISTIC
/begin CHARACTERISTIC InjCrv_tiPiI1DynCorRgn_MAP "Kennfeld für dynamische Ansteuerbeginnkorrektur während Regeneration" MAP 0x800433E6 Kf_Xs16_Ys16_Ws16 18000.00 InjTime_us -13000.00 5000.00 EXTENDED_LIMITS -13107.20 13106.80
 /begin AXIS_DESCR STD_AXIS Epm_nEng EngN 16 0.00 6000.000 EXTENDED_LIMITS -16384.00 16383.50 DEPOSIT ABSOLUTE /end AXIS_DESCR
 /begin AXIS_DESCR STD_AXIS InjCtl_qSetUnBal InjMass 8 0.00 327.6700 EXTENDED_LIMITS -327.6800 327.6700 DEPOSIT ABSOLUTE /end AXIS_DESCR
/end CHARACTERISTIC
/begin CHARACTERISTIC InjCrv_tiPiI1DynCor_MAP "base correction map of pilot injection angle correction" MAP 0x800428B2 Kf_Xs16_Ys16_Ws16 18000.00 InjTime_us -13000.00 5000.00 EXTENDED_LIMITS -13107.20 13106.80
 /begin AXIS_DESCR STD_AXIS Epm_nEng EngN 16 0.00 6000.000 EXTENDED_LIMITS -16384.00 16383.50 DEPOSIT ABSOLUTE /end AXIS_DESCR
 /begin AXIS_DESCR STD_AXIS InjCtl_qSetUnBal InjMass 8 0.00 327.6700 EXTENDED_LIMITS -327.6800 327.6700 DEPOSIT ABSOLUTE /end AXIS_DESCR
/end CHARACTERISTIC
/begin CHARACTERISTIC InjCrv_tiPiI1ETSCor0Rgn1_GMAP "Motortemperaturabhängiger Basiswert für Ansteuerbeginnkorrektur 1 für die PiI1 für die Regenerationsstufe 1" MAP 0x80044C70 MapG_Ws16 18000.00 InjTime_us -13000.00 5000.00 EXTENDED_LIMITS -13107.20 13106.80
 /begin AXIS_DESCR COM_AXIS Epm_nEng EngN 2 0.00 10000.00 EXTENDED_LIMITS -16384.00 16383.50 AXIS_PTS_REF InjCrv_tiPiI1ETSCorRgnX_AXIS /end AXIS_DESCR
 /begin AXIS_DESCR COM_AXIS InjCtl_qSetUnBal InjMass 2 0.00 327.6700 EXTENDED_LIMITS -327.6800 327.6700 AXIS_PTS_REF InjCrv_tiPiI1ETSCorRgnY_AXIS /end AXIS_DESCR
/end CHARACTERISTIC
/begin CHARACTERISTIC InjCrv_tiPiI1ETSCor0Rgn2_GMAP "Motortemperaturabhängiger Basiswert für Ansteuerbeginnkorrektur 2 für die PiI1 für die Regenerationsstufe 1" MAP 0x80044C78 MapG_Ws16 18000.00 InjTime_us -13000.00 5000.00 EXTENDED_LIMITS -13107.20 13106.80
 /begin AXIS_DESCR COM_AXIS Epm_nEng EngN 2 0.00 10000.00 EXTENDED_LIMITS -16384.00 16383.50 AXIS_PTS_REF InjCrv_tiPiI1ETSCorRgnX_AXIS /end AXIS_DESCR
 /begin AXIS_DESCR COM_AXIS InjCtl_qSetUnBal InjMass 2 0.00 327.6700 EXTENDED_LIMITS -327.6800 327.6700 AXIS_PTS_REF InjCrv_tiPiI1ETSCorRgnY_AXIS /end AXIS_DESCR
/end CHARACTERISTIC
/begin CHARACTERISTIC InjCrv_tiPiI1ETSCor11_MAP "motortemperaturabhängiges Korrekturgrundwertekennfeld -1 für die Zeitkomponente Ansteuerbeginn PiI1" MAP 0x800429E6 Kf_Xs16_Ys16_Ws16 18107.20 InjTime_us -13107.20 5000.00 EXTENDED_LIMITS -13107.20 13106.80
 /begin AXIS_DESCR STD_AXIS Epm_nEng EngN 16 -16384.00 16383.50 DEPOSIT ABSOLUTE /end AXIS_DESCR
 /begin AXIS_DESCR STD_AXIS InjCtl_qSetUnBal InjMass 16 -327.6800 327.6700 DEPOSIT ABSOLUTE /end AXIS_DESCR
/end CHARACTERISTIC
/begin CHARACTERISTIC InjCrv_tiPiI1ETSCor12_MAP "motortemperaturabhängiges Korrekturgrundwertekennfeld für die Zeitkomponente des Ansteuerbeginns der PiI1bei aktiver PiI2" MAP 0x80042C2A Kf_Xs16_Ys16_Ws16 18107.20 InjTime_us -13107.20 5000.00 EXTENDED_LIMITS -13107.20 13106.80
 /begin AXIS_DESCR STD_AXIS Epm_nEng EngN 16 -16384.00 16383.50 DEPOSIT ABSOLUTE /end AXIS_DESCR
 /begin AXIS_DESCR STD_AXIS InjCtl_qSetUnBal InjMass 16 -327.6800 327.6700 DEPOSIT ABSOLUTE /end AXIS_DESCR
/end CHARACTERISTIC
/begin CHARACTERISTIC InjCrv_tiPiI1ETSCor1Rgn1_GMAP "Motortemperaturabhängiger Basiswert für Ansteuerbeginnkorrektur 1 für die PiI1 für die Regenerationsstufe 2" MAP 0x80044C80 MapG_Ws16 18000.00 InjTime_us -13000.00 5000.00 EXTENDED_LIMITS -13107.20 13106.80
 /begin AXIS_DESCR COM_AXIS Epm_nEng EngN 2 0.00 10000.00 EXTENDED_LIMITS -16384.00 16383.50 AXIS_PTS_REF InjCrv_tiPiI1ETSCorRgnX_AXIS /end AXIS_DESCR
 /begin AXIS_DESCR COM_AXIS InjCtl_qSetUnBal InjMass 2 0.00 327.6700 EXTENDED_LIMITS -327.6800 327.6700 AXIS_PTS_REF InjCrv_tiPiI1ETSCorRgnY_AXIS /end AXIS_DESCR
/end CHARACTERISTIC
/begin CHARACTERISTIC InjCrv_tiPiI1ETSCor1Rgn2_GMAP "Motortemperaturabhängiger Basiswert für Ansteuerbeginnkorrektur 2 für die PiI1 für die Regenerationsstufe 2" MAP 0x80044C88 MapG_Ws16 18000.00 InjTime_us -13000.00 5000.00 EXTENDED_LIMITS -13107.20 13106.80
 /begin AXIS_DESCR COM_AXIS Epm_nEng EngN 2 0.00 10000.00 EXTENDED_LIMITS -16384.00 16383.50 AXIS_PTS_REF InjCrv_tiPiI1ETSCorRgnX_AXIS /end AXIS_DESCR
 /begin AXIS_DESCR COM_AXIS InjCtl_qSetUnBal InjMass 2 0.00 327.6700 EXTENDED_LIMITS -327.6800 327.6700 AXIS_PTS_REF InjCrv_tiPiI1ETSCorRgnY_AXIS /end AXIS_DESCR
/end CHARACTERISTIC
/begin CHARACTERISTIC InjCrv_tiPiI1ETSCor1_MAP "motortemperaturabhängiges Korrekturgrundwertekennfeld -1 für die Zeitkomponente Ansteuerbeginn PiI1" MAP 0x8004536A Map_Xs16Ys16Ws16 18000.00 InjTime_us -13000.00 5000.00 EXTENDED_LIMITS -13107.20 13106.80
 /begin AXIS_DESCR STD_AXIS Epm_nEng EngN 16 0.00 10000.00 EXTENDED_LIMITS -16384.00 16383.50 DEPOSIT ABSOLUTE /end AXIS_DESCR
 /begin AXIS_DESCR STD_AXIS InjCtl_qSetUnBal InjMass 16 0.00 327.6700 EXTENDED_LIMITS -327.6800 327.6700 DEPOSIT ABSOLUTE /end AXIS_DESCR
/end CHARACTERISTIC
/begin CHARACTERISTIC InjCrv_tiPiI1ETSCor2_MAP "motortemperaturabhängiges Korrekturgrundwertekennfeld -2 für die Zeitkomponente Ansteuerbeginn PiI1" MAP 0x800455AE Map_Xs16Ys16Ws16 18000.00 InjTime_us -13000.00 5000.00 EXTENDED_LIMITS -13107.20 13106.80
 /begin AXIS_DESCR STD_AXIS Epm_nEng EngN 16 0.00 10000.00 EXTENDED_LIMITS -16384.00 16383.50 DEPOSIT ABSOLUTE /end AXIS_DESCR
 /begin AXIS_DESCR STD_AXIS InjCtl_qSetUnBal InjMass 16 0.00 327.6700 EXTENDED_LIMITS -327.6800 327.6700 DEPOSIT ABSOLUTE /end AXIS_DESCR
/end CHARACTERISTIC
/begin AXIS_PTS InjCrv_tiPiI1ETSCorRgnX_AXIS "Stützstellenverteilung für das Ansteuerbeginnkorrekturkennfeld InjCrv_tiPiI1ETSCor%Rgn%_GMAP" 0x80044C90 Epm_nEng Axis_Xs16 10000.00 EngN 2 0.00 10000.00 FORMAT "%8.2" EXTENDED_LIMITS -16384.00 16383.50 DEPOSIT ABSOLUTE /end AXIS_PTS
/begin AXIS_PTS InjCrv_tiPiI1ETSCorRgnY_AXIS "Stützstellenverteilung für das Ansteuerbeginnkorrekturkennfeld InjCrv_tiPiI1ETSCor%Rgn%_GMAP" 0x80044C96 InjCtl_qSetUnBal Axis_Xs16 327.6700 InjMass 2 0.00 327.6700 FORMAT "%8.4" EXTENDED_LIMITS -327.6800 327.6700 DEPOSIT ABSOLUTE /end AXIS_PTS
/begin CHARACTERISTIC InjCrv_tiPiI1ETSCorStrt_MAP "base correction map for time-component of SOE of PiI1" MAP 0x80042E6E Kf_Xs16_Ys16_Ws16 18107.20 InjTime_us -13107.20 5000.00 EXTENDED_LIMITS -13107.20 13106.80
 /begin AXIS_DESCR STD_AXIS Epm_nEng EngN 10 -16384.00 16383.50 DEPOSIT ABSOLUTE /end AXIS_DESCR
 /begin AXIS_DESCR STD_AXIS InjCtl_qSetUnBal InjMass 10 -327.6800 327.6700 DEPOSIT ABSOLUTE /end AXIS_DESCR
/end CHARACTERISTIC
/begin CHARACTERISTIC InjCrv_tiPiI1VehCor2_MAP "" MAP 0x80042F62 Kf_Xs16_Ys16_Ws16 18000.00 InjTime_us -13000.00 5000.00 EXTENDED_LIMITS -13107.20 13106.80
 /begin AXIS_DESCR STD_AXIS Epm_nEng EngN 10 0.00 6000.000 EXTENDED_LIMITS -16384.00 16383.50 DEPOSIT ABSOLUTE /end AXIS_DESCR
 /begin AXIS_DESCR STD_AXIS InjCtl_qSetUnBal InjMass 10 0.00 327.6700 EXTENDED_LIMITS -327.6800 327.6700 DEPOSIT ABSOLUTE /end AXIS_DESCR
/end CHARACTERISTIC
/begin CHARACTERISTIC InjCrv_tiPiI1VehCor_MAP "" MAP 0x80043056 Kf_Xs16_Ys16_Ws16 18000.00 InjTime_us -13000.00 5000.00 EXTENDED_LIMITS -13107.20 13106.80
 /begin AXIS_DESCR STD_AXIS Epm_nEng EngN 10 0.00 6000.000 EXTENDED_LIMITS -16384.00 16383.50 DEPOSIT ABSOLUTE /end AXIS_DESCR
 /begin AXIS_DESCR STD_AXIS InjCtl_qSetUnBal InjMass 10 0.00 327.6700 EXTENDED_LIMITS -327.6800 327.6700 DEPOSIT ABSOLUTE /end AXIS_DESCR
/end CHARACTERISTIC
/begin CHARACTERISTIC InjCrv_tiPiI2APSCor0Rgn_GMAP "Luftdruckabhängiger Basiswert für Ansteuerbeginnkorrekturzeit für die PiI2 für die Regenerationsstufe 1" MAP 0x800479DA MapG_Ws16 18000.00 InjTime_us -13000.00 5000.00 EXTENDED_LIMITS -13107.20 13106.80
 /begin AXIS_DESCR COM_AXIS Epm_nEng EngN 10 0.00 10000.00 EXTENDED_LIMITS -16384.00 16383.50 AXIS_PTS_REF InjCrv_tiPiI2APSCorRgnX_AXIS /end AXIS_DESCR
 /begin AXIS_DESCR COM_AXIS InjCtl_qSetUnBal InjMass 10 0.00 327.6700 EXTENDED_LIMITS -327.6800 327.6700 AXIS_PTS_REF InjCrv_tiPiI2APSCorRgnY_AXIS /end AXIS_DESCR
/end CHARACTERISTIC
/begin CHARACTERISTIC InjCrv_tiPiI2APSCor1Rgn_GMAP "Luftdruckabhängiger Basiswert für Ansteuerbeginnkorrekturzeit für die PiI2 für die Regenerationsstufe 2" MAP 0x80047AA2 MapG_Ws16 18000.00 InjTime_us -13000.00 5000.00 EXTENDED_LIMITS -13107.20 13106.80
 /begin AXIS_DESCR COM_AXIS Epm_nEng EngN 10 0.00 10000.00 EXTENDED_LIMITS -16384.00 16383.50 AXIS_PTS_REF InjCrv_tiPiI2APSCorRgnX_AXIS /end AXIS_DESCR
 /begin AXIS_DESCR COM_AXIS InjCtl_qSetUnBal InjMass 10 0.00 327.6700 EXTENDED_LIMITS -327.6800 327.6700 AXIS_PTS_REF InjCrv_tiPiI2APSCorRgnY_AXIS /end AXIS_DESCR
/end CHARACTERISTIC
/begin AXIS_PTS InjCrv_tiPiI2APSCorRgnX_AXIS "Stützstellenverteilung für das Ansteuerbeginnkorrekturkennfeld InjCrv_tiPiI2APSCor%Rgn_GMAP" 0x80047B6A Epm_nEng Axis_Xs16 10000.00 EngN 10 0.00 10000.00 FORMAT "%8.2" EXTENDED_LIMITS -16384.00 16383.50 DEPOSIT ABSOLUTE /end AXIS_PTS
/begin AXIS_PTS InjCrv_tiPiI2APSCorRgnY_AXIS "Stützstellenverteilung für das Ansteuerbeginnkorrekturkennfeld InjCrv_tiPiI2APSCor%Rgn_GMAP" 0x80047B80 InjCtl_qSetUnBal Axis_Xs16 327.6700 InjMass 10 0.00 327.6700 FORMAT "%8.4" EXTENDED_LIMITS -327.6800 327.6700 DEPOSIT ABSOLUTE /end AXIS_PTS
/begin CHARACTERISTIC InjCrv_tiPiI2APSCorStrt_MAP "Korrekturkennfeld für das Timing der 2. Voreinspritzung abhängig vom Luftdruck während des Startvorganges" MAP 0x80046E0A Kf_Xs16_Ys16_Ws16 18000.00 InjTime_us -13000.00 5000.00 EXTENDED_LIMITS -13107.20 13106.80
 /begin AXIS_DESCR STD_AXIS Epm_nEng EngN 10 0.00 6000.000 EXTENDED_LIMITS -16384.00 16383.50 DEPOSIT ABSOLUTE /end AXIS_DESCR
 /begin AXIS_DESCR STD_AXIS InjCtl_qSetUnBal InjMass 10 0.00 327.6700 EXTENDED_LIMITS -327.6800 327.6700 DEPOSIT ABSOLUTE /end AXIS_DESCR
/end CHARACTERISTIC
/begin CHARACTERISTIC InjCrv_tiPiI2APSCor_MAP "Luftdruckabhängiger Korrekturgrundwertekennfeld für die Zeitkomponente des Ansteuerbeginns der PiI2" MAP 0x80047F7E Map_Xs16Ys16Ws16 18000.00 InjTime_us -13000.00 5000.00 EXTENDED_LIMITS -13107.20 13106.80
 /begin AXIS_DESCR STD_AXIS Epm_nEng EngN 10 0.00 10000.00 EXTENDED_LIMITS -16384.00 16383.50 DEPOSIT ABSOLUTE /end AXIS_DESCR
 /begin AXIS_DESCR STD_AXIS InjCtl_qSetUnBal InjMass 10 0.00 327.6700 EXTENDED_LIMITS -327.6800 327.6700 DEPOSIT ABSOLUTE /end AXIS_DESCR
/end CHARACTERISTIC
/begin CHARACTERISTIC InjCrv_tiPiI2ATSCor0Rgn_GMAP "Ansauglufttemperaturabhängiger Basiswert für Ansteuerbeginnkorrekturzeit für die PiI2 für die Regenerationsstufe 1" MAP 0x80047B96 MapG_Ws16 18000.00 InjTime_us -13000.00 5000.00 EXTENDED_LIMITS -13107.20 13106.80
 /begin AXIS_DESCR COM_AXIS Epm_nEng EngN 10 0.00 10000.00 EXTENDED_LIMITS -16384.00 16383.50 AXIS_PTS_REF InjCrv_tiPiI2ATSCorRgnX_AXIS /end AXIS_DESCR
 /begin AXIS_DESCR COM_AXIS InjCtl_qSetUnBal InjMass 10 0.00 327.6700 EXTENDED_LIMITS -327.6800 327.6700 AXIS_PTS_REF InjCrv_tiPiI2ATSCorRgnY_AXIS /end AXIS_DESCR
/end CHARACTERISTIC
/begin CHARACTERISTIC InjCrv_tiPiI2ATSCor1Rgn_GMAP "Ansauglufttemperaturabhängiger Basiswert für Ansteuerbeginnkorrekturzeit für die PiI2 für die Regenerationsstufe 2" MAP 0x80047C5E MapG_Ws16 18000.00 InjTime_us -13000.00 5000.00 EXTENDED_LIMITS -13107.20 13106.80
 /begin AXIS_DESCR COM_AXIS Epm_nEng EngN 10 0.00 10000.00 EXTENDED_LIMITS -16384.00 16383.50 AXIS_PTS_REF InjCrv_tiPiI2ATSCorRgnX_AXIS /end AXIS_DESCR
 /begin AXIS_DESCR COM_AXIS InjCtl_qSetUnBal InjMass 10 0.00 327.6700 EXTENDED_LIMITS -327.6800 327.6700 AXIS_PTS_REF InjCrv_tiPiI2ATSCorRgnY_AXIS /end AXIS_DESCR
/end CHARACTERISTIC
/begin AXIS_PTS InjCrv_tiPiI2ATSCorRgnX_AXIS "Stützstellenverteilung für das Ansteuerbeginnkorrekturkennfeld InjCrv_tiPiI2ATSCor%Rgn_GMAP" 0x80047D26 Epm_nEng Axis_Xs16 10000.00 EngN 10 0.00 10000.00 FORMAT "%8.2" EXTENDED_LIMITS -16384.00 16383.50 DEPOSIT ABSOLUTE /end AXIS_PTS
/begin AXIS_PTS InjCrv_tiPiI2ATSCorRgnY_AXIS "Stützstellenverteilung für das Ansteuerbeginnkorrekturkennfeld InjCrv_tiPiI2ATSCor%Rgn_GMAP" 0x80047D3C InjCtl_qSetUnBal Axis_Xs16 327.6700 InjMass 10 0.00 327.6700 FORMAT "%8.4" EXTENDED_LIMITS -327.6800 327.6700 DEPOSIT ABSOLUTE /end AXIS_PTS
/begin CHARACTERISTIC InjCrv_tiPiI2ATSCor_MAP "ansauglufttemperaturabhängiges Korrekturgrundwertekennfeld für die Zeitkomponente des Ansteuerbeginns der PiI2" MAP 0x80048072 Map_Xs16Ys16Ws16 18000.00 InjTime_us -13000.00 5000.00 EXTENDED_LIMITS -13107.20 13106.80
 /begin AXIS_DESCR STD_AXIS Epm_nEng EngN 10 0.00 10000.00 EXTENDED_LIMITS -16384.00 16383.50 DEPOSIT ABSOLUTE /end AXIS_DESCR
 /begin AXIS_DESCR STD_AXIS InjCtl_qSetUnBal InjMass 10 0.00 327.6700 EXTENDED_LIMITS -327.6800 327.6700 DEPOSIT ABSOLUTE /end AXIS_DESCR
/end CHARACTERISTIC
/begin CHARACTERISTIC InjCrv_tiPiI2Bas0Rgn_GMAP "Basiskennfeld für die Zeitkomponente des Ansteuerbeginns der PiI2 für die Regenerationsstufe 1" MAP 0x8004865A MapG_Ws16 18107.20 InjTime_us -13107.20 5000.00 EXTENDED_LIMITS -13107.20 13106.80
 /begin AXIS_DESCR COM_AXIS Epm_nEng EngN 10 0.00 10000.00 EXTENDED_LIMITS -16384.00 16383.50 AXIS_PTS_REF InjCrv_tiPiI2BasRgnX_AXIS /end AXIS_DESCR
 /begin AXIS_DESCR COM_AXIS InjCtl_qSetUnBal InjMass 10 0.00 327.6700 EXTENDED_LIMITS -327.6800 327.6700 AXIS_PTS_REF InjCrv_tiPiI2BasRgnY_AXIS /end AXIS_DESCR
/end CHARACTERISTIC
/begin CHARACTERISTIC InjCrv_tiPiI2Bas1Rgn_GMAP "Basiskennfeld für die Zeitkomponente des Ansteuerbeginns der PiI2 für die Regenerationsstufe 2" MAP 0x80048722 MapG_Ws16 18107.20 InjTime_us -13107.20 5000.00 EXTENDED_LIMITS -13107.20 13106.80
 /begin AXIS_DESCR COM_AXIS Epm_nEng EngN 10 0.00 10000.00 EXTENDED_LIMITS -16384.00 16383.50 AXIS_PTS_REF InjCrv_tiPiI2BasRgnX_AXIS /end AXIS_DESCR
 /begin AXIS_DESCR COM_AXIS InjCtl_qSetUnBal InjMass 10 0.00 327.6700 EXTENDED_LIMITS -327.6800 327.6700 AXIS_PTS_REF InjCrv_tiPiI2BasRgnY_AXIS /end AXIS_DESCR
/end CHARACTERISTIC
/begin AXIS_PTS InjCrv_tiPiI2BasRgnX_AXIS "Stützstellenverteilung für das Basisansteuerbeginnkennfeld InjCrv_tiPiI2Bas%Rgn_GMAP" 0x800487EA Epm_nEng Axis_Xs16 10000.00 EngN 10 0.00 10000.00 FORMAT "%8.2" EXTENDED_LIMITS -16384.00 16383.50 DEPOSIT ABSOLUTE /end AXIS_PTS
/begin AXIS_PTS InjCrv_tiPiI2BasRgnY_AXIS "Stützstellenverteilung für das Basisansteuerbeginnkennfeld InjCrv_tiPiI2Bas%Rgn_GMAP" 0x80048800 InjCtl_qSetUnBal Axis_Xs16 327.6700 InjMass 10 0.00 327.6700 FORMAT "%8.4" EXTENDED_LIMITS -327.6800 327.6700 DEPOSIT ABSOLUTE /end AXIS_PTS
/begin CHARACTERISTIC InjCrv_tiPiI2BasStrt_MAP "base map of PiI2 SOE time-component calculation" MAP 0x800489AE Kf_Xs16_Ys16_Ws16 5000.00 InjTime_us 0.00 5000.00 EXTENDED_LIMITS -13107.20 13106.80
 /begin AXIS_DESCR STD_AXIS Epm_nEng EngN 2 0.00 6000.000 EXTENDED_LIMITS -16384.00 16383.50 DEPOSIT ABSOLUTE /end AXIS_DESCR
 /begin AXIS_DESCR STD_AXIS InjCtl_qSetUnBal InjMass 2 0.00 327.6700 EXTENDED_LIMITS -327.6800 327.6700 DEPOSIT ABSOLUTE /end AXIS_DESCR
/end CHARACTERISTIC
/begin CHARACTERISTIC InjCrv_tiPiI2Bas_MAP "Zeitkomponente Ansteuerbeginn Grundwertekennfeld PiI2" MAP 0x80048892 Map_Xs16Ys16Ws16 5000.00 InjTime_us 0.00 5000.00 EXTENDED_LIMITS -13107.20 13106.80
 /begin AXIS_DESCR STD_AXIS Epm_nEng EngN 10 0.00 10000.00 EXTENDED_LIMITS -16384.00 16383.50 DEPOSIT ABSOLUTE /end AXIS_DESCR
 /begin AXIS_DESCR STD_AXIS InjCtl_qSetUnBal InjMass 10 0.00 327.6700 EXTENDED_LIMITS -327.6800 327.6700 DEPOSIT ABSOLUTE /end AXIS_DESCR
/end CHARACTERISTIC
/begin CHARACTERISTIC InjCrv_tiPiI2Des_C "Fernsteuerwert des Ansteuerbeginns (Zeitkomponente) der PiI2" VALUE 0x80046B9C Val_Ws16 5000.00 InjTime_us 0.00 5000.00 EXTENDED_LIMITS -13107.20 13106.80 /end CHARACTERISTIC
/begin CHARACTERISTIC InjCrv_tiPiI2ETSCor0Rgn_GMAP "Motortemperaturabhängiger Basiswert für Ansteuerbeginnkorrekturzeit für die PiI2 für die Regenerationsstufe 1" MAP 0x80047D52 MapG_Ws16 18000.00 InjTime_us -13000.00 5000.00 EXTENDED_LIMITS -13107.20 13106.80
 /begin AXIS_DESCR COM_AXIS Epm_nEng EngN 2 0.00 10000.00 EXTENDED_LIMITS -16384.00 16383.50 AXIS_PTS_REF InjCrv_tiPiI2ETSCorRgnX_AXIS /end AXIS_DESCR
 /begin AXIS_DESCR COM_AXIS InjCtl_qSetUnBal InjMass 2 0.00 327.6700 EXTENDED_LIMITS -327.6800 327.6700 AXIS_PTS_REF InjCrv_tiPiI2ETSCorRgnY_AXIS /end AXIS_DESCR
/end CHARACTERISTIC
/begin CHARACTERISTIC InjCrv_tiPiI2ETSCor1Rgn_GMAP "Motortemperaturabhängiger Basiswert für Ansteuerbeginnkorrekturzeit für die PiI2 für die Regenerationsstufe 2" MAP 0x80047D5A MapG_Ws16 18000.00 InjTime_us -13000.00 5000.00 EXTENDED_LIMITS -13107.20 13106.80
 /begin AXIS_DESCR COM_AXIS Epm_nEng EngN 2 0.00 10000.00 EXTENDED_LIMITS -16384.00 16383.50 AXIS_PTS_REF InjCrv_tiPiI2ETSCorRgnX_AXIS /end AXIS_DESCR
 /begin AXIS_DESCR COM_AXIS InjCtl_qSetUnBal InjMass 2 0.00 327.6700 EXTENDED_LIMITS -327.6800 327.6700 AXIS_PTS_REF InjCrv_tiPiI2ETSCorRgnY_AXIS /end AXIS_DESCR
/end CHARACTERISTIC
/begin AXIS_PTS InjCrv_tiPiI2ETSCorRgnX_AXIS "Stützstellenverteilung für das Ansteuerbeginnkorrekturkennfeld InjCrv_tiPiI2ETSCor%Rgn_GMAP" 0x80047D62 Epm_nEng Axis_Xs16 10000.00 EngN 2 0.00 10000.00 FORMAT "%8.2" EXTENDED_LIMITS -16384.00 16383.50 DEPOSIT ABSOLUTE /end AXIS_PTS
/begin AXIS_PTS InjCrv_tiPiI2ETSCorRgnY_AXIS "Stützstellenverteilung für das Ansteuerbeginnkorrekturkennfeld InjCrv_tiPiI2ETSCor%Rgn_GMAP" 0x80047D68 InjCtl_qSetUnBal Axis_Xs16 327.6700 InjMass 2 0.00 327.6700 FORMAT "%8.4" EXTENDED_LIMITS -327.6800 327.6700 DEPOSIT ABSOLUTE /end AXIS_PTS
/begin CHARACTERISTIC InjCrv_tiPiI2ETSCorStrt_MAP "base correction map for time-component of SOE of PiI2" MAP 0x80046EFE Kf_Xs16_Ys16_Ws16 18000.00 InjTime_us -13000.00 5000.00 EXTENDED_LIMITS -13107.20 13106.80
 /begin AXIS_DESCR STD_AXIS Epm_nEng EngN 2 0.00 6000.000 EXTENDED_LIMITS -16384.00 16383.50 DEPOSIT ABSOLUTE /end AXIS_DESCR
 /begin AXIS_DESCR STD_AXIS InjCtl_qSetUnBal InjMass 2 0.00 327.6700 EXTENDED_LIMITS -327.6800 327.6700 DEPOSIT ABSOLUTE /end AXIS_DESCR
/end CHARACTERISTIC
/begin CHARACTERISTIC InjCrv_tiPiI2ETSCor_MAP "motortemperaturabhängiges Korrekturgrundwertekennfeld für die Zeitkomponente des Ansteuerbeginns der PiI2" MAP 0x80048166 Map_Xs16Ys16Ws16 18000.00 InjTime_us -13000.00 5000.00 EXTENDED_LIMITS -13107.20 13106.80
 /begin AXIS_DESCR STD_AXIS Epm_nEng EngN 16 0.00 10000.00 EXTENDED_LIMITS -16384.00 16383.50 DEPOSIT ABSOLUTE /end AXIS_DESCR
 /begin AXIS_DESCR STD_AXIS InjCtl_qSetUnBal InjMass 16 0.00 327.6700 EXTENDED_LIMITS -327.6800 327.6700 DEPOSIT ABSOLUTE /end AXIS_DESCR
/end CHARACTERISTIC
/begin CHARACTERISTIC InjCrv_tiPiI2Min_MAP "Zeitkomponente PiI2 Minimalwertekennfeld" MAP 0x80046B9E Kf_Xs16_Ys16_Ws16 5000.00 InjTime_us 0.00 5000.00 EXTENDED_LIMITS -13107.20 13106.80
 /begin AXIS_DESCR STD_AXIS Epm_nEng EngN 10 0.00 6000.000 EXTENDED_LIMITS -16384.00 16383.50 DEPOSIT ABSOLUTE /end AXIS_DESCR
 /begin AXIS_DESCR STD_AXIS InjCtl_qSetUnBal InjMass 10 0.00 327.6700 EXTENDED_LIMITS -327.6800 327.6700 DEPOSIT ABSOLUTE /end AXIS_DESCR
/end CHARACTERISTIC
/begin CHARACTERISTIC InjCrv_tiPiI2VehCor_MAP "" MAP 0x80046F12 Kf_Xs16_Ys16_Ws16 18000.00 InjTime_us -13000.00 5000.00 EXTENDED_LIMITS -13107.20 13106.80
 /begin AXIS_DESCR STD_AXIS Epm_nEng EngN 2 0.00 6000.000 EXTENDED_LIMITS -16384.00 16383.50 DEPOSIT ABSOLUTE /end AXIS_DESCR
 /begin AXIS_DESCR STD_AXIS InjCtl_qSetUnBal InjMass 2 0.00 327.6700 EXTENDED_LIMITS -327.6800 327.6700 DEPOSIT ABSOLUTE /end AXIS_DESCR
/end CHARACTERISTIC
/begin CHARACTERISTIC InjCrv_tiPoI1Bas_MAP "" MAP 0x80048B50 Map_Xs16Ys16Ws16 5100.0000 InjTime_us -100.0000 5000.0000 EXTENDED_LIMITS -13107.20 13106.80
 /begin AXIS_DESCR STD_AXIS Epm_nEng EngN 2 0.00 10000.00 EXTENDED_LIMITS -16384.00 16383.50 DEPOSIT ABSOLUTE /end AXIS_DESCR
 /begin AXIS_DESCR STD_AXIS InjCtl_qSetUnBal InjMass 2 0.00 327.6700 EXTENDED_LIMITS -327.6800 327.6700 DEPOSIT ABSOLUTE /end AXIS_DESCR
/end CHARACTERISTIC
/begin CHARACTERISTIC InjCrv_tiPoI1MaxOfs_MAP "" MAP 0x80048B64 Map_Xs16Ys16Ws16 5000.00 InjTime_us 0.00 5000.00 EXTENDED_LIMITS -13107.20 13106.80
 /begin AXIS_DESCR STD_AXIS RailP_pFlt Pres_Rail 8 0.1000000 2000.0000000 EXTENDED_LIMITS -3276.8000000 3276.7000000 DEPOSIT ABSOLUTE /end AXIS_DESCR
 /begin AXIS_DESCR STD_AXIS InjCrv_qPoI2Des1_mp InjMass 8 0.00 35.00000 EXTENDED_LIMITS -327.6800 327.6700 DEPOSIT ABSOLUTE /end AXIS_DESCR
/end CHARACTERISTIC
/begin MEASUREMENT InjCrv_facAPPiI1DynCorRgn_mp "" SWORD Fact 1 100 -4.000000 3.999878 ECU_ADDRESS 0xC000A0FE /end MEASUREMENT
/begin MEASUREMENT InjCrv_facAPPiI1DynCor_mp "atmosphärendruckabhängiger Gewichtungsfaktor" SWORD Fact 1 100 -4.000000 3.999878 ECU_ADDRESS 0xC000A0F4 /end MEASUREMENT
/begin MEASUREMENT InjCrv_facAPPiI1DynQCorRgn_mp "" SWORD Fact 1 100 -4.000000 3.999878 ECU_ADDRESS 0xC000A100 /end MEASUREMENT
/begin MEASUREMENT InjCrv_facAPPiI1DynQCor_mp "Atmosphärendruckabhängiger Gewichtungsfaktor" SWORD Fact 1 100 -4.000000 3.999878 ECU_ADDRESS 0xC000A0F6 /end MEASUREMENT
/begin MEASUREMENT InjCrv_facAPPrPiI1DynCor_mp "Dynamikkorrektur für Pilotabstand PiI1 abhängig vom PWG Niveau" SWORD Fact 1 100 -4.000000 3.999878 ECU_ADDRESS 0xC000A0C6 /end MEASUREMENT
/begin MEASUREMENT InjCrv_facAPPrPiI1DynQCor_mp "Dynamikkorrektur für Pilotmenge PiI1 abhängig vom PWG Niveau" SWORD Fact 1 100 -4.000000 3.999878 ECU_ADDRESS 0xC000A0C8 /end MEASUREMENT
/begin MEASUREMENT InjCrv_facDQPiI1DynCorRgn_mp "Einspritzmengengradientenabhängiger Gewichtungsfaktor für Voreinspritzmengenkorrektur während Regeneration" SWORD Fact 1 100 -4.000000 3.999878 ECU_ADDRESS 0xC000A0EA /end MEASUREMENT
/begin MEASUREMENT InjCrv_facDQPiI1DynCor_mp "einspritzmengengradientenabhängiger Gewichtungsfaktor" SWORD Fact 1 100 -4.000000 3.999878 ECU_ADDRESS 0xC000A0CA /end MEASUREMENT
/begin MEASUREMENT InjCrv_facDQPiI1DynQCorRgn_mp "Einspritzmengengradientenabhängiger Gewichtungsfaktor für Voreinspitzmengenkorrektur waehrend Regeneration" SWORD Fact 1 100 -4.000000 3.999878 ECU_ADDRESS 0xC000A0EC /end MEASUREMENT
/begin MEASUREMENT InjCrv_facDQPiI1DynQCor_mp "einspritzmengengradientenabhängiger Gewichtungsfaktor für Voreinspritzmengenkorrektur" SWORD Fact 1 100 -4.000000 3.999878 ECU_ADDRESS 0xC000A0CC /end MEASUREMENT
/begin MEASUREMENT InjCrv_facETPiI1DynCorRgn_mp "" SWORD Fact 1 100 -4.000000 3.999878 ECU_ADDRESS 0xC000A102 /end MEASUREMENT
/begin MEASUREMENT InjCrv_facETPiI1DynCor_mp "motortemperaturabhängiger Gewichtungsfaktor" SWORD Fact 1 100 -4.000000 3.999878 ECU_ADDRESS 0xC000A0F8 /end MEASUREMENT
/begin MEASUREMENT InjCrv_facETPiI1DynQCorRgn_mp "" SWORD Fact 1 100 -4.000000 3.999878 ECU_ADDRESS 0xC000A104 /end MEASUREMENT
/begin MEASUREMENT InjCrv_facETPiI1DynQCor_mp "Motortemperaturabhängiger Gewichtungfaktor" SWORD Fact 1 100 -4.000000 3.999878 ECU_ADDRESS 0xC000A0FA /end MEASUREMENT
/begin MEASUREMENT InjCrv_facIAPiI1DynCorRgn_mp "" SWORD Fact 1 100 -4.000000 3.999878 ECU_ADDRESS 0xC000A106 /end MEASUREMENT
/begin MEASUREMENT InjCrv_facIAPiI1DynCor_mp "ansauglufttemperaturabhängigen Gewichtungsfaktor der Voreinspritzung PiI1" SWORD Fact 1 100 -4.000000 3.999878 ECU_ADDRESS 0xC000A0FC /end MEASUREMENT
/begin MEASUREMENT InjCrv_facPiI1APSQCor1 "Atmosphärendruckabhängiger Mengenkorrekturfaktor für PiI1 bei inaktiver PiI2" SWORD Fact 1 100 -4.000000 3.999878 ECU_ADDRESS 0xD0000D26 /end MEASUREMENT
/begin MEASUREMENT InjCrv_facPiI1APSQCor2 "Atmosphärendruckabhängiger Mengenkorrekturfaktor für PiI1 bei aktiver PiI2" SWORD Fact 1 100 -4.000000 3.999878 ECU_ADDRESS 0xD0000D28 /end MEASUREMENT
/begin MEASUREMENT InjCrv_facPiI1APSQCorRgn1 "Atmosphärendruckabhängiger Mengenkorrekturfaktor 1 für Voreinspritzung 1 im Regenerationsbetrieb" SWORD Fact 1 100 -4.000000 3.999878 ARRAY_SIZE 2 ECU_ADDRESS 0xD0000D2A /end MEASUREMENT
/begin MEASUREMENT InjCrv_facPiI1APSQCorRgn2 "Atmosphärendruckabhängiger Mengenkorrekturfaktor 2 für Voreinspritzung 1 im Regenerationsbetrieb" SWORD Fact 1 100 -4.000000 3.999878 ARRAY_SIZE 2 ECU_ADDRESS 0xD0000D2E /end MEASUREMENT
/begin MEASUREMENT InjCrv_facPiI1APSQCorStrt "atmosphärendruckabhängiger Mengenkorrekturfaktor für Voreinspritzung 1 bei inaktiver Voreinspritzung 2 im Startzustand" SWORD Fact 1 100 -4.000000 3.999878 ECU_ADDRESS 0xD0000D32 /end MEASUREMENT
/begin MEASUREMENT InjCrv_facPiI1APSSOECor1 "Luftdruckabhängiger Ansteuerbeginnkorrekturfaktor für PiI1 bei inaktiver PiI2" SWORD Fact 1 100 -4.000000 3.999878 ECU_ADDRESS 0xD0000D34 /end MEASUREMENT
/begin MEASUREMENT InjCrv_facPiI1APSSOECor2 "Luftdruckabhängiger Ansteuerbeginnkorrekturfaktor für PiI1 bei aktiver PiI2" SWORD Fact 1 100 -4.000000 3.999878 ECU_ADDRESS 0xD0000D36 /end MEASUREMENT
/begin MEASUREMENT InjCrv_facPiI1APSSOECorRgn1 "Luftdruckabhängiger Ansteuerbeginnkorrekturfaktor 1 für Voreinspritzung 1 im Regenerationsbetrieb" SWORD Fact 1 100 -4.000000 3.999878 ARRAY_SIZE 2 ECU_ADDRESS 0xD0000D38 /end MEASUREMENT
/begin MEASUREMENT InjCrv_facPiI1APSSOECorRgn2 "Luftdruckabhängiger Ansteuerbeginnkorrekturfaktor 2 für Voreinspritzung 1 im Regenerationsbetrieb" SWORD Fact 1 100 -4.000000 3.999878 ARRAY_SIZE 2 ECU_ADDRESS 0xD0000D3C /end MEASUREMENT
/begin MEASUREMENT InjCrv_facPiI1ATSQCor1 "Ansauglufttemperaturabhängiger Mengenkorrekturfaktor für PiI1 bei inaktiver PiI2" SWORD Fact 1 100 -4.000000 3.999878 ECU_ADDRESS 0xD0000D40 /end MEASUREMENT
/begin MEASUREMENT InjCrv_facPiI1ATSQCor2 "Ansauglufttemperaturabhängiger Mengenkorrekturfaktor für PiI1 bei aktiver PiI2" SWORD Fact 1 100 -4.000000 3.999878 ECU_ADDRESS 0xD0000D42 /end MEASUREMENT
/begin MEASUREMENT InjCrv_facPiI1ATSQCorRgn1 "Ansauglufttemperaturabhängiger Mengenkorrekturfaktor 1 für Voreinspritzung 1 im Regenerationsbetrieb" SWORD Fact 1 100 -4.000000 3.999878 ARRAY_SIZE 2 ECU_ADDRESS 0xD0000D44 /end MEASUREMENT
/begin MEASUREMENT InjCrv_facPiI1ATSQCorRgn2 "Ansauglufttemperaturabhängiger Mengenkorrekturfaktor 2 für Voreinspritzung 1 im Regenerationsbetrieb" SWORD Fact 1 100 -4.000000 3.999878 ARRAY_SIZE 2 ECU_ADDRESS 0xD0000D48 /end MEASUREMENT
/begin MEASUREMENT InjCrv_facPiI1ATSQCorStrt "motortemperaturabhängiger Mengenkorrekturfaktor für Voreinspritzung 1 bei inaktiver Voreinspritzung 2 im Startzustand" SWORD Fact 1 100 -4.000000 3.999878 ECU_ADDRESS 0xD0000D4C /end MEASUREMENT
/begin MEASUREMENT InjCrv_facPiI1ATSSOECor1 "Ansauglufttemperaturabhängiger Ansteuerbeginnkorrekturfaktor für PiI1 bei inaktiver PiI2" SWORD Fact 1 100 -4.000000 3.999878 ECU_ADDRESS 0xD0000D4E /end MEASUREMENT
/begin MEASUREMENT InjCrv_facPiI1ATSSOECor2 "Ansauglufttemperaturabhängiger Ansteuerbeginnkorrekturfaktor für PiI1 bei aktiver PiI2" SWORD Fact 1 100 -4.000000 3.999878 ECU_ADDRESS 0xD0000D50 /end MEASUREMENT
/begin MEASUREMENT InjCrv_facPiI1ATSSOECorRgn "Ansauglufttemperaturabhängiger Ansteuerbeginnkorrekturfaktor für Voreinspritzung 1 im Regenerationsbetrieb" SWORD Fact 1 100 -4.000000 3.999878 ECU_ADDRESS 0xD0000D5A /end MEASUREMENT
/begin MEASUREMENT InjCrv_facPiI1ATSSOECorRgn1 "Ansauglufttemperaturabhängiger Ansteuerbeginnkorrekturfaktor 1 für Voreinspritzung 1 im Regenerationsbetrieb" SWORD Fact 1 100 -4.000000 3.999878 ARRAY_SIZE 2 ECU_ADDRESS 0xD0000D52 /end MEASUREMENT
/begin MEASUREMENT InjCrv_facPiI1ATSSOECorRgn2 "Ansauglufttemperaturabhängiger Ansteuerbeginnkorrekturfaktor 2 für Voreinspritzung 1 im Regenerationsbetrieb" SWORD Fact 1 100 -4.000000 3.999878 ARRAY_SIZE 2 ECU_ADDRESS 0xD0000D56 /end MEASUREMENT
/begin MEASUREMENT InjCrv_facPiI1DynQCor "dynamischer Mengenkorrekturfaktor für PiI1" SWORD Fact 1 100 -4.000000 3.999878 ECU_ADDRESS 0xD0000D5C /end MEASUREMENT
/begin MEASUREMENT InjCrv_facPiI1DynQCorRgn "" SWORD Fact 1 100 -4.000000 3.999878 ECU_ADDRESS 0xD0000D5E /end MEASUREMENT
/begin MEASUREMENT InjCrv_facPiI1DynSOECor "motortemperatur- und atmosphärendruckabhängiger Winkelkorrekturfaktor für Pil1" SWORD Fact 1 100 -4.000000 3.999878 ECU_ADDRESS 0xD0000D60 /end MEASUREMENT
/begin MEASUREMENT InjCrv_facPiI1DynSOECorRgn "" SWORD Fact 1 100 -4.000000 3.999878 ECU_ADDRESS 0xD0000D62 /end MEASUREMENT
/begin MEASUREMENT InjCrv_facPiI1ETSQCor1 "Motortemperaturabhängiger Mengenkorrekturfaktor für PiI1 bei inaktiver PiI2" SWORD Fact 1 100 -4.000000 3.999878 ECU_ADDRESS 0xD0000D68 /end MEASUREMENT
/begin MEASUREMENT InjCrv_facPiI1ETSQCor11 "motortemperaturabhängiger Mengenkorrekturfaktor -1 für Voreinspritzung 1" SWORD Fact 1 100 -4.000000 3.999878 ECU_ADDRESS 0xD0000D64 /end MEASUREMENT
/begin MEASUREMENT InjCrv_facPiI1ETSQCor12 "motortemperaturabhängiger Mengenkorrekturfaktor für Voreinspritzung 1 bei inaktiver Voreinspritzung 2" SWORD Fact 1 100 -4.000000 3.999878 ECU_ADDRESS 0xD0000D66 /end MEASUREMENT
/begin MEASUREMENT InjCrv_facPiI1ETSQCor2 "Motortemperaturabhängiger Mengenkorrekturfaktor für PiI1 bei aktiver PiI2" SWORD Fact 1 100 -4.000000 3.999878 ECU_ADDRESS 0xD0000D6A /end MEASUREMENT
/begin MEASUREMENT InjCrv_facPiI1ETSQCorRgn1 "Motortemperaturabhängiger Mengenkorrekturfaktor 1 für Voreinspritzung 1 im Regenerationsbetrieb" SWORD Fact 1 100 -4.000000 3.999878 ARRAY_SIZE 2 ECU_ADDRESS 0xD0000D6C /end MEASUREMENT
/begin MEASUREMENT InjCrv_facPiI1ETSQCorRgn2 "Motortemperaturabhängiger Mengenkorrekturfaktor 2 für Voreinspritzung 1 im Regenerationsbetrieb" SWORD Fact 1 100 -4.000000 3.999878 ARRAY_SIZE 2 ECU_ADDRESS 0xD0000D70 /end MEASUREMENT
/begin MEASUREMENT InjCrv_facPiI1ETSQCorStrt "motortemperaturabhängiger Mengenkorrekturfaktor für Voreinspritzung 1 bei inaktiver Voreinspritzung 2 im Startzustand" SWORD Fact 1 100 -4.000000 3.999878 ECU_ADDRESS 0xD0000D74 /end MEASUREMENT
/begin MEASUREMENT InjCrv_facPiI1ETSSOECor1 "Motortemperaturabhängiger Ansteuerbeginnkorrekturfaktor für PiI1 bei inaktiver PiI2" SWORD Fact 1 100 -4.000000 3.999878 ECU_ADDRESS 0xD0000D7A /end MEASUREMENT
/begin MEASUREMENT InjCrv_facPiI1ETSSOECor11 "motortemperaturabhängiger Ansteuerbeginnkorrekturfaktor -1 für Voreinspritzung 1" SWORD Fact 1 100 -4.000000 3.999878 ECU_ADDRESS 0xD0000D76 /end MEASUREMENT
/begin MEASUREMENT InjCrv_facPiI1ETSSOECor12 """motortemperaturabhängiger Ansteuerbeginnkorrekturfaktor für Voreinspritzung 1 bei inaktiver Voreinspritzung 2""" SWORD Fact 1 100 -4.000000 3.999878 ECU_ADDRESS 0xD0000D78 /end MEASUREMENT
/begin MEASUREMENT InjCrv_facPiI1ETSSOECor2 "Motortemperaturabhängiger Ansteuerbeginnkorrekturfaktor für PiI1 bei aktiver PiI2" SWORD Fact 1 100 -4.000000 3.999878 ECU_ADDRESS 0xD0000D7C /end MEASUREMENT
/begin MEASUREMENT InjCrv_facPiI1ETSSOECorRgn1 "Motortemperaturabhängiger Ansteuerbeginnkorrekturfaktor 1 für Voreinspritzung 1 im Regenerationsbetrieb" SWORD Fact 1 100 -4.000000 3.999878 ARRAY_SIZE 2 ECU_ADDRESS 0xD0000D7E /end MEASUREMENT
/begin MEASUREMENT InjCrv_facPiI1ETSSOECorRgn2 "Motortemperaturabhängiger Ansteuerbeginnkorrekturfaktor 2 für Voreinspritzung 1 im Regenerationsbetrieb" SWORD Fact 1 100 -4.000000 3.999878 ARRAY_SIZE 2 ECU_ADDRESS 0xD0000D82 /end MEASUREMENT
/begin MEASUREMENT InjCrv_facPiI1ETSSOECorStrt """motortemperaturabhängiger Ansteuerbeginnkorrekturfaktor für Voreinspritzung 1 bei inaktiver Voreinspritzung 2 im Startzustand """ SWORD Fact 1 100 -4.000000 3.999878 ECU_ADDRESS 0xD0000D86 /end MEASUREMENT
/begin MEASUREMENT InjCrv_facPiI1QntRmpVal_mp "Interpolationsfaktor für die Funktion InjCrv_PiI1RgnSwtQnt" SWORD CoEOMSwt_S16 1 100 -2.000000 1.999939 FORMAT "%8.6" ECU_ADDRESS 0xC000A12E /end MEASUREMENT
/begin MEASUREMENT InjCrv_facPiI1SOERmpVal_mp "Interpolationsfaktor für die Funktion InjCrv_PiI1RgnSwtSOE" SWORD CoEOMSwt_S16 1 100 -2.000000 1.999939 FORMAT "%8.6" ECU_ADDRESS 0xC000A130 /end MEASUREMENT
/begin MEASUREMENT InjCrv_facPiI2APSQCor "atmosphärendruckabhängiger Mengenkorrekturfaktor für PiI2" SWORD Fact 1 100 -4.000000 3.999878 ECU_ADDRESS 0xD0000D88 /end MEASUREMENT
/begin MEASUREMENT InjCrv_facPiI2APSQCorRgn "Atmosphärendruckabhängiger Mengenkorrekturfaktor für Voreinspritzung 2 im Regenerationsbetrieb" SWORD Fact 1 100 -4.000000 3.999878 ARRAY_SIZE 2 ECU_ADDRESS 0xD0000D8A /end MEASUREMENT
/begin MEASUREMENT InjCrv_facPiI2APSQCorStrt "atmospheric pressure dependent correction factor for quantity PiI2" SWORD Fact 1 100 -4.000000 3.999878 ECU_ADDRESS 0xD0000D8E /end MEASUREMENT
/begin MEASUREMENT InjCrv_facPiI2APSSOECor "Luftdruckabhängiger Gewichtungsfaktor für PiI2" SWORD Fact 1 100 -4.000000 3.999878 ECU_ADDRESS 0xD0000D90 /end MEASUREMENT
/begin MEASUREMENT InjCrv_facPiI2APSSOECorRgn "Luftruckabhängiger Ansteuerbeginnkorrekturfaktor für Voreinspritzung 2 im Regenerationsbetrieb" SWORD Fact 1 100 -4.000000 3.999878 ARRAY_SIZE 2 ECU_ADDRESS 0xD0000D92 /end MEASUREMENT
/begin MEASUREMENT InjCrv_facPiI2APSSOECorStrt "" SWORD Fact 1 100 -4.000000 3.999878 ECU_ADDRESS 0xD0000D96 /end MEASUREMENT
/begin MEASUREMENT InjCrv_facPiI2ATSQCor "ansauglufttemperaturabhängiger Mengenkorrekturfaktor für PiI2" SWORD Fact 1 100 -4.000000 3.999878 ECU_ADDRESS 0xD0000D98 /end MEASUREMENT
/begin MEASUREMENT InjCrv_facPiI2ATSQCorRgn "Ansauglufttemperaturabhängiger Mengenkorrekturfaktor für Voreinspritzung 2 im Regenerationsbetrieb" SWORD Fact 1 100 -4.000000 3.999878 ARRAY_SIZE 2 ECU_ADDRESS 0xD0000D9A /end MEASUREMENT
/begin MEASUREMENT InjCrv_facPiI2ATSQCorStrt "intake air temperature dependent correction factor for quantity PiI2" SWORD Fact 1 100 -4.000000 3.999878 ECU_ADDRESS 0xD0000D9E /end MEASUREMENT
/begin MEASUREMENT InjCrv_facPiI2ATSSOECor "Ansauglufttemperaturspezifischer Gewichtungsfaktor für PiI2" SWORD Fact 1 100 -4.000000 3.999878 ECU_ADDRESS 0xD0000DA0 /end MEASUREMENT
/begin MEASUREMENT InjCrv_facPiI2ATSSOECorRgn "Ansauglufttemperaturabhängiger Ansteuerbeginnkorrekturfaktor für Voreinspritzung 2 im Regenerationsbetrieb" SWORD Fact 1 100 -4.000000 3.999878 ARRAY_SIZE 2 ECU_ADDRESS 0xD0000DA2 /end MEASUREMENT
/begin MEASUREMENT InjCrv_facPiI2ETSQCor "motortemperaturabhängiger Mengenkorrekturfaktor für PiI2" SWORD Fact 1 100 -4.000000 3.999878 ECU_ADDRESS 0xD0000DA8 /end MEASUREMENT
/begin MEASUREMENT InjCrv_facPiI2ETSQCor11 "" SWORD Fact 1 100 -4.000000 3.999878 ECU_ADDRESS 0xD0000DA6 /end MEASUREMENT
/begin MEASUREMENT InjCrv_facPiI2ETSQCorRgn "Motortemperaturabhängiger Mengenkorrekturfaktor für Voreinspritzung 2 im Regenerationsbetrieb" SWORD Fact 1 100 -4.000000 3.999878 ARRAY_SIZE 2 ECU_ADDRESS 0xD0000DAA /end MEASUREMENT
/begin MEASUREMENT InjCrv_facPiI2ETSQCorStrt "atmospheric pressure dependent correction factor for quantity PiI2" SWORD Fact 1 100 -4.000000 3.999878 ECU_ADDRESS 0xD0000DAE /end MEASUREMENT
/begin MEASUREMENT InjCrv_facPiI2ETSSOECor "motortemperaturabhängiger Ansteuerbeginnkorrekturfaktor für PiI2" SWORD Fact 1 100 -4.000000 3.999878 ECU_ADDRESS 0xD0000DB0 /end MEASUREMENT
/begin MEASUREMENT InjCrv_facPiI2ETSSOECorRgn "motortemperaturabhängiger Ansteuerbeginnkorrekturfaktor für Voreinspritzung 2 im Regenerationsbetrieb" SWORD Fact 1 100 -4.000000 3.999878 ARRAY_SIZE 2 ECU_ADDRESS 0xD0000DB2 /end MEASUREMENT
/begin MEASUREMENT InjCrv_facPiI2ETSSOECorStrt "engine temperature dependent correction factor for PiI2-SOE" SWORD Fact 1 100 -4.000000 3.999878 ECU_ADDRESS 0xD0000DB6 /end MEASUREMENT
/begin MEASUREMENT InjCrv_facPiI2QntMin_mp "Wichtungsfaktor zum Abschalten der Berechnung Voreinspritzung 2" SWORD Fact1 1 100 -256.0000 255.9922 ECU_ADDRESS 0xC000A136 /end MEASUREMENT
/begin MEASUREMENT InjCrv_facPiI2QntRmpVal_mp "Interpolationsfaktor für die Funktion InjCrv_PiI2RgnSwtQnt" SWORD CoEOMSwt_S16 1 100 -2.000000 1.999939 FORMAT "%8.6" ECU_ADDRESS 0xC000A180 /end MEASUREMENT
/begin MEASUREMENT InjCrv_facPiI2SOERmpVal_mp "Interpolationsfaktor für die Funktion InjCrv_PiI2RgnSwtSOE" SWORD CoEOMSwt_S16 1 100 -2.000000 1.999939 FORMAT "%8.6" ECU_ADDRESS 0xC000A182 /end MEASUREMENT
/begin MEASUREMENT InjCrv_facPoI1AddCorRgn "" SWORD Fact 1 100 -4.000000 3.999878 ECU_ADDRESS 0xD0000DBA /end MEASUREMENT
/begin MEASUREMENT InjCrv_facPoI1EffSet "" SWORD Fact 1 100 0.00 1.000000 ECU_ADDRESS 0xD0000DC4 /end MEASUREMENT
/begin MEASUREMENT InjCrv_facPoI1Eff_mp "" SWORD Fact 1 100 0.00 1.000000 ECU_ADDRESS 0xC000A18E /end MEASUREMENT
/begin MEASUREMENT InjCrv_facPoI1RgnAPSQCor_mp "" SWORD Fact 1 100 -4.000000 3.999878 ECU_ADDRESS 0xC000A1C8 /end MEASUREMENT
/begin MEASUREMENT InjCrv_numPiI1RgnStg_mp "Anzahl der eingestellten Regenerationsstufen für die PiI1" UBYTE OneToOne 1 100 0.00 255.0 ECU_ADDRESS 0xC000B249 /end MEASUREMENT
/begin MEASUREMENT InjCrv_numPiI2RgnStg_mp "Anzahl der eingestellten Regenerationsstufen für die PiI2" UBYTE OneToOne 1 100 0.00 255.0 ECU_ADDRESS 0xC000B24B /end MEASUREMENT
/begin MEASUREMENT InjCrv_phiDynOfs_mp "Winkelvorhalt für schnelle dynamische Vorgänge" SWORD AngleCrS 1 100 -720.0000 719.9780 ECU_ADDRESS 0xC000A190 /end MEASUREMENT
/begin MEASUREMENT InjCrv_phiNxtCylBnk_mp "Winkel zw. aktuellem OT und OT des nächsten Zylinders auf derselben Bank" SWORD AngleCrS 1 100 -720.0000 719.9780 ECU_ADDRESS 0xC000A192 /end MEASUREMENT
/begin MEASUREMENT InjCrv_phiNxtCyl_mp "Winkel zwischen aktuellem OT und der frühesten Einspritzung des nächsten Zylinders auf derselben Bank" SWORD AngleCrS 1 100 -720.0000 719.9780 ECU_ADDRESS 0xC000A194 /end MEASUREMENT
/begin MEASUREMENT InjCrv_phiPiI1AddCor1 "kundenspezifischer Korrekturwinkel für PiI1 bei inaktiver PiI2" SWORD AngleCrS 1 100 -720.0000 719.9780 ECU_ADDRESS 0xD0000E38 /end MEASUREMENT
/begin MEASUREMENT InjCrv_phiPiI1AddCor2 "kundenspezifischer Korrekturwinkel für PiI1 bei aktiver PiI2" SWORD AngleCrS 1 100 -720.0000 719.9780 ECU_ADDRESS 0xD0000E3A /end MEASUREMENT
/begin MEASUREMENT InjCrv_phiPiI1APSCor1_mp "Luftdruckabhängiger Korrekturgrundwert für die Winkelkomponente des Ansteuerbeginns der PiI1 bei inaktiver PiI2" SWORD AngleCrS 1 100 -720.0000 719.9780 ECU_ADDRESS 0xC000A114 /end MEASUREMENT
/begin MEASUREMENT InjCrv_phiPiI1APSCor2_mp "Luftdruckabhängiger Korrekturgrundwert für die Winkelkomponente des Ansteuerbeginns der PiI1 bei aktiver PiI2" SWORD AngleCrS 1 100 -720.0000 719.9780 ECU_ADDRESS 0xC000A116 /end MEASUREMENT
/begin MEASUREMENT InjCrv_phiPiI1ATSCor1_mp "Ansauglufttemperaturabhängiger Korrekturgrundwert für die Winkelkomponente des Ansteuerbeginns der PiI1 bei inaktiver PiI2" SWORD AngleCrS 1 100 -720.0000 719.9780 ECU_ADDRESS 0xC000A118 /end MEASUREMENT
/begin MEASUREMENT InjCrv_phiPiI1ATSCor2_mp "Ansauglufttemperaturabhängiger Korrekturgrundwert für die Winkelkomponente des Ansteuerbeginns der PiI1 bei aktiver PiI2" SWORD AngleCrS 1 100 -720.0000 719.9780 ECU_ADDRESS 0xC000A11A /end MEASUREMENT
/begin MEASUREMENT InjCrv_phiPiI1EnvCor1 "Korrekturwinkel für PiI1 wenn PiI2 inaktiv" SWORD AngleCrS 1 100 -720.0000 719.9780 ECU_ADDRESS 0xD0000E3E /end MEASUREMENT
/begin MEASUREMENT InjCrv_phiPiI1EnvCor2 "Korrekturwinkel für PiI1 wenn PiI2 aktiv" SWORD AngleCrS 1 100 -720.0000 719.9780 ECU_ADDRESS 0xD0000E40 /end MEASUREMENT
/begin MEASUREMENT InjCrv_phiPiI1ETSCor1_mp "motortemperaturabhängiger Korrekturgrundwert für die Winkelkomponente des Ansteuerbeginns der PiI1 bei inaktiver PiI2" SWORD AngleCrS 1 100 -720.0000 719.9780 ECU_ADDRESS 0xC000A11C /end MEASUREMENT
/begin MEASUREMENT InjCrv_phiPiI1ETSCor2_mp "motortemperaturabhängiger Korrekturgrundwert für die Winkelkomponente des Ansteuerbeginns der PiI1 bei aktiver PiI2" SWORD AngleCrS 1 100 -720.0000 719.9780 ECU_ADDRESS 0xC000A11E /end MEASUREMENT
/begin MEASUREMENT InjCrv_phiPiI2AbsTot_mp "absoluter Ansteuerbeginn PiI2 aus Winkel- und Zeitkomponente" SWORD AngleCrS 1 100 -720.0000 719.9780 ECU_ADDRESS 0xC000A138 /end MEASUREMENT
/begin MEASUREMENT InjCrv_phiPiI2Abs_mp "absolute Winkelkomponente Ansteuerbeginn PiI2" SWORD AngleCrS 1 100 -720.0000 719.9780 ECU_ADDRESS 0xC000A13A /end MEASUREMENT
/begin MEASUREMENT InjCrv_phiPiI2AddCor "kundenspezifischer Korrekturwinkel für PiI2" SWORD AngleCrS 1 100 -720.0000 719.9780 ECU_ADDRESS 0xD0000E42 /end MEASUREMENT
/begin MEASUREMENT InjCrv_phiPiI2AddCorStrt "PII2 SOE Winkelkorrektur während des Motor start state" SWORD AngleCrS 1 100 -720.0000 719.9780 ECU_ADDRESS 0xD0000E44 /end MEASUREMENT
/begin MEASUREMENT InjCrv_phiPiI2APSCor_mp "Luftdruckabhängiger Korrekturgrundwert für die Winkelkomponente des Ansteuerbeginns der PiI2" SWORD AngleCrS 1 100 -720.0000 719.9780 ECU_ADDRESS 0xC000A172 /end MEASUREMENT
/begin MEASUREMENT InjCrv_phiPiI2ATSCor_mp "ansauglufttemperaturabhängiger Korrekturgrundwert für die Winkelkomponente des Ansteuerbeginns der PiI2" SWORD AngleCrS 1 100 -720.0000 719.9780 ECU_ADDRESS 0xC000A174 /end MEASUREMENT
/begin MEASUREMENT InjCrv_phiPiI2BasStrt_mp "SOE Winkels Korrektur für PII2 während des Motor Start State" SWORD AngleCrS 1 100 -720.0000 719.9780 ECU_ADDRESS 0xC000A188 /end MEASUREMENT
/begin MEASUREMENT InjCrv_phiPiI2Bas_mp "Winkelkomponente Ansteuerbeginn PiI2 Grundwert" SWORD AngleCrS 1 100 -720.0000 719.9780 ECU_ADDRESS 0xC000A184 /end MEASUREMENT
/begin MEASUREMENT InjCrv_phiPiI2Cor_mp "korrigierter Grundwert Winkelkomponente Ansteuerbeginn PiI2" SWORD AngleCrS 1 100 -720.0000 719.9780 ECU_ADDRESS 0xC000A13C /end MEASUREMENT
/begin MEASUREMENT InjCrv_phiPiI2EnvCor "Korrekturwinkel für Voreinspritzung 2" SWORD AngleCrS 1 100 -720.0000 719.9780 ECU_ADDRESS 0xD0000E48 /end MEASUREMENT
/begin MEASUREMENT InjCrv_phiPiI2ETSCorStrt_mp "Motor Temperaturabhängiger PII2 SOE Winkel korrektur während des Motor start state" SWORD AngleCrS 1 100 -720.0000 719.9780 ECU_ADDRESS 0xC000A15E /end MEASUREMENT
/begin MEASUREMENT InjCrv_phiPiI2ETSCor_mp "motortemperaturabhängiger Korrekturgrundwert für die Winkelkomponente des Ansteuerbeginns der PiI2" SWORD AngleCrS 1 100 -720.0000 719.9780 ECU_ADDRESS 0xC000A176 /end MEASUREMENT
/begin MEASUREMENT InjCrv_phiPiI2Rel_mp "Winkelkomponente Ansteuerbeginn PiI2 relativ zur MI" SWORD AngleCrS 1 100 -720.0000 719.9780 ECU_ADDRESS 0xC000A13E /end MEASUREMENT
/begin MEASUREMENT InjCrv_phiPoI1Des "gewünschter Bezugswinkel für Beginn der PoI1" SWORD AngleCrS 1 100 -720.0000 719.9780 ECU_ADDRESS 0xD0000E4C /end MEASUREMENT
/begin MEASUREMENT InjCrv_phiPoI1DesAddByp_mp "Wert des gewünschten Winkels für die Nacheinspritzung 1 vor einem additiven Bypasseingriff" SWORD AngleCrS 1 100 -720.0000 719.9780 ECU_ADDRESS 0xC000A196 /end MEASUREMENT
/begin MEASUREMENT InjCrv_phiPoI1DesAdd_mp "Additiver Bypasseingriff für gewünschten Winkel der Nacheinspritzung 1" SWORD AngleCrS 1 100 -720.0000 719.9780 ECU_ADDRESS 0xC000A198 /end MEASUREMENT
/begin MEASUREMENT InjCrv_phiPoI1DesByp_mp "Bypass-Label, Kopie von InjCrv_phiPoI1Des" SWORD AngleCrS 1 100 -720.0000 719.9780 ECU_ADDRESS 0xC000A19A /end MEASUREMENT
/begin MEASUREMENT InjCrv_phiPoI1Dur_mp "Gesamtzeit PoI1 in Winkelgraden" SWORD AngleCrS 1 100 -720.0000 719.9780 ECU_ADDRESS 0xC000A19C /end MEASUREMENT
/begin MEASUREMENT InjCrv_phiPoI1Lim_mp "begrenzter Ansteuerbeginnwinkel PoI1" SWORD AngleCrS 1 100 -720.0000 719.9780 ECU_ADDRESS 0xC000A19E /end MEASUREMENT
/begin MEASUREMENT InjCrv_phiPoI1Max_mp "Frühester Ansteuerbeginnwinkel PoI1" SWORD AngleCrS 1 100 -720.0000 719.9780 ECU_ADDRESS 0xC000A1A0 /end MEASUREMENT
/begin MEASUREMENT InjCrv_phiPoI1Min_mp "spätester Ansteuerbeginnwinkel PoI1" SWORD AngleCrS 1 100 -720.0000 719.9780 ECU_ADDRESS 0xC000A1A2 /end MEASUREMENT
/begin MEASUREMENT InjCrv_phiPoI1Tot_mp "" SWORD AngleCrS 1 100 -720.0000 719.9780 ECU_ADDRESS 0xC000A1A4 /end MEASUREMENT
/begin MEASUREMENT InjCrv_POpPoI1AddCor "kundespezifischer Korrekturwert für Freigabe PoI1" SWORD OneToOne 1 100 -32768.00 32767.00 ECU_ADDRESS 0xD0000CE8 /end MEASUREMENT
/begin MEASUREMENT InjCrv_qMI1MinPiI2_mp "Minimalmenge der MI1 wenn PiI1 und PiI2 abgesetzt werden" SWORD InjMass 1 100 -327.6800 327.6700 ECU_ADDRESS 0xC000A140 /end MEASUREMENT
/begin MEASUREMENT InjCrv_qPiI1AddCor1 "kundenspezifische Korrekturmenge für PiI1 bei nicht freigegebener PiI2" SWORD InjMassInj 1 100 -327.6800 327.6700 ECU_ADDRESS 0xD0000E70 /end MEASUREMENT
/begin MEASUREMENT InjCrv_qPiI1AddCor2 "kundenspezifische Korrekturmenge für PiI1 bei freigegebener PiI2" SWORD InjMassInj 1 100 -327.6800 327.6700 ECU_ADDRESS 0xD0000E72 /end MEASUREMENT
/begin MEASUREMENT InjCrv_qPiI1AddCorRgn1 "additiver Korrekturwert für die Mengenkorrektur der PiI1 im Regenerationsbetrieb für nicht freigegebene PiI2" SWORD InjMass 1 100 -327.6800 327.6700 ECU_ADDRESS 0xD0000E74 /end MEASUREMENT
/begin MEASUREMENT InjCrv_qPiI1AddCorRgn2 "additiver Korrekturwert für die Mengenkorrektur der PiI1 im Regenerationsbetrieb für freigegebene PiI2" SWORD InjMass 1 100 -327.6800 327.6700 ECU_ADDRESS 0xD0000E76 /end MEASUREMENT
/begin MEASUREMENT InjCrv_qPiI1AddCorStrt "PII1 menge korrektur während des Motor start state" SWORD InjMassInj 1 100 -327.6800 327.6700 ECU_ADDRESS 0xD0000E78 /end MEASUREMENT
/begin MEASUREMENT InjCrv_qPiI1APSCor1_mp "atmosphärendruckabhängige Korrekturmenge 1 für PiI1 und PiI2" SWORD InjMass 1 100 -327.6800 327.6700 ECU_ADDRESS 0xC000A108 /end MEASUREMENT
/begin MEASUREMENT InjCrv_qPiI1APSCor2_mp "atmosphärendruckabhängige Korrekturmenge 2 für PiI1 und PiI2" SWORD InjMass 1 100 -327.6800 327.6700 ECU_ADDRESS 0xC000A10A /end MEASUREMENT
/begin MEASUREMENT InjCrv_qPiI1APSCorRgn1_mp "Druckabhängiger Basismengenkorrekturwert 1 der Voreinspritzung 1 im Regenerationsbetrieb" SWORD InjMass 1 100 -327.6800 327.6700 ARRAY_SIZE 2 ECU_ADDRESS 0xC000C03C /end MEASUREMENT
/begin MEASUREMENT InjCrv_qPiI1APSCorRgn2_mp "Druckabhängiger Basismengenkorrekturwert 1 der Voreinspritzung 1 im Regenerationsbetrieb" SWORD InjMass 1 100 -327.6800 327.6700 ARRAY_SIZE 2 ECU_ADDRESS 0xC000C040 /end MEASUREMENT
/begin MEASUREMENT InjCrv_qPiI1APSCorStrt_mp "Wert der Mengenkorrektur abhängig vom Atmosphärendruck" SWORD InjMassInj 1 100 -327.6800 327.6700 ECU_ADDRESS 0xC000A0CE /end MEASUREMENT
/begin MEASUREMENT InjCrv_qPiI1ATSCor1_mp "ansauglufttemperaturabhängige Korrekturmenge 1 für PiI1 und PiI2" SWORD InjMass 1 100 -327.6800 327.6700 ECU_ADDRESS 0xC000A10C /end MEASUREMENT
/begin MEASUREMENT InjCrv_qPiI1ATSCor2_mp "ansauglufttemperaturabhängige Korrekturmenge 2 für PiI1 und PiI2" SWORD InjMass 1 100 -327.6800 327.6700 ECU_ADDRESS 0xC000A10E /end MEASUREMENT
/begin MEASUREMENT InjCrv_qPiI1ATSCorRgn1_mp "Lufttemperaturabhängiger Basismengenkorrekturwert 1 der PiI1 im Regenerationsbetrieb" SWORD InjMass 1 100 -327.6800 327.6700 ARRAY_SIZE 2 ECU_ADDRESS 0xC000C044 /end MEASUREMENT
/begin MEASUREMENT InjCrv_qPiI1ATSCorRgn2_mp "Lufttemperaturabhängiger Basismengenkorrekturwert 2 der PiI1 im Regenerationsbetrieb" SWORD InjMass 1 100 -327.6800 327.6700 ARRAY_SIZE 2 ECU_ADDRESS 0xC000C048 /end MEASUREMENT
/begin MEASUREMENT InjCrv_qPiI1ATSCorStrt_mp "quantity correction value dependent on intake air temperature" SWORD InjMassInj 1 100 -327.6800 327.6700 ECU_ADDRESS 0xC000A0D0 /end MEASUREMENT
/begin MEASUREMENT InjCrv_qPiI1BasRgn_mp "Basiswert für die Mengenkorrektur der Voreinspritzung 1 im Regenerationsbetrieb" SWORD InjMass 1 100 -327.6800 327.6700 ARRAY_SIZE 2 ECU_ADDRESS 0xC000C06C /end MEASUREMENT
/begin MEASUREMENT InjCrv_qPiI1BasStrt_mp "Einspritzmenge PiI 1 Grundwert im Startzustand" SWORD InjMassInj 1 100 -327.6800 327.6700 ECU_ADDRESS 0xC000A132 /end MEASUREMENT
/begin MEASUREMENT InjCrv_qPiI1DynCorBas_mp "Niedriger Wert PII1 SOE der Mengekorrektur" SWORD InjMassInj 1 100 -327.6800 327.6700 ECU_ADDRESS 0xC000A0D2 /end MEASUREMENT
/begin MEASUREMENT InjCrv_qPiI1DynCorRgn_mp "Korrekturgrundwert für dynamische Voreinspritzmengenkorrektur waehrend Regeneration" SWORD InjMassInj 1 100 -327.6800 327.6700 ECU_ADDRESS 0xC000A0EE /end MEASUREMENT
/begin MEASUREMENT InjCrv_qPiI1DynCor_mp "Korrekturgrundwert für dynamische Voreinspritzmengenkorrektur" SWORD InjMassInj 1 100 -327.6800 327.6700 ECU_ADDRESS 0xC000A0D4 /end MEASUREMENT
/begin MEASUREMENT InjCrv_qPiI1EnvCor1 "Korrekturmenge für PiI 1 wenn PiI2 inaktiv" SWORD InjMass 1 100 -327.6800 327.6700 ECU_ADDRESS 0xD0000E92 /end MEASUREMENT
/begin MEASUREMENT InjCrv_qPiI1EnvCor2 "Korrekturmenge für PiI 1 wenn PiI2 aktiv" SWORD InjMass 1 100 -327.6800 327.6700 ECU_ADDRESS 0xD0000E94 /end MEASUREMENT
/begin MEASUREMENT InjCrv_qPiI1EnvCorRgn1 "Korrekturmenge 1 für Voreinspritzung 1 im Regenerationsbetrieb" SWORD InjMass 1 100 -327.6800 327.6700 ARRAY_SIZE 2 ECU_ADDRESS 0xD0000E96 /end MEASUREMENT
/begin MEASUREMENT InjCrv_qPiI1EnvCorRgn2 "Korrekturmenge 2 für Voreinspritzung 1 im Regenerationsbetrieb" SWORD InjMass 1 100 -327.6800 327.6700 ARRAY_SIZE 2 ECU_ADDRESS 0xD0000E9A /end MEASUREMENT
/begin MEASUREMENT InjCrv_qPiI1ETSCor11_mp "motortemperaturabhängige Korrekturmenge -1 für PiI1 und PiI2" SWORD InjMassInj 1 100 -327.6800 327.6700 ECU_ADDRESS 0xC000A0D6 /end MEASUREMENT
/begin MEASUREMENT InjCrv_qPiI1ETSCor12_mp """motortemperaturabhängige Korrekturmenge für PiI1 bei inaktiver PiI2""" SWORD InjMassInj 1 100 -327.6800 327.6700 ECU_ADDRESS 0xC000A0D8 /end MEASUREMENT
/begin MEASUREMENT InjCrv_qPiI1ETSCor1_mp "motortemperaturabhängige Korrekturmenge 1 für PiI1 und PiI2" SWORD InjMass 1 100 -327.6800 327.6700 ECU_ADDRESS 0xC000A110 /end MEASUREMENT
/begin MEASUREMENT InjCrv_qPiI1ETSCor2_mp "motortemperaturabhängige Korrekturmenge 2 für PiI1 und PiI2" SWORD InjMass 1 100 -327.6800 327.6700 ECU_ADDRESS 0xC000A112 /end MEASUREMENT
/begin MEASUREMENT InjCrv_qPiI1ETSCorRgn1_mp "Motortemperaturabhängiger Basismengenkorrekturwert 1 der PiI1 im Regenerationsbetrieb" SWORD InjMass 1 100 -327.6800 327.6700 ARRAY_SIZE 2 ECU_ADDRESS 0xC000C04C /end MEASUREMENT
/begin MEASUREMENT InjCrv_qPiI1ETSCorRgn2_mp "Motortemperaturabhängiger Basismengenkorrekturwert 2 der PiI1 im Regenerationsbetrieb" SWORD InjMass 1 100 -327.6800 327.6700 ARRAY_SIZE 2 ECU_ADDRESS 0xC000C050 /end MEASUREMENT
/begin MEASUREMENT InjCrv_qPiI1ETSCorStrt_mp "quantity correction value dependent on engine temperature" SWORD InjMassInj 1 100 -327.6800 327.6700 ECU_ADDRESS 0xC000A0DA /end MEASUREMENT
/begin MEASUREMENT InjCrv_qPiI1MaxRgn_mp "Maximalwert der Korrekturmenge für die Voreinspritzmenge 1 im Regenerationsbetrieb" SWORD InjMass 1 100 -327.6800 327.6700 ECU_ADDRESS 0xC000A12C /end MEASUREMENT
/begin MEASUREMENT InjCrv_qPiI1Rgn "Regenerationswert für die Einspritmenge der PiI1" SWORD InjMass 1 100 -327.6800 327.6700 ARRAY_SIZE 2 ECU_ADDRESS 0xD0000E9E /end MEASUREMENT
/begin MEASUREMENT InjCrv_qPiI1RgnAdd_mp "Additiver Bypasseingriff für Menge der Voreinspritzung 1 im Regenerationsbetrieb" SWORD InjMass 1 100 -327.6800 327.6700 ARRAY_SIZE 2 ECU_ADDRESS 0xC000C070 /end MEASUREMENT
/begin MEASUREMENT InjCrv_qPiI2AddCor "kundenspezifische Korrekturmenge für PiI2" SWORD InjMass 1 100 -327.6800 327.6700 ECU_ADDRESS 0xD0000EA2 /end MEASUREMENT
/begin MEASUREMENT InjCrv_qPiI2AddCorRgn "additiver Korrekturwert für die Mengenkorrektur der PiI2 im Regenerationsbetrieb" SWORD InjMassInj 1 100 -327.6800 327.6700 ECU_ADDRESS 0xD0000EA4 /end MEASUREMENT
/begin MEASUREMENT InjCrv_qPiI2AddCorStrt "PII2 menge korrektur während des Motor start state" SWORD InjMassInj 1 100 -327.6800 327.6700 ECU_ADDRESS 0xD0000EA6 /end MEASUREMENT
/begin MEASUREMENT InjCrv_qPiI2APSCorRgn_mp "Druckabhängiger Basismengenkorrekturwert der Voreinspritzung 2 im Regenerationsbetrieb" SWORD InjMassInj 1 100 -327.6800 327.6700 ARRAY_SIZE 2 ECU_ADDRESS 0xC000C07C /end MEASUREMENT
/begin MEASUREMENT InjCrv_qPiI2APSCor_mp "atmosphärendruckabhängige Korrekturmenge für Voreinspritzung 2" SWORD InjMass 1 100 -327.6800 327.6700 ECU_ADDRESS 0xC000A16C /end MEASUREMENT
/begin MEASUREMENT InjCrv_qPiI2APSQCorStrt_mp "Atmosphäre Druck abhängiger PII2 menge korrektur während des Motor start state" SWORD InjMassInj 1 100 -327.6800 327.6700 ECU_ADDRESS 0xC000A160 /end MEASUREMENT
/begin MEASUREMENT InjCrv_qPiI2ATSCorRgn_mp "Ansauglufttemperaturabhängiger Basismengenkorrekturwert der PiI2 im Regenerationsbetrieb" SWORD InjMassInj 1 100 -327.6800 327.6700 ARRAY_SIZE 2 ECU_ADDRESS 0xC000C080 /end MEASUREMENT
/begin MEASUREMENT InjCrv_qPiI2ATSCor_mp "ansauglufttemperaturabhängige Korrekturmenge für Voreinspritzung 2" SWORD InjMass 1 100 -327.6800 327.6700 ECU_ADDRESS 0xC000A16E /end MEASUREMENT
/begin MEASUREMENT InjCrv_qPiI2ATSQCorStrt_mp "Lufttemperatur abhängiger PII2 menge korrektur während des Motor start state" SWORD InjMassInj 1 100 -327.6800 327.6700 ECU_ADDRESS 0xC000A162 /end MEASUREMENT
/begin MEASUREMENT InjCrv_qPiI2BasRgn_mp "Basiswert für die Mengenkorrektur der Voreinspritzung 2 im Regenerationsbetrieb" SWORD InjMass 1 100 -327.6800 327.6700 ARRAY_SIZE 2 ECU_ADDRESS 0xC000C094 /end MEASUREMENT
/begin MEASUREMENT InjCrv_qPiI2BasStrt_mp "Einspritzmenge PiI 2 Grundwert im Startzustand" SWORD InjMassInj 1 100 -327.6800 327.6700 ECU_ADDRESS 0xC000A18A /end MEASUREMENT
/begin MEASUREMENT InjCrv_qPiI2Bas_mp "Einspritzmenge PiI2 Grundwert" SWORD InjMass 1 100 -327.6800 327.6700 ECU_ADDRESS 0xC000A142 /end MEASUREMENT
/begin MEASUREMENT InjCrv_qPiI2EnvCor "Korrekturmenge für Voreinspritzung 2" SWORD InjMass 1 100 -327.6800 327.6700 ECU_ADDRESS 0xD0000EB4 /end MEASUREMENT
/begin MEASUREMENT InjCrv_qPiI2EnvCorRgn "Korrekturmenge für Voreinspritzung 2 im Regenerationsbetrieb" SWORD InjMassInj 1 100 -327.6800 327.6700 ARRAY_SIZE 2 ECU_ADDRESS 0xD0000EB6 /end MEASUREMENT
/begin MEASUREMENT InjCrv_qPiI2ETSCor11_mp "" SWORD InjMass 1 100 -327.6800 327.6700 ECU_ADDRESS 0xC000A164 /end MEASUREMENT
/begin MEASUREMENT InjCrv_qPiI2ETSCorRgn_mp "Motortemperaturabhängiger Basismengenkorrekturwert der PiI2 im Regenerationsbetrieb" SWORD InjMassInj 1 100 -327.6800 327.6700 ARRAY_SIZE 2 ECU_ADDRESS 0xC000C084 /end MEASUREMENT
/begin MEASUREMENT InjCrv_qPiI2ETSCor_mp "motortemperaturabhängige Korrekturmenge für Voreinspritzung 2" SWORD InjMass 1 100 -327.6800 327.6700 ECU_ADDRESS 0xC000A170 /end MEASUREMENT
/begin MEASUREMENT InjCrv_qPiI2ETSQCorStrt_mp "Motor Temperaturabhängiger PII2 menge korrektur während des Motor start state" SWORD InjMassInj 1 100 -327.6800 327.6700 ECU_ADDRESS 0xC000A166 /end MEASUREMENT
/begin MEASUREMENT InjCrv_qPiI2MaxRgn_mp "Maximalwert der Korrekturmenge für die Voreinspritzmenge 2 im Regenerationsbetrieb" SWORD InjMass 1 100 -327.6800 327.6700 ECU_ADDRESS 0xC000A17E /end MEASUREMENT
/begin MEASUREMENT InjCrv_qPiI2Max_mp "maximale Einspritzmenge der PiI2" SWORD InjMass 1 100 -327.6800 327.6700 ECU_ADDRESS 0xC000A144 /end MEASUREMENT
/begin MEASUREMENT InjCrv_qPiI2Rgn "Regenerationswert für die Einspritzmenge der PiI2" SWORD InjMass 1 100 -327.6800 327.6700 ARRAY_SIZE 2 ECU_ADDRESS 0xD0000EBA /end MEASUREMENT
/begin MEASUREMENT InjCrv_qPiI2RgnAdd_mp "Additiver Bypasseingriff für Menge der Voreinspritzung 2 im Regenerationsbetrieb" SWORD InjMass 1 100 -327.6800 327.6700 ARRAY_SIZE 2 ECU_ADDRESS 0xC000C098 /end MEASUREMENT
/begin MEASUREMENT InjCrv_qPiI2SetLimMax_mp "begrenzte maximale Solleinspritzmenge PiI2" SWORD InjMass 1 100 -327.6800 327.6700 ECU_ADDRESS 0xC000A146 /end MEASUREMENT
/begin MEASUREMENT InjCrv_qPiI2SetLim_mp "begrenzte Solleinspritzmenge PiI2" SWORD InjMass 1 100 -327.6800 327.6700 ECU_ADDRESS 0xC000A148 /end MEASUREMENT
/begin MEASUREMENT InjCrv_qPiI2Set_mp "Sollwert der Einspritzmenge PiI2" SWORD InjMass 1 100 -327.6800 327.6700 ECU_ADDRESS 0xC000A14A /end MEASUREMENT
/begin MEASUREMENT InjCrv_qPoI1AddCor "kundenspezifische Korrekturmenge für PoI1" SWORD InjMass 1 100 -327.6800 327.6700 ECU_ADDRESS 0xD0000ECA /end MEASUREMENT
/begin MEASUREMENT InjCrv_qPoI1Bas_mp "Grundwert der Einspritzmenge PoI1" SWORD InjMass 1 100 -327.6800 327.6700 ECU_ADDRESS 0xC000A1A6 /end MEASUREMENT
/begin MEASUREMENT InjCrv_qPoI1Clsn "zylinderselektiver Mengenanteil PoI1 bei Kollision" SWORD InjMass 1 100 -327.6800 327.6700 ECU_ADDRESS 0xD0000ECC /end MEASUREMENT
/begin MEASUREMENT InjCrv_qPoI1Cor_mp "korrigierter Grundwert der Einspritzmenge PoI1" SWORD InjMass 1 100 -327.6800 327.6700 ECU_ADDRESS 0xC000A1A8 /end MEASUREMENT
/begin MEASUREMENT InjCrv_qPoI1Des "gewünschte Einspritzmenge PoI1" SWORD InjMass 1 100 -327.6800 327.6700 ARRAY_SIZE 6 ECU_ADDRESS 0xD0000ECE /end MEASUREMENT
/begin MEASUREMENT InjCrv_qPoI1DesAddByp_mp "Wert der gewünschten Menge für die Nacheinspritzung 1 vor einem additiven Bypasseingriff" SWORD InjMass 1 100 -327.6800 327.6700 ECU_ADDRESS 0xC000A1AA /end MEASUREMENT
/begin MEASUREMENT InjCrv_qPoI1DesAdd_mp "Additiver Bypasseingriff für gewünschte Menge der Nacheinspritzung 1" SWORD InjMass 1 100 -327.6800 327.6700 ARRAY_SIZE 6 ECU_ADDRESS 0xC000C0A4 /end MEASUREMENT
/begin MEASUREMENT InjCrv_qPoI1DesByp_mp "Bypass-Label, Kopie von InjCrv_qPoI1Des" SWORD InjMass 1 100 -327.6800 327.6700 ECU_ADDRESS 0xC000A1AC /end MEASUREMENT
/begin MEASUREMENT InjCrv_qPoI1Des_mp "Sollmenge Nacheinspritzung 1" SWORD InjMass 1 100 -327.6800 327.6700 ECU_ADDRESS 0xC000A1AE /end MEASUREMENT
/begin MEASUREMENT InjCrv_qPoI1Eff "" SWORD InjMass 1 100 -327.6800 327.6700 ARRAY_SIZE 6 ECU_ADDRESS 0xD0000EDA /end MEASUREMENT
/begin MEASUREMENT InjCrv_qPoI1Lim_mp "begrenzte Einspritzmenge PoI1" SWORD InjMass 1 100 -327.6800 327.6700 ECU_ADDRESS 0xC000A1B0 /end MEASUREMENT
/begin MEASUREMENT InjCrv_qPoI1Max_mp "Maximalwert der Einspritzmenge PoI1" SWORD InjMass 1 100 -327.6800 327.6700 ECU_ADDRESS 0xC000A1B2 /end MEASUREMENT
/begin MEASUREMENT InjCrv_qPoI1Min_mp "Minimalwert der Einspritzmenge PoI1" SWORD InjMass 1 100 -327.6800 327.6700 ECU_ADDRESS 0xC000A1B4 /end MEASUREMENT
/begin MEASUREMENT InjCrv_qPoI1RgnAPSCorBas_mp "" SWORD InjMass 1 100 -327.6800 327.6700 ECU_ADDRESS 0xC000A1CA /end MEASUREMENT
/begin MEASUREMENT InjCrv_qPoI1RgnAPSCor_mp "" SWORD InjMass 1 100 -327.6800 327.6700 ECU_ADDRESS 0xC000A1CC /end MEASUREMENT
/begin MEASUREMENT InjCrv_qPoI1Set_mp "Sollwert der Einspritzmenge PoI1" SWORD InjMass 1 100 -327.6800 327.6700 ECU_ADDRESS 0xC000A1B6 /end MEASUREMENT
/begin MEASUREMENT InjCrv_qPoI2Des1_mp "" SWORD InjMass 1 100 -327.6800 327.6700 ECU_ADDRESS 0xC000A1B8 /end MEASUREMENT
/begin MEASUREMENT InjCrv_stPiI2_mp "Freigabestatus PiI2" UBYTE OneToOne 1 100 0.00 255.0 ECU_ADDRESS 0xC000B24A /end MEASUREMENT
/begin MEASUREMENT InjCrv_stPoI1_mp "Freigabestatus PoI1" UBYTE OneToOne 1 100 0.00 255.0 ECU_ADDRESS 0xC000B24C /end MEASUREMENT
/begin MEASUREMENT InjCrv_tAirPiI "Ansauglufttemperatur für das Subsystem InjCrv" SWORD Temp_Cels 1 100 -3549.940 3003.560 ECU_ADDRESS 0xD0000F28 /end MEASUREMENT
/begin MEASUREMENT InjCrv_tiPiI1AddCor1 "zusätzliche Korrekturzeit -1 für PiI1 (n sync)" SWORD InjTime_us 1 100 -13107.20 5000.00 ECU_ADDRESS 0xD0000F2E /end MEASUREMENT
/begin MEASUREMENT InjCrv_tiPiI1AddCor2 "zusätzliche Korrekturzeit -2 für PiI1 (n sync)" SWORD InjTime_us 1 100 -13107.20 5000.00 ECU_ADDRESS 0xD0000F30 /end MEASUREMENT
/begin MEASUREMENT InjCrv_tiPiI1AddCorRgn1 "kundenspezifische Korrekturzeit für PiI1 im Regenerationsbetrieb für nicht freigegebene PiI2" SWORD InjTime_us 1 100 -13107.20 5000.00 ECU_ADDRESS 0xD0000F32 /end MEASUREMENT
/begin MEASUREMENT InjCrv_tiPiI1AddCorRgn2 "kundenspezifische Korrekturzeit für PiI1 im Regenerationsbetrieb für freigegebene PiI2" SWORD InjTime_us 1 100 -13107.20 5000.00 ECU_ADDRESS 0xD0000F34 /end MEASUREMENT
/begin MEASUREMENT InjCrv_tiPiI1AddCorStrt "PII1 SOE Zeit korrektur während des Motor start state" SWORD InjTime_us 1 100 -13107.20 5000.00 ECU_ADDRESS 0xD0000F36 /end MEASUREMENT
/begin MEASUREMENT InjCrv_tiPiI1APSCor1_mp "Luftdruckabhängiger Korrekturgrundwert für die Zeitkomponente des Ansteuerbeginns der PiI1 bei inaktiver PiI2" SWORD InjTime_us 1 100 -13107.20 5000.00 ECU_ADDRESS 0xC000A120 /end MEASUREMENT
/begin MEASUREMENT InjCrv_tiPiI1APSCor2_mp "Luftdruckabhängiger Korrekturgrundwert für die Zeitkomponente des Ansteuerbeginns der PiI1 bei aktiver PiI2" SWORD InjTime_us 1 100 -13107.20 5000.00 ECU_ADDRESS 0xC000A122 /end MEASUREMENT
/begin MEASUREMENT InjCrv_tiPiI1APSCorRgn1_mp "Luftdruckabhängiger Basisansteuerbeginnkorrekturwert 1 der PiI1 im Regenerationsbetrieb" SWORD InjTime_us 1 100 -13107.20 5000.00 ARRAY_SIZE 2 ECU_ADDRESS 0xC000C054 /end MEASUREMENT
/begin MEASUREMENT InjCrv_tiPiI1APSCorRgn2_mp "Luftdruckabhängiger Basisansteuerbeginnkorrekturwert 2 der PiI1 im Regenerationsbetrieb" SWORD InjTime_us 1 100 -13107.20 5000.00 ARRAY_SIZE 2 ECU_ADDRESS 0xC000C058 /end MEASUREMENT
/begin MEASUREMENT InjCrv_tiPiI1ATSCor1_mp "Ansauglufttemperaturabhängiger Korrekturgrundwert für die Zeitkomponente des Ansteuerbeginns der PiI1 bei inaktiver PiI2" SWORD InjTime_us 1 100 -13107.20 5000.00 ECU_ADDRESS 0xC000A124 /end MEASUREMENT
/begin MEASUREMENT InjCrv_tiPiI1ATSCor2_mp "Ansauglufttemperaturabhängiger Korrekturgrundwert für die Zeitkomponente des Ansteuerbeginns der PiI1 bei aktiver PiI2" SWORD InjTime_us 1 100 -13107.20 5000.00 ECU_ADDRESS 0xC000A126 /end MEASUREMENT
/begin MEASUREMENT InjCrv_tiPiI1ATSCorRgn1_mp "Lufttemperaturabhängiger Basisansteuerbeginnkorrekturwert 1 der PiI1 im Regenerationsbetrieb" SWORD InjTime_us 1 100 -13107.20 5000.00 ARRAY_SIZE 2 ECU_ADDRESS 0xC000C05C /end MEASUREMENT
/begin MEASUREMENT InjCrv_tiPiI1ATSCorRgn2_mp "Lufttemperaturabhängiger Basisansteuerbeginnkorrekturwert 2 der PiI1 im Regenerationsbetrieb" SWORD InjTime_us 1 100 -13107.20 5000.00 ARRAY_SIZE 2 ECU_ADDRESS 0xC000C060 /end MEASUREMENT
/begin MEASUREMENT InjCrv_tiPiI1ATSCorRgn_mp "" SWORD InjTime_us 1 100 -13107.20 5000.00 ECU_ADDRESS 0xC000A0F0 /end MEASUREMENT
/begin MEASUREMENT InjCrv_tiPiI1BasRgn_mp "Basiswert Ansteuerbeginn der Voreinspritzung 1 im Regenerationsbetrieb" SWORD InjTime_us 1 100 -13107.20 5000.00 ARRAY_SIZE 2 ECU_ADDRESS 0xC000C074 /end MEASUREMENT
/begin MEASUREMENT InjCrv_tiPiI1BasStrt_mp "korrigierter Grundwert Zeitkomponente im Startzustand" SWORD InjTime_us 1 100 -13107.20 5000.00 ECU_ADDRESS 0xC000A134 /end MEASUREMENT
/begin MEASUREMENT InjCrv_tiPiI1DynCorBas_mp "Niedriger Wert PII1 SOE der Zeitkorrektur" SWORD InjTime_us 1 100 -13107.20 5000.00 ECU_ADDRESS 0xC000A0DC /end MEASUREMENT
/begin MEASUREMENT InjCrv_tiPiI1DynCorRgn_mp "Korrekturgrundwert für dynamische Ansteuerbeginnkorrektur waehrend Regeneration" SWORD InjTime_us 1 100 -13107.20 5000.00 ECU_ADDRESS 0xC000A0F2 /end MEASUREMENT
/begin MEASUREMENT InjCrv_tiPiI1DynCor_mp "time correction base value for ET, AP and DQ specific correction" SWORD InjTime_us 1 100 -13107.20 5000.00 ECU_ADDRESS 0xC000A0DE /end MEASUREMENT
/begin MEASUREMENT InjCrv_tiPiI1EnvCor1 "Korrekturzeit für PiI1 wenn PiI2 inaktiv" SWORD InjTime_us 1 100 -13107.20 5000.00 ECU_ADDRESS 0xD0000F46 /end MEASUREMENT
/begin MEASUREMENT InjCrv_tiPiI1EnvCor2 "Korrekturzeit für PiI1 wenn PiI2 aktiv" SWORD InjTime_us 1 100 -13107.20 5000.00 ECU_ADDRESS 0xD0000F48 /end MEASUREMENT
/begin MEASUREMENT InjCrv_tiPiI1EnvCorRgn1 "Korrekturansteuerbeginn 1 im Regeneration Betrieb von PiI1" SWORD InjTime_us 1 100 -13107.20 5000.00 ARRAY_SIZE 2 ECU_ADDRESS 0xD0000F4A /end MEASUREMENT
/begin MEASUREMENT InjCrv_tiPiI1EnvCorRgn2 "Korrekturansteuerbeginn 2 im Regeneration Betrieb von PiI1" SWORD InjTime_us 1 100 -13107.20 5000.00 ARRAY_SIZE 2 ECU_ADDRESS 0xD0000F4E /end MEASUREMENT
/begin MEASUREMENT InjCrv_tiPiI1ETSCor11_mp "motortemperaturabhängiger Korrekturgrundwert -1 für die Zeitkomponente Ansteuerbeginn PiI1" SWORD InjTime_us 1 100 -13107.20 5000.00 ECU_ADDRESS 0xC000A0E0 /end MEASUREMENT
/begin MEASUREMENT InjCrv_tiPiI1ETSCor12_mp "motortemperaturabhängiger Korrekturgrundwert für die Zeitkomponente des Ansteuerbeginns der PiI1 bei inaktiver PiI2" SWORD InjTime_us 1 100 -13107.20 5000.00 ECU_ADDRESS 0xC000A0E2 /end MEASUREMENT
/begin MEASUREMENT InjCrv_tiPiI1ETSCor1_mp "motortemperaturabhängiger Korrekturgrundwert für die Zeitkomponente des Ansteuerbeginns der PiI1 bei inaktiver PiI2" SWORD InjTime_us 1 100 -13107.20 5000.00 ECU_ADDRESS 0xC000A128 /end MEASUREMENT
/begin MEASUREMENT InjCrv_tiPiI1ETSCor2_mp "motortemperaturabhängiger Korrekturgrundwert für die Zeitkomponente des Ansteuerbeginns der PiI1 bei aktiver PiI2" SWORD InjTime_us 1 100 -13107.20 5000.00 ECU_ADDRESS 0xC000A12A /end MEASUREMENT
/begin MEASUREMENT InjCrv_tiPiI1ETSCorRgn1_mp "Motortemperaturabhängiger Basisansteuerbeginnkorrekturwert 1 der PiI1 im Regenerationsbetrieb" SWORD InjTime_us 1 100 -13107.20 5000.00 ARRAY_SIZE 2 ECU_ADDRESS 0xC000C064 /end MEASUREMENT
/begin MEASUREMENT InjCrv_tiPiI1ETSCorRgn2_mp "Motortemperaturabhängiger Basisansteuerbeginnkorrekturwert 2 der PiI1 im Regenerationsbetrieb" SWORD InjTime_us 1 100 -13107.20 5000.00 ARRAY_SIZE 2 ECU_ADDRESS 0xC000C068 /end MEASUREMENT
/begin MEASUREMENT InjCrv_tiPiI1ETSCorStrt_mp "motortemperaturabhängiger Korrekturgrundwert für die Zeitkomponente des Ansteuerbeginns der PiI1 bei inaktiver PiI2 im Startzust" SWORD InjTime_us 1 100 -13107.20 5000.00 ECU_ADDRESS 0xC000A0E4 /end MEASUREMENT
/begin MEASUREMENT InjCrv_tiPiI1Rgn "Regenerationswert für die Zeitkomponente des Ansteuerbeginns der PiI1" SWORD InjTime_us 1 100 -13107.20 5000.00 ARRAY_SIZE 2 ECU_ADDRESS 0xD0000F52 /end MEASUREMENT
/begin MEASUREMENT InjCrv_tiPiI1RgnAdd_mp "Additiver Bypasseingriff für Zeit der Voreinspritzung 1 im Regenerationsbetrieb" SWORD InjTime_us 1 100 -13107.20 5000.00 ARRAY_SIZE 2 ECU_ADDRESS 0xC000C078 /end MEASUREMENT
/begin MEASUREMENT InjCrv_tiPiI1VehCor2_mp "" SWORD InjTime_us 1 100 -13107.20 5000.00 ECU_ADDRESS 0xC000A0E6 /end MEASUREMENT
/begin MEASUREMENT InjCrv_tiPiI1VehCor_mp "" SWORD InjTime_us 1 100 -13107.20 5000.00 ECU_ADDRESS 0xC000A0E8 /end MEASUREMENT
/begin MEASUREMENT InjCrv_tiPiI2AddCor "kundenspezifische Korrekturzeit für PiI2" SWORD InjTime_us 1 100 -13107.20 5000.00 ECU_ADDRESS 0xD0000F56 /end MEASUREMENT
/begin MEASUREMENT InjCrv_tiPiI2AddCorRgn "kundenspezifische Korrekturzeit für PiI2 im Regenerationsbetrieb" SWORD InjTime_us 1 100 -13107.20 5000.00 ECU_ADDRESS 0xD0000F58 /end MEASUREMENT
/begin MEASUREMENT InjCrv_tiPiI2AddCorStrt "PII2 SOE Zeit korrektur während des Motor start state" SWORD InjTime_us 1 100 -13107.20 5000.00 ECU_ADDRESS 0xD0000F5A /end MEASUREMENT
/begin MEASUREMENT InjCrv_tiPiI2APSCorRgn_mp "Luftdruckabhängiger Basisansteuerungskorrekturwert der PiI2 im Regenerationsbetrieb" SWORD InjTime_us 1 100 -13107.20 5000.00 ARRAY_SIZE 2 ECU_ADDRESS 0xC000C088 /end MEASUREMENT
/begin MEASUREMENT InjCrv_tiPiI2APSCorStrt_mp "measuring point fr Korrekturkennfeld für das Timing der 2. Voreinspritzung abhängig vom Luftdruck während des Startvorganges" SWORD InjTime_us 1 100 -13107.20 5000.00 ECU_ADDRESS 0xC000A168 /end MEASUREMENT
/begin MEASUREMENT InjCrv_tiPiI2APSCor_mp "Luftdruckabhängiger Korrekturgrundwert für die Zeitkomponente des Ansteuerbeginns der PiI2" SWORD InjTime_us 1 100 -13107.20 5000.00 ECU_ADDRESS 0xC000A178 /end MEASUREMENT
/begin MEASUREMENT InjCrv_tiPiI2ATSCorRgn_mp "Ansauglufttemperaturabhängiger Basisansteuerungskorrekturwert der PiI2 im Regenerationsbetrieb" SWORD InjTime_us 1 100 -13107.20 5000.00 ARRAY_SIZE 2 ECU_ADDRESS 0xC000C08C /end MEASUREMENT
/begin MEASUREMENT InjCrv_tiPiI2ATSCor_mp "ansauglufttemperaturabhängiger Korrekturgrundwert für die Zeitkomponente des Ansteuerbeginns der PiI2" SWORD InjTime_us 1 100 -13107.20 5000.00 ECU_ADDRESS 0xC000A17A /end MEASUREMENT
/begin MEASUREMENT InjCrv_tiPiI2BasRgn_mp "Basiswert Ansteuerbeginn der Voreinspritzung 2 im Regenerationsbetrieb" SWORD InjTime_us 1 100 -13107.20 5000.00 ARRAY_SIZE 2 ECU_ADDRESS 0xC000C09C /end MEASUREMENT
/begin MEASUREMENT InjCrv_tiPiI2BasStrt_mp "korrigierter Grundwert Zeitkomponente im Startzustand" SWORD InjTime_us 1 100 -13107.20 5000.00 ECU_ADDRESS 0xC000A18C /end MEASUREMENT
/begin MEASUREMENT InjCrv_tiPiI2Bas_mp "Zeitkomponente Ansteuerbeginn PiI2 Grundwert" SWORD InjTime_us 1 100 -13107.20 5000.00 ECU_ADDRESS 0xC000A186 /end MEASUREMENT
/begin MEASUREMENT InjCrv_tiPiI2Cor_mp "korrigierter Grundwert der Zeitkomponente Ansteuerbeginn PiI2" SWORD InjTime_us 1 100 -13107.20 5000.00 ECU_ADDRESS 0xC000A14C /end MEASUREMENT
/begin MEASUREMENT InjCrv_tiPiI2EnvCor "Korrekturzeit für PiI2" SWORD InjTime_us 1 100 -13107.20 5000.00 ECU_ADDRESS 0xD0000F6A /end MEASUREMENT
/begin MEASUREMENT InjCrv_tiPiI2EnvCorRgn "Ansteuerungskorrekturwert in Regenerationsbetrieb der PiI2" SWORD InjTime_us 1 100 -13107.20 5000.00 ARRAY_SIZE 2 ECU_ADDRESS 0xD0000F6C /end MEASUREMENT
/begin MEASUREMENT InjCrv_tiPiI2ETSCorRgn_mp "Motortemperaturabhängiger Basisansteuerungskorrekturwert der PiI2 im Regenerationsbetrieb" SWORD InjTime_us 1 100 -13107.20 5000.00 ARRAY_SIZE 2 ECU_ADDRESS 0xC000C090 /end MEASUREMENT
/begin MEASUREMENT InjCrv_tiPiI2ETSCorStrt_mp "Motor Temperaturabhängiger PII2 SOE Zeit korrektur während des Motor start state" SWORD InjTime_us 1 100 -13107.20 5000.00 ECU_ADDRESS 0xC000A16A /end MEASUREMENT
/begin MEASUREMENT InjCrv_tiPiI2ETSCor_mp "motortemperaturabhängiger Korrekturgrundwert für die Zeitkomponente des Ansteuerbeginns der PiI2" SWORD InjTime_us 1 100 -13107.20 5000.00 ECU_ADDRESS 0xC000A17C /end MEASUREMENT
/begin MEASUREMENT InjCrv_tiPiI2ET_mp "geschätzte Ansteuerdauer PiI2" SWORD InjTime_us 1 100 -13107.20 5000.00 ECU_ADDRESS 0xC000A14E /end MEASUREMENT
/begin MEASUREMENT InjCrv_tiPiI2Min_mp "Zeitkomponente PiI2 Minimalwertekennfeld" SWORD InjTime_us 1 100 -13107.20 5000.00 ECU_ADDRESS 0xC000A150 /end MEASUREMENT
/begin MEASUREMENT InjCrv_tiPiI2RelMI_mp "Zeitkomponente Ansteuerbeginn PiI2 relativ zur MI" SWORD InjTime_us 1 100 -13107.20 5000.00 ECU_ADDRESS 0xC000A152 /end MEASUREMENT
/begin MEASUREMENT InjCrv_tiPiI2RelPiI1_mp "Zeitkomponente Ansteuerbeginn PiI2 relativ zur PiI1" SWORD InjTime_us 1 100 -13107.20 5000.00 ECU_ADDRESS 0xC000A154 /end MEASUREMENT
/begin MEASUREMENT InjCrv_tiPiI2RelTot_mp "Ansteuerbeginnabstand PiI2 aus Winkel- und Zeitkomponente" SWORD InjTime_us 1 100 -13107.20 5000.00 ECU_ADDRESS 0xC000A156 /end MEASUREMENT
/begin MEASUREMENT InjCrv_tiPiI2Rgn "Regenerationswert für die Zeitkomponente des Ansteuerbeginns der PiI2" SWORD InjTime_us 1 100 -13107.20 5000.00 ARRAY_SIZE 2 ECU_ADDRESS 0xD0000F70 /end MEASUREMENT
/begin MEASUREMENT InjCrv_tiPiI2RgnAdd_mp "Additiver Bypasseingriff für Zeit der Voreinspritzung 2 im Regenerationsbetrieb" SWORD InjTime_us 1 100 -13107.20 5000.00 ARRAY_SIZE 2 ECU_ADDRESS 0xC000C0A0 /end MEASUREMENT
/begin MEASUREMENT InjCrv_tiPiI2Tot_mp "gesamte Ansteuerdauer der Pil2" SWORD InjTime_us 1 100 -13107.20 5000.00 ECU_ADDRESS 0xC000A158 /end MEASUREMENT
/begin MEASUREMENT InjCrv_tiPoI1AddCor "Kundenvspecifiz korrektur für Nacheinspritzung" SWORD InjTime_us 1 100 -13107.20 5000.00 ECU_ADDRESS 0xD0000F74 /end MEASUREMENT
/begin MEASUREMENT InjCrv_tiPoI1Bas_mp "" SWORD InjTime_us 1 100 -13107.20 5000.00 ECU_ADDRESS 0xC000A1BA /end MEASUREMENT
/begin MEASUREMENT InjCrv_tiPoI1Des "" SWORD InjTime_us 1 100 -13107.20 5000.00 ECU_ADDRESS 0xD0000F76 /end MEASUREMENT
/begin MEASUREMENT InjCrv_tiPoI1ET_mp "geschätzte Ansteuerdauer PoI1" SWORD InjTime_us 1 100 -13107.20 5000.00 ECU_ADDRESS 0xC000A1BC /end MEASUREMENT
/begin MEASUREMENT InjCrv_tiPoI1Lim_mp "" SWORD InjTime_us 1 100 -13107.20 5000.00 ECU_ADDRESS 0xC000A1BE /end MEASUREMENT
/begin MEASUREMENT InjCrv_tiPoI1Max_mp "" SWORD InjTime_us 1 100 -13107.20 5000.00 ECU_ADDRESS 0xC000A1C0 /end MEASUREMENT
/begin MEASUREMENT InjCrv_tiPoI1Set_mp "" SWORD InjTime_us 1 100 -13107.20 5000.00 ECU_ADDRESS 0xC000A1C2 /end MEASUREMENT
/begin MEASUREMENT InjCrv_tiPoI1ZFCET_mp "" SWORD InjTime_us 1 100 -13107.20 5000.00 ECU_ADDRESS 0xC000A1C4 /end MEASUREMENT
/begin MEASUREMENT InjCrv_volPiI2Cor_mp "korrigiertes Einspritzvolumen zur Ansteuerdauerabschätzung der PiI2" SWORD InjQntInj 1 100 -327.6800 327.6700 ECU_ADDRESS 0xC000A15A /end MEASUREMENT
/begin MEASUREMENT InjCrv_volPiI2_mp "begrenztes Einspritzvolumen PiI2" SWORD InjQntInj 1 100 -327.6800 327.6700 ECU_ADDRESS 0xC000A15C /end MEASUREMENT
/begin MEASUREMENT InjCrv_volPoI1_mp "begrenztes Einspritzvolumen PoI1" SWORD InjQntInj 1 100 -327.6800 327.6700 ECU_ADDRESS 0xC000A1C6 /end MEASUREMENT
/begin FUNCTION InjCrv_PiI1AddCor ""
 /begin DEF_CHARACTERISTIC InjCrv_facAPPrPiI1DynCor_CUR InjCrv_facAPPrPiI1DynQCor_CUR InjCrv_facDQPiI1DynCor_CUR InjCrv_facDQPiI1DynQCor_CUR InjCrv_facPiI1VehCor2_CUR InjCrv_facPiI1VehCor_CUR InjCrv_facPiI1VehTempCor2_CUR InjCrv_facPiI1VehTempCor_CUR InjCrv_qPiI1APSCorStrt_MAP InjCrv_qPiI1ATSCorStrt_MAP InjCrv_qPiI1DynQCor_MAP InjCrv_qPiI1ETSCor11_MAP InjCrv_qPiI1ETSCor12_MAP InjCrv_qPiI1ETSCorStrt_MAP InjCrv_tiPiI1DynCor_MAP InjCrv_tiPiI1ETSCor11_MAP InjCrv_tiPiI1ETSCor12_MAP InjCrv_tiPiI1ETSCorStrt_MAP InjCrv_tiPiI1VehCor2_MAP InjCrv_tiPiI1VehCor_MAP /end DEF_CHARACTERISTIC
 /begin IN_MEASUREMENT APP_r CEngDsT_t CoEng_st Epm_nEng InjCrv_dqSetUnBalFltLim InjCrv_facPiI1APSQCorStrt InjCrv_facPiI1ATSQCorStrt InjCrv_facPiI1DynQCor InjCrv_facPiI1DynSOECor InjCrv_facPiI1ETSQCor11 InjCrv_facPiI1ETSQCor12 InjCrv_facPiI1ETSQCorStrt InjCrv_facPiI1ETSSOECor11 InjCrv_facPiI1ETSSOECor12 InjCrv_facPiI1ETSSOECorStrt InjCrv_swtPiIDblCorMap InjCtl_qSetUnBal VehV_v /end IN_MEASUREMENT
 /begin OUT_MEASUREMENT InjCrv_phiPiI1AddCor1 InjCrv_phiPiI1AddCor2 InjCrv_qPiI1AddCor1 InjCrv_qPiI1AddCor2 InjCrv_qPiI1AddCorStrt InjCrv_tiPiI1AddCor1 InjCrv_tiPiI1AddCor2 InjCrv_tiPiI1AddCorStrt /end OUT_MEASUREMENT
 /begin LOC_MEASUREMENT InjCrv_facAPPrPiI1DynCor_mp InjCrv_facAPPrPiI1DynQCor_mp InjCrv_facDQPiI1DynCor_mp InjCrv_facDQPiI1DynQCor_mp InjCrv_qPiI1APSCorStrt_mp InjCrv_qPiI1ATSCorStrt_mp InjCrv_qPiI1DynCorBas_mp InjCrv_qPiI1DynCor_mp InjCrv_qPiI1ETSCor11_mp InjCrv_qPiI1ETSCor12_mp InjCrv_qPiI1ETSCorStrt_mp InjCrv_tiPiI1DynCorBas_mp InjCrv_tiPiI1DynCor_mp InjCrv_tiPiI1ETSCor11_mp InjCrv_tiPiI1ETSCor12_mp InjCrv_tiPiI1ETSCorStrt_mp InjCrv_tiPiI1VehCor2_mp InjCrv_tiPiI1VehCor_mp /end LOC_MEASUREMENT
/end FUNCTION
/begin FUNCTION InjCrv_PiI1AddCorRgn ""
 /begin DEF_CHARACTERISTIC InjCrv_facDQPiI1DynCorRgn_CUR InjCrv_facDQPiI1DynQCorRgn_CUR InjCrv_qPiI1DynQCorRgn_MAP InjCrv_tiPiI1ATSCorRgn_MAP InjCrv_tiPiI1DynCorRgn_MAP /end DEF_CHARACTERISTIC
 /begin IN_MEASUREMENT Epm_nEng InjCrv_dqSetUnBalFltLim InjCrv_facPiI1ATSSOECorRgn InjCrv_facPiI1DynSOECorRgn InjCtl_qSetUnBal /end IN_MEASUREMENT
 /begin OUT_MEASUREMENT InjCrv_qPiI1AddCorRgn1 InjCrv_qPiI1AddCorRgn2 InjCrv_tiPiI1AddCorRgn1 InjCrv_tiPiI1AddCorRgn2 /end OUT_MEASUREMENT
 /begin LOC_MEASUREMENT InjCrv_facDQPiI1DynCorRgn_mp InjCrv_facDQPiI1DynQCorRgn_mp InjCrv_qPiI1DynCorRgn_mp InjCrv_tiPiI1ATSCorRgn_mp InjCrv_tiPiI1DynCorRgn_mp /end LOC_MEASUREMENT
/end FUNCTION
/begin FUNCTION InjCrv_PiI1AddCorSlow ""
 /begin DEF_CHARACTERISTIC InjCrv_facAPPiI1DynCor_CUR InjCrv_facAPPiI1DynQCor_CUR InjCrv_facETPiI1DynCor_CUR InjCrv_facETPiI1DynQCor_CUR InjCrv_facIAPiI1DynCor_CUR InjCrv_facPiI1APSQCorStrt_CUR InjCrv_facPiI1ATSQCorStrt_CUR InjCrv_facPiI1ETSQCor11_CUR InjCrv_facPiI1ETSQCor12_CUR InjCrv_facPiI1ETSQCorStrt_CUR InjCrv_facPiI1ETSSOECor11_CUR InjCrv_facPiI1ETSSOECor12_CUR InjCrv_facPiI1ETSSOECorStrt_CUR /end DEF_CHARACTERISTIC
 /begin IN_MEASUREMENT CoEng_st EnvP_p InjCrv_swtPiIDblCorMap InjCrv_tAirPiI InjSys_tEng /end IN_MEASUREMENT
 /begin OUT_MEASUREMENT InjCrv_facPiI1APSQCorStrt InjCrv_facPiI1ATSQCorStrt InjCrv_facPiI1DynQCor InjCrv_facPiI1DynSOECor InjCrv_facPiI1ETSQCor11 InjCrv_facPiI1ETSQCor12 InjCrv_facPiI1ETSQCorStrt InjCrv_facPiI1ETSSOECor11 InjCrv_facPiI1ETSSOECor12 InjCrv_facPiI1ETSSOECorStrt /end OUT_MEASUREMENT
 /begin LOC_MEASUREMENT InjCrv_facAPPiI1DynCor_mp InjCrv_facAPPiI1DynQCor_mp InjCrv_facETPiI1DynCor_mp InjCrv_facETPiI1DynQCor_mp InjCrv_facIAPiI1DynCor_mp /end LOC_MEASUREMENT
/end FUNCTION
/begin FUNCTION InjCrv_PiI1AddCorSlowRgn ""
 /begin DEF_CHARACTERISTIC InjCrv_facAPPiI1DynCorRgn_CUR InjCrv_facAPPiI1DynQCorRgn_CUR InjCrv_facETPiI1DynCorRgn_CUR InjCrv_facETPiI1DynQCorRgn_CUR InjCrv_facIAPiI1DynCorRgn_CUR InjCrv_facPiI1ATSSOECorRgn_CUR /end DEF_CHARACTERISTIC
 /begin IN_MEASUREMENT EnvP_p InjCrv_tAirPiI InjSys_tEng /end IN_MEASUREMENT
 /begin OUT_MEASUREMENT InjCrv_facPiI1ATSSOECorRgn InjCrv_facPiI1DynQCorRgn InjCrv_facPiI1DynSOECorRgn /end OUT_MEASUREMENT
 /begin LOC_MEASUREMENT InjCrv_facAPPiI1DynCorRgn_mp InjCrv_facAPPiI1DynQCorRgn_mp InjCrv_facETPiI1DynCorRgn_mp InjCrv_facETPiI1DynQCorRgn_mp InjCrv_facIAPiI1DynCorRgn_mp /end LOC_MEASUREMENT
/end FUNCTION
/begin FUNCTION InjCrv_PiI1EnvCor ""
 /begin DEF_CHARACTERISTIC InjCrv_qPiI1APSCor1_MAP InjCrv_qPiI1APSCor2_MAP InjCrv_qPiI1APSCor_X_AXIS InjCrv_qPiI1APSCor_Y_AXIS InjCrv_qPiI1ATSCor1_MAP InjCrv_qPiI1ATSCor2_MAP InjCrv_qPiI1ATSCor_X_AXIS InjCrv_qPiI1ATSCor_Y_AXIS InjCrv_qPiI1ETSCor1_MAP InjCrv_qPiI1ETSCor2_MAP InjCrv_qPiI1ETSCor_X_AXIS InjCrv_qPiI1ETSCor_Y_AXIS /end DEF_CHARACTERISTIC
 /begin IN_MEASUREMENT Epm_nEng InjCrv_facPiI1APSQCor1 InjCrv_facPiI1APSQCor2 InjCrv_facPiI1APSSOECor1 InjCrv_facPiI1APSSOECor2 InjCrv_facPiI1ATSQCor1 InjCrv_facPiI1ATSQCor2 InjCrv_facPiI1ATSSOECor1 InjCrv_facPiI1ATSSOECor2 InjCrv_facPiI1ETSQCor1 InjCrv_facPiI1ETSQCor2 InjCrv_facPiI1ETSSOECor1 InjCrv_facPiI1ETSSOECor2 InjCrv_stPiI1RgnTSync InjCrv_stPiI2RgnTSync InjCrv_swtPiIDblCorMap InjCtl_qSetUnBal /end IN_MEASUREMENT
 /begin OUT_MEASUREMENT InjCrv_phiPiI1EnvCor1 InjCrv_phiPiI1EnvCor2 InjCrv_qPiI1EnvCor1 InjCrv_qPiI1EnvCor2 InjCrv_tiPiI1EnvCor1 InjCrv_tiPiI1EnvCor2 /end OUT_MEASUREMENT
 /begin LOC_MEASUREMENT InjCrv_qPiI1APSCor1_mp InjCrv_qPiI1APSCor2_mp InjCrv_qPiI1ATSCor1_mp InjCrv_qPiI1ATSCor2_mp InjCrv_qPiI1ETSCor1_mp InjCrv_qPiI1ETSCor2_mp /end LOC_MEASUREMENT
/end FUNCTION
/begin FUNCTION InjCrv_PiI1EnvCorPhi ""
 /begin LOC_MEASUREMENT InjCrv_phiPiI1APSCor1_mp InjCrv_phiPiI1APSCor2_mp InjCrv_phiPiI1ATSCor1_mp InjCrv_phiPiI1ATSCor2_mp InjCrv_phiPiI1ETSCor1_mp InjCrv_phiPiI1ETSCor2_mp /end LOC_MEASUREMENT
/end FUNCTION
/begin FUNCTION InjCrv_PiI1EnvCorRgn ""
 /begin DEF_CHARACTERISTIC InjCrv_qPiI1APSCor0Rgn1_GMAP InjCrv_qPiI1APSCor0Rgn2_GMAP InjCrv_qPiI1APSCor1Rgn1_GMAP InjCrv_qPiI1APSCor1Rgn2_GMAP InjCrv_qPiI1APSCorRgnX_AXIS InjCrv_qPiI1APSCorRgnY_AXIS InjCrv_qPiI1ATSCor0Rgn1_GMAP InjCrv_qPiI1ATSCor0Rgn2_GMAP InjCrv_qPiI1ATSCor1Rgn1_GMAP InjCrv_qPiI1ATSCor1Rgn2_GMAP InjCrv_qPiI1ATSCorRgnX_AXIS InjCrv_qPiI1ATSCorRgnY_AXIS InjCrv_qPiI1ETSCor0Rgn1_GMAP InjCrv_qPiI1ETSCor0Rgn2_GMAP InjCrv_qPiI1ETSCor1Rgn1_GMAP InjCrv_qPiI1ETSCor1Rgn2_GMAP InjCrv_qPiI1ETSCorRgnX_AXIS InjCrv_qPiI1ETSCorRgnY_AXIS InjCrv_tiPiI1APSCor0Rgn1_GMAP InjCrv_tiPiI1APSCor0Rgn2_GMAP InjCrv_tiPiI1APSCor1Rgn1_GMAP InjCrv_tiPiI1APSCor1Rgn2_GMAP InjCrv_tiPiI1APSCorRgnX_AXIS InjCrv_tiPiI1APSCorRgnY_AXIS InjCrv_tiPiI1ATSCor0Rgn1_GMAP InjCrv_tiPiI1ATSCor0Rgn2_GMAP InjCrv_tiPiI1ATSCor1Rgn1_GMAP InjCrv_tiPiI1ATSCor1Rgn2_GMAP InjCrv_tiPiI1ATSCorRgnX_AXIS InjCrv_tiPiI1ATSCorRgnY_AXIS InjCrv_tiPiI1ETSCor0Rgn1_GMAP InjCrv_tiPiI1ETSCor0Rgn2_GMAP InjCrv_tiPiI1ETSCor1Rgn1_GMAP InjCrv_tiPiI1ETSCor1Rgn2_GMAP InjCrv_tiPiI1ETSCorRgnX_AXIS InjCrv_tiPiI1ETSCorRgnY_AXIS /end DEF_CHARACTERISTIC
 /begin IN_MEASUREMENT Epm_nEng InjCrv_facPiI1APSQCorRgn1 InjCrv_facPiI1APSQCorRgn2 InjCrv_facPiI1APSSOECorRgn1 InjCrv_facPiI1APSSOECorRgn2 InjCrv_facPiI1ATSQCorRgn1 InjCrv_facPiI1ATSQCorRgn2 InjCrv_facPiI1ATSSOECorRgn1 InjCrv_facPiI1ATSSOECorRgn2 InjCrv_facPiI1ETSQCorRgn1 InjCrv_facPiI1ETSQCorRgn2 InjCrv_facPiI1ETSSOECorRgn1 InjCrv_facPiI1ETSSOECorRgn2 InjCrv_stPiI1RgnTSync InjCrv_swtPiIDblCorMap InjCtl_qSetUnBal /end IN_MEASUREMENT
 /begin OUT_MEASUREMENT InjCrv_qPiI1EnvCorRgn1 InjCrv_qPiI1EnvCorRgn2 InjCrv_tiPiI1EnvCorRgn1 InjCrv_tiPiI1EnvCorRgn2 /end OUT_MEASUREMENT
 /begin LOC_MEASUREMENT InjCrv_qPiI1APSCorRgn1_mp InjCrv_qPiI1APSCorRgn2_mp InjCrv_qPiI1ATSCorRgn1_mp InjCrv_qPiI1ATSCorRgn2_mp InjCrv_qPiI1ETSCorRgn1_mp InjCrv_qPiI1ETSCorRgn2_mp InjCrv_tiPiI1APSCorRgn1_mp InjCrv_tiPiI1APSCorRgn2_mp InjCrv_tiPiI1ATSCorRgn1_mp InjCrv_tiPiI1ATSCorRgn2_mp InjCrv_tiPiI1ETSCorRgn1_mp InjCrv_tiPiI1ETSCorRgn2_mp /end LOC_MEASUREMENT
/end FUNCTION
/begin FUNCTION InjCrv_PiI1EnvCorSlow ""
 /begin DEF_CHARACTERISTIC InjCrv_ctATSPiISel_C InjCrv_facPiI1APSQCor1_CUR InjCrv_facPiI1APSQCor2_CUR InjCrv_facPiI1APSQCor_AXIS InjCrv_facPiI1APSSOECor1_CUR InjCrv_facPiI1APSSOECor2_CUR InjCrv_facPiI1APSSOECor_AXIS InjCrv_facPiI1ATSQCor1_CUR InjCrv_facPiI1ATSQCor2_CUR InjCrv_facPiI1ATSQCor_AXIS InjCrv_facPiI1ATSSOECor1_CUR InjCrv_facPiI1ATSSOECor2_CUR InjCrv_facPiI1ATSSOECor_AXIS InjCrv_facPiI1ETSQCor1_CUR InjCrv_facPiI1ETSQCor2_CUR InjCrv_facPiI1ETSQCor_AXIS InjCrv_facPiI1ETSSOECor1_CUR InjCrv_facPiI1ETSSOECor2_CUR InjCrv_facPiI1ETSSOECor_AXIS /end DEF_CHARACTERISTIC
 /begin IN_MEASUREMENT AirSys_tFld EnvP_p InjCrv_swtPiIDblCorMap InjSys_tEng /end IN_MEASUREMENT
 /begin OUT_MEASUREMENT InjCrv_facPiI1APSQCor1 InjCrv_facPiI1APSQCor2 InjCrv_facPiI1APSSOECor1 InjCrv_facPiI1APSSOECor2 InjCrv_facPiI1ATSQCor1 InjCrv_facPiI1ATSQCor2 InjCrv_facPiI1ATSSOECor1 InjCrv_facPiI1ATSSOECor2 InjCrv_facPiI1ETSQCor1 InjCrv_facPiI1ETSQCor2 InjCrv_facPiI1ETSSOECor1 InjCrv_facPiI1ETSSOECor2 InjCrv_tAirPiI /end OUT_MEASUREMENT
/end FUNCTION
/begin FUNCTION InjCrv_PiI1EnvCorSlowRgn ""
 /begin DEF_CHARACTERISTIC InjCrv_facPiI1APSQCor0Rgn1_GCUR InjCrv_facPiI1APSQCor0Rgn2_GCUR InjCrv_facPiI1APSQCor1Rgn1_GCUR InjCrv_facPiI1APSQCor1Rgn2_GCUR InjCrv_facPiI1APSQCorRgn_AXIS InjCrv_facPiI1APSSOECor0Rgn1_CUR InjCrv_facPiI1APSSOECor0Rgn2_CUR InjCrv_facPiI1APSSOECor1Rgn1_CUR InjCrv_facPiI1APSSOECor1Rgn2_CUR InjCrv_facPiI1APSSOECorRgn_AXIS InjCrv_facPiI1ATSQCor0Rgn1_GCUR InjCrv_facPiI1ATSQCor0Rgn2_GCUR InjCrv_facPiI1ATSQCor1Rgn1_GCUR InjCrv_facPiI1ATSQCor1Rgn2_GCUR InjCrv_facPiI1ATSQCorRgn_AXIS InjCrv_facPiI1ATSSOECor0Rgn1_CUR InjCrv_facPiI1ATSSOECor0Rgn2_CUR InjCrv_facPiI1ATSSOECor1Rgn1_CUR InjCrv_facPiI1ATSSOECor1Rgn2_CUR InjCrv_facPiI1ATSSOECorRgn_AXIS InjCrv_facPiI1ETSQCor0Rgn1_GCUR InjCrv_facPiI1ETSQCor0Rgn2_GCUR InjCrv_facPiI1ETSQCor1Rgn1_GCUR InjCrv_facPiI1ETSQCor1Rgn2_GCUR InjCrv_facPiI1ETSQCorRgn_AXIS InjCrv_facPiI1ETSSOECor0Rgn1_CUR InjCrv_facPiI1ETSSOECor0Rgn2_CUR InjCrv_facPiI1ETSSOECor1Rgn1_CUR InjCrv_facPiI1ETSSOECor1Rgn2_CUR InjCrv_facPiI1ETSSOECorRgn_AXIS /end DEF_CHARACTERISTIC
 /begin IN_MEASUREMENT EnvP_p InjCrv_swtPiIDblCorMap InjSys_tAirRgn InjSys_tEngRgn /end IN_MEASUREMENT
 /begin OUT_MEASUREMENT InjCrv_facPiI1APSQCorRgn1 InjCrv_facPiI1APSQCorRgn2 InjCrv_facPiI1APSSOECorRgn1 InjCrv_facPiI1APSSOECorRgn2 InjCrv_facPiI1ATSQCorRgn1 InjCrv_facPiI1ATSQCorRgn2 InjCrv_facPiI1ATSSOECorRgn1 InjCrv_facPiI1ATSSOECorRgn2 InjCrv_facPiI1ETSQCorRgn1 InjCrv_facPiI1ETSQCorRgn2 InjCrv_facPiI1ETSSOECorRgn1 InjCrv_facPiI1ETSSOECorRgn2 /end OUT_MEASUREMENT
/end FUNCTION
/begin FUNCTION InjCrv_PiI1EnvCorTi ""
 /begin DEF_CHARACTERISTIC InjCrv_tiPiI1APSCor1_MAP InjCrv_tiPiI1APSCor2_MAP InjCrv_tiPiI1ATSCor1_MAP InjCrv_tiPiI1ATSCor2_MAP InjCrv_tiPiI1ETSCor1_MAP InjCrv_tiPiI1ETSCor2_MAP /end DEF_CHARACTERISTIC
 /begin IN_MEASUREMENT Epm_nEng InjCtl_qSetUnBal /end IN_MEASUREMENT
 /begin LOC_MEASUREMENT InjCrv_tiPiI1APSCor1_mp InjCrv_tiPiI1APSCor2_mp InjCrv_tiPiI1ATSCor1_mp InjCrv_tiPiI1ATSCor2_mp InjCrv_tiPiI1ETSCor1_mp InjCrv_tiPiI1ETSCor2_mp /end LOC_MEASUREMENT
/end FUNCTION
/begin FUNCTION InjCrv_PiI1Rgn ""
 /begin DEF_CHARACTERISTIC InjCrv_qPiI1Bas0Rgn1_GMAP InjCrv_qPiI1Bas0Rgn2_GMAP InjCrv_qPiI1Bas1Rgn1_GMAP InjCrv_qPiI1Bas1Rgn2_GMAP InjCrv_qPiI1BasRgnX_AXIS InjCrv_qPiI1BasRgnY_AXIS InjCrv_qPiI1MaxRgn_MAP InjCrv_tiPiI1Bas0Rgn1_GMAP InjCrv_tiPiI1Bas0Rgn2_GMAP InjCrv_tiPiI1Bas1Rgn1_GMAP InjCrv_tiPiI1Bas1Rgn2_GMAP InjCrv_tiPiI1BasRgnX_AXIS InjCrv_tiPiI1BasRgnY_AXIS /end DEF_CHARACTERISTIC
 /begin IN_MEASUREMENT Epm_nEng InjCrv_qPiI1AddCorRgn1 InjCrv_qPiI1AddCorRgn2 InjCrv_qPiI1EnvCorRgn1 InjCrv_qPiI1EnvCorRgn2 InjCrv_stInjCharSetVal InjCrv_stPiI1Rgn InjCrv_tiPiI1AddCorRgn1 InjCrv_tiPiI1AddCorRgn2 InjCrv_tiPiI1EnvCorRgn1 InjCrv_tiPiI1EnvCorRgn2 InjCtl_qSetUnBal /end IN_MEASUREMENT
 /begin OUT_MEASUREMENT InjCrv_qPiI1Rgn InjCrv_tiPiI1Rgn /end OUT_MEASUREMENT
 /begin LOC_MEASUREMENT InjCrv_numPiI1RgnStg_mp InjCrv_qPiI1BasRgn_mp InjCrv_qPiI1MaxRgn_mp InjCrv_qPiI1RgnAdd_mp InjCrv_tiPiI1BasRgn_mp InjCrv_tiPiI1RgnAdd_mp /end LOC_MEASUREMENT
/end FUNCTION
/begin FUNCTION InjCrv_PiI1RgnLib ""
 /begin DEF_CHARACTERISTIC InjCrv_facPiI1QntRmp0Val_GCUR InjCrv_facPiI1QntRmp1Val_GCUR InjCrv_facPiI1QntRmpValX_AXIS InjCrv_facPiI1SOERmp0Val_GCUR InjCrv_facPiI1SOERmp1Val_GCUR InjCrv_facPiI1SOERmpValX_AXIS /end DEF_CHARACTERISTIC
 /begin IN_MEASUREMENT CoEOM_facRmpVal InjCrv_qPiI1Rgn InjCrv_stPiI1Rgn InjCrv_stPiI1RmpSel InjCrv_tiPiI1Rgn /end IN_MEASUREMENT
 /begin LOC_MEASUREMENT InjCrv_facPiI1QntRmpVal_mp InjCrv_facPiI1SOERmpVal_mp /end LOC_MEASUREMENT
/end FUNCTION
/begin FUNCTION InjCrv_PiI1SOEPhiBas "" /end FUNCTION
/begin FUNCTION InjCrv_PiI1SOETiBas ""
 /begin DEF_CHARACTERISTIC InjCrv_tiPiI1Bas1_MAP InjCrv_tiPiI1Bas2_MAP InjCrv_tiPiI1Bas3_MAP /end DEF_CHARACTERISTIC
 /begin IN_MEASUREMENT Epm_nEng InjCtl_qSetUnBal /end IN_MEASUREMENT
/end FUNCTION
/begin FUNCTION InjCrv_PiI1Strt "" /begin DEF_CHARACTERISTIC InjCrv_qPiI1BasStrt_MAP InjCrv_tiPiI1BasStrt_MAP /end DEF_CHARACTERISTIC
 /begin IN_MEASUREMENT CoEng_st Epm_nEng InjCrv_qPiI1AddCorStrt InjCrv_tiPiI1AddCorStrt InjCtl_qSetUnBal /end IN_MEASUREMENT
 /begin LOC_MEASUREMENT InjCrv_qPiI1BasStrt_mp InjCrv_tiPiI1BasStrt_mp /end LOC_MEASUREMENT
/end FUNCTION
/begin FUNCTION InjCrv_PiI2 ""
 /begin DEF_CHARACTERISTIC InjCrv_facPiI1QntMax_C InjCrv_facPiI2QntMin_CUR InjCrv_nDiffMin_C InjCrv_phiPiI2Des_C InjCrv_qDiffMin_C InjCrv_qMI1MinPiI2DiffHys_C InjCrv_qPiI1WvCorMax_C InjCrv_qPiI2Bas_MAP InjCrv_qPiI2Des_C InjCrv_qPiI2Max_MAP InjCrv_qPiI2MinDiff_C InjCrv_swtPhiPiI2Des_C InjCrv_swtQntPiI2Des_C InjCrv_swtTiPiI2Des_C InjCrv_tiPiI2Des_C InjCrv_tiPiI2Min_MAP /end DEF_CHARACTERISTIC
 /begin REF_CHARACTERISTIC InjCrv_phiPiIMax_C InjCrv_stInjDstSel_C InjCrv_tiPiIMax_C /end REF_CHARACTERISTIC
 /begin IN_MEASUREMENT Epm_ctCyl Epm_nEng Epm_numCyl FlSys_rhoFl InjCrv_phiPiI2AddCor InjCrv_phiPiI2Des InjCrv_phiPiI2EnvCor InjCrv_qPiI2AddCor InjCrv_qPiI2Des InjCrv_qPiI2EnvCor InjCrv_stPiI2Rgn InjCrv_tiPiI2AddCor InjCrv_tiPiI2CylOffs InjCrv_tiPiI2Des InjCrv_tiPiI2EnvCor InjCtl_qSetUnBal InjVlv_tiPse InjVlv_volPiI2CorCyc QWC_st RailP_pFlt /end IN_MEASUREMENT
 /begin LOC_MEASUREMENT InjCrv_facPiI2QntMin_mp InjCrv_phiPiI2AbsTot_mp InjCrv_phiPiI2Abs_mp InjCrv_phiPiI2Cor_mp InjCrv_phiPiI2Rel_mp InjCrv_qMI1MinPiI2_mp InjCrv_qPiI2Bas_mp InjCrv_qPiI2Max_mp InjCrv_qPiI2SetLimMax_mp InjCrv_qPiI2SetLim_mp InjCrv_qPiI2Set_mp InjCrv_stPiI2_mp InjCrv_tiPiI2Cor_mp InjCrv_tiPiI2ET_mp InjCrv_tiPiI2Min_mp InjCrv_tiPiI2RelMI_mp InjCrv_tiPiI2RelPiI1_mp InjCrv_tiPiI2RelTot_mp InjCrv_tiPiI2Tot_mp InjCrv_volPiI2Cor_mp InjCrv_volPiI2_mp /end LOC_MEASUREMENT
/end FUNCTION
/begin FUNCTION InjCrv_PiI2AddCor ""
 /begin DEF_CHARACTERISTIC InjCrv_facPiI2VehCor_CUR InjCrv_facPiI2VehTempCor_CUR InjCrv_phiPiI2ETSCorStrt_MAP InjCrv_qPiI2APSCorStrt_MAP InjCrv_qPiI2ATSCorStrt_MAP InjCrv_qPiI2ETSCor11_MAP InjCrv_qPiI2ETSCorStrt_MAP InjCrv_tiPiI2APSCorStrt_MAP InjCrv_tiPiI2ETSCorStrt_MAP InjCrv_tiPiI2VehCor_MAP /end DEF_CHARACTERISTIC
 /begin IN_MEASUREMENT CEngDsT_t CoEng_st Epm_nEng InjCrv_facPiI2APSQCorStrt InjCrv_facPiI2ATSQCorStrt InjCrv_facPiI2ETSQCor11 InjCrv_facPiI2ETSQCorStrt InjCrv_facPiI2ETSSOECorStrt InjCrv_stPiI2Rgn InjCrv_stPiI2RgnTSync InjCtl_qSetUnBal VehV_v /end IN_MEASUREMENT
 /begin OUT_MEASUREMENT InjCrv_phiPiI2AddCor InjCrv_phiPiI2AddCorStrt InjCrv_qPiI2AddCor InjCrv_qPiI2AddCorStrt InjCrv_tiPiI2AddCor InjCrv_tiPiI2AddCorStrt /end OUT_MEASUREMENT
 /begin LOC_MEASUREMENT InjCrv_phiPiI2ETSCorStrt_mp InjCrv_qPiI2APSQCorStrt_mp InjCrv_qPiI2ATSQCorStrt_mp InjCrv_qPiI2ETSCor11_mp InjCrv_qPiI2ETSQCorStrt_mp InjCrv_tiPiI2APSCorStrt_mp InjCrv_tiPiI2ETSCorStrt_mp /end LOC_MEASUREMENT
/end FUNCTION
/begin FUNCTION InjCrv_PiI2AddCorRgn "" /begin OUT_MEASUREMENT InjCrv_qPiI2AddCorRgn InjCrv_tiPiI2AddCorRgn /end OUT_MEASUREMENT /end FUNCTION
/begin FUNCTION InjCrv_PiI2AddCorSlow ""
 /begin DEF_CHARACTERISTIC InjCrv_facPiI2APSQCorStrt_CUR InjCrv_facPiI2APSSOECorStrt_CUR InjCrv_facPiI2ATSQCorStrt_CUR InjCrv_facPiI2ETSQCor11_CUR InjCrv_facPiI2ETSQCorStrt_CUR InjCrv_facPiI2ETSSOECorStrt_CUR /end DEF_CHARACTERISTIC
 /begin IN_MEASUREMENT CoEng_st EnvP_p InjCrv_tAirPiI InjSys_tEng /end IN_MEASUREMENT
 /begin OUT_MEASUREMENT InjCrv_facPiI2APSQCorStrt InjCrv_facPiI2APSSOECorStrt InjCrv_facPiI2ATSQCorStrt InjCrv_facPiI2ETSQCor11 InjCrv_facPiI2ETSQCorStrt InjCrv_facPiI2ETSSOECorStrt /end OUT_MEASUREMENT
/end FUNCTION
/begin FUNCTION InjCrv_PiI2EnvCor ""
 /begin DEF_CHARACTERISTIC InjCrv_qPiI2APSCor_MAP InjCrv_qPiI2ATSCor_MAP InjCrv_qPiI2ETSCor_MAP /end DEF_CHARACTERISTIC
 /begin IN_MEASUREMENT Epm_nEng InjCrv_facPiI2APSQCor InjCrv_facPiI2ATSQCor InjCrv_facPiI2ATSSOECor InjCrv_facPiI2ETSQCor InjCrv_facPiI2ETSSOECor InjCrv_stPiI2RgnTSync InjCtl_qSetUnBal /end IN_MEASUREMENT
 /begin OUT_MEASUREMENT InjCrv_phiPiI2EnvCor InjCrv_qPiI2EnvCor InjCrv_tiPiI2EnvCor /end OUT_MEASUREMENT
 /begin LOC_MEASUREMENT InjCrv_qPiI2APSCor_mp InjCrv_qPiI2ATSCor_mp InjCrv_qPiI2ETSCor_mp /end LOC_MEASUREMENT
/end FUNCTION
/begin FUNCTION InjCrv_PiI2EnvCorPhi ""
 /begin LOC_MEASUREMENT InjCrv_phiPiI2APSCor_mp InjCrv_phiPiI2ATSCor_mp InjCrv_phiPiI2ETSCor_mp /end LOC_MEASUREMENT
/end FUNCTION
/begin FUNCTION InjCrv_PiI2EnvCorRgn ""
 /begin DEF_CHARACTERISTIC InjCrv_qPiI2APSCor0Rgn_GMAP InjCrv_qPiI2APSCor1Rgn_GMAP InjCrv_qPiI2APSCorRgnX_AXIS InjCrv_qPiI2APSCorRgnY_AXIS InjCrv_qPiI2ATSCor0Rgn_GMAP InjCrv_qPiI2ATSCor1Rgn_GMAP InjCrv_qPiI2ATSCorRgnX_AXIS InjCrv_qPiI2ATSCorRgnY_AXIS InjCrv_qPiI2ETSCor0Rgn_GMAP InjCrv_qPiI2ETSCor1Rgn_GMAP InjCrv_qPiI2ETSCorRgnX_AXIS InjCrv_qPiI2ETSCorRgnY_AXIS InjCrv_tiPiI2APSCor0Rgn_GMAP InjCrv_tiPiI2APSCor1Rgn_GMAP InjCrv_tiPiI2APSCorRgnX_AXIS InjCrv_tiPiI2APSCorRgnY_AXIS InjCrv_tiPiI2ATSCor0Rgn_GMAP InjCrv_tiPiI2ATSCor1Rgn_GMAP InjCrv_tiPiI2ATSCorRgnX_AXIS InjCrv_tiPiI2ATSCorRgnY_AXIS InjCrv_tiPiI2ETSCor0Rgn_GMAP InjCrv_tiPiI2ETSCor1Rgn_GMAP InjCrv_tiPiI2ETSCorRgnX_AXIS InjCrv_tiPiI2ETSCorRgnY_AXIS /end DEF_CHARACTERISTIC
 /begin IN_MEASUREMENT Epm_nEng InjCrv_facPiI2APSQCorRgn InjCrv_facPiI2APSSOECorRgn InjCrv_facPiI2ATSQCorRgn InjCrv_facPiI2ATSSOECorRgn InjCrv_facPiI2ETSQCorRgn InjCrv_facPiI2ETSSOECorRgn InjCrv_stPiI2RgnTSync InjCtl_qSetUnBal /end IN_MEASUREMENT
 /begin OUT_MEASUREMENT InjCrv_qPiI2EnvCorRgn InjCrv_tiPiI2EnvCorRgn /end OUT_MEASUREMENT
 /begin LOC_MEASUREMENT InjCrv_qPiI2APSCorRgn_mp InjCrv_qPiI2ATSCorRgn_mp InjCrv_qPiI2ETSCorRgn_mp InjCrv_tiPiI2APSCorRgn_mp InjCrv_tiPiI2ATSCorRgn_mp InjCrv_tiPiI2ETSCorRgn_mp /end LOC_MEASUREMENT
/end FUNCTION
/begin FUNCTION InjCrv_PiI2EnvCorSlow ""
 /begin DEF_CHARACTERISTIC InjCrv_facPiI2APSQCor_CUR InjCrv_facPiI2APSSOECor_CUR InjCrv_facPiI2ATSQCor_CUR InjCrv_facPiI2ATSSOECor_CUR InjCrv_facPiI2ETSQCor_CUR InjCrv_facPiI2ETSSOECor_CUR /end DEF_CHARACTERISTIC
 /begin IN_MEASUREMENT EnvP_p InjCrv_tAirPiI InjSys_tEng /end IN_MEASUREMENT
 /begin OUT_MEASUREMENT InjCrv_facPiI2APSQCor InjCrv_facPiI2APSSOECor InjCrv_facPiI2ATSQCor InjCrv_facPiI2ATSSOECor InjCrv_facPiI2ETSQCor InjCrv_facPiI2ETSSOECor /end OUT_MEASUREMENT
/end FUNCTION
/begin FUNCTION InjCrv_PiI2EnvCorSlowRgn ""
 /begin DEF_CHARACTERISTIC InjCrv_facPiI2APSQCor0Rgn_GCUR InjCrv_facPiI2APSQCor1Rgn_GCUR InjCrv_facPiI2APSQCorRgn_AXIS InjCrv_facPiI2APSSOECor0Rgn_GCUR InjCrv_facPiI2APSSOECor1Rgn_GCUR InjCrv_facPiI2APSSOECorRgn_AXIS InjCrv_facPiI2ATSQCor0Rgn_GCUR InjCrv_facPiI2ATSQCor1Rgn_GCUR InjCrv_facPiI2ATSQCorRgn_AXIS InjCrv_facPiI2ATSSOECor0Rgn_GCUR InjCrv_facPiI2ATSSOECor1Rgn_GCUR InjCrv_facPiI2ATSSOECorRgn_AXIS InjCrv_facPiI2ETSQCor0Rgn_GCUR InjCrv_facPiI2ETSQCor1Rgn_GCUR InjCrv_facPiI2ETSQCorRgn_AXIS InjCrv_facPiI2ETSSOECor0Rgn_GCUR InjCrv_facPiI2ETSSOECor1Rgn_GCUR InjCrv_facPiI2ETSSOECorRgn_AXIS /end DEF_CHARACTERISTIC
 /begin IN_MEASUREMENT EnvP_p InjSys_tAirRgn InjSys_tEngRgn /end IN_MEASUREMENT
 /begin OUT_MEASUREMENT InjCrv_facPiI2APSQCorRgn InjCrv_facPiI2APSSOECorRgn InjCrv_facPiI2ATSQCorRgn InjCrv_facPiI2ATSSOECorRgn InjCrv_facPiI2ETSQCorRgn InjCrv_facPiI2ETSSOECorRgn /end OUT_MEASUREMENT
/end FUNCTION
/begin FUNCTION InjCrv_PiI2EnvCorTi ""
 /begin DEF_CHARACTERISTIC InjCrv_tiPiI2APSCor_MAP InjCrv_tiPiI2ATSCor_MAP InjCrv_tiPiI2ETSCor_MAP /end DEF_CHARACTERISTIC
 /begin IN_MEASUREMENT Epm_nEng InjCtl_qSetUnBal /end IN_MEASUREMENT
 /begin LOC_MEASUREMENT InjCrv_tiPiI2APSCor_mp InjCrv_tiPiI2ATSCor_mp InjCrv_tiPiI2ETSCor_mp /end LOC_MEASUREMENT
/end FUNCTION
/begin FUNCTION InjCrv_PiI2Rgn ""
 /begin DEF_CHARACTERISTIC InjCrv_qPiI2Bas0Rgn_GMAP InjCrv_qPiI2Bas1Rgn_GMAP InjCrv_qPiI2BasRgnX_AXIS InjCrv_qPiI2BasRgnY_AXIS InjCrv_qPiI2MaxRgn_MAP InjCrv_tiPiI2Bas0Rgn_GMAP InjCrv_tiPiI2Bas1Rgn_GMAP InjCrv_tiPiI2BasRgnX_AXIS InjCrv_tiPiI2BasRgnY_AXIS /end DEF_CHARACTERISTIC
 /begin IN_MEASUREMENT Epm_nEng InjCrv_qPiI2AddCorRgn InjCrv_qPiI2EnvCorRgn InjCrv_stPiI2Rgn InjCrv_tiPiI2AddCorRgn InjCrv_tiPiI2EnvCorRgn InjCtl_qSetUnBal /end IN_MEASUREMENT
 /begin OUT_MEASUREMENT InjCrv_qPiI2Rgn InjCrv_tiPiI2Rgn /end OUT_MEASUREMENT
 /begin LOC_MEASUREMENT InjCrv_numPiI2RgnStg_mp InjCrv_qPiI2BasRgn_mp InjCrv_qPiI2MaxRgn_mp InjCrv_qPiI2RgnAdd_mp InjCrv_tiPiI2BasRgn_mp InjCrv_tiPiI2RgnAdd_mp /end LOC_MEASUREMENT
/end FUNCTION
/begin FUNCTION InjCrv_PiI2RgnLib ""
 /begin DEF_CHARACTERISTIC InjCrv_facPiI2QntRmp0Val_GCUR InjCrv_facPiI2QntRmp1Val_GCUR InjCrv_facPiI2QntRmpValX_AXIS InjCrv_facPiI2SOERmp0Val_GCUR InjCrv_facPiI2SOERmp1Val_GCUR InjCrv_facPiI2SOERmpValX_AXIS /end DEF_CHARACTERISTIC
 /begin IN_MEASUREMENT CoEOM_facRmpVal InjCrv_qPiI2Rgn InjCrv_stPiI2Rgn InjCrv_stPiI2RmpSel InjCrv_tiPiI2Rgn /end IN_MEASUREMENT
 /begin LOC_MEASUREMENT InjCrv_facPiI2QntRmpVal_mp InjCrv_facPiI2SOERmpVal_mp /end LOC_MEASUREMENT
/end FUNCTION
/begin FUNCTION InjCrv_PiI2SOEPhiBas "" /begin LOC_MEASUREMENT InjCrv_phiPiI2Bas_mp /end LOC_MEASUREMENT /end FUNCTION
/begin FUNCTION InjCrv_PiI2SOETiBas "" /begin DEF_CHARACTERISTIC InjCrv_tiPiI2Bas_MAP /end DEF_CHARACTERISTIC /begin IN_MEASUREMENT Epm_nEng InjCtl_qSetUnBal /end IN_MEASUREMENT /begin LOC_MEASUREMENT InjCrv_tiPiI2Bas_mp /end LOC_MEASUREMENT /end FUNCTION
/begin FUNCTION InjCrv_PiI2Strt ""
 /begin DEF_CHARACTERISTIC InjCrv_phiPiI2BasStrt_MAP InjCrv_qPiI2BasStrt_MAP InjCrv_tiPiI2BasStrt_MAP /end DEF_CHARACTERISTIC
 /begin IN_MEASUREMENT Epm_nEng InjCtl_qSetUnBal /end IN_MEASUREMENT
 /begin LOC_MEASUREMENT InjCrv_phiPiI2BasStrt_mp InjCrv_qPiI2BasStrt_mp InjCrv_tiPiI2BasStrt_mp /end LOC_MEASUREMENT
/end FUNCTION
/begin FUNCTION InjCrv_PiI3 "" /end FUNCTION
/begin FUNCTION InjCrv_PoI1 ""
 /begin DEF_CHARACTERISTIC InjCrv_ctCylPoI1Clsn_C InjCrv_facPoI1Eff_MAP InjCrv_facPoI1QntMin_C InjCrv_phiDynOfs_CUR InjCrv_phiPoI1Des_C InjCrv_phiPoI1Max_MAP InjCrv_phiPoI1Min_C InjCrv_qPoI1Bas_MAP InjCrv_qPoI1Des_C InjCrv_qPoI1SetLim_C InjCrv_swtPhiPoI1Des_C InjCrv_swtPoI1Clsn_C InjCrv_swtPoI1ShOff_C InjCrv_swtQntPoI1Des_C InjCrv_tiPoI1Bas_MAP InjCrv_tiPoI1MaxOfs_MAP /end DEF_CHARACTERISTIC
 /begin REF_CHARACTERISTIC InjCrv_stInjCharActVal_C InjCrv_stInjDstSel_C InjCrv_swtStInjCharActVal_C /end REF_CHARACTERISTIC
 /begin IN_MEASUREMENT CoEng_stShutOffPath Epm_ctCyl Epm_nEng Epm_numCyl FlSys_rhoFl InjCrv_phiMI1Des InjCrv_phiPiI1Des InjCrv_phiPiI2Des InjCrv_phiPiI3Des InjCrv_phiPoI2Des InjCrv_qPoI1AddCor InjCrv_qPoI1EnvCor InjCrv_qPoI2Des InjCrv_qPoI2Eff InjCrv_qPoIRem InjCrv_stInjCharActVal InjCrv_stInjCharActValPrg InjCrv_stInjCharRlsPrgVal InjCrv_stInjCharSetVal InjCrv_stPoI1Rgn InjCrv_stPoIOvrLim InjCrv_tiPiI1Des InjCrv_tiPiI2Des InjCrv_tiPoI2Des InjCrv_tiPoI2ET InjCtl_qSetUnBal InjVlv_tiPse RailP_pFlt /end IN_MEASUREMENT
 /begin OUT_MEASUREMENT InjCrv_facPoI1EffSet InjCrv_phiPoI1Des InjCrv_qPoI1Des InjCrv_qPoI1Eff InjCrv_tiPoI1Des /end OUT_MEASUREMENT
 /begin LOC_MEASUREMENT InjCrv_facPoI1Eff_mp InjCrv_phiDynOfs_mp InjCrv_phiNxtCylBnk_mp InjCrv_phiNxtCyl_mp InjCrv_phiPoI1DesAddByp_mp InjCrv_phiPoI1DesAdd_mp InjCrv_phiPoI1DesByp_mp InjCrv_phiPoI1Dur_mp InjCrv_phiPoI1Lim_mp InjCrv_phiPoI1Max_mp InjCrv_phiPoI1Min_mp InjCrv_phiPoI1Tot_mp InjCrv_qPoI1Bas_mp InjCrv_qPoI1Clsn InjCrv_qPoI1Cor_mp InjCrv_qPoI1DesAddByp_mp InjCrv_qPoI1DesAdd_mp InjCrv_qPoI1DesByp_mp InjCrv_qPoI1Des_mp InjCrv_qPoI1Lim_mp InjCrv_qPoI1Max_mp InjCrv_qPoI1Min_mp InjCrv_qPoI1Set_mp InjCrv_qPoI2Des1_mp InjCrv_stPoI1_mp InjCrv_tiPoI1Bas_mp InjCrv_tiPoI1ET_mp InjCrv_tiPoI1Lim_mp InjCrv_tiPoI1Max_mp InjCrv_tiPoI1Set_mp InjCrv_tiPoI1ZFCET_mp InjCrv_volPoI1_mp /end LOC_MEASUREMENT
/end FUNCTION
/begin FUNCTION InjCrv_PoI1AddCor ""
 /begin OUT_MEASUREMENT InjCrv_POpPoI1AddCor InjCrv_qPoI1AddCor InjCrv_tiPoI1AddCor /end OUT_MEASUREMENT
/end FUNCTION
/begin FUNCTION InjCrv_PoI1AddCorRgnLib "" /begin DEF_CHARACTERISTIC InjCrv_facPoI1RgnAPSQCor_CUR InjCrv_qPoI1RgnAPSCor_MAP /end DEF_CHARACTERISTIC /begin IN_MEASUREMENT EnvP_p Epm_nEng InjCtl_qSetUnBal /end IN_MEASUREMENT /begin OUT_MEASUREMENT InjCrv_facPoI1AddCorRgn /end OUT_MEASUREMENT
 /begin LOC_MEASUREMENT InjCrv_facPoI1RgnAPSQCor_mp InjCrv_qPoI1RgnAPSCorBas_mp InjCrv_qPoI1RgnAPSCor_mp /end LOC_MEASUREMENT
/end FUNCTION
/begin COMPU_METHOD AirTempFldSel "" TAB_VERB "%6.3" "" COMPU_TAB_REF AirTempFldSel /end COMPU_METHOD
/begin COMPU_VTAB AirTempFldSel "" TAB_VERB 4 0 "Air_tCACDs" 1 "Air_tAFS" 2 "EnvT_t" 3 "Air_tAFSCorr" /end COMPU_VTAB
/begin COMPU_METHOD AngleCrS "" RAT_FUNC "%6.3" "deg CrS" COEFFS 0 45.5111111111 0 0 0 1 /end COMPU_METHOD
/begin COMPU_METHOD CAS_MOUNTCHK_SY_Compu "" TAB_VERB "%6.3" "" COMPU_TAB_REF CAS_MOUNTCHK_SY_Compu /end COMPU_METHOD
/begin COMPU_VTAB CAS_MOUNTCHK_SY_Compu "" TAB_VERB 2 0 "0" 1 "1" /end COMPU_VTAB
/begin COMPU_METHOD CoEOMSwt_S16 "" RAT_FUNC "%7.6" "-" COEFFS 0 16384 0 0 0 1 /end COMPU_METHOD
/begin COMPU_METHOD EngN "" RAT_FUNC "%5.1" "rpm" COEFFS 0 2 0 0 0 1 /end COMPU_METHOD
/begin COMPU_METHOD Fact "" RAT_FUNC "%6.5" "-" COEFFS 0 8192 0 0 0 1 /end COMPU_METHOD
/begin COMPU_METHOD Fact1 "" RAT_FUNC "%6.4" "-" COEFFS 0 128 0 0 0 1 /end COMPU_METHOD
/begin COMPU_METHOD InjMass "" RAT_FUNC "%5.2" "mg/hub" COEFFS 0 100 0 0 0 1 /end COMPU_METHOD
/begin COMPU_METHOD InjMassInj "" RAT_FUNC "%5.2" "mg/inj" COEFFS 0 100 0 0 0 1 /end COMPU_METHOD
/begin COMPU_METHOD InjMassPerSec_20ms "" RAT_FUNC "%6.3" "mg/hub/s" COEFFS 0 2 0 0 0 1 /end COMPU_METHOD
/begin COMPU_METHOD InjQntInj "" RAT_FUNC "%5.2" "mm^3/inj" COEFFS 0 100 0 0 0 1 /end COMPU_METHOD
/begin COMPU_METHOD InjTime_us "" RAT_FUNC "%5.1" "us" COEFFS 0 2.5 0 0 0 1 /end COMPU_METHOD
/begin COMPU_METHOD OneToOne "" RAT_FUNC "%6.0" "-" COEFFS 0 1 0 0 0 1 /end COMPU_METHOD
/begin COMPU_METHOD Prc "" RAT_FUNC "%6.4" "%" COEFFS 0 81.92 0 0 0 1 /end COMPU_METHOD
/begin COMPU_METHOD Pres_hPa "" RAT_FUNC "%5.1" "hPa" COEFFS 0 1 0 0 0 1 /end COMPU_METHOD
/begin COMPU_METHOD Pres_Rail "" RAT_FUNC "%5.1" "bar" COEFFS 0 10.000000 0 0 0 1 /end COMPU_METHOD
/begin COMPU_METHOD Temp_Cels "" RAT_FUNC "%5.1" "deg C" COEFFS 0 10 2731.4 0 0 1 /end COMPU_METHOD
/begin COMPU_METHOD Vel "" RAT_FUNC "%5.2" "km/h" COEFFS 0 100 0 0 0 1 /end COMPU_METHOD
/begin RECORD_LAYOUT Axis_Xs16 NO_AXIS_PTS_X 1 SWORD AXIS_PTS_X 2 SWORD INDEX_INCR DIRECT /end RECORD_LAYOUT
/begin RECORD_LAYOUT CurG_Ws16 FNC_VALUES 1 SWORD COLUMN_DIR DIRECT /end RECORD_LAYOUT
/begin RECORD_LAYOUT Cur_Xs16Ws16 NO_AXIS_PTS_X 1 SWORD AXIS_PTS_X 2 SWORD INDEX_INCR DIRECT FNC_VALUES 3 SWORD COLUMN_DIR DIRECT /end RECORD_LAYOUT
/begin RECORD_LAYOUT Kf_Xs16_Ys16_Ws16 NO_AXIS_PTS_X 1 SWORD NO_AXIS_PTS_Y 2 SWORD AXIS_PTS_X 3 SWORD INDEX_INCR DIRECT AXIS_PTS_Y 4 SWORD INDEX_INCR DIRECT FNC_VALUES 5 SWORD COLUMN_DIR DIRECT /end RECORD_LAYOUT
/begin RECORD_LAYOUT Kl_Xs16_Ws16 NO_AXIS_PTS_X 1 SWORD AXIS_PTS_X 2 SWORD INDEX_INCR DIRECT FNC_VALUES 3 SWORD COLUMN_DIR DIRECT /end RECORD_LAYOUT
/begin RECORD_LAYOUT MapG_Ws16 FNC_VALUES 1 SWORD COLUMN_DIR DIRECT /end RECORD_LAYOUT
/begin RECORD_LAYOUT Map_Xs16Ys16Ws16 NO_AXIS_PTS_X 1 SWORD NO_AXIS_PTS_Y 2 SWORD AXIS_PTS_X 3 SWORD INDEX_INCR DIRECT AXIS_PTS_Y 4 SWORD INDEX_INCR DIRECT FNC_VALUES 5 SWORD COLUMN_DIR DIRECT /end RECORD_LAYOUT
/begin RECORD_LAYOUT Val_Ws16 FNC_VALUES 1 SWORD COLUMN_DIR DIRECT /end RECORD_LAYOUT
/begin RECORD_LAYOUT Val_Wu8 FNC_VALUES 1 UBYTE COLUMN_DIR DIRECT /end RECORD_LAYOUT
/end MODULE
/end PROJECT

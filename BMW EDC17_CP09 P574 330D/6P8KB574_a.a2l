ASAP2_VERSION 1 4
/begin PROJECT P_574 "EDC17_CP09"
/begin HEADER "" VERSION "V8KB" PROJECT_NO P_574 /end HEADER
/begin MODULE DIM ""
/begin MOD_COMMON "" BYTE_ORDER MSB_LAST ALIGNMENT_BYTE 1 ALIGNMENT_WORD 2 ALIGNMENT_LONG 4 ALIGNMENT_FLOAT32_IEEE 4 /end MOD_COMMON
/begin CHARACTERISTIC PCR_ClthThresLP_CUR "" CURVE 0x80054B34 Cur_Xs16Ws16 327.6700 InjMassCyc 0.00 327.6700 EXTENDED_LIMITS -327.6800 327.6700
 /begin AXIS_DESCR STD_AXIS Epm_nEng EngN 6 0.00 8000.000 EXTENDED_LIMITS -16384.00 16383.50 DEPOSIT ABSOLUTE /end AXIS_DESCR
/end CHARACTERISTIC
/begin CHARACTERISTIC PCR_ClthThres_C "Schwellwert für Einspritzmenge bzw. inneres Drehmoment" VALUE 0x80054998 Val_Ws16 327.6700 InjMass 0.00 327.6700 EXTENDED_LIMITS -327.6800 327.6700 /end CHARACTERISTIC
/begin CHARACTERISTIC PCR_dnOfsCalcLim_C "Threshold for derivation with respect to time of Eng_nAvrg" VALUE 0x80054C18 Val_Ws16 3000.000 dn_dZ20 0.00 3000.000 FORMAT "%8.3" EXTENDED_LIMITS -163840.0 163835.0 /end CHARACTERISTIC
/begin CHARACTERISTIC PCR_dqCtlOfsCalcLim_C "Threshold for derivation with respect to time of InjCtl_qCurr" VALUE 0x80054C1A Val_Ws16 8000.000 InjMassPerSec_20ms -4000.000 4000.000 FORMAT "%8.3" EXTENDED_LIMITS -16384.00 16383.50 /end CHARACTERISTIC
/begin CHARACTERISTIC PCR_drCtlValOfsRmp.Pos_C "/" VALUE 0x80054C1C Kw_Ws32 399999.999814 RmpPrc 0.00 399999.999814 FORMAT "%13.6" EXTENDED_LIMITS -400000.000000 399999.999814 /end CHARACTERISTIC
/begin CHARACTERISTIC PCR_drCtlValOfsRmp.Neg_C "/" VALUE 0x80054C20 Kw_Ws32 399999.999814 RmpPrc 0.00 399999.999814 FORMAT "%13.6" EXTENDED_LIMITS -400000.000000 399999.999814 /end CHARACTERISTIC
/begin CHARACTERISTIC PCR_drRmpCBOpn_CUR "" CURVE 0x8005499A Cur_Xs16Ws16 781.2262 RmpPrc1 0.00 781.2262 FORMAT "%8.4" EXTENDED_LIMITS -781.2500 781.2262
 /begin AXIS_DESCR STD_AXIS Epm_nEng EngN 6 0.00 10000.00 EXTENDED_LIMITS -16384.00 16383.50 DEPOSIT ABSOLUTE /end AXIS_DESCR
/end CHARACTERISTIC
/begin CHARACTERISTIC PCR_DT1WinLP.T1_C "/" VALUE 0x800545B8 Kw_Ws32 4294.9662960 TimeDelay_s 0.0010000000689 4294.9672960 FORMAT "%12.7" EXTENDED_LIMITS 0.000002000000001 4294.9672960 /end CHARACTERISTIC
/begin CHARACTERISTIC PCR_DT1WinLP.Kd_C "/" VALUE 0x800545BC Kw_Ws32 9.99999996275 Kd_Pres_hPa2Prc 0.00 9.99999996275 FORMAT "%13.10" EXTENDED_LIMITS -400.000000000 399.999999814 /end CHARACTERISTIC
/begin CHARACTERISTIC PCR_DT1WinLP.KdPos_C "/" VALUE 0x800545C0 Kw_Ws32 9.99999996275 Kd_Pres_hPa2Prc 0.00 9.99999996275 FORMAT "%13.10" EXTENDED_LIMITS -400.000000000 399.999999814 /end CHARACTERISTIC
/begin CHARACTERISTIC PCR_DT1WinLP.KdNeg_C "/" VALUE 0x800545C4 Kw_Ws32 9.99999996275 Kd_Pres_hPa2Prc 0.00 9.99999996275 FORMAT "%13.10" EXTENDED_LIMITS -400.000000000 399.999999814 /end CHARACTERISTIC
/begin CHARACTERISTIC PCR_DT1WinLP.WinPos_C "/" VALUE 0x800545C8 Kw_Ws32 8500.00000000 Pres_hPa -5000.00000000 3500.00000000 EXTENDED_LIMITS -2147483648.00 2147483647.00 /end CHARACTERISTIC
/begin CHARACTERISTIC PCR_DT1WinLP.WinNeg_C "/" VALUE 0x800545CC Kw_Ws32 8500.00000000 Pres_hPa -5000.00000000 3500.00000000 EXTENDED_LIMITS -2147483648.00 2147483647.00 /end CHARACTERISTIC
/begin CHARACTERISTIC PCR_facLPD_MAP "" MAP 0x800545D0 Map_Xs16Ys16Ws16 50.00000 Fact1 0.00 50.00000 EXTENDED_LIMITS -256.0000 255.9922
 /begin AXIS_DESCR STD_AXIS Epm_nEng EngN 4 0.00 8000.000 EXTENDED_LIMITS -16384.00 16383.50 DEPOSIT ABSOLUTE /end AXIS_DESCR
 /begin AXIS_DESCR STD_AXIS PCR_qGovLP_mp InjMass 4 0.00 327.6700 EXTENDED_LIMITS -327.6800 327.6700 DEPOSIT ABSOLUTE /end AXIS_DESCR
/end CHARACTERISTIC
/begin CHARACTERISTIC PCR_facLPI_MAP "" MAP 0x80054604 Map_Xs16Ys16Ws16 1.000000 Fact1 0.00 1.000000 EXTENDED_LIMITS -256.0000 255.9922
 /begin AXIS_DESCR STD_AXIS Epm_nEng EngN 4 0.00 8000.000 EXTENDED_LIMITS -16384.00 16383.50 DEPOSIT ABSOLUTE /end AXIS_DESCR
 /begin AXIS_DESCR STD_AXIS PCR_qGovLP_mp InjMass 4 0.00 327.6700 EXTENDED_LIMITS -327.6800 327.6700 DEPOSIT ABSOLUTE /end AXIS_DESCR
/end CHARACTERISTIC
/begin CHARACTERISTIC PCR_facLPP_MAP "" MAP 0x80054638 Map_Xs16Ys16Ws16 50.00000 Fact1 0.00 50.00000 EXTENDED_LIMITS -256.0000 255.9922
 /begin AXIS_DESCR STD_AXIS Epm_nEng EngN 4 0.00 8000.000 EXTENDED_LIMITS -16384.00 16383.50 DEPOSIT ABSOLUTE /end AXIS_DESCR
 /begin AXIS_DESCR STD_AXIS PCR_qGovLP_mp InjMass 4 0.00 327.6700 EXTENDED_LIMITS -327.6800 327.6700 DEPOSIT ABSOLUTE /end AXIS_DESCR
/end CHARACTERISTIC
/begin CHARACTERISTIC PCR_facT1LP_MAP "" MAP 0x8005466C Map_Xs16Ys16Ws16 50.00000 Fact1 0.00 50.00000 EXTENDED_LIMITS -256.0000 255.9922
 /begin AXIS_DESCR STD_AXIS Epm_nEng EngN 4 0.00 8000.000 EXTENDED_LIMITS -16384.00 16383.50 DEPOSIT ABSOLUTE /end AXIS_DESCR
 /begin AXIS_DESCR STD_AXIS PCR_qGovLP_mp InjMass 4 0.00 327.6700 EXTENDED_LIMITS -327.6800 327.6700 DEPOSIT ABSOLUTE /end AXIS_DESCR
/end CHARACTERISTIC
/begin CHARACTERISTIC PCR_GovOffEOMLP_CUR "" CURVE 0x800546A0 Cur_Xs16Ws16 327.6700 InjMass 0.00 327.6700 EXTENDED_LIMITS -327.6800 327.6700
 /begin AXIS_DESCR STD_AXIS Epm_nEng EngN 8 0.00 8000.000 EXTENDED_LIMITS -16384.00 16383.50 DEPOSIT ABSOLUTE /end AXIS_DESCR
/end CHARACTERISTIC
/begin CHARACTERISTIC PCR_GovOffLP_CUR "" CURVE 0x800546C2 Cur_Xs16Ws16 327.6700 InjMass 0.00 327.6700 EXTENDED_LIMITS -327.6800 327.6700
 /begin AXIS_DESCR STD_AXIS Epm_nEng EngN 8 0.00 8000.000 EXTENDED_LIMITS -16384.00 16383.50 DEPOSIT ABSOLUTE /end AXIS_DESCR
/end CHARACTERISTIC
/begin CHARACTERISTIC PCR_GovOnEOMLP_CUR "" CURVE 0x800546E4 Cur_Xs16Ws16 327.6700 InjMass 0.00 327.6700 EXTENDED_LIMITS -327.6800 327.6700
 /begin AXIS_DESCR STD_AXIS Epm_nEng EngN 8 0.00 8000.000 EXTENDED_LIMITS -16384.00 16383.50 DEPOSIT ABSOLUTE /end AXIS_DESCR
/end CHARACTERISTIC
/begin CHARACTERISTIC PCR_GovOnLP_CUR "" CURVE 0x80054706 Cur_Xs16Ws16 327.6700 InjMass 0.00 327.6700 EXTENDED_LIMITS -327.6800 327.6700
 /begin AXIS_DESCR STD_AXIS Epm_nEng EngN 8 0.00 8000.000 EXTENDED_LIMITS -16384.00 16383.50 DEPOSIT ABSOLUTE /end AXIS_DESCR
/end CHARACTERISTIC
/begin CHARACTERISTIC PCR_I1OfsCalc.Ki_C "/" VALUE 0x80054C24 Kw_Ws32 1999999.99953 Ki -1000000.00000 999999.999534 FORMAT "%13.5" /end CHARACTERISTIC
/begin CHARACTERISTIC PCR_I1OfsCalc.KiPos_C "/" VALUE 0x80054C28 Kw_Ws32 1999999.99953 Ki -1000000.00000 999999.999534 FORMAT "%13.5" /end CHARACTERISTIC
/begin CHARACTERISTIC PCR_I1OfsCalc.KiNeg_C "/" VALUE 0x80054C2C Kw_Ws32 1999999.99953 Ki -1000000.00000 999999.999534 FORMAT "%13.5" /end CHARACTERISTIC
/begin CHARACTERISTIC PCR_I1OfsCalc.WinPos_C "/" VALUE 0x80054C30 Kw_Ws32 52428799.9878 Prc -26214400.0000 26214399.9878 /end CHARACTERISTIC
/begin CHARACTERISTIC PCR_I1OfsCalc.WinNeg_C "/" VALUE 0x80054C34 Kw_Ws32 52428799.9878 Prc -26214400.0000 26214399.9878 /end CHARACTERISTIC
/begin CHARACTERISTIC PCR_I2OfsCalc.Ki_C "/" VALUE 0x80054C38 Kw_Ws32 1999999.99953 Ki -1000000.00000 999999.999534 FORMAT "%13.5" /end CHARACTERISTIC
/begin CHARACTERISTIC PCR_I2OfsCalc.KiPos_C "/" VALUE 0x80054C3C Kw_Ws32 1999999.99953 Ki -1000000.00000 999999.999534 FORMAT "%13.5" /end CHARACTERISTIC
/begin CHARACTERISTIC PCR_I2OfsCalc.KiNeg_C "/" VALUE 0x80054C40 Kw_Ws32 1999999.99953 Ki -1000000.00000 999999.999534 FORMAT "%13.5" /end CHARACTERISTIC
/begin CHARACTERISTIC PCR_I2OfsCalc.WinPos_C "/" VALUE 0x80054C44 Kw_Ws32 52428799.9878 Prc -26214400.0000 26214399.9878 /end CHARACTERISTIC
/begin CHARACTERISTIC PCR_I2OfsCalc.WinNeg_C "/" VALUE 0x80054C48 Kw_Ws32 52428799.9878 Prc -26214400.0000 26214399.9878 /end CHARACTERISTIC
/begin CHARACTERISTIC PCR_I3OfsCalc.Ki_C "/" VALUE 0x80054C4C Kw_Ws32 1999999.99953 Ki -1000000.00000 999999.999534 FORMAT "%13.5" /end CHARACTERISTIC
/begin CHARACTERISTIC PCR_I3OfsCalc.KiPos_C "/" VALUE 0x80054C50 Kw_Ws32 1999999.99953 Ki -1000000.00000 999999.999534 FORMAT "%13.5" /end CHARACTERISTIC
/begin CHARACTERISTIC PCR_I3OfsCalc.KiNeg_C "/" VALUE 0x80054C54 Kw_Ws32 1999999.99953 Ki -1000000.00000 999999.999534 FORMAT "%13.5" /end CHARACTERISTIC
/begin CHARACTERISTIC PCR_I3OfsCalc.WinPos_C "/" VALUE 0x80054C58 Kw_Ws32 52428799.9878 Prc -26214400.0000 26214399.9878 /end CHARACTERISTIC
/begin CHARACTERISTIC PCR_I3OfsCalc.WinNeg_C "/" VALUE 0x80054C5C Kw_Ws32 52428799.9878 Prc -26214400.0000 26214399.9878 /end CHARACTERISTIC
/begin CHARACTERISTIC PCR_I4OfsCalc.Ki_C "/" VALUE 0x80054C60 Kw_Ws32 1999999.99953 Ki -1000000.00000 999999.999534 FORMAT "%13.5" /end CHARACTERISTIC
/begin CHARACTERISTIC PCR_I4OfsCalc.KiPos_C "/" VALUE 0x80054C64 Kw_Ws32 1999999.99953 Ki -1000000.00000 999999.999534 FORMAT "%13.5" /end CHARACTERISTIC
/begin CHARACTERISTIC PCR_I4OfsCalc.KiNeg_C "/" VALUE 0x80054C68 Kw_Ws32 1999999.99953 Ki -1000000.00000 999999.999534 FORMAT "%13.5" /end CHARACTERISTIC
/begin CHARACTERISTIC PCR_I4OfsCalc.WinPos_C "/" VALUE 0x80054C6C Kw_Ws32 52428799.9878 Prc -26214400.0000 26214399.9878 /end CHARACTERISTIC
/begin CHARACTERISTIC PCR_I4OfsCalc.WinNeg_C "/" VALUE 0x80054C70 Kw_Ws32 52428799.9878 Prc -26214400.0000 26214399.9878 /end CHARACTERISTIC
/begin CHARACTERISTIC PCR_IWinLP.Ki_C "/" VALUE 0x80054728 Kw_Ws32 24414.0624943 Ki_Pres_hPa2Prc -12207.0312500 12207.0312443 FORMAT "%13.7" /end CHARACTERISTIC
/begin CHARACTERISTIC PCR_IWinLP.KiPos_C "/" VALUE 0x8005472C Kw_Ws32 24414.0624943 Ki_Pres_hPa2Prc -12207.0312500 12207.0312443 FORMAT "%13.7" /end CHARACTERISTIC
/begin CHARACTERISTIC PCR_IWinLP.KiNeg_C "/" VALUE 0x80054730 Kw_Ws32 24414.0624943 Ki_Pres_hPa2Prc -12207.0312500 12207.0312443 FORMAT "%13.7" /end CHARACTERISTIC
/begin CHARACTERISTIC PCR_IWinLP.WinPos_C "/" VALUE 0x80054734 Kw_Ws32 2147487148.00 Pres_hPa -2147483648.00 3500.00 EXTENDED_LIMITS -2147483648.00 2147483647.00 /end CHARACTERISTIC
/begin CHARACTERISTIC PCR_IWinLP.WinNeg_C "/" VALUE 0x80054738 Kw_Ws32 2147487148.00 Pres_hPa -2147483648.00 3500.00 EXTENDED_LIMITS -2147483648.00 2147483647.00 /end CHARACTERISTIC
/begin CHARACTERISTIC PCR_LPWrkSph2_C "" VALUE 0x80054B4E Val_Ws16 327.6700 InjMass 0.00 327.6700 EXTENDED_LIMITS -327.6800 327.6700 /end CHARACTERISTIC
/begin CHARACTERISTIC PCR_LPWrkSph3_C "" VALUE 0x80054B50 Val_Ws16 327.6700 InjMass 0.00 327.6700 EXTENDED_LIMITS -327.6800 327.6700 /end CHARACTERISTIC
/begin CHARACTERISTIC PCR_mskOfsCalcNoRls_C "" VALUE 0x80054C74 Val_Wu16 65535.00 OneToOne 0.00 65535.00 /end CHARACTERISTIC
/begin CHARACTERISTIC PCR_mskOfsCalcResetVal_C "" VALUE 0x80054C76 Val_Wu16 65535.00 OneToOne 0.00 65535.00 /end CHARACTERISTIC
/begin CHARACTERISTIC PCR_mskOfsCalcRlsPCRCond_C "Maske für Auswahl der relevanten Bits aus PCR_stPCRBits" VALUE 0x80054C78 Val_Wu32 65535.0000000 OneToOne 0.00 65535.0000000 EXTENDED_LIMITS 0.00 4294967295.00 /end CHARACTERISTIC
/begin CHARACTERISTIC PCR_mskOfsCalcStopLearn_C "" VALUE 0x80054C7C Val_Wu16 65535.00 OneToOne 0.00 65535.00 /end CHARACTERISTIC
/begin CHARACTERISTIC PCR_nCldStrtMax_C "Obere Drehzahlschwelle für die Abschaltung der Ladedruckregelung bei Kaltstart" VALUE 0x800549B4 Val_Ws16 8000.000 EngN1 0.00 8000.000 FORMAT "%8.3" EXTENDED_LIMITS -16384.00 16383.50 /end CHARACTERISTIC
/begin CHARACTERISTIC PCR_nCldStrtMin_C "Untere Drehzahlschwelle für die Abschaltung der Ladedruckregelung bei Kaltstart" VALUE 0x800549B6 Val_Ws16 8000.000 EngN1 0.00 8000.000 FORMAT "%8.3" EXTENDED_LIMITS -16384.00 16383.50 /end CHARACTERISTIC
/begin CHARACTERISTIC PCR_nLPWrkSph2_C "obere Drehzahlgrenze des Arbeitsbereiches 2(LP)" VALUE 0x80054B52 Val_Ws16 8000.000 EngN1 0.00 8000.000 FORMAT "%8.3" EXTENDED_LIMITS -16384.00 16383.50 /end CHARACTERISTIC
/begin CHARACTERISTIC PCR_nLPWrkSph3_C "obere Drehzahlgrenze des Arbeitsbereiches 3(LP)" VALUE 0x80054B54 Val_Ws16 8000.000 EngN1 0.00 8000.000 FORMAT "%8.3" EXTENDED_LIMITS -16384.00 16383.50 /end CHARACTERISTIC
/begin CHARACTERISTIC PCR_nOfsCalc1_C "" VALUE 0x80054C7E Val_Ws16 6000.000 EngN 0.00 6000.000 EXTENDED_LIMITS -16384.00 16383.50 /end CHARACTERISTIC
/begin CHARACTERISTIC PCR_nOfsCalc2_C "" VALUE 0x80054C80 Val_Ws16 6000.000 EngN 0.00 6000.000 EXTENDED_LIMITS -16384.00 16383.50 /end CHARACTERISTIC
/begin CHARACTERISTIC PCR_nOfsCalcRlsMax_C "" VALUE 0x80054C82 Val_Ws16 6000.000 EngN 0.00 6000.000 EXTENDED_LIMITS -16384.00 16383.50 /end CHARACTERISTIC
/begin CHARACTERISTIC PCR_nOfsCalcRlsMin_C "" VALUE 0x80054C84 Val_Ws16 6000.000 EngN 0.00 6000.000 EXTENDED_LIMITS -16384.00 16383.50 /end CHARACTERISTIC
/begin CHARACTERISTIC PCR_numAirTempOfsCalc_C "Auswahl LuftTemperaturArray PCR_OfsCalc" VALUE 0x80054C86 Val_Wu8 255.0 OneToOne 0.00 255.0 /end CHARACTERISTIC
/begin CHARACTERISTIC PCR_numEngTempMon_C "Index zur Auswahl der Motortemperatur für die Überwachung der Ladedruckregelung" VALUE 0x800549B8 Val_Wu8 2.00000000000 EngTempFldSel 0.00 2.00000000000 FORMAT "%13.11" EXTENDED_LIMITS 0.00 3.00000000000 /end CHARACTERISTIC
/begin CHARACTERISTIC PCR_numEngTempOfsCalc_C "Auswahl MotorTemperaturArray PCR_OfsCalc" VALUE 0x80054C87 Val_Wu8 255.0 OneToOne 0.00 255.0 /end CHARACTERISTIC
/begin CHARACTERISTIC PCR_nWrkSph1_C "obere Drehzahlgrenze des Arbeitsbereiches 1" VALUE 0x800549BA Val_Ws16 8000.000 EngN1 0.00 8000.000 FORMAT "%8.3" EXTENDED_LIMITS -16384.00 16383.50 /end CHARACTERISTIC
/begin CHARACTERISTIC PCR_nWrkSph2_C "Drehzahlgrenze zwischen den Arbeitsbereichen 2 und 3" VALUE 0x800549BC Val_Ws16 8000.000 EngN1 0.00 8000.000 FORMAT "%8.3" EXTENDED_LIMITS -16384.00 16383.50 /end CHARACTERISTIC
/begin CHARACTERISTIC PCR_nWrkSph3_C "Drehzahlgrenze zwischen den Arbeitsbereichen 3 und 4" VALUE 0x800549BE Val_Ws16 8000.000 EngN1 0.00 8000.000 FORMAT "%8.3" EXTENDED_LIMITS -16384.00 16383.50 /end CHARACTERISTIC
/begin CHARACTERISTIC PCR_OfsCalcQCtlDT1.T1_C "/" VALUE 0x80054C88 Kw_Ws32 4294.9672940 TimeDelay_s 0.000002000000001 4294.9672960 FORMAT "%12.7" /end CHARACTERISTIC
/begin CHARACTERISTIC PCR_OfsCalcQCtlDT1.Kd_C "/" VALUE 0x80054C8C Kw_Ws32 65535.9999847 Kd -32768.0000000 32767.9999847 FORMAT "%13.7" /end CHARACTERISTIC
/begin CHARACTERISTIC PCR_pBstOfsRlsLim_C "Grenze Ladedruck für Freigabe adaptiver Vorsteuerwert" VALUE 0x80054C90 Val_Ws16 3500.000 Pres_hPa 0.00 3500.000 EXTENDED_LIMITS -32768.00 32767.00 /end CHARACTERISTIC
/begin CHARACTERISTIC PCR_pDesValRelOfs_C "" VALUE 0x800549C0 Kw_Ws16 3500.000 Pres_hPa 0.00 3500.000 EXTENDED_LIMITS -32768.00 32767.00 /end CHARACTERISTIC
/begin CHARACTERISTIC PCR_pEnvOfsCalcMax_C "" VALUE 0x80054C92 Val_Ws16 3500.000 Pres_hPa 0.00 3500.000 EXTENDED_LIMITS -32768.00 32767.00 /end CHARACTERISTIC
/begin CHARACTERISTIC PCR_pEnvOfsCalcMin_C "" VALUE 0x80054C94 Val_Ws16 3500.000 Pres_hPa 0.00 3500.000 EXTENDED_LIMITS -32768.00 32767.00 /end CHARACTERISTIC
/begin CHARACTERISTIC PCR_pGovDvtOfsRlsMin_C "untere Regelabweichungsgrenze für die Freigabe des Offset-Lernens" VALUE 0x80054C96 Val_Ws16 3500.000 Pres_hPa 0.00 3500.000 EXTENDED_LIMITS -32768.00 32767.00 /end CHARACTERISTIC
/begin CHARACTERISTIC PCR_pMaxDvtLP_MAP "" MAP 0x80054B56 Map_Xs16Ys16Ws16 3500.0000 Pres_hPa 0.00 3500.0000 EXTENDED_LIMITS -32768.00 32767.00
 /begin AXIS_DESCR STD_AXIS Epm_nEng EngN 4 0.00 6000.000 EXTENDED_LIMITS -16384.00 16383.50 DEPOSIT ABSOLUTE /end AXIS_DESCR
 /begin AXIS_DESCR STD_AXIS PCR_qMonLP_mp InjMass 4 0.00 327.6700 EXTENDED_LIMITS -327.6800 327.6700 DEPOSIT ABSOLUTE /end AXIS_DESCR
/end CHARACTERISTIC
/begin CHARACTERISTIC PCR_pMaxDvt_MAP "Kennfeld für die obere Grenze zur Erkennung einer bleibenden Regelabweichung" MAP 0x800549C2 Map_Xs16Ys16Ws16 3500.0000 Pres_hPa 0.00 3500.0000 EXTENDED_LIMITS -32768.00 32767.00
 /begin AXIS_DESCR STD_AXIS Epm_nEng EngN 6 0.00 6000.000 EXTENDED_LIMITS -16384.00 16383.50 DEPOSIT ABSOLUTE /end AXIS_DESCR
 /begin AXIS_DESCR STD_AXIS PCR_qMon_mp InjMass 6 0.00 327.6700 EXTENDED_LIMITS -327.6800 327.6700 DEPOSIT ABSOLUTE /end AXIS_DESCR
/end CHARACTERISTIC
/begin CHARACTERISTIC PCR_pMinDvtLP_MAP "" MAP 0x80054B8A Map_Xs16Ys16Ws16 3630.0000 Pres_hPa -130.0000 3500.0000 EXTENDED_LIMITS -32768.00 32767.00
 /begin AXIS_DESCR STD_AXIS Epm_nEng EngN 4 0.00 6000.000 EXTENDED_LIMITS -16384.00 16383.50 DEPOSIT ABSOLUTE /end AXIS_DESCR
 /begin AXIS_DESCR STD_AXIS PCR_qMonLP_mp InjMass 4 0.00 327.6700 EXTENDED_LIMITS -327.6800 327.6700 DEPOSIT ABSOLUTE /end AXIS_DESCR
/end CHARACTERISTIC
/begin CHARACTERISTIC PCR_pMinDvt_MAP "Kennfeld für die untere Grenze zur Erkennung einer bleibenden Regelabweichung" MAP 0x80054A26 Map_Xs16Ys16Ws16 3630.0000 Pres_hPa -130.0000 3500.0000 EXTENDED_LIMITS -32768.00 32767.00
 /begin AXIS_DESCR STD_AXIS Epm_nEng EngN 6 0.00 6000.000 EXTENDED_LIMITS -16384.00 16383.50 DEPOSIT ABSOLUTE /end AXIS_DESCR
 /begin AXIS_DESCR STD_AXIS PCR_qMon_mp InjMass 6 0.00 327.6700 EXTENDED_LIMITS -327.6800 327.6700 DEPOSIT ABSOLUTE /end AXIS_DESCR
/end CHARACTERISTIC
/begin CHARACTERISTIC PCR_pTransLPMax_C "" VALUE 0x80054BBE Val_Ws16 36268.00 Pres_hPa -32768.00 3500.00 EXTENDED_LIMITS -32768.00 32767.00 /end CHARACTERISTIC
/begin CHARACTERISTIC PCR_pTransLPMin_C "" VALUE 0x80054BC0 Val_Ws16 36268.00 Pres_hPa -32768.00 3500.00 EXTENDED_LIMITS -32768.00 32767.00 /end CHARACTERISTIC
/begin CHARACTERISTIC PCR_pTransMax_C "obere Schwelle der Absoluten Regelabweichung zur Transient-Erkennung" VALUE 0x80054A8A Val_Ws16 36268.00 Pres_hPa -32768.00 3500.00 EXTENDED_LIMITS -32768.00 32767.00 /end CHARACTERISTIC
/begin CHARACTERISTIC PCR_pTransMin_C "untere Schwelle der Absoluten Regelabweichung zur Transient-Erkennung" VALUE 0x80054A8C Val_Ws16 36268.00 Pres_hPa -32768.00 3500.00 EXTENDED_LIMITS -32768.00 32767.00 /end CHARACTERISTIC
/begin CHARACTERISTIC PCR_PWinLP.Kp_C "/" VALUE 0x8005473C Kw_Ws32 1599.99999963 Kp_Pres_hPa2Prc -800.000000000 799.999999627 FORMAT "%13.9" /end CHARACTERISTIC
/begin CHARACTERISTIC PCR_PWinLP.KpPos_C "/" VALUE 0x80054740 Kw_Ws32 1599.99999963 Kp_Pres_hPa2Prc -800.000000000 799.999999627 FORMAT "%13.9" /end CHARACTERISTIC
/begin CHARACTERISTIC PCR_PWinLP.KpNeg_C "/" VALUE 0x80054744 Kw_Ws32 1599.99999963 Kp_Pres_hPa2Prc -800.000000000 799.999999627 FORMAT "%13.9" /end CHARACTERISTIC
/begin CHARACTERISTIC PCR_PWinLP.WinPos_C "/" VALUE 0x80054748 Kw_Ws32 2147487148.00 Pres_hPa -2147483648.00 3500.00 EXTENDED_LIMITS -2147483648.00 2147483647.00 /end CHARACTERISTIC
/begin CHARACTERISTIC PCR_PWinLP.WinNeg_C "/" VALUE 0x8005474C Kw_Ws32 2147487148.00 Pres_hPa -2147483648.00 3500.00 EXTENDED_LIMITS -2147483648.00 2147483647.00 /end CHARACTERISTIC
/begin CHARACTERISTIC PCR_qClthThres_CUR "" CURVE 0x80054A8E Cur_Xs16Ws16 100.0000 InjMass 0.00 100.0000 EXTENDED_LIMITS -327.6800 327.6700
 /begin AXIS_DESCR STD_AXIS Epm_nEng EngN 6 0.00 10000.00 EXTENDED_LIMITS -16384.00 16383.50 DEPOSIT ABSOLUTE /end AXIS_DESCR
/end CHARACTERISTIC
/begin CHARACTERISTIC PCR_qLeadDiffLim_C "" VALUE 0x80054AA8 Kw_Ws16 327.6700 InjMass 0.00 327.6700 EXTENDED_LIMITS -327.6800 327.6700 /end CHARACTERISTIC
/begin CHARACTERISTIC PCR_qOfsCalc1_C "" VALUE 0x80054C98 Val_Ws16 327.6700 InjMassCyc 0.00 327.6700 EXTENDED_LIMITS -327.6800 327.6700 /end CHARACTERISTIC
/begin CHARACTERISTIC PCR_qOfsCalc2_C "" VALUE 0x80054C9A Val_Ws16 327.6700 InjMassCyc 0.00 327.6700 EXTENDED_LIMITS -327.6800 327.6700 /end CHARACTERISTIC
/begin CHARACTERISTIC PCR_qOfsCalcRlsMax_C "" VALUE 0x80054C9C Val_Ws16 327.6700 InjMassCyc 0.00 327.6700 EXTENDED_LIMITS -327.6800 327.6700 /end CHARACTERISTIC
/begin CHARACTERISTIC PCR_qOfsCalcRlsMin_C "" VALUE 0x80054C9E Val_Ws16 327.6700 InjMassCyc 0.00 327.6700 EXTENDED_LIMITS -327.6800 327.6700 /end CHARACTERISTIC
/begin CHARACTERISTIC PCR_rDflValLP_CA "" VAL_BLK 0x80054BC2 ValA_Ws16 799.9878 Prc -400.0000 399.9878 NUMBER 17 /end CHARACTERISTIC
/begin CHARACTERISTIC PCR_rDflVal_CA "Vorgabewerte für Abschaltfälle der Ladedruckregelung" VAL_BLK 0x80054AAA ValA_Ws16 799.9878 Prc -400.0000 399.9878 NUMBER 17 /end CHARACTERISTIC
/begin CHARACTERISTIC PCR_rDistOfsCalc1_C "" VALUE 0x80054CA0 Val_Ws16 100.0000 Prc 0.00 100.0000 EXTENDED_LIMITS -400.0000 399.9878 /end CHARACTERISTIC
/begin CHARACTERISTIC PCR_rDistOfsCalc2_C "" VALUE 0x80054CA2 Val_Ws16 100.0000 Prc 0.00 100.0000 EXTENDED_LIMITS -400.0000 399.9878 /end CHARACTERISTIC
/begin CHARACTERISTIC PCR_rDistOfsCalc3_C "" VALUE 0x80054CA4 Val_Ws16 100.0000 Prc 0.00 100.0000 EXTENDED_LIMITS -400.0000 399.9878 /end CHARACTERISTIC
/begin CHARACTERISTIC PCR_rDistOfsCalc4_C "" VALUE 0x80054CA6 Val_Ws16 100.0000 Prc 0.00 100.0000 EXTENDED_LIMITS -400.0000 399.9878 /end CHARACTERISTIC
/begin CHARACTERISTIC PCR_RelAbsLP.xVal_C "/" VALUE 0x80054750 Kw_Wu8 1.000 OneToOne 0.00 1.000 EXTENDED_LIMITS 0.00 255.0 /end CHARACTERISTIC
/begin CHARACTERISTIC PCR_RelAbsLP.xTyp_C "/" VALUE 0x80054751 Kw_Wu8 1.000 OneToOne 1.000 2.000 EXTENDED_LIMITS 0.00 255.0 /end CHARACTERISTIC
/begin CHARACTERISTIC PCR_rGovLPMax_MAP "" MAP 0x80054752 Map_Xs16Ys16Ws16 300.0000 Prc -100.0000 200.0000 EXTENDED_LIMITS -400.0000 399.9878
 /begin AXIS_DESCR STD_AXIS Epm_nEng EngN 12 0.00 8000.000 EXTENDED_LIMITS -16384.00 16383.50 DEPOSIT ABSOLUTE /end AXIS_DESCR
 /begin AXIS_DESCR STD_AXIS PCR_qGovLP_mp InjMass 12 0.00 327.6700 EXTENDED_LIMITS -327.6800 327.6700 DEPOSIT ABSOLUTE /end AXIS_DESCR
/end CHARACTERISTIC
/begin CHARACTERISTIC PCR_rGovLPMin_MAP "" MAP 0x800548A6 Map_Xs16Ys16Ws16 300.0000 Prc -100.0000 200.0000 EXTENDED_LIMITS -400.0000 399.9878
 /begin AXIS_DESCR STD_AXIS Epm_nEng EngN 6 0.00 8000.000 EXTENDED_LIMITS -16384.00 16383.50 DEPOSIT ABSOLUTE /end AXIS_DESCR
 /begin AXIS_DESCR STD_AXIS PCR_qGovLP_mp InjMass 6 0.00 327.6700 EXTENDED_LIMITS -327.6800 327.6700 DEPOSIT ABSOLUTE /end AXIS_DESCR
/end CHARACTERISTIC
/begin CHARACTERISTIC PCR_rOfsRlsMax_MAP "" MAP 0x80054CA8 Map_Xs16Ys16Ws16 100.0000 Prc 0.00 100.0000 EXTENDED_LIMITS -400.0000 399.9878
 /begin AXIS_DESCR STD_AXIS Epm_nEng EngN 6 0.00 6000.000 EXTENDED_LIMITS -16384.00 16383.50 DEPOSIT ABSOLUTE /end AXIS_DESCR
 /begin AXIS_DESCR STD_AXIS PCR_qCtlVal InjMass 6 0.00 100.0000 EXTENDED_LIMITS -327.6800 327.6700 DEPOSIT ABSOLUTE /end AXIS_DESCR
/end CHARACTERISTIC
/begin CHARACTERISTIC PCR_rOfsRlsMin_MAP "" MAP 0x80054D0C Map_Xs16Ys16Ws16 100.0000 Prc 0.00 100.0000 EXTENDED_LIMITS -400.0000 399.9878
 /begin AXIS_DESCR STD_AXIS Epm_nEng EngN 6 0.00 6000.000 EXTENDED_LIMITS -16384.00 16383.50 DEPOSIT ABSOLUTE /end AXIS_DESCR
 /begin AXIS_DESCR STD_AXIS PCR_qCtlVal InjMass 6 0.00 100.0000 EXTENDED_LIMITS -327.6800 327.6700 DEPOSIT ABSOLUTE /end AXIS_DESCR
/end CHARACTERISTIC
/begin CHARACTERISTIC PCR_rOutIMaxLP_MAP "" MAP 0x8005490A Kf_Xs16_Ys16_Ws16 100.0000 Prc 0.00 100.0000 EXTENDED_LIMITS -400.0000 399.9878
 /begin AXIS_DESCR STD_AXIS Air_dpFltIntkVUs PreshPa_sec 4 -350000.0 350000.0 FORMAT "%8.1" EXTENDED_LIMITS -32768.00 32767.00 DEPOSIT ABSOLUTE /end AXIS_DESCR
 /begin AXIS_DESCR STD_AXIS PCR_qGov InjMass 4 0.00 200.0000 EXTENDED_LIMITS -327.6800 327.6700 DEPOSIT ABSOLUTE /end AXIS_DESCR
/end CHARACTERISTIC
/begin CHARACTERISTIC PCR_rOutIMinLP_MAP "" MAP 0x8005493E Kf_Xs16_Ys16_Ws16 100.0000 Prc 0.00 100.0000 EXTENDED_LIMITS -400.0000 399.9878
 /begin AXIS_DESCR STD_AXIS Air_dpFltIntkVUs PreshPa_sec 4 -350000.0 350000.0 FORMAT "%8.1" EXTENDED_LIMITS -32768.00 32767.00 DEPOSIT ABSOLUTE /end AXIS_DESCR
 /begin AXIS_DESCR STD_AXIS PCR_qGov InjMass 4 0.00 200.0000 EXTENDED_LIMITS -327.6800 327.6700 DEPOSIT ABSOLUTE /end AXIS_DESCR
/end CHARACTERISTIC
/begin CHARACTERISTIC PCR_stBitMskEOMLP_CA "" VAL_BLK 0x80054BE4 ValA_Wu32 4294967295.00 OneToOne 0.00 4294967295.00 NUMBER 3 /end CHARACTERISTIC
/begin CHARACTERISTIC PCR_stBitMskEOM_CA "Bitmaske zur Auswahl der relevanten Abschaltfälle für die gewählte Betriebsart" VAL_BLK 0x80054ACC ValA_Wu32 4294967295.00 OneToOne 0.00 4294967295.00 NUMBER 3 /end CHARACTERISTIC
/begin CHARACTERISTIC PCR_stMonEOMMsk_CA "Bitmaske zur Umschaltung zwischen normaler Maskierung und Maskierung des Regenerationsbetriebs" VAL_BLK 0x80054AD8 ValA_Wu32 4294967295.00 OneToOne 0.00 4294967295.00 NUMBER 3 /end CHARACTERISTIC
/begin CHARACTERISTIC PCR_stMonLPEOMMsk_CA "" VAL_BLK 0x80054BF0 ValA_Wu32 4294967295.00 OneToOne 0.00 4294967295.00 NUMBER 3 /end CHARACTERISTIC
/begin CHARACTERISTIC PCR_stMskGovOffEOMLP_C "" VALUE 0x80054974 Val_Wu32 4294967295.00 OneToOne 0.00 4294967295.00 /end CHARACTERISTIC
/begin CHARACTERISTIC PCR_stMskOfsCalc_C "" VALUE 0x80054D70 Kw_Wu32 4294967295.00 OneToOne 0.00 4294967295.00 /end CHARACTERISTIC
/begin CHARACTERISTIC PCR_stOfsCalcReset_C "" VALUE 0x80054D74 Val_Wu8 255.0 OneToOne 0.00 255.0 /end CHARACTERISTIC
/begin CHARACTERISTIC PCR_stPrioMonLP_CA "" VAL_BLK 0x80054BFC ValA_Ws16 65535.00 OneToOne -32768.00 32767.00 NUMBER 8 /end CHARACTERISTIC
/begin CHARACTERISTIC PCR_stPrioMon_CA "Prioritäten der Abschlatfälle" VAL_BLK 0x80054AE4 ValA_Ws16 65535.00 OneToOne -32768.00 32767.00 NUMBER 17 /end CHARACTERISTIC
/begin CHARACTERISTIC PCR_swtMonDvtExtActv_C "" VALUE 0x80054B06 Kw_Wu8 1.000 OneToOne 0.00 1.000 EXTENDED_LIMITS 0.00 255.0 /end CHARACTERISTIC
/begin CHARACTERISTIC PCR_swtOfsCalcBst_C "Umschaltung für Schwelle zur Erhöhung oder Verringerung des Ladedrucks abhängig von PCR_rCtlValOfs" VALUE 0x80054D75 Val_Wu8 2.000 OneToOne 0.00 2.000 EXTENDED_LIMITS 0.00 255.0 /end CHARACTERISTIC
/begin CHARACTERISTIC PCR_swtOfsCalcOn_C "Schalter zur Aktivierung des Offset-Lernens" VALUE 0x80054D76 Val_Wu8 1.000 OneToOne 0.00 1.000 EXTENDED_LIMITS 0.00 255.0 /end CHARACTERISTIC
/begin CHARACTERISTIC PCR_swtRelAbsValMon_C "" VALUE 0x80054B07 Kw_Wu8 1.000 OneToOne 0.00 1.000 EXTENDED_LIMITS 0.00 255.0 /end CHARACTERISTIC
/begin CHARACTERISTIC PCR_tAirOfsCalcMax_C "" VALUE 0x80054D78 Val_Ws16 200.0000 Temp_Cels -0.04000000 199.9600 EXTENDED_LIMITS -3549.940 3003.560 /end CHARACTERISTIC
/begin CHARACTERISTIC PCR_tAirOfsCalcMin_C "" VALUE 0x80054D7A Val_Ws16 200.0000 Temp_Cels -0.04000000 199.9600 EXTENDED_LIMITS -3549.940 3003.560 /end CHARACTERISTIC
/begin CHARACTERISTIC PCR_tClntOfsCalcLim_C "" VALUE 0x80054D7C Val_Ws16 200.0000 Temp_Cels -0.04000000 199.9600 EXTENDED_LIMITS -3549.940 3003.560 /end CHARACTERISTIC
/begin CHARACTERISTIC PCR_tiCldStrt_CUR "Kennlinie für die Zeit, die die Regelung nach Startabwurf abgeschaltet bleibt" CURVE 0x80054B08 Cur_Xs16Ws16 33000.00 Time_ms 0.00 33000.00 EXTENDED_LIMITS -327680.0 327670.0
 /begin AXIS_DESCR STD_AXIS PCR_tEngMon_mp Temp_Cels 6 -100.1400 199.8600 EXTENDED_LIMITS -3549.940 3003.560 DEPOSIT ABSOLUTE /end AXIS_DESCR
/end CHARACTERISTIC
/begin CHARACTERISTIC PCR_tiClthLP_C "" VALUE 0x80054C0C Val_Wu16 655350.0 TimeDeb 0.00 655350.0 /end CHARACTERISTIC
/begin CHARACTERISTIC PCR_tiClth_C "Aktivierungszeit für Kupplungserkennung" VALUE 0x80054B22 Val_Wu16 655350.0 TimeDeb 0.00 655350.0 /end CHARACTERISTIC
/begin CHARACTERISTIC PCR_tiDesMonDeb.tiHiLo_C "/" VALUE 0x80054B24 Kw_Ws16 655350.0 TimeDeb -327680.0 327670.0 /end CHARACTERISTIC
/begin CHARACTERISTIC PCR_tiDesMonDeb.tiLoHi_C "/" VALUE 0x80054B26 Kw_Ws16 655350.0 TimeDeb -327680.0 327670.0 /end CHARACTERISTIC
/begin CHARACTERISTIC PCR_tiGovOffDelLP_CUR "" CURVE 0x80054978 Cur_Xs16Ws16 20.00000 Time_s 0.00 20.00000 EXTENDED_LIMITS -327.6800 327.6700
 /begin AXIS_DESCR STD_AXIS Epm_nEng EngN 4 0.00 8000.000 EXTENDED_LIMITS -16384.00 16383.50 DEPOSIT ABSOLUTE /end AXIS_DESCR
/end CHARACTERISTIC
/begin CHARACTERISTIC PCR_tiMonEOM_CA "Zeitverzögerung zur Umschaltung zwischen normaler Maskierung und Maskierung des Regenerationsbetriebs" VAL_BLK 0x80054B28 ValA_Ws16 655350.0 TimeDeb -327680.0 327670.0 NUMBER 3 /end CHARACTERISTIC
/begin CHARACTERISTIC PCR_tiMonLPEOM_CA "" VAL_BLK 0x80054C0E ValA_Ws16 655350.0 TimeDeb -327680.0 327670.0 NUMBER 3 /end CHARACTERISTIC
/begin CHARACTERISTIC PCR_tiOfsCalcPT1_C "Filterung Drehzahlgradient" VALUE 0x80054D80 Val_Ws32 4294.8272945 TimeDelay_s 0.14000154169 4294.9672960 FORMAT "%12.7" EXTENDED_LIMITS 0.000002000000001 4294.9672960 /end CHARACTERISTIC
/begin CHARACTERISTIC PCR_tiOfsCalcRelStatAll.tiHiLo_C "/" VALUE 0x80054D84 Kw_Ws16 655350.0 TimeDeb -327680.0 327670.0 /end CHARACTERISTIC
/begin CHARACTERISTIC PCR_tiOfsCalcRelStatAll.tiLoHi_C "/" VALUE 0x80054D86 Kw_Ws16 655350.0 TimeDeb -327680.0 327670.0 /end CHARACTERISTIC
/begin CHARACTERISTIC PCR_tiOfsCalcRlsStat3.tiHiLo_C "/" VALUE 0x80054D88 Kw_Ws16 655350.0 TimeDeb -327680.0 327670.0 /end CHARACTERISTIC
/begin CHARACTERISTIC PCR_tiOfsCalcRlsStat3.tiLoHi_C "/" VALUE 0x80054D8A Kw_Ws16 655350.0 TimeDeb -327680.0 327670.0 /end CHARACTERISTIC
/begin CHARACTERISTIC PCR_tiPT1LP_C "" VALUE 0x8005498C Val_Ws32 4294.9662960 TimeDelay_s 0.0010000000689 4294.9672960 FORMAT "%12.7" EXTENDED_LIMITS 0.000002000000001 4294.9672960 /end CHARACTERISTIC
/begin CHARACTERISTIC PCR_tiRmp2LP_C "" VALUE 0x80054990 Val_Ws32 65.535999984741210 TimeCoEOMRmp 0.000000015258789 65.536000000000001 FORMAT "%19.16" EXTENDED_LIMITS 0.000000030517578 65.536000000000001 /end CHARACTERISTIC
/begin CHARACTERISTIC PCR_tiRmpLP_C "" VALUE 0x80054994 Val_Wu32 65.535999984741210 TimeCoEOMRmp 0.000000015258789 65.536000000000001 FORMAT "%19.16" /end CHARACTERISTIC
/begin CHARACTERISTIC PCR_vClthLP_C "" VALUE 0x80054C14 Val_Ws16 300.0000 Vel 0.00 300.0000 EXTENDED_LIMITS -327.6800 327.6700 /end CHARACTERISTIC
/begin CHARACTERISTIC PCR_vClth_C "" VALUE 0x80054B2E Val_Ws16 300.0000 OneToOne 0.00 300.0000 EXTENDED_LIMITS -32768.00 32767.00 /end CHARACTERISTIC
/begin CHARACTERISTIC PCR_WrkSph2_C "Obere Grenze der Einspritzmenge bzw. innerem Drehmoment des Arbeitsbereiches 2" VALUE 0x80054B30 Val_Ws16 327.6700 InjMass 0.00 327.6700 EXTENDED_LIMITS -327.6800 327.6700 /end CHARACTERISTIC
/begin CHARACTERISTIC PCR_WrkSph3_C "Obere Grenze der Einspritzmenge bzw. innerem Drehmoment des Arbeitsbereiches 3" VALUE 0x80054B32 Val_Ws16 327.6700 InjMass 0.00 327.6700 EXTENDED_LIMITS -327.6800 327.6700 /end CHARACTERISTIC
/begin CHARACTERISTIC PCV_CrntCtlDT1.T1_C "/" VALUE 0x80054E88 Kw_Ws32 4294.9672940 TimeDelay_s 0.000002000000001 4294.9672960 FORMAT "%12.7" /end CHARACTERISTIC
/begin CHARACTERISTIC PCV_CrntCtlDT1.Kd_C "/" VALUE 0x80054E8C Kw_Ws32 65535.9999847 Kd -32768.0000000 32767.9999847 FORMAT "%13.7" /end CHARACTERISTIC
/begin CHARACTERISTIC PCV_CrntCtlI.Ki_C "Klasse für Parameter I-Glied/" VALUE 0x80054ED0 Kw_Ws32 244.140624943 Ki_curr2fact -122.070312500 122.070312443 FORMAT "%13.9" /end CHARACTERISTIC
/begin CHARACTERISTIC PCV_CrntCtlI.KiPos_C "Klasse für Parameter I-Glied/" VALUE 0x80054ED4 Kw_Ws32 244.140624943 Ki_curr2fact -122.070312500 122.070312443 FORMAT "%13.9" /end CHARACTERISTIC
/begin CHARACTERISTIC PCV_CrntCtlI.KiNeg_C "Klasse für Parameter I-Glied/" VALUE 0x80054ED8 Kw_Ws32 244.140624943 Ki_curr2fact -122.070312500 122.070312443 FORMAT "%13.9" /end CHARACTERISTIC
/begin CHARACTERISTIC PCV_CrntCtlI.WinPos_C "Klasse für Parameter I-Glied/" VALUE 0x80054EDC Kw_Ws32 4294967295.00 Curr -2147483648.00 2147483647.00 FORMAT "%13.2" /end CHARACTERISTIC
/begin CHARACTERISTIC PCV_CrntCtlI.WinNeg_C "Klasse für Parameter I-Glied/" VALUE 0x80054EE0 Kw_Ws32 4294967295.00 Curr -2147483648.00 2147483647.00 FORMAT "%13.2" /end CHARACTERISTIC
/begin CHARACTERISTIC PCV_diNoStrtRmpSlp_C "Rampenanstieg zur PCV Setpoint Stromerhöhung" VALUE 0x80054EE4 Val_Ws8 10000. RmpCurr 0.00 10000. FORMAT "%5.0" EXTENDED_LIMITS -12800. 12700. /end CHARACTERISTIC
/begin CHARACTERISTIC PCV_dvolLeak_CUR "Leckage des Druckregelventils" CURVE 0x80054F70 Cur_Xs16Ws16 150000.0 Qp_mm3_sec 0.00 150000.0 FORMAT "%8.1" EXTENDED_LIMITS -327680.0 327670.0
 /begin AXIS_DESCR STD_AXIS Rail_pSetPoint Pres_Rail 6 0.00 2000.000 EXTENDED_LIMITS -3276.800 3276.700 DEPOSIT ABSOLUTE /end AXIS_DESCR
/end CHARACTERISTIC
/begin CHARACTERISTIC PCV_dvolUpLim_CUR "Maximaler Durchfluss der Pumpe als Funktion der Drehzahl" CURVE 0x80054DE8 Cur_Xs16Ws16 655350.0 Qp_mm3_sec -327680.0 327670.0 FORMAT "%8.1"
 /begin AXIS_DESCR STD_AXIS Epm_nEng EngN 10 0.00 10000.00 EXTENDED_LIMITS -16384.00 16383.50 DEPOSIT ABSOLUTE /end AXIS_DESCR
/end CHARACTERISTIC
/begin CHARACTERISTIC PCV_facAdaptDiffI_C "Faktor der maximalen Abweichung zwischen Soll- und Iststrom durch das PCV, ab dem die Adaption durchgeführt wird" VALUE 0x80054E12 Val_Ws16 1.000000 Fact 0.00 1.000000 EXTENDED_LIMITS -4.000000 3.999878 /end CHARACTERISTIC
/begin CHARACTERISTIC PCV_facAdaptDiff_C "Faktor der maximalen Abweichung zwischen Railsoll- und Railistdruck, ab der die Adaption durchgeführt wird" VALUE 0x80054E14 Val_Ws16 1.000000 Fact 0.00 1.000000 EXTENDED_LIMITS -4.000000 3.999878 /end CHARACTERISTIC
/begin CHARACTERISTIC PCV_facAdaptFlowMin_C "Mindestwert für den Durchflusskorrektur-Faktor des PCV" VALUE 0x80054E16 Val_Ws16 20.00000 Fact 0.00 20.00000 EXTENDED_LIMITS -4.000000 3.999878 /end CHARACTERISTIC
/begin CHARACTERISTIC PCV_facAdaptFlow_MAP "Durchflusskorrektur-Faktor für die PCV-Kennlinie als Funktion vom Durchfluss durch das PCV und dem Raildruck" MAP 0x80054E18 Map_Xs16Ys16Ws16 7.999878 Fact -4.000000 3.999878
 /begin AXIS_DESCR STD_AXIS RailP_pFlt Pres_Rail 6 0.00 2000.000 EXTENDED_LIMITS -3276.800 3276.700 DEPOSIT ABSOLUTE /end AXIS_DESCR
 /begin AXIS_DESCR STD_AXIS PCV_dvolFlow_mp Qp_mm3_sec 4 -10000.00 50000.00 FORMAT "%8.2" EXTENDED_LIMITS -327680.0 327670.0 DEPOSIT ABSOLUTE /end AXIS_DESCR
/end CHARACTERISTIC
/begin CHARACTERISTIC PCV_facAdaptMax_C "Maximalwert des Adaptionsfaktors des PCV" VALUE 0x80054E60 Val_Ws16 2.000000 Fact 0.00 2.000000 EXTENDED_LIMITS -4.000000 3.999878 /end CHARACTERISTIC
/begin CHARACTERISTIC PCV_facAdaptMin_C "Minimalwert des Adaptionsfaktors des PCV" VALUE 0x80054E62 Val_Ws16 2.000000 Fact 0.00 2.000000 EXTENDED_LIMITS -4.000000 3.999878 /end CHARACTERISTIC
/begin CHARACTERISTIC PCV_facAdaptWgh_C "Gewichtungsfaktor für die Berechnung des Adaptionsfaktors des PCV" VALUE 0x80054E64 Val_Ws16 20.00000 Fact4 0.00 20.00000 FORMAT "%8.5" EXTENDED_LIMITS -1638.400 1638.350 /end CHARACTERISTIC
/begin CHARACTERISTIC PCV_facCrntCtlInit_CUR "Sollstrom bei elektrischer Abschaltung des Druckregelventils" CURVE 0x80054EE6 Cur_Xs16Ws16 2.000000 Fact 0.00 2.000000 EXTENDED_LIMITS -4.000000 3.999878
 /begin AXIS_DESCR STD_AXIS FuelT_tFlSys Temp_Cels 2 -50.14000 149.8600 EXTENDED_LIMITS -3549.940 3003.560 DEPOSIT ABSOLUTE /end AXIS_DESCR
/end CHARACTERISTIC
/begin CHARACTERISTIC PCV_facCrntCtlMax_C "Strom zum Schließen des Druckregelventils" VALUE 0x80054EF0 Val_Ws16 1.000000 Fact 1.000000 2.000000 EXTENDED_LIMITS -4.000000 3.999878 /end CHARACTERISTIC
/begin CHARACTERISTIC PCV_facCrntCtlMin_C "minimaler I-Anteil" VALUE 0x80054EF2 Val_Ws16 0.5000000 Fact 0.5000000 1.000000 EXTENDED_LIMITS -4.000000 3.999878 /end CHARACTERISTIC
/begin CHARACTERISTIC PCV_facWinActrTst_CUR "Kennlinie zur Ermittlung des Faktors zur Berechnung des zulässigen Druckbereichs abhängig vom PCV-Strom" CURVE 0x80054D8C Cur_Xs16Ws16 1.000000 Fact1 0.00 1.000000 EXTENDED_LIMITS -256.0000 255.9922
 /begin AXIS_DESCR STD_AXIS PCV_iActVal Curr 10 200.0000 2000.000 FORMAT "%8.3" EXTENDED_LIMITS -32768.00 32767.00 DEPOSIT ABSOLUTE /end AXIS_DESCR
/end CHARACTERISTIC
/begin CHARACTERISTIC PCV_iCnvPres_CUR "Kennlinie zur Umrechnung von Druck nach Strom" CURVE 0x80054EF4 Cur_Xs16Ws16 5000.000 Curr 0.00 5000.000 FORMAT "%8.3" EXTENDED_LIMITS -32768.00 32767.00
 /begin AXIS_DESCR STD_AXIS PCV_pSet Pres_Rail 10 0.00 2000.000 EXTENDED_LIMITS -3276.800 3276.700 DEPOSIT ABSOLUTE /end AXIS_DESCR
/end CHARACTERISTIC
/begin CHARACTERISTIC PCV_iLin_CUR "Analogeingang, Linearisierungskennlinie" CURVE 0x80054E90 Cur_Xs16Ws16 5000.000 Curr 0.00 5000.000 FORMAT "%8.3" EXTENDED_LIMITS -32768.00 32767.00
 /begin AXIS_DESCR STD_AXIS PCV_uRaw_mp Volt 2 0.00 5200.000 EXTENDED_LIMITS -6553.600 6553.400 DEPOSIT ABSOLUTE /end AXIS_DESCR
/end CHARACTERISTIC
/begin CHARACTERISTIC PCV_iSetClose_CUR "Sollstrom bei elektrischer Abschaltung des Druckregelventils" CURVE 0x80054F1E Cur_Xs16Ws16 5000.000 Curr 0.00 5000.000 FORMAT "%8.3" EXTENDED_LIMITS -32768.00 32767.00
 /begin AXIS_DESCR STD_AXIS FuelT_tFlSys Temp_Cels 8 -50.14000 149.8600 EXTENDED_LIMITS -3549.940 3003.560 DEPOSIT ABSOLUTE /end AXIS_DESCR
/end CHARACTERISTIC
/begin CHARACTERISTIC PCV_iSetMaxBattHi_C "reduzierter Maximalstrom für das Druckregelventil bei erhöhter Batteriespannung" VALUE 0x80054F40 Val_Ws16 5000.000 Curr 0.00 5000.000 FORMAT "%8.3" EXTENDED_LIMITS -32768.00 32767.00 /end CHARACTERISTIC
/begin CHARACTERISTIC PCV_iSetMax_C "maximaler Strom zum Schließen des Druckregelventils" VALUE 0x80054F42 Val_Ws16 5000.000 Curr 0.00 5000.000 FORMAT "%8.3" EXTENDED_LIMITS -32768.00 32767.00 /end CHARACTERISTIC
/begin CHARACTERISTIC PCV_iSetMinNoStrt_C "Sollwert des Druckregelventils im Falle eines unterbrochenen Starts" VALUE 0x80054F44 Val_Ws16 5000.000 Curr 0.00 5000.000 FORMAT "%8.3" EXTENDED_LIMITS -32768.00 32767.00 /end CHARACTERISTIC
/begin CHARACTERISTIC PCV_iSetMinStrStp_C "" VALUE 0x80054F46 Val_Ws16 500.0000 Curr 0.00 500.0000 FORMAT "%8.4" EXTENDED_LIMITS -32768.00 32767.00 /end CHARACTERISTIC
/begin CHARACTERISTIC PCV_iSetMin_C "Sollstrom bei elektrischer Abschaltung des Druckregelventils" VALUE 0x80054F48 Val_Ws16 5000.000 Curr 0.00 5000.000 FORMAT "%8.3" EXTENDED_LIMITS -32768.00 32767.00 /end CHARACTERISTIC
/begin CHARACTERISTIC PCV_nDiffMaxActrTst_C "maximal erlaubte Abweichung der Drehzahl" VALUE 0x80054DB6 Val_Ws16 300.0000 EngN 0.00 300.0000 EXTENDED_LIMITS -16384.00 16383.50 /end CHARACTERISTIC
/begin CHARACTERISTIC PCV_nSetActrTst_C "Sollwert für die Leerlaufdrehzahl" VALUE 0x80054DB8 Val_Ws16 10000.00 EngN 0.00 10000.00 EXTENDED_LIMITS -16384.00 16383.50 /end CHARACTERISTIC
/begin CHARACTERISTIC PCV_nSetClose_C "Drehzahlschwelle zum Verlassen des Modes PCV_stActrCtl == PCV_CLOSE_MODE (0x20)" VALUE 0x80054F4A Val_Ws16 10000.00 EngN 0.00 10000.00 EXTENDED_LIMITS -16384.00 16383.50 /end CHARACTERISTIC
/begin CHARACTERISTIC PCV_nStrStp_C "" VALUE 0x80054F4C Val_Ws16 10000.00 EngN 0.00 10000.00 EXTENDED_LIMITS -16384.00 16383.50 /end CHARACTERISTIC
/begin CHARACTERISTIC PCV_numAdaptSum_C "Anzahl der Funktionsaufrufe der PCV-Adaption im Zustand PCV_ADAPT_SUM_UP" VALUE 0x80054E66 Val_Wu16 20.00000 OneToOne 0.00 20.00000 EXTENDED_LIMITS 0.00 65535.00 /end CHARACTERISTIC
/begin CHARACTERISTIC PCV_numAdaptThres_C "Anzahl der Adaptionen, die bei beliebigem Raildruck durchgeführt werden" VALUE 0x80054E68 Val_Wu32 100.000000000 OneToOne 0.00 100.000000000 EXTENDED_LIMITS 0.00 4294967295.00 /end CHARACTERISTIC
/begin CHARACTERISTIC PCV_numAdapt_C "Anzahl der Funktionsaufrufe der PCV-Adaption im Zustand PCV_ADAPT_STABLE" VALUE 0x80054E6C Val_Wu16 100.0000 OneToOne 0.00 100.0000 EXTENDED_LIMITS 0.00 65535.00 /end CHARACTERISTIC
/begin CHARACTERISTIC PCV_numCalcAvrgActrTst_C "Anzahl der berücksichtigten Werte zur Startwerteberechnung" VALUE 0x80054DBA Val_Ws16 30.00000 OneToOne 0.00 30.00000 EXTENDED_LIMITS -32768.00 32767.00 /end CHARACTERISTIC
/begin CHARACTERISTIC PCV_numCycOffActrTst_C "Anzahl der Zyklen, für die das Tastverhältnis gehalten wird (Trigger ist ""low"")" VALUE 0x80054DBC Val_Wu8 255.0 OneToOne 0.00 255.0 /end CHARACTERISTIC
/begin CHARACTERISTIC PCV_numMaxErrActrTst_C "Schwelle für die Defekterkennung" VALUE 0x80054DBD Val_Wu8 255.0 OneToOne 0.00 255.0 /end CHARACTERISTIC
/begin CHARACTERISTIC PCV_numNoStrt_C "Schwellwert für die Anzahl an zulässigen Stromüberhöhungen bis die Fehlerprüfung gesetzt wird" VALUE 0x80054F4E Val_Wu8 255.0 OneToOne 0.00 255.0 /end CHARACTERISTIC
/begin CHARACTERISTIC PCV_numRepActrTst_C "Anzahl der Testwiederholungen (Iteration)" VALUE 0x80054DBE Val_Wu8 4.000 OneToOne 0.00 4.000 EXTENDED_LIMITS 0.00 255.0 /end CHARACTERISTIC
/begin CHARACTERISTIC PCV_pAdaptThresDec_C "Differenzdruck, um den die Druckschwelle reduziert wird, wenn die letzte Adaption zu lange zurück liegt" VALUE 0x80054E6E Val_Ws16 5276.800 Pres_Rail -3276.800 2000.000 EXTENDED_LIMITS -3276.800 3276.700 /end CHARACTERISTIC
/begin CHARACTERISTIC PCV_pAdaptThresMax_C "Maximaler Raildruck für die Adaptions-Freigabe" VALUE 0x80054E70 Val_Ws16 5276.800 Pres_Rail -3276.800 2000.000 EXTENDED_LIMITS -3276.800 3276.700 /end CHARACTERISTIC
/begin CHARACTERISTIC PCV_pAdaptThresMin_C "Minimaler Raildruck für die Adaptions-Freigabe" VALUE 0x80054E72 Val_Ws16 5276.800 Pres_Rail -3276.800 2000.000 EXTENDED_LIMITS -3276.800 3276.700 /end CHARACTERISTIC
/begin CHARACTERISTIC PCV_pAdaptThres_C "Maximaler Wert für die Druckschwelle, ab der die Adaption durchgeführt wird" VALUE 0x80054E74 Val_Ws16 5276.800 Pres_Rail -3276.800 2000.000 EXTENDED_LIMITS -3276.800 3276.700 /end CHARACTERISTIC
/begin CHARACTERISTIC PCV_pMaxActrTst_C "maximaler Druck für die Umschaltung der Hysterese" VALUE 0x80054DC0 Val_Ws16 2000.000 Pres_Rail 0.00 2000.000 EXTENDED_LIMITS -3276.800 3276.700 /end CHARACTERISTIC
/begin CHARACTERISTIC PCV_pMinActrTst_C "minimaler Druck für die Umschaltung der Hysterese" VALUE 0x80054DC2 Val_Ws16 1800.0000 Pres_Rail 200.0000 2000.0000 EXTENDED_LIMITS -3276.8000 3276.7000 /end CHARACTERISTIC
/begin CHARACTERISTIC PCV_pStrStpMin_C "" VALUE 0x80054F50 Val_Ws16 2000.0000000 Pres_Rail 0.00 2000.0000000 EXTENDED_LIMITS -3276.8000000 3276.7000000 /end CHARACTERISTIC
/begin CHARACTERISTIC PCV_pWinLoActrTst_C "Fenster für minimale Druckveränderung" VALUE 0x80054DC4 Val_Ws16 2000.00000 Pres_Rail 0.00 2000.00000 EXTENDED_LIMITS -3276.80000 3276.70000 /end CHARACTERISTIC
/begin CHARACTERISTIC PCV_Pwm.tiPer_C "Klasse für Parameter Ausgangstastverhältnis/" VALUE 0x80054E9A Kw_Ws16 9.900000 Period 0.1000000 10.00000 FORMAT "%8.5" EXTENDED_LIMITS -3276.800 3276.700 /end CHARACTERISTIC
/begin CHARACTERISTIC PCV_Pwm.stLvl_C "Klasse für Parameter Ausgangstastverhältnis/" VALUE 0x80054E9C Kw_Wu8 1.000 OneToOne 0.00 1.000 EXTENDED_LIMITS 0.00 255.0 /end CHARACTERISTIC
/begin CHARACTERISTIC PCV_Pwm.rMaxDty_C "Klasse für Parameter Ausgangstastverhältnis/" VALUE 0x80054E9E Kw_Ws16 100.0000 DtyCyc 0.00 100.0000 EXTENDED_LIMITS -327.6800 327.6700 /end CHARACTERISTIC
/begin CHARACTERISTIC PCV_Pwm.rPerUn_C "Klasse für Parameter Ausgangstastverhältnis/" VALUE 0x80054EA0 Kw_Ws16 32767.00 OneToOne 0.00 32767.00 EXTENDED_LIMITS -32768.00 32767.00 /end CHARACTERISTIC
/begin CHARACTERISTIC PCV_Pwm.tiPh_C "Klasse für Parameter Ausgangstastverhältnis/" VALUE 0x80054EA2 Kw_Ws16 3276.700 Period 0.00 3276.700 FORMAT "%8.3" EXTENDED_LIMITS -3276.800 3276.700 /end CHARACTERISTIC
/begin CHARACTERISTIC PCV_PwmOut.rMin_C "Klasse für Parameter Ausgangstastverhältnis/" VALUE 0x80054EA4 Kw_Ws16 100.0000 DtyCyc 0.00 100.0000 EXTENDED_LIMITS -327.6800 327.6700 /end CHARACTERISTIC
/begin CHARACTERISTIC PCV_PwmOut.rMax_C "Klasse für Parameter Ausgangstastverhältnis/" VALUE 0x80054EA6 Kw_Ws16 100.0000 DtyCyc 0.00 100.0000 EXTENDED_LIMITS -327.6800 327.6700 /end CHARACTERISTIC
/begin CHARACTERISTIC PCV_PwmOut.tiBtwTstSCB_C "Klasse für Parameter Ausgangstastverhältnis/" VALUE 0x80054EA8 Kw_Ws16 1000.000 Time_ms 0.00 1000.000 EXTENDED_LIMITS -327680.0 327670.0 /end CHARACTERISTIC
/begin CHARACTERISTIC PCV_PwmOut.tiBtwTstOT_C "Klasse für Parameter Ausgangstastverhältnis/" VALUE 0x80054EAA Kw_Ws16 327.6700 Time_s 0.00 327.6700 EXTENDED_LIMITS -327.6800 327.6700 /end CHARACTERISTIC
/begin CHARACTERISTIC PCV_PwmOut.numTstMax_C "Klasse für Parameter Ausgangstastverhältnis/" VALUE 0x80054EAC Kw_Wu16 65535.00 OneToOne 0.00 65535.00 /end CHARACTERISTIC
/begin CHARACTERISTIC PCV_PwmOut.swtBattCor_C "Klasse für Parameter Ausgangstastverhältnis/" VALUE 0x80054EAE Kw_Wu8 1.000 OneToOne 0.00 1.000 EXTENDED_LIMITS 0.00 255.0 /end CHARACTERISTIC
/begin CHARACTERISTIC PCV_PwmOut.swtPsInv_C "Klasse für Parameter Ausgangstastverhältnis/" VALUE 0x80054EAF Kw_Wu8 255.0 OneToOne 0.00 255.0 /end CHARACTERISTIC
/begin CHARACTERISTIC PCV_qDiffMaxActrTst_C "maximal erlaubte Abweichung der Einspritzmenge" VALUE 0x80054DC6 Val_Ws16 20.00000 InjMass 0.00 20.00000 EXTENDED_LIMITS -327.6800 327.6700 /end CHARACTERISTIC
/begin CHARACTERISTIC PCV_rAccPedActrTst_C "maximal erlaubte Stellung des Fahrpedals" VALUE 0x80054DC8 Val_Ws16 9.997559 Prc 0.00 9.997559 EXTENDED_LIMITS -400.0000 399.9878 /end CHARACTERISTIC
/begin CHARACTERISTIC PCV_rDstHiActrTst_C "Delta-Tastverhältnis für das Hoch-Rampen" VALUE 0x80054DCA Val_Ws16 80.00000 DtyCyc 0.00 80.00000 EXTENDED_LIMITS -327.6800 327.6700 /end CHARACTERISTIC
/begin CHARACTERISTIC PCV_rDstLoActrTst_C "Delta-Tastverhältnis für das Runter-Rampen" VALUE 0x80054DCC Val_Ws16 80.00000 DtyCyc 0.00 80.00000 EXTENDED_LIMITS -327.6800 327.6700 /end CHARACTERISTIC
/begin CHARACTERISTIC PCV_resCoil_C "Widerstandswert der DRV-Spule" VALUE 0x80054EB0 Val_Ws16 5000.000 Resist_1 0.00 5000.000 FORMAT "%8.3" EXTENDED_LIMITS -32768.00 32767.00 /end CHARACTERISTIC
/begin CHARACTERISTIC PCV_rMax_C "Max-Wert, Ausgangstastverhältnis" VALUE 0x80054DCE Val_Ws16 100.0000 DtyCyc 0.00 100.0000 EXTENDED_LIMITS -327.6800 327.6700 /end CHARACTERISTIC
/begin CHARACTERISTIC PCV_rMin_C "Min-Wert, Ausgangstastverhältnis" VALUE 0x80054DD0 Val_Ws16 100.0000 DtyCyc 0.00 100.0000 EXTENDED_LIMITS -327.6800 327.6700 /end CHARACTERISTIC
/begin CHARACTERISTIC PCV_rSetLin_CUR "Linearisierungskennlinie des Tastverhältnisses des Druckregelventils" CURVE 0x80054EB2 Cur_Xs16Ws16 100.0000 DtyCyc 0.00 100.0000 EXTENDED_LIMITS -327.6800 327.6700
 /begin AXIS_DESCR STD_AXIS PCV_rSet DtyCyc 4 -327.6800 327.6700 DEPOSIT ABSOLUTE /end AXIS_DESCR
/end CHARACTERISTIC
/begin CHARACTERISTIC PCV_rStpActrTst_C "Schrittweite zum Verändern des Tastverhältnisses" VALUE 0x80054DD2 Val_Ws16 30.00000 DtyCyc 0.00 30.00000 EXTENDED_LIMITS -327.6800 327.6700 /end CHARACTERISTIC
/begin CHARACTERISTIC PCV_rTst_C "Tastverhältnis, das im Fehlerfall zyklisch ausgegeben wird" VALUE 0x80054EC4 Val_Ws16 100.0000 DtyCyc 0.00 100.0000 EXTENDED_LIMITS -327.6800 327.6700 /end CHARACTERISTIC
/begin CHARACTERISTIC PCV_SRC.uMin_C "Klasse für Parameter Analogeingang Signal Range Check/" VALUE 0x80054EC6 Kw_Ws16 5200.000 Volt 0.00 5200.000 EXTENDED_LIMITS -6553.600 6553.400 /end CHARACTERISTIC
/begin CHARACTERISTIC PCV_SRC.uMax_C "Klasse für Parameter Analogeingang Signal Range Check/" VALUE 0x80054EC8 Kw_Ws16 5200.000 Volt 0.00 5200.000 EXTENDED_LIMITS -6553.600 6553.400 /end CHARACTERISTIC
/begin CHARACTERISTIC PCV_stMskCoEOMOpModeActrTst_C "Maske der erlauben Beriebsarten wärhend des PCV Tests" VALUE 0x80054DD4 Val_Wu16 65535.00 OneToOne 0.00 65535.00 /end CHARACTERISTIC
/begin CHARACTERISTIC PCV_stPwrStgActv_C "Signal Range Check Max-Wert" VALUE 0x80054ECA Val_Wu8 255.0 OneToOne 0.00 255.0 /end CHARACTERISTIC
/begin CHARACTERISTIC PCV_stPwrStgDia_C "Statuswort zur Spezifikation des Abschaltverhaltens der Endstufenfehlerdiagnose Druckregelventil" VALUE 0x80054ECB Val_Wu8 255.0 OneToOne 0.00 255.0 /end CHARACTERISTIC
/begin CHARACTERISTIC PCV_swtAdaptCPC_C "Schalter für die Freigabe der Adaption im CPC-Betrieb" VALUE 0x80054E76 Val_Wu8 255.0 OneToOne 0.00 255.0 /end CHARACTERISTIC
/begin CHARACTERISTIC PCV_swtAdaptFlow_C "Schalter für die Freigabe der Durchflusswertberechnung" VALUE 0x80054E77 Val_Wu8 255.0 OneToOne 0.00 255.0 /end CHARACTERISTIC
/begin CHARACTERISTIC PCV_swtAdaptRst_C "Schalter für das Zurücksetzen der Adaptionswerte" VALUE 0x80054E78 Val_Wu8 255.0 OneToOne 0.00 255.0 /end CHARACTERISTIC
/begin CHARACTERISTIC PCV_swtAdapt_C "Schalter für die Freigabe der Adaptionswertberechnung" VALUE 0x80054E79 Val_Wu8 255.0 OneToOne 0.00 255.0 /end CHARACTERISTIC
/begin CHARACTERISTIC PCV_swtClose_C "Schalter zur Wahl der Motorstarterkennung" VALUE 0x80054F52 Val_Wu8 1.000 OneToOne 0.00 1.000 EXTENDED_LIMITS 0.00 255.0 /end CHARACTERISTIC
/begin CHARACTERISTIC PCV_swtNoChkRefActrTst_C "Schalter zur Deaktivierung von Überprüfungen bestimmter Betriebsbedingungen" VALUE 0x80054DD6 Val_Wu8 3.000 OneToOne 0.00 3.000 EXTENDED_LIMITS 0.00 255.0 /end CHARACTERISTIC
/begin CHARACTERISTIC PCV_tFuelAdaptMax_C "Maximale Kraftstofftemperatur, bis zu der die Adaption durchgeführt wird" VALUE 0x80054E7A Val_Ws16 140.0000 Temp_Cels -40.04000 99.96000 EXTENDED_LIMITS -3549.940 3003.560 /end CHARACTERISTIC
/begin CHARACTERISTIC PCV_tFuelAdaptMin_C "Minimale Kraftstofftemperatur, ab der die Adaption durchgeführt wird" VALUE 0x80054E7C Val_Ws16 140.0000 Temp_Cels -40.04000 99.96000 EXTENDED_LIMITS -3549.940 3003.560 /end CHARACTERISTIC
/begin CHARACTERISTIC PCV_tiAdaptMax_C "Maximale Zeitspanne, die zwischen zwei Adaptionsvorgängen ohne Absenkung der Raildruckschwelle vergehen darf" VALUE 0x80054E80 Val_Wu32 65000.0000000 TimeEngOn 0.00 65000.0000000 FORMAT "%13.7" EXTENDED_LIMITS 0.00 4294967295.00 /end CHARACTERISTIC
/begin CHARACTERISTIC PCV_tiCrntCtlInit_C "maximale Zeitdauer der Initialisierungsphase für den Stromregler" VALUE 0x80054F54 Val_Ws16 327670.0 Time_ms 0.00 327670.0 EXTENDED_LIMITS -327680.0 327670.0 /end CHARACTERISTIC
/begin CHARACTERISTIC PCV_tiDelMeasActrTst_C "Verzögerungszeit für die Auswertung" VALUE 0x80054DD8 Val_Ws32 2000.00000000 Time_ms 0.00 2000.00000000 EXTENDED_LIMITS -21474836480.0 21474836470.0 /end CHARACTERISTIC
/begin CHARACTERISTIC PCV_tiDurClose_C "Zeitdauer zum sicheren Schließen des Druckregelventils" VALUE 0x80054F56 Val_Wu16 100.0000 Time_ms 0.00 100.0000 EXTENDED_LIMITS 0.00 655350.0 /end CHARACTERISTIC
/begin CHARACTERISTIC PCV_tiFlt1PT1_C "PT1 Filterzeitkonstante für Strom-Istwert" VALUE 0x80054F58 Val_Ws32 4294.9672940 TimeDelay_s 0.000002000000001 4294.9672960 FORMAT "%12.7" /end CHARACTERISTIC
/begin CHARACTERISTIC PCV_tiFlt2PT1_C "PT1 Filterzeitkonstante für Strom-Sollwert" VALUE 0x80054F5C Val_Ws32 4294.9672940 TimeDelay_s 0.000002000000001 4294.9672960 FORMAT "%12.7" /end CHARACTERISTIC
/begin CHARACTERISTIC PCV_tiFltPT1Init_C "maximaler Strom zum Schließen des Druckregelventils" VALUE 0x80054F60 Val_Ws32 4294.9672940 TimeDelay_s 0.000002000000001 4294.9672960 FORMAT "%12.7" /end CHARACTERISTIC
/begin CHARACTERISTIC PCV_tiMaxActrTst_C "maximal zulässige Testdauer" VALUE 0x80054DDC Val_Ws32 1000.00000000 Time_s 0.00 1000.00000000 EXTENDED_LIMITS -21474836.4800 21474836.4700 /end CHARACTERISTIC
/begin CHARACTERISTIC PCV_tiNoClose_C "Zeitdauer nach der auf max. Strom umgeschaltet werden darf" VALUE 0x80054F64 Val_Wu16 655350.0 Time_ms 0.00 655350.0 /end CHARACTERISTIC
/begin CHARACTERISTIC PCV_tiNoStrt_C "Zeit für welche die Minimum Grenze von PCV_iSet auf PCV_iSetMinNoStart_C gesetzt wird" VALUE 0x80054F66 Val_Wu16 80000.00 Time_ms 0.00 80000.00 EXTENDED_LIMITS 0.00 655350.0 /end CHARACTERISTIC
/begin CHARACTERISTIC PCV_tiSetCloseMax_C "maximale Verweilzeit im Zustand PCV_stActrCtl == PCV_CLOSE_MODE (0x20)" VALUE 0x80054F68 Val_Wu16 100.0000 Time_ms 0.00 100.0000 EXTENDED_LIMITS 0.00 655350.0 /end CHARACTERISTIC
/begin CHARACTERISTIC PCV_tiTst_C "Zeitdauer des aktiven Endstufentests" VALUE 0x80054ECC Val_Wu16 30000.00 Time_ms 0.00 30000.00 EXTENDED_LIMITS 0.00 655350.0 /end CHARACTERISTIC
/begin CHARACTERISTIC PCV_tiWaitActrTst_C "Wartezeit in einzelnen Zuständen des Zustandsautomats" VALUE 0x80054DE0 Val_Ws32 60000.0000000 Time_ms 0.00 60000.0000000 EXTENDED_LIMITS -21474836480.0 21474836470.0 /end CHARACTERISTIC
/begin CHARACTERISTIC PCV_tMinActrTst_C "minimale Temperatur des Kühlwassers (Betriebstemperatur des Motors)" VALUE 0x80054DE4 Val_Ws16 200.0000 Temp_Cels -50.14000 149.8600 EXTENDED_LIMITS -3549.940 3003.560 /end CHARACTERISTIC
/begin CHARACTERISTIC PCV_tSwtMeUn_C "Temperaturschwelle für die Freigabe der Botschaft PCV_stAdaptMeUn" VALUE 0x80054E84 Val_Ws16 140.0000 Temp_Cels -40.04000 99.96000 EXTENDED_LIMITS -3549.940 3003.560 /end CHARACTERISTIC
/begin CHARACTERISTIC PCV_uBattHi_C "obere Abschaltschwelle für den reduzierten Maximalstrom" VALUE 0x80054F6A Val_Ws16 1310700. Volt_Batt -655360.0 655340.0 /end CHARACTERISTIC
/begin CHARACTERISTIC PCV_uBattLo_C "untere Abschaltschwelle für den reduzierten Maximalstrom" VALUE 0x80054F6C Val_Ws16 1310700. Volt_Batt -655360.0 655340.0 /end CHARACTERISTIC
/begin CHARACTERISTIC PCV_uDiffMaxActrTst_C "maximal erlaubte Abweichung der Batteriespannung" VALUE 0x80054DE6 Val_Ws16 3000.000 Volt_Batt 0.00 3000.000 EXTENDED_LIMITS -655360.0 655340.0 /end CHARACTERISTIC
/begin CHARACTERISTIC PFltLd_aVehFltAshCorMax_C "maximal zulässiger Wert Fahrzeugbeschleunigung" VALUE 0x80054F8C Kw_Ws16 10.00000 Acc 0.00 10.00000 FORMAT "%8.5" EXTENDED_LIMITS -32.76800 32.76700 /end CHARACTERISTIC
/begin CHARACTERISTIC PFltLd_aVehFltAshCorMin_C "minimal zulässiger Wert Fahrzeugbeschleunigung" VALUE 0x80054F8E Kw_Ws16 20.00000 Acc -10.00000 10.00000 FORMAT "%8.5" EXTENDED_LIMITS -32.76800 32.76700 /end CHARACTERISTIC
/begin CHARACTERISTIC PFltLd_ctRgnSucMin_C "Minimale Anzahl erfolgreicher Regenerationen" VALUE 0x800550A0 Kw_Wu8 255.0 OneToOne 0.00 255.0 /end CHARACTERISTIC
/begin CHARACTERISTIC PFltLd_dAvaiMin_C "minimaler Schwellenwert für PCBS_dAvaiOut" VALUE 0x80054F90 Kw_Wu8 255.0 OneToOne 0.00 255.0 /end CHARACTERISTIC
/begin CHARACTERISTIC PFltLd_DebSim.tiHiLo_C "Entprellzeit Umschaltung Messung-Simulation/" VALUE 0x800550A2 Kw_Ws16 655350.0 TimeDeb -327680.0 327670.0 /end CHARACTERISTIC
/begin CHARACTERISTIC PFltLd_DebSim.tiLoHi_C "Entprellzeit Umschaltung Messung-Simulation/" VALUE 0x800550A4 Kw_Ws16 655350.0 TimeDeb -327680.0 327670.0 /end CHARACTERISTIC
/begin CHARACTERISTIC PFltLd_dmSotEGROff_MAP "Emissionsgrundkennfeld Partikelmassenstrom stationär bei abgeschalteter Abgasrückführung" MAP 0x800553C8 Map_Xs16Ys16Ws16 327.0000 dmSoot_mg_p_s 0.00 327.0000 FORMAT "%8.4" EXTENDED_LIMITS -327.6800 327.6700
 /begin AXIS_DESCR STD_AXIS Epm_nEng EngN 8 20.00000 10000.00 EXTENDED_LIMITS -16384.00 16383.50 DEPOSIT ABSOLUTE /end AXIS_DESCR
 /begin AXIS_DESCR STD_AXIS InjCtl_qSetUnBal InjMass 8 0.00 327.6700 EXTENDED_LIMITS -327.6800 327.6700 DEPOSIT ABSOLUTE /end AXIS_DESCR
/end CHARACTERISTIC
/begin CHARACTERISTIC PFltLd_dmSotSimDynNCor_CUR "Drehzahlkorrektur für dynamischen Anteil Russrohemissionen" CURVE 0x8005546C Cur_Xs16Ws16 327.0000 dmSoot_mg_p_s 0.00 327.0000 FORMAT "%8.4" EXTENDED_LIMITS -327.6800 327.6700
 /begin AXIS_DESCR STD_AXIS Epm_nEng EngN 8 20.00000 10000.00 EXTENDED_LIMITS -16384.00 16383.50 DEPOSIT ABSOLUTE /end AXIS_DESCR
/end CHARACTERISTIC
/begin CHARACTERISTIC PFltLd_dmSotSimDyn_CUR "dynamischer Anteil der Partikelemission = f(dq/dt)" CURVE 0x8005548E Cur_Xs16Ws16 327.0000 dmSoot_mg_p_s 0.00 327.0000 FORMAT "%8.4" EXTENDED_LIMITS -327.6800 327.6700
 /begin AXIS_DESCR STD_AXIS PFltLd_dqDT1Flt_mp InjMass_p_s 8 -327.6800 327.6700 FORMAT "%8.4" DEPOSIT ABSOLUTE /end AXIS_DESCR
/end CHARACTERISTIC
/begin CHARACTERISTIC PFltLd_dmSotSimInit.Pos_C "/" VALUE 0x800554B0 Kw_Ws32 327679.999847 RmpMSoot 0.00 327679.999847 FORMAT "%13.6" EXTENDED_LIMITS -327680.000000 327679.999847 /end CHARACTERISTIC
/begin CHARACTERISTIC PFltLd_dmSotSimInit.Neg_C "/" VALUE 0x800554B4 Kw_Ws32 327679.999847 RmpMSoot 0.00 327679.999847 FORMAT "%13.6" EXTENDED_LIMITS -327680.000000 327679.999847 /end CHARACTERISTIC
/begin CHARACTERISTIC PFltLd_dmSotSimLmbd_MAP "Lambda Korrektur für dynamischen Anteil der Russmasse" MAP 0x800554B8 Map_Xs16Ys16Ws16 327.0000 dmSoot_mg_p_s 0.00 327.0000 FORMAT "%8.4" EXTENDED_LIMITS -327.6800 327.6700
 /begin AXIS_DESCR STD_AXIS PFltLd_rLmbdStat_mp lambda 8 -32.76800 32.76700 DEPOSIT ABSOLUTE /end AXIS_DESCR
 /begin AXIS_DESCR STD_AXIS PFltLd_rLam_mp lambda 8 -32.76800 32.76700 DEPOSIT ABSOLUTE /end AXIS_DESCR
/end CHARACTERISTIC
/begin CHARACTERISTIC PFltLd_dmSotSimRgnBas_CUR "Basiswert für produzierter Rußmassenstrom abhängig von aktueller Rußmasse" CURVE 0x8005555C Cur_Xs16Ws16 327.0000 dmSoot_mg_p_s 0.00 327.0000 FORMAT "%8.4" EXTENDED_LIMITS -327.6800 327.6700
 /begin AXIS_DESCR STD_AXIS PFltLd_mSot mSoot_g 8 0.00 300.0000 FORMAT "%8.4" EXTENDED_LIMITS -327.6800 327.6700 DEPOSIT ABSOLUTE /end AXIS_DESCR
/end CHARACTERISTIC
/begin CHARACTERISTIC PFltLd_dmSotSimRgnNO2_C "Faktor für konvertierung mg/s nach Fact." VALUE 0x8005557E Val_Ws16 327.0000 dmSoot_mg_p_s 0.00 327.0000 FORMAT "%8.4" EXTENDED_LIMITS -327.6800 327.6700 /end CHARACTERISTIC
/begin CHARACTERISTIC PFltLd_dpDiffMax_C "Schwelle für Druckdifferenzänderung über der auf Simulation geschaltet wird" VALUE 0x800550A6 Kw_Ws16 65535.00 dPres_hPa_p_s -32768.00 32767.00 FORMAT "%8.2" /end CHARACTERISTIC
/begin CHARACTERISTIC PFltLd_DT1Pres.T1_C "Parameter für Druckdifferenz DT1 Filter/" VALUE 0x800550A8 Kw_Ws32 4294.9672940 TimeDelay_s 0.000002000000001 4294.9672960 FORMAT "%12.7" /end CHARACTERISTIC
/begin CHARACTERISTIC PFltLd_DT1Pres.Kd_C "Parameter für Druckdifferenz DT1 Filter/" VALUE 0x800550AC Kw_Ws32 32767.9999847 Kd 0.00 32767.9999847 FORMAT "%13.7" EXTENDED_LIMITS -32768.0000000 32767.9999847 /end CHARACTERISTIC
/begin CHARACTERISTIC PFltLd_DT1Sim.T1_C "/" VALUE 0x80055580 Kw_Ws32 4293.9673036 TimeDelay_s 0.99999238556 4294.9672960 FORMAT "%12.7" EXTENDED_LIMITS 0.000002000000001 4294.9672960 /end CHARACTERISTIC
/begin CHARACTERISTIC PFltLd_DT1Sim.Kd_C "/" VALUE 0x80055584 Kw_Ws32 32767.9999847 Kd 0.00 32767.9999847 FORMAT "%13.7" EXTENDED_LIMITS -32768.0000000 32767.9999847 /end CHARACTERISTIC
/begin CHARACTERISTIC PFltLd_dvolPFltMeasMin_C "Schwelle für Abgasstrom unter der auf Simulation geschaltet wird" VALUE 0x800550B0 Kw_Ws16 3000.000 CubMtrPerHr 0.00 3000.000 FORMAT "%8.3" EXTENDED_LIMITS -3276.800 3276.700 /end CHARACTERISTIC
/begin CHARACTERISTIC PFltLd_dvolResFlwPT1Frz_C "Abgasvolumenstrom Schwelle unter der der Strömungswdst eingefroren wird" VALUE 0x80055108 Val_Ws16 30000.00 CubMtrPerHr 0.00 30000.00 FORMAT "%8.2" EXTENDED_LIMITS -3276.800 3276.700 /end CHARACTERISTIC
/begin CHARACTERISTIC PFltLd_facAshCorOld_C "Faktor für den alten Aschekorrekturwert" VALUE 0x80054F92 Kw_Ws16 65535.00 OneToOne -32768.00 32767.00 /end CHARACTERISTIC
/begin CHARACTERISTIC PFltLd_facAshOil_C "Faktor für Aschenöl" VALUE 0x80054F94 Kw_Ws16 65535.00 OneToOne -32768.00 32767.00 /end CHARACTERISTIC
/begin CHARACTERISTIC PFltLd_facAshVolCor_MAP "Aschevolumen-abhängiger Korrekturfaktor des Differenzdrukkes" MAP 0x8005510A Kf_Xs16_Ys16_Ws16 1500.000 Fact4 0.00 1500.000 FORMAT "%8.3" EXTENDED_LIMITS -1638.400 1638.350
 /begin AXIS_DESCR STD_AXIS ASMod_dvolPFltEG AirVolPerTime 2 0.00 3000.00000000 FORMAT "%13.8" EXTENDED_LIMITS -214748364.800 214748364.700 DEPOSIT ABSOLUTE /end AXIS_DESCR
 /begin AXIS_DESCR STD_AXIS PFltLd_volAsh Vol 2 0.01000000 100.0000 FORMAT "%8.4" EXTENDED_LIMITS -327.6800 327.6700 DEPOSIT ABSOLUTE /end AXIS_DESCR
/end CHARACTERISTIC
/begin CHARACTERISTIC PFltLd_facDynVsc_CUR "Kennlinie zur Berücksichtigung der dynamischen Viskosität" CURVE 0x8005511E Kl_Xs16_Ws16 1.000000 Fact 0.00 1.000000 EXTENDED_LIMITS -4.000000 3.999878
 /begin AXIS_DESCR STD_AXIS ASMod_tPFltSurfSim Temp_Cels 8 99.96000 799.9600 EXTENDED_LIMITS -3549.940 3003.560 DEPOSIT ABSOLUTE /end AXIS_DESCR
/end CHARACTERISTIC
/begin CHARACTERISTIC PFltLd_facFlTotCor_C "Gesamtmenge Kraftstoffkorrekturfaktor" VALUE 0x80054F96 Kw_Ws16 1.000000 Fact 0.00 1.000000 EXTENDED_LIMITS -4.000000 3.999878 /end CHARACTERISTIC
/begin CHARACTERISTIC PFltLd_facMaxOfsNO2_C "Faktor fuer maximal zulaessigen Russmassenoffsetwert aus NO2-Regeneration" VALUE 0x80055140 Val_Ws16 1.000000 Fact 0.00 1.000000 EXTENDED_LIMITS -4.000000 3.999878 /end CHARACTERISTIC
/begin CHARACTERISTIC PFltLd_facMaxOfsStrt_C "Faktor fuer maximal zulaessigen Russmassenoffsetwert aus Startoffsetkorrektur" VALUE 0x80055142 Val_Ws16 1.000000 Fact 0.00 1.000000 EXTENDED_LIMITS -4.000000 3.999878 /end CHARACTERISTIC
/begin CHARACTERISTIC PFltLd_facMltCor_CUR "Kennlinie zur Berücksichtigung der Aschenkorrektur" CURVE 0x800550C0 Kl_Xs16_Ws16 1.000000 Fact 0.00 1.000000 EXTENDED_LIMITS -4.000000 3.999878
 /begin AXIS_DESCR STD_AXIS PFltLd_volAsh_mp Vol 8 0.00 100.0000 FORMAT "%8.4" EXTENDED_LIMITS -327.6800 327.6700 DEPOSIT ABSOLUTE /end AXIS_DESCR
/end CHARACTERISTIC
/begin CHARACTERISTIC PFltLd_facNO2CnvCatLv_CUR "NOx NO2 Konvertierungsrate im Oxicat über Lebensdauer" CURVE 0x80055588 Cur_Xs16Ws16 1.000000 Fact 0.00 1.000000 EXTENDED_LIMITS -4.000000 3.999878
 /begin AXIS_DESCR STD_AXIS PFltLd_facAshAdjCor Fact 8 0.00 1.000000 EXTENDED_LIMITS -4.000000 3.999878 DEPOSIT ABSOLUTE /end AXIS_DESCR
/end CHARACTERISTIC
/begin CHARACTERISTIC PFltLd_facNO2CnvCat_MAP "Faktor Temperaturabhängigkeit der Konvertierung von NO zu NO2 des Oxidationskatalysators" MAP 0x800555AA Map_Xs16Ys16Ws16 1.000000 Fact 0.00 1.000000 EXTENDED_LIMITS -4.000000 3.999878
 /begin AXIS_DESCR STD_AXIS Exh_tAdapTOxiCatUs Temp_Cels 8 -0.04000000 799.9600 EXTENDED_LIMITS -3549.940 3003.560 DEPOSIT ABSOLUTE /end AXIS_DESCR
 /begin AXIS_DESCR STD_AXIS ASMod_dvolPFltEG AirVolPerTime 8 0.00 3000.00000000 FORMAT "%13.8" EXTENDED_LIMITS -214748364.800 214748364.700 DEPOSIT ABSOLUTE /end AXIS_DESCR
/end CHARACTERISTIC
/begin CHARACTERISTIC PFltLd_facSotSimStyCal_C "" VALUE 0x8005564E Val_Ws16 1.000000 Fact 0.00 1.000000 EXTENDED_LIMITS -4.000000 3.999878 /end CHARACTERISTIC
/begin CHARACTERISTIC PFltLd_facTCorOfsNO2_CUR "Korrekturfaktor des Rußmassen-Offsets nach NO2-Regeneration Abhaengigkeit der Zeit seit Ende der NO2-Regeneration" CURVE 0x80055144 Cur_Xs16Ws16 1.000000 Fact 0.00 1.000000 EXTENDED_LIMITS -4.000000 3.999878
 /begin AXIS_DESCR STD_AXIS PFltLd_tiCorOfsNO2_mp TimeRed 8 -5242.880 5242.720 FORMAT "%8.3" DEPOSIT ABSOLUTE /end AXIS_DESCR
/end CHARACTERISTIC
/begin CHARACTERISTIC PFltLd_facTCorOfsStrt_CUR "Korrekturfaktor des Rußmassen-Startoffsets in Abhaengigkeit der Zeit seit Motorstart" CURVE 0x80055166 Cur_Xs16Ws16 1.000000 Fact 0.00 1.000000 EXTENDED_LIMITS -4.000000 3.999878
 /begin AXIS_DESCR STD_AXIS CoEng_tiNormalRed TimeRed 8 -5242.880 5242.720 FORMAT "%8.3" DEPOSIT ABSOLUTE /end AXIS_DESCR
/end CHARACTERISTIC
/begin CHARACTERISTIC PFltLd_facTempNO2_CUR "Faktor für Temperaturabhängigkeit NO2-Effekt" CURVE 0x80055650 Cur_Xs16Ws16 1.000000 Fact 0.00 1.000000 EXTENDED_LIMITS -4.000000 3.999878
 /begin AXIS_DESCR STD_AXIS ASMod_tPFltSurfSim Temp_Cels 8 99.96000 799.9600 EXTENDED_LIMITS -3549.940 3003.560 DEPOSIT ABSOLUTE /end AXIS_DESCR
/end CHARACTERISTIC
/begin CHARACTERISTIC PFltLd_facTempSimRgn_CUR "Einfluß der Temperatur auf regenerierte Partikelmasse" CURVE 0x80055672 Cur_Xs16Ws16 1.000000 Fact 0.00 1.000000 EXTENDED_LIMITS -4.000000 3.999878
 /begin AXIS_DESCR STD_AXIS ASMod_tPFltSurfSim Temp_Cels 8 99.96000 799.9600 EXTENDED_LIMITS -3549.940 3003.560 DEPOSIT ABSOLUTE /end AXIS_DESCR
/end CHARACTERISTIC
/begin CHARACTERISTIC PFltLd_facTempSnceRgnOfs_C "Versatz im Integrator Eingangsgroesse von PFlt_facNO2Rgn" VALUE 0x80055694 Val_Ws16 1.000000 Fact 0.00 1.000000 EXTENDED_LIMITS -4.000000 3.999878 /end CHARACTERISTIC
/begin CHARACTERISTIC PFltLd_KiINO2Rgn_C "Ki Faktor für des Integrator" VALUE 0x80055698 Val_Wu32 262143.000000 Ki_NO2Rgn 0.00 262143.000000 FORMAT "%13.6" EXTENDED_LIMITS 0.00 42949672.9500 /end CHARACTERISTIC
/begin CHARACTERISTIC PFltLd_kiMSotRes_C "Integrationsfaktor für Abschätzung der Restrußmasse im Partikelfilter nach erfolgreicher Regeneration" VALUE 0x8005569C Val_Ws16 49.00000 KiRmnSotMs 0.00 49.00000 FORMAT "%8.5" EXTENDED_LIMITS -16384.00 16383.50 /end CHARACTERISTIC
/begin CHARACTERISTIC PFltLd_lSumMaxHCCond_MAP "Schaltschwelle (Weg) für Regeneration" MAP 0x80066164 Map_Xs16Ys16Ws16 99998.98 lHCCondRes 0.00 99998.98 FORMAT "%8.2" EXTENDED_LIMITS -4194.304 4194.176
 /begin AXIS_DESCR STD_AXIS PFltLd_vAvrgSnceHCCond_mp lSnceRgnRes2 2 -1179.648 1179.612 FORMAT "%8.3" DEPOSIT ABSOLUTE /end AXIS_DESCR
 /begin AXIS_DESCR STD_AXIS PFltLd_lAvrgSnceHCCond_mp lHCCondRes 2 -4194.304 4194.176 FORMAT "%8.3" DEPOSIT ABSOLUTE /end AXIS_DESCR
/end CHARACTERISTIC
/begin CHARACTERISTIC PFltLd_lSumMaxOptHCCond_C "Schaltschwelle (Weg) fürAnforderung optionale Regeneration" VALUE 0x80066178 Val_Ws16 99998.98 lHCCondRes 0.00 99998.98 FORMAT "%8.2" EXTENDED_LIMITS -4194.304 4194.176 /end CHARACTERISTIC
/begin CHARACTERISTIC PFltLd_lSumOptHCCond_C "Schaltschwelle (Weg) für optionale Regeneration" VALUE 0x8006617A Val_Ws16 99998.98 lHCCondRes 0.00 99998.98 FORMAT "%8.2" EXTENDED_LIMITS -4194.304 4194.176 /end CHARACTERISTIC
/begin CHARACTERISTIC PFltLd_mAshCor_MAP "MAP für Aschekorrekturwert" MAP 0x80054F98 Kf_Xs16_Ys16_Ws16 400.0000 mSoot_g -100.0000 300.0000 FORMAT "%8.4" EXTENDED_LIMITS -327.6800 327.6700
 /begin AXIS_DESCR STD_AXIS PFltLd_dVolFltAshCor_mp CubMtrPerHr 8 0.00 3000.000 FORMAT "%8.3" EXTENDED_LIMITS -3276.800 3276.700 DEPOSIT ABSOLUTE /end AXIS_DESCR
 /begin AXIS_DESCR STD_AXIS PFltLd_resFlowFltAshCor_mp Res_hPaHrPerCM 8 0.00 25.00000 FORMAT "%8.5" EXTENDED_LIMITS -3.276800 3.276700 DEPOSIT ABSOLUTE /end AXIS_DESCR
/end CHARACTERISTIC
/begin CHARACTERISTIC PFltLd_mAshOil_CUR "Kennlinie zur Umrechnung des verbrauchten Kraftstoffes in Ölaschenmasse" CURVE 0x800550E2 Kl_Xs16_Ws16 300.0000 mOilAsh_g 0.00 300.0000 FORMAT "%8.4" EXTENDED_LIMITS -327.6800 327.6700
 /begin AXIS_DESCR STD_AXIS PFltLd_qFlTotCorCurIn_mp Fl_2 8 0.00 330.0000 FORMAT "%8.4" EXTENDED_LIMITS -327680.0 327670.0 DEPOSIT ABSOLUTE /end AXIS_DESCR
/end CHARACTERISTIC
/begin CHARACTERISTIC PFltLd_mAshTolcAbs_C "maximal absoluter zulässiger Wert für Aschenmassentoleranz" VALUE 0x8005503C Kw_Ws16 300.0000 mSoot_g 0.00 300.0000 FORMAT "%8.4" EXTENDED_LIMITS -327.6800 327.6700 /end CHARACTERISTIC
/begin CHARACTERISTIC PFltLd_mAshTolcMaxAbs_C "maximal erlaubte absolute Abweichung des neu berechneten Aschewertes" VALUE 0x8005503E Kw_Ws16 300.0000 mSoot_g 0.00 300.0000 FORMAT "%8.4" EXTENDED_LIMITS -327.6800 327.6700 /end CHARACTERISTIC
/begin CHARACTERISTIC PFltLd_mAshTolcMaxRel_C "maximal erlaubte relative Abweichung der neu berechneten Aschemenge" VALUE 0x80055040 Kw_Ws16 300.0000 mSoot_g 0.00 300.0000 FORMAT "%8.4" EXTENDED_LIMITS -327.6800 327.6700 /end CHARACTERISTIC
/begin CHARACTERISTIC PFltLd_mDiffResThres_C "Restliche Ruß-Massenunterschied-Schwelle, darüber hinaus den SotSim Integratoren initialsed sein sollen" VALUE 0x8005569E Val_Ws16 300.0000 mSoot_g 0.00 300.0000 FORMAT "%8.4" EXTENDED_LIMITS -327.6800 327.6700 /end CHARACTERISTIC
/begin CHARACTERISTIC PFltLd_mResFlwMeasAftRgn_MAP "Restliche Ruß-Masse maß nach Regeneration" MAP 0x800556A0 Map_Xs16Ys16Ws16 300.0000 mSoot_g 0.00 300.0000 FORMAT "%8.4" EXTENDED_LIMITS -327.6800 327.6700
 /begin AXIS_DESCR STD_AXIS ASMod_dvolPFltEG AirVolPerTime 5 -214748364.800 214748364.700 FORMAT "%13.3" DEPOSIT ABSOLUTE /end AXIS_DESCR
 /begin AXIS_DESCR STD_AXIS PFltLd_resFlwFlt Res_hPaHrPerCM 14 -3.276800 3.276700 FORMAT "%8.6" DEPOSIT ABSOLUTE /end AXIS_DESCR
/end CHARACTERISTIC
/begin CHARACTERISTIC PFltLd_mSotMeas_MAP "Umrechnung Strömungswiderstand Partikelmasse" MAP 0x80055188 Kf_Xs16_Ys16_Ws16 300.0000 mSoot_g 0.00 300.0000 FORMAT "%8.4" EXTENDED_LIMITS -327.6800 327.6700
 /begin AXIS_DESCR STD_AXIS PFltLd_resFlwFlt Res_hPaHrPerCM 14 0.00 2.500000 FORMAT "%8.6" EXTENDED_LIMITS -3.276800 3.276700 DEPOSIT ABSOLUTE /end AXIS_DESCR
 /begin AXIS_DESCR STD_AXIS PFltLd_dvolPFltEGFlt_mp CubMtrPerHr 5 0.00 3000.000 FORMAT "%8.3" EXTENDED_LIMITS -3276.800 3276.700 DEPOSIT ABSOLUTE /end AXIS_DESCR
/end CHARACTERISTIC
/begin CHARACTERISTIC PFltLd_mSotSimInit_C "" VALUE 0x80055756 Val_Ws16 300.0000 mSoot_g 0.00 300.0000 FORMAT "%8.4" EXTENDED_LIMITS -327.6800 327.6700 /end CHARACTERISTIC
/begin CHARACTERISTIC PFltLd_mSotSimMax_C "Maximum value for a simulated particle mass" VALUE 0x80055758 Val_Ws16 300.0000 mSoot_g 0.00 300.0000 FORMAT "%8.4" EXTENDED_LIMITS -327.6800 327.6700 /end CHARACTERISTIC
/begin CHARACTERISTIC PFltLd_mSotSimNoContSubs_C "Ersatzwert der nicht kontinuierlich simulierten Partikelmasse im Fall eines EEPROM Fehlers" VALUE 0x8005575A Val_Ws16 300.0000 mSoot_g 0.00 300.0000 FORMAT "%8.4" EXTENDED_LIMITS -327.6800 327.6700 /end CHARACTERISTIC
/begin CHARACTERISTIC PFltLd_mSotSimRgnNO2_CUR "" CURVE 0x8005575C Cur_Xs16Ws16 0.00 mSoot_mg 0.00 0.00 FORMAT "%8.6" EXTENDED_LIMITS -327680.0 327670.0
 /begin AXIS_DESCR STD_AXIS PFltLd_mSot mSoot_g 8 0.00 300.0000 FORMAT "%8.4" EXTENDED_LIMITS -327.6800 327.6700 DEPOSIT ABSOLUTE /end AXIS_DESCR
/end CHARACTERISTIC
/begin CHARACTERISTIC PFltLd_nAvrgFltAshCorMax_C "maximal zulässiger Wert Drehzahl" VALUE 0x80055042 Kw_Ws16 6000.000 EngN 0.00 6000.000 EXTENDED_LIMITS -16384.00 16383.50 /end CHARACTERISTIC
/begin CHARACTERISTIC PFltLd_nAvrgFltAshCorMin_C "minimal zulässiger Wert Drehzahl" VALUE 0x80055044 Kw_Ws16 6000.000 EngN 0.00 6000.000 EXTENDED_LIMITS -16384.00 16383.50 /end CHARACTERISTIC
/begin CHARACTERISTIC PFltLd_nFlwRstnSimMin_C "Minimale Drehzahl zur Freigabe der Berechnung des Strömungswiderstandes anhand von Differenzdruck und Abgasvolumenstrom" VALUE 0x8005523E Kw_Ws16 1500.000 EngN 0.00 1500.000 EXTENDED_LIMITS -16384.00 16383.50 /end CHARACTERISTIC
/begin CHARACTERISTIC PFltLd_numAshCorPOp_C "PFltPOp_stEngPOp Bitposition" VALUE 0x80055046 Kw_Wu16 9.000000 OneToOne 0.00 9.000000 EXTENDED_LIMITS 0.00 65535.00 /end CHARACTERISTIC
/begin CHARACTERISTIC PFltLd_numLSU_C "Array - Index für die Lambdasensor Konfiguration" VALUE 0x8005577E Val_Wu8 1.000 OneToOne 0.00 1.000 EXTENDED_LIMITS 0.00 255.0 /end CHARACTERISTIC
/begin CHARACTERISTIC PFltLd_numPPFltDwnStr_C "" VALUE 0x80055240 Val_Wu8 255.0 OneToOne 0.00 255.0 /end CHARACTERISTIC
/begin CHARACTERISTIC PFltLd_numRatO2_C "Index zur Auswahl des Sauerstoff-Anteils nach Abgaskrümmer im Array ASMod_rO2EGFld" VALUE 0x8005577F Val_Wu8 16.00 OneToOne 0.00 16.00 EXTENDED_LIMITS 0.00 255.0 /end CHARACTERISTIC
/begin CHARACTERISTIC PFltLd_numValAvrgOfsNO2_C "Anzahl der Mittelungszyklen für Rußmassenoffset-Berechnung bei NO2-Regeneration" VALUE 0x80055242 Val_Ws16 10000.00 OneToOne 0.00 10000.00 EXTENDED_LIMITS -32768.00 32767.00 /end CHARACTERISTIC
/begin CHARACTERISTIC PFltLd_numValAvrgOfsStrt_C "Anzahl der Mittelungszyklen für Rußmassenoffset-Berechnung bei Motorstart" VALUE 0x80055244 Val_Ws16 10000.00 OneToOne 0.00 10000.00 EXTENDED_LIMITS -32768.00 32767.00 /end CHARACTERISTIC
/begin CHARACTERISTIC PFltLd_pDiffPFlt_MAP "Differenzdruck des leeren Partikelfilters" MAP 0x80055246 Kf_Xs16_Ys16_Ws16 3500.000 Pres_hPa 0.00 3500.000 EXTENDED_LIMITS -32768.00 32767.00
 /begin AXIS_DESCR STD_AXIS ASMod_tPFltSurfSim Temp_Cels 2 49.96000 1399.960 EXTENDED_LIMITS -3549.940 3003.560 DEPOSIT ABSOLUTE /end AXIS_DESCR
 /begin AXIS_DESCR STD_AXIS ASMod_dvolPFltEG AirVolPerTime 2 0.00 3000.00000000 FORMAT "%13.8" EXTENDED_LIMITS -214748364.800 214748364.700 DEPOSIT ABSOLUTE /end AXIS_DESCR
/end CHARACTERISTIC
/begin CHARACTERISTIC PFltLd_qSetUnBalFltAshCorMax_C "maximal zulässiger Wert aktuelle Einspritzmenge" VALUE 0x80055048 Kw_Ws16 327.6700 InjMassCyc 0.00 327.6700 EXTENDED_LIMITS -327.6800 327.6700 /end CHARACTERISTIC
/begin CHARACTERISTIC PFltLd_qSetUnBalFltAshCorMin_C "minimal zulässiger Wert aktuelle Einspritzmenge" VALUE 0x8005504A Kw_Ws16 327.6700 InjMassCyc 0.00 327.6700 EXTENDED_LIMITS -327.6800 327.6700 /end CHARACTERISTIC
/begin CHARACTERISTIC PFltLd_rEGRMax_C "bere Grenze für Abschalterkennung ARF" VALUE 0x80055780 Val_Ws16 300.0000 Prc -100.0000 200.0000 EXTENDED_LIMITS -400.0000 399.9878 /end CHARACTERISTIC
/begin CHARACTERISTIC PFltLd_rEGRMin_C "untere Grenze für Abschalterkennung ARF" VALUE 0x80055782 Val_Ws16 300.0000 Prc -100.0000 200.0000 EXTENDED_LIMITS -400.0000 399.9878 /end CHARACTERISTIC
/begin CHARACTERISTIC PFltLd_resFlwMeasInv_MAP "Inverse Strömungswiderstandskennfeld" MAP 0x8005525A Map_Xs16Ys16Ws16 2.500000 Res_hPaHrPerCM 0.00 2.500000 FORMAT "%8.6" EXTENDED_LIMITS -3.276800 3.276700
 /begin AXIS_DESCR STD_AXIS PFltLd_mSotCrv_mp mSoot_g 7 0.00 300.0000 FORMAT "%8.4" EXTENDED_LIMITS -327.6800 327.6700 DEPOSIT ABSOLUTE /end AXIS_DESCR
 /begin AXIS_DESCR STD_AXIS PFltLd_dvolPFltEGFlt_mp CubMtrPerHr 4 0.00 3000.000 FORMAT "%8.3" EXTENDED_LIMITS -3276.800 3276.700 DEPOSIT ABSOLUTE /end AXIS_DESCR
/end CHARACTERISTIC
/begin CHARACTERISTIC PFltLd_resFlwOfs_MAP "Kennfeld Strömungswiderstandoffset durch Asche im Partikelfilter" MAP 0x800552AC Kf_Xs16_Ys16_Ws16 2.500000 Res_hPaHrPerCM 0.00 2.500000 FORMAT "%8.6" EXTENDED_LIMITS -3.276800 3.276700
 /begin AXIS_DESCR STD_AXIS ASMod_dvolPFltEG AirVolPerTime 8 0.00 3000.00000000 FORMAT "%13.8" EXTENDED_LIMITS -214748364.800 214748364.700 DEPOSIT ABSOLUTE /end AXIS_DESCR
 /begin AXIS_DESCR STD_AXIS PFltLd_volAsh Vol 8 0.00 100.0000 FORMAT "%8.4" EXTENDED_LIMITS -327.6800 327.6700 DEPOSIT ABSOLUTE /end AXIS_DESCR
/end CHARACTERISTIC
/begin CHARACTERISTIC PFltLd_resFlwPhysMax_C "Maximale Begrenzung des Strömungswiderstandes" VALUE 0x80055350 Kw_Ws16 2.500000 Res_hPaHrPerCM 0.00 2.500000 FORMAT "%8.6" EXTENDED_LIMITS -3.276800 3.276700 /end CHARACTERISTIC
/begin CHARACTERISTIC PFltLd_resFlwPhysMin_C "Minimale Begrenzung des Strömungswiderstandes" VALUE 0x80055352 Kw_Ws16 2.500000 Res_hPaHrPerCM 0.00 2.500000 FORMAT "%8.6" EXTENDED_LIMITS -3.276800 3.276700 /end CHARACTERISTIC
/begin CHARACTERISTIC PFltLd_resFlw_MAP "Strömungswiderstand als Funktion von Abgasvolumsstrom und Differenzdruck" MAP 0x80055354 Kf_Xs16_Ys16_Ws16 2.500000 Res_hPaHrPerCM 0.00 2.500000 FORMAT "%8.6" EXTENDED_LIMITS -3.276800 3.276700
 /begin AXIS_DESCR STD_AXIS PFltLd_pDiffSot_mp Pres_hPa 2 0.00 3500.000 EXTENDED_LIMITS -32768.00 32767.00 DEPOSIT ABSOLUTE /end AXIS_DESCR
 /begin AXIS_DESCR STD_AXIS PFltLd_dvolPT1Flt_mp AirVolPerTime 2 0.00 3000.000 FORMAT "%8.3" EXTENDED_LIMITS -3276.800 3276.700 DEPOSIT ABSOLUTE /end AXIS_DESCR
/end CHARACTERISTIC
/begin CHARACTERISTIC PFltLd_resSucRgnThres_C "Strömungswiderstand des Partikelfilters Schwelle darüber hinaus, den SotSim Integratoren nicht initialisiert werden sollen" VALUE 0x80055784 Val_Ws16 6.553500 Res_hPaHrPerCM -3.276800 3.276700 FORMAT "%8.6" /end CHARACTERISTIC
/begin CHARACTERISTIC PFltLd_rhoOilAsh_C "Dichte der Öl-Asche" VALUE 0x80055104 Kw_Ws16 2000.000 rhoOilAsh_g_p_l 0.00 2000.000 FORMAT "%8.3" EXTENDED_LIMITS -3276.800 3276.700 /end CHARACTERISTIC
/begin CHARACTERISTIC PFltLd_rLmbdStat_MAP "Stationäres Lambda für dynamische Korrektur" MAP 0x80055786 Map_Xs16Ys16Ws16 65.53500 lambda -32.76800 32.76700
 /begin AXIS_DESCR STD_AXIS Epm_nEng EngN 8 20.00000 10000.00 EXTENDED_LIMITS -16384.00 16383.50 DEPOSIT ABSOLUTE /end AXIS_DESCR
 /begin AXIS_DESCR STD_AXIS InjCtl_qSetUnBal InjMass 8 0.00 327.6700 EXTENDED_LIMITS -327.6800 327.6700 DEPOSIT ABSOLUTE /end AXIS_DESCR
/end CHARACTERISTIC
/begin CHARACTERISTIC PFltLd_rNO2Sot_C "stöchiometrisches NO2/Ruß-Verhältnis" VALUE 0x8005582A Val_Ws16 6.553500 rNO2Sot -3.276800 3.276700 FORMAT "%8.6" /end CHARACTERISTIC
/begin CHARACTERISTIC PFltLd_rNOxEngBas_MAP "Emissionskennfeld NOx-Massenstrom in ppm" MAP 0x8005582C Map_Xs16Ys16Ws16 0.006553500 RatNOxMass -0.003276800 0.003276700 FORMAT "%11.9"
 /begin AXIS_DESCR STD_AXIS Epm_nEng EngN 8 20.00000 10000.00 EXTENDED_LIMITS -16384.00 16383.50 DEPOSIT ABSOLUTE /end AXIS_DESCR
 /begin AXIS_DESCR STD_AXIS InjCtl_qSetUnBal InjMass 8 0.00 327.6700 EXTENDED_LIMITS -327.6800 327.6700 DEPOSIT ABSOLUTE /end AXIS_DESCR
/end CHARACTERISTIC
/begin CHARACTERISTIC PFltLd_rNOxEngEGROff_MAP "NOx Rohemissionen bei geschlossener EGR" MAP 0x800558D0 Map_Xs16Ys16Ws16 0.006553500 RatNOxMass -0.003276800 0.003276700 FORMAT "%11.9"
 /begin AXIS_DESCR STD_AXIS Epm_nEng EngN 8 20.00000 10000.00 EXTENDED_LIMITS -16384.00 16383.50 DEPOSIT ABSOLUTE /end AXIS_DESCR
 /begin AXIS_DESCR STD_AXIS InjCtl_qSetUnBal InjMass 8 0.00 327.6700 EXTENDED_LIMITS -327.6800 327.6700 DEPOSIT ABSOLUTE /end AXIS_DESCR
/end CHARACTERISTIC
/begin CHARACTERISTIC PFltLd_rNOxEngErr_MAP "NOx Rohemissionen im Fehlerfall" MAP 0x80055974 Map_Xs16Ys16Ws16 0.006553500 RatNOxMass -0.003276800 0.003276700 FORMAT "%11.9"
 /begin AXIS_DESCR STD_AXIS Epm_nEng EngN 8 20.00000 10000.00 EXTENDED_LIMITS -16384.00 16383.50 DEPOSIT ABSOLUTE /end AXIS_DESCR
 /begin AXIS_DESCR STD_AXIS InjCtl_qSetUnBal InjMass 8 0.00 327.6700 EXTENDED_LIMITS -327.6800 327.6700 DEPOSIT ABSOLUTE /end AXIS_DESCR
/end CHARACTERISTIC
/begin CHARACTERISTIC PFltLd_rO2SimRgn_MAP "Kennfeld zur Berechnung des Korrekturfaktors für die thermische Rußabbrandsberechnung abhängig von Lambda- und sauerstoffmassenstromabhängigen" MAP 0x80055A18 Map_Xs16Ys16Ws16 0.6553500 O2 -0.3276800 0.3276700
 /begin AXIS_DESCR STD_AXIS PFltLd_rO2Aprx O2 8 0.00 0.3000000 EXTENDED_LIMITS -0.3276800 0.3276700 DEPOSIT ABSOLUTE /end AXIS_DESCR
 /begin AXIS_DESCR STD_AXIS PFltLd_dmO2Aprx AirMassPerTime 8 0.00 50.00000 EXTENDED_LIMITS -3276.800 3276.700 DEPOSIT ABSOLUTE /end AXIS_DESCR
/end CHARACTERISTIC
/begin CHARACTERISTIC PFltLd_rO2Sot_C "Thermischer Russabbrandfaktor ergibt sich aus rO2/PFltLd_rO2Sot_C" VALUE 0x80055ABC Val_Ws16 0.6553500 O2 -0.3276800 0.3276700 /end CHARACTERISTIC
/begin CHARACTERISTIC PFltLd_rStoich_C "Stöchiometrisches Luft-Kraftstoff-Verhältnis" VALUE 0x80055ABE Val_Ws16 327.6750 AirFlRat -163.8400 163.8350 FORMAT "%8.4" /end CHARACTERISTIC
/begin CHARACTERISTIC PFltLd_stAshCorEOMMsk_C "Status der Aschekorrektur maske" VALUE 0x8005504C Val_Wu32 4294967295.00 OneToOne 0.00 4294967295.00 /end CHARACTERISTIC
/begin CHARACTERISTIC PFltLd_stFlwRstnPT1RgnMsk_C "Maske zur Bestimmung eines regenerationsrelevanten Zustands" VALUE 0x80055368 Val_Wu32 4294967295.00 OneToOne 0.00 4294967295.00 /end CHARACTERISTIC
/begin CHARACTERISTIC PFltLd_stMskRgnActv_CA "Masken-Array zur Auswahl der Betriebsarten, in denen auf Simulation der Partikelmasse umgeschaltet wird" VAL_BLK 0x800550B4 Kwb_Wu32 4294967295.00 OneToOne 0.00 4294967295.00 NUMBER 2 /end CHARACTERISTIC
/begin CHARACTERISTIC PFltLd_stSotSimInitEngPMsk_C "" VALUE 0x80055AC0 Val_Wu8 255.0 OneToOne 0.00 255.0 /end CHARACTERISTIC
/begin CHARACTERISTIC PFltLd_stSotSimInitRgnMsk_C "" VALUE 0x80055AC1 Val_Wu8 255.0 OneToOne 0.00 255.0 /end CHARACTERISTIC
/begin CHARACTERISTIC PFltLd_stSotSimInitTotMsk_C "" VALUE 0x80055AC2 Val_Wu8 255.0 OneToOne 0.00 255.0 /end CHARACTERISTIC
/begin CHARACTERISTIC PFltLd_swtAshCorActive_C "Aktivierung der AshCor-Funktion (1=function activ 0=inactive)" VALUE 0x80055050 Kw_Wu8 1.000 OneToOne 0.00 1.000 EXTENDED_LIMITS 0.00 255.0 /end CHARACTERISTIC
/begin CHARACTERISTIC PFltLd_swtAshCorOn_C "ash adjustment timer started" VALUE 0x80055051 Kw_Wu8 4.000 OneToOne 0.00 4.000 EXTENDED_LIMITS 0.00 255.0 /end CHARACTERISTIC
/begin CHARACTERISTIC PFltLd_swtMsSotResIniOn_C "Schalter zum Aktivieren der Restrußmasseinitialisierung von der Rußmassesimulation nach erfolgreichen Regeneration" VALUE 0x80055AC3 Val_Wu8 1.000 OneToOne 0.00 1.000 EXTENDED_LIMITS 0.00 255.0 /end CHARACTERISTIC
/begin CHARACTERISTIC PFltLd_swtRNOxCalc_C "0: rNOx Berechnung aus ASMod, 1: rNOx Berechnung kundenspezifisch" VALUE 0x80055AC4 Val_Wu8 1.000 OneToOne 0.00 1.000 EXTENDED_LIMITS 0.00 255.0 /end CHARACTERISTIC
/begin CHARACTERISTIC PFltLd_swtSelFacNO2I_C "Schalt für Eingangsgroesse vom Integrator von PFlt_facNO2Rgn auswählen" VALUE 0x80055AC5 Val_Wu8 1.000 OneToOne 0.00 1.000 EXTENDED_LIMITS 0.00 255.0 /end CHARACTERISTIC
/begin CHARACTERISTIC PFltLd_swtSensEvalSel_C "Auswahlschalter für Methode der Sensorauswertung" VALUE 0x8005536C Kw_Wu8 1.000 OneToOne 0.00 1.000 EXTENDED_LIMITS 0.00 255.0 /end CHARACTERISTIC
/begin CHARACTERISTIC PFltLd_swtSimRgnNO2Off_C "Schalter zum Deaktivieren des NO2- Effektbetrachtung" VALUE 0x80055AC6 Val_Wu8 1.000 OneToOne 0.00 1.000 EXTENDED_LIMITS 0.00 255.0 /end CHARACTERISTIC
/begin CHARACTERISTIC PFltLd_swtSotCalcInitOff_C "Schalter zur Deaktivierung der Initialisierung des PT1-Filters für den Strömungswiderstand" VALUE 0x8005536D Val_Wu8 1.000 OneToOne 0.00 1.000 EXTENDED_LIMITS 0.00 255.0 /end CHARACTERISTIC
/begin CHARACTERISTIC PFltLd_swtSotSimInit_C "" VALUE 0x80055AC7 Val_Wu8 1.000 OneToOne 0.00 1.000 EXTENDED_LIMITS 0.00 255.0 /end CHARACTERISTIC
/begin CHARACTERISTIC PFltLd_swtSotSim_C "Schalter zur Auswahl der simulierten Rußmasse für Rußmassenberechnung im Partikelfilter" VALUE 0x80055AC8 Val_Wu8 2.000 OneToOne 0.00 2.000 EXTENDED_LIMITS 0.00 255.0 /end CHARACTERISTIC
/begin CHARACTERISTIC PFltLd_tAirFltAshCorMax_C "maximal zulässiger Wert Lufttemperatur" VALUE 0x80055052 Kw_Ws16 250.0000 Temp_Cels -50.14000 199.8600 EXTENDED_LIMITS -3549.940 3003.560 /end CHARACTERISTIC
/begin CHARACTERISTIC PFltLd_tAirFltAshCorMin_C "minimal zulässiger Wert Lufttemperatur" VALUE 0x80055054 Kw_Ws16 250.0000 Temp_Cels -50.14000 199.8600 EXTENDED_LIMITS -3549.940 3003.560 /end CHARACTERISTIC
/begin CHARACTERISTIC PFltLd_tCIntAshCorMax_C "maximal zulässiger Wert Kühlmitteltemperatur" VALUE 0x80055056 Kw_Ws16 250.0000 Temp_Cels -50.14000 199.8600 EXTENDED_LIMITS -3549.940 3003.560 /end CHARACTERISTIC
/begin CHARACTERISTIC PFltLd_tCIntAshCorMin_C "minimal zulässiger Wert Kühlmitteltemperatur" VALUE 0x80055058 Kw_Ws16 250.0000 Temp_Cels -50.14000 199.8600 EXTENDED_LIMITS -3549.940 3003.560 /end CHARACTERISTIC
/begin CHARACTERISTIC PFltLd_tiAftSucRgn_C "Zeit verging, nach erfolgreicher Regeneration, danach, welche SotSim Integratoren initialisiert werden sollen" VALUE 0x80055ACC Val_Ws32 42949672.9500 Time_s -21474836.4800 21474836.4700 /end CHARACTERISTIC
/begin CHARACTERISTIC PFltLd_tiAshCorAirTempPT1_C "Zeitkonstante Lufttemperatur" VALUE 0x8005505C Kw_Wu32 4294.8272945 TimeDelay_s 0.14000154169 4294.9672960 FORMAT "%12.7" EXTENDED_LIMITS 0.000001000000000 4294.9672960 /end CHARACTERISTIC
/begin CHARACTERISTIC PFltLd_tiAshCorCIntTempPT1_C "Zeitkonstante Kühlmitteltemperatur" VALUE 0x80055060 Kw_Wu32 4294.8272945 TimeDelay_s 0.14000154169 4294.9672960 FORMAT "%12.7" EXTENDED_LIMITS 0.000001000000000 4294.9672960 /end CHARACTERISTIC
/begin CHARACTERISTIC PFltLd_tiAshCorDVolPT1_C "time constant for exhaust gas volume flow before PFlt" VALUE 0x80055064 Kw_Wu32 4294.8272945 TimeDelay_s 0.14000154169 4294.9672960 FORMAT "%12.7" EXTENDED_LIMITS 0.000001000000000 4294.9672960 /end CHARACTERISTIC
/begin CHARACTERISTIC PFltLd_tiAshCorEngSpdPT1_C "Zeitkonstante Drehzahl" VALUE 0x80055068 Kw_Wu32 4294.8272945 TimeDelay_s 0.14000154169 4294.9672960 FORMAT "%12.7" EXTENDED_LIMITS 0.000001000000000 4294.9672960 /end CHARACTERISTIC
/begin CHARACTERISTIC PFltLd_tiAshCorInjMsPT1_C "Zeitkonstante aktuelle Einspritzmasse" VALUE 0x8005506C Kw_Wu32 4294.8272945 TimeDelay_s 0.14000154169 4294.9672960 FORMAT "%12.7" EXTENDED_LIMITS 0.000001000000000 4294.9672960 /end CHARACTERISTIC
/begin CHARACTERISTIC PFltLd_tiAshCorOxiTempPT1_C "Zeitkonstante OxiKat-Temperatur" VALUE 0x80055070 Kw_Wu32 4294.8272945 TimeDelay_s 0.14000154169 4294.9672960 FORMAT "%12.7" EXTENDED_LIMITS 0.000001000000000 4294.9672960 /end CHARACTERISTIC
/begin CHARACTERISTIC PFltLd_tiAshCorPreTempPT1_C "Zeitkonstante Vortemperatur Partikelfilter" VALUE 0x80055074 Kw_Wu32 4294.8272945 TimeDelay_s 0.14000154169 4294.9672960 FORMAT "%12.7" EXTENDED_LIMITS 0.000001000000000 4294.9672960 /end CHARACTERISTIC
/begin CHARACTERISTIC PFltLd_tiAshCorResFlwPT1_C "Zeitkonstante gefilterter Stromwiderstand" VALUE 0x80055078 Kw_Wu32 4294.8272945 TimeDelay_s 0.14000154169 4294.9672960 FORMAT "%12.7" EXTENDED_LIMITS 0.000001000000000 4294.9672960 /end CHARACTERISTIC
/begin CHARACTERISTIC PFltLd_tiAshCorRgnMax_C "maximale Zeit für Aschekorrektur Regeneration" VALUE 0x8005507C Kw_Ws32 30000.0000000 Time_ms 0.00 30000.0000000 EXTENDED_LIMITS -21474836480.0 21474836470.0 /end CHARACTERISTIC
/begin CHARACTERISTIC PFltLd_tiAshCorRgn_C "Zeit für Aschekorrektur Regeneration" VALUE 0x80055080 Kw_Ws32 30000.0000000 Time_ms 0.00 30000.0000000 EXTENDED_LIMITS -21474836480.0 21474836470.0 /end CHARACTERISTIC
/begin CHARACTERISTIC PFltLd_tiAshCorRlsOn_C "Entprellzeit Simulation EIN" VALUE 0x80055084 Kw_Wu16 30000.00 Time_ms 0.00 30000.00 EXTENDED_LIMITS 0.00 655350.0 /end CHARACTERISTIC
/begin CHARACTERISTIC PFltLd_tiAshCorVehAccPT1_C "Zeitkonstante Fahrzeugbeschleunigung" VALUE 0x80055088 Kw_Wu32 4294.8272945 TimeDelay_s 0.14000154169 4294.9672960 FORMAT "%12.7" EXTENDED_LIMITS 0.000001000000000 4294.9672960 /end CHARACTERISTIC
/begin CHARACTERISTIC PFltLd_tiAshCorVehSpdPT1_C "Zeitkonstante Fahrzeuggeschwindigkeit" VALUE 0x8005508C Kw_Wu32 4294.8272945 TimeDelay_s 0.14000154169 4294.9672960 FORMAT "%12.7" EXTENDED_LIMITS 0.000001000000000 4294.9672960 /end CHARACTERISTIC
/begin CHARACTERISTIC PFltLd_tiAshCorWaitMax_C "Regenerationsdauer" VALUE 0x80055090 Kw_Ws32 655140.000000 Time_s 0.00 655140.000000 EXTENDED_LIMITS -21474836.4800 21474836.4700 /end CHARACTERISTIC
/begin CHARACTERISTIC PFltLd_tiFlwRstnAbsPT1_C "Der PT1Filter Zeit konstant für Berechnung von PFltld_resFlwFltAbs" VALUE 0x80055370 Val_Ws32 4294.9672940 TimeDelay_s 0.000002000000001 4294.9672960 FORMAT "%12.7" /end CHARACTERISTIC
/begin CHARACTERISTIC PFltLd_tiFlwRstnAbsRgnPT1_C "Zeitkonstant des PT1-Filters für den Stömungswiederstand in Regenerationsbetrieb" VALUE 0x80055374 Val_Ws32 4294.9672940 TimeDelay_s 0.000002000000001 4294.9672960 FORMAT "%12.7" /end CHARACTERISTIC
/begin CHARACTERISTIC PFltLd_tiFlwRstnPT1_C "Zeitkonstante für Strömungswiderstand" VALUE 0x80055378 Val_Ws32 4294.9672940 TimeDelay_s 0.000002000000001 4294.9672960 FORMAT "%12.7" /end CHARACTERISTIC
/begin CHARACTERISTIC PFltLd_tiFlwRstnRgnPT1_C "Zeitkonstant des PT1-Filters für den Stömungswiederstand in Regenerationsbetrieb" VALUE 0x8005537C Val_Ws32 4294.9672940 TimeDelay_s 0.000002000000001 4294.9672960 FORMAT "%12.7" /end CHARACTERISTIC
/begin CHARACTERISTIC PFltLd_tiMaxOfsNO2_C "Maximaler Mittelungszeit für die Berechnung des Rußmassenoffsetwerts bei NO2-Regeneration" VALUE 0x80055380 Val_Ws16 3600.000 TimeRed 0.00 3600.000 FORMAT "%8.3" EXTENDED_LIMITS -5242.880 5242.720 /end CHARACTERISTIC
/begin CHARACTERISTIC PFltLd_tiMaxOfsStrt_C "Maximaler Mittelungszeit für die Berechnung des Rußmassenoffsetwerts bei Motorstart" VALUE 0x80055382 Val_Ws16 3600.000 TimeRed 0.00 3600.000 FORMAT "%8.3" EXTENDED_LIMITS -5242.880 5242.720 /end CHARACTERISTIC
/begin CHARACTERISTIC PFltLd_tiNO2RgnDel_MAP "Verzugszeit der NO2-Regeneration" MAP 0x80055AD0 Map_Xs16Ys16Ws16 32767.00 Time_s 0.00 32767.00 EXTENDED_LIMITS -327.6800 327.6700
 /begin AXIS_DESCR STD_AXIS Epm_nEng EngN 2 20.00000 10000.00 EXTENDED_LIMITS -16384.00 16383.50 DEPOSIT ABSOLUTE /end AXIS_DESCR
 /begin AXIS_DESCR STD_AXIS InjCtl_qSetUnBal InjMass 2 0.00 327.6700 EXTENDED_LIMITS -327.6800 327.6700 DEPOSIT ABSOLUTE /end AXIS_DESCR
/end CHARACTERISTIC
/begin CHARACTERISTIC PFltLd_tiOfsNO2Del_C "Minimale Gültigkeitszeit der Rußmassenberechnung zur Freigabe der Mittelwertbildung des Rußmassenoffsets bei NO2-Regeneration" VALUE 0x80055384 Val_Ws16 3600.000 Time_ms 0.00 3600.000 EXTENDED_LIMITS -327680.0 327670.0 /end CHARACTERISTIC
/begin CHARACTERISTIC PFltLd_tiOfsStrtDel_C "Minimale Gültigkeitszeit der Rußmassenberechnung zur Freigabe der Mittelwertbildung des Rußmassenoffsets bei Motorstart" VALUE 0x80055386 Val_Ws16 3600.000 Time_ms 0.00 3600.000 EXTENDED_LIMITS -327680.0 327670.0 /end CHARACTERISTIC
/begin CHARACTERISTIC PFltLd_tiPPreDVolDynFlt_MAP "Zeitkonstante des PT1 Filters" MAP 0x80055388 Map_Xs16Ys16Ws16 4000.000 TimeDelay_s_Lin_16_2 0.00 4000.000 FORMAT "%8.3" EXTENDED_LIMITS -2000.061 2000.000
 /begin AXIS_DESCR STD_AXIS PFltLd_pPPreDVolDynFlt_mp Pres_hPa 2 0.00 3500.000 EXTENDED_LIMITS -32768.00 32767.00 DEPOSIT ABSOLUTE /end AXIS_DESCR
 /begin AXIS_DESCR STD_AXIS ASMod_dvolPFltEG AirVolPerTime 8 0.00 30000.0000000 FORMAT "%13.7" EXTENDED_LIMITS -214748364.800 214748364.700 DEPOSIT ABSOLUTE /end AXIS_DESCR
/end CHARACTERISTIC
/begin CHARACTERISTIC PFltLd_tiVolFlwPT1_C "Zeitkonstant des PT1-Filers für Abgasvolumenstom" VALUE 0x800553C0 Val_Ws32 4294.9672940 TimeDelay_s 0.000002000000001 4294.9672960 FORMAT "%12.7" /end CHARACTERISTIC
/begin CHARACTERISTIC PFltLd_tiVolFlwRgnPT1_C "Zeitkonstant des PT1-Filers für Abgasvolumenstom in Regeneration" VALUE 0x800553C4 Val_Ws32 4294.9672940 TimeDelay_s 0.000002000000001 4294.9672960 FORMAT "%12.7" /end CHARACTERISTIC
/begin CHARACTERISTIC PFltLd_tOxiPreFltAshCorMax_C "maximal zulässiger Wert Temperatur vor dem OxiKat" VALUE 0x80055094 Kw_Ws16 1050.000 Temp_Cels 222.9600 1272.960 EXTENDED_LIMITS -3549.940 3003.560 /end CHARACTERISTIC
/begin CHARACTERISTIC PFltLd_tOxiPreFltAshCorMin_C "minimal zulässiger Wert Temperatur vor dem OxiKat" VALUE 0x80055096 Kw_Ws16 1050.000 Temp_Cels 222.9600 1272.960 EXTENDED_LIMITS -3549.940 3003.560 /end CHARACTERISTIC
/begin CHARACTERISTIC PFltLd_tPreFltAshCorMax_C "maximal zulässiger Wert Vortemperatur Partikelfilter" VALUE 0x80055098 Kw_Ws16 1050.000 Temp_Cels 222.9600 1272.960 EXTENDED_LIMITS -3549.940 3003.560 /end CHARACTERISTIC
/begin CHARACTERISTIC PFltLd_tPreFltAshCorMin_C "Minimum permissible value for for temperature pre particle filter" VALUE 0x8005509A Kw_Ws16 1050.000 Temp_Cels 222.9600 1272.960 EXTENDED_LIMITS -3549.940 3003.560 /end CHARACTERISTIC
/begin CHARACTERISTIC PFltLd_volPFlt_C "Volumen des Partikel Filters" VALUE 0x800550BC Kw_Ws16 99.99000 Vol 0.01000000 100.0000 FORMAT "%8.4" EXTENDED_LIMITS -327.6800 327.6700 /end CHARACTERISTIC
/begin CHARACTERISTIC PFltLd_vVehFltAshCorMax_C "maximal zulässiger Wert Fahrzeuggeschwindigkeit" VALUE 0x8005509C Kw_Ws16 300.0000 Vel 0.00 300.0000 EXTENDED_LIMITS -327.6800 327.6700 /end CHARACTERISTIC
/begin CHARACTERISTIC PFltLd_vVehFltAshCorMin_C "minimal zulässiger Wert Fahrzeuggeschwindigkeit" VALUE 0x8005509E Kw_Ws16 300.0000 Vel 0.00 300.0000 EXTENDED_LIMITS -327.6800 327.6700 /end CHARACTERISTIC
/begin CHARACTERISTIC PFltPOp_DebBrk.tiHiLo_C "Entprellzeit für Bremssignal/" VALUE 0x80056034 Kw_Ws16 3000.000 TimeDeb 0.00 3000.000 EXTENDED_LIMITS -327680.0 327670.0 /end CHARACTERISTIC
/begin CHARACTERISTIC PFltPOp_DebBrk.tiLoHi_C "Entprellzeit für Bremssignal/" VALUE 0x80056036 Kw_Ws16 3000.000 TimeDeb 0.00 3000.000 EXTENDED_LIMITS -327680.0 327670.0 /end CHARACTERISTIC
/begin CHARACTERISTIC PFltPOp_DebClth.tiHiLo_C "Entprellzeit für Kupplungssignal/" VALUE 0x80056038 Kw_Ws16 3000.000 TimeDeb 0.00 3000.000 EXTENDED_LIMITS -327680.0 327670.0 /end CHARACTERISTIC
/begin CHARACTERISTIC PFltPOp_DebClth.tiLoHi_C "Entprellzeit für Kupplungssignal/" VALUE 0x8005603A Kw_Ws16 3000.000 TimeDeb 0.00 3000.000 EXTENDED_LIMITS -327680.0 327670.0 /end CHARACTERISTIC
/begin CHARACTERISTIC PFltPOp_DebGear.tiHiLo_C "Entprellzeit für Gangsignal/" VALUE 0x8005603C Kw_Ws16 3000.000 TimeDeb 0.00 3000.000 EXTENDED_LIMITS -327680.0 327670.0 /end CHARACTERISTIC
/begin CHARACTERISTIC PFltPOp_DebGear.tiLoHi_C "Entprellzeit für Gangsignal/" VALUE 0x8005603E Kw_Ws16 3000.000 TimeDeb 0.00 3000.000 EXTENDED_LIMITS -327680.0 327670.0 /end CHARACTERISTIC
/begin CHARACTERISTIC PFltPOp_nEng_CA "Matrix zur Bestimmung der Bereichsgrenzen für die gefilterte mittlere Drehzahl" MAP 0x80055AE8 Kf_Xs16_Ys16_Ws16 32767.50 EngN -16384.00 16383.50
 /begin AXIS_DESCR STD_AXIS PFltPOp_RngIdx_X_mp OneToOne 11 0.00 255.0 DEPOSIT ABSOLUTE /end AXIS_DESCR
 /begin AXIS_DESCR STD_AXIS PFltPOp_RngIdx_Y_mp OneToOne 2 0.00 255.0 DEPOSIT ABSOLUTE /end AXIS_DESCR
/end CHARACTERISTIC
/begin CHARACTERISTIC PFltPOp_numAir_C "Pointer zu Lufttemperaturfeld" VALUE 0x80055B32 Kw_Wu8 2.00000000000 IndSysTempFldSel 0.00 2.00000000000 FORMAT "%13.11" /end CHARACTERISTIC
/begin CHARACTERISTIC PFltPOp_numEngTemp_C "Pointer zum Ansauglufttemperaturfeld" VALUE 0x80056040 Val_Wu8 2.00000000000 EngTempFldSel 0.00 2.00000000000 FORMAT "%13.11" EXTENDED_LIMITS 0.00 3.00000000000 /end CHARACTERISTIC
/begin CHARACTERISTIC PFltPOp_qSetUnBalRng10Max_GCUR "Obere Schwellen-Kraftstoffmengenkennlinie für Bereich 10" CURVE 0x80055B34 Gkl_Ws16 655.3500 InjMass -327.6800 327.6700
 /begin AXIS_DESCR COM_AXIS PFltPOp_nEngFlt EngN 8 -16384.00 16383.50 AXIS_PTS_REF PFltPOp_qSetUnBal_AXIS /end AXIS_DESCR
/end CHARACTERISTIC
/begin CHARACTERISTIC PFltPOp_qSetUnBalRng10Min_GCUR "Untere Schwellen-Kraftstoffmengenkennlinie für Bereich 10" CURVE 0x80055B44 Gkl_Ws16 655.3500 InjMass -327.6800 327.6700
 /begin AXIS_DESCR COM_AXIS PFltPOp_nEngFlt EngN 8 -16384.00 16383.50 AXIS_PTS_REF PFltPOp_qSetUnBal_AXIS /end AXIS_DESCR
/end CHARACTERISTIC
/begin CHARACTERISTIC PFltPOp_qSetUnBalRng1Max_GCUR "Obere Schwellen-Kraftstoffmengenkennlinie für Bereich 1" CURVE 0x80055B54 Gkl_Ws16 655.3500 InjMass -327.6800 327.6700
 /begin AXIS_DESCR COM_AXIS PFltPOp_nEngFlt EngN 8 -16384.00 16383.50 AXIS_PTS_REF PFltPOp_qSetUnBal_AXIS /end AXIS_DESCR
/end CHARACTERISTIC
/begin CHARACTERISTIC PFltPOp_qSetUnBalRng1Min_GCUR "Untere Schwellen-Kraftstoffmengenkennlinie für Bereich 1" CURVE 0x80055B64 Gkl_Ws16 655.3500 InjMass -327.6800 327.6700
 /begin AXIS_DESCR COM_AXIS PFltPOp_nEngFlt EngN 8 -16384.00 16383.50 AXIS_PTS_REF PFltPOp_qSetUnBal_AXIS /end AXIS_DESCR
/end CHARACTERISTIC
/begin CHARACTERISTIC PFltPOp_qSetUnBalRng2Max_GCUR "Obere Schwellen-Kraftstoffmengenkennlinie für Bereich 2" CURVE 0x80055B74 Gkl_Ws16 655.3500 InjMass -327.6800 327.6700
 /begin AXIS_DESCR COM_AXIS PFltPOp_nEngFlt EngN 8 -16384.00 16383.50 AXIS_PTS_REF PFltPOp_qSetUnBal_AXIS /end AXIS_DESCR
/end CHARACTERISTIC
/begin CHARACTERISTIC PFltPOp_qSetUnBalRng2Min_GCUR "Untere Schwellen-Kraftstoffmengenkennlinie für Bereich 2" CURVE 0x80055B84 Gkl_Ws16 655.3500 InjMass -327.6800 327.6700
 /begin AXIS_DESCR COM_AXIS PFltPOp_nEngFlt EngN 8 -16384.00 16383.50 AXIS_PTS_REF PFltPOp_qSetUnBal_AXIS /end AXIS_DESCR
/end CHARACTERISTIC
/begin CHARACTERISTIC PFltPOp_qSetUnBalRng3Max_GCUR "Obere Schwellen-Kraftstoffmengenkennlinie für Bereich 3" CURVE 0x80055B94 Gkl_Ws16 655.3500 InjMass -327.6800 327.6700
 /begin AXIS_DESCR COM_AXIS PFltPOp_nEngFlt EngN 8 -16384.00 16383.50 AXIS_PTS_REF PFltPOp_qSetUnBal_AXIS /end AXIS_DESCR
/end CHARACTERISTIC
/begin CHARACTERISTIC PFltPOp_qSetUnBalRng3Min_GCUR "Untere Schwellen-Kraftstoffmengenkennlinie für Bereich 3" CURVE 0x80055BA4 Gkl_Ws16 655.3500 InjMass -327.6800 327.6700
 /begin AXIS_DESCR COM_AXIS PFltPOp_nEngFlt EngN 8 -16384.00 16383.50 AXIS_PTS_REF PFltPOp_qSetUnBal_AXIS /end AXIS_DESCR
/end CHARACTERISTIC
/begin CHARACTERISTIC PFltPOp_qSetUnBalRng4Max_GCUR "Obere Schwellen-Kraftstoffmengenkennlinie für Bereich 4" CURVE 0x80055BB4 Gkl_Ws16 655.3500 InjMass -327.6800 327.6700
 /begin AXIS_DESCR COM_AXIS PFltPOp_nEngFlt EngN 8 -16384.00 16383.50 AXIS_PTS_REF PFltPOp_qSetUnBal_AXIS /end AXIS_DESCR
/end CHARACTERISTIC
/begin CHARACTERISTIC PFltPOp_qSetUnBalRng4Min_GCUR "Untere Schwellen-Kraftstoffmengenkennlinie für Bereich 4" CURVE 0x80055BC4 Gkl_Ws16 655.3500 InjMass -327.6800 327.6700
 /begin AXIS_DESCR COM_AXIS PFltPOp_nEngFlt EngN 8 -16384.00 16383.50 AXIS_PTS_REF PFltPOp_qSetUnBal_AXIS /end AXIS_DESCR
/end CHARACTERISTIC
/begin CHARACTERISTIC PFltPOp_qSetUnBalRng5Max_GCUR "Obere Schwellen-Kraftstoffmengenkennlinie für Bereich 5" CURVE 0x80055BD4 Gkl_Ws16 655.3500 InjMass -327.6800 327.6700
 /begin AXIS_DESCR COM_AXIS PFltPOp_nEngFlt EngN 8 -16384.00 16383.50 AXIS_PTS_REF PFltPOp_qSetUnBal_AXIS /end AXIS_DESCR
/end CHARACTERISTIC
/begin CHARACTERISTIC PFltPOp_qSetUnBalRng5Min_GCUR "Untere Schwellen-Kraftstoffmengenkennlinie für Bereich 5" CURVE 0x80055BE4 Gkl_Ws16 655.3500 InjMass -327.6800 327.6700
 /begin AXIS_DESCR COM_AXIS PFltPOp_nEngFlt EngN 8 -16384.00 16383.50 AXIS_PTS_REF PFltPOp_qSetUnBal_AXIS /end AXIS_DESCR
/end CHARACTERISTIC
/begin CHARACTERISTIC PFltPOp_qSetUnBalRng6Max_GCUR "Obere Schwellen-Kraftstoffmengenkennlinie für Bereich 6" CURVE 0x80055BF4 Gkl_Ws16 655.3500 InjMass -327.6800 327.6700
 /begin AXIS_DESCR COM_AXIS PFltPOp_nEngFlt EngN 8 -16384.00 16383.50 AXIS_PTS_REF PFltPOp_qSetUnBal_AXIS /end AXIS_DESCR
/end CHARACTERISTIC
/begin CHARACTERISTIC PFltPOp_qSetUnBalRng6Min_GCUR "Untere Schwellen-Kraftstoffmengenkennlinie für Bereich 6" CURVE 0x80055C04 Gkl_Ws16 655.3500 InjMass -327.6800 327.6700
 /begin AXIS_DESCR COM_AXIS PFltPOp_nEngFlt EngN 8 -16384.00 16383.50 AXIS_PTS_REF PFltPOp_qSetUnBal_AXIS /end AXIS_DESCR
/end CHARACTERISTIC
/begin CHARACTERISTIC PFltPOp_qSetUnBalRng7Max_GCUR "Obere Schwellen-Kraftstoffmengenkennlinie für Bereich 7" CURVE 0x80055C14 Gkl_Ws16 655.3500 InjMass -327.6800 327.6700
 /begin AXIS_DESCR COM_AXIS PFltPOp_nEngFlt EngN 8 -16384.00 16383.50 AXIS_PTS_REF PFltPOp_qSetUnBal_AXIS /end AXIS_DESCR
/end CHARACTERISTIC
/begin CHARACTERISTIC PFltPOp_qSetUnBalRng7Min_GCUR "Untere Schwellen-Kraftstoffmengenkennlinie für Bereich 7" CURVE 0x80055C24 Gkl_Ws16 655.3500 InjMass -327.6800 327.6700
 /begin AXIS_DESCR COM_AXIS PFltPOp_nEngFlt EngN 8 -16384.00 16383.50 AXIS_PTS_REF PFltPOp_qSetUnBal_AXIS /end AXIS_DESCR
/end CHARACTERISTIC
/begin CHARACTERISTIC PFltPOp_qSetUnBalRng8Max_GCUR "Obere Schwellen-Kraftstoffmengenkennlinie für Bereich 8" CURVE 0x80055C34 Gkl_Ws16 655.3500 InjMass -327.6800 327.6700
 /begin AXIS_DESCR COM_AXIS PFltPOp_nEngFlt EngN 8 -16384.00 16383.50 AXIS_PTS_REF PFltPOp_qSetUnBal_AXIS /end AXIS_DESCR
/end CHARACTERISTIC
/begin CHARACTERISTIC PFltPOp_qSetUnBalRng8Min_GCUR "Untere Schwellen-Kraftstoffmengenkennlinie für Bereich 8" CURVE 0x80055C44 Gkl_Ws16 655.3500 InjMass -327.6800 327.6700
 /begin AXIS_DESCR COM_AXIS PFltPOp_nEngFlt EngN 8 -16384.00 16383.50 AXIS_PTS_REF PFltPOp_qSetUnBal_AXIS /end AXIS_DESCR
/end CHARACTERISTIC
/begin CHARACTERISTIC PFltPOp_qSetUnBalRng9Max_GCUR "Obere Schwellen-Kraftstoffmengenkennlinie für Bereich 9" CURVE 0x80055C54 Gkl_Ws16 655.3500 InjMass -327.6800 327.6700
 /begin AXIS_DESCR COM_AXIS PFltPOp_nEngFlt EngN 8 -16384.00 16383.50 AXIS_PTS_REF PFltPOp_qSetUnBal_AXIS /end AXIS_DESCR
/end CHARACTERISTIC
/begin CHARACTERISTIC PFltPOp_qSetUnBalRng9Min_GCUR "Untere Schwellen-Kraftstoffmengenkennlinie für Bereich 9" CURVE 0x80055C64 Gkl_Ws16 655.3500 InjMass -327.6800 327.6700
 /begin AXIS_DESCR COM_AXIS PFltPOp_nEngFlt EngN 8 -16384.00 16383.50 AXIS_PTS_REF PFltPOp_qSetUnBal_AXIS /end AXIS_DESCR
/end CHARACTERISTIC
/begin CHARACTERISTIC PFltPOp_qSetUnBalRngSpoMax_GCUR "Obere Schwellen-Kraftstoffmengenkennlinie für spontane Bereiche" CURVE 0x80055C74 Gkl_Ws16 655.3500 InjMass -327.6800 327.6700
 /begin AXIS_DESCR COM_AXIS PFltPOp_nEngFlt EngN 8 -16384.00 16383.50 AXIS_PTS_REF PFltPOp_qSetUnBal_AXIS /end AXIS_DESCR
/end CHARACTERISTIC
/begin CHARACTERISTIC PFltPOp_qSetUnBalRngSpoMin_GCUR "Untere Schwellen-Kraftstoffmengenkennlinie für spontane Bereiche" CURVE 0x80055C84 Gkl_Ws16 655.3500 InjMass -327.6800 327.6700
 /begin AXIS_DESCR COM_AXIS PFltPOp_nEngFlt EngN 8 -16384.00 16383.50 AXIS_PTS_REF PFltPOp_qSetUnBal_AXIS /end AXIS_DESCR
/end CHARACTERISTIC
/begin AXIS_PTS PFltPOp_qSetUnBal_AXIS "Achse für Gruppenkennlinien zur Ermittlung der Bereichsgrenzen der Einspritzmenge" 0x80055C94 PFltPOp_nEngFlt GSst_Xs16 32767.50 EngN 8 -16384.00 16383.50 FORMAT "%8.2" DEPOSIT ABSOLUTE /end AXIS_PTS
/begin CHARACTERISTIC PFltPOp_qTrq2Qnt_CUR "Kennlinie zur Umrechnung des Drehmoments in eine virtuelle Einspritzmenge" CURVE 0x80056042 Cur_Xs16Ws16 655.3500 InjMass -327.6800 327.6700
 /begin AXIS_DESCR STD_AXIS PthSet_trqInrSet Trq 2 -500.0000 1000.000 EXTENDED_LIMITS -3276.800 3276.700 DEPOSIT ABSOLUTE /end AXIS_DESCR
/end CHARACTERISTIC
/begin CHARACTERISTIC PFltPOp_rAPP_CA "Matrix zur Bestimmung der Bereichsgrenzen für das gefilterte Pedalwertgebersignal" MAP 0x80055CA6 Kf_Xs16_Ys16_Ws16 799.9878 Prc -400.0000 399.9878
 /begin AXIS_DESCR STD_AXIS PFltPOp_RngIdx_X_mp OneToOne 11 0.00 255.0 DEPOSIT ABSOLUTE /end AXIS_DESCR
 /begin AXIS_DESCR STD_AXIS PFltPOp_RngIdx_Y_mp OneToOne 2 0.00 255.0 DEPOSIT ABSOLUTE /end AXIS_DESCR
/end CHARACTERISTIC
/begin CHARACTERISTIC PFltPOp_stGearDebValMax_C "Maximaler Schaltsignalwert für die Entprellungsfunktion" VALUE 0x8005604C Val_Ws8 7.000 OneToOne -1.000 6.000 EXTENDED_LIMITS -128.0 127.0 /end CHARACTERISTIC
/begin CHARACTERISTIC PFltPOp_stGearDebValMin_C "Minimaler Schaltsignalwert für die Entprellungsfunktion" VALUE 0x8005604D Val_Ws8 7.000 OneToOne -1.000 6.000 EXTENDED_LIMITS -128.0 127.0 /end CHARACTERISTIC
/begin CHARACTERISTIC PFltPOp_stGear_CA "Matrix zur Bestimmung der Bereichsgrenzen für den eingelegten Gang" MAP 0x80055CF0 Kf_Xs16_Ys16_Ws16 65535.00 OneToOne -32768.00 32767.00
 /begin AXIS_DESCR STD_AXIS PFltPOp_RngIdx_X_mp OneToOne 11 0.00 255.0 DEPOSIT ABSOLUTE /end AXIS_DESCR
 /begin AXIS_DESCR STD_AXIS PFltPOp_RngIdx_Y_mp OneToOne 2 0.00 255.0 DEPOSIT ABSOLUTE /end AXIS_DESCR
/end CHARACTERISTIC
/begin CHARACTERISTIC PFltPOp_swtBrkRng_CA "Array zur Bestimmung der Bereichswerte für das entprellte Bremssignal" VAL_BLK 0x80055D3A ValA_Wu8 255.0 OneToOne 0.00 255.0 NUMBER 11 /end CHARACTERISTIC
/begin CHARACTERISTIC PFltPOp_swtClthRng_CA "Array zur Bestimmung der Bereichswerte für das entprellte Bremssignal" VAL_BLK 0x80055D45 ValA_Wu8 255.0 OneToOne 0.00 255.0 NUMBER 11 /end CHARACTERISTIC
/begin CHARACTERISTIC PFltPOp_swtTrqQnt_C "Schalter zur Auswahl von Einspritzmenge oder Drehmoment zur Betriebspunktberechnung" VALUE 0x8005604E Val_Wu8 1.000 OneToOne 0.00 1.000 EXTENDED_LIMITS 0.00 255.0 /end CHARACTERISTIC
/begin CHARACTERISTIC PFltPOp_tAdapTOxiCatUsOff_CA "Matrix zur Bestimmung der Bereichsgrenzen für die gefilterte Abgastemperatur vom Oxidationskatalysator bei inaktivem Bereich" MAP 0x80055D50 Kf_Xs16_Ys16_Ws16 6553.500 Temp_Cels -3549.940 3003.560
 /begin AXIS_DESCR STD_AXIS PFltPOp_RngIdx_X_mp OneToOne 11 0.00 255.0 DEPOSIT ABSOLUTE /end AXIS_DESCR
 /begin AXIS_DESCR STD_AXIS PFltPOp_RngIdx_Y_mp OneToOne 2 0.00 255.0 DEPOSIT ABSOLUTE /end AXIS_DESCR
/end CHARACTERISTIC
/begin CHARACTERISTIC PFltPOp_tAdapTOxiCatUsOn_CA "Matrix zur Bestimmung der Bereichsgrenzen für die gefilterte Abgastemperatur vom Oxidationskatalysator bei aktivem Bereich" MAP 0x80055D9A Kf_Xs16_Ys16_Ws16 6553.500 Temp_Cels -3549.940 3003.560
 /begin AXIS_DESCR STD_AXIS PFltPOp_RngIdx_X_mp OneToOne 11 0.00 255.0 DEPOSIT ABSOLUTE /end AXIS_DESCR
 /begin AXIS_DESCR STD_AXIS PFltPOp_RngIdx_Y_mp OneToOne 2 0.00 255.0 DEPOSIT ABSOLUTE /end AXIS_DESCR
/end CHARACTERISTIC
/begin CHARACTERISTIC PFltPOp_tAdapTPFltUsOff_CA "Matrix zur Bestimmung der Bereichsgrenzen für die gefilterte Abgastemperatur vom Partikelfilter bei inaktivem Bereich" MAP 0x80055DE4 Kf_Xs16_Ys16_Ws16 6553.500 Temp_Cels -3549.940 3003.560
 /begin AXIS_DESCR STD_AXIS PFltPOp_RngIdx_X_mp OneToOne 11 0.00 255.0 DEPOSIT ABSOLUTE /end AXIS_DESCR
 /begin AXIS_DESCR STD_AXIS PFltPOp_RngIdx_Y_mp OneToOne 2 0.00 255.0 DEPOSIT ABSOLUTE /end AXIS_DESCR
/end CHARACTERISTIC
/begin CHARACTERISTIC PFltPOp_tAdapTPFltUsOn_CA "Matrix zur Bestimmung der Bereichsgrenzen für die gefilterte Abgastemperatur vom Partikelfilter bei aktivem Bereich" MAP 0x80055E2E Kf_Xs16_Ys16_Ws16 6553.500 Temp_Cels -3549.940 3003.560
 /begin AXIS_DESCR STD_AXIS PFltPOp_RngIdx_X_mp OneToOne 11 0.00 255.0 DEPOSIT ABSOLUTE /end AXIS_DESCR
 /begin AXIS_DESCR STD_AXIS PFltPOp_RngIdx_Y_mp OneToOne 2 0.00 255.0 DEPOSIT ABSOLUTE /end AXIS_DESCR
/end CHARACTERISTIC
/begin CHARACTERISTIC PFltPOp_tAir_CA "Matrix zur Bestimmung der Bereichswerte für die gefilterte Lufttemperatur" MAP 0x80055E78 Kf_Xs16_Ys16_Ws16 6553.500 Temp_Cels -3549.940 3003.560
 /begin AXIS_DESCR STD_AXIS PFltPOp_RngIdx_X_mp OneToOne 11 0.00 255.0 DEPOSIT ABSOLUTE /end AXIS_DESCR
 /begin AXIS_DESCR STD_AXIS PFltPOp_RngIdx_Y_mp OneToOne 2 0.00 255.0 DEPOSIT ABSOLUTE /end AXIS_DESCR
/end CHARACTERISTIC
/begin CHARACTERISTIC PFltPOp_tEngTempHi_CA "kennfeld für Motortemperatur" MAP 0x80055EC2 Kf_Xs16_Ys16_Ws16 6553.500 Temp_Cels -3549.940 3003.560
 /begin AXIS_DESCR STD_AXIS PFltPOp_RngIdx_X_mp OneToOne 11 0.00 255.0 DEPOSIT ABSOLUTE /end AXIS_DESCR
 /begin AXIS_DESCR STD_AXIS PFltPOp_RngIdx_Y_mp OneToOne 2 0.00 255.0 DEPOSIT ABSOLUTE /end AXIS_DESCR
/end CHARACTERISTIC
/begin CHARACTERISTIC PFltPOp_tEngTempLo_CA "kennfeld für Motortemperatur" MAP 0x80055F0C Kf_Xs16_Ys16_Ws16 6553.500 Temp_Cels -3549.940 3003.560
 /begin AXIS_DESCR STD_AXIS PFltPOp_RngIdx_X_mp OneToOne 11 0.00 255.0 DEPOSIT ABSOLUTE /end AXIS_DESCR
 /begin AXIS_DESCR STD_AXIS PFltPOp_RngIdx_Y_mp OneToOne 2 0.00 255.0 DEPOSIT ABSOLUTE /end AXIS_DESCR
/end CHARACTERISTIC
/begin CHARACTERISTIC PFltPOp_tiAPPRatPT1_C "Filter-Zeitkonstante für APP_r PT1-Filter" VALUE 0x80056050 Val_Ws32 4294.9672940 TimeDelay_s 0.000002000000001 4294.9672960 FORMAT "%12.7" /end CHARACTERISTIC
/begin CHARACTERISTIC PFltPOp_tiBattPT1_C "Filter-Zeitkonstante für BattU_u PT1-Filter" VALUE 0x80056054 Val_Ws32 4294.9672940 TimeDelay_s 0.000002000000001 4294.9672960 FORMAT "%12.7" /end CHARACTERISTIC
/begin CHARACTERISTIC PFltPOp_tiEngSpdPT1_C "Filter-Zeitkonstante für Epm_nEng PT1-Filter" VALUE 0x80056058 Val_Ws32 4294.9672940 TimeDelay_s 0.000002000000001 4294.9672960 FORMAT "%12.7" /end CHARACTERISTIC
/begin CHARACTERISTIC PFltPOp_tiEngTempPT1_C "Filter-Zeitkonstante für PFltPOp_tEngTemp_mp PT1-Filter" VALUE 0x8005605C Val_Ws32 4294.9672940 TimeDelay_s 0.000002000000001 4294.9672960 FORMAT "%12.7" /end CHARACTERISTIC
/begin CHARACTERISTIC PFltPOp_tiInjMsPT1_C "Filter-Zeitkonstante für InjCtl_qSetUnBal PT1-Filter" VALUE 0x80056060 Val_Ws32 4294.9672940 TimeDelay_s 0.000002000000001 4294.9672960 FORMAT "%12.7" /end CHARACTERISTIC
/begin CHARACTERISTIC PFltPOp_tiSpdVehPT1_C "Filter-Zeitkonstante für VehV_v PT1-Filter" VALUE 0x80056064 Val_Ws32 4294.9672940 TimeDelay_s 0.000002000000001 4294.9672960 FORMAT "%12.7" /end CHARACTERISTIC
/begin CHARACTERISTIC PFltPOp_tiTempOxiCatUsPT1_C "Filter-Zeitkonstante für Exh_tAdapTOxiCatUs PT1-Filter" VALUE 0x80056068 Val_Ws32 4294.9672940 TimeDelay_s 0.000002000000001 4294.9672960 FORMAT "%12.7" /end CHARACTERISTIC
/begin CHARACTERISTIC PFltPOp_tiTempPFltUsPT1_C "Filter-Zeitkonstante für Exh_tAdapTPFltUs PT1-Filter" VALUE 0x8005606C Val_Ws32 4294.9672940 TimeDelay_s 0.000002000000001 4294.9672960 FORMAT "%12.7" /end CHARACTERISTIC
/begin CHARACTERISTIC PFltPOp_uBatt_CA "Matrix zur Bestimmung der Bereichsgrenzen für das gefilterte Batteriespannungssignal" MAP 0x80055F56 Kf_Xs16_Ys16_Ws16 1310700. Volt_Batt -655360.0 655340.0
 /begin AXIS_DESCR STD_AXIS PFltPOp_RngIdx_X_mp OneToOne 11 0.00 255.0 DEPOSIT ABSOLUTE /end AXIS_DESCR
 /begin AXIS_DESCR STD_AXIS PFltPOp_RngIdx_Y_mp OneToOne 2 0.00 255.0 DEPOSIT ABSOLUTE /end AXIS_DESCR
/end CHARACTERISTIC
/begin CHARACTERISTIC PFltPOp_vVehUnFltMinMax_CA "" MAP 0x80055FA0 Map_Xs16Ys16Ws16 300.0000 Vel 0.00 300.0000 EXTENDED_LIMITS -327.6800 327.6700
 /begin AXIS_DESCR STD_AXIS PFltPOp_RngPrjIdx_X_mp OneToOne 11 0.00 255.0 DEPOSIT ABSOLUTE /end AXIS_DESCR
 /begin AXIS_DESCR STD_AXIS PFltPOp_RngPrjIdx_Y_mp OneToOne 2 0.00 255.0 DEPOSIT ABSOLUTE /end AXIS_DESCR
/end CHARACTERISTIC
/begin CHARACTERISTIC PFltPOp_v_CA "Matrix zur Bestimmung der Bereichswerte für die gefilterte Fahrzeuggeschwindigkeit" MAP 0x80055FEA Kf_Xs16_Ys16_Ws16 655.3500 Vel -327.6800 327.6700
 /begin AXIS_DESCR STD_AXIS PFltPOp_RngIdx_X_mp OneToOne 11 0.00 255.0 DEPOSIT ABSOLUTE /end AXIS_DESCR
 /begin AXIS_DESCR STD_AXIS PFltPOp_RngIdx_Y_mp OneToOne 2 0.00 255.0 DEPOSIT ABSOLUTE /end AXIS_DESCR
/end CHARACTERISTIC
/begin CHARACTERISTIC PFlt_facSotSimStyCal_C "Korrekturfaktor für Kalibrierungsleichtigkeit" VALUE 0x80055AE4 Val_Ws16 1.000000 Fact 0.00 1.000000 EXTENDED_LIMITS -4.000000 3.999878 /end CHARACTERISTIC
/begin MEASUREMENT PCR_dnAvrg "" SWORD EngNGrd 1 100 -16384.00 16383.50 FORMAT "%8.2" ECU_ADDRESS 0xD000110E /end MEASUREMENT
/begin MEASUREMENT PCR_dqCtlOfsCalc "" SWORD InjMassPerSec_20ms 1 100 -16384.00 16383.50 FORMAT "%8.2" ECU_ADDRESS 0xD0001110 /end MEASUREMENT
/begin MEASUREMENT PCR_drRmpCBOpn_mp "" SLONG RmpPrc 1 100 -400000.000000 399999.999814 FORMAT "%13.6" ECU_ADDRESS 0xC0009194 /end MEASUREMENT
/begin MEASUREMENT PCR_facLPD_mp "" SWORD Fact1 1 100 -256.0000 255.9922 ECU_ADDRESS 0xC000A82A /end MEASUREMENT
/begin MEASUREMENT PCR_facLPI_mp "" SWORD Fact1 1 100 -256.0000 255.9922 ECU_ADDRESS 0xC000A82C /end MEASUREMENT
/begin MEASUREMENT PCR_facLPP_mp "" SWORD Fact1 1 100 -256.0000 255.9922 ECU_ADDRESS 0xC000A82E /end MEASUREMENT
/begin MEASUREMENT PCR_facOfsCalcC1_mp "" SWORD Fact 1 100 -4.000000 3.999878 ECU_ADDRESS 0xC000A87C /end MEASUREMENT
/begin MEASUREMENT PCR_facOfsCalcC2_mp "" SWORD Fact 1 100 -4.000000 3.999878 ECU_ADDRESS 0xC000A87E /end MEASUREMENT
/begin MEASUREMENT PCR_facOfsCalcC3_mp "" SWORD Fact 1 100 -4.000000 3.999878 ECU_ADDRESS 0xC000A880 /end MEASUREMENT
/begin MEASUREMENT PCR_facOfsCalcC4_mp "" SWORD Fact 1 100 -4.000000 3.999878 ECU_ADDRESS 0xC000A882 /end MEASUREMENT
/begin MEASUREMENT PCR_facOfsCalcRx_mp "" SWORD Fact 1 100 -4.000000 3.999878 ECU_ADDRESS 0xC000A884 /end MEASUREMENT
/begin MEASUREMENT PCR_facOfsCalcRy_mp "" SWORD Fact 1 100 -4.000000 3.999878 ECU_ADDRESS 0xC000A886 /end MEASUREMENT
/begin MEASUREMENT PCR_facRmpVal2LP_mp "" SLONG AirSysSwt 1 100 -131.072000000 131.071999939 FORMAT "%13.9" ECU_ADDRESS 0xC0009190 /end MEASUREMENT
/begin MEASUREMENT PCR_facRmpValLP "" SLONG AirSysSwt 1 100 -131.072000000 131.071999939 FORMAT "%13.9" ECU_ADDRESS 0xD0002F78 /end MEASUREMENT
/begin MEASUREMENT PCR_facT1LP_mp "" SWORD Fact1 1 100 -256.0000 255.9922 ECU_ADDRESS 0xC000A830 /end MEASUREMENT
/begin MEASUREMENT PCR_GovOffLP_mp "" SWORD InjMass 1 100 -327.6800 327.6700 ECU_ADDRESS 0xC000A832 /end MEASUREMENT
/begin MEASUREMENT PCR_GovOnLP_mp "" SWORD InjMass 1 100 -327.6800 327.6700 ECU_ADDRESS 0xC000A834 /end MEASUREMENT
/begin MEASUREMENT PCR_numEOMModeLP_mp "" UWORD OneToOne 1 100 0.00 65535.00 ECU_ADDRESS 0xC000A872 /end MEASUREMENT
/begin MEASUREMENT PCR_numEOMMode_mp "Index der geforderten Betriebsart" UWORD OneToOne 1 100 0.00 65535.00 ECU_ADDRESS 0xC000A85C /end MEASUREMENT
/begin MEASUREMENT PCR_pActValLP_mp "" SWORD Pres_hPa 1 100 -32768.00 3500.00 ECU_ADDRESS 0xC000A836 /end MEASUREMENT
/begin MEASUREMENT PCR_pGovDvtLP "" SWORD Pres_hPa 1 100 -32768.00 3500.00 ECU_ADDRESS 0xD000113A /end MEASUREMENT
/begin MEASUREMENT PCR_pGovDvtLPI_mp "" SWORD Pres_hPa 1 100 -32768.00 3500.00 ECU_ADDRESS 0xC000A838 /end MEASUREMENT
/begin MEASUREMENT PCR_pGovDvtMonFull_mp "" SWORD Pres_hPa 1 100 -32768.00 3500.00 ECU_ADDRESS 0xC000A85E /end MEASUREMENT
/begin MEASUREMENT PCR_pGovDvtMonPos_mp "" SWORD Pres_hPa 1 100 -32768.00 3500.00 ECU_ADDRESS 0xC000A860 /end MEASUREMENT
/begin MEASUREMENT PCR_pGovDvtMon_mp "" SWORD Pres_hPa 1 100 -32768.00 3500.00 ECU_ADDRESS 0xC000A862 /end MEASUREMENT
/begin MEASUREMENT PCR_pMaxDvtLP_mp "" SWORD Pres_hPa 1 100 -32768.00 3500.00 ECU_ADDRESS 0xC000A878 /end MEASUREMENT
/begin MEASUREMENT PCR_pMaxDvt_mp "Obergrenze zur Erkennung einer bleibenden Regelabweichung" SWORD Pres_hPa 1 100 -32768.00 3500.00 ECU_ADDRESS 0xC000A864 /end MEASUREMENT
/begin MEASUREMENT PCR_pMinDvtLP_mp "" SWORD Pres_hPa 1 100 -32768.00 3500.00 ECU_ADDRESS 0xC000A87A /end MEASUREMENT
/begin MEASUREMENT PCR_pMinDvt_mp "Untergrenze zur Erkennung einer bleibenden Regelabweichung" SWORD Pres_hPa 1 100 -32768.00 3500.00 ECU_ADDRESS 0xC000A866 /end MEASUREMENT
/begin MEASUREMENT PCR_qClthThres_mp "" SWORD InjMass 1 100 -327.6800 327.6700 ECU_ADDRESS 0xC000A868 /end MEASUREMENT
/begin MEASUREMENT PCR_qGovLP_mp "" SWORD InjMass 1 100 -327.6800 327.6700 ECU_ADDRESS 0xC000A856 /end MEASUREMENT
/begin MEASUREMENT PCR_qMonLP_mp "" SWORD InjMass 1 100 -327.6800 327.6700 ECU_ADDRESS 0xC000A874 /end MEASUREMENT
/begin MEASUREMENT PCR_qMon_mp "Einspritzmenge für die Überwachung der Ladedruckregelung" SWORD InjMass 1 100 -327.6800 327.6700 ECU_ADDRESS 0xC000A86A /end MEASUREMENT
/begin MEASUREMENT PCR_rCtlValOfs "TV adaptive Vorsteuerung Ladedruck" SWORD Prc 1 100 -400.0000 399.9878 ECU_ADDRESS 0xD0001170 /end MEASUREMENT
/begin MEASUREMENT PCR_rCtlValOfsLim_mp "" SWORD Prc 1 100 -400.0000 399.9878 ECU_ADDRESS 0xC000A888 /end MEASUREMENT
/begin MEASUREMENT PCR_rCtlValOfsUnLim_mp "" SWORD Prc 1 100 -400.0000 399.9878 ECU_ADDRESS 0xC000A88A /end MEASUREMENT
/begin MEASUREMENT PCR_rGovLP "Reglertastverhältnis zur Ansteuerung des Turbinenbypasses der Niederdruckstufe" SWORD Prc 1 100 -400.0000 399.9878 ECU_ADDRESS 0xD0001178 /end MEASUREMENT
/begin MEASUREMENT PCR_rGovLPMaxCor_mp "" SWORD Prc 1 100 -400.0000 399.9878 ECU_ADDRESS 0xC000A858 /end MEASUREMENT
/begin MEASUREMENT PCR_rGovLPMaxNrm_mp "" SWORD Prc 1 100 -400.0000 399.9878 ECU_ADDRESS 0xC000A83A /end MEASUREMENT
/begin MEASUREMENT PCR_rGovLPMax_mp "" SWORD Prc 1 100 -400.0000 399.9878 ECU_ADDRESS 0xC000A83C /end MEASUREMENT
/begin MEASUREMENT PCR_rGovLPMinCor_mp "" SWORD Prc 1 100 -400.0000 399.9878 ECU_ADDRESS 0xC000A85A /end MEASUREMENT
/begin MEASUREMENT PCR_rGovLPMinNrm_mp "" SWORD Prc 1 100 -400.0000 399.9878 ECU_ADDRESS 0xC000A83E /end MEASUREMENT
/begin MEASUREMENT PCR_rGovLPMin_mp "" SWORD Prc 1 100 -400.0000 399.9878 ECU_ADDRESS 0xC000A840 /end MEASUREMENT
/begin MEASUREMENT PCR_rGovLPOut_mp "" SWORD Prc 1 100 -400.0000 399.9878 ECU_ADDRESS 0xC000A842 /end MEASUREMENT
/begin MEASUREMENT PCR_rGovOutLPUnLim_mp "" SWORD Prc 1 100 -400.0000 399.9878 ECU_ADDRESS 0xC000A844 /end MEASUREMENT
/begin MEASUREMENT PCR_rOfsRlsMax_mp "" SWORD Prc 1 100 -400.0000 399.9878 ECU_ADDRESS 0xC000A88C /end MEASUREMENT
/begin MEASUREMENT PCR_rOfsRlsMin_mp "" SWORD Prc 1 100 -400.0000 399.9878 ECU_ADDRESS 0xC000A88E /end MEASUREMENT
/begin MEASUREMENT PCR_rOutIMaxLP_mp "" SWORD Prc 1 100 -400.0000 399.9878 ECU_ADDRESS 0xC000A846 /end MEASUREMENT
/begin MEASUREMENT PCR_rOutIMinLP_mp "" SWORD Prc 1 100 -400.0000 399.9878 ECU_ADDRESS 0xC000A848 /end MEASUREMENT
/begin MEASUREMENT PCR_rOutLPDT1_mp "" SWORD Prc 1 100 -400.0000 399.9878 ECU_ADDRESS 0xC000A84A /end MEASUREMENT
/begin MEASUREMENT PCR_rOutLPI "" SWORD Prc 1 100 -400.0000 399.9878 ECU_ADDRESS 0xD0001196 /end MEASUREMENT
/begin MEASUREMENT PCR_rOutLPP_mp "" SWORD Prc 1 100 -400.0000 399.9878 ECU_ADDRESS 0xC000A84C /end MEASUREMENT
/begin MEASUREMENT PCR_rOutOfsCalcI1_mp "" SWORD Prc 1 100 -400.0000 399.9878 ECU_ADDRESS 0xC000A890 /end MEASUREMENT
/begin MEASUREMENT PCR_rOutOfsCalcI2_mp "" SWORD Prc 1 100 -400.0000 399.9878 ECU_ADDRESS 0xC000A892 /end MEASUREMENT
/begin MEASUREMENT PCR_rOutOfsCalcI3_mp "" SWORD Prc 1 100 -400.0000 399.9878 ECU_ADDRESS 0xC000A894 /end MEASUREMENT
/begin MEASUREMENT PCR_rOutOfsCalcI4_mp "" SWORD Prc 1 100 -400.0000 399.9878 ECU_ADDRESS 0xC000A896 /end MEASUREMENT
/begin MEASUREMENT PCR_rPIDCorLP_mp "" SWORD Prc 1 100 -400.0000 399.9878 ECU_ADDRESS 0xC000A84E /end MEASUREMENT
/begin MEASUREMENT PCR_rPIDCtlLP_mp "" SWORD Prc 1 100 -400.0000 399.9878 ECU_ADDRESS 0xC000A850 /end MEASUREMENT
/begin MEASUREMENT PCR_rPIDLP_mp "" SWORD Prc 1 100 -400.0000 399.9878 ECU_ADDRESS 0xC000A852 /end MEASUREMENT
/begin MEASUREMENT PCR_stARWLP "" UBYTE OneToOne 1 100 0.00 255.0 ECU_ADDRESS 0xD0002004 /end MEASUREMENT
/begin MEASUREMENT PCR_stBitMskEOMLP_mp "" ULONG OneToOne 1 100 0.00 4294967295.00 ECU_ADDRESS 0xC00091A4 /end MEASUREMENT
/begin MEASUREMENT PCR_stBitMskEOM_mp "Bitmaske zur Auswahl der relevanten Abschaltfälle für die gewählte Betriebsart" ULONG OneToOne 1 100 0.00 4294967295.00 ECU_ADDRESS 0xC0009198 /end MEASUREMENT
/begin MEASUREMENT PCR_stDebDefLP_mp "Freigabe der Überwachung auf bleibende Regelabweichung(LP)" UBYTE OneToOne 1 100 0.00 255.0 ECU_ADDRESS 0xC000B41B /end MEASUREMENT
/begin MEASUREMENT PCR_stDebDef_mp "Freigabe der Überwachung auf bleibende Regelabweichung" UBYTE OneToOne 1 100 0.00 255.0 ECU_ADDRESS 0xC000B412 /end MEASUREMENT
/begin MEASUREMENT PCR_stEepOfsCalc_mp "" UBYTE OneToOne 1 100 0.00 255.0 ECU_ADDRESS 0xC000B421 /end MEASUREMENT
/begin MEASUREMENT PCR_stEOMGovLP_mp "" UWORD OneToOne 1 100 0.00 65535.00 ECU_ADDRESS 0xC000A854 /end MEASUREMENT
/begin MEASUREMENT PCR_stGovDvtMonEnaLP_mp "Externe Freigabe der Überwachung auf bleibende Regelabweichung(LP)" UBYTE OneToOne 1 100 0.00 255.0 ECU_ADDRESS 0xC000B41C /end MEASUREMENT
/begin MEASUREMENT PCR_stGovDvtMonEna_mp "externe Freigabe der Überwachung auf bleibende Regelabweichung" UBYTE OneToOne 1 100 0.00 255.0 ECU_ADDRESS 0xC000B413 /end MEASUREMENT
/begin MEASUREMENT PCR_stMaxDvtLP_mp "Regelabweichung größer als Obergrenze(LP)" UBYTE OneToOne 1 100 0.00 255.0 ECU_ADDRESS 0xC000B41D /end MEASUREMENT
/begin MEASUREMENT PCR_stMaxDvt_mp "Regelabweichung größer als Obergrenze" UBYTE OneToOne 1 100 0.00 255.0 ECU_ADDRESS 0xC000B414 /end MEASUREMENT
/begin MEASUREMENT PCR_stMinDvtLP_mp "Regelabweichung kleiner als Untergrenze(LP)" UBYTE OneToOne 1 100 0.00 255.0 ECU_ADDRESS 0xC000B41E /end MEASUREMENT
/begin MEASUREMENT PCR_stMinDvt_mp "Regelabweichung kleiner als Untergrenze" UBYTE OneToOne 1 100 0.00 255.0 ECU_ADDRESS 0xC000B415 /end MEASUREMENT
/begin MEASUREMENT PCR_stMon "aktiver Abschaltfall der Ladedrucküberwachung" UBYTE OneToOne 1 100 0.00 255.0 ECU_ADDRESS 0xD0002008 /end MEASUREMENT
/begin MEASUREMENT PCR_stMonBitsLP_mp "Abschaltfälle der Ladedruckregelung nach Maskierung(LP)" ULONG OneToOne 1 100 0.00 4294967295.00 ECU_ADDRESS 0xC00091A8 /end MEASUREMENT
/begin MEASUREMENT PCR_stMonBits_mp "Abschaltfälle der Ladedruckregelung nach Maskierung" ULONG OneToOne 1 100 0.00 4294967295.00 ECU_ADDRESS 0xC000919C /end MEASUREMENT
/begin MEASUREMENT PCR_stMonLP "Aktiver Abschaltfall der Ladedrucküberwachung(LP)" UBYTE OneToOne 1 100 0.00 255.0 ECU_ADDRESS 0xD000200B /end MEASUREMENT
/begin MEASUREMENT PCR_stMonOld_mp "" UBYTE OneToOne 1 100 0.00 255.0 ECU_ADDRESS 0xC000B416 /end MEASUREMENT
/begin MEASUREMENT PCR_stNrmOpEdge_mp "" UBYTE OneToOne 1 100 0.00 255.0 ECU_ADDRESS 0xC000B417 /end MEASUREMENT
/begin MEASUREMENT PCR_stNrmOpLP_mp "Normale Betrieb der Ladedruckregelung(LP)" UBYTE OneToOne 1 100 0.00 255.0 ECU_ADDRESS 0xC000B41F /end MEASUREMENT
/begin MEASUREMENT PCR_stNrmOp_mp "normale Betrieb der Ladedruckregelung" UBYTE OneToOne 1 100 0.00 255.0 ECU_ADDRESS 0xC000B418 /end MEASUREMENT
/begin MEASUREMENT PCR_stOfsCalcEepAccess_mp "Status EEPROM Access für PCR_OfsCalc" UBYTE OneToOne 1 100 0.00 255.0 ECU_ADDRESS 0xC000B422 /end MEASUREMENT
/begin MEASUREMENT PCR_stOfsCalcResetInit_mp "Status Reset and Init Lernen PCR_OfsCalc" UBYTE OneToOne 1 100 0.00 255.0 ECU_ADDRESS 0xC000B423 /end MEASUREMENT
/begin MEASUREMENT PCR_stOfsCalcRlsAdd1_mp "" UWORD OneToOne 1 100 0.00 65535.00 ECU_ADDRESS 0xC000A898 /end MEASUREMENT
/begin MEASUREMENT PCR_stOfsCalcRlsLearn_mp "" UBYTE OneToOne 1 100 0.00 255.0 ECU_ADDRESS 0xC000B424 /end MEASUREMENT
/begin MEASUREMENT PCR_stOfsCalcRlsPCRBits_mp "Freigabebedingungen aus PCR_stPCRBits (Maskiert" ULONG OneToOne 1 100 0.00 4294967295.00 ECU_ADDRESS 0xC00091B0 /end MEASUREMENT
/begin MEASUREMENT PCR_stOfsCalcRlsStat_mp "" UBYTE OneToOne 1 100 0.00 255.0 ECU_ADDRESS 0xC000B425 /end MEASUREMENT
/begin MEASUREMENT PCR_stOfsCalcRls_mp "Freigabe des TV aus adaptiver Vorsteuerung" UBYTE OneToOne 1 100 0.00 255.0 ECU_ADDRESS 0xC000B426 /end MEASUREMENT
/begin MEASUREMENT PCR_stPCRBits "Abschaltfälle der Ladedruckregelung" ULONG OneToOne 1 100 0.00 4294967295.00 ECU_ADDRESS 0xD0003258 /end MEASUREMENT
/begin MEASUREMENT PCR_stPCRBitsLP "Abschaltfälle der Ladedruckregelung(LP)" ULONG OneToOne 1 100 0.00 4294967295.00 ECU_ADDRESS 0xD0003264 /end MEASUREMENT
/begin MEASUREMENT PCR_stRmpSel_mp "" UBYTE OneToOne 1 100 0.00 255.0 ECU_ADDRESS 0xC000B419 /end MEASUREMENT
/begin MEASUREMENT PCR_stSelBitMskEOMLP_mp "" ULONG OneToOne 1 100 0.00 4294967295.00 ECU_ADDRESS 0xC00091AC /end MEASUREMENT
/begin MEASUREMENT PCR_stSelBitMskEOM_mp "selektierte Bitmaske der Abschaltfälle für die gewählte Betriebsart" ULONG OneToOne 1 100 0.00 4294967295.00 ECU_ADDRESS 0xC00091A0 /end MEASUREMENT
/begin MEASUREMENT PCR_stTrans "Status der Transienten-Erkennung" UBYTE OneToOne 1 100 0.00 255.0 ECU_ADDRESS 0xD0002011 /end MEASUREMENT
/begin MEASUREMENT PCR_stTransLP "Status der Transienten-Erkenung(LP)" UBYTE OneToOne 1 100 0.00 255.0 ECU_ADDRESS 0xD0002014 /end MEASUREMENT
/begin MEASUREMENT PCR_stWrkSphLP_mp "" UBYTE OneToOne 1 100 0.00 255.0 ECU_ADDRESS 0xC000B420 /end MEASUREMENT
/begin MEASUREMENT PCR_stWrkSph_mp "aktueller Arbeitsbereich der Ladedruckregelung" UBYTE OneToOne 1 100 0.00 255.0 ECU_ADDRESS 0xC000B41A /end MEASUREMENT
/begin MEASUREMENT PCR_swtGovLP "" UBYTE OneToOne 1 100 0.00 255.0 ECU_ADDRESS 0xD000201B /end MEASUREMENT
/begin MEASUREMENT PCR_swtGovNoDebLP_mp "" UBYTE OneToOne 1 100 0.00 255.0 ECU_ADDRESS 0xC000B411 /end MEASUREMENT
/begin MEASUREMENT PCR_swtRelAbsLP "" UBYTE OneToOne 1 100 0.00 255.0 ECU_ADDRESS 0xD0002020 /end MEASUREMENT
/begin MEASUREMENT PCR_tAirOfsCalc_mp "LuftTemperatur aus Temperaturfeld für OfsCalc" SWORD Temp_Cels 1 100 -3549.940 3003.560 ECU_ADDRESS 0xC000A89A /end MEASUREMENT
/begin MEASUREMENT PCR_tEngMon_mp "Für die Überwachung ausgewählte Temperatur aus dem Motortemperaturfeld" SWORD Temp_Cels 1 100 -3549.940 3003.560 ECU_ADDRESS 0xC000A86C /end MEASUREMENT
/begin MEASUREMENT PCR_tEngOfsCalc_mp "Temperatur aus dem Motortemperaturfeld für OfsCalc" SWORD Temp_Cels 1 100 -3549.940 3003.560 ECU_ADDRESS 0xC000A89C /end MEASUREMENT
/begin MEASUREMENT PCR_tiMonEOM_mp "Zeitverzögerung bei Auswahl der Abschaltfallmaske" SWORD TimeDeb 1 100 -327680.0 327670.0 ECU_ADDRESS 0xC000A86E /end MEASUREMENT
/begin MEASUREMENT PCR_tiMonLPEOM_mp "" SWORD TimeDeb 1 100 -327680.0 327670.0 ECU_ADDRESS 0xC000A876 /end MEASUREMENT
/begin MEASUREMENT PCR_tiStrtDel_mp "Zeit, in der die Regelung nach Startabwurf abgeschaltet bleibt" UWORD Time_ms 1 100 0.00 655350.0 ECU_ADDRESS 0xC000A870 /end MEASUREMENT
/begin MEASUREMENT PCV_cntErrActrTst "anzahl der nicht erkannten Änderungen des Tastverhältnisses" UBYTE OneToOne 1 100 0.00 255.0 ECU_ADDRESS 0xD0002023 /end MEASUREMENT
/begin MEASUREMENT PCV_cntRepActrTst_mp "Zähler für die bereits durchlaufenen Test-Iterationen" UBYTE OneToOne 1 100 0.00 255.0 ECU_ADDRESS 0xC000B427 /end MEASUREMENT
/begin MEASUREMENT PCV_cntTrgOffActrTst_mp "Aktueller Zählerstand für die Generierung des Rampen-Triggersiganls (Zustand ""low"" von PCV_trgSigActrTst_mp)" UBYTE OneToOne 1 100 0.00 255.0 ECU_ADDRESS 0xC000B428 /end MEASUREMENT
/begin MEASUREMENT PCV_ctAdapt1_mp "Zähler für die Anzahl der Funktionsaufrufe der PCV-Adaption im Zustand PCV_ADAPT_STABLE" UWORD OneToOne 1 100 0.00 65535.00 ECU_ADDRESS 0xC000A8A0 /end MEASUREMENT
/begin MEASUREMENT PCV_ctAdapt2_mp "Zähler für die Anzahl der Funktionsaufrufe der PCV-Adaption im Zustand PCV_ADAPT_SUM_UP" UWORD OneToOne 1 100 0.00 65535.00 ECU_ADDRESS 0xC000A8A2 /end MEASUREMENT
/begin MEASUREMENT PCV_ctAdapt3_mp "Zähler für die erfolgreiche Berechnung der Adaption" ULONG OneToOne 1 100 0.00 4294967295.00 ECU_ADDRESS 0xC00091D8 /end MEASUREMENT
/begin MEASUREMENT PCV_ctNoStrtAct_mp "" UBYTE OneToOne 1 100 0.00 255.0 ECU_ADDRESS 0xC000B42B /end MEASUREMENT
/begin MEASUREMENT PCV_ctNoStrtLstCyc_mp "" UBYTE OneToOne 1 100 0.00 255.0 ECU_ADDRESS 0xC000B42C /end MEASUREMENT
/begin MEASUREMENT PCV_dvolFlow_mp "Eingangswert für das Kennfeld PCV_facAdaptFlow_MAP" SWORD Qp_mm3_sec 1 100 -327680.0 327670.0 FORMAT "%8.1" ECU_ADDRESS 0xC000A8A4 /end MEASUREMENT
/begin MEASUREMENT PCV_dvolLeak_mp "Leckage des Druckregelventils" SWORD Qp_mm3_sec 1 100 -327680.0 327670.0 FORMAT "%8.1" ECU_ADDRESS 0xC000A8C2 /end MEASUREMENT
/begin MEASUREMENT PCV_facAdapt "Adaptionsfaktor für die PCV-Kennlinie" SWORD Fact 1 100 -4.000000 3.999878 ECU_ADDRESS 0xD00011A8 /end MEASUREMENT
/begin MEASUREMENT PCV_facAdaptFlow "Faktor zur Abschätzung des Durchflusses durch das PCV" SWORD Fact 1 100 -4.000000 3.999878 ECU_ADDRESS 0xD00011AA /end MEASUREMENT
/begin MEASUREMENT PCV_facCrntCtlLim_mp "Drucksollwert von der Raildruckregelung für das Druckregelventil" SWORD Fact 1 100 -4.000000 3.999878 ECU_ADDRESS 0xC000A8AE /end MEASUREMENT
/begin MEASUREMENT PCV_facWinActrTst_mp "Faktor zur Berechnung des Druckfensters, abhängig von PCVCD_iActVal" SWORD Fact1 1 100 -256.0000 255.9922 ECU_ADDRESS 0xC000A89E /end MEASUREMENT
/begin MEASUREMENT PCV_iActFlt_mp "Drucksollwert von der Raildruckregelung für das Druckregelventil" SWORD Curr 1 100 -32768.00 32767.00 FORMAT "%8.2" ECU_ADDRESS 0xC000A8B0 /end MEASUREMENT
/begin MEASUREMENT PCV_iActVal "Analogeingang Strom-Istwert" SWORD Curr 1 100 -32768.00 32767.00 FORMAT "%8.2" ECU_ADDRESS 0xD00011AC /end MEASUREMENT
/begin MEASUREMENT PCV_iAct_mp "Sollstrom für das Druckregelventil" SWORD Curr 1 100 -32768.00 32767.00 FORMAT "%8.2" ECU_ADDRESS 0xC000A8B2 /end MEASUREMENT
/begin MEASUREMENT PCV_iCnvPresAdapt_mp "Sollstrom mit adaptiver PCV Korrekturfaktor" SWORD Curr 1 100 -32768.00 32767.00 FORMAT "%8.2" ECU_ADDRESS 0xC000A8B4 /end MEASUREMENT
/begin MEASUREMENT PCV_iCnvPres_mp "Wert aus der Kennlinie für Umrechnung von Druck nach Strom" SWORD Curr 1 100 -32768.00 32767.00 FORMAT "%8.2" ECU_ADDRESS 0xC000A8B6 /end MEASUREMENT
/begin MEASUREMENT PCV_iDvt "Sollstrom für das Druckregelventil" SWORD Curr 1 100 -32768.00 32767.00 FORMAT "%8.2" ECU_ADDRESS 0xD00011AE /end MEASUREMENT
/begin MEASUREMENT PCV_iSet "Sollstrom für das Druckregelventil" SWORD Curr 1 100 -32768.00 32767.00 FORMAT "%8.2" ECU_ADDRESS 0xD00011B0 /end MEASUREMENT
/begin MEASUREMENT PCV_iSetClose_mp "Strom zum Schließen des Druckregelventils" SWORD Curr 1 100 -32768.00 32767.00 FORMAT "%8.2" ECU_ADDRESS 0xC000A8B8 /end MEASUREMENT
/begin MEASUREMENT PCV_iSetFlt "gefilterter Sollstrom für das Druckregelventil" SWORD Curr 1 100 -32768.00 32767.00 FORMAT "%8.2" ECU_ADDRESS 0xD00011B2 /end MEASUREMENT
/begin MEASUREMENT PCV_iSetMax_mp "maximaler Strom zum Schließen des Druckregelventils" SWORD Curr 1 100 -32768.00 32767.00 FORMAT "%8.2" ECU_ADDRESS 0xC000A8BA /end MEASUREMENT
/begin MEASUREMENT PCV_iSetMin_mp "Sollstrom bei elektrischer Abschaltung des Druckregelventils" SWORD Curr 1 100 -32768.00 32767.00 FORMAT "%8.2" ECU_ADDRESS 0xC000A8BC /end MEASUREMENT
/begin MEASUREMENT PCV_nSetActrTst "Leerlauf-Solldrehzahl" SWORD EngN 1 100 -16384.00 16383.50 ECU_ADDRESS 0xD00011B4 /end MEASUREMENT
/begin MEASUREMENT PCV_numCycOffActrTst "Anzahl der Zyklen, die das Rampen-Triggersignal ""low"" ist" UBYTE OneToOne 1 100 0.00 255.0 ECU_ADDRESS 0xD0002024 /end MEASUREMENT
/begin MEASUREMENT PCV_numRepActrTst "Anzahl der zu durchlaufenden Test-Iterationen" UBYTE OneToOne 1 100 0.00 255.0 ECU_ADDRESS 0xD0002025 /end MEASUREMENT
/begin MEASUREMENT PCV_pAdaptThres_mp "Raildruckschwelle für die Berechnung des Adaptionsfaktors" SWORD Pres_Rail 1 100 -3276.800 2000.000 ECU_ADDRESS 0xC000A8A6 /end MEASUREMENT
/begin MEASUREMENT PCV_pAvrgActrTst_mp "Mittelwert des aktuellen Raildrucks RailCD_pPeak" SLONG Pres_Rail 1 100 -214748364.800 2000.000 ECU_ADDRESS 0xC00091B4 /end MEASUREMENT
/begin MEASUREMENT PCV_pFltSum_mp "Aufsummierter Raildruck für Mittelwertbildung" SLONG Pres_Rail 1 100 -214748364.800 2000.000 ECU_ADDRESS 0xC00091DC /end MEASUREMENT
/begin MEASUREMENT PCV_pSet "Drucksollwert von der Raildruckregelung für das Druckregelventil" SWORD Pres_Rail 1 100 -3276.800 2000.000 ECU_ADDRESS 0xD00011B6 /end MEASUREMENT
/begin MEASUREMENT PCV_pSetSum_mp "Aufsummierter Steuerdruck für das PCV für Mittelwertbildung" SLONG Pres_Rail 1 100 -214748364.800 2000.000 ECU_ADDRESS 0xC00091E0 /end MEASUREMENT
/begin MEASUREMENT PCV_pStrtEvalActrTst_mp "Referenzdruck für die Auswertung des aktuellen Mittelwerts von RailCD_pPeak" SLONG Pres_Rail 1 100 -214748364.800 2000.000 ECU_ADDRESS 0xC00091B8 /end MEASUREMENT
/begin MEASUREMENT PCV_pWinActrTst "Fenster für die Raildruckänderung, abhängig vom PCV-Strom" SWORD Pres_Rail 1 100 -3276.800 2000.000 ECU_ADDRESS 0xD00011B8 /end MEASUREMENT
/begin MEASUREMENT PCV_pWinLoActrTst "Ausgangsfenster für die Raildruckänderung, abhängig vom PCV-Strom" SWORD Pres_Rail 1 100 -3276.800 2000.000 ECU_ADDRESS 0xD00011BA /end MEASUREMENT
/begin MEASUREMENT PCV_qAvrgActrTst_mp "Mittelwert der Einspritzmenge InjCtl_qSetUnBal" SLONG InjMassCyc 1 100 -21474836.4800 21474836.4700 ECU_ADDRESS 0xC00091BC /end MEASUREMENT
/begin MEASUREMENT PCV_rDstHiActrTst "Delta-Tastverhältnis vom errechneten Mittelwert nach oben" SWORD DtyCyc 1 100 -327.6800 327.6700 ECU_ADDRESS 0xD00011BC /end MEASUREMENT
/begin MEASUREMENT PCV_rDstLoActrTst "Delta-Tastverhältnis vom errechneten Mittelwert nach unten" SWORD DtyCyc 1 100 -327.6800 327.6700 ECU_ADDRESS 0xD00011BE /end MEASUREMENT
/begin MEASUREMENT PCV_rOutActrTst "Ausgangstastverhältnis zum Abfahren der Hysterese" SWORD DtyCyc 1 100 -327.6800 327.6700 ECU_ADDRESS 0xD00011C0 /end MEASUREMENT
/begin MEASUREMENT PCV_rPs "" SWORD DtyCyc 1 100 -327.6800 327.6700 ECU_ADDRESS 0xD00011C2 /end MEASUREMENT
/begin MEASUREMENT PCV_rSet "PWM Sollwert für PCV" SWORD DtyCyc 1 100 -327.6800 327.6700 ECU_ADDRESS 0xD00011C4 /end MEASUREMENT
/begin MEASUREMENT PCV_rSetDT1_mp "Sollwert Tastverhältnis mit DT1-Anteil" SWORD DtyCyc 1 100 -327.6800 327.6700 ECU_ADDRESS 0xC000A8A8 /end MEASUREMENT
/begin MEASUREMENT PCV_rSetLin_mp "Linearisierter Sollwert für das Druckregelventil" SWORD DtyCyc 1 100 -327.6800 327.6700 ECU_ADDRESS 0xC000A8AA /end MEASUREMENT
/begin MEASUREMENT PCV_rStpActrTst "Schrittweite zum Verändern des Tastverhältnisses" SWORD DtyCyc 1 100 -327.6800 327.6700 ECU_ADDRESS 0xD00011C6 /end MEASUREMENT
/begin MEASUREMENT PCV_rStrtActrTst_mp "Mittelwert des PCV-Tastverhältnisses" SLONG DtyCyc 1 100 -21474836.4800 21474836.4700 ECU_ADDRESS 0xC00091C0 /end MEASUREMENT
/begin MEASUREMENT PCV_stActrCtl "Zustand der Stellwertsteuerung für das Druckregelventil" UBYTE OneToOne 1 100 0.00 255.0 ECU_ADDRESS 0xD0002026 /end MEASUREMENT
/begin MEASUREMENT PCV_stAdapt "Status des Statusautomaten der Adaptionsfunktion" UBYTE OneToOne 1 100 0.00 255.0 ECU_ADDRESS 0xD0002027 /end MEASUREMENT
/begin MEASUREMENT PCV_stAdaptMeUn "Freigabe-Botschaft für die Zumesseinheit" UBYTE OneToOne 1 100 0.00 255.0 ECU_ADDRESS 0xD0002028 /end MEASUREMENT
/begin MEASUREMENT PCV_stDefActrTst "Boolscher Wert für den Zustand des PCV: defekt=TRUE, i.O.=FALSE" UBYTE OneToOne 1 100 0.00 255.0 ECU_ADDRESS 0xD0002029 /end MEASUREMENT
/begin MEASUREMENT PCV_stEffectActrTst "Effekt-Bits" UBYTE OneToOne 1 100 0.00 255.0 ECU_ADDRESS 0xD000202A /end MEASUREMENT
/begin MEASUREMENT PCV_stEngStrtMov_mp "Motorbewegung bei der Berechnung des elektrischen Sollstroms für das Druckregelventil" UBYTE OneToOne 1 100 0.00 255.0 ECU_ADDRESS 0xC000B42D /end MEASUREMENT
/begin MEASUREMENT PCV_stMSA "" UBYTE OneToOne 1 100 0.00 255.0 ECU_ADDRESS 0xD000202B /end MEASUREMENT
/begin MEASUREMENT PCV_stNoStrt "Statusbotschaft für den Raildruck" UBYTE OneToOne 1 100 0.00 255.0 ECU_ADDRESS 0xD000202C /end MEASUREMENT
/begin MEASUREMENT PCV_stRefActrTst "Refuse-Bits" UWORD OneToOne 1 100 0.00 65535.00 ECU_ADDRESS 0xD0001618 /end MEASUREMENT
/begin MEASUREMENT PCV_stRsltActrTst "zusammengesetzte Message aus PCV_cntErrActrTst und PCV_stDefActrTst" UWORD OneToOne 1 100 0.00 65535.00 ECU_ADDRESS 0xD000161A /end MEASUREMENT
/begin MEASUREMENT PCV_stRstMSAStp_mp "" UBYTE OneToOne 1 100 0.00 255.0 ECU_ADDRESS 0xC000B42E /end MEASUREMENT
/begin MEASUREMENT PCV_stSetClose_mp "Zustandsanforderung zum Schließen des Druckregelventils" UBYTE OneToOne 1 100 0.00 255.0 ECU_ADDRESS 0xC000B42F /end MEASUREMENT
/begin MEASUREMENT PCV_stStMActrTst "Aktueller Status des Zustandsautomaten" UBYTE OneToOne 1 100 0.00 255.0 ECU_ADDRESS 0xD000202D /end MEASUREMENT
/begin MEASUREMENT PCV_swtCtlState "Drucksollwert von der Raildruckregelung für das Druckregelventil" UBYTE OneToOne 1 100 0.00 255.0 ECU_ADDRESS 0xD000202E /end MEASUREMENT
/begin MEASUREMENT PCV_swtSrcPSActrTst_mp "Auswahl der Parameter ( 0 = Applikationsdaten, 1 = Testerdaten )" UBYTE OneToOne 1 100 0.00 255.0 ECU_ADDRESS 0xC000B429 /end MEASUREMENT
/begin MEASUREMENT PCV_tiAdaptLst_mp "Zeitpunkt, bei dem die letzte Adaptierung stattgefunden hat" SLONG TimeEngOn 1 100 -2147483648.00 2147483647.00 FORMAT "%13.2" ECU_ADDRESS 0xC00091E4 /end MEASUREMENT
/begin MEASUREMENT PCV_tiCalcActrTst_mp "berechnete Applikationszeit (PCV_numCycOffActrTst * 10ms)" SLONG Time_ms 1 100 -21474836480.0 21474836470.0 ECU_ADDRESS 0xC00091C4 /end MEASUREMENT
/begin MEASUREMENT PCV_tiDelActrTst_mp "Stoppuhr für die Verzögerungszeit zum Aufnehmen und Berechnen von PCV_pAvrgActrTst_mp" SLONG Time_ms 1 100 -21474836480.0 21474836470.0 ECU_ADDRESS 0xC00091C8 /end MEASUREMENT
/begin MEASUREMENT PCV_tiDelMeasActrTst "Verzögerungszeit für die Auswertung" SLONG Time_ms 1 100 -21474836480.0 21474836470.0 ECU_ADDRESS 0xD0002F84 /end MEASUREMENT
/begin MEASUREMENT PCV_tiNoStrt_mp "Zeit seit dem letzten nicht erfolgreichen Motorstart" UWORD Time_ms 1 100 0.00 655350.0 ECU_ADDRESS 0xC000A8BE /end MEASUREMENT
/begin MEASUREMENT PCV_tiSetCloseMax_mp "Verweilzeit im Zustand PCV_stActrCtl == PCV_CLOSE_MODE (0x20)" UWORD Time_ms 1 100 0.00 655350.0 ECU_ADDRESS 0xC000A8C0 /end MEASUREMENT
/begin MEASUREMENT PCV_tiTotalActrTst_mp "Stoppuhr für die Gesanmtlaufzeit des Tests" SLONG Time_s 1 100 -21474836.4800 21474836.4700 ECU_ADDRESS 0xC00091CC /end MEASUREMENT
/begin MEASUREMENT PCV_tiWaitActrTst_mp "Stoppuhr für die Wartezeit" SLONG Time_ms 1 100 -21474836480.0 21474836470.0 ECU_ADDRESS 0xC00091D0 /end MEASUREMENT
/begin MEASUREMENT PCV_trgSigActrTst_mp "Triggersignal zum Rampen des PCV-Tastverhältnisses und Steuern der Auswertung" UBYTE OneToOne 1 100 0.00 255.0 ECU_ADDRESS 0xC000B42A /end MEASUREMENT
/begin MEASUREMENT PCV_uAvrgActrTst_mp "Mittelwert der Batteriespannung BattCD_u" SLONG Volt_Batt 1 100 -42949672960.0 42949672940.0 ECU_ADDRESS 0xC00091D4 /end MEASUREMENT
/begin MEASUREMENT PCV_uRaw_mp "Sollwert Tastverhältnis für Druckregelventil" SWORD Volt 1 100 -6553.600 6553.400 ECU_ADDRESS 0xC000A8AC /end MEASUREMENT
/begin MEASUREMENT PFltLd_aVehFltAshCor_mp "gefilterter Wert Fahrzeugbeschleunigung" SWORD Acc 1 100 -32.76800 32.76700 FORMAT "%8.5" ECU_ADDRESS 0xC000A8C4 /end MEASUREMENT
/begin MEASUREMENT PFltLd_ctStartSnceHCCond_mp "Anzahl der Motorstarts seit letzter Regeneration" SWORD OneToOne 1 100 -32768.00 32767.00 ECU_ADDRESS 0xC000A8F6 /end MEASUREMENT
/begin MEASUREMENT PFltLd_dmO2Aprx "Sauerstoff-Massenstrom nach Abgaskrummer" SWORD AirMassPerTime 1 100 -3276.800 3276.700 ECU_ADDRESS 0xD00011C8 /end MEASUREMENT
/begin MEASUREMENT PFltLd_dmSotRaw_mp "produzierte Partikelmasse" SWORD dmSoot_mg_p_s 1 100 -327.6800 327.6700 FORMAT "%8.4" ECU_ADDRESS 0xC000A93A /end MEASUREMENT
/begin MEASUREMENT PFltLd_dmSotSim "gesamt produzierter Rußmassenstrom" SWORD dmSoot_mg_p_s 1 100 -327.6800 327.6700 FORMAT "%8.4" ECU_ADDRESS 0xD00011CA /end MEASUREMENT
/begin MEASUREMENT PFltLd_dmSotSimDyn "Dynamischer Russmassenanteil in der Simulation" SWORD dmSoot_mg_p_s 1 100 -327.6800 327.6700 FORMAT "%8.4" ECU_ADDRESS 0xD00011CC /end MEASUREMENT
/begin MEASUREMENT PFltLd_dmSotSimRgnBas_mp "Basiswert für produzierter Rußmassenstrom" SWORD dmSoot_mg_p_s 1 100 -327.6800 327.6700 FORMAT "%8.4" ECU_ADDRESS 0xC000A95C /end MEASUREMENT
/begin MEASUREMENT PFltLd_dmSotSimRgnNO2Raw_mp "unverzögerter abgebauter Partikelmassenstrom in Simulation durch NO2" SWORD dmSoot_mg_p_s 1 100 -327.6800 327.6700 FORMAT "%8.4" ECU_ADDRESS 0xC000A93C /end MEASUREMENT
/begin MEASUREMENT PFltLd_dmSotSimRgnNO2_mp "verzögerter abgebauter Partikelmassenstrom in Simulation durch NO2" SWORD dmSoot_mg_p_s 1 100 -327.6800 327.6700 FORMAT "%8.4" ECU_ADDRESS 0xC000A93E /end MEASUREMENT
/begin MEASUREMENT PFltLd_dmSotSimRgnThr_mp "abgebauter Partikelmassenstrom in Simulation durch thermische Regeneration" SWORD dmSoot_mg_p_s 1 100 -327.6800 327.6700 FORMAT "%8.4" ECU_ADDRESS 0xC000A940 /end MEASUREMENT
/begin MEASUREMENT PFltLd_dmSotSimRgn_mp "regenerierte Partikelmasse" SWORD dmSoot_mg_p_s 1 100 -327.6800 327.6700 FORMAT "%8.4" ECU_ADDRESS 0xC000A942 /end MEASUREMENT
/begin MEASUREMENT PFltLd_dpDiff_mp "DT1 gefiltert Differenzdruck über Partikelfilter" SWORD dPres_hPa_p_s 1 100 -32768.00 32767.00 FORMAT "%8.2" ECU_ADDRESS 0xC000A8F0 /end MEASUREMENT
/begin MEASUREMENT PFltLd_dqDT1Flt_mp "DT1-gefilterte Einspritzmasse" SWORD InjMass_p_s 1 100 -327.6800 327.6700 FORMAT "%8.4" ECU_ADDRESS 0xC000A95E /end MEASUREMENT
/begin MEASUREMENT PFltLd_dqFlTotAct_mp "qFlTot Korrekturendwert" SWORD Fl_2 1 100 -327680.0 327670.0 FORMAT "%8.1" ECU_ADDRESS 0xC000A8C6 /end MEASUREMENT
/begin MEASUREMENT PFltLd_dqFlTotEnd_mp "qFlTot Korrekturendwert" SWORD Fl_2 1 100 -327680.0 327670.0 FORMAT "%8.1" ECU_ADDRESS 0xC000A8C8 /end MEASUREMENT
/begin MEASUREMENT PFltLd_dVolFltAshCorMAPIn_mp "i/p für MAP PFltLd_mAshCor_MAP" SWORD CubMtrPerHr 1 100 -3276.800 3276.700 FORMAT "%8.3" ECU_ADDRESS 0xC000A8CA /end MEASUREMENT
/begin MEASUREMENT PFltLd_dVolFltAshCorRaw_mp "dVol-Rohwert" SWORD CubMtrPerHr 1 100 -3276.800 3276.700 FORMAT "%8.3" ECU_ADDRESS 0xC000A8CC /end MEASUREMENT
/begin MEASUREMENT PFltLd_dVolFltAshCor_mp "PT1-gefilterter Wert für PFlt_dvol" SWORD CubMtrPerHr 1 100 -3276.800 3276.700 FORMAT "%8.3" ECU_ADDRESS 0xC000A8CE /end MEASUREMENT
/begin MEASUREMENT PFltLd_dvolPFltEGFlt_mp "Abgasvolumenstrom gefiltert" SWORD CubMtrPerHr 1 100 -3276.800 3276.700 FORMAT "%8.3" ECU_ADDRESS 0xC000A902 /end MEASUREMENT
/begin MEASUREMENT PFltLd_dvolPT1Flt_mp "Abgasvolumenstrom dynamisch gefiltert" SWORD AirVolPerTime 1 100 -3276.800 3276.700 FORMAT "%8.3" ECU_ADDRESS 0xC000A904 /end MEASUREMENT
/begin MEASUREMENT PFltLd_facAshCor "Ash correction factor" SWORD Fact 1 100 -4.000000 3.999878 ECU_ADDRESS 0xD00011D0 /end MEASUREMENT
/begin MEASUREMENT PFltLd_facAshCorDiff_mp "Korrekturfaktor" SWORD Fact 1 100 -4.000000 3.999878 ECU_ADDRESS 0xC000A8D0 /end MEASUREMENT
/begin MEASUREMENT PFltLd_facAshVolCor_mp "Aschevolumen-abhängiger Korrekturfaktor des Differenzdrukkes" SWORD Fact4 1 100 -1638.400 1638.350 FORMAT "%8.3" ECU_ADDRESS 0xC000A906 /end MEASUREMENT
/begin MEASUREMENT PFltLd_facNO2CnvCatB1_mp "" SWORD Fact 1 100 -4.000000 3.999878 ECU_ADDRESS 0xC000A960 /end MEASUREMENT
/begin MEASUREMENT PFltLd_facNO2CnvCatB2_mp "" SWORD Fact 1 100 -4.000000 3.999878 ECU_ADDRESS 0xC000A962 /end MEASUREMENT
/begin MEASUREMENT PFltLd_facNO2CnvCat_mp "NOx NO2 Konvertierungsrate abhängig von Temperatur vor OxiCat und Abgasvolumenstrom" SWORD Fact 1 100 -4.000000 3.999878 ECU_ADDRESS 0xC000A964 /end MEASUREMENT
/begin MEASUREMENT PFltLd_facNO2Rgn "Korrektur faktor für NO2 Inhalt im Partikelfilter" SWORD Fact 1 100 -4.000000 3.999878 ECU_ADDRESS 0xD00011D2 /end MEASUREMENT
/begin MEASUREMENT PFltLd_facSotSimRgn_mp "Korrekturfaktor für Berechnung des thermischen Rußabbrands" SWORD Fact 1 100 -4.000000 3.999878 ECU_ADDRESS 0xC000A944 /end MEASUREMENT
/begin MEASUREMENT PFltLd_facTempI_mp "Ergebnis von Division von PFlt_facTempSnceRgn_mp und PFlt_tiSnceRgn" SLONG Fact 1 100 -262144.000000 262143.999878 ECU_ADDRESS 0xC000920C /end MEASUREMENT
/begin MEASUREMENT PFltLd_facTempNO2_mp "Faktor für die NOx-Emission-Abhängigkeit von der Temperatur" SWORD Fact 1 100 -4.000000 3.999878 ECU_ADDRESS 0xC000A946 /end MEASUREMENT
/begin MEASUREMENT PFltLd_facTempSimRgn_mp "Einfluß der Temperatur auf regenerierte Partikelmasse" SWORD Fact 1 100 -4.000000 3.999878 ECU_ADDRESS 0xC000A966 /end MEASUREMENT
/begin MEASUREMENT PFltLd_facVolFlwNO2_mp "Faktor für die NOx-Emission-Abhängigkeit vom Abgasvolumenstrom" SWORD Fact 1 100 -4.000000 3.999878 ECU_ADDRESS 0xC000A948 /end MEASUREMENT
/begin MEASUREMENT PFltLd_lAvrgSnceHCCond_mp "Durchschnittlich gefahrene Wegstrecke seit letzter erfolgreicher Regeneration" SWORD lHCCondRes 1 100 -4194.304 4194.176 FORMAT "%8.3" ECU_ADDRESS 0xC000A8F8 /end MEASUREMENT
/begin MEASUREMENT PFltLd_lLastHCCond_mp "Wegstrecke zum Zeitpunkt der letzten Regeneration" SLONG Length 1 100 -2147483648.00 2147483647.00 FORMAT "%13.2" ECU_ADDRESS 0xC00091F0 /end MEASUREMENT
/begin MEASUREMENT PFltLd_lSnceHCCond_mp "Wegstrecke seit letzter Regeneration" SLONG Length 1 100 -2147483648.00 2147483647.00 FORMAT "%13.2" ECU_ADDRESS 0xC00091F4 /end MEASUREMENT
/begin MEASUREMENT PFltLd_lSumMaxHCCond_mp "Schaltschwelle um Regeneration anzufordern" SWORD lHCCondRes 1 100 -4194.304 4194.176 FORMAT "%8.3" ECU_ADDRESS 0xC000A8FA /end MEASUREMENT
/begin MEASUREMENT PFltLd_mAshCorAct "tatsächliche Aschenmenge" SWORD mSoot_g 1 100 -327.6800 327.6700 FORMAT "%8.4" ECU_ADDRESS 0xD00011D4 /end MEASUREMENT
/begin MEASUREMENT PFltLd_mAshCorActRel_mp "aktuell relative Abweichung der neu berechneten Aschemenge" SWORD mSoot_g 1 100 -327.6800 327.6700 FORMAT "%8.4" ECU_ADDRESS 0xC000A8D2 /end MEASUREMENT
/begin MEASUREMENT PFltLd_mAshCorDiff1_mp "Absolutbetrag von PFlt_mAshCorDiff_mp, relative Aschemengeabweichung" SWORD mSoot_g 1 100 -327.6800 327.6700 FORMAT "%8.4" ECU_ADDRESS 0xC000A8D4 /end MEASUREMENT
/begin MEASUREMENT PFltLd_mAshCorDiff2_mp "absoluter Zwischenwert für die Aschenmasse" SWORD mSoot_g 1 100 -327.6800 327.6700 FORMAT "%8.4" ECU_ADDRESS 0xC000A8D6 /end MEASUREMENT
/begin MEASUREMENT PFltLd_mAshCorDiff_mp "output of PFlt_mAshCor_MAP, Abweichung vom Aschemengesollwert" SWORD mSoot_g 1 100 -327.6800 327.6700 FORMAT "%8.4" ECU_ADDRESS 0xC000A8D8 /end MEASUREMENT
/begin MEASUREMENT PFltLd_mAshCorNew "Wird nur berechnet" SWORD mSoot_g 1 100 -327.6800 327.6700 FORMAT "%8.4" ECU_ADDRESS 0xD00011D6 /end MEASUREMENT
/begin MEASUREMENT PFltLd_mAshCorOld "Aschekorrekturwert vom vorherigen Zyklus" SWORD mSoot_g 1 100 -327.6800 327.6700 FORMAT "%8.4" ECU_ADDRESS 0xD00011D8 /end MEASUREMENT
/begin MEASUREMENT PFltLd_mAshOilEG "Ölaschenmasse" SWORD mSoot_g 1 100 -327.6800 327.6700 FORMAT "%8.4" ECU_ADDRESS 0xD00011DA /end MEASUREMENT
/begin MEASUREMENT PFltLd_mAshOilNrm "Normalwert - Ölaschenmasse" SWORD mSoot_g 1 100 -327.6800 327.6700 FORMAT "%8.4" ECU_ADDRESS 0xD00011DC /end MEASUREMENT
/begin MEASUREMENT PFltLd_mResFlwMeasAftRgn_mp "Restliche Ruß-Masse maß nach Regeneration" SWORD mSoot_g 1 100 -327.6800 327.6700 FORMAT "%8.4" ECU_ADDRESS 0xC000A94A /end MEASUREMENT
/begin MEASUREMENT PFltLd_mSot "Rußmasse im Partikelfilter" SWORD mSoot_g 1 100 -327.6800 327.6700 FORMAT "%8.4" ECU_ADDRESS 0xD00011DE /end MEASUREMENT
/begin MEASUREMENT PFltLd_mSotAddCorNO2_mp "Offsetwerte der gemessenen Rußmasse nach einer NO2-Regenerationsphase" SWORD mSoot_g 1 100 -327.6800 327.6700 FORMAT "%8.4" ECU_ADDRESS 0xC000A908 /end MEASUREMENT
/begin MEASUREMENT PFltLd_mSotAddCorStrt_mp "Offsetwerte der gemessenen Rußmasse nach Motorstart" SWORD mSoot_g 1 100 -327.6800 327.6700 FORMAT "%8.4" ECU_ADDRESS 0xC000A90A /end MEASUREMENT
/begin MEASUREMENT PFltLd_mSotBefNO2_mp "Rußmasse am Beginn der NO2-Regeneration" SWORD mSoot_g 1 100 -327.6800 327.6700 FORMAT "%8.4" ECU_ADDRESS 0xC000A90C /end MEASUREMENT
/begin MEASUREMENT PFltLd_mSotCrv_mp "Partikelmasse unter Berücksichtigung des Korrekturfaktors" SWORD mSoot_g 1 100 -327.6800 327.6700 FORMAT "%8.4" ECU_ADDRESS 0xC000A90E /end MEASUREMENT
/begin MEASUREMENT PFltLd_mSotDiffNO2_mp "Änderung der Rußmasse während NO2-Regeneration" SWORD mSoot_g 1 100 -327.6800 327.6700 FORMAT "%8.4" ECU_ADDRESS 0xC000A910 /end MEASUREMENT
/begin MEASUREMENT PFltLd_mSotIntegIni_mp "Rußmasse zur Initialisierung der Integratoren für Rußmassensimulation" SWORD mSoot_g 1 100 -327.6800 327.6700 FORMAT "%8.4" ECU_ADDRESS 0xC000A94C /end MEASUREMENT
/begin MEASUREMENT PFltLd_mSotMeas "Partikelmasse additiv korrigiert" SWORD mSoot_g 1 100 -327.6800 327.6700 FORMAT "%8.4" ECU_ADDRESS 0xD00011E0 /end MEASUREMENT
/begin MEASUREMENT PFltLd_mSotMeasBas_mp "Rußmassenbasiswert" SWORD mSoot_g 1 100 -327.6800 327.6700 FORMAT "%8.4" ECU_ADDRESS 0xC000A912 /end MEASUREMENT
/begin MEASUREMENT PFltLd_mSotMeasLstVld_mp "Letzte gültige gemessene Rußmasse vor Aktivierung der Simulation der Partikelmasse" SWORD mSoot_g 1 100 -327.6800 327.6700 FORMAT "%8.4" ECU_ADDRESS 0xC000A914 /end MEASUREMENT
/begin MEASUREMENT PFltLd_mSotMeasRaw_mp "Strömungswdst. in Partikelmasse umgerechnet" SWORD mSoot_g 1 100 -327.6800 327.6700 FORMAT "%8.4" ECU_ADDRESS 0xC000A916 /end MEASUREMENT
/begin MEASUREMENT PFltLd_mSotMeasStdByEx_mp "Letzte gültige gemessene Rußmasse vor der NO2-Regeneration" SWORD mSoot_g 1 100 -327.6800 327.6700 FORMAT "%8.4" ECU_ADDRESS 0xC000A918 /end MEASUREMENT
/begin MEASUREMENT PFltLd_mSotOfsNO2Act_mp "Aktueller Korrekturwert der Rußmasse für NO2-Regeneration" SWORD mSoot_g 1 100 -327.6800 327.6700 FORMAT "%8.4" ECU_ADDRESS 0xC000A91A /end MEASUREMENT
/begin MEASUREMENT PFltLd_mSotOfsNO2Max_mp "Maximaler offsetkorrekturwert der Rußmasse aus NO2-Regeneration" SWORD mSoot_g 1 100 -327.6800 327.6700 FORMAT "%8.4" ECU_ADDRESS 0xC000A91C /end MEASUREMENT
/begin MEASUREMENT PFltLd_mSotOfsNO2Sum_mp "Summe von Korrekturwerten der Rußmasse für NO2-Regeneration zur Ermittlung des Mittelwertes" SLONG mSoot_g 1 100 -21474836.4800 21474836.4700 FORMAT "%13.4" ECU_ADDRESS 0xC0009200 /end MEASUREMENT
/begin MEASUREMENT PFltLd_mSotOfsNO2Tot_mp "In einer vorausgegangenen NO2-Regenerationsphase ermittelter Korrekturwert der Rußmasse" SWORD mSoot_g 1 100 -327.6800 327.6700 FORMAT "%8.4" ECU_ADDRESS 0xC000A91E /end MEASUREMENT
/begin MEASUREMENT PFltLd_mSotOfsNO2_mp "Ermittelten Rußmassen-Offsets für NO2 Regeneration" SWORD mSoot_g 1 100 -327.6800 327.6700 FORMAT "%8.4" ECU_ADDRESS 0xC000A920 /end MEASUREMENT
/begin MEASUREMENT PFltLd_mSotOfsStrtAct_mp "Aktueller Korrekturwert der Rußmasse für Motorstart" SWORD mSoot_g 1 100 -327.6800 327.6700 FORMAT "%8.4" ECU_ADDRESS 0xC000A922 /end MEASUREMENT
/begin MEASUREMENT PFltLd_mSotOfsStrtMax_mp "Maximaler offsetkorrekturwert der Rußmasse aus Motorstart" SWORD mSoot_g 1 100 -327.6800 327.6700 FORMAT "%8.4" ECU_ADDRESS 0xC000A924 /end MEASUREMENT
/begin MEASUREMENT PFltLd_mSotOfsStrtSum_mp "Summe von Korrekturwerten der Rußmasse für Motorstart zur Ermittlung des Mittelwertes" SLONG mSoot_g 1 100 -21474836.4800 21474836.4700 FORMAT "%13.4" ECU_ADDRESS 0xC0009204 /end MEASUREMENT
/begin MEASUREMENT PFltLd_mSotOfsStrt_mp "Ermittelten Rußmassen-Offsets für Motorstart" SWORD mSoot_g 1 100 -327.6800 327.6700 FORMAT "%8.4" ECU_ADDRESS 0xC000A926 /end MEASUREMENT
/begin MEASUREMENT PFltLd_mSotRes_mp "Restrussmasse im Partikelfilter nach erfolgreicher Regeneration" SWORD mSoot_g 1 100 -327.6800 327.6700 FORMAT "%8.4" ECU_ADDRESS 0xC000A94E /end MEASUREMENT
/begin MEASUREMENT PFltLd_mSotRgnThr_mp "Dieser Messpunkt wird nicht verwendet" SWORD mSoot_g 1 100 -327.6800 327.6700 FORMAT "%8.4" ECU_ADDRESS 0xC000A950 /end MEASUREMENT
/begin MEASUREMENT PFltLd_mSotSim "Simulierte Rußmasse im Partikelfilter" SWORD mSoot_g 1 100 -327.6800 327.6700 FORMAT "%8.4" ECU_ADDRESS 0xD00011E2 /end MEASUREMENT
/begin MEASUREMENT PFltLd_mSotSimCont "kontinuierlich simulierte Partikelmasse" SWORD mSoot_g 1 100 -327.6800 327.6700 FORMAT "%8.4" ECU_ADDRESS 0xD00011E4 /end MEASUREMENT
/begin MEASUREMENT PFltLd_mSotSimContEEP_mp "Im EEPROM gespeicherter Wert der kontinuierlich simulierten Partikelmasse" SWORD mSoot_g 1 100 -327.6800 327.6700 FORMAT "%8.4" ECU_ADDRESS 0xC000A968 /end MEASUREMENT
/begin MEASUREMENT PFltLd_mSotSimInit_mp "" SWORD mSoot_g 1 100 -327.6800 327.6700 FORMAT "%8.4" ECU_ADDRESS 0xC000A96A /end MEASUREMENT
/begin MEASUREMENT PFltLd_mSotSimNoContEEP "Im EEPROM gespeicherter Wert der nicht kontinuierlich simulierten Partikelmasse" SWORD mSoot_g 1 100 -327.6800 327.6700 FORMAT "%8.4" ECU_ADDRESS 0xD00011E6 /end MEASUREMENT
/begin MEASUREMENT PFltLd_mSotSimNoCont_mp "nicht kontinuierlich simulierte Partikelmasse" SWORD mSoot_g 1 100 -327.6800 327.6700 FORMAT "%8.4" ECU_ADDRESS 0xC000A952 /end MEASUREMENT
/begin MEASUREMENT PFltLd_mSotSimRgnNO2_mp "" SWORD mSoot_mg 1 100 -327680.0 327670.0 FORMAT "%8.1" ECU_ADDRESS 0xC000A954 /end MEASUREMENT
/begin MEASUREMENT PFltLd_nAvrgFltAshCor_mp "gefilterter Wert Drehzahl" SWORD EngN 1 100 -16384.00 16383.50 ECU_ADDRESS 0xC000A8DA /end MEASUREMENT
/begin MEASUREMENT PFltLd_numValAvrgOfsNO2_mp "Anzahl der durchgeführten Mittelungszyklen für Rußmassenoffset-Berechnung bei NO2-Regeneration" UWORD OneToOne 1 100 0.00 65535.00 ECU_ADDRESS 0xC000A928 /end MEASUREMENT
/begin MEASUREMENT PFltLd_numValAvrgOfsStrt_mp "Anzahl der durchgeführten Mittelungszyklen für Rußmassenoffset-Berechnung bei Motorstart" UWORD OneToOne 1 100 0.00 65535.00 ECU_ADDRESS 0xC000A92A /end MEASUREMENT
/begin MEASUREMENT PFltLd_pDiffAshVolCor_mp "Differenzdruck des aschebeladenen Partikelfilters" SWORD Pres_hPa 1 100 -32768.00 3500.00 ECU_ADDRESS 0xC000A92C /end MEASUREMENT
/begin MEASUREMENT PFltLd_pDiffPFlt_mp "Differenzdruck des leeren Partikelfilters" SWORD Pres_hPa 1 100 -32768.00 3500.00 ECU_ADDRESS 0xC000A92E /end MEASUREMENT
/begin MEASUREMENT PFltLd_pDiffSot_mp "Differenzdruckanteil des Rußes im Partikelfilter" SWORD Pres_hPa 1 100 -32768.00 3500.00 ECU_ADDRESS 0xC000A930 /end MEASUREMENT
/begin MEASUREMENT PFltLd_pPPreDVolDynFlt_mp "Ungefilterter Differenzdruck über Filter für Berechnung dynamische Filterzeitkorrektur" SWORD Pres_hPa 1 100 -32768.00 3500.00 ECU_ADDRESS 0xC000A932 /end MEASUREMENT
/begin MEASUREMENT PFltLd_qFlTotCor "nach der letzten Filterreinigung verbrauchte gesamte Krafstoffmenge" SWORD Fl_2 1 100 -327680.0 327670.0 FORMAT "%8.1" ECU_ADDRESS 0xD00011E8 /end MEASUREMENT
/begin MEASUREMENT PFltLd_qFlTotCorCurIn_mp "gefilterte Korrekturmenge" SWORD Fl_2 1 100 -327680.0 327670.0 FORMAT "%8.1" ECU_ADDRESS 0xC000A8FE /end MEASUREMENT
/begin MEASUREMENT PFltLd_qSetUnBalFltAshCor_mp "gefilterter Wert Einspritzmasse" SWORD InjMassCyc 1 100 -327.6800 327.6700 ECU_ADDRESS 0xC000A8DC /end MEASUREMENT
/begin MEASUREMENT PFltLd_resFlowFltAshCorMAPIn_mp "MAP i/p für PFltLd_mAshCor_MAP" SWORD Res_hPaHrPerCM 1 100 -3.276800 3.276700 FORMAT "%8.6" ECU_ADDRESS 0xC000A8DE /end MEASUREMENT
/begin MEASUREMENT PFltLd_resFlowFltAshCorRaw_mp "Resflow-Rohwert" SWORD Res_hPaHrPerCM 1 100 -3.276800 3.276700 FORMAT "%8.6" ECU_ADDRESS 0xC000A8E0 /end MEASUREMENT
/begin MEASUREMENT PFltLd_resFlowFltAshCor_mp "PT1-gefilterter Wert für for PFlt_resFlow" SWORD Res_hPaHrPerCM 1 100 -3.276800 3.276700 FORMAT "%8.6" ECU_ADDRESS 0xC000A8E2 /end MEASUREMENT
/begin MEASUREMENT PFltLd_resFlw "Strömungswiderstand des Partikelfilters" SWORD Res_hPaHrPerCM 1 100 -3.276800 3.276700 FORMAT "%8.6" ECU_ADDRESS 0xD00011EE /end MEASUREMENT
/begin MEASUREMENT PFltLd_resFlwFlt "Gefilterter Strömungswiderstand des Partikelfilters" SWORD Res_hPaHrPerCM 1 100 -3.276800 3.276700 FORMAT "%8.6" ECU_ADDRESS 0xD00011F0 /end MEASUREMENT
/begin MEASUREMENT PFltLd_resFlwFltAbs "Strömungswiderstand mit Ascheanteil" SWORD Res_hPaHrPerCM 1 100 -3.276800 3.276700 FORMAT "%8.6" ECU_ADDRESS 0xD00011F2 /end MEASUREMENT
/begin MEASUREMENT PFltLd_resFlwMeasInv_mp "Strömungswiderstand aus inversem Strömungswiderstandskennfeld" SWORD Res_hPaHrPerCM 1 100 -3.276800 3.276700 FORMAT "%8.6" ECU_ADDRESS 0xC000A934 /end MEASUREMENT
/begin MEASUREMENT PFltLd_resFlwOfs "" SWORD Res_hPaHrPerCM 1 100 -3.276800 3.276700 FORMAT "%8.6" ECU_ADDRESS 0xD00011F4 /end MEASUREMENT
/begin MEASUREMENT PFltLd_resFlwRaw "" SWORD Res_hPaHrPerCM 1 100 -3.276800 3.276700 FORMAT "%8.6" ECU_ADDRESS 0xD00011F6 /end MEASUREMENT
/begin MEASUREMENT PFltLd_resFlwRaw_mp "Strömungswiderstand des Partikelfilters (Rohwert)" SWORD Res_hPaHrPerCM 1 100 -3.276800 3.276700 FORMAT "%8.6" ECU_ADDRESS 0xC000A936 /end MEASUREMENT
/begin MEASUREMENT PFltLd_resFlwUnCor "nicht korrigierter Strömungswiderstand des Partikelfilters" SWORD Res_hPaHrPerCM 1 100 -3.276800 3.276700 FORMAT "%8.6" ECU_ADDRESS 0xD00011F8 /end MEASUREMENT
/begin MEASUREMENT PFltLd_rLamAprx_mp "Lambdawert vor Partikelfilter aus dem modellierten Sauerstoff nach Abgaskrümmer und dem stöchiometrischen Verhältnisses für die Verbrennung des Kraftstoffes" SWORD lambda 1 100 -32.76800 32.76700 ECU_ADDRESS 0xC000A96C /end MEASUREMENT
/begin MEASUREMENT PFltLd_rLam_mp "Lambdawert vor Partikelfilter" SWORD lambda 1 100 -32.76800 32.76700 ECU_ADDRESS 0xC000A96E /end MEASUREMENT
/begin MEASUREMENT PFltLd_rLmbdStat_mp "Stationäres Lambda für dynamische Korrektur" SWORD lambda 1 100 -32.76800 32.76700 ECU_ADDRESS 0xC000A970 /end MEASUREMENT
/begin MEASUREMENT PFltLd_rNO2TotMax_mp "Maximaler durch NO2-Effekt regenerierbar Rußmassenstrom" SWORD rNO2TotMax 1 100 -0.03276800 0.03276700 FORMAT "%10.8" ECU_ADDRESS 0xC000A956 /end MEASUREMENT
/begin MEASUREMENT PFltLd_rNO2Tot_mp "insgesamt zur Verfügung stehender NO2-Massenstrom" SWORD RatNOxMass 1 100 -0.003276800 0.003276700 FORMAT "%11.9" ECU_ADDRESS 0xC000A958 /end MEASUREMENT
/begin MEASUREMENT PFltLd_rNOxEng_mp "NOx Rohemissionen für Simulation" SWORD RatNOxMass 1 100 -0.003276800 0.003276700 FORMAT "%11.9" ECU_ADDRESS 0xC000A972 /end MEASUREMENT
/begin MEASUREMENT PFltLd_rO2Aprx "Sauerstoffanteil im Abgas für Simulation" SWORD O2 1 100 -0.3276800 0.3276700 ECU_ADDRESS 0xD00011EA /end MEASUREMENT
/begin MEASUREMENT PFltLd_rO2SimRgn_mp "Korrekturfaktor für die thermische Rußabbrandsberechnung abhängig von Lambda- und sauerstoffmassenstromabhängigen" SWORD O2 1 100 -0.3276800 0.3276700 ECU_ADDRESS 0xC000A974 /end MEASUREMENT
/begin MEASUREMENT PFltLd_rSot "Rußmasse im Partikelfilter pro Filtervolumen" SWORD Soot_gPerLtr 1 100 -327.6800 327.6700 FORMAT "%8.4" ECU_ADDRESS 0xD00011EC /end MEASUREMENT
/begin MEASUREMENT PFltLd_stAshCorCalc_mp "Berechnungsstatus Aschekorrektur" UBYTE OneToOne 1 100 0.00 255.0 ECU_ADDRESS 0xC000B430 /end MEASUREMENT
/begin MEASUREMENT PFltLd_stAshCorRgn_mp "bitweise Aufschlüsselung der aktuellen Regenerationsanforderung" UBYTE OneToOne 1 100 0.00 255.0 ECU_ADDRESS 0xC000B431 /end MEASUREMENT
/begin MEASUREMENT PFltLd_stAshCorRlsOn_mp "Status Aschekorrektur-Freigabe am" UWORD OneToOne 1 100 0.00 65535.00 ECU_ADDRESS 0xC000A8E4 /end MEASUREMENT
/begin MEASUREMENT PFltLd_stAshCorRls_mp "Status Aschekorrektur-Freigabe" UBYTE OneToOne 1 100 0.00 255.0 ECU_ADDRESS 0xC000B432 /end MEASUREMENT
/begin MEASUREMENT PFltLd_stAshCor_mp "Status Aschekorrektur" UBYTE OneToOne 1 100 0.00 255.0 ECU_ADDRESS 0xC000B433 /end MEASUREMENT
/begin MEASUREMENT PFltLd_stAvrgTOutNO2_mp "Status Timer für die maximale Dauer der Mittelwertbildung für Rußmassenoffset-Berechnung bei NO2-Regeneration" UBYTE OneToOne 1 100 0.00 255.0 ECU_ADDRESS 0xC000B435 /end MEASUREMENT
/begin MEASUREMENT PFltLd_stEGROff_mp "Erkennung AGR aus für NOx Rohemissionsberechnung" UBYTE OneToOne 1 100 0.00 255.0 ECU_ADDRESS 0xC000B43C /end MEASUREMENT
/begin MEASUREMENT PFltLd_stFlTotCorOn_mp "Status für Gesamtmenge Kraftstoffkorrektur ON" UBYTE OneToOne 1 100 0.00 255.0 ECU_ADDRESS 0xC000B434 /end MEASUREMENT
/begin MEASUREMENT PFltLd_stHCCond "Anforderung HC Conditionierung" UBYTE OneToOne 1 100 0.00 255.0 ECU_ADDRESS 0xD0002030 /end MEASUREMENT
/begin MEASUREMENT PFltLd_stInitAftSuc_mp "Status für die Initialisierung der Integratoren nach einer erfolgreichen Regeneration" UBYTE OneToOne 1 100 0.00 255.0 ECU_ADDRESS 0xC000B43D /end MEASUREMENT
/begin MEASUREMENT PFltLd_stMsSotOfsNO2Actv_mp "Status Berechnung Rußmassenoffset bei NO2-Regeneration aktiv" UBYTE OneToOne 1 100 0.00 255.0 ECU_ADDRESS 0xC000B436 /end MEASUREMENT
/begin MEASUREMENT PFltLd_stMsSotOfsStrtActv_mp "Status Berechnung Rußmassenoffset bei Motorstart aktiv" UBYTE OneToOne 1 100 0.00 255.0 ECU_ADDRESS 0xC000B437 /end MEASUREMENT
/begin MEASUREMENT PFltLd_stNO2Actv "Status NO2-Effekt aktiv" UBYTE OneToOne 1 100 0.00 255.0 ECU_ADDRESS 0xD0002031 /end MEASUREMENT
/begin MEASUREMENT PFltLd_stOfsNO2Rls_mp "Status für die Freigabe der Rußmassenoffset-Berechnung bei NO2-Regeneration" UBYTE OneToOne 1 100 0.00 255.0 ECU_ADDRESS 0xC000B438 /end MEASUREMENT
/begin MEASUREMENT PFltLd_stOptHCCond "Anforderung für optionale HC Conditionierung" UBYTE OneToOne 1 100 0.00 255.0 ECU_ADDRESS 0xD0002032 /end MEASUREMENT
/begin MEASUREMENT PFltLd_stSimOn "Statusbit Simulation aktiv" UBYTE OneToOne 1 100 0.00 255.0 ECU_ADDRESS 0xD0002033 /end MEASUREMENT
/begin MEASUREMENT PFltLd_stSimOnBas_mp "Bitleiste der überprüften Basis-Bedingungen zur Aktivierung der Simulation der Partikelmasse" UWORD OneToOne 1 100 0.00 65535.00 ECU_ADDRESS 0xC000A8F2 /end MEASUREMENT
/begin MEASUREMENT PFltLd_stSimOn_mp "Statuswort Simulation aktiv" UWORD OneToOne 1 100 0.00 65535.00 ECU_ADDRESS 0xC000A8F4 /end MEASUREMENT
/begin MEASUREMENT PFltLd_stSotIniCont_mp "Status Initialisierung des Integrators für kontinuierlich simulierte Rußmasse" UBYTE OneToOne 1 100 0.00 255.0 ECU_ADDRESS 0xC000B43E /end MEASUREMENT
/begin MEASUREMENT PFltLd_stSotIniNoCont_mp "Status Initialisierung des Integrators für nicht kontinuierlich simulierte Rußmasse" UBYTE OneToOne 1 100 0.00 255.0 ECU_ADDRESS 0xC000B43F /end MEASUREMENT
/begin MEASUREMENT PFltLd_stSotIntegIni_mp "Status Initialisierung des Integrators für kontinuierlich und nicht-kontinuierlich simulierte Rußmasse" UBYTE OneToOne 1 100 0.00 255.0 ECU_ADDRESS 0xC000B43A /end MEASUREMENT
/begin MEASUREMENT PFltLd_stSotSimInitLog_mp "" UBYTE OneToOne 1 100 0.00 255.0 ECU_ADDRESS 0xC000B440 /end MEASUREMENT
/begin MEASUREMENT PFltLd_stSotSimInit_mp "" UBYTE OneToOne 1 100 0.00 255.0 ECU_ADDRESS 0xC000B441 /end MEASUREMENT
/begin MEASUREMENT PFltLd_stStMOfsNO2_mp "Status des Zustandsautomats für die Rußmassen-Offsetberechnung bei NO2-Regeneration" UBYTE OneToOne 1 100 0.00 255.0 ECU_ADDRESS 0xC000B439 /end MEASUREMENT
/begin MEASUREMENT PFltLd_stTiAftSucThres_mp "Status - wenn Taktgeber vergangen hat, initialisiert SotSim Integratoren" UBYTE OneToOne 1 100 0.00 255.0 ECU_ADDRESS 0xC000B43B /end MEASUREMENT
/begin MEASUREMENT PFltLd_tAirFltAshCor_mp "gefilterter Wert Ansauglufttemperatur" SWORD Temp_Cels 1 100 -3549.940 3003.560 ECU_ADDRESS 0xC000A8E6 /end MEASUREMENT
/begin MEASUREMENT PFltLd_tCIntFltAshCor_mp "gefilterter Wert Kühlmitteltemperatur" SWORD Temp_Cels 1 100 -3549.940 3003.560 ECU_ADDRESS 0xC000A8E8 /end MEASUREMENT
/begin MEASUREMENT PFltLd_tiCorOfsNO2_mp "Zeit seit Ende der NO2-Regeneration" SWORD TimeRed 1 100 -5242.880 5242.720 FORMAT "%8.3" ECU_ADDRESS 0xC000A938 /end MEASUREMENT
/begin MEASUREMENT PFltLd_tiLastHCCond_mp "Zeitpunkt bei letzter Regeneration" SLONG Time_s_float 1 100 -2147483648.00 2147483647.00 FORMAT "%13.2" ECU_ADDRESS 0xC00091F8 /end MEASUREMENT
/begin MEASUREMENT PFltLd_tiNO2Rgn "Oberen 16 Bits des PFlt_tiTempSnceRgn_mp" SWORD Time_TempSnceRgn16 1 100 -1310720. 1310680. FORMAT "%8.0" ECU_ADDRESS 0xD00011FA /end MEASUREMENT
/begin MEASUREMENT PFltLd_tiNO2RgnDel_mp "Verzugszeit zur Aktivierung des Zustand Regeneration durch NO2" SWORD Time_s 1 100 -327.6800 327.6700 ECU_ADDRESS 0xC000A95A /end MEASUREMENT
/begin MEASUREMENT PFltLd_tiNumAshCorMax_mp "maximale zeit für asche korrektur" SLONG Time_ms 1 100 -21474836480.0 21474836470.0 ECU_ADDRESS 0xC00091E8 /end MEASUREMENT
/begin MEASUREMENT PFltLd_tiNumAshCor_mp "zeit für asche korrektur" SLONG Time_ms 1 100 -21474836480.0 21474836470.0 ECU_ADDRESS 0xC00091EC /end MEASUREMENT
/begin MEASUREMENT PFltLd_tiPPreDVolDynFlt "Zeitkonstante des PT1 Filters" SLONG TimeDelay_s 1 100 0.000002000000001 4294.9672960 FORMAT "%12.7" ECU_ADDRESS 0xD0002F88 /end MEASUREMENT
/begin MEASUREMENT PFltLd_tiRgnAct_mp "Gesamtdauer der Regeneration" SLONG Time_s 1 100 -21474836.4800 21474836.4700 ECU_ADDRESS 0xC0009208 /end MEASUREMENT
/begin MEASUREMENT PFltLd_tiSnceHCCond_mp "Zeit seit letzter Regeneration" SLONG Time_s_float 1 100 -2147483648.00 2147483647.00 FORMAT "%13.2" ECU_ADDRESS 0xC00091FC /end MEASUREMENT
/begin MEASUREMENT PFltLd_tiTempSnceRgn_mp "Integrierter Wert von PFlt_facTempCRT" SLONG Time_TempSnceRgn 1 100 -1342177.28000 1342177.27937 FORMAT "%13.5" ECU_ADDRESS 0xC0009210 /end MEASUREMENT
/begin MEASUREMENT PFltLd_tOxiPreFltAshCor_mp "gefilterter Wert OxiKat-Temperatur" SWORD Temp_Cels 1 100 -3549.940 3003.560 ECU_ADDRESS 0xC000A8EA /end MEASUREMENT
/begin MEASUREMENT PFltLd_tPreFltAshCor_mp "gefilterter Wert Aufwärtstemperatur Partikelfilter" SWORD Temp_Cels 1 100 -3549.940 3003.560 ECU_ADDRESS 0xC000A8EC /end MEASUREMENT
/begin MEASUREMENT PFltLd_vAvrgSnceHCCond_mp "Durchschnittsgeschwindigkeit seit letzter Regeneration" SWORD lSnceRgnRes2 1 100 -1179.648 1179.612 FORMAT "%8.3" ECU_ADDRESS 0xC000A8FC /end MEASUREMENT
/begin MEASUREMENT PFltLd_volAsh "Ash load in terms of volume" SWORD Vol 1 100 -327.6800 327.6700 FORMAT "%8.4" ECU_ADDRESS 0xD00011FC /end MEASUREMENT
/begin MEASUREMENT PFltLd_volAsh_mp "Zur ausgewählten Luftbank umgeschalteter Betriebspunktanzeiger für Kennlinie PFltLd_facMltCor_CUR" SWORD Vol 1 100 -327.6800 327.6700 FORMAT "%8.4" ECU_ADDRESS 0xC000A900 /end MEASUREMENT
/begin MEASUREMENT PFltLd_vVehFltAshCor_mp "gefilterter Wert Fahrzeuggeschwindigkeit" SWORD Vel 1 100 -327.6800 327.6700 ECU_ADDRESS 0xC000A8EE /end MEASUREMENT
/begin MEASUREMENT PFltPOp_nEngFlt "PT1 gefilterte Drehzahl" SWORD EngN 1 100 -16384.00 16383.50 ECU_ADDRESS 0xD00011FE /end MEASUREMENT
/begin MEASUREMENT PFltPOp_qSetUnBalFlt "gefilterter Wert der Einspritzmenge" SWORD InjMassCyc 1 100 -327.6800 327.6700 ECU_ADDRESS 0xD0001200 /end MEASUREMENT
/begin MEASUREMENT PFltPOp_rAPPFlt "gefilterter Wert des Fahrpedalsignals" SWORD Prc 1 100 -400.0000 399.9878 ECU_ADDRESS 0xD0001202 /end MEASUREMENT
/begin MEASUREMENT PFltPOp_RngIdx_X_mp "X-Index für Bereichsgrenzen-Matrizen" UBYTE OneToOne 1 100 0.00 255.0 ECU_ADDRESS 0xC000B442 /end MEASUREMENT
/begin MEASUREMENT PFltPOp_RngIdx_Y_mp "Y-Index für Bereichsgrenzen-Matrizen" UBYTE OneToOne 1 100 0.00 255.0 ECU_ADDRESS 0xC000B443 /end MEASUREMENT
/begin MEASUREMENT PFltPOp_RngPrjIdx_X_mp "" UBYTE OneToOne 1 100 0.00 255.0 ECU_ADDRESS 0xC000B444 /end MEASUREMENT
/begin MEASUREMENT PFltPOp_RngPrjIdx_Y_mp "" UBYTE OneToOne 1 100 0.00 255.0 ECU_ADDRESS 0xC000B445 /end MEASUREMENT
/begin MEASUREMENT PFltPOp_stBrkDeb "Entprelltes Bremssignal" UBYTE OneToOne 1 100 0.00 255.0 ECU_ADDRESS 0xD0002034 /end MEASUREMENT
/begin MEASUREMENT PFltPOp_stClthDeb "Entprelltes Kupplungssignal" UBYTE OneToOne 1 100 0.00 255.0 ECU_ADDRESS 0xD0002035 /end MEASUREMENT
/begin MEASUREMENT PFltPOp_stEngPOp "Motorbetriebspunkt" UBYTE OneToOne 1 100 0.00 255.0 ECU_ADDRESS 0xD0002036 /end MEASUREMENT
/begin MEASUREMENT PFltPOp_stEngPOp10_mp "Motorbetriebspunkt im Prüfungsbereich 10 berechnet" UBYTE OneToOne 1 100 0.00 255.0 ECU_ADDRESS 0xC000B446 /end MEASUREMENT
/begin MEASUREMENT PFltPOp_stEngPOp1_mp "Motorbetriebspunkt im Prüfungsbereich 1 berechnet" UBYTE OneToOne 1 100 0.00 255.0 ECU_ADDRESS 0xC000B447 /end MEASUREMENT
/begin MEASUREMENT PFltPOp_stEngPOp2_mp "Motorbetriebspunkt im Prüfungsbereich 2 berechnet" UBYTE OneToOne 1 100 0.00 255.0 ECU_ADDRESS 0xC000B448 /end MEASUREMENT
/begin MEASUREMENT PFltPOp_stEngPOp3_mp "Motorbetriebspunkt im Prüfungsbereich 3 berechnet" UBYTE OneToOne 1 100 0.00 255.0 ECU_ADDRESS 0xC000B449 /end MEASUREMENT
/begin MEASUREMENT PFltPOp_stEngPOp4_mp "Motorbetriebspunkt im Prüfungsbereich 4 berechnet" UBYTE OneToOne 1 100 0.00 255.0 ECU_ADDRESS 0xC000B44A /end MEASUREMENT
/begin MEASUREMENT PFltPOp_stEngPOp5_mp "Motorbetriebspunkt im Prüfungsbereich 5 berechnet" UBYTE OneToOne 1 100 0.00 255.0 ECU_ADDRESS 0xC000B44B /end MEASUREMENT
/begin MEASUREMENT PFltPOp_stEngPOp6_mp "Motorbetriebspunkt im Prüfungsbereich 6 berechnet" UBYTE OneToOne 1 100 0.00 255.0 ECU_ADDRESS 0xC000B44C /end MEASUREMENT
/begin MEASUREMENT PFltPOp_stEngPOp7_mp "Motorbetriebspunkt im Prüfungsbereich 7 berechnet" UBYTE OneToOne 1 100 0.00 255.0 ECU_ADDRESS 0xC000B44D /end MEASUREMENT
/begin MEASUREMENT PFltPOp_stEngPOp8_mp "Motorbetriebspunkt im Prüfungsbereich 8 berechnet" UBYTE OneToOne 1 100 0.00 255.0 ECU_ADDRESS 0xC000B44E /end MEASUREMENT
/begin MEASUREMENT PFltPOp_stEngPOp9_mp "Motorbetriebspunkt im Prüfungsbereich 9 berechnet" UBYTE OneToOne 1 100 0.00 255.0 ECU_ADDRESS 0xC000B44F /end MEASUREMENT
/begin MEASUREMENT PFltPOp_stEngPOpPrj_mp "" UWORD OneToOne 1 100 0.00 65535.00 ECU_ADDRESS 0xC000A976 /end MEASUREMENT
/begin MEASUREMENT PFltPOp_stEngPOpSpo_mp "Messpunkt für spontane Regeneration" UBYTE OneToOne 1 100 0.00 255.0 ECU_ADDRESS 0xC000B450 /end MEASUREMENT
/begin MEASUREMENT PFltPOp_stGearDeb "entprelltes Gangsignal" UBYTE OneToOne 1 100 0.00 255.0 ECU_ADDRESS 0xD0002037 /end MEASUREMENT
/begin MEASUREMENT PFltPOp_stRng10_mp "Statuswort der Regeneration im Bereich 10" UWORD OneToOne 1 100 0.00 65535.00 ECU_ADDRESS 0xC000A978 /end MEASUREMENT
/begin MEASUREMENT PFltPOp_stRng1_mp "Statuswort der Regeneration im Bereich 1" UWORD OneToOne 1 100 0.00 65535.00 ECU_ADDRESS 0xC000A97A /end MEASUREMENT
/begin MEASUREMENT PFltPOp_stRng2_mp "Statuswort der Regeneration im Bereich 2" UWORD OneToOne 1 100 0.00 65535.00 ECU_ADDRESS 0xC000A97C /end MEASUREMENT
/begin MEASUREMENT PFltPOp_stRng3_mp "Statuswort der Regeneration im Bereich 3" UWORD OneToOne 1 100 0.00 65535.00 ECU_ADDRESS 0xC000A97E /end MEASUREMENT
/begin MEASUREMENT PFltPOp_stRng4_mp "Statuswort der Regeneration im Bereich 4" UWORD OneToOne 1 100 0.00 65535.00 ECU_ADDRESS 0xC000A980 /end MEASUREMENT
/begin MEASUREMENT PFltPOp_stRng5_mp "Statuswort der Regeneration im Bereich 5" UWORD OneToOne 1 100 0.00 65535.00 ECU_ADDRESS 0xC000A982 /end MEASUREMENT
/begin MEASUREMENT PFltPOp_stRng6_mp "Statuswort der Regeneration im Bereich 6" UWORD OneToOne 1 100 0.00 65535.00 ECU_ADDRESS 0xC000A984 /end MEASUREMENT
/begin MEASUREMENT PFltPOp_stRng7_mp "Statuswort der Regeneration im Bereich 7" UWORD OneToOne 1 100 0.00 65535.00 ECU_ADDRESS 0xC000A986 /end MEASUREMENT
/begin MEASUREMENT PFltPOp_stRng8_mp "Statuswort der Regeneration im Bereich 8" UWORD OneToOne 1 100 0.00 65535.00 ECU_ADDRESS 0xC000A988 /end MEASUREMENT
/begin MEASUREMENT PFltPOp_stRng9_mp "Statuswort der Regeneration im Bereich 9" UWORD OneToOne 1 100 0.00 65535.00 ECU_ADDRESS 0xC000A98A /end MEASUREMENT
/begin MEASUREMENT PFltPOp_stRngSpo_mp "Statuswort der spontanen Regeneration" UWORD OneToOne 1 100 0.00 65535.00 ECU_ADDRESS 0xC000A98C /end MEASUREMENT
/begin MEASUREMENT PFltPOp_tAdapTOxiCatUsFlt "gefilterter Wert der Temperatur vor dem Oxidationskatalysator" SWORD Temp_Cels 1 100 -3549.940 3003.560 ECU_ADDRESS 0xD0001204 /end MEASUREMENT
/begin MEASUREMENT PFltPOp_tAdapTPFltUsFlt "Gefilterter Wert der Temperatur vor dem Partikelfilter" SWORD Temp_Cels 1 100 -3549.940 3003.560 ECU_ADDRESS 0xD0001206 /end MEASUREMENT
/begin MEASUREMENT PFltPOp_tAir_mp "Lufttemperatur" SWORD Temp_Cels 1 100 -3549.940 3003.560 ECU_ADDRESS 0xC000A98E /end MEASUREMENT
/begin MEASUREMENT PFltPOp_tEngTempFlt "gefilterter Wert der Kühlmitteltemperatur" SWORD Temp_Cels 1 100 -3549.940 3003.560 ECU_ADDRESS 0xD0001208 /end MEASUREMENT
/begin MEASUREMENT PFltPOp_tEngTemp_mp "Kühlmitteltemperatur" SWORD Temp_Cels 1 100 -3549.940 3003.560 ECU_ADDRESS 0xC000A990 /end MEASUREMENT
/begin MEASUREMENT PFltPOp_uBattFlt "Gefilterter Wert der Batteriespannung" SWORD Volt_Batt 1 100 -655360.0 655340.0 ECU_ADDRESS 0xD000120A /end MEASUREMENT
/begin MEASUREMENT PFltPOp_vFlt "gefilterter Wert der Fahrgeschwindigkeit" SWORD Vel 1 100 -327.6800 327.6700 ECU_ADDRESS 0xD000120C /end MEASUREMENT
/begin FUNCTION PCR_GovLP ""
 /begin DEF_CHARACTERISTIC PCR_DT1WinLP.T1_C PCR_DT1WinLP.Kd_C PCR_DT1WinLP.KdPos_C PCR_DT1WinLP.KdNeg_C PCR_DT1WinLP.WinPos_C PCR_DT1WinLP.WinNeg_C PCR_facLPD_MAP PCR_facLPI_MAP PCR_facLPP_MAP PCR_facT1LP_MAP PCR_GovOffEOMLP_CUR PCR_GovOffLP_CUR PCR_GovOnEOMLP_CUR PCR_GovOnLP_CUR PCR_IWinLP.Ki_C PCR_IWinLP.KiPos_C PCR_IWinLP.KiNeg_C PCR_IWinLP.WinPos_C PCR_IWinLP.WinNeg_C PCR_PWinLP.Kp_C PCR_PWinLP.KpPos_C PCR_PWinLP.KpNeg_C PCR_PWinLP.WinPos_C PCR_PWinLP.WinNeg_C PCR_RelAbsLP.xVal_C PCR_RelAbsLP.xTyp_C PCR_rGovLPMax_MAP PCR_rGovLPMin_MAP PCR_rOutIMaxLP_MAP PCR_rOutIMinLP_MAP PCR_stMskGovOffEOMLP_C PCR_tiGovOffDelLP_CUR PCR_tiPT1LP_C PCR_tiRmp2LP_C PCR_tiRmpLP_C /end DEF_CHARACTERISTIC
 /begin IN_MEASUREMENT Air_dpFltIntkVUs Air_pIntkVUs CoEOM_stOpModeAct EnvP_p Epm_nEng PCR_pDesValLP PCR_qGov PCR_rCtlValAutLP PCR_rCtlValLP PCR_stCByVlvOpn PCR_stMonLP PCR_stTransLP PCR_trqGov /end IN_MEASUREMENT
 /begin OUT_MEASUREMENT PCR_facRmpValLP PCR_pGovDvtLP PCR_qGovLP_mp PCR_rGovLP PCR_rOutLPI PCR_stARWLP PCR_swtGovLP PCR_swtRelAbsLP /end OUT_MEASUREMENT
 /begin LOC_MEASUREMENT PCR_facLPD_mp PCR_facLPI_mp PCR_facLPP_mp PCR_facRmpVal2LP_mp PCR_facT1LP_mp PCR_GovOffLP_mp PCR_GovOnLP_mp PCR_pActValLP_mp PCR_pGovDvtLPI_mp PCR_rGovLPMaxCor_mp PCR_rGovLPMaxNrm_mp PCR_rGovLPMax_mp PCR_rGovLPMinCor_mp PCR_rGovLPMinNrm_mp PCR_rGovLPMin_mp PCR_rGovLPOut_mp PCR_rGovOutLPUnLim_mp PCR_rOutIMaxLP_mp PCR_rOutIMinLP_mp PCR_rOutLPDT1_mp PCR_rOutLPP_mp PCR_rPIDCorLP_mp PCR_rPIDCtlLP_mp PCR_rPIDLP_mp PCR_stEOMGovLP_mp PCR_swtGovNoDebLP_mp /end LOC_MEASUREMENT
/end FUNCTION
/begin FUNCTION PCR_Mon ""
 /begin DEF_CHARACTERISTIC PCR_ClthThres_C PCR_drRmpCBOpn_CUR PCR_nCldStrtMax_C PCR_nCldStrtMin_C PCR_numEngTempMon_C PCR_nWrkSph1_C PCR_nWrkSph2_C PCR_nWrkSph3_C PCR_pDesValRelOfs_C PCR_pMaxDvt_MAP PCR_pMinDvt_MAP PCR_pTransMax_C PCR_pTransMin_C PCR_qClthThres_CUR PCR_qLeadDiffLim_C PCR_rDflVal_CA PCR_stBitMskEOM_CA PCR_stMonEOMMsk_CA PCR_stPrioMon_CA PCR_swtMonDvtExtActv_C PCR_swtRelAbsValMon_C PCR_tiCldStrt_CUR PCR_tiClth_C PCR_tiDesMonDeb.tiHiLo_C PCR_tiDesMonDeb.tiLoHi_C PCR_tiMonEOM_CA PCR_vClth_C PCR_WrkSph2_C PCR_WrkSph3_C /end DEF_CHARACTERISTIC
 /begin REF_CHARACTERISTIC HESrv_swtPOpVis_C HESrv_swtScndFlwActv_C /end REF_CHARACTERISTIC
 /begin IN_MEASUREMENT Air_pIntkVUs Clth_st CoAS_stTrbCh CoEng_st CoEng_tiNormal CoEOM_stOpModeAct EngDa_tFld EnvP_p Epm_nEng PCR_facRmpVal PCR_pDesValMon PCR_pGovDvt PCR_qLeadDiff PCR_qMon PCR_rGov PCR_stCByVlvOpn PCR_stMonLP PCR_trqMon VehV_v /end IN_MEASUREMENT
 /begin OUT_MEASUREMENT PCR_stMon PCR_stPCRBits PCR_stTrans /end OUT_MEASUREMENT
 /begin LOC_MEASUREMENT PCR_drRmpCBOpn_mp PCR_numEOMMode_mp PCR_pGovDvtMonFull_mp PCR_pGovDvtMonPos_mp PCR_pGovDvtMon_mp PCR_pMaxDvt_mp PCR_pMinDvt_mp PCR_qClthThres_mp PCR_qMon_mp PCR_stBitMskEOM_mp PCR_stDebDef_mp PCR_stGovDvtMonEna_mp PCR_stMaxDvt_mp PCR_stMinDvt_mp PCR_stMonBits_mp PCR_stMonOld_mp PCR_stNrmOpEdge_mp PCR_stNrmOp_mp PCR_stRmpSel_mp PCR_stSelBitMskEOM_mp PCR_stWrkSph_mp PCR_tEngMon_mp PCR_tiMonEOM_mp PCR_tiStrtDel_mp /end LOC_MEASUREMENT
/end FUNCTION
/begin FUNCTION PCR_MonLP ""
 /begin DEF_CHARACTERISTIC PCR_ClthThresLP_CUR PCR_LPWrkSph2_C PCR_LPWrkSph3_C PCR_nLPWrkSph2_C PCR_nLPWrkSph3_C PCR_pMaxDvtLP_MAP PCR_pMinDvtLP_MAP PCR_pTransLPMax_C PCR_pTransLPMin_C PCR_rDflValLP_CA PCR_stBitMskEOMLP_CA PCR_stMonLPEOMMsk_CA PCR_stPrioMonLP_CA PCR_tiClthLP_C PCR_tiMonLPEOM_CA PCR_vClthLP_C /end DEF_CHARACTERISTIC
 /begin REF_CHARACTERISTIC HESrv_swtPOpVis_C HESrv_swtScndFlwActv_C /end REF_CHARACTERISTIC
 /begin IN_MEASUREMENT Clth_st CoAS_stTrbCh CoEng_st CoEng_tiNormal CoEOM_stOpModeAct EngDa_tFld Epm_nEng PCR_facRmpVal PCR_pGovDvtLP PCR_qMon PCR_swtGovLP PCR_trqMon /end IN_MEASUREMENT
 /begin OUT_MEASUREMENT PCR_pMaxDvtLP_mp PCR_pMinDvtLP_mp PCR_stDebDefLP_mp PCR_stGovDvtMonEnaLP_mp PCR_stMaxDvtLP_mp PCR_stMinDvtLP_mp PCR_stMonLP PCR_stNrmOpLP_mp PCR_stPCRBitsLP PCR_stTransLP PCR_stWrkSphLP_mp /end OUT_MEASUREMENT
 /begin LOC_MEASUREMENT PCR_numEOMModeLP_mp PCR_qMonLP_mp PCR_stBitMskEOMLP_mp PCR_stMonBitsLP_mp PCR_stSelBitMskEOMLP_mp PCR_tiMonLPEOM_mp /end LOC_MEASUREMENT
/end FUNCTION
/begin FUNCTION PCR_OfsCalc ""
 /begin DEF_CHARACTERISTIC PCR_dnOfsCalcLim_C PCR_dqCtlOfsCalcLim_C PCR_drCtlValOfsRmp.Pos_C PCR_drCtlValOfsRmp.Neg_C PCR_I1OfsCalc.Ki_C PCR_I1OfsCalc.KiPos_C PCR_I1OfsCalc.KiNeg_C PCR_I1OfsCalc.WinPos_C PCR_I1OfsCalc.WinNeg_C PCR_I2OfsCalc.Ki_C PCR_I2OfsCalc.KiPos_C PCR_I2OfsCalc.KiNeg_C PCR_I2OfsCalc.WinPos_C PCR_I2OfsCalc.WinNeg_C PCR_I3OfsCalc.Ki_C PCR_I3OfsCalc.KiPos_C PCR_I3OfsCalc.KiNeg_C PCR_I3OfsCalc.WinPos_C PCR_I3OfsCalc.WinNeg_C PCR_I4OfsCalc.Ki_C PCR_I4OfsCalc.KiPos_C PCR_I4OfsCalc.KiNeg_C PCR_I4OfsCalc.WinPos_C PCR_I4OfsCalc.WinNeg_C PCR_mskOfsCalcNoRls_C PCR_mskOfsCalcResetVal_C PCR_mskOfsCalcRlsPCRCond_C PCR_mskOfsCalcStopLearn_C PCR_nOfsCalc1_C PCR_nOfsCalc2_C PCR_nOfsCalcRlsMax_C PCR_nOfsCalcRlsMin_C PCR_numAirTempOfsCalc_C PCR_numEngTempOfsCalc_C PCR_OfsCalcQCtlDT1.T1_C PCR_OfsCalcQCtlDT1.Kd_C PCR_pBstOfsRlsLim_C PCR_pEnvOfsCalcMax_C PCR_pEnvOfsCalcMin_C PCR_pGovDvtOfsRlsMin_C PCR_qOfsCalc1_C PCR_qOfsCalc2_C PCR_qOfsCalcRlsMax_C PCR_qOfsCalcRlsMin_C PCR_rDistOfsCalc1_C PCR_rDistOfsCalc2_C PCR_rDistOfsCalc3_C PCR_rDistOfsCalc4_C PCR_rOfsRlsMax_MAP PCR_rOfsRlsMin_MAP PCR_stMskOfsCalc_C PCR_stOfsCalcReset_C PCR_swtOfsCalcBst_C PCR_swtOfsCalcOn_C PCR_tAirOfsCalcMax_C PCR_tAirOfsCalcMin_C PCR_tClntOfsCalcLim_C PCR_tiOfsCalcPT1_C PCR_tiOfsCalcRelStatAll.tiHiLo_C PCR_tiOfsCalcRelStatAll.tiLoHi_C PCR_tiOfsCalcRlsStat3.tiHiLo_C PCR_tiOfsCalcRlsStat3.tiLoHi_C /end DEF_CHARACTERISTIC
 /begin IN_MEASUREMENT AirCtl_stMon AirSys_tFld Air_pIntkVUs CoEng_st CoEOM_stOpModeAct CoVeh_stIgnLckTerm15 EngDa_tFld EnvP_p Epm_dnEng Epm_nEng InjCtl_qCurr PCR_pGovDvt PCR_qCtlVal PCR_rGovMaxCor PCR_rGovMinCor PCR_rGovOutUnLim PCR_rOutI PCR_stARW PCR_stMon PCR_stPCRBits PCR_swtGov /end IN_MEASUREMENT
 /begin OUT_MEASUREMENT PCR_dnAvrg PCR_dqCtlOfsCalc PCR_rCtlValOfs /end OUT_MEASUREMENT
 /begin LOC_MEASUREMENT PCR_facOfsCalcC1_mp PCR_facOfsCalcC2_mp PCR_facOfsCalcC3_mp PCR_facOfsCalcC4_mp PCR_facOfsCalcRx_mp PCR_facOfsCalcRy_mp PCR_rCtlValOfsLim_mp PCR_rCtlValOfsUnLim_mp PCR_rOfsRlsMax_mp PCR_rOfsRlsMin_mp PCR_rOutOfsCalcI1_mp PCR_rOutOfsCalcI2_mp PCR_rOutOfsCalcI3_mp PCR_rOutOfsCalcI4_mp PCR_stEepOfsCalc_mp PCR_stOfsCalcEepAccess_mp PCR_stOfsCalcResetInit_mp PCR_stOfsCalcRlsAdd1_mp PCR_stOfsCalcRlsLearn_mp PCR_stOfsCalcRlsPCRBits_mp PCR_stOfsCalcRlsStat_mp PCR_stOfsCalcRls_mp PCR_tAirOfsCalc_mp PCR_tEngOfsCalc_mp /end LOC_MEASUREMENT
/end FUNCTION
/begin FUNCTION PCV_ActrTst ""
 /begin DEF_CHARACTERISTIC PCV_facWinActrTst_CUR PCV_nDiffMaxActrTst_C PCV_nSetActrTst_C PCV_numCalcAvrgActrTst_C PCV_numCycOffActrTst_C PCV_numMaxErrActrTst_C PCV_numRepActrTst_C PCV_pMaxActrTst_C PCV_pMinActrTst_C PCV_pWinLoActrTst_C PCV_qDiffMaxActrTst_C PCV_rAccPedActrTst_C PCV_rDstHiActrTst_C PCV_rDstLoActrTst_C PCV_rMax_C PCV_rMin_C PCV_rStpActrTst_C PCV_stMskCoEOMOpModeActrTst_C PCV_swtNoChkRefActrTst_C PCV_tiDelMeasActrTst_C PCV_tiMaxActrTst_C PCV_tiWaitActrTst_C PCV_tMinActrTst_C PCV_uDiffMaxActrTst_C /end DEF_CHARACTERISTIC
 /begin IN_MEASUREMENT APP_rUnFlt BattU_u Brk_st CEngDsT_t Clth_st CoEOM_stOpModeAct Epm_nEng InjCtl_qSetUnBal PCV_iActVal PCV_rPs PT_stTraType RailP_pFlt VehV_v /end IN_MEASUREMENT
 /begin OUT_MEASUREMENT PCV_cntErrActrTst PCV_nSetActrTst PCV_numCycOffActrTst PCV_numRepActrTst PCV_pWinActrTst PCV_pWinLoActrTst PCV_rDstHiActrTst PCV_rDstLoActrTst PCV_rOutActrTst PCV_rStpActrTst PCV_stDefActrTst PCV_stEffectActrTst PCV_stRefActrTst PCV_stRsltActrTst PCV_stStMActrTst PCV_tiDelMeasActrTst /end OUT_MEASUREMENT
 /begin LOC_MEASUREMENT PCV_cntRepActrTst_mp PCV_cntTrgOffActrTst_mp PCV_facWinActrTst_mp PCV_pAvrgActrTst_mp PCV_pStrtEvalActrTst_mp PCV_qAvrgActrTst_mp PCV_rStrtActrTst_mp PCV_swtSrcPSActrTst_mp PCV_tiCalcActrTst_mp PCV_tiDelActrTst_mp PCV_tiTotalActrTst_mp PCV_tiWaitActrTst_mp PCV_trgSigActrTst_mp PCV_uAvrgActrTst_mp /end LOC_MEASUREMENT
/end FUNCTION
/begin FUNCTION PCV_Adapt ""
 /begin DEF_CHARACTERISTIC PCV_dvolUpLim_CUR PCV_facAdaptDiffI_C PCV_facAdaptDiff_C PCV_facAdaptFlowMin_C PCV_facAdaptFlow_MAP PCV_facAdaptMax_C PCV_facAdaptMin_C PCV_facAdaptWgh_C PCV_numAdaptSum_C PCV_numAdaptThres_C PCV_numAdapt_C PCV_pAdaptThresDec_C PCV_pAdaptThresMax_C PCV_pAdaptThresMin_C PCV_pAdaptThres_C PCV_swtAdaptCPC_C PCV_swtAdaptFlow_C PCV_swtAdaptRst_C PCV_swtAdapt_C PCV_tFuelAdaptMax_C PCV_tFuelAdaptMin_C PCV_tiAdaptMax_C PCV_tSwtMeUn_C /end DEF_CHARACTERISTIC
 /begin IN_MEASUREMENT CoEng_st EngDa_tiEngOn Epm_nEng FuelT_t FuelT_tFlSys MeUn_dvolSet PCV_iDvt PCV_iSet PCV_pSet RailP_pFlt Rail_dvolPreCtl Rail_pDvt Rail_pSetPoint Rail_stCtlLoop /end IN_MEASUREMENT
 /begin OUT_MEASUREMENT PCV_facAdapt PCV_facAdaptFlow PCV_stAdaptMeUn /end OUT_MEASUREMENT
 /begin LOC_MEASUREMENT PCV_ctAdapt1_mp PCV_ctAdapt2_mp PCV_ctAdapt3_mp PCV_dvolFlow_mp PCV_pAdaptThres_mp PCV_pFltSum_mp PCV_pSetSum_mp PCV_stAdapt PCV_tiAdaptLst_mp /end LOC_MEASUREMENT
/end FUNCTION
/begin FUNCTION PCV_DDCo ""
 /begin DEF_CHARACTERISTIC PCV_CrntCtlDT1.T1_C PCV_CrntCtlDT1.Kd_C PCV_iLin_CUR PCV_Pwm.tiPer_C PCV_Pwm.stLvl_C PCV_Pwm.rMaxDty_C PCV_Pwm.rPerUn_C PCV_Pwm.tiPh_C PCV_PwmOut.rMin_C PCV_PwmOut.rMax_C PCV_PwmOut.tiBtwTstSCB_C PCV_PwmOut.tiBtwTstOT_C PCV_PwmOut.numTstMax_C PCV_PwmOut.swtBattCor_C PCV_PwmOut.swtPsInv_C PCV_resCoil_C PCV_rSetLin_CUR PCV_rTst_C PCV_SRC.uMin_C PCV_SRC.uMax_C PCV_stPwrStgActv_C PCV_stPwrStgDia_C PCV_tiTst_C /end DEF_CHARACTERISTIC
 /begin IN_MEASUREMENT BattU_facCor BattU_uRated CoEng_st DevLib_stPwrStgEnaCond PCV_iSet /end IN_MEASUREMENT
 /begin OUT_MEASUREMENT PCV_iActVal PCV_rPs PCV_rSet /end OUT_MEASUREMENT
 /begin LOC_MEASUREMENT PCV_rSetDT1_mp PCV_rSetLin_mp PCV_uRaw_mp /end LOC_MEASUREMENT
/end FUNCTION
/begin FUNCTION PCV_VDCo ""
 /begin DEF_CHARACTERISTIC PCV_CrntCtlI.Ki_C PCV_CrntCtlI.KiPos_C PCV_CrntCtlI.KiNeg_C PCV_CrntCtlI.WinPos_C PCV_CrntCtlI.WinNeg_C PCV_diNoStrtRmpSlp_C PCV_facCrntCtlInit_CUR PCV_facCrntCtlMax_C PCV_facCrntCtlMin_C PCV_iCnvPres_CUR PCV_iSetClose_CUR PCV_iSetMaxBattHi_C PCV_iSetMax_C PCV_iSetMinNoStrt_C PCV_iSetMinStrStp_C PCV_iSetMin_C PCV_nSetClose_C PCV_nStrStp_C PCV_numNoStrt_C PCV_pStrStpMin_C PCV_swtClose_C PCV_tiCrntCtlInit_C PCV_tiDurClose_C PCV_tiFlt1PT1_C PCV_tiFlt2PT1_C PCV_tiFltPT1Init_C PCV_tiNoClose_C PCV_tiNoStrt_C PCV_tiSetCloseMax_C PCV_uBattHi_C PCV_uBattLo_C /end DEF_CHARACTERISTIC
 /begin REF_CHARACTERISTIC Rail_stCtlLoopSel_C /end REF_CHARACTERISTIC
 /begin IN_MEASUREMENT BattU_u CoEng_st CoEng_stMSAStp DevLib_stMonActrPrt EpmHCrS_stSigMode Epm_nEng FlSys_stPCVSetClose FuelT_tFlSys PCV_facAdapt PCV_facAdaptFlow RailP_pFlt Rail_stCtlLoop Strt_st SyC_stMn SyC_stSub /end IN_MEASUREMENT
 /begin OUT_MEASUREMENT PCV_iDvt PCV_iSet PCV_iSetFlt PCV_pSet PCV_stActrCtl PCV_stMSA PCV_stNoStrt PCV_swtCtlState /end OUT_MEASUREMENT
 /begin LOC_MEASUREMENT PCV_ctNoStrtAct_mp PCV_ctNoStrtLstCyc_mp PCV_facCrntCtlLim_mp PCV_iActFlt_mp PCV_iAct_mp PCV_iCnvPresAdapt_mp PCV_iCnvPres_mp PCV_iSetClose_mp PCV_iSetMax_mp PCV_iSetMin_mp PCV_stEngStrtMov_mp PCV_stRstMSAStp_mp PCV_stSetClose_mp PCV_tiNoStrt_mp PCV_tiSetCloseMax_mp /end LOC_MEASUREMENT
/end FUNCTION
/begin FUNCTION PCV_VDLeak "" /begin DEF_CHARACTERISTIC PCV_dvolLeak_CUR /end DEF_CHARACTERISTIC /begin IN_MEASUREMENT Rail_pSetPoint /end IN_MEASUREMENT /begin LOC_MEASUREMENT PCV_dvolLeak_mp /end LOC_MEASUREMENT /end FUNCTION
/begin FUNCTION PFltLd_Ashcor ""
 /begin DEF_CHARACTERISTIC PFltLd_aVehFltAshCorMax_C PFltLd_aVehFltAshCorMin_C PFltLd_dAvaiMin_C PFltLd_facAshCorOld_C PFltLd_facAshOil_C PFltLd_facFlTotCor_C PFltLd_mAshCor_MAP PFltLd_mAshTolcAbs_C PFltLd_mAshTolcMaxAbs_C PFltLd_mAshTolcMaxRel_C PFltLd_nAvrgFltAshCorMax_C PFltLd_nAvrgFltAshCorMin_C PFltLd_numAshCorPOp_C PFltLd_qSetUnBalFltAshCorMax_C PFltLd_qSetUnBalFltAshCorMin_C PFltLd_stAshCorEOMMsk_C PFltLd_swtAshCorActive_C PFltLd_swtAshCorOn_C PFltLd_tAirFltAshCorMax_C PFltLd_tAirFltAshCorMin_C PFltLd_tCIntAshCorMax_C PFltLd_tCIntAshCorMin_C PFltLd_tiAshCorAirTempPT1_C PFltLd_tiAshCorCIntTempPT1_C PFltLd_tiAshCorDVolPT1_C PFltLd_tiAshCorEngSpdPT1_C PFltLd_tiAshCorInjMsPT1_C PFltLd_tiAshCorOxiTempPT1_C PFltLd_tiAshCorPreTempPT1_C PFltLd_tiAshCorResFlwPT1_C PFltLd_tiAshCorRgnMax_C PFltLd_tiAshCorRgn_C PFltLd_tiAshCorRlsOn_C PFltLd_tiAshCorVehAccPT1_C PFltLd_tiAshCorVehSpdPT1_C PFltLd_tiAshCorWaitMax_C PFltLd_tOxiPreFltAshCorMax_C PFltLd_tOxiPreFltAshCorMin_C PFltLd_tPreFltAshCorMax_C PFltLd_tPreFltAshCorMin_C PFltLd_vVehFltAshCorMax_C PFltLd_vVehFltAshCorMin_C /end DEF_CHARACTERISTIC
 /begin IN_MEASUREMENT Air_tAFS CEngDsT_t Epm_nEng Exh_tAdapTOxiCatUs Exh_tAdapTPFltUs InjCtl_qSetUnBal PCBS_dAvaiOut PCBS_stCalc PCBS_stDMEChg PCBS_stPFltChg PFltLd_mAshOilEG PFltLd_mAshOilNrm PFltLd_resFlw PFltPOp_stEngPOp VehV_a VehV_v /end IN_MEASUREMENT
 /begin OUT_MEASUREMENT PFltLd_mAshCorAct PFltLd_mAshCorNew PFltLd_mAshCorOld PFltLd_qFlTotCor /end OUT_MEASUREMENT
 /begin LOC_MEASUREMENT PFltLd_aVehFltAshCor_mp PFltLd_dqFlTotAct_mp PFltLd_dqFlTotEnd_mp PFltLd_dVolFltAshCorMAPIn_mp PFltLd_dVolFltAshCorRaw_mp PFltLd_dVolFltAshCor_mp PFltLd_facAshCorDiff_mp PFltLd_mAshCorActRel_mp PFltLd_mAshCorDiff1_mp PFltLd_mAshCorDiff2_mp PFltLd_mAshCorDiff_mp PFltLd_nAvrgFltAshCor_mp PFltLd_qSetUnBalFltAshCor_mp PFltLd_resFlowFltAshCorMAPIn_mp PFltLd_resFlowFltAshCorRaw_mp PFltLd_resFlowFltAshCor_mp PFltLd_stAshCorCalc_mp PFltLd_stAshCorRgn_mp PFltLd_stAshCorRlsOn_mp PFltLd_stAshCorRls_mp PFltLd_stAshCor_mp PFltLd_stFlTotCorOn_mp PFltLd_tAirFltAshCor_mp PFltLd_tCIntFltAshCor_mp PFltLd_tiNumAshCorMax_mp PFltLd_tiNumAshCor_mp PFltLd_tOxiPreFltAshCor_mp PFltLd_tPreFltAshCor_mp PFltLd_vVehFltAshCor_mp /end LOC_MEASUREMENT
/end FUNCTION
/begin FUNCTION PFltLd_Co ""
 /begin DEF_CHARACTERISTIC PFltLd_ctRgnSucMin_C PFltLd_DebSim.tiHiLo_C PFltLd_DebSim.tiLoHi_C PFltLd_dpDiffMax_C PFltLd_DT1Pres.T1_C PFltLd_DT1Pres.Kd_C PFltLd_dvolPFltMeasMin_C PFltLd_stMskRgnActv_CA PFltLd_volPFlt_C /end DEF_CHARACTERISTIC
 /begin IN_MEASUREMENT ASMod_dvolPFltEG CoEOM_stOpModeAct Exh_pAdapPPFltDiff PFltLd_mSotMeas PFltLd_mSotSim PFltLd_stNO2Actv PFltRgn_ctRgnSuc PFlt_swtActv /end IN_MEASUREMENT
 /begin OUT_MEASUREMENT PFltLd_mSot PFltLd_rSot PFltLd_stSimOn /end OUT_MEASUREMENT
 /begin LOC_MEASUREMENT PFltLd_dpDiff_mp PFltLd_stSimOnBas_mp PFltLd_stSimOn_mp /end LOC_MEASUREMENT
/end FUNCTION
/begin FUNCTION pfltld_hccond ""
 /begin DEF_CHARACTERISTIC PFltLd_lSumMaxHCCond_MAP PFltLd_lSumMaxOptHCCond_C PFltLd_lSumOptHCCond_C /end DEF_CHARACTERISTIC
 /begin IN_MEASUREMENT CoEng_st EngDa_tiEngOn GlbDa_lTotDst PFltRgn_stHCCondEnd PFltRgn_stSuc /end IN_MEASUREMENT
 /begin OUT_MEASUREMENT PFltLd_stHCCond PFltLd_stOptHCCond /end OUT_MEASUREMENT
 /begin LOC_MEASUREMENT PFltLd_ctStartSnceHCCond_mp PFltLd_lAvrgSnceHCCond_mp PFltLd_lLastHCCond_mp PFltLd_lSnceHCCond_mp PFltLd_lSumMaxHCCond_mp PFltLd_tiLastHCCond_mp PFltLd_tiSnceHCCond_mp PFltLd_vAvrgSnceHCCond_mp /end LOC_MEASUREMENT
/end FUNCTION
/begin FUNCTION PFltLd_SotAsh "" /begin DEF_CHARACTERISTIC PFltLd_facMltCor_CUR PFltLd_mAshOil_CUR PFltLd_rhoOilAsh_C /end DEF_CHARACTERISTIC /begin IN_MEASUREMENT PFltLd_qFlTotCor PFltRgn_qFlTot PFlt_swtActv /end IN_MEASUREMENT
 /begin OUT_MEASUREMENT PFltLd_facAshCor PFltLd_mAshOilEG PFltLd_mAshOilNrm PFltLd_volAsh /end OUT_MEASUREMENT
 /begin LOC_MEASUREMENT PFltLd_qFlTotCorCurIn_mp PFltLd_volAsh_mp /end LOC_MEASUREMENT
/end FUNCTION
/begin FUNCTION PFltLd_SotFlwRstn ""
 /begin DEF_CHARACTERISTIC PFltLd_dvolResFlwPT1Frz_C PFltLd_facAshVolCor_MAP PFltLd_facDynVsc_CUR PFltLd_facMaxOfsNO2_C PFltLd_facMaxOfsStrt_C PFltLd_facTCorOfsNO2_CUR PFltLd_facTCorOfsStrt_CUR PFltLd_mSotMeas_MAP PFltLd_nFlwRstnSimMin_C PFltLd_numPPFltDwnStr_C PFltLd_numValAvrgOfsNO2_C PFltLd_numValAvrgOfsStrt_C PFltLd_pDiffPFlt_MAP PFltLd_resFlwMeasInv_MAP PFltLd_resFlwOfs_MAP PFltLd_resFlwPhysMax_C PFltLd_resFlwPhysMin_C PFltLd_resFlw_MAP PFltLd_stFlwRstnPT1RgnMsk_C PFltLd_swtSensEvalSel_C PFltLd_swtSotCalcInitOff_C PFltLd_tiFlwRstnAbsPT1_C PFltLd_tiFlwRstnAbsRgnPT1_C PFltLd_tiFlwRstnPT1_C PFltLd_tiFlwRstnRgnPT1_C PFltLd_tiMaxOfsNO2_C PFltLd_tiMaxOfsStrt_C PFltLd_tiOfsNO2Del_C PFltLd_tiOfsStrtDel_C PFltLd_tiPPreDVolDynFlt_MAP PFltLd_tiVolFlwPT1_C PFltLd_tiVolFlwRgnPT1_C /end DEF_CHARACTERISTIC
 /begin IN_MEASUREMENT ASMod_dvolPFltEG ASMod_pEGFld ASMod_tPFltSurfSim CoEng_tiNormalRed CoEOM_stOpModeAct Epm_nEng Exh_pAdapPPFltDiff Exh_pAdapPPFltUs PFltLd_facAshCor PFltLd_mSot PFltLd_mSotSimNoContEEP PFltLd_stNO2Actv PFltLd_stSimOn PFltLd_volAsh PFlt_swtActv /end IN_MEASUREMENT
 /begin OUT_MEASUREMENT PFltLd_mSotMeas PFltLd_resFlw PFltLd_resFlwFlt PFltLd_resFlwFltAbs PFltLd_resFlwOfs PFltLd_resFlwRaw PFltLd_resFlwUnCor PFltLd_tiPPreDVolDynFlt /end OUT_MEASUREMENT
 /begin LOC_MEASUREMENT PFltLd_dvolPFltEGFlt_mp PFltLd_dvolPT1Flt_mp PFltLd_facAshVolCor_mp PFltLd_mSotAddCorNO2_mp PFltLd_mSotAddCorStrt_mp PFltLd_mSotBefNO2_mp PFltLd_mSotCrv_mp PFltLd_mSotDiffNO2_mp PFltLd_mSotMeasBas_mp PFltLd_mSotMeasLstVld_mp PFltLd_mSotMeasRaw_mp PFltLd_mSotMeasStdByEx_mp PFltLd_mSotOfsNO2Act_mp PFltLd_mSotOfsNO2Max_mp PFltLd_mSotOfsNO2Sum_mp PFltLd_mSotOfsNO2Tot_mp PFltLd_mSotOfsNO2_mp PFltLd_mSotOfsStrtAct_mp PFltLd_mSotOfsStrtMax_mp PFltLd_mSotOfsStrtSum_mp PFltLd_mSotOfsStrt_mp PFltLd_numValAvrgOfsNO2_mp PFltLd_numValAvrgOfsStrt_mp PFltLd_pDiffAshVolCor_mp PFltLd_pDiffPFlt_mp PFltLd_pDiffSot_mp PFltLd_pPPreDVolDynFlt_mp PFltLd_resFlwMeasInv_mp PFltLd_resFlwRaw_mp PFltLd_stAvrgTOutNO2_mp PFltLd_stMsSotOfsNO2Actv_mp PFltLd_stMsSotOfsStrtActv_mp PFltLd_stOfsNO2Rls_mp PFltLd_stStMOfsNO2_mp PFltLd_tiCorOfsNO2_mp /end LOC_MEASUREMENT
/end FUNCTION
/begin FUNCTION PFltLd_SotSim ""
 /begin DEF_CHARACTERISTIC PFltLd_dmSotEGROff_MAP PFltLd_dmSotSimDynNCor_CUR PFltLd_dmSotSimDyn_CUR PFltLd_dmSotSimInit.Pos_C PFltLd_dmSotSimInit.Neg_C PFltLd_dmSotSimLmbd_MAP PFltLd_dmSotSimRgnBas_CUR PFltLd_dmSotSimRgnNO2_C PFltLd_DT1Sim.T1_C PFltLd_DT1Sim.Kd_C PFltLd_facNO2CnvCatLv_CUR PFltLd_facNO2CnvCat_MAP PFltLd_facSotSimStyCal_C PFltLd_facTempNO2_CUR PFltLd_facTempSimRgn_CUR PFltLd_facTempSnceRgnOfs_C PFltLd_KiINO2Rgn_C PFltLd_kiMSotRes_C PFltLd_mDiffResThres_C PFltLd_mResFlwMeasAftRgn_MAP PFltLd_mSotSimInit_C PFltLd_mSotSimMax_C PFltLd_mSotSimNoContSubs_C PFltLd_mSotSimRgnNO2_CUR PFltLd_numLSU_C PFltLd_numRatO2_C PFltLd_rEGRMax_C PFltLd_rEGRMin_C PFltLd_resSucRgnThres_C PFltLd_rLmbdStat_MAP PFltLd_rNO2Sot_C PFltLd_rNOxEngBas_MAP PFltLd_rNOxEngEGROff_MAP PFltLd_rNOxEngErr_MAP PFltLd_rO2SimRgn_MAP PFltLd_rO2Sot_C PFltLd_rStoich_C PFltLd_stSotSimInitEngPMsk_C PFltLd_stSotSimInitRgnMsk_C PFltLd_stSotSimInitTotMsk_C PFltLd_swtMsSotResIniOn_C PFltLd_swtRNOxCalc_C PFltLd_swtSelFacNO2I_C PFltLd_swtSimRgnNO2Off_C PFltLd_swtSotSimInit_C PFltLd_swtSotSim_C PFltLd_tiAftSucRgn_C PFltLd_tiNO2RgnDel_MAP PFlt_facSotSimStyCal_C /end DEF_CHARACTERISTIC
 /begin IN_MEASUREMENT AirCtl_stMon ASMod_dmExhMnfDs ASMod_dmNOxEG ASMod_dmSotEG ASMod_dvolPFltEG ASMod_rNOxEG ASMod_rO2EGFld ASMod_tPFltSurfSim CoEng_st CoEOM_stOpModeAct EGRVlv_r Epm_nEng Exh_tAdapTOxiCatUs InjCtl_qSetUnBal LSU_rLam LSU_rO2Adap PFltLd_facAshAdjCor PFltLd_mSot PFltLd_mSotMeas PFltLd_resFlw PFltLd_resFlwFlt PFltLd_stSimOn PFltPOp_stEngPOp PFltRgn_numRgn PFltRgn_numTot PFltRgn_stIntr PFltRgn_stLck PFltRgn_stSuc PFltRgn_tiSnceRgn PFltSrv_numSrvCs PFlt_mSotOvldHeal PFlt_stOvldHeal PFlt_swtActv /end IN_MEASUREMENT
 /begin OUT_MEASUREMENT PFltLd_dmO2Aprx PFltLd_dmSotSim PFltLd_dmSotSimDyn PFltLd_facNO2Rgn PFltLd_mSotSim PFltLd_mSotSimCont PFltLd_mSotSimNoContEEP PFltLd_rO2Aprx PFltLd_stNO2Actv PFltLd_tiNO2Rgn /end OUT_MEASUREMENT
 /begin LOC_MEASUREMENT PFltLd_dmSotRaw_mp PFltLd_dmSotSimRgnBas_mp PFltLd_dmSotSimRgnNO2Raw_mp PFltLd_dmSotSimRgnNO2_mp PFltLd_dmSotSimRgnThr_mp PFltLd_dmSotSimRgn_mp PFltLd_dqDT1Flt_mp PFltLd_facNO2CnvCatB1_mp PFltLd_facNO2CnvCatB2_mp PFltLd_facNO2CnvCat_mp PFltLd_facSotSimRgn_mp PFltLd_facTempI_mp PFltLd_facTempNO2_mp PFltLd_facTempSimRgn_mp PFltLd_facVolFlwNO2_mp PFltLd_mResFlwMeasAftRgn_mp PFltLd_mSotIntegIni_mp PFltLd_mSotRes_mp PFltLd_mSotRgnThr_mp PFltLd_mSotSimContEEP_mp PFltLd_mSotSimInit_mp PFltLd_mSotSimNoCont_mp PFltLd_mSotSimRgnNO2_mp PFltLd_rLamAprx_mp PFltLd_rLam_mp PFltLd_rLmbdStat_mp PFltLd_rNO2TotMax_mp PFltLd_rNO2Tot_mp PFltLd_rNOxEng_mp PFltLd_rO2SimRgn_mp PFltLd_stEGROff_mp PFltLd_stInitAftSuc_mp PFltLd_stSotIniCont_mp PFltLd_stSotIniNoCont_mp PFltLd_stSotIntegIni_mp PFltLd_stSotSimInitLog_mp PFltLd_stSotSimInit_mp PFltLd_stTiAftSucThres_mp PFltLd_tiNO2RgnDel_mp PFltLd_tiRgnAct_mp PFltLd_tiTempSnceRgn_mp /end LOC_MEASUREMENT
/end FUNCTION
/begin FUNCTION PFltPOp_RngDet ""
 /begin DEF_CHARACTERISTIC PFltPOp_nEng_CA PFltPOp_numAir_C PFltPOp_qSetUnBalRng10Max_GCUR PFltPOp_qSetUnBalRng10Min_GCUR PFltPOp_qSetUnBalRng1Max_GCUR PFltPOp_qSetUnBalRng1Min_GCUR PFltPOp_qSetUnBalRng2Max_GCUR PFltPOp_qSetUnBalRng2Min_GCUR PFltPOp_qSetUnBalRng3Max_GCUR PFltPOp_qSetUnBalRng3Min_GCUR PFltPOp_qSetUnBalRng4Max_GCUR PFltPOp_qSetUnBalRng4Min_GCUR PFltPOp_qSetUnBalRng5Max_GCUR PFltPOp_qSetUnBalRng5Min_GCUR PFltPOp_qSetUnBalRng6Max_GCUR PFltPOp_qSetUnBalRng6Min_GCUR PFltPOp_qSetUnBalRng7Max_GCUR PFltPOp_qSetUnBalRng7Min_GCUR PFltPOp_qSetUnBalRng8Max_GCUR PFltPOp_qSetUnBalRng8Min_GCUR PFltPOp_qSetUnBalRng9Max_GCUR PFltPOp_qSetUnBalRng9Min_GCUR PFltPOp_qSetUnBalRngSpoMax_GCUR PFltPOp_qSetUnBalRngSpoMin_GCUR PFltPOp_qSetUnBal_AXIS PFltPOp_rAPP_CA PFltPOp_stGear_CA PFltPOp_swtBrkRng_CA PFltPOp_swtClthRng_CA PFltPOp_tAdapTOxiCatUsOff_CA PFltPOp_tAdapTOxiCatUsOn_CA PFltPOp_tAdapTPFltUsOff_CA PFltPOp_tAdapTPFltUsOn_CA PFltPOp_tAir_CA PFltPOp_tEngTempHi_CA PFltPOp_tEngTempLo_CA PFltPOp_uBatt_CA PFltPOp_vVehUnFltMinMax_CA PFltPOp_v_CA /end DEF_CHARACTERISTIC
 /begin IN_MEASUREMENT PFltPOp_nEngFlt PFlt_swtActv /end IN_MEASUREMENT
 /begin OUT_MEASUREMENT PFltPOp_stEngPOp /end OUT_MEASUREMENT
 /begin LOC_MEASUREMENT PFltPOp_RngIdx_X_mp PFltPOp_RngIdx_Y_mp PFltPOp_RngPrjIdx_X_mp PFltPOp_RngPrjIdx_Y_mp PFltPOp_stEngPOp10_mp PFltPOp_stEngPOp1_mp PFltPOp_stEngPOp2_mp PFltPOp_stEngPOp3_mp PFltPOp_stEngPOp4_mp PFltPOp_stEngPOp5_mp PFltPOp_stEngPOp6_mp PFltPOp_stEngPOp7_mp PFltPOp_stEngPOp8_mp PFltPOp_stEngPOp9_mp PFltPOp_stEngPOpPrj_mp PFltPOp_stEngPOpSpo_mp PFltPOp_stRng10_mp PFltPOp_stRng1_mp PFltPOp_stRng2_mp PFltPOp_stRng3_mp PFltPOp_stRng4_mp PFltPOp_stRng5_mp PFltPOp_stRng6_mp PFltPOp_stRng7_mp PFltPOp_stRng8_mp PFltPOp_stRng9_mp PFltPOp_stRngSpo_mp PFltPOp_tAir_mp /end LOC_MEASUREMENT
/end FUNCTION
/begin FUNCTION PFltPOp_SigCond ""
 /begin DEF_CHARACTERISTIC PFltPOp_DebBrk.tiHiLo_C PFltPOp_DebBrk.tiLoHi_C PFltPOp_DebClth.tiHiLo_C PFltPOp_DebClth.tiLoHi_C PFltPOp_DebGear.tiHiLo_C PFltPOp_DebGear.tiLoHi_C PFltPOp_numEngTemp_C PFltPOp_qTrq2Qnt_CUR PFltPOp_stGearDebValMax_C PFltPOp_stGearDebValMin_C PFltPOp_swtTrqQnt_C PFltPOp_tiAPPRatPT1_C PFltPOp_tiBattPT1_C PFltPOp_tiEngSpdPT1_C PFltPOp_tiEngTempPT1_C PFltPOp_tiInjMsPT1_C PFltPOp_tiSpdVehPT1_C PFltPOp_tiTempOxiCatUsPT1_C PFltPOp_tiTempPFltUsPT1_C /end DEF_CHARACTERISTIC
 /begin IN_MEASUREMENT APP_r BattU_u Brk_st Clth_st CoEng_st EngDa_tFld Epm_nEng Exh_tAdapTOxiCatUs Exh_tAdapTPFltUs InjCtl_qSetUnBal PFlt_swtActv PthSet_trqInrSet Tra_numGear VehV_v /end IN_MEASUREMENT
 /begin OUT_MEASUREMENT PFltPOp_nEngFlt PFltPOp_qSetUnBalFlt PFltPOp_rAPPFlt PFltPOp_stBrkDeb PFltPOp_stClthDeb PFltPOp_stGearDeb PFltPOp_tAdapTOxiCatUsFlt PFltPOp_tAdapTPFltUsFlt PFltPOp_tEngTempFlt PFltPOp_uBattFlt PFltPOp_vFlt /end OUT_MEASUREMENT
 /begin LOC_MEASUREMENT PFltPOp_tEngTemp_mp /end LOC_MEASUREMENT
/end FUNCTION
/begin COMPU_METHOD Acc "" RAT_FUNC "%6.5" "m/s^2" COEFFS 0 1000 0 0 0 1 /end COMPU_METHOD
/begin COMPU_METHOD AirFlRat "" RAT_FUNC "%6.4" "-" COEFFS 0 200 0 0 0 1 /end COMPU_METHOD
/begin COMPU_METHOD AirMassPerTime "" RAT_FUNC "%5.1" "Kg/h" COEFFS 0 10 0 0 0 1 /end COMPU_METHOD
/begin COMPU_METHOD AirSysSwt "" RAT_FUNC "%10.9" "-" COEFFS 0 16384000 0 0 0 1 /end COMPU_METHOD
/begin COMPU_METHOD AirVolPerTime "" RAT_FUNC "%6.3" "m^3/h" COEFFS 0 10 0 0 0 1 /end COMPU_METHOD
/begin COMPU_METHOD CubMtrPerHr "" RAT_FUNC "%6.3" "m^3/h" COEFFS 0 10 0 0 0 1 /end COMPU_METHOD
/begin COMPU_METHOD Curr "" RAT_FUNC "%6.2" "mA" COEFFS 0 1 0 0 0 1 /end COMPU_METHOD
/begin COMPU_METHOD dmSoot_mg_p_s "" RAT_FUNC "%6.4" "mg/s" COEFFS 0 100 0 0 0 1 /end COMPU_METHOD
/begin COMPU_METHOD dn_dZ20 "" RAT_FUNC "%6.2" "rpm/s" COEFFS 0 0.2 0 0 0 1 /end COMPU_METHOD
/begin COMPU_METHOD dPres_hPa_p_s "" RAT_FUNC "%6.2" "hPa/s" COEFFS 0 1 0 0 0 1 /end COMPU_METHOD
/begin COMPU_METHOD DtyCyc "" RAT_FUNC "%5.2" "%" COEFFS 0 100 0 0 0 1 /end COMPU_METHOD
/begin COMPU_METHOD EngN "" RAT_FUNC "%5.1" "rpm" COEFFS 0 2 0 0 0 1 /end COMPU_METHOD
/begin COMPU_METHOD EngN1 "" RAT_FUNC "%6.3" "rpm" COEFFS 0 2 0 0 0 1 /end COMPU_METHOD
/begin COMPU_METHOD EngNGrd "" RAT_FUNC "%6.3" "rpm/s" COEFFS 0 2 0 0 0 1 /end COMPU_METHOD
/begin COMPU_METHOD EngTempFldSel "" TAB_VERB "%6.3" "" COMPU_TAB_REF EngTempFldSel /end COMPU_METHOD
/begin COMPU_VTAB EngTempFldSel "" TAB_VERB 4 0 "Coolant_Temperature" 1 "Oil_Temperature" 2 "EngDa_tEng" 3 "Chamberwall_Temperature" /end COMPU_VTAB
/begin COMPU_METHOD Fact "" RAT_FUNC "%6.5" "-" COEFFS 0 8192 0 0 0 1 /end COMPU_METHOD
/begin COMPU_METHOD Fact1 "" RAT_FUNC "%6.4" "-" COEFFS 0 128 0 0 0 1 /end COMPU_METHOD
/begin COMPU_METHOD Fact4 "" RAT_FUNC "%6.4" "-" COEFFS 0 20 0 0 0 1 /end COMPU_METHOD
/begin COMPU_METHOD Fl_2 "" RAT_FUNC "%6.1" "l" COEFFS 0 0.1 0 0 0 1 /end COMPU_METHOD
/begin COMPU_METHOD IndSysTempFldSel "" TAB_VERB "%6.3" "-" COMPU_TAB_REF IndSysTempFldSel /end COMPU_METHOD
/begin COMPU_VTAB IndSysTempFldSel "" TAB_VERB 3 0 "CACDsT_t" 1 "AFST_t" 2 "EnvT_t" /end COMPU_VTAB
/begin COMPU_METHOD InjMass "" RAT_FUNC "%5.2" "mg/hub" COEFFS 0 100 0 0 0 1 /end COMPU_METHOD
/begin COMPU_METHOD InjMassCyc "" RAT_FUNC "%5.2" "mg/cyc" COEFFS 0 100 0 0 0 1 /end COMPU_METHOD
/begin COMPU_METHOD InjMassPerSec_20ms "" RAT_FUNC "%6.3" "mg/hub/s" COEFFS 0 2 0 0 0 1 /end COMPU_METHOD
/begin COMPU_METHOD InjMass_p_s "" RAT_FUNC "%6.4" "(mg/stroke)/s" COEFFS 0 100 0 0 0 1 /end COMPU_METHOD
/begin COMPU_METHOD Kd "" RAT_FUNC "%7.6" "1/1" COEFFS 0 65536 0 0 0 1 /end COMPU_METHOD
/begin COMPU_METHOD Kd_Pres_hPa2Prc "" RAT_FUNC "%9.8" "%/hPa" COEFFS 0 5368709.12 0 0 0 1 /end COMPU_METHOD
/begin COMPU_METHOD Ki "" RAT_FUNC "%6.5" "1/s" COEFFS 0 2147.483648 0 0 0 1 /end COMPU_METHOD
/begin COMPU_METHOD KiRmnSotMs "" RAT_FUNC "%6.3" "1/s" COEFFS 0 2 0 0 0 1 /end COMPU_METHOD
/begin COMPU_METHOD Ki_curr2fact "" RAT_FUNC "%10.9" "1/mA*s" COEFFS 0 17592186.044416 0 0 0 1 /end COMPU_METHOD
/begin COMPU_METHOD Ki_NO2Rgn "" RAT_FUNC "%6.4" "1/s" COEFFS 0 100 0 0 0 1 /end COMPU_METHOD
/begin COMPU_METHOD Ki_Pres_hPa2Prc "" RAT_FUNC "%8.7" "%/(hPa*s)" COEFFS 0 175921.86044416 0 0 0 1 /end COMPU_METHOD
/begin COMPU_METHOD Kp_Pres_hPa2Prc "" RAT_FUNC "%9.8" "%/hPa" COEFFS 0 2684354.56 0 0 0 1 /end COMPU_METHOD
/begin COMPU_METHOD lambda "" RAT_FUNC "%4.3" "-" COEFFS 0 1000 0 0 0 1 /end COMPU_METHOD
/begin COMPU_METHOD Length "" RAT_FUNC "%6.2" "m" COEFFS 0 1 0 0 0 1 /end COMPU_METHOD
/begin COMPU_METHOD lHCCondRes "" RAT_FUNC "%6.3" "km" COEFFS 0 7.8125 0 0 0 1 /end COMPU_METHOD
/begin COMPU_METHOD lSnceRgnRes2 "" RAT_FUNC "%6.4" "km/h" COEFFS 0 27.7777777777778 0 0 0 1 /end COMPU_METHOD
/begin COMPU_METHOD mOilAsh_g "" RAT_FUNC "%6.4" "g" COEFFS 0 100 0 0 0 1 /end COMPU_METHOD
/begin COMPU_METHOD mSoot_g "" RAT_FUNC "%6.4" "g" COEFFS 0 100 0 0 0 1 /end COMPU_METHOD
/begin COMPU_METHOD mSoot_mg "" RAT_FUNC "%6.1" "mg" COEFFS 0 0.1 0 0 0 1 /end COMPU_METHOD
/begin COMPU_METHOD O2 "" RAT_FUNC "%6.5" "-" COEFFS 0 100000 0 0 0 1 /end COMPU_METHOD
/begin COMPU_METHOD OneToOne "" RAT_FUNC "%6.0" "-" COEFFS 0 1 0 0 0 1 /end COMPU_METHOD
/begin COMPU_METHOD Period "" RAT_FUNC "%6.3" "ms" COEFFS 0 10 0 0 0 1 /end COMPU_METHOD
/begin COMPU_METHOD Prc "" RAT_FUNC "%6.4" "%" COEFFS 0 81.92 0 0 0 1 /end COMPU_METHOD
/begin COMPU_METHOD PreshPa_sec "" RAT_FUNC "%6.2" "hPa/s" COEFFS 0 1 0 0 0 1 /end COMPU_METHOD
/begin COMPU_METHOD Pres_hPa "" RAT_FUNC "%5.1" "hPa" COEFFS 0 1 0 0 0 1 /end COMPU_METHOD
/begin COMPU_METHOD Pres_Rail "" RAT_FUNC "%5.1" "bar" COEFFS 0 10.000000 0 0 0 1 /end COMPU_METHOD
/begin COMPU_METHOD Qp_mm3_sec "" RAT_FUNC "%6.1" "mm3/s" COEFFS 0 0.1 0 0 0 1 /end COMPU_METHOD
/begin COMPU_METHOD RatNOxMass "" RAT_FUNC "%10.9" "-" COEFFS 0 10000000 0 0 0 1 /end COMPU_METHOD
/begin COMPU_METHOD Resist_1 "" RAT_FUNC "%6.2" "mOhm" COEFFS 0 1 0 0 0 1 /end COMPU_METHOD
/begin COMPU_METHOD Res_hPaHrPerCM "" RAT_FUNC "%7.6" "hPa/(m^3/h)" COEFFS 0 10000 0 0 0 1 /end COMPU_METHOD
/begin COMPU_METHOD rhoOilAsh_g_p_l "" RAT_FUNC "%6.3" "g/l" COEFFS 0 10 0 0 0 1 /end COMPU_METHOD
/begin COMPU_METHOD RmpCurr "" RAT_FUNC "%6.0" "mA/s" COEFFS 0 0.01 0 0 0 1 /end COMPU_METHOD
/begin COMPU_METHOD RmpMSoot "" RAT_FUNC "%6.5" "g/s" COEFFS 0 6553.6 0 0 0 1 /end COMPU_METHOD
/begin COMPU_METHOD RmpPrc "" RAT_FUNC "%6.5" "%/s" COEFFS 0 5368.70912 0 0 0 1 /end COMPU_METHOD
/begin COMPU_METHOD RmpPrc1 "" RAT_FUNC "%6.4" "%/s" COEFFS 0 41.94304 0 0 0 1 /end COMPU_METHOD
/begin COMPU_METHOD rNO2Sot "" RAT_FUNC "%7.6" "s" COEFFS 0 10000 0 0 0 1 /end COMPU_METHOD
/begin COMPU_METHOD rNO2TotMax "" RAT_FUNC "%9.8" "1/s" COEFFS 0 1000000 0 0 0 1 /end COMPU_METHOD
/begin COMPU_METHOD Soot_gPerLtr "" RAT_FUNC "%6.4" "g/l" COEFFS 0 100 0 0 0 1 /end COMPU_METHOD
/begin COMPU_METHOD Temp_Cels "" RAT_FUNC "%5.1" "deg C" COEFFS 0 10 2731.4 0 0 1 /end COMPU_METHOD
/begin COMPU_METHOD TimeCoEOMRmp "" RAT_FUNC "%6.3" "s" COEFFS 0 0 1 0 0.0152587890625 0 /end COMPU_METHOD
/begin COMPU_METHOD TimeDeb "" RAT_FUNC "%5.0" "ms" COEFFS 0 0.1 0 0 0 1 /end COMPU_METHOD
/begin COMPU_METHOD TimeDelay_s "" RAT_FUNC "%12.4" "s" COEFFS 0 0 1 0 0.00023283064365387 0 /end COMPU_METHOD
/begin COMPU_METHOD TimeDelay_s_Lin_16_2 "" RAT_FUNC "%6.4" "s" COEFFS 0 16.3835 0 0 0 1 /end COMPU_METHOD
/begin COMPU_METHOD TimeEngOn "" RAT_FUNC "%6.2" "s" COEFFS 0 1 0 0 0 1 /end COMPU_METHOD
/begin COMPU_METHOD TimeRed "" RAT_FUNC "%6.3" "s" COEFFS 0 6.25 0 0 0 1 /end COMPU_METHOD
/begin COMPU_METHOD Time_ms "" RAT_FUNC "%5.0" "ms" COEFFS 0 0.1 0 0 0 1 /end COMPU_METHOD
/begin COMPU_METHOD Time_s "" RAT_FUNC "%5.2" "s" COEFFS 0 100 0 0 0 1 /end COMPU_METHOD
/begin COMPU_METHOD Time_s_float "" RAT_FUNC "%6.2" "s" COEFFS 0 1 0 0 0 1 /end COMPU_METHOD
/begin COMPU_METHOD Time_TempSnceRgn "" RAT_FUNC "%6.5" "s" COEFFS 0 1600 0 0 0 1 /end COMPU_METHOD
/begin COMPU_METHOD Time_TempSnceRgn16 "" RAT_FUNC "%6.1" "s" COEFFS 0 0.025 0 0 0 1 /end COMPU_METHOD
/begin COMPU_METHOD Trq "" RAT_FUNC "%5.1" "Nm" COEFFS 0 10 0 0 0 1 /end COMPU_METHOD
/begin COMPU_METHOD Vel "" RAT_FUNC "%5.2" "km/h" COEFFS 0 100 0 0 0 1 /end COMPU_METHOD
/begin COMPU_METHOD Vol "" RAT_FUNC "%6.4" "l" COEFFS 0 100 0 0 0 1 /end COMPU_METHOD
/begin COMPU_METHOD Volt "" RAT_FUNC "%6.1" "mV" COEFFS 0 5 0 0 0 1 /end COMPU_METHOD
/begin COMPU_METHOD Volt_Batt "" RAT_FUNC "%5.0" "mV" COEFFS 0 0.05 0 0 0 1 /end COMPU_METHOD
/begin RECORD_LAYOUT Cur_Xs16Ws16 NO_AXIS_PTS_X 1 SWORD AXIS_PTS_X 2 SWORD INDEX_INCR DIRECT FNC_VALUES 3 SWORD COLUMN_DIR DIRECT /end RECORD_LAYOUT
/begin RECORD_LAYOUT Gkl_Ws16 FNC_VALUES 1 SWORD COLUMN_DIR DIRECT /end RECORD_LAYOUT
/begin RECORD_LAYOUT GSst_Xs16 NO_AXIS_PTS_X 1 SWORD AXIS_PTS_X 2 SWORD INDEX_INCR DIRECT /end RECORD_LAYOUT
/begin RECORD_LAYOUT Kf_Xs16_Ys16_Ws16 NO_AXIS_PTS_X 1 SWORD NO_AXIS_PTS_Y 2 SWORD AXIS_PTS_X 3 SWORD INDEX_INCR DIRECT AXIS_PTS_Y 4 SWORD INDEX_INCR DIRECT FNC_VALUES 5 SWORD COLUMN_DIR DIRECT /end RECORD_LAYOUT
/begin RECORD_LAYOUT Kl_Xs16_Ws16 NO_AXIS_PTS_X 1 SWORD AXIS_PTS_X 2 SWORD INDEX_INCR DIRECT FNC_VALUES 3 SWORD COLUMN_DIR DIRECT /end RECORD_LAYOUT
/begin RECORD_LAYOUT Kwb_Wu32 FNC_VALUES 1 ULONG COLUMN_DIR DIRECT /end RECORD_LAYOUT
/begin RECORD_LAYOUT Kw_Ws16 FNC_VALUES 1 SWORD COLUMN_DIR DIRECT /end RECORD_LAYOUT
/begin RECORD_LAYOUT Kw_Ws32 FNC_VALUES 1 SLONG COLUMN_DIR DIRECT /end RECORD_LAYOUT
/begin RECORD_LAYOUT Kw_Wu16 FNC_VALUES 1 UWORD COLUMN_DIR DIRECT /end RECORD_LAYOUT
/begin RECORD_LAYOUT Kw_Wu32 FNC_VALUES 1 ULONG COLUMN_DIR DIRECT /end RECORD_LAYOUT
/begin RECORD_LAYOUT Kw_Wu8 FNC_VALUES 1 UBYTE COLUMN_DIR DIRECT /end RECORD_LAYOUT
/begin RECORD_LAYOUT Map_Xs16Ys16Ws16 NO_AXIS_PTS_X 1 SWORD NO_AXIS_PTS_Y 2 SWORD AXIS_PTS_X 3 SWORD INDEX_INCR DIRECT AXIS_PTS_Y 4 SWORD INDEX_INCR DIRECT FNC_VALUES 5 SWORD COLUMN_DIR DIRECT /end RECORD_LAYOUT
/begin RECORD_LAYOUT ValA_Ws16 FNC_VALUES 1 SWORD COLUMN_DIR DIRECT /end RECORD_LAYOUT
/begin RECORD_LAYOUT ValA_Wu32 FNC_VALUES 1 ULONG COLUMN_DIR DIRECT /end RECORD_LAYOUT
/begin RECORD_LAYOUT ValA_Wu8 FNC_VALUES 1 UBYTE COLUMN_DIR DIRECT /end RECORD_LAYOUT
/begin RECORD_LAYOUT Val_Ws16 FNC_VALUES 1 SWORD COLUMN_DIR DIRECT /end RECORD_LAYOUT
/begin RECORD_LAYOUT Val_Ws32 FNC_VALUES 1 SLONG COLUMN_DIR DIRECT /end RECORD_LAYOUT
/begin RECORD_LAYOUT Val_Ws8 FNC_VALUES 1 SBYTE COLUMN_DIR DIRECT /end RECORD_LAYOUT
/begin RECORD_LAYOUT Val_Wu16 FNC_VALUES 1 UWORD COLUMN_DIR DIRECT /end RECORD_LAYOUT
/begin RECORD_LAYOUT Val_Wu32 FNC_VALUES 1 ULONG COLUMN_DIR DIRECT /end RECORD_LAYOUT
/begin RECORD_LAYOUT Val_Wu8 FNC_VALUES 1 UBYTE COLUMN_DIR DIRECT /end RECORD_LAYOUT
/end MODULE
/end PROJECT

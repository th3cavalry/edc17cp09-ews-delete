ASAP2_VERSION 1 4
/begin PROJECT P_574 "EDC17_CP09"
/begin HEADER "" VERSION "V8KB" PROJECT_NO P_574 /end HEADER
/begin MODULE DIM ""
/begin MOD_COMMON "" BYTE_ORDER MSB_LAST ALIGNMENT_BYTE 1 ALIGNMENT_WORD 2 ALIGNMENT_LONG 4 ALIGNMENT_FLOAT32_IEEE 4 /end MOD_COMMON
/begin CHARACTERISTIC AccPed_rNotPressed_C "" VALUE 0x800626A8 Val_Ws16 19.99512 Prc 0.00 19.99512 EXTENDED_LIMITS -400.0000 399.9878 /end CHARACTERISTIC
/begin CHARACTERISTIC AirC_stCmprAct_C "" VALUE 0x8006162E Kw_Wu8 255.0 OneToOne 0.00 255.0 /end CHARACTERISTIC
/begin CHARACTERISTIC DiffIO_rTrqDfftl_C "" VALUE 0x800626AA Val_Ws16 99.00000 TransR 0.00 99.00000 EXTENDED_LIMITS -327.6800 327.6700 /end CHARACTERISTIC
/begin CHARACTERISTIC DiffIO_stCfg_C "" VALUE 0x800626AC Val_Wu8 3.000 OneToOne 0.00 3.000 EXTENDED_LIMITS 0.00 255.0 /end CHARACTERISTIC
/begin CHARACTERISTIC DiffIO_trqPrtDfftl_C "" VALUE 0x800626AE Val_Ws16 50000.00 TrqPrp 0.00 50000.00 EXTENDED_LIMITS -52428.80 52427.20 /end CHARACTERISTIC
/begin CHARACTERISTIC Eng_stOff_C "" VALUE 0x800626B0 Val_Wu8 1.000 OneToOne 0.00 1.000 EXTENDED_LIMITS 0.00 255.0 /end CHARACTERISTIC
/begin CHARACTERISTIC Eng_stRun_C "" VALUE 0x800626B1 Val_Wu8 1.000 OneToOne 0.00 1.000 EXTENDED_LIMITS 0.00 255.0 /end CHARACTERISTIC
/begin CHARACTERISTIC Exh_numFldTOxiCatUs_C "" VALUE 0x80060E14 Val_Ws16 65535.00 OneToOne -32768.00 32767.00 /end CHARACTERISTIC
/begin CHARACTERISTIC Exh_numFldTTrbnUs_C "" VALUE 0x800610EC Val_Ws16 65535.00 OneToOne -32768.00 32767.00 /end CHARACTERISTIC
/begin CHARACTERISTIC Exh_numModelTTrbnUs_C "" VALUE 0x800610EE Kw_Wu8 255.0 OneToOne 0.00 255.0 /end CHARACTERISTIC
/begin CHARACTERISTIC Exh_numTOxiCatUs_C "" VALUE 0x80060E16 Val_Wu8 255.0 OneToOne 0.00 255.0 /end CHARACTERISTIC
/begin CHARACTERISTIC Exh_numTPFltUs_C "" VALUE 0x80061080 Val_Wu8 255.0 OneToOne 0.00 255.0 /end CHARACTERISTIC
/begin CHARACTERISTIC Exh_RmpSlpTOxiCatUs.Pos_C "/" VALUE 0x80060E18 Kw_Ws32 3276799.99847 RmpTemp 0.00 3276799.99847 FORMAT "%13.5" EXTENDED_LIMITS -3276800.00000 3276799.99847 /end CHARACTERISTIC
/begin CHARACTERISTIC Exh_RmpSlpTOxiCatUs.Neg_C "/" VALUE 0x80060E1C Kw_Ws32 3276799.99847 RmpTemp 0.00 3276799.99847 FORMAT "%13.5" EXTENDED_LIMITS -3276800.00000 3276799.99847 /end CHARACTERISTIC
/begin CHARACTERISTIC Exh_RmpSlpTPFltUs.Pos_C "/" VALUE 0x80061084 Kw_Ws32 3276799.99847 RmpTemp 0.00 3276799.99847 FORMAT "%13.5" EXTENDED_LIMITS -3276800.00000 3276799.99847 /end CHARACTERISTIC
/begin CHARACTERISTIC Exh_RmpSlpTPFltUs.Neg_C "/" VALUE 0x80061088 Kw_Ws32 3276799.99847 RmpTemp 0.00 3276799.99847 FORMAT "%13.5" EXTENDED_LIMITS -3276800.00000 3276799.99847 /end CHARACTERISTIC
/begin CHARACTERISTIC Exh_RmpSlpTTrbnUs.Pos_C "/" VALUE 0x800610F0 Kw_Ws32 3276799.99847 RmpTemp 0.00 3276799.99847 FORMAT "%13.5" EXTENDED_LIMITS -3276800.00000 3276799.99847 /end CHARACTERISTIC
/begin CHARACTERISTIC Exh_RmpSlpTTrbnUs.Neg_C "/" VALUE 0x800610F4 Kw_Ws32 3276799.99847 RmpTemp 0.00 3276799.99847 FORMAT "%13.5" EXTENDED_LIMITS -3276800.00000 3276799.99847 /end CHARACTERISTIC
/begin CHARACTERISTIC Exh_SRCTOxiCatUs.uMin_C "/" VALUE 0x80060BEC Kw_Ws16 13107.00 Volt -6553.600 6553.400 /end CHARACTERISTIC
/begin CHARACTERISTIC Exh_SRCTOxiCatUs.uMax_C "/" VALUE 0x80060BEE Kw_Ws16 1800.000 Volt 3000.000 4800.000 EXTENDED_LIMITS -6553.600 6553.400 /end CHARACTERISTIC
/begin CHARACTERISTIC Exh_SRCTPFltUs.uMin_C "/" VALUE 0x80060EB4 Kw_Ws16 250.0000 Volt 0.00 250.0000 EXTENDED_LIMITS -6553.600 6553.400 /end CHARACTERISTIC
/begin CHARACTERISTIC Exh_SRCTPFltUs.uMax_C "/" VALUE 0x80060EB6 Kw_Ws16 1800.000 Volt 3000.000 4800.000 EXTENDED_LIMITS -6553.600 6553.400 /end CHARACTERISTIC
/begin CHARACTERISTIC Exh_SRCTTrbnUs.uMin_C "/" VALUE 0x800610B2 Kw_Ws16 3300.000 Volt 0.00 3300.000 EXTENDED_LIMITS -6553.600 6553.400 /end CHARACTERISTIC
/begin CHARACTERISTIC Exh_SRCTTrbnUs.uMax_C "/" VALUE 0x800610B4 Kw_Ws16 3300.000 Volt 0.00 3300.000 EXTENDED_LIMITS -6553.600 6553.400 /end CHARACTERISTIC
/begin CHARACTERISTIC Exh_stLckNplTTrbnUs_C "" VALUE 0x800610F8 Kw_Wu32 4294967295.00 OneToOne 0.00 4294967295.00 /end CHARACTERISTIC
/begin CHARACTERISTIC Exh_stMaskLckNplTPFltUs_C "" VALUE 0x8006108C Val_Wu32 4294967295.00 OneToOne 0.00 4294967295.00 /end CHARACTERISTIC
/begin CHARACTERISTIC Exh_stMskLckNplTOxiCatUs_C "" VALUE 0x80060E20 Val_Wu32 4294967295.00 OneToOne 0.00 4294967295.00 /end CHARACTERISTIC
/begin CHARACTERISTIC Exh_swtDflTPFltUs_C "" VALUE 0x80061090 Val_Wu8 255.0 OneToOne 0.00 255.0 /end CHARACTERISTIC
/begin CHARACTERISTIC Exh_swtSensPrsTTrbnUs_C "" VALUE 0x800610B6 Kw_Wu8 255.0 OneToOne 0.00 255.0 /end CHARACTERISTIC
/begin CHARACTERISTIC Exh_swtSensTOxiCatUs_C "" VALUE 0x80060BF0 Val_Wu8 255.0 OneToOne 0.00 255.0 /end CHARACTERISTIC
/begin CHARACTERISTIC Exh_swtTPFltUsASModSel_C "" VALUE 0x80061091 Val_Wu8 1.000 OneToOne 0.00 1.000 EXTENDED_LIMITS 0.00 255.0 /end CHARACTERISTIC
/begin CHARACTERISTIC Exh_tDiffNegTOxiCatUs_CUR "" CURVE 0x80060E24 Kl_Xs16_Ws16 6553.500 TempDiff_Kelv -3276.800 3276.700
 /begin AXIS_DESCR STD_AXIS Exh_tModTOxiCatUs_mp Temp_Cels 16 -3549.940 3003.560 DEPOSIT ABSOLUTE /end AXIS_DESCR
/end CHARACTERISTIC
/begin CHARACTERISTIC Exh_tDiffNegTPFltUs_CUR "" CURVE 0x80061092 Cur_Xs16Ws16 300.0000 TempDiff_Kelv -200.0000 100.0000 EXTENDED_LIMITS -3276.800 3276.700
 /begin AXIS_DESCR STD_AXIS Exh_tEGFldTPFltUs_mp Temp_Cels 2 -45.04000 999.9600 EXTENDED_LIMITS -3549.940 3003.560 DEPOSIT ABSOLUTE /end AXIS_DESCR
/end CHARACTERISTIC
/begin CHARACTERISTIC Exh_tDiffNegTTrbnUs_CUR "" CURVE 0x800610FC Kl_Xs16_Ws16 100.0000 TempDiff_Kelv -100.0000 0.00 EXTENDED_LIMITS -3276.800 3276.700
 /begin AXIS_DESCR STD_AXIS Exh_tModTTrbnUs_mp Temp_Cels 4 -100.0400 999.9600 EXTENDED_LIMITS -3549.940 3003.560 DEPOSIT ABSOLUTE /end AXIS_DESCR
/end CHARACTERISTIC
/begin CHARACTERISTIC Exh_tDiffPosTOxiCatUs_CUR "" CURVE 0x80060E66 Kl_Xs16_Ws16 6553.500 TempDiff_Kelv -3276.800 3276.700
 /begin AXIS_DESCR STD_AXIS Exh_tModTOxiCatUs_mp Temp_Cels 16 -3549.940 3003.560 DEPOSIT ABSOLUTE /end AXIS_DESCR
/end CHARACTERISTIC
/begin CHARACTERISTIC Exh_tDiffPosTPFltUs_CUR "" CURVE 0x8006109C Cur_Xs16Ws16 300.0000 TempDiff_Kelv 0.00 300.0000 EXTENDED_LIMITS -3276.800 3276.700
 /begin AXIS_DESCR STD_AXIS Exh_tEGFldTPFltUs_mp Temp_Cels 2 -0.04000000 1099.960 EXTENDED_LIMITS -3549.940 3003.560 DEPOSIT ABSOLUTE /end AXIS_DESCR
/end CHARACTERISTIC
/begin CHARACTERISTIC Exh_tDiffPosTTrbnUs_CUR "" CURVE 0x8006110E Kl_Xs16_Ws16 100.0000 TempDiff_Kelv 0.00 100.0000 EXTENDED_LIMITS -3276.800 3276.700
 /begin AXIS_DESCR STD_AXIS Exh_tModTTrbnUs_mp Temp_Cels 3 -100.0400 999.9600 EXTENDED_LIMITS -3549.940 3003.560 DEPOSIT ABSOLUTE /end AXIS_DESCR
/end CHARACTERISTIC
/begin CHARACTERISTIC Exh_tiLckNplRgnTOxiCatUs_C "" VALUE 0x80060EA8 Val_Ws16 655.3500 Time_s -327.6800 327.6700 /end CHARACTERISTIC
/begin CHARACTERISTIC Exh_tiLckNplRgnTPFltUs_C "" VALUE 0x800610A6 Val_Ws16 655.3500 Time_s -327.6800 327.6700 /end CHARACTERISTIC
/begin CHARACTERISTIC Exh_tiLckNplRgnTTrbnUs_C "" VALUE 0x8006111C Kw_Ws16 655350.0 Time_ms -327680.0 327670.0 /end CHARACTERISTIC
/begin CHARACTERISTIC Exh_tiLckNplTOxiCatUs_C "" VALUE 0x80060EAA Val_Ws16 655.3500 Time_s -327.6800 327.6700 /end CHARACTERISTIC
/begin CHARACTERISTIC Exh_tiLckNplTPFltUs_C "" VALUE 0x800610A8 Val_Ws16 655.3500 Time_s -327.6800 327.6700 /end CHARACTERISTIC
/begin CHARACTERISTIC Exh_tiLckNplTTrbnUs_C "" VALUE 0x8006111E Kw_Ws16 655350.0 Time_ms -327680.0 327670.0 /end CHARACTERISTIC
/begin CHARACTERISTIC Exh_tiLPFltPT1TOxiCatUs_C "" VALUE 0x80060EAC Val_Ws32 4294.9672940 TimeDelay_s 0.000002000000001 4294.9672960 FORMAT "%12.7" /end CHARACTERISTIC
/begin CHARACTERISTIC Exh_tMntCortOxiCat_MAP "" MAP 0x80060C58 Map_Xs16Ys16Ws16 225.0000 TempDiff_Kelv -45.00000 180.0000 EXTENDED_LIMITS -3276.800 3276.700
 /begin AXIS_DESCR STD_AXIS ASMod_dmPFltUs AirMassPerTime 16 -1000.000 1000.000 EXTENDED_LIMITS -3276.800 3276.700 DEPOSIT ABSOLUTE /end AXIS_DESCR
 /begin AXIS_DESCR STD_AXIS Exh_tSensTOxiCatUs Temp_Cels 12 -45.04000 179.9600 EXTENDED_LIMITS -3549.940 3003.560 DEPOSIT ABSOLUTE /end AXIS_DESCR
/end CHARACTERISTIC
/begin CHARACTERISTIC Exh_tMntCor_MAP "" MAP 0x80060EC2 Map_Xs16Ys16Ws16 225.0000 TempDiff_Kelv -45.00000 180.0000 EXTENDED_LIMITS -3276.800 3276.700
 /begin AXIS_DESCR STD_AXIS ASMod_dmPFltUs AirMassPerTime 16 -1000.000 1000.000 EXTENDED_LIMITS -3276.800 3276.700 DEPOSIT ABSOLUTE /end AXIS_DESCR
 /begin AXIS_DESCR STD_AXIS Exh_tSensTPFltUs Temp_Cels 12 -45.04000 179.9600 EXTENDED_LIMITS -3549.940 3003.560 DEPOSIT ABSOLUTE /end AXIS_DESCR
/end CHARACTERISTIC
/begin CHARACTERISTIC Exh_TransStageParTPFltUs.Dfl_C "/" VALUE 0x800610AA Kw_Ws16 199.0000 Temp_Cels -0.04000000 198.9600 EXTENDED_LIMITS -3549.940 3003.560 /end CHARACTERISTIC
/begin CHARACTERISTIC Exh_TransStageParTPFltUs.stSensId_C "/" VALUE 0x800610AC Kw_Wu8 255.0 OneToOne 0.00 255.0 /end CHARACTERISTIC
/begin CHARACTERISTIC Exh_TransStgTOxiCatUs.Dfl_C "/" VALUE 0x80060EB0 Kw_Ws16 250.0000 Temp_Cels -50.04000 199.9600 EXTENDED_LIMITS -3549.940 3003.560 /end CHARACTERISTIC
/begin CHARACTERISTIC Exh_TransStgTOxiCatUs.stSensId_C "/" VALUE 0x80060EB2 Kw_Wu8 255.0 OneToOne 0.00 255.0 /end CHARACTERISTIC
/begin CHARACTERISTIC Exh_TransStgTTrbnUs.Dfl_C "/" VALUE 0x80061120 Kw_Ws16 500.0000 Temp_Cels -0.04000000 499.9600 EXTENDED_LIMITS -3549.940 3003.560 /end CHARACTERISTIC
/begin CHARACTERISTIC Exh_TransStgTTrbnUs.stSensId_C "/" VALUE 0x80061122 Kw_Wu8 255.0 OneToOne 0.00 255.0 /end CHARACTERISTIC
/begin CHARACTERISTIC Exh_tTransfTOxiCatUs_CUR "" CURVE 0x80060BF2 Cur_Xs16Ws16 225.0000 Temp_Cels -45.04000 179.9600 EXTENDED_LIMITS -3549.940 3003.560
 /begin AXIS_DESCR STD_AXIS Exh_uRawTOxiCatUs Volt 25 0.00 4800.000 EXTENDED_LIMITS -6553.600 6553.400 DEPOSIT ABSOLUTE /end AXIS_DESCR
/end CHARACTERISTIC
/begin CHARACTERISTIC Exh_tTransfTPFltUs_CUR "" CURVE 0x80060EB8 Cur_Xs16Ws16 225.0000 Temp_Cels -45.04000 179.9600 EXTENDED_LIMITS -3549.940 3003.560
 /begin AXIS_DESCR STD_AXIS Exh_uRawTPFltUs Volt 2 0.00 4800.000 EXTENDED_LIMITS -6553.600 6553.400 DEPOSIT ABSOLUTE /end AXIS_DESCR
/end CHARACTERISTIC
/begin CHARACTERISTIC Exh_tTransfTTrbnUs_CUR "" CURVE 0x800610B8 Cur_Xs16Ws16 6553.500 Temp_Cels -3549.940 3003.560
 /begin AXIS_DESCR STD_AXIS Exh_uRawTTrbnUs Volt 12 0.00 5200.000 EXTENDED_LIMITS -6553.600 6553.400 DEPOSIT ABSOLUTE /end AXIS_DESCR
/end CHARACTERISTIC
/begin CHARACTERISTIC LiGov_nSetpoint_C "" VALUE 0x800626B2 Val_Ws16 1200.000 EngN 0.00 1200.000 EXTENDED_LIMITS -16384.00 16383.50 /end CHARACTERISTIC
/begin CHARACTERISTIC PhyMod_pwrClntEntry_C "" VALUE 0x800626B4 Kw_Ws16 1235306. Pwr2 -617662.2 617643.4 FORMAT "%8.1" /end CHARACTERISTIC
/begin CHARACTERISTIC PT_rTraGear1_C "Übersetzungsverhältnis Gang 1" VALUE 0x80061244 Val_Ws16 655.3500 TransR -327.6800 327.6700 /end CHARACTERISTIC
/begin CHARACTERISTIC PT_rTraGear2_C "Übersetzungsverhältnis Gang 2" VALUE 0x80061246 Val_Ws16 655.3500 TransR -327.6800 327.6700 /end CHARACTERISTIC
/begin CHARACTERISTIC PT_rTraGear3_C "Übersetzungsverhältnis Gang 3" VALUE 0x80061248 Val_Ws16 655.3500 TransR -327.6800 327.6700 /end CHARACTERISTIC
/begin CHARACTERISTIC PT_rTraGear4_C "Übersetzungsverhältnis Gang 4" VALUE 0x8006124A Val_Ws16 655.3500 TransR -327.6800 327.6700 /end CHARACTERISTIC
/begin CHARACTERISTIC PT_rTraGear5_C "Übersetzungsverhältnis Gang 5" VALUE 0x8006124C Val_Ws16 655.3500 TransR -327.6800 327.6700 /end CHARACTERISTIC
/begin CHARACTERISTIC PT_rTraGear6_C "Übersetzungsverhältnis Gang 6" VALUE 0x8006124E Val_Ws16 655.3500 TransR -327.6800 327.6700 /end CHARACTERISTIC
/begin CHARACTERISTIC PT_rTraGear7_C "Übersetzungsverhältnis Gang 7" VALUE 0x80061250 Val_Ws16 655.3500 TransR -327.6800 327.6700 /end CHARACTERISTIC
/begin CHARACTERISTIC PT_rTraGearR_C "Übersetzungsverhältnis Gang R" VALUE 0x80061252 Val_Ws16 655.3500 TransR -327.6800 327.6700 /end CHARACTERISTIC
/begin CHARACTERISTIC PT_rTraLoRng_C "Übersetzungsverhältnis Vorgelegegetriebe" VALUE 0x80061254 Val_Ws16 655.3500 TransR -327.6800 327.6700 /end CHARACTERISTIC
/begin CHARACTERISTIC PT_rTraMax_C "Maximales Getriebe-Übersetzungsverhältnis" VALUE 0x80061256 Val_Ws16 655.3500 TransR -327.6800 327.6700 /end CHARACTERISTIC
/begin CHARACTERISTIC SCR_DebUTnkLvl.tiHiLo_C "Struktur, die die Entprellzeitparameter zur Entprellung des Wehrlesensorsignals enthält/" VALUE 0x8006199C Kw_Ws16 5000.000 TimeDeb 0.00 5000.000 EXTENDED_LIMITS -327680.0 327670.0 /end CHARACTERISTIC
/begin CHARACTERISTIC SCR_DebUTnkLvl.tiLoHi_C "Struktur, die die Entprellzeitparameter zur Entprellung des Wehrlesensorsignals enthält/" VALUE 0x8006199E Kw_Ws16 5000.000 TimeDeb 0.00 5000.000 EXTENDED_LIMITS -327680.0 327670.0 /end CHARACTERISTIC
/begin CHARACTERISTIC SCR_pTransfUPmpP_CUR "" CURVE 0x80061938 Cur_Xs16Ws16 3500.00 Pres_hPa 0.00 3500.00 EXTENDED_LIMITS -32768.00 32767.00
 /begin AXIS_DESCR STD_AXIS SCR_uRawUPmpP Volt 16 0.00 5000.000 EXTENDED_LIMITS -6553.600 6553.400 DEPOSIT ABSOLUTE /end AXIS_DESCR
/end CHARACTERISTIC
/begin CHARACTERISTIC SCR_RmpSlpAbsUPmpP.Pos_C "/" VALUE 0x80061980 Kw_Ws32 32764722.9919 RmpPres_hPa 3276.99279785 32767999.9847 FORMAT "%13.4" EXTENDED_LIMITS -32768000.0000 32767999.9847 /end CHARACTERISTIC
/begin CHARACTERISTIC SCR_RmpSlpAbsUPmpP.Neg_C "/" VALUE 0x80061984 Kw_Ws32 32764722.9919 RmpPres_hPa 3276.99279785 32767999.9847 FORMAT "%13.4" EXTENDED_LIMITS -32768000.0000 32767999.9847 /end CHARACTERISTIC
/begin CHARACTERISTIC SCR_RmpSlpUCatUsT.Pos_C "Rampensteigungsstruktur für Temperatursensor vor Harnstoffkatalysator/" VALUE 0x80061678 Kw_Ws32 3273522.99805 RmpTemp 3277.00042725 3276799.99847 FORMAT "%13.5" EXTENDED_LIMITS -3276800.00000 3276799.99847 /end CHARACTERISTIC
/begin CHARACTERISTIC SCR_RmpSlpUCatUsT.Neg_C "Rampensteigungsstruktur für Temperatursensor vor Harnstoffkatalysator/" VALUE 0x8006167C Kw_Ws32 3273522.99805 RmpTemp 3277.00042725 3276799.99847 FORMAT "%13.5" EXTENDED_LIMITS -3276800.00000 3276799.99847 /end CHARACTERISTIC
/begin CHARACTERISTIC SCR_RmpSlpUTnkLvl.Pos_C "Struktur, die die Steigungsparametern für die Rampe enthält/" VALUE 0x800619A8 Kw_Ws32 9999.99996275 RmpPrc 0.00 9999.99996275 FORMAT "%13.7" EXTENDED_LIMITS -400000.000000 399999.999814 /end CHARACTERISTIC
/begin CHARACTERISTIC SCR_RmpSlpUTnkLvl.Neg_C "Struktur, die die Steigungsparametern für die Rampe enthält/" VALUE 0x800619AC Kw_Ws32 9999.99996275 RmpPrc 0.00 9999.99996275 FORMAT "%13.7" EXTENDED_LIMITS -400000.000000 399999.999814 /end CHARACTERISTIC
/begin CHARACTERISTIC SCR_RmpSlpUTnkT.Pos_C "/" VALUE 0x800619FC Kw_Ws32 3273522.99805 RmpTemp 3277.00042725 3276799.99847 FORMAT "%13.5" EXTENDED_LIMITS -3276800.00000 3276799.99847 /end CHARACTERISTIC
/begin CHARACTERISTIC SCR_RmpSlpUTnkT.Neg_C "/" VALUE 0x80061A00 Kw_Ws32 3273522.99805 RmpTemp 3277.00042725 3276799.99847 FORMAT "%13.5" EXTENDED_LIMITS -3276800.00000 3276799.99847 /end CHARACTERISTIC
/begin CHARACTERISTIC SCR_SRCUCatUsT.uMin_C "Struktur zum Einhalten der SRC-Schwellen für Temperatursensor vor Harnstoffkatalysator/" VALUE 0x80061630 Kw_Ws16 1000.000 Volt 0.00 1000.000 EXTENDED_LIMITS -6553.600 6553.400 /end CHARACTERISTIC
/begin CHARACTERISTIC SCR_SRCUCatUsT.uMax_C "Struktur zum Einhalten der SRC-Schwellen für Temperatursensor vor Harnstoffkatalysator/" VALUE 0x80061632 Kw_Ws16 2000.000 Volt 3000.000 5000.000 EXTENDED_LIMITS -6553.600 6553.400 /end CHARACTERISTIC
/begin CHARACTERISTIC SCR_SRCUPmpP.uMin_C "/" VALUE 0x8006197A Kw_Ws16 1000.000 Volt 0.00 1000.000 EXTENDED_LIMITS -6553.600 6553.400 /end CHARACTERISTIC
/begin CHARACTERISTIC SCR_SRCUPmpP.uMax_C "/" VALUE 0x8006197C Kw_Ws16 2000.000 Volt 3000.000 5000.000 EXTENDED_LIMITS -6553.600 6553.400 /end CHARACTERISTIC
/begin CHARACTERISTIC SCR_SRCUTnkT.uMin_C "/" VALUE 0x800619B4 Kw_Ws16 1000.000 Volt 0.00 1000.000 EXTENDED_LIMITS -6553.600 6553.400 /end CHARACTERISTIC
/begin CHARACTERISTIC SCR_SRCUTnkT.uMax_C "/" VALUE 0x800619B6 Kw_Ws16 2000.000 Volt 3000.000 5000.000 EXTENDED_LIMITS -6553.600 6553.400 /end CHARACTERISTIC
/begin CHARACTERISTIC SCR_swtpFltSel_C "Schalter zum wechseln zwischen gefilterten und ungefilterten Wert" VALUE 0x80061988 Val_Wu8 1.000 OneToOne 0.00 1.000 EXTENDED_LIMITS 0.00 255.0 /end CHARACTERISTIC
/begin CHARACTERISTIC SCR_swtSigAbsUPmpP_C "" VALUE 0x8006197E Val_Wu8 1.000 OneToOne 0.00 1.000 EXTENDED_LIMITS 0.00 255.0 /end CHARACTERISTIC
/begin CHARACTERISTIC SCR_swtSigUCatUsT_C "Schalter zur Konfiguration der Signalquelle zwischen Sensorausgang und CAN-Botschaft" VALUE 0x80061634 Val_Wu8 1.000 OneToOne 0.00 1.000 EXTENDED_LIMITS 0.00 255.0 /end CHARACTERISTIC
/begin CHARACTERISTIC SCR_swtSigUTnkT_C "" VALUE 0x800619B8 Val_Wu8 1.000 OneToOne 0.00 1.000 EXTENDED_LIMITS 0.00 255.0 /end CHARACTERISTIC
/begin CHARACTERISTIC SCR_swtUPmpPSel_C "" VALUE 0x80061989 Val_Wu8 1.000 OneToOne 0.00 1.000 EXTENDED_LIMITS 0.00 255.0 /end CHARACTERISTIC
/begin CHARACTERISTIC SCR_tiPT1UPmpP_C "" VALUE 0x8006198C Val_Ws32 4294.9672940 TimeDelay_s 0.000002000000001 4294.9672960 FORMAT "%12.7" /end CHARACTERISTIC
/begin CHARACTERISTIC SCR_tiTstWinMaxUTnkLvl_C "Maximale erlaubte Schwelle für Wehrle-Sensordiagnoseimpuls" VALUE 0x800619A0 Val_Ws16 5000.000 Time_ms 0.00 5000.000 EXTENDED_LIMITS -327680.0 327670.0 /end CHARACTERISTIC
/begin CHARACTERISTIC SCR_tiTstWinMinUTnkLvl_C "Minimale erlaubte Schwelle für Wehrle-Sensordiagnoseimpuls" VALUE 0x800619A2 Val_Ws16 5000.000 Time_ms 0.00 5000.000 EXTENDED_LIMITS -327680.0 327670.0 /end CHARACTERISTIC
/begin CHARACTERISTIC SCR_tiWaitUTnkLvl_C "Wartezeit vor dem Start der Wehrle-Sensordiagnose" VALUE 0x800619A4 Val_Ws16 1000.000 Time_ms 0.00 1000.000 EXTENDED_LIMITS -327680.0 327670.0 /end CHARACTERISTIC
/begin CHARACTERISTIC SCR_TransStgAbsUPmpP.Dfl_C "/" VALUE 0x80061990 Kw_Ws16 7000.00 Pres_hPa -3500.000 3500.00 EXTENDED_LIMITS -32768.00 32767.00 /end CHARACTERISTIC
/begin CHARACTERISTIC SCR_TransStgAbsUPmpP.stSensId_C "/" VALUE 0x80061992 Kw_Wu8 4.000 OneToOne 0.00 4.000 EXTENDED_LIMITS 0.00 255.0 /end CHARACTERISTIC
/begin CHARACTERISTIC SCR_TransStgUCatUsT.Dfl_C "Transstage-Struktur für Temperatursensor vor Harnstoffkatalysator/" VALUE 0x80061680 Kw_Ws16 1050.000 Temp_Cels -50.04000 999.9600 EXTENDED_LIMITS -3549.940 3003.560 /end CHARACTERISTIC
/begin CHARACTERISTIC SCR_TransStgUCatUsT.stSensId_C "Transstage-Struktur für Temperatursensor vor Harnstoffkatalysator/" VALUE 0x80061682 Kw_Wu8 4.000 OneToOne 0.00 4.000 EXTENDED_LIMITS 0.00 255.0 /end CHARACTERISTIC
/begin CHARACTERISTIC SCR_TransStgUTnkLvl.Dfl_C "Transstageparameterstruktur für Harnstofftankstandsensor/" VALUE 0x800619B0 Kw_Ws16 100.0000 Prc 0.00 100.0000 EXTENDED_LIMITS -400.0000 399.9878 /end CHARACTERISTIC
/begin CHARACTERISTIC SCR_TransStgUTnkLvl.stSensId_C "Transstageparameterstruktur für Harnstofftankstandsensor/" VALUE 0x800619B2 Kw_Wu8 4.000 OneToOne 0.00 4.000 EXTENDED_LIMITS 0.00 255.0 /end CHARACTERISTIC
/begin CHARACTERISTIC SCR_TransStgUTnkT.Dfl_C "/" VALUE 0x80061A04 Kw_Ws16 250.0000 Temp_Cels -50.04000 199.9600 EXTENDED_LIMITS -3549.940 3003.560 /end CHARACTERISTIC
/begin CHARACTERISTIC SCR_TransStgUTnkT.stSensId_C "/" VALUE 0x80061A06 Kw_Wu8 4.000 OneToOne 0.00 4.000 EXTENDED_LIMITS 0.00 255.0 /end CHARACTERISTIC
/begin CHARACTERISTIC SCR_tTransfUCatUsT_CUR "Kennlinie zur Umwandlung des erfassten Spannungrohwertes in den physikalischen Temperaturwert vor Harnstoffkatalysator." CURVE 0x80061636 Cur_Xs16Ws16 1050.000 Temp_Cels -50.04000 999.9600 EXTENDED_LIMITS -3549.940 3003.560
 /begin AXIS_DESCR STD_AXIS SCR_uRawUCatUsT Volt 16 0.00 5000.000 EXTENDED_LIMITS -6553.600 6553.400 DEPOSIT ABSOLUTE /end AXIS_DESCR
/end CHARACTERISTIC
/begin CHARACTERISTIC SCR_tTransfUTnkT_CUR "" CURVE 0x800619BA Cur_Xs16Ws16 250.0000 Temp_Cels -50.04000 199.9600 EXTENDED_LIMITS -3549.940 3003.560
 /begin AXIS_DESCR STD_AXIS SCR_uRawUTnkT Volt 16 0.00 5000.000 EXTENDED_LIMITS -6553.600 6553.400 DEPOSIT ABSOLUTE /end AXIS_DESCR
/end CHARACTERISTIC
/begin CHARACTERISTIC SIIO_stDCSIntv_C "" VALUE 0x800626B6 Val_Wu8 255.0 OneToOne 0.00 255.0 /end CHARACTERISTIC
/begin CHARACTERISTIC SIIO_stTCSIntv_C "" VALUE 0x800626B7 Val_Wu8 255.0 OneToOne 0.00 255.0 /end CHARACTERISTIC
/begin CHARACTERISTIC SIIO_trqDesDCS_C "" VALUE 0x800626B8 Val_Ws16 104856.0 TrqPrp -52428.80 52427.20 /end CHARACTERISTIC
/begin CHARACTERISTIC SIIO_trqDesTCS_C "" VALUE 0x800626BA Val_Ws16 104856.0 TrqPrp -52428.80 52427.20 /end CHARACTERISTIC
/begin CHARACTERISTIC SIIO_trqLeadTCS_C "" VALUE 0x800626BC Val_Ws16 104856.0 TrqPrp -52428.80 52427.20 /end CHARACTERISTIC
/begin CHARACTERISTIC StWhl_dphiAg_C "" VALUE 0x800626BE Val_Ws16 360.0000 AngleDerivative 0.00 360.0000 FORMAT "%8.4" EXTENDED_LIMITS -2048.000 2047.938 /end CHARACTERISTIC
/begin CHARACTERISTIC StWhl_phiAg_C "" VALUE 0x800626C0 Val_Ws16 360.0000 Angle 0.00 360.0000 FORMAT "%8.4" EXTENDED_LIMITS -1024.000 1023.969 /end CHARACTERISTIC
/begin CHARACTERISTIC TCPrt_DKdChrgPmpCtlQDT1_C "Applikationslabel für kd" VALUE 0x800608D8 Val_Ws32 6999.99999255 Kd_InjMass2Prc -3499.99999627 3499.99999627 FORMAT "%13.8" EXTENDED_LIMITS -40000.0000000 39999.9999814 /end CHARACTERISTIC
/begin CHARACTERISTIC TCPrt_DkdChrgPmpDetMDT12_C "Applikationslabel für kd" VALUE 0x80060884 Val_Ws32 1000.00000000 Kd_dm2FactM 0.00 1000.00000000 FORMAT "%13.8" EXTENDED_LIMITS -20480.0000000 20479.9999905 /end CHARACTERISTIC
/begin CHARACTERISTIC TCPrt_DkdChrgPmpDetMDT1_C "Applikationslabel für kd" VALUE 0x80060888 Val_Ws32 1000.00000000 Kd_dm2FactM 0.00 1000.00000000 FORMAT "%13.8" EXTENDED_LIMITS -20480.0000000 20479.9999905 /end CHARACTERISTIC
/begin CHARACTERISTIC TCPrt_dnChrgPmpCtlHigh_CUR "Höhere Begrenzung, damit Hysteresis Änderungsgeschwindigkeit von Epm_nEng für Anti-Schwankung LIGov überwacht" CURVE 0x80060614 Cur_Xs16Ws16 3000.000 EngNGrd 0.00 3000.000 FORMAT "%8.3" EXTENDED_LIMITS -16384.00 16383.50
 /begin AXIS_DESCR STD_AXIS Epm_nEng EngN 5 0.00 6000.000 EXTENDED_LIMITS -16384.00 16383.50 DEPOSIT ABSOLUTE /end AXIS_DESCR
/end CHARACTERISTIC
/begin CHARACTERISTIC TCPrt_dnChrgPmpCtlLow_CUR "Unterere Grenze, damit Hysteresis Änderungsgeschwindigkeit von Epm_nEng für Anti-Schwankung LIGov überwacht" CURVE 0x8006062A Cur_Xs16Ws16 3000.000 EngNGrd 0.00 3000.000 FORMAT "%8.3" EXTENDED_LIMITS -16384.00 16383.50
 /begin AXIS_DESCR STD_AXIS Epm_nEng EngN 5 0.00 6000.000 EXTENDED_LIMITS -16384.00 16383.50 DEPOSIT ABSOLUTE /end AXIS_DESCR
/end CHARACTERISTIC
/begin CHARACTERISTIC TCPrt_dnChrgPmpCtlRls_C "Max. Limit für Drehzahlbeschl. bei Erkennung gleicher Status" VALUE 0x800608DC Val_Ws16 3000.000 EngNGrd 0.00 3000.000 FORMAT "%8.3" EXTENDED_LIMITS -16384.00 16383.50 /end CHARACTERISTIC
/begin CHARACTERISTIC TCPrt_dpChrgPmpCtlRmpDwn_C "Anti Surge Rampensteigung AB" VALUE 0x800608E0 Val_Ws32 65000000.0000 RmpPres_hPa 0.00 65000000.0000 FORMAT "%13.4" EXTENDED_LIMITS -32768000.0000 32767999.9847 /end CHARACTERISTIC
/begin CHARACTERISTIC TCPrt_dpChrgPmpCtlRmpUp_C "Anti Surge Rampensteigung AUF" VALUE 0x800608E4 Val_Ws32 65000000.0000 RmpPres_hPa 0.00 65000000.0000 FORMAT "%13.4" EXTENDED_LIMITS -32768000.0000 32767999.9847 /end CHARACTERISTIC
/begin CHARACTERISTIC TCPrt_dqChrgPmpCtlRls_C "Max. Limit für Einspritzmengengradienten bei Erkennung gleicher Status" VALUE 0x800608E8 Val_Ws16 200.0000 InjMassPerSec_20ms 0.00 200.0000 FORMAT "%8.4" EXTENDED_LIMITS -16384.00 16383.50 /end CHARACTERISTIC
/begin CHARACTERISTIC TCPrt_drChrgPmpCtlRmpDwn_C "Anti Surge Rampensteigung AB" VALUE 0x800608EC Val_Ws32 750000.000000 RmpPrc 0.00 750000.000000 FORMAT "%13.6" EXTENDED_LIMITS -400000.000000 399999.999814 /end CHARACTERISTIC
/begin CHARACTERISTIC TCPrt_drChrgPmpCtlRmpUp_C "slope for ramping UP" VALUE 0x800608F0 Val_Ws32 750000.000000 RmpPrc 0.00 750000.000000 FORMAT "%13.6" EXTENDED_LIMITS -400000.000000 399999.999814 /end CHARACTERISTIC
/begin CHARACTERISTIC TCPrt_facAFSensAmpMax_C "Obere Grenzwert für die Turboladerpumpgrenzerkennung" VALUE 0x8006088C Val_Ws16 2047.938 FactM 0.00 2047.938 FORMAT "%8.3" EXTENDED_LIMITS -2048.000 2047.938 /end CHARACTERISTIC
/begin CHARACTERISTIC TCPrt_facAFSensAmpMin_C "Untere Grenzwert für die Turboladerpumpgrenzerkennung" VALUE 0x8006088E Val_Ws16 2047.938 FactM 0.00 2047.938 FORMAT "%8.3" EXTENDED_LIMITS -2048.000 2047.938 /end CHARACTERISTIC
/begin CHARACTERISTIC TCPrt_facChrgPmpDes_MAP "Characteristic diagram for desired value air mass oscillation" MAP 0x800608F4 Map_Xs16Ys16Ws16 1.000000 FactM 0.00 1.000000 FORMAT "%8.6" EXTENDED_LIMITS -2048.000 2047.938
 /begin AXIS_DESCR STD_AXIS Epm_nEng EngN 6 0.00 6000.000 EXTENDED_LIMITS -16384.00 16383.50 DEPOSIT ABSOLUTE /end AXIS_DESCR
 /begin AXIS_DESCR STD_AXIS EnvP_pSens Pres_hPa 4 0.00 3500.000 EXTENDED_LIMITS -32768.00 32767.00 DEPOSIT ABSOLUTE /end AXIS_DESCR
/end CHARACTERISTIC
/begin CHARACTERISTIC TCPrt_facChrgPmpIWinNeg_C "Untere Kleinsignalgrenze für das P-Glied des AntiSurge-Reglers" VALUE 0x8006093C Val_Ws32 4000.00000000 FactM -2000.00000000 2000.00000000 FORMAT "%13.8" EXTENDED_LIMITS -134217728.000 134217727.938 /end CHARACTERISTIC
/begin CHARACTERISTIC TCPrt_facChrgPmpIWinPos_C "Obere Kleinsignalgrenze für das P-Glied des AntiSurge-Reglers" VALUE 0x80060940 Val_Ws32 4000.00000000 FactM -2000.00000000 2000.00000000 FORMAT "%13.8" EXTENDED_LIMITS -134217728.000 134217727.938 /end CHARACTERISTIC
/begin CHARACTERISTIC TCPrt_facChrgPmpI_MAP "Kennfeld für Adaptionsfaktor der I-Verstärkung" MAP 0x80060944 Map_Xs16Ys16Ws16 1.000000 Fact1 0.00 1.000000 EXTENDED_LIMITS -256.0000 255.9922
 /begin AXIS_DESCR STD_AXIS Epm_nEng EngN 6 0.00 6000.000 EXTENDED_LIMITS -16384.00 16383.50 DEPOSIT ABSOLUTE /end AXIS_DESCR
 /begin AXIS_DESCR STD_AXIS EnvP_pSens Pres_hPa 4 0.00 3500.000 EXTENDED_LIMITS -32768.00 32767.00 DEPOSIT ABSOLUTE /end AXIS_DESCR
/end CHARACTERISTIC
/begin CHARACTERISTIC TCPrt_facChrgPmpPWinNeg_C "Untere Kleinsignalgrenze für das P-Glied des AntiSurge-Reglers" VALUE 0x8006098C Val_Ws32 4000.00000000 FactM -2000.00000000 2000.00000000 FORMAT "%13.8" EXTENDED_LIMITS -134217728.000 134217727.938 /end CHARACTERISTIC
/begin CHARACTERISTIC TCPrt_facChrgPmpPWinPos_C "Obere Kleinsignalgrenze für das P-Glied des AntiSurge-Reglers" VALUE 0x80060990 Val_Ws32 4000.00000000 FactM -2000.00000000 2000.00000000 FORMAT "%13.8" EXTENDED_LIMITS -134217728.000 134217727.938 /end CHARACTERISTIC
/begin CHARACTERISTIC TCPrt_facChrgPmpP_MAP "Kennfeld für Adaptionsfaktor der P-Verstärkung" MAP 0x80060994 Map_Xs16Ys16Ws16 1.000000 Fact1 0.00 1.000000 EXTENDED_LIMITS -256.0000 255.9922
 /begin AXIS_DESCR STD_AXIS Epm_nEng EngN 6 0.00 6000.000 EXTENDED_LIMITS -16384.00 16383.50 DEPOSIT ABSOLUTE /end AXIS_DESCR
 /begin AXIS_DESCR STD_AXIS EnvP_pSens Pres_hPa 4 0.00 3500.000 EXTENDED_LIMITS -32768.00 32767.00 DEPOSIT ABSOLUTE /end AXIS_DESCR
/end CHARACTERISTIC
/begin CHARACTERISTIC TCPrt_facCnv_CUR "Kennlinie zur Amplitudenhöhe der oszillierenden Frischluftmasse beim Laderpumpen" CURVE 0x80060890 Cur_Xs16Ws16 1.000000 FactM 0.00 1.000000 FORMAT "%8.6" EXTENDED_LIMITS -2048.000 2047.938
 /begin AXIS_DESCR STD_AXIS TCPrt_facAFSensAmpFlt_mp FactM 10 0.00 10.00000 FORMAT "%8.5" EXTENDED_LIMITS -2048.000 2047.938 DEPOSIT ABSOLUTE /end AXIS_DESCR
/end CHARACTERISTIC
/begin CHARACTERISTIC TCPrt_IChrgPmpKiNeg_C "Grundwert der I-Verstärkung des PI-Reglers bei neg.Großsignalen" VALUE 0x800609DC Val_Ws32 15000000.0000 Ki_Pres_fac2hPa 0.00 15000000.0000 FORMAT "%13.4" EXTENDED_LIMITS -16000000.0000 15999999.9925 /end CHARACTERISTIC
/begin CHARACTERISTIC TCPrt_IChrgPmpKiPos_C "Grundwert der I-Verstärkung des PI-Reglers bei pos.Großsignalen" VALUE 0x800609E0 Val_Ws32 15000000.0000 Ki_Pres_fac2hPa 0.00 15000000.0000 FORMAT "%13.4" EXTENDED_LIMITS -16000000.0000 15999999.9925 /end CHARACTERISTIC
/begin CHARACTERISTIC TCPrt_IChrgPmpKi_C "Grundwert der I-Verstärkung des PI-Reglers bei Kleinsignalen" VALUE 0x800609E4 Val_Ws32 15000000.0000 Ki_Pres_fac2hPa 0.00 15000000.0000 FORMAT "%13.4" EXTENDED_LIMITS -16000000.0000 15999999.9925 /end CHARACTERISTIC
/begin CHARACTERISTIC TCPrt_mskClthDly_C "" VALUE 0x80060640 Val_Wu8 127.0 OneToOne 0.00 127.0 EXTENDED_LIMITS 0.00 255.0 /end CHARACTERISTIC
/begin CHARACTERISTIC TCPrt_nChrgPmpMon1_C "Schwelle Low Überwachung Anti-Surge LIGov/TCPrt_nSetpoint" VALUE 0x80060642 Val_Ws16 6000.000 EngN 0.00 6000.000 EXTENDED_LIMITS -16384.00 16383.50 /end CHARACTERISTIC
/begin CHARACTERISTIC TCPrt_nChrgPmpMon2_C "Schwelle High Überwachung Anti-Surge LIGov/TCPrt_nSetpoint" VALUE 0x80060644 Val_Ws16 6000.000 EngN 0.00 6000.000 EXTENDED_LIMITS -16384.00 16383.50 /end CHARACTERISTIC
/begin CHARACTERISTIC TCPrt_nHLSDemBase_C "LL-Solldrehzahl bei Anti-Surge inaktiv" VALUE 0x80060646 Val_Ws16 6000.000 EngN 0.00 6000.000 EXTENDED_LIMITS -16384.00 16383.50 /end CHARACTERISTIC
/begin CHARACTERISTIC TCPrt_nSetPointHLSDem_C "LIGov Einstellpunkt für Anti_Surge" VALUE 0x80060648 Val_Ws16 6000.000 EngN 0.00 6000.000 EXTENDED_LIMITS -16384.00 16383.50 /end CHARACTERISTIC
/begin CHARACTERISTIC TCPrt_nTSCOfs_CUR "" CURVE 0x8006064A Cur_Xs16Ws16 6000.000 EngN 0.00 6000.000 EXTENDED_LIMITS -16384.00 16383.50
 /begin AXIS_DESCR STD_AXIS VehV_v Vel 6 0.00 300.0000 EXTENDED_LIMITS -327.6800 327.6700 DEPOSIT ABSOLUTE /end AXIS_DESCR
/end CHARACTERISTIC
/begin CHARACTERISTIC TCPrt_pChrgPmpCtlVal_MAP "Map for surge ctl value" MAP 0x800609E8 Map_Xs16Ys16Ws16 3500.000 Pres_hPa 0.00 3500.000 EXTENDED_LIMITS -32768.00 32767.00
 /begin AXIS_DESCR STD_AXIS Epm_nEng EngN 6 0.00 6000.000 EXTENDED_LIMITS -16384.00 16383.50 DEPOSIT ABSOLUTE /end AXIS_DESCR
 /begin AXIS_DESCR STD_AXIS EnvP_pSens Pres_hPa 6 0.00 3500.000 EXTENDED_LIMITS -32768.00 32767.00 DEPOSIT ABSOLUTE /end AXIS_DESCR
/end CHARACTERISTIC
/begin CHARACTERISTIC TCPrt_PChrgPmpKpNeg_C "Grundwert der P-Verstärkung des PI-Reglers bei neg.Großsignalen" VALUE 0x80060A4C Val_Ws32 1048000.00000 Kp_Pres_fac2hPa 0.00 1048000.00000 FORMAT "%13.5" EXTENDED_LIMITS -1048576.00000 1048575.99951 /end CHARACTERISTIC
/begin CHARACTERISTIC TCPrt_PChrgPmpKpPos_C "Grundwert der P-Verstärkung des PI-Reglers bei pos.Großsignalen" VALUE 0x80060A50 Val_Ws32 1048000.00000 Kp_Pres_fac2hPa 0.00 1048000.00000 FORMAT "%13.5" EXTENDED_LIMITS -1048576.00000 1048575.99951 /end CHARACTERISTIC
/begin CHARACTERISTIC TCPrt_PChrgPmpKp_C "Grundwert der P-Verstärkung des PI-Reglers bei Kleinsigna-len" VALUE 0x80060A54 Val_Ws32 1048000.00000 Kp_Pres_fac2hPa 0.00 1048000.00000 FORMAT "%13.5" EXTENDED_LIMITS -1048576.00000 1048575.99951 /end CHARACTERISTIC
/begin CHARACTERISTIC TCPrt_pChrgPmpMax_MAP "Kennfeld zur Bestimmung der max. zulässigen Stellgröße" MAP 0x80060A58 Map_Xs16Ys16Ws16 3500.000 Pres_hPa 0.00 3500.000 EXTENDED_LIMITS -32768.00 32767.00
 /begin AXIS_DESCR STD_AXIS Epm_nEng EngN 5 0.00 6000.000 EXTENDED_LIMITS -16384.00 16383.50 DEPOSIT ABSOLUTE /end AXIS_DESCR
 /begin AXIS_DESCR STD_AXIS EnvP_pSens Pres_hPa 5 0.00 3500.000 EXTENDED_LIMITS -32768.00 32767.00 DEPOSIT ABSOLUTE /end AXIS_DESCR
/end CHARACTERISTIC
/begin CHARACTERISTIC TCPrt_pChrgPmpMin_MAP "Kennfeld zur Bestimmung der min. zulässigen Stellgröße" MAP 0x80060AA2 Map_Xs16Ys16Ws16 3500.000 Pres_hPa 0.00 3500.000 EXTENDED_LIMITS -32768.00 32767.00
 /begin AXIS_DESCR STD_AXIS Epm_nEng EngN 5 0.00 6000.000 EXTENDED_LIMITS -16384.00 16383.50 DEPOSIT ABSOLUTE /end AXIS_DESCR
 /begin AXIS_DESCR STD_AXIS EnvP_pSens Pres_hPa 5 0.00 3500.000 EXTENDED_LIMITS -32768.00 32767.00 DEPOSIT ABSOLUTE /end AXIS_DESCR
/end CHARACTERISTIC
/begin CHARACTERISTIC TCPrt_pDesChrgPmp_CUR "Kennlinie für Sollwert Ladedruck zur Reduktion Laderpumpen" CURVE 0x80060AEC Cur_Xs16Ws16 3500.000 Pres_hPa 0.00 3500.000 EXTENDED_LIMITS -32768.00 32767.00
 /begin AXIS_DESCR STD_AXIS TCPrt_pChrgPmpPICtlLim_mp Pres_hPa 2 0.00 3500.000 EXTENDED_LIMITS -32768.00 32767.00 DEPOSIT ABSOLUTE /end AXIS_DESCR
/end CHARACTERISTIC
/begin CHARACTERISTIC TCPrt_pDvtChrgPmpCtlRls_C "Max. Limit für Stellerabweichung bei Erkennung gleicher Status" VALUE 0x80060AF6 Val_Ws16 3500.000 Pres_hPa 0.00 3500.000 EXTENDED_LIMITS -32768.00 32767.00 /end CHARACTERISTIC
/begin CHARACTERISTIC TCPrt_qChrgPmpCtlHigh_CUR "Höhere Quantität Begrenzung für Hysteresis der Anti-Schwankung LIGov" CURVE 0x80060664 Cur_Xs16Ws16 100.0000 InjMass 0.00 100.0000 EXTENDED_LIMITS -327.6800 327.6700
 /begin AXIS_DESCR STD_AXIS Epm_nEng EngN 5 0.00 6000.000 EXTENDED_LIMITS -16384.00 16383.50 DEPOSIT ABSOLUTE /end AXIS_DESCR
/end CHARACTERISTIC
/begin CHARACTERISTIC TCPrt_qChrgPmpCtlLow_CUR "Senken Sie Quantität Begrenzung für Hysteresis der Anti-Schwankung LIGov" CURVE 0x8006067A Cur_Xs16Ws16 100.0000 InjMass 0.00 100.0000 EXTENDED_LIMITS -327.6800 327.6700
 /begin AXIS_DESCR STD_AXIS Epm_nEng EngN 5 0.00 6000.000 EXTENDED_LIMITS -16384.00 16383.50 DEPOSIT ABSOLUTE /end AXIS_DESCR
/end CHARACTERISTIC
/begin CHARACTERISTIC TCPrt_rChrgPmpCtlValHigh_MAP "Hystereseschwelle oben Druckverhältnis Anti-Surge LIGov" MAP 0x80060690 Map_Xs16Ys16Ws16 100.0000 Prc 0.00 100.0000 EXTENDED_LIMITS -400.0000 399.9878
 /begin AXIS_DESCR STD_AXIS Epm_nEng EngN 8 0.00 6000.000 EXTENDED_LIMITS -16384.00 16383.50 DEPOSIT ABSOLUTE /end AXIS_DESCR
 /begin AXIS_DESCR STD_AXIS EnvP_p Pres_hPa 3 0.00 3500.000 EXTENDED_LIMITS -32768.00 32767.00 DEPOSIT ABSOLUTE /end AXIS_DESCR
/end CHARACTERISTIC
/begin CHARACTERISTIC TCPrt_rChrgPmpCtlValOfs_CUR "Senken Sie ATL Druck-Verhältnisbegrenzung für Hysteresis der Anti-Schwankung LIGov" CURVE 0x800606DA Cur_Xs16Ws16 100.0000 Prc 0.00 100.0000 EXTENDED_LIMITS -400.0000 399.9878
 /begin AXIS_DESCR STD_AXIS Epm_nEng EngN 5 0.00 6000.000 EXTENDED_LIMITS -16384.00 16383.50 DEPOSIT ABSOLUTE /end AXIS_DESCR
/end CHARACTERISTIC
/begin CHARACTERISTIC TCPrt_rChrgPmpCtlVal_MAP "Erhöhung Druckregelungwert für Anti-Schwankung LIGov" MAP 0x800606F0 Map_Xs16Ys16Ws16 100.0000 Prc 0.00 100.0000 EXTENDED_LIMITS -400.0000 399.9878
 /begin AXIS_DESCR STD_AXIS PCR_qCtlVal InjMass 10 0.00 327.6700 EXTENDED_LIMITS -327.6800 327.6700 DEPOSIT ABSOLUTE /end AXIS_DESCR
 /begin AXIS_DESCR STD_AXIS Epm_nEng EngN 10 0.00 6000.000 EXTENDED_LIMITS -16384.00 16383.50 DEPOSIT ABSOLUTE /end AXIS_DESCR
/end CHARACTERISTIC
/begin CHARACTERISTIC TCPrt_rChrgPmpGovOff_CUR "to determine lower limit of PCR inj quantity desired to switch OFF the anti-surge govn." CURVE 0x80060AF8 Cur_Xs16Ws16 100.0000 Prc 0.00 100.0000 EXTENDED_LIMITS -400.0000 399.9878
 /begin AXIS_DESCR STD_AXIS Epm_nEng EngN 5 0.00 6000.000 EXTENDED_LIMITS -16384.00 16383.50 DEPOSIT ABSOLUTE /end AXIS_DESCR
/end CHARACTERISTIC
/begin CHARACTERISTIC TCPrt_rChrgPmpGovOn_MAP "MAP to determine upper limit of PCR desired to switch ON the anti-surge govn." MAP 0x80060B0E Map_Xs16Ys16Ws16 100.0000 Prc 0.00 100.0000 EXTENDED_LIMITS -400.0000 399.9878
 /begin AXIS_DESCR STD_AXIS Epm_nEng EngN 6 0.00 6000.000 EXTENDED_LIMITS -16384.00 16383.50 DEPOSIT ABSOLUTE /end AXIS_DESCR
 /begin AXIS_DESCR STD_AXIS EnvP_pSens Pres_hPa 4 0.00 3500.000 EXTENDED_LIMITS -32768.00 32767.00 DEPOSIT ABSOLUTE /end AXIS_DESCR
/end CHARACTERISTIC
/begin CHARACTERISTIC TCPrt_rChrgPmpGov_MAP "kennlinie für Ladedrucksteuersignal aus AntiSurge-Regler Eingangsgrößen" MAP 0x80060B56 Map_Xs16Ys16Ws16 100.0000 Prc 0.00 100.0000 EXTENDED_LIMITS -400.0000 399.9878
 /begin AXIS_DESCR STD_AXIS TCPrt_pChrgPmpPICtlLim_mp Pres_hPa 5 0.00 3500.000 EXTENDED_LIMITS -32768.00 32767.00 DEPOSIT ABSOLUTE /end AXIS_DESCR
 /begin AXIS_DESCR STD_AXIS Epm_nEng EngN 5 0.00 6000.000 EXTENDED_LIMITS -16384.00 16383.50 DEPOSIT ABSOLUTE /end AXIS_DESCR
/end CHARACTERISTIC
/begin CHARACTERISTIC TCPrt_rChrgPmpHigh_MAP "Hystereseschwelle oben Druckverhältnis Anti-Surge LIGov" MAP 0x800607E4 Map_Xs16Ys16Ws16 100.0000 Prc 0.00 100.0000 EXTENDED_LIMITS -400.0000 399.9878
 /begin AXIS_DESCR STD_AXIS Epm_nEng EngN 8 0.00 6000.000 EXTENDED_LIMITS -16384.00 16383.50 DEPOSIT ABSOLUTE /end AXIS_DESCR
 /begin AXIS_DESCR STD_AXIS EnvP_p Pres_hPa 3 0.00 3500.000 EXTENDED_LIMITS -32768.00 32767.00 DEPOSIT ABSOLUTE /end AXIS_DESCR
/end CHARACTERISTIC
/begin CHARACTERISTIC TCPrt_rChrgPmpOfs_CUR "Senken Sie ATL Druck-Verhältnisbegrenzung für Hysteresis der Anti-Schwankung LIGov" CURVE 0x8006082E Cur_Xs16Ws16 280.0049 Prc 0.00 280.0049 EXTENDED_LIMITS -400.0000 399.9878
 /begin AXIS_DESCR STD_AXIS Epm_nEng EngN 5 0.00 6000.000 EXTENDED_LIMITS -16384.00 16383.50 DEPOSIT ABSOLUTE /end AXIS_DESCR
/end CHARACTERISTIC
/begin CHARACTERISTIC TCPrt_rChrgPmpPhysHigh_CUR "" CURVE 0x80060844 Cur_Xs16Ws16 4.000000 Fact 0.00 4.000000 EXTENDED_LIMITS -4.000000 3.999878
 /begin AXIS_DESCR STD_AXIS ASMod_dmCmprUsRed AirMassPerTime 10 0.00 700.0000 EXTENDED_LIMITS -3276.800 3276.700 DEPOSIT ABSOLUTE /end AXIS_DESCR
/end CHARACTERISTIC
/begin CHARACTERISTIC TCPrt_rPmpLow_C "" VALUE 0x8006086E Val_Ws16 4.000000 Fact 0.00 4.000000 EXTENDED_LIMITS -4.000000 3.999878 /end CHARACTERISTIC
/begin CHARACTERISTIC TCPrt_swtChrgPmpGearHLSDem_C "Maske AntiSurge-LLR Gang-Auswahl (Bit0/1 für Clth_st = 0/1, Bit4/5/6 für Com_stClth = 0/1/2)" VALUE 0x80060870 Val_Wu8 3.000 OneToOne 0.00 3.000 EXTENDED_LIMITS 0.00 255.0 /end CHARACTERISTIC
/begin CHARACTERISTIC TCPrt_swtChrgPmpGearTrbCh_C "Maske AntiSurge-LDR Gang-Auswahl (Bit0 für Com_stClth =0, bit1 für Com_stClth =1)" VALUE 0x80060871 Val_Wu8 127.0 OneToOne 0.00 127.0 EXTENDED_LIMITS 0.00 255.0 /end CHARACTERISTIC
/begin CHARACTERISTIC TCPrt_swtChrgPmpGovActv_C "" VALUE 0x80060BA0 Val_Wu8 1.000 OneToOne 0.00 1.000 EXTENDED_LIMITS 0.00 255.0 /end CHARACTERISTIC
/begin CHARACTERISTIC TCPrt_swtChrgPmpGovSel_C "0: off Bit1: PCR_stSurge: 1: on" VALUE 0x80060BA1 Val_Wu8 255.0 OneToOne 0.00 255.0 /end CHARACTERISTIC
/begin CHARACTERISTIC TCPrt_swtOffStat1_C "Schalter um den Einfluss von TCPrt_stChrgPmpHLSDem_mp zu deaktivieren (1...deaktiviert, 0...aktiviert)" VALUE 0x80060872 Val_Wu8 1.000 OneToOne 0.00 1.000 EXTENDED_LIMITS 0.00 255.0 /end CHARACTERISTIC
/begin CHARACTERISTIC TCPrt_tiAFSensPTCtlFlt1_C "Parameter für PT1-Glied für Tiefpassfilterung der Amplitude der oszillierenden FrischluftmasseCtl-Flt1" VALUE 0x800608BC Val_Ws32 4294967.2940 TimeDelay_ms 0.0020000000009 4294967.2960 FORMAT "%12.4" /end CHARACTERISTIC
/begin CHARACTERISTIC TCPrt_tiAFSensPTCtlFlt2_C "Parameter für PT1-Glied für Tiefpassfilterung der Amplitude" VALUE 0x800608C0 Val_Ws32 4294967.2940 TimeDelay_ms 0.0020000000009 4294967.2960 FORMAT "%12.4" /end CHARACTERISTIC
/begin CHARACTERISTIC TCPrt_tiAFSensPTCtlFlt3_C "Parameter für PT1-Glied für Tiefpassfilterung der Amplitude der oszillierenden FrischluftmasseCtl-Flt2" VALUE 0x800608C4 Val_Ws32 4294967.2940 TimeDelay_ms 0.0020000000009 4294967.2960 FORMAT "%12.4" /end CHARACTERISTIC
/begin CHARACTERISTIC TCPrt_tiChrgPmpCtlHiLoRls3_C "Zeit für Statuswechsel niedrig" VALUE 0x80060BA2 Val_Ws16 327670.0 TimeDeb 0.00 327670.0 EXTENDED_LIMITS -327680.0 327670.0 /end CHARACTERISTIC
/begin CHARACTERISTIC TCPrt_tiChrgPmpCtlHiLo_C "Entprellzeit für Status TCPrt_stCrgPmpCtl für Übergang von 1 auf 0" VALUE 0x80060874 Val_Wu16 4000.000 Time_ms 0.00 4000.000 EXTENDED_LIMITS 0.00 655350.0 /end CHARACTERISTIC
/begin CHARACTERISTIC TCPrt_tiChrgPmpCtlLoHiRls3_C "application label time for change to high" VALUE 0x80060BA4 Val_Ws16 327670.0 TimeDeb 0.00 327670.0 EXTENDED_LIMITS -327680.0 327670.0 /end CHARACTERISTIC
/begin CHARACTERISTIC TCPrt_tiChrgPmpCtlLoHi_C "Entprellzeit für Status TCPrt_stCrgPmpCtl für Übergang von 0 auf 1" VALUE 0x80060876 Val_Wu16 4000.000 Time_ms 0.00 4000.000 EXTENDED_LIMITS 0.00 655350.0 /end CHARACTERISTIC
/begin CHARACTERISTIC TCPrt_tiChrgPmpCtlQDT1_C "Zeitabschnitt für den Filter DT1 für InjCtl_qRaw" VALUE 0x80060BA8 Val_Ws32 4294.9662960 TimeDelay_s 0.0010000000689 4294.9672960 FORMAT "%12.7" EXTENDED_LIMITS 0.000002000000001 4294.9672960 /end CHARACTERISTIC
/begin CHARACTERISTIC TCPrt_tiChrgPmpDetMDT12_C "Zeitabschnitt für die zweiten DT1-filter" VALUE 0x800608C8 Val_Ws32 4294.9662960 TimeDelay_s 0.0010000000689 4294.9672960 FORMAT "%12.7" EXTENDED_LIMITS 0.000002000000001 4294.9672960 /end CHARACTERISTIC
/begin CHARACTERISTIC TCPrt_tiChrgPmpDetMDT1_C "Zeitabschnitt für die DT1-filter" VALUE 0x800608CC Val_Ws32 4294.9662960 TimeDelay_s 0.0010000000689 4294.9672960 FORMAT "%12.7" EXTENDED_LIMITS 0.000002000000001 4294.9672960 /end CHARACTERISTIC
/begin CHARACTERISTIC TCPrt_tiChrgPmpGovPT1_C "Parameter für PT1-Glied für Tiefpassfilterung der Regelabwei-chung für I Anteil" VALUE 0x80060BAC Val_Ws32 4294.9662960 TimeDelay_s 0.0010000000689 4294.9672960 FORMAT "%12.7" EXTENDED_LIMITS 0.000002000000001 4294.9672960 /end CHARACTERISTIC
/begin CHARACTERISTIC TCPrt_tiChrgPmpGovRlsAllHiLo_C "Zeit für Statuswechsel niedrig" VALUE 0x80060BB0 Val_Ws16 327670.0 TimeDeb 0.00 327670.0 EXTENDED_LIMITS -327680.0 327670.0 /end CHARACTERISTIC
/begin CHARACTERISTIC TCPrt_tiChrgPmpGovRlsAllLoHi_C "Zeit für Statuswechsel hoch" VALUE 0x80060BB2 Val_Ws16 327670.0 TimeDeb 0.00 327670.0 EXTENDED_LIMITS -327680.0 327670.0 /end CHARACTERISTIC
/begin CHARACTERISTIC TCPrt_tiChrgPmpMonHLSDem_C "Überwachungszeit Drehzahlanhebung Anti-Surge" VALUE 0x80060878 Val_Wu16 655.3500 Time_s 0.00 655.3500 /end CHARACTERISTIC
/begin CHARACTERISTIC TCPrt_tiChrgPmpPT1_C "Zeitkonstante von PT1 Verzögerungsglied" VALUE 0x8006087C Val_Wu32 4294.8272945 TimeDelay_s 0.14000154169 4294.9672960 FORMAT "%12.7" EXTENDED_LIMITS 0.000001000000000 4294.9672960 /end CHARACTERISTIC
/begin CHARACTERISTIC TCPrt_tiClthDlyHiLo_C "" VALUE 0x80060880 Val_Ws16 4000.000 Time_ms 0.00 4000.000 EXTENDED_LIMITS -327680.0 327670.0 /end CHARACTERISTIC
/begin CHARACTERISTIC TCPrt_tiClthDlyLoHi_C "" VALUE 0x80060882 Val_Ws16 4000.000 Time_ms 0.00 4000.000 EXTENDED_LIMITS -327680.0 327670.0 /end CHARACTERISTIC
/begin CHARACTERISTIC TCPrt_tiDebChrgPmpHiLo_C "Parameter 2 für die Entprellung der Erkennung oszillierende Luftmasse mit großer Amplitude" VALUE 0x800608D0 Val_Ws16 655140.0 TimeDeb 0.00 655140.0 EXTENDED_LIMITS -327680.0 327670.0 /end CHARACTERISTIC
/begin CHARACTERISTIC TCPrt_tiDebChrgPmpLoHi_C "" VALUE 0x800608D2 Val_Ws16 655140.0 TimeDeb 0.00 655140.0 EXTENDED_LIMITS -327680.0 327670.0 /end CHARACTERISTIC
/begin CHARACTERISTIC TCPrt_tiDebPreChrgPmpDetHiLo_C "" VALUE 0x800608D4 Val_Ws16 655140.0 TimeDeb 0.00 655140.0 EXTENDED_LIMITS -327680.0 327670.0 /end CHARACTERISTIC
/begin CHARACTERISTIC TCPrt_tiDebPreChrgPmpDetLoHi_C "" VALUE 0x800608D6 Val_Ws16 655140.0 TimeDeb 0.00 655140.0 EXTENDED_LIMITS -327680.0 327670.0 /end CHARACTERISTIC
/begin CHARACTERISTIC TECU_RmpSlp.Pos_C "/" VALUE 0x80060BDC Kw_Ws32 3276798.99750 RmpTemp 1.00097656250 3276799.99847 FORMAT "%13.5" EXTENDED_LIMITS -3276800.00000 3276799.99847 /end CHARACTERISTIC
/begin CHARACTERISTIC TECU_RmpSlp.Neg_C "/" VALUE 0x80060BE0 Kw_Ws32 3276798.99750 RmpTemp 1.00097656250 3276799.99847 FORMAT "%13.5" EXTENDED_LIMITS -3276800.00000 3276799.99847 /end CHARACTERISTIC
/begin CHARACTERISTIC TECU_SRC.uMin_C "/" VALUE 0x80060BB4 Kw_Ws16 750.0000 Volt 0.00 750.0000 EXTENDED_LIMITS -6553.600 6553.400 /end CHARACTERISTIC
/begin CHARACTERISTIC TECU_SRC.uMax_C "/" VALUE 0x80060BB6 Kw_Ws16 800.0000 Volt 2500.000 3300.000 EXTENDED_LIMITS -6553.600 6553.400 /end CHARACTERISTIC
/begin CHARACTERISTIC TECU_tOvrTemp_C "" VALUE 0x80060BE4 Val_Ws16 400.0000 Temp_Cels -0.04000000 399.9600 EXTENDED_LIMITS -3549.940 3003.560 /end CHARACTERISTIC
/begin CHARACTERISTIC TECU_TransStg.Dfl_C "/" VALUE 0x80060BE6 Kw_Ws16 250.0000 Temp_Cels -50.04000 199.9600 EXTENDED_LIMITS -3549.940 3003.560 /end CHARACTERISTIC
/begin CHARACTERISTIC TECU_TransStg.stSensId_C "/" VALUE 0x80060BE8 Kw_Wu8 4.000 OneToOne 0.00 4.000 EXTENDED_LIMITS 0.00 255.0 /end CHARACTERISTIC
/begin CHARACTERISTIC TECU_tTransf_CUR "" CURVE 0x80060BB8 Cur_Xs16Ws16 250.0000 Temp_Cels -50.04000 199.9600 EXTENDED_LIMITS -3549.940 3003.560
 /begin AXIS_DESCR STD_AXIS TECU_uRaw Volt 8 0.00 5000.000 EXTENDED_LIMITS -6553.600 6553.400 DEPOSIT ABSOLUTE /end AXIS_DESCR
/end CHARACTERISTIC
/begin CHARACTERISTIC ThrVlv_4WinDiagDeb.ct4WinErr1DebDef_C "/" VALUE 0x80061124 Kw_Wu8 255.0 OneToOne 0.00 255.0 /end CHARACTERISTIC
/begin CHARACTERISTIC ThrVlv_4WinDiagDeb.ct4WinErr2DebDef_C "/" VALUE 0x80061125 Kw_Wu8 255.0 OneToOne 0.00 255.0 /end CHARACTERISTIC
/begin CHARACTERISTIC ThrVlv_4WinDiagDeb.ct4WinErr3DebDef_C "/" VALUE 0x80061126 Kw_Wu8 255.0 OneToOne 0.00 255.0 /end CHARACTERISTIC
/begin CHARACTERISTIC ThrVlv_4WinDiagDeb.ct4WinErr4DebDef_C "/" VALUE 0x80061127 Kw_Wu8 255.0 OneToOne 0.00 255.0 /end CHARACTERISTIC
/begin CHARACTERISTIC ThrVlv_4WinDiagDeb.ti4WinErrDebDef_C "/" VALUE 0x80061128 Kw_Wu16 655350.0 Time_ms 0.00 655350.0 /end CHARACTERISTIC
/begin CHARACTERISTIC ThrVlv_4WinSigDur.tiErr1Min_C "/" VALUE 0x8006112A Kw_Ws16 655350.0 Time_ms -327680.0 327670.0 /end CHARACTERISTIC
/begin CHARACTERISTIC ThrVlv_4WinSigDur.tiErr1Max_C "/" VALUE 0x8006112C Kw_Ws16 655350.0 Time_ms -327680.0 327670.0 /end CHARACTERISTIC
/begin CHARACTERISTIC ThrVlv_4WinSigDur.tiErr2Min_C "/" VALUE 0x8006112E Kw_Ws16 655350.0 Time_ms -327680.0 327670.0 /end CHARACTERISTIC
/begin CHARACTERISTIC ThrVlv_4WinSigDur.tiErr2Max_C "/" VALUE 0x80061130 Kw_Ws16 655350.0 Time_ms -327680.0 327670.0 /end CHARACTERISTIC
/begin CHARACTERISTIC ThrVlv_4WinSigDur.tiErr3Min_C "/" VALUE 0x80061132 Kw_Ws16 655350.0 Time_ms -327680.0 327670.0 /end CHARACTERISTIC
/begin CHARACTERISTIC ThrVlv_4WinSigDur.tiErr3Max_C "/" VALUE 0x80061134 Kw_Ws16 655350.0 Time_ms -327680.0 327670.0 /end CHARACTERISTIC
/begin CHARACTERISTIC ThrVlv_4WinSigDur.tiErr4Min_C "/" VALUE 0x80061136 Kw_Ws16 655350.0 Time_ms -327680.0 327670.0 /end CHARACTERISTIC
/begin CHARACTERISTIC ThrVlv_4WinSigDur.tiErr4Max_C "/" VALUE 0x80061138 Kw_Ws16 655350.0 Time_ms -327680.0 327670.0 /end CHARACTERISTIC
/begin CHARACTERISTIC ThrVlv_ctMonDefLimH_C "" VALUE 0x8006122A Val_Wu8 254.0 OneToOne 0.00 254.0 EXTENDED_LIMITS 0.00 255.0 /end CHARACTERISTIC
/begin CHARACTERISTIC ThrVlv_ctMonDefLimL_C "" VALUE 0x8006122B Val_Wu8 254.0 OneToOne 0.00 254.0 EXTENDED_LIMITS 0.00 255.0 /end CHARACTERISTIC
/begin CHARACTERISTIC ThrVlv_pLimMon_C "" VALUE 0x8006122C Val_Ws16 3500.000 Pres_hPa 0.00 3500.000 EXTENDED_LIMITS -32768.00 32767.00 /end CHARACTERISTIC
/begin CHARACTERISTIC ThrVlv_Pwm.tiPer_C "/" VALUE 0x8006113A Kw_Ws16 9.900000 Period 0.1000000 10.00000 FORMAT "%8.5" EXTENDED_LIMITS -3276.800 3276.700 /end CHARACTERISTIC
/begin CHARACTERISTIC ThrVlv_Pwm.stLvl_C "/" VALUE 0x8006113C Kw_Wu8 1.000 OneToOne 0.00 1.000 EXTENDED_LIMITS 0.00 255.0 /end CHARACTERISTIC
/begin CHARACTERISTIC ThrVlv_Pwm.rMaxDty_C "/" VALUE 0x8006113E Kw_Ws16 100.0000 DtyCyc 0.00 100.0000 EXTENDED_LIMITS -327.6800 327.6700 /end CHARACTERISTIC
/begin CHARACTERISTIC ThrVlv_Pwm.rPerUn_C "/" VALUE 0x80061140 Kw_Ws16 3276.700 Period 0.00 3276.700 FORMAT "%8.3" EXTENDED_LIMITS -3276.800 3276.700 /end CHARACTERISTIC
/begin CHARACTERISTIC ThrVlv_Pwm.tiPh_C "/" VALUE 0x80061142 Kw_Ws16 65535.00 OneToOne -32768.00 32767.00 /end CHARACTERISTIC
/begin CHARACTERISTIC ThrVlv_PwmOut.rMin_C "/" VALUE 0x80061144 Kw_Ws16 100.0000 DtyCyc 0.00 100.0000 EXTENDED_LIMITS -327.6800 327.6700 /end CHARACTERISTIC
/begin CHARACTERISTIC ThrVlv_PwmOut.rMax_C "/" VALUE 0x80061146 Kw_Ws16 100.0000 DtyCyc 0.00 100.0000 EXTENDED_LIMITS -327.6800 327.6700 /end CHARACTERISTIC
/begin CHARACTERISTIC ThrVlv_PwmOut.tiBtwTstSCB_C "/" VALUE 0x80061148 Kw_Ws16 1000.000 Time_ms 0.00 1000.000 EXTENDED_LIMITS -327680.0 327670.0 /end CHARACTERISTIC
/begin CHARACTERISTIC ThrVlv_PwmOut.tiBtwTstOT_C "/" VALUE 0x8006114A Kw_Ws16 327.6700 Time_s 0.00 327.6700 EXTENDED_LIMITS -327.6800 327.6700 /end CHARACTERISTIC
/begin CHARACTERISTIC ThrVlv_PwmOut.numTstMax_C "/" VALUE 0x8006114C Kw_Wu16 65535.00 OneToOne 0.00 65535.00 /end CHARACTERISTIC
/begin CHARACTERISTIC ThrVlv_PwmOut.swtBattCor_C "/" VALUE 0x8006114E Kw_Wu8 1.000 OneToOne 0.00 1.000 EXTENDED_LIMITS 0.00 255.0 /end CHARACTERISTIC
/begin CHARACTERISTIC ThrVlv_PwmOut.swtPsInv_C "/" VALUE 0x8006114F Kw_Wu8 255.0 OneToOne 0.00 255.0 /end CHARACTERISTIC
/begin CHARACTERISTIC ThrVlv_rCnv_MAP "" MAP 0x80061150 Map_Xs16Ys16Ws16 100.0000 DtyCyc 0.00 100.0000 EXTENDED_LIMITS -327.6800 327.6700
 /begin AXIS_DESCR STD_AXIS ThrVlv_r Prc 13 -400.0000 399.9878 DEPOSIT ABSOLUTE /end AXIS_DESCR
 /begin AXIS_DESCR STD_AXIS Epm_nEng EngN 6 -16384.00 16383.50 DEPOSIT ABSOLUTE /end AXIS_DESCR
/end CHARACTERISTIC
/begin CHARACTERISTIC ThrVlv_RmpSlp.Pos_C "/" VALUE 0x80061230 Kw_Ws32 327679.999847 RmpDtyCyc 0.00 327679.999847 FORMAT "%13.6" EXTENDED_LIMITS -327680.000000 327679.999847 /end CHARACTERISTIC
/begin CHARACTERISTIC ThrVlv_RmpSlp.Neg_C "/" VALUE 0x80061234 Kw_Ws32 327679.999847 RmpDtyCyc 0.00 327679.999847 FORMAT "%13.6" EXTENDED_LIMITS -327680.000000 327679.999847 /end CHARACTERISTIC
/begin CHARACTERISTIC ThrVlv_rPsDisbl_C "" VALUE 0x80061216 Val_Ws16 100.0000 DtyCyc 0.00 100.0000 EXTENDED_LIMITS -327.6800 327.6700 /end CHARACTERISTIC
/begin CHARACTERISTIC ThrVlv_rTransf_CUR "" CURVE 0x8006121C Cur_Xs16Ws16 655.3500 DtyCyc -327.6800 327.6700
 /begin AXIS_DESCR STD_AXIS ThrVlv_uRaw Volt 2 0.00 5200.000 EXTENDED_LIMITS -6553.600 6553.400 DEPOSIT ABSOLUTE /end AXIS_DESCR
/end CHARACTERISTIC
/begin CHARACTERISTIC ThrVlv_SRC.uMin_C "/" VALUE 0x80061226 Kw_Ws16 5200.000 Volt 0.00 5200.000 EXTENDED_LIMITS -6553.600 6553.400 /end CHARACTERISTIC
/begin CHARACTERISTIC ThrVlv_SRC.uMax_C "/" VALUE 0x80061228 Kw_Ws16 5200.000 Volt 0.00 5200.000 EXTENDED_LIMITS -6553.600 6553.400 /end CHARACTERISTIC
/begin CHARACTERISTIC ThrVlv_stPsDiaDisbl_C "" VALUE 0x80061218 Val_Wu8 255.0 OneToOne 0.00 255.0 /end CHARACTERISTIC
/begin CHARACTERISTIC ThrVlv_stPsDisbl_C "" VALUE 0x80061219 Val_Wu8 255.0 OneToOne 0.00 255.0 /end CHARACTERISTIC
/begin CHARACTERISTIC ThrVlv_swtMon_C "" VALUE 0x8006122E Val_Wu8 1.000 OneToOne 0.00 1.000 EXTENDED_LIMITS 0.00 255.0 /end CHARACTERISTIC
/begin CHARACTERISTIC ThrVlv_TransStagePar.Dfl_C "/" VALUE 0x80061238 Kw_Ws16 100.0000 DtyCyc 0.00 100.0000 EXTENDED_LIMITS -327.6800 327.6700 /end CHARACTERISTIC
/begin CHARACTERISTIC ThrVlv_TransStagePar.stSensId_C "/" VALUE 0x8006123A Kw_Wu8 255.0 OneToOne 0.00 255.0 /end CHARACTERISTIC
/begin CHARACTERISTIC ThrVlv_typ4WinDia_C "" VALUE 0x8006121A Val_Wu8 1.00000000000 Typ4WinDia 0.00 1.00000000000 FORMAT "%13.11" EXTENDED_LIMITS 0.00 3.00000000000 /end CHARACTERISTIC
/begin CHARACTERISTIC Tra_bAST_C "Status AST-Intervention aktiv" VALUE 0x80061418 Val_Wu8 255.0 OneToOne 0.00 255.0 /end CHARACTERISTIC
/begin CHARACTERISTIC Tra_bCanAirCanPtd_C "Bedingung relative Kühlleistungsanforderung vom CAN" VALUE 0x8006123C Val_Wu8 255.0 OneToOne 0.00 255.0 /end CHARACTERISTIC
/begin CHARACTERISTIC Tra_bCANASTIntv_C "Status AST-Eingriff über CAN" VALUE 0x80061419 Val_Wu8 255.0 OneToOne 0.00 255.0 /end CHARACTERISTIC
/begin CHARACTERISTIC Tra_bCanClntCanPtd_C "Bedingung Sollwert der Kühlmitteltemperatur vom CAN" VALUE 0x8006123D Val_Wu8 255.0 OneToOne 0.00 255.0 /end CHARACTERISTIC
/begin CHARACTERISTIC Tra_bCANIdlSetP_C "Status Getriebeleerlaufdrehzahlanhebung über CAN" VALUE 0x8006141A Val_Wu8 255.0 OneToOne 0.00 255.0 /end CHARACTERISTIC
/begin CHARACTERISTIC Tra_bCanInfoCan_C "Bedingung Information CAN möglich vom CAN" VALUE 0x80061258 Val_Wu8 255.0 OneToOne 0.00 255.0 /end CHARACTERISTIC
/begin CHARACTERISTIC Tra_bCanLevPos_C "Bedingung Ganghebelposition vom CAN" VALUE 0x80061259 Val_Wu8 255.0 OneToOne 0.00 255.0 /end CHARACTERISTIC
/begin CHARACTERISTIC Tra_bCanLoRng_C "Bedingung Getriebeuntersetzung vom CAN" VALUE 0x8006125A Val_Wu8 255.0 OneToOne 0.00 255.0 /end CHARACTERISTIC
/begin CHARACTERISTIC Tra_bCanPlausDecIntv_C "Bedingung fallender Getriebeeingriff plausibel" VALUE 0x80061578 Val_Wu8 255.0 OneToOne 0.00 255.0 /end CHARACTERISTIC
/begin CHARACTERISTIC Tra_bCanPlausIncIntv_C "Bedingung steigender Getriebeeingriff plausibel" VALUE 0x80061579 Val_Wu8 255.0 OneToOne 0.00 255.0 /end CHARACTERISTIC
/begin CHARACTERISTIC Tra_bCanRevGear_C "Bedingung Information Istgang = Rückwärtsgang vom CAN" VALUE 0x8006125B Val_Wu8 255.0 OneToOne 0.00 255.0 /end CHARACTERISTIC
/begin CHARACTERISTIC Tra_bCanRTra_C "Bedingung aktuelle Momentenübersetzung des Getriebes (exklusive Wandler) vom CAN" VALUE 0x8006125C Val_Wu8 255.0 OneToOne 0.00 255.0 /end CHARACTERISTIC
/begin CHARACTERISTIC Tra_bFltIdlSpdDes_C "Status Getriebeleerlaufdrehzahlanhebung ungefiltert bzw. gefiltert übernehmen" VALUE 0x8006141B Val_Wu8 255.0 OneToOne 0.00 255.0 /end CHARACTERISTIC
/begin CHARACTERISTIC Tra_bGbxNPosEna_C "Bedingung Aktivierung HW Schalter für Leergang" VALUE 0x8006125D Val_Wu8 255.0 OneToOne 0.00 255.0 /end CHARACTERISTIC
/begin CHARACTERISTIC Tra_bStrtStopEnaDfl_C "Bedingung Einschalten Start/Stop Funktion" VALUE 0x8006125E Val_Wu8 255.0 OneToOne 0.00 255.0 /end CHARACTERISTIC
/begin CHARACTERISTIC Tra_dnNBrkRmp.Pos_C "/" VALUE 0x8006141C Kw_Ws32 199.996948242 RmpEngN 0.00 199.996948242 FORMAT "%13.9" EXTENDED_LIMITS -16384000.0000 16383999.9924 /end CHARACTERISTIC
/begin CHARACTERISTIC Tra_dnNBrkRmp.Neg_C "/" VALUE 0x80061420 Kw_Ws32 199.996948242 RmpEngN 0.00 199.996948242 FORMAT "%13.9" EXTENDED_LIMITS -16384000.0000 16383999.9924 /end CHARACTERISTIC
/begin CHARACTERISTIC Tra_dnNMinRmp.Pos_C "/" VALUE 0x80061424 Kw_Ws32 199.996948242 RmpEngN 0.00 199.996948242 FORMAT "%13.9" EXTENDED_LIMITS -16384000.0000 16383999.9924 /end CHARACTERISTIC
/begin CHARACTERISTIC Tra_dnNMinRmp.Neg_C "/" VALUE 0x80061428 Kw_Ws32 199.996948242 RmpEngN 0.00 199.996948242 FORMAT "%13.9" EXTENDED_LIMITS -16384000.0000 16383999.9924 /end CHARACTERISTIC
/begin CHARACTERISTIC Tra_dnTSCLimRmp2_C "" VALUE 0x8006142C Val_Ws16 7000.000 dn_dZ20 -3500.000 3500.000 FORMAT "%8.3" EXTENDED_LIMITS -163840.0 163835.0 /end CHARACTERISTIC
/begin CHARACTERISTIC Tra_drAPP1Min_C "" VALUE 0x8006142E Val_Ws16 39999.39 PrcPerSec -20000.00 19999.39 FORMAT "%8.2" /end CHARACTERISTIC
/begin CHARACTERISTIC Tra_drAPPFlt_C "" VALUE 0x80061430 Val_Ws16 39999.39 PrcPerSec -20000.00 19999.39 FORMAT "%8.2" /end CHARACTERISTIC
/begin CHARACTERISTIC Tra_drTraDfl.Pos_C "/" VALUE 0x80061260 Kw_Ws32 327679.999847 RmpTransR 0.00 327679.999847 FORMAT "%13.6" EXTENDED_LIMITS -327680.000000 327679.999847 /end CHARACTERISTIC
/begin CHARACTERISTIC Tra_drTraDfl.Neg_C "/" VALUE 0x80061264 Kw_Ws32 327679.999847 RmpTransR 0.00 327679.999847 FORMAT "%13.6" EXTENDED_LIMITS -327680.000000 327679.999847 /end CHARACTERISTIC
/begin CHARACTERISTIC Tra_DT1TSCDiff.T1_C "/" VALUE 0x80061434 Kw_Ws32 4294.9672940 TimeDelay_s 0.000002000000001 4294.9672960 FORMAT "%12.7" /end CHARACTERISTIC
/begin CHARACTERISTIC Tra_DT1TSCDiff.Kd_C "/" VALUE 0x80061438 Kw_Ws32 65535.9999847 Kd -32768.0000000 32767.9999847 FORMAT "%13.7" /end CHARACTERISTIC
/begin CHARACTERISTIC Tra_dtrqLimUp_C "" VALUE 0x800612C4 Val_Ws32 6553599.99847 RmpTrq -3276800.00000 3276799.99847 /end CHARACTERISTIC
/begin CHARACTERISTIC Tra_dtrqPrtRmp.Pos_C "/" VALUE 0x800612C8 Kw_Ws32 3276799.99847 RmpTrq 0.00 3276799.99847 EXTENDED_LIMITS -3276800.00000 3276799.99847 /end CHARACTERISTIC
/begin CHARACTERISTIC Tra_dtrqPrtRmp.Neg_C "/" VALUE 0x800612CC Kw_Ws32 3276799.99847 RmpTrq 0.00 3276799.99847 EXTENDED_LIMITS -3276800.00000 3276799.99847 /end CHARACTERISTIC
/begin CHARACTERISTIC Tra_dtrqPrtRmpP.Pos_C "---/" VALUE 0x800612D0 Kw_Ws32 3276799.99847 RmpTrq 0.00 3276799.99847 EXTENDED_LIMITS -3276800.00000 3276799.99847 /end CHARACTERISTIC
/begin CHARACTERISTIC Tra_dtrqPrtRmpP.Neg_C "---/" VALUE 0x800612D4 Kw_Ws32 3276799.99847 RmpTrq 0.00 3276799.99847 EXTENDED_LIMITS -3276800.00000 3276799.99847 /end CHARACTERISTIC
/begin CHARACTERISTIC Tra_dtrqRmpDecP.Pos_C "---/" VALUE 0x8006157C Kw_Ws32 3276799.99847 RmpTrq 0.00 3276799.99847 EXTENDED_LIMITS -3276800.00000 3276799.99847 /end CHARACTERISTIC
/begin CHARACTERISTIC Tra_dtrqRmpDecP.Neg_C "---/" VALUE 0x80061580 Kw_Ws32 3276799.99847 RmpTrq 0.00 3276799.99847 EXTENDED_LIMITS -3276800.00000 3276799.99847 /end CHARACTERISTIC
/begin CHARACTERISTIC Tra_dtrqRmpIncP.Pos_C "---/" VALUE 0x80061584 Kw_Ws32 3276799.99847 RmpTrq 0.00 3276799.99847 EXTENDED_LIMITS -3276800.00000 3276799.99847 /end CHARACTERISTIC
/begin CHARACTERISTIC Tra_dtrqRmpIncP.Neg_C "---/" VALUE 0x80061588 Kw_Ws32 3276799.99847 RmpTrq 0.00 3276799.99847 EXTENDED_LIMITS -3276800.00000 3276799.99847 /end CHARACTERISTIC
/begin CHARACTERISTIC Tra_facConv_C "" VALUE 0x80061268 Val_Ws16 7.999878 Fact -4.000000 3.999878 /end CHARACTERISTIC
/begin CHARACTERISTIC Tra_facLimUp_CUR "" CURVE 0x800612D8 Kl_Xs16_Ws16 7.999878 Fact -4.000000 3.999878
 /begin AXIS_DESCR STD_AXIS VehV_v Vel 8 0.00 300.0000 EXTENDED_LIMITS -327.6800 327.6700 DEPOSIT ABSOLUTE /end AXIS_DESCR
/end CHARACTERISTIC
/begin CHARACTERISTIC Tra_facVnCor_C "" VALUE 0x8006126A Val_Ws16 7.999878 Fact -4.000000 3.999878 /end CHARACTERISTIC
/begin CHARACTERISTIC Tra_nASTDes_C "Ersatzwert für Synchronisationsdrehzahl" VALUE 0x8006143C Val_Ws16 32767.50 EngN -16384.00 16383.50 /end CHARACTERISTIC
/begin CHARACTERISTIC Tra_nEngMin_C "Minimale Motordrehzahl" VALUE 0x8006126C Val_Ws16 32767.50 EngN -16384.00 16383.50 /end CHARACTERISTIC
/begin CHARACTERISTIC Tra_nHtgUpActMax_C "" VALUE 0x8006143E Val_Ws16 32767.50 EngN -16384.00 16383.50 /end CHARACTERISTIC
/begin CHARACTERISTIC Tra_nMax_C "Maximale Drehzahl Getriebe" VALUE 0x80061440 Val_Ws16 32767.50 EngN -16384.00 16383.50 /end CHARACTERISTIC
/begin CHARACTERISTIC Tra_nMinBrk_MAP "" MAP 0x80061442 Kf_Xs16_Ys16_Ws16 10000.00 EngN 0.00 10000.00 EXTENDED_LIMITS -16384.00 16383.50
 /begin AXIS_DESCR STD_AXIS Gbx_nTrbn EngN 4 0.00 10000.00 EXTENDED_LIMITS -16384.00 16383.50 DEPOSIT ABSOLUTE /end AXIS_DESCR
 /begin AXIS_DESCR STD_AXIS Tra_numGear OneToOne 8 0.00 7.000 EXTENDED_LIMITS -128.0 127.0 DEPOSIT ABSOLUTE /end AXIS_DESCR
/end CHARACTERISTIC
/begin CHARACTERISTIC Tra_nMin_C "Minimale Drehzahl Getriebe" VALUE 0x8006149E Val_Ws16 32767.50 EngN -16384.00 16383.50 /end CHARACTERISTIC
/begin CHARACTERISTIC Tra_nMin_MAP "" MAP 0x800614A0 Kf_Xs16_Ys16_Ws16 10000.00 EngN 0.00 10000.00 EXTENDED_LIMITS -16384.00 16383.50
 /begin AXIS_DESCR STD_AXIS Gbx_nTrbn EngN 4 0.00 10000.00 EXTENDED_LIMITS -16384.00 16383.50 DEPOSIT ABSOLUTE /end AXIS_DESCR
 /begin AXIS_DESCR STD_AXIS Tra_numGear OneToOne 8 0.00 7.000 EXTENDED_LIMITS -128.0 127.0 DEPOSIT ABSOLUTE /end AXIS_DESCR
/end CHARACTERISTIC
/begin CHARACTERISTIC Tra_nRmpTSC1Delta_C "" VALUE 0x800614FC Val_Ws16 163335.0 dn_dZ20 500.0000 163835.0 FORMAT "%8.1" EXTENDED_LIMITS -163840.0 163835.0 /end CHARACTERISTIC
/begin CHARACTERISTIC Tra_nRmpTSC2Delta_C "" VALUE 0x800614FE Val_Ws16 163335.0 dn_dZ20 500.0000 163835.0 FORMAT "%8.1" EXTENDED_LIMITS -163840.0 163835.0 /end CHARACTERISTIC
/begin CHARACTERISTIC Tra_nSpaMaxLowGear_C "" VALUE 0x80061530 Val_Ws16 32767.50 EngN -16384.00 16383.50 /end CHARACTERISTIC
/begin CHARACTERISTIC Tra_nSpaMaxShiftDwn_C "" VALUE 0x80061532 Val_Ws16 9980.000 EngN 20.00000 10000.00 EXTENDED_LIMITS -16384.00 16383.50 /end CHARACTERISTIC
/begin CHARACTERISTIC Tra_nTSCDeltaInit_C "" VALUE 0x80061500 Val_Ws16 32767.50 EngN -16384.00 16383.50 /end CHARACTERISTIC
/begin CHARACTERISTIC Tra_nTSCLimLoRmp2_C "" VALUE 0x80061502 Val_Ws16 7000.000 EngN -3500.000 3500.000 EXTENDED_LIMITS -16384.00 16383.50 /end CHARACTERISTIC
/begin CHARACTERISTIC Tra_nTSCLimMax_C "" VALUE 0x80061504 Val_Ws16 18384.00 EngN -16384.00 2000.000 EXTENDED_LIMITS -16384.00 16383.50 /end CHARACTERISTIC
/begin CHARACTERISTIC Tra_nTSCLimRmp2_C "" VALUE 0x80061506 Val_Ws16 7000.000 EngN -3500.000 3500.000 EXTENDED_LIMITS -16384.00 16383.50 /end CHARACTERISTIC
/begin CHARACTERISTIC Tra_nTSCLimRmpOff_C "" VALUE 0x80061508 Val_Ws16 32767.50 EngN -16384.00 16383.50 /end CHARACTERISTIC
/begin CHARACTERISTIC Tra_nTSCSlip_C "" VALUE 0x8006150A Val_Ws16 32767.50 EngN -16384.00 16383.50 /end CHARACTERISTIC
/begin CHARACTERISTIC Tra_numLevPosCan_C "Initialwert Wählhebelposition" VALUE 0x8006126E Val_Wu8 255.0 OneToOne 0.00 255.0 /end CHARACTERISTIC
/begin CHARACTERISTIC Tra_numSpaLowGear_CUR "" CURVE 0x80061534 Kl_Xs16_Ws16 7.000000 OneToOne 0.00 7.000000 EXTENDED_LIMITS -32768.00 32767.00 /begin AXIS_DESCR STD_AXIS VehV_v Vel 7 -327.6800 327.6700 DEPOSIT ABSOLUTE /end AXIS_DESCR /end CHARACTERISTIC
/begin CHARACTERISTIC Tra_numSpaMaxGear_CUR "" CURVE 0x80061552 Kl_Xs16_Ws16 7.000000 OneToOne 0.00 7.000000 EXTENDED_LIMITS -32768.00 32767.00 /begin AXIS_DESCR STD_AXIS VehV_v Vel 7 -327.6800 327.6700 DEPOSIT ABSOLUTE /end AXIS_DESCR /end CHARACTERISTIC
/begin CHARACTERISTIC Tra_numSpaMaxStep_C "" VALUE 0x80061570 Val_Ws8 7.000 OneToOne 0.00 7.000 EXTENDED_LIMITS -128.0 127.0 /end CHARACTERISTIC
/begin CHARACTERISTIC Tra_numSpaNoGear_C "" VALUE 0x80061571 Val_Wu8 255.0 OneToOne 0.00 255.0 /end CHARACTERISTIC
/begin CHARACTERISTIC Tra_rAPPActv_C "" VALUE 0x8006150C Val_Ws16 100.0000 Prc 0.00 100.0000 EXTENDED_LIMITS -400.0000 399.9878 /end CHARACTERISTIC
/begin CHARACTERISTIC Tra_rAPPCondOff_C "" VALUE 0x8006150E Val_Ws16 799.9878 Prc -400.0000 399.9878 /end CHARACTERISTIC
/begin CHARACTERISTIC Tra_rAPP_C "" VALUE 0x80061510 Val_Ws16 100.0000 Prc 0.00 100.0000 EXTENDED_LIMITS -400.0000 399.9878 /end CHARACTERISTIC
/begin CHARACTERISTIC Tra_rClgDem_C "Parameter für die relative Lüfterkühlleistung" VALUE 0x8006123E Val_Ws16 799.9878 Prc -400.0000 399.9878 /end CHARACTERISTIC
/begin CHARACTERISTIC Tra_rTraDfl_C "" VALUE 0x80061270 Val_Ws16 655.3500 TransR -327.6800 327.6700 /end CHARACTERISTIC
/begin CHARACTERISTIC Tra_rV2NDfl_C "Initialwert für Quotient aus Geschwindigkeit und Drehzahl" VALUE 0x80061272 Val_Ws16 0.6553500 VelToN -0.3276800 0.3276700 FORMAT "%9.7" /end CHARACTERISTIC
/begin CHARACTERISTIC Tra_rV2NMax_C "" VALUE 0x80061274 Val_Ws16 0.6553500 VelToN -0.3276800 0.3276700 FORMAT "%9.7" /end CHARACTERISTIC
/begin CHARACTERISTIC Tra_rV2NMin_C "" VALUE 0x80061276 Val_Ws16 0.6553500 VelToN -0.3276800 0.3276700 FORMAT "%9.7" /end CHARACTERISTIC
/begin CHARACTERISTIC Tra_rVn1H_C "Parameter für maximales Übersetzungsverhältnis Gang 1" VALUE 0x80061278 Val_Ws16 0.6553500 VelToN -0.3276800 0.3276700 FORMAT "%9.7" /end CHARACTERISTIC
/begin CHARACTERISTIC Tra_rVn1L_C "Parameter für minimales Übersetzungsverhältnis Gang 1" VALUE 0x8006127A Val_Ws16 0.6553500 VelToN -0.3276800 0.3276700 FORMAT "%9.7" /end CHARACTERISTIC
/begin CHARACTERISTIC Tra_rVn1To2Des_C "Parameter für Übersetzungsverhältnis vom 1. in den 2. Gang" VALUE 0x8006127C Val_Ws16 0.6553500 VelToN -0.3276800 0.3276700 FORMAT "%9.7" /end CHARACTERISTIC
/begin CHARACTERISTIC Tra_rVn2H_C "Parameter für maximales Übersetzungsverhältnis Gang 2" VALUE 0x8006127E Val_Ws16 0.6553500 VelToN -0.3276800 0.3276700 FORMAT "%9.7" /end CHARACTERISTIC
/begin CHARACTERISTIC Tra_rVn2L_C "Parameter für minimales Übersetzungsverhältnis Gang 2" VALUE 0x80061280 Val_Ws16 0.6553500 VelToN -0.3276800 0.3276700 FORMAT "%9.7" /end CHARACTERISTIC
/begin CHARACTERISTIC Tra_rVn2To3Des_C "Parameter für Übersetzungsverhältnis vom 2. in den 3. Gang" VALUE 0x80061282 Val_Ws16 0.6553500 VelToN -0.3276800 0.3276700 FORMAT "%9.7" /end CHARACTERISTIC
/begin CHARACTERISTIC Tra_rVn3H_C "Parameter für maximales Übersetzungsverhältnis Gang 3" VALUE 0x80061284 Val_Ws16 0.6553500 VelToN -0.3276800 0.3276700 FORMAT "%9.7" /end CHARACTERISTIC
/begin CHARACTERISTIC Tra_rVn3L_C "Parameter für minimales Übersetzungsverhältnis Gang 3" VALUE 0x80061286 Val_Ws16 0.6553500 VelToN -0.3276800 0.3276700 FORMAT "%9.7" /end CHARACTERISTIC
/begin CHARACTERISTIC Tra_rVn3To4Des_C "Parameter für Übersetzungsverhältnis vom 3. in den 4. Gang" VALUE 0x80061288 Val_Ws16 0.6553500 VelToN -0.3276800 0.3276700 FORMAT "%9.7" /end CHARACTERISTIC
/begin CHARACTERISTIC Tra_rVn4H_C "Parameter für maximales Übersetzungsverhältnis Gang 4" VALUE 0x8006128A Val_Ws16 0.6553500 VelToN -0.3276800 0.3276700 FORMAT "%9.7" /end CHARACTERISTIC
/begin CHARACTERISTIC Tra_rVn4L_C "Parameter für minimales Übersetzungsverhältnis Gang 4" VALUE 0x8006128C Val_Ws16 0.6553500 VelToN -0.3276800 0.3276700 FORMAT "%9.7" /end CHARACTERISTIC
/begin CHARACTERISTIC Tra_rVn4To5Des_C "Parameter für Übersetzungsverhältnis vom 4. in den 5. Gang" VALUE 0x8006128E Val_Ws16 0.6553500 VelToN -0.3276800 0.3276700 FORMAT "%9.7" /end CHARACTERISTIC
/begin CHARACTERISTIC Tra_rVn5H_C "Parameter für maximales Übersetzungsverhältnis Gang 5" VALUE 0x80061290 Val_Ws16 0.6553500 VelToN -0.3276800 0.3276700 FORMAT "%9.7" /end CHARACTERISTIC
/begin CHARACTERISTIC Tra_rVn5L_C "Parameter für minimales Übersetzungsverhältnis Gang 5" VALUE 0x80061292 Val_Ws16 0.6553500 VelToN -0.3276800 0.3276700 FORMAT "%9.7" /end CHARACTERISTIC
/begin CHARACTERISTIC Tra_rVn5To6Des_C "Parameter für Übersetzungsverhältnis vom 5. in den 6. Gang" VALUE 0x80061294 Val_Ws16 0.6553500 VelToN -0.3276800 0.3276700 FORMAT "%9.7" /end CHARACTERISTIC
/begin CHARACTERISTIC Tra_rVn6H_C "Parameter für maximales Übersetzungsverhältnis Gang 6" VALUE 0x80061296 Val_Ws16 0.6553500 VelToN -0.3276800 0.3276700 FORMAT "%9.7" /end CHARACTERISTIC
/begin CHARACTERISTIC Tra_rVn6L_C "Parameter für minimales Übersetzungsverhältnis Gang 6" VALUE 0x80061298 Val_Ws16 0.6553500 VelToN -0.3276800 0.3276700 FORMAT "%9.7" /end CHARACTERISTIC
/begin CHARACTERISTIC Tra_rVnRH_C "Parameter für maximales Übersetzungsverhältnis Gang R" VALUE 0x8006129A Val_Ws16 0.6553500 VelToN -0.3276800 0.3276700 FORMAT "%9.7" /end CHARACTERISTIC
/begin CHARACTERISTIC Tra_rVnRL_C "Parameter für minimales Übersetzungsverhältnis Gang R" VALUE 0x8006129C Val_Ws16 0.6553500 VelToN -0.3276800 0.3276700 FORMAT "%9.7" /end CHARACTERISTIC
/begin CHARACTERISTIC Tra_Spa.tiHiLo_C "/" VALUE 0x80061572 Kw_Ws16 655350.0 TimeDeb -327680.0 327670.0 /end CHARACTERISTIC
/begin CHARACTERISTIC Tra_Spa.tiLoHi_C "/" VALUE 0x80061574 Kw_Ws16 655350.0 TimeDeb -327680.0 327670.0 /end CHARACTERISTIC
/begin CHARACTERISTIC Tra_stCoEOMASTAdptDemMsk_C "" VALUE 0x80061514 Val_Wu32 4294967295.00 OneToOne 0.00 4294967295.00 /end CHARACTERISTIC
/begin CHARACTERISTIC Tra_stConvBrk_C "" VALUE 0x80061518 Val_Wu8 1.000 OneToOne 0.00 1.000 EXTENDED_LIMITS 0.00 255.0 /end CHARACTERISTIC
/begin CHARACTERISTIC Tra_stGearbxHtgUpActMsk_C "" VALUE 0x80061519 Val_Wu8 255.0 OneToOne 0.00 255.0 /end CHARACTERISTIC
/begin CHARACTERISTIC Tra_stGearHtgUpAct_C "" VALUE 0x8006151A Val_Wu8 255.0 OneToOne 0.00 255.0 /end CHARACTERISTIC
/begin CHARACTERISTIC Tra_stLevPosD_C "Parameter für Wählhebelposition D" VALUE 0x8006129E Val_Wu8 255.0 OneToOne 0.00 255.0 /end CHARACTERISTIC
/begin CHARACTERISTIC Tra_stPrtCfg_C "Konfiguration CAN" VALUE 0x800612FA Val_Wu8 255.0 OneToOne 0.00 255.0 /end CHARACTERISTIC
/begin CHARACTERISTIC Tra_stTraType_C "Parameter Getriebetyp" VALUE 0x800615C0 Kw_Wu8 255.0 OneToOne 0.00 255.0 /end CHARACTERISTIC
/begin CHARACTERISTIC Tra_stTrqDemMsk_C "" VALUE 0x8006151C Val_Wu16 65535.00 OneToOne 0.00 65535.00 /end CHARACTERISTIC
/begin CHARACTERISTIC Tra_swtAdj_C "" VALUE 0x800612FB Val_Wu8 1.000 OneToOne 0.00 1.000 EXTENDED_LIMITS 0.00 255.0 /end CHARACTERISTIC
/begin CHARACTERISTIC Tra_swtDfl_C "" VALUE 0x8006129F Val_Wu8 255.0 OneToOne 0.00 255.0 /end CHARACTERISTIC
/begin CHARACTERISTIC Tra_swtDrvAway_C "" VALUE 0x800612FC Val_Wu8 1.000 OneToOne 0.00 1.000 EXTENDED_LIMITS 0.00 255.0 /end CHARACTERISTIC
/begin CHARACTERISTIC Tra_swtLevPosSlct_CA "Kennfeld für Gangerkennung über CAN oder individuelle Berechnung" VAL_BLK 0x800612A0 ValA_Wu8 255.0 OneToOne 0.00 255.0 NUMBER 8 /end CHARACTERISTIC
/begin CHARACTERISTIC Tra_swtNTSC_C "" VALUE 0x8006151E Val_Wu8 1.000 OneToOne 0.00 1.000 EXTENDED_LIMITS 0.00 255.0 /end CHARACTERISTIC
/begin CHARACTERISTIC Tra_swtRmpPtd_C "Schalter für Rampenfunktionalität" VALUE 0x8006158C Val_Wu8 255.0 OneToOne 0.00 255.0 /end CHARACTERISTIC
/begin CHARACTERISTIC Tra_swtTypeSlct_CA "Kennfeld für Getriebetyp über CAN oder individuelle Erkennung" VAL_BLK 0x800612A8 ValA_Wu8 255.0 OneToOne 0.00 255.0 NUMBER 8 /end CHARACTERISTIC
/begin CHARACTERISTIC Tra_tClntDes_C "Parameter Kühlmitteltemperatur-Sollwert" VALUE 0x80061240 Val_Ws16 6553.500 Temp_Cels -3549.940 3003.560 /end CHARACTERISTIC
/begin CHARACTERISTIC Tra_tiASTDes_C "Ersatzwert für Synchronisationszeit" VALUE 0x80061520 Val_Ws16 655.3500 Time_s -327.6800 327.6700 /end CHARACTERISTIC
/begin CHARACTERISTIC Tra_tiDebCoEOMAST.tiHiLo_C "/" VALUE 0x80061522 Kw_Ws16 655350.0 TimeDeb -327680.0 327670.0 /end CHARACTERISTIC
/begin CHARACTERISTIC Tra_tiDebCoEOMAST.tiLoHi_C "/" VALUE 0x80061524 Kw_Ws16 655350.0 TimeDeb -327680.0 327670.0 /end CHARACTERISTIC
/begin CHARACTERISTIC Tra_tiDebCrCtlReq.tiHiLo_C "Entprellzeit CrCtl-Anforderung/" VALUE 0x80061526 Kw_Ws16 655350.0 TimeDeb -327680.0 327670.0 /end CHARACTERISTIC
/begin CHARACTERISTIC Tra_tiDebCrCtlReq.tiLoHi_C "Entprellzeit CrCtl-Anforderung/" VALUE 0x80061528 Kw_Ws16 655350.0 TimeDeb -327680.0 327670.0 /end CHARACTERISTIC
/begin CHARACTERISTIC Tra_tiNPT1_C "Filterzeitkonstante zur Vorfilterung der Motordrehzahl für die v/n-Berechnung" VALUE 0x800612B0 Val_Ws32 4294.9672940 TimeDelay_s 0.000002000000001 4294.9672960 FORMAT "%12.7" /end CHARACTERISTIC
/begin CHARACTERISTIC Tra_tiV2NPT1_C "Filterzeitkonstante zur Filterung des v/n-Verhältnisses" VALUE 0x800612B4 Val_Ws32 4294.9672940 TimeDelay_s 0.000002000000001 4294.9672960 FORMAT "%12.7" /end CHARACTERISTIC
/begin CHARACTERISTIC Tra_tOilDfl_C "Applikativer Defaultwert der Getriebeöltemperatur" VALUE 0x800612B8 Val_Ws16 6553.500 Temp_Cels -3549.940 3003.560 /end CHARACTERISTIC
/begin CHARACTERISTIC Tra_trqDesMaxTrq_CUR "Anfahrkennlinie EGS Eingriff" CURVE 0x8006158E Kl_Xs16_Ws16 6553.500 Trq -3276.800 3276.700
 /begin AXIS_DESCR STD_AXIS Epm_nEng EngN 10 -16384.00 16383.50 DEPOSIT ABSOLUTE /end AXIS_DESCR
/end CHARACTERISTIC
/begin CHARACTERISTIC Tra_trqDesMax_C "applizierbares maximales Wunschmoment" VALUE 0x800615B8 Val_Ws16 6553.500 Trq -3276.800 3276.700 /end CHARACTERISTIC
/begin CHARACTERISTIC Tra_trqDesMin_C "applizierbares minimales Wunschmoment" VALUE 0x800615BA Val_Ws16 6553.500 Trq -3276.800 3276.700 /end CHARACTERISTIC
/begin CHARACTERISTIC Tra_trqInMax_C "Allgemeiner Momenten-Maximalwert" VALUE 0x800612FE Val_Ws16 6553.500 Trq -3276.800 3276.700 /end CHARACTERISTIC
/begin CHARACTERISTIC Tra_trqLiGovMin_C "" VALUE 0x8006152A Val_Ws16 6553.500 Trq -3276.800 3276.700 /end CHARACTERISTIC
/begin CHARACTERISTIC Tra_trqLos_C "Parameter Getriebeverlustmoment" VALUE 0x800612C0 Kw_Ws16 6553.500 Trq -3276.800 3276.700 /end CHARACTERISTIC
/begin CHARACTERISTIC Tra_trqMaxErr_CUR "" CURVE 0x80061300 Kl_Xs16_Ws16 1000.000 Trq 0.00 1000.000 EXTENDED_LIMITS -3276.800 3276.700
 /begin AXIS_DESCR STD_AXIS Epm_nEng EngN 10 0.00 6000.000 EXTENDED_LIMITS -16384.00 16383.50 DEPOSIT ABSOLUTE /end AXIS_DESCR
/end CHARACTERISTIC
/begin CHARACTERISTIC Tra_trqMaxGear1_CUR "Kennlinie (n/trq) Gang 1" CURVE 0x8006132A Cur_Xs16Ws16 6553.500 Trq -3276.800 3276.700
 /begin AXIS_DESCR STD_AXIS Epm_nEng EngN 8 -16384.00 16383.50 DEPOSIT ABSOLUTE /end AXIS_DESCR
/end CHARACTERISTIC
/begin CHARACTERISTIC Tra_trqMaxGear2_CUR "Kennlinie (n/trq) Gang 2" CURVE 0x8006134C Cur_Xs16Ws16 6553.500 Trq -3276.800 3276.700
 /begin AXIS_DESCR STD_AXIS Epm_nEng EngN 8 -16384.00 16383.50 DEPOSIT ABSOLUTE /end AXIS_DESCR
/end CHARACTERISTIC
/begin CHARACTERISTIC Tra_trqMaxGear3_CUR "Kennlinie (n/trq) Gang 3" CURVE 0x8006136E Cur_Xs16Ws16 6553.500 Trq -3276.800 3276.700
 /begin AXIS_DESCR STD_AXIS Epm_nEng EngN 8 -16384.00 16383.50 DEPOSIT ABSOLUTE /end AXIS_DESCR
/end CHARACTERISTIC
/begin CHARACTERISTIC Tra_trqMaxGear4_CUR "Kennlinie (n/trq) Gang 4" CURVE 0x80061390 Cur_Xs16Ws16 6553.500 Trq -3276.800 3276.700
 /begin AXIS_DESCR STD_AXIS Epm_nEng EngN 8 -16384.00 16383.50 DEPOSIT ABSOLUTE /end AXIS_DESCR
/end CHARACTERISTIC
/begin CHARACTERISTIC Tra_trqMaxGear5_CUR "Kennlinie (n/trq) Gang 5" CURVE 0x800613B2 Cur_Xs16Ws16 6553.500 Trq -3276.800 3276.700
 /begin AXIS_DESCR STD_AXIS Epm_nEng EngN 8 -16384.00 16383.50 DEPOSIT ABSOLUTE /end AXIS_DESCR
/end CHARACTERISTIC
/begin CHARACTERISTIC Tra_trqMaxGear6_CUR "Kennlinie (n/trq) Gang 6" CURVE 0x800613D4 Cur_Xs16Ws16 6553.500 Trq -3276.800 3276.700
 /begin AXIS_DESCR STD_AXIS Epm_nEng EngN 8 -16384.00 16383.50 DEPOSIT ABSOLUTE /end AXIS_DESCR
/end CHARACTERISTIC
/begin CHARACTERISTIC Tra_trqMaxGearR_CUR "Kennlinie (n/trq) Gang R" CURVE 0x800613F6 Cur_Xs16Ws16 6553.500 Trq -3276.800 3276.700
 /begin AXIS_DESCR STD_AXIS Epm_nEng EngN 8 -16384.00 16383.50 DEPOSIT ABSOLUTE /end AXIS_DESCR
/end CHARACTERISTIC
/begin CHARACTERISTIC Tra_vHtgUpActMax_C "" VALUE 0x8006152C Val_Ws16 655.3500 Vel -327.6800 327.6700 /end CHARACTERISTIC
/begin CHARACTERISTIC Tra_vLimRTra_C "" VALUE 0x800612BA Val_Ws16 655.3500 Vel -327.6800 327.6700 /end CHARACTERISTIC
/begin CHARACTERISTIC Tra_vMinTrqRed_C "applizierbare Motordrehzahl" VALUE 0x800615BC Val_Ws16 655.3500 Vel -327.6800 327.6700 /end CHARACTERISTIC
/begin CHARACTERISTIC Tra_vMin_C "Minimale Fahrzeuggeschwindigkeit zur Gangerkennung" VALUE 0x800612BC Val_Ws16 655.3500 Vel -327.6800 327.6700 /end CHARACTERISTIC
/begin CHARACTERISTIC TrbChLP_Pwm.tiPer_C "/" VALUE 0x800696B6 Kw_Ws16 9.900000 Period 0.1000000 10.00000 FORMAT "%8.5" EXTENDED_LIMITS -3276.800 3276.700 /end CHARACTERISTIC
/begin CHARACTERISTIC TrbChLP_Pwm.stLvl_C "/" VALUE 0x800696B8 Kw_Wu8 1.000 OneToOne 0.00 1.000 EXTENDED_LIMITS 0.00 255.0 /end CHARACTERISTIC
/begin CHARACTERISTIC TrbChLP_Pwm.rMaxDty_C "/" VALUE 0x800696BA Kw_Ws16 100.0000 DtyCyc 0.00 100.0000 EXTENDED_LIMITS -327.6800 327.6700 /end CHARACTERISTIC
/begin CHARACTERISTIC TrbChLP_Pwm.rPerUn_C "/" VALUE 0x800696BC Kw_Ws16 3276.700 Period 0.00 3276.700 FORMAT "%8.3" EXTENDED_LIMITS -3276.800 3276.700 /end CHARACTERISTIC
/begin CHARACTERISTIC TrbChLP_Pwm.tiPh_C "/" VALUE 0x800696BE Kw_Ws16 65535.00 OneToOne -32768.00 32767.00 /end CHARACTERISTIC
/begin CHARACTERISTIC TrbChLP_PwmOut.rMin_C "/" VALUE 0x800696C0 Kw_Ws16 100.0000 DtyCyc 0.00 100.0000 EXTENDED_LIMITS -327.6800 327.6700 /end CHARACTERISTIC
/begin CHARACTERISTIC TrbChLP_PwmOut.rMax_C "/" VALUE 0x800696C2 Kw_Ws16 100.0000 DtyCyc 0.00 100.0000 EXTENDED_LIMITS -327.6800 327.6700 /end CHARACTERISTIC
/begin CHARACTERISTIC TrbChLP_PwmOut.tiBtwTstSCB_C "/" VALUE 0x800696C4 Kw_Ws16 1000.000 Time_ms 0.00 1000.000 EXTENDED_LIMITS -327680.0 327670.0 /end CHARACTERISTIC
/begin CHARACTERISTIC TrbChLP_PwmOut.tiBtwTstOT_C "/" VALUE 0x800696C6 Kw_Ws16 1000.000 Time_s 0.00 1000.000 EXTENDED_LIMITS -327.6800 327.6700 /end CHARACTERISTIC
/begin CHARACTERISTIC TrbChLP_PwmOut.numTstMax_C "/" VALUE 0x800696C8 Kw_Wu16 65535.00 OneToOne 0.00 65535.00 /end CHARACTERISTIC
/begin CHARACTERISTIC TrbChLP_PwmOut.swtBattCor_C "/" VALUE 0x800696CA Kw_Wu8 1.000 OneToOne 0.00 1.000 EXTENDED_LIMITS 0.00 255.0 /end CHARACTERISTIC
/begin CHARACTERISTIC TrbChLP_PwmOut.swtPsInv_C "/" VALUE 0x800696CB Kw_Wu8 255.0 OneToOne 0.00 255.0 /end CHARACTERISTIC
/begin CHARACTERISTIC TrbChLP_rCnv_CUR "" CURVE 0x800696CC Cur_Xs16Ws16 100.0000 DtyCyc 0.00 100.0000 EXTENDED_LIMITS -327.6800 327.6700
 /begin AXIS_DESCR STD_AXIS TrbChLP_r Prc 8 -400.0000 399.9878 DEPOSIT ABSOLUTE /end AXIS_DESCR
/end CHARACTERISTIC
/begin CHARACTERISTIC TrbChLP_rPsDisbl_C "" VALUE 0x800615CC Val_Ws16 100.0000 DtyCyc 0.00 100.0000 EXTENDED_LIMITS -327.6800 327.6700 /end CHARACTERISTIC
/begin CHARACTERISTIC TrbChLP_stPsDiaDisbl_C "" VALUE 0x800696EE Val_Wu8 255.0 OneToOne 0.00 255.0 /end CHARACTERISTIC
/begin CHARACTERISTIC TrbChLP_stPsDisbl_C "" VALUE 0x800696EF Val_Wu8 255.0 OneToOne 0.00 255.0 /end CHARACTERISTIC
/begin CHARACTERISTIC TrbCh_4WinDiagDeb.ct4WinErr1DebDef_C "/" VALUE 0x800615CE Kw_Wu8 255.0 OneToOne 0.00 255.0 /end CHARACTERISTIC
/begin CHARACTERISTIC TrbCh_4WinDiagDeb.ct4WinErr2DebDef_C "/" VALUE 0x800615CF Kw_Wu8 255.0 OneToOne 0.00 255.0 /end CHARACTERISTIC
/begin CHARACTERISTIC TrbCh_4WinDiagDeb.ct4WinErr3DebDef_C "/" VALUE 0x800615D0 Kw_Wu8 255.0 OneToOne 0.00 255.0 /end CHARACTERISTIC
/begin CHARACTERISTIC TrbCh_4WinDiagDeb.ct4WinErr4DebDef_C "/" VALUE 0x800615D1 Kw_Wu8 255.0 OneToOne 0.00 255.0 /end CHARACTERISTIC
/begin CHARACTERISTIC TrbCh_4WinDiagDeb.ti4WinErrDebDef_C "/" VALUE 0x800615D2 Kw_Wu16 655350.0 Time_ms 0.00 655350.0 /end CHARACTERISTIC
/begin CHARACTERISTIC TrbCh_4WinSigDur.tiErr1Min_C "/" VALUE 0x800615D4 Kw_Ws16 655350.0 Time_ms -327680.0 327670.0 /end CHARACTERISTIC
/begin CHARACTERISTIC TrbCh_4WinSigDur.tiErr1Max_C "/" VALUE 0x800615D6 Kw_Ws16 655350.0 Time_ms -327680.0 327670.0 /end CHARACTERISTIC
/begin CHARACTERISTIC TrbCh_4WinSigDur.tiErr2Min_C "/" VALUE 0x800615D8 Kw_Ws16 655350.0 Time_ms -327680.0 327670.0 /end CHARACTERISTIC
/begin CHARACTERISTIC TrbCh_4WinSigDur.tiErr2Max_C "/" VALUE 0x800615DA Kw_Ws16 655350.0 Time_ms -327680.0 327670.0 /end CHARACTERISTIC
/begin CHARACTERISTIC TrbCh_4WinSigDur.tiErr3Min_C "/" VALUE 0x800615DC Kw_Ws16 655350.0 Time_ms -327680.0 327670.0 /end CHARACTERISTIC
/begin CHARACTERISTIC TrbCh_4WinSigDur.tiErr3Max_C "/" VALUE 0x800615DE Kw_Ws16 655350.0 Time_ms -327680.0 327670.0 /end CHARACTERISTIC
/begin CHARACTERISTIC TrbCh_4WinSigDur.tiErr4Min_C "/" VALUE 0x800615E0 Kw_Ws16 655350.0 Time_ms -327680.0 327670.0 /end CHARACTERISTIC
/begin CHARACTERISTIC TrbCh_4WinSigDur.tiErr4Max_C "/" VALUE 0x800615E2 Kw_Ws16 655350.0 Time_ms -327680.0 327670.0 /end CHARACTERISTIC
/begin CHARACTERISTIC TrbCh_Pwm.tiPer_C "/" VALUE 0x800615E4 Kw_Ws16 9.900000 Period 0.1000000 10.00000 FORMAT "%8.5" EXTENDED_LIMITS -3276.800 3276.700 /end CHARACTERISTIC
/begin CHARACTERISTIC TrbCh_Pwm.stLvl_C "/" VALUE 0x800615E6 Kw_Wu8 1.000 OneToOne 0.00 1.000 EXTENDED_LIMITS 0.00 255.0 /end CHARACTERISTIC
/begin CHARACTERISTIC TrbCh_Pwm.rMaxDty_C "/" VALUE 0x800615E8 Kw_Ws16 100.0000 DtyCyc 0.00 100.0000 EXTENDED_LIMITS -327.6800 327.6700 /end CHARACTERISTIC
/begin CHARACTERISTIC TrbCh_Pwm.rPerUn_C "/" VALUE 0x800615EA Kw_Ws16 3276.700 Period 0.00 3276.700 FORMAT "%8.3" EXTENDED_LIMITS -3276.800 3276.700 /end CHARACTERISTIC
/begin CHARACTERISTIC TrbCh_Pwm.tiPh_C "/" VALUE 0x800615EC Kw_Ws16 65535.00 OneToOne -32768.00 32767.00 /end CHARACTERISTIC
/begin CHARACTERISTIC TrbCh_PwmOut.rMin_C "/" VALUE 0x800615EE Kw_Ws16 100.0000 DtyCyc 0.00 100.0000 EXTENDED_LIMITS -327.6800 327.6700 /end CHARACTERISTIC
/begin CHARACTERISTIC TrbCh_PwmOut.rMax_C "/" VALUE 0x800615F0 Kw_Ws16 100.0000 DtyCyc 0.00 100.0000 EXTENDED_LIMITS -327.6800 327.6700 /end CHARACTERISTIC
/begin CHARACTERISTIC TrbCh_PwmOut.tiBtwTstSCB_C "/" VALUE 0x800615F2 Kw_Ws16 1000.000 Time_ms 0.00 1000.000 EXTENDED_LIMITS -327680.0 327670.0 /end CHARACTERISTIC
/begin CHARACTERISTIC TrbCh_PwmOut.tiBtwTstOT_C "/" VALUE 0x800615F4 Kw_Ws16 1000.000 Time_s 0.00 1000.000 EXTENDED_LIMITS -327.6800 327.6700 /end CHARACTERISTIC
/begin CHARACTERISTIC TrbCh_PwmOut.numTstMax_C "/" VALUE 0x800615F6 Kw_Wu16 65535.00 OneToOne 0.00 65535.00 /end CHARACTERISTIC
/begin CHARACTERISTIC TrbCh_PwmOut.swtBattCor_C "/" VALUE 0x800615F8 Kw_Wu8 1.000 OneToOne 0.00 1.000 EXTENDED_LIMITS 0.00 255.0 /end CHARACTERISTIC
/begin CHARACTERISTIC TrbCh_PwmOut.swtPsInv_C "/" VALUE 0x800615F9 Kw_Wu8 255.0 OneToOne 0.00 255.0 /end CHARACTERISTIC
/begin CHARACTERISTIC TrbCh_rCnv_CUR "" CURVE 0x800615FA Cur_Xs16Ws16 100.0000 DtyCyc 0.00 100.0000 EXTENDED_LIMITS -327.6800 327.6700
 /begin AXIS_DESCR STD_AXIS TrbCh_r Prc 11 -400.0000 399.9878 DEPOSIT ABSOLUTE /end AXIS_DESCR
/end CHARACTERISTIC
/begin CHARACTERISTIC TrbCh_rPsDisbl_C "" VALUE 0x80061628 Val_Ws16 100.0000 DtyCyc 0.00 100.0000 EXTENDED_LIMITS -327.6800 327.6700 /end CHARACTERISTIC
/begin CHARACTERISTIC TrbCh_rTransf_CUR "" CURVE 0x800615C2 Cur_Xs16Ws16 100.0000 Prc 0.00 100.0000 EXTENDED_LIMITS -400.0000 399.9878
 /begin AXIS_DESCR STD_AXIS TrbCh_rRaw DtyCyc 2 0.00 100.0000 EXTENDED_LIMITS -327.6800 327.6700 DEPOSIT ABSOLUTE /end AXIS_DESCR
/end CHARACTERISTIC
/begin CHARACTERISTIC TrbCh_stPsDiaDisbl_C "" VALUE 0x8006162A Val_Wu8 255.0 OneToOne 0.00 255.0 /end CHARACTERISTIC
/begin CHARACTERISTIC TrbCh_stPsDisbl_C "" VALUE 0x8006162B Val_Wu8 255.0 OneToOne 0.00 255.0 /end CHARACTERISTIC
/begin CHARACTERISTIC TrbCh_typ4WinDia_C "" VALUE 0x8006162C Val_Wu8 2.00000000000 Typ4WinDia 0.00 2.00000000000 FORMAT "%13.11" EXTENDED_LIMITS 0.00 3.00000000000 /end CHARACTERISTIC
/begin CHARACTERISTIC TSDa_tRadOutSubs_C "Ersatzwert für die Kühlmitteltemperatur am Kühleraustritt" VALUE 0x800610B0 Kw_Ws16 6553.500 Temp_Cels -3549.940 3003.560 /end CHARACTERISTIC
/begin CHARACTERISTIC UDC_DebUTnkLvl.tiHiLo_C "/" VALUE 0x80061770 Kw_Ws16 5000.000 TimeDeb 0.00 5000.000 EXTENDED_LIMITS -327680.0 327670.0 /end CHARACTERISTIC
/begin CHARACTERISTIC UDC_DebUTnkLvl.tiLoHi_C "/" VALUE 0x80061772 Kw_Ws16 5000.000 TimeDeb 0.00 5000.000 EXTENDED_LIMITS -327680.0 327670.0 /end CHARACTERISTIC
/begin CHARACTERISTIC UDC_dmRatio2Mass_CUR "Kennlinie zur Umwandlung des Tastverhältnisses in den tatsächlich dosierten Massendurchsatz" CURVE 0x80061694 Cur_Xs16Ws16 6553.500 SCR_Dm01 -3276.800 3276.700 FORMAT "%8.3"
 /begin AXIS_DESCR STD_AXIS UDosVlv_rPs DtyCyc 10 0.00 100.0000 EXTENDED_LIMITS -327.6800 327.6700 DEPOSIT ABSOLUTE /end AXIS_DESCR
/end CHARACTERISTIC
/begin CHARACTERISTIC UDC_dmRdcAgCurrLim_C "Maximum für plausible Dosiermenge" VALUE 0x80061754 Val_Ws32 1500000.00000 SCR_Dm01 0.00 1500000.00000 FORMAT "%13.5" EXTENDED_LIMITS -214748364.800 214748364.700 /end CHARACTERISTIC
/begin CHARACTERISTIC UDC_dmRdcAgCurrMax_C "Obere Grenze für die aktuelle Dosiermenge" VALUE 0x80061758 Val_Ws32 1500000.00000 SCR_Dm01 0.00 1500000.00000 FORMAT "%13.5" EXTENDED_LIMITS -214748364.800 214748364.700 /end CHARACTERISTIC
/begin CHARACTERISTIC UDC_dmRdcAgCurrMin_C "Untere Grenze für die aktuelle Dosiermenge" VALUE 0x8006175C Val_Ws32 1500000.00000 SCR_Dm01 0.00 1500000.00000 FORMAT "%13.5" EXTENDED_LIMITS -214748364.800 214748364.700 /end CHARACTERISTIC
/begin CHARACTERISTIC UDC_dmRdcAgDes_C "" VALUE 0x80061760 Val_Ws16 3255.000 SCR_Dm01 0.00 3255.000 FORMAT "%8.3" EXTENDED_LIMITS -3276.800 3276.700 /end CHARACTERISTIC
/begin CHARACTERISTIC UDC_dmRdcAgMax_C "Obere Grenze für den Massendurchsatz" VALUE 0x800616BE Val_Ws16 3255.000 SCR_Dm01 0.00 3255.000 FORMAT "%8.3" EXTENDED_LIMITS -3276.800 3276.700 /end CHARACTERISTIC
/begin CHARACTERISTIC UDC_dmRdcAgMin_C "Untere Grenze für den Massendurchsatz" VALUE 0x800616C0 Val_Ws16 3255.000 SCR_Dm01 0.00 3255.000 FORMAT "%8.3" EXTENDED_LIMITS -3276.800 3276.700 /end CHARACTERISTIC
/begin CHARACTERISTIC UDC_facCnvMFl_C "Umrechnungsfaktor von g/s in mg/s" VALUE 0x80061762 Val_Ws16 1000.000 OneToOne 0.00 1000.000 EXTENDED_LIMITS -32768.00 32767.00 /end CHARACTERISTIC
/begin CHARACTERISTIC UDC_facKiRdcAg_C "Ki Faktor für den Integrator der Dosiermenge" VALUE 0x80061764 Val_Ws16 10.00000 SCR_Fact1000 0.00 10.00000 FORMAT "%8.5" EXTENDED_LIMITS -32.76800 32.76700 /end CHARACTERISTIC
/begin CHARACTERISTIC UDC_facPresCorr_CUR "Druckkompensationsfaktor für die Dosieranforderung" CURVE 0x800616C2 Cur_Xs16Ws16 10.00000 SCR_Fact1000 0.00 10.00000 FORMAT "%8.5" EXTENDED_LIMITS -32.76800 32.76700
 /begin AXIS_DESCR STD_AXIS SCR_pUPmpP Pres_hPa 10 0.00 3500.000 EXTENDED_LIMITS -32768.00 32767.00 DEPOSIT ABSOLUTE /end AXIS_DESCR
/end CHARACTERISTIC
/begin CHARACTERISTIC UDC_facQty2Qty_C "Umrechnungsfaktor um Eingangsgröße in mg/s umzurechnen" VALUE 0x80061766 Val_Ws16 1000.000 OneToOne 0.00 1000.000 EXTENDED_LIMITS -32768.00 32767.00 /end CHARACTERISTIC
/begin CHARACTERISTIC UDC_facRdcAgDvt_C "" VALUE 0x80061768 Val_Ws16 10.00000 SCR_Fact1000 0.00 10.00000 FORMAT "%8.5" EXTENDED_LIMITS -32.76800 32.76700 /end CHARACTERISTIC
/begin CHARACTERISTIC UDC_facUTnkLvlThres_C "" VALUE 0x80061774 Val_Ws16 1.000000 Fact 0.00 1.000000 EXTENDED_LIMITS -4.000000 3.999878 /end CHARACTERISTIC
/begin CHARACTERISTIC UDC_mDosQntRstDesVal_C "Wahl Initialisierungswert bei Voll oder Teilbetankung" VALUE 0x80061684 Val_Ws32 50000.0000000 SCR_Mass1000 0.00 50000.0000000 FORMAT "%13.7" EXTENDED_LIMITS -2147483.64800 2147483.64700 /end CHARACTERISTIC
/begin CHARACTERISTIC UDC_mRdcAgDes_C "" VALUE 0x8006176A Val_Wu16 65.00000 SCR_Mass1000 0.00 65.00000 FORMAT "%8.5" EXTENDED_LIMITS 0.00 65.53500 /end CHARACTERISTIC
/begin CHARACTERISTIC UDC_mRdcAgDosTmpQnt_C "Maximal eindosierte temporäre Menge an Reduktionsmittel (Threshold)" VALUE 0x80061688 Val_Ws16 32.00000 SCR_Mass1000 0.00 32.00000 FORMAT "%8.5" EXTENDED_LIMITS -32.76800 32.76700 /end CHARACTERISTIC
/begin CHARACTERISTIC UDC_mRdcAgLopFaultQnt_C "Fehldosiermenge bei Schleifendurchläufen infolge eines Druckverlustes" VALUE 0x8006168A Val_Ws16 32.00000 SCR_Mass1000 0.00 32.00000 FORMAT "%8.5" EXTENDED_LIMITS -32.76800 32.76700 /end CHARACTERISTIC
/begin CHARACTERISTIC UDC_mRdcAgReFlFaultQnt_C "Fehldosiermenge bei Befüllung des Systems" VALUE 0x8006168C Val_Ws16 32.00000 SCR_Mass1000 0.00 32.00000 FORMAT "%8.5" EXTENDED_LIMITS -32.76800 32.76700 /end CHARACTERISTIC
/begin CHARACTERISTIC UDC_mUTnkLvlRdcAgMax_C "Maximaler Tankinhalt" VALUE 0x80061778 Val_Ws32 50000.0000000 SCR_Mass1000 0.00 50000.0000000 FORMAT "%13.7" EXTENDED_LIMITS -2147483.64800 2147483.64700 /end CHARACTERISTIC
/begin CHARACTERISTIC UDC_mUTnkLvlRdcAgResv_C "Tankinhalt bei Reservefüllstand (WARNING LEVEL)" VALUE 0x8006177C Val_Ws32 15000.0000000 SCR_Mass1000 0.00 15000.0000000 FORMAT "%13.7" EXTENDED_LIMITS -2147483.64800 2147483.64700 /end CHARACTERISTIC
/begin CHARACTERISTIC UDC_numRepPresBuildUp_C "Schwelle gegen Anzahl der durchgeführten Druckaufbauversuche" VALUE 0x8006168E Val_Wu8 255.0 OneToOne 0.00 255.0 /end CHARACTERISTIC
/begin CHARACTERISTIC UDC_numUTnkLvlSmpl_C "" VALUE 0x80061780 Val_Ws16 3000.000 OneToOne 0.00 3000.000 EXTENDED_LIMITS -32768.00 32767.00 /end CHARACTERISTIC
/begin CHARACTERISTIC UDC_rDycAftrunEmpt_C "" VALUE 0x800616EC Val_Ws16 100.0000 DtyCyc 0.00 100.0000 EXTENDED_LIMITS -327.6800 327.6700 /end CHARACTERISTIC
/begin CHARACTERISTIC UDC_rDycDfl_C "Fester Wert des Tastverhältnisses für den Steller des Dosierventils" VALUE 0x800616EE Val_Ws16 100.0000 DtyCyc 0.00 100.0000 EXTENDED_LIMITS -327.6800 327.6700 /end CHARACTERISTIC
/begin CHARACTERISTIC UDC_rDycReFl_C "PWM % für Dosierventil im Unterzustand REFILL" VALUE 0x800616F0 Val_Ws16 100.0000 DtyCyc 0.00 100.0000 EXTENDED_LIMITS -327.6800 327.6700 /end CHARACTERISTIC
/begin CHARACTERISTIC UDC_rDycVtln_C "PWM % für Dosierventil im Unterzustand VENTILATION" VALUE 0x800616F2 Val_Ws16 100.0000 DtyCyc 0.00 100.0000 EXTENDED_LIMITS -327.6800 327.6700 /end CHARACTERISTIC
/begin CHARACTERISTIC UDC_rMass2Ratio_CUR "Kennlinie zur Umwandlung des Massendurchsatzes für die Dosierungsanforderung in das Tastverhältnis für den Steller im Zustand COSCR_METERINGCONTROL" CURVE 0x800616F4 Cur_Xs16Ws16 100.0000 DtyCyc 0.00 100.0000 EXTENDED_LIMITS -327.6800 327.6700
 /begin AXIS_DESCR STD_AXIS UDC_dmRdcAgDesLtd_mp SCR_Dm01 10 0.00 3255.000 FORMAT "%8.3" EXTENDED_LIMITS -3276.800 3276.700 DEPOSIT ABSOLUTE /end AXIS_DESCR
/end CHARACTERISTIC
/begin CHARACTERISTIC UDC_stRdcAgInteg_C "" VALUE 0x8006176C Val_Wu8 1.00000000000 DStgy_Compu_Switch_1 0.00 1.00000000000 FORMAT "%13.11" /end CHARACTERISTIC
/begin CHARACTERISTIC UDC_swtDosQntRst_C "Auswahlschalter für den Initailisierungswert von UDC_mRdcAgDosQnt" VALUE 0x8006168F Val_Wu8 2.00000000000 UDC_ResetState 0.00 2.00000000000 FORMAT "%13.11" /end CHARACTERISTIC
/begin CHARACTERISTIC UDC_swtDStgy_C "Auswahl für Dosieranforderung über CAN oder von der internen Dosierstrategie" VALUE 0x8006176D Val_Wu8 1.00000000000 UDC_Compu_Switch_1 0.00 1.00000000000 FORMAT "%13.11" /end CHARACTERISTIC
/begin CHARACTERISTIC UDC_swtSelectCAN_C "Typ der Dosieranforderung (Menge in mg/s oder aufintegrierte Masse)" VALUE 0x8006176E Val_Wu8 2.00000000000 UDC_CANSwitchState 0.00 2.00000000000 FORMAT "%13.11" /end CHARACTERISTIC
/begin CHARACTERISTIC UDC_swtSelectInput_C "Auswahlschalter für das Tastverhältnisund die Periodendauer im Zustand METERING_CONTROL" VALUE 0x8006171E Val_Wu8 1.00000000000 UDC_SwitchState 0.00 1.00000000000 FORMAT "%13.11" /end CHARACTERISTIC
/begin CHARACTERISTIC UDC_swtTestEna_C "" VALUE 0x8006176F Val_Wu8 1.00000000000 SCRAd_Compu_Switch_3 0.00 1.00000000000 FORMAT "%13.11" /end CHARACTERISTIC
/begin CHARACTERISTIC UDC_tiMass2Time_CUR "Kennlinie zur Umwandlung des Massendurchsatzes für die Dosierungsanforderung in die Zeitdauer für den Steller im Unterzustand METERINGCONTROL" CURVE 0x80061720 Cur_Xs16Ws16 1900.000 Period 100.0000 2000.000 FORMAT "%8.3" EXTENDED_LIMITS -3276.800 3276.700
 /begin AXIS_DESCR STD_AXIS UDC_dmRdcAgDesLtd_mp SCR_Dm01 10 0.00 3255.000 FORMAT "%8.3" EXTENDED_LIMITS -3276.800 3276.700 DEPOSIT ABSOLUTE /end AXIS_DESCR
/end CHARACTERISTIC
/begin CHARACTERISTIC UDC_tiPerAftrunEmpt_C "" VALUE 0x8006174A Val_Ws16 1900.000 Period 100.0000 2000.000 FORMAT "%8.3" EXTENDED_LIMITS -3276.800 3276.700 /end CHARACTERISTIC
/begin CHARACTERISTIC UDC_tiPerDfl_C "Fester Wert der Dauer für den Steller des Dosierventils" VALUE 0x8006174C Val_Ws16 1900.000 Period 100.0000 2000.000 FORMAT "%8.3" EXTENDED_LIMITS -3276.800 3276.700 /end CHARACTERISTIC
/begin CHARACTERISTIC UDC_tiPerReFl_C "Periodendauer für die Ansteuerung des Dosierventils im Unterzustand REFILL" VALUE 0x8006174E Val_Ws16 1900.000 Period 100.0000 2000.000 FORMAT "%8.3" EXTENDED_LIMITS -3276.800 3276.700 /end CHARACTERISTIC
/begin CHARACTERISTIC UDC_tiPerVtln_C "Zeitdauer für die Ansteuerung des Dosierventils im Unterzustand VENTILATION" VALUE 0x80061750 Val_Ws16 1900.000 Period 100.0000 2000.000 FORMAT "%8.3" EXTENDED_LIMITS -3276.800 3276.700 /end CHARACTERISTIC
/begin CHARACTERISTIC UDC_tiReFlMin_C "Schwelle - Abfrage: Wurde das System im letztem REFILL befüllt oder nicht?" VALUE 0x80061690 Val_Wu16 655350.0 Time_ms 0.00 655350.0 /end CHARACTERISTIC
/begin CHARACTERISTIC UDC_tiSetPExt_C "" VALUE 0x80061752 Val_Ws16 1900.000 Period 100.0000 2000.000 FORMAT "%8.3" EXTENDED_LIMITS -3276.800 3276.700 /end CHARACTERISTIC
/begin CHARACTERISTIC UDosVlv_DigOut.tiBtwTstSCB_C "/" VALUE 0x80061784 Kw_Ws16 1000.000 Time_ms 0.00 1000.000 EXTENDED_LIMITS -327680.0 327670.0 /end CHARACTERISTIC
/begin CHARACTERISTIC UDosVlv_DigOut.tiBtwTstOT_C "/" VALUE 0x80061786 Kw_Ws16 1000.000 Time_s 0.00 1000.000 EXTENDED_LIMITS -327.6800 327.6700 /end CHARACTERISTIC
/begin CHARACTERISTIC UDosVlv_DigOut.numTstMax_C "/" VALUE 0x80061788 Kw_Wu16 65535.00 OneToOne 0.00 65535.00 /end CHARACTERISTIC
/begin CHARACTERISTIC UDosVlv_PwmOut.rMin_C "/" VALUE 0x8006178A Kw_Ws16 100.0000 DtyCyc 0.00 100.0000 EXTENDED_LIMITS -327.6800 327.6700 /end CHARACTERISTIC
/begin CHARACTERISTIC UDosVlv_PwmOut.rMax_C "/" VALUE 0x8006178C Kw_Ws16 100.0000 DtyCyc 0.00 100.0000 EXTENDED_LIMITS -327.6800 327.6700 /end CHARACTERISTIC
/begin CHARACTERISTIC UDosVlv_PwmOut.tiBtwTstSCB_C "/" VALUE 0x8006178E Kw_Ws16 1000.000 Time_ms 0.00 1000.000 EXTENDED_LIMITS -327680.0 327670.0 /end CHARACTERISTIC
/begin CHARACTERISTIC UDosVlv_PwmOut.tiBtwTstOT_C "/" VALUE 0x80061790 Kw_Ws16 327.6700 Time_s 0.00 327.6700 EXTENDED_LIMITS -327.6800 327.6700 /end CHARACTERISTIC
/begin CHARACTERISTIC UDosVlv_PwmOut.numTstMax_C "/" VALUE 0x80061792 Kw_Wu16 65535.00 OneToOne 0.00 65535.00 /end CHARACTERISTIC
/begin CHARACTERISTIC UDosVlv_PwmOut.swtBattCor_C "/" VALUE 0x80061794 Kw_Wu8 1.000 OneToOne 0.00 1.000 EXTENDED_LIMITS 0.00 255.0 /end CHARACTERISTIC
/begin CHARACTERISTIC UDosVlv_PwmOut.swtPsInv_C "/" VALUE 0x80061795 Kw_Wu8 255.0 OneToOne 0.00 255.0 /end CHARACTERISTIC
/begin CHARACTERISTIC UDosVlv_rDycCnv_CUR "" CURVE 0x80061796 Cur_Xs16Ws16 100.0000 DtyCyc 0.00 100.0000 EXTENDED_LIMITS -327.6800 327.6700
 /begin AXIS_DESCR STD_AXIS UDosVlv_rDyc_mp DtyCyc 16 0.05000000 100.0000 EXTENDED_LIMITS -327.6800 327.6700 DEPOSIT ABSOLUTE /end AXIS_DESCR
/end CHARACTERISTIC
/begin CHARACTERISTIC UDosVlv_rPsDisbl_C "Tastverhältnis bei deaktivierter Endstufe" VALUE 0x800617D8 Val_Ws16 655.3500 DtyCyc -327.6800 327.6700 /end CHARACTERISTIC
/begin CHARACTERISTIC UDosVlv_rPwmOutMaxDty_C "" VALUE 0x800617DA Val_Ws16 100.0000 DtyCyc 0.00 100.0000 EXTENDED_LIMITS -327.6800 327.6700 /end CHARACTERISTIC
/begin CHARACTERISTIC UDosVlv_rPwmOutPerUn_C "" VALUE 0x800617DC Val_Ws16 32767.00 OneToOne 0.00 32767.00 EXTENDED_LIMITS -32768.00 32767.00 /end CHARACTERISTIC
/begin CHARACTERISTIC UDosVlv_stPsDiaDisbl_C "Maske zur Deaktivierung der Endstufendiagnose" VALUE 0x800617DE Val_Wu8 255.0 OneToOne 0.00 255.0 /end CHARACTERISTIC
/begin CHARACTERISTIC UDosVlv_stPsDisbl_C "Maske zur Deaktivierung der Endstufe" VALUE 0x800617DF Val_Wu8 255.0 OneToOne 0.00 255.0 /end CHARACTERISTIC
/begin CHARACTERISTIC UDosVlv_stPwmOutLvl_C "" VALUE 0x800617E0 Val_Wu8 1.000 OneToOne 0.00 1.000 EXTENDED_LIMITS 0.00 255.0 /end CHARACTERISTIC
/begin CHARACTERISTIC UDosVlv_tiPwmOutPh_C "" VALUE 0x800617E2 Val_Ws16 65535.00 OneToOne -32768.00 32767.00 /end CHARACTERISTIC
/begin CHARACTERISTIC UHC_facUTnkTmrDfrstSlp_C "Steigung der DEFROSTING Kennlinie" VALUE 0x800617E4 Val_Ws16 30000.00 SCR_s_p_K -30000.00 0.00 FORMAT "%8.2" EXTENDED_LIMITS -32768.00 32767.00 /end CHARACTERISTIC
/begin CHARACTERISTIC UHC_facUTnkTmrOnSlp_C "Steigung der HEATING Kennlinie" VALUE 0x800617E6 Val_Ws16 30000.00 SCR_s_p_K -30000.00 0.00 FORMAT "%8.2" EXTENDED_LIMITS -32768.00 32767.00 /end CHARACTERISTIC
/begin CHARACTERISTIC UHC_stTstEnf_C "Schalter für erzwungenen Heizungstest" VALUE 0x800617E8 Val_Wu8 1.000 OneToOne 0.00 1.000 EXTENDED_LIMITS 0.00 255.0 /end CHARACTERISTIC
/begin CHARACTERISTIC UHC_tEnvTempMax_C "Minimale Umgebungstemperaturschwelle" VALUE 0x800617EA Val_Ws16 100.0000 Temp_Cels -50.04000 49.96000 EXTENDED_LIMITS -3549.940 3003.560 /end CHARACTERISTIC
/begin CHARACTERISTIC UHC_tEnvTempMin_C "Maximale Umgebungstemperaturschwelle" VALUE 0x800617EC Val_Ws16 100.0000 Temp_Cels -50.04000 49.96000 EXTENDED_LIMITS -3549.940 3003.560 /end CHARACTERISTIC
/begin CHARACTERISTIC UHC_tiC1ClgTmr_C "Abkühlzeit" VALUE 0x800617F0 Val_Ws32 3200.00000000 SCR_Time10 0.00 3200.00000000 FORMAT "%13.8" EXTENDED_LIMITS -214748364.800 214748364.700 /end CHARACTERISTIC
/begin CHARACTERISTIC UHC_tiC1TO_C "Maximale C1 Timeoutschwelle" VALUE 0x800617F4 Val_Ws16 3200.000 SCR_Time10 0.00 3200.000 FORMAT "%8.3" EXTENDED_LIMITS -3276.800 3276.700 /end CHARACTERISTIC
/begin CHARACTERISTIC UHC_tiC2TO_C "Maximale C2 Timeoutschwelle" VALUE 0x800617F6 Val_Ws16 3200.000 SCR_Time10 0.00 3200.000 FORMAT "%8.3" EXTENDED_LIMITS -3276.800 3276.700 /end CHARACTERISTIC
/begin CHARACTERISTIC UHC_tiDfrstC2_CUR "Auftauzeit Druckleitungsheizung" CURVE 0x800617F8 Cur_Xs16Ws16 3200.000 SCR_Time10 0.00 3200.000 FORMAT "%8.3" EXTENDED_LIMITS -3276.800 3276.700
 /begin AXIS_DESCR STD_AXIS EnvT_t Temp_Cels 4 -3549.940 3003.560 DEPOSIT ABSOLUTE /end AXIS_DESCR
/end CHARACTERISTIC
/begin CHARACTERISTIC UHC_tiOffC2_CUR "Zeit für inaktive Heizung (Druckleitung)" CURVE 0x8006180A Cur_Xs16Ws16 3200.000 SCR_Time10 0.00 3200.000 FORMAT "%8.3" EXTENDED_LIMITS -3276.800 3276.700
 /begin AXIS_DESCR STD_AXIS EnvT_t Temp_Cels 4 -3549.940 3003.560 DEPOSIT ABSOLUTE /end AXIS_DESCR
/end CHARACTERISTIC
/begin CHARACTERISTIC UHC_tiOnC2_CUR "Zeit für aktive Heizung (Druckleitung)" CURVE 0x8006181C Cur_Xs16Ws16 3200.000 SCR_Time10 0.00 3200.000 FORMAT "%8.3" EXTENDED_LIMITS -3276.800 3276.700
 /begin AXIS_DESCR STD_AXIS EnvT_t Temp_Cels 4 -3549.940 3003.560 DEPOSIT ABSOLUTE /end AXIS_DESCR
/end CHARACTERISTIC
/begin CHARACTERISTIC UHC_tiReq3Htr2Dly_C "Verzögerungszeit für Heizungsfreigabe (Druckleitung) bei überschwingen" VALUE 0x80061838 Val_Ws32 1000.00000000 Time_s 0.00 1000.00000000 EXTENDED_LIMITS -21474836.4800 21474836.4700 /end CHARACTERISTIC
/begin CHARACTERISTIC UHC_tUTnkDfrstTempMax_C "rechte Hystereseschwelle der Auftauzeitbestimmung" VALUE 0x8006182E Val_Ws16 100.0000 Temp_Cels -50.04000 49.96000 EXTENDED_LIMITS -3549.940 3003.560 /end CHARACTERISTIC
/begin CHARACTERISTIC UHC_tUTnkDfrstTempMin_C "linke Hystereseschwelle der Auftauzeitbestimmung" VALUE 0x80061830 Val_Ws16 100.0000 Temp_Cels -50.04000 49.96000 EXTENDED_LIMITS -3549.940 3003.560 /end CHARACTERISTIC
/begin CHARACTERISTIC UHC_tUTnkTempMinDelta_C "negatives Delta zur Temperaturschwelle Tank gefroren" VALUE 0x80061832 Val_Ws16 500.0000 TempDiff_Kelv 0.00 500.0000 EXTENDED_LIMITS -3276.800 3276.700 /end CHARACTERISTIC
/begin CHARACTERISTIC UHC_tUTnkTempMin_C "Temperaturschwelle Tank gefroren" VALUE 0x80061834 Val_Ws16 100.0000 Temp_Cels -50.04000 49.96000 EXTENDED_LIMITS -3549.940 3003.560 /end CHARACTERISTIC
/begin CHARACTERISTIC UHtrPL_DigOut.tiBtwTstSCB_C "/" VALUE 0x80061890 Kw_Ws16 1000.000 Time_ms 0.00 1000.000 EXTENDED_LIMITS -327680.0 327670.0 /end CHARACTERISTIC
/begin CHARACTERISTIC UHtrPL_DigOut.tiBtwTstOT_C "/" VALUE 0x80061892 Kw_Ws16 1000.000 Time_s 0.00 1000.000 EXTENDED_LIMITS -327.6800 327.6700 /end CHARACTERISTIC
/begin CHARACTERISTIC UHtrPL_DigOut.numTstMax_C "/" VALUE 0x80061894 Kw_Wu16 65535.00 OneToOne 0.00 65535.00 /end CHARACTERISTIC
/begin CHARACTERISTIC UHtrPL_iTransfDia_CUR "" CURVE 0x8006183C Cur_Xs16Ws16 250.0000 Ampere -50.00000 200.0000 FORMAT "%8.4" EXTENDED_LIMITS -6553.600 6553.400
 /begin AXIS_DESCR STD_AXIS UHtrPL_uRawDia Volt 16 0.00 5000.000 EXTENDED_LIMITS -6553.600 6553.400 DEPOSIT ABSOLUTE /end AXIS_DESCR
/end CHARACTERISTIC
/begin CHARACTERISTIC UHtrPL_RmpSlpDia.Pos_C "/" VALUE 0x80061884 Kw_Ws32 3273522.99805 RmpTemp 3277.00042725 3276799.99847 FORMAT "%13.5" EXTENDED_LIMITS -3276800.00000 3276799.99847 /end CHARACTERISTIC
/begin CHARACTERISTIC UHtrPL_RmpSlpDia.Neg_C "/" VALUE 0x80061888 Kw_Ws32 3273522.99805 RmpTemp 3277.00042725 3276799.99847 FORMAT "%13.5" EXTENDED_LIMITS -3276800.00000 3276799.99847 /end CHARACTERISTIC
/begin CHARACTERISTIC UHtrPL_SRCDia.uMin_C "/" VALUE 0x8006187E Kw_Ws16 1000.000 Volt 0.00 1000.000 EXTENDED_LIMITS -6553.600 6553.400 /end CHARACTERISTIC
/begin CHARACTERISTIC UHtrPL_SRCDia.uMax_C "/" VALUE 0x80061880 Kw_Ws16 2000.000 Volt 3000.000 5000.000 EXTENDED_LIMITS -6553.600 6553.400 /end CHARACTERISTIC
/begin CHARACTERISTIC UHtrPL_stPsDiaDisbl_C "" VALUE 0x80061896 Kw_Wu8 255.0 OneToOne 0.00 255.0 /end CHARACTERISTIC
/begin CHARACTERISTIC UHtrPL_stPsDisbl_C "" VALUE 0x80061897 Kw_Wu8 255.0 OneToOne 0.00 255.0 /end CHARACTERISTIC
/begin CHARACTERISTIC UHtrPL_TransStgDia.Dfl_C "/" VALUE 0x8006188C Kw_Ws16 250.0000 Ampere -50.00000 200.0000 FORMAT "%8.4" EXTENDED_LIMITS -6553.600 6553.400 /end CHARACTERISTIC
/begin CHARACTERISTIC UHtrPL_TransStgDia.stSensId_C "/" VALUE 0x8006188E Kw_Wu8 4.000 OneToOne 0.00 4.000 EXTENDED_LIMITS 0.00 255.0 /end CHARACTERISTIC
/begin CHARACTERISTIC UHtrTnk_DigOut.tiBtwTstSCB_C "/" VALUE 0x800618EC Kw_Ws16 1000.000 Time_ms 0.00 1000.000 EXTENDED_LIMITS -327680.0 327670.0 /end CHARACTERISTIC
/begin CHARACTERISTIC UHtrTnk_DigOut.tiBtwTstOT_C "/" VALUE 0x800618EE Kw_Ws16 1000.000 Time_s 0.00 1000.000 EXTENDED_LIMITS -327.6800 327.6700 /end CHARACTERISTIC
/begin CHARACTERISTIC UHtrTnk_DigOut.numTstMax_C "/" VALUE 0x800618F0 Kw_Wu16 65535.00 OneToOne 0.00 65535.00 /end CHARACTERISTIC
/begin CHARACTERISTIC UHtrTnk_iTransfDia_CUR "" CURVE 0x80061898 Cur_Xs16Ws16 250.0000 Ampere -50.00000 200.0000 FORMAT "%8.4" EXTENDED_LIMITS -6553.600 6553.400
 /begin AXIS_DESCR STD_AXIS UHtrTnk_uRawDia Volt 16 0.00 5000.000 EXTENDED_LIMITS -6553.600 6553.400 DEPOSIT ABSOLUTE /end AXIS_DESCR
/end CHARACTERISTIC
/begin CHARACTERISTIC UHtrTnk_RmpSlpDia.Pos_C "/" VALUE 0x800618E0 Kw_Ws32 3273522.99805 RmpTemp 3277.00042725 3276799.99847 FORMAT "%13.5" EXTENDED_LIMITS -3276800.00000 3276799.99847 /end CHARACTERISTIC
/begin CHARACTERISTIC UHtrTnk_RmpSlpDia.Neg_C "/" VALUE 0x800618E4 Kw_Ws32 3273522.99805 RmpTemp 3277.00042725 3276799.99847 FORMAT "%13.5" EXTENDED_LIMITS -3276800.00000 3276799.99847 /end CHARACTERISTIC
/begin CHARACTERISTIC UHtrTnk_SRCDia.uMin_C "/" VALUE 0x800618DA Kw_Ws16 1000.000 Volt 0.00 1000.000 EXTENDED_LIMITS -6553.600 6553.400 /end CHARACTERISTIC
/begin CHARACTERISTIC UHtrTnk_SRCDia.uMax_C "/" VALUE 0x800618DC Kw_Ws16 2000.000 Volt 3000.000 5000.000 EXTENDED_LIMITS -6553.600 6553.400 /end CHARACTERISTIC
/begin CHARACTERISTIC UHtrTnk_stPsDiaDisbl_C "" VALUE 0x800618F2 Kw_Wu8 255.0 OneToOne 0.00 255.0 /end CHARACTERISTIC
/begin CHARACTERISTIC UHtrTnk_stPsDisbl_C "" VALUE 0x800618F3 Kw_Wu8 255.0 OneToOne 0.00 255.0 /end CHARACTERISTIC
/begin CHARACTERISTIC UHtrTnk_TransStgDia.Dfl_C "/" VALUE 0x800618E8 Kw_Ws16 250.0000 Ampere -50.00000 200.0000 FORMAT "%8.4" EXTENDED_LIMITS -6553.600 6553.400 /end CHARACTERISTIC
/begin CHARACTERISTIC UHtrTnk_TransStgDia.stSensId_C "/" VALUE 0x800618EA Kw_Wu8 4.000 OneToOne 0.00 4.000 EXTENDED_LIMITS 0.00 255.0 /end CHARACTERISTIC
/begin CHARACTERISTIC UPmpMot_Pwm.tiPer_C "/" VALUE 0x800618F4 Kw_Ws16 9.900000 Period 0.1000000 10.00000 FORMAT "%8.5" EXTENDED_LIMITS -3276.800 3276.700 /end CHARACTERISTIC
/begin CHARACTERISTIC UPmpMot_Pwm.stLvl_C "/" VALUE 0x800618F6 Kw_Wu8 1.000 OneToOne 0.00 1.000 EXTENDED_LIMITS 0.00 255.0 /end CHARACTERISTIC
/begin CHARACTERISTIC UPmpMot_Pwm.rMaxDty_C "/" VALUE 0x800618F8 Kw_Ws16 100.0000 DtyCyc 0.00 100.0000 EXTENDED_LIMITS -327.6800 327.6700 /end CHARACTERISTIC
/begin CHARACTERISTIC UPmpMot_Pwm.rPerUn_C "/" VALUE 0x800618FA Kw_Ws16 3276.700 Period 0.00 3276.700 FORMAT "%8.3" EXTENDED_LIMITS -3276.800 3276.700 /end CHARACTERISTIC
/begin CHARACTERISTIC UPmpMot_Pwm.tiPh_C "/" VALUE 0x800618FC Kw_Ws16 65535.00 OneToOne -32768.00 32767.00 /end CHARACTERISTIC
/begin CHARACTERISTIC UPmpMot_PwmOut.rMin_C "/" VALUE 0x800618FE Kw_Ws16 100.0000 DtyCyc 0.00 100.0000 EXTENDED_LIMITS -327.6800 327.6700 /end CHARACTERISTIC
/begin CHARACTERISTIC UPmpMot_PwmOut.rMax_C "/" VALUE 0x80061900 Kw_Ws16 100.0000 DtyCyc 0.00 100.0000 EXTENDED_LIMITS -327.6800 327.6700 /end CHARACTERISTIC
/begin CHARACTERISTIC UPmpMot_PwmOut.tiBtwTstSCB_C "/" VALUE 0x80061902 Kw_Ws16 1000.000 Time_ms 0.00 1000.000 EXTENDED_LIMITS -327680.0 327670.0 /end CHARACTERISTIC
/begin CHARACTERISTIC UPmpMot_PwmOut.tiBtwTstOT_C "/" VALUE 0x80061904 Kw_Ws16 1000.000 Time_s 0.00 1000.000 EXTENDED_LIMITS -327.6800 327.6700 /end CHARACTERISTIC
/begin CHARACTERISTIC UPmpMot_PwmOut.numTstMax_C "/" VALUE 0x80061906 Kw_Wu16 65535.00 OneToOne 0.00 65535.00 /end CHARACTERISTIC
/begin CHARACTERISTIC UPmpMot_PwmOut.swtBattCor_C "/" VALUE 0x80061908 Kw_Wu8 1.000 OneToOne 0.00 1.000 EXTENDED_LIMITS 0.00 255.0 /end CHARACTERISTIC
/begin CHARACTERISTIC UPmpMot_PwmOut.swtPsInv_C "/" VALUE 0x80061909 Kw_Wu8 255.0 OneToOne 0.00 255.0 /end CHARACTERISTIC
/begin CHARACTERISTIC UPmpMot_rCnv_CUR "" CURVE 0x8006190A Cur_Xs16Ws16 655.3500 DtyCyc -327.6800 327.6700
 /begin AXIS_DESCR STD_AXIS UPmpMot_r_mp Prc 10 0.00 100.0000 EXTENDED_LIMITS -400.0000 399.9878 DEPOSIT ABSOLUTE /end AXIS_DESCR
/end CHARACTERISTIC
/begin CHARACTERISTIC UPmpMot_rPsDisbl_C "" VALUE 0x80061934 Val_Ws16 655.3500 DtyCyc -327.6800 327.6700 /end CHARACTERISTIC
/begin CHARACTERISTIC UPmpMot_stPsDiaDisbl_C "" VALUE 0x80061936 Val_Wu8 255.0 OneToOne 0.00 255.0 /end CHARACTERISTIC
/begin CHARACTERISTIC UPmpMot_stPsDisbl_C "" VALUE 0x80061937 Val_Wu8 255.0 OneToOne 0.00 255.0 /end CHARACTERISTIC
/begin CHARACTERISTIC URevVlv_DigOut.tiBtwTstSCB_C "Struktur für Digitalausgang/" VALUE 0x80061994 Kw_Ws16 1000.000 Time_ms 0.00 1000.000 EXTENDED_LIMITS -327680.0 327670.0 /end CHARACTERISTIC
/begin CHARACTERISTIC URevVlv_DigOut.tiBtwTstOT_C "Struktur für Digitalausgang/" VALUE 0x80061996 Kw_Ws16 1000.000 Time_s 0.00 1000.000 EXTENDED_LIMITS -327.6800 327.6700 /end CHARACTERISTIC
/begin CHARACTERISTIC URevVlv_DigOut.numTstMax_C "Struktur für Digitalausgang/" VALUE 0x80061998 Kw_Wu16 65535.00 OneToOne 0.00 65535.00 /end CHARACTERISTIC
/begin CHARACTERISTIC URevVlv_stPsDiaDisbl_C "Kalibrierungsparameter zur Endstufendiagnose-Deaktivierung / Freigabe" VALUE 0x8006199A Kw_Wu8 255.0 OneToOne 0.00 255.0 /end CHARACTERISTIC
/begin CHARACTERISTIC URevVlv_stPsDisbl_C "Kalibrierungsparameter zur Endstufendeaktivierung / Freigabe" VALUE 0x8006199B Kw_Wu8 255.0 OneToOne 0.00 255.0 /end CHARACTERISTIC
/begin CHARACTERISTIC VehMot_mInrt_C "Fahrzeugmasse" VALUE 0x80062668 Kw_Ws16 65535.00 Mass -32768.00 32767.00 FORMAT "%8.2" /end CHARACTERISTIC
/begin CHARACTERISTIC VehMot_tiFastLearn_C "Zeitkonstante für schnellen Lernmodus" VALUE 0x8006266A Kw_Ws16 65.53500 Time_s_1 -32.76800 32.76700 FORMAT "%8.5" /end CHARACTERISTIC
/begin CHARACTERISTIC VehMot_tiTrqDragMin_C "Minimale Zeitkonstante für Filterung geschätzter Fahrwiderstand" VALUE 0x8006266C Kw_Ws16 65.53500 Time_s_1 -32.76800 32.76700 FORMAT "%8.5" /end CHARACTERISTIC
/begin CHARACTERISTIC VehMot_tiTrqDragVx_CUR "Kennlinie für Zeitkonstante abhängig von Fahrzeuggeschwindigkeit" CURVE 0x8006266E Kl_Xs16_Ws16 65.53500 Time_s_1 -32.76800 32.76700 FORMAT "%8.5"
 /begin AXIS_DESCR STD_AXIS GlbDa_vX Vel 2 -327.6800 327.6700 DEPOSIT ABSOLUTE /end AXIS_DESCR
/end CHARACTERISTIC
/begin CHARACTERISTIC VehMot_tiTrqPrpPT1_C "Zeitkonstante für Filterung Moment" VALUE 0x80062678 Kw_Ws32 4294.9672940 TimeDelay_s 0.000002000000001 4294.9672960 FORMAT "%12.7" /end CHARACTERISTIC
/begin CHARACTERISTIC VehMot_trqDragMax_C "Maximaler Fahrwiderstand" VALUE 0x8006267C Kw_Ws32 429496729.500 TrqPrpHigh -214748364.800 214748364.700 /end CHARACTERISTIC
/begin CHARACTERISTIC VehMot_trqThresComp_C "Schwelle für komplette Kompensation der Nebenaggregate" VALUE 0x80062680 Kw_Ws32 429496729.500 TrqPrpHigh -214748364.800 214748364.700 /end CHARACTERISTIC
/begin CHARACTERISTIC VehMot_vMinDragEst_C "Minimale Fahrzeuggeschwindigkeit für Berechnnung Fahrwiderstand" VALUE 0x80062684 Kw_Ws16 655.3500 Vel -327.6800 327.6700 /end CHARACTERISTIC
/begin CHARACTERISTIC VehV_nThresPla_C "" VALUE 0x80062688 Val_Ws16 16383.50 EngN 0.00 16383.50 EXTENDED_LIMITS -16384.00 16383.50 /end CHARACTERISTIC
/begin CHARACTERISTIC VehV_swtTrqSel_C "" VALUE 0x8006268A Val_Wu8 255.0 OneToOne 0.00 255.0 /end CHARACTERISTIC
/begin CHARACTERISTIC VehV_tiAPT1_C "" VALUE 0x8006268C Val_Ws32 4294.9672940 TimeDelay_s 0.000002000000001 4294.9672960 FORMAT "%12.7" /end CHARACTERISTIC
/begin CHARACTERISTIC VehV_tiDebMonPla_C "" VALUE 0x80062690 Val_Ws16 655350.0 Time_ms -327680.0 327670.0 /end CHARACTERISTIC
/begin CHARACTERISTIC VehV_tiVehPT1_C "" VALUE 0x80062694 Val_Ws32 4294.9672940 TimeDelay_s 0.000002000000001 4294.9672960 FORMAT "%12.7" /end CHARACTERISTIC
/begin CHARACTERISTIC VehV_tiVPT1_C "" VALUE 0x80062698 Val_Ws32 4294.9672940 TimeDelay_s 0.000002000000001 4294.9672960 FORMAT "%12.7" /end CHARACTERISTIC
/begin CHARACTERISTIC VehV_trqThresPla_C "" VALUE 0x8006269C Val_Ws16 3276.700 Trq 0.00 3276.700 EXTENDED_LIMITS -3276.800 3276.700 /end CHARACTERISTIC
/begin CHARACTERISTIC VehV_vDfl_C "" VALUE 0x8006269E Val_Ws16 327.0000 Vel 0.00 327.0000 EXTENDED_LIMITS -327.6800 327.6700 /end CHARACTERISTIC
/begin CHARACTERISTIC VehV_vMax_C "" VALUE 0x800626A0 Val_Ws16 327.6700 Vel 0.00 327.6700 EXTENDED_LIMITS -327.6800 327.6700 /end CHARACTERISTIC
/begin CHARACTERISTIC VehV_vMin_C "" VALUE 0x800626A2 Val_Ws16 20.00000 Vel 0.00 20.00000 EXTENDED_LIMITS -327.6800 327.6700 /end CHARACTERISTIC
/begin CHARACTERISTIC VehV_vThresPla_C "" VALUE 0x800626A4 Val_Ws16 327.6700 Vel 0.00 327.6700 EXTENDED_LIMITS -327.6800 327.6700 /end CHARACTERISTIC
/begin MEASUREMENT AirC_stCmprAct "aktueller Status des Klimakompressors" UBYTE OneToOne 1 100 0.00 255.0 ECU_ADDRESS 0xD0001BF4 /end MEASUREMENT
/begin MEASUREMENT CoPT_nMaxEng "" SWORD default 1 100 -32768.00 32767.00 FORMAT "%8.2" ECU_ADDRESS 0xD00006F4 /end MEASUREMENT
/begin MEASUREMENT CoPT_nMinEng "" SWORD default 1 100 -32768.00 32767.00 FORMAT "%8.2" ECU_ADDRESS 0xD00006FC /end MEASUREMENT
/begin MEASUREMENT DiffIO_rTrqDfftl "" SWORD TransR 1 100 -327.6800 327.6700 ECU_ADDRESS 0xD00008D0 /end MEASUREMENT
/begin MEASUREMENT DiffIO_stCfg "" UBYTE OneToOne 1 100 0.00 255.0 ECU_ADDRESS 0xD0001DD7 /end MEASUREMENT
/begin MEASUREMENT DiffIO_trqPrtDfftl "" SLONG TrqPrpHigh 1 100 -214748364.800 214748364.700 ECU_ADDRESS 0xD0002EA0 /end MEASUREMENT
/begin MEASUREMENT EngPrt_nMax "" SWORD EngN 1 100 -16384.00 16383.50 ECU_ADDRESS 0xD00009A2 /end MEASUREMENT
/begin MEASUREMENT ETCtl_tiPoI2Cor "" SWORD InjTime_us 1 100 -13107.20 5000.00 ECU_ADDRESS 0xD0000982 /end MEASUREMENT
/begin MEASUREMENT Exh_stEGTDelTTrbnUs_mp "" UBYTE OneToOne 1 100 0.00 255.0 ECU_ADDRESS 0xC000B582 /end MEASUREMENT
/begin MEASUREMENT Exh_stEgtTOxiCatUs_mp "" UBYTE OneToOne 1 100 0.00 255.0 ECU_ADDRESS 0xC000B56A /end MEASUREMENT
/begin MEASUREMENT Exh_stTmrPlausTOxiCatUs_mp "" UBYTE OneToOne 1 100 0.00 255.0 ECU_ADDRESS 0xC000B56B /end MEASUREMENT
/begin MEASUREMENT Exh_stTmrPlausTTrbnUs_mp "" UBYTE OneToOne 1 100 0.00 255.0 ECU_ADDRESS 0xC000B583 /end MEASUREMENT
/begin MEASUREMENT Exh_tAdapTOxiCatUs "" SWORD Temp_Cels 1 100 -3549.940 3003.560 ECU_ADDRESS 0xD0000A78 /end MEASUREMENT
/begin MEASUREMENT Exh_tAdapTPFltUs "Angepasste Temperatur vor Partikelfilter." SWORD Temp_Cels 1 100 -3549.940 3003.560 ECU_ADDRESS 0xD0000A7A /end MEASUREMENT
/begin MEASUREMENT Exh_tAdapTTrbnUs "" SWORD Temp_Cels 1 100 -3549.940 3003.560 ECU_ADDRESS 0xD0000A80 /end MEASUREMENT
/begin MEASUREMENT Exh_tDiffNegTOxiCatUs_mp "" SWORD TempDiff_Kelv 1 100 -3276.800 3276.700 ECU_ADDRESS 0xC000AE3A /end MEASUREMENT
/begin MEASUREMENT Exh_tDiffNegTPFltUs_mp "" SWORD TempDiff_Kelv 1 100 -3276.800 3276.700 ECU_ADDRESS 0xC000AE40 /end MEASUREMENT
/begin MEASUREMENT Exh_tDiffNegTTrbnUs_mp "" SWORD TempDiff_Kelv 1 100 -3276.800 3276.700 ECU_ADDRESS 0xC000AE6E /end MEASUREMENT
/begin MEASUREMENT Exh_tDiffPosTOxiCatUs_mp "" SWORD TempDiff_Kelv 1 100 -3276.800 3276.700 ECU_ADDRESS 0xC000AE3C /end MEASUREMENT
/begin MEASUREMENT Exh_tDiffPosTPFltUs_mp "" SWORD TempDiff_Kelv 1 100 -3276.800 3276.700 ECU_ADDRESS 0xC000AE42 /end MEASUREMENT
/begin MEASUREMENT Exh_tDiffPosTTrbnUs_mp "" SWORD TempDiff_Kelv 1 100 -3276.800 3276.700 ECU_ADDRESS 0xC000AE70 /end MEASUREMENT
/begin MEASUREMENT Exh_tDiffTPFltUs_mp "" SWORD TempDiff_Kelv 1 100 -3276.800 3276.700 ECU_ADDRESS 0xC000AE44 /end MEASUREMENT
/begin MEASUREMENT Exh_tEGFldTPFltUs_mp "" SWORD Temp_Cels 1 100 -3549.940 3003.560 ECU_ADDRESS 0xC000AE46 /end MEASUREMENT
/begin MEASUREMENT Exh_tModTOxiCatUs_mp "" SWORD Temp_Cels 1 100 -3549.940 3003.560 ECU_ADDRESS 0xC000AE3E /end MEASUREMENT
/begin MEASUREMENT Exh_tModTTrbnUs_mp "" SWORD Temp_Cels 1 100 -3549.940 3003.560 ECU_ADDRESS 0xC000AE72 /end MEASUREMENT
/begin MEASUREMENT Exh_tOxiCatUs "" SWORD Temp_Cels 1 100 -3549.940 3003.560 ECU_ADDRESS 0xD0000A9E /end MEASUREMENT
/begin MEASUREMENT Exh_tPFltUs "" SWORD Temp_Cels 1 100 -3549.940 3003.560 ECU_ADDRESS 0xD0000AA2 /end MEASUREMENT
/begin MEASUREMENT Exh_tSensTOxiCatUs "" SWORD Temp_Cels 1 100 -3549.940 3003.560 ECU_ADDRESS 0xD0000AA8 /end MEASUREMENT
/begin MEASUREMENT Exh_tSensTPFltUs "" SWORD Temp_Cels 1 100 -3549.940 3003.560 ECU_ADDRESS 0xD0000AAA /end MEASUREMENT
/begin MEASUREMENT Exh_tSensTTrbnUs "" SWORD Temp_Cels 1 100 -3549.940 3003.560 ECU_ADDRESS 0xD0000AAC /end MEASUREMENT
/begin MEASUREMENT Exh_tTrbnUs "" SWORD Temp_Cels 1 100 -3549.940 3003.560 ECU_ADDRESS 0xD0000AB4 /end MEASUREMENT
/begin MEASUREMENT Exh_uRawTOxiCatUs "" SWORD Volt 1 100 -6553.600 6553.400 ECU_ADDRESS 0xD0000ABA /end MEASUREMENT
/begin MEASUREMENT Exh_uRawTPFltUs "" SWORD Volt 1 100 -6553.600 6553.400 ECU_ADDRESS 0xD0000ABC /end MEASUREMENT
/begin MEASUREMENT Exh_uRawTTrbnUs "" SWORD Volt 1 100 -6553.600 6553.400 ECU_ADDRESS 0xD0000ABE /end MEASUREMENT
/begin MEASUREMENT LiGov_nStat "" SWORD EngN 1 100 -16384.00 16383.50 ECU_ADDRESS 0xD00010CE /end MEASUREMENT
/begin MEASUREMENT PFltRgn_st "" ULONG OneToOne 1 100 0.00 4294967295.00 ECU_ADDRESS 0xD0003270 /end MEASUREMENT
/begin MEASUREMENT PT_rTraGear "Aktuelle Getriebeübersetzung" SWORD TransR 1 100 -327.6800 327.6700 ECU_ADDRESS 0xD0001234 /end MEASUREMENT
/begin MEASUREMENT PT_rTraGear1 "" SWORD TransR 1 100 -327.6800 327.6700 ECU_ADDRESS 0xD0001226 /end MEASUREMENT
/begin MEASUREMENT PT_rTraGear2 "" SWORD TransR 1 100 -327.6800 327.6700 ECU_ADDRESS 0xD0001228 /end MEASUREMENT
/begin MEASUREMENT PT_rTraGear3 "" SWORD TransR 1 100 -327.6800 327.6700 ECU_ADDRESS 0xD000122A /end MEASUREMENT
/begin MEASUREMENT PT_rTraGear4 "" SWORD TransR 1 100 -327.6800 327.6700 ECU_ADDRESS 0xD000122C /end MEASUREMENT
/begin MEASUREMENT PT_rTraGear5 "" SWORD TransR 1 100 -327.6800 327.6700 ECU_ADDRESS 0xD000122E /end MEASUREMENT
/begin MEASUREMENT PT_rTraGear6 "" SWORD TransR 1 100 -327.6800 327.6700 ECU_ADDRESS 0xD0001230 /end MEASUREMENT
/begin MEASUREMENT PT_rTraGear7 "" SWORD TransR 1 100 -327.6800 327.6700 ECU_ADDRESS 0xD0001232 /end MEASUREMENT
/begin MEASUREMENT PT_rTraGearDes "Ziel-Getriebeübersetzung" SWORD TransR 1 100 -327.6800 327.6700 ECU_ADDRESS 0xD0001236 /end MEASUREMENT
/begin MEASUREMENT PT_rTraGearR "" SWORD TransR 1 100 -327.6800 327.6700 ECU_ADDRESS 0xD0001238 /end MEASUREMENT
/begin MEASUREMENT PT_rTraV2N "Quotient: Geschwindigkeit zu Drehzahl" SWORD VelToN 1 100 -0.3276800 0.3276700 FORMAT "%9.7" ECU_ADDRESS 0xD000123A /end MEASUREMENT
/begin MEASUREMENT PT_stStabIntv "ESP-Eingriff auf Getriebeebene aktiv" UBYTE OneToOne 1 100 0.00 255.0 ECU_ADDRESS 0xD0002056 /end MEASUREMENT
/begin MEASUREMENT PT_stTraGrip "Kraftschlusszustand Getriebe" UBYTE OneToOne 1 100 0.00 255.0 ECU_ADDRESS 0xD0002057 /end MEASUREMENT
/begin MEASUREMENT PT_stTraLoRng "Vorgelegegetriebe aktiv/inaktiv" UBYTE OneToOne 1 100 0.00 255.0 ECU_ADDRESS 0xD0002059 /end MEASUREMENT
/begin MEASUREMENT PT_stTraRevGear "Rückwärtsgang aktiv/inaktiv" UBYTE OneToOne 1 100 0.00 255.0 ECU_ADDRESS 0xD000205A /end MEASUREMENT
/begin MEASUREMENT PT_stTraShftOp "Gangwechsel aktiv/inaktiv" UBYTE OneToOne 1 100 0.00 255.0 ECU_ADDRESS 0xD000205B /end MEASUREMENT
/begin MEASUREMENT PT_stTraType "Aktueller Getriebetyp" UBYTE OneToOne 1 100 0.00 255.0 ECU_ADDRESS 0xD000205C /end MEASUREMENT
/begin MEASUREMENT PT_trqTraPrt "Maximaler Momentenwert für Getriebeschutz" SWORD Trq 1 100 -3276.800 3276.700 ECU_ADDRESS 0xD0001244 /end MEASUREMENT
/begin MEASUREMENT SCR_pAbsSensUPmpP "" SWORD Pres_hPa 1 100 -32768.00 3500.00 ECU_ADDRESS 0xD000135A /end MEASUREMENT
/begin MEASUREMENT SCR_pAbsUPmpP "" SWORD Pres_hPa 1 100 -32768.00 3500.00 ECU_ADDRESS 0xD000135C /end MEASUREMENT
/begin MEASUREMENT SCR_pFltUPmpP "" SWORD Pres_hPa 1 100 -32768.00 3500.00 ECU_ADDRESS 0xD000135E /end MEASUREMENT
/begin MEASUREMENT SCR_pUPmpP "" SWORD Pres_hPa 1 100 -32768.00 3500.00 ECU_ADDRESS 0xD0001360 /end MEASUREMENT
/begin MEASUREMENT SCR_rSensUTnkLvl "Erfasster Harnstofftankstand" SWORD Prc 1 100 -400.0000 399.9878 ECU_ADDRESS 0xD0001362 /end MEASUREMENT
/begin MEASUREMENT SCR_rUTnkLvl "" SWORD Prc 1 100 -400.0000 399.9878 ECU_ADDRESS 0xD0001364 /end MEASUREMENT
/begin MEASUREMENT SCR_stDebUTnkLvl "Entprellter Status des Harnstofftankstands" UBYTE OneToOne 1 100 0.00 255.0 ECU_ADDRESS 0xD00020A8 /end MEASUREMENT
/begin MEASUREMENT SCR_stRawUTnkLvl "Harnstofftankstand-Sensorrohsignal" UBYTE OneToOne 1 100 0.00 255.0 ECU_ADDRESS 0xD00020A9 /end MEASUREMENT
/begin MEASUREMENT SCR_stSensRdyUTnkLvl_mp "Status der Wehrle-Sensordiagnose" UBYTE OneToOne 1 100 0.00 255.0 ECU_ADDRESS 0xC000B58E /end MEASUREMENT
/begin MEASUREMENT SCR_stT15UTnkLvl_mp "Status der Klemme 15" UBYTE OneToOne 1 100 0.00 255.0 ECU_ADDRESS 0xC000B58F /end MEASUREMENT
/begin MEASUREMENT SCR_stTstStrtUTnkLvl_mp "Status, ob die Wehrle-Sensordiagnose gestartet werden kann." UBYTE OneToOne 1 100 0.00 255.0 ECU_ADDRESS 0xC000B590 /end MEASUREMENT
/begin MEASUREMENT SCR_tiPlsWidth_mp "Breite der Wehrle-Sensordiagnoseimpuls" SWORD Time_ms 1 100 -327680.0 327670.0 ECU_ADDRESS 0xC000AE98 /end MEASUREMENT
/begin MEASUREMENT SCR_tSensUCatUsT "Erfasster physikalischer Wert der Temperatur vor Harnstoffkatalysator" SWORD Temp_Cels 1 100 -3549.940 3003.560 ECU_ADDRESS 0xD0001366 /end MEASUREMENT
/begin MEASUREMENT SCR_tSensUTnkT "" SWORD Temp_Cels 1 100 -3549.940 3003.560 ECU_ADDRESS 0xD0001368 /end MEASUREMENT
/begin MEASUREMENT SCR_tUCatUsT "Temperatur vor Harnstoffkatalysator" SWORD Temp_Cels 1 100 -3549.940 3003.560 ECU_ADDRESS 0xD000136A /end MEASUREMENT
/begin MEASUREMENT SCR_tUTnkT "" SWORD Temp_Cels 1 100 -3549.940 3003.560 ECU_ADDRESS 0xD000136E /end MEASUREMENT
/begin MEASUREMENT SCR_uRawUCatUsT "Vom ADC gelesener Rohspannungswert des Temperatursensors vor Harnstoffkatalysator." SWORD Volt 1 100 -6553.600 6553.400 ECU_ADDRESS 0xD0001370 /end MEASUREMENT
/begin MEASUREMENT SCR_uRawUPmpP "" SWORD Volt 1 100 -6553.600 6553.400 ECU_ADDRESS 0xD0001372 /end MEASUREMENT
/begin MEASUREMENT SCR_uRawUTnkT "" SWORD Volt 1 100 -6553.600 6553.400 ECU_ADDRESS 0xD0001374 /end MEASUREMENT
/begin MEASUREMENT SIIO_stDCSIntv "" SLONG OneToOne 1 100 -2147483648.00 2147483647.00 ECU_ADDRESS 0xD0003010 /end MEASUREMENT
/begin MEASUREMENT SIIO_stTCSIntv "" SLONG OneToOne 1 100 -2147483648.00 2147483647.00 ECU_ADDRESS 0xD0003014 /end MEASUREMENT
/begin MEASUREMENT SIIO_trqDesDCS "" SLONG TrqPrpHigh 1 100 -214748364.800 214748364.700 ECU_ADDRESS 0xD0003018 /end MEASUREMENT
/begin MEASUREMENT SIIO_trqDesTCS "" SLONG TrqPrpHigh 1 100 -214748364.800 214748364.700 ECU_ADDRESS 0xD000301C /end MEASUREMENT
/begin MEASUREMENT SIIO_trqLeadTCS "" SLONG TrqPrpHigh 1 100 -214748364.800 214748364.700 ECU_ADDRESS 0xD0003020 /end MEASUREMENT
/begin MEASUREMENT TCPrt_dnAvrg "Drehzahlgradient Basis für Korrekturfaktor D-Verstärkung" SWORD EngNGrd 1 100 -16384.00 16383.50 FORMAT "%8.2" ECU_ADDRESS 0xD00013C2 /end MEASUREMENT
/begin MEASUREMENT TCPrt_dnAvrgNeg_mp "Änderungsgeschwindigkeit der Motordrehzahl in der negativen Richtung" SWORD EngNGrd 1 100 -16384.00 16383.50 FORMAT "%8.2" ECU_ADDRESS 0xC000ADEE /end MEASUREMENT
/begin MEASUREMENT TCPrt_dnChrgPmpCtlHigh_mp "Höhere Begrenzung, damit Hysteresis Änderungsgeschwindigkeit von Epm_nEng für Anti-Schwankung LIGov überwacht" SWORD EngNGrd 1 100 -16384.00 16383.50 FORMAT "%8.2" ECU_ADDRESS 0xC000ADF0 /end MEASUREMENT
/begin MEASUREMENT TCPrt_dnChrgPmpCtlLow_mp "Unterere Grenze, damit Hysteresis Änderungsgeschwindigkeit von Epm_nEng für Anti-Schwankung LIGov überwacht" SWORD EngNGrd 1 100 -16384.00 16383.50 FORMAT "%8.2" ECU_ADDRESS 0xC000ADF2 /end MEASUREMENT
/begin MEASUREMENT TCPrt_dqInjCtlQRaw_mp "" SWORD InjMassPerSec_20ms 1 100 -16384.00 16383.50 FORMAT "%8.2" ECU_ADDRESS 0xC000AE2E /end MEASUREMENT
/begin MEASUREMENT TCPrt_facAFSensAmpFlt "Amplitudenhöhe der oszillierenden Frischluftmasse beim La-derpumpen tiefpassgefiltert" SWORD FactM 1 100 -2048.000 2047.938 FORMAT "%8.3" ECU_ADDRESS 0xD00013C4 /end MEASUREMENT
/begin MEASUREMENT TCPrt_facAFSensAmpFlt_mp "Amplitudenhöhe der oszillierenden Frischluftmasse beim Laderpumpen nach DFT tiefpassgefilter (PT1)" SWORD FactM 1 100 -2048.000 2047.938 FORMAT "%8.3" ECU_ADDRESS 0xC000AE04 /end MEASUREMENT
/begin MEASUREMENT TCPrt_facAFSensDTAbsAmp2_mp "Faktor des Absolutwerts von zweitem PT1 - filtern" SWORD FactM 1 100 -2048.000 2047.938 FORMAT "%8.3" ECU_ADDRESS 0xC000AE06 /end MEASUREMENT
/begin MEASUREMENT TCPrt_facAFSensDTAmp12_mp "Messender Punkt für Ausgang zweiter DT1-filter" SWORD FactM 1 100 -2048.000 2047.938 FORMAT "%8.3" ECU_ADDRESS 0xC000AE08 /end MEASUREMENT
/begin MEASUREMENT TCPrt_facAFSensPTAmp12_mp "Maßpunkt für das otput zweiter PT1-filter" SWORD FactM 1 100 -2048.000 2047.938 FORMAT "%8.3" ECU_ADDRESS 0xC000AE0A /end MEASUREMENT
/begin MEASUREMENT TCPrt_facAFSensPTAmp1_mp "Amplitudenhöhe der oszillierenden Frischluftmasse beim Laderpumpen (nach PT1-Ctl1)" SWORD FactM 1 100 -2048.000 2047.938 FORMAT "%8.3" ECU_ADDRESS 0xC000AE0C /end MEASUREMENT
/begin MEASUREMENT TCPrt_facAFSensPTAmp2_mp "Amplitudenhöhe der oszillierenden Frischluftmasse beim Laderpumpen (früher PT1-Ctl2)" SWORD FactM 1 100 -2048.000 2047.938 FORMAT "%8.3" ECU_ADDRESS 0xC000AE0E /end MEASUREMENT
/begin MEASUREMENT TCPrt_facAFSensPTAmpFlt_mp "Amplitudenhöhe der oszillierenden Frischluftmasse beim Laderpumpen (nach PT1-Ctl2)" SWORD FactM 1 100 -2048.000 2047.938 FORMAT "%8.3" ECU_ADDRESS 0xC000AE10 /end MEASUREMENT
/begin MEASUREMENT TCPrt_facChrgPmpDes_mp "" SWORD FactM 1 100 -2048.000 2047.938 FORMAT "%8.3" ECU_ADDRESS 0xC000AE12 /end MEASUREMENT
/begin MEASUREMENT TCPrt_facChrgPmpGovDevI_mp "" SWORD FactM 1 100 -2048.000 2047.938 FORMAT "%8.3" ECU_ADDRESS 0xC000AE14 /end MEASUREMENT
/begin MEASUREMENT TCPrt_facChrgPmpGovDev_mp "" SWORD FactM 1 100 -2048.000 2047.938 FORMAT "%8.3" ECU_ADDRESS 0xC000AE16 /end MEASUREMENT
/begin MEASUREMENT TCPrt_facChrgPmpI_mp "" SWORD Fact1 1 100 -256.0000 255.9922 ECU_ADDRESS 0xC000AE18 /end MEASUREMENT
/begin MEASUREMENT TCPrt_facChrgPmpP_mp "" SWORD Fact1 1 100 -256.0000 255.9922 ECU_ADDRESS 0xC000AE1A /end MEASUREMENT
/begin MEASUREMENT TCPrt_nSetPointChrgPmp "Einstellpunkt für Anti-Schwankung LIGov" SWORD EngN 1 100 -16384.00 16383.50 ECU_ADDRESS 0xD00013C6 /end MEASUREMENT
/begin MEASUREMENT TCPrt_nTSCOfs_mp "Offset-Kennlilie für Abtriebsdrehzahl vom Automatikgetriebe." SWORD EngN 1 100 -16384.00 16383.50 ECU_ADDRESS 0xC000ADF4 /end MEASUREMENT
/begin MEASUREMENT TCPrt_pChrgPmpCtlVal_mp "" SWORD Pres_hPa 1 100 -32768.00 3500.00 ECU_ADDRESS 0xC000AE1C /end MEASUREMENT
/begin MEASUREMENT TCPrt_pChrgPmpMax_mp "" SWORD Pres_hPa 1 100 -32768.00 3500.00 ECU_ADDRESS 0xC000AE1E /end MEASUREMENT
/begin MEASUREMENT TCPrt_pChrgPmpMin_mp "" SWORD Pres_hPa 1 100 -32768.00 3500.00 ECU_ADDRESS 0xC000AE20 /end MEASUREMENT
/begin MEASUREMENT TCPrt_pChrgPmpPICtlLim_mp "" SWORD Pres_hPa 1 100 -32768.00 3500.00 ECU_ADDRESS 0xC000AE22 /end MEASUREMENT
/begin MEASUREMENT TCPrt_pChrgPmpPICtl_mp "" SWORD Pres_hPa 1 100 -32768.00 3500.00 ECU_ADDRESS 0xC000AE24 /end MEASUREMENT
/begin MEASUREMENT TCPrt_pChrgPmpstI_mp "" SWORD Pres_hPa 1 100 -32768.00 3500.00 ECU_ADDRESS 0xC000AE26 /end MEASUREMENT
/begin MEASUREMENT TCPrt_pDesChrgPmpGov "" SWORD Pres_hPa 1 100 -32768.00 3500.00 ECU_ADDRESS 0xD00013C8 /end MEASUREMENT
/begin MEASUREMENT TCPrt_pDesChrgPmpRaw_mp "" SWORD Pres_hPa 1 100 -32768.00 3500.00 ECU_ADDRESS 0xC000AE28 /end MEASUREMENT
/begin MEASUREMENT TCPrt_pOutI_mp "" SWORD Pres_hPa 1 100 -32768.00 3500.00 ECU_ADDRESS 0xC000AE2A /end MEASUREMENT
/begin MEASUREMENT TCPrt_pOutP_mp "" SWORD Pres_hPa 1 100 -32768.00 3500.00 ECU_ADDRESS 0xC000AE2C /end MEASUREMENT
/begin MEASUREMENT TCPrt_qChrgPmpCtlHigh_mp "Höhere Quantität Begrenzung für Hysteresis der Anti-Schwankung LIGov" SWORD InjMass 1 100 -327.6800 327.6700 ECU_ADDRESS 0xC000ADF6 /end MEASUREMENT
/begin MEASUREMENT TCPrt_qChrgPmpCtlLow_mp "Senken Sie Quantität Begrenzung für Hysteresis der Anti-Schwankung LIGov" SWORD InjMass 1 100 -327.6800 327.6700 ECU_ADDRESS 0xC000ADF8 /end MEASUREMENT
/begin MEASUREMENT TCPrt_rChrgPmpCtlVal "Ladedruck Steueranteil der Stellgrösse" SWORD Prc 1 100 -400.0000 399.9878 ECU_ADDRESS 0xD00013CA /end MEASUREMENT
/begin MEASUREMENT TCPrt_rChrgPmpCtlValHigh_mp "Höhere ATL Druck-Verhältnisbegrenzung für Hysteresis der Anti-Schwankung LIGov" SWORD Prc 1 100 -400.0000 399.9878 ECU_ADDRESS 0xC000ADFA /end MEASUREMENT
/begin MEASUREMENT TCPrt_rChrgPmpCtlValLow_mp "Senken Sie ATL Druck-Verhältnisbegrenzung für Hysteresis der Anti-Schwankung LIGov" SWORD Prc 1 100 -400.0000 399.9878 ECU_ADDRESS 0xC000ADFC /end MEASUREMENT
/begin MEASUREMENT TCPrt_rChrgPmpGov "" SWORD Prc 1 100 -400.0000 399.9878 ECU_ADDRESS 0xD00013CC /end MEASUREMENT
/begin MEASUREMENT TCPrt_rChrgPmpGovHysOff_mp "" SWORD Prc 1 100 -400.0000 399.9878 ECU_ADDRESS 0xC000AE30 /end MEASUREMENT
/begin MEASUREMENT TCPrt_rChrgPmpGovOff_mp "" SWORD Prc 1 100 -400.0000 399.9878 ECU_ADDRESS 0xC000AE32 /end MEASUREMENT
/begin MEASUREMENT TCPrt_rChrgPmpGovOn_mp "" SWORD Prc 1 100 -400.0000 399.9878 ECU_ADDRESS 0xC000AE34 /end MEASUREMENT
/begin MEASUREMENT TCPrt_rChrgPmpGovRaw_mp "" SWORD Prc 1 100 -400.0000 399.9878 ECU_ADDRESS 0xC000AE36 /end MEASUREMENT
/begin MEASUREMENT TCPrt_rChrgPmpHysHigh_mp "Höhere ATL Druck-Verhältnisbegrenzung für Hysteresis der Anti-Schwankung LIGov" SWORD Prc 1 100 -400.0000 399.9878 ECU_ADDRESS 0xC000ADFE /end MEASUREMENT
/begin MEASUREMENT TCPrt_rChrgPmpHysLow_mp "Senken Sie ATL Druck-Verhältnisbegrenzung für Hysteresis der Anti-Schwankung LIGov" SWORD Prc 1 100 -400.0000 399.9878 ECU_ADDRESS 0xC000AE00 /end MEASUREMENT
/begin MEASUREMENT TCPrt_rChrgPmpPhysHigh_mp "" SWORD Fact 1 100 -4.000000 3.999878 ECU_ADDRESS 0xC000AE02 /end MEASUREMENT
/begin MEASUREMENT TCPrt_rPresRat "ATL- Druckverhältnis" SWORD Prc 1 100 -400.0000 399.9878 ECU_ADDRESS 0xD00013CE /end MEASUREMENT
/begin MEASUREMENT TCPrt_stChrgPmp "Status der Erkennung für Laderpumpen Zustand 2 (oszillierende Frischluftmasse mit großer Amplitude)" UBYTE OneToOne 1 100 0.00 255.0 ECU_ADDRESS 0xD000258D /end MEASUREMENT
/begin MEASUREMENT TCPrt_stChrgPmp1_mp "Anti-Schwankung LIGov status1, ohne Motordrehzahlzu überwachen" UBYTE OneToOne 1 100 0.00 255.0 ECU_ADDRESS 0xC000B55D /end MEASUREMENT
/begin MEASUREMENT TCPrt_stChrgPmpCtl "Anti-Schwankung LIGov status2" UBYTE OneToOne 1 100 0.00 255.0 ECU_ADDRESS 0xD000258E /end MEASUREMENT
/begin MEASUREMENT TCPrt_stChrgPmpCtl_mp "Status Pre1 der Anti-Schwankung LIGov" UBYTE OneToOne 1 100 0.00 255.0 ECU_ADDRESS 0xC000B55E /end MEASUREMENT
/begin MEASUREMENT TCPrt_stChrgPmpHLSDem_mp "Anti-Schwankung LIGov status1" UBYTE OneToOne 1 100 0.00 255.0 ECU_ADDRESS 0xC000B55F /end MEASUREMENT
/begin MEASUREMENT TCPrt_stChrgPmpPre1_mp "Status Pre1 der Anti-Schwankung LIGov" UBYTE OneToOne 1 100 0.00 255.0 ECU_ADDRESS 0xC000B560 /end MEASUREMENT
/begin MEASUREMENT TCPrt_stPreChrgPmp "Status der Erkennung für Laderpumpen Zustand 1 (oszillierende Frischluftmasse mit kleiner Amplitude)" UBYTE OneToOne 1 100 0.00 255.0 ECU_ADDRESS 0xD000258F /end MEASUREMENT
/begin MEASUREMENT TCPrt_swtChrgPmpGov "" UBYTE OneToOne 1 100 0.00 255.0 ECU_ADDRESS 0xD0002590 /end MEASUREMENT
/begin MEASUREMENT TCPrt_swtChrgPmpGovRls_mp "" UBYTE OneToOne 1 100 0.00 255.0 ECU_ADDRESS 0xC000B561 /end MEASUREMENT
/begin MEASUREMENT TCPrt_swtChrgPmpGovSel_mp "" UBYTE OneToOne 1 100 0.00 255.0 ECU_ADDRESS 0xC000B562 /end MEASUREMENT
/begin MEASUREMENT TECU_t "" SWORD Temp_Cels 1 100 -3549.940 3003.560 ECU_ADDRESS 0xD00013D0 /end MEASUREMENT
/begin MEASUREMENT TECU_tSens "" SWORD Temp_Cels 1 100 -3549.940 3003.560 ECU_ADDRESS 0xD00013D2 /end MEASUREMENT
/begin MEASUREMENT TECU_uRaw "" SWORD Volt 1 100 -6553.600 6553.400 ECU_ADDRESS 0xD00013D4 /end MEASUREMENT
/begin MEASUREMENT ThrVlv_ct4WinErr1_mp "" UBYTE OneToOne 1 100 0.00 255.0 ECU_ADDRESS 0xC000B563 /end MEASUREMENT
/begin MEASUREMENT ThrVlv_ct4WinErr2_mp "" UBYTE OneToOne 1 100 0.00 255.0 ECU_ADDRESS 0xC000B564 /end MEASUREMENT
/begin MEASUREMENT ThrVlv_ct4WinErr3_mp "" UBYTE OneToOne 1 100 0.00 255.0 ECU_ADDRESS 0xC000B565 /end MEASUREMENT
/begin MEASUREMENT ThrVlv_ct4WinErr4_mp "" UBYTE OneToOne 1 100 0.00 255.0 ECU_ADDRESS 0xC000B566 /end MEASUREMENT
/begin MEASUREMENT ThrVlv_ctMonDef_mp "" UBYTE OneToOne 1 100 0.00 255.0 ECU_ADDRESS 0xC000B568 /end MEASUREMENT
/begin MEASUREMENT ThrVlv_pDiffMaxMon_mp "" SWORD Pres_hPa 1 100 -32768.00 3500.00 ECU_ADDRESS 0xC000AE38 /end MEASUREMENT
/begin MEASUREMENT ThrVlv_r "" SWORD Prc 1 100 -400.0000 399.9878 ECU_ADDRESS 0xD00013E8 /end MEASUREMENT
/begin MEASUREMENT ThrVlv_rAct "" SWORD DtyCyc 1 100 -327.6800 327.6700 ECU_ADDRESS 0xD00013EA /end MEASUREMENT
/begin MEASUREMENT ThrVlv_rPs "" SWORD DtyCyc 1 100 -327.6800 327.6700 ECU_ADDRESS 0xD00013F4 /end MEASUREMENT
/begin MEASUREMENT ThrVlv_rSens "" SWORD DtyCyc 1 100 -327.6800 327.6700 ECU_ADDRESS 0xD00013F6 /end MEASUREMENT
/begin MEASUREMENT ThrVlv_stErrMsg_mp "" UBYTE OneToOne 1 100 0.00 255.0 ECU_ADDRESS 0xC000B567 /end MEASUREMENT
/begin MEASUREMENT ThrVlv_stMon_mp "" UBYTE OneToOne 1 100 0.00 255.0 ECU_ADDRESS 0xC000B569 /end MEASUREMENT
/begin MEASUREMENT ThrVlv_uRaw "" SWORD Volt 1 100 -6553.600 6553.400 ECU_ADDRESS 0xD00013F8 /end MEASUREMENT
/begin MEASUREMENT Tra_dtrqLimUp_mp "" SLONG RmpTrq 1 100 -3276800.00000 3276799.99847 ECU_ADDRESS 0xC00093B8 /end MEASUREMENT
/begin MEASUREMENT Tra_nASTDes "Synchronisationsdrehzahl" SWORD EngN 1 100 -16384.00 16383.50 ECU_ADDRESS 0xD00013FA /end MEASUREMENT
/begin MEASUREMENT Tra_nBrk_mp "" SWORD EngN 1 100 -16384.00 16383.50 ECU_ADDRESS 0xC000AE5E /end MEASUREMENT
/begin MEASUREMENT Tra_nEngFlt_mp "tiefpaßgefilterte Motordrehzahl" SWORD EngN 1 100 -16384.00 16383.50 ECU_ADDRESS 0xC000AE48 /end MEASUREMENT
/begin MEASUREMENT Tra_nMax "Maximaldrehzahl für Getriebe" SWORD EngN 1 100 -16384.00 16383.50 ECU_ADDRESS 0xD00013FC /end MEASUREMENT
/begin MEASUREMENT Tra_nMin "Minimaldrehzahl für Getriebe" SWORD EngN 1 100 -16384.00 16383.50 ECU_ADDRESS 0xD00013FE /end MEASUREMENT
/begin MEASUREMENT Tra_nMinRaw_mp "" SWORD EngN 1 100 -16384.00 16383.50 ECU_ADDRESS 0xC000AE60 /end MEASUREMENT
/begin MEASUREMENT Tra_nMinRmp_mp "" SWORD EngN 1 100 -16384.00 16383.50 ECU_ADDRESS 0xC000AE62 /end MEASUREMENT
/begin MEASUREMENT Tra_nRmpTSCDelta_mp "" SWORD EngN 1 100 -16384.00 16383.50 ECU_ADDRESS 0xC000AE64 /end MEASUREMENT
/begin MEASUREMENT Tra_nTSCDelta_mp "" SWORD EngN 1 100 -16384.00 16383.50 ECU_ADDRESS 0xC000AE66 /end MEASUREMENT
/begin MEASUREMENT Tra_nTSCSlip_mp "" SWORD EngN 1 100 -16384.00 16383.50 ECU_ADDRESS 0xC000AE68 /end MEASUREMENT
/begin MEASUREMENT Tra_numDflGear_mp "Messpunkt Default-Gang" SBYTE OneToOne 1 100 -128.0 127.0 ECU_ADDRESS 0xC000B56C /end MEASUREMENT
/begin MEASUREMENT Tra_numGear "Aktueller Gang" SBYTE OneToOne 1 100 -128.0 127.0 ECU_ADDRESS 0xD0001BCF /end MEASUREMENT
/begin MEASUREMENT Tra_numGearDes "aktueller Zielgang" SBYTE OneToOne 1 100 -128.0 127.0 ECU_ADDRESS 0xD0001BD0 /end MEASUREMENT
/begin MEASUREMENT Tra_numGearDsplTar "" UBYTE OneToOne 1 100 0.00 255.0 ECU_ADDRESS 0xD0002592 /end MEASUREMENT
/begin MEASUREMENT Tra_numLstGear "Alter Gang vom Aufruf zuvor" SBYTE OneToOne 1 100 -128.0 127.0 ECU_ADDRESS 0xD0001BD1 /end MEASUREMENT
/begin MEASUREMENT Tra_numLstParGear "Alter Parametergang vom Aufruf zuvor" SBYTE OneToOne 1 100 -128.0 127.0 ECU_ADDRESS 0xD0001BD2 /end MEASUREMENT
/begin MEASUREMENT Tra_numParGear "aktueller Parametergang" SBYTE OneToOne 1 100 -128.0 127.0 ECU_ADDRESS 0xD0001BD3 /end MEASUREMENT
/begin MEASUREMENT Tra_numSpaLowGear_mp "" UBYTE OneToOne 1 100 0.00 255.0 ECU_ADDRESS 0xC000B575 /end MEASUREMENT
/begin MEASUREMENT Tra_numSpaMaxGear_mp "" UBYTE OneToOne 1 100 0.00 255.0 ECU_ADDRESS 0xC000B576 /end MEASUREMENT
/begin MEASUREMENT Tra_numSpaMinGear_mp "" SBYTE OneToOne 1 100 -128.0 127.0 ECU_ADDRESS 0xC000B577 /end MEASUREMENT
/begin MEASUREMENT Tra_nWhl "" SWORD EngN 1 100 -16384.00 16383.50 ECU_ADDRESS 0xD0001400 /end MEASUREMENT
/begin MEASUREMENT Tra_rClgDem "Relative Lüfterkühlleistung" SWORD Prc 1 100 -400.0000 399.9878 ECU_ADDRESS 0xD0001402 /end MEASUREMENT
/begin MEASUREMENT Tra_rTraDyn "" SWORD TransR 1 100 -327.6800 327.6700 ECU_ADDRESS 0xD0001404 /end MEASUREMENT
/begin MEASUREMENT Tra_rTraStat "" SWORD TransR 1 100 -327.6800 327.6700 ECU_ADDRESS 0xD0001406 /end MEASUREMENT
/begin MEASUREMENT Tra_rV2NLoRng_mp "Quotient: Geschwindigkeit zu Drehzahl für Vorgelegegetriebe" SWORD VelToN 1 100 -0.3276800 0.3276700 FORMAT "%9.7" ECU_ADDRESS 0xC000AE4A /end MEASUREMENT
/begin MEASUREMENT Tra_rV2NUnFlt_mp "ungefiltertes v/n-Verhältnis" SWORD VelToN 1 100 -0.3276800 0.3276700 FORMAT "%9.7" ECU_ADDRESS 0xC000AE4C /end MEASUREMENT
/begin MEASUREMENT Tra_rVnCor_mp "" SWORD TransR 1 100 -327.6800 327.6700 ECU_ADDRESS 0xC000AE4E /end MEASUREMENT
/begin MEASUREMENT Tra_rVn_mp "" SWORD TransR 1 100 -327.6800 327.6700 ECU_ADDRESS 0xC000AE50 /end MEASUREMENT
/begin MEASUREMENT Tra_stAST "Status AST Eingriff" UWORD OneToOne 1 100 0.00 65535.00 ECU_ADDRESS 0xD0001662 /end MEASUREMENT
/begin MEASUREMENT Tra_stCoEOMASTAdptDem "" UBYTE OneToOne 1 100 0.00 255.0 ECU_ADDRESS 0xD0002593 /end MEASUREMENT
/begin MEASUREMENT Tra_stCoEOMMASTDeb_mp "" UBYTE OneToOne 1 100 0.00 255.0 ECU_ADDRESS 0xC000B56F /end MEASUREMENT
/begin MEASUREMENT Tra_stDrvAway_mp "" UBYTE OneToOne 1 100 0.00 255.0 ECU_ADDRESS 0xC000B56E /end MEASUREMENT
/begin MEASUREMENT Tra_stGearbxHtgUpAct_mp "" UBYTE OneToOne 1 100 0.00 255.0 ECU_ADDRESS 0xC000B570 /end MEASUREMENT
/begin MEASUREMENT Tra_stGearShftIdctr "" UBYTE OneToOne 1 100 0.00 255.0 ECU_ADDRESS 0xD0002594 /end MEASUREMENT
/begin MEASUREMENT Tra_stNSetP "Zustand für aktuelle Solldrehzahl-Anforderung" UBYTE OneToOne 1 100 0.00 255.0 ECU_ADDRESS 0xD0002595 /end MEASUREMENT
/begin MEASUREMENT Tra_stOpModeActMsk_mp "" UBYTE OneToOne 1 100 0.00 255.0 ECU_ADDRESS 0xC000B571 /end MEASUREMENT
/begin MEASUREMENT Tra_stSLckAdjVal "" UBYTE OneToOne 1 100 0.00 255.0 ECU_ADDRESS 0xD0002596 /end MEASUREMENT
/begin MEASUREMENT Tra_stSLckAdjVal_mp "" UBYTE OneToOne 1 100 0.00 255.0 ECU_ADDRESS 0xC000B574 /end MEASUREMENT
/begin MEASUREMENT Tra_stSpaDisbl_mp "" UBYTE OneToOne 1 100 0.00 255.0 ECU_ADDRESS 0xC000B578 /end MEASUREMENT
/begin MEASUREMENT Tra_stSpaDwnShiftUnPlaus_mp "" UBYTE OneToOne 1 100 0.00 255.0 ECU_ADDRESS 0xC000B579 /end MEASUREMENT
/begin MEASUREMENT Tra_stSpaLowGearUnPlaus_mp "" UBYTE OneToOne 1 100 0.00 255.0 ECU_ADDRESS 0xC000B57A /end MEASUREMENT
/begin MEASUREMENT Tra_stSpaPlaus "" UBYTE OneToOne 1 100 0.00 255.0 ECU_ADDRESS 0xD0002597 /end MEASUREMENT
/begin MEASUREMENT Tra_stSpaPlausRaw_mp "" UBYTE OneToOne 1 100 0.00 255.0 ECU_ADDRESS 0xC000B57B /end MEASUREMENT
/begin MEASUREMENT Tra_stSpaUpShiftUnPlaus_mp "" UBYTE OneToOne 1 100 0.00 255.0 ECU_ADDRESS 0xC000B57C /end MEASUREMENT
/begin MEASUREMENT Tra_stStopEna "Stop-Funktion zugelassen" UBYTE OneToOne 1 100 0.00 255.0 ECU_ADDRESS 0xD0002598 /end MEASUREMENT
/begin MEASUREMENT Tra_stStrtEna "Start-Funktion zugelassen" UBYTE OneToOne 1 100 0.00 255.0 ECU_ADDRESS 0xD0002599 /end MEASUREMENT
/begin MEASUREMENT Tra_stTSCPtd "Eingriff zugelassen (für Monitoring)" UBYTE OneToOne 1 100 0.00 255.0 ECU_ADDRESS 0xD000259A /end MEASUREMENT
/begin MEASUREMENT Tra_stTSCRmp2Init_mp "" UBYTE OneToOne 1 100 0.00 255.0 ECU_ADDRESS 0xC000B572 /end MEASUREMENT
/begin MEASUREMENT Tra_stTSCRmp_mp "" UBYTE OneToOne 1 100 0.00 255.0 ECU_ADDRESS 0xC000B573 /end MEASUREMENT
/begin MEASUREMENT Tra_swtSlctGearInfoCan_mp "Schalter für CAN-Info" UBYTE OneToOne 1 100 0.00 255.0 ECU_ADDRESS 0xC000B56D /end MEASUREMENT
/begin MEASUREMENT Tra_tClntDes "Kühlmitteltemperatur-Sollwert" SWORD Temp_Cels 1 100 -3549.940 3003.560 ECU_ADDRESS 0xD0001408 /end MEASUREMENT
/begin MEASUREMENT Tra_tiASTDes "Synchronisationszeit" SWORD Time_s 1 100 -327.6800 327.6700 ECU_ADDRESS 0xD000140C /end MEASUREMENT
/begin MEASUREMENT Tra_tOil "Getriebeöltemperatur" SWORD Temp_Cels 1 100 -3549.940 3003.560 ECU_ADDRESS 0xD000140A /end MEASUREMENT
/begin MEASUREMENT Tra_trqDecDem_mp "Anschließend wird der ausgewählte Momentwert (von CAN oder TRQ_MAX)" SWORD Trq 1 100 -3276.800 3276.700 ECU_ADDRESS 0xC000AE6A /end MEASUREMENT
/begin MEASUREMENT Tra_trqDesMax "endgültige reduzierende Eingriffsmoment (Für den Sollpfad)" SWORD Trq 1 100 -3276.800 3276.700 ECU_ADDRESS 0xD000140E /end MEASUREMENT
/begin MEASUREMENT Tra_trqDesMin "Erhöhendes Wunschmoment Getriebeeingriffe" SWORD Trq 1 100 -3276.800 3276.700 ECU_ADDRESS 0xD0001410 /end MEASUREMENT
/begin MEASUREMENT Tra_trqIncDem_mp "Aktueller Momentenwert (Messpunkt)" SWORD Trq 1 100 -3276.800 3276.700 ECU_ADDRESS 0xC000AE6C /end MEASUREMENT
/begin MEASUREMENT Tra_trqLeadMax "endgültige reduzierende Eingriffsmoment (Für den Vorhaltpfad)" SWORD Trq 1 100 -3276.800 3276.700 ECU_ADDRESS 0xD0001412 /end MEASUREMENT
/begin MEASUREMENT Tra_trqLeadMin "Erhöhendes Vorhaltemoment Getriebeeingriffe" SWORD Trq 1 100 -3276.800 3276.700 ECU_ADDRESS 0xD0001414 /end MEASUREMENT
/begin MEASUREMENT Tra_trqLimDrvAway_mp "" SWORD Trq 1 100 -3276.800 3276.700 ECU_ADDRESS 0xC000AE52 /end MEASUREMENT
/begin MEASUREMENT Tra_trqLimRampIn_mp "" SWORD Trq 1 100 -3276.800 3276.700 ECU_ADDRESS 0xC000AE54 /end MEASUREMENT
/begin MEASUREMENT Tra_trqLos "Getriebeverlustmoment" SWORD Trq 1 100 -3276.800 3276.700 ECU_ADDRESS 0xD0001416 /end MEASUREMENT
/begin MEASUREMENT Tra_trqMaxCur_mp "" SWORD Trq 1 100 -3276.800 3276.700 ECU_ADDRESS 0xC000AE56 /end MEASUREMENT
/begin MEASUREMENT Tra_trqPrtGear_mp "Messpunkt Momentenwert Gang-Pfad" SWORD Trq 1 100 -3276.800 3276.700 ECU_ADDRESS 0xC000AE58 /end MEASUREMENT
/begin MEASUREMENT Tra_trqPrtKnall_mp "Messpunkt Momentenwert Knallstart-Pfad" SWORD Trq 1 100 -3276.800 3276.700 ECU_ADDRESS 0xC000AE5A /end MEASUREMENT
/begin MEASUREMENT TrbChLP_r "" SWORD Prc 1 100 -400.0000 399.9878 ECU_ADDRESS 0xD0001418 /end MEASUREMENT
/begin MEASUREMENT TrbChLP_rPs "" SWORD DtyCyc 1 100 -327.6800 327.6700 ECU_ADDRESS 0xD000141E /end MEASUREMENT
/begin MEASUREMENT TrbCh_ct4WinErr1_mp "" UBYTE OneToOne 1 100 0.00 255.0 ECU_ADDRESS 0xC000B57D /end MEASUREMENT
/begin MEASUREMENT TrbCh_ct4WinErr2_mp "" UBYTE OneToOne 1 100 0.00 255.0 ECU_ADDRESS 0xC000B57E /end MEASUREMENT
/begin MEASUREMENT TrbCh_ct4WinErr3_mp "" UBYTE OneToOne 1 100 0.00 255.0 ECU_ADDRESS 0xC000B57F /end MEASUREMENT
/begin MEASUREMENT TrbCh_ct4WinErr4_mp "" UBYTE OneToOne 1 100 0.00 255.0 ECU_ADDRESS 0xC000B580 /end MEASUREMENT
/begin MEASUREMENT TrbCh_ctPWMIn "" ULONG OneToOne 1 100 0.00 4294967295.00 ECU_ADDRESS 0xD00035E4 /end MEASUREMENT
/begin MEASUREMENT TrbCh_r "" SWORD Prc 1 100 -400.0000 399.9878 ECU_ADDRESS 0xD0001420 /end MEASUREMENT
/begin MEASUREMENT TrbCh_rPs "" SWORD DtyCyc 1 100 -327.6800 327.6700 ECU_ADDRESS 0xD000142A /end MEASUREMENT
/begin MEASUREMENT TrbCh_rRaw "" SWORD DtyCyc 1 100 -327.6800 327.6700 ECU_ADDRESS 0xD000142C /end MEASUREMENT
/begin MEASUREMENT TrbCh_rSens "" SWORD Prc 1 100 -400.0000 399.9878 ECU_ADDRESS 0xD000142E /end MEASUREMENT
/begin MEASUREMENT TrbCh_stActrErr "" UWORD OneToOne 1 100 0.00 65535.00 ECU_ADDRESS 0xD0001664 /end MEASUREMENT
/begin MEASUREMENT TrbCh_stErrMsg_mp "" UBYTE OneToOne 1 100 0.00 255.0 ECU_ADDRESS 0xC000B581 /end MEASUREMENT
/begin MEASUREMENT TSDa_tClntIniVal "erste gültige Wert der Kühlmitteltemperatur am Motoraustritt" SWORD Temp_Cels 1 100 -3549.940 3003.560 ECU_ADDRESS 0xD00013D6 /end MEASUREMENT
/begin MEASUREMENT TSDa_tClntRadOut "Kühlmitteltemperatur am Kühleraustritt" SWORD Temp_Cels 1 100 -3549.940 3003.560 ECU_ADDRESS 0xD00013D8 /end MEASUREMENT
/begin MEASUREMENT TS_tClntEngOut "Kühlmitteltemperatur am Motoraustritt" SWORD Temp_Cels 1 100 -3549.940 3003.560 ECU_ADDRESS 0xD00013E0 /end MEASUREMENT
/begin MEASUREMENT TS_tClntIniVal "" SWORD default 1 100 -32768.00 32767.00 FORMAT "%8.2" ECU_ADDRESS 0xD00013E2 /end MEASUREMENT
/begin MEASUREMENT UDC_dmRdcAgAct "Tatsächlich dosierter Reduktionsmittel-Massenstrom" SWORD SCR_Dm01 1 100 -3276.800 3276.700 FORMAT "%8.3" ECU_ADDRESS 0xD0001442 /end MEASUREMENT
/begin MEASUREMENT UDC_dmRdcAgActAdd_mp "Rückmeldung der eindosierten Menge (für Bypass)" SWORD SCR_Dm01 1 100 -3276.800 3276.700 FORMAT "%8.3" ECU_ADDRESS 0xC000AE7C /end MEASUREMENT
/begin MEASUREMENT UDC_dmRdcAgActByp_mp "Rückmeldung der eindosierten Menge (für Bypass)" SWORD SCR_Dm01 1 100 -3276.800 3276.700 FORMAT "%8.3" ECU_ADDRESS 0xC000AE7E /end MEASUREMENT
/begin MEASUREMENT UDC_dmRdcAgCurrPreLim_mp "Unlimitierter Urea Massenstrom" SLONG SCR_Dm01 1 100 -214748364.800 214748364.700 FORMAT "%13.3" ECU_ADDRESS 0xC00093BC /end MEASUREMENT
/begin MEASUREMENT UDC_dmRdcAgDes "Angeforderter Reduktionsmittel-Massenstrom" SLONG SCR_Dm01 1 100 -214748364.800 214748364.700 FORMAT "%13.3" ECU_ADDRESS 0xD0003038 /end MEASUREMENT
/begin MEASUREMENT UDC_dmRdcAgDesLtd_mp "Limitierter Reduktionsmittel-Massenstrom" SWORD SCR_Dm01 1 100 -3276.800 3276.700 FORMAT "%8.3" ECU_ADDRESS 0xC000AE76 /end MEASUREMENT
/begin MEASUREMENT UDC_dmRdcAgDos "Rückmeldung der eindosierten Menge" SWORD SCR_Dm01 1 100 -3276.800 3276.700 FORMAT "%8.3" ECU_ADDRESS 0xD0001444 /end MEASUREMENT
/begin MEASUREMENT UDC_dmRdcAg_mp "Aus integrierter Dosiermassenanforderung berechneter Massenstrom" SLONG SCR_Dm01 1 100 -214748364.800 214748364.700 FORMAT "%13.3" ECU_ADDRESS 0xC00093C0 /end MEASUREMENT
/begin MEASUREMENT UDC_dmSetP "Massenstromanforderung" SWORD SCR_Dm01 1 100 -3276.800 3276.700 FORMAT "%8.3" ECU_ADDRESS 0xD0001446 /end MEASUREMENT
/begin MEASUREMENT UDC_facUTnkLvlMovAvrg_mp "" SWORD Fact 1 100 -4.000000 3.999878 ECU_ADDRESS 0xC000AE82 /end MEASUREMENT
/begin MEASUREMENT UDC_mRdcAgAct "Integrierte Dosiermassenrückmeldung" UWORD SCR_Mass1000 1 100 0.00 65.53500 FORMAT "%8.5" ECU_ADDRESS 0xD0001666 /end MEASUREMENT
/begin MEASUREMENT UDC_mRdcAgDosQnt "Langzeitdosiermenge" SLONG SCR_Mass1000 1 100 -2147483.64800 2147483.64700 FORMAT "%13.5" ECU_ADDRESS 0xD000303C /end MEASUREMENT
/begin MEASUREMENT UDC_mRdcAgDosQntTmp_mp "temporäre Dosiermenge" SWORD SCR_Mass1000 1 100 -32.76800 32.76700 FORMAT "%8.5" ECU_ADDRESS 0xC000AE74 /end MEASUREMENT
/begin MEASUREMENT UDC_mRdcAg_mp "Integrierte Dosiermassenrückmeldung" UWORD SCR_Mass1000 1 100 0.00 65.53500 FORMAT "%8.5" ECU_ADDRESS 0xC000AE80 /end MEASUREMENT
/begin MEASUREMENT UDC_mSet "Integrierte Dosiermassenanforderung" UWORD SCR_Mass1000 1 100 0.00 65.53500 FORMAT "%8.5" ECU_ADDRESS 0xD0001668 /end MEASUREMENT
/begin MEASUREMENT UDC_mUTnkLvlRdcAgFrz "" SLONG SCR_Mass1000 1 100 -2147483.64800 2147483.64700 FORMAT "%13.5" ECU_ADDRESS 0xD0003040 /end MEASUREMENT
/begin MEASUREMENT UDC_mUTnkLvlRdcAgRmn "Verbleibende Reduktionsmittelmenge" SLONG SCR_Mass1000 1 100 -2147483.64800 2147483.64700 FORMAT "%13.5" ECU_ADDRESS 0xD0003044 /end MEASUREMENT
/begin MEASUREMENT UDC_numUTnkLvlAvrgFld "" SWORD Fact 1 100 -4.000000 3.999878 ARRAY_SIZE 5 ECU_ADDRESS 0xD0001448 /end MEASUREMENT
/begin MEASUREMENT UDC_numUTnkLvlFldSum_mp "" SLONG Fact 1 100 -262144.000000 262143.999878 ECU_ADDRESS 0xC00093C4 /end MEASUREMENT
/begin MEASUREMENT UDC_numUTnkLvlInteg_mp "" SWORD OneToOne 1 100 -32768.00 32767.00 ECU_ADDRESS 0xC000AE84 /end MEASUREMENT
/begin MEASUREMENT UDC_numUTnkLvlSmplCnt_mp "" SWORD OneToOne 1 100 -32768.00 32767.00 ECU_ADDRESS 0xC000AE86 /end MEASUREMENT
/begin MEASUREMENT UDC_rDyc_mp "Duty Cycle Dosierventil" SWORD DtyCyc 1 100 -327.6800 327.6700 ECU_ADDRESS 0xC000AE78 /end MEASUREMENT
/begin MEASUREMENT UDC_rUTnkLvlRdcAgRmn "Verbleibende Reduktionsmittelmenge" SWORD Prc 1 100 -400.0000 399.9878 ECU_ADDRESS 0xD0001452 /end MEASUREMENT
/begin MEASUREMENT UDC_stEEPROMRead "Status des EEP Lesezugriffs in UDC" UBYTE OneToOne 1 100 0.00 255.0 ECU_ADDRESS 0xD000259B /end MEASUREMENT
/begin MEASUREMENT UDC_stEEPROMWrite "Status des EEP Schreibzugriffs in UDC" UBYTE OneToOne 1 100 0.00 255.0 ECU_ADDRESS 0xD000259C /end MEASUREMENT
/begin MEASUREMENT UDC_stRdcAgInteg "" UBYTE OneToOne 1 100 0.00 255.0 ECU_ADDRESS 0xD000259D /end MEASUREMENT
/begin MEASUREMENT UDC_stUTnkLvl "Aktueller Tankfüllstand" UBYTE UTnk_Lvl 1 100 0.00 2.00000000000 FORMAT "%13.11" ECU_ADDRESS 0xD000259E /end MEASUREMENT
/begin MEASUREMENT UDC_stUTnkLvlDeb "" UBYTE OneToOne 1 100 0.00 255.0 ECU_ADDRESS 0xD000259F /end MEASUREMENT
/begin MEASUREMENT UDC_stUTnkLvlUnDeb_mp "" UBYTE OneToOne 1 100 0.00 255.0 ECU_ADDRESS 0xC000B584 /end MEASUREMENT
/begin MEASUREMENT UDC_swtSelectCAN "Wahlschalter Massenstrom / integrierte Masse" UBYTE UDC_CANSwitchState 1 100 0.00 2.00000000000 FORMAT "%13.11" ECU_ADDRESS 0xD00025A0 /end MEASUREMENT
/begin MEASUREMENT UDC_tiPer_mp "Periodendauer Dosierventil" SWORD Period 1 100 -3276.800 3276.700 FORMAT "%8.3" ECU_ADDRESS 0xC000AE7A /end MEASUREMENT
/begin MEASUREMENT UDosVlv_rDyc "" SWORD DtyCyc 1 100 -327.6800 327.6700 ECU_ADDRESS 0xD0001454 /end MEASUREMENT
/begin MEASUREMENT UDosVlv_rDyc_mp "Angefordertes Tastverhältnis" SWORD DtyCyc 1 100 -327.6800 327.6700 ECU_ADDRESS 0xC000AE88 /end MEASUREMENT
/begin MEASUREMENT UDosVlv_rPs "" SWORD DtyCyc 1 100 -327.6800 327.6700 ECU_ADDRESS 0xD0001456 /end MEASUREMENT
/begin MEASUREMENT UDosVlv_tiPer "" SWORD Period 1 100 -3276.800 3276.700 FORMAT "%8.3" ECU_ADDRESS 0xD0001458 /end MEASUREMENT
/begin MEASUREMENT UHC_stC1 "Status der C1 - Statemachine" UBYTE UHC_StM_Compu 1 100 0.00 5.00000000000 FORMAT "%13.11" ECU_ADDRESS 0xD00025A1 /end MEASUREMENT
/begin MEASUREMENT UHC_stC2 "Status der C2 - Statemachine" UBYTE UHC_StM_Compu 1 100 0.00 5.00000000000 FORMAT "%13.11" ECU_ADDRESS 0xD00025A2 /end MEASUREMENT
/begin MEASUREMENT UHC_stCReq "Anforderung zum Heizen des Tanks und / oder der Druckleitung" UBYTE OneToOne 1 100 0.00 255.0 ECU_ADDRESS 0xD00025A3 /end MEASUREMENT
/begin MEASUREMENT UHC_stCtl "Status der Tanktemperatur und Auftauen der Druckleitung" UBYTE OneToOne 1 100 0.00 255.0 ECU_ADDRESS 0xD00025A4 /end MEASUREMENT
/begin MEASUREMENT UHC_stDfrstChk "Status der Auftauprüfung" UBYTE OneToOne 1 100 0.00 255.0 ECU_ADDRESS 0xD00025A5 /end MEASUREMENT
/begin MEASUREMENT UHC_stEEPROMRead_mp "Status des EEPROM Lesens für die Heizzustände" UBYTE SCR_EepReadSt_Compu 1 100 10.0000000000 13.0000000000 FORMAT "%13.10" ECU_ADDRESS 0xC000B585 /end MEASUREMENT
/begin MEASUREMENT UHC_stEEPROMWrite_mp "Status des EEPROM Schreibens der Heizzustände" UBYTE SCR_EepWriteSt_Compu 1 100 20.0000000000 23.0000000000 FORMAT "%13.10" ECU_ADDRESS 0xC000B586 /end MEASUREMENT
/begin MEASUREMENT UHC_stFullReq_mp "Heizanforderung beider Heizkreise" UBYTE OneToOne 1 100 0.00 255.0 ECU_ADDRESS 0xC000B58C /end MEASUREMENT
/begin MEASUREMENT UHC_stHystC1Dfrst_mp "Status Hystereseausgang der Auftauzeitbestimmung" UBYTE OneToOne 1 100 0.00 255.0 ECU_ADDRESS 0xC000B587 /end MEASUREMENT
/begin MEASUREMENT UHC_stHystC1On_mp "Status Hystereseausgang der Heizzeitbestimmung" UBYTE OneToOne 1 100 0.00 255.0 ECU_ADDRESS 0xC000B588 /end MEASUREMENT
/begin MEASUREMENT UHC_stMonC1 "Freigabe Heizkreis 1 (Tank)" UBYTE stMonCnv 1 100 0.00 2.00000000000 FORMAT "%13.11" ECU_ADDRESS 0xD00025A6 /end MEASUREMENT
/begin MEASUREMENT UHC_stMonC1PwrMng_mp "Freigabe Heizkreis 1 (Tank) unter Berücksichtigung des Powermanagements" UBYTE stMonCnv 1 100 0.00 2.00000000000 FORMAT "%13.11" ECU_ADDRESS 0xC000B589 /end MEASUREMENT
/begin MEASUREMENT UHC_stMonC2 "Freigabe Heizkreis 2 (Druckleitung)" UBYTE stMonCnv 1 100 0.00 2.00000000000 FORMAT "%13.11" ECU_ADDRESS 0xD00025A7 /end MEASUREMENT
/begin MEASUREMENT UHC_stMonC2PwrMng_mp "Freigabe Heizkreis 2 (Druckleitung) unter Berücksichtigung des Powermanagements" UBYTE stMonCnv 1 100 0.00 2.00000000000 FORMAT "%13.11" ECU_ADDRESS 0xC000B58A /end MEASUREMENT
/begin MEASUREMENT UHC_stTstRls "Vorläufige Heizungsfreigabe für die Hauptzustandsautomaten" UBYTE OneToOne 1 100 0.00 255.0 ECU_ADDRESS 0xD00025A8 /end MEASUREMENT
/begin MEASUREMENT UHC_stUTnkTemp_mp "Tank gefroren" UBYTE OneToOne 1 100 0.00 255.0 ECU_ADDRESS 0xC000B58B /end MEASUREMENT
/begin MEASUREMENT UHC_tEnvTFrz "Eingefrorene Umgebungstemperatur" SWORD Temp_Cels 1 100 -3549.940 3003.560 ECU_ADDRESS 0xD000145C /end MEASUREMENT
/begin MEASUREMENT UHC_tiC1DfrstTmr_mp "angeforderte Auftauzeit" SLONG SCR_Time10 1 100 -214748364.800 214748364.700 FORMAT "%13.3" ECU_ADDRESS 0xC00093C8 /end MEASUREMENT
/begin MEASUREMENT UHC_tiC1DlyTmr_mp "angeforderte Verzögerungszeit" SLONG SCR_Time10 1 100 -214748364.800 214748364.700 FORMAT "%13.3" ECU_ADDRESS 0xC00093CC /end MEASUREMENT
/begin MEASUREMENT UHC_tiC1OnTmr_mp "angeforderte Heizzeit" SLONG SCR_Time10 1 100 -214748364.800 214748364.700 FORMAT "%13.3" ECU_ADDRESS 0xC00093D0 /end MEASUREMENT
/begin MEASUREMENT UHC_tiC1TO_mp "C1 Timeout Timer" SWORD SCR_Time10 1 100 -3276.800 3276.700 FORMAT "%8.3" ECU_ADDRESS 0xC000AE8A /end MEASUREMENT
/begin MEASUREMENT UHC_tiC1_mp "Aktuelle Zeit für Heizen / nicht Heizen von Heizkreis 1 (Tankheizung)" SLONG SCR_Time10 1 100 -214748364.800 214748364.700 FORMAT "%13.3" ECU_ADDRESS 0xC00093D4 /end MEASUREMENT
/begin MEASUREMENT UHC_tiC2TO_mp "C2 Timeout Timer" SWORD SCR_Time10 1 100 -3276.800 3276.700 FORMAT "%8.3" ECU_ADDRESS 0xC000AE8C /end MEASUREMENT
/begin MEASUREMENT UHC_tiC2_mp "Aktuelle Zeit für Heizen / nicht Heizen von Heizkreis 2 (Druckleitung)" SWORD SCR_Time10 1 100 -3276.800 3276.700 FORMAT "%8.3" ECU_ADDRESS 0xC000AE8E /end MEASUREMENT
/begin MEASUREMENT UHC_tiTmrC1_mp "Gesamtzeit für Heizen / nicht Heizen von Heizkreis 1 (Tank)" SLONG SCR_Time10 1 100 -214748364.800 214748364.700 FORMAT "%13.3" ECU_ADDRESS 0xC00093D8 /end MEASUREMENT
/begin MEASUREMENT UHC_tiTmrC2_mp "Gesamtzeit für Heizen / nicht Heizen von Heizkreis 2 (Druckleitung)" SWORD SCR_Time10 1 100 -3276.800 3276.700 FORMAT "%8.3" ECU_ADDRESS 0xC000AE90 /end MEASUREMENT
/begin MEASUREMENT UHC_tUTnkTFrz "Eingefrorene Tanktemperatur" SWORD Temp_Cels 1 100 -3549.940 3003.560 ECU_ADDRESS 0xD000145E /end MEASUREMENT
/begin MEASUREMENT UHtrPL_iDia "" SWORD Ampere 1 100 -6553.600 6553.400 FORMAT "%8.3" ECU_ADDRESS 0xD0001460 /end MEASUREMENT
/begin MEASUREMENT UHtrPL_iSensDia "" SWORD Ampere 1 100 -6553.600 6553.400 FORMAT "%8.3" ECU_ADDRESS 0xD0001462 /end MEASUREMENT
/begin MEASUREMENT UHtrPL_st "" SWORD OneToOne 1 100 -32768.00 32767.00 ECU_ADDRESS 0xD0001464 /end MEASUREMENT
/begin MEASUREMENT UHtrPL_stPs "" SWORD OneToOne 1 100 -32768.00 32767.00 ECU_ADDRESS 0xD0001466 /end MEASUREMENT
/begin MEASUREMENT UHtrPL_uRawDia "" SWORD Volt 1 100 -6553.600 6553.400 ECU_ADDRESS 0xD0001468 /end MEASUREMENT
/begin MEASUREMENT UHtrTnk_iDia "" SWORD Ampere 1 100 -6553.600 6553.400 FORMAT "%8.3" ECU_ADDRESS 0xD000146A /end MEASUREMENT
/begin MEASUREMENT UHtrTnk_iSensDia "" SWORD Ampere 1 100 -6553.600 6553.400 FORMAT "%8.3" ECU_ADDRESS 0xD000146C /end MEASUREMENT
/begin MEASUREMENT UHtrTnk_st "" SWORD OneToOne 1 100 -32768.00 32767.00 ECU_ADDRESS 0xD000146E /end MEASUREMENT
/begin MEASUREMENT UHtrTnk_stPs "Status der Endstufe Tankheizung" SWORD OneToOne 1 100 -32768.00 32767.00 ECU_ADDRESS 0xD0001470 /end MEASUREMENT
/begin MEASUREMENT UHtrTnk_uRawDia "" SWORD Volt 1 100 -6553.600 6553.400 ECU_ADDRESS 0xD0001472 /end MEASUREMENT
/begin MEASUREMENT UPmpMot_r "" SWORD Prc 1 100 -400.0000 399.9878 ECU_ADDRESS 0xD0001474 /end MEASUREMENT
/begin MEASUREMENT UPmpMot_rCalc_mp "" SWORD DtyCyc 1 100 -327.6800 327.6700 ECU_ADDRESS 0xC000AE92 /end MEASUREMENT
/begin MEASUREMENT UPmpMot_rCor_mp "" SWORD DtyCyc 1 100 -327.6800 327.6700 ECU_ADDRESS 0xC000AE94 /end MEASUREMENT
/begin MEASUREMENT UPmpMot_rPs "" SWORD DtyCyc 1 100 -327.6800 327.6700 ECU_ADDRESS 0xD0001476 /end MEASUREMENT
/begin MEASUREMENT UPmpMot_r_mp "" SWORD Prc 1 100 -400.0000 399.9878 ECU_ADDRESS 0xC000AE96 /end MEASUREMENT
/begin MEASUREMENT UPmpMot_stPrevTstRslt_mp "" UBYTE OneToOne 1 100 0.00 255.0 ECU_ADDRESS 0xC000B58D /end MEASUREMENT
/begin MEASUREMENT URevVlv_st "Message für den Status des digitalen Eingangs zum 4/2 Wegeventil-Steller." UBYTE OneToOne 1 100 0.00 255.0 ECU_ADDRESS 0xD00025A9 /end MEASUREMENT
/begin MEASUREMENT URevVlv_stPs "Message für den Status des digitalen Ausgangs zum 4/2 Wegeventil-Steller." UBYTE OneToOne 1 100 0.00 255.0 ECU_ADDRESS 0xD00025AA /end MEASUREMENT
/begin MEASUREMENT VehMot_a2trq "Umrechnungsfaktor Beschleunigung in Vortriebsmoment" SWORD MassLength 1 100 -6553.600 6553.400 FORMAT "%8.3" ECU_ADDRESS 0xD00014B0 /end MEASUREMENT
/begin MEASUREMENT VehMot_aPrpCurr "Momentane, geschätzte Beschleunigung" SWORD Acc 1 100 -32.76800 32.76700 FORMAT "%8.5" ECU_ADDRESS 0xD00014B2 /end MEASUREMENT
/begin MEASUREMENT VehMot_aPrpMax "Maximal mögliche Beschleunigung im momentanen Gang" SWORD Acc 1 100 -32.76800 32.76700 FORMAT "%8.5" ECU_ADDRESS 0xD00014B4 /end MEASUREMENT
/begin MEASUREMENT VehMot_aPrpMin "Minimal mögliche Beschleunigung im momentanen Gang" SWORD Acc 1 100 -32.76800 32.76700 FORMAT "%8.5" ECU_ADDRESS 0xD00014B6 /end MEASUREMENT
/begin MEASUREMENT VehMot_tiTrqDragPT1 "Zeitkonstante für Filterung geschätzten Fahrwiderstand" SWORD Time_s_1 1 100 -32.76800 32.76700 FORMAT "%8.5" ECU_ADDRESS 0xD0005022 /end MEASUREMENT
/begin MEASUREMENT VehMot_trqDrag "Gesamter Fahrwiderstand" SLONG TrqPrpHigh 1 100 -214748364.800 214748364.700 ECU_ADDRESS 0xD000306C /end MEASUREMENT
/begin MEASUREMENT VehMot_trqDragEst_mp "Geschätzter Fahrwiderstand" SLONG TrqPrpHigh 1 100 -214748364.800 214748364.700 ECU_ADDRESS 0xC00093DC /end MEASUREMENT
/begin MEASUREMENT VehMot_trqPrpFlt_mp "Aktuelles Vortriebsmoment, gefiltert" SLONG TrqPrpHigh 1 100 -214748364.800 214748364.700 ECU_ADDRESS 0xC00093E0 /end MEASUREMENT
/begin MEASUREMENT VehMot_trqThresComp "Schwelle für komplette Kompensation der Nebenaggregate" SWORD TrqPrpHigh 1 100 -3276.800 3276.700 ECU_ADDRESS 0xD0003080 /end MEASUREMENT
/begin MEASUREMENT VehMot_trqWoComp_mp "Vortriebsmoment ohne Kompensationsanteil" SLONG TrqPrpHigh 1 100 -214748364.800 214748364.700 ECU_ADDRESS 0xC00093E4 /end MEASUREMENT
/begin MEASUREMENT VehV_a "" SWORD Acc 1 100 -32.76800 32.76700 FORMAT "%8.5" ECU_ADDRESS 0xD00014CE /end MEASUREMENT
/begin MEASUREMENT VehV_aRawUnFlt_mp "" SWORD Acc 1 100 -32.76800 32.76700 FORMAT "%8.5" ECU_ADDRESS 0xC000AE9E /end MEASUREMENT
/begin MEASUREMENT VehV_aVeh "" SWORD VehVAcc 1 100 -327.6800 327.6700 FORMAT "%8.4" ECU_ADDRESS 0xD0003084 /end MEASUREMENT
/begin MEASUREMENT VehV_aVehUnFlt_mp "" SWORD VehVAcc 1 100 -327.6800 327.6700 FORMAT "%8.4" ECU_ADDRESS 0xC000AE9A /end MEASUREMENT
/begin MEASUREMENT VehV_v "" SWORD Vel 1 100 -327.6800 327.6700 ECU_ADDRESS 0xD00014D0 /end MEASUREMENT
/begin MEASUREMENT VehV_vRawOld_mp "" SWORD Vel 1 100 -327.6800 327.6700 ECU_ADDRESS 0xC000AE9C /end MEASUREMENT
/begin MEASUREMENT VehV_vUnFlt_mp "" SWORD Vel 1 100 -327.6800 327.6700 ECU_ADDRESS 0xC000AEA0 /end MEASUREMENT
/begin FUNCTION TCPrt_ChrgPmpCtl ""
 /begin DEF_CHARACTERISTIC TCPrt_dnChrgPmpCtlHigh_CUR TCPrt_dnChrgPmpCtlLow_CUR TCPrt_mskClthDly_C TCPrt_nChrgPmpMon1_C TCPrt_nChrgPmpMon2_C TCPrt_nHLSDemBase_C TCPrt_nSetPointHLSDem_C TCPrt_nTSCOfs_CUR TCPrt_qChrgPmpCtlHigh_CUR TCPrt_qChrgPmpCtlLow_CUR TCPrt_rChrgPmpCtlValHigh_MAP TCPrt_rChrgPmpCtlValOfs_CUR TCPrt_rChrgPmpCtlVal_MAP TCPrt_rChrgPmpHigh_MAP TCPrt_rChrgPmpOfs_CUR TCPrt_rChrgPmpPhysHigh_CUR TCPrt_rPmpLow_C TCPrt_swtChrgPmpGearHLSDem_C TCPrt_swtChrgPmpGearTrbCh_C TCPrt_swtOffStat1_C TCPrt_tiChrgPmpCtlHiLo_C TCPrt_tiChrgPmpCtlLoHi_C TCPrt_tiChrgPmpMonHLSDem_C TCPrt_tiChrgPmpPT1_C TCPrt_tiClthDlyHiLo_C TCPrt_tiClthDlyLoHi_C /end DEF_CHARACTERISTIC
 /begin IN_MEASUREMENT Air_pIntkVUs ASMod_dmCmprUsRed ASMod_rPresCmprFMod Clth_st EnvP_p Epm_dnEng Epm_nEng Gbx_nTrbn PCR_qCtlVal PT_stTraType VehV_v /end IN_MEASUREMENT
 /begin OUT_MEASUREMENT TCPrt_dnAvrg TCPrt_nSetPointChrgPmp TCPrt_rChrgPmpCtlVal TCPrt_rPresRat TCPrt_stChrgPmpCtl /end OUT_MEASUREMENT
 /begin LOC_MEASUREMENT TCPrt_dnAvrgNeg_mp TCPrt_dnChrgPmpCtlHigh_mp TCPrt_dnChrgPmpCtlLow_mp TCPrt_nTSCOfs_mp TCPrt_qChrgPmpCtlHigh_mp TCPrt_qChrgPmpCtlLow_mp TCPrt_rChrgPmpCtlValHigh_mp TCPrt_rChrgPmpCtlValLow_mp TCPrt_rChrgPmpHysHigh_mp TCPrt_rChrgPmpHysLow_mp TCPrt_rChrgPmpPhysHigh_mp TCPrt_stChrgPmp1_mp TCPrt_stChrgPmpCtl_mp TCPrt_stChrgPmpHLSDem_mp TCPrt_stChrgPmpPre1_mp /end LOC_MEASUREMENT
/end FUNCTION
/begin FUNCTION TCPrt_ChrgPmpDet ""
 /begin DEF_CHARACTERISTIC TCPrt_DkdChrgPmpDetMDT12_C TCPrt_DkdChrgPmpDetMDT1_C TCPrt_facAFSensAmpMax_C TCPrt_facAFSensAmpMin_C TCPrt_facCnv_CUR TCPrt_tiAFSensPTCtlFlt1_C TCPrt_tiAFSensPTCtlFlt2_C TCPrt_tiAFSensPTCtlFlt3_C TCPrt_tiChrgPmpDetMDT12_C TCPrt_tiChrgPmpDetMDT1_C TCPrt_tiDebChrgPmpHiLo_C TCPrt_tiDebChrgPmpLoHi_C TCPrt_tiDebPreChrgPmpDetHiLo_C TCPrt_tiDebPreChrgPmpDetLoHi_C /end DEF_CHARACTERISTIC
 /begin IN_MEASUREMENT AFS_dmSens /end IN_MEASUREMENT
 /begin OUT_MEASUREMENT TCPrt_facAFSensAmpFlt TCPrt_stChrgPmp TCPrt_stPreChrgPmp /end OUT_MEASUREMENT
 /begin LOC_MEASUREMENT TCPrt_facAFSensAmpFlt_mp TCPrt_facAFSensDTAbsAmp2_mp TCPrt_facAFSensDTAmp12_mp TCPrt_facAFSensPTAmp12_mp TCPrt_facAFSensPTAmp1_mp TCPrt_facAFSensPTAmp2_mp TCPrt_facAFSensPTAmpFlt_mp /end LOC_MEASUREMENT
/end FUNCTION
/begin FUNCTION TCPrt_ChrgPmpGov ""
 /begin DEF_CHARACTERISTIC TCPrt_DKdChrgPmpCtlQDT1_C TCPrt_dnChrgPmpCtlRls_C TCPrt_dpChrgPmpCtlRmpDwn_C TCPrt_dpChrgPmpCtlRmpUp_C TCPrt_dqChrgPmpCtlRls_C TCPrt_drChrgPmpCtlRmpDwn_C TCPrt_drChrgPmpCtlRmpUp_C TCPrt_facChrgPmpDes_MAP TCPrt_facChrgPmpIWinNeg_C TCPrt_facChrgPmpIWinPos_C TCPrt_facChrgPmpI_MAP TCPrt_facChrgPmpPWinNeg_C TCPrt_facChrgPmpPWinPos_C TCPrt_facChrgPmpP_MAP TCPrt_IChrgPmpKiNeg_C TCPrt_IChrgPmpKiPos_C TCPrt_IChrgPmpKi_C TCPrt_pChrgPmpCtlVal_MAP TCPrt_PChrgPmpKpNeg_C TCPrt_PChrgPmpKpPos_C TCPrt_PChrgPmpKp_C TCPrt_pChrgPmpMax_MAP TCPrt_pChrgPmpMin_MAP TCPrt_pDesChrgPmp_CUR TCPrt_pDvtChrgPmpCtlRls_C TCPrt_rChrgPmpGovOff_CUR TCPrt_rChrgPmpGovOn_MAP TCPrt_rChrgPmpGov_MAP TCPrt_swtChrgPmpGovActv_C TCPrt_swtChrgPmpGovSel_C TCPrt_tiChrgPmpCtlHiLoRls3_C TCPrt_tiChrgPmpCtlLoHiRls3_C TCPrt_tiChrgPmpCtlQDT1_C TCPrt_tiChrgPmpGovPT1_C TCPrt_tiChrgPmpGovRlsAllHiLo_C TCPrt_tiChrgPmpGovRlsAllLoHi_C /end DEF_CHARACTERISTIC
 /begin IN_MEASUREMENT EnvP_pSens Epm_nEng /end IN_MEASUREMENT
 /begin OUT_MEASUREMENT TCPrt_pDesChrgPmpGov TCPrt_rChrgPmpGov TCPrt_swtChrgPmpGov /end OUT_MEASUREMENT
 /begin LOC_MEASUREMENT TCPrt_dqInjCtlQRaw_mp TCPrt_facChrgPmpDes_mp TCPrt_facChrgPmpGovDevI_mp TCPrt_facChrgPmpGovDev_mp TCPrt_facChrgPmpI_mp TCPrt_facChrgPmpP_mp TCPrt_pChrgPmpCtlVal_mp TCPrt_pChrgPmpMax_mp TCPrt_pChrgPmpMin_mp TCPrt_pChrgPmpPICtlLim_mp TCPrt_pChrgPmpPICtl_mp TCPrt_pChrgPmpstI_mp TCPrt_pDesChrgPmpRaw_mp TCPrt_pOutI_mp TCPrt_pOutP_mp TCPrt_rChrgPmpGovHysOff_mp TCPrt_rChrgPmpGovOff_mp TCPrt_rChrgPmpGovOn_mp TCPrt_rChrgPmpGovRaw_mp TCPrt_swtChrgPmpGovRls_mp TCPrt_swtChrgPmpGovSel_mp /end LOC_MEASUREMENT
/end FUNCTION
/begin FUNCTION TECU_DD "" /begin DEF_CHARACTERISTIC TECU_SRC.uMin_C TECU_SRC.uMax_C TECU_tTransf_CUR /end DEF_CHARACTERISTIC /begin OUT_MEASUREMENT TECU_tSens TECU_uRaw /end OUT_MEASUREMENT /end FUNCTION
/begin FUNCTION TECU_VD ""
 /begin DEF_CHARACTERISTIC TECU_RmpSlp.Pos_C TECU_RmpSlp.Neg_C TECU_tOvrTemp_C TECU_TransStg.Dfl_C TECU_TransStg.stSensId_C /end DEF_CHARACTERISTIC
 /begin OUT_MEASUREMENT TECU_t /end OUT_MEASUREMENT
/end FUNCTION
/begin FUNCTION ThrVlv_DD ""
 /begin DEF_CHARACTERISTIC ThrVlv_4WinDiagDeb.ct4WinErr1DebDef_C ThrVlv_4WinDiagDeb.ct4WinErr2DebDef_C ThrVlv_4WinDiagDeb.ct4WinErr3DebDef_C ThrVlv_4WinDiagDeb.ct4WinErr4DebDef_C ThrVlv_4WinDiagDeb.ti4WinErrDebDef_C ThrVlv_4WinSigDur.tiErr1Min_C ThrVlv_4WinSigDur.tiErr1Max_C ThrVlv_4WinSigDur.tiErr2Min_C ThrVlv_4WinSigDur.tiErr2Max_C ThrVlv_4WinSigDur.tiErr3Min_C ThrVlv_4WinSigDur.tiErr3Max_C ThrVlv_4WinSigDur.tiErr4Min_C ThrVlv_4WinSigDur.tiErr4Max_C ThrVlv_Pwm.tiPer_C ThrVlv_Pwm.stLvl_C ThrVlv_Pwm.rMaxDty_C ThrVlv_Pwm.rPerUn_C ThrVlv_Pwm.tiPh_C ThrVlv_PwmOut.rMin_C ThrVlv_PwmOut.rMax_C ThrVlv_PwmOut.tiBtwTstSCB_C ThrVlv_PwmOut.tiBtwTstOT_C ThrVlv_PwmOut.numTstMax_C ThrVlv_PwmOut.swtBattCor_C ThrVlv_PwmOut.swtPsInv_C ThrVlv_rCnv_MAP ThrVlv_rPsDisbl_C ThrVlv_stPsDiaDisbl_C ThrVlv_stPsDisbl_C ThrVlv_typ4WinDia_C /end DEF_CHARACTERISTIC
 /begin IN_MEASUREMENT BattU_facCor DevLib_stPwrStgEnaCond Epm_nEng /end IN_MEASUREMENT
 /begin OUT_MEASUREMENT ThrVlv_r ThrVlv_rPs /end OUT_MEASUREMENT
 /begin LOC_MEASUREMENT ThrVlv_ct4WinErr1_mp ThrVlv_ct4WinErr2_mp ThrVlv_ct4WinErr3_mp ThrVlv_ct4WinErr4_mp ThrVlv_stErrMsg_mp /end LOC_MEASUREMENT
/end FUNCTION
/begin FUNCTION ThrVlv_DDSens "" /begin DEF_CHARACTERISTIC ThrVlv_rTransf_CUR ThrVlv_SRC.uMin_C ThrVlv_SRC.uMax_C /end DEF_CHARACTERISTIC /begin OUT_MEASUREMENT ThrVlv_rSens ThrVlv_uRaw /end OUT_MEASUREMENT /end FUNCTION
/begin FUNCTION ThrVlv_VDMon ""
 /begin DEF_CHARACTERISTIC ThrVlv_ctMonDefLimH_C ThrVlv_ctMonDefLimL_C ThrVlv_pLimMon_C ThrVlv_swtMon_C /end DEF_CHARACTERISTIC
 /begin IN_MEASUREMENT Air_pIntkVUs CoEng_stShutOffPath EnvP_p SyC_stSub /end IN_MEASUREMENT
 /begin LOC_MEASUREMENT ThrVlv_ctMonDef_mp ThrVlv_pDiffMaxMon_mp ThrVlv_stMon_mp /end LOC_MEASUREMENT
/end FUNCTION
/begin FUNCTION ThrVlv_VDSens ""
 /begin DEF_CHARACTERISTIC ThrVlv_RmpSlp.Pos_C ThrVlv_RmpSlp.Neg_C ThrVlv_TransStagePar.Dfl_C ThrVlv_TransStagePar.stSensId_C /end DEF_CHARACTERISTIC
 /begin OUT_MEASUREMENT ThrVlv_rAct /end OUT_MEASUREMENT
/end FUNCTION
/begin FUNCTION Tle6232 "" /end FUNCTION
/begin FUNCTION TOxiCatUs_DD ""
 /begin DEF_CHARACTERISTIC Exh_SRCTOxiCatUs.uMin_C Exh_SRCTOxiCatUs.uMax_C Exh_swtSensTOxiCatUs_C Exh_tTransfTOxiCatUs_CUR /end DEF_CHARACTERISTIC
 /begin OUT_MEASUREMENT Exh_tSensTOxiCatUs Exh_uRawTOxiCatUs /end OUT_MEASUREMENT
/end FUNCTION
/begin FUNCTION TOxiCatUs_DD_Inl "" /begin DEF_CHARACTERISTIC Exh_tMntCortOxiCat_MAP /end DEF_CHARACTERISTIC /begin IN_MEASUREMENT ASMod_dmPFltUs Exh_tSensTOxiCatUs /end IN_MEASUREMENT /end FUNCTION
/begin FUNCTION TOxiCatUs_VD ""
 /begin DEF_CHARACTERISTIC Exh_numFldTOxiCatUs_C Exh_numTOxiCatUs_C Exh_RmpSlpTOxiCatUs.Pos_C Exh_RmpSlpTOxiCatUs.Neg_C Exh_stMskLckNplTOxiCatUs_C Exh_tDiffNegTOxiCatUs_CUR Exh_tDiffPosTOxiCatUs_CUR Exh_tiLckNplRgnTOxiCatUs_C Exh_tiLckNplTOxiCatUs_C Exh_tiLPFltPT1TOxiCatUs_C Exh_TransStgTOxiCatUs.Dfl_C Exh_TransStgTOxiCatUs.stSensId_C /end DEF_CHARACTERISTIC
 /begin IN_MEASUREMENT ASMod_tEGFld CoEng_st CoEOM_stOpModeAct Exh_tFld /end IN_MEASUREMENT
 /begin OUT_MEASUREMENT Exh_tAdapTOxiCatUs Exh_tOxiCatUs /end OUT_MEASUREMENT
 /begin LOC_MEASUREMENT Exh_stEgtTOxiCatUs_mp Exh_stTmrPlausTOxiCatUs_mp Exh_tDiffNegTOxiCatUs_mp Exh_tDiffPosTOxiCatUs_mp Exh_tModTOxiCatUs_mp /end LOC_MEASUREMENT
/end FUNCTION
/begin FUNCTION TPFltUs_DD ""
 /begin DEF_CHARACTERISTIC Exh_SRCTPFltUs.uMin_C Exh_SRCTPFltUs.uMax_C Exh_tTransfTPFltUs_CUR /end DEF_CHARACTERISTIC
 /begin OUT_MEASUREMENT Exh_tSensTPFltUs Exh_uRawTPFltUs /end OUT_MEASUREMENT
/end FUNCTION
/begin FUNCTION TPFltUs_DD_Inl "" /begin DEF_CHARACTERISTIC Exh_tMntCor_MAP /end DEF_CHARACTERISTIC /begin IN_MEASUREMENT ASMod_dmPFltUs Exh_tSensTPFltUs /end IN_MEASUREMENT /end FUNCTION
/begin FUNCTION TPFltUs_VD ""
 /begin DEF_CHARACTERISTIC Exh_numTPFltUs_C Exh_RmpSlpTPFltUs.Pos_C Exh_RmpSlpTPFltUs.Neg_C Exh_stMaskLckNplTPFltUs_C Exh_swtDflTPFltUs_C Exh_swtTPFltUsASModSel_C Exh_tDiffNegTPFltUs_CUR Exh_tDiffPosTPFltUs_CUR Exh_tiLckNplRgnTPFltUs_C Exh_tiLckNplTPFltUs_C Exh_TransStageParTPFltUs.Dfl_C Exh_TransStageParTPFltUs.stSensId_C /end DEF_CHARACTERISTIC
 /begin IN_MEASUREMENT ASMod_tEGFld CoEng_st CoEOM_stOpModeAct /end IN_MEASUREMENT
 /begin OUT_MEASUREMENT Exh_tAdapTPFltUs Exh_tPFltUs /end OUT_MEASUREMENT
 /begin LOC_MEASUREMENT Exh_tDiffNegTPFltUs_mp Exh_tDiffPosTPFltUs_mp Exh_tDiffTPFltUs_mp Exh_tEGFldTPFltUs_mp /end LOC_MEASUREMENT
/end FUNCTION
/begin FUNCTION TpNC "" /end FUNCTION
/begin FUNCTION Tprot_Rp "" /end FUNCTION
/begin FUNCTION Tprot_Std "" /end FUNCTION
/begin FUNCTION Tra_Add ""
 /begin DEF_CHARACTERISTIC Tra_bCanAirCanPtd_C Tra_bCanClntCanPtd_C Tra_rClgDem_C Tra_tClntDes_C /end DEF_CHARACTERISTIC
 /begin IN_MEASUREMENT Gbx_rFanClgDem Gbx_tClntDes /end IN_MEASUREMENT
 /begin OUT_MEASUREMENT Tra_rClgDem Tra_tClntDes /end OUT_MEASUREMENT
/end FUNCTION
/begin FUNCTION Tra_GearInfo ""
 /begin DEF_CHARACTERISTIC PT_rTraGear1_C PT_rTraGear2_C PT_rTraGear3_C PT_rTraGear4_C PT_rTraGear5_C PT_rTraGear6_C PT_rTraGear7_C PT_rTraGearR_C PT_rTraLoRng_C PT_rTraMax_C Tra_bCanInfoCan_C Tra_bCanLevPos_C Tra_bCanLoRng_C Tra_bCanRevGear_C Tra_bCanRTra_C Tra_bGbxNPosEna_C Tra_bStrtStopEnaDfl_C Tra_drTraDfl.Pos_C Tra_drTraDfl.Neg_C Tra_facConv_C Tra_facVnCor_C Tra_nEngMin_C Tra_numLevPosCan_C Tra_rTraDfl_C Tra_rV2NDfl_C Tra_rV2NMax_C Tra_rV2NMin_C Tra_rVn1H_C Tra_rVn1L_C Tra_rVn1To2Des_C Tra_rVn2H_C Tra_rVn2L_C Tra_rVn2To3Des_C Tra_rVn3H_C Tra_rVn3L_C Tra_rVn3To4Des_C Tra_rVn4H_C Tra_rVn4L_C Tra_rVn4To5Des_C Tra_rVn5H_C Tra_rVn5L_C Tra_rVn5To6Des_C Tra_rVn6H_C Tra_rVn6L_C Tra_rVnRH_C Tra_rVnRL_C Tra_stLevPosD_C Tra_swtDfl_C Tra_swtLevPosSlct_CA Tra_swtTypeSlct_CA Tra_tiNPT1_C Tra_tiV2NPT1_C Tra_tOilDfl_C Tra_vLimRTra_C Tra_vMin_C /end DEF_CHARACTERISTIC
 /begin IN_MEASUREMENT Com_rTrq Dfftl_bLowRng Epm_nEng GbxNPos_st Gbx_bRevGear Gbx_numGear Gbx_numGearTrgt Gbx_rTrqTra Gbx_stGearLvr GlbDa_lWhlCirc GlbDa_vX GlbDa_vXFlt PT_stTraType VehMot_rTrqDfftl VehV_v /end IN_MEASUREMENT
 /begin OUT_MEASUREMENT PT_rTraGear PT_rTraGear1 PT_rTraGear2 PT_rTraGear3 PT_rTraGear4 PT_rTraGear5 PT_rTraGear6 PT_rTraGear7 PT_rTraGearDes PT_rTraGearR PT_rTraV2N PT_stTraLoRng PT_stTraRevGear PT_stTraShftOp Tra_numGear Tra_numGearDes Tra_numLstGear Tra_numLstParGear Tra_numParGear Tra_nWhl Tra_rTraDyn Tra_rTraStat Tra_stStopEna Tra_stStrtEna /end OUT_MEASUREMENT
 /begin LOC_MEASUREMENT Tra_nEngFlt_mp Tra_numDflGear_mp Tra_rV2NLoRng_mp Tra_rV2NUnFlt_mp Tra_rVnCor_mp Tra_rVn_mp Tra_swtSlctGearInfoCan_mp Tra_tOil /end LOC_MEASUREMENT
/end FUNCTION
/begin FUNCTION Tra_Grip "" /begin IN_MEASUREMENT Tra_numGear /end IN_MEASUREMENT /begin OUT_MEASUREMENT PT_stTraGrip /end OUT_MEASUREMENT /end FUNCTION
/begin FUNCTION Tra_Los "" /begin DEF_CHARACTERISTIC Tra_trqLos_C /end DEF_CHARACTERISTIC /begin OUT_MEASUREMENT Tra_trqLos /end OUT_MEASUREMENT /end FUNCTION
/begin FUNCTION Tra_Prt ""
 /begin DEF_CHARACTERISTIC Tra_dtrqLimUp_C Tra_dtrqPrtRmp.Pos_C Tra_dtrqPrtRmp.Neg_C Tra_dtrqPrtRmpP.Pos_C Tra_dtrqPrtRmpP.Neg_C Tra_facLimUp_CUR Tra_stPrtCfg_C Tra_swtAdj_C Tra_swtDrvAway_C Tra_trqInMax_C Tra_trqMaxErr_CUR Tra_trqMaxGear1_CUR Tra_trqMaxGear2_CUR Tra_trqMaxGear3_CUR Tra_trqMaxGear4_CUR Tra_trqMaxGear5_CUR Tra_trqMaxGear6_CUR Tra_trqMaxGearR_CUR /end DEF_CHARACTERISTIC
 /begin IN_MEASUREMENT Com_stTrqGbxLim CoVeh_trqDes EngDem_facAdj Epm_nEng Gbx_trqPrt PT_rTrq PT_stGrip PT_trqLos Tra_numGear VehV_v /end IN_MEASUREMENT
 /begin OUT_MEASUREMENT PT_trqTraPrt /end OUT_MEASUREMENT
 /begin LOC_MEASUREMENT Tra_dtrqLimUp_mp Tra_stDrvAway_mp Tra_trqLimDrvAway_mp Tra_trqLimRampIn_mp Tra_trqMaxCur_mp Tra_trqPrtGear_mp Tra_trqPrtKnall_mp /end LOC_MEASUREMENT
/end FUNCTION
/begin FUNCTION Tra_RtnIntfc ""
 /begin DEF_CHARACTERISTIC Tra_bAST_C Tra_bCANASTIntv_C Tra_bCANIdlSetP_C Tra_bFltIdlSpdDes_C Tra_dnNBrkRmp.Pos_C Tra_dnNBrkRmp.Neg_C Tra_dnNMinRmp.Pos_C Tra_dnNMinRmp.Neg_C Tra_dnTSCLimRmp2_C Tra_drAPP1Min_C Tra_drAPPFlt_C Tra_DT1TSCDiff.T1_C Tra_DT1TSCDiff.Kd_C Tra_nASTDes_C Tra_nHtgUpActMax_C Tra_nMax_C Tra_nMinBrk_MAP Tra_nMin_C Tra_nMin_MAP Tra_nRmpTSC1Delta_C Tra_nRmpTSC2Delta_C Tra_nTSCDeltaInit_C Tra_nTSCLimLoRmp2_C Tra_nTSCLimMax_C Tra_nTSCLimRmp2_C Tra_nTSCLimRmpOff_C Tra_nTSCSlip_C Tra_rAPPActv_C Tra_rAPPCondOff_C Tra_rAPP_C Tra_stCoEOMASTAdptDemMsk_C Tra_stConvBrk_C Tra_stGearbxHtgUpActMsk_C Tra_stGearHtgUpAct_C Tra_stTrqDemMsk_C Tra_swtNTSC_C Tra_tiASTDes_C Tra_tiDebCoEOMAST.tiHiLo_C Tra_tiDebCoEOMAST.tiLoHi_C Tra_tiDebCrCtlReq.tiHiLo_C Tra_tiDebCrCtlReq.tiLoHi_C Tra_trqLiGovMin_C Tra_vHtgUpActMax_C /end DEF_CHARACTERISTIC
 /begin IN_MEASUREMENT APP_drFlt APP_drUnFlt Brk_st Clth_st CoEOM_stOpModeAct Com_stTSC CrCtl_stReq Epm_nEng Gbx_bASTIntv Gbx_bASTNeutr Gbx_nASTDes Gbx_nIdlDes Gbx_nTrbn Gbx_tiASTDes GlbDa_stTrqDem PthSet_stOvrRun PT_stTraType SpdGov_trqSet Tra_numGear VehV_v /end IN_MEASUREMENT
 /begin OUT_MEASUREMENT Tra_nASTDes Tra_nMax Tra_nMin Tra_stAST Tra_stCoEOMASTAdptDem Tra_stNSetP Tra_tiASTDes /end OUT_MEASUREMENT
 /begin LOC_MEASUREMENT Tra_nBrk_mp Tra_nMinRaw_mp Tra_nMinRmp_mp Tra_nRmpTSCDelta_mp Tra_nTSCDelta_mp Tra_nTSCSlip_mp Tra_stCoEOMMASTDeb_mp Tra_stGearbxHtgUpAct_mp Tra_stOpModeActMsk_mp Tra_stTSCRmp2Init_mp Tra_stTSCRmp_mp /end LOC_MEASUREMENT
/end FUNCTION
/begin FUNCTION Tra_ShiftLck "" /begin IN_MEASUREMENT APP_r GlbDa_vX /end IN_MEASUREMENT /begin OUT_MEASUREMENT Tra_stSLckAdjVal /end OUT_MEASUREMENT /begin LOC_MEASUREMENT Tra_stSLckAdjVal_mp /end LOC_MEASUREMENT /end FUNCTION
/begin FUNCTION Tra_SpaPlausChk ""
 /begin DEF_CHARACTERISTIC Tra_nSpaMaxLowGear_C Tra_nSpaMaxShiftDwn_C Tra_numSpaLowGear_CUR Tra_numSpaMaxGear_CUR Tra_numSpaMaxStep_C Tra_numSpaNoGear_C Tra_Spa.tiHiLo_C Tra_Spa.tiLoHi_C /end DEF_CHARACTERISTIC
 /begin IN_MEASUREMENT Epm_nEng Layer_numGearDsplTar Layer_stGearShftIdctr Layer_stSpaAct Tra_numGear VehV_v /end IN_MEASUREMENT
 /begin OUT_MEASUREMENT Tra_numGearDsplTar Tra_stGearShftIdctr Tra_stSpaPlaus /end OUT_MEASUREMENT
 /begin LOC_MEASUREMENT Tra_numSpaLowGear_mp Tra_numSpaMaxGear_mp Tra_numSpaMinGear_mp Tra_stSpaDisbl_mp Tra_stSpaDwnShiftUnPlaus_mp Tra_stSpaLowGearUnPlaus_mp Tra_stSpaPlausRaw_mp Tra_stSpaUpShiftUnPlaus_mp /end LOC_MEASUREMENT
/end FUNCTION
/begin FUNCTION Tra_TrqRed ""
 /begin DEF_CHARACTERISTIC Tra_bCanPlausDecIntv_C Tra_bCanPlausIncIntv_C Tra_dtrqRmpDecP.Pos_C Tra_dtrqRmpDecP.Neg_C Tra_dtrqRmpIncP.Pos_C Tra_dtrqRmpIncP.Neg_C Tra_swtRmpPtd_C Tra_trqDesMaxTrq_CUR Tra_trqDesMax_C Tra_trqDesMin_C Tra_vMinTrqRed_C /end DEF_CHARACTERISTIC
 /begin IN_MEASUREMENT Epm_nEng Gbx_trqTIIDes Gbx_trqTSCIntv GlbDa_vX MoFExtInt_stTSCPtdMsg /end IN_MEASUREMENT
 /begin OUT_MEASUREMENT Tra_stTSCPtd Tra_trqDesMax Tra_trqDesMin Tra_trqLeadMax Tra_trqLeadMin /end OUT_MEASUREMENT
 /begin LOC_MEASUREMENT Tra_trqDecDem_mp Tra_trqIncDem_mp /end LOC_MEASUREMENT
/end FUNCTION
/begin FUNCTION Tra_TypeInfo "" /begin DEF_CHARACTERISTIC Tra_stTraType_C /end DEF_CHARACTERISTIC /begin OUT_MEASUREMENT PT_stTraType /end OUT_MEASUREMENT /end FUNCTION
/begin FUNCTION TrbChAPos_DD "" /begin DEF_CHARACTERISTIC TrbCh_rTransf_CUR /end DEF_CHARACTERISTIC /begin REF_CHARACTERISTIC TrbCh_typ4WinDia_C /end REF_CHARACTERISTIC /begin OUT_MEASUREMENT TrbCh_ctPWMIn TrbCh_rSens TrbCh_stActrErr /end OUT_MEASUREMENT /begin LOC_MEASUREMENT TrbCh_rRaw /end LOC_MEASUREMENT /end FUNCTION
/begin FUNCTION trbchlp_dd ""
 /begin DEF_CHARACTERISTIC TrbChLP_Pwm.tiPer_C TrbChLP_Pwm.stLvl_C TrbChLP_Pwm.rMaxDty_C TrbChLP_Pwm.rPerUn_C TrbChLP_Pwm.tiPh_C TrbChLP_PwmOut.rMin_C TrbChLP_PwmOut.rMax_C TrbChLP_PwmOut.tiBtwTstSCB_C TrbChLP_PwmOut.tiBtwTstOT_C TrbChLP_PwmOut.numTstMax_C TrbChLP_PwmOut.swtBattCor_C TrbChLP_PwmOut.swtPsInv_C TrbChLP_rCnv_CUR TrbChLP_stPsDiaDisbl_C TrbChLP_stPsDisbl_C /end DEF_CHARACTERISTIC
 /begin IN_MEASUREMENT BattU_facCor DevLib_stPwrStgEnaCond /end IN_MEASUREMENT
 /begin OUT_MEASUREMENT TrbChLP_r TrbChLP_rPs /end OUT_MEASUREMENT
/end FUNCTION
/begin FUNCTION TrbChLP_DDVar "" /begin DEF_CHARACTERISTIC TrbChLP_rPsDisbl_C /end DEF_CHARACTERISTIC /end FUNCTION
/begin FUNCTION TrbCh_DD ""
 /begin DEF_CHARACTERISTIC TrbCh_4WinDiagDeb.ct4WinErr1DebDef_C TrbCh_4WinDiagDeb.ct4WinErr2DebDef_C TrbCh_4WinDiagDeb.ct4WinErr3DebDef_C TrbCh_4WinDiagDeb.ct4WinErr4DebDef_C TrbCh_4WinDiagDeb.ti4WinErrDebDef_C TrbCh_4WinSigDur.tiErr1Min_C TrbCh_4WinSigDur.tiErr1Max_C TrbCh_4WinSigDur.tiErr2Min_C TrbCh_4WinSigDur.tiErr2Max_C TrbCh_4WinSigDur.tiErr3Min_C TrbCh_4WinSigDur.tiErr3Max_C TrbCh_4WinSigDur.tiErr4Min_C TrbCh_4WinSigDur.tiErr4Max_C TrbCh_Pwm.tiPer_C TrbCh_Pwm.stLvl_C TrbCh_Pwm.rMaxDty_C TrbCh_Pwm.rPerUn_C TrbCh_Pwm.tiPh_C TrbCh_PwmOut.rMin_C TrbCh_PwmOut.rMax_C TrbCh_PwmOut.tiBtwTstSCB_C TrbCh_PwmOut.tiBtwTstOT_C TrbCh_PwmOut.numTstMax_C TrbCh_PwmOut.swtBattCor_C TrbCh_PwmOut.swtPsInv_C TrbCh_rCnv_CUR TrbCh_rPsDisbl_C TrbCh_stPsDiaDisbl_C TrbCh_stPsDisbl_C TrbCh_typ4WinDia_C /end DEF_CHARACTERISTIC
 /begin IN_MEASUREMENT BattU_facCor DevLib_stPwrStgEnaCond TrbCh_ctPWMIn TrbCh_stActrErr /end IN_MEASUREMENT
 /begin OUT_MEASUREMENT TrbCh_r TrbCh_rPs /end OUT_MEASUREMENT
 /begin LOC_MEASUREMENT TrbCh_ct4WinErr1_mp TrbCh_ct4WinErr2_mp TrbCh_ct4WinErr3_mp TrbCh_ct4WinErr4_mp TrbCh_stErrMsg_mp /end LOC_MEASUREMENT
/end FUNCTION
/begin FUNCTION TSDa_tClnt "" /begin DEF_CHARACTERISTIC TSDa_tRadOutSubs_C /end DEF_CHARACTERISTIC /begin OUT_MEASUREMENT TSDa_tClntIniVal TSDa_tClntRadOut TS_tClntEngOut /end OUT_MEASUREMENT /end FUNCTION
/begin FUNCTION Ts_Adapt "" /begin DEF_CHARACTERISTIC AirC_stCmprAct_C /end DEF_CHARACTERISTIC /begin OUT_MEASUREMENT AirC_stCmprAct /end OUT_MEASUREMENT /end FUNCTION
/begin FUNCTION TTrbnUs_DD ""
 /begin DEF_CHARACTERISTIC Exh_SRCTTrbnUs.uMin_C Exh_SRCTTrbnUs.uMax_C Exh_swtSensPrsTTrbnUs_C Exh_tTransfTTrbnUs_CUR /end DEF_CHARACTERISTIC
 /begin OUT_MEASUREMENT Exh_tSensTTrbnUs Exh_uRawTTrbnUs /end OUT_MEASUREMENT
/end FUNCTION
/begin FUNCTION TTrbnUs_VD ""
 /begin DEF_CHARACTERISTIC Exh_numFldTTrbnUs_C Exh_numModelTTrbnUs_C Exh_RmpSlpTTrbnUs.Pos_C Exh_RmpSlpTTrbnUs.Neg_C Exh_stLckNplTTrbnUs_C Exh_tDiffNegTTrbnUs_CUR Exh_tDiffPosTTrbnUs_CUR Exh_tiLckNplRgnTTrbnUs_C Exh_tiLckNplTTrbnUs_C Exh_TransStgTTrbnUs.Dfl_C Exh_TransStgTTrbnUs.stSensId_C /end DEF_CHARACTERISTIC
 /begin IN_MEASUREMENT ASMod_tEGFld CoEng_st CoEOM_stOpModeAct Exh_tFld /end IN_MEASUREMENT
 /begin OUT_MEASUREMENT Exh_tAdapTTrbnUs Exh_tTrbnUs /end OUT_MEASUREMENT
 /begin LOC_MEASUREMENT Exh_stEGTDelTTrbnUs_mp Exh_stTmrPlausTTrbnUs_mp Exh_tDiffNegTTrbnUs_mp Exh_tDiffPosTTrbnUs_mp Exh_tModTTrbnUs_mp /end LOC_MEASUREMENT
/end FUNCTION
/begin FUNCTION UaccAppl_Std "" /end FUNCTION
/begin FUNCTION Uacc_Std ""
 /begin IN_MEASUREMENT CThmst_rPs Epm_nEng Epm_numCyl Exh_pDiffOfsValAct Exh_pDiffOfsValOld /end IN_MEASUREMENT
/end FUNCTION
/begin FUNCTION Uart "" /end FUNCTION
/begin FUNCTION UCatUsT "" /begin IN_MEASUREMENT Com_tUCatUsT /end IN_MEASUREMENT /begin SUB_FUNCTION UCatUsT_DD UCatUsT_VD /end SUB_FUNCTION /end FUNCTION
/begin FUNCTION UCatUsT_DD ""
 /begin DEF_CHARACTERISTIC SCR_SRCUCatUsT.uMin_C SCR_SRCUCatUsT.uMax_C SCR_swtSigUCatUsT_C SCR_tTransfUCatUsT_CUR /end DEF_CHARACTERISTIC
 /begin IN_MEASUREMENT Com_tUCatUsT /end IN_MEASUREMENT
 /begin OUT_MEASUREMENT SCR_tSensUCatUsT SCR_uRawUCatUsT /end OUT_MEASUREMENT
/end FUNCTION
/begin FUNCTION UCatUsT_VD ""
 /begin DEF_CHARACTERISTIC SCR_RmpSlpUCatUsT.Pos_C SCR_RmpSlpUCatUsT.Neg_C SCR_TransStgUCatUsT.Dfl_C SCR_TransStgUCatUsT.stSensId_C /end DEF_CHARACTERISTIC
 /begin IN_MEASUREMENT SCR_tSensUCatUsT /end IN_MEASUREMENT
 /begin OUT_MEASUREMENT SCR_tUCatUsT /end OUT_MEASUREMENT
/end FUNCTION
/begin FUNCTION UDC "" /begin SUB_FUNCTION UDC_Main UDC_QntIfc UDC_DosQnt UDC_RdcAgRmn /end SUB_FUNCTION /end FUNCTION
/begin FUNCTION UDC_DosQnt ""
 /begin DEF_CHARACTERISTIC UDC_mDosQntRstDesVal_C UDC_mRdcAgDosTmpQnt_C UDC_mRdcAgLopFaultQnt_C UDC_mRdcAgReFlFaultQnt_C UDC_numRepPresBuildUp_C UDC_swtDosQntRst_C UDC_tiReFlMin_C /end DEF_CHARACTERISTIC
 /begin IN_MEASUREMENT CoSCR_st CoSCR_stSub CoSCR_tiReFl SCRMon_numRepPresBuildup UDC_dmRdcAgDos /end IN_MEASUREMENT
 /begin OUT_MEASUREMENT UDC_mRdcAgDosQnt /end OUT_MEASUREMENT
 /begin LOC_MEASUREMENT UDC_mRdcAgDosQntTmp_mp UDC_stEEPROMRead UDC_stEEPROMWrite /end LOC_MEASUREMENT
/end FUNCTION
/begin FUNCTION UDC_Main ""
 /begin DEF_CHARACTERISTIC UDC_dmRatio2Mass_CUR UDC_dmRdcAgMax_C UDC_dmRdcAgMin_C UDC_facPresCorr_CUR UDC_rDycAftrunEmpt_C UDC_rDycDfl_C UDC_rDycReFl_C UDC_rDycVtln_C UDC_rMass2Ratio_CUR UDC_swtSelectInput_C UDC_tiMass2Time_CUR UDC_tiPerAftrunEmpt_C UDC_tiPerDfl_C UDC_tiPerReFl_C UDC_tiPerVtln_C UDC_tiSetPExt_C /end DEF_CHARACTERISTIC
 /begin IN_MEASUREMENT SCR_pUPmpP UDosVlv_rDyc UDosVlv_rPs UDosVlv_tiPer /end IN_MEASUREMENT
 /begin OUT_MEASUREMENT UDC_dmRdcAgDes UDC_dmRdcAgDos /end OUT_MEASUREMENT
 /begin LOC_MEASUREMENT UDC_dmRdcAgDesLtd_mp UDC_rDyc_mp UDC_tiPer_mp /end LOC_MEASUREMENT
/end FUNCTION
/begin FUNCTION UDC_QntIfc ""
 /begin DEF_CHARACTERISTIC UDC_dmRdcAgCurrLim_C UDC_dmRdcAgCurrMax_C UDC_dmRdcAgCurrMin_C UDC_dmRdcAgDes_C UDC_facCnvMFl_C UDC_facKiRdcAg_C UDC_facQty2Qty_C UDC_facRdcAgDvt_C UDC_mRdcAgDes_C UDC_stRdcAgInteg_C UDC_swtDStgy_C UDC_swtSelectCAN_C UDC_swtTestEna_C /end DEF_CHARACTERISTIC
 /begin IN_MEASUREMENT DStgy_dmRdcAgDes /end IN_MEASUREMENT
 /begin OUT_MEASUREMENT UDC_dmRdcAgAct UDC_dmSetP UDC_mRdcAgAct UDC_mSet UDC_stRdcAgInteg UDC_swtSelectCAN /end OUT_MEASUREMENT
 /begin LOC_MEASUREMENT UDC_dmRdcAgActAdd_mp UDC_dmRdcAgActByp_mp UDC_dmRdcAgCurrPreLim_mp UDC_dmRdcAg_mp UDC_mRdcAg_mp /end LOC_MEASUREMENT
/end FUNCTION
/begin FUNCTION UDC_RdcAgRmn ""
 /begin DEF_CHARACTERISTIC UDC_DebUTnkLvl.tiHiLo_C UDC_DebUTnkLvl.tiLoHi_C UDC_facUTnkLvlThres_C UDC_mUTnkLvlRdcAgMax_C UDC_mUTnkLvlRdcAgResv_C UDC_numUTnkLvlSmpl_C /end DEF_CHARACTERISTIC
 /begin IN_MEASUREMENT SCR_rUTnkLvl UDC_mRdcAgDosQnt /end IN_MEASUREMENT
 /begin OUT_MEASUREMENT UDC_mUTnkLvlRdcAgFrz UDC_mUTnkLvlRdcAgRmn UDC_numUTnkLvlAvrgFld UDC_rUTnkLvlRdcAgRmn UDC_stUTnkLvl UDC_stUTnkLvlDeb /end OUT_MEASUREMENT
 /begin LOC_MEASUREMENT UDC_facUTnkLvlMovAvrg_mp UDC_numUTnkLvlFldSum_mp UDC_numUTnkLvlInteg_mp UDC_numUTnkLvlSmplCnt_mp UDC_stUTnkLvlUnDeb_mp /end LOC_MEASUREMENT
/end FUNCTION
/begin FUNCTION UDosVlv "" /begin IN_MEASUREMENT BattU_facCor DevLib_stPwrStgEnaCond /end IN_MEASUREMENT /begin SUB_FUNCTION UDosVlv_DD /end SUB_FUNCTION /end FUNCTION
/begin FUNCTION UDosVlv_DD ""
 /begin DEF_CHARACTERISTIC UDosVlv_DigOut.tiBtwTstSCB_C UDosVlv_DigOut.tiBtwTstOT_C UDosVlv_DigOut.numTstMax_C UDosVlv_PwmOut.rMin_C UDosVlv_PwmOut.rMax_C UDosVlv_PwmOut.tiBtwTstSCB_C UDosVlv_PwmOut.tiBtwTstOT_C UDosVlv_PwmOut.numTstMax_C UDosVlv_PwmOut.swtBattCor_C UDosVlv_PwmOut.swtPsInv_C UDosVlv_rDycCnv_CUR UDosVlv_rPsDisbl_C UDosVlv_rPwmOutMaxDty_C UDosVlv_rPwmOutPerUn_C UDosVlv_stPsDiaDisbl_C UDosVlv_stPsDisbl_C UDosVlv_stPwmOutLvl_C UDosVlv_tiPwmOutPh_C /end DEF_CHARACTERISTIC
 /begin IN_MEASUREMENT BattU_facCor DevLib_stPwrStgEnaCond /end IN_MEASUREMENT
 /begin OUT_MEASUREMENT UDosVlv_rDyc UDosVlv_rPs UDosVlv_tiPer /end OUT_MEASUREMENT
 /begin LOC_MEASUREMENT UDosVlv_rDyc_mp /end LOC_MEASUREMENT
/end FUNCTION
/begin FUNCTION UHC "" /begin SUB_FUNCTION UHC_Mon UHC_Ctl /end SUB_FUNCTION /end FUNCTION
/begin FUNCTION UHC_Ctl ""
 /begin DEF_CHARACTERISTIC UHC_facUTnkTmrDfrstSlp_C UHC_facUTnkTmrOnSlp_C UHC_stTstEnf_C UHC_tEnvTempMax_C UHC_tEnvTempMin_C UHC_tiC1ClgTmr_C UHC_tiC1TO_C UHC_tiC2TO_C UHC_tiDfrstC2_CUR UHC_tiOffC2_CUR UHC_tiOnC2_CUR UHC_tUTnkDfrstTempMax_C UHC_tUTnkDfrstTempMin_C UHC_tUTnkTempMinDelta_C UHC_tUTnkTempMin_C /end DEF_CHARACTERISTIC
 /begin IN_MEASUREMENT EnvT_t SCRMon_stUHC SCR_tUTnkT UHC_stMonC1 UHC_stMonC2 UHtrPL_st UHtrPL_stPs UHtrTnk_st UHtrTnk_stPs /end IN_MEASUREMENT
 /begin OUT_MEASUREMENT UHC_stC1 UHC_stC2 UHC_stCReq UHC_stCtl UHC_stDfrstChk UHC_stTstRls UHC_tEnvTFrz UHC_tUTnkTFrz /end OUT_MEASUREMENT
 /begin LOC_MEASUREMENT UHC_stEEPROMRead_mp UHC_stEEPROMWrite_mp UHC_stHystC1Dfrst_mp UHC_stHystC1On_mp UHC_stMonC1PwrMng_mp UHC_stMonC2PwrMng_mp UHC_stUTnkTemp_mp UHC_tiC1DfrstTmr_mp UHC_tiC1DlyTmr_mp UHC_tiC1OnTmr_mp UHC_tiC1TO_mp UHC_tiC1_mp UHC_tiC2TO_mp UHC_tiC2_mp UHC_tiTmrC1_mp UHC_tiTmrC2_mp /end LOC_MEASUREMENT
/end FUNCTION
/begin FUNCTION UHC_Mon "" /begin DEF_CHARACTERISTIC UHC_tiReq3Htr2Dly_C /end DEF_CHARACTERISTIC /begin REF_CHARACTERISTIC SCRMon_swtDSMDis_C /end REF_CHARACTERISTIC /begin IN_MEASUREMENT SCRMon_stUHC UHC_stCReq UHtrPL_stPs /end IN_MEASUREMENT /begin OUT_MEASUREMENT UHC_stMonC1 UHC_stMonC2 /end OUT_MEASUREMENT /begin LOC_MEASUREMENT UHC_stFullReq_mp /end LOC_MEASUREMENT /end FUNCTION
/begin FUNCTION UHtrPL "" /begin IN_MEASUREMENT DevLib_stPwrStgEnaCond /end IN_MEASUREMENT /begin SUB_FUNCTION UHtrPL_DD UHtrPLDia /end SUB_FUNCTION /end FUNCTION
/begin FUNCTION UHtrPLDia "" /begin SUB_FUNCTION UHtrPLDia_DD UHtrPLDia_VD /end SUB_FUNCTION /end FUNCTION
/begin FUNCTION UHtrPLDia_DD ""
 /begin DEF_CHARACTERISTIC UHtrPL_iTransfDia_CUR UHtrPL_SRCDia.uMin_C UHtrPL_SRCDia.uMax_C /end DEF_CHARACTERISTIC
 /begin OUT_MEASUREMENT UHtrPL_iSensDia UHtrPL_uRawDia /end OUT_MEASUREMENT
/end FUNCTION
/begin FUNCTION UHtrPLDia_VD ""
 /begin DEF_CHARACTERISTIC UHtrPL_RmpSlpDia.Pos_C UHtrPL_RmpSlpDia.Neg_C UHtrPL_TransStgDia.Dfl_C UHtrPL_TransStgDia.stSensId_C /end DEF_CHARACTERISTIC
 /begin IN_MEASUREMENT UHtrPL_iSensDia /end IN_MEASUREMENT
 /begin OUT_MEASUREMENT UHtrPL_iDia /end OUT_MEASUREMENT
/end FUNCTION
/begin FUNCTION UHtrPL_DD ""
 /begin DEF_CHARACTERISTIC UHtrPL_DigOut.tiBtwTstSCB_C UHtrPL_DigOut.tiBtwTstOT_C UHtrPL_DigOut.numTstMax_C UHtrPL_stPsDiaDisbl_C UHtrPL_stPsDisbl_C /end DEF_CHARACTERISTIC
 /begin IN_MEASUREMENT DevLib_stPwrStgEnaCond /end IN_MEASUREMENT
 /begin OUT_MEASUREMENT UHtrPL_st UHtrPL_stPs /end OUT_MEASUREMENT
/end FUNCTION
/begin FUNCTION UHtrTnk "" /begin IN_MEASUREMENT DevLib_stPwrStgEnaCond /end IN_MEASUREMENT /begin SUB_FUNCTION UHtrTnk_DD UHtrTnkDia /end SUB_FUNCTION /end FUNCTION
/begin FUNCTION UHtrTnkDia "" /begin SUB_FUNCTION UHtrTnkDia_DD UHtrTnkDia_VD /end SUB_FUNCTION /end FUNCTION
/begin FUNCTION UHtrTnkDia_DD ""
 /begin DEF_CHARACTERISTIC UHtrTnk_iTransfDia_CUR UHtrTnk_SRCDia.uMin_C UHtrTnk_SRCDia.uMax_C /end DEF_CHARACTERISTIC
 /begin OUT_MEASUREMENT UHtrTnk_iSensDia UHtrTnk_uRawDia /end OUT_MEASUREMENT
/end FUNCTION
/begin FUNCTION UHtrTnkDia_VD ""
 /begin DEF_CHARACTERISTIC UHtrTnk_RmpSlpDia.Pos_C UHtrTnk_RmpSlpDia.Neg_C UHtrTnk_TransStgDia.Dfl_C UHtrTnk_TransStgDia.stSensId_C /end DEF_CHARACTERISTIC
 /begin IN_MEASUREMENT UHtrTnk_iSensDia /end IN_MEASUREMENT
 /begin OUT_MEASUREMENT UHtrTnk_iDia /end OUT_MEASUREMENT
/end FUNCTION
/begin FUNCTION UHtrTnk_DD ""
 /begin DEF_CHARACTERISTIC UHtrTnk_DigOut.tiBtwTstSCB_C UHtrTnk_DigOut.tiBtwTstOT_C UHtrTnk_DigOut.numTstMax_C UHtrTnk_stPsDiaDisbl_C UHtrTnk_stPsDisbl_C /end DEF_CHARACTERISTIC
 /begin IN_MEASUREMENT DevLib_stPwrStgEnaCond /end IN_MEASUREMENT
 /begin OUT_MEASUREMENT UHtrTnk_st UHtrTnk_stPs /end OUT_MEASUREMENT
/end FUNCTION
/begin FUNCTION UPmpMot "" /begin IN_MEASUREMENT BattU_facCor DevLib_stPwrStgEnaCond /end IN_MEASUREMENT /begin SUB_FUNCTION UPmpMot_DD /end SUB_FUNCTION /end FUNCTION
/begin FUNCTION UPmpMot_DD ""
 /begin DEF_CHARACTERISTIC UPmpMot_Pwm.tiPer_C UPmpMot_Pwm.stLvl_C UPmpMot_Pwm.rMaxDty_C UPmpMot_Pwm.rPerUn_C UPmpMot_Pwm.tiPh_C UPmpMot_PwmOut.rMin_C UPmpMot_PwmOut.rMax_C UPmpMot_PwmOut.tiBtwTstSCB_C UPmpMot_PwmOut.tiBtwTstOT_C UPmpMot_PwmOut.numTstMax_C UPmpMot_PwmOut.swtBattCor_C UPmpMot_PwmOut.swtPsInv_C UPmpMot_rCnv_CUR UPmpMot_rPsDisbl_C UPmpMot_stPsDiaDisbl_C UPmpMot_stPsDisbl_C /end DEF_CHARACTERISTIC
 /begin IN_MEASUREMENT BattU_facCor DevLib_stPwrStgEnaCond /end IN_MEASUREMENT
 /begin OUT_MEASUREMENT UPmpMot_r UPmpMot_rPs /end OUT_MEASUREMENT
 /begin LOC_MEASUREMENT UPmpMot_rCalc_mp UPmpMot_rCor_mp UPmpMot_r_mp UPmpMot_stPrevTstRslt_mp /end LOC_MEASUREMENT
/end FUNCTION
/begin FUNCTION UPmpP "" /begin IN_MEASUREMENT Com_pAbsUPmpP EnvP_p /end IN_MEASUREMENT /begin SUB_FUNCTION UPmpP_DD UPmpP_VD /end SUB_FUNCTION /end FUNCTION
/begin FUNCTION UPmpP_DD ""
 /begin DEF_CHARACTERISTIC SCR_pTransfUPmpP_CUR SCR_SRCUPmpP.uMin_C SCR_SRCUPmpP.uMax_C SCR_swtSigAbsUPmpP_C /end DEF_CHARACTERISTIC
 /begin IN_MEASUREMENT Com_pAbsUPmpP /end IN_MEASUREMENT
 /begin OUT_MEASUREMENT SCR_pAbsSensUPmpP SCR_uRawUPmpP /end OUT_MEASUREMENT
/end FUNCTION
/begin FUNCTION UPmpP_VD ""
 /begin DEF_CHARACTERISTIC SCR_RmpSlpAbsUPmpP.Pos_C SCR_RmpSlpAbsUPmpP.Neg_C SCR_swtpFltSel_C SCR_swtUPmpPSel_C SCR_tiPT1UPmpP_C SCR_TransStgAbsUPmpP.Dfl_C SCR_TransStgAbsUPmpP.stSensId_C /end DEF_CHARACTERISTIC
 /begin IN_MEASUREMENT EnvP_p SCR_pAbsSensUPmpP /end IN_MEASUREMENT
 /begin OUT_MEASUREMENT SCR_pAbsUPmpP SCR_pFltUPmpP SCR_pUPmpP /end OUT_MEASUREMENT
/end FUNCTION
/begin FUNCTION URevVlv "" /begin IN_MEASUREMENT DevLib_stPwrStgEnaCond /end IN_MEASUREMENT /begin SUB_FUNCTION URevVlv_DD /end SUB_FUNCTION /end FUNCTION
/begin FUNCTION URevVlv_DD ""
 /begin DEF_CHARACTERISTIC URevVlv_DigOut.tiBtwTstSCB_C URevVlv_DigOut.tiBtwTstOT_C URevVlv_DigOut.numTstMax_C URevVlv_stPsDiaDisbl_C URevVlv_stPsDisbl_C /end DEF_CHARACTERISTIC
 /begin IN_MEASUREMENT DevLib_stPwrStgEnaCond /end IN_MEASUREMENT
 /begin OUT_MEASUREMENT URevVlv_st URevVlv_stPs /end OUT_MEASUREMENT
/end FUNCTION
/begin FUNCTION UTnkLvl "" /begin IN_MEASUREMENT Com_rUTnkLvl SyC_stSub T15_st /end IN_MEASUREMENT /begin SUB_FUNCTION UTnkLvl_DD UTnkLvl_VD /end SUB_FUNCTION /end FUNCTION
/begin FUNCTION UTnkLvl_DD ""
 /begin DEF_CHARACTERISTIC SCR_DebUTnkLvl.tiHiLo_C SCR_DebUTnkLvl.tiLoHi_C SCR_tiTstWinMaxUTnkLvl_C SCR_tiTstWinMinUTnkLvl_C SCR_tiWaitUTnkLvl_C /end DEF_CHARACTERISTIC
 /begin IN_MEASUREMENT SyC_stSub T15_st /end IN_MEASUREMENT
 /begin OUT_MEASUREMENT SCR_rSensUTnkLvl SCR_stDebUTnkLvl SCR_stRawUTnkLvl /end OUT_MEASUREMENT
 /begin LOC_MEASUREMENT SCR_stSensRdyUTnkLvl_mp SCR_stT15UTnkLvl_mp SCR_stTstStrtUTnkLvl_mp SCR_tiPlsWidth_mp /end LOC_MEASUREMENT
/end FUNCTION
/begin FUNCTION UTnkLvl_VD ""
 /begin DEF_CHARACTERISTIC SCR_RmpSlpUTnkLvl.Pos_C SCR_RmpSlpUTnkLvl.Neg_C SCR_TransStgUTnkLvl.Dfl_C SCR_TransStgUTnkLvl.stSensId_C /end DEF_CHARACTERISTIC
 /begin IN_MEASUREMENT SCR_rSensUTnkLvl /end IN_MEASUREMENT
 /begin OUT_MEASUREMENT SCR_rUTnkLvl /end OUT_MEASUREMENT
/end FUNCTION
/begin FUNCTION UTnkT "" /begin IN_MEASUREMENT Com_tUTnkT /end IN_MEASUREMENT /begin SUB_FUNCTION UTnkT_DD UTnkT_VD /end SUB_FUNCTION /end FUNCTION
/begin FUNCTION UTnkT_DD ""
 /begin DEF_CHARACTERISTIC SCR_SRCUTnkT.uMin_C SCR_SRCUTnkT.uMax_C SCR_swtSigUTnkT_C SCR_tTransfUTnkT_CUR /end DEF_CHARACTERISTIC
 /begin IN_MEASUREMENT Com_tUTnkT /end IN_MEASUREMENT
 /begin OUT_MEASUREMENT SCR_tSensUTnkT SCR_uRawUTnkT /end OUT_MEASUREMENT
/end FUNCTION
/begin FUNCTION UTnkT_VD ""
 /begin DEF_CHARACTERISTIC SCR_RmpSlpUTnkT.Pos_C SCR_RmpSlpUTnkT.Neg_C SCR_TransStgUTnkT.Dfl_C SCR_TransStgUTnkT.stSensId_C /end DEF_CHARACTERISTIC
 /begin IN_MEASUREMENT SCR_tSensUTnkT /end IN_MEASUREMENT
 /begin OUT_MEASUREMENT SCR_tUTnkT /end OUT_MEASUREMENT
/end FUNCTION
/begin FUNCTION VehMot_CalcTrqDrag ""
 /begin DEF_CHARACTERISTIC VehMot_mInrt_C VehMot_tiFastLearn_C VehMot_tiTrqDragMin_C VehMot_tiTrqDragVx_CUR VehMot_tiTrqPrpPT1_C VehMot_trqDragMax_C VehMot_trqThresComp_C VehMot_vMinDragEst_C /end DEF_CHARACTERISTIC
 /begin IN_MEASUREMENT GlbDa_aX GlbDa_lWhlCirc GlbDa_vX PT_stGrip PT_swtMstShft PT_trqSpdGovLtd PT_trqWhl PT_trqWhlMaxEng PT_trqWhlMinEng VehMot_stAccPedOvrRun VehMot_stBrkPed VMD_trqDes /end IN_MEASUREMENT
 /begin OUT_MEASUREMENT VehMot_a2trq VehMot_aPrpCurr VehMot_aPrpMax VehMot_aPrpMin VehMot_tiTrqDragPT1 VehMot_trqDrag VehMot_trqThresComp /end OUT_MEASUREMENT
 /begin LOC_MEASUREMENT VehMot_trqDragEst_mp VehMot_trqPrpFlt_mp VehMot_trqWoComp_mp /end LOC_MEASUREMENT
/end FUNCTION
/begin FUNCTION VehV_VD ""
 /begin DEF_CHARACTERISTIC VehV_nThresPla_C VehV_swtTrqSel_C VehV_tiAPT1_C VehV_tiDebMonPla_C VehV_tiVehPT1_C VehV_tiVPT1_C VehV_trqThresPla_C VehV_vDfl_C VehV_vMax_C VehV_vMin_C VehV_vThresPla_C /end DEF_CHARACTERISTIC
 /begin IN_MEASUREMENT ActMod_trqInr Com_nWhl Com_v Com_vBd Epm_nEng GlbDa_lWhlCirc PthSet_trqInrSet /end IN_MEASUREMENT
 /begin OUT_MEASUREMENT VehV_a VehV_aRawUnFlt_mp VehV_aVeh VehV_v VehV_vUnFlt_mp /end OUT_MEASUREMENT
 /begin LOC_MEASUREMENT VehV_aVehUnFlt_mp VehV_vRawOld_mp /end LOC_MEASUREMENT
/end FUNCTION
/begin FUNCTION Veh_Adapt ""
 /begin DEF_CHARACTERISTIC AccPed_rNotPressed_C DiffIO_rTrqDfftl_C DiffIO_stCfg_C DiffIO_trqPrtDfftl_C Eng_stOff_C Eng_stRun_C LiGov_nSetpoint_C PhyMod_pwrClntEntry_C SIIO_stDCSIntv_C SIIO_stTCSIntv_C SIIO_trqDesDCS_C SIIO_trqDesTCS_C SIIO_trqLeadTCS_C StWhl_dphiAg_C StWhl_phiAg_C /end DEF_CHARACTERISTIC
 /begin OUT_MEASUREMENT DiffIO_rTrqDfftl DiffIO_stCfg DiffIO_trqPrtDfftl EngPrt_nMax ETCtl_tiPoI2Cor LiGov_nStat PFltRgn_st PT_stStabIntv SIIO_stDCSIntv SIIO_stTCSIntv SIIO_trqDesDCS SIIO_trqDesTCS SIIO_trqLeadTCS /end OUT_MEASUREMENT
 /begin LOC_MEASUREMENT CoPT_nMaxEng CoPT_nMinEng TS_tClntIniVal /end LOC_MEASUREMENT
/end FUNCTION
/begin COMPU_METHOD Acc "" RAT_FUNC "%6.5" "m/s^2" COEFFS 0 1000 0 0 0 1 /end COMPU_METHOD
/begin COMPU_METHOD AirMassPerTime "" RAT_FUNC "%5.1" "Kg/h" COEFFS 0 10 0 0 0 1 /end COMPU_METHOD
/begin COMPU_METHOD Ampere "" RAT_FUNC "%6.3" "mA" COEFFS 0 5 0 0 0 1 /end COMPU_METHOD
/begin COMPU_METHOD Angle "" RAT_FUNC "%6.4" "deg" COEFFS 0 32 0 0 0 1 /end COMPU_METHOD
/begin COMPU_METHOD AngleDerivative "" RAT_FUNC "%6.4" "deg/s" COEFFS 0 16 0 0 0 1 /end COMPU_METHOD
/begin COMPU_METHOD COEOM_PCRCTLLPTRQNUMMAP_SY_Compu "" TAB_NOINTP "%6.3" "" COMPU_TAB_REF COEOM_PCRCTLLPTRQNUMMAP_SY_Compu /end COMPU_METHOD
/begin COMPU_TAB COEOM_PCRCTLLPTRQNUMMAP_SY_Compu "" TAB_NOINTP 8 0 0 1 1 2 2 3 3 4 4 5 5 6 6 7 7 /end COMPU_TAB
/begin COMPU_METHOD COEOM_PCRQNTNUMMAP_SY_Compu "" TAB_NOINTP "%6.3" "" COMPU_TAB_REF COEOM_PCRQNTNUMMAP_SY_Compu /end COMPU_METHOD
/begin COMPU_TAB COEOM_PCRQNTNUMMAP_SY_Compu "" TAB_NOINTP 8 0 0 1 1 2 2 3 3 4 4 5 5 6 6 7 7 /end COMPU_TAB
/begin COMPU_METHOD dn_dZ20 "" RAT_FUNC "%6.2" "rpm/s" COEFFS 0 0.2 0 0 0 1 /end COMPU_METHOD
/begin COMPU_METHOD DStgy_Compu_Switch_1 "" TAB_VERB "%6.3" "" COMPU_TAB_REF DStgy_Compu_Switch_1 /end COMPU_METHOD
/begin COMPU_VTAB DStgy_Compu_Switch_1 "" TAB_VERB 2 0 "RUNNING" 1 "RESET" /end COMPU_VTAB
/begin COMPU_METHOD DtyCyc "" RAT_FUNC "%5.2" "%" COEFFS 0 100 0 0 0 1 /end COMPU_METHOD
/begin COMPU_METHOD EngN "" RAT_FUNC "%5.1" "rpm" COEFFS 0 2 0 0 0 1 /end COMPU_METHOD
/begin COMPU_METHOD EngNGrd "" RAT_FUNC "%6.3" "rpm/s" COEFFS 0 2 0 0 0 1 /end COMPU_METHOD
/begin COMPU_METHOD Fact "" RAT_FUNC "%6.5" "-" COEFFS 0 8192 0 0 0 1 /end COMPU_METHOD
/begin COMPU_METHOD Fact1 "" RAT_FUNC "%6.4" "-" COEFFS 0 128 0 0 0 1 /end COMPU_METHOD
/begin COMPU_METHOD FactM "" RAT_FUNC "%6.4" "-" COEFFS 0 16 0 0 0 1 /end COMPU_METHOD
/begin COMPU_METHOD InjMass "" RAT_FUNC "%5.2" "mg/hub" COEFFS 0 100 0 0 0 1 /end COMPU_METHOD
/begin COMPU_METHOD InjMassPerSec_20ms "" RAT_FUNC "%6.3" "mg/hub/s" COEFFS 0 2 0 0 0 1 /end COMPU_METHOD
/begin COMPU_METHOD InjTime_us "" RAT_FUNC "%5.1" "us" COEFFS 0 2.5 0 0 0 1 /end COMPU_METHOD
/begin COMPU_METHOD Kd "" RAT_FUNC "%7.6" "1/1" COEFFS 0 65536 0 0 0 1 /end COMPU_METHOD
/begin COMPU_METHOD Kd_dm2FactM "" RAT_FUNC "%8.7" "Kg/h" COEFFS 0 104857.6 0 0 0 1 /end COMPU_METHOD
/begin COMPU_METHOD Kd_InjMass2Prc "" RAT_FUNC "%7.6" "%/(mg/Hub)" COEFFS 0 53687.0912 0 0 0 1 /end COMPU_METHOD
/begin COMPU_METHOD Ki_Pres_fac2hPa "" RAT_FUNC "%6.4" "hPa/s" COEFFS 0 134.217728 0 0 0 1 /end COMPU_METHOD
/begin COMPU_METHOD Kp_Pres_fac2hPa "" RAT_FUNC "%6.5" "hPa" COEFFS 0 2048 0 0 0 1 /end COMPU_METHOD
/begin COMPU_METHOD Mass "" RAT_FUNC "%6.2" "" COEFFS 0 1 0 0 0 1 /end COMPU_METHOD
/begin COMPU_METHOD MassLength "" RAT_FUNC "%6.3" "" COEFFS 0 5 0 0 0 1 /end COMPU_METHOD
/begin COMPU_METHOD OneToOne "" RAT_FUNC "%6.0" "-" COEFFS 0 1 0 0 0 1 /end COMPU_METHOD
/begin COMPU_METHOD Period "" RAT_FUNC "%6.3" "ms" COEFFS 0 10 0 0 0 1 /end COMPU_METHOD
/begin COMPU_METHOD Prc "" RAT_FUNC "%6.4" "%" COEFFS 0 81.92 0 0 0 1 /end COMPU_METHOD
/begin COMPU_METHOD PrcPerSec "" RAT_FUNC "%6.3" "%/s" COEFFS 0 1.6384 0 0 0 1 /end COMPU_METHOD
/begin COMPU_METHOD Pres_hPa "" RAT_FUNC "%5.1" "hPa" COEFFS 0 1 0 0 0 1 /end COMPU_METHOD
/begin COMPU_METHOD Pwr2 "" RAT_FUNC "%6.1" "W" COEFFS 0 0.0530516476972949 0 0 0 1 /end COMPU_METHOD
/begin COMPU_METHOD RmpDtyCyc "" RAT_FUNC "%6.5" "%/s" COEFFS 0 6553.6 0 0 0 1 /end COMPU_METHOD
/begin COMPU_METHOD RmpEngN "" RAT_FUNC "%6.4" "rpm/s" COEFFS 0 131.072 0 0 0 1 /end COMPU_METHOD
/begin COMPU_METHOD RmpPrc "" RAT_FUNC "%6.5" "%/s" COEFFS 0 5368.70912 0 0 0 1 /end COMPU_METHOD
/begin COMPU_METHOD RmpPres_hPa "" RAT_FUNC "%6.4" "hPa/s" COEFFS 0 65.536 0 0 0 1 /end COMPU_METHOD
/begin COMPU_METHOD RmpTemp "" RAT_FUNC "%6.4" "K/s" COEFFS 0 655.36 0 0 0 1 /end COMPU_METHOD
/begin COMPU_METHOD RmpTransR "" RAT_FUNC "%6.5" "-" COEFFS 0 6553.6 0 0 0 1 /end COMPU_METHOD
/begin COMPU_METHOD RmpTrq "" RAT_FUNC "%6.4" "Nm/s" COEFFS 0 655.36 0 0 0 1 /end COMPU_METHOD
/begin COMPU_METHOD SCRAd_Compu_Switch_3 "" TAB_VERB "%6.3" "" COMPU_TAB_REF SCRAd_Compu_Switch_3 /end COMPU_METHOD
/begin COMPU_VTAB SCRAd_Compu_Switch_3 "" TAB_VERB 2 0 "INAKTIV" 1 "AKTIV" /end COMPU_VTAB
/begin COMPU_METHOD SCR_Dm01 "" RAT_FUNC "%6.3" "mg/s" COEFFS 0 10 0 0 0 1 /end COMPU_METHOD
/begin COMPU_METHOD SCR_EepReadSt_Compu "" TAB_VERB "%6.3" "" COMPU_TAB_REF SCR_EepReadSt_Compu /end COMPU_METHOD
/begin COMPU_VTAB SCR_EepReadSt_Compu "" TAB_VERB 4 10 "SUCCESSFUL" 11 "WRONG PARAMETER" 12 "WRONG CHECKSUM" 13 "NOT IN RAM" DEFAULT_VALUE "INVALID" /end COMPU_VTAB
/begin COMPU_METHOD SCR_EepWriteSt_Compu "" TAB_VERB "%6.3" "" COMPU_TAB_REF SCR_EepWriteSt_Compu /end COMPU_METHOD
/begin COMPU_VTAB SCR_EepWriteSt_Compu "" TAB_VERB 4 20 "SUCCESSFUL" 21 "WRONG PARAMTER" 22 "NOT IN RAM" 23 "RAM MIRROR CURRENTLY STORED IN EEP" DEFAULT_VALUE "INVALID" /end COMPU_VTAB
/begin COMPU_METHOD SCR_Fact1000 "" RAT_FUNC "%6.5" "" COEFFS 0 1000 0 0 0 1 /end COMPU_METHOD
/begin COMPU_METHOD SCR_Mass1000 "" RAT_FUNC "%6.5" "g" COEFFS 0 1000 0 0 0 1 /end COMPU_METHOD
/begin COMPU_METHOD SCR_s_p_K "" RAT_FUNC "%6.2" "s/K" COEFFS 0 1 0 0 0 1 /end COMPU_METHOD
/begin COMPU_METHOD SCR_Time10 "" RAT_FUNC "%6.3" "s" COEFFS 0 10 0 0 0 1 /end COMPU_METHOD
/begin COMPU_METHOD stMonCnv "" TAB_VERB "%6.3" "" COMPU_TAB_REF stMonCnv /end COMPU_METHOD
/begin COMPU_VTAB stMonCnv "" TAB_VERB 3 0 "LOCKED" 1 "RELEASED" 2 "TESTING" DEFAULT_VALUE "LOCKED" /end COMPU_VTAB
/begin COMPU_METHOD TempDiff_Kelv "" RAT_FUNC "%4.1" "K" COEFFS 0 10 0 0 0 1 /end COMPU_METHOD
/begin COMPU_METHOD Temp_Cels "" RAT_FUNC "%5.1" "deg C" COEFFS 0 10 2731.4 0 0 1 /end COMPU_METHOD
/begin COMPU_METHOD TimeDeb "" RAT_FUNC "%5.0" "ms" COEFFS 0 0.1 0 0 0 1 /end COMPU_METHOD
/begin COMPU_METHOD TimeDelay_ms "" RAT_FUNC "%12.1" "ms" COEFFS 0 0 1 0 2.3283064365387e-007 0 /end COMPU_METHOD
/begin COMPU_METHOD TimeDelay_s "" RAT_FUNC "%12.4" "s" COEFFS 0 0 1 0 0.00023283064365387 0 /end COMPU_METHOD
/begin COMPU_METHOD Time_ms "" RAT_FUNC "%5.0" "ms" COEFFS 0 0.1 0 0 0 1 /end COMPU_METHOD
/begin COMPU_METHOD Time_s "" RAT_FUNC "%5.2" "s" COEFFS 0 100 0 0 0 1 /end COMPU_METHOD
/begin COMPU_METHOD Time_s_1 "" RAT_FUNC "%6.5" "" COEFFS 0 1000 0 0 0 1 /end COMPU_METHOD
/begin COMPU_METHOD TransR "" RAT_FUNC "%4.2" "-" COEFFS 0 100 0 0 0 1 /end COMPU_METHOD
/begin COMPU_METHOD Trq "" RAT_FUNC "%5.1" "Nm" COEFFS 0 10 0 0 0 1 /end COMPU_METHOD
/begin COMPU_METHOD TrqPrp "" RAT_FUNC "%5.1" "Nm" COEFFS 0 0.625 0 0 0 1 /end COMPU_METHOD
/begin COMPU_METHOD TrqPrpHigh "" RAT_FUNC "%5.1" "Nm" COEFFS 0 10 0 0 0 1 /end COMPU_METHOD
/begin COMPU_METHOD Typ4WinDia "" TAB_VERB "%6.3" "" COMPU_TAB_REF Typ4WinDia /end COMPU_METHOD
/begin COMPU_VTAB Typ4WinDia "" TAB_VERB 4 0 "4 Window diagnosis over PWM control line" 1 "4 Window diagnosis through Digital input" 2 "4 Window diagnosis over external interface" 3 "No 4 Window diagnosis." /end COMPU_VTAB
/begin COMPU_METHOD UDC_CANSwitchState "" TAB_VERB "%6.3" "" COMPU_TAB_REF UDC_CANSwitchState /end COMPU_METHOD
/begin COMPU_VTAB UDC_CANSwitchState "" TAB_VERB 3 0 "UDC_USE_NO_QNT" 1 "UDC_USE_SETP_CAN" 2 "UDC_USE_PC_LD" /end COMPU_VTAB
/begin COMPU_METHOD UDC_Compu_Switch_1 "" TAB_VERB "%6.3" "" COMPU_TAB_REF UDC_Compu_Switch_1 /end COMPU_METHOD
/begin COMPU_VTAB UDC_Compu_Switch_1 "" TAB_VERB 2 0 "INTERN" 1 "EXTERN" /end COMPU_VTAB
/begin COMPU_METHOD UDC_ResetState "" TAB_VERB "%6.3" "" COMPU_TAB_REF UDC_ResetState /end COMPU_METHOD
/begin COMPU_VTAB UDC_ResetState "" TAB_VERB 3 0 "RUNNING" 1 "RESET" 2 "SET_VALUE" DEFAULT_VALUE "0" /end COMPU_VTAB
/begin COMPU_METHOD UDC_SwitchState "" TAB_VERB "%6.3" "" COMPU_TAB_REF UDC_SwitchState /end COMPU_METHOD
/begin COMPU_VTAB UDC_SwitchState "" TAB_VERB 2 0 "UDC_USE_LABEL" 1 "UDC_USE_CAN" /end COMPU_VTAB
/begin COMPU_METHOD UHC_StM_Compu "" TAB_VERB "%6.3" "" COMPU_TAB_REF UHC_StM_Compu /end COMPU_METHOD
/begin COMPU_VTAB UHC_StM_Compu "" TAB_VERB 6 0 "DELAY" 1 "STANDBY" 2 "OFF" 3 "DEFROSTING" 4 "COOLING" 5 "HEATING" DEFAULT_VALUE "NOT VALID" /end COMPU_VTAB
/begin COMPU_METHOD UTnk_Lvl "" TAB_VERB "%6.3" "-" COMPU_TAB_REF UTnk_Lvl /end COMPU_METHOD
/begin COMPU_VTAB UTnk_Lvl "" TAB_VERB 3 0 "EMPTY" 1 "RESERVE" 2 "FULL" DEFAULT_VALUE "FULL" /end COMPU_VTAB
/begin COMPU_METHOD VehVAcc "" RAT_FUNC "%6.4" "m/s^2" COEFFS 0 100 0 0 0 1 /end COMPU_METHOD
/begin COMPU_METHOD Vel "" RAT_FUNC "%5.2" "km/h" COEFFS 0 100 0 0 0 1 /end COMPU_METHOD
/begin COMPU_METHOD VelToN "" RAT_FUNC "%8.7" "(km/h)/rpm" COEFFS 0 100000 0 0 0 1 /end COMPU_METHOD
/begin COMPU_METHOD Volt "" RAT_FUNC "%6.1" "mV" COEFFS 0 5 0 0 0 1 /end COMPU_METHOD
/begin COMPU_METHOD default "" RAT_FUNC "%6.2" "" COEFFS 0 1 0 0 0 1 /end COMPU_METHOD
/begin RECORD_LAYOUT Cur_Xs16Ws16 NO_AXIS_PTS_X 1 SWORD AXIS_PTS_X 2 SWORD INDEX_INCR DIRECT FNC_VALUES 3 SWORD COLUMN_DIR DIRECT /end RECORD_LAYOUT
/begin RECORD_LAYOUT Kf_Xs16_Ys16_Ws16 NO_AXIS_PTS_X 1 SWORD NO_AXIS_PTS_Y 2 SWORD AXIS_PTS_X 3 SWORD INDEX_INCR DIRECT AXIS_PTS_Y 4 SWORD INDEX_INCR DIRECT FNC_VALUES 5 SWORD COLUMN_DIR DIRECT /end RECORD_LAYOUT
/begin RECORD_LAYOUT Kl_Xs16_Ws16 NO_AXIS_PTS_X 1 SWORD AXIS_PTS_X 2 SWORD INDEX_INCR DIRECT FNC_VALUES 3 SWORD COLUMN_DIR DIRECT /end RECORD_LAYOUT
/begin RECORD_LAYOUT Kw_Ws16 FNC_VALUES 1 SWORD COLUMN_DIR DIRECT /end RECORD_LAYOUT
/begin RECORD_LAYOUT Kw_Ws32 FNC_VALUES 1 SLONG COLUMN_DIR DIRECT /end RECORD_LAYOUT
/begin RECORD_LAYOUT Kw_Wu16 FNC_VALUES 1 UWORD COLUMN_DIR DIRECT /end RECORD_LAYOUT
/begin RECORD_LAYOUT Kw_Wu32 FNC_VALUES 1 ULONG COLUMN_DIR DIRECT /end RECORD_LAYOUT
/begin RECORD_LAYOUT Kw_Wu8 FNC_VALUES 1 UBYTE COLUMN_DIR DIRECT /end RECORD_LAYOUT
/begin RECORD_LAYOUT Map_Xs16Ys16Ws16 NO_AXIS_PTS_X 1 SWORD NO_AXIS_PTS_Y 2 SWORD AXIS_PTS_X 3 SWORD INDEX_INCR DIRECT AXIS_PTS_Y 4 SWORD INDEX_INCR DIRECT FNC_VALUES 5 SWORD COLUMN_DIR DIRECT /end RECORD_LAYOUT
/begin RECORD_LAYOUT ValA_Wu8 FNC_VALUES 1 UBYTE COLUMN_DIR DIRECT /end RECORD_LAYOUT
/begin RECORD_LAYOUT Val_Ws16 FNC_VALUES 1 SWORD COLUMN_DIR DIRECT /end RECORD_LAYOUT
/begin RECORD_LAYOUT Val_Ws32 FNC_VALUES 1 SLONG COLUMN_DIR DIRECT /end RECORD_LAYOUT
/begin RECORD_LAYOUT Val_Ws8 FNC_VALUES 1 SBYTE COLUMN_DIR DIRECT /end RECORD_LAYOUT
/begin RECORD_LAYOUT Val_Wu16 FNC_VALUES 1 UWORD COLUMN_DIR DIRECT /end RECORD_LAYOUT
/begin RECORD_LAYOUT Val_Wu32 FNC_VALUES 1 ULONG COLUMN_DIR DIRECT /end RECORD_LAYOUT
/begin RECORD_LAYOUT Val_Wu8 FNC_VALUES 1 UBYTE COLUMN_DIR DIRECT /end RECORD_LAYOUT
/end MODULE
/end PROJECT

ASAP2_VERSION 1 4
/begin PROJECT P_574 "EDC17_CP09"
/begin HEADER "" VERSION "V8KB" PROJECT_NO P_574 /end HEADER
/begin MODULE DIM ""
/begin MOD_COMMON "" BYTE_ORDER MSB_LAST ALIGNMENT_BYTE 1 ALIGNMENT_WORD 2 ALIGNMENT_LONG 4 ALIGNMENT_FLOAT32_IEEE 4 /end MOD_COMMON
/begin CHARACTERISTIC ECOPOLDLY "Ecos Resultat polling delay" VALUE 0x80064192 Val_Wu8 255. ident 0.00 255. FORMAT "%3.0" /end CHARACTERISTIC
/begin CHARACTERISTIC GlbDa_aX_C "Parameter für Fahrzeuglängsbeschleunigung" VALUE 0x8003C198 Val_Ws16 65.53500 Acc -32.76800 32.76700 FORMAT "%8.5" /end CHARACTERISTIC
/begin CHARACTERISTIC GlbDa_facDstCnt_C "Skalierungsfaktor für das Speichern der zurückgelegten Gesamtstrecke" VALUE 0x8003C174 Val_Ws16 7.999878 Fact -4.000000 3.999878 /end CHARACTERISTIC
/begin CHARACTERISTIC GlbDa_lDstLim_C "Schwelle für EEP- Abspeichern der zurückgelegte Gesamtstrecke" VALUE 0x8003C178 Val_Ws32 1990000.00000 Length 10000.0000000 2000000.00000 FORMAT "%13.5" EXTENDED_LIMITS -2147483648.00 2147483647.00 /end CHARACTERISTIC
/begin CHARACTERISTIC GlbDa_lWhlCirc_C "Parameter für Radumfang" VALUE 0x8003C19A Val_Ws16 65.53500 Length_fine -32.76800 32.76700 FORMAT "%8.5" /end CHARACTERISTIC
/begin CHARACTERISTIC GlbDa_nLoadActv_C "Drehzahlschwelle zur Erfassung des Fahrzeugnutzungsprofils" VALUE 0x8003C17C Kw_Ws16 10000.00 EngN 0.00 10000.00 EXTENDED_LIMITS -16384.00 16383.50 /end CHARACTERISTIC
/begin CHARACTERISTIC GlbDa_nLoad_C "Stützstellen der x-Achse (Drehzahl) des Fahrzeugnutzungsprofils" VAL_BLK 0x8003C17E Kwb_Ws16 10000.00 EngN 0.00 10000.00 EXTENDED_LIMITS -16384.00 16383.50 NUMBER 7 /end CHARACTERISTIC
/begin CHARACTERISTIC GlbDa_pEnv_C "Parameter für Umgebungsluftdruck" VALUE 0x8003C19C Val_Ws16 36268.00 Pres_hPa -32768.00 3500.00 EXTENDED_LIMITS -32768.00 32767.00 /end CHARACTERISTIC
/begin CHARACTERISTIC GlbDa_stIARlsVeh_C "Parameter für Zündwinkelfreigabe" VALUE 0x8003C1AC Val_Wu8 255.0 OneToOne 0.00 255.0 /end CHARACTERISTIC
/begin CHARACTERISTIC GlbDa_stVehLimMin_C "Parameter für Begrenzungszustand" VALUE 0x8003C1AD Val_Wu8 255.0 OneToOne 0.00 255.0 /end CHARACTERISTIC
/begin CHARACTERISTIC GlbDa_swtRst_C "Schalter zum Rücksetzen von VehDa_ctLoadSecRowX_mp[X], VehDa_tiLoadSec_mp und der entsprechenden EEPROM-Werte" VALUE 0x8003C18C Kw_Wu8 1.000 OneToOne 0.00 1.000 EXTENDED_LIMITS 0.00 255.0 /end CHARACTERISTIC
/begin CHARACTERISTIC GlbDa_tEnv_C "Parameter für Umgebungslufttemperatur" VALUE 0x8003C19E Val_Ws16 6553.500 Temp_Cels -3549.940 3003.560 /end CHARACTERISTIC
/begin CHARACTERISTIC GlbDa_tiFltAX_C "Filter-Zeitkonstante für Fahrzeuglängsgeschwindigkeit" VALUE 0x8003C1A0 Val_Ws32 4294.9672940 TimeDelay_s 0.000002000000001 4294.9672960 FORMAT "%12.7" /end CHARACTERISTIC
/begin CHARACTERISTIC GlbDa_tiFltVX_C "Filter-Zeitkonstante für Fahrzeuglängsbeschleunigung" VALUE 0x8003C1A4 Val_Ws32 4294.9672940 TimeDelay_s 0.000002000000001 4294.9672960 FORMAT "%12.7" /end CHARACTERISTIC
/begin CHARACTERISTIC GlbDa_tIndAir_C "Parameter für Ansauglufttemperatur" VALUE 0x8003C1A8 Val_Ws16 6553.500 Temp_Cels -3549.940 3003.560 /end CHARACTERISTIC
/begin CHARACTERISTIC GlbDa_trqLoad_C "Stützstellen der y-Achse (Drehmoment) des Fahrzeugnutzungsprofils" VAL_BLK 0x8003C18E Kwb_Ws16 1500.000 Trq -500.0000 1000.000 EXTENDED_LIMITS -3276.800 3276.700 NUMBER 5 /end CHARACTERISTIC
/begin CHARACTERISTIC GlbDa_trqVehLimMin_C "Wert für minimum- Limitierung (für initialisierung)" VALUE 0x8003C1AE Val_Ws16 6553.500 Trq -3276.800 3276.700 /end CHARACTERISTIC
/begin CHARACTERISTIC GlbDa_vX_C "Parameter für Fahrzeuggeschwindigkeit" VALUE 0x8003C1AA Val_Ws16 655.3500 Vel -327.6800 327.6700 /end CHARACTERISTIC
/begin CHARACTERISTIC GlwCtl_ctPreGlwErr_C "" VALUE 0x8003C1FC Val_Wu8 99.00 OneToOne 1.000 100.0 EXTENDED_LIMITS 0.00 255.0 /end CHARACTERISTIC
/begin CHARACTERISTIC GlwCtl_ctPreGlw_C "" VALUE 0x8003C1FD Val_Wu8 255.0 OneToOne 0.00 255.0 /end CHARACTERISTIC
/begin CHARACTERISTIC GlwCtl_facGlwEngRunBase_CUR "" CURVE 0x8003C240 Cur_Xs16Ws16 7.999878 Fact -4.000000 3.999878
 /begin AXIS_DESCR STD_AXIS GlwCtl_tClnt Temp_Cels 8 -3549.940 3003.560 DEPOSIT ABSOLUTE /end AXIS_DESCR
/end CHARACTERISTIC
/begin CHARACTERISTIC GlwCtl_nEngPre_C "" VALUE 0x8003C1FE Val_Wu16 9980.000 EngN 20.00000 10000.00 EXTENDED_LIMITS 0.00 32767.50 /end CHARACTERISTIC
/begin CHARACTERISTIC GlwCtl_nLamp_C "" VALUE 0x8003C1B0 Val_Ws16 5000.000 EngN 0.00 5000.000 EXTENDED_LIMITS -16384.00 16383.50 /end CHARACTERISTIC
/begin CHARACTERISTIC GlwCtl_stAltLoadHigh_C "" VALUE 0x8003C262 Val_Ws16 799.9878 Prc -400.0000 399.9878 /end CHARACTERISTIC
/begin CHARACTERISTIC GlwCtl_stAltLoadLow_C "" VALUE 0x8003C264 Val_Ws16 799.9878 Prc -400.0000 399.9878 /end CHARACTERISTIC
/begin CHARACTERISTIC GlwCtl_stDesValEOMMsk_CA "" VALUE 0x8003C268 Val_Wu32 4294967295.00 OneToOne 0.00 4294967295.00 /end CHARACTERISTIC
/begin CHARACTERISTIC GlwCtl_stEntlast_1_C "" VALUE 0x8003C26C Val_Ws16 65535.00 OneToOne -32768.00 32767.00 /end CHARACTERISTIC
/begin CHARACTERISTIC GlwCtl_stEntlast_2_C "" VALUE 0x8003C26E Val_Ws16 65535.00 OneToOne -32768.00 32767.00 /end CHARACTERISTIC
/begin CHARACTERISTIC GlwCtl_stHdnPreGlwMsk1_C "" VALUE 0x8003C200 Val_Wu16 255.0000 OneToOne 0.00 255.0000 EXTENDED_LIMITS 0.00 65535.00 /end CHARACTERISTIC
/begin CHARACTERISTIC GlwCtl_stHdnPreGlwMsk2_C "" VALUE 0x8003C202 Val_Wu16 255.0000 OneToOne 0.00 255.0000 EXTENDED_LIMITS 0.00 65535.00 /end CHARACTERISTIC
/begin CHARACTERISTIC GlwCtl_stHdnPreGlwMskT1_C "" VALUE 0x8003C204 Val_Wu16 255.0000 OneToOne 0.00 255.0000 EXTENDED_LIMITS 0.00 65535.00 /end CHARACTERISTIC
/begin CHARACTERISTIC GlwCtl_stLampEnaMsk_C "" VALUE 0x8003C206 Val_Wu16 255.0000 OneToOne 0.00 255.0000 EXTENDED_LIMITS 0.00 65535.00 /end CHARACTERISTIC
/begin CHARACTERISTIC GlwCtl_tAftGlw_MAP "" MAP 0x8003C270 Map_Xs16Ys16Ws16 6553.500 Temp_Cels -3549.940 3003.560
 /begin AXIS_DESCR STD_AXIS GlwCtl_tClnt Temp_Cels 8 -3549.940 3003.560 DEPOSIT ABSOLUTE /end AXIS_DESCR
 /begin AXIS_DESCR STD_AXIS GlwCtl_tFld_mp Temp_Cels 8 -3549.940 3003.560 DEPOSIT ABSOLUTE /end AXIS_DESCR
/end CHARACTERISTIC
/begin CHARACTERISTIC GlwCtl_tAirSelCtl_C "" VALUE 0x8003C314 Val_Ws16 65535.00 OneToOne -32768.00 32767.00 /end CHARACTERISTIC
/begin CHARACTERISTIC GlwCtl_tDflClnt_C "" VALUE 0x8003C208 Val_Ws16 100.0000 Temp_Cels -50.04000 49.96000 EXTENDED_LIMITS -3549.940 3003.560 /end CHARACTERISTIC
/begin CHARACTERISTIC GlwCtl_tEngSel_C "" VALUE 0x8003C20A Val_Wu8 255.0 OneToOne 0.00 255.0 /end CHARACTERISTIC
/begin CHARACTERISTIC GlwCtl_tGlwBaseDes_MAP "" MAP 0x8003C316 Map_Xs16Ys16Ws16 6553.500 Temp_Cels -3549.940 3003.560
 /begin AXIS_DESCR STD_AXIS EngDa_tEng Temp_Cels 8 -3549.940 3003.560 DEPOSIT ABSOLUTE /end AXIS_DESCR
 /begin AXIS_DESCR STD_AXIS GlwCtl_stGlwState OneToOne 5 -32768.00 32767.00 DEPOSIT ABSOLUTE /end AXIS_DESCR
/end CHARACTERISTIC
/begin CHARACTERISTIC GlwCtl_tGlwEngRunBase_MAP "" MAP 0x8003C384 Map_Xs16Ys16Ws16 6553.500 Temp_Cels -3549.940 3003.560
 /begin AXIS_DESCR STD_AXIS Epm_nEng EngN 8 -16384.00 16383.50 DEPOSIT ABSOLUTE /end AXIS_DESCR
 /begin AXIS_DESCR STD_AXIS CoETS_trqInrCurr Trq 8 -3276.800 3276.700 DEPOSIT ABSOLUTE /end AXIS_DESCR
/end CHARACTERISTIC
/begin CHARACTERISTIC GlwCtl_tGlwEngRunOn_C "" VALUE 0x8003C428 Val_Ws16 6553.500 Temp_Cels -3549.940 3003.560 /end CHARACTERISTIC
/begin CHARACTERISTIC GlwCtl_tGlwEngRun_CUR "" CURVE 0x8003C42A Cur_Xs16Ws16 6553.500 Temp_Cels -3549.940 3003.560
 /begin AXIS_DESCR STD_AXIS Layer_tChamWll Temp_Cels 8 -3549.940 3003.560 DEPOSIT ABSOLUTE /end AXIS_DESCR
/end CHARACTERISTIC
/begin CHARACTERISTIC GlwCtl_tiDebConvSig_C "" VALUE 0x8003C20C Val_Wu16 65540.00 Time_ms 0.00 65540.00 EXTENDED_LIMITS 0.00 655350.0 /end CHARACTERISTIC
/begin CHARACTERISTIC GlwCtl_tiDebEpmPre_C "" VALUE 0x8003C20E Val_Wu16 65540.00 Time_ms 0.00 65540.00 EXTENDED_LIMITS 0.00 655350.0 /end CHARACTERISTIC
/begin CHARACTERISTIC GlwCtl_tiGlwOff_C "" VALUE 0x8003C44C Val_Ws16 655350.0 TimeDeb -327680.0 327670.0 /end CHARACTERISTIC
/begin CHARACTERISTIC GlwCtl_tiGlwOn_C "" VALUE 0x8003C44E Val_Ws16 655350.0 TimeDeb -327680.0 327670.0 /end CHARACTERISTIC
/begin CHARACTERISTIC GlwCtl_tiLampEng_C "" VALUE 0x8003C1B2 Val_Wu16 65000.00 Time_ms 0.00 65000.00 EXTENDED_LIMITS 0.00 655350.0 /end CHARACTERISTIC
/begin CHARACTERISTIC GlwCtl_tiLampPAir_CUR "" CURVE 0x8003C1B4 Cur_Xs16Ws16 327460.0 Time_ms 0.00 327460.0 EXTENDED_LIMITS -327680.0 327670.0
 /begin AXIS_DESCR STD_AXIS EnvP_p Pres_hPa 4 0.00 3500.000 EXTENDED_LIMITS -32768.00 32767.00 DEPOSIT ABSOLUTE /end AXIS_DESCR
/end CHARACTERISTIC
/begin CHARACTERISTIC GlwCtl_tiLamptClnt_CUR "" CURVE 0x8003C1C6 Cur_Xs16Ws16 327460.0 Time_ms 0.00 327460.0 EXTENDED_LIMITS -327680.0 327670.0
 /begin AXIS_DESCR STD_AXIS GlwCtl_tClnt Temp_Cels 8 -50.14000 149.8600 EXTENDED_LIMITS -3549.940 3003.560 DEPOSIT ABSOLUTE /end AXIS_DESCR
/end CHARACTERISTIC
/begin CHARACTERISTIC GlwCtl_tiLampUBatt_CUR "" CURVE 0x8003C1E8 Cur_Xs16Ws16 327460.0 Time_ms 0.00 327460.0 EXTENDED_LIMITS -327680.0 327670.0
 /begin AXIS_DESCR STD_AXIS BattU_u Volt_Batt 4 0.00 20780.00 EXTENDED_LIMITS -655360.0 655340.0 DEPOSIT ABSOLUTE /end AXIS_DESCR
/end CHARACTERISTIC
/begin CHARACTERISTIC GlwCtl_tiMaxOnClt_C "" VALUE 0x8003C450 Val_Ws32 42949672950.0 Time_ms -21474836480.0 21474836470.0 /end CHARACTERISTIC
/begin CHARACTERISTIC GlwCtl_tiNoEngSpd_C "" VALUE 0x8003C210 Val_Wu16 65540.00 Time_ms 0.00 65540.00 EXTENDED_LIMITS 0.00 655350.0 /end CHARACTERISTIC
/begin CHARACTERISTIC GlwCtl_tiPre_CUR "" CURVE 0x8003C212 Cur_Xs16Ws16 327460.0 Time_ms 0.00 327460.0 EXTENDED_LIMITS -327680.0 327670.0
 /begin AXIS_DESCR STD_AXIS GlwCtl_tClnt Temp_Cels 8 -50.14000 149.8600 EXTENDED_LIMITS -3549.940 3003.560 DEPOSIT ABSOLUTE /end AXIS_DESCR
/end CHARACTERISTIC
/begin CHARACTERISTIC GlwCtl_tiPSync_C "" VALUE 0x8003C1FA Val_Wu16 10000.00 Time_ms 0.00 10000.00 EXTENDED_LIMITS 0.00 655350.0 /end CHARACTERISTIC
/begin CHARACTERISTIC GlwCtl_tiReady_C "" VALUE 0x8003C234 Val_Wu16 65540.00 Time_ms 0.00 65540.00 EXTENDED_LIMITS 0.00 655350.0 /end CHARACTERISTIC
/begin CHARACTERISTIC GlwCtl_tiStrt_C "Dauer Status Startglühen" VALUE 0x8003C236 Val_Wu16 65540.00 Time_ms 0.00 65540.00 EXTENDED_LIMITS 0.00 655350.0 /end CHARACTERISTIC
/begin CHARACTERISTIC GlwCtl_tiWaitforTemp_C "" VALUE 0x8003C238 Val_Wu16 65540.00 Time_ms 0.00 65540.00 EXTENDED_LIMITS 0.00 655350.0 /end CHARACTERISTIC
/begin CHARACTERISTIC GlwCtl_tLimHigh_C "" VALUE 0x8003C23A Val_Ws16 473.1000 Temp_Cels -273.1400 199.9600 EXTENDED_LIMITS -3549.940 3003.560 /end CHARACTERISTIC
/begin CHARACTERISTIC GlwCtl_tLimLow_C "" VALUE 0x8003C23C Val_Ws16 473.1000 Temp_Cels -273.1400 199.9600 EXTENDED_LIMITS -3549.940 3003.560 /end CHARACTERISTIC
/begin CHARACTERISTIC GlwCtl_tMax_C "" VALUE 0x8003C454 Val_Ws16 6553.500 Temp_Cels -3549.940 3003.560 /end CHARACTERISTIC
/begin CHARACTERISTIC GlwCtl_tStrt_C "Oberer Schwellwert der Wassertemperatur für Startglühen" VALUE 0x8003C23E Val_Ws16 100.0000 Temp_Cels -50.04000 49.96000 EXTENDED_LIMITS -3549.940 3003.560 /end CHARACTERISTIC
/begin CHARACTERISTIC GlwEcu_numEngTyp_C "" VALUE 0x8006418E Val_Wu8 31.00 OneToOne 0.00 31.00 EXTENDED_LIMITS 0.00 255.0 /end CHARACTERISTIC
/begin CHARACTERISTIC GlwEcu_swtTempSel_C "" VALUE 0x8006418F Val_Wu8 4.000 OneToOne 0.00 4.000 EXTENDED_LIMITS 0.00 255.0 /end CHARACTERISTIC
/begin CHARACTERISTIC GlwEcu_tGlwPlgATS_C "" VALUE 0x80064190 Val_Ws16 1000.000 Temp_Cels -0.04000000 999.9600 EXTENDED_LIMITS -3549.940 3003.560 /end CHARACTERISTIC
/begin CHARACTERISTIC GSHDem_CldClthdnAccLim_C "Obere Grenze der zulässigen Beschleunigung der Motordrehzahl, Kalter Motor, offene Kupplung" VALUE 0x8003BE04 Val_Wr32 12000.0000 ISC_dnEng_float 0.00 12000.0000 FORMAT "%10.4" EXTENDED_LIMITS -1.00000000E+037 1.00000000E+037 /end CHARACTERISTIC
/begin CHARACTERISTIC GSHDem_CldClthdnDeclLim_C "Untere Grenze der zulässigen Verzögerung der Motordrehzahl, Kalter Motor, offene Kupplung" VALUE 0x8003BE08 Val_Wr32 12000.0000 ISC_dnEng_float -12000.0000 0.00 FORMAT "%10.4" EXTENDED_LIMITS -1.00000000E+037 1.00000000E+037 /end CHARACTERISTIC
/begin CHARACTERISTIC GSHDem_CldClthILo.Ki_C "I-Parametersatz unterer Drehmomentpfad, kalter Motor und geöffnete Kupplung/Kleinsignal Verstärkungsfaktor (Ki)" VALUE 0x8003BE0C Val_Wr32 20.0000000 ISC_Ki_rpm2Nm_float 0.00 20.0000000 FORMAT "%10.7" EXTENDED_LIMITS -1.00000000E+037 1.00000000E+037 /end CHARACTERISTIC
/begin CHARACTERISTIC GSHDem_CldClthILo.KiPos_C "I-Parametersatz unterer Drehmomentpfad, kalter Motor und geöffnete Kupplung/Großsignal Verstärkungsfaktor positiv (Ki)" VALUE 0x8003BE10 Val_Wr32 20.0000000 ISC_Ki_rpm2Nm_float 0.00 20.0000000 FORMAT "%10.7" EXTENDED_LIMITS -1.00000000E+037 1.00000000E+037 /end CHARACTERISTIC
/begin CHARACTERISTIC GSHDem_CldClthILo.KiNeg_C "I-Parametersatz unterer Drehmomentpfad, kalter Motor und geöffnete Kupplung/Großsignal Verstärkungsfaktor negativ (Ki)" VALUE 0x8003BE14 Val_Wr32 20.0000000 ISC_Ki_rpm2Nm_float 0.00 20.0000000 FORMAT "%10.7" EXTENDED_LIMITS -1.00000000E+037 1.00000000E+037 /end CHARACTERISTIC
/begin CHARACTERISTIC GSHDem_CldClthILo.WinPos_C "I-Parametersatz unterer Drehmomentpfad, kalter Motor und geöffnete Kupplung/Kleinsignal Fensterbreite positiv" VALUE 0x8003BE18 Val_Wr32 20000.0000 EngN_float -10000.0000 10000.0000 EXTENDED_LIMITS -1.00000000E+037 1.00000000E+037 /end CHARACTERISTIC
/begin CHARACTERISTIC GSHDem_CldClthILo.WinNeg_C "I-Parametersatz unterer Drehmomentpfad, kalter Motor und geöffnete Kupplung/Kleinsignal Fensterbreite negativ" VALUE 0x8003BE1C Val_Wr32 20000.0000 EngN_float -10000.0000 10000.0000 EXTENDED_LIMITS -1.00000000E+037 1.00000000E+037 /end CHARACTERISTIC
/begin CHARACTERISTIC GSHDem_CldClthInrtDrvTrn_C "Massenträgheitsmoment offener Antriebstrang" VALUE 0x8003BE20 Val_Wr32 20.0000000 ISC_Inirtia_float 0.00 20.0000000 FORMAT "%10.7" EXTENDED_LIMITS -1.00000000E+037 1.00000000E+037 /end CHARACTERISTIC
/begin CHARACTERISTIC GSHDem_CldClthInrtEng_C "Massenträgheitsmoment offener Antriebstrang, Kalter Motor" VALUE 0x8003BE24 Val_Wr32 20.0000000 ISC_Inirtia_float 0.00 20.0000000 FORMAT "%10.7" EXTENDED_LIMITS -1.00000000E+037 1.00000000E+037 /end CHARACTERISTIC
/begin CHARACTERISTIC GSHDem_CldClthInrtVeh_C "Massenträgheitsmoment offener Antriebstrang, Kalter Motor" VALUE 0x8003BE28 Val_Wr32 20.0000000 ISC_Inirtia_float 0.00 20.0000000 FORMAT "%10.7" EXTENDED_LIMITS -1.00000000E+037 1.00000000E+037 /end CHARACTERISTIC
/begin CHARACTERISTIC GSHDem_CldClthPLo.Kp_C "P-Parametersatz unterer Drehmomentpfad, kalter Motor und geöffnete Kupplung/Kleinsignal Verstärkungsfaktor (Kp)" VALUE 0x8003BE2C Val_Wr32 20.0000000 ISC_Kp_rpm2Nm_float 0.00 20.0000000 FORMAT "%10.7" EXTENDED_LIMITS -1.00000000E+037 1.00000000E+037 /end CHARACTERISTIC
/begin CHARACTERISTIC GSHDem_CldClthPLo.KpPos_C "P-Parametersatz unterer Drehmomentpfad, kalter Motor und geöffnete Kupplung/Großsignal Verstärkungsfaktor positiv (Kp)" VALUE 0x8003BE30 Val_Wr32 20.0000000 ISC_Kp_rpm2Nm_float 0.00 20.0000000 FORMAT "%10.7" EXTENDED_LIMITS -1.00000000E+037 1.00000000E+037 /end CHARACTERISTIC
/begin CHARACTERISTIC GSHDem_CldClthPLo.KpNeg_C "P-Parametersatz unterer Drehmomentpfad, kalter Motor und geöffnete Kupplung/Großsignal Verstärkungsfaktor negativ (Kp)" VALUE 0x8003BE34 Val_Wr32 20.0000000 ISC_Kp_rpm2Nm_float 0.00 20.0000000 FORMAT "%10.7" EXTENDED_LIMITS -1.00000000E+037 1.00000000E+037 /end CHARACTERISTIC
/begin CHARACTERISTIC GSHDem_CldClthPLo.WinPos_C "P-Parametersatz unterer Drehmomentpfad, kalter Motor und geöffnete Kupplung/Kleinsignal Fensterbreite positiv" VALUE 0x8003BE38 Val_Wr32 20000.0000 EngN_float -10000.0000 10000.0000 EXTENDED_LIMITS -1.00000000E+037 1.00000000E+037 /end CHARACTERISTIC
/begin CHARACTERISTIC GSHDem_CldClthPLo.WinNeg_C "P-Parametersatz unterer Drehmomentpfad, kalter Motor und geöffnete Kupplung/Kleinsignal Fensterbreite negativ" VALUE 0x8003BE3C Val_Wr32 20000.0000 EngN_float -10000.0000 10000.0000 EXTENDED_LIMITS -1.00000000E+037 1.00000000E+037 /end CHARACTERISTIC
/begin CHARACTERISTIC GSHDem_CldClthrnEngvVeh_C "Verhältnis Motordrehzahl zu Fahrzeuggeschwindigkeit, Kalter Motor (offene Kupplung)" VALUE 0x8003BE40 Val_Wr32 1000.00000 ISC_rnEng2vVeh_float 0.00 1000.00000 FORMAT "%10.5" EXTENDED_LIMITS -1.00000000E+037 1.00000000E+037 /end CHARACTERISTIC
/begin CHARACTERISTIC GSHDem_CldClthtiFltLosTrqEst_C "Zeitkonstante für die PT1-Glieder der Lastmomentabschätzung, Kalter Motor, offene Kupplung" VALUE 0x8003BE44 Val_Wr32 60.0000000 ISC_tiPTsTrqLoss_float 0.00 60.0000000 FORMAT "%10.7" EXTENDED_LIMITS -1.00000000E+037 1.00000000E+037 /end CHARACTERISTIC
/begin CHARACTERISTIC GSHDem_CldClthtiFltnEng_C "Zeitkonstante für die PT2-Filterung der Motordrehzahl, Kalter Motor, Offene Kupplung" VALUE 0x8003BE48 Val_Wr32 60.0000000 ISC_tiPT2nEng_float 0.00 60.0000000 FORMAT "%10.7" EXTENDED_LIMITS -1.00000000E+037 1.00000000E+037 /end CHARACTERISTIC
/begin CHARACTERISTIC GSHDem_CldSetPLoRmp.SlopePos_C "Rampen-Parametersatz untere Schaltdrehzahl, kalter Motor/Positive Rampenschrittweite" VALUE 0x8003BE4C Val_Ws32 10000.0000000 RmpEngN 0.00 10000.0000000 FORMAT "%13.7" EXTENDED_LIMITS -16384000.0000 16383999.9924 /end CHARACTERISTIC
/begin CHARACTERISTIC GSHDem_CldSetPLoRmp.SlopeNeg_C "Rampen-Parametersatz untere Schaltdrehzahl, kalter Motor/Negative Rampenschrittweite" VALUE 0x8003BE50 Val_Ws32 10000.0000000 RmpEngN 0.00 10000.0000000 FORMAT "%13.7" EXTENDED_LIMITS -16384000.0000 16383999.9924 /end CHARACTERISTIC
/begin CHARACTERISTIC GSHDem_nOfsLoIdlSpd_C "Drehzahl Offset auf die untere Leerlaufsolldrehzahl für die Freigabe des Schaltdrehzahlreglers" VALUE 0x8003BE54 Val_Ws16 10000.00 EngN 0.00 10000.00 EXTENDED_LIMITS -16384.00 16383.50 /end CHARACTERISTIC
/begin CHARACTERISTIC GSHDem_nSetPHiDfl_C "Vorgabewert für die obere Schaltdrehzahl" VALUE 0x8003BE56 Val_Ws16 10000.00 EngN 0.00 10000.00 EXTENDED_LIMITS -16384.00 16383.50 /end CHARACTERISTIC
/begin CHARACTERISTIC GSHDem_nSetPLoOfs_C "additiver Offset für die untere Schaltdrehzahl" VALUE 0x8003BE58 Val_Ws16 10000.00 EngN 0.00 10000.00 EXTENDED_LIMITS -16384.00 16383.50 /end CHARACTERISTIC
/begin CHARACTERISTIC GSHDem_numMaxGear_C "maximal möglicher nächst höherer Gang" VALUE 0x8003BE5A Val_Ws8 5.000 OneToOne 1.000 6.000 EXTENDED_LIMITS -128.0 127.0 /end CHARACTERISTIC
/begin CHARACTERISTIC GSHDem_numTempTrqMax_C "Temperaturauswahl für die Ermittlung vom maximalen Stelldrehmoment des Schaltdrehzahlreglers" VALUE 0x8003BE5B Val_Wu8 3.00000000000 EngTempFldSel 0.00 3.00000000000 FORMAT "%13.11" /end CHARACTERISTIC
/begin CHARACTERISTIC GSHDem_numTemp_C "Temperaturauswahl für die Ermittlung vom Motorzustand ""warm/kalt""" VALUE 0x8003BE5C Val_Wu8 3.00000000000 EngTempFldSel 0.00 3.00000000000 FORMAT "%13.11" /end CHARACTERISTIC
/begin CHARACTERISTIC GSHDem_rTraGear1_C "Triebstrangübersetzung Gang 1" VALUE 0x8003BE5E Val_Ws16 327.6700 TransR 0.00 327.6700 EXTENDED_LIMITS -327.6800 327.6700 /end CHARACTERISTIC
/begin CHARACTERISTIC GSHDem_rTraGear2_C "Triebstrangübersetzung Gang 2" VALUE 0x8003BE60 Val_Ws16 327.6700 TransR 0.00 327.6700 EXTENDED_LIMITS -327.6800 327.6700 /end CHARACTERISTIC
/begin CHARACTERISTIC GSHDem_rTraGear3_C "Triebstrangübersetzung Gang 3" VALUE 0x8003BE62 Val_Ws16 327.6700 TransR 0.00 327.6700 EXTENDED_LIMITS -327.6800 327.6700 /end CHARACTERISTIC
/begin CHARACTERISTIC GSHDem_rTraGear4_C "Triebstrangübersetzung Gang 4" VALUE 0x8003BE64 Val_Ws16 327.6700 TransR 0.00 327.6700 EXTENDED_LIMITS -327.6800 327.6700 /end CHARACTERISTIC
/begin CHARACTERISTIC GSHDem_rTraGear5_C "Triebstrangübersetzung Gang 5" VALUE 0x8003BE66 Val_Ws16 327.6700 TransR 0.00 327.6700 EXTENDED_LIMITS -327.6800 327.6700 /end CHARACTERISTIC
/begin CHARACTERISTIC GSHDem_rTraGear6_C "Triebstrangübersetzung Gang 6" VALUE 0x8003BE68 Val_Ws16 327.6700 TransR 0.00 327.6700 EXTENDED_LIMITS -327.6800 327.6700 /end CHARACTERISTIC
/begin CHARACTERISTIC GSHDem_swtDeActvISC_C "Schalter zur Deaktivierung des Schaltdrehzahlreglers" VALUE 0x8003BE6A Val_Wu8 1.000 OneToOne 0.00 1.000 EXTENDED_LIMITS 0.00 255.0 /end CHARACTERISTIC
/begin CHARACTERISTIC GSHDem_tiHldEngSpd_C "Zeitfenster zur Berücksichtigung der berechneten Schaltdrehzahl" VALUE 0x8003BE6C Val_Wu16 655350.0 Time_ms 0.00 655350.0 /end CHARACTERISTIC
/begin CHARACTERISTIC GSHDem_trqMax_MAP "Kennfeld für das maximal zulässiges Stellmoment für den Schaltdrehzahlreglereingriff" MAP 0x8003BE6E Map_Xs16Ys16Ws16 1000.000 Trq 0.00 1000.000 EXTENDED_LIMITS -3276.800 3276.700
 /begin AXIS_DESCR STD_AXIS Epm_nEng EngN 16 -16384.00 16383.50 DEPOSIT ABSOLUTE /end AXIS_DESCR
 /begin AXIS_DESCR STD_AXIS GSHDem_tTrqMax_mp Temp_Cels 16 -3549.940 3003.560 DEPOSIT ABSOLUTE /end AXIS_DESCR
/end CHARACTERISTIC
/begin CHARACTERISTIC GSHDem_tTempHysHi_C "obere Temperaturschwelle für die Hysterese zur Zustandsbestimmung ""warm/kalt""" VALUE 0x8003C0B2 Val_Ws16 200.0000 Temp_Cels -50.14000 149.8600 EXTENDED_LIMITS -3549.940 3003.560 /end CHARACTERISTIC
/begin CHARACTERISTIC GSHDem_tTempHysLo_C "untere Temperaturschwelle für die Hysterese zur Zustandsbestimmung ""warm/kalt""" VALUE 0x8003C0B4 Val_Ws16 200.0000 Temp_Cels -50.14000 149.8600 EXTENDED_LIMITS -3549.940 3003.560 /end CHARACTERISTIC
/begin CHARACTERISTIC GSHDem_WrmClthdnAccLim_C "Obere Grenze der zulässigen Beschleunigung der Motordrehzahl, warmer Motor, offene Kupplung" VALUE 0x8003C0B8 Val_Wr32 12000.0000 ISC_dnEng_float 0.00 12000.0000 FORMAT "%10.4" EXTENDED_LIMITS -1.00000000E+037 1.00000000E+037 /end CHARACTERISTIC
/begin CHARACTERISTIC GSHDem_WrmClthdnDeclLim_C "Untere Grenze der zulässigen Verzögerung der Motordrehzahl, warmer Motor, offene Kupplung" VALUE 0x8003C0BC Val_Wr32 12000.0000 ISC_dnEng_float -12000.0000 0.00 FORMAT "%10.4" EXTENDED_LIMITS -1.00000000E+037 1.00000000E+037 /end CHARACTERISTIC
/begin CHARACTERISTIC GSHDem_WrmClthILo.Ki_C "I-Parametersatz unterer Drehmomentpfad, warmer Motor und geöffnete Kupplung/Kleinsignal Verstärkungsfaktor (Ki)" VALUE 0x8003C0C0 Val_Wr32 20.0000000 ISC_Ki_rpm2Nm_float 0.00 20.0000000 FORMAT "%10.7" EXTENDED_LIMITS -1.00000000E+037 1.00000000E+037 /end CHARACTERISTIC
/begin CHARACTERISTIC GSHDem_WrmClthILo.KiPos_C "I-Parametersatz unterer Drehmomentpfad, warmer Motor und geöffnete Kupplung/Großsignal Verstärkungsfaktor positiv (Ki)" VALUE 0x8003C0C4 Val_Wr32 20.0000000 ISC_Ki_rpm2Nm_float 0.00 20.0000000 FORMAT "%10.7" EXTENDED_LIMITS -1.00000000E+037 1.00000000E+037 /end CHARACTERISTIC
/begin CHARACTERISTIC GSHDem_WrmClthILo.KiNeg_C "I-Parametersatz unterer Drehmomentpfad, warmer Motor und geöffnete Kupplung/Großsignal Verstärkungsfaktor negativ (Ki)" VALUE 0x8003C0C8 Val_Wr32 20.0000000 ISC_Ki_rpm2Nm_float 0.00 20.0000000 FORMAT "%10.7" EXTENDED_LIMITS -1.00000000E+037 1.00000000E+037 /end CHARACTERISTIC
/begin CHARACTERISTIC GSHDem_WrmClthILo.WinPos_C "I-Parametersatz unterer Drehmomentpfad, warmer Motor und geöffnete Kupplung/Kleinsignal Fensterbreite positiv" VALUE 0x8003C0CC Val_Wr32 20000.0000 EngN_float -10000.0000 10000.0000 EXTENDED_LIMITS -1.00000000E+037 1.00000000E+037 /end CHARACTERISTIC
/begin CHARACTERISTIC GSHDem_WrmClthILo.WinNeg_C "I-Parametersatz unterer Drehmomentpfad, warmer Motor und geöffnete Kupplung/Kleinsignal Fensterbreite negativ" VALUE 0x8003C0D0 Val_Wr32 20000.0000 EngN_float -10000.0000 10000.0000 EXTENDED_LIMITS -1.00000000E+037 1.00000000E+037 /end CHARACTERISTIC
/begin CHARACTERISTIC GSHDem_WrmClthInrtDrvTrn_C "Massenträgheitsmoment offener Antriebstrang" VALUE 0x8003C0D4 Val_Wr32 20.0000000 ISC_Inirtia_float 0.00 20.0000000 FORMAT "%10.7" EXTENDED_LIMITS -1.00000000E+037 1.00000000E+037 /end CHARACTERISTIC
/begin CHARACTERISTIC GSHDem_WrmClthInrtEng_C "Massenträgheitsmoment offener Antriebstrang, warmer Motor" VALUE 0x8003C0D8 Val_Wr32 20.0000000 ISC_Inirtia_float 0.00 20.0000000 FORMAT "%10.7" EXTENDED_LIMITS -1.00000000E+037 1.00000000E+037 /end CHARACTERISTIC
/begin CHARACTERISTIC GSHDem_WrmClthInrtVeh_C "Massenträgheitsmoment offener Antriebstrang, warmer Motor" VALUE 0x8003C0DC Val_Wr32 20.0000000 ISC_Inirtia_float 0.00 20.0000000 FORMAT "%10.7" EXTENDED_LIMITS -1.00000000E+037 1.00000000E+037 /end CHARACTERISTIC
/begin CHARACTERISTIC GSHDem_WrmClthPLo.Kp_C "P-Parametersatz unterer Drehmomentpfad, warmer Motor und geöffnete Kupplung/Kleinsignal Verstärkungsfaktor (Kp)" VALUE 0x8003C0E0 Val_Wr32 20.0000000 ISC_Kp_rpm2Nm_float 0.00 20.0000000 FORMAT "%10.7" EXTENDED_LIMITS -1.00000000E+037 1.00000000E+037 /end CHARACTERISTIC
/begin CHARACTERISTIC GSHDem_WrmClthPLo.KpPos_C "P-Parametersatz unterer Drehmomentpfad, warmer Motor und geöffnete Kupplung/Großsignal Verstärkungsfaktor positiv (Kp)" VALUE 0x8003C0E4 Val_Wr32 20.0000000 ISC_Kp_rpm2Nm_float 0.00 20.0000000 FORMAT "%10.7" EXTENDED_LIMITS -1.00000000E+037 1.00000000E+037 /end CHARACTERISTIC
/begin CHARACTERISTIC GSHDem_WrmClthPLo.KpNeg_C "P-Parametersatz unterer Drehmomentpfad, warmer Motor und geöffnete Kupplung/Großsignal Verstärkungsfaktor negativ (Kp)" VALUE 0x8003C0E8 Val_Wr32 20.0000000 ISC_Kp_rpm2Nm_float 0.00 20.0000000 FORMAT "%10.7" EXTENDED_LIMITS -1.00000000E+037 1.00000000E+037 /end CHARACTERISTIC
/begin CHARACTERISTIC GSHDem_WrmClthPLo.WinPos_C "P-Parametersatz unterer Drehmomentpfad, warmer Motor und geöffnete Kupplung/Kleinsignal Fensterbreite positiv" VALUE 0x8003C0EC Val_Wr32 20000.0000 EngN_float -10000.0000 10000.0000 EXTENDED_LIMITS -1.00000000E+037 1.00000000E+037 /end CHARACTERISTIC
/begin CHARACTERISTIC GSHDem_WrmClthPLo.WinNeg_C "P-Parametersatz unterer Drehmomentpfad, warmer Motor und geöffnete Kupplung/Kleinsignal Fensterbreite negativ" VALUE 0x8003C0F0 Val_Wr32 20000.0000 EngN_float -10000.0000 10000.0000 EXTENDED_LIMITS -1.00000000E+037 1.00000000E+037 /end CHARACTERISTIC
/begin CHARACTERISTIC GSHDem_WrmClthrnEngvVeh_C "Verhältnis Motordrehzahl zu Fahrzeuggeschwindigkeit, warmer Motor (offene Kupplung)" VALUE 0x8003C0F4 Val_Wr32 1000.00000 ISC_rnEng2vVeh_float 0.00 1000.00000 FORMAT "%10.5" EXTENDED_LIMITS -1.00000000E+037 1.00000000E+037 /end CHARACTERISTIC
/begin CHARACTERISTIC GSHDem_WrmClthtiFltLosTrqEst_C "Zeitkonstante für die PT1-Glieder der Lastmomentabschätzung, warmer Motor, offene Kupplung" VALUE 0x8003C0F8 Val_Wr32 60.0000000 ISC_tiPTsTrqLoss_float 0.00 60.0000000 FORMAT "%10.7" EXTENDED_LIMITS -1.00000000E+037 1.00000000E+037 /end CHARACTERISTIC
/begin CHARACTERISTIC GSHDem_WrmClthtiFltnEng_C "Zeitkonstante für die PT2-Filterung der Motordrehzahl, warmer Motor, Offene Kupplung" VALUE 0x8003C0FC Val_Wr32 60.0000000 ISC_tiPT2nEng_float 0.00 60.0000000 FORMAT "%10.7" EXTENDED_LIMITS -1.00000000E+037 1.00000000E+037 /end CHARACTERISTIC
/begin CHARACTERISTIC GSHDem_WrmSetPLoRmp.SlopePos_C "Rampen-Parametersatz untere Schaltdrehzahl, warmer Motor/Positive Rampenschrittweite" VALUE 0x8003C100 Val_Ws32 10000.0000000 RmpEngN 0.00 10000.0000000 FORMAT "%13.7" EXTENDED_LIMITS -16384000.0000 16383999.9924 /end CHARACTERISTIC
/begin CHARACTERISTIC GSHDem_WrmSetPLoRmp.SlopeNeg_C "Rampen-Parametersatz untere Schaltdrehzahl, warmer Motor/Negative Rampenschrittweite" VALUE 0x8003C104 Val_Ws32 10000.0000000 RmpEngN 0.00 10000.0000000 FORMAT "%13.7" EXTENDED_LIMITS -16384000.0000 16383999.9924 /end CHARACTERISTIC
/begin CHARACTERISTIC HESrv_swtPOpVis_C "Bankselektion für die Arbeitspunktanzeige bei zweiflutigen Luftsystemen in INCA" VALUE 0x8003C458 Val_Wu8 1.00000000000 HESrv_SwtPOpVis 0.00 1.00000000000 FORMAT "%13.11" /end CHARACTERISTIC
/begin CHARACTERISTIC HESrv_swtScndFlwActv_C "" VALUE 0x8003C459 Val_Wu8 1.000 OneToOne 0.00 1.000 EXTENDED_LIMITS 0.00 255.0 /end CHARACTERISTIC
/begin CHARACTERISTIC HLSDem_CldClthILo.Ki_C "I-Parametersatz unterer Drehmomentpfad, kalter Motor und geöffnete Kupplung/Kleinsignal Verstärkungsfaktor (Ki)" VALUE 0x8003C45C Val_Wr32 20.0000000 ISC_Ki_rpm2Nm_float 0.00 20.0000000 FORMAT "%10.7" EXTENDED_LIMITS -1.00000000E+037 1.00000000E+037 /end CHARACTERISTIC
/begin CHARACTERISTIC HLSDem_CldClthILo.KiPos_C "I-Parametersatz unterer Drehmomentpfad, kalter Motor und geöffnete Kupplung/Großsignal Verstärkungsfaktor positiv (Ki)" VALUE 0x8003C460 Val_Wr32 20.0000000 ISC_Ki_rpm2Nm_float 0.00 20.0000000 FORMAT "%10.7" EXTENDED_LIMITS -1.00000000E+037 1.00000000E+037 /end CHARACTERISTIC
/begin CHARACTERISTIC HLSDem_CldClthILo.KiNeg_C "I-Parametersatz unterer Drehmomentpfad, kalter Motor und geöffnete Kupplung/Großsignal Verstärkungsfaktor negativ (Ki)" VALUE 0x8003C464 Val_Wr32 20.0000000 ISC_Ki_rpm2Nm_float 0.00 20.0000000 FORMAT "%10.7" EXTENDED_LIMITS -1.00000000E+037 1.00000000E+037 /end CHARACTERISTIC
/begin CHARACTERISTIC HLSDem_CldClthILo.WinPos_C "I-Parametersatz unterer Drehmomentpfad, kalter Motor und geöffnete Kupplung/Kleinsignal Fensterbreite positiv" VALUE 0x8003C468 Val_Wr32 20000.0000 EngN_float -10000.0000 10000.0000 EXTENDED_LIMITS -1.00000000E+037 1.00000000E+037 /end CHARACTERISTIC
/begin CHARACTERISTIC HLSDem_CldClthILo.WinNeg_C "I-Parametersatz unterer Drehmomentpfad, kalter Motor und geöffnete Kupplung/Kleinsignal Fensterbreite negativ" VALUE 0x8003C46C Val_Wr32 20000.0000 EngN_float -10000.0000 10000.0000 EXTENDED_LIMITS -1.00000000E+037 1.00000000E+037 /end CHARACTERISTIC
/begin CHARACTERISTIC HLSDem_CldClthPLo.Kp_C "P-Parametersatz unterer Drehmomentpfad, kalter Motor und geöffnete Kupplung/Kleinsignal Verstärkungsfaktor (Kp)" VALUE 0x8003C470 Val_Wr32 20.0000000 ISC_Kp_rpm2Nm_float 0.00 20.0000000 FORMAT "%10.7" EXTENDED_LIMITS -1.00000000E+037 1.00000000E+037 /end CHARACTERISTIC
/begin CHARACTERISTIC HLSDem_CldClthPLo.KpPos_C "P-Parametersatz unterer Drehmomentpfad, kalter Motor und geöffnete Kupplung/Großsignal Verstärkungsfaktor positiv (Kp)" VALUE 0x8003C474 Val_Wr32 20.0000000 ISC_Kp_rpm2Nm_float 0.00 20.0000000 FORMAT "%10.7" EXTENDED_LIMITS -1.00000000E+037 1.00000000E+037 /end CHARACTERISTIC
/begin CHARACTERISTIC HLSDem_CldClthPLo.KpNeg_C "P-Parametersatz unterer Drehmomentpfad, kalter Motor und geöffnete Kupplung/Großsignal Verstärkungsfaktor negativ (Kp)" VALUE 0x8003C478 Val_Wr32 20.0000000 ISC_Kp_rpm2Nm_float 0.00 20.0000000 FORMAT "%10.7" EXTENDED_LIMITS -1.00000000E+037 1.00000000E+037 /end CHARACTERISTIC
/begin CHARACTERISTIC HLSDem_CldClthPLo.WinPos_C "P-Parametersatz unterer Drehmomentpfad, kalter Motor und geöffnete Kupplung/Kleinsignal Fensterbreite positiv" VALUE 0x8003C47C Val_Wr32 20000.0000 EngN_float -10000.0000 10000.0000 EXTENDED_LIMITS -1.00000000E+037 1.00000000E+037 /end CHARACTERISTIC
/begin CHARACTERISTIC HLSDem_CldClthPLo.WinNeg_C "P-Parametersatz unterer Drehmomentpfad, kalter Motor und geöffnete Kupplung/Kleinsignal Fensterbreite negativ" VALUE 0x8003C480 Val_Wr32 20000.0000 EngN_float -10000.0000 10000.0000 EXTENDED_LIMITS -1.00000000E+037 1.00000000E+037 /end CHARACTERISTIC
/begin CHARACTERISTIC HLSDem_CldClthtiFltLosTrqEst_C "Zeitkonstante für die PT1-Glieder der Lastmomentabschätzung, Kalter Motor, offene Kupplung" VALUE 0x8003C484 Val_Wr32 60.0000000 ISC_tiPTsTrqLoss_float 0.00 60.0000000 FORMAT "%10.7" EXTENDED_LIMITS -1.00000000E+037 1.00000000E+037 /end CHARACTERISTIC
/begin CHARACTERISTIC HLSDem_CldGearPLo.Kp_C "P-Parametersatz unterer Drehmomentpfad, kalter Motor und geschlossene Kupplung (eingelegter Gang)/Kleinsignal Verstärkungsfaktor (Kp)" VALUE 0x8003C488 Val_Wr32 20.0000000 ISC_Kp_rpm2Nm_float 0.00 20.0000000 FORMAT "%10.7" EXTENDED_LIMITS -1.00000000E+037 1.00000000E+037 /end CHARACTERISTIC
/begin CHARACTERISTIC HLSDem_CldGearPLo.KpPos_C "P-Parametersatz unterer Drehmomentpfad, kalter Motor und geschlossene Kupplung (eingelegter Gang)/Großsignal Verstärkungsfaktor positiv (Kp)" VALUE 0x8003C48C Val_Wr32 20.0000000 ISC_Kp_rpm2Nm_float 0.00 20.0000000 FORMAT "%10.7" EXTENDED_LIMITS -1.00000000E+037 1.00000000E+037 /end CHARACTERISTIC
/begin CHARACTERISTIC HLSDem_CldGearPLo.KpNeg_C "P-Parametersatz unterer Drehmomentpfad, kalter Motor und geschlossene Kupplung (eingelegter Gang)/Großsignal Verstärkungsfaktor negativ (Kp)" VALUE 0x8003C490 Val_Wr32 20.0000000 ISC_Kp_rpm2Nm_float 0.00 20.0000000 FORMAT "%10.7" EXTENDED_LIMITS -1.00000000E+037 1.00000000E+037 /end CHARACTERISTIC
/begin CHARACTERISTIC HLSDem_CldGearPLo.WinPos_C "P-Parametersatz unterer Drehmomentpfad, kalter Motor und geschlossene Kupplung (eingelegter Gang)/Kleinsignal Fensterbreite positiv" VALUE 0x8003C494 Val_Wr32 20000.0000 EngN_float -10000.0000 10000.0000 EXTENDED_LIMITS -1.00000000E+037 1.00000000E+037 /end CHARACTERISTIC
/begin CHARACTERISTIC HLSDem_CldGearPLo.WinNeg_C "P-Parametersatz unterer Drehmomentpfad, kalter Motor und geschlossene Kupplung (eingelegter Gang)/Kleinsignal Fensterbreite negativ" VALUE 0x8003C498 Val_Wr32 20000.0000 EngN_float -10000.0000 10000.0000 EXTENDED_LIMITS -1.00000000E+037 1.00000000E+037 /end CHARACTERISTIC
/begin CHARACTERISTIC HLSDem_CldGeartiFltLosTrqEst_C "Zeitkonstante für die PT1-Glieder der Lastmomentabschätzung, Kalter Motor, geschlossene Kupplung" VALUE 0x8003C49C Val_Wr32 60.0000000 ISC_tiPTsTrqLoss_float 0.00 60.0000000 FORMAT "%10.7" EXTENDED_LIMITS -1.00000000E+037 1.00000000E+037 /end CHARACTERISTIC
/begin CHARACTERISTIC HLSDem_dnSetPLoLimHiTrm_C "Obergrenze für den Abgleichswert der unteren Leerlaufsolldrehzahl" VALUE 0x8003C6B8 Kw_Ws16 32767.50 EngN -16384.00 16383.50 /end CHARACTERISTIC
/begin CHARACTERISTIC HLSDem_dnSetPLoLimLoTrm_C "Untergrenze für den Abgleichswert der unteren Leerlaufsolldrehzahl" VALUE 0x8003C6BA Kw_Ws16 32767.50 EngN -16384.00 16383.50 /end CHARACTERISTIC
/begin CHARACTERISTIC HLSDem_Gear1dnAccLim_C "Obere Grenze der zulässigen Beschleunigung der Motordrehzahl, geschlossene Kupplung (eingelegter Gang 1)" VALUE 0x8003C4A0 Val_Wr32 12000.0000 ISC_dnEng_float 0.00 12000.0000 FORMAT "%10.4" EXTENDED_LIMITS -1.00000000E+037 1.00000000E+037 /end CHARACTERISTIC
/begin CHARACTERISTIC HLSDem_Gear1dnDeclLimBrk_C "Untere Grenze der zulässigen Verzögerung der Motordrehzahl, geschlossene Kupplung (eingelegter Gang 1) und Bremse betätigt" VALUE 0x8003C4A4 Val_Wr32 12000.0000 ISC_dnEng_float -12000.0000 0.00 FORMAT "%10.4" EXTENDED_LIMITS -1.00000000E+037 1.00000000E+037 /end CHARACTERISTIC
/begin CHARACTERISTIC HLSDem_Gear1dnDeclLim_C "Untere Grenze der zulässigen Verzögerung der Motordrehzahl, geschlossene Kupplung (eingelegter Gang 1)" VALUE 0x8003C4A8 Val_Wr32 12000.0000 ISC_dnEng_float -12000.0000 0.00 FORMAT "%10.4" EXTENDED_LIMITS -1.00000000E+037 1.00000000E+037 /end CHARACTERISTIC
/begin CHARACTERISTIC HLSDem_Gear1InrtDrvTrn_C "Massenträgheitsmoment geschlossener Antriebstrang, Kalter Motor (eingelegter Gang 1)" VALUE 0x8003C4AC Val_Wr32 20.0000000 ISC_Inirtia_float 0.00 20.0000000 FORMAT "%10.7" EXTENDED_LIMITS -1.00000000E+037 1.00000000E+037 /end CHARACTERISTIC
/begin CHARACTERISTIC HLSDem_Gear1InrtVeh_C "Massenträgheitsmoment gesamtes Fahrzeug, geschlossene Kupplung (eingelegter Gang 1)" VALUE 0x8003C4B0 Val_Wr32 20.0000000 ISC_Inirtia_float 0.00 20.0000000 FORMAT "%10.7" EXTENDED_LIMITS -1.00000000E+037 1.00000000E+037 /end CHARACTERISTIC
/begin CHARACTERISTIC HLSDem_Gear1PLo.Kp_C "P-Parametersatz unterer Drehmomentpfad, geschlossene Kupplung (eingelegter Gang 1)/Kleinsignal Verstärkungsfaktor (Kp)" VALUE 0x8003C4B4 Val_Wr32 20.0000000 ISC_Kp_rpm2Nm_float 0.00 20.0000000 FORMAT "%10.7" EXTENDED_LIMITS -1.00000000E+037 1.00000000E+037 /end CHARACTERISTIC
/begin CHARACTERISTIC HLSDem_Gear1PLo.KpPos_C "P-Parametersatz unterer Drehmomentpfad, geschlossene Kupplung (eingelegter Gang 1)/Großsignal Verstärkungsfaktor positiv (Kp)" VALUE 0x8003C4B8 Val_Wr32 20.0000000 ISC_Kp_rpm2Nm_float 0.00 20.0000000 FORMAT "%10.7" EXTENDED_LIMITS -1.00000000E+037 1.00000000E+037 /end CHARACTERISTIC
/begin CHARACTERISTIC HLSDem_Gear1PLo.KpNeg_C "P-Parametersatz unterer Drehmomentpfad, geschlossene Kupplung (eingelegter Gang 1)/Großsignal Verstärkungsfaktor negativ (Kp)" VALUE 0x8003C4BC Val_Wr32 20.0000000 ISC_Kp_rpm2Nm_float 0.00 20.0000000 FORMAT "%10.7" EXTENDED_LIMITS -1.00000000E+037 1.00000000E+037 /end CHARACTERISTIC
/begin CHARACTERISTIC HLSDem_Gear1PLo.WinPos_C "P-Parametersatz unterer Drehmomentpfad, geschlossene Kupplung (eingelegter Gang 1)/Kleinsignal Fensterbreite positiv" VALUE 0x8003C4C0 Val_Wr32 20000.0000 EngN_float -10000.0000 10000.0000 EXTENDED_LIMITS -1.00000000E+037 1.00000000E+037 /end CHARACTERISTIC
/begin CHARACTERISTIC HLSDem_Gear1PLo.WinNeg_C "P-Parametersatz unterer Drehmomentpfad, geschlossene Kupplung (eingelegter Gang 1)/Kleinsignal Fensterbreite negativ" VALUE 0x8003C4C4 Val_Wr32 20000.0000 EngN_float -10000.0000 10000.0000 EXTENDED_LIMITS -1.00000000E+037 1.00000000E+037 /end CHARACTERISTIC
/begin CHARACTERISTIC HLSDem_Gear1rnEngvVeh_C "Verhältnis Motordrehzahl zu Fahrzeuggeschwindigkeit, geschlosse Kupplung(eingelegter Gang 1)" VALUE 0x8003C4C8 Val_Wr32 1000.00000 ISC_rnEng2vVeh_float 0.00 1000.00000 FORMAT "%10.5" EXTENDED_LIMITS -1.00000000E+037 1.00000000E+037 /end CHARACTERISTIC
/begin CHARACTERISTIC HLSDem_Gear1tiFltLosTrqEst_C "Zeitkonstante für die PT1-Glieder der Lastmomentabschätzung, geschlossene Kupplung (eingelegter Gang 1)" VALUE 0x8003C4CC Val_Wr32 60.0000000 ISC_tiPTsTrqLoss_float 0.00 60.0000000 FORMAT "%10.7" EXTENDED_LIMITS -1.00000000E+037 1.00000000E+037 /end CHARACTERISTIC
/begin CHARACTERISTIC HLSDem_Gear1tiFltnEng_C "Zeitkonstante für die PT2-Filterung der Motordrehzahl, geschlossene Kupplung (eingelegter Gang 1)" VALUE 0x8003C4D0 Val_Wr32 60.0000000 ISC_tiPT2nEng_float 0.00 60.0000000 FORMAT "%10.7" EXTENDED_LIMITS -1.00000000E+037 1.00000000E+037 /end CHARACTERISTIC
/begin CHARACTERISTIC HLSDem_Gear2dnAccLim_C "Obere Grenze der zulässigen Beschleunigung der Motordrehzahl, geschlossene Kupplung (eingelegter Gang 2)" VALUE 0x8003C4D4 Val_Wr32 12000.0000 ISC_dnEng_float 0.00 12000.0000 FORMAT "%10.4" EXTENDED_LIMITS -1.00000000E+037 1.00000000E+037 /end CHARACTERISTIC
/begin CHARACTERISTIC HLSDem_Gear2dnDeclLimBrk_C "Untere Grenze der zulässigen Verzögerung der Motordrehzahl, geschlossene Kupplung (eingelegter Gang 2) und Bremse betätigt" VALUE 0x8003C4D8 Val_Wr32 12000.0000 ISC_dnEng_float -12000.0000 0.00 FORMAT "%10.4" EXTENDED_LIMITS -1.00000000E+037 1.00000000E+037 /end CHARACTERISTIC
/begin CHARACTERISTIC HLSDem_Gear2dnDeclLim_C "Untere Grenze der zulässigen Verzögerung der Motordrehzahl, geschlossene Kupplung (eingelegter Gang 2)" VALUE 0x8003C4DC Val_Wr32 12000.0000 ISC_dnEng_float -12000.0000 0.00 FORMAT "%10.4" EXTENDED_LIMITS -1.00000000E+037 1.00000000E+037 /end CHARACTERISTIC
/begin CHARACTERISTIC HLSDem_Gear2InrtDrvTrn_C "Massenträgheitsmoment geschlossener Antriebstrang, Kalter Motor (eingelegter Gang 2)" VALUE 0x8003C4E0 Val_Wr32 20.0000000 ISC_Inirtia_float 0.00 20.0000000 FORMAT "%10.7" EXTENDED_LIMITS -1.00000000E+037 1.00000000E+037 /end CHARACTERISTIC
/begin CHARACTERISTIC HLSDem_Gear2InrtVeh_C "Massenträgheitsmoment gesamtes Fahrzeug, geschlossene Kupplung (eingelegter Gang 2)" VALUE 0x8003C4E4 Val_Wr32 20.0000000 ISC_Inirtia_float 0.00 20.0000000 FORMAT "%10.7" EXTENDED_LIMITS -1.00000000E+037 1.00000000E+037 /end CHARACTERISTIC
/begin CHARACTERISTIC HLSDem_Gear2PLo.Kp_C "P-Parametersatz unterer Drehmomentpfad, geschlossene Kupplung (eingelegter Gang 2)/Kleinsignal Verstärkungsfaktor (Kp)" VALUE 0x8003C4E8 Val_Wr32 20.0000000 ISC_Kp_rpm2Nm_float 0.00 20.0000000 FORMAT "%10.7" EXTENDED_LIMITS -1.00000000E+037 1.00000000E+037 /end CHARACTERISTIC
/begin CHARACTERISTIC HLSDem_Gear2PLo.KpPos_C "P-Parametersatz unterer Drehmomentpfad, geschlossene Kupplung (eingelegter Gang 2)/Großsignal Verstärkungsfaktor positiv (Kp)" VALUE 0x8003C4EC Val_Wr32 20.0000000 ISC_Kp_rpm2Nm_float 0.00 20.0000000 FORMAT "%10.7" EXTENDED_LIMITS -1.00000000E+037 1.00000000E+037 /end CHARACTERISTIC
/begin CHARACTERISTIC HLSDem_Gear2PLo.KpNeg_C "P-Parametersatz unterer Drehmomentpfad, geschlossene Kupplung (eingelegter Gang 2)/Großsignal Verstärkungsfaktor negativ (Kp)" VALUE 0x8003C4F0 Val_Wr32 20.0000000 ISC_Kp_rpm2Nm_float 0.00 20.0000000 FORMAT "%10.7" EXTENDED_LIMITS -1.00000000E+037 1.00000000E+037 /end CHARACTERISTIC
/begin CHARACTERISTIC HLSDem_Gear2PLo.WinPos_C "P-Parametersatz unterer Drehmomentpfad, geschlossene Kupplung (eingelegter Gang 2)/Kleinsignal Fensterbreite positiv" VALUE 0x8003C4F4 Val_Wr32 20000.0000 EngN_float -10000.0000 10000.0000 EXTENDED_LIMITS -1.00000000E+037 1.00000000E+037 /end CHARACTERISTIC
/begin CHARACTERISTIC HLSDem_Gear2PLo.WinNeg_C "P-Parametersatz unterer Drehmomentpfad, geschlossene Kupplung (eingelegter Gang 2)/Kleinsignal Fensterbreite negativ" VALUE 0x8003C4F8 Val_Wr32 20000.0000 EngN_float -10000.0000 10000.0000 EXTENDED_LIMITS -1.00000000E+037 1.00000000E+037 /end CHARACTERISTIC
/begin CHARACTERISTIC HLSDem_Gear2rnEngvVeh_C "Verhältnis Motordrehzahl zu Fahrzeuggeschwindigkeit, geschlosse Kupplung(eingelegter Gang 2)" VALUE 0x8003C4FC Val_Wr32 1000.00000 ISC_rnEng2vVeh_float 0.00 1000.00000 FORMAT "%10.5" EXTENDED_LIMITS -1.00000000E+037 1.00000000E+037 /end CHARACTERISTIC
/begin CHARACTERISTIC HLSDem_Gear2tiFltLosTrqEst_C "Zeitkonstante für die PT1-Glieder der Lastmomentabschätzung, geschlossene Kupplung (eingelegter Gang 2)" VALUE 0x8003C500 Val_Wr32 60.0000000 ISC_tiPTsTrqLoss_float 0.00 60.0000000 FORMAT "%10.7" EXTENDED_LIMITS -1.00000000E+037 1.00000000E+037 /end CHARACTERISTIC
/begin CHARACTERISTIC HLSDem_Gear2tiFltnEng_C "Zeitkonstante für die PT2-Filterung der Motordrehzahl, geschlossene Kupplung (eingelegter Gang 2)" VALUE 0x8003C504 Val_Wr32 60.0000000 ISC_tiPT2nEng_float 0.00 60.0000000 FORMAT "%10.7" EXTENDED_LIMITS -1.00000000E+037 1.00000000E+037 /end CHARACTERISTIC
/begin CHARACTERISTIC HLSDem_Gear3dnAccLim_C "Obere Grenze der zulässigen Beschleunigung der Motordrehzahl, geschlossene Kupplung (eingelegter Gang 3)" VALUE 0x8003C508 Val_Wr32 12000.0000 ISC_dnEng_float 0.00 12000.0000 FORMAT "%10.4" EXTENDED_LIMITS -1.00000000E+037 1.00000000E+037 /end CHARACTERISTIC
/begin CHARACTERISTIC HLSDem_Gear3dnDeclLimBrk_C "Untere Grenze der zulässigen Verzögerung der Motordrehzahl, geschlossene Kupplung (eingelegter Gang 3) und Bremse betätigt" VALUE 0x8003C50C Val_Wr32 12000.0000 ISC_dnEng_float -12000.0000 0.00 FORMAT "%10.4" EXTENDED_LIMITS -1.00000000E+037 1.00000000E+037 /end CHARACTERISTIC
/begin CHARACTERISTIC HLSDem_Gear3dnDeclLim_C "Untere Grenze der zulässigen Verzögerung der Motordrehzahl, geschlossene Kupplung (eingelegter Gang 3)" VALUE 0x8003C510 Val_Wr32 12000.0000 ISC_dnEng_float -12000.0000 0.00 FORMAT "%10.4" EXTENDED_LIMITS -1.00000000E+037 1.00000000E+037 /end CHARACTERISTIC
/begin CHARACTERISTIC HLSDem_Gear3InrtDrvTrn_C "Massenträgheitsmoment geschlossener Antriebstrang, Kalter Motor (eingelegter Gang 3)" VALUE 0x8003C514 Val_Wr32 20.0000000 ISC_Inirtia_float 0.00 20.0000000 FORMAT "%10.7" EXTENDED_LIMITS -1.00000000E+037 1.00000000E+037 /end CHARACTERISTIC
/begin CHARACTERISTIC HLSDem_Gear3InrtVeh_C "Massenträgheitsmoment gesamtes Fahrzeug, geschlossene Kupplung (eingelegter Gang 3)" VALUE 0x8003C518 Val_Wr32 20.0000000 ISC_Inirtia_float 0.00 20.0000000 FORMAT "%10.7" EXTENDED_LIMITS -1.00000000E+037 1.00000000E+037 /end CHARACTERISTIC
/begin CHARACTERISTIC HLSDem_Gear3PLo.Kp_C "P-Parametersatz unterer Drehmomentpfad, geschlossene Kupplung (eingelegter Gang 3)/Kleinsignal Verstärkungsfaktor (Kp)" VALUE 0x8003C51C Val_Wr32 20.0000000 ISC_Kp_rpm2Nm_float 0.00 20.0000000 FORMAT "%10.7" EXTENDED_LIMITS -1.00000000E+037 1.00000000E+037 /end CHARACTERISTIC
/begin CHARACTERISTIC HLSDem_Gear3PLo.KpPos_C "P-Parametersatz unterer Drehmomentpfad, geschlossene Kupplung (eingelegter Gang 3)/Großsignal Verstärkungsfaktor positiv (Kp)" VALUE 0x8003C520 Val_Wr32 20.0000000 ISC_Kp_rpm2Nm_float 0.00 20.0000000 FORMAT "%10.7" EXTENDED_LIMITS -1.00000000E+037 1.00000000E+037 /end CHARACTERISTIC
/begin CHARACTERISTIC HLSDem_Gear3PLo.KpNeg_C "P-Parametersatz unterer Drehmomentpfad, geschlossene Kupplung (eingelegter Gang 3)/Großsignal Verstärkungsfaktor negativ (Kp)" VALUE 0x8003C524 Val_Wr32 20.0000000 ISC_Kp_rpm2Nm_float 0.00 20.0000000 FORMAT "%10.7" EXTENDED_LIMITS -1.00000000E+037 1.00000000E+037 /end CHARACTERISTIC
/begin CHARACTERISTIC HLSDem_Gear3PLo.WinPos_C "P-Parametersatz unterer Drehmomentpfad, geschlossene Kupplung (eingelegter Gang 3)/Kleinsignal Fensterbreite positiv" VALUE 0x8003C528 Val_Wr32 20000.0000 EngN_float -10000.0000 10000.0000 EXTENDED_LIMITS -1.00000000E+037 1.00000000E+037 /end CHARACTERISTIC
/begin CHARACTERISTIC HLSDem_Gear3PLo.WinNeg_C "P-Parametersatz unterer Drehmomentpfad, geschlossene Kupplung (eingelegter Gang 3)/Kleinsignal Fensterbreite negativ" VALUE 0x8003C52C Val_Wr32 20000.0000 EngN_float -10000.0000 10000.0000 EXTENDED_LIMITS -1.00000000E+037 1.00000000E+037 /end CHARACTERISTIC
/begin CHARACTERISTIC HLSDem_Gear3rnEngvVeh_C "Verhältnis Motordrehzahl zu Fahrzeuggeschwindigkeit, geschlosse Kupplung(eingelegter Gang 3)" VALUE 0x8003C530 Val_Wr32 1000.00000 ISC_rnEng2vVeh_float 0.00 1000.00000 FORMAT "%10.5" EXTENDED_LIMITS -1.00000000E+037 1.00000000E+037 /end CHARACTERISTIC
/begin CHARACTERISTIC HLSDem_Gear3tiFltLosTrqEst_C "Zeitkonstante für die PT1-Glieder der Lastmomentabschätzung, geschlossene Kupplung (eingelegter Gang 3)" VALUE 0x8003C534 Val_Wr32 60.0000000 ISC_tiPTsTrqLoss_float 0.00 60.0000000 FORMAT "%10.7" EXTENDED_LIMITS -1.00000000E+037 1.00000000E+037 /end CHARACTERISTIC
/begin CHARACTERISTIC HLSDem_Gear3tiFltnEng_C "Zeitkonstante für die PT2-Filterung der Motordrehzahl, geschlossene Kupplung (eingelegter Gang 3)" VALUE 0x8003C538 Val_Wr32 60.0000000 ISC_tiPT2nEng_float 0.00 60.0000000 FORMAT "%10.7" EXTENDED_LIMITS -1.00000000E+037 1.00000000E+037 /end CHARACTERISTIC
/begin CHARACTERISTIC HLSDem_Gear4dnAccLim_C "Obere Grenze der zulässigen Beschleunigung der Motordrehzahl, geschlossene Kupplung (eingelegter Gang 4)" VALUE 0x8003C53C Val_Wr32 12000.0000 ISC_dnEng_float 0.00 12000.0000 FORMAT "%10.4" EXTENDED_LIMITS -1.00000000E+037 1.00000000E+037 /end CHARACTERISTIC
/begin CHARACTERISTIC HLSDem_Gear4dnDeclLimBrk_C "Untere Grenze der zulässigen Verzögerung der Motordrehzahl, geschlossene Kupplung (eingelegter Gang 4) und Bremse betätigt" VALUE 0x8003C540 Val_Wr32 12000.0000 ISC_dnEng_float -12000.0000 0.00 FORMAT "%10.4" EXTENDED_LIMITS -1.00000000E+037 1.00000000E+037 /end CHARACTERISTIC
/begin CHARACTERISTIC HLSDem_Gear4dnDeclLim_C "Untere Grenze der zulässigen Verzögerung der Motordrehzahl, geschlossene Kupplung (eingelegter Gang 4)" VALUE 0x8003C544 Val_Wr32 12000.0000 ISC_dnEng_float -12000.0000 0.00 FORMAT "%10.4" EXTENDED_LIMITS -1.00000000E+037 1.00000000E+037 /end CHARACTERISTIC
/begin CHARACTERISTIC HLSDem_Gear4InrtDrvTrn_C "Massenträgheitsmoment geschlossener Antriebstrang, Kalter Motor (eingelegter Gang 4)" VALUE 0x8003C548 Val_Wr32 20.0000000 ISC_Inirtia_float 0.00 20.0000000 FORMAT "%10.7" EXTENDED_LIMITS -1.00000000E+037 1.00000000E+037 /end CHARACTERISTIC
/begin CHARACTERISTIC HLSDem_Gear4InrtVeh_C "Massenträgheitsmoment gesamtes Fahrzeug, geschlossene Kupplung (eingelegter Gang 4)" VALUE 0x8003C54C Val_Wr32 20.0000000 ISC_Inirtia_float 0.00 20.0000000 FORMAT "%10.7" EXTENDED_LIMITS -1.00000000E+037 1.00000000E+037 /end CHARACTERISTIC
/begin CHARACTERISTIC HLSDem_Gear4PLo.Kp_C "P-Parametersatz unterer Drehmomentpfad, geschlossene Kupplung (eingelegter Gang 4)/Kleinsignal Verstärkungsfaktor (Kp)" VALUE 0x8003C550 Val_Wr32 20.0000000 ISC_Kp_rpm2Nm_float 0.00 20.0000000 FORMAT "%10.7" EXTENDED_LIMITS -1.00000000E+037 1.00000000E+037 /end CHARACTERISTIC
/begin CHARACTERISTIC HLSDem_Gear4PLo.KpPos_C "P-Parametersatz unterer Drehmomentpfad, geschlossene Kupplung (eingelegter Gang 4)/Großsignal Verstärkungsfaktor positiv (Kp)" VALUE 0x8003C554 Val_Wr32 20.0000000 ISC_Kp_rpm2Nm_float 0.00 20.0000000 FORMAT "%10.7" EXTENDED_LIMITS -1.00000000E+037 1.00000000E+037 /end CHARACTERISTIC
/begin CHARACTERISTIC HLSDem_Gear4PLo.KpNeg_C "P-Parametersatz unterer Drehmomentpfad, geschlossene Kupplung (eingelegter Gang 4)/Großsignal Verstärkungsfaktor negativ (Kp)" VALUE 0x8003C558 Val_Wr32 20.0000000 ISC_Kp_rpm2Nm_float 0.00 20.0000000 FORMAT "%10.7" EXTENDED_LIMITS -1.00000000E+037 1.00000000E+037 /end CHARACTERISTIC
/begin CHARACTERISTIC HLSDem_Gear4PLo.WinPos_C "P-Parametersatz unterer Drehmomentpfad, geschlossene Kupplung (eingelegter Gang 4)/Kleinsignal Fensterbreite positiv" VALUE 0x8003C55C Val_Wr32 20000.0000 EngN_float -10000.0000 10000.0000 EXTENDED_LIMITS -1.00000000E+037 1.00000000E+037 /end CHARACTERISTIC
/begin CHARACTERISTIC HLSDem_Gear4PLo.WinNeg_C "P-Parametersatz unterer Drehmomentpfad, geschlossene Kupplung (eingelegter Gang 4)/Kleinsignal Fensterbreite negativ" VALUE 0x8003C560 Val_Wr32 20000.0000 EngN_float -10000.0000 10000.0000 EXTENDED_LIMITS -1.00000000E+037 1.00000000E+037 /end CHARACTERISTIC
/begin CHARACTERISTIC HLSDem_Gear4rnEngvVeh_C "Verhältnis Motordrehzahl zu Fahrzeuggeschwindigkeit, geschlosse Kupplung(eingelegter Gang 4)" VALUE 0x8003C564 Val_Wr32 1000.00000 ISC_rnEng2vVeh_float 0.00 1000.00000 FORMAT "%10.5" EXTENDED_LIMITS -1.00000000E+037 1.00000000E+037 /end CHARACTERISTIC
/begin CHARACTERISTIC HLSDem_Gear4tiFltLosTrqEst_C "Zeitkonstante für die PT1-Glieder der Lastmomentabschätzung, geschlossene Kupplung (eingelegter Gang 4)" VALUE 0x8003C568 Val_Wr32 60.0000000 ISC_tiPTsTrqLoss_float 0.00 60.0000000 FORMAT "%10.7" EXTENDED_LIMITS -1.00000000E+037 1.00000000E+037 /end CHARACTERISTIC
/begin CHARACTERISTIC HLSDem_Gear4tiFltnEng_C "Zeitkonstante für die PT2-Filterung der Motordrehzahl, geschlossene Kupplung (eingelegter Gang 4)" VALUE 0x8003C56C Val_Wr32 60.0000000 ISC_tiPT2nEng_float 0.00 60.0000000 FORMAT "%10.7" EXTENDED_LIMITS -1.00000000E+037 1.00000000E+037 /end CHARACTERISTIC
/begin CHARACTERISTIC HLSDem_Gear5dnAccLim_C "Obere Grenze der zulässigen Beschleunigung der Motordrehzahl, geschlossene Kupplung (eingelegter Gang 5)" VALUE 0x8003C570 Val_Wr32 12000.0000 ISC_dnEng_float 0.00 12000.0000 FORMAT "%10.4" EXTENDED_LIMITS -1.00000000E+037 1.00000000E+037 /end CHARACTERISTIC
/begin CHARACTERISTIC HLSDem_Gear5dnDeclLimBrk_C "Untere Grenze der zulässigen Verzögerung der Motordrehzahl, geschlossene Kupplung (eingelegter Gang 5) und Bremse betätigt" VALUE 0x8003C574 Val_Wr32 12000.0000 ISC_dnEng_float -12000.0000 0.00 FORMAT "%10.4" EXTENDED_LIMITS -1.00000000E+037 1.00000000E+037 /end CHARACTERISTIC
/begin CHARACTERISTIC HLSDem_Gear5dnDeclLim_C "Untere Grenze der zulässigen Verzögerung der Motordrehzahl, geschlossene Kupplung (eingelegter Gang 5)" VALUE 0x8003C578 Val_Wr32 12000.0000 ISC_dnEng_float -12000.0000 0.00 FORMAT "%10.4" EXTENDED_LIMITS -1.00000000E+037 1.00000000E+037 /end CHARACTERISTIC
/begin CHARACTERISTIC HLSDem_Gear5InrtDrvTrn_C "Massenträgheitsmoment geschlossener Antriebstrang, Kalter Motor (eingelegter Gang 5)" VALUE 0x8003C57C Val_Wr32 20.0000000 ISC_Inirtia_float 0.00 20.0000000 FORMAT "%10.7" EXTENDED_LIMITS -1.00000000E+037 1.00000000E+037 /end CHARACTERISTIC
/begin CHARACTERISTIC HLSDem_Gear5InrtVeh_C "Massenträgheitsmoment gesamtes Fahrzeug, geschlossene Kupplung (eingelegter Gang 5)" VALUE 0x8003C580 Val_Wr32 20.0000000 ISC_Inirtia_float 0.00 20.0000000 FORMAT "%10.7" EXTENDED_LIMITS -1.00000000E+037 1.00000000E+037 /end CHARACTERISTIC
/begin CHARACTERISTIC HLSDem_Gear5PLo.Kp_C "P-Parametersatz unterer Drehmomentpfad, geschlossene Kupplung (eingelegter Gang 5)/Kleinsignal Verstärkungsfaktor (Kp)" VALUE 0x8003C584 Val_Wr32 20.0000000 ISC_Kp_rpm2Nm_float 0.00 20.0000000 FORMAT "%10.7" EXTENDED_LIMITS -1.00000000E+037 1.00000000E+037 /end CHARACTERISTIC
/begin CHARACTERISTIC HLSDem_Gear5PLo.KpPos_C "P-Parametersatz unterer Drehmomentpfad, geschlossene Kupplung (eingelegter Gang 5)/Großsignal Verstärkungsfaktor positiv (Kp)" VALUE 0x8003C588 Val_Wr32 20.0000000 ISC_Kp_rpm2Nm_float 0.00 20.0000000 FORMAT "%10.7" EXTENDED_LIMITS -1.00000000E+037 1.00000000E+037 /end CHARACTERISTIC
/begin CHARACTERISTIC HLSDem_Gear5PLo.KpNeg_C "P-Parametersatz unterer Drehmomentpfad, geschlossene Kupplung (eingelegter Gang 5)/Großsignal Verstärkungsfaktor negativ (Kp)" VALUE 0x8003C58C Val_Wr32 20.0000000 ISC_Kp_rpm2Nm_float 0.00 20.0000000 FORMAT "%10.7" EXTENDED_LIMITS -1.00000000E+037 1.00000000E+037 /end CHARACTERISTIC
/begin CHARACTERISTIC HLSDem_Gear5PLo.WinPos_C "P-Parametersatz unterer Drehmomentpfad, geschlossene Kupplung (eingelegter Gang 5)/Kleinsignal Fensterbreite positiv" VALUE 0x8003C590 Val_Wr32 20000.0000 EngN_float -10000.0000 10000.0000 EXTENDED_LIMITS -1.00000000E+037 1.00000000E+037 /end CHARACTERISTIC
/begin CHARACTERISTIC HLSDem_Gear5PLo.WinNeg_C "P-Parametersatz unterer Drehmomentpfad, geschlossene Kupplung (eingelegter Gang 5)/Kleinsignal Fensterbreite negativ" VALUE 0x8003C594 Val_Wr32 20000.0000 EngN_float -10000.0000 10000.0000 EXTENDED_LIMITS -1.00000000E+037 1.00000000E+037 /end CHARACTERISTIC
/begin CHARACTERISTIC HLSDem_Gear5rnEngvVeh_C "Verhältnis Motordrehzahl zu Fahrzeuggeschwindigkeit, geschlosse Kupplung(eingelegter Gang 5)" VALUE 0x8003C598 Val_Wr32 1000.00000 ISC_rnEng2vVeh_float 0.00 1000.00000 FORMAT "%10.5" EXTENDED_LIMITS -1.00000000E+037 1.00000000E+037 /end CHARACTERISTIC
/begin CHARACTERISTIC HLSDem_Gear5tiFltLosTrqEst_C "Zeitkonstante für die PT1-Glieder der Lastmomentabschätzung, geschlossene Kupplung (eingelegter Gang 5)" VALUE 0x8003C59C Val_Wr32 60.0000000 ISC_tiPTsTrqLoss_float 0.00 60.0000000 FORMAT "%10.7" EXTENDED_LIMITS -1.00000000E+037 1.00000000E+037 /end CHARACTERISTIC
/begin CHARACTERISTIC HLSDem_Gear5tiFltnEng_C "Zeitkonstante für die PT2-Filterung der Motordrehzahl, geschlossene Kupplung (eingelegter Gang 5)" VALUE 0x8003C5A0 Val_Wr32 60.0000000 ISC_tiPT2nEng_float 0.00 60.0000000 FORMAT "%10.7" EXTENDED_LIMITS -1.00000000E+037 1.00000000E+037 /end CHARACTERISTIC
/begin CHARACTERISTIC HLSDem_Gear6dnAccLim_C "Obere Grenze der zulässigen Beschleunigung der Motordrehzahl, geschlossene Kupplung (eingelegter Gang 6)" VALUE 0x8003C5A4 Val_Wr32 12000.0000 ISC_dnEng_float 0.00 12000.0000 FORMAT "%10.4" EXTENDED_LIMITS -1.00000000E+037 1.00000000E+037 /end CHARACTERISTIC
/begin CHARACTERISTIC HLSDem_Gear6dnDeclLimBrk_C "Untere Grenze der zulässigen Verzögerung der Motordrehzahl, geschlossene Kupplung (eingelegter Gang 6) und Bremse betätigt" VALUE 0x8003C5A8 Val_Wr32 12000.0000 ISC_dnEng_float -12000.0000 0.00 FORMAT "%10.4" EXTENDED_LIMITS -1.00000000E+037 1.00000000E+037 /end CHARACTERISTIC
/begin CHARACTERISTIC HLSDem_Gear6dnDeclLim_C "Untere Grenze der zulässigen Verzögerung der Motordrehzahl, geschlossene Kupplung (eingelegter Gang 6)" VALUE 0x8003C5AC Val_Wr32 12000.0000 ISC_dnEng_float -12000.0000 0.00 FORMAT "%10.4" EXTENDED_LIMITS -1.00000000E+037 1.00000000E+037 /end CHARACTERISTIC
/begin CHARACTERISTIC HLSDem_Gear6InrtDrvTrn_C "Massenträgheitsmoment geschlossener Antriebstrang, Kalter Motor (eingelegter Gang 6)" VALUE 0x8003C5B0 Val_Wr32 20.0000000 ISC_Inirtia_float 0.00 20.0000000 FORMAT "%10.7" EXTENDED_LIMITS -1.00000000E+037 1.00000000E+037 /end CHARACTERISTIC
/begin CHARACTERISTIC HLSDem_Gear6InrtVeh_C "Massenträgheitsmoment gesamtes Fahrzeug, geschlossene Kupplung (eingelegter Gang 6)" VALUE 0x8003C5B4 Val_Wr32 20.0000000 ISC_Inirtia_float 0.00 20.0000000 FORMAT "%10.7" EXTENDED_LIMITS -1.00000000E+037 1.00000000E+037 /end CHARACTERISTIC
/begin CHARACTERISTIC HLSDem_Gear6PLo.Kp_C "P-Parametersatz unterer Drehmomentpfad, geschlossene Kupplung (eingelegter Gang 6)/Kleinsignal Verstärkungsfaktor (Kp)" VALUE 0x8003C5B8 Val_Wr32 20.0000000 ISC_Kp_rpm2Nm_float 0.00 20.0000000 FORMAT "%10.7" EXTENDED_LIMITS -1.00000000E+037 1.00000000E+037 /end CHARACTERISTIC
/begin CHARACTERISTIC HLSDem_Gear6PLo.KpPos_C "P-Parametersatz unterer Drehmomentpfad, geschlossene Kupplung (eingelegter Gang 6)/Großsignal Verstärkungsfaktor positiv (Kp)" VALUE 0x8003C5BC Val_Wr32 20.0000000 ISC_Kp_rpm2Nm_float 0.00 20.0000000 FORMAT "%10.7" EXTENDED_LIMITS -1.00000000E+037 1.00000000E+037 /end CHARACTERISTIC
/begin CHARACTERISTIC HLSDem_Gear6PLo.KpNeg_C "P-Parametersatz unterer Drehmomentpfad, geschlossene Kupplung (eingelegter Gang 6)/Großsignal Verstärkungsfaktor negativ (Kp)" VALUE 0x8003C5C0 Val_Wr32 20.0000000 ISC_Kp_rpm2Nm_float 0.00 20.0000000 FORMAT "%10.7" EXTENDED_LIMITS -1.00000000E+037 1.00000000E+037 /end CHARACTERISTIC
/begin CHARACTERISTIC HLSDem_Gear6PLo.WinPos_C "P-Parametersatz unterer Drehmomentpfad, geschlossene Kupplung (eingelegter Gang 6)/Kleinsignal Fensterbreite positiv" VALUE 0x8003C5C4 Val_Wr32 20000.0000 EngN_float -10000.0000 10000.0000 EXTENDED_LIMITS -1.00000000E+037 1.00000000E+037 /end CHARACTERISTIC
/begin CHARACTERISTIC HLSDem_Gear6PLo.WinNeg_C "P-Parametersatz unterer Drehmomentpfad, geschlossene Kupplung (eingelegter Gang 6)/Kleinsignal Fensterbreite negativ" VALUE 0x8003C5C8 Val_Wr32 20000.0000 EngN_float -10000.0000 10000.0000 EXTENDED_LIMITS -1.00000000E+037 1.00000000E+037 /end CHARACTERISTIC
/begin CHARACTERISTIC HLSDem_Gear6rnEngvVeh_C "Verhältnis Motordrehzahl zu Fahrzeuggeschwindigkeit, geschlosse Kupplung(eingelegter Gang 6)" VALUE 0x8003C5CC Val_Wr32 1000.00000 ISC_rnEng2vVeh_float 0.00 1000.00000 FORMAT "%10.5" EXTENDED_LIMITS -1.00000000E+037 1.00000000E+037 /end CHARACTERISTIC
/begin CHARACTERISTIC HLSDem_Gear6tiFltLosTrqEst_C "Zeitkonstante für die PT1-Glieder der Lastmomentabschätzung, geschlossene Kupplung (eingelegter Gang 6)" VALUE 0x8003C5D0 Val_Wr32 60.0000000 ISC_tiPTsTrqLoss_float 0.00 60.0000000 FORMAT "%10.7" EXTENDED_LIMITS -1.00000000E+037 1.00000000E+037 /end CHARACTERISTIC
/begin CHARACTERISTIC HLSDem_Gear6tiFltnEng_C "Zeitkonstante für die PT2-Filterung der Motordrehzahl, geschlossene Kupplung (eingelegter Gang 6)" VALUE 0x8003C5D4 Val_Wr32 60.0000000 ISC_tiPT2nEng_float 0.00 60.0000000 FORMAT "%10.7" EXTENDED_LIMITS -1.00000000E+037 1.00000000E+037 /end CHARACTERISTIC
/begin CHARACTERISTIC HLSDem_Gear7dnAccLim_C "Obere Grenze der zulässigen Beschleunigung der Motordrehzahl, geschlossene Kupplung (eingelegter Gang 7)" VALUE 0x8003C5D8 Val_Wr32 12000.0000 ISC_dnEng_float 0.00 12000.0000 FORMAT "%10.4" EXTENDED_LIMITS -1.00000000E+037 1.00000000E+037 /end CHARACTERISTIC
/begin CHARACTERISTIC HLSDem_Gear7dnDeclLimBrk_C "Untere Grenze der zulässigen Verzögerung der Motordrehzahl, geschlossene Kupplung (eingelegter Gang 7) und Bremse betätigt" VALUE 0x8003C5DC Val_Wr32 12000.0000 ISC_dnEng_float -12000.0000 0.00 FORMAT "%10.4" EXTENDED_LIMITS -1.00000000E+037 1.00000000E+037 /end CHARACTERISTIC
/begin CHARACTERISTIC HLSDem_Gear7dnDeclLim_C "Untere Grenze der zulässigen Verzögerung der Motordrehzahl, geschlossene Kupplung (eingelegter Gang 7)" VALUE 0x8003C5E0 Val_Wr32 12000.0000 ISC_dnEng_float -12000.0000 0.00 FORMAT "%10.4" EXTENDED_LIMITS -1.00000000E+037 1.00000000E+037 /end CHARACTERISTIC
/begin CHARACTERISTIC HLSDem_Gear7InrtDrvTrn_C "Massenträgheitsmoment geschlossener Antriebstrang, Kalter Motor (eingelegter Gang 7)" VALUE 0x8003C5E4 Val_Wr32 20.0000000 ISC_Inirtia_float 0.00 20.0000000 FORMAT "%10.7" EXTENDED_LIMITS -1.00000000E+037 1.00000000E+037 /end CHARACTERISTIC
/begin CHARACTERISTIC HLSDem_Gear7InrtVeh_C "Massenträgheitsmoment gesamtes Fahrzeug, geschlossene Kupplung (eingelegter Gang 7)" VALUE 0x8003C5E8 Val_Wr32 20.0000000 ISC_Inirtia_float 0.00 20.0000000 FORMAT "%10.7" EXTENDED_LIMITS -1.00000000E+037 1.00000000E+037 /end CHARACTERISTIC
/begin CHARACTERISTIC HLSDem_Gear7PLo.Kp_C "P-Parametersatz unterer Drehmomentpfad, geschlossene Kupplung (eingelegter Gang 7)/Kleinsignal Verstärkungsfaktor (Kp)" VALUE 0x8003C5EC Val_Wr32 20.0000000 ISC_Kp_rpm2Nm_float 0.00 20.0000000 FORMAT "%10.7" EXTENDED_LIMITS -1.00000000E+037 1.00000000E+037 /end CHARACTERISTIC
/begin CHARACTERISTIC HLSDem_Gear7PLo.KpPos_C "P-Parametersatz unterer Drehmomentpfad, geschlossene Kupplung (eingelegter Gang 7)/Großsignal Verstärkungsfaktor positiv (Kp)" VALUE 0x8003C5F0 Val_Wr32 20.0000000 ISC_Kp_rpm2Nm_float 0.00 20.0000000 FORMAT "%10.7" EXTENDED_LIMITS -1.00000000E+037 1.00000000E+037 /end CHARACTERISTIC
/begin CHARACTERISTIC HLSDem_Gear7PLo.KpNeg_C "P-Parametersatz unterer Drehmomentpfad, geschlossene Kupplung (eingelegter Gang 7)/Großsignal Verstärkungsfaktor negativ (Kp)" VALUE 0x8003C5F4 Val_Wr32 20.0000000 ISC_Kp_rpm2Nm_float 0.00 20.0000000 FORMAT "%10.7" EXTENDED_LIMITS -1.00000000E+037 1.00000000E+037 /end CHARACTERISTIC
/begin CHARACTERISTIC HLSDem_Gear7PLo.WinPos_C "P-Parametersatz unterer Drehmomentpfad, geschlossene Kupplung (eingelegter Gang 7)/Kleinsignal Fensterbreite positiv" VALUE 0x8003C5F8 Val_Wr32 20000.0000 EngN_float -10000.0000 10000.0000 EXTENDED_LIMITS -1.00000000E+037 1.00000000E+037 /end CHARACTERISTIC
/begin CHARACTERISTIC HLSDem_Gear7PLo.WinNeg_C "P-Parametersatz unterer Drehmomentpfad, geschlossene Kupplung (eingelegter Gang 7)/Kleinsignal Fensterbreite negativ" VALUE 0x8003C5FC Val_Wr32 20000.0000 EngN_float -10000.0000 10000.0000 EXTENDED_LIMITS -1.00000000E+037 1.00000000E+037 /end CHARACTERISTIC
/begin CHARACTERISTIC HLSDem_Gear7rnEngvVeh_C "Verhältnis Motordrehzahl zu Fahrzeuggeschwindigkeit, geschlosse Kupplung(eingelegter Gang 6)" VALUE 0x8003C600 Val_Wr32 1000.00000 ISC_rnEng2vVeh_float 0.00 1000.00000 FORMAT "%10.5" EXTENDED_LIMITS -1.00000000E+037 1.00000000E+037 /end CHARACTERISTIC
/begin CHARACTERISTIC HLSDem_Gear7tiFltLosTrqEst_C "Zeitkonstante für die PT1-Glieder der Lastmomentabschätzung, geschlossene Kupplung (eingelegter Gang 7)" VALUE 0x8003C604 Val_Wr32 60.0000000 ISC_tiPTsTrqLoss_float 0.00 60.0000000 FORMAT "%10.7" EXTENDED_LIMITS -1.00000000E+037 1.00000000E+037 /end CHARACTERISTIC
/begin CHARACTERISTIC HLSDem_Gear7tiFltnEng_C "Zeitkonstante für die PT2-Filterung der Motordrehzahl, geschlossene Kupplung (eingelegter Gang 7)" VALUE 0x8003C608 Val_Wr32 60.0000000 ISC_tiPT2nEng_float 0.00 60.0000000 FORMAT "%10.7" EXTENDED_LIMITS -1.00000000E+037 1.00000000E+037 /end CHARACTERISTIC
/begin CHARACTERISTIC HLSDem_GearILo.Ki_C "I-Parametersatz unterer Drehmomentpfad, geschlossene Kupplung/Kleinsignal Verstärkungsfaktor (Ki)" VALUE 0x8003C60C Val_Wr32 20.0000000 ISC_Ki_rpm2Nm_float 0.00 20.0000000 FORMAT "%10.7" EXTENDED_LIMITS -1.00000000E+037 1.00000000E+037 /end CHARACTERISTIC
/begin CHARACTERISTIC HLSDem_GearILo.KiPos_C "I-Parametersatz unterer Drehmomentpfad, geschlossene Kupplung/Großsignal Verstärkungsfaktor positiv (Ki)" VALUE 0x8003C610 Val_Wr32 20.0000000 ISC_Ki_rpm2Nm_float 0.00 20.0000000 FORMAT "%10.7" EXTENDED_LIMITS -1.00000000E+037 1.00000000E+037 /end CHARACTERISTIC
/begin CHARACTERISTIC HLSDem_GearILo.KiNeg_C "I-Parametersatz unterer Drehmomentpfad, geschlossene Kupplung/Großsignal Verstärkungsfaktor negativ (Ki)" VALUE 0x8003C614 Val_Wr32 20.0000000 ISC_Ki_rpm2Nm_float 0.00 20.0000000 FORMAT "%10.7" EXTENDED_LIMITS -1.00000000E+037 1.00000000E+037 /end CHARACTERISTIC
/begin CHARACTERISTIC HLSDem_GearILo.WinPos_C "I-Parametersatz unterer Drehmomentpfad, geschlossene Kupplung/Kleinsignal Fensterbreite positiv" VALUE 0x8003C618 Val_Wr32 20000.0000 EngN_float -10000.0000 10000.0000 EXTENDED_LIMITS -1.00000000E+037 1.00000000E+037 /end CHARACTERISTIC
/begin CHARACTERISTIC HLSDem_GearILo.WinNeg_C "I-Parametersatz unterer Drehmomentpfad, geschlossene Kupplung/Kleinsignal Fensterbreite negativ" VALUE 0x8003C61C Val_Wr32 20000.0000 EngN_float -10000.0000 10000.0000 EXTENDED_LIMITS -1.00000000E+037 1.00000000E+037 /end CHARACTERISTIC
/begin CHARACTERISTIC HLSDem_InrtEng_C "Massenträgheitsmoment des Motors" VALUE 0x8003C620 Val_Wr32 20.0000000 ISC_Inirtia_float 0.00 20.0000000 FORMAT "%10.7" EXTENDED_LIMITS -1.00000000E+037 1.00000000E+037 /end CHARACTERISTIC
/begin CHARACTERISTIC HLSDem_nDeltaSec_C "Dreieck-Motordrehzahl" VALUE 0x8003C6BC Kw_Ws16 16383.50 EngN 0.00 16383.50 EXTENDED_LIMITS -16384.00 16383.50 /end CHARACTERISTIC
/begin CHARACTERISTIC HLSDem_nDiffDelta_C "Motordrehzahl-Unterschied" VALUE 0x8003C6BE Kw_Ws16 16383.50 EngN 0.00 16383.50 EXTENDED_LIMITS -16384.00 16383.50 /end CHARACTERISTIC
/begin CHARACTERISTIC HLSDem_nHDC_C "Motordrehzahl für HDC" VALUE 0x8003C6C0 Kw_Ws16 16383.50 EngN 0.00 16383.50 EXTENDED_LIMITS -16384.00 16383.50 /end CHARACTERISTIC
/begin CHARACTERISTIC HLSDem_nLimHiOfs_C "Motordrehzahl hoch Ausgleich" VALUE 0x8003C6C2 Kw_Ws16 32767.50 EngN -16384.00 16383.50 /end CHARACTERISTIC
/begin CHARACTERISTIC HLSDem_nLimHi_C "Motordrehzahl-Schwelle" VALUE 0x8003C6C4 Kw_Ws16 32767.50 EngN -16384.00 16383.50 /end CHARACTERISTIC
/begin CHARACTERISTIC HLSDem_nLLOfsNeg_C "Negativ offset für HLSDem leerlaufdrehzahl" VALUE 0x8003C6C6 Kw_Ws16 9980.000 EngN 20.00000 10000.00 EXTENDED_LIMITS -16384.00 16383.50 /end CHARACTERISTIC
/begin CHARACTERISTIC HLSDem_nLLOfsPos_C "offset für HLSDem leerlaufdrehzahl" VALUE 0x8003C6C8 Kw_Ws16 9980.000 EngN 20.00000 10000.00 EXTENDED_LIMITS -16384.00 16383.50 /end CHARACTERISTIC
/begin CHARACTERISTIC HLSDem_nOfsUndrBrk_C "Drehzahloffset für die Erkennung des HLSDem-Zustand ""Unterbremsen""" VALUE 0x8003C624 Val_Ws16 10000.00 EngN 0.00 10000.00 EXTENDED_LIMITS -16384.00 16383.50 /end CHARACTERISTIC
/begin CHARACTERISTIC HLSDem_nRmpBaseDwn_C "negativ Rampensteigung" VALUE 0x8003C6CA Kw_Ws16 16383.50 dn_dZfine 0.00 16383.50 FORMAT "%8.2" EXTENDED_LIMITS -16384.00 16383.50 /end CHARACTERISTIC
/begin CHARACTERISTIC HLSDem_nRmpBaseUp_C "positiv Rampensteigung" VALUE 0x8003C6CC Kw_Ws16 16383.50 dn_dZfine 0.00 16383.50 FORMAT "%8.2" EXTENDED_LIMITS -16384.00 16383.50 /end CHARACTERISTIC
/begin CHARACTERISTIC HLSDem_nRmpChrgPmpDwn_C "" VALUE 0x8003C6CE Kw_Ws16 16383.50 dn_dZfine 0.00 16383.50 FORMAT "%8.2" EXTENDED_LIMITS -16384.00 16383.50 /end CHARACTERISTIC
/begin CHARACTERISTIC HLSDem_nRmpChrgPmpUp_C "" VALUE 0x8003C6D0 Kw_Ws16 16383.50 dn_dZfine 0.00 16383.50 FORMAT "%8.2" EXTENDED_LIMITS -16384.00 16383.50 /end CHARACTERISTIC
/begin CHARACTERISTIC HLSDem_nRmpCoEngDwn_C "negativ Rampensteigung" VALUE 0x8003C6D2 Kw_Ws16 16383.50 dn_dZfine 0.00 16383.50 FORMAT "%8.2" EXTENDED_LIMITS -16384.00 16383.50 /end CHARACTERISTIC
/begin CHARACTERISTIC HLSDem_nRmpCoEngUp_C "positiv Rampensteigung" VALUE 0x8003C6D4 Kw_Ws16 16383.50 dn_dZfine 0.00 16383.50 FORMAT "%8.2" EXTENDED_LIMITS -16384.00 16383.50 /end CHARACTERISTIC
/begin CHARACTERISTIC HLSDem_nRmpHDCDwn_C "negativ Rampensteigung" VALUE 0x8003C6D6 Kw_Ws16 16383.50 dn_dZfine 0.00 16383.50 FORMAT "%8.2" EXTENDED_LIMITS -16384.00 16383.50 /end CHARACTERISTIC
/begin CHARACTERISTIC HLSDem_nRmpHDCUp_C "positiv Rampensteigung" VALUE 0x8003C6D8 Kw_Ws16 16383.50 dn_dZfine 0.00 16383.50 FORMAT "%8.2" EXTENDED_LIMITS -16384.00 16383.50 /end CHARACTERISTIC
/begin CHARACTERISTIC HLSDem_nRmpPwrMngDwn_C "negativ Rampensteigung" VALUE 0x8003C6DA Kw_Ws16 16383.50 dn_dZfine 0.00 16383.50 FORMAT "%8.2" EXTENDED_LIMITS -16384.00 16383.50 /end CHARACTERISTIC
/begin CHARACTERISTIC HLSDem_nRmpPwrMngUp_C "positiv Rampensteigung" VALUE 0x8003C6DC Kw_Ws16 16383.50 dn_dZfine 0.00 16383.50 FORMAT "%8.2" EXTENDED_LIMITS -16384.00 16383.50 /end CHARACTERISTIC
/begin CHARACTERISTIC HLSDem_nRmpSecDelta_C "Leerlaufdrehzahl" VALUE 0x8003C6DE Kw_Ws16 16383.50 dn_dZfine 0.00 16383.50 FORMAT "%8.2" EXTENDED_LIMITS -16384.00 16383.50 /end CHARACTERISTIC
/begin CHARACTERISTIC HLSDem_nRmpTraDwn_C "Negativ Rampensteigung" VALUE 0x8003C6E0 Kw_Ws16 1800.000 dn_dZfine 700.0000 2500.000 FORMAT "%8.3" EXTENDED_LIMITS -16384.00 16383.50 /end CHARACTERISTIC
/begin CHARACTERISTIC HLSDem_nRmpTraUp_C "Positiv Rampensteigung" VALUE 0x8003C6E2 Kw_Ws16 16383.50 dn_dZfine 0.00 16383.50 FORMAT "%8.2" EXTENDED_LIMITS -16384.00 16383.50 /end CHARACTERISTIC
/begin CHARACTERISTIC HLSDem_nSetPHi_MAP "Kennfeld für die Höchstdrehzahl" MAP 0x8003C6E4 Map_Xs16Ys16Ws16 10000.00 EngN 0.00 10000.00 EXTENDED_LIMITS -16384.00 16383.50
 /begin AXIS_DESCR STD_AXIS PT_rTrq TransR 8 -327.6800 327.6700 DEPOSIT ABSOLUTE /end AXIS_DESCR
 /begin AXIS_DESCR STD_AXIS HLSDem_tSetPHi_mp Temp_Cels 8 -3549.940 3003.560 DEPOSIT ABSOLUTE /end AXIS_DESCR
/end CHARACTERISTIC
/begin CHARACTERISTIC HLSDem_nSetPLoDia_C "unterer Solldrehzahlwert des HLSDem über Diagnoseschnittstelle" VALUE 0x8003C788 Kw_Ws16 32767.50 EngN -16384.00 16383.50 /end CHARACTERISTIC
/begin CHARACTERISTIC HLSDem_nSetPLoDrvAwy_C "untere Leerlaufsolldrehzahl für Fahrzeug fährt (Veh_v > 0)" VALUE 0x8003C78A Kw_Ws16 32767.50 EngN -16384.00 16383.50 /end CHARACTERISTIC
/begin CHARACTERISTIC HLSDem_nSetPLoInit2_MAP "Kennfeld zur Anhebung der Leerlaufdrehzahl des Motors" MAP 0x8003C78C Kf_Xs16_Ys16_Ws16 6000.000 EngN 0.00 6000.000 EXTENDED_LIMITS -16384.00 16383.50
 /begin AXIS_DESCR STD_AXIS CEngDsT_t Temp_Cels 8 -273.1400 149.8600 EXTENDED_LIMITS -3549.940 3003.560 DEPOSIT ABSOLUTE /end AXIS_DESCR
 /begin AXIS_DESCR STD_AXIS EnvP_p Pres_hPa 8 0.00 3500.0000 EXTENDED_LIMITS -32768.00 32767.00 DEPOSIT ABSOLUTE /end AXIS_DESCR
/end CHARACTERISTIC
/begin CHARACTERISTIC HLSDem_nSetPLoInit_MAP "Kennfeld zur Anhebung der Leerlaufdrehzahl des Motors" MAP 0x8003C830 Kf_Xs16_Ys16_Ws16 6000.000 EngN 0.00 6000.000 EXTENDED_LIMITS -16384.00 16383.50
 /begin AXIS_DESCR STD_AXIS CEngDsT_t Temp_Cels 8 -273.1400 149.8600 EXTENDED_LIMITS -3549.940 3003.560 DEPOSIT ABSOLUTE /end AXIS_DESCR
 /begin AXIS_DESCR STD_AXIS EnvP_p Pres_hPa 8 0.00 3500.0000 EXTENDED_LIMITS -32768.00 32767.00 DEPOSIT ABSOLUTE /end AXIS_DESCR
/end CHARACTERISTIC
/begin CHARACTERISTIC HLSDem_nSetPLoTrm_C "Leerlaufdrehzahl" VALUE 0x8003C8D4 Kw_Ws16 32767.50 EngN -16384.00 16383.50 /end CHARACTERISTIC
/begin CHARACTERISTIC HLSDem_nSetPLoWrm_C "untere Leerlaufsolldrehzahl für Fahrzeug steht / warmer Motor" VALUE 0x8003C8D6 Kw_Ws16 32767.50 EngN -16384.00 16383.50 /end CHARACTERISTIC
/begin CHARACTERISTIC HLSDem_numCfgISC_C "Konfiguration der 1) Aufschaltstrategie des ISC-Pfads 2) Initialisierunganforderung bei Sollwertänderung" VALUE 0x8003C626 Val_Wu8 3.000 OneToOne 0.00 3.000 EXTENDED_LIMITS 0.00 255.0 /end CHARACTERISTIC
/begin CHARACTERISTIC HLSDem_numTempSetPHi_C "Temperaturauswahl für die Berechnung der oberen Motorhöchstdrehzahl" VALUE 0x8003C8D8 Val_Wu8 3.00000000000 EngTempFldSel 0.00 3.00000000000 FORMAT "%13.11" /end CHARACTERISTIC
/begin CHARACTERISTIC HLSDem_numTempTrqReqStrt_C "Temperaturauswahl für die Berechnung des Startdrehmoments am Ausgang des Drehzahlregler" VALUE 0x8003C8D9 Val_Wu8 3.00000000000 EngTempFldSel 0.00 3.00000000000 FORMAT "%13.11" /end CHARACTERISTIC
/begin CHARACTERISTIC HLSDem_numTemp_C "Temperaturauswahl für die Ermittlung vom Motorzustand ""warm/kalt""" VALUE 0x8003C627 Val_Wu8 3.00000000000 EngTempFldSel 0.00 3.00000000000 FORMAT "%13.11" /end CHARACTERISTIC
/begin CHARACTERISTIC HLSDem_rAppMax_C "Maximal PWG wert" VALUE 0x8003C8DA Val_Ws16 100.0000 Prc 0.00 100.0000 EXTENDED_LIMITS -400.0000 399.9878 /end CHARACTERISTIC
/begin CHARACTERISTIC HLSDem_RmpCutOut.SlopePos_C "/Positive Rampenschrittweite" VALUE 0x8003C8DC Val_Ws32 10000.0000000 RmpEngN 0.00 10000.0000000 FORMAT "%13.7" EXTENDED_LIMITS -16384000.0000 16383999.9924 /end CHARACTERISTIC
/begin CHARACTERISTIC HLSDem_RmpCutOut.SlopeNeg_C "/Negative Rampenschrittweite" VALUE 0x8003C8E0 Val_Ws32 10000.0000000 RmpEngN 0.00 10000.0000000 FORMAT "%13.7" EXTENDED_LIMITS -16384000.0000 16383999.9924 /end CHARACTERISTIC
/begin CHARACTERISTIC HLSDem_SetPHiRmp.SlopePos_C "Rampenschrittweite der oberen Maximaldrehzahl/Positive Rampenschrittweite" VALUE 0x8003C8E4 Val_Ws32 10000.0000000 RmpEngN 0.00 10000.0000000 FORMAT "%13.7" EXTENDED_LIMITS -16384000.0000 16383999.9924 /end CHARACTERISTIC
/begin CHARACTERISTIC HLSDem_SetPHiRmp.SlopeNeg_C "Rampenschrittweite der oberen Maximaldrehzahl/Negative Rampenschrittweite" VALUE 0x8003C8E8 Val_Ws32 10000.0000000 RmpEngN 0.00 10000.0000000 FORMAT "%13.7" EXTENDED_LIMITS -16384000.0000 16383999.9924 /end CHARACTERISTIC
/begin CHARACTERISTIC HLSDem_stActvHDC_C "Status HDC aktiv" VALUE 0x8003C8EC Kw_Wu8 3.000 OneToOne 0.00 3.000 EXTENDED_LIMITS 0.00 255.0 /end CHARACTERISTIC
/begin CHARACTERISTIC HLSDem_stMskTrqConv_C "Bitleiste, in welchem Kupplungszustand bei Automatfahrzeugen das Wandleraufnahmedrehmoment verwendet wird (Bit0 P/N, Bit1 offen, Bit2 geregelt, Bit3 geschlossen)" VALUE 0x8003C628 Val_Wu8 15.00 OneToOne 0.00 15.00 EXTENDED_LIMITS 0.00 255.0 /end CHARACTERISTIC
/begin CHARACTERISTIC HLSDem_stParSetRevGear_C "wählt Parametersatz für den Rückwärtsgang (1 = Parametersatz Gang 1, 2 = Parametersatz Gang 2)" VALUE 0x8003C62A Val_Ws16 1.000000 OneToOne 1.000000 2.000000 EXTENDED_LIMITS -32768.00 32767.00 /end CHARACTERISTIC
/begin CHARACTERISTIC HLSDem_stRlsHDC_C "Status der HDC-Befreiung(HDC-Freigabe)" VALUE 0x8003C8ED Kw_Wu8 127.0 OneToOne 0.00 127.0 EXTENDED_LIMITS 0.00 255.0 /end CHARACTERISTIC
/begin CHARACTERISTIC HLSDem_swtDisblVehIfc_C "Schalter zur Abschaltung" VALUE 0x8003C8EE Val_Ws16 65535.00 OneToOne -32768.00 32767.00 /end CHARACTERISTIC
/begin CHARACTERISTIC HLSDem_swtGear_C "Gang-Schalter" VALUE 0x8003C8F0 Kw_Wu8 255.0 OneToOne 0.00 255.0 /end CHARACTERISTIC
/begin CHARACTERISTIC HLSDem_tiDelayStEng_C "Delayzeit" VALUE 0x8003C8F2 Kw_Wu16 327460.0 Time_ms 0.00 327460.0 EXTENDED_LIMITS 0.00 655350.0 /end CHARACTERISTIC
/begin CHARACTERISTIC HLSDem_tiDelCutOut_C "Verzögerungszeit" VALUE 0x8003C8F4 Kw_Wu16 2000.000 Time_ms 0.00 2000.000 EXTENDED_LIMITS 0.00 655350.0 /end CHARACTERISTIC
/begin CHARACTERISTIC HLSDem_tiTW_C "Zeit nach Start für T_W-abh. LL-Solldrehzahl" VALUE 0x8003C8F6 Kw_Wu16 655.3500 Time_s 0.00 655.3500 /end CHARACTERISTIC
/begin CHARACTERISTIC HLSDem_TrqConvdnAccLim_C "" VALUE 0x8003C62C Val_Wr32 12000.0000 ISC_dnEng_float 0.00 12000.0000 FORMAT "%10.4" EXTENDED_LIMITS -1.00000000E+037 1.00000000E+037 /end CHARACTERISTIC
/begin CHARACTERISTIC HLSDem_TrqConvdnDeclLimBrk_C "" VALUE 0x8003C630 Val_Wr32 12000.0000 ISC_dnEng_float -12000.0000 0.00 FORMAT "%10.4" EXTENDED_LIMITS -1.00000000E+037 1.00000000E+037 /end CHARACTERISTIC
/begin CHARACTERISTIC HLSDem_TrqConvdnDeclLim_C "" VALUE 0x8003C634 Val_Wr32 12000.0000 ISC_dnEng_float -12000.0000 0.00 FORMAT "%10.4" EXTENDED_LIMITS -1.00000000E+037 1.00000000E+037 /end CHARACTERISTIC
/begin CHARACTERISTIC HLSDem_TrqConvPLo.Kp_C "P-Anteil unterer Pfad, Zustand ""Wandlerkennfeld""/Kleinsignal Verstärkungsfaktor (Kp)" VALUE 0x8003C638 Val_Wr32 20.0000000 ISC_Kp_rpm2Nm_float 0.00 20.0000000 FORMAT "%10.7" EXTENDED_LIMITS -1.00000000E+037 1.00000000E+037 /end CHARACTERISTIC
/begin CHARACTERISTIC HLSDem_TrqConvPLo.KpPos_C "P-Anteil unterer Pfad, Zustand ""Wandlerkennfeld""/Großsignal Verstärkungsfaktor positiv (Kp)" VALUE 0x8003C63C Val_Wr32 20.0000000 ISC_Kp_rpm2Nm_float 0.00 20.0000000 FORMAT "%10.7" EXTENDED_LIMITS -1.00000000E+037 1.00000000E+037 /end CHARACTERISTIC
/begin CHARACTERISTIC HLSDem_TrqConvPLo.KpNeg_C "P-Anteil unterer Pfad, Zustand ""Wandlerkennfeld""/Großsignal Verstärkungsfaktor negativ (Kp)" VALUE 0x8003C640 Val_Wr32 20.0000000 ISC_Kp_rpm2Nm_float 0.00 20.0000000 FORMAT "%10.7" EXTENDED_LIMITS -1.00000000E+037 1.00000000E+037 /end CHARACTERISTIC
/begin CHARACTERISTIC HLSDem_TrqConvPLo.WinPos_C "P-Anteil unterer Pfad, Zustand ""Wandlerkennfeld""/Kleinsignal Fensterbreite positiv" VALUE 0x8003C644 Val_Wr32 20000.0000 EngN_float -10000.0000 10000.0000 EXTENDED_LIMITS -1.00000000E+037 1.00000000E+037 /end CHARACTERISTIC
/begin CHARACTERISTIC HLSDem_TrqConvPLo.WinNeg_C "P-Anteil unterer Pfad, Zustand ""Wandlerkennfeld""/Kleinsignal Fensterbreite negativ" VALUE 0x8003C648 Val_Wr32 20000.0000 EngN_float -10000.0000 10000.0000 EXTENDED_LIMITS -1.00000000E+037 1.00000000E+037 /end CHARACTERISTIC
/begin CHARACTERISTIC HLSDem_TrqConvtiFltLosTrqEst_C "Zeitkonstante für die PT1-Glieder der Lastmomentabschätzung, Benutzung des Wandler Aufnahmedrehmomentes" VALUE 0x8003C64C Val_Wr32 60.0000000 ISC_tiPTsTrqLoss_float 0.00 60.0000000 FORMAT "%10.7" EXTENDED_LIMITS -1.00000000E+037 1.00000000E+037 /end CHARACTERISTIC
/begin CHARACTERISTIC HLSDem_TrqConvtiFltnEng_C "Zeitkonstante für die PT2-Filterung der Motordrehzahl, Benutzung des Wandler Aufnahmedrehmomentes" VALUE 0x8003C650 Val_Wr32 60.0000000 ISC_tiPT2nEng_float 0.00 60.0000000 FORMAT "%10.7" EXTENDED_LIMITS -1.00000000E+037 1.00000000E+037 /end CHARACTERISTIC
/begin CHARACTERISTIC HLSDem_trqReqStrtMSA_MAP "" MAP 0x8003C8F8 Kf_Xs16_Ys16_Ws16 400.0000 Trq 0.00 400.0000 EXTENDED_LIMITS -3276.800 3276.700
 /begin AXIS_DESCR STD_AXIS HLSDem_tTrqReqStrt_mp Temp_Cels 8 -273.1400 199.9600 EXTENDED_LIMITS -3549.940 3003.560 DEPOSIT ABSOLUTE /end AXIS_DESCR
 /begin AXIS_DESCR STD_AXIS EnvP_p Pres_hPa 8 0.00 3500.000 EXTENDED_LIMITS -32768.00 32767.00 DEPOSIT ABSOLUTE /end AXIS_DESCR
/end CHARACTERISTIC
/begin CHARACTERISTIC HLSDem_trqReqStrt_MAP "Kennfeld zur Bestimmung des Initialisierungsstartmoments HLSDem_trqReqStrt" MAP 0x8003C99C Kf_Xs16_Ys16_Ws16 400.0000 Trq 0.00 400.0000 EXTENDED_LIMITS -3276.800 3276.700
 /begin AXIS_DESCR STD_AXIS HLSDem_tTrqReqStrt_mp Temp_Cels 8 -273.1400 199.9600 EXTENDED_LIMITS -3549.940 3003.560 DEPOSIT ABSOLUTE /end AXIS_DESCR
 /begin AXIS_DESCR STD_AXIS EnvP_p Pres_hPa 8 0.00 3500.000 EXTENDED_LIMITS -32768.00 32767.00 DEPOSIT ABSOLUTE /end AXIS_DESCR
/end CHARACTERISTIC
/begin CHARACTERISTIC HLSDem_tTempHysHi_C "obere Temperaturschwelle für die Hysterese zur Zustandsbestimmung ""warm/kalt""" VALUE 0x8003C654 Val_Ws16 200.0000 Temp_Cels -50.14000 149.8600 EXTENDED_LIMITS -3549.940 3003.560 /end CHARACTERISTIC
/begin CHARACTERISTIC HLSDem_tTempHysLo_C "untere Temperaturschwelle für die Hysterese zur Zustandsbestimmung ""warm/kalt""" VALUE 0x8003C656 Val_Ws16 200.0000 Temp_Cels -50.14000 149.8600 EXTENDED_LIMITS -3549.940 3003.560 /end CHARACTERISTIC
/begin CHARACTERISTIC HLSDem_UndrBrkPLo.Kp_C "P-Parametersatz unterer Drehmomentpfad, Zustand ""Unterbremsen""/Kleinsignal Verstärkungsfaktor (Kp)" VALUE 0x8003C658 Val_Wr32 20.0000000 ISC_Kp_rpm2Nm_float 0.00 20.0000000 FORMAT "%10.7" EXTENDED_LIMITS -1.00000000E+037 1.00000000E+037 /end CHARACTERISTIC
/begin CHARACTERISTIC HLSDem_UndrBrkPLo.KpPos_C "P-Parametersatz unterer Drehmomentpfad, Zustand ""Unterbremsen""/Großsignal Verstärkungsfaktor positiv (Kp)" VALUE 0x8003C65C Val_Wr32 20.0000000 ISC_Kp_rpm2Nm_float 0.00 20.0000000 FORMAT "%10.7" EXTENDED_LIMITS -1.00000000E+037 1.00000000E+037 /end CHARACTERISTIC
/begin CHARACTERISTIC HLSDem_UndrBrkPLo.KpNeg_C "P-Parametersatz unterer Drehmomentpfad, Zustand ""Unterbremsen""/Großsignal Verstärkungsfaktor negativ (Kp)" VALUE 0x8003C660 Val_Wr32 20.0000000 ISC_Kp_rpm2Nm_float 0.00 20.0000000 FORMAT "%10.7" EXTENDED_LIMITS -1.00000000E+037 1.00000000E+037 /end CHARACTERISTIC
/begin CHARACTERISTIC HLSDem_UndrBrkPLo.WinPos_C "P-Parametersatz unterer Drehmomentpfad, Zustand ""Unterbremsen""/Kleinsignal Fensterbreite positiv" VALUE 0x8003C664 Val_Wr32 20000.0000 EngN_float -10000.0000 10000.0000 EXTENDED_LIMITS -1.00000000E+037 1.00000000E+037 /end CHARACTERISTIC
/begin CHARACTERISTIC HLSDem_UndrBrkPLo.WinNeg_C "P-Parametersatz unterer Drehmomentpfad, Zustand ""Unterbremsen""/Kleinsignal Fensterbreite negativ" VALUE 0x8003C668 Val_Wr32 20000.0000 EngN_float -10000.0000 10000.0000 EXTENDED_LIMITS -1.00000000E+037 1.00000000E+037 /end CHARACTERISTIC
/begin CHARACTERISTIC HLSDem_vThresUndrBrk_C "Schwellgeschwindigkeit für HLSDem Zustand ""Unterbremsen""" VALUE 0x8003C66C Val_Ws16 327.6700 Vel 0.00 327.6700 EXTENDED_LIMITS -327.6800 327.6700 /end CHARACTERISTIC
/begin CHARACTERISTIC HLSDem_WrmClthdnAccLim_C "Obere Grenze der zulässigen Beschleunigung der Motordrehzahl, warmer Motor, offene Kupplung" VALUE 0x8003C670 Val_Wr32 12000.0000 ISC_dnEng_float 0.00 12000.0000 FORMAT "%10.4" EXTENDED_LIMITS -1.00000000E+037 1.00000000E+037 /end CHARACTERISTIC
/begin CHARACTERISTIC HLSDem_WrmClthdnDeclLimBrk_C "Untere Grenze der zulässigen Verzögerung der Motordrehzahl, warmer Motor, Kupplung offene und Bremse betätigt" VALUE 0x8003C674 Val_Wr32 12000.0000 ISC_dnEng_float -12000.0000 0.00 FORMAT "%10.4" EXTENDED_LIMITS -1.00000000E+037 1.00000000E+037 /end CHARACTERISTIC
/begin CHARACTERISTIC HLSDem_WrmClthdnDeclLim_C "Untere Grenze der zulässigen Verzögerung der Motordrehzahl, warmer Motor, offene Kupplung" VALUE 0x8003C678 Val_Wr32 12000.0000 ISC_dnEng_float -12000.0000 0.00 FORMAT "%10.4" EXTENDED_LIMITS -1.00000000E+037 1.00000000E+037 /end CHARACTERISTIC
/begin CHARACTERISTIC HLSDem_WrmClthILo.Ki_C "I-Parametersatz unterer Drehmomentpfad, warmer Motor und geöffnete Kupplung/Kleinsignal Verstärkungsfaktor (Ki)" VALUE 0x8003C67C Val_Wr32 20.0000000 ISC_Ki_rpm2Nm_float 0.00 20.0000000 FORMAT "%10.7" EXTENDED_LIMITS -1.00000000E+037 1.00000000E+037 /end CHARACTERISTIC
/begin CHARACTERISTIC HLSDem_WrmClthILo.KiPos_C "I-Parametersatz unterer Drehmomentpfad, warmer Motor und geöffnete Kupplung/Großsignal Verstärkungsfaktor positiv (Ki)" VALUE 0x8003C680 Val_Wr32 20.0000000 ISC_Ki_rpm2Nm_float 0.00 20.0000000 FORMAT "%10.7" EXTENDED_LIMITS -1.00000000E+037 1.00000000E+037 /end CHARACTERISTIC
/begin CHARACTERISTIC HLSDem_WrmClthILo.KiNeg_C "I-Parametersatz unterer Drehmomentpfad, warmer Motor und geöffnete Kupplung/Großsignal Verstärkungsfaktor negativ (Ki)" VALUE 0x8003C684 Val_Wr32 20.0000000 ISC_Ki_rpm2Nm_float 0.00 20.0000000 FORMAT "%10.7" EXTENDED_LIMITS -1.00000000E+037 1.00000000E+037 /end CHARACTERISTIC
/begin CHARACTERISTIC HLSDem_WrmClthILo.WinPos_C "I-Parametersatz unterer Drehmomentpfad, warmer Motor und geöffnete Kupplung/Kleinsignal Fensterbreite positiv" VALUE 0x8003C688 Val_Wr32 20000.0000 EngN_float -10000.0000 10000.0000 EXTENDED_LIMITS -1.00000000E+037 1.00000000E+037 /end CHARACTERISTIC
/begin CHARACTERISTIC HLSDem_WrmClthILo.WinNeg_C "I-Parametersatz unterer Drehmomentpfad, warmer Motor und geöffnete Kupplung/Kleinsignal Fensterbreite negativ" VALUE 0x8003C68C Val_Wr32 20000.0000 EngN_float -10000.0000 10000.0000 EXTENDED_LIMITS -1.00000000E+037 1.00000000E+037 /end CHARACTERISTIC
/begin CHARACTERISTIC HLSDem_WrmClthInrtDrvTrn_C "Massenträgheitsmoment offener Antriebstrang" VALUE 0x8003C690 Val_Wr32 20.0000000 ISC_Inirtia_float 0.00 20.0000000 FORMAT "%10.7" EXTENDED_LIMITS -1.00000000E+037 1.00000000E+037 /end CHARACTERISTIC
/begin CHARACTERISTIC HLSDem_WrmClthInrtVeh_C "Massenträgheitsmoment offener Antriebstrang, warmer Motor" VALUE 0x8003C694 Val_Wr32 20.0000000 ISC_Inirtia_float 0.00 20.0000000 FORMAT "%10.7" EXTENDED_LIMITS -1.00000000E+037 1.00000000E+037 /end CHARACTERISTIC
/begin CHARACTERISTIC HLSDem_WrmClthPLo.Kp_C "P-Parametersatz unterer Drehmomentpfad, warmer Motor und geöffnete Kupplung/Kleinsignal Verstärkungsfaktor (Kp)" VALUE 0x8003C698 Val_Wr32 20.0000000 ISC_Kp_rpm2Nm_float 0.00 20.0000000 FORMAT "%10.7" EXTENDED_LIMITS -1.00000000E+037 1.00000000E+037 /end CHARACTERISTIC
/begin CHARACTERISTIC HLSDem_WrmClthPLo.KpPos_C "P-Parametersatz unterer Drehmomentpfad, warmer Motor und geöffnete Kupplung/Großsignal Verstärkungsfaktor positiv (Kp)" VALUE 0x8003C69C Val_Wr32 20.0000000 ISC_Kp_rpm2Nm_float 0.00 20.0000000 FORMAT "%10.7" EXTENDED_LIMITS -1.00000000E+037 1.00000000E+037 /end CHARACTERISTIC
/begin CHARACTERISTIC HLSDem_WrmClthPLo.KpNeg_C "P-Parametersatz unterer Drehmomentpfad, warmer Motor und geöffnete Kupplung/Großsignal Verstärkungsfaktor negativ (Kp)" VALUE 0x8003C6A0 Val_Wr32 20.0000000 ISC_Kp_rpm2Nm_float 0.00 20.0000000 FORMAT "%10.7" EXTENDED_LIMITS -1.00000000E+037 1.00000000E+037 /end CHARACTERISTIC
/begin CHARACTERISTIC HLSDem_WrmClthPLo.WinPos_C "P-Parametersatz unterer Drehmomentpfad, warmer Motor und geöffnete Kupplung/Kleinsignal Fensterbreite positiv" VALUE 0x8003C6A4 Val_Wr32 20000.0000 EngN_float -10000.0000 10000.0000 EXTENDED_LIMITS -1.00000000E+037 1.00000000E+037 /end CHARACTERISTIC
/begin CHARACTERISTIC HLSDem_WrmClthPLo.WinNeg_C "P-Parametersatz unterer Drehmomentpfad, warmer Motor und geöffnete Kupplung/Kleinsignal Fensterbreite negativ" VALUE 0x8003C6A8 Val_Wr32 20000.0000 EngN_float -10000.0000 10000.0000 EXTENDED_LIMITS -1.00000000E+037 1.00000000E+037 /end CHARACTERISTIC
/begin CHARACTERISTIC HLSDem_WrmClthrnEngvVeh_C "Verhältnis Motordrehzahl zu Fahrzeuggeschwindigkeit, warmer Motor (offene Kupplung)" VALUE 0x8003C6AC Val_Wr32 1000.00000 ISC_rnEng2vVeh_float 0.00 1000.00000 FORMAT "%10.5" EXTENDED_LIMITS -1.00000000E+037 1.00000000E+037 /end CHARACTERISTIC
/begin CHARACTERISTIC HLSDem_WrmClthtiFltLosTrqEst_C "Zeitkonstante für die PT1-Glieder der Lastmomentabschätzung, warmer Motor, offene Kupplung" VALUE 0x8003C6B0 Val_Wr32 60.0000000 ISC_tiPTsTrqLoss_float 0.00 60.0000000 FORMAT "%10.7" EXTENDED_LIMITS -1.00000000E+037 1.00000000E+037 /end CHARACTERISTIC
/begin CHARACTERISTIC HLSDem_WrmClthtiFltnEng_C "Zeitkonstante für die PT2-Filterung der Motordrehzahl, warmer Motor, Offene Kupplung" VALUE 0x8003C6B4 Val_Wr32 60.0000000 ISC_tiPT2nEng_float 0.00 60.0000000 FORMAT "%10.7" EXTENDED_LIMITS -1.00000000E+037 1.00000000E+037 /end CHARACTERISTIC
/begin CHARACTERISTIC HPUn_dvolMeUnMax_C "maximales Fördervolumen durch die Zumesseinheit" VALUE 0x8003CA40 Val_Ws16 50000.00 Qp_mm3_sec 0.00 50000.00 FORMAT "%8.2" EXTENDED_LIMITS -327680.0 327670.0 /end CHARACTERISTIC
/begin CHARACTERISTIC HPUn_etaPmpFlTemp_CUR "Kraftstofftemperaturabhängiger Wirkungsgrad der Hochdruckpumpe" CURVE 0x8003CA42 Cur_Xs16Ws16 0.9921875 Eta1 0.007812500 1.000000 FORMAT "%8.6" EXTENDED_LIMITS -256.0000 255.9922
 /begin AXIS_DESCR STD_AXIS FuelT_tFlSys Temp_Cels 2 -50.14000 149.8600 EXTENDED_LIMITS -3549.940 3003.560 DEPOSIT ABSOLUTE /end AXIS_DESCR
/end CHARACTERISTIC
/begin CHARACTERISTIC HPUn_etaPmpMaxAged_CUR "Maximaler Wirkungsgrad einer gealterten Hochdruckpumpe" CURVE 0x8003CA4C Cur_Xs16Ws16 0.9921875 Eta1 0.007812500 1.000000 FORMAT "%8.6" EXTENDED_LIMITS -256.0000 255.9922
 /begin AXIS_DESCR STD_AXIS Epm_nEng EngN 2 0.00 10000.00 EXTENDED_LIMITS -16384.00 16383.50 DEPOSIT ABSOLUTE /end AXIS_DESCR
/end CHARACTERISTIC
/begin CHARACTERISTIC HPUn_etaPmpMech_C "mechanischer Wirkungsgrad der Hochdruckpumpe" VALUE 0x8003CA56 Val_Ws16 0.9921875 Eta1 0.007812500 1.000000 FORMAT "%8.6" EXTENDED_LIMITS -256.0000 255.9922 /end CHARACTERISTIC
/begin CHARACTERISTIC HPUn_nMin_C "Drehzahlschwelle zur Abschaltung der Lastmomentberechnung der Hochdruckpumpe" VALUE 0x8003CA58 Val_Ws16 10000.00 EngN 0.00 10000.00 EXTENDED_LIMITS -16384.00 16383.50 /end CHARACTERISTIC
/begin CHARACTERISTIC HPUn_numInjMin_C "Minimal von der Hochdruckpumpe erlaubte Anzahl an Einspritzungen" VALUE 0x8003CA60 Val_Wu8 6.000 OneToOne 0.00 6.000 EXTENDED_LIMITS 0.00 255.0 /end CHARACTERISTIC
/begin CHARACTERISTIC HPUn_pRailDvtOk_C "Maximale Raildruck Regelabweichung für die Mengenbilanzprüfung" VALUE 0x8003CA62 Val_Wu16 2000.000 Pres_Rail 0.00 2000.000 EXTENDED_LIMITS 0.00 6553.500 /end CHARACTERISTIC
/begin CHARACTERISTIC HPUn_rTransCrS_C "Übersetzung Hochdruckpumpe zu Kurbelwelle" VALUE 0x8003CA5A Val_Ws16 10.00000 TransR 0.00 10.00000 EXTENDED_LIMITS -327.6800 327.6700 /end CHARACTERISTIC
/begin CHARACTERISTIC HPUn_tiPresDvtFlt_C "PT1 Zeitkonstante zur Filterung der Raildruck Regelabweichung" VALUE 0x8003CA64 Val_Ws32 4294.9672940 TimeDelay_s 0.000002000000001 4294.9672960 FORMAT "%12.7" /end CHARACTERISTIC
/begin CHARACTERISTIC HPUn_tiQntBalDel_C "Verzögerungszeit zur Berechnung der Mengenbilanz der Hochdruckpumpe" VALUE 0x8003CA68 Val_Ws16 327670.0 Time_ms 0.00 327670.0 EXTENDED_LIMITS -327680.0 327670.0 /end CHARACTERISTIC
/begin CHARACTERISTIC HPUn_volPmp_C "geometrisches Fördervolumen der Hochdruckpumpe pro Pumpenumdrehung" VALUE 0x8003CA5C Val_Ws16 1500.000 PmpQnt 0.00 1500.000 FORMAT "%8.3" EXTENDED_LIMITS -3276.800 3276.700 /end CHARACTERISTIC
/begin CHARACTERISTIC I15031_PID1C_C "OBD Anforderungen für welches das Fahrzeug ausgelegt ist" VALUE 0x8003CA80 Val_Wu8 12.0000000000 I15031_PID1CVerb 1.00000000000 13.0000000000 FORMAT "%13.10" /end CHARACTERISTIC
/begin CHARACTERISTIC I15031_PID1D_C "Ort der Lambda Sonden" VALUE 0x8003CA81 Val_Wu8 255.0 OneToOne 0.00 255.0 /end CHARACTERISTIC
/begin CHARACTERISTIC I15031_PID4FA_C "Konfigurationsinformation des externen Testgeräts. Maximaler Wert des Gleichgewichtsverhältinisses" VALUE 0x8003CA82 Val_Wu8 255.0 OneToOne 0.00 255.0 /end CHARACTERISTIC
/begin CHARACTERISTIC I15031_PID4FB_C "Konfigurationsinformation des externen Testgeräts. Maximaler Wert der Lambda Sensorspannung" VALUE 0x8003CA83 Val_Wu8 255.0 OneToOne 0.00 255.0 /end CHARACTERISTIC
/begin CHARACTERISTIC I15031_PID4FC_C "Konfigurationsinformation des externen Testgeräts. Maximaler Wert des Lambda Sensorstromes" VALUE 0x8003CA84 Val_Wu8 255.0 OneToOne 0.00 255.0 /end CHARACTERISTIC
/begin CHARACTERISTIC I15031_PID4FD_C "Konfigurationsinformation des externen Testgeräts. Maximaler Wert für Absoluten Saugrohr-Druck" VALUE 0x8003CA85 Val_Wu8 255.0 OneToOne 0.00 255.0 /end CHARACTERISTIC
/begin CHARACTERISTIC I15031_srv9PIDTable.PID0_C "Gruppe der konfigurierbaren unterstützten PID's/Unterstützte PIDs" VALUE 0x8003CA86 Val_Wu8 255.0 OneToOne 0.00 255.0 /end CHARACTERISTIC
/begin CHARACTERISTIC I15031_srv9PIDTable.PID1_C "Gruppe der konfigurierbaren unterstützten PID's/Anzahl der Botschaften für VIN" VALUE 0x8003CA87 Val_Wu8 255.0 OneToOne 0.00 255.0 /end CHARACTERISTIC
/begin CHARACTERISTIC I15031_srv9PIDTable.PID2_C "Gruppe der konfigurierbaren unterstützten PID's/VIN" VALUE 0x8003CA88 Val_Wu8 255.0 OneToOne 0.00 255.0 /end CHARACTERISTIC
/begin CHARACTERISTIC I15031_srv9PIDTable.PID3_C "Gruppe der konfigurierbaren unterstützten PID's/Anzahl der Botschaften für CID" VALUE 0x8003CA89 Val_Wu8 255.0 OneToOne 0.00 255.0 /end CHARACTERISTIC
/begin CHARACTERISTIC I15031_srv9PIDTable.PID4_C "Gruppe der konfigurierbaren unterstützten PID's/CID" VALUE 0x8003CA8A Val_Wu8 255.0 OneToOne 0.00 255.0 /end CHARACTERISTIC
/begin CHARACTERISTIC I15031_srv9PIDTable.PID5_C "Gruppe der konfigurierbaren unterstützten PID's/Anzahl der Botschaften für CVN" VALUE 0x8003CA8B Val_Wu8 255.0 OneToOne 0.00 255.0 /end CHARACTERISTIC
/begin CHARACTERISTIC I15031_srv9PIDTable.PID6_C "Gruppe der konfigurierbaren unterstützten PID's/CVN" VALUE 0x8003CA8C Val_Wu8 255.0 OneToOne 0.00 255.0 /end CHARACTERISTIC
/begin CHARACTERISTIC I15031_srv9PIDTable.PID7_C "Gruppe der konfigurierbaren unterstützten PID's/Anzahl der Botschaften für IUMPR" VALUE 0x8003CA8D Val_Wu8 255.0 OneToOne 0.00 255.0 /end CHARACTERISTIC
/begin CHARACTERISTIC I15031_srv9PIDTable.PID8_C "Gruppe der konfigurierbaren unterstützten PID's/IUMPR" VALUE 0x8003CA8E Val_Wu8 255.0 OneToOne 0.00 255.0 /end CHARACTERISTIC
/begin CHARACTERISTIC I15031_stSrv02SuppPid_CA "Unterstützte PIDs für Mode$02" VAL_BLK 0x8003CA6C ValA_Wu8 255.0 OneToOne 0.00 255.0 NUMBER 20 /end CHARACTERISTIC
/begin CHARACTERISTIC Ibs_ctRst_C "" VALUE 0x8003D46C Val_Wu16 65534.00 OneToOne 1.000000 65535.00 EXTENDED_LIMITS 0.00 65535.00 /end CHARACTERISTIC
/begin CHARACTERISTIC IBS_tiDetPeriode_C "" VALUE 0x8003D468 Val_Ws16 10000.00 Time_ms 0.00 10000.00 EXTENDED_LIMITS -327680.0 327670.0 /end CHARACTERISTIC
/begin CHARACTERISTIC IBS_tiWaitDetection_C "" VALUE 0x8003D46A Val_Ws16 10000.00 Time_ms 0.00 10000.00 EXTENDED_LIMITS -327680.0 327670.0 /end CHARACTERISTIC
/begin CHARACTERISTIC K_BZE_IMAX "Testwert BZE obere Stromschwelle Auswertung" VALUE 0x80064193 Val_Wu8 1306. Def_i_ub_q5p12 0.00 1306. FORMAT "%5.0" /end CHARACTERISTIC
/begin CHARACTERISTIC K_BZE_IMIN "Testwert BZE untere Stromschwelle Auswertung" VALUE 0x80064194 Val_Wu8 1306. Def_i_ub_q5p12 0.00 1306. FORMAT "%5.0" /end CHARACTERISTIC
/begin CHARACTERISTIC K_BZE_TSMPL "Testwert BZE Samplingrate" VALUE 0x80064195 Val_Wu8 255. Def_dez_ub_q1 0.00 255. FORMAT "%3.0" /end CHARACTERISTIC
/begin CHARACTERISTIC K_DFSCHWGENTEST "" VALUE 0x80064176 Val_Wu8 99.61 Def_f_ub_b100 0.00 99.61 /end CHARACTERISTIC
/begin CHARACTERISTIC K_DI1000DT "IBS Parameter" VALUE 0x80064196 Val_Wu8 12.75 Def_td_ub_q0p05 0.00 12.75 FORMAT "%5.2" /end CHARACTERISTIC
/begin CHARACTERISTIC K_DI1000STG "IBS Parameter" VALUE 0x80064197 Val_Wu8 20.40 Def_i_ub_q0p08 0.00 20.40 FORMAT "%5.2" /end CHARACTERISTIC
/begin CHARACTERISTIC K_DI1000TGRZ "IBS Parameter" VALUE 0x80064198 Val_Wu8 255.0 Def_td_ub_q1 0.00 255.0 FORMAT "%5.1" /end CHARACTERISTIC
/begin CHARACTERISTIC K_DI200DT "IBS Parameter" VALUE 0x80064199 Val_Wu8 12.75 Def_td_ub_q0p05 0.00 12.75 FORMAT "%5.2" /end CHARACTERISTIC
/begin CHARACTERISTIC K_DI200STG "IBS Parameter" VALUE 0x8006419A Val_Wu8 5.100 Def_i_ub_q0p02 0.00 5.100 /end CHARACTERISTIC
/begin CHARACTERISTIC K_DIHIGHGRZ "IBS Parameter" VALUE 0x8006419B Val_Wu8 20.40 Def_i_ub_q0p08 0.00 20.40 FORMAT "%5.2" /end CHARACTERISTIC
/begin CHARACTERISTIC K_DILOWGRZ "IBS Parameter" VALUE 0x8006419C Val_Wu8 5.100 Def_i_ub_q0p02 0.00 5.100 /end CHARACTERISTIC
/begin CHARACTERISTIC K_DIPL7 "IBS Parameter" VALUE 0x8006419D Val_Wu8 255. Def_dez_ub_q1 0.00 255. FORMAT "%3.0" /end CHARACTERISTIC
/begin CHARACTERISTIC K_DKL15FIL "IBS Parameter" VALUE 0x8006419E Val_Wu8 1.59375 Def_td_ub_q0p00625 0.00 1.59375 /end CHARACTERISTIC
/begin CHARACTERISTIC K_DTMAXGRZI "IBS Parameter" VALUE 0x8006419F Val_Wu8 255.0 Def_td_ub_q1 0.00 255.0 FORMAT "%5.1" /end CHARACTERISTIC
/begin CHARACTERISTIC K_DUIGRZ "IBS Parameter" VALUE 0x800641A0 Val_Wu8 5.100 Def_i_ub_q0p02 0.00 5.100 /end CHARACTERISTIC
/begin CHARACTERISTIC K_DUMINTGRZ "IBS Parameter" VALUE 0x800641A1 Val_Wu8 12.75 Def_td_ub_q0p05 0.00 12.75 FORMAT "%5.2" /end CHARACTERISTIC
/begin CHARACTERISTIC K_DUREFMAX "IBS Parameter" VALUE 0x800641A2 Val_Wu8 4.99800 Def_u_ub_q0p0196 0.00 4.99800 FORMAT "%7.5" /end CHARACTERISTIC
/begin CHARACTERISTIC K_DUREFMINI "IBS Parameter" VALUE 0x800641A3 Val_Wu8 4.99800 Def_u_ub_q0p0196 0.00 4.99800 FORMAT "%7.5" /end CHARACTERISTIC
/begin CHARACTERISTIC K_ECOMAXI "Testwert Max. Ruhestromschwelle Ecos" VALUE 0x800641A4 Val_Wu8 0.31875 Def_i_ub_q0p00125 0.00 0.31875 FORMAT "%7.5" /end CHARACTERISTIC
/begin CHARACTERISTIC K_ELINTEST "Hier koennte Ihr Langbezeichner stehen" VALUE 0x800641A5 Val_Wu8 255. ident 0.00 255. FORMAT "%3.0" /end CHARACTERISTIC
/begin CHARACTERISTIC K_ELINTEST2 "ibsctrl Testfunktionen" VALUE 0x800641A6 Val_Wu8 255. ident 0.00 255. FORMAT "%3.0" /end CHARACTERISTIC
/begin CHARACTERISTIC K_ELIN_INDEX "Test" VALUE 0x800641A7 Val_Wu8 255. ident 0.00 255. FORMAT "%3.0" /end CHARACTERISTIC
/begin CHARACTERISTIC K_ELIN_REPDLY "Delay vor ELIN Wiederholung bei Fehler" VALUE 0x800641A8 Val_Wu8 25.5 Def_td_ub_q0p1 0.00 25.5 FORMAT "%4.1" /end CHARACTERISTIC
/begin CHARACTERISTIC K_ELIN_REPGRENZ "Anzahl ELIN Wiederholungen bis Flag" VALUE 0x800641A9 Val_Wu8 255. ident 0.00 255. FORMAT "%3.0" /end CHARACTERISTIC
/begin CHARACTERISTIC K_ELIN_REPINCERR "ELIN Unterbrechungsentprellung inctement Fehler" VALUE 0x800641AA Val_Wu8 255. ident 0.00 255. FORMAT "%3.0" /end CHARACTERISTIC
/begin CHARACTERISTIC K_ELIN_REPINCOK "ELIN Unterbrechungsentprellung inctement Heilung" VALUE 0x800641AB Val_Wu8 255. ident 0.00 255. FORMAT "%3.0" /end CHARACTERISTIC
/begin CHARACTERISTIC K_ELIN_TSTERA "Testlabel, Messwerte löschen" VALUE 0x800641AC Val_Wu8 255. ident 0.00 255. FORMAT "%3.0" /end CHARACTERISTIC
/begin CHARACTERISTIC K_ENAIBSCTRL "ibs_ctrl Funktionsfreigaben" VALUE 0x800641AD Val_Wu8 255. ident 0.00 255. FORMAT "%3.0" /end CHARACTERISTIC
/begin CHARACTERISTIC K_ENAIBSCTRL2 "ibsctrl Funktionsfreigaben 2" VALUE 0x800641AE Val_Wu8 255. ident 0.00 255. FORMAT "%3.0" /end CHARACTERISTIC
/begin CHARACTERISTIC K_ENISOC0 "IBS Parameter" VALUE 0x800641AF Val_Wu8 5.100 Def_i_ub_q0p02 0.00 5.100 /end CHARACTERISTIC
/begin CHARACTERISTIC K_ENUSOC0 "IBS Parameter" VALUE 0x800641B0 Val_Wu8 16.32 Def_u_ub_q0p064_o6 6.000 22.32 /end CHARACTERISTIC
/begin CHARACTERISTIC K_FILIGEN "Filterkonstante fuer Igenm" VALUE 0x80064177 Val_Wu8 0.99219 Def_f_ub_b1 0.0039063 0.99609 FORMAT "%7.5" EXTENDED_LIMITS 0.00 0.99609 /end CHARACTERISTIC
/begin CHARACTERISTIC K_GENITEST_TOL "Hier könnte Ihr Langbezeichner stehen" VALUE 0x80064178 Val_Wu8 99.61 Def_f_ub_b100 0.00 99.61 /end CHARACTERISTIC
/begin CHARACTERISTIC K_GENUTEST_TOL "Hier könnte Ihr Langbezeichner stehen" VALUE 0x80064179 Val_Wu8 99.61 Def_f_ub_b100 0.00 99.61 /end CHARACTERISTIC
/begin CHARACTERISTIC K_IBSRES_1 "Reserve" VALUE 0x800641B1 Val_Wu8 255. Def_dez_ub_q1 0.00 255. FORMAT "%3.0" /end CHARACTERISTIC
/begin CHARACTERISTIC K_IBSRES_11 "AEP Stromschwelle Ruhestromüberwachung" VALUE 0x800641B2 Val_Wu16 65535. Def_dez_uw_q1 0.00 65535. FORMAT "%5.0" /end CHARACTERISTIC
/begin CHARACTERISTIC K_IBSRES_2 "Reserve" VALUE 0x800641B4 Val_Wu8 255. Def_dez_ub_q1 0.00 255. FORMAT "%3.0" /end CHARACTERISTIC
/begin CHARACTERISTIC K_IBSRES_3 "Reserve" VALUE 0x800641B5 Val_Wu8 255. Def_dez_ub_q1 0.00 255. FORMAT "%3.0" /end CHARACTERISTIC
/begin CHARACTERISTIC K_IBSRES_4 "Reserve" VALUE 0x800641B6 Val_Wu8 255. Def_dez_ub_q1 0.00 255. FORMAT "%3.0" /end CHARACTERISTIC
/begin CHARACTERISTIC K_IBSRES_5 "Reserve" VALUE 0x800641B7 Val_Wu8 255. Def_dez_ub_q1 0.00 255. FORMAT "%3.0" /end CHARACTERISTIC
/begin CHARACTERISTIC K_IBSRES_6 "Reserve" VALUE 0x800641B8 Val_Wu8 255. Def_dez_ub_q1 0.00 255. FORMAT "%3.0" /end CHARACTERISTIC
/begin CHARACTERISTIC K_IBSRES_7 "AEP Stromschwelle Ruhestromüberwachung" VALUE 0x800641BA Val_Wu16 65535. Def_dez_uw_q1 0.00 65535. FORMAT "%5.0" /end CHARACTERISTIC
/begin CHARACTERISTIC K_IBSRES_9 "AEP Stromschwelle Ruhestromüberwachung" VALUE 0x800641BC Val_Wu16 65535. Def_dez_uw_q1 0.00 65535. FORMAT "%5.0" /end CHARACTERISTIC
/begin CHARACTERISTIC K_IBSTFGKCNT "Periodisches Intervall Startfgrk. -> IBS" VALUE 0x800641BE Val_Wu8 255. ident 0.00 255. FORMAT "%3.0" /end CHARACTERISTIC
/begin CHARACTERISTIC K_IBSVERSION "Liste der kompatiblen IBS SW- Versionen" VAL_BLK 0x800641BF ValA_Wu8 255. Def_dez_ub_q1 0.00 255. FORMAT "%3.0" NUMBER 16 /end CHARACTERISTIC
/begin CHARACTERISTIC K_IRISCHWELL "AEP Stromschwelle Ruhestromüberwachung" VALUE 0x800641CF Val_Wu8 5.100 Def_i_ub_q0p02 0.00 5.100 /end CHARACTERISTIC
/begin CHARACTERISTIC K_IRQSCHWELL "AEP Ladungsschwelle Ruhestromverletzung" VALUE 0x800641D0 Val_Wu8 18.56 Def_ql_ub_q0p0728 0.00 18.56 FORMAT "%5.2" /end CHARACTERISTIC
/begin CHARACTERISTIC K_ISLEEPGRZ "IBS Parameter" VALUE 0x800641D1 Val_Wu8 5.100 Def_i_ub_q0p02 0.00 5.100 /end CHARACTERISTIC
/begin CHARACTERISTIC K_ISTARTTRIG "IBS Parameter" VALUE 0x800641D2 Val_Wu8 1306. Def_i_ub_q5p12 0.00 1306. FORMAT "%5.0" /end CHARACTERISTIC
/begin CHARACTERISTIC K_NSTSTAT1 "Kein Langbezeichner vergeben" VALUE 0x80064170 Val_Ws16 65535. Def_n_sw_q1p0 -32768. 32767. FORMAT "%5.0" /end CHARACTERISTIC
/begin CHARACTERISTIC K_NSTSTAT2 "Kein Langbezeichner vergeben" VALUE 0x80064172 Val_Ws16 65535. Def_n_sw_q1p0 -32768. 32767. FORMAT "%5.0" /end CHARACTERISTIC
/begin CHARACTERISTIC K_NSTSTAT3 "Kein Langbezeichner vergeben" VALUE 0x80064174 Val_Ws16 65535. Def_n_sw_q1p0 -32768. 32767. FORMAT "%5.0" /end CHARACTERISTIC
/begin CHARACTERISTIC K_SLEEPWAIT "Verzögerung sleep indication" VALUE 0x800641D3 Val_Wu8 255. ident 0.00 255. FORMAT "%3.0" /end CHARACTERISTIC
/begin CHARACTERISTIC K_S_CLERRIBS "IBS Fehlerlöschen schaltbar" VALUE 0x800641D4 Val_Wu8 255. Def_dez_ub_q1 0.00 255. FORMAT "%3.0" /end CHARACTERISTIC
/begin CHARACTERISTIC K_T1SCHWELLE "IBS Parameter" VALUE 0x800641D5 Val_Wu8 10.20 Def_i_ub_q0p04 0.00 10.20 FORMAT "%5.2" /end CHARACTERISTIC
/begin CHARACTERISTIC K_T1SOC0 "IBS Parameter" VALUE 0x800641D6 Val_Wu8 65280. Def_td_ub_q256 0.00 65280. /end CHARACTERISTIC
/begin CHARACTERISTIC K_T2SCHWELLE "IBS Parameter" VALUE 0x800641D7 Val_Wu8 10.20 Def_i_ub_q0p04 0.00 10.20 FORMAT "%5.2" /end CHARACTERISTIC
/begin CHARACTERISTIC K_T2SOC0 "IBS Parameter" VALUE 0x800641D8 Val_Wu8 65280. Def_td_ub_q256 0.00 65280. /end CHARACTERISTIC
/begin CHARACTERISTIC K_T3SCHWELLE "IBS Parameter" VALUE 0x800641D9 Val_Wu8 10.20 Def_i_ub_q0p04 0.00 10.20 FORMAT "%5.2" /end CHARACTERISTIC
/begin CHARACTERISTIC K_T3SOC0 "IBS Parameter" VALUE 0x800641DA Val_Wu8 65280. Def_td_ub_q256 0.00 65280. /end CHARACTERISTIC
/begin CHARACTERISTIC K_TDKFREIGABE "Counter fuer Keine Freigabe" VALUE 0x8006417A Val_Wu16 6553.5 Def_td_uw_q0p1 0.00 6553.5 FORMAT "%6.1" /end CHARACTERISTIC
/begin CHARACTERISTIC K_TDSTATE1 "Hier könnte Ihr Langbezeichner stehen" VALUE 0x8006417C Val_Wu16 6553.5 Def_td_uw_q0p1 0.00 6553.5 FORMAT "%6.1" /end CHARACTERISTIC
/begin CHARACTERISTIC K_TDSTATE2 "Hier könnte Ihr Langbezeichner stehen" VALUE 0x8006417E Val_Wu16 6553.5 Def_td_uw_q0p1 0.00 6553.5 FORMAT "%6.1" /end CHARACTERISTIC
/begin CHARACTERISTIC K_TDSTATE3 "Hier könnte Ihr Langbezeichner stehen" VALUE 0x80064180 Val_Wu16 6553.5 Def_td_uw_q0p1 0.00 6553.5 FORMAT "%6.1" /end CHARACTERISTIC
/begin CHARACTERISTIC K_TDSTATE4 "Hier könnte Ihr Langbezeichner stehen" VALUE 0x80064182 Val_Wu16 6553.5 Def_td_uw_q0p1 0.00 6553.5 FORMAT "%6.1" /end CHARACTERISTIC
/begin CHARACTERISTIC K_TIBSERR "Test IBS Eigendiagnose" VALUE 0x800641DB Val_Wu8 255. ident 0.00 255. FORMAT "%3.0" /end CHARACTERISTIC
/begin CHARACTERISTIC K_TIBSL1 "ibs_ctrl Testlabel" VALUE 0x800641DC Val_Wu8 255. ident 0.00 255. FORMAT "%3.0" /end CHARACTERISTIC
/begin CHARACTERISTIC K_TMPCOM_DIV "IBS Parameter" VALUE 0x800641DD Val_Wu8 255. Def_dez_ub_q1 0.00 255. FORMAT "%3.0" /end CHARACTERISTIC
/begin CHARACTERISTIC K_TMPCOM_MUL "IBS Parameter" VALUE 0x800641DE Val_Wu8 255. Def_dez_ub_q1 0.00 255. FORMAT "%3.0" /end CHARACTERISTIC
/begin CHARACTERISTIC K_TNUSTART "IBS Parameter" VALUE 0x800641DF Val_Wu8 3.188 Def_td_ub_q0p0125 0.00 3.188 /end CHARACTERISTIC
/begin CHARACTERISTIC K_TNUSTARTFL "IBS Parameter" VALUE 0x800641E0 Val_Wu8 0.51000 Def_td_ub_q0p002_o01 0.010000 0.52000 FORMAT "%7.5" /end CHARACTERISTIC
/begin CHARACTERISTIC K_TPT1TICO "IBS Parameter" VALUE 0x800641E2 Val_Wu16 3276.75 Def_td_uw_q0p05 0.00 3276.75 FORMAT "%7.2" /end CHARACTERISTIC
/begin CHARACTERISTIC K_TSLEEPRUH "IBS Parameter" VALUE 0x800641E4 Val_Wu8 4080. Def_td_ub_q16 0.00 4080. FORMAT "%5.0" /end CHARACTERISTIC
/begin CHARACTERISTIC K_TSTECOS "kt_ibs enable Kommunikation" VALUE 0x800641E5 Val_Wu8 255. Def_dez_ub_q1 0.00 255. FORMAT "%3.0" /end CHARACTERISTIC
/begin CHARACTERISTIC K_T_CLERRIBS "IBS Fehlerlöschen Signaldauer" VALUE 0x800641E6 Val_Wu8 255. Def_dez_ub_q1 0.00 255. FORMAT "%3.0" /end CHARACTERISTIC
/begin CHARACTERISTIC K_T_IRDIAG "AEP Zeit bis Aktivierung Ruhestromdiagnose" VALUE 0x800641E7 Val_Wu8 1275. Def_td_ub_b1280 0.00 1275. FORMAT "%4.0" /end CHARACTERISTIC
/begin CHARACTERISTIC K_T_UTIEFSET "IBS Parameter" VALUE 0x800641E8 Val_Wu8 255.0 Def_td_ub_q1 0.00 255.0 FORMAT "%5.1" /end CHARACTERISTIC
/begin CHARACTERISTIC K_UGENTEST1 "Hier könnte Ihr Langbezeichner stehen" VALUE 0x80064184 Val_Wu16 6553.500 Def_u_uw_q0p1 0.00 6553.500 FORMAT "%8.3" /end CHARACTERISTIC
/begin CHARACTERISTIC K_UGENTEST2 "Hier könnte Ihr Langbezeichner stehen" VALUE 0x80064186 Val_Wu16 6553.500 Def_u_uw_q0p1 0.00 6553.500 FORMAT "%8.3" /end CHARACTERISTIC
/begin CHARACTERISTIC K_UGENTEST3 "Hier könnte Ihr Langbezeichner stehen" VALUE 0x80064188 Val_Wu16 6553.500 Def_u_uw_q0p1 0.00 6553.500 FORMAT "%8.3" /end CHARACTERISTIC
/begin CHARACTERISTIC K_UGENTEST4 "Hier könnte Ihr Langbezeichner stehen" VALUE 0x8006418A Val_Wu16 6553.500 Def_u_uw_q0p1 0.00 6553.500 FORMAT "%8.3" /end CHARACTERISTIC
/begin CHARACTERISTIC K_UTIEFAPP "IBS Parameter" VALUE 0x800641E9 Val_Wu8 16.32 Def_u_ub_q0p064_o6 6.000 22.32 /end CHARACTERISTIC
/begin CHARACTERISTIC S_GENTESTANF "Hier könnte Ihr Langbezeichner stehen" VALUE 0x8006418C Val_Wu8 1.0 Identity 0.00 1.0 EXTENDED_LIMITS 0.00 255. /end CHARACTERISTIC
/begin MEASUREMENT Bszsi "Betriebsstundenzähler" ULONG Def_dez_ul_q1 1 100 0.00 4294967000. FORMAT "%7.0" ECU_ADDRESS 0xC0008F14 /end MEASUREMENT
/begin MEASUREMENT Bsztemp "temporärer Betriebsstundenzähler" UWORD Def_dez_uw_q1 1 100 0.00 65535. FORMAT "%5.0" ECU_ADDRESS 0xC0009F10 /end MEASUREMENT
/begin MEASUREMENT Bze_reserve1 "Bze_reserve1" UBYTE Def_dez_ub_q1 1 100 0.00 255. FORMAT "%3.0" ECU_ADDRESS 0xC000B1F3 /end MEASUREMENT
/begin MEASUREMENT Chk16_ibs "Checksumme Parameter aus IBS" UWORD Def_dez_uw_q1 1 100 0.00 65535. FORMAT "%5.0" ECU_ADDRESS 0xC0009F78 /end MEASUREMENT
/begin MEASUREMENT Comcontrol "Diagnose Modul dibs control" UBYTE ident 1 100 0.00 255. FORMAT "%3.0" ECU_ADDRESS 0xC000B1F4 /end MEASUREMENT
/begin MEASUREMENT CoVeh_stIgnLckTerm15 "Status Klemme 15" UBYTE OneToOne 1 100 0.00 255.0 ECU_ADDRESS 0xD0001C57 /end MEASUREMENT
/begin MEASUREMENT CoVeh_stIgnLckTerm50 "Status Klemme 50" UBYTE OneToOne 1 100 0.00 255.0 ECU_ADDRESS 0xD0001C58 /end MEASUREMENT
/begin MEASUREMENT Dfdp "Primärkennfeld FASTA Generatorauslastung" UWORD Def_dez_uw_q1 1 100 0.00 65535. FORMAT "%5.0" ARRAY_SIZE 16 ECU_ADDRESS 0xC000BE3C /end MEASUREMENT
/begin MEASUREMENT Dfds "Sekundärkennfeld FASTA Generatorauslastung" UBYTE Def_st_ub_q1 1 100 0.00 255. FORMAT "%3.0" ARRAY_SIZE 16 ECU_ADDRESS 0xC000BE5C /end MEASUREMENT
/begin MEASUREMENT Dfmonitor "DF-Monitor für FASTA" UBYTE Def_f_ub_b100 1 100 0.00 99.61 ECU_ADDRESS 0xC000B1E0 /end MEASUREMENT
/begin MEASUREMENT Dfsumme "DFMonitor Summe FASTA" FLOAT32_IEEE Def_f_r32 1 100 1.000000000000 3.000000000000E+038 FORMAT "%14.0" ECU_ADDRESS 0xC0008F18 /end MEASUREMENT
/begin MEASUREMENT Dfwanzahl "DF-Wertezähler" FLOAT32_IEEE Def_f_r32 1 100 1.000000000000 3.000000000000E+038 FORMAT "%14.0" ECU_ADDRESS 0xC0008F1C /end MEASUREMENT
/begin MEASUREMENT D_qsfg1sav "Startfaehigkeit Zaehler1 save" UWORD Def_ql_uw_q0p0182 1 100 0.00 1192.750 FORMAT "%8.3" ECU_ADDRESS 0xC0009F7A /end MEASUREMENT
/begin MEASUREMENT D_qsfg2sav "Startfaehigkeit Zaehler2 save" UWORD Def_ql_uw_q0p0182 1 100 0.00 1192.750 FORMAT "%8.3" ECU_ADDRESS 0xC0009F7C /end MEASUREMENT
/begin MEASUREMENT Ecoctrl "SDtatus Messwerte löschen" UBYTE ident 1 100 0.00 255. FORMAT "%3.0" ECU_ADDRESS 0xC000B1F5 /end MEASUREMENT
/begin MEASUREMENT Ecopolctr "Ecos Resultat polling delay Zaehler" UBYTE ident 1 100 0.00 255. FORMAT "%3.0" ECU_ADDRESS 0xC000B1F6 /end MEASUREMENT
/begin MEASUREMENT Eco_jobstat1 "Testerstatus" UBYTE Def_dez_ub_q1 1 100 0.00 255. FORMAT "%3.0" ECU_ADDRESS 0xC000B1F7 /end MEASUREMENT
/begin MEASUREMENT Eco_result1 "Ruhestrom Messbereich 1" UWORD Def_i_uw_q0p00125 1 100 0.00 81.918750 ECU_ADDRESS 0xC0009F7E /end MEASUREMENT
/begin MEASUREMENT Elbufind "Index für Elin_buffer" UBYTE Def_dez_ub_q1 1 100 0.00 255. FORMAT "%3.0" ECU_ADDRESS 0xC000B1F8 /end MEASUREMENT
/begin MEASUREMENT Elin_buffer "Puffer für ganze Elin Botschaft" UBYTE ident 1 100 0.00 255. FORMAT "%3.0" ARRAY_SIZE 120 ECU_ADDRESS 0xC000BEFC /end MEASUREMENT
/begin MEASUREMENT Elin_error "Fehlerstatus erweiterte LIN Komm." UBYTE ident 1 100 0.00 255. FORMAT "%3.0" ECU_ADDRESS 0xC000B1F9 /end MEASUREMENT
/begin MEASUREMENT Elin_ind "Startindex der aktuellen Elin- Botschaft" UBYTE Def_dez_ub_q1 1 100 0.00 255. FORMAT "%3.0" ECU_ADDRESS 0xC000B1FA /end MEASUREMENT
/begin MEASUREMENT Elin_numbyt "Anzahl ser Bytes einer ELIN Botschaft" UBYTE Def_dez_ub_q1 1 100 0.00 255. FORMAT "%3.0" ECU_ADDRESS 0xC000B1FB /end MEASUREMENT
/begin MEASUREMENT Elin_numfram "Anzahl der Datenframes der aktuellen ELIN Botschaft" UBYTE Def_dez_ub_q1 1 100 0.00 255. FORMAT "%3.0" ECU_ADDRESS 0xC000B1FC /end MEASUREMENT
/begin MEASUREMENT Elin_numobj "Anzahl Objekte der aktuellen Elin Botschaft" UBYTE Def_dez_ub_q1 1 100 0.00 255. FORMAT "%3.0" ECU_ADDRESS 0xC000B1FD /end MEASUREMENT
/begin MEASUREMENT Elin_repcount "Elin Fehler Zähler" SWORD Def_dez_sw_q1 1 100 -32768. 32767. FORMAT "%5.0" ECU_ADDRESS 0xC0009F80 /end MEASUREMENT
/begin MEASUREMENT Elin_repdelctr "Elin Fehler Wiederholung Delay Zähler" UBYTE Def_td_ub_q0p1 1 100 0.00 25.5 FORMAT "%4.1" ECU_ADDRESS 0xC000B1FE /end MEASUREMENT
/begin MEASUREMENT Elin_stat "Hier koennte Ihr Langbezeichner stehen" UBYTE Def_dez_ub_q1 1 100 0.00 255. FORMAT "%3.0" ECU_ADDRESS 0xC000B1FF /end MEASUREMENT
/begin MEASUREMENT Elin_waitcount "ELIN repeat holdoff" UBYTE ident 1 100 0.00 255. FORMAT "%3.0" ECU_ADDRESS 0xC000B200 /end MEASUREMENT
/begin MEASUREMENT Fsclctr "Hilfszaehler IBS Fehler loeschen" UBYTE Def_dez_ub_q1 1 100 0.00 255. FORMAT "%3.0" ECU_ADDRESS 0xC000B201 /end MEASUREMENT
/begin MEASUREMENT Genitest_tol "Hier könnte Ihr Langbezeichner stehen" UBYTE Def_f_ub_b100 1 100 0.00 99.61 ECU_ADDRESS 0xC000B1D8 /end MEASUREMENT
/begin MEASUREMENT Geniutest_ab "Hier könnte Ihr Langbezeichner stehen" UBYTE Def_st_ub_q1 1 100 0.00 255. FORMAT "%3.0" ECU_ADDRESS 0xC000B1D9 /end MEASUREMENT
/begin MEASUREMENT Geniutest_err "Fehlerstatusbyte" UBYTE Def_st_ub_q1 1 100 0.00 255. FORMAT "%3.0" ECU_ADDRESS 0xC000B1DA /end MEASUREMENT
/begin MEASUREMENT Genutest_tol "Hier könnte Ihr Langbezeichner stehen" UBYTE Def_f_ub_b100 1 100 0.00 99.61 ECU_ADDRESS 0xC000B1DB /end MEASUREMENT
/begin MEASUREMENT GlbDa_aX "Fahrzeuglängsbeschleunigung" SWORD Acc 1 100 -32.76800 32.76700 FORMAT "%8.5" ECU_ADDRESS 0xD0000B5A /end MEASUREMENT
/begin MEASUREMENT GlbDa_aXFlt "gefilterte Fahrzeuglängsbeschleunigung" SWORD Acc 1 100 -32.76800 32.76700 FORMAT "%8.5" ECU_ADDRESS 0xD0000B5C /end MEASUREMENT
/begin MEASUREMENT GlbDa_ctLoadPrimRow0_mp "Primärkennfeld Fahrzeugnutzungsprofil" UWORD OneToOne 1 100 0.00 65535.00 ARRAY_SIZE 8 ECU_ADDRESS 0xC000BE6C /end MEASUREMENT
/begin MEASUREMENT GlbDa_ctLoadPrimRow1_mp "Primärkennfeld Fahrzeugnutzungsprofil" UWORD OneToOne 1 100 0.00 65535.00 ARRAY_SIZE 8 ECU_ADDRESS 0xC000BE7C /end MEASUREMENT
/begin MEASUREMENT GlbDa_ctLoadPrimRow2_mp "Primärkennfeld Fahrzeugnutzungsprofil" UWORD OneToOne 1 100 0.00 65535.00 ARRAY_SIZE 8 ECU_ADDRESS 0xC000BE8C /end MEASUREMENT
/begin MEASUREMENT GlbDa_ctLoadPrimRow3_mp "Primärkennfeld Fahrzeugnutzungsprofil" UWORD OneToOne 1 100 0.00 65535.00 ARRAY_SIZE 8 ECU_ADDRESS 0xC000BE9C /end MEASUREMENT
/begin MEASUREMENT GlbDa_ctLoadPrimRow4_mp "Primärkennfeld Fahrzeugnutzungsprofil" UWORD OneToOne 1 100 0.00 65535.00 ARRAY_SIZE 8 ECU_ADDRESS 0xC000BEAC /end MEASUREMENT
/begin MEASUREMENT GlbDa_ctLoadPrimRow5_mp "Primärkennfeld Fahrzeugnutzungsprofil" UWORD OneToOne 1 100 0.00 65535.00 ARRAY_SIZE 8 ECU_ADDRESS 0xC000BEBC /end MEASUREMENT
/begin MEASUREMENT GlbDa_ctLoadSecRow0_mp "Sekundärkennfeld Fahrzeugnutzungsprofil" UBYTE OneToOne 1 100 0.00 255.0 ARRAY_SIZE 8 ECU_ADDRESS 0xC000BECC /end MEASUREMENT
/begin MEASUREMENT GlbDa_ctLoadSecRow1_mp "Sekundärkennfeld Fahrzeugnutzungsprofil" UBYTE OneToOne 1 100 0.00 255.0 ARRAY_SIZE 8 ECU_ADDRESS 0xC000BED4 /end MEASUREMENT
/begin MEASUREMENT GlbDa_ctLoadSecRow2_mp "Sekundärkennfeld Fahrzeugnutzungsprofil" UBYTE OneToOne 1 100 0.00 255.0 ARRAY_SIZE 8 ECU_ADDRESS 0xC000BEDC /end MEASUREMENT
/begin MEASUREMENT GlbDa_ctLoadSecRow3_mp "Sekundärkennfeld Fahrzeugnutzungsprofil" UBYTE OneToOne 1 100 0.00 255.0 ARRAY_SIZE 8 ECU_ADDRESS 0xC000BEE4 /end MEASUREMENT
/begin MEASUREMENT GlbDa_ctLoadSecRow4_mp "Sekundärkennfeld Fahrzeugnutzungsprofil" UBYTE OneToOne 1 100 0.00 255.0 ARRAY_SIZE 8 ECU_ADDRESS 0xC000BEEC /end MEASUREMENT
/begin MEASUREMENT GlbDa_ctLoadSecRow5_mp "Sekundärkennfeld Fahrzeugnutzungsprofil" UBYTE OneToOne 1 100 0.00 255.0 ARRAY_SIZE 8 ECU_ADDRESS 0xC000BEF4 /end MEASUREMENT
/begin MEASUREMENT GlbDa_lDstSum_mp "Wegstrecke seit dem letzten EEP- Abspeichern" SLONG Length_fine 1 100 -2147483.64800 2147483.64700 FORMAT "%13.5" ECU_ADDRESS 0xC0008F28 /end MEASUREMENT
/begin MEASUREMENT GlbDa_lTotDst "zurückgelegte Gesamtstrecke seit erstem Start" SLONG Length 1 100 -2147483648.00 2147483647.00 FORMAT "%13.2" ECU_ADDRESS 0xD0002CD8 /end MEASUREMENT
/begin MEASUREMENT GlbDa_lTotDstLstStored_mp "letzter ins EEP gespeicherter Wert der zurückgelegte Gesamtstrecke" SLONG Length 1 100 -2147483648.00 2147483647.00 FORMAT "%13.2" ECU_ADDRESS 0xC0008F2C /end MEASUREMENT
/begin MEASUREMENT GlbDa_lWhlCirc "Radumfang" SWORD Length_fine 1 100 -32.76800 32.76700 FORMAT "%8.5" ECU_ADDRESS 0xD0000B5E /end MEASUREMENT
/begin MEASUREMENT GlbDa_pEnv "Umgebungsluftdruck" SWORD Pres_hPa 1 100 -32768.00 3500.00 ECU_ADDRESS 0xD0000B60 /end MEASUREMENT
/begin MEASUREMENT GlbDa_stIARlsVeh "Zündwinkelfreigabe von GlbDa" UBYTE OneToOne 1 100 0.00 255.0 ECU_ADDRESS 0xD0001E64 /end MEASUREMENT
/begin MEASUREMENT GlbDa_stTrqDem "Momentenanfordernde Funktion" UWORD OneToOne 1 100 0.00 65535.00 ECU_ADDRESS 0xD00015BC /end MEASUREMENT
/begin MEASUREMENT GlbDa_stVehLimMin "Aktueller Begrenzungszustand von GlbDa" UBYTE OneToOne 1 100 0.00 255.0 ECU_ADDRESS 0xD0001E65 /end MEASUREMENT
/begin MEASUREMENT GlbDa_tEnv "Umgebungslufttemperatur" SWORD Temp_Cels 1 100 -3549.940 3003.560 ECU_ADDRESS 0xD0000B62 /end MEASUREMENT
/begin MEASUREMENT GlbDa_tEnvMod "Umgebungslufttemperatur modelliert" SWORD Temp_Cels 1 100 -3549.940 3003.560 ECU_ADDRESS 0xD0000B64 /end MEASUREMENT
/begin MEASUREMENT GlbDa_tiLoadPrim_mp "Fahrzeugnutzungsprofil-Betriebsstundenzähler" UWORD OneToOne 1 100 0.00 65535.00 ECU_ADDRESS 0xC0009F12 /end MEASUREMENT
/begin MEASUREMENT GlbDa_tiLoadSec_mp "Fahrzeugnutzungsprofil-Betriebsstundenzähler" SLONG OneToOne 1 100 -2147483648.00 2147483647.00 ECU_ADDRESS 0xC0008F24 /end MEASUREMENT
/begin MEASUREMENT GlbDa_tIndAir "Ansauglufttemperatur" SWORD Temp_Cels 1 100 -3549.940 3003.560 ECU_ADDRESS 0xD0000B66 /end MEASUREMENT
/begin MEASUREMENT GlbDa_trqVehLimMin "Aktuelle Begrenzung von GlbDa" SWORD Trq 1 100 -3276.800 3276.700 ECU_ADDRESS 0xD0000B68 /end MEASUREMENT
/begin MEASUREMENT GlbDa_vX "Fahrzeuggeschwindigkeit" SWORD Vel 1 100 -327.6800 327.6700 ECU_ADDRESS 0xD0000B6A /end MEASUREMENT
/begin MEASUREMENT GlbDa_vXFlt "gefilterte Fahrzeuggeschwindigkeit" SWORD Vel 1 100 -327.6800 327.6700 ECU_ADDRESS 0xD0000B6C /end MEASUREMENT
/begin MEASUREMENT GlbDa_vXmPerSec_mp "Fahrzeuggeschwindigkeit in m/sec" SLONG Vel_SI 1 100 -5965232.35556 5965232.35278 FORMAT "%13.5" ECU_ADDRESS 0xC0008F30 /end MEASUREMENT
/begin MEASUREMENT GlwCtl_ctPreGlw_mp "" UBYTE OneToOne 1 100 0.00 255.0 ECU_ADDRESS 0xC000B1E3 /end MEASUREMENT
/begin MEASUREMENT GlwCtl_stGlw "Glühzustand aus Zustandsautomat" UWORD OneToOne 1 100 0.00 65535.00 ECU_ADDRESS 0xD00015BE /end MEASUREMENT
/begin MEASUREMENT GlwCtl_stGlwState "" SWORD OneToOne 1 100 -32768.00 32767.00 ECU_ADDRESS 0xD0000B6E /end MEASUREMENT
/begin MEASUREMENT GlwCtl_stGlw_mp "" UWORD OneToOne 1 100 0.00 65535.00 ECU_ADDRESS 0xC0009F26 /end MEASUREMENT
/begin MEASUREMENT GlwCtl_stHdnPreGlwOld_mp "" SWORD OneToOne 1 100 -32768.00 32767.00 ECU_ADDRESS 0xC0009F16 /end MEASUREMENT
/begin MEASUREMENT GlwCtl_stHdnPreGlwTrg_mp "" SWORD OneToOne 1 100 -32768.00 32767.00 ECU_ADDRESS 0xC0009F18 /end MEASUREMENT
/begin MEASUREMENT GlwCtl_stHdnPreGlw_mp "" SWORD OneToOne 1 100 -32768.00 32767.00 ECU_ADDRESS 0xC0009F1A /end MEASUREMENT
/begin MEASUREMENT GlwCtl_stLampCond_mp "" UBYTE OneToOne 1 100 0.00 255.0 ECU_ADDRESS 0xC000B1E2 /end MEASUREMENT
/begin MEASUREMENT GlwCtl_stLampEna "" UBYTE OneToOne 1 100 0.00 255.0 ECU_ADDRESS 0xD0001E66 /end MEASUREMENT
/begin MEASUREMENT GlwCtl_stLogicCond_mp "" UBYTE OneToOne 1 100 0.00 255.0 ECU_ADDRESS 0xC000B1E4 /end MEASUREMENT
/begin MEASUREMENT GlwCtl_stPwrRgn_mp "" SWORD OneToOne 1 100 -32768.00 32767.00 ECU_ADDRESS 0xC0009F28 /end MEASUREMENT
/begin MEASUREMENT GlwCtl_tClnt "" SWORD Temp_Cels 1 100 -3549.940 3003.560 ECU_ADDRESS 0xD0000B70 /end MEASUREMENT
/begin MEASUREMENT GlwCtl_tFld_mp "" SWORD Temp_Cels 1 100 -3549.940 3003.560 ECU_ADDRESS 0xC0009F2A /end MEASUREMENT
/begin MEASUREMENT GlwCtl_tGlwPlg "" SWORD Temp_Cels 1 100 -3549.940 3003.560 ECU_ADDRESS 0xD0000B72 /end MEASUREMENT
/begin MEASUREMENT GlwCtl_tiClnt_mp "" SWORD Time_ms 1 100 -327680.0 327670.0 ECU_ADDRESS 0xC0009F1C /end MEASUREMENT
/begin MEASUREMENT GlwCtl_tiEngPre_mp "" UWORD Time_ms 1 100 0.00 655350.0 ECU_ADDRESS 0xC0009F1E /end MEASUREMENT
/begin MEASUREMENT GlwCtl_tiLmp_mp "Ansteuerungszeit der Glühkontrolllampe beim Vorglühen" SWORD Time_ms 1 100 -327680.0 327670.0 ECU_ADDRESS 0xC0009F14 /end MEASUREMENT
/begin MEASUREMENT GlwCtl_tiPreGlw_mp "" SWORD Time_ms 1 100 -327680.0 327670.0 ECU_ADDRESS 0xC0009F20 /end MEASUREMENT
/begin MEASUREMENT GlwCtl_tiRdyGlw_mp "" SWORD Time_ms 1 100 -327680.0 327670.0 ECU_ADDRESS 0xC0009F22 /end MEASUREMENT
/begin MEASUREMENT GlwCtl_tiStrtGlw_mp "" SWORD Time_ms 1 100 -327680.0 327670.0 ECU_ADDRESS 0xC0009F24 /end MEASUREMENT
/begin MEASUREMENT GlwEcu_lSum_mp "" UWORD OneToOne 1 100 0.00 65535.00 ECU_ADDRESS 0xC0009F2C /end MEASUREMENT
/begin MEASUREMENT GlwEcu_numBattU_mp "" UBYTE OneToOne 1 100 0.00 255.0 ECU_ADDRESS 0xC000B1E5 /end MEASUREMENT
/begin MEASUREMENT GlwEcu_numLINnEng_mp "" UWORD OneToOne 1 100 0.00 65535.00 ECU_ADDRESS 0xC0009F2E /end MEASUREMENT
/begin MEASUREMENT GlwEcu_numLINqSet_mp "" UBYTE OneToOne 1 100 0.00 255.0 ECU_ADDRESS 0xC000B1E6 /end MEASUREMENT
/begin MEASUREMENT GlwEcu_numLINtEng_mp "" UBYTE OneToOne 1 100 0.00 255.0 ECU_ADDRESS 0xC000B1E7 /end MEASUREMENT
/begin MEASUREMENT GlwEcu_numLINtGlwPlg_mp "" UBYTE OneToOne 1 100 0.00 255.0 ECU_ADDRESS 0xC000B1E8 /end MEASUREMENT
/begin MEASUREMENT GlwEcu_pAir_mp "" UBYTE OneToOne 1 100 0.00 255.0 ECU_ADDRESS 0xC000B1E9 /end MEASUREMENT
/begin MEASUREMENT GlwEcu_pwrGlow "" UWORD Pwr_HiRes 1 100 0.00 65535.00 FORMAT "%8.2" ECU_ADDRESS 0xD00015C0 /end MEASUREMENT
/begin MEASUREMENT GlwEcu_stCommonFault "" UWORD OneToOne 1 100 0.00 65535.00 ECU_ADDRESS 0xD00015C2 /end MEASUREMENT
/begin MEASUREMENT GlwEcu_stGlowResp_mp "" UBYTE OneToOne 1 100 0.00 255.0 ECU_ADDRESS 0xC000B1EA /end MEASUREMENT
/begin MEASUREMENT GlwEcu_stGPCMConfig_mp "" UBYTE OneToOne 1 100 0.00 255.0 ECU_ADDRESS 0xC000B1EB /end MEASUREMENT
/begin MEASUREMENT GlwEcu_stGPCMDiag "" UBYTE OneToOne 1 100 0.00 255.0 ECU_ADDRESS 0xD0001E67 /end MEASUREMENT
/begin MEASUREMENT GlwEcu_stGPType_mp "" UBYTE OneToOne 1 100 0.00 255.0 ECU_ADDRESS 0xC000B1EC /end MEASUREMENT
/begin MEASUREMENT GlwEcu_stHighresCold "" UBYTE OneToOne 1 100 0.00 255.0 ECU_ADDRESS 0xD0001E6A /end MEASUREMENT
/begin MEASUREMENT GlwEcu_stHighresHot "" UBYTE OneToOne 1 100 0.00 255.0 ECU_ADDRESS 0xD0001E6B /end MEASUREMENT
/begin MEASUREMENT GlwEcu_stHSSOpen "" UBYTE OneToOne 1 100 0.00 255.0 ECU_ADDRESS 0xD0001E68 /end MEASUREMENT
/begin MEASUREMENT GlwEcu_stHSSShort "" UBYTE OneToOne 1 100 0.00 255.0 ECU_ADDRESS 0xD0001E69 /end MEASUREMENT
/begin MEASUREMENT GlwEcu_stInternalFault "" UWORD OneToOne 1 100 0.00 65535.00 ECU_ADDRESS 0xD00015C4 /end MEASUREMENT
/begin MEASUREMENT GlwEcu_stLowresCold "" UBYTE OneToOne 1 100 0.00 255.0 ECU_ADDRESS 0xD0001E6C /end MEASUREMENT
/begin MEASUREMENT GlwEcu_stLowresHot "" UBYTE OneToOne 1 100 0.00 255.0 ECU_ADDRESS 0xD0001E6D /end MEASUREMENT
/begin MEASUREMENT GlwEcu_stOpenLoad "" UBYTE OneToOne 1 100 0.00 255.0 ECU_ADDRESS 0xD0001E6E /end MEASUREMENT
/begin MEASUREMENT GlwEcu_stShortCircuit "" UBYTE OneToOne 1 100 0.00 255.0 ECU_ADDRESS 0xD0001E6F /end MEASUREMENT
/begin MEASUREMENT GlwEcu_tGlwPlg_mp "" SWORD Temp_Cels 1 100 -3549.940 3003.560 ECU_ADDRESS 0xC0009F30 /end MEASUREMENT
/begin MEASUREMENT GSHDem_nCalcSetPLo_mp "berechnete untere Schaltdrehzahl" SWORD EngN 1 100 -16384.00 16383.50 ECU_ADDRESS 0xC0009F32 /end MEASUREMENT
/begin MEASUREMENT GSHDem_nSetPHi "maximale Schaltdrehzahl" SWORD EngN 1 100 -16384.00 16383.50 ECU_ADDRESS 0xD0000B2E /end MEASUREMENT
/begin MEASUREMENT GSHDem_nSetPLo "minimale Schaltdrehzahl" SWORD EngN 1 100 -16384.00 16383.50 ECU_ADDRESS 0xD0000B30 /end MEASUREMENT
/begin MEASUREMENT GSHDem_numGearPre_mp "Gangnummer beim letzten geschlossenen Kupplungszustand" UBYTE OneToOne 1 100 0.00 255.0 ECU_ADDRESS 0xC000B1ED /end MEASUREMENT
/begin MEASUREMENT GSHDem_numGearPst_mp "Gangnummer vom nächst höheren Gang" UBYTE OneToOne 1 100 0.00 255.0 ECU_ADDRESS 0xC000B1EE /end MEASUREMENT
/begin MEASUREMENT GSHDem_rTraPre_mp "Triebstrangübersetzung während des letzten geschlossenen Kopplungszustands" SWORD TransR 1 100 -327.6800 327.6700 ECU_ADDRESS 0xC0009F34 /end MEASUREMENT
/begin MEASUREMENT GSHDem_rTraPst_mp "Triebstrangübersetzung vom nächst höheren Gang" SWORD TransR 1 100 -327.6800 327.6700 ECU_ADDRESS 0xC0009F36 /end MEASUREMENT
/begin MEASUREMENT GSHDem_rVnPre_mp "Verhältnis der Fahrgeschwindigkeit zu Motordrehzahl während des letzten geschlossenen Kopplungszustands" SWORD VelToN 1 100 -0.3276800 0.3276700 FORMAT "%9.7" ECU_ADDRESS 0xC0009F38 /end MEASUREMENT
/begin MEASUREMENT GSHDem_trqLoLimMax "maximales GSHDem Begrenzungsdrehmoment an den ISC" SWORD Trq 1 100 -3276.800 3276.700 ECU_ADDRESS 0xD0000B32 /end MEASUREMENT
/begin MEASUREMENT GSHDem_trqLoLimMin "minimales GSHDem Begrenzungsdrehmoment an den ISC" SWORD Trq 1 100 -3276.800 3276.700 ECU_ADDRESS 0xD0000B34 /end MEASUREMENT
/begin MEASUREMENT GSHDem_trqReq "Anforderung Initialisierungsdrehmoment an den Drehzahlregler" SWORD Trq 1 100 -3276.800 3276.700 ECU_ADDRESS 0xD0000B36 /end MEASUREMENT
/begin MEASUREMENT GSHDem_tTrqMax_mp "ausgewählter Temperaturwert für die Berechnung des maximal zulässigen Stelldrehmoments durch den Schaltdrehzahlregler" SWORD Temp_Cels 1 100 -3549.940 3003.560 ECU_ADDRESS 0xC0009F3A /end MEASUREMENT
/begin MEASUREMENT HLSDem_dnAccLimCurr_mp "Maximale zulässige Beschleunigung (Motordrehzahl)" FLOAT32_IEEE ISC_dnEng_float 1 100 0.00 12000.0000 FORMAT "%10.4" ECU_ADDRESS 0xC0008F34 /end MEASUREMENT
/begin MEASUREMENT HLSDem_dnDeclLimCurr_mp "Maximale zulässige Verzögerung (Motordrehzahl)" FLOAT32_IEEE ISC_dnEng_float 1 100 -12000.0000 0.00 FORMAT "%10.4" ECU_ADDRESS 0xC0008F38 /end MEASUREMENT
/begin MEASUREMENT HLSDem_InrtDrvTrnCurr_mp "Massenträgheitsmoment von Antriebstarng inkl. Motor" FLOAT32_IEEE ISC_Inirtia_float 1 100 0.00 20.0000000 FORMAT "%10.7" ECU_ADDRESS 0xC0008F3C /end MEASUREMENT
/begin MEASUREMENT HLSDem_InrtEngCurr_mp "Massenträgheitsmoment des Motors" FLOAT32_IEEE ISC_Inirtia_float 1 100 0.00 20.0000000 FORMAT "%10.7" ECU_ADDRESS 0xC0008F40 /end MEASUREMENT
/begin MEASUREMENT HLSDem_InrtVehCurr_mp "Massenträgheitsmoment von gesamt Fahrzeug" FLOAT32_IEEE ISC_Inirtia_float 1 100 0.00 20.0000000 FORMAT "%10.7" ECU_ADDRESS 0xC0008F44 /end MEASUREMENT
/begin MEASUREMENT HLSDem_IWinNegLoCurr_mp "Negatives Fenster für I-Glied unterer Pfad" FLOAT32_IEEE EngN_float 1 100 -10000.0000 10000.0000 ECU_ADDRESS 0xC0008F48 /end MEASUREMENT
/begin MEASUREMENT HLSDem_IWinPosLoCurr_mp "positives Fenster für I-Glied unterer Pfad" FLOAT32_IEEE EngN_float 1 100 -10000.0000 10000.0000 ECU_ADDRESS 0xC0008F4C /end MEASUREMENT
/begin MEASUREMENT HLSDem_KiLoCurr_mp "Verstärkung I-Glied unterer Pfad" FLOAT32_IEEE ISC_Ki_rpm2Nm_float 1 100 0.00 20.0000000 FORMAT "%10.7" ECU_ADDRESS 0xC0008F50 /end MEASUREMENT
/begin MEASUREMENT HLSDem_KiNegLoCurr_mp "Negative Großsignalverstärkung I-Glied unterer Pfad" FLOAT32_IEEE ISC_Ki_rpm2Nm_float 1 100 0.00 20.0000000 FORMAT "%10.7" ECU_ADDRESS 0xC0008F54 /end MEASUREMENT
/begin MEASUREMENT HLSDem_KiPosLoCurr_mp "aktuelle Großsignalverstärkung (positiv) I-Anteil unterer Pfad" FLOAT32_IEEE ISC_Ki_rpm2Nm_float 1 100 0.00 20.0000000 FORMAT "%10.7" ECU_ADDRESS 0xC0008F58 /end MEASUREMENT
/begin MEASUREMENT HLSDem_KpHiCurr_mp "Verstärkung P-Glied oberer Pfad" FLOAT32_IEEE ISC_Kp_rpm2Nm_float 1 100 0.00 20.0000000 FORMAT "%10.7" ECU_ADDRESS 0xC0008F5C /end MEASUREMENT
/begin MEASUREMENT HLSDem_KpLoCurr_mp "Aktuelle Verstärkung P-Glied unterer Pfad" FLOAT32_IEEE ISC_Kp_rpm2Nm_float 1 100 0.00 20.0000000 FORMAT "%10.7" ECU_ADDRESS 0xC0008F60 /end MEASUREMENT
/begin MEASUREMENT HLSDem_KpNegHiCurr_mp "Negative Großsignalverstärkung P-Glied oberer Pfad" FLOAT32_IEEE ISC_Kp_rpm2Nm_float 1 100 0.00 20.0000000 FORMAT "%10.7" ECU_ADDRESS 0xC0008F64 /end MEASUREMENT
/begin MEASUREMENT HLSDem_KpNegLoCurr_mp "Negative Großsignalverstärkung P-Glied unterer Pfad" FLOAT32_IEEE ISC_Kp_rpm2Nm_float 1 100 0.00 20.0000000 FORMAT "%10.7" ECU_ADDRESS 0xC0008F68 /end MEASUREMENT
/begin MEASUREMENT HLSDem_KpPosHiCurr_mp "Positive Großsignalverstärkung P-Gllied oberer Pfad" FLOAT32_IEEE ISC_Kp_rpm2Nm_float 1 100 0.00 20.0000000 FORMAT "%10.7" ECU_ADDRESS 0xC0008F6C /end MEASUREMENT
/begin MEASUREMENT HLSDem_KpPosLoCurr_mp "Positive Großsignalverstärkung P-Glied unterer Pfad" FLOAT32_IEEE ISC_Kp_rpm2Nm_float 1 100 0.00 20.0000000 FORMAT "%10.7" ECU_ADDRESS 0xC0008F70 /end MEASUREMENT
/begin MEASUREMENT HLSDem_nDiffDelta_mp "Differenz Motordrehzahl" SWORD EngN 1 100 -16384.00 16383.50 ECU_ADDRESS 0xC0009F3C /end MEASUREMENT
/begin MEASUREMENT HLSDem_nHDC_mp "Motordrehzahl HDC" SWORD EngN 1 100 -16384.00 16383.50 ECU_ADDRESS 0xC0009F3E /end MEASUREMENT
/begin MEASUREMENT HLSDem_nMaxTrq "Ausgewählter Temperaturwert für die Berechnung der Höchstdrehzahl" SWORD EngN 1 100 -16384.00 16383.50 ECU_ADDRESS 0xD0000B76 /end MEASUREMENT
/begin MEASUREMENT HLSDem_nSetPHi "maximale Motordrehzahl des HLSDem" SWORD EngN 1 100 -16384.00 16383.50 ECU_ADDRESS 0xD0000B78 /end MEASUREMENT
/begin MEASUREMENT HLSDem_nSetPHiCo_mp "koordinierte maximale Motordrehzahl" SWORD EngN 1 100 -16384.00 16383.50 ECU_ADDRESS 0xC0009F40 /end MEASUREMENT
/begin MEASUREMENT HLSDem_nSetPLo "minimale Motordrehzahl des HLSDem" SWORD EngN 1 100 -16384.00 16383.50 ECU_ADDRESS 0xD0000B7A /end MEASUREMENT
/begin MEASUREMENT HLSDem_nSetPLoChrgPmpOld_mp "" SWORD EngN 1 100 -16384.00 16383.50 ECU_ADDRESS 0xC0009F42 /end MEASUREMENT
/begin MEASUREMENT HLSDem_nSetPLoChrgPmp_mp "" SWORD EngN 1 100 -16384.00 16383.50 ECU_ADDRESS 0xC0009F44 /end MEASUREMENT
/begin MEASUREMENT HLSDem_nSetPLoCoEng "Ausgewählter Temperaturwert für die Berechnung der unteren Solldrehzahl" SWORD EngN 1 100 -16384.00 16383.50 ECU_ADDRESS 0xD0000B7C /end MEASUREMENT
/begin MEASUREMENT HLSDem_nSetPLoCoEngOld_mp "Minimale Leerlaufdrehzahl" SWORD EngN 1 100 -16384.00 16383.50 ECU_ADDRESS 0xC0009F46 /end MEASUREMENT
/begin MEASUREMENT HLSDem_nSetPLoDyn_mp "HLSDem leerlaufdrehzahl" SWORD EngN 1 100 -16384.00 16383.50 ECU_ADDRESS 0xC0009F48 /end MEASUREMENT
/begin MEASUREMENT HLSDem_nSetPLoHDCOld_mp "Minimale Leerlaufdrehzahl" SWORD EngN 1 100 -16384.00 16383.50 ECU_ADDRESS 0xC0009F4A /end MEASUREMENT
/begin MEASUREMENT HLSDem_nSetPLoHDC_mp "Minimale Leerlaufdrehzahl" SWORD EngN 1 100 -16384.00 16383.50 ECU_ADDRESS 0xC0009F4C /end MEASUREMENT
/begin MEASUREMENT HLSDem_nSetPLoLoc0_mp "Ausgewählter Temperaturwert für die Berechnung des geforderten Ausgangsmoment während des Motorstarts" SWORD EngN 1 100 -16384.00 16383.50 ECU_ADDRESS 0xC0009F4E /end MEASUREMENT
/begin MEASUREMENT HLSDem_nSetPLoLoc2 "Ausgewählter Temperaturwert für die Berechnung des geforderten Ausgangsmoment während des Motorstarts" SWORD EngN 1 100 -16384.00 16383.50 ECU_ADDRESS 0xD0000B7E /end MEASUREMENT
/begin MEASUREMENT HLSDem_nSetPLoLocRamp "Koordinierte untere Solldrehzahl" SWORD EngN 1 100 -16384.00 16383.50 ECU_ADDRESS 0xD0000B80 /end MEASUREMENT
/begin MEASUREMENT HLSDem_nSetPLoLocRampOld_mp "Minimale Leerlaufdrehzahl" SWORD EngN 1 100 -16384.00 16383.50 ECU_ADDRESS 0xC0009F50 /end MEASUREMENT
/begin MEASUREMENT HLSDem_nSetPLoOld_mp "Minimale Leerlaufdrehzahl" SWORD EngN 1 100 -16384.00 16383.50 ECU_ADDRESS 0xC0009F52 /end MEASUREMENT
/begin MEASUREMENT HLSDem_nSetPLoPwrMng "minimale Motordrehzahl des HLSDem" SWORD EngN 1 100 -16384.00 16383.50 ECU_ADDRESS 0xD0000B82 /end MEASUREMENT
/begin MEASUREMENT HLSDem_nSetPLoPwrMngOld_mp "Minimale Leerlaufdrehzahl" SWORD EngN 1 100 -16384.00 16383.50 ECU_ADDRESS 0xC0009F54 /end MEASUREMENT
/begin MEASUREMENT HLSDem_nSetPLoSec1_mp "Minimale Leerlaufdrehzahl" SWORD EngN 1 100 -16384.00 16383.50 ECU_ADDRESS 0xC0009F56 /end MEASUREMENT
/begin MEASUREMENT HLSDem_nSetPLoSec2_mp "Minimale Leerlaufdrehzahl" SWORD EngN 1 100 -16384.00 16383.50 ECU_ADDRESS 0xC0009F58 /end MEASUREMENT
/begin MEASUREMENT HLSDem_nSetPLoSec4_mp "Minimale Leerlaufdrehzahl" SWORD EngN 1 100 -16384.00 16383.50 ECU_ADDRESS 0xC0009F5A /end MEASUREMENT
/begin MEASUREMENT HLSDem_nSetPLoStat "" SWORD EngN 1 100 -16384.00 16383.50 ECU_ADDRESS 0xD0000B84 /end MEASUREMENT
/begin MEASUREMENT HLSDem_nSetPLoTemp_mp "untere Leerlaufdrehzahl während der Startphase (t > HLSDem_tiSetPLoWrm)" SWORD EngN 1 100 -16384.00 16383.50 ECU_ADDRESS 0xC0009F5C /end MEASUREMENT
/begin MEASUREMENT HLSDem_nSetPLoTraOld_mp "HLSDem leerlaufdrehzahl" SWORD EngN 1 100 -16384.00 16383.50 ECU_ADDRESS 0xC0009F5E /end MEASUREMENT
/begin MEASUREMENT HLSDem_nSetPLoTra_mp "HLSDem leerlaufdrehzahl" SWORD EngN 1 100 -16384.00 16383.50 ECU_ADDRESS 0xC0009F60 /end MEASUREMENT
/begin MEASUREMENT HLSDem_nSetPLoTrm "Abgleichswert untere Solldrehzahl" SWORD EngN 1 100 -16384.00 16383.50 ECU_ADDRESS 0xD0000B86 /end MEASUREMENT
/begin MEASUREMENT HLSDem_nSetPLoTrm_mp "Abgleich untere Solldrehzahl" SWORD EngN 1 100 -16384.00 16383.50 ECU_ADDRESS 0xC0009F62 /end MEASUREMENT
/begin MEASUREMENT HLSDem_PWinNegHiCurr_mp "Negatives Fenster für P-Glied oberer Pfad" FLOAT32_IEEE EngN_float 1 100 -10000.0000 10000.0000 ECU_ADDRESS 0xC0008F74 /end MEASUREMENT
/begin MEASUREMENT HLSDem_PWinNegLoCurr_mp "Negatives Fenster für P-Glied für unteren Pfad" FLOAT32_IEEE EngN_float 1 100 -10000.0000 10000.0000 ECU_ADDRESS 0xC0008F78 /end MEASUREMENT
/begin MEASUREMENT HLSDem_PWinPosHiCurr_mp "Postives Fenster für P-Glied oberer Pfad" FLOAT32_IEEE EngN_float 1 100 -10000.0000 10000.0000 ECU_ADDRESS 0xC0008F7C /end MEASUREMENT
/begin MEASUREMENT HLSDem_PWinPosLoCurr_mp "Postives Fenster für P-Glied unterer Pfad" FLOAT32_IEEE EngN_float 1 100 -10000.0000 10000.0000 ECU_ADDRESS 0xC0008F80 /end MEASUREMENT
/begin MEASUREMENT HLSDem_rnEngvVehCurr_mp "Verhältnis Motordrehzahl zu Fahrzeuggeschwindigkeit" FLOAT32_IEEE ISC_rnEng2vVeh_float 1 100 0.00 1000.00000 FORMAT "%10.5" ECU_ADDRESS 0xC0008F84 /end MEASUREMENT
/begin MEASUREMENT HLSDem_stActvHDC "Koordinierte maximale Motordrehzahl" UBYTE OneToOne 1 100 0.00 255.0 ECU_ADDRESS 0xD0001E72 /end MEASUREMENT
/begin MEASUREMENT HLSDem_stIDLE "Status Idle" UBYTE OneToOne 1 100 0.00 255.0 ECU_ADDRESS 0xD0001E73 /end MEASUREMENT
/begin MEASUREMENT HLSDem_stSetPHiCo_mp "ausgewählte Drehzahlanforderung für die maximale Motordrehzahl" SWORD HLSDemsSetPHiSel 1 100 1.00000000000 32767.0000000 FORMAT "%13.7" ECU_ADDRESS 0xC0009F64 /end MEASUREMENT
/begin MEASUREMENT HLSDem_stSetPHiFlt_mp "Art der Filterung der maximalen Motordrehzahl" SWORD HLSDemsFltSel 1 100 1.00000000000 32767.0000000 FORMAT "%13.7" ECU_ADDRESS 0xC0009F66 /end MEASUREMENT
/begin MEASUREMENT HLSDem_stSetPLo "Ausgewählte Drehzahlanforderung für die maximale Motordrehzahl" UWORD OneToOne 1 100 0.00 65535.00 ECU_ADDRESS 0xD00015C6 /end MEASUREMENT
/begin MEASUREMENT HLSDem_tiFltLosTrqEstCurr_mp "Zeitkonstante für die Lastmomentabschätzung (PT1-Glieder)" FLOAT32_IEEE ISC_tiPTsTrqLoss_float 1 100 0.00 60.0000000 FORMAT "%10.7" ECU_ADDRESS 0xC0008F88 /end MEASUREMENT
/begin MEASUREMENT HLSDem_tiFltnEngCurr_mp "Zeitkonstante für die PT2-Filterung der Motordrehzahl" FLOAT32_IEEE ISC_tiPT2nEng_float 1 100 0.00 60.0000000 FORMAT "%10.7" ECU_ADDRESS 0xC0008F8C /end MEASUREMENT
/begin MEASUREMENT HLSDem_trqLoLimMax "maximales HLSDem Begrenzungsdrehmoment an den ISC" SWORD Trq 1 100 -3276.800 3276.700 ECU_ADDRESS 0xD0000B88 /end MEASUREMENT
/begin MEASUREMENT HLSDem_trqLoLimMin "minimales HLSDem Begrenzungsdrehmoment an den ISC" SWORD Trq 1 100 -3276.800 3276.700 ECU_ADDRESS 0xD0000B8A /end MEASUREMENT
/begin MEASUREMENT HLSDem_trqReq "Anforderung Initialisierungsdrehmoment an den Drehzahlregler (bezogen auf den Ausgang)" SWORD Trq 1 100 -3276.800 3276.700 ECU_ADDRESS 0xD0000B8C /end MEASUREMENT
/begin MEASUREMENT HLSDem_trqReqStrt "Anforderung Initialisierungsdrehmoment bis zum Startabwurf an den Drehzahlregler (bezogen auf den Ausgang)" SWORD Trq 1 100 -3276.800 3276.700 ECU_ADDRESS 0xD0000B8E /end MEASUREMENT
/begin MEASUREMENT HLSDem_trqReqStrtMSA_mp "Momentanforderung für Start über MSA" SWORD Trq 1 100 -3276.800 3276.700 ECU_ADDRESS 0xC0009F68 /end MEASUREMENT
/begin MEASUREMENT HLSDem_tSetPHi_mp "Ausgewählter Temperaturwert für die Berechnung der Höchstdrehzahl" SWORD Temp_Cels 1 100 -3549.940 3003.560 ECU_ADDRESS 0xC0009F6A /end MEASUREMENT
/begin MEASUREMENT HLSDem_tTrqReqStrt_mp "Ausgewählter Temperaturwert für die Berechnung des geforderten Ausgangsdrehmoment während des Motorstarts" SWORD Temp_Cels 1 100 -3549.940 3003.560 ECU_ADDRESS 0xC0009F6C /end MEASUREMENT
/begin MEASUREMENT HPUn_dvolPmpMaxCor_mp "Wirkungsgrad korrigiertes physikalisches Maximum des Volumenstroms einer Hochdruckpumpe" SWORD Qp_mm3_sec 1 100 -327680.0 327670.0 FORMAT "%8.1" ECU_ADDRESS 0xC0009F6E /end MEASUREMENT
/begin MEASUREMENT HPUn_dvolPmpMax_mp "Physikalisches Maximum des Volumenstroms einer Hochdruckpumpe" SWORD Qp_mm3_sec 1 100 -327680.0 327670.0 FORMAT "%8.1" ECU_ADDRESS 0xC0009F70 /end MEASUREMENT
/begin MEASUREMENT HPUn_etaPmpFlTemp_mp "Kraftstofftemperaturabhängiger Wirkungsgrad der Hochdruckpumpe" SWORD Eta1 1 100 -256.0000 255.9922 FORMAT "%8.4" ECU_ADDRESS 0xC0009F72 /end MEASUREMENT
/begin MEASUREMENT HPUn_etaPmpMaxAged_mp "maximaler Wirkungsgrad einer gealterten Hochdruckpumpe" SWORD Eta1 1 100 -256.0000 255.9922 FORMAT "%8.4" ECU_ADDRESS 0xC0009F74 /end MEASUREMENT
/begin MEASUREMENT HPUn_numInjQntBal "Maximale Anzahl an Einspritzungen aufgrund der Mengenbilanz der Hochdruckpumpe" UBYTE OneToOne 1 100 0.00 255.0 ECU_ADDRESS 0xD0001E74 /end MEASUREMENT
/begin MEASUREMENT HPUn_pRailDvtFlt_mp "Gefilterte Raildruck Regelabweichung" SWORD Pres_Rail 1 100 -3276.800 2000.000 ECU_ADDRESS 0xC0009F76 /end MEASUREMENT
/begin MEASUREMENT HPUn_rTransCrS "Übersetzung Hochdruckpumpe zu Kurbelwelle" SWORD TransR 1 100 -327.6800 327.6700 ECU_ADDRESS 0xD0000B90 /end MEASUREMENT
/begin MEASUREMENT HPUn_stNumInjMax_mp "Statusvariable, Mengebilanz der Hochruckpumpe" UBYTE OneToOne 1 100 0.00 255.0 ECU_ADDRESS 0xC000B1F0 /end MEASUREMENT
/begin MEASUREMENT HPUn_stQntBal_mp "Status der Mengenbilanz der Hochdruckpumpe" UBYTE OneToOne 1 100 0.00 255.0 ECU_ADDRESS 0xC000B1EF /end MEASUREMENT
/begin MEASUREMENT HPUn_trqLoss "Momentanforderung der Hochdruckpumpe" SWORD Trq 1 100 -3276.800 3276.700 ECU_ADDRESS 0xD0000B92 /end MEASUREMENT
/begin MEASUREMENT I15031_PID1C "OBD Anforderungen für welches das Fahrzeug ausgelegt ist" UBYTE OneToOne 1 100 0.00 255.0 ECU_ADDRESS 0xD0001E75 /end MEASUREMENT
/begin MEASUREMENT I15031_PID1D "Ort der Lambda Sonden" UBYTE OneToOne 1 100 0.00 255.0 ECU_ADDRESS 0xD0001E76 /end MEASUREMENT
/begin MEASUREMENT I15031_PID4FA "Konfigurationsinformation des externen Testgeräts. Maximaler Wert des Gleichgewichtsverhältinisses" UBYTE OneToOne 1 100 0.00 255.0 ECU_ADDRESS 0xD0001E77 /end MEASUREMENT
/begin MEASUREMENT I15031_PID4FB "Konfigurationsinformation des externen Testgeräts. Maximaler Wert der Lambda Sensorspannung" UBYTE Volt 1 100 0.00 51.00 ECU_ADDRESS 0xD0001E78 /end MEASUREMENT
/begin MEASUREMENT I15031_PID4FC "Konfigurationsinformation des externen Testgeräts. Maximaler Wert des Lambda Sensorstromes" UBYTE Curr 1 100 0.00 255.0 FORMAT "%5.1" ECU_ADDRESS 0xD0001E79 /end MEASUREMENT
/begin MEASUREMENT I15031_PID4FD "Konfigurationsinformation des externen Testgeräts. Maximaler Wert für Absoluten Saugrohr-Druck" UBYTE Pres 1 100 0.00 255.0 FORMAT "%6.1" ECU_ADDRESS 0xD0001E7A /end MEASUREMENT
/begin MEASUREMENT Ibhwversi "IBS Hardware Version" UBYTE Def_dez_ub_q1 1 100 0.00 255. FORMAT "%3.0" ECU_ADDRESS 0xC000B202 /end MEASUREMENT
/begin MEASUREMENT Ibsbclctri "IBS Fehlerzähler" UBYTE Def_dez_ub_q1 1 100 0.00 255. FORMAT "%3.0" ECU_ADDRESS 0xC000B203 /end MEASUREMENT
/begin MEASUREMENT Ibsborctr "IBS Fehlerzähler" UWORD Def_dez_uw_q1 1 100 0.00 65535. FORMAT "%5.0" ECU_ADDRESS 0xC0009F82 /end MEASUREMENT
/begin MEASUREMENT ibsclr_ctr "Counter fuer IBS Fsp Loeschsignal" UBYTE ident 1 100 0.00 255. FORMAT "%3.0" ECU_ADDRESS 0xC000B204 /end MEASUREMENT
/begin MEASUREMENT Ibsdncsctr "IBS Fehlerzähler download checksum" UBYTE Def_dez_ub_q1 1 100 0.00 255. FORMAT "%3.0" ECU_ADDRESS 0xC000B205 /end MEASUREMENT
/begin MEASUREMENT Ibseromctr "IBS Fehlerzähler" UBYTE Def_dez_ub_q1 1 100 0.00 255. FORMAT "%3.0" ECU_ADDRESS 0xC000B206 /end MEASUREMENT
/begin MEASUREMENT Ibsiicctri "IBS Fehlerzähler" UBYTE Def_dez_ub_q1 1 100 0.00 255. FORMAT "%3.0" ECU_ADDRESS 0xC000B207 /end MEASUREMENT
/begin MEASUREMENT Ibslvdctr "IBS Fehlerzähler" UWORD Def_dez_uw_q1 1 100 0.00 65535. FORMAT "%5.0" ECU_ADDRESS 0xC0009F84 /end MEASUREMENT
/begin MEASUREMENT Ibsl_buffer "ELIN Datenpuffer, bidirektional" UBYTE Def_dez_ub_q1 1 100 0.00 255. FORMAT "%3.0" ARRAY_SIZE 8 ECU_ADDRESS 0xC000BF74 /end MEASUREMENT
/begin MEASUREMENT Ibsl_busy "Priorisierung ELIN Zugriffe" UBYTE ident 1 100 0.00 255. FORMAT "%3.0" ECU_ADDRESS 0xC000B208 /end MEASUREMENT
/begin MEASUREMENT Ibsl_busysave "Priorisierung ELIN Zugriffe" UBYTE ident 1 100 0.00 255. FORMAT "%3.0" ECU_ADDRESS 0xC000B209 /end MEASUREMENT
/begin MEASUREMENT Ibsl_chk "Checksumme von IBS" UWORD Def_dez_uw_q1 1 100 0.00 65535. FORMAT "%5.0" ECU_ADDRESS 0xC0009F86 /end MEASUREMENT
/begin MEASUREMENT Ibsl_message "ibs_ctrl() Rückgabewert, enthält gewünschte Botschaftsnr." UBYTE Def_dez_ub_q1 1 100 0.00 255. FORMAT "%3.0" ECU_ADDRESS 0xC000B20A /end MEASUREMENT
/begin MEASUREMENT Ibsl_msgind "Index auf ELIN Botschaft" UBYTE Def_dez_ub_q1 1 100 0.00 255. FORMAT "%3.0" ECU_ADDRESS 0xC000B20B /end MEASUREMENT
/begin MEASUREMENT Ibsl_msglen "ELIN Botschaft, Anzahl der Objekte" UBYTE Def_dez_ub_q1 1 100 0.00 255. FORMAT "%3.0" ECU_ADDRESS 0xC000B20C /end MEASUREMENT
/begin MEASUREMENT Ibsl_start "Status IBS Startup Kommunikation" UBYTE Def_dez_ub_q1 1 100 0.00 255. FORMAT "%3.0" ECU_ADDRESS 0xC000B20D /end MEASUREMENT
/begin MEASUREMENT Ibsporctr "IBS Fehlerzähler power on" UWORD Def_dez_uw_q1 1 100 0.00 65535. FORMAT "%5.0" ECU_ADDRESS 0xC0009F88 /end MEASUREMENT
/begin MEASUREMENT Ibspromctr "IBS Fehlerzähler" UBYTE Def_dez_ub_q1 1 100 0.00 255. FORMAT "%3.0" ECU_ADDRESS 0xC000B20E /end MEASUREMENT
/begin MEASUREMENT Ibsptyctr "IBS Fehlerzähler BSD parity" UWORD Def_dez_uw_q1 1 100 0.00 65535. FORMAT "%5.0" ECU_ADDRESS 0xC0009F8A /end MEASUREMENT
/begin MEASUREMENT Ibsramctr "IBS Fehlerzähler" UBYTE Def_dez_ub_q1 1 100 0.00 255. FORMAT "%3.0" ECU_ADDRESS 0xC000B20F /end MEASUREMENT
/begin MEASUREMENT Ibstfgkcnt "Perioden Zähler Startfähigkeit -> IBS" UBYTE ident 1 100 0.00 255. FORMAT "%3.0" ECU_ADDRESS 0xC000B210 /end MEASUREMENT
/begin MEASUREMENT Ibswbase "IBS Software Baseline" UBYTE Def_dez_ub_q1 1 100 0.00 255. FORMAT "%3.0" ECU_ADDRESS 0xC000B211 /end MEASUREMENT
/begin MEASUREMENT Ibswchang "IBS Versionierung Reserve" UBYTE Def_dez_ub_q1 1 100 0.00 255. FORMAT "%3.0" ECU_ADDRESS 0xC000B212 /end MEASUREMENT
/begin MEASUREMENT Ibswdtctr "IBS Fehlerzähler watchdog" UWORD Def_dez_uw_q1 1 100 0.00 65535. FORMAT "%5.0" ECU_ADDRESS 0xC0009F8C /end MEASUREMENT
/begin MEASUREMENT Ibs_asic "Seriennummer" ULONG Def_dez_ul_q1 1 100 0.00 4294967295. FORMAT "%7.0" ARRAY_SIZE 2 ECU_ADDRESS 0xC000BF7C /end MEASUREMENT
/begin MEASUREMENT Ibs_B_bsdbsy "" UBYTE OneToOne 1 100 0.00 1.000 BIT_MASK 0x1 ECU_ADDRESS 0xD00003C7 /end MEASUREMENT
/begin MEASUREMENT Ibs_B_bsddo "" UBYTE OneToOne 1 100 0.00 1.000 BIT_MASK 0x1 ECU_ADDRESS 0xD00003C5 /end MEASUREMENT
/begin MEASUREMENT Ibs_B_bsderr "" UBYTE OneToOne 1 100 0.00 1.000 BIT_MASK 0x1 ECU_ADDRESS 0xD00003C0 /end MEASUREMENT
/begin MEASUREMENT Ibs_B_bsdhtok "" UBYTE OneToOne 1 100 0.00 1.000 BIT_MASK 0x4 ECU_ADDRESS 0xD00003B9 /end MEASUREMENT
/begin MEASUREMENT Ibs_B_bsdrxrdy "" UBYTE OneToOne 1 100 0.00 1.000 BIT_MASK 0x1 ECU_ADDRESS 0xD00003BB /end MEASUREMENT
/begin MEASUREMENT Ibs_B_bsdtxok "" UBYTE OneToOne 1 100 0.00 1.000 BIT_MASK 0x1 ECU_ADDRESS 0xD00003C0 /end MEASUREMENT
/begin MEASUREMENT Ibs_B_bsdwrite "" UBYTE OneToOne 1 100 0.00 1.000 BIT_MASK 0x1 ECU_ADDRESS 0xD00003C7 /end MEASUREMENT
/begin MEASUREMENT Ibs_ctrl_chk "Checksumme in DME berechnet" UWORD Def_dez_uw_q1 1 100 0.00 65535. FORMAT "%5.0" ECU_ADDRESS 0xC0009F8E /end MEASUREMENT
/begin MEASUREMENT Ibs_errors "Hier koennte Ihr Langbezeichner stehen" UBYTE ident 1 100 0.00 255. FORMAT "%3.0" ECU_ADDRESS 0xC000B213 /end MEASUREMENT
/begin MEASUREMENT Ibs_ht_bsStat "" UBYTE OneToOne 1 100 0.00 255.0 ECU_ADDRESS 0xD0001F01 /end MEASUREMENT
/begin MEASUREMENT Ibs_ht_ReadTOC "" UBYTE OneToOne 1 100 0.00 255.0 ECU_ADDRESS 0xD0001EFE /end MEASUREMENT
/begin MEASUREMENT Ibs_ht_ResTOC "" UBYTE OneToOne 1 100 0.00 255.0 ECU_ADDRESS 0xD0001EFF /end MEASUREMENT
/begin MEASUREMENT Ibs_ht_SendTOC "" UBYTE OneToOne 1 100 0.00 255.0 ECU_ADDRESS 0xD0001F00 /end MEASUREMENT
/begin MEASUREMENT Ibs_msgind "Wird noch von aepdiag benutzt!!" UBYTE Def_dez_ub_q1 1 100 0.00 255. FORMAT "%3.0" ECU_ADDRESS 0xC000B214 /end MEASUREMENT
/begin MEASUREMENT Ibs_msgsta "Wird noch von aepdiag benutzt!!" UBYTE Def_dez_ub_q1 1 100 0.00 255. FORMAT "%3.0" ECU_ADDRESS 0xC000B215 /end MEASUREMENT
/begin MEASUREMENT Ibs_start "Wird noch von aepdiag benutzt!!" UBYTE Def_dez_ub_q1 1 100 0.00 255. FORMAT "%3.0" ECU_ADDRESS 0xC000B216 /end MEASUREMENT
/begin MEASUREMENT Ibs_stDetOk "" UBYTE OneToOne 1 100 0.00 1.000 BIT_MASK 0x1 ECU_ADDRESS 0xD00003BF /end MEASUREMENT
/begin MEASUREMENT IBS_stIbsActive_mp "" UBYTE OneToOne 1 100 0.00 255.0 ECU_ADDRESS 0xC000B1F1 /end MEASUREMENT
/begin MEASUREMENT IBS_stIbsDet "" UBYTE OneToOne 1 100 0.00 255.0 ECU_ADDRESS 0xD0001E7B /end MEASUREMENT
/begin MEASUREMENT IBS_stIbsDetFin_mp "" UBYTE OneToOne 1 100 0.00 255.0 ECU_ADDRESS 0xC000B1F2 /end MEASUREMENT
/begin MEASUREMENT Ib_parlen "Länge IBS Parameterliste" UBYTE Def_dez_ub_q1 1 100 0.00 255. FORMAT "%3.0" ECU_ADDRESS 0xC000B217 /end MEASUREMENT
/begin MEASUREMENT Ib_reserve "IBS Hardware Version" UBYTE Def_dez_ub_q1 1 100 0.00 255. FORMAT "%3.0" ECU_ADDRESS 0xC000B218 /end MEASUREMENT
/begin MEASUREMENT Igenk "Generatorstrom aufsummiert im Sekundentakt" FLOAT32_IEEE Def_f_r32 1 100 -3.000000000000E+038 3.000000000000E+038 FORMAT "%14.0" ECU_ADDRESS 0xC0008F20 /end MEASUREMENT
/begin MEASUREMENT I_batt "Batteriestrom vom IBS gemessen" UWORD Def_i_uw_q0p08_o200 1 100 -200.0000 5042.800 FORMAT "%8.3" ECU_ADDRESS 0xC0009F90 /end MEASUREMENT
/begin MEASUREMENT I_genm "Hier könnte Ihr Langbezeichner stehen" UBYTE Def_i_ub_q1 1 100 0.00 255.00 ECU_ADDRESS 0xC000B1DC /end MEASUREMENT
/begin MEASUREMENT I_gentest "Hier könnte Ihr Langbezeichner stehen" UBYTE Def_i_ub_q1 1 100 0.00 255.00 ECU_ADDRESS 0xC000B1DD /end MEASUREMENT
/begin MEASUREMENT I_soc0 "Strom bei Ruhespannungsmessung" SWORD Def_i_sw_q0p02 1 100 -655.3600 655.3400 FORMAT "%8.4" ECU_ADDRESS 0xC0009F92 /end MEASUREMENT
/begin MEASUREMENT I_tnstart "Batteriestrom im Start" UWORD Def_i_uw_q0p02 1 100 0.00 1310.700 FORMAT "%8.3" ECU_ADDRESS 0xC0009F94 /end MEASUREMENT
/begin MEASUREMENT I_vorstart "Batteriestrom vor Start" UWORD Def_i_uw_q0p02_o200 1 100 -200.000 1110.70 ECU_ADDRESS 0xC0009F96 /end MEASUREMENT
/begin MEASUREMENT Ktupcsctr "kt_ibs Fehlerzähler EBSD Checksumme" UWORD Def_dez_uw_q1 1 100 0.00 65535. FORMAT "%5.0" ECU_ADDRESS 0xC0009F98 /end MEASUREMENT
/begin MEASUREMENT Qelad "Batterie Entladezähler ueber LIN" UWORD Def_ql_uw_q0p0182 1 100 0.00 1192.750 FORMAT "%8.3" ECU_ADDRESS 0xC0009F9A /end MEASUREMENT
/begin MEASUREMENT Qeladsoc0 "Entladung bei Ruhespannungsmessung" UWORD Def_ql_uw_q0p0182 1 100 0.00 1192.750 FORMAT "%8.3" ECU_ADDRESS 0xC0009F9C /end MEASUREMENT
/begin MEASUREMENT Qlad "Batterie Ladezähler ueber LIN" UWORD Def_ql_uw_q0p0182 1 100 0.00 1192.750 FORMAT "%8.3" ECU_ADDRESS 0xC0009F9E /end MEASUREMENT
/begin MEASUREMENT Qladsoc0 "Ladung bei Ruhespannungsmessung" UWORD Def_ql_uw_q0p0182 1 100 0.00 1192.750 FORMAT "%8.3" ECU_ADDRESS 0xC0009FA0 /end MEASUREMENT
/begin MEASUREMENT Qvary_i "Startauswertung Messwertarray Strom" UWORD Def_i_uw_q0p02 1 100 0.00 1310.700 FORMAT "%8.3" ARRAY_SIZE 32 ECU_ADDRESS 0xC000BF84 /end MEASUREMENT
/begin MEASUREMENT Qvary_u "Startauswertung Messwertarray Spannung" UWORD Def_u_uw_q0p25em3_o6 1 100 6.0000000 22.383750 FORMAT "%9.6" ARRAY_SIZE 32 ECU_ADDRESS 0xC000BFC4 /end MEASUREMENT
/begin MEASUREMENT Qv_nstartval "Anzahl Messwertepaare fuer QV- Algorithmus" UBYTE Def_dez_ub_q1 1 100 0.00 255. FORMAT "%3.0" ECU_ADDRESS 0xC000B219 /end MEASUREMENT
/begin MEASUREMENT Qv_td "Relativ Stunden aus IBS" UWORD Def_th_uw_q1 1 100 0.00 65535. FORMAT "%5.0" ECU_ADDRESS 0xC0009FA2 /end MEASUREMENT
/begin MEASUREMENT Q_iruhe2 "Entlademenge während Zeit mit erhöhtem Ruhestrom" UWORD Def_ql_uw_q0p0182 1 100 0.00 1192.750 FORMAT "%8.3" ECU_ADDRESS 0xC0009FA4 /end MEASUREMENT
/begin MEASUREMENT Snibs "Seriennummer" ULONG Def_dez_ul_q1 1 100 0.00 4294967295. FORMAT "%7.0" ECU_ADDRESS 0xC0008F90 /end MEASUREMENT
/begin MEASUREMENT Startctrlbze "Status BZE Startauswertung" UBYTE ident 1 100 0.00 255. FORMAT "%3.0" ECU_ADDRESS 0xC000B21A /end MEASUREMENT
/begin MEASUREMENT Startctrlpm "Statusvariable Startauswertung PM" UBYTE ident 1 100 0.00 255. FORMAT "%3.0" ECU_ADDRESS 0xC000B21B /end MEASUREMENT
/begin MEASUREMENT St_ecostat2 "Ecos Statusbyte 2" UBYTE Def_st_ub_q1 1 100 0.00 255. FORMAT "%3.0" ECU_ADDRESS 0xC000B21C /end MEASUREMENT
/begin MEASUREMENT St_gentest "Statuswort Testustand" UBYTE Def_st_ub_q1 1 100 0.00 255. FORMAT "%3.0" ECU_ADDRESS 0xC000B1DE /end MEASUREMENT
/begin MEASUREMENT St_ibebsd1 "Statuswort ibebsd1" UBYTE Def_st_ub_q1 1 100 0.00 255. FORMAT "%3.0" ECU_ADDRESS 0xC000B21D /end MEASUREMENT
/begin MEASUREMENT St_ibsctrl "Statuswort" UBYTE Def_st_ub_q1 1 100 0.00 255. FORMAT "%3.0" ECU_ADDRESS 0xC000B21E /end MEASUREMENT
/begin MEASUREMENT St_ibserr "Statuswort" UBYTE Def_st_ub_q1 1 100 0.00 255. FORMAT "%3.0" ECU_ADDRESS 0xC000B21F /end MEASUREMENT
/begin MEASUREMENT St_ibslmix "Statuswort" UBYTE Def_st_ub_q1 1 100 0.00 255. FORMAT "%3.0" ECU_ADDRESS 0xC000B220 /end MEASUREMENT
/begin MEASUREMENT St_ibslshk "Statuswort" UBYTE Def_st_ub_q1 1 100 0.00 255. FORMAT "%3.0" ECU_ADDRESS 0xC000B221 /end MEASUREMENT
/begin MEASUREMENT St_ibsl_envi0 "Umgebungsvariable zum IBS" UBYTE ident 1 100 0.00 255. FORMAT "%3.0" ECU_ADDRESS 0xC000B222 /end MEASUREMENT
/begin MEASUREMENT St_ibsl_envi1 "Umgebungsvariable zum IBS" UBYTE ident 1 100 0.00 255. FORMAT "%3.0" ECU_ADDRESS 0xC000B223 /end MEASUREMENT
/begin MEASUREMENT St_ibsl_envi2 "Umgebungsvariable zum IBS" UBYTE ident 1 100 0.00 255. FORMAT "%3.0" ECU_ADDRESS 0xC000B224 /end MEASUREMENT
/begin MEASUREMENT St_ibsl_envi3 "Umgebungsvariable zum IBS" UBYTE ident 1 100 0.00 255. FORMAT "%3.0" ECU_ADDRESS 0xC000B225 /end MEASUREMENT
/begin MEASUREMENT St_imdgen_nv1 "Statuswort" UBYTE Def_st_ub_q1 1 100 0.00 255. FORMAT "%3.0" ECU_ADDRESS 0xC000B1E1 /end MEASUREMENT
/begin MEASUREMENT St_sleep "Statuswort Einschlafverhalten" UBYTE Def_st_ub_q1 1 100 0.00 255. FORMAT "%3.0" ECU_ADDRESS 0xC000B226 /end MEASUREMENT
/begin MEASUREMENT St_statgeniu "Statuswort Testzustandswert" UBYTE Def_st_ub_q1 1 100 0.00 255. FORMAT "%3.0" ECU_ADDRESS 0xC000B1DF /end MEASUREMENT
/begin MEASUREMENT T1histiruh "Ruhestromhistogramm Klasse 1" UWORD Def_dez_uw_q1 1 100 0.00 65535. FORMAT "%5.0" ECU_ADDRESS 0xC0009FA6 /end MEASUREMENT
/begin MEASUREMENT T2histiruh "Ruhestromhistogramm Klasse 2" UWORD Def_dez_uw_q1 1 100 0.00 65535. FORMAT "%5.0" ECU_ADDRESS 0xC0009FA8 /end MEASUREMENT
/begin MEASUREMENT T3histiruh "Ruhestromhistogramm Klasse 3" UWORD Def_dez_uw_q1 1 100 0.00 65535. FORMAT "%5.0" ECU_ADDRESS 0xC0009FAA /end MEASUREMENT
/begin MEASUREMENT T4histiruh "Ruhestromhistogramm Klasse 4" UWORD Def_dez_uw_q1 1 100 0.00 65535. FORMAT "%5.0" ECU_ADDRESS 0xC0009FAC /end MEASUREMENT
/begin MEASUREMENT Tbatt_maxi "T_batt_max, Rohwert aus IBS" UBYTE Def_dez_ub_q1 1 100 0.00 255. FORMAT "%3.0" ECU_ADDRESS 0xC000B227 /end MEASUREMENT
/begin MEASUREMENT Tbatt_mini "T_batt_min, Rohwert aus IBS" UBYTE Def_dez_ub_q1 1 100 0.00 255. FORMAT "%3.0" ECU_ADDRESS 0xC000B228 /end MEASUREMENT
/begin MEASUREMENT Tbgrd_ibs "Batterietemperatur Gradient letzte Stunde, von Sensor" SBYTE Def_dez_sb_q1 1 100 -128. 127. FORMAT "%3.0" ECU_ADDRESS 0xC000B229 /end MEASUREMENT
/begin MEASUREMENT Tbsta_ibs "Batterietemperatur beim Start, Rohwert vom IBS" UBYTE Def_dez_ub_q1 1 100 0.00 255. FORMAT "%3.0" ECU_ADDRESS 0xC000B22A /end MEASUREMENT
/begin MEASUREMENT T_batt "Batterietemperatur vom IBS gemessen" SWORD Def_t_sw_q0p1 1 100 -3276.8 3276.7 FORMAT "%6.1" ECU_ADDRESS 0xC0009FAE /end MEASUREMENT
/begin MEASUREMENT T_battgradi "Batterietemperatur Gradient" SWORD Def_t_sw_q0p1 1 100 -3276.8 3276.7 FORMAT "%6.1" ECU_ADDRESS 0xC0009FB0 /end MEASUREMENT
/begin MEASUREMENT T_battsoc0 "Batterietemperatur bei Ruhespannungsmessung" SWORD Def_t_sw_q0p1 1 100 -3276.8 3276.7 FORMAT "%6.1" ECU_ADDRESS 0xC0009FB2 /end MEASUREMENT
/begin MEASUREMENT T_battsoci "T_battsoc0, Rohwert aus IBS" UBYTE Def_dez_ub_q1 1 100 0.00 255. FORMAT "%3.0" ECU_ADDRESS 0xC000B22B /end MEASUREMENT
/begin MEASUREMENT T_battsta "Batterietemperatur beim Start" SWORD Def_t_sw_q0p1 1 100 -3276.8 3276.7 FORMAT "%6.1" ECU_ADDRESS 0xC0009FB4 /end MEASUREMENT
/begin MEASUREMENT T_batt_max "Batterietemperatur maximal vom IBS gemessen" SWORD Def_t_sw_q0p1 1 100 -3276.8 3276.7 FORMAT "%6.1" ECU_ADDRESS 0xC0009FB6 /end MEASUREMENT
/begin MEASUREMENT T_batt_min "Batterietemperatur minimal vom IBS gemessen" SWORD Def_t_sw_q0p1 1 100 -3276.8 3276.7 FORMAT "%6.1" ECU_ADDRESS 0xC0009FB8 /end MEASUREMENT
/begin MEASUREMENT T_difsoc0 "AEP neu" SBYTE Def_dez_sb_q1 1 100 -128. 127. FORMAT "%3.0" ECU_ADDRESS 0xC000B22C /end MEASUREMENT
/begin MEASUREMENT T_relibs "Stundenzähler aus IBS, Genauigkeit nicht spezifiziert!" ULONG Def_dez_ul_q1 1 100 0.00 4294967295. FORMAT "%7.0" ECU_ADDRESS 0xC0008F94 /end MEASUREMENT
/begin MEASUREMENT T_relibs32s "IBS Relativzeit" ULONG Def_dez_ul_q1 1 100 0.00 4294967295. FORMAT "%7.0" ECU_ADDRESS 0xC0008F98 /end MEASUREMENT
/begin MEASUREMENT U1soc0 "Ruhespannung 1" UWORD Def_u_uw_q0p25em3_o6 1 100 6.0000000 22.383750 FORMAT "%9.6" ECU_ADDRESS 0xC0009FBA /end MEASUREMENT
/begin MEASUREMENT U1soc0_q "Ruhespannung 1 f. qvc" UWORD Def_u_uw_q0p25em3_o6 1 100 6.0000000 22.383750 FORMAT "%9.6" ECU_ADDRESS 0xC0009FBC /end MEASUREMENT
/begin MEASUREMENT U2soc0 "Ruhespannung 2" UWORD Def_u_uw_q0p25em3_o6 1 100 6.0000000 22.383750 FORMAT "%9.6" ECU_ADDRESS 0xC0009FBE /end MEASUREMENT
/begin MEASUREMENT U2soc0_q "Ruhespannung 2 f. qvc" UWORD Def_u_uw_q0p25em3_o6 1 100 6.0000000 22.383750 FORMAT "%9.6" ECU_ADDRESS 0xC0009FC0 /end MEASUREMENT
/begin MEASUREMENT U3soc0 "Ruhespannung 3" UWORD Def_u_uw_q0p25em3_o6 1 100 6.0000000 22.383750 FORMAT "%9.6" ECU_ADDRESS 0xC0009FC2 /end MEASUREMENT
/begin MEASUREMENT U3soc0_q "Ruhespannung 3 f. qvc" UWORD Def_u_uw_q0p25em3_o6 1 100 6.0000000 22.383750 FORMAT "%9.6" ECU_ADDRESS 0xC0009FC4 /end MEASUREMENT
/begin MEASUREMENT U_batt "Batteriespannung vom IBS gemessen" UWORD Def_u_uw_q0p25em3_o6 1 100 6.0000000 22.383750 FORMAT "%9.6" ECU_ADDRESS 0xC0009FC6 /end MEASUREMENT
/begin MEASUREMENT U_gentest "Hier könnte Ihr Langbezeichner stehen" UWORD Def_u_uw_q0p1 1 100 0.00 6553.500 FORMAT "%8.3" ECU_ADDRESS 0xC0009F0C /end MEASUREMENT
/begin MEASUREMENT U_tnstart "Spannung im Start" UWORD Def_u_uw_q0p25em3_o6 1 100 6.0000000 22.383750 FORMAT "%9.6" ECU_ADDRESS 0xC0009FC8 /end MEASUREMENT
/begin MEASUREMENT U_vorstart "Spannung vor Start" UWORD Def_u_uw_q0p25em3_o6 1 100 6.0000000 22.383750 FORMAT "%9.6" ECU_ADDRESS 0xC0009FCA /end MEASUREMENT
/begin MEASUREMENT Zbibs "Zusbaunummer" ULONG Def_dez_ul_q1 1 100 0.00 4294967295. FORMAT "%7.0" ECU_ADDRESS 0xC0008F9C /end MEASUREMENT
/begin MEASUREMENT Z_cnt "Abbruchzaehler" UWORD Def_td_uw_q0p1 1 100 0.00 6553.5 FORMAT "%6.1" ECU_ADDRESS 0xC0009F0E /end MEASUREMENT
/begin FUNCTION geniutest ""
 /begin DEF_CHARACTERISTIC K_DFSCHWGENTEST K_FILIGEN K_GENITEST_TOL K_GENUTEST_TOL K_TDKFREIGABE K_TDSTATE1 K_TDSTATE2 K_TDSTATE3 K_TDSTATE4 K_UGENTEST1 K_UGENTEST2 K_UGENTEST3 K_UGENTEST4 S_GENTESTANF /end DEF_CHARACTERISTIC
 /begin OUT_MEASUREMENT Genitest_tol Geniutest_ab Geniutest_err Genutest_tol I_genm I_gentest St_gentest St_statgeniu U_gentest Z_cnt /end OUT_MEASUREMENT
/end FUNCTION
/begin FUNCTION gen_fasta "" /begin DEF_CHARACTERISTIC K_NSTSTAT1 K_NSTSTAT2 K_NSTSTAT3 /end DEF_CHARACTERISTIC
 /begin OUT_MEASUREMENT Bszsi Bsztemp Dfdp Dfds Dfmonitor Dfsumme Dfwanzahl Igenk St_imdgen_nv1 /end OUT_MEASUREMENT
/end FUNCTION
/begin FUNCTION GlbDaAdapt_Adapt "" /end FUNCTION
/begin FUNCTION GlbDa_Axispoints "" /end FUNCTION
/begin FUNCTION GlbDa_LoadCalc ""
 /begin DEF_CHARACTERISTIC GlbDa_nLoadActv_C GlbDa_nLoad_C GlbDa_swtRst_C GlbDa_trqLoad_C /end DEF_CHARACTERISTIC
 /begin IN_MEASUREMENT ActMod_trq Epm_nEng SyC_stSub SyC_stSubOld T15_st /end IN_MEASUREMENT
 /begin LOC_MEASUREMENT GlbDa_ctLoadPrimRow0_mp GlbDa_ctLoadPrimRow1_mp GlbDa_ctLoadPrimRow2_mp GlbDa_ctLoadPrimRow3_mp GlbDa_ctLoadPrimRow4_mp GlbDa_ctLoadPrimRow5_mp GlbDa_ctLoadSecRow0_mp GlbDa_ctLoadSecRow1_mp GlbDa_ctLoadSecRow2_mp GlbDa_ctLoadSecRow3_mp GlbDa_ctLoadSecRow4_mp GlbDa_ctLoadSecRow5_mp GlbDa_tiLoadPrim_mp GlbDa_tiLoadSec_mp /end LOC_MEASUREMENT
/end FUNCTION
/begin FUNCTION GlbDa_LSum "" /begin DEF_CHARACTERISTIC GlbDa_facDstCnt_C GlbDa_lDstLim_C /end DEF_CHARACTERISTIC /begin IN_MEASUREMENT CoEng_st GlbDa_vX /end IN_MEASUREMENT /begin OUT_MEASUREMENT GlbDa_lTotDst /end OUT_MEASUREMENT
 /begin LOC_MEASUREMENT GlbDa_lDstSum_mp GlbDa_lTotDstLstStored_mp GlbDa_vXmPerSec_mp /end LOC_MEASUREMENT
/end FUNCTION
/begin FUNCTION GlbDa_SetData ""
 /begin DEF_CHARACTERISTIC GlbDa_aX_C GlbDa_lWhlCirc_C GlbDa_pEnv_C GlbDa_tEnv_C GlbDa_tiFltAX_C GlbDa_tiFltVX_C GlbDa_tIndAir_C GlbDa_vX_C /end DEF_CHARACTERISTIC
 /begin IN_MEASUREMENT Air_tCACDs EnvP_p EnvT_t EnvT_tMod VehV_a VehV_v /end IN_MEASUREMENT
 /begin OUT_MEASUREMENT GlbDa_aX GlbDa_aXFlt GlbDa_lWhlCirc GlbDa_pEnv GlbDa_tEnv GlbDa_tEnvMod GlbDa_tIndAir GlbDa_vX GlbDa_vXFlt /end OUT_MEASUREMENT
/end FUNCTION
/begin FUNCTION GlbDa_TrqDem ""
 /begin DEF_CHARACTERISTIC GlbDa_stIARlsVeh_C GlbDa_stVehLimMin_C GlbDa_trqVehLimMin_C /end DEF_CHARACTERISTIC
 /begin IN_MEASUREMENT CoPT_stIARls CoVeh_trqPrpLimErr CoVM_stIARls Prp_stIARls PT_rTrq PT_stIARls PT_stStabIntv PT_stTraIntv PT_trqLos PT_trqTraPrt SpdGov_st VehMot_stIARls VehMot_stLimDfftl VehMot_stPrpAccPed VehMot_stPrpCrCtl VehMot_stPrpLLim VehMot_stStabIntv VehMot_trqPrtDfftl /end IN_MEASUREMENT
 /begin OUT_MEASUREMENT GlbDa_stIARlsVeh GlbDa_stTrqDem GlbDa_stVehLimMin GlbDa_trqVehLimMin /end OUT_MEASUREMENT
/end FUNCTION
/begin FUNCTION GlwCtl_ActrCtl ""
 /begin DEF_CHARACTERISTIC GlwCtl_nLamp_C GlwCtl_tiLampEng_C GlwCtl_tiLampPAir_CUR GlwCtl_tiLamptClnt_CUR GlwCtl_tiLampUBatt_CUR GlwCtl_tiPSync_C /end DEF_CHARACTERISTIC
 /begin IN_MEASUREMENT BattU_u EnvP_p Epm_nEng GlwCtl_stGlw GlwCtl_stLampEna GlwCtl_tClnt GlwLmp_st /end IN_MEASUREMENT
 /begin LOC_MEASUREMENT GlwCtl_stLampCond_mp GlwCtl_tiLmp_mp /end LOC_MEASUREMENT
/end FUNCTION
/begin FUNCTION GlwCtl_Stm ""
 /begin DEF_CHARACTERISTIC GlwCtl_ctPreGlwErr_C GlwCtl_ctPreGlw_C GlwCtl_nEngPre_C GlwCtl_stHdnPreGlwMsk1_C GlwCtl_stHdnPreGlwMsk2_C GlwCtl_stHdnPreGlwMskT1_C GlwCtl_stLampEnaMsk_C GlwCtl_tDflClnt_C GlwCtl_tEngSel_C GlwCtl_tiDebConvSig_C GlwCtl_tiDebEpmPre_C GlwCtl_tiNoEngSpd_C GlwCtl_tiPre_CUR GlwCtl_tiReady_C GlwCtl_tiStrt_C GlwCtl_tiWaitforTemp_C GlwCtl_tLimHigh_C GlwCtl_tLimLow_C GlwCtl_tStrt_C /end DEF_CHARACTERISTIC
 /begin IN_MEASUREMENT Brk_st Clth_st CoEng_st Com_stDrWghSeat Com_stKeyVld Com_stTRadio Com_swtDrBltb Epm_nEng T15_st T50_st /end IN_MEASUREMENT
 /begin OUT_MEASUREMENT GlwCtl_stGlw GlwCtl_stLampEna GlwCtl_tClnt /end OUT_MEASUREMENT
 /begin LOC_MEASUREMENT GlwCtl_ctPreGlw_mp GlwCtl_stHdnPreGlwOld_mp GlwCtl_stHdnPreGlwTrg_mp GlwCtl_stHdnPreGlw_mp GlwCtl_stLogicCond_mp GlwCtl_tiClnt_mp GlwCtl_tiEngPre_mp GlwCtl_tiPreGlw_mp GlwCtl_tiRdyGlw_mp GlwCtl_tiStrtGlw_mp /end LOC_MEASUREMENT
/end FUNCTION
/begin FUNCTION GlwCtl_tCtl ""
 /begin DEF_CHARACTERISTIC GlwCtl_facGlwEngRunBase_CUR GlwCtl_stAltLoadHigh_C GlwCtl_stAltLoadLow_C GlwCtl_stDesValEOMMsk_CA GlwCtl_stEntlast_1_C GlwCtl_stEntlast_2_C GlwCtl_tAftGlw_MAP GlwCtl_tAirSelCtl_C GlwCtl_tGlwBaseDes_MAP GlwCtl_tGlwEngRunBase_MAP GlwCtl_tGlwEngRunOn_C GlwCtl_tGlwEngRun_CUR GlwCtl_tiGlwOff_C GlwCtl_tiGlwOn_C GlwCtl_tiMaxOnClt_C GlwCtl_tMax_C /end DEF_CHARACTERISTIC
 /begin IN_MEASUREMENT AirSys_tFld AltIO_rAltLoad CoEng_st CoEOM_stOpModeAct CoETS_trqInrCurr EngDa_tEng Epm_nEng GlwCtl_stGlw GlwCtl_tClnt Layer_stRelVal Layer_tChamWll /end IN_MEASUREMENT
 /begin OUT_MEASUREMENT GlwCtl_stGlwState GlwCtl_tGlwPlg /end OUT_MEASUREMENT
 /begin LOC_MEASUREMENT GlwCtl_stGlw_mp GlwCtl_stPwrRgn_mp GlwCtl_tFld_mp /end LOC_MEASUREMENT
/end FUNCTION
/begin FUNCTION glwecu_lin "" /begin DEF_CHARACTERISTIC GlwEcu_numEngTyp_C GlwEcu_swtTempSel_C GlwEcu_tGlwPlgATS_C /end DEF_CHARACTERISTIC
 /begin IN_MEASUREMENT BattU_uSens Com_lSum EngDa_tFld EnvP_p Epm_nEng GlwCtl_tGlwPlg InjCtl_qSetUnBal StSys_st StSys_stStrt /end IN_MEASUREMENT
 /begin OUT_MEASUREMENT GlwEcu_pwrGlow GlwEcu_stCommonFault GlwEcu_stGPCMDiag GlwEcu_stHighresCold GlwEcu_stHighresHot GlwEcu_stHSSOpen GlwEcu_stHSSShort GlwEcu_stInternalFault GlwEcu_stLowresCold GlwEcu_stLowresHot /end OUT_MEASUREMENT
 /begin LOC_MEASUREMENT GlwEcu_lSum_mp GlwEcu_numBattU_mp GlwEcu_numLINnEng_mp GlwEcu_numLINqSet_mp GlwEcu_numLINtEng_mp GlwEcu_numLINtGlwPlg_mp GlwEcu_pAir_mp GlwEcu_stGlowResp_mp GlwEcu_stGPCMConfig_mp GlwEcu_stGPType_mp GlwEcu_stOpenLoad GlwEcu_stShortCircuit GlwEcu_tGlwPlg_mp /end LOC_MEASUREMENT
/end FUNCTION
/begin FUNCTION Gpta "" /end FUNCTION
/begin FUNCTION GSHDem_Axispoints "" /end FUNCTION
/begin FUNCTION GSHDem_SelectParameter ""
 /begin DEF_CHARACTERISTIC GSHDem_CldClthdnAccLim_C GSHDem_CldClthdnDeclLim_C GSHDem_CldClthILo.Ki_C GSHDem_CldClthILo.KiPos_C GSHDem_CldClthILo.KiNeg_C GSHDem_CldClthILo.WinPos_C GSHDem_CldClthILo.WinNeg_C GSHDem_CldClthInrtDrvTrn_C GSHDem_CldClthInrtEng_C GSHDem_CldClthInrtVeh_C GSHDem_CldClthPLo.Kp_C GSHDem_CldClthPLo.KpPos_C GSHDem_CldClthPLo.KpNeg_C GSHDem_CldClthPLo.WinPos_C GSHDem_CldClthPLo.WinNeg_C GSHDem_CldClthrnEngvVeh_C GSHDem_CldClthtiFltLosTrqEst_C GSHDem_CldClthtiFltnEng_C GSHDem_CldSetPLoRmp.SlopePos_C GSHDem_CldSetPLoRmp.SlopeNeg_C GSHDem_nOfsLoIdlSpd_C GSHDem_nSetPHiDfl_C GSHDem_nSetPLoOfs_C GSHDem_numMaxGear_C GSHDem_numTempTrqMax_C GSHDem_numTemp_C GSHDem_rTraGear1_C GSHDem_rTraGear2_C GSHDem_rTraGear3_C GSHDem_rTraGear4_C GSHDem_rTraGear5_C GSHDem_rTraGear6_C GSHDem_swtDeActvISC_C GSHDem_tiHldEngSpd_C GSHDem_trqMax_MAP GSHDem_tTempHysHi_C GSHDem_tTempHysLo_C GSHDem_WrmClthdnAccLim_C GSHDem_WrmClthdnDeclLim_C GSHDem_WrmClthILo.Ki_C GSHDem_WrmClthILo.KiPos_C GSHDem_WrmClthILo.KiNeg_C GSHDem_WrmClthILo.WinPos_C GSHDem_WrmClthILo.WinNeg_C GSHDem_WrmClthInrtDrvTrn_C GSHDem_WrmClthInrtEng_C GSHDem_WrmClthInrtVeh_C GSHDem_WrmClthPLo.Kp_C GSHDem_WrmClthPLo.KpPos_C GSHDem_WrmClthPLo.KpNeg_C GSHDem_WrmClthPLo.WinPos_C GSHDem_WrmClthPLo.WinNeg_C GSHDem_WrmClthrnEngvVeh_C GSHDem_WrmClthtiFltLosTrqEst_C GSHDem_WrmClthtiFltnEng_C GSHDem_WrmSetPLoRmp.SlopePos_C GSHDem_WrmSetPLoRmp.SlopeNeg_C /end DEF_CHARACTERISTIC
 /begin IN_MEASUREMENT Brk_st Clth_st CoEng_st EngDa_tFld Epm_nEng HLSDem_nSetPLo ISC_st ISC_trq PT_rTraGear PT_rTraGear1 PT_rTraGear2 PT_rTraGear3 PT_rTraGear4 PT_rTraGear5 PT_rTraGear6 PT_rTraGearR PT_rTraV2N PT_stTraType Tra_numGear VehV_v /end IN_MEASUREMENT
 /begin OUT_MEASUREMENT GSHDem_nSetPHi GSHDem_nSetPLo GSHDem_trqLoLimMax GSHDem_trqLoLimMin GSHDem_trqReq /end OUT_MEASUREMENT
 /begin LOC_MEASUREMENT GSHDem_nCalcSetPLo_mp GSHDem_numGearPre_mp GSHDem_numGearPst_mp GSHDem_rTraPre_mp GSHDem_rTraPst_mp GSHDem_rVnPre_mp GSHDem_tTrqMax_mp /end LOC_MEASUREMENT
/end FUNCTION
/begin FUNCTION HESrv_Lib "" /begin DEF_CHARACTERISTIC HESrv_swtPOpVis_C HESrv_swtScndFlwActv_C /end DEF_CHARACTERISTIC /begin IN_MEASUREMENT Epm_numCyl /end IN_MEASUREMENT /end FUNCTION
/begin FUNCTION HESrv_MacroDef "" /end FUNCTION
/begin FUNCTION HLSDem_Axispoints "" /end FUNCTION
/begin FUNCTION HLSDem_SelectParameter ""
 /begin DEF_CHARACTERISTIC HLSDem_CldClthILo.Ki_C HLSDem_CldClthILo.KiPos_C HLSDem_CldClthILo.KiNeg_C HLSDem_CldClthILo.WinPos_C HLSDem_CldClthILo.WinNeg_C HLSDem_CldClthPLo.Kp_C HLSDem_CldClthPLo.KpPos_C HLSDem_CldClthPLo.KpNeg_C HLSDem_CldClthPLo.WinPos_C HLSDem_CldClthPLo.WinNeg_C HLSDem_CldClthtiFltLosTrqEst_C HLSDem_CldGearPLo.Kp_C HLSDem_CldGearPLo.KpPos_C HLSDem_CldGearPLo.KpNeg_C HLSDem_CldGearPLo.WinPos_C HLSDem_CldGearPLo.WinNeg_C HLSDem_CldGeartiFltLosTrqEst_C HLSDem_Gear1dnAccLim_C HLSDem_Gear1dnDeclLimBrk_C HLSDem_Gear1dnDeclLim_C HLSDem_Gear1InrtDrvTrn_C HLSDem_Gear1InrtVeh_C HLSDem_Gear1PLo.Kp_C HLSDem_Gear1PLo.KpPos_C HLSDem_Gear1PLo.KpNeg_C HLSDem_Gear1PLo.WinPos_C HLSDem_Gear1PLo.WinNeg_C HLSDem_Gear1rnEngvVeh_C HLSDem_Gear1tiFltLosTrqEst_C HLSDem_Gear1tiFltnEng_C HLSDem_Gear2dnAccLim_C HLSDem_Gear2dnDeclLimBrk_C HLSDem_Gear2dnDeclLim_C HLSDem_Gear2InrtDrvTrn_C HLSDem_Gear2InrtVeh_C HLSDem_Gear2PLo.Kp_C HLSDem_Gear2PLo.KpPos_C HLSDem_Gear2PLo.KpNeg_C HLSDem_Gear2PLo.WinPos_C HLSDem_Gear2PLo.WinNeg_C HLSDem_Gear2rnEngvVeh_C HLSDem_Gear2tiFltLosTrqEst_C HLSDem_Gear2tiFltnEng_C HLSDem_Gear3dnAccLim_C HLSDem_Gear3dnDeclLimBrk_C HLSDem_Gear3dnDeclLim_C HLSDem_Gear3InrtDrvTrn_C HLSDem_Gear3InrtVeh_C HLSDem_Gear3PLo.Kp_C HLSDem_Gear3PLo.KpPos_C HLSDem_Gear3PLo.KpNeg_C HLSDem_Gear3PLo.WinPos_C HLSDem_Gear3PLo.WinNeg_C HLSDem_Gear3rnEngvVeh_C HLSDem_Gear3tiFltLosTrqEst_C HLSDem_Gear3tiFltnEng_C HLSDem_Gear4dnAccLim_C HLSDem_Gear4dnDeclLimBrk_C HLSDem_Gear4dnDeclLim_C HLSDem_Gear4InrtDrvTrn_C HLSDem_Gear4InrtVeh_C HLSDem_Gear4PLo.Kp_C HLSDem_Gear4PLo.KpPos_C HLSDem_Gear4PLo.KpNeg_C HLSDem_Gear4PLo.WinPos_C HLSDem_Gear4PLo.WinNeg_C HLSDem_Gear4rnEngvVeh_C HLSDem_Gear4tiFltLosTrqEst_C HLSDem_Gear4tiFltnEng_C HLSDem_Gear5dnAccLim_C HLSDem_Gear5dnDeclLimBrk_C HLSDem_Gear5dnDeclLim_C HLSDem_Gear5InrtDrvTrn_C HLSDem_Gear5InrtVeh_C HLSDem_Gear5PLo.Kp_C HLSDem_Gear5PLo.KpPos_C HLSDem_Gear5PLo.KpNeg_C HLSDem_Gear5PLo.WinPos_C HLSDem_Gear5PLo.WinNeg_C HLSDem_Gear5rnEngvVeh_C HLSDem_Gear5tiFltLosTrqEst_C HLSDem_Gear5tiFltnEng_C HLSDem_Gear6dnAccLim_C HLSDem_Gear6dnDeclLimBrk_C HLSDem_Gear6dnDeclLim_C HLSDem_Gear6InrtDrvTrn_C HLSDem_Gear6InrtVeh_C HLSDem_Gear6PLo.Kp_C HLSDem_Gear6PLo.KpPos_C HLSDem_Gear6PLo.KpNeg_C HLSDem_Gear6PLo.WinPos_C HLSDem_Gear6PLo.WinNeg_C HLSDem_Gear6rnEngvVeh_C HLSDem_Gear6tiFltLosTrqEst_C HLSDem_Gear6tiFltnEng_C HLSDem_Gear7dnAccLim_C HLSDem_Gear7dnDeclLimBrk_C HLSDem_Gear7dnDeclLim_C HLSDem_Gear7InrtDrvTrn_C HLSDem_Gear7InrtVeh_C HLSDem_Gear7PLo.Kp_C HLSDem_Gear7PLo.KpPos_C HLSDem_Gear7PLo.KpNeg_C HLSDem_Gear7PLo.WinPos_C HLSDem_Gear7PLo.WinNeg_C HLSDem_Gear7rnEngvVeh_C HLSDem_Gear7tiFltLosTrqEst_C HLSDem_Gear7tiFltnEng_C HLSDem_GearILo.Ki_C HLSDem_GearILo.KiPos_C HLSDem_GearILo.KiNeg_C HLSDem_GearILo.WinPos_C HLSDem_GearILo.WinNeg_C HLSDem_InrtEng_C HLSDem_nOfsUndrBrk_C HLSDem_numCfgISC_C HLSDem_numTemp_C HLSDem_stMskTrqConv_C HLSDem_stParSetRevGear_C HLSDem_TrqConvdnAccLim_C HLSDem_TrqConvdnDeclLimBrk_C HLSDem_TrqConvdnDeclLim_C HLSDem_TrqConvPLo.Kp_C HLSDem_TrqConvPLo.KpPos_C HLSDem_TrqConvPLo.KpNeg_C HLSDem_TrqConvPLo.WinPos_C HLSDem_TrqConvPLo.WinNeg_C HLSDem_TrqConvtiFltLosTrqEst_C HLSDem_TrqConvtiFltnEng_C HLSDem_tTempHysHi_C HLSDem_tTempHysLo_C HLSDem_UndrBrkPLo.Kp_C HLSDem_UndrBrkPLo.KpPos_C HLSDem_UndrBrkPLo.KpNeg_C HLSDem_UndrBrkPLo.WinPos_C HLSDem_UndrBrkPLo.WinNeg_C HLSDem_vThresUndrBrk_C HLSDem_WrmClthdnAccLim_C HLSDem_WrmClthdnDeclLimBrk_C HLSDem_WrmClthdnDeclLim_C HLSDem_WrmClthILo.Ki_C HLSDem_WrmClthILo.KiPos_C HLSDem_WrmClthILo.KiNeg_C HLSDem_WrmClthILo.WinPos_C HLSDem_WrmClthILo.WinNeg_C HLSDem_WrmClthInrtDrvTrn_C HLSDem_WrmClthInrtVeh_C HLSDem_WrmClthPLo.Kp_C HLSDem_WrmClthPLo.KpPos_C HLSDem_WrmClthPLo.KpNeg_C HLSDem_WrmClthPLo.WinPos_C HLSDem_WrmClthPLo.WinNeg_C HLSDem_WrmClthrnEngvVeh_C HLSDem_WrmClthtiFltLosTrqEst_C HLSDem_WrmClthtiFltnEng_C /end DEF_CHARACTERISTIC
 /begin IN_MEASUREMENT Brk_st Clth_st CoEng_st EngDa_tFld Epm_nEng HLSDem_nSetPLo HLSDem_trqReqStrt ISC_st PT_stGrip PT_stTraType Tra_numGear VehV_v /end IN_MEASUREMENT
 /begin OUT_MEASUREMENT HLSDem_trqLoLimMax HLSDem_trqLoLimMin HLSDem_trqReq /end OUT_MEASUREMENT
 /begin LOC_MEASUREMENT HLSDem_dnAccLimCurr_mp HLSDem_dnDeclLimCurr_mp HLSDem_InrtDrvTrnCurr_mp HLSDem_InrtEngCurr_mp HLSDem_InrtVehCurr_mp HLSDem_IWinNegLoCurr_mp HLSDem_IWinPosLoCurr_mp HLSDem_KiLoCurr_mp HLSDem_KiNegLoCurr_mp HLSDem_KiPosLoCurr_mp HLSDem_KpHiCurr_mp HLSDem_KpLoCurr_mp HLSDem_KpNegHiCurr_mp HLSDem_KpNegLoCurr_mp HLSDem_KpPosHiCurr_mp HLSDem_KpPosLoCurr_mp HLSDem_PWinNegHiCurr_mp HLSDem_PWinNegLoCurr_mp HLSDem_PWinPosHiCurr_mp HLSDem_PWinPosLoCurr_mp HLSDem_rnEngvVehCurr_mp HLSDem_tiFltLosTrqEstCurr_mp HLSDem_tiFltnEngCurr_mp /end LOC_MEASUREMENT
/end FUNCTION
/begin FUNCTION HLSDem_Setpoint ""
 /begin DEF_CHARACTERISTIC HLSDem_dnSetPLoLimHiTrm_C HLSDem_dnSetPLoLimLoTrm_C HLSDem_nDeltaSec_C HLSDem_nDiffDelta_C HLSDem_nHDC_C HLSDem_nLimHiOfs_C HLSDem_nLimHi_C HLSDem_nLLOfsNeg_C HLSDem_nLLOfsPos_C HLSDem_nRmpBaseDwn_C HLSDem_nRmpBaseUp_C HLSDem_nRmpChrgPmpDwn_C HLSDem_nRmpChrgPmpUp_C HLSDem_nRmpCoEngDwn_C HLSDem_nRmpCoEngUp_C HLSDem_nRmpHDCDwn_C HLSDem_nRmpHDCUp_C HLSDem_nRmpPwrMngDwn_C HLSDem_nRmpPwrMngUp_C HLSDem_nRmpSecDelta_C HLSDem_nRmpTraDwn_C HLSDem_nRmpTraUp_C HLSDem_nSetPHi_MAP HLSDem_nSetPLoDia_C HLSDem_nSetPLoDrvAwy_C HLSDem_nSetPLoInit2_MAP HLSDem_nSetPLoInit_MAP HLSDem_nSetPLoTrm_C HLSDem_nSetPLoWrm_C HLSDem_numTempSetPHi_C HLSDem_numTempTrqReqStrt_C HLSDem_rAppMax_C HLSDem_RmpCutOut.SlopePos_C HLSDem_RmpCutOut.SlopeNeg_C HLSDem_SetPHiRmp.SlopePos_C HLSDem_SetPHiRmp.SlopeNeg_C HLSDem_stActvHDC_C HLSDem_stRlsHDC_C HLSDem_swtDisblVehIfc_C HLSDem_swtGear_C HLSDem_tiDelayStEng_C HLSDem_tiDelCutOut_C HLSDem_tiTW_C HLSDem_trqReqStrtMSA_MAP HLSDem_trqReqStrt_MAP /end DEF_CHARACTERISTIC
 /begin IN_MEASUREMENT APP_r CEngDsT_t Com_stHDC Com_stMSAStart EnvP_p Epm_nEng ISC_trqLoLtd ISC_trqLossFlt PT_rTrq TCPrt_nSetPointChrgPmp Tra_nMin Tra_numGear /end IN_MEASUREMENT
 /begin OUT_MEASUREMENT HLSDem_nMaxTrq HLSDem_nSetPHi HLSDem_nSetPLo HLSDem_nSetPLoCoEng HLSDem_nSetPLoLoc2 HLSDem_nSetPLoLocRamp HLSDem_nSetPLoPwrMng HLSDem_nSetPLoStat HLSDem_nSetPLoTrm HLSDem_stActvHDC HLSDem_stIDLE HLSDem_stSetPLo HLSDem_trqReqStrt /end OUT_MEASUREMENT
 /begin LOC_MEASUREMENT HLSDem_nDiffDelta_mp HLSDem_nHDC_mp HLSDem_nSetPHiCo_mp HLSDem_nSetPLoChrgPmpOld_mp HLSDem_nSetPLoChrgPmp_mp HLSDem_nSetPLoCoEngOld_mp HLSDem_nSetPLoDyn_mp HLSDem_nSetPLoHDCOld_mp HLSDem_nSetPLoHDC_mp HLSDem_nSetPLoLoc0_mp HLSDem_nSetPLoLocRampOld_mp HLSDem_nSetPLoOld_mp HLSDem_nSetPLoPwrMngOld_mp HLSDem_nSetPLoSec1_mp HLSDem_nSetPLoSec2_mp HLSDem_nSetPLoSec4_mp HLSDem_nSetPLoTemp_mp HLSDem_nSetPLoTraOld_mp HLSDem_nSetPLoTra_mp HLSDem_nSetPLoTrm_mp HLSDem_stSetPHiCo_mp HLSDem_stSetPHiFlt_mp HLSDem_trqReqStrtMSA_mp HLSDem_tSetPHi_mp HLSDem_tTrqReqStrt_mp /end LOC_MEASUREMENT
 /begin SUB_FUNCTION HLSDem_Setpoint /end SUB_FUNCTION
/end FUNCTION
/begin FUNCTION HPUn_Co ""
 /begin DEF_CHARACTERISTIC HPUn_dvolMeUnMax_C HPUn_etaPmpFlTemp_CUR HPUn_etaPmpMaxAged_CUR HPUn_etaPmpMech_C HPUn_nMin_C HPUn_rTransCrS_C HPUn_volPmp_C /end DEF_CHARACTERISTIC
 /begin IN_MEASUREMENT Epm_nEng FuelT_tFlSys InjCrv_numInjMaxSys MeUn_dvolSet RailP_pFlt Rail_dvolEstAged Rail_pDvt Rail_stCtlLoop /end IN_MEASUREMENT
 /begin OUT_MEASUREMENT HPUn_numInjQntBal HPUn_trqLoss /end OUT_MEASUREMENT
 /begin LOC_MEASUREMENT HPUn_dvolPmpMaxCor_mp HPUn_dvolPmpMax_mp HPUn_etaPmpFlTemp_mp HPUn_etaPmpMaxAged_mp HPUn_rTransCrS HPUn_stQntBal_mp /end LOC_MEASUREMENT
/end FUNCTION
/begin FUNCTION HPUn_QntBalInjLim ""
 /begin DEF_CHARACTERISTIC HPUn_numInjMin_C HPUn_pRailDvtOk_C HPUn_tiPresDvtFlt_C HPUn_tiQntBalDel_C /end DEF_CHARACTERISTIC
 /begin LOC_MEASUREMENT HPUn_pRailDvtFlt_mp HPUn_stNumInjMax_mp /end LOC_MEASUREMENT
/end FUNCTION
/begin FUNCTION I14229appl_Ifc ""
 /begin IN_MEASUREMENT AirSys_stSysTst Epm_nEng FBC_stActive FlSys_stRefDeflateTst /end IN_MEASUREMENT
/end FUNCTION
/begin FUNCTION I14229appl_ROE "" /begin IN_MEASUREMENT Com_ctrSecInt /end IN_MEASUREMENT /end FUNCTION
/begin FUNCTION I14229Appl_Std "" /begin IN_MEASUREMENT Com_stTRadio SyC_stSub /end IN_MEASUREMENT /end FUNCTION
/begin FUNCTION I14229_atp "" /end FUNCTION
/begin FUNCTION I14229_Cc "" /end FUNCTION
/begin FUNCTION I14229_cdi "" /end FUNCTION
/begin FUNCTION I14229_Cdtc "" /end FUNCTION
/begin FUNCTION I14229_dddi "" /end FUNCTION
/begin FUNCTION I14229_Dsc "" /end FUNCTION
/begin FUNCTION I14229_Iocbi "" /end FUNCTION
/begin FUNCTION I14229_Lc "" /end FUNCTION
/begin FUNCTION I14229_RC "" /end FUNCTION
/begin FUNCTION I14229_rdbi "" /end FUNCTION
/begin FUNCTION I14229_Rdpi "" /end FUNCTION
/begin FUNCTION I14229_rdtc "" /end FUNCTION
/begin FUNCTION I14229_Reset "" /end FUNCTION
/begin FUNCTION I14229_rmba "" /end FUNCTION
/begin FUNCTION I14229_roe "" /end FUNCTION
/begin FUNCTION I14229_seca "" /end FUNCTION
/begin FUNCTION I14229_Tpr "" /end FUNCTION
/begin FUNCTION I14229_Wdbi "" /end FUNCTION
/begin FUNCTION I14229_wmba "" /end FUNCTION
/begin FUNCTION I14230Appl_Std "" /begin IN_MEASUREMENT Epm_nEng FBC_stActive FlSys_stRefDeflateTst /end IN_MEASUREMENT /end FUNCTION
/begin FUNCTION I14230_Atp "" /end FUNCTION
/begin FUNCTION I14230_CDI "" /end FUNCTION
/begin FUNCTION I14230_Ddli "" /end FUNCTION
/begin FUNCTION I14230_EsCo "" /end FUNCTION
/begin FUNCTION I14230_ioli "" /end FUNCTION
/begin FUNCTION I14230_Rdli "" /end FUNCTION
/begin FUNCTION I14230_Rdtcbs "" /end FUNCTION
/begin FUNCTION I14230_reid "" /end FUNCTION
/begin FUNCTION I14230_Reset "" /end FUNCTION
/begin FUNCTION I14230_Rffd "" /end FUNCTION
/begin FUNCTION I14230_Rmba "" /end FUNCTION
/begin FUNCTION I14230_rrbli "" /end FUNCTION
/begin FUNCTION I14230_Rsodtc "" /end FUNCTION
/begin FUNCTION I14230_seca "" /end FUNCTION
/begin FUNCTION I14230_SpCo "" /end FUNCTION
/begin FUNCTION I14230_SpDS "" /end FUNCTION
/begin FUNCTION I14230_sprbli "" /end FUNCTION
/begin FUNCTION I14230_StCo "" /end FUNCTION
/begin FUNCTION I14230_StDS "" /end FUNCTION
/begin FUNCTION I14230_strbli "" /end FUNCTION
/begin FUNCTION I14230_Td "" /end FUNCTION
/begin FUNCTION I14230_Tpr "" /end FUNCTION
/begin FUNCTION I14230_Wdbi "" /end FUNCTION
/begin FUNCTION I14230_Wmba "" /end FUNCTION
/begin FUNCTION I15031_srv1 "" /end FUNCTION
/begin FUNCTION I15031_srv2 "" /begin DEF_CHARACTERISTIC I15031_stSrv02SuppPid_CA /end DEF_CHARACTERISTIC /end FUNCTION
/begin FUNCTION I15031_srv37 "" /end FUNCTION
/begin FUNCTION I15031_srv4 "" /end FUNCTION
/begin FUNCTION I15031_srv6 "" /end FUNCTION
/begin FUNCTION I15031_srv9 ""
 /begin DEF_CHARACTERISTIC I15031_PID1C_C I15031_PID1D_C I15031_PID4FA_C I15031_PID4FB_C I15031_PID4FC_C I15031_PID4FD_C I15031_srv9PIDTable.PID0_C I15031_srv9PIDTable.PID1_C I15031_srv9PIDTable.PID2_C I15031_srv9PIDTable.PID3_C I15031_srv9PIDTable.PID4_C I15031_srv9PIDTable.PID5_C I15031_srv9PIDTable.PID6_C I15031_srv9PIDTable.PID7_C I15031_srv9PIDTable.PID8_C /end DEF_CHARACTERISTIC
 /begin OUT_MEASUREMENT I15031_PID1C I15031_PID1D I15031_PID4FA I15031_PID4FB I15031_PID4FC I15031_PID4FD /end OUT_MEASUREMENT
/end FUNCTION
/begin FUNCTION Ibs_Adapt "" /begin DEF_CHARACTERISTIC IBS_tiDetPeriode_C IBS_tiWaitDetection_C /end DEF_CHARACTERISTIC /begin IN_MEASUREMENT CoEng_st CoEng_stOld SyC_stSub /end IN_MEASUREMENT /begin OUT_MEASUREMENT IBS_stIbsDet /end OUT_MEASUREMENT
 /begin LOC_MEASUREMENT Ibs_B_bsdbsy Ibs_B_bsddo Ibs_B_bsderr Ibs_B_bsdhtok Ibs_B_bsdrxrdy Ibs_B_bsdtxok Ibs_B_bsdwrite Ibs_stDetOk IBS_stIbsActive_mp IBS_stIbsDetFin_mp /end LOC_MEASUREMENT
/end FUNCTION
/begin FUNCTION ibs_ctrl ""
 /begin DEF_CHARACTERISTIC ECOPOLDLY K_BZE_IMAX K_BZE_IMIN K_BZE_TSMPL K_DI1000DT K_DI1000STG K_DI1000TGRZ K_DI200DT K_DI200STG K_DIHIGHGRZ K_DILOWGRZ K_DIPL7 K_DKL15FIL K_DTMAXGRZI K_DUIGRZ K_DUMINTGRZ K_DUREFMAX K_DUREFMINI K_ECOMAXI K_ELINTEST K_ELINTEST2 K_ELIN_INDEX K_ELIN_REPDLY K_ELIN_REPGRENZ K_ELIN_REPINCERR K_ELIN_REPINCOK K_ELIN_TSTERA K_ENAIBSCTRL K_ENAIBSCTRL2 K_ENISOC0 K_ENUSOC0 K_IBSRES_1 K_IBSRES_11 K_IBSRES_2 K_IBSRES_3 K_IBSRES_4 K_IBSRES_5 K_IBSRES_6 K_IBSRES_7 K_IBSRES_9 K_IBSTFGKCNT K_IBSVERSION K_IRISCHWELL K_IRQSCHWELL K_ISLEEPGRZ K_ISTARTTRIG K_SLEEPWAIT K_S_CLERRIBS K_T1SCHWELLE K_T1SOC0 K_T2SCHWELLE K_T2SOC0 K_T3SCHWELLE K_T3SOC0 K_TIBSERR K_TIBSL1 K_TMPCOM_DIV K_TMPCOM_MUL K_TNUSTART K_TNUSTARTFL K_TPT1TICO K_TSLEEPRUH K_TSTECOS K_T_CLERRIBS K_T_IRDIAG K_T_UTIEFSET K_UTIEFAPP /end DEF_CHARACTERISTIC
 /begin OUT_MEASUREMENT Bze_reserve1 Chk16_ibs Comcontrol D_qsfg1sav D_qsfg2sav Ecoctrl Ecopolctr Eco_jobstat1 Eco_result1 Elbufind Elin_buffer Elin_error Elin_ind Elin_numbyt Elin_numfram Elin_numobj Elin_repcount Elin_repdelctr Elin_stat Elin_waitcount Fsclctr Ibhwversi Ibsbclctri Ibsborctr ibsclr_ctr Ibsdncsctr Ibseromctr Ibsiicctri Ibslvdctr Ibsl_buffer Ibsl_busy Ibsl_busysave Ibsl_chk Ibsl_message Ibsl_msgind Ibsl_msglen Ibsl_start Ibsporctr Ibspromctr Ibsptyctr Ibsramctr Ibstfgkcnt Ibswbase Ibswchang Ibswdtctr Ibs_asic Ibs_ctrl_chk Ibs_errors Ibs_msgind Ibs_msgsta Ibs_start Ib_parlen Ib_reserve I_batt I_soc0 I_tnstart I_vorstart Ktupcsctr Qelad Qeladsoc0 Qlad Qladsoc0 Qvary_i Qvary_u Qv_nstartval Qv_td Q_iruhe2 Snibs Startctrlbze Startctrlpm St_ecostat2 St_ibebsd1 St_ibsctrl St_ibserr St_ibslmix St_ibslshk St_ibsl_envi0 St_ibsl_envi1 St_ibsl_envi2 St_ibsl_envi3 St_sleep T1histiruh T2histiruh T3histiruh T4histiruh Tbatt_maxi Tbatt_mini Tbgrd_ibs Tbsta_ibs T_batt T_battgradi T_battsoc0 T_battsoci T_battsta T_batt_max T_batt_min T_difsoc0 T_relibs T_relibs32s U1soc0 U1soc0_q U2soc0 U2soc0_q U3soc0 U3soc0_q U_batt U_tnstart U_vorstart Zbibs /end OUT_MEASUREMENT
/end FUNCTION
/begin FUNCTION Ibs_DD "" /begin DEF_CHARACTERISTIC Ibs_ctRst_C /end DEF_CHARACTERISTIC /begin LOC_MEASUREMENT Ibs_ht_bsStat Ibs_ht_ReadTOC Ibs_ht_ResTOC Ibs_ht_SendTOC /end LOC_MEASUREMENT /end FUNCTION
/begin FUNCTION IfxFlash "" /end FUNCTION
/begin FUNCTION IgnLck_SetData "" /begin IN_MEASUREMENT T15_st T50_st /end IN_MEASUREMENT /begin OUT_MEASUREMENT CoVeh_stIgnLckTerm15 CoVeh_stIgnLckTerm50 /end OUT_MEASUREMENT /end FUNCTION
/begin COMPU_METHOD Acc "" RAT_FUNC "%6.5" "m/s^2" COEFFS 0 1000 0 0 0 1 /end COMPU_METHOD
/begin COMPU_METHOD Capacity_PA "" RAT_FUNC "%6.5" "uF" COEFFS 0 1000 0 0 0 1 /end COMPU_METHOD
/begin COMPU_METHOD CASTYP_SY_Compu "" TAB_VERB "%6.3" "" COMPU_TAB_REF CASTYP_SY_Compu /end COMPU_METHOD
/begin COMPU_VTAB CASTYP_SY_Compu "" TAB_VERB 5 0 "0" 1 "1" 2 "2" 3 "3" 4 "4" /end COMPU_VTAB
/begin COMPU_METHOD Curr "" RAT_FUNC "%6.2" "mA" COEFFS 0 1 0 0 0 1 /end COMPU_METHOD
/begin COMPU_METHOD Def_dez_sb_q1 "" RAT_FUNC "%3.1" "-" COEFFS 0 1 0 0 0 1 /end COMPU_METHOD
/begin COMPU_METHOD Def_dez_sw_q1 "" RAT_FUNC "%5.2" "-" COEFFS 0 1 0 0 0 1 /end COMPU_METHOD
/begin COMPU_METHOD Def_dez_ub_q1 "" RAT_FUNC "%3.1" "-" COEFFS 0 1 0 0 0 1 /end COMPU_METHOD
/begin COMPU_METHOD Def_dez_ul_q1 "" RAT_FUNC "%7.3" "-" COEFFS 0 1 0 0 0 1 /end COMPU_METHOD
/begin COMPU_METHOD Def_dez_uw_q1 "" RAT_FUNC "%5.2" "-" COEFFS 0 1 0 0 0 1 /end COMPU_METHOD
/begin COMPU_METHOD Def_f_r32 "" RAT_FUNC "%14.6" "-" COEFFS 0 1 0 0 0 1 /end COMPU_METHOD
/begin COMPU_METHOD Def_f_ub_b1 "" RAT_FUNC "%6.4" "-" COEFFS 0 256 0 0 0 1 /end COMPU_METHOD
/begin COMPU_METHOD Def_f_ub_b100 "" RAT_FUNC "%5.2" "%" COEFFS 0 2.56 0 0 0 1 /end COMPU_METHOD
/begin COMPU_METHOD Def_i_sw_q0p02 "" RAT_FUNC "%8.5" "A" COEFFS 0 50 0 0 0 1 /end COMPU_METHOD
/begin COMPU_METHOD Def_i_ub_q0p00125 "" RAT_FUNC "%6.4" "" COEFFS 0 800 0 0 0 1 /end COMPU_METHOD
/begin COMPU_METHOD Def_i_ub_q0p02 "" RAT_FUNC "%5.3" "A" COEFFS 0 50 0 0 0 1 /end COMPU_METHOD
/begin COMPU_METHOD Def_i_ub_q0p04 "" RAT_FUNC "%5.3" "A" COEFFS 0 25 0 0 0 1 /end COMPU_METHOD
/begin COMPU_METHOD Def_i_ub_q0p08 "" RAT_FUNC "%5.3" "A" COEFFS 0 12.5 0 0 0 1 /end COMPU_METHOD
/begin COMPU_METHOD Def_i_ub_q1 "" RAT_FUNC "%6.2" "" COEFFS 0 1 0 0 0 1 /end COMPU_METHOD
/begin COMPU_METHOD Def_i_ub_q5p12 "" RAT_FUNC "%5.2" "" COEFFS 0 0.1953125 0 0 0 1 /end COMPU_METHOD
/begin COMPU_METHOD Def_i_uw_q0p00125 "" RAT_FUNC "%9.6" "A" COEFFS 0 800 0 0 0 1 /end COMPU_METHOD
/begin COMPU_METHOD Def_i_uw_q0p02 "" RAT_FUNC "%8.5" "A" COEFFS 0 50 0 0 0 1 /end COMPU_METHOD
/begin COMPU_METHOD Def_i_uw_q0p02_o200 "" RAT_FUNC "%7.2" "A" COEFFS 0 50 10000 0 0 1 /end COMPU_METHOD
/begin COMPU_METHOD Def_i_uw_q0p08_o200 "" RAT_FUNC "%8.2" "" COEFFS 0 12.5 2500 0 0 1 /end COMPU_METHOD
/begin COMPU_METHOD Def_n_sw_q1p0 "" RAT_FUNC "%5.2" "Upm" COEFFS 0 1 0 0 0 1 /end COMPU_METHOD
/begin COMPU_METHOD Def_ql_ub_q0p0728 "" RAT_FUNC "%5.3" "Ah" COEFFS 0 13.736 0 0 0 1 /end COMPU_METHOD
/begin COMPU_METHOD Def_ql_uw_q0p0182 "" RAT_FUNC "%8.5" "Ah" COEFFS 0 54.9444444444444 0 0 0 1 /end COMPU_METHOD
/begin COMPU_METHOD Def_st_ub_q1 "" RAT_FUNC "%3.1" "-" COEFFS 0 1 0 0 0 1 /end COMPU_METHOD
/begin COMPU_METHOD Def_td_ub_b1280 "" RAT_FUNC "%4.1" "ms" COEFFS 0 0.2 0 0 0 1 /end COMPU_METHOD
/begin COMPU_METHOD Def_td_ub_q0p002_o01 "" RAT_FUNC "%6.4" "s" COEFFS 0 500 -5 0 0 1 /end COMPU_METHOD
/begin COMPU_METHOD Def_td_ub_q0p00625 "" RAT_FUNC "%7.5" "s" COEFFS 0 160 0 0 0 1 /end COMPU_METHOD
/begin COMPU_METHOD Def_td_ub_q0p0125 "" RAT_FUNC "%5.3" "s" COEFFS 0 80 0 0 0 1 /end COMPU_METHOD
/begin COMPU_METHOD Def_td_ub_q0p05 "" RAT_FUNC "%5.3" "s" COEFFS 0 20 0 0 0 1 /end COMPU_METHOD
/begin COMPU_METHOD Def_td_ub_q0p1 "" RAT_FUNC "%4.2" "s" COEFFS 0 10 0 0 0 1 /end COMPU_METHOD
/begin COMPU_METHOD Def_td_ub_q1 "" RAT_FUNC "%5.2" "s" COEFFS 0 1 0 0 0 1 /end COMPU_METHOD
/begin COMPU_METHOD Def_td_ub_q16 "" RAT_FUNC "%5.1" "s" COEFFS 0 0.0625 0 0 0 1 /end COMPU_METHOD
/begin COMPU_METHOD Def_td_ub_q256 "" RAT_FUNC "%5.0" "s" COEFFS 0 0.00390625 0 0 0 1 /end COMPU_METHOD
/begin COMPU_METHOD Def_td_uw_q0p05 "" RAT_FUNC "%7.4" "s" COEFFS 0 20 0 0 0 1 /end COMPU_METHOD
/begin COMPU_METHOD Def_td_uw_q0p1 "" RAT_FUNC "%6.3" "s" COEFFS 0 10 0 0 0 1 /end COMPU_METHOD
/begin COMPU_METHOD Def_th_uw_q1 "" RAT_FUNC "%5.2" "h" COEFFS 0 1 0 0 0 1 /end COMPU_METHOD
/begin COMPU_METHOD Def_t_sw_q0p1 "" RAT_FUNC "%6.3" "°C" COEFFS 0 10 0 0 0 1 /end COMPU_METHOD
/begin COMPU_METHOD Def_u_ub_q0p0196 "" RAT_FUNC "%7.4" "V" COEFFS 0 51.0204081632653 0 0 0 1 /end COMPU_METHOD
/begin COMPU_METHOD Def_u_ub_q0p064_o6 "" RAT_FUNC "%5.2" "V" COEFFS 0 15.625 -93.75 0 0 1 /end COMPU_METHOD
/begin COMPU_METHOD Def_u_uw_q0p1 "" RAT_FUNC "%8.4" "V" COEFFS 0 10 0 0 0 1 /end COMPU_METHOD
/begin COMPU_METHOD Def_u_uw_q0p25em3_o6 "" RAT_FUNC "%9.5" "" COEFFS 0 4000 -24000 0 0 1 /end COMPU_METHOD
/begin COMPU_METHOD dn_dZfine "" RAT_FUNC "%6.3" "rpm/s" COEFFS 0 2 0 0 0 1 /end COMPU_METHOD
/begin COMPU_METHOD EngN "" RAT_FUNC "%5.1" "rpm" COEFFS 0 2 0 0 0 1 /end COMPU_METHOD
/begin COMPU_METHOD EngN_float "" RAT_FUNC "%4.0" "rpm" COEFFS 0 1 0 0 0 1 /end COMPU_METHOD
/begin COMPU_METHOD EngTempFldSel "" TAB_VERB "%6.3" "" COMPU_TAB_REF EngTempFldSel /end COMPU_METHOD
/begin COMPU_VTAB EngTempFldSel "" TAB_VERB 4 0 "Coolant_Temperature" 1 "Oil_Temperature" 2 "EngDa_tEng" 3 "Chamberwall_Temperature" /end COMPU_VTAB
/begin COMPU_METHOD Eta1 "" RAT_FUNC "%6.4" "-" COEFFS 0 128 0 0 0 1 /end COMPU_METHOD
/begin COMPU_METHOD Fact "" RAT_FUNC "%6.5" "-" COEFFS 0 8192 0 0 0 1 /end COMPU_METHOD
/begin COMPU_METHOD HESrv_SwtPOpVis "" TAB_VERB "%6.3" "" COMPU_TAB_REF HESrv_SwtPOpVis /end COMPU_METHOD
/begin COMPU_VTAB HESrv_SwtPOpVis "" TAB_VERB 2 0 "Bank 1" 1 "Bank 2" /end COMPU_VTAB
/begin COMPU_METHOD HLSDemsFltSel "verbale Umrechnungsformel, Auswahl Art der Drehzahlfilterung" TAB_VERB "%6.3" "" COMPU_TAB_REF HLSDemsFltSel /end COMPU_METHOD
/begin COMPU_VTAB HLSDemsFltSel "verbale Umrechnungsformel, Auswahl Art der Drehzahlfilterung" TAB_VERB 4 1 "tipin" 2 "filtered" 3 "unfiltered" 32767 "ramp" /end COMPU_VTAB
/begin COMPU_METHOD HLSDemsSetPHiSel "verbale Umrechnungsformel Funktionsnamen der aktuellen Maximaldrehzahl" TAB_VERB "%6.3" "" COMPU_TAB_REF HLSDemsSetPHiSel /end COMPU_METHOD
/begin COMPU_VTAB HLSDemsSetPHiSel "verbale Umrechnungsformel Funktionsnamen der aktuellen Maximaldrehzahl" TAB_VERB 4 1 "CoPT_nMaxAcs" 2 "CoPT_nMaxTra" 3 "CoPT_nMaxSysErr" 32767 "other" /end COMPU_VTAB
/begin COMPU_METHOD I15031_PID1CVerb "" TAB_VERB "%6.3" "-" COMPU_TAB_REF I15031_PID1CVerb /end COMPU_METHOD
/begin COMPU_VTAB I15031_PID1CVerb "" TAB_VERB 13 1 "OBD II" 2 "OBD" 3 "OBD and OBD II" 4 "OBD I" 5 "No OBD" 6 "EOBD" 7 "EOBD and OBD II" 8 "EOBD and OBD" 9 "EOBD, OBD and OBD II" 10 "JOBD" 11 "JOBD and OBD II" 12 "JOBD and EOBD" 13 "JOBD, EOBD and OBD II" /end COMPU_VTAB
/begin COMPU_METHOD ident "" RAT_FUNC "%3.1" "-" COEFFS 0 1 0 0 0 1 /end COMPU_METHOD
/begin COMPU_METHOD Identity "" RAT_FUNC "%3.1" "-" COEFFS 0 1 0 0 0 1 /end COMPU_METHOD
/begin COMPU_METHOD ISC_dnEng_float "Umrechnung für die Drehzahlbeschleunigung (Float Implementierung)" RAT_FUNC "%6.2" "rpm/s" COEFFS 0 1 0 0 0 1 /end COMPU_METHOD
/begin COMPU_METHOD ISC_Inirtia_float "Umrechnung für Massenträgheitsmoment (Float Implementierung)" RAT_FUNC "%6.2" "Nm/(rpm/s)" COEFFS 0 1 0 0 0 1 /end COMPU_METHOD
/begin COMPU_METHOD ISC_Ki_rpm2Nm_float "Umrechnung für Verstärkung I-Anteil (Float Implementierung)" RAT_FUNC "%6.2" "Nm/(rpm*s)" COEFFS 0 1 0 0 0 1 /end COMPU_METHOD
/begin COMPU_METHOD ISC_Kp_rpm2Nm_float "Umrechnung für Verstärkung P-Anteil (Float Implementierung)" RAT_FUNC "%6.2" "Nm/rpm" COEFFS 0 1 0 0 0 1 /end COMPU_METHOD
/begin COMPU_METHOD ISC_rnEng2vVeh_float "Umrechnung für das Verhältnis Motordrehzahl zu Fahrzeuggeschwindigkeit (Float Implementierung)" RAT_FUNC "%6.2" "rpm/(Km/h)" COEFFS 0 1 0 0 0 1 /end COMPU_METHOD
/begin COMPU_METHOD ISC_tiPT2nEng_float "Umrechnung für Zeitkonstante der PT2-Filterung der Motordrehzahl (Float Implementierung)" RAT_FUNC "%6.2" "s" COEFFS 0 1 0 0 0 1 /end COMPU_METHOD
/begin COMPU_METHOD ISC_tiPTsTrqLoss_float "Umrechnung für die Zeitkonstante für die Filterung bei der Lastmomentabschätzung (Float Implementierung)" RAT_FUNC "%6.2" "s" COEFFS 0 1 0 0 0 1 /end COMPU_METHOD
/begin COMPU_METHOD Length "" RAT_FUNC "%6.2" "m" COEFFS 0 1 0 0 0 1 /end COMPU_METHOD
/begin COMPU_METHOD Length_fine "" RAT_FUNC "%6.5" "m" COEFFS 0 1000 0 0 0 1 /end COMPU_METHOD
/begin COMPU_METHOD OneToOne "" RAT_FUNC "%6.0" "-" COEFFS 0 1 0 0 0 1 /end COMPU_METHOD
/begin COMPU_METHOD PmpQnt "" RAT_FUNC "%6.3" "mm^3/rev" COEFFS 0 10 0 0 0 1 /end COMPU_METHOD
/begin COMPU_METHOD Prc "" RAT_FUNC "%6.4" "%" COEFFS 0 81.92 0 0 0 1 /end COMPU_METHOD
/begin COMPU_METHOD Pres "" RAT_FUNC "%7.2" "hPa" COEFFS 0 1.000000 0 0 0 1 /end COMPU_METHOD
/begin COMPU_METHOD Pres_hPa "" RAT_FUNC "%5.1" "hPa" COEFFS 0 1 0 0 0 1 /end COMPU_METHOD
/begin COMPU_METHOD Pres_Rail "" RAT_FUNC "%5.1" "bar" COEFFS 0 10.000000 0 0 0 1 /end COMPU_METHOD
/begin COMPU_METHOD Pwr_HiRes "" RAT_FUNC "%6.2" "W" COEFFS 0 1 0 0 0 1 /end COMPU_METHOD
/begin COMPU_METHOD Qp_mm3_sec "" RAT_FUNC "%6.1" "mm3/s" COEFFS 0 0.1 0 0 0 1 /end COMPU_METHOD
/begin COMPU_METHOD RmpEngN "" RAT_FUNC "%6.4" "rpm/s" COEFFS 0 131.072 0 0 0 1 /end COMPU_METHOD
/begin COMPU_METHOD Temp_Cels "" RAT_FUNC "%5.1" "deg C" COEFFS 0 10 2731.4 0 0 1 /end COMPU_METHOD
/begin COMPU_METHOD TimeDeb "" RAT_FUNC "%5.0" "ms" COEFFS 0 0.1 0 0 0 1 /end COMPU_METHOD
/begin COMPU_METHOD TimeDelay_s "" RAT_FUNC "%12.4" "s" COEFFS 0 0 1 0 0.00023283064365387 0 /end COMPU_METHOD
/begin COMPU_METHOD Time_ms "" RAT_FUNC "%5.0" "ms" COEFFS 0 0.1 0 0 0 1 /end COMPU_METHOD
/begin COMPU_METHOD Time_s "" RAT_FUNC "%5.2" "s" COEFFS 0 100 0 0 0 1 /end COMPU_METHOD
/begin COMPU_METHOD TransR "" RAT_FUNC "%4.2" "-" COEFFS 0 100 0 0 0 1 /end COMPU_METHOD
/begin COMPU_METHOD Trq "" RAT_FUNC "%5.1" "Nm" COEFFS 0 10 0 0 0 1 /end COMPU_METHOD
/begin COMPU_METHOD Vel "" RAT_FUNC "%5.2" "km/h" COEFFS 0 100 0 0 0 1 /end COMPU_METHOD
/begin COMPU_METHOD VelToN "" RAT_FUNC "%8.7" "(km/h)/rpm" COEFFS 0 100000 0 0 0 1 /end COMPU_METHOD
/begin COMPU_METHOD Vel_SI "" RAT_FUNC "%6.4" "m/s" COEFFS 0 360 0 0 0 1 /end COMPU_METHOD
/begin COMPU_METHOD Volt "" RAT_FUNC "%6.1" "mV" COEFFS 0 5 0 0 0 1 /end COMPU_METHOD
/begin COMPU_METHOD Volt_Batt "" RAT_FUNC "%5.0" "mV" COEFFS 0 0.05 0 0 0 1 /end COMPU_METHOD
/begin RECORD_LAYOUT Cur_Xs16Ws16 NO_AXIS_PTS_X 1 SWORD AXIS_PTS_X 2 SWORD INDEX_INCR DIRECT FNC_VALUES 3 SWORD COLUMN_DIR DIRECT /end RECORD_LAYOUT
/begin RECORD_LAYOUT Kf_Xs16_Ys16_Ws16 NO_AXIS_PTS_X 1 SWORD NO_AXIS_PTS_Y 2 SWORD AXIS_PTS_X 3 SWORD INDEX_INCR DIRECT AXIS_PTS_Y 4 SWORD INDEX_INCR DIRECT FNC_VALUES 5 SWORD COLUMN_DIR DIRECT /end RECORD_LAYOUT
/begin RECORD_LAYOUT Kwb_Ws16 FNC_VALUES 1 SWORD COLUMN_DIR DIRECT /end RECORD_LAYOUT
/begin RECORD_LAYOUT Kw_Ws16 FNC_VALUES 1 SWORD COLUMN_DIR DIRECT /end RECORD_LAYOUT
/begin RECORD_LAYOUT Kw_Wu16 FNC_VALUES 1 UWORD COLUMN_DIR DIRECT /end RECORD_LAYOUT
/begin RECORD_LAYOUT Kw_Wu8 FNC_VALUES 1 UBYTE COLUMN_DIR DIRECT /end RECORD_LAYOUT
/begin RECORD_LAYOUT Map_Xs16Ys16Ws16 NO_AXIS_PTS_X 1 SWORD NO_AXIS_PTS_Y 2 SWORD AXIS_PTS_X 3 SWORD INDEX_INCR DIRECT AXIS_PTS_Y 4 SWORD INDEX_INCR DIRECT FNC_VALUES 5 SWORD COLUMN_DIR DIRECT /end RECORD_LAYOUT
/begin RECORD_LAYOUT ValA_Wu8 FNC_VALUES 1 UBYTE COLUMN_DIR DIRECT /end RECORD_LAYOUT
/begin RECORD_LAYOUT Val_Wr32 FNC_VALUES 1 FLOAT32_IEEE COLUMN_DIR DIRECT /end RECORD_LAYOUT
/begin RECORD_LAYOUT Val_Ws16 FNC_VALUES 1 SWORD COLUMN_DIR DIRECT /end RECORD_LAYOUT
/begin RECORD_LAYOUT Val_Ws32 FNC_VALUES 1 SLONG COLUMN_DIR DIRECT /end RECORD_LAYOUT
/begin RECORD_LAYOUT Val_Ws8 FNC_VALUES 1 SBYTE COLUMN_DIR DIRECT /end RECORD_LAYOUT
/begin RECORD_LAYOUT Val_Wu16 FNC_VALUES 1 UWORD COLUMN_DIR DIRECT /end RECORD_LAYOUT
/begin RECORD_LAYOUT Val_Wu32 FNC_VALUES 1 ULONG COLUMN_DIR DIRECT /end RECORD_LAYOUT
/begin RECORD_LAYOUT Val_Wu8 FNC_VALUES 1 UBYTE COLUMN_DIR DIRECT /end RECORD_LAYOUT
/end MODULE
/end PROJECT

ASAP2_VERSION 1 4
/begin PROJECT P_574 "EDC17_CP09"
/begin HEADER "" VERSION "V8KB" PROJECT_NO P_574 /end HEADER
/begin MODULE DIM ""
/begin MOD_COMMON "" BYTE_ORDER MSB_LAST ALIGNMENT_BYTE 1 ALIGNMENT_WORD 2 ALIGNMENT_LONG 4 ALIGNMENT_FLOAT32_IEEE 4 /end MOD_COMMON
/begin MEASUREMENT Dfds04 "Sekundärkennfeld FASTA Generatorauslastung" UBYTE Def_st_ub_q1 1 100 0.00 255. FORMAT "%3.0" ECU_ADDRESS 0xC000BE60 /end MEASUREMENT
/begin MEASUREMENT Dfds05 "Sekundärkennfeld FASTA Generatorauslastung" UBYTE Def_st_ub_q1 1 100 0.00 255. FORMAT "%3.0" ECU_ADDRESS 0xC000BE61 /end MEASUREMENT
/begin MEASUREMENT Dfds06 "Sekundärkennfeld FASTA Generatorauslastung" UBYTE Def_st_ub_q1 1 100 0.00 255. FORMAT "%3.0" ECU_ADDRESS 0xC000BE62 /end MEASUREMENT
/begin MEASUREMENT Dfds07 "Sekundärkennfeld FASTA Generatorauslastung" UBYTE Def_st_ub_q1 1 100 0.00 255. FORMAT "%3.0" ECU_ADDRESS 0xC000BE63 /end MEASUREMENT
/begin MEASUREMENT Dfds08 "Sekundärkennfeld FASTA Generatorauslastung" UBYTE Def_st_ub_q1 1 100 0.00 255. FORMAT "%3.0" ECU_ADDRESS 0xC000BE64 /end MEASUREMENT
/begin MEASUREMENT Dfds09 "Sekundärkennfeld FASTA Generatorauslastung" UBYTE Def_st_ub_q1 1 100 0.00 255. FORMAT "%3.0" ECU_ADDRESS 0xC000BE65 /end MEASUREMENT
/begin MEASUREMENT Dfds10 "Sekundärkennfeld FASTA Generatorauslastung" UBYTE Def_st_ub_q1 1 100 0.00 255. FORMAT "%3.0" ECU_ADDRESS 0xC000BE66 /end MEASUREMENT
/begin MEASUREMENT Dfds11 "Sekundärkennfeld FASTA Generatorauslastung" UBYTE Def_st_ub_q1 1 100 0.00 255. FORMAT "%3.0" ECU_ADDRESS 0xC000BE67 /end MEASUREMENT
/begin MEASUREMENT Dfds12 "Sekundärkennfeld FASTA Generatorauslastung" UBYTE Def_st_ub_q1 1 100 0.00 255. FORMAT "%3.0" ECU_ADDRESS 0xC000BE68 /end MEASUREMENT
/begin MEASUREMENT Dfds13 "Sekundärkennfeld FASTA Generatorauslastung" UBYTE Def_st_ub_q1 1 100 0.00 255. FORMAT "%3.0" ECU_ADDRESS 0xC000BE69 /end MEASUREMENT
/begin MEASUREMENT Dfds14 "Sekundärkennfeld FASTA Generatorauslastung" UBYTE Def_st_ub_q1 1 100 0.00 255. FORMAT "%3.0" ECU_ADDRESS 0xC000BE6A /end MEASUREMENT
/begin MEASUREMENT Dfds15 "Sekundärkennfeld FASTA Generatorauslastung" UBYTE Def_st_ub_q1 1 100 0.00 255. FORMAT "%3.0" ECU_ADDRESS 0xC000BE6B /end MEASUREMENT
/begin MEASUREMENT DFES_ctDef00 "Fehlerzähler (FLC) aller Fehlerspeichereinträge" UBYTE DFES_OneToOne 1 100 0.00 255.0 ECU_ADDRESS 0xD0008CB6 /end MEASUREMENT
/begin MEASUREMENT DFES_ctDef01 "Fehlerzähler (FLC) aller Fehlerspeichereinträge" UBYTE DFES_OneToOne 1 100 0.00 255.0 ECU_ADDRESS 0xD0008CB7 /end MEASUREMENT
/begin MEASUREMENT DFES_ctDef02 "Fehlerzähler (FLC) aller Fehlerspeichereinträge" UBYTE DFES_OneToOne 1 100 0.00 255.0 ECU_ADDRESS 0xD0008CB8 /end MEASUREMENT
/begin MEASUREMENT DFES_ctDef03 "Fehlerzähler (FLC) aller Fehlerspeichereinträge" UBYTE DFES_OneToOne 1 100 0.00 255.0 ECU_ADDRESS 0xD0008CB9 /end MEASUREMENT
/begin MEASUREMENT DFES_ctDef04 "Fehlerzähler (FLC) aller Fehlerspeichereinträge" UBYTE DFES_OneToOne 1 100 0.00 255.0 ECU_ADDRESS 0xD0008CBA /end MEASUREMENT
/begin MEASUREMENT DFES_ctDef05 "Fehlerzähler (FLC) aller Fehlerspeichereinträge" UBYTE DFES_OneToOne 1 100 0.00 255.0 ECU_ADDRESS 0xD0008CBB /end MEASUREMENT
/begin MEASUREMENT DFES_ctDef06 "Fehlerzähler (FLC) aller Fehlerspeichereinträge" UBYTE DFES_OneToOne 1 100 0.00 255.0 ECU_ADDRESS 0xD0008CBC /end MEASUREMENT
/begin MEASUREMENT DFES_ctDef07 "Fehlerzähler (FLC) aller Fehlerspeichereinträge" UBYTE DFES_OneToOne 1 100 0.00 255.0 ECU_ADDRESS 0xD0008CBD /end MEASUREMENT
/begin MEASUREMENT DFES_ctDef08 "Fehlerzähler (FLC) aller Fehlerspeichereinträge" UBYTE DFES_OneToOne 1 100 0.00 255.0 ECU_ADDRESS 0xD0008CBE /end MEASUREMENT
/begin MEASUREMENT DFES_ctDef09 "Fehlerzähler (FLC) aller Fehlerspeichereinträge" UBYTE DFES_OneToOne 1 100 0.00 255.0 ECU_ADDRESS 0xD0008CBF /end MEASUREMENT
/begin MEASUREMENT DFES_ctDef10 "Fehlerzähler (FLC) aller Fehlerspeichereinträge" UBYTE DFES_OneToOne 1 100 0.00 255.0 ECU_ADDRESS 0xD0008CC0 /end MEASUREMENT
/begin MEASUREMENT DFES_ctDef11 "Fehlerzähler (FLC) aller Fehlerspeichereinträge" UBYTE DFES_OneToOne 1 100 0.00 255.0 ECU_ADDRESS 0xD0008CC1 /end MEASUREMENT
/begin MEASUREMENT DFES_ctDef12 "Fehlerzähler (FLC) aller Fehlerspeichereinträge" UBYTE DFES_OneToOne 1 100 0.00 255.0 ECU_ADDRESS 0xD0008CC2 /end MEASUREMENT
/begin MEASUREMENT DFES_ctDef13 "Fehlerzähler (FLC) aller Fehlerspeichereinträge" UBYTE DFES_OneToOne 1 100 0.00 255.0 ECU_ADDRESS 0xD0008CC3 /end MEASUREMENT
/begin MEASUREMENT DFES_ctDef14 "Fehlerzähler (FLC) aller Fehlerspeichereinträge" UBYTE DFES_OneToOne 1 100 0.00 255.0 ECU_ADDRESS 0xD0008CC4 /end MEASUREMENT
/begin MEASUREMENT DFES_ctDef15 "Fehlerzähler (FLC) aller Fehlerspeichereinträge" UBYTE DFES_OneToOne 1 100 0.00 255.0 ECU_ADDRESS 0xD0008CC5 /end MEASUREMENT
/begin MEASUREMENT DFES_ctDef16 "Fehlerzähler (FLC) aller Fehlerspeichereinträge" UBYTE DFES_OneToOne 1 100 0.00 255.0 ECU_ADDRESS 0xD0008CC6 /end MEASUREMENT
/begin MEASUREMENT DFES_ctDef17 "Fehlerzähler (FLC) aller Fehlerspeichereinträge" UBYTE DFES_OneToOne 1 100 0.00 255.0 ECU_ADDRESS 0xD0008CC7 /end MEASUREMENT
/begin MEASUREMENT DFES_ctDef18 "Fehlerzähler (FLC) aller Fehlerspeichereinträge" UBYTE DFES_OneToOne 1 100 0.00 255.0 ECU_ADDRESS 0xD0008CC8 /end MEASUREMENT
/begin MEASUREMENT DFES_ctDef19 "Fehlerzähler (FLC) aller Fehlerspeichereinträge" UBYTE DFES_OneToOne 1 100 0.00 255.0 ECU_ADDRESS 0xD0008CC9 /end MEASUREMENT
/begin MEASUREMENT DFES_ctDel00 "Löschzähler (DLC) aller Fehlerspeichereinträge" UBYTE DFES_OneToOne 1 100 0.00 255.0 ECU_ADDRESS 0xD0008D06 /end MEASUREMENT
/begin MEASUREMENT DFES_ctDel01 "Löschzähler (DLC) aller Fehlerspeichereinträge" UBYTE DFES_OneToOne 1 100 0.00 255.0 ECU_ADDRESS 0xD0008D07 /end MEASUREMENT
/begin MEASUREMENT DFES_ctDel02 "Löschzähler (DLC) aller Fehlerspeichereinträge" UBYTE DFES_OneToOne 1 100 0.00 255.0 ECU_ADDRESS 0xD0008D08 /end MEASUREMENT
/begin MEASUREMENT DFES_ctDel03 "Löschzähler (DLC) aller Fehlerspeichereinträge" UBYTE DFES_OneToOne 1 100 0.00 255.0 ECU_ADDRESS 0xD0008D09 /end MEASUREMENT
/begin MEASUREMENT DFES_ctDel04 "Löschzähler (DLC) aller Fehlerspeichereinträge" UBYTE DFES_OneToOne 1 100 0.00 255.0 ECU_ADDRESS 0xD0008D0A /end MEASUREMENT
/begin MEASUREMENT DFES_ctDel05 "Löschzähler (DLC) aller Fehlerspeichereinträge" UBYTE DFES_OneToOne 1 100 0.00 255.0 ECU_ADDRESS 0xD0008D0B /end MEASUREMENT
/begin MEASUREMENT DFES_ctDel06 "Löschzähler (DLC) aller Fehlerspeichereinträge" UBYTE DFES_OneToOne 1 100 0.00 255.0 ECU_ADDRESS 0xD0008D0C /end MEASUREMENT
/begin MEASUREMENT DFES_ctDel07 "Löschzähler (DLC) aller Fehlerspeichereinträge" UBYTE DFES_OneToOne 1 100 0.00 255.0 ECU_ADDRESS 0xD0008D0D /end MEASUREMENT
/begin MEASUREMENT DFES_ctDel08 "Löschzähler (DLC) aller Fehlerspeichereinträge" UBYTE DFES_OneToOne 1 100 0.00 255.0 ECU_ADDRESS 0xD0008D0E /end MEASUREMENT
/begin MEASUREMENT DFES_ctDel09 "Löschzähler (DLC) aller Fehlerspeichereinträge" UBYTE DFES_OneToOne 1 100 0.00 255.0 ECU_ADDRESS 0xD0008D0F /end MEASUREMENT
/begin MEASUREMENT DFES_ctDel10 "Löschzähler (DLC) aller Fehlerspeichereinträge" UBYTE DFES_OneToOne 1 100 0.00 255.0 ECU_ADDRESS 0xD0008D10 /end MEASUREMENT
/begin MEASUREMENT DFES_ctDel11 "Löschzähler (DLC) aller Fehlerspeichereinträge" UBYTE DFES_OneToOne 1 100 0.00 255.0 ECU_ADDRESS 0xD0008D11 /end MEASUREMENT
/begin MEASUREMENT DFES_ctDel12 "Löschzähler (DLC) aller Fehlerspeichereinträge" UBYTE DFES_OneToOne 1 100 0.00 255.0 ECU_ADDRESS 0xD0008D12 /end MEASUREMENT
/begin MEASUREMENT DFES_ctDel13 "Löschzähler (DLC) aller Fehlerspeichereinträge" UBYTE DFES_OneToOne 1 100 0.00 255.0 ECU_ADDRESS 0xD0008D13 /end MEASUREMENT
/begin MEASUREMENT DFES_ctDel14 "Löschzähler (DLC) aller Fehlerspeichereinträge" UBYTE DFES_OneToOne 1 100 0.00 255.0 ECU_ADDRESS 0xD0008D14 /end MEASUREMENT
/begin MEASUREMENT DFES_ctDel15 "Löschzähler (DLC) aller Fehlerspeichereinträge" UBYTE DFES_OneToOne 1 100 0.00 255.0 ECU_ADDRESS 0xD0008D15 /end MEASUREMENT
/begin MEASUREMENT DFES_ctDel16 "Löschzähler (DLC) aller Fehlerspeichereinträge" UBYTE DFES_OneToOne 1 100 0.00 255.0 ECU_ADDRESS 0xD0008D16 /end MEASUREMENT
/begin MEASUREMENT DFES_ctDel17 "Löschzähler (DLC) aller Fehlerspeichereinträge" UBYTE DFES_OneToOne 1 100 0.00 255.0 ECU_ADDRESS 0xD0008D17 /end MEASUREMENT
/begin MEASUREMENT DFES_ctDel18 "Löschzähler (DLC) aller Fehlerspeichereinträge" UBYTE DFES_OneToOne 1 100 0.00 255.0 ECU_ADDRESS 0xD0008D18 /end MEASUREMENT
/begin MEASUREMENT DFES_ctDel19 "Löschzähler (DLC) aller Fehlerspeichereinträge" UBYTE DFES_OneToOne 1 100 0.00 255.0 ECU_ADDRESS 0xD0008D19 /end MEASUREMENT
/begin MEASUREMENT DFES_ctFrq00 "Häufigkeitszähler aller Fehlerspeichereinträge" UBYTE DFES_OneToOne 1 100 0.00 255.0 ECU_ADDRESS 0xD0008D1A /end MEASUREMENT
/begin MEASUREMENT DFES_ctFrq01 "Häufigkeitszähler aller Fehlerspeichereinträge" UBYTE DFES_OneToOne 1 100 0.00 255.0 ECU_ADDRESS 0xD0008D1B /end MEASUREMENT
/begin MEASUREMENT DFES_ctFrq02 "Häufigkeitszähler aller Fehlerspeichereinträge" UBYTE DFES_OneToOne 1 100 0.00 255.0 ECU_ADDRESS 0xD0008D1C /end MEASUREMENT
/begin MEASUREMENT DFES_ctFrq03 "Häufigkeitszähler aller Fehlerspeichereinträge" UBYTE DFES_OneToOne 1 100 0.00 255.0 ECU_ADDRESS 0xD0008D1D /end MEASUREMENT
/begin MEASUREMENT DFES_ctFrq04 "Häufigkeitszähler aller Fehlerspeichereinträge" UBYTE DFES_OneToOne 1 100 0.00 255.0 ECU_ADDRESS 0xD0008D1E /end MEASUREMENT
/begin MEASUREMENT DFES_ctFrq05 "Häufigkeitszähler aller Fehlerspeichereinträge" UBYTE DFES_OneToOne 1 100 0.00 255.0 ECU_ADDRESS 0xD0008D1F /end MEASUREMENT
/begin MEASUREMENT DFES_ctFrq06 "Häufigkeitszähler aller Fehlerspeichereinträge" UBYTE DFES_OneToOne 1 100 0.00 255.0 ECU_ADDRESS 0xD0008D20 /end MEASUREMENT
/begin MEASUREMENT DFES_ctFrq07 "Häufigkeitszähler aller Fehlerspeichereinträge" UBYTE DFES_OneToOne 1 100 0.00 255.0 ECU_ADDRESS 0xD0008D21 /end MEASUREMENT
/begin MEASUREMENT DFES_ctFrq08 "Häufigkeitszähler aller Fehlerspeichereinträge" UBYTE DFES_OneToOne 1 100 0.00 255.0 ECU_ADDRESS 0xD0008D22 /end MEASUREMENT
/begin MEASUREMENT DFES_ctFrq09 "Häufigkeitszähler aller Fehlerspeichereinträge" UBYTE DFES_OneToOne 1 100 0.00 255.0 ECU_ADDRESS 0xD0008D23 /end MEASUREMENT
/begin MEASUREMENT DFES_ctFrq10 "Häufigkeitszähler aller Fehlerspeichereinträge" UBYTE DFES_OneToOne 1 100 0.00 255.0 ECU_ADDRESS 0xD0008D24 /end MEASUREMENT
/begin MEASUREMENT DFES_ctFrq11 "Häufigkeitszähler aller Fehlerspeichereinträge" UBYTE DFES_OneToOne 1 100 0.00 255.0 ECU_ADDRESS 0xD0008D25 /end MEASUREMENT
/begin MEASUREMENT DFES_ctFrq12 "Häufigkeitszähler aller Fehlerspeichereinträge" UBYTE DFES_OneToOne 1 100 0.00 255.0 ECU_ADDRESS 0xD0008D26 /end MEASUREMENT
/begin MEASUREMENT DFES_ctFrq13 "Häufigkeitszähler aller Fehlerspeichereinträge" UBYTE DFES_OneToOne 1 100 0.00 255.0 ECU_ADDRESS 0xD0008D27 /end MEASUREMENT
/begin MEASUREMENT DFES_ctFrq14 "Häufigkeitszähler aller Fehlerspeichereinträge" UBYTE DFES_OneToOne 1 100 0.00 255.0 ECU_ADDRESS 0xD0008D28 /end MEASUREMENT
/begin MEASUREMENT DFES_ctFrq15 "Häufigkeitszähler aller Fehlerspeichereinträge" UBYTE DFES_OneToOne 1 100 0.00 255.0 ECU_ADDRESS 0xD0008D29 /end MEASUREMENT
/begin MEASUREMENT DFES_ctFrq16 "Häufigkeitszähler aller Fehlerspeichereinträge" UBYTE DFES_OneToOne 1 100 0.00 255.0 ECU_ADDRESS 0xD0008D2A /end MEASUREMENT
/begin MEASUREMENT DFES_ctFrq17 "Häufigkeitszähler aller Fehlerspeichereinträge" UBYTE DFES_OneToOne 1 100 0.00 255.0 ECU_ADDRESS 0xD0008D2B /end MEASUREMENT
/begin MEASUREMENT DFES_ctFrq18 "Häufigkeitszähler aller Fehlerspeichereinträge" UBYTE DFES_OneToOne 1 100 0.00 255.0 ECU_ADDRESS 0xD0008D2C /end MEASUREMENT
/begin MEASUREMENT DFES_ctFrq19 "Häufigkeitszähler aller Fehlerspeichereinträge" UBYTE DFES_OneToOne 1 100 0.00 255.0 ECU_ADDRESS 0xD0008D2D /end MEASUREMENT
/begin MEASUREMENT DFES_ctManuDef00 "kundenspezifischer Fehlerzähler (SVS-FLC) aller Fehlerspeichereinträge" UBYTE DFES_OneToOne 1 100 0.00 255.0 ECU_ADDRESS 0xD0008CDE /end MEASUREMENT
/begin MEASUREMENT DFES_ctManuDef01 "kundenspezifischer Fehlerzähler (SVS-FLC) aller Fehlerspeichereinträge" UBYTE DFES_OneToOne 1 100 0.00 255.0 ECU_ADDRESS 0xD0008CDF /end MEASUREMENT
/begin MEASUREMENT DFES_ctManuDef02 "kundenspezifischer Fehlerzähler (SVS-FLC) aller Fehlerspeichereinträge" UBYTE DFES_OneToOne 1 100 0.00 255.0 ECU_ADDRESS 0xD0008CE0 /end MEASUREMENT
/begin MEASUREMENT DFES_ctManuDef03 "kundenspezifischer Fehlerzähler (SVS-FLC) aller Fehlerspeichereinträge" UBYTE DFES_OneToOne 1 100 0.00 255.0 ECU_ADDRESS 0xD0008CE1 /end MEASUREMENT
/begin MEASUREMENT DFES_ctManuDef04 "kundenspezifischer Fehlerzähler (SVS-FLC) aller Fehlerspeichereinträge" UBYTE DFES_OneToOne 1 100 0.00 255.0 ECU_ADDRESS 0xD0008CE2 /end MEASUREMENT
/begin MEASUREMENT DFES_ctManuDef05 "kundenspezifischer Fehlerzähler (SVS-FLC) aller Fehlerspeichereinträge" UBYTE DFES_OneToOne 1 100 0.00 255.0 ECU_ADDRESS 0xD0008CE3 /end MEASUREMENT
/begin MEASUREMENT DFES_ctManuDef06 "kundenspezifischer Fehlerzähler (SVS-FLC) aller Fehlerspeichereinträge" UBYTE DFES_OneToOne 1 100 0.00 255.0 ECU_ADDRESS 0xD0008CE4 /end MEASUREMENT
/begin MEASUREMENT DFES_ctManuDef07 "kundenspezifischer Fehlerzähler (SVS-FLC) aller Fehlerspeichereinträge" UBYTE DFES_OneToOne 1 100 0.00 255.0 ECU_ADDRESS 0xD0008CE5 /end MEASUREMENT
/begin MEASUREMENT DFES_ctManuDef08 "kundenspezifischer Fehlerzähler (SVS-FLC) aller Fehlerspeichereinträge" UBYTE DFES_OneToOne 1 100 0.00 255.0 ECU_ADDRESS 0xD0008CE6 /end MEASUREMENT
/begin MEASUREMENT DFES_ctManuDef09 "kundenspezifischer Fehlerzähler (SVS-FLC) aller Fehlerspeichereinträge" UBYTE DFES_OneToOne 1 100 0.00 255.0 ECU_ADDRESS 0xD0008CE7 /end MEASUREMENT
/begin MEASUREMENT DFES_ctManuDef10 "kundenspezifischer Fehlerzähler (SVS-FLC) aller Fehlerspeichereinträge" UBYTE DFES_OneToOne 1 100 0.00 255.0 ECU_ADDRESS 0xD0008CE8 /end MEASUREMENT
/begin MEASUREMENT DFES_ctManuDef11 "kundenspezifischer Fehlerzähler (SVS-FLC) aller Fehlerspeichereinträge" UBYTE DFES_OneToOne 1 100 0.00 255.0 ECU_ADDRESS 0xD0008CE9 /end MEASUREMENT
/begin MEASUREMENT DFES_ctManuDef12 "kundenspezifischer Fehlerzähler (SVS-FLC) aller Fehlerspeichereinträge" UBYTE DFES_OneToOne 1 100 0.00 255.0 ECU_ADDRESS 0xD0008CEA /end MEASUREMENT
/begin MEASUREMENT DFES_ctManuDef13 "kundenspezifischer Fehlerzähler (SVS-FLC) aller Fehlerspeichereinträge" UBYTE DFES_OneToOne 1 100 0.00 255.0 ECU_ADDRESS 0xD0008CEB /end MEASUREMENT
/begin MEASUREMENT DFES_ctManuDef14 "kundenspezifischer Fehlerzähler (SVS-FLC) aller Fehlerspeichereinträge" UBYTE DFES_OneToOne 1 100 0.00 255.0 ECU_ADDRESS 0xD0008CEC /end MEASUREMENT
/begin MEASUREMENT DFES_ctManuDef15 "kundenspezifischer Fehlerzähler (SVS-FLC) aller Fehlerspeichereinträge" UBYTE DFES_OneToOne 1 100 0.00 255.0 ECU_ADDRESS 0xD0008CED /end MEASUREMENT
/begin MEASUREMENT DFES_ctManuDef16 "kundenspezifischer Fehlerzähler (SVS-FLC) aller Fehlerspeichereinträge" UBYTE DFES_OneToOne 1 100 0.00 255.0 ECU_ADDRESS 0xD0008CEE /end MEASUREMENT
/begin MEASUREMENT DFES_ctManuDef17 "kundenspezifischer Fehlerzähler (SVS-FLC) aller Fehlerspeichereinträge" UBYTE DFES_OneToOne 1 100 0.00 255.0 ECU_ADDRESS 0xD0008CEF /end MEASUREMENT
/begin MEASUREMENT DFES_ctManuDef18 "kundenspezifischer Fehlerzähler (SVS-FLC) aller Fehlerspeichereinträge" UBYTE DFES_OneToOne 1 100 0.00 255.0 ECU_ADDRESS 0xD0008CF0 /end MEASUREMENT
/begin MEASUREMENT DFES_ctManuDef19 "kundenspezifischer Fehlerzähler (SVS-FLC) aller Fehlerspeichereinträge" UBYTE DFES_OneToOne 1 100 0.00 255.0 ECU_ADDRESS 0xD0008CF1 /end MEASUREMENT
/begin MEASUREMENT DFES_ctManuOk00 "kundenspezifischer Heilungszähler (SVS-HLC) aller Fehlerspeichereinträge" UBYTE DFES_OneToOne 1 100 0.00 255.0 ECU_ADDRESS 0xD0008CF2 /end MEASUREMENT
/begin MEASUREMENT DFES_ctManuOk01 "kundenspezifischer Heilungszähler (SVS-HLC) aller Fehlerspeichereinträge" UBYTE DFES_OneToOne 1 100 0.00 255.0 ECU_ADDRESS 0xD0008CF3 /end MEASUREMENT
/begin MEASUREMENT DFES_ctManuOk02 "kundenspezifischer Heilungszähler (SVS-HLC) aller Fehlerspeichereinträge" UBYTE DFES_OneToOne 1 100 0.00 255.0 ECU_ADDRESS 0xD0008CF4 /end MEASUREMENT
/begin MEASUREMENT DFES_ctManuOk03 "kundenspezifischer Heilungszähler (SVS-HLC) aller Fehlerspeichereinträge" UBYTE DFES_OneToOne 1 100 0.00 255.0 ECU_ADDRESS 0xD0008CF5 /end MEASUREMENT
/begin MEASUREMENT DFES_ctManuOk04 "kundenspezifischer Heilungszähler (SVS-HLC) aller Fehlerspeichereinträge" UBYTE DFES_OneToOne 1 100 0.00 255.0 ECU_ADDRESS 0xD0008CF6 /end MEASUREMENT
/begin MEASUREMENT DFES_ctManuOk05 "kundenspezifischer Heilungszähler (SVS-HLC) aller Fehlerspeichereinträge" UBYTE DFES_OneToOne 1 100 0.00 255.0 ECU_ADDRESS 0xD0008CF7 /end MEASUREMENT
/begin MEASUREMENT DFES_ctManuOk06 "kundenspezifischer Heilungszähler (SVS-HLC) aller Fehlerspeichereinträge" UBYTE DFES_OneToOne 1 100 0.00 255.0 ECU_ADDRESS 0xD0008CF8 /end MEASUREMENT
/begin MEASUREMENT DFES_ctManuOk07 "kundenspezifischer Heilungszähler (SVS-HLC) aller Fehlerspeichereinträge" UBYTE DFES_OneToOne 1 100 0.00 255.0 ECU_ADDRESS 0xD0008CF9 /end MEASUREMENT
/begin MEASUREMENT DFES_ctManuOk08 "kundenspezifischer Heilungszähler (SVS-HLC) aller Fehlerspeichereinträge" UBYTE DFES_OneToOne 1 100 0.00 255.0 ECU_ADDRESS 0xD0008CFA /end MEASUREMENT
/begin MEASUREMENT DFES_ctManuOk09 "kundenspezifischer Heilungszähler (SVS-HLC) aller Fehlerspeichereinträge" UBYTE DFES_OneToOne 1 100 0.00 255.0 ECU_ADDRESS 0xD0008CFB /end MEASUREMENT
/begin MEASUREMENT DFES_ctManuOk10 "kundenspezifischer Heilungszähler (SVS-HLC) aller Fehlerspeichereinträge" UBYTE DFES_OneToOne 1 100 0.00 255.0 ECU_ADDRESS 0xD0008CFC /end MEASUREMENT
/begin MEASUREMENT DFES_ctManuOk11 "kundenspezifischer Heilungszähler (SVS-HLC) aller Fehlerspeichereinträge" UBYTE DFES_OneToOne 1 100 0.00 255.0 ECU_ADDRESS 0xD0008CFD /end MEASUREMENT
/begin MEASUREMENT DFES_ctManuOk12 "kundenspezifischer Heilungszähler (SVS-HLC) aller Fehlerspeichereinträge" UBYTE DFES_OneToOne 1 100 0.00 255.0 ECU_ADDRESS 0xD0008CFE /end MEASUREMENT
/begin MEASUREMENT DFES_ctManuOk13 "kundenspezifischer Heilungszähler (SVS-HLC) aller Fehlerspeichereinträge" UBYTE DFES_OneToOne 1 100 0.00 255.0 ECU_ADDRESS 0xD0008CFF /end MEASUREMENT
/begin MEASUREMENT DFES_ctManuOk14 "kundenspezifischer Heilungszähler (SVS-HLC) aller Fehlerspeichereinträge" UBYTE DFES_OneToOne 1 100 0.00 255.0 ECU_ADDRESS 0xD0008D00 /end MEASUREMENT
/begin MEASUREMENT DFES_ctManuOk15 "kundenspezifischer Heilungszähler (SVS-HLC) aller Fehlerspeichereinträge" UBYTE DFES_OneToOne 1 100 0.00 255.0 ECU_ADDRESS 0xD0008D01 /end MEASUREMENT
/begin MEASUREMENT DFES_ctManuOk16 "kundenspezifischer Heilungszähler (SVS-HLC) aller Fehlerspeichereinträge" UBYTE DFES_OneToOne 1 100 0.00 255.0 ECU_ADDRESS 0xD0008D02 /end MEASUREMENT
/begin MEASUREMENT DFES_ctManuOk17 "kundenspezifischer Heilungszähler (SVS-HLC) aller Fehlerspeichereinträge" UBYTE DFES_OneToOne 1 100 0.00 255.0 ECU_ADDRESS 0xD0008D03 /end MEASUREMENT
/begin MEASUREMENT DFES_ctManuOk18 "kundenspezifischer Heilungszähler (SVS-HLC) aller Fehlerspeichereinträge" UBYTE DFES_OneToOne 1 100 0.00 255.0 ECU_ADDRESS 0xD0008D04 /end MEASUREMENT
/begin MEASUREMENT DFES_ctManuOk19 "kundenspezifischer Heilungszähler (SVS-HLC) aller Fehlerspeichereinträge" UBYTE DFES_OneToOne 1 100 0.00 255.0 ECU_ADDRESS 0xD0008D05 /end MEASUREMENT
/begin MEASUREMENT DFES_ctOk00 "Heilungszähler (HLC) aller Fehlerspeichereinträge" UBYTE DFES_OneToOne 1 100 0.00 255.0 ECU_ADDRESS 0xD0008CCA /end MEASUREMENT
/begin MEASUREMENT DFES_ctOk01 "Heilungszähler (HLC) aller Fehlerspeichereinträge" UBYTE DFES_OneToOne 1 100 0.00 255.0 ECU_ADDRESS 0xD0008CCB /end MEASUREMENT
/begin MEASUREMENT DFES_ctOk02 "Heilungszähler (HLC) aller Fehlerspeichereinträge" UBYTE DFES_OneToOne 1 100 0.00 255.0 ECU_ADDRESS 0xD0008CCC /end MEASUREMENT
/begin MEASUREMENT DFES_ctOk03 "Heilungszähler (HLC) aller Fehlerspeichereinträge" UBYTE DFES_OneToOne 1 100 0.00 255.0 ECU_ADDRESS 0xD0008CCD /end MEASUREMENT
/begin MEASUREMENT DFES_ctOk04 "Heilungszähler (HLC) aller Fehlerspeichereinträge" UBYTE DFES_OneToOne 1 100 0.00 255.0 ECU_ADDRESS 0xD0008CCE /end MEASUREMENT
/begin MEASUREMENT DFES_ctOk05 "Heilungszähler (HLC) aller Fehlerspeichereinträge" UBYTE DFES_OneToOne 1 100 0.00 255.0 ECU_ADDRESS 0xD0008CCF /end MEASUREMENT
/begin MEASUREMENT DFES_ctOk06 "Heilungszähler (HLC) aller Fehlerspeichereinträge" UBYTE DFES_OneToOne 1 100 0.00 255.0 ECU_ADDRESS 0xD0008CD0 /end MEASUREMENT
/begin MEASUREMENT DFES_ctOk07 "Heilungszähler (HLC) aller Fehlerspeichereinträge" UBYTE DFES_OneToOne 1 100 0.00 255.0 ECU_ADDRESS 0xD0008CD1 /end MEASUREMENT
/begin MEASUREMENT DFES_ctOk08 "Heilungszähler (HLC) aller Fehlerspeichereinträge" UBYTE DFES_OneToOne 1 100 0.00 255.0 ECU_ADDRESS 0xD0008CD2 /end MEASUREMENT
/begin MEASUREMENT DFES_ctOk09 "Heilungszähler (HLC) aller Fehlerspeichereinträge" UBYTE DFES_OneToOne 1 100 0.00 255.0 ECU_ADDRESS 0xD0008CD3 /end MEASUREMENT
/begin MEASUREMENT DFES_ctOk10 "Heilungszähler (HLC) aller Fehlerspeichereinträge" UBYTE DFES_OneToOne 1 100 0.00 255.0 ECU_ADDRESS 0xD0008CD4 /end MEASUREMENT
/begin MEASUREMENT DFES_ctOk11 "Heilungszähler (HLC) aller Fehlerspeichereinträge" UBYTE DFES_OneToOne 1 100 0.00 255.0 ECU_ADDRESS 0xD0008CD5 /end MEASUREMENT
/begin MEASUREMENT DFES_ctOk12 "Heilungszähler (HLC) aller Fehlerspeichereinträge" UBYTE DFES_OneToOne 1 100 0.00 255.0 ECU_ADDRESS 0xD0008CD6 /end MEASUREMENT
/begin MEASUREMENT DFES_ctOk13 "Heilungszähler (HLC) aller Fehlerspeichereinträge" UBYTE DFES_OneToOne 1 100 0.00 255.0 ECU_ADDRESS 0xD0008CD7 /end MEASUREMENT
/begin MEASUREMENT DFES_ctOk14 "Heilungszähler (HLC) aller Fehlerspeichereinträge" UBYTE DFES_OneToOne 1 100 0.00 255.0 ECU_ADDRESS 0xD0008CD8 /end MEASUREMENT
/begin MEASUREMENT DFES_ctOk15 "Heilungszähler (HLC) aller Fehlerspeichereinträge" UBYTE DFES_OneToOne 1 100 0.00 255.0 ECU_ADDRESS 0xD0008CD9 /end MEASUREMENT
/begin MEASUREMENT DFES_ctOk16 "Heilungszähler (HLC) aller Fehlerspeichereinträge" UBYTE DFES_OneToOne 1 100 0.00 255.0 ECU_ADDRESS 0xD0008CDA /end MEASUREMENT
/begin MEASUREMENT DFES_ctOk17 "Heilungszähler (HLC) aller Fehlerspeichereinträge" UBYTE DFES_OneToOne 1 100 0.00 255.0 ECU_ADDRESS 0xD0008CDB /end MEASUREMENT
/begin MEASUREMENT DFES_ctOk18 "Heilungszähler (HLC) aller Fehlerspeichereinträge" UBYTE DFES_OneToOne 1 100 0.00 255.0 ECU_ADDRESS 0xD0008CDC /end MEASUREMENT
/begin MEASUREMENT DFES_ctOk19 "Heilungszähler (HLC) aller Fehlerspeichereinträge" UBYTE DFES_OneToOne 1 100 0.00 255.0 ECU_ADDRESS 0xD0008CDD /end MEASUREMENT
/begin MEASUREMENT DFES_EnvBlock00 "vollständige Umweldaten alle Fehlerspeichereinträge" UBYTE DFES_OneToOne 1 100 0.00 255.0 ECU_ADDRESS 0xD0008E82 /end MEASUREMENT
/begin MEASUREMENT DFES_EnvBlock01 "vollständige Umweldaten alle Fehlerspeichereinträge" UBYTE DFES_OneToOne 1 100 0.00 255.0 ECU_ADDRESS 0xD0008E83 /end MEASUREMENT
/begin MEASUREMENT DFES_EnvBlock02 "vollständige Umweldaten alle Fehlerspeichereinträge" UBYTE DFES_OneToOne 1 100 0.00 255.0 ECU_ADDRESS 0xD0008E84 /end MEASUREMENT
/begin MEASUREMENT DFES_EnvBlock03 "vollständige Umweldaten alle Fehlerspeichereinträge" UBYTE DFES_OneToOne 1 100 0.00 255.0 ECU_ADDRESS 0xD0008E85 /end MEASUREMENT
/begin MEASUREMENT DFES_EnvBlock04 "vollständige Umweldaten alle Fehlerspeichereinträge" UBYTE DFES_OneToOne 1 100 0.00 255.0 ECU_ADDRESS 0xD0008E86 /end MEASUREMENT
/begin MEASUREMENT DFES_EnvBlock05 "vollständige Umweldaten alle Fehlerspeichereinträge" UBYTE DFES_OneToOne 1 100 0.00 255.0 ECU_ADDRESS 0xD0008E87 /end MEASUREMENT
/begin MEASUREMENT DFES_EnvBlock06 "vollständige Umweldaten alle Fehlerspeichereinträge" UBYTE DFES_OneToOne 1 100 0.00 255.0 ECU_ADDRESS 0xD0008E88 /end MEASUREMENT
/begin MEASUREMENT DFES_EnvBlock07 "vollständige Umweldaten alle Fehlerspeichereinträge" UBYTE DFES_OneToOne 1 100 0.00 255.0 ECU_ADDRESS 0xD0008E89 /end MEASUREMENT
/begin MEASUREMENT DFES_EnvBlock08 "vollständige Umweldaten alle Fehlerspeichereinträge" UBYTE DFES_OneToOne 1 100 0.00 255.0 ECU_ADDRESS 0xD0008E8A /end MEASUREMENT
/begin MEASUREMENT DFES_EnvBlock09 "vollständige Umweldaten alle Fehlerspeichereinträge" UBYTE DFES_OneToOne 1 100 0.00 255.0 ECU_ADDRESS 0xD0008E8B /end MEASUREMENT
/begin MEASUREMENT DFES_EnvBlock10 "vollständige Umweldaten alle Fehlerspeichereinträge" UBYTE DFES_OneToOne 1 100 0.00 255.0 ECU_ADDRESS 0xD0008E8C /end MEASUREMENT
/begin MEASUREMENT DFES_EnvBlock11 "vollständige Umweldaten alle Fehlerspeichereinträge" UBYTE DFES_OneToOne 1 100 0.00 255.0 ECU_ADDRESS 0xD0008E8D /end MEASUREMENT
/begin MEASUREMENT DFES_EnvBlock12 "vollständige Umweldaten alle Fehlerspeichereinträge" UBYTE DFES_OneToOne 1 100 0.00 255.0 ECU_ADDRESS 0xD0008E8E /end MEASUREMENT
/begin MEASUREMENT DFES_EnvBlock13 "vollständige Umweldaten alle Fehlerspeichereinträge" UBYTE DFES_OneToOne 1 100 0.00 255.0 ECU_ADDRESS 0xD0008E8F /end MEASUREMENT
/begin MEASUREMENT DFES_EnvBlock14 "vollständige Umweldaten alle Fehlerspeichereinträge" UBYTE DFES_OneToOne 1 100 0.00 255.0 ECU_ADDRESS 0xD0008E90 /end MEASUREMENT
/begin MEASUREMENT DFES_EnvBlock15 "vollständige Umweldaten alle Fehlerspeichereinträge" UBYTE DFES_OneToOne 1 100 0.00 255.0 ECU_ADDRESS 0xD0008E91 /end MEASUREMENT
/begin MEASUREMENT DFES_EnvBlock16 "vollständige Umweldaten alle Fehlerspeichereinträge" UBYTE DFES_OneToOne 1 100 0.00 255.0 ECU_ADDRESS 0xD0008E92 /end MEASUREMENT
/begin MEASUREMENT DFES_EnvBlock17 "vollständige Umweldaten alle Fehlerspeichereinträge" UBYTE DFES_OneToOne 1 100 0.00 255.0 ECU_ADDRESS 0xD0008E93 /end MEASUREMENT
/begin MEASUREMENT DFES_EnvBlock18 "vollständige Umweldaten alle Fehlerspeichereinträge" UBYTE DFES_OneToOne 1 100 0.00 255.0 ECU_ADDRESS 0xD0008E94 /end MEASUREMENT
/begin MEASUREMENT DFES_EnvBlock19 "vollständige Umweldaten alle Fehlerspeichereinträge" UBYTE DFES_OneToOne 1 100 0.00 255.0 ECU_ADDRESS 0xD0008E95 /end MEASUREMENT
/begin MEASUREMENT DFES_EnvBlock20 "vollständige Umweldaten alle Fehlerspeichereinträge" UBYTE DFES_OneToOne 1 100 0.00 255.0 ECU_ADDRESS 0xD0008E96 /end MEASUREMENT
/begin MEASUREMENT DFES_EnvBlock21 "vollständige Umweldaten alle Fehlerspeichereinträge" UBYTE DFES_OneToOne 1 100 0.00 255.0 ECU_ADDRESS 0xD0008E97 /end MEASUREMENT
/begin MEASUREMENT DFES_EnvBlock22 "vollständige Umweldaten alle Fehlerspeichereinträge" UBYTE DFES_OneToOne 1 100 0.00 255.0 ECU_ADDRESS 0xD0008E98 /end MEASUREMENT
/begin MEASUREMENT DFES_EnvBlock23 "vollständige Umweldaten alle Fehlerspeichereinträge" UBYTE DFES_OneToOne 1 100 0.00 255.0 ECU_ADDRESS 0xD0008E99 /end MEASUREMENT
/begin MEASUREMENT DFES_EnvBlock24 "vollständige Umweldaten alle Fehlerspeichereinträge" UBYTE DFES_OneToOne 1 100 0.00 255.0 ECU_ADDRESS 0xD0008E9A /end MEASUREMENT
/begin MEASUREMENT DFES_EnvBlock25 "vollständige Umweldaten alle Fehlerspeichereinträge" UBYTE DFES_OneToOne 1 100 0.00 255.0 ECU_ADDRESS 0xD0008E9B /end MEASUREMENT
/begin MEASUREMENT DFES_EnvBlock26 "vollständige Umweldaten alle Fehlerspeichereinträge" UBYTE DFES_OneToOne 1 100 0.00 255.0 ECU_ADDRESS 0xD0008E9C /end MEASUREMENT
/begin MEASUREMENT DFES_EnvBlock27 "vollständige Umweldaten alle Fehlerspeichereinträge" UBYTE DFES_OneToOne 1 100 0.00 255.0 ECU_ADDRESS 0xD0008E9D /end MEASUREMENT
/begin MEASUREMENT DFES_EnvBlock28 "vollständige Umweldaten alle Fehlerspeichereinträge" UBYTE DFES_OneToOne 1 100 0.00 255.0 ECU_ADDRESS 0xD0008E9E /end MEASUREMENT
/begin MEASUREMENT DFES_EnvBlock29 "vollständige Umweldaten alle Fehlerspeichereinträge" UBYTE DFES_OneToOne 1 100 0.00 255.0 ECU_ADDRESS 0xD0008E9F /end MEASUREMENT
/begin MEASUREMENT DFES_EnvBlock30 "vollständige Umweldaten alle Fehlerspeichereinträge" UBYTE DFES_OneToOne 1 100 0.00 255.0 ECU_ADDRESS 0xD0008EA0 /end MEASUREMENT
/begin MEASUREMENT DFES_EnvBlock31 "vollständige Umweldaten alle Fehlerspeichereinträge" UBYTE DFES_OneToOne 1 100 0.00 255.0 ECU_ADDRESS 0xD0008EA1 /end MEASUREMENT
/begin MEASUREMENT DFES_EnvBlock32 "vollständige Umweldaten alle Fehlerspeichereinträge" UBYTE DFES_OneToOne 1 100 0.00 255.0 ECU_ADDRESS 0xD0008EA2 /end MEASUREMENT
/begin MEASUREMENT DFES_EnvBlock33 "vollständige Umweldaten alle Fehlerspeichereinträge" UBYTE DFES_OneToOne 1 100 0.00 255.0 ECU_ADDRESS 0xD0008EA3 /end MEASUREMENT
/begin MEASUREMENT DFES_EnvBlock34 "vollständige Umweldaten alle Fehlerspeichereinträge" UBYTE DFES_OneToOne 1 100 0.00 255.0 ECU_ADDRESS 0xD0008EA4 /end MEASUREMENT
/begin MEASUREMENT DFES_EnvBlock35 "vollständige Umweldaten alle Fehlerspeichereinträge" UBYTE DFES_OneToOne 1 100 0.00 255.0 ECU_ADDRESS 0xD0008EA5 /end MEASUREMENT
/begin MEASUREMENT DFES_EnvBlock36 "vollständige Umweldaten alle Fehlerspeichereinträge" UBYTE DFES_OneToOne 1 100 0.00 255.0 ECU_ADDRESS 0xD0008EA6 /end MEASUREMENT
/begin MEASUREMENT DFES_EnvBlock37 "vollständige Umweldaten alle Fehlerspeichereinträge" UBYTE DFES_OneToOne 1 100 0.00 255.0 ECU_ADDRESS 0xD0008EA7 /end MEASUREMENT
/begin MEASUREMENT DFES_EnvBlock38 "vollständige Umweldaten alle Fehlerspeichereinträge" UBYTE DFES_OneToOne 1 100 0.00 255.0 ECU_ADDRESS 0xD0008EA8 /end MEASUREMENT
/begin MEASUREMENT DFES_EnvBlock39 "vollständige Umweldaten alle Fehlerspeichereinträge" UBYTE DFES_OneToOne 1 100 0.00 255.0 ECU_ADDRESS 0xD0008EA9 /end MEASUREMENT
/begin MEASUREMENT DFES_EnvBlock40 "vollständige Umweldaten alle Fehlerspeichereinträge" UBYTE DFES_OneToOne 1 100 0.00 255.0 ECU_ADDRESS 0xD0008EAA /end MEASUREMENT
/begin MEASUREMENT DFES_EnvBlock41 "vollständige Umweldaten alle Fehlerspeichereinträge" UBYTE DFES_OneToOne 1 100 0.00 255.0 ECU_ADDRESS 0xD0008EAB /end MEASUREMENT
/begin MEASUREMENT DFES_EnvBlock42 "vollständige Umweldaten alle Fehlerspeichereinträge" UBYTE DFES_OneToOne 1 100 0.00 255.0 ECU_ADDRESS 0xD0008EAC /end MEASUREMENT
/begin MEASUREMENT DFES_EnvBlock43 "vollständige Umweldaten alle Fehlerspeichereinträge" UBYTE DFES_OneToOne 1 100 0.00 255.0 ECU_ADDRESS 0xD0008EAD /end MEASUREMENT
/begin MEASUREMENT DFES_EnvBlock44 "vollständige Umweldaten alle Fehlerspeichereinträge" UBYTE DFES_OneToOne 1 100 0.00 255.0 ECU_ADDRESS 0xD0008EAE /end MEASUREMENT
/begin MEASUREMENT DFES_EnvBlock45 "vollständige Umweldaten alle Fehlerspeichereinträge" UBYTE DFES_OneToOne 1 100 0.00 255.0 ECU_ADDRESS 0xD0008EAF /end MEASUREMENT
/begin MEASUREMENT DFES_EnvBlock46 "vollständige Umweldaten alle Fehlerspeichereinträge" UBYTE DFES_OneToOne 1 100 0.00 255.0 ECU_ADDRESS 0xD0008EB0 /end MEASUREMENT
/begin MEASUREMENT DFES_EnvBlock47 "vollständige Umweldaten alle Fehlerspeichereinträge" UBYTE DFES_OneToOne 1 100 0.00 255.0 ECU_ADDRESS 0xD0008EB1 /end MEASUREMENT
/begin MEASUREMENT DFES_EnvBlock48 "vollständige Umweldaten alle Fehlerspeichereinträge" UBYTE DFES_OneToOne 1 100 0.00 255.0 ECU_ADDRESS 0xD0008EB2 /end MEASUREMENT
/begin MEASUREMENT DFES_EnvBlock49 "vollständige Umweldaten alle Fehlerspeichereinträge" UBYTE DFES_OneToOne 1 100 0.00 255.0 ECU_ADDRESS 0xD0008EB3 /end MEASUREMENT
/begin MEASUREMENT DFES_EnvBlock50 "vollständige Umweldaten alle Fehlerspeichereinträge" UBYTE DFES_OneToOne 1 100 0.00 255.0 ECU_ADDRESS 0xD0008EB4 /end MEASUREMENT
/begin MEASUREMENT DFES_EnvBlock51 "vollständige Umweldaten alle Fehlerspeichereinträge" UBYTE DFES_OneToOne 1 100 0.00 255.0 ECU_ADDRESS 0xD0008EB5 /end MEASUREMENT
/begin MEASUREMENT DFES_EnvBlock52 "vollständige Umweldaten alle Fehlerspeichereinträge" UBYTE DFES_OneToOne 1 100 0.00 255.0 ECU_ADDRESS 0xD0008EB6 /end MEASUREMENT
/begin MEASUREMENT DFES_EnvBlock53 "vollständige Umweldaten alle Fehlerspeichereinträge" UBYTE DFES_OneToOne 1 100 0.00 255.0 ECU_ADDRESS 0xD0008EB7 /end MEASUREMENT
/begin MEASUREMENT DFES_EnvBlock54 "vollständige Umweldaten alle Fehlerspeichereinträge" UBYTE DFES_OneToOne 1 100 0.00 255.0 ECU_ADDRESS 0xD0008EB8 /end MEASUREMENT
/begin MEASUREMENT DFES_EnvBlock55 "vollständige Umweldaten alle Fehlerspeichereinträge" UBYTE DFES_OneToOne 1 100 0.00 255.0 ECU_ADDRESS 0xD0008EB9 /end MEASUREMENT
/begin MEASUREMENT DFES_EnvBlock56 "vollständige Umweldaten alle Fehlerspeichereinträge" UBYTE DFES_OneToOne 1 100 0.00 255.0 ECU_ADDRESS 0xD0008EBA /end MEASUREMENT
/begin MEASUREMENT DFES_EnvBlock57 "vollständige Umweldaten alle Fehlerspeichereinträge" UBYTE DFES_OneToOne 1 100 0.00 255.0 ECU_ADDRESS 0xD0008EBB /end MEASUREMENT
/begin MEASUREMENT DFES_EnvBlock58 "vollständige Umweldaten alle Fehlerspeichereinträge" UBYTE DFES_OneToOne 1 100 0.00 255.0 ECU_ADDRESS 0xD0008EBC /end MEASUREMENT
/begin MEASUREMENT DFES_EnvBlock59 "vollständige Umweldaten alle Fehlerspeichereinträge" UBYTE DFES_OneToOne 1 100 0.00 255.0 ECU_ADDRESS 0xD0008EBD /end MEASUREMENT
/begin MEASUREMENT DFES_EnvBlock60 "vollständige Umweldaten alle Fehlerspeichereinträge" UBYTE DFES_OneToOne 1 100 0.00 255.0 ECU_ADDRESS 0xD0008EBE /end MEASUREMENT
/begin MEASUREMENT DFES_EnvBlock61 "vollständige Umweldaten alle Fehlerspeichereinträge" UBYTE DFES_OneToOne 1 100 0.00 255.0 ECU_ADDRESS 0xD0008EBF /end MEASUREMENT
/begin MEASUREMENT DFES_EnvBlock62 "vollständige Umweldaten alle Fehlerspeichereinträge" UBYTE DFES_OneToOne 1 100 0.00 255.0 ECU_ADDRESS 0xD0008EC0 /end MEASUREMENT
/begin MEASUREMENT DFES_EnvBlock63 "vollständige Umweldaten alle Fehlerspeichereinträge" UBYTE DFES_OneToOne 1 100 0.00 255.0 ECU_ADDRESS 0xD0008EC1 /end MEASUREMENT
/begin MEASUREMENT DFES_EnvBlock64 "vollständige Umweldaten alle Fehlerspeichereinträge" UBYTE DFES_OneToOne 1 100 0.00 255.0 ECU_ADDRESS 0xD0008EC2 /end MEASUREMENT
/begin MEASUREMENT DFES_EnvBlock65 "vollständige Umweldaten alle Fehlerspeichereinträge" UBYTE DFES_OneToOne 1 100 0.00 255.0 ECU_ADDRESS 0xD0008EC3 /end MEASUREMENT
/begin MEASUREMENT DFES_EnvBlock66 "vollständige Umweldaten alle Fehlerspeichereinträge" UBYTE DFES_OneToOne 1 100 0.00 255.0 ECU_ADDRESS 0xD0008EC4 /end MEASUREMENT
/begin MEASUREMENT DFES_EnvBlock67 "vollständige Umweldaten alle Fehlerspeichereinträge" UBYTE DFES_OneToOne 1 100 0.00 255.0 ECU_ADDRESS 0xD0008EC5 /end MEASUREMENT
/begin MEASUREMENT DFES_EnvBlock68 "vollständige Umweldaten alle Fehlerspeichereinträge" UBYTE DFES_OneToOne 1 100 0.00 255.0 ECU_ADDRESS 0xD0008EC6 /end MEASUREMENT
/begin MEASUREMENT DFES_EnvBlock69 "vollständige Umweldaten alle Fehlerspeichereinträge" UBYTE DFES_OneToOne 1 100 0.00 255.0 ECU_ADDRESS 0xD0008EC7 /end MEASUREMENT
/begin MEASUREMENT DFES_EnvBlock70 "vollständige Umweldaten alle Fehlerspeichereinträge" UBYTE DFES_OneToOne 1 100 0.00 255.0 ECU_ADDRESS 0xD0008EC8 /end MEASUREMENT
/begin MEASUREMENT DFES_EnvBlock71 "vollständige Umweldaten alle Fehlerspeichereinträge" UBYTE DFES_OneToOne 1 100 0.00 255.0 ECU_ADDRESS 0xD0008EC9 /end MEASUREMENT
/begin MEASUREMENT DFES_EnvBlock72 "vollständige Umweldaten alle Fehlerspeichereinträge" UBYTE DFES_OneToOne 1 100 0.00 255.0 ECU_ADDRESS 0xD0008ECA /end MEASUREMENT
/begin MEASUREMENT DFES_EnvBlock73 "vollständige Umweldaten alle Fehlerspeichereinträge" UBYTE DFES_OneToOne 1 100 0.00 255.0 ECU_ADDRESS 0xD0008ECB /end MEASUREMENT
/begin MEASUREMENT DFES_EnvBlock74 "vollständige Umweldaten alle Fehlerspeichereinträge" UBYTE DFES_OneToOne 1 100 0.00 255.0 ECU_ADDRESS 0xD0008ECC /end MEASUREMENT
/begin MEASUREMENT DFES_EnvBlock75 "vollständige Umweldaten alle Fehlerspeichereinträge" UBYTE DFES_OneToOne 1 100 0.00 255.0 ECU_ADDRESS 0xD0008ECD /end MEASUREMENT
/begin MEASUREMENT DFES_EnvBlock76 "vollständige Umweldaten alle Fehlerspeichereinträge" UBYTE DFES_OneToOne 1 100 0.00 255.0 ECU_ADDRESS 0xD0008ECE /end MEASUREMENT
/begin MEASUREMENT DFES_EnvBlock77 "vollständige Umweldaten alle Fehlerspeichereinträge" UBYTE DFES_OneToOne 1 100 0.00 255.0 ECU_ADDRESS 0xD0008ECF /end MEASUREMENT
/begin MEASUREMENT DFES_EnvBlock78 "vollständige Umweldaten alle Fehlerspeichereinträge" UBYTE DFES_OneToOne 1 100 0.00 255.0 ECU_ADDRESS 0xD0008ED0 /end MEASUREMENT
/begin MEASUREMENT DFES_EnvBlock79 "vollständige Umweldaten alle Fehlerspeichereinträge" UBYTE DFES_OneToOne 1 100 0.00 255.0 ECU_ADDRESS 0xD0008ED1 /end MEASUREMENT
/begin MEASUREMENT DFES_EnvBlock80 "vollständige Umweldaten alle Fehlerspeichereinträge" UBYTE DFES_OneToOne 1 100 0.00 255.0 ECU_ADDRESS 0xD0008ED2 /end MEASUREMENT
/begin MEASUREMENT DFES_EnvBlock81 "vollständige Umweldaten alle Fehlerspeichereinträge" UBYTE DFES_OneToOne 1 100 0.00 255.0 ECU_ADDRESS 0xD0008ED3 /end MEASUREMENT
/begin MEASUREMENT DFES_EnvBlock82 "vollständige Umweldaten alle Fehlerspeichereinträge" UBYTE DFES_OneToOne 1 100 0.00 255.0 ECU_ADDRESS 0xD0008ED4 /end MEASUREMENT
/begin MEASUREMENT DFES_EnvBlock83 "vollständige Umweldaten alle Fehlerspeichereinträge" UBYTE DFES_OneToOne 1 100 0.00 255.0 ECU_ADDRESS 0xD0008ED5 /end MEASUREMENT
/begin MEASUREMENT DFES_EnvBlock84 "vollständige Umweldaten alle Fehlerspeichereinträge" UBYTE DFES_OneToOne 1 100 0.00 255.0 ECU_ADDRESS 0xD0008ED6 /end MEASUREMENT
/begin MEASUREMENT DFES_EnvBlock85 "vollständige Umweldaten alle Fehlerspeichereinträge" UBYTE DFES_OneToOne 1 100 0.00 255.0 ECU_ADDRESS 0xD0008ED7 /end MEASUREMENT
/begin MEASUREMENT DFES_EnvBlock86 "vollständige Umweldaten alle Fehlerspeichereinträge" UBYTE DFES_OneToOne 1 100 0.00 255.0 ECU_ADDRESS 0xD0008ED8 /end MEASUREMENT
/begin MEASUREMENT DFES_EnvBlock87 "vollständige Umweldaten alle Fehlerspeichereinträge" UBYTE DFES_OneToOne 1 100 0.00 255.0 ECU_ADDRESS 0xD0008ED9 /end MEASUREMENT
/begin MEASUREMENT DFES_EnvBlock88 "vollständige Umweldaten alle Fehlerspeichereinträge" UBYTE DFES_OneToOne 1 100 0.00 255.0 ECU_ADDRESS 0xD0008EDA /end MEASUREMENT
/begin MEASUREMENT DFES_EnvBlock89 "vollständige Umweldaten alle Fehlerspeichereinträge" UBYTE DFES_OneToOne 1 100 0.00 255.0 ECU_ADDRESS 0xD0008EDB /end MEASUREMENT
/begin MEASUREMENT DFES_EnvBlock90 "vollständige Umweldaten alle Fehlerspeichereinträge" UBYTE DFES_OneToOne 1 100 0.00 255.0 ECU_ADDRESS 0xD0008EDC /end MEASUREMENT
/begin MEASUREMENT DFES_EnvBlock91 "vollständige Umweldaten alle Fehlerspeichereinträge" UBYTE DFES_OneToOne 1 100 0.00 255.0 ECU_ADDRESS 0xD0008EDD /end MEASUREMENT
/begin MEASUREMENT DFES_EnvBlock92 "vollständige Umweldaten alle Fehlerspeichereinträge" UBYTE DFES_OneToOne 1 100 0.00 255.0 ECU_ADDRESS 0xD0008EDE /end MEASUREMENT
/begin MEASUREMENT DFES_EnvBlock93 "vollständige Umweldaten alle Fehlerspeichereinträge" UBYTE DFES_OneToOne 1 100 0.00 255.0 ECU_ADDRESS 0xD0008EDF /end MEASUREMENT
/begin MEASUREMENT DFES_EnvBlock94 "vollständige Umweldaten alle Fehlerspeichereinträge" UBYTE DFES_OneToOne 1 100 0.00 255.0 ECU_ADDRESS 0xD0008EE0 /end MEASUREMENT
/begin MEASUREMENT DFES_EnvBlock95 "vollständige Umweldaten alle Fehlerspeichereinträge" UBYTE DFES_OneToOne 1 100 0.00 255.0 ECU_ADDRESS 0xD0008EE1 /end MEASUREMENT
/begin MEASUREMENT DFES_EnvBlock96 "vollständige Umweldaten alle Fehlerspeichereinträge" UBYTE DFES_OneToOne 1 100 0.00 255.0 ECU_ADDRESS 0xD0008EE2 /end MEASUREMENT
/begin MEASUREMENT DFES_EnvBlock97 "vollständige Umweldaten alle Fehlerspeichereinträge" UBYTE DFES_OneToOne 1 100 0.00 255.0 ECU_ADDRESS 0xD0008EE3 /end MEASUREMENT
/begin MEASUREMENT DFES_EnvBlock98 "vollständige Umweldaten alle Fehlerspeichereinträge" UBYTE DFES_OneToOne 1 100 0.00 255.0 ECU_ADDRESS 0xD0008EE4 /end MEASUREMENT
/begin MEASUREMENT DFES_EnvBlock99 "vollständige Umweldaten alle Fehlerspeichereinträge" UBYTE DFES_OneToOne 1 100 0.00 255.0 ECU_ADDRESS 0xD0008EE5 /end MEASUREMENT
/begin MEASUREMENT DFES_EnvBlock100 "vollständige Umweldaten alle Fehlerspeichereinträge" UBYTE DFES_OneToOne 1 100 0.00 255.0 ECU_ADDRESS 0xD0008EE6 /end MEASUREMENT
/begin MEASUREMENT DFES_EnvBlock101 "vollständige Umweldaten alle Fehlerspeichereinträge" UBYTE DFES_OneToOne 1 100 0.00 255.0 ECU_ADDRESS 0xD0008EE7 /end MEASUREMENT
/begin MEASUREMENT DFES_EnvBlock102 "vollständige Umweldaten alle Fehlerspeichereinträge" UBYTE DFES_OneToOne 1 100 0.00 255.0 ECU_ADDRESS 0xD0008EE8 /end MEASUREMENT
/begin MEASUREMENT DFES_EnvBlock103 "vollständige Umweldaten alle Fehlerspeichereinträge" UBYTE DFES_OneToOne 1 100 0.00 255.0 ECU_ADDRESS 0xD0008EE9 /end MEASUREMENT
/begin MEASUREMENT DFES_EnvBlock104 "vollständige Umweldaten alle Fehlerspeichereinträge" UBYTE DFES_OneToOne 1 100 0.00 255.0 ECU_ADDRESS 0xD0008EEA /end MEASUREMENT
/begin MEASUREMENT DFES_EnvBlock105 "vollständige Umweldaten alle Fehlerspeichereinträge" UBYTE DFES_OneToOne 1 100 0.00 255.0 ECU_ADDRESS 0xD0008EEB /end MEASUREMENT
/begin MEASUREMENT DFES_EnvBlock106 "vollständige Umweldaten alle Fehlerspeichereinträge" UBYTE DFES_OneToOne 1 100 0.00 255.0 ECU_ADDRESS 0xD0008EEC /end MEASUREMENT
/begin MEASUREMENT DFES_EnvBlock107 "vollständige Umweldaten alle Fehlerspeichereinträge" UBYTE DFES_OneToOne 1 100 0.00 255.0 ECU_ADDRESS 0xD0008EED /end MEASUREMENT
/begin MEASUREMENT DFES_EnvBlock108 "vollständige Umweldaten alle Fehlerspeichereinträge" UBYTE DFES_OneToOne 1 100 0.00 255.0 ECU_ADDRESS 0xD0008EEE /end MEASUREMENT
/begin MEASUREMENT DFES_EnvBlock109 "vollständige Umweldaten alle Fehlerspeichereinträge" UBYTE DFES_OneToOne 1 100 0.00 255.0 ECU_ADDRESS 0xD0008EEF /end MEASUREMENT
/begin MEASUREMENT DFES_EnvBlock110 "vollständige Umweldaten alle Fehlerspeichereinträge" UBYTE DFES_OneToOne 1 100 0.00 255.0 ECU_ADDRESS 0xD0008EF0 /end MEASUREMENT
/begin MEASUREMENT DFES_EnvBlock111 "vollständige Umweldaten alle Fehlerspeichereinträge" UBYTE DFES_OneToOne 1 100 0.00 255.0 ECU_ADDRESS 0xD0008EF1 /end MEASUREMENT
/begin MEASUREMENT DFES_EnvBlock112 "vollständige Umweldaten alle Fehlerspeichereinträge" UBYTE DFES_OneToOne 1 100 0.00 255.0 ECU_ADDRESS 0xD0008EF2 /end MEASUREMENT
/begin MEASUREMENT DFES_EnvBlock113 "vollständige Umweldaten alle Fehlerspeichereinträge" UBYTE DFES_OneToOne 1 100 0.00 255.0 ECU_ADDRESS 0xD0008EF3 /end MEASUREMENT
/begin MEASUREMENT DFES_EnvBlock114 "vollständige Umweldaten alle Fehlerspeichereinträge" UBYTE DFES_OneToOne 1 100 0.00 255.0 ECU_ADDRESS 0xD0008EF4 /end MEASUREMENT
/begin MEASUREMENT DFES_EnvBlock115 "vollständige Umweldaten alle Fehlerspeichereinträge" UBYTE DFES_OneToOne 1 100 0.00 255.0 ECU_ADDRESS 0xD0008EF5 /end MEASUREMENT
/begin MEASUREMENT DFES_EnvBlock116 "vollständige Umweldaten alle Fehlerspeichereinträge" UBYTE DFES_OneToOne 1 100 0.00 255.0 ECU_ADDRESS 0xD0008EF6 /end MEASUREMENT
/begin MEASUREMENT DFES_EnvBlock117 "vollständige Umweldaten alle Fehlerspeichereinträge" UBYTE DFES_OneToOne 1 100 0.00 255.0 ECU_ADDRESS 0xD0008EF7 /end MEASUREMENT
/begin MEASUREMENT DFES_EnvBlock118 "vollständige Umweldaten alle Fehlerspeichereinträge" UBYTE DFES_OneToOne 1 100 0.00 255.0 ECU_ADDRESS 0xD0008EF8 /end MEASUREMENT
/begin MEASUREMENT DFES_EnvBlock119 "vollständige Umweldaten alle Fehlerspeichereinträge" UBYTE DFES_OneToOne 1 100 0.00 255.0 ECU_ADDRESS 0xD0008EF9 /end MEASUREMENT
/begin MEASUREMENT DFES_EnvBlock120 "vollständige Umweldaten alle Fehlerspeichereinträge" UBYTE DFES_OneToOne 1 100 0.00 255.0 ECU_ADDRESS 0xD0008EFA /end MEASUREMENT
/begin MEASUREMENT DFES_EnvBlock121 "vollständige Umweldaten alle Fehlerspeichereinträge" UBYTE DFES_OneToOne 1 100 0.00 255.0 ECU_ADDRESS 0xD0008EFB /end MEASUREMENT
/begin MEASUREMENT DFES_EnvBlock122 "vollständige Umweldaten alle Fehlerspeichereinträge" UBYTE DFES_OneToOne 1 100 0.00 255.0 ECU_ADDRESS 0xD0008EFC /end MEASUREMENT
/begin MEASUREMENT DFES_EnvBlock123 "vollständige Umweldaten alle Fehlerspeichereinträge" UBYTE DFES_OneToOne 1 100 0.00 255.0 ECU_ADDRESS 0xD0008EFD /end MEASUREMENT
/begin MEASUREMENT DFES_EnvBlock124 "vollständige Umweldaten alle Fehlerspeichereinträge" UBYTE DFES_OneToOne 1 100 0.00 255.0 ECU_ADDRESS 0xD0008EFE /end MEASUREMENT
/begin MEASUREMENT DFES_EnvBlock125 "vollständige Umweldaten alle Fehlerspeichereinträge" UBYTE DFES_OneToOne 1 100 0.00 255.0 ECU_ADDRESS 0xD0008EFF /end MEASUREMENT
/begin MEASUREMENT DFES_EnvBlock126 "vollständige Umweldaten alle Fehlerspeichereinträge" UBYTE DFES_OneToOne 1 100 0.00 255.0 ECU_ADDRESS 0xD0008F00 /end MEASUREMENT
/begin MEASUREMENT DFES_EnvBlock127 "vollständige Umweldaten alle Fehlerspeichereinträge" UBYTE DFES_OneToOne 1 100 0.00 255.0 ECU_ADDRESS 0xD0008F01 /end MEASUREMENT
/begin MEASUREMENT DFES_EnvBlock128 "vollständige Umweldaten alle Fehlerspeichereinträge" UBYTE DFES_OneToOne 1 100 0.00 255.0 ECU_ADDRESS 0xD0008F02 /end MEASUREMENT
/begin MEASUREMENT DFES_EnvBlock129 "vollständige Umweldaten alle Fehlerspeichereinträge" UBYTE DFES_OneToOne 1 100 0.00 255.0 ECU_ADDRESS 0xD0008F03 /end MEASUREMENT
/begin MEASUREMENT DFES_EnvBlock130 "vollständige Umweldaten alle Fehlerspeichereinträge" UBYTE DFES_OneToOne 1 100 0.00 255.0 ECU_ADDRESS 0xD0008F04 /end MEASUREMENT
/begin MEASUREMENT DFES_EnvBlock131 "vollständige Umweldaten alle Fehlerspeichereinträge" UBYTE DFES_OneToOne 1 100 0.00 255.0 ECU_ADDRESS 0xD0008F05 /end MEASUREMENT
/begin MEASUREMENT DFES_EnvBlock132 "vollständige Umweldaten alle Fehlerspeichereinträge" UBYTE DFES_OneToOne 1 100 0.00 255.0 ECU_ADDRESS 0xD0008F06 /end MEASUREMENT
/begin MEASUREMENT DFES_EnvBlock133 "vollständige Umweldaten alle Fehlerspeichereinträge" UBYTE DFES_OneToOne 1 100 0.00 255.0 ECU_ADDRESS 0xD0008F07 /end MEASUREMENT
/begin MEASUREMENT DFES_EnvBlock134 "vollständige Umweldaten alle Fehlerspeichereinträge" UBYTE DFES_OneToOne 1 100 0.00 255.0 ECU_ADDRESS 0xD0008F08 /end MEASUREMENT
/begin MEASUREMENT DFES_EnvBlock135 "vollständige Umweldaten alle Fehlerspeichereinträge" UBYTE DFES_OneToOne 1 100 0.00 255.0 ECU_ADDRESS 0xD0008F09 /end MEASUREMENT
/begin MEASUREMENT DFES_EnvBlock136 "vollständige Umweldaten alle Fehlerspeichereinträge" UBYTE DFES_OneToOne 1 100 0.00 255.0 ECU_ADDRESS 0xD0008F0A /end MEASUREMENT
/begin MEASUREMENT DFES_EnvBlock137 "vollständige Umweldaten alle Fehlerspeichereinträge" UBYTE DFES_OneToOne 1 100 0.00 255.0 ECU_ADDRESS 0xD0008F0B /end MEASUREMENT
/begin MEASUREMENT DFES_EnvBlock138 "vollständige Umweldaten alle Fehlerspeichereinträge" UBYTE DFES_OneToOne 1 100 0.00 255.0 ECU_ADDRESS 0xD0008F0C /end MEASUREMENT
/begin MEASUREMENT DFES_EnvBlock139 "vollständige Umweldaten alle Fehlerspeichereinträge" UBYTE DFES_OneToOne 1 100 0.00 255.0 ECU_ADDRESS 0xD0008F0D /end MEASUREMENT
/begin MEASUREMENT DFES_EnvBlock140 "vollständige Umweldaten alle Fehlerspeichereinträge" UBYTE DFES_OneToOne 1 100 0.00 255.0 ECU_ADDRESS 0xD0008F0E /end MEASUREMENT
/begin MEASUREMENT DFES_EnvBlock141 "vollständige Umweldaten alle Fehlerspeichereinträge" UBYTE DFES_OneToOne 1 100 0.00 255.0 ECU_ADDRESS 0xD0008F0F /end MEASUREMENT
/begin MEASUREMENT DFES_EnvBlock142 "vollständige Umweldaten alle Fehlerspeichereinträge" UBYTE DFES_OneToOne 1 100 0.00 255.0 ECU_ADDRESS 0xD0008F10 /end MEASUREMENT
/begin MEASUREMENT DFES_EnvBlock143 "vollständige Umweldaten alle Fehlerspeichereinträge" UBYTE DFES_OneToOne 1 100 0.00 255.0 ECU_ADDRESS 0xD0008F11 /end MEASUREMENT
/begin MEASUREMENT DFES_EnvBlock144 "vollständige Umweldaten alle Fehlerspeichereinträge" UBYTE DFES_OneToOne 1 100 0.00 255.0 ECU_ADDRESS 0xD0008F12 /end MEASUREMENT
/begin MEASUREMENT DFES_EnvBlock145 "vollständige Umweldaten alle Fehlerspeichereinträge" UBYTE DFES_OneToOne 1 100 0.00 255.0 ECU_ADDRESS 0xD0008F13 /end MEASUREMENT
/begin MEASUREMENT DFES_EnvBlock146 "vollständige Umweldaten alle Fehlerspeichereinträge" UBYTE DFES_OneToOne 1 100 0.00 255.0 ECU_ADDRESS 0xD0008F14 /end MEASUREMENT
/begin MEASUREMENT DFES_EnvBlock147 "vollständige Umweldaten alle Fehlerspeichereinträge" UBYTE DFES_OneToOne 1 100 0.00 255.0 ECU_ADDRESS 0xD0008F15 /end MEASUREMENT
/begin MEASUREMENT DFES_EnvBlock148 "vollständige Umweldaten alle Fehlerspeichereinträge" UBYTE DFES_OneToOne 1 100 0.00 255.0 ECU_ADDRESS 0xD0008F16 /end MEASUREMENT
/begin MEASUREMENT DFES_EnvBlock149 "vollständige Umweldaten alle Fehlerspeichereinträge" UBYTE DFES_OneToOne 1 100 0.00 255.0 ECU_ADDRESS 0xD0008F17 /end MEASUREMENT
/begin MEASUREMENT DFES_EnvBlock150 "vollständige Umweldaten alle Fehlerspeichereinträge" UBYTE DFES_OneToOne 1 100 0.00 255.0 ECU_ADDRESS 0xD0008F18 /end MEASUREMENT
/begin MEASUREMENT DFES_EnvBlock151 "vollständige Umweldaten alle Fehlerspeichereinträge" UBYTE DFES_OneToOne 1 100 0.00 255.0 ECU_ADDRESS 0xD0008F19 /end MEASUREMENT
/begin MEASUREMENT DFES_EnvBlock152 "vollständige Umweldaten alle Fehlerspeichereinträge" UBYTE DFES_OneToOne 1 100 0.00 255.0 ECU_ADDRESS 0xD0008F1A /end MEASUREMENT
/begin MEASUREMENT DFES_EnvBlock153 "vollständige Umweldaten alle Fehlerspeichereinträge" UBYTE DFES_OneToOne 1 100 0.00 255.0 ECU_ADDRESS 0xD0008F1B /end MEASUREMENT
/begin MEASUREMENT DFES_EnvBlock154 "vollständige Umweldaten alle Fehlerspeichereinträge" UBYTE DFES_OneToOne 1 100 0.00 255.0 ECU_ADDRESS 0xD0008F1C /end MEASUREMENT
/begin MEASUREMENT DFES_EnvBlock155 "vollständige Umweldaten alle Fehlerspeichereinträge" UBYTE DFES_OneToOne 1 100 0.00 255.0 ECU_ADDRESS 0xD0008F1D /end MEASUREMENT
/begin MEASUREMENT DFES_EnvBlock156 "vollständige Umweldaten alle Fehlerspeichereinträge" UBYTE DFES_OneToOne 1 100 0.00 255.0 ECU_ADDRESS 0xD0008F1E /end MEASUREMENT
/begin MEASUREMENT DFES_EnvBlock157 "vollständige Umweldaten alle Fehlerspeichereinträge" UBYTE DFES_OneToOne 1 100 0.00 255.0 ECU_ADDRESS 0xD0008F1F /end MEASUREMENT
/begin MEASUREMENT DFES_EnvBlock158 "vollständige Umweldaten alle Fehlerspeichereinträge" UBYTE DFES_OneToOne 1 100 0.00 255.0 ECU_ADDRESS 0xD0008F20 /end MEASUREMENT
/begin MEASUREMENT DFES_EnvBlock159 "vollständige Umweldaten alle Fehlerspeichereinträge" UBYTE DFES_OneToOne 1 100 0.00 255.0 ECU_ADDRESS 0xD0008F21 /end MEASUREMENT
/begin MEASUREMENT DFES_EnvBlock160 "vollständige Umweldaten alle Fehlerspeichereinträge" UBYTE DFES_OneToOne 1 100 0.00 255.0 ECU_ADDRESS 0xD0008F22 /end MEASUREMENT
/begin MEASUREMENT DFES_EnvBlock161 "vollständige Umweldaten alle Fehlerspeichereinträge" UBYTE DFES_OneToOne 1 100 0.00 255.0 ECU_ADDRESS 0xD0008F23 /end MEASUREMENT
/begin MEASUREMENT DFES_EnvBlock162 "vollständige Umweldaten alle Fehlerspeichereinträge" UBYTE DFES_OneToOne 1 100 0.00 255.0 ECU_ADDRESS 0xD0008F24 /end MEASUREMENT
/begin MEASUREMENT DFES_EnvBlock163 "vollständige Umweldaten alle Fehlerspeichereinträge" UBYTE DFES_OneToOne 1 100 0.00 255.0 ECU_ADDRESS 0xD0008F25 /end MEASUREMENT
/begin MEASUREMENT DFES_EnvBlock164 "vollständige Umweldaten alle Fehlerspeichereinträge" UBYTE DFES_OneToOne 1 100 0.00 255.0 ECU_ADDRESS 0xD0008F26 /end MEASUREMENT
/begin MEASUREMENT DFES_EnvBlock165 "vollständige Umweldaten alle Fehlerspeichereinträge" UBYTE DFES_OneToOne 1 100 0.00 255.0 ECU_ADDRESS 0xD0008F27 /end MEASUREMENT
/begin MEASUREMENT DFES_EnvBlock166 "vollständige Umweldaten alle Fehlerspeichereinträge" UBYTE DFES_OneToOne 1 100 0.00 255.0 ECU_ADDRESS 0xD0008F28 /end MEASUREMENT
/begin MEASUREMENT DFES_EnvBlock167 "vollständige Umweldaten alle Fehlerspeichereinträge" UBYTE DFES_OneToOne 1 100 0.00 255.0 ECU_ADDRESS 0xD0008F29 /end MEASUREMENT
/begin MEASUREMENT DFES_EnvBlock168 "vollständige Umweldaten alle Fehlerspeichereinträge" UBYTE DFES_OneToOne 1 100 0.00 255.0 ECU_ADDRESS 0xD0008F2A /end MEASUREMENT
/begin MEASUREMENT DFES_EnvBlock169 "vollständige Umweldaten alle Fehlerspeichereinträge" UBYTE DFES_OneToOne 1 100 0.00 255.0 ECU_ADDRESS 0xD0008F2B /end MEASUREMENT
/begin MEASUREMENT DFES_EnvBlock170 "vollständige Umweldaten alle Fehlerspeichereinträge" UBYTE DFES_OneToOne 1 100 0.00 255.0 ECU_ADDRESS 0xD0008F2C /end MEASUREMENT
/begin MEASUREMENT DFES_EnvBlock171 "vollständige Umweldaten alle Fehlerspeichereinträge" UBYTE DFES_OneToOne 1 100 0.00 255.0 ECU_ADDRESS 0xD0008F2D /end MEASUREMENT
/begin MEASUREMENT DFES_EnvBlock172 "vollständige Umweldaten alle Fehlerspeichereinträge" UBYTE DFES_OneToOne 1 100 0.00 255.0 ECU_ADDRESS 0xD0008F2E /end MEASUREMENT
/begin MEASUREMENT DFES_EnvBlock173 "vollständige Umweldaten alle Fehlerspeichereinträge" UBYTE DFES_OneToOne 1 100 0.00 255.0 ECU_ADDRESS 0xD0008F2F /end MEASUREMENT
/begin MEASUREMENT DFES_EnvBlock174 "vollständige Umweldaten alle Fehlerspeichereinträge" UBYTE DFES_OneToOne 1 100 0.00 255.0 ECU_ADDRESS 0xD0008F30 /end MEASUREMENT
/begin MEASUREMENT DFES_EnvBlock175 "vollständige Umweldaten alle Fehlerspeichereinträge" UBYTE DFES_OneToOne 1 100 0.00 255.0 ECU_ADDRESS 0xD0008F31 /end MEASUREMENT
/begin MEASUREMENT DFES_EnvBlock176 "vollständige Umweldaten alle Fehlerspeichereinträge" UBYTE DFES_OneToOne 1 100 0.00 255.0 ECU_ADDRESS 0xD0008F32 /end MEASUREMENT
/begin MEASUREMENT DFES_EnvBlock177 "vollständige Umweldaten alle Fehlerspeichereinträge" UBYTE DFES_OneToOne 1 100 0.00 255.0 ECU_ADDRESS 0xD0008F33 /end MEASUREMENT
/begin MEASUREMENT DFES_EnvBlock178 "vollständige Umweldaten alle Fehlerspeichereinträge" UBYTE DFES_OneToOne 1 100 0.00 255.0 ECU_ADDRESS 0xD0008F34 /end MEASUREMENT
/begin MEASUREMENT DFES_EnvBlock179 "vollständige Umweldaten alle Fehlerspeichereinträge" UBYTE DFES_OneToOne 1 100 0.00 255.0 ECU_ADDRESS 0xD0008F35 /end MEASUREMENT
/begin MEASUREMENT DFES_EnvBlock180 "vollständige Umweldaten alle Fehlerspeichereinträge" UBYTE DFES_OneToOne 1 100 0.00 255.0 ECU_ADDRESS 0xD0008F36 /end MEASUREMENT
/begin MEASUREMENT DFES_EnvBlock181 "vollständige Umweldaten alle Fehlerspeichereinträge" UBYTE DFES_OneToOne 1 100 0.00 255.0 ECU_ADDRESS 0xD0008F37 /end MEASUREMENT
/begin MEASUREMENT DFES_EnvBlock182 "vollständige Umweldaten alle Fehlerspeichereinträge" UBYTE DFES_OneToOne 1 100 0.00 255.0 ECU_ADDRESS 0xD0008F38 /end MEASUREMENT
/begin MEASUREMENT DFES_EnvBlock183 "vollständige Umweldaten alle Fehlerspeichereinträge" UBYTE DFES_OneToOne 1 100 0.00 255.0 ECU_ADDRESS 0xD0008F39 /end MEASUREMENT
/begin MEASUREMENT DFES_EnvBlock184 "vollständige Umweldaten alle Fehlerspeichereinträge" UBYTE DFES_OneToOne 1 100 0.00 255.0 ECU_ADDRESS 0xD0008F3A /end MEASUREMENT
/begin MEASUREMENT DFES_EnvBlock185 "vollständige Umweldaten alle Fehlerspeichereinträge" UBYTE DFES_OneToOne 1 100 0.00 255.0 ECU_ADDRESS 0xD0008F3B /end MEASUREMENT
/begin MEASUREMENT DFES_EnvBlock186 "vollständige Umweldaten alle Fehlerspeichereinträge" UBYTE DFES_OneToOne 1 100 0.00 255.0 ECU_ADDRESS 0xD0008F3C /end MEASUREMENT
/begin MEASUREMENT DFES_EnvBlock187 "vollständige Umweldaten alle Fehlerspeichereinträge" UBYTE DFES_OneToOne 1 100 0.00 255.0 ECU_ADDRESS 0xD0008F3D /end MEASUREMENT
/begin MEASUREMENT DFES_EnvBlock188 "vollständige Umweldaten alle Fehlerspeichereinträge" UBYTE DFES_OneToOne 1 100 0.00 255.0 ECU_ADDRESS 0xD0008F3E /end MEASUREMENT
/begin MEASUREMENT DFES_EnvBlock189 "vollständige Umweldaten alle Fehlerspeichereinträge" UBYTE DFES_OneToOne 1 100 0.00 255.0 ECU_ADDRESS 0xD0008F3F /end MEASUREMENT
/begin MEASUREMENT DFES_EnvBlock190 "vollständige Umweldaten alle Fehlerspeichereinträge" UBYTE DFES_OneToOne 1 100 0.00 255.0 ECU_ADDRESS 0xD0008F40 /end MEASUREMENT
/begin MEASUREMENT DFES_EnvBlock191 "vollständige Umweldaten alle Fehlerspeichereinträge" UBYTE DFES_OneToOne 1 100 0.00 255.0 ECU_ADDRESS 0xD0008F41 /end MEASUREMENT
/begin MEASUREMENT DFES_EnvBlock192 "vollständige Umweldaten alle Fehlerspeichereinträge" UBYTE DFES_OneToOne 1 100 0.00 255.0 ECU_ADDRESS 0xD0008F42 /end MEASUREMENT
/begin MEASUREMENT DFES_EnvBlock193 "vollständige Umweldaten alle Fehlerspeichereinträge" UBYTE DFES_OneToOne 1 100 0.00 255.0 ECU_ADDRESS 0xD0008F43 /end MEASUREMENT
/begin MEASUREMENT DFES_EnvBlock194 "vollständige Umweldaten alle Fehlerspeichereinträge" UBYTE DFES_OneToOne 1 100 0.00 255.0 ECU_ADDRESS 0xD0008F44 /end MEASUREMENT
/begin MEASUREMENT DFES_EnvBlock195 "vollständige Umweldaten alle Fehlerspeichereinträge" UBYTE DFES_OneToOne 1 100 0.00 255.0 ECU_ADDRESS 0xD0008F45 /end MEASUREMENT
/begin MEASUREMENT DFES_EnvBlock196 "vollständige Umweldaten alle Fehlerspeichereinträge" UBYTE DFES_OneToOne 1 100 0.00 255.0 ECU_ADDRESS 0xD0008F46 /end MEASUREMENT
/begin MEASUREMENT DFES_EnvBlock197 "vollständige Umweldaten alle Fehlerspeichereinträge" UBYTE DFES_OneToOne 1 100 0.00 255.0 ECU_ADDRESS 0xD0008F47 /end MEASUREMENT
/begin MEASUREMENT DFES_EnvBlock198 "vollständige Umweldaten alle Fehlerspeichereinträge" UBYTE DFES_OneToOne 1 100 0.00 255.0 ECU_ADDRESS 0xD0008F48 /end MEASUREMENT
/begin MEASUREMENT DFES_EnvBlock199 "vollständige Umweldaten alle Fehlerspeichereinträge" UBYTE DFES_OneToOne 1 100 0.00 255.0 ECU_ADDRESS 0xD0008F49 /end MEASUREMENT
/begin MEASUREMENT DFES_EnvBlock200 "vollständige Umweldaten alle Fehlerspeichereinträge" UBYTE DFES_OneToOne 1 100 0.00 255.0 ECU_ADDRESS 0xD0008F4A /end MEASUREMENT
/begin MEASUREMENT DFES_EnvBlock201 "vollständige Umweldaten alle Fehlerspeichereinträge" UBYTE DFES_OneToOne 1 100 0.00 255.0 ECU_ADDRESS 0xD0008F4B /end MEASUREMENT
/begin MEASUREMENT DFES_EnvBlock202 "vollständige Umweldaten alle Fehlerspeichereinträge" UBYTE DFES_OneToOne 1 100 0.00 255.0 ECU_ADDRESS 0xD0008F4C /end MEASUREMENT
/begin MEASUREMENT DFES_EnvBlock203 "vollständige Umweldaten alle Fehlerspeichereinträge" UBYTE DFES_OneToOne 1 100 0.00 255.0 ECU_ADDRESS 0xD0008F4D /end MEASUREMENT
/begin MEASUREMENT DFES_EnvBlock204 "vollständige Umweldaten alle Fehlerspeichereinträge" UBYTE DFES_OneToOne 1 100 0.00 255.0 ECU_ADDRESS 0xD0008F4E /end MEASUREMENT
/begin MEASUREMENT DFES_EnvBlock205 "vollständige Umweldaten alle Fehlerspeichereinträge" UBYTE DFES_OneToOne 1 100 0.00 255.0 ECU_ADDRESS 0xD0008F4F /end MEASUREMENT
/begin MEASUREMENT DFES_EnvBlock206 "vollständige Umweldaten alle Fehlerspeichereinträge" UBYTE DFES_OneToOne 1 100 0.00 255.0 ECU_ADDRESS 0xD0008F50 /end MEASUREMENT
/begin MEASUREMENT DFES_EnvBlock207 "vollständige Umweldaten alle Fehlerspeichereinträge" UBYTE DFES_OneToOne 1 100 0.00 255.0 ECU_ADDRESS 0xD0008F51 /end MEASUREMENT
/begin MEASUREMENT DFES_EnvBlock208 "vollständige Umweldaten alle Fehlerspeichereinträge" UBYTE DFES_OneToOne 1 100 0.00 255.0 ECU_ADDRESS 0xD0008F52 /end MEASUREMENT
/begin MEASUREMENT DFES_EnvBlock209 "vollständige Umweldaten alle Fehlerspeichereinträge" UBYTE DFES_OneToOne 1 100 0.00 255.0 ECU_ADDRESS 0xD0008F53 /end MEASUREMENT
/begin MEASUREMENT DFES_EnvBlock210 "vollständige Umweldaten alle Fehlerspeichereinträge" UBYTE DFES_OneToOne 1 100 0.00 255.0 ECU_ADDRESS 0xD0008F54 /end MEASUREMENT
/begin MEASUREMENT DFES_EnvBlock211 "vollständige Umweldaten alle Fehlerspeichereinträge" UBYTE DFES_OneToOne 1 100 0.00 255.0 ECU_ADDRESS 0xD0008F55 /end MEASUREMENT
/begin MEASUREMENT DFES_EnvBlock212 "vollständige Umweldaten alle Fehlerspeichereinträge" UBYTE DFES_OneToOne 1 100 0.00 255.0 ECU_ADDRESS 0xD0008F56 /end MEASUREMENT
/begin MEASUREMENT DFES_EnvBlock213 "vollständige Umweldaten alle Fehlerspeichereinträge" UBYTE DFES_OneToOne 1 100 0.00 255.0 ECU_ADDRESS 0xD0008F57 /end MEASUREMENT
/begin MEASUREMENT DFES_EnvBlock214 "vollständige Umweldaten alle Fehlerspeichereinträge" UBYTE DFES_OneToOne 1 100 0.00 255.0 ECU_ADDRESS 0xD0008F58 /end MEASUREMENT
/begin MEASUREMENT DFES_EnvBlock215 "vollständige Umweldaten alle Fehlerspeichereinträge" UBYTE DFES_OneToOne 1 100 0.00 255.0 ECU_ADDRESS 0xD0008F59 /end MEASUREMENT
/begin MEASUREMENT DFES_EnvBlock216 "vollständige Umweldaten alle Fehlerspeichereinträge" UBYTE DFES_OneToOne 1 100 0.00 255.0 ECU_ADDRESS 0xD0008F5A /end MEASUREMENT
/begin MEASUREMENT DFES_EnvBlock217 "vollständige Umweldaten alle Fehlerspeichereinträge" UBYTE DFES_OneToOne 1 100 0.00 255.0 ECU_ADDRESS 0xD0008F5B /end MEASUREMENT
/begin MEASUREMENT DFES_EnvBlock218 "vollständige Umweldaten alle Fehlerspeichereinträge" UBYTE DFES_OneToOne 1 100 0.00 255.0 ECU_ADDRESS 0xD0008F5C /end MEASUREMENT
/begin MEASUREMENT DFES_EnvBlock219 "vollständige Umweldaten alle Fehlerspeichereinträge" UBYTE DFES_OneToOne 1 100 0.00 255.0 ECU_ADDRESS 0xD0008F5D /end MEASUREMENT
/begin MEASUREMENT DFES_EnvBlock220 "vollständige Umweldaten alle Fehlerspeichereinträge" UBYTE DFES_OneToOne 1 100 0.00 255.0 ECU_ADDRESS 0xD0008F5E /end MEASUREMENT
/begin MEASUREMENT DFES_EnvBlock221 "vollständige Umweldaten alle Fehlerspeichereinträge" UBYTE DFES_OneToOne 1 100 0.00 255.0 ECU_ADDRESS 0xD0008F5F /end MEASUREMENT
/begin MEASUREMENT DFES_EnvBlock222 "vollständige Umweldaten alle Fehlerspeichereinträge" UBYTE DFES_OneToOne 1 100 0.00 255.0 ECU_ADDRESS 0xD0008F60 /end MEASUREMENT
/begin MEASUREMENT DFES_EnvBlock223 "vollständige Umweldaten alle Fehlerspeichereinträge" UBYTE DFES_OneToOne 1 100 0.00 255.0 ECU_ADDRESS 0xD0008F61 /end MEASUREMENT
/begin MEASUREMENT DFES_EnvBlock224 "vollständige Umweldaten alle Fehlerspeichereinträge" UBYTE DFES_OneToOne 1 100 0.00 255.0 ECU_ADDRESS 0xD0008F62 /end MEASUREMENT
/begin MEASUREMENT DFES_EnvBlock225 "vollständige Umweldaten alle Fehlerspeichereinträge" UBYTE DFES_OneToOne 1 100 0.00 255.0 ECU_ADDRESS 0xD0008F63 /end MEASUREMENT
/begin MEASUREMENT DFES_EnvBlock226 "vollständige Umweldaten alle Fehlerspeichereinträge" UBYTE DFES_OneToOne 1 100 0.00 255.0 ECU_ADDRESS 0xD0008F64 /end MEASUREMENT
/begin MEASUREMENT DFES_EnvBlock227 "vollständige Umweldaten alle Fehlerspeichereinträge" UBYTE DFES_OneToOne 1 100 0.00 255.0 ECU_ADDRESS 0xD0008F65 /end MEASUREMENT
/begin MEASUREMENT DFES_EnvBlock228 "vollständige Umweldaten alle Fehlerspeichereinträge" UBYTE DFES_OneToOne 1 100 0.00 255.0 ECU_ADDRESS 0xD0008F66 /end MEASUREMENT
/begin MEASUREMENT DFES_EnvBlock229 "vollständige Umweldaten alle Fehlerspeichereinträge" UBYTE DFES_OneToOne 1 100 0.00 255.0 ECU_ADDRESS 0xD0008F67 /end MEASUREMENT
/begin MEASUREMENT DFES_EnvBlock230 "vollständige Umweldaten alle Fehlerspeichereinträge" UBYTE DFES_OneToOne 1 100 0.00 255.0 ECU_ADDRESS 0xD0008F68 /end MEASUREMENT
/begin MEASUREMENT DFES_EnvBlock231 "vollständige Umweldaten alle Fehlerspeichereinträge" UBYTE DFES_OneToOne 1 100 0.00 255.0 ECU_ADDRESS 0xD0008F69 /end MEASUREMENT
/begin MEASUREMENT DFES_EnvBlock232 "vollständige Umweldaten alle Fehlerspeichereinträge" UBYTE DFES_OneToOne 1 100 0.00 255.0 ECU_ADDRESS 0xD0008F6A /end MEASUREMENT
/begin MEASUREMENT DFES_EnvBlock233 "vollständige Umweldaten alle Fehlerspeichereinträge" UBYTE DFES_OneToOne 1 100 0.00 255.0 ECU_ADDRESS 0xD0008F6B /end MEASUREMENT
/begin MEASUREMENT DFES_EnvBlock234 "vollständige Umweldaten alle Fehlerspeichereinträge" UBYTE DFES_OneToOne 1 100 0.00 255.0 ECU_ADDRESS 0xD0008F6C /end MEASUREMENT
/begin MEASUREMENT DFES_EnvBlock235 "vollständige Umweldaten alle Fehlerspeichereinträge" UBYTE DFES_OneToOne 1 100 0.00 255.0 ECU_ADDRESS 0xD0008F6D /end MEASUREMENT
/begin MEASUREMENT DFES_EnvBlock236 "vollständige Umweldaten alle Fehlerspeichereinträge" UBYTE DFES_OneToOne 1 100 0.00 255.0 ECU_ADDRESS 0xD0008F6E /end MEASUREMENT
/begin MEASUREMENT DFES_EnvBlock237 "vollständige Umweldaten alle Fehlerspeichereinträge" UBYTE DFES_OneToOne 1 100 0.00 255.0 ECU_ADDRESS 0xD0008F6F /end MEASUREMENT
/begin MEASUREMENT DFES_EnvBlock238 "vollständige Umweldaten alle Fehlerspeichereinträge" UBYTE DFES_OneToOne 1 100 0.00 255.0 ECU_ADDRESS 0xD0008F70 /end MEASUREMENT
/begin MEASUREMENT DFES_EnvBlock239 "vollständige Umweldaten alle Fehlerspeichereinträge" UBYTE DFES_OneToOne 1 100 0.00 255.0 ECU_ADDRESS 0xD0008F71 /end MEASUREMENT
/begin MEASUREMENT DFES_EnvBlock240 "vollständige Umweldaten alle Fehlerspeichereinträge" UBYTE DFES_OneToOne 1 100 0.00 255.0 ECU_ADDRESS 0xD0008F72 /end MEASUREMENT
/begin MEASUREMENT DFES_EnvBlock241 "vollständige Umweldaten alle Fehlerspeichereinträge" UBYTE DFES_OneToOne 1 100 0.00 255.0 ECU_ADDRESS 0xD0008F73 /end MEASUREMENT
/begin MEASUREMENT DFES_EnvBlock242 "vollständige Umweldaten alle Fehlerspeichereinträge" UBYTE DFES_OneToOne 1 100 0.00 255.0 ECU_ADDRESS 0xD0008F74 /end MEASUREMENT
/begin MEASUREMENT DFES_EnvBlock243 "vollständige Umweldaten alle Fehlerspeichereinträge" UBYTE DFES_OneToOne 1 100 0.00 255.0 ECU_ADDRESS 0xD0008F75 /end MEASUREMENT
/begin MEASUREMENT DFES_EnvBlock244 "vollständige Umweldaten alle Fehlerspeichereinträge" UBYTE DFES_OneToOne 1 100 0.00 255.0 ECU_ADDRESS 0xD0008F76 /end MEASUREMENT
/begin MEASUREMENT DFES_EnvBlock245 "vollständige Umweldaten alle Fehlerspeichereinträge" UBYTE DFES_OneToOne 1 100 0.00 255.0 ECU_ADDRESS 0xD0008F77 /end MEASUREMENT
/begin MEASUREMENT DFES_EnvBlock246 "vollständige Umweldaten alle Fehlerspeichereinträge" UBYTE DFES_OneToOne 1 100 0.00 255.0 ECU_ADDRESS 0xD0008F78 /end MEASUREMENT
/begin MEASUREMENT DFES_EnvBlock247 "vollständige Umweldaten alle Fehlerspeichereinträge" UBYTE DFES_OneToOne 1 100 0.00 255.0 ECU_ADDRESS 0xD0008F79 /end MEASUREMENT
/begin MEASUREMENT DFES_EnvBlock248 "vollständige Umweldaten alle Fehlerspeichereinträge" UBYTE DFES_OneToOne 1 100 0.00 255.0 ECU_ADDRESS 0xD0008F7A /end MEASUREMENT
/begin MEASUREMENT DFES_EnvBlock249 "vollständige Umweldaten alle Fehlerspeichereinträge" UBYTE DFES_OneToOne 1 100 0.00 255.0 ECU_ADDRESS 0xD0008F7B /end MEASUREMENT
/begin MEASUREMENT DFES_EnvBlock250 "vollständige Umweldaten alle Fehlerspeichereinträge" UBYTE DFES_OneToOne 1 100 0.00 255.0 ECU_ADDRESS 0xD0008F7C /end MEASUREMENT
/begin MEASUREMENT DFES_EnvBlock251 "vollständige Umweldaten alle Fehlerspeichereinträge" UBYTE DFES_OneToOne 1 100 0.00 255.0 ECU_ADDRESS 0xD0008F7D /end MEASUREMENT
/begin MEASUREMENT DFES_EnvBlock252 "vollständige Umweldaten alle Fehlerspeichereinträge" UBYTE DFES_OneToOne 1 100 0.00 255.0 ECU_ADDRESS 0xD0008F7E /end MEASUREMENT
/begin MEASUREMENT DFES_EnvBlock253 "vollständige Umweldaten alle Fehlerspeichereinträge" UBYTE DFES_OneToOne 1 100 0.00 255.0 ECU_ADDRESS 0xD0008F7F /end MEASUREMENT
/begin MEASUREMENT DFES_EnvBlock254 "vollständige Umweldaten alle Fehlerspeichereinträge" UBYTE DFES_OneToOne 1 100 0.00 255.0 ECU_ADDRESS 0xD0008F80 /end MEASUREMENT
/begin MEASUREMENT DFES_EnvBlock255 "vollständige Umweldaten alle Fehlerspeichereinträge" UBYTE DFES_OneToOne 1 100 0.00 255.0 ECU_ADDRESS 0xD0008F81 /end MEASUREMENT
/begin MEASUREMENT DFES_EnvBlock256 "vollständige Umweldaten alle Fehlerspeichereinträge" UBYTE DFES_OneToOne 1 100 0.00 255.0 ECU_ADDRESS 0xD0008F82 /end MEASUREMENT
/begin MEASUREMENT DFES_EnvBlock257 "vollständige Umweldaten alle Fehlerspeichereinträge" UBYTE DFES_OneToOne 1 100 0.00 255.0 ECU_ADDRESS 0xD0008F83 /end MEASUREMENT
/begin MEASUREMENT DFES_EnvBlock258 "vollständige Umweldaten alle Fehlerspeichereinträge" UBYTE DFES_OneToOne 1 100 0.00 255.0 ECU_ADDRESS 0xD0008F84 /end MEASUREMENT
/begin MEASUREMENT DFES_EnvBlock259 "vollständige Umweldaten alle Fehlerspeichereinträge" UBYTE DFES_OneToOne 1 100 0.00 255.0 ECU_ADDRESS 0xD0008F85 /end MEASUREMENT
/begin MEASUREMENT DFES_EnvBlock260 "vollständige Umweldaten alle Fehlerspeichereinträge" UBYTE DFES_OneToOne 1 100 0.00 255.0 ECU_ADDRESS 0xD0008F86 /end MEASUREMENT
/begin MEASUREMENT DFES_EnvBlock261 "vollständige Umweldaten alle Fehlerspeichereinträge" UBYTE DFES_OneToOne 1 100 0.00 255.0 ECU_ADDRESS 0xD0008F87 /end MEASUREMENT
/begin MEASUREMENT DFES_EnvBlock262 "vollständige Umweldaten alle Fehlerspeichereinträge" UBYTE DFES_OneToOne 1 100 0.00 255.0 ECU_ADDRESS 0xD0008F88 /end MEASUREMENT
/begin MEASUREMENT DFES_EnvBlock263 "vollständige Umweldaten alle Fehlerspeichereinträge" UBYTE DFES_OneToOne 1 100 0.00 255.0 ECU_ADDRESS 0xD0008F89 /end MEASUREMENT
/begin MEASUREMENT DFES_EnvBlock264 "vollständige Umweldaten alle Fehlerspeichereinträge" UBYTE DFES_OneToOne 1 100 0.00 255.0 ECU_ADDRESS 0xD0008F8A /end MEASUREMENT
/begin MEASUREMENT DFES_EnvBlock265 "vollständige Umweldaten alle Fehlerspeichereinträge" UBYTE DFES_OneToOne 1 100 0.00 255.0 ECU_ADDRESS 0xD0008F8B /end MEASUREMENT
/begin MEASUREMENT DFES_EnvBlock266 "vollständige Umweldaten alle Fehlerspeichereinträge" UBYTE DFES_OneToOne 1 100 0.00 255.0 ECU_ADDRESS 0xD0008F8C /end MEASUREMENT
/begin MEASUREMENT DFES_EnvBlock267 "vollständige Umweldaten alle Fehlerspeichereinträge" UBYTE DFES_OneToOne 1 100 0.00 255.0 ECU_ADDRESS 0xD0008F8D /end MEASUREMENT
/begin MEASUREMENT DFES_EnvBlock268 "vollständige Umweldaten alle Fehlerspeichereinträge" UBYTE DFES_OneToOne 1 100 0.00 255.0 ECU_ADDRESS 0xD0008F8E /end MEASUREMENT
/begin MEASUREMENT DFES_EnvBlock269 "vollständige Umweldaten alle Fehlerspeichereinträge" UBYTE DFES_OneToOne 1 100 0.00 255.0 ECU_ADDRESS 0xD0008F8F /end MEASUREMENT
/begin MEASUREMENT DFES_EnvBlock270 "vollständige Umweldaten alle Fehlerspeichereinträge" UBYTE DFES_OneToOne 1 100 0.00 255.0 ECU_ADDRESS 0xD0008F90 /end MEASUREMENT
/begin MEASUREMENT DFES_EnvBlock271 "vollständige Umweldaten alle Fehlerspeichereinträge" UBYTE DFES_OneToOne 1 100 0.00 255.0 ECU_ADDRESS 0xD0008F91 /end MEASUREMENT
/begin MEASUREMENT DFES_EnvBlock272 "vollständige Umweldaten alle Fehlerspeichereinträge" UBYTE DFES_OneToOne 1 100 0.00 255.0 ECU_ADDRESS 0xD0008F92 /end MEASUREMENT
/begin MEASUREMENT DFES_EnvBlock273 "vollständige Umweldaten alle Fehlerspeichereinträge" UBYTE DFES_OneToOne 1 100 0.00 255.0 ECU_ADDRESS 0xD0008F93 /end MEASUREMENT
/begin MEASUREMENT DFES_EnvBlock274 "vollständige Umweldaten alle Fehlerspeichereinträge" UBYTE DFES_OneToOne 1 100 0.00 255.0 ECU_ADDRESS 0xD0008F94 /end MEASUREMENT
/begin MEASUREMENT DFES_EnvBlock275 "vollständige Umweldaten alle Fehlerspeichereinträge" UBYTE DFES_OneToOne 1 100 0.00 255.0 ECU_ADDRESS 0xD0008F95 /end MEASUREMENT
/begin MEASUREMENT DFES_EnvBlock276 "vollständige Umweldaten alle Fehlerspeichereinträge" UBYTE DFES_OneToOne 1 100 0.00 255.0 ECU_ADDRESS 0xD0008F96 /end MEASUREMENT
/begin MEASUREMENT DFES_EnvBlock277 "vollständige Umweldaten alle Fehlerspeichereinträge" UBYTE DFES_OneToOne 1 100 0.00 255.0 ECU_ADDRESS 0xD0008F97 /end MEASUREMENT
/begin MEASUREMENT DFES_EnvBlock278 "vollständige Umweldaten alle Fehlerspeichereinträge" UBYTE DFES_OneToOne 1 100 0.00 255.0 ECU_ADDRESS 0xD0008F98 /end MEASUREMENT
/begin MEASUREMENT DFES_EnvBlock279 "vollständige Umweldaten alle Fehlerspeichereinträge" UBYTE DFES_OneToOne 1 100 0.00 255.0 ECU_ADDRESS 0xD0008F99 /end MEASUREMENT
/begin MEASUREMENT DFES_EnvBlock280 "vollständige Umweldaten alle Fehlerspeichereinträge" UBYTE DFES_OneToOne 1 100 0.00 255.0 ECU_ADDRESS 0xD0008F9A /end MEASUREMENT
/begin MEASUREMENT DFES_EnvBlock281 "vollständige Umweldaten alle Fehlerspeichereinträge" UBYTE DFES_OneToOne 1 100 0.00 255.0 ECU_ADDRESS 0xD0008F9B /end MEASUREMENT
/begin MEASUREMENT DFES_EnvBlock282 "vollständige Umweldaten alle Fehlerspeichereinträge" UBYTE DFES_OneToOne 1 100 0.00 255.0 ECU_ADDRESS 0xD0008F9C /end MEASUREMENT
/begin MEASUREMENT DFES_EnvBlock283 "vollständige Umweldaten alle Fehlerspeichereinträge" UBYTE DFES_OneToOne 1 100 0.00 255.0 ECU_ADDRESS 0xD0008F9D /end MEASUREMENT
/begin MEASUREMENT DFES_EnvBlock284 "vollständige Umweldaten alle Fehlerspeichereinträge" UBYTE DFES_OneToOne 1 100 0.00 255.0 ECU_ADDRESS 0xD0008F9E /end MEASUREMENT
/begin MEASUREMENT DFES_EnvBlock285 "vollständige Umweldaten alle Fehlerspeichereinträge" UBYTE DFES_OneToOne 1 100 0.00 255.0 ECU_ADDRESS 0xD0008F9F /end MEASUREMENT
/begin MEASUREMENT DFES_EnvBlock286 "vollständige Umweldaten alle Fehlerspeichereinträge" UBYTE DFES_OneToOne 1 100 0.00 255.0 ECU_ADDRESS 0xD0008FA0 /end MEASUREMENT
/begin MEASUREMENT DFES_EnvBlock287 "vollständige Umweldaten alle Fehlerspeichereinträge" UBYTE DFES_OneToOne 1 100 0.00 255.0 ECU_ADDRESS 0xD0008FA1 /end MEASUREMENT
/begin MEASUREMENT DFES_EnvBlock288 "vollständige Umweldaten alle Fehlerspeichereinträge" UBYTE DFES_OneToOne 1 100 0.00 255.0 ECU_ADDRESS 0xD0008FA2 /end MEASUREMENT
/begin MEASUREMENT DFES_EnvBlock289 "vollständige Umweldaten alle Fehlerspeichereinträge" UBYTE DFES_OneToOne 1 100 0.00 255.0 ECU_ADDRESS 0xD0008FA3 /end MEASUREMENT
/begin MEASUREMENT DFES_EnvBlock290 "vollständige Umweldaten alle Fehlerspeichereinträge" UBYTE DFES_OneToOne 1 100 0.00 255.0 ECU_ADDRESS 0xD0008FA4 /end MEASUREMENT
/begin MEASUREMENT DFES_EnvBlock291 "vollständige Umweldaten alle Fehlerspeichereinträge" UBYTE DFES_OneToOne 1 100 0.00 255.0 ECU_ADDRESS 0xD0008FA5 /end MEASUREMENT
/begin MEASUREMENT DFES_EnvBlock292 "vollständige Umweldaten alle Fehlerspeichereinträge" UBYTE DFES_OneToOne 1 100 0.00 255.0 ECU_ADDRESS 0xD0008FA6 /end MEASUREMENT
/begin MEASUREMENT DFES_EnvBlock293 "vollständige Umweldaten alle Fehlerspeichereinträge" UBYTE DFES_OneToOne 1 100 0.00 255.0 ECU_ADDRESS 0xD0008FA7 /end MEASUREMENT
/begin MEASUREMENT DFES_EnvBlock294 "vollständige Umweldaten alle Fehlerspeichereinträge" UBYTE DFES_OneToOne 1 100 0.00 255.0 ECU_ADDRESS 0xD0008FA8 /end MEASUREMENT
/begin MEASUREMENT DFES_EnvBlock295 "vollständige Umweldaten alle Fehlerspeichereinträge" UBYTE DFES_OneToOne 1 100 0.00 255.0 ECU_ADDRESS 0xD0008FA9 /end MEASUREMENT
/begin MEASUREMENT DFES_EnvBlock296 "vollständige Umweldaten alle Fehlerspeichereinträge" UBYTE DFES_OneToOne 1 100 0.00 255.0 ECU_ADDRESS 0xD0008FAA /end MEASUREMENT
/begin MEASUREMENT DFES_EnvBlock297 "vollständige Umweldaten alle Fehlerspeichereinträge" UBYTE DFES_OneToOne 1 100 0.00 255.0 ECU_ADDRESS 0xD0008FAB /end MEASUREMENT
/begin MEASUREMENT DFES_EnvBlock298 "vollständige Umweldaten alle Fehlerspeichereinträge" UBYTE DFES_OneToOne 1 100 0.00 255.0 ECU_ADDRESS 0xD0008FAC /end MEASUREMENT
/begin MEASUREMENT DFES_EnvBlock299 "vollständige Umweldaten alle Fehlerspeichereinträge" UBYTE DFES_OneToOne 1 100 0.00 255.0 ECU_ADDRESS 0xD0008FAD /end MEASUREMENT
/begin MEASUREMENT DFES_EnvBlock300 "vollständige Umweldaten alle Fehlerspeichereinträge" UBYTE DFES_OneToOne 1 100 0.00 255.0 ECU_ADDRESS 0xD0008FAE /end MEASUREMENT
/begin MEASUREMENT DFES_EnvBlock301 "vollständige Umweldaten alle Fehlerspeichereinträge" UBYTE DFES_OneToOne 1 100 0.00 255.0 ECU_ADDRESS 0xD0008FAF /end MEASUREMENT
/begin MEASUREMENT DFES_EnvBlock302 "vollständige Umweldaten alle Fehlerspeichereinträge" UBYTE DFES_OneToOne 1 100 0.00 255.0 ECU_ADDRESS 0xD0008FB0 /end MEASUREMENT
/begin MEASUREMENT DFES_EnvBlock303 "vollständige Umweldaten alle Fehlerspeichereinträge" UBYTE DFES_OneToOne 1 100 0.00 255.0 ECU_ADDRESS 0xD0008FB1 /end MEASUREMENT
/begin MEASUREMENT DFES_EnvBlock304 "vollständige Umweldaten alle Fehlerspeichereinträge" UBYTE DFES_OneToOne 1 100 0.00 255.0 ECU_ADDRESS 0xD0008FB2 /end MEASUREMENT
/begin MEASUREMENT DFES_EnvBlock305 "vollständige Umweldaten alle Fehlerspeichereinträge" UBYTE DFES_OneToOne 1 100 0.00 255.0 ECU_ADDRESS 0xD0008FB3 /end MEASUREMENT
/begin MEASUREMENT DFES_EnvBlock306 "vollständige Umweldaten alle Fehlerspeichereinträge" UBYTE DFES_OneToOne 1 100 0.00 255.0 ECU_ADDRESS 0xD0008FB4 /end MEASUREMENT
/begin MEASUREMENT DFES_EnvBlock307 "vollständige Umweldaten alle Fehlerspeichereinträge" UBYTE DFES_OneToOne 1 100 0.00 255.0 ECU_ADDRESS 0xD0008FB5 /end MEASUREMENT
/begin MEASUREMENT DFES_EnvBlock308 "vollständige Umweldaten alle Fehlerspeichereinträge" UBYTE DFES_OneToOne 1 100 0.00 255.0 ECU_ADDRESS 0xD0008FB6 /end MEASUREMENT
/begin MEASUREMENT DFES_EnvBlock309 "vollständige Umweldaten alle Fehlerspeichereinträge" UBYTE DFES_OneToOne 1 100 0.00 255.0 ECU_ADDRESS 0xD0008FB7 /end MEASUREMENT
/begin MEASUREMENT DFES_EnvBlock310 "vollständige Umweldaten alle Fehlerspeichereinträge" UBYTE DFES_OneToOne 1 100 0.00 255.0 ECU_ADDRESS 0xD0008FB8 /end MEASUREMENT
/begin MEASUREMENT DFES_EnvBlock311 "vollständige Umweldaten alle Fehlerspeichereinträge" UBYTE DFES_OneToOne 1 100 0.00 255.0 ECU_ADDRESS 0xD0008FB9 /end MEASUREMENT
/begin MEASUREMENT DFES_EnvBlock312 "vollständige Umweldaten alle Fehlerspeichereinträge" UBYTE DFES_OneToOne 1 100 0.00 255.0 ECU_ADDRESS 0xD0008FBA /end MEASUREMENT
/begin MEASUREMENT DFES_EnvBlock313 "vollständige Umweldaten alle Fehlerspeichereinträge" UBYTE DFES_OneToOne 1 100 0.00 255.0 ECU_ADDRESS 0xD0008FBB /end MEASUREMENT
/begin MEASUREMENT DFES_EnvBlock314 "vollständige Umweldaten alle Fehlerspeichereinträge" UBYTE DFES_OneToOne 1 100 0.00 255.0 ECU_ADDRESS 0xD0008FBC /end MEASUREMENT
/begin MEASUREMENT DFES_EnvBlock315 "vollständige Umweldaten alle Fehlerspeichereinträge" UBYTE DFES_OneToOne 1 100 0.00 255.0 ECU_ADDRESS 0xD0008FBD /end MEASUREMENT
/begin MEASUREMENT DFES_EnvBlock316 "vollständige Umweldaten alle Fehlerspeichereinträge" UBYTE DFES_OneToOne 1 100 0.00 255.0 ECU_ADDRESS 0xD0008FBE /end MEASUREMENT
/begin MEASUREMENT DFES_EnvBlock317 "vollständige Umweldaten alle Fehlerspeichereinträge" UBYTE DFES_OneToOne 1 100 0.00 255.0 ECU_ADDRESS 0xD0008FBF /end MEASUREMENT
/begin MEASUREMENT DFES_EnvBlock318 "vollständige Umweldaten alle Fehlerspeichereinträge" UBYTE DFES_OneToOne 1 100 0.00 255.0 ECU_ADDRESS 0xD0008FC0 /end MEASUREMENT
/begin MEASUREMENT DFES_EnvBlock319 "vollständige Umweldaten alle Fehlerspeichereinträge" UBYTE DFES_OneToOne 1 100 0.00 255.0 ECU_ADDRESS 0xD0008FC1 /end MEASUREMENT
/begin MEASUREMENT DFES_EnvBlock320 "vollständige Umweldaten alle Fehlerspeichereinträge" UBYTE DFES_OneToOne 1 100 0.00 255.0 ECU_ADDRESS 0xD0008FC2 /end MEASUREMENT
/begin MEASUREMENT DFES_EnvBlock321 "vollständige Umweldaten alle Fehlerspeichereinträge" UBYTE DFES_OneToOne 1 100 0.00 255.0 ECU_ADDRESS 0xD0008FC3 /end MEASUREMENT
/begin MEASUREMENT DFES_EnvBlock322 "vollständige Umweldaten alle Fehlerspeichereinträge" UBYTE DFES_OneToOne 1 100 0.00 255.0 ECU_ADDRESS 0xD0008FC4 /end MEASUREMENT
/begin MEASUREMENT DFES_EnvBlock323 "vollständige Umweldaten alle Fehlerspeichereinträge" UBYTE DFES_OneToOne 1 100 0.00 255.0 ECU_ADDRESS 0xD0008FC5 /end MEASUREMENT
/begin MEASUREMENT DFES_EnvBlock324 "vollständige Umweldaten alle Fehlerspeichereinträge" UBYTE DFES_OneToOne 1 100 0.00 255.0 ECU_ADDRESS 0xD0008FC6 /end MEASUREMENT
/begin MEASUREMENT DFES_EnvBlock325 "vollständige Umweldaten alle Fehlerspeichereinträge" UBYTE DFES_OneToOne 1 100 0.00 255.0 ECU_ADDRESS 0xD0008FC7 /end MEASUREMENT
/begin MEASUREMENT DFES_EnvBlock326 "vollständige Umweldaten alle Fehlerspeichereinträge" UBYTE DFES_OneToOne 1 100 0.00 255.0 ECU_ADDRESS 0xD0008FC8 /end MEASUREMENT
/begin MEASUREMENT DFES_EnvBlock327 "vollständige Umweldaten alle Fehlerspeichereinträge" UBYTE DFES_OneToOne 1 100 0.00 255.0 ECU_ADDRESS 0xD0008FC9 /end MEASUREMENT
/begin MEASUREMENT DFES_EnvBlock328 "vollständige Umweldaten alle Fehlerspeichereinträge" UBYTE DFES_OneToOne 1 100 0.00 255.0 ECU_ADDRESS 0xD0008FCA /end MEASUREMENT
/begin MEASUREMENT DFES_EnvBlock329 "vollständige Umweldaten alle Fehlerspeichereinträge" UBYTE DFES_OneToOne 1 100 0.00 255.0 ECU_ADDRESS 0xD0008FCB /end MEASUREMENT
/begin MEASUREMENT DFES_EnvBlock330 "vollständige Umweldaten alle Fehlerspeichereinträge" UBYTE DFES_OneToOne 1 100 0.00 255.0 ECU_ADDRESS 0xD0008FCC /end MEASUREMENT
/begin MEASUREMENT DFES_EnvBlock331 "vollständige Umweldaten alle Fehlerspeichereinträge" UBYTE DFES_OneToOne 1 100 0.00 255.0 ECU_ADDRESS 0xD0008FCD /end MEASUREMENT
/begin MEASUREMENT DFES_EnvBlock332 "vollständige Umweldaten alle Fehlerspeichereinträge" UBYTE DFES_OneToOne 1 100 0.00 255.0 ECU_ADDRESS 0xD0008FCE /end MEASUREMENT
/begin MEASUREMENT DFES_EnvBlock333 "vollständige Umweldaten alle Fehlerspeichereinträge" UBYTE DFES_OneToOne 1 100 0.00 255.0 ECU_ADDRESS 0xD0008FCF /end MEASUREMENT
/begin MEASUREMENT DFES_EnvBlock334 "vollständige Umweldaten alle Fehlerspeichereinträge" UBYTE DFES_OneToOne 1 100 0.00 255.0 ECU_ADDRESS 0xD0008FD0 /end MEASUREMENT
/begin MEASUREMENT DFES_EnvBlock335 "vollständige Umweldaten alle Fehlerspeichereinträge" UBYTE DFES_OneToOne 1 100 0.00 255.0 ECU_ADDRESS 0xD0008FD1 /end MEASUREMENT
/begin MEASUREMENT DFES_EnvBlock336 "vollständige Umweldaten alle Fehlerspeichereinträge" UBYTE DFES_OneToOne 1 100 0.00 255.0 ECU_ADDRESS 0xD0008FD2 /end MEASUREMENT
/begin MEASUREMENT DFES_EnvBlock337 "vollständige Umweldaten alle Fehlerspeichereinträge" UBYTE DFES_OneToOne 1 100 0.00 255.0 ECU_ADDRESS 0xD0008FD3 /end MEASUREMENT
/begin MEASUREMENT DFES_EnvBlock338 "vollständige Umweldaten alle Fehlerspeichereinträge" UBYTE DFES_OneToOne 1 100 0.00 255.0 ECU_ADDRESS 0xD0008FD4 /end MEASUREMENT
/begin MEASUREMENT DFES_EnvBlock339 "vollständige Umweldaten alle Fehlerspeichereinträge" UBYTE DFES_OneToOne 1 100 0.00 255.0 ECU_ADDRESS 0xD0008FD5 /end MEASUREMENT
/begin MEASUREMENT DFES_EnvBlock340 "vollständige Umweldaten alle Fehlerspeichereinträge" UBYTE DFES_OneToOne 1 100 0.00 255.0 ECU_ADDRESS 0xD0008FD6 /end MEASUREMENT
/begin MEASUREMENT DFES_EnvBlock341 "vollständige Umweldaten alle Fehlerspeichereinträge" UBYTE DFES_OneToOne 1 100 0.00 255.0 ECU_ADDRESS 0xD0008FD7 /end MEASUREMENT
/begin MEASUREMENT DFES_EnvBlock342 "vollständige Umweldaten alle Fehlerspeichereinträge" UBYTE DFES_OneToOne 1 100 0.00 255.0 ECU_ADDRESS 0xD0008FD8 /end MEASUREMENT
/begin MEASUREMENT DFES_EnvBlock343 "vollständige Umweldaten alle Fehlerspeichereinträge" UBYTE DFES_OneToOne 1 100 0.00 255.0 ECU_ADDRESS 0xD0008FD9 /end MEASUREMENT
/begin MEASUREMENT DFES_EnvBlock344 "vollständige Umweldaten alle Fehlerspeichereinträge" UBYTE DFES_OneToOne 1 100 0.00 255.0 ECU_ADDRESS 0xD0008FDA /end MEASUREMENT
/begin MEASUREMENT DFES_EnvBlock345 "vollständige Umweldaten alle Fehlerspeichereinträge" UBYTE DFES_OneToOne 1 100 0.00 255.0 ECU_ADDRESS 0xD0008FDB /end MEASUREMENT
/begin MEASUREMENT DFES_EnvBlock346 "vollständige Umweldaten alle Fehlerspeichereinträge" UBYTE DFES_OneToOne 1 100 0.00 255.0 ECU_ADDRESS 0xD0008FDC /end MEASUREMENT
/begin MEASUREMENT DFES_EnvBlock347 "vollständige Umweldaten alle Fehlerspeichereinträge" UBYTE DFES_OneToOne 1 100 0.00 255.0 ECU_ADDRESS 0xD0008FDD /end MEASUREMENT
/begin MEASUREMENT DFES_EnvBlock348 "vollständige Umweldaten alle Fehlerspeichereinträge" UBYTE DFES_OneToOne 1 100 0.00 255.0 ECU_ADDRESS 0xD0008FDE /end MEASUREMENT
/begin MEASUREMENT DFES_EnvBlock349 "vollständige Umweldaten alle Fehlerspeichereinträge" UBYTE DFES_OneToOne 1 100 0.00 255.0 ECU_ADDRESS 0xD0008FDF /end MEASUREMENT
/begin MEASUREMENT DFES_EnvBlock350 "vollständige Umweldaten alle Fehlerspeichereinträge" UBYTE DFES_OneToOne 1 100 0.00 255.0 ECU_ADDRESS 0xD0008FE0 /end MEASUREMENT
/begin MEASUREMENT DFES_EnvBlock351 "vollständige Umweldaten alle Fehlerspeichereinträge" UBYTE DFES_OneToOne 1 100 0.00 255.0 ECU_ADDRESS 0xD0008FE1 /end MEASUREMENT
/begin MEASUREMENT DFES_EnvBlock352 "vollständige Umweldaten alle Fehlerspeichereinträge" UBYTE DFES_OneToOne 1 100 0.00 255.0 ECU_ADDRESS 0xD0008FE2 /end MEASUREMENT
/begin MEASUREMENT DFES_EnvBlock353 "vollständige Umweldaten alle Fehlerspeichereinträge" UBYTE DFES_OneToOne 1 100 0.00 255.0 ECU_ADDRESS 0xD0008FE3 /end MEASUREMENT
/begin MEASUREMENT DFES_EnvBlock354 "vollständige Umweldaten alle Fehlerspeichereinträge" UBYTE DFES_OneToOne 1 100 0.00 255.0 ECU_ADDRESS 0xD0008FE4 /end MEASUREMENT
/begin MEASUREMENT DFES_EnvBlock355 "vollständige Umweldaten alle Fehlerspeichereinträge" UBYTE DFES_OneToOne 1 100 0.00 255.0 ECU_ADDRESS 0xD0008FE5 /end MEASUREMENT
/begin MEASUREMENT DFES_EnvBlock356 "vollständige Umweldaten alle Fehlerspeichereinträge" UBYTE DFES_OneToOne 1 100 0.00 255.0 ECU_ADDRESS 0xD0008FE6 /end MEASUREMENT
/begin MEASUREMENT DFES_EnvBlock357 "vollständige Umweldaten alle Fehlerspeichereinträge" UBYTE DFES_OneToOne 1 100 0.00 255.0 ECU_ADDRESS 0xD0008FE7 /end MEASUREMENT
/begin MEASUREMENT DFES_EnvBlock358 "vollständige Umweldaten alle Fehlerspeichereinträge" UBYTE DFES_OneToOne 1 100 0.00 255.0 ECU_ADDRESS 0xD0008FE8 /end MEASUREMENT
/begin MEASUREMENT DFES_EnvBlock359 "vollständige Umweldaten alle Fehlerspeichereinträge" UBYTE DFES_OneToOne 1 100 0.00 255.0 ECU_ADDRESS 0xD0008FE9 /end MEASUREMENT
/begin MEASUREMENT DFES_EnvBlock360 "vollständige Umweldaten alle Fehlerspeichereinträge" UBYTE DFES_OneToOne 1 100 0.00 255.0 ECU_ADDRESS 0xD0008FEA /end MEASUREMENT
/begin MEASUREMENT DFES_EnvBlock361 "vollständige Umweldaten alle Fehlerspeichereinträge" UBYTE DFES_OneToOne 1 100 0.00 255.0 ECU_ADDRESS 0xD0008FEB /end MEASUREMENT
/begin MEASUREMENT DFES_EnvBlock362 "vollständige Umweldaten alle Fehlerspeichereinträge" UBYTE DFES_OneToOne 1 100 0.00 255.0 ECU_ADDRESS 0xD0008FEC /end MEASUREMENT
/begin MEASUREMENT DFES_EnvBlock363 "vollständige Umweldaten alle Fehlerspeichereinträge" UBYTE DFES_OneToOne 1 100 0.00 255.0 ECU_ADDRESS 0xD0008FED /end MEASUREMENT
/begin MEASUREMENT DFES_EnvBlock364 "vollständige Umweldaten alle Fehlerspeichereinträge" UBYTE DFES_OneToOne 1 100 0.00 255.0 ECU_ADDRESS 0xD0008FEE /end MEASUREMENT
/begin MEASUREMENT DFES_EnvBlock365 "vollständige Umweldaten alle Fehlerspeichereinträge" UBYTE DFES_OneToOne 1 100 0.00 255.0 ECU_ADDRESS 0xD0008FEF /end MEASUREMENT
/begin MEASUREMENT DFES_EnvBlock366 "vollständige Umweldaten alle Fehlerspeichereinträge" UBYTE DFES_OneToOne 1 100 0.00 255.0 ECU_ADDRESS 0xD0008FF0 /end MEASUREMENT
/begin MEASUREMENT DFES_EnvBlock367 "vollständige Umweldaten alle Fehlerspeichereinträge" UBYTE DFES_OneToOne 1 100 0.00 255.0 ECU_ADDRESS 0xD0008FF1 /end MEASUREMENT
/begin MEASUREMENT DFES_EnvBlock368 "vollständige Umweldaten alle Fehlerspeichereinträge" UBYTE DFES_OneToOne 1 100 0.00 255.0 ECU_ADDRESS 0xD0008FF2 /end MEASUREMENT
/begin MEASUREMENT DFES_EnvBlock369 "vollständige Umweldaten alle Fehlerspeichereinträge" UBYTE DFES_OneToOne 1 100 0.00 255.0 ECU_ADDRESS 0xD0008FF3 /end MEASUREMENT
/begin MEASUREMENT DFES_EnvBlock370 "vollständige Umweldaten alle Fehlerspeichereinträge" UBYTE DFES_OneToOne 1 100 0.00 255.0 ECU_ADDRESS 0xD0008FF4 /end MEASUREMENT
/begin MEASUREMENT DFES_EnvBlock371 "vollständige Umweldaten alle Fehlerspeichereinträge" UBYTE DFES_OneToOne 1 100 0.00 255.0 ECU_ADDRESS 0xD0008FF5 /end MEASUREMENT
/begin MEASUREMENT DFES_EnvBlock372 "vollständige Umweldaten alle Fehlerspeichereinträge" UBYTE DFES_OneToOne 1 100 0.00 255.0 ECU_ADDRESS 0xD0008FF6 /end MEASUREMENT
/begin MEASUREMENT DFES_EnvBlock373 "vollständige Umweldaten alle Fehlerspeichereinträge" UBYTE DFES_OneToOne 1 100 0.00 255.0 ECU_ADDRESS 0xD0008FF7 /end MEASUREMENT
/begin MEASUREMENT DFES_EnvBlock374 "vollständige Umweldaten alle Fehlerspeichereinträge" UBYTE DFES_OneToOne 1 100 0.00 255.0 ECU_ADDRESS 0xD0008FF8 /end MEASUREMENT
/begin MEASUREMENT DFES_EnvBlock375 "vollständige Umweldaten alle Fehlerspeichereinträge" UBYTE DFES_OneToOne 1 100 0.00 255.0 ECU_ADDRESS 0xD0008FF9 /end MEASUREMENT
/begin MEASUREMENT DFES_EnvBlock376 "vollständige Umweldaten alle Fehlerspeichereinträge" UBYTE DFES_OneToOne 1 100 0.00 255.0 ECU_ADDRESS 0xD0008FFA /end MEASUREMENT
/begin MEASUREMENT DFES_EnvBlock377 "vollständige Umweldaten alle Fehlerspeichereinträge" UBYTE DFES_OneToOne 1 100 0.00 255.0 ECU_ADDRESS 0xD0008FFB /end MEASUREMENT
/begin MEASUREMENT DFES_EnvBlock378 "vollständige Umweldaten alle Fehlerspeichereinträge" UBYTE DFES_OneToOne 1 100 0.00 255.0 ECU_ADDRESS 0xD0008FFC /end MEASUREMENT
/begin MEASUREMENT DFES_EnvBlock379 "vollständige Umweldaten alle Fehlerspeichereinträge" UBYTE DFES_OneToOne 1 100 0.00 255.0 ECU_ADDRESS 0xD0008FFD /end MEASUREMENT
/begin MEASUREMENT DFES_EnvBlock380 "vollständige Umweldaten alle Fehlerspeichereinträge" UBYTE DFES_OneToOne 1 100 0.00 255.0 ECU_ADDRESS 0xD0008FFE /end MEASUREMENT
/begin MEASUREMENT DFES_EnvBlock381 "vollständige Umweldaten alle Fehlerspeichereinträge" UBYTE DFES_OneToOne 1 100 0.00 255.0 ECU_ADDRESS 0xD0008FFF /end MEASUREMENT
/begin MEASUREMENT DFES_EnvBlock382 "vollständige Umweldaten alle Fehlerspeichereinträge" UBYTE DFES_OneToOne 1 100 0.00 255.0 ECU_ADDRESS 0xD0009000 /end MEASUREMENT
/begin MEASUREMENT DFES_EnvBlock383 "vollständige Umweldaten alle Fehlerspeichereinträge" UBYTE DFES_OneToOne 1 100 0.00 255.0 ECU_ADDRESS 0xD0009001 /end MEASUREMENT
/begin MEASUREMENT DFES_EnvBlock384 "vollständige Umweldaten alle Fehlerspeichereinträge" UBYTE DFES_OneToOne 1 100 0.00 255.0 ECU_ADDRESS 0xD0009002 /end MEASUREMENT
/begin MEASUREMENT DFES_EnvBlock385 "vollständige Umweldaten alle Fehlerspeichereinträge" UBYTE DFES_OneToOne 1 100 0.00 255.0 ECU_ADDRESS 0xD0009003 /end MEASUREMENT
/begin MEASUREMENT DFES_EnvBlock386 "vollständige Umweldaten alle Fehlerspeichereinträge" UBYTE DFES_OneToOne 1 100 0.00 255.0 ECU_ADDRESS 0xD0009004 /end MEASUREMENT
/begin MEASUREMENT DFES_EnvBlock387 "vollständige Umweldaten alle Fehlerspeichereinträge" UBYTE DFES_OneToOne 1 100 0.00 255.0 ECU_ADDRESS 0xD0009005 /end MEASUREMENT
/begin MEASUREMENT DFES_EnvBlock388 "vollständige Umweldaten alle Fehlerspeichereinträge" UBYTE DFES_OneToOne 1 100 0.00 255.0 ECU_ADDRESS 0xD0009006 /end MEASUREMENT
/begin MEASUREMENT DFES_EnvBlock389 "vollständige Umweldaten alle Fehlerspeichereinträge" UBYTE DFES_OneToOne 1 100 0.00 255.0 ECU_ADDRESS 0xD0009007 /end MEASUREMENT
/begin MEASUREMENT DFES_EnvBlock390 "vollständige Umweldaten alle Fehlerspeichereinträge" UBYTE DFES_OneToOne 1 100 0.00 255.0 ECU_ADDRESS 0xD0009008 /end MEASUREMENT
/begin MEASUREMENT DFES_EnvBlock391 "vollständige Umweldaten alle Fehlerspeichereinträge" UBYTE DFES_OneToOne 1 100 0.00 255.0 ECU_ADDRESS 0xD0009009 /end MEASUREMENT
/begin MEASUREMENT DFES_EnvBlock392 "vollständige Umweldaten alle Fehlerspeichereinträge" UBYTE DFES_OneToOne 1 100 0.00 255.0 ECU_ADDRESS 0xD000900A /end MEASUREMENT
/begin MEASUREMENT DFES_EnvBlock393 "vollständige Umweldaten alle Fehlerspeichereinträge" UBYTE DFES_OneToOne 1 100 0.00 255.0 ECU_ADDRESS 0xD000900B /end MEASUREMENT
/begin MEASUREMENT DFES_EnvBlock394 "vollständige Umweldaten alle Fehlerspeichereinträge" UBYTE DFES_OneToOne 1 100 0.00 255.0 ECU_ADDRESS 0xD000900C /end MEASUREMENT
/begin MEASUREMENT DFES_EnvBlock395 "vollständige Umweldaten alle Fehlerspeichereinträge" UBYTE DFES_OneToOne 1 100 0.00 255.0 ECU_ADDRESS 0xD000900D /end MEASUREMENT
/begin MEASUREMENT DFES_EnvBlock396 "vollständige Umweldaten alle Fehlerspeichereinträge" UBYTE DFES_OneToOne 1 100 0.00 255.0 ECU_ADDRESS 0xD000900E /end MEASUREMENT
/begin MEASUREMENT DFES_EnvBlock397 "vollständige Umweldaten alle Fehlerspeichereinträge" UBYTE DFES_OneToOne 1 100 0.00 255.0 ECU_ADDRESS 0xD000900F /end MEASUREMENT
/begin MEASUREMENT DFES_EnvBlock398 "vollständige Umweldaten alle Fehlerspeichereinträge" UBYTE DFES_OneToOne 1 100 0.00 255.0 ECU_ADDRESS 0xD0009010 /end MEASUREMENT
/begin MEASUREMENT DFES_EnvBlock399 "vollständige Umweldaten alle Fehlerspeichereinträge" UBYTE DFES_OneToOne 1 100 0.00 255.0 ECU_ADDRESS 0xD0009011 /end MEASUREMENT
/begin MEASUREMENT DFES_EnvBlock400 "vollständige Umweldaten alle Fehlerspeichereinträge" UBYTE DFES_OneToOne 1 100 0.00 255.0 ECU_ADDRESS 0xD0009012 /end MEASUREMENT
/begin MEASUREMENT DFES_EnvBlock401 "vollständige Umweldaten alle Fehlerspeichereinträge" UBYTE DFES_OneToOne 1 100 0.00 255.0 ECU_ADDRESS 0xD0009013 /end MEASUREMENT
/begin MEASUREMENT DFES_EnvBlock402 "vollständige Umweldaten alle Fehlerspeichereinträge" UBYTE DFES_OneToOne 1 100 0.00 255.0 ECU_ADDRESS 0xD0009014 /end MEASUREMENT
/begin MEASUREMENT DFES_EnvBlock403 "vollständige Umweldaten alle Fehlerspeichereinträge" UBYTE DFES_OneToOne 1 100 0.00 255.0 ECU_ADDRESS 0xD0009015 /end MEASUREMENT
/begin MEASUREMENT DFES_EnvBlock404 "vollständige Umweldaten alle Fehlerspeichereinträge" UBYTE DFES_OneToOne 1 100 0.00 255.0 ECU_ADDRESS 0xD0009016 /end MEASUREMENT
/begin MEASUREMENT DFES_EnvBlock405 "vollständige Umweldaten alle Fehlerspeichereinträge" UBYTE DFES_OneToOne 1 100 0.00 255.0 ECU_ADDRESS 0xD0009017 /end MEASUREMENT
/begin MEASUREMENT DFES_EnvBlock406 "vollständige Umweldaten alle Fehlerspeichereinträge" UBYTE DFES_OneToOne 1 100 0.00 255.0 ECU_ADDRESS 0xD0009018 /end MEASUREMENT
/begin MEASUREMENT DFES_EnvBlock407 "vollständige Umweldaten alle Fehlerspeichereinträge" UBYTE DFES_OneToOne 1 100 0.00 255.0 ECU_ADDRESS 0xD0009019 /end MEASUREMENT
/begin MEASUREMENT DFES_EnvBlock408 "vollständige Umweldaten alle Fehlerspeichereinträge" UBYTE DFES_OneToOne 1 100 0.00 255.0 ECU_ADDRESS 0xD000901A /end MEASUREMENT
/begin MEASUREMENT DFES_EnvBlock409 "vollständige Umweldaten alle Fehlerspeichereinträge" UBYTE DFES_OneToOne 1 100 0.00 255.0 ECU_ADDRESS 0xD000901B /end MEASUREMENT
/begin MEASUREMENT DFES_EnvBlock410 "vollständige Umweldaten alle Fehlerspeichereinträge" UBYTE DFES_OneToOne 1 100 0.00 255.0 ECU_ADDRESS 0xD000901C /end MEASUREMENT
/begin MEASUREMENT DFES_EnvBlock411 "vollständige Umweldaten alle Fehlerspeichereinträge" UBYTE DFES_OneToOne 1 100 0.00 255.0 ECU_ADDRESS 0xD000901D /end MEASUREMENT
/begin MEASUREMENT DFES_EnvBlock412 "vollständige Umweldaten alle Fehlerspeichereinträge" UBYTE DFES_OneToOne 1 100 0.00 255.0 ECU_ADDRESS 0xD000901E /end MEASUREMENT
/begin MEASUREMENT DFES_EnvBlock413 "vollständige Umweldaten alle Fehlerspeichereinträge" UBYTE DFES_OneToOne 1 100 0.00 255.0 ECU_ADDRESS 0xD000901F /end MEASUREMENT
/begin MEASUREMENT DFES_EnvBlock414 "vollständige Umweldaten alle Fehlerspeichereinträge" UBYTE DFES_OneToOne 1 100 0.00 255.0 ECU_ADDRESS 0xD0009020 /end MEASUREMENT
/begin MEASUREMENT DFES_EnvBlock415 "vollständige Umweldaten alle Fehlerspeichereinträge" UBYTE DFES_OneToOne 1 100 0.00 255.0 ECU_ADDRESS 0xD0009021 /end MEASUREMENT
/begin MEASUREMENT DFES_EnvBlock416 "vollständige Umweldaten alle Fehlerspeichereinträge" UBYTE DFES_OneToOne 1 100 0.00 255.0 ECU_ADDRESS 0xD0009022 /end MEASUREMENT
/begin MEASUREMENT DFES_EnvBlock417 "vollständige Umweldaten alle Fehlerspeichereinträge" UBYTE DFES_OneToOne 1 100 0.00 255.0 ECU_ADDRESS 0xD0009023 /end MEASUREMENT
/begin MEASUREMENT DFES_EnvBlock418 "vollständige Umweldaten alle Fehlerspeichereinträge" UBYTE DFES_OneToOne 1 100 0.00 255.0 ECU_ADDRESS 0xD0009024 /end MEASUREMENT
/begin MEASUREMENT DFES_EnvBlock419 "vollständige Umweldaten alle Fehlerspeichereinträge" UBYTE DFES_OneToOne 1 100 0.00 255.0 ECU_ADDRESS 0xD0009025 /end MEASUREMENT
/begin MEASUREMENT DFES_EnvBlock420 "vollständige Umweldaten alle Fehlerspeichereinträge" UBYTE DFES_OneToOne 1 100 0.00 255.0 ECU_ADDRESS 0xD0009026 /end MEASUREMENT
/begin MEASUREMENT DFES_EnvBlock421 "vollständige Umweldaten alle Fehlerspeichereinträge" UBYTE DFES_OneToOne 1 100 0.00 255.0 ECU_ADDRESS 0xD0009027 /end MEASUREMENT
/begin MEASUREMENT DFES_EnvBlock422 "vollständige Umweldaten alle Fehlerspeichereinträge" UBYTE DFES_OneToOne 1 100 0.00 255.0 ECU_ADDRESS 0xD0009028 /end MEASUREMENT
/begin MEASUREMENT DFES_EnvBlock423 "vollständige Umweldaten alle Fehlerspeichereinträge" UBYTE DFES_OneToOne 1 100 0.00 255.0 ECU_ADDRESS 0xD0009029 /end MEASUREMENT
/begin MEASUREMENT DFES_EnvBlock424 "vollständige Umweldaten alle Fehlerspeichereinträge" UBYTE DFES_OneToOne 1 100 0.00 255.0 ECU_ADDRESS 0xD000902A /end MEASUREMENT
/begin MEASUREMENT DFES_EnvBlock425 "vollständige Umweldaten alle Fehlerspeichereinträge" UBYTE DFES_OneToOne 1 100 0.00 255.0 ECU_ADDRESS 0xD000902B /end MEASUREMENT
/begin MEASUREMENT DFES_EnvBlock426 "vollständige Umweldaten alle Fehlerspeichereinträge" UBYTE DFES_OneToOne 1 100 0.00 255.0 ECU_ADDRESS 0xD000902C /end MEASUREMENT
/begin MEASUREMENT DFES_EnvBlock427 "vollständige Umweldaten alle Fehlerspeichereinträge" UBYTE DFES_OneToOne 1 100 0.00 255.0 ECU_ADDRESS 0xD000902D /end MEASUREMENT
/begin MEASUREMENT DFES_EnvBlock428 "vollständige Umweldaten alle Fehlerspeichereinträge" UBYTE DFES_OneToOne 1 100 0.00 255.0 ECU_ADDRESS 0xD000902E /end MEASUREMENT
/begin MEASUREMENT DFES_EnvBlock429 "vollständige Umweldaten alle Fehlerspeichereinträge" UBYTE DFES_OneToOne 1 100 0.00 255.0 ECU_ADDRESS 0xD000902F /end MEASUREMENT
/begin MEASUREMENT DFES_EnvBlock430 "vollständige Umweldaten alle Fehlerspeichereinträge" UBYTE DFES_OneToOne 1 100 0.00 255.0 ECU_ADDRESS 0xD0009030 /end MEASUREMENT
/begin MEASUREMENT DFES_EnvBlock431 "vollständige Umweldaten alle Fehlerspeichereinträge" UBYTE DFES_OneToOne 1 100 0.00 255.0 ECU_ADDRESS 0xD0009031 /end MEASUREMENT
/begin MEASUREMENT DFES_EnvBlock432 "vollständige Umweldaten alle Fehlerspeichereinträge" UBYTE DFES_OneToOne 1 100 0.00 255.0 ECU_ADDRESS 0xD0009032 /end MEASUREMENT
/begin MEASUREMENT DFES_EnvBlock433 "vollständige Umweldaten alle Fehlerspeichereinträge" UBYTE DFES_OneToOne 1 100 0.00 255.0 ECU_ADDRESS 0xD0009033 /end MEASUREMENT
/begin MEASUREMENT DFES_EnvBlock434 "vollständige Umweldaten alle Fehlerspeichereinträge" UBYTE DFES_OneToOne 1 100 0.00 255.0 ECU_ADDRESS 0xD0009034 /end MEASUREMENT
/begin MEASUREMENT DFES_EnvBlock435 "vollständige Umweldaten alle Fehlerspeichereinträge" UBYTE DFES_OneToOne 1 100 0.00 255.0 ECU_ADDRESS 0xD0009035 /end MEASUREMENT
/begin MEASUREMENT DFES_EnvBlock436 "vollständige Umweldaten alle Fehlerspeichereinträge" UBYTE DFES_OneToOne 1 100 0.00 255.0 ECU_ADDRESS 0xD0009036 /end MEASUREMENT
/begin MEASUREMENT DFES_EnvBlock437 "vollständige Umweldaten alle Fehlerspeichereinträge" UBYTE DFES_OneToOne 1 100 0.00 255.0 ECU_ADDRESS 0xD0009037 /end MEASUREMENT
/begin MEASUREMENT DFES_EnvBlock438 "vollständige Umweldaten alle Fehlerspeichereinträge" UBYTE DFES_OneToOne 1 100 0.00 255.0 ECU_ADDRESS 0xD0009038 /end MEASUREMENT
/begin MEASUREMENT DFES_EnvBlock439 "vollständige Umweldaten alle Fehlerspeichereinträge" UBYTE DFES_OneToOne 1 100 0.00 255.0 ECU_ADDRESS 0xD0009039 /end MEASUREMENT
/begin MEASUREMENT DFES_EnvBlock440 "vollständige Umweldaten alle Fehlerspeichereinträge" UBYTE DFES_OneToOne 1 100 0.00 255.0 ECU_ADDRESS 0xD000903A /end MEASUREMENT
/begin MEASUREMENT DFES_EnvBlock441 "vollständige Umweldaten alle Fehlerspeichereinträge" UBYTE DFES_OneToOne 1 100 0.00 255.0 ECU_ADDRESS 0xD000903B /end MEASUREMENT
/begin MEASUREMENT DFES_EnvBlock442 "vollständige Umweldaten alle Fehlerspeichereinträge" UBYTE DFES_OneToOne 1 100 0.00 255.0 ECU_ADDRESS 0xD000903C /end MEASUREMENT
/begin MEASUREMENT DFES_EnvBlock443 "vollständige Umweldaten alle Fehlerspeichereinträge" UBYTE DFES_OneToOne 1 100 0.00 255.0 ECU_ADDRESS 0xD000903D /end MEASUREMENT
/begin MEASUREMENT DFES_EnvBlock444 "vollständige Umweldaten alle Fehlerspeichereinträge" UBYTE DFES_OneToOne 1 100 0.00 255.0 ECU_ADDRESS 0xD000903E /end MEASUREMENT
/begin MEASUREMENT DFES_EnvBlock445 "vollständige Umweldaten alle Fehlerspeichereinträge" UBYTE DFES_OneToOne 1 100 0.00 255.0 ECU_ADDRESS 0xD000903F /end MEASUREMENT
/begin MEASUREMENT DFES_EnvBlock446 "vollständige Umweldaten alle Fehlerspeichereinträge" UBYTE DFES_OneToOne 1 100 0.00 255.0 ECU_ADDRESS 0xD0009040 /end MEASUREMENT
/begin MEASUREMENT DFES_EnvBlock447 "vollständige Umweldaten alle Fehlerspeichereinträge" UBYTE DFES_OneToOne 1 100 0.00 255.0 ECU_ADDRESS 0xD0009041 /end MEASUREMENT
/begin MEASUREMENT DFES_EnvBlock448 "vollständige Umweldaten alle Fehlerspeichereinträge" UBYTE DFES_OneToOne 1 100 0.00 255.0 ECU_ADDRESS 0xD0009042 /end MEASUREMENT
/begin MEASUREMENT DFES_EnvBlock449 "vollständige Umweldaten alle Fehlerspeichereinträge" UBYTE DFES_OneToOne 1 100 0.00 255.0 ECU_ADDRESS 0xD0009043 /end MEASUREMENT
/begin MEASUREMENT DFES_EnvBlock450 "vollständige Umweldaten alle Fehlerspeichereinträge" UBYTE DFES_OneToOne 1 100 0.00 255.0 ECU_ADDRESS 0xD0009044 /end MEASUREMENT
/begin MEASUREMENT DFES_EnvBlock451 "vollständige Umweldaten alle Fehlerspeichereinträge" UBYTE DFES_OneToOne 1 100 0.00 255.0 ECU_ADDRESS 0xD0009045 /end MEASUREMENT
/begin MEASUREMENT DFES_EnvBlock452 "vollständige Umweldaten alle Fehlerspeichereinträge" UBYTE DFES_OneToOne 1 100 0.00 255.0 ECU_ADDRESS 0xD0009046 /end MEASUREMENT
/begin MEASUREMENT DFES_EnvBlock453 "vollständige Umweldaten alle Fehlerspeichereinträge" UBYTE DFES_OneToOne 1 100 0.00 255.0 ECU_ADDRESS 0xD0009047 /end MEASUREMENT
/begin MEASUREMENT DFES_EnvBlock454 "vollständige Umweldaten alle Fehlerspeichereinträge" UBYTE DFES_OneToOne 1 100 0.00 255.0 ECU_ADDRESS 0xD0009048 /end MEASUREMENT
/begin MEASUREMENT DFES_EnvBlock455 "vollständige Umweldaten alle Fehlerspeichereinträge" UBYTE DFES_OneToOne 1 100 0.00 255.0 ECU_ADDRESS 0xD0009049 /end MEASUREMENT
/begin MEASUREMENT DFES_EnvBlock456 "vollständige Umweldaten alle Fehlerspeichereinträge" UBYTE DFES_OneToOne 1 100 0.00 255.0 ECU_ADDRESS 0xD000904A /end MEASUREMENT
/begin MEASUREMENT DFES_EnvBlock457 "vollständige Umweldaten alle Fehlerspeichereinträge" UBYTE DFES_OneToOne 1 100 0.00 255.0 ECU_ADDRESS 0xD000904B /end MEASUREMENT
/begin MEASUREMENT DFES_EnvBlock458 "vollständige Umweldaten alle Fehlerspeichereinträge" UBYTE DFES_OneToOne 1 100 0.00 255.0 ECU_ADDRESS 0xD000904C /end MEASUREMENT
/begin MEASUREMENT DFES_EnvBlock459 "vollständige Umweldaten alle Fehlerspeichereinträge" UBYTE DFES_OneToOne 1 100 0.00 255.0 ECU_ADDRESS 0xD000904D /end MEASUREMENT
/begin MEASUREMENT DFES_EnvBlock460 "vollständige Umweldaten alle Fehlerspeichereinträge" UBYTE DFES_OneToOne 1 100 0.00 255.0 ECU_ADDRESS 0xD000904E /end MEASUREMENT
/begin MEASUREMENT DFES_EnvBlock461 "vollständige Umweldaten alle Fehlerspeichereinträge" UBYTE DFES_OneToOne 1 100 0.00 255.0 ECU_ADDRESS 0xD000904F /end MEASUREMENT
/begin MEASUREMENT DFES_EnvBlock462 "vollständige Umweldaten alle Fehlerspeichereinträge" UBYTE DFES_OneToOne 1 100 0.00 255.0 ECU_ADDRESS 0xD0009050 /end MEASUREMENT
/begin MEASUREMENT DFES_EnvBlock463 "vollständige Umweldaten alle Fehlerspeichereinträge" UBYTE DFES_OneToOne 1 100 0.00 255.0 ECU_ADDRESS 0xD0009051 /end MEASUREMENT
/begin MEASUREMENT DFES_EnvBlock464 "vollständige Umweldaten alle Fehlerspeichereinträge" UBYTE DFES_OneToOne 1 100 0.00 255.0 ECU_ADDRESS 0xD0009052 /end MEASUREMENT
/begin MEASUREMENT DFES_EnvBlock465 "vollständige Umweldaten alle Fehlerspeichereinträge" UBYTE DFES_OneToOne 1 100 0.00 255.0 ECU_ADDRESS 0xD0009053 /end MEASUREMENT
/begin MEASUREMENT DFES_EnvBlock466 "vollständige Umweldaten alle Fehlerspeichereinträge" UBYTE DFES_OneToOne 1 100 0.00 255.0 ECU_ADDRESS 0xD0009054 /end MEASUREMENT
/begin MEASUREMENT DFES_EnvBlock467 "vollständige Umweldaten alle Fehlerspeichereinträge" UBYTE DFES_OneToOne 1 100 0.00 255.0 ECU_ADDRESS 0xD0009055 /end MEASUREMENT
/begin MEASUREMENT DFES_EnvBlock468 "vollständige Umweldaten alle Fehlerspeichereinträge" UBYTE DFES_OneToOne 1 100 0.00 255.0 ECU_ADDRESS 0xD0009056 /end MEASUREMENT
/begin MEASUREMENT DFES_EnvBlock469 "vollständige Umweldaten alle Fehlerspeichereinträge" UBYTE DFES_OneToOne 1 100 0.00 255.0 ECU_ADDRESS 0xD0009057 /end MEASUREMENT
/begin MEASUREMENT DFES_EnvBlock470 "vollständige Umweldaten alle Fehlerspeichereinträge" UBYTE DFES_OneToOne 1 100 0.00 255.0 ECU_ADDRESS 0xD0009058 /end MEASUREMENT
/begin MEASUREMENT DFES_EnvBlock471 "vollständige Umweldaten alle Fehlerspeichereinträge" UBYTE DFES_OneToOne 1 100 0.00 255.0 ECU_ADDRESS 0xD0009059 /end MEASUREMENT
/begin MEASUREMENT DFES_EnvBlock472 "vollständige Umweldaten alle Fehlerspeichereinträge" UBYTE DFES_OneToOne 1 100 0.00 255.0 ECU_ADDRESS 0xD000905A /end MEASUREMENT
/begin MEASUREMENT DFES_EnvBlock473 "vollständige Umweldaten alle Fehlerspeichereinträge" UBYTE DFES_OneToOne 1 100 0.00 255.0 ECU_ADDRESS 0xD000905B /end MEASUREMENT
/begin MEASUREMENT DFES_EnvBlock474 "vollständige Umweldaten alle Fehlerspeichereinträge" UBYTE DFES_OneToOne 1 100 0.00 255.0 ECU_ADDRESS 0xD000905C /end MEASUREMENT
/begin MEASUREMENT DFES_EnvBlock475 "vollständige Umweldaten alle Fehlerspeichereinträge" UBYTE DFES_OneToOne 1 100 0.00 255.0 ECU_ADDRESS 0xD000905D /end MEASUREMENT
/begin MEASUREMENT DFES_EnvBlock476 "vollständige Umweldaten alle Fehlerspeichereinträge" UBYTE DFES_OneToOne 1 100 0.00 255.0 ECU_ADDRESS 0xD000905E /end MEASUREMENT
/begin MEASUREMENT DFES_EnvBlock477 "vollständige Umweldaten alle Fehlerspeichereinträge" UBYTE DFES_OneToOne 1 100 0.00 255.0 ECU_ADDRESS 0xD000905F /end MEASUREMENT
/begin MEASUREMENT DFES_EnvBlock478 "vollständige Umweldaten alle Fehlerspeichereinträge" UBYTE DFES_OneToOne 1 100 0.00 255.0 ECU_ADDRESS 0xD0009060 /end MEASUREMENT
/begin MEASUREMENT DFES_EnvBlock479 "vollständige Umweldaten alle Fehlerspeichereinträge" UBYTE DFES_OneToOne 1 100 0.00 255.0 ECU_ADDRESS 0xD0009061 /end MEASUREMENT
/begin MEASUREMENT DFES_EnvBlock480 "vollständige Umweldaten alle Fehlerspeichereinträge" UBYTE DFES_OneToOne 1 100 0.00 255.0 ECU_ADDRESS 0xD0009062 /end MEASUREMENT
/begin MEASUREMENT DFES_EnvBlock481 "vollständige Umweldaten alle Fehlerspeichereinträge" UBYTE DFES_OneToOne 1 100 0.00 255.0 ECU_ADDRESS 0xD0009063 /end MEASUREMENT
/begin MEASUREMENT DFES_EnvBlock482 "vollständige Umweldaten alle Fehlerspeichereinträge" UBYTE DFES_OneToOne 1 100 0.00 255.0 ECU_ADDRESS 0xD0009064 /end MEASUREMENT
/begin MEASUREMENT DFES_EnvBlock483 "vollständige Umweldaten alle Fehlerspeichereinträge" UBYTE DFES_OneToOne 1 100 0.00 255.0 ECU_ADDRESS 0xD0009065 /end MEASUREMENT
/begin MEASUREMENT DFES_EnvBlock484 "vollständige Umweldaten alle Fehlerspeichereinträge" UBYTE DFES_OneToOne 1 100 0.00 255.0 ECU_ADDRESS 0xD0009066 /end MEASUREMENT
/begin MEASUREMENT DFES_EnvBlock485 "vollständige Umweldaten alle Fehlerspeichereinträge" UBYTE DFES_OneToOne 1 100 0.00 255.0 ECU_ADDRESS 0xD0009067 /end MEASUREMENT
/begin MEASUREMENT DFES_EnvBlock486 "vollständige Umweldaten alle Fehlerspeichereinträge" UBYTE DFES_OneToOne 1 100 0.00 255.0 ECU_ADDRESS 0xD0009068 /end MEASUREMENT
/begin MEASUREMENT DFES_EnvBlock487 "vollständige Umweldaten alle Fehlerspeichereinträge" UBYTE DFES_OneToOne 1 100 0.00 255.0 ECU_ADDRESS 0xD0009069 /end MEASUREMENT
/begin MEASUREMENT DFES_EnvBlock488 "vollständige Umweldaten alle Fehlerspeichereinträge" UBYTE DFES_OneToOne 1 100 0.00 255.0 ECU_ADDRESS 0xD000906A /end MEASUREMENT
/begin MEASUREMENT DFES_EnvBlock489 "vollständige Umweldaten alle Fehlerspeichereinträge" UBYTE DFES_OneToOne 1 100 0.00 255.0 ECU_ADDRESS 0xD000906B /end MEASUREMENT
/begin MEASUREMENT DFES_EnvBlock490 "vollständige Umweldaten alle Fehlerspeichereinträge" UBYTE DFES_OneToOne 1 100 0.00 255.0 ECU_ADDRESS 0xD000906C /end MEASUREMENT
/begin MEASUREMENT DFES_EnvBlock491 "vollständige Umweldaten alle Fehlerspeichereinträge" UBYTE DFES_OneToOne 1 100 0.00 255.0 ECU_ADDRESS 0xD000906D /end MEASUREMENT
/begin MEASUREMENT DFES_EnvBlock492 "vollständige Umweldaten alle Fehlerspeichereinträge" UBYTE DFES_OneToOne 1 100 0.00 255.0 ECU_ADDRESS 0xD000906E /end MEASUREMENT
/begin MEASUREMENT DFES_EnvBlock493 "vollständige Umweldaten alle Fehlerspeichereinträge" UBYTE DFES_OneToOne 1 100 0.00 255.0 ECU_ADDRESS 0xD000906F /end MEASUREMENT
/begin MEASUREMENT DFES_EnvBlock494 "vollständige Umweldaten alle Fehlerspeichereinträge" UBYTE DFES_OneToOne 1 100 0.00 255.0 ECU_ADDRESS 0xD0009070 /end MEASUREMENT
/begin MEASUREMENT DFES_EnvBlock495 "vollständige Umweldaten alle Fehlerspeichereinträge" UBYTE DFES_OneToOne 1 100 0.00 255.0 ECU_ADDRESS 0xD0009071 /end MEASUREMENT
/begin MEASUREMENT DFES_EnvBlock496 "vollständige Umweldaten alle Fehlerspeichereinträge" UBYTE DFES_OneToOne 1 100 0.00 255.0 ECU_ADDRESS 0xD0009072 /end MEASUREMENT
/begin MEASUREMENT DFES_EnvBlock497 "vollständige Umweldaten alle Fehlerspeichereinträge" UBYTE DFES_OneToOne 1 100 0.00 255.0 ECU_ADDRESS 0xD0009073 /end MEASUREMENT
/begin MEASUREMENT DFES_EnvBlock498 "vollständige Umweldaten alle Fehlerspeichereinträge" UBYTE DFES_OneToOne 1 100 0.00 255.0 ECU_ADDRESS 0xD0009074 /end MEASUREMENT
/begin MEASUREMENT DFES_EnvBlock499 "vollständige Umweldaten alle Fehlerspeichereinträge" UBYTE DFES_OneToOne 1 100 0.00 255.0 ECU_ADDRESS 0xD0009075 /end MEASUREMENT
/begin MEASUREMENT DFES_EnvBlock500 "vollständige Umweldaten alle Fehlerspeichereinträge" UBYTE DFES_OneToOne 1 100 0.00 255.0 ECU_ADDRESS 0xD0009076 /end MEASUREMENT
/begin MEASUREMENT DFES_EnvBlock501 "vollständige Umweldaten alle Fehlerspeichereinträge" UBYTE DFES_OneToOne 1 100 0.00 255.0 ECU_ADDRESS 0xD0009077 /end MEASUREMENT
/begin MEASUREMENT DFES_EnvBlock502 "vollständige Umweldaten alle Fehlerspeichereinträge" UBYTE DFES_OneToOne 1 100 0.00 255.0 ECU_ADDRESS 0xD0009078 /end MEASUREMENT
/begin MEASUREMENT DFES_EnvBlock503 "vollständige Umweldaten alle Fehlerspeichereinträge" UBYTE DFES_OneToOne 1 100 0.00 255.0 ECU_ADDRESS 0xD0009079 /end MEASUREMENT
/begin MEASUREMENT DFES_EnvBlock504 "vollständige Umweldaten alle Fehlerspeichereinträge" UBYTE DFES_OneToOne 1 100 0.00 255.0 ECU_ADDRESS 0xD000907A /end MEASUREMENT
/begin MEASUREMENT DFES_EnvBlock505 "vollständige Umweldaten alle Fehlerspeichereinträge" UBYTE DFES_OneToOne 1 100 0.00 255.0 ECU_ADDRESS 0xD000907B /end MEASUREMENT
/begin MEASUREMENT DFES_EnvBlock506 "vollständige Umweldaten alle Fehlerspeichereinträge" UBYTE DFES_OneToOne 1 100 0.00 255.0 ECU_ADDRESS 0xD000907C /end MEASUREMENT
/begin MEASUREMENT DFES_EnvBlock507 "vollständige Umweldaten alle Fehlerspeichereinträge" UBYTE DFES_OneToOne 1 100 0.00 255.0 ECU_ADDRESS 0xD000907D /end MEASUREMENT
/begin MEASUREMENT DFES_EnvBlock508 "vollständige Umweldaten alle Fehlerspeichereinträge" UBYTE DFES_OneToOne 1 100 0.00 255.0 ECU_ADDRESS 0xD000907E /end MEASUREMENT
/begin MEASUREMENT DFES_EnvBlock509 "vollständige Umweldaten alle Fehlerspeichereinträge" UBYTE DFES_OneToOne 1 100 0.00 255.0 ECU_ADDRESS 0xD000907F /end MEASUREMENT
/begin MEASUREMENT DFES_EnvBlock510 "vollständige Umweldaten alle Fehlerspeichereinträge" UBYTE DFES_OneToOne 1 100 0.00 255.0 ECU_ADDRESS 0xD0009080 /end MEASUREMENT
/begin MEASUREMENT DFES_EnvBlock511 "vollständige Umweldaten alle Fehlerspeichereinträge" UBYTE DFES_OneToOne 1 100 0.00 255.0 ECU_ADDRESS 0xD0009081 /end MEASUREMENT
/begin MEASUREMENT DFES_EnvBlock512 "vollständige Umweldaten alle Fehlerspeichereinträge" UBYTE DFES_OneToOne 1 100 0.00 255.0 ECU_ADDRESS 0xD0009082 /end MEASUREMENT
/begin MEASUREMENT DFES_EnvBlock513 "vollständige Umweldaten alle Fehlerspeichereinträge" UBYTE DFES_OneToOne 1 100 0.00 255.0 ECU_ADDRESS 0xD0009083 /end MEASUREMENT
/begin MEASUREMENT DFES_EnvBlock514 "vollständige Umweldaten alle Fehlerspeichereinträge" UBYTE DFES_OneToOne 1 100 0.00 255.0 ECU_ADDRESS 0xD0009084 /end MEASUREMENT
/begin MEASUREMENT DFES_EnvBlock515 "vollständige Umweldaten alle Fehlerspeichereinträge" UBYTE DFES_OneToOne 1 100 0.00 255.0 ECU_ADDRESS 0xD0009085 /end MEASUREMENT
/begin MEASUREMENT DFES_EnvBlock516 "vollständige Umweldaten alle Fehlerspeichereinträge" UBYTE DFES_OneToOne 1 100 0.00 255.0 ECU_ADDRESS 0xD0009086 /end MEASUREMENT
/begin MEASUREMENT DFES_EnvBlock517 "vollständige Umweldaten alle Fehlerspeichereinträge" UBYTE DFES_OneToOne 1 100 0.00 255.0 ECU_ADDRESS 0xD0009087 /end MEASUREMENT
/begin MEASUREMENT DFES_EnvBlock518 "vollständige Umweldaten alle Fehlerspeichereinträge" UBYTE DFES_OneToOne 1 100 0.00 255.0 ECU_ADDRESS 0xD0009088 /end MEASUREMENT
/begin MEASUREMENT DFES_EnvBlock519 "vollständige Umweldaten alle Fehlerspeichereinträge" UBYTE DFES_OneToOne 1 100 0.00 255.0 ECU_ADDRESS 0xD0009089 /end MEASUREMENT
/begin MEASUREMENT DFES_EnvBlock520 "vollständige Umweldaten alle Fehlerspeichereinträge" UBYTE DFES_OneToOne 1 100 0.00 255.0 ECU_ADDRESS 0xD000908A /end MEASUREMENT
/begin MEASUREMENT DFES_EnvBlock521 "vollständige Umweldaten alle Fehlerspeichereinträge" UBYTE DFES_OneToOne 1 100 0.00 255.0 ECU_ADDRESS 0xD000908B /end MEASUREMENT
/begin MEASUREMENT DFES_EnvBlock522 "vollständige Umweldaten alle Fehlerspeichereinträge" UBYTE DFES_OneToOne 1 100 0.00 255.0 ECU_ADDRESS 0xD000908C /end MEASUREMENT
/begin MEASUREMENT DFES_EnvBlock523 "vollständige Umweldaten alle Fehlerspeichereinträge" UBYTE DFES_OneToOne 1 100 0.00 255.0 ECU_ADDRESS 0xD000908D /end MEASUREMENT
/begin MEASUREMENT DFES_EnvBlock524 "vollständige Umweldaten alle Fehlerspeichereinträge" UBYTE DFES_OneToOne 1 100 0.00 255.0 ECU_ADDRESS 0xD000908E /end MEASUREMENT
/begin MEASUREMENT DFES_EnvBlock525 "vollständige Umweldaten alle Fehlerspeichereinträge" UBYTE DFES_OneToOne 1 100 0.00 255.0 ECU_ADDRESS 0xD000908F /end MEASUREMENT
/begin MEASUREMENT DFES_EnvBlock526 "vollständige Umweldaten alle Fehlerspeichereinträge" UBYTE DFES_OneToOne 1 100 0.00 255.0 ECU_ADDRESS 0xD0009090 /end MEASUREMENT
/begin MEASUREMENT DFES_EnvBlock527 "vollständige Umweldaten alle Fehlerspeichereinträge" UBYTE DFES_OneToOne 1 100 0.00 255.0 ECU_ADDRESS 0xD0009091 /end MEASUREMENT
/begin MEASUREMENT DFES_EnvBlock528 "vollständige Umweldaten alle Fehlerspeichereinträge" UBYTE DFES_OneToOne 1 100 0.00 255.0 ECU_ADDRESS 0xD0009092 /end MEASUREMENT
/begin MEASUREMENT DFES_EnvBlock529 "vollständige Umweldaten alle Fehlerspeichereinträge" UBYTE DFES_OneToOne 1 100 0.00 255.0 ECU_ADDRESS 0xD0009093 /end MEASUREMENT
/begin MEASUREMENT DFES_EnvBlock530 "vollständige Umweldaten alle Fehlerspeichereinträge" UBYTE DFES_OneToOne 1 100 0.00 255.0 ECU_ADDRESS 0xD0009094 /end MEASUREMENT
/begin MEASUREMENT DFES_EnvBlock531 "vollständige Umweldaten alle Fehlerspeichereinträge" UBYTE DFES_OneToOne 1 100 0.00 255.0 ECU_ADDRESS 0xD0009095 /end MEASUREMENT
/begin MEASUREMENT DFES_EnvBlock532 "vollständige Umweldaten alle Fehlerspeichereinträge" UBYTE DFES_OneToOne 1 100 0.00 255.0 ECU_ADDRESS 0xD0009096 /end MEASUREMENT
/begin MEASUREMENT DFES_EnvBlock533 "vollständige Umweldaten alle Fehlerspeichereinträge" UBYTE DFES_OneToOne 1 100 0.00 255.0 ECU_ADDRESS 0xD0009097 /end MEASUREMENT
/begin MEASUREMENT DFES_EnvBlock534 "vollständige Umweldaten alle Fehlerspeichereinträge" UBYTE DFES_OneToOne 1 100 0.00 255.0 ECU_ADDRESS 0xD0009098 /end MEASUREMENT
/begin MEASUREMENT DFES_EnvBlock535 "vollständige Umweldaten alle Fehlerspeichereinträge" UBYTE DFES_OneToOne 1 100 0.00 255.0 ECU_ADDRESS 0xD0009099 /end MEASUREMENT
/begin MEASUREMENT DFES_EnvBlock536 "vollständige Umweldaten alle Fehlerspeichereinträge" UBYTE DFES_OneToOne 1 100 0.00 255.0 ECU_ADDRESS 0xD000909A /end MEASUREMENT
/begin MEASUREMENT DFES_EnvBlock537 "vollständige Umweldaten alle Fehlerspeichereinträge" UBYTE DFES_OneToOne 1 100 0.00 255.0 ECU_ADDRESS 0xD000909B /end MEASUREMENT
/begin MEASUREMENT DFES_EnvBlock538 "vollständige Umweldaten alle Fehlerspeichereinträge" UBYTE DFES_OneToOne 1 100 0.00 255.0 ECU_ADDRESS 0xD000909C /end MEASUREMENT
/begin MEASUREMENT DFES_EnvBlock539 "vollständige Umweldaten alle Fehlerspeichereinträge" UBYTE DFES_OneToOne 1 100 0.00 255.0 ECU_ADDRESS 0xD000909D /end MEASUREMENT
/begin MEASUREMENT DFES_EnvBlock540 "vollständige Umweldaten alle Fehlerspeichereinträge" UBYTE DFES_OneToOne 1 100 0.00 255.0 ECU_ADDRESS 0xD000909E /end MEASUREMENT
/begin MEASUREMENT DFES_EnvBlock541 "vollständige Umweldaten alle Fehlerspeichereinträge" UBYTE DFES_OneToOne 1 100 0.00 255.0 ECU_ADDRESS 0xD000909F /end MEASUREMENT
/begin MEASUREMENT DFES_EnvBlock542 "vollständige Umweldaten alle Fehlerspeichereinträge" UBYTE DFES_OneToOne 1 100 0.00 255.0 ECU_ADDRESS 0xD00090A0 /end MEASUREMENT
/begin MEASUREMENT DFES_EnvBlock543 "vollständige Umweldaten alle Fehlerspeichereinträge" UBYTE DFES_OneToOne 1 100 0.00 255.0 ECU_ADDRESS 0xD00090A1 /end MEASUREMENT
/begin MEASUREMENT DFES_EnvBlock544 "vollständige Umweldaten alle Fehlerspeichereinträge" UBYTE DFES_OneToOne 1 100 0.00 255.0 ECU_ADDRESS 0xD00090A2 /end MEASUREMENT
/begin MEASUREMENT DFES_EnvBlock545 "vollständige Umweldaten alle Fehlerspeichereinträge" UBYTE DFES_OneToOne 1 100 0.00 255.0 ECU_ADDRESS 0xD00090A3 /end MEASUREMENT
/begin MEASUREMENT DFES_EnvBlock546 "vollständige Umweldaten alle Fehlerspeichereinträge" UBYTE DFES_OneToOne 1 100 0.00 255.0 ECU_ADDRESS 0xD00090A4 /end MEASUREMENT
/begin MEASUREMENT DFES_EnvBlock547 "vollständige Umweldaten alle Fehlerspeichereinträge" UBYTE DFES_OneToOne 1 100 0.00 255.0 ECU_ADDRESS 0xD00090A5 /end MEASUREMENT
/begin MEASUREMENT DFES_EnvBlock548 "vollständige Umweldaten alle Fehlerspeichereinträge" UBYTE DFES_OneToOne 1 100 0.00 255.0 ECU_ADDRESS 0xD00090A6 /end MEASUREMENT
/begin MEASUREMENT DFES_EnvBlock549 "vollständige Umweldaten alle Fehlerspeichereinträge" UBYTE DFES_OneToOne 1 100 0.00 255.0 ECU_ADDRESS 0xD00090A7 /end MEASUREMENT
/begin MEASUREMENT DFES_EnvBlock550 "vollständige Umweldaten alle Fehlerspeichereinträge" UBYTE DFES_OneToOne 1 100 0.00 255.0 ECU_ADDRESS 0xD00090A8 /end MEASUREMENT
/begin MEASUREMENT DFES_EnvBlock551 "vollständige Umweldaten alle Fehlerspeichereinträge" UBYTE DFES_OneToOne 1 100 0.00 255.0 ECU_ADDRESS 0xD00090A9 /end MEASUREMENT
/begin MEASUREMENT DFES_EnvBlock552 "vollständige Umweldaten alle Fehlerspeichereinträge" UBYTE DFES_OneToOne 1 100 0.00 255.0 ECU_ADDRESS 0xD00090AA /end MEASUREMENT
/begin MEASUREMENT DFES_EnvBlock553 "vollständige Umweldaten alle Fehlerspeichereinträge" UBYTE DFES_OneToOne 1 100 0.00 255.0 ECU_ADDRESS 0xD00090AB /end MEASUREMENT
/begin MEASUREMENT DFES_EnvBlock554 "vollständige Umweldaten alle Fehlerspeichereinträge" UBYTE DFES_OneToOne 1 100 0.00 255.0 ECU_ADDRESS 0xD00090AC /end MEASUREMENT
/begin MEASUREMENT DFES_EnvBlock555 "vollständige Umweldaten alle Fehlerspeichereinträge" UBYTE DFES_OneToOne 1 100 0.00 255.0 ECU_ADDRESS 0xD00090AD /end MEASUREMENT
/begin MEASUREMENT DFES_EnvBlock556 "vollständige Umweldaten alle Fehlerspeichereinträge" UBYTE DFES_OneToOne 1 100 0.00 255.0 ECU_ADDRESS 0xD00090AE /end MEASUREMENT
/begin MEASUREMENT DFES_EnvBlock557 "vollständige Umweldaten alle Fehlerspeichereinträge" UBYTE DFES_OneToOne 1 100 0.00 255.0 ECU_ADDRESS 0xD00090AF /end MEASUREMENT
/begin MEASUREMENT DFES_EnvBlock558 "vollständige Umweldaten alle Fehlerspeichereinträge" UBYTE DFES_OneToOne 1 100 0.00 255.0 ECU_ADDRESS 0xD00090B0 /end MEASUREMENT
/begin MEASUREMENT DFES_EnvBlock559 "vollständige Umweldaten alle Fehlerspeichereinträge" UBYTE DFES_OneToOne 1 100 0.00 255.0 ECU_ADDRESS 0xD00090B1 /end MEASUREMENT
/begin MEASUREMENT DFES_EnvBlock560 "vollständige Umweldaten alle Fehlerspeichereinträge" UBYTE DFES_OneToOne 1 100 0.00 255.0 ECU_ADDRESS 0xD00090B2 /end MEASUREMENT
/begin MEASUREMENT DFES_EnvBlock561 "vollständige Umweldaten alle Fehlerspeichereinträge" UBYTE DFES_OneToOne 1 100 0.00 255.0 ECU_ADDRESS 0xD00090B3 /end MEASUREMENT
/begin MEASUREMENT DFES_EnvBlock562 "vollständige Umweldaten alle Fehlerspeichereinträge" UBYTE DFES_OneToOne 1 100 0.00 255.0 ECU_ADDRESS 0xD00090B4 /end MEASUREMENT
/begin MEASUREMENT DFES_EnvBlock563 "vollständige Umweldaten alle Fehlerspeichereinträge" UBYTE DFES_OneToOne 1 100 0.00 255.0 ECU_ADDRESS 0xD00090B5 /end MEASUREMENT
/begin MEASUREMENT DFES_EnvBlock564 "vollständige Umweldaten alle Fehlerspeichereinträge" UBYTE DFES_OneToOne 1 100 0.00 255.0 ECU_ADDRESS 0xD00090B6 /end MEASUREMENT
/begin MEASUREMENT DFES_EnvBlock565 "vollständige Umweldaten alle Fehlerspeichereinträge" UBYTE DFES_OneToOne 1 100 0.00 255.0 ECU_ADDRESS 0xD00090B7 /end MEASUREMENT
/begin MEASUREMENT DFES_EnvBlock566 "vollständige Umweldaten alle Fehlerspeichereinträge" UBYTE DFES_OneToOne 1 100 0.00 255.0 ECU_ADDRESS 0xD00090B8 /end MEASUREMENT
/begin MEASUREMENT DFES_EnvBlock567 "vollständige Umweldaten alle Fehlerspeichereinträge" UBYTE DFES_OneToOne 1 100 0.00 255.0 ECU_ADDRESS 0xD00090B9 /end MEASUREMENT
/begin MEASUREMENT DFES_EnvBlock568 "vollständige Umweldaten alle Fehlerspeichereinträge" UBYTE DFES_OneToOne 1 100 0.00 255.0 ECU_ADDRESS 0xD00090BA /end MEASUREMENT
/begin MEASUREMENT DFES_EnvBlock569 "vollständige Umweldaten alle Fehlerspeichereinträge" UBYTE DFES_OneToOne 1 100 0.00 255.0 ECU_ADDRESS 0xD00090BB /end MEASUREMENT
/begin MEASUREMENT DFES_EnvBlock570 "vollständige Umweldaten alle Fehlerspeichereinträge" UBYTE DFES_OneToOne 1 100 0.00 255.0 ECU_ADDRESS 0xD00090BC /end MEASUREMENT
/begin MEASUREMENT DFES_EnvBlock571 "vollständige Umweldaten alle Fehlerspeichereinträge" UBYTE DFES_OneToOne 1 100 0.00 255.0 ECU_ADDRESS 0xD00090BD /end MEASUREMENT
/begin MEASUREMENT DFES_EnvBlock572 "vollständige Umweldaten alle Fehlerspeichereinträge" UBYTE DFES_OneToOne 1 100 0.00 255.0 ECU_ADDRESS 0xD00090BE /end MEASUREMENT
/begin MEASUREMENT DFES_EnvBlock573 "vollständige Umweldaten alle Fehlerspeichereinträge" UBYTE DFES_OneToOne 1 100 0.00 255.0 ECU_ADDRESS 0xD00090BF /end MEASUREMENT
/begin MEASUREMENT DFES_EnvBlock574 "vollständige Umweldaten alle Fehlerspeichereinträge" UBYTE DFES_OneToOne 1 100 0.00 255.0 ECU_ADDRESS 0xD00090C0 /end MEASUREMENT
/begin MEASUREMENT DFES_EnvBlock575 "vollständige Umweldaten alle Fehlerspeichereinträge" UBYTE DFES_OneToOne 1 100 0.00 255.0 ECU_ADDRESS 0xD00090C1 /end MEASUREMENT
/begin MEASUREMENT DFES_EnvBlock576 "vollständige Umweldaten alle Fehlerspeichereinträge" UBYTE DFES_OneToOne 1 100 0.00 255.0 ECU_ADDRESS 0xD00090C2 /end MEASUREMENT
/begin MEASUREMENT DFES_EnvBlock577 "vollständige Umweldaten alle Fehlerspeichereinträge" UBYTE DFES_OneToOne 1 100 0.00 255.0 ECU_ADDRESS 0xD00090C3 /end MEASUREMENT
/begin MEASUREMENT DFES_EnvBlock578 "vollständige Umweldaten alle Fehlerspeichereinträge" UBYTE DFES_OneToOne 1 100 0.00 255.0 ECU_ADDRESS 0xD00090C4 /end MEASUREMENT
/begin MEASUREMENT DFES_EnvBlock579 "vollständige Umweldaten alle Fehlerspeichereinträge" UBYTE DFES_OneToOne 1 100 0.00 255.0 ECU_ADDRESS 0xD00090C5 /end MEASUREMENT
/begin MEASUREMENT DFES_EnvBlock580 "vollständige Umweldaten alle Fehlerspeichereinträge" UBYTE DFES_OneToOne 1 100 0.00 255.0 ECU_ADDRESS 0xD00090C6 /end MEASUREMENT
/begin MEASUREMENT DFES_EnvBlock581 "vollständige Umweldaten alle Fehlerspeichereinträge" UBYTE DFES_OneToOne 1 100 0.00 255.0 ECU_ADDRESS 0xD00090C7 /end MEASUREMENT
/begin MEASUREMENT DFES_EnvBlock582 "vollständige Umweldaten alle Fehlerspeichereinträge" UBYTE DFES_OneToOne 1 100 0.00 255.0 ECU_ADDRESS 0xD00090C8 /end MEASUREMENT
/begin MEASUREMENT DFES_EnvBlock583 "vollständige Umweldaten alle Fehlerspeichereinträge" UBYTE DFES_OneToOne 1 100 0.00 255.0 ECU_ADDRESS 0xD00090C9 /end MEASUREMENT
/begin MEASUREMENT DFES_EnvBlock584 "vollständige Umweldaten alle Fehlerspeichereinträge" UBYTE DFES_OneToOne 1 100 0.00 255.0 ECU_ADDRESS 0xD00090CA /end MEASUREMENT
/begin MEASUREMENT DFES_EnvBlock585 "vollständige Umweldaten alle Fehlerspeichereinträge" UBYTE DFES_OneToOne 1 100 0.00 255.0 ECU_ADDRESS 0xD00090CB /end MEASUREMENT
/begin MEASUREMENT DFES_EnvBlock586 "vollständige Umweldaten alle Fehlerspeichereinträge" UBYTE DFES_OneToOne 1 100 0.00 255.0 ECU_ADDRESS 0xD00090CC /end MEASUREMENT
/begin MEASUREMENT DFES_EnvBlock587 "vollständige Umweldaten alle Fehlerspeichereinträge" UBYTE DFES_OneToOne 1 100 0.00 255.0 ECU_ADDRESS 0xD00090CD /end MEASUREMENT
/begin MEASUREMENT DFES_EnvBlock588 "vollständige Umweldaten alle Fehlerspeichereinträge" UBYTE DFES_OneToOne 1 100 0.00 255.0 ECU_ADDRESS 0xD00090CE /end MEASUREMENT
/begin MEASUREMENT DFES_EnvBlock589 "vollständige Umweldaten alle Fehlerspeichereinträge" UBYTE DFES_OneToOne 1 100 0.00 255.0 ECU_ADDRESS 0xD00090CF /end MEASUREMENT
/begin MEASUREMENT DFES_EnvBlock590 "vollständige Umweldaten alle Fehlerspeichereinträge" UBYTE DFES_OneToOne 1 100 0.00 255.0 ECU_ADDRESS 0xD00090D0 /end MEASUREMENT
/begin MEASUREMENT DFES_EnvBlock591 "vollständige Umweldaten alle Fehlerspeichereinträge" UBYTE DFES_OneToOne 1 100 0.00 255.0 ECU_ADDRESS 0xD00090D1 /end MEASUREMENT
/begin MEASUREMENT DFES_EnvBlock592 "vollständige Umweldaten alle Fehlerspeichereinträge" UBYTE DFES_OneToOne 1 100 0.00 255.0 ECU_ADDRESS 0xD00090D2 /end MEASUREMENT
/begin MEASUREMENT DFES_EnvBlock593 "vollständige Umweldaten alle Fehlerspeichereinträge" UBYTE DFES_OneToOne 1 100 0.00 255.0 ECU_ADDRESS 0xD00090D3 /end MEASUREMENT
/begin MEASUREMENT DFES_EnvBlock594 "vollständige Umweldaten alle Fehlerspeichereinträge" UBYTE DFES_OneToOne 1 100 0.00 255.0 ECU_ADDRESS 0xD00090D4 /end MEASUREMENT
/begin MEASUREMENT DFES_EnvBlock595 "vollständige Umweldaten alle Fehlerspeichereinträge" UBYTE DFES_OneToOne 1 100 0.00 255.0 ECU_ADDRESS 0xD00090D5 /end MEASUREMENT
/begin MEASUREMENT DFES_EnvBlock596 "vollständige Umweldaten alle Fehlerspeichereinträge" UBYTE DFES_OneToOne 1 100 0.00 255.0 ECU_ADDRESS 0xD00090D6 /end MEASUREMENT
/begin MEASUREMENT DFES_EnvBlock597 "vollständige Umweldaten alle Fehlerspeichereinträge" UBYTE DFES_OneToOne 1 100 0.00 255.0 ECU_ADDRESS 0xD00090D7 /end MEASUREMENT
/begin MEASUREMENT DFES_EnvBlock598 "vollständige Umweldaten alle Fehlerspeichereinträge" UBYTE DFES_OneToOne 1 100 0.00 255.0 ECU_ADDRESS 0xD00090D8 /end MEASUREMENT
/begin MEASUREMENT DFES_EnvBlock599 "vollständige Umweldaten alle Fehlerspeichereinträge" UBYTE DFES_OneToOne 1 100 0.00 255.0 ECU_ADDRESS 0xD00090D9 /end MEASUREMENT
/begin MEASUREMENT DFES_EnvBlock600 "vollständige Umweldaten alle Fehlerspeichereinträge" UBYTE DFES_OneToOne 1 100 0.00 255.0 ECU_ADDRESS 0xD00090DA /end MEASUREMENT
/begin MEASUREMENT DFES_EnvBlock601 "vollständige Umweldaten alle Fehlerspeichereinträge" UBYTE DFES_OneToOne 1 100 0.00 255.0 ECU_ADDRESS 0xD00090DB /end MEASUREMENT
/begin MEASUREMENT DFES_EnvBlock602 "vollständige Umweldaten alle Fehlerspeichereinträge" UBYTE DFES_OneToOne 1 100 0.00 255.0 ECU_ADDRESS 0xD00090DC /end MEASUREMENT
/begin MEASUREMENT DFES_EnvBlock603 "vollständige Umweldaten alle Fehlerspeichereinträge" UBYTE DFES_OneToOne 1 100 0.00 255.0 ECU_ADDRESS 0xD00090DD /end MEASUREMENT
/begin MEASUREMENT DFES_EnvBlock604 "vollständige Umweldaten alle Fehlerspeichereinträge" UBYTE DFES_OneToOne 1 100 0.00 255.0 ECU_ADDRESS 0xD00090DE /end MEASUREMENT
/begin MEASUREMENT DFES_EnvBlock605 "vollständige Umweldaten alle Fehlerspeichereinträge" UBYTE DFES_OneToOne 1 100 0.00 255.0 ECU_ADDRESS 0xD00090DF /end MEASUREMENT
/begin MEASUREMENT DFES_EnvBlock606 "vollständige Umweldaten alle Fehlerspeichereinträge" UBYTE DFES_OneToOne 1 100 0.00 255.0 ECU_ADDRESS 0xD00090E0 /end MEASUREMENT
/begin MEASUREMENT DFES_EnvBlock607 "vollständige Umweldaten alle Fehlerspeichereinträge" UBYTE DFES_OneToOne 1 100 0.00 255.0 ECU_ADDRESS 0xD00090E1 /end MEASUREMENT
/begin MEASUREMENT DFES_EnvBlock608 "vollständige Umweldaten alle Fehlerspeichereinträge" UBYTE DFES_OneToOne 1 100 0.00 255.0 ECU_ADDRESS 0xD00090E2 /end MEASUREMENT
/begin MEASUREMENT DFES_EnvBlock609 "vollständige Umweldaten alle Fehlerspeichereinträge" UBYTE DFES_OneToOne 1 100 0.00 255.0 ECU_ADDRESS 0xD00090E3 /end MEASUREMENT
/begin MEASUREMENT DFES_EnvBlock610 "vollständige Umweldaten alle Fehlerspeichereinträge" UBYTE DFES_OneToOne 1 100 0.00 255.0 ECU_ADDRESS 0xD00090E4 /end MEASUREMENT
/begin MEASUREMENT DFES_EnvBlock611 "vollständige Umweldaten alle Fehlerspeichereinträge" UBYTE DFES_OneToOne 1 100 0.00 255.0 ECU_ADDRESS 0xD00090E5 /end MEASUREMENT
/begin MEASUREMENT DFES_EnvBlock612 "vollständige Umweldaten alle Fehlerspeichereinträge" UBYTE DFES_OneToOne 1 100 0.00 255.0 ECU_ADDRESS 0xD00090E6 /end MEASUREMENT
/begin MEASUREMENT DFES_EnvBlock613 "vollständige Umweldaten alle Fehlerspeichereinträge" UBYTE DFES_OneToOne 1 100 0.00 255.0 ECU_ADDRESS 0xD00090E7 /end MEASUREMENT
/begin MEASUREMENT DFES_EnvBlock614 "vollständige Umweldaten alle Fehlerspeichereinträge" UBYTE DFES_OneToOne 1 100 0.00 255.0 ECU_ADDRESS 0xD00090E8 /end MEASUREMENT
/begin MEASUREMENT DFES_EnvBlock615 "vollständige Umweldaten alle Fehlerspeichereinträge" UBYTE DFES_OneToOne 1 100 0.00 255.0 ECU_ADDRESS 0xD00090E9 /end MEASUREMENT
/begin MEASUREMENT DFES_EnvBlock616 "vollständige Umweldaten alle Fehlerspeichereinträge" UBYTE DFES_OneToOne 1 100 0.00 255.0 ECU_ADDRESS 0xD00090EA /end MEASUREMENT
/begin MEASUREMENT DFES_EnvBlock617 "vollständige Umweldaten alle Fehlerspeichereinträge" UBYTE DFES_OneToOne 1 100 0.00 255.0 ECU_ADDRESS 0xD00090EB /end MEASUREMENT
/begin MEASUREMENT DFES_EnvBlock618 "vollständige Umweldaten alle Fehlerspeichereinträge" UBYTE DFES_OneToOne 1 100 0.00 255.0 ECU_ADDRESS 0xD00090EC /end MEASUREMENT
/begin MEASUREMENT DFES_EnvBlock619 "vollständige Umweldaten alle Fehlerspeichereinträge" UBYTE DFES_OneToOne 1 100 0.00 255.0 ECU_ADDRESS 0xD00090ED /end MEASUREMENT
/begin MEASUREMENT DFES_EnvBlock620 "vollständige Umweldaten alle Fehlerspeichereinträge" UBYTE DFES_OneToOne 1 100 0.00 255.0 ECU_ADDRESS 0xD00090EE /end MEASUREMENT
/begin MEASUREMENT DFES_EnvBlock621 "vollständige Umweldaten alle Fehlerspeichereinträge" UBYTE DFES_OneToOne 1 100 0.00 255.0 ECU_ADDRESS 0xD00090EF /end MEASUREMENT
/begin MEASUREMENT DFES_EnvBlock622 "vollständige Umweldaten alle Fehlerspeichereinträge" UBYTE DFES_OneToOne 1 100 0.00 255.0 ECU_ADDRESS 0xD00090F0 /end MEASUREMENT
/begin MEASUREMENT DFES_EnvBlock623 "vollständige Umweldaten alle Fehlerspeichereinträge" UBYTE DFES_OneToOne 1 100 0.00 255.0 ECU_ADDRESS 0xD00090F1 /end MEASUREMENT
/begin MEASUREMENT DFES_EnvBlock624 "vollständige Umweldaten alle Fehlerspeichereinträge" UBYTE DFES_OneToOne 1 100 0.00 255.0 ECU_ADDRESS 0xD00090F2 /end MEASUREMENT
/begin MEASUREMENT DFES_EnvBlock625 "vollständige Umweldaten alle Fehlerspeichereinträge" UBYTE DFES_OneToOne 1 100 0.00 255.0 ECU_ADDRESS 0xD00090F3 /end MEASUREMENT
/begin MEASUREMENT DFES_EnvBlock626 "vollständige Umweldaten alle Fehlerspeichereinträge" UBYTE DFES_OneToOne 1 100 0.00 255.0 ECU_ADDRESS 0xD00090F4 /end MEASUREMENT
/begin MEASUREMENT DFES_EnvBlock627 "vollständige Umweldaten alle Fehlerspeichereinträge" UBYTE DFES_OneToOne 1 100 0.00 255.0 ECU_ADDRESS 0xD00090F5 /end MEASUREMENT
/begin MEASUREMENT DFES_EnvBlock628 "vollständige Umweldaten alle Fehlerspeichereinträge" UBYTE DFES_OneToOne 1 100 0.00 255.0 ECU_ADDRESS 0xD00090F6 /end MEASUREMENT
/begin MEASUREMENT DFES_EnvBlock629 "vollständige Umweldaten alle Fehlerspeichereinträge" UBYTE DFES_OneToOne 1 100 0.00 255.0 ECU_ADDRESS 0xD00090F7 /end MEASUREMENT
/begin MEASUREMENT DFES_EnvBlock630 "vollständige Umweldaten alle Fehlerspeichereinträge" UBYTE DFES_OneToOne 1 100 0.00 255.0 ECU_ADDRESS 0xD00090F8 /end MEASUREMENT
/begin MEASUREMENT DFES_EnvBlock631 "vollständige Umweldaten alle Fehlerspeichereinträge" UBYTE DFES_OneToOne 1 100 0.00 255.0 ECU_ADDRESS 0xD00090F9 /end MEASUREMENT
/begin MEASUREMENT DFES_EnvBlock632 "vollständige Umweldaten alle Fehlerspeichereinträge" UBYTE DFES_OneToOne 1 100 0.00 255.0 ECU_ADDRESS 0xD00090FA /end MEASUREMENT
/begin MEASUREMENT DFES_EnvBlock633 "vollständige Umweldaten alle Fehlerspeichereinträge" UBYTE DFES_OneToOne 1 100 0.00 255.0 ECU_ADDRESS 0xD00090FB /end MEASUREMENT
/begin MEASUREMENT DFES_EnvBlock634 "vollständige Umweldaten alle Fehlerspeichereinträge" UBYTE DFES_OneToOne 1 100 0.00 255.0 ECU_ADDRESS 0xD00090FC /end MEASUREMENT
/begin MEASUREMENT DFES_EnvBlock635 "vollständige Umweldaten alle Fehlerspeichereinträge" UBYTE DFES_OneToOne 1 100 0.00 255.0 ECU_ADDRESS 0xD00090FD /end MEASUREMENT
/begin MEASUREMENT DFES_EnvBlock636 "vollständige Umweldaten alle Fehlerspeichereinträge" UBYTE DFES_OneToOne 1 100 0.00 255.0 ECU_ADDRESS 0xD00090FE /end MEASUREMENT
/begin MEASUREMENT DFES_EnvBlock637 "vollständige Umweldaten alle Fehlerspeichereinträge" UBYTE DFES_OneToOne 1 100 0.00 255.0 ECU_ADDRESS 0xD00090FF /end MEASUREMENT
/begin MEASUREMENT DFES_EnvBlock638 "vollständige Umweldaten alle Fehlerspeichereinträge" UBYTE DFES_OneToOne 1 100 0.00 255.0 ECU_ADDRESS 0xD0009100 /end MEASUREMENT
/begin MEASUREMENT DFES_EnvBlock639 "vollständige Umweldaten alle Fehlerspeichereinträge" UBYTE DFES_OneToOne 1 100 0.00 255.0 ECU_ADDRESS 0xD0009101 /end MEASUREMENT
/begin MEASUREMENT DFES_EnvBlock640 "vollständige Umweldaten alle Fehlerspeichereinträge" UBYTE DFES_OneToOne 1 100 0.00 255.0 ECU_ADDRESS 0xD0009102 /end MEASUREMENT
/begin MEASUREMENT DFES_EnvBlock641 "vollständige Umweldaten alle Fehlerspeichereinträge" UBYTE DFES_OneToOne 1 100 0.00 255.0 ECU_ADDRESS 0xD0009103 /end MEASUREMENT
/begin MEASUREMENT DFES_EnvBlock642 "vollständige Umweldaten alle Fehlerspeichereinträge" UBYTE DFES_OneToOne 1 100 0.00 255.0 ECU_ADDRESS 0xD0009104 /end MEASUREMENT
/begin MEASUREMENT DFES_EnvBlock643 "vollständige Umweldaten alle Fehlerspeichereinträge" UBYTE DFES_OneToOne 1 100 0.00 255.0 ECU_ADDRESS 0xD0009105 /end MEASUREMENT
/begin MEASUREMENT DFES_EnvBlock644 "vollständige Umweldaten alle Fehlerspeichereinträge" UBYTE DFES_OneToOne 1 100 0.00 255.0 ECU_ADDRESS 0xD0009106 /end MEASUREMENT
/begin MEASUREMENT DFES_EnvBlock645 "vollständige Umweldaten alle Fehlerspeichereinträge" UBYTE DFES_OneToOne 1 100 0.00 255.0 ECU_ADDRESS 0xD0009107 /end MEASUREMENT
/begin MEASUREMENT DFES_EnvBlock646 "vollständige Umweldaten alle Fehlerspeichereinträge" UBYTE DFES_OneToOne 1 100 0.00 255.0 ECU_ADDRESS 0xD0009108 /end MEASUREMENT
/begin MEASUREMENT DFES_EnvBlock647 "vollständige Umweldaten alle Fehlerspeichereinträge" UBYTE DFES_OneToOne 1 100 0.00 255.0 ECU_ADDRESS 0xD0009109 /end MEASUREMENT
/begin MEASUREMENT DFES_EnvBlock648 "vollständige Umweldaten alle Fehlerspeichereinträge" UBYTE DFES_OneToOne 1 100 0.00 255.0 ECU_ADDRESS 0xD000910A /end MEASUREMENT
/begin MEASUREMENT DFES_EnvBlock649 "vollständige Umweldaten alle Fehlerspeichereinträge" UBYTE DFES_OneToOne 1 100 0.00 255.0 ECU_ADDRESS 0xD000910B /end MEASUREMENT
/begin MEASUREMENT DFES_EnvBlock650 "vollständige Umweldaten alle Fehlerspeichereinträge" UBYTE DFES_OneToOne 1 100 0.00 255.0 ECU_ADDRESS 0xD000910C /end MEASUREMENT
/begin MEASUREMENT DFES_EnvBlock651 "vollständige Umweldaten alle Fehlerspeichereinträge" UBYTE DFES_OneToOne 1 100 0.00 255.0 ECU_ADDRESS 0xD000910D /end MEASUREMENT
/begin MEASUREMENT DFES_EnvBlock652 "vollständige Umweldaten alle Fehlerspeichereinträge" UBYTE DFES_OneToOne 1 100 0.00 255.0 ECU_ADDRESS 0xD000910E /end MEASUREMENT
/begin MEASUREMENT DFES_EnvBlock653 "vollständige Umweldaten alle Fehlerspeichereinträge" UBYTE DFES_OneToOne 1 100 0.00 255.0 ECU_ADDRESS 0xD000910F /end MEASUREMENT
/begin MEASUREMENT DFES_EnvBlock654 "vollständige Umweldaten alle Fehlerspeichereinträge" UBYTE DFES_OneToOne 1 100 0.00 255.0 ECU_ADDRESS 0xD0009110 /end MEASUREMENT
/begin MEASUREMENT DFES_EnvBlock655 "vollständige Umweldaten alle Fehlerspeichereinträge" UBYTE DFES_OneToOne 1 100 0.00 255.0 ECU_ADDRESS 0xD0009111 /end MEASUREMENT
/begin MEASUREMENT DFES_EnvBlock656 "vollständige Umweldaten alle Fehlerspeichereinträge" UBYTE DFES_OneToOne 1 100 0.00 255.0 ECU_ADDRESS 0xD0009112 /end MEASUREMENT
/begin MEASUREMENT DFES_EnvBlock657 "vollständige Umweldaten alle Fehlerspeichereinträge" UBYTE DFES_OneToOne 1 100 0.00 255.0 ECU_ADDRESS 0xD0009113 /end MEASUREMENT
/begin MEASUREMENT DFES_EnvBlock658 "vollständige Umweldaten alle Fehlerspeichereinträge" UBYTE DFES_OneToOne 1 100 0.00 255.0 ECU_ADDRESS 0xD0009114 /end MEASUREMENT
/begin MEASUREMENT DFES_EnvBlock659 "vollständige Umweldaten alle Fehlerspeichereinträge" UBYTE DFES_OneToOne 1 100 0.00 255.0 ECU_ADDRESS 0xD0009115 /end MEASUREMENT
/begin MEASUREMENT DFES_EnvBlock660 "vollständige Umweldaten alle Fehlerspeichereinträge" UBYTE DFES_OneToOne 1 100 0.00 255.0 ECU_ADDRESS 0xD0009116 /end MEASUREMENT
/begin MEASUREMENT DFES_EnvBlock661 "vollständige Umweldaten alle Fehlerspeichereinträge" UBYTE DFES_OneToOne 1 100 0.00 255.0 ECU_ADDRESS 0xD0009117 /end MEASUREMENT
/begin MEASUREMENT DFES_EnvBlock662 "vollständige Umweldaten alle Fehlerspeichereinträge" UBYTE DFES_OneToOne 1 100 0.00 255.0 ECU_ADDRESS 0xD0009118 /end MEASUREMENT
/begin MEASUREMENT DFES_EnvBlock663 "vollständige Umweldaten alle Fehlerspeichereinträge" UBYTE DFES_OneToOne 1 100 0.00 255.0 ECU_ADDRESS 0xD0009119 /end MEASUREMENT
/begin MEASUREMENT DFES_EnvBlock664 "vollständige Umweldaten alle Fehlerspeichereinträge" UBYTE DFES_OneToOne 1 100 0.00 255.0 ECU_ADDRESS 0xD000911A /end MEASUREMENT
/begin MEASUREMENT DFES_EnvBlock665 "vollständige Umweldaten alle Fehlerspeichereinträge" UBYTE DFES_OneToOne 1 100 0.00 255.0 ECU_ADDRESS 0xD000911B /end MEASUREMENT
/begin MEASUREMENT DFES_EnvBlock666 "vollständige Umweldaten alle Fehlerspeichereinträge" UBYTE DFES_OneToOne 1 100 0.00 255.0 ECU_ADDRESS 0xD000911C /end MEASUREMENT
/begin MEASUREMENT DFES_EnvBlock667 "vollständige Umweldaten alle Fehlerspeichereinträge" UBYTE DFES_OneToOne 1 100 0.00 255.0 ECU_ADDRESS 0xD000911D /end MEASUREMENT
/begin MEASUREMENT DFES_EnvBlock668 "vollständige Umweldaten alle Fehlerspeichereinträge" UBYTE DFES_OneToOne 1 100 0.00 255.0 ECU_ADDRESS 0xD000911E /end MEASUREMENT
/begin MEASUREMENT DFES_EnvBlock669 "vollständige Umweldaten alle Fehlerspeichereinträge" UBYTE DFES_OneToOne 1 100 0.00 255.0 ECU_ADDRESS 0xD000911F /end MEASUREMENT
/begin MEASUREMENT DFES_EnvBlock670 "vollständige Umweldaten alle Fehlerspeichereinträge" UBYTE DFES_OneToOne 1 100 0.00 255.0 ECU_ADDRESS 0xD0009120 /end MEASUREMENT
/begin MEASUREMENT DFES_EnvBlock671 "vollständige Umweldaten alle Fehlerspeichereinträge" UBYTE DFES_OneToOne 1 100 0.00 255.0 ECU_ADDRESS 0xD0009121 /end MEASUREMENT
/begin MEASUREMENT DFES_EnvBlock672 "vollständige Umweldaten alle Fehlerspeichereinträge" UBYTE DFES_OneToOne 1 100 0.00 255.0 ECU_ADDRESS 0xD0009122 /end MEASUREMENT
/begin MEASUREMENT DFES_EnvBlock673 "vollständige Umweldaten alle Fehlerspeichereinträge" UBYTE DFES_OneToOne 1 100 0.00 255.0 ECU_ADDRESS 0xD0009123 /end MEASUREMENT
/begin MEASUREMENT DFES_EnvBlock674 "vollständige Umweldaten alle Fehlerspeichereinträge" UBYTE DFES_OneToOne 1 100 0.00 255.0 ECU_ADDRESS 0xD0009124 /end MEASUREMENT
/begin MEASUREMENT DFES_EnvBlock675 "vollständige Umweldaten alle Fehlerspeichereinträge" UBYTE DFES_OneToOne 1 100 0.00 255.0 ECU_ADDRESS 0xD0009125 /end MEASUREMENT
/begin MEASUREMENT DFES_EnvBlock676 "vollständige Umweldaten alle Fehlerspeichereinträge" UBYTE DFES_OneToOne 1 100 0.00 255.0 ECU_ADDRESS 0xD0009126 /end MEASUREMENT
/begin MEASUREMENT DFES_EnvBlock677 "vollständige Umweldaten alle Fehlerspeichereinträge" UBYTE DFES_OneToOne 1 100 0.00 255.0 ECU_ADDRESS 0xD0009127 /end MEASUREMENT
/begin MEASUREMENT DFES_EnvBlock678 "vollständige Umweldaten alle Fehlerspeichereinträge" UBYTE DFES_OneToOne 1 100 0.00 255.0 ECU_ADDRESS 0xD0009128 /end MEASUREMENT
/begin MEASUREMENT DFES_EnvBlock679 "vollständige Umweldaten alle Fehlerspeichereinträge" UBYTE DFES_OneToOne 1 100 0.00 255.0 ECU_ADDRESS 0xD0009129 /end MEASUREMENT
/begin MEASUREMENT DFES_EnvBlock680 "vollständige Umweldaten alle Fehlerspeichereinträge" UBYTE DFES_OneToOne 1 100 0.00 255.0 ECU_ADDRESS 0xD000912A /end MEASUREMENT
/begin MEASUREMENT DFES_EnvBlock681 "vollständige Umweldaten alle Fehlerspeichereinträge" UBYTE DFES_OneToOne 1 100 0.00 255.0 ECU_ADDRESS 0xD000912B /end MEASUREMENT
/begin MEASUREMENT DFES_EnvBlock682 "vollständige Umweldaten alle Fehlerspeichereinträge" UBYTE DFES_OneToOne 1 100 0.00 255.0 ECU_ADDRESS 0xD000912C /end MEASUREMENT
/begin MEASUREMENT DFES_EnvBlock683 "vollständige Umweldaten alle Fehlerspeichereinträge" UBYTE DFES_OneToOne 1 100 0.00 255.0 ECU_ADDRESS 0xD000912D /end MEASUREMENT
/begin MEASUREMENT DFES_EnvBlock684 "vollständige Umweldaten alle Fehlerspeichereinträge" UBYTE DFES_OneToOne 1 100 0.00 255.0 ECU_ADDRESS 0xD000912E /end MEASUREMENT
/begin MEASUREMENT DFES_EnvBlock685 "vollständige Umweldaten alle Fehlerspeichereinträge" UBYTE DFES_OneToOne 1 100 0.00 255.0 ECU_ADDRESS 0xD000912F /end MEASUREMENT
/begin MEASUREMENT DFES_EnvBlock686 "vollständige Umweldaten alle Fehlerspeichereinträge" UBYTE DFES_OneToOne 1 100 0.00 255.0 ECU_ADDRESS 0xD0009130 /end MEASUREMENT
/begin MEASUREMENT DFES_EnvBlock687 "vollständige Umweldaten alle Fehlerspeichereinträge" UBYTE DFES_OneToOne 1 100 0.00 255.0 ECU_ADDRESS 0xD0009131 /end MEASUREMENT
/begin MEASUREMENT DFES_EnvBlock688 "vollständige Umweldaten alle Fehlerspeichereinträge" UBYTE DFES_OneToOne 1 100 0.00 255.0 ECU_ADDRESS 0xD0009132 /end MEASUREMENT
/begin MEASUREMENT DFES_EnvBlock689 "vollständige Umweldaten alle Fehlerspeichereinträge" UBYTE DFES_OneToOne 1 100 0.00 255.0 ECU_ADDRESS 0xD0009133 /end MEASUREMENT
/begin MEASUREMENT DFES_EnvBlock690 "vollständige Umweldaten alle Fehlerspeichereinträge" UBYTE DFES_OneToOne 1 100 0.00 255.0 ECU_ADDRESS 0xD0009134 /end MEASUREMENT
/begin MEASUREMENT DFES_EnvBlock691 "vollständige Umweldaten alle Fehlerspeichereinträge" UBYTE DFES_OneToOne 1 100 0.00 255.0 ECU_ADDRESS 0xD0009135 /end MEASUREMENT
/begin MEASUREMENT DFES_EnvBlock692 "vollständige Umweldaten alle Fehlerspeichereinträge" UBYTE DFES_OneToOne 1 100 0.00 255.0 ECU_ADDRESS 0xD0009136 /end MEASUREMENT
/begin MEASUREMENT DFES_EnvBlock693 "vollständige Umweldaten alle Fehlerspeichereinträge" UBYTE DFES_OneToOne 1 100 0.00 255.0 ECU_ADDRESS 0xD0009137 /end MEASUREMENT
/begin MEASUREMENT DFES_EnvBlock694 "vollständige Umweldaten alle Fehlerspeichereinträge" UBYTE DFES_OneToOne 1 100 0.00 255.0 ECU_ADDRESS 0xD0009138 /end MEASUREMENT
/begin MEASUREMENT DFES_EnvBlock695 "vollständige Umweldaten alle Fehlerspeichereinträge" UBYTE DFES_OneToOne 1 100 0.00 255.0 ECU_ADDRESS 0xD0009139 /end MEASUREMENT
/begin MEASUREMENT DFES_EnvBlock696 "vollständige Umweldaten alle Fehlerspeichereinträge" UBYTE DFES_OneToOne 1 100 0.00 255.0 ECU_ADDRESS 0xD000913A /end MEASUREMENT
/begin MEASUREMENT DFES_EnvBlock697 "vollständige Umweldaten alle Fehlerspeichereinträge" UBYTE DFES_OneToOne 1 100 0.00 255.0 ECU_ADDRESS 0xD000913B /end MEASUREMENT
/begin MEASUREMENT DFES_EnvBlock698 "vollständige Umweldaten alle Fehlerspeichereinträge" UBYTE DFES_OneToOne 1 100 0.00 255.0 ECU_ADDRESS 0xD000913C /end MEASUREMENT
/begin MEASUREMENT DFES_EnvBlock699 "vollständige Umweldaten alle Fehlerspeichereinträge" UBYTE DFES_OneToOne 1 100 0.00 255.0 ECU_ADDRESS 0xD000913D /end MEASUREMENT
/begin MEASUREMENT DFES_EnvBlock700 "vollständige Umweldaten alle Fehlerspeichereinträge" UBYTE DFES_OneToOne 1 100 0.00 255.0 ECU_ADDRESS 0xD000913E /end MEASUREMENT
/begin MEASUREMENT DFES_EnvBlock701 "vollständige Umweldaten alle Fehlerspeichereinträge" UBYTE DFES_OneToOne 1 100 0.00 255.0 ECU_ADDRESS 0xD000913F /end MEASUREMENT
/begin MEASUREMENT DFES_EnvBlock702 "vollständige Umweldaten alle Fehlerspeichereinträge" UBYTE DFES_OneToOne 1 100 0.00 255.0 ECU_ADDRESS 0xD0009140 /end MEASUREMENT
/begin MEASUREMENT DFES_EnvBlock703 "vollständige Umweldaten alle Fehlerspeichereinträge" UBYTE DFES_OneToOne 1 100 0.00 255.0 ECU_ADDRESS 0xD0009141 /end MEASUREMENT
/begin MEASUREMENT DFES_EnvBlock704 "vollständige Umweldaten alle Fehlerspeichereinträge" UBYTE DFES_OneToOne 1 100 0.00 255.0 ECU_ADDRESS 0xD0009142 /end MEASUREMENT
/begin MEASUREMENT DFES_EnvBlock705 "vollständige Umweldaten alle Fehlerspeichereinträge" UBYTE DFES_OneToOne 1 100 0.00 255.0 ECU_ADDRESS 0xD0009143 /end MEASUREMENT
/begin MEASUREMENT DFES_EnvBlock706 "vollständige Umweldaten alle Fehlerspeichereinträge" UBYTE DFES_OneToOne 1 100 0.00 255.0 ECU_ADDRESS 0xD0009144 /end MEASUREMENT
/begin MEASUREMENT DFES_EnvBlock707 "vollständige Umweldaten alle Fehlerspeichereinträge" UBYTE DFES_OneToOne 1 100 0.00 255.0 ECU_ADDRESS 0xD0009145 /end MEASUREMENT
/begin MEASUREMENT DFES_EnvBlock708 "vollständige Umweldaten alle Fehlerspeichereinträge" UBYTE DFES_OneToOne 1 100 0.00 255.0 ECU_ADDRESS 0xD0009146 /end MEASUREMENT
/begin MEASUREMENT DFES_EnvBlock709 "vollständige Umweldaten alle Fehlerspeichereinträge" UBYTE DFES_OneToOne 1 100 0.00 255.0 ECU_ADDRESS 0xD0009147 /end MEASUREMENT
/begin MEASUREMENT DFES_EnvBlock710 "vollständige Umweldaten alle Fehlerspeichereinträge" UBYTE DFES_OneToOne 1 100 0.00 255.0 ECU_ADDRESS 0xD0009148 /end MEASUREMENT
/begin MEASUREMENT DFES_EnvBlock711 "vollständige Umweldaten alle Fehlerspeichereinträge" UBYTE DFES_OneToOne 1 100 0.00 255.0 ECU_ADDRESS 0xD0009149 /end MEASUREMENT
/begin MEASUREMENT DFES_EnvBlock712 "vollständige Umweldaten alle Fehlerspeichereinträge" UBYTE DFES_OneToOne 1 100 0.00 255.0 ECU_ADDRESS 0xD000914A /end MEASUREMENT
/begin MEASUREMENT DFES_EnvBlock713 "vollständige Umweldaten alle Fehlerspeichereinträge" UBYTE DFES_OneToOne 1 100 0.00 255.0 ECU_ADDRESS 0xD000914B /end MEASUREMENT
/begin MEASUREMENT DFES_EnvBlock714 "vollständige Umweldaten alle Fehlerspeichereinträge" UBYTE DFES_OneToOne 1 100 0.00 255.0 ECU_ADDRESS 0xD000914C /end MEASUREMENT
/begin MEASUREMENT DFES_EnvBlock715 "vollständige Umweldaten alle Fehlerspeichereinträge" UBYTE DFES_OneToOne 1 100 0.00 255.0 ECU_ADDRESS 0xD000914D /end MEASUREMENT
/begin MEASUREMENT DFES_EnvBlock716 "vollständige Umweldaten alle Fehlerspeichereinträge" UBYTE DFES_OneToOne 1 100 0.00 255.0 ECU_ADDRESS 0xD000914E /end MEASUREMENT
/begin MEASUREMENT DFES_EnvBlock717 "vollständige Umweldaten alle Fehlerspeichereinträge" UBYTE DFES_OneToOne 1 100 0.00 255.0 ECU_ADDRESS 0xD000914F /end MEASUREMENT
/begin MEASUREMENT DFES_EnvBlock718 "vollständige Umweldaten alle Fehlerspeichereinträge" UBYTE DFES_OneToOne 1 100 0.00 255.0 ECU_ADDRESS 0xD0009150 /end MEASUREMENT
/begin MEASUREMENT DFES_EnvBlock719 "vollständige Umweldaten alle Fehlerspeichereinträge" UBYTE DFES_OneToOne 1 100 0.00 255.0 ECU_ADDRESS 0xD0009151 /end MEASUREMENT
/begin MEASUREMENT DFES_EnvBlock720 "vollständige Umweldaten alle Fehlerspeichereinträge" UBYTE DFES_OneToOne 1 100 0.00 255.0 ECU_ADDRESS 0xD0009152 /end MEASUREMENT
/begin MEASUREMENT DFES_EnvBlock721 "vollständige Umweldaten alle Fehlerspeichereinträge" UBYTE DFES_OneToOne 1 100 0.00 255.0 ECU_ADDRESS 0xD0009153 /end MEASUREMENT
/begin MEASUREMENT DFES_EnvBlock722 "vollständige Umweldaten alle Fehlerspeichereinträge" UBYTE DFES_OneToOne 1 100 0.00 255.0 ECU_ADDRESS 0xD0009154 /end MEASUREMENT
/begin MEASUREMENT DFES_EnvBlock723 "vollständige Umweldaten alle Fehlerspeichereinträge" UBYTE DFES_OneToOne 1 100 0.00 255.0 ECU_ADDRESS 0xD0009155 /end MEASUREMENT
/begin MEASUREMENT DFES_EnvBlock724 "vollständige Umweldaten alle Fehlerspeichereinträge" UBYTE DFES_OneToOne 1 100 0.00 255.0 ECU_ADDRESS 0xD0009156 /end MEASUREMENT
/begin MEASUREMENT DFES_EnvBlock725 "vollständige Umweldaten alle Fehlerspeichereinträge" UBYTE DFES_OneToOne 1 100 0.00 255.0 ECU_ADDRESS 0xD0009157 /end MEASUREMENT
/begin MEASUREMENT DFES_EnvBlock726 "vollständige Umweldaten alle Fehlerspeichereinträge" UBYTE DFES_OneToOne 1 100 0.00 255.0 ECU_ADDRESS 0xD0009158 /end MEASUREMENT
/begin MEASUREMENT DFES_EnvBlock727 "vollständige Umweldaten alle Fehlerspeichereinträge" UBYTE DFES_OneToOne 1 100 0.00 255.0 ECU_ADDRESS 0xD0009159 /end MEASUREMENT
/begin MEASUREMENT DFES_EnvBlock728 "vollständige Umweldaten alle Fehlerspeichereinträge" UBYTE DFES_OneToOne 1 100 0.00 255.0 ECU_ADDRESS 0xD000915A /end MEASUREMENT
/begin MEASUREMENT DFES_EnvBlock729 "vollständige Umweldaten alle Fehlerspeichereinträge" UBYTE DFES_OneToOne 1 100 0.00 255.0 ECU_ADDRESS 0xD000915B /end MEASUREMENT
/begin MEASUREMENT DFES_EnvBlock730 "vollständige Umweldaten alle Fehlerspeichereinträge" UBYTE DFES_OneToOne 1 100 0.00 255.0 ECU_ADDRESS 0xD000915C /end MEASUREMENT
/begin MEASUREMENT DFES_EnvBlock731 "vollständige Umweldaten alle Fehlerspeichereinträge" UBYTE DFES_OneToOne 1 100 0.00 255.0 ECU_ADDRESS 0xD000915D /end MEASUREMENT
/begin MEASUREMENT DFES_EnvBlock732 "vollständige Umweldaten alle Fehlerspeichereinträge" UBYTE DFES_OneToOne 1 100 0.00 255.0 ECU_ADDRESS 0xD000915E /end MEASUREMENT
/begin MEASUREMENT DFES_EnvBlock733 "vollständige Umweldaten alle Fehlerspeichereinträge" UBYTE DFES_OneToOne 1 100 0.00 255.0 ECU_ADDRESS 0xD000915F /end MEASUREMENT
/begin MEASUREMENT DFES_EnvBlock734 "vollständige Umweldaten alle Fehlerspeichereinträge" UBYTE DFES_OneToOne 1 100 0.00 255.0 ECU_ADDRESS 0xD0009160 /end MEASUREMENT
/begin MEASUREMENT DFES_EnvBlock735 "vollständige Umweldaten alle Fehlerspeichereinträge" UBYTE DFES_OneToOne 1 100 0.00 255.0 ECU_ADDRESS 0xD0009161 /end MEASUREMENT
/begin MEASUREMENT DFES_EnvBlock736 "vollständige Umweldaten alle Fehlerspeichereinträge" UBYTE DFES_OneToOne 1 100 0.00 255.0 ECU_ADDRESS 0xD0009162 /end MEASUREMENT
/begin MEASUREMENT DFES_EnvBlock737 "vollständige Umweldaten alle Fehlerspeichereinträge" UBYTE DFES_OneToOne 1 100 0.00 255.0 ECU_ADDRESS 0xD0009163 /end MEASUREMENT
/begin MEASUREMENT DFES_EnvBlock738 "vollständige Umweldaten alle Fehlerspeichereinträge" UBYTE DFES_OneToOne 1 100 0.00 255.0 ECU_ADDRESS 0xD0009164 /end MEASUREMENT
/begin MEASUREMENT DFES_EnvBlock739 "vollständige Umweldaten alle Fehlerspeichereinträge" UBYTE DFES_OneToOne 1 100 0.00 255.0 ECU_ADDRESS 0xD0009165 /end MEASUREMENT
/begin MEASUREMENT DFES_EnvBlock740 "vollständige Umweldaten alle Fehlerspeichereinträge" UBYTE DFES_OneToOne 1 100 0.00 255.0 ECU_ADDRESS 0xD0009166 /end MEASUREMENT
/begin MEASUREMENT DFES_EnvBlock741 "vollständige Umweldaten alle Fehlerspeichereinträge" UBYTE DFES_OneToOne 1 100 0.00 255.0 ECU_ADDRESS 0xD0009167 /end MEASUREMENT
/begin MEASUREMENT DFES_EnvBlock742 "vollständige Umweldaten alle Fehlerspeichereinträge" UBYTE DFES_OneToOne 1 100 0.00 255.0 ECU_ADDRESS 0xD0009168 /end MEASUREMENT
/begin MEASUREMENT DFES_EnvBlock743 "vollständige Umweldaten alle Fehlerspeichereinträge" UBYTE DFES_OneToOne 1 100 0.00 255.0 ECU_ADDRESS 0xD0009169 /end MEASUREMENT
/begin MEASUREMENT DFES_EnvBlock744 "vollständige Umweldaten alle Fehlerspeichereinträge" UBYTE DFES_OneToOne 1 100 0.00 255.0 ECU_ADDRESS 0xD000916A /end MEASUREMENT
/begin MEASUREMENT DFES_EnvBlock745 "vollständige Umweldaten alle Fehlerspeichereinträge" UBYTE DFES_OneToOne 1 100 0.00 255.0 ECU_ADDRESS 0xD000916B /end MEASUREMENT
/begin MEASUREMENT DFES_EnvBlock746 "vollständige Umweldaten alle Fehlerspeichereinträge" UBYTE DFES_OneToOne 1 100 0.00 255.0 ECU_ADDRESS 0xD000916C /end MEASUREMENT
/begin MEASUREMENT DFES_EnvBlock747 "vollständige Umweldaten alle Fehlerspeichereinträge" UBYTE DFES_OneToOne 1 100 0.00 255.0 ECU_ADDRESS 0xD000916D /end MEASUREMENT
/begin MEASUREMENT DFES_EnvBlock748 "vollständige Umweldaten alle Fehlerspeichereinträge" UBYTE DFES_OneToOne 1 100 0.00 255.0 ECU_ADDRESS 0xD000916E /end MEASUREMENT
/begin MEASUREMENT DFES_EnvBlock749 "vollständige Umweldaten alle Fehlerspeichereinträge" UBYTE DFES_OneToOne 1 100 0.00 255.0 ECU_ADDRESS 0xD000916F /end MEASUREMENT
/begin MEASUREMENT DFES_EnvBlock750 "vollständige Umweldaten alle Fehlerspeichereinträge" UBYTE DFES_OneToOne 1 100 0.00 255.0 ECU_ADDRESS 0xD0009170 /end MEASUREMENT
/begin MEASUREMENT DFES_EnvBlock751 "vollständige Umweldaten alle Fehlerspeichereinträge" UBYTE DFES_OneToOne 1 100 0.00 255.0 ECU_ADDRESS 0xD0009171 /end MEASUREMENT
/begin MEASUREMENT DFES_EnvBlock752 "vollständige Umweldaten alle Fehlerspeichereinträge" UBYTE DFES_OneToOne 1 100 0.00 255.0 ECU_ADDRESS 0xD0009172 /end MEASUREMENT
/begin MEASUREMENT DFES_EnvBlock753 "vollständige Umweldaten alle Fehlerspeichereinträge" UBYTE DFES_OneToOne 1 100 0.00 255.0 ECU_ADDRESS 0xD0009173 /end MEASUREMENT
/begin MEASUREMENT DFES_EnvBlock754 "vollständige Umweldaten alle Fehlerspeichereinträge" UBYTE DFES_OneToOne 1 100 0.00 255.0 ECU_ADDRESS 0xD0009174 /end MEASUREMENT
/begin MEASUREMENT DFES_EnvBlock755 "vollständige Umweldaten alle Fehlerspeichereinträge" UBYTE DFES_OneToOne 1 100 0.00 255.0 ECU_ADDRESS 0xD0009175 /end MEASUREMENT
/begin MEASUREMENT DFES_EnvBlock756 "vollständige Umweldaten alle Fehlerspeichereinträge" UBYTE DFES_OneToOne 1 100 0.00 255.0 ECU_ADDRESS 0xD0009176 /end MEASUREMENT
/begin MEASUREMENT DFES_EnvBlock757 "vollständige Umweldaten alle Fehlerspeichereinträge" UBYTE DFES_OneToOne 1 100 0.00 255.0 ECU_ADDRESS 0xD0009177 /end MEASUREMENT
/begin MEASUREMENT DFES_EnvBlock758 "vollständige Umweldaten alle Fehlerspeichereinträge" UBYTE DFES_OneToOne 1 100 0.00 255.0 ECU_ADDRESS 0xD0009178 /end MEASUREMENT
/begin MEASUREMENT DFES_EnvBlock759 "vollständige Umweldaten alle Fehlerspeichereinträge" UBYTE DFES_OneToOne 1 100 0.00 255.0 ECU_ADDRESS 0xD0009179 /end MEASUREMENT
/begin MEASUREMENT DFES_EnvBlock760 "vollständige Umweldaten alle Fehlerspeichereinträge" UBYTE DFES_OneToOne 1 100 0.00 255.0 ECU_ADDRESS 0xD000917A /end MEASUREMENT
/begin MEASUREMENT DFES_EnvBlock761 "vollständige Umweldaten alle Fehlerspeichereinträge" UBYTE DFES_OneToOne 1 100 0.00 255.0 ECU_ADDRESS 0xD000917B /end MEASUREMENT
/begin MEASUREMENT DFES_EnvBlock762 "vollständige Umweldaten alle Fehlerspeichereinträge" UBYTE DFES_OneToOne 1 100 0.00 255.0 ECU_ADDRESS 0xD000917C /end MEASUREMENT
/begin MEASUREMENT DFES_EnvBlock763 "vollständige Umweldaten alle Fehlerspeichereinträge" UBYTE DFES_OneToOne 1 100 0.00 255.0 ECU_ADDRESS 0xD000917D /end MEASUREMENT
/begin MEASUREMENT DFES_EnvBlock764 "vollständige Umweldaten alle Fehlerspeichereinträge" UBYTE DFES_OneToOne 1 100 0.00 255.0 ECU_ADDRESS 0xD000917E /end MEASUREMENT
/begin MEASUREMENT DFES_EnvBlock765 "vollständige Umweldaten alle Fehlerspeichereinträge" UBYTE DFES_OneToOne 1 100 0.00 255.0 ECU_ADDRESS 0xD000917F /end MEASUREMENT
/begin MEASUREMENT DFES_EnvBlock766 "vollständige Umweldaten alle Fehlerspeichereinträge" UBYTE DFES_OneToOne 1 100 0.00 255.0 ECU_ADDRESS 0xD0009180 /end MEASUREMENT
/begin MEASUREMENT DFES_EnvBlock767 "vollständige Umweldaten alle Fehlerspeichereinträge" UBYTE DFES_OneToOne 1 100 0.00 255.0 ECU_ADDRESS 0xD0009181 /end MEASUREMENT
/begin MEASUREMENT DFES_EnvBlock768 "vollständige Umweldaten alle Fehlerspeichereinträge" UBYTE DFES_OneToOne 1 100 0.00 255.0 ECU_ADDRESS 0xD0009182 /end MEASUREMENT
/begin MEASUREMENT DFES_EnvBlock769 "vollständige Umweldaten alle Fehlerspeichereinträge" UBYTE DFES_OneToOne 1 100 0.00 255.0 ECU_ADDRESS 0xD0009183 /end MEASUREMENT
/begin MEASUREMENT DFES_EnvBlock770 "vollständige Umweldaten alle Fehlerspeichereinträge" UBYTE DFES_OneToOne 1 100 0.00 255.0 ECU_ADDRESS 0xD0009184 /end MEASUREMENT
/begin MEASUREMENT DFES_EnvBlock771 "vollständige Umweldaten alle Fehlerspeichereinträge" UBYTE DFES_OneToOne 1 100 0.00 255.0 ECU_ADDRESS 0xD0009185 /end MEASUREMENT
/begin MEASUREMENT DFES_EnvBlock772 "vollständige Umweldaten alle Fehlerspeichereinträge" UBYTE DFES_OneToOne 1 100 0.00 255.0 ECU_ADDRESS 0xD0009186 /end MEASUREMENT
/begin MEASUREMENT DFES_EnvBlock773 "vollständige Umweldaten alle Fehlerspeichereinträge" UBYTE DFES_OneToOne 1 100 0.00 255.0 ECU_ADDRESS 0xD0009187 /end MEASUREMENT
/begin MEASUREMENT DFES_EnvBlock774 "vollständige Umweldaten alle Fehlerspeichereinträge" UBYTE DFES_OneToOne 1 100 0.00 255.0 ECU_ADDRESS 0xD0009188 /end MEASUREMENT
/begin MEASUREMENT DFES_EnvBlock775 "vollständige Umweldaten alle Fehlerspeichereinträge" UBYTE DFES_OneToOne 1 100 0.00 255.0 ECU_ADDRESS 0xD0009189 /end MEASUREMENT
/begin MEASUREMENT DFES_EnvBlock776 "vollständige Umweldaten alle Fehlerspeichereinträge" UBYTE DFES_OneToOne 1 100 0.00 255.0 ECU_ADDRESS 0xD000918A /end MEASUREMENT
/begin MEASUREMENT DFES_EnvBlock777 "vollständige Umweldaten alle Fehlerspeichereinträge" UBYTE DFES_OneToOne 1 100 0.00 255.0 ECU_ADDRESS 0xD000918B /end MEASUREMENT
/begin MEASUREMENT DFES_EnvBlock778 "vollständige Umweldaten alle Fehlerspeichereinträge" UBYTE DFES_OneToOne 1 100 0.00 255.0 ECU_ADDRESS 0xD000918C /end MEASUREMENT
/begin MEASUREMENT DFES_EnvBlock779 "vollständige Umweldaten alle Fehlerspeichereinträge" UBYTE DFES_OneToOne 1 100 0.00 255.0 ECU_ADDRESS 0xD000918D /end MEASUREMENT
/begin MEASUREMENT DFES_EnvBlock780 "vollständige Umweldaten alle Fehlerspeichereinträge" UBYTE DFES_OneToOne 1 100 0.00 255.0 ECU_ADDRESS 0xD000918E /end MEASUREMENT
/begin MEASUREMENT DFES_EnvBlock781 "vollständige Umweldaten alle Fehlerspeichereinträge" UBYTE DFES_OneToOne 1 100 0.00 255.0 ECU_ADDRESS 0xD000918F /end MEASUREMENT
/begin MEASUREMENT DFES_EnvBlock782 "vollständige Umweldaten alle Fehlerspeichereinträge" UBYTE DFES_OneToOne 1 100 0.00 255.0 ECU_ADDRESS 0xD0009190 /end MEASUREMENT
/begin MEASUREMENT DFES_EnvBlock783 "vollständige Umweldaten alle Fehlerspeichereinträge" UBYTE DFES_OneToOne 1 100 0.00 255.0 ECU_ADDRESS 0xD0009191 /end MEASUREMENT
/begin MEASUREMENT DFES_EnvBlock784 "vollständige Umweldaten alle Fehlerspeichereinträge" UBYTE DFES_OneToOne 1 100 0.00 255.0 ECU_ADDRESS 0xD0009192 /end MEASUREMENT
/begin MEASUREMENT DFES_EnvBlock785 "vollständige Umweldaten alle Fehlerspeichereinträge" UBYTE DFES_OneToOne 1 100 0.00 255.0 ECU_ADDRESS 0xD0009193 /end MEASUREMENT
/begin MEASUREMENT DFES_EnvBlock786 "vollständige Umweldaten alle Fehlerspeichereinträge" UBYTE DFES_OneToOne 1 100 0.00 255.0 ECU_ADDRESS 0xD0009194 /end MEASUREMENT
/begin MEASUREMENT DFES_EnvBlock787 "vollständige Umweldaten alle Fehlerspeichereinträge" UBYTE DFES_OneToOne 1 100 0.00 255.0 ECU_ADDRESS 0xD0009195 /end MEASUREMENT
/begin MEASUREMENT DFES_EnvBlock788 "vollständige Umweldaten alle Fehlerspeichereinträge" UBYTE DFES_OneToOne 1 100 0.00 255.0 ECU_ADDRESS 0xD0009196 /end MEASUREMENT
/begin MEASUREMENT DFES_EnvBlock789 "vollständige Umweldaten alle Fehlerspeichereinträge" UBYTE DFES_OneToOne 1 100 0.00 255.0 ECU_ADDRESS 0xD0009197 /end MEASUREMENT
/begin MEASUREMENT DFES_EnvBlock790 "vollständige Umweldaten alle Fehlerspeichereinträge" UBYTE DFES_OneToOne 1 100 0.00 255.0 ECU_ADDRESS 0xD0009198 /end MEASUREMENT
/begin MEASUREMENT DFES_EnvBlock791 "vollständige Umweldaten alle Fehlerspeichereinträge" UBYTE DFES_OneToOne 1 100 0.00 255.0 ECU_ADDRESS 0xD0009199 /end MEASUREMENT
/begin MEASUREMENT DFES_EnvBlock792 "vollständige Umweldaten alle Fehlerspeichereinträge" UBYTE DFES_OneToOne 1 100 0.00 255.0 ECU_ADDRESS 0xD000919A /end MEASUREMENT
/begin MEASUREMENT DFES_EnvBlock793 "vollständige Umweldaten alle Fehlerspeichereinträge" UBYTE DFES_OneToOne 1 100 0.00 255.0 ECU_ADDRESS 0xD000919B /end MEASUREMENT
/begin MEASUREMENT DFES_EnvBlock794 "vollständige Umweldaten alle Fehlerspeichereinträge" UBYTE DFES_OneToOne 1 100 0.00 255.0 ECU_ADDRESS 0xD000919C /end MEASUREMENT
/begin MEASUREMENT DFES_EnvBlock795 "vollständige Umweldaten alle Fehlerspeichereinträge" UBYTE DFES_OneToOne 1 100 0.00 255.0 ECU_ADDRESS 0xD000919D /end MEASUREMENT
/begin MEASUREMENT DFES_EnvBlock796 "vollständige Umweldaten alle Fehlerspeichereinträge" UBYTE DFES_OneToOne 1 100 0.00 255.0 ECU_ADDRESS 0xD000919E /end MEASUREMENT
/begin MEASUREMENT DFES_EnvBlock797 "vollständige Umweldaten alle Fehlerspeichereinträge" UBYTE DFES_OneToOne 1 100 0.00 255.0 ECU_ADDRESS 0xD000919F /end MEASUREMENT
/begin MEASUREMENT DFES_EnvBlock798 "vollständige Umweldaten alle Fehlerspeichereinträge" UBYTE DFES_OneToOne 1 100 0.00 255.0 ECU_ADDRESS 0xD00091A0 /end MEASUREMENT
/begin MEASUREMENT DFES_EnvBlock799 "vollständige Umweldaten alle Fehlerspeichereinträge" UBYTE DFES_OneToOne 1 100 0.00 255.0 ECU_ADDRESS 0xD00091A1 /end MEASUREMENT
/begin MEASUREMENT DFES_EnvBlock800 "vollständige Umweldaten alle Fehlerspeichereinträge" UBYTE DFES_OneToOne 1 100 0.00 255.0 ECU_ADDRESS 0xD00091A2 /end MEASUREMENT
/begin MEASUREMENT DFES_EnvBlock801 "vollständige Umweldaten alle Fehlerspeichereinträge" UBYTE DFES_OneToOne 1 100 0.00 255.0 ECU_ADDRESS 0xD00091A3 /end MEASUREMENT
/begin MEASUREMENT DFES_EnvBlock802 "vollständige Umweldaten alle Fehlerspeichereinträge" UBYTE DFES_OneToOne 1 100 0.00 255.0 ECU_ADDRESS 0xD00091A4 /end MEASUREMENT
/begin MEASUREMENT DFES_EnvBlock803 "vollständige Umweldaten alle Fehlerspeichereinträge" UBYTE DFES_OneToOne 1 100 0.00 255.0 ECU_ADDRESS 0xD00091A5 /end MEASUREMENT
/begin MEASUREMENT DFES_EnvBlock804 "vollständige Umweldaten alle Fehlerspeichereinträge" UBYTE DFES_OneToOne 1 100 0.00 255.0 ECU_ADDRESS 0xD00091A6 /end MEASUREMENT
/begin MEASUREMENT DFES_EnvBlock805 "vollständige Umweldaten alle Fehlerspeichereinträge" UBYTE DFES_OneToOne 1 100 0.00 255.0 ECU_ADDRESS 0xD00091A7 /end MEASUREMENT
/begin MEASUREMENT DFES_EnvBlock806 "vollständige Umweldaten alle Fehlerspeichereinträge" UBYTE DFES_OneToOne 1 100 0.00 255.0 ECU_ADDRESS 0xD00091A8 /end MEASUREMENT
/begin MEASUREMENT DFES_EnvBlock807 "vollständige Umweldaten alle Fehlerspeichereinträge" UBYTE DFES_OneToOne 1 100 0.00 255.0 ECU_ADDRESS 0xD00091A9 /end MEASUREMENT
/begin MEASUREMENT DFES_EnvBlock808 "vollständige Umweldaten alle Fehlerspeichereinträge" UBYTE DFES_OneToOne 1 100 0.00 255.0 ECU_ADDRESS 0xD00091AA /end MEASUREMENT
/begin MEASUREMENT DFES_EnvBlock809 "vollständige Umweldaten alle Fehlerspeichereinträge" UBYTE DFES_OneToOne 1 100 0.00 255.0 ECU_ADDRESS 0xD00091AB /end MEASUREMENT
/begin MEASUREMENT DFES_EnvBlock810 "vollständige Umweldaten alle Fehlerspeichereinträge" UBYTE DFES_OneToOne 1 100 0.00 255.0 ECU_ADDRESS 0xD00091AC /end MEASUREMENT
/begin MEASUREMENT DFES_EnvBlock811 "vollständige Umweldaten alle Fehlerspeichereinträge" UBYTE DFES_OneToOne 1 100 0.00 255.0 ECU_ADDRESS 0xD00091AD /end MEASUREMENT
/begin MEASUREMENT DFES_EnvBlock812 "vollständige Umweldaten alle Fehlerspeichereinträge" UBYTE DFES_OneToOne 1 100 0.00 255.0 ECU_ADDRESS 0xD00091AE /end MEASUREMENT
/begin MEASUREMENT DFES_EnvBlock813 "vollständige Umweldaten alle Fehlerspeichereinträge" UBYTE DFES_OneToOne 1 100 0.00 255.0 ECU_ADDRESS 0xD00091AF /end MEASUREMENT
/begin MEASUREMENT DFES_EnvBlock814 "vollständige Umweldaten alle Fehlerspeichereinträge" UBYTE DFES_OneToOne 1 100 0.00 255.0 ECU_ADDRESS 0xD00091B0 /end MEASUREMENT
/begin MEASUREMENT DFES_EnvBlock815 "vollständige Umweldaten alle Fehlerspeichereinträge" UBYTE DFES_OneToOne 1 100 0.00 255.0 ECU_ADDRESS 0xD00091B1 /end MEASUREMENT
/begin MEASUREMENT DFES_EnvBlock816 "vollständige Umweldaten alle Fehlerspeichereinträge" UBYTE DFES_OneToOne 1 100 0.00 255.0 ECU_ADDRESS 0xD00091B2 /end MEASUREMENT
/begin MEASUREMENT DFES_EnvBlock817 "vollständige Umweldaten alle Fehlerspeichereinträge" UBYTE DFES_OneToOne 1 100 0.00 255.0 ECU_ADDRESS 0xD00091B3 /end MEASUREMENT
/begin MEASUREMENT DFES_EnvBlock818 "vollständige Umweldaten alle Fehlerspeichereinträge" UBYTE DFES_OneToOne 1 100 0.00 255.0 ECU_ADDRESS 0xD00091B4 /end MEASUREMENT
/begin MEASUREMENT DFES_EnvBlock819 "vollständige Umweldaten alle Fehlerspeichereinträge" UBYTE DFES_OneToOne 1 100 0.00 255.0 ECU_ADDRESS 0xD00091B5 /end MEASUREMENT
/begin MEASUREMENT DFES_EnvBlock820 "vollständige Umweldaten alle Fehlerspeichereinträge" UBYTE DFES_OneToOne 1 100 0.00 255.0 ECU_ADDRESS 0xD00091B6 /end MEASUREMENT
/begin MEASUREMENT DFES_EnvBlock821 "vollständige Umweldaten alle Fehlerspeichereinträge" UBYTE DFES_OneToOne 1 100 0.00 255.0 ECU_ADDRESS 0xD00091B7 /end MEASUREMENT
/begin MEASUREMENT DFES_EnvBlock822 "vollständige Umweldaten alle Fehlerspeichereinträge" UBYTE DFES_OneToOne 1 100 0.00 255.0 ECU_ADDRESS 0xD00091B8 /end MEASUREMENT
/begin MEASUREMENT DFES_EnvBlock823 "vollständige Umweldaten alle Fehlerspeichereinträge" UBYTE DFES_OneToOne 1 100 0.00 255.0 ECU_ADDRESS 0xD00091B9 /end MEASUREMENT
/begin MEASUREMENT DFES_EnvBlock824 "vollständige Umweldaten alle Fehlerspeichereinträge" UBYTE DFES_OneToOne 1 100 0.00 255.0 ECU_ADDRESS 0xD00091BA /end MEASUREMENT
/begin MEASUREMENT DFES_EnvBlock825 "vollständige Umweldaten alle Fehlerspeichereinträge" UBYTE DFES_OneToOne 1 100 0.00 255.0 ECU_ADDRESS 0xD00091BB /end MEASUREMENT
/begin MEASUREMENT DFES_EnvBlock826 "vollständige Umweldaten alle Fehlerspeichereinträge" UBYTE DFES_OneToOne 1 100 0.00 255.0 ECU_ADDRESS 0xD00091BC /end MEASUREMENT
/begin MEASUREMENT DFES_EnvBlock827 "vollständige Umweldaten alle Fehlerspeichereinträge" UBYTE DFES_OneToOne 1 100 0.00 255.0 ECU_ADDRESS 0xD00091BD /end MEASUREMENT
/begin MEASUREMENT DFES_EnvBlock828 "vollständige Umweldaten alle Fehlerspeichereinträge" UBYTE DFES_OneToOne 1 100 0.00 255.0 ECU_ADDRESS 0xD00091BE /end MEASUREMENT
/begin MEASUREMENT DFES_EnvBlock829 "vollständige Umweldaten alle Fehlerspeichereinträge" UBYTE DFES_OneToOne 1 100 0.00 255.0 ECU_ADDRESS 0xD00091BF /end MEASUREMENT
/begin MEASUREMENT DFES_EnvBlock830 "vollständige Umweldaten alle Fehlerspeichereinträge" UBYTE DFES_OneToOne 1 100 0.00 255.0 ECU_ADDRESS 0xD00091C0 /end MEASUREMENT
/begin MEASUREMENT DFES_EnvBlock831 "vollständige Umweldaten alle Fehlerspeichereinträge" UBYTE DFES_OneToOne 1 100 0.00 255.0 ECU_ADDRESS 0xD00091C1 /end MEASUREMENT
/begin MEASUREMENT DFES_EnvBlock832 "vollständige Umweldaten alle Fehlerspeichereinträge" UBYTE DFES_OneToOne 1 100 0.00 255.0 ECU_ADDRESS 0xD00091C2 /end MEASUREMENT
/begin MEASUREMENT DFES_EnvBlock833 "vollständige Umweldaten alle Fehlerspeichereinträge" UBYTE DFES_OneToOne 1 100 0.00 255.0 ECU_ADDRESS 0xD00091C3 /end MEASUREMENT
/begin MEASUREMENT DFES_EnvBlock834 "vollständige Umweldaten alle Fehlerspeichereinträge" UBYTE DFES_OneToOne 1 100 0.00 255.0 ECU_ADDRESS 0xD00091C4 /end MEASUREMENT
/begin MEASUREMENT DFES_EnvBlock835 "vollständige Umweldaten alle Fehlerspeichereinträge" UBYTE DFES_OneToOne 1 100 0.00 255.0 ECU_ADDRESS 0xD00091C5 /end MEASUREMENT
/begin MEASUREMENT DFES_EnvBlock836 "vollständige Umweldaten alle Fehlerspeichereinträge" UBYTE DFES_OneToOne 1 100 0.00 255.0 ECU_ADDRESS 0xD00091C6 /end MEASUREMENT
/begin MEASUREMENT DFES_EnvBlock837 "vollständige Umweldaten alle Fehlerspeichereinträge" UBYTE DFES_OneToOne 1 100 0.00 255.0 ECU_ADDRESS 0xD00091C7 /end MEASUREMENT
/begin MEASUREMENT DFES_EnvBlock838 "vollständige Umweldaten alle Fehlerspeichereinträge" UBYTE DFES_OneToOne 1 100 0.00 255.0 ECU_ADDRESS 0xD00091C8 /end MEASUREMENT
/begin MEASUREMENT DFES_EnvBlock839 "vollständige Umweldaten alle Fehlerspeichereinträge" UBYTE DFES_OneToOne 1 100 0.00 255.0 ECU_ADDRESS 0xD00091C9 /end MEASUREMENT
/begin MEASUREMENT DFES_EnvBlock840 "vollständige Umweldaten alle Fehlerspeichereinträge" UBYTE DFES_OneToOne 1 100 0.00 255.0 ECU_ADDRESS 0xD00091CA /end MEASUREMENT
/begin MEASUREMENT DFES_EnvBlock841 "vollständige Umweldaten alle Fehlerspeichereinträge" UBYTE DFES_OneToOne 1 100 0.00 255.0 ECU_ADDRESS 0xD00091CB /end MEASUREMENT
/begin MEASUREMENT DFES_EnvBlock842 "vollständige Umweldaten alle Fehlerspeichereinträge" UBYTE DFES_OneToOne 1 100 0.00 255.0 ECU_ADDRESS 0xD00091CC /end MEASUREMENT
/begin MEASUREMENT DFES_EnvBlock843 "vollständige Umweldaten alle Fehlerspeichereinträge" UBYTE DFES_OneToOne 1 100 0.00 255.0 ECU_ADDRESS 0xD00091CD /end MEASUREMENT
/begin MEASUREMENT DFES_EnvBlock844 "vollständige Umweldaten alle Fehlerspeichereinträge" UBYTE DFES_OneToOne 1 100 0.00 255.0 ECU_ADDRESS 0xD00091CE /end MEASUREMENT
/begin MEASUREMENT DFES_EnvBlock845 "vollständige Umweldaten alle Fehlerspeichereinträge" UBYTE DFES_OneToOne 1 100 0.00 255.0 ECU_ADDRESS 0xD00091CF /end MEASUREMENT
/begin MEASUREMENT DFES_EnvBlock846 "vollständige Umweldaten alle Fehlerspeichereinträge" UBYTE DFES_OneToOne 1 100 0.00 255.0 ECU_ADDRESS 0xD00091D0 /end MEASUREMENT
/begin MEASUREMENT DFES_EnvBlock847 "vollständige Umweldaten alle Fehlerspeichereinträge" UBYTE DFES_OneToOne 1 100 0.00 255.0 ECU_ADDRESS 0xD00091D1 /end MEASUREMENT
/begin MEASUREMENT DFES_EnvBlock848 "vollständige Umweldaten alle Fehlerspeichereinträge" UBYTE DFES_OneToOne 1 100 0.00 255.0 ECU_ADDRESS 0xD00091D2 /end MEASUREMENT
/begin MEASUREMENT DFES_EnvBlock849 "vollständige Umweldaten alle Fehlerspeichereinträge" UBYTE DFES_OneToOne 1 100 0.00 255.0 ECU_ADDRESS 0xD00091D3 /end MEASUREMENT
/begin MEASUREMENT DFES_EnvBlock850 "vollständige Umweldaten alle Fehlerspeichereinträge" UBYTE DFES_OneToOne 1 100 0.00 255.0 ECU_ADDRESS 0xD00091D4 /end MEASUREMENT
/begin MEASUREMENT DFES_EnvBlock851 "vollständige Umweldaten alle Fehlerspeichereinträge" UBYTE DFES_OneToOne 1 100 0.00 255.0 ECU_ADDRESS 0xD00091D5 /end MEASUREMENT
/begin MEASUREMENT DFES_EnvBlock852 "vollständige Umweldaten alle Fehlerspeichereinträge" UBYTE DFES_OneToOne 1 100 0.00 255.0 ECU_ADDRESS 0xD00091D6 /end MEASUREMENT
/begin MEASUREMENT DFES_EnvBlock853 "vollständige Umweldaten alle Fehlerspeichereinträge" UBYTE DFES_OneToOne 1 100 0.00 255.0 ECU_ADDRESS 0xD00091D7 /end MEASUREMENT
/begin MEASUREMENT DFES_EnvBlock854 "vollständige Umweldaten alle Fehlerspeichereinträge" UBYTE DFES_OneToOne 1 100 0.00 255.0 ECU_ADDRESS 0xD00091D8 /end MEASUREMENT
/begin MEASUREMENT DFES_EnvBlock855 "vollständige Umweldaten alle Fehlerspeichereinträge" UBYTE DFES_OneToOne 1 100 0.00 255.0 ECU_ADDRESS 0xD00091D9 /end MEASUREMENT
/begin MEASUREMENT DFES_EnvBlock856 "vollständige Umweldaten alle Fehlerspeichereinträge" UBYTE DFES_OneToOne 1 100 0.00 255.0 ECU_ADDRESS 0xD00091DA /end MEASUREMENT
/begin MEASUREMENT DFES_EnvBlock857 "vollständige Umweldaten alle Fehlerspeichereinträge" UBYTE DFES_OneToOne 1 100 0.00 255.0 ECU_ADDRESS 0xD00091DB /end MEASUREMENT
/begin MEASUREMENT DFES_EnvBlock858 "vollständige Umweldaten alle Fehlerspeichereinträge" UBYTE DFES_OneToOne 1 100 0.00 255.0 ECU_ADDRESS 0xD00091DC /end MEASUREMENT
/begin MEASUREMENT DFES_EnvBlock859 "vollständige Umweldaten alle Fehlerspeichereinträge" UBYTE DFES_OneToOne 1 100 0.00 255.0 ECU_ADDRESS 0xD00091DD /end MEASUREMENT
/begin MEASUREMENT DFES_EnvBlock860 "vollständige Umweldaten alle Fehlerspeichereinträge" UBYTE DFES_OneToOne 1 100 0.00 255.0 ECU_ADDRESS 0xD00091DE /end MEASUREMENT
/begin MEASUREMENT DFES_EnvBlock861 "vollständige Umweldaten alle Fehlerspeichereinträge" UBYTE DFES_OneToOne 1 100 0.00 255.0 ECU_ADDRESS 0xD00091DF /end MEASUREMENT
/begin MEASUREMENT DFES_EnvBlock862 "vollständige Umweldaten alle Fehlerspeichereinträge" UBYTE DFES_OneToOne 1 100 0.00 255.0 ECU_ADDRESS 0xD00091E0 /end MEASUREMENT
/begin MEASUREMENT DFES_EnvBlock863 "vollständige Umweldaten alle Fehlerspeichereinträge" UBYTE DFES_OneToOne 1 100 0.00 255.0 ECU_ADDRESS 0xD00091E1 /end MEASUREMENT
/begin MEASUREMENT DFES_EnvBlock864 "vollständige Umweldaten alle Fehlerspeichereinträge" UBYTE DFES_OneToOne 1 100 0.00 255.0 ECU_ADDRESS 0xD00091E2 /end MEASUREMENT
/begin MEASUREMENT DFES_EnvBlock865 "vollständige Umweldaten alle Fehlerspeichereinträge" UBYTE DFES_OneToOne 1 100 0.00 255.0 ECU_ADDRESS 0xD00091E3 /end MEASUREMENT
/begin MEASUREMENT DFES_EnvBlock866 "vollständige Umweldaten alle Fehlerspeichereinträge" UBYTE DFES_OneToOne 1 100 0.00 255.0 ECU_ADDRESS 0xD00091E4 /end MEASUREMENT
/begin MEASUREMENT DFES_EnvBlock867 "vollständige Umweldaten alle Fehlerspeichereinträge" UBYTE DFES_OneToOne 1 100 0.00 255.0 ECU_ADDRESS 0xD00091E5 /end MEASUREMENT
/begin MEASUREMENT DFES_EnvBlock868 "vollständige Umweldaten alle Fehlerspeichereinträge" UBYTE DFES_OneToOne 1 100 0.00 255.0 ECU_ADDRESS 0xD00091E6 /end MEASUREMENT
/begin MEASUREMENT DFES_EnvBlock869 "vollständige Umweldaten alle Fehlerspeichereinträge" UBYTE DFES_OneToOne 1 100 0.00 255.0 ECU_ADDRESS 0xD00091E7 /end MEASUREMENT
/begin MEASUREMENT DFES_EnvBlock870 "vollständige Umweldaten alle Fehlerspeichereinträge" UBYTE DFES_OneToOne 1 100 0.00 255.0 ECU_ADDRESS 0xD00091E8 /end MEASUREMENT
/begin MEASUREMENT DFES_EnvBlock871 "vollständige Umweldaten alle Fehlerspeichereinträge" UBYTE DFES_OneToOne 1 100 0.00 255.0 ECU_ADDRESS 0xD00091E9 /end MEASUREMENT
/begin MEASUREMENT DFES_EnvBlock872 "vollständige Umweldaten alle Fehlerspeichereinträge" UBYTE DFES_OneToOne 1 100 0.00 255.0 ECU_ADDRESS 0xD00091EA /end MEASUREMENT
/begin MEASUREMENT DFES_EnvBlock873 "vollständige Umweldaten alle Fehlerspeichereinträge" UBYTE DFES_OneToOne 1 100 0.00 255.0 ECU_ADDRESS 0xD00091EB /end MEASUREMENT
/begin MEASUREMENT DFES_EnvBlock874 "vollständige Umweldaten alle Fehlerspeichereinträge" UBYTE DFES_OneToOne 1 100 0.00 255.0 ECU_ADDRESS 0xD00091EC /end MEASUREMENT
/begin MEASUREMENT DFES_EnvBlock875 "vollständige Umweldaten alle Fehlerspeichereinträge" UBYTE DFES_OneToOne 1 100 0.00 255.0 ECU_ADDRESS 0xD00091ED /end MEASUREMENT
/begin MEASUREMENT DFES_EnvBlock876 "vollständige Umweldaten alle Fehlerspeichereinträge" UBYTE DFES_OneToOne 1 100 0.00 255.0 ECU_ADDRESS 0xD00091EE /end MEASUREMENT
/begin MEASUREMENT DFES_EnvBlock877 "vollständige Umweldaten alle Fehlerspeichereinträge" UBYTE DFES_OneToOne 1 100 0.00 255.0 ECU_ADDRESS 0xD00091EF /end MEASUREMENT
/begin MEASUREMENT DFES_EnvBlock878 "vollständige Umweldaten alle Fehlerspeichereinträge" UBYTE DFES_OneToOne 1 100 0.00 255.0 ECU_ADDRESS 0xD00091F0 /end MEASUREMENT
/begin MEASUREMENT DFES_EnvBlock879 "vollständige Umweldaten alle Fehlerspeichereinträge" UBYTE DFES_OneToOne 1 100 0.00 255.0 ECU_ADDRESS 0xD00091F1 /end MEASUREMENT
/begin MEASUREMENT DFES_EnvBlock880 "vollständige Umweldaten alle Fehlerspeichereinträge" UBYTE DFES_OneToOne 1 100 0.00 255.0 ECU_ADDRESS 0xD00091F2 /end MEASUREMENT
/begin MEASUREMENT DFES_EnvBlock881 "vollständige Umweldaten alle Fehlerspeichereinträge" UBYTE DFES_OneToOne 1 100 0.00 255.0 ECU_ADDRESS 0xD00091F3 /end MEASUREMENT
/begin MEASUREMENT DFES_EnvBlock882 "vollständige Umweldaten alle Fehlerspeichereinträge" UBYTE DFES_OneToOne 1 100 0.00 255.0 ECU_ADDRESS 0xD00091F4 /end MEASUREMENT
/begin MEASUREMENT DFES_EnvBlock883 "vollständige Umweldaten alle Fehlerspeichereinträge" UBYTE DFES_OneToOne 1 100 0.00 255.0 ECU_ADDRESS 0xD00091F5 /end MEASUREMENT
/begin MEASUREMENT DFES_EnvBlock884 "vollständige Umweldaten alle Fehlerspeichereinträge" UBYTE DFES_OneToOne 1 100 0.00 255.0 ECU_ADDRESS 0xD00091F6 /end MEASUREMENT
/begin MEASUREMENT DFES_EnvBlock885 "vollständige Umweldaten alle Fehlerspeichereinträge" UBYTE DFES_OneToOne 1 100 0.00 255.0 ECU_ADDRESS 0xD00091F7 /end MEASUREMENT
/begin MEASUREMENT DFES_EnvBlock886 "vollständige Umweldaten alle Fehlerspeichereinträge" UBYTE DFES_OneToOne 1 100 0.00 255.0 ECU_ADDRESS 0xD00091F8 /end MEASUREMENT
/begin MEASUREMENT DFES_EnvBlock887 "vollständige Umweldaten alle Fehlerspeichereinträge" UBYTE DFES_OneToOne 1 100 0.00 255.0 ECU_ADDRESS 0xD00091F9 /end MEASUREMENT
/begin MEASUREMENT DFES_EnvBlock888 "vollständige Umweldaten alle Fehlerspeichereinträge" UBYTE DFES_OneToOne 1 100 0.00 255.0 ECU_ADDRESS 0xD00091FA /end MEASUREMENT
/begin MEASUREMENT DFES_EnvBlock889 "vollständige Umweldaten alle Fehlerspeichereinträge" UBYTE DFES_OneToOne 1 100 0.00 255.0 ECU_ADDRESS 0xD00091FB /end MEASUREMENT
/begin MEASUREMENT DFES_EnvBlock890 "vollständige Umweldaten alle Fehlerspeichereinträge" UBYTE DFES_OneToOne 1 100 0.00 255.0 ECU_ADDRESS 0xD00091FC /end MEASUREMENT
/begin MEASUREMENT DFES_EnvBlock891 "vollständige Umweldaten alle Fehlerspeichereinträge" UBYTE DFES_OneToOne 1 100 0.00 255.0 ECU_ADDRESS 0xD00091FD /end MEASUREMENT
/begin MEASUREMENT DFES_EnvBlock892 "vollständige Umweldaten alle Fehlerspeichereinträge" UBYTE DFES_OneToOne 1 100 0.00 255.0 ECU_ADDRESS 0xD00091FE /end MEASUREMENT
/begin MEASUREMENT DFES_EnvBlock893 "vollständige Umweldaten alle Fehlerspeichereinträge" UBYTE DFES_OneToOne 1 100 0.00 255.0 ECU_ADDRESS 0xD00091FF /end MEASUREMENT
/begin MEASUREMENT DFES_EnvBlock894 "vollständige Umweldaten alle Fehlerspeichereinträge" UBYTE DFES_OneToOne 1 100 0.00 255.0 ECU_ADDRESS 0xD0009200 /end MEASUREMENT
/begin MEASUREMENT DFES_EnvBlock895 "vollständige Umweldaten alle Fehlerspeichereinträge" UBYTE DFES_OneToOne 1 100 0.00 255.0 ECU_ADDRESS 0xD0009201 /end MEASUREMENT
/begin MEASUREMENT DFES_EnvBlock896 "vollständige Umweldaten alle Fehlerspeichereinträge" UBYTE DFES_OneToOne 1 100 0.00 255.0 ECU_ADDRESS 0xD0009202 /end MEASUREMENT
/begin MEASUREMENT DFES_EnvBlock897 "vollständige Umweldaten alle Fehlerspeichereinträge" UBYTE DFES_OneToOne 1 100 0.00 255.0 ECU_ADDRESS 0xD0009203 /end MEASUREMENT
/begin MEASUREMENT DFES_EnvBlock898 "vollständige Umweldaten alle Fehlerspeichereinträge" UBYTE DFES_OneToOne 1 100 0.00 255.0 ECU_ADDRESS 0xD0009204 /end MEASUREMENT
/begin MEASUREMENT DFES_EnvBlock899 "vollständige Umweldaten alle Fehlerspeichereinträge" UBYTE DFES_OneToOne 1 100 0.00 255.0 ECU_ADDRESS 0xD0009205 /end MEASUREMENT
/begin MEASUREMENT DFES_EnvBlock900 "vollständige Umweldaten alle Fehlerspeichereinträge" UBYTE DFES_OneToOne 1 100 0.00 255.0 ECU_ADDRESS 0xD0009206 /end MEASUREMENT
/begin MEASUREMENT DFES_EnvBlock901 "vollständige Umweldaten alle Fehlerspeichereinträge" UBYTE DFES_OneToOne 1 100 0.00 255.0 ECU_ADDRESS 0xD0009207 /end MEASUREMENT
/begin MEASUREMENT DFES_EnvBlock902 "vollständige Umweldaten alle Fehlerspeichereinträge" UBYTE DFES_OneToOne 1 100 0.00 255.0 ECU_ADDRESS 0xD0009208 /end MEASUREMENT
/begin MEASUREMENT DFES_EnvBlock903 "vollständige Umweldaten alle Fehlerspeichereinträge" UBYTE DFES_OneToOne 1 100 0.00 255.0 ECU_ADDRESS 0xD0009209 /end MEASUREMENT
/begin MEASUREMENT DFES_EnvBlock904 "vollständige Umweldaten alle Fehlerspeichereinträge" UBYTE DFES_OneToOne 1 100 0.00 255.0 ECU_ADDRESS 0xD000920A /end MEASUREMENT
/begin MEASUREMENT DFES_EnvBlock905 "vollständige Umweldaten alle Fehlerspeichereinträge" UBYTE DFES_OneToOne 1 100 0.00 255.0 ECU_ADDRESS 0xD000920B /end MEASUREMENT
/begin MEASUREMENT DFES_EnvBlock906 "vollständige Umweldaten alle Fehlerspeichereinträge" UBYTE DFES_OneToOne 1 100 0.00 255.0 ECU_ADDRESS 0xD000920C /end MEASUREMENT
/begin MEASUREMENT DFES_EnvBlock907 "vollständige Umweldaten alle Fehlerspeichereinträge" UBYTE DFES_OneToOne 1 100 0.00 255.0 ECU_ADDRESS 0xD000920D /end MEASUREMENT
/begin MEASUREMENT DFES_EnvBlock908 "vollständige Umweldaten alle Fehlerspeichereinträge" UBYTE DFES_OneToOne 1 100 0.00 255.0 ECU_ADDRESS 0xD000920E /end MEASUREMENT
/begin MEASUREMENT DFES_EnvBlock909 "vollständige Umweldaten alle Fehlerspeichereinträge" UBYTE DFES_OneToOne 1 100 0.00 255.0 ECU_ADDRESS 0xD000920F /end MEASUREMENT
/begin MEASUREMENT DFES_EnvBlock910 "vollständige Umweldaten alle Fehlerspeichereinträge" UBYTE DFES_OneToOne 1 100 0.00 255.0 ECU_ADDRESS 0xD0009210 /end MEASUREMENT
/begin MEASUREMENT DFES_EnvBlock911 "vollständige Umweldaten alle Fehlerspeichereinträge" UBYTE DFES_OneToOne 1 100 0.00 255.0 ECU_ADDRESS 0xD0009211 /end MEASUREMENT
/begin MEASUREMENT DFES_EnvBlock912 "vollständige Umweldaten alle Fehlerspeichereinträge" UBYTE DFES_OneToOne 1 100 0.00 255.0 ECU_ADDRESS 0xD0009212 /end MEASUREMENT
/begin MEASUREMENT DFES_EnvBlock913 "vollständige Umweldaten alle Fehlerspeichereinträge" UBYTE DFES_OneToOne 1 100 0.00 255.0 ECU_ADDRESS 0xD0009213 /end MEASUREMENT
/begin MEASUREMENT DFES_EnvBlock914 "vollständige Umweldaten alle Fehlerspeichereinträge" UBYTE DFES_OneToOne 1 100 0.00 255.0 ECU_ADDRESS 0xD0009214 /end MEASUREMENT
/begin MEASUREMENT DFES_EnvBlock915 "vollständige Umweldaten alle Fehlerspeichereinträge" UBYTE DFES_OneToOne 1 100 0.00 255.0 ECU_ADDRESS 0xD0009215 /end MEASUREMENT
/begin MEASUREMENT DFES_EnvBlock916 "vollständige Umweldaten alle Fehlerspeichereinträge" UBYTE DFES_OneToOne 1 100 0.00 255.0 ECU_ADDRESS 0xD0009216 /end MEASUREMENT
/begin MEASUREMENT DFES_EnvBlock917 "vollständige Umweldaten alle Fehlerspeichereinträge" UBYTE DFES_OneToOne 1 100 0.00 255.0 ECU_ADDRESS 0xD0009217 /end MEASUREMENT
/begin MEASUREMENT DFES_EnvBlock918 "vollständige Umweldaten alle Fehlerspeichereinträge" UBYTE DFES_OneToOne 1 100 0.00 255.0 ECU_ADDRESS 0xD0009218 /end MEASUREMENT
/begin MEASUREMENT DFES_EnvBlock919 "vollständige Umweldaten alle Fehlerspeichereinträge" UBYTE DFES_OneToOne 1 100 0.00 255.0 ECU_ADDRESS 0xD0009219 /end MEASUREMENT
/begin MEASUREMENT DFES_EnvBlock920 "vollständige Umweldaten alle Fehlerspeichereinträge" UBYTE DFES_OneToOne 1 100 0.00 255.0 ECU_ADDRESS 0xD000921A /end MEASUREMENT
/begin MEASUREMENT DFES_EnvBlock921 "vollständige Umweldaten alle Fehlerspeichereinträge" UBYTE DFES_OneToOne 1 100 0.00 255.0 ECU_ADDRESS 0xD000921B /end MEASUREMENT
/begin MEASUREMENT DFES_EnvBlock922 "vollständige Umweldaten alle Fehlerspeichereinträge" UBYTE DFES_OneToOne 1 100 0.00 255.0 ECU_ADDRESS 0xD000921C /end MEASUREMENT
/begin MEASUREMENT DFES_EnvBlock923 "vollständige Umweldaten alle Fehlerspeichereinträge" UBYTE DFES_OneToOne 1 100 0.00 255.0 ECU_ADDRESS 0xD000921D /end MEASUREMENT
/begin MEASUREMENT DFES_EnvBlock924 "vollständige Umweldaten alle Fehlerspeichereinträge" UBYTE DFES_OneToOne 1 100 0.00 255.0 ECU_ADDRESS 0xD000921E /end MEASUREMENT
/begin MEASUREMENT DFES_EnvBlock925 "vollständige Umweldaten alle Fehlerspeichereinträge" UBYTE DFES_OneToOne 1 100 0.00 255.0 ECU_ADDRESS 0xD000921F /end MEASUREMENT
/begin MEASUREMENT DFES_EnvBlock926 "vollständige Umweldaten alle Fehlerspeichereinträge" UBYTE DFES_OneToOne 1 100 0.00 255.0 ECU_ADDRESS 0xD0009220 /end MEASUREMENT
/begin MEASUREMENT DFES_EnvBlock927 "vollständige Umweldaten alle Fehlerspeichereinträge" UBYTE DFES_OneToOne 1 100 0.00 255.0 ECU_ADDRESS 0xD0009221 /end MEASUREMENT
/begin MEASUREMENT DFES_EnvBlock928 "vollständige Umweldaten alle Fehlerspeichereinträge" UBYTE DFES_OneToOne 1 100 0.00 255.0 ECU_ADDRESS 0xD0009222 /end MEASUREMENT
/begin MEASUREMENT DFES_EnvBlock929 "vollständige Umweldaten alle Fehlerspeichereinträge" UBYTE DFES_OneToOne 1 100 0.00 255.0 ECU_ADDRESS 0xD0009223 /end MEASUREMENT
/begin MEASUREMENT DFES_EnvBlock930 "vollständige Umweldaten alle Fehlerspeichereinträge" UBYTE DFES_OneToOne 1 100 0.00 255.0 ECU_ADDRESS 0xD0009224 /end MEASUREMENT
/begin MEASUREMENT DFES_EnvBlock931 "vollständige Umweldaten alle Fehlerspeichereinträge" UBYTE DFES_OneToOne 1 100 0.00 255.0 ECU_ADDRESS 0xD0009225 /end MEASUREMENT
/begin MEASUREMENT DFES_EnvBlock932 "vollständige Umweldaten alle Fehlerspeichereinträge" UBYTE DFES_OneToOne 1 100 0.00 255.0 ECU_ADDRESS 0xD0009226 /end MEASUREMENT
/begin MEASUREMENT DFES_EnvBlock933 "vollständige Umweldaten alle Fehlerspeichereinträge" UBYTE DFES_OneToOne 1 100 0.00 255.0 ECU_ADDRESS 0xD0009227 /end MEASUREMENT
/begin MEASUREMENT DFES_EnvBlock934 "vollständige Umweldaten alle Fehlerspeichereinträge" UBYTE DFES_OneToOne 1 100 0.00 255.0 ECU_ADDRESS 0xD0009228 /end MEASUREMENT
/begin MEASUREMENT DFES_EnvBlock935 "vollständige Umweldaten alle Fehlerspeichereinträge" UBYTE DFES_OneToOne 1 100 0.00 255.0 ECU_ADDRESS 0xD0009229 /end MEASUREMENT
/begin MEASUREMENT DFES_EnvBlock936 "vollständige Umweldaten alle Fehlerspeichereinträge" UBYTE DFES_OneToOne 1 100 0.00 255.0 ECU_ADDRESS 0xD000922A /end MEASUREMENT
/begin MEASUREMENT DFES_EnvBlock937 "vollständige Umweldaten alle Fehlerspeichereinträge" UBYTE DFES_OneToOne 1 100 0.00 255.0 ECU_ADDRESS 0xD000922B /end MEASUREMENT
/begin MEASUREMENT DFES_EnvBlock938 "vollständige Umweldaten alle Fehlerspeichereinträge" UBYTE DFES_OneToOne 1 100 0.00 255.0 ECU_ADDRESS 0xD000922C /end MEASUREMENT
/begin MEASUREMENT DFES_EnvBlock939 "vollständige Umweldaten alle Fehlerspeichereinträge" UBYTE DFES_OneToOne 1 100 0.00 255.0 ECU_ADDRESS 0xD000922D /end MEASUREMENT
/begin MEASUREMENT DFES_EnvBlock940 "vollständige Umweldaten alle Fehlerspeichereinträge" UBYTE DFES_OneToOne 1 100 0.00 255.0 ECU_ADDRESS 0xD000922E /end MEASUREMENT
/begin MEASUREMENT DFES_EnvBlock941 "vollständige Umweldaten alle Fehlerspeichereinträge" UBYTE DFES_OneToOne 1 100 0.00 255.0 ECU_ADDRESS 0xD000922F /end MEASUREMENT
/begin MEASUREMENT DFES_EnvBlock942 "vollständige Umweldaten alle Fehlerspeichereinträge" UBYTE DFES_OneToOne 1 100 0.00 255.0 ECU_ADDRESS 0xD0009230 /end MEASUREMENT
/begin MEASUREMENT DFES_EnvBlock943 "vollständige Umweldaten alle Fehlerspeichereinträge" UBYTE DFES_OneToOne 1 100 0.00 255.0 ECU_ADDRESS 0xD0009231 /end MEASUREMENT
/begin MEASUREMENT DFES_EnvBlock944 "vollständige Umweldaten alle Fehlerspeichereinträge" UBYTE DFES_OneToOne 1 100 0.00 255.0 ECU_ADDRESS 0xD0009232 /end MEASUREMENT
/begin MEASUREMENT DFES_EnvBlock945 "vollständige Umweldaten alle Fehlerspeichereinträge" UBYTE DFES_OneToOne 1 100 0.00 255.0 ECU_ADDRESS 0xD0009233 /end MEASUREMENT
/begin MEASUREMENT DFES_EnvBlock946 "vollständige Umweldaten alle Fehlerspeichereinträge" UBYTE DFES_OneToOne 1 100 0.00 255.0 ECU_ADDRESS 0xD0009234 /end MEASUREMENT
/begin MEASUREMENT DFES_EnvBlock947 "vollständige Umweldaten alle Fehlerspeichereinträge" UBYTE DFES_OneToOne 1 100 0.00 255.0 ECU_ADDRESS 0xD0009235 /end MEASUREMENT
/begin MEASUREMENT DFES_EnvBlock948 "vollständige Umweldaten alle Fehlerspeichereinträge" UBYTE DFES_OneToOne 1 100 0.00 255.0 ECU_ADDRESS 0xD0009236 /end MEASUREMENT
/begin MEASUREMENT DFES_EnvBlock949 "vollständige Umweldaten alle Fehlerspeichereinträge" UBYTE DFES_OneToOne 1 100 0.00 255.0 ECU_ADDRESS 0xD0009237 /end MEASUREMENT
/begin MEASUREMENT DFES_EnvBlock950 "vollständige Umweldaten alle Fehlerspeichereinträge" UBYTE DFES_OneToOne 1 100 0.00 255.0 ECU_ADDRESS 0xD0009238 /end MEASUREMENT
/begin MEASUREMENT DFES_EnvBlock951 "vollständige Umweldaten alle Fehlerspeichereinträge" UBYTE DFES_OneToOne 1 100 0.00 255.0 ECU_ADDRESS 0xD0009239 /end MEASUREMENT
/begin MEASUREMENT DFES_EnvBlock952 "vollständige Umweldaten alle Fehlerspeichereinträge" UBYTE DFES_OneToOne 1 100 0.00 255.0 ECU_ADDRESS 0xD000923A /end MEASUREMENT
/begin MEASUREMENT DFES_EnvBlock953 "vollständige Umweldaten alle Fehlerspeichereinträge" UBYTE DFES_OneToOne 1 100 0.00 255.0 ECU_ADDRESS 0xD000923B /end MEASUREMENT
/begin MEASUREMENT DFES_EnvBlock954 "vollständige Umweldaten alle Fehlerspeichereinträge" UBYTE DFES_OneToOne 1 100 0.00 255.0 ECU_ADDRESS 0xD000923C /end MEASUREMENT
/begin MEASUREMENT DFES_EnvBlock955 "vollständige Umweldaten alle Fehlerspeichereinträge" UBYTE DFES_OneToOne 1 100 0.00 255.0 ECU_ADDRESS 0xD000923D /end MEASUREMENT
/begin MEASUREMENT DFES_EnvBlock956 "vollständige Umweldaten alle Fehlerspeichereinträge" UBYTE DFES_OneToOne 1 100 0.00 255.0 ECU_ADDRESS 0xD000923E /end MEASUREMENT
/begin MEASUREMENT DFES_EnvBlock957 "vollständige Umweldaten alle Fehlerspeichereinträge" UBYTE DFES_OneToOne 1 100 0.00 255.0 ECU_ADDRESS 0xD000923F /end MEASUREMENT
/begin MEASUREMENT DFES_EnvBlock958 "vollständige Umweldaten alle Fehlerspeichereinträge" UBYTE DFES_OneToOne 1 100 0.00 255.0 ECU_ADDRESS 0xD0009240 /end MEASUREMENT
/begin MEASUREMENT DFES_EnvBlock959 "vollständige Umweldaten alle Fehlerspeichereinträge" UBYTE DFES_OneToOne 1 100 0.00 255.0 ECU_ADDRESS 0xD0009241 /end MEASUREMENT
/begin MEASUREMENT DFES_EnvBlock960 "vollständige Umweldaten alle Fehlerspeichereinträge" UBYTE DFES_OneToOne 1 100 0.00 255.0 ECU_ADDRESS 0xD0009242 /end MEASUREMENT
/begin MEASUREMENT DFES_EnvBlock961 "vollständige Umweldaten alle Fehlerspeichereinträge" UBYTE DFES_OneToOne 1 100 0.00 255.0 ECU_ADDRESS 0xD0009243 /end MEASUREMENT
/begin MEASUREMENT DFES_EnvBlock962 "vollständige Umweldaten alle Fehlerspeichereinträge" UBYTE DFES_OneToOne 1 100 0.00 255.0 ECU_ADDRESS 0xD0009244 /end MEASUREMENT
/begin MEASUREMENT DFES_EnvBlock963 "vollständige Umweldaten alle Fehlerspeichereinträge" UBYTE DFES_OneToOne 1 100 0.00 255.0 ECU_ADDRESS 0xD0009245 /end MEASUREMENT
/begin MEASUREMENT DFES_EnvBlock964 "vollständige Umweldaten alle Fehlerspeichereinträge" UBYTE DFES_OneToOne 1 100 0.00 255.0 ECU_ADDRESS 0xD0009246 /end MEASUREMENT
/begin MEASUREMENT DFES_EnvBlock965 "vollständige Umweldaten alle Fehlerspeichereinträge" UBYTE DFES_OneToOne 1 100 0.00 255.0 ECU_ADDRESS 0xD0009247 /end MEASUREMENT
/begin MEASUREMENT DFES_EnvBlock966 "vollständige Umweldaten alle Fehlerspeichereinträge" UBYTE DFES_OneToOne 1 100 0.00 255.0 ECU_ADDRESS 0xD0009248 /end MEASUREMENT
/begin MEASUREMENT DFES_EnvBlock967 "vollständige Umweldaten alle Fehlerspeichereinträge" UBYTE DFES_OneToOne 1 100 0.00 255.0 ECU_ADDRESS 0xD0009249 /end MEASUREMENT
/begin MEASUREMENT DFES_EnvBlock968 "vollständige Umweldaten alle Fehlerspeichereinträge" UBYTE DFES_OneToOne 1 100 0.00 255.0 ECU_ADDRESS 0xD000924A /end MEASUREMENT
/begin MEASUREMENT DFES_EnvBlock969 "vollständige Umweldaten alle Fehlerspeichereinträge" UBYTE DFES_OneToOne 1 100 0.00 255.0 ECU_ADDRESS 0xD000924B /end MEASUREMENT
/begin MEASUREMENT DFES_EnvBlock970 "vollständige Umweldaten alle Fehlerspeichereinträge" UBYTE DFES_OneToOne 1 100 0.00 255.0 ECU_ADDRESS 0xD000924C /end MEASUREMENT
/begin MEASUREMENT DFES_EnvBlock971 "vollständige Umweldaten alle Fehlerspeichereinträge" UBYTE DFES_OneToOne 1 100 0.00 255.0 ECU_ADDRESS 0xD000924D /end MEASUREMENT
/begin MEASUREMENT DFES_EnvBlock972 "vollständige Umweldaten alle Fehlerspeichereinträge" UBYTE DFES_OneToOne 1 100 0.00 255.0 ECU_ADDRESS 0xD000924E /end MEASUREMENT
/begin MEASUREMENT DFES_EnvBlock973 "vollständige Umweldaten alle Fehlerspeichereinträge" UBYTE DFES_OneToOne 1 100 0.00 255.0 ECU_ADDRESS 0xD000924F /end MEASUREMENT
/begin MEASUREMENT DFES_EnvBlock974 "vollständige Umweldaten alle Fehlerspeichereinträge" UBYTE DFES_OneToOne 1 100 0.00 255.0 ECU_ADDRESS 0xD0009250 /end MEASUREMENT
/begin MEASUREMENT DFES_EnvBlock975 "vollständige Umweldaten alle Fehlerspeichereinträge" UBYTE DFES_OneToOne 1 100 0.00 255.0 ECU_ADDRESS 0xD0009251 /end MEASUREMENT
/begin MEASUREMENT DFES_EnvBlock976 "vollständige Umweldaten alle Fehlerspeichereinträge" UBYTE DFES_OneToOne 1 100 0.00 255.0 ECU_ADDRESS 0xD0009252 /end MEASUREMENT
/begin MEASUREMENT DFES_EnvBlock977 "vollständige Umweldaten alle Fehlerspeichereinträge" UBYTE DFES_OneToOne 1 100 0.00 255.0 ECU_ADDRESS 0xD0009253 /end MEASUREMENT
/begin MEASUREMENT DFES_EnvBlock978 "vollständige Umweldaten alle Fehlerspeichereinträge" UBYTE DFES_OneToOne 1 100 0.00 255.0 ECU_ADDRESS 0xD0009254 /end MEASUREMENT
/begin MEASUREMENT DFES_EnvBlock979 "vollständige Umweldaten alle Fehlerspeichereinträge" UBYTE DFES_OneToOne 1 100 0.00 255.0 ECU_ADDRESS 0xD0009255 /end MEASUREMENT
/begin MEASUREMENT DFES_EnvBlock980 "vollständige Umweldaten alle Fehlerspeichereinträge" UBYTE DFES_OneToOne 1 100 0.00 255.0 ECU_ADDRESS 0xD0009256 /end MEASUREMENT
/begin MEASUREMENT DFES_EnvBlock981 "vollständige Umweldaten alle Fehlerspeichereinträge" UBYTE DFES_OneToOne 1 100 0.00 255.0 ECU_ADDRESS 0xD0009257 /end MEASUREMENT
/begin MEASUREMENT DFES_EnvBlock982 "vollständige Umweldaten alle Fehlerspeichereinträge" UBYTE DFES_OneToOne 1 100 0.00 255.0 ECU_ADDRESS 0xD0009258 /end MEASUREMENT
/begin MEASUREMENT DFES_EnvBlock983 "vollständige Umweldaten alle Fehlerspeichereinträge" UBYTE DFES_OneToOne 1 100 0.00 255.0 ECU_ADDRESS 0xD0009259 /end MEASUREMENT
/begin MEASUREMENT DFES_EnvBlock984 "vollständige Umweldaten alle Fehlerspeichereinträge" UBYTE DFES_OneToOne 1 100 0.00 255.0 ECU_ADDRESS 0xD000925A /end MEASUREMENT
/begin MEASUREMENT DFES_EnvBlock985 "vollständige Umweldaten alle Fehlerspeichereinträge" UBYTE DFES_OneToOne 1 100 0.00 255.0 ECU_ADDRESS 0xD000925B /end MEASUREMENT
/begin MEASUREMENT DFES_EnvBlock986 "vollständige Umweldaten alle Fehlerspeichereinträge" UBYTE DFES_OneToOne 1 100 0.00 255.0 ECU_ADDRESS 0xD000925C /end MEASUREMENT
/begin MEASUREMENT DFES_EnvBlock987 "vollständige Umweldaten alle Fehlerspeichereinträge" UBYTE DFES_OneToOne 1 100 0.00 255.0 ECU_ADDRESS 0xD000925D /end MEASUREMENT
/begin MEASUREMENT DFES_EnvBlock988 "vollständige Umweldaten alle Fehlerspeichereinträge" UBYTE DFES_OneToOne 1 100 0.00 255.0 ECU_ADDRESS 0xD000925E /end MEASUREMENT
/begin MEASUREMENT DFES_EnvBlock989 "vollständige Umweldaten alle Fehlerspeichereinträge" UBYTE DFES_OneToOne 1 100 0.00 255.0 ECU_ADDRESS 0xD000925F /end MEASUREMENT
/begin MEASUREMENT DFES_EnvBlock990 "vollständige Umweldaten alle Fehlerspeichereinträge" UBYTE DFES_OneToOne 1 100 0.00 255.0 ECU_ADDRESS 0xD0009260 /end MEASUREMENT
/begin MEASUREMENT DFES_EnvBlock991 "vollständige Umweldaten alle Fehlerspeichereinträge" UBYTE DFES_OneToOne 1 100 0.00 255.0 ECU_ADDRESS 0xD0009261 /end MEASUREMENT
/begin MEASUREMENT DFES_EnvBlock992 "vollständige Umweldaten alle Fehlerspeichereinträge" UBYTE DFES_OneToOne 1 100 0.00 255.0 ECU_ADDRESS 0xD0009262 /end MEASUREMENT
/begin MEASUREMENT DFES_EnvBlock993 "vollständige Umweldaten alle Fehlerspeichereinträge" UBYTE DFES_OneToOne 1 100 0.00 255.0 ECU_ADDRESS 0xD0009263 /end MEASUREMENT
/begin MEASUREMENT DFES_EnvBlock994 "vollständige Umweldaten alle Fehlerspeichereinträge" UBYTE DFES_OneToOne 1 100 0.00 255.0 ECU_ADDRESS 0xD0009264 /end MEASUREMENT
/begin MEASUREMENT DFES_EnvBlock995 "vollständige Umweldaten alle Fehlerspeichereinträge" UBYTE DFES_OneToOne 1 100 0.00 255.0 ECU_ADDRESS 0xD0009265 /end MEASUREMENT
/begin MEASUREMENT DFES_EnvBlock996 "vollständige Umweldaten alle Fehlerspeichereinträge" UBYTE DFES_OneToOne 1 100 0.00 255.0 ECU_ADDRESS 0xD0009266 /end MEASUREMENT
/begin MEASUREMENT DFES_EnvBlock997 "vollständige Umweldaten alle Fehlerspeichereinträge" UBYTE DFES_OneToOne 1 100 0.00 255.0 ECU_ADDRESS 0xD0009267 /end MEASUREMENT
/begin MEASUREMENT DFES_EnvBlock998 "vollständige Umweldaten alle Fehlerspeichereinträge" UBYTE DFES_OneToOne 1 100 0.00 255.0 ECU_ADDRESS 0xD0009268 /end MEASUREMENT
/begin MEASUREMENT DFES_EnvBlock999 "vollständige Umweldaten alle Fehlerspeichereinträge" UBYTE DFES_OneToOne 1 100 0.00 255.0 ECU_ADDRESS 0xD0009269 /end MEASUREMENT
/begin MEASUREMENT DFES_EnvBlock1000 "vollständige Umweldaten alle Fehlerspeichereinträge" UBYTE DFES_OneToOne 1 100 0.00 255.0 ECU_ADDRESS 0xD000926A /end MEASUREMENT
/begin MEASUREMENT DFES_EnvBlock1001 "vollständige Umweldaten alle Fehlerspeichereinträge" UBYTE DFES_OneToOne 1 100 0.00 255.0 ECU_ADDRESS 0xD000926B /end MEASUREMENT
/begin MEASUREMENT DFES_EnvBlock1002 "vollständige Umweldaten alle Fehlerspeichereinträge" UBYTE DFES_OneToOne 1 100 0.00 255.0 ECU_ADDRESS 0xD000926C /end MEASUREMENT
/begin MEASUREMENT DFES_EnvBlock1003 "vollständige Umweldaten alle Fehlerspeichereinträge" UBYTE DFES_OneToOne 1 100 0.00 255.0 ECU_ADDRESS 0xD000926D /end MEASUREMENT
/begin MEASUREMENT DFES_EnvBlock1004 "vollständige Umweldaten alle Fehlerspeichereinträge" UBYTE DFES_OneToOne 1 100 0.00 255.0 ECU_ADDRESS 0xD000926E /end MEASUREMENT
/begin MEASUREMENT DFES_EnvBlock1005 "vollständige Umweldaten alle Fehlerspeichereinträge" UBYTE DFES_OneToOne 1 100 0.00 255.0 ECU_ADDRESS 0xD000926F /end MEASUREMENT
/begin MEASUREMENT DFES_EnvBlock1006 "vollständige Umweldaten alle Fehlerspeichereinträge" UBYTE DFES_OneToOne 1 100 0.00 255.0 ECU_ADDRESS 0xD0009270 /end MEASUREMENT
/begin MEASUREMENT DFES_EnvBlock1007 "vollständige Umweldaten alle Fehlerspeichereinträge" UBYTE DFES_OneToOne 1 100 0.00 255.0 ECU_ADDRESS 0xD0009271 /end MEASUREMENT
/begin MEASUREMENT DFES_EnvBlock1008 "vollständige Umweldaten alle Fehlerspeichereinträge" UBYTE DFES_OneToOne 1 100 0.00 255.0 ECU_ADDRESS 0xD0009272 /end MEASUREMENT
/begin MEASUREMENT DFES_EnvBlock1009 "vollständige Umweldaten alle Fehlerspeichereinträge" UBYTE DFES_OneToOne 1 100 0.00 255.0 ECU_ADDRESS 0xD0009273 /end MEASUREMENT
/begin MEASUREMENT DFES_EnvBlock1010 "vollständige Umweldaten alle Fehlerspeichereinträge" UBYTE DFES_OneToOne 1 100 0.00 255.0 ECU_ADDRESS 0xD0009274 /end MEASUREMENT
/begin MEASUREMENT DFES_EnvBlock1011 "vollständige Umweldaten alle Fehlerspeichereinträge" UBYTE DFES_OneToOne 1 100 0.00 255.0 ECU_ADDRESS 0xD0009275 /end MEASUREMENT
/begin MEASUREMENT DFES_EnvBlock1012 "vollständige Umweldaten alle Fehlerspeichereinträge" UBYTE DFES_OneToOne 1 100 0.00 255.0 ECU_ADDRESS 0xD0009276 /end MEASUREMENT
/begin MEASUREMENT DFES_EnvBlock1013 "vollständige Umweldaten alle Fehlerspeichereinträge" UBYTE DFES_OneToOne 1 100 0.00 255.0 ECU_ADDRESS 0xD0009277 /end MEASUREMENT
/begin MEASUREMENT DFES_EnvBlock1014 "vollständige Umweldaten alle Fehlerspeichereinträge" UBYTE DFES_OneToOne 1 100 0.00 255.0 ECU_ADDRESS 0xD0009278 /end MEASUREMENT
/begin MEASUREMENT DFES_EnvBlock1015 "vollständige Umweldaten alle Fehlerspeichereinträge" UBYTE DFES_OneToOne 1 100 0.00 255.0 ECU_ADDRESS 0xD0009279 /end MEASUREMENT
/begin MEASUREMENT DFES_EnvBlock1016 "vollständige Umweldaten alle Fehlerspeichereinträge" UBYTE DFES_OneToOne 1 100 0.00 255.0 ECU_ADDRESS 0xD000927A /end MEASUREMENT
/begin MEASUREMENT DFES_EnvBlock1017 "vollständige Umweldaten alle Fehlerspeichereinträge" UBYTE DFES_OneToOne 1 100 0.00 255.0 ECU_ADDRESS 0xD000927B /end MEASUREMENT
/begin MEASUREMENT DFES_EnvBlock1018 "vollständige Umweldaten alle Fehlerspeichereinträge" UBYTE DFES_OneToOne 1 100 0.00 255.0 ECU_ADDRESS 0xD000927C /end MEASUREMENT
/begin MEASUREMENT DFES_EnvBlock1019 "vollständige Umweldaten alle Fehlerspeichereinträge" UBYTE DFES_OneToOne 1 100 0.00 255.0 ECU_ADDRESS 0xD000927D /end MEASUREMENT
/begin MEASUREMENT DFES_EnvBlock1020 "vollständige Umweldaten alle Fehlerspeichereinträge" UBYTE DFES_OneToOne 1 100 0.00 255.0 ECU_ADDRESS 0xD000927E /end MEASUREMENT
/begin MEASUREMENT DFES_EnvBlock1021 "vollständige Umweldaten alle Fehlerspeichereinträge" UBYTE DFES_OneToOne 1 100 0.00 255.0 ECU_ADDRESS 0xD000927F /end MEASUREMENT
/begin MEASUREMENT DFES_EnvBlock1022 "vollständige Umweldaten alle Fehlerspeichereinträge" UBYTE DFES_OneToOne 1 100 0.00 255.0 ECU_ADDRESS 0xD0009280 /end MEASUREMENT
/begin MEASUREMENT DFES_EnvBlock1023 "vollständige Umweldaten alle Fehlerspeichereinträge" UBYTE DFES_OneToOne 1 100 0.00 255.0 ECU_ADDRESS 0xD0009281 /end MEASUREMENT
/begin MEASUREMENT DFES_EnvBlock1024 "vollständige Umweldaten alle Fehlerspeichereinträge" UBYTE DFES_OneToOne 1 100 0.00 255.0 ECU_ADDRESS 0xD0009282 /end MEASUREMENT
/begin MEASUREMENT DFES_EnvBlock1025 "vollständige Umweldaten alle Fehlerspeichereinträge" UBYTE DFES_OneToOne 1 100 0.00 255.0 ECU_ADDRESS 0xD0009283 /end MEASUREMENT
/begin COMPU_METHOD CylPresVolt "" RAT_FUNC "%6.2" "mV" COEFFS 0 1.24090909090909 0 0 0 1 /end COMPU_METHOD
/begin COMPU_METHOD Def_st_ub_q1 "" RAT_FUNC "%3.1" "-" COEFFS 0 1 0 0 0 1 /end COMPU_METHOD
/begin COMPU_METHOD Dens "" RAT_FUNC "%6.3" "Kg/m^3" COEFFS 0 10 0 0 0 1 /end COMPU_METHOD
/begin COMPU_METHOD DensFine "" RAT_FUNC "%6.4" "Kg/m^3" COEFFS 0 500 0 0 0 1 /end COMPU_METHOD
/begin COMPU_METHOD DEVLIB_4WINDIACMPNENA_SY_Compu "" TAB_VERB "%6.3" "" COMPU_TAB_REF DEVLIB_4WINDIACMPNENA_SY_Compu /end COMPU_METHOD
/begin COMPU_VTAB DEVLIB_4WINDIACMPNENA_SY_Compu "" TAB_VERB 2 0 "False" 1 "True" /end COMPU_VTAB
/begin COMPU_METHOD DEVLIB_ACTRPRTCMPNENA_SY_Compu "" TAB_VERB "%6.3" "" COMPU_TAB_REF DEVLIB_ACTRPRTCMPNENA_SY_Compu /end COMPU_METHOD
/begin COMPU_VTAB DEVLIB_ACTRPRTCMPNENA_SY_Compu "" TAB_VERB 2 0 "False" 1 "True" /end COMPU_VTAB
/begin COMPU_METHOD DEVLIB_DIACTLLINECMPNENA_SY_Compu "" TAB_VERB "%6.3" "" COMPU_TAB_REF DEVLIB_DIACTLLINECMPNENA_SY_Compu /end COMPU_METHOD
/begin COMPU_VTAB DEVLIB_DIACTLLINECMPNENA_SY_Compu "" TAB_VERB 2 0 "False" 1 "True" /end COMPU_VTAB
/begin COMPU_METHOD DFES_COMMILDEB_SY_Compu "" TAB_VERB "%6.3" "" COMPU_TAB_REF DFES_COMMILDEB_SY_Compu /end COMPU_METHOD
/begin COMPU_VTAB DFES_COMMILDEB_SY_Compu "" TAB_VERB 2 0 "DISABLED" 1 "ENABLED" /end COMPU_VTAB
/begin COMPU_METHOD DFES_EXTDFLT_Compu "" TAB_VERB "%6.3" "" COMPU_TAB_REF DFES_EXTDFLT_Compu /end COMPU_METHOD
/begin COMPU_VTAB DFES_EXTDFLT_Compu "" TAB_VERB 2 0 "DISABLED" 1 "ENABLED" /end COMPU_VTAB
/begin COMPU_METHOD DFES_IRV_SY_Compu "" TAB_VERB "%6.3" "" COMPU_TAB_REF DFES_IRV_SY_Compu /end COMPU_METHOD
/begin COMPU_VTAB DFES_IRV_SY_Compu "" TAB_VERB 2 0 "DFES_IRV_DISBL" 1 "DFES_IRV_ENA" /end COMPU_VTAB
/begin COMPU_METHOD DFES_OneToOne "" RAT_FUNC "%6.0" "-" COEFFS 0 1 0 0 0 1 /end COMPU_METHOD
/begin COMPU_METHOD DFES_SIMCOND_SY_Compu "" TAB_VERB "%6.3" "" COMPU_TAB_REF DFES_SIMCOND_SY_Compu /end COMPU_METHOD
/begin COMPU_VTAB DFES_SIMCOND_SY_Compu "" TAB_VERB 2 0 "DISABLED" 1 "ENABLED" /end COMPU_VTAB
/begin COMPU_METHOD dFlConsum "" RAT_FUNC "%6.4" "l/h/s" COEFFS 0 100 0 0 0 1 /end COMPU_METHOD
/begin COMPU_METHOD DIUMPR_500MD_SY_Compu "" TAB_VERB "%6.3" "" COMPU_TAB_REF DIUMPR_500MD_SY_Compu /end COMPU_METHOD
/begin COMPU_VTAB DIUMPR_500MD_SY_Compu "" TAB_VERB 2 0 "DISABLED" 1 "ENABLED" /end COMPU_VTAB
/begin COMPU_METHOD dmNOx_mg_p_s "" RAT_FUNC "%6.3" "mg/s" COEFFS 0 6.66666666666667 0 0 0 1 /end COMPU_METHOD
/begin COMPU_METHOD dmOilAsh_mg_p_s "" RAT_FUNC "%6.4" "mg/s" COEFFS 0 100 0 0 0 1 /end COMPU_METHOD
/begin COMPU_METHOD dmSoot_ppm "" RAT_FUNC "%6.2" "ppm" COEFFS 0 1 0 0 0 1 /end COMPU_METHOD
/begin COMPU_METHOD DSCHED_DFCSPEC_SY_Compu "" TAB_VERB "%6.3" "" COMPU_TAB_REF DSCHED_DFCSPEC_SY_Compu /end COMPU_METHOD
/begin COMPU_VTAB DSCHED_DFCSPEC_SY_Compu "" TAB_VERB 2 0 "DSCHED_DFCSPECIFIC_DISBL" 1 "DSCHED_DFCSPECIFIC_ENA" /end COMPU_VTAB
/begin COMPU_METHOD DSCHED_FTI_SY_Compu "" TAB_VERB "%6.3" "" COMPU_TAB_REF DSCHED_FTI_SY_Compu /end COMPU_METHOD
/begin COMPU_VTAB DSCHED_FTI_SY_Compu "" TAB_VERB 2 0 "DSCHED_FTI_DISBL" 1 "DSCHED_FTI_ENA" /end COMPU_VTAB
/begin COMPU_METHOD DSCHED_RATECALC_SY_Compu "" TAB_VERB "%6.3" "" COMPU_TAB_REF DSCHED_RATECALC_SY_Compu /end COMPU_METHOD
/begin COMPU_VTAB DSCHED_RATECALC_SY_Compu "" TAB_VERB 2 0 "DSCHED_RATECALC_DISBL" 1 "DSCHED_RATECALC_ENA" /end COMPU_VTAB
/begin COMPU_METHOD DSCHED_WTT_SY_Compu "" TAB_VERB "%6.3" "" COMPU_TAB_REF DSCHED_WTT_SY_Compu /end COMPU_METHOD
/begin COMPU_VTAB DSCHED_WTT_SY_Compu "" TAB_VERB 2 0 "DSCHED_WTT_DISBL" 1 "DSCHED_WTT_ENA" /end COMPU_VTAB
/begin COMPU_METHOD DSMAUX_TCSORT_Compu "" TAB_VERB "%6.3" "" COMPU_TAB_REF DSMAUX_TCSORT_Compu /end COMPU_METHOD
/begin COMPU_VTAB DSMAUX_TCSORT_Compu "" TAB_VERB 2 0 "DISABLED" 1 "ENABLED" /end COMPU_VTAB
/begin COMPU_METHOD DSMRDY_INHP41_SY_Compu "" TAB_VERB "%6.3" "" COMPU_TAB_REF DSMRDY_INHP41_SY_Compu /end COMPU_METHOD
/begin COMPU_VTAB DSMRDY_INHP41_SY_Compu "" TAB_VERB 2 0 "(DISABLED)" 1 "(ENABLED)" /end COMPU_VTAB
/begin COMPU_METHOD DSM_WUCDET_SY_Compu "" TAB_VERB "%6.3" "" COMPU_TAB_REF DSM_WUCDET_SY_Compu /end COMPU_METHOD
/begin COMPU_VTAB DSM_WUCDET_SY_Compu "" TAB_VERB 3 0 "DSM_WUCDET_DEFAULT" 1 "DSM_WUCDET_MIN" 2 "DSM_WUCDET_MAX" /end COMPU_VTAB
/begin COMPU_METHOD DTR_LEGIFC_SY_Compu "" TAB_VERB "%6.3" "" COMPU_TAB_REF DTR_LEGIFC_SY_Compu /end COMPU_METHOD
/begin COMPU_VTAB DTR_LEGIFC_SY_Compu "" TAB_VERB 2 0 "DISABLED" 1 "ENABLED" /end COMPU_VTAB
/begin COMPU_METHOD EBXFAN_ATSINTVMOD_SY_Compu "" TAB_VERB "%6.3" "" COMPU_TAB_REF EBXFAN_ATSINTVMOD_SY_Compu /end COMPU_METHOD
/begin COMPU_VTAB EBXFAN_ATSINTVMOD_SY_Compu "" TAB_VERB 2 0 "False" 1 "True" /end COMPU_VTAB
/begin COMPU_METHOD ECBVLV_ATSINTVMOD_SY_Compu "" TAB_VERB "%6.3" "" COMPU_TAB_REF ECBVLV_ATSINTVMOD_SY_Compu /end COMPU_METHOD
/begin COMPU_VTAB ECBVLV_ATSINTVMOD_SY_Compu "" TAB_VERB 2 0 "False" 1 "True" /end COMPU_VTAB
/begin COMPU_METHOD ECUNUM_SY_Compu "" TAB_VERB "%6.3" "" COMPU_TAB_REF ECUNUM_SY_Compu /end COMPU_METHOD
/begin COMPU_VTAB ECUNUM_SY_Compu "" TAB_VERB 3 1 "ECUNUM_1" 2 "ECUNUM_2" 3 "ECUNUM_3" /end COMPU_VTAB
/begin COMPU_METHOD ECUOFF_TMR_SY_Compu "" TAB_VERB "%6.3" "" COMPU_TAB_REF ECUOFF_TMR_SY_Compu /end COMPU_METHOD
/begin COMPU_VTAB ECUOFF_TMR_SY_Compu "" TAB_VERB 2 0 "0" 1 "1" /end COMPU_VTAB
/begin COMPU_METHOD Eep_MainStates_Verb "" TAB_VERB "%6.3" "" COMPU_TAB_REF Eep_MainStates_Verb /end COMPU_METHOD
/begin COMPU_VTAB Eep_MainStates_Verb "" TAB_VERB 12 0 "EEP_INI_RUN" 1 "EEP_SHUTDWN_RUN" 2 "EEP_NORMAL_RUN" 3 "EEP_BEGPD_REQUEST" 4 "EEP_BEGPD_RUN" 5 "EEP_ENDPD_REQUEST" 6 "EEP_ENDPD_RUN" 7 "EEP_PREDRV_REQUEST" 8 "EEP_PREDRV_RUN" 9 "EEP_FIRSTINIT_INI" 10 "EEP_RAM_INI" 11 "EEP_ENVRAM_INI" /end COMPU_VTAB
/end MODULE
/end PROJECT

ASAP2_VERSION 1 4
/begin PROJECT P_574 "EDC17_CP09"
/begin HEADER "" VERSION "V8KB" PROJECT_NO P_574 /end HEADER
/begin MODULE DIM ""
/begin MOD_COMMON "" BYTE_ORDER MSB_LAST ALIGNMENT_BYTE 1 ALIGNMENT_WORD 2 ALIGNMENT_LONG 4 ALIGNMENT_FLOAT32_IEEE 4 /end MOD_COMMON
/begin CHARACTERISTIC Air_nLimPIntkVUs_C "" VALUE 0x80057484 Kw_Ws16 6000.000 EngN 0.00 6000.000 EXTENDED_LIMITS -16384.00 16383.50 /end CHARACTERISTIC
/begin CHARACTERISTIC Air_ParIntkVUsDT1.T1_C "/" VALUE 0x80057488 Kw_Ws32 49.841480947 TimeDelay_s 0.099999238556 49.941480186 FORMAT "%12.9" EXTENDED_LIMITS 0.000002000000001 4294.9672960 /end CHARACTERISTIC
/begin CHARACTERISTIC Air_ParIntkVUsDT1.Kd_C "/" VALUE 0x8005748C Kw_Ws32 999.899993896 Kd 0.100006103516 1000.00000000 FORMAT "%13.8" EXTENDED_LIMITS -32768.0000000 32767.9999847 /end CHARACTERISTIC
/begin CHARACTERISTIC Air_pDiffLimPIntkVUs_C "" VALUE 0x80057490 Kw_Ws16 3500.000 Pres_hPa 0.00 3500.000 EXTENDED_LIMITS -32768.00 32767.00 /end CHARACTERISTIC
/begin CHARACTERISTIC Air_pTransfPIntkVUs_CUR "" CURVE 0x80057438 Cur_Xs16Ws16 3500.000 Pres_hPa 0.00 3500.000 EXTENDED_LIMITS -32768.00 32767.00
 /begin AXIS_DESCR STD_AXIS Air_uRawPIntkVUs Volt 16 0.00 5000.000 EXTENDED_LIMITS -6553.600 6553.400 DEPOSIT ABSOLUTE /end AXIS_DESCR
/end CHARACTERISTIC
/begin CHARACTERISTIC Air_RmpSlpPIntkVUs.Pos_C "Rampensteigung enthaltende Struktur/" VALUE 0x80057494 Kw_Ws32 32767999.0692 RmpPres_hPa 0.915527343750 32767999.9847 FORMAT "%13.4" EXTENDED_LIMITS -32768000.0000 32767999.9847 /end CHARACTERISTIC
/begin CHARACTERISTIC Air_RmpSlpPIntkVUs.Neg_C "Rampensteigung enthaltende Struktur/" VALUE 0x80057498 Kw_Ws32 32767999.0692 RmpPres_hPa 0.915527343750 32767999.9847 FORMAT "%13.4" EXTENDED_LIMITS -32768000.0000 32767999.9847 /end CHARACTERISTIC
/begin CHARACTERISTIC Air_SRCPIntkVUs.uMin_C "SRC Min/Max Kalibriertungswerte enthaltende Struktur/" VALUE 0x8005747A Kw_Ws16 5200.000 Volt 0.00 5200.000 EXTENDED_LIMITS -6553.600 6553.400 /end CHARACTERISTIC
/begin CHARACTERISTIC Air_SRCPIntkVUs.uMax_C "SRC Min/Max Kalibriertungswerte enthaltende Struktur/" VALUE 0x8005747C Kw_Ws16 5200.000 Volt 0.00 5200.000 EXTENDED_LIMITS -6553.600 6553.400 /end CHARACTERISTIC
/begin CHARACTERISTIC Air_swtSensPrsPIntkVUs_C "Sensor-Vorhanden-Schalter für Luftdruck vor Einlassventilsensor." VALUE 0x8005749C Val_Wu8 1.000 OneToOne 0.00 1.000 EXTENDED_LIMITS 0.00 255.0 /end CHARACTERISTIC
/begin CHARACTERISTIC Air_tiPT1T1PIntkVUs_C "PT1-Filterzeitkonstante zur Filterung der ADC-Spannung." VALUE 0x80057480 Val_Ws32 4294.9672940 TimeDelay_s 0.000002000000001 4294.9672960 FORMAT "%12.7" /end CHARACTERISTIC
/begin CHARACTERISTIC Air_tiPT1T1SigPIntkVUs_C "PT1-Filterzeitkonstante zur Filterung des erfassten Druckwerts." VALUE 0x800574A0 Val_Wr32 4294.96000 TimeDelay_s_float 0.00 4294.96000 FORMAT "%10.5" EXTENDED_LIMITS -1.00000000E+037 1.00000000E+037 /end CHARACTERISTIC
/begin CHARACTERISTIC Air_TransStgPIntkVUs.Dfl_C "Vorgabewert und Sens-Id-Wort enthaltende Struktur/" VALUE 0x800574A4 Kw_Ws16 3500.000 Pres_hPa 0.00 3500.000 EXTENDED_LIMITS -32768.00 32767.00 /end CHARACTERISTIC
/begin CHARACTERISTIC Air_TransStgPIntkVUs.stSensId_C "Vorgabewert und Sens-Id-Wort enthaltende Struktur/" VALUE 0x800574A6 Kw_Wu8 4.000 OneToOne 0.00 4.000 EXTENDED_LIMITS 0.00 255.0 /end CHARACTERISTIC
/begin CHARACTERISTIC ASMod_dmNOxEG_C "Applikationslabel für die Dummy - verwendung des Nox Massenstroms im Abgas nach der Verbrennung" VALUE 0x80056B60 Val_Ws16 6553.500 NOxMassPerTime -3276.800 3276.700 FORMAT "%8.3" /end CHARACTERISTIC
/begin CHARACTERISTIC ASMod_dmSotEG_C "Applikationslabel für die Dummy - Verwendung des Russmassenstroms im abgas nach der Verbrennung" VALUE 0x80056B62 Val_Ws16 655.3500 SotMassPerTime -327.6800 327.6700 FORMAT "%8.4" /end CHARACTERISTIC
/begin CHARACTERISTIC Exh_ddvolHsLnNegPPFltDiff_C "" VALUE 0x80057524 Val_Ws16 1500.000 CubMtrPerHrPerSec -1500.000 0.00 FORMAT "%8.3" EXTENDED_LIMITS -3276.800 3276.700 /end CHARACTERISTIC
/begin CHARACTERISTIC Exh_ddvolHsLnPosPPFltDiff_C "" VALUE 0x80057526 Val_Ws16 1500.000 CubMtrPerHrPerSec 0.00 1500.000 FORMAT "%8.3" EXTENDED_LIMITS -3276.800 3276.700 /end CHARACTERISTIC
/begin CHARACTERISTIC Exh_numFldPPFltDiff_C "" VALUE 0x80057528 Val_Ws16 65535.00 OneToOne -32768.00 32767.00 /end CHARACTERISTIC
/begin CHARACTERISTIC Exh_numTiStpNplPPFltDiff_C "" VALUE 0x8005752A Val_Wu8 9.000 OneToOne 1.000 10.00 EXTENDED_LIMITS 0.00 255.0 /end CHARACTERISTIC
/begin CHARACTERISTIC Exh_pBPAPTolcMaxPPFltDiff_C "" VALUE 0x8005752C Val_Ws16 36268.00 Pres_hPa -32768.00 3500.00 EXTENDED_LIMITS -32768.00 32767.00 /end CHARACTERISTIC
/begin CHARACTERISTIC Exh_pDiffTolcMaxPPFltDiff_C "" VALUE 0x8005752E Val_Ws16 3277.0000 Pres_hPa 223.0000 3500.0000 EXTENDED_LIMITS -32768.00 32767.00 /end CHARACTERISTIC
/begin CHARACTERISTIC Exh_pHsLnNegPPFltDiff_C "" VALUE 0x80057530 Val_Ws16 36268.00 Pres_hPa -32768.00 3500.00 EXTENDED_LIMITS -32768.00 32767.00 /end CHARACTERISTIC
/begin CHARACTERISTIC Exh_pMaxPPFltDiff_C "" VALUE 0x80057532 Val_Ws16 36268.00 Pres_hPa -32768.00 3500.00 EXTENDED_LIMITS -32768.00 32767.00 /end CHARACTERISTIC
/begin CHARACTERISTIC Exh_pMinPPFltDiff_C "" VALUE 0x80057534 Val_Ws16 36268.00 Pres_hPa -32768.00 3500.00 EXTENDED_LIMITS -32768.00 32767.00 /end CHARACTERISTIC
/begin CHARACTERISTIC Exh_pMntCor_CUR "" CURVE 0x8005756A Cur_Xs16Ws16 3500.000 Pres_hPa 0.00 3500.000 EXTENDED_LIMITS -32768.00 32767.00
 /begin AXIS_DESCR STD_AXIS ASMod_dvolPFltEG AirVolPerTime 16 -214748364.800 214748364.700 FORMAT "%13.3" DEPOSIT ABSOLUTE /end AXIS_DESCR
/end CHARACTERISTIC
/begin CHARACTERISTIC Exh_pOfsValActMidPPFltDiff_C "" VALUE 0x80056B64 Val_Ws16 7000.000 Pres_hPa -3500.000 3500.000 EXTENDED_LIMITS -32768.00 32767.00 /end CHARACTERISTIC
/begin CHARACTERISTIC Exh_pPFltDiffMaxVar_C "" VALUE 0x80057536 Val_Ws16 36268.00 Pres_hPa -32768.00 3500.00 EXTENDED_LIMITS -32768.00 32767.00 /end CHARACTERISTIC
/begin CHARACTERISTIC Exh_pPFltUsBPMaxPPFltDiff_C "" VALUE 0x80057538 Val_Ws16 36268.00 Pres_hPa -32768.00 3500.00 EXTENDED_LIMITS -32768.00 32767.00 /end CHARACTERISTIC
/begin CHARACTERISTIC Exh_pTransfPPFltDiff_CUR "" CURVE 0x80057516 Cur_Xs16Ws16 3500.000 Pres_hPa 0.00 3500.000 EXTENDED_LIMITS -32768.00 32767.00
 /begin AXIS_DESCR STD_AXIS Exh_uRawPPFltDiff Volt 2 0.00 5200.000 EXTENDED_LIMITS -6553.600 6553.400 DEPOSIT ABSOLUTE /end AXIS_DESCR
/end CHARACTERISTIC
/begin CHARACTERISTIC Exh_pTransfPPFltUs_CUR "" CURVE 0x8005755C Cur_Xs16Ws16 3500.000 Pres_hPa 0.00 3500.000 EXTENDED_LIMITS -32768.00 32767.00
 /begin AXIS_DESCR STD_AXIS Exh_uRawPPFltUs Volt 2 0.00 5200.000 EXTENDED_LIMITS -6553.600 6553.400 DEPOSIT ABSOLUTE /end AXIS_DESCR
/end CHARACTERISTIC
/begin CHARACTERISTIC Exh_pUsTolcMaxPPFltDiff_C "" VALUE 0x8005753A Val_Ws16 3277.0000 Pres_hPa 223.0000 3500.0000 EXTENDED_LIMITS -32768.00 32767.00 /end CHARACTERISTIC
/begin CHARACTERISTIC Exh_resFlowTolcPPFltDiff_C "" VALUE 0x8005753C Val_Ws16 2.500000 Res_hPaHrPerCM 0.00 2.500000 FORMAT "%8.6" EXTENDED_LIMITS -3.276800 3.276700 /end CHARACTERISTIC
/begin CHARACTERISTIC Exh_RmpSlpPPFltDiff.Pos_C "/" VALUE 0x80057540 Kw_Ws32 32767999.9847 RmpPres_hPa 0.00 32767999.9847 FORMAT "%13.4" EXTENDED_LIMITS -32768000.0000 32767999.9847 /end CHARACTERISTIC
/begin CHARACTERISTIC Exh_RmpSlpPPFltDiff.Neg_C "/" VALUE 0x80057544 Kw_Ws32 32767999.9847 RmpPres_hPa 0.00 32767999.9847 FORMAT "%13.4" EXTENDED_LIMITS -32768000.0000 32767999.9847 /end CHARACTERISTIC
/begin CHARACTERISTIC Exh_SRCPPFltDiff.uMin_C "/" VALUE 0x80057520 Kw_Ws16 5200.000 Volt 0.00 5200.000 EXTENDED_LIMITS -6553.600 6553.400 /end CHARACTERISTIC
/begin CHARACTERISTIC Exh_SRCPPFltDiff.uMax_C "/" VALUE 0x80057522 Kw_Ws16 5200.000 Volt 0.00 5200.000 EXTENDED_LIMITS -6553.600 6553.400 /end CHARACTERISTIC
/begin CHARACTERISTIC Exh_SRCPPFltUs.uMin_C "/" VALUE 0x80057566 Kw_Ws16 5200.000 Volt 0.00 5200.000 EXTENDED_LIMITS -6553.600 6553.400 /end CHARACTERISTIC
/begin CHARACTERISTIC Exh_SRCPPFltUs.uMax_C "/" VALUE 0x80057568 Kw_Ws16 13107.00 Volt -6553.600 6553.400 /end CHARACTERISTIC
/begin CHARACTERISTIC Exh_stStyPPFltDiff_C "" VALUE 0x80056B66 Val_Ws16 1.000000 OneToOne 0.00 1.000000 EXTENDED_LIMITS -32768.00 32767.00 /end CHARACTERISTIC
/begin CHARACTERISTIC Exh_stTrgAftRunPPFltDiff_C "" VALUE 0x80056B68 Val_Ws16 1.000000 OneToOne 0.00 1.000000 EXTENDED_LIMITS -32768.00 32767.00 /end CHARACTERISTIC
/begin CHARACTERISTIC Exh_swtDflPPFltDiff_C "" VALUE 0x80057548 Val_Wu8 255.0 OneToOne 0.00 255.0 /end CHARACTERISTIC
/begin CHARACTERISTIC Exh_swtOfsPPFltDiff_C "" VALUE 0x80057549 Val_Wu8 1.000 OneToOne 0.00 1.000 EXTENDED_LIMITS 0.00 255.0 /end CHARACTERISTIC
/begin CHARACTERISTIC Exh_swtSvcChngPPFltDiff_C "" VALUE 0x8005754A Val_Wu8 255.0 OneToOne 0.00 255.0 /end CHARACTERISTIC
/begin CHARACTERISTIC Exh_tiDelOfsCalcPPFltDiff_C "" VALUE 0x8005754C Val_Ws16 99.30000 Time_s 0.7000000 100.0000 EXTENDED_LIMITS -327.6800 327.6700 /end CHARACTERISTIC
/begin CHARACTERISTIC Exh_tiPPFltDiffStyChk_C "" VALUE 0x80057550 Val_Ws32 99.3000000000 Time_s 0.700000000000 100.000000000 EXTENDED_LIMITS -21474836.4800 21474836.4700 /end CHARACTERISTIC
/begin CHARACTERISTIC Exh_tiPT1PPFltDiff_C "" VALUE 0x80057554 Val_Ws32 4294.9672940 TimeDelay_s 0.000002000000001 4294.9672960 FORMAT "%12.7" /end CHARACTERISTIC
/begin CHARACTERISTIC Exh_TransStgPPFltDiff.Dfl_C "/" VALUE 0x80057558 Kw_Ws16 3500.000 Pres_hPa 0.00 3500.000 EXTENDED_LIMITS -32768.00 32767.00 /end CHARACTERISTIC
/begin CHARACTERISTIC Exh_TransStgPPFltDiff.stSensId_C "/" VALUE 0x8005755A Kw_Wu8 255.0 OneToOne 0.00 255.0 /end CHARACTERISTIC
/begin CHARACTERISTIC KF_IERRGREHT "Generatorstrombegrenzung bei Generatorhochtemparatur" MAP 0x800661BE MapTKF_SW_SW_UB 31.875 Def_i_ub_q0p125 0.00 31.875
 /begin AXIS_DESCR STD_AXIS N_gen Def_n_sw_q1p0 3 -32768. 32767. FORMAT "%5.0" DEPOSIT ABSOLUTE /end AXIS_DESCR
 /begin AXIS_DESCR STD_AXIS Gen_awnumm Def_st_ub_q1 6 -32768. 32767. FORMAT "%3.0" EXTENDED_LIMITS 0.00 255. DEPOSIT ABSOLUTE /end AXIS_DESCR
/end CHARACTERISTIC
/begin CHARACTERISTIC KF_TANSGENKO "Kennfeld zur Bestimmung Ansauglufttemparatur Generator" MAP 0x800661E4 MapTKF_SW_SW_SW 6553.5 Def_t_sw_q0p1 -3276.8 3276.7 FORMAT "%6.1"
 /begin AXIS_DESCR STD_AXIS Tchip_fil_l Def_t_sw_q0p1 4 -3276.8 3276.7 FORMAT "%6.1" DEPOSIT ABSOLUTE /end AXIS_DESCR
 /begin AXIS_DESCR STD_AXIS N_gen Def_n_sw_q1p0 4 -32768. 32767. FORMAT "%5.0" DEPOSIT ABSOLUTE /end AXIS_DESCR
/end CHARACTERISTIC
/begin CHARACTERISTIC KF_UFDIODE "Kennfeld für Diodenvorwärtsspannung" MAP 0x80066216 MapTKF_UB_SW_UW 319.9951 Def_u_uw_q0p00488 0.00 319.9951 FORMAT "%8.4"
 /begin AXIS_DESCR STD_AXIS Tans_gen Def_t_sw_q0p1 2 -3276.8 3276.7 FORMAT "%6.1" DEPOSIT ABSOLUTE /end AXIS_DESCR
 /begin AXIS_DESCR STD_AXIS Gen_awnumm Def_st_ub_q1 6 0.00 255. FORMAT "%3.0" DEPOSIT ABSOLUTE /end AXIS_DESCR
/end CHARACTERISTIC
/begin CHARACTERISTIC KL_GELIKMIE "Faktor für Generatorlastbegrenzung für Leerlaufstabilisierung" CURVE 0x8006617C CurTKL_UB_VV_UB 1.9922 Def_f_ub_b2 0.00 1.9922
 /begin AXIS_DESCR STD_AXIS Ierr Def_i_ub_q0p125 6 0.00 31.875 DEPOSIT ABSOLUTE /end AXIS_DESCR
/end CHARACTERISTIC
/begin CHARACTERISTIC KL_NELUEFTGE "E-Lüfteranforderung Generator" CURVE 0x8006623A CurTKL_UB_VV_UB 99.61 Def_tv_ub_q0p390625 0.00 99.61
 /begin AXIS_DESCR STD_AXIS Gen_awnumm Def_st_ub_q1 6 0.00 255. FORMAT "%3.0" DEPOSIT ABSOLUTE /end AXIS_DESCR
/end CHARACTERISTIC
/begin CHARACTERISTIC KL_RTHJADIOD "Temperaturkoeffizient der Diode" CURVE 0x80066248 CurTKL_UB_VV_UW 99.99847 Def_f_uw_b100 0.00 99.99847
 /begin AXIS_DESCR STD_AXIS Gen_awnumm Def_st_ub_q1 6 0.00 255. FORMAT "%3.0" DEPOSIT ABSOLUTE /end AXIS_DESCR
/end CHARACTERISTIC
/begin CHARACTERISTIC KL_TCHIPOFFS "Offset zur gemessenen Chiptemperatur Herstellerspezifisch" CURVE 0x8006625C CurTKL_UB_VV_SW 6553.5 Def_t_sw_q0p1 -3276.8 3276.7 FORMAT "%6.1"
 /begin AXIS_DESCR STD_AXIS Gen_manufak Def_st_ub_q1 8 0.00 255. FORMAT "%3.0" DEPOSIT ABSOLUTE /end AXIS_DESCR
/end CHARACTERISTIC
/begin CHARACTERISTIC KL_TMAXDIODE "Zulässige Diodenmaximaltemperatur" CURVE 0x80066276 CurTKL_UB_VV_SW 6553.5 Def_t_sw_q0p1 -3276.8 3276.7 FORMAT "%6.1"
 /begin AXIS_DESCR STD_AXIS Gen_awnumm Def_st_ub_q1 6 0.00 255. FORMAT "%3.0" DEPOSIT ABSOLUTE /end AXIS_DESCR
/end CHARACTERISTIC
/begin CHARACTERISTIC K_DELTADFFMX "Gradientenschwelle des Generator-Lastsignals für Leerlauf-Solldrehzahlanhebung" VALUE 0x8006618A Val_Ws8 127.5 Def_f_sb_b64 -64.00 63.50 /end CHARACTERISTIC
/begin CHARACTERISTIC K_DFFLIM "Schwelle für Generatorlast zum Rücksetzen der Leerlauf-Solldrehzahlanhebung" VALUE 0x8006618B Val_Wu8 99.61 Def_f_ub_b100 0.00 99.61 /end CHARACTERISTIC
/begin CHARACTERISTIC K_DFFLLANH "Schwelle für Generatorlast zum Aktivieren der Leerlauf-Solldrehzahlanhebung" VALUE 0x8006618C Val_Wu8 99.61 Def_f_ub_b100 0.00 99.61 /end CHARACTERISTIC
/begin CHARACTERISTIC K_DFFSCHZMX "Zählerschwelle für Aktivieren der Leerlauf-Solldrehzahlanhebung bei Generatorlastschw." VALUE 0x8006618D Val_Wu8 255. Def_dez_ub_q1 0.00 255. FORMAT "%3.0" /end CHARACTERISTIC
/begin CHARACTERISTIC K_GELIIEAPP "Applikationswert Generatorlastbegrenzung für Leerlaufsolldrehzahlberechnung" VALUE 0x8006618E Val_Wu8 31.875 Def_i_ub_q0p125 0.00 31.875 /end CHARACTERISTIC
/begin CHARACTERISTIC K_GELIIEZK "Zeitkonstante für Filterung Generatorlastsignal (Leerlaufsolldrehzahlberechnung)" VALUE 0x8006618F Val_Wu8 0.99609 Def_f_ub_b1 0.00 0.99609 FORMAT "%7.5" /end CHARACTERISTIC
/begin CHARACTERISTIC K_GELISETAPP "Aoolikationswert Generatorlastbegrenzung für Leerlaufstabilisierung" VALUE 0x80066190 Val_Wu8 1.0 Identity 0.00 1.0 EXTENDED_LIMITS 0.00 255. /end CHARACTERISTIC
/begin CHARACTERISTIC K_GELIVMAX "Maximale Fahrzeuggeschwindigkeit für Generatorlastbegrenzung" VALUE 0x80066192 Val_Wu16 6553.50 Def_v_uw_q0p1 0.00 6553.50 FORMAT "%7.2" /end CHARACTERISTIC
/begin CHARACTERISTIC K_GENMXGRADH "Maximal zulässiger Gradient Chiptemperatur" VALUE 0x8006628A Val_Ws16 6553.5 Def_t_sw_q0p1 -3276.8 3276.7 FORMAT "%6.1" /end CHARACTERISTIC
/begin CHARACTERISTIC K_HTGENDFGRO "Schwelle Generaorauslastung zur E-Lüfteranforderung" VALUE 0x8006628C Val_Wu8 255. Def_st_ub_q1 0.00 255. FORMAT "%3.0" /end CHARACTERISTIC
/begin CHARACTERISTIC K_I_VERTEIL "Stromverteilung" VALUE 0x8006628D Val_Wu8 3.969 Def_f_ub_b4 0.01563 3.984 EXTENDED_LIMITS 0.00 3.984 /end CHARACTERISTIC
/begin CHARACTERISTIC K_LLWDNMAX "Obere Schwelle Drehzahlabweichung im Leerlauf für Erkennung Generatorlastschwankung" VALUE 0x80066194 Val_Ws16 65535. Def_n_sw_q1p0 -32768. 32767. FORMAT "%5.0" /end CHARACTERISTIC
/begin CHARACTERISTIC K_LLWDNMIN "Untere Schwelle Drehzahlabweichung im Leerlauf für Erkennung Generatorlastschwankung" VALUE 0x80066196 Val_Ws16 65535. Def_n_sw_q1p0 -32768. 32767. FORMAT "%5.0" /end CHARACTERISTIC
/begin CHARACTERISTIC K_NGENHTMN1 "Untere Drehzahlschwelle für kritischen Bereich Didentemparatur" VALUE 0x8006628E Val_Ws16 32767. Def_n_sw_q1p0 0.00 32767. FORMAT "%5.0" EXTENDED_LIMITS -32768. 32767. /end CHARACTERISTIC
/begin CHARACTERISTIC K_NGENHTMX1 "Obere Drehzahlschwelle für kritischen Bereich Didentemparatur" VALUE 0x80066290 Val_Ws16 32767. Def_n_sw_q1p0 0.00 32767. FORMAT "%5.0" EXTENDED_LIMITS -32768. 32767. /end CHARACTERISTIC
/begin CHARACTERISTIC K_NMOTLLANH "Motordrehzahlschwelle für Rücksetzen der Leerlaufanhebung Generatorlast" VALUE 0x80066198 Val_Ws16 65535. Def_n_sw_q1p0 -32768. 32767. FORMAT "%5.0" /end CHARACTERISTIC
/begin CHARACTERISTIC K_NSTATLLANH "Schwelle Leerlaufsolldrehzahl zum Aktivieren der Leerlaufanhebung Generatorlast" VALUE 0x8006619A Val_Ws16 65535. Def_n_sw_q1p0 -32768. 32767. FORMAT "%5.0" /end CHARACTERISTIC
/begin CHARACTERISTIC K_PR_IERRLLRED "Prio Erregerstrombegrenzung durch LL Sägen" VALUE 0x8006619C Val_Wu8 255. Def_dez_ub_q1 0.00 255. FORMAT "%3.0" /end CHARACTERISTIC
/begin CHARACTERISTIC K_PR_IERRTRED "Prio Erregerstromanforderung wegen Hochtemperatur" VALUE 0x80066292 Val_Wu8 255. Def_st_ub_q1 0.00 255. FORMAT "%3.0" /end CHARACTERISTIC
/begin CHARACTERISTIC K_PWGLLANH "Fahrpedalwinkel-Schwelle für Rücksetzen der Leerlaufanhebung Generatorlast" VALUE 0x8006619E Val_Ws16 1599.98 Def_wdk_sw_q0p0244 -800.000 799.976 FORMAT "%7.3" /end CHARACTERISTIC
/begin CHARACTERISTIC K_SCHNKWLLRED "Drehzahlgrenze für Aktivierung Sägeerkennung PGENLLRED" VALUE 0x800661A0 Val_Ws16 65535. Def_n_sw_q1p0 -32768. 32767. FORMAT "%5.0" /end CHARACTERISTIC
/begin CHARACTERISTIC K_SCHPWGLLRED "Grenze Pedalwertgeber für Verzögerung B_ll in PGENLLRED" VALUE 0x800661A2 Val_Ws16 1599.98 Def_wdk_sw_q0p0244 -800.000 799.976 FORMAT "%7.3" /end CHARACTERISTIC
/begin CHARACTERISTIC K_TCHIPFIL "Filterkonstante schneller Tchip Filter" VALUE 0x80066294 Val_Wu16 0.9999847412109 Def_f_uw_b1 0.00 0.9999847412109 FORMAT "%15.13" /end CHARACTERISTIC
/begin CHARACTERISTIC K_TDBLLLLRED "Applizierbare Verzögerung B_ll in PGENLLRED" VALUE 0x800661A4 Val_Wu16 655.350 Def_td_uw_q0p01 0.00 655.350 FORMAT "%7.3" /end CHARACTERISTIC
/begin CHARACTERISTIC K_TDFDTMAX "Zeitschwelle zum Erkennen Drehzahlabweichung durch Generatorlastschwankung" VALUE 0x800661A6 Val_Wu16 13107. Def_td_uw_q0p2 0.00 13107. FORMAT "%6.0" /end CHARACTERISTIC
/begin CHARACTERISTIC K_TDFFABLF "Zeitschwelle (Tdffgen) zum Rücksetzen der Leerlaufanhebung" VALUE 0x800661A8 Val_Wu16 13107. Def_td_uw_q0p2 0.00 13107. FORMAT "%6.0" /end CHARACTERISTIC
/begin CHARACTERISTIC K_TDFFMAX "Maximale Periodendauer Generatorlastschwankungen für Leerlaufstabilisierung" VALUE 0x800661AA Val_Wu16 13107. Def_td_uw_q0p2 0.00 13107. FORMAT "%6.0" /end CHARACTERISTIC
/begin CHARACTERISTIC K_TDFFMIN "Minimale Periodendauer Generatorlastschwankungen für Leerlaufstabilisierung" VALUE 0x800661AC Val_Wu16 13107. Def_td_uw_q0p2 0.00 13107. FORMAT "%6.0" /end CHARACTERISTIC
/begin CHARACTERISTIC K_TDNGENKRIT "Verzögerung Generator im kritischen Drehzahlbereich" VALUE 0x80066296 Val_Wu8 255.0 Def_td_ub_q1 0.00 255.0 FORMAT "%5.1" /end CHARACTERISTIC
/begin CHARACTERISTIC K_TDNHOLD "Haltezeit für Bedingung Drehzahlabweichung durch Generatorlastschwankung" VALUE 0x800661AE Val_Wu8 51.0 Def_td_ub_q0p2 0.00 51.0 FORMAT "%4.1" /end CHARACTERISTIC
/begin CHARACTERISTIC K_TDTCHIPKRI "Verzögerung Generatorhochtemperatur" VALUE 0x80066297 Val_Wu8 255.0 Def_td_ub_q1 0.00 255.0 FORMAT "%5.1" /end CHARACTERISTIC
/begin CHARACTERISTIC K_TDTCHIPMX "Verzögerung erhöhte Chiptemperatur" VALUE 0x80066298 Val_Wu8 255. Def_st_ub_q1 0.00 255. FORMAT "%3.0" /end CHARACTERISTIC
/begin CHARACTERISTIC K_TDUBFZMN "Verzögerung Bordnetzschwelle" VALUE 0x80066299 Val_Wu8 255.0 Def_td_ub_q1 0.00 255.0 FORMAT "%5.1" /end CHARACTERISTIC
/begin CHARACTERISTIC K_TFIGENHT "Filterkonstante verteilter Generatorstrom" VALUE 0x8006629A Val_Wu8 0.99219 Def_f_ub_b1 0.0039063 0.99609 FORMAT "%7.5" EXTENDED_LIMITS 0.00 0.99609 /end CHARACTERISTIC
/begin CHARACTERISTIC K_TFTDIODE "Filterkonstante Deltatemparatur Diode" VALUE 0x8006629C Val_Wu16 0.9999694824219 Def_f_uw_b1 0.000015258789063 0.9999847412109 FORMAT "%15.13" EXTENDED_LIMITS 0.00 0.9999847412109 /end CHARACTERISTIC
/begin CHARACTERISTIC K_TGENMXGRAD "Schwellwert für Erkennung mayimaler Gradient" VALUE 0x8006629E Val_Ws16 6553.5 Def_t_sw_q0p1 -3276.8 3276.7 FORMAT "%6.1" /end CHARACTERISTIC
/begin CHARACTERISTIC K_TGENMXTHD "Schwellwert für überhöhte Temparatur Generator" VALUE 0x800662A0 Val_Ws16 6553.5 Def_t_sw_q0p1 -3276.8 3276.7 FORMAT "%6.1" /end CHARACTERISTIC
/begin CHARACTERISTIC K_TGENRSHT "Reset bei unterschrittener Chiptemperatur" VALUE 0x800662A2 Val_Ws16 6553.5 Def_t_sw_q0p1 -3276.8 3276.7 FORMAT "%6.1" /end CHARACTERISTIC
/begin CHARACTERISTIC K_TLCHTEP "Entprellung Hochtemperatur Generator" VALUE 0x800662A4 Val_Wu8 255.0 Def_td_ub_q1 0.00 255.0 FORMAT "%5.1" /end CHARACTERISTIC
/begin CHARACTERISTIC K_TMOTLLANH "Motortemperatur-Schwelle zum Aktivieren der Leerlaufanhebung Generatorlast" VALUE 0x800661B0 Val_Ws16 655.350 Def_t_sw_q0p01 -327.680 327.670 FORMAT "%7.3" /end CHARACTERISTIC
/begin CHARACTERISTIC K_TNSTLLANH "Zeitschwelle nach Startende zum Aktivieren der Leerlaufanhebung Generatorlast" VALUE 0x800661B2 Val_Wu16 655.350 Def_td_uw_q0p01 0.00 655.350 FORMAT "%7.3" /end CHARACTERISTIC
/begin CHARACTERISTIC K_UGENHTMN "Schwellwert Bordnetzspannung Reset Generatorstrombefrenzung durch Hochtemperatur" VALUE 0x800662A6 Val_Wu16 6173.4 Def_u_uw_q0p0942 0.00 6173.4 FORMAT "%6.1" /end CHARACTERISTIC
/begin CHARACTERISTIC K_VFZGGENFIL "Filterkonstante Filterung V" VALUE 0x800661B4 Val_Wu16 0.9999694824219 Def_f_uw_b1 0.000015258789063 0.9999847412109 FORMAT "%15.13" EXTENDED_LIMITS 0.00 0.9999847412109 /end CHARACTERISTIC
/begin CHARACTERISTIC K_VFZGGENKOR "Korrekturfaktor für V" VALUE 0x800661B6 Val_Wu8 7.969 Def_f_ub_b8 0.00 7.969 /end CHARACTERISTIC
/begin CHARACTERISTIC K_VFZGLLANH "Fahrgeschwindigkeits-Schwelle ¨ fur R¨ ucksetzen der Leerlaufanhebung Generatorlast" VALUE 0x800661B8 Val_Wu16 65535. Def_v_uw_q1p0 0.00 65535. FORMAT "%5.0" /end CHARACTERISTIC
/begin CHARACTERISTIC PFltDem_tiDelAftNoSuc_C "Regenerationspause nach nicht erfolgreicher Rgn" VALUE 0x80056070 Val_Ws32 42949672.9500 Time_s 0.00 42949672.9500 EXTENDED_LIMITS -21474836.4800 21474836.4700 /end CHARACTERISTIC
/begin CHARACTERISTIC PFltRgn_aDynMinLim_MAP "Kennfeld minimale Beschleunigung" MAP 0x80056948 Map_Xs16Ys16Ws16 30.00000 Acc 0.00 30.00000 FORMAT "%8.5" EXTENDED_LIMITS -32.76800 32.76700
 /begin AXIS_DESCR STD_AXIS Epm_nEng EngN 6 20.00000 6000.000 EXTENDED_LIMITS -16384.00 16383.50 DEPOSIT ABSOLUTE /end AXIS_DESCR
 /begin AXIS_DESCR STD_AXIS Tra_numGear OneToOne 6 0.00 7.000 EXTENDED_LIMITS -128.0 127.0 DEPOSIT ABSOLUTE /end AXIS_DESCR
/end CHARACTERISTIC
/begin CHARACTERISTIC PFltRgn_ctRgnSubs_C "Ersatzwert für EEPROM-Initialisierung der Anzahl erfolgreicher Partikelfilterregenerationen" VALUE 0x800560C4 Val_Wu16 255.0000 OneToOne 0.00 255.0000 EXTENDED_LIMITS 0.00 65535.00 /end CHARACTERISTIC
/begin CHARACTERISTIC PFltRgn_DebLck.tiHiLo_C "Entprellzeit für maximale Regenerationsdauer/" VALUE 0x800560C6 Kw_Ws16 655350.0 TimeDeb -327680.0 327670.0 /end CHARACTERISTIC
/begin CHARACTERISTIC PFltRgn_DebLck.tiLoHi_C "Entprellzeit für maximale Regenerationsdauer/" VALUE 0x800560C8 Kw_Ws16 655350.0 TimeDeb -327680.0 327670.0 /end CHARACTERISTIC
/begin CHARACTERISTIC PFltRgn_drAccPedDyn_C "Minimale Beschleunigungsschwelle Dynamikerkennung" VALUE 0x800569AC Kw_Ws16 5000.000 PrcPerSec 0.00 5000.000 FORMAT "%8.3" EXTENDED_LIMITS -20000.00 19999.39 /end CHARACTERISTIC
/begin CHARACTERISTIC PFltRgn_drAccPedRawMax_C "Obere Schwelle Beschleunigung über Pedalwert" VALUE 0x800569AE Kw_Ws16 5000.000 PrcPerSec 0.00 5000.000 FORMAT "%8.3" EXTENDED_LIMITS -20000.00 19999.39 /end CHARACTERISTIC
/begin CHARACTERISTIC PFltRgn_drAccPedRawMin_C "Untere Schwelle Beschleunigung über Pedalwert" VALUE 0x800569B0 Kw_Ws16 5000.000 PrcPerSec 0.00 5000.000 FORMAT "%8.3" EXTENDED_LIMITS -20000.00 19999.39 /end CHARACTERISTIC
/begin CHARACTERISTIC PFltRgn_DT1AccPed.T1_C "D-Anteil Dynamik über Pedalwert/" VALUE 0x800569B4 Kw_Ws32 1073.7408240 TimeDelay_s 0.0010000000689 1073.7418240 FORMAT "%12.7" EXTENDED_LIMITS 0.000002000000001 4294.9672960 /end CHARACTERISTIC
/begin CHARACTERISTIC PFltRgn_DT1AccPed.Kd_C "D-Anteil Dynamik über Pedalwert/" VALUE 0x800569B8 Kw_Ws32 1.00000000000 Kd 0.00 1.00000000000 FORMAT "%13.11" EXTENDED_LIMITS -32768.0000000 32767.9999847 /end CHARACTERISTIC
/begin CHARACTERISTIC PFltRgn_facChngRgnDel_CA "Korrekturfaktor für den Grenzwert der Zeitdauer nach einer Änderung des Betriebsarten- bzw. Regenerationsstufenwunsches" VAL_BLK 0x800560CA ValA_Ws16 7.999878 Fact -4.000000 3.999878 NUMBER 7 /end CHARACTERISTIC
/begin CHARACTERISTIC PFltRgn_facDynInjQnt_C "Korrekturfaktor Einspritzmenge" VALUE 0x800569BC Kw_Ws16 2.000000 Fact 0.00 2.000000 EXTENDED_LIMITS -4.000000 3.999878 /end CHARACTERISTIC
/begin CHARACTERISTIC PFltRgn_facFlHighTrm_C "" VALUE 0x8005654C Val_Ws16 2.000000 Fact 0.00 2.000000 EXTENDED_LIMITS -4.000000 3.999878 /end CHARACTERISTIC
/begin CHARACTERISTIC PFltRgn_facFlLowTrm_C "" VALUE 0x8005654E Val_Ws16 2.000000 Fact 0.00 2.000000 EXTENDED_LIMITS -4.000000 3.999878 /end CHARACTERISTIC
/begin CHARACTERISTIC PFltRgn_facFullLdCor_MAP "Korrekturkennfed Volllastbestimmung" MAP 0x800569BE Map_Xs16Ys16Ws16 2.000000 Fact 0.00 2.000000 EXTENDED_LIMITS -4.000000 3.999878
 /begin AXIS_DESCR STD_AXIS VehV_v Vel 8 0.00 327.6700 EXTENDED_LIMITS -327.6800 327.6700 DEPOSIT ABSOLUTE /end AXIS_DESCR
 /begin AXIS_DESCR STD_AXIS Tra_numGear OneToOne 8 0.00 7.000 EXTENDED_LIMITS -128.0 127.0 DEPOSIT ABSOLUTE /end AXIS_DESCR
/end CHARACTERISTIC
/begin CHARACTERISTIC PFltRgn_facNO2RgnPrtMax_CUR "NO2 Bewertungsfaktor für Motorschutzregenerationsschwellen" CURVE 0x80056550 Cur_Xs16Ws16 1.000000 Fact 0.00 1.000000 EXTENDED_LIMITS -4.000000 3.999878
 /begin AXIS_DESCR STD_AXIS PFltLd_facNO2Rgn Fact 10 0.00 1.000000 EXTENDED_LIMITS -4.000000 3.999878 DEPOSIT ABSOLUTE /end AXIS_DESCR
/end CHARACTERISTIC
/begin CHARACTERISTIC PFltRgn_facSumHighTrm_C "" VALUE 0x8005657A Val_Ws16 2.000000 Fact 0.00 2.000000 EXTENDED_LIMITS -4.000000 3.999878 /end CHARACTERISTIC
/begin CHARACTERISTIC PFltRgn_facSumLowTrm_C "" VALUE 0x8005657C Val_Ws16 2.000000 Fact 0.00 2.000000 EXTENDED_LIMITS -4.000000 3.999878 /end CHARACTERISTIC
/begin CHARACTERISTIC PFltRgn_facTiNO2RgnPrtMax_CUR "NO2 Bewertungsfaktor für Motorschutzregenerationsschwellen" CURVE 0x8005657E Cur_Xs16Ws16 1.000000 Fact 0.00 1.000000 EXTENDED_LIMITS -4.000000 3.999878
 /begin AXIS_DESCR STD_AXIS PFltLd_tiNO2Rgn Time_TempSnceRgn16 10 0.00 2684360. FORMAT "%8.0" EXTENDED_LIMITS -1310720. 1310680. DEPOSIT ABSOLUTE /end AXIS_DESCR
/end CHARACTERISTIC
/begin CHARACTERISTIC PFltRgn_lSnceRgnIntr_CA "Gefahrene Abstandsschwelle für sperren Regenerationsunterbrechung" VAL_BLK 0x80056074 ValA_Ws32 2147483647.00 Length 0.00 2147483647.00 FORMAT "%13.2" EXTENDED_LIMITS -2147483648.00 2147483647.00 NUMBER 10 /end CHARACTERISTIC
/begin CHARACTERISTIC PFltRgn_lSumMaxDef_C "Gefahrene Entfernungsschwelle der Regeneration beim Fehlerfall" VALUE 0x800565A8 Val_Ws32 4294967295.00 Length -2147483648.00 2147483647.00 FORMAT "%13.2" /end CHARACTERISTIC
/begin CHARACTERISTIC PFltRgn_lSumMax_MAP "map fuer maximale Strecke seit letzter erfolgreicher regeneration" MAP 0x800565AC Map_Xs16Ys16Ws16 4194176. lSnceRgnRes 0.00 4194176. FORMAT "%8.0" EXTENDED_LIMITS -4194304. 4194176.
 /begin AXIS_DESCR STD_AXIS PFltRgn_vAvrgSnceRgn_mp Vel 12 0.00 200.0000 EXTENDED_LIMITS -327.6800 327.6700 DEPOSIT ABSOLUTE /end AXIS_DESCR
 /begin AXIS_DESCR STD_AXIS PFltRgn_lAvrgSnceRgn_mp lSnceRgnRes 10 0.00 499968.0 FORMAT "%8.1" EXTENDED_LIMITS -4194304. 4194176. DEPOSIT ABSOLUTE /end AXIS_DESCR
/end CHARACTERISTIC
/begin CHARACTERISTIC PFltRgn_lSumSubs_C "Ersatzwert für gefahrene Strecke im Fall eines Eeprom lese Fehlers" VALUE 0x800566CC Val_Ws32 4294967295.00 Length -2147483648.00 2147483647.00 FORMAT "%13.2" /end CHARACTERISTIC
/begin CHARACTERISTIC PFltRgn_mskLckRgnOilDil_C "Maske zur Erkennung ölverdünnender Regenerationsstufen" VALUE 0x800560D8 Val_Wu32 2147483647.00 OneToOne 0.00 2147483647.00 EXTENDED_LIMITS 0.00 4294967295.00 /end CHARACTERISTIC
/begin CHARACTERISTIC PFltRgn_mSotMeas_CUR "Umrechnung Strömungswiederstand der Partikelmasse" CURVE 0x800566D0 Cur_Xs16Ws16 300.0000 mSoot_g 0.00 300.0000 FORMAT "%8.4" EXTENDED_LIMITS -327.6800 327.6700
 /begin AXIS_DESCR STD_AXIS PFltRgn_resFlwOfs_mp Res_hPaHrPerCM 8 0.00 2.500000 FORMAT "%8.6" EXTENDED_LIMITS -3.276800 3.276700 DEPOSIT ABSOLUTE /end AXIS_DESCR
/end CHARACTERISTIC
/begin CHARACTERISTIC PFltRgn_mSotRngDwn_CA "Übergangsgrenzen für Wechsel in niedrigere Beladungszustände" VAL_BLK 0x800566F2 ValA_Ws16 300.0000 mSoot_g 0.00 300.0000 FORMAT "%8.4" EXTENDED_LIMITS -327.6800 327.6700 NUMBER 10 /end CHARACTERISTIC
/begin CHARACTERISTIC PFltRgn_mSotRngUp_CA "Übergangsgrenzen für Wechsel in höhere Beladungszustände" VAL_BLK 0x80056706 ValA_Ws16 300.0000 mSoot_g 0.00 300.0000 FORMAT "%8.4" EXTENDED_LIMITS -327.6800 327.6700 NUMBER 10 /end CHARACTERISTIC
/begin CHARACTERISTIC PFltRgn_numEngPOpDel_CA "Verzögert wirksame Bewertungsmatrix der Regenerationsanforderungszahl und Motorzustand für unterbrochene Regeneration" MAP 0x800560DC Map_Xs16Ys16Ws16 65535.00 OneToOne -32768.00 32767.00
 /begin AXIS_DESCR STD_AXIS PFltPOp_stEngPOp OneToOne 12 0.00 255.0 DEPOSIT ABSOLUTE /end AXIS_DESCR
 /begin AXIS_DESCR STD_AXIS PFltRgn_numRgn_mp OneToOne 9 0.00 255.0 DEPOSIT ABSOLUTE /end AXIS_DESCR
/end CHARACTERISTIC
/begin CHARACTERISTIC PFltRgn_numEngPOpIntr_CA "Bewertungsmatrix der Regenerationsanforderungszahl und Motorzustand für unterbrochene Regeneration" MAP 0x800561E2 Map_Xs16Ys16Ws16 65535.00 OneToOne -32768.00 32767.00
 /begin AXIS_DESCR STD_AXIS PFltPOp_stEngPOp OneToOne 12 0.00 255.0 DEPOSIT ABSOLUTE /end AXIS_DESCR
 /begin AXIS_DESCR STD_AXIS PFltRgn_numRgn_mp OneToOne 9 0.00 255.0 DEPOSIT ABSOLUTE /end AXIS_DESCR
/end CHARACTERISTIC
/begin CHARACTERISTIC PFltRgn_numEngPOp_CA "Bewertungsmatrix der Regenerationsanforderungszahl und Motorzustand" MAP 0x800562E8 Map_Xs16Ys16Ws16 65535.00 OneToOne -32768.00 32767.00
 /begin AXIS_DESCR STD_AXIS PFltPOp_stEngPOp OneToOne 12 0.00 255.0 DEPOSIT ABSOLUTE /end AXIS_DESCR
 /begin AXIS_DESCR STD_AXIS PFltRgn_numRgn_mp OneToOne 9 0.00 255.0 DEPOSIT ABSOLUTE /end AXIS_DESCR
/end CHARACTERISTIC
/begin CHARACTERISTIC PFltRgn_numHCCond_C "Regenerationsanforderung für Block ¿HC Conditionierung¿" VALUE 0x8005671A Val_Wu8 255.0 OneToOne 0.00 255.0 /end CHARACTERISTIC
/begin CHARACTERISTIC PFltRgn_numLst_C "Regenerationsanfoderung wegen Kraftstoffverbrauch, Betriebsdauer oder Strecke" VALUE 0x8005671B Val_Wu8 255.0 OneToOne 0.00 255.0 /end CHARACTERISTIC
/begin CHARACTERISTIC PFltRgn_numPFltErrRgnIntr_C "" VALUE 0x8005671C Val_Wu8 9.000 OneToOne 0.00 9.000 EXTENDED_LIMITS 0.00 255.0 /end CHARACTERISTIC
/begin CHARACTERISTIC PFltRgn_numPFltErr_C "" VALUE 0x8005671D Val_Wu8 9.000 OneToOne 0.00 9.000 EXTENDED_LIMITS 0.00 255.0 /end CHARACTERISTIC
/begin CHARACTERISTIC PFltRgn_numPrt_C "Regenerationsanforderung wegen Motorschut" VALUE 0x8005671E Val_Wu8 255.0 OneToOne 0.00 255.0 /end CHARACTERISTIC
/begin CHARACTERISTIC PFltRgn_numRgnSuc_C "Größte Regenerationsanforderungszahl, ab der eine erfolgreiche Regeneration erkannt wird" VALUE 0x800563EE Val_Wu8 100.0 OneToOne 0.00 100.0 EXTENDED_LIMITS 0.00 255.0 /end CHARACTERISTIC
/begin CHARACTERISTIC PFltRgn_numRgnTxtMsg_C "Minimal Regenerationsanforderung für Text-Botschaft" VALUE 0x800563EF Val_Wu8 255.0 OneToOne 0.00 255.0 /end CHARACTERISTIC
/begin CHARACTERISTIC PFltRgn_numTRgnMin_C "Enumerator zur Auswahl der Temperatur für Bewertung Wirkungsgrdabhängige Regenerationsdauer" VALUE 0x8005671F Val_Wu8 255.0 OneToOne 0.00 255.0 /end CHARACTERISTIC
/begin CHARACTERISTIC PFltRgn_pEngPrtAshCor_MAP "Aschekorrektur für Motorschutzregenerationsschwellen" MAP 0x80056720 Map_Xs16Ys16Ws16 36268.00 Pres_hPa -32768.00 3500.00 EXTENDED_LIMITS -32768.00 32767.00
 /begin AXIS_DESCR STD_AXIS Epm_nEng EngN 2 20.00000 10000.00 EXTENDED_LIMITS -16384.00 16383.50 DEPOSIT ABSOLUTE /end AXIS_DESCR
 /begin AXIS_DESCR STD_AXIS InjCtl_qSetUnBal InjMass 2 0.00 327.6700 EXTENDED_LIMITS -327.6800 327.6700 DEPOSIT ABSOLUTE /end AXIS_DESCR
/end CHARACTERISTIC
/begin CHARACTERISTIC PFltRgn_pEngPrtMaxInit_C "Initialisierungswert des PT1-Filters für den Maximalwert im Motorschutz" VALUE 0x80056734 Val_Ws16 3500.000 Pres_hPa 0.00 3500.000 EXTENDED_LIMITS -32768.00 32767.00 /end CHARACTERISTIC
/begin CHARACTERISTIC PFltRgn_pEngPrtMax_MAP "Obere Druckschwelle Motorschutz" MAP 0x80056736 Map_Xs16Ys16Ws16 3500.000 Pres_hPa 0.00 3500.000 EXTENDED_LIMITS -32768.00 32767.00
 /begin AXIS_DESCR STD_AXIS Epm_nEng EngN 2 20.00000 10000.00 EXTENDED_LIMITS -16384.00 16383.50 DEPOSIT ABSOLUTE /end AXIS_DESCR
 /begin AXIS_DESCR STD_AXIS InjCtl_qSetUnBal InjMass 2 0.00 327.6700 EXTENDED_LIMITS -327.6800 327.6700 DEPOSIT ABSOLUTE /end AXIS_DESCR
/end CHARACTERISTIC
/begin CHARACTERISTIC PFltRgn_pEngPrtMin_MAP "Untere Druckschwelle Motorschutz" MAP 0x8005674A Map_Xs16Ys16Ws16 3500.000 Pres_hPa 0.00 3500.000 EXTENDED_LIMITS -32768.00 32767.00
 /begin AXIS_DESCR STD_AXIS Epm_nEng EngN 2 20.00000 10000.00 EXTENDED_LIMITS -16384.00 16383.50 DEPOSIT ABSOLUTE /end AXIS_DESCR
 /begin AXIS_DESCR STD_AXIS InjCtl_qSetUnBal InjMass 2 0.00 327.6700 EXTENDED_LIMITS -327.6800 327.6700 DEPOSIT ABSOLUTE /end AXIS_DESCR
/end CHARACTERISTIC
/begin CHARACTERISTIC PFltRgn_qFlMaxDef_C "Kraftstoffverbrauchsschwelle für Regeneration im Falles eines Fehlers" VALUE 0x8005675E Val_Ws16 320.0000 Fl_L 0.00 320.0000 FORMAT "%8.4" EXTENDED_LIMITS -327.6800 327.6700 /end CHARACTERISTIC
/begin CHARACTERISTIC PFltRgn_qFlMax_C "Schwelle für den Kraftstoffverbrauch seit der letzten erfolgreichen Regeneration" VALUE 0x80056760 Val_Ws16 320.0000 Fl_L 0.00 320.0000 FORMAT "%8.4" EXTENDED_LIMITS -327.6800 327.6700 /end CHARACTERISTIC
/begin CHARACTERISTIC PFltRgn_qFlSubs_C "Ersatzwert für EEPROM-Initialisierung der seit der letzten erfolgreichen Regeneration verbrauchten Kraftstoffmenge" VALUE 0x80056762 Val_Ws16 320.0000 Fl_L 0.00 320.0000 FORMAT "%8.4" EXTENDED_LIMITS -327.6800 327.6700 /end CHARACTERISTIC
/begin CHARACTERISTIC PFltRgn_rAccPedDynMin_C "Minimaler Pedalwert zur Dynamikerkennung" VALUE 0x80056A62 Kw_Ws16 100.0000 Prc 0.00 100.0000 EXTENDED_LIMITS -400.0000 399.9878 /end CHARACTERISTIC
/begin CHARACTERISTIC PFltRgn_resFlwEngPrtCor_MAP "Aschekorrektur für Motorschutzregenerationsschwellen" MAP 0x80056764 Map_Xs16Ys16Ws16 2.500000 Res_hPaHrPerCM 0.00 2.500000 FORMAT "%8.6" EXTENDED_LIMITS -3.276800 3.276700
 /begin AXIS_DESCR STD_AXIS Epm_nEng EngN 2 20.00000 10000.00 EXTENDED_LIMITS -16384.00 16383.50 DEPOSIT ABSOLUTE /end AXIS_DESCR
 /begin AXIS_DESCR STD_AXIS InjCtl_qSetUnBal InjMass 2 0.00 327.6700 EXTENDED_LIMITS -327.6800 327.6700 DEPOSIT ABSOLUTE /end AXIS_DESCR
/end CHARACTERISTIC
/begin CHARACTERISTIC PFltRgn_resFlwEngPrtMaxInit_C "Initialisierungswert für Maximum Motorschutzregeneratonsschwelle PT1 Filter" VALUE 0x80056778 Val_Ws16 6.553500 Res_hPaHrPerCM -3.276800 3.276700 FORMAT "%8.6" /end CHARACTERISTIC
/begin CHARACTERISTIC PFltRgn_resFlwEngPrtMax_MAP "Maximum Motorschutzregeneratonsschwelle" MAP 0x8005677A Map_Xs16Ys16Ws16 2.500000 Res_hPaHrPerCM 0.00 2.500000 FORMAT "%8.6" EXTENDED_LIMITS -3.276800 3.276700
 /begin AXIS_DESCR STD_AXIS Epm_nEng EngN 8 20.00000 10000.00 EXTENDED_LIMITS -16384.00 16383.50 DEPOSIT ABSOLUTE /end AXIS_DESCR
 /begin AXIS_DESCR STD_AXIS InjCtl_qSetUnBal InjMass 8 0.00 327.6700 EXTENDED_LIMITS -327.6800 327.6700 DEPOSIT ABSOLUTE /end AXIS_DESCR
/end CHARACTERISTIC
/begin CHARACTERISTIC PFltRgn_resFlwEngPrtMin_MAP "Minimum Motorschutzregeneratonsschwelle" MAP 0x8005681E Map_Xs16Ys16Ws16 2.500000 Res_hPaHrPerCM 0.00 2.500000 FORMAT "%8.6" EXTENDED_LIMITS -3.276800 3.276700
 /begin AXIS_DESCR STD_AXIS Epm_nEng EngN 8 20.00000 10000.00 EXTENDED_LIMITS -16384.00 16383.50 DEPOSIT ABSOLUTE /end AXIS_DESCR
 /begin AXIS_DESCR STD_AXIS InjCtl_qSetUnBal InjMass 8 0.00 327.6700 EXTENDED_LIMITS -327.6800 327.6700 DEPOSIT ABSOLUTE /end AXIS_DESCR
/end CHARACTERISTIC
/begin CHARACTERISTIC PFltRgn_rFullLdBas_MAP "Kennfeld zur Volllasterkennung" MAP 0x80056A64 Map_Xs16Ys16Ws16 100.0000 Prc 0.00 100.0000 EXTENDED_LIMITS -400.0000 399.9878
 /begin AXIS_DESCR STD_AXIS Epm_nEng EngN 8 20.00000 6000.000 EXTENDED_LIMITS -16384.00 16383.50 DEPOSIT ABSOLUTE /end AXIS_DESCR
 /begin AXIS_DESCR STD_AXIS InjCtl_qSetUnBal InjMass 8 0.00 327.6700 EXTENDED_LIMITS -327.6800 327.6700 DEPOSIT ABSOLUTE /end AXIS_DESCR
/end CHARACTERISTIC
/begin CHARACTERISTIC PFltRgn_rFullLdMax_C "obere Schwelle Volllasterkennung" VALUE 0x80056B08 Kw_Ws16 100.0000 Prc 0.00 100.0000 EXTENDED_LIMITS -400.0000 399.9878 /end CHARACTERISTIC
/begin CHARACTERISTIC PFltRgn_rFullLdMin_C "Untere Schwelle Volllasterkennung" VALUE 0x80056B0A Kw_Ws16 100.0000 Prc 0.00 100.0000 EXTENDED_LIMITS -400.0000 399.9878 /end CHARACTERISTIC
/begin CHARACTERISTIC PFltRgn_stHCCondActvMsk_C "Maskierung Aktive HC Konditionierung" VALUE 0x800568C4 Val_Wu32 4294967295.00 OneToOne 0.00 4294967295.00 /end CHARACTERISTIC
/begin CHARACTERISTIC PFltRgn_stLckFlMsk_C "Maske für PFltRgn_numTot" VALUE 0x8005609C Kw_Wu16 65535.00 OneToOne 0.00 65535.00 /end CHARACTERISTIC
/begin CHARACTERISTIC PFltRgn_stLckOpMode_C "Betriebsanforderungsbitwort gesperrte Regeneration (besteht aus Regenerationsstufe, Prioritätszahl und Betriebsartfreigabe)" VALUE 0x800563F0 Val_Wu32 2147483647.00 OneToOne 0.00 2147483647.00 EXTENDED_LIMITS 0.00 4294967295.00 /end CHARACTERISTIC
/begin CHARACTERISTIC PFltRgn_stLckRgnMsk_C "Maske für die Regenerationssperre und die Freigabe" VALUE 0x800563F4 Val_Wu32 4294967295.00 OneToOne 0.00 4294967295.00 /end CHARACTERISTIC
/begin CHARACTERISTIC PFltRgn_stMinDistRgn_C "Maske zur Aktivierung des Regenerationsabbruchs bei niedrigen Anforderungen" VALUE 0x8005609E Val_Wu16 65535.00 OneToOne 0.00 65535.00 /end CHARACTERISTIC
/begin CHARACTERISTIC PFltRgn_stOpModeAct_CA "Array mit aktueller Betriebsarten für die Direktsprungsbedingung" VAL_BLK 0x800563F8 ValA_Wu32 4294967295.00 OneToOne 0.00 4294967295.00 NUMBER 3 /end CHARACTERISTIC
/begin CHARACTERISTIC PFltRgn_stOpModeDes_CA "Array mit gewünschter Betriebsarten für die Direktsprungsbedingung" VAL_BLK 0x80056404 ValA_Wu32 4294967295.00 OneToOne 0.00 4294967295.00 NUMBER 3 /end CHARACTERISTIC
/begin CHARACTERISTIC PFltRgn_stRgnActvMsk_C "Maske für DPF Regenerationszeit relevante Abgasnachbehandlungszustand" VALUE 0x800568C8 Val_Wu32 4294967295.00 OneToOne 0.00 4294967295.00 /end CHARACTERISTIC
/begin CHARACTERISTIC PFltRgn_stRgnJmpMsk_C "Maske Sprungbedinungserkennung" VALUE 0x80056B0C Kw_Wu8 255.0 OneToOne 0.00 255.0 /end CHARACTERISTIC
/begin CHARACTERISTIC PFltRgn_stRgnNoCmplnSubs_C "Ersatzwert für EEPROM-Initialisierung der Status Regeneration nicht erfolgreich beendet" VALUE 0x80056410 Val_Wu8 1.000 OneToOne 0.00 1.000 EXTENDED_LIMITS 0.00 255.0 /end CHARACTERISTIC
/begin CHARACTERISTIC PFltRgn_stRgnOpMode_CA "Array mit erforderlicher Betriebsart gemäß Regenerationsanforderung und Motorzustand" VAL_BLK 0x80056414 ValA_Wu32 4294967295.00 OneToOne 0.00 4294967295.00 NUMBER 11 /end CHARACTERISTIC
/begin CHARACTERISTIC PFltRgn_stRgnSucMsk_C "" VALUE 0x80056440 Val_Wu16 63.00000 OneToOne 0.00 63.00000 EXTENDED_LIMITS 0.00 65535.00 /end CHARACTERISTIC
/begin CHARACTERISTIC PFltRgn_stSysFailMsk_C "Bitmaske zur Auswahl der Regenerationsunterbrechung auslösenden Systemfehler" VALUE 0x800560A0 Kw_Wu8 255.0 OneToOne 0.00 255.0 /end CHARACTERISTIC
/begin CHARACTERISTIC PFltRgn_swtAshCor_C "Schalter um die Partikelmassen-Modellschwellewerte zu korregieren" VALUE 0x800568CC Val_Wu8 1.000 OneToOne 0.00 1.000 EXTENDED_LIMITS 0.00 255.0 /end CHARACTERISTIC
/begin CHARACTERISTIC PFltRgn_swtCntAshCor_C "Schalter zur Berüchsichtigung des Aschekorrekturfaktors beim Überprüfen der Bedingungen für Regenerationsanforderung nach Kraftstoffverbrauch, Betriebsstunden und gefahrener Strecke" VALUE 0x800568CD Val_Wu8 1.000 OneToOne 0.00 1.000 EXTENDED_LIMITS 0.00 255.0 /end CHARACTERISTIC
/begin CHARACTERISTIC PFltRgn_swtDynDetSmkLimOn_C "Schalter Berücksichtigung Rauchbegrenzung bei Dynamikerkennung" VALUE 0x80056B0D Kw_Wu8 1.000 OneToOne 0.00 1.000 EXTENDED_LIMITS 0.00 255.0 /end CHARACTERISTIC
/begin CHARACTERISTIC PFltRgn_swtEngPrtAshCor_C "Aktivierung Aschekorrektur für Motorschutzregenerationsschwellen" VALUE 0x800568CE Val_Wu8 1.000 OneToOne 0.00 1.000 EXTENDED_LIMITS 0.00 255.0 /end CHARACTERISTIC
/begin CHARACTERISTIC PFltRgn_swtFacTiNO2Rgn_C "Auswahl NO2 Bewertungsfaktor für Motorschutzregenerationsschwellen" VALUE 0x800568CF Val_Wu8 1.000 OneToOne 0.00 1.000 EXTENDED_LIMITS 0.00 255.0 /end CHARACTERISTIC
/begin CHARACTERISTIC PFltRgn_swtHCCondActv_C "" VALUE 0x800568D0 Val_Wu8 1.000 OneToOne 0.00 1.000 EXTENDED_LIMITS 0.00 255.0 /end CHARACTERISTIC
/begin CHARACTERISTIC PFltRgn_swtMsSotRngDwnCor_C "Bitwort-Schalter zur Berücksichtigung des Aschekorrekturfaktors beim Überprüfen der Übergangsgrenzen für Wechsel in niedrigere Beladungszustände" VALUE 0x800568D2 Val_Wu16 63.00000 OneToOne 0.00 63.00000 EXTENDED_LIMITS 0.00 65535.00 /end CHARACTERISTIC
/begin CHARACTERISTIC PFltRgn_swtMsSotRngUpCor_C "Bitwort-Schalter zur Berücksichtigung des Aschekorrekturfaktors beim Überprüfen der Übergangsgrenzen für Wechsel in höhere Beladungszustände" VALUE 0x800568D4 Val_Wu16 63.00000 OneToOne 0.00 63.00000 EXTENDED_LIMITS 0.00 65535.00 /end CHARACTERISTIC
/begin CHARACTERISTIC PFltRgn_swtNoSucDetActv_C "Erkennung nicht erfolgreiche Regeneration" VALUE 0x800568D6 Kw_Wu8 255.0 OneToOne 0.00 255.0 /end CHARACTERISTIC
/begin CHARACTERISTIC PFltRgn_swtOfsCor_C "Schalter um die Offset Korrektur in der Zustandsmachine auszuschalten" VALUE 0x800568D7 Val_Wu8 1.000 OneToOne 0.00 1.000 EXTENDED_LIMITS 0.00 255.0 /end CHARACTERISTIC
/begin CHARACTERISTIC PFltRgn_swtPresResFlowSel_C "Motorschutzregeneration nach ResFlow/pDiff" VALUE 0x800568D8 Val_Wu8 1.000 OneToOne 0.00 1.000 EXTENDED_LIMITS 0.00 255.0 /end CHARACTERISTIC
/begin CHARACTERISTIC PFltRgn_swtRgnSuc_C "" VALUE 0x80056442 Kw_Wu8 1.000 OneToOne 0.00 1.000 EXTENDED_LIMITS 0.00 255.0 /end CHARACTERISTIC
/begin CHARACTERISTIC PFltRgn_swtShOffSucAshCor_C "" VALUE 0x80056443 Kw_Wu8 1.000 OneToOne 0.00 1.000 EXTENDED_LIMITS 0.00 255.0 /end CHARACTERISTIC
/begin CHARACTERISTIC PFltRgn_swtTmrLckRst_C "Schalter zum Rücksetzen des EEPROM-Werts des Zählerstandes zur Sperrung der Regeneration" VALUE 0x80056444 Kw_Wu8 1.000 OneToOne 0.00 1.000 EXTENDED_LIMITS 0.00 255.0 /end CHARACTERISTIC
/begin CHARACTERISTIC PFltRgn_tCEngHCOffEna_C "" VALUE 0x800568DA Val_Ws16 6553.500 Temp_Cels -3549.940 3003.560 /end CHARACTERISTIC
/begin CHARACTERISTIC PFltRgn_tiAccPedPT1_C "P-Anteil Pedalwertänderung" VALUE 0x80056B0E Kw_Ws16 1073.7408240 TimeDelay_s 0.0010000000689 1073.7418240 FORMAT "%12.7" EXTENDED_LIMITS 0.13107600012 4294.9672960 /end CHARACTERISTIC
/begin CHARACTERISTIC PFltRgn_tiChngRgnDelBas_MAP "Maximale Verzögerungszeit nach Änderung des Betriebsartenwunsches abhängig von Motorsbetriebszustand" MAP 0x80056446 Map_Xs16Ys16Ws16 655.3500 Time_s -327.6800 327.6700
 /begin AXIS_DESCR STD_AXIS Epm_nEng EngN 8 20.00000 10000.00 EXTENDED_LIMITS -16384.00 16383.50 DEPOSIT ABSOLUTE /end AXIS_DESCR
 /begin AXIS_DESCR STD_AXIS InjCtl_qSetUnBal InjMass 8 0.00 327.6700 EXTENDED_LIMITS -327.6800 327.6700 DEPOSIT ABSOLUTE /end AXIS_DESCR
/end CHARACTERISTIC
/begin CHARACTERISTIC PFltRgn_tiDebPOp.tiHiLo_C "/" VALUE 0x800564EA Kw_Ws16 655350.0 TimeDeb -327680.0 327670.0 /end CHARACTERISTIC
/begin CHARACTERISTIC PFltRgn_tiDebPOp.tiLoHi_C "/" VALUE 0x800564EC Kw_Ws16 655350.0 TimeDeb -327680.0 327670.0 /end CHARACTERISTIC
/begin CHARACTERISTIC PFltRgn_tiDebQLimErrIntr_C "Entprellzeit für Regenerationsunterbrechung aufgrund der Mengenbegrenzung" VALUE 0x800560A4 Kw_Ws32 1043741820.00 TimeDeb 0.00 1043741820.00 EXTENDED_LIMITS -21474836480.0 21474836470.0 /end CHARACTERISTIC
/begin CHARACTERISTIC PFltRgn_tiDebTrqOvhtIntr_C "Entprellzeit für Regenerationsunterbrechung aufgrund des Überhitzungsschutzes" VALUE 0x800560A8 Kw_Ws16 1043741820. TimeDeb 0.00 1043741820. EXTENDED_LIMITS -327680.0 327670.0 /end CHARACTERISTIC
/begin CHARACTERISTIC PFltRgn_tiEngOnMaxDef_C "Motorbetriebszeitschwelle für Regeneration im Falle eines Fehlers" VALUE 0x800568DC Val_Ws32 4294967295.00 TimeEngOn -2147483648.00 2147483647.00 FORMAT "%13.2" /end CHARACTERISTIC
/begin CHARACTERISTIC PFltRgn_tiEngOnMax_C "Motorbetriebszeitschwelle für Regeneration" VALUE 0x800568E0 Val_Ws32 4294967295.00 TimeEngOn -2147483648.00 2147483647.00 FORMAT "%13.2" /end CHARACTERISTIC
/begin CHARACTERISTIC PFltRgn_tiEngPrtDeb_C "Dauer der Regeneration, die durch die Motorschutzfunktion ausgelöst wird" VALUE 0x800568E4 Val_Ws16 655350.0 TimeDeb -327680.0 327670.0 /end CHARACTERISTIC
/begin CHARACTERISTIC PFltRgn_tiEngPrtPT1_C "Zeitkonstant für das PT1 Element des Motorschutz" VALUE 0x800568E8 Val_Ws32 4294.9672940 TimeDelay_s 0.000002000000001 4294.9672960 FORMAT "%12.7" /end CHARACTERISTIC
/begin CHARACTERISTIC PFltRgn_tiEngPrt_C "Regenerationsanforderung wegen Motorschutz" VALUE 0x800568EC Val_Ws32 21474836.4700 Time_s 0.00 21474836.4700 EXTENDED_LIMITS -21474836.4800 21474836.4700 /end CHARACTERISTIC
/begin CHARACTERISTIC PFltRgn_tiHCCond_C "Regenerationszeit für die HC Conditionierung" VALUE 0x800568F0 Kw_Ws32 42949672.9500 Time_s -21474836.4800 21474836.4700 /end CHARACTERISTIC
/begin CHARACTERISTIC PFltRgn_tiHCCond_CUR "" CURVE 0x800568F4 Cur_Xs16Ws16 1800.000 Time_s_Resolution100ms 0.00 1800.000 FORMAT "%8.3" EXTENDED_LIMITS -3276.800 3276.700
 /begin AXIS_DESCR STD_AXIS EnvT_t Temp_Cels 10 -3549.940 3003.560 DEPOSIT ABSOLUTE /end AXIS_DESCR
/end CHARACTERISTIC
/begin CHARACTERISTIC PFltRgn_tiKpRgnOvrRun_C "Dauer zum Bewahren von Regeneration im Schub" VALUE 0x800560AC Kw_Ws32 42949672.9500 Time_s 0.00 42949672.9500 EXTENDED_LIMITS -21474836.4800 21474836.4700 /end CHARACTERISTIC
/begin CHARACTERISTIC PFltRgn_tiLckRgnErr_CA "Sperrzeit nach maximaler Regenerationsdauer überschritten im Falle eines Fehler, abhängig von dem Regenerationszustand" VAL_BLK 0x800564F0 ValA_Ws32 42949672.9500 Time_s -21474836.4800 21474836.4700 NUMBER 7 /end CHARACTERISTIC
/begin CHARACTERISTIC PFltRgn_tiLckRgn_CA "Sperrzeit nach maximaler Regenerationsdauer überschritten, abhängig vom Regenerationszustand" VAL_BLK 0x8005650C ValA_Ws32 42949672.9500 Time_s -21474836.4800 21474836.4700 NUMBER 7 /end CHARACTERISTIC
/begin CHARACTERISTIC PFltRgn_tiLckSubs_C "Ersatzwert für EEPROM-Initialisierung des Timers für Regenerationsperre" VALUE 0x80056528 Kw_Ws32 21474836.4700 Time_s 0.00 21474836.4700 EXTENDED_LIMITS -21474836.4800 21474836.4700 /end CHARACTERISTIC
/begin CHARACTERISTIC PFltRgn_tiLstRgnRstrt_C "Minimale Regenerationszeit nach abgebrochener Regeneration" VALUE 0x80056920 Val_Ws32 21474836.4700 Time_s 0.00 21474836.4700 EXTENDED_LIMITS -21474836.4800 21474836.4700 /end CHARACTERISTIC
/begin CHARACTERISTIC PFltRgn_tiLstRgn_C "Dauer der Regenerations wegen Kraftstoffverbrauch, Betriebsdauer oder Strecke" VALUE 0x80056924 Val_Ws32 21474836.4700 Time_s 0.00 21474836.4700 EXTENDED_LIMITS -21474836.4800 21474836.4700 /end CHARACTERISTIC
/begin CHARACTERISTIC PFltRgn_tiOpSubs_C "Ersatzwert für EEPROM-Initialisierung der Betriebsdauer seit der letzten erfolgreichen Regeneration" VALUE 0x80056928 Val_Ws32 4294967295.00 TimeEngOn -2147483648.00 2147483647.00 FORMAT "%13.2" /end CHARACTERISTIC
/begin CHARACTERISTIC PFltRgn_tiPFltErrPer_C "" VALUE 0x8005692C Val_Wu16 655350.0 TimePFltLimpHome 0.00 655350.0 FORMAT "%8.1" /end CHARACTERISTIC
/begin CHARACTERISTIC PFltRgn_tiPFltErrRgn_C "" VALUE 0x8005692E Val_Wu16 655350.0 TimePFltLimpHome 0.00 655350.0 FORMAT "%8.1" /end CHARACTERISTIC
/begin CHARACTERISTIC PFltRgn_tiRgnMax_CA "Array mit maximalen Regenerationszeiten" VAL_BLK 0x8005652C ValA_Ws32 42949672.9500 Time_s -21474836.4800 21474836.4700 NUMBER 7 /end CHARACTERISTIC
/begin CHARACTERISTIC PFltRgn_tiRgnMinRstrt_C "Minimale Regenerationszeit mit Berücksichtigung Rgnwirkungsgrad nach abgebrochener Regeneration" VALUE 0x80056930 Val_Ws32 21474836.4700 Time_s 0.00 21474836.4700 EXTENDED_LIMITS -21474836.4800 21474836.4700 /end CHARACTERISTIC
/begin CHARACTERISTIC PFltRgn_tiRgnMinSubs_C "Minimale Regenerationszeit mit Berücksichtigung Rgnwirkungsgrad nach abgebrochener Regeneration bei EEPROM Fehler" VALUE 0x80056934 Val_Ws32 42949672.9500 Time_s -21474836.4800 21474836.4700 /end CHARACTERISTIC
/begin CHARACTERISTIC PFltRgn_tiRgnMin_C "Notwendige Regenerationsszeit mit optimalem Regenerationswirkungsgrad" VALUE 0x80056938 Kw_Ws32 42949672.9500 Time_s -21474836.4800 21474836.4700 /end CHARACTERISTIC
/begin CHARACTERISTIC PFltRgn_tiRgnSpo_C "Regenerationszeit für die Erkennung einer spontanen Regeneration" VALUE 0x80056548 Val_Ws32 42949672.9500 Time_s -21474836.4800 21474836.4700 /end CHARACTERISTIC
/begin CHARACTERISTIC PFltRgn_tiSysFailDel_C "Entprellzeit für Regenerationsunterbrechung aufgrund von Systemfehlern" VALUE 0x800560B0 Kw_Ws16 327670.0 TimeDeb 0.00 327670.0 EXTENDED_LIMITS -327680.0 327670.0 /end CHARACTERISTIC
/begin CHARACTERISTIC PFltRgn_tiTmrLstRgnSubs_C "Ersatzwert für EEPROM-Initialisierung des Timers für letzte Regeneration" VALUE 0x8005693C Val_Ws32 21474836.4700 Time_s 0.00 21474836.4700 EXTENDED_LIMITS -21474836.4800 21474836.4700 /end CHARACTERISTIC
/begin CHARACTERISTIC PFltRgn_tOxiCatUsMaxHi_C "Maximal zulässiger Wert für Temperatur stromaufwärts vom Oxidationkatalysator (obere Grenze)" VALUE 0x800560B2 Kw_Ws16 700.0000 Temp_Cels 99.96000 799.9600 EXTENDED_LIMITS -3549.940 3003.560 /end CHARACTERISTIC
/begin CHARACTERISTIC PFltRgn_tOxiCatUsMaxLo_C "Maximal zulässiger Wert für Temperatur stromaufwärts vom Oxidationkatalysator (untere Grenze)" VALUE 0x800560B4 Kw_Ws16 700.0000 Temp_Cels 99.96000 799.9600 EXTENDED_LIMITS -3549.940 3003.560 /end CHARACTERISTIC
/begin CHARACTERISTIC PFltRgn_tOxiPreHCOff_C "" VALUE 0x80056940 Val_Ws16 1000.000 Temp_Cels -0.04000000 999.9600 EXTENDED_LIMITS -3549.940 3003.560 /end CHARACTERISTIC
/begin CHARACTERISTIC PFltRgn_tPFltUsMaxHi_C "Maximal zulässiger Wert für Temperatur stromaufwärts vom Partikelfilter (obere Grenze)" VALUE 0x800560B6 Kw_Ws16 700.0000 Temp_Cels 99.96000 799.9600 EXTENDED_LIMITS -3549.940 3003.560 /end CHARACTERISTIC
/begin CHARACTERISTIC PFltRgn_tPFltUsMaxLo_C "Maximal zulässiger Wert für Temperatur stromaufwärts vom Partikelfilter (untere Grenze)" VALUE 0x800560B8 Kw_Ws16 6553.500 Temp_Cels -3549.940 3003.560 /end CHARACTERISTIC
/begin CHARACTERISTIC PFltRgn_tPFltUsMinOvrRun_C "Minimal zulässiger Temperaturwert zum Aufrechterhalten von der Regeneration im Schub" VALUE 0x800560BA Kw_Ws16 600.0000 Temp_Cels 99.96000 699.9600 EXTENDED_LIMITS -3549.940 3003.560 /end CHARACTERISTIC
/begin CHARACTERISTIC PFltRgn_tPreHCOff_C "" VALUE 0x80056942 Val_Ws16 1000.000 Temp_Cels -0.04000000 999.9600 EXTENDED_LIMITS -3549.940 3003.560 /end CHARACTERISTIC
/begin CHARACTERISTIC PFltRgn_tRgnMin_C "T Schwelle zur Erkennung optimaler Regenerationswirkungsgrad" VALUE 0x80056944 Val_Ws16 200.0000 Temp_Cels -0.04000000 199.9600 EXTENDED_LIMITS -3549.940 3003.560 /end CHARACTERISTIC
/begin CHARACTERISTIC PFltRgn_tTrbnUsMaxHi_C "Maximal zulässiger Wert für Temperatur stromaufwärts vom Turbolader (obere Grenze)" VALUE 0x800560BC Kw_Ws16 700.0000 Temp_Cels 99.96000 799.9600 EXTENDED_LIMITS -3549.940 3003.560 /end CHARACTERISTIC
/begin CHARACTERISTIC PFltRgn_tTrbnUsMinLo_C "Maximal zulässiger Wert für Temperatur stromaufwärts vom Turbolader (untere Grenze)" VALUE 0x800560BE Kw_Ws16 700.0000 Temp_Cels 99.96000 799.9600 EXTENDED_LIMITS -3549.940 3003.560 /end CHARACTERISTIC
/begin CHARACTERISTIC PFltRgn_vDynDetMax_C "Maximale Geschwindigkeit zur Dynamikerkennung" VALUE 0x80056B10 Kw_Ws16 327.6700 Vel 0.00 327.6700 EXTENDED_LIMITS -327.6800 327.6700 /end CHARACTERISTIC
/begin CHARACTERISTIC PFltRgn_vDynDetMin_C "Minimale Geschwindigkeit zur Dynamikerkennung" VALUE 0x80056B12 Kw_Ws16 70.00000 Vel 0.00 70.00000 EXTENDED_LIMITS -327.6800 327.6700 /end CHARACTERISTIC
/begin CHARACTERISTIC PFltRgn_volFlConsumSubs_C "Ersatzwert für EEPROM-Initialisierung der verbrauchten Gesamtkraftstoffmenge" VALUE 0x80056946 Val_Wu16 65.50000 Fl_Vol 0.00 65.50000 FORMAT "%8.5" EXTENDED_LIMITS 0.00 65.53500 /end CHARACTERISTIC
/begin CHARACTERISTIC PFltRgn_volFlMinHi_C "Obere Hystereseschwelle zum Entfernen von der Verriegelung" VALUE 0x800560C0 Kw_Ws16 100.0000 Vol 0.00 100.0000 FORMAT "%8.4" EXTENDED_LIMITS -327.6800 327.6700 /end CHARACTERISTIC
/begin CHARACTERISTIC PFltRgn_volFlMinLo_C "Untere Hystereseschwelle zum Entfernen von der Verriegelung" VALUE 0x800560C2 Kw_Ws16 100.0000 Vol 0.00 100.0000 FORMAT "%8.4" EXTENDED_LIMITS -327.6800 327.6700 /end CHARACTERISTIC
/begin CHARACTERISTIC PFltRgn_vOvrRunMax_C "Maximale Geschwindigkeit zur Schuberkennung" VALUE 0x80056B14 Kw_Ws16 327.6700 Vel 0.00 327.6700 EXTENDED_LIMITS -327.6800 327.6700 /end CHARACTERISTIC
/begin CHARACTERISTIC PFltRgn_vOvrRunMin_C "Minimale Geschwindigkeit zur Schuberkennung" VALUE 0x80056B16 Kw_Ws16 70.00000 Vel 0.00 70.00000 EXTENDED_LIMITS -327.6800 327.6700 /end CHARACTERISTIC
/begin CHARACTERISTIC PFltSrv_ctRgnDemAdjMax_C "Maximal erlaubter Abgleichwert für die Anzahl der angeforderten Regenerationen" VALUE 0x80056B18 Val_Wu16 32767.00 OneToOne 0.00 32767.00 EXTENDED_LIMITS 0.00 65535.00 /end CHARACTERISTIC
/begin CHARACTERISTIC PFltSrv_ctRgnSucAdjMax_C "Maximal erlaubter Abgleichwert für die Anzahl der erfolgreichen Regenerationen" VALUE 0x80056B1A Val_Wu16 32767.00 OneToOne 0.00 32767.00 EXTENDED_LIMITS 0.00 65535.00 /end CHARACTERISTIC
/begin CHARACTERISTIC PFltSrv_dmOilAshDia_C "Ölaschenstrom für Service" VALUE 0x80056B1C Val_Ws16 1000.000 AshEGMassPerTime 0.00 1000.000 FORMAT "%8.3" EXTENDED_LIMITS -16.38400 16.38350 /end CHARACTERISTIC
/begin CHARACTERISTIC PFltSrv_facPOpOilAshAdjMax_C "Maximal erlaubter Abgleichwert für den Ölaschenfaktor" VALUE 0x80056B20 Val_Ws32 212144.000000 Fact 0.00 212144.000000 EXTENDED_LIMITS -262144.000000 262143.999878 /end CHARACTERISTIC
/begin CHARACTERISTIC PFltSrv_lSumAdjMax_C "Maximal erlaubter Abgleichwert für den Streckenpunkt der letzten erfolgreichen Regeneration" VALUE 0x80056B24 Val_Ws32 21474836.0000 Length 0.00 21474836.0000 FORMAT "%13.4" EXTENDED_LIMITS -2147483648.00 2147483647.00 /end CHARACTERISTIC
/begin CHARACTERISTIC PFltSrv_lSumDiaAdjMax_C "Maximal erlaubter Abgleichwert für die Strecke seit letztem Partikelfilterwechsel" VALUE 0x80056B28 Val_Ws16 32767.00 OneToOne 0.00 32767.00 EXTENDED_LIMITS -32768.00 32767.00 /end CHARACTERISTIC
/begin CHARACTERISTIC PFltSrv_mOilAshAdjMax_C "Maximal erlaubter Abgleichwert für die Ölaschenmasse" VALUE 0x80056B2A Val_Ws16 3200.000 AshMs_g_p0q1_COMPU 0.00 3200.000 FORMAT "%8.3" EXTENDED_LIMITS -3276.800 3276.700 /end CHARACTERISTIC
/begin CHARACTERISTIC PFltSrv_mSotContAdjMax_C "Maximal erlaubter Abgleichwert für kontinuierliche Rußmasse" VALUE 0x80056B2C Val_Ws16 655.3500 mSoot_g -327.6800 327.6700 FORMAT "%8.4" /end CHARACTERISTIC
/begin CHARACTERISTIC PFltSrv_mSotDia_C "Rußmasse bei Steuergerätewechsel ohne Wertübernahme" VALUE 0x80056B2E Val_Ws16 320.0000 mSoot_g 0.00 320.0000 FORMAT "%8.4" EXTENDED_LIMITS -327.6800 327.6700 /end CHARACTERISTIC
/begin CHARACTERISTIC PFltSrv_mSotNoContAdjMax_C "Maximal erlaubter Abgleichwert für nichtkontinuierliche Rußmasse" VALUE 0x80056B30 Val_Ws16 655.3500 mSoot_g -327.6800 327.6700 FORMAT "%8.4" /end CHARACTERISTIC
/begin CHARACTERISTIC PFltSrv_numAdjIdAdjMax_C "Maximal erlaubter Wert für die Anzahl der Abgleichwerte" VALUE 0x80056B32 Val_Wu8 255.0 OneToOne 0.00 255.0 /end CHARACTERISTIC
/begin CHARACTERISTIC PFltSrv_numSrvIdAdjMax_C "Maximal erlaubter Wert für die Anzahl der Servicefälle" VALUE 0x80056B33 Val_Wu8 255.0 OneToOne 0.00 255.0 /end CHARACTERISTIC
/begin CHARACTERISTIC PFltSrv_qFlAdjMax_C "Maximal erlaubter Wert für die verbrauchte Kraftstoffmenge seit letzter erfolgreicher Regeneration" VALUE 0x80056B34 Val_Ws16 327.6700 Fl_L 0.00 327.6700 FORMAT "%8.4" EXTENDED_LIMITS -327.6800 327.6700 /end CHARACTERISTIC
/begin CHARACTERISTIC PFltSrv_qFlTotAdjMax_C "Maximale Abgleichwert für Kraftstoff seit letztem Partikelfiltertausch" VALUE 0x80056B38 Val_Ws32 32767.0000000 Fl_L 0.00 32767.0000000 FORMAT "%13.7" EXTENDED_LIMITS -21474836.4800 21474836.4700 /end CHARACTERISTIC
/begin CHARACTERISTIC PFltSrv_stRgnNoComplAdjMax_C "Maximal erlaubter Wert für den Status unvollendete Regeneration" VALUE 0x80056B3C Val_Wu8 1.000 OneToOne 0.00 1.000 EXTENDED_LIMITS 0.00 255.0 /end CHARACTERISTIC
/begin CHARACTERISTIC PFltSrv_tiEngPrtAdjMax_C "Maximal erlaubter Wert für Restzeit der Regenerationsanforderung nach Motorschutz" VALUE 0x80056B40 Val_Ws32 21474836.0000 Time_s 0.00 21474836.0000 EXTENDED_LIMITS -21474836.4800 21474836.4700 /end CHARACTERISTIC
/begin CHARACTERISTIC PFltSrv_tiLckRlsAdjMax_C "Maximal erlaubter Wert für Restzeit der Regenerationsverriegelung" VALUE 0x80056B44 Val_Ws32 21474836.0000 Time_s 0.00 21474836.0000 EXTENDED_LIMITS -21474836.4800 21474836.4700 /end CHARACTERISTIC
/begin CHARACTERISTIC PFltSrv_tiLstRgnAdjMax_C "Maximal erlaubter Wert für Restzeit der Regenerationsanforderung nach Zähler" VALUE 0x80056B48 Val_Ws32 21474836.0000 Time_s 0.00 21474836.0000 EXTENDED_LIMITS -21474836.4800 21474836.4700 /end CHARACTERISTIC
/begin CHARACTERISTIC PFltSrv_tiLstRgnDia_C "Restzeit einer Regenerationanforderung nach Zähler im Service" VALUE 0x80056B4C Val_Ws32 21474836.0000 Time_s 0.00 21474836.0000 EXTENDED_LIMITS -21474836.4800 21474836.4700 /end CHARACTERISTIC
/begin CHARACTERISTIC PFltSrv_tiOpAdjMax_C "Maximal erlaubter Abgleichwert für den Zeitpunkt der letzten erfolgreichen Regeneration" VALUE 0x80056B50 Val_Ws32 21474836.0000 TimeEngOn 0.00 21474836.0000 FORMAT "%13.4" EXTENDED_LIMITS -2147483648.00 2147483647.00 /end CHARACTERISTIC
/begin CHARACTERISTIC PFltSrv_tiOpPFltAdjMax_C "Maximal erlaubter Abgleichwert für Betriebsdauer der Partikelfilters" VALUE 0x80056B54 Val_Ws32 21474836.0000 TimeEngOn 0.00 21474836.0000 FORMAT "%13.4" EXTENDED_LIMITS -2147483648.00 2147483647.00 /end CHARACTERISTIC
/begin CHARACTERISTIC PFltSrv_tiTmrMinRgnAdjMax_C "Diagnosewertbegrenzung Verbliebene Zeit aus Wirkungsgradabhängige Regenertionsdauer aus letztem Fahrzyklus" VALUE 0x80056B58 Val_Ws32 21474836.0000 Time_s 0.00 21474836.0000 EXTENDED_LIMITS -21474836.4800 21474836.4700 /end CHARACTERISTIC
/begin CHARACTERISTIC PFltSrv_vAvrgDia_C "Durchschnittsgeschwindigkeit für Servicefall" VALUE 0x80056B5C Val_Ws16 320.0000 Vel 0.00 320.0000 EXTENDED_LIMITS -327.6800 327.6700 /end CHARACTERISTIC
/begin CHARACTERISTIC PFltSrv_volConsAvrg_C "Durchschnittlicher Kraftstoffverbrauch" VALUE 0x80056B5E Val_Ws16 32.00000 Fl_Vol 0.00 32.00000 FORMAT "%8.5" EXTENDED_LIMITS -32.76800 32.76700 /end CHARACTERISTIC
/begin CHARACTERISTIC PFlt_ctEngPrtRgn_C "Schwelle für Maschinenschutz-Regenerationszählimpuls" VALUE 0x80065B0C Val_Wu16 65535.00 OneToOne 0.00 65535.00 /end CHARACTERISTIC
/begin CHARACTERISTIC PFlt_DebOxiPreNplDef_C "Defekterkennungszeit für den tOxiPre NPL Fehler" VALUE 0x80065B0E Val_Wu16 20000.00 Time_ms 0.00 20000.00 EXTENDED_LIMITS 0.00 655350.0 /end CHARACTERISTIC
/begin CHARACTERISTIC PFlt_DebOxiPreNplOk_C "Heilungszeit für den tOxiPre NPL Fehler" VALUE 0x80065B10 Val_Wu16 20000.00 Time_ms 0.00 20000.00 EXTENDED_LIMITS 0.00 655350.0 /end CHARACTERISTIC
/begin CHARACTERISTIC PFlt_DebPFltOvldHeal_C "Debounce Zeit für resFlow Heilungsbedingungen erweiterte" VALUE 0x80065B12 Val_Wu16 1000.000 Time_ms 0.00 1000.000 EXTENDED_LIMITS 0.00 655350.0 /end CHARACTERISTIC
/begin CHARACTERISTIC PFlt_DebPFltOvldInhRgnDef_C "Defekt debounce Zeit für Dfp_PFltOvldInhRgn" VALUE 0x80065B14 Val_Wu16 20000.00 Time_ms 0.00 20000.00 EXTENDED_LIMITS 0.00 655350.0 /end CHARACTERISTIC
/begin CHARACTERISTIC PFlt_DebPFltOvldInhRgnOk_C "Heilende Zeit für Dfp_PFltOvldInhRgn" VALUE 0x80065B16 Val_Wu16 20000.00 Time_ms 0.00 20000.00 EXTENDED_LIMITS 0.00 655350.0 /end CHARACTERISTIC
/begin CHARACTERISTIC PFlt_DebPFltOvldTrqLimDef_C "Defekt debounce Zeit fuer Dfp_PFltOvldTrqLim" VALUE 0x80065B18 Val_Wu16 20000.00 Time_ms 0.00 20000.00 EXTENDED_LIMITS 0.00 655350.0 /end CHARACTERISTIC
/begin CHARACTERISTIC PFlt_DebPFltOvldTrqLimOk_C "Heilende entprell Zeit für Dfp_PFltOvldTrqLim" VALUE 0x80065B1A Val_Wu16 20000.00 Time_ms 0.00 20000.00 EXTENDED_LIMITS 0.00 655350.0 /end CHARACTERISTIC
/begin CHARACTERISTIC PFlt_DebPreNplDef_C "Defekterkennungszeit für den tPre NPL Fehler" VALUE 0x80065B1C Val_Wu16 20000.00 Time_ms 0.00 20000.00 EXTENDED_LIMITS 0.00 655350.0 /end CHARACTERISTIC
/begin CHARACTERISTIC PFlt_DebPreNplOk_C "Heilungszeit für den tPre NPL Fehler" VALUE 0x80065B1E Val_Wu16 20000.00 Time_ms 0.00 20000.00 EXTENDED_LIMITS 0.00 655350.0 /end CHARACTERISTIC
/begin CHARACTERISTIC PFlt_DebRstDfpEngPrtRgnMon_C "Entprellzeit zum Zurücksetzen von DfpEngPrtRgnMon_C" VALUE 0x80065B20 Val_Ws16 655.3500 Time_s -327.6800 327.6700 /end CHARACTERISTIC
/begin CHARACTERISTIC PFlt_dvolCharMonMin_C "Minimaler Abgasvolumenstrom zur Überwachung der Partikelfilter-Charakteristik mit Hilfe des Differenzdruck" VALUE 0x80056B6C Val_Ws16 100.0000 AirVolPerTime 0.00 100.0000 FORMAT "%8.4" EXTENDED_LIMITS -3276.800 3276.700 /end CHARACTERISTIC
/begin CHARACTERISTIC PFlt_dvolChkDstrMin_C "Minimaler Abgasvolumenstrom zur Überprüfung des maximalen Differenzdrucks im Nachlauf" VALUE 0x80056B6E Val_Ws16 100.0000 AirVolPerTime 0.00 100.0000 FORMAT "%8.4" EXTENDED_LIMITS -3276.800 3276.700 /end CHARACTERISTIC
/begin CHARACTERISTIC PFlt_dvolMaxVar_C "Maximale Variation des Abgasvolumenstromes für die Erkennung des stationären Zustandes" VALUE 0x80056B70 Val_Ws16 100.0000 AirVolPerTime 0.00 100.0000 FORMAT "%8.4" EXTENDED_LIMITS -3276.800 3276.700 /end CHARACTERISTIC
/begin CHARACTERISTIC PFlt_dvolRstDfpEngPrtMon_C "Luftstromschwelle zum Zurücksetzen von dpf_pfltmsotdiffmax" VALUE 0x80065B22 Val_Ws16 3000.000 CubMtrPerHr 0.00 3000.000 FORMAT "%8.3" EXTENDED_LIMITS -3276.800 3276.700 /end CHARACTERISTIC
/begin CHARACTERISTIC PFlt_facInrDesAPSTCor_CUR "" CURVE 0x80056CA0 Cur_Xs16Ws16 1.000000 Fact 0.00 1.000000 EXTENDED_LIMITS -4.000000 3.999878
 /begin AXIS_DESCR STD_AXIS EnvP_p Pres_hPa 16 0.00 3500.000 EXTENDED_LIMITS -32768.00 32767.00 DEPOSIT ABSOLUTE /end AXIS_DESCR
/end CHARACTERISTIC
/begin CHARACTERISTIC PFlt_facNO2RgnInhRgn_CUR "Kennline für stromungswiderstand korrecturfaktor" CURVE 0x80065B24 Cur_Xs16Ws16 7.999878 Fact -4.000000 3.999878
 /begin AXIS_DESCR STD_AXIS PFlt_facNO2RgnMapIn_mp Fact 10 0.00 1.000000 EXTENDED_LIMITS -4.000000 3.999878 DEPOSIT ABSOLUTE /end AXIS_DESCR
/end CHARACTERISTIC
/begin CHARACTERISTIC PFlt_facNO2RgnTrqLim_CUR "Kennline für stromungswiderstand korrecturfaktor" CURVE 0x80065B4E Cur_Xs16Ws16 7.999878 Fact -4.000000 3.999878
 /begin AXIS_DESCR STD_AXIS PFlt_facNO2RgnMapIn_mp Fact 10 0.00 1.000000 EXTENDED_LIMITS -4.000000 3.999878 DEPOSIT ABSOLUTE /end AXIS_DESCR
/end CHARACTERISTIC
/begin CHARACTERISTIC PFlt_factiNO2RgnInhRgn_CUR "NO2 Bewertungsfaktor Kennlinie, wenn PFlt_tiNO2Rgn Eingang ist" CURVE 0x80065B78 Cur_Xs16Ws16 7.999878 Fact -4.000000 3.999878
 /begin AXIS_DESCR STD_AXIS PFlt_tiNO2RgnMapIn_mp Time_TempSnceRgn16 11 0.00 2684360. FORMAT "%8.0" EXTENDED_LIMITS -1310720. 1310680. DEPOSIT ABSOLUTE /end AXIS_DESCR
/end CHARACTERISTIC
/begin CHARACTERISTIC PFlt_factiNO2RgnTrqLim_CUR "NO2 Bewertungsfaktor Kennlinie, wenn PFlt_tiNO2Rgn Eingang ist" CURVE 0x80065BA6 Cur_Xs16Ws16 7.999878 Fact -4.000000 3.999878
 /begin AXIS_DESCR STD_AXIS PFlt_tiNO2RgnMapIn_mp Time_TempSnceRgn16 11 0.00 2684360. FORMAT "%8.0" EXTENDED_LIMITS -1310720. 1310680. DEPOSIT ABSOLUTE /end AXIS_DESCR
/end CHARACTERISTIC
/begin CHARACTERISTIC PFlt_lOvldHealObsNO2_C "Heilzyklusdistanz bei unzureichendem Russabbrand" VALUE 0x80065BD4 Val_Wu32 4294967295.00 Length 0.00 4294967295.00 FORMAT "%13.2" /end CHARACTERISTIC
/begin CHARACTERISTIC PFlt_lRstDfpEngPrtMon_C "Strecke seit der letzten erfolgreichen Regeneration zum Zurücksetzen von dpf_pfltmsotdiffmax" VALUE 0x80065BD8 Val_Ws32 4294967295.00 Length -2147483648.00 2147483647.00 FORMAT "%13.2" /end CHARACTERISTIC
/begin CHARACTERISTIC PFlt_lSumDiffMax_C "Maximum erlaubte Unterschied für gefahrene Länge in Kilometer" VALUE 0x80065BDC Val_Wu32 85899345900.0 LengthKm 0.00 85899345900.0 FORMAT "%13.1" /end CHARACTERISTIC
/begin CHARACTERISTIC PFlt_mLoIdlSotSimMax_C "maximaler Wert des simulierten Rußes, über den Druck-Plausibilitätsprüfungen im niedrigen Leerlaufzustand verhindert werden" VALUE 0x80065BE0 Val_Ws16 300.0000 mSoot_g 0.00 300.0000 FORMAT "%8.4" EXTENDED_LIMITS -327.6800 327.6700 /end CHARACTERISTIC
/begin CHARACTERISTIC PFlt_mOvldHealEngPrtOK_C "Nötiger Russmassenabbrand zur Heilung der Überbeladungsfehler" VALUE 0x80065BE2 Val_Ws16 300.0000 mSoot_g 0.00 300.0000 FORMAT "%8.4" EXTENDED_LIMITS -327.6800 327.6700 /end CHARACTERISTIC
/begin CHARACTERISTIC PFlt_mOvldHealInhRgn_C "Russmassenäquivalent zur Regenerationssperr-Überbeladungsschwelle" VALUE 0x80065BE4 Val_Ws16 300.0000 mSoot_g 0.00 300.0000 FORMAT "%8.4" EXTENDED_LIMITS -327.6800 327.6700 /end CHARACTERISTIC
/begin CHARACTERISTIC PFlt_mOvldHealTrqLim_C "Russmassenäquivalent zur Momentenbegrenzungs-Überbeladungsschwelle" VALUE 0x80065BE6 Val_Ws16 300.0000 mSoot_g 0.00 300.0000 FORMAT "%8.4" EXTENDED_LIMITS -327.6800 327.6700 /end CHARACTERISTIC
/begin CHARACTERISTIC PFlt_mSotChkDstrMax_C "Maximale Russmasse zur Druchführung der Überwachung auf zerstörten Partikelfilter" VALUE 0x80056B72 Val_Ws16 300.0000 mSoot_g 0.00 300.0000 FORMAT "%8.4" EXTENDED_LIMITS -327.6800 327.6700 /end CHARACTERISTIC
/begin CHARACTERISTIC PFlt_mSotChkDstrMin_C "Minimale Russmasse zur Druchführung der Überwachung auf zerstörten Partikelfilter" VALUE 0x80056B74 Val_Ws16 300.0000 mSoot_g 0.00 300.0000 FORMAT "%8.4" EXTENDED_LIMITS -327.6800 327.6700 /end CHARACTERISTIC
/begin CHARACTERISTIC PFlt_mSotChkDvtMin_C "Minimale Russmasse zur Druchführung der Überwachung auf Abweichung von simulierter und gemessener Partikelmasse" VALUE 0x80056B76 Val_Ws16 300.0000 mSoot_g 0.00 300.0000 FORMAT "%8.4" EXTENDED_LIMITS -327.6800 327.6700 /end CHARACTERISTIC
/begin CHARACTERISTIC PFlt_mSotChkFlwRstnMin_C "Minimale Russmasse zur Druchführung der Überwachung der Strömungswiderstand" VALUE 0x80056B78 Val_Ws16 300.0000 mSoot_g 0.00 300.0000 FORMAT "%8.4" EXTENDED_LIMITS -327.6800 327.6700 /end CHARACTERISTIC
/begin CHARACTERISTIC PFlt_mSotDiff_C "Threshold value for difference between simulated and measured value of soot mass" VALUE 0x80065BE8 Val_Ws16 300.0000 mSoot_g 0.00 300.0000 FORMAT "%8.4" EXTENDED_LIMITS -327.6800 327.6700 /end CHARACTERISTIC
/begin CHARACTERISTIC PFlt_mSotHysMaxDwn_C "Untere Hysteresegrenze der Russmasse zur Überprüfung auf maximale Beladung des Partikelfilters" VALUE 0x80056B7A Val_Ws16 300.0000 mSoot_g 0.00 300.0000 FORMAT "%8.4" EXTENDED_LIMITS -327.6800 327.6700 /end CHARACTERISTIC
/begin CHARACTERISTIC PFlt_mSotHysMaxUp_C "Obere Hysteresegrenze der Russmasse zur Überprüfung auf maximale Beladung des Partikelfilters" VALUE 0x80056B7C Val_Ws16 300.0000 mSoot_g 0.00 300.0000 FORMAT "%8.4" EXTENDED_LIMITS -327.6800 327.6700 /end CHARACTERISTIC
/begin CHARACTERISTIC PFlt_nLoIdlMax_C "obere Grenze des Drehzahlfensters, um Druck-Plausibilitätsprüfungen im niedrigen Leerlaufzustand zu ermöglichen" VALUE 0x80065BEA Val_Ws16 5000.000 EngN 0.00 5000.000 EXTENDED_LIMITS -16384.00 16383.50 /end CHARACTERISTIC
/begin CHARACTERISTIC PFlt_nLoIdlMin_C "untere Grenze des Drehzahlfensters, um Druck-Plausibilitätsprüfungen im niedrigen Leerlaufzustand zu ermöglichen" VALUE 0x80065BEC Val_Ws16 5000.000 EngN 0.00 5000.000 EXTENDED_LIMITS -16384.00 16383.50 /end CHARACTERISTIC
/begin CHARACTERISTIC PFlt_nMin_C "minimale Drehzahl, um Druck-Plausibilitätsprüfungen bei Kl15-EIN und nach dem Aufwachungszustand zu deaktivieren" VALUE 0x80065BEE Val_Ws16 5000.000 EngN 0.00 5000.000 EXTENDED_LIMITS -16384.00 16383.50 /end CHARACTERISTIC
/begin CHARACTERISTIC PFlt_nPFltOvldHeal_C "Minimale Motordrehzahlschwelle für das Heilend von PFlt Überlastung dfps" VALUE 0x80065BF0 Val_Ws16 5000.000 EngN 0.00 5000.000 EXTENDED_LIMITS -16384.00 16383.50 /end CHARACTERISTIC
/begin CHARACTERISTIC PFlt_nStrtMax_C "obere Grenze des Drehzahlfensters, um Druck-Plausibilitätsprüfungen im Startzustand zu ermöglichen" VALUE 0x80065BF2 Val_Ws16 5000.000 EngN 0.00 5000.000 EXTENDED_LIMITS -16384.00 16383.50 /end CHARACTERISTIC
/begin CHARACTERISTIC PFlt_nStrtMin_C "untere Grenze des Drehzahlfensters, um Druck-Plausibilitätsprüfungen im Startzustand zu ermöglichen" VALUE 0x80065BF4 Val_Ws16 5000.000 EngN 0.00 5000.000 EXTENDED_LIMITS -16384.00 16383.50 /end CHARACTERISTIC
/begin CHARACTERISTIC PFlt_numEngPrtActvMsk_C "Aktivierungsmaske des Motorschutzes abhängig von der Regeneration" VALUE 0x80065BF6 Val_Wu8 255.0 OneToOne 0.00 255.0 /end CHARACTERISTIC
/begin CHARACTERISTIC PFlt_numPPreOxiC_C "" VALUE 0x80065BF7 Val_Wu8 255.0 OneToOne 0.00 255.0 /end CHARACTERISTIC
/begin CHARACTERISTIC PFlt_numRgnStep1_C "Partikelfilterregeneration im 1. Schritt" VALUE 0x80065BF8 Val_Wu8 255.0 OneToOne 0.00 255.0 /end CHARACTERISTIC
/begin CHARACTERISTIC PFlt_numRgnStep2_C "Partikelfilterregeneration im 2 . Schritt" VALUE 0x80065BF9 Val_Wu8 255.0 OneToOne 0.00 255.0 /end CHARACTERISTIC
/begin CHARACTERISTIC PFlt_numRgnStep3_C "Partikelfilterregeneration im 3. Schritt" VALUE 0x80065BFA Val_Wu8 255.0 OneToOne 0.00 255.0 /end CHARACTERISTIC
/begin CHARACTERISTIC PFlt_numRgnStep4_C "Partikelfilterregeneration im 4. Schritt" VALUE 0x80065BFB Val_Wu8 255.0 OneToOne 0.00 255.0 /end CHARACTERISTIC
/begin CHARACTERISTIC PFlt_numRgnStep5_C "Partikelfilterregeneration im 5. Schritt" VALUE 0x80065BFC Val_Wu8 255.0 OneToOne 0.00 255.0 /end CHARACTERISTIC
/begin CHARACTERISTIC PFlt_numRgnStep6_C "Partikelfilterregeneration im 6. Schritt" VALUE 0x80065BFD Val_Wu8 255.0 OneToOne 0.00 255.0 /end CHARACTERISTIC
/begin CHARACTERISTIC PFlt_numRgnStep7_C "Partikelfilterregeneration im 7. Schritt" VALUE 0x80065BFE Val_Wu8 255.0 OneToOne 0.00 255.0 /end CHARACTERISTIC
/begin CHARACTERISTIC PFlt_numRgnStep8_C "Partikelfilterregeneration im 8. Schritt" VALUE 0x80065BFF Val_Wu8 255.0 OneToOne 0.00 255.0 /end CHARACTERISTIC
/begin CHARACTERISTIC PFlt_numTOxiPreSty_C "" VALUE 0x80065C00 Val_Wu8 255.0 OneToOne 0.00 255.0 /end CHARACTERISTIC
/begin CHARACTERISTIC PFlt_numTPreSty_C "" VALUE 0x80065C01 Val_Wu8 255.0 OneToOne 0.00 255.0 /end CHARACTERISTIC
/begin CHARACTERISTIC PFlt_pAPSNegDvt_C "Begrenzung der APS unter welchem der MIN-Fehler bei Druck-Plausibilitätsprüfungen auf APS-Plaus gesetzt wird" VALUE 0x80065C02 Val_Ws16 3500.000 Pres_hPa 0.00 3500.000 EXTENDED_LIMITS -32768.00 32767.00 /end CHARACTERISTIC
/begin CHARACTERISTIC PFlt_pAPSPosDvt_C "Begrenzung der APS über welchem der MAX-Fehler bei Druck-Plausibilitätsprüfungen auf APS-Plaus gesetzt wird" VALUE 0x80065C04 Val_Ws16 3500.000 Pres_hPa 0.00 3500.000 EXTENDED_LIMITS -32768.00 32767.00 /end CHARACTERISTIC
/begin CHARACTERISTIC PFlt_pBPSNegDvt_C "Begrenzung der BPS unter welchem der MIN-Fehler bei Druck-Plausibilitätsprüfungen auf APS Plaus gesetzt wird" VALUE 0x80065C06 Val_Ws16 3500.000 Pres_hPa 0.00 3500.000 EXTENDED_LIMITS -32768.00 32767.00 /end CHARACTERISTIC
/begin CHARACTERISTIC PFlt_pBPSPosDvt_C "Begrenzung der BPS über den maximalen Fehler auf BPS-Plaus bei Druck-Plausibilitätsprüfungen gestellt" VALUE 0x80065C08 Val_Ws16 3500.000 Pres_hPa 0.00 3500.000 EXTENDED_LIMITS -32768.00 32767.00 /end CHARACTERISTIC
/begin CHARACTERISTIC PFlt_pDiffCharMonMin_MAP "Von Russmasse und Abgasvolumenstrom abhängiger minimaler Differenzdruck für die Überwachung auf Filterdurchbruch" MAP 0x80056B7E Kf_Xs16_Ys16_Ws16 3500.000 Pres_hPa 0.00 3500.000 EXTENDED_LIMITS -32768.00 32767.00
 /begin AXIS_DESCR STD_AXIS ASMod_dvolPFltEG AirVolPerTime 8 0.00 1000.00000000 FORMAT "%13.8" EXTENDED_LIMITS -214748364.800 214748364.700 DEPOSIT ABSOLUTE /end AXIS_DESCR
 /begin AXIS_DESCR STD_AXIS PFltLd_mSotSimCont mSoot_g 8 -327.6700 327.6700 FORMAT "%8.4" EXTENDED_LIMITS -327.6800 327.6700 DEPOSIT ABSOLUTE /end AXIS_DESCR
/end CHARACTERISTIC
/begin CHARACTERISTIC PFlt_pDiffMax1_C "maximale Schwelle für die Regenerationsüberwachung des Motorschutzes" VALUE 0x80065C0A Val_Ws16 3277.0000 Pres_hPa 223.0000 3500.0000 EXTENDED_LIMITS -32768.00 32767.00 /end CHARACTERISTIC
/begin CHARACTERISTIC PFlt_pDiffNoDstrMin_CUR "Von stationärem Abgasvolumenstrom abhängiger minimaler Differenzdruck in Nachlauf zur Unterstellung eines zerstörten Partikelfilters" CURVE 0x80056C22 Cur_Xs16Ws16 3500.000 Pres_hPa 0.00 3500.000 EXTENDED_LIMITS -32768.00 32767.00
 /begin AXIS_DESCR STD_AXIS PFlt_dvolMaxSty_mp AirVolPerTime 8 0.00 3500.000 FORMAT "%8.3" EXTENDED_LIMITS -3276.800 3276.700 DEPOSIT ABSOLUTE /end AXIS_DESCR
/end CHARACTERISTIC
/begin CHARACTERISTIC PFlt_pPFltOvldInhRgn_MAP "Kennfeld für PFlt Überlastung Regenerationshemmung" MAP 0x80065C0C Map_Xs16Ys16Ws16 3500.000 Pres_hPa 0.00 3500.000 EXTENDED_LIMITS -32768.00 32767.00
 /begin AXIS_DESCR STD_AXIS Epm_nEng EngN 2 40.00000 6000.000 EXTENDED_LIMITS -16384.00 16383.50 DEPOSIT ABSOLUTE /end AXIS_DESCR
 /begin AXIS_DESCR STD_AXIS InjCtl_qSetUnBal InjMass 2 0.00 327.6700 EXTENDED_LIMITS -327.6800 327.6700 DEPOSIT ABSOLUTE /end AXIS_DESCR
/end CHARACTERISTIC
/begin CHARACTERISTIC PFlt_pPFltOvldInit_C "Initwert des PT1Filter fuer PFlt_pPFltOvldLckRgn_mp" VALUE 0x80065C20 Val_Ws16 3500.00 Pres_hPa 0.00 3500.00 EXTENDED_LIMITS -32768.00 32767.00 /end CHARACTERISTIC
/begin CHARACTERISTIC PFlt_pPFltOvldOfsHeal_C "Schwelle für die Heilung" VALUE 0x80065C22 Val_Ws16 3500.00 Pres_hPa 0.00 3500.00 EXTENDED_LIMITS -32768.00 32767.00 /end CHARACTERISTIC
/begin CHARACTERISTIC PFlt_pPFltOvldTrqLim_MAP "Kennfeld fuer PFlt Uberladung Drehkraft-Beschränkung Berechnung" MAP 0x80065C24 Map_Xs16Ys16Ws16 3500.000 Pres_hPa 0.00 3500.000 EXTENDED_LIMITS -32768.00 32767.00
 /begin AXIS_DESCR STD_AXIS Epm_nEng EngN 2 40.00000 6000.000 EXTENDED_LIMITS -16384.00 16383.50 DEPOSIT ABSOLUTE /end AXIS_DESCR
 /begin AXIS_DESCR STD_AXIS InjCtl_qSetUnBal InjMass 2 0.00 327.6700 EXTENDED_LIMITS -327.6800 327.6700 DEPOSIT ABSOLUTE /end AXIS_DESCR
/end CHARACTERISTIC
/begin CHARACTERISTIC PFlt_pPreAshOilCorr_MAP "von Auf PFlt_dvol und PFlt_mAshOil abhängiges Kennfeld zur Korrekturwertberechnung von PFlt_pPre" MAP 0x80065C38 Map_Xs16Ys16Ws16 3500.000 Pres_hPa 0.00 3500.000 EXTENDED_LIMITS -32768.00 32767.00
 /begin AXIS_DESCR STD_AXIS PFlt_dVolMapIn_mp CubMtrPerHr 5 0.00 3000.000 FORMAT "%8.3" EXTENDED_LIMITS -3276.800 3276.700 DEPOSIT ABSOLUTE /end AXIS_DESCR
 /begin AXIS_DESCR STD_AXIS PFlt_facAshCorMapIn_mp Fact 5 0.00 300.0000 EXTENDED_LIMITS -4.000000 3.999878 DEPOSIT ABSOLUTE /end AXIS_DESCR
/end CHARACTERISTIC
/begin CHARACTERISTIC PFlt_pPreCorrMax_C "maximaler Korrekturwert, welcher für PFlt_pPre zum Plausibilitätstest appliziert werden kann" VALUE 0x80065C82 Val_Ws16 3500.000 Pres_hPa 0.00 3500.000 EXTENDED_LIMITS -32768.00 32767.00 /end CHARACTERISTIC
/begin CHARACTERISTIC PFlt_pPresNegDvt_C "Begrenzung der pPreCorr unter welchem der MIN-Fehler bei Druck-Plausibilitätsprüfungen auf pPre Plaus gesetzt wird" VALUE 0x80065C84 Val_Ws16 3500.000 Pres_hPa 0.00 3500.000 EXTENDED_LIMITS -32768.00 32767.00 /end CHARACTERISTIC
/begin CHARACTERISTIC PFlt_pPreSotSimCorr_MAP "von PFlt_dvol und PFlt_mSotSim abhängiges Kennfeld zur Korrekturwertberechnung von PFlt_pPre" MAP 0x80065C86 Map_Xs16Ys16Ws16 3500.000 Pres_hPa 0.00 3500.000 EXTENDED_LIMITS -32768.00 32767.00
 /begin AXIS_DESCR STD_AXIS PFlt_dVolMapIn_mp CubMtrPerHr 5 0.00 3000.000 FORMAT "%8.3" EXTENDED_LIMITS -3276.800 3276.700 DEPOSIT ABSOLUTE /end AXIS_DESCR
 /begin AXIS_DESCR STD_AXIS PFlt_mSotSimMapIn_mp mSoot_g 5 0.00 300.0000 FORMAT "%8.4" EXTENDED_LIMITS -327.6800 327.6700 DEPOSIT ABSOLUTE /end AXIS_DESCR
/end CHARACTERISTIC
/begin CHARACTERISTIC PFlt_pPresPlausMaxDvt_C "Begrenzung für Druckunterschied über den NPL-Fehler auf Doppeldefekt Plaus bei den Druck-Plausibilitätsprüfungen gestellt" VALUE 0x80065CD0 Val_Ws16 3500.000 Pres_hPa 0.00 3500.000 EXTENDED_LIMITS -32768.00 32767.00 /end CHARACTERISTIC
/begin CHARACTERISTIC PFlt_pPresPlausMinDvt_C "Begrenzung der Druckdifferenz unter welchem alle Fehler bei Druck-Plausibilitätsprüfungen gelöscht werden" VALUE 0x80065CD2 Val_Ws16 3500.000 Pres_hPa 0.00 3500.000 EXTENDED_LIMITS -32768.00 32767.00 /end CHARACTERISTIC
/begin CHARACTERISTIC PFlt_pPresPosDvt_C "Begrenzung der pPreCorr über den maximalen Fehler auf pPre Plaus für Druck-Plausibilitätsprüfungen" VALUE 0x80065CD4 Val_Ws16 3500.000 Pres_hPa 0.00 3500.000 EXTENDED_LIMITS -32768.00 32767.00 /end CHARACTERISTIC
/begin CHARACTERISTIC PFlt_pPreVolCorr_CUR "von PFlt_dvol abhängige Kennlinie zur Korrekturwertberechnung von PFlt_pPre" CURVE 0x80065CD6 Cur_Xs16Ws16 3500.000 Pres_hPa 0.00 3500.000 EXTENDED_LIMITS -32768.00 32767.00
 /begin AXIS_DESCR STD_AXIS PFlt_dVolMapIn_mp CubMtrPerHr 5 0.00 3000.000 FORMAT "%8.3" EXTENDED_LIMITS -3276.800 3276.700 DEPOSIT ABSOLUTE /end AXIS_DESCR
/end CHARACTERISTIC
/begin CHARACTERISTIC PFlt_qLoIdlMax_C "obere Grenze der Einspritzmenge für den Leerlaufdruckplausibilitätstest" VALUE 0x80065CEC Val_Ws16 327.6700 InjMassCyc 0.00 327.6700 EXTENDED_LIMITS -327.6800 327.6700 /end CHARACTERISTIC
/begin CHARACTERISTIC PFlt_qLoIdlMin_C "untere Grenze der Einspritzmenge für den Leerlaufdruckplausibilitätstest" VALUE 0x80065CEE Val_Ws16 327.6700 InjMassCyc 0.00 327.6700 EXTENDED_LIMITS -327.6800 327.6700 /end CHARACTERISTIC
/begin CHARACTERISTIC PFlt_qPFltOvldHeal_C "Schwelle für die Einspritzmenge" VALUE 0x80065CF0 Val_Ws16 327.6700 InjMassInj 0.00 327.6700 EXTENDED_LIMITS -327.6800 327.6700 /end CHARACTERISTIC
/begin CHARACTERISTIC PFlt_rEngPrtRgnMax_C "Schwellwert für das Verhältnis der Aufgabezeit und letzter Regenerationszeit" VALUE 0x80065CF2 Val_Ws16 799.9878 Prc -400.0000 399.9878 /end CHARACTERISTIC
/begin CHARACTERISTIC PFlt_resFlowOvldInhRgn_MAP "Stromungswiderstand KF für regenaration momenten begrensung imfall des überandungserkennung" MAP 0x80065CF4 Map_Xs16Ys16Ws16 25.00000 Res_hPaHrPerCM 0.00 25.00000 FORMAT "%8.5" EXTENDED_LIMITS -3.276800 3.276700
 /begin AXIS_DESCR STD_AXIS Epm_nEng EngN 2 40.00000 6000.000 EXTENDED_LIMITS -16384.00 16383.50 DEPOSIT ABSOLUTE /end AXIS_DESCR
 /begin AXIS_DESCR STD_AXIS InjCtl_qSetUnBal InjMass 2 0.00 327.6700 EXTENDED_LIMITS -327.6800 327.6700 DEPOSIT ABSOLUTE /end AXIS_DESCR
/end CHARACTERISTIC
/begin CHARACTERISTIC PFlt_resFlowOvldInit_C "Initwerte des PT1Filters von Überladungserkennung für den fall Stromungswiderstand gewählt ist" VALUE 0x80065D08 Val_Ws16 25.00000 Res_hPaHrPerCM 0.00 25.00000 FORMAT "%8.5" EXTENDED_LIMITS -3.276800 3.276700 /end CHARACTERISTIC
/begin CHARACTERISTIC PFlt_resFlowOvldOfsHeal_C "Stromungswiderstand offset imfall des überlandungserkennung" VALUE 0x80065D0A Val_Ws16 25.00000 Res_hPaHrPerCM 0.00 25.00000 FORMAT "%8.5" EXTENDED_LIMITS -3.276800 3.276700 /end CHARACTERISTIC
/begin CHARACTERISTIC PFlt_resFlowOvldTrqLim_MAP "Stromungswiderstand KF für regenaration momenten begrensung imfall des überandungserkennung" MAP 0x80065D0C Map_Xs16Ys16Ws16 25.00000 Res_hPaHrPerCM 0.00 25.00000 FORMAT "%8.5" EXTENDED_LIMITS -3.276800 3.276700
 /begin AXIS_DESCR STD_AXIS Epm_nEng EngN 2 40.00000 6000.000 EXTENDED_LIMITS -16384.00 16383.50 DEPOSIT ABSOLUTE /end AXIS_DESCR
 /begin AXIS_DESCR STD_AXIS InjCtl_qSetUnBal InjMass 2 0.00 327.6700 EXTENDED_LIMITS -327.6800 327.6700 DEPOSIT ABSOLUTE /end AXIS_DESCR
/end CHARACTERISTIC
/begin CHARACTERISTIC PFlt_resFlwMax_CUR "Maximale Strömungswiderstand abhängig von kontinuirlich simulierter Russmasse" CURVE 0x80056C44 Cur_Xs16Ws16 2.500000 Res_hPaHrPerCM 0.00 2.500000 FORMAT "%8.6" EXTENDED_LIMITS -3.276800 3.276700
 /begin AXIS_DESCR STD_AXIS PFltLd_mSotSimCont mSoot_g 8 -327.6700 327.6700 FORMAT "%8.4" EXTENDED_LIMITS -327.6800 327.6700 DEPOSIT ABSOLUTE /end AXIS_DESCR
/end CHARACTERISTIC
/begin CHARACTERISTIC PFlt_resFlwMin_CUR "Mnimaler Strömungswiderstand abhängig von kontinuirlich simulierter Russmasse" CURVE 0x80056C66 Cur_Xs16Ws16 2.500000 Res_hPaHrPerCM 0.00 2.500000 FORMAT "%8.6" EXTENDED_LIMITS -3.276800 3.276700
 /begin AXIS_DESCR STD_AXIS PFltLd_mSotSimCont mSoot_g 8 -327.6700 327.6700 FORMAT "%8.4" EXTENDED_LIMITS -327.6800 327.6700 DEPOSIT ABSOLUTE /end AXIS_DESCR
/end CHARACTERISTIC
/begin CHARACTERISTIC PFlt_rLoIdlTVAMax_C "maximaler Wert des TVACD-Tastverhältnisses, über welchem die Plausibilitätsprüfungen im niedrigen Leerlauf deaktiviert werden" VALUE 0x80065D20 Val_Ws16 100.0000 DtyCyc 0.00 100.0000 EXTENDED_LIMITS -327.6800 327.6700 /end CHARACTERISTIC
/begin CHARACTERISTIC PFlt_rSotMsDvtMax_C "Maximale normierte Abweichung zwischen gemessener und kontinuierlich simulierter Russmasse" VALUE 0x80056C88 Val_Ws16 4.000000 RatSotSot 0.00 4.000000 FORMAT "%8.6" EXTENDED_LIMITS -8.192000 8.191750 /end CHARACTERISTIC
/begin CHARACTERISTIC PFlt_rSotMsDvtMin_C "Minimale normierte Abweichung zwischen gemessener und kontinuierlich simulierter Russmasse" VALUE 0x80056C8A Val_Ws16 4.000000 RatSotSot -4.000000 0.00 FORMAT "%8.6" EXTENDED_LIMITS -8.192000 8.191750 /end CHARACTERISTIC
/begin CHARACTERISTIC PFlt_stCharMonRgnOffMsk_CA "Maske zur Auswahl der Betriebsarten für Überwachung des Strömungswiderstandes" VAL_BLK 0x80056C8C Kwb_Wu32 4294967295.00 OneToOne 0.00 4294967295.00 NUMBER 2 /end CHARACTERISTIC
/begin CHARACTERISTIC PFlt_stChkDstrMsk_CA "Maske zur Auswahl der Betriebsarten für Überwachung auf zerstörten Partikelfilter" VAL_BLK 0x80056C94 Kwb_Wu32 4294967295.00 OneToOne 0.00 4294967295.00 NUMBER 2 /end CHARACTERISTIC
/begin CHARACTERISTIC PFlt_stHealRdcDoc_MAP "" MAP 0x80065D22 Map_Xs16Ys16Ws16 1.000000 OneToOne 0.00 1.000000 EXTENDED_LIMITS -32768.00 32767.00
 /begin AXIS_DESCR STD_AXIS Epm_nEng EngN 6 20.00000 10000.00 EXTENDED_LIMITS -16384.00 16383.50 DEPOSIT ABSOLUTE /end AXIS_DESCR
 /begin AXIS_DESCR STD_AXIS PthSet_trqInrSet Trq 6 -500.0000 1000.000 EXTENDED_LIMITS -3276.800 3276.700 DEPOSIT ABSOLUTE /end AXIS_DESCR
/end CHARACTERISTIC
/begin CHARACTERISTIC PFlt_stLoIdlEGTMsk_C "Abgasnachbehandlungsmaske für Druck-Plausibilitätsprüfungen im niedrigen Leerlaufzustand" VALUE 0x80065D88 Val_Wu32 2147483647.00 OneToOne 0.00 2147483647.00 EXTENDED_LIMITS 0.00 4294967295.00 /end CHARACTERISTIC
/begin CHARACTERISTIC PFlt_stMaxEOMMsk_C "" VALUE 0x80065D8C Val_Wu32 4294967295.00 OneToOne 0.00 4294967295.00 /end CHARACTERISTIC
/begin CHARACTERISTIC PFlt_swtActv_C "Schalter zur Deaktivierung der Partikelfilter-Funktionalität" VALUE 0x80056B6A Val_Wu8 1.000 OneToOne 0.00 1.000 EXTENDED_LIMITS 0.00 255.0 /end CHARACTERISTIC
/begin CHARACTERISTIC PFlt_swtDiagRlsmSotCtl_C "Schalter zur Meldung von stDiagRlsmSotCtl an dfp" VALUE 0x80065D90 Val_Wu8 1.000 OneToOne 0.00 1.000 EXTENDED_LIMITS 0.00 255.0 /end CHARACTERISTIC
/begin CHARACTERISTIC PFlt_swtEngPrtWrEEPROM_C "Schalter, um Schreiben der regeneration protection counter ins EEPROM freizugeben. (1: freigegeben, 0: gesperrt)" VALUE 0x80065D91 Val_Wu8 1.000 OneToOne 0.00 1.000 EXTENDED_LIMITS 0.00 255.0 /end CHARACTERISTIC
/begin CHARACTERISTIC PFlt_swtFactiNO2Rgn_C "Schalter für zeit oder faktor für NO2 Bewertungsfaktor kennlinie Auswahlen ." VALUE 0x80065D92 Val_Wu8 1.000 OneToOne 0.00 1.000 EXTENDED_LIMITS 0.00 255.0 /end CHARACTERISTIC
/begin CHARACTERISTIC PFlt_swtMonAshCor_C "Schalter zur Aktivierung der Aschenkorrektur für die Partikelfilter-Überwachung" VALUE 0x80056C9C Val_Wu8 1.000 OneToOne 0.00 1.000 EXTENDED_LIMITS 0.00 255.0 /end CHARACTERISTIC
/begin CHARACTERISTIC PFlt_swtOvldHealExtd_C "Überbeladungsheilung über Simulation" VALUE 0x80065D93 Val_Wu8 1.000 OneToOne 0.00 1.000 EXTENDED_LIMITS 0.00 255.0 /end CHARACTERISTIC
/begin CHARACTERISTIC PFlt_swtPFltOvldInhRgnCor_C "Schalter für schreiben er EEPROM Größen" VALUE 0x80065D94 Val_Wu8 1.000 OneToOne 0.00 1.000 EXTENDED_LIMITS 0.00 255.0 /end CHARACTERISTIC
/begin CHARACTERISTIC PFlt_swtPFltOvldTrqLimCor_C "Schalter für schreiben er EEPROM Größen" VALUE 0x80065D95 Val_Wu8 1.000 OneToOne 0.00 1.000 EXTENDED_LIMITS 0.00 255.0 /end CHARACTERISTIC
/begin CHARACTERISTIC PFlt_swtPresResFlowSel_C "Schalter zus pDiff Oder resflow auswolhe" VALUE 0x80065D96 Val_Wu8 1.000 OneToOne 0.00 1.000 EXTENDED_LIMITS 0.00 255.0 /end CHARACTERISTIC
/begin CHARACTERISTIC PFlt_swtSrvVal_C "Schalter zum Rücksetzen der EEPROM-Werte" VALUE 0x80056B6B Val_Wu8 255.0 OneToOne 0.00 255.0 /end CHARACTERISTIC
/begin CHARACTERISTIC PFlt_swtTempInrOutr_C "Schalter zur Auswahl des Sollwerts aus dem inneren oder äußeren Regelkreis" VALUE 0x80056CE2 Val_Wu8 1.000 OneToOne 0.00 1.000 EXTENDED_LIMITS 0.00 255.0 /end CHARACTERISTIC
/begin CHARACTERISTIC PFlt_swtTrgCharMon_C "Schalter zur Auswahl der Bedingung für die Überwachung des DPF durch Überprüfung des berechneten Strömungswiderstands" VALUE 0x80056C9D Val_Wu8 255.0 OneToOne 0.00 255.0 /end CHARACTERISTIC
/begin CHARACTERISTIC PFlt_tClntPFltOvldHeal_C "Schwelle für Fehlerheilung" VALUE 0x80065D98 Val_Ws16 600.0000 Temp_Cels -100.0400 499.9600 EXTENDED_LIMITS -3549.940 3003.560 /end CHARACTERISTIC
/begin CHARACTERISTIC PFlt_tDevOxiPreMax_C "Grenzwert für den Schleppzeiger, um Fehlerpfad zu setzen" VALUE 0x80065D9A Val_Ws16 600.0000 TempDiff_Cels -100.0000 500.0000 FORMAT "%8.4" EXTENDED_LIMITS -3276.800 3276.700 /end CHARACTERISTIC
/begin CHARACTERISTIC PFlt_tDevOxiPreRgnMax_C "Grenzwert für den Schleppzeiger um bei Regeneration einen Fehlerpfad zu setzen" VALUE 0x80065D9C Val_Ws16 600.0000 TempDiff_Cels -100.0000 500.0000 FORMAT "%8.4" EXTENDED_LIMITS -3276.800 3276.700 /end CHARACTERISTIC
/begin CHARACTERISTIC PFlt_tDevPreMax_C "Grenzwert für den Schleppzeiger um Fehlerpfad zu setzen" VALUE 0x80065D9E Val_Ws16 600.0000 TempDiff_Cels -100.0000 500.0000 FORMAT "%8.4" EXTENDED_LIMITS -3276.800 3276.700 /end CHARACTERISTIC
/begin CHARACTERISTIC PFlt_tDevPreRgnMax_C "Grenzwert für den Schleppzeiger um im Regenerationsfall einen Fehlerpfad zu setzen" VALUE 0x80065DA0 Val_Ws16 600.0000 TempDiff_Cels -100.0000 500.0000 FORMAT "%8.4" EXTENDED_LIMITS -3276.800 3276.700 /end CHARACTERISTIC
/begin CHARACTERISTIC PFlt_tiDebAftRunTst_C "Entprellzeit der Nachlaufbedingung zur Freigabe der Druck-Plausibilitätsprüfungen" VALUE 0x80065DA2 Val_Wu16 1000.000 Time_ms 0.00 1000.000 EXTENDED_LIMITS 0.00 655350.0 /end CHARACTERISTIC
/begin CHARACTERISTIC PFlt_tiDebLoIdl_C "Entprellzeit der Leerlaufbedingung zur Freigabe der Druck-Plausibilitätsprüfungen" VALUE 0x80065DA4 Val_Wu16 1000.000 Time_ms 0.00 1000.000 EXTENDED_LIMITS 0.00 655350.0 /end CHARACTERISTIC
/begin CHARACTERISTIC PFlt_tiDebT15On_C "Entprellzeit der T15 EIN Bedingung zur Freigabe der Plausibilitätsprüfungen" VALUE 0x80065DA6 Val_Wu16 1000.000 Time_ms 0.00 1000.000 EXTENDED_LIMITS 0.00 655350.0 /end CHARACTERISTIC
/begin CHARACTERISTIC PFlt_tiDelSysErr2Can_C "" VALUE 0x80065DA8 Val_Ws32 20000.0000000 Time_s 0.00 20000.0000000 EXTENDED_LIMITS -21474836.4800 21474836.4700 /end CHARACTERISTIC
/begin CHARACTERISTIC PFlt_tiDvolStyChk_C "Minimale Zeit für die Erkennung eines stationäres Abgasvolumenstromes" VALUE 0x80056C9E Val_Ws16 100.0000 Time_s 0.00 100.0000 EXTENDED_LIMITS -327.6800 327.6700 /end CHARACTERISTIC
/begin CHARACTERISTIC PFlt_tiEngNrmOvldheal_C "Zeitschwelle, um Dfp_PfltOvldInhRgn und Dfp_PfltOvldTrqLim zu heilen" VALUE 0x80065DAC Val_Wu32 42949672.9500 Time_s 0.00 42949672.9500 /end CHARACTERISTIC
/begin CHARACTERISTIC PFlt_tiFstEngPrtRgnMax_C "Schwelle zum Zurücksetzen des Zählers für Regeneration wegen Motorschutz" VALUE 0x80065DB0 Val_Wu32 4294967295.00 TimeEngOn 0.00 4294967295.00 FORMAT "%13.2" /end CHARACTERISTIC
/begin CHARACTERISTIC PFlt_tiLoIdlSnceRgnMax_C "Zeit seit letzter erfolgreicher Regeneration, nach der Plausibilitätsprüfungen freigegeben werden" VALUE 0x80065DB4 Val_Ws32 4294967295.00 TimeEngOn -2147483648.00 2147483647.00 FORMAT "%13.2" /end CHARACTERISTIC
/begin CHARACTERISTIC PFlt_tInrDesAPSCor_MAP "" MAP 0x80056CE4 Map_Xs16Ys16Ws16 1600.000 TempDiff_Cels -100.0000 1500.000 FORMAT "%8.3" EXTENDED_LIMITS -3276.800 3276.700
 /begin AXIS_DESCR STD_AXIS Epm_nEng EngN 16 0.00 10000.00 EXTENDED_LIMITS -16384.00 16383.50 DEPOSIT ABSOLUTE /end AXIS_DESCR
 /begin AXIS_DESCR STD_AXIS InjCtl_qSetUnBal InjMass 16 0.00 327.6700 EXTENDED_LIMITS -327.6800 327.6700 DEPOSIT ABSOLUTE /end AXIS_DESCR
/end CHARACTERISTIC
/begin CHARACTERISTIC PFlt_tInrDesTempTrbn_CUR "Sollwertkorrektur des inneren Regelkreises abhängig von der Temperatur vor Turbolader" CURVE 0x80056F28 Cur_Xs16Ws16 1600.000 TempDiff_Kelv -100.0000 1500.000 EXTENDED_LIMITS -3276.800 3276.700
 /begin AXIS_DESCR STD_AXIS Exh_tAdapTTrbnUs Temp_Cels 8 -45.04000 1049.960 EXTENDED_LIMITS -3549.940 3003.560 DEPOSIT ABSOLUTE /end AXIS_DESCR
/end CHARACTERISTIC
/begin CHARACTERISTIC PFlt_tInrDes_MAP "Kennfeld zur Berechnung von Sollwert der inneren Schleife des Abgastemperaturereglers" MAP 0x80056F4A Map_Xs16Ys16Ws16 1600.000 Temp_Cels -100.0400 1499.960 EXTENDED_LIMITS -3549.940 3003.560
 /begin AXIS_DESCR STD_AXIS Epm_nEng EngN 16 0.00 10000.00 EXTENDED_LIMITS -16384.00 16383.50 DEPOSIT ABSOLUTE /end AXIS_DESCR
 /begin AXIS_DESCR STD_AXIS InjCtl_qSetUnBal InjMass 16 0.00 327.6700 EXTENDED_LIMITS -327.6800 327.6700 DEPOSIT ABSOLUTE /end AXIS_DESCR
/end CHARACTERISTIC
/begin CHARACTERISTIC PFlt_tiPFltOvld1PT1_C "Zeitkonstante für Überladungserkennung" VALUE 0x80065DB8 Val_Ws32 4294.9672940 TimeDelay_s 0.000002000000001 4294.9672960 FORMAT "%12.7" /end CHARACTERISTIC
/begin CHARACTERISTIC PFlt_tiPFltOvld2PT1_C "Zeitkonstante für Überladungserkennung" VALUE 0x80065DBC Val_Ws32 4294.9672940 TimeDelay_s 0.000002000000001 4294.9672960 FORMAT "%12.7" /end CHARACTERISTIC
/begin CHARACTERISTIC PFlt_tiWakeUpTrans_C "Zeit seit WakeUp Status" VALUE 0x80065DC0 Val_Wu16 10.00000 Time_s 0.00 10.00000 EXTENDED_LIMITS 0.00 655.3500 /end CHARACTERISTIC
/begin CHARACTERISTIC PFlt_tOutrDesMsFlwO2_CUR "Sollwertkorrektur des äußeren Regelkreises abhängig vom Sauerstoffmassenstrom" CURVE 0x8005718E Cur_Xs16Ws16 1600.000 TempDiff_Kelv -100.0000 1500.000 EXTENDED_LIMITS -3276.800 3276.700
 /begin AXIS_DESCR STD_AXIS PFlt_dmO2Aprx_mp AirMassPerTime 8 0.00 50.00000 EXTENDED_LIMITS -3276.800 3276.700 DEPOSIT ABSOLUTE /end AXIS_DESCR
/end CHARACTERISTIC
/begin CHARACTERISTIC PFlt_tOutrDesMsSot_CUR "Sollwertkorrektur des äußeren Regelkreises abhängig von der Rußbeladung des Partikelfilters" CURVE 0x800571B0 Cur_Xs16Ws16 1600.000 TempDiff_Kelv -100.0000 1500.000 EXTENDED_LIMITS -3276.800 3276.700
 /begin AXIS_DESCR STD_AXIS PFlt_mSot_mp mSoot_g 8 0.00 300.0000 FORMAT "%8.4" EXTENDED_LIMITS -327.6800 327.6700 DEPOSIT ABSOLUTE /end AXIS_DESCR
/end CHARACTERISTIC
/begin CHARACTERISTIC PFlt_tOutrDesTempDs_CUR "Sollwertkorrektur abhängig von der Temperatur nach Oxidationskatalysator" CURVE 0x800571D2 Cur_Xs16Ws16 1600.000 TempDiff_Kelv -100.0000 1500.000 EXTENDED_LIMITS -3276.800 3276.700
 /begin AXIS_DESCR STD_AXIS PFlt_tAdpaTOxiCatDs_mp Temp_Cels 8 -45.04000 1049.960 EXTENDED_LIMITS -3549.940 3003.560 DEPOSIT ABSOLUTE /end AXIS_DESCR
/end CHARACTERISTIC
/begin CHARACTERISTIC PFlt_tOutrDes_MAP "Kennfeld zur Berechnung von Sollwert der äußeren Schleife des Abgastemperaturereglers" MAP 0x800571F4 Map_Xs16Ys16Ws16 1600.000 Temp_Cels -100.0400 1499.960 EXTENDED_LIMITS -3549.940 3003.560
 /begin AXIS_DESCR STD_AXIS Epm_nEng EngN 16 0.00 10000.00 EXTENDED_LIMITS -16384.00 16383.50 DEPOSIT ABSOLUTE /end AXIS_DESCR
 /begin AXIS_DESCR STD_AXIS InjCtl_qSetUnBal InjMass 16 0.00 327.6700 EXTENDED_LIMITS -327.6800 327.6700 DEPOSIT ABSOLUTE /end AXIS_DESCR
/end CHARACTERISTIC
/begin CHARACTERISTIC PFlt_tOxiPreDiffMax_MAP "Schwelle für Maximale Differenztemperatur den tOxiPre" MAP 0x80065DC2 Map_Xs16Ys16Ws16 700.0000 Temp_Cels 99.96000 799.9600 EXTENDED_LIMITS -3549.940 3003.560
 /begin AXIS_DESCR STD_AXIS Epm_nEng EngN 6 40.00000 6000.000 EXTENDED_LIMITS -16384.00 16383.50 DEPOSIT ABSOLUTE /end AXIS_DESCR
 /begin AXIS_DESCR STD_AXIS InjCtl_qSetUnBal InjMass 6 0.00 327.6700 EXTENDED_LIMITS -327.6800 327.6700 DEPOSIT ABSOLUTE /end AXIS_DESCR
/end CHARACTERISTIC
/begin CHARACTERISTIC PFlt_tPreDiffMax_MAP "Schwelle für Maximale Differenztemperatur" MAP 0x80065E26 Map_Xs16Ys16Ws16 700.0000 Temp_Cels 99.96000 799.9600 EXTENDED_LIMITS -3549.940 3003.560
 /begin AXIS_DESCR STD_AXIS Epm_nEng EngN 6 40.00000 6000.000 EXTENDED_LIMITS -16384.00 16383.50 DEPOSIT ABSOLUTE /end AXIS_DESCR
 /begin AXIS_DESCR STD_AXIS InjCtl_qSetUnBal InjMass 6 0.00 327.6700 EXTENDED_LIMITS -327.6800 327.6700 DEPOSIT ABSOLUTE /end AXIS_DESCR
/end CHARACTERISTIC
/begin CHARACTERISTIC PFlt_trqGbxRpmRduc_MAP "" MAP 0x80065E8A Map_Xs16Ys16Ws16 6000.000 Trq 0.00 6000.000 EXTENDED_LIMITS -3276.800 3276.700
 /begin AXIS_DESCR STD_AXIS PFlt_pPreOxiCFlt_mp Pres_hPa 20 0.00 3500.000 EXTENDED_LIMITS -32768.00 32767.00 DEPOSIT ABSOLUTE /end AXIS_DESCR
 /begin AXIS_DESCR STD_AXIS Epm_nEng EngN 16 0.00 6000.000 EXTENDED_LIMITS -16384.00 16383.50 DEPOSIT ABSOLUTE /end AXIS_DESCR
/end CHARACTERISTIC
/begin CHARACTERISTIC PFlt_tThresOxiPreMax_C "Grenzwert für die Fehlerpfadaktivierung" VALUE 0x80066156 Val_Ws16 600.0000 Temp_Cels -100.0400 499.9600 EXTENDED_LIMITS -3549.940 3003.560 /end CHARACTERISTIC
/begin CHARACTERISTIC PFlt_tThresOxiPreRgnMax_C "Grenzwert zum Setzen eines Fehlerpfades im regenerationsfall" VALUE 0x80066158 Val_Ws16 600.0000 Temp_Cels -100.0400 499.9600 EXTENDED_LIMITS -3549.940 3003.560 /end CHARACTERISTIC
/begin CHARACTERISTIC PFlt_tThresPreMax_C "Grenzwert von PFlt_tPre zum setzen eines Fehlerpfades" VALUE 0x8006615A Val_Ws16 600.0000 Temp_Cels -100.0400 499.9600 EXTENDED_LIMITS -3549.940 3003.560 /end CHARACTERISTIC
/begin CHARACTERISTIC PFlt_tThresPreRgnMax_C "Grenzwert von PFlt_tPre zum Setzen eines Fehlerpfades im Regenerationsfall" VALUE 0x8006615C Val_Ws16 600.0000 Temp_Cels -100.0400 499.9600 EXTENDED_LIMITS -3549.940 3003.560 /end CHARACTERISTIC
/begin CHARACTERISTIC PFlt_vLoIdlSpeedMax_C "VSSCD_v Grenze für Plausibilitätstests im Leerlaufzustand" VALUE 0x8006615E Val_Ws16 655.3500 Vel -327.6800 327.6700 /end CHARACTERISTIC
/begin CHARACTERISTIC PFlt_vPFltOvldHeal_C "VSSCD_v Schwelle für Fehlerheilung" VALUE 0x80066160 Val_Ws16 655.3500 Vel -327.6800 327.6700 /end CHARACTERISTIC
/begin CHARACTERISTIC PhyMod_facEtaCorLim_MAP "" MAP 0x80057760 Map_Xs16Ys16Ws16 7.000000 Fact -4.000000 3.000000 EXTENDED_LIMITS -4.000000 3.999878
 /begin AXIS_DESCR STD_AXIS Epm_nEng EngN 16 0.00 6000.000 EXTENDED_LIMITS -16384.00 16383.50 DEPOSIT ABSOLUTE /end AXIS_DESCR
 /begin AXIS_DESCR STD_AXIS PthSet_trqInrSet Trq 16 -500.0000 1000.000 EXTENDED_LIMITS -3276.800 3276.700 DEPOSIT ABSOLUTE /end AXIS_DESCR
/end CHARACTERISTIC
/begin CHARACTERISTIC PhyMod_facPCRCorr0_CUR "" CURVE 0x800579A4 Cur_Xs16Ws16 3.999878 Fact 0.00 3.999878 EXTENDED_LIMITS -4.000000 3.999878
 /begin AXIS_DESCR STD_AXIS PthSet_trqInrSet Trq 2 -3276.800 3276.700 DEPOSIT ABSOLUTE /end AXIS_DESCR
/end CHARACTERISTIC
/begin CHARACTERISTIC PhyMod_facPCRCorr0_MAP "" MAP 0x800579AE Map_Xs16Ys16Ws16 10.00000 Fact 0.00 10.00000 EXTENDED_LIMITS -4.000000 3.999878
 /begin AXIS_DESCR STD_AXIS Epm_nEng EngN 8 0.00 6000.000 EXTENDED_LIMITS -16384.00 16383.50 DEPOSIT ABSOLUTE /end AXIS_DESCR
 /begin AXIS_DESCR STD_AXIS PhyMod_pPCRDiff0_mp Pres_hPa 8 -30.00000 3500.00000 EXTENDED_LIMITS -32768.00 32767.00 DEPOSIT ABSOLUTE /end AXIS_DESCR
/end CHARACTERISTIC
/begin CHARACTERISTIC PhyMod_facPCRCorr1_CUR "" CURVE 0x80057A52 Cur_Xs16Ws16 3.999878 Fact 0.00 3.999878 EXTENDED_LIMITS -4.000000 3.999878
 /begin AXIS_DESCR STD_AXIS PthSet_trqInrSet Trq 2 -3276.800 3276.700 DEPOSIT ABSOLUTE /end AXIS_DESCR
/end CHARACTERISTIC
/begin CHARACTERISTIC PhyMod_facPCRCorr1_MAP "" MAP 0x80057A5C Map_Xs16Ys16Ws16 10.00000 Fact 0.00 10.00000 EXTENDED_LIMITS -4.000000 3.999878
 /begin AXIS_DESCR STD_AXIS Epm_nEng EngN 8 0.00 6000.000 EXTENDED_LIMITS -16384.00 16383.50 DEPOSIT ABSOLUTE /end AXIS_DESCR
 /begin AXIS_DESCR STD_AXIS PhyMod_pPCRDiff1_mp Pres_hPa 8 -30.00000 3500.00000 EXTENDED_LIMITS -32768.00 32767.00 DEPOSIT ABSOLUTE /end AXIS_DESCR
/end CHARACTERISTIC
/begin CHARACTERISTIC PhyMod_facRmpVal_C "Rampenfaktor für BA-Umschaltung" VALUE 0x80058BC8 Val_Ws16 3.999939 EGTSwt_S16 -2.000000 1.999939 FORMAT "%8.6" /end CHARACTERISTIC
/begin AXIS_PTS PhyMod_InjTyp_AXIS "" 0x80058BCA PhyMod_InjTyp Axis_Xu8 1. PhyMod_InjName 2 0.00 1. FORMAT "%2.0" DEPOSIT ABSOLUTE /end AXIS_PTS
/begin CHARACTERISTIC PhyMod_OpMode2Map_GMAP "" MAP 0x80058BCD MapG_Wu8 9. PhyMod_MapName 0.00 9. FORMAT "%2.0"
 /begin AXIS_DESCR COM_AXIS PhyMod_InjTyp PhyMod_InjName 2 0.00 1. FORMAT "%2.0" AXIS_PTS_REF PhyMod_InjTyp_AXIS /end AXIS_DESCR
 /begin AXIS_DESCR COM_AXIS PhyMod_stPrs PhyMod_OpModeName 10 0.00 20. FORMAT "%2.0" AXIS_PTS_REF PhyMod_OpMode_AXIS /end AXIS_DESCR
/end CHARACTERISTIC
/begin AXIS_PTS PhyMod_OpMode_AXIS "Liste von Betriebsarten inkl. Stufen, die in der Momentenstruktur unterstützt sind" 0x80058BE1 PhyMod_stPrs Axis_Xu8 20. PhyMod_OpModeName 10 0.00 20. FORMAT "%2.0" DEPOSIT ABSOLUTE /end AXIS_PTS
/begin CHARACTERISTIC PhyMod_pPCROpt0_MAP "" MAP 0x80057B00 Map_Xs16Ys16Ws16 3500.00 Pres_hPa 0.00 3500.00 EXTENDED_LIMITS -32768.00 32767.00
 /begin AXIS_DESCR STD_AXIS Epm_nEng EngN 16 0.00 6000.000 EXTENDED_LIMITS -16384.00 16383.50 DEPOSIT ABSOLUTE /end AXIS_DESCR
 /begin AXIS_DESCR STD_AXIS PthSet_trqInrSet Trq 16 -500.0000 1000.000 EXTENDED_LIMITS -3276.800 3276.700 DEPOSIT ABSOLUTE /end AXIS_DESCR
/end CHARACTERISTIC
/begin CHARACTERISTIC PhyMod_pPCROpt1_MAP "" MAP 0x80057D44 Map_Xs16Ys16Ws16 3500.00 Pres_hPa 0.00 3500.00 EXTENDED_LIMITS -32768.00 32767.00
 /begin AXIS_DESCR STD_AXIS Epm_nEng EngN 16 0.00 6000.000 EXTENDED_LIMITS -16384.00 16383.50 DEPOSIT ABSOLUTE /end AXIS_DESCR
 /begin AXIS_DESCR STD_AXIS PthSet_trqInrSet Trq 16 -500.0000 1000.000 EXTENDED_LIMITS -3276.800 3276.700 DEPOSIT ABSOLUTE /end AXIS_DESCR
/end CHARACTERISTIC
/begin CHARACTERISTIC PhyMod_pwrEGLos_MAP "KF zum ermitteln der Verlustleistung in Abgas und Motorumgebung" MAP 0x80058BF4 Map_Xs16Ys16Ws16 617643.4 Pwr2 0.00 617643.4 FORMAT "%8.1" EXTENDED_LIMITS -617662.2 617643.4
 /begin AXIS_DESCR STD_AXIS InjCtl_qSetUnBal InjMass 8 -327.6800 327.6700 DEPOSIT ABSOLUTE /end AXIS_DESCR
 /begin AXIS_DESCR STD_AXIS Epm_nEng EngN 8 -16384.00 16383.50 DEPOSIT ABSOLUTE /end AXIS_DESCR
/end CHARACTERISTIC
/begin CHARACTERISTIC PhyMod_stOpModeCtl_C "Schalter um BA-Vorgabe innerhalb Momentenstruktur zu aktivieren" VALUE 0x80058BEC Val_Wu8 255.0 OneToOne 0.00 255.0 /end CHARACTERISTIC
/begin CHARACTERISTIC PhyMod_stOpMode_C "Vorgabe für BA-Maske" VALUE 0x80058BF0 Val_Wu32 4294967295.00 OneToOne 0.00 4294967295.00 /end CHARACTERISTIC
/begin CHARACTERISTIC PhyMod_trq2qBas0_MAP "Motorbasiskennfeld 0" MAP 0x80057F88 Map_Xs16Ys16Ws16 327.6700 InjMass 0.00 327.6700 EXTENDED_LIMITS -327.6800 327.6700
 /begin AXIS_DESCR STD_AXIS Epm_nEng EngN 20 0.00 6000.000 EXTENDED_LIMITS -16384.00 16383.50 DEPOSIT ABSOLUTE /end AXIS_DESCR
 /begin AXIS_DESCR STD_AXIS PthSet_trqInrSet Trq 16 0.00 1000.000 EXTENDED_LIMITS -3276.800 3276.700 DEPOSIT ABSOLUTE /end AXIS_DESCR
/end CHARACTERISTIC
/begin CHARACTERISTIC PhyMod_trq2qBas1_MAP "Motorbasiskennfeld 1" MAP 0x80058254 Map_Xs16Ys16Ws16 327.6700 InjMass 0.00 327.6700 EXTENDED_LIMITS -327.6800 327.6700
 /begin AXIS_DESCR STD_AXIS Epm_nEng EngN 16 0.00 6000.000 EXTENDED_LIMITS -16384.00 16383.50 DEPOSIT ABSOLUTE /end AXIS_DESCR
 /begin AXIS_DESCR STD_AXIS PthSet_trqInrSet Trq 16 0.00 1000.000 EXTENDED_LIMITS -3276.800 3276.700 DEPOSIT ABSOLUTE /end AXIS_DESCR
/end CHARACTERISTIC
/begin CHARACTERISTIC PhyMod_trq2qBas2_MAP "Motorbasiskennfeld 2" MAP 0x80058498 Map_Xs16Ys16Ws16 327.6700 InjMass 0.00 327.6700 EXTENDED_LIMITS -327.6800 327.6700
 /begin AXIS_DESCR STD_AXIS Epm_nEng EngN 16 0.00 6000.000 EXTENDED_LIMITS -16384.00 16383.50 DEPOSIT ABSOLUTE /end AXIS_DESCR
 /begin AXIS_DESCR STD_AXIS PthSet_trqInrSet Trq 16 0.00 1000.000 EXTENDED_LIMITS -3276.800 3276.700 DEPOSIT ABSOLUTE /end AXIS_DESCR
/end CHARACTERISTIC
/begin CHARACTERISTIC PhyMod_trq2qBas3_MAP "Motorbasiskennfeld 3" MAP 0x800586DC Map_Xs16Ys16Ws16 327.6700 InjMass 0.00 327.6700 EXTENDED_LIMITS -327.6800 327.6700
 /begin AXIS_DESCR STD_AXIS Epm_nEng EngN 16 0.00 6000.000 EXTENDED_LIMITS -16384.00 16383.50 DEPOSIT ABSOLUTE /end AXIS_DESCR
 /begin AXIS_DESCR STD_AXIS PthSet_trqInrSet Trq 16 0.00 1000.000 EXTENDED_LIMITS -3276.800 3276.700 DEPOSIT ABSOLUTE /end AXIS_DESCR
/end CHARACTERISTIC
/begin CHARACTERISTIC PhyMod_trq2qBas4_MAP "Motorbasiskennfeld 4" MAP 0x80058920 Map_Xs16Ys16Ws16 327.6700 InjMass 0.00 327.6700 EXTENDED_LIMITS -327.6800 327.6700
 /begin AXIS_DESCR STD_AXIS Epm_nEng EngN 16 0.00 6000.000 EXTENDED_LIMITS -16384.00 16383.50 DEPOSIT ABSOLUTE /end AXIS_DESCR
 /begin AXIS_DESCR STD_AXIS PthSet_trqInrSet Trq 16 0.00 1000.000 EXTENDED_LIMITS -3276.800 3276.700 DEPOSIT ABSOLUTE /end AXIS_DESCR
/end CHARACTERISTIC
/begin CHARACTERISTIC PhyMod_trq2qBas5_MAP "Motorbasiskennfeld 5" MAP 0x80058B64 Map_Xs16Ys16Ws16 327.6700 InjMass 0.00 327.6700 EXTENDED_LIMITS -327.6800 327.6700
 /begin AXIS_DESCR STD_AXIS Epm_nEng EngN 2 0.00 6000.000 EXTENDED_LIMITS -16384.00 16383.50 DEPOSIT ABSOLUTE /end AXIS_DESCR
 /begin AXIS_DESCR STD_AXIS PthSet_trqInrSet Trq 2 0.00 1000.000 EXTENDED_LIMITS -3276.800 3276.700 DEPOSIT ABSOLUTE /end AXIS_DESCR
/end CHARACTERISTIC
/begin CHARACTERISTIC PhyMod_trq2qBas6_MAP "Motorbasiskennfeld 6" MAP 0x80058B78 Map_Xs16Ys16Ws16 327.6700 InjMass 0.00 327.6700 EXTENDED_LIMITS -327.6800 327.6700
 /begin AXIS_DESCR STD_AXIS Epm_nEng EngN 2 0.00 6000.000 EXTENDED_LIMITS -16384.00 16383.50 DEPOSIT ABSOLUTE /end AXIS_DESCR
 /begin AXIS_DESCR STD_AXIS PthSet_trqInrSet Trq 2 0.00 1000.000 EXTENDED_LIMITS -3276.800 3276.700 DEPOSIT ABSOLUTE /end AXIS_DESCR
/end CHARACTERISTIC
/begin CHARACTERISTIC PhyMod_trq2qBas7_MAP "Motorbasiskennfeld 7" MAP 0x80058B8C Map_Xs16Ys16Ws16 327.6700 InjMass 0.00 327.6700 EXTENDED_LIMITS -327.6800 327.6700
 /begin AXIS_DESCR STD_AXIS Epm_nEng EngN 2 0.00 6000.000 EXTENDED_LIMITS -16384.00 16383.50 DEPOSIT ABSOLUTE /end AXIS_DESCR
 /begin AXIS_DESCR STD_AXIS PthSet_trqInrSet Trq 2 0.00 1000.000 EXTENDED_LIMITS -3276.800 3276.700 DEPOSIT ABSOLUTE /end AXIS_DESCR
/end CHARACTERISTIC
/begin CHARACTERISTIC PhyMod_trq2qBas8_MAP "Motorbasiskennfeld 8" MAP 0x80058BA0 Map_Xs16Ys16Ws16 327.6700 InjMass 0.00 327.6700 EXTENDED_LIMITS -327.6800 327.6700
 /begin AXIS_DESCR STD_AXIS Epm_nEng EngN 2 0.00 6000.000 EXTENDED_LIMITS -16384.00 16383.50 DEPOSIT ABSOLUTE /end AXIS_DESCR
 /begin AXIS_DESCR STD_AXIS PthSet_trqInrSet Trq 2 0.00 1000.000 EXTENDED_LIMITS -3276.800 3276.700 DEPOSIT ABSOLUTE /end AXIS_DESCR
/end CHARACTERISTIC
/begin CHARACTERISTIC PhyMod_trq2qBas9_MAP "Motorbasiskennfeld 9" MAP 0x80058BB4 Map_Xs16Ys16Ws16 327.6700 InjMass 0.00 327.6700 EXTENDED_LIMITS -327.6800 327.6700
 /begin AXIS_DESCR STD_AXIS Epm_nEng EngN 2 0.00 6000.000 EXTENDED_LIMITS -16384.00 16383.50 DEPOSIT ABSOLUTE /end AXIS_DESCR
 /begin AXIS_DESCR STD_AXIS PthSet_trqInrSet Trq 2 0.00 1000.000 EXTENDED_LIMITS -3276.800 3276.700 DEPOSIT ABSOLUTE /end AXIS_DESCR
/end CHARACTERISTIC
/begin CHARACTERISTIC PPC_facDT1WinNegVal_C "Schwellwert für das Umschalten in den negativen Bereich des D Reglers" VALUE 0x800574A8 Val_Ws32 8500.00000000 Pres_hPa -5000.00000000 3500.00000000 EXTENDED_LIMITS -2147483648.00 2147483647.00 /end CHARACTERISTIC
/begin CHARACTERISTIC PPC_facDT1WinPosVal_C "Schwellwert für das Umschalten in den positiven Bereich des D Reglers" VALUE 0x800574AC Val_Ws32 3500.00000000 Pres_hPa 0.00 3500.00000000 EXTENDED_LIMITS -2147483648.00 2147483647.00 /end CHARACTERISTIC
/begin CHARACTERISTIC PPC_facIWinNegVal_C "Schwellwert für das Umschalten in den negativen Bereich des I-Reglers" VALUE 0x800574B0 Val_Ws32 8500.00000000 Pres_hPa -5000.00000000 3500.00000000 EXTENDED_LIMITS -2147483648.00 2147483647.00 /end CHARACTERISTIC
/begin CHARACTERISTIC PPC_facIWinPosVal_C "Schwellwert für das Umschalten in den positiven Bereich des I Reglers" VALUE 0x800574B4 Val_Ws32 3500.00000000 Pres_hPa 0.00 3500.00000000 EXTENDED_LIMITS -2147483648.00 2147483647.00 /end CHARACTERISTIC
/begin CHARACTERISTIC PPC_facKdNegVal_C "Kd Faktor für den D-Regler im negativen Bereich" VALUE 0x800574B8 Val_Ws32 799.999999814 Kd_Pres_hPa2Prc -400.000000000 399.999999814 FORMAT "%13.9" /end CHARACTERISTIC
/begin CHARACTERISTIC PPC_facKdPosVal_C "Kd Faktor für den positiven Bereich des D Reglers" VALUE 0x800574BC Val_Ws32 799.999999814 Kd_Pres_hPa2Prc -400.000000000 399.999999814 FORMAT "%13.9" /end CHARACTERISTIC
/begin CHARACTERISTIC PPC_facKdVal_C "Kd Faktor für den D-Regler" VALUE 0x800574C0 Val_Ws32 799.999999814 Kd_Pres_hPa2Prc -400.000000000 399.999999814 FORMAT "%13.9" /end CHARACTERISTIC
/begin CHARACTERISTIC PPC_facKiNegVal_C "Ki Faktor für den negativen Bereich des I-Reglers" VALUE 0x800574C4 Val_Ws32 24414.0624943 Ki_Pres_hPa2Prc -12207.0312500 12207.0312443 FORMAT "%13.7" /end CHARACTERISTIC
/begin CHARACTERISTIC PPC_facKiPosVal_C "Ki Faktor für den positiven Bereich des I-Reglers" VALUE 0x800574C8 Val_Ws32 24414.0624943 Ki_Pres_hPa2Prc -12207.0312500 12207.0312443 FORMAT "%13.7" /end CHARACTERISTIC
/begin CHARACTERISTIC PPC_facKiVal_C "Ki Faktor für den I-Regler" VALUE 0x800574CC Val_Ws32 24414.0624943 Ki_Pres_hPa2Prc -12207.0312500 12207.0312443 FORMAT "%13.7" /end CHARACTERISTIC
/begin CHARACTERISTIC PPC_facKpNegVal_C "Kp Faktor für den negativen Bereich des P-Reglers" VALUE 0x800574D0 Val_Ws32 1599.99999963 Kp_Pres_hPa2Prc -800.000000000 799.999999627 FORMAT "%13.9" /end CHARACTERISTIC
/begin CHARACTERISTIC PPC_facKpPosVal_C "Kp Faktor für den positiven Bereich des P-Reglers" VALUE 0x800574D4 Val_Ws32 1599.99999963 Kp_Pres_hPa2Prc -800.000000000 799.999999627 FORMAT "%13.9" /end CHARACTERISTIC
/begin CHARACTERISTIC PPC_facKpVal_C "Kp Faktor für den P-Reglers" VALUE 0x800574D8 Val_Ws32 1599.99999963 Kp_Pres_hPa2Prc -800.000000000 799.999999627 FORMAT "%13.9" /end CHARACTERISTIC
/begin CHARACTERISTIC PPC_facPWinNegVal_C "Schwellwert für das Umschalten in den negativen Bereich des P-Reglers" VALUE 0x800574DC Val_Ws16 8500.000 Pres_hPa -5000.000 3500.000 EXTENDED_LIMITS -32768.00 32767.00 /end CHARACTERISTIC
/begin CHARACTERISTIC PPC_facPWinPosVal_C "Schwellwert für das Umschalten in den positiven Bereich des P-Reglers" VALUE 0x800574DE Val_Ws16 3500.000 Pres_hPa 0.00 3500.000 EXTENDED_LIMITS -32768.00 32767.00 /end CHARACTERISTIC
/begin CHARACTERISTIC PPC_facT1Val_C "Zeitkonstante T1 für den D-Regler" VALUE 0x800574E0 Val_Ws32 4294.9672940 TimeDelay_s 0.000002000000001 4294.9672960 FORMAT "%12.7" /end CHARACTERISTIC
/begin CHARACTERISTIC PPC_pGovNom_C "Nominaldruck für die Druckregelung" VALUE 0x800574E4 Val_Ws16 3500.000 Pres_hPa 0.00 3500.000 EXTENDED_LIMITS -32768.00 32767.00 /end CHARACTERISTIC
/begin CHARACTERISTIC PPC_pInDT1Ini_C "Initialwert für den Eingang des D-Reglers" VALUE 0x800574E8 Val_Ws32 3500.00000000 Pres_hPa 0.00 3500.00000000 EXTENDED_LIMITS -2147483648.00 2147483647.00 /end CHARACTERISTIC
/begin CHARACTERISTIC PPC_pUPmpPHys_C "Delta für die Hysterese des SCR Pumpendrucks" VALUE 0x80057504 Val_Ws16 3500.000 Pres_hPa 0.00 3500.000 EXTENDED_LIMITS -32768.00 32767.00 /end CHARACTERISTIC
/begin CHARACTERISTIC PPC_pUPmpPNom_C "Rechte Grenze für die Hysterese des SCR Pumpendrucks" VALUE 0x80057506 Val_Ws16 3500.000 Pres_hPa 0.00 3500.000 EXTENDED_LIMITS -32768.00 32767.00 /end CHARACTERISTIC
/begin CHARACTERISTIC PPC_rDycAftrunEmpt_C "" VALUE 0x80057508 Val_Ws16 100.0000 Prc 0.00 100.0000 EXTENDED_LIMITS -400.0000 399.9878 /end CHARACTERISTIC
/begin CHARACTERISTIC PPC_rDycDfl_C "Ersatzwert für den Dutycycle für den Pumpenmotor in den Unterzuständen (AFTERRUN_EMPTYING und WAITING_FOR_SHUTOFF)" VALUE 0x8005750A Val_Ws16 100.0000 Prc 0.00 100.0000 EXTENDED_LIMITS -400.0000 399.9878 /end CHARACTERISTIC
/begin CHARACTERISTIC PPC_rDycDT1Max_C "Maximaler D-Anteil der Druckregelung" VALUE 0x800574EC Val_Ws16 200.0000 Prc -100.0000 100.0000 EXTENDED_LIMITS -400.0000 399.9878 /end CHARACTERISTIC
/begin CHARACTERISTIC PPC_rDycDT1Min_C "Minimaler D-Anteil der Druckregelung" VALUE 0x800574EE Val_Ws16 200.0000 Prc -100.0000 100.0000 EXTENDED_LIMITS -400.0000 399.9878 /end CHARACTERISTIC
/begin CHARACTERISTIC PPC_rDycIMax_C "Maximaler I-Anteil der Druckregelung" VALUE 0x800574F0 Val_Ws16 100.0000 Prc 0.00 100.0000 EXTENDED_LIMITS -400.0000 399.9878 /end CHARACTERISTIC
/begin CHARACTERISTIC PPC_rDycIMin_C "Minimaler I-Anteil der Druckregelung" VALUE 0x800574F2 Val_Ws16 100.0000 Prc 0.00 100.0000 EXTENDED_LIMITS -400.0000 399.9878 /end CHARACTERISTIC
/begin CHARACTERISTIC PPC_rDycPIDMax_C "Maximaler Dutycycle der PID Druckregelung" VALUE 0x800574F4 Val_Ws16 100.0000 Prc 0.00 100.0000 EXTENDED_LIMITS -400.0000 399.9878 /end CHARACTERISTIC
/begin CHARACTERISTIC PPC_rDycPIDMin_C "Minimaler Dutycycle der PID Druckregelung" VALUE 0x800574F6 Val_Ws16 799.9878 Prc -400.0000 399.9878 /end CHARACTERISTIC
/begin CHARACTERISTIC PPC_rDycPMax_C "Maximaler P-Anteil für die Druckregelung" VALUE 0x800574F8 Val_Ws16 100.0000 Prc 0.00 100.0000 EXTENDED_LIMITS -400.0000 399.9878 /end CHARACTERISTIC
/begin CHARACTERISTIC PPC_rDycPMin_C "Minimaler P-Anteil für den Dutycycle der Druckregelung" VALUE 0x800574FA Val_Ws16 100.0000 Prc 0.00 100.0000 EXTENDED_LIMITS -400.0000 399.9878 /end CHARACTERISTIC
/begin CHARACTERISTIC PPC_rDycPresBuildUp_C "PWM % für Pumpenmotor im Zustand PRESSUREBUILDUP" VALUE 0x8005750C Val_Ws16 100.0000 Prc 0.00 100.0000 EXTENDED_LIMITS -400.0000 399.9878 /end CHARACTERISTIC
/begin CHARACTERISTIC PPC_rDycPresRdc_C "PWM % für Pumpenmotor im Zustand PRESSUREREDUCTION" VALUE 0x8005750E Val_Ws16 100.0000 Prc 0.00 100.0000 EXTENDED_LIMITS -400.0000 399.9878 /end CHARACTERISTIC
/begin CHARACTERISTIC PPC_rDycReFl_C "PWM % für Pumpenmotor im Unterzustand REFILL" VALUE 0x80057510 Val_Ws16 100.0000 Prc 0.00 100.0000 EXTENDED_LIMITS -400.0000 399.9878 /end CHARACTERISTIC
/begin CHARACTERISTIC PPC_rDycVtln_C "PWM % für Pumpenmotor im Unterzustand VENTILATION" VALUE 0x80057512 Val_Ws16 100.0000 Prc 0.00 100.0000 EXTENDED_LIMITS -400.0000 399.9878 /end CHARACTERISTIC
/begin CHARACTERISTIC PPC_rOutDT1Ini_C "Startwert für den D Regler der Druckkontrolle" VALUE 0x800574FC Val_Ws32 100.000000000 Prc 0.00 100.000000000 EXTENDED_LIMITS -26214400.0000 26214399.9878 /end CHARACTERISTIC
/begin CHARACTERISTIC PPC_rOutIIni_C "Initialwert für den Dutycycle bei Eintritt in MeteringControl" VALUE 0x80057500 Val_Ws16 100.0000 Prc 0.00 100.0000 EXTENDED_LIMITS -400.0000 399.9878 /end CHARACTERISTIC
/begin CHARACTERISTIC PPC_swtUPmpCtl_C "Auswahlschalter für das PWM Signal für den Pumpenmotor im Unterzustand METERINGCONTROL" VALUE 0x80057514 Val_Wu8 2.00000000000 PPC_SwitchState 0.00 2.00000000000 FORMAT "%13.11" /end CHARACTERISTIC
/begin CHARACTERISTIC S_ENABLLLLRED "Aktivierung Einrechnung B_ll in PGENLLRED" VALUE 0x800661BA Val_Wu8 1.0 Identity 0.00 1.0 EXTENDED_LIMITS 0.00 255. /end CHARACTERISTIC
/begin CHARACTERISTIC S_GELIBIEAPP "Applikation Generatorlastbegrenzung für Leerlaufstabilisierung" VALUE 0x800661BB Val_Wu8 1.0 Identity 0.00 1.0 EXTENDED_LIMITS 0.00 255. /end CHARACTERISTIC
/begin CHARACTERISTIC S_HTDETEC "Schalter zur Aktivierung Überwachung Diodentemparatur" VALUE 0x800662A8 Val_Wu8 1.0 Identity 0.00 1.0 EXTENDED_LIMITS 0.00 255. /end CHARACTERISTIC
/begin CHARACTERISTIC S_PGENLL_AKT "Aktivierung Leistungsreduzierung Generator durch Generatorlastschwankung" VALUE 0x800661BC Val_Wu8 1.0 Identity 0.00 1.0 EXTENDED_LIMITS 0.00 255. /end CHARACTERISTIC
/begin MEASUREMENT Air_dpFltIntkVUs "" SWORD PreshPa_sec 1 100 -32768.00 32767.00 FORMAT "%8.2" ECU_ADDRESS 0xD000062C /end MEASUREMENT
/begin MEASUREMENT Air_pIntkVUs "Luftdruck vor Einlassventil" SWORD Pres_hPa 1 100 -32768.00 3500.00 ECU_ADDRESS 0xD0000630 /end MEASUREMENT
/begin MEASUREMENT Air_pSensPIntkVUs "Gemessener Luftdruckwert vor Einlassventil" SWORD Pres_hPa 1 100 -32768.00 3500.00 ECU_ADDRESS 0xD0000632 /end MEASUREMENT
/begin MEASUREMENT Air_pUnFltPIntkVUs "Ungefilterter Luftdruckwert vor Einlassventil" SWORD Pres_hPa 1 100 -32768.00 3500.00 ECU_ADDRESS 0xD0000634 /end MEASUREMENT
/begin MEASUREMENT Air_uRawPIntkVUs "Spannungsrohwert aus ADC" SWORD Volt 1 100 -6553.600 6553.400 ECU_ADDRESS 0xD000064A /end MEASUREMENT
/begin MEASUREMENT Deltadff "Gradient des vom Generator empfangenen Lastsignals" SBYTE Def_f_sb_b64 1 100 -64.00 63.50 ECU_ADDRESS 0xC000B488 /end MEASUREMENT
/begin MEASUREMENT Dffgenschz "Zähler für Generatorlastschwnkungen zur Leerlauf-Solldrehzahlanhebung" UBYTE Def_dez_ub_q1 1 100 0.00 255. FORMAT "%3.0" ECU_ADDRESS 0xC000B489 /end MEASUREMENT
/begin MEASUREMENT Dnkw "Drehzahlabweichung bei Leerlaufregelung" SWORD Def_n_sw_q1p0 1 100 -32768. 32767. FORMAT "%5.0" ECU_ADDRESS 0xC000AA40 /end MEASUREMENT
/begin MEASUREMENT Exh_ddvolFltPPFltDiff_mp "" SWORD CubMtrPerHrPerSec 1 100 -3276.800 3276.700 FORMAT "%8.3" ECU_ADDRESS 0xC000AA76 /end MEASUREMENT
/begin MEASUREMENT Exh_dpFltPPFltDiff_mp "" SWORD hPaPerSec 1 100 -3276.800 3276.700 FORMAT "%8.3" ECU_ADDRESS 0xC000AA78 /end MEASUREMENT
/begin MEASUREMENT Exh_dpNegDefPPFltDiff_mp "" SWORD hPaPerSec 1 100 -3276.800 3276.700 FORMAT "%8.3" ECU_ADDRESS 0xC000AA7A /end MEASUREMENT
/begin MEASUREMENT Exh_dpPosDefPPFltDiff_mp "" SWORD hPaPerSec 1 100 -3276.800 3276.700 FORMAT "%8.3" ECU_ADDRESS 0xC000AA7C /end MEASUREMENT
/begin MEASUREMENT Exh_pAdapPPFltDiff "" SWORD Pres_hPa 1 100 -32768.00 3500.00 ECU_ADDRESS 0xD0000A04 /end MEASUREMENT
/begin MEASUREMENT Exh_pDiffOfsValAct "" SWORD Pres_hPa 1 100 -32768.00 3500.00 ECU_ADDRESS 0xD0000A10 /end MEASUREMENT
/begin MEASUREMENT Exh_pDiffOfsValActMid "" SWORD Pres_hPa 1 100 -32768.00 3500.00 ECU_ADDRESS 0xD0000A12 /end MEASUREMENT
/begin MEASUREMENT Exh_pDiffOfsValAct_mp "" SWORD Pres_hPa 1 100 -32768.00 3500.00 ECU_ADDRESS 0xC000AA7E /end MEASUREMENT
/begin MEASUREMENT Exh_pDiffOfsValOld "" SWORD Pres_hPa 1 100 -32768.00 3500.00 ECU_ADDRESS 0xD0000A14 /end MEASUREMENT
/begin MEASUREMENT Exh_pDiffOfsValOld_mp "" SWORD Pres_hPa 1 100 -32768.00 3500.00 ECU_ADDRESS 0xC000AA80 /end MEASUREMENT
/begin MEASUREMENT Exh_pFltPPFltDiff "" SWORD Pres_hPa 1 100 -32768.00 3500.00 ECU_ADDRESS 0xD0000A26 /end MEASUREMENT
/begin MEASUREMENT Exh_pMinStyPPFltDiff "" SWORD Pres_hPa 1 100 -32768.00 3500.00 ECU_ADDRESS 0xD0000A2E /end MEASUREMENT
/begin MEASUREMENT Exh_pOfsValActMidPPFltDiff "" SWORD Pres_hPa 1 100 -32768.00 3500.00 ECU_ADDRESS 0xD0000A30 /end MEASUREMENT
/begin MEASUREMENT Exh_pPFltDiff "" SWORD Pres_hPa 1 100 -32768.00 3500.00 ECU_ADDRESS 0xD0000A32 /end MEASUREMENT
/begin MEASUREMENT Exh_pRawAdapPPFltDiff "" SWORD Pres_hPa 1 100 -32768.00 3500.00 ECU_ADDRESS 0xD0000A3A /end MEASUREMENT
/begin MEASUREMENT Exh_pSensPPFltDiff "" SWORD Pres_hPa 1 100 -32768.00 3500.00 ECU_ADDRESS 0xD0000A3C /end MEASUREMENT
/begin MEASUREMENT Exh_pSensPPFltUs "" SWORD Pres_hPa 1 100 -32768.00 3500.00 ECU_ADDRESS 0xD0000A3E /end MEASUREMENT
/begin MEASUREMENT Exh_stAftRunDelDemPPFltDiff "" UBYTE OneToOne 1 100 0.00 255.0 ECU_ADDRESS 0xD0001E13 /end MEASUREMENT
/begin MEASUREMENT Exh_stDynNplPPFltDiff_mp "" UBYTE OneToOne 1 100 0.00 255.0 ECU_ADDRESS 0xC000B495 /end MEASUREMENT
/begin MEASUREMENT Exh_stpDiffTstDem_mp "" UBYTE OneToOne 1 100 0.00 255.0 ECU_ADDRESS 0xC000B496 /end MEASUREMENT
/begin MEASUREMENT Exh_stStyPPFltDiff "" UBYTE OneToOne 1 100 0.00 255.0 ECU_ADDRESS 0xD0001E2C /end MEASUREMENT
/begin MEASUREMENT Exh_stTrgAftRunPPFltDiff "" UBYTE OneToOne 1 100 0.00 255.0 ECU_ADDRESS 0xD0001E2E /end MEASUREMENT
/begin MEASUREMENT Exh_uRawPPFltDiff "" SWORD Volt 1 100 -6553.600 6553.400 ECU_ADDRESS 0xD0000AB6 /end MEASUREMENT
/begin MEASUREMENT Exh_uRawPPFltUs "" SWORD Volt 1 100 -6553.600 6553.400 ECU_ADDRESS 0xD0000AB8 /end MEASUREMENT
/begin MEASUREMENT FuelLvl_vol "" SWORD Vol 1 100 -327.6800 327.6700 FORMAT "%8.4" ECU_ADDRESS 0xD0000B24 /end MEASUREMENT
/begin MEASUREMENT Ierrgrenz_ht "Grenzerregerstrom durch Überhitzung Dioden" UBYTE Def_i_ub_q0p125 1 100 0.00 31.875 ECU_ADDRESS 0xC000B48E /end MEASUREMENT
/begin MEASUREMENT Ierrgrenz_ll "Grenzerregerstrombegrenzung Generator" UBYTE Def_i_ub_q0p125 1 100 0.00 31.875 ECU_ADDRESS 0xC000B48A /end MEASUREMENT
/begin MEASUREMENT Nelueft_gen "Drehzahlanforderung E-Lüfter Generator" UBYTE Def_tv_ub_q0p390625 1 100 0.00 99.61 ECU_ADDRESS 0xC000B48F /end MEASUREMENT
/begin MEASUREMENT PFltLd_facAshAdjCor "Aschefaktor nach Ascheabgleich" SWORD Fact 1 100 -4.000000 3.999878 ECU_ADDRESS 0xD00011CE /end MEASUREMENT
/begin MEASUREMENT PFltRgn_aDynMinLim_mp "Minimale Schwelle zur Dynamikerkennung über Beschleunigung" SWORD Acc 1 100 -32.76800 32.76700 FORMAT "%8.5" ECU_ADDRESS 0xC000A9CA /end MEASUREMENT
/begin MEASUREMENT PFltRgn_ctRgnDemEEP_mp "Im EEPROM gespeicherte Anzahl der angeforderten Regenerationen" UWORD OneToOne 1 100 0.00 65535.00 ECU_ADDRESS 0xC000A996 /end MEASUREMENT
/begin MEASUREMENT PFltRgn_ctRgnDem_mp "Anzahl der angeforderten Regenerationen" UWORD OneToOne 1 100 0.00 65535.00 ECU_ADDRESS 0xC000A998 /end MEASUREMENT
/begin MEASUREMENT PFltRgn_ctRgnSuc "Anzahl erfolgreicher Partikelfilterregenerationen" UWORD OneToOne 1 100 0.00 65535.00 ECU_ADDRESS 0xD000161C /end MEASUREMENT
/begin MEASUREMENT PFltRgn_ctRgnSucEEP_mp "Im EEPROM gespeicherte Anzahl erfolgreicher Partikelfilterregenerationen" UWORD OneToOne 1 100 0.00 65535.00 ECU_ADDRESS 0xC000A99A /end MEASUREMENT
/begin MEASUREMENT PFltRgn_ctStrtSnceRgn_mp "Motorstarts seit letzter erfolgreicher Regeneration" UWORD OneToOne 1 100 0.00 65535.00 ECU_ADDRESS 0xC000A9A2 /end MEASUREMENT
/begin MEASUREMENT PFltRgn_dqFlAvrg_mp "mittlerer verbrauch" SWORD FlCons_100km 1 100 -1638.400 1638.350 FORMAT "%8.3" ECU_ADDRESS 0xC000A9A4 /end MEASUREMENT
/begin MEASUREMENT PFltRgn_drAccPedFlt_mp "Gefilterte Änderung des Pedalwertes" SWORD PrcPerSec 1 100 -20000.00 19999.39 FORMAT "%8.2" ECU_ADDRESS 0xC000A9CC /end MEASUREMENT
/begin MEASUREMENT PFltRgn_drAccPedRaw_mp "Änderung des Pedalwertes" SWORD PrcPerSec 1 100 -20000.00 19999.39 FORMAT "%8.2" ECU_ADDRESS 0xC000A9CE /end MEASUREMENT
/begin MEASUREMENT PFltRgn_dvolFlCons_mp "Kraftstoffverbrauch" SWORD FlCons_lps_q0p0001 1 100 -3.276800 3.276700 FORMAT "%8.6" ECU_ADDRESS 0xC000A9A6 /end MEASUREMENT
/begin MEASUREMENT PFltRgn_facAshPrt "Aschekorrektur für Motorschutzregenerationsschwellen" SWORD Fact 1 100 -4.000000 3.999878 ECU_ADDRESS 0xD000120E /end MEASUREMENT
/begin MEASUREMENT PFltRgn_facFlTrmUnlim_mp "" SWORD Fact 1 100 -4.000000 3.999878 ECU_ADDRESS 0xC000A9A8 /end MEASUREMENT
/begin MEASUREMENT PFltRgn_facFullLdCor_mp "Korrekturfaktor für Volllasterkennung" SWORD Fact 1 100 -4.000000 3.999878 ECU_ADDRESS 0xC000A9D0 /end MEASUREMENT
/begin MEASUREMENT PFltRgn_facNO2RgnPrtCor "NO2 Bewertungsfaktor für Motorschutzregenerationsschwellen" SWORD Fact 1 100 -4.000000 3.999878 ECU_ADDRESS 0xD0001210 /end MEASUREMENT
/begin MEASUREMENT PFltRgn_facSumTrmUnlim_mp "" SWORD Fact 1 100 -4.000000 3.999878 ECU_ADDRESS 0xC000A9AA /end MEASUREMENT
/begin MEASUREMENT PFltRgn_lAvrgSnceRgn_mp "Durchschnittlicher Abstand reiste seit letzter Regeneration" SWORD lSnceRgnRes 1 100 -4194304. 4194176. FORMAT "%8.0" ECU_ADDRESS 0xC000A9AC /end MEASUREMENT
/begin MEASUREMENT PFltRgn_lSnceRgn "Seit der letzten erfolgreichen Regeneration gefahrene Strecke" SLONG Length 1 100 -2147483648.00 2147483647.00 FORMAT "%13.2" ECU_ADDRESS 0xD0002F8C /end MEASUREMENT
/begin MEASUREMENT PFltRgn_lSumEEP_mp "Seit der letzten erfolgreichen Regeneration gesamt gefahrene Strecke (im EEPROM gespeicherten Wert)" SLONG Length 1 100 -2147483648.00 2147483647.00 FORMAT "%13.2" ECU_ADDRESS 0xC0009238 /end MEASUREMENT
/begin MEASUREMENT PFltRgn_lSumMax "gefahrene Strecke Schwelle für Regeneration" SWORD lSnceRgnRes 1 100 -4194304. 4194176. FORMAT "%8.0" ECU_ADDRESS 0xD0001212 /end MEASUREMENT
/begin MEASUREMENT PFltRgn_lSumMax_mp "Maximale Schwelle für die zurückgelegte Strecke seit der letzten erfolgreichen Regeneration" SLONG Length 1 100 -2147483648.00 2147483647.00 FORMAT "%13.2" ECU_ADDRESS 0xC000923C /end MEASUREMENT
/begin MEASUREMENT PFltRgn_lSumRgnBck0_mp "Km-Stand der letzten Regeneration" SLONG Length 1 100 -2147483648.00 2147483647.00 FORMAT "%13.2" ECU_ADDRESS 0xC0009240 /end MEASUREMENT
/begin MEASUREMENT PFltRgn_lSumRgnBck1_mp "Km-Stand der letzten Regeneration" SLONG Length 1 100 -2147483648.00 2147483647.00 FORMAT "%13.2" ECU_ADDRESS 0xC0009244 /end MEASUREMENT
/begin MEASUREMENT PFltRgn_lSumRgnBck2_mp "Km-Stand der letzten Regeneration" SLONG Length 1 100 -2147483648.00 2147483647.00 FORMAT "%13.2" ECU_ADDRESS 0xC0009248 /end MEASUREMENT
/begin MEASUREMENT PFltRgn_lSumRgnBck3_mp "Km-Stand der letzten Regeneration" SLONG Length 1 100 -2147483648.00 2147483647.00 FORMAT "%13.2" ECU_ADDRESS 0xC000924C /end MEASUREMENT
/begin MEASUREMENT PFltRgn_lSumRgnBck4_mp "Km-Stand der letzten Regeneration" SLONG Length 1 100 -2147483648.00 2147483647.00 FORMAT "%13.2" ECU_ADDRESS 0xC0009250 /end MEASUREMENT
/begin MEASUREMENT PFltRgn_lSum_mp "Seit der letzten erfolgreichen Regeneration gesamt gefahrene Strecke" SLONG Length 1 100 -2147483648.00 2147483647.00 FORMAT "%13.2" ECU_ADDRESS 0xC0009254 /end MEASUREMENT
/begin MEASUREMENT PFltRgn_mSotOfs_mp "Äquivalent Massenoffset" SWORD mSoot_g 1 100 -327.6800 327.6700 FORMAT "%8.4" ECU_ADDRESS 0xC000A9AE /end MEASUREMENT
/begin MEASUREMENT PFltRgn_numEngPOp_mp "Regenerationszahl nach Berücksichtigung des Motorbetriebszustands" UWORD OneToOne 1 100 0.00 65535.00 ECU_ADDRESS 0xC000A99C /end MEASUREMENT
/begin MEASUREMENT PFltRgn_numLst_mp "Regenerationsanforderung wegen Kraftstoffverbrauch, Betriebsdauer oder Strecke" UBYTE OneToOne 1 100 0.00 255.0 ECU_ADDRESS 0xC000B45F /end MEASUREMENT
/begin MEASUREMENT PFltRgn_numPFltErr_mp "" UBYTE OneToOne 1 100 0.00 255.0 ECU_ADDRESS 0xC000B460 /end MEASUREMENT
/begin MEASUREMENT PFltRgn_numPrt_mp "Regenerationsanforderung wegen Motorschutz" UBYTE OneToOne 1 100 0.00 255.0 ECU_ADDRESS 0xC000B461 /end MEASUREMENT
/begin MEASUREMENT PFltRgn_numRgn "Regenerationsanforderung" UBYTE OneToOne 1 100 0.00 255.0 ECU_ADDRESS 0xD0002038 /end MEASUREMENT
/begin MEASUREMENT PFltRgn_numRgn_mp "Zur ausgewählten Luftbank umgeschalteter Betriebspunktanzeiger für Array PFltRgn_numEngPOpDel_CA" UBYTE OneToOne 1 100 0.00 255.0 ECU_ADDRESS 0xC000B451 /end MEASUREMENT
/begin MEASUREMENT PFltRgn_numSot_mp "Beladungszustand des DPF" UBYTE OneToOne 1 100 0.00 255.0 ECU_ADDRESS 0xC000B462 /end MEASUREMENT
/begin MEASUREMENT PFltRgn_numTot "gesamte Regenerationsanforderung" UBYTE OneToOne 1 100 0.00 255.0 ECU_ADDRESS 0xD0002039 /end MEASUREMENT
/begin MEASUREMENT PFltRgn_pActEngPrt_mp "Aktueller Differenzdruck über Partikelfilter für Überprüfung der Regenerationsanforderung wegen Motorschutz" SWORD Pres_hPa 1 100 -32768.00 3500.00 ECU_ADDRESS 0xC000A9B0 /end MEASUREMENT
/begin MEASUREMENT PFltRgn_pEngPrtAshCor "Aschekorrektur für Motorschutzregenerationsschwellen" SWORD Pres_hPa 1 100 -32768.00 3500.00 ECU_ADDRESS 0xD0001214 /end MEASUREMENT
/begin MEASUREMENT PFltRgn_pEngPrtMaxRaw_mp "Ungefilterter maximaler Differenzdruck für Motorschutz" SWORD Pres_hPa 1 100 -32768.00 3500.00 ECU_ADDRESS 0xC000A9B2 /end MEASUREMENT
/begin MEASUREMENT PFltRgn_pEngPrtMax_mp "Maximaldruck Motorschutz" SWORD Pres_hPa 1 100 -32768.00 3500.00 ECU_ADDRESS 0xC000A9B4 /end MEASUREMENT
/begin MEASUREMENT PFltRgn_pEngPrtMinRaw_mp "Ungefilterter minimaler Differenzdruck für Motorschutz" SWORD Pres_hPa 1 100 -32768.00 3500.00 ECU_ADDRESS 0xC000A9B6 /end MEASUREMENT
/begin MEASUREMENT PFltRgn_pEngPrtMin_mp "Minimaldruck Motorschutz" SWORD Pres_hPa 1 100 -32768.00 3500.00 ECU_ADDRESS 0xC000A9B8 /end MEASUREMENT
/begin MEASUREMENT PFltRgn_qFlEEP_mp "Im EEPROM gespeicherter Wert der seit der letzten erfolgreichen Regeneration verbrauchten Kraftstoffmenge" SWORD Fl_L 1 100 -327.6800 327.6700 FORMAT "%8.4" ECU_ADDRESS 0xC000A9BA /end MEASUREMENT
/begin MEASUREMENT PFltRgn_qFlMax_mp "Schwelle für den Kraftstoffverbrauch seit der letzten erfolgreichen Regeneration" SWORD Fl_L 1 100 -327.6800 327.6700 FORMAT "%8.4" ECU_ADDRESS 0xC000A9BC /end MEASUREMENT
/begin MEASUREMENT PFltRgn_qFlTot "Insgesamt verbrauchte Kraftstoffmenge seit letzter Filterreinigung" SWORD Fl_2 1 100 -327680.0 327670.0 FORMAT "%8.1" ECU_ADDRESS 0xD0001216 /end MEASUREMENT
/begin MEASUREMENT PFltRgn_qFlTotEEP_mp "Im EEPROM gespeicherter Wert der insgesamt verbrauchten Kraftstoffmenge seit letzter Filterreinigung" SLONG Fl_L 1 100 -21474836.4800 21474836.4700 FORMAT "%13.4" ECU_ADDRESS 0xC0009258 /end MEASUREMENT
/begin MEASUREMENT PFltRgn_qFl_mp "Seit der letzten erfolgreichen Regeneration verbrauchte Kraftstoffmenge" SWORD Fl_L 1 100 -327.6800 327.6700 FORMAT "%8.4" ECU_ADDRESS 0xC000A9BE /end MEASUREMENT
/begin MEASUREMENT PFltRgn_resFlwEngPrtAshCor "Aschekorrektur für Motorschutzregenerationsschwellen" SWORD Res_hPaHrPerCM 1 100 -3.276800 3.276700 FORMAT "%8.6" ECU_ADDRESS 0xD0001218 /end MEASUREMENT
/begin MEASUREMENT PFltRgn_resFlwEngPrtMax_mp "Aktivierungsschwelle für Motorschutzregeneration nach Stroemungswdst." SWORD Res_hPaHrPerCM 1 100 -3.276800 3.276700 FORMAT "%8.6" ECU_ADDRESS 0xC000A9C0 /end MEASUREMENT
/begin MEASUREMENT PFltRgn_resFlwEngPrtMin_mp "Deaktivierungsschwelle für Motorschutzregeneration nach Stroemungswdst." SWORD Res_hPaHrPerCM 1 100 -3.276800 3.276700 FORMAT "%8.6" ECU_ADDRESS 0xC000A9C2 /end MEASUREMENT
/begin MEASUREMENT PFltRgn_resFlwOfs_mp "Zur ausgewählten Luftbank umgeschalteter Betriebspunktanzeiger für Kennlinie PFltRgn_mSotMeas_CUR" SWORD Res_hPaHrPerCM 1 100 -3.276800 3.276700 FORMAT "%8.6" ECU_ADDRESS 0xC000A9C4 /end MEASUREMENT
/begin MEASUREMENT PFltRgn_rFullLdBas_mp "Grunderwert zur Volllasterkennung" SWORD Prc 1 100 -400.0000 399.9878 ECU_ADDRESS 0xC000A9D2 /end MEASUREMENT
/begin MEASUREMENT PFltRgn_rFullLd_mp "Verhältnis für Volllasterkennung" SWORD Prc 1 100 -400.0000 399.9878 ECU_ADDRESS 0xC000A9D4 /end MEASUREMENT
/begin MEASUREMENT PFltRgn_stActEngPrt_mp "Status Regenerationsanforderung wegen Motorschutz" UBYTE OneToOne 1 100 0.00 255.0 ECU_ADDRESS 0xC000B463 /end MEASUREMENT
/begin MEASUREMENT PFltRgn_stChngImmd_mp "Status für einen direkten Betriebsarten- bzw. Regenerationsstufenwechsel" UBYTE OneToOne 1 100 0.00 255.0 ECU_ADDRESS 0xC000B452 /end MEASUREMENT
/begin MEASUREMENT PFltRgn_stChngRgnDelExpd_mp "Status Maximale Verzögerungszeit nach Änderung des Betriebsartenwunsches erreicht" UBYTE OneToOne 1 100 0.00 255.0 ECU_ADDRESS 0xC000B453 /end MEASUREMENT
/begin MEASUREMENT PFltRgn_stChngRgnDel_mp "Verzögerter Status für einen Betriebsarten- bzw. Regenerationsstufenwechsel" UBYTE OneToOne 1 100 0.00 255.0 ECU_ADDRESS 0xC000B454 /end MEASUREMENT
/begin MEASUREMENT PFltRgn_stChngRgn_mp "Status für einen Betriebsarten- bzw. Regenerationsstufenwechsel" UBYTE OneToOne 1 100 0.00 255.0 ECU_ADDRESS 0xC000B455 /end MEASUREMENT
/begin MEASUREMENT PFltRgn_stDelAftNoSucEnd "Ende Regenerationsunterbrechung nach erfolgloser Regeneration" UBYTE OneToOne 1 100 0.00 255.0 ECU_ADDRESS 0xD000203A /end MEASUREMENT
/begin MEASUREMENT PFltRgn_stEngPrtActv "Status Motorschutz aktiv" UBYTE OneToOne 1 100 0.00 255.0 ECU_ADDRESS 0xD000203B /end MEASUREMENT
/begin MEASUREMENT PFltRgn_stEngPrt_mp "Status Motorschutz" UBYTE OneToOne 1 100 0.00 255.0 ECU_ADDRESS 0xC000B464 /end MEASUREMENT
/begin MEASUREMENT PFltRgn_stHCCondEnd "" UBYTE OneToOne 1 100 0.00 255.0 ECU_ADDRESS 0xD000203C /end MEASUREMENT
/begin MEASUREMENT PFltRgn_stIntr "Statuswort Regenerationsunterbrechung" UWORD OneToOne 1 100 0.00 65535.00 ECU_ADDRESS 0xD000161E /end MEASUREMENT
/begin MEASUREMENT PFltRgn_stIntrAct_mp "Basis-Statuswort Regenerationsunterbrechung" UWORD OneToOne 1 100 0.00 65535.00 ECU_ADDRESS 0xC000A992 /end MEASUREMENT
/begin MEASUREMENT PFltRgn_stIntrPrj_mp "" UWORD OneToOne 1 100 0.00 65535.00 ECU_ADDRESS 0xC000A994 /end MEASUREMENT
/begin MEASUREMENT PFltRgn_stJmpCond_mp "Status Sprungbedingung" UBYTE OneToOne 1 100 0.00 255.0 ECU_ADDRESS 0xC000B456 /end MEASUREMENT
/begin MEASUREMENT PFltRgn_stLck "Statusbitwort Sperrung der Partikelfilterregeneration" UBYTE OneToOne 1 100 0.00 255.0 ECU_ADDRESS 0xD000203D /end MEASUREMENT
/begin MEASUREMENT PFltRgn_stLstRgnEnd_mp "Status erkennt das Ende der Regeneration aus Zählerblöcken" UBYTE OneToOne 1 100 0.00 255.0 ECU_ADDRESS 0xC000B465 /end MEASUREMENT
/begin MEASUREMENT PFltRgn_stLstRgn_mp "Status Timer für Regeneration von Zählerblöcken" UBYTE OneToOne 1 100 0.00 255.0 ECU_ADDRESS 0xC000B466 /end MEASUREMENT
/begin MEASUREMENT PFltRgn_stLst_mp "Status Regenerationsanforderung nach Kraftstoffverbrauch, Betriebsstunden oder gefahrener Strecke" UBYTE OneToOne 1 100 0.00 255.0 ECU_ADDRESS 0xC000B467 /end MEASUREMENT
/begin MEASUREMENT PFltRgn_stNoSucDet "" UBYTE OneToOne 1 100 0.00 255.0 ECU_ADDRESS 0xD000203E /end MEASUREMENT
/begin MEASUREMENT PFltRgn_stNoSuc_mp "" UBYTE OneToOne 1 100 0.00 255.0 ECU_ADDRESS 0xC000B457 /end MEASUREMENT
/begin MEASUREMENT PFltRgn_stNumEngPOpDelOn_mp "Statusbit verzögert wirksame Matrix zur Berücksichtigung des Motorbetriebszustandes bei Regeneration." UBYTE OneToOne 1 100 0.00 255.0 ECU_ADDRESS 0xC000B458 /end MEASUREMENT
/begin MEASUREMENT PFltRgn_stNumSotSucAct_mp "Basis-Status erfolgreiche Regeneration wegen kleiner Regenerationszahl" UBYTE OneToOne 1 100 0.00 255.0 ECU_ADDRESS 0xC000B459 /end MEASUREMENT
/begin MEASUREMENT PFltRgn_stNumSotSuc_mp "Status erfolgreiche Regeneration wegen kleiner Regenerationszahl" UBYTE OneToOne 1 100 0.00 255.0 ECU_ADDRESS 0xC000B45A /end MEASUREMENT
/begin MEASUREMENT PFltRgn_stNumTxtMsg_mp "Status Text-Botschaft-Zahl für Partikelfilter" UBYTE OneToOne 1 100 0.00 255.0 ECU_ADDRESS 0xC000B45B /end MEASUREMENT
/begin MEASUREMENT PFltRgn_stOpMode "Betriebsartenanforderung für Partikelfilter" ULONG OneToOne 1 100 0.00 4294967295.00 ECU_ADDRESS 0xD0003274 /end MEASUREMENT
/begin MEASUREMENT PFltRgn_stPFltErr_mp "" UBYTE OneToOne 1 100 0.00 255.0 ECU_ADDRESS 0xC000B468 /end MEASUREMENT
/begin MEASUREMENT PFltRgn_stPrt "Motorschutzregeneration angefordert" UBYTE OneToOne 1 100 0.00 255.0 ECU_ADDRESS 0xD000203F /end MEASUREMENT
/begin MEASUREMENT PFltRgn_stRgnJmp "Status der Sprungerkennung" UBYTE OneToOne 1 100 0.00 255.0 ECU_ADDRESS 0xD0002040 /end MEASUREMENT
/begin MEASUREMENT PFltRgn_stRgnJmpNoMsk_mp "Unmaskierter Zustand Rampensprung möglich" UBYTE OneToOne 1 100 0.00 255.0 ECU_ADDRESS 0xC000B46A /end MEASUREMENT
/begin MEASUREMENT PFltRgn_stRgnNoCmplnEEP_mp "Im EEPROM gespeicherter Status Regeneration nicht erfolgreich beendet" UBYTE OneToOne 1 100 0.00 255.0 ECU_ADDRESS 0xC000B45C /end MEASUREMENT
/begin MEASUREMENT PFltRgn_stRgnNoCmpln_mp "Status Regeneration nicht erfolgreich beendet" UBYTE OneToOne 1 100 0.00 255.0 ECU_ADDRESS 0xC000B45D /end MEASUREMENT
/begin MEASUREMENT PFltRgn_stRgnOpMode "Erforderliche Betriebsart gemäß Regenerationsanforderung und Motorzustand" ULONG OneToOne 1 100 0.00 4294967295.00 ECU_ADDRESS 0xD0003278 /end MEASUREMENT
/begin MEASUREMENT PFltRgn_stRgnOpModeDel_mp "Verzögerte Betriebsartenanforderung" ULONG OneToOne 1 100 0.00 4294967295.00 ECU_ADDRESS 0xC0009218 /end MEASUREMENT
/begin MEASUREMENT PFltRgn_stRgnSwtPar_mp "Status Umschaltung auf den zweiten Grenzen-Parametersatz für Regenerationsanforderung nach Kraftstoffverbrauch, Betriebsstunden oder gefahrener Strecke" UBYTE OneToOne 1 100 0.00 255.0 ECU_ADDRESS 0xC000B469 /end MEASUREMENT
/begin MEASUREMENT PFltRgn_stSmkLim_mp "Status Erreichen der Rauchbegrenzungsmenge" UBYTE OneToOne 1 100 0.00 255.0 ECU_ADDRESS 0xC000B46B /end MEASUREMENT
/begin MEASUREMENT PFltRgn_stSuc "Status für erfolgreiche Regeneration" UBYTE OneToOne 1 100 0.00 255.0 ECU_ADDRESS 0xD0002041 /end MEASUREMENT
/begin MEASUREMENT PFltRgn_stSucAct_mp "Basis-Status erfolgreiche Regeneration" UBYTE OneToOne 1 100 0.00 255.0 ECU_ADDRESS 0xC000B45E /end MEASUREMENT
/begin MEASUREMENT PFltRgn_stTxtMsg "Status Text-Botschaft für Partikelfilter" UBYTE OneToOne 1 100 0.00 255.0 ECU_ADDRESS 0xD0002042 /end MEASUREMENT
/begin MEASUREMENT PFltRgn_tiChngRgnDel "Maximale Verzögerungszeit nach Änderung des Betriebsartenwunsches" SWORD Time_s 1 100 -327.6800 327.6700 ECU_ADDRESS 0xD0002F90 /end MEASUREMENT
/begin MEASUREMENT PFltRgn_tiChngRgnDelBas_mp "Unkorrigierte Maximale Verzögerungszeit nach Änderung des Betriebsartenwunsches" SWORD Time_s 1 100 -327.6800 327.6700 ECU_ADDRESS 0xC000A99E /end MEASUREMENT
/begin MEASUREMENT PFltRgn_tiChngRgn_mp "Zeitdauer nach Änderung des Betriebsartenwunsches" SWORD Time_s 1 100 -327.6800 327.6700 ECU_ADDRESS 0xC000A9A0 /end MEASUREMENT
/begin MEASUREMENT PFltRgn_tiHCCond_mp "HC Konditionierzeit" ULONG Time_s 1 100 0.00 42949672.9500 ECU_ADDRESS 0xC000925C /end MEASUREMENT
/begin MEASUREMENT PFltRgn_tiLckRgn_mp "Regenerationssperrzeit" SLONG Time_s 1 100 -21474836.4800 21474836.4700 ECU_ADDRESS 0xC000921C /end MEASUREMENT
/begin MEASUREMENT PFltRgn_tiOpEEP_mp "Motorbetriebszeit bei der letzten erfolgreichen Regeneration (im EEPROM gespeicherten Wert)" SLONG TimeEngOn 1 100 -2147483648.00 2147483647.00 FORMAT "%13.2" ECU_ADDRESS 0xC0009260 /end MEASUREMENT
/begin MEASUREMENT PFltRgn_tiOp_mp "Motorbetriebszeit bei der letzten erfolgreichen Regeneration" SLONG TimeEngOn 1 100 -2147483648.00 2147483647.00 FORMAT "%13.2" ECU_ADDRESS 0xC0009264 /end MEASUREMENT
/begin MEASUREMENT PFltRgn_tiPFltErr_mp "" UWORD TimePFltLimpHome 1 100 0.00 655350.0 FORMAT "%8.1" ECU_ADDRESS 0xC000A9C6 /end MEASUREMENT
/begin MEASUREMENT PFltRgn_tiRgnMax_mp "Maximale Regenerationszeit" SLONG Time_s 1 100 -21474836.4800 21474836.4700 ECU_ADDRESS 0xC0009220 /end MEASUREMENT
/begin MEASUREMENT PFltRgn_tiRgnMinEEP_mp "Verbliebene Zeit aus Wirkungsgradabhängige Regenertionsdauer aus letztem Fahrzyklus" SLONG Time_s 1 100 -21474836.4800 21474836.4700 ECU_ADDRESS 0xC0009268 /end MEASUREMENT
/begin MEASUREMENT PFltRgn_tiRgnMin_mp "Regenerationsszeit mit optimalem Regenerationswirkungsgrad" ULONG Time_s 1 100 0.00 42949672.9500 ECU_ADDRESS 0xC000926C /end MEASUREMENT
/begin MEASUREMENT PFltRgn_tiRgnSpo_mp "Spontane Regenerationszeit" SLONG Time_s 1 100 -21474836.4800 21474836.4700 ECU_ADDRESS 0xC0009224 /end MEASUREMENT
/begin MEASUREMENT PFltRgn_tiSnceRgn "Betriebsdauer seit der letzten erfolgreichen Regeneration" SLONG TimeEngOn 1 100 -2147483648.00 2147483647.00 FORMAT "%13.2" ECU_ADDRESS 0xD0002F94 /end MEASUREMENT
/begin MEASUREMENT PFltRgn_tiTmrEngPrt_mp "Regenerationsanfoderungszeit wegen Motorschutz" SLONG Time_s 1 100 -21474836.4800 21474836.4700 ECU_ADDRESS 0xC0009270 /end MEASUREMENT
/begin MEASUREMENT PFltRgn_tiTmrLckRgnEEP_mp "Im EEPROM gespeicherte Regenerationssperrzeit" SLONG Time_s 1 100 -21474836.4800 21474836.4700 ECU_ADDRESS 0xC0009228 /end MEASUREMENT
/begin MEASUREMENT PFltRgn_tiTmrLckRgn_mp "Timer zur Messung der Regenerations-Sperrzeit" SLONG Time_s 1 100 -21474836.4800 21474836.4700 ECU_ADDRESS 0xC000922C /end MEASUREMENT
/begin MEASUREMENT PFltRgn_tiTmrLstRgnEEP_mp "Verbliebene Zeit aus Regeneration nach Zähler aus letztem Fahrzyklus" SLONG Time_s 1 100 -21474836.4800 21474836.4700 ECU_ADDRESS 0xC0009274 /end MEASUREMENT
/begin MEASUREMENT PFltRgn_tiTmrLstRgn_mp "Regenerationsanforderungszeit wegen Kraftstoffverbrauch, Betriebsdauer oder gefahrene Strecke" SLONG Time_s 1 100 -21474836.4800 21474836.4700 ECU_ADDRESS 0xC0009278 /end MEASUREMENT
/begin MEASUREMENT PFltRgn_tiTmrRgnMax_mp "Timer für maximale Dauer der Regeneration" SLONG Time_s 1 100 -21474836.4800 21474836.4700 ECU_ADDRESS 0xC0009230 /end MEASUREMENT
/begin MEASUREMENT PFltRgn_tiTmrRgnSpo_mp "Spontane Regenerationszeit" SLONG Time_s 1 100 -21474836.4800 21474836.4700 ECU_ADDRESS 0xC0009234 /end MEASUREMENT
/begin MEASUREMENT PFltRgn_tiTmrStOvrRun_mp "Zeit in Schubbetrieb" SLONG Time_s 1 100 -21474836.4800 21474836.4700 ECU_ADDRESS 0xC0009214 /end MEASUREMENT
/begin MEASUREMENT PFltRgn_vAvrgSnceRgn_mp "Durchschnittsgeschwindigkeit seit der letzten erfolgreichen Regeneration" SWORD Vel 1 100 -327.6800 327.6700 ECU_ADDRESS 0xC000A9C8 /end MEASUREMENT
/begin MEASUREMENT PFltSrv_numSrvCs "Servicefallnummer" UBYTE OneToOne 1 100 0.00 255.0 ECU_ADDRESS 0xD0002043 /end MEASUREMENT
/begin MEASUREMENT PFltSrv_stOpMode "Anforderung der Betriebsart für die Serviceregeneration" ULONG OneToOne 1 100 0.00 4294967295.00 ECU_ADDRESS 0xD000327C /end MEASUREMENT
/begin MEASUREMENT PFltSrv_stRgnOn "Status Partikelfilter-Serviceregeneration aktiv und freigegeben" UBYTE OneToOne 1 100 0.00 255.0 ECU_ADDRESS 0xD0002044 /end MEASUREMENT
/begin MEASUREMENT PFltSrv_stRgnSuc "Status Partikelfilter-Serviceregeneration erfolgreich" UBYTE OneToOne 1 100 0.00 255.0 ECU_ADDRESS 0xD0002045 /end MEASUREMENT
/begin MEASUREMENT PFltSrv_stRgnTstr "Status der Partikelfilter-Serviceregeneration für den Servicetester" UWORD OneToOne 1 100 0.00 65535.00 ECU_ADDRESS 0xD0001620 /end MEASUREMENT
/begin MEASUREMENT PFlt_ctEngPrtRgn_mp "Motorschutz-Regenerationszähler" UWORD OneToOne 1 100 0.00 65535.00 ECU_ADDRESS 0xC000A9EA /end MEASUREMENT
/begin MEASUREMENT PFlt_ctOvldHealObsNO2_mp "" UWORD OneToOne 1 100 0.00 65535.00 ECU_ADDRESS 0xC000AA32 /end MEASUREMENT
/begin MEASUREMENT PFlt_ctRgnStep1_mp "Regenerationsschritt 1" UBYTE OneToOne 1 100 0.00 255.0 ECU_ADDRESS 0xC000B47F /end MEASUREMENT
/begin MEASUREMENT PFlt_ctRgnStep2_mp "Regenerationsschritt 2" UBYTE OneToOne 1 100 0.00 255.0 ECU_ADDRESS 0xC000B480 /end MEASUREMENT
/begin MEASUREMENT PFlt_ctRgnStep3_mp "Regenerationsschritt 3" UBYTE OneToOne 1 100 0.00 255.0 ECU_ADDRESS 0xC000B481 /end MEASUREMENT
/begin MEASUREMENT PFlt_ctRgnStep4_mp "Regenerationsschritt 4" UBYTE OneToOne 1 100 0.00 255.0 ECU_ADDRESS 0xC000B482 /end MEASUREMENT
/begin MEASUREMENT PFlt_ctRgnStep5_mp "Regenerationsschritt 5" UBYTE OneToOne 1 100 0.00 255.0 ECU_ADDRESS 0xC000B483 /end MEASUREMENT
/begin MEASUREMENT PFlt_ctRgnStep6_mp "Regenerationsschritt 6" UBYTE OneToOne 1 100 0.00 255.0 ECU_ADDRESS 0xC000B484 /end MEASUREMENT
/begin MEASUREMENT PFlt_ctRgnStep7_mp "Regenerationsschritt 1" UBYTE OneToOne 1 100 0.00 255.0 ECU_ADDRESS 0xC000B485 /end MEASUREMENT
/begin MEASUREMENT PFlt_ctRgnStep8_mp "Regenerationsschritt 8" UBYTE OneToOne 1 100 0.00 255.0 ECU_ADDRESS 0xC000B486 /end MEASUREMENT
/begin MEASUREMENT PFlt_ctRgnSum_mp "Summe Regenerationschritte 1 bis 8" UWORD OneToOne 1 100 0.00 65535.00 ECU_ADDRESS 0xC000A9EC /end MEASUREMENT
/begin MEASUREMENT PFlt_dmO2Aprx_mp "Zur ausgewählten Luftbank umgeschalteter Betriebspunktanzeiger für Kennlinie PFlt_tOutrDesMsFlwO2_CUR" SWORD AirMassPerTime 1 100 -3276.800 3276.700 ECU_ADDRESS 0xC000AA36 /end MEASUREMENT
/begin MEASUREMENT PFlt_dVolMapIn_mp "Copy der Message PFlt_dvol% für Ansicht des korrekten Prozesspunktes während des Testens" SWORD CubMtrPerHr 1 100 -3276.800 3276.700 FORMAT "%8.3" ECU_ADDRESS 0xC000A9EE /end MEASUREMENT
/begin MEASUREMENT PFlt_dvolMaxSty_mp "Maximaler stationärer Abgasvolumenstrom zur Überprüfung des maximalen Differenzdrucks im Nachlauf" SWORD AirVolPerTime 1 100 -3276.800 3276.700 FORMAT "%8.3" ECU_ADDRESS 0xC000A9D6 /end MEASUREMENT
/begin MEASUREMENT PFlt_dvolPFltEGInMon_mp "Zur ausgewählten Luftbank umgeschalteter Betriebspunktanzeiger für Kennfeld PFlt_pDiffCharMonMin_MAP" SWORD CubMtrPerHr 1 100 -3276.800 3276.700 FORMAT "%8.3" ECU_ADDRESS 0xC000A9D8 /end MEASUREMENT
/begin MEASUREMENT PFlt_facAshCorMapIn_mp "" SWORD Fact 1 100 -4.000000 3.999878 ECU_ADDRESS 0xC000A9F0 /end MEASUREMENT
/begin MEASUREMENT PFlt_facNO2RgnMapIn_mp "neutral eingang von PFlt_facNO2RgnInhRgn_CUR" SWORD Fact 1 100 -4.000000 3.999878 ECU_ADDRESS 0xC000A9F2 /end MEASUREMENT
/begin MEASUREMENT PFlt_lAvrgRgn "Mittlere Strecke der Regeneration in Kilometer" UWORD LengthKm 1 100 0.00 1310700. FORMAT "%8.0" ECU_ADDRESS 0xD0001622 /end MEASUREMENT
/begin MEASUREMENT PFlt_lOvldHealObsNO2_mp "" ULONG OneToOne 1 100 0.00 4294967295.00 ECU_ADDRESS 0xC000927C /end MEASUREMENT
/begin MEASUREMENT PFlt_mSotDvt_mp "Abweichung zwischen gemessener und kontinuierlich simulierter Russmasse" SWORD mSoot_g 1 100 -327.6800 327.6700 FORMAT "%8.4" ECU_ADDRESS 0xC000A9DA /end MEASUREMENT
/begin MEASUREMENT PFlt_mSotOvldHeal "" SWORD mSoot_g 1 100 -327.6800 327.6700 FORMAT "%8.4" ECU_ADDRESS 0xD000121A /end MEASUREMENT
/begin MEASUREMENT PFlt_mSotSimMapIn_mp "Copy der Message PFlt_mSotSim% für Ansicht des korrekten Prozesspunktes während des Testens" SWORD mSoot_g 1 100 -327.6800 327.6700 FORMAT "%8.4" ECU_ADDRESS 0xC000A9F4 /end MEASUREMENT
/begin MEASUREMENT PFlt_mSot_mp "Zur ausgewählten Luftbank umgeschalteter Betriebspunktanzeiger für Kennlinie PFlt_tOutrDesMsSot_CUR" SWORD mSoot_g 1 100 -327.6800 327.6700 FORMAT "%8.4" ECU_ADDRESS 0xC000AA38 /end MEASUREMENT
/begin MEASUREMENT PFlt_numIdxCntRgn_mp "Index der Regeneration" UBYTE OneToOne 1 100 0.00 255.0 ECU_ADDRESS 0xC000B472 /end MEASUREMENT
/begin MEASUREMENT PFlt_pAPSBPSDiff_mp "absoluter Wertunterschied zwischen APSCD_pVal und BPSCD_pLin" SWORD Pres_hPa 1 100 -32768.00 3500.00 ECU_ADDRESS 0xC000A9F6 /end MEASUREMENT
/begin MEASUREMENT PFlt_pAPSDvt_mp "Abweichung von APSCD_pVal bezüglich Mittelwert von BPSCD_pLin und korrigiertem PFlt_pPre" SWORD Pres_hPa 1 100 -32768.00 3500.00 ECU_ADDRESS 0xC000A9F8 /end MEASUREMENT
/begin MEASUREMENT PFlt_pAPSPFltPresDiff_mp "absoluter Wertunterschied zwischen APSCD_pVal und korrigiertem PFlt_pPre" SWORD Pres_hPa 1 100 -32768.00 3500.00 ECU_ADDRESS 0xC000A9FA /end MEASUREMENT
/begin MEASUREMENT PFlt_pBPSDvt_mp "Abweichung von BPSCD_pLin bezüglich Mittelwert von APSCD_pVal und korrigiertem PFlt_pPre" SWORD Pres_hPa 1 100 -32768.00 3500.00 ECU_ADDRESS 0xC000A9FC /end MEASUREMENT
/begin MEASUREMENT PFlt_pBPSPFltPresDiff_mp "absoluter Wertunterschied zwischen BPSCD_pLin und korrigiertem PFlt_pPre" SWORD Pres_hPa 1 100 -32768.00 3500.00 ECU_ADDRESS 0xC000A9FE /end MEASUREMENT
/begin MEASUREMENT PFlt_pDiffCharMonMin_mp "Untere Grenze der Überwachung der DPF-Charakteristik mit Hilfe des Differenzdruck" SWORD Pres_hPa 1 100 -32768.00 3500.00 ECU_ADDRESS 0xC000A9DC /end MEASUREMENT
/begin MEASUREMENT PFlt_pDiffMaxStyOfsCor_mp "Stationären Maximalwerte des Differenzdrucks nach Offset-Korrektur" SWORD Pres_hPa 1 100 -32768.00 3500.00 ECU_ADDRESS 0xC000A9DE /end MEASUREMENT
/begin MEASUREMENT PFlt_pDiffMaxSty_mp "Stationären Maximalwerte des Differenzdrucks" SWORD Pres_hPa 1 100 -32768.00 3500.00 ECU_ADDRESS 0xC000A9E0 /end MEASUREMENT
/begin MEASUREMENT PFlt_pDiffNoDstrMin_mp "Von stationärem Abgasvolumenstrom abhängiger minimaler Differenzdruck in Nachlauf zur Unterstellung eines zerstörten Partikelfilters" SWORD Pres_hPa 1 100 -32768.00 3500.00 ECU_ADDRESS 0xC000A9E2 /end MEASUREMENT
/begin MEASUREMENT PFlt_pPFltB1B2Diff_mp "absoluter Wertunterschied zwischen PFlt_pPreCorrB1_mp und PFlt_pPreCorrB2_mp" SWORD Pres_hPa 1 100 -32768.00 3500.00 ECU_ADDRESS 0xC000AA00 /end MEASUREMENT
/begin MEASUREMENT PFlt_pPFltOvldLckRgn_mp "Druckschwelle Überladungserkennung" SWORD Pres_hPa 1 100 -32768.00 3500.00 ECU_ADDRESS 0xC000AA02 /end MEASUREMENT
/begin MEASUREMENT PFlt_pPFltOvldTrqLim_mp "Druckschwelle Überladungserkennung" SWORD Pres_hPa 1 100 -32768.00 3500.00 ECU_ADDRESS 0xC000AA04 /end MEASUREMENT
/begin MEASUREMENT PFlt_pPFltPresDvt_mp "Abweichung des korrigierten PFlt_pPre bezüglich Mittelwert von APSCD_pVal und BPSCD_pLin" SWORD Pres_hPa 1 100 -32768.00 3500.00 ECU_ADDRESS 0xC000AA06 /end MEASUREMENT
/begin MEASUREMENT PFlt_pPreAshOilCorr_mp "Ausgang des PFlt_pPre-Korrekturkennfelds mit den Eingängen PFlt_dvol und PFlt_mAshOil" SWORD Pres_hPa 1 100 -32768.00 3500.00 ECU_ADDRESS 0xC000AA08 /end MEASUREMENT
/begin MEASUREMENT PFlt_pPreCorr_mp "korrigierter Wert von PFlt_pPre zur Nutzung durch projektspezifische Druck-Plausibilitätsprüfungen" SWORD Pres_hPa 1 100 -32768.00 3500.00 ECU_ADDRESS 0xC000AA34 /end MEASUREMENT
/begin MEASUREMENT PFlt_pPreOxiCFlt_mp "" SWORD Pres_hPa 1 100 -32768.00 3500.00 ECU_ADDRESS 0xC000AA0A /end MEASUREMENT
/begin MEASUREMENT PFlt_pPreSotAshCorrSum_mp "Summe aus PFlt_pPreSotSimCorr_mp und PFlt_pPreAshOilCorr_mp" SWORD Pres_hPa 1 100 -32768.00 3500.00 ECU_ADDRESS 0xC000AA0C /end MEASUREMENT
/begin MEASUREMENT PFlt_pPreSotSimCorr_mp "Ausgang des PFlt_pPre Korrekturkennfelds mit den Eingängen PFlt_dvol und PFlt_mSotSim" SWORD Pres_hPa 1 100 -32768.00 3500.00 ECU_ADDRESS 0xC000AA0E /end MEASUREMENT
/begin MEASUREMENT PFlt_pPreVolCorr_mp "Ausgang der PFlt_pPre Korrekturkennlinie mit den Eingängen PFlt_dvol und PFlt_dvol" SWORD Pres_hPa 1 100 -32768.00 3500.00 ECU_ADDRESS 0xC000AA10 /end MEASUREMENT
/begin MEASUREMENT PFlt_rEngPrtRgn_mp "Motorschutz Regenerationsverhältnis der Aufgabezeit und letzter Regenerationszeit" SWORD Prc 1 100 -400.0000 399.9878 ECU_ADDRESS 0xC000AA12 /end MEASUREMENT
/begin MEASUREMENT PFlt_resFlowOvldLckRgn_mp "Stromungswiderstumdwert für regenaration imfall des überlandungserkennung" SWORD Res_hPaHrPerCM 1 100 -3.276800 3.276700 FORMAT "%8.6" ECU_ADDRESS 0xC000AA14 /end MEASUREMENT
/begin MEASUREMENT PFlt_resFlowOvldTrqLim_mp "Stromungswiderstumdwert für momentenbegresung imfall des überladungserkennung" SWORD Res_hPaHrPerCM 1 100 -3.276800 3.276700 FORMAT "%8.6" ECU_ADDRESS 0xC000AA16 /end MEASUREMENT
/begin MEASUREMENT PFlt_resFlwMax_mp "Maximaler Strömungswiderstand abhängig von kontinuirlich simulierter Russmasse" SWORD Res_hPaHrPerCM 1 100 -3.276800 3.276700 FORMAT "%8.6" ECU_ADDRESS 0xC000A9E4 /end MEASUREMENT
/begin MEASUREMENT PFlt_resFlwMin_mp "Mnimaler Strömungswiderstand abhängig von kontinuirlich simulierter Russmasse" SWORD Res_hPaHrPerCM 1 100 -3.276800 3.276700 FORMAT "%8.6" ECU_ADDRESS 0xC000A9E6 /end MEASUREMENT
/begin MEASUREMENT PFlt_rSotMsDvt_mp "Normierte Abweichung zwischen gemessener und kontinuierlich simulierter Russmasse" SWORD RatSotSot 1 100 -8.192000 8.191750 FORMAT "%8.6" ECU_ADDRESS 0xC000A9E8 /end MEASUREMENT
/begin MEASUREMENT PFlt_stAPSPlausDefHigh_mp "APSCD_pVal Abweichung ist positiv und fehlerhaft" UBYTE OneToOne 1 100 0.00 255.0 ECU_ADDRESS 0xC000B473 /end MEASUREMENT
/begin MEASUREMENT PFlt_stAPSPlausDefLow_mp "APSCD_pVal Abweichung ist negativ und fehlerhaft" UBYTE OneToOne 1 100 0.00 255.0 ECU_ADDRESS 0xC000B474 /end MEASUREMENT
/begin MEASUREMENT PFlt_stBPSPlausDefHigh_mp "BPSCD_pLin Abweichung ist positiv und fehlerhaft" UBYTE OneToOne 1 100 0.00 255.0 ECU_ADDRESS 0xC000B475 /end MEASUREMENT
/begin MEASUREMENT PFlt_stBPSPlausDefLow_mp "BPSCD_pLin Abweichung ist negativ und fehlerhaft" UBYTE OneToOne 1 100 0.00 255.0 ECU_ADDRESS 0xC000B476 /end MEASUREMENT
/begin MEASUREMENT PFlt_stDvolSty_mp "Status stationärer Abgasvolumenstrom" UBYTE OneToOne 1 100 0.00 255.0 ECU_ADDRESS 0xC000B46C /end MEASUREMENT
/begin MEASUREMENT PFlt_stEngPrtRgn_mp "Status der Motorschutz-Regeneration" UWORD OneToOne 1 100 0.00 65535.00 ECU_ADDRESS 0xC000AA18 /end MEASUREMENT
/begin MEASUREMENT PFlt_stFlwRstnHi_mp "Status Strömungswiderstand zu hoch" UBYTE OneToOne 1 100 0.00 255.0 ECU_ADDRESS 0xC000B46D /end MEASUREMENT
/begin MEASUREMENT PFlt_stFlwRstnLo_mp "Status Strömungswiderstand zu niedrig" UBYTE OneToOne 1 100 0.00 255.0 ECU_ADDRESS 0xC000B46E /end MEASUREMENT
/begin MEASUREMENT PFlt_stOvldHeal "" UBYTE OneToOne 1 100 0.00 255.0 ECU_ADDRESS 0xD0002046 /end MEASUREMENT
/begin MEASUREMENT PFlt_stPFltOvldHealCond_mp "" UBYTE OneToOne 1 100 0.00 255.0 ECU_ADDRESS 0xC000B477 /end MEASUREMENT
/begin MEASUREMENT PFlt_stPresPlausDefHigh_mp "PFlt_pPreCorr_mp ist positiv und fehlerhaft" UBYTE OneToOne 1 100 0.00 255.0 ECU_ADDRESS 0xC000B478 /end MEASUREMENT
/begin MEASUREMENT PFlt_stPresPlausDefLow_mp "PFlt_pPreCorr_mp ist negativ und fehlerhaft" UBYTE OneToOne 1 100 0.00 255.0 ECU_ADDRESS 0xC000B479 /end MEASUREMENT
/begin MEASUREMENT PFlt_stPresPlausLoIdl_mp "Bit-kodierte Informationen, um projektspezifische Druck-Plausibilitätsprüfungen im niedrigen Leerlaufzustand zu ermöglichen" UBYTE OneToOne 1 100 0.00 255.0 ECU_ADDRESS 0xC000B47A /end MEASUREMENT
/begin MEASUREMENT PFlt_stPresPlausOk_mp "Zur Anzeige, ob projektspezifische Druck-Plausibilitätsprüfungen in Ordnung sind" UBYTE OneToOne 1 100 0.00 255.0 ECU_ADDRESS 0xC000B47B /end MEASUREMENT
/begin MEASUREMENT PFlt_stPresPlausTst_mp "Zustandsgröße zur Anzeige, ob projektspezifische Druck-Plausibilitätsprüfungen aktiv sind oder nicht" UBYTE OneToOne 1 100 0.00 255.0 ECU_ADDRESS 0xC000B47C /end MEASUREMENT
/begin MEASUREMENT PFlt_stPresPlaus_mp "Bit-kodierte Informationen, um projektspezifische Druck-Plausibilitätsprüfungen zu ermöglichen" UBYTE OneToOne 1 100 0.00 255.0 ECU_ADDRESS 0xC000B487 /end MEASUREMENT
/begin MEASUREMENT PFlt_stRgnRlsOff_mp "Filter is no longer regeneratable" UBYTE OneToOne 1 100 0.00 255.0 ECU_ADDRESS 0xC000B47D /end MEASUREMENT
/begin MEASUREMENT PFlt_stRlsmSotCtl_mp "Status der Motorschutz-Regeneration zur Freigabe der Rußregelung" UBYTE OneToOne 1 100 0.00 255.0 ECU_ADDRESS 0xC000B47E /end MEASUREMENT
/begin MEASUREMENT PFlt_stSysErr2Can "" UBYTE OneToOne 1 100 0.00 255.0 ECU_ADDRESS 0xD0002047 /end MEASUREMENT
/begin MEASUREMENT PFlt_stSysFail "Status Systemfehler für Partikelfilter-Überwachung" UBYTE OneToOne 1 100 0.00 255.0 ECU_ADDRESS 0xD0002048 /end MEASUREMENT
/begin MEASUREMENT PFlt_stTrgCharMon_mp "Trigger für Überwachung des Partikelfilters durch Überprüfung des berechneten Strömungswiderstands" UBYTE OneToOne 1 100 0.00 255.0 ECU_ADDRESS 0xC000B46F /end MEASUREMENT
/begin MEASUREMENT PFlt_stTrgCharPDiffMon_mp "Trigger für Überwachung des Partikelfilters mit Hilfe des Differenzdruck" UBYTE OneToOne 1 100 0.00 255.0 ECU_ADDRESS 0xC000B470 /end MEASUREMENT
/begin MEASUREMENT PFlt_stTrgChkDvt_mp "Trigger für Überwachung der Abweichung von simulierter und gemessener Partikelmasse" UBYTE OneToOne 1 100 0.00 255.0 ECU_ADDRESS 0xC000B471 /end MEASUREMENT
/begin MEASUREMENT PFlt_swtActv "Message zur Deaktivierung der Partikelfilter-Funktionalität" UBYTE OneToOne 1 100 0.00 255.0 ECU_ADDRESS 0xD0002049 /end MEASUREMENT
/begin MEASUREMENT PFlt_tAdaptTrbnUs_mp "Zur ausgewählten Luftbank umgeschalteter Betriebspunktanzeiger für Kennlinie PFlt_tInrDesTempTrbn_CUR" SWORD Temp_Cels 1 100 -3549.940 3003.560 ECU_ADDRESS 0xC000AA3A /end MEASUREMENT
/begin MEASUREMENT PFlt_tAdpaTOxiCatDs_mp "Zur ausgewählten Luftbank umgeschalteter Betriebspunktanzeiger für Kennlinie PFlt_tOutrDesTempDs_CUR" SWORD Temp_Cels 1 100 -3549.940 3003.560 ECU_ADDRESS 0xC000AA3C /end MEASUREMENT
/begin MEASUREMENT PFlt_tiNO2RgnMapIn_mp "neutral eingang von PFlt_factiNO2RgnInhRgn_CUR" SWORD Time_TempSnceRgn16 1 100 -1310720. 1310680. FORMAT "%8.0" ECU_ADDRESS 0xC000AA1A /end MEASUREMENT
/begin MEASUREMENT PFlt_tInrDes "Sollwert für die innere Schleife des Abgastemperaturereglers" SWORD Temp_Cels 1 100 -3549.940 3003.560 ECU_ADDRESS 0xD000121C /end MEASUREMENT
/begin MEASUREMENT PFlt_tInrDesAPSCor_mp "" SWORD TempDiff_Cels 1 100 -3276.800 3276.700 FORMAT "%8.3" ECU_ADDRESS 0xC000AA3E /end MEASUREMENT
/begin MEASUREMENT PFlt_tiOpOld_mp "Aus EEPROM gelesene Dauer des Motorschutzes bei der Initialisierung" ULONG TimeEngOn 1 100 0.00 4294967295.00 FORMAT "%13.2" ECU_ADDRESS 0xC0009280 /end MEASUREMENT
/begin MEASUREMENT PFlt_tiSnceFstEngPrtRgn_mp "Zeit seit der ersten Motorschutz-Regeneration" ULONG TimeEngOn 1 100 0.00 4294967295.00 FORMAT "%13.2" ECU_ADDRESS 0xC0009284 /end MEASUREMENT
/begin MEASUREMENT PFlt_tOutrDes "Sollwert des äußeren Abgastemperaturregelkreises" SWORD Temp_Cels 1 100 -3549.940 3003.560 ECU_ADDRESS 0xD000121E /end MEASUREMENT
/begin MEASUREMENT PFlt_tOxiPreDiffMax_mp "Maximaler Schwellwert für die Differenz zwischen Temperatur vor Partikelfilter und stationärer Temperatur für den Oxicat" SWORD Temp_Cels 1 100 -3549.940 3003.560 ECU_ADDRESS 0xC000AA1C /end MEASUREMENT
/begin MEASUREMENT PFlt_tOxiPreDiff_mp "Difference between upstream temperature and stationary temperature" SWORD Temp_Cels 1 100 -3549.940 3003.560 ECU_ADDRESS 0xC000AA1E /end MEASUREMENT
/begin MEASUREMENT PFlt_tOxiPreMax_mp "Maximale Temperatur vor Partikelfilter für den Oxicat" SWORD Temp_Cels 1 100 -3549.940 3003.560 ECU_ADDRESS 0xC000AA20 /end MEASUREMENT
/begin MEASUREMENT PFlt_tOxiPreRgnMax_mp "Maximaler Abgasgegendruck vor Oxicat im Regenerationsfall" SWORD Temp_Cels 1 100 -3549.940 3003.560 ECU_ADDRESS 0xC000AA22 /end MEASUREMENT
/begin MEASUREMENT PFlt_tOxiPreSty_mp "" SWORD Temp_Cels 1 100 -3549.940 3003.560 ECU_ADDRESS 0xC000AA24 /end MEASUREMENT
/begin MEASUREMENT PFlt_tPreDiffMax_mp "Maximaler Schwellwert für die Differenz zwischen Temperatur vor Partikelfilter und Stationärer Temperatur für Oxicat" SWORD Temp_Cels 1 100 -3549.940 3003.560 ECU_ADDRESS 0xC000AA26 /end MEASUREMENT
/begin MEASUREMENT PFlt_tPreDiff_mp "Difference between upstream temperature and stationary temperature" SWORD Temp_Cels 1 100 -3549.940 3003.560 ECU_ADDRESS 0xC000AA28 /end MEASUREMENT
/begin MEASUREMENT PFlt_tPreMax_mp "Maximale Temperatur vor Partikelfilter" SWORD Temp_Cels 1 100 -3549.940 3003.560 ECU_ADDRESS 0xC000AA2A /end MEASUREMENT
/begin MEASUREMENT PFlt_tPreRgnMax_mp "Maximaler Abgasdruck im Regenerationsfall" SWORD Temp_Cels 1 100 -3549.940 3003.560 ECU_ADDRESS 0xC000AA2C /end MEASUREMENT
/begin MEASUREMENT PFlt_tPreSty_mp "Stationäre Solltemperatur vor Partikelfilter" SWORD Temp_Cels 1 100 -3549.940 3003.560 ECU_ADDRESS 0xC000AA2E /end MEASUREMENT
/begin MEASUREMENT PFlt_trqTraRpmRdc_mp "" SWORD Trq 1 100 -3276.800 3276.700 ECU_ADDRESS 0xC000AA30 /end MEASUREMENT
/begin MEASUREMENT PhyMod_facEtaCor "aktueller Wirkungsgradkorrekturfaktor" SWORD Fact 1 100 -4.000000 3.999878 ECU_ADDRESS 0xD0001248 /end MEASUREMENT
/begin MEASUREMENT PhyMod_facEtaCor0 "aktueller Wirkungsgradkorrekturfaktor" SWORD Fact 1 100 -4.000000 3.999878 ECU_ADDRESS 0xD0001246 /end MEASUREMENT
/begin MEASUREMENT PhyMod_facEtaCor1_mp "" SWORD Fact 1 100 -4.000000 3.999878 ECU_ADDRESS 0xC000AA5A /end MEASUREMENT
/begin MEASUREMENT PhyMod_facEtaCorLim_mp "" SWORD Fact 1 100 -4.000000 3.999878 ECU_ADDRESS 0xC000AA5C /end MEASUREMENT
/begin MEASUREMENT PhyMod_facEtaCorNxt "künftiger Wirkungsgradkorrekturfaktor" SWORD Fact 1 100 -4.000000 3.999878 ECU_ADDRESS 0xD000124A /end MEASUREMENT
/begin MEASUREMENT PhyMod_facRmpVal "Rampenwert fürs umschalten zwischen akutellen und gewünschten Modus" SWORD CoEOMSwt_S16 1 100 -2.000000 1.999939 FORMAT "%8.6" ECU_ADDRESS 0xD000124C /end MEASUREMENT
/begin MEASUREMENT PhyMod_GenCurMapID_mp "" UBYTE OneToOne 1 100 0.00 255.0 ECU_ADDRESS 0xC000B493 /end MEASUREMENT
/begin MEASUREMENT PhyMod_InjTyp "Einspritzart" UBYTE PhyMod_InjName 1 100 0.00 1. FORMAT "%2.0" ECU_ADDRESS 0xD000205E /end MEASUREMENT
/begin MEASUREMENT PhyMod_MskNxt "Gewünschte Betriebsmaske" ULONG OneToOne 1 100 0.00 4294967295.00 ECU_ADDRESS 0xD0003280 /end MEASUREMENT
/begin MEASUREMENT PhyMod_MskPrs "Aktuelle Betriebsmaske" ULONG OneToOne 1 100 0.00 4294967295.00 ECU_ADDRESS 0xD0003284 /end MEASUREMENT
/begin MEASUREMENT PhyMod_OpModeMsk "Betriebsmasken Feld" ULONG OneToOne 1 100 0.00 4294967295.00 ARRAY_SIZE 10 ECU_ADDRESS 0xD0003288 /end MEASUREMENT
/begin MEASUREMENT PhyMod_OpModeNxt "gewünschte Betriebsart" UBYTE OneToOne 1 100 0.00 255.0 ECU_ADDRESS 0xD000205F /end MEASUREMENT
/begin MEASUREMENT PhyMod_OpModePrs "aktueller Betriebsmodus" UBYTE OneToOne 1 100 0.00 255.0 ECU_ADDRESS 0xD0002060 /end MEASUREMENT
/begin MEASUREMENT PhyMod_pPCRDiff0_mp "" SWORD Pres_hPa 1 100 -32768.00 3500.00 ECU_ADDRESS 0xC000AA5E /end MEASUREMENT
/begin MEASUREMENT PhyMod_pPCRDiff1_mp "" SWORD Pres_hPa 1 100 -32768.00 3500.00 ECU_ADDRESS 0xC000AA60 /end MEASUREMENT
/begin MEASUREMENT PhyMod_pPCROpt0_mp "" SWORD Pres_hPa 1 100 -32768.00 3500.00 ECU_ADDRESS 0xC000AA62 /end MEASUREMENT
/begin MEASUREMENT PhyMod_pPCROpt1_mp "" SWORD Pres_hPa 1 100 -32768.00 3500.00 ECU_ADDRESS 0xC000AA64 /end MEASUREMENT
/begin MEASUREMENT PhyMod_pwrClntEntry "Leistungseintrag des Motors in das Kühlwasser" SWORD Pwr2 1 100 -617662.2 617643.4 FORMAT "%8.1" ECU_ADDRESS 0xD000124E /end MEASUREMENT
/begin MEASUREMENT PhyMod_pwrClntEntry_mp "Leistungseintrag in das Kühlwasser ohne Begrenzung auf 0" SLONG Pwr2 1 100 -40479113113.6 40479113094.7 FORMAT "%13.1" ECU_ADDRESS 0xC0009288 /end MEASUREMENT
/begin MEASUREMENT PhyMod_pwrEGLos_mp "Verlustleistung in Abgas und an Motorumgebung" SWORD Pwr2 1 100 -617662.2 617643.4 FORMAT "%8.1" ECU_ADDRESS 0xC000AA66 /end MEASUREMENT
/begin MEASUREMENT PhyMod_pwrLos_mp "gesamte Verlustleistung" SLONG Pwr2 1 100 -40479113113.6 40479113094.7 FORMAT "%13.1" ECU_ADDRESS 0xC000928C /end MEASUREMENT
/begin MEASUREMENT PhyMod_pwrMech_mp "berechnete mechanische Leistung aus aktuellem Moment" SLONG Pwr2 1 100 -40479113113.6 40479113094.7 FORMAT "%13.1" ECU_ADDRESS 0xC0009290 /end MEASUREMENT
/begin MEASUREMENT PhyMod_pwrTheo_mp "berechnete theoretische Leistung aus zugeführter Kraftstoffmenge" SLONG Pwr2 1 100 -40479113113.6 40479113094.7 FORMAT "%13.1" ECU_ADDRESS 0xC0009294 /end MEASUREMENT
/begin MEASUREMENT PhyMod_StageNxt "gewünschte Betriebsstufe" UBYTE OneToOne 1 100 0.00 255.0 ECU_ADDRESS 0xD0002061 /end MEASUREMENT
/begin MEASUREMENT PhyMod_StagePrs "aktuelle Betriebsstufe" UBYTE OneToOne 1 100 0.00 255.0 ECU_ADDRESS 0xD0002062 /end MEASUREMENT
/begin MEASUREMENT PhyMod_stCmpMsk_mp "Vergleichsmake" UBYTE OneToOne 1 100 0.00 255.0 ECU_ADDRESS 0xC000B494 /end MEASUREMENT
/begin MEASUREMENT PhyMod_stNxt "Künftige Betriebsart für die Momentenstruktur" UBYTE PhyMod_OpModeName 1 100 0.00 9. FORMAT "%2.0" ECU_ADDRESS 0xD0002063 /end MEASUREMENT
/begin MEASUREMENT PhyMod_stPrs "Aktuelle Betriebsart für die Momentenstruktur" UBYTE PhyMod_OpModeName 1 100 0.00 9. FORMAT "%2.0" ECU_ADDRESS 0xD0002064 /end MEASUREMENT
/begin MEASUREMENT PPC_pGovDiff_mp "Differenzdruck zwischen applikativem Nominaldruck und dem SCR Pumpendruck" SWORD Pres_hPa 1 100 -32768.00 3500.00 ECU_ADDRESS 0xC000AA68 /end MEASUREMENT
/begin MEASUREMENT PPC_rDycDT1_mp "D-Anteil des Dutycycles (PPC_rDycPID_mp)" SWORD Prc 1 100 -400.0000 399.9878 ECU_ADDRESS 0xC000AA6A /end MEASUREMENT
/begin MEASUREMENT PPC_rDycGov "Limitierter Dutycycle der PID Druckregelung" SWORD Prc 1 100 -400.0000 399.9878 ECU_ADDRESS 0xD0001220 /end MEASUREMENT
/begin MEASUREMENT PPC_rDycGov_mp "" SWORD Prc 1 100 -400.0000 399.9878 ECU_ADDRESS 0xC000AA6C /end MEASUREMENT
/begin MEASUREMENT PPC_rDycI_mp "I-Antei des Dutycycles (PPC_rDycPID_mp)" SWORD Prc 1 100 -400.0000 399.9878 ECU_ADDRESS 0xC000AA6E /end MEASUREMENT
/begin MEASUREMENT PPC_rDycPID_mp "Dutycycles des PID Reglers der Druckregelung" SWORD Prc 1 100 -400.0000 399.9878 ECU_ADDRESS 0xC000AA70 /end MEASUREMENT
/begin MEASUREMENT PPC_rDycP_mp "P-Anteil des Dutycycles (PPC_rDycPID_mp)" SWORD Prc 1 100 -400.0000 399.9878 ECU_ADDRESS 0xC000AA72 /end MEASUREMENT
/begin MEASUREMENT PPC_rDyc_mp "Duty Cycle Pumpenmotor" SWORD Prc 1 100 -400.0000 399.9878 ECU_ADDRESS 0xC000AA74 /end MEASUREMENT
/begin MEASUREMENT Pr_ierrllred "Prio Erregerstrombegrenzung durch LL Sägen" UBYTE Def_dez_ub_q1 1 100 0.00 255. FORMAT "%3.0" ECU_ADDRESS 0xC000B48B /end MEASUREMENT
/begin MEASUREMENT Pr_ierrtred "Prio Erregerstromanforderung wegen Hochtemperatur" UBYTE Def_st_ub_q1 1 100 0.00 255. FORMAT "%3.0" ECU_ADDRESS 0xC000B490 /end MEASUREMENT
/begin MEASUREMENT P_totdiode "Verlustleistung der Diode" UWORD Def_f_uw_b256 1 100 0.00 255.9961 FORMAT "%8.4" ECU_ADDRESS 0xC000AA46 /end MEASUREMENT
/begin MEASUREMENT St_pgenllred "Statuswort" UBYTE Def_st_ub_q1 1 100 0.00 255. FORMAT "%3.0" ECU_ADDRESS 0xC000B48C /end MEASUREMENT
/begin MEASUREMENT St_pgenllred_200ms "Statuswort" UBYTE Def_st_ub_q1 1 100 0.00 255. FORMAT "%3.0" ECU_ADDRESS 0xC000B48D /end MEASUREMENT
/begin MEASUREMENT St_pgenred_1s "Statuswort" UBYTE Def_st_ub_q1 1 100 0.00 255. FORMAT "%3.0" ECU_ADDRESS 0xC000B491 /end MEASUREMENT
/begin MEASUREMENT Tans_gen "Ansauglufttemparatur Generator" SWORD Def_t_sw_q0p1 1 100 -3276.8 3276.7 FORMAT "%6.1" ECU_ADDRESS 0xC000AA48 /end MEASUREMENT
/begin MEASUREMENT Tchip_fil_l "Wirkliche Chiptemperatur vom Generatorregler als Mittelwert gefiltert" SWORD Def_t_sw_q0p1 1 100 -3276.8 3276.7 FORMAT "%6.1" ECU_ADDRESS 0xC000AA4A /end MEASUREMENT
/begin MEASUREMENT Tchip_fil_s "Wirkliche Chiptemperatur vom Generatorregler als Mittelwert gefiltert" SWORD Def_t_sw_q0p1 1 100 -3276.8 3276.7 FORMAT "%6.1" ECU_ADDRESS 0xC000AA4C /end MEASUREMENT
/begin MEASUREMENT Tchip_ist "Wirkliche Chiptemperatur vom Generatorregler" SWORD Def_t_sw_q0p1 1 100 -3276.8 3276.7 FORMAT "%6.1" ECU_ADDRESS 0xC000AA4E /end MEASUREMENT
/begin MEASUREMENT Tchip_mwa "Array zur Mittelwerbildung Tchip_ist" SWORD Def_t_sw_q0p1 1 100 -3276.8 3276.7 FORMAT "%6.1" ARRAY_SIZE 16 ECU_ADDRESS 0xC000C42C /end MEASUREMENT
/begin MEASUREMENT Tchip_sum "Summenwert Tchip zur Mittelwertbildung" SWORD Def_t_sw_q0p1 1 100 -3276.8 3276.7 FORMAT "%6.1" ECU_ADDRESS 0xC000AA50 /end MEASUREMENT
/begin MEASUREMENT Tdffgen "Zeitzähler für Erkennung Generatorlastschwankung für Leerlaufanhebung" UWORD Def_td_uw_q0p2 1 100 0.00 13107. FORMAT "%6.0" ECU_ADDRESS 0xC000AA42 /end MEASUREMENT
/begin MEASUREMENT T_chipfilsdt "Differenzenquotient schnellgefilterte Chiptemparatur" SWORD Def_t_sw_q0p1 1 100 -3276.8 3276.7 FORMAT "%6.1" ECU_ADDRESS 0xC000AA52 /end MEASUREMENT
/begin MEASUREMENT T_diode "Diodentemparatur" SWORD Def_t_sw_q0p1 1 100 -3276.8 3276.7 FORMAT "%6.1" ECU_ADDRESS 0xC000AA54 /end MEASUREMENT
/begin MEASUREMENT T_diodedelta "Deltatemparatur Diode" SWORD Def_t_sw_q0p1 1 100 -3276.8 3276.7 FORMAT "%6.1" ECU_ADDRESS 0xC000AA56 /end MEASUREMENT
/begin MEASUREMENT U_vordiode "Diodenvorwärtsspannung" UWORD Def_u_uw_q0p00488 1 100 0.00 319.9951 FORMAT "%8.4" ECU_ADDRESS 0xC000AA58 /end MEASUREMENT
/begin MEASUREMENT V_pgenllkor "Fahrzeuggeschwindigkeit korrigiert" UWORD Def_v_uw_q0p1 1 100 0.00 6553.50 FORMAT "%7.2" ECU_ADDRESS 0xC000AA44 /end MEASUREMENT
/begin MEASUREMENT Z_tchip "Zaehler für Mittelwerbildung Tchip_ist" UBYTE Def_st_ub_q1 1 100 0.00 255. FORMAT "%3.0" ECU_ADDRESS 0xC000B492 /end MEASUREMENT
/begin FUNCTION PFltRgn_CmpnPrt ""
 /begin DEF_CHARACTERISTIC PFltDem_tiDelAftNoSuc_C PFltRgn_lSnceRgnIntr_CA PFltRgn_stLckFlMsk_C PFltRgn_stMinDistRgn_C PFltRgn_stSysFailMsk_C PFltRgn_tiDebQLimErrIntr_C PFltRgn_tiDebTrqOvhtIntr_C PFltRgn_tiKpRgnOvrRun_C PFltRgn_tiSysFailDel_C PFltRgn_tOxiCatUsMaxHi_C PFltRgn_tOxiCatUsMaxLo_C PFltRgn_tPFltUsMaxHi_C PFltRgn_tPFltUsMaxLo_C PFltRgn_tPFltUsMinOvrRun_C PFltRgn_tTrbnUsMaxHi_C PFltRgn_tTrbnUsMinLo_C PFltRgn_volFlMinHi_C PFltRgn_volFlMinLo_C /end DEF_CHARACTERISTIC
 /begin IN_MEASUREMENT PFltRgn_lSnceRgn PFltRgn_numRgn PFltRgn_stNoSucDet /end IN_MEASUREMENT
 /begin OUT_MEASUREMENT PFltRgn_stDelAftNoSucEnd PFltRgn_stIntr /end OUT_MEASUREMENT
 /begin LOC_MEASUREMENT PFltRgn_stIntrAct_mp PFltRgn_stIntrPrj_mp PFltRgn_tiTmrStOvrRun_mp /end LOC_MEASUREMENT
/end FUNCTION
/begin FUNCTION PFltRgn_Co ""
 /begin DEF_CHARACTERISTIC PFltRgn_ctRgnSubs_C PFltRgn_DebLck.tiHiLo_C PFltRgn_DebLck.tiLoHi_C PFltRgn_facChngRgnDel_CA PFltRgn_mskLckRgnOilDil_C PFltRgn_numEngPOpDel_CA PFltRgn_numEngPOpIntr_CA PFltRgn_numEngPOp_CA PFltRgn_numRgnSuc_C PFltRgn_numRgnTxtMsg_C PFltRgn_stLckOpMode_C PFltRgn_stLckRgnMsk_C PFltRgn_stOpModeAct_CA PFltRgn_stOpModeDes_CA PFltRgn_stRgnNoCmplnSubs_C PFltRgn_stRgnOpMode_CA PFltRgn_stRgnSucMsk_C PFltRgn_swtRgnSuc_C PFltRgn_swtShOffSucAshCor_C PFltRgn_swtTmrLckRst_C PFltRgn_tiChngRgnDelBas_MAP PFltRgn_tiDebPOp.tiHiLo_C PFltRgn_tiDebPOp.tiLoHi_C PFltRgn_tiLckRgnErr_CA PFltRgn_tiLckRgn_CA PFltRgn_tiLckSubs_C PFltRgn_tiRgnMax_CA PFltRgn_tiRgnSpo_C /end DEF_CHARACTERISTIC
 /begin IN_MEASUREMENT CoEOM_stOpModeAct CoEOM_tiRmpSlp Epm_nEng InjCtl_qSetUnBal PFltLd_stAshCorRgnMax PFltPOp_stEngPOp PFltRgn_numRgn PFltRgn_stIntr PFltRgn_stNoSucDet PFltRgn_stRgnJmp PFltSrv_numSrvCs PFltSrv_stOpMode PFltSrv_stRgnOn PFltSrv_stRgnSuc PFlt_swtActv PthSet_stOvrRun PthSet_trqInrSet /end IN_MEASUREMENT
 /begin OUT_MEASUREMENT PFltRgn_ctRgnSuc PFltRgn_numTot PFltRgn_stLck PFltRgn_stOpMode PFltRgn_stRgnOpMode PFltRgn_stSuc PFltRgn_stTxtMsg PFltRgn_tiChngRgnDel /end OUT_MEASUREMENT
 /begin LOC_MEASUREMENT PFltRgn_ctRgnDemEEP_mp PFltRgn_ctRgnDem_mp PFltRgn_ctRgnSucEEP_mp PFltRgn_numEngPOp_mp PFltRgn_numRgn_mp PFltRgn_stChngImmd_mp PFltRgn_stChngRgnDelExpd_mp PFltRgn_stChngRgnDel_mp PFltRgn_stChngRgn_mp PFltRgn_stJmpCond_mp PFltRgn_stNoSuc_mp PFltRgn_stNumEngPOpDelOn_mp PFltRgn_stNumSotSucAct_mp PFltRgn_stNumSotSuc_mp PFltRgn_stNumTxtMsg_mp PFltRgn_stRgnNoCmplnEEP_mp PFltRgn_stRgnNoCmpln_mp PFltRgn_stRgnOpModeDel_mp PFltRgn_stSucAct_mp PFltRgn_tiChngRgnDelBas_mp PFltRgn_tiChngRgn_mp PFltRgn_tiLckRgn_mp PFltRgn_tiRgnMax_mp PFltRgn_tiRgnSpo_mp PFltRgn_tiTmrLckRgnEEP_mp PFltRgn_tiTmrLckRgn_mp PFltRgn_tiTmrRgnMax_mp PFltRgn_tiTmrRgnSpo_mp /end LOC_MEASUREMENT
/end FUNCTION
/begin FUNCTION PFltRgn_Dem ""
 /begin DEF_CHARACTERISTIC PFltRgn_facFlHighTrm_C PFltRgn_facFlLowTrm_C PFltRgn_facNO2RgnPrtMax_CUR PFltRgn_facSumHighTrm_C PFltRgn_facSumLowTrm_C PFltRgn_facTiNO2RgnPrtMax_CUR PFltRgn_lSumMaxDef_C PFltRgn_lSumMax_MAP PFltRgn_lSumSubs_C PFltRgn_mSotMeas_CUR PFltRgn_mSotRngDwn_CA PFltRgn_mSotRngUp_CA PFltRgn_numHCCond_C PFltRgn_numLst_C PFltRgn_numPFltErrRgnIntr_C PFltRgn_numPFltErr_C PFltRgn_numPrt_C PFltRgn_numTRgnMin_C PFltRgn_pEngPrtAshCor_MAP PFltRgn_pEngPrtMaxInit_C PFltRgn_pEngPrtMax_MAP PFltRgn_pEngPrtMin_MAP PFltRgn_qFlMaxDef_C PFltRgn_qFlMax_C PFltRgn_qFlSubs_C PFltRgn_resFlwEngPrtCor_MAP PFltRgn_resFlwEngPrtMaxInit_C PFltRgn_resFlwEngPrtMax_MAP PFltRgn_resFlwEngPrtMin_MAP PFltRgn_stHCCondActvMsk_C PFltRgn_stRgnActvMsk_C PFltRgn_swtAshCor_C PFltRgn_swtCntAshCor_C PFltRgn_swtEngPrtAshCor_C PFltRgn_swtFacTiNO2Rgn_C PFltRgn_swtHCCondActv_C PFltRgn_swtMsSotRngDwnCor_C PFltRgn_swtMsSotRngUpCor_C PFltRgn_swtNoSucDetActv_C PFltRgn_swtOfsCor_C PFltRgn_swtPresResFlowSel_C PFltRgn_tCEngHCOffEna_C PFltRgn_tiEngOnMaxDef_C PFltRgn_tiEngOnMax_C PFltRgn_tiEngPrtDeb_C PFltRgn_tiEngPrtPT1_C PFltRgn_tiEngPrt_C PFltRgn_tiHCCond_C PFltRgn_tiHCCond_CUR PFltRgn_tiLstRgnRstrt_C PFltRgn_tiLstRgn_C PFltRgn_tiOpSubs_C PFltRgn_tiPFltErrPer_C PFltRgn_tiPFltErrRgn_C PFltRgn_tiRgnMinRstrt_C PFltRgn_tiRgnMinSubs_C PFltRgn_tiRgnMin_C PFltRgn_tiTmrLstRgnSubs_C PFltRgn_tOxiPreHCOff_C PFltRgn_tPreHCOff_C PFltRgn_tRgnMin_C PFltRgn_volFlConsumSubs_C /end DEF_CHARACTERISTIC
 /begin IN_MEASUREMENT CEngDsT_t CoEng_st CoEOM_stOpModeAct EngDa_tiEngOn EnvT_t Epm_nEng Exh_pAdapPPFltDiff Exh_tAdapTOxiCatUs Exh_tAdapTPFltUs FlSys_dvolFlCons GlbDa_lTotDst InjCtl_qSetUnBal PCBS_qFlTotDMEChg PCBS_stCalc PCBS_stDMEChg PCBS_stPFltChg PFltLd_facAshCor PFltLd_facNO2Rgn PFltLd_mSot PFltLd_resFlwOfs PFltLd_tiNO2Rgn PFltRgn_stSuc PFltSrv_numSrvCs PFlt_swtActv /end IN_MEASUREMENT
 /begin OUT_MEASUREMENT PFltRgn_facAshPrt PFltRgn_facNO2RgnPrtCor PFltRgn_lSnceRgn PFltRgn_lSumMax PFltRgn_numRgn PFltRgn_pEngPrtAshCor PFltRgn_qFlTot PFltRgn_resFlwEngPrtAshCor PFltRgn_stEngPrtActv PFltRgn_stHCCondEnd PFltRgn_stNoSucDet PFltRgn_stPrt PFltRgn_tiSnceRgn /end OUT_MEASUREMENT
 /begin LOC_MEASUREMENT PFltRgn_ctStrtSnceRgn_mp PFltRgn_dqFlAvrg_mp PFltRgn_dvolFlCons_mp PFltRgn_facFlTrmUnlim_mp PFltRgn_facSumTrmUnlim_mp PFltRgn_lAvrgSnceRgn_mp PFltRgn_lSumEEP_mp PFltRgn_lSumMax_mp PFltRgn_lSumRgnBck0_mp PFltRgn_lSumRgnBck1_mp PFltRgn_lSumRgnBck2_mp PFltRgn_lSumRgnBck3_mp PFltRgn_lSumRgnBck4_mp PFltRgn_lSum_mp PFltRgn_mSotOfs_mp PFltRgn_numLst_mp PFltRgn_numPFltErr_mp PFltRgn_numPrt_mp PFltRgn_numSot_mp PFltRgn_pActEngPrt_mp PFltRgn_pEngPrtMaxRaw_mp PFltRgn_pEngPrtMax_mp PFltRgn_pEngPrtMinRaw_mp PFltRgn_pEngPrtMin_mp PFltRgn_qFlEEP_mp PFltRgn_qFlMax_mp PFltRgn_qFlTotEEP_mp PFltRgn_qFl_mp PFltRgn_resFlwEngPrtMax_mp PFltRgn_resFlwEngPrtMin_mp PFltRgn_resFlwOfs_mp PFltRgn_stActEngPrt_mp PFltRgn_stEngPrt_mp PFltRgn_stLstRgnEnd_mp PFltRgn_stLstRgn_mp PFltRgn_stLst_mp PFltRgn_stPFltErr_mp PFltRgn_stRgnSwtPar_mp PFltRgn_tiHCCond_mp PFltRgn_tiOpEEP_mp PFltRgn_tiOp_mp PFltRgn_tiPFltErr_mp PFltRgn_tiRgnMinEEP_mp PFltRgn_tiRgnMin_mp PFltRgn_tiTmrEngPrt_mp PFltRgn_tiTmrLstRgnEEP_mp PFltRgn_tiTmrLstRgn_mp PFltRgn_vAvrgSnceRgn_mp /end LOC_MEASUREMENT
/end FUNCTION
/begin FUNCTION PFltRgn_JmpCondDet ""
 /begin DEF_CHARACTERISTIC PFltRgn_aDynMinLim_MAP PFltRgn_drAccPedDyn_C PFltRgn_drAccPedRawMax_C PFltRgn_drAccPedRawMin_C PFltRgn_DT1AccPed.T1_C PFltRgn_DT1AccPed.Kd_C PFltRgn_facDynInjQnt_C PFltRgn_facFullLdCor_MAP PFltRgn_rAccPedDynMin_C PFltRgn_rFullLdBas_MAP PFltRgn_rFullLdMax_C PFltRgn_rFullLdMin_C PFltRgn_stRgnJmpMsk_C PFltRgn_swtDynDetSmkLimOn_C PFltRgn_tiAccPedPT1_C PFltRgn_vDynDetMax_C PFltRgn_vDynDetMin_C PFltRgn_vOvrRunMax_C PFltRgn_vOvrRunMin_C /end DEF_CHARACTERISTIC
 /begin IN_MEASUREMENT APP_r Epm_nEng InjCtl_qSetUnBal PFlt_swtActv PthSet_stOvrRun PthSet_trqInrSet PT_stGrip SmkLim_qLimSmk Tra_numGear VehV_a VehV_v /end IN_MEASUREMENT
 /begin OUT_MEASUREMENT PFltRgn_stRgnJmp /end OUT_MEASUREMENT
 /begin LOC_MEASUREMENT PFltRgn_aDynMinLim_mp PFltRgn_drAccPedFlt_mp PFltRgn_drAccPedRaw_mp PFltRgn_facFullLdCor_mp PFltRgn_rFullLdBas_mp PFltRgn_rFullLd_mp PFltRgn_stRgnJmpNoMsk_mp PFltRgn_stSmkLim_mp /end LOC_MEASUREMENT
/end FUNCTION
/begin FUNCTION PFltSrv_Lib ""
 /begin DEF_CHARACTERISTIC PFltSrv_ctRgnDemAdjMax_C PFltSrv_ctRgnSucAdjMax_C PFltSrv_dmOilAshDia_C PFltSrv_facPOpOilAshAdjMax_C PFltSrv_lSumAdjMax_C PFltSrv_lSumDiaAdjMax_C PFltSrv_mOilAshAdjMax_C PFltSrv_mSotContAdjMax_C PFltSrv_mSotDia_C PFltSrv_mSotNoContAdjMax_C PFltSrv_numAdjIdAdjMax_C PFltSrv_numSrvIdAdjMax_C PFltSrv_qFlAdjMax_C PFltSrv_qFlTotAdjMax_C PFltSrv_stRgnNoComplAdjMax_C PFltSrv_tiEngPrtAdjMax_C PFltSrv_tiLckRlsAdjMax_C PFltSrv_tiLstRgnAdjMax_C PFltSrv_tiLstRgnDia_C PFltSrv_tiOpAdjMax_C PFltSrv_tiOpPFltAdjMax_C PFltSrv_tiTmrMinRgnAdjMax_C PFltSrv_vAvrgDia_C PFltSrv_volConsAvrg_C /end DEF_CHARACTERISTIC
 /begin IN_MEASUREMENT EngDa_tiEngOn GlbDa_lTotDst PFltSrv_stRgnTstr /end IN_MEASUREMENT
 /begin OUT_MEASUREMENT PFltSrv_numSrvCs /end OUT_MEASUREMENT
/end FUNCTION
/begin FUNCTION PFlt_Adapt ""
 /begin DEF_CHARACTERISTIC ASMod_dmNOxEG_C ASMod_dmSotEG_C Exh_pOfsValActMidPPFltDiff_C Exh_stStyPPFltDiff_C Exh_stTrgAftRunPPFltDiff_C /end DEF_CHARACTERISTIC
 /begin IN_MEASUREMENT Exh_pDiffOfsValActMid PFltLd_facAshCor /end IN_MEASUREMENT
 /begin OUT_MEASUREMENT Exh_pOfsValActMidPPFltDiff FuelLvl_vol PFltLd_facAshAdjCor PFltSrv_stOpMode PFltSrv_stRgnOn PFltSrv_stRgnSuc PFltSrv_stRgnTstr /end OUT_MEASUREMENT
/end FUNCTION
/begin FUNCTION PFlt_Ini "" /begin DEF_CHARACTERISTIC PFlt_swtActv_C PFlt_swtSrvVal_C /end DEF_CHARACTERISTIC /begin OUT_MEASUREMENT PFlt_swtActv /end OUT_MEASUREMENT /end FUNCTION
/begin FUNCTION PFlt_Mon ""
 /begin DEF_CHARACTERISTIC PFlt_dvolCharMonMin_C PFlt_dvolChkDstrMin_C PFlt_dvolMaxVar_C PFlt_mSotChkDstrMax_C PFlt_mSotChkDstrMin_C PFlt_mSotChkDvtMin_C PFlt_mSotChkFlwRstnMin_C PFlt_mSotHysMaxDwn_C PFlt_mSotHysMaxUp_C PFlt_pDiffCharMonMin_MAP PFlt_pDiffNoDstrMin_CUR PFlt_resFlwMax_CUR PFlt_resFlwMin_CUR PFlt_rSotMsDvtMax_C PFlt_rSotMsDvtMin_C PFlt_stCharMonRgnOffMsk_CA PFlt_stChkDstrMsk_CA PFlt_swtMonAshCor_C PFlt_swtTrgCharMon_C PFlt_tiDvolStyChk_C /end DEF_CHARACTERISTIC
 /begin IN_MEASUREMENT ASMod_dvolPFltEG CoEOM_stOpModeAct Exh_pAdapPPFltDiff Exh_pOfsValActMidPPFltDiff Exh_pRawAdapPPFltDiff Exh_stStyPPFltDiff Exh_stTrgAftRunPPFltDiff PFltLd_facAshCor PFltLd_mSot PFltLd_mSotMeas PFltLd_mSotSimCont PFltLd_stSimOn PFltRgn_stEngPrtActv PFltRgn_stLck PFlt_swtActv /end IN_MEASUREMENT
 /begin OUT_MEASUREMENT PFlt_stSysFail /end OUT_MEASUREMENT
 /begin LOC_MEASUREMENT PFlt_dvolMaxSty_mp PFlt_dvolPFltEGInMon_mp PFlt_mSotDvt_mp PFlt_pDiffCharMonMin_mp PFlt_pDiffMaxStyOfsCor_mp PFlt_pDiffMaxSty_mp PFlt_pDiffNoDstrMin_mp PFlt_resFlwMax_mp PFlt_resFlwMin_mp PFlt_rSotMsDvt_mp PFlt_stDvolSty_mp PFlt_stFlwRstnHi_mp PFlt_stFlwRstnLo_mp PFlt_stTrgCharMon_mp PFlt_stTrgCharPDiffMon_mp PFlt_stTrgChkDvt_mp /end LOC_MEASUREMENT
/end FUNCTION
/begin FUNCTION pflt_monprj ""
 /begin DEF_CHARACTERISTIC PFlt_ctEngPrtRgn_C PFlt_DebOxiPreNplDef_C PFlt_DebOxiPreNplOk_C PFlt_DebPFltOvldHeal_C PFlt_DebPFltOvldInhRgnDef_C PFlt_DebPFltOvldInhRgnOk_C PFlt_DebPFltOvldTrqLimDef_C PFlt_DebPFltOvldTrqLimOk_C PFlt_DebPreNplDef_C PFlt_DebPreNplOk_C PFlt_DebRstDfpEngPrtRgnMon_C PFlt_dvolRstDfpEngPrtMon_C PFlt_facNO2RgnInhRgn_CUR PFlt_facNO2RgnTrqLim_CUR PFlt_factiNO2RgnInhRgn_CUR PFlt_factiNO2RgnTrqLim_CUR PFlt_lOvldHealObsNO2_C PFlt_lRstDfpEngPrtMon_C PFlt_lSumDiffMax_C PFlt_mLoIdlSotSimMax_C PFlt_mOvldHealEngPrtOK_C PFlt_mOvldHealInhRgn_C PFlt_mOvldHealTrqLim_C PFlt_mSotDiff_C PFlt_nLoIdlMax_C PFlt_nLoIdlMin_C PFlt_nMin_C PFlt_nPFltOvldHeal_C PFlt_nStrtMax_C PFlt_nStrtMin_C PFlt_numEngPrtActvMsk_C PFlt_numPPreOxiC_C PFlt_numRgnStep1_C PFlt_numRgnStep2_C PFlt_numRgnStep3_C PFlt_numRgnStep4_C PFlt_numRgnStep5_C PFlt_numRgnStep6_C PFlt_numRgnStep7_C PFlt_numRgnStep8_C PFlt_numTOxiPreSty_C PFlt_numTPreSty_C PFlt_pAPSNegDvt_C PFlt_pAPSPosDvt_C PFlt_pBPSNegDvt_C PFlt_pBPSPosDvt_C PFlt_pDiffMax1_C PFlt_pPFltOvldInhRgn_MAP PFlt_pPFltOvldInit_C PFlt_pPFltOvldOfsHeal_C PFlt_pPFltOvldTrqLim_MAP PFlt_pPreAshOilCorr_MAP PFlt_pPreCorrMax_C PFlt_pPresNegDvt_C PFlt_pPreSotSimCorr_MAP PFlt_pPresPlausMaxDvt_C PFlt_pPresPlausMinDvt_C PFlt_pPresPosDvt_C PFlt_pPreVolCorr_CUR PFlt_qLoIdlMax_C PFlt_qLoIdlMin_C PFlt_qPFltOvldHeal_C PFlt_rEngPrtRgnMax_C PFlt_resFlowOvldInhRgn_MAP PFlt_resFlowOvldInit_C PFlt_resFlowOvldOfsHeal_C PFlt_resFlowOvldTrqLim_MAP PFlt_rLoIdlTVAMax_C PFlt_stHealRdcDoc_MAP PFlt_stLoIdlEGTMsk_C PFlt_stMaxEOMMsk_C PFlt_swtDiagRlsmSotCtl_C PFlt_swtEngPrtWrEEPROM_C PFlt_swtFactiNO2Rgn_C PFlt_swtOvldHealExtd_C PFlt_swtPFltOvldInhRgnCor_C PFlt_swtPFltOvldTrqLimCor_C PFlt_swtPresResFlowSel_C PFlt_tClntPFltOvldHeal_C PFlt_tDevOxiPreMax_C PFlt_tDevOxiPreRgnMax_C PFlt_tDevPreMax_C PFlt_tDevPreRgnMax_C PFlt_tiDebAftRunTst_C PFlt_tiDebLoIdl_C PFlt_tiDebT15On_C PFlt_tiDelSysErr2Can_C PFlt_tiEngNrmOvldheal_C PFlt_tiFstEngPrtRgnMax_C PFlt_tiLoIdlSnceRgnMax_C PFlt_tiPFltOvld1PT1_C PFlt_tiPFltOvld2PT1_C PFlt_tiWakeUpTrans_C PFlt_tOxiPreDiffMax_MAP PFlt_tPreDiffMax_MAP PFlt_trqGbxRpmRduc_MAP PFlt_tThresOxiPreMax_C PFlt_tThresOxiPreRgnMax_C PFlt_tThresPreMax_C PFlt_tThresPreRgnMax_C PFlt_vLoIdlSpeedMax_C PFlt_vPFltOvldHeal_C /end DEF_CHARACTERISTIC
 /begin IN_MEASUREMENT Air_pIntkVUs ASMod_dvolPFltEG ASMod_pEGFld ASMod_tEGFld CEngDsT_t CoEng_st CoEng_tiNormal CoEOM_stOpModeAct Com_lSum EngDa_tiEngOn EngPrt_trqPrtLim EnvP_p Epm_nEng Exh_pAdapPPFltDiff Exh_pAdapPPFltUs Exh_tAdapTOxiCatUs Exh_tAdapTPFltUs GlbDa_lTotDst InjCtl_qSetUnBal PCBS_stPFltActv PFltLd_facAshCor PFltLd_facNO2Rgn PFltLd_mSotMeas PFltLd_mSotSim PFltLd_resFlwFlt PFltLd_tiNO2Rgn PFltPOp_stEngPOp PFltRgn_lSnceRgn PFltRgn_numRgn PFltRgn_pEngPrtAshCor PFltRgn_resFlwEngPrtAshCor PFltRgn_stEngPrtActv PFltRgn_stPrt PFltRgn_stSuc PFltRgn_tiSnceRgn PFltSrv_numSrvCs PthSet_trqInrSet T50_st ThrVlv_rPs VehV_v /end IN_MEASUREMENT
 /begin OUT_MEASUREMENT PFlt_lAvrgRgn PFlt_mSotOvldHeal PFlt_stOvldHeal PFlt_stSysErr2Can /end OUT_MEASUREMENT
 /begin LOC_MEASUREMENT PFlt_ctEngPrtRgn_mp PFlt_ctOvldHealObsNO2_mp PFlt_ctRgnStep1_mp PFlt_ctRgnStep2_mp PFlt_ctRgnStep3_mp PFlt_ctRgnStep4_mp PFlt_ctRgnStep5_mp PFlt_ctRgnStep6_mp PFlt_ctRgnStep7_mp PFlt_ctRgnStep8_mp PFlt_ctRgnSum_mp PFlt_dVolMapIn_mp PFlt_facAshCorMapIn_mp PFlt_facNO2RgnMapIn_mp PFlt_lOvldHealObsNO2_mp PFlt_mSotSimMapIn_mp PFlt_numIdxCntRgn_mp PFlt_pAPSBPSDiff_mp PFlt_pAPSDvt_mp PFlt_pAPSPFltPresDiff_mp PFlt_pBPSDvt_mp PFlt_pBPSPFltPresDiff_mp PFlt_pPFltB1B2Diff_mp PFlt_pPFltOvldLckRgn_mp PFlt_pPFltOvldTrqLim_mp PFlt_pPFltPresDvt_mp PFlt_pPreAshOilCorr_mp PFlt_pPreCorr_mp PFlt_pPreOxiCFlt_mp PFlt_pPreSotAshCorrSum_mp PFlt_pPreSotSimCorr_mp PFlt_pPreVolCorr_mp PFlt_rEngPrtRgn_mp PFlt_resFlowOvldLckRgn_mp PFlt_resFlowOvldTrqLim_mp PFlt_stAPSPlausDefHigh_mp PFlt_stAPSPlausDefLow_mp PFlt_stBPSPlausDefHigh_mp PFlt_stBPSPlausDefLow_mp PFlt_stEngPrtRgn_mp PFlt_stPFltOvldHealCond_mp PFlt_stPresPlausDefHigh_mp PFlt_stPresPlausDefLow_mp PFlt_stPresPlausLoIdl_mp PFlt_stPresPlausOk_mp PFlt_stPresPlausTst_mp PFlt_stPresPlaus_mp PFlt_stRgnRlsOff_mp PFlt_stRlsmSotCtl_mp PFlt_tiNO2RgnMapIn_mp PFlt_tiOpOld_mp PFlt_tiSnceFstEngPrtRgn_mp PFlt_tOxiPreDiffMax_mp PFlt_tOxiPreDiff_mp PFlt_tOxiPreMax_mp PFlt_tOxiPreRgnMax_mp PFlt_tOxiPreSty_mp PFlt_tPreDiffMax_mp PFlt_tPreDiff_mp PFlt_tPreMax_mp PFlt_tPreRgnMax_mp PFlt_tPreSty_mp PFlt_trqTraRpmRdc_mp /end LOC_MEASUREMENT
/end FUNCTION
/begin FUNCTION PFlt_TempDesVal ""
 /begin DEF_CHARACTERISTIC PFlt_facInrDesAPSTCor_CUR PFlt_swtTempInrOutr_C PFlt_tInrDesAPSCor_MAP PFlt_tInrDesTempTrbn_CUR PFlt_tInrDes_MAP PFlt_tOutrDesMsFlwO2_CUR PFlt_tOutrDesMsSot_CUR PFlt_tOutrDesTempDs_CUR PFlt_tOutrDes_MAP /end DEF_CHARACTERISTIC
 /begin IN_MEASUREMENT EnvP_p Epm_nEng Exh_tAdapTOxiCatDs Exh_tAdapTTrbnUs InjCtl_qSetUnBal PFltLd_dmO2Aprx PFltLd_mSot PFlt_swtActv /end IN_MEASUREMENT
 /begin OUT_MEASUREMENT PFlt_tInrDes PFlt_tOutrDes /end OUT_MEASUREMENT
 /begin LOC_MEASUREMENT PFlt_dmO2Aprx_mp PFlt_mSot_mp PFlt_tAdaptTrbnUs_mp PFlt_tAdpaTOxiCatDs_mp PFlt_tInrDesAPSCor_mp /end LOC_MEASUREMENT
/end FUNCTION
/begin FUNCTION pgenllred ""
 /begin DEF_CHARACTERISTIC KL_GELIKMIE K_DELTADFFMX K_DFFLIM K_DFFLLANH K_DFFSCHZMX K_GELIIEAPP K_GELIIEZK K_GELISETAPP K_GELIVMAX K_LLWDNMAX K_LLWDNMIN K_NMOTLLANH K_NSTATLLANH K_PR_IERRLLRED K_PWGLLANH K_SCHNKWLLRED K_SCHPWGLLRED K_TDBLLLLRED K_TDFDTMAX K_TDFFABLF K_TDFFMAX K_TDFFMIN K_TDNHOLD K_TMOTLLANH K_TNSTLLANH K_VFZGGENFIL K_VFZGGENKOR K_VFZGLLANH S_ENABLLLLRED S_GELIBIEAPP S_PGENLL_AKT /end DEF_CHARACTERISTIC
 /begin IN_MEASUREMENT Ierr /end IN_MEASUREMENT
 /begin OUT_MEASUREMENT Deltadff Dffgenschz Dnkw Ierrgrenz_ll Pr_ierrllred St_pgenllred St_pgenllred_200ms Tdffgen V_pgenllkor /end OUT_MEASUREMENT
/end FUNCTION
/begin FUNCTION pgentred ""
 /begin DEF_CHARACTERISTIC KF_IERRGREHT KF_TANSGENKO KF_UFDIODE KL_NELUEFTGE KL_RTHJADIOD KL_TCHIPOFFS KL_TMAXDIODE K_GENMXGRADH K_HTGENDFGRO K_I_VERTEIL K_NGENHTMN1 K_NGENHTMX1 K_PR_IERRTRED K_TCHIPFIL K_TDNGENKRIT K_TDTCHIPKRI K_TDTCHIPMX K_TDUBFZMN K_TFIGENHT K_TFTDIODE K_TGENMXGRAD K_TGENMXTHD K_TGENRSHT K_TLCHTEP K_UGENHTMN S_HTDETEC /end DEF_CHARACTERISTIC
 /begin IN_MEASUREMENT Gen_awnumm Gen_manufak N_gen /end IN_MEASUREMENT
 /begin OUT_MEASUREMENT Ierrgrenz_ht Nelueft_gen Pr_ierrtred P_totdiode St_pgenred_1s Tans_gen Tchip_fil_l Tchip_fil_s Tchip_ist Tchip_mwa Tchip_sum T_chipfilsdt T_diode T_diodedelta U_vordiode Z_tchip /end OUT_MEASUREMENT
/end FUNCTION
/begin FUNCTION PhyMod_CalcCor ""
 /begin DEF_CHARACTERISTIC PhyMod_facEtaCorLim_MAP PhyMod_facPCRCorr0_CUR PhyMod_facPCRCorr0_MAP PhyMod_facPCRCorr1_CUR PhyMod_facPCRCorr1_MAP PhyMod_pPCROpt0_MAP PhyMod_pPCROpt1_MAP /end DEF_CHARACTERISTIC
 /begin REF_CHARACTERISTIC PhyMod_OpMode_AXIS /end REF_CHARACTERISTIC
 /begin IN_MEASUREMENT Air_pSensPIntkVUs Epm_nEng InjCrv_phiMI1Des PhyMod_stNxt PhyMod_stPrs PthSet_trqInrSet /end IN_MEASUREMENT
 /begin OUT_MEASUREMENT PhyMod_facEtaCor PhyMod_facEtaCor0 PhyMod_facEtaCorNxt /end OUT_MEASUREMENT
 /begin LOC_MEASUREMENT PhyMod_facEtaCor1_mp PhyMod_facEtaCorLim_mp PhyMod_pPCRDiff0_mp PhyMod_pPCRDiff1_mp PhyMod_pPCROpt0_mp PhyMod_pPCROpt1_mp /end LOC_MEASUREMENT
/end FUNCTION
/begin FUNCTION PhyMod_GenCur ""
 /begin DEF_CHARACTERISTIC PhyMod_trq2qBas0_MAP PhyMod_trq2qBas1_MAP PhyMod_trq2qBas2_MAP PhyMod_trq2qBas3_MAP PhyMod_trq2qBas4_MAP PhyMod_trq2qBas5_MAP PhyMod_trq2qBas6_MAP PhyMod_trq2qBas7_MAP PhyMod_trq2qBas8_MAP PhyMod_trq2qBas9_MAP /end DEF_CHARACTERISTIC
 /begin IN_MEASUREMENT Epm_nEng PhyMod_stNxt PhyMod_stPrs PthSet_trqInrSet /end IN_MEASUREMENT
 /begin LOC_MEASUREMENT PhyMod_GenCurMapID_mp /end LOC_MEASUREMENT
/end FUNCTION
/begin FUNCTION PhyMod_GenCur_Lib "" /end FUNCTION
/begin FUNCTION PhyMod_OpModeSelect ""
 /begin DEF_CHARACTERISTIC PhyMod_facRmpVal_C PhyMod_InjTyp_AXIS PhyMod_OpMode2Map_GMAP PhyMod_OpMode_AXIS PhyMod_stOpModeCtl_C PhyMod_stOpMode_C /end DEF_CHARACTERISTIC
 /begin IN_MEASUREMENT CoEOM_facRmpVal CoEOM_stOpModeAct /end IN_MEASUREMENT
 /begin OUT_MEASUREMENT PhyMod_facRmpVal PhyMod_InjTyp PhyMod_MskNxt PhyMod_MskPrs PhyMod_OpModeMsk PhyMod_OpModeNxt PhyMod_OpModePrs PhyMod_StageNxt PhyMod_StagePrs PhyMod_stCmpMsk_mp PhyMod_stNxt PhyMod_stPrs /end OUT_MEASUREMENT
/end FUNCTION
/begin FUNCTION PhyMod_OpModeSelect_Lib "" /end FUNCTION
/begin FUNCTION PhyMod_PwrEntryCalc "" /begin DEF_CHARACTERISTIC PhyMod_pwrEGLos_MAP /end DEF_CHARACTERISTIC /begin IN_MEASUREMENT ActMod_trqInr Epm_nEng Epm_numCyl InjCtl_qSetUnBal /end IN_MEASUREMENT /begin OUT_MEASUREMENT PhyMod_pwrClntEntry /end OUT_MEASUREMENT
 /begin LOC_MEASUREMENT PhyMod_pwrClntEntry_mp PhyMod_pwrEGLos_mp PhyMod_pwrLos_mp PhyMod_pwrMech_mp PhyMod_pwrTheo_mp /end LOC_MEASUREMENT
/end FUNCTION
/begin FUNCTION PIntkVUs_DD ""
 /begin DEF_CHARACTERISTIC Air_pTransfPIntkVUs_CUR Air_SRCPIntkVUs.uMin_C Air_SRCPIntkVUs.uMax_C Air_tiPT1T1PIntkVUs_C /end DEF_CHARACTERISTIC
 /begin IN_MEASUREMENT EpmCrS_numSeg EpmSyn_stCrSPos /end IN_MEASUREMENT
 /begin OUT_MEASUREMENT Air_pSensPIntkVUs /end OUT_MEASUREMENT
 /begin LOC_MEASUREMENT Air_uRawPIntkVUs /end LOC_MEASUREMENT
/end FUNCTION
/begin FUNCTION PIntkVUs_VD ""
 /begin DEF_CHARACTERISTIC Air_nLimPIntkVUs_C Air_ParIntkVUsDT1.T1_C Air_ParIntkVUsDT1.Kd_C Air_pDiffLimPIntkVUs_C Air_RmpSlpPIntkVUs.Pos_C Air_RmpSlpPIntkVUs.Neg_C Air_swtSensPrsPIntkVUs_C Air_tiPT1T1SigPIntkVUs_C Air_TransStgPIntkVUs.Dfl_C Air_TransStgPIntkVUs.stSensId_C /end DEF_CHARACTERISTIC
 /begin IN_MEASUREMENT Air_pSensPIntkVUs EnvP_pSens Epm_nEng /end IN_MEASUREMENT
 /begin OUT_MEASUREMENT Air_dpFltIntkVUs Air_pIntkVUs Air_pUnFltPIntkVUs /end OUT_MEASUREMENT
/end FUNCTION
/begin FUNCTION Pmd "" /end FUNCTION
/begin FUNCTION pm_services "" /end FUNCTION
/begin FUNCTION Port "" /end FUNCTION
/begin FUNCTION PPC "" /begin SUB_FUNCTION PPC_Main PPC_Gov /end SUB_FUNCTION /end FUNCTION
/begin FUNCTION PPC_Gov ""
 /begin DEF_CHARACTERISTIC PPC_facDT1WinNegVal_C PPC_facDT1WinPosVal_C PPC_facIWinNegVal_C PPC_facIWinPosVal_C PPC_facKdNegVal_C PPC_facKdPosVal_C PPC_facKdVal_C PPC_facKiNegVal_C PPC_facKiPosVal_C PPC_facKiVal_C PPC_facKpNegVal_C PPC_facKpPosVal_C PPC_facKpVal_C PPC_facPWinNegVal_C PPC_facPWinPosVal_C PPC_facT1Val_C PPC_pGovNom_C PPC_pInDT1Ini_C PPC_rDycDT1Max_C PPC_rDycDT1Min_C PPC_rDycIMax_C PPC_rDycIMin_C PPC_rDycPIDMax_C PPC_rDycPIDMin_C PPC_rDycPMax_C PPC_rDycPMin_C PPC_rOutDT1Ini_C PPC_rOutIIni_C /end DEF_CHARACTERISTIC
 /begin IN_MEASUREMENT SCR_pFltUPmpP /end IN_MEASUREMENT
 /begin OUT_MEASUREMENT PPC_rDycGov /end OUT_MEASUREMENT
 /begin LOC_MEASUREMENT PPC_pGovDiff_mp PPC_rDycDT1_mp PPC_rDycGov_mp PPC_rDycI_mp PPC_rDycPID_mp PPC_rDycP_mp /end LOC_MEASUREMENT
/end FUNCTION
/begin FUNCTION PPC_Main ""
 /begin DEF_CHARACTERISTIC PPC_pUPmpPHys_C PPC_pUPmpPNom_C PPC_rDycAftrunEmpt_C PPC_rDycDfl_C PPC_rDycPresBuildUp_C PPC_rDycPresRdc_C PPC_rDycReFl_C PPC_rDycVtln_C PPC_swtUPmpCtl_C /end DEF_CHARACTERISTIC
 /begin IN_MEASUREMENT UPmpMot_r URevVlv_st /end IN_MEASUREMENT
 /begin LOC_MEASUREMENT PPC_rDyc_mp /end LOC_MEASUREMENT
/end FUNCTION
/begin FUNCTION PPFltDiff_DD ""
 /begin DEF_CHARACTERISTIC Exh_pTransfPPFltDiff_CUR Exh_SRCPPFltDiff.uMin_C Exh_SRCPPFltDiff.uMax_C /end DEF_CHARACTERISTIC
 /begin OUT_MEASUREMENT Exh_pSensPPFltDiff Exh_uRawPPFltDiff /end OUT_MEASUREMENT
/end FUNCTION
/begin FUNCTION PPFltDiff_VD ""
 /begin DEF_CHARACTERISTIC Exh_ddvolHsLnNegPPFltDiff_C Exh_ddvolHsLnPosPPFltDiff_C Exh_numFldPPFltDiff_C Exh_numTiStpNplPPFltDiff_C Exh_pBPAPTolcMaxPPFltDiff_C Exh_pDiffTolcMaxPPFltDiff_C Exh_pHsLnNegPPFltDiff_C Exh_pMaxPPFltDiff_C Exh_pMinPPFltDiff_C Exh_pPFltDiffMaxVar_C Exh_pPFltUsBPMaxPPFltDiff_C Exh_pUsTolcMaxPPFltDiff_C Exh_resFlowTolcPPFltDiff_C Exh_RmpSlpPPFltDiff.Pos_C Exh_RmpSlpPPFltDiff.Neg_C Exh_swtDflPPFltDiff_C Exh_swtOfsPPFltDiff_C Exh_swtSvcChngPPFltDiff_C Exh_tiDelOfsCalcPPFltDiff_C Exh_tiPPFltDiffStyChk_C Exh_tiPT1PPFltDiff_C Exh_TransStgPPFltDiff.Dfl_C Exh_TransStgPPFltDiff.stSensId_C /end DEF_CHARACTERISTIC
 /begin IN_MEASUREMENT Air_pIntkVUs ASMod_dvolPFltEG ASMod_pPFltSimDs CoEng_st EnvP_p Exh_pFld Exh_pSensPPFltDiff /end IN_MEASUREMENT
 /begin OUT_MEASUREMENT Exh_pAdapPPFltDiff Exh_pDiffOfsValAct Exh_pDiffOfsValActMid Exh_pDiffOfsValOld Exh_pFltPPFltDiff Exh_pMinStyPPFltDiff Exh_pPFltDiff Exh_pRawAdapPPFltDiff Exh_stAftRunDelDemPPFltDiff Exh_stStyPPFltDiff Exh_stTrgAftRunPPFltDiff /end OUT_MEASUREMENT
 /begin LOC_MEASUREMENT Exh_ddvolFltPPFltDiff_mp Exh_dpFltPPFltDiff_mp Exh_dpNegDefPPFltDiff_mp Exh_dpPosDefPPFltDiff_mp Exh_pDiffOfsValAct_mp Exh_pDiffOfsValOld_mp Exh_stDynNplPPFltDiff_mp Exh_stpDiffTstDem_mp /end LOC_MEASUREMENT
/end FUNCTION
/begin FUNCTION PPFltUs_DD ""
 /begin DEF_CHARACTERISTIC Exh_pTransfPPFltUs_CUR Exh_SRCPPFltUs.uMin_C Exh_SRCPPFltUs.uMax_C /end DEF_CHARACTERISTIC
 /begin OUT_MEASUREMENT Exh_pSensPPFltUs Exh_uRawPPFltUs /end OUT_MEASUREMENT
/end FUNCTION
/begin FUNCTION PPFltUs_DD_Inl "" /begin DEF_CHARACTERISTIC Exh_pMntCor_CUR /end DEF_CHARACTERISTIC /begin IN_MEASUREMENT ASMod_dvolPFltEG /end IN_MEASUREMENT /end FUNCTION
/begin COMPU_METHOD Acc "" RAT_FUNC "%6.5" "m/s^2" COEFFS 0 1000 0 0 0 1 /end COMPU_METHOD
/begin COMPU_METHOD AirMassPerTime "" RAT_FUNC "%5.1" "Kg/h" COEFFS 0 10 0 0 0 1 /end COMPU_METHOD
/begin COMPU_METHOD AirVolPerTime "" RAT_FUNC "%6.3" "m^3/h" COEFFS 0 10 0 0 0 1 /end COMPU_METHOD
/begin COMPU_METHOD AshEGMassPerTime "" RAT_FUNC "%6.5" "mg/s" COEFFS 0 2000 0 0 0 1 /end COMPU_METHOD
/begin COMPU_METHOD AshMs_g_p0q1_COMPU "" RAT_FUNC "%6.3" "g" COEFFS 0 10 0 0 0 1 /end COMPU_METHOD
/begin COMPU_METHOD CoEOMSwt_S16 "" RAT_FUNC "%7.6" "-" COEFFS 0 16384 0 0 0 1 /end COMPU_METHOD
/begin COMPU_METHOD COEOM_EGRCLGQNTNUMMAP_SY_Compu "" TAB_NOINTP "%6.3" "" COMPU_TAB_REF COEOM_EGRCLGQNTNUMMAP_SY_Compu /end COMPU_METHOD
/begin COMPU_TAB COEOM_EGRCLGQNTNUMMAP_SY_Compu "" TAB_NOINTP 8 0 0 1 1 2 2 3 3 4 4 5 5 6 6 7 7 /end COMPU_TAB
/begin COMPU_METHOD CubMtrPerHr "" RAT_FUNC "%6.3" "m^3/h" COEFFS 0 10 0 0 0 1 /end COMPU_METHOD
/begin COMPU_METHOD CubMtrPerHrPerSec "" RAT_FUNC "%6.3" "m^3/h/s" COEFFS 0 10 0 0 0 1 /end COMPU_METHOD
/begin COMPU_METHOD Def_dez_ub_q1 "" RAT_FUNC "%3.1" "-" COEFFS 0 1 0 0 0 1 /end COMPU_METHOD
/begin COMPU_METHOD Def_f_sb_b64 "" RAT_FUNC "%5.2" "-" COEFFS 0 2 0 0 0 1 /end COMPU_METHOD
/begin COMPU_METHOD Def_f_ub_b1 "" RAT_FUNC "%6.4" "-" COEFFS 0 256 0 0 0 1 /end COMPU_METHOD
/begin COMPU_METHOD Def_f_ub_b100 "" RAT_FUNC "%5.2" "%" COEFFS 0 2.56 0 0 0 1 /end COMPU_METHOD
/begin COMPU_METHOD Def_f_ub_b2 "" RAT_FUNC "%6.4" "-" COEFFS 0 128 0 0 0 1 /end COMPU_METHOD
/begin COMPU_METHOD Def_f_ub_b4 "" RAT_FUNC "%5.3" "-" COEFFS 0 64 0 0 0 1 /end COMPU_METHOD
/begin COMPU_METHOD Def_f_ub_b8 "" RAT_FUNC "%5.3" "-" COEFFS 0 32 0 0 0 1 /end COMPU_METHOD
/begin COMPU_METHOD Def_f_uw_b1 "" RAT_FUNC "%14.10" "-" COEFFS 0 65536 0 0 0 1 /end COMPU_METHOD
/begin COMPU_METHOD Def_f_uw_b100 "" RAT_FUNC "%8.5" "%" COEFFS 0 655.36 0 0 0 1 /end COMPU_METHOD
/begin COMPU_METHOD Def_f_uw_b256 "" RAT_FUNC "%8.5" "-" COEFFS 0 256 0 0 0 1 /end COMPU_METHOD
/begin COMPU_METHOD Def_i_ub_q0p125 "" RAT_FUNC "%6.3" "A" COEFFS 0 8 0 0 0 1 /end COMPU_METHOD
/begin COMPU_METHOD Def_n_sw_q1p0 "" RAT_FUNC "%5.2" "Upm" COEFFS 0 1 0 0 0 1 /end COMPU_METHOD
/begin COMPU_METHOD Def_st_ub_q1 "" RAT_FUNC "%3.1" "-" COEFFS 0 1 0 0 0 1 /end COMPU_METHOD
/begin COMPU_METHOD Def_td_ub_q0p2 "" RAT_FUNC "%4.2" "s" COEFFS 0 5 0 0 0 1 /end COMPU_METHOD
/begin COMPU_METHOD Def_td_ub_q1 "" RAT_FUNC "%5.2" "s" COEFFS 0 1 0 0 0 1 /end COMPU_METHOD
/begin COMPU_METHOD Def_td_uw_q0p01 "" RAT_FUNC "%7.5" "s" COEFFS 0 100 0 0 0 1 /end COMPU_METHOD
/begin COMPU_METHOD Def_td_uw_q0p2 "" RAT_FUNC "%6.3" "s" COEFFS 0 5 0 0 0 1 /end COMPU_METHOD
/begin COMPU_METHOD Def_tv_ub_q0p390625 "" RAT_FUNC "%5.2" "%" COEFFS 0 2.56 0 0 0 1 /end COMPU_METHOD
/begin COMPU_METHOD Def_t_sw_q0p01 "" RAT_FUNC "%7.5" "°C" COEFFS 0 100 0 0 0 1 /end COMPU_METHOD
/begin COMPU_METHOD Def_t_sw_q0p1 "" RAT_FUNC "%6.3" "°C" COEFFS 0 10 0 0 0 1 /end COMPU_METHOD
/begin COMPU_METHOD Def_u_uw_q0p00488 "" RAT_FUNC "%8.5" "V" COEFFS 0 204.8 0 0 0 1 /end COMPU_METHOD
/begin COMPU_METHOD Def_u_uw_q0p0942 "" RAT_FUNC "%6.3" "V" COEFFS 0 10.6157112526539 0 0 0 1 /end COMPU_METHOD
/begin COMPU_METHOD Def_v_uw_q0p1 "" RAT_FUNC "%7.4" "km/h" COEFFS 0 10 0 0 0 1 /end COMPU_METHOD
/begin COMPU_METHOD Def_v_uw_q1p0 "" RAT_FUNC "%5.2" "km/h" COEFFS 0 1 0 0 0 1 /end COMPU_METHOD
/begin COMPU_METHOD Def_wdk_sw_q0p0244 "" RAT_FUNC "%7.4" "%" COEFFS 0 40.96 0 0 0 1 /end COMPU_METHOD
/begin COMPU_METHOD DtyCyc "" RAT_FUNC "%5.2" "%" COEFFS 0 100 0 0 0 1 /end COMPU_METHOD
/begin COMPU_METHOD EGTSwt_S16 "" RAT_FUNC "%7.6" "-" COEFFS 0 16384 0 0 0 1 /end COMPU_METHOD
/begin COMPU_METHOD EngN "" RAT_FUNC "%5.1" "rpm" COEFFS 0 2 0 0 0 1 /end COMPU_METHOD
/begin COMPU_METHOD Fact "" RAT_FUNC "%6.5" "-" COEFFS 0 8192 0 0 0 1 /end COMPU_METHOD
/begin COMPU_METHOD FlCons_100km "" RAT_FUNC "%6.4" "l/100km" COEFFS 0 20 0 0 0 1 /end COMPU_METHOD
/begin COMPU_METHOD FlCons_lps_q0p0001 "" RAT_FUNC "%7.6" "l/s" COEFFS 0 10000 0 0 0 1 /end COMPU_METHOD
/begin COMPU_METHOD Fl_2 "" RAT_FUNC "%6.1" "l" COEFFS 0 0.1 0 0 0 1 /end COMPU_METHOD
/begin COMPU_METHOD Fl_L "" RAT_FUNC "%6.4" "l" COEFFS 0 100 0 0 0 1 /end COMPU_METHOD
/begin COMPU_METHOD Fl_Vol "" RAT_FUNC "%6.5" "l/100km" COEFFS 0 1000 0 0 0 1 /end COMPU_METHOD
/begin COMPU_METHOD hPaPerSec "" RAT_FUNC "%6.3" "hPa/s" COEFFS 0 10 0 0 0 1 /end COMPU_METHOD
/begin COMPU_METHOD Identity "" RAT_FUNC "%3.1" "-" COEFFS 0 1 0 0 0 1 /end COMPU_METHOD
/begin COMPU_METHOD InjMass "" RAT_FUNC "%5.2" "mg/hub" COEFFS 0 100 0 0 0 1 /end COMPU_METHOD
/begin COMPU_METHOD InjMassCyc "" RAT_FUNC "%5.2" "mg/cyc" COEFFS 0 100 0 0 0 1 /end COMPU_METHOD
/begin COMPU_METHOD InjMassInj "" RAT_FUNC "%5.2" "mg/inj" COEFFS 0 100 0 0 0 1 /end COMPU_METHOD
/begin COMPU_METHOD Kd "" RAT_FUNC "%7.6" "1/1" COEFFS 0 65536 0 0 0 1 /end COMPU_METHOD
/begin COMPU_METHOD Kd_Pres_hPa2Prc "" RAT_FUNC "%9.8" "%/hPa" COEFFS 0 5368709.12 0 0 0 1 /end COMPU_METHOD
/begin COMPU_METHOD Ki_Pres_hPa2Prc "" RAT_FUNC "%8.7" "%/(hPa*s)" COEFFS 0 175921.86044416 0 0 0 1 /end COMPU_METHOD
/begin COMPU_METHOD Kp_Pres_hPa2Prc "" RAT_FUNC "%9.8" "%/hPa" COEFFS 0 2684354.56 0 0 0 1 /end COMPU_METHOD
/begin COMPU_METHOD Length "" RAT_FUNC "%6.2" "m" COEFFS 0 1 0 0 0 1 /end COMPU_METHOD
/begin COMPU_METHOD LengthKm "" RAT_FUNC "%6.1" "Km" COEFFS 0 0.05 0 0 0 1 /end COMPU_METHOD
/begin COMPU_METHOD lSnceRgnRes "" RAT_FUNC "%6.0" "m" COEFFS 0 0.0078125 0 0 0 1 /end COMPU_METHOD
/begin COMPU_METHOD mSoot_g "" RAT_FUNC "%6.4" "g" COEFFS 0 100 0 0 0 1 /end COMPU_METHOD
/begin COMPU_METHOD NOxMassPerTime "" RAT_FUNC "%6.3" "mg/s" COEFFS 0 10 0 0 0 1 /end COMPU_METHOD
/begin COMPU_METHOD OneToOne "" RAT_FUNC "%6.0" "-" COEFFS 0 1 0 0 0 1 /end COMPU_METHOD
/begin COMPU_METHOD PhyMod_InjName "" TAB_VERB "%2.1" "-" COMPU_TAB_REF PhyMod_InjName /end COMPU_METHOD
/begin COMPU_VTAB PhyMod_InjName "" TAB_VERB 2 0 "CALCCOR" 1 "GENCUR" /end COMPU_VTAB
/begin COMPU_METHOD PhyMod_MapName "" TAB_VERB "%2.1" "-" COMPU_TAB_REF PhyMod_MapName /end COMPU_METHOD
/begin COMPU_VTAB PhyMod_MapName "" TAB_VERB 10 0 "MAP-0" 1 "MAP-1" 2 "MAP-2" 3 "MAP-3" 4 "MAP-4" 5 "MAP-5" 6 "MAP-6" 7 "MAP-7" 8 "MAP-8" 9 "MAP-9" /end COMPU_VTAB
/begin COMPU_METHOD PhyMod_OpModeName "Konvertiert den Betriebsartindex in den Betriebsartnamen" TAB_VERB "%2.1" "-" COMPU_TAB_REF PhyMod_OpModeName /end COMPU_METHOD
/begin COMPU_VTAB PhyMod_OpModeName "Konvertiert den Betriebsartindex in den Betriebsartnamen" TAB_VERB 21 0 "LEAN [0]" 1 "LEAN [1]" 2 "LEAN [2]" 3 "PFLT1 [0]" 4 "PFLT1 [1]" 5 "PFLT1 [2]" 6 "PFLT1 [3]" 7 "PFLT1 [4]" 8 "PFLT1 [5]" 9 "PFLT1 [6]" 10 "PHC [1]" 11 "PHC [2]" 12 "PHC [3]" 13 "NSC [0]" 14 "NSC [1]" 15 "NSC [2]" 16 "NSC [3]" 17 "SOX [0]" 18 "SOX [1]" 19 "SOX [2]" 20 "SOX [3]" /end COMPU_VTAB
/begin COMPU_METHOD PPC_SwitchState "" TAB_VERB "%6.3" "" COMPU_TAB_REF PPC_SwitchState /end COMPU_METHOD
/begin COMPU_VTAB PPC_SwitchState "" TAB_VERB 3 0 "PPC_USE_LABEL" 1 "PPC_USE_GOVERNOR" 2 "PPC_USE_HYSTERESIS" /end COMPU_VTAB
/begin COMPU_METHOD Prc "" RAT_FUNC "%6.4" "%" COEFFS 0 81.92 0 0 0 1 /end COMPU_METHOD
/begin COMPU_METHOD PrcPerSec "" RAT_FUNC "%6.3" "%/s" COEFFS 0 1.6384 0 0 0 1 /end COMPU_METHOD
/begin COMPU_METHOD PreshPa_sec "" RAT_FUNC "%6.2" "hPa/s" COEFFS 0 1 0 0 0 1 /end COMPU_METHOD
/begin COMPU_METHOD Pres_hPa "" RAT_FUNC "%5.1" "hPa" COEFFS 0 1 0 0 0 1 /end COMPU_METHOD
/begin COMPU_METHOD Pwr2 "" RAT_FUNC "%6.1" "W" COEFFS 0 0.0530516476972949 0 0 0 1 /end COMPU_METHOD
/begin COMPU_METHOD RatSotSot "" RAT_FUNC "%6.5" "-" COEFFS 0 4000 0 0 0 1 /end COMPU_METHOD
/begin COMPU_METHOD Res_hPaHrPerCM "" RAT_FUNC "%7.6" "hPa/(m^3/h)" COEFFS 0 10000 0 0 0 1 /end COMPU_METHOD
/begin COMPU_METHOD RmpPres_hPa "" RAT_FUNC "%6.4" "hPa/s" COEFFS 0 65.536 0 0 0 1 /end COMPU_METHOD
/begin COMPU_METHOD SotMassPerTime "" RAT_FUNC "%6.4" "mg/s" COEFFS 0 100 0 0 0 1 /end COMPU_METHOD
/begin COMPU_METHOD TempDiff_Cels "" RAT_FUNC "%6.3" "deg C" COEFFS 0 10 0 0 0 1 /end COMPU_METHOD
/begin COMPU_METHOD TempDiff_Kelv "" RAT_FUNC "%4.1" "K" COEFFS 0 10 0 0 0 1 /end COMPU_METHOD
/begin COMPU_METHOD Temp_Cels "" RAT_FUNC "%5.1" "deg C" COEFFS 0 10 2731.4 0 0 1 /end COMPU_METHOD
/begin COMPU_METHOD TimeDeb "" RAT_FUNC "%5.0" "ms" COEFFS 0 0.1 0 0 0 1 /end COMPU_METHOD
/begin COMPU_METHOD TimeDelay_s "" RAT_FUNC "%12.4" "s" COEFFS 0 0 1 0 0.00023283064365387 0 /end COMPU_METHOD
/begin COMPU_METHOD TimeDelay_s_float "" RAT_FUNC "%6.2" "s" COEFFS 0 1 0 0 0 1 /end COMPU_METHOD
/begin COMPU_METHOD TimeEngOn "" RAT_FUNC "%6.2" "s" COEFFS 0 1 0 0 0 1 /end COMPU_METHOD
/begin COMPU_METHOD TimePFltLimpHome "" RAT_FUNC "%6.1" "s" COEFFS 0 0.1 0 0 0 1 /end COMPU_METHOD
/begin COMPU_METHOD Time_ms "" RAT_FUNC "%5.0" "ms" COEFFS 0 0.1 0 0 0 1 /end COMPU_METHOD
/begin COMPU_METHOD Time_s "" RAT_FUNC "%5.2" "s" COEFFS 0 100 0 0 0 1 /end COMPU_METHOD
/begin COMPU_METHOD Time_s_Resolution100ms "" RAT_FUNC "%6.3" "s" COEFFS 0 10 0 0 0 1 /end COMPU_METHOD
/begin COMPU_METHOD Time_TempSnceRgn16 "" RAT_FUNC "%6.1" "s" COEFFS 0 0.025 0 0 0 1 /end COMPU_METHOD
/begin COMPU_METHOD Trq "" RAT_FUNC "%5.1" "Nm" COEFFS 0 10 0 0 0 1 /end COMPU_METHOD
/begin COMPU_METHOD Vel "" RAT_FUNC "%5.2" "km/h" COEFFS 0 100 0 0 0 1 /end COMPU_METHOD
/begin COMPU_METHOD Vol "" RAT_FUNC "%6.4" "l" COEFFS 0 100 0 0 0 1 /end COMPU_METHOD
/begin COMPU_METHOD Volt "" RAT_FUNC "%6.1" "mV" COEFFS 0 5 0 0 0 1 /end COMPU_METHOD
/begin RECORD_LAYOUT Axis_Xu8 NO_AXIS_PTS_X 1 UBYTE AXIS_PTS_X 2 UBYTE INDEX_INCR DIRECT /end RECORD_LAYOUT
/begin RECORD_LAYOUT CurTKL_UB_VV_SW NO_AXIS_PTS_X 1 UBYTE RESERVED 2 BYTE AXIS_PTS_X 3 UBYTE INDEX_INCR DIRECT FNC_VALUES 4 SWORD COLUMN_DIR DIRECT /end RECORD_LAYOUT
/begin RECORD_LAYOUT CurTKL_UB_VV_UB NO_AXIS_PTS_X 1 UBYTE RESERVED 2 BYTE AXIS_PTS_X 3 UBYTE INDEX_INCR DIRECT FNC_VALUES 4 UBYTE COLUMN_DIR DIRECT /end RECORD_LAYOUT
/begin RECORD_LAYOUT CurTKL_UB_VV_UW NO_AXIS_PTS_X 1 UBYTE RESERVED 2 BYTE AXIS_PTS_X 3 UBYTE INDEX_INCR DIRECT FNC_VALUES 4 UWORD COLUMN_DIR DIRECT /end RECORD_LAYOUT
/begin RECORD_LAYOUT Cur_Xs16Ws16 NO_AXIS_PTS_X 1 SWORD AXIS_PTS_X 2 SWORD INDEX_INCR DIRECT FNC_VALUES 3 SWORD COLUMN_DIR DIRECT /end RECORD_LAYOUT
/begin RECORD_LAYOUT Kf_Xs16_Ys16_Ws16 NO_AXIS_PTS_X 1 SWORD NO_AXIS_PTS_Y 2 SWORD AXIS_PTS_X 3 SWORD INDEX_INCR DIRECT AXIS_PTS_Y 4 SWORD INDEX_INCR DIRECT FNC_VALUES 5 SWORD COLUMN_DIR DIRECT /end RECORD_LAYOUT
/begin RECORD_LAYOUT Kwb_Wu32 FNC_VALUES 1 ULONG COLUMN_DIR DIRECT /end RECORD_LAYOUT
/begin RECORD_LAYOUT Kw_Ws16 FNC_VALUES 1 SWORD COLUMN_DIR DIRECT /end RECORD_LAYOUT
/begin RECORD_LAYOUT Kw_Ws32 FNC_VALUES 1 SLONG COLUMN_DIR DIRECT /end RECORD_LAYOUT
/begin RECORD_LAYOUT Kw_Wu16 FNC_VALUES 1 UWORD COLUMN_DIR DIRECT /end RECORD_LAYOUT
/begin RECORD_LAYOUT Kw_Wu8 FNC_VALUES 1 UBYTE COLUMN_DIR DIRECT /end RECORD_LAYOUT
/begin RECORD_LAYOUT MapG_Wu8 FNC_VALUES 1 UBYTE COLUMN_DIR DIRECT /end RECORD_LAYOUT
/begin RECORD_LAYOUT MapTKF_SW_SW_SW NO_AXIS_PTS_X 1 UBYTE NO_AXIS_PTS_Y 2 UBYTE AXIS_PTS_X 3 SWORD INDEX_INCR DIRECT AXIS_PTS_Y 4 SWORD INDEX_INCR DIRECT FNC_VALUES 5 SWORD COLUMN_DIR DIRECT /end RECORD_LAYOUT
/begin RECORD_LAYOUT MapTKF_SW_SW_UB NO_AXIS_PTS_X 1 UBYTE NO_AXIS_PTS_Y 2 UBYTE AXIS_PTS_X 3 SWORD INDEX_INCR DIRECT AXIS_PTS_Y 4 SWORD INDEX_INCR DIRECT FNC_VALUES 5 UBYTE COLUMN_DIR DIRECT /end RECORD_LAYOUT
/begin RECORD_LAYOUT MapTKF_UB_SW_UW NO_AXIS_PTS_X 1 UBYTE NO_AXIS_PTS_Y 2 UBYTE AXIS_PTS_X 3 SWORD INDEX_INCR DIRECT AXIS_PTS_Y 4 UBYTE INDEX_INCR DIRECT FNC_VALUES 5 UWORD COLUMN_DIR DIRECT /end RECORD_LAYOUT
/begin RECORD_LAYOUT Map_Xs16Ys16Ws16 NO_AXIS_PTS_X 1 SWORD NO_AXIS_PTS_Y 2 SWORD AXIS_PTS_X 3 SWORD INDEX_INCR DIRECT AXIS_PTS_Y 4 SWORD INDEX_INCR DIRECT FNC_VALUES 5 SWORD COLUMN_DIR DIRECT /end RECORD_LAYOUT
/begin RECORD_LAYOUT ValA_Ws16 FNC_VALUES 1 SWORD COLUMN_DIR DIRECT /end RECORD_LAYOUT
/begin RECORD_LAYOUT ValA_Ws32 FNC_VALUES 1 SLONG COLUMN_DIR DIRECT /end RECORD_LAYOUT
/begin RECORD_LAYOUT ValA_Wu32 FNC_VALUES 1 ULONG COLUMN_DIR DIRECT /end RECORD_LAYOUT
/begin RECORD_LAYOUT Val_Wr32 FNC_VALUES 1 FLOAT32_IEEE COLUMN_DIR DIRECT /end RECORD_LAYOUT
/begin RECORD_LAYOUT Val_Ws16 FNC_VALUES 1 SWORD COLUMN_DIR DIRECT /end RECORD_LAYOUT
/begin RECORD_LAYOUT Val_Ws32 FNC_VALUES 1 SLONG COLUMN_DIR DIRECT /end RECORD_LAYOUT
/begin RECORD_LAYOUT Val_Ws8 FNC_VALUES 1 SBYTE COLUMN_DIR DIRECT /end RECORD_LAYOUT
/begin RECORD_LAYOUT Val_Wu16 FNC_VALUES 1 UWORD COLUMN_DIR DIRECT /end RECORD_LAYOUT
/begin RECORD_LAYOUT Val_Wu32 FNC_VALUES 1 ULONG COLUMN_DIR DIRECT /end RECORD_LAYOUT
/begin RECORD_LAYOUT Val_Wu8 FNC_VALUES 1 UBYTE COLUMN_DIR DIRECT /end RECORD_LAYOUT
/end MODULE
/end PROJECT

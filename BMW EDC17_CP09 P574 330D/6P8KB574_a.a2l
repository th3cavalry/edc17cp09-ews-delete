ASAP2_VERSION 1 4
/begin PROJECT P_574 "EDC17_CP09"
/begin HEADER "" VERSION "V8KB" PROJECT_NO P_574 /end HEADER
/begin MODULE DIM ""
/begin MOD_COMMON "" BYTE_ORDER MSB_LAST ALIGNMENT_BYTE 1 ALIGNMENT_WORD 2 ALIGNMENT_LONG 4 ALIGNMENT_FLOAT32_IEEE 4 /end MOD_COMMON
/begin CHARACTERISTIC DFES_DbLv.DFC_ComRpmWhlTo_FX_C "DFES/Entprelllevel zur Erstellung eines DFES Eintrages für Prüfung DFC_ComRpmWhlTo_FX" VALUE 0x80029995 Val_Wu8 15.00 DFES_OneToOne 0.00 15.00 EXTENDED_LIMITS 0.00 255.0 /end CHARACTERISTIC
/begin CHARACTERISTIC DFES_DbLv.DFC_ComSecCtrRelSig_FA_C "DFES/Entprelllevel zur Erstellung eines DFES Eintrages für Prüfung DFC_ComSecCtrRelSig_FA" VALUE 0x80029996 Val_Wu8 15.00 DFES_OneToOne 0.00 15.00 EXTENDED_LIMITS 0.00 255.0 /end CHARACTERISTIC
/begin CHARACTERISTIC DFES_DbLv.DFC_ComSecCtrRelTo_FA_C "DFES/Entprelllevel zur Erstellung eines DFES Eintrages für Prüfung DFC_ComSecCtrRelTo_FA" VALUE 0x80029997 Val_Wu8 15.00 DFES_OneToOne 0.00 15.00 EXTENDED_LIMITS 0.00 255.0 /end CHARACTERISTIC
/begin CHARACTERISTIC DFES_DbLv.DFC_ComSensNOxGndSig_C "DFES/Entprelllevel zur Erstellung eines DFES Eintrages für Prüfung DFC_ComSensNOxGndSig" VALUE 0x80029998 Val_Wu8 15.00 DFES_OneToOne 0.00 15.00 EXTENDED_LIMITS 0.00 255.0 /end CHARACTERISTIC
/begin CHARACTERISTIC DFES_DbLv.DFC_ComSensNOxGndTo_C "DFES/Entprelllevel zur Erstellung eines DFES Eintrages für Prüfung DFC_ComSensNOxGndTo" VALUE 0x80029999 Val_Wu8 15.00 DFES_OneToOne 0.00 15.00 EXTENDED_LIMITS 0.00 255.0 /end CHARACTERISTIC
/begin CHARACTERISTIC DFES_DbLv.DFC_ComSensNOxMode_C "DFES/Entprelllevel zur Erstellung eines DFES Eintrages für Prüfung DFC_ComSensNOxMode" VALUE 0x8002999A Val_Wu8 15.00 DFES_OneToOne 0.00 15.00 EXTENDED_LIMITS 0.00 255.0 /end CHARACTERISTIC
/begin CHARACTERISTIC DFES_DbLv.DFC_ComSensNOxUbattSig_C "DFES/Entprelllevel zur Erstellung eines DFES Eintrages für Prüfung DFC_ComSensNOxUbattSig" VALUE 0x8002999B Val_Wu8 15.00 DFES_OneToOne 0.00 15.00 EXTENDED_LIMITS 0.00 255.0 /end CHARACTERISTIC
/begin CHARACTERISTIC DFES_DbLv.DFC_ComSensNOxUbattTo_C "DFES/Entprelllevel zur Erstellung eines DFES Eintrages für Prüfung DFC_ComSensNOxUbattTo" VALUE 0x8002999C Val_Wu8 15.00 DFES_OneToOne 0.00 15.00 EXTENDED_LIMITS 0.00 255.0 /end CHARACTERISTIC
/begin CHARACTERISTIC DFES_DbLv.DFC_ComShiftPaddleTo_FX_C "DFES/Entprelllevel zur Erstellung eines DFES Eintrages für Prüfung DFC_ComShiftPaddleTo_FX" VALUE 0x8002999D Val_Wu8 15.00 DFES_OneToOne 0.00 15.00 EXTENDED_LIMITS 0.00 255.0 /end CHARACTERISTIC
/begin CHARACTERISTIC DFES_DbLv.DFC_ComShutOffPSPSig_C "DFES/Entprelllevel zur Erstellung eines DFES Eintrages für Prüfung DFC_ComShutOffPSPSig" VALUE 0x8002999E Val_Wu8 15.00 DFES_OneToOne 0.00 15.00 EXTENDED_LIMITS 0.00 255.0 /end CHARACTERISTIC
/begin CHARACTERISTIC DFES_DbLv.DFC_ComShutOffPSPTo_C "DFES/Entprelllevel zur Erstellung eines DFES Eintrages für Prüfung DFC_ComShutOffPSPTo" VALUE 0x8002999F Val_Wu8 15.00 DFES_OneToOne 0.00 15.00 EXTENDED_LIMITS 0.00 255.0 /end CHARACTERISTIC
/begin CHARACTERISTIC DFES_DbLv.DFC_ComSlrdiGlbFZMTo_FA_C "DFES/Entprelllevel zur Erstellung eines DFES Eintrages für Prüfung DFC_ComSlrdiGlbFZMTo_FA" VALUE 0x800299A0 Val_Wu8 15.00 DFES_OneToOne 0.00 15.00 EXTENDED_LIMITS 0.00 255.0 /end CHARACTERISTIC
/begin CHARACTERISTIC DFES_DbLv.DFC_ComSlrdiGlbFZMTo_FX_C "DFES/Entprelllevel zur Erstellung eines DFES Eintrages für Prüfung DFC_ComSlrdiGlbFZMTo_FX" VALUE 0x800299A1 Val_Wu8 15.00 DFES_OneToOne 0.00 15.00 EXTENDED_LIMITS 0.00 255.0 /end CHARACTERISTIC
/begin CHARACTERISTIC DFES_DbLv.DFC_ComSpeedVehicleChk_FX_C "DFES/Entprelllevel zur Erstellung eines DFES Eintrages für Prüfung DFC_ComSpeedVehicleChk_FX" VALUE 0x800299A2 Val_Wu8 15.00 DFES_OneToOne 0.00 15.00 EXTENDED_LIMITS 0.00 255.0 /end CHARACTERISTIC
/begin CHARACTERISTIC DFES_DbLv.DFC_ComSpeedVehicleCtr_FX_C "DFES/Entprelllevel zur Erstellung eines DFES Eintrages für Prüfung DFC_ComSpeedVehicleCtr_FX" VALUE 0x800299A3 Val_Wu8 15.00 DFES_OneToOne 0.00 15.00 EXTENDED_LIMITS 0.00 255.0 /end CHARACTERISTIC
/begin CHARACTERISTIC DFES_DbLv.DFC_ComSpeedVehicleTo_FX_C "DFES/Entprelllevel zur Erstellung eines DFES Eintrages für Prüfung DFC_ComSpeedVehicleTo_FX" VALUE 0x800299A4 Val_Wu8 15.00 DFES_OneToOne 0.00 15.00 EXTENDED_LIMITS 0.00 255.0 /end CHARACTERISTIC
/begin CHARACTERISTIC DFES_DbLv.DFC_ComStConintDSCChk_FX_C "DFES/Entprelllevel zur Erstellung eines DFES Eintrages für Prüfung DFC_ComStConintDSCChk_FX" VALUE 0x800299A5 Val_Wu8 15.00 DFES_OneToOne 0.00 15.00 EXTENDED_LIMITS 0.00 255.0 /end CHARACTERISTIC
/begin CHARACTERISTIC DFES_DbLv.DFC_ComStConintDSCCtr_FX_C "DFES/Entprelllevel zur Erstellung eines DFES Eintrages für Prüfung DFC_ComStConintDSCCtr_FX" VALUE 0x800299A6 Val_Wu8 15.00 DFES_OneToOne 0.00 15.00 EXTENDED_LIMITS 0.00 255.0 /end CHARACTERISTIC
/begin CHARACTERISTIC DFES_DbLv.DFC_ComStConintDSCTo_FX_C "DFES/Entprelllevel zur Erstellung eines DFES Eintrages für Prüfung DFC_ComStConintDSCTo_FX" VALUE 0x800299A7 Val_Wu8 15.00 DFES_OneToOne 0.00 15.00 EXTENDED_LIMITS 0.00 255.0 /end CHARACTERISTIC
/begin CHARACTERISTIC DFES_DbLv.DFC_ComStatACFrontSig_FA_C "DFES/Entprelllevel zur Erstellung eines DFES Eintrages für Prüfung DFC_ComStatACFrontSig_FA" VALUE 0x800299A8 Val_Wu8 15.00 DFES_OneToOne 0.00 15.00 EXTENDED_LIMITS 0.00 255.0 /end CHARACTERISTIC
/begin CHARACTERISTIC DFES_DbLv.DFC_ComStatACFrontTo_FA_C "DFES/Entprelllevel zur Erstellung eines DFES Eintrages für Prüfung DFC_ComStatACFrontTo_FA" VALUE 0x800299A9 Val_Wu8 15.00 DFES_OneToOne 0.00 15.00 EXTENDED_LIMITS 0.00 255.0 /end CHARACTERISTIC
/begin CHARACTERISTIC DFES_DbLv.DFC_ComStatEkpSig_A_C "DFES/Entprelllevel zur Erstellung eines DFES Eintrages für Prüfung DFC_ComStatEkpSig_A" VALUE 0x800299AA Val_Wu8 15.00 DFES_OneToOne 0.00 15.00 EXTENDED_LIMITS 0.00 255.0 /end CHARACTERISTIC
/begin CHARACTERISTIC DFES_DbLv.DFC_ComStatEkpTo_A_C "DFES/Entprelllevel zur Erstellung eines DFES Eintrages für Prüfung DFC_ComStatEkpTo_A" VALUE 0x800299AB Val_Wu8 15.00 DFES_OneToOne 0.00 15.00 EXTENDED_LIMITS 0.00 255.0 /end CHARACTERISTIC
/begin CHARACTERISTIC DFES_DbLv.DFC_ComStatGearRevSig_FA_C "DFES/Entprelllevel zur Erstellung eines DFES Eintrages für Prüfung DFC_ComStatGearRevSig_FA" VALUE 0x800299AC Val_Wu8 15.00 DFES_OneToOne 0.00 15.00 EXTENDED_LIMITS 0.00 255.0 /end CHARACTERISTIC
/begin CHARACTERISTIC DFES_DbLv.DFC_ComStatGearRevTo_FA_C "DFES/Entprelllevel zur Erstellung eines DFES Eintrages für Prüfung DFC_ComStatGearRevTo_FA" VALUE 0x800299AD Val_Wu8 15.00 DFES_OneToOne 0.00 15.00 EXTENDED_LIMITS 0.00 255.0 /end CHARACTERISTIC
/begin CHARACTERISTIC DFES_DbLv.DFC_ComStatZVKlappenSig_FA_C "DFES/Entprelllevel zur Erstellung eines DFES Eintrages für Prüfung DFC_ComStatZVKlappenSig_FA" VALUE 0x800299AE Val_Wu8 15.00 DFES_OneToOne 0.00 15.00 EXTENDED_LIMITS 0.00 255.0 /end CHARACTERISTIC
/begin CHARACTERISTIC DFES_DbLv.DFC_ComStatZVKlappenTo_FA_C "DFES/Entprelllevel zur Erstellung eines DFES Eintrages für Prüfung DFC_ComStatZVKlappenTo_FA" VALUE 0x800299AF Val_Wu8 15.00 DFES_OneToOne 0.00 15.00 EXTENDED_LIMITS 0.00 255.0 /end CHARACTERISTIC
/begin CHARACTERISTIC DFES_DbLv.DFC_ComStateARSCtr_C "DFES/Entprelllevel zur Erstellung eines DFES Eintrages für Prüfung DFC_ComStateARSCtr" VALUE 0x800299B0 Val_Wu8 15.00 DFES_OneToOne 0.00 15.00 EXTENDED_LIMITS 0.00 255.0 /end CHARACTERISTIC
/begin CHARACTERISTIC DFES_DbLv.DFC_ComStateARSSig_C "DFES/Entprelllevel zur Erstellung eines DFES Eintrages für Prüfung DFC_ComStateARSSig" VALUE 0x800299B1 Val_Wu8 15.00 DFES_OneToOne 0.00 15.00 EXTENDED_LIMITS 0.00 255.0 /end CHARACTERISTIC
/begin CHARACTERISTIC DFES_DbLv.DFC_ComStateARSTo_C "DFES/Entprelllevel zur Erstellung eines DFES Eintrages für Prüfung DFC_ComStateARSTo" VALUE 0x800299B2 Val_Wu8 15.00 DFES_OneToOne 0.00 15.00 EXTENDED_LIMITS 0.00 255.0 /end CHARACTERISTIC
/begin CHARACTERISTIC DFES_DbLv.DFC_ComStateDscSig_C "DFES/Entprelllevel zur Erstellung eines DFES Eintrages für Prüfung DFC_ComStateDscSig" VALUE 0x800299B3 Val_Wu8 15.00 DFES_OneToOne 0.00 15.00 EXTENDED_LIMITS 0.00 255.0 /end CHARACTERISTIC
/begin CHARACTERISTIC DFES_DbLv.DFC_ComStateDscTo_C "DFES/Entprelllevel zur Erstellung eines DFES Eintrages für Prüfung DFC_ComStateDscTo" VALUE 0x800299B4 Val_Wu8 15.00 DFES_OneToOne 0.00 15.00 EXTENDED_LIMITS 0.00 255.0 /end CHARACTERISTIC
/begin CHARACTERISTIC DFES_DbLv.DFC_ComStateSeatSig_C "DFES/Entprelllevel zur Erstellung eines DFES Eintrages für Prüfung DFC_ComStateSeatSig" VALUE 0x800299B5 Val_Wu8 15.00 DFES_OneToOne 0.00 15.00 EXTENDED_LIMITS 0.00 255.0 /end CHARACTERISTIC
/begin CHARACTERISTIC DFES_DbLv.DFC_ComStateSeatSig_FA_C "DFES/Entprelllevel zur Erstellung eines DFES Eintrages für Prüfung DFC_ComStateSeatSig_FA" VALUE 0x800299B6 Val_Wu8 15.00 DFES_OneToOne 0.00 15.00 EXTENDED_LIMITS 0.00 255.0 /end CHARACTERISTIC
/begin CHARACTERISTIC DFES_DbLv.DFC_ComStateSeatTo_C "DFES/Entprelllevel zur Erstellung eines DFES Eintrages für Prüfung DFC_ComStateSeatTo" VALUE 0x800299B7 Val_Wu8 15.00 DFES_OneToOne 0.00 15.00 EXTENDED_LIMITS 0.00 255.0 /end CHARACTERISTIC
/begin CHARACTERISTIC DFES_DbLv.DFC_ComStateSeatTo_FA_C "DFES/Entprelllevel zur Erstellung eines DFES Eintrages für Prüfung DFC_ComStateSeatTo_FA" VALUE 0x800299B8 Val_Wu8 15.00 DFES_OneToOne 0.00 15.00 EXTENDED_LIMITS 0.00 255.0 /end CHARACTERISTIC
/begin CHARACTERISTIC DFES_DbLv.DFC_ComStatusEGSSig_A_C "DFES/Entprelllevel zur Erstellung eines DFES Eintrages für Prüfung DFC_ComStatusEGSSig_A" VALUE 0x800299B9 Val_Wu8 15.00 DFES_OneToOne 0.00 15.00 EXTENDED_LIMITS 0.00 255.0 /end CHARACTERISTIC
/begin CHARACTERISTIC DFES_DbLv.DFC_ComStatusEGSSig_FA_C "DFES/Entprelllevel zur Erstellung eines DFES Eintrages für Prüfung DFC_ComStatusEGSSig_FA" VALUE 0x800299BA Val_Wu8 15.00 DFES_OneToOne 0.00 15.00 EXTENDED_LIMITS 0.00 255.0 /end CHARACTERISTIC
/begin CHARACTERISTIC DFES_DbLv.DFC_ComStatusEGSTo_A_C "DFES/Entprelllevel zur Erstellung eines DFES Eintrages für Prüfung DFC_ComStatusEGSTo_A" VALUE 0x800299BB Val_Wu8 15.00 DFES_OneToOne 0.00 15.00 EXTENDED_LIMITS 0.00 255.0 /end CHARACTERISTIC
/begin CHARACTERISTIC DFES_DbLv.DFC_ComStatusEGSTo_FA_C "DFES/Entprelllevel zur Erstellung eines DFES Eintrages für Prüfung DFC_ComStatusEGSTo_FA" VALUE 0x800299BC Val_Wu8 15.00 DFES_OneToOne 0.00 15.00 EXTENDED_LIMITS 0.00 255.0 /end CHARACTERISTIC
/begin CHARACTERISTIC DFES_DbLv.DFC_ComStatusEMFChk_C "DFES/Entprelllevel zur Erstellung eines DFES Eintrages für Prüfung DFC_ComStatusEMFChk" VALUE 0x800299BD Val_Wu8 15.00 DFES_OneToOne 0.00 15.00 EXTENDED_LIMITS 0.00 255.0 /end CHARACTERISTIC
/begin CHARACTERISTIC DFES_DbLv.DFC_ComStatusEMFCtr_C "DFES/Entprelllevel zur Erstellung eines DFES Eintrages für Prüfung DFC_ComStatusEMFCtr" VALUE 0x800299BE Val_Wu8 15.00 DFES_OneToOne 0.00 15.00 EXTENDED_LIMITS 0.00 255.0 /end CHARACTERISTIC
/begin CHARACTERISTIC DFES_DbLv.DFC_ComStatusEMFSig_C "DFES/Entprelllevel zur Erstellung eines DFES Eintrages für Prüfung DFC_ComStatusEMFSig" VALUE 0x800299BF Val_Wu8 15.00 DFES_OneToOne 0.00 15.00 EXTENDED_LIMITS 0.00 255.0 /end CHARACTERISTIC
/begin CHARACTERISTIC DFES_DbLv.DFC_ComStatusEMFTo_C "DFES/Entprelllevel zur Erstellung eines DFES Eintrages für Prüfung DFC_ComStatusEMFTo" VALUE 0x800299C0 Val_Wu8 15.00 DFES_OneToOne 0.00 15.00 EXTENDED_LIMITS 0.00 255.0 /end CHARACTERISTIC
/begin CHARACTERISTIC DFES_DbLv.DFC_ComStatusRGangSig_C "DFES/Entprelllevel zur Erstellung eines DFES Eintrages für Prüfung DFC_ComStatusRGangSig" VALUE 0x800299C1 Val_Wu8 15.00 DFES_OneToOne 0.00 15.00 EXTENDED_LIMITS 0.00 255.0 /end CHARACTERISTIC
/begin CHARACTERISTIC DFES_DbLv.DFC_ComStatusRGangTo_C "DFES/Entprelllevel zur Erstellung eines DFES Eintrages für Prüfung DFC_ComStatusRGangTo" VALUE 0x800299C2 Val_Wu8 15.00 DFES_OneToOne 0.00 15.00 EXTENDED_LIMITS 0.00 255.0 /end CHARACTERISTIC
/begin CHARACTERISTIC DFES_DbLv.DFC_ComSteeringAngleChk_FX_C "DFES/Entprelllevel zur Erstellung eines DFES Eintrages für Prüfung DFC_ComSteeringAngleChk_FX" VALUE 0x800299C3 Val_Wu8 15.00 DFES_OneToOne 0.00 15.00 EXTENDED_LIMITS 0.00 255.0 /end CHARACTERISTIC
/begin CHARACTERISTIC DFES_DbLv.DFC_ComSteeringAngleCtr_FX_C "DFES/Entprelllevel zur Erstellung eines DFES Eintrages für Prüfung DFC_ComSteeringAngleCtr_FX" VALUE 0x800299C4 Val_Wu8 15.00 DFES_OneToOne 0.00 15.00 EXTENDED_LIMITS 0.00 255.0 /end CHARACTERISTIC
/begin CHARACTERISTIC DFES_DbLv.DFC_ComSteeringAngleTo_FX_C "DFES/Entprelllevel zur Erstellung eines DFES Eintrages für Prüfung DFC_ComSteeringAngleTo_FX" VALUE 0x800299C5 Val_Wu8 15.00 DFES_OneToOne 0.00 15.00 EXTENDED_LIMITS 0.00 255.0 /end CHARACTERISTIC
/begin CHARACTERISTIC DFES_DbLv.DFC_ComTerminalChk_C "DFES/Entprelllevel zur Erstellung eines DFES Eintrages für Prüfung DFC_ComTerminalChk" VALUE 0x800299C6 Val_Wu8 15.00 DFES_OneToOne 0.00 15.00 EXTENDED_LIMITS 0.00 255.0 /end CHARACTERISTIC
/begin CHARACTERISTIC DFES_DbLv.DFC_ComTerminalCtr_C "DFES/Entprelllevel zur Erstellung eines DFES Eintrages für Prüfung DFC_ComTerminalCtr" VALUE 0x800299C7 Val_Wu8 15.00 DFES_OneToOne 0.00 15.00 EXTENDED_LIMITS 0.00 255.0 /end CHARACTERISTIC
/begin CHARACTERISTIC DFES_DbLv.DFC_ComTerminalSig_C "DFES/Entprelllevel zur Erstellung eines DFES Eintrages für Prüfung DFC_ComTerminalSig" VALUE 0x800299C8 Val_Wu8 15.00 DFES_OneToOne 0.00 15.00 EXTENDED_LIMITS 0.00 255.0 /end CHARACTERISTIC
/begin CHARACTERISTIC DFES_DbLv.DFC_ComTerminalTo_C "DFES/Entprelllevel zur Erstellung eines DFES Eintrages für Prüfung DFC_ComTerminalTo" VALUE 0x800299C9 Val_Wu8 15.00 DFES_OneToOne 0.00 15.00 EXTENDED_LIMITS 0.00 255.0 /end CHARACTERISTIC
/begin CHARACTERISTIC DFES_DbLv.DFC_ComTimeDateSig_FA_C "DFES/Entprelllevel zur Erstellung eines DFES Eintrages für Prüfung DFC_ComTimeDateSig_FA" VALUE 0x800299CA Val_Wu8 15.00 DFES_OneToOne 0.00 15.00 EXTENDED_LIMITS 0.00 255.0 /end CHARACTERISTIC
/begin CHARACTERISTIC DFES_DbLv.DFC_ComTimeDateTo_FA_C "DFES/Entprelllevel zur Erstellung eines DFES Eintrages für Prüfung DFC_ComTimeDateTo_FA" VALUE 0x800299CB Val_Wu8 15.00 DFES_OneToOne 0.00 15.00 EXTENDED_LIMITS 0.00 255.0 /end CHARACTERISTIC
/begin CHARACTERISTIC DFES_DbLv.DFC_ComTrailerSig_C "DFES/Entprelllevel zur Erstellung eines DFES Eintrages für Prüfung DFC_ComTrailerSig" VALUE 0x800299CC Val_Wu8 15.00 DFES_OneToOne 0.00 15.00 EXTENDED_LIMITS 0.00 255.0 /end CHARACTERISTIC
/begin CHARACTERISTIC DFES_DbLv.DFC_ComTrailerSig_FA_C "DFES/Entprelllevel zur Erstellung eines DFES Eintrages für Prüfung DFC_ComTrailerSig_FA" VALUE 0x800299CD Val_Wu8 15.00 DFES_OneToOne 0.00 15.00 EXTENDED_LIMITS 0.00 255.0 /end CHARACTERISTIC
/begin CHARACTERISTIC DFES_DbLv.DFC_ComTrailerTo_C "DFES/Entprelllevel zur Erstellung eines DFES Eintrages für Prüfung DFC_ComTrailerTo" VALUE 0x800299CE Val_Wu8 15.00 DFES_OneToOne 0.00 15.00 EXTENDED_LIMITS 0.00 255.0 /end CHARACTERISTIC
/begin CHARACTERISTIC DFES_DbLv.DFC_ComTrailerTo_FA_C "DFES/Entprelllevel zur Erstellung eines DFES Eintrages für Prüfung DFC_ComTrailerTo_FA" VALUE 0x800299CF Val_Wu8 15.00 DFES_OneToOne 0.00 15.00 EXTENDED_LIMITS 0.00 255.0 /end CHARACTERISTIC
/begin CHARACTERISTIC DFES_DbLv.DFC_ComTrqDemCrshDrDyChk_FX_C "DFES/Entprelllevel zur Erstellung eines DFES Eintrages für Prüfung DFC_ComTrqDemCrshDrDyChk_FX" VALUE 0x800299D0 Val_Wu8 15.00 DFES_OneToOne 0.00 15.00 EXTENDED_LIMITS 0.00 255.0 /end CHARACTERISTIC
/begin CHARACTERISTIC DFES_DbLv.DFC_ComTrqDemCrshDrDyCtr_FX_C "DFES/Entprelllevel zur Erstellung eines DFES Eintrages für Prüfung DFC_ComTrqDemCrshDrDyCtr_FX" VALUE 0x800299D1 Val_Wu8 15.00 DFES_OneToOne 0.00 15.00 EXTENDED_LIMITS 0.00 255.0 /end CHARACTERISTIC
/begin CHARACTERISTIC DFES_DbLv.DFC_ComTrqDemCrshDrDyTo_FX_C "DFES/Entprelllevel zur Erstellung eines DFES Eintrages für Prüfung DFC_ComTrqDemCrshDrDyTo_FX" VALUE 0x800299D2 Val_Wu8 15.00 DFES_OneToOne 0.00 15.00 EXTENDED_LIMITS 0.00 255.0 /end CHARACTERISTIC
/begin CHARACTERISTIC DFES_DbLv.DFC_ComTrqDemandDesSig_C "DFES/Entprelllevel zur Erstellung eines DFES Eintrages für Prüfung DFC_ComTrqDemandDesSig" VALUE 0x800299D3 Val_Wu8 15.00 DFES_OneToOne 0.00 15.00 EXTENDED_LIMITS 0.00 255.0 /end CHARACTERISTIC
/begin CHARACTERISTIC DFES_DbLv.DFC_ComTrqDemandDesTo_C "DFES/Entprelllevel zur Erstellung eines DFES Eintrages für Prüfung DFC_ComTrqDemandDesTo" VALUE 0x800299D4 Val_Wu8 15.00 DFES_OneToOne 0.00 15.00 EXTENDED_LIMITS 0.00 255.0 /end CHARACTERISTIC
/begin CHARACTERISTIC DFES_DbLv.DFC_ComTrqDemandDscChk_C "DFES/Entprelllevel zur Erstellung eines DFES Eintrages für Prüfung DFC_ComTrqDemandDscChk" VALUE 0x800299D5 Val_Wu8 15.00 DFES_OneToOne 0.00 15.00 EXTENDED_LIMITS 0.00 255.0 /end CHARACTERISTIC
/begin CHARACTERISTIC DFES_DbLv.DFC_ComTrqDemandDscCtr_C "DFES/Entprelllevel zur Erstellung eines DFES Eintrages für Prüfung DFC_ComTrqDemandDscCtr" VALUE 0x800299D6 Val_Wu8 15.00 DFES_OneToOne 0.00 15.00 EXTENDED_LIMITS 0.00 255.0 /end CHARACTERISTIC
/begin CHARACTERISTIC DFES_DbLv.DFC_ComTrqDemandDscSig_C "DFES/Entprelllevel zur Erstellung eines DFES Eintrages für Prüfung DFC_ComTrqDemandDscSig" VALUE 0x800299D7 Val_Wu8 15.00 DFES_OneToOne 0.00 15.00 EXTENDED_LIMITS 0.00 255.0 /end CHARACTERISTIC
/begin CHARACTERISTIC DFES_DbLv.DFC_ComTrqDemandDscTo_C "DFES/Entprelllevel zur Erstellung eines DFES Eintrages für Prüfung DFC_ComTrqDemandDscTo" VALUE 0x800299D8 Val_Wu8 15.00 DFES_OneToOne 0.00 15.00 EXTENDED_LIMITS 0.00 255.0 /end CHARACTERISTIC
/begin CHARACTERISTIC DFES_DbLv.DFC_ComTrqDemandGbxChk_A_C "DFES/Entprelllevel zur Erstellung eines DFES Eintrages für Prüfung DFC_ComTrqDemandGbxChk_A" VALUE 0x800299D9 Val_Wu8 15.00 DFES_OneToOne 0.00 15.00 EXTENDED_LIMITS 0.00 255.0 /end CHARACTERISTIC
/begin CHARACTERISTIC DFES_DbLv.DFC_ComTrqDemandGbxChk_FA_C "DFES/Entprelllevel zur Erstellung eines DFES Eintrages für Prüfung DFC_ComTrqDemandGbxChk_FA" VALUE 0x800299DA Val_Wu8 15.00 DFES_OneToOne 0.00 15.00 EXTENDED_LIMITS 0.00 255.0 /end CHARACTERISTIC
/begin CHARACTERISTIC DFES_DbLv.DFC_ComTrqDemandGbxCtr_A_C "DFES/Entprelllevel zur Erstellung eines DFES Eintrages für Prüfung DFC_ComTrqDemandGbxCtr_A" VALUE 0x800299DB Val_Wu8 15.00 DFES_OneToOne 0.00 15.00 EXTENDED_LIMITS 0.00 255.0 /end CHARACTERISTIC
/begin CHARACTERISTIC DFES_DbLv.DFC_ComTrqDemandGbxCtr_FA_C "DFES/Entprelllevel zur Erstellung eines DFES Eintrages für Prüfung DFC_ComTrqDemandGbxCtr_FA" VALUE 0x800299DC Val_Wu8 15.00 DFES_OneToOne 0.00 15.00 EXTENDED_LIMITS 0.00 255.0 /end CHARACTERISTIC
/begin CHARACTERISTIC DFES_DbLv.DFC_ComTrqDemandGbxSig_A_C "DFES/Entprelllevel zur Erstellung eines DFES Eintrages für Prüfung DFC_ComTrqDemandGbxSig_A" VALUE 0x800299DD Val_Wu8 15.00 DFES_OneToOne 0.00 15.00 EXTENDED_LIMITS 0.00 255.0 /end CHARACTERISTIC
/begin CHARACTERISTIC DFES_DbLv.DFC_ComTrqDemandGbxSig_FA_C "DFES/Entprelllevel zur Erstellung eines DFES Eintrages für Prüfung DFC_ComTrqDemandGbxSig_FA" VALUE 0x800299DE Val_Wu8 15.00 DFES_OneToOne 0.00 15.00 EXTENDED_LIMITS 0.00 255.0 /end CHARACTERISTIC
/begin CHARACTERISTIC DFES_DbLv.DFC_ComTrqDemandGbxTo_A_C "DFES/Entprelllevel zur Erstellung eines DFES Eintrages für Prüfung DFC_ComTrqDemandGbxTo_A" VALUE 0x800299DF Val_Wu8 15.00 DFES_OneToOne 0.00 15.00 EXTENDED_LIMITS 0.00 255.0 /end CHARACTERISTIC
/begin CHARACTERISTIC DFES_DbLv.DFC_ComTrqDemandGbxTo_FA_C "DFES/Entprelllevel zur Erstellung eines DFES Eintrages für Prüfung DFC_ComTrqDemandGbxTo_FA" VALUE 0x800299E0 Val_Wu8 15.00 DFES_OneToOne 0.00 15.00 EXTENDED_LIMITS 0.00 255.0 /end CHARACTERISTIC
/begin CHARACTERISTIC DFES_DbLv.DFC_ComTrqWhlDemChk_C "DFES/Entprelllevel zur Erstellung eines DFES Eintrages für Prüfung DFC_ComTrqWhlDemChk" VALUE 0x800299E1 Val_Wu8 15.00 DFES_OneToOne 0.00 15.00 EXTENDED_LIMITS 0.00 255.0 /end CHARACTERISTIC
/begin CHARACTERISTIC DFES_DbLv.DFC_ComTrqWhlDemCtr_C "DFES/Entprelllevel zur Erstellung eines DFES Eintrages für Prüfung DFC_ComTrqWhlDemCtr" VALUE 0x800299E2 Val_Wu8 15.00 DFES_OneToOne 0.00 15.00 EXTENDED_LIMITS 0.00 255.0 /end CHARACTERISTIC
/begin CHARACTERISTIC DFES_DbLv.DFC_ComTrqWhlDemFASChk_FX_C "DFES/Entprelllevel zur Erstellung eines DFES Eintrages für Prüfung DFC_ComTrqWhlDemFASChk_FX" VALUE 0x800299E3 Val_Wu8 15.00 DFES_OneToOne 0.00 15.00 EXTENDED_LIMITS 0.00 255.0 /end CHARACTERISTIC
/begin CHARACTERISTIC DFES_DbLv.DFC_ComTrqWhlDemFASCtr_FX_C "DFES/Entprelllevel zur Erstellung eines DFES Eintrages für Prüfung DFC_ComTrqWhlDemFASCtr_FX" VALUE 0x800299E4 Val_Wu8 15.00 DFES_OneToOne 0.00 15.00 EXTENDED_LIMITS 0.00 255.0 /end CHARACTERISTIC
/begin CHARACTERISTIC DFES_DbLv.DFC_ComTrqWhlDemFASTo_FX_C "DFES/Entprelllevel zur Erstellung eines DFES Eintrages für Prüfung DFC_ComTrqWhlDemFASTo_FX" VALUE 0x800299E5 Val_Wu8 15.00 DFES_OneToOne 0.00 15.00 EXTENDED_LIMITS 0.00 255.0 /end CHARACTERISTIC
/begin CHARACTERISTIC DFES_DbLv.DFC_ComTrqWhlDemSig_C "DFES/Entprelllevel zur Erstellung eines DFES Eintrages für Prüfung DFC_ComTrqWhlDemSig" VALUE 0x800299E6 Val_Wu8 15.00 DFES_OneToOne 0.00 15.00 EXTENDED_LIMITS 0.00 255.0 /end CHARACTERISTIC
/begin CHARACTERISTIC DFES_DbLv.DFC_ComTrqWhlDemTo_C "DFES/Entprelllevel zur Erstellung eines DFES Eintrages für Prüfung DFC_ComTrqWhlDemTo" VALUE 0x800299E7 Val_Wu8 15.00 DFES_OneToOne 0.00 15.00 EXTENDED_LIMITS 0.00 255.0 /end CHARACTERISTIC
/begin CHARACTERISTIC DFES_DbLv.DFC_ComVelocityChk_FA_C "DFES/Entprelllevel zur Erstellung eines DFES Eintrages für Prüfung DFC_ComVelocityChk_FA" VALUE 0x800299E8 Val_Wu8 15.00 DFES_OneToOne 0.00 15.00 EXTENDED_LIMITS 0.00 255.0 /end CHARACTERISTIC
/begin CHARACTERISTIC DFES_DbLv.DFC_ComVelocityCtr_FA_C "DFES/Entprelllevel zur Erstellung eines DFES Eintrages für Prüfung DFC_ComVelocityCtr_FA" VALUE 0x800299E9 Val_Wu8 15.00 DFES_OneToOne 0.00 15.00 EXTENDED_LIMITS 0.00 255.0 /end CHARACTERISTIC
/begin CHARACTERISTIC DFES_DbLv.DFC_ComVelocitySig_C "DFES/Entprelllevel zur Erstellung eines DFES Eintrages für Prüfung DFC_ComVelocitySig" VALUE 0x800299EA Val_Wu8 15.00 DFES_OneToOne 0.00 15.00 EXTENDED_LIMITS 0.00 255.0 /end CHARACTERISTIC
/begin CHARACTERISTIC DFES_DbLv.DFC_ComVelocitySig_FA_C "DFES/Entprelllevel zur Erstellung eines DFES Eintrages für Prüfung DFC_ComVelocitySig_FA" VALUE 0x800299EB Val_Wu8 15.00 DFES_OneToOne 0.00 15.00 EXTENDED_LIMITS 0.00 255.0 /end CHARACTERISTIC
/begin CHARACTERISTIC DFES_DbLv.DFC_ComVelocityTo_C "DFES/Entprelllevel zur Erstellung eines DFES Eintrages für Prüfung DFC_ComVelocityTo" VALUE 0x800299EC Val_Wu8 15.00 DFES_OneToOne 0.00 15.00 EXTENDED_LIMITS 0.00 255.0 /end CHARACTERISTIC
/begin CHARACTERISTIC DFES_DbLv.DFC_ComVelocityTo_FA_C "DFES/Entprelllevel zur Erstellung eines DFES Eintrages für Prüfung DFC_ComVelocityTo_FA" VALUE 0x800299ED Val_Wu8 15.00 DFES_OneToOne 0.00 15.00 EXTENDED_LIMITS 0.00 255.0 /end CHARACTERISTIC
/begin CHARACTERISTIC DFES_DbLv.DFC_ComVerbraucherTo_C "DFES/Entprelllevel zur Erstellung eines DFES Eintrages für Prüfung DFC_ComVerbraucherTo" VALUE 0x800299EE Val_Wu8 15.00 DFES_OneToOne 0.00 15.00 EXTENDED_LIMITS 0.00 255.0 /end CHARACTERISTIC
/begin CHARACTERISTIC DFES_DbLv.DFC_ComWMomPTStabChk_FX_C "DFES/Entprelllevel zur Erstellung eines DFES Eintrages für Prüfung DFC_ComWMomPTStabChk_FX" VALUE 0x800299EF Val_Wu8 15.00 DFES_OneToOne 0.00 15.00 EXTENDED_LIMITS 0.00 255.0 /end CHARACTERISTIC
/begin CHARACTERISTIC DFES_DbLv.DFC_ComWMomPTStabCtr_FX_C "DFES/Entprelllevel zur Erstellung eines DFES Eintrages für Prüfung DFC_ComWMomPTStabCtr_FX" VALUE 0x800299F0 Val_Wu8 15.00 DFES_OneToOne 0.00 15.00 EXTENDED_LIMITS 0.00 255.0 /end CHARACTERISTIC
/begin CHARACTERISTIC DFES_DbLv.DFC_ComWMomPTStabTo_FX_C "DFES/Entprelllevel zur Erstellung eines DFES Eintrages für Prüfung DFC_ComWMomPTStabTo_FX" VALUE 0x800299F1 Val_Wu8 15.00 DFES_OneToOne 0.00 15.00 EXTENDED_LIMITS 0.00 255.0 /end CHARACTERISTIC
/begin CHARACTERISTIC DFES_DbLv.DFC_ComWheelSpeedSig_C "DFES/Entprelllevel zur Erstellung eines DFES Eintrages für Prüfung DFC_ComWheelSpeedSig" VALUE 0x800299F2 Val_Wu8 15.00 DFES_OneToOne 0.00 15.00 EXTENDED_LIMITS 0.00 255.0 /end CHARACTERISTIC
/begin CHARACTERISTIC DFES_DbLv.DFC_ComWheelSpeedTo_C "DFES/Entprelllevel zur Erstellung eines DFES Eintrages für Prüfung DFC_ComWheelSpeedTo" VALUE 0x800299F3 Val_Wu8 15.00 DFES_OneToOne 0.00 15.00 EXTENDED_LIMITS 0.00 255.0 /end CHARACTERISTIC
/begin CHARACTERISTIC DFES_DbLv.DFC_ComZvKlappenSig_C "DFES/Entprelllevel zur Erstellung eines DFES Eintrages für Prüfung DFC_ComZvKlappenSig" VALUE 0x800299F4 Val_Wu8 15.00 DFES_OneToOne 0.00 15.00 EXTENDED_LIMITS 0.00 255.0 /end CHARACTERISTIC
/begin CHARACTERISTIC DFES_DbLv.DFC_ComZvKlappenTo_C "DFES/Entprelllevel zur Erstellung eines DFES Eintrages für Prüfung DFC_ComZvKlappenTo" VALUE 0x800299F5 Val_Wu8 15.00 DFES_OneToOne 0.00 15.00 EXTENDED_LIMITS 0.00 255.0 /end CHARACTERISTIC
/begin CHARACTERISTIC DFES_DbLv.DFC_ComaDirectChk_FX_C "DFES/Entprelllevel zur Erstellung eines DFES Eintrages für Prüfung DFC_ComaDirectChk_FX" VALUE 0x800299F6 Val_Wu8 15.00 DFES_OneToOne 0.00 15.00 EXTENDED_LIMITS 0.00 255.0 /end CHARACTERISTIC
/begin CHARACTERISTIC DFES_DbLv.DFC_ComaDirectCtr_FX_C "DFES/Entprelllevel zur Erstellung eines DFES Eintrages für Prüfung DFC_ComaDirectCtr_FX" VALUE 0x800299F7 Val_Wu8 15.00 DFES_OneToOne 0.00 15.00 EXTENDED_LIMITS 0.00 255.0 /end CHARACTERISTIC
/begin CHARACTERISTIC DFES_DbLv.DFC_ComaDirectTo_FX_C "DFES/Entprelllevel zur Erstellung eines DFES Eintrages für Prüfung DFC_ComaDirectTo_FX" VALUE 0x800299F8 Val_Wu8 15.00 DFES_OneToOne 0.00 15.00 EXTENDED_LIMITS 0.00 255.0 /end CHARACTERISTIC
/begin CHARACTERISTIC DFES_DbLv.DFC_ComaSideChk_FX_C "DFES/Entprelllevel zur Erstellung eines DFES Eintrages für Prüfung DFC_ComaSideChk_FX" VALUE 0x800299F9 Val_Wu8 15.00 DFES_OneToOne 0.00 15.00 EXTENDED_LIMITS 0.00 255.0 /end CHARACTERISTIC
/begin CHARACTERISTIC DFES_DbLv.DFC_ComaSideCtr_FX_C "DFES/Entprelllevel zur Erstellung eines DFES Eintrages für Prüfung DFC_ComaSideCtr_FX" VALUE 0x800299FA Val_Wu8 15.00 DFES_OneToOne 0.00 15.00 EXTENDED_LIMITS 0.00 255.0 /end CHARACTERISTIC
/begin CHARACTERISTIC DFES_DbLv.DFC_ComaSideTo_FX_C "DFES/Entprelllevel zur Erstellung eines DFES Eintrages für Prüfung DFC_ComaSideTo_FX" VALUE 0x800299FB Val_Wu8 15.00 DFES_OneToOne 0.00 15.00 EXTENDED_LIMITS 0.00 255.0 /end CHARACTERISTIC
/begin CHARACTERISTIC DFES_DbLv.DFC_Cy320SpiCom_C "DFES/Entprelllevel zur Erstellung eines DFES Eintrages für Prüfung DFC_Cy320SpiCom" VALUE 0x800299FC Val_Wu8 15.00 DFES_OneToOne 0.00 15.00 EXTENDED_LIMITS 0.00 255.0 /end CHARACTERISTIC
/begin CHARACTERISTIC DFES_DbLv.DFC_ETCtlDvtInrMax_C "DFES/Entprelllevel zur Erstellung eines DFES Eintrages für Prüfung DFC_ETCtlDvtInrMax" VALUE 0x800299FD Val_Wu8 15.00 DFES_OneToOne 0.00 15.00 EXTENDED_LIMITS 0.00 255.0 /end CHARACTERISTIC
/begin CHARACTERISTIC DFES_DbLv.DFC_ETCtlDvtInrMin_C "DFES/Entprelllevel zur Erstellung eines DFES Eintrages für Prüfung DFC_ETCtlDvtInrMin" VALUE 0x800299FE Val_Wu8 15.00 DFES_OneToOne 0.00 15.00 EXTENDED_LIMITS 0.00 255.0 /end CHARACTERISTIC
/begin CHARACTERISTIC DFES_DbLv.DFC_ETCtlDvtOutrMax_C "DFES/Entprelllevel zur Erstellung eines DFES Eintrages für Prüfung DFC_ETCtlDvtOutrMax" VALUE 0x800299FF Val_Wu8 15.00 DFES_OneToOne 0.00 15.00 EXTENDED_LIMITS 0.00 255.0 /end CHARACTERISTIC
/begin CHARACTERISTIC DFES_DbLv.DFC_ETCtlDvtOutrMin_C "DFES/Entprelllevel zur Erstellung eines DFES Eintrages für Prüfung DFC_ETCtlDvtOutrMin" VALUE 0x80029A00 Val_Wu8 15.00 DFES_OneToOne 0.00 15.00 EXTENDED_LIMITS 0.00 255.0 /end CHARACTERISTIC
/begin CHARACTERISTIC DFES_DbLv.DFC_FBCqDvtMax_C "DFES/Entprelllevel zur Erstellung eines DFES Eintrages für Prüfung DFC_FBCqDvtMax" VALUE 0x80029A01 Val_Wu8 15.00 DFES_OneToOne 0.00 15.00 EXTENDED_LIMITS 0.00 255.0 /end CHARACTERISTIC
/begin CHARACTERISTIC DFES_DbLv.DFC_FBCqDvtMin_C "DFES/Entprelllevel zur Erstellung eines DFES Eintrages für Prüfung DFC_FBCqDvtMin" VALUE 0x80029A02 Val_Wu8 15.00 DFES_OneToOne 0.00 15.00 EXTENDED_LIMITS 0.00 255.0 /end CHARACTERISTIC
/begin CHARACTERISTIC DFES_DbLv.DFC_Fan4WinErr1_C "DFES/Entprelllevel zur Erstellung eines DFES Eintrages für Prüfung DFC_Fan4WinErr1" VALUE 0x80029A03 Val_Wu8 15.00 DFES_OneToOne 0.00 15.00 EXTENDED_LIMITS 0.00 255.0 /end CHARACTERISTIC
/begin CHARACTERISTIC DFES_DbLv.DFC_Fan4WinErr2_C "DFES/Entprelllevel zur Erstellung eines DFES Eintrages für Prüfung DFC_Fan4WinErr2" VALUE 0x80029A04 Val_Wu8 15.00 DFES_OneToOne 0.00 15.00 EXTENDED_LIMITS 0.00 255.0 /end CHARACTERISTIC
/begin CHARACTERISTIC DFES_DbLv.DFC_Fan4WinErr3_C "DFES/Entprelllevel zur Erstellung eines DFES Eintrages für Prüfung DFC_Fan4WinErr3" VALUE 0x80029A05 Val_Wu8 15.00 DFES_OneToOne 0.00 15.00 EXTENDED_LIMITS 0.00 255.0 /end CHARACTERISTIC
/begin CHARACTERISTIC DFES_DbLv.DFC_Fan4WinErr4_C "DFES/Entprelllevel zur Erstellung eines DFES Eintrages für Prüfung DFC_Fan4WinErr4" VALUE 0x80029A06 Val_Wu8 15.00 DFES_OneToOne 0.00 15.00 EXTENDED_LIMITS 0.00 255.0 /end CHARACTERISTIC
/begin CHARACTERISTIC DFES_DbLv.DFC_FanSCG_C "DFES/Entprelllevel zur Erstellung eines DFES Eintrages für Prüfung DFC_FanSCG" VALUE 0x80029A07 Val_Wu8 15.00 DFES_OneToOne 0.00 15.00 EXTENDED_LIMITS 0.00 255.0 /end CHARACTERISTIC
/begin CHARACTERISTIC DFES_DbLv.DFC_FlFCBS_C "DFES/Entprelllevel zur Erstellung eines DFES Eintrages für Prüfung DFC_FlFCBS" VALUE 0x80029A08 Val_Wu8 15.00 DFES_OneToOne 0.00 15.00 EXTENDED_LIMITS 0.00 255.0 /end CHARACTERISTIC
/begin CHARACTERISTIC DFES_DbLv.DFC_GlwEcuConfigErr_C "DFES/Entprelllevel zur Erstellung eines DFES Eintrages für Prüfung DFC_GlwEcuConfigErr" VALUE 0x80029A09 Val_Wu8 15.00 DFES_OneToOne 0.00 15.00 EXTENDED_LIMITS 0.00 255.0 /end CHARACTERISTIC
/begin CHARACTERISTIC DFES_DbLv.DFC_GlwEcuEepErr_C "DFES/Entprelllevel zur Erstellung eines DFES Eintrages für Prüfung DFC_GlwEcuEepErr" VALUE 0x80029A0A Val_Wu8 15.00 DFES_OneToOne 0.00 15.00 EXTENDED_LIMITS 0.00 255.0 /end CHARACTERISTIC
/begin CHARACTERISTIC DFES_DbLv.DFC_GlwEcuFrmErr_C "DFES/Entprelllevel zur Erstellung eines DFES Eintrages für Prüfung DFC_GlwEcuFrmErr" VALUE 0x80029A0B Val_Wu8 15.00 DFES_OneToOne 0.00 15.00 EXTENDED_LIMITS 0.00 255.0 /end CHARACTERISTIC
/begin CHARACTERISTIC DFES_DbLv.DFC_GlwEcuGPCMFaultInfo_C "DFES/Entprelllevel zur Erstellung eines DFES Eintrages für Prüfung DFC_GlwEcuGPCMFaultInfo" VALUE 0x80029A0C Val_Wu8 15.00 DFES_OneToOne 0.00 15.00 EXTENDED_LIMITS 0.00 255.0 /end CHARACTERISTIC
/begin CHARACTERISTIC DFES_DbLv.DFC_GlwEcuGPCMInfo_C "DFES/Entprelllevel zur Erstellung eines DFES Eintrages für Prüfung DFC_GlwEcuGPCMInfo" VALUE 0x80029A0D Val_Wu8 15.00 DFES_OneToOne 0.00 15.00 EXTENDED_LIMITS 0.00 255.0 /end CHARACTERISTIC
/begin CHARACTERISTIC DFES_DbLv.DFC_GlwEcuGk1HSS_C "DFES/Entprelllevel zur Erstellung eines DFES Eintrages für Prüfung DFC_GlwEcuGk1HSS" VALUE 0x80029A0E Val_Wu8 15.00 DFES_OneToOne 0.00 15.00 EXTENDED_LIMITS 0.00 255.0 /end CHARACTERISTIC
/begin CHARACTERISTIC DFES_DbLv.DFC_GlwEcuGk1OL_C "DFES/Entprelllevel zur Erstellung eines DFES Eintrages für Prüfung DFC_GlwEcuGk1OL" VALUE 0x80029A0F Val_Wu8 15.00 DFES_OneToOne 0.00 15.00 EXTENDED_LIMITS 0.00 255.0 /end CHARACTERISTIC
/begin CHARACTERISTIC DFES_DbLv.DFC_GlwEcuGk1SC_C "DFES/Entprelllevel zur Erstellung eines DFES Eintrages für Prüfung DFC_GlwEcuGk1SC" VALUE 0x80029A10 Val_Wu8 15.00 DFES_OneToOne 0.00 15.00 EXTENDED_LIMITS 0.00 255.0 /end CHARACTERISTIC
/begin CHARACTERISTIC DFES_DbLv.DFC_GlwEcuGk1Wdst_C "DFES/Entprelllevel zur Erstellung eines DFES Eintrages für Prüfung DFC_GlwEcuGk1Wdst" VALUE 0x80029A11 Val_Wu8 15.00 DFES_OneToOne 0.00 15.00 EXTENDED_LIMITS 0.00 255.0 /end CHARACTERISTIC
/begin CHARACTERISTIC DFES_DbLv.DFC_GlwEcuGk2HSS_C "DFES/Entprelllevel zur Erstellung eines DFES Eintrages für Prüfung DFC_GlwEcuGk2HSS" VALUE 0x80029A12 Val_Wu8 15.00 DFES_OneToOne 0.00 15.00 EXTENDED_LIMITS 0.00 255.0 /end CHARACTERISTIC
/begin CHARACTERISTIC DFES_DbLv.DFC_GlwEcuGk2OL_C "DFES/Entprelllevel zur Erstellung eines DFES Eintrages für Prüfung DFC_GlwEcuGk2OL" VALUE 0x80029A13 Val_Wu8 15.00 DFES_OneToOne 0.00 15.00 EXTENDED_LIMITS 0.00 255.0 /end CHARACTERISTIC
/begin CHARACTERISTIC DFES_DbLv.DFC_GlwEcuGk2SC_C "DFES/Entprelllevel zur Erstellung eines DFES Eintrages für Prüfung DFC_GlwEcuGk2SC" VALUE 0x80029A14 Val_Wu8 15.00 DFES_OneToOne 0.00 15.00 EXTENDED_LIMITS 0.00 255.0 /end CHARACTERISTIC
/begin CHARACTERISTIC DFES_DbLv.DFC_GlwEcuGk2Wdst_C "DFES/Entprelllevel zur Erstellung eines DFES Eintrages für Prüfung DFC_GlwEcuGk2Wdst" VALUE 0x80029A15 Val_Wu8 15.00 DFES_OneToOne 0.00 15.00 EXTENDED_LIMITS 0.00 255.0 /end CHARACTERISTIC
/begin CHARACTERISTIC DFES_DbLv.DFC_GlwEcuGk3HSS_C "DFES/Entprelllevel zur Erstellung eines DFES Eintrages für Prüfung DFC_GlwEcuGk3HSS" VALUE 0x80029A16 Val_Wu8 15.00 DFES_OneToOne 0.00 15.00 EXTENDED_LIMITS 0.00 255.0 /end CHARACTERISTIC
/begin CHARACTERISTIC DFES_DbLv.DFC_GlwEcuGk3OL_C "DFES/Entprelllevel zur Erstellung eines DFES Eintrages für Prüfung DFC_GlwEcuGk3OL" VALUE 0x80029A17 Val_Wu8 15.00 DFES_OneToOne 0.00 15.00 EXTENDED_LIMITS 0.00 255.0 /end CHARACTERISTIC
/begin CHARACTERISTIC DFES_DbLv.DFC_GlwEcuGk3SC_C "DFES/Entprelllevel zur Erstellung eines DFES Eintrages für Prüfung DFC_GlwEcuGk3SC" VALUE 0x80029A18 Val_Wu8 15.00 DFES_OneToOne 0.00 15.00 EXTENDED_LIMITS 0.00 255.0 /end CHARACTERISTIC
/begin CHARACTERISTIC DFES_DbLv.DFC_GlwEcuGk3Wdst_C "DFES/Entprelllevel zur Erstellung eines DFES Eintrages für Prüfung DFC_GlwEcuGk3Wdst" VALUE 0x80029A19 Val_Wu8 15.00 DFES_OneToOne 0.00 15.00 EXTENDED_LIMITS 0.00 255.0 /end CHARACTERISTIC
/begin CHARACTERISTIC DFES_DbLv.DFC_GlwEcuGk4HSS_C "DFES/Entprelllevel zur Erstellung eines DFES Eintrages für Prüfung DFC_GlwEcuGk4HSS" VALUE 0x80029A1A Val_Wu8 15.00 DFES_OneToOne 0.00 15.00 EXTENDED_LIMITS 0.00 255.0 /end CHARACTERISTIC
/begin CHARACTERISTIC DFES_DbLv.DFC_GlwEcuGk4OL_C "DFES/Entprelllevel zur Erstellung eines DFES Eintrages für Prüfung DFC_GlwEcuGk4OL" VALUE 0x80029A1B Val_Wu8 15.00 DFES_OneToOne 0.00 15.00 EXTENDED_LIMITS 0.00 255.0 /end CHARACTERISTIC
/begin CHARACTERISTIC DFES_DbLv.DFC_GlwEcuGk4SC_C "DFES/Entprelllevel zur Erstellung eines DFES Eintrages für Prüfung DFC_GlwEcuGk4SC" VALUE 0x80029A1C Val_Wu8 15.00 DFES_OneToOne 0.00 15.00 EXTENDED_LIMITS 0.00 255.0 /end CHARACTERISTIC
/begin CHARACTERISTIC DFES_DbLv.DFC_GlwEcuGk4Wdst_C "DFES/Entprelllevel zur Erstellung eines DFES Eintrages für Prüfung DFC_GlwEcuGk4Wdst" VALUE 0x80029A1D Val_Wu8 15.00 DFES_OneToOne 0.00 15.00 EXTENDED_LIMITS 0.00 255.0 /end CHARACTERISTIC
/begin CHARACTERISTIC DFES_DbLv.DFC_GlwEcuGk5HSS_C "DFES/Entprelllevel zur Erstellung eines DFES Eintrages für Prüfung DFC_GlwEcuGk5HSS" VALUE 0x80029A1E Val_Wu8 15.00 DFES_OneToOne 0.00 15.00 EXTENDED_LIMITS 0.00 255.0 /end CHARACTERISTIC
/begin CHARACTERISTIC DFES_DbLv.DFC_GlwEcuGk5OL_C "DFES/Entprelllevel zur Erstellung eines DFES Eintrages für Prüfung DFC_GlwEcuGk5OL" VALUE 0x80029A1F Val_Wu8 15.00 DFES_OneToOne 0.00 15.00 EXTENDED_LIMITS 0.00 255.0 /end CHARACTERISTIC
/begin CHARACTERISTIC DFES_DbLv.DFC_GlwEcuGk5SC_C "DFES/Entprelllevel zur Erstellung eines DFES Eintrages für Prüfung DFC_GlwEcuGk5SC" VALUE 0x80029A20 Val_Wu8 15.00 DFES_OneToOne 0.00 15.00 EXTENDED_LIMITS 0.00 255.0 /end CHARACTERISTIC
/begin CHARACTERISTIC DFES_DbLv.DFC_GlwEcuGk5Wdst_C "DFES/Entprelllevel zur Erstellung eines DFES Eintrages für Prüfung DFC_GlwEcuGk5Wdst" VALUE 0x80029A21 Val_Wu8 15.00 DFES_OneToOne 0.00 15.00 EXTENDED_LIMITS 0.00 255.0 /end CHARACTERISTIC
/begin CHARACTERISTIC DFES_DbLv.DFC_GlwEcuGk6HSS_C "DFES/Entprelllevel zur Erstellung eines DFES Eintrages für Prüfung DFC_GlwEcuGk6HSS" VALUE 0x80029A22 Val_Wu8 15.00 DFES_OneToOne 0.00 15.00 EXTENDED_LIMITS 0.00 255.0 /end CHARACTERISTIC
/begin CHARACTERISTIC DFES_DbLv.DFC_GlwEcuGk6OL_C "DFES/Entprelllevel zur Erstellung eines DFES Eintrages für Prüfung DFC_GlwEcuGk6OL" VALUE 0x80029A23 Val_Wu8 15.00 DFES_OneToOne 0.00 15.00 EXTENDED_LIMITS 0.00 255.0 /end CHARACTERISTIC
/begin CHARACTERISTIC DFES_DbLv.DFC_GlwEcuGk6SC_C "DFES/Entprelllevel zur Erstellung eines DFES Eintrages für Prüfung DFC_GlwEcuGk6SC" VALUE 0x80029A24 Val_Wu8 15.00 DFES_OneToOne 0.00 15.00 EXTENDED_LIMITS 0.00 255.0 /end CHARACTERISTIC
/begin CHARACTERISTIC DFES_DbLv.DFC_GlwEcuGk6Wdst_C "DFES/Entprelllevel zur Erstellung eines DFES Eintrages für Prüfung DFC_GlwEcuGk6Wdst" VALUE 0x80029A25 Val_Wu8 15.00 DFES_OneToOne 0.00 15.00 EXTENDED_LIMITS 0.00 255.0 /end CHARACTERISTIC
/begin CHARACTERISTIC DFES_DbLv.DFC_GlwEcuGndErr_C "DFES/Entprelllevel zur Erstellung eines DFES Eintrages für Prüfung DFC_GlwEcuGndErr" VALUE 0x80029A26 Val_Wu8 15.00 DFES_OneToOne 0.00 15.00 EXTENDED_LIMITS 0.00 255.0 /end CHARACTERISTIC
/begin CHARACTERISTIC DFES_DbLv.DFC_GlwEcuIntErr_C "DFES/Entprelllevel zur Erstellung eines DFES Eintrages für Prüfung DFC_GlwEcuIntErr" VALUE 0x80029A27 Val_Wu8 15.00 DFES_OneToOne 0.00 15.00 EXTENDED_LIMITS 0.00 255.0 /end CHARACTERISTIC
/begin CHARACTERISTIC DFES_DbLv.DFC_GlwEcuMsgTimeout_C "DFES/Entprelllevel zur Erstellung eines DFES Eintrages für Prüfung DFC_GlwEcuMsgTimeout" VALUE 0x80029A28 Val_Wu8 15.00 DFES_OneToOne 0.00 15.00 EXTENDED_LIMITS 0.00 255.0 /end CHARACTERISTIC
/begin CHARACTERISTIC DFES_DbLv.DFC_GlwEcuT30Err_C "DFES/Entprelllevel zur Erstellung eines DFES Eintrages für Prüfung DFC_GlwEcuT30Err" VALUE 0x80029A29 Val_Wu8 15.00 DFES_OneToOne 0.00 15.00 EXTENDED_LIMITS 0.00 255.0 /end CHARACTERISTIC
/begin CHARACTERISTIC DFES_DbLv.DFC_GlwEcuTempErr_C "DFES/Entprelllevel zur Erstellung eines DFES Eintrages für Prüfung DFC_GlwEcuTempErr" VALUE 0x80029A2A Val_Wu8 15.00 DFES_OneToOne 0.00 15.00 EXTENDED_LIMITS 0.00 255.0 /end CHARACTERISTIC
/begin CHARACTERISTIC DFES_DbLv.DFC_GlwEcuUdiffT30_C "DFES/Entprelllevel zur Erstellung eines DFES Eintrages für Prüfung DFC_GlwEcuUdiffT30" VALUE 0x80029A2B Val_Wu8 15.00 DFES_OneToOne 0.00 15.00 EXTENDED_LIMITS 0.00 255.0 /end CHARACTERISTIC
/begin CHARACTERISTIC DFES_DbLv.DFC_IBSComErr_C "DFES/Entprelllevel zur Erstellung eines DFES Eintrages für Prüfung DFC_IBSComErr" VALUE 0x80029A2C Val_Wu8 15.00 DFES_OneToOne 0.00 15.00 EXTENDED_LIMITS 0.00 255.0 /end CHARACTERISTIC
/begin CHARACTERISTIC DFES_DbLv.DFC_LubSRCOilFldtCrit_C "DFES/Entprelllevel zur Erstellung eines DFES Eintrages für Prüfung DFC_LubSRCOilFldtCrit" VALUE 0x80029A2D Val_Wu8 15.00 DFES_OneToOne 0.00 15.00 EXTENDED_LIMITS 0.00 255.0 /end CHARACTERISTIC
/begin CHARACTERISTIC DFES_DbLv.DFC_LubSRCOilFldtCritDflMin_C "DFES/Entprelllevel zur Erstellung eines DFES Eintrages für Prüfung DFC_LubSRCOilFldtCritDflMin" VALUE 0x80029A2E Val_Wu8 15.00 DFES_OneToOne 0.00 15.00 EXTENDED_LIMITS 0.00 255.0 /end CHARACTERISTIC
/begin CHARACTERISTIC DFES_DbLv.DFC_LubSRCOilLvlCritMax_C "DFES/Entprelllevel zur Erstellung eines DFES Eintrages für Prüfung DFC_LubSRCOilLvlCritMax" VALUE 0x80029A2F Val_Wu8 15.00 DFES_OneToOne 0.00 15.00 EXTENDED_LIMITS 0.00 255.0 /end CHARACTERISTIC
/begin CHARACTERISTIC DFES_DbLv.DFC_LubSRCOilLvlCritMin_C "DFES/Entprelllevel zur Erstellung eines DFES Eintrages für Prüfung DFC_LubSRCOilLvlCritMin" VALUE 0x80029A30 Val_Wu8 15.00 DFES_OneToOne 0.00 15.00 EXTENDED_LIMITS 0.00 255.0 /end CHARACTERISTIC
/begin CHARACTERISTIC DFES_DbLv.DFC_LubSRCTot_C "DFES/Entprelllevel zur Erstellung eines DFES Eintrages für Prüfung DFC_LubSRCTot" VALUE 0x80029A31 Val_Wu8 15.00 DFES_OneToOne 0.00 15.00 EXTENDED_LIMITS 0.00 255.0 /end CHARACTERISTIC
/begin CHARACTERISTIC DFES_DbLv.DFC_MonUMaxSupply1_C "DFES/Entprelllevel zur Erstellung eines DFES Eintrages für Prüfung DFC_MonUMaxSupply1" VALUE 0x80029A32 Val_Wu8 15.00 DFES_OneToOne 0.00 15.00 EXTENDED_LIMITS 0.00 255.0 /end CHARACTERISTIC
/begin CHARACTERISTIC DFES_DbLv.DFC_MonUMinSupply1_C "DFES/Entprelllevel zur Erstellung eines DFES Eintrages für Prüfung DFC_MonUMinSupply1" VALUE 0x80029A33 Val_Wu8 15.00 DFES_OneToOne 0.00 15.00 EXTENDED_LIMITS 0.00 255.0 /end CHARACTERISTIC
/begin CHARACTERISTIC DFES_DbLv.DFC_OilComNpl_C "DFES/Entprelllevel zur Erstellung eines DFES Eintrages für Prüfung DFC_OilComNpl" VALUE 0x80029A34 Val_Wu8 15.00 DFES_OneToOne 0.00 15.00 EXTENDED_LIMITS 0.00 255.0 /end CHARACTERISTIC
/begin CHARACTERISTIC DFES_DbLv.DFC_PCBS_C "DFES/Entprelllevel zur Erstellung eines DFES Eintrages für Prüfung DFC_PCBS" VALUE 0x80029A35 Val_Wu8 15.00 DFES_OneToOne 0.00 15.00 EXTENDED_LIMITS 0.00 255.0 /end CHARACTERISTIC
/begin CHARACTERISTIC DFES_DbLv.DFC_PCBSPFltChg_C "DFES/Entprelllevel zur Erstellung eines DFES Eintrages für Prüfung DFC_PCBSPFltChg" VALUE 0x80029A36 Val_Wu8 15.00 DFES_OneToOne 0.00 15.00 EXTENDED_LIMITS 0.00 255.0 /end CHARACTERISTIC
/begin CHARACTERISTIC DFES_DbLv.DFC_PCRGovDvtLPMax_C "DFES/Entprelllevel zur Erstellung eines DFES Eintrages für Prüfung DFC_PCRGovDvtLPMax" VALUE 0x80029A37 Val_Wu8 15.00 DFES_OneToOne 0.00 15.00 EXTENDED_LIMITS 0.00 255.0 /end CHARACTERISTIC
/begin CHARACTERISTIC DFES_DbLv.DFC_PCRGovDvtLPMin_C "DFES/Entprelllevel zur Erstellung eines DFES Eintrages für Prüfung DFC_PCRGovDvtLPMin" VALUE 0x80029A38 Val_Wu8 15.00 DFES_OneToOne 0.00 15.00 EXTENDED_LIMITS 0.00 255.0 /end CHARACTERISTIC
/begin CHARACTERISTIC DFES_DbLv.DFC_PCRGovDvtMax_C "DFES/Entprelllevel zur Erstellung eines DFES Eintrages für Prüfung DFC_PCRGovDvtMax" VALUE 0x80029A39 Val_Wu8 15.00 DFES_OneToOne 0.00 15.00 EXTENDED_LIMITS 0.00 255.0 /end CHARACTERISTIC
/begin CHARACTERISTIC DFES_DbLv.DFC_PCRGovDvtMin_C "DFES/Entprelllevel zur Erstellung eines DFES Eintrages für Prüfung DFC_PCRGovDvtMin" VALUE 0x80029A3A Val_Wu8 15.00 DFES_OneToOne 0.00 15.00 EXTENDED_LIMITS 0.00 255.0 /end CHARACTERISTIC
/begin CHARACTERISTIC DFES_DbLv.DFC_PFltAPSPlausMAX_C "DFES/Entprelllevel zur Erstellung eines DFES Eintrages für Prüfung DFC_PFltAPSPlausMAX" VALUE 0x80029A3B Val_Wu8 15.00 DFES_OneToOne 0.00 15.00 EXTENDED_LIMITS 0.00 255.0 /end CHARACTERISTIC
/begin CHARACTERISTIC DFES_DbLv.DFC_PFltAPSPlausMIN_C "DFES/Entprelllevel zur Erstellung eines DFES Eintrages für Prüfung DFC_PFltAPSPlausMIN" VALUE 0x80029A3C Val_Wu8 15.00 DFES_OneToOne 0.00 15.00 EXTENDED_LIMITS 0.00 255.0 /end CHARACTERISTIC
/begin CHARACTERISTIC DFES_DbLv.DFC_PFltBPSPlausMAX_C "DFES/Entprelllevel zur Erstellung eines DFES Eintrages für Prüfung DFC_PFltBPSPlausMAX" VALUE 0x80029A3D Val_Wu8 15.00 DFES_OneToOne 0.00 15.00 EXTENDED_LIMITS 0.00 255.0 /end CHARACTERISTIC
/begin CHARACTERISTIC DFES_DbLv.DFC_PFltBPSPlausMIN_C "DFES/Entprelllevel zur Erstellung eines DFES Eintrages für Prüfung DFC_PFltBPSPlausMIN" VALUE 0x80029A3E Val_Wu8 15.00 DFES_OneToOne 0.00 15.00 EXTENDED_LIMITS 0.00 255.0 /end CHARACTERISTIC
/begin CHARACTERISTIC DFES_DbLv.DFC_PFltOvldInhRgn_C "DFES/Entprelllevel zur Erstellung eines DFES Eintrages für Prüfung DFC_PFltOvldInhRgn" VALUE 0x80029A3F Val_Wu8 15.00 DFES_OneToOne 0.00 15.00 EXTENDED_LIMITS 0.00 255.0 /end CHARACTERISTIC
/begin CHARACTERISTIC DFES_DbLv.DFC_PFltOvldTrqLim_C "DFES/Entprelllevel zur Erstellung eines DFES Eintrages für Prüfung DFC_PFltOvldTrqLim" VALUE 0x80029A40 Val_Wu8 15.00 DFES_OneToOne 0.00 15.00 EXTENDED_LIMITS 0.00 255.0 /end CHARACTERISTIC
/begin CHARACTERISTIC DFES_DbLv.DFC_PFltPresPlausMAX_C "DFES/Entprelllevel zur Erstellung eines DFES Eintrages für Prüfung DFC_PFltPresPlausMAX" VALUE 0x80029A41 Val_Wu8 15.00 DFES_OneToOne 0.00 15.00 EXTENDED_LIMITS 0.00 255.0 /end CHARACTERISTIC
/begin CHARACTERISTIC DFES_DbLv.DFC_PFltPresPlausMIN_C "DFES/Entprelllevel zur Erstellung eines DFES Eintrages für Prüfung DFC_PFltPresPlausMIN" VALUE 0x80029A42 Val_Wu8 15.00 DFES_OneToOne 0.00 15.00 EXTENDED_LIMITS 0.00 255.0 /end CHARACTERISTIC
/begin CHARACTERISTIC DFES_DbLv.DFC_PFltTraRpmRdc_C "DFES/Entprelllevel zur Erstellung eines DFES Eintrages für Prüfung DFC_PFltTraRpmRdc" VALUE 0x80029A43 Val_Wu8 15.00 DFES_OneToOne 0.00 15.00 EXTENDED_LIMITS 0.00 255.0 /end CHARACTERISTIC
/begin CHARACTERISTIC DFES_DbLv.DFC_PFlt_tOxiPreMax_C "DFES/Entprelllevel zur Erstellung eines DFES Eintrages für Prüfung DFC_PFlt_tOxiPreMax" VALUE 0x80029A44 Val_Wu8 15.00 DFES_OneToOne 0.00 15.00 EXTENDED_LIMITS 0.00 255.0 /end CHARACTERISTIC
/begin CHARACTERISTIC DFES_DbLv.DFC_PFlt_tOxiPreMaxRgn_C "DFES/Entprelllevel zur Erstellung eines DFES Eintrages für Prüfung DFC_PFlt_tOxiPreMaxRgn" VALUE 0x80029A45 Val_Wu8 15.00 DFES_OneToOne 0.00 15.00 EXTENDED_LIMITS 0.00 255.0 /end CHARACTERISTIC
/begin CHARACTERISTIC DFES_DbLv.DFC_PFlt_tOxiPreNpl_C "DFES/Entprelllevel zur Erstellung eines DFES Eintrages für Prüfung DFC_PFlt_tOxiPreNpl" VALUE 0x80029A46 Val_Wu8 15.00 DFES_OneToOne 0.00 15.00 EXTENDED_LIMITS 0.00 255.0 /end CHARACTERISTIC
/begin CHARACTERISTIC DFES_DbLv.DFC_PFlt_tPreMax_C "DFES/Entprelllevel zur Erstellung eines DFES Eintrages für Prüfung DFC_PFlt_tPreMax" VALUE 0x80029A47 Val_Wu8 15.00 DFES_OneToOne 0.00 15.00 EXTENDED_LIMITS 0.00 255.0 /end CHARACTERISTIC
/begin CHARACTERISTIC DFES_DbLv.DFC_PFlt_tPreMaxRgn_C "DFES/Entprelllevel zur Erstellung eines DFES Eintrages für Prüfung DFC_PFlt_tPreMaxRgn" VALUE 0x80029A48 Val_Wu8 15.00 DFES_OneToOne 0.00 15.00 EXTENDED_LIMITS 0.00 255.0 /end CHARACTERISTIC
/begin CHARACTERISTIC DFES_DbLv.DFC_PFlt_tPreNpl_C "DFES/Entprelllevel zur Erstellung eines DFES Eintrages für Prüfung DFC_PFlt_tPreNpl" VALUE 0x80029A49 Val_Wu8 15.00 DFES_OneToOne 0.00 15.00 EXTENDED_LIMITS 0.00 255.0 /end CHARACTERISTIC
/begin CHARACTERISTIC DFES_DbLv.DFC_PFltmSotDiffMAX_C "DFES/Entprelllevel zur Erstellung eines DFES Eintrages für Prüfung DFC_PFltmSotDiffMAX" VALUE 0x80029A4A Val_Wu8 15.00 DFES_OneToOne 0.00 15.00 EXTENDED_LIMITS 0.00 255.0 /end CHARACTERISTIC
/begin CHARACTERISTIC DFES_DbLv.DFC_PFltmSotDiffMIN_C "DFES/Entprelllevel zur Erstellung eines DFES Eintrages für Prüfung DFC_PFltmSotDiffMIN" VALUE 0x80029A4B Val_Wu8 15.00 DFES_OneToOne 0.00 15.00 EXTENDED_LIMITS 0.00 255.0 /end CHARACTERISTIC
/begin CHARACTERISTIC DFES_DbLv.DFC_PFltmSotDiffSIG_C "DFES/Entprelllevel zur Erstellung eines DFES Eintrages für Prüfung DFC_PFltmSotDiffSIG" VALUE 0x80029A4C Val_Wu8 15.00 DFES_OneToOne 0.00 15.00 EXTENDED_LIMITS 0.00 255.0 /end CHARACTERISTIC
/begin CHARACTERISTIC DFES_DbLv.DFC_PIntkVUsEnvPPls_C "DFES/Entprelllevel zur Erstellung eines DFES Eintrages für Prüfung DFC_PIntkVUsEnvPPls" VALUE 0x80029A4D Val_Wu8 15.00 DFES_OneToOne 0.00 15.00 EXTENDED_LIMITS 0.00 255.0 /end CHARACTERISTIC
/begin CHARACTERISTIC DFES_DbLv.DFC_PresPlausDblDef_C "DFES/Entprelllevel zur Erstellung eines DFES Eintrages für Prüfung DFC_PresPlausDblDef" VALUE 0x80029A4E Val_Wu8 15.00 DFES_OneToOne 0.00 15.00 EXTENDED_LIMITS 0.00 255.0 /end CHARACTERISTIC
/begin CHARACTERISTIC DFES_DbLv.DFC_RailCPC1_C "DFES/Entprelllevel zur Erstellung eines DFES Eintrages für Prüfung DFC_RailCPC1" VALUE 0x80029A4F Val_Wu8 15.00 DFES_OneToOne 0.00 15.00 EXTENDED_LIMITS 0.00 255.0 /end CHARACTERISTIC
/begin CHARACTERISTIC DFES_DbLv.DFC_RailCPC3_C "DFES/Entprelllevel zur Erstellung eines DFES Eintrages für Prüfung DFC_RailCPC3" VALUE 0x80029A50 Val_Wu8 15.00 DFES_OneToOne 0.00 15.00 EXTENDED_LIMITS 0.00 255.0 /end CHARACTERISTIC
/begin CHARACTERISTIC DFES_DbLv.DFC_RailCPC4_C "DFES/Entprelllevel zur Erstellung eines DFES Eintrages für Prüfung DFC_RailCPC4" VALUE 0x80029A51 Val_Wu8 15.00 DFES_OneToOne 0.00 15.00 EXTENDED_LIMITS 0.00 255.0 /end CHARACTERISTIC
/begin CHARACTERISTIC DFES_DbLv.DFC_RailMeUn0_C "DFES/Entprelllevel zur Erstellung eines DFES Eintrages für Prüfung DFC_RailMeUn0" VALUE 0x80029A52 Val_Wu8 15.00 DFES_OneToOne 0.00 15.00 EXTENDED_LIMITS 0.00 255.0 /end CHARACTERISTIC
/begin CHARACTERISTIC DFES_DbLv.DFC_RailMeUn1_C "DFES/Entprelllevel zur Erstellung eines DFES Eintrages für Prüfung DFC_RailMeUn1" VALUE 0x80029A53 Val_Wu8 15.00 DFES_OneToOne 0.00 15.00 EXTENDED_LIMITS 0.00 255.0 /end CHARACTERISTIC
/begin CHARACTERISTIC DFES_DbLv.DFC_RailMeUn2_C "DFES/Entprelllevel zur Erstellung eines DFES Eintrages für Prüfung DFC_RailMeUn2" VALUE 0x80029A54 Val_Wu8 15.00 DFES_OneToOne 0.00 15.00 EXTENDED_LIMITS 0.00 255.0 /end CHARACTERISTIC
/begin CHARACTERISTIC DFES_DbLv.DFC_RailMeUn22_C "DFES/Entprelllevel zur Erstellung eines DFES Eintrages für Prüfung DFC_RailMeUn22" VALUE 0x80029A55 Val_Wu8 15.00 DFES_OneToOne 0.00 15.00 EXTENDED_LIMITS 0.00 255.0 /end CHARACTERISTIC
/begin CHARACTERISTIC DFES_DbLv.DFC_RailMeUn3_C "DFES/Entprelllevel zur Erstellung eines DFES Eintrages für Prüfung DFC_RailMeUn3" VALUE 0x80029A56 Val_Wu8 15.00 DFES_OneToOne 0.00 15.00 EXTENDED_LIMITS 0.00 255.0 /end CHARACTERISTIC
/begin CHARACTERISTIC DFES_DbLv.DFC_RailMeUn4_C "DFES/Entprelllevel zur Erstellung eines DFES Eintrages für Prüfung DFC_RailMeUn4" VALUE 0x80029A57 Val_Wu8 15.00 DFES_OneToOne 0.00 15.00 EXTENDED_LIMITS 0.00 255.0 /end CHARACTERISTIC
/begin CHARACTERISTIC DFES_DbLv.DFC_RailMeUn42_C "DFES/Entprelllevel zur Erstellung eines DFES Eintrages für Prüfung DFC_RailMeUn42" VALUE 0x80029A58 Val_Wu8 15.00 DFES_OneToOne 0.00 15.00 EXTENDED_LIMITS 0.00 255.0 /end CHARACTERISTIC
/begin CHARACTERISTIC DFES_DbLv.DFC_RailMeUn5_C "DFES/Entprelllevel zur Erstellung eines DFES Eintrages für Prüfung DFC_RailMeUn5" VALUE 0x80029A59 Val_Wu8 15.00 DFES_OneToOne 0.00 15.00 EXTENDED_LIMITS 0.00 255.0 /end CHARACTERISTIC
/begin CHARACTERISTIC DFES_DbLv.DFC_RailPCV0_C "DFES/Entprelllevel zur Erstellung eines DFES Eintrages für Prüfung DFC_RailPCV0" VALUE 0x80029A5A Val_Wu8 15.00 DFES_OneToOne 0.00 15.00 EXTENDED_LIMITS 0.00 255.0 /end CHARACTERISTIC
/begin CHARACTERISTIC DFES_DbLv.DFC_RailPCV1_C "DFES/Entprelllevel zur Erstellung eines DFES Eintrages für Prüfung DFC_RailPCV1" VALUE 0x80029A5B Val_Wu8 15.00 DFES_OneToOne 0.00 15.00 EXTENDED_LIMITS 0.00 255.0 /end CHARACTERISTIC
/begin CHARACTERISTIC DFES_DbLv.DFC_RailPCV2_C "DFES/Entprelllevel zur Erstellung eines DFES Eintrages für Prüfung DFC_RailPCV2" VALUE 0x80029A5C Val_Wu8 15.00 DFES_OneToOne 0.00 15.00 EXTENDED_LIMITS 0.00 255.0 /end CHARACTERISTIC
/begin CHARACTERISTIC DFES_DbLv.DFC_RailPCV22_C "DFES/Entprelllevel zur Erstellung eines DFES Eintrages für Prüfung DFC_RailPCV22" VALUE 0x80029A5D Val_Wu8 15.00 DFES_OneToOne 0.00 15.00 EXTENDED_LIMITS 0.00 255.0 /end CHARACTERISTIC
/begin CHARACTERISTIC DFES_DbLv.DFC_RailPCV3_C "DFES/Entprelllevel zur Erstellung eines DFES Eintrages für Prüfung DFC_RailPCV3" VALUE 0x80029A5E Val_Wu8 15.00 DFES_OneToOne 0.00 15.00 EXTENDED_LIMITS 0.00 255.0 /end CHARACTERISTIC
/begin CHARACTERISTIC DFES_DbLv.DFC_RailPCV4_C "DFES/Entprelllevel zur Erstellung eines DFES Eintrages für Prüfung DFC_RailPCV4" VALUE 0x80029A5F Val_Wu8 15.00 DFES_OneToOne 0.00 15.00 EXTENDED_LIMITS 0.00 255.0 /end CHARACTERISTIC
/begin CHARACTERISTIC DFES_DbLv.DFC_RailPCV42_C "DFES/Entprelllevel zur Erstellung eines DFES Eintrages für Prüfung DFC_RailPCV42" VALUE 0x80029A60 Val_Wu8 15.00 DFES_OneToOne 0.00 15.00 EXTENDED_LIMITS 0.00 255.0 /end CHARACTERISTIC
/begin CHARACTERISTIC DFES_DbLv.DFC_RailPMonStrt_C "DFES/Entprelllevel zur Erstellung eines DFES Eintrages für Prüfung DFC_RailPMonStrt" VALUE 0x80029A61 Val_Wu8 15.00 DFES_OneToOne 0.00 15.00 EXTENDED_LIMITS 0.00 255.0 /end CHARACTERISTIC
/begin CHARACTERISTIC DFES_DbLv.DFC_SSpMon1_C "DFES/Entprelllevel zur Erstellung eines DFES Eintrages für Prüfung DFC_SSpMon1" VALUE 0x80029A62 Val_Wu8 15.00 DFES_OneToOne 0.00 15.00 EXTENDED_LIMITS 0.00 255.0 /end CHARACTERISTIC
/begin CHARACTERISTIC DFES_DbLv.DFC_SSpMon2_C "DFES/Entprelllevel zur Erstellung eines DFES Eintrages für Prüfung DFC_SSpMon2" VALUE 0x80029A63 Val_Wu8 15.00 DFES_OneToOne 0.00 15.00 EXTENDED_LIMITS 0.00 255.0 /end CHARACTERISTIC
/begin CHARACTERISTIC DFES_DbLv.DFC_SSpMon3_C "DFES/Entprelllevel zur Erstellung eines DFES Eintrages für Prüfung DFC_SSpMon3" VALUE 0x80029A64 Val_Wu8 15.00 DFES_OneToOne 0.00 15.00 EXTENDED_LIMITS 0.00 255.0 /end CHARACTERISTIC
/begin CHARACTERISTIC DFES_DbLv.DFC_ThrVlv4WinErr1_C "DFES/Entprelllevel zur Erstellung eines DFES Eintrages für Prüfung DFC_ThrVlv4WinErr1" VALUE 0x80029A65 Val_Wu8 15.00 DFES_OneToOne 0.00 15.00 EXTENDED_LIMITS 0.00 255.0 /end CHARACTERISTIC
/begin CHARACTERISTIC DFES_DbLv.DFC_ThrVlv4WinErr2_C "DFES/Entprelllevel zur Erstellung eines DFES Eintrages für Prüfung DFC_ThrVlv4WinErr2" VALUE 0x80029A66 Val_Wu8 15.00 DFES_OneToOne 0.00 15.00 EXTENDED_LIMITS 0.00 255.0 /end CHARACTERISTIC
/begin CHARACTERISTIC DFES_DbLv.DFC_ThrVlv4WinErr3_C "DFES/Entprelllevel zur Erstellung eines DFES Eintrages für Prüfung DFC_ThrVlv4WinErr3" VALUE 0x80029A67 Val_Wu8 15.00 DFES_OneToOne 0.00 15.00 EXTENDED_LIMITS 0.00 255.0 /end CHARACTERISTIC
/begin CHARACTERISTIC DFES_DbLv.DFC_ThrVlv4WinErr4_C "DFES/Entprelllevel zur Erstellung eines DFES Eintrages für Prüfung DFC_ThrVlv4WinErr4" VALUE 0x80029A68 Val_Wu8 15.00 DFES_OneToOne 0.00 15.00 EXTENDED_LIMITS 0.00 255.0 /end CHARACTERISTIC
/begin CHARACTERISTIC DFES_DbLv.DFC_ThrVlvSCG_C "DFES/Entprelllevel zur Erstellung eines DFES Eintrages für Prüfung DFC_ThrVlvSCG" VALUE 0x80029A69 Val_Wu8 15.00 DFES_OneToOne 0.00 15.00 EXTENDED_LIMITS 0.00 255.0 /end CHARACTERISTIC
/begin CHARACTERISTIC DFES_DbLv.DFC_Tle6232Spi1_C "DFES/Entprelllevel zur Erstellung eines DFES Eintrages für Prüfung DFC_Tle6232Spi1" VALUE 0x80029A6A Val_Wu8 15.00 DFES_OneToOne 0.00 15.00 EXTENDED_LIMITS 0.00 255.0 /end CHARACTERISTIC
/begin CHARACTERISTIC DFES_DbLv.DFC_TrbCh4WinErr1_C "DFES/Entprelllevel zur Erstellung eines DFES Eintrages für Prüfung DFC_TrbCh4WinErr1" VALUE 0x80029A6B Val_Wu8 15.00 DFES_OneToOne 0.00 15.00 EXTENDED_LIMITS 0.00 255.0 /end CHARACTERISTIC
/begin CHARACTERISTIC DFES_DbLv.DFC_TrbCh4WinErr2_C "DFES/Entprelllevel zur Erstellung eines DFES Eintrages für Prüfung DFC_TrbCh4WinErr2" VALUE 0x80029A6C Val_Wu8 15.00 DFES_OneToOne 0.00 15.00 EXTENDED_LIMITS 0.00 255.0 /end CHARACTERISTIC
/begin CHARACTERISTIC DFES_DbLv.DFC_TrbCh4WinErr3_C "DFES/Entprelllevel zur Erstellung eines DFES Eintrages für Prüfung DFC_TrbCh4WinErr3" VALUE 0x80029A6D Val_Wu8 15.00 DFES_OneToOne 0.00 15.00 EXTENDED_LIMITS 0.00 255.0 /end CHARACTERISTIC
/begin CHARACTERISTIC DFES_DbLv.DFC_TrbCh4WinErr4_C "DFES/Entprelllevel zur Erstellung eines DFES Eintrages für Prüfung DFC_TrbCh4WinErr4" VALUE 0x80029A6E Val_Wu8 15.00 DFES_OneToOne 0.00 15.00 EXTENDED_LIMITS 0.00 255.0 /end CHARACTERISTIC
/begin CHARACTERISTIC DFES_DbLv.DFC_TrbChSCG_C "DFES/Entprelllevel zur Erstellung eines DFES Eintrages für Prüfung DFC_TrbChSCG" VALUE 0x80029A6F Val_Wu8 15.00 DFES_OneToOne 0.00 15.00 EXTENDED_LIMITS 0.00 255.0 /end CHARACTERISTIC
/begin CHARACTERISTIC DFES_DbLv.DFC_TrbChSRCMax_C "DFES/Entprelllevel zur Erstellung eines DFES Eintrages für Prüfung DFC_TrbChSRCMax" VALUE 0x80029A70 Val_Wu8 15.00 DFES_OneToOne 0.00 15.00 EXTENDED_LIMITS 0.00 255.0 /end CHARACTERISTIC
/begin CHARACTERISTIC DFES_DbLv.DFC_TrbChSRCMin_C "DFES/Entprelllevel zur Erstellung eines DFES Eintrages für Prüfung DFC_TrbChSRCMin" VALUE 0x80029A71 Val_Wu8 15.00 DFES_OneToOne 0.00 15.00 EXTENDED_LIMITS 0.00 255.0 /end CHARACTERISTIC
/begin CHARACTERISTIC DFES_DbLv.DFC_WaHtEl4WinErr1_C "DFES/Entprelllevel zur Erstellung eines DFES Eintrages für Prüfung DFC_WaHtEl4WinErr1" VALUE 0x80029A72 Val_Wu8 15.00 DFES_OneToOne 0.00 15.00 EXTENDED_LIMITS 0.00 255.0 /end CHARACTERISTIC
/begin CHARACTERISTIC DFES_DbLv.DFC_WaHtEl4WinErr2_C "DFES/Entprelllevel zur Erstellung eines DFES Eintrages für Prüfung DFC_WaHtEl4WinErr2" VALUE 0x80029A73 Val_Wu8 15.00 DFES_OneToOne 0.00 15.00 EXTENDED_LIMITS 0.00 255.0 /end CHARACTERISTIC
/begin CHARACTERISTIC DFES_DbLv.DFC_WaHtEl4WinErr3_C "DFES/Entprelllevel zur Erstellung eines DFES Eintrages für Prüfung DFC_WaHtEl4WinErr3" VALUE 0x80029A74 Val_Wu8 15.00 DFES_OneToOne 0.00 15.00 EXTENDED_LIMITS 0.00 255.0 /end CHARACTERISTIC
/begin CHARACTERISTIC DFES_DbLv.DFC_WaHtEl4WinErr4_C "DFES/Entprelllevel zur Erstellung eines DFES Eintrages für Prüfung DFC_WaHtEl4WinErr4" VALUE 0x80029A75 Val_Wu8 15.00 DFES_OneToOne 0.00 15.00 EXTENDED_LIMITS 0.00 255.0 /end CHARACTERISTIC
/begin CHARACTERISTIC DFES_DbLv.DFC_WaHtElSCG_C "DFES/Entprelllevel zur Erstellung eines DFES Eintrages für Prüfung DFC_WaHtElSCG" VALUE 0x80029A76 Val_Wu8 15.00 DFES_OneToOne 0.00 15.00 EXTENDED_LIMITS 0.00 255.0 /end CHARACTERISTIC
/begin CHARACTERISTIC DFES_DbLv.DFC_ETClbETFltMax_0_C "DFES/Entprelllevel zur Erstellung eines DFES Eintrages für Prüfung DFC_ETClbETFltMax_0" VALUE 0x80029A77 Val_Wu8 15.00 DFES_OneToOne 0.00 15.00 EXTENDED_LIMITS 0.00 255.0 /end CHARACTERISTIC
/begin CHARACTERISTIC DFES_DbLv.DFC_ETClbETFltMax_1_C "DFES/Entprelllevel zur Erstellung eines DFES Eintrages für Prüfung DFC_ETClbETFltMax_1" VALUE 0x80029A78 Val_Wu8 15.00 DFES_OneToOne 0.00 15.00 EXTENDED_LIMITS 0.00 255.0 /end CHARACTERISTIC
/begin CHARACTERISTIC DFES_DbLv.DFC_ETClbETFltMax_2_C "DFES/Entprelllevel zur Erstellung eines DFES Eintrages für Prüfung DFC_ETClbETFltMax_2" VALUE 0x80029A79 Val_Wu8 15.00 DFES_OneToOne 0.00 15.00 EXTENDED_LIMITS 0.00 255.0 /end CHARACTERISTIC
/begin CHARACTERISTIC DFES_DbLv.DFC_ETClbETFltMax_3_C "DFES/Entprelllevel zur Erstellung eines DFES Eintrages für Prüfung DFC_ETClbETFltMax_3" VALUE 0x80029A7A Val_Wu8 15.00 DFES_OneToOne 0.00 15.00 EXTENDED_LIMITS 0.00 255.0 /end CHARACTERISTIC
/begin CHARACTERISTIC DFES_DbLv.DFC_ETClbETFltMax_4_C "DFES/Entprelllevel zur Erstellung eines DFES Eintrages für Prüfung DFC_ETClbETFltMax_4" VALUE 0x80029A7B Val_Wu8 15.00 DFES_OneToOne 0.00 15.00 EXTENDED_LIMITS 0.00 255.0 /end CHARACTERISTIC
/begin CHARACTERISTIC DFES_DbLv.DFC_ETClbETFltMax_5_C "DFES/Entprelllevel zur Erstellung eines DFES Eintrages für Prüfung DFC_ETClbETFltMax_5" VALUE 0x80029A7C Val_Wu8 15.00 DFES_OneToOne 0.00 15.00 EXTENDED_LIMITS 0.00 255.0 /end CHARACTERISTIC
/begin CHARACTERISTIC DFES_DbLv.DFC_ETClbETFltMin_0_C "DFES/Entprelllevel zur Erstellung eines DFES Eintrages für Prüfung DFC_ETClbETFltMin_0" VALUE 0x80029A7D Val_Wu8 15.00 DFES_OneToOne 0.00 15.00 EXTENDED_LIMITS 0.00 255.0 /end CHARACTERISTIC
/begin CHARACTERISTIC DFES_DbLv.DFC_ETClbETFltMin_1_C "DFES/Entprelllevel zur Erstellung eines DFES Eintrages für Prüfung DFC_ETClbETFltMin_1" VALUE 0x80029A7E Val_Wu8 15.00 DFES_OneToOne 0.00 15.00 EXTENDED_LIMITS 0.00 255.0 /end CHARACTERISTIC
/begin CHARACTERISTIC DFES_DbLv.DFC_ETClbETFltMin_2_C "DFES/Entprelllevel zur Erstellung eines DFES Eintrages für Prüfung DFC_ETClbETFltMin_2" VALUE 0x80029A7F Val_Wu8 15.00 DFES_OneToOne 0.00 15.00 EXTENDED_LIMITS 0.00 255.0 /end CHARACTERISTIC
/begin CHARACTERISTIC DFES_DbLv.DFC_ETClbETFltMin_3_C "DFES/Entprelllevel zur Erstellung eines DFES Eintrages für Prüfung DFC_ETClbETFltMin_3" VALUE 0x80029A80 Val_Wu8 15.00 DFES_OneToOne 0.00 15.00 EXTENDED_LIMITS 0.00 255.0 /end CHARACTERISTIC
/begin CHARACTERISTIC DFES_DbLv.DFC_ETClbETFltMin_4_C "DFES/Entprelllevel zur Erstellung eines DFES Eintrages für Prüfung DFC_ETClbETFltMin_4" VALUE 0x80029A81 Val_Wu8 15.00 DFES_OneToOne 0.00 15.00 EXTENDED_LIMITS 0.00 255.0 /end CHARACTERISTIC
/begin CHARACTERISTIC DFES_DbLv.DFC_ETClbETFltMin_5_C "DFES/Entprelllevel zur Erstellung eines DFES Eintrages für Prüfung DFC_ETClbETFltMin_5" VALUE 0x80029A82 Val_Wu8 15.00 DFES_OneToOne 0.00 15.00 EXTENDED_LIMITS 0.00 255.0 /end CHARACTERISTIC
/begin CHARACTERISTIC DFES_DbLv.DFC_InjCrvInjLimChrgBal_C "DFES/Entprelllevel zur Erstellung eines DFES Eintrages für Prüfung DFC_InjCrvInjLimChrgBal" VALUE 0x80029A83 Val_Wu8 15.00 DFES_OneToOne 0.00 15.00 EXTENDED_LIMITS 0.00 255.0 /end CHARACTERISTIC
/begin CHARACTERISTIC DFES_DbLv.DFC_InjCrvInjLimQntBal_C "DFES/Entprelllevel zur Erstellung eines DFES Eintrages für Prüfung DFC_InjCrvInjLimQntBal" VALUE 0x80029A84 Val_Wu8 15.00 DFES_OneToOne 0.00 15.00 EXTENDED_LIMITS 0.00 255.0 /end CHARACTERISTIC
/begin CHARACTERISTIC DFES_DbLv.DFC_InjCrvInjLimSys_C "DFES/Entprelllevel zur Erstellung eines DFES Eintrages für Prüfung DFC_InjCrvInjLimSys" VALUE 0x80029A85 Val_Wu8 15.00 DFES_OneToOne 0.00 15.00 EXTENDED_LIMITS 0.00 255.0 /end CHARACTERISTIC
/begin CHARACTERISTIC DFES_DbLv.DFC_InjCrvNumInjRtmLim_C "DFES/Entprelllevel zur Erstellung eines DFES Eintrages für Prüfung DFC_InjCrvNumInjRtmLim" VALUE 0x80029A86 Val_Wu8 15.00 DFES_OneToOne 0.00 15.00 EXTENDED_LIMITS 0.00 255.0 /end CHARACTERISTIC
/begin CHARACTERISTIC DFES_DbLv.DFC_LSUHtCoupSig_C "DFES/Entprelllevel zur Erstellung eines DFES Eintrages für Prüfung DFC_LSUHtCoupSig" VALUE 0x80029A87 Val_Wu8 15.00 DFES_OneToOne 0.00 15.00 EXTENDED_LIMITS 0.00 255.0 /end CHARACTERISTIC
/begin CHARACTERISTIC DFES_DbLv.DFC_AFS_SSpShOffOL_C "DFES/Entprelllevel zur Erstellung eines DFES Eintrages für Prüfung DFC_AFS_SSpShOffOL" VALUE 0x80029A88 Val_Wu8 15.00 DFES_OneToOne 0.00 15.00 EXTENDED_LIMITS 0.00 255.0 /end CHARACTERISTIC
/begin CHARACTERISTIC DFES_DbLv.DFC_AFS_SSpShOffOvrTemp_C "DFES/Entprelllevel zur Erstellung eines DFES Eintrages für Prüfung DFC_AFS_SSpShOffOvrTemp" VALUE 0x80029A89 Val_Wu8 15.00 DFES_OneToOne 0.00 15.00 EXTENDED_LIMITS 0.00 255.0 /end CHARACTERISTIC
/begin CHARACTERISTIC DFES_DbLv.DFC_AFS_SSpShOffSCB_C "DFES/Entprelllevel zur Erstellung eines DFES Eintrages für Prüfung DFC_AFS_SSpShOffSCB" VALUE 0x80029A8A Val_Wu8 15.00 DFES_OneToOne 0.00 15.00 EXTENDED_LIMITS 0.00 255.0 /end CHARACTERISTIC
/begin CHARACTERISTIC DFES_DbLv.DFC_AFS_SSpShOffSCG_C "DFES/Entprelllevel zur Erstellung eines DFES Eintrages für Prüfung DFC_AFS_SSpShOffSCG" VALUE 0x80029A8B Val_Wu8 15.00 DFES_OneToOne 0.00 15.00 EXTENDED_LIMITS 0.00 255.0 /end CHARACTERISTIC
/begin CHARACTERISTIC DFES_DbLv.DFC_AirCCmprOL_C "DFES/Entprelllevel zur Erstellung eines DFES Eintrages für Prüfung DFC_AirCCmprOL" VALUE 0x80029A8C Val_Wu8 15.00 DFES_OneToOne 0.00 15.00 EXTENDED_LIMITS 0.00 255.0 /end CHARACTERISTIC
/begin CHARACTERISTIC DFES_DbLv.DFC_AirCCmprOvrTemp_C "DFES/Entprelllevel zur Erstellung eines DFES Eintrages für Prüfung DFC_AirCCmprOvrTemp" VALUE 0x80029A8D Val_Wu8 15.00 DFES_OneToOne 0.00 15.00 EXTENDED_LIMITS 0.00 255.0 /end CHARACTERISTIC
/begin CHARACTERISTIC DFES_DbLv.DFC_AirCCmprSCB_C "DFES/Entprelllevel zur Erstellung eines DFES Eintrages für Prüfung DFC_AirCCmprSCB" VALUE 0x80029A8E Val_Wu8 15.00 DFES_OneToOne 0.00 15.00 EXTENDED_LIMITS 0.00 255.0 /end CHARACTERISTIC
/begin CHARACTERISTIC DFES_DbLv.DFC_AirCCmprSCG_C "DFES/Entprelllevel zur Erstellung eines DFES Eintrages für Prüfung DFC_AirCCmprSCG" VALUE 0x80029A8F Val_Wu8 15.00 DFES_OneToOne 0.00 15.00 EXTENDED_LIMITS 0.00 255.0 /end CHARACTERISTIC
/begin CHARACTERISTIC DFES_DbLv.DFC_CByVlvOL_C "DFES/Entprelllevel zur Erstellung eines DFES Eintrages für Prüfung DFC_CByVlvOL" VALUE 0x80029A90 Val_Wu8 15.00 DFES_OneToOne 0.00 15.00 EXTENDED_LIMITS 0.00 255.0 /end CHARACTERISTIC
/begin CHARACTERISTIC DFES_DbLv.DFC_CByVlvOvrTemp_C "DFES/Entprelllevel zur Erstellung eines DFES Eintrages für Prüfung DFC_CByVlvOvrTemp" VALUE 0x80029A91 Val_Wu8 15.00 DFES_OneToOne 0.00 15.00 EXTENDED_LIMITS 0.00 255.0 /end CHARACTERISTIC
/begin CHARACTERISTIC DFES_DbLv.DFC_CByVlvSCB_C "DFES/Entprelllevel zur Erstellung eines DFES Eintrages für Prüfung DFC_CByVlvSCB" VALUE 0x80029A92 Val_Wu8 15.00 DFES_OneToOne 0.00 15.00 EXTENDED_LIMITS 0.00 255.0 /end CHARACTERISTIC
/begin CHARACTERISTIC DFES_DbLv.DFC_CByVlvSCG_C "DFES/Entprelllevel zur Erstellung eines DFES Eintrages für Prüfung DFC_CByVlvSCG" VALUE 0x80029A93 Val_Wu8 15.00 DFES_OneToOne 0.00 15.00 EXTENDED_LIMITS 0.00 255.0 /end CHARACTERISTIC
/begin CHARACTERISTIC DFES_DbLv.DFC_CThmstOL_C "DFES/Entprelllevel zur Erstellung eines DFES Eintrages für Prüfung DFC_CThmstOL" VALUE 0x80029A94 Val_Wu8 15.00 DFES_OneToOne 0.00 15.00 EXTENDED_LIMITS 0.00 255.0 /end CHARACTERISTIC
/begin CHARACTERISTIC DFES_DbLv.DFC_CThmstOvrTemp_C "DFES/Entprelllevel zur Erstellung eines DFES Eintrages für Prüfung DFC_CThmstOvrTemp" VALUE 0x80029A95 Val_Wu8 15.00 DFES_OneToOne 0.00 15.00 EXTENDED_LIMITS 0.00 255.0 /end CHARACTERISTIC
/begin CHARACTERISTIC DFES_DbLv.DFC_CThmstSCB_C "DFES/Entprelllevel zur Erstellung eines DFES Eintrages für Prüfung DFC_CThmstSCB" VALUE 0x80029A96 Val_Wu8 15.00 DFES_OneToOne 0.00 15.00 EXTENDED_LIMITS 0.00 255.0 /end CHARACTERISTIC
/begin CHARACTERISTIC DFES_DbLv.DFC_CThmstSCG_C "DFES/Entprelllevel zur Erstellung eines DFES Eintrages für Prüfung DFC_CThmstSCG" VALUE 0x80029A97 Val_Wu8 15.00 DFES_OneToOne 0.00 15.00 EXTENDED_LIMITS 0.00 255.0 /end CHARACTERISTIC
/begin CHARACTERISTIC DFES_DbLv.DFC_DSMDummy_C "DFES/Entprelllevel zur Erstellung eines DFES Eintrages für Prüfung DFC_DSMDummy" VALUE 0x80029A98 Val_Wu8 15.00 DFES_OneToOne 0.00 15.00 EXTENDED_LIMITS 0.00 255.0 /end CHARACTERISTIC
/begin CHARACTERISTIC DFES_DbLv.DFC_EBxFanOL_C "DFES/Entprelllevel zur Erstellung eines DFES Eintrages für Prüfung DFC_EBxFanOL" VALUE 0x80029A99 Val_Wu8 15.00 DFES_OneToOne 0.00 15.00 EXTENDED_LIMITS 0.00 255.0 /end CHARACTERISTIC
/begin CHARACTERISTIC DFES_DbLv.DFC_EBxFanOvrTemp_C "DFES/Entprelllevel zur Erstellung eines DFES Eintrages für Prüfung DFC_EBxFanOvrTemp" VALUE 0x80029A9A Val_Wu8 15.00 DFES_OneToOne 0.00 15.00 EXTENDED_LIMITS 0.00 255.0 /end CHARACTERISTIC
/begin CHARACTERISTIC DFES_DbLv.DFC_EBxFanSCB_C "DFES/Entprelllevel zur Erstellung eines DFES Eintrages für Prüfung DFC_EBxFanSCB" VALUE 0x80029A9B Val_Wu8 15.00 DFES_OneToOne 0.00 15.00 EXTENDED_LIMITS 0.00 255.0 /end CHARACTERISTIC
/begin CHARACTERISTIC DFES_DbLv.DFC_EBxFanSCG_C "DFES/Entprelllevel zur Erstellung eines DFES Eintrages für Prüfung DFC_EBxFanSCG" VALUE 0x80029A9C Val_Wu8 15.00 DFES_OneToOne 0.00 15.00 EXTENDED_LIMITS 0.00 255.0 /end CHARACTERISTIC
/begin CHARACTERISTIC DFES_DbLv.DFC_ECBVlvOL_C "DFES/Entprelllevel zur Erstellung eines DFES Eintrages für Prüfung DFC_ECBVlvOL" VALUE 0x80029A9D Val_Wu8 15.00 DFES_OneToOne 0.00 15.00 EXTENDED_LIMITS 0.00 255.0 /end CHARACTERISTIC
/begin CHARACTERISTIC DFES_DbLv.DFC_ECBVlvOvrTemp_C "DFES/Entprelllevel zur Erstellung eines DFES Eintrages für Prüfung DFC_ECBVlvOvrTemp" VALUE 0x80029A9E Val_Wu8 15.00 DFES_OneToOne 0.00 15.00 EXTENDED_LIMITS 0.00 255.0 /end CHARACTERISTIC
/begin CHARACTERISTIC DFES_DbLv.DFC_ECBVlvSCB_C "DFES/Entprelllevel zur Erstellung eines DFES Eintrages für Prüfung DFC_ECBVlvSCB" VALUE 0x80029A9F Val_Wu8 15.00 DFES_OneToOne 0.00 15.00 EXTENDED_LIMITS 0.00 255.0 /end CHARACTERISTIC
/begin CHARACTERISTIC DFES_DbLv.DFC_ECBVlvSCG_C "DFES/Entprelllevel zur Erstellung eines DFES Eintrages für Prüfung DFC_ECBVlvSCG" VALUE 0x80029AA0 Val_Wu8 15.00 DFES_OneToOne 0.00 15.00 EXTENDED_LIMITS 0.00 255.0 /end CHARACTERISTIC
/begin CHARACTERISTIC DFES_DbLv.DFC_EMDmpOL_0_C "DFES/Entprelllevel zur Erstellung eines DFES Eintrages für Prüfung DFC_EMDmpOL_0" VALUE 0x80029AA1 Val_Wu8 15.00 DFES_OneToOne 0.00 15.00 EXTENDED_LIMITS 0.00 255.0 /end CHARACTERISTIC
/begin CHARACTERISTIC DFES_DbLv.DFC_EMDmpOL_1_C "DFES/Entprelllevel zur Erstellung eines DFES Eintrages für Prüfung DFC_EMDmpOL_1" VALUE 0x80029AA2 Val_Wu8 15.00 DFES_OneToOne 0.00 15.00 EXTENDED_LIMITS 0.00 255.0 /end CHARACTERISTIC
/begin CHARACTERISTIC DFES_DbLv.DFC_EMDmpOvrTemp_0_C "DFES/Entprelllevel zur Erstellung eines DFES Eintrages für Prüfung DFC_EMDmpOvrTemp_0" VALUE 0x80029AA3 Val_Wu8 15.00 DFES_OneToOne 0.00 15.00 EXTENDED_LIMITS 0.00 255.0 /end CHARACTERISTIC
/begin CHARACTERISTIC DFES_DbLv.DFC_EMDmpOvrTemp_1_C "DFES/Entprelllevel zur Erstellung eines DFES Eintrages für Prüfung DFC_EMDmpOvrTemp_1" VALUE 0x80029AA4 Val_Wu8 15.00 DFES_OneToOne 0.00 15.00 EXTENDED_LIMITS 0.00 255.0 /end CHARACTERISTIC
/begin CHARACTERISTIC DFES_DbLv.DFC_EMDmpSCB_0_C "DFES/Entprelllevel zur Erstellung eines DFES Eintrages für Prüfung DFC_EMDmpSCB_0" VALUE 0x80029AA5 Val_Wu8 15.00 DFES_OneToOne 0.00 15.00 EXTENDED_LIMITS 0.00 255.0 /end CHARACTERISTIC
/begin CHARACTERISTIC DFES_DbLv.DFC_EMDmpSCB_1_C "DFES/Entprelllevel zur Erstellung eines DFES Eintrages für Prüfung DFC_EMDmpSCB_1" VALUE 0x80029AA6 Val_Wu8 15.00 DFES_OneToOne 0.00 15.00 EXTENDED_LIMITS 0.00 255.0 /end CHARACTERISTIC
/begin CHARACTERISTIC DFES_DbLv.DFC_EMDmpSCG_0_C "DFES/Entprelllevel zur Erstellung eines DFES Eintrages für Prüfung DFC_EMDmpSCG_0" VALUE 0x80029AA7 Val_Wu8 15.00 DFES_OneToOne 0.00 15.00 EXTENDED_LIMITS 0.00 255.0 /end CHARACTERISTIC
/begin CHARACTERISTIC DFES_DbLv.DFC_EMDmpSCG_1_C "DFES/Entprelllevel zur Erstellung eines DFES Eintrages für Prüfung DFC_EMDmpSCG_1" VALUE 0x80029AA8 Val_Wu8 15.00 DFES_OneToOne 0.00 15.00 EXTENDED_LIMITS 0.00 255.0 /end CHARACTERISTIC
/begin CHARACTERISTIC DFES_DbLv.DFC_EngStAOL_C "DFES/Entprelllevel zur Erstellung eines DFES Eintrages für Prüfung DFC_EngStAOL" VALUE 0x80029AA9 Val_Wu8 15.00 DFES_OneToOne 0.00 15.00 EXTENDED_LIMITS 0.00 255.0 /end CHARACTERISTIC
/begin CHARACTERISTIC DFES_DbLv.DFC_EngStAOvrTemp_C "DFES/Entprelllevel zur Erstellung eines DFES Eintrages für Prüfung DFC_EngStAOvrTemp" VALUE 0x80029AAA Val_Wu8 15.00 DFES_OneToOne 0.00 15.00 EXTENDED_LIMITS 0.00 255.0 /end CHARACTERISTIC
/begin CHARACTERISTIC DFES_DbLv.DFC_EngStASCB_C "DFES/Entprelllevel zur Erstellung eines DFES Eintrages für Prüfung DFC_EngStASCB" VALUE 0x80029AAB Val_Wu8 15.00 DFES_OneToOne 0.00 15.00 EXTENDED_LIMITS 0.00 255.0 /end CHARACTERISTIC
/begin CHARACTERISTIC DFES_DbLv.DFC_EngStASCG_C "DFES/Entprelllevel zur Erstellung eines DFES Eintrages für Prüfung DFC_EngStASCG" VALUE 0x80029AAC Val_Wu8 15.00 DFES_OneToOne 0.00 15.00 EXTENDED_LIMITS 0.00 255.0 /end CHARACTERISTIC
/begin CHARACTERISTIC DFES_DbLv.DFC_FanOL_C "DFES/Entprelllevel zur Erstellung eines DFES Eintrages für Prüfung DFC_FanOL" VALUE 0x80029AAD Val_Wu8 15.00 DFES_OneToOne 0.00 15.00 EXTENDED_LIMITS 0.00 255.0 /end CHARACTERISTIC
/begin CHARACTERISTIC DFES_DbLv.DFC_FanOvrTemp_C "DFES/Entprelllevel zur Erstellung eines DFES Eintrages für Prüfung DFC_FanOvrTemp" VALUE 0x80029AAE Val_Wu8 15.00 DFES_OneToOne 0.00 15.00 EXTENDED_LIMITS 0.00 255.0 /end CHARACTERISTIC
/begin CHARACTERISTIC DFES_DbLv.DFC_FanSCB_C "DFES/Entprelllevel zur Erstellung eines DFES Eintrages für Prüfung DFC_FanSCB" VALUE 0x80029AAF Val_Wu8 15.00 DFES_OneToOne 0.00 15.00 EXTENDED_LIMITS 0.00 255.0 /end CHARACTERISTIC
/begin CHARACTERISTIC DFES_DbLv.DFC_FlFltHtOL_C "DFES/Entprelllevel zur Erstellung eines DFES Eintrages für Prüfung DFC_FlFltHtOL" VALUE 0x80029AB0 Val_Wu8 15.00 DFES_OneToOne 0.00 15.00 EXTENDED_LIMITS 0.00 255.0 /end CHARACTERISTIC
/begin CHARACTERISTIC DFES_DbLv.DFC_FlFltHtOvrTemp_C "DFES/Entprelllevel zur Erstellung eines DFES Eintrages für Prüfung DFC_FlFltHtOvrTemp" VALUE 0x80029AB1 Val_Wu8 15.00 DFES_OneToOne 0.00 15.00 EXTENDED_LIMITS 0.00 255.0 /end CHARACTERISTIC
/begin CHARACTERISTIC DFES_DbLv.DFC_FlFltHtSCB_C "DFES/Entprelllevel zur Erstellung eines DFES Eintrages für Prüfung DFC_FlFltHtSCB" VALUE 0x80029AB2 Val_Wu8 15.00 DFES_OneToOne 0.00 15.00 EXTENDED_LIMITS 0.00 255.0 /end CHARACTERISTIC
/begin CHARACTERISTIC DFES_DbLv.DFC_FlFltHtSCG_C "DFES/Entprelllevel zur Erstellung eines DFES Eintrages für Prüfung DFC_FlFltHtSCG" VALUE 0x80029AB3 Val_Wu8 15.00 DFES_OneToOne 0.00 15.00 EXTENDED_LIMITS 0.00 255.0 /end CHARACTERISTIC
/begin CHARACTERISTIC DFES_DbLv.DFC_LSUHtrMax_C "DFES/Entprelllevel zur Erstellung eines DFES Eintrages für Prüfung DFC_LSUHtrMax" VALUE 0x80029AB4 Val_Wu8 15.00 DFES_OneToOne 0.00 15.00 EXTENDED_LIMITS 0.00 255.0 /end CHARACTERISTIC
/begin CHARACTERISTIC DFES_DbLv.DFC_LSUHtrMin_C "DFES/Entprelllevel zur Erstellung eines DFES Eintrages für Prüfung DFC_LSUHtrMin" VALUE 0x80029AB5 Val_Wu8 15.00 DFES_OneToOne 0.00 15.00 EXTENDED_LIMITS 0.00 255.0 /end CHARACTERISTIC
/begin CHARACTERISTIC DFES_DbLv.DFC_LSUHtrNpl_C "DFES/Entprelllevel zur Erstellung eines DFES Eintrages für Prüfung DFC_LSUHtrNpl" VALUE 0x80029AB6 Val_Wu8 15.00 DFES_OneToOne 0.00 15.00 EXTENDED_LIMITS 0.00 255.0 /end CHARACTERISTIC
/begin CHARACTERISTIC DFES_DbLv.DFC_LSUHtrSig_C "DFES/Entprelllevel zur Erstellung eines DFES Eintrages für Prüfung DFC_LSUHtrSig" VALUE 0x80029AB7 Val_Wu8 15.00 DFES_OneToOne 0.00 15.00 EXTENDED_LIMITS 0.00 255.0 /end CHARACTERISTIC
/begin CHARACTERISTIC DFES_DbLv.DFC_LSUtExcMax_C "DFES/Entprelllevel zur Erstellung eines DFES Eintrages für Prüfung DFC_LSUtExcMax" VALUE 0x80029AB8 Val_Wu8 15.00 DFES_OneToOne 0.00 15.00 EXTENDED_LIMITS 0.00 255.0 /end CHARACTERISTIC
/begin CHARACTERISTIC DFES_DbLv.DFC_LSUtExcMin_C "DFES/Entprelllevel zur Erstellung eines DFES Eintrages für Prüfung DFC_LSUtExcMin" VALUE 0x80029AB9 Val_Wu8 15.00 DFES_OneToOne 0.00 15.00 EXTENDED_LIMITS 0.00 255.0 /end CHARACTERISTIC
/begin CHARACTERISTIC DFES_DbLv.DFC_MeUnOL_C "DFES/Entprelllevel zur Erstellung eines DFES Eintrages für Prüfung DFC_MeUnOL" VALUE 0x80029ABA Val_Wu8 15.00 DFES_OneToOne 0.00 15.00 EXTENDED_LIMITS 0.00 255.0 /end CHARACTERISTIC
/begin CHARACTERISTIC DFES_DbLv.DFC_MeUnSCB_C "DFES/Entprelllevel zur Erstellung eines DFES Eintrages für Prüfung DFC_MeUnSCB" VALUE 0x80029ABB Val_Wu8 15.00 DFES_OneToOne 0.00 15.00 EXTENDED_LIMITS 0.00 255.0 /end CHARACTERISTIC
/begin CHARACTERISTIC DFES_DbLv.DFC_MeUnSRCMax_C "DFES/Entprelllevel zur Erstellung eines DFES Eintrages für Prüfung DFC_MeUnSRCMax" VALUE 0x80029ABC Val_Wu8 15.00 DFES_OneToOne 0.00 15.00 EXTENDED_LIMITS 0.00 255.0 /end CHARACTERISTIC
/begin CHARACTERISTIC DFES_DbLv.DFC_MeUnSRCMin_C "DFES/Entprelllevel zur Erstellung eines DFES Eintrages für Prüfung DFC_MeUnSRCMin" VALUE 0x80029ABD Val_Wu8 15.00 DFES_OneToOne 0.00 15.00 EXTENDED_LIMITS 0.00 255.0 /end CHARACTERISTIC
/begin CHARACTERISTIC DFES_DbLv.DFC_PCVOL_C "DFES/Entprelllevel zur Erstellung eines DFES Eintrages für Prüfung DFC_PCVOL" VALUE 0x80029ABE Val_Wu8 15.00 DFES_OneToOne 0.00 15.00 EXTENDED_LIMITS 0.00 255.0 /end CHARACTERISTIC
/begin CHARACTERISTIC DFES_DbLv.DFC_PCVSCB_C "DFES/Entprelllevel zur Erstellung eines DFES Eintrages für Prüfung DFC_PCVSCB" VALUE 0x80029ABF Val_Wu8 15.00 DFES_OneToOne 0.00 15.00 EXTENDED_LIMITS 0.00 255.0 /end CHARACTERISTIC
/begin CHARACTERISTIC DFES_DbLv.DFC_PCVSRCMax_C "DFES/Entprelllevel zur Erstellung eines DFES Eintrages für Prüfung DFC_PCVSRCMax" VALUE 0x80029AC0 Val_Wu8 15.00 DFES_OneToOne 0.00 15.00 EXTENDED_LIMITS 0.00 255.0 /end CHARACTERISTIC
/begin CHARACTERISTIC DFES_DbLv.DFC_PCVSRCMin_C "DFES/Entprelllevel zur Erstellung eines DFES Eintrages für Prüfung DFC_PCVSRCMin" VALUE 0x80029AC1 Val_Wu8 15.00 DFES_OneToOne 0.00 15.00 EXTENDED_LIMITS 0.00 255.0 /end CHARACTERISTIC
/begin CHARACTERISTIC DFES_DbLv.DFC_RailPSRCMax_C "DFES/Entprelllevel zur Erstellung eines DFES Eintrages für Prüfung DFC_RailPSRCMax" VALUE 0x80029AC2 Val_Wu8 15.00 DFES_OneToOne 0.00 15.00 EXTENDED_LIMITS 0.00 255.0 /end CHARACTERISTIC
/begin CHARACTERISTIC DFES_DbLv.DFC_RailPSRCMin_C "DFES/Entprelllevel zur Erstellung eines DFES Eintrages für Prüfung DFC_RailPSRCMin" VALUE 0x80029AC3 Val_Wu8 15.00 DFES_OneToOne 0.00 15.00 EXTENDED_LIMITS 0.00 255.0 /end CHARACTERISTIC
/begin CHARACTERISTIC DFES_DbLv.DFC_ShtrOL_C "DFES/Entprelllevel zur Erstellung eines DFES Eintrages für Prüfung DFC_ShtrOL" VALUE 0x80029AC4 Val_Wu8 15.00 DFES_OneToOne 0.00 15.00 EXTENDED_LIMITS 0.00 255.0 /end CHARACTERISTIC
/begin CHARACTERISTIC DFES_DbLv.DFC_ShtrOvrTemp_C "DFES/Entprelllevel zur Erstellung eines DFES Eintrages für Prüfung DFC_ShtrOvrTemp" VALUE 0x80029AC5 Val_Wu8 15.00 DFES_OneToOne 0.00 15.00 EXTENDED_LIMITS 0.00 255.0 /end CHARACTERISTIC
/begin CHARACTERISTIC DFES_DbLv.DFC_ShtrSCB_C "DFES/Entprelllevel zur Erstellung eines DFES Eintrages für Prüfung DFC_ShtrSCB" VALUE 0x80029AC6 Val_Wu8 15.00 DFES_OneToOne 0.00 15.00 EXTENDED_LIMITS 0.00 255.0 /end CHARACTERISTIC
/begin CHARACTERISTIC DFES_DbLv.DFC_ShtrSCG_C "DFES/Entprelllevel zur Erstellung eines DFES Eintrages für Prüfung DFC_ShtrSCG" VALUE 0x80029AC7 Val_Wu8 15.00 DFES_OneToOne 0.00 15.00 EXTENDED_LIMITS 0.00 255.0 /end CHARACTERISTIC
/begin CHARACTERISTIC DFES_DbLv.DFC_StrtOL_C "DFES/Entprelllevel zur Erstellung eines DFES Eintrages für Prüfung DFC_StrtOL" VALUE 0x80029AC8 Val_Wu8 15.00 DFES_OneToOne 0.00 15.00 EXTENDED_LIMITS 0.00 255.0 /end CHARACTERISTIC
/begin CHARACTERISTIC DFES_DbLv.DFC_StrtOvrTemp_C "DFES/Entprelllevel zur Erstellung eines DFES Eintrages für Prüfung DFC_StrtOvrTemp" VALUE 0x80029AC9 Val_Wu8 15.00 DFES_OneToOne 0.00 15.00 EXTENDED_LIMITS 0.00 255.0 /end CHARACTERISTIC
/begin CHARACTERISTIC DFES_DbLv.DFC_StrtSCB_C "DFES/Entprelllevel zur Erstellung eines DFES Eintrages für Prüfung DFC_StrtSCB" VALUE 0x80029ACA Val_Wu8 15.00 DFES_OneToOne 0.00 15.00 EXTENDED_LIMITS 0.00 255.0 /end CHARACTERISTIC
/begin CHARACTERISTIC DFES_DbLv.DFC_StrtSCG_C "DFES/Entprelllevel zur Erstellung eines DFES Eintrages für Prüfung DFC_StrtSCG" VALUE 0x80029ACB Val_Wu8 15.00 DFES_OneToOne 0.00 15.00 EXTENDED_LIMITS 0.00 255.0 /end CHARACTERISTIC
/begin CHARACTERISTIC DFES_DbLv.DFC_ThrVlvOL_C "DFES/Entprelllevel zur Erstellung eines DFES Eintrages für Prüfung DFC_ThrVlvOL" VALUE 0x80029ACC Val_Wu8 15.00 DFES_OneToOne 0.00 15.00 EXTENDED_LIMITS 0.00 255.0 /end CHARACTERISTIC
/begin CHARACTERISTIC DFES_DbLv.DFC_ThrVlvOvrTemp_C "DFES/Entprelllevel zur Erstellung eines DFES Eintrages für Prüfung DFC_ThrVlvOvrTemp" VALUE 0x80029ACD Val_Wu8 15.00 DFES_OneToOne 0.00 15.00 EXTENDED_LIMITS 0.00 255.0 /end CHARACTERISTIC
/begin CHARACTERISTIC DFES_DbLv.DFC_ThrVlvSCB_C "DFES/Entprelllevel zur Erstellung eines DFES Eintrages für Prüfung DFC_ThrVlvSCB" VALUE 0x80029ACE Val_Wu8 15.00 DFES_OneToOne 0.00 15.00 EXTENDED_LIMITS 0.00 255.0 /end CHARACTERISTIC
/begin CHARACTERISTIC DFES_DbLv.DFC_TrbChOL_C "DFES/Entprelllevel zur Erstellung eines DFES Eintrages für Prüfung DFC_TrbChOL" VALUE 0x80029ACF Val_Wu8 15.00 DFES_OneToOne 0.00 15.00 EXTENDED_LIMITS 0.00 255.0 /end CHARACTERISTIC
/begin CHARACTERISTIC DFES_DbLv.DFC_TrbChOvrTemp_C "DFES/Entprelllevel zur Erstellung eines DFES Eintrages für Prüfung DFC_TrbChOvrTemp" VALUE 0x80029AD0 Val_Wu8 15.00 DFES_OneToOne 0.00 15.00 EXTENDED_LIMITS 0.00 255.0 /end CHARACTERISTIC
/begin CHARACTERISTIC DFES_DbLv.DFC_TrbChSCB_C "DFES/Entprelllevel zur Erstellung eines DFES Eintrages für Prüfung DFC_TrbChSCB" VALUE 0x80029AD1 Val_Wu8 15.00 DFES_OneToOne 0.00 15.00 EXTENDED_LIMITS 0.00 255.0 /end CHARACTERISTIC
/begin CHARACTERISTIC DFES_DbLv.DFC_UDosVlvOL_C "DFES/Entprelllevel zur Erstellung eines DFES Eintrages für Prüfung DFC_UDosVlvOL" VALUE 0x80029AD2 Val_Wu8 15.00 DFES_OneToOne 0.00 15.00 EXTENDED_LIMITS 0.00 255.0 /end CHARACTERISTIC
/begin CHARACTERISTIC DFES_DbLv.DFC_UDosVlvOvrTemp_C "DFES/Entprelllevel zur Erstellung eines DFES Eintrages für Prüfung DFC_UDosVlvOvrTemp" VALUE 0x80029AD3 Val_Wu8 15.00 DFES_OneToOne 0.00 15.00 EXTENDED_LIMITS 0.00 255.0 /end CHARACTERISTIC
/begin CHARACTERISTIC DFES_DbLv.DFC_UDosVlvSCB_C "DFES/Entprelllevel zur Erstellung eines DFES Eintrages für Prüfung DFC_UDosVlvSCB" VALUE 0x80029AD4 Val_Wu8 15.00 DFES_OneToOne 0.00 15.00 EXTENDED_LIMITS 0.00 255.0 /end CHARACTERISTIC
/begin CHARACTERISTIC DFES_DbLv.DFC_UDosVlvSCG_C "DFES/Entprelllevel zur Erstellung eines DFES Eintrages für Prüfung DFC_UDosVlvSCG" VALUE 0x80029AD5 Val_Wu8 15.00 DFES_OneToOne 0.00 15.00 EXTENDED_LIMITS 0.00 255.0 /end CHARACTERISTIC
/begin CHARACTERISTIC DFES_DbLv.DFC_UPmpMotOL_C "DFES/Entprelllevel zur Erstellung eines DFES Eintrages für Prüfung DFC_UPmpMotOL" VALUE 0x80029AD6 Val_Wu8 15.00 DFES_OneToOne 0.00 15.00 EXTENDED_LIMITS 0.00 255.0 /end CHARACTERISTIC
/begin CHARACTERISTIC DFES_DbLv.DFC_UPmpMotOvrTemp_C "DFES/Entprelllevel zur Erstellung eines DFES Eintrages für Prüfung DFC_UPmpMotOvrTemp" VALUE 0x80029AD7 Val_Wu8 15.00 DFES_OneToOne 0.00 15.00 EXTENDED_LIMITS 0.00 255.0 /end CHARACTERISTIC
/begin CHARACTERISTIC DFES_DbLv.DFC_UPmpMotSCB_C "DFES/Entprelllevel zur Erstellung eines DFES Eintrages für Prüfung DFC_UPmpMotSCB" VALUE 0x80029AD8 Val_Wu8 15.00 DFES_OneToOne 0.00 15.00 EXTENDED_LIMITS 0.00 255.0 /end CHARACTERISTIC
/begin CHARACTERISTIC DFES_DbLv.DFC_UPmpMotSCG_C "DFES/Entprelllevel zur Erstellung eines DFES Eintrages für Prüfung DFC_UPmpMotSCG" VALUE 0x80029AD9 Val_Wu8 15.00 DFES_OneToOne 0.00 15.00 EXTENDED_LIMITS 0.00 255.0 /end CHARACTERISTIC
/begin CHARACTERISTIC DFES_DbLv.DFC_WaHtElOL_C "DFES/Entprelllevel zur Erstellung eines DFES Eintrages für Prüfung DFC_WaHtElOL" VALUE 0x80029ADA Val_Wu8 15.00 DFES_OneToOne 0.00 15.00 EXTENDED_LIMITS 0.00 255.0 /end CHARACTERISTIC
/begin CHARACTERISTIC DFES_DbLv.DFC_WaHtElOvrTemp_C "DFES/Entprelllevel zur Erstellung eines DFES Eintrages für Prüfung DFC_WaHtElOvrTemp" VALUE 0x80029ADB Val_Wu8 15.00 DFES_OneToOne 0.00 15.00 EXTENDED_LIMITS 0.00 255.0 /end CHARACTERISTIC
/begin CHARACTERISTIC DFES_DbLv.DFC_WaHtElSCB_C "DFES/Entprelllevel zur Erstellung eines DFES Eintrages für Prüfung DFC_WaHtElSCB" VALUE 0x80029ADC Val_Wu8 15.00 DFES_OneToOne 0.00 15.00 EXTENDED_LIMITS 0.00 255.0 /end CHARACTERISTIC
/begin CHARACTERISTIC DFES_DbLv.DFC_IVActrUChSRCMax_C "DFES/Entprelllevel zur Erstellung eines DFES Eintrages für Prüfung DFC_IVActrUChSRCMax" VALUE 0x80029ADD Val_Wu8 15.00 DFES_OneToOne 0.00 15.00 EXTENDED_LIMITS 0.00 255.0 /end CHARACTERISTIC
/begin CHARACTERISTIC DFES_DbLv.DFC_IVActrUChSRCMin_C "DFES/Entprelllevel zur Erstellung eines DFES Eintrages für Prüfung DFC_IVActrUChSRCMin" VALUE 0x80029ADE Val_Wu8 15.00 DFES_OneToOne 0.00 15.00 EXTENDED_LIMITS 0.00 255.0 /end CHARACTERISTIC
/begin CHARACTERISTIC DFES_DbLv.DFC_IVActrVltgSRCMax_C "DFES/Entprelllevel zur Erstellung eines DFES Eintrages für Prüfung DFC_IVActrVltgSRCMax" VALUE 0x80029ADF Val_Wu8 15.00 DFES_OneToOne 0.00 15.00 EXTENDED_LIMITS 0.00 255.0 /end CHARACTERISTIC
/begin CHARACTERISTIC DFES_DbLv.DFC_IVActrVltgSRCMin_C "DFES/Entprelllevel zur Erstellung eines DFES Eintrages für Prüfung DFC_IVActrVltgSRCMin" VALUE 0x80029AE0 Val_Wu8 15.00 DFES_OneToOne 0.00 15.00 EXTENDED_LIMITS 0.00 255.0 /end CHARACTERISTIC
/begin CHARACTERISTIC DFES_DbLv.DFC_IVDiaTunDet_C "DFES/Entprelllevel zur Erstellung eines DFES Eintrages für Prüfung DFC_IVDiaTunDet" VALUE 0x80029AE1 Val_Wu8 15.00 DFES_OneToOne 0.00 15.00 EXTENDED_LIMITS 0.00 255.0 /end CHARACTERISTIC
/begin CHARACTERISTIC DFES_DbLv.DFC_IVPSplyStopDCDC_C "DFES/Entprelllevel zur Erstellung eines DFES Eintrages für Prüfung DFC_IVPSplyStopDCDC" VALUE 0x80029AE2 Val_Wu8 15.00 DFES_OneToOne 0.00 15.00 EXTENDED_LIMITS 0.00 255.0 /end CHARACTERISTIC
/begin CHARACTERISTIC DFES_DbLv.DFC_IVPSplyVltgSRCMax_C "DFES/Entprelllevel zur Erstellung eines DFES Eintrages für Prüfung DFC_IVPSplyVltgSRCMax" VALUE 0x80029AE3 Val_Wu8 15.00 DFES_OneToOne 0.00 15.00 EXTENDED_LIMITS 0.00 255.0 /end CHARACTERISTIC
/begin CHARACTERISTIC DFES_DbLv.DFC_IVPSplyVltgSRCMin_C "DFES/Entprelllevel zur Erstellung eines DFES Eintrages für Prüfung DFC_IVPSplyVltgSRCMin" VALUE 0x80029AE4 Val_Wu8 15.00 DFES_OneToOne 0.00 15.00 EXTENDED_LIMITS 0.00 255.0 /end CHARACTERISTIC
/begin CHARACTERISTIC DFES_DbLv.DFC_SCREtaErr_C "DFES/Entprelllevel zur Erstellung eines DFES Eintrages für Prüfung DFC_SCREtaErr" VALUE 0x80029AE5 Val_Wu8 15.00 DFES_OneToOne 0.00 15.00 EXTENDED_LIMITS 0.00 255.0 /end CHARACTERISTIC
/begin CHARACTERISTIC DFES_DbLv.DFC_SCREtaErr1_C "DFES/Entprelllevel zur Erstellung eines DFES Eintrages für Prüfung DFC_SCREtaErr1" VALUE 0x80029AE6 Val_Wu8 15.00 DFES_OneToOne 0.00 15.00 EXTENDED_LIMITS 0.00 255.0 /end CHARACTERISTIC
/begin CHARACTERISTIC DFES_DbLv.DFC_SCREtaErr2_C "DFES/Entprelllevel zur Erstellung eines DFES Eintrages für Prüfung DFC_SCREtaErr2" VALUE 0x80029AE7 Val_Wu8 15.00 DFES_OneToOne 0.00 15.00 EXTENDED_LIMITS 0.00 255.0 /end CHARACTERISTIC
/begin CHARACTERISTIC DFES_DbLv.DFC_SCRMonMetCtlPresErr_C "DFES/Entprelllevel zur Erstellung eines DFES Eintrages für Prüfung DFC_SCRMonMetCtlPresErr" VALUE 0x80029AE8 Val_Wu8 15.00 DFES_OneToOne 0.00 15.00 EXTENDED_LIMITS 0.00 255.0 /end CHARACTERISTIC
/begin CHARACTERISTIC DFES_DbLv.DFC_SCRMonPresBuildUpErr_C "DFES/Entprelllevel zur Erstellung eines DFES Eintrages für Prüfung DFC_SCRMonPresBuildUpErr" VALUE 0x80029AE9 Val_Wu8 15.00 DFES_OneToOne 0.00 15.00 EXTENDED_LIMITS 0.00 255.0 /end CHARACTERISTIC
/begin CHARACTERISTIC DFES_DbLv.DFC_SCRMonPresRdcErr_C "DFES/Entprelllevel zur Erstellung eines DFES Eintrages für Prüfung DFC_SCRMonPresRdcErr" VALUE 0x80029AEA Val_Wu8 15.00 DFES_OneToOne 0.00 15.00 EXTENDED_LIMITS 0.00 255.0 /end CHARACTERISTIC
/begin CHARACTERISTIC DFES_DbLv.DFC_AFSOffsDrftMax_C "DFES/Entprelllevel zur Erstellung eines DFES Eintrages für Prüfung DFC_AFSOffsDrftMax" VALUE 0x80029AEB Val_Wu8 15.00 DFES_OneToOne 0.00 15.00 EXTENDED_LIMITS 0.00 255.0 /end CHARACTERISTIC
/begin CHARACTERISTIC DFES_DbLv.DFC_AFSOffsDrftMin_C "DFES/Entprelllevel zur Erstellung eines DFES Eintrages für Prüfung DFC_AFSOffsDrftMin" VALUE 0x80029AEC Val_Wu8 15.00 DFES_OneToOne 0.00 15.00 EXTENDED_LIMITS 0.00 255.0 /end CHARACTERISTIC
/begin CHARACTERISTIC DFES_DbLv.DFC_AFSSRCCorMax_C "DFES/Entprelllevel zur Erstellung eines DFES Eintrages für Prüfung DFC_AFSSRCCorMax" VALUE 0x80029AED Val_Wu8 15.00 DFES_OneToOne 0.00 15.00 EXTENDED_LIMITS 0.00 255.0 /end CHARACTERISTIC
/begin CHARACTERISTIC DFES_DbLv.DFC_AFSSRCCorMin_C "DFES/Entprelllevel zur Erstellung eines DFES Eintrages für Prüfung DFC_AFSSRCCorMin" VALUE 0x80029AEE Val_Wu8 15.00 DFES_OneToOne 0.00 15.00 EXTENDED_LIMITS 0.00 255.0 /end CHARACTERISTIC
/begin CHARACTERISTIC DFES_DbLv.DFC_AFSSRCRawMax_C "DFES/Entprelllevel zur Erstellung eines DFES Eintrages für Prüfung DFC_AFSSRCRawMax" VALUE 0x80029AEF Val_Wu8 15.00 DFES_OneToOne 0.00 15.00 EXTENDED_LIMITS 0.00 255.0 /end CHARACTERISTIC
/begin CHARACTERISTIC DFES_DbLv.DFC_AFSSRCRawMin_C "DFES/Entprelllevel zur Erstellung eines DFES Eintrages für Prüfung DFC_AFSSRCRawMin" VALUE 0x80029AF0 Val_Wu8 15.00 DFES_OneToOne 0.00 15.00 EXTENDED_LIMITS 0.00 255.0 /end CHARACTERISTIC
/begin CHARACTERISTIC DFES_DbLv.DFC_AFSSetyDrftMax_C "DFES/Entprelllevel zur Erstellung eines DFES Eintrages für Prüfung DFC_AFSSetyDrftMax" VALUE 0x80029AF1 Val_Wu8 15.00 DFES_OneToOne 0.00 15.00 EXTENDED_LIMITS 0.00 255.0 /end CHARACTERISTIC
/begin CHARACTERISTIC DFES_DbLv.DFC_AFSSetyDrftMin_C "DFES/Entprelllevel zur Erstellung eines DFES Eintrages für Prüfung DFC_AFSSetyDrftMin" VALUE 0x80029AF2 Val_Wu8 15.00 DFES_OneToOne 0.00 15.00 EXTENDED_LIMITS 0.00 255.0 /end CHARACTERISTIC
/begin CHARACTERISTIC DFES_DbLv.DFC_AirCSwtNpl_C "DFES/Entprelllevel zur Erstellung eines DFES Eintrages für Prüfung DFC_AirCSwtNpl" VALUE 0x80029AF3 Val_Wu8 15.00 DFES_OneToOne 0.00 15.00 EXTENDED_LIMITS 0.00 255.0 /end CHARACTERISTIC
/begin CHARACTERISTIC DFES_DbLv.DFC_AirCSwtSig_C "DFES/Entprelllevel zur Erstellung eines DFES Eintrages für Prüfung DFC_AirCSwtSig" VALUE 0x80029AF4 Val_Wu8 15.00 DFES_OneToOne 0.00 15.00 EXTENDED_LIMITS 0.00 255.0 /end CHARACTERISTIC
/begin CHARACTERISTIC DFES_DbLv.DFC_BattUSRCMax_C "DFES/Entprelllevel zur Erstellung eines DFES Eintrages für Prüfung DFC_BattUSRCMax" VALUE 0x80029AF5 Val_Wu8 15.00 DFES_OneToOne 0.00 15.00 EXTENDED_LIMITS 0.00 255.0 /end CHARACTERISTIC
/begin CHARACTERISTIC DFES_DbLv.DFC_BattUSRCMin_C "DFES/Entprelllevel zur Erstellung eines DFES Eintrages für Prüfung DFC_BattUSRCMin" VALUE 0x80029AF6 Val_Wu8 15.00 DFES_OneToOne 0.00 15.00 EXTENDED_LIMITS 0.00 255.0 /end CHARACTERISTIC
/begin CHARACTERISTIC DFES_DbLv.DFC_BrkNpl_C "DFES/Entprelllevel zur Erstellung eines DFES Eintrages für Prüfung DFC_BrkNpl" VALUE 0x80029AF7 Val_Wu8 15.00 DFES_OneToOne 0.00 15.00 EXTENDED_LIMITS 0.00 255.0 /end CHARACTERISTIC
/begin CHARACTERISTIC DFES_DbLv.DFC_BrkPSRCMax_C "DFES/Entprelllevel zur Erstellung eines DFES Eintrages für Prüfung DFC_BrkPSRCMax" VALUE 0x80029AF8 Val_Wu8 15.00 DFES_OneToOne 0.00 15.00 EXTENDED_LIMITS 0.00 255.0 /end CHARACTERISTIC
/begin CHARACTERISTIC DFES_DbLv.DFC_BrkPSRCMin_C "DFES/Entprelllevel zur Erstellung eines DFES Eintrages für Prüfung DFC_BrkPSRCMin" VALUE 0x80029AF9 Val_Wu8 15.00 DFES_OneToOne 0.00 15.00 EXTENDED_LIMITS 0.00 255.0 /end CHARACTERISTIC
/begin CHARACTERISTIC DFES_DbLv.DFC_CEngDsTSRCMax_C "DFES/Entprelllevel zur Erstellung eines DFES Eintrages für Prüfung DFC_CEngDsTSRCMax" VALUE 0x80029AFA Val_Wu8 15.00 DFES_OneToOne 0.00 15.00 EXTENDED_LIMITS 0.00 255.0 /end CHARACTERISTIC
/begin CHARACTERISTIC DFES_DbLv.DFC_CEngDsTSRCMin_C "DFES/Entprelllevel zur Erstellung eines DFES Eintrages für Prüfung DFC_CEngDsTSRCMin" VALUE 0x80029AFB Val_Wu8 15.00 DFES_OneToOne 0.00 15.00 EXTENDED_LIMITS 0.00 255.0 /end CHARACTERISTIC
/begin CHARACTERISTIC DFES_DbLv.DFC_CrCUIDet_C "DFES/Entprelllevel zur Erstellung eines DFES Eintrages für Prüfung DFC_CrCUIDet" VALUE 0x80029AFC Val_Wu8 15.00 DFES_OneToOne 0.00 15.00 EXTENDED_LIMITS 0.00 255.0 /end CHARACTERISTIC
/begin CHARACTERISTIC DFES_DbLv.DFC_ECBVlvSRCMax_C "DFES/Entprelllevel zur Erstellung eines DFES Eintrages für Prüfung DFC_ECBVlvSRCMax" VALUE 0x80029AFD Val_Wu8 15.00 DFES_OneToOne 0.00 15.00 EXTENDED_LIMITS 0.00 255.0 /end CHARACTERISTIC
/begin CHARACTERISTIC DFES_DbLv.DFC_ECBVlvSRCMin_C "DFES/Entprelllevel zur Erstellung eines DFES Eintrages für Prüfung DFC_ECBVlvSRCMin" VALUE 0x80029AFE Val_Wu8 15.00 DFES_OneToOne 0.00 15.00 EXTENDED_LIMITS 0.00 255.0 /end CHARACTERISTIC
/begin CHARACTERISTIC DFES_DbLv.DFC_ECUOvrTemp_C "DFES/Entprelllevel zur Erstellung eines DFES Eintrages für Prüfung DFC_ECUOvrTemp" VALUE 0x80029AFF Val_Wu8 15.00 DFES_OneToOne 0.00 15.00 EXTENDED_LIMITS 0.00 255.0 /end CHARACTERISTIC
/begin CHARACTERISTIC DFES_DbLv.DFC_EGRVlvGovDvtMax_C "DFES/Entprelllevel zur Erstellung eines DFES Eintrages für Prüfung DFC_EGRVlvGovDvtMax" VALUE 0x80029B00 Val_Wu8 15.00 DFES_OneToOne 0.00 15.00 EXTENDED_LIMITS 0.00 255.0 /end CHARACTERISTIC
/begin CHARACTERISTIC DFES_DbLv.DFC_EGRVlvGovDvtMin_C "DFES/Entprelllevel zur Erstellung eines DFES Eintrages für Prüfung DFC_EGRVlvGovDvtMin" VALUE 0x80029B01 Val_Wu8 15.00 DFES_OneToOne 0.00 15.00 EXTENDED_LIMITS 0.00 255.0 /end CHARACTERISTIC
/begin CHARACTERISTIC DFES_DbLv.DFC_EGRVlvHBrgOpnLd_C "DFES/Entprelllevel zur Erstellung eines DFES Eintrages für Prüfung DFC_EGRVlvHBrgOpnLd" VALUE 0x80029B02 Val_Wu8 15.00 DFES_OneToOne 0.00 15.00 EXTENDED_LIMITS 0.00 255.0 /end CHARACTERISTIC
/begin CHARACTERISTIC DFES_DbLv.DFC_EGRVlvHBrgOvrCurr_C "DFES/Entprelllevel zur Erstellung eines DFES Eintrages für Prüfung DFC_EGRVlvHBrgOvrCurr" VALUE 0x80029B03 Val_Wu8 15.00 DFES_OneToOne 0.00 15.00 EXTENDED_LIMITS 0.00 255.0 /end CHARACTERISTIC
/begin CHARACTERISTIC DFES_DbLv.DFC_EGRVlvHBrgOvrTemp_C "DFES/Entprelllevel zur Erstellung eines DFES Eintrages für Prüfung DFC_EGRVlvHBrgOvrTemp" VALUE 0x80029B04 Val_Wu8 15.00 DFES_OneToOne 0.00 15.00 EXTENDED_LIMITS 0.00 255.0 /end CHARACTERISTIC
/begin CHARACTERISTIC DFES_DbLv.DFC_EGRVlvHBrgShCirBatt1_C "DFES/Entprelllevel zur Erstellung eines DFES Eintrages für Prüfung DFC_EGRVlvHBrgShCirBatt1" VALUE 0x80029B05 Val_Wu8 15.00 DFES_OneToOne 0.00 15.00 EXTENDED_LIMITS 0.00 255.0 /end CHARACTERISTIC
/begin CHARACTERISTIC DFES_DbLv.DFC_EGRVlvHBrgShCirBatt2_C "DFES/Entprelllevel zur Erstellung eines DFES Eintrages für Prüfung DFC_EGRVlvHBrgShCirBatt2" VALUE 0x80029B06 Val_Wu8 15.00 DFES_OneToOne 0.00 15.00 EXTENDED_LIMITS 0.00 255.0 /end CHARACTERISTIC
/begin CHARACTERISTIC DFES_DbLv.DFC_EGRVlvHBrgShCirGnd1_C "DFES/Entprelllevel zur Erstellung eines DFES Eintrages für Prüfung DFC_EGRVlvHBrgShCirGnd1" VALUE 0x80029B07 Val_Wu8 15.00 DFES_OneToOne 0.00 15.00 EXTENDED_LIMITS 0.00 255.0 /end CHARACTERISTIC
/begin CHARACTERISTIC DFES_DbLv.DFC_EGRVlvHBrgShCirGnd2_C "DFES/Entprelllevel zur Erstellung eines DFES Eintrages für Prüfung DFC_EGRVlvHBrgShCirGnd2" VALUE 0x80029B08 Val_Wu8 15.00 DFES_OneToOne 0.00 15.00 EXTENDED_LIMITS 0.00 255.0 /end CHARACTERISTIC
/begin CHARACTERISTIC DFES_DbLv.DFC_EGRVlvHBrgShCirOvrLd_C "DFES/Entprelllevel zur Erstellung eines DFES Eintrages für Prüfung DFC_EGRVlvHBrgShCirOvrLd" VALUE 0x80029B09 Val_Wu8 15.00 DFES_OneToOne 0.00 15.00 EXTENDED_LIMITS 0.00 255.0 /end CHARACTERISTIC
/begin CHARACTERISTIC DFES_DbLv.DFC_EGRVlvHBrgTempOvrCurr_C "DFES/Entprelllevel zur Erstellung eines DFES Eintrages für Prüfung DFC_EGRVlvHBrgTempOvrCurr" VALUE 0x80029B0A Val_Wu8 15.00 DFES_OneToOne 0.00 15.00 EXTENDED_LIMITS 0.00 255.0 /end CHARACTERISTIC
/begin CHARACTERISTIC DFES_DbLv.DFC_EGRVlvHBrgUndrVltg_C "DFES/Entprelllevel zur Erstellung eines DFES Eintrages für Prüfung DFC_EGRVlvHBrgUndrVltg" VALUE 0x80029B0B Val_Wu8 15.00 DFES_OneToOne 0.00 15.00 EXTENDED_LIMITS 0.00 255.0 /end CHARACTERISTIC
/begin CHARACTERISTIC DFES_DbLv.DFC_EGRVlvLPGovDvtMax_C "DFES/Entprelllevel zur Erstellung eines DFES Eintrages für Prüfung DFC_EGRVlvLPGovDvtMax" VALUE 0x80029B0C Val_Wu8 15.00 DFES_OneToOne 0.00 15.00 EXTENDED_LIMITS 0.00 255.0 /end CHARACTERISTIC
/begin CHARACTERISTIC DFES_DbLv.DFC_EGRVlvLPGovDvtMin_C "DFES/Entprelllevel zur Erstellung eines DFES Eintrages für Prüfung DFC_EGRVlvLPGovDvtMin" VALUE 0x80029B0D Val_Wu8 15.00 DFES_OneToOne 0.00 15.00 EXTENDED_LIMITS 0.00 255.0 /end CHARACTERISTIC
/begin CHARACTERISTIC DFES_DbLv.DFC_EGRVlvLPHBrgOpnLd_C "DFES/Entprelllevel zur Erstellung eines DFES Eintrages für Prüfung DFC_EGRVlvLPHBrgOpnLd" VALUE 0x80029B0E Val_Wu8 15.00 DFES_OneToOne 0.00 15.00 EXTENDED_LIMITS 0.00 255.0 /end CHARACTERISTIC
/begin CHARACTERISTIC DFES_DbLv.DFC_EGRVlvLPHBrgOvrCurr_C "DFES/Entprelllevel zur Erstellung eines DFES Eintrages für Prüfung DFC_EGRVlvLPHBrgOvrCurr" VALUE 0x80029B0F Val_Wu8 15.00 DFES_OneToOne 0.00 15.00 EXTENDED_LIMITS 0.00 255.0 /end CHARACTERISTIC
/begin CHARACTERISTIC DFES_DbLv.DFC_EGRVlvLPHBrgOvrTemp_C "DFES/Entprelllevel zur Erstellung eines DFES Eintrages für Prüfung DFC_EGRVlvLPHBrgOvrTemp" VALUE 0x80029B10 Val_Wu8 15.00 DFES_OneToOne 0.00 15.00 EXTENDED_LIMITS 0.00 255.0 /end CHARACTERISTIC
/begin CHARACTERISTIC DFES_DbLv.DFC_EGRVlvLPHBrgShCirBatt1_C "DFES/Entprelllevel zur Erstellung eines DFES Eintrages für Prüfung DFC_EGRVlvLPHBrgShCirBatt1" VALUE 0x80029B11 Val_Wu8 15.00 DFES_OneToOne 0.00 15.00 EXTENDED_LIMITS 0.00 255.0 /end CHARACTERISTIC
/begin CHARACTERISTIC DFES_DbLv.DFC_EGRVlvLPHBrgShCirBatt2_C "DFES/Entprelllevel zur Erstellung eines DFES Eintrages für Prüfung DFC_EGRVlvLPHBrgShCirBatt2" VALUE 0x80029B12 Val_Wu8 15.00 DFES_OneToOne 0.00 15.00 EXTENDED_LIMITS 0.00 255.0 /end CHARACTERISTIC
/begin CHARACTERISTIC DFES_DbLv.DFC_EGRVlvLPHBrgShCirGnd1_C "DFES/Entprelllevel zur Erstellung eines DFES Eintrages für Prüfung DFC_EGRVlvLPHBrgShCirGnd1" VALUE 0x80029B13 Val_Wu8 15.00 DFES_OneToOne 0.00 15.00 EXTENDED_LIMITS 0.00 255.0 /end CHARACTERISTIC
/begin CHARACTERISTIC DFES_DbLv.DFC_EGRVlvLPHBrgShCirGnd2_C "DFES/Entprelllevel zur Erstellung eines DFES Eintrages für Prüfung DFC_EGRVlvLPHBrgShCirGnd2" VALUE 0x80029B14 Val_Wu8 15.00 DFES_OneToOne 0.00 15.00 EXTENDED_LIMITS 0.00 255.0 /end CHARACTERISTIC
/begin CHARACTERISTIC DFES_DbLv.DFC_EGRVlvLPHBrgShCirOvrLd_C "DFES/Entprelllevel zur Erstellung eines DFES Eintrages für Prüfung DFC_EGRVlvLPHBrgShCirOvrLd" VALUE 0x80029B15 Val_Wu8 15.00 DFES_OneToOne 0.00 15.00 EXTENDED_LIMITS 0.00 255.0 /end CHARACTERISTIC
/begin CHARACTERISTIC DFES_DbLv.DFC_EGRVlvLPHBrgTempOvrCurr_C "DFES/Entprelllevel zur Erstellung eines DFES Eintrages für Prüfung DFC_EGRVlvLPHBrgTempOvrCurr" VALUE 0x80029B16 Val_Wu8 15.00 DFES_OneToOne 0.00 15.00 EXTENDED_LIMITS 0.00 255.0 /end CHARACTERISTIC
/begin CHARACTERISTIC DFES_DbLv.DFC_EGRVlvLPHBrgUndrVltg_C "DFES/Entprelllevel zur Erstellung eines DFES Eintrages für Prüfung DFC_EGRVlvLPHBrgUndrVltg" VALUE 0x80029B17 Val_Wu8 15.00 DFES_OneToOne 0.00 15.00 EXTENDED_LIMITS 0.00 255.0 /end CHARACTERISTIC
/begin CHARACTERISTIC DFES_DbLv.DFC_EGRVlvLPOL_C "DFES/Entprelllevel zur Erstellung eines DFES Eintrages für Prüfung DFC_EGRVlvLPOL" VALUE 0x80029B18 Val_Wu8 15.00 DFES_OneToOne 0.00 15.00 EXTENDED_LIMITS 0.00 255.0 /end CHARACTERISTIC
/begin CHARACTERISTIC DFES_DbLv.DFC_EGRVlvLPSCB_C "DFES/Entprelllevel zur Erstellung eines DFES Eintrages für Prüfung DFC_EGRVlvLPSCB" VALUE 0x80029B19 Val_Wu8 15.00 DFES_OneToOne 0.00 15.00 EXTENDED_LIMITS 0.00 255.0 /end CHARACTERISTIC
/begin CHARACTERISTIC DFES_DbLv.DFC_EGRVlvLPSCG_C "DFES/Entprelllevel zur Erstellung eines DFES Eintrages für Prüfung DFC_EGRVlvLPSCG" VALUE 0x80029B1A Val_Wu8 15.00 DFES_OneToOne 0.00 15.00 EXTENDED_LIMITS 0.00 255.0 /end CHARACTERISTIC
/begin CHARACTERISTIC DFES_DbLv.DFC_EGRVlvLPSRCMax_C "DFES/Entprelllevel zur Erstellung eines DFES Eintrages für Prüfung DFC_EGRVlvLPSRCMax" VALUE 0x80029B1B Val_Wu8 15.00 DFES_OneToOne 0.00 15.00 EXTENDED_LIMITS 0.00 255.0 /end CHARACTERISTIC
/begin CHARACTERISTIC DFES_DbLv.DFC_EGRVlvLPSRCMin_C "DFES/Entprelllevel zur Erstellung eines DFES Eintrages für Prüfung DFC_EGRVlvLPSRCMin" VALUE 0x80029B1C Val_Wu8 15.00 DFES_OneToOne 0.00 15.00 EXTENDED_LIMITS 0.00 255.0 /end CHARACTERISTIC
/begin CHARACTERISTIC DFES_DbLv.DFC_EGRVlvOL_C "DFES/Entprelllevel zur Erstellung eines DFES Eintrages für Prüfung DFC_EGRVlvOL" VALUE 0x80029B1D Val_Wu8 15.00 DFES_OneToOne 0.00 15.00 EXTENDED_LIMITS 0.00 255.0 /end CHARACTERISTIC
/begin CHARACTERISTIC DFES_DbLv.DFC_EGRVlvSCB_C "DFES/Entprelllevel zur Erstellung eines DFES Eintrages für Prüfung DFC_EGRVlvSCB" VALUE 0x80029B1E Val_Wu8 15.00 DFES_OneToOne 0.00 15.00 EXTENDED_LIMITS 0.00 255.0 /end CHARACTERISTIC
/begin CHARACTERISTIC DFES_DbLv.DFC_EGRVlvSCG_C "DFES/Entprelllevel zur Erstellung eines DFES Eintrages für Prüfung DFC_EGRVlvSCG" VALUE 0x80029B1F Val_Wu8 15.00 DFES_OneToOne 0.00 15.00 EXTENDED_LIMITS 0.00 255.0 /end CHARACTERISTIC
/begin CHARACTERISTIC DFES_DbLv.DFC_EGRVlvSRCMax_C "DFES/Entprelllevel zur Erstellung eines DFES Eintrages für Prüfung DFC_EGRVlvSRCMax" VALUE 0x80029B20 Val_Wu8 15.00 DFES_OneToOne 0.00 15.00 EXTENDED_LIMITS 0.00 255.0 /end CHARACTERISTIC
/begin CHARACTERISTIC DFES_DbLv.DFC_EGRVlvSRCMin_C "DFES/Entprelllevel zur Erstellung eines DFES Eintrages für Prüfung DFC_EGRVlvSRCMin" VALUE 0x80029B21 Val_Wu8 15.00 DFES_OneToOne 0.00 15.00 EXTENDED_LIMITS 0.00 255.0 /end CHARACTERISTIC
/begin CHARACTERISTIC DFES_DbLv.DFC_EngPrtOvrSpd_C "DFES/Entprelllevel zur Erstellung eines DFES Eintrages für Prüfung DFC_EngPrtOvrSpd" VALUE 0x80029B22 Val_Wu8 15.00 DFES_OneToOne 0.00 15.00 EXTENDED_LIMITS 0.00 255.0 /end CHARACTERISTIC
/begin CHARACTERISTIC DFES_DbLv.DFC_EngSpdOL_C "DFES/Entprelllevel zur Erstellung eines DFES Eintrages für Prüfung DFC_EngSpdOL" VALUE 0x80029B23 Val_Wu8 15.00 DFES_OneToOne 0.00 15.00 EXTENDED_LIMITS 0.00 255.0 /end CHARACTERISTIC
/begin CHARACTERISTIC DFES_DbLv.DFC_EngSpdSCB_C "DFES/Entprelllevel zur Erstellung eines DFES Eintrages für Prüfung DFC_EngSpdSCB" VALUE 0x80029B24 Val_Wu8 15.00 DFES_OneToOne 0.00 15.00 EXTENDED_LIMITS 0.00 255.0 /end CHARACTERISTIC
/begin CHARACTERISTIC DFES_DbLv.DFC_EngSpdSCG_C "DFES/Entprelllevel zur Erstellung eines DFES Eintrages für Prüfung DFC_EngSpdSCG" VALUE 0x80029B25 Val_Wu8 15.00 DFES_OneToOne 0.00 15.00 EXTENDED_LIMITS 0.00 255.0 /end CHARACTERISTIC
/begin CHARACTERISTIC DFES_DbLv.DFC_EnhSRCMaxPPFltDiff_C "DFES/Entprelllevel zur Erstellung eines DFES Eintrages für Prüfung DFC_EnhSRCMaxPPFltDiff" VALUE 0x80029B26 Val_Wu8 15.00 DFES_OneToOne 0.00 15.00 EXTENDED_LIMITS 0.00 255.0 /end CHARACTERISTIC
/begin CHARACTERISTIC DFES_DbLv.DFC_EnhSRCMaxT1ExhTMon_C "DFES/Entprelllevel zur Erstellung eines DFES Eintrages für Prüfung DFC_EnhSRCMaxT1ExhTMon" VALUE 0x80029B27 Val_Wu8 15.00 DFES_OneToOne 0.00 15.00 EXTENDED_LIMITS 0.00 255.0 /end CHARACTERISTIC
/begin CHARACTERISTIC DFES_DbLv.DFC_EnhSRCMaxT2ExhTMon_C "DFES/Entprelllevel zur Erstellung eines DFES Eintrages für Prüfung DFC_EnhSRCMaxT2ExhTMon" VALUE 0x80029B28 Val_Wu8 15.00 DFES_OneToOne 0.00 15.00 EXTENDED_LIMITS 0.00 255.0 /end CHARACTERISTIC
/begin CHARACTERISTIC DFES_DbLv.DFC_EnhSRCMaxT3ExhTMon_C "DFES/Entprelllevel zur Erstellung eines DFES Eintrages für Prüfung DFC_EnhSRCMaxT3ExhTMon" VALUE 0x80029B29 Val_Wu8 15.00 DFES_OneToOne 0.00 15.00 EXTENDED_LIMITS 0.00 255.0 /end CHARACTERISTIC
/begin CHARACTERISTIC DFES_DbLv.DFC_EnhSRCMinPPFltDiff_C "DFES/Entprelllevel zur Erstellung eines DFES Eintrages für Prüfung DFC_EnhSRCMinPPFltDiff" VALUE 0x80029B2A Val_Wu8 15.00 DFES_OneToOne 0.00 15.00 EXTENDED_LIMITS 0.00 255.0 /end CHARACTERISTIC
/begin CHARACTERISTIC DFES_DbLv.DFC_EnhSRCMinT1ExhTMon_C "DFES/Entprelllevel zur Erstellung eines DFES Eintrages für Prüfung DFC_EnhSRCMinT1ExhTMon" VALUE 0x80029B2B Val_Wu8 15.00 DFES_OneToOne 0.00 15.00 EXTENDED_LIMITS 0.00 255.0 /end CHARACTERISTIC
/begin CHARACTERISTIC DFES_DbLv.DFC_EnhSRCMinT2ExhTMon_C "DFES/Entprelllevel zur Erstellung eines DFES Eintrages für Prüfung DFC_EnhSRCMinT2ExhTMon" VALUE 0x80029B2C Val_Wu8 15.00 DFES_OneToOne 0.00 15.00 EXTENDED_LIMITS 0.00 255.0 /end CHARACTERISTIC
/begin CHARACTERISTIC DFES_DbLv.DFC_EnhSRCMinT3ExhTMon_C "DFES/Entprelllevel zur Erstellung eines DFES Eintrages für Prüfung DFC_EnhSRCMinT3ExhTMon" VALUE 0x80029B2D Val_Wu8 15.00 DFES_OneToOne 0.00 15.00 EXTENDED_LIMITS 0.00 255.0 /end CHARACTERISTIC
/begin CHARACTERISTIC DFES_DbLv.DFC_EnvPSRCMax_C "DFES/Entprelllevel zur Erstellung eines DFES Eintrages für Prüfung DFC_EnvPSRCMax" VALUE 0x80029B2E Val_Wu8 15.00 DFES_OneToOne 0.00 15.00 EXTENDED_LIMITS 0.00 255.0 /end CHARACTERISTIC
/begin CHARACTERISTIC DFES_DbLv.DFC_EnvPSRCMin_C "DFES/Entprelllevel zur Erstellung eines DFES Eintrages für Prüfung DFC_EnvPSRCMin" VALUE 0x80029B2F Val_Wu8 15.00 DFES_OneToOne 0.00 15.00 EXTENDED_LIMITS 0.00 255.0 /end CHARACTERISTIC
/begin CHARACTERISTIC DFES_DbLv.DFC_ExhTMonPlaus_C "DFES/Entprelllevel zur Erstellung eines DFES Eintrages für Prüfung DFC_ExhTMonPlaus" VALUE 0x80029B30 Val_Wu8 15.00 DFES_OneToOne 0.00 15.00 EXTENDED_LIMITS 0.00 255.0 /end CHARACTERISTIC
/begin CHARACTERISTIC DFES_DbLv.DFC_ExhTMonPlausPos1_C "DFES/Entprelllevel zur Erstellung eines DFES Eintrages für Prüfung DFC_ExhTMonPlausPos1" VALUE 0x80029B31 Val_Wu8 15.00 DFES_OneToOne 0.00 15.00 EXTENDED_LIMITS 0.00 255.0 /end CHARACTERISTIC
/begin CHARACTERISTIC DFES_DbLv.DFC_ExhTMonPlausPos2_C "DFES/Entprelllevel zur Erstellung eines DFES Eintrages für Prüfung DFC_ExhTMonPlausPos2" VALUE 0x80029B32 Val_Wu8 15.00 DFES_OneToOne 0.00 15.00 EXTENDED_LIMITS 0.00 255.0 /end CHARACTERISTIC
/begin CHARACTERISTIC DFES_DbLv.DFC_ExhTMonPlausPos3_C "DFES/Entprelllevel zur Erstellung eines DFES Eintrages für Prüfung DFC_ExhTMonPlausPos3" VALUE 0x80029B33 Val_Wu8 15.00 DFES_OneToOne 0.00 15.00 EXTENDED_LIMITS 0.00 255.0 /end CHARACTERISTIC
/begin CHARACTERISTIC DFES_DbLv.DFC_ExhTMonT1Plaus_C "DFES/Entprelllevel zur Erstellung eines DFES Eintrages für Prüfung DFC_ExhTMonT1Plaus" VALUE 0x80029B34 Val_Wu8 15.00 DFES_OneToOne 0.00 15.00 EXTENDED_LIMITS 0.00 255.0 /end CHARACTERISTIC
/begin CHARACTERISTIC DFES_DbLv.DFC_ExhTMonT2Plaus_C "DFES/Entprelllevel zur Erstellung eines DFES Eintrages für Prüfung DFC_ExhTMonT2Plaus" VALUE 0x80029B35 Val_Wu8 15.00 DFES_OneToOne 0.00 15.00 EXTENDED_LIMITS 0.00 255.0 /end CHARACTERISTIC
/begin CHARACTERISTIC DFES_DbLv.DFC_ExhTMonT3Plaus_C "DFES/Entprelllevel zur Erstellung eines DFES Eintrages für Prüfung DFC_ExhTMonT3Plaus" VALUE 0x80029B36 Val_Wu8 15.00 DFES_OneToOne 0.00 15.00 EXTENDED_LIMITS 0.00 255.0 /end CHARACTERISTIC
/begin CHARACTERISTIC DFES_DbLv.DFC_FlFltDsPSRCMax_C "DFES/Entprelllevel zur Erstellung eines DFES Eintrages für Prüfung DFC_FlFltDsPSRCMax" VALUE 0x80029B37 Val_Wu8 15.00 DFES_OneToOne 0.00 15.00 EXTENDED_LIMITS 0.00 255.0 /end CHARACTERISTIC
/begin CHARACTERISTIC DFES_DbLv.DFC_FlFltDsPSRCMin_C "DFES/Entprelllevel zur Erstellung eines DFES Eintrages für Prüfung DFC_FlFltDsPSRCMin" VALUE 0x80029B38 Val_Wu8 15.00 DFES_OneToOne 0.00 15.00 EXTENDED_LIMITS 0.00 255.0 /end CHARACTERISTIC
/begin CHARACTERISTIC DFES_DbLv.DFC_FlFltSig_C "DFES/Entprelllevel zur Erstellung eines DFES Eintrages für Prüfung DFC_FlFltSig" VALUE 0x80029B39 Val_Wu8 15.00 DFES_OneToOne 0.00 15.00 EXTENDED_LIMITS 0.00 255.0 /end CHARACTERISTIC
/begin CHARACTERISTIC DFES_DbLv.DFC_FlFltUsPSRCMax_C "DFES/Entprelllevel zur Erstellung eines DFES Eintrages für Prüfung DFC_FlFltUsPSRCMax" VALUE 0x80029B3A Val_Wu8 15.00 DFES_OneToOne 0.00 15.00 EXTENDED_LIMITS 0.00 255.0 /end CHARACTERISTIC
/begin CHARACTERISTIC DFES_DbLv.DFC_FlFltUsPSRCMin_C "DFES/Entprelllevel zur Erstellung eines DFES Eintrages für Prüfung DFC_FlFltUsPSRCMin" VALUE 0x80029B3B Val_Wu8 15.00 DFES_OneToOne 0.00 15.00 EXTENDED_LIMITS 0.00 255.0 /end CHARACTERISTIC
/begin CHARACTERISTIC DFES_DbLv.DFC_FuelTSRCMax_C "DFES/Entprelllevel zur Erstellung eines DFES Eintrages für Prüfung DFC_FuelTSRCMax" VALUE 0x80029B3C Val_Wu8 15.00 DFES_OneToOne 0.00 15.00 EXTENDED_LIMITS 0.00 255.0 /end CHARACTERISTIC
/begin CHARACTERISTIC DFES_DbLv.DFC_FuelTSRCMin_C "DFES/Entprelllevel zur Erstellung eines DFES Eintrages für Prüfung DFC_FuelTSRCMin" VALUE 0x80029B3D Val_Wu8 15.00 DFES_OneToOne 0.00 15.00 EXTENDED_LIMITS 0.00 255.0 /end CHARACTERISTIC
/begin CHARACTERISTIC DFES_DbLv.DFC_GbxNPosPPerSRCMax_C "DFES/Entprelllevel zur Erstellung eines DFES Eintrages für Prüfung DFC_GbxNPosPPerSRCMax" VALUE 0x80029B3E Val_Wu8 15.00 DFES_OneToOne 0.00 15.00 EXTENDED_LIMITS 0.00 255.0 /end CHARACTERISTIC
/begin CHARACTERISTIC DFES_DbLv.DFC_GbxNPosPPerSRCMin_C "DFES/Entprelllevel zur Erstellung eines DFES Eintrages für Prüfung DFC_GbxNPosPPerSRCMin" VALUE 0x80029B3F Val_Wu8 15.00 DFES_OneToOne 0.00 15.00 EXTENDED_LIMITS 0.00 255.0 /end CHARACTERISTIC
/begin CHARACTERISTIC DFES_DbLv.DFC_GbxNPosPdcycSRCMax_C "DFES/Entprelllevel zur Erstellung eines DFES Eintrages für Prüfung DFC_GbxNPosPdcycSRCMax" VALUE 0x80029B40 Val_Wu8 15.00 DFES_OneToOne 0.00 15.00 EXTENDED_LIMITS 0.00 255.0 /end CHARACTERISTIC
/begin CHARACTERISTIC DFES_DbLv.DFC_GbxNPosPdcycSRCMin_C "DFES/Entprelllevel zur Erstellung eines DFES Eintrages für Prüfung DFC_GbxNPosPdcycSRCMin" VALUE 0x80029B41 Val_Wu8 15.00 DFES_OneToOne 0.00 15.00 EXTENDED_LIMITS 0.00 255.0 /end CHARACTERISTIC
/begin CHARACTERISTIC DFES_DbLv.DFC_InjVlvPresMin_C "DFES/Entprelllevel zur Erstellung eines DFES Eintrages für Prüfung DFC_InjVlvPresMin" VALUE 0x80029B42 Val_Wu8 15.00 DFES_OneToOne 0.00 15.00 EXTENDED_LIMITS 0.00 255.0 /end CHARACTERISTIC
/begin CHARACTERISTIC DFES_DbLv.DFC_LSUCircNernstSig_C "DFES/Entprelllevel zur Erstellung eines DFES Eintrages für Prüfung DFC_LSUCircNernstSig" VALUE 0x80029B43 Val_Wu8 15.00 DFES_OneToOne 0.00 15.00 EXTENDED_LIMITS 0.00 255.0 /end CHARACTERISTIC
/begin CHARACTERISTIC DFES_DbLv.DFC_LSUCircPmpCurSig_C "DFES/Entprelllevel zur Erstellung eines DFES Eintrages für Prüfung DFC_LSUCircPmpCurSig" VALUE 0x80029B44 Val_Wu8 15.00 DFES_OneToOne 0.00 15.00 EXTENDED_LIMITS 0.00 255.0 /end CHARACTERISTIC
/begin CHARACTERISTIC DFES_DbLv.DFC_LSUCircVirtGndSig_C "DFES/Entprelllevel zur Erstellung eines DFES Eintrages für Prüfung DFC_LSUCircVirtGndSig" VALUE 0x80029B45 Val_Wu8 15.00 DFES_OneToOne 0.00 15.00 EXTENDED_LIMITS 0.00 255.0 /end CHARACTERISTIC
/begin CHARACTERISTIC DFES_DbLv.DFC_LSUO2Max_C "DFES/Entprelllevel zur Erstellung eines DFES Eintrages für Prüfung DFC_LSUO2Max" VALUE 0x80029B46 Val_Wu8 15.00 DFES_OneToOne 0.00 15.00 EXTENDED_LIMITS 0.00 255.0 /end CHARACTERISTIC
/begin CHARACTERISTIC DFES_DbLv.DFC_LSUO2Min_C "DFES/Entprelllevel zur Erstellung eines DFES Eintrages für Prüfung DFC_LSUO2Min" VALUE 0x80029B47 Val_Wu8 15.00 DFES_OneToOne 0.00 15.00 EXTENDED_LIMITS 0.00 255.0 /end CHARACTERISTIC
/begin CHARACTERISTIC DFES_DbLv.DFC_LSUSPIBattLowMin_C "DFES/Entprelllevel zur Erstellung eines DFES Eintrages für Prüfung DFC_LSUSPIBattLowMin" VALUE 0x80029B48 Val_Wu8 15.00 DFES_OneToOne 0.00 15.00 EXTENDED_LIMITS 0.00 255.0 /end CHARACTERISTIC
/begin CHARACTERISTIC DFES_DbLv.DFC_LSUWireSCB_C "DFES/Entprelllevel zur Erstellung eines DFES Eintrages für Prüfung DFC_LSUWireSCB" VALUE 0x80029B49 Val_Wu8 15.00 DFES_OneToOne 0.00 15.00 EXTENDED_LIMITS 0.00 255.0 /end CHARACTERISTIC
/begin CHARACTERISTIC DFES_DbLv.DFC_LSUWireSCG_C "DFES/Entprelllevel zur Erstellung eines DFES Eintrages für Prüfung DFC_LSUWireSCG" VALUE 0x80029B4A Val_Wu8 15.00 DFES_OneToOne 0.00 15.00 EXTENDED_LIMITS 0.00 255.0 /end CHARACTERISTIC
/begin CHARACTERISTIC DFES_DbLv.DFC_MeUnSCG_C "DFES/Entprelllevel zur Erstellung eines DFES Eintrages für Prüfung DFC_MeUnSCG" VALUE 0x80029B4B Val_Wu8 15.00 DFES_OneToOne 0.00 15.00 EXTENDED_LIMITS 0.00 255.0 /end CHARACTERISTIC
/begin CHARACTERISTIC DFES_DbLv.DFC_NSCDsCmpChk_C "DFES/Entprelllevel zur Erstellung eines DFES Eintrages für Prüfung DFC_NSCDsCmpChk" VALUE 0x80029B4C Val_Wu8 15.00 DFES_OneToOne 0.00 15.00 EXTENDED_LIMITS 0.00 255.0 /end CHARACTERISTIC
/begin CHARACTERISTIC DFES_DbLv.DFC_NSCDsLamBinSRCMax_C "DFES/Entprelllevel zur Erstellung eines DFES Eintrages für Prüfung DFC_NSCDsLamBinSRCMax" VALUE 0x80029B4D Val_Wu8 15.00 DFES_OneToOne 0.00 15.00 EXTENDED_LIMITS 0.00 255.0 /end CHARACTERISTIC
/begin CHARACTERISTIC DFES_DbLv.DFC_NSCDsLamBinSRCMin_C "DFES/Entprelllevel zur Erstellung eines DFES Eintrages für Prüfung DFC_NSCDsLamBinSRCMin" VALUE 0x80029B4E Val_Wu8 15.00 DFES_OneToOne 0.00 15.00 EXTENDED_LIMITS 0.00 255.0 /end CHARACTERISTIC
/begin CHARACTERISTIC DFES_DbLv.DFC_NSCDsLamLinSRCMax_C "DFES/Entprelllevel zur Erstellung eines DFES Eintrages für Prüfung DFC_NSCDsLamLinSRCMax" VALUE 0x80029B4F Val_Wu8 15.00 DFES_OneToOne 0.00 15.00 EXTENDED_LIMITS 0.00 255.0 /end CHARACTERISTIC
/begin CHARACTERISTIC DFES_DbLv.DFC_NSCDsLamLinSRCMin_C "DFES/Entprelllevel zur Erstellung eines DFES Eintrages für Prüfung DFC_NSCDsLamLinSRCMin" VALUE 0x80029B50 Val_Wu8 15.00 DFES_OneToOne 0.00 15.00 EXTENDED_LIMITS 0.00 255.0 /end CHARACTERISTIC
/begin CHARACTERISTIC DFES_DbLv.DFC_NSCDsLamPlausMax_C "DFES/Entprelllevel zur Erstellung eines DFES Eintrages für Prüfung DFC_NSCDsLamPlausMax" VALUE 0x80029B51 Val_Wu8 15.00 DFES_OneToOne 0.00 15.00 EXTENDED_LIMITS 0.00 255.0 /end CHARACTERISTIC
/begin CHARACTERISTIC DFES_DbLv.DFC_NSCDsLamPlausMin_C "DFES/Entprelllevel zur Erstellung eines DFES Eintrages für Prüfung DFC_NSCDsLamPlausMin" VALUE 0x80029B52 Val_Wu8 15.00 DFES_OneToOne 0.00 15.00 EXTENDED_LIMITS 0.00 255.0 /end CHARACTERISTIC
/begin CHARACTERISTIC DFES_DbLv.DFC_NSCDsNOxSRCMax_C "DFES/Entprelllevel zur Erstellung eines DFES Eintrages für Prüfung DFC_NSCDsNOxSRCMax" VALUE 0x80029B53 Val_Wu8 15.00 DFES_OneToOne 0.00 15.00 EXTENDED_LIMITS 0.00 255.0 /end CHARACTERISTIC
/begin CHARACTERISTIC DFES_DbLv.DFC_NSCDsNOxSRCMin_C "DFES/Entprelllevel zur Erstellung eines DFES Eintrages für Prüfung DFC_NSCDsNOxSRCMin" VALUE 0x80029B54 Val_Wu8 15.00 DFES_OneToOne 0.00 15.00 EXTENDED_LIMITS 0.00 255.0 /end CHARACTERISTIC
/begin CHARACTERISTIC DFES_DbLv.DFC_NSCDsOpCir_C "DFES/Entprelllevel zur Erstellung eines DFES Eintrages für Prüfung DFC_NSCDsOpCir" VALUE 0x80029B55 Val_Wu8 15.00 DFES_OneToOne 0.00 15.00 EXTENDED_LIMITS 0.00 255.0 /end CHARACTERISTIC
/begin CHARACTERISTIC DFES_DbLv.DFC_NSCDsShCir_C "DFES/Entprelllevel zur Erstellung eines DFES Eintrages für Prüfung DFC_NSCDsShCir" VALUE 0x80029B56 Val_Wu8 15.00 DFES_OneToOne 0.00 15.00 EXTENDED_LIMITS 0.00 255.0 /end CHARACTERISTIC
/begin CHARACTERISTIC DFES_DbLv.DFC_NoCat2DsCmpChk_C "DFES/Entprelllevel zur Erstellung eines DFES Eintrages für Prüfung DFC_NoCat2DsCmpChk" VALUE 0x80029B57 Val_Wu8 15.00 DFES_OneToOne 0.00 15.00 EXTENDED_LIMITS 0.00 255.0 /end CHARACTERISTIC
/begin CHARACTERISTIC DFES_DbLv.DFC_NoCat2DsLamBinSRCMax_C "DFES/Entprelllevel zur Erstellung eines DFES Eintrages für Prüfung DFC_NoCat2DsLamBinSRCMax" VALUE 0x80029B58 Val_Wu8 15.00 DFES_OneToOne 0.00 15.00 EXTENDED_LIMITS 0.00 255.0 /end CHARACTERISTIC
/begin CHARACTERISTIC DFES_DbLv.DFC_NoCat2DsLamBinSRCMin_C "DFES/Entprelllevel zur Erstellung eines DFES Eintrages für Prüfung DFC_NoCat2DsLamBinSRCMin" VALUE 0x80029B59 Val_Wu8 15.00 DFES_OneToOne 0.00 15.00 EXTENDED_LIMITS 0.00 255.0 /end CHARACTERISTIC
/begin CHARACTERISTIC DFES_DbLv.DFC_NoCat2DsLamLinSRCMax_C "DFES/Entprelllevel zur Erstellung eines DFES Eintrages für Prüfung DFC_NoCat2DsLamLinSRCMax" VALUE 0x80029B5A Val_Wu8 15.00 DFES_OneToOne 0.00 15.00 EXTENDED_LIMITS 0.00 255.0 /end CHARACTERISTIC
/begin CHARACTERISTIC DFES_DbLv.DFC_NoCat2DsLamLinSRCMin_C "DFES/Entprelllevel zur Erstellung eines DFES Eintrages für Prüfung DFC_NoCat2DsLamLinSRCMin" VALUE 0x80029B5B Val_Wu8 15.00 DFES_OneToOne 0.00 15.00 EXTENDED_LIMITS 0.00 255.0 /end CHARACTERISTIC
/begin CHARACTERISTIC DFES_DbLv.DFC_NoCat2DsLamPlausMax_C "DFES/Entprelllevel zur Erstellung eines DFES Eintrages für Prüfung DFC_NoCat2DsLamPlausMax" VALUE 0x80029B5C Val_Wu8 15.00 DFES_OneToOne 0.00 15.00 EXTENDED_LIMITS 0.00 255.0 /end CHARACTERISTIC
/begin CHARACTERISTIC DFES_DbLv.DFC_NoCat2DsLamPlausMin_C "DFES/Entprelllevel zur Erstellung eines DFES Eintrages für Prüfung DFC_NoCat2DsLamPlausMin" VALUE 0x80029B5D Val_Wu8 15.00 DFES_OneToOne 0.00 15.00 EXTENDED_LIMITS 0.00 255.0 /end CHARACTERISTIC
/begin CHARACTERISTIC DFES_DbLv.DFC_NoCat2DsNOxSRCMax_C "DFES/Entprelllevel zur Erstellung eines DFES Eintrages für Prüfung DFC_NoCat2DsNOxSRCMax" VALUE 0x80029B5E Val_Wu8 15.00 DFES_OneToOne 0.00 15.00 EXTENDED_LIMITS 0.00 255.0 /end CHARACTERISTIC
/begin CHARACTERISTIC DFES_DbLv.DFC_NoCat2DsNOxSRCMin_C "DFES/Entprelllevel zur Erstellung eines DFES Eintrages für Prüfung DFC_NoCat2DsNOxSRCMin" VALUE 0x80029B5F Val_Wu8 15.00 DFES_OneToOne 0.00 15.00 EXTENDED_LIMITS 0.00 255.0 /end CHARACTERISTIC
/begin CHARACTERISTIC DFES_DbLv.DFC_NoCat2DsOpCir_C "DFES/Entprelllevel zur Erstellung eines DFES Eintrages für Prüfung DFC_NoCat2DsOpCir" VALUE 0x80029B60 Val_Wu8 15.00 DFES_OneToOne 0.00 15.00 EXTENDED_LIMITS 0.00 255.0 /end CHARACTERISTIC
/begin CHARACTERISTIC DFES_DbLv.DFC_NoCat2DsShCir_C "DFES/Entprelllevel zur Erstellung eines DFES Eintrages für Prüfung DFC_NoCat2DsShCir" VALUE 0x80029B61 Val_Wu8 15.00 DFES_OneToOne 0.00 15.00 EXTENDED_LIMITS 0.00 255.0 /end CHARACTERISTIC
/begin CHARACTERISTIC DFES_DbLv.DFC_NplDynPPFltDiff_C "DFES/Entprelllevel zur Erstellung eines DFES Eintrages für Prüfung DFC_NplDynPPFltDiff" VALUE 0x80029B62 Val_Wu8 15.00 DFES_OneToOne 0.00 15.00 EXTENDED_LIMITS 0.00 255.0 /end CHARACTERISTIC
/begin CHARACTERISTIC DFES_DbLv.DFC_NplHsChngPPFltDiff_C "DFES/Entprelllevel zur Erstellung eines DFES Eintrages für Prüfung DFC_NplHsChngPPFltDiff" VALUE 0x80029B63 Val_Wu8 15.00 DFES_OneToOne 0.00 15.00 EXTENDED_LIMITS 0.00 255.0 /end CHARACTERISTIC
/begin CHARACTERISTIC DFES_DbLv.DFC_NplHsLnPPFltDiff_C "DFES/Entprelllevel zur Erstellung eines DFES Eintrages für Prüfung DFC_NplHsLnPPFltDiff" VALUE 0x80029B64 Val_Wu8 15.00 DFES_OneToOne 0.00 15.00 EXTENDED_LIMITS 0.00 255.0 /end CHARACTERISTIC
/begin CHARACTERISTIC DFES_DbLv.DFC_NplTOxiCatUs_C "DFES/Entprelllevel zur Erstellung eines DFES Eintrages für Prüfung DFC_NplTOxiCatUs" VALUE 0x80029B65 Val_Wu8 15.00 DFES_OneToOne 0.00 15.00 EXTENDED_LIMITS 0.00 255.0 /end CHARACTERISTIC
/begin CHARACTERISTIC DFES_DbLv.DFC_NplTPFltUs_C "DFES/Entprelllevel zur Erstellung eines DFES Eintrages für Prüfung DFC_NplTPFltUs" VALUE 0x80029B66 Val_Wu8 15.00 DFES_OneToOne 0.00 15.00 EXTENDED_LIMITS 0.00 255.0 /end CHARACTERISTIC
/begin CHARACTERISTIC DFES_DbLv.DFC_NplTTrbnUs_C "DFES/Entprelllevel zur Erstellung eines DFES Eintrages für Prüfung DFC_NplTTrbnUs" VALUE 0x80029B67 Val_Wu8 15.00 DFES_OneToOne 0.00 15.00 EXTENDED_LIMITS 0.00 255.0 /end CHARACTERISTIC
/begin CHARACTERISTIC DFES_DbLv.DFC_OilPSwmpSRCMax_C "DFES/Entprelllevel zur Erstellung eines DFES Eintrages für Prüfung DFC_OilPSwmpSRCMax" VALUE 0x80029B68 Val_Wu8 15.00 DFES_OneToOne 0.00 15.00 EXTENDED_LIMITS 0.00 255.0 /end CHARACTERISTIC
/begin CHARACTERISTIC DFES_DbLv.DFC_OilPSwmpSRCMin_C "DFES/Entprelllevel zur Erstellung eines DFES Eintrages für Prüfung DFC_OilPSwmpSRCMin" VALUE 0x80029B69 Val_Wu8 15.00 DFES_OneToOne 0.00 15.00 EXTENDED_LIMITS 0.00 255.0 /end CHARACTERISTIC
/begin CHARACTERISTIC DFES_DbLv.DFC_PCVSCG_C "DFES/Entprelllevel zur Erstellung eines DFES Eintrages für Prüfung DFC_PCVSCG" VALUE 0x80029B6A Val_Wu8 15.00 DFES_OneToOne 0.00 15.00 EXTENDED_LIMITS 0.00 255.0 /end CHARACTERISTIC
/begin CHARACTERISTIC DFES_DbLv.DFC_PFltCharPDiffMin_C "DFES/Entprelllevel zur Erstellung eines DFES Eintrages für Prüfung DFC_PFltCharPDiffMin" VALUE 0x80029B6B Val_Wu8 15.00 DFES_OneToOne 0.00 15.00 EXTENDED_LIMITS 0.00 255.0 /end CHARACTERISTIC
/begin CHARACTERISTIC DFES_DbLv.DFC_PFltDstrMin_C "DFES/Entprelllevel zur Erstellung eines DFES Eintrages für Prüfung DFC_PFltDstrMin" VALUE 0x80029B6C Val_Wu8 15.00 DFES_OneToOne 0.00 15.00 EXTENDED_LIMITS 0.00 255.0 /end CHARACTERISTIC
/begin CHARACTERISTIC DFES_DbLv.DFC_PFltEngPrt_C "DFES/Entprelllevel zur Erstellung eines DFES Eintrages für Prüfung DFC_PFltEngPrt" VALUE 0x80029B6D Val_Wu8 15.00 DFES_OneToOne 0.00 15.00 EXTENDED_LIMITS 0.00 255.0 /end CHARACTERISTIC
/begin CHARACTERISTIC DFES_DbLv.DFC_PFltRgnPerm_C "DFES/Entprelllevel zur Erstellung eines DFES Eintrages für Prüfung DFC_PFltRgnPerm" VALUE 0x80029B6E Val_Wu8 15.00 DFES_OneToOne 0.00 15.00 EXTENDED_LIMITS 0.00 255.0 /end CHARACTERISTIC
/begin CHARACTERISTIC DFES_DbLv.DFC_PFltSRCMaxFlwRstn_C "DFES/Entprelllevel zur Erstellung eines DFES Eintrages für Prüfung DFC_PFltSRCMaxFlwRstn" VALUE 0x80029B6F Val_Wu8 15.00 DFES_OneToOne 0.00 15.00 EXTENDED_LIMITS 0.00 255.0 /end CHARACTERISTIC
/begin CHARACTERISTIC DFES_DbLv.DFC_PFltSRCMinFlwRstn_C "DFES/Entprelllevel zur Erstellung eines DFES Eintrages für Prüfung DFC_PFltSRCMinFlwRstn" VALUE 0x80029B70 Val_Wu8 15.00 DFES_OneToOne 0.00 15.00 EXTENDED_LIMITS 0.00 255.0 /end CHARACTERISTIC
/begin CHARACTERISTIC DFES_DbLv.DFC_PFltSotMsDvtMax_C "DFES/Entprelllevel zur Erstellung eines DFES Eintrages für Prüfung DFC_PFltSotMsDvtMax" VALUE 0x80029B71 Val_Wu8 15.00 DFES_OneToOne 0.00 15.00 EXTENDED_LIMITS 0.00 255.0 /end CHARACTERISTIC
/begin CHARACTERISTIC DFES_DbLv.DFC_PFltSotMsDvtMin_C "DFES/Entprelllevel zur Erstellung eines DFES Eintrages für Prüfung DFC_PFltSotMsDvtMin" VALUE 0x80029B72 Val_Wu8 15.00 DFES_OneToOne 0.00 15.00 EXTENDED_LIMITS 0.00 255.0 /end CHARACTERISTIC
/begin CHARACTERISTIC DFES_DbLv.DFC_PFltSotMsMax_C "DFES/Entprelllevel zur Erstellung eines DFES Eintrages für Prüfung DFC_PFltSotMsMax" VALUE 0x80029B73 Val_Wu8 15.00 DFES_OneToOne 0.00 15.00 EXTENDED_LIMITS 0.00 255.0 /end CHARACTERISTIC
/begin CHARACTERISTIC DFES_DbLv.DFC_PIntkVUsSRCMax_C "DFES/Entprelllevel zur Erstellung eines DFES Eintrages für Prüfung DFC_PIntkVUsSRCMax" VALUE 0x80029B74 Val_Wu8 15.00 DFES_OneToOne 0.00 15.00 EXTENDED_LIMITS 0.00 255.0 /end CHARACTERISTIC
/begin CHARACTERISTIC DFES_DbLv.DFC_PIntkVUsSRCMin_C "DFES/Entprelllevel zur Erstellung eines DFES Eintrages für Prüfung DFC_PIntkVUsSRCMin" VALUE 0x80029B75 Val_Wu8 15.00 DFES_OneToOne 0.00 15.00 EXTENDED_LIMITS 0.00 255.0 /end CHARACTERISTIC
/begin CHARACTERISTIC DFES_DbLv.DFC_SRCHighAPP1_C "DFES/Entprelllevel zur Erstellung eines DFES Eintrages für Prüfung DFC_SRCHighAPP1" VALUE 0x80029B76 Val_Wu8 15.00 DFES_OneToOne 0.00 15.00 EXTENDED_LIMITS 0.00 255.0 /end CHARACTERISTIC
/begin CHARACTERISTIC DFES_DbLv.DFC_SRCHighAPP2_C "DFES/Entprelllevel zur Erstellung eines DFES Eintrages für Prüfung DFC_SRCHighAPP2" VALUE 0x80029B77 Val_Wu8 15.00 DFES_OneToOne 0.00 15.00 EXTENDED_LIMITS 0.00 255.0 /end CHARACTERISTIC
/begin CHARACTERISTIC DFES_DbLv.DFC_SRCLowAPP1_C "DFES/Entprelllevel zur Erstellung eines DFES Eintrages für Prüfung DFC_SRCLowAPP1" VALUE 0x80029B78 Val_Wu8 15.00 DFES_OneToOne 0.00 15.00 EXTENDED_LIMITS 0.00 255.0 /end CHARACTERISTIC
/begin CHARACTERISTIC DFES_DbLv.DFC_SRCLowAPP2_C "DFES/Entprelllevel zur Erstellung eines DFES Eintrages für Prüfung DFC_SRCLowAPP2" VALUE 0x80029B79 Val_Wu8 15.00 DFES_OneToOne 0.00 15.00 EXTENDED_LIMITS 0.00 255.0 /end CHARACTERISTIC
/begin CHARACTERISTIC DFES_DbLv.DFC_SRCMaxPPFltDiff_C "DFES/Entprelllevel zur Erstellung eines DFES Eintrages für Prüfung DFC_SRCMaxPPFltDiff" VALUE 0x80029B7A Val_Wu8 15.00 DFES_OneToOne 0.00 15.00 EXTENDED_LIMITS 0.00 255.0 /end CHARACTERISTIC
/begin CHARACTERISTIC DFES_DbLv.DFC_SRCMaxPPFltUs_C "DFES/Entprelllevel zur Erstellung eines DFES Eintrages für Prüfung DFC_SRCMaxPPFltUs" VALUE 0x80029B7B Val_Wu8 15.00 DFES_OneToOne 0.00 15.00 EXTENDED_LIMITS 0.00 255.0 /end CHARACTERISTIC
/begin CHARACTERISTIC DFES_DbLv.DFC_SRCMaxTECU_C "DFES/Entprelllevel zur Erstellung eines DFES Eintrages für Prüfung DFC_SRCMaxTECU" VALUE 0x80029B7C Val_Wu8 15.00 DFES_OneToOne 0.00 15.00 EXTENDED_LIMITS 0.00 255.0 /end CHARACTERISTIC
/begin CHARACTERISTIC DFES_DbLv.DFC_SRCMaxTOxiCatUs_C "DFES/Entprelllevel zur Erstellung eines DFES Eintrages für Prüfung DFC_SRCMaxTOxiCatUs" VALUE 0x80029B7D Val_Wu8 15.00 DFES_OneToOne 0.00 15.00 EXTENDED_LIMITS 0.00 255.0 /end CHARACTERISTIC
/begin CHARACTERISTIC DFES_DbLv.DFC_SRCMaxTPFltUs_C "DFES/Entprelllevel zur Erstellung eines DFES Eintrages für Prüfung DFC_SRCMaxTPFltUs" VALUE 0x80029B7E Val_Wu8 15.00 DFES_OneToOne 0.00 15.00 EXTENDED_LIMITS 0.00 255.0 /end CHARACTERISTIC
/begin CHARACTERISTIC DFES_DbLv.DFC_SRCMaxTTrbnUs_C "DFES/Entprelllevel zur Erstellung eines DFES Eintrages für Prüfung DFC_SRCMaxTTrbnUs" VALUE 0x80029B7F Val_Wu8 15.00 DFES_OneToOne 0.00 15.00 EXTENDED_LIMITS 0.00 255.0 /end CHARACTERISTIC
/begin CHARACTERISTIC DFES_DbLv.DFC_SRCMaxUCatUsT_C "DFES/Entprelllevel zur Erstellung eines DFES Eintrages für Prüfung DFC_SRCMaxUCatUsT" VALUE 0x80029B80 Val_Wu8 15.00 DFES_OneToOne 0.00 15.00 EXTENDED_LIMITS 0.00 255.0 /end CHARACTERISTIC
/begin CHARACTERISTIC DFES_DbLv.DFC_SRCMaxUPmpP_C "DFES/Entprelllevel zur Erstellung eines DFES Eintrages für Prüfung DFC_SRCMaxUPmpP" VALUE 0x80029B81 Val_Wu8 15.00 DFES_OneToOne 0.00 15.00 EXTENDED_LIMITS 0.00 255.0 /end CHARACTERISTIC
/begin CHARACTERISTIC DFES_DbLv.DFC_SRCMinPPFltDiff_C "DFES/Entprelllevel zur Erstellung eines DFES Eintrages für Prüfung DFC_SRCMinPPFltDiff" VALUE 0x80029B82 Val_Wu8 15.00 DFES_OneToOne 0.00 15.00 EXTENDED_LIMITS 0.00 255.0 /end CHARACTERISTIC
/begin CHARACTERISTIC DFES_DbLv.DFC_SRCMinPPFltUs_C "DFES/Entprelllevel zur Erstellung eines DFES Eintrages für Prüfung DFC_SRCMinPPFltUs" VALUE 0x80029B83 Val_Wu8 15.00 DFES_OneToOne 0.00 15.00 EXTENDED_LIMITS 0.00 255.0 /end CHARACTERISTIC
/begin CHARACTERISTIC DFES_DbLv.DFC_SRCMinTECU_C "DFES/Entprelllevel zur Erstellung eines DFES Eintrages für Prüfung DFC_SRCMinTECU" VALUE 0x80029B84 Val_Wu8 15.00 DFES_OneToOne 0.00 15.00 EXTENDED_LIMITS 0.00 255.0 /end CHARACTERISTIC
/begin CHARACTERISTIC DFES_DbLv.DFC_SRCMinTOxiCatUs_C "DFES/Entprelllevel zur Erstellung eines DFES Eintrages für Prüfung DFC_SRCMinTOxiCatUs" VALUE 0x80029B85 Val_Wu8 15.00 DFES_OneToOne 0.00 15.00 EXTENDED_LIMITS 0.00 255.0 /end CHARACTERISTIC
/begin CHARACTERISTIC DFES_DbLv.DFC_SRCMinTPFltUs_C "DFES/Entprelllevel zur Erstellung eines DFES Eintrages für Prüfung DFC_SRCMinTPFltUs" VALUE 0x80029B86 Val_Wu8 15.00 DFES_OneToOne 0.00 15.00 EXTENDED_LIMITS 0.00 255.0 /end CHARACTERISTIC
/begin CHARACTERISTIC DFES_DbLv.DFC_SRCMinTTrbnUs_C "DFES/Entprelllevel zur Erstellung eines DFES Eintrages für Prüfung DFC_SRCMinTTrbnUs" VALUE 0x80029B87 Val_Wu8 15.00 DFES_OneToOne 0.00 15.00 EXTENDED_LIMITS 0.00 255.0 /end CHARACTERISTIC
/begin CHARACTERISTIC DFES_DbLv.DFC_SRCMinUCatUsT_C "DFES/Entprelllevel zur Erstellung eines DFES Eintrages für Prüfung DFC_SRCMinUCatUsT" VALUE 0x80029B88 Val_Wu8 15.00 DFES_OneToOne 0.00 15.00 EXTENDED_LIMITS 0.00 255.0 /end CHARACTERISTIC
/begin CHARACTERISTIC DFES_DbLv.DFC_SRCMinUPmpP_C "DFES/Entprelllevel zur Erstellung eines DFES Eintrages für Prüfung DFC_SRCMinUPmpP" VALUE 0x80029B89 Val_Wu8 15.00 DFES_OneToOne 0.00 15.00 EXTENDED_LIMITS 0.00 255.0 /end CHARACTERISTIC
/begin CHARACTERISTIC DFES_DbLv.DFC_SigUCatUsT_C "DFES/Entprelllevel zur Erstellung eines DFES Eintrages für Prüfung DFC_SigUCatUsT" VALUE 0x80029B8A Val_Wu8 15.00 DFES_OneToOne 0.00 15.00 EXTENDED_LIMITS 0.00 255.0 /end CHARACTERISTIC
/begin CHARACTERISTIC DFES_DbLv.DFC_SigUPmpP_C "DFES/Entprelllevel zur Erstellung eines DFES Eintrages für Prüfung DFC_SigUPmpP" VALUE 0x80029B8B Val_Wu8 15.00 DFES_OneToOne 0.00 15.00 EXTENDED_LIMITS 0.00 255.0 /end CHARACTERISTIC
/begin CHARACTERISTIC DFES_DbLv.DFC_SyncAPP_C "DFES/Entprelllevel zur Erstellung eines DFES Eintrages für Prüfung DFC_SyncAPP" VALUE 0x80029B8C Val_Wu8 15.00 DFES_OneToOne 0.00 15.00 EXTENDED_LIMITS 0.00 255.0 /end CHARACTERISTIC
/begin CHARACTERISTIC DFES_DbLv.DFC_T15Npl_C "DFES/Entprelllevel zur Erstellung eines DFES Eintrages für Prüfung DFC_T15Npl" VALUE 0x80029B8D Val_Wu8 15.00 DFES_OneToOne 0.00 15.00 EXTENDED_LIMITS 0.00 255.0 /end CHARACTERISTIC
/begin CHARACTERISTIC DFES_DbLv.DFC_TAFSDtyCycHi_C "DFES/Entprelllevel zur Erstellung eines DFES Eintrages für Prüfung DFC_TAFSDtyCycHi" VALUE 0x80029B8E Val_Wu8 15.00 DFES_OneToOne 0.00 15.00 EXTENDED_LIMITS 0.00 255.0 /end CHARACTERISTIC
/begin CHARACTERISTIC DFES_DbLv.DFC_TAFSDtyCycLo_C "DFES/Entprelllevel zur Erstellung eines DFES Eintrages für Prüfung DFC_TAFSDtyCycLo" VALUE 0x80029B8F Val_Wu8 15.00 DFES_OneToOne 0.00 15.00 EXTENDED_LIMITS 0.00 255.0 /end CHARACTERISTIC
/begin CHARACTERISTIC DFES_DbLv.DFC_TAFSPerHi_C "DFES/Entprelllevel zur Erstellung eines DFES Eintrages für Prüfung DFC_TAFSPerHi" VALUE 0x80029B90 Val_Wu8 15.00 DFES_OneToOne 0.00 15.00 EXTENDED_LIMITS 0.00 255.0 /end CHARACTERISTIC
/begin CHARACTERISTIC DFES_DbLv.DFC_TAFSPerLo_C "DFES/Entprelllevel zur Erstellung eines DFES Eintrages für Prüfung DFC_TAFSPerLo" VALUE 0x80029B91 Val_Wu8 15.00 DFES_OneToOne 0.00 15.00 EXTENDED_LIMITS 0.00 255.0 /end CHARACTERISTIC
/begin CHARACTERISTIC DFES_DbLv.DFC_TCACDsSRCMax_C "DFES/Entprelllevel zur Erstellung eines DFES Eintrages für Prüfung DFC_TCACDsSRCMax" VALUE 0x80029B92 Val_Wu8 15.00 DFES_OneToOne 0.00 15.00 EXTENDED_LIMITS 0.00 255.0 /end CHARACTERISTIC
/begin CHARACTERISTIC DFES_DbLv.DFC_TCACDsSRCMin_C "DFES/Entprelllevel zur Erstellung eines DFES Eintrages für Prüfung DFC_TCACDsSRCMin" VALUE 0x80029B93 Val_Wu8 15.00 DFES_OneToOne 0.00 15.00 EXTENDED_LIMITS 0.00 255.0 /end CHARACTERISTIC
/begin CHARACTERISTIC DFES_DbLv.DFC_ThrVlvSRCMax_C "DFES/Entprelllevel zur Erstellung eines DFES Eintrages für Prüfung DFC_ThrVlvSRCMax" VALUE 0x80029B94 Val_Wu8 15.00 DFES_OneToOne 0.00 15.00 EXTENDED_LIMITS 0.00 255.0 /end CHARACTERISTIC
/begin CHARACTERISTIC DFES_DbLv.DFC_ThrVlvSRCMin_C "DFES/Entprelllevel zur Erstellung eines DFES Eintrages für Prüfung DFC_ThrVlvSRCMin" VALUE 0x80029B95 Val_Wu8 15.00 DFES_OneToOne 0.00 15.00 EXTENDED_LIMITS 0.00 255.0 /end CHARACTERISTIC
/begin CHARACTERISTIC DFES_DbLv.DFC_TrbChLPOL_C "DFES/Entprelllevel zur Erstellung eines DFES Eintrages für Prüfung DFC_TrbChLPOL" VALUE 0x80029B96 Val_Wu8 15.00 DFES_OneToOne 0.00 15.00 EXTENDED_LIMITS 0.00 255.0 /end CHARACTERISTIC
/begin CHARACTERISTIC DFES_DbLv.DFC_TrbChLPSCB_C "DFES/Entprelllevel zur Erstellung eines DFES Eintrages für Prüfung DFC_TrbChLPSCB" VALUE 0x80029B97 Val_Wu8 15.00 DFES_OneToOne 0.00 15.00 EXTENDED_LIMITS 0.00 255.0 /end CHARACTERISTIC
/begin CHARACTERISTIC DFES_DbLv.DFC_TrbChLPSCG_C "DFES/Entprelllevel zur Erstellung eines DFES Eintrages für Prüfung DFC_TrbChLPSCG" VALUE 0x80029B98 Val_Wu8 15.00 DFES_OneToOne 0.00 15.00 EXTENDED_LIMITS 0.00 255.0 /end CHARACTERISTIC
/begin CHARACTERISTIC DFES_DbLv.DFC_UHtrPLOL_C "DFES/Entprelllevel zur Erstellung eines DFES Eintrages für Prüfung DFC_UHtrPLOL" VALUE 0x80029B99 Val_Wu8 15.00 DFES_OneToOne 0.00 15.00 EXTENDED_LIMITS 0.00 255.0 /end CHARACTERISTIC
/begin CHARACTERISTIC DFES_DbLv.DFC_UHtrPLSCB_C "DFES/Entprelllevel zur Erstellung eines DFES Eintrages für Prüfung DFC_UHtrPLSCB" VALUE 0x80029B9A Val_Wu8 15.00 DFES_OneToOne 0.00 15.00 EXTENDED_LIMITS 0.00 255.0 /end CHARACTERISTIC
/begin CHARACTERISTIC DFES_DbLv.DFC_UHtrPLSCG_C "DFES/Entprelllevel zur Erstellung eines DFES Eintrages für Prüfung DFC_UHtrPLSCG" VALUE 0x80029B9B Val_Wu8 15.00 DFES_OneToOne 0.00 15.00 EXTENDED_LIMITS 0.00 255.0 /end CHARACTERISTIC
/begin CHARACTERISTIC DFES_DbLv.DFC_UHtrPLSRCMaxDia_C "DFES/Entprelllevel zur Erstellung eines DFES Eintrages für Prüfung DFC_UHtrPLSRCMaxDia" VALUE 0x80029B9C Val_Wu8 15.00 DFES_OneToOne 0.00 15.00 EXTENDED_LIMITS 0.00 255.0 /end CHARACTERISTIC
/begin CHARACTERISTIC DFES_DbLv.DFC_UHtrPLSRCMinDia_C "DFES/Entprelllevel zur Erstellung eines DFES Eintrages für Prüfung DFC_UHtrPLSRCMinDia" VALUE 0x80029B9D Val_Wu8 15.00 DFES_OneToOne 0.00 15.00 EXTENDED_LIMITS 0.00 255.0 /end CHARACTERISTIC
/begin CHARACTERISTIC DFES_DbLv.DFC_UHtrTnkOL_C "DFES/Entprelllevel zur Erstellung eines DFES Eintrages für Prüfung DFC_UHtrTnkOL" VALUE 0x80029B9E Val_Wu8 15.00 DFES_OneToOne 0.00 15.00 EXTENDED_LIMITS 0.00 255.0 /end CHARACTERISTIC
/begin CHARACTERISTIC DFES_DbLv.DFC_UHtrTnkSCB_C "DFES/Entprelllevel zur Erstellung eines DFES Eintrages für Prüfung DFC_UHtrTnkSCB" VALUE 0x80029B9F Val_Wu8 15.00 DFES_OneToOne 0.00 15.00 EXTENDED_LIMITS 0.00 255.0 /end CHARACTERISTIC
/begin CHARACTERISTIC DFES_DbLv.DFC_UHtrTnkSCG_C "DFES/Entprelllevel zur Erstellung eines DFES Eintrages für Prüfung DFC_UHtrTnkSCG" VALUE 0x80029BA0 Val_Wu8 15.00 DFES_OneToOne 0.00 15.00 EXTENDED_LIMITS 0.00 255.0 /end CHARACTERISTIC
/begin CHARACTERISTIC DFES_DbLv.DFC_UHtrTnkSRCMaxDia_C "DFES/Entprelllevel zur Erstellung eines DFES Eintrages für Prüfung DFC_UHtrTnkSRCMaxDia" VALUE 0x80029BA1 Val_Wu8 15.00 DFES_OneToOne 0.00 15.00 EXTENDED_LIMITS 0.00 255.0 /end CHARACTERISTIC
/begin CHARACTERISTIC DFES_DbLv.DFC_UHtrTnkSRCMinDia_C "DFES/Entprelllevel zur Erstellung eines DFES Eintrages für Prüfung DFC_UHtrTnkSRCMinDia" VALUE 0x80029BA2 Val_Wu8 15.00 DFES_OneToOne 0.00 15.00 EXTENDED_LIMITS 0.00 255.0 /end CHARACTERISTIC
/begin CHARACTERISTIC DFES_DbLv.DFC_URevVlvOL_C "DFES/Entprelllevel zur Erstellung eines DFES Eintrages für Prüfung DFC_URevVlvOL" VALUE 0x80029BA3 Val_Wu8 15.00 DFES_OneToOne 0.00 15.00 EXTENDED_LIMITS 0.00 255.0 /end CHARACTERISTIC
/begin CHARACTERISTIC DFES_DbLv.DFC_URevVlvSCB_C "DFES/Entprelllevel zur Erstellung eines DFES Eintrages für Prüfung DFC_URevVlvSCB" VALUE 0x80029BA4 Val_Wu8 15.00 DFES_OneToOne 0.00 15.00 EXTENDED_LIMITS 0.00 255.0 /end CHARACTERISTIC
/begin CHARACTERISTIC DFES_DbLv.DFC_URevVlvSCG_C "DFES/Entprelllevel zur Erstellung eines DFES Eintrages für Prüfung DFC_URevVlvSCG" VALUE 0x80029BA5 Val_Wu8 15.00 DFES_OneToOne 0.00 15.00 EXTENDED_LIMITS 0.00 255.0 /end CHARACTERISTIC
/begin CHARACTERISTIC DFES_DbLv.DFC_UTnkTSRCMax_C "DFES/Entprelllevel zur Erstellung eines DFES Eintrages für Prüfung DFC_UTnkTSRCMax" VALUE 0x80029BA6 Val_Wu8 15.00 DFES_OneToOne 0.00 15.00 EXTENDED_LIMITS 0.00 255.0 /end CHARACTERISTIC
/begin CHARACTERISTIC DFES_DbLv.DFC_UTnkTSRCMin_C "DFES/Entprelllevel zur Erstellung eines DFES Eintrages für Prüfung DFC_UTnkTSRCMin" VALUE 0x80029BA7 Val_Wu8 15.00 DFES_OneToOne 0.00 15.00 EXTENDED_LIMITS 0.00 255.0 /end CHARACTERISTIC
/begin CHARACTERISTIC DFES_DbLv.DFC_UTnkTSig_C "DFES/Entprelllevel zur Erstellung eines DFES Eintrages für Prüfung DFC_UTnkTSig" VALUE 0x80029BA8 Val_Wu8 15.00 DFES_OneToOne 0.00 15.00 EXTENDED_LIMITS 0.00 255.0 /end CHARACTERISTIC
/begin CHARACTERISTIC DFES_DbLv.DFC_VSwVlvGovDvtMax_C "DFES/Entprelllevel zur Erstellung eines DFES Eintrages für Prüfung DFC_VSwVlvGovDvtMax" VALUE 0x80029BA9 Val_Wu8 15.00 DFES_OneToOne 0.00 15.00 EXTENDED_LIMITS 0.00 255.0 /end CHARACTERISTIC
/begin CHARACTERISTIC DFES_DbLv.DFC_VSwVlvGovDvtMin_C "DFES/Entprelllevel zur Erstellung eines DFES Eintrages für Prüfung DFC_VSwVlvGovDvtMin" VALUE 0x80029BAA Val_Wu8 15.00 DFES_OneToOne 0.00 15.00 EXTENDED_LIMITS 0.00 255.0 /end CHARACTERISTIC
/begin CHARACTERISTIC DFES_DbLv.DFC_VSwVlvHBrgOpnLd_C "DFES/Entprelllevel zur Erstellung eines DFES Eintrages für Prüfung DFC_VSwVlvHBrgOpnLd" VALUE 0x80029BAB Val_Wu8 15.00 DFES_OneToOne 0.00 15.00 EXTENDED_LIMITS 0.00 255.0 /end CHARACTERISTIC
/begin CHARACTERISTIC DFES_DbLv.DFC_VSwVlvHBrgOvrCurr_C "DFES/Entprelllevel zur Erstellung eines DFES Eintrages für Prüfung DFC_VSwVlvHBrgOvrCurr" VALUE 0x80029BAC Val_Wu8 15.00 DFES_OneToOne 0.00 15.00 EXTENDED_LIMITS 0.00 255.0 /end CHARACTERISTIC
/begin CHARACTERISTIC DFES_DbLv.DFC_VSwVlvHBrgOvrTemp_C "DFES/Entprelllevel zur Erstellung eines DFES Eintrages für Prüfung DFC_VSwVlvHBrgOvrTemp" VALUE 0x80029BAD Val_Wu8 15.00 DFES_OneToOne 0.00 15.00 EXTENDED_LIMITS 0.00 255.0 /end CHARACTERISTIC
/begin CHARACTERISTIC DFES_DbLv.DFC_VSwVlvHBrgShCirBatt1_C "DFES/Entprelllevel zur Erstellung eines DFES Eintrages für Prüfung DFC_VSwVlvHBrgShCirBatt1" VALUE 0x80029BAE Val_Wu8 15.00 DFES_OneToOne 0.00 15.00 EXTENDED_LIMITS 0.00 255.0 /end CHARACTERISTIC
/begin CHARACTERISTIC DFES_DbLv.DFC_VSwVlvHBrgShCirBatt2_C "DFES/Entprelllevel zur Erstellung eines DFES Eintrages für Prüfung DFC_VSwVlvHBrgShCirBatt2" VALUE 0x80029BAF Val_Wu8 15.00 DFES_OneToOne 0.00 15.00 EXTENDED_LIMITS 0.00 255.0 /end CHARACTERISTIC
/begin CHARACTERISTIC DFES_DbLv.DFC_VSwVlvHBrgShCirGnd1_C "DFES/Entprelllevel zur Erstellung eines DFES Eintrages für Prüfung DFC_VSwVlvHBrgShCirGnd1" VALUE 0x80029BB0 Val_Wu8 15.00 DFES_OneToOne 0.00 15.00 EXTENDED_LIMITS 0.00 255.0 /end CHARACTERISTIC
/begin CHARACTERISTIC DFES_DbLv.DFC_VSwVlvHBrgShCirGnd2_C "DFES/Entprelllevel zur Erstellung eines DFES Eintrages für Prüfung DFC_VSwVlvHBrgShCirGnd2" VALUE 0x80029BB1 Val_Wu8 15.00 DFES_OneToOne 0.00 15.00 EXTENDED_LIMITS 0.00 255.0 /end CHARACTERISTIC
/begin CHARACTERISTIC DFES_DbLv.DFC_VSwVlvHBrgShCirOvrLd_C "DFES/Entprelllevel zur Erstellung eines DFES Eintrages für Prüfung DFC_VSwVlvHBrgShCirOvrLd" VALUE 0x80029BB2 Val_Wu8 15.00 DFES_OneToOne 0.00 15.00 EXTENDED_LIMITS 0.00 255.0 /end CHARACTERISTIC
/begin CHARACTERISTIC DFES_DbLv.DFC_VSwVlvHBrgTempOvrCurr_C "DFES/Entprelllevel zur Erstellung eines DFES Eintrages für Prüfung DFC_VSwVlvHBrgTempOvrCurr" VALUE 0x80029BB3 Val_Wu8 15.00 DFES_OneToOne 0.00 15.00 EXTENDED_LIMITS 0.00 255.0 /end CHARACTERISTIC
/begin CHARACTERISTIC DFES_DbLv.DFC_VSwVlvHBrgUndrVltg_C "DFES/Entprelllevel zur Erstellung eines DFES Eintrages für Prüfung DFC_VSwVlvHBrgUndrVltg" VALUE 0x80029BB4 Val_Wu8 15.00 DFES_OneToOne 0.00 15.00 EXTENDED_LIMITS 0.00 255.0 /end CHARACTERISTIC
/begin CHARACTERISTIC DFES_DbLv.DFC_VSwVlvOL_C "DFES/Entprelllevel zur Erstellung eines DFES Eintrages für Prüfung DFC_VSwVlvOL" VALUE 0x80029BB5 Val_Wu8 15.00 DFES_OneToOne 0.00 15.00 EXTENDED_LIMITS 0.00 255.0 /end CHARACTERISTIC
/begin CHARACTERISTIC DFES_DbLv.DFC_VSwVlvSCB_C "DFES/Entprelllevel zur Erstellung eines DFES Eintrages für Prüfung DFC_VSwVlvSCB" VALUE 0x80029BB6 Val_Wu8 15.00 DFES_OneToOne 0.00 15.00 EXTENDED_LIMITS 0.00 255.0 /end CHARACTERISTIC
/begin CHARACTERISTIC DFES_DbLv.DFC_VSwVlvSCG_C "DFES/Entprelllevel zur Erstellung eines DFES Eintrages für Prüfung DFC_VSwVlvSCG" VALUE 0x80029BB7 Val_Wu8 15.00 DFES_OneToOne 0.00 15.00 EXTENDED_LIMITS 0.00 255.0 /end CHARACTERISTIC
/begin CHARACTERISTIC DFES_DbLv.DFC_VSwVlvSRCMax_C "DFES/Entprelllevel zur Erstellung eines DFES Eintrages für Prüfung DFC_VSwVlvSRCMax" VALUE 0x80029BB8 Val_Wu8 15.00 DFES_OneToOne 0.00 15.00 EXTENDED_LIMITS 0.00 255.0 /end CHARACTERISTIC
/begin CHARACTERISTIC DFES_DbLv.DFC_VSwVlvSRCMin_C "DFES/Entprelllevel zur Erstellung eines DFES Eintrages für Prüfung DFC_VSwVlvSRCMin" VALUE 0x80029BB9 Val_Wu8 15.00 DFES_OneToOne 0.00 15.00 EXTENDED_LIMITS 0.00 255.0 /end CHARACTERISTIC
/begin CHARACTERISTIC DFES_DbLv.DFC_ClthNpl_C "DFES/Entprelllevel zur Erstellung eines DFES Eintrages für Prüfung DFC_ClthNpl" VALUE 0x80029BBA Val_Wu8 15.00 DFES_OneToOne 0.00 15.00 EXTENDED_LIMITS 0.00 255.0 /end CHARACTERISTIC
/begin CHARACTERISTIC DFES_DbLv.DFC_ETClbETMax_0_C "DFES/Entprelllevel zur Erstellung eines DFES Eintrages für Prüfung DFC_ETClbETMax_0" VALUE 0x80029BBB Val_Wu8 15.00 DFES_OneToOne 0.00 15.00 EXTENDED_LIMITS 0.00 255.0 /end CHARACTERISTIC
/begin CHARACTERISTIC DFES_DbLv.DFC_ETClbETMax_1_C "DFES/Entprelllevel zur Erstellung eines DFES Eintrages für Prüfung DFC_ETClbETMax_1" VALUE 0x80029BBC Val_Wu8 15.00 DFES_OneToOne 0.00 15.00 EXTENDED_LIMITS 0.00 255.0 /end CHARACTERISTIC
/begin CHARACTERISTIC DFES_DbLv.DFC_ETClbETMax_2_C "DFES/Entprelllevel zur Erstellung eines DFES Eintrages für Prüfung DFC_ETClbETMax_2" VALUE 0x80029BBD Val_Wu8 15.00 DFES_OneToOne 0.00 15.00 EXTENDED_LIMITS 0.00 255.0 /end CHARACTERISTIC
/begin CHARACTERISTIC DFES_DbLv.DFC_ETClbETMax_3_C "DFES/Entprelllevel zur Erstellung eines DFES Eintrages für Prüfung DFC_ETClbETMax_3" VALUE 0x80029BBE Val_Wu8 15.00 DFES_OneToOne 0.00 15.00 EXTENDED_LIMITS 0.00 255.0 /end CHARACTERISTIC
/begin CHARACTERISTIC DFES_DbLv.DFC_ETClbETMax_4_C "DFES/Entprelllevel zur Erstellung eines DFES Eintrages für Prüfung DFC_ETClbETMax_4" VALUE 0x80029BBF Val_Wu8 15.00 DFES_OneToOne 0.00 15.00 EXTENDED_LIMITS 0.00 255.0 /end CHARACTERISTIC
/begin CHARACTERISTIC DFES_DbLv.DFC_ETClbETMax_5_C "DFES/Entprelllevel zur Erstellung eines DFES Eintrages für Prüfung DFC_ETClbETMax_5" VALUE 0x80029BC0 Val_Wu8 15.00 DFES_OneToOne 0.00 15.00 EXTENDED_LIMITS 0.00 255.0 /end CHARACTERISTIC
/begin CHARACTERISTIC DFES_DbLv.DFC_ETClbETMin_0_C "DFES/Entprelllevel zur Erstellung eines DFES Eintrages für Prüfung DFC_ETClbETMin_0" VALUE 0x80029BC1 Val_Wu8 15.00 DFES_OneToOne 0.00 15.00 EXTENDED_LIMITS 0.00 255.0 /end CHARACTERISTIC
/begin CHARACTERISTIC DFES_DbLv.DFC_ETClbETMin_1_C "DFES/Entprelllevel zur Erstellung eines DFES Eintrages für Prüfung DFC_ETClbETMin_1" VALUE 0x80029BC2 Val_Wu8 15.00 DFES_OneToOne 0.00 15.00 EXTENDED_LIMITS 0.00 255.0 /end CHARACTERISTIC
/begin CHARACTERISTIC DFES_DbLv.DFC_ETClbETMin_2_C "DFES/Entprelllevel zur Erstellung eines DFES Eintrages für Prüfung DFC_ETClbETMin_2" VALUE 0x80029BC3 Val_Wu8 15.00 DFES_OneToOne 0.00 15.00 EXTENDED_LIMITS 0.00 255.0 /end CHARACTERISTIC
/begin CHARACTERISTIC DFES_DbLv.DFC_ETClbETMin_3_C "DFES/Entprelllevel zur Erstellung eines DFES Eintrages für Prüfung DFC_ETClbETMin_3" VALUE 0x80029BC4 Val_Wu8 15.00 DFES_OneToOne 0.00 15.00 EXTENDED_LIMITS 0.00 255.0 /end CHARACTERISTIC
/begin CHARACTERISTIC DFES_DbLv.DFC_ETClbETMin_4_C "DFES/Entprelllevel zur Erstellung eines DFES Eintrages für Prüfung DFC_ETClbETMin_4" VALUE 0x80029BC5 Val_Wu8 15.00 DFES_OneToOne 0.00 15.00 EXTENDED_LIMITS 0.00 255.0 /end CHARACTERISTIC
/begin CHARACTERISTIC DFES_DbLv.DFC_ETClbETMin_5_C "DFES/Entprelllevel zur Erstellung eines DFES Eintrages für Prüfung DFC_ETClbETMin_5" VALUE 0x80029BC6 Val_Wu8 15.00 DFES_OneToOne 0.00 15.00 EXTENDED_LIMITS 0.00 255.0 /end CHARACTERISTIC
/begin CHARACTERISTIC DFES_DbLv.DFC_IVActrEnrgMax_0_C "DFES/Entprelllevel zur Erstellung eines DFES Eintrages für Prüfung DFC_IVActrEnrgMax_0" VALUE 0x80029BC7 Val_Wu8 15.00 DFES_OneToOne 0.00 15.00 EXTENDED_LIMITS 0.00 255.0 /end CHARACTERISTIC
/begin CHARACTERISTIC DFES_DbLv.DFC_IVActrEnrgMax_1_C "DFES/Entprelllevel zur Erstellung eines DFES Eintrages für Prüfung DFC_IVActrEnrgMax_1" VALUE 0x80029BC8 Val_Wu8 15.00 DFES_OneToOne 0.00 15.00 EXTENDED_LIMITS 0.00 255.0 /end CHARACTERISTIC
/begin CHARACTERISTIC DFES_DbLv.DFC_IVActrEnrgMax_2_C "DFES/Entprelllevel zur Erstellung eines DFES Eintrages für Prüfung DFC_IVActrEnrgMax_2" VALUE 0x80029BC9 Val_Wu8 15.00 DFES_OneToOne 0.00 15.00 EXTENDED_LIMITS 0.00 255.0 /end CHARACTERISTIC
/begin CHARACTERISTIC DFES_DbLv.DFC_IVActrEnrgMax_3_C "DFES/Entprelllevel zur Erstellung eines DFES Eintrages für Prüfung DFC_IVActrEnrgMax_3" VALUE 0x80029BCA Val_Wu8 15.00 DFES_OneToOne 0.00 15.00 EXTENDED_LIMITS 0.00 255.0 /end CHARACTERISTIC
/begin CHARACTERISTIC DFES_DbLv.DFC_IVActrEnrgMax_4_C "DFES/Entprelllevel zur Erstellung eines DFES Eintrages für Prüfung DFC_IVActrEnrgMax_4" VALUE 0x80029BCB Val_Wu8 15.00 DFES_OneToOne 0.00 15.00 EXTENDED_LIMITS 0.00 255.0 /end CHARACTERISTIC
/begin CHARACTERISTIC DFES_DbLv.DFC_IVActrEnrgMax_5_C "DFES/Entprelllevel zur Erstellung eines DFES Eintrages für Prüfung DFC_IVActrEnrgMax_5" VALUE 0x80029BCC Val_Wu8 15.00 DFES_OneToOne 0.00 15.00 EXTENDED_LIMITS 0.00 255.0 /end CHARACTERISTIC
/begin CHARACTERISTIC DFES_DbLv.DFC_IVActrEnrgMax_6_C "DFES/Entprelllevel zur Erstellung eines DFES Eintrages für Prüfung DFC_IVActrEnrgMax_6" VALUE 0x80029BCD Val_Wu8 15.00 DFES_OneToOne 0.00 15.00 EXTENDED_LIMITS 0.00 255.0 /end CHARACTERISTIC
/begin CHARACTERISTIC DFES_DbLv.DFC_IVActrEnrgMax_7_C "DFES/Entprelllevel zur Erstellung eines DFES Eintrages für Prüfung DFC_IVActrEnrgMax_7" VALUE 0x80029BCE Val_Wu8 15.00 DFES_OneToOne 0.00 15.00 EXTENDED_LIMITS 0.00 255.0 /end CHARACTERISTIC
/begin CHARACTERISTIC DFES_DbLv.DFC_IVActrEnrgMin_0_C "DFES/Entprelllevel zur Erstellung eines DFES Eintrages für Prüfung DFC_IVActrEnrgMin_0" VALUE 0x80029BCF Val_Wu8 15.00 DFES_OneToOne 0.00 15.00 EXTENDED_LIMITS 0.00 255.0 /end CHARACTERISTIC
/begin CHARACTERISTIC DFES_DbLv.DFC_IVActrEnrgMin_1_C "DFES/Entprelllevel zur Erstellung eines DFES Eintrages für Prüfung DFC_IVActrEnrgMin_1" VALUE 0x80029BD0 Val_Wu8 15.00 DFES_OneToOne 0.00 15.00 EXTENDED_LIMITS 0.00 255.0 /end CHARACTERISTIC
/begin CHARACTERISTIC DFES_DbLv.DFC_IVActrEnrgMin_2_C "DFES/Entprelllevel zur Erstellung eines DFES Eintrages für Prüfung DFC_IVActrEnrgMin_2" VALUE 0x80029BD1 Val_Wu8 15.00 DFES_OneToOne 0.00 15.00 EXTENDED_LIMITS 0.00 255.0 /end CHARACTERISTIC
/begin CHARACTERISTIC DFES_DbLv.DFC_IVActrEnrgMin_3_C "DFES/Entprelllevel zur Erstellung eines DFES Eintrages für Prüfung DFC_IVActrEnrgMin_3" VALUE 0x80029BD2 Val_Wu8 15.00 DFES_OneToOne 0.00 15.00 EXTENDED_LIMITS 0.00 255.0 /end CHARACTERISTIC
/begin CHARACTERISTIC DFES_DbLv.DFC_IVActrEnrgMin_4_C "DFES/Entprelllevel zur Erstellung eines DFES Eintrages für Prüfung DFC_IVActrEnrgMin_4" VALUE 0x80029BD3 Val_Wu8 15.00 DFES_OneToOne 0.00 15.00 EXTENDED_LIMITS 0.00 255.0 /end CHARACTERISTIC
/begin CHARACTERISTIC DFES_DbLv.DFC_IVActrEnrgMin_5_C "DFES/Entprelllevel zur Erstellung eines DFES Eintrages für Prüfung DFC_IVActrEnrgMin_5" VALUE 0x80029BD4 Val_Wu8 15.00 DFES_OneToOne 0.00 15.00 EXTENDED_LIMITS 0.00 255.0 /end CHARACTERISTIC
/begin CHARACTERISTIC DFES_DbLv.DFC_IVActrEnrgMin_6_C "DFES/Entprelllevel zur Erstellung eines DFES Eintrages für Prüfung DFC_IVActrEnrgMin_6" VALUE 0x80029BD5 Val_Wu8 15.00 DFES_OneToOne 0.00 15.00 EXTENDED_LIMITS 0.00 255.0 /end CHARACTERISTIC
/begin CHARACTERISTIC DFES_DbLv.DFC_IVActrEnrgMin_7_C "DFES/Entprelllevel zur Erstellung eines DFES Eintrages für Prüfung DFC_IVActrEnrgMin_7" VALUE 0x80029BD6 Val_Wu8 15.00 DFES_OneToOne 0.00 15.00 EXTENDED_LIMITS 0.00 255.0 /end CHARACTERISTIC
/begin CHARACTERISTIC DFES_DbLv.DFC_IVActrEnrgPlaus_0_C "DFES/Entprelllevel zur Erstellung eines DFES Eintrages für Prüfung DFC_IVActrEnrgPlaus_0" VALUE 0x80029BD7 Val_Wu8 15.00 DFES_OneToOne 0.00 15.00 EXTENDED_LIMITS 0.00 255.0 /end CHARACTERISTIC
/begin CHARACTERISTIC DFES_DbLv.DFC_IVActrEnrgPlaus_1_C "DFES/Entprelllevel zur Erstellung eines DFES Eintrages für Prüfung DFC_IVActrEnrgPlaus_1" VALUE 0x80029BD8 Val_Wu8 15.00 DFES_OneToOne 0.00 15.00 EXTENDED_LIMITS 0.00 255.0 /end CHARACTERISTIC
/begin CHARACTERISTIC DFES_DbLv.DFC_IVActrEnrgPlaus_2_C "DFES/Entprelllevel zur Erstellung eines DFES Eintrages für Prüfung DFC_IVActrEnrgPlaus_2" VALUE 0x80029BD9 Val_Wu8 15.00 DFES_OneToOne 0.00 15.00 EXTENDED_LIMITS 0.00 255.0 /end CHARACTERISTIC
/begin CHARACTERISTIC DFES_DbLv.DFC_IVActrEnrgPlaus_3_C "DFES/Entprelllevel zur Erstellung eines DFES Eintrages für Prüfung DFC_IVActrEnrgPlaus_3" VALUE 0x80029BDA Val_Wu8 15.00 DFES_OneToOne 0.00 15.00 EXTENDED_LIMITS 0.00 255.0 /end CHARACTERISTIC
/begin CHARACTERISTIC DFES_DbLv.DFC_IVActrEnrgPlaus_4_C "DFES/Entprelllevel zur Erstellung eines DFES Eintrages für Prüfung DFC_IVActrEnrgPlaus_4" VALUE 0x80029BDB Val_Wu8 15.00 DFES_OneToOne 0.00 15.00 EXTENDED_LIMITS 0.00 255.0 /end CHARACTERISTIC
/begin CHARACTERISTIC DFES_DbLv.DFC_IVActrEnrgPlaus_5_C "DFES/Entprelllevel zur Erstellung eines DFES Eintrages für Prüfung DFC_IVActrEnrgPlaus_5" VALUE 0x80029BDC Val_Wu8 15.00 DFES_OneToOne 0.00 15.00 EXTENDED_LIMITS 0.00 255.0 /end CHARACTERISTIC
/begin CHARACTERISTIC DFES_DbLv.DFC_IVActrEnrgPlaus_6_C "DFES/Entprelllevel zur Erstellung eines DFES Eintrages für Prüfung DFC_IVActrEnrgPlaus_6" VALUE 0x80029BDD Val_Wu8 15.00 DFES_OneToOne 0.00 15.00 EXTENDED_LIMITS 0.00 255.0 /end CHARACTERISTIC
/begin CHARACTERISTIC DFES_DbLv.DFC_IVActrEnrgPlaus_7_C "DFES/Entprelllevel zur Erstellung eines DFES Eintrages für Prüfung DFC_IVActrEnrgPlaus_7" VALUE 0x80029BDE Val_Wu8 15.00 DFES_OneToOne 0.00 15.00 EXTENDED_LIMITS 0.00 255.0 /end CHARACTERISTIC
/begin CHARACTERISTIC DFES_DbLv.DFC_IVCtlTiDiff_0_C "DFES/Entprelllevel zur Erstellung eines DFES Eintrages für Prüfung DFC_IVCtlTiDiff_0" VALUE 0x80029BDF Val_Wu8 15.00 DFES_OneToOne 0.00 15.00 EXTENDED_LIMITS 0.00 255.0 /end CHARACTERISTIC
/begin CHARACTERISTIC DFES_DbLv.DFC_IVCtlTiDiff_1_C "DFES/Entprelllevel zur Erstellung eines DFES Eintrages für Prüfung DFC_IVCtlTiDiff_1" VALUE 0x80029BE0 Val_Wu8 15.00 DFES_OneToOne 0.00 15.00 EXTENDED_LIMITS 0.00 255.0 /end CHARACTERISTIC
/begin CHARACTERISTIC DFES_DbLv.DFC_IVCtlTiDiff_2_C "DFES/Entprelllevel zur Erstellung eines DFES Eintrages für Prüfung DFC_IVCtlTiDiff_2" VALUE 0x80029BE1 Val_Wu8 15.00 DFES_OneToOne 0.00 15.00 EXTENDED_LIMITS 0.00 255.0 /end CHARACTERISTIC
/begin CHARACTERISTIC DFES_DbLv.DFC_IVCtlTiDiff_3_C "DFES/Entprelllevel zur Erstellung eines DFES Eintrages für Prüfung DFC_IVCtlTiDiff_3" VALUE 0x80029BE2 Val_Wu8 15.00 DFES_OneToOne 0.00 15.00 EXTENDED_LIMITS 0.00 255.0 /end CHARACTERISTIC
/begin CHARACTERISTIC DFES_DbLv.DFC_IVCtlTiDiff_4_C "DFES/Entprelllevel zur Erstellung eines DFES Eintrages für Prüfung DFC_IVCtlTiDiff_4" VALUE 0x80029BE3 Val_Wu8 15.00 DFES_OneToOne 0.00 15.00 EXTENDED_LIMITS 0.00 255.0 /end CHARACTERISTIC
/begin CHARACTERISTIC DFES_DbLv.DFC_IVCtlTiDiff_5_C "DFES/Entprelllevel zur Erstellung eines DFES Eintrages für Prüfung DFC_IVCtlTiDiff_5" VALUE 0x80029BE4 Val_Wu8 15.00 DFES_OneToOne 0.00 15.00 EXTENDED_LIMITS 0.00 255.0 /end CHARACTERISTIC
/begin CHARACTERISTIC DFES_DbLv.DFC_IVCtlUDiffUp_0_C "DFES/Entprelllevel zur Erstellung eines DFES Eintrages für Prüfung DFC_IVCtlUDiffUp_0" VALUE 0x80029BE5 Val_Wu8 15.00 DFES_OneToOne 0.00 15.00 EXTENDED_LIMITS 0.00 255.0 /end CHARACTERISTIC
/begin CHARACTERISTIC DFES_DbLv.DFC_IVCtlUDiffUp_1_C "DFES/Entprelllevel zur Erstellung eines DFES Eintrages für Prüfung DFC_IVCtlUDiffUp_1" VALUE 0x80029BE6 Val_Wu8 15.00 DFES_OneToOne 0.00 15.00 EXTENDED_LIMITS 0.00 255.0 /end CHARACTERISTIC
/begin CHARACTERISTIC DFES_DbLv.DFC_IVCtlUDiffUp_2_C "DFES/Entprelllevel zur Erstellung eines DFES Eintrages für Prüfung DFC_IVCtlUDiffUp_2" VALUE 0x80029BE7 Val_Wu8 15.00 DFES_OneToOne 0.00 15.00 EXTENDED_LIMITS 0.00 255.0 /end CHARACTERISTIC
/begin CHARACTERISTIC DFES_DbLv.DFC_IVCtlUDiffUp_3_C "DFES/Entprelllevel zur Erstellung eines DFES Eintrages für Prüfung DFC_IVCtlUDiffUp_3" VALUE 0x80029BE8 Val_Wu8 15.00 DFES_OneToOne 0.00 15.00 EXTENDED_LIMITS 0.00 255.0 /end CHARACTERISTIC
/begin CHARACTERISTIC DFES_DbLv.DFC_IVCtlUDiffUp_4_C "DFES/Entprelllevel zur Erstellung eines DFES Eintrages für Prüfung DFC_IVCtlUDiffUp_4" VALUE 0x80029BE9 Val_Wu8 15.00 DFES_OneToOne 0.00 15.00 EXTENDED_LIMITS 0.00 255.0 /end CHARACTERISTIC
/begin CHARACTERISTIC DFES_DbLv.DFC_IVCtlUDiffUp_5_C "DFES/Entprelllevel zur Erstellung eines DFES Eintrages für Prüfung DFC_IVCtlUDiffUp_5" VALUE 0x80029BEA Val_Wu8 15.00 DFES_OneToOne 0.00 15.00 EXTENDED_LIMITS 0.00 255.0 /end CHARACTERISTIC
/begin CHARACTERISTIC DFES_DbLv.DFC_IVCtlUUp_0_C "DFES/Entprelllevel zur Erstellung eines DFES Eintrages für Prüfung DFC_IVCtlUUp_0" VALUE 0x80029BEB Val_Wu8 15.00 DFES_OneToOne 0.00 15.00 EXTENDED_LIMITS 0.00 255.0 /end CHARACTERISTIC
/begin CHARACTERISTIC DFES_DbLv.DFC_IVCtlUUp_1_C "DFES/Entprelllevel zur Erstellung eines DFES Eintrages für Prüfung DFC_IVCtlUUp_1" VALUE 0x80029BEC Val_Wu8 15.00 DFES_OneToOne 0.00 15.00 EXTENDED_LIMITS 0.00 255.0 /end CHARACTERISTIC
/begin CHARACTERISTIC DFES_DbLv.DFC_IVCtlUUp_2_C "DFES/Entprelllevel zur Erstellung eines DFES Eintrages für Prüfung DFC_IVCtlUUp_2" VALUE 0x80029BED Val_Wu8 15.00 DFES_OneToOne 0.00 15.00 EXTENDED_LIMITS 0.00 255.0 /end CHARACTERISTIC
/begin CHARACTERISTIC DFES_DbLv.DFC_IVCtlUUp_3_C "DFES/Entprelllevel zur Erstellung eines DFES Eintrages für Prüfung DFC_IVCtlUUp_3" VALUE 0x80029BEE Val_Wu8 15.00 DFES_OneToOne 0.00 15.00 EXTENDED_LIMITS 0.00 255.0 /end CHARACTERISTIC
/begin CHARACTERISTIC DFES_DbLv.DFC_IVCtlUUp_4_C "DFES/Entprelllevel zur Erstellung eines DFES Eintrages für Prüfung DFC_IVCtlUUp_4" VALUE 0x80029BEF Val_Wu8 15.00 DFES_OneToOne 0.00 15.00 EXTENDED_LIMITS 0.00 255.0 /end CHARACTERISTIC
/begin CHARACTERISTIC DFES_DbLv.DFC_IVCtlUUp_5_C "DFES/Entprelllevel zur Erstellung eines DFES Eintrages für Prüfung DFC_IVCtlUUp_5" VALUE 0x80029BF0 Val_Wu8 15.00 DFES_OneToOne 0.00 15.00 EXTENDED_LIMITS 0.00 255.0 /end CHARACTERISTIC
/begin CHARACTERISTIC DFES_DbLv.DFC_IVDiaBnkShCir_0_C "DFES/Entprelllevel zur Erstellung eines DFES Eintrages für Prüfung DFC_IVDiaBnkShCir_0" VALUE 0x80029BF1 Val_Wu8 15.00 DFES_OneToOne 0.00 15.00 EXTENDED_LIMITS 0.00 255.0 /end CHARACTERISTIC
/begin CHARACTERISTIC DFES_DbLv.DFC_IVDiaBnkShCir_1_C "DFES/Entprelllevel zur Erstellung eines DFES Eintrages für Prüfung DFC_IVDiaBnkShCir_1" VALUE 0x80029BF2 Val_Wu8 15.00 DFES_OneToOne 0.00 15.00 EXTENDED_LIMITS 0.00 255.0 /end CHARACTERISTIC
/begin CHARACTERISTIC DFES_DbLv.DFC_IVDiaBnkShCirChSwt_0_C "DFES/Entprelllevel zur Erstellung eines DFES Eintrages für Prüfung DFC_IVDiaBnkShCirChSwt_0" VALUE 0x80029BF3 Val_Wu8 15.00 DFES_OneToOne 0.00 15.00 EXTENDED_LIMITS 0.00 255.0 /end CHARACTERISTIC
/begin CHARACTERISTIC DFES_DbLv.DFC_IVDiaBnkShCirChSwt_1_C "DFES/Entprelllevel zur Erstellung eines DFES Eintrages für Prüfung DFC_IVDiaBnkShCirChSwt_1" VALUE 0x80029BF4 Val_Wu8 15.00 DFES_OneToOne 0.00 15.00 EXTENDED_LIMITS 0.00 255.0 /end CHARACTERISTIC
/begin CHARACTERISTIC DFES_DbLv.DFC_IVDiaChp_0_C "DFES/Entprelllevel zur Erstellung eines DFES Eintrages für Prüfung DFC_IVDiaChp_0" VALUE 0x80029BF5 Val_Wu8 15.00 DFES_OneToOne 0.00 15.00 EXTENDED_LIMITS 0.00 255.0 /end CHARACTERISTIC
/begin CHARACTERISTIC DFES_DbLv.DFC_IVDiaChp_1_C "DFES/Entprelllevel zur Erstellung eines DFES Eintrages für Prüfung DFC_IVDiaChp_1" VALUE 0x80029BF6 Val_Wu8 15.00 DFES_OneToOne 0.00 15.00 EXTENDED_LIMITS 0.00 255.0 /end CHARACTERISTIC
/begin CHARACTERISTIC DFES_DbLv.DFC_IVDiaCylNoCls_0_C "DFES/Entprelllevel zur Erstellung eines DFES Eintrages für Prüfung DFC_IVDiaCylNoCls_0" VALUE 0x80029BF7 Val_Wu8 15.00 DFES_OneToOne 0.00 15.00 EXTENDED_LIMITS 0.00 255.0 /end CHARACTERISTIC
/begin CHARACTERISTIC DFES_DbLv.DFC_IVDiaCylNoCls_1_C "DFES/Entprelllevel zur Erstellung eines DFES Eintrages für Prüfung DFC_IVDiaCylNoCls_1" VALUE 0x80029BF8 Val_Wu8 15.00 DFES_OneToOne 0.00 15.00 EXTENDED_LIMITS 0.00 255.0 /end CHARACTERISTIC
/begin CHARACTERISTIC DFES_DbLv.DFC_IVDiaCylNoCls_2_C "DFES/Entprelllevel zur Erstellung eines DFES Eintrages für Prüfung DFC_IVDiaCylNoCls_2" VALUE 0x80029BF9 Val_Wu8 15.00 DFES_OneToOne 0.00 15.00 EXTENDED_LIMITS 0.00 255.0 /end CHARACTERISTIC
/begin CHARACTERISTIC DFES_DbLv.DFC_IVDiaCylNoCls_3_C "DFES/Entprelllevel zur Erstellung eines DFES Eintrages für Prüfung DFC_IVDiaCylNoCls_3" VALUE 0x80029BFA Val_Wu8 15.00 DFES_OneToOne 0.00 15.00 EXTENDED_LIMITS 0.00 255.0 /end CHARACTERISTIC
/begin CHARACTERISTIC DFES_DbLv.DFC_IVDiaCylNoCls_4_C "DFES/Entprelllevel zur Erstellung eines DFES Eintrages für Prüfung DFC_IVDiaCylNoCls_4" VALUE 0x80029BFB Val_Wu8 15.00 DFES_OneToOne 0.00 15.00 EXTENDED_LIMITS 0.00 255.0 /end CHARACTERISTIC
/begin CHARACTERISTIC DFES_DbLv.DFC_IVDiaCylNoCls_5_C "DFES/Entprelllevel zur Erstellung eines DFES Eintrages für Prüfung DFC_IVDiaCylNoCls_5" VALUE 0x80029BFC Val_Wu8 15.00 DFES_OneToOne 0.00 15.00 EXTENDED_LIMITS 0.00 255.0 /end CHARACTERISTIC
/begin CHARACTERISTIC DFES_DbLv.DFC_IVDiaCylNoLd_0_C "DFES/Entprelllevel zur Erstellung eines DFES Eintrages für Prüfung DFC_IVDiaCylNoLd_0" VALUE 0x80029BFD Val_Wu8 15.00 DFES_OneToOne 0.00 15.00 EXTENDED_LIMITS 0.00 255.0 /end CHARACTERISTIC
/begin CHARACTERISTIC DFES_DbLv.DFC_IVDiaCylNoLd_1_C "DFES/Entprelllevel zur Erstellung eines DFES Eintrages für Prüfung DFC_IVDiaCylNoLd_1" VALUE 0x80029BFE Val_Wu8 15.00 DFES_OneToOne 0.00 15.00 EXTENDED_LIMITS 0.00 255.0 /end CHARACTERISTIC
/begin CHARACTERISTIC DFES_DbLv.DFC_IVDiaCylNoLd_2_C "DFES/Entprelllevel zur Erstellung eines DFES Eintrages für Prüfung DFC_IVDiaCylNoLd_2" VALUE 0x80029BFF Val_Wu8 15.00 DFES_OneToOne 0.00 15.00 EXTENDED_LIMITS 0.00 255.0 /end CHARACTERISTIC
/begin CHARACTERISTIC DFES_DbLv.DFC_IVDiaCylNoLd_3_C "DFES/Entprelllevel zur Erstellung eines DFES Eintrages für Prüfung DFC_IVDiaCylNoLd_3" VALUE 0x80029C00 Val_Wu8 15.00 DFES_OneToOne 0.00 15.00 EXTENDED_LIMITS 0.00 255.0 /end CHARACTERISTIC
/begin CHARACTERISTIC DFES_DbLv.DFC_IVDiaCylNoLd_4_C "DFES/Entprelllevel zur Erstellung eines DFES Eintrages für Prüfung DFC_IVDiaCylNoLd_4" VALUE 0x80029C01 Val_Wu8 15.00 DFES_OneToOne 0.00 15.00 EXTENDED_LIMITS 0.00 255.0 /end CHARACTERISTIC
/begin CHARACTERISTIC DFES_DbLv.DFC_IVDiaCylNoLd_5_C "DFES/Entprelllevel zur Erstellung eines DFES Eintrages für Prüfung DFC_IVDiaCylNoLd_5" VALUE 0x80029C02 Val_Wu8 15.00 DFES_OneToOne 0.00 15.00 EXTENDED_LIMITS 0.00 255.0 /end CHARACTERISTIC
/begin CHARACTERISTIC DFES_DbLv.DFC_IVDiaCylShCir_0_C "DFES/Entprelllevel zur Erstellung eines DFES Eintrages für Prüfung DFC_IVDiaCylShCir_0" VALUE 0x80029C03 Val_Wu8 15.00 DFES_OneToOne 0.00 15.00 EXTENDED_LIMITS 0.00 255.0 /end CHARACTERISTIC
/begin CHARACTERISTIC DFES_DbLv.DFC_IVDiaCylShCir_1_C "DFES/Entprelllevel zur Erstellung eines DFES Eintrages für Prüfung DFC_IVDiaCylShCir_1" VALUE 0x80029C04 Val_Wu8 15.00 DFES_OneToOne 0.00 15.00 EXTENDED_LIMITS 0.00 255.0 /end CHARACTERISTIC
/begin CHARACTERISTIC DFES_DbLv.DFC_IVDiaCylShCir_2_C "DFES/Entprelllevel zur Erstellung eines DFES Eintrages für Prüfung DFC_IVDiaCylShCir_2" VALUE 0x80029C05 Val_Wu8 15.00 DFES_OneToOne 0.00 15.00 EXTENDED_LIMITS 0.00 255.0 /end CHARACTERISTIC
/begin CHARACTERISTIC DFES_DbLv.DFC_IVDiaCylShCir_3_C "DFES/Entprelllevel zur Erstellung eines DFES Eintrages für Prüfung DFC_IVDiaCylShCir_3" VALUE 0x80029C06 Val_Wu8 15.00 DFES_OneToOne 0.00 15.00 EXTENDED_LIMITS 0.00 255.0 /end CHARACTERISTIC
/begin CHARACTERISTIC DFES_DbLv.DFC_IVDiaCylShCir_4_C "DFES/Entprelllevel zur Erstellung eines DFES Eintrages für Prüfung DFC_IVDiaCylShCir_4" VALUE 0x80029C07 Val_Wu8 15.00 DFES_OneToOne 0.00 15.00 EXTENDED_LIMITS 0.00 255.0 /end CHARACTERISTIC
/begin CHARACTERISTIC DFES_DbLv.DFC_IVDiaCylShCir_5_C "DFES/Entprelllevel zur Erstellung eines DFES Eintrages für Prüfung DFC_IVDiaCylShCir_5" VALUE 0x80029C08 Val_Wu8 15.00 DFES_OneToOne 0.00 15.00 EXTENDED_LIMITS 0.00 255.0 /end CHARACTERISTIC
/begin CHARACTERISTIC DFES_DbLv.DFC_IVDiaCylShCirHSLS_0_C "DFES/Entprelllevel zur Erstellung eines DFES Eintrages für Prüfung DFC_IVDiaCylShCirHSLS_0" VALUE 0x80029C09 Val_Wu8 15.00 DFES_OneToOne 0.00 15.00 EXTENDED_LIMITS 0.00 255.0 /end CHARACTERISTIC
/begin CHARACTERISTIC DFES_DbLv.DFC_IVDiaCylShCirHSLS_1_C "DFES/Entprelllevel zur Erstellung eines DFES Eintrages für Prüfung DFC_IVDiaCylShCirHSLS_1" VALUE 0x80029C0A Val_Wu8 15.00 DFES_OneToOne 0.00 15.00 EXTENDED_LIMITS 0.00 255.0 /end CHARACTERISTIC
/begin CHARACTERISTIC DFES_DbLv.DFC_IVDiaCylShCirHSLS_2_C "DFES/Entprelllevel zur Erstellung eines DFES Eintrages für Prüfung DFC_IVDiaCylShCirHSLS_2" VALUE 0x80029C0B Val_Wu8 15.00 DFES_OneToOne 0.00 15.00 EXTENDED_LIMITS 0.00 255.0 /end CHARACTERISTIC
/begin CHARACTERISTIC DFES_DbLv.DFC_IVDiaCylShCirHSLS_3_C "DFES/Entprelllevel zur Erstellung eines DFES Eintrages für Prüfung DFC_IVDiaCylShCirHSLS_3" VALUE 0x80029C0C Val_Wu8 15.00 DFES_OneToOne 0.00 15.00 EXTENDED_LIMITS 0.00 255.0 /end CHARACTERISTIC
/begin CHARACTERISTIC DFES_DbLv.DFC_IVDiaCylShCirHSLS_4_C "DFES/Entprelllevel zur Erstellung eines DFES Eintrages für Prüfung DFC_IVDiaCylShCirHSLS_4" VALUE 0x80029C0D Val_Wu8 15.00 DFES_OneToOne 0.00 15.00 EXTENDED_LIMITS 0.00 255.0 /end CHARACTERISTIC
/begin CHARACTERISTIC DFES_DbLv.DFC_IVDiaCylShCirHSLS_5_C "DFES/Entprelllevel zur Erstellung eines DFES Eintrages für Prüfung DFC_IVDiaCylShCirHSLS_5" VALUE 0x80029C0E Val_Wu8 15.00 DFES_OneToOne 0.00 15.00 EXTENDED_LIMITS 0.00 255.0 /end CHARACTERISTIC
/begin CHARACTERISTIC DFES_DbLv.DFC_IVDiaCylShCirMeas_0_C "DFES/Entprelllevel zur Erstellung eines DFES Eintrages für Prüfung DFC_IVDiaCylShCirMeas_0" VALUE 0x80029C0F Val_Wu8 15.00 DFES_OneToOne 0.00 15.00 EXTENDED_LIMITS 0.00 255.0 /end CHARACTERISTIC
/begin CHARACTERISTIC DFES_DbLv.DFC_IVDiaCylShCirMeas_1_C "DFES/Entprelllevel zur Erstellung eines DFES Eintrages für Prüfung DFC_IVDiaCylShCirMeas_1" VALUE 0x80029C10 Val_Wu8 15.00 DFES_OneToOne 0.00 15.00 EXTENDED_LIMITS 0.00 255.0 /end CHARACTERISTIC
/begin CHARACTERISTIC DFES_DbLv.DFC_IVDiaCylShCirMeas_2_C "DFES/Entprelllevel zur Erstellung eines DFES Eintrages für Prüfung DFC_IVDiaCylShCirMeas_2" VALUE 0x80029C11 Val_Wu8 15.00 DFES_OneToOne 0.00 15.00 EXTENDED_LIMITS 0.00 255.0 /end CHARACTERISTIC
/begin CHARACTERISTIC DFES_DbLv.DFC_IVDiaCylShCirMeas_3_C "DFES/Entprelllevel zur Erstellung eines DFES Eintrages für Prüfung DFC_IVDiaCylShCirMeas_3" VALUE 0x80029C12 Val_Wu8 15.00 DFES_OneToOne 0.00 15.00 EXTENDED_LIMITS 0.00 255.0 /end CHARACTERISTIC
/begin CHARACTERISTIC DFES_DbLv.DFC_IVDiaCylShCirMeas_4_C "DFES/Entprelllevel zur Erstellung eines DFES Eintrages für Prüfung DFC_IVDiaCylShCirMeas_4" VALUE 0x80029C13 Val_Wu8 15.00 DFES_OneToOne 0.00 15.00 EXTENDED_LIMITS 0.00 255.0 /end CHARACTERISTIC
/begin CHARACTERISTIC DFES_DbLv.DFC_IVDiaCylShCirMeas_5_C "DFES/Entprelllevel zur Erstellung eines DFES Eintrages für Prüfung DFC_IVDiaCylShCirMeas_5" VALUE 0x80029C14 Val_Wu8 15.00 DFES_OneToOne 0.00 15.00 EXTENDED_LIMITS 0.00 255.0 /end CHARACTERISTIC
/begin CHARACTERISTIC DFES_DbLv.DFC_LSUDynChk_C "DFES/Entprelllevel zur Erstellung eines DFES Eintrages für Prüfung DFC_LSUDynChk" VALUE 0x80029C15 Val_Wu8 15.00 DFES_OneToOne 0.00 15.00 EXTENDED_LIMITS 0.00 255.0 /end CHARACTERISTIC
/begin CHARACTERISTIC DFES_DbLv.DFC_LSUO2ClbMax_C "DFES/Entprelllevel zur Erstellung eines DFES Eintrages für Prüfung DFC_LSUO2ClbMax" VALUE 0x80029C16 Val_Wu8 15.00 DFES_OneToOne 0.00 15.00 EXTENDED_LIMITS 0.00 255.0 /end CHARACTERISTIC
/begin CHARACTERISTIC DFES_DbLv.DFC_LSUO2ClbMin_C "DFES/Entprelllevel zur Erstellung eines DFES Eintrages für Prüfung DFC_LSUO2ClbMin" VALUE 0x80029C17 Val_Wu8 15.00 DFES_OneToOne 0.00 15.00 EXTENDED_LIMITS 0.00 255.0 /end CHARACTERISTIC
/begin CHARACTERISTIC DFES_DbLv.DFC_LSUO2PlausMaxFLd_C "DFES/Entprelllevel zur Erstellung eines DFES Eintrages für Prüfung DFC_LSUO2PlausMaxFLd" VALUE 0x80029C18 Val_Wu8 15.00 DFES_OneToOne 0.00 15.00 EXTENDED_LIMITS 0.00 255.0 /end CHARACTERISTIC
/begin CHARACTERISTIC DFES_DbLv.DFC_LSUO2PlausMaxOvrRun_C "DFES/Entprelllevel zur Erstellung eines DFES Eintrages für Prüfung DFC_LSUO2PlausMaxOvrRun" VALUE 0x80029C19 Val_Wu8 15.00 DFES_OneToOne 0.00 15.00 EXTENDED_LIMITS 0.00 255.0 /end CHARACTERISTIC
/begin CHARACTERISTIC DFES_DbLv.DFC_LSUO2PlausMaxPartLd_C "DFES/Entprelllevel zur Erstellung eines DFES Eintrages für Prüfung DFC_LSUO2PlausMaxPartLd" VALUE 0x80029C1A Val_Wu8 15.00 DFES_OneToOne 0.00 15.00 EXTENDED_LIMITS 0.00 255.0 /end CHARACTERISTIC
/begin CHARACTERISTIC DFES_DbLv.DFC_LSUO2PlausMinFLd_C "DFES/Entprelllevel zur Erstellung eines DFES Eintrages für Prüfung DFC_LSUO2PlausMinFLd" VALUE 0x80029C1B Val_Wu8 15.00 DFES_OneToOne 0.00 15.00 EXTENDED_LIMITS 0.00 255.0 /end CHARACTERISTIC
/begin CHARACTERISTIC DFES_DbLv.DFC_LSUO2PlausMinOvrRun_C "DFES/Entprelllevel zur Erstellung eines DFES Eintrages für Prüfung DFC_LSUO2PlausMinOvrRun" VALUE 0x80029C1C Val_Wu8 15.00 DFES_OneToOne 0.00 15.00 EXTENDED_LIMITS 0.00 255.0 /end CHARACTERISTIC
/begin CHARACTERISTIC DFES_DbLv.DFC_LSUO2PlausMinPartLd_C "DFES/Entprelllevel zur Erstellung eines DFES Eintrages für Prüfung DFC_LSUO2PlausMinPartLd" VALUE 0x80029C1D Val_Wu8 15.00 DFES_OneToOne 0.00 15.00 EXTENDED_LIMITS 0.00 255.0 /end CHARACTERISTIC
/begin CHARACTERISTIC DFES_DbLv.DFC_LSURiClbMax_C "DFES/Entprelllevel zur Erstellung eines DFES Eintrages für Prüfung DFC_LSURiClbMax" VALUE 0x80029C1E Val_Wu8 15.00 DFES_OneToOne 0.00 15.00 EXTENDED_LIMITS 0.00 255.0 /end CHARACTERISTIC
/begin CHARACTERISTIC DFES_DbLv.DFC_LSURiClbMin_C "DFES/Entprelllevel zur Erstellung eines DFES Eintrages für Prüfung DFC_LSURiClbMin" VALUE 0x80029C1F Val_Wu8 15.00 DFES_OneToOne 0.00 15.00 EXTENDED_LIMITS 0.00 255.0 /end CHARACTERISTIC
/begin CHARACTERISTIC DFES_DbLv.DFC_LSUWireIPSig_C "DFES/Entprelllevel zur Erstellung eines DFES Eintrages für Prüfung DFC_LSUWireIPSig" VALUE 0x80029C20 Val_Wu8 15.00 DFES_OneToOne 0.00 15.00 EXTENDED_LIMITS 0.00 255.0 /end CHARACTERISTIC
/begin CHARACTERISTIC DFES_DbLv.DFC_Layer_BSDMax_C "DFES/Entprelllevel zur Erstellung eines DFES Eintrages für Prüfung DFC_Layer_BSDMax" VALUE 0x80029C21 Val_Wu8 15.00 DFES_OneToOne 0.00 15.00 EXTENDED_LIMITS 0.00 255.0 /end CHARACTERISTIC
/begin CHARACTERISTIC DFES_DbLv.DFC_Layer_BSDMin_C "DFES/Entprelllevel zur Erstellung eines DFES Eintrages für Prüfung DFC_Layer_BSDMin" VALUE 0x80029C22 Val_Wu8 15.00 DFES_OneToOne 0.00 15.00 EXTENDED_LIMITS 0.00 255.0 /end CHARACTERISTIC
/begin CHARACTERISTIC DFES_DbLv.DFC_Layer_BSDNpl_C "DFES/Entprelllevel zur Erstellung eines DFES Eintrages für Prüfung DFC_Layer_BSDNpl" VALUE 0x80029C23 Val_Wu8 15.00 DFES_OneToOne 0.00 15.00 EXTENDED_LIMITS 0.00 255.0 /end CHARACTERISTIC
/begin CHARACTERISTIC DFES_DbLv.DFC_Layer_BSDSig_C "DFES/Entprelllevel zur Erstellung eines DFES Eintrages für Prüfung DFC_Layer_BSDSig" VALUE 0x80029C24 Val_Wu8 15.00 DFES_OneToOne 0.00 15.00 EXTENDED_LIMITS 0.00 255.0 /end CHARACTERISTIC
/begin CHARACTERISTIC DFES_DbLv.DFC_Layer_FltMngTstMax_C "DFES/Entprelllevel zur Erstellung eines DFES Eintrages für Prüfung DFC_Layer_FltMngTstMax" VALUE 0x80029C25 Val_Wu8 15.00 DFES_OneToOne 0.00 15.00 EXTENDED_LIMITS 0.00 255.0 /end CHARACTERISTIC
/begin CHARACTERISTIC DFES_DbLv.DFC_Layer_FltMngTstMin_C "DFES/Entprelllevel zur Erstellung eines DFES Eintrages für Prüfung DFC_Layer_FltMngTstMin" VALUE 0x80029C26 Val_Wu8 15.00 DFES_OneToOne 0.00 15.00 EXTENDED_LIMITS 0.00 255.0 /end CHARACTERISTIC
/begin CHARACTERISTIC DFES_DbLv.DFC_Layer_FltMngTstNpl_C "DFES/Entprelllevel zur Erstellung eines DFES Eintrages für Prüfung DFC_Layer_FltMngTstNpl" VALUE 0x80029C27 Val_Wu8 15.00 DFES_OneToOne 0.00 15.00 EXTENDED_LIMITS 0.00 255.0 /end CHARACTERISTIC
/begin CHARACTERISTIC DFES_DbLv.DFC_Layer_FltMngTstSig_C "DFES/Entprelllevel zur Erstellung eines DFES Eintrages für Prüfung DFC_Layer_FltMngTstSig" VALUE 0x80029C28 Val_Wu8 15.00 DFES_OneToOne 0.00 15.00 EXTENDED_LIMITS 0.00 255.0 /end CHARACTERISTIC
/begin CHARACTERISTIC DFES_DbLv.DFC_Layer_GENELBMax_C "DFES/Entprelllevel zur Erstellung eines DFES Eintrages für Prüfung DFC_Layer_GENELBMax" VALUE 0x80029C29 Val_Wu8 15.00 DFES_OneToOne 0.00 15.00 EXTENDED_LIMITS 0.00 255.0 /end CHARACTERISTIC
/begin CHARACTERISTIC DFES_DbLv.DFC_Layer_GENELBMin_C "DFES/Entprelllevel zur Erstellung eines DFES Eintrages für Prüfung DFC_Layer_GENELBMin" VALUE 0x80029C2A Val_Wu8 15.00 DFES_OneToOne 0.00 15.00 EXTENDED_LIMITS 0.00 255.0 /end CHARACTERISTIC
/begin CHARACTERISTIC DFES_DbLv.DFC_Layer_GENELBNpl_C "DFES/Entprelllevel zur Erstellung eines DFES Eintrages für Prüfung DFC_Layer_GENELBNpl" VALUE 0x80029C2B Val_Wu8 15.00 DFES_OneToOne 0.00 15.00 EXTENDED_LIMITS 0.00 255.0 /end CHARACTERISTIC
/begin CHARACTERISTIC DFES_DbLv.DFC_Layer_GENELBSig_C "DFES/Entprelllevel zur Erstellung eines DFES Eintrages für Prüfung DFC_Layer_GENELBSig" VALUE 0x80029C2C Val_Wu8 15.00 DFES_OneToOne 0.00 15.00 EXTENDED_LIMITS 0.00 255.0 /end CHARACTERISTIC
/begin CHARACTERISTIC DFES_DbLv.DFC_Layer_GENELMax_C "DFES/Entprelllevel zur Erstellung eines DFES Eintrages für Prüfung DFC_Layer_GENELMax" VALUE 0x80029C2D Val_Wu8 15.00 DFES_OneToOne 0.00 15.00 EXTENDED_LIMITS 0.00 255.0 /end CHARACTERISTIC
/begin CHARACTERISTIC DFES_DbLv.DFC_Layer_GENELMin_C "DFES/Entprelllevel zur Erstellung eines DFES Eintrages für Prüfung DFC_Layer_GENELMin" VALUE 0x80029C2E Val_Wu8 15.00 DFES_OneToOne 0.00 15.00 EXTENDED_LIMITS 0.00 255.0 /end CHARACTERISTIC
/begin CHARACTERISTIC DFES_DbLv.DFC_Layer_GENELNpl_C "DFES/Entprelllevel zur Erstellung eines DFES Eintrages für Prüfung DFC_Layer_GENELNpl" VALUE 0x80029C2F Val_Wu8 15.00 DFES_OneToOne 0.00 15.00 EXTENDED_LIMITS 0.00 255.0 /end CHARACTERISTIC
/begin CHARACTERISTIC DFES_DbLv.DFC_Layer_GENELSig_C "DFES/Entprelllevel zur Erstellung eines DFES Eintrages für Prüfung DFC_Layer_GENELSig" VALUE 0x80029C30 Val_Wu8 15.00 DFES_OneToOne 0.00 15.00 EXTENDED_LIMITS 0.00 255.0 /end CHARACTERISTIC
/begin CHARACTERISTIC DFES_DbLv.DFC_Layer_GENHTBMax_C "DFES/Entprelllevel zur Erstellung eines DFES Eintrages für Prüfung DFC_Layer_GENHTBMax" VALUE 0x80029C31 Val_Wu8 15.00 DFES_OneToOne 0.00 15.00 EXTENDED_LIMITS 0.00 255.0 /end CHARACTERISTIC
/begin CHARACTERISTIC DFES_DbLv.DFC_Layer_GENHTBMin_C "DFES/Entprelllevel zur Erstellung eines DFES Eintrages für Prüfung DFC_Layer_GENHTBMin" VALUE 0x80029C32 Val_Wu8 15.00 DFES_OneToOne 0.00 15.00 EXTENDED_LIMITS 0.00 255.0 /end CHARACTERISTIC
/begin CHARACTERISTIC DFES_DbLv.DFC_Layer_GENHTBNpl_C "DFES/Entprelllevel zur Erstellung eines DFES Eintrages für Prüfung DFC_Layer_GENHTBNpl" VALUE 0x80029C33 Val_Wu8 15.00 DFES_OneToOne 0.00 15.00 EXTENDED_LIMITS 0.00 255.0 /end CHARACTERISTIC
/begin CHARACTERISTIC DFES_DbLv.DFC_Layer_GENHTBSig_C "DFES/Entprelllevel zur Erstellung eines DFES Eintrages für Prüfung DFC_Layer_GENHTBSig" VALUE 0x80029C34 Val_Wu8 15.00 DFES_OneToOne 0.00 15.00 EXTENDED_LIMITS 0.00 255.0 /end CHARACTERISTIC
/begin CHARACTERISTIC DFES_DbLv.DFC_Layer_GENHTMax_C "DFES/Entprelllevel zur Erstellung eines DFES Eintrages für Prüfung DFC_Layer_GENHTMax" VALUE 0x80029C35 Val_Wu8 15.00 DFES_OneToOne 0.00 15.00 EXTENDED_LIMITS 0.00 255.0 /end CHARACTERISTIC
/begin CHARACTERISTIC DFES_DbLv.DFC_Layer_GENHTMin_C "DFES/Entprelllevel zur Erstellung eines DFES Eintrages für Prüfung DFC_Layer_GENHTMin" VALUE 0x80029C36 Val_Wu8 15.00 DFES_OneToOne 0.00 15.00 EXTENDED_LIMITS 0.00 255.0 /end CHARACTERISTIC
/begin CHARACTERISTIC DFES_DbLv.DFC_Layer_GENHTNpl_C "DFES/Entprelllevel zur Erstellung eines DFES Eintrages für Prüfung DFC_Layer_GENHTNpl" VALUE 0x80029C37 Val_Wu8 15.00 DFES_OneToOne 0.00 15.00 EXTENDED_LIMITS 0.00 255.0 /end CHARACTERISTIC
/begin CHARACTERISTIC DFES_DbLv.DFC_Layer_GENHTSig_C "DFES/Entprelllevel zur Erstellung eines DFES Eintrages für Prüfung DFC_Layer_GENHTSig" VALUE 0x80029C38 Val_Wu8 15.00 DFES_OneToOne 0.00 15.00 EXTENDED_LIMITS 0.00 255.0 /end CHARACTERISTIC
/begin CHARACTERISTIC DFES_DbLv.DFC_Layer_GENKOMMMax_C "DFES/Entprelllevel zur Erstellung eines DFES Eintrages für Prüfung DFC_Layer_GENKOMMMax" VALUE 0x80029C39 Val_Wu8 15.00 DFES_OneToOne 0.00 15.00 EXTENDED_LIMITS 0.00 255.0 /end CHARACTERISTIC
/begin CHARACTERISTIC DFES_DbLv.DFC_Layer_GENKOMMMin_C "DFES/Entprelllevel zur Erstellung eines DFES Eintrages für Prüfung DFC_Layer_GENKOMMMin" VALUE 0x80029C3A Val_Wu8 15.00 DFES_OneToOne 0.00 15.00 EXTENDED_LIMITS 0.00 255.0 /end CHARACTERISTIC
/begin CHARACTERISTIC DFES_DbLv.DFC_Layer_GENKOMMNpl_C "DFES/Entprelllevel zur Erstellung eines DFES Eintrages für Prüfung DFC_Layer_GENKOMMNpl" VALUE 0x80029C3B Val_Wu8 15.00 DFES_OneToOne 0.00 15.00 EXTENDED_LIMITS 0.00 255.0 /end CHARACTERISTIC
/begin CHARACTERISTIC DFES_DbLv.DFC_Layer_GENKOMMSig_C "DFES/Entprelllevel zur Erstellung eines DFES Eintrages für Prüfung DFC_Layer_GENKOMMSig" VALUE 0x80029C3C Val_Wu8 15.00 DFES_OneToOne 0.00 15.00 EXTENDED_LIMITS 0.00 255.0 /end CHARACTERISTIC
/begin CHARACTERISTIC DFES_DbLv.DFC_Layer_GENMECHMax_C "DFES/Entprelllevel zur Erstellung eines DFES Eintrages für Prüfung DFC_Layer_GENMECHMax" VALUE 0x80029C3D Val_Wu8 15.00 DFES_OneToOne 0.00 15.00 EXTENDED_LIMITS 0.00 255.0 /end CHARACTERISTIC
/begin CHARACTERISTIC DFES_DbLv.DFC_Layer_GENMECHMin_C "DFES/Entprelllevel zur Erstellung eines DFES Eintrages für Prüfung DFC_Layer_GENMECHMin" VALUE 0x80029C3E Val_Wu8 15.00 DFES_OneToOne 0.00 15.00 EXTENDED_LIMITS 0.00 255.0 /end CHARACTERISTIC
/begin CHARACTERISTIC DFES_DbLv.DFC_Layer_GENMECHNpl_C "DFES/Entprelllevel zur Erstellung eines DFES Eintrages für Prüfung DFC_Layer_GENMECHNpl" VALUE 0x80029C3F Val_Wu8 15.00 DFES_OneToOne 0.00 15.00 EXTENDED_LIMITS 0.00 255.0 /end CHARACTERISTIC
/begin CHARACTERISTIC DFES_DbLv.DFC_Layer_GENMECHSig_C "DFES/Entprelllevel zur Erstellung eines DFES Eintrages für Prüfung DFC_Layer_GENMECHSig" VALUE 0x80029C40 Val_Wu8 15.00 DFES_OneToOne 0.00 15.00 EXTENDED_LIMITS 0.00 255.0 /end CHARACTERISTIC
/begin CHARACTERISTIC DFES_DbLv.DFC_Layer_GENMax_C "DFES/Entprelllevel zur Erstellung eines DFES Eintrages für Prüfung DFC_Layer_GENMax" VALUE 0x80029C41 Val_Wu8 15.00 DFES_OneToOne 0.00 15.00 EXTENDED_LIMITS 0.00 255.0 /end CHARACTERISTIC
/begin CHARACTERISTIC DFES_DbLv.DFC_Layer_GENMin_C "DFES/Entprelllevel zur Erstellung eines DFES Eintrages für Prüfung DFC_Layer_GENMin" VALUE 0x80029C42 Val_Wu8 15.00 DFES_OneToOne 0.00 15.00 EXTENDED_LIMITS 0.00 255.0 /end CHARACTERISTIC
/begin CHARACTERISTIC DFES_DbLv.DFC_Layer_GENNpl_C "DFES/Entprelllevel zur Erstellung eines DFES Eintrages für Prüfung DFC_Layer_GENNpl" VALUE 0x80029C43 Val_Wu8 15.00 DFES_OneToOne 0.00 15.00 EXTENDED_LIMITS 0.00 255.0 /end CHARACTERISTIC
/begin CHARACTERISTIC DFES_DbLv.DFC_Layer_GENREGUPLMax_C "DFES/Entprelllevel zur Erstellung eines DFES Eintrages für Prüfung DFC_Layer_GENREGUPLMax" VALUE 0x80029C44 Val_Wu8 15.00 DFES_OneToOne 0.00 15.00 EXTENDED_LIMITS 0.00 255.0 /end CHARACTERISTIC
/begin CHARACTERISTIC DFES_DbLv.DFC_Layer_GENREGUPLMin_C "DFES/Entprelllevel zur Erstellung eines DFES Eintrages für Prüfung DFC_Layer_GENREGUPLMin" VALUE 0x80029C45 Val_Wu8 15.00 DFES_OneToOne 0.00 15.00 EXTENDED_LIMITS 0.00 255.0 /end CHARACTERISTIC
/begin CHARACTERISTIC DFES_DbLv.DFC_Layer_GENREGUPLNpl_C "DFES/Entprelllevel zur Erstellung eines DFES Eintrages für Prüfung DFC_Layer_GENREGUPLNpl" VALUE 0x80029C46 Val_Wu8 15.00 DFES_OneToOne 0.00 15.00 EXTENDED_LIMITS 0.00 255.0 /end CHARACTERISTIC
/begin CHARACTERISTIC DFES_DbLv.DFC_Layer_GENREGUPLSig_C "DFES/Entprelllevel zur Erstellung eines DFES Eintrages für Prüfung DFC_Layer_GENREGUPLSig" VALUE 0x80029C47 Val_Wu8 15.00 DFES_OneToOne 0.00 15.00 EXTENDED_LIMITS 0.00 255.0 /end CHARACTERISTIC
/begin CHARACTERISTIC DFES_DbLv.DFC_Layer_GENSig_C "DFES/Entprelllevel zur Erstellung eines DFES Eintrages für Prüfung DFC_Layer_GENSig" VALUE 0x80029C48 Val_Wu8 15.00 DFES_OneToOne 0.00 15.00 EXTENDED_LIMITS 0.00 255.0 /end CHARACTERISTIC
/begin CHARACTERISTIC DFES_DbLv.DFC_Layer_GENUPLMax_C "DFES/Entprelllevel zur Erstellung eines DFES Eintrages für Prüfung DFC_Layer_GENUPLMax" VALUE 0x80029C49 Val_Wu8 15.00 DFES_OneToOne 0.00 15.00 EXTENDED_LIMITS 0.00 255.0 /end CHARACTERISTIC
/begin CHARACTERISTIC DFES_DbLv.DFC_Layer_GENUPLMin_C "DFES/Entprelllevel zur Erstellung eines DFES Eintrages für Prüfung DFC_Layer_GENUPLMin" VALUE 0x80029C4A Val_Wu8 15.00 DFES_OneToOne 0.00 15.00 EXTENDED_LIMITS 0.00 255.0 /end CHARACTERISTIC
/begin CHARACTERISTIC DFES_DbLv.DFC_Layer_GENUPLNpl_C "DFES/Entprelllevel zur Erstellung eines DFES Eintrages für Prüfung DFC_Layer_GENUPLNpl" VALUE 0x80029C4B Val_Wu8 15.00 DFES_OneToOne 0.00 15.00 EXTENDED_LIMITS 0.00 255.0 /end CHARACTERISTIC
/begin CHARACTERISTIC DFES_DbLv.DFC_Layer_GENUPLSig_C "DFES/Entprelllevel zur Erstellung eines DFES Eintrages für Prüfung DFC_Layer_GENUPLSig" VALUE 0x80029C4C Val_Wu8 15.00 DFES_OneToOne 0.00 15.00 EXTENDED_LIMITS 0.00 255.0 /end CHARACTERISTIC
/begin CHARACTERISTIC DFES_DbLv.DFC_Layer_IBS1Max_C "DFES/Entprelllevel zur Erstellung eines DFES Eintrages für Prüfung DFC_Layer_IBS1Max" VALUE 0x80029C4D Val_Wu8 15.00 DFES_OneToOne 0.00 15.00 EXTENDED_LIMITS 0.00 255.0 /end CHARACTERISTIC
/begin CHARACTERISTIC DFES_DbLv.DFC_Layer_IBS1Min_C "DFES/Entprelllevel zur Erstellung eines DFES Eintrages für Prüfung DFC_Layer_IBS1Min" VALUE 0x80029C4E Val_Wu8 15.00 DFES_OneToOne 0.00 15.00 EXTENDED_LIMITS 0.00 255.0 /end CHARACTERISTIC
/begin CHARACTERISTIC DFES_DbLv.DFC_Layer_IBS1Npl_C "DFES/Entprelllevel zur Erstellung eines DFES Eintrages für Prüfung DFC_Layer_IBS1Npl" VALUE 0x80029C4F Val_Wu8 15.00 DFES_OneToOne 0.00 15.00 EXTENDED_LIMITS 0.00 255.0 /end CHARACTERISTIC
/begin CHARACTERISTIC DFES_DbLv.DFC_Layer_IBS1Sig_C "DFES/Entprelllevel zur Erstellung eines DFES Eintrages für Prüfung DFC_Layer_IBS1Sig" VALUE 0x80029C50 Val_Wu8 15.00 DFES_OneToOne 0.00 15.00 EXTENDED_LIMITS 0.00 255.0 /end CHARACTERISTIC
/begin CHARACTERISTIC DFES_DbLv.DFC_Layer_IBS2Max_C "DFES/Entprelllevel zur Erstellung eines DFES Eintrages für Prüfung DFC_Layer_IBS2Max" VALUE 0x80029C51 Val_Wu8 15.00 DFES_OneToOne 0.00 15.00 EXTENDED_LIMITS 0.00 255.0 /end CHARACTERISTIC
/begin CHARACTERISTIC DFES_DbLv.DFC_Layer_IBS2Min_C "DFES/Entprelllevel zur Erstellung eines DFES Eintrages für Prüfung DFC_Layer_IBS2Min" VALUE 0x80029C52 Val_Wu8 15.00 DFES_OneToOne 0.00 15.00 EXTENDED_LIMITS 0.00 255.0 /end CHARACTERISTIC
/begin CHARACTERISTIC DFES_DbLv.DFC_Layer_IBS2Npl_C "DFES/Entprelllevel zur Erstellung eines DFES Eintrages für Prüfung DFC_Layer_IBS2Npl" VALUE 0x80029C53 Val_Wu8 15.00 DFES_OneToOne 0.00 15.00 EXTENDED_LIMITS 0.00 255.0 /end CHARACTERISTIC
/begin CHARACTERISTIC DFES_DbLv.DFC_Layer_IBS2Sig_C "DFES/Entprelllevel zur Erstellung eines DFES Eintrages für Prüfung DFC_Layer_IBS2Sig" VALUE 0x80029C54 Val_Wu8 15.00 DFES_OneToOne 0.00 15.00 EXTENDED_LIMITS 0.00 255.0 /end CHARACTERISTIC
/begin CHARACTERISTIC DFES_DbLv.DFC_Layer_IBS3Max_C "DFES/Entprelllevel zur Erstellung eines DFES Eintrages für Prüfung DFC_Layer_IBS3Max" VALUE 0x80029C55 Val_Wu8 15.00 DFES_OneToOne 0.00 15.00 EXTENDED_LIMITS 0.00 255.0 /end CHARACTERISTIC
/begin CHARACTERISTIC DFES_DbLv.DFC_Layer_IBS3Min_C "DFES/Entprelllevel zur Erstellung eines DFES Eintrages für Prüfung DFC_Layer_IBS3Min" VALUE 0x80029C56 Val_Wu8 15.00 DFES_OneToOne 0.00 15.00 EXTENDED_LIMITS 0.00 255.0 /end CHARACTERISTIC
/begin CHARACTERISTIC DFES_DbLv.DFC_Layer_IBS3Npl_C "DFES/Entprelllevel zur Erstellung eines DFES Eintrages für Prüfung DFC_Layer_IBS3Npl" VALUE 0x80029C57 Val_Wu8 15.00 DFES_OneToOne 0.00 15.00 EXTENDED_LIMITS 0.00 255.0 /end CHARACTERISTIC
/begin CHARACTERISTIC DFES_DbLv.DFC_Layer_IBS3Sig_C "DFES/Entprelllevel zur Erstellung eines DFES Eintrages für Prüfung DFC_Layer_IBS3Sig" VALUE 0x80029C58 Val_Wu8 15.00 DFES_OneToOne 0.00 15.00 EXTENDED_LIMITS 0.00 255.0 /end CHARACTERISTIC
/begin CHARACTERISTIC DFES_DbLv.DFC_Layer_MANDETEKMax_C "DFES/Entprelllevel zur Erstellung eines DFES Eintrages für Prüfung DFC_Layer_MANDETEKMax" VALUE 0x80029C59 Val_Wu8 15.00 DFES_OneToOne 0.00 15.00 EXTENDED_LIMITS 0.00 255.0 /end CHARACTERISTIC
/begin CHARACTERISTIC DFES_DbLv.DFC_Layer_MANDETEKMin_C "DFES/Entprelllevel zur Erstellung eines DFES Eintrages für Prüfung DFC_Layer_MANDETEKMin" VALUE 0x80029C5A Val_Wu8 15.00 DFES_OneToOne 0.00 15.00 EXTENDED_LIMITS 0.00 255.0 /end CHARACTERISTIC
/begin CHARACTERISTIC DFES_DbLv.DFC_Layer_MANDETEKNpl_C "DFES/Entprelllevel zur Erstellung eines DFES Eintrages für Prüfung DFC_Layer_MANDETEKNpl" VALUE 0x80029C5B Val_Wu8 15.00 DFES_OneToOne 0.00 15.00 EXTENDED_LIMITS 0.00 255.0 /end CHARACTERISTIC
/begin CHARACTERISTIC DFES_DbLv.DFC_Layer_MANDETEKSig_C "DFES/Entprelllevel zur Erstellung eines DFES Eintrages für Prüfung DFC_Layer_MANDETEKSig" VALUE 0x80029C5C Val_Wu8 15.00 DFES_OneToOne 0.00 15.00 EXTENDED_LIMITS 0.00 255.0 /end CHARACTERISTIC
/begin CHARACTERISTIC DFES_DbLv.DFC_Layer_NDR1Max_C "DFES/Entprelllevel zur Erstellung eines DFES Eintrages für Prüfung DFC_Layer_NDR1Max" VALUE 0x80029C5D Val_Wu8 15.00 DFES_OneToOne 0.00 15.00 EXTENDED_LIMITS 0.00 255.0 /end CHARACTERISTIC
/begin CHARACTERISTIC DFES_DbLv.DFC_Layer_NDR1Min_C "DFES/Entprelllevel zur Erstellung eines DFES Eintrages für Prüfung DFC_Layer_NDR1Min" VALUE 0x80029C5E Val_Wu8 15.00 DFES_OneToOne 0.00 15.00 EXTENDED_LIMITS 0.00 255.0 /end CHARACTERISTIC
/begin CHARACTERISTIC DFES_DbLv.DFC_Layer_NDR1Npl_C "DFES/Entprelllevel zur Erstellung eines DFES Eintrages für Prüfung DFC_Layer_NDR1Npl" VALUE 0x80029C5F Val_Wu8 15.00 DFES_OneToOne 0.00 15.00 EXTENDED_LIMITS 0.00 255.0 /end CHARACTERISTIC
/begin CHARACTERISTIC DFES_DbLv.DFC_Layer_NDR1Sig_C "DFES/Entprelllevel zur Erstellung eines DFES Eintrages für Prüfung DFC_Layer_NDR1Sig" VALUE 0x80029C60 Val_Wu8 15.00 DFES_OneToOne 0.00 15.00 EXTENDED_LIMITS 0.00 255.0 /end CHARACTERISTIC
/begin CHARACTERISTIC DFES_DbLv.DFC_Layer_NDR2Max_C "DFES/Entprelllevel zur Erstellung eines DFES Eintrages für Prüfung DFC_Layer_NDR2Max" VALUE 0x80029C61 Val_Wu8 15.00 DFES_OneToOne 0.00 15.00 EXTENDED_LIMITS 0.00 255.0 /end CHARACTERISTIC
/begin CHARACTERISTIC DFES_DbLv.DFC_Layer_NDR2Min_C "DFES/Entprelllevel zur Erstellung eines DFES Eintrages für Prüfung DFC_Layer_NDR2Min" VALUE 0x80029C62 Val_Wu8 15.00 DFES_OneToOne 0.00 15.00 EXTENDED_LIMITS 0.00 255.0 /end CHARACTERISTIC
/begin CHARACTERISTIC DFES_DbLv.DFC_Layer_NDR2Npl_C "DFES/Entprelllevel zur Erstellung eines DFES Eintrages für Prüfung DFC_Layer_NDR2Npl" VALUE 0x80029C63 Val_Wu8 15.00 DFES_OneToOne 0.00 15.00 EXTENDED_LIMITS 0.00 255.0 /end CHARACTERISTIC
/begin CHARACTERISTIC DFES_DbLv.DFC_Layer_NDR2Sig_C "DFES/Entprelllevel zur Erstellung eines DFES Eintrages für Prüfung DFC_Layer_NDR2Sig" VALUE 0x80029C64 Val_Wu8 15.00 DFES_OneToOne 0.00 15.00 EXTENDED_LIMITS 0.00 255.0 /end CHARACTERISTIC
/begin CHARACTERISTIC DFES_DbLv.DFC_Layer_NGLERNMax_C "DFES/Entprelllevel zur Erstellung eines DFES Eintrages für Prüfung DFC_Layer_NGLERNMax" VALUE 0x80029C65 Val_Wu8 15.00 DFES_OneToOne 0.00 15.00 EXTENDED_LIMITS 0.00 255.0 /end CHARACTERISTIC
/begin CHARACTERISTIC DFES_DbLv.DFC_Layer_NGLERNMin_C "DFES/Entprelllevel zur Erstellung eines DFES Eintrages für Prüfung DFC_Layer_NGLERNMin" VALUE 0x80029C66 Val_Wu8 15.00 DFES_OneToOne 0.00 15.00 EXTENDED_LIMITS 0.00 255.0 /end CHARACTERISTIC
/begin CHARACTERISTIC DFES_DbLv.DFC_Layer_NGLERNNpl_C "DFES/Entprelllevel zur Erstellung eines DFES Eintrages für Prüfung DFC_Layer_NGLERNNpl" VALUE 0x80029C67 Val_Wu8 15.00 DFES_OneToOne 0.00 15.00 EXTENDED_LIMITS 0.00 255.0 /end CHARACTERISTIC
/begin CHARACTERISTIC DFES_DbLv.DFC_Layer_NGLERNSig_C "DFES/Entprelllevel zur Erstellung eines DFES Eintrages für Prüfung DFC_Layer_NGLERNSig" VALUE 0x80029C68 Val_Wu8 15.00 DFES_OneToOne 0.00 15.00 EXTENDED_LIMITS 0.00 255.0 /end CHARACTERISTIC
/begin FUNCTION DFES ""
 /begin DEF_CHARACTERISTIC DFES_DbLv.DFC_ComRpmWhlTo_FX_C DFES_DbLv.DFC_ComSecCtrRelSig_FA_C DFES_DbLv.DFC_ComSecCtrRelTo_FA_C DFES_DbLv.DFC_ComSensNOxGndSig_C DFES_DbLv.DFC_ComSensNOxGndTo_C DFES_DbLv.DFC_ComSensNOxMode_C DFES_DbLv.DFC_ComSensNOxUbattSig_C DFES_DbLv.DFC_ComSensNOxUbattTo_C DFES_DbLv.DFC_ComShiftPaddleTo_FX_C DFES_DbLv.DFC_ComShutOffPSPSig_C DFES_DbLv.DFC_ComShutOffPSPTo_C DFES_DbLv.DFC_ComSlrdiGlbFZMTo_FA_C DFES_DbLv.DFC_ComSlrdiGlbFZMTo_FX_C DFES_DbLv.DFC_ComSpeedVehicleChk_FX_C DFES_DbLv.DFC_ComSpeedVehicleCtr_FX_C DFES_DbLv.DFC_ComSpeedVehicleTo_FX_C DFES_DbLv.DFC_ComStConintDSCChk_FX_C DFES_DbLv.DFC_ComStConintDSCCtr_FX_C DFES_DbLv.DFC_ComStConintDSCTo_FX_C DFES_DbLv.DFC_ComStatACFrontSig_FA_C DFES_DbLv.DFC_ComStatACFrontTo_FA_C DFES_DbLv.DFC_ComStatEkpSig_A_C DFES_DbLv.DFC_ComStatEkpTo_A_C DFES_DbLv.DFC_ComStatGearRevSig_FA_C DFES_DbLv.DFC_ComStatGearRevTo_FA_C DFES_DbLv.DFC_ComStatZVKlappenSig_FA_C DFES_DbLv.DFC_ComStatZVKlappenTo_FA_C DFES_DbLv.DFC_ComStateARSCtr_C DFES_DbLv.DFC_ComStateARSSig_C DFES_DbLv.DFC_ComStateARSTo_C DFES_DbLv.DFC_ComStateDscSig_C DFES_DbLv.DFC_ComStateDscTo_C DFES_DbLv.DFC_ComStateSeatSig_C DFES_DbLv.DFC_ComStateSeatSig_FA_C DFES_DbLv.DFC_ComStateSeatTo_C DFES_DbLv.DFC_ComStateSeatTo_FA_C DFES_DbLv.DFC_ComStatusEGSSig_A_C DFES_DbLv.DFC_ComStatusEGSSig_FA_C DFES_DbLv.DFC_ComStatusEGSTo_A_C DFES_DbLv.DFC_ComStatusEGSTo_FA_C DFES_DbLv.DFC_ComStatusEMFChk_C DFES_DbLv.DFC_ComStatusEMFCtr_C DFES_DbLv.DFC_ComStatusEMFSig_C DFES_DbLv.DFC_ComStatusEMFTo_C DFES_DbLv.DFC_ComStatusRGangSig_C DFES_DbLv.DFC_ComStatusRGangTo_C DFES_DbLv.DFC_ComSteeringAngleChk_FX_C DFES_DbLv.DFC_ComSteeringAngleCtr_FX_C DFES_DbLv.DFC_ComSteeringAngleTo_FX_C DFES_DbLv.DFC_ComTerminalChk_C DFES_DbLv.DFC_ComTerminalCtr_C DFES_DbLv.DFC_ComTerminalSig_C DFES_DbLv.DFC_ComTerminalTo_C DFES_DbLv.DFC_ComTimeDateSig_FA_C DFES_DbLv.DFC_ComTimeDateTo_FA_C DFES_DbLv.DFC_ComTrailerSig_C DFES_DbLv.DFC_ComTrailerSig_FA_C DFES_DbLv.DFC_ComTrailerTo_C DFES_DbLv.DFC_ComTrailerTo_FA_C DFES_DbLv.DFC_ComTrqDemCrshDrDyChk_FX_C DFES_DbLv.DFC_ComTrqDemCrshDrDyCtr_FX_C DFES_DbLv.DFC_ComTrqDemCrshDrDyTo_FX_C DFES_DbLv.DFC_ComTrqDemandDesSig_C DFES_DbLv.DFC_ComTrqDemandDesTo_C DFES_DbLv.DFC_ComTrqDemandDscChk_C DFES_DbLv.DFC_ComTrqDemandDscCtr_C DFES_DbLv.DFC_ComTrqDemandDscSig_C DFES_DbLv.DFC_ComTrqDemandDscTo_C DFES_DbLv.DFC_ComTrqDemandGbxChk_A_C DFES_DbLv.DFC_ComTrqDemandGbxChk_FA_C DFES_DbLv.DFC_ComTrqDemandGbxCtr_A_C DFES_DbLv.DFC_ComTrqDemandGbxCtr_FA_C DFES_DbLv.DFC_ComTrqDemandGbxSig_A_C DFES_DbLv.DFC_ComTrqDemandGbxSig_FA_C DFES_DbLv.DFC_ComTrqDemandGbxTo_A_C DFES_DbLv.DFC_ComTrqDemandGbxTo_FA_C DFES_DbLv.DFC_ComTrqWhlDemChk_C DFES_DbLv.DFC_ComTrqWhlDemCtr_C DFES_DbLv.DFC_ComTrqWhlDemFASChk_FX_C DFES_DbLv.DFC_ComTrqWhlDemFASCtr_FX_C DFES_DbLv.DFC_ComTrqWhlDemFASTo_FX_C DFES_DbLv.DFC_ComTrqWhlDemSig_C DFES_DbLv.DFC_ComTrqWhlDemTo_C DFES_DbLv.DFC_ComVelocityChk_FA_C DFES_DbLv.DFC_ComVelocityCtr_FA_C DFES_DbLv.DFC_ComVelocitySig_C DFES_DbLv.DFC_ComVelocitySig_FA_C DFES_DbLv.DFC_ComVelocityTo_C DFES_DbLv.DFC_ComVelocityTo_FA_C DFES_DbLv.DFC_ComVerbraucherTo_C DFES_DbLv.DFC_ComWMomPTStabChk_FX_C DFES_DbLv.DFC_ComWMomPTStabCtr_FX_C DFES_DbLv.DFC_ComWMomPTStabTo_FX_C DFES_DbLv.DFC_ComWheelSpeedSig_C DFES_DbLv.DFC_ComWheelSpeedTo_C DFES_DbLv.DFC_ComZvKlappenSig_C DFES_DbLv.DFC_ComZvKlappenTo_C DFES_DbLv.DFC_ComaDirectChk_FX_C DFES_DbLv.DFC_ComaDirectCtr_FX_C DFES_DbLv.DFC_ComaDirectTo_FX_C DFES_DbLv.DFC_ComaSideChk_FX_C DFES_DbLv.DFC_ComaSideCtr_FX_C DFES_DbLv.DFC_ComaSideTo_FX_C DFES_DbLv.DFC_Cy320SpiCom_C DFES_DbLv.DFC_ETCtlDvtInrMax_C DFES_DbLv.DFC_ETCtlDvtInrMin_C DFES_DbLv.DFC_ETCtlDvtOutrMax_C DFES_DbLv.DFC_ETCtlDvtOutrMin_C DFES_DbLv.DFC_FBCqDvtMax_C DFES_DbLv.DFC_FBCqDvtMin_C DFES_DbLv.DFC_Fan4WinErr1_C DFES_DbLv.DFC_Fan4WinErr2_C DFES_DbLv.DFC_Fan4WinErr3_C DFES_DbLv.DFC_Fan4WinErr4_C DFES_DbLv.DFC_FanSCG_C DFES_DbLv.DFC_FlFCBS_C DFES_DbLv.DFC_GlwEcuConfigErr_C DFES_DbLv.DFC_GlwEcuEepErr_C DFES_DbLv.DFC_GlwEcuFrmErr_C DFES_DbLv.DFC_GlwEcuGPCMFaultInfo_C DFES_DbLv.DFC_GlwEcuGPCMInfo_C DFES_DbLv.DFC_GlwEcuGk1HSS_C DFES_DbLv.DFC_GlwEcuGk1OL_C DFES_DbLv.DFC_GlwEcuGk1SC_C DFES_DbLv.DFC_GlwEcuGk1Wdst_C DFES_DbLv.DFC_GlwEcuGk2HSS_C DFES_DbLv.DFC_GlwEcuGk2OL_C DFES_DbLv.DFC_GlwEcuGk2SC_C DFES_DbLv.DFC_GlwEcuGk2Wdst_C DFES_DbLv.DFC_GlwEcuGk3HSS_C DFES_DbLv.DFC_GlwEcuGk3OL_C DFES_DbLv.DFC_GlwEcuGk3SC_C DFES_DbLv.DFC_GlwEcuGk3Wdst_C DFES_DbLv.DFC_GlwEcuGk4HSS_C DFES_DbLv.DFC_GlwEcuGk4OL_C DFES_DbLv.DFC_GlwEcuGk4SC_C DFES_DbLv.DFC_GlwEcuGk4Wdst_C DFES_DbLv.DFC_GlwEcuGk5HSS_C DFES_DbLv.DFC_GlwEcuGk5OL_C DFES_DbLv.DFC_GlwEcuGk5SC_C DFES_DbLv.DFC_GlwEcuGk5Wdst_C DFES_DbLv.DFC_GlwEcuGk6HSS_C DFES_DbLv.DFC_GlwEcuGk6OL_C DFES_DbLv.DFC_GlwEcuGk6SC_C DFES_DbLv.DFC_GlwEcuGk6Wdst_C DFES_DbLv.DFC_GlwEcuGndErr_C DFES_DbLv.DFC_GlwEcuIntErr_C DFES_DbLv.DFC_GlwEcuMsgTimeout_C DFES_DbLv.DFC_GlwEcuT30Err_C DFES_DbLv.DFC_GlwEcuTempErr_C DFES_DbLv.DFC_GlwEcuUdiffT30_C DFES_DbLv.DFC_IBSComErr_C DFES_DbLv.DFC_LubSRCOilFldtCrit_C DFES_DbLv.DFC_LubSRCOilFldtCritDflMin_C DFES_DbLv.DFC_LubSRCOilLvlCritMax_C DFES_DbLv.DFC_LubSRCOilLvlCritMin_C DFES_DbLv.DFC_LubSRCTot_C DFES_DbLv.DFC_MonUMaxSupply1_C DFES_DbLv.DFC_MonUMinSupply1_C DFES_DbLv.DFC_OilComNpl_C DFES_DbLv.DFC_PCBS_C DFES_DbLv.DFC_PCBSPFltChg_C DFES_DbLv.DFC_PCRGovDvtLPMax_C DFES_DbLv.DFC_PCRGovDvtLPMin_C DFES_DbLv.DFC_PCRGovDvtMax_C DFES_DbLv.DFC_PCRGovDvtMin_C DFES_DbLv.DFC_PFltAPSPlausMAX_C DFES_DbLv.DFC_PFltAPSPlausMIN_C DFES_DbLv.DFC_PFltBPSPlausMAX_C DFES_DbLv.DFC_PFltBPSPlausMIN_C DFES_DbLv.DFC_PFltOvldInhRgn_C DFES_DbLv.DFC_PFltOvldTrqLim_C DFES_DbLv.DFC_PFltPresPlausMAX_C DFES_DbLv.DFC_PFltPresPlausMIN_C DFES_DbLv.DFC_PFltTraRpmRdc_C DFES_DbLv.DFC_PFlt_tOxiPreMax_C DFES_DbLv.DFC_PFlt_tOxiPreMaxRgn_C DFES_DbLv.DFC_PFlt_tOxiPreNpl_C DFES_DbLv.DFC_PFlt_tPreMax_C DFES_DbLv.DFC_PFlt_tPreMaxRgn_C DFES_DbLv.DFC_PFlt_tPreNpl_C DFES_DbLv.DFC_PFltmSotDiffMAX_C DFES_DbLv.DFC_PFltmSotDiffMIN_C DFES_DbLv.DFC_PFltmSotDiffSIG_C DFES_DbLv.DFC_PIntkVUsEnvPPls_C DFES_DbLv.DFC_PresPlausDblDef_C DFES_DbLv.DFC_RailCPC1_C DFES_DbLv.DFC_RailCPC3_C DFES_DbLv.DFC_RailCPC4_C DFES_DbLv.DFC_RailMeUn0_C DFES_DbLv.DFC_RailMeUn1_C DFES_DbLv.DFC_RailMeUn2_C DFES_DbLv.DFC_RailMeUn22_C DFES_DbLv.DFC_RailMeUn3_C DFES_DbLv.DFC_RailMeUn4_C DFES_DbLv.DFC_RailMeUn42_C DFES_DbLv.DFC_RailMeUn5_C DFES_DbLv.DFC_RailPCV0_C DFES_DbLv.DFC_RailPCV1_C DFES_DbLv.DFC_RailPCV2_C DFES_DbLv.DFC_RailPCV22_C DFES_DbLv.DFC_RailPCV3_C DFES_DbLv.DFC_RailPCV4_C DFES_DbLv.DFC_RailPCV42_C DFES_DbLv.DFC_RailPMonStrt_C DFES_DbLv.DFC_SSpMon1_C DFES_DbLv.DFC_SSpMon2_C DFES_DbLv.DFC_SSpMon3_C DFES_DbLv.DFC_ThrVlv4WinErr1_C DFES_DbLv.DFC_ThrVlv4WinErr2_C DFES_DbLv.DFC_ThrVlv4WinErr3_C DFES_DbLv.DFC_ThrVlv4WinErr4_C DFES_DbLv.DFC_ThrVlvSCG_C DFES_DbLv.DFC_Tle6232Spi1_C DFES_DbLv.DFC_TrbCh4WinErr1_C DFES_DbLv.DFC_TrbCh4WinErr2_C DFES_DbLv.DFC_TrbCh4WinErr3_C DFES_DbLv.DFC_TrbCh4WinErr4_C DFES_DbLv.DFC_TrbChSCG_C DFES_DbLv.DFC_TrbChSRCMax_C DFES_DbLv.DFC_TrbChSRCMin_C DFES_DbLv.DFC_WaHtEl4WinErr1_C DFES_DbLv.DFC_WaHtEl4WinErr2_C DFES_DbLv.DFC_WaHtEl4WinErr3_C DFES_DbLv.DFC_WaHtEl4WinErr4_C DFES_DbLv.DFC_WaHtElSCG_C DFES_DbLv.DFC_ETClbETFltMax_0_C DFES_DbLv.DFC_ETClbETFltMax_1_C DFES_DbLv.DFC_ETClbETFltMax_2_C DFES_DbLv.DFC_ETClbETFltMax_3_C DFES_DbLv.DFC_ETClbETFltMax_4_C DFES_DbLv.DFC_ETClbETFltMax_5_C DFES_DbLv.DFC_ETClbETFltMin_0_C DFES_DbLv.DFC_ETClbETFltMin_1_C DFES_DbLv.DFC_ETClbETFltMin_2_C DFES_DbLv.DFC_ETClbETFltMin_3_C DFES_DbLv.DFC_ETClbETFltMin_4_C DFES_DbLv.DFC_ETClbETFltMin_5_C DFES_DbLv.DFC_InjCrvInjLimChrgBal_C DFES_DbLv.DFC_InjCrvInjLimQntBal_C DFES_DbLv.DFC_InjCrvInjLimSys_C DFES_DbLv.DFC_InjCrvNumInjRtmLim_C DFES_DbLv.DFC_LSUHtCoupSig_C DFES_DbLv.DFC_AFS_SSpShOffOL_C DFES_DbLv.DFC_AFS_SSpShOffOvrTemp_C DFES_DbLv.DFC_AFS_SSpShOffSCB_C DFES_DbLv.DFC_AFS_SSpShOffSCG_C DFES_DbLv.DFC_AirCCmprOL_C DFES_DbLv.DFC_AirCCmprOvrTemp_C DFES_DbLv.DFC_AirCCmprSCB_C DFES_DbLv.DFC_AirCCmprSCG_C DFES_DbLv.DFC_CByVlvOL_C DFES_DbLv.DFC_CByVlvOvrTemp_C DFES_DbLv.DFC_CByVlvSCB_C DFES_DbLv.DFC_CByVlvSCG_C DFES_DbLv.DFC_CThmstOL_C DFES_DbLv.DFC_CThmstOvrTemp_C DFES_DbLv.DFC_CThmstSCB_C DFES_DbLv.DFC_CThmstSCG_C DFES_DbLv.DFC_DSMDummy_C DFES_DbLv.DFC_EBxFanOL_C DFES_DbLv.DFC_EBxFanOvrTemp_C DFES_DbLv.DFC_EBxFanSCB_C DFES_DbLv.DFC_EBxFanSCG_C DFES_DbLv.DFC_ECBVlvOL_C DFES_DbLv.DFC_ECBVlvOvrTemp_C DFES_DbLv.DFC_ECBVlvSCB_C DFES_DbLv.DFC_ECBVlvSCG_C DFES_DbLv.DFC_EMDmpOL_0_C DFES_DbLv.DFC_EMDmpOL_1_C DFES_DbLv.DFC_EMDmpOvrTemp_0_C DFES_DbLv.DFC_EMDmpOvrTemp_1_C DFES_DbLv.DFC_EMDmpSCB_0_C DFES_DbLv.DFC_EMDmpSCB_1_C DFES_DbLv.DFC_EMDmpSCG_0_C DFES_DbLv.DFC_EMDmpSCG_1_C DFES_DbLv.DFC_EngStAOL_C DFES_DbLv.DFC_EngStAOvrTemp_C DFES_DbLv.DFC_EngStASCB_C DFES_DbLv.DFC_EngStASCG_C DFES_DbLv.DFC_FanOL_C DFES_DbLv.DFC_FanOvrTemp_C DFES_DbLv.DFC_FanSCB_C DFES_DbLv.DFC_FlFltHtOL_C DFES_DbLv.DFC_FlFltHtOvrTemp_C DFES_DbLv.DFC_FlFltHtSCB_C DFES_DbLv.DFC_FlFltHtSCG_C DFES_DbLv.DFC_LSUHtrMax_C DFES_DbLv.DFC_LSUHtrMin_C DFES_DbLv.DFC_LSUHtrNpl_C DFES_DbLv.DFC_LSUHtrSig_C DFES_DbLv.DFC_LSUtExcMax_C DFES_DbLv.DFC_LSUtExcMin_C DFES_DbLv.DFC_MeUnOL_C DFES_DbLv.DFC_MeUnSCB_C DFES_DbLv.DFC_MeUnSRCMax_C DFES_DbLv.DFC_MeUnSRCMin_C DFES_DbLv.DFC_PCVOL_C DFES_DbLv.DFC_PCVSCB_C DFES_DbLv.DFC_PCVSRCMax_C DFES_DbLv.DFC_PCVSRCMin_C DFES_DbLv.DFC_RailPSRCMax_C DFES_DbLv.DFC_RailPSRCMin_C DFES_DbLv.DFC_ShtrOL_C DFES_DbLv.DFC_ShtrOvrTemp_C DFES_DbLv.DFC_ShtrSCB_C DFES_DbLv.DFC_ShtrSCG_C DFES_DbLv.DFC_StrtOL_C DFES_DbLv.DFC_StrtOvrTemp_C DFES_DbLv.DFC_StrtSCB_C DFES_DbLv.DFC_StrtSCG_C DFES_DbLv.DFC_ThrVlvOL_C DFES_DbLv.DFC_ThrVlvOvrTemp_C DFES_DbLv.DFC_ThrVlvSCB_C DFES_DbLv.DFC_TrbChOL_C DFES_DbLv.DFC_TrbChOvrTemp_C DFES_DbLv.DFC_TrbChSCB_C DFES_DbLv.DFC_UDosVlvOL_C DFES_DbLv.DFC_UDosVlvOvrTemp_C DFES_DbLv.DFC_UDosVlvSCB_C DFES_DbLv.DFC_UDosVlvSCG_C DFES_DbLv.DFC_UPmpMotOL_C DFES_DbLv.DFC_UPmpMotOvrTemp_C DFES_DbLv.DFC_UPmpMotSCB_C DFES_DbLv.DFC_UPmpMotSCG_C DFES_DbLv.DFC_WaHtElOL_C DFES_DbLv.DFC_WaHtElOvrTemp_C DFES_DbLv.DFC_WaHtElSCB_C DFES_DbLv.DFC_IVActrUChSRCMax_C DFES_DbLv.DFC_IVActrUChSRCMin_C DFES_DbLv.DFC_IVActrVltgSRCMax_C DFES_DbLv.DFC_IVActrVltgSRCMin_C DFES_DbLv.DFC_IVDiaTunDet_C DFES_DbLv.DFC_IVPSplyStopDCDC_C DFES_DbLv.DFC_IVPSplyVltgSRCMax_C DFES_DbLv.DFC_IVPSplyVltgSRCMin_C DFES_DbLv.DFC_SCREtaErr_C DFES_DbLv.DFC_SCREtaErr1_C DFES_DbLv.DFC_SCREtaErr2_C DFES_DbLv.DFC_SCRMonMetCtlPresErr_C DFES_DbLv.DFC_SCRMonPresBuildUpErr_C DFES_DbLv.DFC_SCRMonPresRdcErr_C DFES_DbLv.DFC_AFSOffsDrftMax_C DFES_DbLv.DFC_AFSOffsDrftMin_C DFES_DbLv.DFC_AFSSRCCorMax_C DFES_DbLv.DFC_AFSSRCCorMin_C DFES_DbLv.DFC_AFSSRCRawMax_C DFES_DbLv.DFC_AFSSRCRawMin_C DFES_DbLv.DFC_AFSSetyDrftMax_C DFES_DbLv.DFC_AFSSetyDrftMin_C DFES_DbLv.DFC_AirCSwtNpl_C DFES_DbLv.DFC_AirCSwtSig_C DFES_DbLv.DFC_BattUSRCMax_C DFES_DbLv.DFC_BattUSRCMin_C DFES_DbLv.DFC_BrkNpl_C DFES_DbLv.DFC_BrkPSRCMax_C DFES_DbLv.DFC_BrkPSRCMin_C DFES_DbLv.DFC_CEngDsTSRCMax_C DFES_DbLv.DFC_CEngDsTSRCMin_C DFES_DbLv.DFC_CrCUIDet_C DFES_DbLv.DFC_ECBVlvSRCMax_C DFES_DbLv.DFC_ECBVlvSRCMin_C DFES_DbLv.DFC_ECUOvrTemp_C DFES_DbLv.DFC_EGRVlvGovDvtMax_C DFES_DbLv.DFC_EGRVlvGovDvtMin_C DFES_DbLv.DFC_EGRVlvHBrgOpnLd_C DFES_DbLv.DFC_EGRVlvHBrgOvrCurr_C DFES_DbLv.DFC_EGRVlvHBrgOvrTemp_C DFES_DbLv.DFC_EGRVlvHBrgShCirBatt1_C DFES_DbLv.DFC_EGRVlvHBrgShCirBatt2_C DFES_DbLv.DFC_EGRVlvHBrgShCirGnd1_C DFES_DbLv.DFC_EGRVlvHBrgShCirGnd2_C DFES_DbLv.DFC_EGRVlvHBrgShCirOvrLd_C DFES_DbLv.DFC_EGRVlvHBrgTempOvrCurr_C DFES_DbLv.DFC_EGRVlvHBrgUndrVltg_C DFES_DbLv.DFC_EGRVlvLPGovDvtMax_C DFES_DbLv.DFC_EGRVlvLPGovDvtMin_C DFES_DbLv.DFC_EGRVlvLPHBrgOpnLd_C DFES_DbLv.DFC_EGRVlvLPHBrgOvrCurr_C DFES_DbLv.DFC_EGRVlvLPHBrgOvrTemp_C DFES_DbLv.DFC_EGRVlvLPHBrgShCirBatt1_C DFES_DbLv.DFC_EGRVlvLPHBrgShCirBatt2_C DFES_DbLv.DFC_EGRVlvLPHBrgShCirGnd1_C DFES_DbLv.DFC_EGRVlvLPHBrgShCirGnd2_C DFES_DbLv.DFC_EGRVlvLPHBrgShCirOvrLd_C DFES_DbLv.DFC_EGRVlvLPHBrgTempOvrCurr_C DFES_DbLv.DFC_EGRVlvLPHBrgUndrVltg_C DFES_DbLv.DFC_EGRVlvLPOL_C DFES_DbLv.DFC_EGRVlvLPSCB_C DFES_DbLv.DFC_EGRVlvLPSCG_C DFES_DbLv.DFC_EGRVlvLPSRCMax_C DFES_DbLv.DFC_EGRVlvLPSRCMin_C DFES_DbLv.DFC_EGRVlvOL_C DFES_DbLv.DFC_EGRVlvSCB_C DFES_DbLv.DFC_EGRVlvSCG_C DFES_DbLv.DFC_EGRVlvSRCMax_C DFES_DbLv.DFC_EGRVlvSRCMin_C DFES_DbLv.DFC_EngPrtOvrSpd_C DFES_DbLv.DFC_EngSpdOL_C DFES_DbLv.DFC_EngSpdSCB_C DFES_DbLv.DFC_EngSpdSCG_C DFES_DbLv.DFC_EnhSRCMaxPPFltDiff_C DFES_DbLv.DFC_EnhSRCMaxT1ExhTMon_C DFES_DbLv.DFC_EnhSRCMaxT2ExhTMon_C DFES_DbLv.DFC_EnhSRCMaxT3ExhTMon_C DFES_DbLv.DFC_EnhSRCMinPPFltDiff_C DFES_DbLv.DFC_EnhSRCMinT1ExhTMon_C DFES_DbLv.DFC_EnhSRCMinT2ExhTMon_C DFES_DbLv.DFC_EnhSRCMinT3ExhTMon_C DFES_DbLv.DFC_EnvPSRCMax_C DFES_DbLv.DFC_EnvPSRCMin_C DFES_DbLv.DFC_ExhTMonPlaus_C DFES_DbLv.DFC_ExhTMonPlausPos1_C DFES_DbLv.DFC_ExhTMonPlausPos2_C DFES_DbLv.DFC_ExhTMonPlausPos3_C DFES_DbLv.DFC_ExhTMonT1Plaus_C DFES_DbLv.DFC_ExhTMonT2Plaus_C DFES_DbLv.DFC_ExhTMonT3Plaus_C DFES_DbLv.DFC_FlFltDsPSRCMax_C DFES_DbLv.DFC_FlFltDsPSRCMin_C DFES_DbLv.DFC_FlFltSig_C DFES_DbLv.DFC_FlFltUsPSRCMax_C DFES_DbLv.DFC_FlFltUsPSRCMin_C DFES_DbLv.DFC_FuelTSRCMax_C DFES_DbLv.DFC_FuelTSRCMin_C DFES_DbLv.DFC_GbxNPosPPerSRCMax_C DFES_DbLv.DFC_GbxNPosPPerSRCMin_C DFES_DbLv.DFC_GbxNPosPdcycSRCMax_C DFES_DbLv.DFC_GbxNPosPdcycSRCMin_C DFES_DbLv.DFC_InjVlvPresMin_C DFES_DbLv.DFC_LSUCircNernstSig_C DFES_DbLv.DFC_LSUCircPmpCurSig_C DFES_DbLv.DFC_LSUCircVirtGndSig_C DFES_DbLv.DFC_LSUO2Max_C DFES_DbLv.DFC_LSUO2Min_C DFES_DbLv.DFC_LSUSPIBattLowMin_C DFES_DbLv.DFC_LSUWireSCB_C DFES_DbLv.DFC_LSUWireSCG_C DFES_DbLv.DFC_MeUnSCG_C DFES_DbLv.DFC_NSCDsCmpChk_C DFES_DbLv.DFC_NSCDsLamBinSRCMax_C DFES_DbLv.DFC_NSCDsLamBinSRCMin_C DFES_DbLv.DFC_NSCDsLamLinSRCMax_C DFES_DbLv.DFC_NSCDsLamLinSRCMin_C DFES_DbLv.DFC_NSCDsLamPlausMax_C DFES_DbLv.DFC_NSCDsLamPlausMin_C DFES_DbLv.DFC_NSCDsNOxSRCMax_C DFES_DbLv.DFC_NSCDsNOxSRCMin_C DFES_DbLv.DFC_NSCDsOpCir_C DFES_DbLv.DFC_NSCDsShCir_C DFES_DbLv.DFC_NoCat2DsCmpChk_C DFES_DbLv.DFC_NoCat2DsLamBinSRCMax_C DFES_DbLv.DFC_NoCat2DsLamBinSRCMin_C DFES_DbLv.DFC_NoCat2DsLamLinSRCMax_C DFES_DbLv.DFC_NoCat2DsLamLinSRCMin_C DFES_DbLv.DFC_NoCat2DsLamPlausMax_C DFES_DbLv.DFC_NoCat2DsLamPlausMin_C DFES_DbLv.DFC_NoCat2DsNOxSRCMax_C DFES_DbLv.DFC_NoCat2DsNOxSRCMin_C DFES_DbLv.DFC_NoCat2DsOpCir_C DFES_DbLv.DFC_NoCat2DsShCir_C DFES_DbLv.DFC_NplDynPPFltDiff_C DFES_DbLv.DFC_NplHsChngPPFltDiff_C DFES_DbLv.DFC_NplHsLnPPFltDiff_C DFES_DbLv.DFC_NplTOxiCatUs_C DFES_DbLv.DFC_NplTPFltUs_C DFES_DbLv.DFC_NplTTrbnUs_C DFES_DbLv.DFC_OilPSwmpSRCMax_C DFES_DbLv.DFC_OilPSwmpSRCMin_C DFES_DbLv.DFC_PCVSCG_C DFES_DbLv.DFC_PFltCharPDiffMin_C DFES_DbLv.DFC_PFltDstrMin_C DFES_DbLv.DFC_PFltEngPrt_C DFES_DbLv.DFC_PFltRgnPerm_C DFES_DbLv.DFC_PFltSRCMaxFlwRstn_C DFES_DbLv.DFC_PFltSRCMinFlwRstn_C DFES_DbLv.DFC_PFltSotMsDvtMax_C DFES_DbLv.DFC_PFltSotMsDvtMin_C DFES_DbLv.DFC_PFltSotMsMax_C DFES_DbLv.DFC_PIntkVUsSRCMax_C DFES_DbLv.DFC_PIntkVUsSRCMin_C DFES_DbLv.DFC_SRCHighAPP1_C DFES_DbLv.DFC_SRCHighAPP2_C DFES_DbLv.DFC_SRCLowAPP1_C DFES_DbLv.DFC_SRCLowAPP2_C DFES_DbLv.DFC_SRCMaxPPFltDiff_C DFES_DbLv.DFC_SRCMaxPPFltUs_C DFES_DbLv.DFC_SRCMaxTECU_C DFES_DbLv.DFC_SRCMaxTOxiCatUs_C DFES_DbLv.DFC_SRCMaxTPFltUs_C DFES_DbLv.DFC_SRCMaxTTrbnUs_C DFES_DbLv.DFC_SRCMaxUCatUsT_C DFES_DbLv.DFC_SRCMaxUPmpP_C DFES_DbLv.DFC_SRCMinPPFltDiff_C DFES_DbLv.DFC_SRCMinPPFltUs_C DFES_DbLv.DFC_SRCMinTECU_C DFES_DbLv.DFC_SRCMinTOxiCatUs_C DFES_DbLv.DFC_SRCMinTPFltUs_C DFES_DbLv.DFC_SRCMinTTrbnUs_C DFES_DbLv.DFC_SRCMinUCatUsT_C DFES_DbLv.DFC_SRCMinUPmpP_C DFES_DbLv.DFC_SigUCatUsT_C DFES_DbLv.DFC_SigUPmpP_C DFES_DbLv.DFC_SyncAPP_C DFES_DbLv.DFC_T15Npl_C DFES_DbLv.DFC_TAFSDtyCycHi_C DFES_DbLv.DFC_TAFSDtyCycLo_C DFES_DbLv.DFC_TAFSPerHi_C DFES_DbLv.DFC_TAFSPerLo_C DFES_DbLv.DFC_TCACDsSRCMax_C DFES_DbLv.DFC_TCACDsSRCMin_C DFES_DbLv.DFC_ThrVlvSRCMax_C DFES_DbLv.DFC_ThrVlvSRCMin_C DFES_DbLv.DFC_TrbChLPOL_C DFES_DbLv.DFC_TrbChLPSCB_C DFES_DbLv.DFC_TrbChLPSCG_C DFES_DbLv.DFC_UHtrPLOL_C DFES_DbLv.DFC_UHtrPLSCB_C DFES_DbLv.DFC_UHtrPLSCG_C DFES_DbLv.DFC_UHtrPLSRCMaxDia_C DFES_DbLv.DFC_UHtrPLSRCMinDia_C DFES_DbLv.DFC_UHtrTnkOL_C DFES_DbLv.DFC_UHtrTnkSCB_C DFES_DbLv.DFC_UHtrTnkSCG_C DFES_DbLv.DFC_UHtrTnkSRCMaxDia_C DFES_DbLv.DFC_UHtrTnkSRCMinDia_C DFES_DbLv.DFC_URevVlvOL_C DFES_DbLv.DFC_URevVlvSCB_C DFES_DbLv.DFC_URevVlvSCG_C DFES_DbLv.DFC_UTnkTSRCMax_C DFES_DbLv.DFC_UTnkTSRCMin_C DFES_DbLv.DFC_UTnkTSig_C DFES_DbLv.DFC_VSwVlvGovDvtMax_C DFES_DbLv.DFC_VSwVlvGovDvtMin_C DFES_DbLv.DFC_VSwVlvHBrgOpnLd_C DFES_DbLv.DFC_VSwVlvHBrgOvrCurr_C DFES_DbLv.DFC_VSwVlvHBrgOvrTemp_C DFES_DbLv.DFC_VSwVlvHBrgShCirBatt1_C DFES_DbLv.DFC_VSwVlvHBrgShCirBatt2_C DFES_DbLv.DFC_VSwVlvHBrgShCirGnd1_C DFES_DbLv.DFC_VSwVlvHBrgShCirGnd2_C DFES_DbLv.DFC_VSwVlvHBrgShCirOvrLd_C DFES_DbLv.DFC_VSwVlvHBrgTempOvrCurr_C DFES_DbLv.DFC_VSwVlvHBrgUndrVltg_C DFES_DbLv.DFC_VSwVlvOL_C DFES_DbLv.DFC_VSwVlvSCB_C DFES_DbLv.DFC_VSwVlvSCG_C DFES_DbLv.DFC_VSwVlvSRCMax_C DFES_DbLv.DFC_VSwVlvSRCMin_C DFES_DbLv.DFC_ClthNpl_C DFES_DbLv.DFC_ETClbETMax_0_C DFES_DbLv.DFC_ETClbETMax_1_C DFES_DbLv.DFC_ETClbETMax_2_C DFES_DbLv.DFC_ETClbETMax_3_C DFES_DbLv.DFC_ETClbETMax_4_C DFES_DbLv.DFC_ETClbETMax_5_C DFES_DbLv.DFC_ETClbETMin_0_C DFES_DbLv.DFC_ETClbETMin_1_C DFES_DbLv.DFC_ETClbETMin_2_C DFES_DbLv.DFC_ETClbETMin_3_C DFES_DbLv.DFC_ETClbETMin_4_C DFES_DbLv.DFC_ETClbETMin_5_C DFES_DbLv.DFC_IVActrEnrgMax_0_C DFES_DbLv.DFC_IVActrEnrgMax_1_C DFES_DbLv.DFC_IVActrEnrgMax_2_C DFES_DbLv.DFC_IVActrEnrgMax_3_C DFES_DbLv.DFC_IVActrEnrgMax_4_C DFES_DbLv.DFC_IVActrEnrgMax_5_C DFES_DbLv.DFC_IVActrEnrgMax_6_C DFES_DbLv.DFC_IVActrEnrgMax_7_C DFES_DbLv.DFC_IVActrEnrgMin_0_C DFES_DbLv.DFC_IVActrEnrgMin_1_C DFES_DbLv.DFC_IVActrEnrgMin_2_C DFES_DbLv.DFC_IVActrEnrgMin_3_C DFES_DbLv.DFC_IVActrEnrgMin_4_C DFES_DbLv.DFC_IVActrEnrgMin_5_C DFES_DbLv.DFC_IVActrEnrgMin_6_C DFES_DbLv.DFC_IVActrEnrgMin_7_C DFES_DbLv.DFC_IVActrEnrgPlaus_0_C DFES_DbLv.DFC_IVActrEnrgPlaus_1_C DFES_DbLv.DFC_IVActrEnrgPlaus_2_C DFES_DbLv.DFC_IVActrEnrgPlaus_3_C DFES_DbLv.DFC_IVActrEnrgPlaus_4_C DFES_DbLv.DFC_IVActrEnrgPlaus_5_C DFES_DbLv.DFC_IVActrEnrgPlaus_6_C DFES_DbLv.DFC_IVActrEnrgPlaus_7_C DFES_DbLv.DFC_IVCtlTiDiff_0_C DFES_DbLv.DFC_IVCtlTiDiff_1_C DFES_DbLv.DFC_IVCtlTiDiff_2_C DFES_DbLv.DFC_IVCtlTiDiff_3_C DFES_DbLv.DFC_IVCtlTiDiff_4_C DFES_DbLv.DFC_IVCtlTiDiff_5_C DFES_DbLv.DFC_IVCtlUDiffUp_0_C DFES_DbLv.DFC_IVCtlUDiffUp_1_C DFES_DbLv.DFC_IVCtlUDiffUp_2_C DFES_DbLv.DFC_IVCtlUDiffUp_3_C DFES_DbLv.DFC_IVCtlUDiffUp_4_C DFES_DbLv.DFC_IVCtlUDiffUp_5_C DFES_DbLv.DFC_IVCtlUUp_0_C DFES_DbLv.DFC_IVCtlUUp_1_C DFES_DbLv.DFC_IVCtlUUp_2_C DFES_DbLv.DFC_IVCtlUUp_3_C DFES_DbLv.DFC_IVCtlUUp_4_C DFES_DbLv.DFC_IVCtlUUp_5_C DFES_DbLv.DFC_IVDiaBnkShCir_0_C DFES_DbLv.DFC_IVDiaBnkShCir_1_C DFES_DbLv.DFC_IVDiaBnkShCirChSwt_0_C DFES_DbLv.DFC_IVDiaBnkShCirChSwt_1_C DFES_DbLv.DFC_IVDiaChp_0_C DFES_DbLv.DFC_IVDiaChp_1_C DFES_DbLv.DFC_IVDiaCylNoCls_0_C DFES_DbLv.DFC_IVDiaCylNoCls_1_C DFES_DbLv.DFC_IVDiaCylNoCls_2_C DFES_DbLv.DFC_IVDiaCylNoCls_3_C DFES_DbLv.DFC_IVDiaCylNoCls_4_C DFES_DbLv.DFC_IVDiaCylNoCls_5_C DFES_DbLv.DFC_IVDiaCylNoLd_0_C DFES_DbLv.DFC_IVDiaCylNoLd_1_C DFES_DbLv.DFC_IVDiaCylNoLd_2_C DFES_DbLv.DFC_IVDiaCylNoLd_3_C DFES_DbLv.DFC_IVDiaCylNoLd_4_C DFES_DbLv.DFC_IVDiaCylNoLd_5_C DFES_DbLv.DFC_IVDiaCylShCir_0_C DFES_DbLv.DFC_IVDiaCylShCir_1_C DFES_DbLv.DFC_IVDiaCylShCir_2_C DFES_DbLv.DFC_IVDiaCylShCir_3_C DFES_DbLv.DFC_IVDiaCylShCir_4_C DFES_DbLv.DFC_IVDiaCylShCir_5_C DFES_DbLv.DFC_IVDiaCylShCirHSLS_0_C DFES_DbLv.DFC_IVDiaCylShCirHSLS_1_C DFES_DbLv.DFC_IVDiaCylShCirHSLS_2_C DFES_DbLv.DFC_IVDiaCylShCirHSLS_3_C DFES_DbLv.DFC_IVDiaCylShCirHSLS_4_C DFES_DbLv.DFC_IVDiaCylShCirHSLS_5_C DFES_DbLv.DFC_IVDiaCylShCirMeas_0_C DFES_DbLv.DFC_IVDiaCylShCirMeas_1_C DFES_DbLv.DFC_IVDiaCylShCirMeas_2_C DFES_DbLv.DFC_IVDiaCylShCirMeas_3_C DFES_DbLv.DFC_IVDiaCylShCirMeas_4_C DFES_DbLv.DFC_IVDiaCylShCirMeas_5_C DFES_DbLv.DFC_LSUDynChk_C DFES_DbLv.DFC_LSUO2ClbMax_C DFES_DbLv.DFC_LSUO2ClbMin_C DFES_DbLv.DFC_LSUO2PlausMaxFLd_C DFES_DbLv.DFC_LSUO2PlausMaxOvrRun_C DFES_DbLv.DFC_LSUO2PlausMaxPartLd_C DFES_DbLv.DFC_LSUO2PlausMinFLd_C DFES_DbLv.DFC_LSUO2PlausMinOvrRun_C DFES_DbLv.DFC_LSUO2PlausMinPartLd_C DFES_DbLv.DFC_LSURiClbMax_C DFES_DbLv.DFC_LSURiClbMin_C DFES_DbLv.DFC_LSUWireIPSig_C DFES_DbLv.DFC_Layer_BSDMax_C DFES_DbLv.DFC_Layer_BSDMin_C DFES_DbLv.DFC_Layer_BSDNpl_C DFES_DbLv.DFC_Layer_BSDSig_C DFES_DbLv.DFC_Layer_FltMngTstMax_C DFES_DbLv.DFC_Layer_FltMngTstMin_C DFES_DbLv.DFC_Layer_FltMngTstNpl_C DFES_DbLv.DFC_Layer_FltMngTstSig_C DFES_DbLv.DFC_Layer_GENELBMax_C DFES_DbLv.DFC_Layer_GENELBMin_C DFES_DbLv.DFC_Layer_GENELBNpl_C DFES_DbLv.DFC_Layer_GENELBSig_C DFES_DbLv.DFC_Layer_GENELMax_C DFES_DbLv.DFC_Layer_GENELMin_C DFES_DbLv.DFC_Layer_GENELNpl_C DFES_DbLv.DFC_Layer_GENELSig_C DFES_DbLv.DFC_Layer_GENHTBMax_C DFES_DbLv.DFC_Layer_GENHTBMin_C DFES_DbLv.DFC_Layer_GENHTBNpl_C DFES_DbLv.DFC_Layer_GENHTBSig_C DFES_DbLv.DFC_Layer_GENHTMax_C DFES_DbLv.DFC_Layer_GENHTMin_C DFES_DbLv.DFC_Layer_GENHTNpl_C DFES_DbLv.DFC_Layer_GENHTSig_C DFES_DbLv.DFC_Layer_GENKOMMMax_C DFES_DbLv.DFC_Layer_GENKOMMMin_C DFES_DbLv.DFC_Layer_GENKOMMNpl_C DFES_DbLv.DFC_Layer_GENKOMMSig_C DFES_DbLv.DFC_Layer_GENMECHMax_C DFES_DbLv.DFC_Layer_GENMECHMin_C DFES_DbLv.DFC_Layer_GENMECHNpl_C DFES_DbLv.DFC_Layer_GENMECHSig_C DFES_DbLv.DFC_Layer_GENMax_C DFES_DbLv.DFC_Layer_GENMin_C DFES_DbLv.DFC_Layer_GENNpl_C DFES_DbLv.DFC_Layer_GENREGUPLMax_C DFES_DbLv.DFC_Layer_GENREGUPLMin_C DFES_DbLv.DFC_Layer_GENREGUPLNpl_C DFES_DbLv.DFC_Layer_GENREGUPLSig_C DFES_DbLv.DFC_Layer_GENSig_C DFES_DbLv.DFC_Layer_GENUPLMax_C DFES_DbLv.DFC_Layer_GENUPLMin_C DFES_DbLv.DFC_Layer_GENUPLNpl_C DFES_DbLv.DFC_Layer_GENUPLSig_C DFES_DbLv.DFC_Layer_IBS1Max_C DFES_DbLv.DFC_Layer_IBS1Min_C DFES_DbLv.DFC_Layer_IBS1Npl_C DFES_DbLv.DFC_Layer_IBS1Sig_C DFES_DbLv.DFC_Layer_IBS2Max_C DFES_DbLv.DFC_Layer_IBS2Min_C DFES_DbLv.DFC_Layer_IBS2Npl_C DFES_DbLv.DFC_Layer_IBS2Sig_C DFES_DbLv.DFC_Layer_IBS3Max_C DFES_DbLv.DFC_Layer_IBS3Min_C DFES_DbLv.DFC_Layer_IBS3Npl_C DFES_DbLv.DFC_Layer_IBS3Sig_C DFES_DbLv.DFC_Layer_MANDETEKMax_C DFES_DbLv.DFC_Layer_MANDETEKMin_C DFES_DbLv.DFC_Layer_MANDETEKNpl_C DFES_DbLv.DFC_Layer_MANDETEKSig_C DFES_DbLv.DFC_Layer_NDR1Max_C DFES_DbLv.DFC_Layer_NDR1Min_C DFES_DbLv.DFC_Layer_NDR1Npl_C DFES_DbLv.DFC_Layer_NDR1Sig_C DFES_DbLv.DFC_Layer_NDR2Max_C DFES_DbLv.DFC_Layer_NDR2Min_C DFES_DbLv.DFC_Layer_NDR2Npl_C DFES_DbLv.DFC_Layer_NDR2Sig_C DFES_DbLv.DFC_Layer_NGLERNMax_C DFES_DbLv.DFC_Layer_NGLERNMin_C DFES_DbLv.DFC_Layer_NGLERNNpl_C DFES_DbLv.DFC_Layer_NGLERNSig_C /end DEF_CHARACTERISTIC
/end FUNCTION
/begin COMPU_METHOD DFES_OneToOne "" RAT_FUNC "%6.0" "-" COEFFS 0 1 0 0 0 1 /end COMPU_METHOD
/begin RECORD_LAYOUT Val_Wu8 FNC_VALUES 1 UBYTE COLUMN_DIR DIRECT /end RECORD_LAYOUT
/end MODULE
/end PROJECT

ASAP2_VERSION 1 4
/begin PROJECT P_574 "EDC17_CP09"
/begin HEADER "" VERSION "V8KB" PROJECT_NO P_574 /end HEADER
/begin MODULE DIM ""
/begin MOD_COMMON "" BYTE_ORDER MSB_LAST ALIGNMENT_BYTE 1 ALIGNMENT_WORD 2 ALIGNMENT_LONG 4 ALIGNMENT_FLOAT32_IEEE 4 /end MOD_COMMON
/begin CHARACTERISTIC DFES_FaultTyp.DFC_ComSpeedVehicleTo_FX_C "DFES/Fehlertyp Zuordnung für Prüfung DFC_ComSpeedVehicleTo_FX" VALUE 0x8002A4F4 Val_Wu8 255.0 DFES_OneToOne 0.00 255.0 /end CHARACTERISTIC
/begin CHARACTERISTIC DFES_FaultTyp.DFC_ComStConintDSCChk_FX_C "DFES/Fehlertyp Zuordnung für Prüfung DFC_ComStConintDSCChk_FX" VALUE 0x8002A4F5 Val_Wu8 255.0 DFES_OneToOne 0.00 255.0 /end CHARACTERISTIC
/begin CHARACTERISTIC DFES_FaultTyp.DFC_ComStConintDSCCtr_FX_C "DFES/Fehlertyp Zuordnung für Prüfung DFC_ComStConintDSCCtr_FX" VALUE 0x8002A4F6 Val_Wu8 255.0 DFES_OneToOne 0.00 255.0 /end CHARACTERISTIC
/begin CHARACTERISTIC DFES_FaultTyp.DFC_ComStConintDSCTo_FX_C "DFES/Fehlertyp Zuordnung für Prüfung DFC_ComStConintDSCTo_FX" VALUE 0x8002A4F7 Val_Wu8 255.0 DFES_OneToOne 0.00 255.0 /end CHARACTERISTIC
/begin CHARACTERISTIC DFES_FaultTyp.DFC_ComStatACFrontSig_FA_C "DFES/Fehlertyp Zuordnung für Prüfung DFC_ComStatACFrontSig_FA" VALUE 0x8002A4F8 Val_Wu8 255.0 DFES_OneToOne 0.00 255.0 /end CHARACTERISTIC
/begin CHARACTERISTIC DFES_FaultTyp.DFC_ComStatACFrontTo_FA_C "DFES/Fehlertyp Zuordnung für Prüfung DFC_ComStatACFrontTo_FA" VALUE 0x8002A4F9 Val_Wu8 255.0 DFES_OneToOne 0.00 255.0 /end CHARACTERISTIC
/begin CHARACTERISTIC DFES_FaultTyp.DFC_ComStatEkpSig_A_C "DFES/Fehlertyp Zuordnung für Prüfung DFC_ComStatEkpSig_A" VALUE 0x8002A4FA Val_Wu8 255.0 DFES_OneToOne 0.00 255.0 /end CHARACTERISTIC
/begin CHARACTERISTIC DFES_FaultTyp.DFC_ComStatEkpTo_A_C "DFES/Fehlertyp Zuordnung für Prüfung DFC_ComStatEkpTo_A" VALUE 0x8002A4FB Val_Wu8 255.0 DFES_OneToOne 0.00 255.0 /end CHARACTERISTIC
/begin CHARACTERISTIC DFES_FaultTyp.DFC_ComStatGearRevSig_FA_C "DFES/Fehlertyp Zuordnung für Prüfung DFC_ComStatGearRevSig_FA" VALUE 0x8002A4FC Val_Wu8 255.0 DFES_OneToOne 0.00 255.0 /end CHARACTERISTIC
/begin CHARACTERISTIC DFES_FaultTyp.DFC_ComStatGearRevTo_FA_C "DFES/Fehlertyp Zuordnung für Prüfung DFC_ComStatGearRevTo_FA" VALUE 0x8002A4FD Val_Wu8 255.0 DFES_OneToOne 0.00 255.0 /end CHARACTERISTIC
/begin CHARACTERISTIC DFES_FaultTyp.DFC_ComStatZVKlappenSig_FA_C "DFES/Fehlertyp Zuordnung für Prüfung DFC_ComStatZVKlappenSig_FA" VALUE 0x8002A4FE Val_Wu8 255.0 DFES_OneToOne 0.00 255.0 /end CHARACTERISTIC
/begin CHARACTERISTIC DFES_FaultTyp.DFC_ComStatZVKlappenTo_FA_C "DFES/Fehlertyp Zuordnung für Prüfung DFC_ComStatZVKlappenTo_FA" VALUE 0x8002A4FF Val_Wu8 255.0 DFES_OneToOne 0.00 255.0 /end CHARACTERISTIC
/begin CHARACTERISTIC DFES_FaultTyp.DFC_ComStateARSCtr_C "DFES/Fehlertyp Zuordnung für Prüfung DFC_ComStateARSCtr" VALUE 0x8002A500 Val_Wu8 255.0 DFES_OneToOne 0.00 255.0 /end CHARACTERISTIC
/begin CHARACTERISTIC DFES_FaultTyp.DFC_ComStateARSSig_C "DFES/Fehlertyp Zuordnung für Prüfung DFC_ComStateARSSig" VALUE 0x8002A501 Val_Wu8 255.0 DFES_OneToOne 0.00 255.0 /end CHARACTERISTIC
/begin CHARACTERISTIC DFES_FaultTyp.DFC_ComStateARSTo_C "DFES/Fehlertyp Zuordnung für Prüfung DFC_ComStateARSTo" VALUE 0x8002A502 Val_Wu8 255.0 DFES_OneToOne 0.00 255.0 /end CHARACTERISTIC
/begin CHARACTERISTIC DFES_FaultTyp.DFC_ComStateDscSig_C "DFES/Fehlertyp Zuordnung für Prüfung DFC_ComStateDscSig" VALUE 0x8002A503 Val_Wu8 255.0 DFES_OneToOne 0.00 255.0 /end CHARACTERISTIC
/begin CHARACTERISTIC DFES_FaultTyp.DFC_ComStateDscTo_C "DFES/Fehlertyp Zuordnung für Prüfung DFC_ComStateDscTo" VALUE 0x8002A504 Val_Wu8 255.0 DFES_OneToOne 0.00 255.0 /end CHARACTERISTIC
/begin CHARACTERISTIC DFES_FaultTyp.DFC_ComStateSeatSig_C "DFES/Fehlertyp Zuordnung für Prüfung DFC_ComStateSeatSig" VALUE 0x8002A505 Val_Wu8 255.0 DFES_OneToOne 0.00 255.0 /end CHARACTERISTIC
/begin CHARACTERISTIC DFES_FaultTyp.DFC_ComStateSeatSig_FA_C "DFES/Fehlertyp Zuordnung für Prüfung DFC_ComStateSeatSig_FA" VALUE 0x8002A506 Val_Wu8 255.0 DFES_OneToOne 0.00 255.0 /end CHARACTERISTIC
/begin CHARACTERISTIC DFES_FaultTyp.DFC_ComStateSeatTo_C "DFES/Fehlertyp Zuordnung für Prüfung DFC_ComStateSeatTo" VALUE 0x8002A507 Val_Wu8 255.0 DFES_OneToOne 0.00 255.0 /end CHARACTERISTIC
/begin CHARACTERISTIC DFES_FaultTyp.DFC_ComStateSeatTo_FA_C "DFES/Fehlertyp Zuordnung für Prüfung DFC_ComStateSeatTo_FA" VALUE 0x8002A508 Val_Wu8 255.0 DFES_OneToOne 0.00 255.0 /end CHARACTERISTIC
/begin CHARACTERISTIC DFES_FaultTyp.DFC_ComStatusEGSSig_A_C "DFES/Fehlertyp Zuordnung für Prüfung DFC_ComStatusEGSSig_A" VALUE 0x8002A509 Val_Wu8 255.0 DFES_OneToOne 0.00 255.0 /end CHARACTERISTIC
/begin CHARACTERISTIC DFES_FaultTyp.DFC_ComStatusEGSSig_FA_C "DFES/Fehlertyp Zuordnung für Prüfung DFC_ComStatusEGSSig_FA" VALUE 0x8002A50A Val_Wu8 255.0 DFES_OneToOne 0.00 255.0 /end CHARACTERISTIC
/begin CHARACTERISTIC DFES_FaultTyp.DFC_ComStatusEGSTo_A_C "DFES/Fehlertyp Zuordnung für Prüfung DFC_ComStatusEGSTo_A" VALUE 0x8002A50B Val_Wu8 255.0 DFES_OneToOne 0.00 255.0 /end CHARACTERISTIC
/begin CHARACTERISTIC DFES_FaultTyp.DFC_ComStatusEGSTo_FA_C "DFES/Fehlertyp Zuordnung für Prüfung DFC_ComStatusEGSTo_FA" VALUE 0x8002A50C Val_Wu8 255.0 DFES_OneToOne 0.00 255.0 /end CHARACTERISTIC
/begin CHARACTERISTIC DFES_FaultTyp.DFC_ComStatusEMFChk_C "DFES/Fehlertyp Zuordnung für Prüfung DFC_ComStatusEMFChk" VALUE 0x8002A50D Val_Wu8 255.0 DFES_OneToOne 0.00 255.0 /end CHARACTERISTIC
/begin CHARACTERISTIC DFES_FaultTyp.DFC_ComStatusEMFCtr_C "DFES/Fehlertyp Zuordnung für Prüfung DFC_ComStatusEMFCtr" VALUE 0x8002A50E Val_Wu8 255.0 DFES_OneToOne 0.00 255.0 /end CHARACTERISTIC
/begin CHARACTERISTIC DFES_FaultTyp.DFC_ComStatusEMFSig_C "DFES/Fehlertyp Zuordnung für Prüfung DFC_ComStatusEMFSig" VALUE 0x8002A50F Val_Wu8 255.0 DFES_OneToOne 0.00 255.0 /end CHARACTERISTIC
/begin CHARACTERISTIC DFES_FaultTyp.DFC_ComStatusEMFTo_C "DFES/Fehlertyp Zuordnung für Prüfung DFC_ComStatusEMFTo" VALUE 0x8002A510 Val_Wu8 255.0 DFES_OneToOne 0.00 255.0 /end CHARACTERISTIC
/begin CHARACTERISTIC DFES_FaultTyp.DFC_ComStatusRGangSig_C "DFES/Fehlertyp Zuordnung für Prüfung DFC_ComStatusRGangSig" VALUE 0x8002A511 Val_Wu8 255.0 DFES_OneToOne 0.00 255.0 /end CHARACTERISTIC
/begin CHARACTERISTIC DFES_FaultTyp.DFC_ComStatusRGangTo_C "DFES/Fehlertyp Zuordnung für Prüfung DFC_ComStatusRGangTo" VALUE 0x8002A512 Val_Wu8 255.0 DFES_OneToOne 0.00 255.0 /end CHARACTERISTIC
/begin CHARACTERISTIC DFES_FaultTyp.DFC_ComSteeringAngleChk_FX_C "DFES/Fehlertyp Zuordnung für Prüfung DFC_ComSteeringAngleChk_FX" VALUE 0x8002A513 Val_Wu8 255.0 DFES_OneToOne 0.00 255.0 /end CHARACTERISTIC
/begin CHARACTERISTIC DFES_FaultTyp.DFC_ComSteeringAngleCtr_FX_C "DFES/Fehlertyp Zuordnung für Prüfung DFC_ComSteeringAngleCtr_FX" VALUE 0x8002A514 Val_Wu8 255.0 DFES_OneToOne 0.00 255.0 /end CHARACTERISTIC
/begin CHARACTERISTIC DFES_FaultTyp.DFC_ComSteeringAngleTo_FX_C "DFES/Fehlertyp Zuordnung für Prüfung DFC_ComSteeringAngleTo_FX" VALUE 0x8002A515 Val_Wu8 255.0 DFES_OneToOne 0.00 255.0 /end CHARACTERISTIC
/begin CHARACTERISTIC DFES_FaultTyp.DFC_ComTerminalChk_C "DFES/Fehlertyp Zuordnung für Prüfung DFC_ComTerminalChk" VALUE 0x8002A516 Val_Wu8 255.0 DFES_OneToOne 0.00 255.0 /end CHARACTERISTIC
/begin CHARACTERISTIC DFES_FaultTyp.DFC_ComTerminalCtr_C "DFES/Fehlertyp Zuordnung für Prüfung DFC_ComTerminalCtr" VALUE 0x8002A517 Val_Wu8 255.0 DFES_OneToOne 0.00 255.0 /end CHARACTERISTIC
/begin CHARACTERISTIC DFES_FaultTyp.DFC_ComTerminalSig_C "DFES/Fehlertyp Zuordnung für Prüfung DFC_ComTerminalSig" VALUE 0x8002A518 Val_Wu8 255.0 DFES_OneToOne 0.00 255.0 /end CHARACTERISTIC
/begin CHARACTERISTIC DFES_FaultTyp.DFC_ComTerminalTo_C "DFES/Fehlertyp Zuordnung für Prüfung DFC_ComTerminalTo" VALUE 0x8002A519 Val_Wu8 255.0 DFES_OneToOne 0.00 255.0 /end CHARACTERISTIC
/begin CHARACTERISTIC DFES_FaultTyp.DFC_ComTimeDateSig_FA_C "DFES/Fehlertyp Zuordnung für Prüfung DFC_ComTimeDateSig_FA" VALUE 0x8002A51A Val_Wu8 255.0 DFES_OneToOne 0.00 255.0 /end CHARACTERISTIC
/begin CHARACTERISTIC DFES_FaultTyp.DFC_ComTimeDateTo_FA_C "DFES/Fehlertyp Zuordnung für Prüfung DFC_ComTimeDateTo_FA" VALUE 0x8002A51B Val_Wu8 255.0 DFES_OneToOne 0.00 255.0 /end CHARACTERISTIC
/begin CHARACTERISTIC DFES_FaultTyp.DFC_ComTrailerSig_C "DFES/Fehlertyp Zuordnung für Prüfung DFC_ComTrailerSig" VALUE 0x8002A51C Val_Wu8 255.0 DFES_OneToOne 0.00 255.0 /end CHARACTERISTIC
/begin CHARACTERISTIC DFES_FaultTyp.DFC_ComTrailerSig_FA_C "DFES/Fehlertyp Zuordnung für Prüfung DFC_ComTrailerSig_FA" VALUE 0x8002A51D Val_Wu8 255.0 DFES_OneToOne 0.00 255.0 /end CHARACTERISTIC
/begin CHARACTERISTIC DFES_FaultTyp.DFC_ComTrailerTo_C "DFES/Fehlertyp Zuordnung für Prüfung DFC_ComTrailerTo" VALUE 0x8002A51E Val_Wu8 255.0 DFES_OneToOne 0.00 255.0 /end CHARACTERISTIC
/begin CHARACTERISTIC DFES_FaultTyp.DFC_ComTrailerTo_FA_C "DFES/Fehlertyp Zuordnung für Prüfung DFC_ComTrailerTo_FA" VALUE 0x8002A51F Val_Wu8 255.0 DFES_OneToOne 0.00 255.0 /end CHARACTERISTIC
/begin CHARACTERISTIC DFES_FaultTyp.DFC_ComTrqDemCrshDrDyChk_FX_C "DFES/Fehlertyp Zuordnung für Prüfung DFC_ComTrqDemCrshDrDyChk_FX" VALUE 0x8002A520 Val_Wu8 255.0 DFES_OneToOne 0.00 255.0 /end CHARACTERISTIC
/begin CHARACTERISTIC DFES_FaultTyp.DFC_ComTrqDemCrshDrDyCtr_FX_C "DFES/Fehlertyp Zuordnung für Prüfung DFC_ComTrqDemCrshDrDyCtr_FX" VALUE 0x8002A521 Val_Wu8 255.0 DFES_OneToOne 0.00 255.0 /end CHARACTERISTIC
/begin CHARACTERISTIC DFES_FaultTyp.DFC_ComTrqDemCrshDrDyTo_FX_C "DFES/Fehlertyp Zuordnung für Prüfung DFC_ComTrqDemCrshDrDyTo_FX" VALUE 0x8002A522 Val_Wu8 255.0 DFES_OneToOne 0.00 255.0 /end CHARACTERISTIC
/begin CHARACTERISTIC DFES_FaultTyp.DFC_ComTrqDemandDesSig_C "DFES/Fehlertyp Zuordnung für Prüfung DFC_ComTrqDemandDesSig" VALUE 0x8002A523 Val_Wu8 255.0 DFES_OneToOne 0.00 255.0 /end CHARACTERISTIC
/begin CHARACTERISTIC DFES_FaultTyp.DFC_ComTrqDemandDesTo_C "DFES/Fehlertyp Zuordnung für Prüfung DFC_ComTrqDemandDesTo" VALUE 0x8002A524 Val_Wu8 255.0 DFES_OneToOne 0.00 255.0 /end CHARACTERISTIC
/begin CHARACTERISTIC DFES_FaultTyp.DFC_ComTrqDemandDscChk_C "DFES/Fehlertyp Zuordnung für Prüfung DFC_ComTrqDemandDscChk" VALUE 0x8002A525 Val_Wu8 255.0 DFES_OneToOne 0.00 255.0 /end CHARACTERISTIC
/begin CHARACTERISTIC DFES_FaultTyp.DFC_ComTrqDemandDscCtr_C "DFES/Fehlertyp Zuordnung für Prüfung DFC_ComTrqDemandDscCtr" VALUE 0x8002A526 Val_Wu8 255.0 DFES_OneToOne 0.00 255.0 /end CHARACTERISTIC
/begin CHARACTERISTIC DFES_FaultTyp.DFC_ComTrqDemandDscSig_C "DFES/Fehlertyp Zuordnung für Prüfung DFC_ComTrqDemandDscSig" VALUE 0x8002A527 Val_Wu8 255.0 DFES_OneToOne 0.00 255.0 /end CHARACTERISTIC
/begin CHARACTERISTIC DFES_FaultTyp.DFC_ComTrqDemandDscTo_C "DFES/Fehlertyp Zuordnung für Prüfung DFC_ComTrqDemandDscTo" VALUE 0x8002A528 Val_Wu8 255.0 DFES_OneToOne 0.00 255.0 /end CHARACTERISTIC
/begin CHARACTERISTIC DFES_FaultTyp.DFC_ComTrqDemandGbxChk_A_C "DFES/Fehlertyp Zuordnung für Prüfung DFC_ComTrqDemandGbxChk_A" VALUE 0x8002A529 Val_Wu8 255.0 DFES_OneToOne 0.00 255.0 /end CHARACTERISTIC
/begin CHARACTERISTIC DFES_FaultTyp.DFC_ComTrqDemandGbxChk_FA_C "DFES/Fehlertyp Zuordnung für Prüfung DFC_ComTrqDemandGbxChk_FA" VALUE 0x8002A52A Val_Wu8 255.0 DFES_OneToOne 0.00 255.0 /end CHARACTERISTIC
/begin CHARACTERISTIC DFES_FaultTyp.DFC_ComTrqDemandGbxCtr_A_C "DFES/Fehlertyp Zuordnung für Prüfung DFC_ComTrqDemandGbxCtr_A" VALUE 0x8002A52B Val_Wu8 255.0 DFES_OneToOne 0.00 255.0 /end CHARACTERISTIC
/begin CHARACTERISTIC DFES_FaultTyp.DFC_ComTrqDemandGbxCtr_FA_C "DFES/Fehlertyp Zuordnung für Prüfung DFC_ComTrqDemandGbxCtr_FA" VALUE 0x8002A52C Val_Wu8 255.0 DFES_OneToOne 0.00 255.0 /end CHARACTERISTIC
/begin CHARACTERISTIC DFES_FaultTyp.DFC_ComTrqDemandGbxSig_A_C "DFES/Fehlertyp Zuordnung für Prüfung DFC_ComTrqDemandGbxSig_A" VALUE 0x8002A52D Val_Wu8 255.0 DFES_OneToOne 0.00 255.0 /end CHARACTERISTIC
/begin CHARACTERISTIC DFES_FaultTyp.DFC_ComTrqDemandGbxSig_FA_C "DFES/Fehlertyp Zuordnung für Prüfung DFC_ComTrqDemandGbxSig_FA" VALUE 0x8002A52E Val_Wu8 255.0 DFES_OneToOne 0.00 255.0 /end CHARACTERISTIC
/begin CHARACTERISTIC DFES_FaultTyp.DFC_ComTrqDemandGbxTo_A_C "DFES/Fehlertyp Zuordnung für Prüfung DFC_ComTrqDemandGbxTo_A" VALUE 0x8002A52F Val_Wu8 255.0 DFES_OneToOne 0.00 255.0 /end CHARACTERISTIC
/begin CHARACTERISTIC DFES_FaultTyp.DFC_ComTrqDemandGbxTo_FA_C "DFES/Fehlertyp Zuordnung für Prüfung DFC_ComTrqDemandGbxTo_FA" VALUE 0x8002A530 Val_Wu8 255.0 DFES_OneToOne 0.00 255.0 /end CHARACTERISTIC
/begin CHARACTERISTIC DFES_FaultTyp.DFC_ComTrqWhlDemChk_C "DFES/Fehlertyp Zuordnung für Prüfung DFC_ComTrqWhlDemChk" VALUE 0x8002A531 Val_Wu8 255.0 DFES_OneToOne 0.00 255.0 /end CHARACTERISTIC
/begin CHARACTERISTIC DFES_FaultTyp.DFC_ComTrqWhlDemCtr_C "DFES/Fehlertyp Zuordnung für Prüfung DFC_ComTrqWhlDemCtr" VALUE 0x8002A532 Val_Wu8 255.0 DFES_OneToOne 0.00 255.0 /end CHARACTERISTIC
/begin CHARACTERISTIC DFES_FaultTyp.DFC_ComTrqWhlDemFASChk_FX_C "DFES/Fehlertyp Zuordnung für Prüfung DFC_ComTrqWhlDemFASChk_FX" VALUE 0x8002A533 Val_Wu8 255.0 DFES_OneToOne 0.00 255.0 /end CHARACTERISTIC
/begin CHARACTERISTIC DFES_FaultTyp.DFC_ComTrqWhlDemFASCtr_FX_C "DFES/Fehlertyp Zuordnung für Prüfung DFC_ComTrqWhlDemFASCtr_FX" VALUE 0x8002A534 Val_Wu8 255.0 DFES_OneToOne 0.00 255.0 /end CHARACTERISTIC
/begin CHARACTERISTIC DFES_FaultTyp.DFC_ComTrqWhlDemFASTo_FX_C "DFES/Fehlertyp Zuordnung für Prüfung DFC_ComTrqWhlDemFASTo_FX" VALUE 0x8002A535 Val_Wu8 255.0 DFES_OneToOne 0.00 255.0 /end CHARACTERISTIC
/begin CHARACTERISTIC DFES_FaultTyp.DFC_ComTrqWhlDemSig_C "DFES/Fehlertyp Zuordnung für Prüfung DFC_ComTrqWhlDemSig" VALUE 0x8002A536 Val_Wu8 255.0 DFES_OneToOne 0.00 255.0 /end CHARACTERISTIC
/begin CHARACTERISTIC DFES_FaultTyp.DFC_ComTrqWhlDemTo_C "DFES/Fehlertyp Zuordnung für Prüfung DFC_ComTrqWhlDemTo" VALUE 0x8002A537 Val_Wu8 255.0 DFES_OneToOne 0.00 255.0 /end CHARACTERISTIC
/begin CHARACTERISTIC DFES_FaultTyp.DFC_ComVelocityChk_FA_C "DFES/Fehlertyp Zuordnung für Prüfung DFC_ComVelocityChk_FA" VALUE 0x8002A538 Val_Wu8 255.0 DFES_OneToOne 0.00 255.0 /end CHARACTERISTIC
/begin CHARACTERISTIC DFES_FaultTyp.DFC_ComVelocityCtr_FA_C "DFES/Fehlertyp Zuordnung für Prüfung DFC_ComVelocityCtr_FA" VALUE 0x8002A539 Val_Wu8 255.0 DFES_OneToOne 0.00 255.0 /end CHARACTERISTIC
/begin CHARACTERISTIC DFES_FaultTyp.DFC_ComVelocitySig_C "DFES/Fehlertyp Zuordnung für Prüfung DFC_ComVelocitySig" VALUE 0x8002A53A Val_Wu8 255.0 DFES_OneToOne 0.00 255.0 /end CHARACTERISTIC
/begin CHARACTERISTIC DFES_FaultTyp.DFC_ComVelocitySig_FA_C "DFES/Fehlertyp Zuordnung für Prüfung DFC_ComVelocitySig_FA" VALUE 0x8002A53B Val_Wu8 255.0 DFES_OneToOne 0.00 255.0 /end CHARACTERISTIC
/begin CHARACTERISTIC DFES_FaultTyp.DFC_ComVelocityTo_C "DFES/Fehlertyp Zuordnung für Prüfung DFC_ComVelocityTo" VALUE 0x8002A53C Val_Wu8 255.0 DFES_OneToOne 0.00 255.0 /end CHARACTERISTIC
/begin CHARACTERISTIC DFES_FaultTyp.DFC_ComVelocityTo_FA_C "DFES/Fehlertyp Zuordnung für Prüfung DFC_ComVelocityTo_FA" VALUE 0x8002A53D Val_Wu8 255.0 DFES_OneToOne 0.00 255.0 /end CHARACTERISTIC
/begin CHARACTERISTIC DFES_FaultTyp.DFC_ComVerbraucherTo_C "DFES/Fehlertyp Zuordnung für Prüfung DFC_ComVerbraucherTo" VALUE 0x8002A53E Val_Wu8 255.0 DFES_OneToOne 0.00 255.0 /end CHARACTERISTIC
/begin CHARACTERISTIC DFES_FaultTyp.DFC_ComWMomPTStabChk_FX_C "DFES/Fehlertyp Zuordnung für Prüfung DFC_ComWMomPTStabChk_FX" VALUE 0x8002A53F Val_Wu8 255.0 DFES_OneToOne 0.00 255.0 /end CHARACTERISTIC
/begin CHARACTERISTIC DFES_FaultTyp.DFC_ComWMomPTStabCtr_FX_C "DFES/Fehlertyp Zuordnung für Prüfung DFC_ComWMomPTStabCtr_FX" VALUE 0x8002A540 Val_Wu8 255.0 DFES_OneToOne 0.00 255.0 /end CHARACTERISTIC
/begin CHARACTERISTIC DFES_FaultTyp.DFC_ComWMomPTStabTo_FX_C "DFES/Fehlertyp Zuordnung für Prüfung DFC_ComWMomPTStabTo_FX" VALUE 0x8002A541 Val_Wu8 255.0 DFES_OneToOne 0.00 255.0 /end CHARACTERISTIC
/begin CHARACTERISTIC DFES_FaultTyp.DFC_ComWheelSpeedSig_C "DFES/Fehlertyp Zuordnung für Prüfung DFC_ComWheelSpeedSig" VALUE 0x8002A542 Val_Wu8 255.0 DFES_OneToOne 0.00 255.0 /end CHARACTERISTIC
/begin CHARACTERISTIC DFES_FaultTyp.DFC_ComWheelSpeedTo_C "DFES/Fehlertyp Zuordnung für Prüfung DFC_ComWheelSpeedTo" VALUE 0x8002A543 Val_Wu8 255.0 DFES_OneToOne 0.00 255.0 /end CHARACTERISTIC
/begin CHARACTERISTIC DFES_FaultTyp.DFC_ComZvKlappenSig_C "DFES/Fehlertyp Zuordnung für Prüfung DFC_ComZvKlappenSig" VALUE 0x8002A544 Val_Wu8 255.0 DFES_OneToOne 0.00 255.0 /end CHARACTERISTIC
/begin CHARACTERISTIC DFES_FaultTyp.DFC_ComZvKlappenTo_C "DFES/Fehlertyp Zuordnung für Prüfung DFC_ComZvKlappenTo" VALUE 0x8002A545 Val_Wu8 255.0 DFES_OneToOne 0.00 255.0 /end CHARACTERISTIC
/begin CHARACTERISTIC DFES_FaultTyp.DFC_ComaDirectChk_FX_C "DFES/Fehlertyp Zuordnung für Prüfung DFC_ComaDirectChk_FX" VALUE 0x8002A546 Val_Wu8 255.0 DFES_OneToOne 0.00 255.0 /end CHARACTERISTIC
/begin CHARACTERISTIC DFES_FaultTyp.DFC_ComaDirectCtr_FX_C "DFES/Fehlertyp Zuordnung für Prüfung DFC_ComaDirectCtr_FX" VALUE 0x8002A547 Val_Wu8 255.0 DFES_OneToOne 0.00 255.0 /end CHARACTERISTIC
/begin CHARACTERISTIC DFES_FaultTyp.DFC_ComaDirectTo_FX_C "DFES/Fehlertyp Zuordnung für Prüfung DFC_ComaDirectTo_FX" VALUE 0x8002A548 Val_Wu8 255.0 DFES_OneToOne 0.00 255.0 /end CHARACTERISTIC
/begin CHARACTERISTIC DFES_FaultTyp.DFC_ComaSideChk_FX_C "DFES/Fehlertyp Zuordnung für Prüfung DFC_ComaSideChk_FX" VALUE 0x8002A549 Val_Wu8 255.0 DFES_OneToOne 0.00 255.0 /end CHARACTERISTIC
/begin CHARACTERISTIC DFES_FaultTyp.DFC_ComaSideCtr_FX_C "DFES/Fehlertyp Zuordnung für Prüfung DFC_ComaSideCtr_FX" VALUE 0x8002A54A Val_Wu8 255.0 DFES_OneToOne 0.00 255.0 /end CHARACTERISTIC
/begin CHARACTERISTIC DFES_FaultTyp.DFC_ComaSideTo_FX_C "DFES/Fehlertyp Zuordnung für Prüfung DFC_ComaSideTo_FX" VALUE 0x8002A54B Val_Wu8 255.0 DFES_OneToOne 0.00 255.0 /end CHARACTERISTIC
/begin CHARACTERISTIC DFES_FaultTyp.DFC_Cy320SpiCom_C "DFES/Fehlertyp Zuordnung für Prüfung DFC_Cy320SpiCom" VALUE 0x8002A54C Val_Wu8 255.0 DFES_OneToOne 0.00 255.0 /end CHARACTERISTIC
/begin CHARACTERISTIC DFES_FaultTyp.DFC_ETCtlDvtInrMax_C "DFES/Fehlertyp Zuordnung für Prüfung DFC_ETCtlDvtInrMax" VALUE 0x8002A54D Val_Wu8 255.0 DFES_OneToOne 0.00 255.0 /end CHARACTERISTIC
/begin CHARACTERISTIC DFES_FaultTyp.DFC_ETCtlDvtInrMin_C "DFES/Fehlertyp Zuordnung für Prüfung DFC_ETCtlDvtInrMin" VALUE 0x8002A54E Val_Wu8 255.0 DFES_OneToOne 0.00 255.0 /end CHARACTERISTIC
/begin CHARACTERISTIC DFES_FaultTyp.DFC_ETCtlDvtOutrMax_C "DFES/Fehlertyp Zuordnung für Prüfung DFC_ETCtlDvtOutrMax" VALUE 0x8002A54F Val_Wu8 255.0 DFES_OneToOne 0.00 255.0 /end CHARACTERISTIC
/begin CHARACTERISTIC DFES_FaultTyp.DFC_ETCtlDvtOutrMin_C "DFES/Fehlertyp Zuordnung für Prüfung DFC_ETCtlDvtOutrMin" VALUE 0x8002A550 Val_Wu8 255.0 DFES_OneToOne 0.00 255.0 /end CHARACTERISTIC
/begin CHARACTERISTIC DFES_FaultTyp.DFC_FBCqDvtMax_C "DFES/Fehlertyp Zuordnung für Prüfung DFC_FBCqDvtMax" VALUE 0x8002A551 Val_Wu8 255.0 DFES_OneToOne 0.00 255.0 /end CHARACTERISTIC
/begin CHARACTERISTIC DFES_FaultTyp.DFC_FBCqDvtMin_C "DFES/Fehlertyp Zuordnung für Prüfung DFC_FBCqDvtMin" VALUE 0x8002A552 Val_Wu8 255.0 DFES_OneToOne 0.00 255.0 /end CHARACTERISTIC
/begin CHARACTERISTIC DFES_FaultTyp.DFC_Fan4WinErr1_C "DFES/Fehlertyp Zuordnung für Prüfung DFC_Fan4WinErr1" VALUE 0x8002A553 Val_Wu8 255.0 DFES_OneToOne 0.00 255.0 /end CHARACTERISTIC
/begin CHARACTERISTIC DFES_FaultTyp.DFC_Fan4WinErr2_C "DFES/Fehlertyp Zuordnung für Prüfung DFC_Fan4WinErr2" VALUE 0x8002A554 Val_Wu8 255.0 DFES_OneToOne 0.00 255.0 /end CHARACTERISTIC
/begin CHARACTERISTIC DFES_FaultTyp.DFC_Fan4WinErr3_C "DFES/Fehlertyp Zuordnung für Prüfung DFC_Fan4WinErr3" VALUE 0x8002A555 Val_Wu8 255.0 DFES_OneToOne 0.00 255.0 /end CHARACTERISTIC
/begin CHARACTERISTIC DFES_FaultTyp.DFC_Fan4WinErr4_C "DFES/Fehlertyp Zuordnung für Prüfung DFC_Fan4WinErr4" VALUE 0x8002A556 Val_Wu8 255.0 DFES_OneToOne 0.00 255.0 /end CHARACTERISTIC
/begin CHARACTERISTIC DFES_FaultTyp.DFC_FanSCG_C "DFES/Fehlertyp Zuordnung für Prüfung DFC_FanSCG" VALUE 0x8002A557 Val_Wu8 255.0 DFES_OneToOne 0.00 255.0 /end CHARACTERISTIC
/begin CHARACTERISTIC DFES_FaultTyp.DFC_FlFCBS_C "DFES/Fehlertyp Zuordnung für Prüfung DFC_FlFCBS" VALUE 0x8002A558 Val_Wu8 255.0 DFES_OneToOne 0.00 255.0 /end CHARACTERISTIC
/begin CHARACTERISTIC DFES_FaultTyp.DFC_GlwEcuConfigErr_C "DFES/Fehlertyp Zuordnung für Prüfung DFC_GlwEcuConfigErr" VALUE 0x8002A559 Val_Wu8 255.0 DFES_OneToOne 0.00 255.0 /end CHARACTERISTIC
/begin CHARACTERISTIC DFES_FaultTyp.DFC_GlwEcuEepErr_C "DFES/Fehlertyp Zuordnung für Prüfung DFC_GlwEcuEepErr" VALUE 0x8002A55A Val_Wu8 255.0 DFES_OneToOne 0.00 255.0 /end CHARACTERISTIC
/begin CHARACTERISTIC DFES_FaultTyp.DFC_GlwEcuFrmErr_C "DFES/Fehlertyp Zuordnung für Prüfung DFC_GlwEcuFrmErr" VALUE 0x8002A55B Val_Wu8 255.0 DFES_OneToOne 0.00 255.0 /end CHARACTERISTIC
/begin CHARACTERISTIC DFES_FaultTyp.DFC_GlwEcuGPCMFaultInfo_C "DFES/Fehlertyp Zuordnung für Prüfung DFC_GlwEcuGPCMFaultInfo" VALUE 0x8002A55C Val_Wu8 255.0 DFES_OneToOne 0.00 255.0 /end CHARACTERISTIC
/begin CHARACTERISTIC DFES_FaultTyp.DFC_GlwEcuGPCMInfo_C "DFES/Fehlertyp Zuordnung für Prüfung DFC_GlwEcuGPCMInfo" VALUE 0x8002A55D Val_Wu8 255.0 DFES_OneToOne 0.00 255.0 /end CHARACTERISTIC
/begin CHARACTERISTIC DFES_FaultTyp.DFC_GlwEcuGk1HSS_C "DFES/Fehlertyp Zuordnung für Prüfung DFC_GlwEcuGk1HSS" VALUE 0x8002A55E Val_Wu8 255.0 DFES_OneToOne 0.00 255.0 /end CHARACTERISTIC
/begin CHARACTERISTIC DFES_FaultTyp.DFC_GlwEcuGk1OL_C "DFES/Fehlertyp Zuordnung für Prüfung DFC_GlwEcuGk1OL" VALUE 0x8002A55F Val_Wu8 255.0 DFES_OneToOne 0.00 255.0 /end CHARACTERISTIC
/begin CHARACTERISTIC DFES_FaultTyp.DFC_GlwEcuGk1SC_C "DFES/Fehlertyp Zuordnung für Prüfung DFC_GlwEcuGk1SC" VALUE 0x8002A560 Val_Wu8 255.0 DFES_OneToOne 0.00 255.0 /end CHARACTERISTIC
/begin CHARACTERISTIC DFES_FaultTyp.DFC_GlwEcuGk1Wdst_C "DFES/Fehlertyp Zuordnung für Prüfung DFC_GlwEcuGk1Wdst" VALUE 0x8002A561 Val_Wu8 255.0 DFES_OneToOne 0.00 255.0 /end CHARACTERISTIC
/begin CHARACTERISTIC DFES_FaultTyp.DFC_GlwEcuGk2HSS_C "DFES/Fehlertyp Zuordnung für Prüfung DFC_GlwEcuGk2HSS" VALUE 0x8002A562 Val_Wu8 255.0 DFES_OneToOne 0.00 255.0 /end CHARACTERISTIC
/begin CHARACTERISTIC DFES_FaultTyp.DFC_GlwEcuGk2OL_C "DFES/Fehlertyp Zuordnung für Prüfung DFC_GlwEcuGk2OL" VALUE 0x8002A563 Val_Wu8 255.0 DFES_OneToOne 0.00 255.0 /end CHARACTERISTIC
/begin CHARACTERISTIC DFES_FaultTyp.DFC_GlwEcuGk2SC_C "DFES/Fehlertyp Zuordnung für Prüfung DFC_GlwEcuGk2SC" VALUE 0x8002A564 Val_Wu8 255.0 DFES_OneToOne 0.00 255.0 /end CHARACTERISTIC
/begin CHARACTERISTIC DFES_FaultTyp.DFC_GlwEcuGk2Wdst_C "DFES/Fehlertyp Zuordnung für Prüfung DFC_GlwEcuGk2Wdst" VALUE 0x8002A565 Val_Wu8 255.0 DFES_OneToOne 0.00 255.0 /end CHARACTERISTIC
/begin CHARACTERISTIC DFES_FaultTyp.DFC_GlwEcuGk3HSS_C "DFES/Fehlertyp Zuordnung für Prüfung DFC_GlwEcuGk3HSS" VALUE 0x8002A566 Val_Wu8 255.0 DFES_OneToOne 0.00 255.0 /end CHARACTERISTIC
/begin CHARACTERISTIC DFES_FaultTyp.DFC_GlwEcuGk3OL_C "DFES/Fehlertyp Zuordnung für Prüfung DFC_GlwEcuGk3OL" VALUE 0x8002A567 Val_Wu8 255.0 DFES_OneToOne 0.00 255.0 /end CHARACTERISTIC
/begin CHARACTERISTIC DFES_FaultTyp.DFC_GlwEcuGk3SC_C "DFES/Fehlertyp Zuordnung für Prüfung DFC_GlwEcuGk3SC" VALUE 0x8002A568 Val_Wu8 255.0 DFES_OneToOne 0.00 255.0 /end CHARACTERISTIC
/begin CHARACTERISTIC DFES_FaultTyp.DFC_GlwEcuGk3Wdst_C "DFES/Fehlertyp Zuordnung für Prüfung DFC_GlwEcuGk3Wdst" VALUE 0x8002A569 Val_Wu8 255.0 DFES_OneToOne 0.00 255.0 /end CHARACTERISTIC
/begin CHARACTERISTIC DFES_FaultTyp.DFC_GlwEcuGk4HSS_C "DFES/Fehlertyp Zuordnung für Prüfung DFC_GlwEcuGk4HSS" VALUE 0x8002A56A Val_Wu8 255.0 DFES_OneToOne 0.00 255.0 /end CHARACTERISTIC
/begin CHARACTERISTIC DFES_FaultTyp.DFC_GlwEcuGk4OL_C "DFES/Fehlertyp Zuordnung für Prüfung DFC_GlwEcuGk4OL" VALUE 0x8002A56B Val_Wu8 255.0 DFES_OneToOne 0.00 255.0 /end CHARACTERISTIC
/begin CHARACTERISTIC DFES_FaultTyp.DFC_GlwEcuGk4SC_C "DFES/Fehlertyp Zuordnung für Prüfung DFC_GlwEcuGk4SC" VALUE 0x8002A56C Val_Wu8 255.0 DFES_OneToOne 0.00 255.0 /end CHARACTERISTIC
/begin CHARACTERISTIC DFES_FaultTyp.DFC_GlwEcuGk4Wdst_C "DFES/Fehlertyp Zuordnung für Prüfung DFC_GlwEcuGk4Wdst" VALUE 0x8002A56D Val_Wu8 255.0 DFES_OneToOne 0.00 255.0 /end CHARACTERISTIC
/begin CHARACTERISTIC DFES_FaultTyp.DFC_GlwEcuGk5HSS_C "DFES/Fehlertyp Zuordnung für Prüfung DFC_GlwEcuGk5HSS" VALUE 0x8002A56E Val_Wu8 255.0 DFES_OneToOne 0.00 255.0 /end CHARACTERISTIC
/begin CHARACTERISTIC DFES_FaultTyp.DFC_GlwEcuGk5OL_C "DFES/Fehlertyp Zuordnung für Prüfung DFC_GlwEcuGk5OL" VALUE 0x8002A56F Val_Wu8 255.0 DFES_OneToOne 0.00 255.0 /end CHARACTERISTIC
/begin CHARACTERISTIC DFES_FaultTyp.DFC_GlwEcuGk5SC_C "DFES/Fehlertyp Zuordnung für Prüfung DFC_GlwEcuGk5SC" VALUE 0x8002A570 Val_Wu8 255.0 DFES_OneToOne 0.00 255.0 /end CHARACTERISTIC
/begin CHARACTERISTIC DFES_FaultTyp.DFC_GlwEcuGk5Wdst_C "DFES/Fehlertyp Zuordnung für Prüfung DFC_GlwEcuGk5Wdst" VALUE 0x8002A571 Val_Wu8 255.0 DFES_OneToOne 0.00 255.0 /end CHARACTERISTIC
/begin CHARACTERISTIC DFES_FaultTyp.DFC_GlwEcuGk6HSS_C "DFES/Fehlertyp Zuordnung für Prüfung DFC_GlwEcuGk6HSS" VALUE 0x8002A572 Val_Wu8 255.0 DFES_OneToOne 0.00 255.0 /end CHARACTERISTIC
/begin CHARACTERISTIC DFES_FaultTyp.DFC_GlwEcuGk6OL_C "DFES/Fehlertyp Zuordnung für Prüfung DFC_GlwEcuGk6OL" VALUE 0x8002A573 Val_Wu8 255.0 DFES_OneToOne 0.00 255.0 /end CHARACTERISTIC
/begin CHARACTERISTIC DFES_FaultTyp.DFC_GlwEcuGk6SC_C "DFES/Fehlertyp Zuordnung für Prüfung DFC_GlwEcuGk6SC" VALUE 0x8002A574 Val_Wu8 255.0 DFES_OneToOne 0.00 255.0 /end CHARACTERISTIC
/begin CHARACTERISTIC DFES_FaultTyp.DFC_GlwEcuGk6Wdst_C "DFES/Fehlertyp Zuordnung für Prüfung DFC_GlwEcuGk6Wdst" VALUE 0x8002A575 Val_Wu8 255.0 DFES_OneToOne 0.00 255.0 /end CHARACTERISTIC
/begin CHARACTERISTIC DFES_FaultTyp.DFC_GlwEcuGndErr_C "DFES/Fehlertyp Zuordnung für Prüfung DFC_GlwEcuGndErr" VALUE 0x8002A576 Val_Wu8 255.0 DFES_OneToOne 0.00 255.0 /end CHARACTERISTIC
/begin CHARACTERISTIC DFES_FaultTyp.DFC_GlwEcuIntErr_C "DFES/Fehlertyp Zuordnung für Prüfung DFC_GlwEcuIntErr" VALUE 0x8002A577 Val_Wu8 255.0 DFES_OneToOne 0.00 255.0 /end CHARACTERISTIC
/begin CHARACTERISTIC DFES_FaultTyp.DFC_GlwEcuMsgTimeout_C "DFES/Fehlertyp Zuordnung für Prüfung DFC_GlwEcuMsgTimeout" VALUE 0x8002A578 Val_Wu8 255.0 DFES_OneToOne 0.00 255.0 /end CHARACTERISTIC
/begin CHARACTERISTIC DFES_FaultTyp.DFC_GlwEcuT30Err_C "DFES/Fehlertyp Zuordnung für Prüfung DFC_GlwEcuT30Err" VALUE 0x8002A579 Val_Wu8 255.0 DFES_OneToOne 0.00 255.0 /end CHARACTERISTIC
/begin CHARACTERISTIC DFES_FaultTyp.DFC_GlwEcuTempErr_C "DFES/Fehlertyp Zuordnung für Prüfung DFC_GlwEcuTempErr" VALUE 0x8002A57A Val_Wu8 255.0 DFES_OneToOne 0.00 255.0 /end CHARACTERISTIC
/begin CHARACTERISTIC DFES_FaultTyp.DFC_GlwEcuUdiffT30_C "DFES/Fehlertyp Zuordnung für Prüfung DFC_GlwEcuUdiffT30" VALUE 0x8002A57B Val_Wu8 255.0 DFES_OneToOne 0.00 255.0 /end CHARACTERISTIC
/begin CHARACTERISTIC DFES_FaultTyp.DFC_IBSComErr_C "DFES/Fehlertyp Zuordnung für Prüfung DFC_IBSComErr" VALUE 0x8002A57C Val_Wu8 255.0 DFES_OneToOne 0.00 255.0 /end CHARACTERISTIC
/begin CHARACTERISTIC DFES_FaultTyp.DFC_LubSRCOilFldtCrit_C "DFES/Fehlertyp Zuordnung für Prüfung DFC_LubSRCOilFldtCrit" VALUE 0x8002A57D Val_Wu8 255.0 DFES_OneToOne 0.00 255.0 /end CHARACTERISTIC
/begin CHARACTERISTIC DFES_FaultTyp.DFC_LubSRCOilFldtCritDflMin_C "DFES/Fehlertyp Zuordnung für Prüfung DFC_LubSRCOilFldtCritDflMin" VALUE 0x8002A57E Val_Wu8 255.0 DFES_OneToOne 0.00 255.0 /end CHARACTERISTIC
/begin CHARACTERISTIC DFES_FaultTyp.DFC_LubSRCOilLvlCritMax_C "DFES/Fehlertyp Zuordnung für Prüfung DFC_LubSRCOilLvlCritMax" VALUE 0x8002A57F Val_Wu8 255.0 DFES_OneToOne 0.00 255.0 /end CHARACTERISTIC
/begin CHARACTERISTIC DFES_FaultTyp.DFC_LubSRCOilLvlCritMin_C "DFES/Fehlertyp Zuordnung für Prüfung DFC_LubSRCOilLvlCritMin" VALUE 0x8002A580 Val_Wu8 255.0 DFES_OneToOne 0.00 255.0 /end CHARACTERISTIC
/begin CHARACTERISTIC DFES_FaultTyp.DFC_LubSRCTot_C "DFES/Fehlertyp Zuordnung für Prüfung DFC_LubSRCTot" VALUE 0x8002A581 Val_Wu8 255.0 DFES_OneToOne 0.00 255.0 /end CHARACTERISTIC
/begin CHARACTERISTIC DFES_FaultTyp.DFC_MonUMaxSupply1_C "DFES/Fehlertyp Zuordnung für Prüfung DFC_MonUMaxSupply1" VALUE 0x8002A582 Val_Wu8 255.0 DFES_OneToOne 0.00 255.0 /end CHARACTERISTIC
/begin CHARACTERISTIC DFES_FaultTyp.DFC_MonUMinSupply1_C "DFES/Fehlertyp Zuordnung für Prüfung DFC_MonUMinSupply1" VALUE 0x8002A583 Val_Wu8 255.0 DFES_OneToOne 0.00 255.0 /end CHARACTERISTIC
/begin CHARACTERISTIC DFES_FaultTyp.DFC_OilComNpl_C "DFES/Fehlertyp Zuordnung für Prüfung DFC_OilComNpl" VALUE 0x8002A584 Val_Wu8 255.0 DFES_OneToOne 0.00 255.0 /end CHARACTERISTIC
/begin CHARACTERISTIC DFES_FaultTyp.DFC_PCBS_C "DFES/Fehlertyp Zuordnung für Prüfung DFC_PCBS" VALUE 0x8002A585 Val_Wu8 255.0 DFES_OneToOne 0.00 255.0 /end CHARACTERISTIC
/begin CHARACTERISTIC DFES_FaultTyp.DFC_PCBSPFltChg_C "DFES/Fehlertyp Zuordnung für Prüfung DFC_PCBSPFltChg" VALUE 0x8002A586 Val_Wu8 255.0 DFES_OneToOne 0.00 255.0 /end CHARACTERISTIC
/begin CHARACTERISTIC DFES_FaultTyp.DFC_PCRGovDvtLPMax_C "DFES/Fehlertyp Zuordnung für Prüfung DFC_PCRGovDvtLPMax" VALUE 0x8002A587 Val_Wu8 255.0 DFES_OneToOne 0.00 255.0 /end CHARACTERISTIC
/begin CHARACTERISTIC DFES_FaultTyp.DFC_PCRGovDvtLPMin_C "DFES/Fehlertyp Zuordnung für Prüfung DFC_PCRGovDvtLPMin" VALUE 0x8002A588 Val_Wu8 255.0 DFES_OneToOne 0.00 255.0 /end CHARACTERISTIC
/begin CHARACTERISTIC DFES_FaultTyp.DFC_PCRGovDvtMax_C "DFES/Fehlertyp Zuordnung für Prüfung DFC_PCRGovDvtMax" VALUE 0x8002A589 Val_Wu8 255.0 DFES_OneToOne 0.00 255.0 /end CHARACTERISTIC
/begin CHARACTERISTIC DFES_FaultTyp.DFC_PCRGovDvtMin_C "DFES/Fehlertyp Zuordnung für Prüfung DFC_PCRGovDvtMin" VALUE 0x8002A58A Val_Wu8 255.0 DFES_OneToOne 0.00 255.0 /end CHARACTERISTIC
/begin CHARACTERISTIC DFES_FaultTyp.DFC_PFltAPSPlausMAX_C "DFES/Fehlertyp Zuordnung für Prüfung DFC_PFltAPSPlausMAX" VALUE 0x8002A58B Val_Wu8 255.0 DFES_OneToOne 0.00 255.0 /end CHARACTERISTIC
/begin CHARACTERISTIC DFES_FaultTyp.DFC_PFltAPSPlausMIN_C "DFES/Fehlertyp Zuordnung für Prüfung DFC_PFltAPSPlausMIN" VALUE 0x8002A58C Val_Wu8 255.0 DFES_OneToOne 0.00 255.0 /end CHARACTERISTIC
/begin CHARACTERISTIC DFES_FaultTyp.DFC_PFltBPSPlausMAX_C "DFES/Fehlertyp Zuordnung für Prüfung DFC_PFltBPSPlausMAX" VALUE 0x8002A58D Val_Wu8 255.0 DFES_OneToOne 0.00 255.0 /end CHARACTERISTIC
/begin CHARACTERISTIC DFES_FaultTyp.DFC_PFltBPSPlausMIN_C "DFES/Fehlertyp Zuordnung für Prüfung DFC_PFltBPSPlausMIN" VALUE 0x8002A58E Val_Wu8 255.0 DFES_OneToOne 0.00 255.0 /end CHARACTERISTIC
/begin CHARACTERISTIC DFES_FaultTyp.DFC_PFltOvldInhRgn_C "DFES/Fehlertyp Zuordnung für Prüfung DFC_PFltOvldInhRgn" VALUE 0x8002A58F Val_Wu8 255.0 DFES_OneToOne 0.00 255.0 /end CHARACTERISTIC
/begin CHARACTERISTIC DFES_FaultTyp.DFC_PFltOvldTrqLim_C "DFES/Fehlertyp Zuordnung für Prüfung DFC_PFltOvldTrqLim" VALUE 0x8002A590 Val_Wu8 255.0 DFES_OneToOne 0.00 255.0 /end CHARACTERISTIC
/begin CHARACTERISTIC DFES_FaultTyp.DFC_PFltPresPlausMAX_C "DFES/Fehlertyp Zuordnung für Prüfung DFC_PFltPresPlausMAX" VALUE 0x8002A591 Val_Wu8 255.0 DFES_OneToOne 0.00 255.0 /end CHARACTERISTIC
/begin CHARACTERISTIC DFES_FaultTyp.DFC_PFltPresPlausMIN_C "DFES/Fehlertyp Zuordnung für Prüfung DFC_PFltPresPlausMIN" VALUE 0x8002A592 Val_Wu8 255.0 DFES_OneToOne 0.00 255.0 /end CHARACTERISTIC
/begin CHARACTERISTIC DFES_FaultTyp.DFC_PFltTraRpmRdc_C "DFES/Fehlertyp Zuordnung für Prüfung DFC_PFltTraRpmRdc" VALUE 0x8002A593 Val_Wu8 255.0 DFES_OneToOne 0.00 255.0 /end CHARACTERISTIC
/begin CHARACTERISTIC DFES_FaultTyp.DFC_PFlt_tOxiPreMax_C "DFES/Fehlertyp Zuordnung für Prüfung DFC_PFlt_tOxiPreMax" VALUE 0x8002A594 Val_Wu8 255.0 DFES_OneToOne 0.00 255.0 /end CHARACTERISTIC
/begin CHARACTERISTIC DFES_FaultTyp.DFC_PFlt_tOxiPreMaxRgn_C "DFES/Fehlertyp Zuordnung für Prüfung DFC_PFlt_tOxiPreMaxRgn" VALUE 0x8002A595 Val_Wu8 255.0 DFES_OneToOne 0.00 255.0 /end CHARACTERISTIC
/begin CHARACTERISTIC DFES_FaultTyp.DFC_PFlt_tOxiPreNpl_C "DFES/Fehlertyp Zuordnung für Prüfung DFC_PFlt_tOxiPreNpl" VALUE 0x8002A596 Val_Wu8 255.0 DFES_OneToOne 0.00 255.0 /end CHARACTERISTIC
/begin CHARACTERISTIC DFES_FaultTyp.DFC_PFlt_tPreMax_C "DFES/Fehlertyp Zuordnung für Prüfung DFC_PFlt_tPreMax" VALUE 0x8002A597 Val_Wu8 255.0 DFES_OneToOne 0.00 255.0 /end CHARACTERISTIC
/begin CHARACTERISTIC DFES_FaultTyp.DFC_PFlt_tPreMaxRgn_C "DFES/Fehlertyp Zuordnung für Prüfung DFC_PFlt_tPreMaxRgn" VALUE 0x8002A598 Val_Wu8 255.0 DFES_OneToOne 0.00 255.0 /end CHARACTERISTIC
/begin CHARACTERISTIC DFES_FaultTyp.DFC_PFlt_tPreNpl_C "DFES/Fehlertyp Zuordnung für Prüfung DFC_PFlt_tPreNpl" VALUE 0x8002A599 Val_Wu8 255.0 DFES_OneToOne 0.00 255.0 /end CHARACTERISTIC
/begin CHARACTERISTIC DFES_FaultTyp.DFC_PFltmSotDiffMAX_C "DFES/Fehlertyp Zuordnung für Prüfung DFC_PFltmSotDiffMAX" VALUE 0x8002A59A Val_Wu8 255.0 DFES_OneToOne 0.00 255.0 /end CHARACTERISTIC
/begin CHARACTERISTIC DFES_FaultTyp.DFC_PFltmSotDiffMIN_C "DFES/Fehlertyp Zuordnung für Prüfung DFC_PFltmSotDiffMIN" VALUE 0x8002A59B Val_Wu8 255.0 DFES_OneToOne 0.00 255.0 /end CHARACTERISTIC
/begin CHARACTERISTIC DFES_FaultTyp.DFC_PFltmSotDiffSIG_C "DFES/Fehlertyp Zuordnung für Prüfung DFC_PFltmSotDiffSIG" VALUE 0x8002A59C Val_Wu8 255.0 DFES_OneToOne 0.00 255.0 /end CHARACTERISTIC
/begin CHARACTERISTIC DFES_FaultTyp.DFC_PIntkVUsEnvPPls_C "DFES/Fehlertyp Zuordnung für Prüfung DFC_PIntkVUsEnvPPls" VALUE 0x8002A59D Val_Wu8 255.0 DFES_OneToOne 0.00 255.0 /end CHARACTERISTIC
/begin CHARACTERISTIC DFES_FaultTyp.DFC_PresPlausDblDef_C "DFES/Fehlertyp Zuordnung für Prüfung DFC_PresPlausDblDef" VALUE 0x8002A59E Val_Wu8 255.0 DFES_OneToOne 0.00 255.0 /end CHARACTERISTIC
/begin CHARACTERISTIC DFES_FaultTyp.DFC_RailCPC1_C "DFES/Fehlertyp Zuordnung für Prüfung DFC_RailCPC1" VALUE 0x8002A59F Val_Wu8 255.0 DFES_OneToOne 0.00 255.0 /end CHARACTERISTIC
/begin CHARACTERISTIC DFES_FaultTyp.DFC_RailCPC3_C "DFES/Fehlertyp Zuordnung für Prüfung DFC_RailCPC3" VALUE 0x8002A5A0 Val_Wu8 255.0 DFES_OneToOne 0.00 255.0 /end CHARACTERISTIC
/begin CHARACTERISTIC DFES_FaultTyp.DFC_RailCPC4_C "DFES/Fehlertyp Zuordnung für Prüfung DFC_RailCPC4" VALUE 0x8002A5A1 Val_Wu8 255.0 DFES_OneToOne 0.00 255.0 /end CHARACTERISTIC
/begin CHARACTERISTIC DFES_FaultTyp.DFC_RailMeUn0_C "DFES/Fehlertyp Zuordnung für Prüfung DFC_RailMeUn0" VALUE 0x8002A5A2 Val_Wu8 255.0 DFES_OneToOne 0.00 255.0 /end CHARACTERISTIC
/begin CHARACTERISTIC DFES_FaultTyp.DFC_RailMeUn1_C "DFES/Fehlertyp Zuordnung für Prüfung DFC_RailMeUn1" VALUE 0x8002A5A3 Val_Wu8 255.0 DFES_OneToOne 0.00 255.0 /end CHARACTERISTIC
/begin CHARACTERISTIC DFES_FaultTyp.DFC_RailMeUn2_C "DFES/Fehlertyp Zuordnung für Prüfung DFC_RailMeUn2" VALUE 0x8002A5A4 Val_Wu8 255.0 DFES_OneToOne 0.00 255.0 /end CHARACTERISTIC
/begin CHARACTERISTIC DFES_FaultTyp.DFC_RailMeUn22_C "DFES/Fehlertyp Zuordnung für Prüfung DFC_RailMeUn22" VALUE 0x8002A5A5 Val_Wu8 255.0 DFES_OneToOne 0.00 255.0 /end CHARACTERISTIC
/begin CHARACTERISTIC DFES_FaultTyp.DFC_RailMeUn3_C "DFES/Fehlertyp Zuordnung für Prüfung DFC_RailMeUn3" VALUE 0x8002A5A6 Val_Wu8 255.0 DFES_OneToOne 0.00 255.0 /end CHARACTERISTIC
/begin CHARACTERISTIC DFES_FaultTyp.DFC_RailMeUn4_C "DFES/Fehlertyp Zuordnung für Prüfung DFC_RailMeUn4" VALUE 0x8002A5A7 Val_Wu8 255.0 DFES_OneToOne 0.00 255.0 /end CHARACTERISTIC
/begin CHARACTERISTIC DFES_FaultTyp.DFC_RailMeUn42_C "DFES/Fehlertyp Zuordnung für Prüfung DFC_RailMeUn42" VALUE 0x8002A5A8 Val_Wu8 255.0 DFES_OneToOne 0.00 255.0 /end CHARACTERISTIC
/begin CHARACTERISTIC DFES_FaultTyp.DFC_RailMeUn5_C "DFES/Fehlertyp Zuordnung für Prüfung DFC_RailMeUn5" VALUE 0x8002A5A9 Val_Wu8 255.0 DFES_OneToOne 0.00 255.0 /end CHARACTERISTIC
/begin CHARACTERISTIC DFES_FaultTyp.DFC_RailPCV0_C "DFES/Fehlertyp Zuordnung für Prüfung DFC_RailPCV0" VALUE 0x8002A5AA Val_Wu8 255.0 DFES_OneToOne 0.00 255.0 /end CHARACTERISTIC
/begin CHARACTERISTIC DFES_FaultTyp.DFC_RailPCV1_C "DFES/Fehlertyp Zuordnung für Prüfung DFC_RailPCV1" VALUE 0x8002A5AB Val_Wu8 255.0 DFES_OneToOne 0.00 255.0 /end CHARACTERISTIC
/begin CHARACTERISTIC DFES_FaultTyp.DFC_RailPCV2_C "DFES/Fehlertyp Zuordnung für Prüfung DFC_RailPCV2" VALUE 0x8002A5AC Val_Wu8 255.0 DFES_OneToOne 0.00 255.0 /end CHARACTERISTIC
/begin CHARACTERISTIC DFES_FaultTyp.DFC_RailPCV22_C "DFES/Fehlertyp Zuordnung für Prüfung DFC_RailPCV22" VALUE 0x8002A5AD Val_Wu8 255.0 DFES_OneToOne 0.00 255.0 /end CHARACTERISTIC
/begin CHARACTERISTIC DFES_FaultTyp.DFC_RailPCV3_C "DFES/Fehlertyp Zuordnung für Prüfung DFC_RailPCV3" VALUE 0x8002A5AE Val_Wu8 255.0 DFES_OneToOne 0.00 255.0 /end CHARACTERISTIC
/begin CHARACTERISTIC DFES_FaultTyp.DFC_RailPCV4_C "DFES/Fehlertyp Zuordnung für Prüfung DFC_RailPCV4" VALUE 0x8002A5AF Val_Wu8 255.0 DFES_OneToOne 0.00 255.0 /end CHARACTERISTIC
/begin CHARACTERISTIC DFES_FaultTyp.DFC_RailPCV42_C "DFES/Fehlertyp Zuordnung für Prüfung DFC_RailPCV42" VALUE 0x8002A5B0 Val_Wu8 255.0 DFES_OneToOne 0.00 255.0 /end CHARACTERISTIC
/begin CHARACTERISTIC DFES_FaultTyp.DFC_RailPMonStrt_C "DFES/Fehlertyp Zuordnung für Prüfung DFC_RailPMonStrt" VALUE 0x8002A5B1 Val_Wu8 255.0 DFES_OneToOne 0.00 255.0 /end CHARACTERISTIC
/begin CHARACTERISTIC DFES_FaultTyp.DFC_SSpMon1_C "DFES/Fehlertyp Zuordnung für Prüfung DFC_SSpMon1" VALUE 0x8002A5B2 Val_Wu8 255.0 DFES_OneToOne 0.00 255.0 /end CHARACTERISTIC
/begin CHARACTERISTIC DFES_FaultTyp.DFC_SSpMon2_C "DFES/Fehlertyp Zuordnung für Prüfung DFC_SSpMon2" VALUE 0x8002A5B3 Val_Wu8 255.0 DFES_OneToOne 0.00 255.0 /end CHARACTERISTIC
/begin CHARACTERISTIC DFES_FaultTyp.DFC_SSpMon3_C "DFES/Fehlertyp Zuordnung für Prüfung DFC_SSpMon3" VALUE 0x8002A5B4 Val_Wu8 255.0 DFES_OneToOne 0.00 255.0 /end CHARACTERISTIC
/begin CHARACTERISTIC DFES_FaultTyp.DFC_ThrVlv4WinErr1_C "DFES/Fehlertyp Zuordnung für Prüfung DFC_ThrVlv4WinErr1" VALUE 0x8002A5B5 Val_Wu8 255.0 DFES_OneToOne 0.00 255.0 /end CHARACTERISTIC
/begin CHARACTERISTIC DFES_FaultTyp.DFC_ThrVlv4WinErr2_C "DFES/Fehlertyp Zuordnung für Prüfung DFC_ThrVlv4WinErr2" VALUE 0x8002A5B6 Val_Wu8 255.0 DFES_OneToOne 0.00 255.0 /end CHARACTERISTIC
/begin CHARACTERISTIC DFES_FaultTyp.DFC_ThrVlv4WinErr3_C "DFES/Fehlertyp Zuordnung für Prüfung DFC_ThrVlv4WinErr3" VALUE 0x8002A5B7 Val_Wu8 255.0 DFES_OneToOne 0.00 255.0 /end CHARACTERISTIC
/begin CHARACTERISTIC DFES_FaultTyp.DFC_ThrVlv4WinErr4_C "DFES/Fehlertyp Zuordnung für Prüfung DFC_ThrVlv4WinErr4" VALUE 0x8002A5B8 Val_Wu8 255.0 DFES_OneToOne 0.00 255.0 /end CHARACTERISTIC
/begin CHARACTERISTIC DFES_FaultTyp.DFC_ThrVlvSCG_C "DFES/Fehlertyp Zuordnung für Prüfung DFC_ThrVlvSCG" VALUE 0x8002A5B9 Val_Wu8 255.0 DFES_OneToOne 0.00 255.0 /end CHARACTERISTIC
/begin CHARACTERISTIC DFES_FaultTyp.DFC_Tle6232Spi1_C "DFES/Fehlertyp Zuordnung für Prüfung DFC_Tle6232Spi1" VALUE 0x8002A5BA Val_Wu8 255.0 DFES_OneToOne 0.00 255.0 /end CHARACTERISTIC
/begin CHARACTERISTIC DFES_FaultTyp.DFC_TrbCh4WinErr1_C "DFES/Fehlertyp Zuordnung für Prüfung DFC_TrbCh4WinErr1" VALUE 0x8002A5BB Val_Wu8 255.0 DFES_OneToOne 0.00 255.0 /end CHARACTERISTIC
/begin CHARACTERISTIC DFES_FaultTyp.DFC_TrbCh4WinErr2_C "DFES/Fehlertyp Zuordnung für Prüfung DFC_TrbCh4WinErr2" VALUE 0x8002A5BC Val_Wu8 255.0 DFES_OneToOne 0.00 255.0 /end CHARACTERISTIC
/begin CHARACTERISTIC DFES_FaultTyp.DFC_TrbCh4WinErr3_C "DFES/Fehlertyp Zuordnung für Prüfung DFC_TrbCh4WinErr3" VALUE 0x8002A5BD Val_Wu8 255.0 DFES_OneToOne 0.00 255.0 /end CHARACTERISTIC
/begin CHARACTERISTIC DFES_FaultTyp.DFC_TrbCh4WinErr4_C "DFES/Fehlertyp Zuordnung für Prüfung DFC_TrbCh4WinErr4" VALUE 0x8002A5BE Val_Wu8 255.0 DFES_OneToOne 0.00 255.0 /end CHARACTERISTIC
/begin CHARACTERISTIC DFES_FaultTyp.DFC_TrbChSCG_C "DFES/Fehlertyp Zuordnung für Prüfung DFC_TrbChSCG" VALUE 0x8002A5BF Val_Wu8 255.0 DFES_OneToOne 0.00 255.0 /end CHARACTERISTIC
/begin CHARACTERISTIC DFES_FaultTyp.DFC_TrbChSRCMax_C "DFES/Fehlertyp Zuordnung für Prüfung DFC_TrbChSRCMax" VALUE 0x8002A5C0 Val_Wu8 255.0 DFES_OneToOne 0.00 255.0 /end CHARACTERISTIC
/begin CHARACTERISTIC DFES_FaultTyp.DFC_TrbChSRCMin_C "DFES/Fehlertyp Zuordnung für Prüfung DFC_TrbChSRCMin" VALUE 0x8002A5C1 Val_Wu8 255.0 DFES_OneToOne 0.00 255.0 /end CHARACTERISTIC
/begin CHARACTERISTIC DFES_FaultTyp.DFC_WaHtEl4WinErr1_C "DFES/Fehlertyp Zuordnung für Prüfung DFC_WaHtEl4WinErr1" VALUE 0x8002A5C2 Val_Wu8 255.0 DFES_OneToOne 0.00 255.0 /end CHARACTERISTIC
/begin CHARACTERISTIC DFES_FaultTyp.DFC_WaHtEl4WinErr2_C "DFES/Fehlertyp Zuordnung für Prüfung DFC_WaHtEl4WinErr2" VALUE 0x8002A5C3 Val_Wu8 255.0 DFES_OneToOne 0.00 255.0 /end CHARACTERISTIC
/begin CHARACTERISTIC DFES_FaultTyp.DFC_WaHtEl4WinErr3_C "DFES/Fehlertyp Zuordnung für Prüfung DFC_WaHtEl4WinErr3" VALUE 0x8002A5C4 Val_Wu8 255.0 DFES_OneToOne 0.00 255.0 /end CHARACTERISTIC
/begin CHARACTERISTIC DFES_FaultTyp.DFC_WaHtEl4WinErr4_C "DFES/Fehlertyp Zuordnung für Prüfung DFC_WaHtEl4WinErr4" VALUE 0x8002A5C5 Val_Wu8 255.0 DFES_OneToOne 0.00 255.0 /end CHARACTERISTIC
/begin CHARACTERISTIC DFES_FaultTyp.DFC_WaHtElSCG_C "DFES/Fehlertyp Zuordnung für Prüfung DFC_WaHtElSCG" VALUE 0x8002A5C6 Val_Wu8 255.0 DFES_OneToOne 0.00 255.0 /end CHARACTERISTIC
/begin CHARACTERISTIC DFES_FaultTyp.DFC_ETClbETFltMax_0_C "DFES/Fehlertyp Zuordnung für Prüfung DFC_ETClbETFltMax_0" VALUE 0x8002A5C7 Val_Wu8 255.0 DFES_OneToOne 0.00 255.0 /end CHARACTERISTIC
/begin CHARACTERISTIC DFES_FaultTyp.DFC_ETClbETFltMax_1_C "DFES/Fehlertyp Zuordnung für Prüfung DFC_ETClbETFltMax_1" VALUE 0x8002A5C8 Val_Wu8 255.0 DFES_OneToOne 0.00 255.0 /end CHARACTERISTIC
/begin CHARACTERISTIC DFES_FaultTyp.DFC_ETClbETFltMax_2_C "DFES/Fehlertyp Zuordnung für Prüfung DFC_ETClbETFltMax_2" VALUE 0x8002A5C9 Val_Wu8 255.0 DFES_OneToOne 0.00 255.0 /end CHARACTERISTIC
/begin CHARACTERISTIC DFES_FaultTyp.DFC_ETClbETFltMax_3_C "DFES/Fehlertyp Zuordnung für Prüfung DFC_ETClbETFltMax_3" VALUE 0x8002A5CA Val_Wu8 255.0 DFES_OneToOne 0.00 255.0 /end CHARACTERISTIC
/begin CHARACTERISTIC DFES_FaultTyp.DFC_ETClbETFltMax_4_C "DFES/Fehlertyp Zuordnung für Prüfung DFC_ETClbETFltMax_4" VALUE 0x8002A5CB Val_Wu8 255.0 DFES_OneToOne 0.00 255.0 /end CHARACTERISTIC
/begin CHARACTERISTIC DFES_FaultTyp.DFC_ETClbETFltMax_5_C "DFES/Fehlertyp Zuordnung für Prüfung DFC_ETClbETFltMax_5" VALUE 0x8002A5CC Val_Wu8 255.0 DFES_OneToOne 0.00 255.0 /end CHARACTERISTIC
/begin CHARACTERISTIC DFES_FaultTyp.DFC_ETClbETFltMin_0_C "DFES/Fehlertyp Zuordnung für Prüfung DFC_ETClbETFltMin_0" VALUE 0x8002A5CD Val_Wu8 255.0 DFES_OneToOne 0.00 255.0 /end CHARACTERISTIC
/begin CHARACTERISTIC DFES_FaultTyp.DFC_ETClbETFltMin_1_C "DFES/Fehlertyp Zuordnung für Prüfung DFC_ETClbETFltMin_1" VALUE 0x8002A5CE Val_Wu8 255.0 DFES_OneToOne 0.00 255.0 /end CHARACTERISTIC
/begin CHARACTERISTIC DFES_FaultTyp.DFC_ETClbETFltMin_2_C "DFES/Fehlertyp Zuordnung für Prüfung DFC_ETClbETFltMin_2" VALUE 0x8002A5CF Val_Wu8 255.0 DFES_OneToOne 0.00 255.0 /end CHARACTERISTIC
/begin CHARACTERISTIC DFES_FaultTyp.DFC_ETClbETFltMin_3_C "DFES/Fehlertyp Zuordnung für Prüfung DFC_ETClbETFltMin_3" VALUE 0x8002A5D0 Val_Wu8 255.0 DFES_OneToOne 0.00 255.0 /end CHARACTERISTIC
/begin CHARACTERISTIC DFES_FaultTyp.DFC_ETClbETFltMin_4_C "DFES/Fehlertyp Zuordnung für Prüfung DFC_ETClbETFltMin_4" VALUE 0x8002A5D1 Val_Wu8 255.0 DFES_OneToOne 0.00 255.0 /end CHARACTERISTIC
/begin CHARACTERISTIC DFES_FaultTyp.DFC_ETClbETFltMin_5_C "DFES/Fehlertyp Zuordnung für Prüfung DFC_ETClbETFltMin_5" VALUE 0x8002A5D2 Val_Wu8 255.0 DFES_OneToOne 0.00 255.0 /end CHARACTERISTIC
/begin CHARACTERISTIC DFES_FaultTyp.DFC_InjCrvInjLimChrgBal_C "DFES/Fehlertyp Zuordnung für Prüfung DFC_InjCrvInjLimChrgBal" VALUE 0x8002A5D3 Val_Wu8 255.0 DFES_OneToOne 0.00 255.0 /end CHARACTERISTIC
/begin CHARACTERISTIC DFES_FaultTyp.DFC_InjCrvInjLimQntBal_C "DFES/Fehlertyp Zuordnung für Prüfung DFC_InjCrvInjLimQntBal" VALUE 0x8002A5D4 Val_Wu8 255.0 DFES_OneToOne 0.00 255.0 /end CHARACTERISTIC
/begin CHARACTERISTIC DFES_FaultTyp.DFC_InjCrvInjLimSys_C "DFES/Fehlertyp Zuordnung für Prüfung DFC_InjCrvInjLimSys" VALUE 0x8002A5D5 Val_Wu8 255.0 DFES_OneToOne 0.00 255.0 /end CHARACTERISTIC
/begin CHARACTERISTIC DFES_FaultTyp.DFC_InjCrvNumInjRtmLim_C "DFES/Fehlertyp Zuordnung für Prüfung DFC_InjCrvNumInjRtmLim" VALUE 0x8002A5D6 Val_Wu8 255.0 DFES_OneToOne 0.00 255.0 /end CHARACTERISTIC
/begin CHARACTERISTIC DFES_FaultTyp.DFC_LSUHtCoupSig_C "DFES/Fehlertyp Zuordnung für Prüfung DFC_LSUHtCoupSig" VALUE 0x8002A5D7 Val_Wu8 255.0 DFES_OneToOne 0.00 255.0 /end CHARACTERISTIC
/begin CHARACTERISTIC DFES_FaultTyp.DFC_AFS_SSpShOffOL_C "DFES/Fehlertyp Zuordnung für Prüfung DFC_AFS_SSpShOffOL" VALUE 0x8002A5D8 Val_Wu8 255.0 DFES_OneToOne 0.00 255.0 /end CHARACTERISTIC
/begin CHARACTERISTIC DFES_FaultTyp.DFC_AFS_SSpShOffOvrTemp_C "DFES/Fehlertyp Zuordnung für Prüfung DFC_AFS_SSpShOffOvrTemp" VALUE 0x8002A5D9 Val_Wu8 255.0 DFES_OneToOne 0.00 255.0 /end CHARACTERISTIC
/begin CHARACTERISTIC DFES_FaultTyp.DFC_AFS_SSpShOffSCB_C "DFES/Fehlertyp Zuordnung für Prüfung DFC_AFS_SSpShOffSCB" VALUE 0x8002A5DA Val_Wu8 255.0 DFES_OneToOne 0.00 255.0 /end CHARACTERISTIC
/begin CHARACTERISTIC DFES_FaultTyp.DFC_AFS_SSpShOffSCG_C "DFES/Fehlertyp Zuordnung für Prüfung DFC_AFS_SSpShOffSCG" VALUE 0x8002A5DB Val_Wu8 255.0 DFES_OneToOne 0.00 255.0 /end CHARACTERISTIC
/begin CHARACTERISTIC DFES_FaultTyp.DFC_AirCCmprOL_C "DFES/Fehlertyp Zuordnung für Prüfung DFC_AirCCmprOL" VALUE 0x8002A5DC Val_Wu8 255.0 DFES_OneToOne 0.00 255.0 /end CHARACTERISTIC
/begin CHARACTERISTIC DFES_FaultTyp.DFC_AirCCmprOvrTemp_C "DFES/Fehlertyp Zuordnung für Prüfung DFC_AirCCmprOvrTemp" VALUE 0x8002A5DD Val_Wu8 255.0 DFES_OneToOne 0.00 255.0 /end CHARACTERISTIC
/begin CHARACTERISTIC DFES_FaultTyp.DFC_AirCCmprSCB_C "DFES/Fehlertyp Zuordnung für Prüfung DFC_AirCCmprSCB" VALUE 0x8002A5DE Val_Wu8 255.0 DFES_OneToOne 0.00 255.0 /end CHARACTERISTIC
/begin CHARACTERISTIC DFES_FaultTyp.DFC_AirCCmprSCG_C "DFES/Fehlertyp Zuordnung für Prüfung DFC_AirCCmprSCG" VALUE 0x8002A5DF Val_Wu8 255.0 DFES_OneToOne 0.00 255.0 /end CHARACTERISTIC
/begin CHARACTERISTIC DFES_FaultTyp.DFC_CByVlvOL_C "DFES/Fehlertyp Zuordnung für Prüfung DFC_CByVlvOL" VALUE 0x8002A5E0 Val_Wu8 255.0 DFES_OneToOne 0.00 255.0 /end CHARACTERISTIC
/begin CHARACTERISTIC DFES_FaultTyp.DFC_CByVlvOvrTemp_C "DFES/Fehlertyp Zuordnung für Prüfung DFC_CByVlvOvrTemp" VALUE 0x8002A5E1 Val_Wu8 255.0 DFES_OneToOne 0.00 255.0 /end CHARACTERISTIC
/begin CHARACTERISTIC DFES_FaultTyp.DFC_CByVlvSCB_C "DFES/Fehlertyp Zuordnung für Prüfung DFC_CByVlvSCB" VALUE 0x8002A5E2 Val_Wu8 255.0 DFES_OneToOne 0.00 255.0 /end CHARACTERISTIC
/begin CHARACTERISTIC DFES_FaultTyp.DFC_CByVlvSCG_C "DFES/Fehlertyp Zuordnung für Prüfung DFC_CByVlvSCG" VALUE 0x8002A5E3 Val_Wu8 255.0 DFES_OneToOne 0.00 255.0 /end CHARACTERISTIC
/begin CHARACTERISTIC DFES_FaultTyp.DFC_CThmstOL_C "DFES/Fehlertyp Zuordnung für Prüfung DFC_CThmstOL" VALUE 0x8002A5E4 Val_Wu8 255.0 DFES_OneToOne 0.00 255.0 /end CHARACTERISTIC
/begin CHARACTERISTIC DFES_FaultTyp.DFC_CThmstOvrTemp_C "DFES/Fehlertyp Zuordnung für Prüfung DFC_CThmstOvrTemp" VALUE 0x8002A5E5 Val_Wu8 255.0 DFES_OneToOne 0.00 255.0 /end CHARACTERISTIC
/begin CHARACTERISTIC DFES_FaultTyp.DFC_CThmstSCB_C "DFES/Fehlertyp Zuordnung für Prüfung DFC_CThmstSCB" VALUE 0x8002A5E6 Val_Wu8 255.0 DFES_OneToOne 0.00 255.0 /end CHARACTERISTIC
/begin CHARACTERISTIC DFES_FaultTyp.DFC_CThmstSCG_C "DFES/Fehlertyp Zuordnung für Prüfung DFC_CThmstSCG" VALUE 0x8002A5E7 Val_Wu8 255.0 DFES_OneToOne 0.00 255.0 /end CHARACTERISTIC
/begin CHARACTERISTIC DFES_FaultTyp.DFC_DSMDummy_C "DFES/Fehlertyp Zuordnung für Prüfung DFC_DSMDummy" VALUE 0x8002A5E8 Val_Wu8 255.0 DFES_OneToOne 0.00 255.0 /end CHARACTERISTIC
/begin CHARACTERISTIC DFES_FaultTyp.DFC_EBxFanOL_C "DFES/Fehlertyp Zuordnung für Prüfung DFC_EBxFanOL" VALUE 0x8002A5E9 Val_Wu8 255.0 DFES_OneToOne 0.00 255.0 /end CHARACTERISTIC
/begin CHARACTERISTIC DFES_FaultTyp.DFC_EBxFanOvrTemp_C "DFES/Fehlertyp Zuordnung für Prüfung DFC_EBxFanOvrTemp" VALUE 0x8002A5EA Val_Wu8 255.0 DFES_OneToOne 0.00 255.0 /end CHARACTERISTIC
/begin CHARACTERISTIC DFES_FaultTyp.DFC_EBxFanSCB_C "DFES/Fehlertyp Zuordnung für Prüfung DFC_EBxFanSCB" VALUE 0x8002A5EB Val_Wu8 255.0 DFES_OneToOne 0.00 255.0 /end CHARACTERISTIC
/begin CHARACTERISTIC DFES_FaultTyp.DFC_EBxFanSCG_C "DFES/Fehlertyp Zuordnung für Prüfung DFC_EBxFanSCG" VALUE 0x8002A5EC Val_Wu8 255.0 DFES_OneToOne 0.00 255.0 /end CHARACTERISTIC
/begin CHARACTERISTIC DFES_FaultTyp.DFC_ECBVlvOL_C "DFES/Fehlertyp Zuordnung für Prüfung DFC_ECBVlvOL" VALUE 0x8002A5ED Val_Wu8 255.0 DFES_OneToOne 0.00 255.0 /end CHARACTERISTIC
/begin CHARACTERISTIC DFES_FaultTyp.DFC_ECBVlvOvrTemp_C "DFES/Fehlertyp Zuordnung für Prüfung DFC_ECBVlvOvrTemp" VALUE 0x8002A5EE Val_Wu8 255.0 DFES_OneToOne 0.00 255.0 /end CHARACTERISTIC
/begin CHARACTERISTIC DFES_FaultTyp.DFC_ECBVlvSCB_C "DFES/Fehlertyp Zuordnung für Prüfung DFC_ECBVlvSCB" VALUE 0x8002A5EF Val_Wu8 255.0 DFES_OneToOne 0.00 255.0 /end CHARACTERISTIC
/begin CHARACTERISTIC DFES_FaultTyp.DFC_ECBVlvSCG_C "DFES/Fehlertyp Zuordnung für Prüfung DFC_ECBVlvSCG" VALUE 0x8002A5F0 Val_Wu8 255.0 DFES_OneToOne 0.00 255.0 /end CHARACTERISTIC
/begin CHARACTERISTIC DFES_FaultTyp.DFC_EMDmpOL_0_C "DFES/Fehlertyp Zuordnung für Prüfung DFC_EMDmpOL_0" VALUE 0x8002A5F1 Val_Wu8 255.0 DFES_OneToOne 0.00 255.0 /end CHARACTERISTIC
/begin CHARACTERISTIC DFES_FaultTyp.DFC_EMDmpOL_1_C "DFES/Fehlertyp Zuordnung für Prüfung DFC_EMDmpOL_1" VALUE 0x8002A5F2 Val_Wu8 255.0 DFES_OneToOne 0.00 255.0 /end CHARACTERISTIC
/begin CHARACTERISTIC DFES_FaultTyp.DFC_EMDmpOvrTemp_0_C "DFES/Fehlertyp Zuordnung für Prüfung DFC_EMDmpOvrTemp_0" VALUE 0x8002A5F3 Val_Wu8 255.0 DFES_OneToOne 0.00 255.0 /end CHARACTERISTIC
/begin CHARACTERISTIC DFES_FaultTyp.DFC_EMDmpOvrTemp_1_C "DFES/Fehlertyp Zuordnung für Prüfung DFC_EMDmpOvrTemp_1" VALUE 0x8002A5F4 Val_Wu8 255.0 DFES_OneToOne 0.00 255.0 /end CHARACTERISTIC
/begin CHARACTERISTIC DFES_FaultTyp.DFC_EMDmpSCB_0_C "DFES/Fehlertyp Zuordnung für Prüfung DFC_EMDmpSCB_0" VALUE 0x8002A5F5 Val_Wu8 255.0 DFES_OneToOne 0.00 255.0 /end CHARACTERISTIC
/begin CHARACTERISTIC DFES_FaultTyp.DFC_EMDmpSCB_1_C "DFES/Fehlertyp Zuordnung für Prüfung DFC_EMDmpSCB_1" VALUE 0x8002A5F6 Val_Wu8 255.0 DFES_OneToOne 0.00 255.0 /end CHARACTERISTIC
/begin CHARACTERISTIC DFES_FaultTyp.DFC_EMDmpSCG_0_C "DFES/Fehlertyp Zuordnung für Prüfung DFC_EMDmpSCG_0" VALUE 0x8002A5F7 Val_Wu8 255.0 DFES_OneToOne 0.00 255.0 /end CHARACTERISTIC
/begin CHARACTERISTIC DFES_FaultTyp.DFC_EMDmpSCG_1_C "DFES/Fehlertyp Zuordnung für Prüfung DFC_EMDmpSCG_1" VALUE 0x8002A5F8 Val_Wu8 255.0 DFES_OneToOne 0.00 255.0 /end CHARACTERISTIC
/begin CHARACTERISTIC DFES_FaultTyp.DFC_EngStAOL_C "DFES/Fehlertyp Zuordnung für Prüfung DFC_EngStAOL" VALUE 0x8002A5F9 Val_Wu8 255.0 DFES_OneToOne 0.00 255.0 /end CHARACTERISTIC
/begin CHARACTERISTIC DFES_FaultTyp.DFC_EngStAOvrTemp_C "DFES/Fehlertyp Zuordnung für Prüfung DFC_EngStAOvrTemp" VALUE 0x8002A5FA Val_Wu8 255.0 DFES_OneToOne 0.00 255.0 /end CHARACTERISTIC
/begin CHARACTERISTIC DFES_FaultTyp.DFC_EngStASCB_C "DFES/Fehlertyp Zuordnung für Prüfung DFC_EngStASCB" VALUE 0x8002A5FB Val_Wu8 255.0 DFES_OneToOne 0.00 255.0 /end CHARACTERISTIC
/begin CHARACTERISTIC DFES_FaultTyp.DFC_EngStASCG_C "DFES/Fehlertyp Zuordnung für Prüfung DFC_EngStASCG" VALUE 0x8002A5FC Val_Wu8 255.0 DFES_OneToOne 0.00 255.0 /end CHARACTERISTIC
/begin CHARACTERISTIC DFES_FaultTyp.DFC_FanOL_C "DFES/Fehlertyp Zuordnung für Prüfung DFC_FanOL" VALUE 0x8002A5FD Val_Wu8 255.0 DFES_OneToOne 0.00 255.0 /end CHARACTERISTIC
/begin CHARACTERISTIC DFES_FaultTyp.DFC_FanOvrTemp_C "DFES/Fehlertyp Zuordnung für Prüfung DFC_FanOvrTemp" VALUE 0x8002A5FE Val_Wu8 255.0 DFES_OneToOne 0.00 255.0 /end CHARACTERISTIC
/begin CHARACTERISTIC DFES_FaultTyp.DFC_FanSCB_C "DFES/Fehlertyp Zuordnung für Prüfung DFC_FanSCB" VALUE 0x8002A5FF Val_Wu8 255.0 DFES_OneToOne 0.00 255.0 /end CHARACTERISTIC
/begin CHARACTERISTIC DFES_FaultTyp.DFC_FlFltHtOL_C "DFES/Fehlertyp Zuordnung für Prüfung DFC_FlFltHtOL" VALUE 0x8002A600 Val_Wu8 255.0 DFES_OneToOne 0.00 255.0 /end CHARACTERISTIC
/begin CHARACTERISTIC DFES_FaultTyp.DFC_FlFltHtOvrTemp_C "DFES/Fehlertyp Zuordnung für Prüfung DFC_FlFltHtOvrTemp" VALUE 0x8002A601 Val_Wu8 255.0 DFES_OneToOne 0.00 255.0 /end CHARACTERISTIC
/begin CHARACTERISTIC DFES_FaultTyp.DFC_FlFltHtSCB_C "DFES/Fehlertyp Zuordnung für Prüfung DFC_FlFltHtSCB" VALUE 0x8002A602 Val_Wu8 255.0 DFES_OneToOne 0.00 255.0 /end CHARACTERISTIC
/begin CHARACTERISTIC DFES_FaultTyp.DFC_FlFltHtSCG_C "DFES/Fehlertyp Zuordnung für Prüfung DFC_FlFltHtSCG" VALUE 0x8002A603 Val_Wu8 255.0 DFES_OneToOne 0.00 255.0 /end CHARACTERISTIC
/begin CHARACTERISTIC DFES_FaultTyp.DFC_LSUHtrMax_C "DFES/Fehlertyp Zuordnung für Prüfung DFC_LSUHtrMax" VALUE 0x8002A604 Val_Wu8 255.0 DFES_OneToOne 0.00 255.0 /end CHARACTERISTIC
/begin CHARACTERISTIC DFES_FaultTyp.DFC_LSUHtrMin_C "DFES/Fehlertyp Zuordnung für Prüfung DFC_LSUHtrMin" VALUE 0x8002A605 Val_Wu8 255.0 DFES_OneToOne 0.00 255.0 /end CHARACTERISTIC
/begin CHARACTERISTIC DFES_FaultTyp.DFC_LSUHtrNpl_C "DFES/Fehlertyp Zuordnung für Prüfung DFC_LSUHtrNpl" VALUE 0x8002A606 Val_Wu8 255.0 DFES_OneToOne 0.00 255.0 /end CHARACTERISTIC
/begin CHARACTERISTIC DFES_FaultTyp.DFC_LSUHtrSig_C "DFES/Fehlertyp Zuordnung für Prüfung DFC_LSUHtrSig" VALUE 0x8002A607 Val_Wu8 255.0 DFES_OneToOne 0.00 255.0 /end CHARACTERISTIC
/begin CHARACTERISTIC DFES_FaultTyp.DFC_LSUtExcMax_C "DFES/Fehlertyp Zuordnung für Prüfung DFC_LSUtExcMax" VALUE 0x8002A608 Val_Wu8 255.0 DFES_OneToOne 0.00 255.0 /end CHARACTERISTIC
/begin CHARACTERISTIC DFES_FaultTyp.DFC_LSUtExcMin_C "DFES/Fehlertyp Zuordnung für Prüfung DFC_LSUtExcMin" VALUE 0x8002A609 Val_Wu8 255.0 DFES_OneToOne 0.00 255.0 /end CHARACTERISTIC
/begin CHARACTERISTIC DFES_FaultTyp.DFC_MeUnOL_C "DFES/Fehlertyp Zuordnung für Prüfung DFC_MeUnOL" VALUE 0x8002A60A Val_Wu8 255.0 DFES_OneToOne 0.00 255.0 /end CHARACTERISTIC
/begin CHARACTERISTIC DFES_FaultTyp.DFC_MeUnSCB_C "DFES/Fehlertyp Zuordnung für Prüfung DFC_MeUnSCB" VALUE 0x8002A60B Val_Wu8 255.0 DFES_OneToOne 0.00 255.0 /end CHARACTERISTIC
/begin CHARACTERISTIC DFES_FaultTyp.DFC_MeUnSRCMax_C "DFES/Fehlertyp Zuordnung für Prüfung DFC_MeUnSRCMax" VALUE 0x8002A60C Val_Wu8 255.0 DFES_OneToOne 0.00 255.0 /end CHARACTERISTIC
/begin CHARACTERISTIC DFES_FaultTyp.DFC_MeUnSRCMin_C "DFES/Fehlertyp Zuordnung für Prüfung DFC_MeUnSRCMin" VALUE 0x8002A60D Val_Wu8 255.0 DFES_OneToOne 0.00 255.0 /end CHARACTERISTIC
/begin CHARACTERISTIC DFES_FaultTyp.DFC_PCVOL_C "DFES/Fehlertyp Zuordnung für Prüfung DFC_PCVOL" VALUE 0x8002A60E Val_Wu8 255.0 DFES_OneToOne 0.00 255.0 /end CHARACTERISTIC
/begin CHARACTERISTIC DFES_FaultTyp.DFC_PCVSCB_C "DFES/Fehlertyp Zuordnung für Prüfung DFC_PCVSCB" VALUE 0x8002A60F Val_Wu8 255.0 DFES_OneToOne 0.00 255.0 /end CHARACTERISTIC
/begin CHARACTERISTIC DFES_FaultTyp.DFC_PCVSRCMax_C "DFES/Fehlertyp Zuordnung für Prüfung DFC_PCVSRCMax" VALUE 0x8002A610 Val_Wu8 255.0 DFES_OneToOne 0.00 255.0 /end CHARACTERISTIC
/begin CHARACTERISTIC DFES_FaultTyp.DFC_PCVSRCMin_C "DFES/Fehlertyp Zuordnung für Prüfung DFC_PCVSRCMin" VALUE 0x8002A611 Val_Wu8 255.0 DFES_OneToOne 0.00 255.0 /end CHARACTERISTIC
/begin CHARACTERISTIC DFES_FaultTyp.DFC_RailPSRCMax_C "DFES/Fehlertyp Zuordnung für Prüfung DFC_RailPSRCMax" VALUE 0x8002A612 Val_Wu8 255.0 DFES_OneToOne 0.00 255.0 /end CHARACTERISTIC
/begin CHARACTERISTIC DFES_FaultTyp.DFC_RailPSRCMin_C "DFES/Fehlertyp Zuordnung für Prüfung DFC_RailPSRCMin" VALUE 0x8002A613 Val_Wu8 255.0 DFES_OneToOne 0.00 255.0 /end CHARACTERISTIC
/begin CHARACTERISTIC DFES_FaultTyp.DFC_ShtrOL_C "DFES/Fehlertyp Zuordnung für Prüfung DFC_ShtrOL" VALUE 0x8002A614 Val_Wu8 255.0 DFES_OneToOne 0.00 255.0 /end CHARACTERISTIC
/begin CHARACTERISTIC DFES_FaultTyp.DFC_ShtrOvrTemp_C "DFES/Fehlertyp Zuordnung für Prüfung DFC_ShtrOvrTemp" VALUE 0x8002A615 Val_Wu8 255.0 DFES_OneToOne 0.00 255.0 /end CHARACTERISTIC
/begin CHARACTERISTIC DFES_FaultTyp.DFC_ShtrSCB_C "DFES/Fehlertyp Zuordnung für Prüfung DFC_ShtrSCB" VALUE 0x8002A616 Val_Wu8 255.0 DFES_OneToOne 0.00 255.0 /end CHARACTERISTIC
/begin CHARACTERISTIC DFES_FaultTyp.DFC_ShtrSCG_C "DFES/Fehlertyp Zuordnung für Prüfung DFC_ShtrSCG" VALUE 0x8002A617 Val_Wu8 255.0 DFES_OneToOne 0.00 255.0 /end CHARACTERISTIC
/begin CHARACTERISTIC DFES_FaultTyp.DFC_StrtOL_C "DFES/Fehlertyp Zuordnung für Prüfung DFC_StrtOL" VALUE 0x8002A618 Val_Wu8 255.0 DFES_OneToOne 0.00 255.0 /end CHARACTERISTIC
/begin CHARACTERISTIC DFES_FaultTyp.DFC_StrtOvrTemp_C "DFES/Fehlertyp Zuordnung für Prüfung DFC_StrtOvrTemp" VALUE 0x8002A619 Val_Wu8 255.0 DFES_OneToOne 0.00 255.0 /end CHARACTERISTIC
/begin CHARACTERISTIC DFES_FaultTyp.DFC_StrtSCB_C "DFES/Fehlertyp Zuordnung für Prüfung DFC_StrtSCB" VALUE 0x8002A61A Val_Wu8 255.0 DFES_OneToOne 0.00 255.0 /end CHARACTERISTIC
/begin CHARACTERISTIC DFES_FaultTyp.DFC_StrtSCG_C "DFES/Fehlertyp Zuordnung für Prüfung DFC_StrtSCG" VALUE 0x8002A61B Val_Wu8 255.0 DFES_OneToOne 0.00 255.0 /end CHARACTERISTIC
/begin CHARACTERISTIC DFES_FaultTyp.DFC_ThrVlvOL_C "DFES/Fehlertyp Zuordnung für Prüfung DFC_ThrVlvOL" VALUE 0x8002A61C Val_Wu8 255.0 DFES_OneToOne 0.00 255.0 /end CHARACTERISTIC
/begin CHARACTERISTIC DFES_FaultTyp.DFC_ThrVlvOvrTemp_C "DFES/Fehlertyp Zuordnung für Prüfung DFC_ThrVlvOvrTemp" VALUE 0x8002A61D Val_Wu8 255.0 DFES_OneToOne 0.00 255.0 /end CHARACTERISTIC
/begin CHARACTERISTIC DFES_FaultTyp.DFC_ThrVlvSCB_C "DFES/Fehlertyp Zuordnung für Prüfung DFC_ThrVlvSCB" VALUE 0x8002A61E Val_Wu8 255.0 DFES_OneToOne 0.00 255.0 /end CHARACTERISTIC
/begin CHARACTERISTIC DFES_FaultTyp.DFC_TrbChOL_C "DFES/Fehlertyp Zuordnung für Prüfung DFC_TrbChOL" VALUE 0x8002A61F Val_Wu8 255.0 DFES_OneToOne 0.00 255.0 /end CHARACTERISTIC
/begin CHARACTERISTIC DFES_FaultTyp.DFC_TrbChOvrTemp_C "DFES/Fehlertyp Zuordnung für Prüfung DFC_TrbChOvrTemp" VALUE 0x8002A620 Val_Wu8 255.0 DFES_OneToOne 0.00 255.0 /end CHARACTERISTIC
/begin CHARACTERISTIC DFES_FaultTyp.DFC_TrbChSCB_C "DFES/Fehlertyp Zuordnung für Prüfung DFC_TrbChSCB" VALUE 0x8002A621 Val_Wu8 255.0 DFES_OneToOne 0.00 255.0 /end CHARACTERISTIC
/begin CHARACTERISTIC DFES_FaultTyp.DFC_UDosVlvOL_C "DFES/Fehlertyp Zuordnung für Prüfung DFC_UDosVlvOL" VALUE 0x8002A622 Val_Wu8 255.0 DFES_OneToOne 0.00 255.0 /end CHARACTERISTIC
/begin CHARACTERISTIC DFES_FaultTyp.DFC_UDosVlvOvrTemp_C "DFES/Fehlertyp Zuordnung für Prüfung DFC_UDosVlvOvrTemp" VALUE 0x8002A623 Val_Wu8 255.0 DFES_OneToOne 0.00 255.0 /end CHARACTERISTIC
/begin CHARACTERISTIC DFES_FaultTyp.DFC_UDosVlvSCB_C "DFES/Fehlertyp Zuordnung für Prüfung DFC_UDosVlvSCB" VALUE 0x8002A624 Val_Wu8 255.0 DFES_OneToOne 0.00 255.0 /end CHARACTERISTIC
/begin CHARACTERISTIC DFES_FaultTyp.DFC_UDosVlvSCG_C "DFES/Fehlertyp Zuordnung für Prüfung DFC_UDosVlvSCG" VALUE 0x8002A625 Val_Wu8 255.0 DFES_OneToOne 0.00 255.0 /end CHARACTERISTIC
/begin CHARACTERISTIC DFES_FaultTyp.DFC_UPmpMotOL_C "DFES/Fehlertyp Zuordnung für Prüfung DFC_UPmpMotOL" VALUE 0x8002A626 Val_Wu8 255.0 DFES_OneToOne 0.00 255.0 /end CHARACTERISTIC
/begin CHARACTERISTIC DFES_FaultTyp.DFC_UPmpMotOvrTemp_C "DFES/Fehlertyp Zuordnung für Prüfung DFC_UPmpMotOvrTemp" VALUE 0x8002A627 Val_Wu8 255.0 DFES_OneToOne 0.00 255.0 /end CHARACTERISTIC
/begin CHARACTERISTIC DFES_FaultTyp.DFC_UPmpMotSCB_C "DFES/Fehlertyp Zuordnung für Prüfung DFC_UPmpMotSCB" VALUE 0x8002A628 Val_Wu8 255.0 DFES_OneToOne 0.00 255.0 /end CHARACTERISTIC
/begin CHARACTERISTIC DFES_FaultTyp.DFC_UPmpMotSCG_C "DFES/Fehlertyp Zuordnung für Prüfung DFC_UPmpMotSCG" VALUE 0x8002A629 Val_Wu8 255.0 DFES_OneToOne 0.00 255.0 /end CHARACTERISTIC
/begin CHARACTERISTIC DFES_FaultTyp.DFC_WaHtElOL_C "DFES/Fehlertyp Zuordnung für Prüfung DFC_WaHtElOL" VALUE 0x8002A62A Val_Wu8 255.0 DFES_OneToOne 0.00 255.0 /end CHARACTERISTIC
/begin CHARACTERISTIC DFES_FaultTyp.DFC_WaHtElOvrTemp_C "DFES/Fehlertyp Zuordnung für Prüfung DFC_WaHtElOvrTemp" VALUE 0x8002A62B Val_Wu8 255.0 DFES_OneToOne 0.00 255.0 /end CHARACTERISTIC
/begin CHARACTERISTIC DFES_FaultTyp.DFC_WaHtElSCB_C "DFES/Fehlertyp Zuordnung für Prüfung DFC_WaHtElSCB" VALUE 0x8002A62C Val_Wu8 255.0 DFES_OneToOne 0.00 255.0 /end CHARACTERISTIC
/begin CHARACTERISTIC DFES_FaultTyp.DFC_IVActrUChSRCMax_C "DFES/Fehlertyp Zuordnung für Prüfung DFC_IVActrUChSRCMax" VALUE 0x8002A62D Val_Wu8 255.0 DFES_OneToOne 0.00 255.0 /end CHARACTERISTIC
/begin CHARACTERISTIC DFES_FaultTyp.DFC_IVActrUChSRCMin_C "DFES/Fehlertyp Zuordnung für Prüfung DFC_IVActrUChSRCMin" VALUE 0x8002A62E Val_Wu8 255.0 DFES_OneToOne 0.00 255.0 /end CHARACTERISTIC
/begin CHARACTERISTIC DFES_FaultTyp.DFC_IVActrVltgSRCMax_C "DFES/Fehlertyp Zuordnung für Prüfung DFC_IVActrVltgSRCMax" VALUE 0x8002A62F Val_Wu8 255.0 DFES_OneToOne 0.00 255.0 /end CHARACTERISTIC
/begin CHARACTERISTIC DFES_FaultTyp.DFC_IVActrVltgSRCMin_C "DFES/Fehlertyp Zuordnung für Prüfung DFC_IVActrVltgSRCMin" VALUE 0x8002A630 Val_Wu8 255.0 DFES_OneToOne 0.00 255.0 /end CHARACTERISTIC
/begin CHARACTERISTIC DFES_FaultTyp.DFC_IVDiaTunDet_C "DFES/Fehlertyp Zuordnung für Prüfung DFC_IVDiaTunDet" VALUE 0x8002A631 Val_Wu8 255.0 DFES_OneToOne 0.00 255.0 /end CHARACTERISTIC
/begin CHARACTERISTIC DFES_FaultTyp.DFC_IVPSplyStopDCDC_C "DFES/Fehlertyp Zuordnung für Prüfung DFC_IVPSplyStopDCDC" VALUE 0x8002A632 Val_Wu8 255.0 DFES_OneToOne 0.00 255.0 /end CHARACTERISTIC
/begin CHARACTERISTIC DFES_FaultTyp.DFC_IVPSplyVltgSRCMax_C "DFES/Fehlertyp Zuordnung für Prüfung DFC_IVPSplyVltgSRCMax" VALUE 0x8002A633 Val_Wu8 255.0 DFES_OneToOne 0.00 255.0 /end CHARACTERISTIC
/begin CHARACTERISTIC DFES_FaultTyp.DFC_IVPSplyVltgSRCMin_C "DFES/Fehlertyp Zuordnung für Prüfung DFC_IVPSplyVltgSRCMin" VALUE 0x8002A634 Val_Wu8 255.0 DFES_OneToOne 0.00 255.0 /end CHARACTERISTIC
/begin CHARACTERISTIC DFES_FaultTyp.DFC_SCREtaErr_C "DFES/Fehlertyp Zuordnung für Prüfung DFC_SCREtaErr" VALUE 0x8002A635 Val_Wu8 255.0 DFES_OneToOne 0.00 255.0 /end CHARACTERISTIC
/begin CHARACTERISTIC DFES_FaultTyp.DFC_SCREtaErr1_C "DFES/Fehlertyp Zuordnung für Prüfung DFC_SCREtaErr1" VALUE 0x8002A636 Val_Wu8 255.0 DFES_OneToOne 0.00 255.0 /end CHARACTERISTIC
/begin CHARACTERISTIC DFES_FaultTyp.DFC_SCREtaErr2_C "DFES/Fehlertyp Zuordnung für Prüfung DFC_SCREtaErr2" VALUE 0x8002A637 Val_Wu8 255.0 DFES_OneToOne 0.00 255.0 /end CHARACTERISTIC
/begin CHARACTERISTIC DFES_FaultTyp.DFC_SCRMonMetCtlPresErr_C "DFES/Fehlertyp Zuordnung für Prüfung DFC_SCRMonMetCtlPresErr" VALUE 0x8002A638 Val_Wu8 255.0 DFES_OneToOne 0.00 255.0 /end CHARACTERISTIC
/begin CHARACTERISTIC DFES_FaultTyp.DFC_SCRMonPresBuildUpErr_C "DFES/Fehlertyp Zuordnung für Prüfung DFC_SCRMonPresBuildUpErr" VALUE 0x8002A639 Val_Wu8 255.0 DFES_OneToOne 0.00 255.0 /end CHARACTERISTIC
/begin CHARACTERISTIC DFES_FaultTyp.DFC_SCRMonPresRdcErr_C "DFES/Fehlertyp Zuordnung für Prüfung DFC_SCRMonPresRdcErr" VALUE 0x8002A63A Val_Wu8 255.0 DFES_OneToOne 0.00 255.0 /end CHARACTERISTIC
/begin CHARACTERISTIC DFES_FaultTyp.DFC_AFSOffsDrftMax_C "DFES/Fehlertyp Zuordnung für Prüfung DFC_AFSOffsDrftMax" VALUE 0x8002A63B Val_Wu8 255.0 DFES_OneToOne 0.00 255.0 /end CHARACTERISTIC
/begin CHARACTERISTIC DFES_FaultTyp.DFC_AFSOffsDrftMin_C "DFES/Fehlertyp Zuordnung für Prüfung DFC_AFSOffsDrftMin" VALUE 0x8002A63C Val_Wu8 255.0 DFES_OneToOne 0.00 255.0 /end CHARACTERISTIC
/begin CHARACTERISTIC DFES_FaultTyp.DFC_AFSSRCCorMax_C "DFES/Fehlertyp Zuordnung für Prüfung DFC_AFSSRCCorMax" VALUE 0x8002A63D Val_Wu8 255.0 DFES_OneToOne 0.00 255.0 /end CHARACTERISTIC
/begin CHARACTERISTIC DFES_FaultTyp.DFC_AFSSRCCorMin_C "DFES/Fehlertyp Zuordnung für Prüfung DFC_AFSSRCCorMin" VALUE 0x8002A63E Val_Wu8 255.0 DFES_OneToOne 0.00 255.0 /end CHARACTERISTIC
/begin CHARACTERISTIC DFES_FaultTyp.DFC_AFSSRCRawMax_C "DFES/Fehlertyp Zuordnung für Prüfung DFC_AFSSRCRawMax" VALUE 0x8002A63F Val_Wu8 255.0 DFES_OneToOne 0.00 255.0 /end CHARACTERISTIC
/begin CHARACTERISTIC DFES_FaultTyp.DFC_AFSSRCRawMin_C "DFES/Fehlertyp Zuordnung für Prüfung DFC_AFSSRCRawMin" VALUE 0x8002A640 Val_Wu8 255.0 DFES_OneToOne 0.00 255.0 /end CHARACTERISTIC
/begin CHARACTERISTIC DFES_FaultTyp.DFC_AFSSetyDrftMax_C "DFES/Fehlertyp Zuordnung für Prüfung DFC_AFSSetyDrftMax" VALUE 0x8002A641 Val_Wu8 255.0 DFES_OneToOne 0.00 255.0 /end CHARACTERISTIC
/begin CHARACTERISTIC DFES_FaultTyp.DFC_AFSSetyDrftMin_C "DFES/Fehlertyp Zuordnung für Prüfung DFC_AFSSetyDrftMin" VALUE 0x8002A642 Val_Wu8 255.0 DFES_OneToOne 0.00 255.0 /end CHARACTERISTIC
/begin CHARACTERISTIC DFES_FaultTyp.DFC_AirCSwtNpl_C "DFES/Fehlertyp Zuordnung für Prüfung DFC_AirCSwtNpl" VALUE 0x8002A643 Val_Wu8 255.0 DFES_OneToOne 0.00 255.0 /end CHARACTERISTIC
/begin CHARACTERISTIC DFES_FaultTyp.DFC_AirCSwtSig_C "DFES/Fehlertyp Zuordnung für Prüfung DFC_AirCSwtSig" VALUE 0x8002A644 Val_Wu8 255.0 DFES_OneToOne 0.00 255.0 /end CHARACTERISTIC
/begin CHARACTERISTIC DFES_FaultTyp.DFC_BattUSRCMax_C "DFES/Fehlertyp Zuordnung für Prüfung DFC_BattUSRCMax" VALUE 0x8002A645 Val_Wu8 255.0 DFES_OneToOne 0.00 255.0 /end CHARACTERISTIC
/begin CHARACTERISTIC DFES_FaultTyp.DFC_BattUSRCMin_C "DFES/Fehlertyp Zuordnung für Prüfung DFC_BattUSRCMin" VALUE 0x8002A646 Val_Wu8 255.0 DFES_OneToOne 0.00 255.0 /end CHARACTERISTIC
/begin CHARACTERISTIC DFES_FaultTyp.DFC_BrkNpl_C "DFES/Fehlertyp Zuordnung für Prüfung DFC_BrkNpl" VALUE 0x8002A647 Val_Wu8 255.0 DFES_OneToOne 0.00 255.0 /end CHARACTERISTIC
/begin CHARACTERISTIC DFES_FaultTyp.DFC_BrkPSRCMax_C "DFES/Fehlertyp Zuordnung für Prüfung DFC_BrkPSRCMax" VALUE 0x8002A648 Val_Wu8 255.0 DFES_OneToOne 0.00 255.0 /end CHARACTERISTIC
/begin CHARACTERISTIC DFES_FaultTyp.DFC_BrkPSRCMin_C "DFES/Fehlertyp Zuordnung für Prüfung DFC_BrkPSRCMin" VALUE 0x8002A649 Val_Wu8 255.0 DFES_OneToOne 0.00 255.0 /end CHARACTERISTIC
/begin CHARACTERISTIC DFES_FaultTyp.DFC_CEngDsTSRCMax_C "DFES/Fehlertyp Zuordnung für Prüfung DFC_CEngDsTSRCMax" VALUE 0x8002A64A Val_Wu8 255.0 DFES_OneToOne 0.00 255.0 /end CHARACTERISTIC
/begin CHARACTERISTIC DFES_FaultTyp.DFC_CEngDsTSRCMin_C "DFES/Fehlertyp Zuordnung für Prüfung DFC_CEngDsTSRCMin" VALUE 0x8002A64B Val_Wu8 255.0 DFES_OneToOne 0.00 255.0 /end CHARACTERISTIC
/begin CHARACTERISTIC DFES_FaultTyp.DFC_CrCUIDet_C "DFES/Fehlertyp Zuordnung für Prüfung DFC_CrCUIDet" VALUE 0x8002A64C Val_Wu8 255.0 DFES_OneToOne 0.00 255.0 /end CHARACTERISTIC
/begin CHARACTERISTIC DFES_FaultTyp.DFC_ECBVlvSRCMax_C "DFES/Fehlertyp Zuordnung für Prüfung DFC_ECBVlvSRCMax" VALUE 0x8002A64D Val_Wu8 255.0 DFES_OneToOne 0.00 255.0 /end CHARACTERISTIC
/begin CHARACTERISTIC DFES_FaultTyp.DFC_ECBVlvSRCMin_C "DFES/Fehlertyp Zuordnung für Prüfung DFC_ECBVlvSRCMin" VALUE 0x8002A64E Val_Wu8 255.0 DFES_OneToOne 0.00 255.0 /end CHARACTERISTIC
/begin CHARACTERISTIC DFES_FaultTyp.DFC_ECUOvrTemp_C "DFES/Fehlertyp Zuordnung für Prüfung DFC_ECUOvrTemp" VALUE 0x8002A64F Val_Wu8 255.0 DFES_OneToOne 0.00 255.0 /end CHARACTERISTIC
/begin CHARACTERISTIC DFES_FaultTyp.DFC_EGRVlvGovDvtMax_C "DFES/Fehlertyp Zuordnung für Prüfung DFC_EGRVlvGovDvtMax" VALUE 0x8002A650 Val_Wu8 255.0 DFES_OneToOne 0.00 255.0 /end CHARACTERISTIC
/begin CHARACTERISTIC DFES_FaultTyp.DFC_EGRVlvGovDvtMin_C "DFES/Fehlertyp Zuordnung für Prüfung DFC_EGRVlvGovDvtMin" VALUE 0x8002A651 Val_Wu8 255.0 DFES_OneToOne 0.00 255.0 /end CHARACTERISTIC
/begin CHARACTERISTIC DFES_FaultTyp.DFC_EGRVlvHBrgOpnLd_C "DFES/Fehlertyp Zuordnung für Prüfung DFC_EGRVlvHBrgOpnLd" VALUE 0x8002A652 Val_Wu8 255.0 DFES_OneToOne 0.00 255.0 /end CHARACTERISTIC
/begin CHARACTERISTIC DFES_FaultTyp.DFC_EGRVlvHBrgOvrCurr_C "DFES/Fehlertyp Zuordnung für Prüfung DFC_EGRVlvHBrgOvrCurr" VALUE 0x8002A653 Val_Wu8 255.0 DFES_OneToOne 0.00 255.0 /end CHARACTERISTIC
/begin CHARACTERISTIC DFES_FaultTyp.DFC_EGRVlvHBrgOvrTemp_C "DFES/Fehlertyp Zuordnung für Prüfung DFC_EGRVlvHBrgOvrTemp" VALUE 0x8002A654 Val_Wu8 255.0 DFES_OneToOne 0.00 255.0 /end CHARACTERISTIC
/begin CHARACTERISTIC DFES_FaultTyp.DFC_EGRVlvHBrgShCirBatt1_C "DFES/Fehlertyp Zuordnung für Prüfung DFC_EGRVlvHBrgShCirBatt1" VALUE 0x8002A655 Val_Wu8 255.0 DFES_OneToOne 0.00 255.0 /end CHARACTERISTIC
/begin CHARACTERISTIC DFES_FaultTyp.DFC_EGRVlvHBrgShCirBatt2_C "DFES/Fehlertyp Zuordnung für Prüfung DFC_EGRVlvHBrgShCirBatt2" VALUE 0x8002A656 Val_Wu8 255.0 DFES_OneToOne 0.00 255.0 /end CHARACTERISTIC
/begin CHARACTERISTIC DFES_FaultTyp.DFC_EGRVlvHBrgShCirGnd1_C "DFES/Fehlertyp Zuordnung für Prüfung DFC_EGRVlvHBrgShCirGnd1" VALUE 0x8002A657 Val_Wu8 255.0 DFES_OneToOne 0.00 255.0 /end CHARACTERISTIC
/begin CHARACTERISTIC DFES_FaultTyp.DFC_EGRVlvHBrgShCirGnd2_C "DFES/Fehlertyp Zuordnung für Prüfung DFC_EGRVlvHBrgShCirGnd2" VALUE 0x8002A658 Val_Wu8 255.0 DFES_OneToOne 0.00 255.0 /end CHARACTERISTIC
/begin CHARACTERISTIC DFES_FaultTyp.DFC_EGRVlvHBrgShCirOvrLd_C "DFES/Fehlertyp Zuordnung für Prüfung DFC_EGRVlvHBrgShCirOvrLd" VALUE 0x8002A659 Val_Wu8 255.0 DFES_OneToOne 0.00 255.0 /end CHARACTERISTIC
/begin CHARACTERISTIC DFES_FaultTyp.DFC_EGRVlvHBrgTempOvrCurr_C "DFES/Fehlertyp Zuordnung für Prüfung DFC_EGRVlvHBrgTempOvrCurr" VALUE 0x8002A65A Val_Wu8 255.0 DFES_OneToOne 0.00 255.0 /end CHARACTERISTIC
/begin CHARACTERISTIC DFES_FaultTyp.DFC_EGRVlvHBrgUndrVltg_C "DFES/Fehlertyp Zuordnung für Prüfung DFC_EGRVlvHBrgUndrVltg" VALUE 0x8002A65B Val_Wu8 255.0 DFES_OneToOne 0.00 255.0 /end CHARACTERISTIC
/begin CHARACTERISTIC DFES_FaultTyp.DFC_EGRVlvLPGovDvtMax_C "DFES/Fehlertyp Zuordnung für Prüfung DFC_EGRVlvLPGovDvtMax" VALUE 0x8002A65C Val_Wu8 255.0 DFES_OneToOne 0.00 255.0 /end CHARACTERISTIC
/begin CHARACTERISTIC DFES_FaultTyp.DFC_EGRVlvLPGovDvtMin_C "DFES/Fehlertyp Zuordnung für Prüfung DFC_EGRVlvLPGovDvtMin" VALUE 0x8002A65D Val_Wu8 255.0 DFES_OneToOne 0.00 255.0 /end CHARACTERISTIC
/begin CHARACTERISTIC DFES_FaultTyp.DFC_EGRVlvLPHBrgOpnLd_C "DFES/Fehlertyp Zuordnung für Prüfung DFC_EGRVlvLPHBrgOpnLd" VALUE 0x8002A65E Val_Wu8 255.0 DFES_OneToOne 0.00 255.0 /end CHARACTERISTIC
/begin CHARACTERISTIC DFES_FaultTyp.DFC_EGRVlvLPHBrgOvrCurr_C "DFES/Fehlertyp Zuordnung für Prüfung DFC_EGRVlvLPHBrgOvrCurr" VALUE 0x8002A65F Val_Wu8 255.0 DFES_OneToOne 0.00 255.0 /end CHARACTERISTIC
/begin CHARACTERISTIC DFES_FaultTyp.DFC_EGRVlvLPHBrgOvrTemp_C "DFES/Fehlertyp Zuordnung für Prüfung DFC_EGRVlvLPHBrgOvrTemp" VALUE 0x8002A660 Val_Wu8 255.0 DFES_OneToOne 0.00 255.0 /end CHARACTERISTIC
/begin CHARACTERISTIC DFES_FaultTyp.DFC_EGRVlvLPHBrgShCirBatt1_C "DFES/Fehlertyp Zuordnung für Prüfung DFC_EGRVlvLPHBrgShCirBatt1" VALUE 0x8002A661 Val_Wu8 255.0 DFES_OneToOne 0.00 255.0 /end CHARACTERISTIC
/begin CHARACTERISTIC DFES_FaultTyp.DFC_EGRVlvLPHBrgShCirBatt2_C "DFES/Fehlertyp Zuordnung für Prüfung DFC_EGRVlvLPHBrgShCirBatt2" VALUE 0x8002A662 Val_Wu8 255.0 DFES_OneToOne 0.00 255.0 /end CHARACTERISTIC
/begin CHARACTERISTIC DFES_FaultTyp.DFC_EGRVlvLPHBrgShCirGnd1_C "DFES/Fehlertyp Zuordnung für Prüfung DFC_EGRVlvLPHBrgShCirGnd1" VALUE 0x8002A663 Val_Wu8 255.0 DFES_OneToOne 0.00 255.0 /end CHARACTERISTIC
/begin CHARACTERISTIC DFES_FaultTyp.DFC_EGRVlvLPHBrgShCirGnd2_C "DFES/Fehlertyp Zuordnung für Prüfung DFC_EGRVlvLPHBrgShCirGnd2" VALUE 0x8002A664 Val_Wu8 255.0 DFES_OneToOne 0.00 255.0 /end CHARACTERISTIC
/begin CHARACTERISTIC DFES_FaultTyp.DFC_EGRVlvLPHBrgShCirOvrLd_C "DFES/Fehlertyp Zuordnung für Prüfung DFC_EGRVlvLPHBrgShCirOvrLd" VALUE 0x8002A665 Val_Wu8 255.0 DFES_OneToOne 0.00 255.0 /end CHARACTERISTIC
/begin CHARACTERISTIC DFES_FaultTyp.DFC_EGRVlvLPHBrgTempOvrCurr_C "DFES/Fehlertyp Zuordnung für Prüfung DFC_EGRVlvLPHBrgTempOvrCurr" VALUE 0x8002A666 Val_Wu8 255.0 DFES_OneToOne 0.00 255.0 /end CHARACTERISTIC
/begin CHARACTERISTIC DFES_FaultTyp.DFC_EGRVlvLPHBrgUndrVltg_C "DFES/Fehlertyp Zuordnung für Prüfung DFC_EGRVlvLPHBrgUndrVltg" VALUE 0x8002A667 Val_Wu8 255.0 DFES_OneToOne 0.00 255.0 /end CHARACTERISTIC
/begin CHARACTERISTIC DFES_FaultTyp.DFC_EGRVlvLPOL_C "DFES/Fehlertyp Zuordnung für Prüfung DFC_EGRVlvLPOL" VALUE 0x8002A668 Val_Wu8 255.0 DFES_OneToOne 0.00 255.0 /end CHARACTERISTIC
/begin CHARACTERISTIC DFES_FaultTyp.DFC_EGRVlvLPSCB_C "DFES/Fehlertyp Zuordnung für Prüfung DFC_EGRVlvLPSCB" VALUE 0x8002A669 Val_Wu8 255.0 DFES_OneToOne 0.00 255.0 /end CHARACTERISTIC
/begin CHARACTERISTIC DFES_FaultTyp.DFC_EGRVlvLPSCG_C "DFES/Fehlertyp Zuordnung für Prüfung DFC_EGRVlvLPSCG" VALUE 0x8002A66A Val_Wu8 255.0 DFES_OneToOne 0.00 255.0 /end CHARACTERISTIC
/begin CHARACTERISTIC DFES_FaultTyp.DFC_EGRVlvLPSRCMax_C "DFES/Fehlertyp Zuordnung für Prüfung DFC_EGRVlvLPSRCMax" VALUE 0x8002A66B Val_Wu8 255.0 DFES_OneToOne 0.00 255.0 /end CHARACTERISTIC
/begin CHARACTERISTIC DFES_FaultTyp.DFC_EGRVlvLPSRCMin_C "DFES/Fehlertyp Zuordnung für Prüfung DFC_EGRVlvLPSRCMin" VALUE 0x8002A66C Val_Wu8 255.0 DFES_OneToOne 0.00 255.0 /end CHARACTERISTIC
/begin CHARACTERISTIC DFES_FaultTyp.DFC_EGRVlvOL_C "DFES/Fehlertyp Zuordnung für Prüfung DFC_EGRVlvOL" VALUE 0x8002A66D Val_Wu8 255.0 DFES_OneToOne 0.00 255.0 /end CHARACTERISTIC
/begin CHARACTERISTIC DFES_FaultTyp.DFC_EGRVlvSCB_C "DFES/Fehlertyp Zuordnung für Prüfung DFC_EGRVlvSCB" VALUE 0x8002A66E Val_Wu8 255.0 DFES_OneToOne 0.00 255.0 /end CHARACTERISTIC
/begin CHARACTERISTIC DFES_FaultTyp.DFC_EGRVlvSCG_C "DFES/Fehlertyp Zuordnung für Prüfung DFC_EGRVlvSCG" VALUE 0x8002A66F Val_Wu8 255.0 DFES_OneToOne 0.00 255.0 /end CHARACTERISTIC
/begin CHARACTERISTIC DFES_FaultTyp.DFC_EGRVlvSRCMax_C "DFES/Fehlertyp Zuordnung für Prüfung DFC_EGRVlvSRCMax" VALUE 0x8002A670 Val_Wu8 255.0 DFES_OneToOne 0.00 255.0 /end CHARACTERISTIC
/begin CHARACTERISTIC DFES_FaultTyp.DFC_EGRVlvSRCMin_C "DFES/Fehlertyp Zuordnung für Prüfung DFC_EGRVlvSRCMin" VALUE 0x8002A671 Val_Wu8 255.0 DFES_OneToOne 0.00 255.0 /end CHARACTERISTIC
/begin CHARACTERISTIC DFES_FaultTyp.DFC_EngPrtOvrSpd_C "DFES/Fehlertyp Zuordnung für Prüfung DFC_EngPrtOvrSpd" VALUE 0x8002A672 Val_Wu8 255.0 DFES_OneToOne 0.00 255.0 /end CHARACTERISTIC
/begin CHARACTERISTIC DFES_FaultTyp.DFC_EngSpdOL_C "DFES/Fehlertyp Zuordnung für Prüfung DFC_EngSpdOL" VALUE 0x8002A673 Val_Wu8 255.0 DFES_OneToOne 0.00 255.0 /end CHARACTERISTIC
/begin CHARACTERISTIC DFES_FaultTyp.DFC_EngSpdSCB_C "DFES/Fehlertyp Zuordnung für Prüfung DFC_EngSpdSCB" VALUE 0x8002A674 Val_Wu8 255.0 DFES_OneToOne 0.00 255.0 /end CHARACTERISTIC
/begin CHARACTERISTIC DFES_FaultTyp.DFC_EngSpdSCG_C "DFES/Fehlertyp Zuordnung für Prüfung DFC_EngSpdSCG" VALUE 0x8002A675 Val_Wu8 255.0 DFES_OneToOne 0.00 255.0 /end CHARACTERISTIC
/begin CHARACTERISTIC DFES_FaultTyp.DFC_EnhSRCMaxPPFltDiff_C "DFES/Fehlertyp Zuordnung für Prüfung DFC_EnhSRCMaxPPFltDiff" VALUE 0x8002A676 Val_Wu8 255.0 DFES_OneToOne 0.00 255.0 /end CHARACTERISTIC
/begin CHARACTERISTIC DFES_FaultTyp.DFC_EnhSRCMaxT1ExhTMon_C "DFES/Fehlertyp Zuordnung für Prüfung DFC_EnhSRCMaxT1ExhTMon" VALUE 0x8002A677 Val_Wu8 255.0 DFES_OneToOne 0.00 255.0 /end CHARACTERISTIC
/begin CHARACTERISTIC DFES_FaultTyp.DFC_EnhSRCMaxT2ExhTMon_C "DFES/Fehlertyp Zuordnung für Prüfung DFC_EnhSRCMaxT2ExhTMon" VALUE 0x8002A678 Val_Wu8 255.0 DFES_OneToOne 0.00 255.0 /end CHARACTERISTIC
/begin CHARACTERISTIC DFES_FaultTyp.DFC_EnhSRCMaxT3ExhTMon_C "DFES/Fehlertyp Zuordnung für Prüfung DFC_EnhSRCMaxT3ExhTMon" VALUE 0x8002A679 Val_Wu8 255.0 DFES_OneToOne 0.00 255.0 /end CHARACTERISTIC
/begin CHARACTERISTIC DFES_FaultTyp.DFC_EnhSRCMinPPFltDiff_C "DFES/Fehlertyp Zuordnung für Prüfung DFC_EnhSRCMinPPFltDiff" VALUE 0x8002A67A Val_Wu8 255.0 DFES_OneToOne 0.00 255.0 /end CHARACTERISTIC
/begin CHARACTERISTIC DFES_FaultTyp.DFC_EnhSRCMinT1ExhTMon_C "DFES/Fehlertyp Zuordnung für Prüfung DFC_EnhSRCMinT1ExhTMon" VALUE 0x8002A67B Val_Wu8 255.0 DFES_OneToOne 0.00 255.0 /end CHARACTERISTIC
/begin CHARACTERISTIC DFES_FaultTyp.DFC_EnhSRCMinT2ExhTMon_C "DFES/Fehlertyp Zuordnung für Prüfung DFC_EnhSRCMinT2ExhTMon" VALUE 0x8002A67C Val_Wu8 255.0 DFES_OneToOne 0.00 255.0 /end CHARACTERISTIC
/begin CHARACTERISTIC DFES_FaultTyp.DFC_EnhSRCMinT3ExhTMon_C "DFES/Fehlertyp Zuordnung für Prüfung DFC_EnhSRCMinT3ExhTMon" VALUE 0x8002A67D Val_Wu8 255.0 DFES_OneToOne 0.00 255.0 /end CHARACTERISTIC
/begin CHARACTERISTIC DFES_FaultTyp.DFC_EnvPSRCMax_C "DFES/Fehlertyp Zuordnung für Prüfung DFC_EnvPSRCMax" VALUE 0x8002A67E Val_Wu8 255.0 DFES_OneToOne 0.00 255.0 /end CHARACTERISTIC
/begin CHARACTERISTIC DFES_FaultTyp.DFC_EnvPSRCMin_C "DFES/Fehlertyp Zuordnung für Prüfung DFC_EnvPSRCMin" VALUE 0x8002A67F Val_Wu8 255.0 DFES_OneToOne 0.00 255.0 /end CHARACTERISTIC
/begin CHARACTERISTIC DFES_FaultTyp.DFC_ExhTMonPlaus_C "DFES/Fehlertyp Zuordnung für Prüfung DFC_ExhTMonPlaus" VALUE 0x8002A680 Val_Wu8 255.0 DFES_OneToOne 0.00 255.0 /end CHARACTERISTIC
/begin CHARACTERISTIC DFES_FaultTyp.DFC_ExhTMonPlausPos1_C "DFES/Fehlertyp Zuordnung für Prüfung DFC_ExhTMonPlausPos1" VALUE 0x8002A681 Val_Wu8 255.0 DFES_OneToOne 0.00 255.0 /end CHARACTERISTIC
/begin CHARACTERISTIC DFES_FaultTyp.DFC_ExhTMonPlausPos2_C "DFES/Fehlertyp Zuordnung für Prüfung DFC_ExhTMonPlausPos2" VALUE 0x8002A682 Val_Wu8 255.0 DFES_OneToOne 0.00 255.0 /end CHARACTERISTIC
/begin CHARACTERISTIC DFES_FaultTyp.DFC_ExhTMonPlausPos3_C "DFES/Fehlertyp Zuordnung für Prüfung DFC_ExhTMonPlausPos3" VALUE 0x8002A683 Val_Wu8 255.0 DFES_OneToOne 0.00 255.0 /end CHARACTERISTIC
/begin CHARACTERISTIC DFES_FaultTyp.DFC_ExhTMonT1Plaus_C "DFES/Fehlertyp Zuordnung für Prüfung DFC_ExhTMonT1Plaus" VALUE 0x8002A684 Val_Wu8 255.0 DFES_OneToOne 0.00 255.0 /end CHARACTERISTIC
/begin CHARACTERISTIC DFES_FaultTyp.DFC_ExhTMonT2Plaus_C "DFES/Fehlertyp Zuordnung für Prüfung DFC_ExhTMonT2Plaus" VALUE 0x8002A685 Val_Wu8 255.0 DFES_OneToOne 0.00 255.0 /end CHARACTERISTIC
/begin CHARACTERISTIC DFES_FaultTyp.DFC_ExhTMonT3Plaus_C "DFES/Fehlertyp Zuordnung für Prüfung DFC_ExhTMonT3Plaus" VALUE 0x8002A686 Val_Wu8 255.0 DFES_OneToOne 0.00 255.0 /end CHARACTERISTIC
/begin CHARACTERISTIC DFES_FaultTyp.DFC_FlFltDsPSRCMax_C "DFES/Fehlertyp Zuordnung für Prüfung DFC_FlFltDsPSRCMax" VALUE 0x8002A687 Val_Wu8 255.0 DFES_OneToOne 0.00 255.0 /end CHARACTERISTIC
/begin CHARACTERISTIC DFES_FaultTyp.DFC_FlFltDsPSRCMin_C "DFES/Fehlertyp Zuordnung für Prüfung DFC_FlFltDsPSRCMin" VALUE 0x8002A688 Val_Wu8 255.0 DFES_OneToOne 0.00 255.0 /end CHARACTERISTIC
/begin CHARACTERISTIC DFES_FaultTyp.DFC_FlFltSig_C "DFES/Fehlertyp Zuordnung für Prüfung DFC_FlFltSig" VALUE 0x8002A689 Val_Wu8 255.0 DFES_OneToOne 0.00 255.0 /end CHARACTERISTIC
/begin CHARACTERISTIC DFES_FaultTyp.DFC_FlFltUsPSRCMax_C "DFES/Fehlertyp Zuordnung für Prüfung DFC_FlFltUsPSRCMax" VALUE 0x8002A68A Val_Wu8 255.0 DFES_OneToOne 0.00 255.0 /end CHARACTERISTIC
/begin CHARACTERISTIC DFES_FaultTyp.DFC_FlFltUsPSRCMin_C "DFES/Fehlertyp Zuordnung für Prüfung DFC_FlFltUsPSRCMin" VALUE 0x8002A68B Val_Wu8 255.0 DFES_OneToOne 0.00 255.0 /end CHARACTERISTIC
/begin CHARACTERISTIC DFES_FaultTyp.DFC_FuelTSRCMax_C "DFES/Fehlertyp Zuordnung für Prüfung DFC_FuelTSRCMax" VALUE 0x8002A68C Val_Wu8 255.0 DFES_OneToOne 0.00 255.0 /end CHARACTERISTIC
/begin CHARACTERISTIC DFES_FaultTyp.DFC_FuelTSRCMin_C "DFES/Fehlertyp Zuordnung für Prüfung DFC_FuelTSRCMin" VALUE 0x8002A68D Val_Wu8 255.0 DFES_OneToOne 0.00 255.0 /end CHARACTERISTIC
/begin CHARACTERISTIC DFES_FaultTyp.DFC_GbxNPosPPerSRCMax_C "DFES/Fehlertyp Zuordnung für Prüfung DFC_GbxNPosPPerSRCMax" VALUE 0x8002A68E Val_Wu8 255.0 DFES_OneToOne 0.00 255.0 /end CHARACTERISTIC
/begin CHARACTERISTIC DFES_FaultTyp.DFC_GbxNPosPPerSRCMin_C "DFES/Fehlertyp Zuordnung für Prüfung DFC_GbxNPosPPerSRCMin" VALUE 0x8002A68F Val_Wu8 255.0 DFES_OneToOne 0.00 255.0 /end CHARACTERISTIC
/begin CHARACTERISTIC DFES_FaultTyp.DFC_GbxNPosPdcycSRCMax_C "DFES/Fehlertyp Zuordnung für Prüfung DFC_GbxNPosPdcycSRCMax" VALUE 0x8002A690 Val_Wu8 255.0 DFES_OneToOne 0.00 255.0 /end CHARACTERISTIC
/begin CHARACTERISTIC DFES_FaultTyp.DFC_GbxNPosPdcycSRCMin_C "DFES/Fehlertyp Zuordnung für Prüfung DFC_GbxNPosPdcycSRCMin" VALUE 0x8002A691 Val_Wu8 255.0 DFES_OneToOne 0.00 255.0 /end CHARACTERISTIC
/begin CHARACTERISTIC DFES_FaultTyp.DFC_InjVlvPresMin_C "DFES/Fehlertyp Zuordnung für Prüfung DFC_InjVlvPresMin" VALUE 0x8002A692 Val_Wu8 255.0 DFES_OneToOne 0.00 255.0 /end CHARACTERISTIC
/begin CHARACTERISTIC DFES_FaultTyp.DFC_LSUCircNernstSig_C "DFES/Fehlertyp Zuordnung für Prüfung DFC_LSUCircNernstSig" VALUE 0x8002A693 Val_Wu8 255.0 DFES_OneToOne 0.00 255.0 /end CHARACTERISTIC
/begin CHARACTERISTIC DFES_FaultTyp.DFC_LSUCircPmpCurSig_C "DFES/Fehlertyp Zuordnung für Prüfung DFC_LSUCircPmpCurSig" VALUE 0x8002A694 Val_Wu8 255.0 DFES_OneToOne 0.00 255.0 /end CHARACTERISTIC
/begin CHARACTERISTIC DFES_FaultTyp.DFC_LSUCircVirtGndSig_C "DFES/Fehlertyp Zuordnung für Prüfung DFC_LSUCircVirtGndSig" VALUE 0x8002A695 Val_Wu8 255.0 DFES_OneToOne 0.00 255.0 /end CHARACTERISTIC
/begin CHARACTERISTIC DFES_FaultTyp.DFC_LSUO2Max_C "DFES/Fehlertyp Zuordnung für Prüfung DFC_LSUO2Max" VALUE 0x8002A696 Val_Wu8 255.0 DFES_OneToOne 0.00 255.0 /end CHARACTERISTIC
/begin CHARACTERISTIC DFES_FaultTyp.DFC_LSUO2Min_C "DFES/Fehlertyp Zuordnung für Prüfung DFC_LSUO2Min" VALUE 0x8002A697 Val_Wu8 255.0 DFES_OneToOne 0.00 255.0 /end CHARACTERISTIC
/begin CHARACTERISTIC DFES_FaultTyp.DFC_LSUSPIBattLowMin_C "DFES/Fehlertyp Zuordnung für Prüfung DFC_LSUSPIBattLowMin" VALUE 0x8002A698 Val_Wu8 255.0 DFES_OneToOne 0.00 255.0 /end CHARACTERISTIC
/begin CHARACTERISTIC DFES_FaultTyp.DFC_LSUWireSCB_C "DFES/Fehlertyp Zuordnung für Prüfung DFC_LSUWireSCB" VALUE 0x8002A699 Val_Wu8 255.0 DFES_OneToOne 0.00 255.0 /end CHARACTERISTIC
/begin CHARACTERISTIC DFES_FaultTyp.DFC_LSUWireSCG_C "DFES/Fehlertyp Zuordnung für Prüfung DFC_LSUWireSCG" VALUE 0x8002A69A Val_Wu8 255.0 DFES_OneToOne 0.00 255.0 /end CHARACTERISTIC
/begin CHARACTERISTIC DFES_FaultTyp.DFC_MeUnSCG_C "DFES/Fehlertyp Zuordnung für Prüfung DFC_MeUnSCG" VALUE 0x8002A69B Val_Wu8 255.0 DFES_OneToOne 0.00 255.0 /end CHARACTERISTIC
/begin CHARACTERISTIC DFES_FaultTyp.DFC_NSCDsCmpChk_C "DFES/Fehlertyp Zuordnung für Prüfung DFC_NSCDsCmpChk" VALUE 0x8002A69C Val_Wu8 255.0 DFES_OneToOne 0.00 255.0 /end CHARACTERISTIC
/begin CHARACTERISTIC DFES_FaultTyp.DFC_NSCDsLamBinSRCMax_C "DFES/Fehlertyp Zuordnung für Prüfung DFC_NSCDsLamBinSRCMax" VALUE 0x8002A69D Val_Wu8 255.0 DFES_OneToOne 0.00 255.0 /end CHARACTERISTIC
/begin CHARACTERISTIC DFES_FaultTyp.DFC_NSCDsLamBinSRCMin_C "DFES/Fehlertyp Zuordnung für Prüfung DFC_NSCDsLamBinSRCMin" VALUE 0x8002A69E Val_Wu8 255.0 DFES_OneToOne 0.00 255.0 /end CHARACTERISTIC
/begin CHARACTERISTIC DFES_FaultTyp.DFC_NSCDsLamLinSRCMax_C "DFES/Fehlertyp Zuordnung für Prüfung DFC_NSCDsLamLinSRCMax" VALUE 0x8002A69F Val_Wu8 255.0 DFES_OneToOne 0.00 255.0 /end CHARACTERISTIC
/begin CHARACTERISTIC DFES_FaultTyp.DFC_NSCDsLamLinSRCMin_C "DFES/Fehlertyp Zuordnung für Prüfung DFC_NSCDsLamLinSRCMin" VALUE 0x8002A6A0 Val_Wu8 255.0 DFES_OneToOne 0.00 255.0 /end CHARACTERISTIC
/begin CHARACTERISTIC DFES_FaultTyp.DFC_NSCDsLamPlausMax_C "DFES/Fehlertyp Zuordnung für Prüfung DFC_NSCDsLamPlausMax" VALUE 0x8002A6A1 Val_Wu8 255.0 DFES_OneToOne 0.00 255.0 /end CHARACTERISTIC
/begin CHARACTERISTIC DFES_FaultTyp.DFC_NSCDsLamPlausMin_C "DFES/Fehlertyp Zuordnung für Prüfung DFC_NSCDsLamPlausMin" VALUE 0x8002A6A2 Val_Wu8 255.0 DFES_OneToOne 0.00 255.0 /end CHARACTERISTIC
/begin CHARACTERISTIC DFES_FaultTyp.DFC_NSCDsNOxSRCMax_C "DFES/Fehlertyp Zuordnung für Prüfung DFC_NSCDsNOxSRCMax" VALUE 0x8002A6A3 Val_Wu8 255.0 DFES_OneToOne 0.00 255.0 /end CHARACTERISTIC
/begin CHARACTERISTIC DFES_FaultTyp.DFC_NSCDsNOxSRCMin_C "DFES/Fehlertyp Zuordnung für Prüfung DFC_NSCDsNOxSRCMin" VALUE 0x8002A6A4 Val_Wu8 255.0 DFES_OneToOne 0.00 255.0 /end CHARACTERISTIC
/begin CHARACTERISTIC DFES_FaultTyp.DFC_NSCDsOpCir_C "DFES/Fehlertyp Zuordnung für Prüfung DFC_NSCDsOpCir" VALUE 0x8002A6A5 Val_Wu8 255.0 DFES_OneToOne 0.00 255.0 /end CHARACTERISTIC
/begin CHARACTERISTIC DFES_FaultTyp.DFC_NSCDsShCir_C "DFES/Fehlertyp Zuordnung für Prüfung DFC_NSCDsShCir" VALUE 0x8002A6A6 Val_Wu8 255.0 DFES_OneToOne 0.00 255.0 /end CHARACTERISTIC
/begin CHARACTERISTIC DFES_FaultTyp.DFC_NoCat2DsCmpChk_C "DFES/Fehlertyp Zuordnung für Prüfung DFC_NoCat2DsCmpChk" VALUE 0x8002A6A7 Val_Wu8 255.0 DFES_OneToOne 0.00 255.0 /end CHARACTERISTIC
/begin CHARACTERISTIC DFES_FaultTyp.DFC_NoCat2DsLamBinSRCMax_C "DFES/Fehlertyp Zuordnung für Prüfung DFC_NoCat2DsLamBinSRCMax" VALUE 0x8002A6A8 Val_Wu8 255.0 DFES_OneToOne 0.00 255.0 /end CHARACTERISTIC
/begin CHARACTERISTIC DFES_FaultTyp.DFC_NoCat2DsLamBinSRCMin_C "DFES/Fehlertyp Zuordnung für Prüfung DFC_NoCat2DsLamBinSRCMin" VALUE 0x8002A6A9 Val_Wu8 255.0 DFES_OneToOne 0.00 255.0 /end CHARACTERISTIC
/begin CHARACTERISTIC DFES_FaultTyp.DFC_NoCat2DsLamLinSRCMax_C "DFES/Fehlertyp Zuordnung für Prüfung DFC_NoCat2DsLamLinSRCMax" VALUE 0x8002A6AA Val_Wu8 255.0 DFES_OneToOne 0.00 255.0 /end CHARACTERISTIC
/begin CHARACTERISTIC DFES_FaultTyp.DFC_NoCat2DsLamLinSRCMin_C "DFES/Fehlertyp Zuordnung für Prüfung DFC_NoCat2DsLamLinSRCMin" VALUE 0x8002A6AB Val_Wu8 255.0 DFES_OneToOne 0.00 255.0 /end CHARACTERISTIC
/begin CHARACTERISTIC DFES_FaultTyp.DFC_NoCat2DsLamPlausMax_C "DFES/Fehlertyp Zuordnung für Prüfung DFC_NoCat2DsLamPlausMax" VALUE 0x8002A6AC Val_Wu8 255.0 DFES_OneToOne 0.00 255.0 /end CHARACTERISTIC
/begin CHARACTERISTIC DFES_FaultTyp.DFC_NoCat2DsLamPlausMin_C "DFES/Fehlertyp Zuordnung für Prüfung DFC_NoCat2DsLamPlausMin" VALUE 0x8002A6AD Val_Wu8 255.0 DFES_OneToOne 0.00 255.0 /end CHARACTERISTIC
/begin CHARACTERISTIC DFES_FaultTyp.DFC_NoCat2DsNOxSRCMax_C "DFES/Fehlertyp Zuordnung für Prüfung DFC_NoCat2DsNOxSRCMax" VALUE 0x8002A6AE Val_Wu8 255.0 DFES_OneToOne 0.00 255.0 /end CHARACTERISTIC
/begin CHARACTERISTIC DFES_FaultTyp.DFC_NoCat2DsNOxSRCMin_C "DFES/Fehlertyp Zuordnung für Prüfung DFC_NoCat2DsNOxSRCMin" VALUE 0x8002A6AF Val_Wu8 255.0 DFES_OneToOne 0.00 255.0 /end CHARACTERISTIC
/begin CHARACTERISTIC DFES_FaultTyp.DFC_NoCat2DsOpCir_C "DFES/Fehlertyp Zuordnung für Prüfung DFC_NoCat2DsOpCir" VALUE 0x8002A6B0 Val_Wu8 255.0 DFES_OneToOne 0.00 255.0 /end CHARACTERISTIC
/begin CHARACTERISTIC DFES_FaultTyp.DFC_NoCat2DsShCir_C "DFES/Fehlertyp Zuordnung für Prüfung DFC_NoCat2DsShCir" VALUE 0x8002A6B1 Val_Wu8 255.0 DFES_OneToOne 0.00 255.0 /end CHARACTERISTIC
/begin CHARACTERISTIC DFES_FaultTyp.DFC_NplDynPPFltDiff_C "DFES/Fehlertyp Zuordnung für Prüfung DFC_NplDynPPFltDiff" VALUE 0x8002A6B2 Val_Wu8 255.0 DFES_OneToOne 0.00 255.0 /end CHARACTERISTIC
/begin CHARACTERISTIC DFES_FaultTyp.DFC_NplHsChngPPFltDiff_C "DFES/Fehlertyp Zuordnung für Prüfung DFC_NplHsChngPPFltDiff" VALUE 0x8002A6B3 Val_Wu8 255.0 DFES_OneToOne 0.00 255.0 /end CHARACTERISTIC
/begin CHARACTERISTIC DFES_FaultTyp.DFC_NplHsLnPPFltDiff_C "DFES/Fehlertyp Zuordnung für Prüfung DFC_NplHsLnPPFltDiff" VALUE 0x8002A6B4 Val_Wu8 255.0 DFES_OneToOne 0.00 255.0 /end CHARACTERISTIC
/begin CHARACTERISTIC DFES_FaultTyp.DFC_NplTOxiCatUs_C "DFES/Fehlertyp Zuordnung für Prüfung DFC_NplTOxiCatUs" VALUE 0x8002A6B5 Val_Wu8 255.0 DFES_OneToOne 0.00 255.0 /end CHARACTERISTIC
/begin CHARACTERISTIC DFES_FaultTyp.DFC_NplTPFltUs_C "DFES/Fehlertyp Zuordnung für Prüfung DFC_NplTPFltUs" VALUE 0x8002A6B6 Val_Wu8 255.0 DFES_OneToOne 0.00 255.0 /end CHARACTERISTIC
/begin CHARACTERISTIC DFES_FaultTyp.DFC_NplTTrbnUs_C "DFES/Fehlertyp Zuordnung für Prüfung DFC_NplTTrbnUs" VALUE 0x8002A6B7 Val_Wu8 255.0 DFES_OneToOne 0.00 255.0 /end CHARACTERISTIC
/begin CHARACTERISTIC DFES_FaultTyp.DFC_OilPSwmpSRCMax_C "DFES/Fehlertyp Zuordnung für Prüfung DFC_OilPSwmpSRCMax" VALUE 0x8002A6B8 Val_Wu8 255.0 DFES_OneToOne 0.00 255.0 /end CHARACTERISTIC
/begin CHARACTERISTIC DFES_FaultTyp.DFC_OilPSwmpSRCMin_C "DFES/Fehlertyp Zuordnung für Prüfung DFC_OilPSwmpSRCMin" VALUE 0x8002A6B9 Val_Wu8 255.0 DFES_OneToOne 0.00 255.0 /end CHARACTERISTIC
/begin CHARACTERISTIC DFES_FaultTyp.DFC_PCVSCG_C "DFES/Fehlertyp Zuordnung für Prüfung DFC_PCVSCG" VALUE 0x8002A6BA Val_Wu8 255.0 DFES_OneToOne 0.00 255.0 /end CHARACTERISTIC
/begin CHARACTERISTIC DFES_FaultTyp.DFC_PFltCharPDiffMin_C "DFES/Fehlertyp Zuordnung für Prüfung DFC_PFltCharPDiffMin" VALUE 0x8002A6BB Val_Wu8 255.0 DFES_OneToOne 0.00 255.0 /end CHARACTERISTIC
/begin CHARACTERISTIC DFES_FaultTyp.DFC_PFltDstrMin_C "DFES/Fehlertyp Zuordnung für Prüfung DFC_PFltDstrMin" VALUE 0x8002A6BC Val_Wu8 255.0 DFES_OneToOne 0.00 255.0 /end CHARACTERISTIC
/begin CHARACTERISTIC DFES_FaultTyp.DFC_PFltEngPrt_C "DFES/Fehlertyp Zuordnung für Prüfung DFC_PFltEngPrt" VALUE 0x8002A6BD Val_Wu8 255.0 DFES_OneToOne 0.00 255.0 /end CHARACTERISTIC
/begin CHARACTERISTIC DFES_FaultTyp.DFC_PFltRgnPerm_C "DFES/Fehlertyp Zuordnung für Prüfung DFC_PFltRgnPerm" VALUE 0x8002A6BE Val_Wu8 255.0 DFES_OneToOne 0.00 255.0 /end CHARACTERISTIC
/begin CHARACTERISTIC DFES_FaultTyp.DFC_PFltSRCMaxFlwRstn_C "DFES/Fehlertyp Zuordnung für Prüfung DFC_PFltSRCMaxFlwRstn" VALUE 0x8002A6BF Val_Wu8 255.0 DFES_OneToOne 0.00 255.0 /end CHARACTERISTIC
/begin CHARACTERISTIC DFES_FaultTyp.DFC_PFltSRCMinFlwRstn_C "DFES/Fehlertyp Zuordnung für Prüfung DFC_PFltSRCMinFlwRstn" VALUE 0x8002A6C0 Val_Wu8 255.0 DFES_OneToOne 0.00 255.0 /end CHARACTERISTIC
/begin CHARACTERISTIC DFES_FaultTyp.DFC_PFltSotMsDvtMax_C "DFES/Fehlertyp Zuordnung für Prüfung DFC_PFltSotMsDvtMax" VALUE 0x8002A6C1 Val_Wu8 255.0 DFES_OneToOne 0.00 255.0 /end CHARACTERISTIC
/begin CHARACTERISTIC DFES_FaultTyp.DFC_PFltSotMsDvtMin_C "DFES/Fehlertyp Zuordnung für Prüfung DFC_PFltSotMsDvtMin" VALUE 0x8002A6C2 Val_Wu8 255.0 DFES_OneToOne 0.00 255.0 /end CHARACTERISTIC
/begin CHARACTERISTIC DFES_FaultTyp.DFC_PFltSotMsMax_C "DFES/Fehlertyp Zuordnung für Prüfung DFC_PFltSotMsMax" VALUE 0x8002A6C3 Val_Wu8 255.0 DFES_OneToOne 0.00 255.0 /end CHARACTERISTIC
/begin CHARACTERISTIC DFES_FaultTyp.DFC_PIntkVUsSRCMax_C "DFES/Fehlertyp Zuordnung für Prüfung DFC_PIntkVUsSRCMax" VALUE 0x8002A6C4 Val_Wu8 255.0 DFES_OneToOne 0.00 255.0 /end CHARACTERISTIC
/begin CHARACTERISTIC DFES_FaultTyp.DFC_PIntkVUsSRCMin_C "DFES/Fehlertyp Zuordnung für Prüfung DFC_PIntkVUsSRCMin" VALUE 0x8002A6C5 Val_Wu8 255.0 DFES_OneToOne 0.00 255.0 /end CHARACTERISTIC
/begin CHARACTERISTIC DFES_FaultTyp.DFC_SRCHighAPP1_C "DFES/Fehlertyp Zuordnung für Prüfung DFC_SRCHighAPP1" VALUE 0x8002A6C6 Val_Wu8 255.0 DFES_OneToOne 0.00 255.0 /end CHARACTERISTIC
/begin CHARACTERISTIC DFES_FaultTyp.DFC_SRCHighAPP2_C "DFES/Fehlertyp Zuordnung für Prüfung DFC_SRCHighAPP2" VALUE 0x8002A6C7 Val_Wu8 255.0 DFES_OneToOne 0.00 255.0 /end CHARACTERISTIC
/begin CHARACTERISTIC DFES_FaultTyp.DFC_SRCLowAPP1_C "DFES/Fehlertyp Zuordnung für Prüfung DFC_SRCLowAPP1" VALUE 0x8002A6C8 Val_Wu8 255.0 DFES_OneToOne 0.00 255.0 /end CHARACTERISTIC
/begin CHARACTERISTIC DFES_FaultTyp.DFC_SRCLowAPP2_C "DFES/Fehlertyp Zuordnung für Prüfung DFC_SRCLowAPP2" VALUE 0x8002A6C9 Val_Wu8 255.0 DFES_OneToOne 0.00 255.0 /end CHARACTERISTIC
/begin CHARACTERISTIC DFES_FaultTyp.DFC_SRCMaxPPFltDiff_C "DFES/Fehlertyp Zuordnung für Prüfung DFC_SRCMaxPPFltDiff" VALUE 0x8002A6CA Val_Wu8 255.0 DFES_OneToOne 0.00 255.0 /end CHARACTERISTIC
/begin CHARACTERISTIC DFES_FaultTyp.DFC_SRCMaxPPFltUs_C "DFES/Fehlertyp Zuordnung für Prüfung DFC_SRCMaxPPFltUs" VALUE 0x8002A6CB Val_Wu8 255.0 DFES_OneToOne 0.00 255.0 /end CHARACTERISTIC
/begin CHARACTERISTIC DFES_FaultTyp.DFC_SRCMaxTECU_C "DFES/Fehlertyp Zuordnung für Prüfung DFC_SRCMaxTECU" VALUE 0x8002A6CC Val_Wu8 255.0 DFES_OneToOne 0.00 255.0 /end CHARACTERISTIC
/begin CHARACTERISTIC DFES_FaultTyp.DFC_SRCMaxTOxiCatUs_C "DFES/Fehlertyp Zuordnung für Prüfung DFC_SRCMaxTOxiCatUs" VALUE 0x8002A6CD Val_Wu8 255.0 DFES_OneToOne 0.00 255.0 /end CHARACTERISTIC
/begin CHARACTERISTIC DFES_FaultTyp.DFC_SRCMaxTPFltUs_C "DFES/Fehlertyp Zuordnung für Prüfung DFC_SRCMaxTPFltUs" VALUE 0x8002A6CE Val_Wu8 255.0 DFES_OneToOne 0.00 255.0 /end CHARACTERISTIC
/begin CHARACTERISTIC DFES_FaultTyp.DFC_SRCMaxTTrbnUs_C "DFES/Fehlertyp Zuordnung für Prüfung DFC_SRCMaxTTrbnUs" VALUE 0x8002A6CF Val_Wu8 255.0 DFES_OneToOne 0.00 255.0 /end CHARACTERISTIC
/begin CHARACTERISTIC DFES_FaultTyp.DFC_SRCMaxUCatUsT_C "DFES/Fehlertyp Zuordnung für Prüfung DFC_SRCMaxUCatUsT" VALUE 0x8002A6D0 Val_Wu8 255.0 DFES_OneToOne 0.00 255.0 /end CHARACTERISTIC
/begin CHARACTERISTIC DFES_FaultTyp.DFC_SRCMaxUPmpP_C "DFES/Fehlertyp Zuordnung für Prüfung DFC_SRCMaxUPmpP" VALUE 0x8002A6D1 Val_Wu8 255.0 DFES_OneToOne 0.00 255.0 /end CHARACTERISTIC
/begin CHARACTERISTIC DFES_FaultTyp.DFC_SRCMinPPFltDiff_C "DFES/Fehlertyp Zuordnung für Prüfung DFC_SRCMinPPFltDiff" VALUE 0x8002A6D2 Val_Wu8 255.0 DFES_OneToOne 0.00 255.0 /end CHARACTERISTIC
/begin CHARACTERISTIC DFES_FaultTyp.DFC_SRCMinPPFltUs_C "DFES/Fehlertyp Zuordnung für Prüfung DFC_SRCMinPPFltUs" VALUE 0x8002A6D3 Val_Wu8 255.0 DFES_OneToOne 0.00 255.0 /end CHARACTERISTIC
/begin CHARACTERISTIC DFES_FaultTyp.DFC_SRCMinTECU_C "DFES/Fehlertyp Zuordnung für Prüfung DFC_SRCMinTECU" VALUE 0x8002A6D4 Val_Wu8 255.0 DFES_OneToOne 0.00 255.0 /end CHARACTERISTIC
/begin CHARACTERISTIC DFES_FaultTyp.DFC_SRCMinTOxiCatUs_C "DFES/Fehlertyp Zuordnung für Prüfung DFC_SRCMinTOxiCatUs" VALUE 0x8002A6D5 Val_Wu8 255.0 DFES_OneToOne 0.00 255.0 /end CHARACTERISTIC
/begin CHARACTERISTIC DFES_FaultTyp.DFC_SRCMinTPFltUs_C "DFES/Fehlertyp Zuordnung für Prüfung DFC_SRCMinTPFltUs" VALUE 0x8002A6D6 Val_Wu8 255.0 DFES_OneToOne 0.00 255.0 /end CHARACTERISTIC
/begin CHARACTERISTIC DFES_FaultTyp.DFC_SRCMinTTrbnUs_C "DFES/Fehlertyp Zuordnung für Prüfung DFC_SRCMinTTrbnUs" VALUE 0x8002A6D7 Val_Wu8 255.0 DFES_OneToOne 0.00 255.0 /end CHARACTERISTIC
/begin CHARACTERISTIC DFES_FaultTyp.DFC_SRCMinUCatUsT_C "DFES/Fehlertyp Zuordnung für Prüfung DFC_SRCMinUCatUsT" VALUE 0x8002A6D8 Val_Wu8 255.0 DFES_OneToOne 0.00 255.0 /end CHARACTERISTIC
/begin CHARACTERISTIC DFES_FaultTyp.DFC_SRCMinUPmpP_C "DFES/Fehlertyp Zuordnung für Prüfung DFC_SRCMinUPmpP" VALUE 0x8002A6D9 Val_Wu8 255.0 DFES_OneToOne 0.00 255.0 /end CHARACTERISTIC
/begin CHARACTERISTIC DFES_FaultTyp.DFC_SigUCatUsT_C "DFES/Fehlertyp Zuordnung für Prüfung DFC_SigUCatUsT" VALUE 0x8002A6DA Val_Wu8 255.0 DFES_OneToOne 0.00 255.0 /end CHARACTERISTIC
/begin CHARACTERISTIC DFES_FaultTyp.DFC_SigUPmpP_C "DFES/Fehlertyp Zuordnung für Prüfung DFC_SigUPmpP" VALUE 0x8002A6DB Val_Wu8 255.0 DFES_OneToOne 0.00 255.0 /end CHARACTERISTIC
/begin CHARACTERISTIC DFES_FaultTyp.DFC_SyncAPP_C "DFES/Fehlertyp Zuordnung für Prüfung DFC_SyncAPP" VALUE 0x8002A6DC Val_Wu8 255.0 DFES_OneToOne 0.00 255.0 /end CHARACTERISTIC
/begin CHARACTERISTIC DFES_FaultTyp.DFC_T15Npl_C "DFES/Fehlertyp Zuordnung für Prüfung DFC_T15Npl" VALUE 0x8002A6DD Val_Wu8 255.0 DFES_OneToOne 0.00 255.0 /end CHARACTERISTIC
/begin CHARACTERISTIC DFES_FaultTyp.DFC_TAFSDtyCycHi_C "DFES/Fehlertyp Zuordnung für Prüfung DFC_TAFSDtyCycHi" VALUE 0x8002A6DE Val_Wu8 255.0 DFES_OneToOne 0.00 255.0 /end CHARACTERISTIC
/begin CHARACTERISTIC DFES_FaultTyp.DFC_TAFSDtyCycLo_C "DFES/Fehlertyp Zuordnung für Prüfung DFC_TAFSDtyCycLo" VALUE 0x8002A6DF Val_Wu8 255.0 DFES_OneToOne 0.00 255.0 /end CHARACTERISTIC
/begin CHARACTERISTIC DFES_FaultTyp.DFC_TAFSPerHi_C "DFES/Fehlertyp Zuordnung für Prüfung DFC_TAFSPerHi" VALUE 0x8002A6E0 Val_Wu8 255.0 DFES_OneToOne 0.00 255.0 /end CHARACTERISTIC
/begin CHARACTERISTIC DFES_FaultTyp.DFC_TAFSPerLo_C "DFES/Fehlertyp Zuordnung für Prüfung DFC_TAFSPerLo" VALUE 0x8002A6E1 Val_Wu8 255.0 DFES_OneToOne 0.00 255.0 /end CHARACTERISTIC
/begin CHARACTERISTIC DFES_FaultTyp.DFC_TCACDsSRCMax_C "DFES/Fehlertyp Zuordnung für Prüfung DFC_TCACDsSRCMax" VALUE 0x8002A6E2 Val_Wu8 255.0 DFES_OneToOne 0.00 255.0 /end CHARACTERISTIC
/begin CHARACTERISTIC DFES_FaultTyp.DFC_TCACDsSRCMin_C "DFES/Fehlertyp Zuordnung für Prüfung DFC_TCACDsSRCMin" VALUE 0x8002A6E3 Val_Wu8 255.0 DFES_OneToOne 0.00 255.0 /end CHARACTERISTIC
/begin CHARACTERISTIC DFES_FaultTyp.DFC_ThrVlvSRCMax_C "DFES/Fehlertyp Zuordnung für Prüfung DFC_ThrVlvSRCMax" VALUE 0x8002A6E4 Val_Wu8 255.0 DFES_OneToOne 0.00 255.0 /end CHARACTERISTIC
/begin CHARACTERISTIC DFES_FaultTyp.DFC_ThrVlvSRCMin_C "DFES/Fehlertyp Zuordnung für Prüfung DFC_ThrVlvSRCMin" VALUE 0x8002A6E5 Val_Wu8 255.0 DFES_OneToOne 0.00 255.0 /end CHARACTERISTIC
/begin CHARACTERISTIC DFES_FaultTyp.DFC_TrbChLPOL_C "DFES/Fehlertyp Zuordnung für Prüfung DFC_TrbChLPOL" VALUE 0x8002A6E6 Val_Wu8 255.0 DFES_OneToOne 0.00 255.0 /end CHARACTERISTIC
/begin CHARACTERISTIC DFES_FaultTyp.DFC_TrbChLPSCB_C "DFES/Fehlertyp Zuordnung für Prüfung DFC_TrbChLPSCB" VALUE 0x8002A6E7 Val_Wu8 255.0 DFES_OneToOne 0.00 255.0 /end CHARACTERISTIC
/begin CHARACTERISTIC DFES_FaultTyp.DFC_TrbChLPSCG_C "DFES/Fehlertyp Zuordnung für Prüfung DFC_TrbChLPSCG" VALUE 0x8002A6E8 Val_Wu8 255.0 DFES_OneToOne 0.00 255.0 /end CHARACTERISTIC
/begin CHARACTERISTIC DFES_FaultTyp.DFC_UHtrPLOL_C "DFES/Fehlertyp Zuordnung für Prüfung DFC_UHtrPLOL" VALUE 0x8002A6E9 Val_Wu8 255.0 DFES_OneToOne 0.00 255.0 /end CHARACTERISTIC
/begin CHARACTERISTIC DFES_FaultTyp.DFC_UHtrPLSCB_C "DFES/Fehlertyp Zuordnung für Prüfung DFC_UHtrPLSCB" VALUE 0x8002A6EA Val_Wu8 255.0 DFES_OneToOne 0.00 255.0 /end CHARACTERISTIC
/begin CHARACTERISTIC DFES_FaultTyp.DFC_UHtrPLSCG_C "DFES/Fehlertyp Zuordnung für Prüfung DFC_UHtrPLSCG" VALUE 0x8002A6EB Val_Wu8 255.0 DFES_OneToOne 0.00 255.0 /end CHARACTERISTIC
/begin CHARACTERISTIC DFES_FaultTyp.DFC_UHtrPLSRCMaxDia_C "DFES/Fehlertyp Zuordnung für Prüfung DFC_UHtrPLSRCMaxDia" VALUE 0x8002A6EC Val_Wu8 255.0 DFES_OneToOne 0.00 255.0 /end CHARACTERISTIC
/begin CHARACTERISTIC DFES_FaultTyp.DFC_UHtrPLSRCMinDia_C "DFES/Fehlertyp Zuordnung für Prüfung DFC_UHtrPLSRCMinDia" VALUE 0x8002A6ED Val_Wu8 255.0 DFES_OneToOne 0.00 255.0 /end CHARACTERISTIC
/begin CHARACTERISTIC DFES_FaultTyp.DFC_UHtrTnkOL_C "DFES/Fehlertyp Zuordnung für Prüfung DFC_UHtrTnkOL" VALUE 0x8002A6EE Val_Wu8 255.0 DFES_OneToOne 0.00 255.0 /end CHARACTERISTIC
/begin CHARACTERISTIC DFES_FaultTyp.DFC_UHtrTnkSCB_C "DFES/Fehlertyp Zuordnung für Prüfung DFC_UHtrTnkSCB" VALUE 0x8002A6EF Val_Wu8 255.0 DFES_OneToOne 0.00 255.0 /end CHARACTERISTIC
/begin CHARACTERISTIC DFES_FaultTyp.DFC_UHtrTnkSCG_C "DFES/Fehlertyp Zuordnung für Prüfung DFC_UHtrTnkSCG" VALUE 0x8002A6F0 Val_Wu8 255.0 DFES_OneToOne 0.00 255.0 /end CHARACTERISTIC
/begin CHARACTERISTIC DFES_FaultTyp.DFC_UHtrTnkSRCMaxDia_C "DFES/Fehlertyp Zuordnung für Prüfung DFC_UHtrTnkSRCMaxDia" VALUE 0x8002A6F1 Val_Wu8 255.0 DFES_OneToOne 0.00 255.0 /end CHARACTERISTIC
/begin CHARACTERISTIC DFES_FaultTyp.DFC_UHtrTnkSRCMinDia_C "DFES/Fehlertyp Zuordnung für Prüfung DFC_UHtrTnkSRCMinDia" VALUE 0x8002A6F2 Val_Wu8 255.0 DFES_OneToOne 0.00 255.0 /end CHARACTERISTIC
/begin CHARACTERISTIC DFES_FaultTyp.DFC_URevVlvOL_C "DFES/Fehlertyp Zuordnung für Prüfung DFC_URevVlvOL" VALUE 0x8002A6F3 Val_Wu8 255.0 DFES_OneToOne 0.00 255.0 /end CHARACTERISTIC
/begin CHARACTERISTIC DFES_FaultTyp.DFC_URevVlvSCB_C "DFES/Fehlertyp Zuordnung für Prüfung DFC_URevVlvSCB" VALUE 0x8002A6F4 Val_Wu8 255.0 DFES_OneToOne 0.00 255.0 /end CHARACTERISTIC
/begin CHARACTERISTIC DFES_FaultTyp.DFC_URevVlvSCG_C "DFES/Fehlertyp Zuordnung für Prüfung DFC_URevVlvSCG" VALUE 0x8002A6F5 Val_Wu8 255.0 DFES_OneToOne 0.00 255.0 /end CHARACTERISTIC
/begin CHARACTERISTIC DFES_FaultTyp.DFC_UTnkTSRCMax_C "DFES/Fehlertyp Zuordnung für Prüfung DFC_UTnkTSRCMax" VALUE 0x8002A6F6 Val_Wu8 255.0 DFES_OneToOne 0.00 255.0 /end CHARACTERISTIC
/begin CHARACTERISTIC DFES_FaultTyp.DFC_UTnkTSRCMin_C "DFES/Fehlertyp Zuordnung für Prüfung DFC_UTnkTSRCMin" VALUE 0x8002A6F7 Val_Wu8 255.0 DFES_OneToOne 0.00 255.0 /end CHARACTERISTIC
/begin CHARACTERISTIC DFES_FaultTyp.DFC_UTnkTSig_C "DFES/Fehlertyp Zuordnung für Prüfung DFC_UTnkTSig" VALUE 0x8002A6F8 Val_Wu8 255.0 DFES_OneToOne 0.00 255.0 /end CHARACTERISTIC
/begin CHARACTERISTIC DFES_FaultTyp.DFC_VSwVlvGovDvtMax_C "DFES/Fehlertyp Zuordnung für Prüfung DFC_VSwVlvGovDvtMax" VALUE 0x8002A6F9 Val_Wu8 255.0 DFES_OneToOne 0.00 255.0 /end CHARACTERISTIC
/begin CHARACTERISTIC DFES_FaultTyp.DFC_VSwVlvGovDvtMin_C "DFES/Fehlertyp Zuordnung für Prüfung DFC_VSwVlvGovDvtMin" VALUE 0x8002A6FA Val_Wu8 255.0 DFES_OneToOne 0.00 255.0 /end CHARACTERISTIC
/begin CHARACTERISTIC DFES_FaultTyp.DFC_VSwVlvHBrgOpnLd_C "DFES/Fehlertyp Zuordnung für Prüfung DFC_VSwVlvHBrgOpnLd" VALUE 0x8002A6FB Val_Wu8 255.0 DFES_OneToOne 0.00 255.0 /end CHARACTERISTIC
/begin CHARACTERISTIC DFES_FaultTyp.DFC_VSwVlvHBrgOvrCurr_C "DFES/Fehlertyp Zuordnung für Prüfung DFC_VSwVlvHBrgOvrCurr" VALUE 0x8002A6FC Val_Wu8 255.0 DFES_OneToOne 0.00 255.0 /end CHARACTERISTIC
/begin CHARACTERISTIC DFES_FaultTyp.DFC_VSwVlvHBrgOvrTemp_C "DFES/Fehlertyp Zuordnung für Prüfung DFC_VSwVlvHBrgOvrTemp" VALUE 0x8002A6FD Val_Wu8 255.0 DFES_OneToOne 0.00 255.0 /end CHARACTERISTIC
/begin CHARACTERISTIC DFES_FaultTyp.DFC_VSwVlvHBrgShCirBatt1_C "DFES/Fehlertyp Zuordnung für Prüfung DFC_VSwVlvHBrgShCirBatt1" VALUE 0x8002A6FE Val_Wu8 255.0 DFES_OneToOne 0.00 255.0 /end CHARACTERISTIC
/begin CHARACTERISTIC DFES_FaultTyp.DFC_VSwVlvHBrgShCirBatt2_C "DFES/Fehlertyp Zuordnung für Prüfung DFC_VSwVlvHBrgShCirBatt2" VALUE 0x8002A6FF Val_Wu8 255.0 DFES_OneToOne 0.00 255.0 /end CHARACTERISTIC
/begin CHARACTERISTIC DFES_FaultTyp.DFC_VSwVlvHBrgShCirGnd1_C "DFES/Fehlertyp Zuordnung für Prüfung DFC_VSwVlvHBrgShCirGnd1" VALUE 0x8002A700 Val_Wu8 255.0 DFES_OneToOne 0.00 255.0 /end CHARACTERISTIC
/begin CHARACTERISTIC DFES_FaultTyp.DFC_VSwVlvHBrgShCirGnd2_C "DFES/Fehlertyp Zuordnung für Prüfung DFC_VSwVlvHBrgShCirGnd2" VALUE 0x8002A701 Val_Wu8 255.0 DFES_OneToOne 0.00 255.0 /end CHARACTERISTIC
/begin CHARACTERISTIC DFES_FaultTyp.DFC_VSwVlvHBrgShCirOvrLd_C "DFES/Fehlertyp Zuordnung für Prüfung DFC_VSwVlvHBrgShCirOvrLd" VALUE 0x8002A702 Val_Wu8 255.0 DFES_OneToOne 0.00 255.0 /end CHARACTERISTIC
/begin CHARACTERISTIC DFES_FaultTyp.DFC_VSwVlvHBrgTempOvrCurr_C "DFES/Fehlertyp Zuordnung für Prüfung DFC_VSwVlvHBrgTempOvrCurr" VALUE 0x8002A703 Val_Wu8 255.0 DFES_OneToOne 0.00 255.0 /end CHARACTERISTIC
/begin CHARACTERISTIC DFES_FaultTyp.DFC_VSwVlvHBrgUndrVltg_C "DFES/Fehlertyp Zuordnung für Prüfung DFC_VSwVlvHBrgUndrVltg" VALUE 0x8002A704 Val_Wu8 255.0 DFES_OneToOne 0.00 255.0 /end CHARACTERISTIC
/begin CHARACTERISTIC DFES_FaultTyp.DFC_VSwVlvOL_C "DFES/Fehlertyp Zuordnung für Prüfung DFC_VSwVlvOL" VALUE 0x8002A705 Val_Wu8 255.0 DFES_OneToOne 0.00 255.0 /end CHARACTERISTIC
/begin CHARACTERISTIC DFES_FaultTyp.DFC_VSwVlvSCB_C "DFES/Fehlertyp Zuordnung für Prüfung DFC_VSwVlvSCB" VALUE 0x8002A706 Val_Wu8 255.0 DFES_OneToOne 0.00 255.0 /end CHARACTERISTIC
/begin CHARACTERISTIC DFES_FaultTyp.DFC_VSwVlvSCG_C "DFES/Fehlertyp Zuordnung für Prüfung DFC_VSwVlvSCG" VALUE 0x8002A707 Val_Wu8 255.0 DFES_OneToOne 0.00 255.0 /end CHARACTERISTIC
/begin CHARACTERISTIC DFES_FaultTyp.DFC_VSwVlvSRCMax_C "DFES/Fehlertyp Zuordnung für Prüfung DFC_VSwVlvSRCMax" VALUE 0x8002A708 Val_Wu8 255.0 DFES_OneToOne 0.00 255.0 /end CHARACTERISTIC
/begin CHARACTERISTIC DFES_FaultTyp.DFC_VSwVlvSRCMin_C "DFES/Fehlertyp Zuordnung für Prüfung DFC_VSwVlvSRCMin" VALUE 0x8002A709 Val_Wu8 255.0 DFES_OneToOne 0.00 255.0 /end CHARACTERISTIC
/begin CHARACTERISTIC DFES_FaultTyp.DFC_ClthNpl_C "DFES/Fehlertyp Zuordnung für Prüfung DFC_ClthNpl" VALUE 0x8002A70A Val_Wu8 255.0 DFES_OneToOne 0.00 255.0 /end CHARACTERISTIC
/begin CHARACTERISTIC DFES_FaultTyp.DFC_ETClbETMax_0_C "DFES/Fehlertyp Zuordnung für Prüfung DFC_ETClbETMax_0" VALUE 0x8002A70B Val_Wu8 255.0 DFES_OneToOne 0.00 255.0 /end CHARACTERISTIC
/begin CHARACTERISTIC DFES_FaultTyp.DFC_ETClbETMax_1_C "DFES/Fehlertyp Zuordnung für Prüfung DFC_ETClbETMax_1" VALUE 0x8002A70C Val_Wu8 255.0 DFES_OneToOne 0.00 255.0 /end CHARACTERISTIC
/begin CHARACTERISTIC DFES_FaultTyp.DFC_ETClbETMax_2_C "DFES/Fehlertyp Zuordnung für Prüfung DFC_ETClbETMax_2" VALUE 0x8002A70D Val_Wu8 255.0 DFES_OneToOne 0.00 255.0 /end CHARACTERISTIC
/begin CHARACTERISTIC DFES_FaultTyp.DFC_ETClbETMax_3_C "DFES/Fehlertyp Zuordnung für Prüfung DFC_ETClbETMax_3" VALUE 0x8002A70E Val_Wu8 255.0 DFES_OneToOne 0.00 255.0 /end CHARACTERISTIC
/begin CHARACTERISTIC DFES_FaultTyp.DFC_ETClbETMax_4_C "DFES/Fehlertyp Zuordnung für Prüfung DFC_ETClbETMax_4" VALUE 0x8002A70F Val_Wu8 255.0 DFES_OneToOne 0.00 255.0 /end CHARACTERISTIC
/begin CHARACTERISTIC DFES_FaultTyp.DFC_ETClbETMax_5_C "DFES/Fehlertyp Zuordnung für Prüfung DFC_ETClbETMax_5" VALUE 0x8002A710 Val_Wu8 255.0 DFES_OneToOne 0.00 255.0 /end CHARACTERISTIC
/begin CHARACTERISTIC DFES_FaultTyp.DFC_ETClbETMin_0_C "DFES/Fehlertyp Zuordnung für Prüfung DFC_ETClbETMin_0" VALUE 0x8002A711 Val_Wu8 255.0 DFES_OneToOne 0.00 255.0 /end CHARACTERISTIC
/begin CHARACTERISTIC DFES_FaultTyp.DFC_ETClbETMin_1_C "DFES/Fehlertyp Zuordnung für Prüfung DFC_ETClbETMin_1" VALUE 0x8002A712 Val_Wu8 255.0 DFES_OneToOne 0.00 255.0 /end CHARACTERISTIC
/begin CHARACTERISTIC DFES_FaultTyp.DFC_ETClbETMin_2_C "DFES/Fehlertyp Zuordnung für Prüfung DFC_ETClbETMin_2" VALUE 0x8002A713 Val_Wu8 255.0 DFES_OneToOne 0.00 255.0 /end CHARACTERISTIC
/begin CHARACTERISTIC DFES_FaultTyp.DFC_ETClbETMin_3_C "DFES/Fehlertyp Zuordnung für Prüfung DFC_ETClbETMin_3" VALUE 0x8002A714 Val_Wu8 255.0 DFES_OneToOne 0.00 255.0 /end CHARACTERISTIC
/begin CHARACTERISTIC DFES_FaultTyp.DFC_ETClbETMin_4_C "DFES/Fehlertyp Zuordnung für Prüfung DFC_ETClbETMin_4" VALUE 0x8002A715 Val_Wu8 255.0 DFES_OneToOne 0.00 255.0 /end CHARACTERISTIC
/begin CHARACTERISTIC DFES_FaultTyp.DFC_ETClbETMin_5_C "DFES/Fehlertyp Zuordnung für Prüfung DFC_ETClbETMin_5" VALUE 0x8002A716 Val_Wu8 255.0 DFES_OneToOne 0.00 255.0 /end CHARACTERISTIC
/begin CHARACTERISTIC DFES_FaultTyp.DFC_IVActrEnrgMax_0_C "DFES/Fehlertyp Zuordnung für Prüfung DFC_IVActrEnrgMax_0" VALUE 0x8002A717 Val_Wu8 255.0 DFES_OneToOne 0.00 255.0 /end CHARACTERISTIC
/begin CHARACTERISTIC DFES_FaultTyp.DFC_IVActrEnrgMax_1_C "DFES/Fehlertyp Zuordnung für Prüfung DFC_IVActrEnrgMax_1" VALUE 0x8002A718 Val_Wu8 255.0 DFES_OneToOne 0.00 255.0 /end CHARACTERISTIC
/begin CHARACTERISTIC DFES_FaultTyp.DFC_IVActrEnrgMax_2_C "DFES/Fehlertyp Zuordnung für Prüfung DFC_IVActrEnrgMax_2" VALUE 0x8002A719 Val_Wu8 255.0 DFES_OneToOne 0.00 255.0 /end CHARACTERISTIC
/begin CHARACTERISTIC DFES_FaultTyp.DFC_IVActrEnrgMax_3_C "DFES/Fehlertyp Zuordnung für Prüfung DFC_IVActrEnrgMax_3" VALUE 0x8002A71A Val_Wu8 255.0 DFES_OneToOne 0.00 255.0 /end CHARACTERISTIC
/begin CHARACTERISTIC DFES_FaultTyp.DFC_IVActrEnrgMax_4_C "DFES/Fehlertyp Zuordnung für Prüfung DFC_IVActrEnrgMax_4" VALUE 0x8002A71B Val_Wu8 255.0 DFES_OneToOne 0.00 255.0 /end CHARACTERISTIC
/begin CHARACTERISTIC DFES_FaultTyp.DFC_IVActrEnrgMax_5_C "DFES/Fehlertyp Zuordnung für Prüfung DFC_IVActrEnrgMax_5" VALUE 0x8002A71C Val_Wu8 255.0 DFES_OneToOne 0.00 255.0 /end CHARACTERISTIC
/begin CHARACTERISTIC DFES_FaultTyp.DFC_IVActrEnrgMax_6_C "DFES/Fehlertyp Zuordnung für Prüfung DFC_IVActrEnrgMax_6" VALUE 0x8002A71D Val_Wu8 255.0 DFES_OneToOne 0.00 255.0 /end CHARACTERISTIC
/begin CHARACTERISTIC DFES_FaultTyp.DFC_IVActrEnrgMax_7_C "DFES/Fehlertyp Zuordnung für Prüfung DFC_IVActrEnrgMax_7" VALUE 0x8002A71E Val_Wu8 255.0 DFES_OneToOne 0.00 255.0 /end CHARACTERISTIC
/begin CHARACTERISTIC DFES_FaultTyp.DFC_IVActrEnrgMin_0_C "DFES/Fehlertyp Zuordnung für Prüfung DFC_IVActrEnrgMin_0" VALUE 0x8002A71F Val_Wu8 255.0 DFES_OneToOne 0.00 255.0 /end CHARACTERISTIC
/begin CHARACTERISTIC DFES_FaultTyp.DFC_IVActrEnrgMin_1_C "DFES/Fehlertyp Zuordnung für Prüfung DFC_IVActrEnrgMin_1" VALUE 0x8002A720 Val_Wu8 255.0 DFES_OneToOne 0.00 255.0 /end CHARACTERISTIC
/begin CHARACTERISTIC DFES_FaultTyp.DFC_IVActrEnrgMin_2_C "DFES/Fehlertyp Zuordnung für Prüfung DFC_IVActrEnrgMin_2" VALUE 0x8002A721 Val_Wu8 255.0 DFES_OneToOne 0.00 255.0 /end CHARACTERISTIC
/begin CHARACTERISTIC DFES_FaultTyp.DFC_IVActrEnrgMin_3_C "DFES/Fehlertyp Zuordnung für Prüfung DFC_IVActrEnrgMin_3" VALUE 0x8002A722 Val_Wu8 255.0 DFES_OneToOne 0.00 255.0 /end CHARACTERISTIC
/begin CHARACTERISTIC DFES_FaultTyp.DFC_IVActrEnrgMin_4_C "DFES/Fehlertyp Zuordnung für Prüfung DFC_IVActrEnrgMin_4" VALUE 0x8002A723 Val_Wu8 255.0 DFES_OneToOne 0.00 255.0 /end CHARACTERISTIC
/begin CHARACTERISTIC DFES_FaultTyp.DFC_IVActrEnrgMin_5_C "DFES/Fehlertyp Zuordnung für Prüfung DFC_IVActrEnrgMin_5" VALUE 0x8002A724 Val_Wu8 255.0 DFES_OneToOne 0.00 255.0 /end CHARACTERISTIC
/begin CHARACTERISTIC DFES_FaultTyp.DFC_IVActrEnrgMin_6_C "DFES/Fehlertyp Zuordnung für Prüfung DFC_IVActrEnrgMin_6" VALUE 0x8002A725 Val_Wu8 255.0 DFES_OneToOne 0.00 255.0 /end CHARACTERISTIC
/begin CHARACTERISTIC DFES_FaultTyp.DFC_IVActrEnrgMin_7_C "DFES/Fehlertyp Zuordnung für Prüfung DFC_IVActrEnrgMin_7" VALUE 0x8002A726 Val_Wu8 255.0 DFES_OneToOne 0.00 255.0 /end CHARACTERISTIC
/begin CHARACTERISTIC DFES_FaultTyp.DFC_IVActrEnrgPlaus_0_C "DFES/Fehlertyp Zuordnung für Prüfung DFC_IVActrEnrgPlaus_0" VALUE 0x8002A727 Val_Wu8 255.0 DFES_OneToOne 0.00 255.0 /end CHARACTERISTIC
/begin CHARACTERISTIC DFES_FaultTyp.DFC_IVActrEnrgPlaus_1_C "DFES/Fehlertyp Zuordnung für Prüfung DFC_IVActrEnrgPlaus_1" VALUE 0x8002A728 Val_Wu8 255.0 DFES_OneToOne 0.00 255.0 /end CHARACTERISTIC
/begin CHARACTERISTIC DFES_FaultTyp.DFC_IVActrEnrgPlaus_2_C "DFES/Fehlertyp Zuordnung für Prüfung DFC_IVActrEnrgPlaus_2" VALUE 0x8002A729 Val_Wu8 255.0 DFES_OneToOne 0.00 255.0 /end CHARACTERISTIC
/begin CHARACTERISTIC DFES_FaultTyp.DFC_IVActrEnrgPlaus_3_C "DFES/Fehlertyp Zuordnung für Prüfung DFC_IVActrEnrgPlaus_3" VALUE 0x8002A72A Val_Wu8 255.0 DFES_OneToOne 0.00 255.0 /end CHARACTERISTIC
/begin CHARACTERISTIC DFES_FaultTyp.DFC_IVActrEnrgPlaus_4_C "DFES/Fehlertyp Zuordnung für Prüfung DFC_IVActrEnrgPlaus_4" VALUE 0x8002A72B Val_Wu8 255.0 DFES_OneToOne 0.00 255.0 /end CHARACTERISTIC
/begin CHARACTERISTIC DFES_FaultTyp.DFC_IVActrEnrgPlaus_5_C "DFES/Fehlertyp Zuordnung für Prüfung DFC_IVActrEnrgPlaus_5" VALUE 0x8002A72C Val_Wu8 255.0 DFES_OneToOne 0.00 255.0 /end CHARACTERISTIC
/begin CHARACTERISTIC DFES_FaultTyp.DFC_IVActrEnrgPlaus_6_C "DFES/Fehlertyp Zuordnung für Prüfung DFC_IVActrEnrgPlaus_6" VALUE 0x8002A72D Val_Wu8 255.0 DFES_OneToOne 0.00 255.0 /end CHARACTERISTIC
/begin CHARACTERISTIC DFES_FaultTyp.DFC_IVActrEnrgPlaus_7_C "DFES/Fehlertyp Zuordnung für Prüfung DFC_IVActrEnrgPlaus_7" VALUE 0x8002A72E Val_Wu8 255.0 DFES_OneToOne 0.00 255.0 /end CHARACTERISTIC
/begin CHARACTERISTIC DFES_FaultTyp.DFC_IVCtlTiDiff_0_C "DFES/Fehlertyp Zuordnung für Prüfung DFC_IVCtlTiDiff_0" VALUE 0x8002A72F Val_Wu8 255.0 DFES_OneToOne 0.00 255.0 /end CHARACTERISTIC
/begin CHARACTERISTIC DFES_FaultTyp.DFC_IVCtlTiDiff_1_C "DFES/Fehlertyp Zuordnung für Prüfung DFC_IVCtlTiDiff_1" VALUE 0x8002A730 Val_Wu8 255.0 DFES_OneToOne 0.00 255.0 /end CHARACTERISTIC
/begin CHARACTERISTIC DFES_FaultTyp.DFC_IVCtlTiDiff_2_C "DFES/Fehlertyp Zuordnung für Prüfung DFC_IVCtlTiDiff_2" VALUE 0x8002A731 Val_Wu8 255.0 DFES_OneToOne 0.00 255.0 /end CHARACTERISTIC
/begin CHARACTERISTIC DFES_FaultTyp.DFC_IVCtlTiDiff_3_C "DFES/Fehlertyp Zuordnung für Prüfung DFC_IVCtlTiDiff_3" VALUE 0x8002A732 Val_Wu8 255.0 DFES_OneToOne 0.00 255.0 /end CHARACTERISTIC
/begin CHARACTERISTIC DFES_FaultTyp.DFC_IVCtlTiDiff_4_C "DFES/Fehlertyp Zuordnung für Prüfung DFC_IVCtlTiDiff_4" VALUE 0x8002A733 Val_Wu8 255.0 DFES_OneToOne 0.00 255.0 /end CHARACTERISTIC
/begin CHARACTERISTIC DFES_FaultTyp.DFC_IVCtlTiDiff_5_C "DFES/Fehlertyp Zuordnung für Prüfung DFC_IVCtlTiDiff_5" VALUE 0x8002A734 Val_Wu8 255.0 DFES_OneToOne 0.00 255.0 /end CHARACTERISTIC
/begin CHARACTERISTIC DFES_FaultTyp.DFC_IVCtlUDiffUp_0_C "DFES/Fehlertyp Zuordnung für Prüfung DFC_IVCtlUDiffUp_0" VALUE 0x8002A735 Val_Wu8 255.0 DFES_OneToOne 0.00 255.0 /end CHARACTERISTIC
/begin CHARACTERISTIC DFES_FaultTyp.DFC_IVCtlUDiffUp_1_C "DFES/Fehlertyp Zuordnung für Prüfung DFC_IVCtlUDiffUp_1" VALUE 0x8002A736 Val_Wu8 255.0 DFES_OneToOne 0.00 255.0 /end CHARACTERISTIC
/begin CHARACTERISTIC DFES_FaultTyp.DFC_IVCtlUDiffUp_2_C "DFES/Fehlertyp Zuordnung für Prüfung DFC_IVCtlUDiffUp_2" VALUE 0x8002A737 Val_Wu8 255.0 DFES_OneToOne 0.00 255.0 /end CHARACTERISTIC
/begin CHARACTERISTIC DFES_FaultTyp.DFC_IVCtlUDiffUp_3_C "DFES/Fehlertyp Zuordnung für Prüfung DFC_IVCtlUDiffUp_3" VALUE 0x8002A738 Val_Wu8 255.0 DFES_OneToOne 0.00 255.0 /end CHARACTERISTIC
/begin CHARACTERISTIC DFES_FaultTyp.DFC_IVCtlUDiffUp_4_C "DFES/Fehlertyp Zuordnung für Prüfung DFC_IVCtlUDiffUp_4" VALUE 0x8002A739 Val_Wu8 255.0 DFES_OneToOne 0.00 255.0 /end CHARACTERISTIC
/begin CHARACTERISTIC DFES_FaultTyp.DFC_IVCtlUDiffUp_5_C "DFES/Fehlertyp Zuordnung für Prüfung DFC_IVCtlUDiffUp_5" VALUE 0x8002A73A Val_Wu8 255.0 DFES_OneToOne 0.00 255.0 /end CHARACTERISTIC
/begin CHARACTERISTIC DFES_FaultTyp.DFC_IVCtlUUp_0_C "DFES/Fehlertyp Zuordnung für Prüfung DFC_IVCtlUUp_0" VALUE 0x8002A73B Val_Wu8 255.0 DFES_OneToOne 0.00 255.0 /end CHARACTERISTIC
/begin CHARACTERISTIC DFES_FaultTyp.DFC_IVCtlUUp_1_C "DFES/Fehlertyp Zuordnung für Prüfung DFC_IVCtlUUp_1" VALUE 0x8002A73C Val_Wu8 255.0 DFES_OneToOne 0.00 255.0 /end CHARACTERISTIC
/begin CHARACTERISTIC DFES_FaultTyp.DFC_IVCtlUUp_2_C "DFES/Fehlertyp Zuordnung für Prüfung DFC_IVCtlUUp_2" VALUE 0x8002A73D Val_Wu8 255.0 DFES_OneToOne 0.00 255.0 /end CHARACTERISTIC
/begin CHARACTERISTIC DFES_FaultTyp.DFC_IVCtlUUp_3_C "DFES/Fehlertyp Zuordnung für Prüfung DFC_IVCtlUUp_3" VALUE 0x8002A73E Val_Wu8 255.0 DFES_OneToOne 0.00 255.0 /end CHARACTERISTIC
/begin CHARACTERISTIC DFES_FaultTyp.DFC_IVCtlUUp_4_C "DFES/Fehlertyp Zuordnung für Prüfung DFC_IVCtlUUp_4" VALUE 0x8002A73F Val_Wu8 255.0 DFES_OneToOne 0.00 255.0 /end CHARACTERISTIC
/begin CHARACTERISTIC DFES_FaultTyp.DFC_IVCtlUUp_5_C "DFES/Fehlertyp Zuordnung für Prüfung DFC_IVCtlUUp_5" VALUE 0x8002A740 Val_Wu8 255.0 DFES_OneToOne 0.00 255.0 /end CHARACTERISTIC
/begin CHARACTERISTIC DFES_FaultTyp.DFC_IVDiaBnkShCir_0_C "DFES/Fehlertyp Zuordnung für Prüfung DFC_IVDiaBnkShCir_0" VALUE 0x8002A741 Val_Wu8 255.0 DFES_OneToOne 0.00 255.0 /end CHARACTERISTIC
/begin CHARACTERISTIC DFES_FaultTyp.DFC_IVDiaBnkShCir_1_C "DFES/Fehlertyp Zuordnung für Prüfung DFC_IVDiaBnkShCir_1" VALUE 0x8002A742 Val_Wu8 255.0 DFES_OneToOne 0.00 255.0 /end CHARACTERISTIC
/begin CHARACTERISTIC DFES_FaultTyp.DFC_IVDiaBnkShCirChSwt_0_C "DFES/Fehlertyp Zuordnung für Prüfung DFC_IVDiaBnkShCirChSwt_0" VALUE 0x8002A743 Val_Wu8 255.0 DFES_OneToOne 0.00 255.0 /end CHARACTERISTIC
/begin CHARACTERISTIC DFES_FaultTyp.DFC_IVDiaBnkShCirChSwt_1_C "DFES/Fehlertyp Zuordnung für Prüfung DFC_IVDiaBnkShCirChSwt_1" VALUE 0x8002A744 Val_Wu8 255.0 DFES_OneToOne 0.00 255.0 /end CHARACTERISTIC
/begin CHARACTERISTIC DFES_FaultTyp.DFC_IVDiaChp_0_C "DFES/Fehlertyp Zuordnung für Prüfung DFC_IVDiaChp_0" VALUE 0x8002A745 Val_Wu8 255.0 DFES_OneToOne 0.00 255.0 /end CHARACTERISTIC
/begin CHARACTERISTIC DFES_FaultTyp.DFC_IVDiaChp_1_C "DFES/Fehlertyp Zuordnung für Prüfung DFC_IVDiaChp_1" VALUE 0x8002A746 Val_Wu8 255.0 DFES_OneToOne 0.00 255.0 /end CHARACTERISTIC
/begin CHARACTERISTIC DFES_FaultTyp.DFC_IVDiaCylNoCls_0_C "DFES/Fehlertyp Zuordnung für Prüfung DFC_IVDiaCylNoCls_0" VALUE 0x8002A747 Val_Wu8 255.0 DFES_OneToOne 0.00 255.0 /end CHARACTERISTIC
/begin CHARACTERISTIC DFES_FaultTyp.DFC_IVDiaCylNoCls_1_C "DFES/Fehlertyp Zuordnung für Prüfung DFC_IVDiaCylNoCls_1" VALUE 0x8002A748 Val_Wu8 255.0 DFES_OneToOne 0.00 255.0 /end CHARACTERISTIC
/begin CHARACTERISTIC DFES_FaultTyp.DFC_IVDiaCylNoCls_2_C "DFES/Fehlertyp Zuordnung für Prüfung DFC_IVDiaCylNoCls_2" VALUE 0x8002A749 Val_Wu8 255.0 DFES_OneToOne 0.00 255.0 /end CHARACTERISTIC
/begin CHARACTERISTIC DFES_FaultTyp.DFC_IVDiaCylNoCls_3_C "DFES/Fehlertyp Zuordnung für Prüfung DFC_IVDiaCylNoCls_3" VALUE 0x8002A74A Val_Wu8 255.0 DFES_OneToOne 0.00 255.0 /end CHARACTERISTIC
/begin CHARACTERISTIC DFES_FaultTyp.DFC_IVDiaCylNoCls_4_C "DFES/Fehlertyp Zuordnung für Prüfung DFC_IVDiaCylNoCls_4" VALUE 0x8002A74B Val_Wu8 255.0 DFES_OneToOne 0.00 255.0 /end CHARACTERISTIC
/begin CHARACTERISTIC DFES_FaultTyp.DFC_IVDiaCylNoCls_5_C "DFES/Fehlertyp Zuordnung für Prüfung DFC_IVDiaCylNoCls_5" VALUE 0x8002A74C Val_Wu8 255.0 DFES_OneToOne 0.00 255.0 /end CHARACTERISTIC
/begin CHARACTERISTIC DFES_FaultTyp.DFC_IVDiaCylNoLd_0_C "DFES/Fehlertyp Zuordnung für Prüfung DFC_IVDiaCylNoLd_0" VALUE 0x8002A74D Val_Wu8 255.0 DFES_OneToOne 0.00 255.0 /end CHARACTERISTIC
/begin CHARACTERISTIC DFES_FaultTyp.DFC_IVDiaCylNoLd_1_C "DFES/Fehlertyp Zuordnung für Prüfung DFC_IVDiaCylNoLd_1" VALUE 0x8002A74E Val_Wu8 255.0 DFES_OneToOne 0.00 255.0 /end CHARACTERISTIC
/begin CHARACTERISTIC DFES_FaultTyp.DFC_IVDiaCylNoLd_2_C "DFES/Fehlertyp Zuordnung für Prüfung DFC_IVDiaCylNoLd_2" VALUE 0x8002A74F Val_Wu8 255.0 DFES_OneToOne 0.00 255.0 /end CHARACTERISTIC
/begin CHARACTERISTIC DFES_FaultTyp.DFC_IVDiaCylNoLd_3_C "DFES/Fehlertyp Zuordnung für Prüfung DFC_IVDiaCylNoLd_3" VALUE 0x8002A750 Val_Wu8 255.0 DFES_OneToOne 0.00 255.0 /end CHARACTERISTIC
/begin CHARACTERISTIC DFES_FaultTyp.DFC_IVDiaCylNoLd_4_C "DFES/Fehlertyp Zuordnung für Prüfung DFC_IVDiaCylNoLd_4" VALUE 0x8002A751 Val_Wu8 255.0 DFES_OneToOne 0.00 255.0 /end CHARACTERISTIC
/begin CHARACTERISTIC DFES_FaultTyp.DFC_IVDiaCylNoLd_5_C "DFES/Fehlertyp Zuordnung für Prüfung DFC_IVDiaCylNoLd_5" VALUE 0x8002A752 Val_Wu8 255.0 DFES_OneToOne 0.00 255.0 /end CHARACTERISTIC
/begin CHARACTERISTIC DFES_FaultTyp.DFC_IVDiaCylShCir_0_C "DFES/Fehlertyp Zuordnung für Prüfung DFC_IVDiaCylShCir_0" VALUE 0x8002A753 Val_Wu8 255.0 DFES_OneToOne 0.00 255.0 /end CHARACTERISTIC
/begin CHARACTERISTIC DFES_FaultTyp.DFC_IVDiaCylShCir_1_C "DFES/Fehlertyp Zuordnung für Prüfung DFC_IVDiaCylShCir_1" VALUE 0x8002A754 Val_Wu8 255.0 DFES_OneToOne 0.00 255.0 /end CHARACTERISTIC
/begin CHARACTERISTIC DFES_FaultTyp.DFC_IVDiaCylShCir_2_C "DFES/Fehlertyp Zuordnung für Prüfung DFC_IVDiaCylShCir_2" VALUE 0x8002A755 Val_Wu8 255.0 DFES_OneToOne 0.00 255.0 /end CHARACTERISTIC
/begin CHARACTERISTIC DFES_FaultTyp.DFC_IVDiaCylShCir_3_C "DFES/Fehlertyp Zuordnung für Prüfung DFC_IVDiaCylShCir_3" VALUE 0x8002A756 Val_Wu8 255.0 DFES_OneToOne 0.00 255.0 /end CHARACTERISTIC
/begin CHARACTERISTIC DFES_FaultTyp.DFC_IVDiaCylShCir_4_C "DFES/Fehlertyp Zuordnung für Prüfung DFC_IVDiaCylShCir_4" VALUE 0x8002A757 Val_Wu8 255.0 DFES_OneToOne 0.00 255.0 /end CHARACTERISTIC
/begin CHARACTERISTIC DFES_FaultTyp.DFC_IVDiaCylShCir_5_C "DFES/Fehlertyp Zuordnung für Prüfung DFC_IVDiaCylShCir_5" VALUE 0x8002A758 Val_Wu8 255.0 DFES_OneToOne 0.00 255.0 /end CHARACTERISTIC
/begin CHARACTERISTIC DFES_FaultTyp.DFC_IVDiaCylShCirHSLS_0_C "DFES/Fehlertyp Zuordnung für Prüfung DFC_IVDiaCylShCirHSLS_0" VALUE 0x8002A759 Val_Wu8 255.0 DFES_OneToOne 0.00 255.0 /end CHARACTERISTIC
/begin CHARACTERISTIC DFES_FaultTyp.DFC_IVDiaCylShCirHSLS_1_C "DFES/Fehlertyp Zuordnung für Prüfung DFC_IVDiaCylShCirHSLS_1" VALUE 0x8002A75A Val_Wu8 255.0 DFES_OneToOne 0.00 255.0 /end CHARACTERISTIC
/begin CHARACTERISTIC DFES_FaultTyp.DFC_IVDiaCylShCirHSLS_2_C "DFES/Fehlertyp Zuordnung für Prüfung DFC_IVDiaCylShCirHSLS_2" VALUE 0x8002A75B Val_Wu8 255.0 DFES_OneToOne 0.00 255.0 /end CHARACTERISTIC
/begin CHARACTERISTIC DFES_FaultTyp.DFC_IVDiaCylShCirHSLS_3_C "DFES/Fehlertyp Zuordnung für Prüfung DFC_IVDiaCylShCirHSLS_3" VALUE 0x8002A75C Val_Wu8 255.0 DFES_OneToOne 0.00 255.0 /end CHARACTERISTIC
/begin CHARACTERISTIC DFES_FaultTyp.DFC_IVDiaCylShCirHSLS_4_C "DFES/Fehlertyp Zuordnung für Prüfung DFC_IVDiaCylShCirHSLS_4" VALUE 0x8002A75D Val_Wu8 255.0 DFES_OneToOne 0.00 255.0 /end CHARACTERISTIC
/begin CHARACTERISTIC DFES_FaultTyp.DFC_IVDiaCylShCirHSLS_5_C "DFES/Fehlertyp Zuordnung für Prüfung DFC_IVDiaCylShCirHSLS_5" VALUE 0x8002A75E Val_Wu8 255.0 DFES_OneToOne 0.00 255.0 /end CHARACTERISTIC
/begin CHARACTERISTIC DFES_FaultTyp.DFC_IVDiaCylShCirMeas_0_C "DFES/Fehlertyp Zuordnung für Prüfung DFC_IVDiaCylShCirMeas_0" VALUE 0x8002A75F Val_Wu8 255.0 DFES_OneToOne 0.00 255.0 /end CHARACTERISTIC
/begin CHARACTERISTIC DFES_FaultTyp.DFC_IVDiaCylShCirMeas_1_C "DFES/Fehlertyp Zuordnung für Prüfung DFC_IVDiaCylShCirMeas_1" VALUE 0x8002A760 Val_Wu8 255.0 DFES_OneToOne 0.00 255.0 /end CHARACTERISTIC
/begin CHARACTERISTIC DFES_FaultTyp.DFC_IVDiaCylShCirMeas_2_C "DFES/Fehlertyp Zuordnung für Prüfung DFC_IVDiaCylShCirMeas_2" VALUE 0x8002A761 Val_Wu8 255.0 DFES_OneToOne 0.00 255.0 /end CHARACTERISTIC
/begin CHARACTERISTIC DFES_FaultTyp.DFC_IVDiaCylShCirMeas_3_C "DFES/Fehlertyp Zuordnung für Prüfung DFC_IVDiaCylShCirMeas_3" VALUE 0x8002A762 Val_Wu8 255.0 DFES_OneToOne 0.00 255.0 /end CHARACTERISTIC
/begin CHARACTERISTIC DFES_FaultTyp.DFC_IVDiaCylShCirMeas_4_C "DFES/Fehlertyp Zuordnung für Prüfung DFC_IVDiaCylShCirMeas_4" VALUE 0x8002A763 Val_Wu8 255.0 DFES_OneToOne 0.00 255.0 /end CHARACTERISTIC
/begin CHARACTERISTIC DFES_FaultTyp.DFC_IVDiaCylShCirMeas_5_C "DFES/Fehlertyp Zuordnung für Prüfung DFC_IVDiaCylShCirMeas_5" VALUE 0x8002A764 Val_Wu8 255.0 DFES_OneToOne 0.00 255.0 /end CHARACTERISTIC
/begin CHARACTERISTIC DFES_FaultTyp.DFC_LSUDynChk_C "DFES/Fehlertyp Zuordnung für Prüfung DFC_LSUDynChk" VALUE 0x8002A765 Val_Wu8 255.0 DFES_OneToOne 0.00 255.0 /end CHARACTERISTIC
/begin CHARACTERISTIC DFES_FaultTyp.DFC_LSUO2ClbMax_C "DFES/Fehlertyp Zuordnung für Prüfung DFC_LSUO2ClbMax" VALUE 0x8002A766 Val_Wu8 255.0 DFES_OneToOne 0.00 255.0 /end CHARACTERISTIC
/begin CHARACTERISTIC DFES_FaultTyp.DFC_LSUO2ClbMin_C "DFES/Fehlertyp Zuordnung für Prüfung DFC_LSUO2ClbMin" VALUE 0x8002A767 Val_Wu8 255.0 DFES_OneToOne 0.00 255.0 /end CHARACTERISTIC
/begin CHARACTERISTIC DFES_FaultTyp.DFC_LSUO2PlausMaxFLd_C "DFES/Fehlertyp Zuordnung für Prüfung DFC_LSUO2PlausMaxFLd" VALUE 0x8002A768 Val_Wu8 255.0 DFES_OneToOne 0.00 255.0 /end CHARACTERISTIC
/begin CHARACTERISTIC DFES_FaultTyp.DFC_LSUO2PlausMaxOvrRun_C "DFES/Fehlertyp Zuordnung für Prüfung DFC_LSUO2PlausMaxOvrRun" VALUE 0x8002A769 Val_Wu8 255.0 DFES_OneToOne 0.00 255.0 /end CHARACTERISTIC
/begin CHARACTERISTIC DFES_FaultTyp.DFC_LSUO2PlausMaxPartLd_C "DFES/Fehlertyp Zuordnung für Prüfung DFC_LSUO2PlausMaxPartLd" VALUE 0x8002A76A Val_Wu8 255.0 DFES_OneToOne 0.00 255.0 /end CHARACTERISTIC
/begin CHARACTERISTIC DFES_FaultTyp.DFC_LSUO2PlausMinFLd_C "DFES/Fehlertyp Zuordnung für Prüfung DFC_LSUO2PlausMinFLd" VALUE 0x8002A76B Val_Wu8 255.0 DFES_OneToOne 0.00 255.0 /end CHARACTERISTIC
/begin CHARACTERISTIC DFES_FaultTyp.DFC_LSUO2PlausMinOvrRun_C "DFES/Fehlertyp Zuordnung für Prüfung DFC_LSUO2PlausMinOvrRun" VALUE 0x8002A76C Val_Wu8 255.0 DFES_OneToOne 0.00 255.0 /end CHARACTERISTIC
/begin CHARACTERISTIC DFES_FaultTyp.DFC_LSUO2PlausMinPartLd_C "DFES/Fehlertyp Zuordnung für Prüfung DFC_LSUO2PlausMinPartLd" VALUE 0x8002A76D Val_Wu8 255.0 DFES_OneToOne 0.00 255.0 /end CHARACTERISTIC
/begin CHARACTERISTIC DFES_FaultTyp.DFC_LSURiClbMax_C "DFES/Fehlertyp Zuordnung für Prüfung DFC_LSURiClbMax" VALUE 0x8002A76E Val_Wu8 255.0 DFES_OneToOne 0.00 255.0 /end CHARACTERISTIC
/begin CHARACTERISTIC DFES_FaultTyp.DFC_LSURiClbMin_C "DFES/Fehlertyp Zuordnung für Prüfung DFC_LSURiClbMin" VALUE 0x8002A76F Val_Wu8 255.0 DFES_OneToOne 0.00 255.0 /end CHARACTERISTIC
/begin CHARACTERISTIC DFES_FaultTyp.DFC_LSUWireIPSig_C "DFES/Fehlertyp Zuordnung für Prüfung DFC_LSUWireIPSig" VALUE 0x8002A770 Val_Wu8 255.0 DFES_OneToOne 0.00 255.0 /end CHARACTERISTIC
/begin CHARACTERISTIC DFES_FaultTyp.DFC_Layer_BSDMax_C "DFES/Fehlertyp Zuordnung für Prüfung DFC_Layer_BSDMax" VALUE 0x8002A771 Val_Wu8 255.0 DFES_OneToOne 0.00 255.0 /end CHARACTERISTIC
/begin CHARACTERISTIC DFES_FaultTyp.DFC_Layer_BSDMin_C "DFES/Fehlertyp Zuordnung für Prüfung DFC_Layer_BSDMin" VALUE 0x8002A772 Val_Wu8 255.0 DFES_OneToOne 0.00 255.0 /end CHARACTERISTIC
/begin CHARACTERISTIC DFES_FaultTyp.DFC_Layer_BSDNpl_C "DFES/Fehlertyp Zuordnung für Prüfung DFC_Layer_BSDNpl" VALUE 0x8002A773 Val_Wu8 255.0 DFES_OneToOne 0.00 255.0 /end CHARACTERISTIC
/begin CHARACTERISTIC DFES_FaultTyp.DFC_Layer_BSDSig_C "DFES/Fehlertyp Zuordnung für Prüfung DFC_Layer_BSDSig" VALUE 0x8002A774 Val_Wu8 255.0 DFES_OneToOne 0.00 255.0 /end CHARACTERISTIC
/begin CHARACTERISTIC DFES_FaultTyp.DFC_Layer_FltMngTstMax_C "DFES/Fehlertyp Zuordnung für Prüfung DFC_Layer_FltMngTstMax" VALUE 0x8002A775 Val_Wu8 255.0 DFES_OneToOne 0.00 255.0 /end CHARACTERISTIC
/begin CHARACTERISTIC DFES_FaultTyp.DFC_Layer_FltMngTstMin_C "DFES/Fehlertyp Zuordnung für Prüfung DFC_Layer_FltMngTstMin" VALUE 0x8002A776 Val_Wu8 255.0 DFES_OneToOne 0.00 255.0 /end CHARACTERISTIC
/begin CHARACTERISTIC DFES_FaultTyp.DFC_Layer_FltMngTstNpl_C "DFES/Fehlertyp Zuordnung für Prüfung DFC_Layer_FltMngTstNpl" VALUE 0x8002A777 Val_Wu8 255.0 DFES_OneToOne 0.00 255.0 /end CHARACTERISTIC
/begin CHARACTERISTIC DFES_FaultTyp.DFC_Layer_FltMngTstSig_C "DFES/Fehlertyp Zuordnung für Prüfung DFC_Layer_FltMngTstSig" VALUE 0x8002A778 Val_Wu8 255.0 DFES_OneToOne 0.00 255.0 /end CHARACTERISTIC
/begin CHARACTERISTIC DFES_FaultTyp.DFC_Layer_GENELBMax_C "DFES/Fehlertyp Zuordnung für Prüfung DFC_Layer_GENELBMax" VALUE 0x8002A779 Val_Wu8 255.0 DFES_OneToOne 0.00 255.0 /end CHARACTERISTIC
/begin CHARACTERISTIC DFES_FaultTyp.DFC_Layer_GENELBMin_C "DFES/Fehlertyp Zuordnung für Prüfung DFC_Layer_GENELBMin" VALUE 0x8002A77A Val_Wu8 255.0 DFES_OneToOne 0.00 255.0 /end CHARACTERISTIC
/begin CHARACTERISTIC DFES_FaultTyp.DFC_Layer_GENELBNpl_C "DFES/Fehlertyp Zuordnung für Prüfung DFC_Layer_GENELBNpl" VALUE 0x8002A77B Val_Wu8 255.0 DFES_OneToOne 0.00 255.0 /end CHARACTERISTIC
/begin CHARACTERISTIC DFES_FaultTyp.DFC_Layer_GENELBSig_C "DFES/Fehlertyp Zuordnung für Prüfung DFC_Layer_GENELBSig" VALUE 0x8002A77C Val_Wu8 255.0 DFES_OneToOne 0.00 255.0 /end CHARACTERISTIC
/begin CHARACTERISTIC DFES_FaultTyp.DFC_Layer_GENELMax_C "DFES/Fehlertyp Zuordnung für Prüfung DFC_Layer_GENELMax" VALUE 0x8002A77D Val_Wu8 255.0 DFES_OneToOne 0.00 255.0 /end CHARACTERISTIC
/begin CHARACTERISTIC DFES_FaultTyp.DFC_Layer_GENELMin_C "DFES/Fehlertyp Zuordnung für Prüfung DFC_Layer_GENELMin" VALUE 0x8002A77E Val_Wu8 255.0 DFES_OneToOne 0.00 255.0 /end CHARACTERISTIC
/begin CHARACTERISTIC DFES_FaultTyp.DFC_Layer_GENELNpl_C "DFES/Fehlertyp Zuordnung für Prüfung DFC_Layer_GENELNpl" VALUE 0x8002A77F Val_Wu8 255.0 DFES_OneToOne 0.00 255.0 /end CHARACTERISTIC
/begin CHARACTERISTIC DFES_FaultTyp.DFC_Layer_GENELSig_C "DFES/Fehlertyp Zuordnung für Prüfung DFC_Layer_GENELSig" VALUE 0x8002A780 Val_Wu8 255.0 DFES_OneToOne 0.00 255.0 /end CHARACTERISTIC
/begin CHARACTERISTIC DFES_FaultTyp.DFC_Layer_GENHTBMax_C "DFES/Fehlertyp Zuordnung für Prüfung DFC_Layer_GENHTBMax" VALUE 0x8002A781 Val_Wu8 255.0 DFES_OneToOne 0.00 255.0 /end CHARACTERISTIC
/begin CHARACTERISTIC DFES_FaultTyp.DFC_Layer_GENHTBMin_C "DFES/Fehlertyp Zuordnung für Prüfung DFC_Layer_GENHTBMin" VALUE 0x8002A782 Val_Wu8 255.0 DFES_OneToOne 0.00 255.0 /end CHARACTERISTIC
/begin CHARACTERISTIC DFES_FaultTyp.DFC_Layer_GENHTBNpl_C "DFES/Fehlertyp Zuordnung für Prüfung DFC_Layer_GENHTBNpl" VALUE 0x8002A783 Val_Wu8 255.0 DFES_OneToOne 0.00 255.0 /end CHARACTERISTIC
/begin CHARACTERISTIC DFES_FaultTyp.DFC_Layer_GENHTBSig_C "DFES/Fehlertyp Zuordnung für Prüfung DFC_Layer_GENHTBSig" VALUE 0x8002A784 Val_Wu8 255.0 DFES_OneToOne 0.00 255.0 /end CHARACTERISTIC
/begin CHARACTERISTIC DFES_FaultTyp.DFC_Layer_GENHTMax_C "DFES/Fehlertyp Zuordnung für Prüfung DFC_Layer_GENHTMax" VALUE 0x8002A785 Val_Wu8 255.0 DFES_OneToOne 0.00 255.0 /end CHARACTERISTIC
/begin CHARACTERISTIC DFES_FaultTyp.DFC_Layer_GENHTMin_C "DFES/Fehlertyp Zuordnung für Prüfung DFC_Layer_GENHTMin" VALUE 0x8002A786 Val_Wu8 255.0 DFES_OneToOne 0.00 255.0 /end CHARACTERISTIC
/begin CHARACTERISTIC DFES_FaultTyp.DFC_Layer_GENHTNpl_C "DFES/Fehlertyp Zuordnung für Prüfung DFC_Layer_GENHTNpl" VALUE 0x8002A787 Val_Wu8 255.0 DFES_OneToOne 0.00 255.0 /end CHARACTERISTIC
/begin CHARACTERISTIC DFES_FaultTyp.DFC_Layer_GENHTSig_C "DFES/Fehlertyp Zuordnung für Prüfung DFC_Layer_GENHTSig" VALUE 0x8002A788 Val_Wu8 255.0 DFES_OneToOne 0.00 255.0 /end CHARACTERISTIC
/begin CHARACTERISTIC DFES_FaultTyp.DFC_Layer_GENKOMMMax_C "DFES/Fehlertyp Zuordnung für Prüfung DFC_Layer_GENKOMMMax" VALUE 0x8002A789 Val_Wu8 255.0 DFES_OneToOne 0.00 255.0 /end CHARACTERISTIC
/begin CHARACTERISTIC DFES_FaultTyp.DFC_Layer_GENKOMMMin_C "DFES/Fehlertyp Zuordnung für Prüfung DFC_Layer_GENKOMMMin" VALUE 0x8002A78A Val_Wu8 255.0 DFES_OneToOne 0.00 255.0 /end CHARACTERISTIC
/begin CHARACTERISTIC DFES_FaultTyp.DFC_Layer_GENKOMMNpl_C "DFES/Fehlertyp Zuordnung für Prüfung DFC_Layer_GENKOMMNpl" VALUE 0x8002A78B Val_Wu8 255.0 DFES_OneToOne 0.00 255.0 /end CHARACTERISTIC
/begin CHARACTERISTIC DFES_FaultTyp.DFC_Layer_GENKOMMSig_C "DFES/Fehlertyp Zuordnung für Prüfung DFC_Layer_GENKOMMSig" VALUE 0x8002A78C Val_Wu8 255.0 DFES_OneToOne 0.00 255.0 /end CHARACTERISTIC
/begin CHARACTERISTIC DFES_FaultTyp.DFC_Layer_GENMECHMax_C "DFES/Fehlertyp Zuordnung für Prüfung DFC_Layer_GENMECHMax" VALUE 0x8002A78D Val_Wu8 255.0 DFES_OneToOne 0.00 255.0 /end CHARACTERISTIC
/begin CHARACTERISTIC DFES_FaultTyp.DFC_Layer_GENMECHMin_C "DFES/Fehlertyp Zuordnung für Prüfung DFC_Layer_GENMECHMin" VALUE 0x8002A78E Val_Wu8 255.0 DFES_OneToOne 0.00 255.0 /end CHARACTERISTIC
/begin CHARACTERISTIC DFES_FaultTyp.DFC_Layer_GENMECHNpl_C "DFES/Fehlertyp Zuordnung für Prüfung DFC_Layer_GENMECHNpl" VALUE 0x8002A78F Val_Wu8 255.0 DFES_OneToOne 0.00 255.0 /end CHARACTERISTIC
/begin CHARACTERISTIC DFES_FaultTyp.DFC_Layer_GENMECHSig_C "DFES/Fehlertyp Zuordnung für Prüfung DFC_Layer_GENMECHSig" VALUE 0x8002A790 Val_Wu8 255.0 DFES_OneToOne 0.00 255.0 /end CHARACTERISTIC
/begin CHARACTERISTIC DFES_FaultTyp.DFC_Layer_GENMax_C "DFES/Fehlertyp Zuordnung für Prüfung DFC_Layer_GENMax" VALUE 0x8002A791 Val_Wu8 255.0 DFES_OneToOne 0.00 255.0 /end CHARACTERISTIC
/begin CHARACTERISTIC DFES_FaultTyp.DFC_Layer_GENMin_C "DFES/Fehlertyp Zuordnung für Prüfung DFC_Layer_GENMin" VALUE 0x8002A792 Val_Wu8 255.0 DFES_OneToOne 0.00 255.0 /end CHARACTERISTIC
/begin CHARACTERISTIC DFES_FaultTyp.DFC_Layer_GENNpl_C "DFES/Fehlertyp Zuordnung für Prüfung DFC_Layer_GENNpl" VALUE 0x8002A793 Val_Wu8 255.0 DFES_OneToOne 0.00 255.0 /end CHARACTERISTIC
/begin CHARACTERISTIC DFES_FaultTyp.DFC_Layer_GENREGUPLMax_C "DFES/Fehlertyp Zuordnung für Prüfung DFC_Layer_GENREGUPLMax" VALUE 0x8002A794 Val_Wu8 255.0 DFES_OneToOne 0.00 255.0 /end CHARACTERISTIC
/begin CHARACTERISTIC DFES_FaultTyp.DFC_Layer_GENREGUPLMin_C "DFES/Fehlertyp Zuordnung für Prüfung DFC_Layer_GENREGUPLMin" VALUE 0x8002A795 Val_Wu8 255.0 DFES_OneToOne 0.00 255.0 /end CHARACTERISTIC
/begin CHARACTERISTIC DFES_FaultTyp.DFC_Layer_GENREGUPLNpl_C "DFES/Fehlertyp Zuordnung für Prüfung DFC_Layer_GENREGUPLNpl" VALUE 0x8002A796 Val_Wu8 255.0 DFES_OneToOne 0.00 255.0 /end CHARACTERISTIC
/begin CHARACTERISTIC DFES_FaultTyp.DFC_Layer_GENREGUPLSig_C "DFES/Fehlertyp Zuordnung für Prüfung DFC_Layer_GENREGUPLSig" VALUE 0x8002A797 Val_Wu8 255.0 DFES_OneToOne 0.00 255.0 /end CHARACTERISTIC
/begin CHARACTERISTIC DFES_FaultTyp.DFC_Layer_GENSig_C "DFES/Fehlertyp Zuordnung für Prüfung DFC_Layer_GENSig" VALUE 0x8002A798 Val_Wu8 255.0 DFES_OneToOne 0.00 255.0 /end CHARACTERISTIC
/begin CHARACTERISTIC DFES_FaultTyp.DFC_Layer_GENUPLMax_C "DFES/Fehlertyp Zuordnung für Prüfung DFC_Layer_GENUPLMax" VALUE 0x8002A799 Val_Wu8 255.0 DFES_OneToOne 0.00 255.0 /end CHARACTERISTIC
/begin CHARACTERISTIC DFES_FaultTyp.DFC_Layer_GENUPLMin_C "DFES/Fehlertyp Zuordnung für Prüfung DFC_Layer_GENUPLMin" VALUE 0x8002A79A Val_Wu8 255.0 DFES_OneToOne 0.00 255.0 /end CHARACTERISTIC
/begin CHARACTERISTIC DFES_FaultTyp.DFC_Layer_GENUPLNpl_C "DFES/Fehlertyp Zuordnung für Prüfung DFC_Layer_GENUPLNpl" VALUE 0x8002A79B Val_Wu8 255.0 DFES_OneToOne 0.00 255.0 /end CHARACTERISTIC
/begin CHARACTERISTIC DFES_FaultTyp.DFC_Layer_GENUPLSig_C "DFES/Fehlertyp Zuordnung für Prüfung DFC_Layer_GENUPLSig" VALUE 0x8002A79C Val_Wu8 255.0 DFES_OneToOne 0.00 255.0 /end CHARACTERISTIC
/begin CHARACTERISTIC DFES_FaultTyp.DFC_Layer_IBS1Max_C "DFES/Fehlertyp Zuordnung für Prüfung DFC_Layer_IBS1Max" VALUE 0x8002A79D Val_Wu8 255.0 DFES_OneToOne 0.00 255.0 /end CHARACTERISTIC
/begin CHARACTERISTIC DFES_FaultTyp.DFC_Layer_IBS1Min_C "DFES/Fehlertyp Zuordnung für Prüfung DFC_Layer_IBS1Min" VALUE 0x8002A79E Val_Wu8 255.0 DFES_OneToOne 0.00 255.0 /end CHARACTERISTIC
/begin CHARACTERISTIC DFES_FaultTyp.DFC_Layer_IBS1Npl_C "DFES/Fehlertyp Zuordnung für Prüfung DFC_Layer_IBS1Npl" VALUE 0x8002A79F Val_Wu8 255.0 DFES_OneToOne 0.00 255.0 /end CHARACTERISTIC
/begin CHARACTERISTIC DFES_FaultTyp.DFC_Layer_IBS1Sig_C "DFES/Fehlertyp Zuordnung für Prüfung DFC_Layer_IBS1Sig" VALUE 0x8002A7A0 Val_Wu8 255.0 DFES_OneToOne 0.00 255.0 /end CHARACTERISTIC
/begin CHARACTERISTIC DFES_FaultTyp.DFC_Layer_IBS2Max_C "DFES/Fehlertyp Zuordnung für Prüfung DFC_Layer_IBS2Max" VALUE 0x8002A7A1 Val_Wu8 255.0 DFES_OneToOne 0.00 255.0 /end CHARACTERISTIC
/begin CHARACTERISTIC DFES_FaultTyp.DFC_Layer_IBS2Min_C "DFES/Fehlertyp Zuordnung für Prüfung DFC_Layer_IBS2Min" VALUE 0x8002A7A2 Val_Wu8 255.0 DFES_OneToOne 0.00 255.0 /end CHARACTERISTIC
/begin CHARACTERISTIC DFES_FaultTyp.DFC_Layer_IBS2Npl_C "DFES/Fehlertyp Zuordnung für Prüfung DFC_Layer_IBS2Npl" VALUE 0x8002A7A3 Val_Wu8 255.0 DFES_OneToOne 0.00 255.0 /end CHARACTERISTIC
/begin CHARACTERISTIC DFES_FaultTyp.DFC_Layer_IBS2Sig_C "DFES/Fehlertyp Zuordnung für Prüfung DFC_Layer_IBS2Sig" VALUE 0x8002A7A4 Val_Wu8 255.0 DFES_OneToOne 0.00 255.0 /end CHARACTERISTIC
/begin CHARACTERISTIC DFES_FaultTyp.DFC_Layer_IBS3Max_C "DFES/Fehlertyp Zuordnung für Prüfung DFC_Layer_IBS3Max" VALUE 0x8002A7A5 Val_Wu8 255.0 DFES_OneToOne 0.00 255.0 /end CHARACTERISTIC
/begin CHARACTERISTIC DFES_FaultTyp.DFC_Layer_IBS3Min_C "DFES/Fehlertyp Zuordnung für Prüfung DFC_Layer_IBS3Min" VALUE 0x8002A7A6 Val_Wu8 255.0 DFES_OneToOne 0.00 255.0 /end CHARACTERISTIC
/begin CHARACTERISTIC DFES_FaultTyp.DFC_Layer_IBS3Npl_C "DFES/Fehlertyp Zuordnung für Prüfung DFC_Layer_IBS3Npl" VALUE 0x8002A7A7 Val_Wu8 255.0 DFES_OneToOne 0.00 255.0 /end CHARACTERISTIC
/begin CHARACTERISTIC DFES_FaultTyp.DFC_Layer_IBS3Sig_C "DFES/Fehlertyp Zuordnung für Prüfung DFC_Layer_IBS3Sig" VALUE 0x8002A7A8 Val_Wu8 255.0 DFES_OneToOne 0.00 255.0 /end CHARACTERISTIC
/begin CHARACTERISTIC DFES_FaultTyp.DFC_Layer_MANDETEKMax_C "DFES/Fehlertyp Zuordnung für Prüfung DFC_Layer_MANDETEKMax" VALUE 0x8002A7A9 Val_Wu8 255.0 DFES_OneToOne 0.00 255.0 /end CHARACTERISTIC
/begin CHARACTERISTIC DFES_FaultTyp.DFC_Layer_MANDETEKMin_C "DFES/Fehlertyp Zuordnung für Prüfung DFC_Layer_MANDETEKMin" VALUE 0x8002A7AA Val_Wu8 255.0 DFES_OneToOne 0.00 255.0 /end CHARACTERISTIC
/begin CHARACTERISTIC DFES_FaultTyp.DFC_Layer_MANDETEKNpl_C "DFES/Fehlertyp Zuordnung für Prüfung DFC_Layer_MANDETEKNpl" VALUE 0x8002A7AB Val_Wu8 255.0 DFES_OneToOne 0.00 255.0 /end CHARACTERISTIC
/begin CHARACTERISTIC DFES_FaultTyp.DFC_Layer_MANDETEKSig_C "DFES/Fehlertyp Zuordnung für Prüfung DFC_Layer_MANDETEKSig" VALUE 0x8002A7AC Val_Wu8 255.0 DFES_OneToOne 0.00 255.0 /end CHARACTERISTIC
/begin CHARACTERISTIC DFES_FaultTyp.DFC_Layer_NDR1Max_C "DFES/Fehlertyp Zuordnung für Prüfung DFC_Layer_NDR1Max" VALUE 0x8002A7AD Val_Wu8 255.0 DFES_OneToOne 0.00 255.0 /end CHARACTERISTIC
/begin CHARACTERISTIC DFES_FaultTyp.DFC_Layer_NDR1Min_C "DFES/Fehlertyp Zuordnung für Prüfung DFC_Layer_NDR1Min" VALUE 0x8002A7AE Val_Wu8 255.0 DFES_OneToOne 0.00 255.0 /end CHARACTERISTIC
/begin CHARACTERISTIC DFES_FaultTyp.DFC_Layer_NDR1Npl_C "DFES/Fehlertyp Zuordnung für Prüfung DFC_Layer_NDR1Npl" VALUE 0x8002A7AF Val_Wu8 255.0 DFES_OneToOne 0.00 255.0 /end CHARACTERISTIC
/begin CHARACTERISTIC DFES_FaultTyp.DFC_Layer_NDR1Sig_C "DFES/Fehlertyp Zuordnung für Prüfung DFC_Layer_NDR1Sig" VALUE 0x8002A7B0 Val_Wu8 255.0 DFES_OneToOne 0.00 255.0 /end CHARACTERISTIC
/begin CHARACTERISTIC DFES_FaultTyp.DFC_Layer_NDR2Max_C "DFES/Fehlertyp Zuordnung für Prüfung DFC_Layer_NDR2Max" VALUE 0x8002A7B1 Val_Wu8 255.0 DFES_OneToOne 0.00 255.0 /end CHARACTERISTIC
/begin CHARACTERISTIC DFES_FaultTyp.DFC_Layer_NDR2Min_C "DFES/Fehlertyp Zuordnung für Prüfung DFC_Layer_NDR2Min" VALUE 0x8002A7B2 Val_Wu8 255.0 DFES_OneToOne 0.00 255.0 /end CHARACTERISTIC
/begin CHARACTERISTIC DFES_FaultTyp.DFC_Layer_NDR2Npl_C "DFES/Fehlertyp Zuordnung für Prüfung DFC_Layer_NDR2Npl" VALUE 0x8002A7B3 Val_Wu8 255.0 DFES_OneToOne 0.00 255.0 /end CHARACTERISTIC
/begin CHARACTERISTIC DFES_FaultTyp.DFC_Layer_NDR2Sig_C "DFES/Fehlertyp Zuordnung für Prüfung DFC_Layer_NDR2Sig" VALUE 0x8002A7B4 Val_Wu8 255.0 DFES_OneToOne 0.00 255.0 /end CHARACTERISTIC
/begin CHARACTERISTIC DFES_FaultTyp.DFC_Layer_NGLERNMax_C "DFES/Fehlertyp Zuordnung für Prüfung DFC_Layer_NGLERNMax" VALUE 0x8002A7B5 Val_Wu8 255.0 DFES_OneToOne 0.00 255.0 /end CHARACTERISTIC
/begin CHARACTERISTIC DFES_FaultTyp.DFC_Layer_NGLERNMin_C "DFES/Fehlertyp Zuordnung für Prüfung DFC_Layer_NGLERNMin" VALUE 0x8002A7B6 Val_Wu8 255.0 DFES_OneToOne 0.00 255.0 /end CHARACTERISTIC
/begin CHARACTERISTIC DFES_FaultTyp.DFC_Layer_NGLERNNpl_C "DFES/Fehlertyp Zuordnung für Prüfung DFC_Layer_NGLERNNpl" VALUE 0x8002A7B7 Val_Wu8 255.0 DFES_OneToOne 0.00 255.0 /end CHARACTERISTIC
/begin CHARACTERISTIC DFES_FaultTyp.DFC_Layer_NGLERNSig_C "DFES/Fehlertyp Zuordnung für Prüfung DFC_Layer_NGLERNSig" VALUE 0x8002A7B8 Val_Wu8 255.0 DFES_OneToOne 0.00 255.0 /end CHARACTERISTIC
/begin CHARACTERISTIC DFES_FaultTyp.DFC_Layer_PMBATTMax_C "DFES/Fehlertyp Zuordnung für Prüfung DFC_Layer_PMBATTMax" VALUE 0x8002A7B9 Val_Wu8 255.0 DFES_OneToOne 0.00 255.0 /end CHARACTERISTIC
/begin CHARACTERISTIC DFES_FaultTyp.DFC_Layer_PMBATTMin_C "DFES/Fehlertyp Zuordnung für Prüfung DFC_Layer_PMBATTMin" VALUE 0x8002A7BA Val_Wu8 255.0 DFES_OneToOne 0.00 255.0 /end CHARACTERISTIC
/begin CHARACTERISTIC DFES_FaultTyp.DFC_Layer_PMBATTNpl_C "DFES/Fehlertyp Zuordnung für Prüfung DFC_Layer_PMBATTNpl" VALUE 0x8002A7BB Val_Wu8 255.0 DFES_OneToOne 0.00 255.0 /end CHARACTERISTIC
/begin CHARACTERISTIC DFES_FaultTyp.DFC_Layer_PMBATTSig_C "DFES/Fehlertyp Zuordnung für Prüfung DFC_Layer_PMBATTSig" VALUE 0x8002A7BC Val_Wu8 255.0 DFES_OneToOne 0.00 255.0 /end CHARACTERISTIC
/begin CHARACTERISTIC DFES_FaultTyp.DFC_Layer_PMBNMax_C "DFES/Fehlertyp Zuordnung für Prüfung DFC_Layer_PMBNMax" VALUE 0x8002A7BD Val_Wu8 255.0 DFES_OneToOne 0.00 255.0 /end CHARACTERISTIC
/begin CHARACTERISTIC DFES_FaultTyp.DFC_Layer_PMBNMin_C "DFES/Fehlertyp Zuordnung für Prüfung DFC_Layer_PMBNMin" VALUE 0x8002A7BE Val_Wu8 255.0 DFES_OneToOne 0.00 255.0 /end CHARACTERISTIC
/begin CHARACTERISTIC DFES_FaultTyp.DFC_Layer_PMBNNpl_C "DFES/Fehlertyp Zuordnung für Prüfung DFC_Layer_PMBNNpl" VALUE 0x8002A7BF Val_Wu8 255.0 DFES_OneToOne 0.00 255.0 /end CHARACTERISTIC
/begin CHARACTERISTIC DFES_FaultTyp.DFC_Layer_PMBNSig_C "DFES/Fehlertyp Zuordnung für Prüfung DFC_Layer_PMBNSig" VALUE 0x8002A7C0 Val_Wu8 255.0 DFES_OneToOne 0.00 255.0 /end CHARACTERISTIC
/begin CHARACTERISTIC DFES_FaultTyp.DFC_Layer_PMRUHVERLMax_C "DFES/Fehlertyp Zuordnung für Prüfung DFC_Layer_PMRUHVERLMax" VALUE 0x8002A7C1 Val_Wu8 255.0 DFES_OneToOne 0.00 255.0 /end CHARACTERISTIC
/begin CHARACTERISTIC DFES_FaultTyp.DFC_Layer_PMRUHVERLMin_C "DFES/Fehlertyp Zuordnung für Prüfung DFC_Layer_PMRUHVERLMin" VALUE 0x8002A7C2 Val_Wu8 255.0 DFES_OneToOne 0.00 255.0 /end CHARACTERISTIC
/begin CHARACTERISTIC DFES_FaultTyp.DFC_Layer_PMRUHVERLNpl_C "DFES/Fehlertyp Zuordnung für Prüfung DFC_Layer_PMRUHVERLNpl" VALUE 0x8002A7C3 Val_Wu8 255.0 DFES_OneToOne 0.00 255.0 /end CHARACTERISTIC
/begin CHARACTERISTIC DFES_FaultTyp.DFC_Layer_PMRUHVERLSig_C "DFES/Fehlertyp Zuordnung für Prüfung DFC_Layer_PMRUHVERLSig" VALUE 0x8002A7C4 Val_Wu8 255.0 DFES_OneToOne 0.00 255.0 /end CHARACTERISTIC
/begin CHARACTERISTIC DFES_FaultTyp.DFC_Layer_QLTMax_C "DFES/Fehlertyp Zuordnung für Prüfung DFC_Layer_QLTMax" VALUE 0x8002A7C5 Val_Wu8 255.0 DFES_OneToOne 0.00 255.0 /end CHARACTERISTIC
/begin CHARACTERISTIC DFES_FaultTyp.DFC_Layer_QLTMin_C "DFES/Fehlertyp Zuordnung für Prüfung DFC_Layer_QLTMin" VALUE 0x8002A7C6 Val_Wu8 255.0 DFES_OneToOne 0.00 255.0 /end CHARACTERISTIC
/begin CHARACTERISTIC DFES_FaultTyp.DFC_Layer_QLTNpl_C "DFES/Fehlertyp Zuordnung für Prüfung DFC_Layer_QLTNpl" VALUE 0x8002A7C7 Val_Wu8 255.0 DFES_OneToOne 0.00 255.0 /end CHARACTERISTIC
/begin CHARACTERISTIC DFES_FaultTyp.DFC_Layer_QLTSig_C "DFES/Fehlertyp Zuordnung für Prüfung DFC_Layer_QLTSig" VALUE 0x8002A7C8 Val_Wu8 255.0 DFES_OneToOne 0.00 255.0 /end CHARACTERISTIC
/begin CHARACTERISTIC DFES_FaultTyp.DFC_Layer_TOENSMax_C "DFES/Fehlertyp Zuordnung für Prüfung DFC_Layer_TOENSMax" VALUE 0x8002A7C9 Val_Wu8 255.0 DFES_OneToOne 0.00 255.0 /end CHARACTERISTIC
/begin CHARACTERISTIC DFES_FaultTyp.DFC_Layer_TOENSMin_C "DFES/Fehlertyp Zuordnung für Prüfung DFC_Layer_TOENSMin" VALUE 0x8002A7CA Val_Wu8 255.0 DFES_OneToOne 0.00 255.0 /end CHARACTERISTIC
/begin CHARACTERISTIC DFES_FaultTyp.DFC_Layer_TOENSNpl_C "DFES/Fehlertyp Zuordnung für Prüfung DFC_Layer_TOENSNpl" VALUE 0x8002A7CB Val_Wu8 255.0 DFES_OneToOne 0.00 255.0 /end CHARACTERISTIC
/begin CHARACTERISTIC DFES_FaultTyp.DFC_Layer_TOENSSig_C "DFES/Fehlertyp Zuordnung für Prüfung DFC_Layer_TOENSSig" VALUE 0x8002A7CC Val_Wu8 255.0 DFES_OneToOne 0.00 255.0 /end CHARACTERISTIC
/begin CHARACTERISTIC DFES_FaultTyp.DFC_MonLimCurr_C "DFES/Fehlertyp Zuordnung für Prüfung DFC_MonLimCurr" VALUE 0x8002A7CD Val_Wu8 255.0 DFES_OneToOne 0.00 255.0 /end CHARACTERISTIC
/begin CHARACTERISTIC DFES_FaultTyp.DFC_MonLimLead_C "DFES/Fehlertyp Zuordnung für Prüfung DFC_MonLimLead" VALUE 0x8002A7CE Val_Wu8 255.0 DFES_OneToOne 0.00 255.0 /end CHARACTERISTIC
/begin CHARACTERISTIC DFES_FaultTyp.DFC_MonLimSet_C "DFES/Fehlertyp Zuordnung für Prüfung DFC_MonLimSet" VALUE 0x8002A7CF Val_Wu8 255.0 DFES_OneToOne 0.00 255.0 /end CHARACTERISTIC
/begin CHARACTERISTIC DFES_FaultTyp.DFC_NSCDsNOxOfsMax_C "DFES/Fehlertyp Zuordnung für Prüfung DFC_NSCDsNOxOfsMax" VALUE 0x8002A7D0 Val_Wu8 255.0 DFES_OneToOne 0.00 255.0 /end CHARACTERISTIC
/begin CHARACTERISTIC DFES_FaultTyp.DFC_NSCDsNOxOfsMin_C "DFES/Fehlertyp Zuordnung für Prüfung DFC_NSCDsNOxOfsMin" VALUE 0x8002A7D1 Val_Wu8 255.0 DFES_OneToOne 0.00 255.0 /end CHARACTERISTIC
/begin CHARACTERISTIC DFES_FaultTyp.DFC_NSCDsNOxPlausMin_C "DFES/Fehlertyp Zuordnung für Prüfung DFC_NSCDsNOxPlausMin" VALUE 0x8002A7D2 Val_Wu8 255.0 DFES_OneToOne 0.00 255.0 /end CHARACTERISTIC
/begin CHARACTERISTIC DFES_FaultTyp.DFC_NoCat2DsNOxOfsMax_C "DFES/Fehlertyp Zuordnung für Prüfung DFC_NoCat2DsNOxOfsMax" VALUE 0x8002A7D3 Val_Wu8 255.0 DFES_OneToOne 0.00 255.0 /end CHARACTERISTIC
/begin CHARACTERISTIC DFES_FaultTyp.DFC_NoCat2DsNOxOfsMin_C "DFES/Fehlertyp Zuordnung für Prüfung DFC_NoCat2DsNOxOfsMin" VALUE 0x8002A7D4 Val_Wu8 255.0 DFES_OneToOne 0.00 255.0 /end CHARACTERISTIC
/begin CHARACTERISTIC DFES_FaultTyp.DFC_NoCat2DsNOxPlausMin_C "DFES/Fehlertyp Zuordnung für Prüfung DFC_NoCat2DsNOxPlausMin" VALUE 0x8002A7D5 Val_Wu8 255.0 DFES_OneToOne 0.00 255.0 /end CHARACTERISTIC
/begin CHARACTERISTIC DFES_FaultTyp.DFC_PCVNoStrt_C "DFES/Fehlertyp Zuordnung für Prüfung DFC_PCVNoStrt" VALUE 0x8002A7D6 Val_Wu8 255.0 DFES_OneToOne 0.00 255.0 /end CHARACTERISTIC
/begin CHARACTERISTIC DFES_FaultTyp.DFC_RailPGradMon_C "DFES/Fehlertyp Zuordnung für Prüfung DFC_RailPGradMon" VALUE 0x8002A7D7 Val_Wu8 255.0 DFES_OneToOne 0.00 255.0 /end CHARACTERISTIC
/begin CHARACTERISTIC DFES_FaultTyp.DFC_SCRPODPresBuildUp_C "DFES/Fehlertyp Zuordnung für Prüfung DFC_SCRPODPresBuildUp" VALUE 0x8002A7D8 Val_Wu8 255.0 DFES_OneToOne 0.00 255.0 /end CHARACTERISTIC
/begin CHARACTERISTIC DFES_FaultTyp.DFC_AFSDrftIdlAdjVal_C "DFES/Fehlertyp Zuordnung für Prüfung DFC_AFSDrftIdlAdjVal" VALUE 0x8002A7D9 Val_Wu8 255.0 DFES_OneToOne 0.00 255.0 /end CHARACTERISTIC
/begin CHARACTERISTIC DFES_FaultTyp.DFC_AFSDrftLdAdjVal_C "DFES/Fehlertyp Zuordnung für Prüfung DFC_AFSDrftLdAdjVal" VALUE 0x8002A7DA Val_Wu8 255.0 DFES_OneToOne 0.00 255.0 /end CHARACTERISTIC
/begin CHARACTERISTIC DFES_FaultTyp.DFC_AdcIADC0Cal_C "DFES/Fehlertyp Zuordnung für Prüfung DFC_AdcIADC0Cal" VALUE 0x8002A7DB Val_Wu8 255.0 DFES_OneToOne 0.00 255.0 /end CHARACTERISTIC
/begin CHARACTERISTIC DFES_FaultTyp.DFC_AdcIADC0Conv_C "DFES/Fehlertyp Zuordnung für Prüfung DFC_AdcIADC0Conv" VALUE 0x8002A7DC Val_Wu8 255.0 DFES_OneToOne 0.00 255.0 /end CHARACTERISTIC
/begin CHARACTERISTIC DFES_FaultTyp.DFC_AdcIADC1Cal_C "DFES/Fehlertyp Zuordnung für Prüfung DFC_AdcIADC1Cal" VALUE 0x8002A7DD Val_Wu8 255.0 DFES_OneToOne 0.00 255.0 /end CHARACTERISTIC
/begin CHARACTERISTIC DFES_FaultTyp.DFC_AdcIADC1Conv_C "DFES/Fehlertyp Zuordnung für Prüfung DFC_AdcIADC1Conv" VALUE 0x8002A7DE Val_Wu8 255.0 DFES_OneToOne 0.00 255.0 /end CHARACTERISTIC
/begin CHARACTERISTIC DFES_FaultTyp.DFC_CmbChbMisfireMax_0_C "DFES/Fehlertyp Zuordnung für Prüfung DFC_CmbChbMisfireMax_0" VALUE 0x8002A7DF Val_Wu8 255.0 DFES_OneToOne 0.00 255.0 /end CHARACTERISTIC
/begin CHARACTERISTIC DFES_FaultTyp.DFC_CmbChbMisfireMax_1_C "DFES/Fehlertyp Zuordnung für Prüfung DFC_CmbChbMisfireMax_1" VALUE 0x8002A7E0 Val_Wu8 255.0 DFES_OneToOne 0.00 255.0 /end CHARACTERISTIC
/begin CHARACTERISTIC DFES_FaultTyp.DFC_CmbChbMisfireMax_2_C "DFES/Fehlertyp Zuordnung für Prüfung DFC_CmbChbMisfireMax_2" VALUE 0x8002A7E1 Val_Wu8 255.0 DFES_OneToOne 0.00 255.0 /end CHARACTERISTIC
/begin CHARACTERISTIC DFES_FaultTyp.DFC_CmbChbMisfireMax_3_C "DFES/Fehlertyp Zuordnung für Prüfung DFC_CmbChbMisfireMax_3" VALUE 0x8002A7E2 Val_Wu8 255.0 DFES_OneToOne 0.00 255.0 /end CHARACTERISTIC
/begin CHARACTERISTIC DFES_FaultTyp.DFC_CmbChbMisfireMax_4_C "DFES/Fehlertyp Zuordnung für Prüfung DFC_CmbChbMisfireMax_4" VALUE 0x8002A7E3 Val_Wu8 255.0 DFES_OneToOne 0.00 255.0 /end CHARACTERISTIC
/begin CHARACTERISTIC DFES_FaultTyp.DFC_CmbChbMisfireMax_5_C "DFES/Fehlertyp Zuordnung für Prüfung DFC_CmbChbMisfireMax_5" VALUE 0x8002A7E4 Val_Wu8 255.0 DFES_OneToOne 0.00 255.0 /end CHARACTERISTIC
/begin CHARACTERISTIC DFES_FaultTyp.DFC_CmbChbMisfireMul_C "DFES/Fehlertyp Zuordnung für Prüfung DFC_CmbChbMisfireMul" VALUE 0x8002A7E5 Val_Wu8 255.0 DFES_OneToOne 0.00 255.0 /end CHARACTERISTIC
/begin CHARACTERISTIC DFES_FaultTyp.DFC_EGRVlvLPOfsNeutr_C "DFES/" VALUE 0x8002A7E6 Val_Wu8 255.0 DFES_OneToOne 0.00 255.0 /end CHARACTERISTIC
/begin CHARACTERISTIC DFES_FaultTyp.DFC_EGRVlvOfsNeutr_C "DFES/Fehlertyp Zuordnung für Prüfung DFC_EGRVlvOfsNeutr" VALUE 0x8002A7E7 Val_Wu8 255.0 DFES_OneToOne 0.00 255.0 /end CHARACTERISTIC
/begin CHARACTERISTIC DFES_FaultTyp.DFC_FMAErrModMax_C "DFES/Fehlertyp Zuordnung für Prüfung DFC_FMAErrModMax" VALUE 0x8002A7E8 Val_Wu8 255.0 DFES_OneToOne 0.00 255.0 /end CHARACTERISTIC
/begin CHARACTERISTIC DFES_FaultTyp.DFC_FMAErrModMin_C "DFES/Fehlertyp Zuordnung für Prüfung DFC_FMAErrModMin" VALUE 0x8002A7E9 Val_Wu8 255.0 DFES_OneToOne 0.00 255.0 /end CHARACTERISTIC
/begin CHARACTERISTIC DFES_FaultTyp.DFC_FlSysTnkLo_C "DFES/Fehlertyp Zuordnung für Prüfung DFC_FlSysTnkLo" VALUE 0x8002A7EA Val_Wu8 255.0 DFES_OneToOne 0.00 255.0 /end CHARACTERISTIC
/begin CHARACTERISTIC DFES_FaultTyp.DFC_GbxNPosPlaus_C "DFES/Fehlertyp Zuordnung für Prüfung DFC_GbxNPosPlaus" VALUE 0x8002A7EB Val_Wu8 255.0 DFES_OneToOne 0.00 255.0 /end CHARACTERISTIC
/begin CHARACTERISTIC DFES_FaultTyp.DFC_I14229_ROETst_Appl_C "DFES/" VALUE 0x8002A7EC Val_Wu8 255.0 DFES_OneToOne 0.00 255.0 /end CHARACTERISTIC
/begin CHARACTERISTIC DFES_FaultTyp.DFC_I14229_ROETst_Netw_C "DFES/" VALUE 0x8002A7ED Val_Wu8 255.0 DFES_OneToOne 0.00 255.0 /end CHARACTERISTIC
/begin CHARACTERISTIC DFES_FaultTyp.DFC_I14229_ROE_BufFull_C "DFES/" VALUE 0x8002A7EE Val_Wu8 255.0 DFES_OneToOne 0.00 255.0 /end CHARACTERISTIC
/begin CHARACTERISTIC DFES_FaultTyp.DFC_IVAdjDiaIVAdj_C "DFES/Fehlertyp Zuordnung für Prüfung DFC_IVAdjDiaIVAdj" VALUE 0x8002A7EF Val_Wu8 255.0 DFES_OneToOne 0.00 255.0 /end CHARACTERISTIC
/begin CHARACTERISTIC DFES_FaultTyp.DFC_IVAdjIVA_0_C "DFES/Fehlertyp Zuordnung für Prüfung DFC_IVAdjIVA_0" VALUE 0x8002A7F0 Val_Wu8 255.0 DFES_OneToOne 0.00 255.0 /end CHARACTERISTIC
/begin CHARACTERISTIC DFES_FaultTyp.DFC_IVAdjIVA_1_C "DFES/Fehlertyp Zuordnung für Prüfung DFC_IVAdjIVA_1" VALUE 0x8002A7F1 Val_Wu8 255.0 DFES_OneToOne 0.00 255.0 /end CHARACTERISTIC
/begin CHARACTERISTIC DFES_FaultTyp.DFC_IVAdjIVA_2_C "DFES/Fehlertyp Zuordnung für Prüfung DFC_IVAdjIVA_2" VALUE 0x8002A7F2 Val_Wu8 255.0 DFES_OneToOne 0.00 255.0 /end CHARACTERISTIC
/begin CHARACTERISTIC DFES_FaultTyp.DFC_IVAdjIVA_3_C "DFES/Fehlertyp Zuordnung für Prüfung DFC_IVAdjIVA_3" VALUE 0x8002A7F3 Val_Wu8 255.0 DFES_OneToOne 0.00 255.0 /end CHARACTERISTIC
/begin CHARACTERISTIC DFES_FaultTyp.DFC_IVAdjIVA_4_C "DFES/Fehlertyp Zuordnung für Prüfung DFC_IVAdjIVA_4" VALUE 0x8002A7F4 Val_Wu8 255.0 DFES_OneToOne 0.00 255.0 /end CHARACTERISTIC
/begin CHARACTERISTIC DFES_FaultTyp.DFC_IVAdjIVA_5_C "DFES/Fehlertyp Zuordnung für Prüfung DFC_IVAdjIVA_5" VALUE 0x8002A7F5 Val_Wu8 255.0 DFES_OneToOne 0.00 255.0 /end CHARACTERISTIC
/begin CHARACTERISTIC DFES_FaultTyp.DFC_IVPSplyDCDCOff_0_C "DFES/Fehlertyp Zuordnung für Prüfung DFC_IVPSplyDCDCOff_0" VALUE 0x8002A7F6 Val_Wu8 255.0 DFES_OneToOne 0.00 255.0 /end CHARACTERISTIC
/begin CHARACTERISTIC DFES_FaultTyp.DFC_IVPSplyDCDCOff_1_C "DFES/Fehlertyp Zuordnung für Prüfung DFC_IVPSplyDCDCOff_1" VALUE 0x8002A7F7 Val_Wu8 255.0 DFES_OneToOne 0.00 255.0 /end CHARACTERISTIC
/begin CHARACTERISTIC DFES_FaultTyp.DFC_IVPSplyDCDCOff_2_C "DFES/Fehlertyp Zuordnung für Prüfung DFC_IVPSplyDCDCOff_2" VALUE 0x8002A7F8 Val_Wu8 255.0 DFES_OneToOne 0.00 255.0 /end CHARACTERISTIC
/begin CHARACTERISTIC DFES_FaultTyp.DFC_IVPSplyDCDCOff_3_C "DFES/Fehlertyp Zuordnung für Prüfung DFC_IVPSplyDCDCOff_3" VALUE 0x8002A7F9 Val_Wu8 255.0 DFES_OneToOne 0.00 255.0 /end CHARACTERISTIC
/begin CHARACTERISTIC DFES_FaultTyp.DFC_InjCtlAdjQntEEPCS_C "DFES/Fehlertyp Zuordnung für Prüfung DFC_InjCtlAdjQntEEPCS" VALUE 0x8002A7FA Val_Wu8 255.0 DFES_OneToOne 0.00 255.0 /end CHARACTERISTIC
/begin CHARACTERISTIC DFES_FaultTyp.DFC_LSUSPISig_C "DFES/Fehlertyp Zuordnung für Prüfung DFC_LSUSPISig" VALUE 0x8002A7FB Val_Wu8 255.0 DFES_OneToOne 0.00 255.0 /end CHARACTERISTIC
/begin CHARACTERISTIC DFES_FaultTyp.DFC_Layer_Dummy_C "DFES/Fehlertyp Zuordnung für Prüfung DFC_Layer_Dummy" VALUE 0x8002A7FC Val_Wu8 255.0 DFES_OneToOne 0.00 255.0 /end CHARACTERISTIC
/begin CHARACTERISTIC DFES_FaultTyp.DFC_NplEnvPSensPPFltDiff_C "DFES/Fehlertyp Zuordnung für Prüfung DFC_NplEnvPSensPPFltDiff" VALUE 0x8002A7FD Val_Wu8 255.0 DFES_OneToOne 0.00 255.0 /end CHARACTERISTIC
/begin CHARACTERISTIC DFES_FaultTyp.DFC_NplPresSensPPFltDiff_C "DFES/Fehlertyp Zuordnung für Prüfung DFC_NplPresSensPPFltDiff" VALUE 0x8002A7FE Val_Wu8 255.0 DFES_OneToOne 0.00 255.0 /end CHARACTERISTIC
/begin CHARACTERISTIC DFES_FaultTyp.DFC_OilLvlPlaus_C "DFES/Fehlertyp Zuordnung für Prüfung DFC_OilLvlPlaus" VALUE 0x8002A7FF Val_Wu8 255.0 DFES_OneToOne 0.00 255.0 /end CHARACTERISTIC
/begin CHARACTERISTIC DFES_FaultTyp.DFC_OilTOutLvl_C "DFES/Fehlertyp Zuordnung für Prüfung DFC_OilTOutLvl" VALUE 0x8002A800 Val_Wu8 255.0 DFES_OneToOne 0.00 255.0 /end CHARACTERISTIC
/begin CHARACTERISTIC DFES_FaultTyp.DFC_PCVfacAdaptMax_C "DFES/Fehlertyp Zuordnung für Prüfung DFC_PCVfacAdaptMax" VALUE 0x8002A801 Val_Wu8 255.0 DFES_OneToOne 0.00 255.0 /end CHARACTERISTIC
/begin CHARACTERISTIC DFES_FaultTyp.DFC_PCVfacAdaptMin_C "DFES/Fehlertyp Zuordnung für Prüfung DFC_PCVfacAdaptMin" VALUE 0x8002A802 Val_Wu8 255.0 DFES_OneToOne 0.00 255.0 /end CHARACTERISTIC
/begin CHARACTERISTIC DFES_FaultTyp.DFC_SensFrzPPFltUs_C "DFES/Fehlertyp Zuordnung für Prüfung DFC_SensFrzPPFltUs" VALUE 0x8002A803 Val_Wu8 255.0 DFES_OneToOne 0.00 255.0 /end CHARACTERISTIC
/begin CHARACTERISTIC DFES_FaultTyp.DFC_SensMonUTnkLvl_C "DFES/Fehlertyp Zuordnung für Prüfung DFC_SensMonUTnkLvl" VALUE 0x8002A804 Val_Wu8 255.0 DFES_OneToOne 0.00 255.0 /end CHARACTERISTIC
/begin CHARACTERISTIC DFES_FaultTyp.DFC_T15Sig_C "DFES/Fehlertyp Zuordnung für Prüfung DFC_T15Sig" VALUE 0x8002A805 Val_Wu8 255.0 DFES_OneToOne 0.00 255.0 /end CHARACTERISTIC
/begin CHARACTERISTIC DFES_FaultTyp.DFC_AirCtlRmpTOut_C "DFES/Fehlertyp Zuordnung für Prüfung DFC_AirCtlRmpTOut" VALUE 0x8002A806 Val_Wu8 255.0 DFES_OneToOne 0.00 255.0 /end CHARACTERISTIC
/begin CHARACTERISTIC DFES_FaultTyp.DFC_BrkPPlaus_C "DFES/Fehlertyp Zuordnung für Prüfung DFC_BrkPPlaus" VALUE 0x8002A807 Val_Wu8 255.0 DFES_OneToOne 0.00 255.0 /end CHARACTERISTIC
/begin CHARACTERISTIC DFES_FaultTyp.DFC_CEngDsTDynTst_C "DFES/Fehlertyp Zuordnung für Prüfung DFC_CEngDsTDynTst" VALUE 0x8002A808 Val_Wu8 255.0 DFES_OneToOne 0.00 255.0 /end CHARACTERISTIC
/begin CHARACTERISTIC DFES_FaultTyp.DFC_EEPEraseErr_C "DFES/Fehlertyp Zuordnung für Prüfung DFC_EEPEraseErr" VALUE 0x8002A809 Val_Wu8 255.0 DFES_OneToOne 0.00 255.0 /end CHARACTERISTIC
/begin CHARACTERISTIC DFES_FaultTyp.DFC_EEPRdErr_C "DFES/Fehlertyp Zuordnung für Prüfung DFC_EEPRdErr" VALUE 0x8002A80A Val_Wu8 255.0 DFES_OneToOne 0.00 255.0 /end CHARACTERISTIC
/begin CHARACTERISTIC DFES_FaultTyp.DFC_EEPWrErr_C "DFES/Fehlertyp Zuordnung für Prüfung DFC_EEPWrErr" VALUE 0x8002A80B Val_Wu8 255.0 DFES_OneToOne 0.00 255.0 /end CHARACTERISTIC
/begin CHARACTERISTIC DFES_FaultTyp.DFC_EGRVlvJamVlvClsd_C "DFES/Fehlertyp Zuordnung für Prüfung DFC_EGRVlvJamVlvClsd" VALUE 0x8002A80C Val_Wu8 255.0 DFES_OneToOne 0.00 255.0 /end CHARACTERISTIC
/begin CHARACTERISTIC DFES_FaultTyp.DFC_EGRVlvJamVlvOpn_C "DFES/Fehlertyp Zuordnung für Prüfung DFC_EGRVlvJamVlvOpn" VALUE 0x8002A80D Val_Wu8 255.0 DFES_OneToOne 0.00 255.0 /end CHARACTERISTIC
/begin CHARACTERISTIC DFES_FaultTyp.DFC_EGRVlvLPJamVlvClsd_C "DFES/Fehlertyp Zuordnung für Prüfung DFC_EGRVlvLPJamVlvClsd" VALUE 0x8002A80E Val_Wu8 255.0 DFES_OneToOne 0.00 255.0 /end CHARACTERISTIC
/begin CHARACTERISTIC DFES_FaultTyp.DFC_EGRVlvLPJamVlvOpn_C "DFES/Fehlertyp Zuordnung für Prüfung DFC_EGRVlvLPJamVlvOpn" VALUE 0x8002A80F Val_Wu8 255.0 DFES_OneToOne 0.00 255.0 /end CHARACTERISTIC
/begin CHARACTERISTIC DFES_FaultTyp.DFC_EGRVlvLPLgTDrft_C "DFES/Fehlertyp Zuordnung für Prüfung DFC_EGRVlvLPLgTDrft" VALUE 0x8002A810 Val_Wu8 255.0 DFES_OneToOne 0.00 255.0 /end CHARACTERISTIC
/begin CHARACTERISTIC DFES_FaultTyp.DFC_EGRVlvLPOfsLrnJamVlv_C "DFES/Fehlertyp Zuordnung für Prüfung DFC_EGRVlvLPOfsLrnJamVlv" VALUE 0x8002A811 Val_Wu8 255.0 DFES_OneToOne 0.00 255.0 /end CHARACTERISTIC
/begin CHARACTERISTIC DFES_FaultTyp.DFC_EGRVlvLPShTDrft_C "DFES/Fehlertyp Zuordnung für Prüfung DFC_EGRVlvLPShTDrft" VALUE 0x8002A812 Val_Wu8 255.0 DFES_OneToOne 0.00 255.0 /end CHARACTERISTIC
/begin CHARACTERISTIC DFES_FaultTyp.DFC_EGRVlvLgTDrft_C "DFES/Fehlertyp Zuordnung für Prüfung DFC_EGRVlvLgTDrft" VALUE 0x8002A813 Val_Wu8 255.0 DFES_OneToOne 0.00 255.0 /end CHARACTERISTIC
/begin CHARACTERISTIC DFES_FaultTyp.DFC_EGRVlvOfsLrnJamVlv_C "DFES/Fehlertyp Zuordnung für Prüfung DFC_EGRVlvOfsLrnJamVlv" VALUE 0x8002A814 Val_Wu8 255.0 DFES_OneToOne 0.00 255.0 /end CHARACTERISTIC
/begin CHARACTERISTIC DFES_FaultTyp.DFC_EGRVlvShTDrft_C "DFES/Fehlertyp Zuordnung für Prüfung DFC_EGRVlvShTDrft" VALUE 0x8002A815 Val_Wu8 255.0 DFES_OneToOne 0.00 255.0 /end CHARACTERISTIC
/begin CHARACTERISTIC DFES_FaultTyp.DFC_EngICO_C "DFES/Fehlertyp Zuordnung für Prüfung DFC_EngICO" VALUE 0x8002A816 Val_Wu8 255.0 DFES_OneToOne 0.00 255.0 /end CHARACTERISTIC
/begin CHARACTERISTIC DFES_FaultTyp.DFC_EpmCaSI1ErrSig_C "DFES/Fehlertyp Zuordnung für Prüfung DFC_EpmCaSI1ErrSig" VALUE 0x8002A817 Val_Wu8 255.0 DFES_OneToOne 0.00 255.0 /end CHARACTERISTIC
/begin CHARACTERISTIC DFES_FaultTyp.DFC_EpmCaSI1NoSig_C "DFES/Fehlertyp Zuordnung für Prüfung DFC_EpmCaSI1NoSig" VALUE 0x8002A818 Val_Wu8 255.0 DFES_OneToOne 0.00 255.0 /end CHARACTERISTIC
/begin CHARACTERISTIC DFES_FaultTyp.DFC_EpmCaSI1OfsErr_C "DFES/Fehlertyp Zuordnung für Prüfung DFC_EpmCaSI1OfsErr" VALUE 0x8002A819 Val_Wu8 255.0 DFES_OneToOne 0.00 255.0 /end CHARACTERISTIC
/begin CHARACTERISTIC DFES_FaultTyp.DFC_EpmCrSErrSig_C "DFES/Fehlertyp Zuordnung für Prüfung DFC_EpmCrSErrSig" VALUE 0x8002A81A Val_Wu8 255.0 DFES_OneToOne 0.00 255.0 /end CHARACTERISTIC
/begin CHARACTERISTIC DFES_FaultTyp.DFC_EpmCrSNoSig_C "DFES/Fehlertyp Zuordnung für Prüfung DFC_EpmCrSNoSig" VALUE 0x8002A81B Val_Wu8 255.0 DFES_OneToOne 0.00 255.0 /end CHARACTERISTIC
/begin CHARACTERISTIC DFES_FaultTyp.DFC_IVPlausComprTst_C "DFES/Fehlertyp Zuordnung für Prüfung DFC_IVPlausComprTst" VALUE 0x8002A81C Val_Wu8 255.0 DFES_OneToOne 0.00 255.0 /end CHARACTERISTIC
/begin CHARACTERISTIC DFES_FaultTyp.DFC_IVPlausRunUpTst_C "DFES/Fehlertyp Zuordnung für Prüfung DFC_IVPlausRunUpTst" VALUE 0x8002A81D Val_Wu8 255.0 DFES_OneToOne 0.00 255.0 /end CHARACTERISTIC
/begin CHARACTERISTIC DFES_FaultTyp.DFC_InjCrvShOffTst_C "DFES/Fehlertyp Zuordnung für Prüfung DFC_InjCrvShOffTst" VALUE 0x8002A81E Val_Wu8 255.0 DFES_OneToOne 0.00 255.0 /end CHARACTERISTIC
/begin CHARACTERISTIC DFES_FaultTyp.DFC_LayerEnSavModProd_C "DFES/Fehlertyp Zuordnung für Prüfung DFC_LayerEnSavModProd" VALUE 0x8002A81F Val_Wu8 255.0 DFES_OneToOne 0.00 255.0 /end CHARACTERISTIC
/begin CHARACTERISTIC DFES_FaultTyp.DFC_LayerEnSavModRep_C "DFES/Fehlertyp Zuordnung für Prüfung DFC_LayerEnSavModRep" VALUE 0x8002A820 Val_Wu8 255.0 DFES_OneToOne 0.00 255.0 /end CHARACTERISTIC
/begin CHARACTERISTIC DFES_FaultTyp.DFC_LayerEnSavModShip_C "DFES/Fehlertyp Zuordnung für Prüfung DFC_LayerEnSavModShip" VALUE 0x8002A821 Val_Wu8 255.0 DFES_OneToOne 0.00 255.0 /end CHARACTERISTIC
/begin CHARACTERISTIC DFES_FaultTyp.DFC_MRlyErlyOpng_C "DFES/Fehlertyp Zuordnung für Prüfung DFC_MRlyErlyOpng" VALUE 0x8002A822 Val_Wu8 255.0 DFES_OneToOne 0.00 255.0 /end CHARACTERISTIC
/begin CHARACTERISTIC DFES_FaultTyp.DFC_MRlyStk_C "DFES/Fehlertyp Zuordnung für Prüfung DFC_MRlyStk" VALUE 0x8002A823 Val_Wu8 255.0 DFES_OneToOne 0.00 255.0 /end CHARACTERISTIC
/begin CHARACTERISTIC DFES_FaultTyp.DFC_MeUnActrTst_C "DFES/Fehlertyp Zuordnung für Prüfung DFC_MeUnActrTst" VALUE 0x8002A824 Val_Wu8 255.0 DFES_OneToOne 0.00 255.0 /end CHARACTERISTIC
/begin CHARACTERISTIC DFES_FaultTyp.DFC_MoCADCCmp_C "DFES/Fehlertyp Zuordnung für Prüfung DFC_MoCADCCmp" VALUE 0x8002A825 Val_Wu8 255.0 DFES_OneToOne 0.00 255.0 /end CHARACTERISTIC
/begin CHARACTERISTIC DFES_FaultTyp.DFC_MoCADCTst_C "DFES/Fehlertyp Zuordnung für Prüfung DFC_MoCADCTst" VALUE 0x8002A826 Val_Wu8 255.0 DFES_OneToOne 0.00 255.0 /end CHARACTERISTIC
/begin CHARACTERISTIC DFES_FaultTyp.DFC_MoCADCVltgRatio_C "DFES/Fehlertyp Zuordnung für Prüfung DFC_MoCADCVltgRatio" VALUE 0x8002A827 Val_Wu8 255.0 DFES_OneToOne 0.00 255.0 /end CHARACTERISTIC
/begin CHARACTERISTIC DFES_FaultTyp.DFC_MoCComErrCnt_C "DFES/Fehlertyp Zuordnung für Prüfung DFC_MoCComErrCnt" VALUE 0x8002A828 Val_Wu8 255.0 DFES_OneToOne 0.00 255.0 /end CHARACTERISTIC
/begin CHARACTERISTIC DFES_FaultTyp.DFC_MoCComSPI_C "DFES/Fehlertyp Zuordnung für Prüfung DFC_MoCComSPI" VALUE 0x8002A829 Val_Wu8 255.0 DFES_OneToOne 0.00 255.0 /end CHARACTERISTIC
/begin CHARACTERISTIC DFES_FaultTyp.DFC_MoCROMErrXPg_C "DFES/Fehlertyp Zuordnung für Prüfung DFC_MoCROMErrXPg" VALUE 0x8002A82A Val_Wu8 255.0 DFES_OneToOne 0.00 255.0 /end CHARACTERISTIC
/begin CHARACTERISTIC DFES_FaultTyp.DFC_MoCSOPHwNoRdy_C "DFES/Fehlertyp Zuordnung für Prüfung DFC_MoCSOPHwNoRdy" VALUE 0x8002A82B Val_Wu8 255.0 DFES_OneToOne 0.00 255.0 /end CHARACTERISTIC
/begin CHARACTERISTIC DFES_FaultTyp.DFC_MoCSOPLoLi_C "DFES/Fehlertyp Zuordnung für Prüfung DFC_MoCSOPLoLi" VALUE 0x8002A82C Val_Wu8 255.0 DFES_OneToOne 0.00 255.0 /end CHARACTERISTIC
/begin CHARACTERISTIC DFES_FaultTyp.DFC_MoCSOPMM_C "DFES/Fehlertyp Zuordnung für Prüfung DFC_MoCSOPMM" VALUE 0x8002A82D Val_Wu8 255.0 DFES_OneToOne 0.00 255.0 /end CHARACTERISTIC
/begin CHARACTERISTIC DFES_FaultTyp.DFC_MoCSOPTimeOut_C "DFES/Fehlertyp Zuordnung für Prüfung DFC_MoCSOPTimeOut" VALUE 0x8002A82E Val_Wu8 255.0 DFES_OneToOne 0.00 255.0 /end CHARACTERISTIC
/begin CHARACTERISTIC DFES_FaultTyp.DFC_MoCSOPUpLi_C "DFES/Fehlertyp Zuordnung für Prüfung DFC_MoCSOPUpLi" VALUE 0x8002A82F Val_Wu8 255.0 DFES_OneToOne 0.00 255.0 /end CHARACTERISTIC
/begin CHARACTERISTIC DFES_FaultTyp.DFC_MoFAPP_C "DFES/Fehlertyp Zuordnung für Prüfung DFC_MoFAPP" VALUE 0x8002A830 Val_Wu8 255.0 DFES_OneToOne 0.00 255.0 /end CHARACTERISTIC
/begin CHARACTERISTIC DFES_FaultTyp.DFC_MoFESpd_C "DFES/Fehlertyp Zuordnung für Prüfung DFC_MoFESpd" VALUE 0x8002A831 Val_Wu8 255.0 DFES_OneToOne 0.00 255.0 /end CHARACTERISTIC
/begin CHARACTERISTIC DFES_FaultTyp.DFC_MoFInjDatPhi_C "DFES/Fehlertyp Zuordnung für Prüfung DFC_MoFInjDatPhi" VALUE 0x8002A832 Val_Wu8 255.0 DFES_OneToOne 0.00 255.0 /end CHARACTERISTIC
/begin CHARACTERISTIC DFES_FaultTyp.DFC_MoFInjDatQnt_C "DFES/Fehlertyp Zuordnung für Prüfung DFC_MoFInjDatQnt" VALUE 0x8002A833 Val_Wu8 255.0 DFES_OneToOne 0.00 255.0 /end CHARACTERISTIC
/begin CHARACTERISTIC DFES_FaultTyp.DFC_MoFInjQnt_C "DFES/Fehlertyp Zuordnung für Prüfung DFC_MoFInjQnt" VALUE 0x8002A834 Val_Wu8 255.0 DFES_OneToOne 0.00 255.0 /end CHARACTERISTIC
/begin CHARACTERISTIC DFES_FaultTyp.DFC_MoFMode1PoI1_C "DFES/Fehlertyp Zuordnung für Prüfung DFC_MoFMode1PoI1" VALUE 0x8002A835 Val_Wu8 255.0 DFES_OneToOne 0.00 255.0 /end CHARACTERISTIC
/begin CHARACTERISTIC DFES_FaultTyp.DFC_MoFMode1PoI2_C "DFES/Fehlertyp Zuordnung für Prüfung DFC_MoFMode1PoI2" VALUE 0x8002A836 Val_Wu8 255.0 DFES_OneToOne 0.00 255.0 /end CHARACTERISTIC
/begin CHARACTERISTIC DFES_FaultTyp.DFC_MoFMode2PoI1_C "DFES/Fehlertyp Zuordnung für Prüfung DFC_MoFMode2PoI1" VALUE 0x8002A837 Val_Wu8 255.0 DFES_OneToOne 0.00 255.0 /end CHARACTERISTIC
/begin CHARACTERISTIC DFES_FaultTyp.DFC_MoFMode2PoI2_C "DFES/Fehlertyp Zuordnung für Prüfung DFC_MoFMode2PoI2" VALUE 0x8002A838 Val_Wu8 255.0 DFES_OneToOne 0.00 255.0 /end CHARACTERISTIC
/begin CHARACTERISTIC DFES_FaultTyp.DFC_MoFOvR_C "DFES/Fehlertyp Zuordnung für Prüfung DFC_MoFOvR" VALUE 0x8002A839 Val_Wu8 255.0 DFES_OneToOne 0.00 255.0 /end CHARACTERISTIC
/begin CHARACTERISTIC DFES_FaultTyp.DFC_MoFQntCor_C "DFES/Fehlertyp Zuordnung für Prüfung DFC_MoFQntCor" VALUE 0x8002A83A Val_Wu8 255.0 DFES_OneToOne 0.00 255.0 /end CHARACTERISTIC
/begin CHARACTERISTIC DFES_FaultTyp.DFC_MoFRailP_C "DFES/Fehlertyp Zuordnung für Prüfung DFC_MoFRailP" VALUE 0x8002A83B Val_Wu8 255.0 DFES_OneToOne 0.00 255.0 /end CHARACTERISTIC
/begin CHARACTERISTIC DFES_FaultTyp.DFC_MoFTrqCmp_C "DFES/Fehlertyp Zuordnung für Prüfung DFC_MoFTrqCmp" VALUE 0x8002A83C Val_Wu8 255.0 DFES_OneToOne 0.00 255.0 /end CHARACTERISTIC
/begin CHARACTERISTIC DFES_FaultTyp.DFC_NSCDsHtrSetP_C "DFES/Fehlertyp Zuordnung für Prüfung DFC_NSCDsHtrSetP" VALUE 0x8002A83D Val_Wu8 255.0 DFES_OneToOne 0.00 255.0 /end CHARACTERISTIC
/begin CHARACTERISTIC DFES_FaultTyp.DFC_NoCat2DsHtrSetP_C "DFES/Fehlertyp Zuordnung für Prüfung DFC_NoCat2DsHtrSetP" VALUE 0x8002A83E Val_Wu8 255.0 DFES_OneToOne 0.00 255.0 /end CHARACTERISTIC
/begin CHARACTERISTIC DFES_FaultTyp.DFC_PCVActrTst_C "DFES/Fehlertyp Zuordnung für Prüfung DFC_PCVActrTst" VALUE 0x8002A83F Val_Wu8 255.0 DFES_OneToOne 0.00 255.0 /end CHARACTERISTIC
/begin CHARACTERISTIC DFES_FaultTyp.DFC_PhyModNonMonMapNpl_C "DFES/Fehlertyp Zuordnung für Prüfung DFC_PhyModNonMonMapNpl" VALUE 0x8002A840 Val_Wu8 255.0 DFES_OneToOne 0.00 255.0 /end CHARACTERISTIC
/begin CHARACTERISTIC DFES_FaultTyp.DFC_RailHpTst_C "DFES/Fehlertyp Zuordnung für Prüfung DFC_RailHpTst" VALUE 0x8002A841 Val_Wu8 255.0 DFES_OneToOne 0.00 255.0 /end CHARACTERISTIC
/begin CHARACTERISTIC DFES_FaultTyp.DFC_RailPOfsTstMax_C "DFES/Fehlertyp Zuordnung für Prüfung DFC_RailPOfsTstMax" VALUE 0x8002A842 Val_Wu8 255.0 DFES_OneToOne 0.00 255.0 /end CHARACTERISTIC
/begin CHARACTERISTIC DFES_FaultTyp.DFC_RailPOfsTstMin_C "DFES/Fehlertyp Zuordnung für Prüfung DFC_RailPOfsTstMin" VALUE 0x8002A843 Val_Wu8 255.0 DFES_OneToOne 0.00 255.0 /end CHARACTERISTIC
/begin CHARACTERISTIC DFES_FaultTyp.DFC_SIA_E1max_C "DFES/Fehlertyp Zuordnung für Prüfung DFC_SIA_E1max" VALUE 0x8002A844 Val_Wu8 255.0 DFES_OneToOne 0.00 255.0 /end CHARACTERISTIC
/begin CHARACTERISTIC DFES_FaultTyp.DFC_SIA_E1min_C "DFES/Fehlertyp Zuordnung für Prüfung DFC_SIA_E1min" VALUE 0x8002A845 Val_Wu8 255.0 DFES_OneToOne 0.00 255.0 /end CHARACTERISTIC
/begin CHARACTERISTIC DFES_FaultTyp.DFC_SIA_E1npl_C "DFES/Fehlertyp Zuordnung für Prüfung DFC_SIA_E1npl" VALUE 0x8002A846 Val_Wu8 255.0 DFES_OneToOne 0.00 255.0 /end CHARACTERISTIC
/begin CHARACTERISTIC DFES_FaultTyp.DFC_SIA_E1sig_C "DFES/Fehlertyp Zuordnung für Prüfung DFC_SIA_E1sig" VALUE 0x8002A847 Val_Wu8 255.0 DFES_OneToOne 0.00 255.0 /end CHARACTERISTIC
/begin CHARACTERISTIC DFES_FaultTyp.DFC_SIA_E2max_C "DFES/Fehlertyp Zuordnung für Prüfung DFC_SIA_E2max" VALUE 0x8002A848 Val_Wu8 255.0 DFES_OneToOne 0.00 255.0 /end CHARACTERISTIC
/begin CHARACTERISTIC DFES_FaultTyp.DFC_SIA_E2min_C "DFES/Fehlertyp Zuordnung für Prüfung DFC_SIA_E2min" VALUE 0x8002A849 Val_Wu8 255.0 DFES_OneToOne 0.00 255.0 /end CHARACTERISTIC
/begin CHARACTERISTIC DFES_FaultTyp.DFC_SIA_E2npl_C "DFES/Fehlertyp Zuordnung für Prüfung DFC_SIA_E2npl" VALUE 0x8002A84A Val_Wu8 255.0 DFES_OneToOne 0.00 255.0 /end CHARACTERISTIC
/begin CHARACTERISTIC DFES_FaultTyp.DFC_SIA_E2sig_C "DFES/Fehlertyp Zuordnung für Prüfung DFC_SIA_E2sig" VALUE 0x8002A84B Val_Wu8 255.0 DFES_OneToOne 0.00 255.0 /end CHARACTERISTIC
/begin CHARACTERISTIC DFES_FaultTyp.DFC_SIA_E3max_C "DFES/Fehlertyp Zuordnung für Prüfung DFC_SIA_E3max" VALUE 0x8002A84C Val_Wu8 255.0 DFES_OneToOne 0.00 255.0 /end CHARACTERISTIC
/begin CHARACTERISTIC DFES_FaultTyp.DFC_SIA_E3min_C "DFES/Fehlertyp Zuordnung für Prüfung DFC_SIA_E3min" VALUE 0x8002A84D Val_Wu8 255.0 DFES_OneToOne 0.00 255.0 /end CHARACTERISTIC
/begin CHARACTERISTIC DFES_FaultTyp.DFC_SIA_E3npl_C "DFES/Fehlertyp Zuordnung für Prüfung DFC_SIA_E3npl" VALUE 0x8002A84E Val_Wu8 255.0 DFES_OneToOne 0.00 255.0 /end CHARACTERISTIC
/begin CHARACTERISTIC DFES_FaultTyp.DFC_SIA_E3sig_C "DFES/Fehlertyp Zuordnung für Prüfung DFC_SIA_E3sig" VALUE 0x8002A84F Val_Wu8 255.0 DFES_OneToOne 0.00 255.0 /end CHARACTERISTIC
/begin CHARACTERISTIC DFES_FaultTyp.DFC_SIA_E4max_C "DFES/Fehlertyp Zuordnung für Prüfung DFC_SIA_E4max" VALUE 0x8002A850 Val_Wu8 255.0 DFES_OneToOne 0.00 255.0 /end CHARACTERISTIC
/begin CHARACTERISTIC DFES_FaultTyp.DFC_SIA_E4min_C "DFES/Fehlertyp Zuordnung für Prüfung DFC_SIA_E4min" VALUE 0x8002A851 Val_Wu8 255.0 DFES_OneToOne 0.00 255.0 /end CHARACTERISTIC
/begin CHARACTERISTIC DFES_FaultTyp.DFC_SIA_E4npl_C "DFES/Fehlertyp Zuordnung für Prüfung DFC_SIA_E4npl" VALUE 0x8002A852 Val_Wu8 255.0 DFES_OneToOne 0.00 255.0 /end CHARACTERISTIC
/begin CHARACTERISTIC DFES_FaultTyp.DFC_SIA_E4sig_C "DFES/Fehlertyp Zuordnung für Prüfung DFC_SIA_E4sig" VALUE 0x8002A853 Val_Wu8 255.0 DFES_OneToOne 0.00 255.0 /end CHARACTERISTIC
/begin CHARACTERISTIC DFES_FaultTyp.DFC_SWReset_0_C "DFES/Fehlertyp Zuordnung für Prüfung DFC_SWReset_0" VALUE 0x8002A854 Val_Wu8 255.0 DFES_OneToOne 0.00 255.0 /end CHARACTERISTIC
/begin CHARACTERISTIC DFES_FaultTyp.DFC_SWReset_1_C "DFES/Fehlertyp Zuordnung für Prüfung DFC_SWReset_1" VALUE 0x8002A855 Val_Wu8 255.0 DFES_OneToOne 0.00 255.0 /end CHARACTERISTIC
/begin CHARACTERISTIC DFES_FaultTyp.DFC_SWReset_2_C "DFES/Fehlertyp Zuordnung für Prüfung DFC_SWReset_2" VALUE 0x8002A856 Val_Wu8 255.0 DFES_OneToOne 0.00 255.0 /end CHARACTERISTIC
/begin CHARACTERISTIC DFES_FaultTyp.DFC_ShtrAKKMax_C "DFES/Fehlertyp Zuordnung für Prüfung DFC_ShtrAKKMax" VALUE 0x8002A857 Val_Wu8 255.0 DFES_OneToOne 0.00 255.0 /end CHARACTERISTIC
/begin CHARACTERISTIC DFES_FaultTyp.DFC_ShtrAKKMin_C "DFES/Fehlertyp Zuordnung für Prüfung DFC_ShtrAKKMin" VALUE 0x8002A858 Val_Wu8 255.0 DFES_OneToOne 0.00 255.0 /end CHARACTERISTIC
/begin CHARACTERISTIC DFES_FaultTyp.DFC_ShtrAKKNpl_C "DFES/Fehlertyp Zuordnung für Prüfung DFC_ShtrAKKNpl" VALUE 0x8002A859 Val_Wu8 255.0 DFES_OneToOne 0.00 255.0 /end CHARACTERISTIC
/begin CHARACTERISTIC DFES_FaultTyp.DFC_ShtrPKKMax_C "DFES/Fehlertyp Zuordnung für Prüfung DFC_ShtrPKKMax" VALUE 0x8002A85A Val_Wu8 255.0 DFES_OneToOne 0.00 255.0 /end CHARACTERISTIC
/begin CHARACTERISTIC DFES_FaultTyp.DFC_StopCntTmr_C "DFES/Fehlertyp Zuordnung für Prüfung DFC_StopCntTmr" VALUE 0x8002A85B Val_Wu8 255.0 DFES_OneToOne 0.00 255.0 /end CHARACTERISTIC
/begin CHARACTERISTIC DFES_FaultTyp.DFC_ThrVlvMon_C "DFES/Fehlertyp Zuordnung für Prüfung DFC_ThrVlvMon" VALUE 0x8002A85C Val_Wu8 255.0 DFES_OneToOne 0.00 255.0 /end CHARACTERISTIC
/begin CHARACTERISTIC DFES_FaultTyp.DFC_VSwVlvJamVlv_C "DFES/Fehlertyp Zuordnung für Prüfung DFC_VSwVlvJamVlv" VALUE 0x8002A85D Val_Wu8 255.0 DFES_OneToOne 0.00 255.0 /end CHARACTERISTIC
/begin CHARACTERISTIC DFES_FaultTyp.DFC_VSwVlvLgTDrft_C "DFES/Fehlertyp Zuordnung für Prüfung DFC_VSwVlvLgTDrft" VALUE 0x8002A85E Val_Wu8 255.0 DFES_OneToOne 0.00 255.0 /end CHARACTERISTIC
/begin CHARACTERISTIC DFES_FaultTyp.DFC_VSwVlvOfsLrnJamVlv_C "DFES/Fehlertyp Zuordnung für Prüfung DFC_VSwVlvOfsLrnJamVlv" VALUE 0x8002A85F Val_Wu8 255.0 DFES_OneToOne 0.00 255.0 /end CHARACTERISTIC
/begin CHARACTERISTIC DFES_FaultTyp.DFC_VSwVlvOfsNeutr_C "DFES/Fehlertyp Zuordnung für Prüfung DFC_VSwVlvOfsNeutr" VALUE 0x8002A860 Val_Wu8 255.0 DFES_OneToOne 0.00 255.0 /end CHARACTERISTIC
/begin CHARACTERISTIC DFES_FaultTyp.DFC_VSwVlvShTDrft_C "DFES/Fehlertyp Zuordnung für Prüfung DFC_VSwVlvShTDrft" VALUE 0x8002A861 Val_Wu8 255.0 DFES_OneToOne 0.00 255.0 /end CHARACTERISTIC
/begin CHARACTERISTIC DFES_FaultTyp.DFC_VSwVlvSpgDef_C "DFES/Fehlertyp Zuordnung für Prüfung DFC_VSwVlvSpgDef" VALUE 0x8002A862 Val_Wu8 255.0 DFES_OneToOne 0.00 255.0 /end CHARACTERISTIC
/begin CHARACTERISTIC DFES_MonEvtMSK0_C "Filter für die Ausgabe der Fehlerspeicherüberwachung - Bits auf 0 setzen, um mit 0 zu filtern" VALUE 0x80023834 Val_Wu16 65535.00 OneToOne 0.00 65535.00 /end CHARACTERISTIC
/begin CHARACTERISTIC DFES_MonEvtMSK1_C "Filter für die Ausgabe der Fehlerspeicherüberwachung - Bits auf 1 setzen, um mit 1 zu filtern" VALUE 0x80023836 Val_Wu16 65535.00 OneToOne 0.00 65535.00 /end CHARACTERISTIC
/begin CHARACTERISTIC DFES_MonRepeat_C "Ausgabemodus Fehlerpeicherüberwachung, auf 1 setzen um gleiche Meldungen nacheinander zu verhindern" VALUE 0x80023838 Val_Wu8 255.0 OneToOne 0.00 255.0 /end CHARACTERISTIC
/begin CHARACTERISTIC DFES_numClsDlt_CA "Fehlerklassenparameter: Initialisierungswert OBD Löschzähler DLC" VAL_BLK 0x80023839 ValA_Wu8 255.0 DFES_OneToOne 0.00 255.0 NUMBER 30 /end CHARACTERISTIC
/begin CHARACTERISTIC DFES_numClsFaultCycl_CA "Fehlerklassenparameter: Initialisierungswert Fehlerzähler FLC" VAL_BLK 0x80023857 ValA_Wu8 255.0 DFES_OneToOne 0.00 255.0 NUMBER 30 /end CHARACTERISTIC
/begin CHARACTERISTIC DFES_numClsHealCycl_CA "Fehlerklassenparameter: Initialisierungswert Heilungszähler HLC" VAL_BLK 0x80023875 ValA_Wu8 255.0 DFES_OneToOne 0.00 255.0 NUMBER 30 /end CHARACTERISTIC
/begin FUNCTION DFES ""
 /begin DEF_CHARACTERISTIC DFES_FaultTyp.DFC_ComSpeedVehicleTo_FX_C DFES_FaultTyp.DFC_ComStConintDSCChk_FX_C DFES_FaultTyp.DFC_ComStConintDSCCtr_FX_C DFES_FaultTyp.DFC_ComStConintDSCTo_FX_C DFES_FaultTyp.DFC_ComStatACFrontSig_FA_C DFES_FaultTyp.DFC_ComStatACFrontTo_FA_C DFES_FaultTyp.DFC_ComStatEkpSig_A_C DFES_FaultTyp.DFC_ComStatEkpTo_A_C DFES_FaultTyp.DFC_ComStatGearRevSig_FA_C DFES_FaultTyp.DFC_ComStatGearRevTo_FA_C DFES_FaultTyp.DFC_ComStatZVKlappenSig_FA_C DFES_FaultTyp.DFC_ComStatZVKlappenTo_FA_C DFES_FaultTyp.DFC_ComStateARSCtr_C DFES_FaultTyp.DFC_ComStateARSSig_C DFES_FaultTyp.DFC_ComStateARSTo_C DFES_FaultTyp.DFC_ComStateDscSig_C DFES_FaultTyp.DFC_ComStateDscTo_C DFES_FaultTyp.DFC_ComStateSeatSig_C DFES_FaultTyp.DFC_ComStateSeatSig_FA_C DFES_FaultTyp.DFC_ComStateSeatTo_C DFES_FaultTyp.DFC_ComStateSeatTo_FA_C DFES_FaultTyp.DFC_ComStatusEGSSig_A_C DFES_FaultTyp.DFC_ComStatusEGSSig_FA_C DFES_FaultTyp.DFC_ComStatusEGSTo_A_C DFES_FaultTyp.DFC_ComStatusEGSTo_FA_C DFES_FaultTyp.DFC_ComStatusEMFChk_C DFES_FaultTyp.DFC_ComStatusEMFCtr_C DFES_FaultTyp.DFC_ComStatusEMFSig_C DFES_FaultTyp.DFC_ComStatusEMFTo_C DFES_FaultTyp.DFC_ComStatusRGangSig_C DFES_FaultTyp.DFC_ComStatusRGangTo_C DFES_FaultTyp.DFC_ComSteeringAngleChk_FX_C DFES_FaultTyp.DFC_ComSteeringAngleCtr_FX_C DFES_FaultTyp.DFC_ComSteeringAngleTo_FX_C DFES_FaultTyp.DFC_ComTerminalChk_C DFES_FaultTyp.DFC_ComTerminalCtr_C DFES_FaultTyp.DFC_ComTerminalSig_C DFES_FaultTyp.DFC_ComTerminalTo_C DFES_FaultTyp.DFC_ComTimeDateSig_FA_C DFES_FaultTyp.DFC_ComTimeDateTo_FA_C DFES_FaultTyp.DFC_ComTrailerSig_C DFES_FaultTyp.DFC_ComTrailerSig_FA_C DFES_FaultTyp.DFC_ComTrailerTo_C DFES_FaultTyp.DFC_ComTrailerTo_FA_C DFES_FaultTyp.DFC_ComTrqDemCrshDrDyChk_FX_C DFES_FaultTyp.DFC_ComTrqDemCrshDrDyCtr_FX_C DFES_FaultTyp.DFC_ComTrqDemCrshDrDyTo_FX_C DFES_FaultTyp.DFC_ComTrqDemandDesSig_C DFES_FaultTyp.DFC_ComTrqDemandDesTo_C DFES_FaultTyp.DFC_ComTrqDemandDscChk_C DFES_FaultTyp.DFC_ComTrqDemandDscCtr_C DFES_FaultTyp.DFC_ComTrqDemandDscSig_C DFES_FaultTyp.DFC_ComTrqDemandDscTo_C DFES_FaultTyp.DFC_ComTrqDemandGbxChk_A_C DFES_FaultTyp.DFC_ComTrqDemandGbxChk_FA_C DFES_FaultTyp.DFC_ComTrqDemandGbxCtr_A_C DFES_FaultTyp.DFC_ComTrqDemandGbxCtr_FA_C DFES_FaultTyp.DFC_ComTrqDemandGbxSig_A_C DFES_FaultTyp.DFC_ComTrqDemandGbxSig_FA_C DFES_FaultTyp.DFC_ComTrqDemandGbxTo_A_C DFES_FaultTyp.DFC_ComTrqDemandGbxTo_FA_C DFES_FaultTyp.DFC_ComTrqWhlDemChk_C DFES_FaultTyp.DFC_ComTrqWhlDemCtr_C DFES_FaultTyp.DFC_ComTrqWhlDemFASChk_FX_C DFES_FaultTyp.DFC_ComTrqWhlDemFASCtr_FX_C DFES_FaultTyp.DFC_ComTrqWhlDemFASTo_FX_C DFES_FaultTyp.DFC_ComTrqWhlDemSig_C DFES_FaultTyp.DFC_ComTrqWhlDemTo_C DFES_FaultTyp.DFC_ComVelocityChk_FA_C DFES_FaultTyp.DFC_ComVelocityCtr_FA_C DFES_FaultTyp.DFC_ComVelocitySig_C DFES_FaultTyp.DFC_ComVelocitySig_FA_C DFES_FaultTyp.DFC_ComVelocityTo_C DFES_FaultTyp.DFC_ComVelocityTo_FA_C DFES_FaultTyp.DFC_ComVerbraucherTo_C DFES_FaultTyp.DFC_ComWMomPTStabChk_FX_C DFES_FaultTyp.DFC_ComWMomPTStabCtr_FX_C DFES_FaultTyp.DFC_ComWMomPTStabTo_FX_C DFES_FaultTyp.DFC_ComWheelSpeedSig_C DFES_FaultTyp.DFC_ComWheelSpeedTo_C DFES_FaultTyp.DFC_ComZvKlappenSig_C DFES_FaultTyp.DFC_ComZvKlappenTo_C DFES_FaultTyp.DFC_ComaDirectChk_FX_C DFES_FaultTyp.DFC_ComaDirectCtr_FX_C DFES_FaultTyp.DFC_ComaDirectTo_FX_C DFES_FaultTyp.DFC_ComaSideChk_FX_C DFES_FaultTyp.DFC_ComaSideCtr_FX_C DFES_FaultTyp.DFC_ComaSideTo_FX_C DFES_FaultTyp.DFC_Cy320SpiCom_C DFES_FaultTyp.DFC_ETCtlDvtInrMax_C DFES_FaultTyp.DFC_ETCtlDvtInrMin_C DFES_FaultTyp.DFC_ETCtlDvtOutrMax_C DFES_FaultTyp.DFC_ETCtlDvtOutrMin_C DFES_FaultTyp.DFC_FBCqDvtMax_C DFES_FaultTyp.DFC_FBCqDvtMin_C DFES_FaultTyp.DFC_Fan4WinErr1_C DFES_FaultTyp.DFC_Fan4WinErr2_C DFES_FaultTyp.DFC_Fan4WinErr3_C DFES_FaultTyp.DFC_Fan4WinErr4_C DFES_FaultTyp.DFC_FanSCG_C DFES_FaultTyp.DFC_FlFCBS_C DFES_FaultTyp.DFC_GlwEcuConfigErr_C DFES_FaultTyp.DFC_GlwEcuEepErr_C DFES_FaultTyp.DFC_GlwEcuFrmErr_C DFES_FaultTyp.DFC_GlwEcuGPCMFaultInfo_C DFES_FaultTyp.DFC_GlwEcuGPCMInfo_C DFES_FaultTyp.DFC_GlwEcuGk1HSS_C DFES_FaultTyp.DFC_GlwEcuGk1OL_C DFES_FaultTyp.DFC_GlwEcuGk1SC_C DFES_FaultTyp.DFC_GlwEcuGk1Wdst_C DFES_FaultTyp.DFC_GlwEcuGk2HSS_C DFES_FaultTyp.DFC_GlwEcuGk2OL_C DFES_FaultTyp.DFC_GlwEcuGk2SC_C DFES_FaultTyp.DFC_GlwEcuGk2Wdst_C DFES_FaultTyp.DFC_GlwEcuGk3HSS_C DFES_FaultTyp.DFC_GlwEcuGk3OL_C DFES_FaultTyp.DFC_GlwEcuGk3SC_C DFES_FaultTyp.DFC_GlwEcuGk3Wdst_C DFES_FaultTyp.DFC_GlwEcuGk4HSS_C DFES_FaultTyp.DFC_GlwEcuGk4OL_C DFES_FaultTyp.DFC_GlwEcuGk4SC_C DFES_FaultTyp.DFC_GlwEcuGk4Wdst_C DFES_FaultTyp.DFC_GlwEcuGk5HSS_C DFES_FaultTyp.DFC_GlwEcuGk5OL_C DFES_FaultTyp.DFC_GlwEcuGk5SC_C DFES_FaultTyp.DFC_GlwEcuGk5Wdst_C DFES_FaultTyp.DFC_GlwEcuGk6HSS_C DFES_FaultTyp.DFC_GlwEcuGk6OL_C DFES_FaultTyp.DFC_GlwEcuGk6SC_C DFES_FaultTyp.DFC_GlwEcuGk6Wdst_C DFES_FaultTyp.DFC_GlwEcuGndErr_C DFES_FaultTyp.DFC_GlwEcuIntErr_C DFES_FaultTyp.DFC_GlwEcuMsgTimeout_C DFES_FaultTyp.DFC_GlwEcuT30Err_C DFES_FaultTyp.DFC_GlwEcuTempErr_C DFES_FaultTyp.DFC_GlwEcuUdiffT30_C DFES_FaultTyp.DFC_IBSComErr_C DFES_FaultTyp.DFC_LubSRCOilFldtCrit_C DFES_FaultTyp.DFC_LubSRCOilFldtCritDflMin_C DFES_FaultTyp.DFC_LubSRCOilLvlCritMax_C DFES_FaultTyp.DFC_LubSRCOilLvlCritMin_C DFES_FaultTyp.DFC_LubSRCTot_C DFES_FaultTyp.DFC_MonUMaxSupply1_C DFES_FaultTyp.DFC_MonUMinSupply1_C DFES_FaultTyp.DFC_OilComNpl_C DFES_FaultTyp.DFC_PCBS_C DFES_FaultTyp.DFC_PCBSPFltChg_C DFES_FaultTyp.DFC_PCRGovDvtLPMax_C DFES_FaultTyp.DFC_PCRGovDvtLPMin_C DFES_FaultTyp.DFC_PCRGovDvtMax_C DFES_FaultTyp.DFC_PCRGovDvtMin_C DFES_FaultTyp.DFC_PFltAPSPlausMAX_C DFES_FaultTyp.DFC_PFltAPSPlausMIN_C DFES_FaultTyp.DFC_PFltBPSPlausMAX_C DFES_FaultTyp.DFC_PFltBPSPlausMIN_C DFES_FaultTyp.DFC_PFltOvldInhRgn_C DFES_FaultTyp.DFC_PFltOvldTrqLim_C DFES_FaultTyp.DFC_PFltPresPlausMAX_C DFES_FaultTyp.DFC_PFltPresPlausMIN_C DFES_FaultTyp.DFC_PFltTraRpmRdc_C DFES_FaultTyp.DFC_PFlt_tOxiPreMax_C DFES_FaultTyp.DFC_PFlt_tOxiPreMaxRgn_C DFES_FaultTyp.DFC_PFlt_tOxiPreNpl_C DFES_FaultTyp.DFC_PFlt_tPreMax_C DFES_FaultTyp.DFC_PFlt_tPreMaxRgn_C DFES_FaultTyp.DFC_PFlt_tPreNpl_C DFES_FaultTyp.DFC_PFltmSotDiffMAX_C DFES_FaultTyp.DFC_PFltmSotDiffMIN_C DFES_FaultTyp.DFC_PFltmSotDiffSIG_C DFES_FaultTyp.DFC_PIntkVUsEnvPPls_C DFES_FaultTyp.DFC_PresPlausDblDef_C DFES_FaultTyp.DFC_RailCPC1_C DFES_FaultTyp.DFC_RailCPC3_C DFES_FaultTyp.DFC_RailCPC4_C DFES_FaultTyp.DFC_RailMeUn0_C DFES_FaultTyp.DFC_RailMeUn1_C DFES_FaultTyp.DFC_RailMeUn2_C DFES_FaultTyp.DFC_RailMeUn22_C DFES_FaultTyp.DFC_RailMeUn3_C DFES_FaultTyp.DFC_RailMeUn4_C DFES_FaultTyp.DFC_RailMeUn42_C DFES_FaultTyp.DFC_RailMeUn5_C DFES_FaultTyp.DFC_RailPCV0_C DFES_FaultTyp.DFC_RailPCV1_C DFES_FaultTyp.DFC_RailPCV2_C DFES_FaultTyp.DFC_RailPCV22_C DFES_FaultTyp.DFC_RailPCV3_C DFES_FaultTyp.DFC_RailPCV4_C DFES_FaultTyp.DFC_RailPCV42_C DFES_FaultTyp.DFC_RailPMonStrt_C DFES_FaultTyp.DFC_SSpMon1_C DFES_FaultTyp.DFC_SSpMon2_C DFES_FaultTyp.DFC_SSpMon3_C DFES_FaultTyp.DFC_ThrVlv4WinErr1_C DFES_FaultTyp.DFC_ThrVlv4WinErr2_C DFES_FaultTyp.DFC_ThrVlv4WinErr3_C DFES_FaultTyp.DFC_ThrVlv4WinErr4_C DFES_FaultTyp.DFC_ThrVlvSCG_C DFES_FaultTyp.DFC_Tle6232Spi1_C DFES_FaultTyp.DFC_TrbCh4WinErr1_C DFES_FaultTyp.DFC_TrbCh4WinErr2_C DFES_FaultTyp.DFC_TrbCh4WinErr3_C DFES_FaultTyp.DFC_TrbCh4WinErr4_C DFES_FaultTyp.DFC_TrbChSCG_C DFES_FaultTyp.DFC_TrbChSRCMax_C DFES_FaultTyp.DFC_TrbChSRCMin_C DFES_FaultTyp.DFC_WaHtEl4WinErr1_C DFES_FaultTyp.DFC_WaHtEl4WinErr2_C DFES_FaultTyp.DFC_WaHtEl4WinErr3_C DFES_FaultTyp.DFC_WaHtEl4WinErr4_C DFES_FaultTyp.DFC_WaHtElSCG_C DFES_FaultTyp.DFC_ETClbETFltMax_0_C DFES_FaultTyp.DFC_ETClbETFltMax_1_C DFES_FaultTyp.DFC_ETClbETFltMax_2_C DFES_FaultTyp.DFC_ETClbETFltMax_3_C DFES_FaultTyp.DFC_ETClbETFltMax_4_C DFES_FaultTyp.DFC_ETClbETFltMax_5_C DFES_FaultTyp.DFC_ETClbETFltMin_0_C DFES_FaultTyp.DFC_ETClbETFltMin_1_C DFES_FaultTyp.DFC_ETClbETFltMin_2_C DFES_FaultTyp.DFC_ETClbETFltMin_3_C DFES_FaultTyp.DFC_ETClbETFltMin_4_C DFES_FaultTyp.DFC_ETClbETFltMin_5_C DFES_FaultTyp.DFC_InjCrvInjLimChrgBal_C DFES_FaultTyp.DFC_InjCrvInjLimQntBal_C DFES_FaultTyp.DFC_InjCrvInjLimSys_C DFES_FaultTyp.DFC_InjCrvNumInjRtmLim_C DFES_FaultTyp.DFC_LSUHtCoupSig_C DFES_FaultTyp.DFC_AFS_SSpShOffOL_C DFES_FaultTyp.DFC_AFS_SSpShOffOvrTemp_C DFES_FaultTyp.DFC_AFS_SSpShOffSCB_C DFES_FaultTyp.DFC_AFS_SSpShOffSCG_C DFES_FaultTyp.DFC_AirCCmprOL_C DFES_FaultTyp.DFC_AirCCmprOvrTemp_C DFES_FaultTyp.DFC_AirCCmprSCB_C DFES_FaultTyp.DFC_AirCCmprSCG_C DFES_FaultTyp.DFC_CByVlvOL_C DFES_FaultTyp.DFC_CByVlvOvrTemp_C DFES_FaultTyp.DFC_CByVlvSCB_C DFES_FaultTyp.DFC_CByVlvSCG_C DFES_FaultTyp.DFC_CThmstOL_C DFES_FaultTyp.DFC_CThmstOvrTemp_C DFES_FaultTyp.DFC_CThmstSCB_C DFES_FaultTyp.DFC_CThmstSCG_C DFES_FaultTyp.DFC_DSMDummy_C DFES_FaultTyp.DFC_EBxFanOL_C DFES_FaultTyp.DFC_EBxFanOvrTemp_C DFES_FaultTyp.DFC_EBxFanSCB_C DFES_FaultTyp.DFC_EBxFanSCG_C DFES_FaultTyp.DFC_ECBVlvOL_C DFES_FaultTyp.DFC_ECBVlvOvrTemp_C DFES_FaultTyp.DFC_ECBVlvSCB_C DFES_FaultTyp.DFC_ECBVlvSCG_C DFES_FaultTyp.DFC_EMDmpOL_0_C DFES_FaultTyp.DFC_EMDmpOL_1_C DFES_FaultTyp.DFC_EMDmpOvrTemp_0_C DFES_FaultTyp.DFC_EMDmpOvrTemp_1_C DFES_FaultTyp.DFC_EMDmpSCB_0_C DFES_FaultTyp.DFC_EMDmpSCB_1_C DFES_FaultTyp.DFC_EMDmpSCG_0_C DFES_FaultTyp.DFC_EMDmpSCG_1_C DFES_FaultTyp.DFC_EngStAOL_C DFES_FaultTyp.DFC_EngStAOvrTemp_C DFES_FaultTyp.DFC_EngStASCB_C DFES_FaultTyp.DFC_EngStASCG_C DFES_FaultTyp.DFC_FanOL_C DFES_FaultTyp.DFC_FanOvrTemp_C DFES_FaultTyp.DFC_FanSCB_C DFES_FaultTyp.DFC_FlFltHtOL_C DFES_FaultTyp.DFC_FlFltHtOvrTemp_C DFES_FaultTyp.DFC_FlFltHtSCB_C DFES_FaultTyp.DFC_FlFltHtSCG_C DFES_FaultTyp.DFC_LSUHtrMax_C DFES_FaultTyp.DFC_LSUHtrMin_C DFES_FaultTyp.DFC_LSUHtrNpl_C DFES_FaultTyp.DFC_LSUHtrSig_C DFES_FaultTyp.DFC_LSUtExcMax_C DFES_FaultTyp.DFC_LSUtExcMin_C DFES_FaultTyp.DFC_MeUnOL_C DFES_FaultTyp.DFC_MeUnSCB_C DFES_FaultTyp.DFC_MeUnSRCMax_C DFES_FaultTyp.DFC_MeUnSRCMin_C DFES_FaultTyp.DFC_PCVOL_C DFES_FaultTyp.DFC_PCVSCB_C DFES_FaultTyp.DFC_PCVSRCMax_C DFES_FaultTyp.DFC_PCVSRCMin_C DFES_FaultTyp.DFC_RailPSRCMax_C DFES_FaultTyp.DFC_RailPSRCMin_C DFES_FaultTyp.DFC_ShtrOL_C DFES_FaultTyp.DFC_ShtrOvrTemp_C DFES_FaultTyp.DFC_ShtrSCB_C DFES_FaultTyp.DFC_ShtrSCG_C DFES_FaultTyp.DFC_StrtOL_C DFES_FaultTyp.DFC_StrtOvrTemp_C DFES_FaultTyp.DFC_StrtSCB_C DFES_FaultTyp.DFC_StrtSCG_C DFES_FaultTyp.DFC_ThrVlvOL_C DFES_FaultTyp.DFC_ThrVlvOvrTemp_C DFES_FaultTyp.DFC_ThrVlvSCB_C DFES_FaultTyp.DFC_TrbChOL_C DFES_FaultTyp.DFC_TrbChOvrTemp_C DFES_FaultTyp.DFC_TrbChSCB_C DFES_FaultTyp.DFC_UDosVlvOL_C DFES_FaultTyp.DFC_UDosVlvOvrTemp_C DFES_FaultTyp.DFC_UDosVlvSCB_C DFES_FaultTyp.DFC_UDosVlvSCG_C DFES_FaultTyp.DFC_UPmpMotOL_C DFES_FaultTyp.DFC_UPmpMotOvrTemp_C DFES_FaultTyp.DFC_UPmpMotSCB_C DFES_FaultTyp.DFC_UPmpMotSCG_C DFES_FaultTyp.DFC_WaHtElOL_C DFES_FaultTyp.DFC_WaHtElOvrTemp_C DFES_FaultTyp.DFC_WaHtElSCB_C DFES_FaultTyp.DFC_IVActrUChSRCMax_C DFES_FaultTyp.DFC_IVActrUChSRCMin_C DFES_FaultTyp.DFC_IVActrVltgSRCMax_C DFES_FaultTyp.DFC_IVActrVltgSRCMin_C DFES_FaultTyp.DFC_IVDiaTunDet_C DFES_FaultTyp.DFC_IVPSplyStopDCDC_C DFES_FaultTyp.DFC_IVPSplyVltgSRCMax_C DFES_FaultTyp.DFC_IVPSplyVltgSRCMin_C DFES_FaultTyp.DFC_SCREtaErr_C DFES_FaultTyp.DFC_SCREtaErr1_C DFES_FaultTyp.DFC_SCREtaErr2_C DFES_FaultTyp.DFC_SCRMonMetCtlPresErr_C DFES_FaultTyp.DFC_SCRMonPresBuildUpErr_C DFES_FaultTyp.DFC_SCRMonPresRdcErr_C DFES_FaultTyp.DFC_AFSOffsDrftMax_C DFES_FaultTyp.DFC_AFSOffsDrftMin_C DFES_FaultTyp.DFC_AFSSRCCorMax_C DFES_FaultTyp.DFC_AFSSRCCorMin_C DFES_FaultTyp.DFC_AFSSRCRawMax_C DFES_FaultTyp.DFC_AFSSRCRawMin_C DFES_FaultTyp.DFC_AFSSetyDrftMax_C DFES_FaultTyp.DFC_AFSSetyDrftMin_C DFES_FaultTyp.DFC_AirCSwtNpl_C DFES_FaultTyp.DFC_AirCSwtSig_C DFES_FaultTyp.DFC_BattUSRCMax_C DFES_FaultTyp.DFC_BattUSRCMin_C DFES_FaultTyp.DFC_BrkNpl_C DFES_FaultTyp.DFC_BrkPSRCMax_C DFES_FaultTyp.DFC_BrkPSRCMin_C DFES_FaultTyp.DFC_CEngDsTSRCMax_C DFES_FaultTyp.DFC_CEngDsTSRCMin_C DFES_FaultTyp.DFC_CrCUIDet_C DFES_FaultTyp.DFC_ECBVlvSRCMax_C DFES_FaultTyp.DFC_ECBVlvSRCMin_C DFES_FaultTyp.DFC_ECUOvrTemp_C DFES_FaultTyp.DFC_EGRVlvGovDvtMax_C DFES_FaultTyp.DFC_EGRVlvGovDvtMin_C DFES_FaultTyp.DFC_EGRVlvHBrgOpnLd_C DFES_FaultTyp.DFC_EGRVlvHBrgOvrCurr_C DFES_FaultTyp.DFC_EGRVlvHBrgOvrTemp_C DFES_FaultTyp.DFC_EGRVlvHBrgShCirBatt1_C DFES_FaultTyp.DFC_EGRVlvHBrgShCirBatt2_C DFES_FaultTyp.DFC_EGRVlvHBrgShCirGnd1_C DFES_FaultTyp.DFC_EGRVlvHBrgShCirGnd2_C DFES_FaultTyp.DFC_EGRVlvHBrgShCirOvrLd_C DFES_FaultTyp.DFC_EGRVlvHBrgTempOvrCurr_C DFES_FaultTyp.DFC_EGRVlvHBrgUndrVltg_C DFES_FaultTyp.DFC_EGRVlvLPGovDvtMax_C DFES_FaultTyp.DFC_EGRVlvLPGovDvtMin_C DFES_FaultTyp.DFC_EGRVlvLPHBrgOpnLd_C DFES_FaultTyp.DFC_EGRVlvLPHBrgOvrCurr_C DFES_FaultTyp.DFC_EGRVlvLPHBrgOvrTemp_C DFES_FaultTyp.DFC_EGRVlvLPHBrgShCirBatt1_C DFES_FaultTyp.DFC_EGRVlvLPHBrgShCirBatt2_C DFES_FaultTyp.DFC_EGRVlvLPHBrgShCirGnd1_C DFES_FaultTyp.DFC_EGRVlvLPHBrgShCirGnd2_C DFES_FaultTyp.DFC_EGRVlvLPHBrgShCirOvrLd_C DFES_FaultTyp.DFC_EGRVlvLPHBrgTempOvrCurr_C DFES_FaultTyp.DFC_EGRVlvLPHBrgUndrVltg_C DFES_FaultTyp.DFC_EGRVlvLPOL_C DFES_FaultTyp.DFC_EGRVlvLPSCB_C DFES_FaultTyp.DFC_EGRVlvLPSCG_C DFES_FaultTyp.DFC_EGRVlvLPSRCMax_C DFES_FaultTyp.DFC_EGRVlvLPSRCMin_C DFES_FaultTyp.DFC_EGRVlvOL_C DFES_FaultTyp.DFC_EGRVlvSCB_C DFES_FaultTyp.DFC_EGRVlvSCG_C DFES_FaultTyp.DFC_EGRVlvSRCMax_C DFES_FaultTyp.DFC_EGRVlvSRCMin_C DFES_FaultTyp.DFC_EngPrtOvrSpd_C DFES_FaultTyp.DFC_EngSpdOL_C DFES_FaultTyp.DFC_EngSpdSCB_C DFES_FaultTyp.DFC_EngSpdSCG_C DFES_FaultTyp.DFC_EnhSRCMaxPPFltDiff_C DFES_FaultTyp.DFC_EnhSRCMaxT1ExhTMon_C DFES_FaultTyp.DFC_EnhSRCMaxT2ExhTMon_C DFES_FaultTyp.DFC_EnhSRCMaxT3ExhTMon_C DFES_FaultTyp.DFC_EnhSRCMinPPFltDiff_C DFES_FaultTyp.DFC_EnhSRCMinT1ExhTMon_C DFES_FaultTyp.DFC_EnhSRCMinT2ExhTMon_C DFES_FaultTyp.DFC_EnhSRCMinT3ExhTMon_C DFES_FaultTyp.DFC_EnvPSRCMax_C DFES_FaultTyp.DFC_EnvPSRCMin_C DFES_FaultTyp.DFC_ExhTMonPlaus_C DFES_FaultTyp.DFC_ExhTMonPlausPos1_C DFES_FaultTyp.DFC_ExhTMonPlausPos2_C DFES_FaultTyp.DFC_ExhTMonPlausPos3_C DFES_FaultTyp.DFC_ExhTMonT1Plaus_C DFES_FaultTyp.DFC_ExhTMonT2Plaus_C DFES_FaultTyp.DFC_ExhTMonT3Plaus_C DFES_FaultTyp.DFC_FlFltDsPSRCMax_C DFES_FaultTyp.DFC_FlFltDsPSRCMin_C DFES_FaultTyp.DFC_FlFltSig_C DFES_FaultTyp.DFC_FlFltUsPSRCMax_C DFES_FaultTyp.DFC_FlFltUsPSRCMin_C DFES_FaultTyp.DFC_FuelTSRCMax_C DFES_FaultTyp.DFC_FuelTSRCMin_C DFES_FaultTyp.DFC_GbxNPosPPerSRCMax_C DFES_FaultTyp.DFC_GbxNPosPPerSRCMin_C DFES_FaultTyp.DFC_GbxNPosPdcycSRCMax_C DFES_FaultTyp.DFC_GbxNPosPdcycSRCMin_C DFES_FaultTyp.DFC_InjVlvPresMin_C DFES_FaultTyp.DFC_LSUCircNernstSig_C DFES_FaultTyp.DFC_LSUCircPmpCurSig_C DFES_FaultTyp.DFC_LSUCircVirtGndSig_C DFES_FaultTyp.DFC_LSUO2Max_C DFES_FaultTyp.DFC_LSUO2Min_C DFES_FaultTyp.DFC_LSUSPIBattLowMin_C DFES_FaultTyp.DFC_LSUWireSCB_C DFES_FaultTyp.DFC_LSUWireSCG_C DFES_FaultTyp.DFC_MeUnSCG_C DFES_FaultTyp.DFC_NSCDsCmpChk_C DFES_FaultTyp.DFC_NSCDsLamBinSRCMax_C DFES_FaultTyp.DFC_NSCDsLamBinSRCMin_C DFES_FaultTyp.DFC_NSCDsLamLinSRCMax_C DFES_FaultTyp.DFC_NSCDsLamLinSRCMin_C DFES_FaultTyp.DFC_NSCDsLamPlausMax_C DFES_FaultTyp.DFC_NSCDsLamPlausMin_C DFES_FaultTyp.DFC_NSCDsNOxSRCMax_C DFES_FaultTyp.DFC_NSCDsNOxSRCMin_C DFES_FaultTyp.DFC_NSCDsOpCir_C DFES_FaultTyp.DFC_NSCDsShCir_C DFES_FaultTyp.DFC_NoCat2DsCmpChk_C DFES_FaultTyp.DFC_NoCat2DsLamBinSRCMax_C DFES_FaultTyp.DFC_NoCat2DsLamBinSRCMin_C DFES_FaultTyp.DFC_NoCat2DsLamLinSRCMax_C DFES_FaultTyp.DFC_NoCat2DsLamLinSRCMin_C DFES_FaultTyp.DFC_NoCat2DsLamPlausMax_C DFES_FaultTyp.DFC_NoCat2DsLamPlausMin_C DFES_FaultTyp.DFC_NoCat2DsNOxSRCMax_C DFES_FaultTyp.DFC_NoCat2DsNOxSRCMin_C DFES_FaultTyp.DFC_NoCat2DsOpCir_C DFES_FaultTyp.DFC_NoCat2DsShCir_C DFES_FaultTyp.DFC_NplDynPPFltDiff_C DFES_FaultTyp.DFC_NplHsChngPPFltDiff_C DFES_FaultTyp.DFC_NplHsLnPPFltDiff_C DFES_FaultTyp.DFC_NplTOxiCatUs_C DFES_FaultTyp.DFC_NplTPFltUs_C DFES_FaultTyp.DFC_NplTTrbnUs_C DFES_FaultTyp.DFC_OilPSwmpSRCMax_C DFES_FaultTyp.DFC_OilPSwmpSRCMin_C DFES_FaultTyp.DFC_PCVSCG_C DFES_FaultTyp.DFC_PFltCharPDiffMin_C DFES_FaultTyp.DFC_PFltDstrMin_C DFES_FaultTyp.DFC_PFltEngPrt_C DFES_FaultTyp.DFC_PFltRgnPerm_C DFES_FaultTyp.DFC_PFltSRCMaxFlwRstn_C DFES_FaultTyp.DFC_PFltSRCMinFlwRstn_C DFES_FaultTyp.DFC_PFltSotMsDvtMax_C DFES_FaultTyp.DFC_PFltSotMsDvtMin_C DFES_FaultTyp.DFC_PFltSotMsMax_C DFES_FaultTyp.DFC_PIntkVUsSRCMax_C DFES_FaultTyp.DFC_PIntkVUsSRCMin_C DFES_FaultTyp.DFC_SRCHighAPP1_C DFES_FaultTyp.DFC_SRCHighAPP2_C DFES_FaultTyp.DFC_SRCLowAPP1_C DFES_FaultTyp.DFC_SRCLowAPP2_C DFES_FaultTyp.DFC_SRCMaxPPFltDiff_C DFES_FaultTyp.DFC_SRCMaxPPFltUs_C DFES_FaultTyp.DFC_SRCMaxTECU_C DFES_FaultTyp.DFC_SRCMaxTOxiCatUs_C DFES_FaultTyp.DFC_SRCMaxTPFltUs_C DFES_FaultTyp.DFC_SRCMaxTTrbnUs_C DFES_FaultTyp.DFC_SRCMaxUCatUsT_C DFES_FaultTyp.DFC_SRCMaxUPmpP_C DFES_FaultTyp.DFC_SRCMinPPFltDiff_C DFES_FaultTyp.DFC_SRCMinPPFltUs_C DFES_FaultTyp.DFC_SRCMinTECU_C DFES_FaultTyp.DFC_SRCMinTOxiCatUs_C DFES_FaultTyp.DFC_SRCMinTPFltUs_C DFES_FaultTyp.DFC_SRCMinTTrbnUs_C DFES_FaultTyp.DFC_SRCMinUCatUsT_C DFES_FaultTyp.DFC_SRCMinUPmpP_C DFES_FaultTyp.DFC_SigUCatUsT_C DFES_FaultTyp.DFC_SigUPmpP_C DFES_FaultTyp.DFC_SyncAPP_C DFES_FaultTyp.DFC_T15Npl_C DFES_FaultTyp.DFC_TAFSDtyCycHi_C DFES_FaultTyp.DFC_TAFSDtyCycLo_C DFES_FaultTyp.DFC_TAFSPerHi_C DFES_FaultTyp.DFC_TAFSPerLo_C DFES_FaultTyp.DFC_TCACDsSRCMax_C DFES_FaultTyp.DFC_TCACDsSRCMin_C DFES_FaultTyp.DFC_ThrVlvSRCMax_C DFES_FaultTyp.DFC_ThrVlvSRCMin_C DFES_FaultTyp.DFC_TrbChLPOL_C DFES_FaultTyp.DFC_TrbChLPSCB_C DFES_FaultTyp.DFC_TrbChLPSCG_C DFES_FaultTyp.DFC_UHtrPLOL_C DFES_FaultTyp.DFC_UHtrPLSCB_C DFES_FaultTyp.DFC_UHtrPLSCG_C DFES_FaultTyp.DFC_UHtrPLSRCMaxDia_C DFES_FaultTyp.DFC_UHtrPLSRCMinDia_C DFES_FaultTyp.DFC_UHtrTnkOL_C DFES_FaultTyp.DFC_UHtrTnkSCB_C DFES_FaultTyp.DFC_UHtrTnkSCG_C DFES_FaultTyp.DFC_UHtrTnkSRCMaxDia_C DFES_FaultTyp.DFC_UHtrTnkSRCMinDia_C DFES_FaultTyp.DFC_URevVlvOL_C DFES_FaultTyp.DFC_URevVlvSCB_C DFES_FaultTyp.DFC_URevVlvSCG_C DFES_FaultTyp.DFC_UTnkTSRCMax_C DFES_FaultTyp.DFC_UTnkTSRCMin_C DFES_FaultTyp.DFC_UTnkTSig_C DFES_FaultTyp.DFC_VSwVlvGovDvtMax_C DFES_FaultTyp.DFC_VSwVlvGovDvtMin_C DFES_FaultTyp.DFC_VSwVlvHBrgOpnLd_C DFES_FaultTyp.DFC_VSwVlvHBrgOvrCurr_C DFES_FaultTyp.DFC_VSwVlvHBrgOvrTemp_C DFES_FaultTyp.DFC_VSwVlvHBrgShCirBatt1_C DFES_FaultTyp.DFC_VSwVlvHBrgShCirBatt2_C DFES_FaultTyp.DFC_VSwVlvHBrgShCirGnd1_C DFES_FaultTyp.DFC_VSwVlvHBrgShCirGnd2_C DFES_FaultTyp.DFC_VSwVlvHBrgShCirOvrLd_C DFES_FaultTyp.DFC_VSwVlvHBrgTempOvrCurr_C DFES_FaultTyp.DFC_VSwVlvHBrgUndrVltg_C DFES_FaultTyp.DFC_VSwVlvOL_C DFES_FaultTyp.DFC_VSwVlvSCB_C DFES_FaultTyp.DFC_VSwVlvSCG_C DFES_FaultTyp.DFC_VSwVlvSRCMax_C DFES_FaultTyp.DFC_VSwVlvSRCMin_C DFES_FaultTyp.DFC_ClthNpl_C DFES_FaultTyp.DFC_ETClbETMax_0_C DFES_FaultTyp.DFC_ETClbETMax_1_C DFES_FaultTyp.DFC_ETClbETMax_2_C DFES_FaultTyp.DFC_ETClbETMax_3_C DFES_FaultTyp.DFC_ETClbETMax_4_C DFES_FaultTyp.DFC_ETClbETMax_5_C DFES_FaultTyp.DFC_ETClbETMin_0_C DFES_FaultTyp.DFC_ETClbETMin_1_C DFES_FaultTyp.DFC_ETClbETMin_2_C DFES_FaultTyp.DFC_ETClbETMin_3_C DFES_FaultTyp.DFC_ETClbETMin_4_C DFES_FaultTyp.DFC_ETClbETMin_5_C DFES_FaultTyp.DFC_IVActrEnrgMax_0_C DFES_FaultTyp.DFC_IVActrEnrgMax_1_C DFES_FaultTyp.DFC_IVActrEnrgMax_2_C DFES_FaultTyp.DFC_IVActrEnrgMax_3_C DFES_FaultTyp.DFC_IVActrEnrgMax_4_C DFES_FaultTyp.DFC_IVActrEnrgMax_5_C DFES_FaultTyp.DFC_IVActrEnrgMax_6_C DFES_FaultTyp.DFC_IVActrEnrgMax_7_C DFES_FaultTyp.DFC_IVActrEnrgMin_0_C DFES_FaultTyp.DFC_IVActrEnrgMin_1_C DFES_FaultTyp.DFC_IVActrEnrgMin_2_C DFES_FaultTyp.DFC_IVActrEnrgMin_3_C DFES_FaultTyp.DFC_IVActrEnrgMin_4_C DFES_FaultTyp.DFC_IVActrEnrgMin_5_C DFES_FaultTyp.DFC_IVActrEnrgMin_6_C DFES_FaultTyp.DFC_IVActrEnrgMin_7_C DFES_FaultTyp.DFC_IVActrEnrgPlaus_0_C DFES_FaultTyp.DFC_IVActrEnrgPlaus_1_C DFES_FaultTyp.DFC_IVActrEnrgPlaus_2_C DFES_FaultTyp.DFC_IVActrEnrgPlaus_3_C DFES_FaultTyp.DFC_IVActrEnrgPlaus_4_C DFES_FaultTyp.DFC_IVActrEnrgPlaus_5_C DFES_FaultTyp.DFC_IVActrEnrgPlaus_6_C DFES_FaultTyp.DFC_IVActrEnrgPlaus_7_C DFES_FaultTyp.DFC_IVCtlTiDiff_0_C DFES_FaultTyp.DFC_IVCtlTiDiff_1_C DFES_FaultTyp.DFC_IVCtlTiDiff_2_C DFES_FaultTyp.DFC_IVCtlTiDiff_3_C DFES_FaultTyp.DFC_IVCtlTiDiff_4_C DFES_FaultTyp.DFC_IVCtlTiDiff_5_C DFES_FaultTyp.DFC_IVCtlUDiffUp_0_C DFES_FaultTyp.DFC_IVCtlUDiffUp_1_C DFES_FaultTyp.DFC_IVCtlUDiffUp_2_C DFES_FaultTyp.DFC_IVCtlUDiffUp_3_C DFES_FaultTyp.DFC_IVCtlUDiffUp_4_C DFES_FaultTyp.DFC_IVCtlUDiffUp_5_C DFES_FaultTyp.DFC_IVCtlUUp_0_C DFES_FaultTyp.DFC_IVCtlUUp_1_C DFES_FaultTyp.DFC_IVCtlUUp_2_C DFES_FaultTyp.DFC_IVCtlUUp_3_C DFES_FaultTyp.DFC_IVCtlUUp_4_C DFES_FaultTyp.DFC_IVCtlUUp_5_C DFES_FaultTyp.DFC_IVDiaBnkShCir_0_C DFES_FaultTyp.DFC_IVDiaBnkShCir_1_C DFES_FaultTyp.DFC_IVDiaBnkShCirChSwt_0_C DFES_FaultTyp.DFC_IVDiaBnkShCirChSwt_1_C DFES_FaultTyp.DFC_IVDiaChp_0_C DFES_FaultTyp.DFC_IVDiaChp_1_C DFES_FaultTyp.DFC_IVDiaCylNoCls_0_C DFES_FaultTyp.DFC_IVDiaCylNoCls_1_C DFES_FaultTyp.DFC_IVDiaCylNoCls_2_C DFES_FaultTyp.DFC_IVDiaCylNoCls_3_C DFES_FaultTyp.DFC_IVDiaCylNoCls_4_C DFES_FaultTyp.DFC_IVDiaCylNoCls_5_C DFES_FaultTyp.DFC_IVDiaCylNoLd_0_C DFES_FaultTyp.DFC_IVDiaCylNoLd_1_C DFES_FaultTyp.DFC_IVDiaCylNoLd_2_C DFES_FaultTyp.DFC_IVDiaCylNoLd_3_C DFES_FaultTyp.DFC_IVDiaCylNoLd_4_C DFES_FaultTyp.DFC_IVDiaCylNoLd_5_C DFES_FaultTyp.DFC_IVDiaCylShCir_0_C DFES_FaultTyp.DFC_IVDiaCylShCir_1_C DFES_FaultTyp.DFC_IVDiaCylShCir_2_C DFES_FaultTyp.DFC_IVDiaCylShCir_3_C DFES_FaultTyp.DFC_IVDiaCylShCir_4_C DFES_FaultTyp.DFC_IVDiaCylShCir_5_C DFES_FaultTyp.DFC_IVDiaCylShCirHSLS_0_C DFES_FaultTyp.DFC_IVDiaCylShCirHSLS_1_C DFES_FaultTyp.DFC_IVDiaCylShCirHSLS_2_C DFES_FaultTyp.DFC_IVDiaCylShCirHSLS_3_C DFES_FaultTyp.DFC_IVDiaCylShCirHSLS_4_C DFES_FaultTyp.DFC_IVDiaCylShCirHSLS_5_C DFES_FaultTyp.DFC_IVDiaCylShCirMeas_0_C DFES_FaultTyp.DFC_IVDiaCylShCirMeas_1_C DFES_FaultTyp.DFC_IVDiaCylShCirMeas_2_C DFES_FaultTyp.DFC_IVDiaCylShCirMeas_3_C DFES_FaultTyp.DFC_IVDiaCylShCirMeas_4_C DFES_FaultTyp.DFC_IVDiaCylShCirMeas_5_C DFES_FaultTyp.DFC_LSUDynChk_C DFES_FaultTyp.DFC_LSUO2ClbMax_C DFES_FaultTyp.DFC_LSUO2ClbMin_C DFES_FaultTyp.DFC_LSUO2PlausMaxFLd_C DFES_FaultTyp.DFC_LSUO2PlausMaxOvrRun_C DFES_FaultTyp.DFC_LSUO2PlausMaxPartLd_C DFES_FaultTyp.DFC_LSUO2PlausMinFLd_C DFES_FaultTyp.DFC_LSUO2PlausMinOvrRun_C DFES_FaultTyp.DFC_LSUO2PlausMinPartLd_C DFES_FaultTyp.DFC_LSURiClbMax_C DFES_FaultTyp.DFC_LSURiClbMin_C DFES_FaultTyp.DFC_LSUWireIPSig_C DFES_FaultTyp.DFC_Layer_BSDMax_C DFES_FaultTyp.DFC_Layer_BSDMin_C DFES_FaultTyp.DFC_Layer_BSDNpl_C DFES_FaultTyp.DFC_Layer_BSDSig_C DFES_FaultTyp.DFC_Layer_FltMngTstMax_C DFES_FaultTyp.DFC_Layer_FltMngTstMin_C DFES_FaultTyp.DFC_Layer_FltMngTstNpl_C DFES_FaultTyp.DFC_Layer_FltMngTstSig_C DFES_FaultTyp.DFC_Layer_GENELBMax_C DFES_FaultTyp.DFC_Layer_GENELBMin_C DFES_FaultTyp.DFC_Layer_GENELBNpl_C DFES_FaultTyp.DFC_Layer_GENELBSig_C DFES_FaultTyp.DFC_Layer_GENELMax_C DFES_FaultTyp.DFC_Layer_GENELMin_C DFES_FaultTyp.DFC_Layer_GENELNpl_C DFES_FaultTyp.DFC_Layer_GENELSig_C DFES_FaultTyp.DFC_Layer_GENHTBMax_C DFES_FaultTyp.DFC_Layer_GENHTBMin_C DFES_FaultTyp.DFC_Layer_GENHTBNpl_C DFES_FaultTyp.DFC_Layer_GENHTBSig_C DFES_FaultTyp.DFC_Layer_GENHTMax_C DFES_FaultTyp.DFC_Layer_GENHTMin_C DFES_FaultTyp.DFC_Layer_GENHTNpl_C DFES_FaultTyp.DFC_Layer_GENHTSig_C DFES_FaultTyp.DFC_Layer_GENKOMMMax_C DFES_FaultTyp.DFC_Layer_GENKOMMMin_C DFES_FaultTyp.DFC_Layer_GENKOMMNpl_C DFES_FaultTyp.DFC_Layer_GENKOMMSig_C DFES_FaultTyp.DFC_Layer_GENMECHMax_C DFES_FaultTyp.DFC_Layer_GENMECHMin_C DFES_FaultTyp.DFC_Layer_GENMECHNpl_C DFES_FaultTyp.DFC_Layer_GENMECHSig_C DFES_FaultTyp.DFC_Layer_GENMax_C DFES_FaultTyp.DFC_Layer_GENMin_C DFES_FaultTyp.DFC_Layer_GENNpl_C DFES_FaultTyp.DFC_Layer_GENREGUPLMax_C DFES_FaultTyp.DFC_Layer_GENREGUPLMin_C DFES_FaultTyp.DFC_Layer_GENREGUPLNpl_C DFES_FaultTyp.DFC_Layer_GENREGUPLSig_C DFES_FaultTyp.DFC_Layer_GENSig_C DFES_FaultTyp.DFC_Layer_GENUPLMax_C DFES_FaultTyp.DFC_Layer_GENUPLMin_C DFES_FaultTyp.DFC_Layer_GENUPLNpl_C DFES_FaultTyp.DFC_Layer_GENUPLSig_C DFES_FaultTyp.DFC_Layer_IBS1Max_C DFES_FaultTyp.DFC_Layer_IBS1Min_C DFES_FaultTyp.DFC_Layer_IBS1Npl_C DFES_FaultTyp.DFC_Layer_IBS1Sig_C DFES_FaultTyp.DFC_Layer_IBS2Max_C DFES_FaultTyp.DFC_Layer_IBS2Min_C DFES_FaultTyp.DFC_Layer_IBS2Npl_C DFES_FaultTyp.DFC_Layer_IBS2Sig_C DFES_FaultTyp.DFC_Layer_IBS3Max_C DFES_FaultTyp.DFC_Layer_IBS3Min_C DFES_FaultTyp.DFC_Layer_IBS3Npl_C DFES_FaultTyp.DFC_Layer_IBS3Sig_C DFES_FaultTyp.DFC_Layer_MANDETEKMax_C DFES_FaultTyp.DFC_Layer_MANDETEKMin_C DFES_FaultTyp.DFC_Layer_MANDETEKNpl_C DFES_FaultTyp.DFC_Layer_MANDETEKSig_C DFES_FaultTyp.DFC_Layer_NDR1Max_C DFES_FaultTyp.DFC_Layer_NDR1Min_C DFES_FaultTyp.DFC_Layer_NDR1Npl_C DFES_FaultTyp.DFC_Layer_NDR1Sig_C DFES_FaultTyp.DFC_Layer_NDR2Max_C DFES_FaultTyp.DFC_Layer_NDR2Min_C DFES_FaultTyp.DFC_Layer_NDR2Npl_C DFES_FaultTyp.DFC_Layer_NDR2Sig_C DFES_FaultTyp.DFC_Layer_NGLERNMax_C DFES_FaultTyp.DFC_Layer_NGLERNMin_C DFES_FaultTyp.DFC_Layer_NGLERNNpl_C DFES_FaultTyp.DFC_Layer_NGLERNSig_C DFES_FaultTyp.DFC_Layer_PMBATTMax_C DFES_FaultTyp.DFC_Layer_PMBATTMin_C DFES_FaultTyp.DFC_Layer_PMBATTNpl_C DFES_FaultTyp.DFC_Layer_PMBATTSig_C DFES_FaultTyp.DFC_Layer_PMBNMax_C DFES_FaultTyp.DFC_Layer_PMBNMin_C DFES_FaultTyp.DFC_Layer_PMBNNpl_C DFES_FaultTyp.DFC_Layer_PMBNSig_C DFES_FaultTyp.DFC_Layer_PMRUHVERLMax_C DFES_FaultTyp.DFC_Layer_PMRUHVERLMin_C DFES_FaultTyp.DFC_Layer_PMRUHVERLNpl_C DFES_FaultTyp.DFC_Layer_PMRUHVERLSig_C DFES_FaultTyp.DFC_Layer_QLTMax_C DFES_FaultTyp.DFC_Layer_QLTMin_C DFES_FaultTyp.DFC_Layer_QLTNpl_C DFES_FaultTyp.DFC_Layer_QLTSig_C DFES_FaultTyp.DFC_Layer_TOENSMax_C DFES_FaultTyp.DFC_Layer_TOENSMin_C DFES_FaultTyp.DFC_Layer_TOENSNpl_C DFES_FaultTyp.DFC_Layer_TOENSSig_C DFES_FaultTyp.DFC_MonLimCurr_C DFES_FaultTyp.DFC_MonLimLead_C DFES_FaultTyp.DFC_MonLimSet_C DFES_FaultTyp.DFC_NSCDsNOxOfsMax_C DFES_FaultTyp.DFC_NSCDsNOxOfsMin_C DFES_FaultTyp.DFC_NSCDsNOxPlausMin_C DFES_FaultTyp.DFC_NoCat2DsNOxOfsMax_C DFES_FaultTyp.DFC_NoCat2DsNOxOfsMin_C DFES_FaultTyp.DFC_NoCat2DsNOxPlausMin_C DFES_FaultTyp.DFC_PCVNoStrt_C DFES_FaultTyp.DFC_RailPGradMon_C DFES_FaultTyp.DFC_SCRPODPresBuildUp_C DFES_FaultTyp.DFC_AFSDrftIdlAdjVal_C DFES_FaultTyp.DFC_AFSDrftLdAdjVal_C DFES_FaultTyp.DFC_AdcIADC0Cal_C DFES_FaultTyp.DFC_AdcIADC0Conv_C DFES_FaultTyp.DFC_AdcIADC1Cal_C DFES_FaultTyp.DFC_AdcIADC1Conv_C DFES_FaultTyp.DFC_CmbChbMisfireMax_0_C DFES_FaultTyp.DFC_CmbChbMisfireMax_1_C DFES_FaultTyp.DFC_CmbChbMisfireMax_2_C DFES_FaultTyp.DFC_CmbChbMisfireMax_3_C DFES_FaultTyp.DFC_CmbChbMisfireMax_4_C DFES_FaultTyp.DFC_CmbChbMisfireMax_5_C DFES_FaultTyp.DFC_CmbChbMisfireMul_C DFES_FaultTyp.DFC_EGRVlvLPOfsNeutr_C DFES_FaultTyp.DFC_EGRVlvOfsNeutr_C DFES_FaultTyp.DFC_FMAErrModMax_C DFES_FaultTyp.DFC_FMAErrModMin_C DFES_FaultTyp.DFC_FlSysTnkLo_C DFES_FaultTyp.DFC_GbxNPosPlaus_C DFES_FaultTyp.DFC_I14229_ROETst_Appl_C DFES_FaultTyp.DFC_I14229_ROETst_Netw_C DFES_FaultTyp.DFC_I14229_ROE_BufFull_C DFES_FaultTyp.DFC_IVAdjDiaIVAdj_C DFES_FaultTyp.DFC_IVAdjIVA_0_C DFES_FaultTyp.DFC_IVAdjIVA_1_C DFES_FaultTyp.DFC_IVAdjIVA_2_C DFES_FaultTyp.DFC_IVAdjIVA_3_C DFES_FaultTyp.DFC_IVAdjIVA_4_C DFES_FaultTyp.DFC_IVAdjIVA_5_C DFES_FaultTyp.DFC_IVPSplyDCDCOff_0_C DFES_FaultTyp.DFC_IVPSplyDCDCOff_1_C DFES_FaultTyp.DFC_IVPSplyDCDCOff_2_C DFES_FaultTyp.DFC_IVPSplyDCDCOff_3_C DFES_FaultTyp.DFC_InjCtlAdjQntEEPCS_C DFES_FaultTyp.DFC_LSUSPISig_C DFES_FaultTyp.DFC_Layer_Dummy_C DFES_FaultTyp.DFC_NplEnvPSensPPFltDiff_C DFES_FaultTyp.DFC_NplPresSensPPFltDiff_C DFES_FaultTyp.DFC_OilLvlPlaus_C DFES_FaultTyp.DFC_OilTOutLvl_C DFES_FaultTyp.DFC_PCVfacAdaptMax_C DFES_FaultTyp.DFC_PCVfacAdaptMin_C DFES_FaultTyp.DFC_SensFrzPPFltUs_C DFES_FaultTyp.DFC_SensMonUTnkLvl_C DFES_FaultTyp.DFC_T15Sig_C DFES_FaultTyp.DFC_AirCtlRmpTOut_C DFES_FaultTyp.DFC_BrkPPlaus_C DFES_FaultTyp.DFC_CEngDsTDynTst_C DFES_FaultTyp.DFC_EEPEraseErr_C DFES_FaultTyp.DFC_EEPRdErr_C DFES_FaultTyp.DFC_EEPWrErr_C DFES_FaultTyp.DFC_EGRVlvJamVlvClsd_C DFES_FaultTyp.DFC_EGRVlvJamVlvOpn_C DFES_FaultTyp.DFC_EGRVlvLPJamVlvClsd_C DFES_FaultTyp.DFC_EGRVlvLPJamVlvOpn_C DFES_FaultTyp.DFC_EGRVlvLPLgTDrft_C DFES_FaultTyp.DFC_EGRVlvLPOfsLrnJamVlv_C DFES_FaultTyp.DFC_EGRVlvLPShTDrft_C DFES_FaultTyp.DFC_EGRVlvLgTDrft_C DFES_FaultTyp.DFC_EGRVlvOfsLrnJamVlv_C DFES_FaultTyp.DFC_EGRVlvShTDrft_C DFES_FaultTyp.DFC_EngICO_C DFES_FaultTyp.DFC_EpmCaSI1ErrSig_C DFES_FaultTyp.DFC_EpmCaSI1NoSig_C DFES_FaultTyp.DFC_EpmCaSI1OfsErr_C DFES_FaultTyp.DFC_EpmCrSErrSig_C DFES_FaultTyp.DFC_EpmCrSNoSig_C DFES_FaultTyp.DFC_IVPlausComprTst_C DFES_FaultTyp.DFC_IVPlausRunUpTst_C DFES_FaultTyp.DFC_InjCrvShOffTst_C DFES_FaultTyp.DFC_LayerEnSavModProd_C DFES_FaultTyp.DFC_LayerEnSavModRep_C DFES_FaultTyp.DFC_LayerEnSavModShip_C DFES_FaultTyp.DFC_MRlyErlyOpng_C DFES_FaultTyp.DFC_MRlyStk_C DFES_FaultTyp.DFC_MeUnActrTst_C DFES_FaultTyp.DFC_MoCADCCmp_C DFES_FaultTyp.DFC_MoCADCTst_C DFES_FaultTyp.DFC_MoCADCVltgRatio_C DFES_FaultTyp.DFC_MoCComErrCnt_C DFES_FaultTyp.DFC_MoCComSPI_C DFES_FaultTyp.DFC_MoCROMErrXPg_C DFES_FaultTyp.DFC_MoCSOPHwNoRdy_C DFES_FaultTyp.DFC_MoCSOPLoLi_C DFES_FaultTyp.DFC_MoCSOPMM_C DFES_FaultTyp.DFC_MoCSOPTimeOut_C DFES_FaultTyp.DFC_MoCSOPUpLi_C DFES_FaultTyp.DFC_MoFAPP_C DFES_FaultTyp.DFC_MoFESpd_C DFES_FaultTyp.DFC_MoFInjDatPhi_C DFES_FaultTyp.DFC_MoFInjDatQnt_C DFES_FaultTyp.DFC_MoFInjQnt_C DFES_FaultTyp.DFC_MoFMode1PoI1_C DFES_FaultTyp.DFC_MoFMode1PoI2_C DFES_FaultTyp.DFC_MoFMode2PoI1_C DFES_FaultTyp.DFC_MoFMode2PoI2_C DFES_FaultTyp.DFC_MoFOvR_C DFES_FaultTyp.DFC_MoFQntCor_C DFES_FaultTyp.DFC_MoFRailP_C DFES_FaultTyp.DFC_MoFTrqCmp_C DFES_FaultTyp.DFC_NSCDsHtrSetP_C DFES_FaultTyp.DFC_NoCat2DsHtrSetP_C DFES_FaultTyp.DFC_PCVActrTst_C DFES_FaultTyp.DFC_PhyModNonMonMapNpl_C DFES_FaultTyp.DFC_RailHpTst_C DFES_FaultTyp.DFC_RailPOfsTstMax_C DFES_FaultTyp.DFC_RailPOfsTstMin_C DFES_FaultTyp.DFC_SIA_E1max_C DFES_FaultTyp.DFC_SIA_E1min_C DFES_FaultTyp.DFC_SIA_E1npl_C DFES_FaultTyp.DFC_SIA_E1sig_C DFES_FaultTyp.DFC_SIA_E2max_C DFES_FaultTyp.DFC_SIA_E2min_C DFES_FaultTyp.DFC_SIA_E2npl_C DFES_FaultTyp.DFC_SIA_E2sig_C DFES_FaultTyp.DFC_SIA_E3max_C DFES_FaultTyp.DFC_SIA_E3min_C DFES_FaultTyp.DFC_SIA_E3npl_C DFES_FaultTyp.DFC_SIA_E3sig_C DFES_FaultTyp.DFC_SIA_E4max_C DFES_FaultTyp.DFC_SIA_E4min_C DFES_FaultTyp.DFC_SIA_E4npl_C DFES_FaultTyp.DFC_SIA_E4sig_C DFES_FaultTyp.DFC_SWReset_0_C DFES_FaultTyp.DFC_SWReset_1_C DFES_FaultTyp.DFC_SWReset_2_C DFES_FaultTyp.DFC_ShtrAKKMax_C DFES_FaultTyp.DFC_ShtrAKKMin_C DFES_FaultTyp.DFC_ShtrAKKNpl_C DFES_FaultTyp.DFC_ShtrPKKMax_C DFES_FaultTyp.DFC_StopCntTmr_C DFES_FaultTyp.DFC_ThrVlvMon_C DFES_FaultTyp.DFC_VSwVlvJamVlv_C DFES_FaultTyp.DFC_VSwVlvLgTDrft_C DFES_FaultTyp.DFC_VSwVlvOfsLrnJamVlv_C DFES_FaultTyp.DFC_VSwVlvOfsNeutr_C DFES_FaultTyp.DFC_VSwVlvShTDrft_C DFES_FaultTyp.DFC_VSwVlvSpgDef_C DFES_MonEvtMSK0_C DFES_MonEvtMSK1_C DFES_MonRepeat_C DFES_numClsDlt_CA DFES_numClsFaultCycl_CA DFES_numClsHealCycl_CA /end DEF_CHARACTERISTIC
/end FUNCTION
/begin COMPU_METHOD DFES_OneToOne "" RAT_FUNC "%6.0" "-" COEFFS 0 1 0 0 0 1 /end COMPU_METHOD
/begin COMPU_METHOD OneToOne "" RAT_FUNC "%6.0" "-" COEFFS 0 1 0 0 0 1 /end COMPU_METHOD
/begin RECORD_LAYOUT ValA_Wu8 FNC_VALUES 1 UBYTE COLUMN_DIR DIRECT /end RECORD_LAYOUT
/begin RECORD_LAYOUT Val_Wu16 FNC_VALUES 1 UWORD COLUMN_DIR DIRECT /end RECORD_LAYOUT
/begin RECORD_LAYOUT Val_Wu8 FNC_VALUES 1 UBYTE COLUMN_DIR DIRECT /end RECORD_LAYOUT
/end MODULE
/end PROJECT

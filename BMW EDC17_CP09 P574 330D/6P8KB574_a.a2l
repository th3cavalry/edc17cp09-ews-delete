ASAP2_VERSION 1 4
/begin PROJECT P_574 "EDC17_CP09"
/begin HEADER "" VERSION "V8KB" PROJECT_NO P_574 /end HEADER
/begin MODULE DIM ""
/begin MOD_COMMON "" BYTE_ORDER MSB_LAST ALIGNMENT_BYTE 1 ALIGNMENT_WORD 2 ALIGNMENT_LONG 4 ALIGNMENT_FLOAT32_IEEE 4 /end MOD_COMMON
/begin CHARACTERISTIC CW_BNS_LR "Codewort zur Einrechnung Bordnetzstabilität in Loadresponse" VALUE 0x80064A06 Val_Wu8 1.0 Def_st_ub_q1 0.00 1.0 EXTENDED_LIMITS 0.00 255. /end CHARACTERISTIC
/begin CHARACTERISTIC CW_NA_KONF "Konfiguration schnelle/langsame Entlastung" VALUE 0x80064D86 Val_Wu8 255. Def_dez_ub_q1 0.00 255. FORMAT "%3.0" /end CHARACTERISTIC
/begin AXIS_PTS InjVlv_pRailZFCETCor_AXIS "gemeinsame Raildruck-Achse für ZFC Ansteuerdauerkorrektur-Kennfelder" 0x8004CE02 RailP_pCurr_mp Axis_Xs16 600000.0 Pres_Rail 6 200000.0 800000.0 FORMAT "%8.1" EXTENDED_LIMITS -3276800. 3276700. DEPOSIT ABSOLUTE /end AXIS_PTS
/begin AXIS_PTS InjVlv_pRailZFCETPoICor_AXIS "" 0x8004CE10 RailP_pCurr_mp Axis_Xs16 600000.0 Pres_Rail 6 200000.0 800000.0 FORMAT "%8.1" EXTENDED_LIMITS -3276800. 3276700. DEPOSIT ABSOLUTE /end AXIS_PTS
/begin AXIS_PTS InjVlv_qZFCETCor_AXIS "Stützstellen der Menge für Korrekturfaktor-Gruppenkennfelder der Ansteuerdauerkorrektur der Nullmengenkalibrierung" 0x8004CE1E InjVlv_qInZFCETGMap_mp Axis_Xs16 3.000000 InjMass 6 0.00 3.000000 FORMAT "%8.6" EXTENDED_LIMITS -327.6800 327.6700 DEPOSIT ABSOLUTE /end AXIS_PTS
/begin AXIS_PTS InjVlv_qZFCETPoI1Cor_AXIS "" 0x8004CE2C InjVlv_qInZFCETGMap_mp Axis_Xs16 3.000000 InjMass 6 0.00 3.000000 FORMAT "%8.6" EXTENDED_LIMITS -327.6800 327.6700 DEPOSIT ABSOLUTE /end AXIS_PTS
/begin AXIS_PTS InjVlv_qZFCETPoI2Cor_AXIS "" 0x8004CE3A InjVlv_qInZFCETGMap_mp Axis_Xs16 3.000000 InjMass 6 0.00 3.000000 FORMAT "%8.6" EXTENDED_LIMITS -327.6800 327.6700 DEPOSIT ABSOLUTE /end AXIS_PTS
/begin CHARACTERISTIC InjVlv_rZFCETDif0_GMAP "Gruppenkennfeld Bewertungsfaktor für Ansteuerdauerkorrektur durch Nullmengenkalibrierung am Raildruck-Kalibrierpunkt 0" MAP 0x8004CE48 MapG_Ws16 100.0000 Prc 0.00 100.0000 EXTENDED_LIMITS -400.0000 399.9878
 /begin AXIS_DESCR COM_AXIS RailP_pCurr_mp Pres_Rail 6 200.0000 2000.0000 EXTENDED_LIMITS -3276.8000 3276.7000 AXIS_PTS_REF InjVlv_pRailZFCETCor_AXIS /end AXIS_DESCR
 /begin AXIS_DESCR COM_AXIS InjVlv_qInZFCETGMap_mp InjMass 6 0.00 3.000000 EXTENDED_LIMITS -327.6800 327.6700 AXIS_PTS_REF InjVlv_qZFCETCor_AXIS /end AXIS_DESCR
/end CHARACTERISTIC
/begin CHARACTERISTIC InjVlv_rZFCETDif1_GMAP "Gruppenkennfeld Bewertungsfaktor für Ansteuerdauerkorrektur durch Nullmengenkalibrierung am Raildruck-Kalibrierpunkt 1" MAP 0x8004CE90 MapG_Ws16 100.0000 Prc 0.00 100.0000 EXTENDED_LIMITS -400.0000 399.9878
 /begin AXIS_DESCR COM_AXIS RailP_pCurr_mp Pres_Rail 6 200.0000 2000.0000 EXTENDED_LIMITS -3276.8000 3276.7000 AXIS_PTS_REF InjVlv_pRailZFCETCor_AXIS /end AXIS_DESCR
 /begin AXIS_DESCR COM_AXIS InjVlv_qInZFCETGMap_mp InjMass 6 0.00 3.000000 EXTENDED_LIMITS -327.6800 327.6700 AXIS_PTS_REF InjVlv_qZFCETCor_AXIS /end AXIS_DESCR
/end CHARACTERISTIC
/begin CHARACTERISTIC InjVlv_rZFCETDif2_GMAP "Gruppenkennfeld Bewertungsfaktor für Ansteuerdauerkorrektur durch Nullmengenkalibrierung am Raildruck-Kalibrierpunkt 2" MAP 0x8004CED8 MapG_Ws16 100.0000 Prc 0.00 100.0000 EXTENDED_LIMITS -400.0000 399.9878
 /begin AXIS_DESCR COM_AXIS RailP_pCurr_mp Pres_Rail 6 200.0000 2000.0000 EXTENDED_LIMITS -3276.8000 3276.7000 AXIS_PTS_REF InjVlv_pRailZFCETCor_AXIS /end AXIS_DESCR
 /begin AXIS_DESCR COM_AXIS InjVlv_qInZFCETGMap_mp InjMass 6 0.00 3.000000 EXTENDED_LIMITS -327.6800 327.6700 AXIS_PTS_REF InjVlv_qZFCETCor_AXIS /end AXIS_DESCR
/end CHARACTERISTIC
/begin CHARACTERISTIC InjVlv_rZFCETDif3_GMAP "Gruppenkennfeld Bewertungsfaktor für Ansteuerdauerkorrektur durch Nullmengenkalibrierung am Raildruck-Kalibrierpunkt 3" MAP 0x8004CF20 MapG_Ws16 100.0000 Prc 0.00 100.0000 EXTENDED_LIMITS -400.0000 399.9878
 /begin AXIS_DESCR COM_AXIS RailP_pCurr_mp Pres_Rail 6 200.0000 2000.0000 EXTENDED_LIMITS -3276.8000 3276.7000 AXIS_PTS_REF InjVlv_pRailZFCETCor_AXIS /end AXIS_DESCR
 /begin AXIS_DESCR COM_AXIS InjVlv_qInZFCETGMap_mp InjMass 6 0.00 3.000000 EXTENDED_LIMITS -327.6800 327.6700 AXIS_PTS_REF InjVlv_qZFCETCor_AXIS /end AXIS_DESCR
/end CHARACTERISTIC
/begin CHARACTERISTIC InjVlv_rZFCETDif4_GMAP "Gruppenkennfeld Bewertungsfaktor für Ansteuerdauerkorrektur durch Nullmengenkalibrierung am Raildruck-Kalibrierpunkt 4" MAP 0x8004CF68 MapG_Ws16 100.0000 Prc 0.00 100.0000 EXTENDED_LIMITS -400.0000 399.9878
 /begin AXIS_DESCR COM_AXIS RailP_pCurr_mp Pres_Rail 6 200.0000 2000.0000 EXTENDED_LIMITS -3276.8000 3276.7000 AXIS_PTS_REF InjVlv_pRailZFCETCor_AXIS /end AXIS_DESCR
 /begin AXIS_DESCR COM_AXIS InjVlv_qInZFCETGMap_mp InjMass 6 0.00 3.000000 EXTENDED_LIMITS -327.6800 327.6700 AXIS_PTS_REF InjVlv_qZFCETCor_AXIS /end AXIS_DESCR
/end CHARACTERISTIC
/begin CHARACTERISTIC InjVlv_rZFCETDif5_GMAP "Gruppenkennfeld Bewertungsfaktor für Ansteuerdauerkorrektur durch Nullmengenkalibrierung am Raildruck-Kalibrierpunkt 5" MAP 0x8004CFB0 MapG_Ws16 100.0000 Prc 0.00 100.0000 EXTENDED_LIMITS -400.0000 399.9878
 /begin AXIS_DESCR COM_AXIS RailP_pCurr_mp Pres_Rail 6 200.0000 2000.0000 EXTENDED_LIMITS -3276.8000 3276.7000 AXIS_PTS_REF InjVlv_pRailZFCETCor_AXIS /end AXIS_DESCR
 /begin AXIS_DESCR COM_AXIS InjVlv_qInZFCETGMap_mp InjMass 6 0.00 3.000000 EXTENDED_LIMITS -327.6800 327.6700 AXIS_PTS_REF InjVlv_qZFCETCor_AXIS /end AXIS_DESCR
/end CHARACTERISTIC
/begin CHARACTERISTIC InjVlv_rZFCETDif6_GMAP "Gruppenkennfeld Bewertungsfaktor für Ansteuerdauerkorrektur durch Nullmengenkalibrierung am Raildruck-Kalibrierpunkt 6" MAP 0x8004CFF8 MapG_Ws16 100.0000 Prc 0.00 100.0000 EXTENDED_LIMITS -400.0000 399.9878
 /begin AXIS_DESCR COM_AXIS RailP_pCurr_mp Pres_Rail 6 200.0000 2000.0000 EXTENDED_LIMITS -3276.8000 3276.7000 AXIS_PTS_REF InjVlv_pRailZFCETCor_AXIS /end AXIS_DESCR
 /begin AXIS_DESCR COM_AXIS InjVlv_qInZFCETGMap_mp InjMass 6 0.00 3.000000 EXTENDED_LIMITS -327.6800 327.6700 AXIS_PTS_REF InjVlv_qZFCETCor_AXIS /end AXIS_DESCR
/end CHARACTERISTIC
/begin CHARACTERISTIC InjVlv_rZFCETMsk_GMAP "Gruppenkennfeld Gesamtbewertungsfaktor der Ansteuerdauerkorrektur durch Nullmengenkalibrierung" MAP 0x8004D040 MapG_Ws16 100.0000 Prc 0.00 100.0000 EXTENDED_LIMITS -400.0000 399.9878
 /begin AXIS_DESCR COM_AXIS RailP_pCurr_mp Pres_Rail 6 200.0000 2000.0000 EXTENDED_LIMITS -3276.8000 3276.7000 AXIS_PTS_REF InjVlv_pRailZFCETCor_AXIS /end AXIS_DESCR
 /begin AXIS_DESCR COM_AXIS InjVlv_qInZFCETGMap_mp InjMass 6 0.00 3.000000 EXTENDED_LIMITS -327.6800 327.6700 AXIS_PTS_REF InjVlv_qZFCETCor_AXIS /end AXIS_DESCR
/end CHARACTERISTIC
/begin CHARACTERISTIC InjVlv_rZFCETPoI1CorPos_C "" VALUE 0x8004D088 Val_Ws16 100.0000 Prc 0.00 100.0000 EXTENDED_LIMITS -400.0000 399.9878 /end CHARACTERISTIC
/begin CHARACTERISTIC InjVlv_rZFCETPoI1Dif0_GMAP "" MAP 0x8004D08A MapG_Ws16 100.0000 Prc 0.00 100.0000 EXTENDED_LIMITS -400.0000 399.9878
 /begin AXIS_DESCR COM_AXIS RailP_pCurr_mp Pres_Rail 6 200.0000 2000.0000 EXTENDED_LIMITS -3276.8000 3276.7000 AXIS_PTS_REF InjVlv_pRailZFCETPoICor_AXIS /end AXIS_DESCR
 /begin AXIS_DESCR COM_AXIS InjVlv_qInZFCETGMap_mp InjMass 6 0.00 3.000000 EXTENDED_LIMITS -327.6800 327.6700 AXIS_PTS_REF InjVlv_qZFCETPoI1Cor_AXIS /end AXIS_DESCR
/end CHARACTERISTIC
/begin CHARACTERISTIC InjVlv_rZFCETPoI1Dif1_GMAP "" MAP 0x8004D0D2 MapG_Ws16 100.0000 Prc 0.00 100.0000 EXTENDED_LIMITS -400.0000 399.9878
 /begin AXIS_DESCR COM_AXIS RailP_pCurr_mp Pres_Rail 6 200.0000 2000.0000 EXTENDED_LIMITS -3276.8000 3276.7000 AXIS_PTS_REF InjVlv_pRailZFCETPoICor_AXIS /end AXIS_DESCR
 /begin AXIS_DESCR COM_AXIS InjVlv_qInZFCETGMap_mp InjMass 6 0.00 3.000000 EXTENDED_LIMITS -327.6800 327.6700 AXIS_PTS_REF InjVlv_qZFCETPoI1Cor_AXIS /end AXIS_DESCR
/end CHARACTERISTIC
/begin CHARACTERISTIC InjVlv_rZFCETPoI1Dif2_GMAP "" MAP 0x8004D11A MapG_Ws16 100.0000 Prc 0.00 100.0000 EXTENDED_LIMITS -400.0000 399.9878
 /begin AXIS_DESCR COM_AXIS RailP_pCurr_mp Pres_Rail 6 200.0000 2000.0000 EXTENDED_LIMITS -3276.8000 3276.7000 AXIS_PTS_REF InjVlv_pRailZFCETPoICor_AXIS /end AXIS_DESCR
 /begin AXIS_DESCR COM_AXIS InjVlv_qInZFCETGMap_mp InjMass 6 0.00 3.000000 EXTENDED_LIMITS -327.6800 327.6700 AXIS_PTS_REF InjVlv_qZFCETPoI1Cor_AXIS /end AXIS_DESCR
/end CHARACTERISTIC
/begin CHARACTERISTIC InjVlv_rZFCETPoI1Dif3_GMAP "" MAP 0x8004D162 MapG_Ws16 100.0000 Prc 0.00 100.0000 EXTENDED_LIMITS -400.0000 399.9878
 /begin AXIS_DESCR COM_AXIS RailP_pCurr_mp Pres_Rail 6 200.0000 2000.0000 EXTENDED_LIMITS -3276.8000 3276.7000 AXIS_PTS_REF InjVlv_pRailZFCETPoICor_AXIS /end AXIS_DESCR
 /begin AXIS_DESCR COM_AXIS InjVlv_qInZFCETGMap_mp InjMass 6 0.00 3.000000 EXTENDED_LIMITS -327.6800 327.6700 AXIS_PTS_REF InjVlv_qZFCETPoI1Cor_AXIS /end AXIS_DESCR
/end CHARACTERISTIC
/begin CHARACTERISTIC InjVlv_rZFCETPoI1Dif4_GMAP "" MAP 0x8004D1AA MapG_Ws16 100.0000 Prc 0.00 100.0000 EXTENDED_LIMITS -400.0000 399.9878
 /begin AXIS_DESCR COM_AXIS RailP_pCurr_mp Pres_Rail 6 200.0000 2000.0000 EXTENDED_LIMITS -3276.8000 3276.7000 AXIS_PTS_REF InjVlv_pRailZFCETPoICor_AXIS /end AXIS_DESCR
 /begin AXIS_DESCR COM_AXIS InjVlv_qInZFCETGMap_mp InjMass 6 0.00 3.000000 EXTENDED_LIMITS -327.6800 327.6700 AXIS_PTS_REF InjVlv_qZFCETPoI1Cor_AXIS /end AXIS_DESCR
/end CHARACTERISTIC
/begin CHARACTERISTIC InjVlv_rZFCETPoI1Dif5_GMAP "" MAP 0x8004D1F2 MapG_Ws16 100.0000 Prc 0.00 100.0000 EXTENDED_LIMITS -400.0000 399.9878
 /begin AXIS_DESCR COM_AXIS RailP_pCurr_mp Pres_Rail 6 200.0000 2000.0000 EXTENDED_LIMITS -3276.8000 3276.7000 AXIS_PTS_REF InjVlv_pRailZFCETPoICor_AXIS /end AXIS_DESCR
 /begin AXIS_DESCR COM_AXIS InjVlv_qInZFCETGMap_mp InjMass 6 0.00 3.000000 EXTENDED_LIMITS -327.6800 327.6700 AXIS_PTS_REF InjVlv_qZFCETPoI1Cor_AXIS /end AXIS_DESCR
/end CHARACTERISTIC
/begin CHARACTERISTIC InjVlv_rZFCETPoI1Dif6_GMAP "" MAP 0x8004D23A MapG_Ws16 100.0000 Prc 0.00 100.0000 EXTENDED_LIMITS -400.0000 399.9878
 /begin AXIS_DESCR COM_AXIS RailP_pCurr_mp Pres_Rail 6 200.0000 2000.0000 EXTENDED_LIMITS -3276.8000 3276.7000 AXIS_PTS_REF InjVlv_pRailZFCETPoICor_AXIS /end AXIS_DESCR
 /begin AXIS_DESCR COM_AXIS InjVlv_qInZFCETGMap_mp InjMass 6 0.00 3.000000 EXTENDED_LIMITS -327.6800 327.6700 AXIS_PTS_REF InjVlv_qZFCETPoI1Cor_AXIS /end AXIS_DESCR
/end CHARACTERISTIC
/begin CHARACTERISTIC InjVlv_rZFCETPoI1Msk_GMAP "" MAP 0x8004D282 MapG_Ws16 100.0000 Prc 0.00 100.0000 EXTENDED_LIMITS -400.0000 399.9878
 /begin AXIS_DESCR COM_AXIS RailP_pCurr_mp Pres_Rail 6 200.0000 2000.0000 EXTENDED_LIMITS -3276.8000 3276.7000 AXIS_PTS_REF InjVlv_pRailZFCETPoICor_AXIS /end AXIS_DESCR
 /begin AXIS_DESCR COM_AXIS InjVlv_qInZFCETGMap_mp InjMass 6 0.00 3.000000 EXTENDED_LIMITS -327.6800 327.6700 AXIS_PTS_REF InjVlv_qZFCETPoI1Cor_AXIS /end AXIS_DESCR
/end CHARACTERISTIC
/begin CHARACTERISTIC InjVlv_rZFCETPoI2CorPos_C "" VALUE 0x8004D2CA Val_Ws16 100.0000 Prc 0.00 100.0000 EXTENDED_LIMITS -400.0000 399.9878 /end CHARACTERISTIC
/begin CHARACTERISTIC InjVlv_rZFCETPoI2Dif0_GMAP "" MAP 0x8004D2CC MapG_Ws16 100.0000 Prc 0.00 100.0000 EXTENDED_LIMITS -400.0000 399.9878
 /begin AXIS_DESCR COM_AXIS RailP_pCurr_mp Pres_Rail 6 200.0000 2000.0000 EXTENDED_LIMITS -3276.8000 3276.7000 AXIS_PTS_REF InjVlv_pRailZFCETPoICor_AXIS /end AXIS_DESCR
 /begin AXIS_DESCR COM_AXIS InjVlv_qInZFCETGMap_mp InjMass 6 0.00 3.000000 EXTENDED_LIMITS -327.6800 327.6700 AXIS_PTS_REF InjVlv_qZFCETPoI2Cor_AXIS /end AXIS_DESCR
/end CHARACTERISTIC
/begin CHARACTERISTIC InjVlv_rZFCETPoI2Dif1_GMAP "" MAP 0x8004D314 MapG_Ws16 100.0000 Prc 0.00 100.0000 EXTENDED_LIMITS -400.0000 399.9878
 /begin AXIS_DESCR COM_AXIS RailP_pCurr_mp Pres_Rail 6 200.0000 2000.0000 EXTENDED_LIMITS -3276.8000 3276.7000 AXIS_PTS_REF InjVlv_pRailZFCETPoICor_AXIS /end AXIS_DESCR
 /begin AXIS_DESCR COM_AXIS InjVlv_qInZFCETGMap_mp InjMass 6 0.00 3.000000 EXTENDED_LIMITS -327.6800 327.6700 AXIS_PTS_REF InjVlv_qZFCETPoI2Cor_AXIS /end AXIS_DESCR
/end CHARACTERISTIC
/begin CHARACTERISTIC InjVlv_rZFCETPoI2Dif2_GMAP "" MAP 0x8004D35C MapG_Ws16 100.0000 Prc 0.00 100.0000 EXTENDED_LIMITS -400.0000 399.9878
 /begin AXIS_DESCR COM_AXIS RailP_pCurr_mp Pres_Rail 6 200.0000 2000.0000 EXTENDED_LIMITS -3276.8000 3276.7000 AXIS_PTS_REF InjVlv_pRailZFCETPoICor_AXIS /end AXIS_DESCR
 /begin AXIS_DESCR COM_AXIS InjVlv_qInZFCETGMap_mp InjMass 6 0.00 3.000000 EXTENDED_LIMITS -327.6800 327.6700 AXIS_PTS_REF InjVlv_qZFCETPoI2Cor_AXIS /end AXIS_DESCR
/end CHARACTERISTIC
/begin CHARACTERISTIC InjVlv_rZFCETPoI2Dif3_GMAP "" MAP 0x8004D3A4 MapG_Ws16 100.0000 Prc 0.00 100.0000 EXTENDED_LIMITS -400.0000 399.9878
 /begin AXIS_DESCR COM_AXIS RailP_pCurr_mp Pres_Rail 6 200.0000 2000.0000 EXTENDED_LIMITS -3276.8000 3276.7000 AXIS_PTS_REF InjVlv_pRailZFCETPoICor_AXIS /end AXIS_DESCR
 /begin AXIS_DESCR COM_AXIS InjVlv_qInZFCETGMap_mp InjMass 6 0.00 3.000000 EXTENDED_LIMITS -327.6800 327.6700 AXIS_PTS_REF InjVlv_qZFCETPoI2Cor_AXIS /end AXIS_DESCR
/end CHARACTERISTIC
/begin CHARACTERISTIC InjVlv_rZFCETPoI2Dif4_GMAP "" MAP 0x8004D3EC MapG_Ws16 100.0000 Prc 0.00 100.0000 EXTENDED_LIMITS -400.0000 399.9878
 /begin AXIS_DESCR COM_AXIS RailP_pCurr_mp Pres_Rail 6 200.0000 2000.0000 EXTENDED_LIMITS -3276.8000 3276.7000 AXIS_PTS_REF InjVlv_pRailZFCETPoICor_AXIS /end AXIS_DESCR
 /begin AXIS_DESCR COM_AXIS InjVlv_qInZFCETGMap_mp InjMass 6 0.00 3.000000 EXTENDED_LIMITS -327.6800 327.6700 AXIS_PTS_REF InjVlv_qZFCETPoI2Cor_AXIS /end AXIS_DESCR
/end CHARACTERISTIC
/begin CHARACTERISTIC InjVlv_rZFCETPoI2Dif5_GMAP "" MAP 0x8004D434 MapG_Ws16 100.0000 Prc 0.00 100.0000 EXTENDED_LIMITS -400.0000 399.9878
 /begin AXIS_DESCR COM_AXIS RailP_pCurr_mp Pres_Rail 6 200.0000 2000.0000 EXTENDED_LIMITS -3276.8000 3276.7000 AXIS_PTS_REF InjVlv_pRailZFCETPoICor_AXIS /end AXIS_DESCR
 /begin AXIS_DESCR COM_AXIS InjVlv_qInZFCETGMap_mp InjMass 6 0.00 3.000000 EXTENDED_LIMITS -327.6800 327.6700 AXIS_PTS_REF InjVlv_qZFCETPoI2Cor_AXIS /end AXIS_DESCR
/end CHARACTERISTIC
/begin CHARACTERISTIC InjVlv_rZFCETPoI2Dif6_GMAP "" MAP 0x8004D47C MapG_Ws16 100.0000 Prc 0.00 100.0000 EXTENDED_LIMITS -400.0000 399.9878
 /begin AXIS_DESCR COM_AXIS RailP_pCurr_mp Pres_Rail 6 200.0000 2000.0000 EXTENDED_LIMITS -3276.8000 3276.7000 AXIS_PTS_REF InjVlv_pRailZFCETPoICor_AXIS /end AXIS_DESCR
 /begin AXIS_DESCR COM_AXIS InjVlv_qInZFCETGMap_mp InjMass 6 0.00 3.000000 EXTENDED_LIMITS -327.6800 327.6700 AXIS_PTS_REF InjVlv_qZFCETPoI2Cor_AXIS /end AXIS_DESCR
/end CHARACTERISTIC
/begin CHARACTERISTIC InjVlv_rZFCETPoI2Msk_GMAP "" MAP 0x8004D4C4 MapG_Ws16 100.0000 Prc 0.00 100.0000 EXTENDED_LIMITS -400.0000 399.9878
 /begin AXIS_DESCR COM_AXIS RailP_pCurr_mp Pres_Rail 6 200.0000 2000.0000 EXTENDED_LIMITS -3276.8000 3276.7000 AXIS_PTS_REF InjVlv_pRailZFCETPoICor_AXIS /end AXIS_DESCR
 /begin AXIS_DESCR COM_AXIS InjVlv_qInZFCETGMap_mp InjMass 6 0.00 3.000000 EXTENDED_LIMITS -327.6800 327.6700 AXIS_PTS_REF InjVlv_qZFCETPoI2Cor_AXIS /end AXIS_DESCR
/end CHARACTERISTIC
/begin CHARACTERISTIC InjVlv_stInputZFCETGMap_C "Auswahl der Menge für Anzeige der Gruppenkennfelder InjVlv_rZFCETDif0_GMAP, ...Dif1_GMAP, ...Msk_GMAP" VALUE 0x8004D50C Val_Wu8 255.0 OneToOne 0.00 255.0 /end CHARACTERISTIC
/begin CHARACTERISTIC InjVlv_stZFCETCorActv_C "Aktivierungsstatus der ZFC Ansteuerdauerkorrektur (0 = keine Korrektur)" VALUE 0x8004D50D Val_Wu8 0.00 OneToOne 0.00 0.00 EXTENDED_LIMITS 0.00 255.0 /end CHARACTERISTIC
/begin CHARACTERISTIC InjVlv_swtZFCCorOvrRunOn_C "minimale ZFC Ansteuerdauerkorrektur" VALUE 0x8004D50E Val_Wu8 0.00 OneToOne 0.00 0.00 EXTENDED_LIMITS 0.00 255.0 /end CHARACTERISTIC
/begin CHARACTERISTIC InjVlv_tiZFCETCorMax_C "maximale ZFC Ansteuerdauerkorrektur" VALUE 0x8004D510 Val_Ws16 5300.0000 InjTime_us -300.0000 5000.0000 EXTENDED_LIMITS -13107.20 13106.80 /end CHARACTERISTIC
/begin CHARACTERISTIC InjVlv_tiZFCETCorMin_C "minimale ZFC Ansteuerdauerkorrektur" VALUE 0x8004D512 Val_Ws16 5300.0000 InjTime_us -300.0000 5000.0000 EXTENDED_LIMITS -13107.20 13106.80 /end CHARACTERISTIC
/begin CHARACTERISTIC ISC_stMskTrqAcc_C "Bitleiste, in welchem Kupplungszustand bei Automatfahrzeugen die Beschleunigende Drehmomente des Antriebsstrangs und des Fahrzeugs mitgerechnet werden (Bit0 P/N, Bit1 offen, Bit2 geregelt, Bit3 geschlossen)" VALUE 0x8003CA98 Val_Wu8 15.00 OneToOne 0.00 15.00 EXTENDED_LIMITS 0.00 255.0 /end CHARACTERISTIC
/begin CHARACTERISTIC ISC_stMskTrqConv_C "Bitleiste, in welchem Kupplungszustand bei Automatfahrzeugen das Wandleraufnahmedrehmoment verwendet wird (Bit0 P/N, Bit1 offen, Bit2 geregelt, Bit3 geschlossen)" VALUE 0x8003CA99 Val_Wu8 15.00 OneToOne 0.00 15.00 EXTENDED_LIMITS 0.00 255.0 /end CHARACTERISTIC
/begin CHARACTERISTIC ISC_stPrio_CA "Priorisierung der ISC Anforderer" VAL_BLK 0x8003CA9A ValA_Ws16 4.00000000000 ISCstPrioSel 1.00000000000 5.00000000000 FORMAT "%13.11" NUMBER 5 /end CHARACTERISTIC
/begin CHARACTERISTIC ISC_swtEngTestBen_C "Software Schalter für Betriebsarten Umschaltung am Motorprüfstand" VALUE 0x8003CA90 Val_Wu8 2.000 OneToOne 0.00 2.000 EXTENDED_LIMITS 0.00 255.0 /end CHARACTERISTIC
/begin CHARACTERISTIC ISC_swtTrqConv_C "Softwareschalter um auszuwählen ob der Wert von Conv_trqFlt vorgesteuert werden soll" VALUE 0x8003CA91 Val_Wu8 4.000 OneToOne 0.00 4.000 EXTENDED_LIMITS 0.00 255.0 /end CHARACTERISTIC
/begin CHARACTERISTIC ISC_tiPT1TrqFlt_CUR "Kennlinie der Zeitkonstanten für die PT1-Flterung des ISC Ausgangsdrehmoments" CURVE 0x8003CAA4 Cur_Xs16Ws16 5.000000 TimeDelay_s_Lin_16 0.00 5.000000 FORMAT "%8.6" EXTENDED_LIMITS -5.000153 5.000000
 /begin AXIS_DESCR STD_AXIS ISC_nDiffLoFlt_mp EngN 25 -16384.00 16383.50 DEPOSIT ABSOLUTE /end AXIS_DESCR
/end CHARACTERISTIC
/begin CHARACTERISTIC ISC_trqLossFlt_C "Applikationsgröße für trqLossFlt kann über Schalter fest auf diesen Wert gesetzt werden" VALUE 0x8003CA94 Val_Wr32 1500.00000 Trq_float -500.000000 1000.00000 EXTENDED_LIMITS -1.00000000E+037 1.00000000E+037 /end CHARACTERISTIC
/begin CHARACTERISTIC IVActr_chRC_C "Remote control für IVActr_ch" VALUE 0x8003CB6C Val_Ws16 65535.00 Charge_PA -32768.00 32767.00 FORMAT "%8.2" /end CHARACTERISTIC
/begin CHARACTERISTIC IVActr_facWActrChCor_C "Korrekturfaktor für die Aktorenergie des Ladevorgang" VALUE 0x8003CB0C Val_Ws16 511.9922 Fact1 -256.0000 255.9922 /end CHARACTERISTIC
/begin CHARACTERISTIC IVActr_facWActrCor_C "Korrekturfaktor für die Aktorenergie" VALUE 0x8003CB0E Val_Ws16 511.9922 Fact1 -256.0000 255.9922 /end CHARACTERISTIC
/begin CHARACTERISTIC IVActr_facWActrDisChCor_C "Korrekturfaktor für die Entladeenergie des Aktors" VALUE 0x8003CB10 Val_Ws16 511.9922 Fact1 -256.0000 255.9922 /end CHARACTERISTIC
/begin CHARACTERISTIC IVActr_facWActrDvtAvrgRC_C "Fernsteuerwert des durchschnittlichen Aktorenergieabweichungsfaktors" VALUE 0x8003CB12 Val_Ws16 511.9922 Fact1 -256.0000 255.9922 /end CHARACTERISTIC
/begin CHARACTERISTIC IVActr_facWActrDvtMax_C "Maximalwert für die Aktorenergieabweichung" VALUE 0x8003CB14 Val_Ws16 511.9922 Fact1 -256.0000 255.9922 /end CHARACTERISTIC
/begin CHARACTERISTIC IVActr_facWActrDvtMin_C "Minimalwert für die Aktorenergieabweichung" VALUE 0x8003CB16 Val_Ws16 511.9922 Fact1 -256.0000 255.9922 /end CHARACTERISTIC
/begin CHARACTERISTIC IVActr_facWActrMax_C "obere Grenze des Energieverbrauchsfaktors zur Energiedrifterkennung" VALUE 0x8003CB18 Val_Ws16 511.9922 Fact1 -256.0000 255.9922 /end CHARACTERISTIC
/begin CHARACTERISTIC IVActr_facWActrMin_C "Untere Grenze des Energieverbrauchsfaktors zur Energiedrifterkennung" VALUE 0x8003CB1A Val_Ws16 511.9922 Fact1 -256.0000 255.9922 /end CHARACTERISTIC
/begin CHARACTERISTIC IVActr_facWActrTemp_CUR "Kennlinie für die Temperaturkorrektur des erwarteten Aktorenergieverbrauchs" CURVE 0x8003CB1C Cur_Xs16Ws16 511.9922 Fact1 -256.0000 255.9922
 /begin AXIS_DESCR STD_AXIS IVActr_tActr Temp_Cels 5 -273.1400 136.3600 EXTENDED_LIMITS -3549.940 3003.560 DEPOSIT ABSOLUTE /end AXIS_DESCR
/end CHARACTERISTIC
/begin CHARACTERISTIC IVActr_numFacWVldMin_C "minimale Anzahl an gültigen Aktorenergiekorrekturfaktoren zur Mittelwertbildung" VALUE 0x8003CB32 Val_Ws16 65535.00 OneToOne -32768.00 32767.00 /end CHARACTERISTIC
/begin CHARACTERISTIC IVActr_numIntrGetMeas_C "Max. Anzahl Interrups des gemessenen Einspritztyps zwischen Start und Auswertung der Aktormessung" VALUE 0x8003CB6E Val_Wu8 255.0 OneToOne 0.00 255.0 /end CHARACTERISTIC
/begin CHARACTERISTIC IVActr_pRailLnkRC_C "Remote-Wert für gepaarten Raildruck der gemessenen Einspritzung" VALUE 0x8003CB70 Val_Ws16 5276.800 Pres_Rail -3276.800 2000.000 EXTENDED_LIMITS -3276.800 3276.700 /end CHARACTERISTIC
/begin CHARACTERISTIC IVActr_resCalcChShunt_C "Shunt auf dem Piezo Aktor" VALUE 0x8003CB72 Val_Ws16 0.00 Resist_1 20.00000 20.00000 FORMAT "%8.5" EXTENDED_LIMITS -32768.00 32767.00 /end CHARACTERISTIC
/begin CHARACTERISTIC IVActr_stActrEnrgRC_C "Fernsteuerwert der des Aktorenergiestatus" VALUE 0x8003CB34 Val_Wu16 65535.00 OneToOne 0.00 65535.00 /end CHARACTERISTIC
/begin CHARACTERISTIC IVActr_stChRC_C "Remote_Wert für IVActr_stCh" VALUE 0x8003CB74 Val_Wu8 255.0 OneToOne 0.00 255.0 /end CHARACTERISTIC
/begin CHARACTERISTIC IVActr_stTiDisChRC_C "Remote-Wert für Status der Aktor-Entladezeit" VALUE 0x8003CB75 Val_Wu8 255.0 OneToOne 0.00 255.0 /end CHARACTERISTIC
/begin CHARACTERISTIC IVActr_stTiETMeasRC_C "Remote-Wert für Status der gemessenen Ansteuerdauer" VALUE 0x8003CB76 Val_Wu8 255.0 OneToOne 0.00 255.0 /end CHARACTERISTIC
/begin CHARACTERISTIC IVActr_stUChrgUpRC_C "Remote-Schalter für Status der Aktorspannung nach dem Laden" VALUE 0x8003CB77 Val_Wu8 255.0 OneToOne 0.00 255.0 /end CHARACTERISTIC
/begin CHARACTERISTIC IVActr_stUDisChStopRC_C "Remote-Wert für Status der Aktorspannung nach dem Entladen" VALUE 0x8003CB78 Val_Wu8 255.0 OneToOne 0.00 255.0 /end CHARACTERISTIC
/begin CHARACTERISTIC IVActr_stUUpRC_C "Remote-Wert für Status der Aktorspannung Up-Niveau" VALUE 0x8003CB79 Val_Wu8 255.0 OneToOne 0.00 255.0 /end CHARACTERISTIC
/begin CHARACTERISTIC IVActr_swtActrEnrgEnaRC_C "Schalter zum aktivieren der Fernsteuerung für die Bitpositionen im Status der Aktorenergie" VALUE 0x8003CB36 Val_Wu16 65535.00 OneToOne 0.00 65535.00 /end CHARACTERISTIC
/begin CHARACTERISTIC IVActr_swtActrEnrgRC_C "Schalter zur Aktivierung der Fernsteuerung der Aktorenergieberechnung" VALUE 0x8003CB38 Val_Wu8 255.0 OneToOne 0.00 255.0 /end CHARACTERISTIC
/begin CHARACTERISTIC IVActr_swtChRC_C "Remote-Schalter für Piezo Aktor-Ladung nach dem Laden" VALUE 0x8003CB7A Val_Wu8 255.0 OneToOne 0.00 255.0 /end CHARACTERISTIC
/begin CHARACTERISTIC IVActr_swtEnaWActrCor_C "Schalter zur aktivierung der Aktorenergiekorrektur" VALUE 0x8003CB39 Val_Wu8 255.0 OneToOne 0.00 255.0 /end CHARACTERISTIC
/begin CHARACTERISTIC IVActr_swtFacWActrDvtAvrgRC_C "Schalter zur Aktivierung des Fernsteuerwertes des durchschnittlichen Aktorenergieabweichungsfaktors" VALUE 0x8003CB3A Val_Wu8 255.0 OneToOne 0.00 255.0 /end CHARACTERISTIC
/begin CHARACTERISTIC IVActr_swtGetMeasRC_C "Allgemeine Aktivierung von Remote-Schalter in Piezo Aktor Messung Funktion." VALUE 0x8003CB7B Val_Wu8 255.0 OneToOne 0.00 255.0 /end CHARACTERISTIC
/begin CHARACTERISTIC IVActr_swtNewMeasRC_C "Fernsteuerwert zur Aktivierung des Modules (Aktivierung findet im Fall einer neuen Messung statt)" VALUE 0x8003CB3B Val_Wu8 255.0 OneToOne 0.00 255.0 /end CHARACTERISTIC
/begin CHARACTERISTIC IVActr_swtPRailLnkRC_C "Remote-Schalter für gepaarten Raildruck der gemessenen Einspritzung" VALUE 0x8003CB7C Val_Wu8 255.0 OneToOne 0.00 255.0 /end CHARACTERISTIC
/begin CHARACTERISTIC IVActr_swtTiChrgLnkRC_C "Remote-Schalter für gepaarte Soll-Ladezeit" VALUE 0x8003CB7D Val_Wu8 255.0 OneToOne 0.00 255.0 /end CHARACTERISTIC
/begin CHARACTERISTIC IVActr_swtTiDisChLnkRC_C "Remote-Schalter für die gepaarte Soll-Entladezeit" VALUE 0x8003CB7E Val_Wu8 255.0 OneToOne 0.00 255.0 /end CHARACTERISTIC
/begin CHARACTERISTIC IVActr_swtTiDisChRC_C "Remote-Schalter für Aktor-Entladezeit" VALUE 0x8003CB7F Val_Wu8 255.0 OneToOne 0.00 255.0 /end CHARACTERISTIC
/begin CHARACTERISTIC IVActr_swtTiETMeasRC_C "Remote-Schalter für gemessene Ansteuerdauer" VALUE 0x8003CB80 Val_Wu8 255.0 OneToOne 0.00 255.0 /end CHARACTERISTIC
/begin CHARACTERISTIC IVActr_swtTunDet_C "" VALUE 0x8003CB81 Val_Wu8 255.0 OneToOne 0.00 255.0 /end CHARACTERISTIC
/begin CHARACTERISTIC IVActr_swtUChrgUpRC_C "Remote-Schalter für Aktorspannung nach dem Laden" VALUE 0x8003CB82 Val_Wu8 255.0 OneToOne 0.00 255.0 /end CHARACTERISTIC
/begin CHARACTERISTIC IVActr_swtUDisChStopRC_C "Remote-Schalter für Aktorspannung nach dem Entladen" VALUE 0x8003CB83 Val_Wu8 255.0 OneToOne 0.00 255.0 /end CHARACTERISTIC
/begin CHARACTERISTIC IVActr_swtUUpLnkRC_C "Remote-Schalter für gepaarten Aktor-Sollspannungswert Up-Niveau" VALUE 0x8003CB84 Val_Wu8 255.0 OneToOne 0.00 255.0 /end CHARACTERISTIC
/begin CHARACTERISTIC IVActr_swtUUpRC_C "Remote-Schalter für Aktorspannung Up-Niveau" VALUE 0x8003CB85 Val_Wu8 255.0 OneToOne 0.00 255.0 /end CHARACTERISTIC
/begin CHARACTERISTIC IVActr_tActrDfl_C "Defaultaktortemperatur" VALUE 0x8003CBBA Val_Ws16 220.0000 Temp_Cels -40.04000 179.9600 EXTENDED_LIMITS -3549.940 3003.560 /end CHARACTERISTIC
/begin CHARACTERISTIC IVActr_tActr_CUR "Kennlinie: Anpassung der Aktortemperatur zur vorgegebenen Temperatur" CURVE 0x8003CBBC Cur_Xs16Ws16 220.0000 Temp_Cels -40.04000 179.9600 EXTENDED_LIMITS -3549.940 3003.560
 /begin AXIS_DESCR STD_AXIS CEngDsT_t Temp_Cels 4 -50.14000 199.8600 EXTENDED_LIMITS -3549.940 3003.560 DEPOSIT ABSOLUTE /end AXIS_DESCR
/end CHARACTERISTIC
/begin CHARACTERISTIC IVActr_tiActrMeasTOut_C "Timeout's Label für die Überprüfung des Messungsdauers" VALUE 0x8003CB86 Val_Ws8 0.08000 Time_s 0.02000 0.1000 EXTENDED_LIMITS -1.280 1.270 /end CHARACTERISTIC
/begin CHARACTERISTIC IVActr_tiChrgLnkRC_C "Remote-Wert für gepaarte Soll-Ladezeit" VALUE 0x8003CB88 Val_Ws16 18107.20 InjTime_us -13107.20 5000.00 EXTENDED_LIMITS -13107.20 13106.80 /end CHARACTERISTIC
/begin CHARACTERISTIC IVActr_tiDisChLnkRC_C "Remote-Wert für die gepaarte Soll-Entladezeit" VALUE 0x8003CB8A Val_Ws16 18107.20 InjTime_us -13107.20 5000.00 EXTENDED_LIMITS -13107.20 13106.80 /end CHARACTERISTIC
/begin CHARACTERISTIC IVActr_tiDisChRC_C "Remote-Wert für Aktor-Entladezeit" VALUE 0x8003CB8C Val_Ws16 18107.20 InjTime_us -13107.20 5000.00 EXTENDED_LIMITS -13107.20 13106.80 /end CHARACTERISTIC
/begin CHARACTERISTIC IVActr_tiEnrgIntegAdjMax_C "Maximale Zeit seit dem letzten Integratorabgleich, nach der die Ladungsmessung noch gültig ist" VALUE 0x8003CB3C Val_Wu32 234505214.307 Time_PzoMeas 0.00 234505214.307 FORMAT "%13.3" /end CHARACTERISTIC
/begin CHARACTERISTIC IVActr_tiETMeasRC_C "Remote-Wert für gemessene Ansteuerdauer" VALUE 0x8003CB8E Val_Ws16 18107.20 InjTime_us -13107.20 5000.00 EXTENDED_LIMITS -13107.20 13106.80 /end CHARACTERISTIC
/begin CHARACTERISTIC IVActr_tiMax_C "Max Zeit Begrenzung" VALUE 0x8003CB90 Val_Ws16 5000.00 InjTime_us 0.00 5000.00 EXTENDED_LIMITS -13107.20 13106.80 /end CHARACTERISTIC
/begin CHARACTERISTIC IVActr_tiMinDstTunTrg_C "" VALUE 0x8003CB92 Val_Ws16 5000.0000 InjTime_us 0.00 5000.0000 EXTENDED_LIMITS -13107.20 13106.80 /end CHARACTERISTIC
/begin CHARACTERISTIC IVActr_tiMin_C "Min Zeit Begrenzung" VALUE 0x8003CB94 Val_Ws16 5000.00 InjTime_us 0.00 5000.00 EXTENDED_LIMITS -13107.20 13106.80 /end CHARACTERISTIC
/begin CHARACTERISTIC IVActr_uActrLin_CUR "Linearisierungs-Kennlinie für Aktorspannung" CURVE 0x8003CB96 Cur_Xs16Ws16 655.3500 Vltg_PA -327.6800 327.6700
 /begin AXIS_DESCR STD_AXIS IVActr_uActrRaw_mp Volt 2 0.00 5200.000 EXTENDED_LIMITS -6553.600 6553.400 DEPOSIT ABSOLUTE /end AXIS_DESCR
/end CHARACTERISTIC
/begin CHARACTERISTIC IVActr_uBotDfl_C "Vorgabewert der Spannung eines entladenen Aktors" VALUE 0x8003CB40 Val_Ws16 655.3500 Vltg_PA -327.6800 327.6700 /end CHARACTERISTIC
/begin CHARACTERISTIC IVActr_uChrgUpRC_C "Remote-Wert für Aktorspannung nach dem Laden" VALUE 0x8003CBA0 Val_Ws16 655.3500 Vltg_PA -327.6800 327.6700 /end CHARACTERISTIC
/begin CHARACTERISTIC IVActr_UCh_SRC.uMin_C "Klasseninstanz für Ladespannungs: Signal Range Check/" VALUE 0x8003CBA2 Kw_Ws16 5200.000 Volt 0.00 5200.000 EXTENDED_LIMITS -6553.600 6553.400 /end CHARACTERISTIC
/begin CHARACTERISTIC IVActr_UCh_SRC.uMax_C "Klasseninstanz für Ladespannungs: Signal Range Check/" VALUE 0x8003CBA4 Kw_Ws16 5200.000 Volt 0.00 5200.000 EXTENDED_LIMITS -6553.600 6553.400 /end CHARACTERISTIC
/begin CHARACTERISTIC IVActr_uDisChStopRC_C "Remote-Wert für Aktorspannung nach dem Entladen" VALUE 0x8003CBA6 Val_Ws16 655.3500 Vltg_PA -327.6800 327.6700 /end CHARACTERISTIC
/begin CHARACTERISTIC IVActr_uUpLnkRC_CA "Zylinder spezifischer Remote-Wert für gepaarten Aktor-Sollspannungswert Up-Niveau" VAL_BLK 0x8003CBA8 ValA_Ws16 250.0000 Vltg_PA 0.00 250.0000 EXTENDED_LIMITS -327.6800 327.6700 NUMBER 6 /end CHARACTERISTIC
/begin CHARACTERISTIC IVActr_uUpRC_C "Remote-Wert für Aktorspannung Up-Niveau" VALUE 0x8003CBB4 Val_Ws16 655.3500 Vltg_PA -327.6800 327.6700 /end CHARACTERISTIC
/begin CHARACTERISTIC IVActr_Vltg_SRC.uMin_C "Klasseninstanz für Aktorspannungs Signal Range Check/" VALUE 0x8003CBB6 Kw_Ws16 5200.000 Volt 0.00 5200.000 EXTENDED_LIMITS -6553.600 6553.400 /end CHARACTERISTIC
/begin CHARACTERISTIC IVActr_Vltg_SRC.uMax_C "Klasseninstanz für Aktorspannungs Signal Range Check/" VALUE 0x8003CBB8 Kw_Ws16 5200.000 Volt 0.00 5200.000 EXTENDED_LIMITS -6553.600 6553.400 /end CHARACTERISTIC
/begin CHARACTERISTIC IVActr_wActrChDfl_C "Rohwert der Aktorladeenergie Vorgabewert" VALUE 0x8003CB42 Val_Ws16 655.3500 W_PA -327.6800 327.6700 FORMAT "%8.4" /end CHARACTERISTIC
/begin CHARACTERISTIC IVActr_wActrDisChDfl_C "Rohwert der Aktorentladeenergie Vorgabewert" VALUE 0x8003CB44 Val_Ws16 655.3500 W_PA -327.6800 327.6700 FORMAT "%8.4" /end CHARACTERISTIC
/begin CHARACTERISTIC IVActr_wActrNom_CUR "Kennlinie für den nominelle Aktorenergieverbrauch" CURVE 0x8003CB46 Cur_Xs16Ws16 655.3500 W_PA -327.6800 327.6700 FORMAT "%8.4"
 /begin AXIS_DESCR STD_AXIS IVActr_uChUpInCur_mp Vltg_PA 8 -250.0000 250.0000 EXTENDED_LIMITS -327.6800 327.6700 DEPOSIT ABSOLUTE /end AXIS_DESCR
/end CHARACTERISTIC
/begin CHARACTERISTIC IVActr_wActrPlausMax_C "oberer Grenzwert für die Plausibilisierung des Aktorenergieverbrauchs" VALUE 0x8003CB68 Val_Ws16 655.3500 W_PA -327.6800 327.6700 FORMAT "%8.4" /end CHARACTERISTIC
/begin CHARACTERISTIC IVActr_wActrPlausMin_C "unterer Grenzwert für die Plausibilisierung des Aktorenergieverbrauchs" VALUE 0x8003CB6A Val_Ws16 655.3500 W_PA -327.6800 327.6700 FORMAT "%8.4" /end CHARACTERISTIC
/begin CHARACTERISTIC IVAdj_facCtNVCEna_C "Skalierungsfaktoro für NVC-Lernfreigabezähler" VALUE 0x8003CD0C Val_Wu8 255.0 OneToOne 0.00 255.0 /end CHARACTERISTIC
/begin CHARACTERISTIC IVAdj_facNVCDflI_C "Default-Wert für NVC-I-Regler" VALUE 0x8003CD0E Val_Ws16 1.000000 Fact -0.5000000 0.5000000 EXTENDED_LIMITS -4.000000 3.999878 /end CHARACTERISTIC
/begin CHARACTERISTIC IVAdj_facNVCInPI_C "Gewichtungsfaktor für NVC-PI-Reglereingang" VALUE 0x8003CD10 Val_Ws16 2.000000 Fact -1.000000 1.000000 EXTENDED_LIMITS -4.000000 3.999878 /end CHARACTERISTIC
/begin CHARACTERISTIC IVAdj_facNVCMax_C "Oberer Grenzwert des NVC-Korrekturfaktors" VALUE 0x8003CD12 Val_Ws16 3.900024 Fact 0.00 3.900024 EXTENDED_LIMITS -4.000000 3.999878 /end CHARACTERISTIC
/begin CHARACTERISTIC IVAdj_facNVCMin_C "Unterer Grenzwert des NVC-Korrekturfaktors" VALUE 0x8003CD14 Val_Ws16 3.900024 Fact 0.00 3.900024 EXTENDED_LIMITS -4.000000 3.999878 /end CHARACTERISTIC
/begin CHARACTERISTIC IVAdj_facNVCRC_CA "Remote-Werte für NVC-Korrekturfaktor" VAL_BLK 0x8003CD16 ValA_Ws16 1.000000 Fact 0.5000000 1.500000 EXTENDED_LIMITS -4.000000 3.999878 NUMBER 6 /end CHARACTERISTIC
/begin CHARACTERISTIC IVAdj_INVC_CSTR.Ki_C "NVC-I-Regler (Parameter)/" VALUE 0x8003CD24 Kw_Ws32 24414.0624943 Ki_Vltg_PA2Fact -12207.0312500 12207.0312443 FORMAT "%13.7" /end CHARACTERISTIC
/begin CHARACTERISTIC IVAdj_INVC_CSTR.KiPos_C "NVC-I-Regler (Parameter)/" VALUE 0x8003CD28 Kw_Ws32 24414.0624943 Ki_Vltg_PA2Fact -12207.0312500 12207.0312443 FORMAT "%13.7" /end CHARACTERISTIC
/begin CHARACTERISTIC IVAdj_INVC_CSTR.KiNeg_C "NVC-I-Regler (Parameter)/" VALUE 0x8003CD2C Kw_Ws32 24414.0624943 Ki_Vltg_PA2Fact -12207.0312500 12207.0312443 FORMAT "%13.7" /end CHARACTERISTIC
/begin CHARACTERISTIC IVAdj_INVC_CSTR.WinPos_C "NVC-I-Regler (Parameter)/" VALUE 0x8003CD30 Kw_Ws32 42949672.9500 Vltg_PA -21474836.4800 21474836.4700 /end CHARACTERISTIC
/begin CHARACTERISTIC IVAdj_INVC_CSTR.WinNeg_C "NVC-I-Regler (Parameter)/" VALUE 0x8003CD34 Kw_Ws32 42949672.9500 Vltg_PA -21474836.4800 21474836.4700 /end CHARACTERISTIC
/begin CHARACTERISTIC IVAdj_mskInjCharNVC_C "NVC-Lernfreigabebedingung: Byte zum ausmaskieren von nicht erlaubten Einspritztypen" VALUE 0x8003CD38 Val_Wu8 255.0 OneToOne 0.00 255.0 /end CHARACTERISTIC
/begin CHARACTERISTIC IVAdj_mskStUChrgUpNVC_C "NVC-Lernfreigabebedingung: Byte zum ausmaskieren der Statusbits der Ladespannung" VALUE 0x8003CD39 Val_Wu8 255.0 OneToOne 0.00 255.0 /end CHARACTERISTIC
/begin CHARACTERISTIC IVAdj_mskStUUpNVC_C "NVC-Lernfreigabebedingung: Byte zum ausmaskieren der Statusbits der Sollspannung" VALUE 0x8003CD3A Val_Wu8 255.0 OneToOne 0.00 255.0 /end CHARACTERISTIC
/begin CHARACTERISTIC IVAdj_numClsIVAMax_C "höchste erlaubte ISA-Klasse" VALUE 0x8003CD08 Val_Wu8 0.00 OneToOne 8.000 8.000 EXTENDED_LIMITS 0.00 255.0 /end CHARACTERISTIC
/begin CHARACTERISTIC IVAdj_numClsIVAMin_C "kleinste erlaubte ISA-Klasse" VALUE 0x8003CD09 Val_Wu8 0.00 OneToOne 2.000 2.000 EXTENDED_LIMITS 0.00 255.0 /end CHARACTERISTIC
/begin CHARACTERISTIC IVAdj_numCylRC_C "Zylindernummer (Funktionsparameter von IVAdj_NVCGovInit)" VALUE 0x8003CD3B Val_Wu8 255.0 OneToOne 0.00 255.0 /end CHARACTERISTIC
/begin CHARACTERISTIC IVAdj_pMaxNVC_C "NVC-Lernfreigabebedingung: Oberere Grenze des Raildruckes" VALUE 0x8003CD3C Val_Ws16 2000.000 Pres_Rail 0.00 2000.000 EXTENDED_LIMITS -3276.800 3276.700 /end CHARACTERISTIC
/begin CHARACTERISTIC IVAdj_pMinNVC_C "NVC-Lernfreigabebedingung: Unterere Grenze des Raildrucks" VALUE 0x8003CD3E Val_Ws16 2000.000 Pres_Rail 0.00 2000.000 EXTENDED_LIMITS -3276.800 3276.700 /end CHARACTERISTIC
/begin CHARACTERISTIC IVAdj_PNVC_CSTR.Kp_C "NVC-P-Regler (Parameter)/" VALUE 0x8003CD40 Kw_Ws32 1599.99999963 Kp_Vltg_PA2Fact -800.000000000 799.999999627 FORMAT "%13.9" /end CHARACTERISTIC
/begin CHARACTERISTIC IVAdj_PNVC_CSTR.KpPos_C "NVC-P-Regler (Parameter)/" VALUE 0x8003CD44 Kw_Ws32 1599.99999963 Kp_Vltg_PA2Fact -800.000000000 799.999999627 FORMAT "%13.9" /end CHARACTERISTIC
/begin CHARACTERISTIC IVAdj_PNVC_CSTR.KpNeg_C "NVC-P-Regler (Parameter)/" VALUE 0x8003CD48 Kw_Ws32 1599.99999963 Kp_Vltg_PA2Fact -800.000000000 799.999999627 FORMAT "%13.9" /end CHARACTERISTIC
/begin CHARACTERISTIC IVAdj_PNVC_CSTR.WinPos_C "NVC-P-Regler (Parameter)/" VALUE 0x8003CD4C Kw_Ws32 42949672.9500 Vltg_PA -21474836.4800 21474836.4700 /end CHARACTERISTIC
/begin CHARACTERISTIC IVAdj_PNVC_CSTR.WinNeg_C "NVC-P-Regler (Parameter)/" VALUE 0x8003CD50 Kw_Ws32 42949672.9500 Vltg_PA -21474836.4800 21474836.4700 /end CHARACTERISTIC
/begin CHARACTERISTIC IVAdj_stGovInitRC_C "Funktionsauswahl von IVAdj_NVCGovInit (Funktionsparameter von IVAdj_NVCGovInit)" VALUE 0x8003CD54 Val_Wu8 255.0 OneToOne 0.00 255.0 /end CHARACTERISTIC
/begin CHARACTERISTIC IVAdj_stQntAdj_MAP "Statuskennfeld (Index und Gewichtungsfaktor) für den Injektor-Mengenabgleich" MAP 0x8003CBD0 Map_Xs16Ys16Ws16 32767.00 OneToOne 0.00 32767.00 EXTENDED_LIMITS -32768.00 32767.00
 /begin AXIS_DESCR STD_AXIS RailP_pFlt Pres_Rail 7 0.00 2000.000 EXTENDED_LIMITS -3276.800 3276.700 DEPOSIT ABSOLUTE /end AXIS_DESCR
 /begin AXIS_DESCR STD_AXIS InjVlv_volMI1Cor_mp InjQntInj 8 0.00 100.0000 EXTENDED_LIMITS -327.6800 327.6700 DEPOSIT ABSOLUTE /end AXIS_DESCR
/end CHARACTERISTIC
/begin CHARACTERISTIC IVAdj_stRawValRepl_C "Ersatzwerte für Injektorabgleich" VAL_BLK 0x8003CC64 ValA_Wu32 4.00000000000 OneToOne 0.00 4.00000000000 EXTENDED_LIMITS 0.00 4294967295.00 NUMBER 12 /end CHARACTERISTIC
/begin CHARACTERISTIC IVAdj_swtDiaIVAdj_C "Schalter zur Aktivierung der Überwachung auf fehlende Programmierung der Injektor-Abgleichwerte" VALUE 0x8003CC94 Val_Wu8 1.000 OneToOne 0.00 1.000 EXTENDED_LIMITS 0.00 255.0 /end CHARACTERISTIC
/begin CHARACTERISTIC IVAdj_swtFacNVCRC_C "Remote-Schalter für NVC-Korrekturfaktor" VALUE 0x8003CD55 Val_Wu8 255.0 OneToOne 0.00 255.0 /end CHARACTERISTIC
/begin CHARACTERISTIC IVAdj_swtNVCGovInitRC_C "Remoteschalter zum aktivieren des IVAdj_NVCGovInit Testprozesses" VALUE 0x8003CD56 Val_Wu8 255.0 OneToOne 0.00 255.0 /end CHARACTERISTIC
/begin CHARACTERISTIC IVAdj_swtRawValRepl_C "Schalter zum Ersetzen der Injektorabgleichwerte (0...EEPROM, 1...Ersatzwerte)" VALUE 0x8003CC95 Val_Wu8 1.000 OneToOne 0.00 1.000 EXTENDED_LIMITS 0.00 255.0 /end CHARACTERISTIC
/begin CHARACTERISTIC IVAdj_tActrMaxNVC_C "NVC-Lernfreigabebedingung: Oberer Grenzwert für Aktortemperatur" VALUE 0x8003CD58 Val_Ws16 250.0000 Temp_Cels -50.14000 199.8600 EXTENDED_LIMITS -3549.940 3003.560 /end CHARACTERISTIC
/begin CHARACTERISTIC IVAdj_tActrMinNVC_C "NVC-Lernfreigabebedingung: Unterer Grenzwert der Aktortemperatur" VALUE 0x8003CD5A Val_Ws16 250.0000 Temp_Cels -50.14000 199.8600 EXTENDED_LIMITS -3549.940 3003.560 /end CHARACTERISTIC
/begin CHARACTERISTIC IVAdj_tiMeasUUpThresNVC_C "NVC-Lernfreigabebedingung: Grenzwert für die Messdauer der Injektorspannung" VALUE 0x8003CD5C Val_Ws16 5000.00 InjTime_us 0.00 5000.00 EXTENDED_LIMITS -13107.20 13106.80 /end CHARACTERISTIC
/begin CHARACTERISTIC IVAdj_tiPIDisChThresNVC_C "NVC-Lernfreigabebedingung: Grenzwert des Entladezeitreglereinganges" VALUE 0x8003CD5E Val_Ws16 5000.00000 InjTime_us 0.00 5000.00000 EXTENDED_LIMITS -13107.20 13106.80 /end CHARACTERISTIC
/begin CHARACTERISTIC IVAdj_uDiffNVCSet_CUR "Spannungsdifferenzreferenzkurve des Sollwertes" CURVE 0x8003CD60 Cur_Xs16Ws16 250.0000 Vltg_PA 0.00 250.0000 EXTENDED_LIMITS -327.6800 327.6700
 /begin AXIS_DESCR STD_AXIS IVAdj_pDiffNVCSetCURIn_mp Pres_Rail 20 -3276.800 2000.000 EXTENDED_LIMITS -3276.800 3276.700 DEPOSIT ABSOLUTE /end AXIS_DESCR
/end CHARACTERISTIC
/begin CHARACTERISTIC IVAdj_uPIVltgThresNVC_C "NVC-Lernfreigabebedingung: Grenzwert des Sollspannungsreglereinganges" VALUE 0x8003CDB2 Val_Ws16 20.00000 Vltg_PA 0.00 20.00000 EXTENDED_LIMITS -327.6800 327.6700 /end CHARACTERISTIC
/begin CHARACTERISTIC IVAdj_valSrcPtrRC_C "Wert der Schreibquelle (Source-Pointer) (Funktionsparameter von IVAdj_NVCGovInit)" VALUE 0x8003CDB4 Val_Wu16 65535.00 OneToOne 0.00 65535.00 /end CHARACTERISTIC
/begin CHARACTERISTIC IVAdj_volQntAdjLim_C "symmetrische Begrenzung des Mengen-Abgleichwertes" VALUE 0x8003CC96 Val_Ws16 128.0000 InjQntInj 0.00 128.0000 EXTENDED_LIMITS -327.6800 327.6700 /end CHARACTERISTIC
/begin CHARACTERISTIC IVAdj_volQntAdjMax0_C "obere Grenzwerte der Mengen-Abgleichwerte für die 0-Quantisierungsschrittweite (0d=00b)" VAL_BLK 0x8003CC98 ValA_Ws16 6.300000 InjQntInj 0.00 6.300000 EXTENDED_LIMITS -327.6800 327.6700 NUMBER 7 /end CHARACTERISTIC
/begin CHARACTERISTIC IVAdj_volQntAdjMax1_C "obere Grenzwerte der Mengen-Abgleichwerte für die 1-Quantisierungsschrittweite (1d=01b)" VAL_BLK 0x8003CCA6 ValA_Ws16 9.450000 InjQntInj 0.00 9.450000 EXTENDED_LIMITS -327.6800 327.6700 NUMBER 7 /end CHARACTERISTIC
/begin CHARACTERISTIC IVAdj_volQntAdjMax2_C "obere Grenzwerte der Mengen-Abgleichwerte für die 2-Quantisierungsschrittweite (2d=10b)" VAL_BLK 0x8003CCB4 ValA_Ws16 15.75000 InjQntInj 0.00 15.75000 EXTENDED_LIMITS -327.6800 327.6700 NUMBER 7 /end CHARACTERISTIC
/begin CHARACTERISTIC IVAdj_volQntAdjMax3_C "obere Grenzwerte der Mengen-Abgleichwerte für die 3-Quantisierungsschrittweite (3d=11b)" VAL_BLK 0x8003CCC2 ValA_Ws16 31.50000 InjQntInj 0.00 31.50000 EXTENDED_LIMITS -327.6800 327.6700 NUMBER 7 /end CHARACTERISTIC
/begin CHARACTERISTIC IVAdj_volQntAdjMin0_C "untere Grenzwerte der Mengen-Abgleichwerte für die 0-Quantisierungsschrittweite (0d=00b)" VAL_BLK 0x8003CCD0 ValA_Ws16 6.400000 InjQntInj -6.400000 0.00 EXTENDED_LIMITS -327.6800 327.6700 NUMBER 7 /end CHARACTERISTIC
/begin CHARACTERISTIC IVAdj_volQntAdjMin1_C "untere Grenzwerte der Mengen-Abgleichwerte für die 1-Quantisierungsschrittweite (1d=01b)" VAL_BLK 0x8003CCDE ValA_Ws16 9.600000 InjQntInj -9.600000 0.00 EXTENDED_LIMITS -327.6800 327.6700 NUMBER 7 /end CHARACTERISTIC
/begin CHARACTERISTIC IVAdj_volQntAdjMin2_C "untere Grenzwerte der Mengen-Abgleichwerte für die 2-Quantisierungsschrittweite (2d=10b)" VAL_BLK 0x8003CCEC ValA_Ws16 16.00000 InjQntInj -16.00000 0.00 EXTENDED_LIMITS -327.6800 327.6700 NUMBER 7 /end CHARACTERISTIC
/begin CHARACTERISTIC IVAdj_volQntAdjMin3_C "untere Grenzwerte der Mengen-Abgleichwerte für die 3-Quantisierungsschrittweite (3d=11b)" VAL_BLK 0x8003CCFA ValA_Ws16 32.00000 InjQntInj -32.00000 0.00 EXTENDED_LIMITS -327.6800 327.6700 NUMBER 7 /end CHARACTERISTIC
/begin CHARACTERISTIC IVCtl_facUDiffUpPlausMax_C "Plausibilitätsgrenze des Spannungsreglereingangs" VALUE 0x8003D24C Val_Ws16 2.000000 Fact 0.00 2.000000 EXTENDED_LIMITS -4.000000 3.999878 /end CHARACTERISTIC
/begin CHARACTERISTIC IVCtl_facVltgTempCor_CUR "Kennlinie: Bestimmung der Spannungskompensation aus der Aktortemperatur" CURVE 0x8003CF92 Cur_Xs16Ws16 0.2099609 Fact 1.000000 1.209961 EXTENDED_LIMITS -4.000000 3.999878
 /begin AXIS_DESCR STD_AXIS IVActr_tActr Temp_Cels 10 -40.04000 179.9600 EXTENDED_LIMITS -3549.940 3003.560 DEPOSIT ABSOLUTE /end AXIS_DESCR
/end CHARACTERISTIC
/begin CHARACTERISTIC IVCtl_iChrgRC_CA "Remotewert für Ladestrom" VAL_BLK 0x8003CFBC ValA_Ws16 20000.00 Curr 0.00 20000.00 FORMAT "%8.2" EXTENDED_LIMITS -32768.00 32767.00 NUMBER 6 /end CHARACTERISTIC
/begin CHARACTERISTIC IVCtl_iChrg_MAP "Kennfeld: Bestimmung des Ladestroms aus Ladezeit und Spannung" MAP 0x8003CFC8 Map_Xs16Ys16Ws16 20000.00 Curr 0.00 20000.00 FORMAT "%8.2" EXTENDED_LIMITS -32768.00 32767.00
 /begin AXIS_DESCR STD_AXIS IVCtl_uChrgMapIn_mp Vltg_PA 25 -327.6800 327.6700 DEPOSIT ABSOLUTE /end AXIS_DESCR
 /begin AXIS_DESCR STD_AXIS IVCtl_tiChrg InjTime_us 6 0.00 5000.00 EXTENDED_LIMITS -13107.20 13106.80 DEPOSIT ABSOLUTE /end AXIS_DESCR
/end CHARACTERISTIC
/begin CHARACTERISTIC IVCtl_iDisCh_MAP "Kennfeld: Berechnung der Entladestroms aus Entladezeit und Spannung" MAP 0x8003CDEC Map_Xs16Ys16Ws16 60000.00 Curr -30000.00 30000.00 FORMAT "%8.2" EXTENDED_LIMITS -32768.00 32767.00
 /begin AXIS_DESCR STD_AXIS IVCtl_uUpMapIn_mp Vltg_PA 25 -327.6800 327.6700 DEPOSIT ABSOLUTE /end AXIS_DESCR
 /begin AXIS_DESCR STD_AXIS IVCtl_tiDisCh InjTime_us 6 0.00 5000.0000 EXTENDED_LIMITS -13107.20 13106.80 DEPOSIT ABSOLUTE /end AXIS_DESCR
/end CHARACTERISTIC
/begin CHARACTERISTIC IVCtl_iPIMax_C "Begrenzung: Maximalwert des PI-Reglerausgangs der Entladezeitregelung" VALUE 0x8003CDB8 Val_Ws16 20000.00 Curr -10000.00 10000.00 FORMAT "%8.2" EXTENDED_LIMITS -32768.00 32767.00 /end CHARACTERISTIC
/begin CHARACTERISTIC IVCtl_iPIMin_C "Begrenzung: Minimalwert des PI-Reglerausgangs der Entladezeitregelung" VALUE 0x8003CDBA Val_Ws16 20000.00 Curr -10000.00 10000.00 FORMAT "%8.2" EXTENDED_LIMITS -32768.00 32767.00 /end CHARACTERISTIC
/begin CHARACTERISTIC IVCtl_ITGov_CSTR.Ki_C "I-Parameter des Entladezeitreglers/" VALUE 0x8003CDBC Kw_Ws32 4999999.99884 Ki_InjTime_us2Curr -2500000.00000 2499999.99884 FORMAT "%13.5" /end CHARACTERISTIC
/begin CHARACTERISTIC IVCtl_ITGov_CSTR.KiPos_C "I-Parameter des Entladezeitreglers/" VALUE 0x8003CDC0 Kw_Ws32 4999999.99884 Ki_InjTime_us2Curr -2500000.00000 2499999.99884 FORMAT "%13.5" /end CHARACTERISTIC
/begin CHARACTERISTIC IVCtl_ITGov_CSTR.KiNeg_C "I-Parameter des Entladezeitreglers/" VALUE 0x8003CDC4 Kw_Ws32 4999999.99884 Ki_InjTime_us2Curr -2500000.00000 2499999.99884 FORMAT "%13.5" /end CHARACTERISTIC
/begin CHARACTERISTIC IVCtl_ITGov_CSTR.WinPos_C "I-Parameter des Entladezeitreglers/" VALUE 0x8003CDC8 Kw_Ws32 858998459.200 InjTime_us -858993459.200 5000.000 EXTENDED_LIMITS -858993459.200 858993458.800 /end CHARACTERISTIC
/begin CHARACTERISTIC IVCtl_ITGov_CSTR.WinNeg_C "I-Parameter des Entladezeitreglers/" VALUE 0x8003CDCC Kw_Ws32 858998459.200 InjTime_us -858993459.200 5000.000 EXTENDED_LIMITS -858993459.200 858993458.800 /end CHARACTERISTIC
/begin CHARACTERISTIC IVCtl_IVltgGov_CSTR.Ki_C "I-Werte des Aktorspannungsreglers/" VALUE 0x8003D250 Kw_Ws32 1999999.99953 Ki_Vltg_PA2Vltg_PA -1000000.00000 999999.999534 FORMAT "%13.5" /end CHARACTERISTIC
/begin CHARACTERISTIC IVCtl_IVltgGov_CSTR.KiPos_C "I-Werte des Aktorspannungsreglers/" VALUE 0x8003D254 Kw_Ws32 1999999.99953 Ki_Vltg_PA2Vltg_PA -1000000.00000 999999.999534 FORMAT "%13.5" /end CHARACTERISTIC
/begin CHARACTERISTIC IVCtl_IVltgGov_CSTR.KiNeg_C "I-Werte des Aktorspannungsreglers/" VALUE 0x8003D258 Kw_Ws32 1999999.99953 Ki_Vltg_PA2Vltg_PA -1000000.00000 999999.999534 FORMAT "%13.5" /end CHARACTERISTIC
/begin CHARACTERISTIC IVCtl_IVltgGov_CSTR.WinPos_C "I-Werte des Aktorspannungsreglers/" VALUE 0x8003D25C Kw_Ws32 42949672.9500 Vltg_PA -21474836.4800 21474836.4700 /end CHARACTERISTIC
/begin CHARACTERISTIC IVCtl_IVltgGov_CSTR.WinNeg_C "I-Werte des Aktorspannungsreglers/" VALUE 0x8003D260 Kw_Ws32 42949672.9500 Vltg_PA -21474836.4800 21474836.4700 /end CHARACTERISTIC
/begin CHARACTERISTIC IVCtl_mskTGov_C "Bitmaske: gesetzte Bits in IVActr_stUUp führen zur Verriegelung des PI-Reglers der Aktorspannungsregelung" VALUE 0x8003CDD0 Val_Wu8 255.0 OneToOne 0.00 255.0 /end CHARACTERISTIC
/begin CHARACTERISTIC IVCtl_mskVltgGov_C "Bitmaske: gesetzte Bits in IVActr_stUUp führen zur Verriegelung des PI-Reglers der Aktorspannungsregelung" VALUE 0x8003D264 Val_Wu8 255.0 OneToOne 0.00 255.0 /end CHARACTERISTIC
/begin CHARACTERISTIC IVCtl_pRC_CA "Remotewert für IVCtl_p (Einspritztyp-spezifisch)" VAL_BLK 0x8003D136 ValA_Ws16 2000.000 Pres_Rail 0.00 2000.000 EXTENDED_LIMITS -3276.800 3276.700 NUMBER 8 /end CHARACTERISTIC
/begin CHARACTERISTIC IVCtl_PTGov_CSTR.Kp_C "P-Parameter des Entladezeitreglers/" VALUE 0x8003CDD4 Kw_Ws32 327679.999924 Kp_InjTime_us2Curr -163840.000000 163839.999924 FORMAT "%13.6" /end CHARACTERISTIC
/begin CHARACTERISTIC IVCtl_PTGov_CSTR.KpPos_C "P-Parameter des Entladezeitreglers/" VALUE 0x8003CDD8 Kw_Ws32 327679.999924 Kp_InjTime_us2Curr -163840.000000 163839.999924 FORMAT "%13.6" /end CHARACTERISTIC
/begin CHARACTERISTIC IVCtl_PTGov_CSTR.KpNeg_C "P-Parameter des Entladezeitreglers/" VALUE 0x8003CDDC Kw_Ws32 327679.999924 Kp_InjTime_us2Curr -163840.000000 163839.999924 FORMAT "%13.6" /end CHARACTERISTIC
/begin CHARACTERISTIC IVCtl_PTGov_CSTR.WinPos_C "P-Parameter des Entladezeitreglers/" VALUE 0x8003CDE0 Kw_Ws32 858998459.200 InjTime_us -858993459.200 5000.000 EXTENDED_LIMITS -858993459.200 858993458.800 /end CHARACTERISTIC
/begin CHARACTERISTIC IVCtl_PTGov_CSTR.WinNeg_C "P-Parameter des Entladezeitreglers/" VALUE 0x8003CDE4 Kw_Ws32 858998459.200 InjTime_us -858993459.200 5000.000 EXTENDED_LIMITS -858993459.200 858993458.800 /end CHARACTERISTIC
/begin CHARACTERISTIC IVCtl_PVltgGov_CSTR.Kp_C "P-Werte des Spannungsreglers/" VALUE 0x8003D268 Kw_Ws32 131071.999969 Kp_Vltg_PA2Vltg_PA -65536.0000000 65535.9999695 FORMAT "%13.7" /end CHARACTERISTIC
/begin CHARACTERISTIC IVCtl_PVltgGov_CSTR.KpPos_C "P-Werte des Spannungsreglers/" VALUE 0x8003D26C Kw_Ws32 131071.999969 Kp_Vltg_PA2Vltg_PA -65536.0000000 65535.9999695 FORMAT "%13.7" /end CHARACTERISTIC
/begin CHARACTERISTIC IVCtl_PVltgGov_CSTR.KpNeg_C "P-Werte des Spannungsreglers/" VALUE 0x8003D270 Kw_Ws32 131071.999969 Kp_Vltg_PA2Vltg_PA -65536.0000000 65535.9999695 FORMAT "%13.7" /end CHARACTERISTIC
/begin CHARACTERISTIC IVCtl_PVltgGov_CSTR.WinPos_C "P-Werte des Spannungsreglers/" VALUE 0x8003D274 Kw_Ws32 42949672.9500 Vltg_PA -21474836.4800 21474836.4700 /end CHARACTERISTIC
/begin CHARACTERISTIC IVCtl_PVltgGov_CSTR.WinNeg_C "P-Werte des Spannungsreglers/" VALUE 0x8003D278 Kw_Ws32 42949672.9500 Vltg_PA -21474836.4800 21474836.4700 /end CHARACTERISTIC
/begin CHARACTERISTIC IVCtl_swtIChrgRC_C "Schalter:Die Ladestrom-Grenze wird auf Remoterwerte IVCtl_iChrgRC_CA gesetzt" VALUE 0x8003D146 Val_Wu8 255.0 OneToOne 0.00 255.0 /end CHARACTERISTIC
/begin CHARACTERISTIC IVCtl_swtPRC_C "Schalter: IVCtl_p wird durch Remotewert IVCtl_pRC_CA gesetzt (einspritztypspezifisch)" VALUE 0x8003D147 Val_Wu8 1.000 OneToOne 0.00 1.000 EXTENDED_LIMITS 0.00 255.0 /end CHARACTERISTIC
/begin CHARACTERISTIC IVCtl_swtUUpRC_C "Remoteschalter für die gemessene Akuatorspannung" VALUE 0x8003D148 Val_Wu8 255.0 OneToOne 0.00 255.0 /end CHARACTERISTIC
/begin CHARACTERISTIC IVCtl_tiChrg_CUR "Kennlinie: Bestimmung der Solladezeit aus dem Raildruck" CURVE 0x8003CF5A Cur_Xs16Ws16 5000.0000 InjTime_us 0.00 5000.0000 EXTENDED_LIMITS -13107.20 13106.80
 /begin AXIS_DESCR STD_AXIS RailP_pFlt Pres_Rail 4 -3276.800 2000.000 EXTENDED_LIMITS -3276.800 3276.700 DEPOSIT ABSOLUTE /end AXIS_DESCR
/end CHARACTERISTIC
/begin CHARACTERISTIC IVCtl_tiDiffOBDDvt_C "Zulässige Regelabweichung der Entladezeit für die OBD Überwachung" VALUE 0x8003CDE8 Val_Ws16 5000.0000 InjTime_us 0.00 5000.0000 EXTENDED_LIMITS -13107.20 13106.80 /end CHARACTERISTIC
/begin CHARACTERISTIC IVCtl_tiDisCh_CUR "Kennlinie: Berechnung der Entladezeit aus dem Raildruck" CURVE 0x8003CF6C Cur_Xs16Ws16 35000.00 InjTime_us -30000.00 5000.00 EXTENDED_LIMITS -13107.20 13106.80
 /begin AXIS_DESCR STD_AXIS RailP_pFlt Pres_Rail 4 -3276.800 2000.000 EXTENDED_LIMITS -3276.800 3276.700 DEPOSIT ABSOLUTE /end AXIS_DESCR
/end CHARACTERISTIC
/begin CHARACTERISTIC IVCtl_tiPseChrg_CUR "Kennlinie: Bestimmung der Ladepuls-Pausezeit aus der Sollladezeit" CURVE 0x8003CF7E Cur_Xs16Ws16 18.00000 Time_PzoChrgPse 2.000000 20.00000 FORMAT "%8.5" EXTENDED_LIMITS -327.6800 327.6700
 /begin AXIS_DESCR STD_AXIS IVCtl_tiChrg InjTime_us 2 0.00 5000.0000 EXTENDED_LIMITS -13107.20 13106.80 DEPOSIT ABSOLUTE /end AXIS_DESCR
/end CHARACTERISTIC
/begin CHARACTERISTIC IVCtl_tiPseDisCh_CUR "Kennlinie: Bestimmung der Entladepuls-Pausezeit aus der Soll-Entladezeit" CURVE 0x8003CF88 Cur_Xs16Ws16 18.00000 Time_PzoChrgPse 2.000000 20.00000 FORMAT "%8.5" EXTENDED_LIMITS -327.6800 327.6700
 /begin AXIS_DESCR STD_AXIS IVCtl_tiDisCh InjTime_us 2 0.00 5000.0000 EXTENDED_LIMITS -13107.20 13106.80 DEPOSIT ABSOLUTE /end AXIS_DESCR
/end CHARACTERISTIC
/begin CHARACTERISTIC IVCtl_tiStrtMax_C "Umschaltzeitpunkt zur Startspannung des Piezoaktors" VALUE 0x8003D364 Val_Ws16 60000.00 Time_ms 0.00 60000.00 EXTENDED_LIMITS -327680.0 327670.0 /end CHARACTERISTIC
/begin CHARACTERISTIC IVCtl_uCorPreCtl_CUR "Kennlinie der Vorsteuerspannung" CURVE 0x8003D14A Cur_Xs16Ws16 20.00000 Vltg_PA 0.00 20.00000 EXTENDED_LIMITS -327.6800 327.6700
 /begin AXIS_DESCR STD_AXIS IVCtl_p Pres_Rail 20 0.00 2000.000 EXTENDED_LIMITS -3276.800 3276.700 DEPOSIT ABSOLUTE /end AXIS_DESCR
/end CHARACTERISTIC
/begin CHARACTERISTIC IVCtl_uDiffUpOBDDvt_C "OBD-Grenze für IVCtl_VltgGov" VALUE 0x8003D27C Val_Ws16 20.00000 Vltg_PA 0.00 20.00000 EXTENDED_LIMITS -327.6800 327.6700 /end CHARACTERISTIC
/begin CHARACTERISTIC IVCtl_uPIMax_C "Begrenzung: Maximalwert des PI-Reglerausgangs der Aktorspannungsregelung" VALUE 0x8003D27E Val_Ws16 500.0000 Vltg_PA -250.0000 250.0000 EXTENDED_LIMITS -327.6800 327.6700 /end CHARACTERISTIC
/begin CHARACTERISTIC IVCtl_uPIMin_C "Begrenzung: Minimalwert des PI-Reglerausgangs der Aktorspannungsregelung" VALUE 0x8003D280 Val_Ws16 500.0000 Vltg_PA -250.0000 250.0000 EXTENDED_LIMITS -327.6800 327.6700 /end CHARACTERISTIC
/begin CHARACTERISTIC IVCtl_uSetPress0_CUR "Sollspannungskennlinie für ISA-Klasse 0" CURVE 0x8003D284 Cur_Xs16Ws16 500.0000 Vltg_PA -250.0000 250.0000 EXTENDED_LIMITS -327.6800 327.6700
 /begin AXIS_DESCR STD_AXIS IVCtl_p Pres_Rail 3 0.00 2000.000 EXTENDED_LIMITS -3276.800 3276.700 DEPOSIT ABSOLUTE /end AXIS_DESCR
/end CHARACTERISTIC
/begin CHARACTERISTIC IVCtl_uSetPress10_CUR "Sollspannungskennlinie für ISA-Klasse 10" CURVE 0x8003D292 Cur_Xs16Ws16 500.0000 Vltg_PA -250.0000 250.0000 EXTENDED_LIMITS -327.6800 327.6700
 /begin AXIS_DESCR STD_AXIS IVCtl_p Pres_Rail 3 0.00 2000.000 EXTENDED_LIMITS -3276.800 3276.700 DEPOSIT ABSOLUTE /end AXIS_DESCR
/end CHARACTERISTIC
/begin CHARACTERISTIC IVCtl_uSetPress11_CUR "Sollspannungskennlinie für ISA-Klasse 11" CURVE 0x8003D2A0 Cur_Xs16Ws16 500.0000 Vltg_PA -250.0000 250.0000 EXTENDED_LIMITS -327.6800 327.6700
 /begin AXIS_DESCR STD_AXIS IVCtl_p Pres_Rail 3 0.00 2000.000 EXTENDED_LIMITS -3276.800 3276.700 DEPOSIT ABSOLUTE /end AXIS_DESCR
/end CHARACTERISTIC
/begin CHARACTERISTIC IVCtl_uSetPress12_CUR "Sollspannungskennlinie für ISA-Klasse 12" CURVE 0x8003D2AE Cur_Xs16Ws16 500.0000 Vltg_PA -250.0000 250.0000 EXTENDED_LIMITS -327.6800 327.6700
 /begin AXIS_DESCR STD_AXIS IVCtl_p Pres_Rail 3 0.00 2000.000 EXTENDED_LIMITS -3276.800 3276.700 DEPOSIT ABSOLUTE /end AXIS_DESCR
/end CHARACTERISTIC
/begin CHARACTERISTIC IVCtl_uSetPress13_CUR "Sollspannungskennlinie für ISA-Klasse 13" CURVE 0x8003D2BC Cur_Xs16Ws16 500.0000 Vltg_PA -250.0000 250.0000 EXTENDED_LIMITS -327.6800 327.6700
 /begin AXIS_DESCR STD_AXIS IVCtl_p Pres_Rail 3 0.00 2000.000 EXTENDED_LIMITS -3276.800 3276.700 DEPOSIT ABSOLUTE /end AXIS_DESCR
/end CHARACTERISTIC
/begin CHARACTERISTIC IVCtl_uSetPress14_CUR "Sollspannungskennlinie für ISA-Klasse 14" CURVE 0x8003D2CA Cur_Xs16Ws16 500.0000 Vltg_PA -250.0000 250.0000 EXTENDED_LIMITS -327.6800 327.6700
 /begin AXIS_DESCR STD_AXIS IVCtl_p Pres_Rail 3 0.00 2000.000 EXTENDED_LIMITS -3276.800 3276.700 DEPOSIT ABSOLUTE /end AXIS_DESCR
/end CHARACTERISTIC
/begin CHARACTERISTIC IVCtl_uSetPress15_CUR "Sollspannungskennlinie für ISA-Klasse 15" CURVE 0x8003D2D8 Cur_Xs16Ws16 500.0000 Vltg_PA -250.0000 250.0000 EXTENDED_LIMITS -327.6800 327.6700
 /begin AXIS_DESCR STD_AXIS IVCtl_p Pres_Rail 3 -3276.800 2000.000 EXTENDED_LIMITS -3276.800 3276.700 DEPOSIT ABSOLUTE /end AXIS_DESCR
/end CHARACTERISTIC
/begin CHARACTERISTIC IVCtl_uSetPress1_CUR "Sollspannungskennlinie für ISA-Klasse 1" CURVE 0x8003D2E6 Cur_Xs16Ws16 500.0000 Vltg_PA -250.0000 250.0000 EXTENDED_LIMITS -327.6800 327.6700
 /begin AXIS_DESCR STD_AXIS IVCtl_p Pres_Rail 3 0.00 2000.000 EXTENDED_LIMITS -3276.800 3276.700 DEPOSIT ABSOLUTE /end AXIS_DESCR
/end CHARACTERISTIC
/begin CHARACTERISTIC IVCtl_uSetPress2_CUR "Sollspannungskennlinie für ISA-Klasse 2" CURVE 0x8003D2F4 Cur_Xs16Ws16 500.0000 Vltg_PA -250.0000 250.0000 EXTENDED_LIMITS -327.6800 327.6700
 /begin AXIS_DESCR STD_AXIS IVCtl_p Pres_Rail 3 0.00 2000.000 EXTENDED_LIMITS -3276.800 3276.700 DEPOSIT ABSOLUTE /end AXIS_DESCR
/end CHARACTERISTIC
/begin CHARACTERISTIC IVCtl_uSetPress3_CUR "Sollspannungskennlinie für ISA-Klasse 3" CURVE 0x8003D302 Cur_Xs16Ws16 500.0000 Vltg_PA -250.0000 250.0000 EXTENDED_LIMITS -327.6800 327.6700
 /begin AXIS_DESCR STD_AXIS IVCtl_p Pres_Rail 3 0.00 2000.000 EXTENDED_LIMITS -3276.800 3276.700 DEPOSIT ABSOLUTE /end AXIS_DESCR
/end CHARACTERISTIC
/begin CHARACTERISTIC IVCtl_uSetPress4_CUR "Sollspannungskennlinie für ISA-Klasse 4" CURVE 0x8003D310 Cur_Xs16Ws16 500.0000 Vltg_PA -250.0000 250.0000 EXTENDED_LIMITS -327.6800 327.6700
 /begin AXIS_DESCR STD_AXIS IVCtl_p Pres_Rail 3 0.00 2000.000 EXTENDED_LIMITS -3276.800 3276.700 DEPOSIT ABSOLUTE /end AXIS_DESCR
/end CHARACTERISTIC
/begin CHARACTERISTIC IVCtl_uSetPress5_CUR "Sollspannungskennlinie für ISA-Klasse 5" CURVE 0x8003D31E Cur_Xs16Ws16 500.0000 Vltg_PA -250.0000 250.0000 EXTENDED_LIMITS -327.6800 327.6700
 /begin AXIS_DESCR STD_AXIS IVCtl_p Pres_Rail 3 0.00 2000.000 EXTENDED_LIMITS -3276.800 3276.700 DEPOSIT ABSOLUTE /end AXIS_DESCR
/end CHARACTERISTIC
/begin CHARACTERISTIC IVCtl_uSetPress6_CUR "Sollspannungskennlinie für ISA-Klasse 6" CURVE 0x8003D32C Cur_Xs16Ws16 500.0000 Vltg_PA -250.0000 250.0000 EXTENDED_LIMITS -327.6800 327.6700
 /begin AXIS_DESCR STD_AXIS IVCtl_p Pres_Rail 3 0.00 2000.000 EXTENDED_LIMITS -3276.800 3276.700 DEPOSIT ABSOLUTE /end AXIS_DESCR
/end CHARACTERISTIC
/begin CHARACTERISTIC IVCtl_uSetPress7_CUR "Sollspannungskennlinie für ISA-Klasse 7" CURVE 0x8003D33A Cur_Xs16Ws16 500.0000 Vltg_PA -250.0000 250.0000 EXTENDED_LIMITS -327.6800 327.6700
 /begin AXIS_DESCR STD_AXIS IVCtl_p Pres_Rail 3 0.00 2000.000 EXTENDED_LIMITS -3276.800 3276.700 DEPOSIT ABSOLUTE /end AXIS_DESCR
/end CHARACTERISTIC
/begin CHARACTERISTIC IVCtl_uSetPress8_CUR "Sollspannungskennlinie für ISA-Klasse 8" CURVE 0x8003D348 Cur_Xs16Ws16 500.0000 Vltg_PA -250.0000 250.0000 EXTENDED_LIMITS -327.6800 327.6700
 /begin AXIS_DESCR STD_AXIS IVCtl_p Pres_Rail 3 0.00 2000.000 EXTENDED_LIMITS -3276.800 3276.700 DEPOSIT ABSOLUTE /end AXIS_DESCR
/end CHARACTERISTIC
/begin CHARACTERISTIC IVCtl_uSetPress9_CUR "Sollspannungskennlinie für ISA-Klasse 9" CURVE 0x8003D356 Cur_Xs16Ws16 500.0000 Vltg_PA -250.0000 250.0000 EXTENDED_LIMITS -327.6800 327.6700
 /begin AXIS_DESCR STD_AXIS IVCtl_p Pres_Rail 3 0.00 2000.000 EXTENDED_LIMITS -3276.800 3276.700 DEPOSIT ABSOLUTE /end AXIS_DESCR
/end CHARACTERISTIC
/begin CHARACTERISTIC IVCtl_uUpOBDMax_CUR "Kennlinie: raildruckabhängige obere OBD-Grenze der Up-Spannung" CURVE 0x8003D19C Cur_Xs16Ws16 200.0000 Vltg_PA 0.00 200.0000 EXTENDED_LIMITS -327.6800 327.6700
 /begin AXIS_DESCR STD_AXIS IVCtl_p Pres_Rail 20 0.00 2000.000 EXTENDED_LIMITS -3276.800 3276.700 DEPOSIT ABSOLUTE /end AXIS_DESCR
/end CHARACTERISTIC
/begin CHARACTERISTIC IVCtl_uUpOBDMin_CUR "Kennlinie: raildruckabhängige untere OBD-Grenze der Up-Spannung" CURVE 0x8003D1EE Cur_Xs16Ws16 200.0000 Vltg_PA 0.00 200.0000 EXTENDED_LIMITS -327.6800 327.6700
 /begin AXIS_DESCR STD_AXIS IVCtl_p Pres_Rail 20 0.00 2000.000 EXTENDED_LIMITS -3276.800 3276.700 DEPOSIT ABSOLUTE /end AXIS_DESCR
/end CHARACTERISTIC
/begin CHARACTERISTIC IVCtl_uUpRC_CA "Remotewert für IVCtl_uUp" VAL_BLK 0x8003D240 ValA_Ws16 250.0000 Vltg_PA 0.00 250.0000 EXTENDED_LIMITS -327.6800 327.6700 NUMBER 6 /end CHARACTERISTIC
/begin CHARACTERISTIC IVCtl_uUpStrt_C "Startspannung des Piezoaktors" VALUE 0x8003D366 Val_Ws16 210.0000 Vltg_PA 0.00 210.0000 EXTENDED_LIMITS -327.6800 327.6700 /end CHARACTERISTIC
/begin CHARACTERISTIC IVDia_facUPlaus_CA "Faktor zu Umrechnung der Schwelle für Plausibilitätprüfung der Aktorspannung" VAL_BLK 0x8003D3BE ValA_Ws16 2.000000 Fact 0.00 2.000000 EXTENDED_LIMITS -4.000000 3.999878 NUMBER 3 /end CHARACTERISTIC
/begin CHARACTERISTIC IVDia_numMinCylOk_C "Mindestanzahl für den Motorbetrieb erforderlicher intakter Zylinder" VALUE 0x8003D368 Val_Wu8 8.000 OneToOne 0.00 8.000 EXTENDED_LIMITS 0.00 255.0 /end CHARACTERISTIC
/begin CHARACTERISTIC IVDia_numTst_C "Anzahl Testansteuerungen pro Zylinder" VALUE 0x8003D3C8 Val_Wu8 19.00 OneToOne 1.000 20.00 EXTENDED_LIMITS 0.00 255.0 /end CHARACTERISTIC
/begin CHARACTERISTIC IVDia_numUTunDefThres_C "" VALUE 0x8003D3C4 Val_Wu8 255.0 OneToOne 0.00 255.0 /end CHARACTERISTIC
/begin CHARACTERISTIC IVDia_numUTunOkThres_C "" VALUE 0x8003D3C5 Val_Wu8 255.0 OneToOne 0.00 255.0 /end CHARACTERISTIC
/begin CHARACTERISTIC IVDia_pTstMax_C "Raildruckgrenze für IVDia_Tst" VALUE 0x8003D3CA Val_Ws16 2000.0000 Pres_Rail 0.00 2000.0000 EXTENDED_LIMITS -3276.8000 3276.7000 /end CHARACTERISTIC
/begin CHARACTERISTIC IVDia_stDFCChp_C "DFC-Muster des chipspezifischen Fehlers" VALUE 0x8003D369 Val_Wu8 255.0 OneToOne 0.00 255.0 /end CHARACTERISTIC
/begin CHARACTERISTIC IVDia_stDFCCylNoCls_C "DFC-Muster des nicht klassifizierbar Kurzschluss" VALUE 0x8003D36A Val_Wu16 65535.00 OneToOne 0.00 65535.00 /end CHARACTERISTIC
/begin CHARACTERISTIC IVDia_stErrDFC_CA "Tabelle zur Zuordnung eines DFCs zu einem in der Pattern- und Select-Matrix applizierten Fehlermuster" VAL_BLK 0x8003D36C ValA_Wu8 255.000000000 IVDia_stErrDFC 0.00 255.000000000 FORMAT "%13.9" NUMBER 16 /end CHARACTERISTIC
/begin CHARACTERISTIC IVDia_stErrMskPattern_CA "Pattern-Matrix der Injektordiagnose" VAL_BLK 0x8003D37C ValA_Wu16 65535.00 OneToOne 0.00 65535.00 NUMBER 16 /end CHARACTERISTIC
/begin CHARACTERISTIC IVDia_stErrMskSelect_CA "Select-Matrix der Injektordiagnose" VAL_BLK 0x8003D39C ValA_Wu16 65535.00 OneToOne 0.00 65535.00 NUMBER 16 /end CHARACTERISTIC
/begin CHARACTERISTIC IVDia_stTstActvRC_C "Remotewert zur Aktivierung des Kurzschluss- und Lastabfalltests" VALUE 0x8003D3CC Val_Wu8 1.000 OneToOne 0.00 1.000 EXTENDED_LIMITS 0.00 255.0 /end CHARACTERISTIC
/begin CHARACTERISTIC IVDia_stTstRC_C "Remotewert für IVDia_Tst" VALUE 0x8003D3CD Val_Wu8 255.0 OneToOne 0.00 255.0 /end CHARACTERISTIC
/begin CHARACTERISTIC IVDia_swtStTstActvRC_C "Schalter zum Setzen von IVDia_stTstActv über den Remotewert IVDia_stTstActvRC_C" VALUE 0x8003D3CE Val_Wu8 1.000 OneToOne 0.00 1.000 EXTENDED_LIMITS 0.00 255.0 /end CHARACTERISTIC
/begin CHARACTERISTIC IVDia_swtStTstRC_C "Schalter zum Setzen von IVDia_stTst über den Remotewert IVDia_stTstRC_C" VALUE 0x8003D3CF Val_Wu8 1.000 OneToOne 0.00 1.000 EXTENDED_LIMITS 0.00 255.0 /end CHARACTERISTIC
/begin CHARACTERISTIC IVDia_tiChrgTst_C "Ladezeit für IVDia_Tst" VALUE 0x8003D3D0 Val_Ws16 4920.0000 InjTime_us 80.00000 5000.0000 EXTENDED_LIMITS -13107.20 13106.80 /end CHARACTERISTIC
/begin CHARACTERISTIC IVDia_tiDisChTst_C "Entladezeit für IVDia_Tst" VALUE 0x8003D3D2 Val_Ws16 4920.0000 InjTime_us 80.00000 5000.0000 EXTENDED_LIMITS -13107.20 13106.80 /end CHARACTERISTIC
/begin CHARACTERISTIC IVDia_tiETTst_C "Ansteuerdauer für IVDia_Tst" VALUE 0x8003D3D4 Val_Ws16 4920.000 InjTime_us 80.00000 5000.000 EXTENDED_LIMITS -13107.20 13106.80 /end CHARACTERISTIC
/begin CHARACTERISTIC IVDia_uShCirChSwtThres_C "Bankspannungsschwelle zur Erkennung des Ladeschalterkurzschluss" VALUE 0x8003D3BC Val_Ws16 500.0000 Vltg_PA -250.0000 250.0000 EXTENDED_LIMITS -327.6800 327.6700 /end CHARACTERISTIC
/begin CHARACTERISTIC IVDia_uTunThres_C "" VALUE 0x8003D3C6 Val_Ws16 655.3500 Vltg_PA -327.6800 327.6700 /end CHARACTERISTIC
/begin CHARACTERISTIC IVDia_uUpTst_C "Sollspannung für IVDia_Tst und IVH_SOPTst" VALUE 0x8003D3D6 Val_Ws16 100.0000 Vltg_PA 50.00000 150.0000 EXTENDED_LIMITS -327.6800 327.6700 /end CHARACTERISTIC
/begin CHARACTERISTIC IVH_iChrgSOPT_C "Ladestrom für SOPT Testansteuerungen" VALUE 0x8003D3DA Val_Ws16 7500.000 Curr 1500.000 9000.000 FORMAT "%8.3" EXTENDED_LIMITS -32768.00 32767.00 /end CHARACTERISTIC
/begin CHARACTERISTIC IVH_iDisChSOPT_C "Entladestrom für SOPT Testansteuerungen" VALUE 0x8003D3DC Val_Ws16 7500.000 Curr 1500.000 9000.000 FORMAT "%8.3" EXTENDED_LIMITS -32768.00 32767.00 /end CHARACTERISTIC
/begin CHARACTERISTIC IVH_tiBusyMax_C "maximale zulässige Busydauer. Bei Überschreitung erfolgt Busyfehlererkennung" VALUE 0x8003D3E6 Val_Ws16 5000.0000 InjTime_us 0.00 5000.0000 EXTENDED_LIMITS -13107.20 13106.80 /end CHARACTERISTIC
/begin CHARACTERISTIC IVH_tiChrgSOPT_C "Ladezeit für SOPT Testansteuerungen" VALUE 0x8003D3DE Val_Ws16 4950.0000 InjTime_us 50.00000 5000.0000 EXTENDED_LIMITS -13107.20 13106.80 /end CHARACTERISTIC
/begin CHARACTERISTIC IVH_tiETSOPT_C "Ansteuerdauer für IVH_SOPTst" VALUE 0x8003D3E0 Val_Ws16 4900.0000 InjTime_us 100.0000 5000.0000 EXTENDED_LIMITS -13107.20 13106.80 /end CHARACTERISTIC
/begin CHARACTERISTIC IVH_tiPseChrgSOPT_C "Ladepausenzeit für SOPT Testansteuerungen" VALUE 0x8003D3E2 Val_Ws16 26.30000 Time_PzoChrgPse 3.700000 30.00000 FORMAT "%8.5" EXTENDED_LIMITS -327.6800 327.6700 /end CHARACTERISTIC
/begin CHARACTERISTIC IVH_tiPseDisChSOPT_C "Entladepausenzeit für SOPT Testansteuerungen" VALUE 0x8003D3E4 Val_Ws16 26.30000 Time_PzoChrgPse 3.700000 30.00000 FORMAT "%8.5" EXTENDED_LIMITS -327.6800 327.6700 /end CHARACTERISTIC
/begin CHARACTERISTIC IVH_tiTunOfsTrg_C "" VALUE 0x8003D3D8 Val_Ws16 5000.000 InjTime_us 0.00 5000.000 EXTENDED_LIMITS -13107.20 13106.80 /end CHARACTERISTIC
/begin CHARACTERISTIC IVPlaus_nEngDiffComprTst_C "zulässige Drehzahlschwankung für den Start der Messung des Kompressionstests" VALUE 0x8003D41C Val_Ws16 32767.50 EngN -16384.00 16383.50 /end CHARACTERISTIC
/begin CHARACTERISTIC IVPlaus_nMinComprTst_C "notwendige minimale Drehzahl für den Start des Kompressionsdrucktests" VALUE 0x8003D41E Val_Ws16 10000.00 EngN 0.00 10000.00 EXTENDED_LIMITS -16384.00 16383.50 /end CHARACTERISTIC
/begin CHARACTERISTIC IVPlaus_numSegOfs1_C "Segmentoffset der zylinderselektiven Drehzahlberechnung für Modus A" VALUE 0x8003D430 Val_Wu8 11.00 OneToOne 0.00 11.00 EXTENDED_LIMITS 0.00 255.0 /end CHARACTERISTIC
/begin CHARACTERISTIC IVPlaus_numSegOfs2_C "Segmentoffset der zylinderselektiven Drehzahlberechnung für Modi B und C" VALUE 0x8003D431 Val_Wu8 11.00 OneToOne 0.00 11.00 EXTENDED_LIMITS 0.00 255.0 /end CHARACTERISTIC
/begin CHARACTERISTIC IVPlaus_phiPreTDCComprTst1_C "frühester Winkel vor TDC" VALUE 0x8003D420 Val_Ws16 299.9927 AngleCrS -197.9956 101.9971 EXTENDED_LIMITS -720.0000 719.9780 /end CHARACTERISTIC
/begin CHARACTERISTIC IVPlaus_phiPreTDCComprTst2_C "spätester Winkel vor TDC" VALUE 0x8003D422 Val_Ws16 299.9927 AngleCrS -197.9956 101.9971 EXTENDED_LIMITS -720.0000 719.9780 /end CHARACTERISTIC
/begin CHARACTERISTIC IVPlaus_phiPstTDCComprTst3_C "frühester Winkel nach TDC" VALUE 0x8003D424 Val_Ws16 330.0073 AngleCrS -138.0103 191.9971 EXTENDED_LIMITS -720.0000 719.9780 /end CHARACTERISTIC
/begin CHARACTERISTIC IVPlaus_phiPstTDCComprTst4_C "spätester Winkel nach TDC" VALUE 0x8003D426 Val_Ws16 330.0073 AngleCrS -138.0103 191.9971 EXTENDED_LIMITS -720.0000 719.9780 /end CHARACTERISTIC
/begin CHARACTERISTIC IVPlaus_stCylChk_C "Schalter für zylinderselektive Drehzahl" VALUE 0x8003D432 Val_Wu8 1.000 OneToOne 0.00 1.000 EXTENDED_LIMITS 0.00 255.0 /end CHARACTERISTIC
/begin CHARACTERISTIC IVPlaus_tiMaxComprTst_C "Maximale Zeit für den Kompressionstest" VALUE 0x8003D428 Val_Ws32 42949672950.0 Time_ms -21474836480.0 21474836470.0 /end CHARACTERISTIC
/begin CHARACTERISTIC IVPlaus_uMinBattComprTst_C "minimale Batteriespannung um den Kompressionstest zu starten" VALUE 0x8003D42C Val_Ws16 1310700. Volt_Batt -655360.0 655340.0 /end CHARACTERISTIC
/begin CHARACTERISTIC KF_LORESP "Kennfeld Loadresponse ueber Motordrehzahl und rel. Luftmasse" MAP 0x80064A08 MapTKF_SW_SW_UB 25.5 Def_td_ub_q0p1 0.00 25.5 FORMAT "%4.1"
 /begin AXIS_DESCR STD_AXIS Nkw Def_n_sw_q1p0 6 -32768. 32767. FORMAT "%5.0" DEPOSIT ABSOLUTE /end AXIS_DESCR
 /begin AXIS_DESCR STD_AXIS Rf Def_rf_sw_q0p01 6 -327.68000 327.67000 FORMAT "%9.5" DEPOSIT ABSOLUTE /end AXIS_DESCR
/end CHARACTERISTIC
/begin CHARACTERISTIC KF_LORESPKH "Loadresponse bei Kat-Heizen" MAP 0x80064A46 MapTKF_SW_SW_UB 25.5 Def_td_ub_q0p1 0.00 25.5 FORMAT "%4.1"
 /begin AXIS_DESCR STD_AXIS Nkw Def_n_sw_q1p0 6 -32768. 32767. FORMAT "%5.0" DEPOSIT ABSOLUTE /end AXIS_DESCR
 /begin AXIS_DESCR STD_AXIS Rf Def_rf_sw_q0p01 6 -327.68000 327.67000 FORMAT "%9.5" DEPOSIT ABSOLUTE /end AXIS_DESCR
/end CHARACTERISTIC
/begin CHARACTERISTIC KF_LRWAFS "Loadresponse bei Lenken mit EPS" MAP 0x80064A84 MapTKF_SW_SW_UB 25.5 Def_td_ub_q0p1 0.00 25.5 FORMAT "%4.1"
 /begin AXIS_DESCR STD_AXIS W_afs Def_wdk_sw_q0p1 6 -3276.80 3276.70 FORMAT "%7.2" DEPOSIT ABSOLUTE /end AXIS_DESCR
 /begin AXIS_DESCR STD_AXIS W_dafs Def_wdk_sw_q0p1 6 -3276.80 3276.70 FORMAT "%7.2" DEPOSIT ABSOLUTE /end AXIS_DESCR
/end CHARACTERISTIC
/begin CHARACTERISTIC KF_MDMAX_ARS "max. Aufnahmemoment ARS" MAP 0x80064B68 MapTKF_SW_UW_SW 6553.50 Def_m_sw_q0p1 -3276.80 3276.70 FORMAT "%7.2"
 /begin AXIS_DESCR STD_AXIS V Def_v_uw_q1p0 4 0.00 360.0 FORMAT "%5.1" EXTENDED_LIMITS 0.00 65535. DEPOSIT ABSOLUTE /end AXIS_DESCR
 /begin AXIS_DESCR STD_AXIS Nkw Def_n_sw_q1p0 4 -32768. 32767. FORMAT "%5.0" DEPOSIT ABSOLUTE /end AXIS_DESCR
/end CHARACTERISTIC
/begin CHARACTERISTIC KF_MDMAX_GEN "max. Aufnahmemoment Generator" MAP 0x80064B9A MapTKF_SW_SW_SW 6553.50 Def_m_sw_q0p1 -3276.80 3276.70 FORMAT "%7.2"
 /begin AXIS_DESCR STD_AXIS Tgen Def_t_sw_q0p1 4 -3276.8 3276.7 FORMAT "%6.1" DEPOSIT ABSOLUTE /end AXIS_DESCR
 /begin AXIS_DESCR STD_AXIS Nkw Def_n_sw_q1p0 4 -32768. 32767. FORMAT "%5.0" DEPOSIT ABSOLUTE /end AXIS_DESCR
/end CHARACTERISTIC
/begin CHARACTERISTIC KF_MDMAX_KK "max. Aufnahmemoment Klimakompressor" MAP 0x80064BCC MapTKF_SW_SW_SW 6553.50 Def_m_sw_q0p1 -3276.80 3276.70 FORMAT "%7.2"
 /begin AXIS_DESCR STD_AXIS Tumg Def_t_sw_q0p1 4 -3276.8 3276.7 FORMAT "%6.1" DEPOSIT ABSOLUTE /end AXIS_DESCR
 /begin AXIS_DESCR STD_AXIS Nkw Def_n_sw_q1p0 4 -32768. 32767. FORMAT "%5.0" DEPOSIT ABSOLUTE /end AXIS_DESCR
/end CHARACTERISTIC
/begin CHARACTERISTIC KF_MDMAX_SL "max. Aufnahmemoment Servolenkung" MAP 0x80064BFE MapTKF_SW_SW_SW 6553.50 Def_m_sw_q0p1 -3276.80 3276.70 FORMAT "%7.2"
 /begin AXIS_DESCR STD_AXIS W_afs Def_wdk_sw_q0p1 4 -3276.80 3276.70 FORMAT "%7.2" DEPOSIT ABSOLUTE /end AXIS_DESCR
 /begin AXIS_DESCR STD_AXIS W_dafs Def_wdk_sw_q0p1 4 -3276.80 3276.70 FORMAT "%7.2" DEPOSIT ABSOLUTE /end AXIS_DESCR
/end CHARACTERISTIC
/begin CHARACTERISTIC KF_MDRESWAFS "Momentenreserve bei Lenken mit EPS und instabilem Bordnetz" MAP 0x80064AC2 MapTKF_SW_SW_SW 6553.50 Def_m_sw_q0p1 -3276.80 3276.70 FORMAT "%7.2"
 /begin AXIS_DESCR STD_AXIS W_afs Def_wdk_sw_q0p1 6 -3276.80 3276.70 FORMAT "%7.2" DEPOSIT ABSOLUTE /end AXIS_DESCR
 /begin AXIS_DESCR STD_AXIS W_dafs Def_wdk_sw_q0p1 6 -3276.80 3276.70 FORMAT "%7.2" DEPOSIT ABSOLUTE /end AXIS_DESCR
/end CHARACTERISTIC
/begin CHARACTERISTIC KF_VERLWAN "max. Aufnahmemoment Servolenkung" MAP 0x80064C30 MapTKF_SW_SW_SW 6553.50 Def_m_sw_q0p1 -3276.80 3276.70 FORMAT "%7.2"
 /begin AXIS_DESCR STD_AXIS Nturb Def_n_sw_q1p0 6 -32768. 32767. FORMAT "%5.0" DEPOSIT ABSOLUTE /end AXIS_DESCR
 /begin AXIS_DESCR STD_AXIS Nkw Def_n_sw_q1p0 6 -32768. 32767. FORMAT "%5.0" DEPOSIT ABSOLUTE /end AXIS_DESCR
/end CHARACTERISTIC
/begin CHARACTERISTIC KF_ZLRESOF "Kennfeld Generatorausschaltzeit bei Stillstand" MAP 0x800649A6 MapTKF_UW_SW_UB 25.5 Def_td_ub_q0p1 0.00 25.5 FORMAT "%4.1"
 /begin AXIS_DESCR STD_AXIS Tmot_start Def_t_sw_q0p01 4 -327.680 327.670 FORMAT "%7.3" DEPOSIT ABSOLUTE /end AXIS_DESCR
 /begin AXIS_DESCR STD_AXIS Km_st Def_km_uw_q10 4 0.00 655350. FORMAT "%5.0" DEPOSIT ABSOLUTE /end AXIS_DESCR
/end CHARACTERISTIC
/begin CHARACTERISTIC KF_ZLRRESOFV "Kennfeld Generatorausschaltzeit bei Fahrt" MAP 0x800649C8 MapTKF_UW_SW_UB 25.5 Def_td_ub_q0p1 0.00 25.5 FORMAT "%4.1"
 /begin AXIS_DESCR STD_AXIS Tmot_start Def_t_sw_q0p01 4 -327.680 327.670 FORMAT "%7.3" DEPOSIT ABSOLUTE /end AXIS_DESCR
 /begin AXIS_DESCR STD_AXIS Km_st Def_km_uw_q10 4 0.00 655350. FORMAT "%5.0" DEPOSIT ABSOLUTE /end AXIS_DESCR
/end CHARACTERISTIC
/begin CHARACTERISTIC KL_DMD_MAX1 "Maximaler Momentengradient Generator" CURVE 0x80064930 CurTKL_SW_VV_SW 6553.50 Def_m_sw_q0p1 -3276.80 3276.70 FORMAT "%7.2"
 /begin AXIS_DESCR STD_AXIS Md_res_real Def_m_sw_q0p1 6 -3276.80 3276.70 FORMAT "%7.2" DEPOSIT ABSOLUTE /end AXIS_DESCR
/end CHARACTERISTIC
/begin CHARACTERISTIC KL_DMD_MAX2 "Offset maximaler Momentengradient Generator" CURVE 0x8006494A CurTKL_SW_VV_SW 6553.50 Def_m_sw_q0p1 -3276.80 3276.70 FORMAT "%7.2"
 /begin AXIS_DESCR STD_AXIS Nkw Def_n_sw_q1p0 6 -32768. 32767. FORMAT "%5.0" DEPOSIT ABSOLUTE /end AXIS_DESCR
/end CHARACTERISTIC
/begin CHARACTERISTIC KL_F_GENTYP "Faktor auf Maximalmoment Generator" CURVE 0x80064C92 CurTKL_UB_VV_UB 1.9922 Def_f_ub_b2 0.00 1.9922
 /begin AXIS_DESCR STD_AXIS Gen_awnumm Def_st_ub_q1 8 0.00 255. FORMAT "%3.0" DEPOSIT ABSOLUTE /end AXIS_DESCR
/end CHARACTERISTIC
/begin CHARACTERISTIC KL_F_MDSLT "Temperaturkorrektur auf Maximalmoment Lenkung" CURVE 0x80064CA4 CurTKL_SW_VV_UB 1.9922 Def_f_ub_b2 0.00 1.9922
 /begin AXIS_DESCR STD_AXIS Tmot Def_t_sw_q0p01 4 -327.680 327.670 FORMAT "%7.3" DEPOSIT ABSOLUTE /end AXIS_DESCR
/end CHARACTERISTIC
/begin CHARACTERISTIC KL_LORESPM "Motorabhängiger Loadresponse-Faktor" CURVE 0x80064B24 CurTKL_SW_VV_UB 3.984 Def_f_ub_b4 0.00 3.984
 /begin AXIS_DESCR STD_AXIS Tmot Def_t_sw_q0p01 6 -327.680 327.670 FORMAT "%7.3" DEPOSIT ABSOLUTE /end AXIS_DESCR
/end CHARACTERISTIC
/begin CHARACTERISTIC KL_LRIGR "Loadresponse bei IGR Betrieb" CURVE 0x80064B38 CurTKL_SW_VV_UB 25.5 Def_td_ub_q0p1 0.00 25.5 FORMAT "%4.1"
 /begin AXIS_DESCR STD_AXIS Nkw Def_n_sw_q1p0 8 -32768. 32767. FORMAT "%5.0" DEPOSIT ABSOLUTE /end AXIS_DESCR
/end CHARACTERISTIC
/begin CHARACTERISTIC KL_MDGRAD_AFS "Maximaler Momentengradient AFS" CURVE 0x80064CB2 CurTKL_SW_VV_SW 6553.50 Def_m_sw_q0p1 -3276.80 3276.70 FORMAT "%7.2"
 /begin AXIS_DESCR STD_AXIS W_afs Def_wdk_sw_q0p1 4 -3276.80 3276.70 FORMAT "%7.2" DEPOSIT ABSOLUTE /end AXIS_DESCR
/end CHARACTERISTIC
/begin CHARACTERISTIC KL_MDGRAD_GEN "Maximaler Momentengradient Generator" CURVE 0x80064CC4 CurTKL_UB_VV_SW 6553.50 Def_m_sw_q0p1 -3276.80 3276.70 FORMAT "%7.2"
 /begin AXIS_DESCR STD_AXIS Tlrgen Def_td_ub_q0p1 8 0.00 25.5 FORMAT "%4.1" DEPOSIT ABSOLUTE /end AXIS_DESCR
/end CHARACTERISTIC
/begin CHARACTERISTIC KL_MDGRAD_SL "Maximaler Momentengradient Servolenkung" CURVE 0x80064CDE CurTKL_SW_VV_SW 6553.50 Def_m_sw_q0p1 -3276.80 3276.70 FORMAT "%7.2"
 /begin AXIS_DESCR STD_AXIS W_afs Def_wdk_sw_q0p1 4 -3276.80 3276.70 FORMAT "%7.2" DEPOSIT ABSOLUTE /end AXIS_DESCR
/end CHARACTERISTIC
/begin CHARACTERISTIC KL_MDKMAXRED "Reduktion Maximalmoment Motor über Zündwinkeladaption" CURVE 0x80064CF0 CurTKL_SW_VV_SW 6553.50 Def_m_sw_q0p1 -3276.80 3276.70 FORMAT "%7.2"
 /begin AXIS_DESCR STD_AXIS Dzw_krann_vl Def_zw_sw_q0p1 4 -50.000 60.000 EXTENDED_LIMITS -3276.8 3276.7 DEPOSIT ABSOLUTE /end AXIS_DESCR
/end CHARACTERISTIC
/begin CHARACTERISTIC KL_MDMAX_GETR "Maximalmoment Getriebe" CURVE 0x80064D02 CurTKL_SW_VV_SW 6553.50 Def_m_sw_q0p1 -3276.80 3276.70 FORMAT "%7.2"
 /begin AXIS_DESCR STD_AXIS Tget Def_t_sw_q0p01 4 -327.680 327.670 FORMAT "%7.3" DEPOSIT ABSOLUTE /end AXIS_DESCR
/end CHARACTERISTIC
/begin CHARACTERISTIC KL_MDZIEL "Zielmomentenreserve für Generator bei BN i.O." CURVE 0x80064964 CurTKL_SW_VV_SW 655.350 Def_m_sw_q0p01 -327.680 327.670 FORMAT "%7.3"
 /begin AXIS_DESCR STD_AXIS Nkw Def_n_sw_q1p0 6 -32768. 32767. FORMAT "%5.0" DEPOSIT ABSOLUTE /end AXIS_DESCR
/end CHARACTERISTIC
/begin CHARACTERISTIC KL_MDZIELIERR "Momentenoffset auf Zielreserve Generatorlimitierung" CURVE 0x8006497E CurTKL_UB_VV_SW 655.350 Def_m_sw_q0p01 -327.680 327.670 FORMAT "%7.3"
 /begin AXIS_DESCR STD_AXIS Ierr Def_i_ub_q0p125 6 0.00 31.875 DEPOSIT ABSOLUTE /end AXIS_DESCR
/end CHARACTERISTIC
/begin CHARACTERISTIC KL_U_ENTL "Umschaltung Entlastung über Strom oder Spannung" CURVE 0x80064DC2 CurTKL_UB_VV_UB 255. Def_dez_ub_q1 0.00 255. FORMAT "%3.0"
 /begin AXIS_DESCR STD_AXIS Pr_md_entlsoll Def_dez_ub_q1 8 0.00 255. FORMAT "%3.0" DEPOSIT ABSOLUTE /end AXIS_DESCR
/end CHARACTERISTIC
/begin CHARACTERISTIC KL_VERLPU "Getriebepumpenmoment" CURVE 0x80064D14 CurTKL_SW_VV_SW 6553.50 Def_m_sw_q0p1 -3276.80 3276.70 FORMAT "%7.2"
 /begin AXIS_DESCR STD_AXIS Nkw Def_n_sw_q1p0 6 -32768. 32767. FORMAT "%5.0" DEPOSIT ABSOLUTE /end AXIS_DESCR
/end CHARACTERISTIC
/begin CHARACTERISTIC KL_VERLPU_TKOR "Temperaturkorrektur auf Getriebepumpenmoment" CURVE 0x80064D2E CurTKL_SW_VV_UB 1.9922 Def_f_ub_b2 0.00 1.9922
 /begin AXIS_DESCR STD_AXIS Tget Def_t_sw_q0p01 4 -327.680 327.670 FORMAT "%7.3" DEPOSIT ABSOLUTE /end AXIS_DESCR
/end CHARACTERISTIC
/begin CHARACTERISTIC KL_VERLWAN_TKOR "Temperaturkorrektur auf Wandlerverlustmoment" CURVE 0x80064D3C CurTKL_SW_VV_UB 1.9922 Def_f_ub_b2 0.00 1.9922
 /begin AXIS_DESCR STD_AXIS Tget Def_t_sw_q0p01 4 -327.680 327.670 FORMAT "%7.3" DEPOSIT ABSOLUTE /end AXIS_DESCR
/end CHARACTERISTIC
/begin CHARACTERISTIC K_ANZ_RENN "Begrenzung Anzahl Entlastung Generator bei Rennstart" VALUE 0x80064D60 Val_Wu8 255. Def_dez_ub_q1 0.00 255. FORMAT "%3.0" /end CHARACTERISTIC
/begin CHARACTERISTIC K_APPLROFF "Generator-Loadresponse-Schwelle (in)aktiv" VALUE 0x80064B52 Val_Wu8 1.0 Identity 0.00 1.0 EXTENDED_LIMITS 0.00 255. /end CHARACTERISTIC
/begin CHARACTERISTIC K_DMDGEN_FAK "Korrekturfaktor zulässige Generatordynamik" VALUE 0x80064992 Val_Wu16 1.999908447266 Def_f_uw_b2 0.00 1.999908447266 FORMAT "%14.12" EXTENDED_LIMITS 0.00 1.999969482422 /end CHARACTERISTIC
/begin CHARACTERISTIC K_DMDGEN_OFF "Korrekturoffset zulässige Generatordynamik" VALUE 0x80064994 Val_Ws16 6553.50 Def_m_sw_q0p1 -3276.80 3276.70 FORMAT "%7.2" /end CHARACTERISTIC
/begin CHARACTERISTIC K_ENAPPLGOFF "Enable Generatorauschaltsteuerung" VALUE 0x800649EA Val_Wu8 255. Def_st_ub_q1 0.00 255. FORMAT "%3.0" /end CHARACTERISTIC
/begin CHARACTERISTIC K_ENAPPLRESP "Enable Handsteuerung Loadresponse" VALUE 0x80064B53 Val_Wu8 255. Def_st_ub_q1 0.00 255. FORMAT "%3.0" /end CHARACTERISTIC
/begin CHARACTERISTIC K_FHOGNMN "minimaler Wichtungsfaktor fuer minimale HFM-Luftmassen Schwelle in Abhaengigkeit von d.Hoehe fuer Generatorreduzierung" VALUE 0x800649EB Val_Wu8 3.984 Def_f_ub_b4 0.00 3.984 /end CHARACTERISTIC
/begin CHARACTERISTIC K_F_LLRI "Faktor auf I-Anteil LL Regler zur Bestimmung der NA Momentenbilanz" VALUE 0x80064D4A Val_Ws8 1.9922 Def_f_sb_b1 -1.0000 0.99219 /end CHARACTERISTIC
/begin CHARACTERISTIC K_F_MDMXREAL "Faktor auf maximales Motormoment zur Bestimmung der NA Momentenbilanz" VALUE 0x80064D4B Val_Wu8 1.9922 Def_f_ub_b2 0.00 1.9922 /end CHARACTERISTIC
/begin CHARACTERISTIC K_F_MDSLT "Faktor auf Maximalmoment bei normaler Lenkung" VALUE 0x80064D4C Val_Wu8 1.9922 Def_f_ub_b2 0.00 1.9922 /end CHARACTERISTIC
/begin CHARACTERISTIC K_F_NABC "Faktor auf im best case freigebbares Moment der NA" VALUE 0x80064D4D Val_Wu8 0.99609 Def_f_ub_b1 0.00 0.99609 FORMAT "%7.5" /end CHARACTERISTIC
/begin CHARACTERISTIC K_GENGCALC "Zeitraster, in dem Md_gennm für GEN_GRENZ übernommen wird (Ringpuffer)" VALUE 0x80064996 Val_Wu16 655.350 Def_td_uw_q0p01 0.00 655.350 FORMAT "%7.3" /end CHARACTERISTIC
/begin CHARACTERISTIC K_IERRGRENZ_APPL "Applikation Ierrgrenz" VALUE 0x800649A2 Val_Wu8 31.875 Def_i_ub_q0p125 0.00 31.875 /end CHARACTERISTIC
/begin CHARACTERISTIC K_IERRHYSMAX "Obere Schwelle für Hystereseerkennung (Aufweitung der Zielreserve)" VALUE 0x80064998 Val_Ws16 8191.875 Def_i_sw_q0p125 -4096.000 4095.875 FORMAT "%8.3" /end CHARACTERISTIC
/begin CHARACTERISTIC K_IERRHYSMN "Untere Schwelle für Hystereseerkennung (Aufweitung der Zielreserve)" VALUE 0x8006499A Val_Ws16 8191.875 Def_i_sw_q0p125 -4096.000 4095.875 FORMAT "%8.3" /end CHARACTERISTIC
/begin CHARACTERISTIC K_LRBNS "Loadrespo´nse bei Warnung Bordnetzstabilität gefährdet" VALUE 0x80064B54 Val_Wu8 25.5 Def_td_ub_q0p1 0.00 25.5 FORMAT "%4.1" /end CHARACTERISTIC
/begin CHARACTERISTIC K_LRESPAPP "Load-Response Applikation" VALUE 0x80064B55 Val_Wu8 25.5 Def_td_ub_q0p1 0.00 25.5 FORMAT "%4.1" /end CHARACTERISTIC
/begin CHARACTERISTIC K_LRHZTST "Hier könnte Ihr Langbezeichner stehen" VALUE 0x80064B56 Val_Wu8 25.5 Def_td_ub_q0p1 0.00 25.5 FORMAT "%4.1" /end CHARACTERISTIC
/begin CHARACTERISTIC K_LRSPGW "Loadresponse bei Spannungswächtereingriff" VALUE 0x80064B57 Val_Wu8 25.5 Def_td_ub_q0p1 0.00 25.5 FORMAT "%4.1" /end CHARACTERISTIC
/begin CHARACTERISTIC K_LRTEST "Loadresponsevorgabe zu Testzwecken" VALUE 0x80064B58 Val_Wu8 25.5 Def_td_ub_q0p1 0.00 25.5 FORMAT "%4.1" /end CHARACTERISTIC
/begin CHARACTERISTIC K_MDACMIN "Minimales Restmoment Klimakompressor bei Entlastung" VALUE 0x80064DD4 Val_Ws16 6553.50 Def_m_sw_q0p1 -3276.80 3276.70 FORMAT "%7.2" /end CHARACTERISTIC
/begin CHARACTERISTIC K_MDENTLFUNK "Entlastungsmoment Nebenaggregate funktionale Gründe" VALUE 0x80064D88 Val_Ws16 6553.50 Def_m_sw_q0p1 -3276.80 3276.70 FORMAT "%7.2" /end CHARACTERISTIC
/begin CHARACTERISTIC K_MDENTLKOMF "Entlastungsmoment Nebenaggregate Komfortgründe" VALUE 0x80064D8A Val_Ws16 6553.50 Def_m_sw_q0p1 -3276.80 3276.70 FORMAT "%7.2" /end CHARACTERISTIC
/begin CHARACTERISTIC K_MDENTLSICH "Entlastungsmoment Nebenaggregate Sicherheitsgründe" VALUE 0x80064D8C Val_Ws16 6553.50 Def_m_sw_q0p1 -3276.80 3276.70 FORMAT "%7.2" /end CHARACTERISTIC
/begin CHARACTERISTIC K_MDENTLSOLL2 "Sollentlastungsmoment Generator im Start" VALUE 0x800649EC Val_Ws16 6553.50 Def_m_sw_q0p1 -3276.80 3276.70 FORMAT "%7.2" /end CHARACTERISTIC
/begin CHARACTERISTIC K_MDENTLTEST "Generatorentlastungsmoment zu Testzwecken" VALUE 0x80064D8E Val_Ws16 6553.50 Def_m_sw_q0p1 -3276.80 3276.70 FORMAT "%7.2" /end CHARACTERISTIC
/begin CHARACTERISTIC K_MDENTL_GENOFFVL "Momentenentlastung bei Volllast" VALUE 0x80064D62 Val_Ws16 6553.50 Def_m_sw_q0p1 -3276.80 3276.70 FORMAT "%7.2" /end CHARACTERISTIC
/begin CHARACTERISTIC K_MDENTL_RENN "Momentenentlastung bei Rennstart" VALUE 0x80064D64 Val_Ws16 6553.50 Def_m_sw_q0p1 -3276.80 3276.70 FORMAT "%7.2" /end CHARACTERISTIC
/begin CHARACTERISTIC K_MDGENGGFIL "Filterkonstante Filterung lokales Generatormoment" VALUE 0x8006499C Val_Wu16 0.9999694824219 Def_f_uw_b1 0.000015258789063 0.9999847412109 FORMAT "%15.13" EXTENDED_LIMITS 0.00 0.9999847412109 /end CHARACTERISTIC
/begin CHARACTERISTIC K_MDGRAD_ARS "Max. Momentengradient des ARS bezogen auf 1s" VALUE 0x80064D4E Val_Ws16 6553.50 Def_m_sw_q0p1 -3276.80 3276.70 FORMAT "%7.2" /end CHARACTERISTIC
/begin CHARACTERISTIC K_MDGRAD_GETR "Max. Momentengradient des Getriebes bezogen auf 1s" VALUE 0x80064D50 Val_Ws16 6553.50 Def_m_sw_q0p1 -3276.80 3276.70 FORMAT "%7.2" /end CHARACTERISTIC
/begin CHARACTERISTIC K_MDGRAD_GETRFS "Max. Momentengradient des Getriebes bei Fahrstufe bezogen auf 1s" VALUE 0x80064D52 Val_Ws16 6553.50 Def_m_sw_q0p1 -3276.80 3276.70 FORMAT "%7.2" /end CHARACTERISTIC
/begin CHARACTERISTIC K_MDGRAD_KK "Max. Momentengradient des Klimakompressors bezogen auf 1s" VALUE 0x80064D54 Val_Ws16 6553.50 Def_m_sw_q0p1 -3276.80 3276.70 FORMAT "%7.2" /end CHARACTERISTIC
/begin CHARACTERISTIC K_MDKWFUNK_HYS "Hysterese Momentenschwelle für Generatorentlastung funktionale Gründe" VALUE 0x80064D90 Val_Ws16 6553.50 Def_m_sw_q0p1 -3276.80 3276.70 FORMAT "%7.2" /end CHARACTERISTIC
/begin CHARACTERISTIC K_MDKWKOMF_HYS "Hysterese Momentenschwelle für Generatorentlastung Komfortgründe" VALUE 0x80064D92 Val_Ws16 6553.50 Def_m_sw_q0p1 -3276.80 3276.70 FORMAT "%7.2" /end CHARACTERISTIC
/begin CHARACTERISTIC K_MDKWRESTMXVOFF "Momentenschwelle für Verbraucherausschaltung" VALUE 0x80064D94 Val_Ws16 6553.50 Def_m_sw_q0p1 -3276.80 3276.70 FORMAT "%7.2" /end CHARACTERISTIC
/begin CHARACTERISTIC K_MDKWRESTMXVOFF_HYS "Hysterese Momentenschwelle für Verbraucherausschaltung" VALUE 0x80064D96 Val_Ws16 6553.50 Def_m_sw_q0p1 -3276.80 3276.70 FORMAT "%7.2" /end CHARACTERISTIC
/begin CHARACTERISTIC K_MDKWSICH_HYS "Hysterese Momentenschwelle für Generatorentlastung SIcherheitsgründe" VALUE 0x80064D98 Val_Ws16 6553.50 Def_m_sw_q0p1 -3276.80 3276.70 FORMAT "%7.2" /end CHARACTERISTIC
/begin CHARACTERISTIC K_MDKW_FUNK "Momentenschwelle für Generatorentlastung funktionale Gründe" VALUE 0x80064D9A Val_Ws16 6553.50 Def_m_sw_q0p1 -3276.80 3276.70 FORMAT "%7.2" /end CHARACTERISTIC
/begin CHARACTERISTIC K_MDKW_KOMF "Momentenschwelle für Generatorentlastung Komfortgründe" VALUE 0x80064D9C Val_Ws16 6553.50 Def_m_sw_q0p1 -3276.80 3276.70 FORMAT "%7.2" /end CHARACTERISTIC
/begin CHARACTERISTIC K_MDKW_RESTAFU "Schwellwert Notanfahrunterstützung" VALUE 0x80064D9E Val_Ws16 6553.50 Def_m_sw_q0p1 -3276.80 3276.70 FORMAT "%7.2" /end CHARACTERISTIC
/begin CHARACTERISTIC K_MDKW_SICH "Momentenschwelle für Generatorentlastung Sicherheitsgründe" VALUE 0x80064DA0 Val_Ws16 6553.50 Def_m_sw_q0p1 -3276.80 3276.70 FORMAT "%7.2" /end CHARACTERISTIC
/begin CHARACTERISTIC K_MDMAXMAN "Manuelle Vorgabe des maximalen Motormoments" VALUE 0x80064D56 Val_Ws16 6553.50 Def_m_sw_q0p1 -3276.80 3276.70 FORMAT "%7.2" /end CHARACTERISTIC
/begin CHARACTERISTIC K_MDRESBN "Momentenreserve bei instabilem Bordnetz" VALUE 0x80064B5A Val_Ws16 6553.50 Def_m_sw_q0p1 -3276.80 3276.70 FORMAT "%7.2" /end CHARACTERISTIC
/begin CHARACTERISTIC K_NGENOFMN "Nkw-Schwelle zur Aktivierung Generatorvolllastabschaltung" VALUE 0x80064D66 Val_Ws16 65535. Def_n_sw_q1p0 -32768. 32767. FORMAT "%5.0" /end CHARACTERISTIC
/begin CHARACTERISTIC K_NGENOFMX "Nkw-Schwelle zur Deaktivierung Generatorvolllastabschaltung" VALUE 0x80064D68 Val_Ws16 65535. Def_n_sw_q1p0 -32768. 32767. FORMAT "%5.0" /end CHARACTERISTIC
/begin CHARACTERISTIC K_NKW_SCH "Drehzahlschwelle für Generator-Grenzmoment-Berechnung" VALUE 0x8006499E Val_Ws16 65535. Def_n_sw_q1p0 -32768. 32767. FORMAT "%5.0" /end CHARACTERISTIC
/begin CHARACTERISTIC K_NMXGENOF "Motordrehzahlschwelle für Generatorzuschaltung" VALUE 0x800649EE Val_Ws16 65535. Def_n_sw_q1p0 -32768. 32767. FORMAT "%5.0" /end CHARACTERISTIC
/begin CHARACTERISTIC K_PR_GENOFFVL "Prio zur Begrenzung Generatormoment bei Volllast" VALUE 0x80064D6A Val_Wu8 255. Def_dez_ub_q1 0.00 255. FORMAT "%3.0" /end CHARACTERISTIC
/begin CHARACTERISTIC K_PR_GENSTOFF "Priorität der Generatorentlastung im Start" VALUE 0x800649F0 Val_Wu8 255. Def_dez_ub_q1 0.00 255. FORMAT "%3.0" /end CHARACTERISTIC
/begin CHARACTERISTIC K_PR_IERRAPPL "Prio zur Begrenzung Generatormoment" VALUE 0x800649A3 Val_Wu8 255. Def_dez_ub_q1 0.00 255. FORMAT "%3.0" /end CHARACTERISTIC
/begin CHARACTERISTIC K_PR_IERRTESTER "Prio zur Begrenzung Generatormoment" VALUE 0x800649A4 Val_Wu8 255. Def_dez_ub_q1 0.00 255. FORMAT "%3.0" /end CHARACTERISTIC
/begin CHARACTERISTIC K_PR_MDDYN "Priorität der Generatordynamikbegrenzung für iGR" VALUE 0x800649A0 Val_Wu8 255. Def_dez_ub_q1 0.00 255. FORMAT "%3.0" /end CHARACTERISTIC
/begin CHARACTERISTIC K_PR_MDFUNK "Prio zur Begrenzung Generatormoment" VALUE 0x80064DA2 Val_Wu8 255. Def_dez_ub_q1 0.00 255. FORMAT "%3.0" /end CHARACTERISTIC
/begin CHARACTERISTIC K_PR_MDKOMF "Prio zur Begrenzung Generatormoment" VALUE 0x80064DA3 Val_Wu8 255. Def_dez_ub_q1 0.00 255. FORMAT "%3.0" /end CHARACTERISTIC
/begin CHARACTERISTIC K_PR_MDSICH "Prio zur Begrenzung Generatormoment" VALUE 0x80064DA4 Val_Wu8 255. Def_dez_ub_q1 0.00 255. FORMAT "%3.0" /end CHARACTERISTIC
/begin CHARACTERISTIC K_PR_MDTEST "Priorität zum Testen der Generatorentlastung" VALUE 0x80064DA5 Val_Wu8 255. Def_dez_ub_q1 0.00 255. FORMAT "%3.0" /end CHARACTERISTIC
/begin CHARACTERISTIC K_PR_RENNST "Prio zur Begrenzung Generatormoment bei Rennstart" VALUE 0x80064D6B Val_Wu8 255. Def_dez_ub_q1 0.00 255. FORMAT "%3.0" /end CHARACTERISTIC
/begin CHARACTERISTIC K_PR_RENNSTAGM "Prio zur Begrenzung Generatormoment bei Rennstart" VALUE 0x80064D6C Val_Wu8 255. Def_dez_ub_q1 0.00 255. FORMAT "%3.0" /end CHARACTERISTIC
/begin CHARACTERISTIC K_RLMXGENOF "relative Luftfüllungschwelle für Generatorzuschaltung" VALUE 0x800649F2 Val_Ws16 655.35000 Def_rf_sw_q0p01 -327.68000 327.67000 FORMAT "%9.5" /end CHARACTERISTIC
/begin CHARACTERISTIC K_SCHNKWSPGW "Drehzahlschwelle für Rücknahme LR Verringerung nach Spannungswächter" VALUE 0x80064B5C Val_Ws16 65535. Def_n_sw_q1p0 -32768. 32767. FORMAT "%5.0" /end CHARACTERISTIC
/begin CHARACTERISTIC K_SCHNKW_IPMNA "Drehzahlschwelle Berechnung iPM NA" VALUE 0x80064DA6 Val_Ws16 65535. Def_n_sw_q1p0 -32768. 32767. FORMAT "%5.0" /end CHARACTERISTIC
/begin CHARACTERISTIC K_SCHPRLRTEST "Mindestpriorität zur Loadresponsevorgabe zu Testzwecken" VALUE 0x80064B5E Val_Wu8 255. Def_dez_ub_q1 0.00 255. FORMAT "%3.0" /end CHARACTERISTIC
/begin CHARACTERISTIC K_SCHPR_KKMN "Mindestpriorität zur Abschaltung Klimakompressor" VALUE 0x80064DD6 Val_Wu8 255. Def_dez_ub_q1 0.00 255. FORMAT "%3.0" /end CHARACTERISTIC
/begin CHARACTERISTIC K_SCHPR_KKOFF "Mindestpriorität für Begrenzung Klimakompressor" VALUE 0x80064DD7 Val_Wu8 255. Def_dez_ub_q1 0.00 255. FORMAT "%3.0" /end CHARACTERISTIC
/begin CHARACTERISTIC K_SCHWPRSPWGLR1 "Schwellwert für Spannungsreglereingriff auf Loadresponse" VALUE 0x80064B5F Val_Wu8 255. Def_dez_ub_q1 0.00 255. FORMAT "%3.0" /end CHARACTERISTIC
/begin CHARACTERISTIC K_SCHWPRSPWGLR2 "Schwellwert für Spannungsreglereingriff auf Loadresponse" VALUE 0x80064B60 Val_Wu8 255. Def_dez_ub_q1 0.00 255. FORMAT "%3.0" /end CHARACTERISTIC
/begin CHARACTERISTIC K_SCHWPRSPWGLR3 "Schwellwert für Spannungsreglereingriff auf Loadresponse" VALUE 0x80064B61 Val_Wu8 255. Def_dez_ub_q1 0.00 255. FORMAT "%3.0" /end CHARACTERISTIC
/begin CHARACTERISTIC K_SCHWPRSPWGLR4 "Schwellwert für Spannungsreglereingriff auf Loadresponse" VALUE 0x80064B62 Val_Wu8 255. Def_dez_ub_q1 0.00 255. FORMAT "%3.0" /end CHARACTERISTIC
/begin CHARACTERISTIC K_SCHWPRSPWGLR5 "Schwellwert für Spannungsreglereingriff auf Loadresponse" VALUE 0x80064B63 Val_Wu8 255. Def_dez_ub_q1 0.00 255. FORMAT "%3.0" /end CHARACTERISTIC
/begin CHARACTERISTIC K_SCH_ANFAHR "Pwg_ist-Anfahrschwelle" VALUE 0x80064DA8 Val_Ws16 1599.98 Def_wdk_sw_q0p0244 -800.000 799.976 FORMAT "%7.3" /end CHARACTERISTIC
/begin CHARACTERISTIC K_SCH_MDNAVERL "Momentenchwelle Entlastung wegen Sicherheit" VALUE 0x80064DAA Val_Ws16 6553.50 Def_m_sw_q0p1 -3276.80 3276.70 FORMAT "%7.2" /end CHARACTERISTIC
/begin CHARACTERISTIC K_SCH_NKWENTL "Drehzahlschwelle Entlastung wegen Sicherheit" VALUE 0x80064DAC Val_Ws16 65535. Def_n_sw_q1p0 -32768. 32767. FORMAT "%5.0" /end CHARACTERISTIC
/begin CHARACTERISTIC K_SCH_NKWGRAD "Schwelle Drehzahlgradient gefiltert" VALUE 0x80064DAE Val_Ws8 8160. Def_ngrd_sb_q32p0 -4096. 4064. FORMAT "%5.0" /end CHARACTERISTIC
/begin CHARACTERISTIC K_SCH_PWGRENNST "Pwg_ist-Schwelle für Rennstart" VALUE 0x80064D6E Val_Ws16 1599.98 Def_wdk_sw_q0p0244 -800.000 799.976 FORMAT "%7.3" /end CHARACTERISTIC
/begin CHARACTERISTIC K_SCH_VSICH "Schwelle Fahrzeug steht" VALUE 0x80064DB0 Val_Wu16 360.0 Def_v_uw_q1p0 0.00 360.0 FORMAT "%5.1" EXTENDED_LIMITS 0.00 65535. /end CHARACTERISTIC
/begin CHARACTERISTIC K_TABSTGNMN "minimale Abstellzeit für Generatorreduzierung" VALUE 0x800649F4 Val_Wu16 65535. Def_st_uw_q1 0.00 65535. FORMAT "%5.0" /end CHARACTERISTIC
/begin CHARACTERISTIC K_TABSTGNMX "maximale Abstellzeit für Generatorreduzierung" VALUE 0x800649F6 Val_Wu16 65535. Def_st_uw_q1 0.00 65535. FORMAT "%5.0" /end CHARACTERISTIC
/begin CHARACTERISTIC K_TATMGENOF "Motordrehzahlschwelle Katalysatortemperatur" VALUE 0x800649F8 Val_Ws16 6553.5 Def_t_sw_q0p1 -3276.8 3276.7 FORMAT "%6.1" /end CHARACTERISTIC
/begin CHARACTERISTIC K_TDAFU "Ausschaltverzögerung B_notafu" VALUE 0x80064DD8 Val_Wu16 655.350 Def_td_uw_q0p01 0.00 655.350 FORMAT "%7.3" /end CHARACTERISTIC
/begin CHARACTERISTIC K_TDGENOFFST "Zeitverzögerung B_start für Spannung im Start Generator" VALUE 0x800649FA Val_Wu16 6553.5 Def_td_uw_q0p1 0.00 6553.5 FORMAT "%6.1" /end CHARACTERISTIC
/begin CHARACTERISTIC K_TD_GENBVL "Verzögerungszeit Volllast" VALUE 0x80064D70 Val_Wu16 6553.5 Def_td_uw_q0p1 0.00 6553.5 FORMAT "%6.1" /end CHARACTERISTIC
/begin CHARACTERISTIC K_TD_GENOFVL "Verzögerungszeit Generatorvolllastabschaltung" VALUE 0x80064D72 Val_Wu16 6553.5 Def_td_uw_q0p1 0.00 6553.5 FORMAT "%6.1" /end CHARACTERISTIC
/begin CHARACTERISTIC K_TD_GETRIEBE "Entprellzeit Gangwechsel aus N" VALUE 0x80064D58 Val_Wu8 2.550 Def_td_ub_q0p01 0.00 2.550 FORMAT "%5.3" /end CHARACTERISTIC
/begin CHARACTERISTIC K_TD_KKOFF "Erlaubte Dauer der KK-Abkopplung" VALUE 0x80064DB2 Val_Wu16 655.350 Def_td_uw_q0p01 0.00 655.350 FORMAT "%7.3" /end CHARACTERISTIC
/begin CHARACTERISTIC K_TD_KKOFFSICH "Erlaubte Zeit der Klimakompressorabkopplung" VALUE 0x80064DB4 Val_Wu16 655.350 Def_td_uw_q0p01 0.00 655.350 FORMAT "%7.3" /end CHARACTERISTIC
/begin CHARACTERISTIC K_TD_MDENTFUNKRES "Verzögerungszeit" VALUE 0x80064DB6 Val_Wu16 655.350 Def_td_uw_q0p01 0.00 655.350 FORMAT "%7.3" /end CHARACTERISTIC
/begin CHARACTERISTIC K_TD_MDENTKKRES "Verzögerungszeit" VALUE 0x80064DB8 Val_Wu16 655.350 Def_td_uw_q0p01 0.00 655.350 FORMAT "%7.3" /end CHARACTERISTIC
/begin CHARACTERISTIC K_TD_MDENTKOMFRES "Verzögerungszeit" VALUE 0x80064DBA Val_Wu16 655.350 Def_td_uw_q0p01 0.00 655.350 FORMAT "%7.3" /end CHARACTERISTIC
/begin CHARACTERISTIC K_TD_MDENTKOMFSET "Verzögerungszeit" VALUE 0x80064DBC Val_Wu16 655.350 Def_td_uw_q0p01 0.00 655.350 FORMAT "%7.3" /end CHARACTERISTIC
/begin CHARACTERISTIC K_TD_MDENTSICHRES "Verzögerungszeit" VALUE 0x80064DBE Val_Wu16 655.350 Def_td_uw_q0p01 0.00 655.350 FORMAT "%7.3" /end CHARACTERISTIC
/begin CHARACTERISTIC K_TD_RENN "Verzögerungszeit Rennstartbereitschaft" VALUE 0x80064D74 Val_Wu16 6553.5 Def_td_uw_q0p1 0.00 6553.5 FORMAT "%6.1" /end CHARACTERISTIC
/begin CHARACTERISTIC K_TGENOFMN "Tmot-Schwelle zur Aktivierung Generatorvolllastabschaltung" VALUE 0x80064D76 Val_Ws16 655.350 Def_t_sw_q0p01 -327.680 327.670 FORMAT "%7.3" /end CHARACTERISTIC
/begin CHARACTERISTIC K_TGENOFMX "Tmot-Schwelle zur Deaktivierung Generatorvolllastabschaltung" VALUE 0x80064D78 Val_Ws16 655.350 Def_t_sw_q0p01 -327.680 327.670 FORMAT "%7.3" /end CHARACTERISTIC
/begin CHARACTERISTIC K_TLORESPST "Startloadresponse" VALUE 0x80064B64 Val_Wu16 25.5000 Def_td_uw_q0p02 0.00 25.5000 EXTENDED_LIMITS 0.00 1310.70 /end CHARACTERISTIC
/begin CHARACTERISTIC K_TMOTABGNMN "minimale Motorabstelltemperatur für Generatorreduzierung" VALUE 0x800649FC Val_Ws16 655.350 Def_t_sw_q0p01 -327.680 327.670 FORMAT "%7.3" /end CHARACTERISTIC
/begin CHARACTERISTIC K_TUMGGNMN "minimale Umgebungstemperatur für Generatorreduzierung" VALUE 0x800649FE Val_Ws16 6553.5 Def_t_sw_q0p1 -3276.8 3276.7 FORMAT "%6.1" /end CHARACTERISTIC
/begin CHARACTERISTIC K_TUMGGNMX "maximale Umgebungstemperatur für Generatorreduzierung" VALUE 0x80064A00 Val_Ws16 6553.5 Def_t_sw_q0p1 -3276.8 3276.7 FORMAT "%6.1" /end CHARACTERISTIC
/begin CHARACTERISTIC K_T_MDNAGEN "Totzeit bei Abschaltung Generator" VALUE 0x80064D59 Val_Wu8 1.9922 Def_t_ub_b2 0.00 1.9922 /end CHARACTERISTIC
/begin CHARACTERISTIC K_T_MDNAKK "Totzeit bei Abschaltung Klimakompressor" VALUE 0x80064D5A Val_Wu8 1.9922 Def_t_ub_b2 0.00 1.9922 /end CHARACTERISTIC
/begin CHARACTERISTIC K_T_MDNAKKUP "Totzeit bei Abschaltung Klimakompressor mit Kupplung" VALUE 0x80064D5B Val_Wu8 1.9922 Def_t_ub_b2 0.00 1.9922 /end CHARACTERISTIC
/begin CHARACTERISTIC K_T_RENNAKT "Zeit in der der Rennstart aktiv ist" VALUE 0x80064D7A Val_Wu16 6553.5 Def_td_uw_q0p1 0.00 6553.5 FORMAT "%6.1" /end CHARACTERISTIC
/begin CHARACTERISTIC K_T_VRENN "Zeit die von B_bls == true bis V != 0 vergehen darf" VALUE 0x80064D7C Val_Wu8 25.5 Def_td_ub_q0p1 0.00 25.5 FORMAT "%4.1" /end CHARACTERISTIC
/begin CHARACTERISTIC K_UENTL_SOLL "Spannungsanforderung für Generatorentlastung" VALUE 0x80064DDA Val_Wu8 25.50 Def_u_ub_q0p1 0.00 25.50 FORMAT "%5.2" /end CHARACTERISTIC
/begin CHARACTERISTIC K_VGENOFMN "V-Schwelle zur Aktivierung Generatorvolllastabschaltung" VALUE 0x80064D7E Val_Wu16 360.0 Def_v_uw_q1p0 0.00 360.0 FORMAT "%5.1" EXTENDED_LIMITS 0.00 65535. /end CHARACTERISTIC
/begin CHARACTERISTIC K_VGENOFMX "V-Schwelle zur Deaktivierung Generatorvolllastabschaltung" VALUE 0x80064D80 Val_Wu16 360.0 Def_v_uw_q1p0 0.00 360.0 FORMAT "%5.1" EXTENDED_LIMITS 0.00 65535. /end CHARACTERISTIC
/begin CHARACTERISTIC K_VZLORESOFV "Geschwindigkeitsschwelle für Generatorzuschaltung" VALUE 0x80064A02 Val_Wu16 65535. Def_v_uw_q1p0 0.00 65535. FORMAT "%5.0" /end CHARACTERISTIC
/begin CHARACTERISTIC K_ZRRENN_INI "Initialisierungswert Rennstartzähler" VALUE 0x80064D82 Val_Wu8 255. Def_dez_ub_q1 0.00 255. FORMAT "%3.0" /end CHARACTERISTIC
/begin CHARACTERISTIC S_GENOFFVL "Schalter Freigabe Generatorvolllastabschaltung" VALUE 0x80064D83 Val_Wu8 255. Def_dez_ub_q1 0.00 255. FORMAT "%3.0" /end CHARACTERISTIC
/begin CHARACTERISTIC S_IPMNA_AN "Freigabe iPM NA Erregerstrombegrenzung" VALUE 0x800649A5 Val_Wu8 255. Def_dez_ub_q1 0.00 255. FORMAT "%3.0" /end CHARACTERISTIC
/begin CHARACTERISTIC S_KKOFF "1: KK darf abgeschaltet werden" VALUE 0x80064D5C Val_Wu8 255. Def_dez_ub_q1 0.00 255. FORMAT "%3.0" /end CHARACTERISTIC
/begin CHARACTERISTIC S_LORESLL "Schalter Kennlinienausschaltzeit" VALUE 0x80064A04 Val_Wu8 1.0 Identity 0.00 1.0 EXTENDED_LIMITS 0.00 255. /end CHARACTERISTIC
/begin CHARACTERISTIC S_LRTEST "Umschaltung Loadresponse zu Testzwecken" VALUE 0x80064B66 Val_Wu8 1.0 Identity 0.00 1.0 EXTENDED_LIMITS 0.00 255. /end CHARACTERISTIC
/begin CHARACTERISTIC S_MDGETR_DME "1: Getriebeverlustmoment wird von DME berechnet" VALUE 0x80064D5D Val_Wu8 255. Def_dez_ub_q1 0.00 255. FORMAT "%3.0" /end CHARACTERISTIC
/begin CHARACTERISTIC S_MDMAXMAN "Schalter zur manuellen Vorgabe des maximalen Motormoments" VALUE 0x80064D5E Val_Wu8 255. Def_dez_ub_q1 0.00 255. FORMAT "%3.0" /end CHARACTERISTIC
/begin CHARACTERISTIC S_MDNAICM "1: Botschaft EF-Nebenaggregateverluste vorhanden" VALUE 0x80064D5F Val_Wu8 255. Def_dez_ub_q1 0.00 255. FORMAT "%3.0" /end CHARACTERISTIC
/begin CHARACTERISTIC S_MDWAHLGG "1: Lokal gefiltertes Generatormoment wird verwendet" VALUE 0x800649A1 Val_Wu8 1.0 Identity 0.00 1.0 EXTENDED_LIMITS 0.00 255. /end CHARACTERISTIC
/begin CHARACTERISTIC S_STATM_AN "Freigabe der NA Momentenbilanz" VALUE 0x80064DC0 Val_Wu8 255. Def_dez_ub_q1 0.00 255. FORMAT "%3.0" /end CHARACTERISTIC
/begin CHARACTERISTIC S_TESTMBILANZ "Freigabe der Generatorentlastung zu Testzwecken" VALUE 0x80064DC1 Val_Wu8 255. Def_dez_ub_q1 0.00 255. FORMAT "%3.0" /end CHARACTERISTIC
/begin CHARACTERISTIC S_ZRRENN_INI "Initialisierung Rennstartzähler" VALUE 0x80064D84 Val_Wu8 255. Def_dez_ub_q1 0.00 255. FORMAT "%3.0" /end CHARACTERISTIC
/begin MEASUREMENT Dmd_gen "Maximaler Momentenanstieg Motor für Generator" SWORD Def_m_sw_q0p1 1 100 -3276.80 3276.70 FORMAT "%7.2" ECU_ADDRESS 0xC000A2D6 /end MEASUREMENT
/begin MEASUREMENT Dmd_gen_kor "Bedingung: Erhöhung der Zielreserve wenn Ierrdiff zu klein" SWORD Def_m_sw_q0p1 1 100 -3276.80 3276.70 FORMAT "%7.2" ECU_ADDRESS 0xC000A2D8 /end MEASUREMENT
/begin MEASUREMENT Ierrdiff "Differenz zwischen Ierr und Ierrgrenz" SWORD Def_i_sw_q0p125 1 100 -4096.000 4095.875 FORMAT "%8.3" ECU_ADDRESS 0xC000A2DA /end MEASUREMENT
/begin MEASUREMENT Ierrgrenz "Grenzerregerstrom" UBYTE Def_i_ub_q0p125 1 100 0.00 31.875 ECU_ADDRESS 0xC000B276 /end MEASUREMENT
/begin MEASUREMENT Ierrgrenz_ext "Grenzerregerstrom vom Tester" UBYTE Def_i_ub_q0p125 1 100 0.00 31.875 ECU_ADDRESS 0xC000B277 /end MEASUREMENT
/begin MEASUREMENT Ierrgrenz_md "Grenzerregerstrom Momentenbasiert" UBYTE Def_i_ub_q0p125 1 100 0.00 31.875 ECU_ADDRESS 0xC000B284 /end MEASUREMENT
/begin MEASUREMENT InjVlv_qInZFCETGMap_mp "Menge für Eingangsanzeige der Gruppenkennfelder InjVlv_rZFCETMsk_GMAP, ...Dif0_GMAP, ...Dif1_GMAP" SWORD InjMass 1 100 -327.6800 327.6700 ECU_ADDRESS 0xC000A2D2 /end MEASUREMENT
/begin MEASUREMENT InjVlv_rZFCETCoeffDif_mp "Bewertungsfaktoren für Ansteuerdauerkorrektur durch Nullmengenkalibrierung" SWORD Prc 1 100 -400.0000 399.9878 ARRAY_SIZE 3 ECU_ADDRESS 0xC000C148 /end MEASUREMENT
/begin MEASUREMENT InjVlv_rZFCETCoeffMsk_mp "Gesamtbewertungsfaktor der Ansteuerdauerkorrektur durch Nullmengenkalibrierung" SWORD Prc 1 100 -400.0000 399.9878 ECU_ADDRESS 0xC000A2D4 /end MEASUREMENT
/begin MEASUREMENT InjVlv_rZFCETPoI1CoeffDif_mp "" SWORD Prc 1 100 -400.0000 399.9878 ARRAY_SIZE 3 ECU_ADDRESS 0xC000C14E /end MEASUREMENT
/begin MEASUREMENT InjVlv_rZFCETPoI1CoeffMsk "" SWORD Prc 1 100 -400.0000 399.9878 ECU_ADDRESS 0xD0001012 /end MEASUREMENT
/begin MEASUREMENT InjVlv_rZFCETPoI2CoeffDif_mp "" SWORD Prc 1 100 -400.0000 399.9878 ARRAY_SIZE 3 ECU_ADDRESS 0xC000C154 /end MEASUREMENT
/begin MEASUREMENT InjVlv_rZFCETPoI2CoeffMsk "" SWORD Prc 1 100 -400.0000 399.9878 ECU_ADDRESS 0xD0001014 /end MEASUREMENT
/begin MEASUREMENT InjVlv_tiPiI1ZFCETCor_mp "Ansteuerdauerkorrektur der ZFC für Voreinspritzung 1 und jeden Zylinder" SWORD InjTime_us 1 100 -13107.20 5000.00 ARRAY_SIZE 6 ECU_ADDRESS 0xC000C15A /end MEASUREMENT
/begin MEASUREMENT InjVlv_tiPiI2ZFCETCor_mp "Ansteuerdauerkorrektur der ZFC für Voreinspritzung 2 und jeden Zylinder" SWORD InjTime_us 1 100 -13107.20 5000.00 ARRAY_SIZE 6 ECU_ADDRESS 0xC000C166 /end MEASUREMENT
/begin MEASUREMENT InjVlv_tiPiI3ZFCETCor_mp "Ansteuerdauerkorrektur der ZFC für Voreinspritzung 3 und jeden Zylinder" SWORD InjTime_us 1 100 -13107.20 5000.00 ARRAY_SIZE 6 ECU_ADDRESS 0xC000C172 /end MEASUREMENT
/begin MEASUREMENT InjVlv_tiPoI1ZFCETCor_mp "" SWORD InjTime_us 1 100 -13107.20 5000.00 ARRAY_SIZE 6 ECU_ADDRESS 0xC000C17E /end MEASUREMENT
/begin MEASUREMENT InjVlv_tiPoI2ZFCETCor_mp "" SWORD InjTime_us 1 100 -13107.20 5000.00 ARRAY_SIZE 6 ECU_ADDRESS 0xC000C18A /end MEASUREMENT
/begin MEASUREMENT ISC_dnAccLimCurr_mp "Maximale zulässige Beschleunigung (Motordrehzahl)" FLOAT32_IEEE ISC_dnEng_float 1 100 0.00 12000.0000 FORMAT "%10.4" ECU_ADDRESS 0xC0008FFC /end MEASUREMENT
/begin MEASUREMENT ISC_dnDeclLimCurr_mp "Maximale zulässige Verzögerung (Motordrehzahl)" FLOAT32_IEEE ISC_dnEng_float 1 100 -12000.0000 0.00 FORMAT "%10.4" ECU_ADDRESS 0xC0009000 /end MEASUREMENT
/begin MEASUREMENT ISC_dnDrvTrnFlt_mp "gefiltertes und begrenztes Beschleunigungssignal des Antriebstrangs" FLOAT32_IEEE EngN_float 1 100 0.00 10000.0000 ECU_ADDRESS 0xC0009004 /end MEASUREMENT
/begin MEASUREMENT ISC_dnDrvTrn_mp "Beschleunigungssignal Antriebsstrang" FLOAT32_IEEE EngN_float 1 100 0.00 10000.0000 ECU_ADDRESS 0xC0009008 /end MEASUREMENT
/begin MEASUREMENT ISC_dnEngFlt_mp "gefiltertes und begrenztes Beschleunigungssignal des Motors" FLOAT32_IEEE EngN_float 1 100 0.00 10000.0000 ECU_ADDRESS 0xC000900C /end MEASUREMENT
/begin MEASUREMENT ISC_dnEng_mp "Beschleunigungssignal Motor" FLOAT32_IEEE EngN_float 1 100 0.00 10000.0000 ECU_ADDRESS 0xC0009010 /end MEASUREMENT
/begin MEASUREMENT ISC_dnVehFlt_mp "gefiltertes und begrenztes Beschleunigungssignal des Fahrzeugs" FLOAT32_IEEE EngN_float 1 100 0.00 10000.0000 ECU_ADDRESS 0xC0009014 /end MEASUREMENT
/begin MEASUREMENT ISC_dnVeh_mp "Beschleunigungssignal Fahrzeug" FLOAT32_IEEE EngN_float 1 100 0.00 10000.0000 ECU_ADDRESS 0xC0009018 /end MEASUREMENT
/begin MEASUREMENT ISC_InrtDrvTrnCurr_mp "Massenträgheitsmoment vom Antriebstarng inkl. Motor" FLOAT32_IEEE ISC_Inirtia_float 1 100 0.00 20.0000000 FORMAT "%10.7" ECU_ADDRESS 0xC000901C /end MEASUREMENT
/begin MEASUREMENT ISC_InrtDrvTrnSet_mp "Massenträgheitsmoment des Fahrzeuges ohne Motor" FLOAT32_IEEE ISC_Inirtia_float 1 100 0.00 20.0000000 FORMAT "%10.7" ECU_ADDRESS 0xC0009020 /end MEASUREMENT
/begin MEASUREMENT ISC_InrtEngCurr_mp "Massenträgheitsmoment des offenen Antriebstrang" FLOAT32_IEEE ISC_Inirtia_float 1 100 0.00 20.0000000 FORMAT "%10.7" ECU_ADDRESS 0xC0009024 /end MEASUREMENT
/begin MEASUREMENT ISC_InrtVehCurr_mp "Massenträgheitsmoment vom gesamten Fahrzeug" FLOAT32_IEEE ISC_Inirtia_float 1 100 0.00 20.0000000 FORMAT "%10.7" ECU_ADDRESS 0xC0009028 /end MEASUREMENT
/begin MEASUREMENT ISC_InrtVehSet_mp "Massenträgheitsmoment des Fahrzeuges ohne Antriebstrang" FLOAT32_IEEE ISC_Inirtia_float 1 100 0.00 20.0000000 FORMAT "%10.7" ECU_ADDRESS 0xC000902C /end MEASUREMENT
/begin MEASUREMENT ISC_IWinNegLoCurr_mp "aktuelles negatives Kleinsignalfenster I-Anteil unterer Pfad" FLOAT32_IEEE EngN_float 1 100 -10000.0000 10000.0000 ECU_ADDRESS 0xC0009030 /end MEASUREMENT
/begin MEASUREMENT ISC_IWinPosLoCurr_mp "aktuelles positives Kleinsignalfenster I-Anteil unterer Pfad" FLOAT32_IEEE EngN_float 1 100 -10000.0000 10000.0000 ECU_ADDRESS 0xC0009034 /end MEASUREMENT
/begin MEASUREMENT ISC_KiLoCurr_mp "aktuelle Kleinsignalverstärkung I-Anteil unterer Pfad" FLOAT32_IEEE ISC_Ki_rpm2Nm_float 1 100 0.00 20.0000000 FORMAT "%10.7" ECU_ADDRESS 0xC0009038 /end MEASUREMENT
/begin MEASUREMENT ISC_KiNegLoCurr_mp "aktuelle Großsignalverstärkung (negativ) I-Anteil unterer Pfad" FLOAT32_IEEE ISC_Ki_rpm2Nm_float 1 100 0.00 20.0000000 FORMAT "%10.7" ECU_ADDRESS 0xC000903C /end MEASUREMENT
/begin MEASUREMENT ISC_KiPosLoCurr_mp "aktuelle Großsignalverstärkung (positiv) I-Anteil unterer Pfad" FLOAT32_IEEE ISC_Ki_rpm2Nm_float 1 100 0.00 20.0000000 FORMAT "%10.7" ECU_ADDRESS 0xC0009040 /end MEASUREMENT
/begin MEASUREMENT ISC_KpHiCurr_mp "aktuelle Kleinsignalverstärkung P-Anteil oberer Pfad" FLOAT32_IEEE ISC_Kp_rpm2Nm_float 1 100 0.00 20.0000000 FORMAT "%10.7" ECU_ADDRESS 0xC0008FC4 /end MEASUREMENT
/begin MEASUREMENT ISC_KpLoCurr_mp "aktuelle Kleinsignalverstärkung P-Anteil unterer Pfad" FLOAT32_IEEE ISC_Kp_rpm2Nm_float 1 100 0.00 20.0000000 FORMAT "%10.7" ECU_ADDRESS 0xC0009044 /end MEASUREMENT
/begin MEASUREMENT ISC_KpNegHiCurr_mp "aktuelles negatives Kleinsignalfenster P-Anteil oberer Pfad" FLOAT32_IEEE ISC_Kp_rpm2Nm_float 1 100 0.00 20.0000000 FORMAT "%10.7" ECU_ADDRESS 0xC0008FC8 /end MEASUREMENT
/begin MEASUREMENT ISC_KpNegLoCurr_mp "aktuelles negatives Kleinsignalfenster P-Anteil unterer Pfad" FLOAT32_IEEE ISC_Kp_rpm2Nm_float 1 100 0.00 20.0000000 FORMAT "%10.7" ECU_ADDRESS 0xC0009048 /end MEASUREMENT
/begin MEASUREMENT ISC_KpPosHiCurr_mp "aktuelles positives Kleinsignalfenster P-Anteil oberer Pfad" FLOAT32_IEEE ISC_Kp_rpm2Nm_float 1 100 0.00 20.0000000 FORMAT "%10.7" ECU_ADDRESS 0xC0008FCC /end MEASUREMENT
/begin MEASUREMENT ISC_KpPosLoCurr_mp "aktuelles positives Kleinsignalfenster P-Anteil unterer Pfad" FLOAT32_IEEE ISC_Kp_rpm2Nm_float 1 100 0.00 20.0000000 FORMAT "%10.7" ECU_ADDRESS 0xC000904C /end MEASUREMENT
/begin MEASUREMENT ISC_nAvrgPT1Out_mp "PT1 gefilterte Motordrehzahl" FLOAT32_IEEE EngN_float 1 100 0.00 10000.0000 ECU_ADDRESS 0xC0009050 /end MEASUREMENT
/begin MEASUREMENT ISC_nAvrgPT2Out_mp "PT2 gefilterte Motordrehzahl" FLOAT32_IEEE EngN_float 1 100 0.00 10000.0000 ECU_ADDRESS 0xC0009054 /end MEASUREMENT
/begin MEASUREMENT ISC_nDiffHi_mp "Regelabweichung zur oberen Drehzahlgrenze" FLOAT32_IEEE EngN_float 1 100 -10000.0000 10000.0000 ECU_ADDRESS 0xC0008FD0 /end MEASUREMENT
/begin MEASUREMENT ISC_nDiffLoFlt_mp "Regelabweichung zwischen unterer Solldrehzahl und aktueller Motordrehzahl für die Berechnung der PT1-Filterzeitkonstanten" SWORD EngN 1 100 -16384.00 16383.50 ECU_ADDRESS 0xC000A35E /end MEASUREMENT
/begin MEASUREMENT ISC_nDiffLo_mp "Regelabweichung zur unteren Drehzahlgrenze" FLOAT32_IEEE EngN_float 1 100 -10000.0000 10000.0000 ECU_ADDRESS 0xC0009058 /end MEASUREMENT
/begin MEASUREMENT ISC_nEngPT2Ftl "PT2 gefilterte Motordrehzahl" FLOAT32_IEEE EngN_float 1 100 0.00 10000.0000 ECU_ADDRESS 0xD0002DB0 /end MEASUREMENT
/begin MEASUREMENT ISC_nSetPHi "Obergrenze Drehzahlintervall (Maximaldrehzahl) des ISC" SWORD EngN 1 100 -16384.00 16383.50 ECU_ADDRESS 0xD0000B94 /end MEASUREMENT
/begin MEASUREMENT ISC_nSetPLo "Untergrenze Drehzahlintervall (Solldrehzahl) des ISC" SWORD EngN 1 100 -16384.00 16383.50 ECU_ADDRESS 0xD0000B96 /end MEASUREMENT
/begin MEASUREMENT ISC_numCurrFunc "Identifikationsname / -nummer des aktuell aktiven ISC Clients, der die aktuellen Reglerparameter bestimmt" SWORD ISCCurrFu 1 100 -1.00000000000 128.000000000 FORMAT "%13.9" ECU_ADDRESS 0xD0000B98 /end MEASUREMENT
/begin MEASUREMENT ISC_numCurrFuncSetPHi "Identifikationsname / -nummer des ISC Clients, der die obere Drehzahlgrenze bestimmt" SWORD ISCCurrFu 1 100 -1.00000000000 128.000000000 FORMAT "%13.9" ECU_ADDRESS 0xD0000B9A /end MEASUREMENT
/begin MEASUREMENT ISC_numCurrFuncSetPLo "Identifikationsname / -nummer des ISC Clients, der die untere Drehzahlgrenze bestimmt" SWORD ISCCurrFu 1 100 -1.00000000000 128.000000000 FORMAT "%13.9" ECU_ADDRESS 0xD0000B9C /end MEASUREMENT
/begin MEASUREMENT ISC_PWinNegHiCurr_mp "aktuelles negatives Kleinsignalfenster P-Anteil oberer Pfad" FLOAT32_IEEE EngN_float 1 100 -10000.0000 10000.0000 ECU_ADDRESS 0xC0008FD4 /end MEASUREMENT
/begin MEASUREMENT ISC_PWinNegLoCurr_mp "aktuelles negatives Kleinsignalfenster P-Anteil unterer Pfad" FLOAT32_IEEE EngN_float 1 100 -10000.0000 10000.0000 ECU_ADDRESS 0xC000905C /end MEASUREMENT
/begin MEASUREMENT ISC_PWinPosHiCurr_mp "aktuelles positives Kleinsignalfenster P-Anteil oberer Pfad" FLOAT32_IEEE EngN_float 1 100 -10000.0000 10000.0000 ECU_ADDRESS 0xC0008FD8 /end MEASUREMENT
/begin MEASUREMENT ISC_PWinPosLoCurr_mp "aktuelles positives Kleinsignalfenster P-Anteil unterer Pfad" FLOAT32_IEEE EngN_float 1 100 -10000.0000 10000.0000 ECU_ADDRESS 0xC0009060 /end MEASUREMENT
/begin MEASUREMENT ISC_rnEngvVehCurr_mp "Verhältnis Motordrehzahl zu Fahrzeuggeschwindigkeit" FLOAT32_IEEE ISC_rnEng2vVeh_float 1 100 0.00 1000.00000 FORMAT "%10.5" ECU_ADDRESS 0xC0009064 /end MEASUREMENT
/begin MEASUREMENT ISC_st "Statusinformation des ISC und seiner Clients" ULONG OneToOne 1 100 0.00 4294967295.00 ARRAY_SIZE 6 ECU_ADDRESS 0xD0002CEC /end MEASUREMENT
/begin MEASUREMENT ISC_stExtIni_mp "aktuelle Initialisierungsart" SWORD OneToOne 1 100 -32768.00 32767.00 ECU_ADDRESS 0xC000A35C /end MEASUREMENT
/begin MEASUREMENT ISC_stHiLo_mp "Zustand der Drehzahlbereich, in dem sich der Motordrehzahl befindet" UBYTE OneToOne 1 100 0.00 255.0 ECU_ADDRESS 0xC000B29D /end MEASUREMENT
/begin MEASUREMENT ISC_stPthSel_mp "aktuelle Aufschalstrategie der beiden ISC-Pfade" UBYTE OneToOne 1 100 0.00 255.0 ECU_ADDRESS 0xC000B29E /end MEASUREMENT
/begin MEASUREMENT ISC_tiFltLosTrqEstCurr_mp "Zeitkonstante für die Lastmomentabschaltzung (PT1-Glieder)" FLOAT32_IEEE ISC_tiPTsTrqLoss_float 1 100 0.00 60.0000000 FORMAT "%10.7" ECU_ADDRESS 0xC0009068 /end MEASUREMENT
/begin MEASUREMENT ISC_tiFltnEngCurr_mp "Zeitkonstante für die PT2-Filterung der Motordrehzahl" FLOAT32_IEEE ISC_tiPT2nEng_float 1 100 0.00 60.0000000 FORMAT "%10.7" ECU_ADDRESS 0xC000906C /end MEASUREMENT
/begin MEASUREMENT ISC_tiPT1TrqFlt "Filterzeitkonstante für das gefilterte ISC Ausgangsdrehmoment" FLOAT32_IEEE ISC_tiPTsTrqLoss_float 1 100 0.00 60.0000000 FORMAT "%10.7" ECU_ADDRESS 0xD0002DB4 /end MEASUREMENT
/begin MEASUREMENT ISC_trq "Stellgröße des ISC" SWORD Trq 1 100 -3276.800 3276.700 ECU_ADDRESS 0xD0000B9E /end MEASUREMENT
/begin MEASUREMENT ISC_trqAcc_mp "resulierendes Beschleunigungsmoment aus aus Motor, Antriebstrang und Fahrzeug" FLOAT32_IEEE Trq_float 1 100 -500.000000 1000.00000 ECU_ADDRESS 0xC0009070 /end MEASUREMENT
/begin MEASUREMENT ISC_trqDrvTrnAccUnFlt "Beschleunigendes unbegrenztes Drehmoment des Antriebstrangs" SWORD Trq 1 100 -3276.800 3276.700 ECU_ADDRESS 0xD0000BA0 /end MEASUREMENT
/begin MEASUREMENT ISC_trqDrvTrnAcc_mp "Beschleunigungsmoment berechnet aus Getriebeeingangsdrehzahl und Massenträgheitsmoment vom Antriebstrang ohne Motor" FLOAT32_IEEE Trq_float 1 100 -500.000000 1000.00000 ECU_ADDRESS 0xC0009074 /end MEASUREMENT
/begin MEASUREMENT ISC_trqEngAccUnFlt "beschleunigendes unbegrenztes Drehmoment des Motors" SWORD Trq 1 100 -3276.800 3276.700 ECU_ADDRESS 0xD0000BA2 /end MEASUREMENT
/begin MEASUREMENT ISC_trqEngAcc_mp "Beschleunigsmoment berechnet aus Motordrehzahl und Motormassenträgheit" FLOAT32_IEEE Trq_float 1 100 -500.000000 1000.00000 ECU_ADDRESS 0xC0009078 /end MEASUREMENT
/begin MEASUREMENT ISC_trqFlt "gefilterte Stellgröße des ISC" SWORD Trq 1 100 -3276.800 3276.700 ECU_ADDRESS 0xD0000BA4 /end MEASUREMENT
/begin MEASUREMENT ISC_trqHiLimMax "obere Drehmomentstellgrenze für den oberen Pfad des ISC" FLOAT32_IEEE Trq_float 1 100 -500.000000 1000.00000 ECU_ADDRESS 0xD0002DB8 /end MEASUREMENT
/begin MEASUREMENT ISC_trqHiLimMax_mp "obere Drehmomentenbegrenzung des Stelleingriffs für oberen ISC-Pfad" FLOAT32_IEEE Trq_float 1 100 -500.000000 1000.00000 ECU_ADDRESS 0xC0008FDC /end MEASUREMENT
/begin MEASUREMENT ISC_trqHiLimMin "untere Drehmomentstellgrenze für den oberen Pfad des ISC" FLOAT32_IEEE Trq_float 1 100 -500.000000 1000.00000 ECU_ADDRESS 0xD0002DBC /end MEASUREMENT
/begin MEASUREMENT ISC_trqHiLimMin_mp "untere Drehmomentenbegrenzung des Stelleingriffs für oberen ISC-Pfad" FLOAT32_IEEE Trq_float 1 100 -500.000000 1000.00000 ECU_ADDRESS 0xC0008FE0 /end MEASUREMENT
/begin MEASUREMENT ISC_trqILoLtd_mp "begrenzter I-Anteil des unteren Pfades" FLOAT32_IEEE Trq_float 1 100 -500.000000 1000.00000 ECU_ADDRESS 0xC000907C /end MEASUREMENT
/begin MEASUREMENT ISC_trqInrSetFlt_mp "Inneres Moment für den Set-Pfad nach der Verbrennungsmotorkompensation" FLOAT32_IEEE Trq_float 1 100 -500.000000 1000.00000 ECU_ADDRESS 0xC0009080 /end MEASUREMENT
/begin MEASUREMENT ISC_trqInrSetReal_mp "inneres Moment ungefiltert, abzüglich Vorgesteuerter Momente" FLOAT32_IEEE Trq_float 1 100 -500.000000 1000.00000 ECU_ADDRESS 0xC0009084 /end MEASUREMENT
/begin MEASUREMENT ISC_trqIscAsd_mp "Summe aus SpdGov_trqInrLimSet und Führungsformerausgang(ASDrf_trqInrSet)" FLOAT32_IEEE Trq_float 1 100 -500.000000 1000.00000 ECU_ADDRESS 0xC0008FE4 /end MEASUREMENT
/begin MEASUREMENT ISC_trqLoLimMax "obere Drehmomentstellgrenze für den unteren Pfad des ISC" FLOAT32_IEEE Trq_float 1 100 -500.000000 1000.00000 ECU_ADDRESS 0xD0002DC0 /end MEASUREMENT
/begin MEASUREMENT ISC_trqLoLimMin "untere Drehmomentstellgrenze für den unteren Pfad des ISC" FLOAT32_IEEE Trq_float 1 100 -500.000000 1000.00000 ECU_ADDRESS 0xD0002DC4 /end MEASUREMENT
/begin MEASUREMENT ISC_trqLoLtd "Ausgangdrehmoment der unteren ISC-Pfades" SWORD Trq 1 100 -3276.800 3276.700 ECU_ADDRESS 0xD0000BA6 /end MEASUREMENT
/begin MEASUREMENT ISC_trqLoNoPreCtlLtd_mp "Drehmoment des unteren ISC-Pfades vor der Aufschaltung von Vorsteuermoment (ISC_trqPreCtl)" FLOAT32_IEEE Trq_float 1 100 -500.000000 1000.00000 ECU_ADDRESS 0xC0009088 /end MEASUREMENT
/begin MEASUREMENT ISC_trqLoPreCtlLtd_mp "Drehmoment des unteren ISC-Pfades nach der Aufschaltung von Vorsteuermoment (ISC_trqPreCtl)" FLOAT32_IEEE Trq_float 1 100 -500.000000 1000.00000 ECU_ADDRESS 0xC000908C /end MEASUREMENT
/begin MEASUREMENT ISC_trqLossFlt "gefiltertes abgeschätztes Verlustmoment" FLOAT32_IEEE Trq_float 1 100 -500.000000 1000.00000 ECU_ADDRESS 0xD0002DC8 /end MEASUREMENT
/begin MEASUREMENT ISC_trqLossFltK1_mp "gefiltertes abgeschätztes Verlustmoment" FLOAT32_IEEE Trq_float 1 100 -500.000000 1000.00000 ECU_ADDRESS 0xC0009090 /end MEASUREMENT
/begin MEASUREMENT ISC_trqLossFltK2_mp "gefiltertes abgeschätztes Verlustmoment nach Aufschaltung des unteren Integratormoments" FLOAT32_IEEE Trq_float 1 100 -500.000000 1000.00000 ECU_ADDRESS 0xC0009094 /end MEASUREMENT
/begin MEASUREMENT ISC_trqLossFltK3_mp "gefiltertes abgeschätztes Verlustmoment nach einer Parametersatzwechsel (P-Parameter)" FLOAT32_IEEE Trq_float 1 100 -500.000000 1000.00000 ECU_ADDRESS 0xC0009098 /end MEASUREMENT
/begin MEASUREMENT ISC_trqLossFltK4_mp "gefiltertes abgeschätztes Verlustmoment nach einer Parametersatzwechsel des oberen P-Glides (P-Parameter)" FLOAT32_IEEE Trq_float 1 100 -500.000000 1000.00000 ECU_ADDRESS 0xC0008FE8 /end MEASUREMENT
/begin MEASUREMENT ISC_trqLossUnFlt_mp "Ungefiltertes abgeschätztes Verlustmoment" FLOAT32_IEEE Trq_float 1 100 -500.000000 1000.00000 ECU_ADDRESS 0xC000909C /end MEASUREMENT
/begin MEASUREMENT ISC_trqPHi_mp "P-Anteil des oberen Pfades" FLOAT32_IEEE Trq_float 1 100 -500.000000 1000.00000 ECU_ADDRESS 0xC0008FEC /end MEASUREMENT
/begin MEASUREMENT ISC_trqPLo_mp "P-Anteil des unteres Pfades" FLOAT32_IEEE Trq_float 1 100 -500.000000 1000.00000 ECU_ADDRESS 0xC00090A0 /end MEASUREMENT
/begin MEASUREMENT ISC_trqReq "ausgewählte Anforderung (aus allen Anforderungen der aktiven ISC Clients) für ein Initialisierungsdrehmoment an den ISC" FLOAT32_IEEE Trq_float 1 100 -500.000000 1000.00000 ECU_ADDRESS 0xD0002DCC /end MEASUREMENT
/begin MEASUREMENT ISC_trqSetLtd_mp "Limitierter Ausgang des ISC ohne berücksichtigung des Führungsformerausganges (ASDrf_trqInrSet)" FLOAT32_IEEE Trq_float 1 100 -500.000000 1000.00000 ECU_ADDRESS 0xC0008FF0 /end MEASUREMENT
/begin MEASUREMENT ISC_trqSet_mp "Nicht limitierter Ausgang des ISC ohne berücksichtigung des Führungsformerausganges (ASDrf_trqInrSet)" FLOAT32_IEEE Trq_float 1 100 -500.000000 1000.00000 ECU_ADDRESS 0xC0008FF4 /end MEASUREMENT
/begin MEASUREMENT ISC_trqVehAcc_mp "Beschleunigungsmoment berechnet aus und Massenträgheitsmoment vom Antriebstrang ohne Motor" FLOAT32_IEEE Trq_float 1 100 -500.000000 1000.00000 ECU_ADDRESS 0xC00090A4 /end MEASUREMENT
/begin MEASUREMENT ISC_trq_mp "Stellgröße des ISC, ohne Nebenaggregate" FLOAT32_IEEE Trq_float 1 100 -500.000000 1000.00000 ECU_ADDRESS 0xC0008FF8 /end MEASUREMENT
/begin MEASUREMENT IVActr_ch "Ladung beim piezo Aktor-Ladevorgang" SWORD Charge_PA 1 100 -32768.00 32767.00 FORMAT "%8.2" ARRAY_SIZE 6 ECU_ADDRESS 0xD0000BA8 /end MEASUREMENT
/begin MEASUREMENT IVActr_chnImmdMeas "Gemessener Kanal im sofortigem Modus" UBYTE OneToOne 1 100 0.00 255.0 ECU_ADDRESS 0xD0001E7C /end MEASUREMENT
/begin MEASUREMENT IVActr_ctIntrGetMeas "Anzahl Interrups des gemessenen Einspritztyps zwischen Start und Auswertung der Aktormessung" UBYTE OneToOne 1 100 0.00 255.0 ARRAY_SIZE 6 ECU_ADDRESS 0xD0001E7D /end MEASUREMENT
/begin MEASUREMENT IVActr_facWActrDvtAvrg "Verbrauchsabweichung der Aktorenergieabweichung" SWORD Fact1 1 100 -256.0000 255.9922 ECU_ADDRESS 0xD0000BB4 /end MEASUREMENT
/begin MEASUREMENT IVActr_facWActrDvtUnCor_mp "unkorrigierter Faktor der Aktorenergieabweichung" SWORD Fact1 1 100 -256.0000 255.9922 ARRAY_SIZE 6 ECU_ADDRESS 0xC000C196 /end MEASUREMENT
/begin MEASUREMENT IVActr_facWActrDvt_mp "Begrenzte durchschnittliche Abweichung der Aktorenergie" SWORD Fact1 1 100 -256.0000 255.9922 ECU_ADDRESS 0xC000A360 /end MEASUREMENT
/begin MEASUREMENT IVActr_facWActrTemp_mp "Temperaturkorrekturfaktor des erwarteten Aktorenergieverbrauchs" SWORD Fact1 1 100 -256.0000 255.9922 ECU_ADDRESS 0xC000A362 /end MEASUREMENT
/begin MEASUREMENT IVActr_numCylMeasNxt "Nächster zu messender Zylinder für Aktormessung" ULONG OneToOne 1 100 0.00 4294967295.00 ECU_ADDRESS 0xD0003170 /end MEASUREMENT
/begin MEASUREMENT IVActr_numFacWVld_mp "Anzahl der gültigen Energieabweichungsfaktoren" ULONG OneToOne 1 100 0.00 4294967295.00 ECU_ADDRESS 0xC00090A8 /end MEASUREMENT
/begin MEASUREMENT IVActr_pRailLnk "gepaarten Raildruck der gemessenen Einspritzung" SWORD Pres_Rail 1 100 -3276.800 2000.000 ARRAY_SIZE 6 ECU_ADDRESS 0xD0000BB6 /end MEASUREMENT
/begin MEASUREMENT IVActr_stActrEnrg "Status der Aktorenergieberechnung" UWORD OneToOne 1 100 0.00 65535.00 ARRAY_SIZE 6 ECU_ADDRESS 0xD00015C8 /end MEASUREMENT
/begin MEASUREMENT IVActr_stCh "Status von IVActr_ch" UBYTE OneToOne 1 100 0.00 255.0 ARRAY_SIZE 6 ECU_ADDRESS 0xD0001E83 /end MEASUREMENT
/begin MEASUREMENT IVActr_stGetImmdMeas "Status der Aktormessung, sofortiger Modus" UBYTE OneToOne 1 100 0.00 255.0 ECU_ADDRESS 0xD0001E89 /end MEASUREMENT
/begin MEASUREMENT IVActr_stGetMeas "Status der Aktormessung, Einspritzungsmodus" UBYTE OneToOne 1 100 0.00 255.0 ARRAY_SIZE 6 ECU_ADDRESS 0xD0001E8A /end MEASUREMENT
/begin MEASUREMENT IVActr_stMeasDisbl "Status: temporäre Deaktivierung der Aktormessung (zylinderspezifisch) - Einspritzung Modus" UBYTE OneToOne 1 100 0.00 255.0 ECU_ADDRESS 0xD0001E90 /end MEASUREMENT
/begin MEASUREMENT IVActr_stMeasEna "Status von ADC Messung: aktiv oder nicht" UBYTE OneToOne 1 100 0.00 255.0 ECU_ADDRESS 0xD0001E91 /end MEASUREMENT
/begin MEASUREMENT IVActr_stMeasTyp "Letzter Messungsmodus aktiviert" UBYTE OneToOne 1 100 0.00 255.0 ECU_ADDRESS 0xD0001E92 /end MEASUREMENT
/begin MEASUREMENT IVActr_stTiDisCh "Status der Aktor-Entladezeit" UBYTE OneToOne 1 100 0.00 255.0 ARRAY_SIZE 6 ECU_ADDRESS 0xD0001E93 /end MEASUREMENT
/begin MEASUREMENT IVActr_stTiETMeas "Status der gemessenen Ansteuerdauer" UBYTE OneToOne 1 100 0.00 255.0 ARRAY_SIZE 6 ECU_ADDRESS 0xD0001E99 /end MEASUREMENT
/begin MEASUREMENT IVActr_stUChrgUp "Status der Aktorspannung nach dem Laden" UBYTE OneToOne 1 100 0.00 255.0 ARRAY_SIZE 6 ECU_ADDRESS 0xD0001E9F /end MEASUREMENT
/begin MEASUREMENT IVActr_stUDisChStop "Status der Aktorspannung nach dem Entladen" UBYTE OneToOne 1 100 0.00 255.0 ARRAY_SIZE 6 ECU_ADDRESS 0xD0001EA5 /end MEASUREMENT
/begin MEASUREMENT IVActr_stUTunChk "" UBYTE OneToOne 1 100 0.00 255.0 ARRAY_SIZE 6 ECU_ADDRESS 0xD0001EAB /end MEASUREMENT
/begin MEASUREMENT IVActr_stUUp "Status der Aktorspannung Up-Niveau" UBYTE OneToOne 1 100 0.00 255.0 ARRAY_SIZE 6 ECU_ADDRESS 0xD0001EB1 /end MEASUREMENT
/begin MEASUREMENT IVActr_tActr "Aktortemperatur" SWORD Temp_Cels 1 100 -3549.940 3003.560 ECU_ADDRESS 0xD0000BC2 /end MEASUREMENT
/begin MEASUREMENT IVActr_tiActrMeasCurr "Zylinderspezifischer Zeitstempel der letzen Aktormessung, aktualisiert in 10ms." ULONG Time_PzoMeas 1 100 0.00 234505214.307 FORMAT "%13.3" ARRAY_SIZE 6 ECU_ADDRESS 0xD0003174 /end MEASUREMENT
/begin MEASUREMENT IVActr_tiActrMeasTmr_mp "Timeout's Timer Wert für die Überprüfung des Messungsdauers" SLONG Time_s 1 100 -21474836.4800 21474836.4700 ECU_ADDRESS 0xC00090AC /end MEASUREMENT
/begin MEASUREMENT IVActr_tiChrgLnk "gepaarte Soll-Ladezeit" SWORD InjTime_us 1 100 -13107.20 5000.00 ARRAY_SIZE 6 ECU_ADDRESS 0xD0000BC4 /end MEASUREMENT
/begin MEASUREMENT IVActr_tiDiffActrInteg_mp "Zeitraum zwischen Integratorabgleich und Messung des aktuellen Zylinders" ULONG Time_PzoMeas 1 100 0.00 234505214.307 FORMAT "%13.3" ARRAY_SIZE 6 ECU_ADDRESS 0xC000C1A4 /end MEASUREMENT
/begin MEASUREMENT IVActr_tiDisCh "Aktor-Entladezeit" SWORD InjTime_us 1 100 -13107.20 5000.00 ARRAY_SIZE 6 ECU_ADDRESS 0xD0000BDC /end MEASUREMENT
/begin MEASUREMENT IVActr_tiDisChLnk "gepaarte Soll-Entladezeit" SWORD InjTime_us 1 100 -13107.20 5000.00 ARRAY_SIZE 6 ECU_ADDRESS 0xD0000BD0 /end MEASUREMENT
/begin MEASUREMENT IVActr_tiEnrgCalc "Zeitstempel der Aktorenergieberechnung" ULONG Time_PzoMeas 1 100 0.00 234505214.307 FORMAT "%13.3" ARRAY_SIZE 6 ECU_ADDRESS 0xD000318C /end MEASUREMENT
/begin MEASUREMENT IVActr_tiETMeas "Gemessene Ansteuerdauer" SWORD InjTime_us 1 100 -13107.20 5000.00 ARRAY_SIZE 6 ECU_ADDRESS 0xD0000BE8 /end MEASUREMENT
/begin MEASUREMENT IVActr_uActrRaw_mp "ADC-Rohwert der Aktorspannung für IVActr_uActrLin_CUR" SWORD Volt 1 100 -6553.600 6553.400 ECU_ADDRESS 0xC000A366 /end MEASUREMENT
/begin MEASUREMENT IVActr_uChrgUp "Aktorspannung nach dem Laden" SWORD Vltg_PA 1 100 -327.6800 327.6700 ARRAY_SIZE 6 ECU_ADDRESS 0xD0000BF4 /end MEASUREMENT
/begin MEASUREMENT IVActr_uChUpInCur_mp "Eingangswert für IVActr_wActrNom_CUR" SWORD Vltg_PA 1 100 -327.6800 327.6700 ECU_ADDRESS 0xC000A364 /end MEASUREMENT
/begin MEASUREMENT IVActr_uCh_mp "Messpunkt von IVActr_UCh" SWORD Volt 1 100 -6553.600 6553.400 ECU_ADDRESS 0xC000A368 /end MEASUREMENT
/begin MEASUREMENT IVActr_uDisChStop "Aktorspannung nach dem Entladen" SWORD Vltg_PA 1 100 -327.6800 327.6700 ARRAY_SIZE 6 ECU_ADDRESS 0xD0000C00 /end MEASUREMENT
/begin MEASUREMENT IVActr_uImmdMeasRaw_mp "Rohwert von dem sofortigen Messung" SWORD Volt 1 100 -6553.600 6553.400 ECU_ADDRESS 0xC000A36A /end MEASUREMENT
/begin MEASUREMENT IVActr_uTunChk "" SWORD Vltg_PA 1 100 -327.6800 327.6700 ARRAY_SIZE 6 ECU_ADDRESS 0xD0000C0C /end MEASUREMENT
/begin MEASUREMENT IVActr_uUp "Aktorspannung Up-Niveau" SWORD Vltg_PA 1 100 -327.6800 327.6700 ARRAY_SIZE 6 ECU_ADDRESS 0xD0000C24 /end MEASUREMENT
/begin MEASUREMENT IVActr_uUpLnk "gepaarte Aktor-Sollspannung Up-Niveau" SWORD Vltg_PA 1 100 -327.6800 327.6700 ARRAY_SIZE 6 ECU_ADDRESS 0xD0000C18 /end MEASUREMENT
/begin MEASUREMENT IVActr_wActrDiff_mp "Energie des Lade- Entladeenergiezyklus des Aktors" SWORD W_PA 1 100 -327.6800 327.6700 FORMAT "%8.4" ARRAY_SIZE 6 ECU_ADDRESS 0xC000C1BC /end MEASUREMENT
/begin MEASUREMENT IVActr_wActrNomCor_mp "Temperaturkorrigierter nominaler Aktorenergieverbrauch" SWORD W_PA 1 100 -327.6800 327.6700 FORMAT "%8.4" ARRAY_SIZE 6 ECU_ADDRESS 0xC000C1C8 /end MEASUREMENT
/begin MEASUREMENT IVActr_wActrNom_mp "Nominaler Aktorenergieverbrauch" SWORD W_PA 1 100 -327.6800 327.6700 FORMAT "%8.4" ARRAY_SIZE 6 ECU_ADDRESS 0xC000C1D4 /end MEASUREMENT
/begin MEASUREMENT IVActr_wChActrRaw_mp "Rohwert der Aktorladeenergie" SWORD W_PA 1 100 -327.6800 327.6700 FORMAT "%8.4" ARRAY_SIZE 6 ECU_ADDRESS 0xC000C1E0 /end MEASUREMENT
/begin MEASUREMENT IVActr_wDisChActrRaw_mp "Rohwert der Aktorentladeenergie" SWORD W_PA 1 100 -327.6800 327.6700 FORMAT "%8.4" ARRAY_SIZE 6 ECU_ADDRESS 0xC000C1EC /end MEASUREMENT
/begin MEASUREMENT IVAdj_clsIVA "InjektorSpannungsAbgeich-Klasse des Piezo-Aktors" UBYTE OneToOne 1 100 0.00 255.0 ARRAY_SIZE 6 ECU_ADDRESS 0xD0001EB7 /end MEASUREMENT
/begin MEASUREMENT IVAdj_ctNVCEna_mp "Wert des NVC-Freigabezählers" UWORD OneToOne 1 100 0.00 65535.00 ARRAY_SIZE 6 ECU_ADDRESS 0xC000C1F8 /end MEASUREMENT
/begin MEASUREMENT IVAdj_facNVC "NVC Korrekturfaktor" SWORD Fact 1 100 -4.000000 3.999878 ARRAY_SIZE 6 ECU_ADDRESS 0xD0000C30 /end MEASUREMENT
/begin MEASUREMENT IVAdj_facNVCEepWrI_mp "Im EEPROM gespeicherter Wert des NVC-I-Reglers" SWORD Fact 1 100 -4.000000 3.999878 ARRAY_SIZE 6 ECU_ADDRESS 0xC000C204 /end MEASUREMENT
/begin MEASUREMENT IVAdj_facNVCInitI_mp "Initialisierungswert des NVC-I-Reglers" SWORD Fact 1 100 -4.000000 3.999878 ARRAY_SIZE 6 ECU_ADDRESS 0xC000C210 /end MEASUREMENT
/begin MEASUREMENT IVAdj_pDiffNVCSetCURIn_mp "Eingangswert der Spannungsdifferenzreferenzkurve" SWORD Pres_Rail 1 100 -3276.800 2000.000 ECU_ADDRESS 0xC000A378 /end MEASUREMENT
/begin MEASUREMENT IVAdj_stChkErr_mp "Status des Checksummenfehlers" ULONG OneToOne 1 100 0.00 4294967295.00 ECU_ADDRESS 0xC00090B0 /end MEASUREMENT
/begin MEASUREMENT IVAdj_stChkSumErrAdj_mp "Fehlerstatus der Prüfsummen-Verletzung der Injektorabgleichwerte" UBYTE OneToOne 1 100 0.00 255.0 ECU_ADDRESS 0xC000B29F /end MEASUREMENT
/begin MEASUREMENT IVAdj_stIVAErr "ISA Fehlerstatus" UBYTE OneToOne 1 100 0.00 255.0 ARRAY_SIZE 4 ECU_ADDRESS 0xD0001EBD /end MEASUREMENT
/begin MEASUREMENT IVAdj_stNVCCond_mp "Status der NVC-Lernfreigabebedingungen" UWORD OneToOne 1 100 0.00 65535.00 ECU_ADDRESS 0xC000A37A /end MEASUREMENT
/begin MEASUREMENT IVAdj_stNVCEna_mp "Status der NVC-Lernfreigabe" UBYTE OneToOne 1 100 0.00 255.0 ECU_ADDRESS 0xC000B2A0 /end MEASUREMENT
/begin MEASUREMENT IVAdj_stNVCGovInit_mp "Status der ausgeführten Funktion (Rügabewert von IVAdj_NVCGovInit)" UBYTE OneToOne 1 100 0.00 255.0 ECU_ADDRESS 0xC000B2A1 /end MEASUREMENT
/begin MEASUREMENT IVAdj_stNVCRls "Freigabestatus der NVC" UBYTE OneToOne 1 100 0.00 255.0 ECU_ADDRESS 0xD0001EC1 /end MEASUREMENT
/begin MEASUREMENT IVAdj_tiNVCGovCalc "Systemzeit der letzten NVC Berechnung" ULONG Time_PzoMeas 1 100 0.00 234505214.307 FORMAT "%13.3" ARRAY_SIZE 6 ECU_ADDRESS 0xD00031A4 /end MEASUREMENT
/begin MEASUREMENT IVAdj_uDiffNVCInPI_mp "NVC-Reglereingangswert" SWORD Vltg_PA 1 100 -327.6800 327.6700 ARRAY_SIZE 6 ECU_ADDRESS 0xC000C21C /end MEASUREMENT
/begin MEASUREMENT IVAdj_uDiffNVCSet_mp "aktueller Wert aus der Spannungsdifferenzreferenzkurve" SWORD Vltg_PA 1 100 -327.6800 327.6700 ARRAY_SIZE 6 ECU_ADDRESS 0xC000C228 /end MEASUREMENT
/begin MEASUREMENT IVAdj_uDiffNVC_mp "Istwert der NVC-Regelgröße (Differenz aus Aktorladesspannung und Aktorspannung)" SWORD Vltg_PA 1 100 -327.6800 327.6700 ARRAY_SIZE 6 ECU_ADDRESS 0xC000C234 /end MEASUREMENT
/begin MEASUREMENT IVAdj_valDestPtr_mp "Wert des Ziel-Pointers (gelesener EEPROM-Wert) (Funktionsparameter von IVAdj_NVCGovInit)" UWORD OneToOne 1 100 0.00 65535.00 ARRAY_SIZE 6 ECU_ADDRESS 0xC000C240 /end MEASUREMENT
/begin MEASUREMENT IVAdj_volMI1QntAdj_mp "Injektor-Abgleichmenge der Haupteinspritzung 1" SWORD InjQntInj 1 100 -327.6800 327.6700 ECU_ADDRESS 0xC000A36C /end MEASUREMENT
/begin MEASUREMENT IVAdj_volPiI1QntAdj_mp "Injektor-Abgleichmenge der Voreinspritzung 1" SWORD InjQntInj 1 100 -327.6800 327.6700 ECU_ADDRESS 0xC000A36E /end MEASUREMENT
/begin MEASUREMENT IVAdj_volPiI2QntAdj_mp "Injektor-Abgleichmenge der Voreinspritzung 2" SWORD InjQntInj 1 100 -327.6800 327.6700 ECU_ADDRESS 0xC000A370 /end MEASUREMENT
/begin MEASUREMENT IVAdj_volPiI3QntAdj_mp "Injektor-Abgleichmenge der Voreinspritzung 3" SWORD InjQntInj 1 100 -327.6800 327.6700 ECU_ADDRESS 0xC000A372 /end MEASUREMENT
/begin MEASUREMENT IVAdj_volPoI1QntAdj_mp "Injektor-Abgleichmenge der Nacheinspritzung 1" SWORD InjQntInj 1 100 -327.6800 327.6700 ECU_ADDRESS 0xC000A374 /end MEASUREMENT
/begin MEASUREMENT IVAdj_volPoI2QntAdj_mp "Injektor-Abgleichmenge der Nacheinspritzung 2" SWORD InjQntInj 1 100 -327.6800 327.6700 ECU_ADDRESS 0xC000A376 /end MEASUREMENT
/begin MEASUREMENT IVCtl_facVltgTempCor "Temperaturkompensationsfaktor der Aktorspannung" SWORD Fact 1 100 -4.000000 3.999878 ECU_ADDRESS 0xD0000C3C /end MEASUREMENT
/begin MEASUREMENT IVCtl_iChrg "Ladestrom-Grenze" SWORD Curr 1 100 0.00 20000.00 FORMAT "%8.2" ARRAY_SIZE 6 ECU_ADDRESS 0xD0000C3E /end MEASUREMENT
/begin MEASUREMENT IVCtl_iCorPI "Ausgang des Entladezeitreglers" SWORD Curr 1 100 -10000.00 10000.00 FORMAT "%8.2" ARRAY_SIZE 6 ECU_ADDRESS 0xD0000C4A /end MEASUREMENT
/begin MEASUREMENT IVCtl_iCorPIUnLim_mp "Unbegrenzter Reglerausgang des PI-Reglers der Entladezeitregelung" SWORD Curr 1 100 -32768.00 32767.00 FORMAT "%8.2" ARRAY_SIZE 6 ECU_ADDRESS 0xC000C24C /end MEASUREMENT
/begin MEASUREMENT IVCtl_iDisCh "Entladestrom" SWORD Curr 1 100 -30000.00 30000.00 FORMAT "%8.2" ARRAY_SIZE 6 ECU_ADDRESS 0xD0000C56 /end MEASUREMENT
/begin MEASUREMENT IVCtl_iDisChUnCor_mp "Unkorrigierter Entladestrom" SWORD Curr 1 100 -30000.00 30000.00 FORMAT "%8.2" ARRAY_SIZE 6 ECU_ADDRESS 0xC000C258 /end MEASUREMENT
/begin MEASUREMENT IVCtl_p "aktueller Raildruck der Spannungssollwertberechnung" SWORD Pres_Rail 1 100 -3276.800 2000.000 ECU_ADDRESS 0xD0000C62 /end MEASUREMENT
/begin MEASUREMENT IVCtl_stOBDErr "OBD Fehlerstatus der Up-Spannung" UBYTE OneToOne 1 100 0.00 255.0 ARRAY_SIZE 2 ECU_ADDRESS 0xD0001EC2 /end MEASUREMENT
/begin MEASUREMENT IVCtl_stStrt "Zustand: Startspannung des Einspritzventils aktiv" UBYTE OneToOne 1 100 0.00 1.000 ECU_ADDRESS 0xD0001EC4 /end MEASUREMENT
/begin MEASUREMENT IVCtl_stTGovPIHi_mp "Zylinderspezifischer Zustand: PI-Regler der Entladezeitregelung ist am oberen Anschlag" UBYTE OneToOne 1 100 0.00 255.0 ECU_ADDRESS 0xC000B2A2 /end MEASUREMENT
/begin MEASUREMENT IVCtl_stTGovPILo_mp "Zylinderspezifischer Zustand: PI-Regler der Entladezeitregelung ist am unteren Anschlag" UBYTE OneToOne 1 100 0.00 255.0 ECU_ADDRESS 0xC000B2A3 /end MEASUREMENT
/begin MEASUREMENT IVCtl_stUDiffUpImPlaus_mp "Zustand: Reglereingang IVCtl_uDiffUp ist unplausibel (zylinderspezifisch)" UBYTE OneToOne 1 100 0.00 255.0 ECU_ADDRESS 0xC000B2A4 /end MEASUREMENT
/begin MEASUREMENT IVCtl_stVltgGovPIHi_mp "Zylinderspezifischer Zustand: Ausgang des Aktorspannunsreglers überschreitet Grenzwert" UBYTE OneToOne 1 100 0.00 255.0 ECU_ADDRESS 0xC000B2A5 /end MEASUREMENT
/begin MEASUREMENT IVCtl_stVltgGovPILo_mp "Zylinderspezifischer Zustand: PI-Regler der Aktorspannungsregelung ist am oberen Anschlag" UBYTE OneToOne 1 100 0.00 255.0 ECU_ADDRESS 0xC000B2A6 /end MEASUREMENT
/begin MEASUREMENT IVCtl_tiChrg "Soll-Ladezeit" SWORD InjTime_us 1 100 0.00 5000.0000 ECU_ADDRESS 0xD0000C64 /end MEASUREMENT
/begin MEASUREMENT IVCtl_tiDiff "Eingang des Entladezeitreglers" SWORD InjTime_us 1 100 -13107.20 5000.00 ARRAY_SIZE 6 ECU_ADDRESS 0xD0000C66 /end MEASUREMENT
/begin MEASUREMENT IVCtl_tiDisCh "Soll-Entladezeit" SWORD InjTime_us 1 100 0.00 5000.0000 ECU_ADDRESS 0xD0000C72 /end MEASUREMENT
/begin MEASUREMENT IVCtl_tiPseChrg "Ladepuls-Pausezeit" SWORD Time_PzoChrgPse 1 100 2.000000 20.00000 FORMAT "%8.5" ECU_ADDRESS 0xD0000C74 /end MEASUREMENT
/begin MEASUREMENT IVCtl_tiPseDisCh "Entladestrompuls Pausezeit" SWORD Time_PzoChrgPse 1 100 2.000000 20.00000 FORMAT "%8.5" ECU_ADDRESS 0xD0000C76 /end MEASUREMENT
/begin MEASUREMENT IVCtl_tiStrt_mp "Zeit ""Motorstart verzögert""" SWORD Time_ms 1 100 -327680.0 327670.0 ECU_ADDRESS 0xC000A386 /end MEASUREMENT
/begin MEASUREMENT IVCtl_tiTGovCalc "Zeitstempel: Letzte Berechnung des Entladezeitreglers" ULONG Time_PzoMeas 1 100 0.00 234505214.307 FORMAT "%13.3" ARRAY_SIZE 6 ECU_ADDRESS 0xD00031BC /end MEASUREMENT
/begin MEASUREMENT IVCtl_tiVltgGovCalc "Zeitstempel: Letzte Berechnung des Spannungsreglers" ULONG Time_PzoMeas 1 100 0.00 234505214.307 FORMAT "%13.3" ARRAY_SIZE 6 ECU_ADDRESS 0xD00031D4 /end MEASUREMENT
/begin MEASUREMENT IVCtl_uChrgMapIn_mp "Eingang für IVCtl_iChrg_MAP" SWORD Vltg_PA 1 100 -327.6800 327.6700 ECU_ADDRESS 0xC000A37E /end MEASUREMENT
/begin MEASUREMENT IVCtl_uChrgUp_mp "Sollspannung nach dem Laden" SWORD Vltg_PA 1 100 -327.6800 327.6700 ARRAY_SIZE 6 ECU_ADDRESS 0xC000C264 /end MEASUREMENT
/begin MEASUREMENT IVCtl_uCorPI "Ausgang des Aktorspannungsreglers" SWORD Vltg_PA 1 100 -327.6800 327.6700 ARRAY_SIZE 6 ECU_ADDRESS 0xD0000C78 /end MEASUREMENT
/begin MEASUREMENT IVCtl_uCorPIUnLim_mp "Unbegrenzter Reglerausgang des PI-Reglers der Aktorspannungsregelung" SWORD Vltg_PA 1 100 -327.6800 327.6700 ARRAY_SIZE 6 ECU_ADDRESS 0xC000C294 /end MEASUREMENT
/begin MEASUREMENT IVCtl_uCorPreCtl_mp "Vorsteuerspannung" SWORD Vltg_PA 1 100 -327.6800 327.6700 ARRAY_SIZE 6 ECU_ADDRESS 0xC000C270 /end MEASUREMENT
/begin MEASUREMENT IVCtl_uDiffUp "Eingang des Aktorspannungsreglers" SWORD Vltg_PA 1 100 -327.6800 327.6700 ARRAY_SIZE 6 ECU_ADDRESS 0xD0000C84 /end MEASUREMENT
/begin MEASUREMENT IVCtl_uUp "Spannungssollwert Up-Niveau" SWORD Vltg_PA 1 100 -327.6800 327.6700 ARRAY_SIZE 6 ECU_ADDRESS 0xD0000C92 /end MEASUREMENT
/begin MEASUREMENT IVCtl_uUpMapIn_mp "Eingangsgröße für IVCtl_iDisCh_MAP" SWORD Vltg_PA 1 100 -327.6800 327.6700 ECU_ADDRESS 0xC000A37C /end MEASUREMENT
/begin MEASUREMENT IVCtl_uUpOBDMax_mp "Obere OBD-Grenze der Up-Spannungsüberwachung" SWORD Vltg_PA 1 100 -327.6800 327.6700 ECU_ADDRESS 0xC000A380 /end MEASUREMENT
/begin MEASUREMENT IVCtl_uUpOBDMin_mp "Untere OBD-Grenze der Up-Spannungsüberwachung" SWORD Vltg_PA 1 100 -327.6800 327.6700 ECU_ADDRESS 0xC000A382 /end MEASUREMENT
/begin MEASUREMENT IVCtl_uUpStrt "Startspannung des Piezoaktors" SWORD Vltg_PA 1 100 0.00 210.0000 ECU_ADDRESS 0xD0000C90 /end MEASUREMENT
/begin MEASUREMENT IVCtl_uUpUnCor_mp "Unkorrigierter Spannungssollwert Up-Niveau" SWORD Vltg_PA 1 100 -327.6800 327.6700 ARRAY_SIZE 6 ECU_ADDRESS 0xC000C27C /end MEASUREMENT
/begin MEASUREMENT IVCtl_uUpUnLim_mp "Unbegrenzter Spannungssollwert Up-Niveau" SWORD Vltg_PA 1 100 -327.6800 327.6700 ARRAY_SIZE 6 ECU_ADDRESS 0xC000C288 /end MEASUREMENT
/begin MEASUREMENT IVDia_numTstLeft_mp "Anzahl der noch verbleibenden Ansteuerungen für IVDia_Tst" SWORD OneToOne 1 100 -32768.00 32767.00 ECU_ADDRESS 0xC000A38A /end MEASUREMENT
/begin MEASUREMENT IVDia_st "Botschaft zur Erkennung von mehrfachem Lastabfall" UBYTE OneToOne 1 100 0.00 255.0 ECU_ADDRESS 0xD0001EC5 /end MEASUREMENT
/begin MEASUREMENT IVDia_stChkShCirChSwt "Zustand der Ladeschalterkurzschlusserkennung" UBYTE OneToOne 1 100 0.00 255.0 ECU_ADDRESS 0xD0001EC6 /end MEASUREMENT
/begin MEASUREMENT IVDia_stClctComplInvldCyl_mp "Bit des vollständigen Diagnose-Information ist ungültig" UWORD OneToOne 1 100 0.00 65535.00 ARRAY_SIZE 6 ECU_ADDRESS 0xC000C2A0 /end MEASUREMENT
/begin MEASUREMENT IVDia_stDFCPtt_mp "Fehlerart, die in DFC-Patten zugeführt wird" UWORD OneToOne 1 100 0.00 65535.00 ARRAY_SIZE 6 ECU_ADDRESS 0xC000C2AC /end MEASUREMENT
/begin MEASUREMENT IVDia_stErrClctChp_mp "Versammelte Chip-Fehler" UBYTE OneToOne 1 100 0.00 255.0 ARRAY_SIZE 1 ECU_ADDRESS 0xC000C2B8 /end MEASUREMENT
/begin MEASUREMENT IVDia_stErrClctComplCyl_mp "Vollständige lowlevel Fehlermeldung für CY33x vorverarbeitet pro Zylinder" UWORD OneToOne 1 100 0.00 65535.00 ARRAY_SIZE 6 ECU_ADDRESS 0xC000C2BA /end MEASUREMENT
/begin MEASUREMENT IVDia_stErrClctPsIcCyl_mp "Messpunkt des Fehlermusters, der sammelt die Fehler aus Diagnoseregister" UWORD OneToOne 1 100 0.00 65535.00 ARRAY_SIZE 6 ECU_ADDRESS 0xC000C2C6 /end MEASUREMENT
/begin MEASUREMENT IVDia_stErrCyl_mp "Zylinderspezifische Diagnoseinformation" UBYTE OneToOne 1 100 0.00 255.0 ARRAY_SIZE 6 ECU_ADDRESS 0xC000C2D2 /end MEASUREMENT
/begin MEASUREMENT IVDia_stOnlyNeedPsIc_mp "Messpunkt eines Bitleisters, der den Fehlermuster welche nur durch Fehler des Diagnoseregisters erkannt werden können." UWORD OneToOne 1 100 0.00 65535.00 ECU_ADDRESS 0xC000A388 /end MEASUREMENT
/begin MEASUREMENT IVDia_stPsIcChp "Chipspezifisch Diagnose-Information der SPI-Übertragung und SPI Control-Byte" UWORD OneToOne 1 100 0.00 65535.00 ARRAY_SIZE 1 ECU_ADDRESS 0xD00015D4 /end MEASUREMENT
/begin MEASUREMENT IVDia_stPsIcCyl "Cylinderspezifische Diagnoseinformation aus PsIc Diagnose-Register" UBYTE OneToOne 1 100 0.00 255.0 ARRAY_SIZE 6 ECU_ADDRESS 0xD0001EC7 /end MEASUREMENT
/begin MEASUREMENT IVDia_stRlsErrRecgCompl_mp "Freegabe der vollständige Fehlererkannung" UWORD OneToOne 1 100 0.00 65535.00 ARRAY_SIZE 6 ECU_ADDRESS 0xC000C2D8 /end MEASUREMENT
/begin MEASUREMENT IVDia_stRlsErrRecgPsIc_mp "Freegabe der Fehlererkannung, die nur von PsIc-Diagnoseinformation abhängig ist." UWORD OneToOne 1 100 0.00 65535.00 ARRAY_SIZE 6 ECU_ADDRESS 0xC000C2E4 /end MEASUREMENT
/begin MEASUREMENT IVDia_stShCirChSwt "Zustand: Ladeschalterkurzschluss erkannt" UBYTE OneToOne 1 100 0.00 255.0 ECU_ADDRESS 0xD0001ECD /end MEASUREMENT
/begin MEASUREMENT IVDia_stTst "Zustand des Kurzschluss- und Lastabfalltests" UBYTE OneToOne 1 100 0.00 255.0 ECU_ADDRESS 0xD0001ECE /end MEASUREMENT
/begin MEASUREMENT IVDia_stTstActv "Zustand: Anforderung für den Kurzschluss- und Lastabfalltest" UBYTE OneToOne 1 100 0.00 255.0 ECU_ADDRESS 0xD0001ECF /end MEASUREMENT
/begin MEASUREMENT IVDia_stTstBnkShCir "Zustand: IVDia_Tst hat auf Kurzschluss auf der angegebenen Bank erkannt" UBYTE OneToOne 1 100 0.00 255.0 ECU_ADDRESS 0xD0001ED0 /end MEASUREMENT
/begin MEASUREMENT IVDia_stTstBnkShCirChSwt "Zustand: IVDia_Tst hat Ladeschalterkurzschluss auf der angegebenen Bank erkannt" UBYTE OneToOne 1 100 0.00 255.0 ECU_ADDRESS 0xD0001ED1 /end MEASUREMENT
/begin MEASUREMENT IVDia_stTstChp "Zustand: IVDia_Tst hat Fehler auf dem angegebenen Endstufenbaustein erkannt" UBYTE OneToOne 1 100 0.00 255.0 ECU_ADDRESS 0xD0001ED2 /end MEASUREMENT
/begin MEASUREMENT IVDia_stTstCylNoCls "Zustand: IVDia_Tst hat einen nicht klassifizierbaren Fehler auf dem angegebenen Zylinder erkannt" UBYTE OneToOne 1 100 0.00 255.0 ECU_ADDRESS 0xD0001ED3 /end MEASUREMENT
/begin MEASUREMENT IVDia_stTstCylNoLd "Zustand: IVDia_Tst hat auf Lastabfall erkannt (zylinderspezifisch)" UBYTE OneToOne 1 100 0.00 255.0 ECU_ADDRESS 0xD0001ED4 /end MEASUREMENT
/begin MEASUREMENT IVDia_stTstCylShCir "Zustand: IVDia_Tst hat einen Kurzschluss auf dem angegebenen Zylinder erkannt" UBYTE OneToOne 1 100 0.00 255.0 ECU_ADDRESS 0xD0001ED5 /end MEASUREMENT
/begin MEASUREMENT IVDia_stTstCylShCirHSLS "Zustand: IVDia_Tst hat Highside-Lowside Kurzschluss auf dem angegebenen Zylinder erkannt" UBYTE OneToOne 1 100 0.00 255.0 ECU_ADDRESS 0xD0001ED6 /end MEASUREMENT
/begin MEASUREMENT IVDia_stTstCylShCirMeas "Zustand: IVDia_Tst hat einen Kurzschluss auf dem angegebenen Zylinder erkannt (auf Grund gemessener Aktorspannung)" UBYTE OneToOne 1 100 0.00 255.0 ECU_ADDRESS 0xD0001ED7 /end MEASUREMENT
/begin MEASUREMENT IVDia_stTstInjErr_mp "Zustand: Fehler bei der Programmierung einer Ansteuerung für den Kurzschluss- und Lastabfalltest (zylinderspezifisch)" UBYTE OneToOne 1 100 0.00 255.0 ECU_ADDRESS 0xC000B2A7 /end MEASUREMENT
/begin MEASUREMENT IVDia_stTstInjOK_mp "Zustand: Erfolgreiche Programmierung einer Ansteuerung für den Kurzschluss- und Lastabfalltest (zylinderspezifisch)" UBYTE OneToOne 1 100 0.00 255.0 ECU_ADDRESS 0xC000B2A8 /end MEASUREMENT
/begin MEASUREMENT IVDia_stTstPreCond_mp "Zustand: Freigabebedingungen für IVDia_Tst" UBYTE OneToOne 1 100 0.00 255.0 ECU_ADDRESS 0xC000B2A9 /end MEASUREMENT
/begin MEASUREMENT IVDia_stUPlausBnk "Bankspezifische Spannungsplausibilität-Statusmessages" UBYTE OneToOne 1 100 0.00 255.0 ARRAY_SIZE 2 ECU_ADDRESS 0xD0001ED8 /end MEASUREMENT
/begin MEASUREMENT IVDia_stUPlausCyl "Zylinderspezifische Spannungsplausibilität-Statusmessage der Aktorspannungsmessung" UBYTE OneToOne 1 100 0.00 255.0 ARRAY_SIZE 6 ECU_ADDRESS 0xD0001EDA /end MEASUREMENT
/begin MEASUREMENT IVDia_stUTunDet "" UBYTE OneToOne 1 100 0.00 255.0 ARRAY_SIZE 6 ECU_ADDRESS 0xD0001EE0 /end MEASUREMENT
/begin MEASUREMENT IVDia_uThres_mp "Schwelle der Plausibilitätprüfung" SWORD Vltg_PA 1 100 -327.6800 327.6700 ARRAY_SIZE 3 ECU_ADDRESS 0xC000C2F0 /end MEASUREMENT
/begin MEASUREMENT IVPlaus_cntNSyncS0_mp "interner Zähler für den statischen Interrupt" UBYTE OneToOne 1 100 0.00 255.0 ECU_ADDRESS 0xC000B2AD /end MEASUREMENT
/begin MEASUREMENT IVPlaus_cntNSyncS1_mp "interner Zähler für den dynamischen Interrupt" UBYTE OneToOne 1 100 0.00 255.0 ECU_ADDRESS 0xC000B2AE /end MEASUREMENT
/begin MEASUREMENT IVPlaus_nCyl "zylinderselektive Drehzahl" SWORD EngN 1 100 -16384.00 16383.50 ARRAY_SIZE 6 ECU_ADDRESS 0xD0000CA6 /end MEASUREMENT
/begin MEASUREMENT IVPlaus_nEngDiffComprTst "Mittlerer Drehzahlabweichung über 2 Motorzyklen" SWORD EngN 1 100 -16384.00 16383.50 ECU_ADDRESS 0xD0000CB2 /end MEASUREMENT
/begin MEASUREMENT IVPlaus_nEngDiffComprTst_mp "Mittlere Drehzahlabweichung über 2 Motorzyklen" SWORD EngN 1 100 -16384.00 16383.50 ECU_ADDRESS 0xC000A38C /end MEASUREMENT
/begin MEASUREMENT IVPlaus_nMinComprTst "Minimale Motordrehzahl für den Kompressionstest" SWORD EngN 1 100 -16384.00 16383.50 ECU_ADDRESS 0xD0000CBC /end MEASUREMENT
/begin MEASUREMENT IVPlaus_numMn2PrevTDCComprTst_mp "Anzahl der TDC für Winkelintervall vor TDC" UBYTE OneToOne 1 100 0.00 255.0 ECU_ADDRESS 0xC000B2AA /end MEASUREMENT
/begin MEASUREMENT IVPlaus_numPi2PrevTDCComprTst_mp "Anzahl von TDC's für Wiinkelintervall nach TDC" UBYTE OneToOne 1 100 0.00 255.0 ECU_ADDRESS 0xC000B2AB /end MEASUREMENT
/begin MEASUREMENT IVPlaus_phiMn2PrevTDCComprTst_mp "Winkelintervall vor TDC" SWORD AngleCrS 1 100 -720.0000 719.9780 ECU_ADDRESS 0xC000A38E /end MEASUREMENT
/begin MEASUREMENT IVPlaus_phiPi2PrevTDCComprTst_mp "Winkelintervall nach TDC" SWORD AngleCrS 1 100 -720.0000 719.9780 ECU_ADDRESS 0xC000A390 /end MEASUREMENT
/begin MEASUREMENT IVPlaus_phiPreTDCComprTst1 "frühester Winkel vor TDC" SWORD AngleCrS 1 100 -720.0000 719.9780 ECU_ADDRESS 0xD0000CCA /end MEASUREMENT
/begin MEASUREMENT IVPlaus_phiPreTDCComprTst2 "spätester Winkel vor TDC" SWORD AngleCrS 1 100 -720.0000 719.9780 ECU_ADDRESS 0xD0000CCC /end MEASUREMENT
/begin MEASUREMENT IVPlaus_phiPstTDCComprTst3 "frühester Winkel nach TDC" SWORD AngleCrS 1 100 -720.0000 719.9780 ECU_ADDRESS 0xD0000CCE /end MEASUREMENT
/begin MEASUREMENT IVPlaus_phiPstTDCComprTst4 "spätester Winkel nach TDC" SWORD AngleCrS 1 100 -720.0000 719.9780 ECU_ADDRESS 0xD0000CD0 /end MEASUREMENT
/begin MEASUREMENT IVPlaus_qFBCCyl "zylinderselektive Mengenkorrektur des Laufruhereglers" SWORD InjMass 1 100 -327.6800 327.6700 ARRAY_SIZE 6 ECU_ADDRESS 0xD0000CD2 /end MEASUREMENT
/begin MEASUREMENT IVPlaus_stEffectComprTst "Statusbits für Eingriffe in andere Funktionsmodule" UBYTE OneToOne 1 100 0.00 255.0 ECU_ADDRESS 0xD0001EF9 /end MEASUREMENT
/begin MEASUREMENT IVPlaus_stRefComprTst "Statusbitleiste für einen abgebrochenen Kompressionstest" UWORD OneToOne 1 100 0.00 65535.00 ECU_ADDRESS 0xD00015DC /end MEASUREMENT
/begin MEASUREMENT IVPlaus_stStMNSyncComprTst "Status des Zustandsautomaten des Kompressionstests drehzahlsynchron" UBYTE OneToOne 1 100 0.00 255.0 ECU_ADDRESS 0xD0001EFB /end MEASUREMENT
/begin MEASUREMENT IVPlaus_stStMTSyncComprTst "Status des Zustandsautomaten des Kompressionstests zeitsynchron" UBYTE OneToOne 1 100 0.00 255.0 ECU_ADDRESS 0xD0001EFD /end MEASUREMENT
/begin MEASUREMENT IVPlaus_swtSrcPSComprTst_mp "Messpunkt für Schalterstellung welcher Datensatz benutzt wird (vom Tester bzw. aus der ECU)" UBYTE OneToOne 1 100 0.00 255.0 ECU_ADDRESS 0xC000B2AC /end MEASUREMENT
/begin MEASUREMENT IVPlaus_tiEvalComprTst_mp "Laufzeit des Kompressionstest" SLONG Time_ms 1 100 -21474836480.0 21474836470.0 ECU_ADDRESS 0xC00090B4 /end MEASUREMENT
/begin MEASUREMENT IVPlaus_tiPreTDCComprTst "Array der gemessenen Zeiten zwischen den Winkeln vor TDC" SLONG OneToOne_us 1 100 -2147483648.00 2147483647.00 FORMAT "%13.2" ARRAY_SIZE 6 ECU_ADDRESS 0xD0002EEC /end MEASUREMENT
/begin MEASUREMENT IVPlaus_tiPstTDCComprTst "Array von gemessenen Zeiten zwischen den programmierten Winkeln nach TDC" SLONG OneToOne_us 1 100 -2147483648.00 2147483647.00 FORMAT "%13.2" ARRAY_SIZE 6 ECU_ADDRESS 0xD0002F04 /end MEASUREMENT
/begin MEASUREMENT I_genipol1 "Invers interpolierte Generatorstrom 1. Kennfeld" SWORD Def_i_sw_q0p125 1 100 -4096.000 4095.875 FORMAT "%8.3" ECU_ADDRESS 0xC000A302 /end MEASUREMENT
/begin MEASUREMENT I_genipol2 "Invers interpolierte Generatorstrom 2. Kennfeld" SWORD Def_i_sw_q0p125 1 100 -4096.000 4095.875 FORMAT "%8.3" ECU_ADDRESS 0xC000A304 /end MEASUREMENT
/begin MEASUREMENT I_genipol3 "Invers interpolierte Generatorstrom 3. Kennfeld" SWORD Def_i_sw_q0p125 1 100 -4096.000 4095.875 FORMAT "%8.3" ECU_ADDRESS 0xC000A306 /end MEASUREMENT
/begin MEASUREMENT Loadresp "Loadresponse Zeit aus Kennfeldrechnung (alte Version)" UBYTE Def_td_ub_q0p1 1 100 0.00 25.5 FORMAT "%4.1" ECU_ADDRESS 0xC000B27E /end MEASUREMENT
/begin MEASUREMENT Mdkw_grenz "Begrenzungsmoment für Generator" SWORD Def_m_sw_q0p1 1 100 -3276.80 3276.70 FORMAT "%7.2" ECU_ADDRESS 0xC000A2EE /end MEASUREMENT
/begin MEASUREMENT Mdkw_grenz_dyn "Maximalmoment Generator" SWORD Def_m_sw_q0p1 1 100 -3276.80 3276.70 FORMAT "%7.2" ECU_ADDRESS 0xC000A2DC /end MEASUREMENT
/begin MEASUREMENT Mdkw_grenz_stat "Stationäres Generatorbegrenzungsmoment" SWORD Def_m_sw_q0p1 1 100 -3276.80 3276.70 FORMAT "%7.2" ECU_ADDRESS 0xC000A352 /end MEASUREMENT
/begin MEASUREMENT Mdkw_rest "Restmoment an der Kurbelwelle" SWORD Def_m_sw_q0p1 1 100 -3276.80 3276.70 FORMAT "%7.2" ECU_ADDRESS 0xC000A30A /end MEASUREMENT
/begin MEASUREMENT Md_dmm "Delta Moment pro Rechenraster für Generatorgrenzmoment" SWORD Def_m_sw_q0p01 1 100 -327.680 327.670 FORMAT "%7.3" ECU_ADDRESS 0xC000A2DE /end MEASUREMENT
/begin MEASUREMENT Md_entlsoll "Sollentlastungsmoment Generator" SWORD Def_m_sw_q0p1 1 100 -3276.80 3276.70 FORMAT "%7.2" ECU_ADDRESS 0xC000A354 /end MEASUREMENT
/begin MEASUREMENT Md_entlsoll1 "Sollentlastungsmoment bei NA Überlast" SWORD Def_m_sw_q0p1 1 100 -3276.80 3276.70 FORMAT "%7.2" ECU_ADDRESS 0xC000A30C /end MEASUREMENT
/begin MEASUREMENT Md_entlsoll2 "Sollentlastungsmoment Generator im Start" SWORD Def_m_sw_q0p1 1 100 -3276.80 3276.70 FORMAT "%7.2" ECU_ADDRESS 0xC000A2FE /end MEASUREMENT
/begin MEASUREMENT Md_entlsoll4 "Sollentlastungsmoment bei Rennstart" SWORD Def_m_sw_q0p1 1 100 -3276.80 3276.70 FORMAT "%7.2" ECU_ADDRESS 0xC000A332 /end MEASUREMENT
/begin MEASUREMENT Md_entlsollkk "Sollentlastungsmoment für Klimakompressor" SWORD Def_m_sw_q0p1 1 100 -3276.80 3276.70 FORMAT "%7.2" ECU_ADDRESS 0xC000A30E /end MEASUREMENT
/begin MEASUREMENT Md_gennmgg "Generatormoment gefiltert für GEN_GRENZ" SWORD Def_m_sw_q0p1 1 100 -3276.80 3276.70 FORMAT "%7.2" ECU_ADDRESS 0xC000A2E0 /end MEASUREMENT
/begin MEASUREMENT Md_gennmnofil "Generatormoment ungefiltert" SWORD Def_m_sw_q0p1 1 100 -3276.80 3276.70 FORMAT "%7.2" ECU_ADDRESS 0xC000A2E2 /end MEASUREMENT
/begin MEASUREMENT Md_get_ipm "Getriebeverlustmoment" SWORD Def_m_sw_q0p1 1 100 -3276.80 3276.70 FORMAT "%7.2" ECU_ADDRESS 0xC000A310 /end MEASUREMENT
/begin MEASUREMENT Md_grenz_int "Generatorgrenzmoment aus Integration" SWORD Def_m_sw_q0p01 1 100 -327.680 327.670 FORMAT "%7.3" ECU_ADDRESS 0xC000A2E4 /end MEASUREMENT
/begin MEASUREMENT Md_grenz_kor "Korrigiertes Grenzmoment" SWORD Def_m_sw_q0p1 1 100 -3276.80 3276.70 FORMAT "%7.2" ECU_ADDRESS 0xC000A308 /end MEASUREMENT
/begin MEASUREMENT Md_grenz_res "Generatorgrenzmoment aus Addition der Zielreserve" SWORD Def_m_sw_q0p01 1 100 -327.680 327.670 FORMAT "%7.3" ECU_ADDRESS 0xC000A2E6 /end MEASUREMENT
/begin MEASUREMENT Md_gresziel "Zielreserve für Generator BN i.O." SWORD Def_m_sw_q0p01 1 100 -327.680 327.670 FORMAT "%7.3" ECU_ADDRESS 0xC000A2E8 /end MEASUREMENT
/begin MEASUREMENT Md_greszielkorr "Korrigierte Zielreserve für Generator" SWORD Def_m_sw_q0p01 1 100 -327.680 327.670 FORMAT "%7.3" ECU_ADDRESS 0xC000A2EA /end MEASUREMENT
/begin MEASUREMENT Md_max_acnaue "Begrenzungsmomente Klimakompressor bei NA Überlast" SWORD Def_m_sw_q0p1 1 100 -3276.80 3276.70 FORMAT "%7.2" ECU_ADDRESS 0xC000A356 /end MEASUREMENT
/begin MEASUREMENT Md_max_klima "Begrenzungsmoment Klimakompressor" SWORD Def_m_sw_q0p1 1 100 -3276.80 3276.70 FORMAT "%7.2" ECU_ADDRESS 0xC000A358 /end MEASUREMENT
/begin MEASUREMENT Md_naars_wcl "Moment, daß das ARS maximal noch aufnehmen kann; bei langsamer Entlastung" SWORD Def_m_sw_q0p1 1 100 -3276.80 3276.70 FORMAT "%7.2" ECU_ADDRESS 0xC000A312 /end MEASUREMENT
/begin MEASUREMENT Md_naars_wcs "Moment, daß das ARS maximal noch aufnehmen kann; bei schneller Entlastung" SWORD Def_m_sw_q0p1 1 100 -3276.80 3276.70 FORMAT "%7.2" ECU_ADDRESS 0xC000A314 /end MEASUREMENT
/begin MEASUREMENT Md_naef_wcl "Moment, daß die EF-Nebenaggregate maximal noch aufnehmen können; bei langsamer Entlastung" SWORD Def_m_sw_q0p1 1 100 -3276.80 3276.70 FORMAT "%7.2" ECU_ADDRESS 0xC000A316 /end MEASUREMENT
/begin MEASUREMENT Md_naef_wcs "Moment, daß die EF-Nebenaggregate maximal noch aufnehmen können; bei schneller Entlastung" SWORD Def_m_sw_q0p1 1 100 -3276.80 3276.70 FORMAT "%7.2" ECU_ADDRESS 0xC000A318 /end MEASUREMENT
/begin MEASUREMENT Md_nagen_wcl "Moment, daß der Generator maximal noch aufnehmen kann; bei langsamer Entlastung" SWORD Def_m_sw_q0p1 1 100 -3276.80 3276.70 FORMAT "%7.2" ECU_ADDRESS 0xC000A31A /end MEASUREMENT
/begin MEASUREMENT Md_nagen_wcs "Moment, daß der Generator maximal noch aufnehmen kann; bei schneller Entlastung" SWORD Def_m_sw_q0p1 1 100 -3276.80 3276.70 FORMAT "%7.2" ECU_ADDRESS 0xC000A31C /end MEASUREMENT
/begin MEASUREMENT Md_nagesverlust "Gesamtverlustmoment der NA inkl. Wandler" SWORD Def_m_sw_q0p1 1 100 -3276.80 3276.70 FORMAT "%7.2" ECU_ADDRESS 0xC000A31E /end MEASUREMENT
/begin MEASUREMENT Md_nagetr_wcl "Moment, daß das Getriebe maximal noch aufnehmen kann; bei langsamer Entlastung" SWORD Def_m_sw_q0p1 1 100 -3276.80 3276.70 FORMAT "%7.2" ECU_ADDRESS 0xC000A320 /end MEASUREMENT
/begin MEASUREMENT Md_nagetr_wcs "Moment, daß das Getriebe maximal noch aufnehmen kann; bei schneller Entlastung" SWORD Def_m_sw_q0p1 1 100 -3276.80 3276.70 FORMAT "%7.2" ECU_ADDRESS 0xC000A322 /end MEASUREMENT
/begin MEASUREMENT Md_nakk_wcl "Moment, daß der Klimakompressor maximal noch aufnehmen kann; bei langsamer Entlastung" SWORD Def_m_sw_q0p1 1 100 -3276.80 3276.70 FORMAT "%7.2" ECU_ADDRESS 0xC000A324 /end MEASUREMENT
/begin MEASUREMENT Md_nakk_wcs "Moment, daß der Klimakompressor maximal noch aufnehmen kannn; bei schneller Entlastung" SWORD Def_m_sw_q0p1 1 100 -3276.80 3276.70 FORMAT "%7.2" ECU_ADDRESS 0xC000A326 /end MEASUREMENT
/begin MEASUREMENT Md_nasl_wcl "Moment, daß die Servolenkung maximal noch aufnehmen kann; bei langsamer Entlastung" SWORD Def_m_sw_q0p1 1 100 -3276.80 3276.70 FORMAT "%7.2" ECU_ADDRESS 0xC000A328 /end MEASUREMENT
/begin MEASUREMENT Md_nasl_wcs "Moment, daß die Servolenkung maximal noch aufnehmen kann; bei schneller Entlastung" SWORD Def_m_sw_q0p1 1 100 -3276.80 3276.70 FORMAT "%7.2" ECU_ADDRESS 0xC000A32A /end MEASUREMENT
/begin MEASUREMENT Md_na_bc "Im best case freigebbares Moment der NA" SWORD Def_m_sw_q0p1 1 100 -3276.80 3276.70 FORMAT "%7.2" ECU_ADDRESS 0xC000A32C /end MEASUREMENT
/begin MEASUREMENT Md_na_bilanzgen "mögliches Entlastungsmoment durch GEN" SWORD Def_m_sw_q0p1 1 100 -3276.80 3276.70 FORMAT "%7.2" ECU_ADDRESS 0xC000A33C /end MEASUREMENT
/begin MEASUREMENT Md_na_bilanzkk "mögliches Entlastungsmoment durch KK" SWORD Def_m_sw_q0p1 1 100 -3276.80 3276.70 FORMAT "%7.2" ECU_ADDRESS 0xC000A33E /end MEASUREMENT
/begin MEASUREMENT Md_na_bilanzl "Md_na_bc + Md_na_wcl" SWORD Def_m_sw_q0p1 1 100 -3276.80 3276.70 FORMAT "%7.2" ECU_ADDRESS 0xC000A340 /end MEASUREMENT
/begin MEASUREMENT Md_na_bilanzs "Md_na_bc + Md_na_wcs" SWORD Def_m_sw_q0p1 1 100 -3276.80 3276.70 FORMAT "%7.2" ECU_ADDRESS 0xC000A342 /end MEASUREMENT
/begin MEASUREMENT Md_na_wcl "Moment, daß die Nebenaggregate maximal noch aufnehmen können; bei langsamer Entlastung" SWORD Def_m_sw_q0p1 1 100 -3276.80 3276.70 FORMAT "%7.2" ECU_ADDRESS 0xC000A32E /end MEASUREMENT
/begin MEASUREMENT Md_na_wcs "Moment, daß die Nebenaggregate maximal noch aufnehmen können; bei schneller Entlastung" SWORD Def_m_sw_q0p1 1 100 -3276.80 3276.70 FORMAT "%7.2" ECU_ADDRESS 0xC000A330 /end MEASUREMENT
/begin MEASUREMENT Md_res_bn "Momentenreserve bei instabilem Bordnetz" SWORD Def_m_sw_q0p1 1 100 -3276.80 3276.70 FORMAT "%7.2" ECU_ADDRESS 0xC000A300 /end MEASUREMENT
/begin MEASUREMENT Md_res_real "Aktuelle Momentenreserve des Motors" SWORD Def_m_sw_q0p1 1 100 -3276.80 3276.70 FORMAT "%7.2" ECU_ADDRESS 0xC000A2EC /end MEASUREMENT
/begin MEASUREMENT Napr_i_appl "priorisierter Ierrgrenz" UWORD Def_dez_uw_q1 1 100 0.00 65535. FORMAT "%5.0" ECU_ADDRESS 0xC000A2F0 /end MEASUREMENT
/begin MEASUREMENT Napr_i_ext "priorisierter Ierrgrenz" UWORD Def_dez_uw_q1 1 100 0.00 65535. FORMAT "%5.0" ECU_ADDRESS 0xC000A2F2 /end MEASUREMENT
/begin MEASUREMENT Napr_i_ht "priorisierter Ierrgrenz" UWORD Def_dez_uw_q1 1 100 0.00 65535. FORMAT "%5.0" ECU_ADDRESS 0xC000A2F4 /end MEASUREMENT
/begin MEASUREMENT Napr_i_ll "priorisierter Ierrgrenz" UWORD Def_dez_uw_q1 1 100 0.00 65535. FORMAT "%5.0" ECU_ADDRESS 0xC000A2F6 /end MEASUREMENT
/begin MEASUREMENT Napr_i_md "priorisierter Ierrgrenz" UWORD Def_dez_uw_q1 1 100 0.00 65535. FORMAT "%5.0" ECU_ADDRESS 0xC000A2F8 /end MEASUREMENT
/begin MEASUREMENT Napr_md_dyn "priorisiertes Generatormoment" ULONG Def_dez_ul_q1 1 100 0.00 4294967295. FORMAT "%7.0" ECU_ADDRESS 0xC0008FBC /end MEASUREMENT
/begin MEASUREMENT Napr_md_stat "priorisiertes Generatormoment" ULONG Def_dez_ul_q1 1 100 0.00 4294967295. FORMAT "%7.0" ECU_ADDRESS 0xC0008FC0 /end MEASUREMENT
/begin MEASUREMENT Napr_sollmn "Priorisierter Erregerstrom aus Sollspannung vom PM" UWORD Def_dez_uw_q1 1 100 0.00 65535. FORMAT "%5.0" ECU_ADDRESS 0xC000A2FA /end MEASUREMENT
/begin MEASUREMENT Napr_spgw "Priorisierter Erregerstrom aus Spannungswächter vom PM" UWORD Def_dez_uw_q1 1 100 0.00 65535. FORMAT "%5.0" ECU_ADDRESS 0xC000A2FC /end MEASUREMENT
/begin MEASUREMENT Pr_entl_soll "Priorität der Spannungsanforderung für Generatorentlastung" UBYTE Def_dez_ub_q1 1 100 0.00 255. FORMAT "%3.0" ECU_ADDRESS 0xC000B295 /end MEASUREMENT
/begin MEASUREMENT Pr_grenz_ist "Aktuelle Priorität Erregerstrombegrenzung" UBYTE Def_dez_ub_q1 1 100 0.00 255. FORMAT "%3.0" ECU_ADDRESS 0xC000B278 /end MEASUREMENT
/begin MEASUREMENT Pr_grenz_md "Priorität Momentenbegrenzung des Generators" UBYTE Def_dez_ub_q1 1 100 0.00 255. FORMAT "%3.0" ECU_ADDRESS 0xC000B279 /end MEASUREMENT
/begin MEASUREMENT Pr_ipmna "Aktuelle Priorität Erregerstrombegrenzung iPM NA" UBYTE Def_dez_ub_q1 1 100 0.00 255. FORMAT "%3.0" ECU_ADDRESS 0xC000B27A /end MEASUREMENT
/begin MEASUREMENT Pr_mddyn "Priorität der Generatordynamikbegrenzung für iGR" UBYTE Def_dez_ub_q1 1 100 0.00 255. FORMAT "%3.0" ECU_ADDRESS 0xC000B274 /end MEASUREMENT
/begin MEASUREMENT Pr_mdfunk "Prio Entlastung wegen Funktion" UBYTE Def_dez_ub_q1 1 100 0.00 255. FORMAT "%3.0" ECU_ADDRESS 0xC000B28E /end MEASUREMENT
/begin MEASUREMENT Pr_mdkomf "Prio Entlastung wegen Komfort" UBYTE Def_dez_ub_q1 1 100 0.00 255. FORMAT "%3.0" ECU_ADDRESS 0xC000B28F /end MEASUREMENT
/begin MEASUREMENT Pr_mdsich "Prio Entlastung wegen Sicherheit" UBYTE Def_dez_ub_q1 1 100 0.00 255. FORMAT "%3.0" ECU_ADDRESS 0xC000B290 /end MEASUREMENT
/begin MEASUREMENT Pr_mdsichkk "Prio Entlastung wegen Sicherheit" UBYTE Def_dez_ub_q1 1 100 0.00 255. FORMAT "%3.0" ECU_ADDRESS 0xC000B291 /end MEASUREMENT
/begin MEASUREMENT Pr_md_entlkk "Priorität der Begrenzung des Klimakompressors" UBYTE Def_dez_ub_q1 1 100 0.00 255. FORMAT "%3.0" ECU_ADDRESS 0xC000B292 /end MEASUREMENT
/begin MEASUREMENT Pr_md_entlsoll "Priorität der Momentenbegrenzung für Generatorentlastung" UBYTE Def_dez_ub_q1 1 100 0.00 255. FORMAT "%3.0" ECU_ADDRESS 0xC000B296 /end MEASUREMENT
/begin MEASUREMENT Pr_md_entlsoll1 "Priorität der Generatorentlastung bei NA Überlast" UBYTE Def_dez_ub_q1 1 100 0.00 255. FORMAT "%3.0" ECU_ADDRESS 0xC000B293 /end MEASUREMENT
/begin MEASUREMENT Pr_md_entlsoll1alt "Priorität der NA Begrenzung im Start (alter Wert)" UBYTE Def_dez_ub_q1 1 100 0.00 255. FORMAT "%3.0" ECU_ADDRESS 0xC000B297 /end MEASUREMENT
/begin MEASUREMENT Pr_md_entlsoll2 "Priorität der Generatorentlastung im Start" UBYTE Def_dez_ub_q1 1 100 0.00 255. FORMAT "%3.0" ECU_ADDRESS 0xC000B27C /end MEASUREMENT
/begin MEASUREMENT Pr_md_entlsoll2alt "Priorität der NA Begrenzung im Start (alter Wert)" UBYTE Def_dez_ub_q1 1 100 0.00 255. FORMAT "%3.0" ECU_ADDRESS 0xC000B298 /end MEASUREMENT
/begin MEASUREMENT Pr_md_entlsoll3alt "Priorität der NA Begrenzung von ELMOTENTL (alter Wert)" UBYTE Def_dez_ub_q1 1 100 0.00 255. FORMAT "%3.0" ECU_ADDRESS 0xC000B299 /end MEASUREMENT
/begin MEASUREMENT Pr_md_entlsoll4 "Prio zur Begrenzung Generatormoment bei Rennstart" UBYTE Def_dez_ub_q1 1 100 0.00 255. FORMAT "%3.0" ECU_ADDRESS 0xC000B28A /end MEASUREMENT
/begin MEASUREMENT St_gengrenz "Statuswort" UBYTE Def_st_ub_q1 1 100 0.00 255. FORMAT "%3.0" ECU_ADDRESS 0xC000B275 /end MEASUREMENT
/begin MEASUREMENT St_genkor "Status Genkor" UBYTE Def_st_ub_q1 1 100 0.00 255. FORMAT "%3.0" ECU_ADDRESS 0xC000B27B /end MEASUREMENT
/begin MEASUREMENT St_ipmnaprae "Status IPMNA_PRAE" UBYTE Def_st_ub_q1 1 100 0.00 255. FORMAT "%3.0" ECU_ADDRESS 0xC000B294 /end MEASUREMENT
/begin MEASUREMENT St_loadresp "Statuswort" UBYTE Def_st_ub_q1 1 100 0.00 255. FORMAT "%3.0" ECU_ADDRESS 0xC000B27F /end MEASUREMENT
/begin MEASUREMENT St_loadresp0 "Statuswort" UBYTE Def_st_ub_q1 1 100 0.00 255. FORMAT "%3.0" ECU_ADDRESS 0xC000B27D /end MEASUREMENT
/begin MEASUREMENT St_loadresp2 "Statuswort" UBYTE Def_st_ub_q1 1 100 0.00 255. FORMAT "%3.0" ECU_ADDRESS 0xC000B280 /end MEASUREMENT
/begin MEASUREMENT St_rennst "Status Rennstart" UBYTE Def_st_ub_q1 1 100 0.00 255. FORMAT "%3.0" ECU_ADDRESS 0xC000B28B /end MEASUREMENT
/begin MEASUREMENT St_statmkor "Statuswort" UBYTE Def_st_ub_q1 1 100 0.00 255. FORMAT "%3.0" ECU_ADDRESS 0xC000B29A /end MEASUREMENT
/begin MEASUREMENT St_statmkor1 "Statuswort" UBYTE Def_st_ub_q1 1 100 0.00 255. FORMAT "%3.0" ECU_ADDRESS 0xC000B29B /end MEASUREMENT
/begin MEASUREMENT Td_afu "Ausschaltverzögerung B_notafu" UWORD Def_td_uw_q0p01 1 100 0.00 655.350 FORMAT "%7.3" ECU_ADDRESS 0xC000A35A /end MEASUREMENT
/begin MEASUREMENT Td_genbvl "Verzögerungszeit Volllast" UWORD Def_td_uw_q0p1 1 100 0.00 6553.5 FORMAT "%6.1" ECU_ADDRESS 0xC000A334 /end MEASUREMENT
/begin MEASUREMENT Td_genofvl "Verzögerungszeit Generatorvolllastabschaltung" UWORD Def_td_uw_q0p1 1 100 0.00 6553.5 FORMAT "%6.1" ECU_ADDRESS 0xC000A336 /end MEASUREMENT
/begin MEASUREMENT Td_getriebe "Entprellzeit Gangwechsel aus N" UBYTE Def_td_ub_q0p01 1 100 0.00 2.550 FORMAT "%5.3" ECU_ADDRESS 0xC000B285 /end MEASUREMENT
/begin MEASUREMENT Td_kkoff "Erlaubte Dauer der KK-Abkopplung aus Pr_mdkomf und Pr_mdfunk" UWORD Def_td_uw_q0p01 1 100 0.00 655.350 FORMAT "%7.3" ECU_ADDRESS 0xC000A344 /end MEASUREMENT
/begin MEASUREMENT Td_kkoff_sich "Erlaubte Dauer der KK-Abkopplung" UWORD Def_td_uw_q0p01 1 100 0.00 655.350 FORMAT "%7.3" ECU_ADDRESS 0xC000A346 /end MEASUREMENT
/begin MEASUREMENT Td_mdent_funkres "Verzögerungszeit" UWORD Def_td_uw_q0p01 1 100 0.00 655.350 FORMAT "%7.3" ECU_ADDRESS 0xC000A348 /end MEASUREMENT
/begin MEASUREMENT Td_mdent_kkres "Verzögerungszeit" UWORD Def_td_uw_q0p01 1 100 0.00 655.350 FORMAT "%7.3" ECU_ADDRESS 0xC000A34A /end MEASUREMENT
/begin MEASUREMENT Td_mdent_komfres "Verzögerungszeit" UWORD Def_td_uw_q0p01 1 100 0.00 655.350 FORMAT "%7.3" ECU_ADDRESS 0xC000A34C /end MEASUREMENT
/begin MEASUREMENT Td_mdent_komfset "Verzögerungszeit" UWORD Def_td_uw_q0p01 1 100 0.00 655.350 FORMAT "%7.3" ECU_ADDRESS 0xC000A34E /end MEASUREMENT
/begin MEASUREMENT Td_mdent_sichres "Verzögerungszeit" UWORD Def_td_uw_q0p01 1 100 0.00 655.350 FORMAT "%7.3" ECU_ADDRESS 0xC000A350 /end MEASUREMENT
/begin MEASUREMENT Td_renn "Verzögerungszeit Rennstartbereitschaft" UWORD Def_td_uw_q0p1 1 100 0.00 6553.5 FORMAT "%6.1" ECU_ADDRESS 0xC000A338 /end MEASUREMENT
/begin MEASUREMENT Tlrgen "Sollwert Load- Response- Zeit Generator" UBYTE Def_td_ub_q0p1 1 100 0.00 25.5 FORMAT "%4.1" ECU_ADDRESS 0xC000B281 /end MEASUREMENT
/begin MEASUREMENT Tlrgen2 "Sollwert Load- Response- Zeit Generator2" UBYTE Def_td_ub_q0p1 1 100 0.00 25.5 FORMAT "%4.1" ECU_ADDRESS 0xC000B282 /end MEASUREMENT
/begin MEASUREMENT T_mdnal "Zeit bis Momentenentlastung greift" UBYTE Def_t_ub_b2 1 100 0.00 1.9922 ECU_ADDRESS 0xC000B286 /end MEASUREMENT
/begin MEASUREMENT T_mdnas "Zeit bis Momentenentlastung greift" UBYTE Def_t_ub_b2 1 100 0.00 1.9922 ECU_ADDRESS 0xC000B287 /end MEASUREMENT
/begin MEASUREMENT T_renn_akt "Zeit in der der Rennstart aktiv ist" UWORD Def_td_uw_q0p1 1 100 0.00 6553.5 FORMAT "%6.1" ECU_ADDRESS 0xC000A33A /end MEASUREMENT
/begin MEASUREMENT T_v_renn "Zeit die von B_bls == true bis V != 0 vergehen darf" UBYTE Def_td_ub_q0p1 1 100 0.00 25.5 FORMAT "%4.1" ECU_ADDRESS 0xC000B28C /end MEASUREMENT
/begin MEASUREMENT U_entl_soll "Spannungsanforderung für Generatorentlastung" UBYTE Def_u_ub_q0p1 1 100 0.00 25.50 FORMAT "%5.2" ECU_ADDRESS 0xC000B29C /end MEASUREMENT
/begin MEASUREMENT Var_afs "Variante AFS" UBYTE Def_dez_ub_q1 1 100 0.00 255. FORMAT "%3.0" ECU_ADDRESS 0xC000B288 /end MEASUREMENT
/begin MEASUREMENT Var_ars "Variante ARS" UBYTE Def_dez_ub_q1 1 100 0.00 255. FORMAT "%3.0" ECU_ADDRESS 0xC000B289 /end MEASUREMENT
/begin MEASUREMENT Zr_rennstart "Zähler Rennstart" UBYTE Def_dez_ub_q1 1 100 0.00 255. FORMAT "%3.0" ECU_ADDRESS 0xC000B28D /end MEASUREMENT
/begin MEASUREMENT Z_dmdblock "Kein Langbezeichner vergeben" UBYTE Def_dez_ub_q1 1 100 0.00 255. FORMAT "%3.0" ECU_ADDRESS 0xC000B283 /end MEASUREMENT
/begin FUNCTION InjVlv_ZFCETCor ""
 /begin DEF_CHARACTERISTIC InjVlv_pRailZFCETCor_AXIS InjVlv_pRailZFCETPoICor_AXIS InjVlv_qZFCETCor_AXIS InjVlv_qZFCETPoI1Cor_AXIS InjVlv_qZFCETPoI2Cor_AXIS InjVlv_rZFCETDif0_GMAP InjVlv_rZFCETDif1_GMAP InjVlv_rZFCETDif2_GMAP InjVlv_rZFCETDif3_GMAP InjVlv_rZFCETDif4_GMAP InjVlv_rZFCETDif5_GMAP InjVlv_rZFCETDif6_GMAP InjVlv_rZFCETMsk_GMAP InjVlv_rZFCETPoI1CorPos_C InjVlv_rZFCETPoI1Dif0_GMAP InjVlv_rZFCETPoI1Dif1_GMAP InjVlv_rZFCETPoI1Dif2_GMAP InjVlv_rZFCETPoI1Dif3_GMAP InjVlv_rZFCETPoI1Dif4_GMAP InjVlv_rZFCETPoI1Dif5_GMAP InjVlv_rZFCETPoI1Dif6_GMAP InjVlv_rZFCETPoI1Msk_GMAP InjVlv_rZFCETPoI2CorPos_C InjVlv_rZFCETPoI2Dif0_GMAP InjVlv_rZFCETPoI2Dif1_GMAP InjVlv_rZFCETPoI2Dif2_GMAP InjVlv_rZFCETPoI2Dif3_GMAP InjVlv_rZFCETPoI2Dif4_GMAP InjVlv_rZFCETPoI2Dif5_GMAP InjVlv_rZFCETPoI2Dif6_GMAP InjVlv_rZFCETPoI2Msk_GMAP InjVlv_stInputZFCETGMap_C InjVlv_stZFCETCorActv_C InjVlv_swtZFCCorOvrRunOn_C InjVlv_tiZFCETCorMax_C InjVlv_tiZFCETCorMin_C /end DEF_CHARACTERISTIC
 /begin IN_MEASUREMENT MoFOvR_stActvMsg RailP_pCurr_mp /end IN_MEASUREMENT
 /begin OUT_MEASUREMENT InjVlv_rZFCETPoI1CoeffMsk InjVlv_rZFCETPoI2CoeffMsk /end OUT_MEASUREMENT
 /begin LOC_MEASUREMENT InjVlv_qInZFCETGMap_mp InjVlv_rZFCETCoeffDif_mp InjVlv_rZFCETCoeffMsk_mp InjVlv_rZFCETPoI1CoeffDif_mp InjVlv_rZFCETPoI2CoeffDif_mp InjVlv_tiPiI1ZFCETCor_mp InjVlv_tiPiI2ZFCETCor_mp InjVlv_tiPiI3ZFCETCor_mp InjVlv_tiPoI1ZFCETCor_mp InjVlv_tiPoI2ZFCETCor_mp /end LOC_MEASUREMENT
/end FUNCTION
/begin FUNCTION ipmna_dynkor ""
 /begin DEF_CHARACTERISTIC KL_DMD_MAX1 KL_DMD_MAX2 KL_MDZIEL KL_MDZIELIERR K_DMDGEN_FAK K_DMDGEN_OFF K_GENGCALC K_IERRHYSMAX K_IERRHYSMN K_MDGENGGFIL K_NKW_SCH K_PR_MDDYN S_MDWAHLGG /end DEF_CHARACTERISTIC
 /begin IN_MEASUREMENT Ierr Nkw /end IN_MEASUREMENT
 /begin OUT_MEASUREMENT Dmd_gen Dmd_gen_kor Ierrdiff Mdkw_grenz_dyn Md_dmm Md_gennmgg Md_gennmnofil Md_grenz_int Md_grenz_res Md_gresziel Md_greszielkorr Md_res_real Pr_mddyn St_gengrenz /end OUT_MEASUREMENT
/end FUNCTION
/begin FUNCTION ipmna_genkor "" /begin DEF_CHARACTERISTIC K_IERRGRENZ_APPL K_PR_IERRAPPL K_PR_IERRTESTER S_IPMNA_AN /end DEF_CHARACTERISTIC
 /begin OUT_MEASUREMENT Ierrgrenz Ierrgrenz_ext Mdkw_grenz Napr_i_appl Napr_i_ext Napr_i_ht Napr_i_ll Napr_i_md Napr_md_dyn Napr_md_stat Napr_sollmn Napr_spgw Pr_grenz_ist Pr_grenz_md Pr_ipmna St_genkor /end OUT_MEASUREMENT
/end FUNCTION
/begin FUNCTION ipmna_genstoff ""
 /begin DEF_CHARACTERISTIC KF_ZLRESOF KF_ZLRRESOFV K_ENAPPLGOFF K_FHOGNMN K_MDENTLSOLL2 K_NMXGENOF K_PR_GENSTOFF K_RLMXGENOF K_TABSTGNMN K_TABSTGNMX K_TATMGENOF K_TDGENOFFST K_TMOTABGNMN K_TUMGGNMN K_TUMGGNMX K_VZLORESOFV S_LORESLL /end DEF_CHARACTERISTIC
 /begin IN_MEASUREMENT Km_st Tmot_start /end IN_MEASUREMENT
 /begin OUT_MEASUREMENT Md_entlsoll2 Pr_md_entlsoll2 St_loadresp0 /end OUT_MEASUREMENT
/end FUNCTION
/begin FUNCTION ipmna_loadresp ""
 /begin DEF_CHARACTERISTIC CW_BNS_LR KF_LORESP KF_LORESPKH KF_LRWAFS KF_MDRESWAFS KL_LORESPM KL_LRIGR K_APPLROFF K_ENAPPLRESP K_LRBNS K_LRESPAPP K_LRHZTST K_LRSPGW K_LRTEST K_MDRESBN K_SCHNKWSPGW K_SCHPRLRTEST K_SCHWPRSPWGLR1 K_SCHWPRSPWGLR2 K_SCHWPRSPWGLR3 K_SCHWPRSPWGLR4 K_SCHWPRSPWGLR5 K_TLORESPST S_LRTEST /end DEF_CHARACTERISTIC
 /begin IN_MEASUREMENT Nkw Rf Tmot W_afs W_dafs /end IN_MEASUREMENT
 /begin OUT_MEASUREMENT Loadresp Md_res_bn St_loadresp St_loadresp2 Tlrgen Tlrgen2 Z_dmdblock /end OUT_MEASUREMENT
/end FUNCTION
/begin FUNCTION ipmna_md2ierr "" /begin OUT_MEASUREMENT Ierrgrenz_md I_genipol1 I_genipol2 I_genipol3 Md_grenz_kor /end OUT_MEASUREMENT /end FUNCTION
/begin FUNCTION ipmna_prae ""
 /begin DEF_CHARACTERISTIC KF_MDMAX_ARS KF_MDMAX_GEN KF_MDMAX_KK KF_MDMAX_SL KF_VERLWAN KL_F_GENTYP KL_F_MDSLT KL_MDGRAD_AFS KL_MDGRAD_GEN KL_MDGRAD_SL KL_MDKMAXRED KL_MDMAX_GETR KL_VERLPU KL_VERLPU_TKOR KL_VERLWAN_TKOR K_F_LLRI K_F_MDMXREAL K_F_MDSLT K_F_NABC K_MDGRAD_ARS K_MDGRAD_GETR K_MDGRAD_GETRFS K_MDGRAD_KK K_MDMAXMAN K_TD_GETRIEBE K_T_MDNAGEN K_T_MDNAKK K_T_MDNAKKUP S_KKOFF S_MDGETR_DME S_MDMAXMAN S_MDNAICM /end DEF_CHARACTERISTIC
 /begin IN_MEASUREMENT Dzw_krann_vl Gen_awnumm Nkw Nturb Tgen Tget Tlrgen Tmot Tumg V W_afs W_dafs /end IN_MEASUREMENT
 /begin OUT_MEASUREMENT Mdkw_rest Md_entlsoll1 Md_entlsollkk Md_get_ipm Md_naars_wcl Md_naars_wcs Md_naef_wcl Md_naef_wcs Md_nagen_wcl Md_nagen_wcs Md_nagesverlust Md_nagetr_wcl Md_nagetr_wcs Md_nakk_wcl Md_nakk_wcs Md_nasl_wcl Md_nasl_wcs Md_na_bc Md_na_wcl Md_na_wcs Td_getriebe T_mdnal T_mdnas Var_afs Var_ars /end OUT_MEASUREMENT
/end FUNCTION
/begin FUNCTION ipmna_rennst ""
 /begin DEF_CHARACTERISTIC K_ANZ_RENN K_MDENTL_GENOFFVL K_MDENTL_RENN K_NGENOFMN K_NGENOFMX K_PR_GENOFFVL K_PR_RENNST K_PR_RENNSTAGM K_SCH_PWGRENNST K_TD_GENBVL K_TD_GENOFVL K_TD_RENN K_TGENOFMN K_TGENOFMX K_T_RENNAKT K_T_VRENN K_VGENOFMN K_VGENOFMX K_ZRRENN_INI S_GENOFFVL S_ZRRENN_INI /end DEF_CHARACTERISTIC
 /begin OUT_MEASUREMENT Md_entlsoll4 Pr_md_entlsoll4 St_rennst Td_genbvl Td_genofvl Td_renn T_renn_akt T_v_renn Zr_rennstart /end OUT_MEASUREMENT
/end FUNCTION
/begin FUNCTION ipmna_statmbilanz ""
 /begin DEF_CHARACTERISTIC CW_NA_KONF K_MDENTLFUNK K_MDENTLKOMF K_MDENTLSICH K_MDENTLTEST K_MDKWFUNK_HYS K_MDKWKOMF_HYS K_MDKWRESTMXVOFF K_MDKWRESTMXVOFF_HYS K_MDKWSICH_HYS K_MDKW_FUNK K_MDKW_KOMF K_MDKW_RESTAFU K_MDKW_SICH K_PR_MDFUNK K_PR_MDKOMF K_PR_MDSICH K_PR_MDTEST K_SCHNKW_IPMNA K_SCH_ANFAHR K_SCH_MDNAVERL K_SCH_NKWENTL K_SCH_NKWGRAD K_SCH_VSICH K_TD_KKOFF K_TD_KKOFFSICH K_TD_MDENTFUNKRES K_TD_MDENTKKRES K_TD_MDENTKOMFRES K_TD_MDENTKOMFSET K_TD_MDENTSICHRES S_STATM_AN S_TESTMBILANZ /end DEF_CHARACTERISTIC
 /begin OUT_MEASUREMENT Md_na_bilanzgen Md_na_bilanzkk Md_na_bilanzl Md_na_bilanzs Pr_mdfunk Pr_mdkomf Pr_mdsich Pr_mdsichkk Pr_md_entlkk Pr_md_entlsoll1 St_ipmnaprae Td_kkoff Td_kkoff_sich Td_mdent_funkres Td_mdent_kkres Td_mdent_komfres Td_mdent_komfset Td_mdent_sichres /end OUT_MEASUREMENT
/end FUNCTION
/begin FUNCTION ipmna_statmkor ""
 /begin DEF_CHARACTERISTIC KL_U_ENTL K_MDACMIN K_SCHPR_KKMN K_SCHPR_KKOFF K_TDAFU K_UENTL_SOLL /end DEF_CHARACTERISTIC
 /begin OUT_MEASUREMENT Mdkw_grenz_stat Md_entlsoll Md_max_acnaue Md_max_klima Pr_entl_soll Pr_md_entlsoll Pr_md_entlsoll1alt Pr_md_entlsoll2alt Pr_md_entlsoll3alt St_statmkor St_statmkor1 Td_afu U_entl_soll /end OUT_MEASUREMENT
/end FUNCTION
/begin FUNCTION ISC_Axispoints "" /end FUNCTION
/begin FUNCTION ISC_CoreHiPth ""
 /begin IN_MEASUREMENT ASDrf_trqInrSet CoPT_trqDesCompEng Epm_nEng ISC_nEngPT2Ftl ISC_nSetPHi ISC_nSetPLo ISC_numCurrFunc ISC_st ISC_tiPT1TrqFlt ISC_trqHiLimMax ISC_trqHiLimMin ISC_trqLossFlt SpdGov_trqInrLimSet /end IN_MEASUREMENT
 /begin OUT_MEASUREMENT ISC_trq ISC_trqFlt /end OUT_MEASUREMENT
 /begin LOC_MEASUREMENT ISC_KpHiCurr_mp ISC_KpNegHiCurr_mp ISC_KpPosHiCurr_mp ISC_nDiffHi_mp ISC_PWinNegHiCurr_mp ISC_PWinPosHiCurr_mp ISC_stHiLo_mp ISC_stPthSel_mp ISC_trqHiLimMax_mp ISC_trqHiLimMin_mp ISC_trqIscAsd_mp ISC_trqLossFltK4_mp ISC_trqPHi_mp ISC_trqSetLtd_mp ISC_trqSet_mp ISC_trq_mp /end LOC_MEASUREMENT
/end FUNCTION
/begin FUNCTION ISC_CoreLoPth "" /begin DEF_CHARACTERISTIC ISC_swtEngTestBen_C ISC_swtTrqConv_C ISC_trqLossFlt_C /end DEF_CHARACTERISTIC
 /begin IN_MEASUREMENT Conv_bTrbnSpdCan Conv_dnTrbn Conv_trqFlt Epm_nEng ISC_nSetPHi ISC_nSetPLo ISC_numCurrFunc ISC_st ISC_trqLoLimMax ISC_trqLoLimMin ISC_trqReq PthSet_trqInrSet PT_trqLos RngMod_trqClthMin VehMot_stSlip VehV_aVeh /end IN_MEASUREMENT
 /begin OUT_MEASUREMENT ISC_nEngPT2Ftl ISC_trqDrvTrnAccUnFlt ISC_trqEngAccUnFlt ISC_trqLoLtd ISC_trqLossFlt /end OUT_MEASUREMENT
 /begin LOC_MEASUREMENT ISC_dnAccLimCurr_mp ISC_dnDeclLimCurr_mp ISC_dnDrvTrnFlt_mp ISC_dnDrvTrn_mp ISC_dnEngFlt_mp ISC_dnEng_mp ISC_dnVehFlt_mp ISC_dnVeh_mp ISC_InrtDrvTrnCurr_mp ISC_InrtDrvTrnSet_mp ISC_InrtEngCurr_mp ISC_InrtVehCurr_mp ISC_InrtVehSet_mp ISC_IWinNegLoCurr_mp ISC_IWinPosLoCurr_mp ISC_KiLoCurr_mp ISC_KiNegLoCurr_mp ISC_KiPosLoCurr_mp ISC_KpLoCurr_mp ISC_KpNegLoCurr_mp ISC_KpPosLoCurr_mp ISC_nAvrgPT1Out_mp ISC_nAvrgPT2Out_mp ISC_nDiffLo_mp ISC_PWinNegLoCurr_mp ISC_PWinPosLoCurr_mp ISC_rnEngvVehCurr_mp ISC_stExtIni_mp ISC_tiFltLosTrqEstCurr_mp ISC_tiFltnEngCurr_mp ISC_trqAcc_mp ISC_trqDrvTrnAcc_mp ISC_trqEngAcc_mp ISC_trqILoLtd_mp ISC_trqInrSetFlt_mp ISC_trqInrSetReal_mp ISC_trqLoNoPreCtlLtd_mp ISC_trqLoPreCtlLtd_mp ISC_trqLossFltK1_mp ISC_trqLossFltK2_mp ISC_trqLossFltK3_mp ISC_trqLossUnFlt_mp ISC_trqPLo_mp ISC_trqVehAcc_mp /end LOC_MEASUREMENT
/end FUNCTION
/begin FUNCTION ISC_Global "" /end FUNCTION
/begin FUNCTION ISC_SelPar ""
 /begin DEF_CHARACTERISTIC ISC_stMskTrqAcc_C ISC_stMskTrqConv_C ISC_stPrio_CA ISC_tiPT1TrqFlt_CUR /end DEF_CHARACTERISTIC
 /begin IN_MEASUREMENT AGSDem_nSetPHi AGSDem_nSetPLo Clth_st DiaDem_nSetPHi DiaDem_nSetPLo EngICO_nCtOff Epm_nEng GSHDem_nSetPHi GSHDem_nSetPLo HLSDem_nSetPHi HLSDem_nSetPLo PT_stTraType /end IN_MEASUREMENT
 /begin OUT_MEASUREMENT ISC_nSetPHi ISC_nSetPLo ISC_numCurrFunc ISC_numCurrFuncSetPHi ISC_numCurrFuncSetPLo ISC_st ISC_tiPT1TrqFlt /end OUT_MEASUREMENT
 /begin LOC_MEASUREMENT ISC_nDiffLoFlt_mp /end LOC_MEASUREMENT
/end FUNCTION
/begin FUNCTION ISC_SelTrqLimTrjPln ""
 /begin IN_MEASUREMENT AGSDem_trqLoLimMax AGSDem_trqLoLimMin AGSDem_trqReq ASDrf_trqInrSet CoETS_trqInrLim CoPT_trqDesCompEng DiaDem_trqLimMax DiaDem_trqLimMin DiaDem_trqReq GSHDem_trqLoLimMax GSHDem_trqLoLimMin GSHDem_trqReq HLSDem_trqLoLimMax HLSDem_trqLoLimMin HLSDem_trqReq ISC_nSetPLo ISC_numCurrFunc ISC_st ISC_trq PthSet_trqInrSet /end IN_MEASUREMENT
 /begin OUT_MEASUREMENT ISC_trqHiLimMax ISC_trqHiLimMin ISC_trqLoLimMax ISC_trqLoLimMin ISC_trqReq /end OUT_MEASUREMENT
/end FUNCTION
/begin FUNCTION IsoTpAppl_Std "" /end FUNCTION
/begin FUNCTION IsoTp_Std "" /end FUNCTION
/begin FUNCTION IVActr_Enrg ""
 /begin DEF_CHARACTERISTIC IVActr_facWActrChCor_C IVActr_facWActrCor_C IVActr_facWActrDisChCor_C IVActr_facWActrDvtAvrgRC_C IVActr_facWActrDvtMax_C IVActr_facWActrDvtMin_C IVActr_facWActrMax_C IVActr_facWActrMin_C IVActr_facWActrTemp_CUR IVActr_numFacWVldMin_C IVActr_stActrEnrgRC_C IVActr_swtActrEnrgEnaRC_C IVActr_swtActrEnrgRC_C IVActr_swtEnaWActrCor_C IVActr_swtFacWActrDvtAvrgRC_C IVActr_swtNewMeasRC_C IVActr_tiEnrgIntegAdjMax_C IVActr_uBotDfl_C IVActr_wActrChDfl_C IVActr_wActrDisChDfl_C IVActr_wActrNom_CUR IVActr_wActrPlausMax_C IVActr_wActrPlausMin_C /end DEF_CHARACTERISTIC
 /begin IN_MEASUREMENT Epm_numCyl IVActr_ch IVActr_stCh IVActr_stUChrgUp IVActr_stUUp IVActr_tActr IVActr_tiActrMeasCurr IVActr_uChrgUp IVActr_uUp IVDia_stUPlausCyl IVPSIC_tiIntegAdj /end IN_MEASUREMENT
 /begin OUT_MEASUREMENT IVActr_facWActrDvtAvrg IVActr_stActrEnrg IVActr_tiEnrgCalc /end OUT_MEASUREMENT
 /begin LOC_MEASUREMENT IVActr_facWActrDvtUnCor_mp IVActr_facWActrDvt_mp IVActr_facWActrTemp_mp IVActr_numFacWVld_mp IVActr_tiDiffActrInteg_mp IVActr_uChUpInCur_mp IVActr_wActrDiff_mp IVActr_wActrNomCor_mp IVActr_wActrNom_mp IVActr_wChActrRaw_mp IVActr_wDisChActrRaw_mp /end LOC_MEASUREMENT
/end FUNCTION
/begin FUNCTION IVActr_GetMeas ""
 /begin DEF_CHARACTERISTIC IVActr_chRC_C IVActr_numIntrGetMeas_C IVActr_pRailLnkRC_C IVActr_resCalcChShunt_C IVActr_stChRC_C IVActr_stTiDisChRC_C IVActr_stTiETMeasRC_C IVActr_stUChrgUpRC_C IVActr_stUDisChStopRC_C IVActr_stUUpRC_C IVActr_swtChRC_C IVActr_swtGetMeasRC_C IVActr_swtPRailLnkRC_C IVActr_swtTiChrgLnkRC_C IVActr_swtTiDisChLnkRC_C IVActr_swtTiDisChRC_C IVActr_swtTiETMeasRC_C IVActr_swtTunDet_C IVActr_swtUChrgUpRC_C IVActr_swtUDisChStopRC_C IVActr_swtUUpLnkRC_C IVActr_swtUUpRC_C IVActr_tiActrMeasTOut_C IVActr_tiChrgLnkRC_C IVActr_tiDisChLnkRC_C IVActr_tiDisChRC_C IVActr_tiETMeasRC_C IVActr_tiMax_C IVActr_tiMinDstTunTrg_C IVActr_tiMin_C IVActr_uActrLin_CUR IVActr_uChrgUpRC_C IVActr_UCh_SRC.uMin_C IVActr_UCh_SRC.uMax_C IVActr_uDisChStopRC_C IVActr_uUpLnkRC_CA IVActr_uUpRC_C IVActr_Vltg_SRC.uMin_C IVActr_Vltg_SRC.uMax_C /end DEF_CHARACTERISTIC
 /begin IN_MEASUREMENT InjVlv_stInjCo IVCtl_p IVCtl_tiChrg IVCtl_tiDisCh IVCtl_uUp IVPSIC_stIntegAdjVld IVPSIC_tiIntegRC IVPSIC_uIntegOfs IVPSIC_uIntegWrkPnt /end IN_MEASUREMENT
 /begin OUT_MEASUREMENT IVActr_ch IVActr_chnImmdMeas IVActr_ctIntrGetMeas IVActr_numCylMeasNxt IVActr_pRailLnk IVActr_stCh IVActr_stGetImmdMeas IVActr_stGetMeas IVActr_stMeasDisbl IVActr_stMeasEna IVActr_stMeasTyp IVActr_stTiDisCh IVActr_stTiETMeas IVActr_stUChrgUp IVActr_stUDisChStop IVActr_stUTunChk IVActr_stUUp IVActr_tiActrMeasCurr IVActr_tiChrgLnk IVActr_tiDisCh IVActr_tiDisChLnk IVActr_tiETMeas IVActr_uChrgUp IVActr_uDisChStop IVActr_uTunChk IVActr_uUp IVActr_uUpLnk /end OUT_MEASUREMENT
 /begin LOC_MEASUREMENT IVActr_tiActrMeasTmr_mp IVActr_uActrRaw_mp IVActr_uCh_mp IVActr_uImmdMeasRaw_mp /end LOC_MEASUREMENT
/end FUNCTION
/begin FUNCTION IVActr_Temp "" /begin DEF_CHARACTERISTIC IVActr_tActrDfl_C IVActr_tActr_CUR /end DEF_CHARACTERISTIC /begin IN_MEASUREMENT CEngDsT_t /end IN_MEASUREMENT /begin OUT_MEASUREMENT IVActr_tActr /end OUT_MEASUREMENT /end FUNCTION
/begin FUNCTION IVAdj_Co ""
 /begin DEF_CHARACTERISTIC IVAdj_stQntAdj_MAP IVAdj_stRawValRepl_C IVAdj_swtDiaIVAdj_C IVAdj_swtRawValRepl_C IVAdj_volQntAdjLim_C IVAdj_volQntAdjMax0_C IVAdj_volQntAdjMax1_C IVAdj_volQntAdjMax2_C IVAdj_volQntAdjMax3_C IVAdj_volQntAdjMin0_C IVAdj_volQntAdjMin1_C IVAdj_volQntAdjMin2_C IVAdj_volQntAdjMin3_C /end DEF_CHARACTERISTIC
 /begin IN_MEASUREMENT Epm_numCyl InjVlv_volMI1Cor_mp RailP_pFlt /end IN_MEASUREMENT
 /begin LOC_MEASUREMENT IVAdj_stChkSumErrAdj_mp IVAdj_volMI1QntAdj_mp IVAdj_volPiI1QntAdj_mp IVAdj_volPiI2QntAdj_mp IVAdj_volPiI3QntAdj_mp IVAdj_volPoI1QntAdj_mp IVAdj_volPoI2QntAdj_mp /end LOC_MEASUREMENT
/end FUNCTION
/begin FUNCTION IVAdj_CoLib "" /begin DEF_CHARACTERISTIC IVAdj_numClsIVAMax_C IVAdj_numClsIVAMin_C /end DEF_CHARACTERISTIC /begin OUT_MEASUREMENT IVAdj_clsIVA IVAdj_stIVAErr /end OUT_MEASUREMENT /begin LOC_MEASUREMENT IVAdj_stChkErr_mp /end LOC_MEASUREMENT /end FUNCTION
/begin FUNCTION IVAdj_NVC ""
 /begin DEF_CHARACTERISTIC IVAdj_facCtNVCEna_C IVAdj_facNVCDflI_C IVAdj_facNVCInPI_C IVAdj_facNVCMax_C IVAdj_facNVCMin_C IVAdj_facNVCRC_CA IVAdj_INVC_CSTR.Ki_C IVAdj_INVC_CSTR.KiPos_C IVAdj_INVC_CSTR.KiNeg_C IVAdj_INVC_CSTR.WinPos_C IVAdj_INVC_CSTR.WinNeg_C IVAdj_mskInjCharNVC_C IVAdj_mskStUChrgUpNVC_C IVAdj_mskStUUpNVC_C IVAdj_numCylRC_C IVAdj_pMaxNVC_C IVAdj_pMinNVC_C IVAdj_PNVC_CSTR.Kp_C IVAdj_PNVC_CSTR.KpPos_C IVAdj_PNVC_CSTR.KpNeg_C IVAdj_PNVC_CSTR.WinPos_C IVAdj_PNVC_CSTR.WinNeg_C IVAdj_stGovInitRC_C IVAdj_swtFacNVCRC_C IVAdj_swtNVCGovInitRC_C IVAdj_tActrMaxNVC_C IVAdj_tActrMinNVC_C IVAdj_tiMeasUUpThresNVC_C IVAdj_tiPIDisChThresNVC_C IVAdj_uDiffNVCSet_CUR IVAdj_uPIVltgThresNVC_C IVAdj_valSrcPtrRC_C /end DEF_CHARACTERISTIC
 /begin IN_MEASUREMENT Epm_numCyl InjCrv_stInjCharActVal IVActr_pRailLnk IVActr_stUChrgUp IVActr_stUUp IVActr_tActr IVActr_tiActrMeasCurr IVActr_tiETMeas IVActr_uChrgUp IVActr_uUp IVCtl_tiChrg IVCtl_tiDiff IVCtl_uDiffUp /end IN_MEASUREMENT
 /begin OUT_MEASUREMENT IVAdj_facNVC /end OUT_MEASUREMENT
 /begin LOC_MEASUREMENT IVAdj_ctNVCEna_mp IVAdj_facNVCEepWrI_mp IVAdj_facNVCInitI_mp IVAdj_pDiffNVCSetCURIn_mp IVAdj_stNVCCond_mp IVAdj_stNVCEna_mp IVAdj_stNVCGovInit_mp IVAdj_stNVCRls IVAdj_tiNVCGovCalc IVAdj_uDiffNVCInPI_mp IVAdj_uDiffNVCSet_mp IVAdj_uDiffNVC_mp IVAdj_valDestPtr_mp /end LOC_MEASUREMENT
/end FUNCTION
/begin FUNCTION IVCtl_TGov ""
 /begin DEF_CHARACTERISTIC IVCtl_iPIMax_C IVCtl_iPIMin_C IVCtl_ITGov_CSTR.Ki_C IVCtl_ITGov_CSTR.KiPos_C IVCtl_ITGov_CSTR.KiNeg_C IVCtl_ITGov_CSTR.WinPos_C IVCtl_ITGov_CSTR.WinNeg_C IVCtl_mskTGov_C IVCtl_PTGov_CSTR.Kp_C IVCtl_PTGov_CSTR.KpPos_C IVCtl_PTGov_CSTR.KpNeg_C IVCtl_PTGov_CSTR.WinPos_C IVCtl_PTGov_CSTR.WinNeg_C IVCtl_tiDiffOBDDvt_C /end DEF_CHARACTERISTIC
 /begin IN_MEASUREMENT Epm_numCyl IVActr_stTiDisCh IVActr_tiActrMeasCurr IVActr_tiDisCh IVActr_tiDisChLnk IVCtl_tiChrg /end IN_MEASUREMENT
 /begin OUT_MEASUREMENT IVCtl_iCorPI IVCtl_tiDiff /end OUT_MEASUREMENT
 /begin LOC_MEASUREMENT IVCtl_iCorPIUnLim_mp IVCtl_stTGovPIHi_mp IVCtl_stTGovPILo_mp IVCtl_tiTGovCalc /end LOC_MEASUREMENT
/end FUNCTION
/begin FUNCTION IVCtl_TSetP ""
 /begin DEF_CHARACTERISTIC IVCtl_iDisCh_MAP IVCtl_tiChrg_CUR IVCtl_tiDisCh_CUR IVCtl_tiPseChrg_CUR IVCtl_tiPseDisCh_CUR /end DEF_CHARACTERISTIC
 /begin REF_CHARACTERISTIC IVDia_tiChrgTst_C IVDia_tiDisChTst_C /end REF_CHARACTERISTIC
 /begin IN_MEASUREMENT InjVlv_stInjCo InjVlv_tiChrgPrep InjVlv_tiDisChPrep IVCtl_iCorPI IVCtl_p IVCtl_uUp RailP_pFlt /end IN_MEASUREMENT
 /begin OUT_MEASUREMENT IVCtl_iDisCh IVCtl_tiChrg IVCtl_tiDisCh IVCtl_tiPseChrg IVCtl_tiPseDisCh /end OUT_MEASUREMENT
 /begin LOC_MEASUREMENT IVCtl_iDisChUnCor_mp IVCtl_uUpMapIn_mp /end LOC_MEASUREMENT
/end FUNCTION
/begin FUNCTION IVCtl_VltgCo ""
 /begin DEF_CHARACTERISTIC IVCtl_facVltgTempCor_CUR IVCtl_iChrgRC_CA IVCtl_iChrg_MAP IVCtl_pRC_CA IVCtl_swtIChrgRC_C IVCtl_swtPRC_C IVCtl_swtUUpRC_C IVCtl_uCorPreCtl_CUR IVCtl_uUpOBDMax_CUR IVCtl_uUpOBDMin_CUR IVCtl_uUpRC_CA /end DEF_CHARACTERISTIC
 /begin REF_CHARACTERISTIC IVDia_uUpTst_C /end REF_CHARACTERISTIC
 /begin IN_MEASUREMENT Epm_numCyl InjVlv_stInjCo InjVlv_uUpPrep IVActr_tActr IVAdj_clsIVA IVAdj_facNVC IVCtl_stStrt IVCtl_tiChrg IVCtl_uCorPI IVCtl_uUpStrt /end IN_MEASUREMENT
 /begin OUT_MEASUREMENT IVCtl_iChrg IVCtl_p IVCtl_stOBDErr IVCtl_uUp /end OUT_MEASUREMENT
 /begin LOC_MEASUREMENT IVCtl_facVltgTempCor IVCtl_uChrgMapIn_mp IVCtl_uChrgUp_mp IVCtl_uCorPreCtl_mp IVCtl_uUpOBDMax_mp IVCtl_uUpOBDMin_mp IVCtl_uUpUnCor_mp IVCtl_uUpUnLim_mp /end LOC_MEASUREMENT
/end FUNCTION
/begin FUNCTION IVCtl_VltgGov ""
 /begin DEF_CHARACTERISTIC IVCtl_facUDiffUpPlausMax_C IVCtl_IVltgGov_CSTR.Ki_C IVCtl_IVltgGov_CSTR.KiPos_C IVCtl_IVltgGov_CSTR.KiNeg_C IVCtl_IVltgGov_CSTR.WinPos_C IVCtl_IVltgGov_CSTR.WinNeg_C IVCtl_mskVltgGov_C IVCtl_PVltgGov_CSTR.Kp_C IVCtl_PVltgGov_CSTR.KpPos_C IVCtl_PVltgGov_CSTR.KpNeg_C IVCtl_PVltgGov_CSTR.WinPos_C IVCtl_PVltgGov_CSTR.WinNeg_C IVCtl_uDiffUpOBDDvt_C IVCtl_uPIMax_C IVCtl_uPIMin_C /end DEF_CHARACTERISTIC
 /begin IN_MEASUREMENT Epm_numCyl IVActr_stUUp IVActr_tiActrMeasCurr IVActr_uUp IVActr_uUpLnk IVCtl_p /end IN_MEASUREMENT
 /begin OUT_MEASUREMENT IVCtl_uCorPI IVCtl_uDiffUp /end OUT_MEASUREMENT
 /begin LOC_MEASUREMENT IVCtl_stUDiffUpImPlaus_mp IVCtl_stVltgGovPIHi_mp IVCtl_stVltgGovPILo_mp IVCtl_tiVltgGovCalc IVCtl_uCorPIUnLim_mp /end LOC_MEASUREMENT
/end FUNCTION
/begin FUNCTION IVCtl_VltgSetP ""
 /begin DEF_CHARACTERISTIC IVCtl_uSetPress0_CUR IVCtl_uSetPress10_CUR IVCtl_uSetPress11_CUR IVCtl_uSetPress12_CUR IVCtl_uSetPress13_CUR IVCtl_uSetPress14_CUR IVCtl_uSetPress15_CUR IVCtl_uSetPress1_CUR IVCtl_uSetPress2_CUR IVCtl_uSetPress3_CUR IVCtl_uSetPress4_CUR IVCtl_uSetPress5_CUR IVCtl_uSetPress6_CUR IVCtl_uSetPress7_CUR IVCtl_uSetPress8_CUR IVCtl_uSetPress9_CUR /end DEF_CHARACTERISTIC
 /begin IN_MEASUREMENT IVAdj_clsIVA IVCtl_p /end IN_MEASUREMENT
/end FUNCTION
/begin FUNCTION IVCtl_VltgStrt "" /begin DEF_CHARACTERISTIC IVCtl_tiStrtMax_C IVCtl_uUpStrt_C /end DEF_CHARACTERISTIC /begin IN_MEASUREMENT CoEng_st /end IN_MEASUREMENT /begin OUT_MEASUREMENT IVCtl_stStrt IVCtl_uUpStrt /end OUT_MEASUREMENT /begin LOC_MEASUREMENT IVCtl_tiStrt_mp /end LOC_MEASUREMENT /end FUNCTION
/begin FUNCTION IVDia_Co ""
 /begin DEF_CHARACTERISTIC IVDia_numMinCylOk_C IVDia_stDFCChp_C IVDia_stDFCCylNoCls_C IVDia_stErrDFC_CA IVDia_stErrMskPattern_CA IVDia_stErrMskSelect_CA IVDia_uShCirChSwtThres_C /end DEF_CHARACTERISTIC
 /begin REF_CHARACTERISTIC InjVlv_numBnkTDC_CA /end REF_CHARACTERISTIC
 /begin IN_MEASUREMENT Epm_numCyl InjVlv_stInjCo IVActr_tiActrMeasCurr IVDia_stUPlausBnk IVDia_stUPlausCyl /end IN_MEASUREMENT
 /begin OUT_MEASUREMENT IVDia_st IVDia_stPsIcChp IVDia_stPsIcCyl IVDia_stShCirChSwt /end OUT_MEASUREMENT
 /begin LOC_MEASUREMENT IVDia_stChkShCirChSwt IVDia_stClctComplInvldCyl_mp IVDia_stDFCPtt_mp IVDia_stErrClctChp_mp IVDia_stErrClctComplCyl_mp IVDia_stErrClctPsIcCyl_mp IVDia_stErrCyl_mp IVDia_stOnlyNeedPsIc_mp IVDia_stRlsErrRecgCompl_mp IVDia_stRlsErrRecgPsIc_mp /end LOC_MEASUREMENT
/end FUNCTION
/begin FUNCTION IVDia_Plaus ""
 /begin DEF_CHARACTERISTIC IVDia_facUPlaus_CA IVDia_numUTunDefThres_C IVDia_numUTunOkThres_C IVDia_uTunThres_C /end DEF_CHARACTERISTIC
 /begin REF_CHARACTERISTIC InjVlv_numBnkTDC_CA /end REF_CHARACTERISTIC
 /begin IN_MEASUREMENT IVActr_stUTunChk IVActr_tiActrMeasCurr IVActr_uTunChk /end IN_MEASUREMENT
 /begin OUT_MEASUREMENT IVDia_stUPlausBnk IVDia_stUPlausCyl /end OUT_MEASUREMENT
 /begin LOC_MEASUREMENT IVDia_stUTunDet IVDia_uThres_mp /end LOC_MEASUREMENT
/end FUNCTION
/begin FUNCTION IVDia_Tst ""
 /begin DEF_CHARACTERISTIC IVDia_numTst_C IVDia_pTstMax_C IVDia_stTstActvRC_C IVDia_stTstRC_C IVDia_swtStTstActvRC_C IVDia_swtStTstRC_C IVDia_tiChrgTst_C IVDia_tiDisChTst_C IVDia_tiETTst_C IVDia_uUpTst_C /end DEF_CHARACTERISTIC
 /begin REF_CHARACTERISTIC InjVlv_numBnkTDC_CA /end REF_CHARACTERISTIC
 /begin IN_MEASUREMENT CoEng_st InjVlv_stInjCo IVPSply_stBufErr RailP_pFlt /end IN_MEASUREMENT
 /begin OUT_MEASUREMENT IVDia_stTst IVDia_stTstActv IVDia_stTstBnkShCir IVDia_stTstBnkShCirChSwt IVDia_stTstChp IVDia_stTstCylNoCls IVDia_stTstCylNoLd IVDia_stTstCylShCir IVDia_stTstCylShCirHSLS IVDia_stTstCylShCirMeas /end OUT_MEASUREMENT
 /begin LOC_MEASUREMENT IVDia_numTstLeft_mp IVDia_stTstInjErr_mp IVDia_stTstInjOK_mp IVDia_stTstPreCond_mp /end LOC_MEASUREMENT
/end FUNCTION
/begin FUNCTION IVH_ADCInt "" /begin DEF_CHARACTERISTIC IVH_tiTunOfsTrg_C /end DEF_CHARACTERISTIC /begin IN_MEASUREMENT IVActr_chnImmdMeas /end IN_MEASUREMENT /end FUNCTION
/begin FUNCTION IVH_BusyInt "" /begin IN_MEASUREMENT IVActr_numCylMeasNxt /end IN_MEASUREMENT /end FUNCTION
/begin FUNCTION IVH_Ini "" /begin IN_MEASUREMENT IVActr_numCylMeasNxt /end IN_MEASUREMENT /end FUNCTION
/begin FUNCTION IVH_ProgSOIInt "" /end FUNCTION
/begin FUNCTION IVH_SetupInjInt "" /end FUNCTION
/begin FUNCTION IVH_SOPTst ""
 /begin DEF_CHARACTERISTIC IVH_iChrgSOPT_C IVH_iDisChSOPT_C IVH_tiChrgSOPT_C IVH_tiETSOPT_C IVH_tiPseChrgSOPT_C IVH_tiPseDisChSOPT_C /end DEF_CHARACTERISTIC
 /begin REF_CHARACTERISTIC InjVlv_numBnkTDC_CA MoCSOP_swtPsvTst_C /end REF_CHARACTERISTIC
 /begin IN_MEASUREMENT Epm_numCyl InjVlv_stInjCo /end IN_MEASUREMENT
/end FUNCTION
/begin FUNCTION IVH_SPIInt "" /begin DEF_CHARACTERISTIC IVH_tiBusyMax_C /end DEF_CHARACTERISTIC /end FUNCTION
/begin FUNCTION IVH_WupInt "" /end FUNCTION
/begin FUNCTION IVPlaus_ComprTst ""
 /begin DEF_CHARACTERISTIC IVPlaus_nEngDiffComprTst_C IVPlaus_nMinComprTst_C IVPlaus_phiPreTDCComprTst1_C IVPlaus_phiPreTDCComprTst2_C IVPlaus_phiPstTDCComprTst3_C IVPlaus_phiPstTDCComprTst4_C IVPlaus_tiMaxComprTst_C IVPlaus_uMinBattComprTst_C /end DEF_CHARACTERISTIC
 /begin IN_MEASUREMENT BattU_u EpmSeq_numInt EpmSyn_phiInt Epm_ctCyl Epm_nEng Epm_numCyl T15_st VehV_v /end IN_MEASUREMENT
 /begin LOC_MEASUREMENT IVPlaus_cntNSyncS0_mp IVPlaus_cntNSyncS1_mp IVPlaus_nEngDiffComprTst IVPlaus_nEngDiffComprTst_mp IVPlaus_nMinComprTst IVPlaus_numMn2PrevTDCComprTst_mp IVPlaus_numPi2PrevTDCComprTst_mp IVPlaus_phiMn2PrevTDCComprTst_mp IVPlaus_phiPi2PrevTDCComprTst_mp IVPlaus_phiPreTDCComprTst1 IVPlaus_phiPreTDCComprTst2 IVPlaus_phiPstTDCComprTst3 IVPlaus_phiPstTDCComprTst4 IVPlaus_stEffectComprTst IVPlaus_stRefComprTst IVPlaus_stStMNSyncComprTst IVPlaus_stStMTSyncComprTst IVPlaus_swtSrcPSComprTst_mp IVPlaus_tiEvalComprTst_mp IVPlaus_tiPreTDCComprTst IVPlaus_tiPstTDCComprTst /end LOC_MEASUREMENT
/end FUNCTION
/begin FUNCTION IVPlaus_CylChk ""
 /begin DEF_CHARACTERISTIC IVPlaus_numSegOfs1_C IVPlaus_numSegOfs2_C IVPlaus_stCylChk_C /end DEF_CHARACTERISTIC
 /begin IN_MEASUREMENT EpmCrS_numSeg Epm_nEng Epm_nEngCurr Epm_numCyl FBC_qDvtCyl /end IN_MEASUREMENT
 /begin LOC_MEASUREMENT IVPlaus_nCyl IVPlaus_qFBCCyl /end LOC_MEASUREMENT
/end FUNCTION
/begin FUNCTION IVPlaus_MonRunUpTst "" /begin IN_MEASUREMENT IVPlaus_stEffectRunUpTst /end IN_MEASUREMENT /end FUNCTION
/begin COMPU_METHOD AngleCrS "" RAT_FUNC "%6.3" "deg CrS" COEFFS 0 45.5111111111 0 0 0 1 /end COMPU_METHOD
/begin COMPU_METHOD Charge_PA "" RAT_FUNC "%6.2" "uC" COEFFS 0 1 0 0 0 1 /end COMPU_METHOD
/begin COMPU_METHOD CnvtCoeff_Fl "" RAT_FUNC "%6.2" "J/m^2/K/s" COEFFS 0 1 0 0 0 1 /end COMPU_METHOD
/begin COMPU_METHOD Curr "" RAT_FUNC "%6.2" "mA" COEFFS 0 1 0 0 0 1 /end COMPU_METHOD
/begin COMPU_METHOD Def_dez_ub_q1 "" RAT_FUNC "%3.1" "-" COEFFS 0 1 0 0 0 1 /end COMPU_METHOD
/begin COMPU_METHOD Def_dez_ul_q1 "" RAT_FUNC "%7.3" "-" COEFFS 0 1 0 0 0 1 /end COMPU_METHOD
/begin COMPU_METHOD Def_dez_uw_q1 "" RAT_FUNC "%5.2" "-" COEFFS 0 1 0 0 0 1 /end COMPU_METHOD
/begin COMPU_METHOD Def_f_sb_b1 "" RAT_FUNC "%6.4" "-" COEFFS 0 128 0 0 0 1 /end COMPU_METHOD
/begin COMPU_METHOD Def_f_ub_b1 "" RAT_FUNC "%6.4" "-" COEFFS 0 256 0 0 0 1 /end COMPU_METHOD
/begin COMPU_METHOD Def_f_ub_b2 "" RAT_FUNC "%6.4" "-" COEFFS 0 128 0 0 0 1 /end COMPU_METHOD
/begin COMPU_METHOD Def_f_ub_b4 "" RAT_FUNC "%5.3" "-" COEFFS 0 64 0 0 0 1 /end COMPU_METHOD
/begin COMPU_METHOD Def_f_uw_b1 "" RAT_FUNC "%14.10" "-" COEFFS 0 65536 0 0 0 1 /end COMPU_METHOD
/begin COMPU_METHOD Def_f_uw_b2 "" RAT_FUNC "%14.10" "-" COEFFS 0 32768 0 0 0 1 /end COMPU_METHOD
/begin COMPU_METHOD Def_i_sw_q0p125 "" RAT_FUNC "%8.4" "A" COEFFS 0 8 0 0 0 1 /end COMPU_METHOD
/begin COMPU_METHOD Def_i_ub_q0p125 "" RAT_FUNC "%6.3" "A" COEFFS 0 8 0 0 0 1 /end COMPU_METHOD
/begin COMPU_METHOD Def_km_uw_q10 "" RAT_FUNC "%5.1" "km" COEFFS 0 0.1 0 0 0 1 /end COMPU_METHOD
/begin COMPU_METHOD Def_m_sw_q0p01 "" RAT_FUNC "%7.5" "Nm" COEFFS 0 100 0 0 0 1 /end COMPU_METHOD
/begin COMPU_METHOD Def_m_sw_q0p1 "" RAT_FUNC "%7.4" "Nm" COEFFS 0 10 0 0 0 1 /end COMPU_METHOD
/begin COMPU_METHOD Def_ngrd_sb_q32p0 "" RAT_FUNC "%5.1" "Upm/s" COEFFS 0 0.03125 0 0 0 1 /end COMPU_METHOD
/begin COMPU_METHOD Def_n_sw_q1p0 "" RAT_FUNC "%5.2" "Upm" COEFFS 0 1 0 0 0 1 /end COMPU_METHOD
/begin COMPU_METHOD Def_rf_sw_q0p01 "" RAT_FUNC "%9.6" "%" COEFFS 0 100 0 0 0 1 /end COMPU_METHOD
/begin COMPU_METHOD Def_st_ub_q1 "" RAT_FUNC "%3.1" "-" COEFFS 0 1 0 0 0 1 /end COMPU_METHOD
/begin COMPU_METHOD Def_st_uw_q1 "" RAT_FUNC "%5.2" "-" COEFFS 0 1 0 0 0 1 /end COMPU_METHOD
/begin COMPU_METHOD Def_td_ub_q0p01 "" RAT_FUNC "%5.4" "s" COEFFS 0 100 0 0 0 1 /end COMPU_METHOD
/begin COMPU_METHOD Def_td_ub_q0p1 "" RAT_FUNC "%4.2" "s" COEFFS 0 10 0 0 0 1 /end COMPU_METHOD
/begin COMPU_METHOD Def_td_uw_q0p01 "" RAT_FUNC "%7.5" "s" COEFFS 0 100 0 0 0 1 /end COMPU_METHOD
/begin COMPU_METHOD Def_td_uw_q0p02 "" RAT_FUNC "%7.4" "s" COEFFS 0 50 0 0 0 1 /end COMPU_METHOD
/begin COMPU_METHOD Def_td_uw_q0p1 "" RAT_FUNC "%6.3" "s" COEFFS 0 10 0 0 0 1 /end COMPU_METHOD
/begin COMPU_METHOD Def_t_sw_q0p01 "" RAT_FUNC "%7.5" "°C" COEFFS 0 100 0 0 0 1 /end COMPU_METHOD
/begin COMPU_METHOD Def_t_sw_q0p1 "" RAT_FUNC "%6.3" "°C" COEFFS 0 10 0 0 0 1 /end COMPU_METHOD
/begin COMPU_METHOD Def_t_ub_b2 "" RAT_FUNC "%6.4" "s" COEFFS 0 128 0 0 0 1 /end COMPU_METHOD
/begin COMPU_METHOD Def_u_ub_q0p1 "" RAT_FUNC "%5.3" "V" COEFFS 0 10 0 0 0 1 /end COMPU_METHOD
/begin COMPU_METHOD Def_v_uw_q1p0 "" RAT_FUNC "%5.2" "km/h" COEFFS 0 1 0 0 0 1 /end COMPU_METHOD
/begin COMPU_METHOD Def_wdk_sw_q0p0244 "" RAT_FUNC "%7.4" "%" COEFFS 0 40.96 0 0 0 1 /end COMPU_METHOD
/begin COMPU_METHOD Def_wdk_sw_q0p1 "" RAT_FUNC "%7.4" "-" COEFFS 0 10 0 0 0 1 /end COMPU_METHOD
/begin COMPU_METHOD Def_zw_sw_q0p1 "" RAT_FUNC "%6.3" "°" COEFFS 0 10 0 0 0 1 /end COMPU_METHOD
/begin COMPU_METHOD EngN "" RAT_FUNC "%5.1" "rpm" COEFFS 0 2 0 0 0 1 /end COMPU_METHOD
/begin COMPU_METHOD EngN_float "" RAT_FUNC "%4.0" "rpm" COEFFS 0 1 0 0 0 1 /end COMPU_METHOD
/begin COMPU_METHOD Fact "" RAT_FUNC "%6.5" "-" COEFFS 0 8192 0 0 0 1 /end COMPU_METHOD
/begin COMPU_METHOD Fact1 "" RAT_FUNC "%6.4" "-" COEFFS 0 128 0 0 0 1 /end COMPU_METHOD
/begin COMPU_METHOD Identity "" RAT_FUNC "%3.1" "-" COEFFS 0 1 0 0 0 1 /end COMPU_METHOD
/begin COMPU_METHOD InjMass "" RAT_FUNC "%5.2" "mg/hub" COEFFS 0 100 0 0 0 1 /end COMPU_METHOD
/begin COMPU_METHOD InjQntInj "" RAT_FUNC "%5.2" "mm^3/inj" COEFFS 0 100 0 0 0 1 /end COMPU_METHOD
/begin COMPU_METHOD InjTime_us "" RAT_FUNC "%5.1" "us" COEFFS 0 2.5 0 0 0 1 /end COMPU_METHOD
/begin COMPU_METHOD ISCCurrFu "Verbale Umrechnung für den zur Zeit aktiven ISC Anforderer" TAB_VERB "%6.3" "" COMPU_TAB_REF ISCCurrFu /end COMPU_METHOD
/begin COMPU_VTAB ISCCurrFu "Verbale Umrechnung für den zur Zeit aktiven ISC Anforderer" TAB_VERB 8 -1 "no active ISC client" 0 "ISC" 1 "HLSDem" 2 "GSHDem" 3 "WESDem" 4 "DiaDem" 5 "AGSDem" 128 "EngICO" /end COMPU_VTAB
/begin COMPU_METHOD ISCstPrioSel "Verbale Umrechnung für die Priorisierung der verschiedenen ISC Anforderer" TAB_VERB "%6.3" "" COMPU_TAB_REF ISCstPrioSel /end COMPU_METHOD
/begin COMPU_VTAB ISCstPrioSel "Verbale Umrechnung für die Priorisierung der verschiedenen ISC Anforderer" TAB_VERB 5 1 "HLSDem" 2 "GSHDem" 3 "WESDem" 4 "DiaDem" 5 "AGSDem" /end COMPU_VTAB
/begin COMPU_METHOD ISC_dnEng_float "Umrechnung für die Drehzahlbeschleunigung (Float Implementierung)" RAT_FUNC "%6.2" "rpm/s" COEFFS 0 1 0 0 0 1 /end COMPU_METHOD
/begin COMPU_METHOD ISC_Inirtia_float "Umrechnung für Massenträgheitsmoment (Float Implementierung)" RAT_FUNC "%6.2" "Nm/(rpm/s)" COEFFS 0 1 0 0 0 1 /end COMPU_METHOD
/begin COMPU_METHOD ISC_Ki_rpm2Nm_float "Umrechnung für Verstärkung I-Anteil (Float Implementierung)" RAT_FUNC "%6.2" "Nm/(rpm*s)" COEFFS 0 1 0 0 0 1 /end COMPU_METHOD
/begin COMPU_METHOD ISC_Kp_rpm2Nm_float "Umrechnung für Verstärkung P-Anteil (Float Implementierung)" RAT_FUNC "%6.2" "Nm/rpm" COEFFS 0 1 0 0 0 1 /end COMPU_METHOD
/begin COMPU_METHOD ISC_rnEng2vVeh_float "Umrechnung für das Verhältnis Motordrehzahl zu Fahrzeuggeschwindigkeit (Float Implementierung)" RAT_FUNC "%6.2" "rpm/(Km/h)" COEFFS 0 1 0 0 0 1 /end COMPU_METHOD
/begin COMPU_METHOD ISC_tiPT2nEng_float "Umrechnung für Zeitkonstante der PT2-Filterung der Motordrehzahl (Float Implementierung)" RAT_FUNC "%6.2" "s" COEFFS 0 1 0 0 0 1 /end COMPU_METHOD
/begin COMPU_METHOD ISC_tiPTsTrqLoss_float "Umrechnung für die Zeitkonstante für die Filterung bei der Lastmomentabschätzung (Float Implementierung)" RAT_FUNC "%6.2" "s" COEFFS 0 1 0 0 0 1 /end COMPU_METHOD
/begin COMPU_METHOD IVDia_stErrDFC "" TAB_VERB "%6.3" "-" COMPU_TAB_REF IVDia_stErrDFC /end COMPU_METHOD
/begin COMPU_VTAB IVDia_stErrDFC "" TAB_VERB 8 0 "DFC_IVDiaCylShCirHSLS" 1 "DFC_IVDiaCylNoLd" 2 "DFC_IVDiaCylShCir" 3 "DFC_IVDiaCylShCirMeas" 4 "DFC_IVDiaBnkShCirChSwt" 5 "DFC_IVDiaBnkShCir" 6 "DFC_IVDiaChp" 255 "No_DFC" /end COMPU_VTAB
/begin COMPU_METHOD Ki_InjTime_us2Curr "" RAT_FUNC "%6.4" "mA/us/s" COEFFS 0 858.9934592 0 0 0 1 /end COMPU_METHOD
/begin COMPU_METHOD Ki_Vltg_PA2Fact "" RAT_FUNC "%8.7" "1/V/s" COEFFS 0 175921.86044416 0 0 0 1 /end COMPU_METHOD
/begin COMPU_METHOD Ki_Vltg_PA2Vltg_PA "" RAT_FUNC "%6.5" "V/V/s" COEFFS 0 2147.483648 0 0 0 1 /end COMPU_METHOD
/begin COMPU_METHOD Kp_InjTime_us2Curr "" RAT_FUNC "%7.6" "mA/us" COEFFS 0 13107.2 0 0 0 1 /end COMPU_METHOD
/begin COMPU_METHOD Kp_Vltg_PA2Fact "" RAT_FUNC "%9.8" "1/V" COEFFS 0 2684354.56 0 0 0 1 /end COMPU_METHOD
/begin COMPU_METHOD Kp_Vltg_PA2Vltg_PA "" RAT_FUNC "%7.6" "V/V" COEFFS 0 32768 0 0 0 1 /end COMPU_METHOD
/begin COMPU_METHOD OneToOne "" RAT_FUNC "%6.0" "-" COEFFS 0 1 0 0 0 1 /end COMPU_METHOD
/begin COMPU_METHOD OneToOne_us "" RAT_FUNC "%6.2" "us" COEFFS 0 1 0 0 0 1 /end COMPU_METHOD
/begin COMPU_METHOD Prc "" RAT_FUNC "%6.4" "%" COEFFS 0 81.92 0 0 0 1 /end COMPU_METHOD
/begin COMPU_METHOD Pres_Rail "" RAT_FUNC "%5.1" "bar" COEFFS 0 10.000000 0 0 0 1 /end COMPU_METHOD
/begin COMPU_METHOD Resist_1 "" RAT_FUNC "%6.2" "mOhm" COEFFS 0 1 0 0 0 1 /end COMPU_METHOD
/begin COMPU_METHOD Temp_Cels "" RAT_FUNC "%5.1" "deg C" COEFFS 0 10 2731.4 0 0 1 /end COMPU_METHOD
/begin COMPU_METHOD TimeDelay_s_Lin_16 "" RAT_FUNC "%6.5" "s" COEFFS 0 6553.4 0 0 0 1 /end COMPU_METHOD
/begin COMPU_METHOD Time_ms "" RAT_FUNC "%5.0" "ms" COEFFS 0 0.1 0 0 0 1 /end COMPU_METHOD
/begin COMPU_METHOD Time_PzoChrgPse "" RAT_FUNC "%6.4" "us" COEFFS 0 100 0 0 0 1 /end COMPU_METHOD
/begin COMPU_METHOD Time_PzoMeas "" RAT_FUNC "%6.4" "ms" COEFFS 0 18.3150183150183 0 0 0 1 /end COMPU_METHOD
/begin COMPU_METHOD Time_s "" RAT_FUNC "%5.2" "s" COEFFS 0 100 0 0 0 1 /end COMPU_METHOD
/begin COMPU_METHOD Trq "" RAT_FUNC "%5.1" "Nm" COEFFS 0 10 0 0 0 1 /end COMPU_METHOD
/begin COMPU_METHOD Trq_float "" RAT_FUNC "%5.1" "Nm" COEFFS 0 1 0 0 0 1 /end COMPU_METHOD
/begin COMPU_METHOD Vltg_PA "" RAT_FUNC "%4.2" "V" COEFFS 0 100 0 0 0 1 /end COMPU_METHOD
/begin COMPU_METHOD Volt "" RAT_FUNC "%6.1" "mV" COEFFS 0 5 0 0 0 1 /end COMPU_METHOD
/begin COMPU_METHOD Volt_Batt "" RAT_FUNC "%5.0" "mV" COEFFS 0 0.05 0 0 0 1 /end COMPU_METHOD
/begin COMPU_METHOD W_PA "" RAT_FUNC "%6.4" "mWs" COEFFS 0 100 0 0 0 1 /end COMPU_METHOD
/begin RECORD_LAYOUT Axis_Xs16 NO_AXIS_PTS_X 1 SWORD AXIS_PTS_X 2 SWORD INDEX_INCR DIRECT /end RECORD_LAYOUT
/begin RECORD_LAYOUT CurTKL_SW_VV_SW NO_AXIS_PTS_X 1 UBYTE RESERVED 2 BYTE AXIS_PTS_X 3 SWORD INDEX_INCR DIRECT FNC_VALUES 4 SWORD COLUMN_DIR DIRECT /end RECORD_LAYOUT
/begin RECORD_LAYOUT CurTKL_SW_VV_UB NO_AXIS_PTS_X 1 UBYTE RESERVED 2 BYTE AXIS_PTS_X 3 SWORD INDEX_INCR DIRECT FNC_VALUES 4 UBYTE COLUMN_DIR DIRECT /end RECORD_LAYOUT
/begin RECORD_LAYOUT CurTKL_UB_VV_SW NO_AXIS_PTS_X 1 UBYTE RESERVED 2 BYTE AXIS_PTS_X 3 UBYTE INDEX_INCR DIRECT FNC_VALUES 4 SWORD COLUMN_DIR DIRECT /end RECORD_LAYOUT
/begin RECORD_LAYOUT CurTKL_UB_VV_UB NO_AXIS_PTS_X 1 UBYTE RESERVED 2 BYTE AXIS_PTS_X 3 UBYTE INDEX_INCR DIRECT FNC_VALUES 4 UBYTE COLUMN_DIR DIRECT /end RECORD_LAYOUT
/begin RECORD_LAYOUT Cur_Xs16Ws16 NO_AXIS_PTS_X 1 SWORD AXIS_PTS_X 2 SWORD INDEX_INCR DIRECT FNC_VALUES 3 SWORD COLUMN_DIR DIRECT /end RECORD_LAYOUT
/begin RECORD_LAYOUT Kw_Ws16 FNC_VALUES 1 SWORD COLUMN_DIR DIRECT /end RECORD_LAYOUT
/begin RECORD_LAYOUT Kw_Ws32 FNC_VALUES 1 SLONG COLUMN_DIR DIRECT /end RECORD_LAYOUT
/begin RECORD_LAYOUT MapG_Ws16 FNC_VALUES 1 SWORD COLUMN_DIR DIRECT /end RECORD_LAYOUT
/begin RECORD_LAYOUT MapTKF_SW_SW_SW NO_AXIS_PTS_X 1 UBYTE NO_AXIS_PTS_Y 2 UBYTE AXIS_PTS_X 3 SWORD INDEX_INCR DIRECT AXIS_PTS_Y 4 SWORD INDEX_INCR DIRECT FNC_VALUES 5 SWORD COLUMN_DIR DIRECT /end RECORD_LAYOUT
/begin RECORD_LAYOUT MapTKF_SW_SW_UB NO_AXIS_PTS_X 1 UBYTE NO_AXIS_PTS_Y 2 UBYTE AXIS_PTS_X 3 SWORD INDEX_INCR DIRECT AXIS_PTS_Y 4 SWORD INDEX_INCR DIRECT FNC_VALUES 5 UBYTE COLUMN_DIR DIRECT /end RECORD_LAYOUT
/begin RECORD_LAYOUT MapTKF_SW_UW_SW NO_AXIS_PTS_X 1 UBYTE NO_AXIS_PTS_Y 2 UBYTE AXIS_PTS_X 3 UWORD INDEX_INCR DIRECT AXIS_PTS_Y 4 SWORD INDEX_INCR DIRECT FNC_VALUES 5 SWORD COLUMN_DIR DIRECT /end RECORD_LAYOUT
/begin RECORD_LAYOUT MapTKF_UW_SW_UB NO_AXIS_PTS_X 1 UBYTE NO_AXIS_PTS_Y 2 UBYTE AXIS_PTS_X 3 SWORD INDEX_INCR DIRECT AXIS_PTS_Y 4 UWORD INDEX_INCR DIRECT FNC_VALUES 5 UBYTE COLUMN_DIR DIRECT /end RECORD_LAYOUT
/begin RECORD_LAYOUT Map_Xs16Ys16Ws16 NO_AXIS_PTS_X 1 SWORD NO_AXIS_PTS_Y 2 SWORD AXIS_PTS_X 3 SWORD INDEX_INCR DIRECT AXIS_PTS_Y 4 SWORD INDEX_INCR DIRECT FNC_VALUES 5 SWORD COLUMN_DIR DIRECT /end RECORD_LAYOUT
/begin RECORD_LAYOUT ValA_Ws16 FNC_VALUES 1 SWORD COLUMN_DIR DIRECT /end RECORD_LAYOUT
/begin RECORD_LAYOUT ValA_Wu16 FNC_VALUES 1 UWORD COLUMN_DIR DIRECT /end RECORD_LAYOUT
/begin RECORD_LAYOUT ValA_Wu32 FNC_VALUES 1 ULONG COLUMN_DIR DIRECT /end RECORD_LAYOUT
/begin RECORD_LAYOUT ValA_Wu8 FNC_VALUES 1 UBYTE COLUMN_DIR DIRECT /end RECORD_LAYOUT
/begin RECORD_LAYOUT Val_Wr32 FNC_VALUES 1 FLOAT32_IEEE COLUMN_DIR DIRECT /end RECORD_LAYOUT
/begin RECORD_LAYOUT Val_Ws16 FNC_VALUES 1 SWORD COLUMN_DIR DIRECT /end RECORD_LAYOUT
/begin RECORD_LAYOUT Val_Ws32 FNC_VALUES 1 SLONG COLUMN_DIR DIRECT /end RECORD_LAYOUT
/begin RECORD_LAYOUT Val_Ws8 FNC_VALUES 1 SBYTE COLUMN_DIR DIRECT /end RECORD_LAYOUT
/begin RECORD_LAYOUT Val_Wu16 FNC_VALUES 1 UWORD COLUMN_DIR DIRECT /end RECORD_LAYOUT
/begin RECORD_LAYOUT Val_Wu32 FNC_VALUES 1 ULONG COLUMN_DIR DIRECT /end RECORD_LAYOUT
/begin RECORD_LAYOUT Val_Wu8 FNC_VALUES 1 UBYTE COLUMN_DIR DIRECT /end RECORD_LAYOUT
/end MODULE
/end PROJECT

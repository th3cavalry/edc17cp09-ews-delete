ASAP2_VERSION 1 4
/begin PROJECT P_574 "EDC17_CP09"
/begin HEADER "" VERSION "V8KB" PROJECT_NO P_574 /end HEADER
/begin MODULE DIM ""
/begin MOD_COMMON "" BYTE_ORDER MSB_LAST ALIGNMENT_BYTE 1 ALIGNMENT_WORD 2 ALIGNMENT_LONG 4 ALIGNMENT_FLOAT32_IEEE 4 /end MOD_COMMON
/begin CHARACTERISTIC DDRC_DurDeb.WaHtEl_tiOLDebDef_C "DDRC/Dauer der Fehlerentprellung für Prüfung DFC_WaHtElOL" VALUE 0x800223B6 Val_Wu16 655350.0 DDRCTime_ms 0.00 655350.0 /end CHARACTERISTIC
/begin CHARACTERISTIC DDRC_DurDeb.MeUn_tiOLDebOk_C "DDRC/Dauer der Heilungsentprellung für Prüfung DFC_MeUnOL" VALUE 0x800223B8 Val_Wu16 655350.0 DDRCTime_ms 0.00 655350.0 /end CHARACTERISTIC
/begin CHARACTERISTIC DDRC_DurDeb.MeUn_tiOLDebDef_C "DDRC/Dauer der Fehlerentprellung für Prüfung DFC_MeUnOL" VALUE 0x800223BA Val_Wu16 655350.0 DDRCTime_ms 0.00 655350.0 /end CHARACTERISTIC
/begin CHARACTERISTIC DDRC_DurDeb.LSU_tiHtrNplDebOk_C "DDRC/Dauer der Heilungsentprellung für Prüfung DFC_LSUHtrNpl" VALUE 0x800223BC Val_Wu16 655350.0 DDRCTime_ms 0.00 655350.0 /end CHARACTERISTIC
/begin CHARACTERISTIC DDRC_DurDeb.LSU_tiHtrNplDebDef_C "DDRC/Dauer der Fehlerentprellung für Prüfung DFC_LSUHtrNpl" VALUE 0x800223BE Val_Wu16 655350.0 DDRCTime_ms 0.00 655350.0 /end CHARACTERISTIC
/begin CHARACTERISTIC DDRC_DurDeb.Strt_tiOLDebOk_C "DDRC/Dauer der Heilungsentprellung für Prüfung DFC_StrtOL" VALUE 0x800223C0 Val_Wu16 655350.0 DDRCTime_ms 0.00 655350.0 /end CHARACTERISTIC
/begin CHARACTERISTIC DDRC_DurDeb.Strt_tiOLDebDef_C "DDRC/Dauer der Fehlerentprellung für Prüfung DFC_StrtOL" VALUE 0x800223C2 Val_Wu16 655350.0 DDRCTime_ms 0.00 655350.0 /end CHARACTERISTIC
/begin CHARACTERISTIC DDRC_DurDeb.PCV_tiSRCMinDebOk_C "DDRC/Dauer der Heilungsentprellung für Prüfung DFC_PCVSRCMin" VALUE 0x800223C4 Val_Wu16 655350.0 DDRCTime_ms 0.00 655350.0 /end CHARACTERISTIC
/begin CHARACTERISTIC DDRC_DurDeb.PCV_tiSRCMinDebDef_C "DDRC/Dauer der Fehlerentprellung für Prüfung DFC_PCVSRCMin" VALUE 0x800223C6 Val_Wu16 655350.0 DDRCTime_ms 0.00 655350.0 /end CHARACTERISTIC
/begin CHARACTERISTIC DDRC_DurDeb.AirC_tiCmprOvrTempDebOk_C "DDRC/Dauer der Heilungsentprellung für Prüfung DFC_AirCCmprOvrTemp" VALUE 0x800223C8 Val_Wu16 655350.0 DDRCTime_ms 0.00 655350.0 /end CHARACTERISTIC
/begin CHARACTERISTIC DDRC_DurDeb.AirC_tiCmprOvrTempDebDef_C "DDRC/Dauer der Fehlerentprellung für Prüfung DFC_AirCCmprOvrTemp" VALUE 0x800223CA Val_Wu16 655350.0 DDRCTime_ms 0.00 655350.0 /end CHARACTERISTIC
/begin CHARACTERISTIC DDRC_DurDeb.UPmpMot_tiOvrTempDebOk_C "DDRC/Dauer der Heilungsentprellung für Prüfung DFC_UPmpMotOvrTemp" VALUE 0x800223CC Val_Wu16 655350.0 DDRCTime_ms 0.00 655350.0 /end CHARACTERISTIC
/begin CHARACTERISTIC DDRC_DurDeb.UPmpMot_tiOvrTempDebDef_C "DDRC/Dauer der Fehlerentprellung für Prüfung DFC_UPmpMotOvrTemp" VALUE 0x800223CE Val_Wu16 655350.0 DDRCTime_ms 0.00 655350.0 /end CHARACTERISTIC
/begin CHARACTERISTIC DDRC_DurDeb.LSU_tiHtrMaxDebOk_C "DDRC/Dauer der Heilungsentprellung für Prüfung DFC_LSUHtrMax" VALUE 0x800223D0 Val_Wu16 655350.0 DDRCTime_ms 0.00 655350.0 /end CHARACTERISTIC
/begin CHARACTERISTIC DDRC_DurDeb.LSU_tiHtrMaxDebDef_C "DDRC/Dauer der Fehlerentprellung für Prüfung DFC_LSUHtrMax" VALUE 0x800223D2 Val_Wu16 655350.0 DDRCTime_ms 0.00 655350.0 /end CHARACTERISTIC
/begin CHARACTERISTIC DDRC_DurDeb.EngStA_tiSCGDebOk_C "DDRC/Dauer der Heilungsentprellung für Prüfung DFC_EngStASCG" VALUE 0x800223D4 Val_Wu16 655350.0 DDRCTime_ms 0.00 655350.0 /end CHARACTERISTIC
/begin CHARACTERISTIC DDRC_DurDeb.EngStA_tiSCGDebDef_C "DDRC/Dauer der Fehlerentprellung für Prüfung DFC_EngStASCG" VALUE 0x800223D6 Val_Wu16 655350.0 DDRCTime_ms 0.00 655350.0 /end CHARACTERISTIC
/begin CHARACTERISTIC DDRC_DurDeb.EngStA_tiSCBDebOk_C "DDRC/Dauer der Heilungsentprellung für Prüfung DFC_EngStASCB" VALUE 0x800223D8 Val_Wu16 655350.0 DDRCTime_ms 0.00 655350.0 /end CHARACTERISTIC
/begin CHARACTERISTIC DDRC_DurDeb.EngStA_tiSCBDebDef_C "DDRC/Dauer der Fehlerentprellung für Prüfung DFC_EngStASCB" VALUE 0x800223DA Val_Wu16 655350.0 DDRCTime_ms 0.00 655350.0 /end CHARACTERISTIC
/begin CHARACTERISTIC DDRC_DurDeb.Shtr_tiSCGDebOk_C "DDRC/Dauer der Heilungsentprellung für Prüfung DFC_ShtrSCG" VALUE 0x800223DC Val_Wu16 655350.0 DDRCTime_ms 0.00 655350.0 /end CHARACTERISTIC
/begin CHARACTERISTIC DDRC_DurDeb.Shtr_tiSCGDebDef_C "DDRC/Dauer der Fehlerentprellung für Prüfung DFC_ShtrSCG" VALUE 0x800223DE Val_Wu16 655350.0 DDRCTime_ms 0.00 655350.0 /end CHARACTERISTIC
/begin CHARACTERISTIC DDRC_DurDeb.EMDmp_tiOvrTempDebOk_C "DDRC/Dauer der Heilungsentprellung für Prüfung DFC_EMDmpOvrTemp" VALUE 0x800223E0 Val_Wu16 655350.0 DDRCTime_ms 0.00 655350.0 /end CHARACTERISTIC
/begin CHARACTERISTIC DDRC_DurDeb.EMDmp_tiOvrTempDebDef_C "DDRC/Dauer der Fehlerentprellung für Prüfung DFC_EMDmpOvrTemp" VALUE 0x800223E2 Val_Wu16 655350.0 DDRCTime_ms 0.00 655350.0 /end CHARACTERISTIC
/begin CHARACTERISTIC DDRC_DurDeb.MeUn_tiSCBDebOk_C "DDRC/Dauer der Heilungsentprellung für Prüfung DFC_MeUnSCB" VALUE 0x800223E4 Val_Wu16 655350.0 DDRCTime_ms 0.00 655350.0 /end CHARACTERISTIC
/begin CHARACTERISTIC DDRC_DurDeb.MeUn_tiSCBDebDef_C "DDRC/Dauer der Fehlerentprellung für Prüfung DFC_MeUnSCB" VALUE 0x800223E6 Val_Wu16 655350.0 DDRCTime_ms 0.00 655350.0 /end CHARACTERISTIC
/begin CHARACTERISTIC DDRC_DurDeb.Strt_tiSCGDebOk_C "DDRC/Dauer der Heilungsentprellung für Prüfung DFC_StrtSCG" VALUE 0x800223E8 Val_Wu16 655350.0 DDRCTime_ms 0.00 655350.0 /end CHARACTERISTIC
/begin CHARACTERISTIC DDRC_DurDeb.Strt_tiSCGDebDef_C "DDRC/Dauer der Fehlerentprellung für Prüfung DFC_StrtSCG" VALUE 0x800223EA Val_Wu16 655350.0 DDRCTime_ms 0.00 655350.0 /end CHARACTERISTIC
/begin CHARACTERISTIC DDRC_DurDeb.EngStA_tiOLDebOk_C "DDRC/Dauer der Heilungsentprellung für Prüfung DFC_EngStAOL" VALUE 0x800223EC Val_Wu16 655350.0 DDRCTime_ms 0.00 655350.0 /end CHARACTERISTIC
/begin CHARACTERISTIC DDRC_DurDeb.EngStA_tiOLDebDef_C "DDRC/Dauer der Fehlerentprellung für Prüfung DFC_EngStAOL" VALUE 0x800223EE Val_Wu16 655350.0 DDRCTime_ms 0.00 655350.0 /end CHARACTERISTIC
/begin CHARACTERISTIC DDRC_DurDeb.CByVlv_tiOvrTempDebOk_C "DDRC/Dauer der Heilungsentprellung für Prüfung DFC_CByVlvOvrTemp" VALUE 0x800223F0 Val_Wu16 655350.0 DDRCTime_ms 0.00 655350.0 /end CHARACTERISTIC
/begin CHARACTERISTIC DDRC_DurDeb.CByVlv_tiOvrTempDebDef_C "DDRC/Dauer der Fehlerentprellung für Prüfung DFC_CByVlvOvrTemp" VALUE 0x800223F2 Val_Wu16 655350.0 DDRCTime_ms 0.00 655350.0 /end CHARACTERISTIC
/begin CHARACTERISTIC DDRC_DurDeb.LSU_titExcMaxDebOk_C "DDRC/Dauer der Heilungsentprellung für Prüfung DFC_LSUtExcMax" VALUE 0x800223F4 Val_Wu16 655350.0 DDRCTime_ms 0.00 655350.0 /end CHARACTERISTIC
/begin CHARACTERISTIC DDRC_DurDeb.LSU_titExcMaxDebDef_C "DDRC/Dauer der Fehlerentprellung für Prüfung DFC_LSUtExcMax" VALUE 0x800223F6 Val_Wu16 655350.0 DDRCTime_ms 0.00 655350.0 /end CHARACTERISTIC
/begin CHARACTERISTIC DDRC_DurDeb.Shtr_tiOLDebOk_C "DDRC/Dauer der Heilungsentprellung für Prüfung DFC_ShtrOL" VALUE 0x800223F8 Val_Wu16 655350.0 DDRCTime_ms 0.00 655350.0 /end CHARACTERISTIC
/begin CHARACTERISTIC DDRC_DurDeb.Shtr_tiOLDebDef_C "DDRC/Dauer der Fehlerentprellung für Prüfung DFC_ShtrOL" VALUE 0x800223FA Val_Wu16 655350.0 DDRCTime_ms 0.00 655350.0 /end CHARACTERISTIC
/begin CHARACTERISTIC DDRC_DurDeb.Shtr_tiSCBDebOk_C "DDRC/Dauer der Heilungsentprellung für Prüfung DFC_ShtrSCB" VALUE 0x800223FC Val_Wu16 655350.0 DDRCTime_ms 0.00 655350.0 /end CHARACTERISTIC
/begin CHARACTERISTIC DDRC_DurDeb.Shtr_tiSCBDebDef_C "DDRC/Dauer der Fehlerentprellung für Prüfung DFC_ShtrSCB" VALUE 0x800223FE Val_Wu16 655350.0 DDRCTime_ms 0.00 655350.0 /end CHARACTERISTIC
/begin CHARACTERISTIC DDRC_DurDeb.ECBVlv_tiSCGDebOk_C "DDRC/Dauer der Heilungsentprellung für Prüfung DFC_ECBVlvSCG" VALUE 0x80022400 Val_Wu16 655350.0 DDRCTime_ms 0.00 655350.0 /end CHARACTERISTIC
/begin CHARACTERISTIC DDRC_DurDeb.ECBVlv_tiSCGDebDef_C "DDRC/Dauer der Fehlerentprellung für Prüfung DFC_ECBVlvSCG" VALUE 0x80022402 Val_Wu16 655350.0 DDRCTime_ms 0.00 655350.0 /end CHARACTERISTIC
/begin CHARACTERISTIC DDRC_DurDeb.FlFltHt_tiSCGDebOk_C "DDRC/Dauer der Heilungsentprellung für Prüfung DFC_FlFltHtSCG" VALUE 0x80022404 Val_Wu16 655350.0 DDRCTime_ms 0.00 655350.0 /end CHARACTERISTIC
/begin CHARACTERISTIC DDRC_DurDeb.FlFltHt_tiSCGDebDef_C "DDRC/Dauer der Fehlerentprellung für Prüfung DFC_FlFltHtSCG" VALUE 0x80022406 Val_Wu16 655350.0 DDRCTime_ms 0.00 655350.0 /end CHARACTERISTIC
/begin CHARACTERISTIC DDRC_DurDeb.UDosVlv_tiSCBDebOk_C "DDRC/Dauer der Heilungsentprellung für Prüfung DFC_UDosVlvSCB" VALUE 0x80022408 Val_Wu16 655350.0 DDRCTime_ms 0.00 655350.0 /end CHARACTERISTIC
/begin CHARACTERISTIC DDRC_DurDeb.UDosVlv_tiSCBDebDef_C "DDRC/Dauer der Fehlerentprellung für Prüfung DFC_UDosVlvSCB" VALUE 0x8002240A Val_Wu16 655350.0 DDRCTime_ms 0.00 655350.0 /end CHARACTERISTIC
/begin CHARACTERISTIC DDRC_DurDeb.AFS_SSpShOff_tiOvrTempDebOk_C "DDRC/Dauer der Heilungsentprellung für Prüfung DFC_AFS_SSpShOffOvrTemp" VALUE 0x8002240C Val_Wu16 655350.0 DDRCTime_ms 0.00 655350.0 /end CHARACTERISTIC
/begin CHARACTERISTIC DDRC_DurDeb.AFS_SSpShOff_tiOvrTempDebDef_C "DDRC/Dauer der Fehlerentprellung für Prüfung DFC_AFS_SSpShOffOvrTemp" VALUE 0x8002240E Val_Wu16 655350.0 DDRCTime_ms 0.00 655350.0 /end CHARACTERISTIC
/begin CHARACTERISTIC DDRC_DurDeb.MeUn_tiSRCMinDebOk_C "DDRC/Dauer der Heilungsentprellung für Prüfung DFC_MeUnSRCMin" VALUE 0x80022410 Val_Wu16 655350.0 DDRCTime_ms 0.00 655350.0 /end CHARACTERISTIC
/begin CHARACTERISTIC DDRC_DurDeb.MeUn_tiSRCMinDebDef_C "DDRC/Dauer der Fehlerentprellung für Prüfung DFC_MeUnSRCMin" VALUE 0x80022412 Val_Wu16 655350.0 DDRCTime_ms 0.00 655350.0 /end CHARACTERISTIC
/begin CHARACTERISTIC DDRC_DurDeb.FlFltHt_tiOLDebOk_C "DDRC/Dauer der Heilungsentprellung für Prüfung DFC_FlFltHtOL" VALUE 0x80022414 Val_Wu16 655350.0 DDRCTime_ms 0.00 655350.0 /end CHARACTERISTIC
/begin CHARACTERISTIC DDRC_DurDeb.FlFltHt_tiOLDebDef_C "DDRC/Dauer der Fehlerentprellung für Prüfung DFC_FlFltHtOL" VALUE 0x80022416 Val_Wu16 655350.0 DDRCTime_ms 0.00 655350.0 /end CHARACTERISTIC
/begin CHARACTERISTIC DDRC_DurDeb.Fan_tiOvrTempDebOk_C "DDRC/Dauer der Heilungsentprellung für Prüfung DFC_FanOvrTemp" VALUE 0x80022418 Val_Wu16 655350.0 DDRCTime_ms 0.00 655350.0 /end CHARACTERISTIC
/begin CHARACTERISTIC DDRC_DurDeb.Fan_tiOvrTempDebDef_C "DDRC/Dauer der Fehlerentprellung für Prüfung DFC_FanOvrTemp" VALUE 0x8002241A Val_Wu16 655350.0 DDRCTime_ms 0.00 655350.0 /end CHARACTERISTIC
/begin CHARACTERISTIC DDRC_DurDeb.MeUn_tiSRCMaxDebOk_C "DDRC/Dauer der Heilungsentprellung für Prüfung DFC_MeUnSRCMax" VALUE 0x8002241C Val_Wu16 655350.0 DDRCTime_ms 0.00 655350.0 /end CHARACTERISTIC
/begin CHARACTERISTIC DDRC_DurDeb.MeUn_tiSRCMaxDebDef_C "DDRC/Dauer der Fehlerentprellung für Prüfung DFC_MeUnSRCMax" VALUE 0x8002241E Val_Wu16 655350.0 DDRCTime_ms 0.00 655350.0 /end CHARACTERISTIC
/begin CHARACTERISTIC DDRC_DurDeb.CThmst_tiSCGDebOk_C "DDRC/Dauer der Heilungsentprellung für Prüfung DFC_CThmstSCG" VALUE 0x80022420 Val_Wu16 655350.0 DDRCTime_ms 0.00 655350.0 /end CHARACTERISTIC
/begin CHARACTERISTIC DDRC_DurDeb.CThmst_tiSCGDebDef_C "DDRC/Dauer der Fehlerentprellung für Prüfung DFC_CThmstSCG" VALUE 0x80022422 Val_Wu16 655350.0 DDRCTime_ms 0.00 655350.0 /end CHARACTERISTIC
/begin CHARACTERISTIC DDRC_DurDeb.PCV_tiSRCMaxDebOk_C "DDRC/Dauer der Heilungsentprellung für Prüfung DFC_PCVSRCMax" VALUE 0x80022424 Val_Wu16 655350.0 DDRCTime_ms 0.00 655350.0 /end CHARACTERISTIC
/begin CHARACTERISTIC DDRC_DurDeb.PCV_tiSRCMaxDebDef_C "DDRC/Dauer der Fehlerentprellung für Prüfung DFC_PCVSRCMax" VALUE 0x80022426 Val_Wu16 655350.0 DDRCTime_ms 0.00 655350.0 /end CHARACTERISTIC
/begin CHARACTERISTIC DDRC_DurDeb.PCV_tiSCBDebOk_C "DDRC/Dauer der Heilungsentprellung für Prüfung DFC_PCVSCB" VALUE 0x80022428 Val_Wu16 655350.0 DDRCTime_ms 0.00 655350.0 /end CHARACTERISTIC
/begin CHARACTERISTIC DDRC_DurDeb.PCV_tiSCBDebDef_C "DDRC/Dauer der Fehlerentprellung für Prüfung DFC_PCVSCB" VALUE 0x8002242A Val_Wu16 655350.0 DDRCTime_ms 0.00 655350.0 /end CHARACTERISTIC
/begin CHARACTERISTIC DDRC_DurDeb.EMDmp_tiSCGDebOk_C "DDRC/Dauer der Heilungsentprellung für Prüfung DFC_EMDmpSCG" VALUE 0x8002242C Val_Wu16 655350.0 DDRCTime_ms 0.00 655350.0 /end CHARACTERISTIC
/begin CHARACTERISTIC DDRC_DurDeb.EMDmp_tiSCGDebDef_C "DDRC/Dauer der Fehlerentprellung für Prüfung DFC_EMDmpSCG" VALUE 0x8002242E Val_Wu16 655350.0 DDRCTime_ms 0.00 655350.0 /end CHARACTERISTIC
/begin CHARACTERISTIC DDRC_DurDeb.AFS_SSpShOff_tiOLDebOk_C "DDRC/Dauer der Heilungsentprellung für Prüfung DFC_AFS_SSpShOffOL" VALUE 0x80022430 Val_Wu16 655350.0 DDRCTime_ms 0.00 655350.0 /end CHARACTERISTIC
/begin CHARACTERISTIC DDRC_DurDeb.AFS_SSpShOff_tiOLDebDef_C "DDRC/Dauer der Fehlerentprellung für Prüfung DFC_AFS_SSpShOffOL" VALUE 0x80022432 Val_Wu16 655350.0 DDRCTime_ms 0.00 655350.0 /end CHARACTERISTIC
/begin CHARACTERISTIC DDRC_DurDeb.AFS_SSpShOff_tiSCBDebOk_C "DDRC/Dauer der Heilungsentprellung für Prüfung DFC_AFS_SSpShOffSCB" VALUE 0x80022434 Val_Wu16 655350.0 DDRCTime_ms 0.00 655350.0 /end CHARACTERISTIC
/begin CHARACTERISTIC DDRC_DurDeb.AFS_SSpShOff_tiSCBDebDef_C "DDRC/Dauer der Fehlerentprellung für Prüfung DFC_AFS_SSpShOffSCB" VALUE 0x80022436 Val_Wu16 655350.0 DDRCTime_ms 0.00 655350.0 /end CHARACTERISTIC
/begin CHARACTERISTIC DDRC_DurDeb.AFS_SSpShOff_tiSCGDebOk_C "DDRC/Dauer der Heilungsentprellung für Prüfung DFC_AFS_SSpShOffSCG" VALUE 0x80022438 Val_Wu16 655350.0 DDRCTime_ms 0.00 655350.0 /end CHARACTERISTIC
/begin CHARACTERISTIC DDRC_DurDeb.AFS_SSpShOff_tiSCGDebDef_C "DDRC/Dauer der Fehlerentprellung für Prüfung DFC_AFS_SSpShOffSCG" VALUE 0x8002243A Val_Wu16 655350.0 DDRCTime_ms 0.00 655350.0 /end CHARACTERISTIC
/begin CHARACTERISTIC DDRC_DurDeb.EMDmp_tiOLDebOk_C "DDRC/Dauer der Heilungsentprellung für Prüfung DFC_EMDmpOL" VALUE 0x8002243C Val_Wu16 655350.0 DDRCTime_ms 0.00 655350.0 /end CHARACTERISTIC
/begin CHARACTERISTIC DDRC_DurDeb.EMDmp_tiOLDebDef_C "DDRC/Dauer der Fehlerentprellung für Prüfung DFC_EMDmpOL" VALUE 0x8002243E Val_Wu16 655350.0 DDRCTime_ms 0.00 655350.0 /end CHARACTERISTIC
/begin CHARACTERISTIC DDRC_DurDeb.CByVlv_tiSCBDebOk_C "DDRC/Dauer der Heilungsentprellung für Prüfung DFC_CByVlvSCB" VALUE 0x80022440 Val_Wu16 655350.0 DDRCTime_ms 0.00 655350.0 /end CHARACTERISTIC
/begin CHARACTERISTIC DDRC_DurDeb.CByVlv_tiSCBDebDef_C "DDRC/Dauer der Fehlerentprellung für Prüfung DFC_CByVlvSCB" VALUE 0x80022442 Val_Wu16 655350.0 DDRCTime_ms 0.00 655350.0 /end CHARACTERISTIC
/begin CHARACTERISTIC DDRC_DurDeb.AirC_tiCmprSCGDebOk_C "DDRC/Dauer der Heilungsentprellung für Prüfung DFC_AirCCmprSCG" VALUE 0x80022444 Val_Wu16 655350.0 DDRCTime_ms 0.00 655350.0 /end CHARACTERISTIC
/begin CHARACTERISTIC DDRC_DurDeb.AirC_tiCmprSCGDebDef_C "DDRC/Dauer der Fehlerentprellung für Prüfung DFC_AirCCmprSCG" VALUE 0x80022446 Val_Wu16 655350.0 DDRCTime_ms 0.00 655350.0 /end CHARACTERISTIC
/begin CHARACTERISTIC DDRC_DurDeb.TrbCh_tiSCBDebOk_C "DDRC/Dauer der Heilungsentprellung für Prüfung DFC_TrbChSCB" VALUE 0x80022448 Val_Wu16 655350.0 DDRCTime_ms 0.00 655350.0 /end CHARACTERISTIC
/begin CHARACTERISTIC DDRC_DurDeb.TrbCh_tiSCBDebDef_C "DDRC/Dauer der Fehlerentprellung für Prüfung DFC_TrbChSCB" VALUE 0x8002244A Val_Wu16 655350.0 DDRCTime_ms 0.00 655350.0 /end CHARACTERISTIC
/begin CHARACTERISTIC DDRC_DurDeb.RailP_tiSRCMaxDebOk_C "DDRC/Dauer der Heilungsentprellung für Prüfung DFC_RailPSRCMax" VALUE 0x8002244C Val_Wu16 655350.0 DDRCTime_ms 0.00 655350.0 /end CHARACTERISTIC
/begin CHARACTERISTIC DDRC_DurDeb.RailP_tiSRCMaxDebDef_C "DDRC/Dauer der Fehlerentprellung für Prüfung DFC_RailPSRCMax" VALUE 0x8002244E Val_Wu16 655350.0 DDRCTime_ms 0.00 655350.0 /end CHARACTERISTIC
/begin CHARACTERISTIC DDRC_DurDeb.SCRMon_numDFCPresRdcDebOk_C "DDRC/Dauer der Heilungsentprellung für Prüfung DFC_PresRdcMaxP" VALUE 0x80022450 Val_Wu16 65535.00 OneToOne 0.00 65535.00 /end CHARACTERISTIC
/begin CHARACTERISTIC DDRC_DurDeb.SCRMon_numDFCPresRdcDebDef_C "DDRC/Dauer der Fehlerentprellung für Prüfung DFC_PresRdcMaxP" VALUE 0x80022452 Val_Wu16 65535.00 OneToOne 0.00 65535.00 /end CHARACTERISTIC
/begin CHARACTERISTIC DDRC_DurDeb.IVActr_numVltgSRCMaxDebOk_C "DDRC/Heilungsentprellung für den Spannungs-SRC: Maximum" VALUE 0x80022454 Val_Wu16 65535.00 OneToOne 0.00 65535.00 /end CHARACTERISTIC
/begin CHARACTERISTIC DDRC_DurDeb.IVActr_numVltgSRCMaxDebDef_C "DDRC/Defektentprellung für den Spannungs-SRC: Maximum" VALUE 0x80022456 Val_Wu16 65535.00 OneToOne 0.00 65535.00 /end CHARACTERISTIC
/begin CHARACTERISTIC DDRC_DurDeb.IVActr_numUChSRCMinDebOk_C "DDRC/Heilungsentprellung für die Spannungsmessung: Minimum" VALUE 0x80022458 Val_Wu16 65535.00 OneToOne 0.00 65535.00 /end CHARACTERISTIC
/begin CHARACTERISTIC DDRC_DurDeb.IVActr_numUChSRCMinDebDef_C "DDRC/Defektentprellung für die Spannungsmessung: Minimum" VALUE 0x8002245A Val_Wu16 65535.00 OneToOne 0.00 65535.00 /end CHARACTERISTIC
/begin CHARACTERISTIC DDRC_DurDeb.SCRMon_numDFCMetCtlDebOk_C "DDRC/Dauer der Heilungsentprellung für Prüfung DFC_SCRMonMetCtlPresErr" VALUE 0x8002245C Val_Wu16 65535.00 OneToOne 0.00 65535.00 /end CHARACTERISTIC
/begin CHARACTERISTIC DDRC_DurDeb.SCRMon_numDFCMetCtlDebDef_C "DDRC/Dauer der Fehlerentprellung für Prüfung DFC_SCRMonMetCtlPresErr" VALUE 0x8002245E Val_Wu16 65535.00 OneToOne 0.00 65535.00 /end CHARACTERISTIC
/begin CHARACTERISTIC DDRC_DurDeb.IVPSply_numDCDCDebOk_C "DDRC/Dauer der Heilungsentprellung für Prüfung DFC_IVPSplyDCDC" VALUE 0x80022460 Val_Wu16 65535.00 OneToOne 0.00 65535.00 /end CHARACTERISTIC
/begin CHARACTERISTIC DDRC_DurDeb.IVPSply_numDCDCDebDef_C "DDRC/Dauer der Fehlerentprellung für Prüfung DFC_IVPSplyDCDC" VALUE 0x80022462 Val_Wu16 65535.00 OneToOne 0.00 65535.00 /end CHARACTERISTIC
/begin CHARACTERISTIC DDRC_DurDeb.SCRMon_numDFCPresBuildUpDebOk_C "DDRC/Dauer der Heilungsentprellung für Prüfung DFC_SCRMonPresBuildUpErr" VALUE 0x80022464 Val_Wu16 65535.00 OneToOne 0.00 65535.00 /end CHARACTERISTIC
/begin CHARACTERISTIC DDRC_DurDeb.SCRMon_numDFCPresBuildUpDebDef_C "DDRC/Dauer der Fehlerentprellung für Prüfung DFC_SCRMonPresBuildUpErr" VALUE 0x80022466 Val_Wu16 65535.00 OneToOne 0.00 65535.00 /end CHARACTERISTIC
/begin CHARACTERISTIC DDRC_DurDeb.SCRChk_numEtaErrDebOk_C "DDRC/Dauer der Heilungsentprellung für Prüfung DFC_SCREtaErr" VALUE 0x80022468 Val_Wu16 65535.00 OneToOne 0.00 65535.00 /end CHARACTERISTIC
/begin CHARACTERISTIC DDRC_DurDeb.SCRChk_numEtaErrDebDef_C "DDRC/Dauer der Fehlerentprellung für Prüfung DFC_SCREtaErr" VALUE 0x8002246A Val_Wu16 65535.00 OneToOne 0.00 65535.00 /end CHARACTERISTIC
/begin CHARACTERISTIC DDRC_DurDeb.IVPSply_numVltgSRCMaxDebOk_C "DDRC/Dauer der Heilungsentprellung für Prüfung DFC_IVPSplyVltgSRCMax" VALUE 0x8002246C Val_Wu16 65535.00 OneToOne 0.00 65535.00 /end CHARACTERISTIC
/begin CHARACTERISTIC DDRC_DurDeb.IVPSply_numVltgSRCMaxDebDef_C "DDRC/Dauer der Fehlerentprellung für Prüfung DFC_IVPSplyVltgSRCMax" VALUE 0x8002246E Val_Wu16 65535.00 OneToOne 0.00 65535.00 /end CHARACTERISTIC
/begin CHARACTERISTIC DDRC_DurDeb.SCRChk_numEtaErr1DebOk_C "DDRC/Dauer der Heilungsentprellung für Prüfung DFC_SCREtaErr1" VALUE 0x80022470 Val_Wu16 65535.00 OneToOne 0.00 65535.00 /end CHARACTERISTIC
/begin CHARACTERISTIC DDRC_DurDeb.SCRChk_numEtaErr1DebDef_C "DDRC/Dauer der Fehlerentprellung für Prüfung DFC_SCREtaErr1" VALUE 0x80022472 Val_Wu16 65535.00 OneToOne 0.00 65535.00 /end CHARACTERISTIC
/begin CHARACTERISTIC DDRC_DurDeb.IVDia_numTunDetDebOk_C "DDRC/Dauer der Heilungsentprellung für Prüfung DFC_IVDiaTunDet" VALUE 0x80022474 Val_Wu16 65535.00 OneToOne 0.00 65535.00 /end CHARACTERISTIC
/begin CHARACTERISTIC DDRC_DurDeb.IVDia_numTunDetDebDef_C "DDRC/Dauer der Fehlerentprellung für Prüfung DFC_IVDiaTunDet" VALUE 0x80022476 Val_Wu16 65535.00 OneToOne 0.00 65535.00 /end CHARACTERISTIC
/begin CHARACTERISTIC DDRC_DurDeb.SCRChk_numEtaErr2DebOk_C "DDRC/Dauer der Heilungsentprellung für Prüfung DFC_SCREtaErr2" VALUE 0x80022478 Val_Wu16 65535.00 OneToOne 0.00 65535.00 /end CHARACTERISTIC
/begin CHARACTERISTIC DDRC_DurDeb.SCRChk_numEtaErr2DebDef_C "DDRC/Dauer der Fehlerentprellung für Prüfung DFC_SCREtaErr2" VALUE 0x8002247A Val_Wu16 65535.00 OneToOne 0.00 65535.00 /end CHARACTERISTIC
/begin CHARACTERISTIC DDRC_DurDeb.IVActr_numVltgSRCMinDebOk_C "DDRC/Heilungsentprellung für den Spannungs-SRC: Minimum" VALUE 0x8002247C Val_Wu16 65535.00 OneToOne 0.00 65535.00 /end CHARACTERISTIC
/begin CHARACTERISTIC DDRC_DurDeb.IVActr_numVltgSRCMinDebDef_C "DDRC/Defektentprellung für den Spannungs-SRC: Minimum" VALUE 0x8002247E Val_Wu16 65535.00 OneToOne 0.00 65535.00 /end CHARACTERISTIC
/begin CHARACTERISTIC DDRC_DurDeb.IVActr_numUChSRCMaxDebOk_C "DDRC/Heilungsentprellung für die Spannungsmessung: Maximum" VALUE 0x80022480 Val_Wu16 65535.00 OneToOne 0.00 65535.00 /end CHARACTERISTIC
/begin CHARACTERISTIC DDRC_DurDeb.IVActr_numUChSRCMaxDebDef_C "DDRC/Defektentprellung für die Spannungsmessung: Maximum" VALUE 0x80022482 Val_Wu16 65535.00 OneToOne 0.00 65535.00 /end CHARACTERISTIC
/begin CHARACTERISTIC DDRC_DurDeb.IVPSply_numVltgSRCMinDebOk_C "DDRC/Dauer der Heilungsentprellung für Prüfung DFC_IVPSplyVltgSRCMin" VALUE 0x80022484 Val_Wu16 65535.00 OneToOne 0.00 65535.00 /end CHARACTERISTIC
/begin CHARACTERISTIC DDRC_DurDeb.IVPSply_numVltgSRCMinDebDef_C "DDRC/Dauer der Fehlerentprellung für Prüfung DFC_IVPSplyVltgSRCMin" VALUE 0x80022486 Val_Wu16 65535.00 OneToOne 0.00 65535.00 /end CHARACTERISTIC
/begin CHARACTERISTIC DDRC_DurDeb.Exh_tiPlausExhTMon1DebOk_C "DDRC/Dauer der Heilungsentprellung für Prüfung DFC_ExhTMonT1Plaus" VALUE 0x80022488 Val_Wu16 655350.0 DDRCTime_ms 0.00 655350.0 /end CHARACTERISTIC
/begin CHARACTERISTIC DDRC_DurDeb.Exh_tiPlausExhTMon1DebDef_C "DDRC/Dauer der Fehlerentprellung für Prüfung DFC_ExhTMonT1Plaus" VALUE 0x8002248A Val_Wu16 655350.0 DDRCTime_ms 0.00 655350.0 /end CHARACTERISTIC
/begin CHARACTERISTIC DDRC_DurDeb.Exh_tiMaxNSCDsDebOk_C "DDRC/Dauer der Heilungsentprellung für Prüfung DFC_NSCDsShCir" VALUE 0x8002248C Val_Wu16 655350.0 DDRCTime_ms 0.00 655350.0 /end CHARACTERISTIC
/begin CHARACTERISTIC DDRC_DurDeb.Exh_tiMaxNSCDsDebDef_C "DDRC/Dauer der Fehlerentprellung für Prüfung DFC_NSCDsShCir" VALUE 0x8002248E Val_Wu16 655350.0 DDRCTime_ms 0.00 655350.0 /end CHARACTERISTIC
/begin CHARACTERISTIC DDRC_DurDeb.Air_tiDtyCycLoTAFSDebOk_C "DDRC/Dauer der Heilungsentprellung für Prüfung DFC_TAFSDtyCycLo" VALUE 0x80022490 Val_Wu16 655350.0 DDRCTime_ms 0.00 655350.0 /end CHARACTERISTIC
/begin CHARACTERISTIC DDRC_DurDeb.Air_tiDtyCycLoTAFSDebDef_C "DDRC/Dauer der Fehlerentprellung für Prüfung DFC_TAFSDtyCycLo" VALUE 0x80022492 Val_Wu16 655350.0 DDRCTime_ms 0.00 655350.0 /end CHARACTERISTIC
/begin CHARACTERISTIC DDRC_DurDeb.ECBVlv_tiSRCMaxDebOk_C "DDRC/Dauer der Heilungsentprellung für Prüfung DFC_ECBVlvSRCMax" VALUE 0x80022494 Val_Wu16 655350.0 DDRCTime_ms 0.00 655350.0 /end CHARACTERISTIC
/begin CHARACTERISTIC DDRC_DurDeb.ECBVlv_tiSRCMaxDebDef_C "DDRC/Dauer der Fehlerentprellung für Prüfung DFC_ECBVlvSRCMax" VALUE 0x80022496 Val_Wu16 655350.0 DDRCTime_ms 0.00 655350.0 /end CHARACTERISTIC
/begin CHARACTERISTIC DDRC_DurDeb.Exh_tiLamPlausMinNoCat2DsDebOk_C "DDRC/Dauer der Heilungsentprellung für Prüfung DFC_NoCat2DsLamPlausMin" VALUE 0x80022498 Val_Wu16 655350.0 DDRCTime_ms 0.00 655350.0 /end CHARACTERISTIC
/begin CHARACTERISTIC DDRC_DurDeb.Exh_tiLamPlausMinNoCat2DsDebDef_C "DDRC/Dauer der Fehlerentprellung für Prüfung DFC_NoCat2DsLamPlausMin" VALUE 0x8002249A Val_Wu16 655350.0 DDRCTime_ms 0.00 655350.0 /end CHARACTERISTIC
/begin CHARACTERISTIC DDRC_DurDeb.VSwVlv_tiHBrgShCirGnd1DebOk_C "DDRC/Dauer der Heilungsentprellung für Prüfung DFC_VSwVlvHBrgShCirGnd1" VALUE 0x8002249C Val_Wu16 655350.0 DDRCTime_ms 0.00 655350.0 /end CHARACTERISTIC
/begin CHARACTERISTIC DDRC_DurDeb.VSwVlv_tiHBrgShCirGnd1DebDef_C "DDRC/Dauer der Fehlerentprellung für Prüfung DFC_VSwVlvHBrgShCirGnd1" VALUE 0x8002249E Val_Wu16 655350.0 DDRCTime_ms 0.00 655350.0 /end CHARACTERISTIC
/begin CHARACTERISTIC DDRC_DurDeb.EGRVlv_tiSCGDebOk_C "DDRC/Dauer der Heilungsentprellung für Prüfung DFC_EGRVlvSCG" VALUE 0x800224A0 Val_Wu16 655350.0 DDRCTime_ms 0.00 655350.0 /end CHARACTERISTIC
/begin CHARACTERISTIC DDRC_DurDeb.EGRVlv_tiSCGDebDef_C "DDRC/Dauer der Fehlerentprellung für Prüfung DFC_EGRVlvSCG" VALUE 0x800224A2 Val_Wu16 655350.0 DDRCTime_ms 0.00 655350.0 /end CHARACTERISTIC
/begin CHARACTERISTIC DDRC_DurDeb.FlFltDsP_tiMinDebOk_C "DDRC/Dauer der Heilungsentprellung für Prüfung DFC_FlFltDsPSRCMin" VALUE 0x800224A4 Val_Wu16 655350.0 DDRCTime_ms 0.00 655350.0 /end CHARACTERISTIC
/begin CHARACTERISTIC DDRC_DurDeb.FlFltDsP_tiMinDebDef_C "DDRC/Dauer der Fehlerentprellung für Prüfung DFC_FlFltDsPSRCMin" VALUE 0x800224A6 Val_Wu16 655350.0 DDRCTime_ms 0.00 655350.0 /end CHARACTERISTIC
/begin CHARACTERISTIC DDRC_DurDeb.InjVlv_tiPresMinDebOk_C "DDRC/Dauer der Heilungsentprellung für Prüfung DFC_InjVlvPresMin" VALUE 0x800224A8 Val_Wu16 655350.0 DDRCTime_ms 0.00 655350.0 /end CHARACTERISTIC
/begin CHARACTERISTIC DDRC_DurDeb.InjVlv_tiPresMinDebDef_C "DDRC/Dauer der Fehlerentprellung für Prüfung DFC_InjVlvPresMin" VALUE 0x800224AA Val_Wu16 655350.0 DDRCTime_ms 0.00 655350.0 /end CHARACTERISTIC
/begin CHARACTERISTIC DDRC_DurDeb.Exh_tiLamPlausMaxNSCDsDebOk_C "DDRC/Dauer der Heilungsentprellung für Prüfung DFC_NSCDsLamPlausMax" VALUE 0x800224AC Val_Wu16 655350.0 DDRCTime_ms 0.00 655350.0 /end CHARACTERISTIC
/begin CHARACTERISTIC DDRC_DurDeb.Exh_tiLamPlausMaxNSCDsDebDef_C "DDRC/Dauer der Fehlerentprellung für Prüfung DFC_NSCDsLamPlausMax" VALUE 0x800224AE Val_Wu16 655350.0 DDRCTime_ms 0.00 655350.0 /end CHARACTERISTIC
/begin CHARACTERISTIC DDRC_DurDeb.Exh_tiNplDynPPFltDiffDebOk_C "DDRC/Dauer der Heilungsentprellung für Prüfung DFC_NplDynPPFltDiff" VALUE 0x800224B0 Val_Wu16 655350.0 DDRCTime_ms 0.00 655350.0 /end CHARACTERISTIC
/begin CHARACTERISTIC DDRC_DurDeb.Exh_tiNplDynPPFltDiffDebDef_C "DDRC/Dauer der Fehlerentprellung für Prüfung DFC_NplDynPPFltDiff" VALUE 0x800224B2 Val_Wu16 655350.0 DDRCTime_ms 0.00 655350.0 /end CHARACTERISTIC
/begin CHARACTERISTIC DDRC_DurDeb.TECU_tiSRCMaxDebOk_C "DDRC/Dauer der Heilungsentprellung für Prüfung DFC_SRCMaxTECU" VALUE 0x800224B4 Val_Wu16 655350.0 DDRCTime_ms 0.00 655350.0 /end CHARACTERISTIC
/begin CHARACTERISTIC DDRC_DurDeb.TECU_tiSRCMaxDebDef_C "DDRC/Dauer der Fehlerentprellung für Prüfung DFC_SRCMaxTECU" VALUE 0x800224B6 Val_Wu16 655350.0 DDRCTime_ms 0.00 655350.0 /end CHARACTERISTIC
/begin CHARACTERISTIC DDRC_DurDeb.AFS_tiCorSRCMaxDebOk_C "DDRC/Dauer der Heilungsentprellung für Prüfung DFC_AFSSRCCorMax" VALUE 0x800224B8 Val_Wu16 655350.0 DDRCTime_ms 0.00 655350.0 /end CHARACTERISTIC
/begin CHARACTERISTIC DDRC_DurDeb.AFS_tiCorSRCMaxDebDef_C "DDRC/Dauer der Fehlerentprellung für Prüfung DFC_AFSSRCCorMax" VALUE 0x800224BA Val_Wu16 655350.0 DDRCTime_ms 0.00 655350.0 /end CHARACTERISTIC
/begin CHARACTERISTIC DDRC_DurDeb.Exh_tiExhTMon3PlausDebOk_C "DDRC/Dauer der Heilungsentprellung für Prüfung DFC_ExhTMonPlausPos3" VALUE 0x800224BC Val_Wu16 655350.0 DDRCTime_ms 0.00 655350.0 /end CHARACTERISTIC
/begin CHARACTERISTIC DDRC_DurDeb.Exh_tiExhTMon3PlausDebDef_C "DDRC/Dauer der Fehlerentprellung für Prüfung DFC_ExhTMonPlausPos3" VALUE 0x800224BE Val_Wu16 655350.0 DDRCTime_ms 0.00 655350.0 /end CHARACTERISTIC
/begin CHARACTERISTIC DDRC_DurDeb.Exh_tiLamPlausMinNSCDsDebOk_C "DDRC/Dauer der Heilungsentprellung für Prüfung DFC_NSCDsLamPlausMin" VALUE 0x800224C0 Val_Wu16 655350.0 DDRCTime_ms 0.00 655350.0 /end CHARACTERISTIC
/begin CHARACTERISTIC DDRC_DurDeb.Exh_tiLamPlausMinNSCDsDebDef_C "DDRC/Dauer der Fehlerentprellung für Prüfung DFC_NSCDsLamPlausMin" VALUE 0x800224C2 Val_Wu16 655350.0 DDRCTime_ms 0.00 655350.0 /end CHARACTERISTIC
/begin CHARACTERISTIC DDRC_DurDeb.EGRVlvLP_tiHBrgShCirOvrLdDebOk_C "DDRC/Dauer der Heilungsentprellung für Prüfung DFC_EGRVlvLPHBrgShCirOvrLd" VALUE 0x800224C4 Val_Wu16 655350.0 DDRCTime_ms 0.00 655350.0 /end CHARACTERISTIC
/begin CHARACTERISTIC DDRC_DurDeb.EGRVlvLP_tiHBrgShCirOvrLdDebDef_C "DDRC/Dauer der Fehlerentprellung für Prüfung DFC_EGRVlvLPHBrgShCirOvrLd" VALUE 0x800224C6 Val_Wu16 655350.0 DDRCTime_ms 0.00 655350.0 /end CHARACTERISTIC
/begin CHARACTERISTIC DDRC_DurDeb.CrCUI_tiDetDebOk_C "DDRC/Dauer der Heilungsentprellung für Prüfung DFC_CrCUIDet" VALUE 0x800224C8 Val_Wu16 655350.0 DDRCTime_ms 0.00 655350.0 /end CHARACTERISTIC
/begin CHARACTERISTIC DDRC_DurDeb.CrCUI_tiDetDebDef_C "DDRC/Dauer der Fehlerentprellung für Prüfung DFC_CrCUIDet" VALUE 0x800224CA Val_Wu16 655350.0 DDRCTime_ms 0.00 655350.0 /end CHARACTERISTIC
/begin CHARACTERISTIC DDRC_DurDeb.CEngDsT_tiMaxDebOk_C "DDRC/Dauer der Heilungsentprellung für Prüfung DFC_CEngDsTSRCMax" VALUE 0x800224CC Val_Wu16 655350.0 DDRCTime_ms 0.00 655350.0 /end CHARACTERISTIC
/begin CHARACTERISTIC DDRC_DurDeb.CEngDsT_tiMaxDebDef_C "DDRC/Dauer der Fehlerentprellung für Prüfung DFC_CEngDsTSRCMax" VALUE 0x800224CE Val_Wu16 655350.0 DDRCTime_ms 0.00 655350.0 /end CHARACTERISTIC
/begin CHARACTERISTIC DDRC_DurDeb.MeUn_tiSCGDebOk_C "DDRC/Dauer der Heilungsentprellung für Prüfung DFC_MeUnSCG" VALUE 0x800224D0 Val_Wu16 655350.0 DDRCTime_ms 0.00 655350.0 /end CHARACTERISTIC
/begin CHARACTERISTIC DDRC_DurDeb.MeUn_tiSCGDebDef_C "DDRC/Dauer der Fehlerentprellung für Prüfung DFC_MeUnSCG" VALUE 0x800224D2 Val_Wu16 655350.0 DDRCTime_ms 0.00 655350.0 /end CHARACTERISTIC
/begin CHARACTERISTIC DDRC_DurDeb.FlFltUsP_tiMinDebOk_C "DDRC/Dauer der Heilungsentprellung für Prüfung DFC_FlFltUsPSRCMin" VALUE 0x800224D4 Val_Wu16 655350.0 DDRCTime_ms 0.00 655350.0 /end CHARACTERISTIC
/begin CHARACTERISTIC DDRC_DurDeb.FlFltUsP_tiMinDebDef_C "DDRC/Dauer der Fehlerentprellung für Prüfung DFC_FlFltUsPSRCMin" VALUE 0x800224D6 Val_Wu16 655350.0 DDRCTime_ms 0.00 655350.0 /end CHARACTERISTIC
/begin CHARACTERISTIC DDRC_DurDeb.EGRVlv_tiHBrgShCirOvrLdDebOk_C "DDRC/Dauer der Heilungsentprellung für Prüfung DFC_EGRVlvHBrgShCirOvrLd" VALUE 0x800224D8 Val_Wu16 655350.0 DDRCTime_ms 0.00 655350.0 /end CHARACTERISTIC
/begin CHARACTERISTIC DDRC_DurDeb.EGRVlv_tiHBrgShCirOvrLdDebDef_C "DDRC/Dauer der Fehlerentprellung für Prüfung DFC_EGRVlvHBrgShCirOvrLd" VALUE 0x800224DA Val_Wu16 655350.0 DDRCTime_ms 0.00 655350.0 /end CHARACTERISTIC
/begin CHARACTERISTIC DDRC_DurDeb.UHtrTnk_tiSCGDebOk_C "DDRC/Dauer der Heilungsentprellung für Prüfung DFC_UHtrTnkSCG" VALUE 0x800224DC Val_Wu16 655350.0 DDRCTime_ms 0.00 655350.0 /end CHARACTERISTIC
/begin CHARACTERISTIC DDRC_DurDeb.UHtrTnk_tiSCGDebDef_C "DDRC/Dauer der Fehlerentprellung für Prüfung DFC_UHtrTnkSCG" VALUE 0x800224DE Val_Wu16 655350.0 DDRCTime_ms 0.00 655350.0 /end CHARACTERISTIC
/begin CHARACTERISTIC DDRC_DurDeb.Exh_tiSRCLamLinNSCDsDebOk_C "DDRC/Dauer der Heilungsentprellung für Prüfung DFC_NSCDsLamLinSRCMax" VALUE 0x800224E0 Val_Wu16 655350.0 DDRCTime_ms 0.00 655350.0 /end CHARACTERISTIC
/begin CHARACTERISTIC DDRC_DurDeb.Exh_tiSRCLamLinNSCDsDebDef_C "DDRC/Dauer der Fehlerentprellung für Prüfung DFC_NSCDsLamLinSRCMax" VALUE 0x800224E2 Val_Wu16 655350.0 DDRCTime_ms 0.00 655350.0 /end CHARACTERISTIC
/begin CHARACTERISTIC DDRC_DurDeb.EngPrt_tiOvrSpdDebOk_C "DDRC/Dauer der Heilungsentprellung für Prüfung DFC_EngPrtOvrSpd" VALUE 0x800224E4 Val_Wu16 655350.0 DDRCTime_ms 0.00 655350.0 /end CHARACTERISTIC
/begin CHARACTERISTIC DDRC_DurDeb.EngPrt_tiOvrSpdDebDef_C "DDRC/Dauer der Fehlerentprellung für Prüfung DFC_EngPrtOvrSpd" VALUE 0x800224E6 Val_Wu16 655350.0 DDRCTime_ms 0.00 655350.0 /end CHARACTERISTIC
/begin CHARACTERISTIC DDRC_DurDeb.SCR_tiSRCMinUTnkTDebOk_C "DDRC/Dauer der Heilungsentprellung für Prüfung DFC_UTnkTSRCMin" VALUE 0x800224E8 Val_Wu16 655350.0 DDRCTime_ms 0.00 655350.0 /end CHARACTERISTIC
/begin CHARACTERISTIC DDRC_DurDeb.SCR_tiSRCMinUTnkTDebDef_C "DDRC/Dauer der Fehlerentprellung für Prüfung DFC_UTnkTSRCMin" VALUE 0x800224EA Val_Wu16 655350.0 DDRCTime_ms 0.00 655350.0 /end CHARACTERISTIC
/begin CHARACTERISTIC DDRC_DurDeb.UHtrPL_tiSRCMinDiaDebOk_C "DDRC/Dauer der Heilungsentprellung für Prüfung DFC_UHtrPLSRCMinDia" VALUE 0x800224EC Val_Wu16 655350.0 DDRCTime_ms 0.00 655350.0 /end CHARACTERISTIC
/begin CHARACTERISTIC DDRC_DurDeb.UHtrPL_tiSRCMinDiaDebDef_C "DDRC/Dauer der Fehlerentprellung für Prüfung DFC_UHtrPLSRCMinDia" VALUE 0x800224EE Val_Wu16 655350.0 DDRCTime_ms 0.00 655350.0 /end CHARACTERISTIC
/begin CHARACTERISTIC DDRC_DurDeb.FlFlt_tiSigDebOk_C "DDRC/Dauer der Heilungsentprellung für Prüfung DFC_FlFltSig" VALUE 0x800224F0 Val_Wu16 655350.0 DDRCTime_ms 0.00 655350.0 /end CHARACTERISTIC
/begin CHARACTERISTIC DDRC_DurDeb.FlFlt_tiSigDebDef_C "DDRC/Dauer der Fehlerentprellung für Prüfung DFC_FlFltSig" VALUE 0x800224F2 Val_Wu16 655350.0 DDRCTime_ms 0.00 655350.0 /end CHARACTERISTIC
/begin CHARACTERISTIC DDRC_DurDeb.FuelT_tiMaxDebOk_C "DDRC/Dauer der Heilungsentprellung für Prüfung DFC_FuelTSRCMax" VALUE 0x800224F4 Val_Wu16 655350.0 DDRCTime_ms 0.00 655350.0 /end CHARACTERISTIC
/begin CHARACTERISTIC DDRC_DurDeb.FuelT_tiMaxDebDef_C "DDRC/Dauer der Fehlerentprellung für Prüfung DFC_FuelTSRCMax" VALUE 0x800224F6 Val_Wu16 655350.0 DDRCTime_ms 0.00 655350.0 /end CHARACTERISTIC
/begin CHARACTERISTIC DDRC_DurDeb.SCR_tiSRCMinUCatUsTDebOk_C "DDRC/Dauer der Heilungsentprellung für Prüfung DFC_SRCMinUCatUsT" VALUE 0x800224F8 Val_Wu16 655350.0 DDRCTime_ms 0.00 655350.0 /end CHARACTERISTIC
/begin CHARACTERISTIC DDRC_DurDeb.SCR_tiSRCMinUCatUsTDebDef_C "DDRC/Dauer der Fehlerentprellung für Prüfung DFC_SRCMinUCatUsT" VALUE 0x800224FA Val_Wu16 655350.0 DDRCTime_ms 0.00 655350.0 /end CHARACTERISTIC
/begin CHARACTERISTIC DDRC_DurDeb.Exh_tiCmpChkNoCat2DsDebOk_C "DDRC/Dauer der Heilungsentprellung für Prüfung DFC_NoCat2DsCmpChk" VALUE 0x800224FC Val_Wu16 655350.0 DDRCTime_ms 0.00 655350.0 /end CHARACTERISTIC
/begin CHARACTERISTIC DDRC_DurDeb.Exh_tiCmpChkNoCat2DsDebDef_C "DDRC/Dauer der Fehlerentprellung für Prüfung DFC_NoCat2DsCmpChk" VALUE 0x800224FE Val_Wu16 655350.0 DDRCTime_ms 0.00 655350.0 /end CHARACTERISTIC
/begin CHARACTERISTIC DDRC_DurDeb.BrkP_tiMinDebOk_C "DDRC/Dauer der Heilungsentprellung für Prüfung DFC_BrkPSRCMin" VALUE 0x80022500 Val_Wu16 655350.0 DDRCTime_ms 0.00 655350.0 /end CHARACTERISTIC
/begin CHARACTERISTIC DDRC_DurDeb.BrkP_tiMinDebDef_C "DDRC/Dauer der Fehlerentprellung für Prüfung DFC_BrkPSRCMin" VALUE 0x80022502 Val_Wu16 655350.0 DDRCTime_ms 0.00 655350.0 /end CHARACTERISTIC
/begin CHARACTERISTIC DDRC_DurDeb.T15_tiNplDebOk_C "DDRC/Dauer der Heilungsentprellung für Prüfung DFC_T15Npl" VALUE 0x80022504 Val_Wu16 655350.0 DDRCTime_ms 0.00 655350.0 /end CHARACTERISTIC
/begin CHARACTERISTIC DDRC_DurDeb.T15_tiNplDebDef_C "DDRC/Dauer der Fehlerentprellung für Prüfung DFC_T15Npl" VALUE 0x80022506 Val_Wu16 655350.0 DDRCTime_ms 0.00 655350.0 /end CHARACTERISTIC
/begin CHARACTERISTIC DDRC_DurDeb.EGRVlv_tiHBrgTempOvrCurrDebOk_C "DDRC/Dauer der Heilungsentprellung für Prüfung DFC_EGRVlvHBrgTempOvrCurr" VALUE 0x80022508 Val_Wu16 655350.0 DDRCTime_ms 0.00 655350.0 /end CHARACTERISTIC
/begin CHARACTERISTIC DDRC_DurDeb.EGRVlv_tiHBrgTempOvrCurrDebDef_C "DDRC/Dauer der Fehlerentprellung für Prüfung DFC_EGRVlvHBrgTempOvrCurr" VALUE 0x8002250A Val_Wu16 655350.0 DDRCTime_ms 0.00 655350.0 /end CHARACTERISTIC
/begin CHARACTERISTIC DDRC_DurDeb.UHtrTnk_tiSCBDebOk_C "DDRC/Dauer der Heilungsentprellung für Prüfung DFC_UHtrTnkSCB" VALUE 0x8002250C Val_Wu16 655350.0 DDRCTime_ms 0.00 655350.0 /end CHARACTERISTIC
/begin CHARACTERISTIC DDRC_DurDeb.UHtrTnk_tiSCBDebDef_C "DDRC/Dauer der Fehlerentprellung für Prüfung DFC_UHtrTnkSCB" VALUE 0x8002250E Val_Wu16 655350.0 DDRCTime_ms 0.00 655350.0 /end CHARACTERISTIC
/begin CHARACTERISTIC DDRC_DurDeb.Exh_tiSRCNOxNoCat2DsDebOk_C "DDRC/Dauer der Heilungsentprellung für Prüfung DFC_NoCat2DsNOxSRCMin" VALUE 0x80022510 Val_Wu16 655350.0 DDRCTime_ms 0.00 655350.0 /end CHARACTERISTIC
/begin CHARACTERISTIC DDRC_DurDeb.Exh_tiSRCNOxNoCat2DsDebDef_C "DDRC/Dauer der Fehlerentprellung für Prüfung DFC_NoCat2DsNOxSRCMin" VALUE 0x80022512 Val_Wu16 655350.0 DDRCTime_ms 0.00 655350.0 /end CHARACTERISTIC
/begin CHARACTERISTIC DDRC_DurDeb.PFlt_tiDstrMinDebOk_C "DDRC/Dauer der Heilungsentprellung für Prüfung DFC_PFltDstrMin" VALUE 0x80022514 Val_Wu16 655350.0 DDRCTime_ms 0.00 655350.0 /end CHARACTERISTIC
/begin CHARACTERISTIC DDRC_DurDeb.PFlt_tiDstrMinDebDef_C "DDRC/Dauer der Fehlerentprellung für Prüfung DFC_PFltDstrMin" VALUE 0x80022516 Val_Wu16 655350.0 DDRCTime_ms 0.00 655350.0 /end CHARACTERISTIC
/begin CHARACTERISTIC DDRC_DurDeb.AFS_tiOffsDrftMaxDebOk_C "DDRC/Dauer der Heilungsentprellung für Prüfung DFC_AFSOffsDrftMax" VALUE 0x80022518 Val_Wu16 655350.0 DDRCTime_ms 0.00 655350.0 /end CHARACTERISTIC
/begin CHARACTERISTIC DDRC_DurDeb.AFS_tiOffsDrftMaxDebDef_C "DDRC/Dauer der Fehlerentprellung für Prüfung DFC_AFSOffsDrftMax" VALUE 0x8002251A Val_Wu16 655350.0 DDRCTime_ms 0.00 655350.0 /end CHARACTERISTIC
/begin CHARACTERISTIC DDRC_DurDeb.PFlt_tiSRCMinFlwRstnDebOk_C "DDRC/Dauer der Heilungsentprellung für Prüfung DFC_PFltSRCMinFlwRstn" VALUE 0x8002251C Val_Wu16 655350.0 DDRCTime_ms 0.00 655350.0 /end CHARACTERISTIC
/begin CHARACTERISTIC DDRC_DurDeb.PFlt_tiSRCMinFlwRstnDebDef_C "DDRC/Dauer der Fehlerentprellung für Prüfung DFC_PFltSRCMinFlwRstn" VALUE 0x8002251E Val_Wu16 655350.0 DDRCTime_ms 0.00 655350.0 /end CHARACTERISTIC
/begin CHARACTERISTIC DDRC_DurDeb.Exh_tiSRCMinTTrbnUsDebOk_C "DDRC/Dauer der Heilungsentprellung für Prüfung DFC_SRCMinTTrbnUs" VALUE 0x80022520 Val_Wu16 655350.0 DDRCTime_ms 0.00 655350.0 /end CHARACTERISTIC
/begin CHARACTERISTIC DDRC_DurDeb.Exh_tiSRCMinTTrbnUsDebDef_C "DDRC/Dauer der Fehlerentprellung für Prüfung DFC_SRCMinTTrbnUs" VALUE 0x80022522 Val_Wu16 655350.0 DDRCTime_ms 0.00 655350.0 /end CHARACTERISTIC
/begin CHARACTERISTIC DDRC_DurDeb.EGRVlvLP_tiSCGDebOk_C "DDRC/Dauer der Heilungsentprellung für Prüfung DFC_EGRVlvLPSCG" VALUE 0x80022524 Val_Wu16 655350.0 DDRCTime_ms 0.00 655350.0 /end CHARACTERISTIC
/begin CHARACTERISTIC DDRC_DurDeb.EGRVlvLP_tiSCGDebDef_C "DDRC/Dauer der Fehlerentprellung für Prüfung DFC_EGRVlvLPSCG" VALUE 0x80022526 Val_Wu16 655350.0 DDRCTime_ms 0.00 655350.0 /end CHARACTERISTIC
/begin CHARACTERISTIC DDRC_DurDeb.AirC_tiSwtNplDebOk_C "DDRC/Dauer der Heilungsentprellung für Prüfung DFC_AirCSwtNpl" VALUE 0x80022528 Val_Wu16 655350.0 DDRCTime_ms 0.00 655350.0 /end CHARACTERISTIC
/begin CHARACTERISTIC DDRC_DurDeb.AirC_tiSwtNplDebDef_C "DDRC/Dauer der Fehlerentprellung für Prüfung DFC_AirCSwtNpl" VALUE 0x8002252A Val_Wu16 655350.0 DDRCTime_ms 0.00 655350.0 /end CHARACTERISTIC
/begin CHARACTERISTIC DDRC_DurDeb.EGRVlv_tiHBrgShCirBatt1DebOk_C "DDRC/Dauer der Heilungsentprellung für Prüfung DFC_EGRVlvHBrgShCirBatt1" VALUE 0x8002252C Val_Wu16 655350.0 DDRCTime_ms 0.00 655350.0 /end CHARACTERISTIC
/begin CHARACTERISTIC DDRC_DurDeb.EGRVlv_tiHBrgShCirBatt1DebDef_C "DDRC/Dauer der Fehlerentprellung für Prüfung DFC_EGRVlvHBrgShCirBatt1" VALUE 0x8002252E Val_Wu16 655350.0 DDRCTime_ms 0.00 655350.0 /end CHARACTERISTIC
/begin CHARACTERISTIC DDRC_DurDeb.SCR_tiSRCMaxUPmpPDebOk_C "DDRC/Dauer der Heilungsentprellung für Prüfung DFC_SRCMaxUPmpP" VALUE 0x80022530 Val_Wu16 655350.0 DDRCTime_ms 0.00 655350.0 /end CHARACTERISTIC
/begin CHARACTERISTIC DDRC_DurDeb.SCR_tiSRCMaxUPmpPDebDef_C "DDRC/Dauer der Fehlerentprellung für Prüfung DFC_SRCMaxUPmpP" VALUE 0x80022532 Val_Wu16 655350.0 DDRCTime_ms 0.00 655350.0 /end CHARACTERISTIC
/begin CHARACTERISTIC DDRC_DurDeb.URevVlv_tiSCBDebOk_C "DDRC/Dauer der Heilungsentprellung für Prüfung DFC_URevVlvSCB" VALUE 0x80022534 Val_Wu16 655350.0 DDRCTime_ms 0.00 655350.0 /end CHARACTERISTIC
/begin CHARACTERISTIC DDRC_DurDeb.URevVlv_tiSCBDebDef_C "DDRC/Dauer der Fehlerentprellung für Prüfung DFC_URevVlvSCB" VALUE 0x80022536 Val_Wu16 655350.0 DDRCTime_ms 0.00 655350.0 /end CHARACTERISTIC
/begin CHARACTERISTIC DDRC_DurDeb.Exh_tiSigNSCDsDebOk_C "DDRC/Dauer der Heilungsentprellung für Prüfung DFC_NSCDsOpCir" VALUE 0x80022538 Val_Wu16 655350.0 DDRCTime_ms 0.00 655350.0 /end CHARACTERISTIC
/begin CHARACTERISTIC DDRC_DurDeb.Exh_tiSigNSCDsDebDef_C "DDRC/Dauer der Fehlerentprellung für Prüfung DFC_NSCDsOpCir" VALUE 0x8002253A Val_Wu16 655350.0 DDRCTime_ms 0.00 655350.0 /end CHARACTERISTIC
/begin CHARACTERISTIC DDRC_DurDeb.EGRVlvLP_tiHBrgUndrVltgDebOk_C "DDRC/Dauer der Heilungsentprellung für Prüfung DFC_EGRVlvLPHBrgUndrVltg" VALUE 0x8002253C Val_Wu16 655350.0 DDRCTime_ms 0.00 655350.0 /end CHARACTERISTIC
/begin CHARACTERISTIC DDRC_DurDeb.EGRVlvLP_tiHBrgUndrVltgDebDef_C "DDRC/Dauer der Fehlerentprellung für Prüfung DFC_EGRVlvLPHBrgUndrVltg" VALUE 0x8002253E Val_Wu16 655350.0 DDRCTime_ms 0.00 655350.0 /end CHARACTERISTIC
/begin CHARACTERISTIC DDRC_DurDeb.PFlt_tiEngPrtMaxDebOk_C "DDRC/Dauer der Heilungsentprellung für Prüfung DFC_PFltEngPrt" VALUE 0x80022540 Val_Wu16 655350.0 DDRCTime_ms 0.00 655350.0 /end CHARACTERISTIC
/begin CHARACTERISTIC DDRC_DurDeb.PFlt_tiEngPrtMaxDebDef_C "DDRC/Dauer der Fehlerentprellung für Prüfung DFC_PFltEngPrt" VALUE 0x80022542 Val_Wu16 655350.0 DDRCTime_ms 0.00 655350.0 /end CHARACTERISTIC
/begin CHARACTERISTIC DDRC_DurDeb.Exh_tiSigNoCat2DsDebOk_C "DDRC/Dauer der Heilungsentprellung für Prüfung DFC_NoCat2DsOpCir" VALUE 0x80022544 Val_Wu16 655350.0 DDRCTime_ms 0.00 655350.0 /end CHARACTERISTIC
/begin CHARACTERISTIC DDRC_DurDeb.Exh_tiSigNoCat2DsDebDef_C "DDRC/Dauer der Fehlerentprellung für Prüfung DFC_NoCat2DsOpCir" VALUE 0x80022546 Val_Wu16 655350.0 DDRCTime_ms 0.00 655350.0 /end CHARACTERISTIC
/begin CHARACTERISTIC DDRC_DurDeb.FlFltUsP_tiMaxDebOk_C "DDRC/Dauer der Heilungsentprellung für Prüfung DFC_FlFltUsPSRCMax" VALUE 0x80022548 Val_Wu16 655350.0 DDRCTime_ms 0.00 655350.0 /end CHARACTERISTIC
/begin CHARACTERISTIC DDRC_DurDeb.FlFltUsP_tiMaxDebDef_C "DDRC/Dauer der Fehlerentprellung für Prüfung DFC_FlFltUsPSRCMax" VALUE 0x8002254A Val_Wu16 655350.0 DDRCTime_ms 0.00 655350.0 /end CHARACTERISTIC
/begin CHARACTERISTIC DDRC_DurDeb.VSwVlv_tiHBrgShCirOvrLdDebOk_C "DDRC/Dauer der Heilungsentprellung für Prüfung DFC_VSwVlvHBrgShCirOvrLd" VALUE 0x8002254C Val_Wu16 655350.0 DDRCTime_ms 0.00 655350.0 /end CHARACTERISTIC
/begin CHARACTERISTIC DDRC_DurDeb.VSwVlv_tiHBrgShCirOvrLdDebDef_C "DDRC/Dauer der Fehlerentprellung für Prüfung DFC_VSwVlvHBrgShCirOvrLd" VALUE 0x8002254E Val_Wu16 655350.0 DDRCTime_ms 0.00 655350.0 /end CHARACTERISTIC
/begin CHARACTERISTIC DDRC_DurDeb.SCR_tiSRCMaxUTnkTDebOk_C "DDRC/Dauer der Heilungsentprellung für Prüfung DFC_UTnkTSRCMax" VALUE 0x80022550 Val_Wu16 655350.0 DDRCTime_ms 0.00 655350.0 /end CHARACTERISTIC
/begin CHARACTERISTIC DDRC_DurDeb.SCR_tiSRCMaxUTnkTDebDef_C "DDRC/Dauer der Fehlerentprellung für Prüfung DFC_UTnkTSRCMax" VALUE 0x80022552 Val_Wu16 655350.0 DDRCTime_ms 0.00 655350.0 /end CHARACTERISTIC
/begin CHARACTERISTIC DDRC_DurDeb.GbxNPos_tiSRCPerMinDebOk_C "DDRC/Dauer der Heilungsentprellung für Prüfung DFC_GbxNPosPPerSRCMin" VALUE 0x80022554 Val_Wu16 655350.0 DDRCTime_ms 0.00 655350.0 /end CHARACTERISTIC
/begin CHARACTERISTIC DDRC_DurDeb.GbxNPos_tiSRCPerMinDebDef_C "DDRC/Dauer der Fehlerentprellung für Prüfung DFC_GbxNPosPPerSRCMin" VALUE 0x80022556 Val_Wu16 655350.0 DDRCTime_ms 0.00 655350.0 /end CHARACTERISTIC
/begin CHARACTERISTIC DDRC_DurDeb.EGRVlvLP_tiGovDvtMaxDebOk_C "DDRC/Dauer der Heilungsentprellung für Prüfung DFC_EGRVlvLPGovDvtMax" VALUE 0x80022558 Val_Wu16 655350.0 DDRCTime_ms 0.00 655350.0 /end CHARACTERISTIC
/begin CHARACTERISTIC DDRC_DurDeb.EGRVlvLP_tiGovDvtMaxDebDef_C "DDRC/Dauer der Fehlerentprellung für Prüfung DFC_EGRVlvLPGovDvtMax" VALUE 0x8002255A Val_Wu16 655350.0 DDRCTime_ms 0.00 655350.0 /end CHARACTERISTIC
/begin CHARACTERISTIC DDRC_DurDeb.Exh_tiSRCLamBinNoCat2DsDebOk_C "DDRC/Dauer der Heilungsentprellung für Prüfung DFC_NoCat2DsLamBinSRCMin" VALUE 0x8002255C Val_Wu16 655350.0 DDRCTime_ms 0.00 655350.0 /end CHARACTERISTIC
/begin CHARACTERISTIC DDRC_DurDeb.Exh_tiSRCLamBinNoCat2DsDebDef_C "DDRC/Dauer der Fehlerentprellung für Prüfung DFC_NoCat2DsLamBinSRCMin" VALUE 0x8002255E Val_Wu16 655350.0 DDRCTime_ms 0.00 655350.0 /end CHARACTERISTIC
/begin CHARACTERISTIC DDRC_DurDeb.AFS_tiRawSRCMaxDebOk_C "DDRC/Dauer der Heilungsentprellung für Prüfung DFC_AFSSRCRawMax" VALUE 0x80022560 Val_Wu16 655350.0 DDRCTime_ms 0.00 655350.0 /end CHARACTERISTIC
/begin CHARACTERISTIC DDRC_DurDeb.AFS_tiRawSRCMaxDebDef_C "DDRC/Dauer der Fehlerentprellung für Prüfung DFC_AFSSRCRawMax" VALUE 0x80022562 Val_Wu16 655350.0 DDRCTime_ms 0.00 655350.0 /end CHARACTERISTIC
/begin CHARACTERISTIC DDRC_DurDeb.UHtrPL_tiSCGDebOk_C "DDRC/Dauer der Heilungsentprellung für Prüfung DFC_UHtrPLSCG" VALUE 0x80022564 Val_Wu16 655350.0 DDRCTime_ms 0.00 655350.0 /end CHARACTERISTIC
/begin CHARACTERISTIC DDRC_DurDeb.UHtrPL_tiSCGDebDef_C "DDRC/Dauer der Fehlerentprellung für Prüfung DFC_UHtrPLSCG" VALUE 0x80022566 Val_Wu16 655350.0 DDRCTime_ms 0.00 655350.0 /end CHARACTERISTIC
/begin CHARACTERISTIC DDRC_DurDeb.UHtrPL_tiSCBDebOk_C "DDRC/Dauer der Heilungsentprellung für Prüfung DFC_UHtrPLSCB" VALUE 0x80022568 Val_Wu16 655350.0 DDRCTime_ms 0.00 655350.0 /end CHARACTERISTIC
/begin CHARACTERISTIC DDRC_DurDeb.UHtrPL_tiSCBDebDef_C "DDRC/Dauer der Fehlerentprellung für Prüfung DFC_UHtrPLSCB" VALUE 0x8002256A Val_Wu16 655350.0 DDRCTime_ms 0.00 655350.0 /end CHARACTERISTIC
/begin CHARACTERISTIC DDRC_DurDeb.VSwVlv_tiHBrgShCirGnd2DebOk_C "DDRC/Dauer der Heilungsentprellung für Prüfung DFC_VSwVlvHBrgShCirGnd2" VALUE 0x8002256C Val_Wu16 655350.0 DDRCTime_ms 0.00 655350.0 /end CHARACTERISTIC
/begin CHARACTERISTIC DDRC_DurDeb.VSwVlv_tiHBrgShCirGnd2DebDef_C "DDRC/Dauer der Fehlerentprellung für Prüfung DFC_VSwVlvHBrgShCirGnd2" VALUE 0x8002256E Val_Wu16 655350.0 DDRCTime_ms 0.00 655350.0 /end CHARACTERISTIC
/begin CHARACTERISTIC DDRC_DurDeb.URevVlv_tiSCGDebOk_C "DDRC/Dauer der Heilungsentprellung für Prüfung DFC_URevVlvSCG" VALUE 0x80022570 Val_Wu16 655350.0 DDRCTime_ms 0.00 655350.0 /end CHARACTERISTIC
/begin CHARACTERISTIC DDRC_DurDeb.URevVlv_tiSCGDebDef_C "DDRC/Dauer der Fehlerentprellung für Prüfung DFC_URevVlvSCG" VALUE 0x80022572 Val_Wu16 655350.0 DDRCTime_ms 0.00 655350.0 /end CHARACTERISTIC
/begin CHARACTERISTIC DDRC_DurDeb.Exh_tiSRCNOxNSCDsDebOk_C "DDRC/Dauer der Heilungsentprellung für Prüfung DFC_NSCDsNOxSRCMin" VALUE 0x80022574 Val_Wu16 655350.0 DDRCTime_ms 0.00 655350.0 /end CHARACTERISTIC
/begin CHARACTERISTIC DDRC_DurDeb.Exh_tiSRCNOxNSCDsDebDef_C "DDRC/Dauer der Fehlerentprellung für Prüfung DFC_NSCDsNOxSRCMin" VALUE 0x80022576 Val_Wu16 655350.0 DDRCTime_ms 0.00 655350.0 /end CHARACTERISTIC
/begin CHARACTERISTIC DDRC_DurDeb.BattU_tiMaxDebOk_C "DDRC/Dauer der Heilungsentprellung für Prüfung DFC_BattUSRCMax" VALUE 0x80022578 Val_Wu16 655350.0 DDRCTime_ms 0.00 655350.0 /end CHARACTERISTIC
/begin CHARACTERISTIC DDRC_DurDeb.BattU_tiMaxDebDef_C "DDRC/Dauer der Fehlerentprellung für Prüfung DFC_BattUSRCMax" VALUE 0x8002257A Val_Wu16 655350.0 DDRCTime_ms 0.00 655350.0 /end CHARACTERISTIC
/begin CHARACTERISTIC DDRC_DurDeb.Air_tiMinTCACDsDebOk_C "DDRC/Dauer der Heilungsentprellung für Prüfung DFC_TCACDsSRCMin" VALUE 0x8002257C Val_Wu16 655350.0 DDRCTime_ms 0.00 655350.0 /end CHARACTERISTIC
/begin CHARACTERISTIC DDRC_DurDeb.Air_tiMinTCACDsDebDef_C "DDRC/Dauer der Fehlerentprellung für Prüfung DFC_TCACDsSRCMin" VALUE 0x8002257E Val_Wu16 655350.0 DDRCTime_ms 0.00 655350.0 /end CHARACTERISTIC
/begin CHARACTERISTIC DDRC_DurDeb.EGRVlv_tiSCBDebOk_C "DDRC/Dauer der Heilungsentprellung für Prüfung DFC_EGRVlvSCB" VALUE 0x80022580 Val_Wu16 655350.0 DDRCTime_ms 0.00 655350.0 /end CHARACTERISTIC
/begin CHARACTERISTIC DDRC_DurDeb.EGRVlv_tiSCBDebDef_C "DDRC/Dauer der Fehlerentprellung für Prüfung DFC_EGRVlvSCB" VALUE 0x80022582 Val_Wu16 655350.0 DDRCTime_ms 0.00 655350.0 /end CHARACTERISTIC
/begin CHARACTERISTIC DDRC_DurDeb.FuelT_tiMinDebOk_C "DDRC/Dauer der Heilungsentprellung für Prüfung DFC_FuelTSRCMin" VALUE 0x80022584 Val_Wu16 655350.0 DDRCTime_ms 0.00 655350.0 /end CHARACTERISTIC
/begin CHARACTERISTIC DDRC_DurDeb.FuelT_tiMinDebDef_C "DDRC/Dauer der Fehlerentprellung für Prüfung DFC_FuelTSRCMin" VALUE 0x80022586 Val_Wu16 655350.0 DDRCTime_ms 0.00 655350.0 /end CHARACTERISTIC
/begin CHARACTERISTIC DDRC_DurDeb.Oil_tiSRCMaxPSwmpDebOk_C "DDRC/Dauer der Heilungsentprellung für Prüfung DFC_OilPSwmpSRCMax" VALUE 0x80022588 Val_Wu16 655350.0 DDRCTime_ms 0.00 655350.0 /end CHARACTERISTIC
/begin CHARACTERISTIC DDRC_DurDeb.Oil_tiSRCMaxPSwmpDebDef_C "DDRC/Dauer der Fehlerentprellung für Prüfung DFC_OilPSwmpSRCMax" VALUE 0x8002258A Val_Wu16 655350.0 DDRCTime_ms 0.00 655350.0 /end CHARACTERISTIC
/begin CHARACTERISTIC DDRC_DurDeb.EGRVlv_tiHBrgShCirGnd2DebOk_C "DDRC/Dauer der Heilungsentprellung für Prüfung DFC_EGRVlvHBrgShCirGnd2" VALUE 0x8002258C Val_Wu16 655350.0 DDRCTime_ms 0.00 655350.0 /end CHARACTERISTIC
/begin CHARACTERISTIC DDRC_DurDeb.EGRVlv_tiHBrgShCirGnd2DebDef_C "DDRC/Dauer der Fehlerentprellung für Prüfung DFC_EGRVlvHBrgShCirGnd2" VALUE 0x8002258E Val_Wu16 655350.0 DDRCTime_ms 0.00 655350.0 /end CHARACTERISTIC
/begin CHARACTERISTIC DDRC_DurDeb.Exh_tiNplTTrbnUsDebOk_C "DDRC/Dauer der Heilungsentprellung für Prüfung DFC_NplTTrbnUs" VALUE 0x80022590 Val_Wu16 655350.0 DDRCTime_ms 0.00 655350.0 /end CHARACTERISTIC
/begin CHARACTERISTIC DDRC_DurDeb.Exh_tiNplTTrbnUsDebDef_C "DDRC/Dauer der Fehlerentprellung für Prüfung DFC_NplTTrbnUs" VALUE 0x80022592 Val_Wu16 655350.0 DDRCTime_ms 0.00 655350.0 /end CHARACTERISTIC
/begin CHARACTERISTIC DDRC_DurDeb.EGRVlvLP_tiHBrgShCirBatt2DebOk_C "DDRC/Dauer der Heilungsentprellung für Prüfung DFC_EGRVlvLPHBrgShCirBatt2" VALUE 0x80022594 Val_Wu16 655350.0 DDRCTime_ms 0.00 655350.0 /end CHARACTERISTIC
/begin CHARACTERISTIC DDRC_DurDeb.EGRVlvLP_tiHBrgShCirBatt2DebDef_C "DDRC/Dauer der Fehlerentprellung für Prüfung DFC_EGRVlvLPHBrgShCirBatt2" VALUE 0x80022596 Val_Wu16 655350.0 DDRCTime_ms 0.00 655350.0 /end CHARACTERISTIC
/begin CHARACTERISTIC DDRC_DurDeb.Air_tiMaxTCACDsDebOk_C "DDRC/Dauer der Heilungsentprellung für Prüfung DFC_TCACDsSRCMax" VALUE 0x80022598 Val_Wu16 655350.0 DDRCTime_ms 0.00 655350.0 /end CHARACTERISTIC
/begin CHARACTERISTIC DDRC_DurDeb.Air_tiMaxTCACDsDebDef_C "DDRC/Dauer der Fehlerentprellung für Prüfung DFC_TCACDsSRCMax" VALUE 0x8002259A Val_Wu16 655350.0 DDRCTime_ms 0.00 655350.0 /end CHARACTERISTIC
/begin CHARACTERISTIC DDRC_DurDeb.TrbChLP_tiSCGDebOk_C "DDRC/Dauer der Heilungsentprellung für Prüfung DFC_TrbChLPSCG" VALUE 0x8002259C Val_Wu16 655350.0 DDRCTime_ms 0.00 655350.0 /end CHARACTERISTIC
/begin CHARACTERISTIC DDRC_DurDeb.TrbChLP_tiSCGDebDef_C "DDRC/Dauer der Fehlerentprellung für Prüfung DFC_TrbChLPSCG" VALUE 0x8002259E Val_Wu16 655350.0 DDRCTime_ms 0.00 655350.0 /end CHARACTERISTIC
/begin CHARACTERISTIC DDRC_DurDeb.LSU_tiO2MaxDebOk_C "DDRC/Dauer der Heilungsentprellung für Prüfung DFC_LSUO2Max" VALUE 0x800225A0 Val_Wu16 655350.0 DDRCTime_ms 0.00 655350.0 /end CHARACTERISTIC
/begin CHARACTERISTIC DDRC_DurDeb.LSU_tiO2MaxDebDef_C "DDRC/Dauer der Fehlerentprellung für Prüfung DFC_LSUO2Max" VALUE 0x800225A2 Val_Wu16 655350.0 DDRCTime_ms 0.00 655350.0 /end CHARACTERISTIC
/begin CHARACTERISTIC DDRC_DurDeb.Exh_tiNplTPFltUsDebOk_C "DDRC/Dauer der Heilungsentprellung für Prüfung DFC_NplTPFltUs" VALUE 0x800225A4 Val_Wu16 655350.0 DDRCTime_ms 0.00 655350.0 /end CHARACTERISTIC
/begin CHARACTERISTIC DDRC_DurDeb.Exh_tiNplTPFltUsDebDef_C "DDRC/Dauer der Fehlerentprellung für Prüfung DFC_NplTPFltUs" VALUE 0x800225A6 Val_Wu16 655350.0 DDRCTime_ms 0.00 655350.0 /end CHARACTERISTIC
/begin CHARACTERISTIC DDRC_DurDeb.LSU_tiOpnLdDebOk_C "DDRC/Dauer der Heilungsentprellung für Prüfung DFC_LSUCircVirtGndSig" VALUE 0x800225A8 Val_Wu16 655350.0 DDRCTime_ms 0.00 655350.0 /end CHARACTERISTIC
/begin CHARACTERISTIC DDRC_DurDeb.LSU_tiOpnLdDebDef_C "DDRC/Dauer der Fehlerentprellung für Prüfung DFC_LSUCircVirtGndSig" VALUE 0x800225AA Val_Wu16 655350.0 DDRCTime_ms 0.00 655350.0 /end CHARACTERISTIC
/begin CHARACTERISTIC DDRC_DurDeb.EGRVlvLP_tiSRCMinDebOk_C "DDRC/Dauer der Heilungsentprellung für Prüfung DFC_EGRVlvLPSRCMin" VALUE 0x800225AC Val_Wu16 655350.0 DDRCTime_ms 0.00 655350.0 /end CHARACTERISTIC
/begin CHARACTERISTIC DDRC_DurDeb.EGRVlvLP_tiSRCMinDebDef_C "DDRC/Dauer der Fehlerentprellung für Prüfung DFC_EGRVlvLPSRCMin" VALUE 0x800225AE Val_Wu16 655350.0 DDRCTime_ms 0.00 655350.0 /end CHARACTERISTIC
/begin CHARACTERISTIC DDRC_DurDeb.TECU_tiOvrTempDebOk_C "DDRC/Dauer der Heilungsentprellung für Prüfung DFC_ECUOvrTemp" VALUE 0x800225B0 Val_Wu16 655350.0 DDRCTime_ms 0.00 655350.0 /end CHARACTERISTIC
/begin CHARACTERISTIC DDRC_DurDeb.TECU_tiOvrTempDebDef_C "DDRC/Dauer der Fehlerentprellung für Prüfung DFC_ECUOvrTemp" VALUE 0x800225B2 Val_Wu16 655350.0 DDRCTime_ms 0.00 655350.0 /end CHARACTERISTIC
/begin CHARACTERISTIC DDRC_DurDeb.AFS_tiSetyDrftMinDebOk_C "DDRC/Dauer der Heilungsentprellung für Prüfung DFC_AFSSetyDrftMin" VALUE 0x800225B4 Val_Wu16 655350.0 DDRCTime_ms 0.00 655350.0 /end CHARACTERISTIC
/begin CHARACTERISTIC DDRC_DurDeb.AFS_tiSetyDrftMinDebDef_C "DDRC/Dauer der Fehlerentprellung für Prüfung DFC_AFSSetyDrftMin" VALUE 0x800225B6 Val_Wu16 655350.0 DDRCTime_ms 0.00 655350.0 /end CHARACTERISTIC
/begin CHARACTERISTIC DDRC_DurDeb.VSwVlv_tiGovDvtMinDebOk_C "DDRC/Dauer der Heilungsentprellung für Prüfung DFC_VSwVlvGovDvtMin" VALUE 0x800225B8 Val_Wu16 655350.0 DDRCTime_ms 0.00 655350.0 /end CHARACTERISTIC
/begin CHARACTERISTIC DDRC_DurDeb.VSwVlv_tiGovDvtMinDebDef_C "DDRC/Dauer der Fehlerentprellung für Prüfung DFC_VSwVlvGovDvtMin" VALUE 0x800225BA Val_Wu16 655350.0 DDRCTime_ms 0.00 655350.0 /end CHARACTERISTIC
/begin CHARACTERISTIC DDRC_DurDeb.CEngDsT_tiMinDebOk_C "DDRC/Dauer der Heilungsentprellung für Prüfung DFC_CEngDsTSRCMin" VALUE 0x800225BC Val_Wu16 655350.0 DDRCTime_ms 0.00 655350.0 /end CHARACTERISTIC
/begin CHARACTERISTIC DDRC_DurDeb.CEngDsT_tiMinDebDef_C "DDRC/Dauer der Fehlerentprellung für Prüfung DFC_CEngDsTSRCMin" VALUE 0x800225BE Val_Wu16 655350.0 DDRCTime_ms 0.00 655350.0 /end CHARACTERISTIC
/begin CHARACTERISTIC DDRC_DurDeb.SCR_tiSRCMinUPmpPDebOk_C "DDRC/Dauer der Heilungsentprellung für Prüfung DFC_SRCMinUPmpP" VALUE 0x800225C0 Val_Wu16 655350.0 DDRCTime_ms 0.00 655350.0 /end CHARACTERISTIC
/begin CHARACTERISTIC DDRC_DurDeb.SCR_tiSRCMinUPmpPDebDef_C "DDRC/Dauer der Fehlerentprellung für Prüfung DFC_SRCMinUPmpP" VALUE 0x800225C2 Val_Wu16 655350.0 DDRCTime_ms 0.00 655350.0 /end CHARACTERISTIC
/begin CHARACTERISTIC DDRC_DurDeb.EGRVlvLP_tiHBrgOvrCurrDebOk_C "DDRC/Dauer der Heilungsentprellung für Prüfung DFC_EGRVlvLPHBrgOvrCurr" VALUE 0x800225C4 Val_Wu16 655350.0 DDRCTime_ms 0.00 655350.0 /end CHARACTERISTIC
/begin CHARACTERISTIC DDRC_DurDeb.EGRVlvLP_tiHBrgOvrCurrDebDef_C "DDRC/Dauer der Fehlerentprellung für Prüfung DFC_EGRVlvLPHBrgOvrCurr" VALUE 0x800225C6 Val_Wu16 655350.0 DDRCTime_ms 0.00 655350.0 /end CHARACTERISTIC
/begin CHARACTERISTIC DDRC_DurDeb.ThrVlv_tiSRCMaxDebOk_C "DDRC/Dauer der Heilungsentprellung für Prüfung DFC_ThrVlvSRCMax" VALUE 0x800225C8 Val_Wu16 655350.0 DDRCTime_ms 0.00 655350.0 /end CHARACTERISTIC
/begin CHARACTERISTIC DDRC_DurDeb.ThrVlv_tiSRCMaxDebDef_C "DDRC/Dauer der Fehlerentprellung für Prüfung DFC_ThrVlvSRCMax" VALUE 0x800225CA Val_Wu16 655350.0 DDRCTime_ms 0.00 655350.0 /end CHARACTERISTIC
/begin CHARACTERISTIC DDRC_DurDeb.EnvP_tiMinDebOk_C "DDRC/Dauer der Heilungsentprellung für Prüfung DFC_EnvPSRCMin" VALUE 0x800225CC Val_Wu16 655350.0 DDRCTime_ms 0.00 655350.0 /end CHARACTERISTIC
/begin CHARACTERISTIC DDRC_DurDeb.EnvP_tiMinDebDef_C "DDRC/Dauer der Fehlerentprellung für Prüfung DFC_EnvPSRCMin" VALUE 0x800225CE Val_Wu16 655350.0 DDRCTime_ms 0.00 655350.0 /end CHARACTERISTIC
/begin CHARACTERISTIC DDRC_DurDeb.LSU_tiShCirDebOk_C "DDRC/Dauer der Heilungsentprellung für Prüfung DFC_LSUWireSCG" VALUE 0x800225D0 Val_Wu16 655350.0 DDRCTime_ms 0.00 655350.0 /end CHARACTERISTIC
/begin CHARACTERISTIC DDRC_DurDeb.LSU_tiShCirDebDef_C "DDRC/Dauer der Fehlerentprellung für Prüfung DFC_LSUWireSCG" VALUE 0x800225D2 Val_Wu16 655350.0 DDRCTime_ms 0.00 655350.0 /end CHARACTERISTIC
/begin CHARACTERISTIC DDRC_DurDeb.EGRVlv_tiHBrgShCirBatt2DebOk_C "DDRC/Dauer der Heilungsentprellung für Prüfung DFC_EGRVlvHBrgShCirBatt2" VALUE 0x800225D4 Val_Wu16 655350.0 DDRCTime_ms 0.00 655350.0 /end CHARACTERISTIC
/begin CHARACTERISTIC DDRC_DurDeb.EGRVlv_tiHBrgShCirBatt2DebDef_C "DDRC/Dauer der Fehlerentprellung für Prüfung DFC_EGRVlvHBrgShCirBatt2" VALUE 0x800225D6 Val_Wu16 655350.0 DDRCTime_ms 0.00 655350.0 /end CHARACTERISTIC
/begin CHARACTERISTIC DDRC_DurDeb.AFS_tiSetyDrftMaxDebOk_C "DDRC/Dauer der Heilungsentprellung für Prüfung DFC_AFSSetyDrftMax" VALUE 0x800225D8 Val_Wu16 655350.0 DDRCTime_ms 0.00 655350.0 /end CHARACTERISTIC
/begin CHARACTERISTIC DDRC_DurDeb.AFS_tiSetyDrftMaxDebDef_C "DDRC/Dauer der Fehlerentprellung für Prüfung DFC_AFSSetyDrftMax" VALUE 0x800225DA Val_Wu16 655350.0 DDRCTime_ms 0.00 655350.0 /end CHARACTERISTIC
/begin CHARACTERISTIC DDRC_DurDeb.VSwVlv_tiHBrgOvrTempDebOk_C "DDRC/Dauer der Heilungsentprellung für Prüfung DFC_VSwVlvHBrgOvrTemp" VALUE 0x800225DC Val_Wu16 655350.0 DDRCTime_ms 0.00 655350.0 /end CHARACTERISTIC
/begin CHARACTERISTIC DDRC_DurDeb.VSwVlv_tiHBrgOvrTempDebDef_C "DDRC/Dauer der Fehlerentprellung für Prüfung DFC_VSwVlvHBrgOvrTemp" VALUE 0x800225DE Val_Wu16 655350.0 DDRCTime_ms 0.00 655350.0 /end CHARACTERISTIC
/begin CHARACTERISTIC DDRC_DurDeb.Exh_tiSRCMaxTPFltUsDebOk_C "DDRC/Dauer der Heilungsentprellung für Prüfung DFC_SRCMaxTPFltUs" VALUE 0x800225E0 Val_Wu16 655350.0 DDRCTime_ms 0.00 655350.0 /end CHARACTERISTIC
/begin CHARACTERISTIC DDRC_DurDeb.Exh_tiSRCMaxTPFltUsDebDef_C "DDRC/Dauer der Fehlerentprellung für Prüfung DFC_SRCMaxTPFltUs" VALUE 0x800225E2 Val_Wu16 655350.0 DDRCTime_ms 0.00 655350.0 /end CHARACTERISTIC
/begin CHARACTERISTIC DDRC_DurDeb.EGRVlvLP_tiSRCMaxDebOk_C "DDRC/Dauer der Heilungsentprellung für Prüfung DFC_EGRVlvLPSRCMax" VALUE 0x800225E4 Val_Wu16 655350.0 DDRCTime_ms 0.00 655350.0 /end CHARACTERISTIC
/begin CHARACTERISTIC DDRC_DurDeb.EGRVlvLP_tiSRCMaxDebDef_C "DDRC/Dauer der Fehlerentprellung für Prüfung DFC_EGRVlvLPSRCMax" VALUE 0x800225E6 Val_Wu16 655350.0 DDRCTime_ms 0.00 655350.0 /end CHARACTERISTIC
/begin CHARACTERISTIC DDRC_DurDeb.EGRVlv_tiHBrgOvrCurrDebOk_C "DDRC/Dauer der Heilungsentprellung für Prüfung DFC_EGRVlvHBrgOvrCurr" VALUE 0x800225E8 Val_Wu16 655350.0 DDRCTime_ms 0.00 655350.0 /end CHARACTERISTIC
/begin CHARACTERISTIC DDRC_DurDeb.EGRVlv_tiHBrgOvrCurrDebDef_C "DDRC/Dauer der Fehlerentprellung für Prüfung DFC_EGRVlvHBrgOvrCurr" VALUE 0x800225EA Val_Wu16 655350.0 DDRCTime_ms 0.00 655350.0 /end CHARACTERISTIC
/begin CHARACTERISTIC DDRC_DurDeb.EGRVlv_tiOLDebOk_C "DDRC/Dauer der Heilungsentprellung für Prüfung DFC_EGRVlvOL" VALUE 0x800225EC Val_Wu16 655350.0 DDRCTime_ms 0.00 655350.0 /end CHARACTERISTIC
/begin CHARACTERISTIC DDRC_DurDeb.EGRVlv_tiOLDebDef_C "DDRC/Dauer der Fehlerentprellung für Prüfung DFC_EGRVlvOL" VALUE 0x800225EE Val_Wu16 655350.0 DDRCTime_ms 0.00 655350.0 /end CHARACTERISTIC
/begin CHARACTERISTIC DDRC_DurDeb.AFS_tiOffsDrftMinDebOk_C "DDRC/Dauer der Heilungsentprellung für Prüfung DFC_AFSOffsDrftMin" VALUE 0x800225F0 Val_Wu16 655350.0 DDRCTime_ms 0.00 655350.0 /end CHARACTERISTIC
/begin CHARACTERISTIC DDRC_DurDeb.AFS_tiOffsDrftMinDebDef_C "DDRC/Dauer der Fehlerentprellung für Prüfung DFC_AFSOffsDrftMin" VALUE 0x800225F2 Val_Wu16 655350.0 DDRCTime_ms 0.00 655350.0 /end CHARACTERISTIC
/begin CHARACTERISTIC DDRC_DurDeb.UHtrTnk_tiSRCMaxDiaDebOk_C "DDRC/Dauer der Heilungsentprellung für Prüfung DFC_UHtrTnkSRCMaxDia" VALUE 0x800225F4 Val_Wu16 655350.0 DDRCTime_ms 0.00 655350.0 /end CHARACTERISTIC
/begin CHARACTERISTIC DDRC_DurDeb.UHtrTnk_tiSRCMaxDiaDebDef_C "DDRC/Dauer der Fehlerentprellung für Prüfung DFC_UHtrTnkSRCMaxDia" VALUE 0x800225F6 Val_Wu16 655350.0 DDRCTime_ms 0.00 655350.0 /end CHARACTERISTIC
/begin CHARACTERISTIC DDRC_DurDeb.PFlt_tiCharPDiffMinDebOk_C "DDRC/Dauer der Heilungsentprellung für Prüfung DFC_PFltCharPDiffMin" VALUE 0x800225F8 Val_Wu16 655350.0 DDRCTime_ms 0.00 655350.0 /end CHARACTERISTIC
/begin CHARACTERISTIC DDRC_DurDeb.PFlt_tiCharPDiffMinDebDef_C "DDRC/Dauer der Fehlerentprellung für Prüfung DFC_PFltCharPDiffMin" VALUE 0x800225FA Val_Wu16 655350.0 DDRCTime_ms 0.00 655350.0 /end CHARACTERISTIC
/begin CHARACTERISTIC DDRC_DurDeb.Exh_tiHsLnPPFltDiffDebOk_C "DDRC/Dauer der Heilungsentprellung für Prüfung DFC_NplHsLnPPFltDiff" VALUE 0x800225FC Val_Wu16 655350.0 DDRCTime_ms 0.00 655350.0 /end CHARACTERISTIC
/begin CHARACTERISTIC DDRC_DurDeb.Exh_tiHsLnPPFltDiffDebDef_C "DDRC/Dauer der Fehlerentprellung für Prüfung DFC_NplHsLnPPFltDiff" VALUE 0x800225FE Val_Wu16 655350.0 DDRCTime_ms 0.00 655350.0 /end CHARACTERISTIC
/begin CHARACTERISTIC DDRC_DurDeb.Exh_tiExhTMon1PlausDebOk_C "DDRC/Dauer der Heilungsentprellung für Prüfung DFC_ExhTMonPlausPos1" VALUE 0x80022600 Val_Wu16 655350.0 DDRCTime_ms 0.00 655350.0 /end CHARACTERISTIC
/begin CHARACTERISTIC DDRC_DurDeb.Exh_tiExhTMon1PlausDebDef_C "DDRC/Dauer der Fehlerentprellung für Prüfung DFC_ExhTMonPlausPos1" VALUE 0x80022602 Val_Wu16 655350.0 DDRCTime_ms 0.00 655350.0 /end CHARACTERISTIC
/begin CHARACTERISTIC DDRC_DurDeb.TrbChLP_tiOLDebOk_C "DDRC/Dauer der Heilungsentprellung für Prüfung DFC_TrbChLPOL" VALUE 0x80022604 Val_Wu16 655350.0 DDRCTime_ms 0.00 655350.0 /end CHARACTERISTIC
/begin CHARACTERISTIC DDRC_DurDeb.TrbChLP_tiOLDebDef_C "DDRC/Dauer der Fehlerentprellung für Prüfung DFC_TrbChLPOL" VALUE 0x80022606 Val_Wu16 655350.0 DDRCTime_ms 0.00 655350.0 /end CHARACTERISTIC
/begin CHARACTERISTIC DDRC_DurDeb.UHtrTnk_tiOLDebOk_C "DDRC/Dauer der Heilungsentprellung für Prüfung DFC_UHtrTnkOL" VALUE 0x80022608 Val_Wu16 655350.0 DDRCTime_ms 0.00 655350.0 /end CHARACTERISTIC
/begin CHARACTERISTIC DDRC_DurDeb.UHtrTnk_tiOLDebDef_C "DDRC/Dauer der Fehlerentprellung für Prüfung DFC_UHtrTnkOL" VALUE 0x8002260A Val_Wu16 655350.0 DDRCTime_ms 0.00 655350.0 /end CHARACTERISTIC
/begin CHARACTERISTIC DDRC_DurDeb.Exh_tiSRCMinTPFltUsDebOk_C "DDRC/Dauer der Heilungsentprellung für Prüfung DFC_SRCMinTPFltUs" VALUE 0x8002260C Val_Wu16 655350.0 DDRCTime_ms 0.00 655350.0 /end CHARACTERISTIC
/begin CHARACTERISTIC DDRC_DurDeb.Exh_tiSRCMinTPFltUsDebDef_C "DDRC/Dauer der Fehlerentprellung für Prüfung DFC_SRCMinTPFltUs" VALUE 0x8002260E Val_Wu16 655350.0 DDRCTime_ms 0.00 655350.0 /end CHARACTERISTIC
/begin CHARACTERISTIC DDRC_DurDeb.EGRVlv_tiGovDvtMinDebOk_C "DDRC/Dauer der Heilungsentprellung für Prüfung DFC_EGRVlvGovDvtMin" VALUE 0x80022610 Val_Wu16 655350.0 DDRCTime_ms 0.00 655350.0 /end CHARACTERISTIC
/begin CHARACTERISTIC DDRC_DurDeb.EGRVlv_tiGovDvtMinDebDef_C "DDRC/Dauer der Fehlerentprellung für Prüfung DFC_EGRVlvGovDvtMin" VALUE 0x80022612 Val_Wu16 655350.0 DDRCTime_ms 0.00 655350.0 /end CHARACTERISTIC
/begin CHARACTERISTIC DDRC_DurDeb.LSU_tiSPIBattLowMinDebOk_C "DDRC/Dauer der Heilungsentprellung für Prüfung DFC_LSUSPIBattLowMin" VALUE 0x80022614 Val_Wu16 655350.0 DDRCTime_ms 0.00 655350.0 /end CHARACTERISTIC
/begin CHARACTERISTIC DDRC_DurDeb.LSU_tiSPIBattLowMinDebDef_C "DDRC/Dauer der Fehlerentprellung für Prüfung DFC_LSUSPIBattLowMin" VALUE 0x80022616 Val_Wu16 655350.0 DDRCTime_ms 0.00 655350.0 /end CHARACTERISTIC
/begin CHARACTERISTIC DDRC_DurDeb.VSwVlv_tiHBrgOpnLdDebOk_C "DDRC/Dauer der Heilungsentprellung für Prüfung DFC_VSwVlvHBrgOpnLd" VALUE 0x80022618 Val_Wu16 655350.0 DDRCTime_ms 0.00 655350.0 /end CHARACTERISTIC
/begin CHARACTERISTIC DDRC_DurDeb.VSwVlv_tiHBrgOpnLdDebDef_C "DDRC/Dauer der Fehlerentprellung für Prüfung DFC_VSwVlvHBrgOpnLd" VALUE 0x8002261A Val_Wu16 655350.0 DDRCTime_ms 0.00 655350.0 /end CHARACTERISTIC
/begin CHARACTERISTIC DDRC_DurDeb.VSwVlv_tiOLDebOk_C "DDRC/Dauer der Heilungsentprellung für Prüfung DFC_VSwVlvOL" VALUE 0x8002261C Val_Wu16 655350.0 DDRCTime_ms 0.00 655350.0 /end CHARACTERISTIC
/begin CHARACTERISTIC DDRC_DurDeb.VSwVlv_tiOLDebDef_C "DDRC/Dauer der Fehlerentprellung für Prüfung DFC_VSwVlvOL" VALUE 0x8002261E Val_Wu16 655350.0 DDRCTime_ms 0.00 655350.0 /end CHARACTERISTIC
/begin CHARACTERISTIC DDRC_DurDeb.Exh_tiSRCMaxTTrbnUsDebOk_C "DDRC/Dauer der Heilungsentprellung für Prüfung DFC_SRCMaxTTrbnUs" VALUE 0x80022620 Val_Wu16 655350.0 DDRCTime_ms 0.00 655350.0 /end CHARACTERISTIC
/begin CHARACTERISTIC DDRC_DurDeb.Exh_tiSRCMaxTTrbnUsDebDef_C "DDRC/Dauer der Fehlerentprellung für Prüfung DFC_SRCMaxTTrbnUs" VALUE 0x80022622 Val_Wu16 655350.0 DDRCTime_ms 0.00 655350.0 /end CHARACTERISTIC
/begin CHARACTERISTIC DDRC_DurDeb.UHtrPL_tiSRCMaxDiaDebOk_C "DDRC/Dauer der Heilungsentprellung für Prüfung DFC_UHtrPLSRCMaxDia" VALUE 0x80022624 Val_Wu16 655350.0 DDRCTime_ms 0.00 655350.0 /end CHARACTERISTIC
/begin CHARACTERISTIC DDRC_DurDeb.UHtrPL_tiSRCMaxDiaDebDef_C "DDRC/Dauer der Fehlerentprellung für Prüfung DFC_UHtrPLSRCMaxDia" VALUE 0x80022626 Val_Wu16 655350.0 DDRCTime_ms 0.00 655350.0 /end CHARACTERISTIC
/begin CHARACTERISTIC DDRC_DurDeb.EGRVlvLP_tiOLDebOk_C "DDRC/Dauer der Heilungsentprellung für Prüfung DFC_EGRVlvLPOL" VALUE 0x80022628 Val_Wu16 655350.0 DDRCTime_ms 0.00 655350.0 /end CHARACTERISTIC
/begin CHARACTERISTIC DDRC_DurDeb.EGRVlvLP_tiOLDebDef_C "DDRC/Dauer der Fehlerentprellung für Prüfung DFC_EGRVlvLPOL" VALUE 0x8002262A Val_Wu16 655350.0 DDRCTime_ms 0.00 655350.0 /end CHARACTERISTIC
/begin CHARACTERISTIC DDRC_DurDeb.Air_tiSRCMinPIntkVUsDebOk_C "DDRC/Dauer der Heilungsentprellung für Prüfung DFC_PIntkVUsSRCMin" VALUE 0x8002262C Val_Wu16 655350.0 DDRCTime_ms 0.00 655350.0 /end CHARACTERISTIC
/begin CHARACTERISTIC DDRC_DurDeb.Air_tiSRCMinPIntkVUsDebDef_C "DDRC/Dauer der Fehlerentprellung für Prüfung DFC_PIntkVUsSRCMin" VALUE 0x8002262E Val_Wu16 655350.0 DDRCTime_ms 0.00 655350.0 /end CHARACTERISTIC
/begin CHARACTERISTIC DDRC_DurDeb.EGRVlvLP_tiHBrgShCirGnd1DebOk_C "DDRC/Dauer der Heilungsentprellung für Prüfung DFC_EGRVlvLPHBrgShCirGnd1" VALUE 0x80022630 Val_Wu16 655350.0 DDRCTime_ms 0.00 655350.0 /end CHARACTERISTIC
/begin CHARACTERISTIC DDRC_DurDeb.EGRVlvLP_tiHBrgShCirGnd1DebDef_C "DDRC/Dauer der Fehlerentprellung für Prüfung DFC_EGRVlvLPHBrgShCirGnd1" VALUE 0x80022632 Val_Wu16 655350.0 DDRCTime_ms 0.00 655350.0 /end CHARACTERISTIC
/begin CHARACTERISTIC DDRC_DurDeb.TECU_tiSRCMinDebOk_C "DDRC/Dauer der Heilungsentprellung für Prüfung DFC_SRCMinTECU" VALUE 0x80022634 Val_Wu16 655350.0 DDRCTime_ms 0.00 655350.0 /end CHARACTERISTIC
/begin CHARACTERISTIC DDRC_DurDeb.TECU_tiSRCMinDebDef_C "DDRC/Dauer der Fehlerentprellung für Prüfung DFC_SRCMinTECU" VALUE 0x80022636 Val_Wu16 655350.0 DDRCTime_ms 0.00 655350.0 /end CHARACTERISTIC
/begin CHARACTERISTIC DDRC_DurDeb.PFlt_tiSotMsMaxDebOk_C "DDRC/Dauer der Heilungsentprellung für Prüfung DFC_PFltSotMsMax" VALUE 0x80022638 Val_Wu16 655350.0 DDRCTime_ms 0.00 655350.0 /end CHARACTERISTIC
/begin CHARACTERISTIC DDRC_DurDeb.PFlt_tiSotMsMaxDebDef_C "DDRC/Dauer der Fehlerentprellung für Prüfung DFC_PFltSotMsMax" VALUE 0x8002263A Val_Wu16 655350.0 DDRCTime_ms 0.00 655350.0 /end CHARACTERISTIC
/begin CHARACTERISTIC DDRC_DurDeb.VSwVlv_tiHBrgUndrVltgDebOk_C "DDRC/Dauer der Heilungsentprellung für Prüfung DFC_VSwVlvHBrgUndrVltg" VALUE 0x8002263C Val_Wu16 655350.0 DDRCTime_ms 0.00 655350.0 /end CHARACTERISTIC
/begin CHARACTERISTIC DDRC_DurDeb.VSwVlv_tiHBrgUndrVltgDebDef_C "DDRC/Dauer der Fehlerentprellung für Prüfung DFC_VSwVlvHBrgUndrVltg" VALUE 0x8002263E Val_Wu16 655350.0 DDRCTime_ms 0.00 655350.0 /end CHARACTERISTIC
/begin CHARACTERISTIC DDRC_DurDeb.Exh_tiSRCMaxPPFltUsDebOk_C "DDRC/Dauer der Heilungsentprellung für Prüfung DFC_SRCMaxPPFltUs" VALUE 0x80022640 Val_Wu16 655350.0 DDRCTime_ms 0.00 655350.0 /end CHARACTERISTIC
/begin CHARACTERISTIC DDRC_DurDeb.Exh_tiSRCMaxPPFltUsDebDef_C "DDRC/Dauer der Fehlerentprellung für Prüfung DFC_SRCMaxPPFltUs" VALUE 0x80022642 Val_Wu16 655350.0 DDRCTime_ms 0.00 655350.0 /end CHARACTERISTIC
/begin CHARACTERISTIC DDRC_DurDeb.Exh_tiEMaxPPFltDiffDebOk_C "DDRC/Dauer der Heilungsentprellung für Prüfung DFC_EnhSRCMaxPPFltDiff" VALUE 0x80022644 Val_Wu16 655350.0 DDRCTime_ms 0.00 655350.0 /end CHARACTERISTIC
/begin CHARACTERISTIC DDRC_DurDeb.Exh_tiEMaxPPFltDiffDebDef_C "DDRC/Dauer der Fehlerentprellung für Prüfung DFC_EnhSRCMaxPPFltDiff" VALUE 0x80022646 Val_Wu16 655350.0 DDRCTime_ms 0.00 655350.0 /end CHARACTERISTIC
/begin CHARACTERISTIC DDRC_DurDeb.EngSpd_tiSCGDebOk_C "DDRC/Dauer der Heilungsentprellung für Prüfung DFC_EngSpdSCG" VALUE 0x80022648 Val_Wu16 655350.0 DDRCTime_ms 0.00 655350.0 /end CHARACTERISTIC
/begin CHARACTERISTIC DDRC_DurDeb.EngSpd_tiSCGDebDef_C "DDRC/Dauer der Fehlerentprellung für Prüfung DFC_EngSpdSCG" VALUE 0x8002264A Val_Wu16 655350.0 DDRCTime_ms 0.00 655350.0 /end CHARACTERISTIC
/begin CHARACTERISTIC DDRC_DurDeb.APP_PlaAPP12DebOk_C "DDRC/Dauer der Heilungsentprellung für Prüfung DFC_SyncAPP" VALUE 0x8002264C Val_Wu16 655350.0 DDRCTime_ms 0.00 655350.0 /end CHARACTERISTIC
/begin CHARACTERISTIC DDRC_DurDeb.APP_PlaAPP12DebDef_C "DDRC/Dauer der Fehlerentprellung für Prüfung DFC_SyncAPP" VALUE 0x8002264E Val_Wu16 655350.0 DDRCTime_ms 0.00 655350.0 /end CHARACTERISTIC
/begin CHARACTERISTIC DDRC_DurDeb.APP_tiSRCLowDebOk_C "DDRC/Dauer der Heilungsentprellung für Prüfung DFC_SRCLowAPP2" VALUE 0x80022650 Val_Wu16 655350.0 DDRCTime_ms 0.00 655350.0 /end CHARACTERISTIC
/begin CHARACTERISTIC DDRC_DurDeb.APP_tiSRCLowDebDef_C "DDRC/Dauer der Fehlerentprellung für Prüfung DFC_SRCLowAPP2" VALUE 0x80022652 Val_Wu16 655350.0 DDRCTime_ms 0.00 655350.0 /end CHARACTERISTIC
/begin CHARACTERISTIC DDRC_DurDeb.EGRVlv_tiSRCMaxDebOk_C "DDRC/Dauer der Heilungsentprellung für Prüfung DFC_EGRVlvSRCMax" VALUE 0x80022654 Val_Wu16 655350.0 DDRCTime_ms 0.00 655350.0 /end CHARACTERISTIC
/begin CHARACTERISTIC DDRC_DurDeb.EGRVlv_tiSRCMaxDebDef_C "DDRC/Dauer der Fehlerentprellung für Prüfung DFC_EGRVlvSRCMax" VALUE 0x80022656 Val_Wu16 655350.0 DDRCTime_ms 0.00 655350.0 /end CHARACTERISTIC
/begin CHARACTERISTIC DDRC_DurDeb.EGRVlv_tiHBrgOpnLdDebOk_C "DDRC/Dauer der Heilungsentprellung für Prüfung DFC_EGRVlvHBrgOpnLd" VALUE 0x80022658 Val_Wu16 655350.0 DDRCTime_ms 0.00 655350.0 /end CHARACTERISTIC
/begin CHARACTERISTIC DDRC_DurDeb.EGRVlv_tiHBrgOpnLdDebDef_C "DDRC/Dauer der Fehlerentprellung für Prüfung DFC_EGRVlvHBrgOpnLd" VALUE 0x8002265A Val_Wu16 655350.0 DDRCTime_ms 0.00 655350.0 /end CHARACTERISTIC
/begin CHARACTERISTIC DDRC_DurDeb.VSwVlv_tiSRCMinDebOk_C "DDRC/Dauer der Heilungsentprellung für Prüfung DFC_VSwVlvSRCMin" VALUE 0x8002265C Val_Wu16 655350.0 DDRCTime_ms 0.00 655350.0 /end CHARACTERISTIC
/begin CHARACTERISTIC DDRC_DurDeb.VSwVlv_tiSRCMinDebDef_C "DDRC/Dauer der Fehlerentprellung für Prüfung DFC_VSwVlvSRCMin" VALUE 0x8002265E Val_Wu16 655350.0 DDRCTime_ms 0.00 655350.0 /end CHARACTERISTIC
/begin CHARACTERISTIC DDRC_DurDeb.Exh_tiEMinPPFltDiffDebOk_C "DDRC/Dauer der Heilungsentprellung für Prüfung DFC_EnhSRCMinPPFltDiff" VALUE 0x80022660 Val_Wu16 655350.0 DDRCTime_ms 0.00 655350.0 /end CHARACTERISTIC
/begin CHARACTERISTIC DDRC_DurDeb.Exh_tiEMinPPFltDiffDebDef_C "DDRC/Dauer der Fehlerentprellung für Prüfung DFC_EnhSRCMinPPFltDiff" VALUE 0x80022662 Val_Wu16 655350.0 DDRCTime_ms 0.00 655350.0 /end CHARACTERISTIC
/begin CHARACTERISTIC DDRC_DurDeb.SCR_tiSigUPmpPDebOk_C "DDRC/Dauer der Heilungsentprellung für Prüfung DFC_SigUPmpP" VALUE 0x80022664 Val_Wu16 655350.0 DDRCTime_ms 0.00 655350.0 /end CHARACTERISTIC
/begin CHARACTERISTIC DDRC_DurDeb.SCR_tiSigUPmpPDebDef_C "DDRC/Dauer der Fehlerentprellung für Prüfung DFC_SigUPmpP" VALUE 0x80022666 Val_Wu16 655350.0 DDRCTime_ms 0.00 655350.0 /end CHARACTERISTIC
/begin CHARACTERISTIC DDRC_DurDeb.Air_tiPerHiTAFSDebOk_C "DDRC/Dauer der Heilungsentprellung für Prüfung DFC_TAFSPerHi" VALUE 0x80022668 Val_Wu16 655350.0 DDRCTime_ms 0.00 655350.0 /end CHARACTERISTIC
/begin CHARACTERISTIC DDRC_DurDeb.Air_tiPerHiTAFSDebDef_C "DDRC/Dauer der Fehlerentprellung für Prüfung DFC_TAFSPerHi" VALUE 0x8002266A Val_Wu16 655350.0 DDRCTime_ms 0.00 655350.0 /end CHARACTERISTIC
/begin CHARACTERISTIC DDRC_DurDeb.EGRVlvLP_tiHBrgTempOvrCurrDebOk_C "DDRC/Dauer der Heilungsentprellung für Prüfung DFC_EGRVlvLPHBrgTempOvrCurr" VALUE 0x8002266C Val_Wu16 655350.0 DDRCTime_ms 0.00 655350.0 /end CHARACTERISTIC
/begin CHARACTERISTIC DDRC_DurDeb.EGRVlvLP_tiHBrgTempOvrCurrDebDef_C "DDRC/Dauer der Fehlerentprellung für Prüfung DFC_EGRVlvLPHBrgTempOvrCurr" VALUE 0x8002266E Val_Wu16 655350.0 DDRCTime_ms 0.00 655350.0 /end CHARACTERISTIC
/begin CHARACTERISTIC DDRC_DurDeb.APP_tiSRCHighDebOk_C "DDRC/Dauer der Heilungsentprellung für Prüfung DFC_SRCHighAPP2" VALUE 0x80022670 Val_Wu16 655350.0 DDRCTime_ms 0.00 655350.0 /end CHARACTERISTIC
/begin CHARACTERISTIC DDRC_DurDeb.APP_tiSRCHighDebDef_C "DDRC/Dauer der Fehlerentprellung für Prüfung DFC_SRCHighAPP2" VALUE 0x80022672 Val_Wu16 655350.0 DDRCTime_ms 0.00 655350.0 /end CHARACTERISTIC
/begin CHARACTERISTIC DDRC_DurDeb.Air_tiSRCMaxPIntkVUsDebOk_C "DDRC/Dauer der Heilungsentprellung für Prüfung DFC_PIntkVUsSRCMax" VALUE 0x80022674 Val_Wu16 655350.0 DDRCTime_ms 0.00 655350.0 /end CHARACTERISTIC
/begin CHARACTERISTIC DDRC_DurDeb.Air_tiSRCMaxPIntkVUsDebDef_C "DDRC/Dauer der Fehlerentprellung für Prüfung DFC_PIntkVUsSRCMax" VALUE 0x80022676 Val_Wu16 655350.0 DDRCTime_ms 0.00 655350.0 /end CHARACTERISTIC
/begin CHARACTERISTIC DDRC_DurDeb.Exh_tiSRCMinPPFltUsDebOk_C "DDRC/Dauer der Heilungsentprellung für Prüfung DFC_SRCMinPPFltUs" VALUE 0x80022678 Val_Wu16 655350.0 DDRCTime_ms 0.00 655350.0 /end CHARACTERISTIC
/begin CHARACTERISTIC DDRC_DurDeb.Exh_tiSRCMinPPFltUsDebDef_C "DDRC/Dauer der Fehlerentprellung für Prüfung DFC_SRCMinPPFltUs" VALUE 0x8002267A Val_Wu16 655350.0 DDRCTime_ms 0.00 655350.0 /end CHARACTERISTIC
/begin CHARACTERISTIC DDRC_DurDeb.Exh_tiPlausExhTMonDebOk_C "DDRC/Dauer der Heilungsentprellung für Prüfung DFC_ExhTMonPlaus" VALUE 0x8002267C Val_Wu16 655350.0 DDRCTime_ms 0.00 655350.0 /end CHARACTERISTIC
/begin CHARACTERISTIC DDRC_DurDeb.Exh_tiPlausExhTMonDebDef_C "DDRC/Dauer der Fehlerentprellung für Prüfung DFC_ExhTMonPlaus" VALUE 0x8002267E Val_Wu16 655350.0 DDRCTime_ms 0.00 655350.0 /end CHARACTERISTIC
/begin CHARACTERISTIC DDRC_DurDeb.Exh_tiLamPlausMaxNoCat2DsDebOk_C "DDRC/Dauer der Heilungsentprellung für Prüfung DFC_NoCat2DsLamPlausMax" VALUE 0x80022680 Val_Wu16 655350.0 DDRCTime_ms 0.00 655350.0 /end CHARACTERISTIC
/begin CHARACTERISTIC DDRC_DurDeb.Exh_tiLamPlausMaxNoCat2DsDebDef_C "DDRC/Dauer der Fehlerentprellung für Prüfung DFC_NoCat2DsLamPlausMax" VALUE 0x80022682 Val_Wu16 655350.0 DDRCTime_ms 0.00 655350.0 /end CHARACTERISTIC
/begin CHARACTERISTIC DDRC_DurDeb.PFlt_tiNplHsChngPPFltDiffDebOk_C "DDRC/Dauer der Heilungsentprellung für Prüfung DFC_NplHsChngPPFltDiff" VALUE 0x80022684 Val_Wu16 655350.0 DDRCTime_ms 0.00 655350.0 /end CHARACTERISTIC
/begin CHARACTERISTIC DDRC_DurDeb.PFlt_tiNplHsChngPPFltDiffDebDef_C "DDRC/Dauer der Fehlerentprellung für Prüfung DFC_NplHsChngPPFltDiff" VALUE 0x80022686 Val_Wu16 655350.0 DDRCTime_ms 0.00 655350.0 /end CHARACTERISTIC
/begin CHARACTERISTIC DDRC_DurDeb.EGRVlvLP_tiGovDvtMinDebOk_C "DDRC/Dauer der Heilungsentprellung für Prüfung DFC_EGRVlvLPGovDvtMin" VALUE 0x80022688 Val_Wu16 655350.0 DDRCTime_ms 0.00 655350.0 /end CHARACTERISTIC
/begin CHARACTERISTIC DDRC_DurDeb.EGRVlvLP_tiGovDvtMinDebDef_C "DDRC/Dauer der Fehlerentprellung für Prüfung DFC_EGRVlvLPGovDvtMin" VALUE 0x8002268A Val_Wu16 655350.0 DDRCTime_ms 0.00 655350.0 /end CHARACTERISTIC
/begin CHARACTERISTIC DDRC_DurDeb.PFlt_tiSRCMaxFlwRstnDebOk_C "DDRC/Dauer der Heilungsentprellung für Prüfung DFC_PFltSRCMaxFlwRstn" VALUE 0x8002268C Val_Wu16 655350.0 DDRCTime_ms 0.00 655350.0 /end CHARACTERISTIC
/begin CHARACTERISTIC DDRC_DurDeb.PFlt_tiSRCMaxFlwRstnDebDef_C "DDRC/Dauer der Fehlerentprellung für Prüfung DFC_PFltSRCMaxFlwRstn" VALUE 0x8002268E Val_Wu16 655350.0 DDRCTime_ms 0.00 655350.0 /end CHARACTERISTIC
/begin CHARACTERISTIC DDRC_DurDeb.PFlt_tiRgnPermMaxDebOk_C "DDRC/Dauer der Heilungsentprellung für Prüfung DFC_PFltRgnPerm" VALUE 0x80022690 Val_Wu16 655350.0 DDRCTime_ms 0.00 655350.0 /end CHARACTERISTIC
/begin CHARACTERISTIC DDRC_DurDeb.PFlt_tiRgnPermMaxDebDef_C "DDRC/Dauer der Fehlerentprellung für Prüfung DFC_PFltRgnPerm" VALUE 0x80022692 Val_Wu16 655350.0 DDRCTime_ms 0.00 655350.0 /end CHARACTERISTIC
/begin CHARACTERISTIC DDRC_DurDeb.SCR_tiSigUCatUsTDebOk_C "DDRC/Dauer der Heilungsentprellung für Prüfung DFC_SigUCatUsT" VALUE 0x80022694 Val_Wu16 655350.0 DDRCTime_ms 0.00 655350.0 /end CHARACTERISTIC
/begin CHARACTERISTIC DDRC_DurDeb.SCR_tiSigUCatUsTDebDef_C "DDRC/Dauer der Fehlerentprellung für Prüfung DFC_SigUCatUsT" VALUE 0x80022696 Val_Wu16 655350.0 DDRCTime_ms 0.00 655350.0 /end CHARACTERISTIC
/begin CHARACTERISTIC DDRC_DurDeb.Exh_tiMaxExhTMonDebOk_C "DDRC/Dauer der Heilungsentprellung für Prüfung DFC_EnhSRCMaxT3ExhTMon" VALUE 0x80022698 Val_Wu16 655350.0 DDRCTime_ms 0.00 655350.0 /end CHARACTERISTIC
/begin CHARACTERISTIC DDRC_DurDeb.Exh_tiMaxExhTMonDebDef_C "DDRC/Dauer der Fehlerentprellung für Prüfung DFC_EnhSRCMaxT3ExhTMon" VALUE 0x8002269A Val_Wu16 655350.0 DDRCTime_ms 0.00 655350.0 /end CHARACTERISTIC
/begin CHARACTERISTIC DDRC_DurDeb.URevVlv_tiOLDebOk_C "DDRC/Dauer der Heilungsentprellung für Prüfung DFC_URevVlvOL" VALUE 0x8002269C Val_Wu16 655350.0 DDRCTime_ms 0.00 655350.0 /end CHARACTERISTIC
/begin CHARACTERISTIC DDRC_DurDeb.URevVlv_tiOLDebDef_C "DDRC/Dauer der Fehlerentprellung für Prüfung DFC_URevVlvOL" VALUE 0x8002269E Val_Wu16 655350.0 DDRCTime_ms 0.00 655350.0 /end CHARACTERISTIC
/begin CHARACTERISTIC DDRC_DurDeb.GbxNPos_tiSRCPerMaxDebOk_C "DDRC/Dauer der Heilungsentprellung für Prüfung DFC_GbxNPosPPerSRCMax" VALUE 0x800226A0 Val_Wu16 655350.0 DDRCTime_ms 0.00 655350.0 /end CHARACTERISTIC
/begin CHARACTERISTIC DDRC_DurDeb.GbxNPos_tiSRCPerMaxDebDef_C "DDRC/Dauer der Fehlerentprellung für Prüfung DFC_GbxNPosPPerSRCMax" VALUE 0x800226A2 Val_Wu16 655350.0 DDRCTime_ms 0.00 655350.0 /end CHARACTERISTIC
/begin CHARACTERISTIC DDRC_DurDeb.LSU_tiCircPmpCurSigDebOk_C "DDRC/Dauer der Heilungsentprellung für Prüfung DFC_LSUCircPmpCurSig" VALUE 0x800226A4 Val_Wu16 655350.0 DDRCTime_ms 0.00 655350.0 /end CHARACTERISTIC
/begin CHARACTERISTIC DDRC_DurDeb.LSU_tiCircPmpCurSigDebDef_C "DDRC/Dauer der Fehlerentprellung für Prüfung DFC_LSUCircPmpCurSig" VALUE 0x800226A6 Val_Wu16 655350.0 DDRCTime_ms 0.00 655350.0 /end CHARACTERISTIC
/begin CHARACTERISTIC DDRC_DurDeb.VSwVlv_tiSRCMaxDebOk_C "DDRC/Dauer der Heilungsentprellung für Prüfung DFC_VSwVlvSRCMax" VALUE 0x800226A8 Val_Wu16 655350.0 DDRCTime_ms 0.00 655350.0 /end CHARACTERISTIC
/begin CHARACTERISTIC DDRC_DurDeb.VSwVlv_tiSRCMaxDebDef_C "DDRC/Dauer der Fehlerentprellung für Prüfung DFC_VSwVlvSRCMax" VALUE 0x800226AA Val_Wu16 655350.0 DDRCTime_ms 0.00 655350.0 /end CHARACTERISTIC
/begin CHARACTERISTIC DDRC_DurDeb.Exh_tiSRCLamBinNSCDsDebOk_C "DDRC/Dauer der Heilungsentprellung für Prüfung DFC_NSCDsLamBinSRCMin" VALUE 0x800226AC Val_Wu16 655350.0 DDRCTime_ms 0.00 655350.0 /end CHARACTERISTIC
/begin CHARACTERISTIC DDRC_DurDeb.Exh_tiSRCLamBinNSCDsDebDef_C "DDRC/Dauer der Fehlerentprellung für Prüfung DFC_NSCDsLamBinSRCMin" VALUE 0x800226AE Val_Wu16 655350.0 DDRCTime_ms 0.00 655350.0 /end CHARACTERISTIC
/begin CHARACTERISTIC DDRC_DurDeb.VSwVlv_tiSCBDebOk_C "DDRC/Dauer der Heilungsentprellung für Prüfung DFC_VSwVlvSCB" VALUE 0x800226B0 Val_Wu16 655350.0 DDRCTime_ms 0.00 655350.0 /end CHARACTERISTIC
/begin CHARACTERISTIC DDRC_DurDeb.VSwVlv_tiSCBDebDef_C "DDRC/Dauer der Fehlerentprellung für Prüfung DFC_VSwVlvSCB" VALUE 0x800226B2 Val_Wu16 655350.0 DDRCTime_ms 0.00 655350.0 /end CHARACTERISTIC
/begin CHARACTERISTIC DDRC_DurDeb.EGRVlvLP_tiSCBDebOk_C "DDRC/Dauer der Heilungsentprellung für Prüfung DFC_EGRVlvLPSCB" VALUE 0x800226B4 Val_Wu16 655350.0 DDRCTime_ms 0.00 655350.0 /end CHARACTERISTIC
/begin CHARACTERISTIC DDRC_DurDeb.EGRVlvLP_tiSCBDebDef_C "DDRC/Dauer der Fehlerentprellung für Prüfung DFC_EGRVlvLPSCB" VALUE 0x800226B6 Val_Wu16 655350.0 DDRCTime_ms 0.00 655350.0 /end CHARACTERISTIC
/begin CHARACTERISTIC DDRC_DurDeb.EngSpd_tiSCBDebOk_C "DDRC/Dauer der Heilungsentprellung für Prüfung DFC_EngSpdSCB" VALUE 0x800226B8 Val_Wu16 655350.0 DDRCTime_ms 0.00 655350.0 /end CHARACTERISTIC
/begin CHARACTERISTIC DDRC_DurDeb.EngSpd_tiSCBDebDef_C "DDRC/Dauer der Fehlerentprellung für Prüfung DFC_EngSpdSCB" VALUE 0x800226BA Val_Wu16 655350.0 DDRCTime_ms 0.00 655350.0 /end CHARACTERISTIC
/begin CHARACTERISTIC DDRC_DurDeb.Exh_tiMinExhTMonDebOk_C "DDRC/Dauer der Heilungsentprellung für Prüfung DFC_EnhSRCMinT3ExhTMon" VALUE 0x800226BC Val_Wu16 655350.0 DDRCTime_ms 0.00 655350.0 /end CHARACTERISTIC
/begin CHARACTERISTIC DDRC_DurDeb.Exh_tiMinExhTMonDebDef_C "DDRC/Dauer der Fehlerentprellung für Prüfung DFC_EnhSRCMinT3ExhTMon" VALUE 0x800226BE Val_Wu16 655350.0 DDRCTime_ms 0.00 655350.0 /end CHARACTERISTIC
/begin CHARACTERISTIC DDRC_DurDeb.EGRVlvLP_tiHBrgShCirGnd2DebOk_C "DDRC/Dauer der Heilungsentprellung für Prüfung DFC_EGRVlvLPHBrgShCirGnd2" VALUE 0x800226C0 Val_Wu16 655350.0 DDRCTime_ms 0.00 655350.0 /end CHARACTERISTIC
/begin CHARACTERISTIC DDRC_DurDeb.EGRVlvLP_tiHBrgShCirGnd2DebDef_C "DDRC/Dauer der Fehlerentprellung für Prüfung DFC_EGRVlvLPHBrgShCirGnd2" VALUE 0x800226C2 Val_Wu16 655350.0 DDRCTime_ms 0.00 655350.0 /end CHARACTERISTIC
/begin CHARACTERISTIC DDRC_DurDeb.BattU_tiMinDebOk_C "DDRC/Dauer der Heilungsentprellung für Prüfung DFC_BattUSRCMin" VALUE 0x800226C4 Val_Wu16 655350.0 DDRCTime_ms 0.00 655350.0 /end CHARACTERISTIC
/begin CHARACTERISTIC DDRC_DurDeb.BattU_tiMinDebDef_C "DDRC/Dauer der Fehlerentprellung für Prüfung DFC_BattUSRCMin" VALUE 0x800226C6 Val_Wu16 655350.0 DDRCTime_ms 0.00 655350.0 /end CHARACTERISTIC
/begin CHARACTERISTIC DDRC_DurDeb.VSwVlv_tiSCGDebOk_C "DDRC/Dauer der Heilungsentprellung für Prüfung DFC_VSwVlvSCG" VALUE 0x800226C8 Val_Wu16 655350.0 DDRCTime_ms 0.00 655350.0 /end CHARACTERISTIC
/begin CHARACTERISTIC DDRC_DurDeb.VSwVlv_tiSCGDebDef_C "DDRC/Dauer der Fehlerentprellung für Prüfung DFC_VSwVlvSCG" VALUE 0x800226CA Val_Wu16 655350.0 DDRCTime_ms 0.00 655350.0 /end CHARACTERISTIC
/begin CHARACTERISTIC DDRC_DurDeb.PCV_tiSCGDebOk_C "DDRC/Dauer der Heilungsentprellung für Prüfung DFC_PCVSCG" VALUE 0x800226CC Val_Wu16 655350.0 DDRCTime_ms 0.00 655350.0 /end CHARACTERISTIC
/begin CHARACTERISTIC DDRC_DurDeb.PCV_tiSCGDebDef_C "DDRC/Dauer der Fehlerentprellung für Prüfung DFC_PCVSCG" VALUE 0x800226CE Val_Wu16 655350.0 DDRCTime_ms 0.00 655350.0 /end CHARACTERISTIC
/begin CHARACTERISTIC DDRC_DurDeb.Exh_tiSRCMaxPPFltDiffDebOk_C "DDRC/Dauer der Heilungsentprellung für Prüfung DFC_SRCMaxPPFltDiff" VALUE 0x800226D0 Val_Wu16 655350.0 DDRCTime_ms 0.00 655350.0 /end CHARACTERISTIC
/begin CHARACTERISTIC DDRC_DurDeb.Exh_tiSRCMaxPPFltDiffDebDef_C "DDRC/Dauer der Fehlerentprellung für Prüfung DFC_SRCMaxPPFltDiff" VALUE 0x800226D2 Val_Wu16 655350.0 DDRCTime_ms 0.00 655350.0 /end CHARACTERISTIC
/begin CHARACTERISTIC DDRC_DurDeb.Exh_tiPlausExhTMon3DebOk_C "DDRC/Dauer der Heilungsentprellung für Prüfung DFC_ExhTMonT3Plaus" VALUE 0x800226D4 Val_Wu16 655350.0 DDRCTime_ms 0.00 655350.0 /end CHARACTERISTIC
/begin CHARACTERISTIC DDRC_DurDeb.Exh_tiPlausExhTMon3DebDef_C "DDRC/Dauer der Fehlerentprellung für Prüfung DFC_ExhTMonT3Plaus" VALUE 0x800226D6 Val_Wu16 655350.0 DDRCTime_ms 0.00 655350.0 /end CHARACTERISTIC
/begin CHARACTERISTIC DDRC_DurDeb.EnvP_tiMaxDebOk_C "DDRC/Dauer der Heilungsentprellung für Prüfung DFC_EnvPSRCMax" VALUE 0x800226D8 Val_Wu16 655350.0 DDRCTime_ms 0.00 655350.0 /end CHARACTERISTIC
/begin CHARACTERISTIC DDRC_DurDeb.EnvP_tiMaxDebDef_C "DDRC/Dauer der Fehlerentprellung für Prüfung DFC_EnvPSRCMax" VALUE 0x800226DA Val_Wu16 655350.0 DDRCTime_ms 0.00 655350.0 /end CHARACTERISTIC
/begin CHARACTERISTIC DDRC_DurDeb.Air_tiDtyCycHiTAFSDebOk_C "DDRC/Dauer der Heilungsentprellung für Prüfung DFC_TAFSDtyCycHi" VALUE 0x800226DC Val_Wu16 655350.0 DDRCTime_ms 0.00 655350.0 /end CHARACTERISTIC
/begin CHARACTERISTIC DDRC_DurDeb.Air_tiDtyCycHiTAFSDebDef_C "DDRC/Dauer der Fehlerentprellung für Prüfung DFC_TAFSDtyCycHi" VALUE 0x800226DE Val_Wu16 655350.0 DDRCTime_ms 0.00 655350.0 /end CHARACTERISTIC
/begin CHARACTERISTIC DDRC_DurDeb.EGRVlvLP_tiHBrgShCirBatt1DebOk_C "DDRC/Dauer der Heilungsentprellung für Prüfung DFC_EGRVlvLPHBrgShCirBatt1" VALUE 0x800226E0 Val_Wu16 655350.0 DDRCTime_ms 0.00 655350.0 /end CHARACTERISTIC
/begin CHARACTERISTIC DDRC_DurDeb.EGRVlvLP_tiHBrgShCirBatt1DebDef_C "DDRC/Dauer der Fehlerentprellung für Prüfung DFC_EGRVlvLPHBrgShCirBatt1" VALUE 0x800226E2 Val_Wu16 655350.0 DDRCTime_ms 0.00 655350.0 /end CHARACTERISTIC
/begin CHARACTERISTIC DDRC_DurDeb.Exh_tiExhTMon2PlausDebOk_C "DDRC/Dauer der Heilungsentprellung für Prüfung DFC_ExhTMonPlausPos2" VALUE 0x800226E4 Val_Wu16 655350.0 DDRCTime_ms 0.00 655350.0 /end CHARACTERISTIC
/begin CHARACTERISTIC DDRC_DurDeb.Exh_tiExhTMon2PlausDebDef_C "DDRC/Dauer der Fehlerentprellung für Prüfung DFC_ExhTMonPlausPos2" VALUE 0x800226E6 Val_Wu16 655350.0 DDRCTime_ms 0.00 655350.0 /end CHARACTERISTIC
/begin CHARACTERISTIC DDRC_DurDeb.Exh_tiSRCLamLinNoCat2DsDebOk_C "DDRC/Dauer der Heilungsentprellung für Prüfung DFC_NoCat2DsLamLinSRCMax" VALUE 0x800226E8 Val_Wu16 655350.0 DDRCTime_ms 0.00 655350.0 /end CHARACTERISTIC
/begin CHARACTERISTIC DDRC_DurDeb.Exh_tiSRCLamLinNoCat2DsDebDef_C "DDRC/Dauer der Fehlerentprellung für Prüfung DFC_NoCat2DsLamLinSRCMax" VALUE 0x800226EA Val_Wu16 655350.0 DDRCTime_ms 0.00 655350.0 /end CHARACTERISTIC
/begin CHARACTERISTIC DDRC_DurDeb.Exh_tiSRCMinTOxiCatUsDebOk_C "DDRC/Dauer der Heilungsentprellung für Prüfung DFC_SRCMinTOxiCatUs" VALUE 0x800226EC Val_Wu16 655350.0 DDRCTime_ms 0.00 655350.0 /end CHARACTERISTIC
/begin CHARACTERISTIC DDRC_DurDeb.Exh_tiSRCMinTOxiCatUsDebDef_C "DDRC/Dauer der Fehlerentprellung für Prüfung DFC_SRCMinTOxiCatUs" VALUE 0x800226EE Val_Wu16 655350.0 DDRCTime_ms 0.00 655350.0 /end CHARACTERISTIC
/begin CHARACTERISTIC DDRC_DurDeb.EGRVlvLP_tiHBrgOvrTempDebOk_C "DDRC/Dauer der Heilungsentprellung für Prüfung DFC_EGRVlvLPHBrgOvrTemp" VALUE 0x800226F0 Val_Wu16 655350.0 DDRCTime_ms 0.00 655350.0 /end CHARACTERISTIC
/begin CHARACTERISTIC DDRC_DurDeb.EGRVlvLP_tiHBrgOvrTempDebDef_C "DDRC/Dauer der Fehlerentprellung für Prüfung DFC_EGRVlvLPHBrgOvrTemp" VALUE 0x800226F2 Val_Wu16 655350.0 DDRCTime_ms 0.00 655350.0 /end CHARACTERISTIC
/begin CHARACTERISTIC DDRC_DurDeb.UHtrTnk_tiSRCMinDiaDebOk_C "DDRC/Dauer der Heilungsentprellung für Prüfung DFC_UHtrTnkSRCMinDia" VALUE 0x800226F4 Val_Wu16 655350.0 DDRCTime_ms 0.00 655350.0 /end CHARACTERISTIC
/begin CHARACTERISTIC DDRC_DurDeb.UHtrTnk_tiSRCMinDiaDebDef_C "DDRC/Dauer der Fehlerentprellung für Prüfung DFC_UHtrTnkSRCMinDia" VALUE 0x800226F6 Val_Wu16 655350.0 DDRCTime_ms 0.00 655350.0 /end CHARACTERISTIC
/begin CHARACTERISTIC DDRC_DurDeb.UHtrPL_tiOLDebOk_C "DDRC/Dauer der Heilungsentprellung für Prüfung DFC_UHtrPLOL" VALUE 0x800226F8 Val_Wu16 655350.0 DDRCTime_ms 0.00 655350.0 /end CHARACTERISTIC
/begin CHARACTERISTIC DDRC_DurDeb.UHtrPL_tiOLDebDef_C "DDRC/Dauer der Fehlerentprellung für Prüfung DFC_UHtrPLOL" VALUE 0x800226FA Val_Wu16 655350.0 DDRCTime_ms 0.00 655350.0 /end CHARACTERISTIC
/begin CHARACTERISTIC DDRC_DurDeb.EGRVlv_tiHBrgUndrVltgDebOk_C "DDRC/Dauer der Heilungsentprellung für Prüfung DFC_EGRVlvHBrgUndrVltg" VALUE 0x800226FC Val_Wu16 655350.0 DDRCTime_ms 0.00 655350.0 /end CHARACTERISTIC
/begin CHARACTERISTIC DDRC_DurDeb.EGRVlv_tiHBrgUndrVltgDebDef_C "DDRC/Dauer der Fehlerentprellung für Prüfung DFC_EGRVlvHBrgUndrVltg" VALUE 0x800226FE Val_Wu16 655350.0 DDRCTime_ms 0.00 655350.0 /end CHARACTERISTIC
/begin CHARACTERISTIC DDRC_DurDeb.PFlt_tiSotMsDvtMaxDebOk_C "DDRC/Dauer der Heilungsentprellung für Prüfung DFC_PFltSotMsDvtMax" VALUE 0x80022700 Val_Wu16 655350.0 DDRCTime_ms 0.00 655350.0 /end CHARACTERISTIC
/begin CHARACTERISTIC DDRC_DurDeb.PFlt_tiSotMsDvtMaxDebDef_C "DDRC/Dauer der Fehlerentprellung für Prüfung DFC_PFltSotMsDvtMax" VALUE 0x80022702 Val_Wu16 655350.0 DDRCTime_ms 0.00 655350.0 /end CHARACTERISTIC
/begin CHARACTERISTIC DDRC_DurDeb.Exh_tiSRCMaxTOxiCatUsDebOk_C "DDRC/Dauer der Heilungsentprellung für Prüfung DFC_SRCMaxTOxiCatUs" VALUE 0x80022704 Val_Wu16 655350.0 DDRCTime_ms 0.00 655350.0 /end CHARACTERISTIC
/begin CHARACTERISTIC DDRC_DurDeb.Exh_tiSRCMaxTOxiCatUsDebDef_C "DDRC/Dauer der Fehlerentprellung für Prüfung DFC_SRCMaxTOxiCatUs" VALUE 0x80022706 Val_Wu16 655350.0 DDRCTime_ms 0.00 655350.0 /end CHARACTERISTIC
/begin CHARACTERISTIC DDRC_DurDeb.VSwVlv_tiGovDvtMaxDebOk_C "DDRC/Dauer der Heilungsentprellung für Prüfung DFC_VSwVlvGovDvtMax" VALUE 0x80022708 Val_Wu16 655350.0 DDRCTime_ms 0.00 655350.0 /end CHARACTERISTIC
/begin CHARACTERISTIC DDRC_DurDeb.VSwVlv_tiGovDvtMaxDebDef_C "DDRC/Dauer der Fehlerentprellung für Prüfung DFC_VSwVlvGovDvtMax" VALUE 0x8002270A Val_Wu16 655350.0 DDRCTime_ms 0.00 655350.0 /end CHARACTERISTIC
/begin CHARACTERISTIC DDRC_DurDeb.FlFltDsP_tiMaxDebOk_C "DDRC/Dauer der Heilungsentprellung für Prüfung DFC_FlFltDsPSRCMax" VALUE 0x8002270C Val_Wu16 655350.0 DDRCTime_ms 0.00 655350.0 /end CHARACTERISTIC
/begin CHARACTERISTIC DDRC_DurDeb.FlFltDsP_tiMaxDebDef_C "DDRC/Dauer der Fehlerentprellung für Prüfung DFC_FlFltDsPSRCMax" VALUE 0x8002270E Val_Wu16 655350.0 DDRCTime_ms 0.00 655350.0 /end CHARACTERISTIC
/begin CHARACTERISTIC DDRC_DurDeb.Brk_tiPlaDebOk_C "DDRC/Dauer der Heilungsentprellung für Prüfung DFC_BrkNpl" VALUE 0x80022710 Val_Wu16 655350.0 DDRCTime_ms 0.00 655350.0 /end CHARACTERISTIC
/begin CHARACTERISTIC DDRC_DurDeb.Brk_tiPlaDebDef_C "DDRC/Dauer der Fehlerentprellung für Prüfung DFC_BrkNpl" VALUE 0x80022712 Val_Wu16 655350.0 DDRCTime_ms 0.00 655350.0 /end CHARACTERISTIC
/begin CHARACTERISTIC DDRC_DurDeb.GbxNPos_tiSRCdcycMinDebOk_C "DDRC/Dauer der Heilungsentprellung für Prüfung DFC_GbxNPosPdcycSRCMin" VALUE 0x80022714 Val_Wu16 655350.0 DDRCTime_ms 0.00 655350.0 /end CHARACTERISTIC
/begin CHARACTERISTIC DDRC_DurDeb.GbxNPos_tiSRCdcycMinDebDef_C "DDRC/Dauer der Fehlerentprellung für Prüfung DFC_GbxNPosPdcycSRCMin" VALUE 0x80022716 Val_Wu16 655350.0 DDRCTime_ms 0.00 655350.0 /end CHARACTERISTIC
/begin CHARACTERISTIC DDRC_DurDeb.Oil_tiSRCMinPSwmpDebOk_C "DDRC/Dauer der Heilungsentprellung für Prüfung DFC_OilPSwmpSRCMin" VALUE 0x80022718 Val_Wu16 655350.0 DDRCTime_ms 0.00 655350.0 /end CHARACTERISTIC
/begin CHARACTERISTIC DDRC_DurDeb.Oil_tiSRCMinPSwmpDebDef_C "DDRC/Dauer der Fehlerentprellung für Prüfung DFC_OilPSwmpSRCMin" VALUE 0x8002271A Val_Wu16 655350.0 DDRCTime_ms 0.00 655350.0 /end CHARACTERISTIC
/begin CHARACTERISTIC DDRC_DurDeb.TrbChLP_tiSCBDebOk_C "DDRC/Dauer der Heilungsentprellung für Prüfung DFC_TrbChLPSCB" VALUE 0x8002271C Val_Wu16 655350.0 DDRCTime_ms 0.00 655350.0 /end CHARACTERISTIC
/begin CHARACTERISTIC DDRC_DurDeb.TrbChLP_tiSCBDebDef_C "DDRC/Dauer der Fehlerentprellung für Prüfung DFC_TrbChLPSCB" VALUE 0x8002271E Val_Wu16 655350.0 DDRCTime_ms 0.00 655350.0 /end CHARACTERISTIC
/begin CHARACTERISTIC DDRC_DurDeb.Exh_tiSRCMinPPFltDiffDebOk_C "DDRC/Dauer der Heilungsentprellung für Prüfung DFC_SRCMinPPFltDiff" VALUE 0x80022720 Val_Wu16 655350.0 DDRCTime_ms 0.00 655350.0 /end CHARACTERISTIC
/begin CHARACTERISTIC DDRC_DurDeb.Exh_tiSRCMinPPFltDiffDebDef_C "DDRC/Dauer der Fehlerentprellung für Prüfung DFC_SRCMinPPFltDiff" VALUE 0x80022722 Val_Wu16 655350.0 DDRCTime_ms 0.00 655350.0 /end CHARACTERISTIC
/begin CHARACTERISTIC DDRC_DurDeb.PFlt_tiSotMsDvtMinDebOk_C "DDRC/Dauer der Heilungsentprellung für Prüfung DFC_PFltSotMsDvtMin" VALUE 0x80022724 Val_Wu16 655350.0 DDRCTime_ms 0.00 655350.0 /end CHARACTERISTIC
/begin CHARACTERISTIC DDRC_DurDeb.PFlt_tiSotMsDvtMinDebDef_C "DDRC/Dauer der Fehlerentprellung für Prüfung DFC_PFltSotMsDvtMin" VALUE 0x80022726 Val_Wu16 655350.0 DDRCTime_ms 0.00 655350.0 /end CHARACTERISTIC
/begin CHARACTERISTIC DDRC_DurDeb.EGRVlvLP_tiHBrgOpnLdDebOk_C "DDRC/Dauer der Heilungsentprellung für Prüfung DFC_EGRVlvLPHBrgOpnLd" VALUE 0x80022728 Val_Wu16 655350.0 DDRCTime_ms 0.00 655350.0 /end CHARACTERISTIC
/begin CHARACTERISTIC DDRC_DurDeb.EGRVlvLP_tiHBrgOpnLdDebDef_C "DDRC/Dauer der Fehlerentprellung für Prüfung DFC_EGRVlvLPHBrgOpnLd" VALUE 0x8002272A Val_Wu16 655350.0 DDRCTime_ms 0.00 655350.0 /end CHARACTERISTIC
/begin CHARACTERISTIC DDRC_DurDeb.Exh_tiCmpChkNSCDsDebOk_C "DDRC/Dauer der Heilungsentprellung für Prüfung DFC_NSCDsCmpChk" VALUE 0x8002272C Val_Wu16 655350.0 DDRCTime_ms 0.00 655350.0 /end CHARACTERISTIC
/begin CHARACTERISTIC DDRC_DurDeb.Exh_tiCmpChkNSCDsDebDef_C "DDRC/Dauer der Fehlerentprellung für Prüfung DFC_NSCDsCmpChk" VALUE 0x8002272E Val_Wu16 655350.0 DDRCTime_ms 0.00 655350.0 /end CHARACTERISTIC
/begin CHARACTERISTIC DDRC_DurDeb.EGRVlv_tiHBrgOvrTempDebOk_C "DDRC/Dauer der Heilungsentprellung für Prüfung DFC_EGRVlvHBrgOvrTemp" VALUE 0x80022730 Val_Wu16 655350.0 DDRCTime_ms 0.00 655350.0 /end CHARACTERISTIC
/begin CHARACTERISTIC DDRC_DurDeb.EGRVlv_tiHBrgOvrTempDebDef_C "DDRC/Dauer der Fehlerentprellung für Prüfung DFC_EGRVlvHBrgOvrTemp" VALUE 0x80022732 Val_Wu16 655350.0 DDRCTime_ms 0.00 655350.0 /end CHARACTERISTIC
/begin CHARACTERISTIC DDRC_DurDeb.EGRVlv_tiGovDvtMaxDebOk_C "DDRC/Dauer der Heilungsentprellung für Prüfung DFC_EGRVlvGovDvtMax" VALUE 0x80022734 Val_Wu16 655350.0 DDRCTime_ms 0.00 655350.0 /end CHARACTERISTIC
/begin CHARACTERISTIC DDRC_DurDeb.EGRVlv_tiGovDvtMaxDebDef_C "DDRC/Dauer der Fehlerentprellung für Prüfung DFC_EGRVlvGovDvtMax" VALUE 0x80022736 Val_Wu16 655350.0 DDRCTime_ms 0.00 655350.0 /end CHARACTERISTIC
/begin CHARACTERISTIC DDRC_DurDeb.Exh_tiPlausExhTMon2DebOk_C "DDRC/Dauer der Heilungsentprellung für Prüfung DFC_ExhTMonT2Plaus" VALUE 0x80022738 Val_Wu16 655350.0 DDRCTime_ms 0.00 655350.0 /end CHARACTERISTIC
/begin CHARACTERISTIC DDRC_DurDeb.Exh_tiPlausExhTMon2DebDef_C "DDRC/Dauer der Fehlerentprellung für Prüfung DFC_ExhTMonT2Plaus" VALUE 0x8002273A Val_Wu16 655350.0 DDRCTime_ms 0.00 655350.0 /end CHARACTERISTIC
/begin CHARACTERISTIC DDRC_DurDeb.VSwVlv_tiHBrgShCirBatt2DebOk_C "DDRC/Dauer der Heilungsentprellung für Prüfung DFC_VSwVlvHBrgShCirBatt2" VALUE 0x8002273C Val_Wu16 655350.0 DDRCTime_ms 0.00 655350.0 /end CHARACTERISTIC
/begin CHARACTERISTIC DDRC_DurDeb.VSwVlv_tiHBrgShCirBatt2DebDef_C "DDRC/Dauer der Fehlerentprellung für Prüfung DFC_VSwVlvHBrgShCirBatt2" VALUE 0x8002273E Val_Wu16 655350.0 DDRCTime_ms 0.00 655350.0 /end CHARACTERISTIC
/begin CHARACTERISTIC DDRC_DurDeb.SCR_tiSRCMaxUCatUsTDebOk_C "DDRC/Dauer der Heilungsentprellung für Prüfung DFC_SRCMaxUCatUsT" VALUE 0x80022740 Val_Wu16 655350.0 DDRCTime_ms 0.00 655350.0 /end CHARACTERISTIC
/begin CHARACTERISTIC DDRC_DurDeb.SCR_tiSRCMaxUCatUsTDebDef_C "DDRC/Dauer der Fehlerentprellung für Prüfung DFC_SRCMaxUCatUsT" VALUE 0x80022742 Val_Wu16 655350.0 DDRCTime_ms 0.00 655350.0 /end CHARACTERISTIC
/begin CHARACTERISTIC DDRC_DurDeb.AFS_tiRawSRCMinDebOk_C "DDRC/Dauer der Heilungsentprellung für Prüfung DFC_AFSSRCRawMin" VALUE 0x80022744 Val_Wu16 655350.0 DDRCTime_ms 0.00 655350.0 /end CHARACTERISTIC
/begin CHARACTERISTIC DDRC_DurDeb.AFS_tiRawSRCMinDebDef_C "DDRC/Dauer der Fehlerentprellung für Prüfung DFC_AFSSRCRawMin" VALUE 0x80022746 Val_Wu16 655350.0 DDRCTime_ms 0.00 655350.0 /end CHARACTERISTIC
/begin CHARACTERISTIC DDRC_DurDeb.LSU_tiO2MinDebOk_C "DDRC/Dauer der Heilungsentprellung für Prüfung DFC_LSUO2Min" VALUE 0x80022748 Val_Wu16 655350.0 DDRCTime_ms 0.00 655350.0 /end CHARACTERISTIC
/begin CHARACTERISTIC DDRC_DurDeb.LSU_tiO2MinDebDef_C "DDRC/Dauer der Fehlerentprellung für Prüfung DFC_LSUO2Min" VALUE 0x8002274A Val_Wu16 655350.0 DDRCTime_ms 0.00 655350.0 /end CHARACTERISTIC
/begin CHARACTERISTIC DDRC_DurDeb.ThrVlv_tiSRCMinDebOk_C "DDRC/Dauer der Heilungsentprellung für Prüfung DFC_ThrVlvSRCMin" VALUE 0x8002274C Val_Wu16 655350.0 DDRCTime_ms 0.00 655350.0 /end CHARACTERISTIC
/begin CHARACTERISTIC DDRC_DurDeb.ThrVlv_tiSRCMinDebDef_C "DDRC/Dauer der Fehlerentprellung für Prüfung DFC_ThrVlvSRCMin" VALUE 0x8002274E Val_Wu16 655350.0 DDRCTime_ms 0.00 655350.0 /end CHARACTERISTIC
/begin CHARACTERISTIC DDRC_DurDeb.VSwVlv_tiHBrgTempOvrCurrDebOk_C "DDRC/Dauer der Heilungsentprellung für Prüfung DFC_VSwVlvHBrgTempOvrCurr" VALUE 0x80022750 Val_Wu16 655350.0 DDRCTime_ms 0.00 655350.0 /end CHARACTERISTIC
/begin CHARACTERISTIC DDRC_DurDeb.VSwVlv_tiHBrgTempOvrCurrDebDef_C "DDRC/Dauer der Fehlerentprellung für Prüfung DFC_VSwVlvHBrgTempOvrCurr" VALUE 0x80022752 Val_Wu16 655350.0 DDRCTime_ms 0.00 655350.0 /end CHARACTERISTIC
/begin CHARACTERISTIC DDRC_DurDeb.Exh_tiNplTOxiUsDebOk_C "DDRC/Dauer der Heilungsentprellung für Prüfung DFC_NplTOxiCatUs" VALUE 0x80022754 Val_Wu16 655350.0 DDRCTime_ms 0.00 655350.0 /end CHARACTERISTIC
/begin CHARACTERISTIC DDRC_DurDeb.Exh_tiNplTOxiUsDebDef_C "DDRC/Dauer der Fehlerentprellung für Prüfung DFC_NplTOxiCatUs" VALUE 0x80022756 Val_Wu16 655350.0 DDRCTime_ms 0.00 655350.0 /end CHARACTERISTIC
/begin CHARACTERISTIC DDRC_DurDeb.EGRVlv_tiSRCMinDebOk_C "DDRC/Dauer der Heilungsentprellung für Prüfung DFC_EGRVlvSRCMin" VALUE 0x80022758 Val_Wu16 655350.0 DDRCTime_ms 0.00 655350.0 /end CHARACTERISTIC
/begin CHARACTERISTIC DDRC_DurDeb.EGRVlv_tiSRCMinDebDef_C "DDRC/Dauer der Fehlerentprellung für Prüfung DFC_EGRVlvSRCMin" VALUE 0x8002275A Val_Wu16 655350.0 DDRCTime_ms 0.00 655350.0 /end CHARACTERISTIC
/begin CHARACTERISTIC DDRC_DurDeb.ECBVlv_tiSRCMinDebOk_C "DDRC/Dauer der Heilungsentprellung für Prüfung DFC_ECBVlvSRCMin" VALUE 0x8002275C Val_Wu16 655350.0 DDRCTime_ms 0.00 655350.0 /end CHARACTERISTIC
/begin CHARACTERISTIC DDRC_DurDeb.ECBVlv_tiSRCMinDebDef_C "DDRC/Dauer der Fehlerentprellung für Prüfung DFC_ECBVlvSRCMin" VALUE 0x8002275E Val_Wu16 655350.0 DDRCTime_ms 0.00 655350.0 /end CHARACTERISTIC
/begin CHARACTERISTIC DDRC_DurDeb.EGRVlv_tiHBrgShCirGnd1DebOk_C "DDRC/Dauer der Heilungsentprellung für Prüfung DFC_EGRVlvHBrgShCirGnd1" VALUE 0x80022760 Val_Wu16 655350.0 DDRCTime_ms 0.00 655350.0 /end CHARACTERISTIC
/begin CHARACTERISTIC DDRC_DurDeb.EGRVlv_tiHBrgShCirGnd1DebDef_C "DDRC/Dauer der Fehlerentprellung für Prüfung DFC_EGRVlvHBrgShCirGnd1" VALUE 0x80022762 Val_Wu16 655350.0 DDRCTime_ms 0.00 655350.0 /end CHARACTERISTIC
/begin CHARACTERISTIC DDRC_DurDeb.Air_tiPerLoTAFSDebOk_C "DDRC/Dauer der Heilungsentprellung für Prüfung DFC_TAFSPerLo" VALUE 0x80022764 Val_Wu16 655350.0 DDRCTime_ms 0.00 655350.0 /end CHARACTERISTIC
/begin CHARACTERISTIC DDRC_DurDeb.Air_tiPerLoTAFSDebDef_C "DDRC/Dauer der Fehlerentprellung für Prüfung DFC_TAFSPerLo" VALUE 0x80022766 Val_Wu16 655350.0 DDRCTime_ms 0.00 655350.0 /end CHARACTERISTIC
/begin CHARACTERISTIC DDRC_DurDeb.EngSpd_tiOLDebOk_C "DDRC/Dauer der Heilungsentprellung für Prüfung DFC_EngSpdOL" VALUE 0x80022768 Val_Wu16 655350.0 DDRCTime_ms 0.00 655350.0 /end CHARACTERISTIC
/begin CHARACTERISTIC DDRC_DurDeb.EngSpd_tiOLDebDef_C "DDRC/Dauer der Fehlerentprellung für Prüfung DFC_EngSpdOL" VALUE 0x8002276A Val_Wu16 655350.0 DDRCTime_ms 0.00 655350.0 /end CHARACTERISTIC
/begin CHARACTERISTIC DDRC_DurDeb.BrkP_tiMaxDebOk_C "DDRC/Dauer der Heilungsentprellung für Prüfung DFC_BrkPSRCMax" VALUE 0x8002276C Val_Wu16 655350.0 DDRCTime_ms 0.00 655350.0 /end CHARACTERISTIC
/begin CHARACTERISTIC DDRC_DurDeb.BrkP_tiMaxDebDef_C "DDRC/Dauer der Fehlerentprellung für Prüfung DFC_BrkPSRCMax" VALUE 0x8002276E Val_Wu16 655350.0 DDRCTime_ms 0.00 655350.0 /end CHARACTERISTIC
/begin CHARACTERISTIC DDRC_DurDeb.AFS_tiCorSRCMinDebOk_C "DDRC/Dauer der Heilungsentprellung für Prüfung DFC_AFSSRCCorMin" VALUE 0x80022770 Val_Wu16 655350.0 DDRCTime_ms 0.00 655350.0 /end CHARACTERISTIC
/begin CHARACTERISTIC DDRC_DurDeb.AFS_tiCorSRCMinDebDef_C "DDRC/Dauer der Fehlerentprellung für Prüfung DFC_AFSSRCCorMin" VALUE 0x80022772 Val_Wu16 655350.0 DDRCTime_ms 0.00 655350.0 /end CHARACTERISTIC
/begin CHARACTERISTIC DDRC_DurDeb.VSwVlv_tiHBrgOvrCurrDebOk_C "DDRC/Dauer der Heilungsentprellung für Prüfung DFC_VSwVlvHBrgOvrCurr" VALUE 0x80022774 Val_Wu16 655350.0 DDRCTime_ms 0.00 655350.0 /end CHARACTERISTIC
/begin CHARACTERISTIC DDRC_DurDeb.VSwVlv_tiHBrgOvrCurrDebDef_C "DDRC/Dauer der Fehlerentprellung für Prüfung DFC_VSwVlvHBrgOvrCurr" VALUE 0x80022776 Val_Wu16 655350.0 DDRCTime_ms 0.00 655350.0 /end CHARACTERISTIC
/begin CHARACTERISTIC DDRC_DurDeb.AirC_tiSwtSigDebOk_C "DDRC/Dauer der Heilungsentprellung für Prüfung DFC_AirCSwtSig" VALUE 0x80022778 Val_Wu16 655350.0 DDRCTime_ms 0.00 655350.0 /end CHARACTERISTIC
/begin CHARACTERISTIC DDRC_DurDeb.AirC_tiSwtSigDebDef_C "DDRC/Dauer der Fehlerentprellung für Prüfung DFC_AirCSwtSig" VALUE 0x8002277A Val_Wu16 655350.0 DDRCTime_ms 0.00 655350.0 /end CHARACTERISTIC
/begin CHARACTERISTIC DDRC_DurDeb.VSwVlv_tiHBrgShCirBatt1DebOk_C "DDRC/Dauer der Heilungsentprellung für Prüfung DFC_VSwVlvHBrgShCirBatt1" VALUE 0x8002277C Val_Wu16 655350.0 DDRCTime_ms 0.00 655350.0 /end CHARACTERISTIC
/begin CHARACTERISTIC DDRC_DurDeb.VSwVlv_tiHBrgShCirBatt1DebDef_C "DDRC/Dauer der Fehlerentprellung für Prüfung DFC_VSwVlvHBrgShCirBatt1" VALUE 0x8002277E Val_Wu16 655350.0 DDRCTime_ms 0.00 655350.0 /end CHARACTERISTIC
/begin CHARACTERISTIC DDRC_DurDeb.SCR_tiSigUTnkTDebOk_C "DDRC/Dauer der Heilungsentprellung für Prüfung DFC_UTnkTSig" VALUE 0x80022780 Val_Wu16 655350.0 DDRCTime_ms 0.00 655350.0 /end CHARACTERISTIC
/begin CHARACTERISTIC DDRC_DurDeb.SCR_tiSigUTnkTDebDef_C "DDRC/Dauer der Fehlerentprellung für Prüfung DFC_UTnkTSig" VALUE 0x80022782 Val_Wu16 655350.0 DDRCTime_ms 0.00 655350.0 /end CHARACTERISTIC
/begin CHARACTERISTIC DDRC_DurDeb.GbxNPos_tiSRCdcycMaxDebOk_C "DDRC/Dauer der Heilungsentprellung für Prüfung DFC_GbxNPosPdcycSRCMax" VALUE 0x80022784 Val_Wu16 655350.0 DDRCTime_ms 0.00 655350.0 /end CHARACTERISTIC
/begin CHARACTERISTIC DDRC_DurDeb.GbxNPos_tiSRCdcycMaxDebDef_C "DDRC/Dauer der Fehlerentprellung für Prüfung DFC_GbxNPosPdcycSRCMax" VALUE 0x80022786 Val_Wu16 655350.0 DDRCTime_ms 0.00 655350.0 /end CHARACTERISTIC
/begin CHARACTERISTIC DDRC_DurDeb.Exh_tiMaxNoCat2DsDebOk_C "DDRC/Dauer der Heilungsentprellung für Prüfung DFC_NoCat2DsShCir" VALUE 0x80022788 Val_Wu16 655350.0 DDRCTime_ms 0.00 655350.0 /end CHARACTERISTIC
/begin CHARACTERISTIC DDRC_DurDeb.Exh_tiMaxNoCat2DsDebDef_C "DDRC/Dauer der Fehlerentprellung für Prüfung DFC_NoCat2DsShCir" VALUE 0x8002278A Val_Wu16 655350.0 DDRCTime_ms 0.00 655350.0 /end CHARACTERISTIC
/begin CHARACTERISTIC DDRC_DurDeb.EngTrqPtd_ctMonLimLeadDebOk_C "DDRC/Dauer der Heilungsentprellung für Prüfung DFC_MonLimLead" VALUE 0x8002278C Val_Wu16 65535.00 OneToOne 0.00 65535.00 /end CHARACTERISTIC
/begin CHARACTERISTIC DDRC_DurDeb.EngTrqPtd_ctMonLimLeadDebDef_C "DDRC/Dauer der Fehlerentprellung für Prüfung DFC_MonLimLead" VALUE 0x8002278E Val_Wu16 65535.00 OneToOne 0.00 65535.00 /end CHARACTERISTIC
/begin CHARACTERISTIC DDRC_DurDeb.Layer_numFltMngTstDebOk_C "DDRC/Dauer der Heilungsentprellung für Prüfung DFC_Layer_FltMngTstNpl" VALUE 0x80022790 Val_Wu16 65535.00 OneToOne 0.00 65535.00 /end CHARACTERISTIC
/begin CHARACTERISTIC DDRC_DurDeb.Layer_numFltMngTstDebDef_C "DDRC/Dauer der Fehlerentprellung für Prüfung DFC_Layer_FltMngTstNpl" VALUE 0x80022792 Val_Wu16 65535.00 OneToOne 0.00 65535.00 /end CHARACTERISTIC
/begin CHARACTERISTIC DDRC_DurDeb.Layer_numGENREGUPLDebOk_C "DDRC/Dauer der Heilungsentprellung für Prüfung DFC_Layer_GENREGUPLNpl" VALUE 0x80022794 Val_Wu16 65535.00 OneToOne 0.00 65535.00 /end CHARACTERISTIC
/begin CHARACTERISTIC DDRC_DurDeb.Layer_numGENREGUPLDebDef_C "DDRC/Dauer der Fehlerentprellung für Prüfung DFC_Layer_GENREGUPLNpl" VALUE 0x80022796 Val_Wu16 65535.00 OneToOne 0.00 65535.00 /end CHARACTERISTIC
/begin CHARACTERISTIC DDRC_DurDeb.Layer_numGENUPLDebOk_C "DDRC/Dauer der Heilungsentprellung für Prüfung DFC_Layer_GENUPLNpl" VALUE 0x80022798 Val_Wu16 65535.00 OneToOne 0.00 65535.00 /end CHARACTERISTIC
/begin CHARACTERISTIC DDRC_DurDeb.Layer_numGENUPLDebDef_C "DDRC/Dauer der Fehlerentprellung für Prüfung DFC_Layer_GENUPLNpl" VALUE 0x8002279A Val_Wu16 65535.00 OneToOne 0.00 65535.00 /end CHARACTERISTIC
/begin CHARACTERISTIC DDRC_DurDeb.IVDia_numCylNoLdDebOk_C "DDRC/Dauer der Heilungsentprellung für Prüfung DFC_IVDiaCylNoLd" VALUE 0x8002279C Val_Wu16 65535.00 OneToOne 0.00 65535.00 /end CHARACTERISTIC
/begin CHARACTERISTIC DDRC_DurDeb.IVDia_numCylNoLdDebDef_C "DDRC/Dauer der Fehlerentprellung für Prüfung DFC_IVDiaCylNoLd" VALUE 0x8002279E Val_Wu16 65535.00 OneToOne 0.00 65535.00 /end CHARACTERISTIC
/begin CHARACTERISTIC DDRC_DurDeb.LSU_numRiClbMinDebOk_C "DDRC/Dauer der Heilungsentprellung für Prüfung DFC_LSURiClbMin" VALUE 0x800227A0 Val_Wu16 65535.00 OneToOne 0.00 65535.00 /end CHARACTERISTIC
/begin CHARACTERISTIC DDRC_DurDeb.LSU_numRiClbMinDebDef_C "DDRC/Dauer der Fehlerentprellung für Prüfung DFC_LSURiClbMin" VALUE 0x800227A2 Val_Wu16 65535.00 OneToOne 0.00 65535.00 /end CHARACTERISTIC
/begin CHARACTERISTIC DDRC_DurDeb.Exh_numNOxOfsNoCat2DsDebOk_C "DDRC/Dauer der Heilungsentprellung für Prüfung DFC_NoCat2DsNOxOfsMin" VALUE 0x800227A4 Val_Wu16 65535.00 OneToOne 0.00 65535.00 /end CHARACTERISTIC
/begin CHARACTERISTIC DDRC_DurDeb.Exh_numNOxOfsNoCat2DsDebDef_C "DDRC/Dauer der Fehlerentprellung für Prüfung DFC_NoCat2DsNOxOfsMin" VALUE 0x800227A6 Val_Wu16 65535.00 OneToOne 0.00 65535.00 /end CHARACTERISTIC
/begin CHARACTERISTIC DDRC_DurDeb.Layer_numGENKOMMDebOk_C "DDRC/Dauer der Heilungsentprellung für Prüfung DFC_Layer_GENKOMMNpl" VALUE 0x800227A8 Val_Wu16 65535.00 OneToOne 0.00 65535.00 /end CHARACTERISTIC
/begin CHARACTERISTIC DDRC_DurDeb.Layer_numGENKOMMDebDef_C "DDRC/Dauer der Fehlerentprellung für Prüfung DFC_Layer_GENKOMMNpl" VALUE 0x800227AA Val_Wu16 65535.00 OneToOne 0.00 65535.00 /end CHARACTERISTIC
/begin CHARACTERISTIC DDRC_DurDeb.PCV_numNoStrtDebOk_C "DDRC/Dauer der Heilungsentprellung für Prüfung DFC_PCVNoStrt" VALUE 0x800227AC Val_Wu16 65535.00 OneToOne 0.00 65535.00 /end CHARACTERISTIC
/begin CHARACTERISTIC DDRC_DurDeb.PCV_numNoStrtDebDef_C "DDRC/Dauer der Fehlerentprellung für Prüfung DFC_PCVNoStrt" VALUE 0x800227AE Val_Wu16 65535.00 OneToOne 0.00 65535.00 /end CHARACTERISTIC
/begin CHARACTERISTIC DDRC_DurDeb.ETClb_numETMaxDebOk_C "DDRC/Dauer der Heilungsentprellung für Prüfung DFC_ETClbETMax" VALUE 0x800227B0 Val_Wu16 65535.00 OneToOne 0.00 65535.00 /end CHARACTERISTIC
/begin CHARACTERISTIC DDRC_DurDeb.ETClb_numETMaxDebDef_C "DDRC/Dauer der Fehlerentprellung für Prüfung DFC_ETClbETMax" VALUE 0x800227B2 Val_Wu16 65535.00 OneToOne 0.00 65535.00 /end CHARACTERISTIC
/begin CHARACTERISTIC DDRC_DurDeb.RailP_numdpDebDebOk_C "DDRC/Dauer der Heilungsentprellung für Prüfung DFC_RailPGradMon" VALUE 0x800227B4 Val_Wu16 65535.00 OneToOne 0.00 65535.00 /end CHARACTERISTIC
/begin CHARACTERISTIC DDRC_DurDeb.RailP_numdpDebDebDef_C "DDRC/Dauer der Fehlerentprellung für Prüfung DFC_RailPGradMon" VALUE 0x800227B6 Val_Wu16 65535.00 OneToOne 0.00 65535.00 /end CHARACTERISTIC
/begin CHARACTERISTIC DDRC_DurDeb.LSU_numRiClbMaxDebOk_C "DDRC/Dauer der Heilungsentprellung für Prüfung DFC_LSURiClbMax" VALUE 0x800227B8 Val_Wu16 65535.00 OneToOne 0.00 65535.00 /end CHARACTERISTIC
/begin CHARACTERISTIC DDRC_DurDeb.LSU_numRiClbMaxDebDef_C "DDRC/Dauer der Fehlerentprellung für Prüfung DFC_LSURiClbMax" VALUE 0x800227BA Val_Wu16 65535.00 OneToOne 0.00 65535.00 /end CHARACTERISTIC
/begin CHARACTERISTIC DDRC_DurDeb.IVCtl_numUDiffUpOBDDebOk_C "DDRC/Dauer der Heilungsentprellung für Prüfung DFC_IVCtlUDiffUp" VALUE 0x800227BC Val_Wu16 65535.00 OneToOne 0.00 65535.00 /end CHARACTERISTIC
/begin CHARACTERISTIC DDRC_DurDeb.IVCtl_numUDiffUpOBDDebDef_C "DDRC/Dauer der Fehlerentprellung für Prüfung DFC_IVCtlUDiffUp" VALUE 0x800227BE Val_Wu16 65535.00 OneToOne 0.00 65535.00 /end CHARACTERISTIC
/begin CHARACTERISTIC DDRC_DurDeb.Layer_numNGLERNDebOk_C "DDRC/Dauer der Heilungsentprellung für Prüfung DFC_Layer_NGLERNNpl" VALUE 0x800227C0 Val_Wu16 65535.00 OneToOne 0.00 65535.00 /end CHARACTERISTIC
/begin CHARACTERISTIC DDRC_DurDeb.Layer_numNGLERNDebDef_C "DDRC/Dauer der Fehlerentprellung für Prüfung DFC_Layer_NGLERNNpl" VALUE 0x800227C2 Val_Wu16 65535.00 OneToOne 0.00 65535.00 /end CHARACTERISTIC
/begin CHARACTERISTIC DDRC_DurDeb.Layer_numMANDETEKDebOk_C "DDRC/Dauer der Heilungsentprellung für Prüfung DFC_Layer_MANDETEKNpl" VALUE 0x800227C4 Val_Wu16 65535.00 OneToOne 0.00 65535.00 /end CHARACTERISTIC
/begin CHARACTERISTIC DDRC_DurDeb.Layer_numMANDETEKDebDef_C "DDRC/Dauer der Fehlerentprellung für Prüfung DFC_Layer_MANDETEKNpl" VALUE 0x800227C6 Val_Wu16 65535.00 OneToOne 0.00 65535.00 /end CHARACTERISTIC
/begin CHARACTERISTIC DDRC_DurDeb.Exh_numNOxR2LMinNSCDsDebOk_C "DDRC/Dauer der Heilungsentprellung für Prüfung DFC_NSCDsNOxPlausMin" VALUE 0x800227C8 Val_Wu16 65535.00 OneToOne 0.00 65535.00 /end CHARACTERISTIC
/begin CHARACTERISTIC DDRC_DurDeb.Exh_numNOxR2LMinNSCDsDebDef_C "DDRC/Dauer der Fehlerentprellung für Prüfung DFC_NSCDsNOxPlausMin" VALUE 0x800227CA Val_Wu16 65535.00 OneToOne 0.00 65535.00 /end CHARACTERISTIC
/begin CHARACTERISTIC DDRC_DurDeb.Layer_numBSDDebOk_C "DDRC/Dauer der Heilungsentprellung für Prüfung DFC_Layer_BSDNpl" VALUE 0x800227CC Val_Wu16 65535.00 OneToOne 0.00 65535.00 /end CHARACTERISTIC
/begin CHARACTERISTIC DDRC_DurDeb.Layer_numBSDDebDef_C "DDRC/Dauer der Fehlerentprellung für Prüfung DFC_Layer_BSDNpl" VALUE 0x800227CE Val_Wu16 65535.00 OneToOne 0.00 65535.00 /end CHARACTERISTIC
/begin CHARACTERISTIC DDRC_DurDeb.IVActr_numEnrgMinDebOk_C "DDRC/Heilungsentprellung für die Energiediagnose: Minimum" VALUE 0x800227D0 Val_Wu16 65535.00 OneToOne 0.00 65535.00 /end CHARACTERISTIC
/begin CHARACTERISTIC DDRC_DurDeb.IVActr_numEnrgMinDebDef_C "DDRC/Defektentprellung für die Energiediagnose: Minimum" VALUE 0x800227D2 Val_Wu16 65535.00 OneToOne 0.00 65535.00 /end CHARACTERISTIC
/begin CHARACTERISTIC DDRC_DurDeb.LSU_numO2ClbMinDebOk_C "DDRC/Dauer der Heilungsentprellung für Prüfung DFC_LSUO2ClbMin" VALUE 0x800227D4 Val_Wu16 65535.00 OneToOne 0.00 65535.00 /end CHARACTERISTIC
/begin CHARACTERISTIC DDRC_DurDeb.LSU_numO2ClbMinDebDef_C "DDRC/Dauer der Fehlerentprellung für Prüfung DFC_LSUO2ClbMin" VALUE 0x800227D6 Val_Wu16 65535.00 OneToOne 0.00 65535.00 /end CHARACTERISTIC
/begin CHARACTERISTIC DDRC_DurDeb.IVDia_numCylShCirDebOk_C "DDRC/Dauer der Heilungsentprellung für Prüfung DFC_IVDiaCylShCir" VALUE 0x800227D8 Val_Wu16 65535.00 OneToOne 0.00 65535.00 /end CHARACTERISTIC
/begin CHARACTERISTIC DDRC_DurDeb.IVDia_numCylShCirDebDef_C "DDRC/Dauer der Fehlerentprellung für Prüfung DFC_IVDiaCylShCir" VALUE 0x800227DA Val_Wu16 65535.00 OneToOne 0.00 65535.00 /end CHARACTERISTIC
/begin CHARACTERISTIC DDRC_DurDeb.IVDia_numBnkShCirDebOk_C "DDRC/Dauer der Heilungsentprellung für Prüfung DFC_IVDiaBnkShCir" VALUE 0x800227DC Val_Wu16 65535.00 OneToOne 0.00 65535.00 /end CHARACTERISTIC
/begin CHARACTERISTIC DDRC_DurDeb.IVDia_numBnkShCirDebDef_C "DDRC/Dauer der Fehlerentprellung für Prüfung DFC_IVDiaBnkShCir" VALUE 0x800227DE Val_Wu16 65535.00 OneToOne 0.00 65535.00 /end CHARACTERISTIC
/begin CHARACTERISTIC DDRC_DurDeb.IVCtl_numTiDiffOBDDebOk_C "DDRC/Dauer der Heilungsentprellung für Prüfung DFC_IVCtlTiDiff" VALUE 0x800227E0 Val_Wu16 65535.00 OneToOne 0.00 65535.00 /end CHARACTERISTIC
/begin CHARACTERISTIC DDRC_DurDeb.IVCtl_numTiDiffOBDDebDef_C "DDRC/Dauer der Fehlerentprellung für Prüfung DFC_IVCtlTiDiff" VALUE 0x800227E2 Val_Wu16 65535.00 OneToOne 0.00 65535.00 /end CHARACTERISTIC
/begin CHARACTERISTIC DDRC_DurDeb.LSU_numO2PlausMaxPartLdDebOk_C "DDRC/Dauer der Heilungsentprellung für Prüfung DFC_LSUO2PlausMaxPartLd" VALUE 0x800227E4 Val_Wu16 65535.00 OneToOne 0.00 65535.00 /end CHARACTERISTIC
/begin CHARACTERISTIC DDRC_DurDeb.LSU_numO2PlausMaxPartLdDebDef_C "DDRC/Dauer der Fehlerentprellung für Prüfung DFC_LSUO2PlausMaxPartLd" VALUE 0x800227E6 Val_Wu16 65535.00 OneToOne 0.00 65535.00 /end CHARACTERISTIC
/begin CHARACTERISTIC DDRC_DurDeb.IVDia_numCylNoClsDebOk_C "DDRC/Heilungsentprellung für den Fehlerpfad Injektorfehler: nicht klassifizierbar" VALUE 0x800227E8 Val_Wu16 65535.00 OneToOne 0.00 65535.00 /end CHARACTERISTIC
/begin CHARACTERISTIC DDRC_DurDeb.IVDia_numCylNoClsDebDef_C "DDRC/Defektentprellung für den Fehlerpfad Injektorfehler: nicht klassifizierbar" VALUE 0x800227EA Val_Wu16 65535.00 OneToOne 0.00 65535.00 /end CHARACTERISTIC
/begin CHARACTERISTIC DDRC_DurDeb.Layer_numGENELBDebOk_C "DDRC/Dauer der Heilungsentprellung für Prüfung DFC_Layer_GENELBNpl" VALUE 0x800227EC Val_Wu16 65535.00 OneToOne 0.00 65535.00 /end CHARACTERISTIC
/begin CHARACTERISTIC DDRC_DurDeb.Layer_numGENELBDebDef_C "DDRC/Dauer der Fehlerentprellung für Prüfung DFC_Layer_GENELBNpl" VALUE 0x800227EE Val_Wu16 65535.00 OneToOne 0.00 65535.00 /end CHARACTERISTIC
/begin CHARACTERISTIC DDRC_DurDeb.LSU_numO2PlausMaxOvrRunDebOk_C "DDRC/Dauer der Heilungsentprellung für Prüfung DFC_LSUO2PlausMaxOvrRun" VALUE 0x800227F0 Val_Wu16 65535.00 OneToOne 0.00 65535.00 /end CHARACTERISTIC
/begin CHARACTERISTIC DDRC_DurDeb.LSU_numO2PlausMaxOvrRunDebDef_C "DDRC/Dauer der Fehlerentprellung für Prüfung DFC_LSUO2PlausMaxOvrRun" VALUE 0x800227F2 Val_Wu16 65535.00 OneToOne 0.00 65535.00 /end CHARACTERISTIC
/begin CHARACTERISTIC DDRC_DurDeb.SCRPOD_numPresBuildUpErrDebOk_C "DDRC/Dauer der Heilungsentprellung für Prüfung DFC_SCRPODPresBuildUp" VALUE 0x800227F4 Val_Wu16 65535.00 OneToOne 0.00 65535.00 /end CHARACTERISTIC
/begin CHARACTERISTIC DDRC_DurDeb.SCRPOD_numPresBuildUpErrDebDef_C "DDRC/Dauer der Fehlerentprellung für Prüfung DFC_SCRPODPresBuildUp" VALUE 0x800227F6 Val_Wu16 65535.00 OneToOne 0.00 65535.00 /end CHARACTERISTIC
/begin CHARACTERISTIC DDRC_DurDeb.Layer_numPMRUHVERLDebOk_C "DDRC/Dauer der Heilungsentprellung für Prüfung DFC_Layer_PMRUHVERLNpl" VALUE 0x800227F8 Val_Wu16 65535.00 OneToOne 0.00 65535.00 /end CHARACTERISTIC
/begin CHARACTERISTIC DDRC_DurDeb.Layer_numPMRUHVERLDebDef_C "DDRC/Dauer der Fehlerentprellung für Prüfung DFC_Layer_PMRUHVERLNpl" VALUE 0x800227FA Val_Wu16 65535.00 OneToOne 0.00 65535.00 /end CHARACTERISTIC
/begin CHARACTERISTIC DDRC_DurDeb.Layer_numQLTDebOk_C "DDRC/Dauer der Heilungsentprellung für Prüfung DFC_Layer_QLTNpl" VALUE 0x800227FC Val_Wu16 65535.00 OneToOne 0.00 65535.00 /end CHARACTERISTIC
/begin CHARACTERISTIC DDRC_DurDeb.Layer_numQLTDebDef_C "DDRC/Dauer der Fehlerentprellung für Prüfung DFC_Layer_QLTNpl" VALUE 0x800227FE Val_Wu16 65535.00 OneToOne 0.00 65535.00 /end CHARACTERISTIC
/begin CHARACTERISTIC DDRC_DurDeb.Layer_numPMBNDebOk_C "DDRC/Dauer der Heilungsentprellung für Prüfung DFC_Layer_PMBNNpl" VALUE 0x80022800 Val_Wu16 65535.00 OneToOne 0.00 65535.00 /end CHARACTERISTIC
/begin CHARACTERISTIC DDRC_DurDeb.Layer_numPMBNDebDef_C "DDRC/Dauer der Fehlerentprellung für Prüfung DFC_Layer_PMBNNpl" VALUE 0x80022802 Val_Wu16 65535.00 OneToOne 0.00 65535.00 /end CHARACTERISTIC
/begin CHARACTERISTIC DDRC_DurDeb.Layer_numGENDebOk_C "DDRC/Dauer der Heilungsentprellung für Prüfung DFC_Layer_GENNpl" VALUE 0x80022804 Val_Wu16 65535.00 OneToOne 0.00 65535.00 /end CHARACTERISTIC
/begin CHARACTERISTIC DDRC_DurDeb.Layer_numGENDebDef_C "DDRC/Dauer der Fehlerentprellung für Prüfung DFC_Layer_GENNpl" VALUE 0x80022806 Val_Wu16 65535.00 OneToOne 0.00 65535.00 /end CHARACTERISTIC
/begin CHARACTERISTIC DDRC_DurDeb.IVDia_numBnkShCirChSwtDebOk_C "DDRC/Heilungsentprellung für den Fehlerpfad" VALUE 0x80022808 Val_Wu16 65535.00 OneToOne 0.00 65535.00 /end CHARACTERISTIC
/begin CHARACTERISTIC DDRC_DurDeb.IVDia_numBnkShCirChSwtDebDef_C "DDRC/Defektentprellung für den Fehlerpfad" VALUE 0x8002280A Val_Wu16 65535.00 OneToOne 0.00 65535.00 /end CHARACTERISTIC
/begin CHARACTERISTIC DDRC_DurDeb.Layer_numIBS3DebOk_C "DDRC/Dauer der Heilungsentprellung für Prüfung DFC_Layer_IBS3Npl" VALUE 0x8002280C Val_Wu16 65535.00 OneToOne 0.00 65535.00 /end CHARACTERISTIC
/begin CHARACTERISTIC DDRC_DurDeb.Layer_numIBS3DebDef_C "DDRC/Dauer der Fehlerentprellung für Prüfung DFC_Layer_IBS3Npl" VALUE 0x8002280E Val_Wu16 65535.00 OneToOne 0.00 65535.00 /end CHARACTERISTIC
/begin CHARACTERISTIC DDRC_DurDeb.IVDia_numCylShCirMeasDebOk_C "DDRC/Dauer der Heilungsentprellung für Prüfung DFC_IVDiaCylShCirMeas" VALUE 0x80022810 Val_Wu16 65535.00 OneToOne 0.00 65535.00 /end CHARACTERISTIC
/begin CHARACTERISTIC DDRC_DurDeb.IVDia_numCylShCirMeasDebDef_C "DDRC/Dauer der Fehlerentprellung für Prüfung DFC_IVDiaCylShCirMeas" VALUE 0x80022812 Val_Wu16 65535.00 OneToOne 0.00 65535.00 /end CHARACTERISTIC
/begin CHARACTERISTIC DDRC_DurDeb.Layer_numGENHTBDebOk_C "DDRC/Dauer der Heilungsentprellung für Prüfung DFC_Layer_GENHTBNpl" VALUE 0x80022814 Val_Wu16 65535.00 OneToOne 0.00 65535.00 /end CHARACTERISTIC
/begin CHARACTERISTIC DDRC_DurDeb.Layer_numGENHTBDebDef_C "DDRC/Dauer der Fehlerentprellung für Prüfung DFC_Layer_GENHTBNpl" VALUE 0x80022816 Val_Wu16 65535.00 OneToOne 0.00 65535.00 /end CHARACTERISTIC
/begin CHARACTERISTIC DDRC_DurDeb.EngTrqPtd_ctMonLimCurrDebOk_C "DDRC/Dauer der Heilungsentprellung für Prüfung DFC_MonLimCurr" VALUE 0x80022818 Val_Wu16 65535.00 OneToOne 0.00 65535.00 /end CHARACTERISTIC
/begin CHARACTERISTIC DDRC_DurDeb.EngTrqPtd_ctMonLimCurrDebDef_C "DDRC/Dauer der Fehlerentprellung für Prüfung DFC_MonLimCurr" VALUE 0x8002281A Val_Wu16 65535.00 OneToOne 0.00 65535.00 /end CHARACTERISTIC
/begin CHARACTERISTIC DDRC_DurDeb.Layer_numIBS2DebOk_C "DDRC/Dauer der Heilungsentprellung für Prüfung DFC_Layer_IBS2Npl" VALUE 0x8002281C Val_Wu16 65535.00 OneToOne 0.00 65535.00 /end CHARACTERISTIC
/begin CHARACTERISTIC DDRC_DurDeb.Layer_numIBS2DebDef_C "DDRC/Dauer der Fehlerentprellung für Prüfung DFC_Layer_IBS2Npl" VALUE 0x8002281E Val_Wu16 65535.00 OneToOne 0.00 65535.00 /end CHARACTERISTIC
/begin CHARACTERISTIC DDRC_DurDeb.LSU_numO2ClbMaxDebOk_C "DDRC/Dauer der Heilungsentprellung für Prüfung DFC_LSUO2ClbMax" VALUE 0x80022820 Val_Wu16 65535.00 OneToOne 0.00 65535.00 /end CHARACTERISTIC
/begin CHARACTERISTIC DDRC_DurDeb.LSU_numO2ClbMaxDebDef_C "DDRC/Dauer der Fehlerentprellung für Prüfung DFC_LSUO2ClbMax" VALUE 0x80022822 Val_Wu16 65535.00 OneToOne 0.00 65535.00 /end CHARACTERISTIC
/begin CHARACTERISTIC DDRC_DurDeb.IVActr_numEnrgNplDebOk_C "DDRC/Heilungsentprellung für die Energiediagnose: NPL" VALUE 0x80022824 Val_Wu16 65535.00 OneToOne 0.00 65535.00 /end CHARACTERISTIC
/begin CHARACTERISTIC DDRC_DurDeb.IVActr_numEnrgNplDebDef_C "DDRC/Defektentprellung für die Energiediagnose: NPL" VALUE 0x80022826 Val_Wu16 65535.00 OneToOne 0.00 65535.00 /end CHARACTERISTIC
/begin CHARACTERISTIC DDRC_DurDeb.LSU_numO2PlausMinPartLdDebOk_C "DDRC/Dauer der Heilungsentprellung für Prüfung DFC_LSUO2PlausMinPartLd" VALUE 0x80022828 Val_Wu16 65535.00 OneToOne 0.00 65535.00 /end CHARACTERISTIC
/begin CHARACTERISTIC DDRC_DurDeb.LSU_numO2PlausMinPartLdDebDef_C "DDRC/Dauer der Fehlerentprellung für Prüfung DFC_LSUO2PlausMinPartLd" VALUE 0x8002282A Val_Wu16 65535.00 OneToOne 0.00 65535.00 /end CHARACTERISTIC
/begin CHARACTERISTIC DDRC_DurDeb.Layer_numGENMECHDebOk_C "DDRC/Dauer der Heilungsentprellung für Prüfung DFC_Layer_GENMECHNpl" VALUE 0x8002282C Val_Wu16 65535.00 OneToOne 0.00 65535.00 /end CHARACTERISTIC
/begin CHARACTERISTIC DDRC_DurDeb.Layer_numGENMECHDebDef_C "DDRC/Dauer der Fehlerentprellung für Prüfung DFC_Layer_GENMECHNpl" VALUE 0x8002282E Val_Wu16 65535.00 OneToOne 0.00 65535.00 /end CHARACTERISTIC
/begin CHARACTERISTIC DDRC_DurDeb.Layer_numGENHTDebOk_C "DDRC/Dauer der Heilungsentprellung für Prüfung DFC_Layer_GENHTNpl" VALUE 0x80022830 Val_Wu16 65535.00 OneToOne 0.00 65535.00 /end CHARACTERISTIC
/begin CHARACTERISTIC DDRC_DurDeb.Layer_numGENHTDebDef_C "DDRC/Dauer der Fehlerentprellung für Prüfung DFC_Layer_GENHTNpl" VALUE 0x80022832 Val_Wu16 65535.00 OneToOne 0.00 65535.00 /end CHARACTERISTIC
/begin CHARACTERISTIC DDRC_DurDeb.Layer_numIBS1DebOk_C "DDRC/Dauer der Heilungsentprellung für Prüfung DFC_Layer_IBS1Npl" VALUE 0x80022834 Val_Wu16 65535.00 OneToOne 0.00 65535.00 /end CHARACTERISTIC
/begin CHARACTERISTIC DDRC_DurDeb.Layer_numIBS1DebDef_C "DDRC/Dauer der Fehlerentprellung für Prüfung DFC_Layer_IBS1Npl" VALUE 0x80022836 Val_Wu16 65535.00 OneToOne 0.00 65535.00 /end CHARACTERISTIC
/begin CHARACTERISTIC DDRC_DurDeb.Exh_numNOxR2LMinNoCat2DsDebOk_C "DDRC/Dauer der Heilungsentprellung für Prüfung DFC_NoCat2DsNOxPlausMin" VALUE 0x80022838 Val_Wu16 65535.00 OneToOne 0.00 65535.00 /end CHARACTERISTIC
/begin CHARACTERISTIC DDRC_DurDeb.Exh_numNOxR2LMinNoCat2DsDebDef_C "DDRC/Dauer der Fehlerentprellung für Prüfung DFC_NoCat2DsNOxPlausMin" VALUE 0x8002283A Val_Wu16 65535.00 OneToOne 0.00 65535.00 /end CHARACTERISTIC
/begin CHARACTERISTIC DDRC_DurDeb.LSU_numO2PlausMinFLdDebOk_C "DDRC/Dauer der Heilungsentprellung für Prüfung DFC_LSUO2PlausMinFLd" VALUE 0x8002283C Val_Wu16 65535.00 OneToOne 0.00 65535.00 /end CHARACTERISTIC
/begin CHARACTERISTIC DDRC_DurDeb.LSU_numO2PlausMinFLdDebDef_C "DDRC/Dauer der Fehlerentprellung für Prüfung DFC_LSUO2PlausMinFLd" VALUE 0x8002283E Val_Wu16 65535.00 OneToOne 0.00 65535.00 /end CHARACTERISTIC
/begin CHARACTERISTIC DDRC_DurDeb.Layer_numTOENSDebOk_C "DDRC/Dauer der Heilungsentprellung für Prüfung DFC_Layer_TOENSNpl" VALUE 0x80022840 Val_Wu16 65535.00 OneToOne 0.00 65535.00 /end CHARACTERISTIC
/begin CHARACTERISTIC DDRC_DurDeb.Layer_numTOENSDebDef_C "DDRC/Dauer der Fehlerentprellung für Prüfung DFC_Layer_TOENSNpl" VALUE 0x80022842 Val_Wu16 65535.00 OneToOne 0.00 65535.00 /end CHARACTERISTIC
/begin CHARACTERISTIC DDRC_DurDeb.IVActr_numEnrgMaxDebOk_C "DDRC/Heilungsentprellung für die Energiediagnose: Maximum" VALUE 0x80022844 Val_Wu16 65535.00 OneToOne 0.00 65535.00 /end CHARACTERISTIC
/begin CHARACTERISTIC DDRC_DurDeb.IVActr_numEnrgMaxDebDef_C "DDRC/Defektentprellung für die Energiediagnose: Maximum" VALUE 0x80022846 Val_Wu16 65535.00 OneToOne 0.00 65535.00 /end CHARACTERISTIC
/begin CHARACTERISTIC DDRC_DurDeb.ETClb_numETMinDebOk_C "DDRC/Dauer der Heilungsentprellung für Prüfung DFC_ETClbETMin" VALUE 0x80022848 Val_Wu16 65535.00 OneToOne 0.00 65535.00 /end CHARACTERISTIC
/begin CHARACTERISTIC DDRC_DurDeb.ETClb_numETMinDebDef_C "DDRC/Dauer der Fehlerentprellung für Prüfung DFC_ETClbETMin" VALUE 0x8002284A Val_Wu16 65535.00 OneToOne 0.00 65535.00 /end CHARACTERISTIC
/begin CHARACTERISTIC DDRC_DurDeb.Clth_numPlaDebOk_C "DDRC/Dauer der Heilungsentprellung für Prüfung DFC_ClthNpl" VALUE 0x8002284C Val_Wu16 65535.00 OneToOne 0.00 65535.00 /end CHARACTERISTIC
/begin CHARACTERISTIC DDRC_DurDeb.Clth_numPlaDebDef_C "DDRC/Dauer der Fehlerentprellung für Prüfung DFC_ClthNpl" VALUE 0x8002284E Val_Wu16 65535.00 OneToOne 0.00 65535.00 /end CHARACTERISTIC
/begin CHARACTERISTIC DDRC_DurDeb.Exh_numNOxOfsNSCDsDebOk_C "DDRC/Dauer der Heilungsentprellung für Prüfung DFC_NSCDsNOxOfsMin" VALUE 0x80022850 Val_Wu16 65535.00 OneToOne 0.00 65535.00 /end CHARACTERISTIC
/begin CHARACTERISTIC DDRC_DurDeb.Exh_numNOxOfsNSCDsDebDef_C "DDRC/Dauer der Fehlerentprellung für Prüfung DFC_NSCDsNOxOfsMin" VALUE 0x80022852 Val_Wu16 65535.00 OneToOne 0.00 65535.00 /end CHARACTERISTIC
/begin CHARACTERISTIC DDRC_DurDeb.Layer_numNDR1DebOk_C "DDRC/Dauer der Heilungsentprellung für Prüfung DFC_Layer_NDR1Npl" VALUE 0x80022854 Val_Wu16 65535.00 OneToOne 0.00 65535.00 /end CHARACTERISTIC
/begin CHARACTERISTIC DDRC_DurDeb.Layer_numNDR1DebDef_C "DDRC/Dauer der Fehlerentprellung für Prüfung DFC_Layer_NDR1Npl" VALUE 0x80022856 Val_Wu16 65535.00 OneToOne 0.00 65535.00 /end CHARACTERISTIC
/begin CHARACTERISTIC DDRC_DurDeb.Layer_numPMBATTDebOk_C "DDRC/Dauer der Heilungsentprellung für Prüfung DFC_Layer_PMBATTNpl" VALUE 0x80022858 Val_Wu16 65535.00 OneToOne 0.00 65535.00 /end CHARACTERISTIC
/begin CHARACTERISTIC DDRC_DurDeb.Layer_numPMBATTDebDef_C "DDRC/Dauer der Fehlerentprellung für Prüfung DFC_Layer_PMBATTNpl" VALUE 0x8002285A Val_Wu16 65535.00 OneToOne 0.00 65535.00 /end CHARACTERISTIC
/begin CHARACTERISTIC DDRC_DurDeb.LSU_numDynChkMinDebOk_C "DDRC/Dauer der Heilungsentprellung für Prüfung DFC_LSUDynChk" VALUE 0x8002285C Val_Wu16 65535.00 OneToOne 0.00 65535.00 /end CHARACTERISTIC
/begin CHARACTERISTIC DDRC_DurDeb.LSU_numDynChkMinDebDef_C "DDRC/Dauer der Fehlerentprellung für Prüfung DFC_LSUDynChk" VALUE 0x8002285E Val_Wu16 65535.00 OneToOne 0.00 65535.00 /end CHARACTERISTIC
/begin CHARACTERISTIC DDRC_DurDeb.LSU_numO2PlausMaxFLdDebOk_C "DDRC/Dauer der Heilungsentprellung für Prüfung DFC_LSUO2PlausMaxFLd" VALUE 0x80022860 Val_Wu16 65535.00 OneToOne 0.00 65535.00 /end CHARACTERISTIC
/begin CHARACTERISTIC DDRC_DurDeb.LSU_numO2PlausMaxFLdDebDef_C "DDRC/Dauer der Fehlerentprellung für Prüfung DFC_LSUO2PlausMaxFLd" VALUE 0x80022862 Val_Wu16 65535.00 OneToOne 0.00 65535.00 /end CHARACTERISTIC
/begin CHARACTERISTIC DDRC_DurDeb.IVCtl_numUUpOBDDebOk_C "DDRC/Dauer der Heilungsentprellung für Prüfung DFC_IVCtlUUp" VALUE 0x80022864 Val_Wu16 65535.00 OneToOne 0.00 65535.00 /end CHARACTERISTIC
/begin CHARACTERISTIC DDRC_DurDeb.IVCtl_numUUpOBDDebDef_C "DDRC/Dauer der Fehlerentprellung für Prüfung DFC_IVCtlUUp" VALUE 0x80022866 Val_Wu16 65535.00 OneToOne 0.00 65535.00 /end CHARACTERISTIC
/begin CHARACTERISTIC DDRC_DurDeb.Layer_numNDR2DebOk_C "DDRC/Dauer der Heilungsentprellung für Prüfung DFC_Layer_NDR2Npl" VALUE 0x80022868 Val_Wu16 65535.00 OneToOne 0.00 65535.00 /end CHARACTERISTIC
/begin CHARACTERISTIC DDRC_DurDeb.Layer_numNDR2DebDef_C "DDRC/Dauer der Fehlerentprellung für Prüfung DFC_Layer_NDR2Npl" VALUE 0x8002286A Val_Wu16 65535.00 OneToOne 0.00 65535.00 /end CHARACTERISTIC
/begin CHARACTERISTIC DDRC_DurDeb.LSU_numWireIPSigDebOk_C "DDRC/Dauer der Heilungsentprellung für Prüfung DFC_LSUWireIPSig" VALUE 0x8002286C Val_Wu16 65535.00 OneToOne 0.00 65535.00 /end CHARACTERISTIC
/begin CHARACTERISTIC DDRC_DurDeb.LSU_numWireIPSigDebDef_C "DDRC/Dauer der Fehlerentprellung für Prüfung DFC_LSUWireIPSig" VALUE 0x8002286E Val_Wu16 65535.00 OneToOne 0.00 65535.00 /end CHARACTERISTIC
/begin CHARACTERISTIC DDRC_DurDeb.IVDia_numCylShCirHSLSDebOk_C "DDRC/Dauer der Heilungsentprellung für Prüfung DFC_IVDiaCylShCirHSLS" VALUE 0x80022870 Val_Wu16 65535.00 OneToOne 0.00 65535.00 /end CHARACTERISTIC
/begin CHARACTERISTIC DDRC_DurDeb.IVDia_numCylShCirHSLSDebDef_C "DDRC/Dauer der Fehlerentprellung für Prüfung DFC_IVDiaCylShCirHSLS" VALUE 0x80022872 Val_Wu16 65535.00 OneToOne 0.00 65535.00 /end CHARACTERISTIC
/begin CHARACTERISTIC DDRC_DurDeb.Layer_numGENELDebOk_C "DDRC/Dauer der Heilungsentprellung für Prüfung DFC_Layer_GENELNpl" VALUE 0x80022874 Val_Wu16 65535.00 OneToOne 0.00 65535.00 /end CHARACTERISTIC
/begin CHARACTERISTIC DDRC_DurDeb.Layer_numGENELDebDef_C "DDRC/Dauer der Fehlerentprellung für Prüfung DFC_Layer_GENELNpl" VALUE 0x80022876 Val_Wu16 65535.00 OneToOne 0.00 65535.00 /end CHARACTERISTIC
/begin CHARACTERISTIC DDRC_DurDeb.EngTrqPtd_ctMonLimSetDebOk_C "DDRC/Dauer der Heilungsentprellung für Prüfung DFC_MonLimSet" VALUE 0x80022878 Val_Wu16 65535.00 OneToOne 0.00 65535.00 /end CHARACTERISTIC
/begin CHARACTERISTIC DDRC_DurDeb.EngTrqPtd_ctMonLimSetDebDef_C "DDRC/Dauer der Fehlerentprellung für Prüfung DFC_MonLimSet" VALUE 0x8002287A Val_Wu16 65535.00 OneToOne 0.00 65535.00 /end CHARACTERISTIC
/begin CHARACTERISTIC DDRC_DurDeb.LSU_numO2PlausMinOvrRunDebOk_C "DDRC/Dauer der Heilungsentprellung für Prüfung DFC_LSUO2PlausMinOvrRun" VALUE 0x8002287C Val_Wu16 65535.00 OneToOne 0.00 65535.00 /end CHARACTERISTIC
/begin CHARACTERISTIC DDRC_DurDeb.LSU_numO2PlausMinOvrRunDebDef_C "DDRC/Dauer der Fehlerentprellung für Prüfung DFC_LSUO2PlausMinOvrRun" VALUE 0x8002287E Val_Wu16 65535.00 OneToOne 0.00 65535.00 /end CHARACTERISTIC
/begin CHARACTERISTIC DDRC_DurDeb.IVDia_numChpDebOk_C "DDRC/Dauer der Heilungsentprellung für Prüfung DFC_IVDiaChp" VALUE 0x80022880 Val_Wu16 65535.00 OneToOne 0.00 65535.00 /end CHARACTERISTIC
/begin CHARACTERISTIC DDRC_DurDeb.IVDia_numChpDebDef_C "DDRC/Dauer der Fehlerentprellung für Prüfung DFC_IVDiaChp" VALUE 0x80022882 Val_Wu16 65535.00 OneToOne 0.00 65535.00 /end CHARACTERISTIC
/begin CHARACTERISTIC DDRC_DurDeb.Com_tiPspToDebOk_C "DDRC/Dauer der Heilungsentprellung für Prüfung DFC_ComPspTo" VALUE 0x80022884 Val_Wu16 655350.0 DDRCTime_ms 0.00 655350.0 /end CHARACTERISTIC
/begin CHARACTERISTIC DDRC_DurDeb.Com_tiPspToDebDef_C "DDRC/Dauer der Fehlerentprellung für Prüfung DFC_ComPspTo" VALUE 0x80022886 Val_Wu16 655350.0 DDRCTime_ms 0.00 655350.0 /end CHARACTERISTIC
/begin CHARACTERISTIC DDRC_DurDeb.Com_tiTrqWhlDemFASCtr_FXDebOk_C "DDRC/Dauer der Heilungsentprellung für Prüfung DFC_ComTrqWhlDemFASCtr_FX" VALUE 0x80022888 Val_Wu16 655350.0 DDRCTime_ms 0.00 655350.0 /end CHARACTERISTIC
/begin CHARACTERISTIC DDRC_DurDeb.Com_tiTrqWhlDemFASCtr_FXDebDef_C "DDRC/Dauer der Fehlerentprellung für Prüfung DFC_ComTrqWhlDemFASCtr_FX" VALUE 0x8002288A Val_Wu16 655350.0 DDRCTime_ms 0.00 655350.0 /end CHARACTERISTIC
/begin CHARACTERISTIC DDRC_DurDeb.Com_tiTrqDemandGbxTo_FADebOk_C "DDRC/Dauer der Heilungsentprellung für Prüfung DFC_ComTrqDemandGbxTo_FA" VALUE 0x8002288C Val_Wu16 655350.0 DDRCTime_ms 0.00 655350.0 /end CHARACTERISTIC
/begin CHARACTERISTIC DDRC_DurDeb.Com_tiTrqDemandGbxTo_FADebDef_C "DDRC/Dauer der Fehlerentprellung für Prüfung DFC_ComTrqDemandGbxTo_FA" VALUE 0x8002288E Val_Wu16 655350.0 DDRCTime_ms 0.00 655350.0 /end CHARACTERISTIC
/begin CHARACTERISTIC DDRC_DurDeb.Com_tiTrqDemCrshDrDyCtr_FXDebOk_C "DDRC/Dauer der Heilungsentprellung für Prüfung DFC_ComTrqDemCrshDrDyCtr_FX" VALUE 0x80022890 Val_Wu16 655350.0 DDRCTime_ms 0.00 655350.0 /end CHARACTERISTIC
/begin CHARACTERISTIC DDRC_DurDeb.Com_tiTrqDemCrshDrDyCtr_FXDebDef_C "DDRC/Dauer der Fehlerentprellung für Prüfung DFC_ComTrqDemCrshDrDyCtr_FX" VALUE 0x80022892 Val_Wu16 655350.0 DDRCTime_ms 0.00 655350.0 /end CHARACTERISTIC
/begin CHARACTERISTIC DDRC_DurDeb.Rail_tiMeUn2DebOk_C "DDRC/Dauer der Heilungsentprellung für Prüfung DFC_RailMeUn2" VALUE 0x80022894 Val_Wu16 655350.0 DDRCTime_ms 0.00 655350.0 /end CHARACTERISTIC
/begin CHARACTERISTIC DDRC_DurDeb.Rail_tiMeUn2DebDef_C "DDRC/Dauer der Fehlerentprellung für Prüfung DFC_RailMeUn2" VALUE 0x80022896 Val_Wu16 655350.0 DDRCTime_ms 0.00 655350.0 /end CHARACTERISTIC
/begin CHARACTERISTIC DDRC_DurDeb.Com_tiTrqDemandGbxSig_ADebOk_C "DDRC/Dauer der Heilungsentprellung für Prüfung DFC_ComTrqDemandGbxSig_A" VALUE 0x80022898 Val_Wu16 655350.0 DDRCTime_ms 0.00 655350.0 /end CHARACTERISTIC
/begin CHARACTERISTIC DDRC_DurDeb.Com_tiTrqDemandGbxSig_ADebDef_C "DDRC/Dauer der Fehlerentprellung für Prüfung DFC_ComTrqDemandGbxSig_A" VALUE 0x8002289A Val_Wu16 655350.0 DDRCTime_ms 0.00 655350.0 /end CHARACTERISTIC
/begin CHARACTERISTIC DDRC_DurDeb.AirCtl_tiGovDvtMinDebOk_C "DDRC/Dauer der Heilungsentprellung für Prüfung DFC_AirCtlGovDvtMin" VALUE 0x8002289C Val_Wu16 655350.0 DDRCTime_ms 0.00 655350.0 /end CHARACTERISTIC
/begin CHARACTERISTIC DDRC_DurDeb.AirCtl_tiGovDvtMinDebDef_C "DDRC/Dauer der Fehlerentprellung für Prüfung DFC_AirCtlGovDvtMin" VALUE 0x8002289E Val_Wu16 655350.0 DDRCTime_ms 0.00 655350.0 /end CHARACTERISTIC
/begin CHARACTERISTIC DDRC_DurDeb.WaHtEl_ti4WinErr3DebOk_C "DDRC/Dauer der Heilungsentprellung für Prüfung DFC_WaHtEl4WinErr3" VALUE 0x800228A0 Val_Wu16 655350.0 DDRCTime_ms 0.00 655350.0 /end CHARACTERISTIC
/begin CHARACTERISTIC DDRC_DurDeb.WaHtEl_ti4WinErr3DebDef_C "DDRC/Dauer der Fehlerentprellung für Prüfung DFC_WaHtEl4WinErr3" VALUE 0x800228A2 Val_Wu16 655350.0 DDRCTime_ms 0.00 655350.0 /end CHARACTERISTIC
/begin CHARACTERISTIC DDRC_DurDeb.Com_tiTrqDemandGbxCtr_ADebOk_C "DDRC/Dauer der Heilungsentprellung für Prüfung DFC_ComTrqDemandGbxCtr_A" VALUE 0x800228A4 Val_Wu16 655350.0 DDRCTime_ms 0.00 655350.0 /end CHARACTERISTIC
/begin CHARACTERISTIC DDRC_DurDeb.Com_tiTrqDemandGbxCtr_ADebDef_C "DDRC/Dauer der Fehlerentprellung für Prüfung DFC_ComTrqDemandGbxCtr_A" VALUE 0x800228A6 Val_Wu16 655350.0 DDRCTime_ms 0.00 655350.0 /end CHARACTERISTIC
/begin CHARACTERISTIC DDRC_DurDeb.Rail_tiMeUn22DebOk_C "DDRC/Dauer der Heilungsentprellung für Prüfung DFC_RailMeUn22" VALUE 0x800228A8 Val_Wu16 655350.0 DDRCTime_ms 0.00 655350.0 /end CHARACTERISTIC
/begin CHARACTERISTIC DDRC_DurDeb.Rail_tiMeUn22DebDef_C "DDRC/Dauer der Fehlerentprellung für Prüfung DFC_RailMeUn22" VALUE 0x800228AA Val_Wu16 655350.0 DDRCTime_ms 0.00 655350.0 /end CHARACTERISTIC
/begin CHARACTERISTIC DDRC_DurDeb.PFlt_tiPreMaxRgnDebOk_C "DDRC/Dauer der Heilungsentprellung für Prüfung DFC_PFlt_tPreMaxRgn" VALUE 0x800228AC Val_Wu16 655350.0 DDRCTime_ms 0.00 655350.0 /end CHARACTERISTIC
/begin CHARACTERISTIC DDRC_DurDeb.PFlt_tiPreMaxRgnDebDef_C "DDRC/Dauer der Fehlerentprellung für Prüfung DFC_PFlt_tPreMaxRgn" VALUE 0x800228AE Val_Wu16 655350.0 DDRCTime_ms 0.00 655350.0 /end CHARACTERISTIC
/begin CHARACTERISTIC DDRC_DurDeb.Com_tiRpmWhlChk_FXDebOk_C "DDRC/Dauer der Heilungsentprellung für Prüfung DFC_ComRpmWhlChk_FX" VALUE 0x800228B0 Val_Wu16 655350.0 DDRCTime_ms 0.00 655350.0 /end CHARACTERISTIC
/begin CHARACTERISTIC DDRC_DurDeb.Com_tiRpmWhlChk_FXDebDef_C "DDRC/Dauer der Fehlerentprellung für Prüfung DFC_ComRpmWhlChk_FX" VALUE 0x800228B2 Val_Wu16 655350.0 DDRCTime_ms 0.00 655350.0 /end CHARACTERISTIC
/begin CHARACTERISTIC DDRC_DurDeb.Fan_ti4WinErr2DebOk_C "DDRC/Dauer der Heilungsentprellung für Prüfung DFC_Fan4WinErr2" VALUE 0x800228B4 Val_Wu16 655350.0 DDRCTime_ms 0.00 655350.0 /end CHARACTERISTIC
/begin CHARACTERISTIC DDRC_DurDeb.Fan_ti4WinErr2DebDef_C "DDRC/Dauer der Fehlerentprellung für Prüfung DFC_Fan4WinErr2" VALUE 0x800228B6 Val_Wu16 655350.0 DDRCTime_ms 0.00 655350.0 /end CHARACTERISTIC
/begin CHARACTERISTIC DDRC_DurDeb.Fan_ti4WinErr1DebOk_C "DDRC/Dauer der Heilungsentprellung für Prüfung DFC_Fan4WinErr1" VALUE 0x800228B8 Val_Wu16 655350.0 DDRCTime_ms 0.00 655350.0 /end CHARACTERISTIC
/begin CHARACTERISTIC DDRC_DurDeb.Fan_ti4WinErr1DebDef_C "DDRC/Dauer der Fehlerentprellung für Prüfung DFC_Fan4WinErr1" VALUE 0x800228BA Val_Wu16 655350.0 DDRCTime_ms 0.00 655350.0 /end CHARACTERISTIC
/begin CHARACTERISTIC DDRC_DurDeb.AltIO_tiComNplDebOk_C "DDRC/Dauer der Heilungsentprellung für Prüfung DFC_AltIOComNpl" VALUE 0x800228BC Val_Wu16 655350.0 DDRCTime_ms 0.00 655350.0 /end CHARACTERISTIC
/begin CHARACTERISTIC DDRC_DurDeb.AltIO_tiComNplDebDef_C "DDRC/Dauer der Fehlerentprellung für Prüfung DFC_AltIOComNpl" VALUE 0x800228BE Val_Wu16 655350.0 DDRCTime_ms 0.00 655350.0 /end CHARACTERISTIC
/begin CHARACTERISTIC DDRC_DurDeb.Com_tiStConintDSCTo_FXDebOk_C "DDRC/Dauer der Heilungsentprellung für Prüfung DFC_ComStConintDSCTo_FX" VALUE 0x800228C0 Val_Wu16 655350.0 DDRCTime_ms 0.00 655350.0 /end CHARACTERISTIC
/begin CHARACTERISTIC DDRC_DurDeb.Com_tiStConintDSCTo_FXDebDef_C "DDRC/Dauer der Fehlerentprellung für Prüfung DFC_ComStConintDSCTo_FX" VALUE 0x800228C2 Val_Wu16 655350.0 DDRCTime_ms 0.00 655350.0 /end CHARACTERISTIC
/begin CHARACTERISTIC DDRC_DurDeb.Com_tiPspSigDebOk_C "DDRC/Dauer der Heilungsentprellung für Prüfung DFC_ComPspSig" VALUE 0x800228C4 Val_Wu16 655350.0 DDRCTime_ms 0.00 655350.0 /end CHARACTERISTIC
/begin CHARACTERISTIC DDRC_DurDeb.Com_tiPspSigDebDef_C "DDRC/Dauer der Fehlerentprellung für Prüfung DFC_ComPspSig" VALUE 0x800228C6 Val_Wu16 655350.0 DDRCTime_ms 0.00 655350.0 /end CHARACTERISTIC
/begin CHARACTERISTIC DDRC_DurDeb.Rail_tiPCV42DebOk_C "DDRC/Dauer der Heilungsentprellung für Prüfung DFC_RailPCV42" VALUE 0x800228C8 Val_Wu16 655350.0 DDRCTime_ms 0.00 655350.0 /end CHARACTERISTIC
/begin CHARACTERISTIC DDRC_DurDeb.Rail_tiPCV42DebDef_C "DDRC/Dauer der Fehlerentprellung für Prüfung DFC_RailPCV42" VALUE 0x800228CA Val_Wu16 655350.0 DDRCTime_ms 0.00 655350.0 /end CHARACTERISTIC
/begin CHARACTERISTIC DDRC_DurDeb.Com_tiDiaOBDGbxSig_ADebOk_C "DDRC/Dauer der Heilungsentprellung für Prüfung DFC_ComDiaOBDGbxSig_A" VALUE 0x800228CC Val_Wu16 655350.0 DDRCTime_ms 0.00 655350.0 /end CHARACTERISTIC
/begin CHARACTERISTIC DDRC_DurDeb.Com_tiDiaOBDGbxSig_ADebDef_C "DDRC/Dauer der Fehlerentprellung für Prüfung DFC_ComDiaOBDGbxSig_A" VALUE 0x800228CE Val_Wu16 655350.0 DDRCTime_ms 0.00 655350.0 /end CHARACTERISTIC
/begin CHARACTERISTIC DDRC_DurDeb.Com_tiStateARSSigDebOk_C "DDRC/Dauer der Heilungsentprellung für Prüfung DFC_ComStateARSSig" VALUE 0x800228D0 Val_Wu16 655350.0 DDRCTime_ms 0.00 655350.0 /end CHARACTERISTIC
/begin CHARACTERISTIC DDRC_DurDeb.Com_tiStateARSSigDebDef_C "DDRC/Dauer der Fehlerentprellung für Prüfung DFC_ComStateARSSig" VALUE 0x800228D2 Val_Wu16 655350.0 DDRCTime_ms 0.00 655350.0 /end CHARACTERISTIC
/begin CHARACTERISTIC DDRC_DurDeb.Com_tiTerminalCtrDebOk_C "DDRC/Dauer der Heilungsentprellung für Prüfung DFC_ComTerminalCtr" VALUE 0x800228D4 Val_Wu16 655350.0 DDRCTime_ms 0.00 655350.0 /end CHARACTERISTIC
/begin CHARACTERISTIC DDRC_DurDeb.Com_tiTerminalCtrDebDef_C "DDRC/Dauer der Fehlerentprellung für Prüfung DFC_ComTerminalCtr" VALUE 0x800228D6 Val_Wu16 655350.0 DDRCTime_ms 0.00 655350.0 /end CHARACTERISTIC
/begin CHARACTERISTIC DDRC_DurDeb.BusDiag_tiBusOffNodeADebOk_C "DDRC/Dauer der Heilungsentprellung für Prüfung DFC_BusDiagBusOffNodeA" VALUE 0x800228D8 Val_Wu16 655350.0 DDRCTime_ms 0.00 655350.0 /end CHARACTERISTIC
/begin CHARACTERISTIC DDRC_DurDeb.BusDiag_tiBusOffNodeADebDef_C "DDRC/Dauer der Fehlerentprellung für Prüfung DFC_BusDiagBusOffNodeA" VALUE 0x800228DA Val_Wu16 655350.0 DDRCTime_ms 0.00 655350.0 /end CHARACTERISTIC
/begin CHARACTERISTIC DDRC_DurDeb.TrbCh_tiSCGDebOk_C "DDRC/Dauer der Heilungsentprellung für Prüfung DFC_TrbChSCG" VALUE 0x800228DC Val_Wu16 655350.0 DDRCTime_ms 0.00 655350.0 /end CHARACTERISTIC
/begin CHARACTERISTIC DDRC_DurDeb.TrbCh_tiSCGDebDef_C "DDRC/Dauer der Fehlerentprellung für Prüfung DFC_TrbChSCG" VALUE 0x800228DE Val_Wu16 655350.0 DDRCTime_ms 0.00 655350.0 /end CHARACTERISTIC
/begin CHARACTERISTIC DDRC_DurDeb.Com_tiaSideChk_FXDebOk_C "DDRC/Dauer der Heilungsentprellung für Prüfung DFC_ComaSideChk_FX" VALUE 0x800228E0 Val_Wu16 655350.0 DDRCTime_ms 0.00 655350.0 /end CHARACTERISTIC
/begin CHARACTERISTIC DDRC_DurDeb.Com_tiaSideChk_FXDebDef_C "DDRC/Dauer der Fehlerentprellung für Prüfung DFC_ComaSideChk_FX" VALUE 0x800228E2 Val_Wu16 655350.0 DDRCTime_ms 0.00 655350.0 /end CHARACTERISTIC
/begin CHARACTERISTIC DDRC_DurDeb.Com_tiTerminalSigDebOk_C "DDRC/Dauer der Heilungsentprellung für Prüfung DFC_ComTerminalSig" VALUE 0x800228E4 Val_Wu16 655350.0 DDRCTime_ms 0.00 655350.0 /end CHARACTERISTIC
/begin CHARACTERISTIC DDRC_DurDeb.Com_tiTerminalSigDebDef_C "DDRC/Dauer der Fehlerentprellung für Prüfung DFC_ComTerminalSig" VALUE 0x800228E6 Val_Wu16 655350.0 DDRCTime_ms 0.00 655350.0 /end CHARACTERISTIC
/begin CHARACTERISTIC DDRC_DurDeb.Com_tiVelocityChk_FADebOk_C "DDRC/Dauer der Heilungsentprellung für Prüfung DFC_ComVelocityChk_FA" VALUE 0x800228E8 Val_Wu16 655350.0 DDRCTime_ms 0.00 655350.0 /end CHARACTERISTIC
/begin CHARACTERISTIC DDRC_DurDeb.Com_tiVelocityChk_FADebDef_C "DDRC/Dauer der Fehlerentprellung für Prüfung DFC_ComVelocityChk_FA" VALUE 0x800228EA Val_Wu16 655350.0 DDRCTime_ms 0.00 655350.0 /end CHARACTERISTIC
/begin CHARACTERISTIC DDRC_DurDeb.Rail_tiPCV22DebOk_C "DDRC/Dauer der Heilungsentprellung für Prüfung DFC_RailPCV22" VALUE 0x800228EC Val_Wu16 655350.0 DDRCTime_ms 0.00 655350.0 /end CHARACTERISTIC
/begin CHARACTERISTIC DDRC_DurDeb.Rail_tiPCV22DebDef_C "DDRC/Dauer der Fehlerentprellung für Prüfung DFC_RailPCV22" VALUE 0x800228EE Val_Wu16 655350.0 DDRCTime_ms 0.00 655350.0 /end CHARACTERISTIC
/begin CHARACTERISTIC DDRC_DurDeb.GlwEcu_tiGkOLDebOk_C "DDRC/Dauer der Heilungsentprellung für Prüfung DFC_GlwEcuGk6OL" VALUE 0x800228F0 Val_Wu16 655350.0 DDRCTime_ms 0.00 655350.0 /end CHARACTERISTIC
/begin CHARACTERISTIC DDRC_DurDeb.GlwEcu_tiGkOLDebDef_C "DDRC/Dauer der Fehlerentprellung für Prüfung DFC_GlwEcuGk6OL" VALUE 0x800228F2 Val_Wu16 655350.0 DDRCTime_ms 0.00 655350.0 /end CHARACTERISTIC
/begin CHARACTERISTIC DDRC_DurDeb.Com_tiStConintDSCChk_FXDebOk_C "DDRC/Dauer der Heilungsentprellung für Prüfung DFC_ComStConintDSCChk_FX" VALUE 0x800228F4 Val_Wu16 655350.0 DDRCTime_ms 0.00 655350.0 /end CHARACTERISTIC
/begin CHARACTERISTIC DDRC_DurDeb.Com_tiStConintDSCChk_FXDebDef_C "DDRC/Dauer der Fehlerentprellung für Prüfung DFC_ComStConintDSCChk_FX" VALUE 0x800228F6 Val_Wu16 655350.0 DDRCTime_ms 0.00 655350.0 /end CHARACTERISTIC
/begin CHARACTERISTIC DDRC_DurDeb.Rail_tiPMonStrtDebOk_C "DDRC/Dauer der Heilungsentprellung für Prüfung DFC_RailPMonStrt" VALUE 0x800228F8 Val_Wu16 655350.0 DDRCTime_ms 0.00 655350.0 /end CHARACTERISTIC
/begin CHARACTERISTIC DDRC_DurDeb.Rail_tiPMonStrtDebDef_C "DDRC/Dauer der Fehlerentprellung für Prüfung DFC_RailPMonStrt" VALUE 0x800228FA Val_Wu16 655350.0 DDRCTime_ms 0.00 655350.0 /end CHARACTERISTIC
/begin CHARACTERISTIC DDRC_DurDeb.Lub_tiTotDebOk_C "DDRC/Dauer der Heilungsentprellung für Prüfung DFC_LubSRCTot" VALUE 0x800228FC Val_Wu16 655350.0 DDRCTime_ms 0.00 655350.0 /end CHARACTERISTIC
/begin CHARACTERISTIC DDRC_DurDeb.Lub_tiTotDebDef_C "DDRC/Dauer der Fehlerentprellung für Prüfung DFC_LubSRCTot" VALUE 0x800228FE Val_Wu16 655350.0 DDRCTime_ms 0.00 655350.0 /end CHARACTERISTIC
/begin CHARACTERISTIC DDRC_DurDeb.GlwEcu_tiGPCMFaultInfoDebOk_C "DDRC/Dauer der Heilungsentprellung für Prüfung DFC_GlwEcuGPCMFaultInfo" VALUE 0x80022900 Val_Wu16 655350.0 DDRCTime_ms 0.00 655350.0 /end CHARACTERISTIC
/begin CHARACTERISTIC DDRC_DurDeb.GlwEcu_tiGPCMFaultInfoDebDef_C "DDRC/Dauer der Fehlerentprellung für Prüfung DFC_GlwEcuGPCMFaultInfo" VALUE 0x80022902 Val_Wu16 655350.0 DDRCTime_ms 0.00 655350.0 /end CHARACTERISTIC
/begin CHARACTERISTIC DDRC_DurDeb.ThrVlv_ti4WinErr3DebOk_C "DDRC/Dauer der Heilungsentprellung für Prüfung DFC_ThrVlv4WinErr3" VALUE 0x80022904 Val_Wu16 655350.0 DDRCTime_ms 0.00 655350.0 /end CHARACTERISTIC
/begin CHARACTERISTIC DDRC_DurDeb.ThrVlv_ti4WinErr3DebDef_C "DDRC/Dauer der Fehlerentprellung für Prüfung DFC_ThrVlv4WinErr3" VALUE 0x80022906 Val_Wu16 655350.0 DDRCTime_ms 0.00 655350.0 /end CHARACTERISTIC
/begin CHARACTERISTIC DDRC_DurDeb.Com_StatEkpSig_ADebOk_C "DDRC/Dauer der Heilungsentprellung für Prüfung DFC_ComStatEkpSig_A" VALUE 0x80022908 Val_Wu16 655350.0 DDRCTime_ms 0.00 655350.0 /end CHARACTERISTIC
/begin CHARACTERISTIC DDRC_DurDeb.Com_StatEkpSig_ADebDef_C "DDRC/Dauer der Fehlerentprellung für Prüfung DFC_ComStatEkpSig_A" VALUE 0x8002290A Val_Wu16 655350.0 DDRCTime_ms 0.00 655350.0 /end CHARACTERISTIC
/begin CHARACTERISTIC DDRC_DurDeb.Com_tiGbxDataTo_ADebOk_C "DDRC/Dauer der Heilungsentprellung für Prüfung DFC_ComGbxDataTo_A" VALUE 0x8002290C Val_Wu16 655350.0 DDRCTime_ms 0.00 655350.0 /end CHARACTERISTIC
/begin CHARACTERISTIC DDRC_DurDeb.Com_tiGbxDataTo_ADebDef_C "DDRC/Dauer der Fehlerentprellung für Prüfung DFC_ComGbxDataTo_A" VALUE 0x8002290E Val_Wu16 655350.0 DDRCTime_ms 0.00 655350.0 /end CHARACTERISTIC
/begin CHARACTERISTIC DDRC_DurDeb.Com_StatEkpTo_ADebOk_C "DDRC/Dauer der Heilungsentprellung für Prüfung DFC_ComStatEkpTo_A" VALUE 0x80022910 Val_Wu16 655350.0 DDRCTime_ms 0.00 655350.0 /end CHARACTERISTIC
/begin CHARACTERISTIC DDRC_DurDeb.Com_StatEkpTo_ADebDef_C "DDRC/Dauer der Fehlerentprellung für Prüfung DFC_ComStatEkpTo_A" VALUE 0x80022912 Val_Wu16 655350.0 DDRCTime_ms 0.00 655350.0 /end CHARACTERISTIC
/begin CHARACTERISTIC DDRC_DurDeb.Com_tiRelTimeSig_FADebOk_C "DDRC/Dauer der Heilungsentprellung für Prüfung DFC_ComRelTimeSig_FA" VALUE 0x80022914 Val_Wu16 655350.0 DDRCTime_ms 0.00 655350.0 /end CHARACTERISTIC
/begin CHARACTERISTIC DDRC_DurDeb.Com_tiRelTimeSig_FADebDef_C "DDRC/Dauer der Fehlerentprellung für Prüfung DFC_ComRelTimeSig_FA" VALUE 0x80022916 Val_Wu16 655350.0 DDRCTime_ms 0.00 655350.0 /end CHARACTERISTIC
/begin CHARACTERISTIC DDRC_DurDeb.Com_tiLenkradwinkelSigDebOk_C "DDRC/Dauer der Heilungsentprellung für Prüfung DFC_ComLenkradwinkelSig" VALUE 0x80022918 Val_Wu16 655350.0 DDRCTime_ms 0.00 655350.0 /end CHARACTERISTIC
/begin CHARACTERISTIC DDRC_DurDeb.Com_tiLenkradwinkelSigDebDef_C "DDRC/Dauer der Fehlerentprellung für Prüfung DFC_ComLenkradwinkelSig" VALUE 0x8002291A Val_Wu16 655350.0 DDRCTime_ms 0.00 655350.0 /end CHARACTERISTIC
/begin CHARACTERISTIC DDRC_DurDeb.Com_tiSlrdiGlbFZMTo_FXDebOk_C "DDRC/Dauer der Heilungsentprellung für Prüfung DFC_ComSlrdiGlbFZMTo_FX" VALUE 0x8002291C Val_Wu16 655350.0 DDRCTime_ms 0.00 655350.0 /end CHARACTERISTIC
/begin CHARACTERISTIC DDRC_DurDeb.Com_tiSlrdiGlbFZMTo_FXDebDef_C "DDRC/Dauer der Fehlerentprellung für Prüfung DFC_ComSlrdiGlbFZMTo_FX" VALUE 0x8002291E Val_Wu16 655350.0 DDRCTime_ms 0.00 655350.0 /end CHARACTERISTIC
/begin CHARACTERISTIC DDRC_DurDeb.Com_tiCrCtlLvrChkDebOk_C "DDRC/Dauer der Heilungsentprellung für Prüfung DFC_ComCrCtlLvrChk" VALUE 0x80022920 Val_Wu16 655350.0 DDRCTime_ms 0.00 655350.0 /end CHARACTERISTIC
/begin CHARACTERISTIC DDRC_DurDeb.Com_tiCrCtlLvrChkDebDef_C "DDRC/Dauer der Fehlerentprellung für Prüfung DFC_ComCrCtlLvrChk" VALUE 0x80022922 Val_Wu16 655350.0 DDRCTime_ms 0.00 655350.0 /end CHARACTERISTIC
/begin CHARACTERISTIC DDRC_DurDeb.Com_tiStateSeatSig_FADebOk_C "DDRC/Dauer der Heilungsentprellung für Prüfung DFC_ComStateSeatSig_FA" VALUE 0x80022924 Val_Wu16 655350.0 DDRCTime_ms 0.00 655350.0 /end CHARACTERISTIC
/begin CHARACTERISTIC DDRC_DurDeb.Com_tiStateSeatSig_FADebDef_C "DDRC/Dauer der Fehlerentprellung für Prüfung DFC_ComStateSeatSig_FA" VALUE 0x80022926 Val_Wu16 655350.0 DDRCTime_ms 0.00 655350.0 /end CHARACTERISTIC
/begin CHARACTERISTIC DDRC_DurDeb.Rail_tiMeUn1DebOk_C "DDRC/Dauer der Heilungsentprellung für Prüfung DFC_RailMeUn1" VALUE 0x80022928 Val_Wu16 655350.0 DDRCTime_ms 0.00 655350.0 /end CHARACTERISTIC
/begin CHARACTERISTIC DDRC_DurDeb.Rail_tiMeUn1DebDef_C "DDRC/Dauer der Fehlerentprellung für Prüfung DFC_RailMeUn1" VALUE 0x8002292A Val_Wu16 655350.0 DDRCTime_ms 0.00 655350.0 /end CHARACTERISTIC
/begin CHARACTERISTIC DDRC_DurDeb.Fan_ti4WinErr3DebOk_C "DDRC/Dauer der Heilungsentprellung für Prüfung DFC_Fan4WinErr3" VALUE 0x8002292C Val_Wu16 655350.0 DDRCTime_ms 0.00 655350.0 /end CHARACTERISTIC
/begin CHARACTERISTIC DDRC_DurDeb.Fan_ti4WinErr3DebDef_C "DDRC/Dauer der Fehlerentprellung für Prüfung DFC_Fan4WinErr3" VALUE 0x8002292E Val_Wu16 655350.0 DDRCTime_ms 0.00 655350.0 /end CHARACTERISTIC
/begin CHARACTERISTIC DDRC_DurDeb.Com_tiShutOffPSPToDebOk_C "DDRC/Dauer der Heilungsentprellung für Prüfung DFC_ComShutOffPSPTo" VALUE 0x80022930 Val_Wu16 655350.0 DDRCTime_ms 0.00 655350.0 /end CHARACTERISTIC
/begin CHARACTERISTIC DDRC_DurDeb.Com_tiShutOffPSPToDebDef_C "DDRC/Dauer der Fehlerentprellung für Prüfung DFC_ComShutOffPSPTo" VALUE 0x80022932 Val_Wu16 655350.0 DDRCTime_ms 0.00 655350.0 /end CHARACTERISTIC
/begin CHARACTERISTIC DDRC_DurDeb.Com_tiFahrzeugtypSig_FADebOk_C "DDRC/Dauer der Heilungsentprellung für Prüfung DFC_ComFahrzeugtypSig_FA" VALUE 0x80022934 Val_Wu16 655350.0 DDRCTime_ms 0.00 655350.0 /end CHARACTERISTIC
/begin CHARACTERISTIC DDRC_DurDeb.Com_tiFahrzeugtypSig_FADebDef_C "DDRC/Dauer der Fehlerentprellung für Prüfung DFC_ComFahrzeugtypSig_FA" VALUE 0x80022936 Val_Wu16 655350.0 DDRCTime_ms 0.00 655350.0 /end CHARACTERISTIC
/begin CHARACTERISTIC DDRC_DurDeb.Com_tiVelocityTo_FADebOk_C "DDRC/Dauer der Heilungsentprellung für Prüfung DFC_ComVelocityTo_FA" VALUE 0x80022938 Val_Wu16 655350.0 DDRCTime_ms 0.00 655350.0 /end CHARACTERISTIC
/begin CHARACTERISTIC DDRC_DurDeb.Com_tiVelocityTo_FADebDef_C "DDRC/Dauer der Fehlerentprellung für Prüfung DFC_ComVelocityTo_FA" VALUE 0x8002293A Val_Wu16 655350.0 DDRCTime_ms 0.00 655350.0 /end CHARACTERISTIC
/begin CHARACTERISTIC DDRC_DurDeb.Rail_tiPCV3DebOk_C "DDRC/Dauer der Heilungsentprellung für Prüfung DFC_RailPCV3" VALUE 0x8002293C Val_Wu16 655350.0 DDRCTime_ms 0.00 655350.0 /end CHARACTERISTIC
/begin CHARACTERISTIC DDRC_DurDeb.Rail_tiPCV3DebDef_C "DDRC/Dauer der Fehlerentprellung für Prüfung DFC_RailPCV3" VALUE 0x8002293E Val_Wu16 655350.0 DDRCTime_ms 0.00 655350.0 /end CHARACTERISTIC
/begin CHARACTERISTIC DDRC_DurDeb.IBS_tiComErrDebOk_C "DDRC/Dauer der Heilungsentprellung für Prüfung DFC_IBSComErr" VALUE 0x80022940 Val_Wu16 655350.0 DDRCTime_ms 0.00 655350.0 /end CHARACTERISTIC
/begin CHARACTERISTIC DDRC_DurDeb.IBS_tiComErrDebDef_C "DDRC/Dauer der Fehlerentprellung für Prüfung DFC_IBSComErr" VALUE 0x80022942 Val_Wu16 655350.0 DDRCTime_ms 0.00 655350.0 /end CHARACTERISTIC
/begin CHARACTERISTIC DDRC_DurDeb.GlwEcu_tiT30ErrDebOk_C "DDRC/Dauer der Heilungsentprellung für Prüfung DFC_GlwEcuT30Err" VALUE 0x80022944 Val_Wu16 655350.0 DDRCTime_ms 0.00 655350.0 /end CHARACTERISTIC
/begin CHARACTERISTIC DDRC_DurDeb.GlwEcu_tiT30ErrDebDef_C "DDRC/Dauer der Fehlerentprellung für Prüfung DFC_GlwEcuT30Err" VALUE 0x80022946 Val_Wu16 655350.0 DDRCTime_ms 0.00 655350.0 /end CHARACTERISTIC
/begin CHARACTERISTIC DDRC_DurDeb.Com_tiFllupGpwsupSig_FADebOk_C "DDRC/Dauer der Heilungsentprellung für Prüfung DFC_ComFllupGpwsupSig_FA" VALUE 0x80022948 Val_Wu16 655350.0 DDRCTime_ms 0.00 655350.0 /end CHARACTERISTIC
/begin CHARACTERISTIC DDRC_DurDeb.Com_tiFllupGpwsupSig_FADebDef_C "DDRC/Dauer der Fehlerentprellung für Prüfung DFC_ComFllupGpwsupSig_FA" VALUE 0x8002294A Val_Wu16 655350.0 DDRCTime_ms 0.00 655350.0 /end CHARACTERISTIC
/begin CHARACTERISTIC DDRC_DurDeb.PFlt_tiPFltmSotDiffMINDebOk_C "DDRC/Dauer der Heilungsentprellung für Prüfung DFC_PFltmSotDiffMIN" VALUE 0x8002294C Val_Wu16 655350.0 DDRCTime_ms 0.00 655350.0 /end CHARACTERISTIC
/begin CHARACTERISTIC DDRC_DurDeb.PFlt_tiPFltmSotDiffMINDebDef_C "DDRC/Dauer der Fehlerentprellung für Prüfung DFC_PFltmSotDiffMIN" VALUE 0x8002294E Val_Wu16 655350.0 DDRCTime_ms 0.00 655350.0 /end CHARACTERISTIC
/begin CHARACTERISTIC DDRC_DurDeb.WaHtEl_tiSCGDebOk_C "DDRC/Dauer der Heilungsentprellung für Prüfung DFC_WaHtElSCG" VALUE 0x80022950 Val_Wu16 655350.0 DDRCTime_ms 0.00 655350.0 /end CHARACTERISTIC
/begin CHARACTERISTIC DDRC_DurDeb.WaHtEl_tiSCGDebDef_C "DDRC/Dauer der Fehlerentprellung für Prüfung DFC_WaHtElSCG" VALUE 0x80022952 Val_Wu16 655350.0 DDRCTime_ms 0.00 655350.0 /end CHARACTERISTIC
/begin CHARACTERISTIC DDRC_DurDeb.Com_tiRequestEMFChkDebOk_C "DDRC/Dauer der Heilungsentprellung für Prüfung DFC_ComRequestEMFChk" VALUE 0x80022954 Val_Wu16 655350.0 DDRCTime_ms 0.00 655350.0 /end CHARACTERISTIC
/begin CHARACTERISTIC DDRC_DurDeb.Com_tiRequestEMFChkDebDef_C "DDRC/Dauer der Fehlerentprellung für Prüfung DFC_ComRequestEMFChk" VALUE 0x80022956 Val_Wu16 655350.0 DDRCTime_ms 0.00 655350.0 /end CHARACTERISTIC
/begin CHARACTERISTIC DDRC_DurDeb.ETCtl_tiDvtInrMinDebOk_C "DDRC/Dauer der Heilungsentprellung für Prüfung DFC_ETCtlDvtInrMin" VALUE 0x80022958 Val_Wu16 655350.0 DDRCTime_ms 0.00 655350.0 /end CHARACTERISTIC
/begin CHARACTERISTIC DDRC_DurDeb.ETCtl_tiDvtInrMinDebDef_C "DDRC/Dauer der Fehlerentprellung für Prüfung DFC_ETCtlDvtInrMin" VALUE 0x8002295A Val_Wu16 655350.0 DDRCTime_ms 0.00 655350.0 /end CHARACTERISTIC
/begin CHARACTERISTIC DDRC_DurDeb.Rail_tiPCV2DebOk_C "DDRC/Dauer der Heilungsentprellung für Prüfung DFC_RailPCV2" VALUE 0x8002295C Val_Wu16 655350.0 DDRCTime_ms 0.00 655350.0 /end CHARACTERISTIC
/begin CHARACTERISTIC DDRC_DurDeb.Rail_tiPCV2DebDef_C "DDRC/Dauer der Fehlerentprellung für Prüfung DFC_RailPCV2" VALUE 0x8002295E Val_Wu16 655350.0 DDRCTime_ms 0.00 655350.0 /end CHARACTERISTIC
/begin CHARACTERISTIC DDRC_DurDeb.Com_tiSpeedVehicleTo_FXDebOk_C "DDRC/Dauer der Heilungsentprellung für Prüfung DFC_ComSpeedVehicleTo_FX" VALUE 0x80022960 Val_Wu16 655350.0 DDRCTime_ms 0.00 655350.0 /end CHARACTERISTIC
/begin CHARACTERISTIC DDRC_DurDeb.Com_tiSpeedVehicleTo_FXDebDef_C "DDRC/Dauer der Fehlerentprellung für Prüfung DFC_ComSpeedVehicleTo_FX" VALUE 0x80022962 Val_Wu16 655350.0 DDRCTime_ms 0.00 655350.0 /end CHARACTERISTIC
/begin CHARACTERISTIC DDRC_DurDeb.Com_tiKlemmenCtr_FADebOk_C "DDRC/Dauer der Heilungsentprellung für Prüfung DFC_ComKlemmenCtr_FA" VALUE 0x80022964 Val_Wu16 655350.0 DDRCTime_ms 0.00 655350.0 /end CHARACTERISTIC
/begin CHARACTERISTIC DDRC_DurDeb.Com_tiKlemmenCtr_FADebDef_C "DDRC/Dauer der Fehlerentprellung für Prüfung DFC_ComKlemmenCtr_FA" VALUE 0x80022966 Val_Wu16 655350.0 DDRCTime_ms 0.00 655350.0 /end CHARACTERISTIC
/begin CHARACTERISTIC DDRC_DurDeb.Com_tiTrailerToDebOk_C "DDRC/Dauer der Heilungsentprellung für Prüfung DFC_ComTrailerTo" VALUE 0x80022968 Val_Wu16 655350.0 DDRCTime_ms 0.00 655350.0 /end CHARACTERISTIC
/begin CHARACTERISTIC DDRC_DurDeb.Com_tiTrailerToDebDef_C "DDRC/Dauer der Fehlerentprellung für Prüfung DFC_ComTrailerTo" VALUE 0x8002296A Val_Wu16 655350.0 DDRCTime_ms 0.00 655350.0 /end CHARACTERISTIC
/begin CHARACTERISTIC DDRC_DurDeb.Com_tiSensNOxUbattSigDebOk_C "DDRC/Dauer der Heilungsentprellung für Prüfung DFC_ComSensNOxUbattSig" VALUE 0x8002296C Val_Wu16 655350.0 DDRCTime_ms 0.00 655350.0 /end CHARACTERISTIC
/begin CHARACTERISTIC DDRC_DurDeb.Com_tiSensNOxUbattSigDebDef_C "DDRC/Dauer der Fehlerentprellung für Prüfung DFC_ComSensNOxUbattSig" VALUE 0x8002296E Val_Wu16 655350.0 DDRCTime_ms 0.00 655350.0 /end CHARACTERISTIC
/begin CHARACTERISTIC DDRC_DurDeb.Com_tiBrkTrqSumCtr_FXDebOk_C "DDRC/Dauer der Heilungsentprellung für Prüfung DFC_ComBrkTrqSumCtr_FX" VALUE 0x80022970 Val_Wu16 655350.0 DDRCTime_ms 0.00 655350.0 /end CHARACTERISTIC
/begin CHARACTERISTIC DDRC_DurDeb.Com_tiBrkTrqSumCtr_FXDebDef_C "DDRC/Dauer der Fehlerentprellung für Prüfung DFC_ComBrkTrqSumCtr_FX" VALUE 0x80022972 Val_Wu16 655350.0 DDRCTime_ms 0.00 655350.0 /end CHARACTERISTIC
/begin CHARACTERISTIC DDRC_DurDeb.Com_tiZvKlappenSigDebOk_C "DDRC/Dauer der Heilungsentprellung für Prüfung DFC_ComZvKlappenSig" VALUE 0x80022974 Val_Wu16 655350.0 DDRCTime_ms 0.00 655350.0 /end CHARACTERISTIC
/begin CHARACTERISTIC DDRC_DurDeb.Com_tiZvKlappenSigDebDef_C "DDRC/Dauer der Fehlerentprellung für Prüfung DFC_ComZvKlappenSig" VALUE 0x80022976 Val_Wu16 655350.0 DDRCTime_ms 0.00 655350.0 /end CHARACTERISTIC
/begin CHARACTERISTIC DDRC_DurDeb.Com_tiSecCtrRelTo_FADebOk_C "DDRC/Dauer der Heilungsentprellung für Prüfung DFC_ComSecCtrRelTo_FA" VALUE 0x80022978 Val_Wu16 655350.0 DDRCTime_ms 0.00 655350.0 /end CHARACTERISTIC
/begin CHARACTERISTIC DDRC_DurDeb.Com_tiSecCtrRelTo_FADebDef_C "DDRC/Dauer der Fehlerentprellung für Prüfung DFC_ComSecCtrRelTo_FA" VALUE 0x8002297A Val_Wu16 655350.0 DDRCTime_ms 0.00 655350.0 /end CHARACTERISTIC
/begin CHARACTERISTIC DDRC_DurDeb.Com_tiTrqDemandDesSigDebOk_C "DDRC/Dauer der Heilungsentprellung für Prüfung DFC_ComTrqDemandDesSig" VALUE 0x8002297C Val_Wu16 655350.0 DDRCTime_ms 0.00 655350.0 /end CHARACTERISTIC
/begin CHARACTERISTIC DDRC_DurDeb.Com_tiTrqDemandDesSigDebDef_C "DDRC/Dauer der Fehlerentprellung für Prüfung DFC_ComTrqDemandDesSig" VALUE 0x8002297E Val_Wu16 655350.0 DDRCTime_ms 0.00 655350.0 /end CHARACTERISTIC
/begin CHARACTERISTIC DDRC_DurDeb.Com_tiCtrCrshSwoEkpSig_FADebOk_C "DDRC/Dauer der Heilungsentprellung für Prüfung DFC_ComCtrCrshSwoEkpSig_FA" VALUE 0x80022980 Val_Wu16 655350.0 DDRCTime_ms 0.00 655350.0 /end CHARACTERISTIC
/begin CHARACTERISTIC DDRC_DurDeb.Com_tiCtrCrshSwoEkpSig_FADebDef_C "DDRC/Dauer der Fehlerentprellung für Prüfung DFC_ComCtrCrshSwoEkpSig_FA" VALUE 0x80022982 Val_Wu16 655350.0 DDRCTime_ms 0.00 655350.0 /end CHARACTERISTIC
/begin CHARACTERISTIC DDRC_DurDeb.Com_tiaSideTo_FXDebOk_C "DDRC/Dauer der Heilungsentprellung für Prüfung DFC_ComaSideTo_FX" VALUE 0x80022984 Val_Wu16 655350.0 DDRCTime_ms 0.00 655350.0 /end CHARACTERISTIC
/begin CHARACTERISTIC DDRC_DurDeb.Com_tiaSideTo_FXDebDef_C "DDRC/Dauer der Fehlerentprellung für Prüfung DFC_ComaSideTo_FX" VALUE 0x80022986 Val_Wu16 655350.0 DDRCTime_ms 0.00 655350.0 /end CHARACTERISTIC
/begin CHARACTERISTIC DDRC_DurDeb.PCR_tiGovDvtMinDebOk_C "DDRC/Dauer der Heilungsentprellung für Prüfung DFC_PCRGovDvtMin" VALUE 0x80022988 Val_Wu16 655350.0 DDRCTime_ms 0.00 655350.0 /end CHARACTERISTIC
/begin CHARACTERISTIC DDRC_DurDeb.PCR_tiGovDvtMinDebDef_C "DDRC/Dauer der Fehlerentprellung für Prüfung DFC_PCRGovDvtMin" VALUE 0x8002298A Val_Wu16 655350.0 DDRCTime_ms 0.00 655350.0 /end CHARACTERISTIC
/begin CHARACTERISTIC DDRC_DurDeb.Com_tiLenkradwinkelToDebOk_C "DDRC/Dauer der Heilungsentprellung für Prüfung DFC_ComLenkradwinkelTo" VALUE 0x8002298C Val_Wu16 655350.0 DDRCTime_ms 0.00 655350.0 /end CHARACTERISTIC
/begin CHARACTERISTIC DDRC_DurDeb.Com_tiLenkradwinkelToDebDef_C "DDRC/Dauer der Fehlerentprellung für Prüfung DFC_ComLenkradwinkelTo" VALUE 0x8002298E Val_Wu16 655350.0 DDRCTime_ms 0.00 655350.0 /end CHARACTERISTIC
/begin CHARACTERISTIC DDRC_DurDeb.Com_tiGbxDataChk_ADebOk_C "DDRC/Dauer der Heilungsentprellung für Prüfung DFC_ComGbxDataChk_A" VALUE 0x80022990 Val_Wu16 655350.0 DDRCTime_ms 0.00 655350.0 /end CHARACTERISTIC
/begin CHARACTERISTIC DDRC_DurDeb.Com_tiGbxDataChk_ADebDef_C "DDRC/Dauer der Fehlerentprellung für Prüfung DFC_ComGbxDataChk_A" VALUE 0x80022992 Val_Wu16 655350.0 DDRCTime_ms 0.00 655350.0 /end CHARACTERISTIC
/begin CHARACTERISTIC DDRC_DurDeb.Com_tiStatGearRevTo_FADebOk_C "DDRC/Dauer der Heilungsentprellung für Prüfung DFC_ComStatGearRevTo_FA" VALUE 0x80022994 Val_Wu16 655350.0 DDRCTime_ms 0.00 655350.0 /end CHARACTERISTIC
/begin CHARACTERISTIC DDRC_DurDeb.Com_tiStatGearRevTo_FADebDef_C "DDRC/Dauer der Fehlerentprellung für Prüfung DFC_ComStatGearRevTo_FA" VALUE 0x80022996 Val_Wu16 655350.0 DDRCTime_ms 0.00 655350.0 /end CHARACTERISTIC
/begin CHARACTERISTIC DDRC_DurDeb.Com_tiStatusEGSSig_FADebOk_C "DDRC/Dauer der Heilungsentprellung für Prüfung DFC_ComStatusEGSSig_FA" VALUE 0x80022998 Val_Wu16 655350.0 DDRCTime_ms 0.00 655350.0 /end CHARACTERISTIC
/begin CHARACTERISTIC DDRC_DurDeb.Com_tiStatusEGSSig_FADebDef_C "DDRC/Dauer der Fehlerentprellung für Prüfung DFC_ComStatusEGSSig_FA" VALUE 0x8002299A Val_Wu16 655350.0 DDRCTime_ms 0.00 655350.0 /end CHARACTERISTIC
/begin CHARACTERISTIC DDRC_DurDeb.PFlt_tiPFltAPSPlausMINDebOk_C "DDRC/Dauer der Heilungsentprellung für Prüfung DFC_PFltAPSPlausMIN" VALUE 0x8002299C Val_Wu16 655350.0 DDRCTime_ms 0.00 655350.0 /end CHARACTERISTIC
/begin CHARACTERISTIC DDRC_DurDeb.PFlt_tiPFltAPSPlausMINDebDef_C "DDRC/Dauer der Fehlerentprellung für Prüfung DFC_PFltAPSPlausMIN" VALUE 0x8002299E Val_Wu16 655350.0 DDRCTime_ms 0.00 655350.0 /end CHARACTERISTIC
/begin CHARACTERISTIC DDRC_DurDeb.Com_tiaDirectChk_FXDebOk_C "DDRC/Dauer der Heilungsentprellung für Prüfung DFC_ComaDirectChk_FX" VALUE 0x800229A0 Val_Wu16 655350.0 DDRCTime_ms 0.00 655350.0 /end CHARACTERISTIC
/begin CHARACTERISTIC DDRC_DurDeb.Com_tiaDirectChk_FXDebDef_C "DDRC/Dauer der Fehlerentprellung für Prüfung DFC_ComaDirectChk_FX" VALUE 0x800229A2 Val_Wu16 655350.0 DDRCTime_ms 0.00 655350.0 /end CHARACTERISTIC
/begin CHARACTERISTIC DDRC_DurDeb.BusDiag_tiBusOffFlexRayDebOk_C "DDRC/" VALUE 0x800229A4 Val_Wu16 655350.0 DDRCTime_ms 0.00 655350.0 /end CHARACTERISTIC
/begin CHARACTERISTIC DDRC_DurDeb.BusDiag_tiBusOffFlexRayDebDef_C "DDRC/" VALUE 0x800229A6 Val_Wu16 655350.0 DDRCTime_ms 0.00 655350.0 /end CHARACTERISTIC
/begin CHARACTERISTIC DDRC_DurDeb.Com_tiTimeDateSig_FADebOk_C "DDRC/Dauer der Heilungsentprellung für Prüfung DFC_ComTimeDateSig_FA" VALUE 0x800229A8 Val_Wu16 655350.0 DDRCTime_ms 0.00 655350.0 /end CHARACTERISTIC
/begin CHARACTERISTIC DDRC_DurDeb.Com_tiTimeDateSig_FADebDef_C "DDRC/Dauer der Fehlerentprellung für Prüfung DFC_ComTimeDateSig_FA" VALUE 0x800229AA Val_Wu16 655350.0 DDRCTime_ms 0.00 655350.0 /end CHARACTERISTIC
/begin CHARACTERISTIC DDRC_DurDeb.Com_tiStateSeatToDebOk_C "DDRC/Dauer der Heilungsentprellung für Prüfung DFC_ComStateSeatTo" VALUE 0x800229AC Val_Wu16 655350.0 DDRCTime_ms 0.00 655350.0 /end CHARACTERISTIC
/begin CHARACTERISTIC DDRC_DurDeb.Com_tiStateSeatToDebDef_C "DDRC/Dauer der Fehlerentprellung für Prüfung DFC_ComStateSeatTo" VALUE 0x800229AE Val_Wu16 655350.0 DDRCTime_ms 0.00 655350.0 /end CHARACTERISTIC
/begin CHARACTERISTIC DDRC_DurDeb.Com_tiaDirectCtr_FXDebOk_C "DDRC/Dauer der Heilungsentprellung für Prüfung DFC_ComaDirectCtr_FX" VALUE 0x800229B0 Val_Wu16 655350.0 DDRCTime_ms 0.00 655350.0 /end CHARACTERISTIC
/begin CHARACTERISTIC DDRC_DurDeb.Com_tiaDirectCtr_FXDebDef_C "DDRC/Dauer der Fehlerentprellung für Prüfung DFC_ComaDirectCtr_FX" VALUE 0x800229B2 Val_Wu16 655350.0 DDRCTime_ms 0.00 655350.0 /end CHARACTERISTIC
/begin CHARACTERISTIC DDRC_DurDeb.PFlt_tiPFltmSotDiffMAXDebOk_C "DDRC/Dauer der Heilungsentprellung für Prüfung DFC_PFltmSotDiffMAX" VALUE 0x800229B4 Val_Wu16 655350.0 DDRCTime_ms 0.00 655350.0 /end CHARACTERISTIC
/begin CHARACTERISTIC DDRC_DurDeb.PFlt_tiPFltmSotDiffMAXDebDef_C "DDRC/Dauer der Fehlerentprellung für Prüfung DFC_PFltmSotDiffMAX" VALUE 0x800229B6 Val_Wu16 655350.0 DDRCTime_ms 0.00 655350.0 /end CHARACTERISTIC
/begin CHARACTERISTIC DDRC_DurDeb.FBC_tiDvtMaxDebOk_C "DDRC/Dauer der Heilungsentprellung für Prüfung DFC_FBCqDvtMax" VALUE 0x800229B8 Val_Wu16 655350.0 DDRCTime_ms 0.00 655350.0 /end CHARACTERISTIC
/begin CHARACTERISTIC DDRC_DurDeb.FBC_tiDvtMaxDebDef_C "DDRC/Dauer der Fehlerentprellung für Prüfung DFC_FBCqDvtMax" VALUE 0x800229BA Val_Wu16 655350.0 DDRCTime_ms 0.00 655350.0 /end CHARACTERISTIC
/begin CHARACTERISTIC DDRC_DurDeb.GlwEcu_tiFrmErrDebOk_C "DDRC/Dauer der Heilungsentprellung für Prüfung DFC_GlwEcuFrmErr" VALUE 0x800229BC Val_Wu16 655350.0 DDRCTime_ms 0.00 655350.0 /end CHARACTERISTIC
/begin CHARACTERISTIC DDRC_DurDeb.GlwEcu_tiFrmErrDebDef_C "DDRC/Dauer der Fehlerentprellung für Prüfung DFC_GlwEcuFrmErr" VALUE 0x800229BE Val_Wu16 655350.0 DDRCTime_ms 0.00 655350.0 /end CHARACTERISTIC
/begin CHARACTERISTIC DDRC_DurDeb.Com_tiGbxDataChk_FADebOk_C "DDRC/Dauer der Heilungsentprellung für Prüfung DFC_ComGbxDataChk_FA" VALUE 0x800229C0 Val_Wu16 655350.0 DDRCTime_ms 0.00 655350.0 /end CHARACTERISTIC
/begin CHARACTERISTIC DDRC_DurDeb.Com_tiGbxDataChk_FADebDef_C "DDRC/Dauer der Fehlerentprellung für Prüfung DFC_ComGbxDataChk_FA" VALUE 0x800229C2 Val_Wu16 655350.0 DDRCTime_ms 0.00 655350.0 /end CHARACTERISTIC
/begin CHARACTERISTIC DDRC_DurDeb.Com_tiSpeedVehicleCtr_FXDebOk_C "DDRC/Dauer der Heilungsentprellung für Prüfung DFC_ComSpeedVehicleCtr_FX" VALUE 0x800229C4 Val_Wu16 655350.0 DDRCTime_ms 0.00 655350.0 /end CHARACTERISTIC
/begin CHARACTERISTIC DDRC_DurDeb.Com_tiSpeedVehicleCtr_FXDebDef_C "DDRC/Dauer der Fehlerentprellung für Prüfung DFC_ComSpeedVehicleCtr_FX" VALUE 0x800229C6 Val_Wu16 655350.0 DDRCTime_ms 0.00 655350.0 /end CHARACTERISTIC
/begin CHARACTERISTIC DDRC_DurDeb.GlwEcu_tiUdiffT30DebOk_C "DDRC/Dauer der Heilungsentprellung für Prüfung DFC_GlwEcuUdiffT30" VALUE 0x800229C8 Val_Wu16 655350.0 DDRCTime_ms 0.00 655350.0 /end CHARACTERISTIC
/begin CHARACTERISTIC DDRC_DurDeb.GlwEcu_tiUdiffT30DebDef_C "DDRC/Dauer der Fehlerentprellung für Prüfung DFC_GlwEcuUdiffT30" VALUE 0x800229CA Val_Wu16 655350.0 DDRCTime_ms 0.00 655350.0 /end CHARACTERISTIC
/begin CHARACTERISTIC DDRC_DurDeb.Com_tiSensNOxGndSigDebOk_C "DDRC/Dauer der Heilungsentprellung für Prüfung DFC_ComSensNOxGndSig" VALUE 0x800229CC Val_Wu16 655350.0 DDRCTime_ms 0.00 655350.0 /end CHARACTERISTIC
/begin CHARACTERISTIC DDRC_DurDeb.Com_tiSensNOxGndSigDebDef_C "DDRC/Dauer der Fehlerentprellung für Prüfung DFC_ComSensNOxGndSig" VALUE 0x800229CE Val_Wu16 655350.0 DDRCTime_ms 0.00 655350.0 /end CHARACTERISTIC
/begin CHARACTERISTIC DDRC_DurDeb.Com_tiATempTo_FADebOk_C "DDRC/Dauer der Heilungsentprellung für Prüfung DFC_ComATempTo_FA" VALUE 0x800229D0 Val_Wu16 655350.0 DDRCTime_ms 0.00 655350.0 /end CHARACTERISTIC
/begin CHARACTERISTIC DDRC_DurDeb.Com_tiATempTo_FADebDef_C "DDRC/Dauer der Fehlerentprellung für Prüfung DFC_ComATempTo_FA" VALUE 0x800229D2 Val_Wu16 655350.0 DDRCTime_ms 0.00 655350.0 /end CHARACTERISTIC
/begin CHARACTERISTIC DDRC_DurDeb.Rail_tiMeUn4DebOk_C "DDRC/Dauer der Heilungsentprellung für Prüfung DFC_RailMeUn4" VALUE 0x800229D4 Val_Wu16 655350.0 DDRCTime_ms 0.00 655350.0 /end CHARACTERISTIC
/begin CHARACTERISTIC DDRC_DurDeb.Rail_tiMeUn4DebDef_C "DDRC/Dauer der Fehlerentprellung für Prüfung DFC_RailMeUn4" VALUE 0x800229D6 Val_Wu16 655350.0 DDRCTime_ms 0.00 655350.0 /end CHARACTERISTIC
/begin CHARACTERISTIC DDRC_DurDeb.Com_tiGbxDataSig_FADebOk_C "DDRC/Dauer der Heilungsentprellung für Prüfung DFC_ComGbxDataSig_FA" VALUE 0x800229D8 Val_Wu16 655350.0 DDRCTime_ms 0.00 655350.0 /end CHARACTERISTIC
/begin CHARACTERISTIC DDRC_DurDeb.Com_tiGbxDataSig_FADebDef_C "DDRC/Dauer der Fehlerentprellung für Prüfung DFC_ComGbxDataSig_FA" VALUE 0x800229DA Val_Wu16 655350.0 DDRCTime_ms 0.00 655350.0 /end CHARACTERISTIC
/begin CHARACTERISTIC DDRC_DurDeb.Com_tiSensNOxGndToDebOk_C "DDRC/Dauer der Heilungsentprellung für Prüfung DFC_ComSensNOxGndTo" VALUE 0x800229DC Val_Wu16 655350.0 DDRCTime_ms 0.00 655350.0 /end CHARACTERISTIC
/begin CHARACTERISTIC DDRC_DurDeb.Com_tiSensNOxGndToDebDef_C "DDRC/Dauer der Fehlerentprellung für Prüfung DFC_ComSensNOxGndTo" VALUE 0x800229DE Val_Wu16 655350.0 DDRCTime_ms 0.00 655350.0 /end CHARACTERISTIC
/begin CHARACTERISTIC DDRC_DurDeb.BusDiag_tiBusOffNodeCDebOk_C "DDRC/Dauer der Heilungsentprellung für Prüfung DFC_BusDiagBusOffNodeC" VALUE 0x800229E0 Val_Wu16 655350.0 DDRCTime_ms 0.00 655350.0 /end CHARACTERISTIC
/begin CHARACTERISTIC DDRC_DurDeb.BusDiag_tiBusOffNodeCDebDef_C "DDRC/Dauer der Fehlerentprellung für Prüfung DFC_BusDiagBusOffNodeC" VALUE 0x800229E2 Val_Wu16 655350.0 DDRCTime_ms 0.00 655350.0 /end CHARACTERISTIC
/begin CHARACTERISTIC DDRC_DurDeb.AirCtl_tiGovDvtEOMMaxDebOk_C "DDRC/Dauer der Heilungsentprellung für Prüfung DFC_AirCtlGovDvtEOMMax" VALUE 0x800229E4 Val_Wu16 655350.0 DDRCTime_ms 0.00 655350.0 /end CHARACTERISTIC
/begin CHARACTERISTIC DDRC_DurDeb.AirCtl_tiGovDvtEOMMaxDebDef_C "DDRC/Dauer der Fehlerentprellung für Prüfung DFC_AirCtlGovDvtEOMMax" VALUE 0x800229E6 Val_Wu16 655350.0 DDRCTime_ms 0.00 655350.0 /end CHARACTERISTIC
/begin CHARACTERISTIC DDRC_DurDeb.Com_tiTrqDemandDscCtrDebOk_C "DDRC/Dauer der Heilungsentprellung für Prüfung DFC_ComTrqDemandDscCtr" VALUE 0x800229E8 Val_Wu16 655350.0 DDRCTime_ms 0.00 655350.0 /end CHARACTERISTIC
/begin CHARACTERISTIC DDRC_DurDeb.Com_tiTrqDemandDscCtrDebDef_C "DDRC/Dauer der Fehlerentprellung für Prüfung DFC_ComTrqDemandDscCtr" VALUE 0x800229EA Val_Wu16 655350.0 DDRCTime_ms 0.00 655350.0 /end CHARACTERISTIC
/begin CHARACTERISTIC DDRC_DurDeb.Com_tiTrqDemandDscToDebOk_C "DDRC/Dauer der Heilungsentprellung für Prüfung DFC_ComTrqDemandDscTo" VALUE 0x800229EC Val_Wu16 655350.0 DDRCTime_ms 0.00 655350.0 /end CHARACTERISTIC
/begin CHARACTERISTIC DDRC_DurDeb.Com_tiTrqDemandDscToDebDef_C "DDRC/Dauer der Fehlerentprellung für Prüfung DFC_ComTrqDemandDscTo" VALUE 0x800229EE Val_Wu16 655350.0 DDRCTime_ms 0.00 655350.0 /end CHARACTERISTIC
/begin CHARACTERISTIC DDRC_DurDeb.PCR_tiGovDvtLPMaxDebOk_C "DDRC/Dauer der Heilungsentprellung für Prüfung DFC_PCRGovDvtLPMax" VALUE 0x800229F0 Val_Wu16 655350.0 DDRCTime_ms 0.00 655350.0 /end CHARACTERISTIC
/begin CHARACTERISTIC DDRC_DurDeb.PCR_tiGovDvtLPMaxDebDef_C "DDRC/Dauer der Fehlerentprellung für Prüfung DFC_PCRGovDvtLPMax" VALUE 0x800229F2 Val_Wu16 655350.0 DDRCTime_ms 0.00 655350.0 /end CHARACTERISTIC
/begin CHARACTERISTIC DDRC_DurDeb.PFlt_tiOxiPreMaxDebOk_C "DDRC/Dauer der Heilungsentprellung für Prüfung DFC_PFlt_tOxiPreMax" VALUE 0x800229F4 Val_Wu16 655350.0 DDRCTime_ms 0.00 655350.0 /end CHARACTERISTIC
/begin CHARACTERISTIC DDRC_DurDeb.PFlt_tiOxiPreMaxDebDef_C "DDRC/Dauer der Fehlerentprellung für Prüfung DFC_PFlt_tOxiPreMax" VALUE 0x800229F6 Val_Wu16 655350.0 DDRCTime_ms 0.00 655350.0 /end CHARACTERISTIC
/begin CHARACTERISTIC DDRC_DurDeb.PCBS_tiLThresDebOk_C "DDRC/Dauer der Heilungsentprellung für Prüfung DFC_PCBS" VALUE 0x800229F8 Val_Wu16 655350.0 DDRCTime_ms 0.00 655350.0 /end CHARACTERISTIC
/begin CHARACTERISTIC DDRC_DurDeb.PCBS_tiLThresDebDef_C "DDRC/Dauer der Fehlerentprellung für Prüfung DFC_PCBS" VALUE 0x800229FA Val_Wu16 655350.0 DDRCTime_ms 0.00 655350.0 /end CHARACTERISTIC
/begin CHARACTERISTIC DDRC_DurDeb.TrbCh_tiSRCMaxDebOk_C "DDRC/Dauer der Heilungsentprellung für Prüfung DFC_TrbChSRCMax" VALUE 0x800229FC Val_Wu16 655350.0 DDRCTime_ms 0.00 655350.0 /end CHARACTERISTIC
/begin CHARACTERISTIC DDRC_DurDeb.TrbCh_tiSRCMaxDebDef_C "DDRC/Dauer der Fehlerentprellung für Prüfung DFC_TrbChSRCMax" VALUE 0x800229FE Val_Wu16 655350.0 DDRCTime_ms 0.00 655350.0 /end CHARACTERISTIC
/begin CHARACTERISTIC DDRC_DurDeb.Com_tiBrkTrqSumChk_FXDebOk_C "DDRC/Dauer der Heilungsentprellung für Prüfung DFC_ComBrkTrqSumChk_FX" VALUE 0x80022A00 Val_Wu16 655350.0 DDRCTime_ms 0.00 655350.0 /end CHARACTERISTIC
/begin CHARACTERISTIC DDRC_DurDeb.Com_tiBrkTrqSumChk_FXDebDef_C "DDRC/Dauer der Fehlerentprellung für Prüfung DFC_ComBrkTrqSumChk_FX" VALUE 0x80022A02 Val_Wu16 655350.0 DDRCTime_ms 0.00 655350.0 /end CHARACTERISTIC
/begin CHARACTERISTIC DDRC_DurDeb.PFlt_tiPFltBPSPlausMINDebOk_C "DDRC/Dauer der Heilungsentprellung für Prüfung DFC_PFltBPSPlausMIN" VALUE 0x80022A04 Val_Wu16 655350.0 DDRCTime_ms 0.00 655350.0 /end CHARACTERISTIC
/begin CHARACTERISTIC DDRC_DurDeb.PFlt_tiPFltBPSPlausMINDebDef_C "DDRC/Dauer der Fehlerentprellung für Prüfung DFC_PFltBPSPlausMIN" VALUE 0x80022A06 Val_Wu16 655350.0 DDRCTime_ms 0.00 655350.0 /end CHARACTERISTIC
/begin CHARACTERISTIC DDRC_DurDeb.Com_tiDiaOBDGbxTo_ADebOk_C "DDRC/Dauer der Heilungsentprellung für Prüfung DFC_ComDiaOBDGbxTo_A" VALUE 0x80022A08 Val_Wu16 655350.0 DDRCTime_ms 0.00 655350.0 /end CHARACTERISTIC
/begin CHARACTERISTIC DDRC_DurDeb.Com_tiDiaOBDGbxTo_ADebDef_C "DDRC/Dauer der Fehlerentprellung für Prüfung DFC_ComDiaOBDGbxTo_A" VALUE 0x80022A0A Val_Wu16 655350.0 DDRCTime_ms 0.00 655350.0 /end CHARACTERISTIC
/begin CHARACTERISTIC DDRC_DurDeb.Rail_tiMeUn0DebOk_C "DDRC/Dauer der Heilungsentprellung für Prüfung DFC_RailMeUn0" VALUE 0x80022A0C Val_Wu16 655350.0 DDRCTime_ms 0.00 655350.0 /end CHARACTERISTIC
/begin CHARACTERISTIC DDRC_DurDeb.Rail_tiMeUn0DebDef_C "DDRC/Dauer der Fehlerentprellung für Prüfung DFC_RailMeUn0" VALUE 0x80022A0E Val_Wu16 655350.0 DDRCTime_ms 0.00 655350.0 /end CHARACTERISTIC
/begin CHARACTERISTIC DDRC_DurDeb.GlwEcu_tiGndErrDebOk_C "DDRC/Dauer der Heilungsentprellung für Prüfung DFC_GlwEcuGndErr" VALUE 0x80022A10 Val_Wu16 655350.0 DDRCTime_ms 0.00 655350.0 /end CHARACTERISTIC
/begin CHARACTERISTIC DDRC_DurDeb.GlwEcu_tiGndErrDebDef_C "DDRC/Dauer der Fehlerentprellung für Prüfung DFC_GlwEcuGndErr" VALUE 0x80022A12 Val_Wu16 655350.0 DDRCTime_ms 0.00 655350.0 /end CHARACTERISTIC
/begin CHARACTERISTIC DDRC_DurDeb.BusDiag_tiHwFlexRayDebOk_C "DDRC/" VALUE 0x80022A14 Val_Wu16 655350.0 DDRCTime_ms 0.00 655350.0 /end CHARACTERISTIC
/begin CHARACTERISTIC DDRC_DurDeb.BusDiag_tiHwFlexRayDebDef_C "DDRC/" VALUE 0x80022A16 Val_Wu16 655350.0 DDRCTime_ms 0.00 655350.0 /end CHARACTERISTIC
/begin FUNCTION DDRC ""
 /begin DEF_CHARACTERISTIC DDRC_DurDeb.WaHtEl_tiOLDebDef_C DDRC_DurDeb.MeUn_tiOLDebOk_C DDRC_DurDeb.MeUn_tiOLDebDef_C DDRC_DurDeb.LSU_tiHtrNplDebOk_C DDRC_DurDeb.LSU_tiHtrNplDebDef_C DDRC_DurDeb.Strt_tiOLDebOk_C DDRC_DurDeb.Strt_tiOLDebDef_C DDRC_DurDeb.PCV_tiSRCMinDebOk_C DDRC_DurDeb.PCV_tiSRCMinDebDef_C DDRC_DurDeb.AirC_tiCmprOvrTempDebOk_C DDRC_DurDeb.AirC_tiCmprOvrTempDebDef_C DDRC_DurDeb.UPmpMot_tiOvrTempDebOk_C DDRC_DurDeb.UPmpMot_tiOvrTempDebDef_C DDRC_DurDeb.LSU_tiHtrMaxDebOk_C DDRC_DurDeb.LSU_tiHtrMaxDebDef_C DDRC_DurDeb.EngStA_tiSCGDebOk_C DDRC_DurDeb.EngStA_tiSCGDebDef_C DDRC_DurDeb.EngStA_tiSCBDebOk_C DDRC_DurDeb.EngStA_tiSCBDebDef_C DDRC_DurDeb.Shtr_tiSCGDebOk_C DDRC_DurDeb.Shtr_tiSCGDebDef_C DDRC_DurDeb.EMDmp_tiOvrTempDebOk_C DDRC_DurDeb.EMDmp_tiOvrTempDebDef_C DDRC_DurDeb.MeUn_tiSCBDebOk_C DDRC_DurDeb.MeUn_tiSCBDebDef_C DDRC_DurDeb.Strt_tiSCGDebOk_C DDRC_DurDeb.Strt_tiSCGDebDef_C DDRC_DurDeb.EngStA_tiOLDebOk_C DDRC_DurDeb.EngStA_tiOLDebDef_C DDRC_DurDeb.CByVlv_tiOvrTempDebOk_C DDRC_DurDeb.CByVlv_tiOvrTempDebDef_C DDRC_DurDeb.LSU_titExcMaxDebOk_C DDRC_DurDeb.LSU_titExcMaxDebDef_C DDRC_DurDeb.Shtr_tiOLDebOk_C DDRC_DurDeb.Shtr_tiOLDebDef_C DDRC_DurDeb.Shtr_tiSCBDebOk_C DDRC_DurDeb.Shtr_tiSCBDebDef_C DDRC_DurDeb.ECBVlv_tiSCGDebOk_C DDRC_DurDeb.ECBVlv_tiSCGDebDef_C DDRC_DurDeb.FlFltHt_tiSCGDebOk_C DDRC_DurDeb.FlFltHt_tiSCGDebDef_C DDRC_DurDeb.UDosVlv_tiSCBDebOk_C DDRC_DurDeb.UDosVlv_tiSCBDebDef_C DDRC_DurDeb.AFS_SSpShOff_tiOvrTempDebOk_C DDRC_DurDeb.AFS_SSpShOff_tiOvrTempDebDef_C DDRC_DurDeb.MeUn_tiSRCMinDebOk_C DDRC_DurDeb.MeUn_tiSRCMinDebDef_C DDRC_DurDeb.FlFltHt_tiOLDebOk_C DDRC_DurDeb.FlFltHt_tiOLDebDef_C DDRC_DurDeb.Fan_tiOvrTempDebOk_C DDRC_DurDeb.Fan_tiOvrTempDebDef_C DDRC_DurDeb.MeUn_tiSRCMaxDebOk_C DDRC_DurDeb.MeUn_tiSRCMaxDebDef_C DDRC_DurDeb.CThmst_tiSCGDebOk_C DDRC_DurDeb.CThmst_tiSCGDebDef_C DDRC_DurDeb.PCV_tiSRCMaxDebOk_C DDRC_DurDeb.PCV_tiSRCMaxDebDef_C DDRC_DurDeb.PCV_tiSCBDebOk_C DDRC_DurDeb.PCV_tiSCBDebDef_C DDRC_DurDeb.EMDmp_tiSCGDebOk_C DDRC_DurDeb.EMDmp_tiSCGDebDef_C DDRC_DurDeb.AFS_SSpShOff_tiOLDebOk_C DDRC_DurDeb.AFS_SSpShOff_tiOLDebDef_C DDRC_DurDeb.AFS_SSpShOff_tiSCBDebOk_C DDRC_DurDeb.AFS_SSpShOff_tiSCBDebDef_C DDRC_DurDeb.AFS_SSpShOff_tiSCGDebOk_C DDRC_DurDeb.AFS_SSpShOff_tiSCGDebDef_C DDRC_DurDeb.EMDmp_tiOLDebOk_C DDRC_DurDeb.EMDmp_tiOLDebDef_C DDRC_DurDeb.CByVlv_tiSCBDebOk_C DDRC_DurDeb.CByVlv_tiSCBDebDef_C DDRC_DurDeb.AirC_tiCmprSCGDebOk_C DDRC_DurDeb.AirC_tiCmprSCGDebDef_C DDRC_DurDeb.TrbCh_tiSCBDebOk_C DDRC_DurDeb.TrbCh_tiSCBDebDef_C DDRC_DurDeb.RailP_tiSRCMaxDebOk_C DDRC_DurDeb.RailP_tiSRCMaxDebDef_C DDRC_DurDeb.SCRMon_numDFCPresRdcDebOk_C DDRC_DurDeb.SCRMon_numDFCPresRdcDebDef_C DDRC_DurDeb.IVActr_numVltgSRCMaxDebOk_C DDRC_DurDeb.IVActr_numVltgSRCMaxDebDef_C DDRC_DurDeb.IVActr_numUChSRCMinDebOk_C DDRC_DurDeb.IVActr_numUChSRCMinDebDef_C DDRC_DurDeb.SCRMon_numDFCMetCtlDebOk_C DDRC_DurDeb.SCRMon_numDFCMetCtlDebDef_C DDRC_DurDeb.IVPSply_numDCDCDebOk_C DDRC_DurDeb.IVPSply_numDCDCDebDef_C DDRC_DurDeb.SCRMon_numDFCPresBuildUpDebOk_C DDRC_DurDeb.SCRMon_numDFCPresBuildUpDebDef_C DDRC_DurDeb.SCRChk_numEtaErrDebOk_C DDRC_DurDeb.SCRChk_numEtaErrDebDef_C DDRC_DurDeb.IVPSply_numVltgSRCMaxDebOk_C DDRC_DurDeb.IVPSply_numVltgSRCMaxDebDef_C DDRC_DurDeb.SCRChk_numEtaErr1DebOk_C DDRC_DurDeb.SCRChk_numEtaErr1DebDef_C DDRC_DurDeb.IVDia_numTunDetDebOk_C DDRC_DurDeb.IVDia_numTunDetDebDef_C DDRC_DurDeb.SCRChk_numEtaErr2DebOk_C DDRC_DurDeb.SCRChk_numEtaErr2DebDef_C DDRC_DurDeb.IVActr_numVltgSRCMinDebOk_C DDRC_DurDeb.IVActr_numVltgSRCMinDebDef_C DDRC_DurDeb.IVActr_numUChSRCMaxDebOk_C DDRC_DurDeb.IVActr_numUChSRCMaxDebDef_C DDRC_DurDeb.IVPSply_numVltgSRCMinDebOk_C DDRC_DurDeb.IVPSply_numVltgSRCMinDebDef_C DDRC_DurDeb.Exh_tiPlausExhTMon1DebOk_C DDRC_DurDeb.Exh_tiPlausExhTMon1DebDef_C DDRC_DurDeb.Exh_tiMaxNSCDsDebOk_C DDRC_DurDeb.Exh_tiMaxNSCDsDebDef_C DDRC_DurDeb.Air_tiDtyCycLoTAFSDebOk_C DDRC_DurDeb.Air_tiDtyCycLoTAFSDebDef_C DDRC_DurDeb.ECBVlv_tiSRCMaxDebOk_C DDRC_DurDeb.ECBVlv_tiSRCMaxDebDef_C DDRC_DurDeb.Exh_tiLamPlausMinNoCat2DsDebOk_C DDRC_DurDeb.Exh_tiLamPlausMinNoCat2DsDebDef_C DDRC_DurDeb.VSwVlv_tiHBrgShCirGnd1DebOk_C DDRC_DurDeb.VSwVlv_tiHBrgShCirGnd1DebDef_C DDRC_DurDeb.EGRVlv_tiSCGDebOk_C DDRC_DurDeb.EGRVlv_tiSCGDebDef_C DDRC_DurDeb.FlFltDsP_tiMinDebOk_C DDRC_DurDeb.FlFltDsP_tiMinDebDef_C DDRC_DurDeb.InjVlv_tiPresMinDebOk_C DDRC_DurDeb.InjVlv_tiPresMinDebDef_C DDRC_DurDeb.Exh_tiLamPlausMaxNSCDsDebOk_C DDRC_DurDeb.Exh_tiLamPlausMaxNSCDsDebDef_C DDRC_DurDeb.Exh_tiNplDynPPFltDiffDebOk_C DDRC_DurDeb.Exh_tiNplDynPPFltDiffDebDef_C DDRC_DurDeb.TECU_tiSRCMaxDebOk_C DDRC_DurDeb.TECU_tiSRCMaxDebDef_C DDRC_DurDeb.AFS_tiCorSRCMaxDebOk_C DDRC_DurDeb.AFS_tiCorSRCMaxDebDef_C DDRC_DurDeb.Exh_tiExhTMon3PlausDebOk_C DDRC_DurDeb.Exh_tiExhTMon3PlausDebDef_C DDRC_DurDeb.Exh_tiLamPlausMinNSCDsDebOk_C DDRC_DurDeb.Exh_tiLamPlausMinNSCDsDebDef_C DDRC_DurDeb.EGRVlvLP_tiHBrgShCirOvrLdDebOk_C DDRC_DurDeb.EGRVlvLP_tiHBrgShCirOvrLdDebDef_C DDRC_DurDeb.CrCUI_tiDetDebOk_C DDRC_DurDeb.CrCUI_tiDetDebDef_C DDRC_DurDeb.CEngDsT_tiMaxDebOk_C DDRC_DurDeb.CEngDsT_tiMaxDebDef_C DDRC_DurDeb.MeUn_tiSCGDebOk_C DDRC_DurDeb.MeUn_tiSCGDebDef_C DDRC_DurDeb.FlFltUsP_tiMinDebOk_C DDRC_DurDeb.FlFltUsP_tiMinDebDef_C DDRC_DurDeb.EGRVlv_tiHBrgShCirOvrLdDebOk_C DDRC_DurDeb.EGRVlv_tiHBrgShCirOvrLdDebDef_C DDRC_DurDeb.UHtrTnk_tiSCGDebOk_C DDRC_DurDeb.UHtrTnk_tiSCGDebDef_C DDRC_DurDeb.Exh_tiSRCLamLinNSCDsDebOk_C DDRC_DurDeb.Exh_tiSRCLamLinNSCDsDebDef_C DDRC_DurDeb.EngPrt_tiOvrSpdDebOk_C DDRC_DurDeb.EngPrt_tiOvrSpdDebDef_C DDRC_DurDeb.SCR_tiSRCMinUTnkTDebOk_C DDRC_DurDeb.SCR_tiSRCMinUTnkTDebDef_C DDRC_DurDeb.UHtrPL_tiSRCMinDiaDebOk_C DDRC_DurDeb.UHtrPL_tiSRCMinDiaDebDef_C DDRC_DurDeb.FlFlt_tiSigDebOk_C DDRC_DurDeb.FlFlt_tiSigDebDef_C DDRC_DurDeb.FuelT_tiMaxDebOk_C DDRC_DurDeb.FuelT_tiMaxDebDef_C DDRC_DurDeb.SCR_tiSRCMinUCatUsTDebOk_C DDRC_DurDeb.SCR_tiSRCMinUCatUsTDebDef_C DDRC_DurDeb.Exh_tiCmpChkNoCat2DsDebOk_C DDRC_DurDeb.Exh_tiCmpChkNoCat2DsDebDef_C DDRC_DurDeb.BrkP_tiMinDebOk_C DDRC_DurDeb.BrkP_tiMinDebDef_C DDRC_DurDeb.T15_tiNplDebOk_C DDRC_DurDeb.T15_tiNplDebDef_C DDRC_DurDeb.EGRVlv_tiHBrgTempOvrCurrDebOk_C DDRC_DurDeb.EGRVlv_tiHBrgTempOvrCurrDebDef_C DDRC_DurDeb.UHtrTnk_tiSCBDebOk_C DDRC_DurDeb.UHtrTnk_tiSCBDebDef_C DDRC_DurDeb.Exh_tiSRCNOxNoCat2DsDebOk_C DDRC_DurDeb.Exh_tiSRCNOxNoCat2DsDebDef_C DDRC_DurDeb.PFlt_tiDstrMinDebOk_C DDRC_DurDeb.PFlt_tiDstrMinDebDef_C DDRC_DurDeb.AFS_tiOffsDrftMaxDebOk_C DDRC_DurDeb.AFS_tiOffsDrftMaxDebDef_C DDRC_DurDeb.PFlt_tiSRCMinFlwRstnDebOk_C DDRC_DurDeb.PFlt_tiSRCMinFlwRstnDebDef_C DDRC_DurDeb.Exh_tiSRCMinTTrbnUsDebOk_C DDRC_DurDeb.Exh_tiSRCMinTTrbnUsDebDef_C DDRC_DurDeb.EGRVlvLP_tiSCGDebOk_C DDRC_DurDeb.EGRVlvLP_tiSCGDebDef_C DDRC_DurDeb.AirC_tiSwtNplDebOk_C DDRC_DurDeb.AirC_tiSwtNplDebDef_C DDRC_DurDeb.EGRVlv_tiHBrgShCirBatt1DebOk_C DDRC_DurDeb.EGRVlv_tiHBrgShCirBatt1DebDef_C DDRC_DurDeb.SCR_tiSRCMaxUPmpPDebOk_C DDRC_DurDeb.SCR_tiSRCMaxUPmpPDebDef_C DDRC_DurDeb.URevVlv_tiSCBDebOk_C DDRC_DurDeb.URevVlv_tiSCBDebDef_C DDRC_DurDeb.Exh_tiSigNSCDsDebOk_C DDRC_DurDeb.Exh_tiSigNSCDsDebDef_C DDRC_DurDeb.EGRVlvLP_tiHBrgUndrVltgDebOk_C DDRC_DurDeb.EGRVlvLP_tiHBrgUndrVltgDebDef_C DDRC_DurDeb.PFlt_tiEngPrtMaxDebOk_C DDRC_DurDeb.PFlt_tiEngPrtMaxDebDef_C DDRC_DurDeb.Exh_tiSigNoCat2DsDebOk_C DDRC_DurDeb.Exh_tiSigNoCat2DsDebDef_C DDRC_DurDeb.FlFltUsP_tiMaxDebOk_C DDRC_DurDeb.FlFltUsP_tiMaxDebDef_C DDRC_DurDeb.VSwVlv_tiHBrgShCirOvrLdDebOk_C DDRC_DurDeb.VSwVlv_tiHBrgShCirOvrLdDebDef_C DDRC_DurDeb.SCR_tiSRCMaxUTnkTDebOk_C DDRC_DurDeb.SCR_tiSRCMaxUTnkTDebDef_C DDRC_DurDeb.GbxNPos_tiSRCPerMinDebOk_C DDRC_DurDeb.GbxNPos_tiSRCPerMinDebDef_C DDRC_DurDeb.EGRVlvLP_tiGovDvtMaxDebOk_C DDRC_DurDeb.EGRVlvLP_tiGovDvtMaxDebDef_C DDRC_DurDeb.Exh_tiSRCLamBinNoCat2DsDebOk_C DDRC_DurDeb.Exh_tiSRCLamBinNoCat2DsDebDef_C DDRC_DurDeb.AFS_tiRawSRCMaxDebOk_C DDRC_DurDeb.AFS_tiRawSRCMaxDebDef_C DDRC_DurDeb.UHtrPL_tiSCGDebOk_C DDRC_DurDeb.UHtrPL_tiSCGDebDef_C DDRC_DurDeb.UHtrPL_tiSCBDebOk_C DDRC_DurDeb.UHtrPL_tiSCBDebDef_C DDRC_DurDeb.VSwVlv_tiHBrgShCirGnd2DebOk_C DDRC_DurDeb.VSwVlv_tiHBrgShCirGnd2DebDef_C DDRC_DurDeb.URevVlv_tiSCGDebOk_C DDRC_DurDeb.URevVlv_tiSCGDebDef_C DDRC_DurDeb.Exh_tiSRCNOxNSCDsDebOk_C DDRC_DurDeb.Exh_tiSRCNOxNSCDsDebDef_C DDRC_DurDeb.BattU_tiMaxDebOk_C DDRC_DurDeb.BattU_tiMaxDebDef_C DDRC_DurDeb.Air_tiMinTCACDsDebOk_C DDRC_DurDeb.Air_tiMinTCACDsDebDef_C DDRC_DurDeb.EGRVlv_tiSCBDebOk_C DDRC_DurDeb.EGRVlv_tiSCBDebDef_C DDRC_DurDeb.FuelT_tiMinDebOk_C DDRC_DurDeb.FuelT_tiMinDebDef_C DDRC_DurDeb.Oil_tiSRCMaxPSwmpDebOk_C DDRC_DurDeb.Oil_tiSRCMaxPSwmpDebDef_C DDRC_DurDeb.EGRVlv_tiHBrgShCirGnd2DebOk_C DDRC_DurDeb.EGRVlv_tiHBrgShCirGnd2DebDef_C DDRC_DurDeb.Exh_tiNplTTrbnUsDebOk_C DDRC_DurDeb.Exh_tiNplTTrbnUsDebDef_C DDRC_DurDeb.EGRVlvLP_tiHBrgShCirBatt2DebOk_C DDRC_DurDeb.EGRVlvLP_tiHBrgShCirBatt2DebDef_C DDRC_DurDeb.Air_tiMaxTCACDsDebOk_C DDRC_DurDeb.Air_tiMaxTCACDsDebDef_C DDRC_DurDeb.TrbChLP_tiSCGDebOk_C DDRC_DurDeb.TrbChLP_tiSCGDebDef_C DDRC_DurDeb.LSU_tiO2MaxDebOk_C DDRC_DurDeb.LSU_tiO2MaxDebDef_C DDRC_DurDeb.Exh_tiNplTPFltUsDebOk_C DDRC_DurDeb.Exh_tiNplTPFltUsDebDef_C DDRC_DurDeb.LSU_tiOpnLdDebOk_C DDRC_DurDeb.LSU_tiOpnLdDebDef_C DDRC_DurDeb.EGRVlvLP_tiSRCMinDebOk_C DDRC_DurDeb.EGRVlvLP_tiSRCMinDebDef_C DDRC_DurDeb.TECU_tiOvrTempDebOk_C DDRC_DurDeb.TECU_tiOvrTempDebDef_C DDRC_DurDeb.AFS_tiSetyDrftMinDebOk_C DDRC_DurDeb.AFS_tiSetyDrftMinDebDef_C DDRC_DurDeb.VSwVlv_tiGovDvtMinDebOk_C DDRC_DurDeb.VSwVlv_tiGovDvtMinDebDef_C DDRC_DurDeb.CEngDsT_tiMinDebOk_C DDRC_DurDeb.CEngDsT_tiMinDebDef_C DDRC_DurDeb.SCR_tiSRCMinUPmpPDebOk_C DDRC_DurDeb.SCR_tiSRCMinUPmpPDebDef_C DDRC_DurDeb.EGRVlvLP_tiHBrgOvrCurrDebOk_C DDRC_DurDeb.EGRVlvLP_tiHBrgOvrCurrDebDef_C DDRC_DurDeb.ThrVlv_tiSRCMaxDebOk_C DDRC_DurDeb.ThrVlv_tiSRCMaxDebDef_C DDRC_DurDeb.EnvP_tiMinDebOk_C DDRC_DurDeb.EnvP_tiMinDebDef_C DDRC_DurDeb.LSU_tiShCirDebOk_C DDRC_DurDeb.LSU_tiShCirDebDef_C DDRC_DurDeb.EGRVlv_tiHBrgShCirBatt2DebOk_C DDRC_DurDeb.EGRVlv_tiHBrgShCirBatt2DebDef_C DDRC_DurDeb.AFS_tiSetyDrftMaxDebOk_C DDRC_DurDeb.AFS_tiSetyDrftMaxDebDef_C DDRC_DurDeb.VSwVlv_tiHBrgOvrTempDebOk_C DDRC_DurDeb.VSwVlv_tiHBrgOvrTempDebDef_C DDRC_DurDeb.Exh_tiSRCMaxTPFltUsDebOk_C DDRC_DurDeb.Exh_tiSRCMaxTPFltUsDebDef_C DDRC_DurDeb.EGRVlvLP_tiSRCMaxDebOk_C DDRC_DurDeb.EGRVlvLP_tiSRCMaxDebDef_C DDRC_DurDeb.EGRVlv_tiHBrgOvrCurrDebOk_C DDRC_DurDeb.EGRVlv_tiHBrgOvrCurrDebDef_C DDRC_DurDeb.EGRVlv_tiOLDebOk_C DDRC_DurDeb.EGRVlv_tiOLDebDef_C DDRC_DurDeb.AFS_tiOffsDrftMinDebOk_C DDRC_DurDeb.AFS_tiOffsDrftMinDebDef_C DDRC_DurDeb.UHtrTnk_tiSRCMaxDiaDebOk_C DDRC_DurDeb.UHtrTnk_tiSRCMaxDiaDebDef_C DDRC_DurDeb.PFlt_tiCharPDiffMinDebOk_C DDRC_DurDeb.PFlt_tiCharPDiffMinDebDef_C DDRC_DurDeb.Exh_tiHsLnPPFltDiffDebOk_C DDRC_DurDeb.Exh_tiHsLnPPFltDiffDebDef_C DDRC_DurDeb.Exh_tiExhTMon1PlausDebOk_C DDRC_DurDeb.Exh_tiExhTMon1PlausDebDef_C DDRC_DurDeb.TrbChLP_tiOLDebOk_C DDRC_DurDeb.TrbChLP_tiOLDebDef_C DDRC_DurDeb.UHtrTnk_tiOLDebOk_C DDRC_DurDeb.UHtrTnk_tiOLDebDef_C DDRC_DurDeb.Exh_tiSRCMinTPFltUsDebOk_C DDRC_DurDeb.Exh_tiSRCMinTPFltUsDebDef_C DDRC_DurDeb.EGRVlv_tiGovDvtMinDebOk_C DDRC_DurDeb.EGRVlv_tiGovDvtMinDebDef_C DDRC_DurDeb.LSU_tiSPIBattLowMinDebOk_C DDRC_DurDeb.LSU_tiSPIBattLowMinDebDef_C DDRC_DurDeb.VSwVlv_tiHBrgOpnLdDebOk_C DDRC_DurDeb.VSwVlv_tiHBrgOpnLdDebDef_C DDRC_DurDeb.VSwVlv_tiOLDebOk_C DDRC_DurDeb.VSwVlv_tiOLDebDef_C DDRC_DurDeb.Exh_tiSRCMaxTTrbnUsDebOk_C DDRC_DurDeb.Exh_tiSRCMaxTTrbnUsDebDef_C DDRC_DurDeb.UHtrPL_tiSRCMaxDiaDebOk_C DDRC_DurDeb.UHtrPL_tiSRCMaxDiaDebDef_C DDRC_DurDeb.EGRVlvLP_tiOLDebOk_C DDRC_DurDeb.EGRVlvLP_tiOLDebDef_C DDRC_DurDeb.Air_tiSRCMinPIntkVUsDebOk_C DDRC_DurDeb.Air_tiSRCMinPIntkVUsDebDef_C DDRC_DurDeb.EGRVlvLP_tiHBrgShCirGnd1DebOk_C DDRC_DurDeb.EGRVlvLP_tiHBrgShCirGnd1DebDef_C DDRC_DurDeb.TECU_tiSRCMinDebOk_C DDRC_DurDeb.TECU_tiSRCMinDebDef_C DDRC_DurDeb.PFlt_tiSotMsMaxDebOk_C DDRC_DurDeb.PFlt_tiSotMsMaxDebDef_C DDRC_DurDeb.VSwVlv_tiHBrgUndrVltgDebOk_C DDRC_DurDeb.VSwVlv_tiHBrgUndrVltgDebDef_C DDRC_DurDeb.Exh_tiSRCMaxPPFltUsDebOk_C DDRC_DurDeb.Exh_tiSRCMaxPPFltUsDebDef_C DDRC_DurDeb.Exh_tiEMaxPPFltDiffDebOk_C DDRC_DurDeb.Exh_tiEMaxPPFltDiffDebDef_C DDRC_DurDeb.EngSpd_tiSCGDebOk_C DDRC_DurDeb.EngSpd_tiSCGDebDef_C DDRC_DurDeb.APP_PlaAPP12DebOk_C DDRC_DurDeb.APP_PlaAPP12DebDef_C DDRC_DurDeb.APP_tiSRCLowDebOk_C DDRC_DurDeb.APP_tiSRCLowDebDef_C DDRC_DurDeb.EGRVlv_tiSRCMaxDebOk_C DDRC_DurDeb.EGRVlv_tiSRCMaxDebDef_C DDRC_DurDeb.EGRVlv_tiHBrgOpnLdDebOk_C DDRC_DurDeb.EGRVlv_tiHBrgOpnLdDebDef_C DDRC_DurDeb.VSwVlv_tiSRCMinDebOk_C DDRC_DurDeb.VSwVlv_tiSRCMinDebDef_C DDRC_DurDeb.Exh_tiEMinPPFltDiffDebOk_C DDRC_DurDeb.Exh_tiEMinPPFltDiffDebDef_C DDRC_DurDeb.SCR_tiSigUPmpPDebOk_C DDRC_DurDeb.SCR_tiSigUPmpPDebDef_C DDRC_DurDeb.Air_tiPerHiTAFSDebOk_C DDRC_DurDeb.Air_tiPerHiTAFSDebDef_C DDRC_DurDeb.EGRVlvLP_tiHBrgTempOvrCurrDebOk_C DDRC_DurDeb.EGRVlvLP_tiHBrgTempOvrCurrDebDef_C DDRC_DurDeb.APP_tiSRCHighDebOk_C DDRC_DurDeb.APP_tiSRCHighDebDef_C DDRC_DurDeb.Air_tiSRCMaxPIntkVUsDebOk_C DDRC_DurDeb.Air_tiSRCMaxPIntkVUsDebDef_C DDRC_DurDeb.Exh_tiSRCMinPPFltUsDebOk_C DDRC_DurDeb.Exh_tiSRCMinPPFltUsDebDef_C DDRC_DurDeb.Exh_tiPlausExhTMonDebOk_C DDRC_DurDeb.Exh_tiPlausExhTMonDebDef_C DDRC_DurDeb.Exh_tiLamPlausMaxNoCat2DsDebOk_C DDRC_DurDeb.Exh_tiLamPlausMaxNoCat2DsDebDef_C DDRC_DurDeb.PFlt_tiNplHsChngPPFltDiffDebOk_C DDRC_DurDeb.PFlt_tiNplHsChngPPFltDiffDebDef_C DDRC_DurDeb.EGRVlvLP_tiGovDvtMinDebOk_C DDRC_DurDeb.EGRVlvLP_tiGovDvtMinDebDef_C DDRC_DurDeb.PFlt_tiSRCMaxFlwRstnDebOk_C DDRC_DurDeb.PFlt_tiSRCMaxFlwRstnDebDef_C DDRC_DurDeb.PFlt_tiRgnPermMaxDebOk_C DDRC_DurDeb.PFlt_tiRgnPermMaxDebDef_C DDRC_DurDeb.SCR_tiSigUCatUsTDebOk_C DDRC_DurDeb.SCR_tiSigUCatUsTDebDef_C DDRC_DurDeb.Exh_tiMaxExhTMonDebOk_C DDRC_DurDeb.Exh_tiMaxExhTMonDebDef_C DDRC_DurDeb.URevVlv_tiOLDebOk_C DDRC_DurDeb.URevVlv_tiOLDebDef_C DDRC_DurDeb.GbxNPos_tiSRCPerMaxDebOk_C DDRC_DurDeb.GbxNPos_tiSRCPerMaxDebDef_C DDRC_DurDeb.LSU_tiCircPmpCurSigDebOk_C DDRC_DurDeb.LSU_tiCircPmpCurSigDebDef_C DDRC_DurDeb.VSwVlv_tiSRCMaxDebOk_C DDRC_DurDeb.VSwVlv_tiSRCMaxDebDef_C DDRC_DurDeb.Exh_tiSRCLamBinNSCDsDebOk_C DDRC_DurDeb.Exh_tiSRCLamBinNSCDsDebDef_C DDRC_DurDeb.VSwVlv_tiSCBDebOk_C DDRC_DurDeb.VSwVlv_tiSCBDebDef_C DDRC_DurDeb.EGRVlvLP_tiSCBDebOk_C DDRC_DurDeb.EGRVlvLP_tiSCBDebDef_C DDRC_DurDeb.EngSpd_tiSCBDebOk_C DDRC_DurDeb.EngSpd_tiSCBDebDef_C DDRC_DurDeb.Exh_tiMinExhTMonDebOk_C DDRC_DurDeb.Exh_tiMinExhTMonDebDef_C DDRC_DurDeb.EGRVlvLP_tiHBrgShCirGnd2DebOk_C DDRC_DurDeb.EGRVlvLP_tiHBrgShCirGnd2DebDef_C DDRC_DurDeb.BattU_tiMinDebOk_C DDRC_DurDeb.BattU_tiMinDebDef_C DDRC_DurDeb.VSwVlv_tiSCGDebOk_C DDRC_DurDeb.VSwVlv_tiSCGDebDef_C DDRC_DurDeb.PCV_tiSCGDebOk_C DDRC_DurDeb.PCV_tiSCGDebDef_C DDRC_DurDeb.Exh_tiSRCMaxPPFltDiffDebOk_C DDRC_DurDeb.Exh_tiSRCMaxPPFltDiffDebDef_C DDRC_DurDeb.Exh_tiPlausExhTMon3DebOk_C DDRC_DurDeb.Exh_tiPlausExhTMon3DebDef_C DDRC_DurDeb.EnvP_tiMaxDebOk_C DDRC_DurDeb.EnvP_tiMaxDebDef_C DDRC_DurDeb.Air_tiDtyCycHiTAFSDebOk_C DDRC_DurDeb.Air_tiDtyCycHiTAFSDebDef_C DDRC_DurDeb.EGRVlvLP_tiHBrgShCirBatt1DebOk_C DDRC_DurDeb.EGRVlvLP_tiHBrgShCirBatt1DebDef_C DDRC_DurDeb.Exh_tiExhTMon2PlausDebOk_C DDRC_DurDeb.Exh_tiExhTMon2PlausDebDef_C DDRC_DurDeb.Exh_tiSRCLamLinNoCat2DsDebOk_C DDRC_DurDeb.Exh_tiSRCLamLinNoCat2DsDebDef_C DDRC_DurDeb.Exh_tiSRCMinTOxiCatUsDebOk_C DDRC_DurDeb.Exh_tiSRCMinTOxiCatUsDebDef_C DDRC_DurDeb.EGRVlvLP_tiHBrgOvrTempDebOk_C DDRC_DurDeb.EGRVlvLP_tiHBrgOvrTempDebDef_C DDRC_DurDeb.UHtrTnk_tiSRCMinDiaDebOk_C DDRC_DurDeb.UHtrTnk_tiSRCMinDiaDebDef_C DDRC_DurDeb.UHtrPL_tiOLDebOk_C DDRC_DurDeb.UHtrPL_tiOLDebDef_C DDRC_DurDeb.EGRVlv_tiHBrgUndrVltgDebOk_C DDRC_DurDeb.EGRVlv_tiHBrgUndrVltgDebDef_C DDRC_DurDeb.PFlt_tiSotMsDvtMaxDebOk_C DDRC_DurDeb.PFlt_tiSotMsDvtMaxDebDef_C DDRC_DurDeb.Exh_tiSRCMaxTOxiCatUsDebOk_C DDRC_DurDeb.Exh_tiSRCMaxTOxiCatUsDebDef_C DDRC_DurDeb.VSwVlv_tiGovDvtMaxDebOk_C DDRC_DurDeb.VSwVlv_tiGovDvtMaxDebDef_C DDRC_DurDeb.FlFltDsP_tiMaxDebOk_C DDRC_DurDeb.FlFltDsP_tiMaxDebDef_C DDRC_DurDeb.Brk_tiPlaDebOk_C DDRC_DurDeb.Brk_tiPlaDebDef_C DDRC_DurDeb.GbxNPos_tiSRCdcycMinDebOk_C DDRC_DurDeb.GbxNPos_tiSRCdcycMinDebDef_C DDRC_DurDeb.Oil_tiSRCMinPSwmpDebOk_C DDRC_DurDeb.Oil_tiSRCMinPSwmpDebDef_C DDRC_DurDeb.TrbChLP_tiSCBDebOk_C DDRC_DurDeb.TrbChLP_tiSCBDebDef_C DDRC_DurDeb.Exh_tiSRCMinPPFltDiffDebOk_C DDRC_DurDeb.Exh_tiSRCMinPPFltDiffDebDef_C DDRC_DurDeb.PFlt_tiSotMsDvtMinDebOk_C DDRC_DurDeb.PFlt_tiSotMsDvtMinDebDef_C DDRC_DurDeb.EGRVlvLP_tiHBrgOpnLdDebOk_C DDRC_DurDeb.EGRVlvLP_tiHBrgOpnLdDebDef_C DDRC_DurDeb.Exh_tiCmpChkNSCDsDebOk_C DDRC_DurDeb.Exh_tiCmpChkNSCDsDebDef_C DDRC_DurDeb.EGRVlv_tiHBrgOvrTempDebOk_C DDRC_DurDeb.EGRVlv_tiHBrgOvrTempDebDef_C DDRC_DurDeb.EGRVlv_tiGovDvtMaxDebOk_C DDRC_DurDeb.EGRVlv_tiGovDvtMaxDebDef_C DDRC_DurDeb.Exh_tiPlausExhTMon2DebOk_C DDRC_DurDeb.Exh_tiPlausExhTMon2DebDef_C DDRC_DurDeb.VSwVlv_tiHBrgShCirBatt2DebOk_C DDRC_DurDeb.VSwVlv_tiHBrgShCirBatt2DebDef_C DDRC_DurDeb.SCR_tiSRCMaxUCatUsTDebOk_C DDRC_DurDeb.SCR_tiSRCMaxUCatUsTDebDef_C DDRC_DurDeb.AFS_tiRawSRCMinDebOk_C DDRC_DurDeb.AFS_tiRawSRCMinDebDef_C DDRC_DurDeb.LSU_tiO2MinDebOk_C DDRC_DurDeb.LSU_tiO2MinDebDef_C DDRC_DurDeb.ThrVlv_tiSRCMinDebOk_C DDRC_DurDeb.ThrVlv_tiSRCMinDebDef_C DDRC_DurDeb.VSwVlv_tiHBrgTempOvrCurrDebOk_C DDRC_DurDeb.VSwVlv_tiHBrgTempOvrCurrDebDef_C DDRC_DurDeb.Exh_tiNplTOxiUsDebOk_C DDRC_DurDeb.Exh_tiNplTOxiUsDebDef_C DDRC_DurDeb.EGRVlv_tiSRCMinDebOk_C DDRC_DurDeb.EGRVlv_tiSRCMinDebDef_C DDRC_DurDeb.ECBVlv_tiSRCMinDebOk_C DDRC_DurDeb.ECBVlv_tiSRCMinDebDef_C DDRC_DurDeb.EGRVlv_tiHBrgShCirGnd1DebOk_C DDRC_DurDeb.EGRVlv_tiHBrgShCirGnd1DebDef_C DDRC_DurDeb.Air_tiPerLoTAFSDebOk_C DDRC_DurDeb.Air_tiPerLoTAFSDebDef_C DDRC_DurDeb.EngSpd_tiOLDebOk_C DDRC_DurDeb.EngSpd_tiOLDebDef_C DDRC_DurDeb.BrkP_tiMaxDebOk_C DDRC_DurDeb.BrkP_tiMaxDebDef_C DDRC_DurDeb.AFS_tiCorSRCMinDebOk_C DDRC_DurDeb.AFS_tiCorSRCMinDebDef_C DDRC_DurDeb.VSwVlv_tiHBrgOvrCurrDebOk_C DDRC_DurDeb.VSwVlv_tiHBrgOvrCurrDebDef_C DDRC_DurDeb.AirC_tiSwtSigDebOk_C DDRC_DurDeb.AirC_tiSwtSigDebDef_C DDRC_DurDeb.VSwVlv_tiHBrgShCirBatt1DebOk_C DDRC_DurDeb.VSwVlv_tiHBrgShCirBatt1DebDef_C DDRC_DurDeb.SCR_tiSigUTnkTDebOk_C DDRC_DurDeb.SCR_tiSigUTnkTDebDef_C DDRC_DurDeb.GbxNPos_tiSRCdcycMaxDebOk_C DDRC_DurDeb.GbxNPos_tiSRCdcycMaxDebDef_C DDRC_DurDeb.Exh_tiMaxNoCat2DsDebOk_C DDRC_DurDeb.Exh_tiMaxNoCat2DsDebDef_C DDRC_DurDeb.EngTrqPtd_ctMonLimLeadDebOk_C DDRC_DurDeb.EngTrqPtd_ctMonLimLeadDebDef_C DDRC_DurDeb.Layer_numFltMngTstDebOk_C DDRC_DurDeb.Layer_numFltMngTstDebDef_C DDRC_DurDeb.Layer_numGENREGUPLDebOk_C DDRC_DurDeb.Layer_numGENREGUPLDebDef_C DDRC_DurDeb.Layer_numGENUPLDebOk_C DDRC_DurDeb.Layer_numGENUPLDebDef_C DDRC_DurDeb.IVDia_numCylNoLdDebOk_C DDRC_DurDeb.IVDia_numCylNoLdDebDef_C DDRC_DurDeb.LSU_numRiClbMinDebOk_C DDRC_DurDeb.LSU_numRiClbMinDebDef_C DDRC_DurDeb.Exh_numNOxOfsNoCat2DsDebOk_C DDRC_DurDeb.Exh_numNOxOfsNoCat2DsDebDef_C DDRC_DurDeb.Layer_numGENKOMMDebOk_C DDRC_DurDeb.Layer_numGENKOMMDebDef_C DDRC_DurDeb.PCV_numNoStrtDebOk_C DDRC_DurDeb.PCV_numNoStrtDebDef_C DDRC_DurDeb.ETClb_numETMaxDebOk_C DDRC_DurDeb.ETClb_numETMaxDebDef_C DDRC_DurDeb.RailP_numdpDebDebOk_C DDRC_DurDeb.RailP_numdpDebDebDef_C DDRC_DurDeb.LSU_numRiClbMaxDebOk_C DDRC_DurDeb.LSU_numRiClbMaxDebDef_C DDRC_DurDeb.IVCtl_numUDiffUpOBDDebOk_C DDRC_DurDeb.IVCtl_numUDiffUpOBDDebDef_C DDRC_DurDeb.Layer_numNGLERNDebOk_C DDRC_DurDeb.Layer_numNGLERNDebDef_C DDRC_DurDeb.Layer_numMANDETEKDebOk_C DDRC_DurDeb.Layer_numMANDETEKDebDef_C DDRC_DurDeb.Exh_numNOxR2LMinNSCDsDebOk_C DDRC_DurDeb.Exh_numNOxR2LMinNSCDsDebDef_C DDRC_DurDeb.Layer_numBSDDebOk_C DDRC_DurDeb.Layer_numBSDDebDef_C DDRC_DurDeb.IVActr_numEnrgMinDebOk_C DDRC_DurDeb.IVActr_numEnrgMinDebDef_C DDRC_DurDeb.LSU_numO2ClbMinDebOk_C DDRC_DurDeb.LSU_numO2ClbMinDebDef_C DDRC_DurDeb.IVDia_numCylShCirDebOk_C DDRC_DurDeb.IVDia_numCylShCirDebDef_C DDRC_DurDeb.IVDia_numBnkShCirDebOk_C DDRC_DurDeb.IVDia_numBnkShCirDebDef_C DDRC_DurDeb.IVCtl_numTiDiffOBDDebOk_C DDRC_DurDeb.IVCtl_numTiDiffOBDDebDef_C DDRC_DurDeb.LSU_numO2PlausMaxPartLdDebOk_C DDRC_DurDeb.LSU_numO2PlausMaxPartLdDebDef_C DDRC_DurDeb.IVDia_numCylNoClsDebOk_C DDRC_DurDeb.IVDia_numCylNoClsDebDef_C DDRC_DurDeb.Layer_numGENELBDebOk_C DDRC_DurDeb.Layer_numGENELBDebDef_C DDRC_DurDeb.LSU_numO2PlausMaxOvrRunDebOk_C DDRC_DurDeb.LSU_numO2PlausMaxOvrRunDebDef_C DDRC_DurDeb.SCRPOD_numPresBuildUpErrDebOk_C DDRC_DurDeb.SCRPOD_numPresBuildUpErrDebDef_C DDRC_DurDeb.Layer_numPMRUHVERLDebOk_C DDRC_DurDeb.Layer_numPMRUHVERLDebDef_C DDRC_DurDeb.Layer_numQLTDebOk_C DDRC_DurDeb.Layer_numQLTDebDef_C DDRC_DurDeb.Layer_numPMBNDebOk_C DDRC_DurDeb.Layer_numPMBNDebDef_C DDRC_DurDeb.Layer_numGENDebOk_C DDRC_DurDeb.Layer_numGENDebDef_C DDRC_DurDeb.IVDia_numBnkShCirChSwtDebOk_C DDRC_DurDeb.IVDia_numBnkShCirChSwtDebDef_C DDRC_DurDeb.Layer_numIBS3DebOk_C DDRC_DurDeb.Layer_numIBS3DebDef_C DDRC_DurDeb.IVDia_numCylShCirMeasDebOk_C DDRC_DurDeb.IVDia_numCylShCirMeasDebDef_C DDRC_DurDeb.Layer_numGENHTBDebOk_C DDRC_DurDeb.Layer_numGENHTBDebDef_C DDRC_DurDeb.EngTrqPtd_ctMonLimCurrDebOk_C DDRC_DurDeb.EngTrqPtd_ctMonLimCurrDebDef_C DDRC_DurDeb.Layer_numIBS2DebOk_C DDRC_DurDeb.Layer_numIBS2DebDef_C DDRC_DurDeb.LSU_numO2ClbMaxDebOk_C DDRC_DurDeb.LSU_numO2ClbMaxDebDef_C DDRC_DurDeb.IVActr_numEnrgNplDebOk_C DDRC_DurDeb.IVActr_numEnrgNplDebDef_C DDRC_DurDeb.LSU_numO2PlausMinPartLdDebOk_C DDRC_DurDeb.LSU_numO2PlausMinPartLdDebDef_C DDRC_DurDeb.Layer_numGENMECHDebOk_C DDRC_DurDeb.Layer_numGENMECHDebDef_C DDRC_DurDeb.Layer_numGENHTDebOk_C DDRC_DurDeb.Layer_numGENHTDebDef_C DDRC_DurDeb.Layer_numIBS1DebOk_C DDRC_DurDeb.Layer_numIBS1DebDef_C DDRC_DurDeb.Exh_numNOxR2LMinNoCat2DsDebOk_C DDRC_DurDeb.Exh_numNOxR2LMinNoCat2DsDebDef_C DDRC_DurDeb.LSU_numO2PlausMinFLdDebOk_C DDRC_DurDeb.LSU_numO2PlausMinFLdDebDef_C DDRC_DurDeb.Layer_numTOENSDebOk_C DDRC_DurDeb.Layer_numTOENSDebDef_C DDRC_DurDeb.IVActr_numEnrgMaxDebOk_C DDRC_DurDeb.IVActr_numEnrgMaxDebDef_C DDRC_DurDeb.ETClb_numETMinDebOk_C DDRC_DurDeb.ETClb_numETMinDebDef_C DDRC_DurDeb.Clth_numPlaDebOk_C DDRC_DurDeb.Clth_numPlaDebDef_C DDRC_DurDeb.Exh_numNOxOfsNSCDsDebOk_C DDRC_DurDeb.Exh_numNOxOfsNSCDsDebDef_C DDRC_DurDeb.Layer_numNDR1DebOk_C DDRC_DurDeb.Layer_numNDR1DebDef_C DDRC_DurDeb.Layer_numPMBATTDebOk_C DDRC_DurDeb.Layer_numPMBATTDebDef_C DDRC_DurDeb.LSU_numDynChkMinDebOk_C DDRC_DurDeb.LSU_numDynChkMinDebDef_C DDRC_DurDeb.LSU_numO2PlausMaxFLdDebOk_C DDRC_DurDeb.LSU_numO2PlausMaxFLdDebDef_C DDRC_DurDeb.IVCtl_numUUpOBDDebOk_C DDRC_DurDeb.IVCtl_numUUpOBDDebDef_C DDRC_DurDeb.Layer_numNDR2DebOk_C DDRC_DurDeb.Layer_numNDR2DebDef_C DDRC_DurDeb.LSU_numWireIPSigDebOk_C DDRC_DurDeb.LSU_numWireIPSigDebDef_C DDRC_DurDeb.IVDia_numCylShCirHSLSDebOk_C DDRC_DurDeb.IVDia_numCylShCirHSLSDebDef_C DDRC_DurDeb.Layer_numGENELDebOk_C DDRC_DurDeb.Layer_numGENELDebDef_C DDRC_DurDeb.EngTrqPtd_ctMonLimSetDebOk_C DDRC_DurDeb.EngTrqPtd_ctMonLimSetDebDef_C DDRC_DurDeb.LSU_numO2PlausMinOvrRunDebOk_C DDRC_DurDeb.LSU_numO2PlausMinOvrRunDebDef_C DDRC_DurDeb.IVDia_numChpDebOk_C DDRC_DurDeb.IVDia_numChpDebDef_C DDRC_DurDeb.Com_tiPspToDebOk_C DDRC_DurDeb.Com_tiPspToDebDef_C DDRC_DurDeb.Com_tiTrqWhlDemFASCtr_FXDebOk_C DDRC_DurDeb.Com_tiTrqWhlDemFASCtr_FXDebDef_C DDRC_DurDeb.Com_tiTrqDemandGbxTo_FADebOk_C DDRC_DurDeb.Com_tiTrqDemandGbxTo_FADebDef_C DDRC_DurDeb.Com_tiTrqDemCrshDrDyCtr_FXDebOk_C DDRC_DurDeb.Com_tiTrqDemCrshDrDyCtr_FXDebDef_C DDRC_DurDeb.Rail_tiMeUn2DebOk_C DDRC_DurDeb.Rail_tiMeUn2DebDef_C DDRC_DurDeb.Com_tiTrqDemandGbxSig_ADebOk_C DDRC_DurDeb.Com_tiTrqDemandGbxSig_ADebDef_C DDRC_DurDeb.AirCtl_tiGovDvtMinDebOk_C DDRC_DurDeb.AirCtl_tiGovDvtMinDebDef_C DDRC_DurDeb.WaHtEl_ti4WinErr3DebOk_C DDRC_DurDeb.WaHtEl_ti4WinErr3DebDef_C DDRC_DurDeb.Com_tiTrqDemandGbxCtr_ADebOk_C DDRC_DurDeb.Com_tiTrqDemandGbxCtr_ADebDef_C DDRC_DurDeb.Rail_tiMeUn22DebOk_C DDRC_DurDeb.Rail_tiMeUn22DebDef_C DDRC_DurDeb.PFlt_tiPreMaxRgnDebOk_C DDRC_DurDeb.PFlt_tiPreMaxRgnDebDef_C DDRC_DurDeb.Com_tiRpmWhlChk_FXDebOk_C DDRC_DurDeb.Com_tiRpmWhlChk_FXDebDef_C DDRC_DurDeb.Fan_ti4WinErr2DebOk_C DDRC_DurDeb.Fan_ti4WinErr2DebDef_C DDRC_DurDeb.Fan_ti4WinErr1DebOk_C DDRC_DurDeb.Fan_ti4WinErr1DebDef_C DDRC_DurDeb.AltIO_tiComNplDebOk_C DDRC_DurDeb.AltIO_tiComNplDebDef_C DDRC_DurDeb.Com_tiStConintDSCTo_FXDebOk_C DDRC_DurDeb.Com_tiStConintDSCTo_FXDebDef_C DDRC_DurDeb.Com_tiPspSigDebOk_C DDRC_DurDeb.Com_tiPspSigDebDef_C DDRC_DurDeb.Rail_tiPCV42DebOk_C DDRC_DurDeb.Rail_tiPCV42DebDef_C DDRC_DurDeb.Com_tiDiaOBDGbxSig_ADebOk_C DDRC_DurDeb.Com_tiDiaOBDGbxSig_ADebDef_C DDRC_DurDeb.Com_tiStateARSSigDebOk_C DDRC_DurDeb.Com_tiStateARSSigDebDef_C DDRC_DurDeb.Com_tiTerminalCtrDebOk_C DDRC_DurDeb.Com_tiTerminalCtrDebDef_C DDRC_DurDeb.BusDiag_tiBusOffNodeADebOk_C DDRC_DurDeb.BusDiag_tiBusOffNodeADebDef_C DDRC_DurDeb.TrbCh_tiSCGDebOk_C DDRC_DurDeb.TrbCh_tiSCGDebDef_C DDRC_DurDeb.Com_tiaSideChk_FXDebOk_C DDRC_DurDeb.Com_tiaSideChk_FXDebDef_C DDRC_DurDeb.Com_tiTerminalSigDebOk_C DDRC_DurDeb.Com_tiTerminalSigDebDef_C DDRC_DurDeb.Com_tiVelocityChk_FADebOk_C DDRC_DurDeb.Com_tiVelocityChk_FADebDef_C DDRC_DurDeb.Rail_tiPCV22DebOk_C DDRC_DurDeb.Rail_tiPCV22DebDef_C DDRC_DurDeb.GlwEcu_tiGkOLDebOk_C DDRC_DurDeb.GlwEcu_tiGkOLDebDef_C DDRC_DurDeb.Com_tiStConintDSCChk_FXDebOk_C DDRC_DurDeb.Com_tiStConintDSCChk_FXDebDef_C DDRC_DurDeb.Rail_tiPMonStrtDebOk_C DDRC_DurDeb.Rail_tiPMonStrtDebDef_C DDRC_DurDeb.Lub_tiTotDebOk_C DDRC_DurDeb.Lub_tiTotDebDef_C DDRC_DurDeb.GlwEcu_tiGPCMFaultInfoDebOk_C DDRC_DurDeb.GlwEcu_tiGPCMFaultInfoDebDef_C DDRC_DurDeb.ThrVlv_ti4WinErr3DebOk_C DDRC_DurDeb.ThrVlv_ti4WinErr3DebDef_C DDRC_DurDeb.Com_StatEkpSig_ADebOk_C DDRC_DurDeb.Com_StatEkpSig_ADebDef_C DDRC_DurDeb.Com_tiGbxDataTo_ADebOk_C DDRC_DurDeb.Com_tiGbxDataTo_ADebDef_C DDRC_DurDeb.Com_StatEkpTo_ADebOk_C DDRC_DurDeb.Com_StatEkpTo_ADebDef_C DDRC_DurDeb.Com_tiRelTimeSig_FADebOk_C DDRC_DurDeb.Com_tiRelTimeSig_FADebDef_C DDRC_DurDeb.Com_tiLenkradwinkelSigDebOk_C DDRC_DurDeb.Com_tiLenkradwinkelSigDebDef_C DDRC_DurDeb.Com_tiSlrdiGlbFZMTo_FXDebOk_C DDRC_DurDeb.Com_tiSlrdiGlbFZMTo_FXDebDef_C DDRC_DurDeb.Com_tiCrCtlLvrChkDebOk_C DDRC_DurDeb.Com_tiCrCtlLvrChkDebDef_C DDRC_DurDeb.Com_tiStateSeatSig_FADebOk_C DDRC_DurDeb.Com_tiStateSeatSig_FADebDef_C DDRC_DurDeb.Rail_tiMeUn1DebOk_C DDRC_DurDeb.Rail_tiMeUn1DebDef_C DDRC_DurDeb.Fan_ti4WinErr3DebOk_C DDRC_DurDeb.Fan_ti4WinErr3DebDef_C DDRC_DurDeb.Com_tiShutOffPSPToDebOk_C DDRC_DurDeb.Com_tiShutOffPSPToDebDef_C DDRC_DurDeb.Com_tiFahrzeugtypSig_FADebOk_C DDRC_DurDeb.Com_tiFahrzeugtypSig_FADebDef_C DDRC_DurDeb.Com_tiVelocityTo_FADebOk_C DDRC_DurDeb.Com_tiVelocityTo_FADebDef_C DDRC_DurDeb.Rail_tiPCV3DebOk_C DDRC_DurDeb.Rail_tiPCV3DebDef_C DDRC_DurDeb.IBS_tiComErrDebOk_C DDRC_DurDeb.IBS_tiComErrDebDef_C DDRC_DurDeb.GlwEcu_tiT30ErrDebOk_C DDRC_DurDeb.GlwEcu_tiT30ErrDebDef_C DDRC_DurDeb.Com_tiFllupGpwsupSig_FADebOk_C DDRC_DurDeb.Com_tiFllupGpwsupSig_FADebDef_C DDRC_DurDeb.PFlt_tiPFltmSotDiffMINDebOk_C DDRC_DurDeb.PFlt_tiPFltmSotDiffMINDebDef_C DDRC_DurDeb.WaHtEl_tiSCGDebOk_C DDRC_DurDeb.WaHtEl_tiSCGDebDef_C DDRC_DurDeb.Com_tiRequestEMFChkDebOk_C DDRC_DurDeb.Com_tiRequestEMFChkDebDef_C DDRC_DurDeb.ETCtl_tiDvtInrMinDebOk_C DDRC_DurDeb.ETCtl_tiDvtInrMinDebDef_C DDRC_DurDeb.Rail_tiPCV2DebOk_C DDRC_DurDeb.Rail_tiPCV2DebDef_C DDRC_DurDeb.Com_tiSpeedVehicleTo_FXDebOk_C DDRC_DurDeb.Com_tiSpeedVehicleTo_FXDebDef_C DDRC_DurDeb.Com_tiKlemmenCtr_FADebOk_C DDRC_DurDeb.Com_tiKlemmenCtr_FADebDef_C DDRC_DurDeb.Com_tiTrailerToDebOk_C DDRC_DurDeb.Com_tiTrailerToDebDef_C DDRC_DurDeb.Com_tiSensNOxUbattSigDebOk_C DDRC_DurDeb.Com_tiSensNOxUbattSigDebDef_C DDRC_DurDeb.Com_tiBrkTrqSumCtr_FXDebOk_C DDRC_DurDeb.Com_tiBrkTrqSumCtr_FXDebDef_C DDRC_DurDeb.Com_tiZvKlappenSigDebOk_C DDRC_DurDeb.Com_tiZvKlappenSigDebDef_C DDRC_DurDeb.Com_tiSecCtrRelTo_FADebOk_C DDRC_DurDeb.Com_tiSecCtrRelTo_FADebDef_C DDRC_DurDeb.Com_tiTrqDemandDesSigDebOk_C DDRC_DurDeb.Com_tiTrqDemandDesSigDebDef_C DDRC_DurDeb.Com_tiCtrCrshSwoEkpSig_FADebOk_C DDRC_DurDeb.Com_tiCtrCrshSwoEkpSig_FADebDef_C DDRC_DurDeb.Com_tiaSideTo_FXDebOk_C DDRC_DurDeb.Com_tiaSideTo_FXDebDef_C DDRC_DurDeb.PCR_tiGovDvtMinDebOk_C DDRC_DurDeb.PCR_tiGovDvtMinDebDef_C DDRC_DurDeb.Com_tiLenkradwinkelToDebOk_C DDRC_DurDeb.Com_tiLenkradwinkelToDebDef_C DDRC_DurDeb.Com_tiGbxDataChk_ADebOk_C DDRC_DurDeb.Com_tiGbxDataChk_ADebDef_C DDRC_DurDeb.Com_tiStatGearRevTo_FADebOk_C DDRC_DurDeb.Com_tiStatGearRevTo_FADebDef_C DDRC_DurDeb.Com_tiStatusEGSSig_FADebOk_C DDRC_DurDeb.Com_tiStatusEGSSig_FADebDef_C DDRC_DurDeb.PFlt_tiPFltAPSPlausMINDebOk_C DDRC_DurDeb.PFlt_tiPFltAPSPlausMINDebDef_C DDRC_DurDeb.Com_tiaDirectChk_FXDebOk_C DDRC_DurDeb.Com_tiaDirectChk_FXDebDef_C DDRC_DurDeb.BusDiag_tiBusOffFlexRayDebOk_C DDRC_DurDeb.BusDiag_tiBusOffFlexRayDebDef_C DDRC_DurDeb.Com_tiTimeDateSig_FADebOk_C DDRC_DurDeb.Com_tiTimeDateSig_FADebDef_C DDRC_DurDeb.Com_tiStateSeatToDebOk_C DDRC_DurDeb.Com_tiStateSeatToDebDef_C DDRC_DurDeb.Com_tiaDirectCtr_FXDebOk_C DDRC_DurDeb.Com_tiaDirectCtr_FXDebDef_C DDRC_DurDeb.PFlt_tiPFltmSotDiffMAXDebOk_C DDRC_DurDeb.PFlt_tiPFltmSotDiffMAXDebDef_C DDRC_DurDeb.FBC_tiDvtMaxDebOk_C DDRC_DurDeb.FBC_tiDvtMaxDebDef_C DDRC_DurDeb.GlwEcu_tiFrmErrDebOk_C DDRC_DurDeb.GlwEcu_tiFrmErrDebDef_C DDRC_DurDeb.Com_tiGbxDataChk_FADebOk_C DDRC_DurDeb.Com_tiGbxDataChk_FADebDef_C DDRC_DurDeb.Com_tiSpeedVehicleCtr_FXDebOk_C DDRC_DurDeb.Com_tiSpeedVehicleCtr_FXDebDef_C DDRC_DurDeb.GlwEcu_tiUdiffT30DebOk_C DDRC_DurDeb.GlwEcu_tiUdiffT30DebDef_C DDRC_DurDeb.Com_tiSensNOxGndSigDebOk_C DDRC_DurDeb.Com_tiSensNOxGndSigDebDef_C DDRC_DurDeb.Com_tiATempTo_FADebOk_C DDRC_DurDeb.Com_tiATempTo_FADebDef_C DDRC_DurDeb.Rail_tiMeUn4DebOk_C DDRC_DurDeb.Rail_tiMeUn4DebDef_C DDRC_DurDeb.Com_tiGbxDataSig_FADebOk_C DDRC_DurDeb.Com_tiGbxDataSig_FADebDef_C DDRC_DurDeb.Com_tiSensNOxGndToDebOk_C DDRC_DurDeb.Com_tiSensNOxGndToDebDef_C DDRC_DurDeb.BusDiag_tiBusOffNodeCDebOk_C DDRC_DurDeb.BusDiag_tiBusOffNodeCDebDef_C DDRC_DurDeb.AirCtl_tiGovDvtEOMMaxDebOk_C DDRC_DurDeb.AirCtl_tiGovDvtEOMMaxDebDef_C DDRC_DurDeb.Com_tiTrqDemandDscCtrDebOk_C DDRC_DurDeb.Com_tiTrqDemandDscCtrDebDef_C DDRC_DurDeb.Com_tiTrqDemandDscToDebOk_C DDRC_DurDeb.Com_tiTrqDemandDscToDebDef_C DDRC_DurDeb.PCR_tiGovDvtLPMaxDebOk_C DDRC_DurDeb.PCR_tiGovDvtLPMaxDebDef_C DDRC_DurDeb.PFlt_tiOxiPreMaxDebOk_C DDRC_DurDeb.PFlt_tiOxiPreMaxDebDef_C DDRC_DurDeb.PCBS_tiLThresDebOk_C DDRC_DurDeb.PCBS_tiLThresDebDef_C DDRC_DurDeb.TrbCh_tiSRCMaxDebOk_C DDRC_DurDeb.TrbCh_tiSRCMaxDebDef_C DDRC_DurDeb.Com_tiBrkTrqSumChk_FXDebOk_C DDRC_DurDeb.Com_tiBrkTrqSumChk_FXDebDef_C DDRC_DurDeb.PFlt_tiPFltBPSPlausMINDebOk_C DDRC_DurDeb.PFlt_tiPFltBPSPlausMINDebDef_C DDRC_DurDeb.Com_tiDiaOBDGbxTo_ADebOk_C DDRC_DurDeb.Com_tiDiaOBDGbxTo_ADebDef_C DDRC_DurDeb.Rail_tiMeUn0DebOk_C DDRC_DurDeb.Rail_tiMeUn0DebDef_C DDRC_DurDeb.GlwEcu_tiGndErrDebOk_C DDRC_DurDeb.GlwEcu_tiGndErrDebDef_C DDRC_DurDeb.BusDiag_tiHwFlexRayDebOk_C DDRC_DurDeb.BusDiag_tiHwFlexRayDebDef_C /end DEF_CHARACTERISTIC
/end FUNCTION
/begin COMPU_METHOD DDRCTime_ms "" RAT_FUNC "%5.0" "ms" COEFFS 0 1 0 0 0 10 /end COMPU_METHOD
/begin COMPU_METHOD OneToOne "" RAT_FUNC "%6.0" "-" COEFFS 0 1 0 0 0 1 /end COMPU_METHOD
/begin RECORD_LAYOUT Val_Wu16 FNC_VALUES 1 UWORD COLUMN_DIR DIRECT /end RECORD_LAYOUT
/end MODULE
/end PROJECT

ASAP2_VERSION 1 4
/begin PROJECT P_574 "EDC17_CP09"
/begin HEADER "" VERSION "V8KB" PROJECT_NO P_574 /end HEADER
/begin MODULE DIM ""
/begin MOD_COMMON "" BYTE_ORDER MSB_LAST ALIGNMENT_BYTE 1 ALIGNMENT_WORD 2 ALIGNMENT_LONG 4 ALIGNMENT_FLOAT32_IEEE 4 /end MOD_COMMON
/begin CHARACTERISTIC AltIO_trqDes_C "" VALUE 0x80039078 Kw_Ws16 6553.500 Trq -3276.800 3276.700 /end CHARACTERISTIC
/begin CHARACTERISTIC Com_dnDynDisp.Pos_C "/" VALUE 0x8003A4BC Kw_Ws32 16383999.9924 RmpEngN 0.00 16383999.9924 FORMAT "%13.4" EXTENDED_LIMITS -16384000.0000 16383999.9924 /end CHARACTERISTIC
/begin CHARACTERISTIC Com_dnDynDisp.Neg_C "/" VALUE 0x8003A4C0 Kw_Ws32 16383999.9924 RmpEngN 0.00 16383999.9924 FORMAT "%13.4" EXTENDED_LIMITS -16384000.0000 16383999.9924 /end CHARACTERISTIC
/begin CHARACTERISTIC Com_dTrqOvrRunRmp.Pos_C "/" VALUE 0x8003A4C4 Kw_Ws32 2147483647.00 OneToOne 0.00 2147483647.00 EXTENDED_LIMITS -2147483648.00 2147483647.00 /end CHARACTERISTIC
/begin CHARACTERISTIC Com_dTrqOvrRunRmp.Neg_C "/" VALUE 0x8003A4C8 Kw_Ws32 2147483647.00 OneToOne 0.00 2147483647.00 EXTENDED_LIMITS -2147483648.00 2147483647.00 /end CHARACTERISTIC
/begin CHARACTERISTIC Com_dtrqWheelRmp.Pos_C "/" VALUE 0x8003A510 Kw_Ws32 3276798.99902 RmpTrqPrpHigh 0.999450683594 3276799.99847 FORMAT "%13.5" EXTENDED_LIMITS -3276800.00000 3276799.99847 /end CHARACTERISTIC
/begin CHARACTERISTIC Com_dtrqWheelRmp.Neg_C "/" VALUE 0x8003A514 Kw_Ws32 3276798.99902 RmpTrqPrpHigh 0.999450683594 3276799.99847 FORMAT "%13.5" EXTENDED_LIMITS -3276800.00000 3276799.99847 /end CHARACTERISTIC
/begin CHARACTERISTIC Com_dTrqWhlRmp.Pos_C "/" VALUE 0x8003A4CC Kw_Ws32 3276799.99847 RmpTrqPrpHigh 0.00 3276799.99847 FORMAT "%13.5" EXTENDED_LIMITS -3276800.00000 3276799.99847 /end CHARACTERISTIC
/begin CHARACTERISTIC Com_dTrqWhlRmp.Neg_C "/" VALUE 0x8003A4D0 Kw_Ws32 3276799.99847 RmpTrqPrpHigh 0.00 3276799.99847 FORMAT "%13.5" EXTENDED_LIMITS -3276800.00000 3276799.99847 /end CHARACTERISTIC
/begin CHARACTERISTIC Com_facTrqInrStrt_C "" VALUE 0x8003A4D4 Val_Ws16 655.3500 Fact100 -327.6800 327.6700 FORMAT "%8.4" /end CHARACTERISTIC
/begin CHARACTERISTIC Com_nEISGovOffs_C "" VALUE 0x8003A4D6 Val_Ws16 32767.50 EngN -16384.00 16383.50 /end CHARACTERISTIC
/begin CHARACTERISTIC Com_nEngOn_C "" VALUE 0x8003A4D8 Val_Ws16 32767.50 EngN -16384.00 16383.50 /end CHARACTERISTIC
/begin CHARACTERISTIC Com_qOvrRun_C "" VALUE 0x8003A4DA Val_Ws16 655.3500 InjMass -327.6800 327.6700 /end CHARACTERISTIC
/begin CHARACTERISTIC Com_rWaterVlvClose_C "" VALUE 0x8003A4DC Val_Ws16 100.0000 Prc 0.00 100.0000 EXTENDED_LIMITS -400.0000 399.9878 /end CHARACTERISTIC
/begin CHARACTERISTIC Com_rWaterVlvCtl_C "" VALUE 0x8003A4DE Val_Ws16 100.0000 Prc 0.00 100.0000 EXTENDED_LIMITS -400.0000 399.9878 /end CHARACTERISTIC
/begin CHARACTERISTIC Com_rWaterVlvDef_C "" VALUE 0x8003A4E0 Val_Ws16 100.0000 Prc 0.00 100.0000 EXTENDED_LIMITS -400.0000 399.9878 /end CHARACTERISTIC
/begin CHARACTERISTIC Com_rWaterVlvOpen_C "" VALUE 0x8003A4E2 Val_Ws16 100.0000 Prc 0.00 100.0000 EXTENDED_LIMITS -400.0000 399.9878 /end CHARACTERISTIC
/begin CHARACTERISTIC Com_stTrqInrErr_C "" VALUE 0x8003A4E4 Val_Wu8 3.000 OneToOne 0.00 3.000 EXTENDED_LIMITS 0.00 255.0 /end CHARACTERISTIC
/begin CHARACTERISTIC Com_swtAngAcpd_FA_C "" VALUE 0x8003A4FC Val_Wu8 255.0 OneToOne 0.00 255.0 /end CHARACTERISTIC
/begin CHARACTERISTIC Com_swtAngAcpd_FX_C "" VALUE 0x8003A584 Val_Wu8 1.000 OneToOne 0.00 1.000 EXTENDED_LIMITS 0.00 255.0 /end CHARACTERISTIC
/begin CHARACTERISTIC Com_swtASDdc_C "" VALUE 0x8003A4E5 Val_Wu8 255.0 OneToOne 0.00 255.0 /end CHARACTERISTIC
/begin CHARACTERISTIC Com_swtBNVltg_FA_C "" VALUE 0x8003A4FD Val_Wu8 255.0 OneToOne 0.00 255.0 /end CHARACTERISTIC
/begin CHARACTERISTIC Com_swtDataPT2_FX_C "" VALUE 0x8003A585 Val_Wu8 1.000 OneToOne 0.00 1.000 EXTENDED_LIMITS 0.00 255.0 /end CHARACTERISTIC
/begin CHARACTERISTIC Com_swtDataPT_FX_C "" VALUE 0x8003A586 Val_Wu8 1.000 OneToOne 0.00 1.000 EXTENDED_LIMITS 0.00 255.0 /end CHARACTERISTIC
/begin CHARACTERISTIC Com_swtDispRpmPt_FA_C "" VALUE 0x8003A4FE Val_Wu8 255.0 OneToOne 0.00 255.0 /end CHARACTERISTIC
/begin CHARACTERISTIC Com_swtDriveTrainData1_FA_C "" VALUE 0x8003A4FF Val_Wu8 255.0 OneToOne 0.00 255.0 /end CHARACTERISTIC
/begin CHARACTERISTIC Com_swtDriveTrainData2_FA_C "" VALUE 0x8003A500 Val_Wu8 255.0 OneToOne 0.00 255.0 /end CHARACTERISTIC
/begin CHARACTERISTIC Com_swtElektrMOelMess_FA_C "" VALUE 0x8003A501 Val_Wu8 255.0 OneToOne 0.00 255.0 /end CHARACTERISTIC
/begin CHARACTERISTIC Com_swtEngine1_FA_C "" VALUE 0x8003A502 Val_Wu8 255.0 OneToOne 0.00 255.0 /end CHARACTERISTIC
/begin CHARACTERISTIC Com_swtGbxDriveTrain_FX_C "" VALUE 0x8003A587 Val_Wu8 1.000 OneToOne 0.00 1.000 EXTENDED_LIMITS 0.00 255.0 /end CHARACTERISTIC
/begin CHARACTERISTIC Com_swtHtgUpTempSel_C "" VALUE 0x8003A4E6 Val_Wu8 3.00000000000 EngTempFldSel 0.00 3.00000000000 FORMAT "%13.11" /end CHARACTERISTIC
/begin CHARACTERISTIC Com_swtHtMgtEngCtr_FA_C "" VALUE 0x8003A503 Val_Wu8 255.0 OneToOne 0.00 255.0 /end CHARACTERISTIC
/begin CHARACTERISTIC Com_swtHtqUpCoEOMOff_C "" VALUE 0x8003A4E7 Val_Wu8 1.000 OneToOne 0.00 1.000 EXTENDED_LIMITS 0.00 255.0 /end CHARACTERISTIC
/begin CHARACTERISTIC Com_swtLLDynDisp_C "" VALUE 0x8003A4E8 Val_Wu8 100.0 OneToOne 0.00 100.0 EXTENDED_LIMITS 0.00 255.0 /end CHARACTERISTIC
/begin CHARACTERISTIC Com_swtPwrmngCtrCos_FA_C "" VALUE 0x8003A504 Val_Wu8 255.0 OneToOne 0.00 255.0 /end CHARACTERISTIC
/begin CHARACTERISTIC Com_swtStatusBatterie_FA_C "" VALUE 0x8003A505 Val_Wu8 255.0 OneToOne 0.00 255.0 /end CHARACTERISTIC
/begin CHARACTERISTIC Com_swtStatusMSA_FX_C "" VALUE 0x8003A588 Val_Wu8 1.000 OneToOne 0.00 1.000 EXTENDED_LIMITS 0.00 255.0 /end CHARACTERISTIC
/begin CHARACTERISTIC Com_swtStCospFuEng_FA_C "" VALUE 0x8003A506 Val_Wu8 255.0 OneToOne 0.00 255.0 /end CHARACTERISTIC
/begin CHARACTERISTIC Com_swtStEnergGen_FA_C "" VALUE 0x8003A507 Val_Wu8 255.0 OneToOne 0.00 255.0 /end CHARACTERISTIC
/begin CHARACTERISTIC Com_swtTrqCrsh1_FA_C "" VALUE 0x8003A508 Val_Wu8 255.0 OneToOne 0.00 255.0 /end CHARACTERISTIC
/begin CHARACTERISTIC Com_swtTrqCrsh1_FX_C "" VALUE 0x8003A589 Val_Wu8 1.000 OneToOne 0.00 1.000 EXTENDED_LIMITS 0.00 255.0 /end CHARACTERISTIC
/begin CHARACTERISTIC Com_swtTrqCrsh2_FA_C "" VALUE 0x8003A509 Val_Wu8 255.0 OneToOne 0.00 255.0 /end CHARACTERISTIC
/begin CHARACTERISTIC Com_swtTrqCrsh3_FA_C "" VALUE 0x8003A50A Val_Wu8 255.0 OneToOne 0.00 255.0 /end CHARACTERISTIC
/begin CHARACTERISTIC Com_swtTrqCrsh3_FX_C "" VALUE 0x8003A58A Val_Wu8 1.000 OneToOne 0.00 1.000 EXTENDED_LIMITS 0.00 255.0 /end CHARACTERISTIC
/begin CHARACTERISTIC Com_swtVerbraucherstg_FX_C "" VALUE 0x8003A58B Val_Wu8 1.000 OneToOne 0.00 1.000 EXTENDED_LIMITS 0.00 255.0 /end CHARACTERISTIC
/begin CHARACTERISTIC Com_swtWhlTrqPT1_FX_C "" VALUE 0x8003A58C Val_Wu8 1.000 OneToOne 0.00 1.000 EXTENDED_LIMITS 0.00 255.0 /end CHARACTERISTIC
/begin CHARACTERISTIC Com_swtWhlTrqPT2_FX_C "" VALUE 0x8003A58D Val_Wu8 1.000 OneToOne 0.00 1.000 EXTENDED_LIMITS 0.00 255.0 /end CHARACTERISTIC
/begin CHARACTERISTIC Com_swtWhlTrqPT3_FX_C "" VALUE 0x8003A58E Val_Wu8 1.000 OneToOne 0.00 1.000 EXTENDED_LIMITS 0.00 255.0 /end CHARACTERISTIC
/begin CHARACTERISTIC Com_swtWhlTrqPT4_FA_C "" VALUE 0x8003A50B Val_Wu8 255.0 OneToOne 0.00 255.0 /end CHARACTERISTIC
/begin CHARACTERISTIC Com_swtWhlTrqPT4_FX_C "" VALUE 0x8003A58F Val_Wu8 1.000 OneToOne 0.00 1.000 EXTENDED_LIMITS 0.00 255.0 /end CHARACTERISTIC
/begin CHARACTERISTIC Com_swtWhlTrqPT5_FA_C "" VALUE 0x8003A50C Val_Wu8 255.0 OneToOne 0.00 255.0 /end CHARACTERISTIC
/begin CHARACTERISTIC Com_swtWhlTrqPT5_FX_C "" VALUE 0x8003A590 Val_Wu8 1.000 OneToOne 0.00 1.000 EXTENDED_LIMITS 0.00 255.0 /end CHARACTERISTIC
/begin CHARACTERISTIC Com_tEngLimHi_C "" VALUE 0x8003A4EA Val_Ws16 6553.500 Temp_Cels -3549.940 3003.560 /end CHARACTERISTIC
/begin CHARACTERISTIC Com_tEngLimLo_C "" VALUE 0x8003A4EC Val_Ws16 6553.500 Temp_Cels -3549.940 3003.560 /end CHARACTERISTIC
/begin CHARACTERISTIC Com_tiDebDscAck.tiHiLo_C "/" VALUE 0x8003A4EE Kw_Ws16 65535.00 OneToOne -32768.00 32767.00 /end CHARACTERISTIC
/begin CHARACTERISTIC Com_tiDebDscAck.tiLoHi_C "/" VALUE 0x8003A4F0 Kw_Ws16 65535.00 OneToOne -32768.00 32767.00 /end CHARACTERISTIC
/begin CHARACTERISTIC Com_tiDebGbxAck.tiHiLo_C "/" VALUE 0x8003A4F2 Kw_Ws16 65535.00 OneToOne -32768.00 32767.00 /end CHARACTERISTIC
/begin CHARACTERISTIC Com_tiDebGbxAck.tiLoHi_C "/" VALUE 0x8003A4F4 Kw_Ws16 65535.00 OneToOne -32768.00 32767.00 /end CHARACTERISTIC
/begin CHARACTERISTIC Com_tiDebRTrq.tiHiLo_C "/" VALUE 0x8003A518 Kw_Ws16 65535.00 OneToOne -32768.00 32767.00 /end CHARACTERISTIC
/begin CHARACTERISTIC Com_tiDebRTrq.tiLoHi_C "/" VALUE 0x8003A51A Kw_Ws16 65535.00 OneToOne -32768.00 32767.00 /end CHARACTERISTIC
/begin CHARACTERISTIC Com_tiNDynDisp_C "" VALUE 0x8003A4F6 Val_Ws16 10000.00 Time_ms 0.00 10000.00 EXTENDED_LIMITS -327680.0 327670.0 /end CHARACTERISTIC
/begin CHARACTERISTIC Com_tiTrqAccPT1Flt_C "" VALUE 0x8003A51C Val_Ws32 49.841480947 TimeDelay_s 0.099999238556 49.941480186 FORMAT "%12.9" EXTENDED_LIMITS 0.000002000000001 4294.9672960 /end CHARACTERISTIC
/begin CHARACTERISTIC Com_trqLosDflt_MAP "" MAP 0x8003A520 Map_Xs16Ys16Ws16 6553.500 Trq -3276.800 3276.700
 /begin AXIS_DESCR STD_AXIS Tra_numGear OneToOne 6 -128.0 127.0 DEPOSIT ABSOLUTE /end AXIS_DESCR
 /begin AXIS_DESCR STD_AXIS Epm_nEng EngN 6 -16384.00 16383.50 DEPOSIT ABSOLUTE /end AXIS_DESCR
/end CHARACTERISTIC
/begin CHARACTERISTIC Com_tWaterVlv_C "" VALUE 0x8003A4F8 Val_Ws16 100.0000 Temp_Cels -0.04000000 99.96000 EXTENDED_LIMITS -3549.940 3003.560 /end CHARACTERISTIC
/begin CHARACTERISTIC Com_vT15Hw_C "" VALUE 0x8003A4FA Val_Ws16 655.3500 Vel -327.6800 327.6700 /end CHARACTERISTIC
/begin CHARACTERISTIC EngICO_dnRmp.Pos_C "Strukturelement für Drehzahl-Sollwertrampe der komfortablen EMB/" VALUE 0x8003A594 Kw_Ws32 16383999.9924 RmpEngN 0.00 16383999.9924 FORMAT "%13.4" EXTENDED_LIMITS -16384000.0000 16383999.9924 /end CHARACTERISTIC
/begin CHARACTERISTIC EngICO_dnRmp.Neg_C "Strukturelement für Drehzahl-Sollwertrampe der komfortablen EMB/" VALUE 0x8003A598 Kw_Ws32 16383999.9924 RmpEngN 0.00 16383999.9924 FORMAT "%13.4" EXTENDED_LIMITS -16384000.0000 16383999.9924 /end CHARACTERISTIC
/begin CHARACTERISTIC EngICO_nCtOff_C "Maximal zulässige Motordrehzahl bei angeforderter Einspritzmengenausblendung" VALUE 0x8003A59C Val_Ws16 10000.00 EngN 0.00 10000.00 EXTENDED_LIMITS -16384.00 16383.50 /end CHARACTERISTIC
/begin CHARACTERISTIC EngICO_stMode_C "Auswahl-Schalter zwischen Standard-EMB und komfortabler EMB" VALUE 0x8003A59E Val_Wu8 255.0 OneToOne 0.00 255.0 /end CHARACTERISTIC
/begin CHARACTERISTIC EngPrt_dtOvhtLim.Pos_C "/" VALUE 0x8003AA34 Kw_Ws32 1030.00030518 RmpTemp -30.0003051758 1000.00000000 FORMAT "%13.8" EXTENDED_LIMITS -3276800.00000 3276799.99847 /end CHARACTERISTIC
/begin CHARACTERISTIC EngPrt_dtOvhtLim.Neg_C "/" VALUE 0x8003AA38 Kw_Ws32 1030.00030518 RmpTemp -30.0003051758 1000.00000000 FORMAT "%13.8" EXTENDED_LIMITS -3276800.00000 3276799.99847 /end CHARACTERISTIC
/begin CHARACTERISTIC EngPrt_dtrqLimDiffOvht.Pos_C "Rampenparameter für Momenten-Rampe/" VALUE 0x8003AA3C Kw_Ws32 3276799.99847 RmpTrq 0.00 3276799.99847 EXTENDED_LIMITS -3276800.00000 3276799.99847 /end CHARACTERISTIC
/begin CHARACTERISTIC EngPrt_dtrqLimDiffOvht.Neg_C "Rampenparameter für Momenten-Rampe/" VALUE 0x8003AA40 Kw_Ws32 3276799.99847 RmpTrq 0.00 3276799.99847 EXTENDED_LIMITS -3276800.00000 3276799.99847 /end CHARACTERISTIC
/begin CHARACTERISTIC EngPrt_dtrqReplVal.Pos_C "Rampenparameter für Momentenrampe/" VALUE 0x8003AA44 Kw_Ws32 3276799.99847 RmpTrq 0.00 3276799.99847 EXTENDED_LIMITS -3276800.00000 3276799.99847 /end CHARACTERISTIC
/begin CHARACTERISTIC EngPrt_dtrqReplVal.Neg_C "Rampenparameter für Momentenrampe/" VALUE 0x8003AA48 Kw_Ws32 3276799.99847 RmpTrq 0.00 3276799.99847 EXTENDED_LIMITS -3276800.00000 3276799.99847 /end CHARACTERISTIC
/begin CHARACTERISTIC EngPrt_dtrqReplValDynCor.Pos_C "Rampen-steigung Struktur/" VALUE 0x8003AA4C Kw_Ws32 200.000000000 RmpTrq -100.000000000 100.000000000 EXTENDED_LIMITS -3276800.00000 3276799.99847 /end CHARACTERISTIC
/begin CHARACTERISTIC EngPrt_dtrqReplValDynCor.Neg_C "Rampen-steigung Struktur/" VALUE 0x8003AA50 Kw_Ws32 200.000000000 RmpTrq -100.000000000 100.000000000 EXTENDED_LIMITS -3276800.00000 3276799.99847 /end CHARACTERISTIC
/begin CHARACTERISTIC EngPrt_facAPSPrv2_MAP "" MAP 0x8003AA54 Kf_Xs16_Ys16_Ws16 3.999878 Fact 0.00 3.999878 EXTENDED_LIMITS -4.000000 3.999878
 /begin AXIS_DESCR STD_AXIS EnvP_p Pres_hPa 9 -32768.00 3500.00 EXTENDED_LIMITS -32768.00 32767.00 DEPOSIT ABSOLUTE /end AXIS_DESCR
 /begin AXIS_DESCR STD_AXIS Epm_nEng EngN 9 0.00 16383.50 EXTENDED_LIMITS -16384.00 16383.50 DEPOSIT ABSOLUTE /end AXIS_DESCR
/end CHARACTERISTIC
/begin CHARACTERISTIC EngPrt_facAPSPrvEOM_MAP "" MAP 0x8003AB1E Kf_Xs16_Ys16_Ws16 3.999878 Fact 0.00 3.999878 EXTENDED_LIMITS -4.000000 3.999878
 /begin AXIS_DESCR STD_AXIS EnvP_p Pres_hPa 9 -32768.00 3500.00 EXTENDED_LIMITS -32768.00 32767.00 DEPOSIT ABSOLUTE /end AXIS_DESCR
 /begin AXIS_DESCR STD_AXIS Epm_nEng EngN 9 0.00 16383.50 EXTENDED_LIMITS -16384.00 16383.50 DEPOSIT ABSOLUTE /end AXIS_DESCR
/end CHARACTERISTIC
/begin CHARACTERISTIC EngPrt_facAPSPrv_MAP "Überhitzungsschutz-Kennfeld" MAP 0x8003ABE8 Kf_Xs16_Ys16_Ws16 3.999878 Fact 0.00 3.999878 EXTENDED_LIMITS -4.000000 3.999878
 /begin AXIS_DESCR STD_AXIS EnvP_p Pres_hPa 10 -32768.00 3500.00 EXTENDED_LIMITS -32768.00 32767.00 DEPOSIT ABSOLUTE /end AXIS_DESCR
 /begin AXIS_DESCR STD_AXIS Epm_nEng EngN 10 0.00 16383.50 EXTENDED_LIMITS -16384.00 16383.50 DEPOSIT ABSOLUTE /end AXIS_DESCR
/end CHARACTERISTIC
/begin CHARACTERISTIC EngPrt_facCTCor_CUR "Kühlmitteltemperaturabhängige Momentenkorrektur" CURVE 0x8003A5BC Cur_Xs16Ws16 1.000000 Fact 0.00 1.000000 EXTENDED_LIMITS -4.000000 3.999878
 /begin AXIS_DESCR STD_AXIS CEngDsT_t Temp_Cels 25 -50.14000 149.8600 EXTENDED_LIMITS -3549.940 3003.560 DEPOSIT ABSOLUTE /end AXIS_DESCR
/end CHARACTERISTIC
/begin CHARACTERISTIC EngPrt_facOvhtPrtRmp_CUR "" CURVE 0x8003ACDC Cur_Xs16Ws16 3.000000 CoEOMSwt_S16 0.00 3.000000 FORMAT "%8.6" EXTENDED_LIMITS -2.000000 1.999939
 /begin AXIS_DESCR STD_AXIS CoEOM_facRmpVal CoEOMSwt_S16 8 -100.1400 199.8600 FORMAT "%8.4" EXTENDED_LIMITS -2.000000 1.999939 DEPOSIT ABSOLUTE /end AXIS_DESCR
/end CHARACTERISTIC
/begin CHARACTERISTIC EngPrt_facOvhtPrvTrailer_MAP "Überhitzungsschutz-Kennfeld Kühlwassertemperatur in Faktor bei Anhängererkennung" MAP 0x8003ACFE Map_Xs16Ys16Ws16 3.999878 Fact 0.00 3.999878 EXTENDED_LIMITS -4.000000 3.999878
 /begin AXIS_DESCR STD_AXIS EngPrt_tEngDaFld_mp Temp_Cels 7 -3549.940 3003.560 DEPOSIT ABSOLUTE /end AXIS_DESCR
 /begin AXIS_DESCR STD_AXIS VehV_v Vel 7 0.00 327.6700 EXTENDED_LIMITS -327.6800 327.6700 DEPOSIT ABSOLUTE /end AXIS_DESCR
/end CHARACTERISTIC
/begin CHARACTERISTIC EngPrt_facOvhtPrv_MAP "Überhitzungsschutz-Kennfeld" MAP 0x8003AD80 Map_Xs16Ys16Ws16 3.999878 Fact 0.00 3.999878 EXTENDED_LIMITS -4.000000 3.999878
 /begin AXIS_DESCR STD_AXIS EngPrt_tEngDaFld_mp Temp_Cels 7 -3549.940 3003.560 DEPOSIT ABSOLUTE /end AXIS_DESCR
 /begin AXIS_DESCR STD_AXIS VehV_v Vel 7 0.00 327.6700 EXTENDED_LIMITS -327.6800 327.6700 DEPOSIT ABSOLUTE /end AXIS_DESCR
/end CHARACTERISTIC
/begin CHARACTERISTIC EngPrt_facT31Ovht_MAP "" MAP 0x8003AE02 Map_Xs16Ys16Ws16 3.999878 Fact 0.00 3.999878 EXTENDED_LIMITS -4.000000 3.999878
 /begin AXIS_DESCR STD_AXIS Epm_nEng EngN 4 20.00000 10000.00 EXTENDED_LIMITS -16384.00 16383.50 DEPOSIT ABSOLUTE /end AXIS_DESCR
 /begin AXIS_DESCR STD_AXIS EngPrt_pDesMinT31Ovht_mp Pres_hPa 4 0.00 3500.000 EXTENDED_LIMITS -32768.00 32767.00 DEPOSIT ABSOLUTE /end AXIS_DESCR
/end CHARACTERISTIC
/begin CHARACTERISTIC EngPrt_factCACDsPrv_CUR "" CURVE 0x8003AE36 Cur_Xs16Ws16 4.000000 Fact 0.00 4.000000 EXTENDED_LIMITS -4.000000 3.999878
 /begin AXIS_DESCR STD_AXIS Air_tCACDs Temp_Cels 8 -100.1400 199.8600 EXTENDED_LIMITS -3549.940 3003.560 DEPOSIT ABSOLUTE /end AXIS_DESCR
/end CHARACTERISTIC
/begin CHARACTERISTIC EngPrt_ITrqLimKiNeg_C "I-Verstärkung für negativ signale für torque" VALUE 0x8003AE58 Kw_Ws32 1.99954956770 Ki_Temp2Trq -0.999774783850 0.999774783850 FORMAT "%13.11" EXTENDED_LIMITS -1000000.00000 999999.999534 /end CHARACTERISTIC
/begin CHARACTERISTIC EngPrt_ITrqLimKiPos_C "I-Verstärkung für positiv signale für torque" VALUE 0x8003AE5C Kw_Ws32 1.99954956770 Ki_Temp2Trq -0.999774783850 0.999774783850 FORMAT "%13.11" EXTENDED_LIMITS -1000000.00000 999999.999534 /end CHARACTERISTIC
/begin CHARACTERISTIC EngPrt_ITrqLimKi_C "I-Verstärkung für torque" VALUE 0x8003AE60 Kw_Ws32 1.99954956770 Ki_Temp2Trq -0.999774783850 0.999774783850 FORMAT "%13.11" EXTENDED_LIMITS -1000000.00000 999999.999534 /end CHARACTERISTIC
/begin CHARACTERISTIC EngPrt_nOvrSpd_C "Schwelle für Überdrehzahlerkennung" VALUE 0x8003A5AC Val_Ws16 6000.000 EngN 0.00 6000.000 EXTENDED_LIMITS -16384.00 16383.50 /end CHARACTERISTIC
/begin CHARACTERISTIC EngPrt_nThrClsdHi_C "" VALUE 0x8003A5AE Val_Ws16 6000.000 EngN 0.00 6000.000 EXTENDED_LIMITS -16384.00 16383.50 /end CHARACTERISTIC
/begin CHARACTERISTIC EngPrt_nThrClsdLo_C "" VALUE 0x8003A5B0 Val_Ws16 6000.000 EngN 0.00 6000.000 EXTENDED_LIMITS -16384.00 16383.50 /end CHARACTERISTIC
/begin CHARACTERISTIC EngPrt_nTrqShutOff_C "Drehzahlschwelle" VALUE 0x8003A5A0 Kw_Ws16 6000.000 EngN 0.00 6000.000 EXTENDED_LIMITS -16384.00 16383.50 /end CHARACTERISTIC
/begin CHARACTERISTIC EngPrt_numEngTempOvhtPrv_C "Motorverhinderung durch Überhitzung" VALUE 0x8003AE64 Val_Wu8 0.00 EngTempFldSel 0.00 0.00 FORMAT "%13.2" EXTENDED_LIMITS 0.00 3.00000000000 /end CHARACTERISTIC
/begin CHARACTERISTIC EngPrt_pAPSPrvDfl_C "Default-Wert bei Ausfall des Atmosphärendrucksensors" VALUE 0x8003AE66 Kw_Ws16 3500.000 Pres_hPa 0.00 3500.000 EXTENDED_LIMITS -32768.00 32767.00 /end CHARACTERISTIC
/begin CHARACTERISTIC EngPrt_PTrqLimKpNeg_C "P-Verstärkung für negativ signale für torque" VALUE 0x8003AE68 Kw_Ws32 10.0000000000 Kp_Temp2Trq -5.00000000000 5.00000000000 FORMAT "%13.11" EXTENDED_LIMITS -65536.0000000 65535.9999695 /end CHARACTERISTIC
/begin CHARACTERISTIC EngPrt_PTrqLimKpPos_C "P-Verstärkung für positiv signale für torque" VALUE 0x8003AE6C Kw_Ws32 10.0000000000 Kp_Temp2Trq -5.00000000000 5.00000000000 FORMAT "%13.11" EXTENDED_LIMITS -65536.0000000 65535.9999695 /end CHARACTERISTIC
/begin CHARACTERISTIC EngPrt_PTrqLimKp_C "P-Verstärkung für torque" VALUE 0x8003AE70 Kw_Ws32 10.0000000000 Kp_Temp2Trq -5.00000000000 5.00000000000 FORMAT "%13.11" EXTENDED_LIMITS -65536.0000000 65535.9999695 /end CHARACTERISTIC
/begin CHARACTERISTIC EngPrt_rAPPThrClsdHi_C "" VALUE 0x8003A5B2 Val_Ws16 100.0000 Prc 0.00 100.0000 EXTENDED_LIMITS -400.0000 399.9878 /end CHARACTERISTIC
/begin CHARACTERISTIC EngPrt_rAPPThrClsdLo_C "" VALUE 0x8003A5B4 Val_Ws16 100.0000 Prc 0.00 100.0000 EXTENDED_LIMITS -400.0000 399.9878 /end CHARACTERISTIC
/begin CHARACTERISTIC EngPrt_RmpCBLim.Pos_C "/" VALUE 0x8003A624 Kw_Ws32 3276794.99817 RmpTrq 5.00030517578 3276799.99847 EXTENDED_LIMITS -3276800.00000 3276799.99847 /end CHARACTERISTIC
/begin CHARACTERISTIC EngPrt_RmpCBLim.Neg_C "/" VALUE 0x8003A628 Kw_Ws32 3276794.99817 RmpTrq 5.00030517578 3276799.99847 EXTENDED_LIMITS -3276800.00000 3276799.99847 /end CHARACTERISTIC
/begin CHARACTERISTIC EngPrt_RmpNLim.Pos_C "/" VALUE 0x8003A62C Kw_Ws32 3276794.99817 RmpTrq 5.00030517578 3276799.99847 EXTENDED_LIMITS -3276800.00000 3276799.99847 /end CHARACTERISTIC
/begin CHARACTERISTIC EngPrt_RmpNLim.Neg_C "/" VALUE 0x8003A630 Kw_Ws32 3276794.99817 RmpTrq 5.00030517578 3276799.99847 EXTENDED_LIMITS -3276800.00000 3276799.99847 /end CHARACTERISTIC
/begin CHARACTERISTIC EngPrt_RmpTrqLim.Pos_C "/" VALUE 0x8003A634 Kw_Ws32 3276799.99847 RmpTrq 0.00 3276799.99847 EXTENDED_LIMITS -3276800.00000 3276799.99847 /end CHARACTERISTIC
/begin CHARACTERISTIC EngPrt_RmpTrqLim.Neg_C "/" VALUE 0x8003A638 Kw_Ws32 3276799.99847 RmpTrq 0.00 3276799.99847 EXTENDED_LIMITS -3276800.00000 3276799.99847 /end CHARACTERISTIC
/begin CHARACTERISTIC EngPrt_rVnDAMax_C "Maximum v/n Verhältnis" VALUE 0x8003A63C Kw_Ws16 0.3276700 VelToN 0.00 0.3276700 FORMAT "%9.7" EXTENDED_LIMITS -0.3276800 0.3276700 /end CHARACTERISTIC
/begin CHARACTERISTIC EngPrt_rVnDAMin_C "Minimum v/n Verhältnis" VALUE 0x8003A63E Kw_Ws16 0.3276700 VelToN 0.00 0.3276700 FORMAT "%9.7" EXTENDED_LIMITS -0.3276800 0.3276700 /end CHARACTERISTIC
/begin CHARACTERISTIC EngPrt_rVnTrqMax_C "Maximum v/n Verhältnis)" VALUE 0x8003A640 Kw_Ws16 0.3276700 VelToN 0.00 0.3276700 FORMAT "%9.7" EXTENDED_LIMITS -0.3276800 0.3276700 /end CHARACTERISTIC
/begin CHARACTERISTIC EngPrt_rVnTrqMin_C "Minimum v/n Verhältnis" VALUE 0x8003A642 Kw_Ws16 0.3276700 VelToN 0.00 0.3276700 FORMAT "%9.7" EXTENDED_LIMITS -0.3276800 0.3276700 /end CHARACTERISTIC
/begin CHARACTERISTIC EngPrt_stOvhtPrtEOMMsk_CA "" VAL_BLK 0x8003AE74 ValA_Wu32 4294967295.00 OneToOne 0.00 4294967295.00 NUMBER 1 /end CHARACTERISTIC
/begin CHARACTERISTIC EngPrt_stTrailerErr_C "Default-Wert bei Ausfall des Anhängers" VALUE 0x8003AE78 Val_Wu8 255.0 OneToOne 0.00 255.0 /end CHARACTERISTIC
/begin CHARACTERISTIC EngPrt_swtDebOn_C "" VALUE 0x8003A5A2 Kw_Wu8 1.000 OneToOne 0.00 1.000 EXTENDED_LIMITS 0.00 255.0 /end CHARACTERISTIC
/begin CHARACTERISTIC EngPrt_swtT31PrtAct_C "Schalter zur T31-Schutz Deaktivierung" VALUE 0x8003AE79 Kw_Wu8 1.000 OneToOne 0.00 1.000 EXTENDED_LIMITS 0.00 255.0 /end CHARACTERISTIC
/begin CHARACTERISTIC EngPrt_swtT31PrtReplValAct_C "" VALUE 0x8003AE7A Kw_Wu8 1.000 OneToOne 0.00 1.000 EXTENDED_LIMITS 0.00 255.0 /end CHARACTERISTIC
/begin CHARACTERISTIC EngPrt_swtT31_C "Schalter zur PT1- Eingang auswählen" VALUE 0x8003AE7B Kw_Wu8 1.000 OneToOne 0.00 1.000 EXTENDED_LIMITS 0.00 255.0 /end CHARACTERISTIC
/begin CHARACTERISTIC EngPrt_tiFWOsc_C "" VALUE 0x8003A5A4 Kw_Ws32 6000.00000000 Time_ms 0.00 6000.00000000 EXTENDED_LIMITS -21474836480.0 21474836470.0 /end CHARACTERISTIC
/begin CHARACTERISTIC EngPrt_tInit_C "Initialisierungswert des PT1-Gliedes" VALUE 0x8003AE7C Kw_Ws16 6553.500 Temp_Cels -3549.940 3003.560 /end CHARACTERISTIC
/begin CHARACTERISTIC EngPrt_tiNoFWOsc_C "" VALUE 0x8003A5A8 Kw_Ws32 6000.00000000 Time_ms 0.00 6000.00000000 EXTENDED_LIMITS -21474836480.0 21474836470.0 /end CHARACTERISTIC
/begin CHARACTERISTIC EngPrt_tiT31PT1_C "Zeitkonstante für EngPrt_t31Flt_mp" VALUE 0x8003AE80 Kw_Ws32 14017.375782 TimeDelay_ms 999.99238556 15017.368168 FORMAT "%12.6" EXTENDED_LIMITS 0.0020000000009 4294967.2960 /end CHARACTERISTIC
/begin CHARACTERISTIC EngPrt_tiThrClsd_C "" VALUE 0x8003A5B6 Val_Wu16 65540.00 Time_ms 0.00 65540.00 EXTENDED_LIMITS 0.00 655350.0 /end CHARACTERISTIC
/begin CHARACTERISTIC EngPrt_tiThrOpn_C "" VALUE 0x8003A5B8 Val_Wu16 65540.00 Time_ms 0.00 65540.00 EXTENDED_LIMITS 0.00 655350.0 /end CHARACTERISTIC
/begin CHARACTERISTIC EngPrt_tiTOvhtThresPT1_C "" VALUE 0x8003AE84 Kw_Ws32 14017.375782 TimeDelay_ms 999.99238556 15017.368168 FORMAT "%12.6" EXTENDED_LIMITS 0.0020000000009 4294967.2960 /end CHARACTERISTIC
/begin CHARACTERISTIC EngPrt_tOvhtT31Lim_C "Heilschwelle Abgastemperaturabhängiger Motorschutz" VALUE 0x8003AE88 Kw_Ws16 1000.000 Temp_Cels -0.04000000 999.9600 EXTENDED_LIMITS -3549.940 3003.560 /end CHARACTERISTIC
/begin CHARACTERISTIC EngPrt_tOvhtT40Lim_C "Ausgleich-Wert für Temperatur von OxiCatUs" VALUE 0x8003AE8A Kw_Ws16 1000.000 Temp_Cels -0.04000000 999.9600 EXTENDED_LIMITS -3549.940 3003.560 /end CHARACTERISTIC
/begin CHARACTERISTIC EngPrt_trqCBLim_MAP "Anfahrdremomentenbegrenzungskennlinie bei geöffnetem Verdichterbypass" MAP 0x8003A644 Map_Xs16Ys16Ws16 6553.500 Trq -3276.800 3276.700
 /begin AXIS_DESCR STD_AXIS Epm_nEng EngN 16 -16384.00 16383.50 DEPOSIT ABSOLUTE /end AXIS_DESCR
 /begin AXIS_DESCR STD_AXIS CodVar_stTrqInr OneToOne 8 0.00 255.0 DEPOSIT ABSOLUTE /end AXIS_DESCR
/end CHARACTERISTIC
/begin CHARACTERISTIC EngPrt_trqLimDA_CUR "Anfahrdrehmomentenbegrenzungskennlinie" CURVE 0x8003A778 Kl_Xs16_Ws16 3276.700 Trq 0.00 3276.700 EXTENDED_LIMITS -3276.800 3276.700
 /begin AXIS_DESCR STD_AXIS Epm_nEng EngN 21 0.00 16383.50 EXTENDED_LIMITS -16384.00 16383.50 DEPOSIT ABSOLUTE /end AXIS_DESCR
/end CHARACTERISTIC
/begin CHARACTERISTIC EngPrt_trqLimDiffOvhtMax_C "obere Grenze für PI -Regler (Überhitzungsschutz)" VALUE 0x8003AE8C Kw_Ws16 1000.000 Trq 0.00 1000.000 EXTENDED_LIMITS -3276.800 3276.700 /end CHARACTERISTIC
/begin CHARACTERISTIC EngPrt_trqLimDiffOvhtMin_MAP "" MAP 0x8003AE8E Map_Xs16Ys16Ws16 250.0000 Trq -250.0000 0.00 EXTENDED_LIMITS -3276.800 3276.700
 /begin AXIS_DESCR STD_AXIS Epm_nEng EngN 4 20.00000 10000.00 EXTENDED_LIMITS -16384.00 16383.50 DEPOSIT ABSOLUTE /end AXIS_DESCR
 /begin AXIS_DESCR STD_AXIS InjCtl_qSetUnBal InjMass 4 0.00 327.6700 EXTENDED_LIMITS -327.6800 327.6700 DEPOSIT ABSOLUTE /end AXIS_DESCR
/end CHARACTERISTIC
/begin CHARACTERISTIC EngPrt_trqLim_MAP "Anfahrdrehmomentenbegrenzungskennlinie bei geschlossenem Verdichterbypass" MAP 0x8003A7CE Map_Xs16Ys16Ws16 3276.700 Trq 0.00 3276.700 EXTENDED_LIMITS -3276.800 3276.700
 /begin AXIS_DESCR STD_AXIS Epm_nEng EngN 21 0.00 16383.50 EXTENDED_LIMITS -16384.00 16383.50 DEPOSIT ABSOLUTE /end AXIS_DESCR
 /begin AXIS_DESCR STD_AXIS CodVar_stTrqInr OneToOne 8 0.00 255.0 DEPOSIT ABSOLUTE /end AXIS_DESCR
/end CHARACTERISTIC
/begin CHARACTERISTIC EngPrt_trqNCor_CUR "Drehzahlabhängige Momentenkorrektur" CURVE 0x8003A95C Kl_Xs16_Ws16 3276.700 Trq 0.00 3276.700 EXTENDED_LIMITS -3276.800 3276.700
 /begin AXIS_DESCR STD_AXIS Epm_nEng EngN 21 0.00 16383.50 EXTENDED_LIMITS -16384.00 16383.50 DEPOSIT ABSOLUTE /end AXIS_DESCR
/end CHARACTERISTIC
/begin CHARACTERISTIC EngPrt_trqNLimSpr_CUR "Kennlinie für Motordrehzahlbegrenzung bei Systemfehler (als Begrenzungsmoment)" CURVE 0x8003A9B2 Kl_Xs16_Ws16 3276.700 Trq 0.00 3276.700 EXTENDED_LIMITS -3276.800 3276.700
 /begin AXIS_DESCR STD_AXIS Epm_nEng EngN 10 0.00 16383.50 EXTENDED_LIMITS -16384.00 16383.50 DEPOSIT ABSOLUTE /end AXIS_DESCR
/end CHARACTERISTIC
/begin CHARACTERISTIC EngPrt_trqNLim_CUR "Kennlinie für Drehzahlbegrenzung im Normalbetrieb (inneres Motormoment)" CURVE 0x8003A9DC Cur_Xs16Ws16 3276.700 Trq 0.00 3276.700 EXTENDED_LIMITS -3276.800 3276.700
 /begin AXIS_DESCR STD_AXIS Epm_nEng EngN 21 0.00 16383.50 EXTENDED_LIMITS -16384.00 16383.50 DEPOSIT ABSOLUTE /end AXIS_DESCR
/end CHARACTERISTIC
/begin CHARACTERISTIC EngPrt_tT31PrtOfs_CUR "" CURVE 0x8003AEC2 Cur_Xs16Ws16 130.0000 TempDiff_Cels -30.00000 100.0000 FORMAT "%8.4" EXTENDED_LIMITS -3276.800 3276.700
 /begin AXIS_DESCR STD_AXIS EnvP_p Pres_hPa 4 0.00 3500.000 EXTENDED_LIMITS -32768.00 32767.00 DEPOSIT ABSOLUTE /end AXIS_DESCR
/end CHARACTERISTIC
/begin CHARACTERISTIC EngPrt_tTrqLimIWinNeg_C "Negativ Fensterbegrenzung des Integrators" VALUE 0x8003AED4 Kw_Ws32 220.000000000 TempDiff_Cels -20.0000000000 200.000000000 FORMAT "%13.9" EXTENDED_LIMITS -214748364.800 214748364.700 /end CHARACTERISTIC
/begin CHARACTERISTIC EngPrt_tTrqLimIWinPos_C "Positiv Fensterbegrenzung des Integrators" VALUE 0x8003AED8 Kw_Ws32 220.000000000 TempDiff_Cels -20.0000000000 200.000000000 FORMAT "%13.9" EXTENDED_LIMITS -214748364.800 214748364.700 /end CHARACTERISTIC
/begin CHARACTERISTIC EngPrt_tTrqLimPWinNeg_C "Negativ Fensterbegrenzung (P-Glied)" VALUE 0x8003AEDC Kw_Ws32 220.000000000 TempDiff_Cels -20.0000000000 200.000000000 FORMAT "%13.9" EXTENDED_LIMITS -214748364.800 214748364.700 /end CHARACTERISTIC
/begin CHARACTERISTIC EngPrt_tTrqLimPWinPos_C "Positiv Fensterbegrenzung (P-Glied)" VALUE 0x8003AEE0 Kw_Ws32 220.000000000 TempDiff_Cels -20.0000000000 200.000000000 FORMAT "%13.9" EXTENDED_LIMITS -214748364.800 214748364.700 /end CHARACTERISTIC
/begin CHARACTERISTIC EngReq_facRmpVal_CUR "Kennlinie für Rampenfaktor Umschaltrampe" CURVE 0x8003AEE4 Cur_Xs16Ws16 1.000000 CoEOMSwt_S16 0.00 1.000000 FORMAT "%8.6" EXTENDED_LIMITS -2.000000 1.999939
 /begin AXIS_DESCR STD_AXIS CoEOM_facRmpVal CoEOMSwt_S16 11 0.00 1.000000 FORMAT "%8.6" EXTENDED_LIMITS -2.000000 1.999939 DEPOSIT ABSOLUTE /end AXIS_DESCR
/end CHARACTERISTIC
/begin CHARACTERISTIC EngReq_SlpLim.Pos_C "Anstiegsbegrenzungsrampe/" VALUE 0x8003AF14 Kw_Ws32 3276799.99847 RmpTrq 0.00 3276799.99847 EXTENDED_LIMITS -3276800.00000 3276799.99847 /end CHARACTERISTIC
/begin CHARACTERISTIC EngReq_SlpLim.Neg_C "Anstiegsbegrenzungsrampe/" VALUE 0x8003AF18 Kw_Ws32 3276799.99847 RmpTrq 0.00 3276799.99847 EXTENDED_LIMITS -3276800.00000 3276799.99847 /end CHARACTERISTIC
/begin CHARACTERISTIC EngSpd_Pwm.tiPer_C "Software Struktur für Kalibrierungsdaten für das PWM Signal des TD Signals/" VALUE 0x8003AF1C Kw_Ws16 9.900000 Period 0.1000000 10.00000 FORMAT "%8.5" EXTENDED_LIMITS -3276.800 3276.700 /end CHARACTERISTIC
/begin CHARACTERISTIC EngSpd_Pwm.stLvl_C "Software Struktur für Kalibrierungsdaten für das PWM Signal des TD Signals/" VALUE 0x8003AF1E Kw_Wu8 1.000 OneToOne 0.00 1.000 EXTENDED_LIMITS 0.00 255.0 /end CHARACTERISTIC
/begin CHARACTERISTIC EngSpd_Pwm.rMaxDty_C "Software Struktur für Kalibrierungsdaten für das PWM Signal des TD Signals/" VALUE 0x8003AF20 Kw_Ws16 100.0000 DtyCyc 0.00 100.0000 EXTENDED_LIMITS -327.6800 327.6700 /end CHARACTERISTIC
/begin CHARACTERISTIC EngSpd_Pwm.rPerUn_C "Software Struktur für Kalibrierungsdaten für das PWM Signal des TD Signals/" VALUE 0x8003AF22 Kw_Ws16 3276.700 Period 0.00 3276.700 FORMAT "%8.3" EXTENDED_LIMITS -3276.800 3276.700 /end CHARACTERISTIC
/begin CHARACTERISTIC EngSpd_Pwm.tiPh_C "Software Struktur für Kalibrierungsdaten für das PWM Signal des TD Signals/" VALUE 0x8003AF24 Kw_Ws16 65535.00 OneToOne -32768.00 32767.00 /end CHARACTERISTIC
/begin CHARACTERISTIC EngSpd_PwmOut.rMin_C "/" VALUE 0x8003AF26 Kw_Ws16 100.0000 DtyCyc 0.00 100.0000 EXTENDED_LIMITS -327.6800 327.6700 /end CHARACTERISTIC
/begin CHARACTERISTIC EngSpd_PwmOut.rMax_C "/" VALUE 0x8003AF28 Kw_Ws16 100.0000 DtyCyc 0.00 100.0000 EXTENDED_LIMITS -327.6800 327.6700 /end CHARACTERISTIC
/begin CHARACTERISTIC EngSpd_PwmOut.tiBtwTstSCB_C "/" VALUE 0x8003AF2A Kw_Ws16 1000.000 Time_ms 0.00 1000.000 EXTENDED_LIMITS -327680.0 327670.0 /end CHARACTERISTIC
/begin CHARACTERISTIC EngSpd_PwmOut.tiBtwTstOT_C "/" VALUE 0x8003AF2C Kw_Ws16 327.6700 Time_s 0.00 327.6700 EXTENDED_LIMITS -327.6800 327.6700 /end CHARACTERISTIC
/begin CHARACTERISTIC EngSpd_PwmOut.numTstMax_C "/" VALUE 0x8003AF2E Kw_Wu16 65535.00 OneToOne 0.00 65535.00 /end CHARACTERISTIC
/begin CHARACTERISTIC EngSpd_PwmOut.swtBattCor_C "/" VALUE 0x8003AF30 Kw_Wu8 0.00 OneToOne 0.00 0.00 EXTENDED_LIMITS 0.00 255.0 /end CHARACTERISTIC
/begin CHARACTERISTIC EngSpd_PwmOut.swtPsInv_C "/" VALUE 0x8003AF31 Kw_Wu8 255.0 OneToOne 0.00 255.0 /end CHARACTERISTIC
/begin CHARACTERISTIC EngSpd_rPs_C "Ausgangstastverhältnis, wenn Endstufe deaktiviert ist." VALUE 0x8003AF32 Val_Ws16 655.3500 DtyCyc -327.6800 327.6700 /end CHARACTERISTIC
/begin CHARACTERISTIC EngSpd_stPsDiaDisbl_C "Applikationsparameter zur Deaktivierung der Endstufendiagnose während verschiedener Motorzustände und Batteriebedingungen." VALUE 0x8003AF34 Val_Wu8 255.0 OneToOne 0.00 255.0 /end CHARACTERISTIC
/begin CHARACTERISTIC EngSpd_stPsDisbl_C "Applikationsparameter zur Deaktivierung der Endstufe während verschiedener Motorzustände und Batteriebedingungen." VALUE 0x8003AF35 Val_Wu8 255.0 OneToOne 0.00 255.0 /end CHARACTERISTIC
/begin CHARACTERISTIC EngStA_DigOut.tiBtwTstSCB_C "/" VALUE 0x8003AF36 Kw_Ws16 1000.000 Time_ms 0.00 1000.000 EXTENDED_LIMITS -327680.0 327670.0 /end CHARACTERISTIC
/begin CHARACTERISTIC EngStA_DigOut.tiBtwTstOT_C "/" VALUE 0x8003AF38 Kw_Ws16 1000.000 Time_s 0.00 1000.000 EXTENDED_LIMITS -327.6800 327.6700 /end CHARACTERISTIC
/begin CHARACTERISTIC EngStA_DigOut.numTstMax_C "/" VALUE 0x8003AF3A Kw_Wu16 65535.00 OneToOne 0.00 65535.00 /end CHARACTERISTIC
/begin CHARACTERISTIC EngStA_stPsDiaDisbl_C "" VALUE 0x8003AF3C Val_Wu8 255.0 OneToOne 0.00 255.0 /end CHARACTERISTIC
/begin CHARACTERISTIC EngStA_stPsDisbl_C "" VALUE 0x8003AF3D Val_Wu8 255.0 OneToOne 0.00 255.0 /end CHARACTERISTIC
/begin CHARACTERISTIC EngTrqPtd_nEngMin_C "Drehzahlschwelle oberhalb der eine Begrenzung der Ebene 1 aus der Überwachung erfolgen kann" VALUE 0x8003AF48 Val_Ws16 32767.50 EngN -16384.00 16383.50 /end CHARACTERISTIC
/begin CHARACTERISTIC EngTrqPtd_rAppRls_C "Volllastschwelle zum Öffnen der Momentenbegrenzung aus der Überwachung" VALUE 0x8003B098 Val_Ws16 799.9878 Prc -400.0000 399.9878 /end CHARACTERISTIC
/begin CHARACTERISTIC EngTrqPtd_rTrqNOfs_MAP "Kennfeld zur Bedatung des Ebene 1 Offsets der Momentenbegrenzung (n-synchrone Berechnung)" MAP 0x8003AF4A Map_Xs16Ys16Ws16 99.60938 Mo_r_prc_q0p39 0.00 99.60938 FORMAT "%8.5" EXTENDED_LIMITS -12800.00 12799.61
 /begin AXIS_DESCR STD_AXIS EngTrqPtd_rTrqNPtd_mp Mo_r_prc_q0p39 8 0.00 99.61 FORMAT "%5.2" DEPOSIT ABSOLUTE /end AXIS_DESCR
 /begin AXIS_DESCR STD_AXIS Epm_nEng EngN 8 -16384.00 16383.50 DEPOSIT ABSOLUTE /end AXIS_DESCR
/end CHARACTERISTIC
/begin CHARACTERISTIC EngTrqPtd_rTrqTOfs_MAP "Kennfeld zur Bedatung des Ebene 1 Offsets der Momentenbegrenzung (t-synchrone Berechnung)" MAP 0x8003AFEE Map_Xs16Ys16Ws16 99.60938 Mo_r_prc_q0p39 0.00 99.60938 FORMAT "%8.5" EXTENDED_LIMITS -12800.00 12799.61
 /begin AXIS_DESCR STD_AXIS EngTrqPtd_rTrqTPtd_mp Mo_r_prc_q0p39 8 0.00 99.61 FORMAT "%5.2" DEPOSIT ABSOLUTE /end AXIS_DESCR
 /begin AXIS_DESCR STD_AXIS Epm_nEng EngN 8 -16384.00 16383.50 DEPOSIT ABSOLUTE /end AXIS_DESCR
/end CHARACTERISTIC
/begin CHARACTERISTIC EngTrqPtd_tiPthSetDeb_C "Entprellzeit der Ebene 1 motorseitigen Sollwertpfadbegrenzung" VALUE 0x8003B094 Val_Ws32 4294967295.00 TimeDT -2147483648.00 2147483647.00 FORMAT "%13.2" /end CHARACTERISTIC
/begin CHARACTERISTIC EngTrqPtd_tiT1_C "PT1 Filterzeitkonstante der Ruckeldämpferüberwachung der Ebene 1 Begrenzung" VALUE 0x8003AF40 Val_Ws32 4294.9672940 TimeDelay_s 0.000002000000001 4294.9672960 FORMAT "%12.7" /end CHARACTERISTIC
/begin CHARACTERISTIC EngTrqPtd_trqFltMax_C "Maximaler Stellbereich der gefilterten Ruckeldämpferstellgröße der Ebene 1 Begrenzung" VALUE 0x8003AF44 Val_Ws16 200.0000 Mo_trq_nm_q0p1 0.00 200.0000 FORMAT "%8.4" EXTENDED_LIMITS -3276.800 3276.700 /end CHARACTERISTIC
/begin CHARACTERISTIC EngTrqPtd_trqMax_C "Maximaler Stellbereich der Ruckeldämpferstellgröße der Ebene 1 Begrenzung" VALUE 0x8003AF46 Val_Ws16 200.0000 Mo_trq_nm_q0p1 0.00 200.0000 FORMAT "%8.4" EXTENDED_LIMITS -3276.800 3276.700 /end CHARACTERISTIC
/begin CHARACTERISTIC EngTrqPtd_trqMax_MAP "Maximal zulässige Moment bei aktiver Schaltdrehzahlregler Anforderung" MAP 0x8003B09A Map_Xs16Ys16Ws16 6553.500 Mo_trq_nm_q0p1 -3276.800 3276.700 FORMAT "%8.3"
 /begin AXIS_DESCR STD_AXIS Epm_nEng EngN 6 -16384.00 16383.50 DEPOSIT ABSOLUTE /end AXIS_DESCR
 /begin AXIS_DESCR STD_AXIS EngDa_tEng Temp_Cels 6 -3549.940 3003.560 DEPOSIT ABSOLUTE /end AXIS_DESCR
/end CHARACTERISTIC
/begin CHARACTERISTIC EngTrqPtd_trqSpdGPtd_MAP "zulässiges Moment des Drehzahlreglers abhängig von Drehzahl und Motortemperatur" MAP 0x8003B0FE Map_Xs16Ys16Ws16 6553.500 Mo_trq_nm_q0p1 -3276.800 3276.700 FORMAT "%8.3"
 /begin AXIS_DESCR STD_AXIS Epm_nEng EngN 6 -16384.00 16383.50 DEPOSIT ABSOLUTE /end AXIS_DESCR
 /begin AXIS_DESCR STD_AXIS EngDa_tEng Temp_Cels 6 -3549.940 3003.560 DEPOSIT ABSOLUTE /end AXIS_DESCR
/end CHARACTERISTIC
/begin CHARACTERISTIC EnvP_nLimHigh_C "Hochsteschwelle der Motordrehzahl, oberhalb der der Umgebungsdruck aus dem Ladedruck nicht modelliert werden können" VALUE 0x8003B180 Val_Ws16 6000.000 EngN 0.00 6000.000 EXTENDED_LIMITS -16384.00 16383.50 /end CHARACTERISTIC
/begin CHARACTERISTIC EnvP_pCorr_MAP "Kennfeld der aus Ladedruck berechneten Umgebungstemperaturkorrektur" MAP 0x8003B182 Map_Xs16Ys16Ws16 3850.000 Pres_hPa -350.0000 3500.000 EXTENDED_LIMITS -32768.00 32767.00
 /begin AXIS_DESCR STD_AXIS Epm_nEng EngN 2 0.00 6000.000 EXTENDED_LIMITS -16384.00 16383.50 DEPOSIT ABSOLUTE /end AXIS_DESCR
 /begin AXIS_DESCR STD_AXIS Epm_nEngDiff EngN 2 -6000.000 6000.000 EXTENDED_LIMITS -16384.00 16383.50 DEPOSIT ABSOLUTE /end AXIS_DESCR
/end CHARACTERISTIC
/begin CHARACTERISTIC EnvP_pTransf_CUR "Umwandlungsskennlinie für Umgebungsdruck" CURVE 0x8003B162 Cur_Xs16Ws16 3500.000 Pres_hPa 0.00 3500.000 EXTENDED_LIMITS -32768.00 32767.00
 /begin AXIS_DESCR STD_AXIS EnvP_uRaw Volt 2 0.00 5000.000 EXTENDED_LIMITS -6553.600 6553.400 DEPOSIT ABSOLUTE /end AXIS_DESCR
/end CHARACTERISTIC
/begin CHARACTERISTIC EnvP_RmpSlp.Pos_C "/" VALUE 0x8003B170 Kw_Ws32 32767949.9817 RmpPres_hPa 50.0030517578 32767999.9847 FORMAT "%13.4" EXTENDED_LIMITS -32768000.0000 32767999.9847 /end CHARACTERISTIC
/begin CHARACTERISTIC EnvP_RmpSlp.Neg_C "/" VALUE 0x8003B174 Kw_Ws32 32767949.9817 RmpPres_hPa 50.0030517578 32767999.9847 FORMAT "%13.4" EXTENDED_LIMITS -32768000.0000 32767999.9847 /end CHARACTERISTIC
/begin CHARACTERISTIC EnvP_SRC.uMin_C "/" VALUE 0x8003B16C Kw_Ws16 5200.000 Volt 0.00 5200.000 EXTENDED_LIMITS -6553.600 6553.400 /end CHARACTERISTIC
/begin CHARACTERISTIC EnvP_SRC.uMax_C "/" VALUE 0x8003B16E Kw_Ws16 5200.000 Volt 0.00 5200.000 EXTENDED_LIMITS -6553.600 6553.400 /end CHARACTERISTIC
/begin CHARACTERISTIC EnvP_swtSensPres_C "Schalter zur Festlegung von dem Vorhandensein oder Nichtvorhandensein des Umgebungsdrucksensors" VALUE 0x8003B178 Val_Wu8 1.000 OneToOne 0.00 1.000 EXTENDED_LIMITS 0.00 255.0 /end CHARACTERISTIC
/begin CHARACTERISTIC EnvP_tiDel_C "Zeitverzögerung zur Sperrung der Modellberechnung, nachdem die Motordrehzahl eine höhere Schwelle überschreitet" VALUE 0x8003B196 Val_Wu16 655350.0 Time_ms 0.00 655350.0 /end CHARACTERISTIC
/begin CHARACTERISTIC EnvP_TransStg.Dfl_C "/" VALUE 0x8003B17A Kw_Ws16 3500.000 Pres_hPa 0.00 3500.000 EXTENDED_LIMITS -32768.00 32767.00 /end CHARACTERISTIC
/begin CHARACTERISTIC EnvP_TransStg.stSensId_C "/" VALUE 0x8003B17C Kw_Wu8 255.0 OneToOne 0.00 255.0 /end CHARACTERISTIC
/begin CHARACTERISTIC EnvT_RmpSlp.Pos_C "/" VALUE 0x8003B198 Kw_Ws32 3276798.99750 RmpTemp 1.00097656250 3276799.99847 FORMAT "%13.5" EXTENDED_LIMITS -3276800.00000 3276799.99847 /end CHARACTERISTIC
/begin CHARACTERISTIC EnvT_RmpSlp.Neg_C "/" VALUE 0x8003B19C Kw_Ws32 3276798.99750 RmpTemp 1.00097656250 3276799.99847 FORMAT "%13.5" EXTENDED_LIMITS -3276800.00000 3276799.99847 /end CHARACTERISTIC
/begin CHARACTERISTIC EnvT_tAirCorr_MAP "Kennfeld zur Lufttemperaturberechnung" MAP 0x8003B1A0 Map_Xs16Ys16Ws16 6553.500 Temp_Cels -3549.940 3003.560
 /begin AXIS_DESCR STD_AXIS Air_tCACDs Temp_Cels 8 -3549.940 3003.560 DEPOSIT ABSOLUTE /end AXIS_DESCR
 /begin AXIS_DESCR STD_AXIS Air_pIntkVUs Pres_hPa 8 -32768.00 3500.00 EXTENDED_LIMITS -32768.00 32767.00 DEPOSIT ABSOLUTE /end AXIS_DESCR
/end CHARACTERISTIC
/begin CHARACTERISTIC EnvT_tClntMod_CUR "Kennlinie zur Bewertung des Temperaturwerts aus Kühlmitteltemperatur" CURVE 0x8003B244 Cur_Xs16Ws16 6553.500 Temp_Cels -3549.940 3003.560
 /begin AXIS_DESCR STD_AXIS EnvT_tClntPT1_mp Temp_Cels 8 -3549.940 3003.560 DEPOSIT ABSOLUTE /end AXIS_DESCR
/end CHARACTERISTIC
/begin CHARACTERISTIC EnvT_tiLPFiltPT1_C "PT1-Filterzeitkonstante für Umgebungstemperatur." VALUE 0x8003B268 Val_Ws32 4294.9672940 TimeDelay_s 0.000002000000001 4294.9672960 FORMAT "%12.7" /end CHARACTERISTIC
/begin CHARACTERISTIC EnvT_tiTempAirPT1_C "PT1-Filterzeitkonstante für korrigierte Lufttemperatur." VALUE 0x8003B26C Val_Ws16 4294.8362200 TimeDelay_s 0.13107600012 4294.9672960 FORMAT "%12.7" /end CHARACTERISTIC
/begin CHARACTERISTIC EnvT_tiTempClntPT1_C "PT1-Filterzeitkonstante für Kühlmitteltemperatur." VALUE 0x8003B26E Val_Ws16 4294.8362200 TimeDelay_s 0.13107600012 4294.9672960 FORMAT "%12.7" /end CHARACTERISTIC
/begin CHARACTERISTIC EnvT_TransStg.Dfl_C "/" VALUE 0x8003B270 Kw_Ws16 250.0000 Temp_Cels -50.04000 199.9600 EXTENDED_LIMITS -3549.940 3003.560 /end CHARACTERISTIC
/begin CHARACTERISTIC EnvT_TransStg.stSensId_C "/" VALUE 0x8003B272 Kw_Wu8 255.0 OneToOne 0.00 255.0 /end CHARACTERISTIC
/begin CHARACTERISTIC EpmBCa_facSegTimeAcc_CUR "Faktor um eine Beschleunigung nach einer Testeinspritzung zu erkennen" CURVE 0x8003B274 Cur_Xs16Ws16 5.000000 EpmBCa_FacTstInj 0.00 5.000000 FORMAT "%8.6" EXTENDED_LIMITS -32.76800 32.76700
 /begin AXIS_DESCR STD_AXIS Epm_nEng EngN 3 -16384.00 16383.50 DEPOSIT ABSOLUTE /end AXIS_DESCR
/end CHARACTERISTIC
/begin CHARACTERISTIC EpmBCa_facSegTimeConstHigh_C "Oberer Grenzwert für das Erkennen einer konstanten Drehzahl" VALUE 0x8003B282 Val_Ws16 5.000000 EpmBCa_FacTstInj 0.00 5.000000 FORMAT "%8.6" EXTENDED_LIMITS -32.76800 32.76700 /end CHARACTERISTIC
/begin CHARACTERISTIC EpmBCa_facSegTimeConstLow_C "Unterer Grenzwert für das Erkennen einer konstanten Drehzahl" VALUE 0x8003B284 Val_Ws16 5.000000 EpmBCa_FacTstInj 0.00 5.000000 FORMAT "%8.6" EXTENDED_LIMITS -32.76800 32.76700 /end CHARACTERISTIC
/begin CHARACTERISTIC EpmBCa_nTstInjMax_C "Maximal zulässige Drehzahl bei der noch eine Testeinspritzung programmiert wird" VALUE 0x8003B286 Val_Ws16 32767.50 EngN -16384.00 16383.50 /end CHARACTERISTIC
/begin CHARACTERISTIC EpmBCa_numInjSer_C "Anzahl der Testeinspritzungen in Folge" VALUE 0x8003B288 Val_Wu8 9.000 OneToOne 1.000 10.00 EXTENDED_LIMITS 0.00 255.0 /end CHARACTERISTIC
/begin CHARACTERISTIC EpmBCa_numTstInjMax_C "Maximal zulässige Anzahl an Testeinspritzungen" VALUE 0x8003B28A Val_Wu16 65535.00 OneToOne 0.00 65535.00 /end CHARACTERISTIC
/begin CHARACTERISTIC EpmBCa_phiSegEndOld_C "Segmentende des alten (noch nicht beschleunigten) Segments zur Auswertung einer Beschleunigung nach einer Testeinspritzung" VALUE 0x8003B28C Val_Ws16 1439.978 AngleCrS -720.0000 719.9780 /end CHARACTERISTIC
/begin CHARACTERISTIC EpmBCa_phiSegLen_C "Segmentlänge die zur Berechnung der Segmentzeit der Drehzahlbeschleunigung benötigt wird" VALUE 0x8003B28E Val_Ws16 189.9976 AngleCrS 9.997559 199.9951 EXTENDED_LIMITS -720.0000 719.9780 /end CHARACTERISTIC
/begin AXIS_PTS EpmBCr_nEng_DST "Gruppenstützstellen für die Plausibilisierungskurven eines n+1-Nockenwellen-Geberrades während des Notlauf Kurbelwelle" 0x8003B294 Epm_nEng Axis_Xs16 32767.50 EngN 5 -16384.00 16383.50 FORMAT "%8.2" DEPOSIT ABSOLUTE /end AXIS_PTS
/begin CHARACTERISTIC EpmBCr_phiSync2Seg_C "Winkel zwischen Sync- und Segmentzahn" VALUE 0x8003B2A0 Val_Ws16 180.0000 AngleCrS 0.00 180.0000 EXTENDED_LIMITS -720.0000 719.9780 /end CHARACTERISTIC
/begin CHARACTERISTIC EpmBCr_phiTimeoutInt_C "Winkel bis zum Timeout-Interrupts wenn der Motor abgebremst wird" VALUE 0x8003B290 Val_Ws16 360.0000 AngleCrS 0.00 360.0000 EXTENDED_LIMITS -720.0000 719.9780 /end CHARACTERISTIC
/begin CHARACTERISTIC EpmBCr_phiZero2Sync_CA "Winkel von der 0°-Position bis zur Sync-Marke des Nockenwellengeberrads" VAL_BLK 0x8003B2CA ValA_Ws16 1439.978 AngleCrS -720.0000 719.9780 NUMBER 2 /end CHARACTERISTIC
/begin CHARACTERISTIC EpmBCr_rSeg2SegMax_GCUR "obere Plausibilisierungskurve für das Verhältnis von 2 Segmentzähnen" CURVE 0x8003B2A2 CurG_Ws16 20.00000 Fact100 0.00 20.00000 FORMAT "%8.5" EXTENDED_LIMITS -327.6800 327.6700
 /begin AXIS_DESCR COM_AXIS Epm_nEng EngN 5 -16384.00 16383.50 AXIS_PTS_REF EpmBCr_nEng_DST /end AXIS_DESCR
/end CHARACTERISTIC
/begin CHARACTERISTIC EpmBCr_rSeg2SegMin_GCUR "untere Plausibilisierungskurve für das Verhältnis von 2 Segmentzähnen" CURVE 0x8003B2AC CurG_Ws16 20.00000 Fact100 0.00 20.00000 FORMAT "%8.5" EXTENDED_LIMITS -327.6800 327.6700
 /begin AXIS_DESCR COM_AXIS Epm_nEng EngN 5 -16384.00 16383.50 AXIS_PTS_REF EpmBCr_nEng_DST /end AXIS_DESCR
/end CHARACTERISTIC
/begin CHARACTERISTIC EpmBCr_rSeg2SyncMax_GCUR "obere Plausibilisierungskurve für das Verhältnis von Segment- zu Sync-Zähnen" CURVE 0x8003B2B6 CurG_Ws16 20.00000 Fact100 0.00 20.00000 FORMAT "%8.5" EXTENDED_LIMITS -327.6800 327.6700
 /begin AXIS_DESCR COM_AXIS Epm_nEng EngN 5 -16384.00 16383.50 AXIS_PTS_REF EpmBCr_nEng_DST /end AXIS_DESCR
/end CHARACTERISTIC
/begin CHARACTERISTIC EpmBCr_rSeg2SyncMin_GCUR "untere Plausibilisierungskurve für das Verhältnis von Segment- zu Sync-Zähnen" CURVE 0x8003B2C0 CurG_Ws16 20.00000 Fact100 0.00 20.00000 FORMAT "%8.5" EXTENDED_LIMITS -327.6800 327.6700
 /begin AXIS_DESCR COM_AXIS Epm_nEng EngN 5 -16384.00 16383.50 AXIS_PTS_REF EpmBCr_nEng_DST /end AXIS_DESCR
/end CHARACTERISTIC
/begin CHARACTERISTIC EpmBCr_swtEnable_C "Freigabe Notlauf ohne Kurbelwelle" VALUE 0x8003B292 Val_Wu8 255.0 OneToOne 0.00 255.0 /end CHARACTERISTIC
/begin CHARACTERISTIC EpmCaS_dSegSeries_CA "Reihenfolge der Nockenwellensegmente" VAL_BLK 0x8003B2E8 ValA_Wu8 255.0 OneToOne 0.00 255.0 NUMBER 10 /end CHARACTERISTIC
/begin CHARACTERISTIC EpmCaS_facPlausHigh_GCUR "Faktor für die obere Grenze der Plausibilitätsprüfung des Nockenwellensignals" CURVE 0x8003B2F2 CurG_Ws16 65.53500 EpmCaS_Fac_Plaus -32.76800 32.76700 FORMAT "%8.5"
 /begin AXIS_DESCR COM_AXIS Epm_nEng EngN 3 -16384.00 16383.50 AXIS_PTS_REF EpmCaS_facPlaus_DST /end AXIS_DESCR
/end CHARACTERISTIC
/begin CHARACTERISTIC EpmCaS_facPlausLow_GCUR "Faktor für die untere Grenze der Plausibilitätsprüfung des Nockenwellensignals" CURVE 0x8003B2F8 CurG_Ws16 65.53500 EpmCaS_Fac_Plaus -32.76800 32.76700 FORMAT "%8.5"
 /begin AXIS_DESCR COM_AXIS Epm_nEng EngN 3 -16384.00 16383.50 AXIS_PTS_REF EpmCaS_facPlaus_DST /end AXIS_DESCR
/end CHARACTERISTIC
/begin AXIS_PTS EpmCaS_facPlaus_DST "Stützstellen für die Kennlinien der Plausibilätsprüfung des Nockenwellensignals" 0x8003B2FE Epm_nEng Axis_Xs16 32767.50 EngN 3 -16384.00 16383.50 FORMAT "%8.2" DEPOSIT ABSOLUTE /end AXIS_PTS
/begin CHARACTERISTIC EpmCaS_numEdgeTol_C "Anzahl der zu tolerierenden fehlerhaften NW-Flanken für Diagnose und Winkelversatz" VALUE 0x8003B2CE Val_Wu8 30.00 OneToOne 0.00 30.00 EXTENDED_LIMITS 0.00 255.0 /end CHARACTERISTIC
/begin CHARACTERISTIC EpmCaS_numErrSigDef_C "Schwelle des Entprellzählers für die Defekterkennung bei einer Nockenwellenstörung" VALUE 0x8003B2D0 Val_Wu16 99.98333 CrSRev2CrSInc 0.01666667 100.0000 FORMAT "%8.4" EXTENDED_LIMITS 0.00 1092.250 /end CHARACTERISTIC
/begin CHARACTERISTIC EpmCaS_numErrSigOk_C "Schwelle des Entprellzählers für die Heilung einer erkannten Nockenwellenstörung" VALUE 0x8003B2D2 Val_Wu16 99.98333 CrSRev2CrSInc 0.01666667 100.0000 FORMAT "%8.4" EXTENDED_LIMITS 0.00 1092.250 /end CHARACTERISTIC
/begin CHARACTERISTIC EpmCaS_numNoSigDef_C "Schwelle des Entprellzählers für die Erkennung des Ausfalls eines Nockenwellensignals" VALUE 0x8003B2D4 Val_Wu16 99.98333 CrSRev2CrSInc 0.01666667 100.0000 FORMAT "%8.4" EXTENDED_LIMITS 0.00 1092.250 /end CHARACTERISTIC
/begin CHARACTERISTIC EpmCaS_numOfsErr_C "Anzahl Nockenwellenumdrehung bis Feher DFC_EpmCaS..OfsErr gesetzt wird" VALUE 0x8003B2DA Val_Wu8 255.0 OneToOne 0.00 255.0 /end CHARACTERISTIC
/begin CHARACTERISTIC EpmCaS_numSegSerLst_C "Index des letzten Segments in EpmCaS_dSegSeries" VALUE 0x8003B306 Val_Wu8 255.0 OneToOne 0.00 255.0 /end CHARACTERISTIC
/begin CHARACTERISTIC EpmCaS_phiNCor_CUR "drehzahlabhängiger Winkelkorrekturwert des Nockenwellensignals" CURVE 0x8003B308 Cur_Xs16Ws16 1439.978 AngleCrS -720.0000 719.9780
 /begin AXIS_DESCR STD_AXIS Epm_nEng EngN 6 -16384.00 16383.50 DEPOSIT ABSOLUTE /end AXIS_DESCR
/end CHARACTERISTIC
/begin CHARACTERISTIC EpmCaS_phiOfsMax_C "max. zulässiger Verdrehwinkel zwischen Nockenwelle und Kurbelwelle" VALUE 0x8003B2DC Val_Ws16 1439.978 AngleCrS -720.0000 719.9780 /end CHARACTERISTIC
/begin CHARACTERISTIC EpmCaS_phiOfsMin_C "min. zulässiger Verdrehwinkel zwischen Nockenwelle und Kurbelwelle" VALUE 0x8003B2DE Val_Ws16 1439.978 AngleCrS -720.0000 719.9780 /end CHARACTERISTIC
/begin CHARACTERISTIC EpmCaS_phiOfsTolc_C "Toleranzbereich einer Nockenwellenflanke zur Berechnung der Nockenwellenverdrehung" VALUE 0x8003B2E0 Val_Ws16 1439.978 AngleCrS -720.0000 719.9780 /end CHARACTERISTIC
/begin CHARACTERISTIC EpmCaS_phiSegLenTol_CA "Toleranz für jede Segmentlänge" VAL_BLK 0x8003B322 ValA_Ws16 1439.978 AngleCrS -720.0000 719.9780 NUMBER 10 /end CHARACTERISTIC
/begin CHARACTERISTIC EpmCaS_phiSegLen_CA "Länge der Nockenwellensegmente" VAL_BLK 0x8003B336 ValA_Ws16 1439.978 AngleCrS -720.0000 719.9780 NUMBER 10 /end CHARACTERISTIC
/begin CHARACTERISTIC EpmCaS_phiSegOfs_CA "Winkel zwischen Nullpunkt des Winkelsystems und Beginn von EpmCaS_dSegSeries_C" VAL_BLK 0x8003B34A ValA_Ws16 1439.978 AngleCrS -720.0000 719.9780 NUMBER 1 /end CHARACTERISTIC
/begin AXIS_PTS EpmCaS_phiTempCor05_DST "Stützstellen der Temperaturverteilung für die Winkelkorrekturwerte der Nockenwellen" 0x8003B34C EngDa_tEng Axis_Xs16 6553.500 Temp_Cels 3 -3549.940 3003.560 FORMAT "%8.3" DEPOSIT ABSOLUTE /end AXIS_PTS
/begin CHARACTERISTIC EpmCaS_phiTempCorI1_GCUR "Winkelkorrekturwerte für die erste Einlassnockenwelle" CURVE 0x8003B354 CurG_Ws16 1439.978 AngleCrS -720.0000 719.9780
 /begin AXIS_DESCR COM_AXIS EngDa_tEng Temp_Cels 3 -3549.940 3003.560 AXIS_PTS_REF EpmCaS_phiTempCor05_DST /end AXIS_DESCR
/end CHARACTERISTIC
/begin CHARACTERISTIC EpmCaS_stActEdge_C "Zu erfassende Nockenwellenflanke(n)" VALUE 0x8003B35A Val_Wu8 255.0 OneToOne 0.00 255.0 /end CHARACTERISTIC
/begin CHARACTERISTIC EpmCaS_stDiagMode_C "Abschalten der Nockenwellendiagnose in EPM_MODE_OK , wenn ein Nockenwellenfehler erkannt ist." VALUE 0x8003B2D6 Val_Wu8 255.0 OneToOne 0.00 255.0 /end CHARACTERISTIC
/begin CHARACTERISTIC EpmCaS_stOfsDiagMode_C "Abschalten der Winkelversatzdiagnose in EPM_MODE_OK" VALUE 0x8003B2E2 Val_Wu8 1.000 OneToOne 0.00 1.000 EXTENDED_LIMITS 0.00 255.0 /end CHARACTERISTIC
/begin CHARACTERISTIC EpmCaS_swtMeasCaS_C "Schalter für die Messung der Nockenwellen Rohwerte" VALUE 0x8003B2D8 Val_Wu8 255.0 OneToOne 0.00 255.0 /end CHARACTERISTIC
/begin CHARACTERISTIC EpmCaS_tiGlitchFilter_C "Filterzeit für das Nockenwellensignal" VALUE 0x8003B35C Val_Ws32 4294967295.00 OneToOne_us -2147483648.00 2147483647.00 FORMAT "%13.2" /end CHARACTERISTIC
/begin CHARACTERISTIC EpmCaS_tiOfsPT1_C "Zeitkonstante für gefilterten Nockenwellenverdrehwinkel" VALUE 0x8003B2E4 Val_Wu16 4294901.7590 TimeDelay_ms 65.537000015 4294967.2960 FORMAT "%12.4" /end CHARACTERISTIC
/begin CHARACTERISTIC EpmCaS_tiTimeout_C "Zeitdauer nach der die Zeitstempel der Nockenwelle auf ungültig gesetzt werden wenn keine neuen Flanken anliegen" VALUE 0x8003B360 Val_Ws32 42949672950.0 Time_ms -21474836480.0 21474836470.0 /end CHARACTERISTIC
/begin CHARACTERISTIC EpmCrS_dnEngMax_C "max. Motorverzögerung bei der noch die Diagnose auf gestörtes KW Signal durchgeführt wird" VALUE 0x8003B364 Val_Ws16 32767.00 EngNGrd -16383.50 16383.50 FORMAT "%8.2" EXTENDED_LIMITS -16384.00 16383.50 /end CHARACTERISTIC
/begin CHARACTERISTIC EpmCrS_facGapCrit1_C "Faktor für erstes Lückenkriterium" VALUE 0x8003B378 Val_Wu8 15.94 EPM_FAC_PLAUS 0.00 15.94 FORMAT "%5.2" /end CHARACTERISTIC
/begin CHARACTERISTIC EpmCrS_facGapCrit2_C "Faktor für zweites Lückenkriterium" VALUE 0x8003B379 Val_Wu8 15.94 EPM_FAC_PLAUS 0.00 15.94 FORMAT "%5.2" /end CHARACTERISTIC
/begin CHARACTERISTIC EpmCrS_facGapPlausHigh_CA "Verhältnis zur Bestimmung der oberen Grenze des Fensters zur Lückenplausibilisierung des Inkrementsignals" VAL_BLK 0x8003B37A ValA_Wu8 15.94 EPM_FAC_PLAUS 0.00 15.94 FORMAT "%5.2" NUMBER 4 /end CHARACTERISTIC
/begin CHARACTERISTIC EpmCrS_facIncPlausHigh_CA "Faktor obere Plausibilitätsgrenze Kurbelwellensignal" VAL_BLK 0x8003B37E ValA_Wu8 15.94 EPM_FAC_PLAUS 0.00 15.94 FORMAT "%5.2" NUMBER 4 /end CHARACTERISTIC
/begin CHARACTERISTIC EpmCrS_facIncPlausLow_CA "Faktor untere Plausibilitätsgrenze Kurbelwellensignal" VAL_BLK 0x8003B382 ValA_Wu8 15.94 EPM_FAC_PLAUS 0.00 15.94 FORMAT "%5.2" NUMBER 4 /end CHARACTERISTIC
/begin CHARACTERISTIC EpmCrS_facIncPlsTolc_C "Toleranz für die Impulsbreite des DGI Kurbelwellensensors" VALUE 0x8003B386 Val_Ws16 100.0000 Prc 0.00 100.0000 EXTENDED_LIMITS -400.0000 399.9878 /end CHARACTERISTIC
/begin CHARACTERISTIC EpmCrS_facScale_C "TTMeasure - Auflösung der gemessenen Zahnzeiten" VALUE 0x8003B3C0 Val_Wu8 10.00 OneToOne 0.00 10.00 EXTENDED_LIMITS 0.00 255.0 /end CHARACTERISTIC
/begin CHARACTERISTIC EpmCrS_nDiagOff_C "Drehzahlschwelle zum deaktivieren der KW Diagnose" VALUE 0x8003B366 Val_Ws16 8000.000 EngN 0.00 8000.000 EXTENDED_LIMITS -16384.00 16383.50 /end CHARACTERISTIC
/begin CHARACTERISTIC EpmCrS_nDiagOn_C "Drehzahlschwelle zum aktivieren der KW Diagnose" VALUE 0x8003B368 Val_Ws16 8000.000 EngN 0.00 8000.000 EXTENDED_LIMITS -16384.00 16383.50 /end CHARACTERISTIC
/begin CHARACTERISTIC EpmCrS_nFacScale_C "TTMeasure - Drehzahlschwelle zur Umschaltung der Auflösung der gemessenen Zahnzeiten" VALUE 0x8003B3C2 Val_Ws16 10000.00 EngN 0.00 10000.00 EXTENDED_LIMITS -16384.00 16383.50 /end CHARACTERISTIC
/begin CHARACTERISTIC EpmCrS_nMaxInc_C "max Inkrementdrehzahl" VALUE 0x8003B388 Val_Ws16 9980.000 EngN 20.00000 10000.00 EXTENDED_LIMITS -16384.00 16383.50 /end CHARACTERISTIC
/begin CHARACTERISTIC EpmCrS_nMinInc_C "min Inkrementdrehzahl" VALUE 0x8003B38A Val_Ws16 9980.000 EngN 20.00000 10000.00 EXTENDED_LIMITS -16384.00 16383.50 /end CHARACTERISTIC
/begin CHARACTERISTIC EpmCrS_nThreshRange_CA "Drehzahlschwellen der Drehzahlbereiche in der dynamischen Plausibilisierung" VAL_BLK 0x8003B38C ValA_Ws32 16319.868465052328 EngN2tiIncPer 19.999999000000049 16339.868464052328 FORMAT "%19.13" EXTENDED_LIMITS 0.001164153160604 2499999.8750000061 NUMBER 4 /end CHARACTERISTIC
/begin CHARACTERISTIC EpmCrS_nTiIncPerAvrg_CA "Drehzahlschwellen zur Bestimmung der Anzahl von Kurbelwellenzähne über die die Zahnzeit gemittelt wird" VAL_BLK 0x8003B39C ValA_Ws16 16363.00 EngN 20.00000 16383.00 EXTENDED_LIMITS -16384.00 16383.50 NUMBER 4 /end CHARACTERISTIC
/begin CHARACTERISTIC EpmCrS_numErrSigGlitMax_C "Grenzwert für den Fehlereintrag für den Glitchfehler auf der Kurbelwelle" VALUE 0x8003B36A Val_Ws16 32767.00 OneToOne 0.00 32767.00 EXTENDED_LIMITS -32768.00 32767.00 /end CHARACTERISTIC
/begin CHARACTERISTIC EpmCrS_numErrSigIncDef_C "Schrittweite Defektentprellung KW Störung" VALUE 0x8003B36C Val_Ws16 32767.00 OneToOne 0.00 32767.00 EXTENDED_LIMITS -32768.00 32767.00 /end CHARACTERISTIC
/begin CHARACTERISTIC EpmCrS_numErrSigMaxDef_C "max. Anzahl Störungen bis Fehlereintrag KW Störung" VALUE 0x8003B36E Val_Ws16 32767.00 OneToOne 0.00 32767.00 EXTENDED_LIMITS -32768.00 32767.00 /end CHARACTERISTIC
/begin CHARACTERISTIC EpmCrS_numErrSigMinOK_C "min. Anzahl von plausieblen Kurbelwellenumdrehungen bis Fehler geheilt wird" VALUE 0x8003B370 Val_Ws16 32767.00 OneToOne 0.00 32767.00 EXTENDED_LIMITS -32768.00 32767.00 /end CHARACTERISTIC
/begin CHARACTERISTIC EpmCrS_numIgnInc_C "Anzahl KW Zähne, die ausgeblendet werden" VALUE 0x8003B3A4 Val_Wu8 255.0 OneToOne 0.00 255.0 /end CHARACTERISTIC
/begin CHARACTERISTIC EpmCrS_numNoSigDef_C "Anzahl NW-Umdrehungen bis Fehlereintrag KW-Ausfall" VALUE 0x8003B372 Val_Ws16 32767.00 OneToOne 0.00 32767.00 EXTENDED_LIMITS -32768.00 32767.00 /end CHARACTERISTIC
/begin CHARACTERISTIC EpmCrS_numTiIncPerAvrg_CA "Anzahl der Kurbelwellenzähne zur Berechnung der gemittelten Zahnzeit" VAL_BLK 0x8003B3A5 ValA_Wu8 50.00 OneToOne 0.00 50.00 EXTENDED_LIMITS 0.00 255.0 NUMBER 4 /end CHARACTERISTIC
/begin CHARACTERISTIC EpmCrS_stDiagT50Reset_C "KL50 Information für KW Diagnose verwenden" VALUE 0x8003B374 Val_Wu8 255.0 OneToOne 0.00 255.0 /end CHARACTERISTIC
/begin CHARACTERISTIC EpmCrS_stTTMeasureOn_C "TTMeasure - Einschalten (=1) der Zahnzeiten Messfunktion" VALUE 0x8003B3C4 Val_Wu8 1.000 OneToOne 0.00 1.000 EXTENDED_LIMITS 0.00 255.0 /end CHARACTERISTIC
/begin CHARACTERISTIC EpmCrS_swtEnableDiag_C "Abschalten der KW Diagnose" VALUE 0x8003B375 Val_Wu8 255.0 OneToOne 0.00 255.0 /end CHARACTERISTIC
/begin CHARACTERISTIC EpmCrS_swtIncSrc_C "TTMeasure - Rohwerte oder durch die TAA korrigierte Werte" VALUE 0x8003B3C5 Val_Wu8 1.000 OneToOne 0.00 1.000 EXTENDED_LIMITS 0.00 255.0 /end CHARACTERISTIC
/begin CHARACTERISTIC EpmCrS_tiGlitchFilter_CA "Glitchfilterzeit Kurbelwellensignal" VAL_BLK 0x8003B3AC ValA_Ws32 100000.000000 OneToOne_us 0.00 100000.000000 FORMAT "%13.6" EXTENDED_LIMITS -2147483648.00 2147483647.00 NUMBER 4 /end CHARACTERISTIC
/begin CHARACTERISTIC EpmCrS_tiIgnSig_C "Zeit zum Ausblenden des KW-Signals" VALUE 0x8003B3BC Val_Ws32 100000.000000 OneToOne_ms 0.00 100000.000000 FORMAT "%13.6" EXTENDED_LIMITS -2147483648.00 2147483647.00 /end CHARACTERISTIC
/begin CHARACTERISTIC EpmHCrS_swtDGIEna_C "Schalter für Kurbelwellenauswertung mit einem DGI Sensor (KW-Sensor mit Rückdreherkennung)" VALUE 0x8003B3C6 Val_Wu8 1.000 OneToOne 0.00 1.000 EXTENDED_LIMITS 0.00 255.0 /end CHARACTERISTIC
/begin CHARACTERISTIC EpmHCrS_swtIAPDvtCorEna_C "Schalter Abweichungskorrekturalgorithmus der Inkrementvorhersage aktiviert" VALUE 0x8003B3C7 Val_Wu8 1.000 OneToOne 0.00 1.000 EXTENDED_LIMITS 0.00 255.0 /end CHARACTERISTIC
/begin CHARACTERISTIC EpmHCrS_swtIAPEna_C "Schalter Inkrementvorhersage aktiviert" VALUE 0x8003B3C8 Val_Wu8 1.000 OneToOne 0.00 1.000 EXTENDED_LIMITS 0.00 255.0 /end CHARACTERISTIC
/begin CHARACTERISTIC EpmHCrS_swtIASEna_C "Schalter Inkrementverschleifen aktiviert" VALUE 0x8003B3C9 Val_Wu8 1.000 OneToOne 0.00 1.000 EXTENDED_LIMITS 0.00 255.0 /end CHARACTERISTIC
/begin CHARACTERISTIC EpmRRS_nEngDiffMin_C "Drehzahldifferenz fuer EpmRRS" VALUE 0x80069920 Val_Ws16 10000.00 EngN -10000.00 0.00 EXTENDED_LIMITS -16384.00 16383.50 /end CHARACTERISTIC
/begin CHARACTERISTIC EpmRRS_nEngMax_C "Drehzahlobergrenze fuer EpmRRS" VALUE 0x80069922 Val_Ws16 10000.00 EngN 0.00 10000.00 EXTENDED_LIMITS -16384.00 16383.50 /end CHARACTERISTIC
/begin CHARACTERISTIC EpmSeq_nMaxStrtInt_C "maximale Drehzahl bei der noch ein Startinterrupt ausgelöst werden kann" VALUE 0x8003B3CA Val_Ws16 10000.00 EngN 0.00 10000.00 EXTENDED_LIMITS -16384.00 16383.50 /end CHARACTERISTIC
/begin CHARACTERISTIC EpmSeq_phiDelayMax_C "Maximaler Winkel um den ein Interrupt im Start verzögert werden darf" VALUE 0x8003B3CC Val_Ws16 180.0000 AngleCrS 0.00 180.0000 EXTENDED_LIMITS -720.0000 719.9780 /end CHARACTERISTIC
/begin CHARACTERISTIC EpmSeq_phiIntBCr_CA "Interruptpositionen bezogen auf OT während des Notlaufs Kurbelwelle" VAL_BLK 0x8003B3CE ValA_Ws16 719.9780 AngleCrS 0.00 719.9780 EXTENDED_LIMITS -720.0000 719.9780 NUMBER 2 /end CHARACTERISTIC
/begin CHARACTERISTIC EpmSeq_phiInt_CA "Interruptpositionen bezogen auf OT" VAL_BLK 0x8003B3D2 ValA_Ws16 719.9780 AngleCrS 0.00 719.9780 EXTENDED_LIMITS -720.0000 719.9780 NUMBER 2 /end CHARACTERISTIC
/begin CHARACTERISTIC EpmSeq_phiStrtInt_CA "Interruptpositionen bezogen auf OT im Start" VAL_BLK 0x8003B3D6 ValA_Ws16 719.9780 AngleCrS 0.00 719.9780 EXTENDED_LIMITS -720.0000 719.9780 NUMBER 2 /end CHARACTERISTIC
/begin CHARACTERISTIC EpmSeq_phiSyncInt_C "Lage des ersten Interrupt zur Dynchronisation" VALUE 0x8003B3DA Val_Ws16 719.9780 AngleCrS 0.00 719.9780 EXTENDED_LIMITS -720.0000 719.9780 /end CHARACTERISTIC
/begin CHARACTERISTIC EpmSeq_swtInt_C "Schalter, um Funktionalitäten des Sequence-Managers zu aktivieren/deaktieren" VALUE 0x8003B3DC Val_Wu8 255.0 OneToOne 0.00 255.0 /end CHARACTERISTIC
/begin CHARACTERISTIC EpmSrv_numTDCMIAPStrt_C "Anzahl der OT's für MIAP (Multiple Increment Angle Predicrion) nach dem Motorstart" VALUE 0x8003B3DE Val_Wu8 255.0 OneToOne 0.00 255.0 /end CHARACTERISTIC
/begin CHARACTERISTIC EpmSrv_numTDCMIAP_C "Anzahl der OT's für MIAP (Multiple Increment Angle Predicrion)" VALUE 0x8003B3DF Val_Wu8 255.0 OneToOne 0.00 255.0 /end CHARACTERISTIC
/begin CHARACTERISTIC EpmSyn_dCaSSegMsk_C "Maskieren der gültigen Information in EpmCaS_dSegSeries_C" VALUE 0x8003B3E0 Val_Wu8 255.0 OneToOne 0.00 255.0 /end CHARACTERISTIC
/begin CHARACTERISTIC EpmSyn_dTrigMsk_C "Triggermaske für vorlaeufige Segmenterkennung" VALUE 0x8003B3E1 Val_Wu8 255.0 OneToOne 0.00 255.0 /end CHARACTERISTIC
/begin CHARACTERISTIC EpmSyn_dTrigRslt_C "Triggerergebnis der vorlaeufigen Segmenterkennung" VALUE 0x8003B3E2 Val_Wu8 255.0 OneToOne 0.00 255.0 /end CHARACTERISTIC
/begin CHARACTERISTIC EpmSyn_phiIncCor_CUR "Drehzahlabhängiger Winkelfehler des Kurbelwellensignals" CURVE 0x8003B3E6 Cur_Xs16Ws16 1439.978 AngleCrS -720.0000 719.9780
 /begin AXIS_DESCR STD_AXIS Epm_nEng EngN 4 -16384.00 16383.50 DEPOSIT ABSOLUTE /end AXIS_DESCR
/end CHARACTERISTIC
/begin CHARACTERISTIC EpmSyn_phiRRMax_C "Maximaler Verdrehwinkel zur Erkennung eines rückwärtsdrehenden Motors" VALUE 0x8003B3F8 Val_Ws16 1439.978 AngleCrS -720.0000 719.9780 /end CHARACTERISTIC
/begin CHARACTERISTIC EpmSyn_phiTrig_C "Triggerwinkel für vorlaeufige Segmenterkennung" VALUE 0x8003B3E4 Val_Ws16 1439.978 AngleCrS -720.0000 719.9780 /end CHARACTERISTIC
/begin CHARACTERISTIC Epm_nNoSyncVerify_C "Keine sync. Während der Überprüfung der Phasenlage" VALUE 0x8003B414 Val_Ws16 10000.00 EngN 0.00 10000.00 EXTENDED_LIMITS -16384.00 16383.50 /end CHARACTERISTIC
/begin CHARACTERISTIC Epm_numConf_CA "Aktueller Zustand der EPM Konfiguration" VAL_BLK 0x8003B3FC ValA_Wu32 4294967295.00 OneToOne 0.00 4294967295.00 READ_ONLY NUMBER 3 /end CHARACTERISTIC
/begin CHARACTERISTIC Epm_numCyl_C "Tatsächliche Anzahl der Zylinder" VALUE 0x8003B408 Val_Wu8 5.000 OneToOne 1.000 6.000 EXTENDED_LIMITS 0.00 255.0 /end CHARACTERISTIC
/begin CHARACTERISTIC Epm_numFireSeg_C "Zündreihenfolge" VAL_BLK 0x8003B409 ValA_Wu8 5.000 OneToOne 1.000 6.000 EXTENDED_LIMITS 0.00 255.0 NUMBER 6 /end CHARACTERISTIC
/begin CHARACTERISTIC Epm_numReSync_C "Anzehl der zulässigne Synchronisationsversuche" VALUE 0x8003B416 Val_Wu8 100.0 OneToOne 0.00 100.0 EXTENDED_LIMITS 0.00 255.0 /end CHARACTERISTIC
/begin CHARACTERISTIC Epm_phiDiffMax_C "maximal zulaessige Abweichung waehrend Synchronisation mit Auslauf-Erkennung" VALUE 0x8003B418 Val_Ws16 90.00000 AngleCrS 0.00 90.00000 EXTENDED_LIMITS -720.0000 719.9780 /end CHARACTERISTIC
/begin CHARACTERISTIC Epm_phiGap2Zero_C "Winkel zwischen KW-Lücke und Nullpunkt des Winkelsystems" VALUE 0x8003B410 Val_Ws16 1439.978 AngleCrS -720.0000 719.9780 /end CHARACTERISTIC
/begin CHARACTERISTIC Epm_phiIgrOfs_C "Winkeloffset fuer Start mit Auslauf-Erkennung" VALUE 0x8003B41A Val_Ws16 90.00000 AngleCrS 0.00 90.00000 EXTENDED_LIMITS -720.0000 719.9780 /end CHARACTERISTIC
/begin CHARACTERISTIC Epm_phiTdc1_C "Winkel zwischen erstem OT und Nullpunkt des Winkelsystems" VALUE 0x8003B412 Val_Ws16 719.9780 AngleCrS 0.00 719.9780 EXTENDED_LIMITS -720.0000 719.9780 /end CHARACTERISTIC
/begin CHARACTERISTIC Epm_swtBlkInjCaSSync_C "Keine Synchronisation vor der KW-Lücke" VALUE 0x8003B41C Val_Wu8 1.000 OneToOne 0.00 1.000 EXTENDED_LIMITS 0.00 255.0 /end CHARACTERISTIC
/begin CHARACTERISTIC Epm_swtOpModeStgy_C "bitcodierter Schalter fuer Synchronisations-Strategien in Epm_OpMode" VALUE 0x8003B41D Val_Wu8 3.000 OneToOne 0.00 3.000 EXTENDED_LIMITS 0.00 255.0 /end CHARACTERISTIC
/begin CHARACTERISTIC Epm_tiSpd2Zero_C "Zeit bis Motordrehzahl Null" VALUE 0x8003B41E Val_Wu16 655350.0 Time_ms 0.00 655350.0 /end CHARACTERISTIC
/begin CHARACTERISTIC Epm_tiSpdGrdFlt_C "Filterzeit für Tiefpassfilter zur Berechnung des gefilterten Drehzahlgradienten" VALUE 0x8003B420 Val_Ws32 998.99238550 TimeDelay_ms 1.0000000689 999.99238556 FORMAT "%12.7" EXTENDED_LIMITS 0.0020000000009 4294967.2960 /end CHARACTERISTIC
/begin CHARACTERISTIC ErrLmp_MIL.nThres_C "Lampentest Parameterstruktur für MIL Lampe/Drehzahl zum Ausschalten des Fehlerlamptests" VALUE 0x8003B424 Val_Ws16 32767.50 EngN -16384.00 16383.50 /end CHARACTERISTIC
/begin CHARACTERISTIC ErrLmp_MIL.tiMax_C "Lampentest Parameterstruktur für MIL Lampe/Maximale Zeitdauer für Fehlerlampentest" VALUE 0x8003B426 Val_Ws16 655350.0 Time_ms -327680.0 327670.0 /end CHARACTERISTIC
/begin CHARACTERISTIC ErrLmp_MIL.tiTst_C "Lampentest Parameterstruktur für MIL Lampe/Maximale Dauer für Fehlerlampentest, nachdem die Drehzahlgrenze erreicht wurde" VALUE 0x8003B428 Val_Ws16 655350.0 Time_ms -327680.0 327670.0 /end CHARACTERISTIC
/begin CHARACTERISTIC ErrLmp_MIL.tiDel_C "Lampentest Parameterstruktur für MIL Lampe/Verzögerung für MIL-Aktivierung wegen Fehler, Zeit für Endstufetests während MIL-Aus" VALUE 0x8003B42A Val_Ws16 655350.0 Time_ms -327680.0 327670.0 /end CHARACTERISTIC
/begin CHARACTERISTIC ErrLmp_MIL.tiBln_C "Lampentest Parameterstruktur für MIL Lampe/Blinkperiodendauer für Status-MIL-Blinken" VALUE 0x8003B42C Val_Ws16 655350.0 Time_ms -327680.0 327670.0 /end CHARACTERISTIC
/begin CHARACTERISTIC ErrLmp_MIL.stEna_C "Lampentest Parameterstruktur für MIL Lampe/Freigabe oder Sperrung der Beleuchtung" VALUE 0x8003B42E Val_Wu8 255.0 OneToOne 0.00 255.0 /end CHARACTERISTIC
/begin CHARACTERISTIC ErrLmp_Rdy.st_C "Strucktur der Felherlampen-Readiness/Status der Readiness-Funktionalität" VALUE 0x8003B430 Val_Wu8 1.000 OneToOne 0.00 1.000 EXTENDED_LIMITS 0.00 255.0 /end CHARACTERISTIC
/begin CHARACTERISTIC ErrLmp_Rdy.ti_C "Strucktur der Felherlampen-Readiness/Maximale Grenze der Blinkphase während Readiness-Visualisierung über MIL" VALUE 0x8003B432 Val_Ws16 655350.0 Time_ms -327680.0 327670.0 /end CHARACTERISTIC
/begin CHARACTERISTIC ErrLmp_Rdy.tiBlnOn_C "Strucktur der Felherlampen-Readiness/Blink-Ein-Zeitdauer während der Blinkphase" VALUE 0x8003B434 Val_Ws16 655350.0 Time_ms -327680.0 327670.0 /end CHARACTERISTIC
/begin CHARACTERISTIC ErrLmp_Rdy.tiBlnOff_C "Strucktur der Felherlampen-Readiness/Blink-Aus-Zeitdauer während der Blinkphase" VALUE 0x8003B436 Val_Ws16 655350.0 Time_ms -327680.0 327670.0 /end CHARACTERISTIC
/begin CHARACTERISTIC ErrLmp_stPsMILDiaDisbl_C "Statuswort für Endstufendiagnose-Deaktivierung" VALUE 0x8003B438 Val_Wu8 255.0 OneToOne 0.00 255.0 /end CHARACTERISTIC
/begin CHARACTERISTIC ErrLmp_stPsMILDisbl_C "Statuswort für Endstufen-Aktivierung" VALUE 0x8003B439 Val_Wu8 255.0 OneToOne 0.00 255.0 /end CHARACTERISTIC
/begin CHARACTERISTIC ErrLmp_stPsSVSDiaDisbl_C "Statuswort für SVS-Diagnose-Deaktivierung" VALUE 0x8003B43A Val_Wu8 255.0 OneToOne 0.00 255.0 /end CHARACTERISTIC
/begin CHARACTERISTIC ErrLmp_stPsSVSDisbl_C "Statuswort für SVS-Lampen-Aktivierung" VALUE 0x8003B43B Val_Wu8 255.0 OneToOne 0.00 255.0 /end CHARACTERISTIC
/begin CHARACTERISTIC ErrLmp_SVS.nThres_C "Lampentest Parameterstruktur für SVS Lampe/Drehzahl zum Ausschalten des Fehlerlamptests" VALUE 0x8003B43C Val_Ws16 32767.50 EngN -16384.00 16383.50 /end CHARACTERISTIC
/begin CHARACTERISTIC ErrLmp_SVS.tiMax_C "Lampentest Parameterstruktur für SVS Lampe/Maximale Zeitdauer für Fehlerlampentest" VALUE 0x8003B43E Val_Ws16 655350.0 Time_ms -327680.0 327670.0 /end CHARACTERISTIC
/begin CHARACTERISTIC ErrLmp_SVS.tiTst_C "Lampentest Parameterstruktur für SVS Lampe/Maximale Dauer für Fehlerlampentest, nachdem die Drehzahlgrenze erreicht wurde" VALUE 0x8003B440 Val_Ws16 655350.0 Time_ms -327680.0 327670.0 /end CHARACTERISTIC
/begin CHARACTERISTIC ErrLmp_SVS.tiDel_C "Lampentest Parameterstruktur für SVS Lampe/Verzögerung für MIL-Aktivierung wegen Fehler, Zeit für Endstufetests während MIL-Aus" VALUE 0x8003B442 Val_Ws16 655350.0 Time_ms -327680.0 327670.0 /end CHARACTERISTIC
/begin CHARACTERISTIC ErrLmp_SVS.tiBln_C "Lampentest Parameterstruktur für SVS Lampe/Blinkperiodendauer für Status-MIL-Blinken" VALUE 0x8003B444 Val_Ws16 655350.0 Time_ms -327680.0 327670.0 /end CHARACTERISTIC
/begin CHARACTERISTIC ErrLmp_SVS.stEna_C "Lampentest Parameterstruktur für SVS Lampe/Freigabe oder Sperrung der Beleuchtung" VALUE 0x8003B446 Val_Wu8 255.0 OneToOne 0.00 255.0 /end CHARACTERISTIC
/begin CHARACTERISTIC ErrLmp_swtSVSEqGlwLmp_C "Schalter zur Freigabe der Glühlampe statt der SVS-Lampe" VALUE 0x8003B448 Val_Wu8 255.0 OneToOne 0.00 255.0 /end CHARACTERISTIC
/begin CHARACTERISTIC ESC_dLimCond_ASD_CA "Abschrankbedingung für winkelsynchrone Berechnungen im ASD-Kontainer" VAL_BLK 0x80039032 ValA_Wu8 255.0 OneToOne 0.00 255.0 NUMBER 3 /end CHARACTERISTIC
/begin CHARACTERISTIC ESC_dLimCond_Common_CA "Abschrankbedingung für winkelsynchrone Berechnungen im Common-Kontainer" VAL_BLK 0x80039035 ValA_Wu8 255.0 OneToOne 0.00 255.0 NUMBER 3 /end CHARACTERISTIC
/begin CHARACTERISTIC ESC_dLimCond_CPP_CA "Abschrankbedingung für winkelsynchrone Berechnungen im CPP-Kontainer" VAL_BLK 0x80039038 ValA_Wu8 255.0 OneToOne 0.00 255.0 NUMBER 3 /end CHARACTERISTIC
/begin CHARACTERISTIC ESC_dLimCond_FBC_CA "Abschrankbedingung für winkelsynchrone Berechnungen im FBC-Kontainer" VAL_BLK 0x8003903B ValA_Wu8 255.0 OneToOne 0.00 255.0 NUMBER 3 /end CHARACTERISTIC
/begin CHARACTERISTIC ESC_dLimCond_Joint_CA "Abschrankbedingung für winkelsynchrone Berechnungen im Joint-Kontainer" VAL_BLK 0x8003903E ValA_Wu8 255.0 OneToOne 0.00 255.0 NUMBER 3 /end CHARACTERISTIC
/begin CHARACTERISTIC ESC_dLimCond_LiGov_CA "Abschrankbedingung für winkelsynchrone Berechnungen im LiGoV-Kontainer" VAL_BLK 0x80039041 ValA_Wu8 255.0 OneToOne 0.00 255.0 NUMBER 3 /end CHARACTERISTIC
/begin CHARACTERISTIC ESC_dLimCond_Post_CA "Abschrankbedingung für winkelsynchrone Berechnungen im SyncPost-Kontainer" VAL_BLK 0x80039044 ValA_Wu8 255.0 OneToOne 0.00 255.0 NUMBER 3 /end CHARACTERISTIC
/begin CHARACTERISTIC ESC_dLimCond_Pre_CA "Abschrankbedingung für winkelsynchrone Berechnungen im SyncPre-Kontainer" VAL_BLK 0x80039047 ValA_Wu8 255.0 OneToOne 0.00 255.0 NUMBER 3 /end CHARACTERISTIC
/begin CHARACTERISTIC ESC_dLimCond_PSC_CA "Abschrankbedingung für winkelsynchrone Berechnungen im PSC-Kontainer" VAL_BLK 0x8003904A ValA_Wu8 255.0 OneToOne 0.00 255.0 NUMBER 3 /end CHARACTERISTIC
/begin CHARACTERISTIC ESC_dLimCond_S0_A_CA "Abschrankbedingung für winkelsynchrone Berechnungen im S0_A-Kontainer" VAL_BLK 0x8003904D ValA_Wu8 255.0 OneToOne 0.00 255.0 NUMBER 3 /end CHARACTERISTIC
/begin CHARACTERISTIC ESC_dLimCond_S0_B_CA "Abschrankbedingung für winkelsynchrone Berechnungen im S0_B-Kontainer" VAL_BLK 0x80039050 ValA_Wu8 255.0 OneToOne 0.00 255.0 NUMBER 3 /end CHARACTERISTIC
/begin CHARACTERISTIC ESC_dLimCond_S0_Rmt_CA "Abschrankbedingung für winkelsynchrone Berechnungen im S0-Remote Container" VAL_BLK 0x80039053 ValA_Wu8 255.0 OneToOne 0.00 255.0 NUMBER 3 /end CHARACTERISTIC
/begin CHARACTERISTIC ESC_dLimCond_S1_A_CA "Abschrankbedingung für winkelsynchrone Berechnungen im S1_A-Kontainer" VAL_BLK 0x80039056 ValA_Wu8 255.0 OneToOne 0.00 255.0 NUMBER 3 /end CHARACTERISTIC
/begin CHARACTERISTIC ESC_dLimCond_S1_B_CA "Abschrankbedingung für winkelsynchrone Berechnungen im S1_B-Kontainer" VAL_BLK 0x80039059 ValA_Wu8 255.0 OneToOne 0.00 255.0 NUMBER 3 /end CHARACTERISTIC
/begin CHARACTERISTIC ESC_dLimCond_S1_Rmt_CA "Abschrankbedingung fürwinkelsynchrone Berechnungen des S1-Remote Container" VAL_BLK 0x8003905C ValA_Wu8 255.0 OneToOne 0.00 255.0 NUMBER 3 /end CHARACTERISTIC
/begin CHARACTERISTIC ESC_dLimCond_UnitInjector_CA "Abschrankbedingung für winkelsynchrone Berechnungen im UnitInjector-Kontainer" VAL_BLK 0x8003905F ValA_Wu8 255.0 OneToOne 0.00 255.0 NUMBER 3 /end CHARACTERISTIC
/begin CHARACTERISTIC ESC_dLimCond_Update_CA "Abschrankbedingung für winkelsynchrone Berechnungen im Update-Kontainer" VAL_BLK 0x80039062 ValA_Wu8 255.0 OneToOne 0.00 255.0 NUMBER 3 /end CHARACTERISTIC
/begin CHARACTERISTIC ESC_nLimInj_C "Drehzahlgrenze zum Umschalten zwischen Sx_A und Sx_B Kontainer" VALUE 0x80039066 Val_Ws16 10000.00 EngN 0.00 10000.00 EXTENDED_LIMITS -16384.00 16383.50 /end CHARACTERISTIC
/begin CHARACTERISTIC ESC_nLimThreshHyst_CA "Drehzahlhystereseschwelle für die Umschaltung der Abschrankbedingungen" VAL_BLK 0x80039068 ValA_Wu16 600.0000 EngN 0.00 600.0000 EXTENDED_LIMITS 0.00 32767.50 NUMBER 3 /end CHARACTERISTIC
/begin CHARACTERISTIC ESC_nLimThresh_CA "Drechzahlschwellen zur Umschaltung der Abschrankbedingungen" VAL_BLK 0x8003906E ValA_Wu16 6000.000 EngN 0.00 6000.000 EXTENDED_LIMITS 0.00 32767.50 NUMBER 3 /end CHARACTERISTIC
/begin CHARACTERISTIC ESC_numLimInj_C "Anzahl wie oft Sx_B Kontainer aktiviert wird, bevor wieder Sx_A Kontainer aktiviert wird" VALUE 0x80039074 Val_Wu8 254.0 OneToOne 1.000 255.0 EXTENDED_LIMITS 0.00 255.0 /end CHARACTERISTIC
/begin CHARACTERISTIC ESC_stS1FrstSched_C "Winkelsynchrones Scheduling beginnt immer mit einem S1Task (Berechnung der PILOT Injections)" VALUE 0x80039076 Val_Wu8 2.00000000000 ESC_stS1FrstSched_t 0.00 2.00000000000 FORMAT "%13.11" /end CHARACTERISTIC
/begin CHARACTERISTIC ETClb_ctLrnThresQck_C "Anzahl der Lernzyklen für die Freigabe der Ansteuerdauerkorrektur durch die Ansteuerdauerkalibrierung bei Schnellkalibrierung" VALUE 0x8003907A Val_Wu16 65535.00 OneToOne 0.00 65535.00 /end CHARACTERISTIC
/begin CHARACTERISTIC ETClb_ctLrnThresRC_C "Anzahl der Lernzyklen für die Freigabe der Ansteuerdauerkorrektur bei Rollenprüfstands-Kalibrierung" VALUE 0x8003907C Val_Wu16 10.00000 OneToOne 0.00 10.00000 EXTENDED_LIMITS 0.00 65535.00 /end CHARACTERISTIC
/begin CHARACTERISTIC ETClb_ctLrnThres_C "Anzahl der Lernzyklen für die Freigabe der Ansteuerdauerkorrektur durch die Ansteuerdauerkalibrierung" VALUE 0x8003907E Val_Wu16 65535.00 OneToOne 0.00 65535.00 /end CHARACTERISTIC
/begin CHARACTERISTIC ETClb_dpRailLim_CA "Raildruck-Kalibrierpunkt abhängige max. Abweichung des Raildrucks für die Nullmengenkalibrierung" VAL_BLK 0x80039080 ValA_Ws16 2000.000 Pres_Rail 0.00 2000.000 EXTENDED_LIMITS -3276.800 3276.700 NUMBER 3 /end CHARACTERISTIC
/begin CHARACTERISTIC ETClb_facFltQck_C "Filterkonstante für die Ansteuerdauerdifferenz der Ansteuerdauerkalibrierung bei Schnellkalibrierung" VALUE 0x80039086 Val_Wu16 1.000000 Fact 0.00 1.000000 EXTENDED_LIMITS 0.00 7.999878 /end CHARACTERISTIC
/begin CHARACTERISTIC ETClb_facFltRC_C "Filterkonstante für die Ansteuerdauerdifferenz der Ansteuerdauerkalibrierung bei Rollenprüfstands-Kalibrierung" VALUE 0x80039088 Val_Wu16 1.000000 Fact 0.00 1.000000 EXTENDED_LIMITS 0.00 7.999878 /end CHARACTERISTIC
/begin CHARACTERISTIC ETClb_facFlt_C "Filterkonstante für die Ansteuerdauerdifferenz der Ansteuerdauerkalibrierung" VALUE 0x8003908A Val_Wu16 1.000000 Fact 0.00 1.000000 EXTENDED_LIMITS 0.00 7.999878 /end CHARACTERISTIC
/begin CHARACTERISTIC ETClb_numCyclMeas_C "Anzahl der Einspritzzyklen für die Messung der Ansteuerdauerkalibrierung" VALUE 0x8003908C Val_Wu16 65535.00 OneToOne 0.00 65535.00 /end CHARACTERISTIC
/begin CHARACTERISTIC ETClb_numCyclNoDyn_C "Anzahl der Einspritzzyklen bis die Ansteuerdauerkalibrierung den maximalen Drehzahlanstieg prüft" VALUE 0x8003908E Val_Wu16 65535.00 OneToOne 0.00 65535.00 /end CHARACTERISTIC
/begin CHARACTERISTIC ETClb_numCyclStartEnergize_C "Anzahl der Einspritzzyklen bis die Ansteuerdauerkalibrierung für die Messung eingeschwungen ist" VALUE 0x80039090 Val_Wu16 65535.00 OneToOne 0.00 65535.00 /end CHARACTERISTIC
/begin CHARACTERISTIC ETClb_pRailSet_CA "Raildruck-Kalibrierpunkte für die Ansteuerdauerkalibrierung" VAL_BLK 0x80039092 ValA_Ws16 2000.000 Pres_Rail 0.00 2000.000 EXTENDED_LIMITS -3276.800 3276.700 NUMBER 3 /end CHARACTERISTIC
/begin CHARACTERISTIC ETClb_SigThres_CA "Raildurck-Kalibrierpunkt abhängige Signalschwelle der Nullmengenkalibrierung" VAL_BLK 0x80039098 ValA_Ws16 200.0000 OneToOne 0.00 200.0000 EXTENDED_LIMITS -32768.00 32767.00 NUMBER 3 /end CHARACTERISTIC
/begin CHARACTERISTIC ETClb_swtWrDflVal_C "Aktivierung zum Schreiben der Testwerte für die Ansteuerdauerkalibrierung bei Wechsel von 0 nach 1" VALUE 0x8003909E Val_Wu8 1.000 OneToOne 0.00 1.000 EXTENDED_LIMITS 0.00 255.0 /end CHARACTERISTIC
/begin CHARACTERISTIC ETClb_tiBstPresCorr0_CUR "Korrektur über Ladedruck für die ETClb Ansteuerdauer im Raildruck-Kalibrierpunkt 0" CURVE 0x800390A0 Cur_Xs16Ws16 5500.0000 InjTime_us -500.0000 5000.0000 EXTENDED_LIMITS -13107.20 13106.80
 /begin AXIS_DESCR STD_AXIS Air_pIntkVUs Pres_hPa 12 600.0000 3500.000 EXTENDED_LIMITS -32768.00 32767.00 DEPOSIT ABSOLUTE /end AXIS_DESCR
/end CHARACTERISTIC
/begin CHARACTERISTIC ETClb_tiBstPresCorr1_CUR "Korrektur über Ladedruck für die ETClb Ansteuerdauer im Raildruck-Kalibrierpunkt 1" CURVE 0x800390D2 Cur_Xs16Ws16 5500.0000 InjTime_us -500.0000 5000.0000 EXTENDED_LIMITS -13107.20 13106.80
 /begin AXIS_DESCR STD_AXIS Air_pIntkVUs Pres_hPa 12 600.0000 3500.000 EXTENDED_LIMITS -32768.00 32767.00 DEPOSIT ABSOLUTE /end AXIS_DESCR
/end CHARACTERISTIC
/begin CHARACTERISTIC ETClb_tiBstPresCorr2_CUR "Korrektur über Ladedruck für die ETClb Ansteuerdauer im Raildruck-Kalibrierpunkt 2" CURVE 0x80039104 Cur_Xs16Ws16 5500.0000 InjTime_us -500.0000 5000.0000 EXTENDED_LIMITS -13107.20 13106.80
 /begin AXIS_DESCR STD_AXIS Air_pIntkVUs Pres_hPa 12 600.0000 3500.000 EXTENDED_LIMITS -32768.00 32767.00 DEPOSIT ABSOLUTE /end AXIS_DESCR
/end CHARACTERISTIC
/begin CHARACTERISTIC ETClb_tiETOvrRunMonMax_C "Maximale ZFC Ansteuerdauer für Schubüberwachung" VALUE 0x80039136 Val_Ws16 18107.20 InjTime_us -13107.20 5000.00 EXTENDED_LIMITS -13107.20 13106.80 /end CHARACTERISTIC
/begin CHARACTERISTIC ETClb_tiETStep_CA "Schrittweite der Ansteuerdauer für die Anhebung oder Senkung der Ansteuerdauer von der Ansteuerdauer-Kalibrierung" VAL_BLK 0x8003914A ValA_Ws16 5000.000 InjTime_us 0.00 5000.000 EXTENDED_LIMITS -13107.20 13106.80 NUMBER 3 /end CHARACTERISTIC
/begin CHARACTERISTIC ETClb_tiET_MAX_CA "Maximale Ansteuerdauer der Einspritzungen für die Ansteuerdauerkalibrierung für jeden Raildruck-Kalibirierpunkt" VAL_BLK 0x80039150 ValA_Ws16 5000.00 InjTime_us 0.00 5000.00 EXTENDED_LIMITS -13107.20 13106.80 NUMBER 3 /end CHARACTERISTIC
/begin CHARACTERISTIC ETClb_tiET_MIN_CA "Minimale Ansteuerdauer der Einspritzungen für die Ansteuerdauerkalibrierung für jeden Raildruck-Kalibirierpunkt" VAL_BLK 0x80039156 ValA_Ws16 5000.00 InjTime_us 0.00 5000.00 EXTENDED_LIMITS -13107.20 13106.80 NUMBER 3 /end CHARACTERISTIC
/begin CHARACTERISTIC ETClb_volEffectiveMin_CA "Menge der Wirkgrenze für die Ansteuerdauerkalibrierung" VAL_BLK 0x80039138 ValA_Ws16 100.0000 InjQntInj 0.00 100.0000 EXTENDED_LIMITS -327.6800 327.6700 NUMBER 3 /end CHARACTERISTIC
/begin CHARACTERISTIC ETClb_vStartClb_CA "Minimale Fahrzeuggeschwindigkeit zum Starten der Ansteuerdauerkalibrierung bei jedem Raildruck-Kalibrierpunkt" VAL_BLK 0x8003913E ValA_Ws16 200.0000 Vel 0.00 200.0000 EXTENDED_LIMITS -327.6800 327.6700 NUMBER 3 /end CHARACTERISTIC
/begin CHARACTERISTIC ETClb_vStopClb_CA "Minimale Fahrzeuggeschwindigkeit der Ansteuerdauerkalibrierung bei jedem Raildruck-Kalibrierpunkt" VAL_BLK 0x80039144 ValA_Ws16 200.0000 Vel 0.00 200.0000 EXTENDED_LIMITS -327.6800 327.6700 NUMBER 3 /end CHARACTERISTIC
/begin CHARACTERISTIC Etc_MaxReqTO_C "Maximale Zeit zwischen zwei Motortestanforderungen. Wert wird im 10ms Raster appliziert (Wert von 500 bedeutet 5s), kleinste erreichbare Auflösung ist aber 100ms. Aktive Tests werden nach Verstreichen der Zeit gestoppt." VALUE 0x8003B44A Val_Wu16 65535.00 OneToOne 0.00 65535.00 /end CHARACTERISTIC
/begin MEASUREMENT AltIO_trqDes "" SWORD Trq 1 100 -3276.800 3276.700 ECU_ADDRESS 0xD000065A /end MEASUREMENT
/begin MEASUREMENT Com_bLckOvrRunShOff "" UBYTE OneToOne 1 100 0.00 255.0 ECU_ADDRESS 0xD0001C65 /end MEASUREMENT
/begin MEASUREMENT Com_bShftDwn "" UBYTE OneToOne 1 100 0.00 255.0 ECU_ADDRESS 0xD0001C6D /end MEASUREMENT
/begin MEASUREMENT Com_ctrDebugFlxChA "" UBYTE OneToOne 1 100 0.00 255.0 ECU_ADDRESS 0xD0001C73 /end MEASUREMENT
/begin MEASUREMENT Com_ctrHeaderErrFlxChA "" UBYTE OneToOne 1 100 0.00 255.0 ECU_ADDRESS 0xD0001C74 /end MEASUREMENT
/begin MEASUREMENT Com_ctrSlotBoundaryFlxChA "" UBYTE OneToOne 1 100 0.00 255.0 ECU_ADDRESS 0xD0001C75 /end MEASUREMENT
/begin MEASUREMENT Com_ctrSyntaxErrFlxChA "" UBYTE OneToOne 1 100 0.00 255.0 ECU_ADDRESS 0xD0001C76 /end MEASUREMENT
/begin MEASUREMENT Com_dAngAcpdCHK_FA "" UBYTE OneToOne 1 100 0.00 255.0 ECU_ADDRESS 0xD0001C78 /end MEASUREMENT
/begin MEASUREMENT Com_dAngAcpdCHK_FX "" UBYTE OneToOne 1 100 0.00 255.0 ECU_ADDRESS 0xD0001C79 /end MEASUREMENT
/begin MEASUREMENT Com_dAngAcpdCTR_FA "" UWORD OneToOne 1 100 0.00 65535.00 ECU_ADDRESS 0xD00014F6 /end MEASUREMENT
/begin MEASUREMENT Com_dAngAcpdCTR_FX "" UWORD OneToOne 1 100 0.00 65535.00 ECU_ADDRESS 0xD00014F8 /end MEASUREMENT
/begin MEASUREMENT Com_dDataPT2CHK_FX "" UBYTE OneToOne 1 100 0.00 255.0 ECU_ADDRESS 0xD0001C7D /end MEASUREMENT
/begin MEASUREMENT Com_dDataPT2CTR_FX "" UWORD OneToOne 1 100 0.00 65535.00 ECU_ADDRESS 0xD0001500 /end MEASUREMENT
/begin MEASUREMENT Com_dDebugCTR_FX "" UWORD OneToOne 1 100 0.00 65535.00 ECU_ADDRESS 0xD0001502 /end MEASUREMENT
/begin MEASUREMENT Com_dDispRpmCTR "" UWORD OneToOne 1 100 0.00 65535.00 ECU_ADDRESS 0xD0001504 /end MEASUREMENT
/begin MEASUREMENT Com_dDispRpmEngCTR_FA "" UWORD OneToOne 1 100 0.00 65535.00 ECU_ADDRESS 0xD0001506 /end MEASUREMENT
/begin MEASUREMENT Com_dDriveTrainData2CHK_FA "" UBYTE OneToOne 1 100 0.00 255.0 ECU_ADDRESS 0xD0001C81 /end MEASUREMENT
/begin MEASUREMENT Com_dDriveTrainData2CTR_FA "" UWORD OneToOne 1 100 0.00 65535.00 ECU_ADDRESS 0xD000150A /end MEASUREMENT
/begin MEASUREMENT Com_dDsplGSICHK "" UBYTE OneToOne 1 100 0.00 255.0 ECU_ADDRESS 0xD0001C82 /end MEASUREMENT
/begin MEASUREMENT Com_dDsplGSICTR "" UWORD OneToOne 1 100 0.00 65535.00 ECU_ADDRESS 0xD000150C /end MEASUREMENT
/begin MEASUREMENT Com_dEngineCTR "" UWORD OneToOne 1 100 0.00 65535.00 ECU_ADDRESS 0xD0001510 /end MEASUREMENT
/begin MEASUREMENT Com_dStatusMSACHK "" UBYTE OneToOne 1 100 0.00 255.0 ECU_ADDRESS 0xD0001C99 /end MEASUREMENT
/begin MEASUREMENT Com_dStatusMSACTR "" UWORD OneToOne 1 100 0.00 65535.00 ECU_ADDRESS 0xD000152A /end MEASUREMENT
/begin MEASUREMENT Com_dTorque1CHK "" UBYTE OneToOne 1 100 0.00 255.0 ECU_ADDRESS 0xD0001C9C /end MEASUREMENT
/begin MEASUREMENT Com_dTorque1CTR "" UWORD OneToOne 1 100 0.00 65535.00 ECU_ADDRESS 0xD0001534 /end MEASUREMENT
/begin MEASUREMENT Com_dTorque2CHK "" UBYTE OneToOne 1 100 0.00 255.0 ECU_ADDRESS 0xD0001C9E /end MEASUREMENT
/begin MEASUREMENT Com_dTorque2CTR "" UWORD OneToOne 1 100 0.00 65535.00 ECU_ADDRESS 0xD0001538 /end MEASUREMENT
/begin MEASUREMENT Com_dTorque3CHK "" UBYTE OneToOne 1 100 0.00 255.0 ECU_ADDRESS 0xD0001CA0 /end MEASUREMENT
/begin MEASUREMENT Com_dTorque3CTR "" UWORD OneToOne 1 100 0.00 65535.00 ECU_ADDRESS 0xD000153C /end MEASUREMENT
/begin MEASUREMENT Com_dTrqCrsh1CHK_FA "" UBYTE OneToOne 1 100 0.00 255.0 ECU_ADDRESS 0xD0001CA2 /end MEASUREMENT
/begin MEASUREMENT Com_dTrqCrsh1CHK_FX "" UBYTE OneToOne 1 100 0.00 255.0 ECU_ADDRESS 0xD0001CA3 /end MEASUREMENT
/begin MEASUREMENT Com_dTrqCrsh1CTR_FA "" UWORD OneToOne 1 100 0.00 65535.00 ECU_ADDRESS 0xD0001540 /end MEASUREMENT
/begin MEASUREMENT Com_dTrqCrsh1CTR_FX "" UWORD OneToOne 1 100 0.00 65535.00 ECU_ADDRESS 0xD0001542 /end MEASUREMENT
/begin MEASUREMENT Com_dTrqCrsh2CHK_FA "" UBYTE OneToOne 1 100 0.00 255.0 ECU_ADDRESS 0xD0001CA4 /end MEASUREMENT
/begin MEASUREMENT Com_dTrqCrsh2CTR_FA "" UWORD OneToOne 1 100 0.00 65535.00 ECU_ADDRESS 0xD0001544 /end MEASUREMENT
/begin MEASUREMENT Com_dTrqCrsh3CHK_FA "" UBYTE OneToOne 1 100 0.00 255.0 ECU_ADDRESS 0xD0001CA5 /end MEASUREMENT
/begin MEASUREMENT Com_dTrqCrsh3CTR_FA "" UWORD OneToOne 1 100 0.00 65535.00 ECU_ADDRESS 0xD0001546 /end MEASUREMENT
/begin MEASUREMENT Com_dTrqWheel2CHK "" UBYTE OneToOne 1 100 0.00 255.0 ECU_ADDRESS 0xD0001CAE /end MEASUREMENT
/begin MEASUREMENT Com_dTrqWheel2CTR "" UWORD OneToOne 1 100 0.00 65535.00 ECU_ADDRESS 0xD0001558 /end MEASUREMENT
/begin MEASUREMENT Com_dTrqWheelCHK "" UBYTE OneToOne 1 100 0.00 255.0 ECU_ADDRESS 0xD0001CAF /end MEASUREMENT
/begin MEASUREMENT Com_dTrqWheelCTR "" UWORD OneToOne 1 100 0.00 65535.00 ECU_ADDRESS 0xD000155A /end MEASUREMENT
/begin MEASUREMENT Com_dummyTX1 "" UBYTE OneToOne 1 100 0.00 255.0 ECU_ADDRESS 0xD0001CC3 /end MEASUREMENT
/begin MEASUREMENT Com_dummyTX2 "" UBYTE OneToOne 1 100 0.00 255.0 ECU_ADDRESS 0xD0001CC4 /end MEASUREMENT
/begin MEASUREMENT Com_dummyTX3 "" UBYTE OneToOne 1 100 0.00 255.0 ECU_ADDRESS 0xD0001CC5 /end MEASUREMENT
/begin MEASUREMENT Com_dummyTXEvent "" UBYTE OneToOne 1 100 0.00 255.0 ECU_ADDRESS 0xD0001CC6 /end MEASUREMENT
/begin MEASUREMENT Com_dvolOut "" SWORD FlConsum_l_h 1 100 -327.6800 327.6700 FORMAT "%8.4" ECU_ADDRESS 0xD0000764 /end MEASUREMENT
/begin MEASUREMENT Com_dWhlTrqPT1CHK_FX "" UBYTE default 1 100 0.00 255.0 FORMAT "%5.1" ECU_ADDRESS 0xD0001CB4 /end MEASUREMENT
/begin MEASUREMENT Com_dWhlTrqPT1CTR_FX "" UWORD default 1 100 0.00 65535.00 FORMAT "%8.2" ECU_ADDRESS 0xD0001564 /end MEASUREMENT
/begin MEASUREMENT Com_dWhlTrqPT2CHK_FX "" UBYTE default 1 100 0.00 255.0 FORMAT "%5.1" ECU_ADDRESS 0xD0001CB5 /end MEASUREMENT
/begin MEASUREMENT Com_dWhlTrqPT2CTR_FX "" UWORD default 1 100 0.00 65535.00 FORMAT "%8.2" ECU_ADDRESS 0xD0001566 /end MEASUREMENT
/begin MEASUREMENT Com_dWhlTrqPT3CHK_FX "" UBYTE default 1 100 0.00 255.0 FORMAT "%5.1" ECU_ADDRESS 0xD0001CB6 /end MEASUREMENT
/begin MEASUREMENT Com_dWhlTrqPT3CTR_FX "" UWORD default 1 100 0.00 65535.00 FORMAT "%8.2" ECU_ADDRESS 0xD0001568 /end MEASUREMENT
/begin MEASUREMENT Com_dWhlTrqPT4CHK_FA "" UBYTE OneToOne 1 100 0.00 255.0 ECU_ADDRESS 0xD0001CB7 /end MEASUREMENT
/begin MEASUREMENT Com_dWhlTrqPT4CHK_FX "" UBYTE default 1 100 0.00 255.0 FORMAT "%5.1" ECU_ADDRESS 0xD0001CB8 /end MEASUREMENT
/begin MEASUREMENT Com_dWhlTrqPT4CTR_FA "" UWORD OneToOne 1 100 0.00 65535.00 ECU_ADDRESS 0xD000156A /end MEASUREMENT
/begin MEASUREMENT Com_dWhlTrqPT4CTR_FX "" UWORD default 1 100 0.00 65535.00 FORMAT "%8.2" ECU_ADDRESS 0xD000156C /end MEASUREMENT
/begin MEASUREMENT Com_dWhlTrqPT5CHK_FA "" UBYTE OneToOne 1 100 0.00 255.0 ECU_ADDRESS 0xD0001CB9 /end MEASUREMENT
/begin MEASUREMENT Com_dWhlTrqPT5CHK_FX "" UBYTE default 1 100 0.00 255.0 FORMAT "%5.1" ECU_ADDRESS 0xD0001CBA /end MEASUREMENT
/begin MEASUREMENT Com_dWhlTrqPT5CTR_FA "" UWORD OneToOne 1 100 0.00 65535.00 ECU_ADDRESS 0xD000156E /end MEASUREMENT
/begin MEASUREMENT Com_dWhlTrqPT5CTR_FX "" UWORD default 1 100 0.00 65535.00 FORMAT "%8.2" ECU_ADDRESS 0xD0001570 /end MEASUREMENT
/begin MEASUREMENT Com_iCurrEngDes "" SWORD Curr_10A_Step_A 1 100 -327680.0 327670.0 FORMAT "%8.1" ECU_ADDRESS 0xD000076A /end MEASUREMENT
/begin MEASUREMENT Com_nDynDisp "" SWORD EngN 1 100 -16384.00 16383.50 ECU_ADDRESS 0xD0000786 /end MEASUREMENT
/begin MEASUREMENT Com_nGbxRed "" SWORD EngN 1 100 -16384.00 16383.50 ECU_ADDRESS 0xD000078A /end MEASUREMENT
/begin MEASUREMENT Com_numGearDsplTar "" UBYTE OneToOne 1 100 0.00 255.0 ECU_ADDRESS 0xD0001CC7 /end MEASUREMENT
/begin MEASUREMENT Com_PSPdvolOut "" SWORD OneToOne 1 100 -32768.00 32767.00 ECU_ADDRESS 0xD0000752 /end MEASUREMENT
/begin MEASUREMENT Com_rAPP "" SWORD Prc 1 100 -400.0000 399.9878 ECU_ADDRESS 0xD00007BE /end MEASUREMENT
/begin MEASUREMENT Com_rTrqPT "" SWORD TransR 1 100 -327.6800 327.6700 ECU_ADDRESS 0xD00007EC /end MEASUREMENT
/begin MEASUREMENT Com_rWaterVlv "" SWORD Prc 1 100 -400.0000 399.9878 ECU_ADDRESS 0xD00007F0 /end MEASUREMENT
/begin MEASUREMENT Com_stAckReqT15 "" UBYTE OneToOne 1 100 0.00 255.0 ECU_ADDRESS 0xD0001CD2 /end MEASUREMENT
/begin MEASUREMENT Com_stAdptShftPoint "" UBYTE OneToOne 1 100 0.00 255.0 ECU_ADDRESS 0xD0001CD4 /end MEASUREMENT
/begin MEASUREMENT Com_stAPPQl "" UBYTE OneToOne 1 100 0.00 255.0 ECU_ADDRESS 0xD0001CD0 /end MEASUREMENT
/begin MEASUREMENT Com_stBrk "" UBYTE OneToOne 1 100 0.00 255.0 ECU_ADDRESS 0xD0001CD9 /end MEASUREMENT
/begin MEASUREMENT Com_stBrkPedal "" UBYTE OneToOne 1 100 0.00 255.0 ECU_ADDRESS 0xD0001CDA /end MEASUREMENT
/begin MEASUREMENT Com_stBrkQl "" UBYTE OneToOne 1 100 0.00 255.0 ECU_ADDRESS 0xD0001CDB /end MEASUREMENT
/begin MEASUREMENT Com_stCLCTRV "" UBYTE OneToOne 1 100 0.00 255.0 ECU_ADDRESS 0xD0001CE0 /end MEASUREMENT
/begin MEASUREMENT Com_stClthOpenPlaus "" UBYTE OneToOne 1 100 0.00 255.0 ECU_ADDRESS 0xD0001CEB /end MEASUREMENT
/begin MEASUREMENT Com_stCtrPrio "" UBYTE OneToOne 1 100 0.00 255.0 ECU_ADDRESS 0xD0001CF2 /end MEASUREMENT
/begin MEASUREMENT Com_stCtrPrioCf "" UBYTE OneToOne 1 100 0.00 255.0 ECU_ADDRESS 0xD0001CF3 /end MEASUREMENT
/begin MEASUREMENT Com_stDDEQual "" UBYTE OneToOne 1 100 0.00 255.0 ECU_ADDRESS 0xD0001CF4 /end MEASUREMENT
/begin MEASUREMENT Com_stDrvDirDes "" UBYTE OneToOne 1 100 0.00 255.0 ECU_ADDRESS 0xD0001D00 /end MEASUREMENT
/begin MEASUREMENT Com_stDscAck "" UBYTE OneToOne 1 100 0.00 255.0 ECU_ADDRESS 0xD0001D06 /end MEASUREMENT
/begin MEASUREMENT Com_stECUQlICM "" UBYTE OneToOne 1 100 0.00 255.0 ECU_ADDRESS 0xD0001D08 /end MEASUREMENT
/begin MEASUREMENT Com_stEng "" UBYTE OneToOne 1 100 0.00 255.0 ECU_ADDRESS 0xD0001D09 /end MEASUREMENT
/begin MEASUREMENT Com_stGbxAck "" UBYTE OneToOne 1 100 0.00 255.0 ECU_ADDRESS 0xD0001D11 /end MEASUREMENT
/begin MEASUREMENT Com_stGbxModDemFAS "" UBYTE OneToOne 1 100 0.00 255.0 ECU_ADDRESS 0xD0001D12 /end MEASUREMENT
/begin MEASUREMENT Com_stGearShftIdctr "" UBYTE OneToOne 1 100 0.00 255.0 ECU_ADDRESS 0xD0001D17 /end MEASUREMENT
/begin MEASUREMENT Com_stGrip "" UBYTE OneToOne 1 100 0.00 255.0 ECU_ADDRESS 0xD0001D1A /end MEASUREMENT
/begin MEASUREMENT Com_stGrip_mp "" UBYTE OneToOne 1 100 0.00 255.0 ECU_ADDRESS 0xC000B17C /end MEASUREMENT
/begin MEASUREMENT Com_stHtgUp "" UBYTE OneToOne 1 100 0.00 255.0 ECU_ADDRESS 0xD0001D1C /end MEASUREMENT
/begin MEASUREMENT Com_stHtgUpHyst "" UBYTE OneToOne 1 100 0.00 255.0 ECU_ADDRESS 0xD0001D1D /end MEASUREMENT
/begin MEASUREMENT Com_stInjDu "" UBYTE OneToOne 1 100 0.00 255.0 ECU_ADDRESS 0xD0001D20 /end MEASUREMENT
/begin MEASUREMENT Com_stIntfPT "" UBYTE OneToOne 1 100 0.00 255.0 ECU_ADDRESS 0xD0001D21 /end MEASUREMENT
/begin MEASUREMENT Com_stLckGbxDemQl "" UBYTE OneToOne 1 100 0.00 255.0 ECU_ADDRESS 0xD0001D29 /end MEASUREMENT
/begin MEASUREMENT Com_stLPCOff "" UBYTE OneToOne 1 100 0.00 255.0 ECU_ADDRESS 0xD0001D24 /end MEASUREMENT
/begin MEASUREMENT Com_stMSAFct "" UBYTE OneToOne 1 100 0.00 255.0 ECU_ADDRESS 0xD0001D2D /end MEASUREMENT
/begin MEASUREMENT Com_stMSAStart "" UBYTE OneToOne 1 100 0.00 255.0 ECU_ADDRESS 0xD0001D2F /end MEASUREMENT
/begin MEASUREMENT Com_stMSAStop "" UBYTE OneToOne 1 100 0.00 255.0 ECU_ADDRESS 0xD0001D30 /end MEASUREMENT
/begin MEASUREMENT Com_stnEng "" UBYTE OneToOne 1 100 0.00 255.0 ECU_ADDRESS 0xD0001DAE /end MEASUREMENT
/begin MEASUREMENT Com_stnEngQl "" UBYTE OneToOne 1 100 0.00 255.0 ECU_ADDRESS 0xD0001DAF /end MEASUREMENT
/begin MEASUREMENT Com_stNGbxRedQl "" UBYTE OneToOne 1 100 0.00 255.0 ECU_ADDRESS 0xD0001D32 /end MEASUREMENT
/begin MEASUREMENT Com_stOBDCtl "" UBYTE OneToOne 1 100 0.00 255.0 ECU_ADDRESS 0xD0001D39 /end MEASUREMENT
/begin MEASUREMENT Com_stOvrRun "" UBYTE OneToOne 1 100 0.00 255.0 ECU_ADDRESS 0xD0001D42 /end MEASUREMENT
/begin MEASUREMENT Com_stPCos "" UBYTE OneToOne 1 100 0.00 255.0 ECU_ADDRESS 0xD0001D48 /end MEASUREMENT
/begin MEASUREMENT Com_stRdcDwnCtlRpm "" UBYTE OneToOne 1 100 0.00 255.0 ECU_ADDRESS 0xD0001D52 /end MEASUREMENT
/begin MEASUREMENT Com_stRTrqPTQl "" UBYTE OneToOne 1 100 0.00 255.0 ECU_ADDRESS 0xD0001D50 /end MEASUREMENT
/begin MEASUREMENT Com_stSLck "" UBYTE OneToOne 1 100 0.00 255.0 ECU_ADDRESS 0xD0001D56 /end MEASUREMENT
/begin MEASUREMENT Com_stStrt "" UBYTE OneToOne 1 100 0.00 255.0 ECU_ADDRESS 0xD0001D7B /end MEASUREMENT
/begin MEASUREMENT Com_stStrtLck "" UBYTE OneToOne 1 100 0.00 255.0 ECU_ADDRESS 0xD0001D7D /end MEASUREMENT
/begin MEASUREMENT Com_stSwLevRpm "" UBYTE OneToOne 1 100 0.00 255.0 ECU_ADDRESS 0xD0001D80 /end MEASUREMENT
/begin MEASUREMENT Com_stTrqGbxQl "" UBYTE OneToOne 1 100 0.00 255.0 ECU_ADDRESS 0xD0001D96 /end MEASUREMENT
/begin MEASUREMENT Com_stTrqInr "" UBYTE OneToOne 1 100 0.00 255.0 ECU_ADDRESS 0xD0001D97 /end MEASUREMENT
/begin MEASUREMENT Com_stTrqInrQl "" UBYTE OneToOne 1 100 0.00 255.0 ECU_ADDRESS 0xD0001D98 /end MEASUREMENT
/begin MEASUREMENT Com_stTrqWhlFASQl "" UBYTE OneToOne 1 100 0.00 255.0 ECU_ADDRESS 0xD0001D9F /end MEASUREMENT
/begin MEASUREMENT Com_stTrqWhlQl "" UBYTE OneToOne 1 100 0.00 255.0 ECU_ADDRESS 0xD0001DA0 /end MEASUREMENT
/begin MEASUREMENT Com_stTrqWhlStbQl "" UBYTE OneToOne 1 100 0.00 255.0 ECU_ADDRESS 0xD0001DA1 /end MEASUREMENT
/begin MEASUREMENT Com_stvVehQL "" UBYTE OneToOne 1 100 0.00 255.0 ECU_ADDRESS 0xD0001DB1 /end MEASUREMENT
/begin MEASUREMENT Com_trqBefRmp_mp "" SWORD Trq 1 100 -3276.800 3276.700 ECU_ADDRESS 0xC0009D90 /end MEASUREMENT
/begin MEASUREMENT Com_trqCootdTar "" SLONG TrqPrpHigh 1 100 -214748364.800 214748364.700 ECU_ADDRESS 0xD0002E68 /end MEASUREMENT
/begin MEASUREMENT Com_trqDVCH "" SWORD Trq 1 100 -3276.800 3276.700 ECU_ADDRESS 0xD0000820 /end MEASUREMENT
/begin MEASUREMENT Com_trqGbx "" SWORD Trq 1 100 -3276.800 3276.700 ECU_ADDRESS 0xD0000824 /end MEASUREMENT
/begin MEASUREMENT Com_trqInr "" SWORD Trq 1 100 -3276.800 3276.700 ECU_ADDRESS 0xD0000838 /end MEASUREMENT
/begin MEASUREMENT Com_trqInrLtd_mp "" SWORD Trq 1 100 -3276.800 3276.700 ECU_ADDRESS 0xC0009D92 /end MEASUREMENT
/begin MEASUREMENT Com_trqISCAccFlt_mp "" SWORD Trq 1 100 -3276.800 3276.700 ECU_ADDRESS 0xC0009D96 /end MEASUREMENT
/begin MEASUREMENT Com_trqLos_mp "" SWORD Trq 1 100 -3276.800 3276.700 ECU_ADDRESS 0xC0009D98 /end MEASUREMENT
/begin MEASUREMENT Com_trqMdInd "" SWORD Trq 1 100 -3276.800 3276.700 ECU_ADDRESS 0xD000083A /end MEASUREMENT
/begin MEASUREMENT Com_trqMdIndNe "" SWORD Trq 1 100 -3276.800 3276.700 ECU_ADDRESS 0xD000083C /end MEASUREMENT
/begin MEASUREMENT Com_trqResPos "" SWORD Trq 1 100 -3276.800 3276.700 ECU_ADDRESS 0xD000083E /end MEASUREMENT
/begin MEASUREMENT Com_trqWhl "" SLONG TrqPrpHigh 1 100 -214748364.800 214748364.700 ECU_ADDRESS 0xD0002E74 /end MEASUREMENT
/begin MEASUREMENT Com_trqWhlMax "" SLONG TrqPrpHigh 1 100 -214748364.800 214748364.700 ECU_ADDRESS 0xD0002E80 /end MEASUREMENT
/begin MEASUREMENT Com_trqWhlMin "" SLONG TrqPrpHigh 1 100 -214748364.800 214748364.700 ECU_ADDRESS 0xD0002E84 /end MEASUREMENT
/begin MEASUREMENT Com_trqWhl_mp "" SWORD Trq 1 100 -3276.800 3276.700 ECU_ADDRESS 0xC0009D9A /end MEASUREMENT
/begin MEASUREMENT Com_tstHtgUp_mp "" SWORD Temp_Cels 1 100 -3549.940 3003.560 ECU_ADDRESS 0xC0009D94 /end MEASUREMENT
/begin MEASUREMENT Com_volTotFlCons "" SLONG FlConsum_ul_20ms 1 100 -2147483648.00 2147483647.00 FORMAT "%13.2" ECU_ADDRESS 0xD0002E94 /end MEASUREMENT
/begin MEASUREMENT EngICO_nCtOff "Maximale Solldrehzahl zur Ausblendung der Einspritzungen durch Enddrehzahlregler (Komfort EMB)" SWORD EngN 1 100 -16384.00 16383.50 ECU_ADDRESS 0xD000099E /end MEASUREMENT
/begin MEASUREMENT EngICO_stICO "Anforderung zur Ausblendung der Einspritzungen" UBYTE OneToOne 1 100 0.00 255.0 ECU_ADDRESS 0xD0001DEC /end MEASUREMENT
/begin MEASUREMENT EngPrt_facAPSCor_mp "" SWORD Fact 1 100 -4.000000 3.999878 ECU_ADDRESS 0xC0009DA0 /end MEASUREMENT
/begin MEASUREMENT EngPrt_facAPSPrvEOM_mp "" SWORD Fact 1 100 -4.000000 3.999878 ECU_ADDRESS 0xC0009DA2 /end MEASUREMENT
/begin MEASUREMENT EngPrt_facAPSPrvPrt_mp "" SWORD Fact 1 100 -4.000000 3.999878 ECU_ADDRESS 0xC0009DA4 /end MEASUREMENT
/begin MEASUREMENT EngPrt_facAPSPrv_mp "" SWORD Fact 1 100 -4.000000 3.999878 ECU_ADDRESS 0xC0009DA6 /end MEASUREMENT
/begin MEASUREMENT EngPrt_facOvhtPrvPrt_mp "" SWORD Fact 1 100 -4.000000 3.999878 ECU_ADDRESS 0xC0009DA8 /end MEASUREMENT
/begin MEASUREMENT EngPrt_facPrtLim "Begrenzungfaktor des Motorschutzes" SWORD Fact 1 100 -4.000000 3.999878 ECU_ADDRESS 0xD00009A0 /end MEASUREMENT
/begin MEASUREMENT EngPrt_facT31Ovht_mp "Messpunkt für Ersatz-Kennlinie EngPrt_facT31Ovht_MAP" SWORD Fact 1 100 -4.000000 3.999878 ECU_ADDRESS 0xC0009DAA /end MEASUREMENT
/begin MEASUREMENT EngPrt_factCACDsCor_mp "" SWORD Fact 1 100 -4.000000 3.999878 ECU_ADDRESS 0xC0009DAC /end MEASUREMENT
/begin MEASUREMENT EngPrt_pDesMinT31Ovht_mp "Minimal Ladedruck sollwert für Motorschütz" SWORD Pres_hPa 1 100 -32768.00 3500.00 ECU_ADDRESS 0xC0009DAE /end MEASUREMENT
/begin MEASUREMENT EngPrt_stOscDet_mp "" UBYTE OneToOne 1 100 0.00 255.0 ECU_ADDRESS 0xC000B17D /end MEASUREMENT
/begin MEASUREMENT EngPrt_stOvrSpd "Überdrehzahl-Status" UBYTE OneToOne 1 100 0.00 255.0 ECU_ADDRESS 0xD0001DED /end MEASUREMENT
/begin MEASUREMENT EngPrt_stT31PrtAct_mp "" UBYTE OneToOne 1 100 0.00 255.0 ECU_ADDRESS 0xC000B17E /end MEASUREMENT
/begin MEASUREMENT EngPrt_stThrClsd "Status von Schliessen der Drosselklappe" UBYTE OneToOne 1 100 0.00 255.0 ECU_ADDRESS 0xD0001DEE /end MEASUREMENT
/begin MEASUREMENT EngPrt_tEngDaFld_mp "Motortemperatur" SWORD Temp_Cels 1 100 -3549.940 3003.560 ECU_ADDRESS 0xC0009DB0 /end MEASUREMENT
/begin MEASUREMENT EngPrt_tiFWOsc_mp "" SLONG Time_ms 1 100 -21474836480.0 21474836470.0 ECU_ADDRESS 0xC0008EC4 /end MEASUREMENT
/begin MEASUREMENT EngPrt_tiNoFWOsc_mp "" SLONG Time_ms 1 100 -21474836480.0 21474836470.0 ECU_ADDRESS 0xC0008EC8 /end MEASUREMENT
/begin MEASUREMENT EngPrt_tiSeg "Zeit zwischen 2 Nockenwellensegmentflanken" SLONG OneToOne_us 1 100 -2147483648.00 2147483647.00 FORMAT "%13.2" ARRAY_SIZE 4 ECU_ADDRESS 0xD0002EA4 /end MEASUREMENT
/begin MEASUREMENT EngPrt_tiSegMax_mp "Maximum Zeit zwischen 2 Nockenwellensegmentflanken" SLONG OneToOne_us 1 100 -2147483648.00 2147483647.00 FORMAT "%13.2" ECU_ADDRESS 0xC0008ECC /end MEASUREMENT
/begin MEASUREMENT EngPrt_tOvhtDvt_mp "" SWORD TempDiff_Cels 1 100 -3276.800 3276.700 FORMAT "%8.3" ECU_ADDRESS 0xC0009DB2 /end MEASUREMENT
/begin MEASUREMENT EngPrt_tOvhtThresFlt_mp "" SWORD Temp_Cels 1 100 -3549.940 3003.560 ECU_ADDRESS 0xC0009DB4 /end MEASUREMENT
/begin MEASUREMENT EngPrt_tOvhtThres_mp "" SWORD Temp_Cels 1 100 -3549.940 3003.560 ECU_ADDRESS 0xC0009DB6 /end MEASUREMENT
/begin MEASUREMENT EngPrt_tOvht_mp "" SWORD Temp_Cels 1 100 -3549.940 3003.560 ECU_ADDRESS 0xC0009DB8 /end MEASUREMENT
/begin MEASUREMENT EngPrt_trqCTCor_mp "Messpunkt für Momentenkorrektur basierend auf Drehzahl und Kühlmitteltemperatur" SWORD Trq 1 100 -3276.800 3276.700 ECU_ADDRESS 0xC0009D9C /end MEASUREMENT
/begin MEASUREMENT EngPrt_trqLim "Begrenzungsmoment zum Schutz vor zu hohem Drehmoment (als inneres Motormoment)" SWORD Trq 1 100 -3276.800 3276.700 ECU_ADDRESS 0xD00009A4 /end MEASUREMENT
/begin MEASUREMENT EngPrt_trqLimDA_mp "Drehmomentbegrenzung (als inneres Moment)" SWORD Trq 1 100 -3276.800 3276.700 ECU_ADDRESS 0xC0009D9E /end MEASUREMENT
/begin MEASUREMENT EngPrt_trqLimDiffOvhtMin_mp "" SWORD Trq 1 100 -3276.800 3276.700 ECU_ADDRESS 0xC0009DBA /end MEASUREMENT
/begin MEASUREMENT EngPrt_trqLimDiffOvht_mp "" SWORD Trq 1 100 -3276.800 3276.700 ECU_ADDRESS 0xC0009DC4 /end MEASUREMENT
/begin MEASUREMENT EngPrt_trqLimIOut_mp "" SWORD Trq 1 100 -3276.800 3276.700 ECU_ADDRESS 0xC0009DC6 /end MEASUREMENT
/begin MEASUREMENT EngPrt_trqLimLead "resultierendes Begrenzungsmoment Motorschutz Lead-Pfad" SWORD Trq 1 100 -3276.800 3276.700 ECU_ADDRESS 0xD00009A6 /end MEASUREMENT
/begin MEASUREMENT EngPrt_trqLimMech "resultierendes Begrenzungsmoment für Motormechanikschutz (inneres Motormoment)" SWORD Trq 1 100 -3276.800 3276.700 ECU_ADDRESS 0xD00009A8 /end MEASUREMENT
/begin MEASUREMENT EngPrt_trqLimOvhtPrv "Begrenzungsmoment zum Schutz vor Überhitzung" SWORD Trq 1 100 -3276.800 3276.700 ECU_ADDRESS 0xD00009AA /end MEASUREMENT
/begin MEASUREMENT EngPrt_trqLimOvhtPrvUnCor_mp "" SWORD Trq 1 100 -3276.800 3276.700 ECU_ADDRESS 0xC0009DC8 /end MEASUREMENT
/begin MEASUREMENT EngPrt_trqLimPOut_mp "" SWORD Trq 1 100 -3276.800 3276.700 ECU_ADDRESS 0xC0009DCA /end MEASUREMENT
/begin MEASUREMENT EngPrt_trqLimPrvLim "uic-Datei für Motormechanikschutz" SWORD Trq 1 100 -3276.800 3276.700 ECU_ADDRESS 0xD00009AC /end MEASUREMENT
/begin MEASUREMENT EngPrt_trqNLim "Begrenzungsmoment zum Schutz vor zu hoher Drehzahl (als inneres Motormoment)" SWORD Trq 1 100 -3276.800 3276.700 ECU_ADDRESS 0xD00009AE /end MEASUREMENT
/begin MEASUREMENT EngPrt_trqPrtLim "Begrenzungsmoment zum Schutz vor zu hohem Drehmoment (als inneres Motormoment)" SWORD Trq 1 100 -3276.800 3276.700 ECU_ADDRESS 0xD00009B0 /end MEASUREMENT
/begin MEASUREMENT EngPrt_trqPrtLimCor "Korrigiertes Begrenzungsmoment zum Schutz vor zu hohem Drehmoment (als inneres Motormoment)" SWORD Trq 1 100 -3276.800 3276.700 ECU_ADDRESS 0xD00009B2 /end MEASUREMENT
/begin MEASUREMENT EngPrt_trqReplValDynCor_mp "Dynamischmoment ersatzwert für Motorschütz" SWORD Trq 1 100 -3276.800 3276.700 ECU_ADDRESS 0xC0009DBC /end MEASUREMENT
/begin MEASUREMENT EngPrt_trqReplVal_mp "Ersatzwert für EngPrt_trqLimDiffOvht" SWORD Trq 1 100 -3276.800 3276.700 ECU_ADDRESS 0xC0009DBE /end MEASUREMENT
/begin MEASUREMENT EngPrt_tT31Flt_mp "" SWORD Temp_Cels 1 100 -3549.940 3003.560 ECU_ADDRESS 0xC0009DCC /end MEASUREMENT
/begin MEASUREMENT EngPrt_tT31OvhtRmpOut_mp "" SWORD Temp_Cels 1 100 -3549.940 3003.560 ECU_ADDRESS 0xC0009DC0 /end MEASUREMENT
/begin MEASUREMENT EngPrt_tT31PrtOfs_mp "" SWORD TempDiff_Cels 1 100 -3276.800 3276.700 FORMAT "%8.3" ECU_ADDRESS 0xC0009DC2 /end MEASUREMENT
/begin MEASUREMENT EngReq_facRmpVal_mp "Rampenfaktor Umschaltrampe" SWORD CoEOMSwt_S16 1 100 -2.000000 1.999939 FORMAT "%8.6" ECU_ADDRESS 0xC0009DCE /end MEASUREMENT
/begin MEASUREMENT EngReq_qFullLdIncrOfs "Mengenoffset zur Erhöhung der Volllastbegrenzung" SWORD InjMass 1 100 -327.6800 327.6700 ECU_ADDRESS 0xD00009B4 /end MEASUREMENT
/begin MEASUREMENT EngReq_qLimSmkNxt_mp "resultierende Begrenzungsmenge künftige Betriebsart" SWORD InjMass 1 100 -327.6800 327.6700 ECU_ADDRESS 0xC0009DD0 /end MEASUREMENT
/begin MEASUREMENT EngReq_qLimSmkPrs_mp "resultierende Begrenzungsmenge aktuelle Betriebsart" SWORD InjMass 1 100 -327.6800 327.6700 ECU_ADDRESS 0xC0009DD2 /end MEASUREMENT
/begin MEASUREMENT EngReq_trqInrLimSmk "Begrenzungsmoment Rauchgrenze" SWORD Trq 1 100 -3276.800 3276.700 ECU_ADDRESS 0xD00009B6 /end MEASUREMENT
/begin MEASUREMENT EngReq_trqInrLimSmkNxt "Begrenzungsmoment Rauchgrenze künftige Betriebsart" SWORD Trq 1 100 -3276.800 3276.700 ECU_ADDRESS 0xD00009B8 /end MEASUREMENT
/begin MEASUREMENT EngReq_trqInrLimSmkNxt_mp "Begrenzungsmoment nach Interpolation für künftige Betriebsart" SWORD Trq 1 100 -3276.800 3276.700 ECU_ADDRESS 0xC0009DD4 /end MEASUREMENT
/begin MEASUREMENT EngReq_trqInrLimSmkPrs "resultierendes Begrenzungsmoment Rauchgrenze aktuelle Betriebsart" SWORD Trq 1 100 -3276.800 3276.700 ECU_ADDRESS 0xD00009BA /end MEASUREMENT
/begin MEASUREMENT EngReq_trqInrLimSmkPrs_mp "Begrenzungsmoment nach Interpolation für aktuell eBetriebsart" SWORD Trq 1 100 -3276.800 3276.700 ECU_ADDRESS 0xC0009DD6 /end MEASUREMENT
/begin MEASUREMENT EngReq_trqInrQLim "Begrenzungsmoment ausgehend von Begrenzungsmengen (ausgenommen Rauchgrenze)" SWORD Trq 1 100 -3276.800 3276.700 ECU_ADDRESS 0xD00009BC /end MEASUREMENT
/begin MEASUREMENT EngReq_trqLim "resultierendes Begrenzungsmoment aus Motorvorgaben" SWORD Trq 1 100 -3276.800 3276.700 ECU_ADDRESS 0xD00009BE /end MEASUREMENT
/begin MEASUREMENT EngReq_trqLimLead "resultierendes Begrenzungsmoment nur langanhaltende Begrenzungen aus Motorvorgaben" SWORD Trq 1 100 -3276.800 3276.700 ECU_ADDRESS 0xD00009C0 /end MEASUREMENT
/begin MEASUREMENT EngReq_trqLimSmkUnLim_mp "Begrenzungsmoment durch Rauchgrenze ohne Anstiegsbegrenzung" SWORD Trq 1 100 -3276.800 3276.700 ECU_ADDRESS 0xC0009DD8 /end MEASUREMENT
/begin MEASUREMENT EngStA_st "" UBYTE OneToOne 1 100 0.00 255.0 ECU_ADDRESS 0xD0001DEF /end MEASUREMENT
/begin MEASUREMENT EngStA_stPs "" UBYTE OneToOne 1 100 0.00 255.0 ECU_ADDRESS 0xD0001DF0 /end MEASUREMENT
/begin MEASUREMENT EngTrqPtd_ctProc10ms "Zähler zur Bildung der 40ms Zeitscheibe aus 10ms" UBYTE OneToOne 1 100 0.00 255.0 ECU_ADDRESS 0xD0001DF1 /end MEASUREMENT
/begin MEASUREMENT EngTrqPtd_ctProcSet "Prozessaufrufzähler zur Momenten-Mittelwertbildung n-synchroner Größen über 40ms" UBYTE OneToOne 1 100 0.00 255.0 ECU_ADDRESS 0xD0001DF2 /end MEASUREMENT
/begin MEASUREMENT EngTrqPtd_rTrqNPtd_mp "Begrenzungsmoment ohne Ebene 1 Offset (n-synchrone Berechnung)" UBYTE Mo_r_prc_q0p39 1 100 0.00 99.61 FORMAT "%5.2" ECU_ADDRESS 0xC000B17F /end MEASUREMENT
/begin MEASUREMENT EngTrqPtd_rTrqPtdOld "Zulässiges Motormoment aus der Ebene 2 verzögert um einen Zeitschritt" UBYTE Mo_r_prc_q0p39 1 100 0.00 99.61 FORMAT "%5.2" ECU_ADDRESS 0xD0001DF3 /end MEASUREMENT
/begin MEASUREMENT EngTrqPtd_rTrqTPtd_mp "Zeitsynchron berechnete zulässige Moment ohne Ebene 1 Offset" UBYTE Mo_r_prc_q0p39 1 100 0.00 99.61 FORMAT "%5.2" ECU_ADDRESS 0xC000B180 /end MEASUREMENT
/begin MEASUREMENT EngTrqPtd_stDKGActv_mp "" UBYTE OneToOne 1 100 0.00 255.0 ECU_ADDRESS 0xC000B183 /end MEASUREMENT
/begin MEASUREMENT EngTrqPtd_stLim "Status der Begrenzungsfreigabe bei permanenten Momentenforderungen des Ruckeldämpfers" UBYTE OneToOne 1 100 0.00 255.0 ECU_ADDRESS 0xD0001DF4 /end MEASUREMENT
/begin MEASUREMENT EngTrqPtd_stLimDeb_mp "Entprellter Status der Ebene 1 Sollwertpfadebegrenzung der Überwachung" UBYTE OneToOne 1 100 0.00 255.0 ECU_ADDRESS 0xC000B181 /end MEASUREMENT
/begin MEASUREMENT EngTrqPtd_stLimUnDeb_mp "Unentprellter Status der Ebene 1 Sollwertpfadebegrenzung der Überwachung" UBYTE OneToOne 1 100 0.00 255.0 ECU_ADDRESS 0xC000B182 /end MEASUREMENT
/begin MEASUREMENT EngTrqPtd_stPthLim "Status der motorseitigen Momentenbegrenzung aus der Überwachung" UBYTE OneToOne 1 100 0.00 255.0 ECU_ADDRESS 0xD0001DF5 /end MEASUREMENT
/begin MEASUREMENT EngTrqPtd_tiPthSetDebDly "Aktuelle Zeit der Einschaltverzögerung" SLONG TimeDT 1 100 -2147483648.00 2147483647.00 FORMAT "%13.2" ECU_ADDRESS 0xD0002EB4 /end MEASUREMENT
/begin MEASUREMENT EngTrqPtd_trqASD "Plausibilisiertes Ruckeldämpfermoment" SWORD Mo_trq_nm_q0p1 1 100 -3276.800 3276.700 FORMAT "%8.3" ECU_ADDRESS 0xD00009C2 /end MEASUREMENT
/begin MEASUREMENT EngTrqPtd_trqASDAvrg_mp "Gemittelter Ruckeldämpfereingriff zur Bestimmung des Begrenzungsstatus" SWORD Mo_trq_nm_q0p1 1 100 -3276.800 3276.700 FORMAT "%8.3" ECU_ADDRESS 0xC0009DDA /end MEASUREMENT
/begin MEASUREMENT EngTrqPtd_trqASDFlt "Begrenztes Ruckeldämpfermoment der Überwachungbegrenzung" SWORD Mo_trq_nm_q0p1 1 100 -3276.800 3276.700 FORMAT "%8.3" ECU_ADDRESS 0xD00009C4 /end MEASUREMENT
/begin MEASUREMENT EngTrqPtd_trqASDSum "Summenmoment des Ruckeldämpfereingriffs zur Mittelwertbildung über 40ms" ULONG Mo_trq_nm_q0p1 1 100 0.00 429496729.500 FORMAT "%13.3" ECU_ADDRESS 0xD0002EB8 /end MEASUREMENT
/begin MEASUREMENT EngTrqPtd_trqFlt "PT1 Filter-Variable der Ruckeldämpfer-Plausibilisierung" SLONG Mo_trq_nm_q0p00000152587890625 1 100 -3276.80000000 3276.79999847 FORMAT "%13.8" ECU_ADDRESS 0xD0002EBC /end MEASUREMENT
/begin MEASUREMENT EngTrqPtd_trqInrAvrg_mp "Gemitteltes inners Sollwertpfadmoment der Ebene 1" SWORD Mo_trq_nm_q0p1 1 100 -3276.800 3276.700 FORMAT "%8.3" ECU_ADDRESS 0xC0009DDC /end MEASUREMENT
/begin MEASUREMENT EngTrqPtd_trqInrSet_mp "Maximal zulässiges Moment der Ebene 2" SWORD Mo_trq_nm_q0p1 1 100 -3276.800 3276.700 FORMAT "%8.3" ECU_ADDRESS 0xC0009DDE /end MEASUREMENT
/begin MEASUREMENT EngTrqPtd_trqLim "Begrenzungsmoment der Sollwertpfade aus der Überwachung" SWORD Mo_trq_nm_q0p1 1 100 -3276.800 3276.700 FORMAT "%8.3" ECU_ADDRESS 0xD00009C6 /end MEASUREMENT
/begin MEASUREMENT EngTrqPtd_trqSpdG "zulässiges Moment des Drehzahlreglers" SWORD Mo_trq_nm_q0p1 1 100 -3276.800 3276.700 FORMAT "%8.3" ECU_ADDRESS 0xD00009C8 /end MEASUREMENT
/begin MEASUREMENT EngTrqPtd_trqSpdGAvrg_mp "Gemittelter Drehzahlreglereingriff zur Bestimmung des Begrenzungsstatus" SWORD Mo_trq_nm_q0p1 1 100 -3276.800 3276.700 FORMAT "%8.3" ECU_ADDRESS 0xC0009DE0 /end MEASUREMENT
/begin MEASUREMENT EngTrqPtd_trqSpdGSum "Summenmoment des Drezahlreglereingriffs zur Mittelwertbildung über 40ms" SLONG Mo_trq_nm_q0p1 1 100 -214748364.800 214748364.700 FORMAT "%13.3" ECU_ADDRESS 0xD0002EC0 /end MEASUREMENT
/begin MEASUREMENT EngTrqPtd_trqTOfs_mp "Ebene 1 Offset zur Berechnung des zulässigen Moments der Ebene 2" SWORD Mo_trq_nm_q0p1 1 100 -3276.800 3276.700 FORMAT "%8.3" ECU_ADDRESS 0xC0009DE2 /end MEASUREMENT
/begin MEASUREMENT EnvP_p "Umgebungsluftdruck" SWORD Pres_hPa 1 100 -32768.00 3500.00 ECU_ADDRESS 0xD00009CA /end MEASUREMENT
/begin MEASUREMENT EnvP_pSens "Erfasster Umgebungsdruck" SWORD Pres_hPa 1 100 -32768.00 3500.00 ECU_ADDRESS 0xD00009CC /end MEASUREMENT
/begin MEASUREMENT EnvP_uRaw "Rohspannung aus ADC für Umgebungsdruck" SWORD Volt 1 100 -6553.600 6553.400 ECU_ADDRESS 0xD00009CE /end MEASUREMENT
/begin MEASUREMENT EnvT_t "Umgebungstemperatur" SWORD Temp_Cels 1 100 -3549.940 3003.560 ECU_ADDRESS 0xD00009D0 /end MEASUREMENT
/begin MEASUREMENT EnvT_tAirCorrPT1_mp "Gefilterte Modelllufttemperatur" SWORD Temp_Cels 1 100 -3549.940 3003.560 ECU_ADDRESS 0xC0009DE4 /end MEASUREMENT
/begin MEASUREMENT EnvT_tAirCorr_mp "Die aus der Ansauglufttemperatur und dem Ansaugluftdruck modellierte Lufttemperatur" SWORD Temp_Cels 1 100 -3549.940 3003.560 ECU_ADDRESS 0xC0009DE6 /end MEASUREMENT
/begin MEASUREMENT EnvT_tClntModCur_mp "Aus Kühlmitteltemperatur berechnete Lufttemperatur" SWORD Temp_Cels 1 100 -3549.940 3003.560 ECU_ADDRESS 0xC0009DE8 /end MEASUREMENT
/begin MEASUREMENT EnvT_tClntPT1_mp "Gefilterte Kühlmitteltemperatur" SWORD Temp_Cels 1 100 -3549.940 3003.560 ECU_ADDRESS 0xC0009DEA /end MEASUREMENT
/begin MEASUREMENT EnvT_tMod "Modellierte Umgebungslufttemperatur" SWORD Temp_Cels 1 100 -3549.940 3003.560 ECU_ADDRESS 0xD00009D2 /end MEASUREMENT
/begin MEASUREMENT EnvT_tSens "Erfasste Umgebungslufttemperatur" SWORD Temp_Cels 1 100 -3549.940 3003.560 ECU_ADDRESS 0xD00009D4 /end MEASUREMENT
/begin MEASUREMENT EnvT_uRaw "Rohsignal aus dem Umgebungstemperatursensor" SWORD Volt 1 100 0.00 5000.000 ECU_ADDRESS 0xD00009D6 /end MEASUREMENT
/begin MEASUREMENT EpmBCa_ctInjSer "aktuelle Anzahl an durchgeführten Testeinspritzungen in Folge" UBYTE OneToOne 1 100 0.00 255.0 ECU_ADDRESS 0xC0006379 /end MEASUREMENT
/begin MEASUREMENT EpmBCa_ctTstInj "Anzahl der durchgeführten Testeinspritzungen seit Aufruf des Zustands" UWORD OneToOne 1 100 0.00 65535.00 ECU_ADDRESS 0xD00040F0 /end MEASUREMENT
/begin MEASUREMENT EpmBCa_ctWaitTDC "Zähler der Zylinder, die nach der Freigabe der Einspritzung bis zur Einspritzung vergehen" UBYTE OneToOne 1 100 0.00 255.0 ECU_ADDRESS 0xC000637A /end MEASUREMENT
/begin MEASUREMENT EpmBCa_CurrCyl "Aktueller Zylinder für den die Auswertung der nächsten Segmentzeiten stattfindet." UBYTE OneToOne 1 100 0.00 255.0 ECU_ADDRESS 0xC000637B /end MEASUREMENT
/begin MEASUREMENT EpmBCa_facTimes_mp "Verhältnis der Segmentzeiten des letzten ausgewerteten Zylinders in EpmBCa_CurrCyl" SWORD EpmBCa_FacTstInj 1 100 -32.76800 32.76700 FORMAT "%8.5" ECU_ADDRESS 0xC0009DEC /end MEASUREMENT
/begin MEASUREMENT EpmBCa_numCylInj "Bitfeld in dem die Zylinder markiert sind in die keine Testeinspritzung mehr stattfinden darf" UWORD OneToOne 1 100 0.00 65535.00 ECU_ADDRESS 0xD00040F2 /end MEASUREMENT
/begin MEASUREMENT EpmBCa_numWaitTDC "Anzahl der Zylinder die gewartet werden, bis ein Testeinspritzung aktiviert wird" UBYTE OneToOne 1 100 0.00 255.0 ECU_ADDRESS 0xC000637C /end MEASUREMENT
/begin MEASUREMENT EpmBCa_stTstInj "aktueller Zustand des Zustandsautomaten Notfahren ohne Nockenwelle" UBYTE EpmBCa_stTstInj_State_t 1 100 0.00 4.00000000000 FORMAT "%13.11" ECU_ADDRESS 0xC000637D /end MEASUREMENT
/begin MEASUREMENT EpmBCa_stTstInjRslt_mp "Ergebnis-Parameter der Function EpmBCa_TstInj fuer Epm_OpMode" UBYTE OneToOne 1 100 0.00 255.0 ECU_ADDRESS 0xC000B184 /end MEASUREMENT
/begin MEASUREMENT EpmBCa_tiSegOld_mp "Segmentzeit des alten segments in us" SLONG OneToOne_us 1 100 -2147483648.00 2147483647.00 FORMAT "%13.2" ECU_ADDRESS 0xC0008ED0 /end MEASUREMENT
/begin MEASUREMENT EpmBCa_tiSeg_mp "Segmentzeit des neuen Segments in us" SLONG OneToOne_us 1 100 -2147483648.00 2147483647.00 FORMAT "%13.2" ECU_ADDRESS 0xC0008ED4 /end MEASUREMENT
/begin MEASUREMENT EpmBCr_nEng "Motordrehzahl während des Notlaufs Kurbelwelle" SWORD EngN 1 100 -16384.00 16383.50 ECU_ADDRESS 0xD0005818 /end MEASUREMENT
/begin MEASUREMENT EpmBCr_phiCurrCaSEdge "Position der aktuell erkannten Nockenwellenflanke während des Notlaufs Kurbelwelle" SWORD AngleCrS 1 100 -720.0000 719.9780 ECU_ADDRESS 0xD0005812 /end MEASUREMENT
/begin MEASUREMENT EpmBCr_phiNxtCaSEdge "Position der nächsten erwarteten Nockenwellenflanke während des Notlaufs Kurbelwelle" SWORD AngleCrS 1 100 -720.0000 719.9780 ECU_ADDRESS 0xD0005814 /end MEASUREMENT
/begin MEASUREMENT EpmBCr_phiPos "Motorposition zum Interruptzeitpunkt nach einer Segmentflanke auf der Nockenwelle" SWORD AngleCrS 1 100 -720.0000 719.9780 ECU_ADDRESS 0xD0005816 /end MEASUREMENT
/begin MEASUREMENT EpmBCr_phiSeg2Seg "Winkeldifferenz zwischen zwei Segmentflanken" SWORD AngleCrS 1 100 -720.0000 719.9780 ECU_ADDRESS 0xD000580E /end MEASUREMENT
/begin MEASUREMENT EpmBCr_rSeg2SegMax_mp "berechneter Maxmimalwert des Verhältnisses zwischen den beiden letzten Segmenten (interpoliert aus EpmBCr_rSeg2SegMax_GCUR)" SWORD Fact100 1 100 -327.6800 327.6700 FORMAT "%8.4" ECU_ADDRESS 0xC0009DEE /end MEASUREMENT
/begin MEASUREMENT EpmBCr_rSeg2SegMin_mp "berechneter Minimalwert des Verhältnisses zwischen den beiden letzten Segmenten (interpoliert aus EpmBCr_rSeg2SegMin_GCUR)" SWORD Fact100 1 100 -327.6800 327.6700 FORMAT "%8.4" ECU_ADDRESS 0xC0009DF0 /end MEASUREMENT
/begin MEASUREMENT EpmBCr_rSeg2Seg_mp "berechnetes Verhältnis zweier Segmentzeit im Notluaf KW" SWORD Fact100 1 100 -327.6800 327.6700 FORMAT "%8.4" ECU_ADDRESS 0xC0009DF2 /end MEASUREMENT
/begin MEASUREMENT EpmBCr_rSeg2SyncMax_mp "berechneterMaximalwert des Verhältnisses zwischen Segment- und Synczeit (interpoliert aus EpmBCr_rSeg2SyncMax_GCUR)" SWORD Fact100 1 100 -327.6800 327.6700 FORMAT "%8.4" ECU_ADDRESS 0xC0009DF4 /end MEASUREMENT
/begin MEASUREMENT EpmBCr_rSeg2SyncMin_mp "berechneter Minimalwert des Verhältnisses zwischen Segment- und Synczeit (interpoliert aus EpmBCr_rSeg2SyncMin_GCUR)" SWORD Fact100 1 100 -327.6800 327.6700 FORMAT "%8.4" ECU_ADDRESS 0xC0009DF6 /end MEASUREMENT
/begin MEASUREMENT EpmBCr_rSeg2Sync_mp "berechnetes Verhältnis zwischen Segmentzeit und Synczahnzeit im Notlauf KW" SWORD Fact100 1 100 -327.6800 327.6700 FORMAT "%8.4" ECU_ADDRESS 0xC0009DF8 /end MEASUREMENT
/begin MEASUREMENT EpmBCr_stIntrCo "Status des Interruptkoordinators während des Notlaufs Kurbelwelle" UBYTE EpmBCr_stIntrCo_State_t 1 100 0.00 3.00000000000 FORMAT "%13.11" ECU_ADDRESS 0xC0007E66 /end MEASUREMENT
/begin MEASUREMENT EpmBCr_stPlaus_mp "Status der Plausibilisierung des Nockenwellensignals während des Notlaufs Kurbelwelle" UBYTE EpmBCr_stPlaus_State 1 100 0.00 3.00000000000 FORMAT "%13.11" ECU_ADDRESS 0xC000B185 /end MEASUREMENT
/begin MEASUREMENT EpmBCr_stPos "Status der Positionserkennung während des Notlaufs Kurbelwelle" UBYTE EpmBCr_stPos_State 1 100 0.00 1.00000000000 FORMAT "%13.11" ECU_ADDRESS 0xC0007E6F /end MEASUREMENT
/begin MEASUREMENT EpmBCr_stTmrModeStarted "Status, ob der TIMERMODE der Kurbelwellensignalerfassung gestartet wurde für den Notlauf Kurbelwelle" UBYTE OneToOne 1 100 0.00 255.0 ECU_ADDRESS 0xC0007E67 /end MEASUREMENT
/begin MEASUREMENT EpmBCr_tiIncPer "Periodendauer eines simulierten Kurbelwelleninkrements" SLONG OneToOne_us 1 100 -2147483648.00 2147483647.00 FORMAT "%13.2" ECU_ADDRESS 0xC00033E8 /end MEASUREMENT
/begin MEASUREMENT EpmBCr_tiSeg "Zeit zwischen 2 Nockenwellensegmentflanken (Zeit für den Winkel EpmBCr_phiSeg2Seg)" SLONG OneToOne_us 1 100 -2147483648.00 2147483647.00 FORMAT "%13.2" ECU_ADDRESS 0xC00033E4 /end MEASUREMENT
/begin MEASUREMENT EpmCaS_ctEdgeEquid "Offset der letzten equidistanten Nockenwellenflanke in EpmSyn_ctEdgeMapEquid" UBYTE OneToOne 1 100 0.00 255.0 ARRAY_SIZE 1 ECU_ADDRESS 0xD0001DF8 /end MEASUREMENT
/begin MEASUREMENT EpmCaS_ctErrSigDef "Anzahl von Kurbelwellen-Inkrements während das Nockenwellen Pattern Matching Fehler liefert" UWORD OneToOne 1 100 0.00 65535.00 ARRAY_SIZE 1 ECU_ADDRESS 0xD000581E /end MEASUREMENT
/begin MEASUREMENT EpmCaS_ctErrSigOk "Entprellzähler Heilung Nockenwellenstörung" UWORD OneToOne 1 100 0.00 65535.00 ARRAY_SIZE 1 ECU_ADDRESS 0xD0005820 /end MEASUREMENT
/begin MEASUREMENT EpmCaS_ctNoSig "Anzahl der Kurbelwellen-Inkrements bei fehlendem Nockenwellensignal" UWORD OneToOne 1 100 0.00 65535.00 ARRAY_SIZE 1 ECU_ADDRESS 0xD000581C /end MEASUREMENT
/begin MEASUREMENT EpmCaS_ctOfsErr_mp "Entprellzähler Verdrehung Nockenwelle" UBYTE OneToOne 1 100 0.00 255.0 ARRAY_SIZE 1 ECU_ADDRESS 0xC000BB7C /end MEASUREMENT
/begin MEASUREMENT EpmCaS_nCaS_mp "Nockenwellendrehzahl aufgrund einer Nockenwellenumdrehung" SWORD EngNCaS 1 100 -8192.000 8191.750 FORMAT "%8.3" ECU_ADDRESS 0xC0009DFE /end MEASUREMENT
/begin MEASUREMENT EpmCaS_nEng "Motordrehzahl aufgrund einer NW-Umdrehung" SWORD EngN 1 100 -16384.00 16383.50 ECU_ADDRESS 0xD00009D8 /end MEASUREMENT
/begin MEASUREMENT EpmCaS_numBufEntry_mp "Index des nächsten freien Elements im Puffer" UBYTE OneToOne 1 100 0.00 255.0 ARRAY_SIZE 1 ECU_ADDRESS 0xC000BB7D /end MEASUREMENT
/begin MEASUREMENT EpmCaS_numCurrEdge "Anzahl der aktuell erkannten Nockenwellenflanken" UWORD OneToOne 1 100 0.00 65535.00 ARRAY_SIZE 1 ECU_ADDRESS 0xD000581A /end MEASUREMENT
/begin MEASUREMENT EpmCaS_numRawValue_mp "Index auf das jüngste gültige Element im Array der Nockenwellen-Rohwerte." SBYTE OneToOne 1 100 -128.0 127.0 ECU_ADDRESS 0xC000B186 /end MEASUREMENT
/begin MEASUREMENT EpmCaS_numSegTeeth_mp "Anzahl der äquidistanten Segmentflanken über eine NW-Umdrehung" UBYTE OneToOne 1 100 0.00 255.0 ECU_ADDRESS 0xC000B187 /end MEASUREMENT
/begin MEASUREMENT EpmCaS_numValidTeeth_mp "Anzahl der äquidistanten Segmentflanken, die während eines Prozess Aufrufs gefunden wurden" UBYTE OneToOne 1 100 0.00 255.0 ARRAY_SIZE 1 ECU_ADDRESS 0xC000BB7E /end MEASUREMENT
/begin MEASUREMENT EpmCaS_phiCaSOfsAvg "gemittelter Verdrehwinkel der Nockenwelle" SLONG AngleCrS 1 100 -47185920.0000 47185919.9780 ARRAY_SIZE 1 ECU_ADDRESS 0xC00033EC /end MEASUREMENT
/begin MEASUREMENT EpmCaS_phiCor "Winkelkorrekturwert der Nockenwelle über Drehzahl und Temperatur" SWORD AngleCrS 1 100 -720.0000 719.9780 ARRAY_SIZE 1 ECU_ADDRESS 0xD00009DA /end MEASUREMENT
/begin MEASUREMENT EpmCaS_phiDiff "Abweichung der aktuellen NW Position von der adaptierten bzw realen Referenzposition" SWORD AngleCrS 1 100 -720.0000 719.9780 ARRAY_SIZE 1 ECU_ADDRESS 0xD00009DC /end MEASUREMENT
/begin MEASUREMENT EpmCaS_phiEdge "Winkel der NW Flanke" SWORD AngleCrS 1 100 -720.0000 719.9780 ARRAY_SIZE 1 ECU_ADDRESS 0xD00009DE /end MEASUREMENT
/begin MEASUREMENT EpmCaS_phiMissedSeg_mp "Erwarteter Winkel einer fehlenden äquidistanten NW-Flanke" SWORD AngleCrS 1 100 -720.0000 719.9780 ARRAY_SIZE 1 ECU_ADDRESS 0xC000BB80 /end MEASUREMENT
/begin MEASUREMENT EpmCaS_phiOfsCorr "gefilterter Nockenwellenverdrehwinkel" SWORD AngleCrS 1 100 -720.0000 719.9780 ARRAY_SIZE 1 ECU_ADDRESS 0xD00009E0 /end MEASUREMENT
/begin MEASUREMENT EpmCaS_phiRawValue_mp "Array mit den Rohwerte der Flankenpositionen der Nockenwelle." SWORD AngleCrS 1 100 -720.0000 719.9780 ARRAY_SIZE 10 ECU_ADDRESS 0xC000BB68 /end MEASUREMENT
/begin MEASUREMENT EpmCaS_phiSegLenTolc_mp "Berechnete Toleranz für den Flankenabstand von äquidistanten NW-Flanken" SWORD AngleCrS 1 100 -720.0000 719.9780 ECU_ADDRESS 0xC0009DFA /end MEASUREMENT
/begin MEASUREMENT EpmCaS_phiSpeedSegLen_mp "Berechnete Segmentlänge von äquidistanten NW-Flanken für den Winkelversatz" SWORD AngleCrS 1 100 -720.0000 719.9780 ECU_ADDRESS 0xC0009DFC /end MEASUREMENT
/begin MEASUREMENT EpmCaS_phiTempCor "Winkelkorrekturwert für jede Nockenwelle abhängig von der Temperatur" SWORD AngleCrS 1 100 -720.0000 719.9780 ARRAY_SIZE 1 ECU_ADDRESS 0xD00009E2 /end MEASUREMENT
/begin MEASUREMENT EpmCaS_stAdap "Status der Nockenwellenadaption" UBYTE EpmCaS_stAdap_State 1 100 0.00 4.00000000000 FORMAT "%13.11" ARRAY_SIZE 1 ECU_ADDRESS 0xD00095B4 /end MEASUREMENT
/begin MEASUREMENT EpmCaS_stDiag "Zustand der Nockenwellendiagnose" UBYTE OneToOne 1 100 0.00 255.0 ARRAY_SIZE 1 ECU_ADDRESS 0xC0007E72 /end MEASUREMENT
/begin MEASUREMENT EpmCaS_stErrSig "Fehlerzustand für Nockenwellenstörung" UBYTE OneToOne 1 100 0.00 255.0 ARRAY_SIZE 1 ECU_ADDRESS 0xC0007E73 /end MEASUREMENT
/begin MEASUREMENT EpmCaS_stNEng "Status der Nockenwellendrehzahl" UBYTE OneToOne 1 100 0.00 255.0 ECU_ADDRESS 0xD0001DF9 /end MEASUREMENT
/begin MEASUREMENT EpmCaS_stNoSig "Fehlerzustand für Nockenwellenausfall" UBYTE OneToOne 1 100 0.00 255.0 ARRAY_SIZE 1 ECU_ADDRESS 0xC0007E74 /end MEASUREMENT
/begin MEASUREMENT EpmCaS_stOfs "Zustand der NW-Verdrehberechnung" UBYTE EpmCas_stOfs_State 1 100 0.00 1.00000000000 FORMAT "%13.11" ARRAY_SIZE 1 ECU_ADDRESS 0xD0002D04 /end MEASUREMENT
/begin MEASUREMENT EpmCaS_stOfsErr "Fehlerzustand der NW-Verdrehberechnung" UBYTE EpmCaS_stOfsErr_Val 1 100 0.00 5.00000000000 FORMAT "%13.11" ARRAY_SIZE 1 ECU_ADDRESS 0xC0007E7C /end MEASUREMENT
/begin MEASUREMENT EpmCaS_tiEdge "Zeitpunkt der NW Flanke" SLONG Per_Dur 1 100 -2147483648.00 2147483647.00 FORMAT "%13.2" ARRAY_SIZE 1 ECU_ADDRESS 0xD0002EC4 /end MEASUREMENT
/begin MEASUREMENT EpmCrS_ctCaSRev_mp "Entprellzähler für Ausfall Kurbelwellensignal" SWORD OneToOne 1 100 -32768.00 32767.00 ECU_ADDRESS 0xC0009E00 /end MEASUREMENT
/begin MEASUREMENT EpmCrS_ctErrSig "Entprellzähler für Störung Kurbelwellensignal" SWORD OneToOne 1 100 -32768.00 32767.00 ECU_ADDRESS 0xD00040F4 /end MEASUREMENT
/begin MEASUREMENT EpmCrS_ctGlitch "Entprellzähler für Glitch - Ereignisse an der Kurbelwelle" SWORD OneToOne 1 100 -32768.00 32767.00 ECU_ADDRESS 0xD00040F6 /end MEASUREMENT
/begin MEASUREMENT EpmCrS_ctGlitchRev_mp "Anzahl der Glitches pro KW-Umdrehung" SBYTE OneToOne 1 100 -128.0 127.0 ECU_ADDRESS 0xC000B188 /end MEASUREMENT
/begin MEASUREMENT EpmCrS_ctRange_mp "Zähler zur Auswahl der Drehzahlbereiche in der dynamischen Plausibilisierung" UBYTE OneToOne 1 100 0.00 255.0 ECU_ADDRESS 0xC000B18D /end MEASUREMENT
/begin MEASUREMENT EpmCrS_ctRev100msLim_mp "Zähler der Kurbelwellenumdrehungen in 100ms" SBYTE OneToOne 1 100 -128.0 127.0 ECU_ADDRESS 0xC000B189 /end MEASUREMENT
/begin MEASUREMENT EpmCrS_ctRevCnt "Motorumdrehungszähler" UWORD RevCnt 1 100 0.00 4095.938 FORMAT "%8.3" ECU_ADDRESS 0xD0005880 /end MEASUREMENT
/begin MEASUREMENT EpmCrS_ctRevIni "Kurbelwellenumdrehungen seit Synchronisation" SWORD OneToOne 1 100 -32768.00 32767.00 ECU_ADDRESS 0xD00009E4 /end MEASUREMENT
/begin MEASUREMENT EpmCrS_ctRevStrt "Motorumdrehungszähler seit Startabwurf" SWORD OneToOne 1 100 -32768.00 32767.00 ECU_ADDRESS 0xD00009E6 /end MEASUREMENT
/begin MEASUREMENT EpmCrS_ctRevWaitDiag "Heilungsentprellzähler Störung Kurbelwellensignal" SWORD OneToOne 1 100 -32768.00 32767.00 ECU_ADDRESS 0xD00040F8 /end MEASUREMENT
/begin MEASUREMENT EpmCrS_facScale_mp "TTMeasure - aktuell eingestellte Auflösung für die Ausgabe der Zahnzeiten" UBYTE OneToOne 1 100 0.00 255.0 ECU_ADDRESS 0xC000B18F /end MEASUREMENT
/begin MEASUREMENT EpmCrS_numNewInc_mp "TTMeasure - Anzahl der neuen Zahnzeiten seit dem letzten Interrupt" UBYTE OneToOne 1 100 0.00 255.0 ECU_ADDRESS 0xC000B190 /end MEASUREMENT
/begin MEASUREMENT EpmCrS_numSeg "Teilsegmentzähler" UBYTE OneToOne 1 100 0.00 255.0 ECU_ADDRESS 0xD0001DFA /end MEASUREMENT
/begin MEASUREMENT EpmCrS_numTiIncPerAvrg_mp "aktuelle Anzahl der Kurbelwellenzähne zur Berechnung der gemittelten Zahnzeit" UBYTE OneToOne 1 100 0.00 255.0 ECU_ADDRESS 0xC000B18E /end MEASUREMENT
/begin MEASUREMENT EpmCrS_stDiag "Status der Kurbelwellen diagnose" UBYTE OneToOne 1 100 0.00 255.0 ECU_ADDRESS 0xD0001DFB /end MEASUREMENT
/begin MEASUREMENT EpmCrS_stDiagErrSig "Aktueller Status des Fehlers ErrSig" UBYTE OneToOne 1 100 0.00 255.0 ECU_ADDRESS 0xC0007E90 /end MEASUREMENT
/begin MEASUREMENT EpmCrS_stDiagFFReset_mp "Sperrzustand aus Abwürgeerkennung Kurbelwellendiagnose" UBYTE OneToOne 1 100 0.00 255.0 ECU_ADDRESS 0xC000B18A /end MEASUREMENT
/begin MEASUREMENT EpmCrS_stDiagNoSig "Aktueller Status des Fehlers NoSig" UBYTE OneToOne 1 100 0.00 255.0 ECU_ADDRESS 0xC0007E91 /end MEASUREMENT
/begin MEASUREMENT EpmCrS_stDiagReset_mp "Sammelsperrzustand Kurbelwellendiagnose" UBYTE OneToOne 1 100 0.00 255.0 ECU_ADDRESS 0xC000B18B /end MEASUREMENT
/begin MEASUREMENT EpmCrS_stDiagVehSpdReset_mp "Sperrzustand Anschlepperkennung Kurbelwellendiagnose" UBYTE OneToOne 1 100 0.00 255.0 ECU_ADDRESS 0xC000B18C /end MEASUREMENT
/begin MEASUREMENT EpmCrS_stSigDiagSrc "Fehlerursache Kurbelwellensignal" UWORD OneToOne 1 100 0.00 65535.00 ECU_ADDRESS 0xD0005872 /end MEASUREMENT
/begin MEASUREMENT EpmCrS_stSigMode "Status Kurbelwellensignalauswertung" UBYTE OneToOne 1 100 0.00 255.0 ECU_ADDRESS 0xD0001DFC /end MEASUREMENT
/begin MEASUREMENT EpmCrS_tiIncPer_mp "aktuelle Zahnzeit der Kurbelwelle" SLONG TimeGT0Tic 1 100 -858993.459200 858993.458800 FORMAT "%13.6" ECU_ADDRESS 0xC0008ED8 /end MEASUREMENT
/begin MEASUREMENT EpmCrS_tiInc_mp "TTmeasure - KW-Zahnzeiten seit dem letzten Interrupt" UWORD TimeGPTATick 1 100 0.00 3276.750 FORMAT "%8.3" ARRAY_SIZE 20 ECU_ADDRESS 0xC000BB82 /end MEASUREMENT
/begin MEASUREMENT EpmCrS_tiSeg "Segmentzeit" SLONG Per_Dur 1 100 -2147483648.00 2147483647.00 FORMAT "%13.2" ECU_ADDRESS 0xD0002EC8 /end MEASUREMENT
/begin MEASUREMENT EpmCrS_tiSegCurr "Teilsegmentzähler" SLONG Per_Dur 1 100 -2147483648.00 2147483647.00 FORMAT "%13.2" ECU_ADDRESS 0xD0002ECC /end MEASUREMENT
/begin MEASUREMENT EpmHCrS_ctIncEngPos "Zahnzähler aktuelle Motorposition" UWORD OneToOne 1 100 0.00 65535.00 ECU_ADDRESS 0xC00008B8 /end MEASUREMENT
/begin MEASUREMENT EpmHCrS_ctIncEngPosDev "Zahnzählerabweichung aktuelle Motorposition" SWORD OneToOne 1 100 -32768.00 32767.00 ECU_ADDRESS 0xD000588A /end MEASUREMENT
/begin MEASUREMENT EpmHCrS_ctIncEngPosStrt "Zahnzähler aktuelle Motorposition für den Startfall" UWORD OneToOne 1 100 0.00 65535.00 ECU_ADDRESS 0xC00008BA /end MEASUREMENT
/begin MEASUREMENT EpmHCrS_stSigErr "Kurbelwellensignalfehler" UWORD OneToOne 1 100 0.00 65535.00 ECU_ADDRESS 0xD0005888 /end MEASUREMENT
/begin MEASUREMENT EpmHCrS_stSigMode "Zustand der Kurbelwellensignalauswertung" UBYTE EpmHCrS_stSigMode_State_t 1 100 0.00 8.00000000000 FORMAT "%13.11" ECU_ADDRESS 0xC0007E96 /end MEASUREMENT
/begin MEASUREMENT EpmHInt_tiInt4Del_mp "Latenzzeit segmentsynchroner Interrupt" ULONG OneToOne_us 1 100 0.00 4294967295.00 FORMAT "%13.2" ECU_ADDRESS 0xC0008EDC /end MEASUREMENT
/begin MEASUREMENT EpmRRS_bEngStopAg_mp "Gültigkeit Motorstopp-Position/Abstellwinkel" UBYTE EpmRRS_bEngStopAg_t 1 100 0.00 1.00000000000 FORMAT "%13.11" ECU_ADDRESS 0xC000B191 /end MEASUREMENT
/begin MEASUREMENT EpmRRS_bEngSwOff "Motor Notaus (rueckwaertsdrehender Motor)" UBYTE default 1 100 0.00 1.000 BIT_MASK 0x1 FORMAT "%5.3" ECU_ADDRESS 0xD00003BD /end MEASUREMENT
/begin MEASUREMENT EpmRRS_ctInc10msOld_mp "alter Zahnzaehlerstand" UWORD OneToOne 1 100 0.00 65535.00 ECU_ADDRESS 0xC0009E02 /end MEASUREMENT
/begin MEASUREMENT EpmRRS_ctInc10ms_mp "letzte Zahnnummer der HWE" UWORD OneToOne 1 100 0.00 65535.00 ECU_ADDRESS 0xC0009E04 /end MEASUREMENT
/begin MEASUREMENT EpmRRS_ctIncArrayNew_mp "Position des neuen ctInc -Zählers im Array" UWORD OneToOne 1 100 0.00 65535.00 ECU_ADDRESS 0xC0009E06 /end MEASUREMENT
/begin MEASUREMENT EpmRRS_ctIncEngStop_mp "Zahnnummer bei Motorstopp" UWORD OneToOne 1 100 0.00 65535.00 ECU_ADDRESS 0xC0009E08 /end MEASUREMENT
/begin MEASUREMENT EpmRRS_ctIncEstGap_mp "Erwartete Lückenposition im Zahnzeitenarray" UWORD OneToOne 1 100 0.00 65535.00 ECU_ADDRESS 0xC0009E0A /end MEASUREMENT
/begin MEASUREMENT EpmRRS_ctIncRdPos_mp "Zahnzaehler beim Start fuer Stopp Start Systeme fuer DGI" UWORD OneToOne 1 100 0.00 65535.00 ECU_ADDRESS 0xC0009E0C /end MEASUREMENT
/begin MEASUREMENT EpmRRS_GapPos_mp "Zahnnummer der Lueckenzaehne" UBYTE OneToOne 1 100 0.00 255.0 ECU_ADDRESS 0xC000B192 /end MEASUREMENT
/begin MEASUREMENT EpmRRS_phiCalcPos_mp "Winkel beim Start fuer DGI" SWORD AngleCrS 1 100 -720.0000 719.9780 ECU_ADDRESS 0xC0009E0E /end MEASUREMENT
/begin MEASUREMENT EpmRRS_phiEngStop_mp "Winkel bei Motorstopp" SWORD AngleCrS 1 100 -720.0000 719.9780 ECU_ADDRESS 0xC0009E10 /end MEASUREMENT
/begin MEASUREMENT EpmRRS_phiRdPos_mp "Winkel beim Start fuer Stopp Start Systeme fuer DGI" SWORD AngleCrS 1 100 -720.0000 719.9780 ECU_ADDRESS 0xC0009E12 /end MEASUREMENT
/begin MEASUREMENT EpmRRS_stAgDetect_mp "Zustand des Zustandautomaten" UBYTE EpmRRS_stAgDetect_t 1 100 0.00 7.00000000000 FORMAT "%13.11" ECU_ADDRESS 0xC000B193 /end MEASUREMENT
/begin MEASUREMENT EpmRRS_stToothAgCond_mp "Zahnzeit- und Winkelbedingungen" UWORD OneToOne 1 100 0.00 65535.00 ECU_ADDRESS 0xC0009E14 /end MEASUREMENT
/begin MEASUREMENT EpmRRS_stToothGapArrayCond_mp "Status der Berechungen im Array" UWORD OneToOne 1 100 0.00 65535.00 ECU_ADDRESS 0xC0009E16 /end MEASUREMENT
/begin MEASUREMENT EpmRRS_tiToothPerOrg_mp "Zahnzeitenpuffer ohne Lückenkorrektur" SLONG OneToOne_us 1 100 -2147483648.00 2147483647.00 FORMAT "%13.2" ARRAY_SIZE 12 ECU_ADDRESS 0xC000BBAC /end MEASUREMENT
/begin MEASUREMENT EpmRRS_tiToothTypic_mp "Zahnzeit aus EpmRRS_tiTemp_CUR" SLONG OneToOne_us 1 100 -2147483648.00 2147483647.00 FORMAT "%13.2" ECU_ADDRESS 0xC0008EE0 /end MEASUREMENT
/begin MEASUREMENT EpmSeq_numIncDiffInt "Abstand zwischen 2 Synchro-Interrupts in Kurbelwellenzähnen" SWORD OneToOne 1 100 -32768.00 32767.00 ARRAY_SIZE 2 ECU_ADDRESS 0xD00009E8 /end MEASUREMENT
/begin MEASUREMENT EpmSeq_numInt "Interrupttyp des Sequencemanagers" UBYTE EpmSeq_numInt_Compu 1 100 0.00 16.0000000000 FORMAT "%13.10" ECU_ADDRESS 0xD0001DFD /end MEASUREMENT
/begin MEASUREMENT EpmSeq_phiNxtInt "Winkel des nächsten auszulösenden Syncrointerrupts" SWORD AngleCrS 1 100 0.00 719.9780 ECU_ADDRESS 0xD000588E /end MEASUREMENT
/begin MEASUREMENT EpmSeq_stInt "Status des Sequencemanagers" UBYTE EpmSeq_stInt_Compu 1 100 0.00 8.00000000000 FORMAT "%13.11" ECU_ADDRESS 0xC0007E9B /end MEASUREMENT
/begin MEASUREMENT EpmSrv_stCnvAgT2Ag_mp "Interner Status der Funktion EpmSrv_CnvAgT2Ag" UBYTE EpmSrv_stCnvAgT2Ag_t 1 100 0.00 255.000000000 FORMAT "%13.9" ECU_ADDRESS 0xC000B194 /end MEASUREMENT
/begin MEASUREMENT EpmSyn_CaSData "Signaltabelle mit den erfassten Nockenwellensegmenten" UBYTE OneToOne 1 100 0.00 255.0 ARRAY_SIZE 16 ECU_ADDRESS 0xD00058A2 /end MEASUREMENT
/begin MEASUREMENT EpmSyn_ctEdgeEarly "Anzahl der tolerierten NW-Flanken, die zu früh kommen" UBYTE OneToOne 1 100 0.00 255.0 ARRAY_SIZE 1 ECU_ADDRESS 0xC0007EBA /end MEASUREMENT
/begin MEASUREMENT EpmSyn_ctEdgeLate "Anzahl der tolerierten Nockenwellenflanken, die zu spät kommen" UBYTE OneToOne 1 100 0.00 255.0 ARRAY_SIZE 1 ECU_ADDRESS 0xC0007EBB /end MEASUREMENT
/begin MEASUREMENT EpmSyn_ctLstEdge_mp "Letzter Wert des KW-Flankenzählers" SWORD OneToOne 1 100 -32768.00 32767.00 ECU_ADDRESS 0xC0009E18 /end MEASUREMENT
/begin MEASUREMENT EpmSyn_ctSigTabLstEntr_mp "Index des letzten Eintrags in der Signaltabelle" SBYTE OneToOne 1 100 -128.0 127.0 ECU_ADDRESS 0xC000B195 /end MEASUREMENT
/begin MEASUREMENT EpmSyn_EdgeFailType "Fehlerart beim Tolerieren von Nockenwellenstörungen" UBYTE EpmSyn_EdgeFailTypes 1 100 0.00 2.00000000000 FORMAT "%13.11" ARRAY_SIZE 1 ECU_ADDRESS 0xC0007EB9 /end MEASUREMENT
/begin MEASUREMENT EpmSyn_numCaSSync "Nockenwelle mit der die Syncronisation durchgeführt wird" UBYTE OneToOne 1 100 0.00 255.0 ECU_ADDRESS 0xC0007EA0 /end MEASUREMENT
/begin MEASUREMENT EpmSyn_numMatches_mp "Anzahl Übereinstimmungen zwischen EpmCaS_dSegSeries und Signaltabelle" UBYTE OneToOne 1 100 0.00 255.0 ECU_ADDRESS 0xC000B196 /end MEASUREMENT
/begin MEASUREMENT EpmSyn_numMatchPos "Position bei der EpmCas_dSegSeries_C mit dem erfassten Muster übereinstimmt" SBYTE OneToOne 1 100 -128.0 127.0 ARRAY_SIZE 1 ECU_ADDRESS 0xC0007EB8 /end MEASUREMENT
/begin MEASUREMENT EpmSyn_numMatchPos_mp "Position der Übereinstimmung" UBYTE OneToOne 1 100 0.00 255.0 ECU_ADDRESS 0xC000B197 /end MEASUREMENT
/begin MEASUREMENT EpmSyn_numNewEdges_mp "Anzahl neuer NW Flanken seit dem letzten Aufruf" UBYTE OneToOne 1 100 0.00 255.0 ECU_ADDRESS 0xC000B198 /end MEASUREMENT
/begin MEASUREMENT EpmSyn_numSegInSigTab_mp "Anzahl der Segmenteinträge in der Signaltabelle" UBYTE OneToOne 1 100 0.00 255.0 ECU_ADDRESS 0xC000B199 /end MEASUREMENT
/begin MEASUREMENT EpmSyn_phiCaSPos "Nockenwellenwinkel nach Mustererkennung" SWORD AngleCrS 1 100 -720.0000 719.9780 ARRAY_SIZE 1 ECU_ADDRESS 0xD00058A0 /end MEASUREMENT
/begin MEASUREMENT EpmSyn_phiDiff_mp "Differenz zwischen Nocken- und Kurbellwelle" SWORD AngleCrS 1 100 -720.0000 719.9780 ECU_ADDRESS 0xC0009E1A /end MEASUREMENT
/begin MEASUREMENT EpmSyn_phiIncCor_mp "Korrekturwert drehzahlabhängiger Phasenfehler Kurbelwellensignal" SWORD AngleCrS 1 100 -720.0000 719.9780 ECU_ADDRESS 0xC0009E1C /end MEASUREMENT
/begin MEASUREMENT EpmSyn_phiInt "Position des Syncro interrupts" SWORD AngleCrS 1 100 -720.0000 719.9780 ECU_ADDRESS 0xD00009EC /end MEASUREMENT
/begin MEASUREMENT EpmSyn_phiOffs "Synchronisationsoffset" SWORD AngleCrS 1 100 -720.0000 719.9780 ECU_ADDRESS 0xD00058BE /end MEASUREMENT
/begin MEASUREMENT EpmSyn_phiSegLenUncorr "unkorrigierte segmentlänge des toleranten Nockenwellenmustervergleichs" SLONG OneToOne 1 100 -2147483648.00 2147483647.00 ARRAY_SIZE 1 ECU_ADDRESS 0xC0003700 /end MEASUREMENT
/begin MEASUREMENT EpmSyn_stCasEval "Zustand der Nockenwellenauswertung" UBYTE EpmSyn_stCaSEvalComp 1 100 0.00 4.00000000000 FORMAT "%13.11" ECU_ADDRESS 0xC0007EBE /end MEASUREMENT
/begin MEASUREMENT EpmSyn_stCaSPos "Zustand der Nockenwellenposition" UBYTE EpmSyn_stCaSPosComp 1 100 0.00 20.0000000000 FORMAT "%13.10" ARRAY_SIZE 1 ECU_ADDRESS 0xC0007EA2 /end MEASUREMENT
/begin MEASUREMENT EpmSyn_stCrSPos "Zustand Kurbelwellenposition" UBYTE EpmSyn_stCrSPos_State_t 1 100 0.00 3.00000000000 FORMAT "%13.11" ECU_ADDRESS 0xD0001DFE /end MEASUREMENT
/begin MEASUREMENT EpmSyn_stCrSPosErr "Fehler der Kurbelwellenposition" UWORD OneToOne 1 100 0.00 65535.00 ECU_ADDRESS 0xD00058C2 /end MEASUREMENT
/begin MEASUREMENT EpmSyn_stGapPos "1=Lückenposition zur Phasenüberprüfung verwenden" UBYTE OneToOne 1 100 0.00 255.0 ECU_ADDRESS 0xC0007EBF /end MEASUREMENT
/begin MEASUREMENT EpmSyn_stPreSeg_mp "Zustand der vorläufigen Segmenterkennung" UBYTE OneToOne 1 100 0.00 255.0 ECU_ADDRESS 0xC000B19A /end MEASUREMENT
/begin MEASUREMENT EpmSyn_stRR "Zustand Rückdreherkennung durch Nockenwellenmustervergleich" UBYTE EpmSyn_stRRComp 1 100 0.00 1.00000000000 FORMAT "%13.11" ARRAY_SIZE 1 ECU_ADDRESS 0xD0001DFF /end MEASUREMENT
/begin MEASUREMENT Epm_ctCyl "aktuelle Zylindernummer" UBYTE OneToOne 1 100 0.00 255.0 ECU_ADDRESS 0xD0001E00 /end MEASUREMENT
/begin MEASUREMENT Epm_ctCylPerECU "Zylinderzähler pro Steuergerät (Master/Slave)" UBYTE OneToOne 1 100 0.00 255.0 ECU_ADDRESS 0xD0001E01 /end MEASUREMENT
/begin MEASUREMENT Epm_ctReSync_mp "Anzahl der Neusynchronisationen während der Synchronisationsphase im Zustand Epm_stOpMode = 33" UBYTE OneToOne 1 100 0.00 255.0 ECU_ADDRESS 0xC000B19B /end MEASUREMENT
/begin MEASUREMENT Epm_ctTDCPhys_mp "Zylinderzähler, der in der Zündreihenfolge zählt" UBYTE OneToOne 1 100 0.00 255.0 ECU_ADDRESS 0xC000B19C /end MEASUREMENT
/begin MEASUREMENT Epm_dnEng "Drehzahlgradient berechnet über das aktuelle Segment (S0-S0 oder S1-S1)" SWORD EngNGrd 1 100 -16384.00 16383.50 FORMAT "%8.2" ECU_ADDRESS 0xD00009EE /end MEASUREMENT
/begin MEASUREMENT Epm_dnEngFlt "Gefilterter Drehzahlgradient berechnet über das aktuelle Segment (S0-S0 oder S1-S1)" SWORD EngNGrd 1 100 -16384.00 16383.50 FORMAT "%8.2" ECU_ADDRESS 0xD00009F0 /end MEASUREMENT
/begin MEASUREMENT Epm_nEng "Motordrehzahl" SWORD EngN 1 100 -16384.00 16383.50 ECU_ADDRESS 0xD00003E2 /end MEASUREMENT
/begin MEASUREMENT Epm_nEng10ms "Drehzahl im 10ms-Raster" SWORD EngN 1 100 -16384.00 16383.50 ECU_ADDRESS 0xD00009F2 /end MEASUREMENT
/begin MEASUREMENT Epm_nEngCurr "Aktuelle Motordrehzahl" SWORD EngN 1 100 -16384.00 16383.50 ECU_ADDRESS 0xD00009F4 /end MEASUREMENT
/begin MEASUREMENT Epm_nEngDiff "Differenzdrehzahl berechnet über das aktuelle Segment (S0-S0 oder S1-S1)" SWORD EngN 1 100 -16384.00 16383.50 ECU_ADDRESS 0xD00009F6 /end MEASUREMENT
/begin MEASUREMENT Epm_nEngLRes "Motordrehzahl mit geringer Auflösung" UBYTE EngN_LRes 1 100 0.00 10200. FORMAT "%5.0" ECU_ADDRESS 0xD0001E02 /end MEASUREMENT
/begin MEASUREMENT Epm_nEngOldS0_mp "Drehzahl des letzten S0-Synchros" SWORD EngN 1 100 -16384.00 16383.50 ECU_ADDRESS 0xC0009E26 /end MEASUREMENT
/begin MEASUREMENT Epm_nEngOldS1_mp "Drehzahl des letzten S1-Synchros" SWORD EngN 1 100 -16384.00 16383.50 ECU_ADDRESS 0xC0009E28 /end MEASUREMENT
/begin MEASUREMENT Epm_nEngRaw "Rohdrehzahl für OBD Tester" SWORD EngN 1 100 -16384.00 16383.50 ECU_ADDRESS 0xD00040FA /end MEASUREMENT
/begin MEASUREMENT Epm_nEngTooth10ms_mp "Drehzahl aus einer Zahnzeit" SWORD EngN 1 100 -16384.00 16383.50 ECU_ADDRESS 0xC0009E22 /end MEASUREMENT
/begin MEASUREMENT Epm_numCyl "Tatsächliche Anzahl der Zylinder" UBYTE OneToOne 1 100 0.00 255.0 ECU_ADDRESS 0xD0001E03 /end MEASUREMENT
/begin MEASUREMENT Epm_numVariant "Im aktuellen Programmstand aktive EPM Varianten." UWORD OneToOne 1 100 0.00 65535.00 ECU_ADDRESS 0xD00057FC /end MEASUREMENT
/begin MEASUREMENT Epm_numVersion "Versionsnummer des EPM-Paketes (z.B. 710 entspricht EPM71)" UWORD OneToOne 1 100 0.00 65535.00 ECU_ADDRESS 0xC00008CA /end MEASUREMENT
/begin MEASUREMENT Epm_phiDiffRRS_mp "Abweichung des gesetzten Winkels mit Auslauf-Erkennung und dem realen Winkel" SWORD AngleCrS 1 100 -720.0000 719.9780 ECU_ADDRESS 0xC0009E1E /end MEASUREMENT
/begin MEASUREMENT Epm_phiDiffTDC "Abstand zwischen zwei Zylinder" SWORD AngleCrS 1 100 -720.0000 719.9780 ECU_ADDRESS 0xD00009F8 /end MEASUREMENT
/begin MEASUREMENT Epm_phiIntDelay_mp "Winkeldifferenz zwischen Soll und Ist Position des Syncro Interrupts" SWORD AngleCrS 1 100 -720.0000 719.9780 ECU_ADDRESS 0xC0009E20 /end MEASUREMENT
/begin MEASUREMENT Epm_stCmbTestReq "Zustand für Anforderung des Verbrennungstests" UBYTE Epm_stCmbTestReq_State_t 1 100 0.00 10.0000000000 FORMAT "%13.10" ECU_ADDRESS 0xD0001E04 /end MEASUREMENT
/begin MEASUREMENT Epm_stOpMode "Zustand Betriebsmodus" UBYTE Epm_stOpMode_State_t 1 100 1.00000000000 60.0000000000 FORMAT "%13.10" ECU_ADDRESS 0xD0001E05 /end MEASUREMENT
/begin MEASUREMENT Epm_stReSyncReason_mp "Ursache für Umsynchronisatin / Verlust der Synchronisation im Zustand Epm_stOpMode = 33" UBYTE Epm_stReSyncReason_State_t 1 100 0.00 5.00000000000 FORMAT "%13.11" ECU_ADDRESS 0xC000B19D /end MEASUREMENT
/begin MEASUREMENT Epm_stRmtInjVlv "Einspritzung für nächsten Zylinder liegt im Master (=0) oder im Slave (=1)" UBYTE OneToOne 1 100 0.00 255.0 ECU_ADDRESS 0xD0001E06 /end MEASUREMENT
/begin MEASUREMENT Epm_stSpd "Auswahl der Motordrehzahl" UBYTE Epm_stSpd_t 1 100 0.00 4.00000000000 FORMAT "%13.11" ECU_ADDRESS 0xD0001E07 /end MEASUREMENT
/begin MEASUREMENT Epm_stSync "Zustand Synchronisation" UBYTE Epm_stSync_State_t 1 100 0.00 30.0000000000 FORMAT "%13.10" ECU_ADDRESS 0xD0001E08 /end MEASUREMENT
/begin MEASUREMENT Epm_tiSegRaw_mp "Rohwert der Zeit eines Segments" SLONG OneToOne_us 1 100 -2147483648.00 2147483647.00 FORMAT "%13.2" ECU_ADDRESS 0xC0008EE4 /end MEASUREMENT
/begin MEASUREMENT Epm_tiSpd2Zero_mp "Timer bis Motordrehzahl Null" UWORD Time_ms 1 100 0.00 655350.0 ECU_ADDRESS 0xC0009E24 /end MEASUREMENT
/begin MEASUREMENT ErrLmp_stMIL "MIL-Statusanzeige" UBYTE OneToOne 1 100 0.00 255.0 ECU_ADDRESS 0xD0001E09 /end MEASUREMENT
/begin MEASUREMENT ErrLmp_stMILDigOut_mp "Messpunkt für den Ausgangswert für MIL-Test" UBYTE OneToOne 1 100 0.00 255.0 ECU_ADDRESS 0xC000B19E /end MEASUREMENT
/begin MEASUREMENT ErrLmp_stMILReq "MIL-Anforderungsstatus" UBYTE OneToOne 1 100 0.00 255.0 ECU_ADDRESS 0xD0001E0A /end MEASUREMENT
/begin MEASUREMENT ErrLmp_stOrdGlwLmp "Status des Auftrags zu der Glühlampen" UBYTE OneToOne 1 100 0.00 255.0 ECU_ADDRESS 0xD0001E0B /end MEASUREMENT
/begin MEASUREMENT ErrLmp_stSVS "SVS-Lampenstatus" UBYTE OneToOne 1 100 0.00 255.0 ECU_ADDRESS 0xD0001E0C /end MEASUREMENT
/begin MEASUREMENT ErrLmp_stSVSDigOut_mp "Messpunkt für den Ausgangswert für SVS-Test" UBYTE OneToOne 1 100 0.00 255.0 ECU_ADDRESS 0xC000B19F /end MEASUREMENT
/begin MEASUREMENT ErrLmp_stSVSReq "SVS-Anforderungsstatus" UBYTE OneToOne 1 100 0.00 255.0 ECU_ADDRESS 0xD0001E0D /end MEASUREMENT
/begin MEASUREMENT ErrLmp_stTstStateMil "" UBYTE OneToOne 1 100 0.00 255.0 ECU_ADDRESS 0xD0001E0E /end MEASUREMENT
/begin MEASUREMENT ErrLmp_stTstStateSVS "" UBYTE OneToOne 1 100 0.00 255.0 ECU_ADDRESS 0xD0001E0F /end MEASUREMENT
/begin MEASUREMENT ESC_stErr "Abtastzeit Stack-Überlauffehler" UBYTE OneToOne 1 100 0.00 255.0 ECU_ADDRESS 0xC0007EDB /end MEASUREMENT
/begin MEASUREMENT ESC_stSchdFlag_mp "Messpunkt für die aktuelle Position des bedingten Schedulings" UBYTE OneToOne 1 100 0.00 255.0 ECU_ADDRESS 0xC000B1A0 /end MEASUREMENT
/begin MEASUREMENT ESC_stSchdLevel_mp "Messpunkt für das aktive Drehzahlband der Abschrankung" UBYTE OneToOne 1 100 0.00 255.0 ECU_ADDRESS 0xC000B1A1 /end MEASUREMENT
/begin MEASUREMENT ESC_stSchdS0_mp "Messpunkt für einen Eintrag der S0-Interrupttabelle, der die Aktivierung des Containers anzeigt" UBYTE ESC_stSchdSx_CntnrNames_t 1 100 0.00 255.000000000 FORMAT "%13.9" ARRAY_SIZE 16 ECU_ADDRESS 0xC000BBDC /end MEASUREMENT
/begin MEASUREMENT ESC_stSchdS1_mp "Messpunkt für einen Eintrag der S1-Interrupttabelle, der die Aktivierung des Containers anzeigt" UBYTE ESC_stSchdSx_CntnrNames_t 1 100 0.00 255.000000000 FORMAT "%13.9" ARRAY_SIZE 16 ECU_ADDRESS 0xC000BBEC /end MEASUREMENT
/begin MEASUREMENT ESC_tiSampling "Abtastzeit" SLONG Per_Dur 1 100 -2147483648.00 2147483647.00 FORMAT "%13.2" ECU_ADDRESS 0xC0003754 /end MEASUREMENT
/begin MEASUREMENT ETClb_ctInjCycl_mp "Aktuelle Anzahl der Einspritzzyklen für die Ansteuerdauerkalibrierung" UWORD OneToOne 1 100 0.00 65535.00 ECU_ADDRESS 0xC0009E2A /end MEASUREMENT
/begin MEASUREMENT ETClb_ctLrn_mp "Lernzykluszähler für jeden Raildruck-Kalibrierpunkt der Ansteuerdauerkalibrierung" UWORD OneToOne 1 100 0.00 65535.00 ARRAY_SIZE 3 ECU_ADDRESS 0xC000BC2A /end MEASUREMENT
/begin MEASUREMENT ETClb_dtiETFlt0_mp "Gefilterte Ansteuerdauerdifferenz der Ansteuerdauerkalibrierung für jeden Zylinder beim Raildruck-Kalibrierpunkt 0" SWORD InjTime_us 1 100 -13107.20 5000.00 ARRAY_SIZE 6 ECU_ADDRESS 0xC000BC30 /end MEASUREMENT
/begin MEASUREMENT ETClb_dtiETFlt1_mp "Gefilterte Ansteuerdauerdifferenz der Ansteuerdauerkalibrierung für jeden Zylinder beim Raildruck-Kalibrierpunkt 1" SWORD InjTime_us 1 100 -13107.20 5000.00 ARRAY_SIZE 6 ECU_ADDRESS 0xC000BC3C /end MEASUREMENT
/begin MEASUREMENT ETClb_dtiETFlt2_mp "Gefilterte Ansteuerdauerdifferenz der Ansteuerdauerkalibrierung für jeden Zylinder beim Raildruck-Kalibrierpunkt 2" SWORD InjTime_us 1 100 -13107.20 5000.00 ARRAY_SIZE 6 ECU_ADDRESS 0xC000BC48 /end MEASUREMENT
/begin MEASUREMENT ETClb_numCylCur_mp "Aktueller Zylinder für die Ansteuerdauerkalibrierung bei jedem Raildruck-Kalibrierpunkt" UBYTE OneToOne 1 100 0.00 255.0 ARRAY_SIZE 3 ECU_ADDRESS 0xC000BBFC /end MEASUREMENT
/begin MEASUREMENT ETClb_numPres_mp "Aktueller Raildruck-Kalibrierpunkt der Ansteuerdauerkalibrierung" UBYTE OneToOne 1 100 0.00 255.0 ECU_ADDRESS 0xC000B1A2 /end MEASUREMENT
/begin MEASUREMENT ETClb_numRailPresClbPnt_mp "Anzahl der Raildruck-Kalibrierpunkte für die Ansteuerdauerkalibrierung" UBYTE OneToOne 1 100 0.00 255.0 ECU_ADDRESS 0xC000B1A3 /end MEASUREMENT
/begin MEASUREMENT ETClb_pRailSet "Zustand der Ansteuerdauerkalibrierung" SWORD OneToOne 1 100 -32768.00 32767.00 ARRAY_SIZE 3 ECU_ADDRESS 0xD0000938 /end MEASUREMENT
/begin MEASUREMENT ETClb_stCor "Statusanzeige der Freigaben für die Ansteuerdauerkorrektur der Nullmengenkalibrierung" UBYTE OneToOne 1 100 0.00 255.0 ECU_ADDRESS 0xD0001DE5 /end MEASUREMENT
/begin MEASUREMENT ETClb_stDemCor_mp "Anforderung der Ansteuerdauerkorrektur der Ansteuerdauerkalibrierung" UBYTE OneToOne 1 100 0.00 255.0 ECU_ADDRESS 0xC000B1A4 /end MEASUREMENT
/begin MEASUREMENT ETClb_stEvalResult_mp "Ergebnis der Ansteuerdauerkalibrierungs-Einspritzungen" UBYTE ETClb_Eval_Rslt 1 100 0.00 2.00000000000 FORMAT "%13.11" ECU_ADDRESS 0xC000B1A9 /end MEASUREMENT
/begin MEASUREMENT ETClb_stEval_mp "Zustand des Zustandsautomaten zur Auswertung der Ansteuerdauerkalibrierung" UBYTE ETClb_Eval_State 1 100 0.00 2.00000000000 FORMAT "%13.11" ARRAY_SIZE 3 ECU_ADDRESS 0xC000BC5A /end MEASUREMENT
/begin MEASUREMENT ETClb_stOld_mp "Alter Zustand der Ansteuerdauerkalibrierung" UBYTE ETClb_State 1 100 0.00 3.00000000000 FORMAT "%13.11" ECU_ADDRESS 0xC000B1A5 /end MEASUREMENT
/begin MEASUREMENT ETClb_stRailpClbPntMaxErr_mp "Ergebnis der Ansteuerdauerkalibrierungs-Einspritzungen" UBYTE OneToOne 1 100 0.00 255.0 ARRAY_SIZE 6 ECU_ADDRESS 0xC000BC5D /end MEASUREMENT
/begin MEASUREMENT ETClb_stRailpClbPntMinErr_mp "Ergebnis der Ansteuerdauerkalibrierungs-Einspritzungen" UBYTE OneToOne 1 100 0.00 255.0 ARRAY_SIZE 6 ECU_ADDRESS 0xC000BC63 /end MEASUREMENT
/begin MEASUREMENT ETClb_stRlsCylCor_mp "Zylinderspezifische Freigabe der Ansteuerdauerkorrektur der Ansteuerdauerkalibrierung" UBYTE OneToOne 1 100 0.00 255.0 ECU_ADDRESS 0xC000B1A8 /end MEASUREMENT
/begin MEASUREMENT ETClb_st_mp "Zustand der Ansteuerdauerkalibrierung" UBYTE ETClb_State 1 100 0.00 3.00000000000 FORMAT "%13.11" ECU_ADDRESS 0xC000B1A6 /end MEASUREMENT
/begin MEASUREMENT ETClb_swtCorActv "SW-Schalter zur Aktivierung der Ansteuerdauerkorrektur der Nullmengenkalibrierung" UBYTE OneToOne 1 100 0.00 255.0 ECU_ADDRESS 0xD0001DE7 /end MEASUREMENT
/begin MEASUREMENT ETClb_swtQckClb_mp "Anzeiger der Umschaltung auf schnelle Ansteuerdauerkalibrierung" UBYTE OneToOne 1 100 0.00 255.0 ECU_ADDRESS 0xC000B1A7 /end MEASUREMENT
/begin MEASUREMENT ETClb_tiBstPresCor_mp "Laddruck-Korrekturzeiten für die ZFC Einspritzungen" SWORD InjTime_us 1 100 -13107.20 5000.00 ECU_ADDRESS 0xC0009E2C /end MEASUREMENT
/begin MEASUREMENT ETClb_tiETAvrg "Zustand der Ansteuerdauerkalibrierung" SWORD OneToOne 1 100 -32768.00 32767.00 ARRAY_SIZE 3 ECU_ADDRESS 0xD0000944 /end MEASUREMENT
/begin MEASUREMENT ETClb_tiETCor0_mp "Ansteuerdauerkorrekturwert der Ansteuerdauer-Kalibrierung für den Raildruck-Kalibrierpunkt 0" SWORD InjTime_us 1 100 -13107.20 5000.00 ARRAY_SIZE 6 ECU_ADDRESS 0xC000BC00 /end MEASUREMENT
/begin MEASUREMENT ETClb_tiETCor1_mp "Ansteuerdauerkorrekturwert der Ansteuerdauer-Kalibrierung für den Raildruck-Kalibrierpunkt 1" SWORD InjTime_us 1 100 -13107.20 5000.00 ARRAY_SIZE 6 ECU_ADDRESS 0xC000BC0C /end MEASUREMENT
/begin MEASUREMENT ETClb_tiETCor2_mp "Ansteuerdauerkorrekturwert der Ansteuerdauer-Kalibrierung für den Raildruck-Kalibrierpunkt 2" SWORD InjTime_us 1 100 -13107.20 5000.00 ARRAY_SIZE 6 ECU_ADDRESS 0xC000BC18 /end MEASUREMENT
/begin MEASUREMENT ETClb_tiETCur_mp "Aktuelle Ansteuerdauer der Ansteuerdauer-Kalibrierung für jeden Raildruck-Kalibrierpunkt" SWORD InjTime_us 1 100 -13107.20 5000.00 ARRAY_SIZE 3 ECU_ADDRESS 0xC000BC24 /end MEASUREMENT
/begin MEASUREMENT ETClb_tiETMax "Ergebnis der Ansteuerdauerkalibrierungs-Einspritzungen" SWORD OneToOne 1 100 -32768.00 32767.00 ARRAY_SIZE 6 ECU_ADDRESS 0xD0000950 /end MEASUREMENT
/begin MEASUREMENT ETClb_tiETMin "Ergebnis der Ansteuerdauerkalibrierungs-Einspritzungen" SWORD OneToOne 1 100 -32768.00 32767.00 ARRAY_SIZE 6 ECU_ADDRESS 0xD000095C /end MEASUREMENT
/begin MEASUREMENT ETClb_tiETMinEff_mp "Ansteuerdauer der Nullmenge des aktuellen Zylinder für jeden Raildruck-Kalibrierpunkt" SWORD InjTime_us 1 100 -13107.20 5000.00 ARRAY_SIZE 3 ECU_ADDRESS 0xC000BC54 /end MEASUREMENT
/begin MEASUREMENT Etc_ctCurRunTst "Enthält die aktuelle Anzahl laufender Motortests" UBYTE OneToOne 1 100 0.00 255.0 ECU_ADDRESS 0xD0001E10 /end MEASUREMENT
/begin MEASUREMENT Layer_iGen "" SWORD Curr_10A_Step_A 1 100 -327680.0 327670.0 FORMAT "%8.1" ECU_ADDRESS 0xD00010AA /end MEASUREMENT
/begin MEASUREMENT Layer_rCtrPwrSpCos "" SWORD Prc 1 100 -400.0000 399.9878 ECU_ADDRESS 0xD00010BA /end MEASUREMENT
/begin MEASUREMENT Layer_rLoadGen "" SWORD Prc 1 100 -400.0000 399.9878 ECU_ADDRESS 0xD00010C0 /end MEASUREMENT
/begin MEASUREMENT Layer_stCtrCbr "" UBYTE OneToOne 1 100 0.00 255.0 ECU_ADDRESS 0xD0001FA2 /end MEASUREMENT
/begin MEASUREMENT Layer_stCtrPCos "" UBYTE OneToOne 1 100 0.00 255.0 ECU_ADDRESS 0xD0001FA3 /end MEASUREMENT
/begin MEASUREMENT Layer_stCtrPwrCos "" UWORD OneToOne 1 100 0.00 65535.00 ECU_ADDRESS 0xD00015F4 /end MEASUREMENT
/begin MEASUREMENT Layer_stFldLvlEngOil "" UBYTE OneToOne 1 100 0.00 255.0 ECU_ADDRESS 0xD0001FA6 /end MEASUREMENT
/begin MEASUREMENT Layer_stGen "" UBYTE OneToOne 1 100 0.00 255.0 ECU_ADDRESS 0xD0001FA8 /end MEASUREMENT
/begin MEASUREMENT Layer_stLoadGen "" UBYTE OneToOne 1 100 0.00 255.0 ECU_ADDRESS 0xD0001FAE /end MEASUREMENT
/begin MEASUREMENT Layer_stRqPCos "" UBYTE OneToOne 1 100 0.00 255.0 ECU_ADDRESS 0xD0001FB2 /end MEASUREMENT
/begin MEASUREMENT Layer_stSelSpCos "" UBYTE OneToOne 1 100 0.00 255.0 ECU_ADDRESS 0xD0001FB3 /end MEASUREMENT
/begin MEASUREMENT Layer_stVolEngOil "" UBYTE OneToOne 1 100 0.00 255.0 ECU_ADDRESS 0xD0001FB6 /end MEASUREMENT
/begin MEASUREMENT Layer_stVoltageLevel "" UBYTE OneToOne 1 100 0.00 255.0 ECU_ADDRESS 0xD0001FB7 /end MEASUREMENT
/begin MEASUREMENT Layer_uBatt "" SWORD Volt_Batt 1 100 -655360.0 655340.0 ECU_ADDRESS 0xD00010CA /end MEASUREMENT
/begin FUNCTION EngECU_co ""
 /begin DEF_CHARACTERISTIC Com_dnDynDisp.Pos_C Com_dnDynDisp.Neg_C Com_dTrqOvrRunRmp.Pos_C Com_dTrqOvrRunRmp.Neg_C Com_dTrqWhlRmp.Pos_C Com_dTrqWhlRmp.Neg_C Com_facTrqInrStrt_C Com_nEISGovOffs_C Com_nEngOn_C Com_qOvrRun_C Com_rWaterVlvClose_C Com_rWaterVlvCtl_C Com_rWaterVlvDef_C Com_rWaterVlvOpen_C Com_stTrqInrErr_C Com_swtASDdc_C Com_swtHtgUpTempSel_C Com_swtHtqUpCoEOMOff_C Com_swtLLDynDisp_C Com_tEngLimHi_C Com_tEngLimLo_C Com_tiDebDscAck.tiHiLo_C Com_tiDebDscAck.tiLoHi_C Com_tiDebGbxAck.tiHiLo_C Com_tiDebGbxAck.tiLoHi_C Com_tiNDynDisp_C Com_tWaterVlv_C Com_vT15Hw_C /end DEF_CHARACTERISTIC
 /begin IN_MEASUREMENT ACCI_stCLCTRV ACCI_stError ACCI_stOff ACCI_trqDes AccPed_trqDes ActMod_trqInr APP_rUnFlt Brk_stMn Brk_stRed CEngDsT_t Clth_st CnvSet_qSet CoEng_st CoEng_stShutOffPath CoETS_trqInrLim CoETS_trqInrLimSet CoETS_trqInrLtd CoETS_trqUnFltLtd Com_bRecACC Com_nGbxOut Com_rHtFlowReq Com_stDynDisp Com_stT15Hw Com_stTSC CoPT_trqTraDes CoVeh_trqAcs CoVMD_trqCrCtl CrCtl_stCLCTRV EngDa_tFld EngDem_stTrqLimErrActv Epm_nEng FlSys_volTotFlCons GlbDa_vX HLSDem_nSetPLo HLSDem_stIDLE Layer_stLPCOff PSP_dvolOut PthSet_stOvrRun PthSet_tiRmpStrt PthSet_tiSwtOff PthSet_trqLimOffs PthSet_trqSetASDdc PT_rTraGear PT_rTrq PT_stGrip PT_stTraType PT_trqLos PT_trqSpdGovLtd PT_trqWhl PT_trqWhlMaxEng PT_trqWhlMinEng RngMod_trqMin SpdGov_trqSet StSys_stStrt StSys_trqStrt T15_st Tra_numGear Tra_stCoEOMASTAdptDem VehMot_rTrqDfftl VehV_v VMD_rVirtAPP VMD_rVirtAPPDes VMD_stVirtAPP WaHt_stHtgUp /end IN_MEASUREMENT
 /begin OUT_MEASUREMENT Com_dDispRpmCTR Com_dDsplGSICHK Com_dDsplGSICTR Com_dEngineCTR Com_dStatusMSACHK Com_dStatusMSACTR Com_dTorque1CHK Com_dTorque1CTR Com_dTorque2CHK Com_dTorque2CTR Com_dTorque3CHK Com_dTorque3CTR Com_dTrqWheel2CHK Com_dTrqWheel2CTR Com_dTrqWheelCHK Com_dTrqWheelCTR Com_dummyTX1 Com_dummyTX2 Com_dummyTX3 Com_dummyTXEvent Com_dvolOut Com_iCurrEngDes Com_nDynDisp Com_numGearDsplTar Com_rAPP Com_rWaterVlv Com_stAckReqT15 Com_stAdptShftPoint Com_stBrk Com_stBrkPedal Com_stCLCTRV Com_stClthOpenPlaus Com_stCtrPrio Com_stCtrPrioCf Com_stDscAck Com_stEng Com_stGbxAck Com_stGearShftIdctr Com_stGrip Com_stHtgUp Com_stHtgUpHyst Com_stInjDu Com_stIntfPT Com_stLPCOff Com_stMSAFct Com_stMSAStart Com_stMSAStop Com_stnEng Com_stOBDCtl Com_stOvrRun Com_stPCos Com_stRdcDwnCtlRpm Com_stSwLevRpm Com_stTrqInr Com_trqCootdTar Com_trqDVCH Com_trqGbx Com_trqInr Com_trqMdInd Com_trqMdIndNe Com_trqResPos Com_trqWhl Com_trqWhlMax Com_trqWhlMin Com_volTotFlCons /end OUT_MEASUREMENT
 /begin LOC_MEASUREMENT Com_trqBefRmp_mp Com_trqInrLtd_mp Com_tstHtgUp_mp Layer_iGen Layer_rCtrPwrSpCos Layer_rLoadGen Layer_stCtrCbr Layer_stCtrPCos Layer_stCtrPwrCos Layer_stFldLvlEngOil Layer_stGen Layer_stLoadGen Layer_stRqPCos Layer_stSelSpCos Layer_stVolEngOil Layer_stVoltageLevel Layer_uBatt /end LOC_MEASUREMENT
/end FUNCTION
/begin FUNCTION EngECU_fa ""
 /begin DEF_CHARACTERISTIC Com_swtAngAcpd_FA_C Com_swtBNVltg_FA_C Com_swtDispRpmPt_FA_C Com_swtDriveTrainData1_FA_C Com_swtDriveTrainData2_FA_C Com_swtElektrMOelMess_FA_C Com_swtEngine1_FA_C Com_swtHtMgtEngCtr_FA_C Com_swtPwrmngCtrCos_FA_C Com_swtStatusBatterie_FA_C Com_swtStCospFuEng_FA_C Com_swtStEnergGen_FA_C Com_swtTrqCrsh1_FA_C Com_swtTrqCrsh2_FA_C Com_swtTrqCrsh3_FA_C Com_swtWhlTrqPT4_FA_C Com_swtWhlTrqPT5_FA_C /end DEF_CHARACTERISTIC
 /begin OUT_MEASUREMENT Com_dAngAcpdCHK_FA Com_dAngAcpdCTR_FA Com_dDispRpmEngCTR_FA Com_dDriveTrainData2CHK_FA Com_dDriveTrainData2CTR_FA Com_dTrqCrsh1CHK_FA Com_dTrqCrsh1CTR_FA Com_dTrqCrsh2CHK_FA Com_dTrqCrsh2CTR_FA Com_dTrqCrsh3CHK_FA Com_dTrqCrsh3CTR_FA Com_dWhlTrqPT4CHK_FA Com_dWhlTrqPT4CTR_FA Com_dWhlTrqPT5CHK_FA Com_dWhlTrqPT5CTR_FA Com_stTrqInrQl Com_stTrqWhlFASQl Com_stTrqWhlStbQl /end OUT_MEASUREMENT
/end FUNCTION
/begin FUNCTION EngECU_flex ""
 /begin DEF_CHARACTERISTIC Com_dtrqWheelRmp.Pos_C Com_dtrqWheelRmp.Neg_C Com_tiDebRTrq.tiHiLo_C Com_tiDebRTrq.tiLoHi_C Com_tiTrqAccPT1Flt_C Com_trqLosDflt_MAP /end DEF_CHARACTERISTIC
 /begin IN_MEASUREMENT ACCI_stError ACCI_stOff ActMod_trqClth Clth_st Com_nGbxOut Com_stClthOpen Com_stGear Com_stGrip Com_stOvrRun Com_stTSC CrCtl_stCLCTRV Epm_nEng ISC_trqDrvTrnAccUnFlt ISC_trqEngAccUnFlt PT_rTrq PT_stGrip PT_stTraType PT_trqLos PT_trqSpdGovLtd PT_trqWhlMaxEng PT_trqWhlMinEng Tra_numGear VehMot_rTrqDfftl /end IN_MEASUREMENT
 /begin OUT_MEASUREMENT Com_bLckOvrRunShOff Com_bShftDwn Com_ctrDebugFlxChA Com_ctrHeaderErrFlxChA Com_ctrSlotBoundaryFlxChA Com_ctrSyntaxErrFlxChA Com_nGbxRed Com_PSPdvolOut Com_rTrqPT Com_stAPPQl Com_stBrkQl Com_stDDEQual Com_stDrvDirDes Com_stECUQlICM Com_stGbxModDemFAS Com_stLckGbxDemQl Com_stnEngQl Com_stNGbxRedQl Com_stRTrqPTQl Com_stSLck Com_stStrt Com_stStrtLck Com_stTrqGbxQl Com_stTrqWhlQl Com_stvVehQL /end OUT_MEASUREMENT
 /begin LOC_MEASUREMENT Com_stGrip_mp Com_trqISCAccFlt_mp Com_trqLos_mp Com_trqWhl_mp /end LOC_MEASUREMENT
/end FUNCTION
/begin FUNCTION EngECU_fx ""
 /begin DEF_CHARACTERISTIC Com_swtAngAcpd_FX_C Com_swtDataPT2_FX_C Com_swtDataPT_FX_C Com_swtGbxDriveTrain_FX_C Com_swtStatusMSA_FX_C Com_swtTrqCrsh1_FX_C Com_swtTrqCrsh3_FX_C Com_swtVerbraucherstg_FX_C Com_swtWhlTrqPT1_FX_C Com_swtWhlTrqPT2_FX_C Com_swtWhlTrqPT3_FX_C Com_swtWhlTrqPT4_FX_C Com_swtWhlTrqPT5_FX_C /end DEF_CHARACTERISTIC
 /begin OUT_MEASUREMENT Com_dAngAcpdCHK_FX Com_dAngAcpdCTR_FX Com_dDataPT2CHK_FX Com_dDataPT2CTR_FX Com_dTrqCrsh1CTR_FX /end OUT_MEASUREMENT
 /begin LOC_MEASUREMENT Com_dDebugCTR_FX Com_dTrqCrsh1CHK_FX Com_dWhlTrqPT1CHK_FX Com_dWhlTrqPT1CTR_FX Com_dWhlTrqPT2CHK_FX Com_dWhlTrqPT2CTR_FX Com_dWhlTrqPT3CHK_FX Com_dWhlTrqPT3CTR_FX Com_dWhlTrqPT4CHK_FX Com_dWhlTrqPT4CTR_FX Com_dWhlTrqPT5CHK_FX Com_dWhlTrqPT5CTR_FX /end LOC_MEASUREMENT
/end FUNCTION
/begin FUNCTION EngICO_Co ""
 /begin DEF_CHARACTERISTIC EngICO_dnRmp.Pos_C EngICO_dnRmp.Neg_C EngICO_nCtOff_C EngICO_stMode_C /end DEF_CHARACTERISTIC
 /begin IN_MEASUREMENT Epm_nEng Mo_stICOMsg Mo_stIrvErrReacMsg SpdGov_nSetPHi /end IN_MEASUREMENT
 /begin OUT_MEASUREMENT EngICO_nCtOff EngICO_stICO /end OUT_MEASUREMENT
/end FUNCTION
/begin FUNCTION EngPrt_FWOscDet ""
 /begin DEF_CHARACTERISTIC EngPrt_nTrqShutOff_C EngPrt_swtDebOn_C EngPrt_tiFWOsc_C EngPrt_tiNoFWOsc_C /end DEF_CHARACTERISTIC
 /begin IN_MEASUREMENT CoEng_st EpmSeq_numInt EpmSyn_phiInt Epm_numCyl FBC_numAASeg /end IN_MEASUREMENT
 /begin OUT_MEASUREMENT EngPrt_tiSeg /end OUT_MEASUREMENT
 /begin LOC_MEASUREMENT EngPrt_stOscDet_mp EngPrt_tiFWOsc_mp EngPrt_tiNoFWOsc_mp EngPrt_tiSegMax_mp /end LOC_MEASUREMENT
/end FUNCTION
/begin FUNCTION EngPrt_OvrSpd ""
 /begin DEF_CHARACTERISTIC EngPrt_nOvrSpd_C EngPrt_nThrClsdHi_C EngPrt_nThrClsdLo_C EngPrt_rAPPThrClsdHi_C EngPrt_rAPPThrClsdLo_C EngPrt_tiThrClsd_C EngPrt_tiThrOpn_C /end DEF_CHARACTERISTIC
 /begin IN_MEASUREMENT APP_r Epm_nEng /end IN_MEASUREMENT
 /begin OUT_MEASUREMENT EngPrt_stOvrSpd EngPrt_stThrClsd /end OUT_MEASUREMENT
/end FUNCTION
/begin FUNCTION EngPrt_PrtLimMech ""
 /begin DEF_CHARACTERISTIC EngPrt_facCTCor_CUR EngPrt_RmpCBLim.Pos_C EngPrt_RmpCBLim.Neg_C EngPrt_RmpNLim.Pos_C EngPrt_RmpNLim.Neg_C EngPrt_RmpTrqLim.Pos_C EngPrt_RmpTrqLim.Neg_C EngPrt_rVnDAMax_C EngPrt_rVnDAMin_C EngPrt_rVnTrqMax_C EngPrt_rVnTrqMin_C EngPrt_trqCBLim_MAP EngPrt_trqLimDA_CUR EngPrt_trqLim_MAP EngPrt_trqNCor_CUR EngPrt_trqNLimSpr_CUR EngPrt_trqNLim_CUR /end DEF_CHARACTERISTIC
 /begin IN_MEASUREMENT CEngDsT_t Clth_st CodVar_stTrqInr EngDa_tEng EnvP_p Epm_nEng Tra_numGear /end IN_MEASUREMENT
 /begin OUT_MEASUREMENT EngPrt_trqLimMech EngPrt_trqLimPrvLim EngPrt_trqNLim EngPrt_trqPrtLim EngPrt_trqPrtLimCor /end OUT_MEASUREMENT
 /begin LOC_MEASUREMENT EngPrt_trqCTCor_mp EngPrt_trqLimDA_mp /end LOC_MEASUREMENT
/end FUNCTION
/begin FUNCTION EngPrt_PrtLimOvht ""
 /begin DEF_CHARACTERISTIC EngPrt_dtOvhtLim.Pos_C EngPrt_dtOvhtLim.Neg_C EngPrt_dtrqLimDiffOvht.Pos_C EngPrt_dtrqLimDiffOvht.Neg_C EngPrt_dtrqReplVal.Pos_C EngPrt_dtrqReplVal.Neg_C EngPrt_dtrqReplValDynCor.Pos_C EngPrt_dtrqReplValDynCor.Neg_C EngPrt_facAPSPrv2_MAP EngPrt_facAPSPrvEOM_MAP EngPrt_facAPSPrv_MAP EngPrt_facOvhtPrtRmp_CUR EngPrt_facOvhtPrvTrailer_MAP EngPrt_facOvhtPrv_MAP EngPrt_facT31Ovht_MAP EngPrt_factCACDsPrv_CUR EngPrt_ITrqLimKiNeg_C EngPrt_ITrqLimKiPos_C EngPrt_ITrqLimKi_C EngPrt_numEngTempOvhtPrv_C EngPrt_pAPSPrvDfl_C EngPrt_PTrqLimKpNeg_C EngPrt_PTrqLimKpPos_C EngPrt_PTrqLimKp_C EngPrt_stOvhtPrtEOMMsk_CA EngPrt_stTrailerErr_C EngPrt_swtT31PrtAct_C EngPrt_swtT31PrtReplValAct_C EngPrt_swtT31_C EngPrt_tInit_C EngPrt_tiT31PT1_C EngPrt_tiTOvhtThresPT1_C EngPrt_tOvhtT31Lim_C EngPrt_tOvhtT40Lim_C EngPrt_trqLimDiffOvhtMax_C EngPrt_trqLimDiffOvhtMin_MAP EngPrt_tT31PrtOfs_CUR EngPrt_tTrqLimIWinNeg_C EngPrt_tTrqLimIWinPos_C EngPrt_tTrqLimPWinNeg_C EngPrt_tTrqLimPWinPos_C /end DEF_CHARACTERISTIC
 /begin IN_MEASUREMENT Air_tCACDs CoEOM_facRmpVal CoEOM_stOpModeAct Com_stTrailer EnvP_p Epm_nEng InjCtl_qSetUnBal PCR_pDesT20Cor PCR_pDesTrbChPrtCor VehV_v /end IN_MEASUREMENT
 /begin OUT_MEASUREMENT EngPrt_facPrtLim EngPrt_trqLimDiffOvht_mp EngPrt_trqLimIOut_mp EngPrt_trqLimOvhtPrv EngPrt_trqLimOvhtPrvUnCor_mp EngPrt_trqLimPOut_mp EngPrt_tT31Flt_mp /end OUT_MEASUREMENT
 /begin LOC_MEASUREMENT EngPrt_facAPSCor_mp EngPrt_facAPSPrvEOM_mp EngPrt_facAPSPrvPrt_mp EngPrt_facAPSPrv_mp EngPrt_facOvhtPrvPrt_mp EngPrt_facT31Ovht_mp EngPrt_factCACDsCor_mp EngPrt_pDesMinT31Ovht_mp EngPrt_stT31PrtAct_mp EngPrt_tEngDaFld_mp EngPrt_tOvhtDvt_mp EngPrt_tOvhtThresFlt_mp EngPrt_tOvhtThres_mp EngPrt_tOvht_mp EngPrt_trqLimDiffOvhtMin_mp EngPrt_trqReplValDynCor_mp EngPrt_trqReplVal_mp EngPrt_tT31OvhtRmpOut_mp EngPrt_tT31PrtOfs_mp /end LOC_MEASUREMENT
/end FUNCTION
/begin FUNCTION EngPrt_TrqLimCalc "" /begin IN_MEASUREMENT EngPrt_trqLimMech EngPrt_trqLimOvhtPrv /end IN_MEASUREMENT /begin OUT_MEASUREMENT EngPrt_trqLim EngPrt_trqLimLead /end OUT_MEASUREMENT /end FUNCTION
/begin FUNCTION EngReq_FullLdIncr "" /begin OUT_MEASUREMENT EngReq_qFullLdIncrOfs /end OUT_MEASUREMENT /end FUNCTION
/begin FUNCTION EngReq_InjLimCalc "" /begin IN_MEASUREMENT T3Lim_qLim /end IN_MEASUREMENT /begin OUT_MEASUREMENT EngReq_trqInrQLim /end OUT_MEASUREMENT /end FUNCTION
/begin FUNCTION EngReq_SmkLimCalc ""
 /begin DEF_CHARACTERISTIC EngReq_facRmpVal_CUR EngReq_SlpLim.Pos_C EngReq_SlpLim.Neg_C /end DEF_CHARACTERISTIC
 /begin IN_MEASUREMENT CoEOM_facRmpVal PhyMod_stNxt PhyMod_stPrs SmkLim_qLimSmkNxt SmkLim_qLimSmkPrs /end IN_MEASUREMENT
 /begin OUT_MEASUREMENT EngReq_trqInrLimSmk EngReq_trqInrLimSmkNxt EngReq_trqInrLimSmkPrs /end OUT_MEASUREMENT
 /begin LOC_MEASUREMENT EngReq_facRmpVal_mp EngReq_qLimSmkNxt_mp EngReq_qLimSmkPrs_mp EngReq_trqInrLimSmkNxt_mp EngReq_trqInrLimSmkPrs_mp EngReq_trqLimSmkUnLim_mp /end LOC_MEASUREMENT
/end FUNCTION
/begin FUNCTION EngReq_TrqLimCalc "" /begin IN_MEASUREMENT EngReq_trqInrLimSmk EngReq_trqInrQLim InjSys_trqLim /end IN_MEASUREMENT /begin OUT_MEASUREMENT EngReq_trqLim EngReq_trqLimLead /end OUT_MEASUREMENT /end FUNCTION
/begin FUNCTION EngSpd "" /begin IN_MEASUREMENT DevLib_stPwrStgEnaCond Epm_nEng /end IN_MEASUREMENT /begin SUB_FUNCTION EngSpd_DD /end SUB_FUNCTION /end FUNCTION
/begin FUNCTION EngSpd_DD ""
 /begin DEF_CHARACTERISTIC EngSpd_Pwm.tiPer_C EngSpd_Pwm.stLvl_C EngSpd_Pwm.rMaxDty_C EngSpd_Pwm.rPerUn_C EngSpd_Pwm.tiPh_C EngSpd_PwmOut.rMin_C EngSpd_PwmOut.rMax_C EngSpd_PwmOut.tiBtwTstSCB_C EngSpd_PwmOut.tiBtwTstOT_C EngSpd_PwmOut.numTstMax_C EngSpd_PwmOut.swtBattCor_C EngSpd_PwmOut.swtPsInv_C EngSpd_rPs_C EngSpd_stPsDiaDisbl_C EngSpd_stPsDisbl_C /end DEF_CHARACTERISTIC
 /begin IN_MEASUREMENT DevLib_stPwrStgEnaCond Epm_nEng /end IN_MEASUREMENT
/end FUNCTION
/begin FUNCTION EngStA_DD ""
 /begin DEF_CHARACTERISTIC EngStA_DigOut.tiBtwTstSCB_C EngStA_DigOut.tiBtwTstOT_C EngStA_DigOut.numTstMax_C EngStA_stPsDiaDisbl_C EngStA_stPsDisbl_C /end DEF_CHARACTERISTIC
 /begin IN_MEASUREMENT DevLib_stPwrStgEnaCond /end IN_MEASUREMENT
 /begin OUT_MEASUREMENT EngStA_st EngStA_stPs /end OUT_MEASUREMENT
/end FUNCTION
/begin FUNCTION EngTrqPtd_ASD "" /begin DEF_CHARACTERISTIC EngTrqPtd_tiT1_C EngTrqPtd_trqFltMax_C EngTrqPtd_trqMax_C /end DEF_CHARACTERISTIC /begin IN_MEASUREMENT ASDdc_trq /end IN_MEASUREMENT
 /begin OUT_MEASUREMENT EngTrqPtd_stLim EngTrqPtd_trqASD EngTrqPtd_trqASDFlt EngTrqPtd_trqFlt /end OUT_MEASUREMENT
/end FUNCTION
/begin FUNCTION EngTrqPtd_CoOfs ""
 /begin DEF_CHARACTERISTIC EngTrqPtd_nEngMin_C EngTrqPtd_rTrqNOfs_MAP EngTrqPtd_rTrqTOfs_MAP EngTrqPtd_tiPthSetDeb_C /end DEF_CHARACTERISTIC
 /begin REF_CHARACTERISTIC Mo_trqIdcMax_C /end REF_CHARACTERISTIC
 /begin IN_MEASUREMENT EngTrqPtd_trqASD Epm_nEng MoFCoOfs_rTrqPtdMsg MoFOvR_stActvMsg PthLead_stActvMonLim PthSet_ctProcSet PthSet_stActvMonLim PthSet_trqInrSetNoMo PthSet_trqInrSetSum SpdGov_trqSet /end IN_MEASUREMENT
 /begin OUT_MEASUREMENT EngTrqPtd_ctProc10ms EngTrqPtd_ctProcSet EngTrqPtd_rTrqPtdOld EngTrqPtd_stPthLim EngTrqPtd_tiPthSetDebDly EngTrqPtd_trqASDSum EngTrqPtd_trqLim EngTrqPtd_trqSpdGSum /end OUT_MEASUREMENT
 /begin LOC_MEASUREMENT EngTrqPtd_rTrqNPtd_mp EngTrqPtd_rTrqTPtd_mp EngTrqPtd_stLimDeb_mp EngTrqPtd_stLimUnDeb_mp EngTrqPtd_trqASDAvrg_mp EngTrqPtd_trqInrAvrg_mp EngTrqPtd_trqInrSet_mp EngTrqPtd_trqSpdGAvrg_mp EngTrqPtd_trqTOfs_mp /end LOC_MEASUREMENT
/end FUNCTION
/begin FUNCTION EngTrqPtd_SpdG ""
 /begin DEF_CHARACTERISTIC EngTrqPtd_rAppRls_C EngTrqPtd_trqMax_MAP EngTrqPtd_trqSpdGPtd_MAP /end DEF_CHARACTERISTIC
 /begin REF_CHARACTERISTIC AGSDem_stActive_C AGSDem_tiMaxActive_C /end REF_CHARACTERISTIC
 /begin IN_MEASUREMENT APP_r Com_stModDKG EngDa_tEng Epm_nEng ISC_numCurrFunc MoFDrDem_trqOvrRunMsg MoFETC_stTstMsg /end IN_MEASUREMENT
 /begin OUT_MEASUREMENT EngTrqPtd_trqSpdG /end OUT_MEASUREMENT
 /begin LOC_MEASUREMENT EngTrqPtd_stDKGActv_mp /end LOC_MEASUREMENT
/end FUNCTION
/begin FUNCTION EnvP_DD "" /begin DEF_CHARACTERISTIC EnvP_pTransf_CUR EnvP_SRC.uMin_C EnvP_SRC.uMax_C /end DEF_CHARACTERISTIC /begin OUT_MEASUREMENT EnvP_pSens EnvP_uRaw /end OUT_MEASUREMENT /end FUNCTION
/begin FUNCTION EnvP_VD ""
 /begin DEF_CHARACTERISTIC EnvP_RmpSlp.Pos_C EnvP_RmpSlp.Neg_C EnvP_swtSensPres_C EnvP_TransStg.Dfl_C EnvP_TransStg.stSensId_C /end DEF_CHARACTERISTIC
 /begin OUT_MEASUREMENT EnvP_p /end OUT_MEASUREMENT
/end FUNCTION
/begin FUNCTION EnvP_VDModel "" /begin DEF_CHARACTERISTIC EnvP_nLimHigh_C EnvP_pCorr_MAP EnvP_tiDel_C /end DEF_CHARACTERISTIC /begin IN_MEASUREMENT Air_pIntkVUs Epm_nEng Epm_nEngDiff /end IN_MEASUREMENT /end FUNCTION
/begin FUNCTION EnvT_DD "" /begin IN_MEASUREMENT Com_tEnvT /end IN_MEASUREMENT /begin LOC_MEASUREMENT EnvT_tSens EnvT_uRaw /end LOC_MEASUREMENT /end FUNCTION
/begin FUNCTION EnvT_VD ""
 /begin DEF_CHARACTERISTIC EnvT_RmpSlp.Pos_C EnvT_RmpSlp.Neg_C EnvT_tAirCorr_MAP EnvT_tClntMod_CUR EnvT_tiLPFiltPT1_C EnvT_tiTempAirPT1_C EnvT_tiTempClntPT1_C EnvT_TransStg.Dfl_C EnvT_TransStg.stSensId_C /end DEF_CHARACTERISTIC
 /begin IN_MEASUREMENT Air_pIntkVUs Air_tCACDs CEngDsT_t EnvP_p /end IN_MEASUREMENT
 /begin OUT_MEASUREMENT EnvT_t EnvT_tMod /end OUT_MEASUREMENT
 /begin LOC_MEASUREMENT EnvT_tAirCorrPT1_mp EnvT_tAirCorr_mp EnvT_tClntModCur_mp EnvT_tClntPT1_mp /end LOC_MEASUREMENT
/end FUNCTION
/begin FUNCTION EpmBCa_TstInj ""
 /begin DEF_CHARACTERISTIC EpmBCa_facSegTimeAcc_CUR EpmBCa_facSegTimeConstHigh_C EpmBCa_facSegTimeConstLow_C EpmBCa_nTstInjMax_C EpmBCa_numInjSer_C EpmBCa_numTstInjMax_C EpmBCa_phiSegEndOld_C EpmBCa_phiSegLen_C /end DEF_CHARACTERISTIC
 /begin IN_MEASUREMENT EpmSeq_numInt EpmSyn_phiInt Epm_ctCyl Epm_nEng Epm_numCyl Epm_phiDiffTDC /end IN_MEASUREMENT
 /begin LOC_MEASUREMENT EpmBCa_ctInjSer EpmBCa_ctTstInj EpmBCa_ctWaitTDC EpmBCa_CurrCyl EpmBCa_facTimes_mp EpmBCa_numCylInj EpmBCa_numWaitTDC EpmBCa_stTstInj EpmBCa_stTstInjRslt_mp EpmBCa_tiSegOld_mp EpmBCa_tiSeg_mp /end LOC_MEASUREMENT
/end FUNCTION
/begin FUNCTION EpmBCr_IntrCo "" /begin DEF_CHARACTERISTIC EpmBCr_phiTimeoutInt_C EpmBCr_swtEnable_C /end DEF_CHARACTERISTIC
 /begin IN_MEASUREMENT EpmCaS_nEng EpmCrS_stDiagErrSig EpmCrS_stDiagNoSig EpmSeq_phiNxtInt EpmSyn_phiInt /end IN_MEASUREMENT
 /begin OUT_MEASUREMENT EpmBCr_stIntrCo EpmBCr_stTmrModeStarted /end OUT_MEASUREMENT
/end FUNCTION
/begin FUNCTION EpmBCr_Plaus ""
 /begin DEF_CHARACTERISTIC EpmBCr_nEng_DST EpmBCr_phiSync2Seg_C EpmBCr_rSeg2SegMax_GCUR EpmBCr_rSeg2SegMin_GCUR EpmBCr_rSeg2SyncMax_GCUR EpmBCr_rSeg2SyncMin_GCUR /end DEF_CHARACTERISTIC
 /begin IN_MEASUREMENT Epm_nEng /end IN_MEASUREMENT
 /begin OUT_MEASUREMENT EpmBCr_phiSeg2Seg EpmBCr_tiSeg /end OUT_MEASUREMENT
 /begin LOC_MEASUREMENT EpmBCr_rSeg2SegMax_mp EpmBCr_rSeg2SegMin_mp EpmBCr_rSeg2Seg_mp EpmBCr_rSeg2SyncMax_mp EpmBCr_rSeg2SyncMin_mp EpmBCr_rSeg2Sync_mp EpmBCr_stPlaus_mp /end LOC_MEASUREMENT
/end FUNCTION
/begin FUNCTION EpmBCr_Pos "" /begin DEF_CHARACTERISTIC EpmBCr_phiZero2Sync_CA /end DEF_CHARACTERISTIC /begin IN_MEASUREMENT EpmBCr_phiSeg2Seg EpmBCr_tiSeg /end IN_MEASUREMENT /begin OUT_MEASUREMENT EpmBCr_nEng EpmBCr_phiPos EpmBCr_stPos /end OUT_MEASUREMENT /begin LOC_MEASUREMENT EpmBCr_phiCurrCaSEdge EpmBCr_phiNxtCaSEdge EpmBCr_tiIncPer /end LOC_MEASUREMENT /end FUNCTION
/begin FUNCTION EpmCaS_Adap "" /begin LOC_MEASUREMENT EpmCaS_stAdap /end LOC_MEASUREMENT /end FUNCTION
/begin FUNCTION EpmCaS_Diag ""
 /begin DEF_CHARACTERISTIC EpmCaS_numEdgeTol_C EpmCaS_numErrSigDef_C EpmCaS_numErrSigOk_C EpmCaS_numNoSigDef_C EpmCaS_stDiagMode_C /end DEF_CHARACTERISTIC
 /begin IN_MEASUREMENT EpmSeq_numInt Epm_ctCyl Epm_stOpMode T15_st /end IN_MEASUREMENT
 /begin OUT_MEASUREMENT EpmCaS_stErrSig EpmCaS_stNoSig /end OUT_MEASUREMENT
 /begin LOC_MEASUREMENT EpmCaS_ctErrSigDef EpmCaS_ctErrSigOk EpmCaS_ctNoSig EpmCaS_numCurrEdge EpmCaS_stDiag /end LOC_MEASUREMENT
/end FUNCTION
/begin FUNCTION EpmCaS_Meas "" /begin DEF_CHARACTERISTIC EpmCaS_swtMeasCaS_C /end DEF_CHARACTERISTIC /begin IN_MEASUREMENT EpmCrS_stSigMode Epm_stOpMode /end IN_MEASUREMENT /begin LOC_MEASUREMENT EpmCaS_numRawValue_mp EpmCaS_phiRawValue_mp /end LOC_MEASUREMENT /end FUNCTION
/begin FUNCTION EpmCaS_OfsDiag ""
 /begin DEF_CHARACTERISTIC EpmCaS_numOfsErr_C EpmCaS_phiOfsMax_C EpmCaS_phiOfsMin_C EpmCaS_phiOfsTolc_C EpmCaS_stOfsDiagMode_C EpmCaS_tiOfsPT1_C /end DEF_CHARACTERISTIC
 /begin IN_MEASUREMENT EpmCaS_phiCor EpmSyn_stRR Epm_stOpMode /end IN_MEASUREMENT
 /begin OUT_MEASUREMENT EpmCaS_phiCaSOfsAvg EpmCaS_phiOfsCorr EpmCaS_stOfs EpmCaS_stOfsErr /end OUT_MEASUREMENT
 /begin LOC_MEASUREMENT EpmCaS_ctOfsErr_mp EpmCaS_numBufEntry_mp EpmCaS_numSegTeeth_mp EpmCaS_numValidTeeth_mp EpmCaS_phiMissedSeg_mp EpmCaS_phiSegLenTolc_mp EpmCaS_phiSpeedSegLen_mp /end LOC_MEASUREMENT
/end FUNCTION
/begin FUNCTION EpmCaS_Seg ""
 /begin DEF_CHARACTERISTIC EpmCaS_dSegSeries_CA EpmCaS_facPlausHigh_GCUR EpmCaS_facPlausLow_GCUR EpmCaS_facPlaus_DST EpmCaS_numSegSerLst_C EpmCaS_phiNCor_CUR EpmCaS_phiSegLenTol_CA EpmCaS_phiSegLen_CA EpmCaS_phiSegOfs_CA EpmCaS_phiTempCor05_DST EpmCaS_phiTempCorI1_GCUR EpmCaS_stActEdge_C EpmCaS_tiGlitchFilter_C EpmCaS_tiTimeout_C /end DEF_CHARACTERISTIC
 /begin IN_MEASUREMENT EngDa_tEng EpmCaS_stAdap Epm_nEng /end IN_MEASUREMENT
 /begin OUT_MEASUREMENT EpmCaS_ctEdgeEquid EpmCaS_nEng EpmCaS_phiCor EpmCaS_phiDiff EpmCaS_phiEdge EpmCaS_phiTempCor EpmCaS_stNEng EpmCaS_tiEdge /end OUT_MEASUREMENT
 /begin LOC_MEASUREMENT EpmCaS_nCaS_mp /end LOC_MEASUREMENT
/end FUNCTION
/begin FUNCTION EpmCaS_SegCor "" /end FUNCTION
/begin FUNCTION EpmCrS_Diag ""
 /begin DEF_CHARACTERISTIC EpmCrS_dnEngMax_C EpmCrS_nDiagOff_C EpmCrS_nDiagOn_C EpmCrS_numErrSigGlitMax_C EpmCrS_numErrSigIncDef_C EpmCrS_numErrSigMaxDef_C EpmCrS_numErrSigMinOK_C EpmCrS_numNoSigDef_C EpmCrS_stDiagT50Reset_C EpmCrS_swtEnableDiag_C /end DEF_CHARACTERISTIC
 /begin IN_MEASUREMENT CoEng_st EpmCaS_stNEng Epm_dnEngFlt Epm_nEng Epm_stOpMode Strt_stPs T15_st VehV_v /end IN_MEASUREMENT
 /begin OUT_MEASUREMENT EpmCrS_stDiag EpmCrS_stDiagErrSig EpmCrS_stDiagNoSig /end OUT_MEASUREMENT
 /begin LOC_MEASUREMENT EpmCrS_ctCaSRev_mp EpmCrS_ctErrSig EpmCrS_ctGlitch EpmCrS_ctGlitchRev_mp EpmCrS_ctRev100msLim_mp EpmCrS_ctRevWaitDiag EpmCrS_stDiagFFReset_mp EpmCrS_stDiagReset_mp EpmCrS_stDiagVehSpdReset_mp EpmCrS_stSigDiagSrc /end LOC_MEASUREMENT
/end FUNCTION
/begin FUNCTION EpmCrS_Plaus ""
 /begin DEF_CHARACTERISTIC EpmCrS_facGapCrit1_C EpmCrS_facGapCrit2_C EpmCrS_facGapPlausHigh_CA EpmCrS_facIncPlausHigh_CA EpmCrS_facIncPlausLow_CA EpmCrS_facIncPlsTolc_C EpmCrS_nMaxInc_C EpmCrS_nMinInc_C EpmCrS_nThreshRange_CA EpmCrS_nTiIncPerAvrg_CA EpmCrS_numIgnInc_C EpmCrS_numTiIncPerAvrg_CA EpmCrS_tiGlitchFilter_CA EpmCrS_tiIgnSig_C /end DEF_CHARACTERISTIC
 /begin IN_MEASUREMENT EpmCrS_stSigMode Epm_nEng /end IN_MEASUREMENT
 /begin LOC_MEASUREMENT EpmCrS_ctRange_mp EpmCrS_numTiIncPerAvrg_mp EpmCrS_tiIncPer_mp /end LOC_MEASUREMENT
/end FUNCTION
/begin FUNCTION EpmCrS_RevCnt ""
 /begin IN_MEASUREMENT CoEng_st EpmCrS_numSeg EpmHCrS_stSigMode Epm_nEng Epm_stSync /end IN_MEASUREMENT
 /begin OUT_MEASUREMENT EpmCrS_ctRevIni EpmCrS_ctRevStrt /end OUT_MEASUREMENT
 /begin LOC_MEASUREMENT EpmCrS_ctRevCnt /end LOC_MEASUREMENT
/end FUNCTION
/begin FUNCTION EpmCrS_Seg ""
 /begin DEF_CHARACTERISTIC EpmCrS_facScale_C EpmCrS_nFacScale_C EpmCrS_stTTMeasureOn_C EpmCrS_swtIncSrc_C /end DEF_CHARACTERISTIC
 /begin REF_CHARACTERISTIC EpmSeq_phiInt_CA EpmSeq_swtInt_C /end REF_CHARACTERISTIC
 /begin IN_MEASUREMENT EpmSeq_numInt EpmSyn_phiInt Epm_ctCyl Epm_nEng Epm_numCyl Epm_stOpMode /end IN_MEASUREMENT
 /begin OUT_MEASUREMENT EpmCrS_numSeg EpmCrS_stSigMode EpmCrS_tiSeg EpmCrS_tiSegCurr /end OUT_MEASUREMENT
 /begin LOC_MEASUREMENT EpmCrS_facScale_mp EpmCrS_numNewInc_mp EpmCrS_tiInc_mp /end LOC_MEASUREMENT
/end FUNCTION
/begin FUNCTION EpmHCaS_SigBuf "" /end FUNCTION
/begin FUNCTION EpmHCaS_SigEval "" /end FUNCTION
/begin FUNCTION EpmHCrS_SigBuf "" /begin IN_MEASUREMENT EpmSyn_phiInt Epm_phiDiffTDC /end IN_MEASUREMENT /end FUNCTION
/begin FUNCTION EpmHCrS_SigEval ""
 /begin DEF_CHARACTERISTIC EpmHCrS_swtDGIEna_C EpmHCrS_swtIAPDvtCorEna_C EpmHCrS_swtIAPEna_C EpmHCrS_swtIASEna_C /end DEF_CHARACTERISTIC
 /begin IN_MEASUREMENT EpmCrS_stSigMode /end IN_MEASUREMENT
 /begin OUT_MEASUREMENT EpmHCrS_ctIncEngPos EpmHCrS_ctIncEngPosStrt EpmHCrS_stSigErr EpmHCrS_stSigMode /end OUT_MEASUREMENT
 /begin LOC_MEASUREMENT EpmHCrS_ctIncEngPosDev /end LOC_MEASUREMENT
/end FUNCTION
/begin FUNCTION EpmHInt_IntGen "" /begin LOC_MEASUREMENT EpmHInt_tiInt4Del_mp /end LOC_MEASUREMENT /end FUNCTION
/begin FUNCTION EpmHwe_Ini "" /end FUNCTION
/begin FUNCTION EpmHwe_Srv "" /end FUNCTION
/begin FUNCTION EpmRRS_AgDetect "" /begin DEF_CHARACTERISTIC EpmRRS_nEngDiffMin_C EpmRRS_nEngMax_C /end DEF_CHARACTERISTIC /begin REF_CHARACTERISTIC Epm_phiGap2Zero_C /end REF_CHARACTERISTIC /begin IN_MEASUREMENT Epm_nEng Epm_nEngDiff Epm_stOpMode Epm_stSync VehV_v /end IN_MEASUREMENT /begin OUT_MEASUREMENT EpmRRS_bEngSwOff /end OUT_MEASUREMENT
 /begin LOC_MEASUREMENT EpmRRS_bEngStopAg_mp EpmRRS_ctInc10msOld_mp EpmRRS_ctInc10ms_mp EpmRRS_ctIncArrayNew_mp EpmRRS_ctIncEngStop_mp EpmRRS_ctIncEstGap_mp EpmRRS_ctIncRdPos_mp EpmRRS_GapPos_mp EpmRRS_phiCalcPos_mp EpmRRS_phiEngStop_mp EpmRRS_phiRdPos_mp EpmRRS_stAgDetect_mp EpmRRS_stToothAgCond_mp EpmRRS_stToothGapArrayCond_mp EpmRRS_tiToothPerOrg_mp EpmRRS_tiToothTypic_mp /end LOC_MEASUREMENT
/end FUNCTION
/begin FUNCTION EpmSeq_StateMn ""
 /begin DEF_CHARACTERISTIC EpmSeq_nMaxStrtInt_C EpmSeq_phiDelayMax_C EpmSeq_phiIntBCr_CA EpmSeq_phiInt_CA EpmSeq_phiStrtInt_CA EpmSeq_phiSyncInt_C EpmSeq_swtInt_C /end DEF_CHARACTERISTIC
 /begin IN_MEASUREMENT EpmCrS_stSigMode Epm_nEng Epm_numCyl Epm_stOpMode /end IN_MEASUREMENT
 /begin OUT_MEASUREMENT EpmSeq_numIncDiffInt EpmSeq_numInt EpmSeq_phiNxtInt EpmSeq_stInt /end OUT_MEASUREMENT
/end FUNCTION
/begin FUNCTION EpmSrv_Lib "" /begin DEF_CHARACTERISTIC EpmSrv_numTDCMIAPStrt_C EpmSrv_numTDCMIAP_C /end DEF_CHARACTERISTIC /begin IN_MEASUREMENT Epm_nEng /end IN_MEASUREMENT /begin LOC_MEASUREMENT EpmSrv_stCnvAgT2Ag_mp /end LOC_MEASUREMENT /end FUNCTION
/begin FUNCTION EpmSyn_CaSPos ""
 /begin DEF_CHARACTERISTIC EpmSyn_dCaSSegMsk_C EpmSyn_dTrigMsk_C EpmSyn_dTrigRslt_C EpmSyn_phiTrig_C /end DEF_CHARACTERISTIC
 /begin IN_MEASUREMENT Epm_stOpMode /end IN_MEASUREMENT
 /begin OUT_MEASUREMENT EpmSyn_stRR /end OUT_MEASUREMENT
 /begin LOC_MEASUREMENT EpmSyn_CaSData EpmSyn_ctEdgeEarly EpmSyn_ctEdgeLate EpmSyn_ctLstEdge_mp EpmSyn_ctSigTabLstEntr_mp EpmSyn_EdgeFailType EpmSyn_numCaSSync EpmSyn_numMatches_mp EpmSyn_numMatchPos EpmSyn_numMatchPos_mp EpmSyn_numNewEdges_mp EpmSyn_numSegInSigTab_mp EpmSyn_phiCaSPos EpmSyn_phiSegLenUncorr EpmSyn_stCasEval EpmSyn_stCaSPos EpmSyn_stGapPos EpmSyn_stPreSeg_mp /end LOC_MEASUREMENT
/end FUNCTION
/begin FUNCTION EpmSyn_CrSPos "" /begin DEF_CHARACTERISTIC EpmSyn_phiIncCor_CUR EpmSyn_phiRRMax_C /end DEF_CHARACTERISTIC /begin IN_MEASUREMENT EpmCrS_stSigMode EpmSyn_stRR Epm_nEng Epm_stOpMode /end IN_MEASUREMENT /begin OUT_MEASUREMENT EpmSyn_phiInt EpmSyn_stCrSPos EpmSyn_stCrSPosErr /end OUT_MEASUREMENT /begin LOC_MEASUREMENT EpmSyn_phiDiff_mp EpmSyn_phiIncCor_mp EpmSyn_phiOffs /end LOC_MEASUREMENT /end FUNCTION
/begin FUNCTION Epm_Auto "" /begin DEF_CHARACTERISTIC Epm_numConf_CA /end DEF_CHARACTERISTIC /begin LOC_MEASUREMENT Epm_numVersion /end LOC_MEASUREMENT /end FUNCTION
/begin FUNCTION Epm_Axispoints "" /end FUNCTION
/begin FUNCTION Epm_HE "" /begin OUT_MEASUREMENT Epm_ctCylPerECU Epm_stRmtInjVlv /end OUT_MEASUREMENT /end FUNCTION
/begin FUNCTION Epm_Ini ""
 /begin DEF_CHARACTERISTIC Epm_numCyl_C Epm_numFireSeg_C Epm_phiGap2Zero_C Epm_phiTdc1_C /end DEF_CHARACTERISTIC
 /begin OUT_MEASUREMENT Epm_numCyl Epm_phiDiffTDC /end OUT_MEASUREMENT
 /begin LOC_MEASUREMENT Epm_numVariant /end LOC_MEASUREMENT
/end FUNCTION
/begin FUNCTION Epm_OpMode ""
 /begin DEF_CHARACTERISTIC Epm_nNoSyncVerify_C Epm_numReSync_C Epm_phiDiffMax_C Epm_phiIgrOfs_C Epm_swtBlkInjCaSSync_C Epm_swtOpModeStgy_C /end DEF_CHARACTERISTIC
 /begin REF_CHARACTERISTIC EpmCaS_stActEdge_C EpmCaS_tiGlitchFilter_C /end REF_CHARACTERISTIC
 /begin IN_MEASUREMENT EpmBCr_phiPos EpmBCr_stTmrModeStarted EpmCaS_nEng EpmCaS_stOfsErr EpmCrS_stSigMode EpmRRS_bEngSwOff EpmSeq_numInt EpmSeq_phiNxtInt EpmSyn_phiInt EpmSyn_stCrSPos EpmSyn_stCrSPosErr EpmSyn_stRR Epm_ctCylPerECU Epm_nEng Epm_numCyl /end IN_MEASUREMENT
 /begin OUT_MEASUREMENT Epm_ctCyl Epm_stCmbTestReq Epm_stOpMode Epm_stSync /end OUT_MEASUREMENT
 /begin LOC_MEASUREMENT Epm_ctReSync_mp Epm_ctTDCPhys_mp Epm_phiDiffRRS_mp Epm_phiIntDelay_mp Epm_stReSyncReason_mp /end LOC_MEASUREMENT
/end FUNCTION
/begin FUNCTION Epm_Spd "" /begin DEF_CHARACTERISTIC Epm_tiSpd2Zero_C /end DEF_CHARACTERISTIC
 /begin IN_MEASUREMENT EpmBCr_nEng EpmBCr_stPos EpmCaS_nEng EpmCaS_stErrSig EpmCaS_stNoSig EpmCrS_stDiag EpmCrS_stDiagErrSig EpmCrS_stDiagNoSig EpmCrS_stSigMode EpmCrS_tiSeg EpmCrS_tiSegCurr EpmSyn_phiInt Epm_stOpMode /end IN_MEASUREMENT
 /begin OUT_MEASUREMENT Epm_nEng Epm_nEng10ms Epm_nEngCurr Epm_nEngLRes Epm_nEngRaw Epm_stSpd /end OUT_MEASUREMENT
 /begin LOC_MEASUREMENT Epm_nEngTooth10ms_mp Epm_tiSegRaw_mp Epm_tiSpd2Zero_mp /end LOC_MEASUREMENT
/end FUNCTION
/begin FUNCTION Epm_SpdGrd "" /begin DEF_CHARACTERISTIC Epm_tiSpdGrdFlt_C /end DEF_CHARACTERISTIC /begin IN_MEASUREMENT EpmCrS_tiSeg EpmSeq_numInt Epm_nEng Epm_stSync /end IN_MEASUREMENT /begin OUT_MEASUREMENT Epm_dnEng Epm_dnEngFlt Epm_nEngDiff /end OUT_MEASUREMENT /begin LOC_MEASUREMENT Epm_nEngOldS0_mp Epm_nEngOldS1_mp /end LOC_MEASUREMENT /end FUNCTION
/begin FUNCTION ErrLmp_DD ""
 /begin DEF_CHARACTERISTIC ErrLmp_MIL.nThres_C ErrLmp_MIL.tiMax_C ErrLmp_MIL.tiTst_C ErrLmp_MIL.tiDel_C ErrLmp_MIL.tiBln_C ErrLmp_MIL.stEna_C ErrLmp_Rdy.st_C ErrLmp_Rdy.ti_C ErrLmp_Rdy.tiBlnOn_C ErrLmp_Rdy.tiBlnOff_C ErrLmp_stPsMILDiaDisbl_C ErrLmp_stPsMILDisbl_C ErrLmp_stPsSVSDiaDisbl_C ErrLmp_stPsSVSDisbl_C ErrLmp_SVS.nThres_C ErrLmp_SVS.tiMax_C ErrLmp_SVS.tiTst_C ErrLmp_SVS.tiDel_C ErrLmp_SVS.tiBln_C ErrLmp_SVS.stEna_C ErrLmp_swtSVSEqGlwLmp_C /end DEF_CHARACTERISTIC
 /begin IN_MEASUREMENT CodVar_stMIL CoEng_st Com_stMILReq Com_stSVSReq DFES_stErrLamp Epm_nEng SyC_stSub /end IN_MEASUREMENT
 /begin OUT_MEASUREMENT ErrLmp_stMIL ErrLmp_stMILReq ErrLmp_stOrdGlwLmp ErrLmp_stSVS ErrLmp_stSVSReq ErrLmp_stTstStateMil ErrLmp_stTstStateSVS /end OUT_MEASUREMENT
 /begin LOC_MEASUREMENT ErrLmp_stMILDigOut_mp ErrLmp_stSVSDigOut_mp /end LOC_MEASUREMENT
/end FUNCTION
/begin FUNCTION ErrLmp_DD_TstState "" /end FUNCTION
/begin FUNCTION ESC_SeqSched ""
 /begin DEF_CHARACTERISTIC ESC_dLimCond_ASD_CA ESC_dLimCond_Common_CA ESC_dLimCond_CPP_CA ESC_dLimCond_FBC_CA ESC_dLimCond_Joint_CA ESC_dLimCond_LiGov_CA ESC_dLimCond_Post_CA ESC_dLimCond_Pre_CA ESC_dLimCond_PSC_CA ESC_dLimCond_S0_A_CA ESC_dLimCond_S0_B_CA ESC_dLimCond_S0_Rmt_CA ESC_dLimCond_S1_A_CA ESC_dLimCond_S1_B_CA ESC_dLimCond_S1_Rmt_CA ESC_dLimCond_UnitInjector_CA ESC_dLimCond_Update_CA ESC_nLimInj_C ESC_nLimThreshHyst_CA ESC_nLimThresh_CA ESC_numLimInj_C /end DEF_CHARACTERISTIC
 /begin IN_MEASUREMENT EpmCrS_tiSeg EpmCrS_tiSegCurr EpmSeq_numInt Epm_ctCyl Epm_nEng Epm_numCyl Epm_stRmtInjVlv ESC_tiSampling /end IN_MEASUREMENT
 /begin LOC_MEASUREMENT ESC_stSchdFlag_mp ESC_stSchdLevel_mp ESC_stSchdS0_mp ESC_stSchdS1_mp /end LOC_MEASUREMENT
/end FUNCTION
/begin FUNCTION ESC_Stack "" /begin IN_MEASUREMENT EpmCrS_tiSeg EpmCrS_tiSegCurr /end IN_MEASUREMENT /begin OUT_MEASUREMENT ESC_stErr ESC_tiSampling /end OUT_MEASUREMENT /end FUNCTION
/begin FUNCTION ESC_TaskLink "" /begin DEF_CHARACTERISTIC ESC_stS1FrstSched_C /end DEF_CHARACTERISTIC /begin IN_MEASUREMENT EpmSeq_numInt SyC_stSub SyC_tiDrv /end IN_MEASUREMENT /end FUNCTION
/begin FUNCTION ESS_Adapt "" /begin DEF_CHARACTERISTIC AltIO_trqDes_C /end DEF_CHARACTERISTIC /begin OUT_MEASUREMENT AltIO_trqDes /end OUT_MEASUREMENT /end FUNCTION
/begin FUNCTION Etc "" /begin DEF_CHARACTERISTIC Etc_MaxReqTO_C /end DEF_CHARACTERISTIC /begin OUT_MEASUREMENT Etc_ctCurRunTst /end OUT_MEASUREMENT /end FUNCTION
/begin FUNCTION ETClb_AVS ""
 /begin REF_CHARACTERISTIC ETClb_tiETOfsMax_CA ETClb_tiETOfsMin_CA ETClb_tiET_MAX_CA ETClb_tiET_MIN_CA /end REF_CHARACTERISTIC
 /begin IN_MEASUREMENT Epm_numCyl /end IN_MEASUREMENT
/end FUNCTION
/begin FUNCTION ETClb_Calibration ""
 /begin DEF_CHARACTERISTIC ETClb_ctLrnThresQck_C ETClb_ctLrnThresRC_C ETClb_ctLrnThres_C ETClb_dpRailLim_CA ETClb_facFltQck_C ETClb_facFltRC_C ETClb_facFlt_C ETClb_numCyclMeas_C ETClb_numCyclNoDyn_C ETClb_numCyclStartEnergize_C ETClb_pRailSet_CA ETClb_SigThres_CA ETClb_swtWrDflVal_C ETClb_tiBstPresCorr0_CUR ETClb_tiBstPresCorr1_CUR ETClb_tiBstPresCorr2_CUR ETClb_tiETOvrRunMonMax_C ETClb_volEffectiveMin_CA ETClb_vStartClb_CA ETClb_vStopClb_CA /end DEF_CHARACTERISTIC
 /begin REF_CHARACTERISTIC ETClb_tiET_MAX_CA ETClb_tiET_MIN_CA InjVlv_stZFCETCorActv_C InjVlv_swtZFCCorOvrRunOn_C /end REF_CHARACTERISTIC
 /begin IN_MEASUREMENT Air_pIntkVUs ETClb_stLimClbFrq MoFOvR_stActvMsg PthSet_stOvrRunCoord VehV_v /end IN_MEASUREMENT
 /begin OUT_MEASUREMENT ETClb_stCor ETClb_swtCorActv /end OUT_MEASUREMENT
 /begin LOC_MEASUREMENT ETClb_ctInjCycl_mp ETClb_ctLrn_mp ETClb_dtiETFlt0_mp ETClb_dtiETFlt1_mp ETClb_dtiETFlt2_mp ETClb_numCylCur_mp ETClb_numPres_mp ETClb_numRailPresClbPnt_mp ETClb_pRailSet ETClb_stDemCor_mp ETClb_stOld_mp ETClb_stRlsCylCor_mp ETClb_st_mp ETClb_swtQckClb_mp ETClb_tiBstPresCor_mp ETClb_tiETAvrg ETClb_tiETCor0_mp ETClb_tiETCor1_mp ETClb_tiETCor2_mp ETClb_tiETCur_mp ETClb_tiETMinEff_mp /end LOC_MEASUREMENT
/end FUNCTION
/begin FUNCTION ETClb_Eval "" /begin DEF_CHARACTERISTIC ETClb_tiETStep_CA ETClb_tiET_MAX_CA ETClb_tiET_MIN_CA /end DEF_CHARACTERISTIC
 /begin LOC_MEASUREMENT ETClb_stEvalResult_mp ETClb_stEval_mp ETClb_stRailpClbPntMaxErr_mp ETClb_stRailpClbPntMinErr_mp ETClb_tiETMax ETClb_tiETMin /end LOC_MEASUREMENT
/end FUNCTION
/begin COMPU_METHOD AngleCrS "" RAT_FUNC "%6.3" "deg CrS" COEFFS 0 45.5111111111 0 0 0 1 /end COMPU_METHOD
/begin COMPU_METHOD AshMs_mg_p0q0016_COMPU "" RAT_FUNC "%6.4" "mg" COEFFS 0 625 0 0 0 1 /end COMPU_METHOD
/begin COMPU_METHOD ASMod_HtFlw "" RAT_FUNC "%6.2" "J/s" COEFFS 0 0.5 0 0 0 1 /end COMPU_METHOD
/begin COMPU_METHOD CoEOMSwt_S16 "" RAT_FUNC "%7.6" "-" COEFFS 0 16384 0 0 0 1 /end COMPU_METHOD
/begin COMPU_METHOD CrSRev2CrSInc "" RAT_FUNC "%6.4" "-" COEFFS 0 60 0 0 0 1 /end COMPU_METHOD
/begin COMPU_METHOD Curr_10A_Step_A "" RAT_FUNC "%6.1" "A" COEFFS 0 1 0 0 0 10 /end COMPU_METHOD
/begin COMPU_METHOD DtyCyc "" RAT_FUNC "%5.2" "%" COEFFS 0 100 0 0 0 1 /end COMPU_METHOD
/begin COMPU_METHOD EngN "" RAT_FUNC "%5.1" "rpm" COEFFS 0 2 0 0 0 1 /end COMPU_METHOD
/begin COMPU_METHOD EngN2tiIncPer "" RAT_FUNC "%8.0" "rpm" COEFFS 0 0 1 0 4.0000002e-007 0 /end COMPU_METHOD
/begin COMPU_METHOD EngNCaS "" RAT_FUNC "%6.3" "CaSrpm" COEFFS 0 4 0 0 0 1 /end COMPU_METHOD
/begin COMPU_METHOD EngNGrd "" RAT_FUNC "%6.3" "rpm/s" COEFFS 0 2 0 0 0 1 /end COMPU_METHOD
/begin COMPU_METHOD EngN_LRes "" RAT_FUNC "%6.1" "rpm" COEFFS 0 0.025 0 0 0 1 /end COMPU_METHOD
/begin COMPU_METHOD EngTempFldSel "" TAB_VERB "%6.3" "" COMPU_TAB_REF EngTempFldSel /end COMPU_METHOD
/begin COMPU_VTAB EngTempFldSel "" TAB_VERB 4 0 "Coolant_Temperature" 1 "Oil_Temperature" 2 "EngDa_tEng" 3 "Chamberwall_Temperature" /end COMPU_VTAB
/begin COMPU_METHOD EpmBCa_FacTstInj "" RAT_FUNC "%6.5" "-" COEFFS 0 1000 0 0 0 1 /end COMPU_METHOD
/begin COMPU_METHOD EpmBCa_stTstInj_State_t "" TAB_VERB "%6.3" "" COMPU_TAB_REF EpmBCa_stTstInj_State_t /end COMPU_METHOD
/begin COMPU_VTAB EpmBCa_stTstInj_State_t "" TAB_VERB 5 0 "EPMBCA_STVOID" 1 "EPMBCA_STINJ" 2 "EPMBCA_STCALC" 3 "EPMBCA_STNOSYNC" 4 "EPMBCA_STSYNC" /end COMPU_VTAB
/begin COMPU_METHOD EpmBCr_stIntrCo_State_t "" TAB_VERB "%6.3" "" COMPU_TAB_REF EpmBCr_stIntrCo_State_t /end COMPU_METHOD
/begin COMPU_VTAB EpmBCr_stIntrCo_State_t "" TAB_VERB 4 0 "EPMBCR_STINTRCO_NOPOS" 1 "EPMBCR_STINTRCO_CASEDGE" 2 "EPMBCR_STINTRCO_SYNCRO" 3 "EPMBCR_STINTRCO_WAIT" /end COMPU_VTAB
/begin COMPU_METHOD EpmBCr_stPlaus_State "" TAB_VERB "%6.3" "" COMPU_TAB_REF EpmBCr_stPlaus_State /end COMPU_METHOD
/begin COMPU_VTAB EpmBCr_stPlaus_State "" TAB_VERB 4 0 "EPMBCR_NOSYNC" 1 "EPMBCR_SYNC" 2 "EPMBCR_SEG1" 3 "EPMBCR_SEG2" /end COMPU_VTAB
/begin COMPU_METHOD EpmBCr_stPos_State "" TAB_VERB "%6.3" "" COMPU_TAB_REF EpmBCr_stPos_State /end COMPU_METHOD
/begin COMPU_VTAB EpmBCr_stPos_State "" TAB_VERB 2 0 "EPMBCR_STPOS_NOPOS" 1 "EPMBCR_STPOS_POSFOUND" /end COMPU_VTAB
/begin COMPU_METHOD EpmCaS_Fac_Plaus "" RAT_FUNC "%6.5" "-" COEFFS 0 1000 0 0 0 1 /end COMPU_METHOD
/begin COMPU_METHOD EpmCaS_stAdap_State "" TAB_VERB "%6.3" "" COMPU_TAB_REF EpmCaS_stAdap_State /end COMPU_METHOD
/begin COMPU_VTAB EpmCaS_stAdap_State "" TAB_VERB 5 0 "EPMCAS_STNOADAP" 1 "EPMCAS_STERRADAP" 2 "EPMCAS_STADAP" 3 "EPMCAS_STADAPSTOP" 4 "EPMCAS_STFULLADAP" /end COMPU_VTAB
/begin COMPU_METHOD EpmCaS_stOfsErr_Val "" TAB_VERB "%6.3" "" COMPU_TAB_REF EpmCaS_stOfsErr_Val /end COMPU_METHOD
/begin COMPU_VTAB EpmCaS_stOfsErr_Val "" TAB_VERB 6 0 "EPMCAS_OFS_AMBI" 1 "EPMCAS_OFS_NOEQUI_EDGE" 2 "EPMCAS_OFS_LOWEQUI_EDGE" 3 "EPMCAS_OFS_NOREFPOS" 4 "EPMCAS_OFS_EXCEED" 5 "EPMCAS_OFS_OK" /end COMPU_VTAB
/begin COMPU_METHOD EpmCas_stOfs_State "" TAB_VERB "%6.3" "" COMPU_TAB_REF EpmCas_stOfs_State /end COMPU_METHOD
/begin COMPU_VTAB EpmCas_stOfs_State "" TAB_VERB 2 0 "EPMCAS_OFS_WAITSEG" 1 "EPMCAS_OFS_SEGCALC" /end COMPU_VTAB
/begin COMPU_METHOD EpmHCrS_stSigMode_State_t "" TAB_VERB "%6.3" "" COMPU_TAB_REF EpmHCrS_stSigMode_State_t /end COMPU_METHOD
/begin COMPU_VTAB EpmHCrS_stSigMode_State_t "" TAB_VERB 9 0 "RESET" 1 "HALT" 2 "WAITSIG" 3 "IGNTIME" 4 "IGNFRSTEDGE" 5 "IGNEDGE" 6 "WAITGAP" 7 "GAPFOUND" 8 "TIMERMODE" /end COMPU_VTAB
/begin COMPU_METHOD EpmRRS_bEngStopAg_t "Umrechnungsformel für Gültigkeitsbit" TAB_VERB "%6.3" "" COMPU_TAB_REF EpmRRS_bEngStopAg_t /end COMPU_METHOD
/begin COMPU_VTAB EpmRRS_bEngStopAg_t "Umrechnungsformel für Gültigkeitsbit" TAB_VERB 2 0 "EPMRRS_AG_INVLD" 1 "EPMRRS_AG_VLD" /end COMPU_VTAB
/begin COMPU_METHOD EpmRRS_stAgDetect_t "Umrechnungsformel für Zustandsvariable" TAB_VERB "%6.3" "" COMPU_TAB_REF EpmRRS_stAgDetect_t /end COMPU_METHOD
/begin COMPU_VTAB EpmRRS_stAgDetect_t "Umrechnungsformel für Zustandsvariable" TAB_VERB 8 0 "EPMRRS_DISABLE" 1 "EPMRRS_ENABLE" 2 "EPMRRS_SEARCH" 3 "EPMRRS_REJECT" 4 "EPMRRS_POSSIBLE" 5 "EPMRRS_CONFIRM" 6 "EPMRRS_UNDEF" 7 "EPMRRS_STOP" /end COMPU_VTAB
/begin COMPU_METHOD EpmSeq_numInt_Compu "" TAB_VERB "%6.3" "" COMPU_TAB_REF EpmSeq_numInt_Compu /end COMPU_METHOD
/begin COMPU_VTAB EpmSeq_numInt_Compu "" TAB_VERB 8 0 "S_0" 1 "S_1" 2 "S_0_FIRST" 3 "S_1_FIRST" 6 "S_0_FIRST_START" 7 "S_1_FIRST_START" 8 "S_EPM" 16 "S_INI" /end COMPU_VTAB
/begin COMPU_METHOD EpmSeq_stInt_Compu "" TAB_VERB "%6.3" "" COMPU_TAB_REF EpmSeq_stInt_Compu /end COMPU_METHOD
/begin COMPU_VTAB EpmSeq_stInt_Compu "" TAB_VERB 5 0 "ST_S_0" 1 "ST_S_1" 4 "ST_S_0_START" 5 "ST_S_1_START" 8 "ST_EPM" /end COMPU_VTAB
/begin COMPU_METHOD EpmSrv_stCnvAgT2Ag_t "" TAB_VERB "%6.3" "" COMPU_TAB_REF EpmSrv_stCnvAgT2Ag_t /end COMPU_METHOD
/begin COMPU_VTAB EpmSrv_stCnvAgT2Ag_t "" TAB_VERB 30 0 "0" 1 "1" 2 "2" 3 "3" 4 "4" 5 "5" 6 "6" 7 "7" 8 "8" 9 "9" 10 "10" 11 "11" 12 "12" 13 "13" 14 "14" 15 "15" 16 "16" 17 "17" 18 "18" 19 "19" 20 "20" 21 "21" 22 "22" 23 "23" 24 "24" 25 "AVRGSPD" 26 "EXTRAPOLATION" 253 "ERRORSTGY" 254 "ERRORCRS" 255 "ERRORMIAP" /end COMPU_VTAB
/begin COMPU_METHOD EpmSyn_EdgeFailTypes "" TAB_VERB "%6.3" "" COMPU_TAB_REF EpmSyn_EdgeFailTypes /end COMPU_METHOD
/begin COMPU_VTAB EpmSyn_EdgeFailTypes "" TAB_VERB 3 0 "EPMSYN_EDGE_OK" 1 "EPMSYN_EDGE_EARLY" 2 "EPMSYN_EDGE_LATE" /end COMPU_VTAB
/begin COMPU_METHOD EpmSyn_stCaSEvalComp "" TAB_VERB "%6.3" "" COMPU_TAB_REF EpmSyn_stCaSEvalComp /end COMPU_METHOD
/begin COMPU_VTAB EpmSyn_stCaSEvalComp "" TAB_VERB 5 0 "NO_CASPOS" 1 "SEARCH_CASPOS" 2 "VERIFY_CASPOS" 3 "SWTOFF_CASPOS" 4 "EVAL_CASPOS" /end COMPU_VTAB
/begin COMPU_METHOD EpmSyn_stCaSPosComp "" TAB_VERB "%6.3" "" COMPU_TAB_REF EpmSyn_stCaSPosComp /end COMPU_METHOD
/begin COMPU_VTAB EpmSyn_stCaSPosComp "" TAB_VERB 9 0 "EPMSYN_CASPOS_NOTVALID" 1 "EPMSYN_SIGTAB_NOUPDATE" 2 "EPMSYN_SIGTAB_AMBI" 5 "EPMSYN_CASPOS_VALID" 10 "EPMSYN_WRONG_SEG_LEN" 11 "EPMSYN_SIGTAB_END" 12 "EPMSYN_SIGTAB_SEQ" 13 "EPMSYN_EXCEED_TOLC" 20 "EPMSYN_CASPOS_SWTOFF" /end COMPU_VTAB
/begin COMPU_METHOD EpmSyn_stCrSPos_State_t "" TAB_VERB "%6.3" "" COMPU_TAB_REF EpmSyn_stCrSPos_State_t /end COMPU_METHOD
/begin COMPU_VTAB EpmSyn_stCrSPos_State_t "" TAB_VERB 4 0 "EPMSYN_NO_SYNC" 1 "EPMSYN_CRS_SYNC" 2 "EPMSYN_CAS_SYNC" 3 "EPMSYN_FULL_SYNC" /end COMPU_VTAB
/begin COMPU_METHOD EpmSyn_stRRComp "" TAB_VERB "%6.3" "" COMPU_TAB_REF EpmSyn_stRRComp /end COMPU_METHOD
/begin COMPU_VTAB EpmSyn_stRRComp "" TAB_VERB 2 0 "EPMSYN_FORWARDS" 1 "EPMSYN_BACKWARDS" /end COMPU_VTAB
/begin COMPU_METHOD EPM_FAC_PLAUS "" RAT_FUNC "%6.4" "-" COEFFS 0 16 0 0 0 1 /end COMPU_METHOD
/begin COMPU_METHOD Epm_stCmbTestReq_State_t "" TAB_VERB "%6.3" "" COMPU_TAB_REF Epm_stCmbTestReq_State_t /end COMPU_METHOD
/begin COMPU_VTAB Epm_stCmbTestReq_State_t "" TAB_VERB 2 0 "EPM_NO_CMBTEST" 10 "EPM_CMBTEST" /end COMPU_VTAB
/begin COMPU_METHOD Epm_stOpMode_State_t "" TAB_VERB "%6.3" "" COMPU_TAB_REF Epm_stOpMode_State_t /end COMPU_METHOD
/begin COMPU_VTAB Epm_stOpMode_State_t "" TAB_VERB 8 1 "EPM_MODE_WAIT" 5 "EPM_MODE_LOCKRESYNC" 20 "EPM_MODE_ALE" 33 "EPM_MODE_VERIFY" 36 "EPM_MODE_VERIFY_EXT" 38 "EPM_MODE_BACKUP_CAS" 48 "EPM_MODE_OK" 60 "EPM_MODE_BACKUP_CRS" /end COMPU_VTAB
/begin COMPU_METHOD Epm_stReSyncReason_State_t "" TAB_VERB "%6.3" "" COMPU_TAB_REF Epm_stReSyncReason_State_t /end COMPU_METHOD
/begin COMPU_VTAB Epm_stReSyncReason_State_t "" TAB_VERB 6 0 "EPM_RESYNC_NORESYNC" 1 "EPM_RESYNC_NOCRS" 2 "EPM_RESYNC_SYNCLOST" 3 "EPM_RESYNC_BRK" 4 "EPM_RESYNC_OFSERR" 5 "EPM_RESYNC_CANERR" /end COMPU_VTAB
/begin COMPU_METHOD Epm_stSpd_t "Status von Epm_stSpd" TAB_VERB "%6.3" "" COMPU_TAB_REF Epm_stSpd_t /end COMPU_METHOD
/begin COMPU_VTAB Epm_stSpd_t "Status von Epm_stSpd" TAB_VERB 5 0 "EPM_SPD_CRS" 1 "EPM_SPD_HOLD" 2 "EPM_SPD_ZERO" 3 "EPM_SPD_CAS" 4 "EPM_SPD_BACKUP" /end COMPU_VTAB
/begin COMPU_METHOD Epm_stSync_State_t "" TAB_VERB "%6.3" "" COMPU_TAB_REF Epm_stSync_State_t /end COMPU_METHOD
/begin COMPU_VTAB Epm_stSync_State_t "" TAB_VERB 4 0 "EPM_NO_SYNC" 10 "EPM_ALE_SYNC" 20 "EPM_CAS_SYNC" 30 "EPM_FULL_SYNC" /end COMPU_VTAB
/begin COMPU_METHOD ESC_stS1FrstSched_t "" TAB_VERB "%6.3" "" COMPU_TAB_REF ESC_stS1FrstSched_t /end COMPU_METHOD
/begin COMPU_VTAB ESC_stS1FrstSched_t "" TAB_VERB 3 0 "ESC_SX_SCHEDSTRT" 1 "ESC_S1_SCHEDSTRT" 2 "ESC_S0_SCHEDSTRT" /end COMPU_VTAB
/begin COMPU_METHOD ESC_stSchdSx_CntnrNames_t "" TAB_VERB "%6.3" "" COMPU_TAB_REF ESC_stSchdSx_CntnrNames_t /end COMPU_METHOD
/begin COMPU_VTAB ESC_stSchdSx_CntnrNames_t "" TAB_VERB 19 0 "ESC_syncPre_Cntnr" 1 "ESC_syncCommon_Cntnr" 2 "ESC_syncLiGov_Cntnr" 3 "ESC_syncASD_Cntnr" 4 "ESC_syncUpdate_Cntnr" 5 "ESC_syncS0_A_Cntnr" 6 "ESC_syncS0_B_Cntnr" 7 "ESC_syncS1_A_Cntnr" 8 "ESC_syncS1_B_Cntnr" 9 "ESC_syncFBC_Cntnr" 10 "ESC_syncJoint_Cntnr" 11 "ESC_syncUnitInjector_Cntnr" 12 "ESC_syncPost_Cntnr" 13 "ESC_syncCPP_Cntnr" 14 "ESC_syncPSC_Cntnr" 15 "ESC_syncS0_Rmt_Cntnr" 16 "ESC_syncS1_Rmt_Cntnr" 17 "ESC_ERROR_UNDEF_CNTNR" 255 "ESC_NoSched" /end COMPU_VTAB
/begin COMPU_METHOD ETClb_Eval_Rslt "" TAB_VERB "%6.3" "-" COMPU_TAB_REF ETClb_Eval_Rslt /end COMPU_METHOD
/begin COMPU_VTAB ETClb_Eval_Rslt "" TAB_VERB 3 0 "ETCLB_ST_CLB_CONT" 1 "ETCLB_ST_CLB_END" 2 "ETCLB_ST_CLB_ERR" /end COMPU_VTAB
/begin COMPU_METHOD ETClb_Eval_State "" TAB_VERB "%6.3" "-" COMPU_TAB_REF ETClb_Eval_State /end COMPU_METHOD
/begin COMPU_VTAB ETClb_Eval_State "" TAB_VERB 3 0 "ETCLB_ST_EVAL_INIT" 1 "ETCLB_ST_EVAL_ADD" 2 "ETCLB_ST_EVAL_SUB" /end COMPU_VTAB
/begin COMPU_METHOD ETClb_State "" TAB_VERB "%6.3" "-" COMPU_TAB_REF ETClb_State /end COMPU_METHOD
/begin COMPU_VTAB ETClb_State "" TAB_VERB 4 0 "ETCLB_ST_NOT_ACTV" 1 "ETCLB_ST_START_ENERGIZE" 2 "ETCLB_ST_MEASURE" 3 "ETCLB_ST_EVALUATE" /end COMPU_VTAB
/begin COMPU_METHOD Fact "" RAT_FUNC "%6.5" "-" COEFFS 0 8192 0 0 0 1 /end COMPU_METHOD
/begin COMPU_METHOD Fact100 "" RAT_FUNC "%6.4" "-" COEFFS 0 100 0 0 0 1 /end COMPU_METHOD
/begin COMPU_METHOD FlConsum_l_h "" RAT_FUNC "%6.4" "l/h" COEFFS 0 100 0 0 0 1 /end COMPU_METHOD
/begin COMPU_METHOD FlConsum_ul_20ms "" RAT_FUNC "%6.2" "ul/20ms" COEFFS 0 1 0 0 0 1 /end COMPU_METHOD
/begin COMPU_METHOD InjMass "" RAT_FUNC "%5.2" "mg/hub" COEFFS 0 100 0 0 0 1 /end COMPU_METHOD
/begin COMPU_METHOD InjQntInj "" RAT_FUNC "%5.2" "mm^3/inj" COEFFS 0 100 0 0 0 1 /end COMPU_METHOD
/begin COMPU_METHOD InjTime_us "" RAT_FUNC "%5.1" "us" COEFFS 0 2.5 0 0 0 1 /end COMPU_METHOD
/begin COMPU_METHOD Ki_Temp2Trq "" RAT_FUNC "%6.5" "Nm/_deg C/s" COEFFS 0 2147.483648 0 0 0 1 /end COMPU_METHOD
/begin COMPU_METHOD Kp_Temp2Trq "" RAT_FUNC "%7.6" "Nm/_deg C" COEFFS 0 32768 0 0 0 1 /end COMPU_METHOD
/begin COMPU_METHOD Mo_r_prc_q0p39 "" RAT_FUNC "%6.3" "%" COEFFS 0 256 0 0 0 100 /end COMPU_METHOD
/begin COMPU_METHOD Mo_trq_nm_q0p00000152587890625 "" RAT_FUNC "%8.7" "Nm" COEFFS 0 655360 0 0 0 1 /end COMPU_METHOD
/begin COMPU_METHOD Mo_trq_nm_q0p1 "" RAT_FUNC "%6.3" "Nm" COEFFS 0 10 0 0 0 1 /end COMPU_METHOD
/begin COMPU_METHOD OneToOne "" RAT_FUNC "%6.0" "-" COEFFS 0 1 0 0 0 1 /end COMPU_METHOD
/begin COMPU_METHOD OneToOne_ms "" RAT_FUNC "%6.2" "ms" COEFFS 0 1 0 0 0 1 /end COMPU_METHOD
/begin COMPU_METHOD OneToOne_us "" RAT_FUNC "%6.2" "us" COEFFS 0 1 0 0 0 1 /end COMPU_METHOD
/begin COMPU_METHOD Period "" RAT_FUNC "%6.3" "ms" COEFFS 0 10 0 0 0 1 /end COMPU_METHOD
/begin COMPU_METHOD Per_Dur "" RAT_FUNC "%6.2" "usec" COEFFS 0 1 0 0 0 1 /end COMPU_METHOD
/begin COMPU_METHOD Prc "" RAT_FUNC "%6.4" "%" COEFFS 0 81.92 0 0 0 1 /end COMPU_METHOD
/begin COMPU_METHOD Pres_hPa "" RAT_FUNC "%5.1" "hPa" COEFFS 0 1 0 0 0 1 /end COMPU_METHOD
/begin COMPU_METHOD Pres_Rail "" RAT_FUNC "%5.1" "bar" COEFFS 0 10.000000 0 0 0 1 /end COMPU_METHOD
/begin COMPU_METHOD RevCnt "" RAT_FUNC "%6.4" "-" COEFFS 0 16 0 0 0 1 /end COMPU_METHOD
/begin COMPU_METHOD RmpEngN "" RAT_FUNC "%6.4" "rpm/s" COEFFS 0 131.072 0 0 0 1 /end COMPU_METHOD
/begin COMPU_METHOD RmpPres_hPa "" RAT_FUNC "%6.4" "hPa/s" COEFFS 0 65.536 0 0 0 1 /end COMPU_METHOD
/begin COMPU_METHOD RmpTemp "" RAT_FUNC "%6.4" "K/s" COEFFS 0 655.36 0 0 0 1 /end COMPU_METHOD
/begin COMPU_METHOD RmpTrq "" RAT_FUNC "%6.4" "Nm/s" COEFFS 0 655.36 0 0 0 1 /end COMPU_METHOD
/begin COMPU_METHOD RmpTrqPrpHigh "" RAT_FUNC "%6.4" "Nm/s" COEFFS 0 655.36 0 0 0 1 /end COMPU_METHOD
/begin COMPU_METHOD TempDiff_Cels "" RAT_FUNC "%6.3" "deg C" COEFFS 0 10 0 0 0 1 /end COMPU_METHOD
/begin COMPU_METHOD Temp_Cels "" RAT_FUNC "%5.1" "deg C" COEFFS 0 10 2731.4 0 0 1 /end COMPU_METHOD
/begin COMPU_METHOD TimeDelay_ms "" RAT_FUNC "%12.1" "ms" COEFFS 0 0 1 0 2.3283064365387e-007 0 /end COMPU_METHOD
/begin COMPU_METHOD TimeDelay_s "" RAT_FUNC "%12.4" "s" COEFFS 0 0 1 0 0.00023283064365387 0 /end COMPU_METHOD
/begin COMPU_METHOD TimeDT "" RAT_FUNC "%6.2" "us" COEFFS 0 1 0 0 0 1 /end COMPU_METHOD
/begin COMPU_METHOD TimeGPTATick "" RAT_FUNC "%6.4" "ns" COEFFS 0 20 0 0 0 1 /end COMPU_METHOD
/begin COMPU_METHOD TimeGT0Tic "" RAT_FUNC "%6.5" "ns" COEFFS 0 2500 0 0 0 1 /end COMPU_METHOD
/begin COMPU_METHOD Time_ms "" RAT_FUNC "%5.0" "ms" COEFFS 0 0.1 0 0 0 1 /end COMPU_METHOD
/begin COMPU_METHOD Time_s "" RAT_FUNC "%5.2" "s" COEFFS 0 100 0 0 0 1 /end COMPU_METHOD
/begin COMPU_METHOD TransR "" RAT_FUNC "%4.2" "-" COEFFS 0 100 0 0 0 1 /end COMPU_METHOD
/begin COMPU_METHOD Trq "" RAT_FUNC "%5.1" "Nm" COEFFS 0 10 0 0 0 1 /end COMPU_METHOD
/begin COMPU_METHOD TrqPrpHigh "" RAT_FUNC "%5.1" "Nm" COEFFS 0 10 0 0 0 1 /end COMPU_METHOD
/begin COMPU_METHOD Vel "" RAT_FUNC "%5.2" "km/h" COEFFS 0 100 0 0 0 1 /end COMPU_METHOD
/begin COMPU_METHOD VelToN "" RAT_FUNC "%8.7" "(km/h)/rpm" COEFFS 0 100000 0 0 0 1 /end COMPU_METHOD
/begin COMPU_METHOD Volt "" RAT_FUNC "%6.1" "mV" COEFFS 0 5 0 0 0 1 /end COMPU_METHOD
/begin COMPU_METHOD Volt_Batt "" RAT_FUNC "%5.0" "mV" COEFFS 0 0.05 0 0 0 1 /end COMPU_METHOD
/begin COMPU_METHOD default "" RAT_FUNC "%6.2" "" COEFFS 0 1 0 0 0 1 /end COMPU_METHOD
/begin RECORD_LAYOUT Axis_Xs16 NO_AXIS_PTS_X 1 SWORD AXIS_PTS_X 2 SWORD INDEX_INCR DIRECT /end RECORD_LAYOUT
/begin RECORD_LAYOUT CurG_Ws16 FNC_VALUES 1 SWORD COLUMN_DIR DIRECT /end RECORD_LAYOUT
/begin RECORD_LAYOUT Cur_Xs16Ws16 NO_AXIS_PTS_X 1 SWORD AXIS_PTS_X 2 SWORD INDEX_INCR DIRECT FNC_VALUES 3 SWORD COLUMN_DIR DIRECT /end RECORD_LAYOUT
/begin RECORD_LAYOUT Kf_Xs16_Ys16_Ws16 NO_AXIS_PTS_X 1 SWORD NO_AXIS_PTS_Y 2 SWORD AXIS_PTS_X 3 SWORD INDEX_INCR DIRECT AXIS_PTS_Y 4 SWORD INDEX_INCR DIRECT FNC_VALUES 5 SWORD COLUMN_DIR DIRECT /end RECORD_LAYOUT
/begin RECORD_LAYOUT Kl_Xs16_Ws16 NO_AXIS_PTS_X 1 SWORD AXIS_PTS_X 2 SWORD INDEX_INCR DIRECT FNC_VALUES 3 SWORD COLUMN_DIR DIRECT /end RECORD_LAYOUT
/begin RECORD_LAYOUT Kw_Ws16 FNC_VALUES 1 SWORD COLUMN_DIR DIRECT /end RECORD_LAYOUT
/begin RECORD_LAYOUT Kw_Ws32 FNC_VALUES 1 SLONG COLUMN_DIR DIRECT /end RECORD_LAYOUT
/begin RECORD_LAYOUT Kw_Wu16 FNC_VALUES 1 UWORD COLUMN_DIR DIRECT /end RECORD_LAYOUT
/begin RECORD_LAYOUT Kw_Wu8 FNC_VALUES 1 UBYTE COLUMN_DIR DIRECT /end RECORD_LAYOUT
/begin RECORD_LAYOUT Map_Xs16Ys16Ws16 NO_AXIS_PTS_X 1 SWORD NO_AXIS_PTS_Y 2 SWORD AXIS_PTS_X 3 SWORD INDEX_INCR DIRECT AXIS_PTS_Y 4 SWORD INDEX_INCR DIRECT FNC_VALUES 5 SWORD COLUMN_DIR DIRECT /end RECORD_LAYOUT
/begin RECORD_LAYOUT ValA_Ws16 FNC_VALUES 1 SWORD COLUMN_DIR DIRECT /end RECORD_LAYOUT
/begin RECORD_LAYOUT ValA_Ws32 FNC_VALUES 1 SLONG COLUMN_DIR DIRECT /end RECORD_LAYOUT
/begin RECORD_LAYOUT ValA_Wu16 FNC_VALUES 1 UWORD COLUMN_DIR DIRECT /end RECORD_LAYOUT
/begin RECORD_LAYOUT ValA_Wu32 FNC_VALUES 1 ULONG COLUMN_DIR DIRECT /end RECORD_LAYOUT
/begin RECORD_LAYOUT ValA_Wu8 FNC_VALUES 1 UBYTE COLUMN_DIR DIRECT /end RECORD_LAYOUT
/begin RECORD_LAYOUT Val_Ws16 FNC_VALUES 1 SWORD COLUMN_DIR DIRECT /end RECORD_LAYOUT
/begin RECORD_LAYOUT Val_Ws32 FNC_VALUES 1 SLONG COLUMN_DIR DIRECT /end RECORD_LAYOUT
/begin RECORD_LAYOUT Val_Wu16 FNC_VALUES 1 UWORD COLUMN_DIR DIRECT /end RECORD_LAYOUT
/begin RECORD_LAYOUT Val_Wu8 FNC_VALUES 1 UBYTE COLUMN_DIR DIRECT /end RECORD_LAYOUT
/end MODULE
/end PROJECT

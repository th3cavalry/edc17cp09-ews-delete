ASAP2_VERSION 1 4
/begin PROJECT P_574 "EDC17_CP09"
/begin HEADER "" VERSION "V8KB" PROJECT_NO P_574 /end HEADER
/begin MODULE DIM ""
/begin MOD_COMMON "" BYTE_ORDER MSB_LAST ALIGNMENT_BYTE 1 ALIGNMENT_WORD 2 ALIGNMENT_LONG 4 ALIGNMENT_FLOAT32_IEEE 4 /end MOD_COMMON
/begin CHARACTERISTIC Com_swtATemp_FA_C "" VALUE 0x80038D60 Val_Wu8 255.0 OneToOne 0.00 255.0 /end CHARACTERISTIC
/begin CHARACTERISTIC Com_swtATemp_FX_C "" VALUE 0x80038D6A Val_Wu8 1.000 OneToOne 0.00 1.000 EXTENDED_LIMITS 0.00 255.0 /end CHARACTERISTIC
/begin CHARACTERISTIC Com_swtMileageRange_A_C "" VALUE 0x80038D5A Val_Wu8 255.0 OneToOne 0.00 255.0 /end CHARACTERISTIC
/begin CHARACTERISTIC Com_swtMileageRange_C "" VALUE 0x80038D5C Val_Wu8 1.000 OneToOne 0.00 1.000 EXTENDED_LIMITS 0.00 255.0 /end CHARACTERISTIC
/begin CHARACTERISTIC Com_swtMileageRange_FA_C "" VALUE 0x80038D61 Val_Wu8 255.0 OneToOne 0.00 255.0 /end CHARACTERISTIC
/begin CHARACTERISTIC Com_swtRelTime_FA_C "" VALUE 0x80038D62 Val_Wu8 255.0 OneToOne 0.00 255.0 /end CHARACTERISTIC
/begin CHARACTERISTIC Com_swtSecCtrRel_FA_C "" VALUE 0x80038D63 Val_Wu8 255.0 OneToOne 0.00 255.0 /end CHARACTERISTIC
/begin CHARACTERISTIC Com_swtStKombi_C "" VALUE 0x80038D5D Val_Wu8 1.000 OneToOne 0.00 1.000 EXTENDED_LIMITS 0.00 255.0 /end CHARACTERISTIC
/begin CHARACTERISTIC Com_swtTempRelTime_C "" VALUE 0x80038D5E Val_Wu8 1.000 OneToOne 0.00 1.000 EXTENDED_LIMITS 0.00 255.0 /end CHARACTERISTIC
/begin CHARACTERISTIC Com_swtTimeDate_C "" VALUE 0x80038D5F Val_Wu8 1.000 OneToOne 0.00 1.000 EXTENDED_LIMITS 0.00 255.0 /end CHARACTERISTIC
/begin CHARACTERISTIC Com_swtTimeDate_FA_C "" VALUE 0x80038D64 Val_Wu8 255.0 OneToOne 0.00 255.0 /end CHARACTERISTIC
/begin CHARACTERISTIC Com_tiSysTimeOk_C "" VALUE 0x80038D66 Val_Ws16 327670.0 Time_ms 0.00 327670.0 EXTENDED_LIMITS -327680.0 327670.0 /end CHARACTERISTIC
/begin CHARACTERISTIC Com_tiSysTimeOut_C "" VALUE 0x80038D68 Val_Ws16 327670.0 Time_ms 0.00 327670.0 EXTENDED_LIMITS -327680.0 327670.0 /end CHARACTERISTIC
/begin CHARACTERISTIC DIUMPR_Check_CA "zugewiesenen Fehlerprüfungen der IUMPR Berechnung (Variante 1)" VAL_BLK 0x80025BEE ValA_Wu16 964. DFC_Verb 0.00 964. FORMAT "%2.0" NUMBER 20 /end CHARACTERISTIC
/begin CHARACTERISTIC DIUMPR_ctGen.tiIgnMin_C "Kriterien zum Inkrementieren von General Denominator und Ignition counter/minimale Startzeit für den Ignition counter" VALUE 0x80025C16 Val_Wu8 25.50 DIUMPR_ti100ms 0.00 25.50 FORMAT "%5.2" /end CHARACTERISTIC
/begin CHARACTERISTIC DIUMPR_ctGen.tiActrMin_C "Kriterien zum Inkrementieren von General Denominator und Ignition counter/minimale Aktivierungszeit für die physikalische Freigabe einer Komponente" VALUE 0x80025C17 Val_Wu8 25.50 DIUMPR_ti100ms 0.00 25.50 FORMAT "%5.2" /end CHARACTERISTIC
/begin CHARACTERISTIC DIUMPR_ctGen.l500MD_C "Kriterien zum Inkrementieren von General Denominator und Ignition counter/minimal driven distance to release special 500 miles denominator" VALUE 0x80025C18 Val_Wu8 1260. DIUMPR_l10km 0.00 1260. FORMAT "%5.0" EXTENDED_LIMITS 0.00 2550. READ_ONLY /end CHARACTERISTIC
/begin CHARACTERISTIC DIUMPR_ctGen.tiVehSpdMin_C "Kriterien zum Inkrementieren von General Denominator und Ignition counter/minimale Betriebszeit über einer Geschwindigkeitsgrenze" VALUE 0x80025C1A Val_Ws16 6553.500 DIUMPR_ti100ms -3276.800 3276.700 FORMAT "%8.3" /end CHARACTERISTIC
/begin CHARACTERISTIC DIUMPR_ctGen.nIgnMin_C "Kriterien zum Inkrementieren von General Denominator und Ignition counter/Drehzahlgrenze für Motorstarterkennung" VALUE 0x80025C1C Val_Ws16 32767.50 EngN -16384.00 16383.50 /end CHARACTERISTIC
/begin CHARACTERISTIC DIUMPR_ctGen.pEnvMin_C "Kriterien zum Inkrementieren von General Denominator und Ignition counter/max. Höhe über Meerespiegel (representiert durch Mindestumgebungsdruck)" VALUE 0x80025C1E Val_Ws16 36268.00 Pres_hPa -32768.00 3500.00 EXTENDED_LIMITS -32768.00 32767.00 /end CHARACTERISTIC
/begin CHARACTERISTIC DIUMPR_ctGen.vVehMin_C "Kriterien zum Inkrementieren von General Denominator und Ignition counter/minimale Fahrzeuggeschwindigkeit" VALUE 0x80025C20 Val_Ws16 655.3500 Vel -327.6800 327.6700 /end CHARACTERISTIC
/begin CHARACTERISTIC DIUMPR_ctGen.rAPPMax_C "Kriterien zum Inkrementieren von General Denominator und Ignition counter/maximaler Pedalwert in Ruhestellung" VALUE 0x80025C22 Val_Ws16 799.9878 Prc -400.0000 399.9878 /end CHARACTERISTIC
/begin CHARACTERISTIC DIUMPR_ctGen.vVehIdlMax_C "Kriterien zum Inkrementieren von General Denominator und Ignition counter/maximale Fahrzeuggeschwindigkeit für die Leerlauferkennung" VALUE 0x80025C24 Val_Ws16 655.3500 Vel -327.6800 327.6700 /end CHARACTERISTIC
/begin CHARACTERISTIC DIUMPR_ctGen.tEnvMin_C "Kriterien zum Inkrementieren von General Denominator und Ignition counter/minimale Umgebungstemperatur" VALUE 0x80025C26 Val_Ws16 6553.500 Temp_Cels -3549.940 3003.560 /end CHARACTERISTIC
/begin CHARACTERISTIC DIUMPR_ctGen.tiIdlMin_C "Kriterien zum Inkrementieren von General Denominator und Ignition counter/minimale Betriebszeit im Leerlauf" VALUE 0x80025C28 Val_Ws16 6553.500 DIUMPR_ti100ms -3276.800 3276.700 FORMAT "%8.3" /end CHARACTERISTIC
/begin CHARACTERISTIC DIUMPR_ctGen.tiOpMin_C "Kriterien zum Inkrementieren von General Denominator und Ignition counter/minimale Betriebszeit seit Motorstart" VALUE 0x80025C2A Val_Ws16 6553.500 DIUMPR_ti100ms -3276.800 3276.700 FORMAT "%8.3" /end CHARACTERISTIC
/begin CHARACTERISTIC DIUMPR_ctGen.l500MDInc_C "Kriterien zum Inkrementieren von General Denominator und Ignition counter/Anzahl an Inkrements des internen Kilometerzählers in einem 10 km Intervall" VALUE 0x80025C2C Val_Ws16 65535.00 OneToOne -32768.00 32767.00 READ_ONLY /end CHARACTERISTIC
/begin CHARACTERISTIC DIUMPR_ctRatioIdx_CA "zugewiesene Messwerteblöcke der IUMPR Berechnung (Variante 1)" VAL_BLK 0x80025C2E ValA_Wu8 9.000 OneToOne 0.00 9.000 EXTENDED_LIMITS 0.00 255.0 NUMBER 20 /end CHARACTERISTIC
/begin CHARACTERISTIC DIUMPR_FID_CA "zugewiesenen Funktionsidentifer der IUMPR Berechnung (Variante 1)" VAL_BLK 0x80025C42 ValA_Wu16 688. DINH_FIdVerb 0.00 688. FORMAT "%2.0" NUMBER 20 /end CHARACTERISTIC
/begin CHARACTERISTIC DIUMPR_Group_CA "zugewiesene Komponentengruppen der IUMPR Berechnung (Variante 1)" VAL_BLK 0x80025C6A ValA_Wu8 8.00000000000 DIUMPR_GroupVerb 0.00 8.00000000000 FORMAT "%13.11" NUMBER 20 /end CHARACTERISTIC
/begin CHARACTERISTIC DIUMPR_numSigActv_CA "zugewiesene Signale der IUMPR Berechnung zur Bestimmung der physikalischen Aktivität (Variante 1)" VAL_BLK 0x80025C7E ValA_Wu16 702.000000000 Signals_IntSigNumVerb 0.00 702.000000000 FORMAT "%13.9" NUMBER 5 /end CHARACTERISTIC
/begin CHARACTERISTIC DIUMPR_stSigActv_CA "zugewiesene Detektierungsverfahren der physikalischen Aktivität der IUMPR Berechnung (Variante 1)" VAL_BLK 0x80025C88 ValA_Wu8 255.0 OneToOne 0.00 255.0 NUMBER 5 /end CHARACTERISTIC
/begin CHARACTERISTIC DIUMPR_valSigActvMax_CA "zugewiesene oberen Grenzen zur Bestimmung der physikalischen Aktivität (Variante 1)" VAL_BLK 0x80025C8E ValA_Wu16 65535.00 OneToOne 0.00 65535.00 NUMBER 5 /end CHARACTERISTIC
/begin CHARACTERISTIC DIUMPR_valSigActvMin_CA "zugewiesene unteren Grenzen zur Bestimmung der physikalischen Aktivität (Variante 1)" VAL_BLK 0x80025C98 ValA_Wu16 65535.00 OneToOne 0.00 65535.00 NUMBER 5 /end CHARACTERISTIC
/begin CHARACTERISTIC DSCHED_BsPrio.FId_InhibitAlways_C "DSCHED/Basis Priorität für den geschedulten FId FId_InhibitAlways" VALUE 0x80028F60 Val_Wu16 65535.00 DFC_OneToOne 0.00 65535.00 /end CHARACTERISTIC
/begin CHARACTERISTIC DSCHED_BsPrio.FId_CoordALS_C "DSCHED/Basis Priorität für den geschedulten FId FId_CoordALS" VALUE 0x80028F62 Val_Wu16 65535.00 DFC_OneToOne 0.00 65535.00 /end CHARACTERISTIC
/begin CHARACTERISTIC DSCHED_BsPrio.FId_CoordFBC_C "DSCHED/Basis Priorität für den geschedulten FId FId_CoordFBC" VALUE 0x80028F64 Val_Wu16 65535.00 DFC_OneToOne 0.00 65535.00 /end CHARACTERISTIC
/begin CHARACTERISTIC DSCHED_BsPrio.FId_CoordTAA_C "DSCHED/Basis Priorität für den geschedulten FId FId_CoordTAA" VALUE 0x80028F66 Val_Wu16 65535.00 DFC_OneToOne 0.00 65535.00 /end CHARACTERISTIC
/begin CHARACTERISTIC DSCHED_BsPrio.FId_CoordZFC_C "DSCHED/Basis Priorität für den geschedulten FId FId_CoordZFC" VALUE 0x80028F68 Val_Wu16 65535.00 DFC_OneToOne 0.00 65535.00 /end CHARACTERISTIC
/begin CHARACTERISTIC DSCHED_BsPrio.FId_IVPlausRunUpTstActv_C "DSCHED/Basis Priorität für den geschedulten FId FId_IVPlausRunUpTstActv" VALUE 0x80028F6A Val_Wu16 65535.00 DFC_OneToOne 0.00 65535.00 /end CHARACTERISTIC
/begin CHARACTERISTIC DSCHED_BsPrio.FId_RailHpTstActv_C "DSCHED/Basis Priorität für den geschedulten FId FId_RailHpTstActv" VALUE 0x80028F6C Val_Wu16 65535.00 DFC_OneToOne 0.00 65535.00 /end CHARACTERISTIC
/begin CHARACTERISTIC DSCHED_DrvModeMsk.FId_InhibitAlways_C "DSCHED/Fahrmodus Maske für den geschedulten FId FId_InhibitAlways" VALUE 0x80028F6E Val_Wu16 65535.00 DFC_OneToOne 0.00 65535.00 /end CHARACTERISTIC
/begin CHARACTERISTIC DSCHED_DrvModeMsk.FId_CoordALS_C "DSCHED/Fahrmodus Maske für den geschedulten FId FId_CoordALS" VALUE 0x80028F70 Val_Wu16 65535.00 DFC_OneToOne 0.00 65535.00 /end CHARACTERISTIC
/begin CHARACTERISTIC DSCHED_DrvModeMsk.FId_CoordFBC_C "DSCHED/Fahrmodus Maske für den geschedulten FId FId_CoordFBC" VALUE 0x80028F72 Val_Wu16 65535.00 DFC_OneToOne 0.00 65535.00 /end CHARACTERISTIC
/begin CHARACTERISTIC DSCHED_DrvModeMsk.FId_CoordTAA_C "DSCHED/Fahrmodus Maske für den geschedulten FId FId_CoordTAA" VALUE 0x80028F74 Val_Wu16 65535.00 DFC_OneToOne 0.00 65535.00 /end CHARACTERISTIC
/begin CHARACTERISTIC DSCHED_DrvModeMsk.FId_CoordZFC_C "DSCHED/Fahrmodus Maske für den geschedulten FId FId_CoordZFC" VALUE 0x80028F76 Val_Wu16 65535.00 DFC_OneToOne 0.00 65535.00 /end CHARACTERISTIC
/begin CHARACTERISTIC DSCHED_DrvModeMsk.FId_IVPlausRunUpTstActv_C "DSCHED/Fahrmodus Maske für den geschedulten FId FId_IVPlausRunUpTstActv" VALUE 0x80028F78 Val_Wu16 65535.00 DFC_OneToOne 0.00 65535.00 /end CHARACTERISTIC
/begin CHARACTERISTIC DSCHED_DrvModeMsk.FId_RailHpTstActv_C "DSCHED/Fahrmodus Maske für den geschedulten FId FId_RailHpTstActv" VALUE 0x80028F7A Val_Wu16 65535.00 DFC_OneToOne 0.00 65535.00 /end CHARACTERISTIC
/begin CHARACTERISTIC DSCHED_Excl.FId_InhibitAlways_CA "DSCHED/Liste der exklusiven FIds für FId FId_InhibitAlways" VAL_BLK 0x80025CA2 ValA_Wu16 7. DSCHED_FIdExcVerb 0.00 7. FORMAT "%2.0" NUMBER 8 /end CHARACTERISTIC
/begin CHARACTERISTIC DSCHED_Excl.FId_CoordALS_CA "DSCHED/Liste der exklusiven FIds für FId FId_CoordALS" VAL_BLK 0x80025CB2 ValA_Wu16 7. DSCHED_FIdExcVerb 0.00 7. FORMAT "%2.0" NUMBER 8 /end CHARACTERISTIC
/begin CHARACTERISTIC DSCHED_Excl.FId_CoordFBC_CA "DSCHED/Liste der exklusiven FIds für FId FId_CoordFBC" VAL_BLK 0x80025CC2 ValA_Wu16 7. DSCHED_FIdExcVerb 0.00 7. FORMAT "%2.0" NUMBER 8 /end CHARACTERISTIC
/begin CHARACTERISTIC DSCHED_Excl.FId_CoordTAA_CA "DSCHED/Liste der exklusiven FIds für FId FId_CoordTAA" VAL_BLK 0x80025CD2 ValA_Wu16 7. DSCHED_FIdExcVerb 0.00 7. FORMAT "%2.0" NUMBER 8 /end CHARACTERISTIC
/begin CHARACTERISTIC DSCHED_Excl.FId_CoordZFC_CA "DSCHED/Liste der exklusiven FIds für FId FId_CoordZFC" VAL_BLK 0x80025CE2 ValA_Wu16 7. DSCHED_FIdExcVerb 0.00 7. FORMAT "%2.0" NUMBER 8 /end CHARACTERISTIC
/begin CHARACTERISTIC DSCHED_Excl.FId_IVPlausRunUpTstActv_CA "DSCHED/Liste der exklusiven FIds für FId FId_IVPlausRunUpTstActv" VAL_BLK 0x80025CF2 ValA_Wu16 7. DSCHED_FIdExcVerb 0.00 7. FORMAT "%2.0" NUMBER 8 /end CHARACTERISTIC
/begin CHARACTERISTIC DSCHED_Excl.FId_RailHpTstActv_CA "DSCHED/Liste der exklusiven FIds für FId FId_RailHpTstActv" VAL_BLK 0x80025D02 ValA_Wu16 7. DSCHED_FIdExcVerb 0.00 7. FORMAT "%2.0" NUMBER 8 /end CHARACTERISTIC
/begin CHARACTERISTIC DSCHED_FacPhys.FId_InhibitAlways_C "DSCHED/Faktor der physikalischen Priorität für den geschedulten FId FId_InhibitAlways" VALUE 0x80028F7C Val_Wu8 255.0 DFC_OneToOne 0.00 255.0 /end CHARACTERISTIC
/begin CHARACTERISTIC DSCHED_FacPhys.FId_CoordALS_C "DSCHED/Faktor der physikalischen Priorität für den geschedulten FId FId_CoordALS" VALUE 0x80028F7D Val_Wu8 255.0 DFC_OneToOne 0.00 255.0 /end CHARACTERISTIC
/begin CHARACTERISTIC DSCHED_FacPhys.FId_CoordFBC_C "DSCHED/Faktor der physikalischen Priorität für den geschedulten FId FId_CoordFBC" VALUE 0x80028F7E Val_Wu8 255.0 DFC_OneToOne 0.00 255.0 /end CHARACTERISTIC
/begin CHARACTERISTIC DSCHED_FacPhys.FId_CoordTAA_C "DSCHED/Faktor der physikalischen Priorität für den geschedulten FId FId_CoordTAA" VALUE 0x80028F7F Val_Wu8 255.0 DFC_OneToOne 0.00 255.0 /end CHARACTERISTIC
/begin CHARACTERISTIC DSCHED_FacPhys.FId_CoordZFC_C "DSCHED/Faktor der physikalischen Priorität für den geschedulten FId FId_CoordZFC" VALUE 0x80028F80 Val_Wu8 255.0 DFC_OneToOne 0.00 255.0 /end CHARACTERISTIC
/begin CHARACTERISTIC DSCHED_FacPhys.FId_IVPlausRunUpTstActv_C "DSCHED/Faktor der physikalischen Priorität für den geschedulten FId FId_IVPlausRunUpTstActv" VALUE 0x80028F81 Val_Wu8 255.0 DFC_OneToOne 0.00 255.0 /end CHARACTERISTIC
/begin CHARACTERISTIC DSCHED_FacPhys.FId_RailHpTstActv_C "DSCHED/Faktor der physikalischen Priorität für den geschedulten FId FId_RailHpTstActv" VALUE 0x80028F82 Val_Wu8 255.0 DFC_OneToOne 0.00 255.0 /end CHARACTERISTIC
/begin CHARACTERISTIC DSCHED_JmpActvPrio.FId_InhibitAlways_C "DSCHED/Aktiv Prioritätssprung für den geschedulten FId FId_InhibitAlways" VALUE 0x80028F84 Val_Wu16 65535.00 DFC_OneToOne 0.00 65535.00 /end CHARACTERISTIC
/begin CHARACTERISTIC DSCHED_JmpActvPrio.FId_CoordALS_C "DSCHED/Aktiv Prioritätssprung für den geschedulten FId FId_CoordALS" VALUE 0x80028F86 Val_Wu16 65535.00 DFC_OneToOne 0.00 65535.00 /end CHARACTERISTIC
/begin CHARACTERISTIC DSCHED_JmpActvPrio.FId_CoordFBC_C "DSCHED/Aktiv Prioritätssprung für den geschedulten FId FId_CoordFBC" VALUE 0x80028F88 Val_Wu16 65535.00 DFC_OneToOne 0.00 65535.00 /end CHARACTERISTIC
/begin CHARACTERISTIC DSCHED_JmpActvPrio.FId_CoordTAA_C "DSCHED/Aktiv Prioritätssprung für den geschedulten FId FId_CoordTAA" VALUE 0x80028F8A Val_Wu16 65535.00 DFC_OneToOne 0.00 65535.00 /end CHARACTERISTIC
/begin CHARACTERISTIC DSCHED_JmpActvPrio.FId_CoordZFC_C "DSCHED/Aktiv Prioritätssprung für den geschedulten FId FId_CoordZFC" VALUE 0x80028F8C Val_Wu16 65535.00 DFC_OneToOne 0.00 65535.00 /end CHARACTERISTIC
/begin CHARACTERISTIC DSCHED_JmpActvPrio.FId_IVPlausRunUpTstActv_C "DSCHED/Aktiv Prioritätssprung für den geschedulten FId FId_IVPlausRunUpTstActv" VALUE 0x80028F8E Val_Wu16 65535.00 DFC_OneToOne 0.00 65535.00 /end CHARACTERISTIC
/begin CHARACTERISTIC DSCHED_JmpActvPrio.FId_RailHpTstActv_C "DSCHED/Aktiv Prioritätssprung für den geschedulten FId FId_RailHpTstActv" VALUE 0x80028F90 Val_Wu16 65535.00 DFC_OneToOne 0.00 65535.00 /end CHARACTERISTIC
/begin CHARACTERISTIC DSCHED_OpModeMsk.FId_InhibitAlways_C "DSCHED/Betriebsarten Maske für den geschedulten FId FId_InhibitAlways" VALUE 0x80028F92 Val_Wu16 65535.00 DFC_OneToOne 0.00 65535.00 /end CHARACTERISTIC
/begin CHARACTERISTIC DSCHED_OpModeMsk.FId_CoordALS_C "DSCHED/Betriebsarten Maske für den geschedulten FId FId_CoordALS" VALUE 0x80028F94 Val_Wu16 65535.00 DFC_OneToOne 0.00 65535.00 /end CHARACTERISTIC
/begin CHARACTERISTIC DSCHED_OpModeMsk.FId_CoordFBC_C "DSCHED/Betriebsarten Maske für den geschedulten FId FId_CoordFBC" VALUE 0x80028F96 Val_Wu16 65535.00 DFC_OneToOne 0.00 65535.00 /end CHARACTERISTIC
/begin CHARACTERISTIC DSCHED_OpModeMsk.FId_CoordTAA_C "DSCHED/Betriebsarten Maske für den geschedulten FId FId_CoordTAA" VALUE 0x80028F98 Val_Wu16 65535.00 DFC_OneToOne 0.00 65535.00 /end CHARACTERISTIC
/begin CHARACTERISTIC DSCHED_OpModeMsk.FId_CoordZFC_C "DSCHED/Betriebsarten Maske für den geschedulten FId FId_CoordZFC" VALUE 0x80028F9A Val_Wu16 65535.00 DFC_OneToOne 0.00 65535.00 /end CHARACTERISTIC
/begin CHARACTERISTIC DSCHED_OpModeMsk.FId_IVPlausRunUpTstActv_C "DSCHED/Betriebsarten Maske für den geschedulten FId FId_IVPlausRunUpTstActv" VALUE 0x80028F9C Val_Wu16 65535.00 DFC_OneToOne 0.00 65535.00 /end CHARACTERISTIC
/begin CHARACTERISTIC DSCHED_OpModeMsk.FId_RailHpTstActv_C "DSCHED/Betriebsarten Maske für den geschedulten FId FId_RailHpTstActv" VALUE 0x80028F9E Val_Wu16 65535.00 DFC_OneToOne 0.00 65535.00 /end CHARACTERISTIC
/begin CHARACTERISTIC DSCHED_RmpIniPrio.FId_InhibitAlways_C "DSCHED/Initiale Rampenpriorität für den geschedulten FId FId_InhibitAlways" VALUE 0x80028FA0 Val_Wu16 65535.00 DFC_OneToOne 0.00 65535.00 /end CHARACTERISTIC
/begin CHARACTERISTIC DSCHED_RmpIniPrio.FId_CoordALS_C "DSCHED/Initiale Rampenpriorität für den geschedulten FId FId_CoordALS" VALUE 0x80028FA2 Val_Wu16 65535.00 DFC_OneToOne 0.00 65535.00 /end CHARACTERISTIC
/begin CHARACTERISTIC DSCHED_RmpIniPrio.FId_CoordFBC_C "DSCHED/Initiale Rampenpriorität für den geschedulten FId FId_CoordFBC" VALUE 0x80028FA4 Val_Wu16 65535.00 DFC_OneToOne 0.00 65535.00 /end CHARACTERISTIC
/begin CHARACTERISTIC DSCHED_RmpIniPrio.FId_CoordTAA_C "DSCHED/Initiale Rampenpriorität für den geschedulten FId FId_CoordTAA" VALUE 0x80028FA6 Val_Wu16 65535.00 DFC_OneToOne 0.00 65535.00 /end CHARACTERISTIC
/begin CHARACTERISTIC DSCHED_RmpIniPrio.FId_CoordZFC_C "DSCHED/Initiale Rampenpriorität für den geschedulten FId FId_CoordZFC" VALUE 0x80028FA8 Val_Wu16 65535.00 DFC_OneToOne 0.00 65535.00 /end CHARACTERISTIC
/begin CHARACTERISTIC DSCHED_RmpIniPrio.FId_IVPlausRunUpTstActv_C "DSCHED/Initiale Rampenpriorität für den geschedulten FId FId_IVPlausRunUpTstActv" VALUE 0x80028FAA Val_Wu16 65535.00 DFC_OneToOne 0.00 65535.00 /end CHARACTERISTIC
/begin CHARACTERISTIC DSCHED_RmpIniPrio.FId_RailHpTstActv_C "DSCHED/Initiale Rampenpriorität für den geschedulten FId FId_RailHpTstActv" VALUE 0x80028FAC Val_Wu16 65535.00 DFC_OneToOne 0.00 65535.00 /end CHARACTERISTIC
/begin CHARACTERISTIC DSCHED_RmpSlpActv.FId_InhibitAlways_C "DSCHED/Aktiv Rampensteigung für den geschedulten FId FId_InhibitAlways" VALUE 0x80028FAE Val_Wu16 327675.0 DSCHED_RmpSlp 0.00 327675.0 FORMAT "%8.1" /end CHARACTERISTIC
/begin CHARACTERISTIC DSCHED_RmpSlpActv.FId_CoordALS_C "DSCHED/Aktiv Rampensteigung für den geschedulten FId FId_CoordALS" VALUE 0x80028FB0 Val_Wu16 327675.0 DSCHED_RmpSlp 0.00 327675.0 FORMAT "%8.1" /end CHARACTERISTIC
/begin CHARACTERISTIC DSCHED_RmpSlpActv.FId_CoordFBC_C "DSCHED/Aktiv Rampensteigung für den geschedulten FId FId_CoordFBC" VALUE 0x80028FB2 Val_Wu16 327675.0 DSCHED_RmpSlp 0.00 327675.0 FORMAT "%8.1" /end CHARACTERISTIC
/begin CHARACTERISTIC DSCHED_RmpSlpActv.FId_CoordTAA_C "DSCHED/Aktiv Rampensteigung für den geschedulten FId FId_CoordTAA" VALUE 0x80028FB4 Val_Wu16 327675.0 DSCHED_RmpSlp 0.00 327675.0 FORMAT "%8.1" /end CHARACTERISTIC
/begin CHARACTERISTIC DSCHED_RmpSlpActv.FId_CoordZFC_C "DSCHED/Aktiv Rampensteigung für den geschedulten FId FId_CoordZFC" VALUE 0x80028FB6 Val_Wu16 327675.0 DSCHED_RmpSlp 0.00 327675.0 FORMAT "%8.1" /end CHARACTERISTIC
/begin CHARACTERISTIC DSCHED_RmpSlpActv.FId_IVPlausRunUpTstActv_C "DSCHED/Aktiv Rampensteigung für den geschedulten FId FId_IVPlausRunUpTstActv" VALUE 0x80028FB8 Val_Wu16 327675.0 DSCHED_RmpSlp 0.00 327675.0 FORMAT "%8.1" /end CHARACTERISTIC
/begin CHARACTERISTIC DSCHED_RmpSlpActv.FId_RailHpTstActv_C "DSCHED/Aktiv Rampensteigung für den geschedulten FId FId_RailHpTstActv" VALUE 0x80028FBA Val_Wu16 327675.0 DSCHED_RmpSlp 0.00 327675.0 FORMAT "%8.1" /end CHARACTERISTIC
/begin CHARACTERISTIC DSCHED_RmpSlpPas.FId_InhibitAlways_C "DSCHED/Passiv Rampensteigung für den geschedulten FId FId_InhibitAlways" VALUE 0x80028FBC Val_Wu16 327675.0 DSCHED_RmpSlp 0.00 327675.0 FORMAT "%8.1" /end CHARACTERISTIC
/begin CHARACTERISTIC DSCHED_RmpSlpPas.FId_CoordALS_C "DSCHED/Passiv Rampensteigung für den geschedulten FId FId_CoordALS" VALUE 0x80028FBE Val_Wu16 327675.0 DSCHED_RmpSlp 0.00 327675.0 FORMAT "%8.1" /end CHARACTERISTIC
/begin CHARACTERISTIC DSCHED_RmpSlpPas.FId_CoordFBC_C "DSCHED/Passiv Rampensteigung für den geschedulten FId FId_CoordFBC" VALUE 0x80028FC0 Val_Wu16 327675.0 DSCHED_RmpSlp 0.00 327675.0 FORMAT "%8.1" /end CHARACTERISTIC
/begin CHARACTERISTIC DSCHED_RmpSlpPas.FId_CoordTAA_C "DSCHED/Passiv Rampensteigung für den geschedulten FId FId_CoordTAA" VALUE 0x80028FC2 Val_Wu16 327675.0 DSCHED_RmpSlp 0.00 327675.0 FORMAT "%8.1" /end CHARACTERISTIC
/begin CHARACTERISTIC DSCHED_RmpSlpPas.FId_CoordZFC_C "DSCHED/Passiv Rampensteigung für den geschedulten FId FId_CoordZFC" VALUE 0x80028FC4 Val_Wu16 327675.0 DSCHED_RmpSlp 0.00 327675.0 FORMAT "%8.1" /end CHARACTERISTIC
/begin CHARACTERISTIC DSCHED_RmpSlpPas.FId_IVPlausRunUpTstActv_C "DSCHED/Passiv Rampensteigung für den geschedulten FId FId_IVPlausRunUpTstActv" VALUE 0x80028FC6 Val_Wu16 327675.0 DSCHED_RmpSlp 0.00 327675.0 FORMAT "%8.1" /end CHARACTERISTIC
/begin CHARACTERISTIC DSCHED_RmpSlpPas.FId_RailHpTstActv_C "DSCHED/Passiv Rampensteigung für den geschedulten FId FId_RailHpTstActv" VALUE 0x80028FC8 Val_Wu16 327675.0 DSCHED_RmpSlp 0.00 327675.0 FORMAT "%8.1" /end CHARACTERISTIC
/begin CHARACTERISTIC DSCHED_RmpUpLim.FId_InhibitAlways_C "DSCHED/Obere Rampengrenze für den geschedulten FId FId_InhibitAlways" VALUE 0x80028FCA Val_Wu16 65535.00 DFC_OneToOne 0.00 65535.00 /end CHARACTERISTIC
/begin CHARACTERISTIC DSCHED_RmpUpLim.FId_CoordALS_C "DSCHED/Obere Rampengrenze für den geschedulten FId FId_CoordALS" VALUE 0x80028FCC Val_Wu16 65535.00 DFC_OneToOne 0.00 65535.00 /end CHARACTERISTIC
/begin CHARACTERISTIC DSCHED_RmpUpLim.FId_CoordFBC_C "DSCHED/Obere Rampengrenze für den geschedulten FId FId_CoordFBC" VALUE 0x80028FCE Val_Wu16 65535.00 DFC_OneToOne 0.00 65535.00 /end CHARACTERISTIC
/begin CHARACTERISTIC DSCHED_RmpUpLim.FId_CoordTAA_C "DSCHED/Obere Rampengrenze für den geschedulten FId FId_CoordTAA" VALUE 0x80028FD0 Val_Wu16 65535.00 DFC_OneToOne 0.00 65535.00 /end CHARACTERISTIC
/begin CHARACTERISTIC DSCHED_RmpUpLim.FId_CoordZFC_C "DSCHED/Obere Rampengrenze für den geschedulten FId FId_CoordZFC" VALUE 0x80028FD2 Val_Wu16 65535.00 DFC_OneToOne 0.00 65535.00 /end CHARACTERISTIC
/begin CHARACTERISTIC DSCHED_RmpUpLim.FId_IVPlausRunUpTstActv_C "DSCHED/Obere Rampengrenze für den geschedulten FId FId_IVPlausRunUpTstActv" VALUE 0x80028FD4 Val_Wu16 65535.00 DFC_OneToOne 0.00 65535.00 /end CHARACTERISTIC
/begin CHARACTERISTIC DSCHED_RmpUpLim.FId_RailHpTstActv_C "DSCHED/Obere Rampengrenze für den geschedulten FId FId_RailHpTstActv" VALUE 0x80028FD6 Val_Wu16 65535.00 DFC_OneToOne 0.00 65535.00 /end CHARACTERISTIC
/begin CHARACTERISTIC DSCHED_stMode_C "zentrale Deaktivierung für alle geschedulten FID's (abgeschalten bei 0)" VALUE 0x80028FD8 Val_Wu8 255.0 DINH_OneToOne 0.00 255.0 FORMAT "%5.1" /end CHARACTERISTIC
/begin CHARACTERISTIC DSCHED_valDflOpMode_C "vom Betriebsartenkoordinator angeforderte Betriebsart im abgeschalteten Zustand (DSCHED_stMode_C = 0)" VALUE 0x80028FDA Val_Wu16 65535.00 DINH_OneToOne 0.00 65535.00 FORMAT "%8.2" /end CHARACTERISTIC
/begin CHARACTERISTIC DSCHED_valOfsPrioOpMode_C "Betriebsart Prioritätsaufschlag (zusätzliche Priorität, falls die Betriebsart mit den möglichen Betriebsarten vereinbar ist)" VALUE 0x80028FDC Val_Wu16 65535.00 DINH_OneToOne 0.00 65535.00 FORMAT "%8.2" /end CHARACTERISTIC
/begin CHARACTERISTIC DSCHED_xSleepFId_CA "Liste der FId, die durch die Funktion selbst gesperrt werden können." VAL_BLK 0x80028FDE ValA_Wu8 7. DSCHED_FIdVerb 0.00 7. FORMAT "%2.0" NUMBER 5 /end CHARACTERISTIC
/begin CHARACTERISTIC DSMAUX_dtWUCMin_C "Mindesttemperaturanstieg für warm up cycle Erkennung" VALUE 0x80025D12 Val_Ws16 6553.500 TempDiff_Kelv -3276.800 3276.700 /end CHARACTERISTIC
/begin CHARACTERISTIC DSMAUX_tWUCMin_C "Mindesttemperatur für warm up cycle Erkennung" VALUE 0x80025D14 Val_Ws16 6553.500 Temp_Cels -3549.940 3003.560 /end CHARACTERISTIC
/begin CHARACTERISTIC DSMAUX_xClearMode_C "Löschmodus für applikatives Löschen" VALUE 0x80025D16 Val_Wu16 964. DFC_Verb 0.00 964. FORMAT "%2.0" /end CHARACTERISTIC
/begin CHARACTERISTIC DSMAUX_xClearTrg_C "Trigger zum Löschen der DSM Informationen" VALUE 0x80025D18 Val_Wu8 255.0 DFC_OneToOne 0.00 255.0 /end CHARACTERISTIC
/begin CHARACTERISTIC DSMDur_valEvntQntDist_C "Quantisierungseinheit für den Streckenzähler" VALUE 0x80025D1A Val_Wu16 65535.00 DFES_OneToOne 0.00 65535.00 /end CHARACTERISTIC
/begin CHARACTERISTIC DSMDur_valEvntQntTi_C "Quantisierungseinheit für den Betriebsstundenzähler" VALUE 0x80025D1C Val_Wu16 65535.00 DFES_OneToOne 0.00 65535.00 /end CHARACTERISTIC
/begin CHARACTERISTIC DSMDur_xEnaDFES_CA "Freigabebedingungen für die eintragsspezifischen duration counter" VAL_BLK 0x80025D1E ValA_Wu16 65535.00 DFES_OneToOne 0.00 65535.00 NUMBER 3 /end CHARACTERISTIC
/begin CHARACTERISTIC DSMDur_xEnaGlb_CA "Freigabebedingungen für die globalen duration counter" VAL_BLK 0x80025D24 ValA_Wu16 65535.00 DFES_OneToOne 0.00 65535.00 NUMBER 1 /end CHARACTERISTIC
/begin CHARACTERISTIC DSMDur_xRstDFES_CA "Rücksetzbedingungen für die eintragsspezifischen duration counter" VAL_BLK 0x80025D26 ValA_Wu8 255.0 DFES_OneToOne 0.00 255.0 NUMBER 3 /end CHARACTERISTIC
/begin CHARACTERISTIC DSMDur_xRstGlb_CA "Rücksetzbedingungen für die globalen duration counter" VAL_BLK 0x80025D29 ValA_Wu8 255.0 DFES_OneToOne 0.00 255.0 NUMBER 1 /end CHARACTERISTIC
/begin CHARACTERISTIC DSMDur_xSelEvntDFES_CA "Zählereignis für die eintragsspezifischen duration counter" VAL_BLK 0x80025D2A ValA_Wu8 4.00000000000 DSMDur_EvntSel_Verb 0.00 4.00000000000 FORMAT "%13.11" NUMBER 3 /end CHARACTERISTIC
/begin CHARACTERISTIC DSMDur_xSelEvntGlb_CA "Zählereignis für die globalen duration counter" VAL_BLK 0x80025D2D ValA_Wu8 4.00000000000 DSMDur_EvntSel_Verb 0.00 4.00000000000 FORMAT "%13.11" NUMBER 1 /end CHARACTERISTIC
/begin CHARACTERISTIC DSMRdy_Grp.Misf_CA "Readinessberechnung: zugeordnete Fehlerprüfungen/Komponentengruppe misfire monitoring" VAL_BLK 0x80028FE4 ValA_Wu16 964. DFC_Verb 0.00 964. FORMAT "%2.0" NUMBER 10 /end CHARACTERISTIC
/begin CHARACTERISTIC DSMRdy_Grp.FlSys_CA "Readinessberechnung: zugeordnete Fehlerprüfungen/Komponentengruppe fuel system monitoring" VAL_BLK 0x80028FF8 ValA_Wu16 964. DFC_Verb 0.00 964. FORMAT "%2.0" NUMBER 30 /end CHARACTERISTIC
/begin CHARACTERISTIC DSMRdy_Grp.ComprCmpnt_CA "Readinessberechnung: zugeordnete Fehlerprüfungen/Komponentengruppe comprehensive component monitoring" VAL_BLK 0x80029034 ValA_Wu16 964. DFC_Verb 0.00 964. FORMAT "%2.0" NUMBER 100 /end CHARACTERISTIC
/begin CHARACTERISTIC DSMRdy_Grp.Cat_CA "Readinessberechnung: zugeordnete Fehlerprüfungen/Komponentengruppe catalyst monitoring" VAL_BLK 0x800290FC ValA_Wu16 964. DFC_Verb 0.00 964. FORMAT "%2.0" NUMBER 10 /end CHARACTERISTIC
/begin CHARACTERISTIC DSMRdy_Grp.HtCat_CA "Readinessberechnung: zugeordnete Fehlerprüfungen/Komponentengruppe heated catalyst monitoring" VAL_BLK 0x80029110 ValA_Wu16 964. DFC_Verb 0.00 964. FORMAT "%2.0" NUMBER 10 /end CHARACTERISTIC
/begin CHARACTERISTIC DSMRdy_Grp.EvpSys_CA "Readinessberechnung: zugeordnete Fehlerprüfungen/Komponentengruppe evaporative system monitoring" VAL_BLK 0x80029124 ValA_Wu16 964. DFC_Verb 0.00 964. FORMAT "%2.0" NUMBER 10 /end CHARACTERISTIC
/begin CHARACTERISTIC DSMRdy_Grp.SecAirSys_CA "Readinessberechnung: zugeordnete Fehlerprüfungen/Komponentengruppe secondary air system monitoring" VAL_BLK 0x80029138 ValA_Wu16 964. DFC_Verb 0.00 964. FORMAT "%2.0" NUMBER 10 /end CHARACTERISTIC
/begin CHARACTERISTIC DSMRdy_Grp.AC_CA "Readinessberechnung: zugeordnete Fehlerprüfungen/Komponentengruppe A/C system refrigerant monitoring" VAL_BLK 0x8002914C ValA_Wu16 964. DFC_Verb 0.00 964. FORMAT "%2.0" NUMBER 10 /end CHARACTERISTIC
/begin CHARACTERISTIC DSMRdy_Grp.O2Sens_CA "Readinessberechnung: zugeordnete Fehlerprüfungen/Komponentengruppe oxygen sensor monitoring" VAL_BLK 0x80029160 ValA_Wu16 964. DFC_Verb 0.00 964. FORMAT "%2.0" NUMBER 10 /end CHARACTERISTIC
/begin CHARACTERISTIC DSMRdy_Grp.O2SensHt_CA "Readinessberechnung: zugeordnete Fehlerprüfungen/Komponentengruppe oxygen sensor heater monitoring" VAL_BLK 0x80029174 ValA_Wu16 964. DFC_Verb 0.00 964. FORMAT "%2.0" NUMBER 10 /end CHARACTERISTIC
/begin CHARACTERISTIC DSMRdy_Grp.EGR_CA "Readinessberechnung: zugeordnete Fehlerprüfungen/Komponentengruppe EGR system monitoring" VAL_BLK 0x80029188 ValA_Wu16 964. DFC_Verb 0.00 964. FORMAT "%2.0" NUMBER 30 /end CHARACTERISTIC
/begin CHARACTERISTIC DSMRdy_X.PID1ForceLowMsk_C "DSMRdy/bitmaske zum unbedingten Rücksetzen von Bits in PID01" VALUE 0x80025D30 Val_Wu32 4294967295.00 DSMRdy_OneToOne 0.00 4294967295.00 FORMAT "%13.2" /end CHARACTERISTIC
/begin CHARACTERISTIC DSMRdy_X.PID1ForceHighMsk_C "DSMRdy/bitmaske zum unbedingten Setzen von Bits in PID01" VALUE 0x80025D34 Val_Wu32 4294967295.00 DSMRdy_OneToOne 0.00 4294967295.00 FORMAT "%13.2" /end CHARACTERISTIC
/begin CHARACTERISTIC DSMRdy_X.PID41ForceLowMsk_C "DSMRdy/bitmaske zum unbedingten Rücksetzen von Bits in PID41" VALUE 0x80025D38 Val_Wu32 4294967295.00 DSMRdy_OneToOne 0.00 4294967295.00 FORMAT "%13.2" /end CHARACTERISTIC
/begin CHARACTERISTIC DSMRdy_X.PID41ForceHighMsk_C "DSMRdy/bitmaske zum unbedingten Setzen von Bits in PID41" VALUE 0x80025D3C Val_Wu32 4294967295.00 DSMRdy_OneToOne 0.00 4294967295.00 FORMAT "%13.2" /end CHARACTERISTIC
/begin CHARACTERISTIC DSMRdy_X.DFESSetMode_C "DSMRdy/Schalter, um bei Mode3 sichtbaren Fehlern alle Gruppen auf Ready zu setzen" VALUE 0x80025D40 Val_Wu8 1.00000000000 DSMRdy_Mode3ModeVerb 0.00 1.00000000000 FORMAT "%13.11" /end CHARACTERISTIC
/begin CHARACTERISTIC DSM_tiDlyStandBy_C "Verzögerung beim Zurücksetzen des Bits11 von DSM_DisblMode_mp" VALUE 0x800389DA Val_Ws16 10000.00 Time_ms 0.00 10000.00 EXTENDED_LIMITS -327680.0 327670.0 /end CHARACTERISTIC
/begin CHARACTERISTIC DStgy_dtTempGradMax_CUR "Schwellwert für den Temperaturgradienten" CURVE 0x800389E4 Cur_Xs16Ws16 65534.00 TempCels_100ms -32767.00 32767.00 FORMAT "%8.2" EXTENDED_LIMITS -32768.00 32767.00
 /begin AXIS_DESCR STD_AXIS DStgy_tAvrg_mp Temp_Cels 16 -3549.940 3003.560 DEPOSIT ABSOLUTE /end AXIS_DESCR
/end CHARACTERISTIC
/begin CHARACTERISTIC DStgy_numPosOxiTDs_C "Arrayindex Temperatur nach OxiCat" VALUE 0x800389DC Val_Wu8 255.0 OneToOne 0.00 255.0 /end CHARACTERISTIC
/begin CHARACTERISTIC DStgy_numPosOxi_C "Arrayindex OxiCat Temperatur" VALUE 0x800389DD Val_Wu8 12.00 OneToOne 0.00 12.00 EXTENDED_LIMITS 0.00 255.0 /end CHARACTERISTIC
/begin CHARACTERISTIC DStgy_numPosPFltDs_C "Arrayindex Temperatur nach Partikelfilter" VALUE 0x800389DE Val_Wu8 255.0 OneToOne 0.00 255.0 /end CHARACTERISTIC
/begin CHARACTERISTIC DStgy_numPosSCRTUs_C "Arrayindex Temperatur vor SCR" VALUE 0x800389DF Val_Wu8 255.0 OneToOne 0.00 255.0 /end CHARACTERISTIC
/begin CHARACTERISTIC DStgy_numPosSCRUs_C "Position des Abgasmassenstroms in ASMod_dmEGFld" VALUE 0x800389E0 Val_Wu8 255.0 OneToOne 0.00 255.0 /end CHARACTERISTIC
/begin CHARACTERISTIC DStgy_numPosStoich_C "Positionsnummer für das Feld der SCR Katalysator Temperaturen" VALUE 0x800389E1 Val_Wu8 12.00 OneToOne 0.00 12.00 EXTENDED_LIMITS 0.00 255.0 /end CHARACTERISTIC
/begin CHARACTERISTIC DStgy_numPosWallTUs_C "Feldindex für die Katalysatorwandtemperatur" VALUE 0x800389E2 Val_Wu8 255.0 OneToOne 0.00 255.0 /end CHARACTERISTIC
/begin CHARACTERISTIC DStgy_numTempFldGrad_C "" VALUE 0x80038A26 Val_Wu8 15.00 OneToOne 0.00 15.00 EXTENDED_LIMITS 0.00 255.0 /end CHARACTERISTIC
/begin CHARACTERISTIC DStgy_stEnaMsk_C "Freigabemaske für die Betriebsartenstufe" VALUE 0x80038A28 Val_Wu32 4294967295.00 OneToOne 0.00 4294967295.00 /end CHARACTERISTIC
/begin CHARACTERISTIC DStgy_stMskMetStgy_C "Freigabemaske für die Dosierstrategie" VALUE 0x80038A2C Val_Wu16 65535.00 OneToOne 0.00 65535.00 /end CHARACTERISTIC
/begin CHARACTERISTIC DStgy_swtAdapEna_C "Schalter für die NH3 Füllstandsadaption" VALUE 0x80038A2E Val_Wu8 1.000 OneToOne 0.00 1.000 EXTENDED_LIMITS 0.00 255.0 /end CHARACTERISTIC
/begin CHARACTERISTIC DStgy_swtMetEna_C "Schalter für die Aktivierung/Deaktivierung der Dosierstrategie" VALUE 0x80038A2F Val_Wu8 1.000 OneToOne 0.00 1.000 EXTENDED_LIMITS 0.00 255.0 /end CHARACTERISTIC
/begin CHARACTERISTIC DStgy_tAvrgHi_C "Obere Temperaturschwelle für die Hysterese" VALUE 0x80038A30 Val_Ws16 1240.000 Temp_Cels -40.04000 1199.960 EXTENDED_LIMITS -3549.940 3003.560 /end CHARACTERISTIC
/begin CHARACTERISTIC DStgy_tAvrgLo_C "Untere Temperaturschwelle für die Hysterese" VALUE 0x80038A32 Val_Ws16 1240.000 Temp_Cels -40.04000 1199.960 EXTENDED_LIMITS -3549.940 3003.560 /end CHARACTERISTIC
/begin CHARACTERISTIC DStgy_TempGrad.T1_C "/" VALUE 0x80038A34 Kw_Ws32 4294.9672940 TimeDelay_s 0.000002000000001 4294.9672960 FORMAT "%12.7" /end CHARACTERISTIC
/begin CHARACTERISTIC DStgy_TempGrad.Kd_C "/" VALUE 0x80038A38 Kw_Ws32 5.00000000000 Kd 0.00 5.00000000000 FORMAT "%13.11" EXTENDED_LIMITS -32768.0000000 32767.9999847 /end CHARACTERISTIC
/begin CHARACTERISTIC DStgy_TempGradDeb.tiHiLo_C "/" VALUE 0x80038A3C Kw_Ws16 120000.0 TimeDeb 0.00 120000.0 EXTENDED_LIMITS -327680.0 327670.0 /end CHARACTERISTIC
/begin CHARACTERISTIC DStgy_TempGradDeb.tiLoHi_C "/" VALUE 0x80038A3E Kw_Ws16 120000.0 TimeDeb 0.00 120000.0 EXTENDED_LIMITS -327680.0 327670.0 /end CHARACTERISTIC
/begin CHARACTERISTIC DStgy_tiDosRlsMin_C "Zeitschwelle im Motorzustand COENG_RUNNING" VALUE 0x80038A40 Val_Wu32 120000.000000 Time_ms 0.00 120000.000000 EXTENDED_LIMITS 0.00 42949672950.0 /end CHARACTERISTIC
/begin CHARACTERISTIC DStgy_tPFltDsHi_C "" VALUE 0x80038A44 Val_Ws16 1240.000 Temp_Cels -40.04000 1199.960 EXTENDED_LIMITS -3549.940 3003.560 /end CHARACTERISTIC
/begin CHARACTERISTIC DStgy_tPFltDsLo_C "" VALUE 0x80038A46 Val_Ws16 1240.000 Temp_Cels -40.04000 1199.960 EXTENDED_LIMITS -3549.940 3003.560 /end CHARACTERISTIC
/begin CHARACTERISTIC DStgy_tUCatDsHi_C "" VALUE 0x80038A48 Val_Ws16 1240.000 Temp_Cels -40.04000 1199.960 EXTENDED_LIMITS -3549.940 3003.560 /end CHARACTERISTIC
/begin CHARACTERISTIC DStgy_tUCatDsLo_C "" VALUE 0x80038A4A Val_Ws16 1240.000 Temp_Cels -40.04000 1199.960 EXTENDED_LIMITS -3549.940 3003.560 /end CHARACTERISTIC
/begin CHARACTERISTIC DStgy_tUCatUsHi_C "" VALUE 0x80038A4C Val_Ws16 1240.000 Temp_Cels -40.04000 1199.960 EXTENDED_LIMITS -3549.940 3003.560 /end CHARACTERISTIC
/begin CHARACTERISTIC DStgy_tUCatUsLo_C "" VALUE 0x80038A4E Val_Ws16 1240.000 Temp_Cels -40.04000 1199.960 EXTENDED_LIMITS -3549.940 3003.560 /end CHARACTERISTIC
/begin CHARACTERISTIC DStgy_tWallUCatUsHiLim_C "Oberer Schwellwert für die Hysterese der Katalysatorwandtemperatur" VALUE 0x80038A50 Val_Ws16 1240.000 Temp_Cels -40.04000 1199.960 EXTENDED_LIMITS -3549.940 3003.560 /end CHARACTERISTIC
/begin CHARACTERISTIC DStgy_tWallUCatUsLoLim_C "Unterer Schwellwert für die Katalysatorwandtemperatur" VALUE 0x80038A52 Val_Ws16 1240.000 Temp_Cels -40.04000 1199.960 EXTENDED_LIMITS -3549.940 3003.560 /end CHARACTERISTIC
/begin CHARACTERISTIC DStgy_uBattHi_C "" VALUE 0x80038A54 Val_Ws16 20000.00 Volt_Batt 0.00 20000.00 EXTENDED_LIMITS -655360.0 655340.0 /end CHARACTERISTIC
/begin CHARACTERISTIC DStgy_uBattLo_C "" VALUE 0x80038A56 Val_Ws16 20000.00 Volt_Batt 0.00 20000.00 EXTENDED_LIMITS -655360.0 655340.0 /end CHARACTERISTIC
/begin CHARACTERISTIC DStgy_vVehMin_CUR "Kennlinie für den Schwellwert der Geschwindigkeit" CURVE 0x80038A58 Cur_Xs16Ws16 255.0000 Vel 0.00 255.0000 EXTENDED_LIMITS -327.6800 327.6700
 /begin AXIS_DESCR STD_AXIS Exh_tPFltDs Temp_Cels 16 -3549.940 3003.560 DEPOSIT ABSOLUTE /end AXIS_DESCR
/end CHARACTERISTIC
/begin CHARACTERISTIC K_DTOG_UBMIN "Min Spannung für die Diagnose Toens" VALUE 0x80063A82 Val_Wu16 6173.4 Def_u_uw_q0p0942 0.00 6173.4 FORMAT "%6.1" /end CHARACTERISTIC
/begin CHARACTERISTIC K_OZDELTOE "Verzögerung für das Schreiben in Fehlerspeicher Töns-Fehler" VALUE 0x80063A84 Val_Wu16 65535. Def_dez_uw_q1 0.00 65535. FORMAT "%5.0" /end CHARACTERISTIC
/begin CHARACTERISTIC K_OZDIAGNMOT "Mindestdrehzahl zur QLT-Diagnose" VALUE 0x80063A86 Val_Ws16 65535. Def_n_sw_q1p0 -32768. 32767. FORMAT "%5.0" /end CHARACTERISTIC
/begin CHARACTERISTIC K_OZDIAGNMOT2 "Max Drehzahl zur QLT-Diagnose" VALUE 0x80063A88 Val_Ws16 65535. Def_n_sw_q1p0 -32768. 32767. FORMAT "%5.0" /end CHARACTERISTIC
/begin CHARACTERISTIC K_OZDIAGSPG "Spannung, unterhalb der die Diagnose ausgeblendet wird" VALUE 0x80063A8A Val_Wu16 6173.4 Def_u_uw_q0p0942 0.00 6173.4 FORMAT "%6.1" /end CHARACTERISTIC
/begin CHARACTERISTIC K_OZERRD "Entprellzeit Sensor- und Kommunikationsfehler" VALUE 0x80063A8C Val_Wu16 65535. Def_dez_uw_q1 0.00 65535. FORMAT "%5.0" /end CHARACTERISTIC
/begin CHARACTERISTIC K_OZHEAL "Entprellzeit Fehler-Healing" VALUE 0x80063A8E Val_Wu16 65535. Def_dez_uw_q1 0.00 65535. FORMAT "%5.0" /end CHARACTERISTIC
/begin CHARACTERISTIC K_OZPLTEMP "Max Temperatursprung QLT (Plausibilisierung wegen ASIC-Pins Bruch)" VALUE 0x80063A90 Val_Wu8 255. Def_dez_ub_q1 0.00 255. FORMAT "%3.0" /end CHARACTERISTIC
/begin CHARACTERISTIC K_OZPLZTEMP "Max unplausibel Sprünge (Plausibilisierung wegen ASIC-Pins Bruch)" VALUE 0x80063A91 Val_Wu8 255. Def_dez_ub_q1 0.00 255. FORMAT "%3.0" /end CHARACTERISTIC
/begin CHARACTERISTIC K_OZTEMPQERR "Temperaturschwelle für den Permittivitätsfehler" VALUE 0x80063A92 Val_Ws16 6553.5 Def_t_sw_q0p1 -3276.8 3276.7 FORMAT "%6.1" /end CHARACTERISTIC
/begin CHARACTERISTIC K_OZZTEMP "Max Zeit mit dem selben Temperaturwert (Plausibilisierung wegen ASIC-Pins Bruch)" VALUE 0x80063A94 Val_Wu16 65535. Def_dez_uw_q1 0.00 65535. FORMAT "%5.0" /end CHARACTERISTIC
/begin CHARACTERISTIC K_TOGMAXUNPL "Max Versuche für unplausibel Fehler Toens" VALUE 0x80063A96 Val_Wu8 255. Def_dez_ub_q1 0.00 255. FORMAT "%3.0" /end CHARACTERISTIC
/begin CHARACTERISTIC K_TOG_CNTMAX "Max Versuche für Signal-Fehler Toens" VALUE 0x80063A98 Val_Wu16 655.350 Def_td_uw_q0p01 0.00 655.350 FORMAT "%7.3" /end CHARACTERISTIC
/begin CHARACTERISTIC S_OZBSDKOORD "BSD Koordinator aktiv" VALUE 0x80063A9A Val_Wu8 255. Def_dez_ub_q1 0.00 255. FORMAT "%3.0" /end CHARACTERISTIC
/begin MEASUREMENT Com_ctrDay "" UWORD OneToOne 1 100 0.00 65535.00 ECU_ADDRESS 0xD00014F0 /end MEASUREMENT
/begin MEASUREMENT Com_ctrDay_FA "" UWORD OneToOne 1 100 0.00 65535.00 ECU_ADDRESS 0xD00014F2 /end MEASUREMENT
/begin MEASUREMENT Com_ctrSec "" ULONG OneToOne 1 100 0.00 4294967295.00 ECU_ADDRESS 0xD000314C /end MEASUREMENT
/begin MEASUREMENT Com_ctrSecAbs "" ULONG OneToOne 1 100 0.00 4294967295.00 ECU_ADDRESS 0xD0003150 /end MEASUREMENT
/begin MEASUREMENT Com_ctrSecAbs_FA "" ULONG OneToOne 1 100 0.00 4294967295.00 ECU_ADDRESS 0xD0003154 /end MEASUREMENT
/begin MEASUREMENT Com_ctrSecInt "" ULONG OneToOne 1 100 0.00 4294967295.00 ECU_ADDRESS 0xD0003158 /end MEASUREMENT
/begin MEASUREMENT Com_ctrSec_FA "" ULONG OneToOne 1 100 0.00 4294967295.00 ECU_ADDRESS 0xD000315C /end MEASUREMENT
/begin MEASUREMENT Com_dDay "" UBYTE OneToOne 1 100 0.00 255.0 ECU_ADDRESS 0xD0001C7E /end MEASUREMENT
/begin MEASUREMENT Com_dDay_FA "" UBYTE OneToOne 1 100 0.00 255.0 ECU_ADDRESS 0xD0001C7F /end MEASUREMENT
/begin MEASUREMENT Com_dMonth "" UBYTE OneToOne 1 100 0.00 255.0 ECU_ADDRESS 0xD0001C90 /end MEASUREMENT
/begin MEASUREMENT Com_dMonth_FA "" UBYTE OneToOne 1 100 0.00 255.0 ECU_ADDRESS 0xD0001C95 /end MEASUREMENT
/begin MEASUREMENT Com_dStKombiCTR "" UWORD OneToOne 1 100 0.00 65535.00 ECU_ADDRESS 0xD0001526 /end MEASUREMENT
/begin MEASUREMENT Com_dYear "" UWORD OneToOne 1 100 0.00 65535.00 ECU_ADDRESS 0xD0001572 /end MEASUREMENT
/begin MEASUREMENT Com_dYear_FA "" UWORD OneToOne 1 100 0.00 65535.00 ECU_ADDRESS 0xD0001574 /end MEASUREMENT
/begin MEASUREMENT Com_lFlTnkQntLow "" UWORD OneToOne_km 1 100 0.00 65535.00 FORMAT "%8.2" ECU_ADDRESS 0xD0001588 /end MEASUREMENT
/begin MEASUREMENT Com_lFlTnkQntLow_FA "" UWORD OneToOne_km 1 100 0.00 65535.00 FORMAT "%8.2" ECU_ADDRESS 0xD000158A /end MEASUREMENT
/begin MEASUREMENT Com_lSum "" ULONG OneToOne_km 1 100 0.00 4294967295.00 FORMAT "%13.2" ECU_ADDRESS 0xD0003160 /end MEASUREMENT
/begin MEASUREMENT Com_lSumRaw "" ULONG OneToOne_km 1 100 0.00 4294967295.00 FORMAT "%13.2" ECU_ADDRESS 0xD0003164 /end MEASUREMENT
/begin MEASUREMENT Com_lSum_FA "" ULONG OneToOne_km 1 100 0.00 4294967295.00 FORMAT "%13.2" ECU_ADDRESS 0xD0003168 /end MEASUREMENT
/begin MEASUREMENT Com_stCrCtlKombi "" UBYTE OneToOne 1 100 0.00 255.0 ECU_ADDRESS 0xD0001CF0 /end MEASUREMENT
/begin MEASUREMENT Com_stFlTnkQntRes "" UBYTE OneToOne 1 100 0.00 255.0 ECU_ADDRESS 0xD0001D0E /end MEASUREMENT
/begin MEASUREMENT Com_stFlTnkQntRes_FA "" UBYTE OneToOne 1 100 0.00 255.0 ECU_ADDRESS 0xD0001D0F /end MEASUREMENT
/begin MEASUREMENT Com_stLmpPrkBrk "" UBYTE OneToOne 1 100 0.00 255.0 ECU_ADDRESS 0xD0001D2B /end MEASUREMENT
/begin MEASUREMENT Com_stSeason "" UBYTE OneToOne 1 100 0.00 255.0 ECU_ADDRESS 0xD0001D5B /end MEASUREMENT
/begin MEASUREMENT Com_stSeason_FA "" UBYTE OneToOne 1 100 0.00 255.0 ECU_ADDRESS 0xD0001D5C /end MEASUREMENT
/begin MEASUREMENT Com_stSysTime "" UBYTE OneToOne 1 100 0.00 255.0 ECU_ADDRESS 0xD0001D81 /end MEASUREMENT
/begin MEASUREMENT Com_stUnVel "" UBYTE OneToOne 1 100 0.00 255.0 ECU_ADDRESS 0xD0001DA7 /end MEASUREMENT
/begin MEASUREMENT Com_tEnvT "" SWORD Temp_Cels 1 100 -3549.940 3003.560 ECU_ADDRESS 0xD00007FA /end MEASUREMENT
/begin MEASUREMENT Com_tEnvT_FA "" SWORD Temp_Cels 1 100 -3549.940 3003.560 ECU_ADDRESS 0xD00007FC /end MEASUREMENT
/begin MEASUREMENT Com_tEnvT_FX "" SWORD Temp_Cels 1 100 -3549.940 3003.560 ECU_ADDRESS 0xD00007FE /end MEASUREMENT
/begin MEASUREMENT Com_vDspl "" SWORD Vel 1 100 -327.6800 327.6700 ECU_ADDRESS 0xD000086A /end MEASUREMENT
/begin MEASUREMENT Com_volFlTnkQnt "" SWORD Vol 1 100 -327.6800 327.6700 FORMAT "%8.4" ECU_ADDRESS 0xD0000874 /end MEASUREMENT
/begin MEASUREMENT Com_volFlTnkQntLH "" SWORD Vol 1 100 -327.6800 327.6700 FORMAT "%8.4" ECU_ADDRESS 0xD0000876 /end MEASUREMENT
/begin MEASUREMENT Com_volFlTnkQntLH_FA "" SWORD Vol 1 100 -327.6800 327.6700 FORMAT "%8.4" ECU_ADDRESS 0xD0000878 /end MEASUREMENT
/begin MEASUREMENT Com_volFlTnkQntRH "" SWORD Vol 1 100 -327.6800 327.6700 FORMAT "%8.4" ECU_ADDRESS 0xD000087A /end MEASUREMENT
/begin MEASUREMENT Com_volFlTnkQntRH_FA "" SWORD Vol 1 100 -327.6800 327.6700 FORMAT "%8.4" ECU_ADDRESS 0xD000087C /end MEASUREMENT
/begin MEASUREMENT Com_volFlTnkQnt_FA "" SWORD Vol 1 100 -327.6800 327.6700 FORMAT "%8.4" ECU_ADDRESS 0xD000087E /end MEASUREMENT
/begin MEASUREMENT DIUMPR_ctDenom "berechnete Nenner der IUMPR relevanten Diagnosen (Varainte 1)" UWORD OneToOne 1 100 0.00 65535.00 ARRAY_SIZE 20 ECU_ADDRESS 0xD00095E6 /end MEASUREMENT
/begin MEASUREMENT DIUMPR_ctGenDenom "general denominator" UWORD DFES_OneToOne 1 100 0.00 65535.00 ECU_ADDRESS 0xD000960E /end MEASUREMENT
/begin MEASUREMENT DIUMPR_ctIgn "ignition cycle counter" UWORD DFES_OneToOne 1 100 0.00 65535.00 ECU_ADDRESS 0xD0009610 /end MEASUREMENT
/begin MEASUREMENT DIUMPR_ctNum "berechnete Zähler der IUMPR relevanten Diagnosen (Variante 1)" UWORD OneToOne 1 100 0.00 65535.00 ARRAY_SIZE 20 ECU_ADDRESS 0xD00095BE /end MEASUREMENT
/begin MEASUREMENT DIUMPR_numIndGrp "IUMPR record mit dem kleinsten Ratio innerhalb der Komponentengruppe" UBYTE OneToOne 1 100 0.00 255.0 ARRAY_SIZE 8 ECU_ADDRESS 0xC0008993 /end MEASUREMENT
/begin MEASUREMENT DIUMPR_rMBGrp "kleinstes Ratio innerhalb des Messwerteblocks" UWORD Fact 1 100 0.00 7.999878 ARRAY_SIZE 10 ECU_ADDRESS 0xD0006674 /end MEASUREMENT
/begin MEASUREMENT DIUMPR_rValRatMin "kleinstes Ratio innerhalb der Komponentegruppe" UWORD Fact 1 100 0.00 7.999878 ARRAY_SIZE 8 ECU_ADDRESS 0xD0006664 /end MEASUREMENT
/begin MEASUREMENT DIUMPR_state "Statusbytes der IUMPR relevanten Diagnosen (Variante 1)" UBYTE OneToOne 1 100 0.00 255.0 ARRAY_SIZE 20 ECU_ADDRESS 0xC000897A /end MEASUREMENT
/begin MEASUREMENT DIUMPR_stEnaDenom "status von general denominator und ignition cycle counter" UWORD DFES_OneToOne 1 100 0.00 65535.00 ECU_ADDRESS 0xD000564C /end MEASUREMENT
/begin MEASUREMENT DIUMPR_stFIdGenDenom_mp "FId status (Mode 7 Sichtbarkeit) des general denominator" UBYTE OneToOne 1 100 0.00 255.0 ECU_ADDRESS 0xC000B139 /end MEASUREMENT
/begin MEASUREMENT DIUMPR_tiEngOpCum "kumulierte Betriebszeit seit Motorstart" UWORD DIUMPR_ti100ms 1 100 0.00 6553.500 FORMAT "%8.3" ECU_ADDRESS 0xD0005650 /end MEASUREMENT
/begin MEASUREMENT DIUMPR_tiIdl "ununterbrochene Betriebszeit im Leerlauf" UWORD DIUMPR_ti100ms 1 100 0.00 6553.500 FORMAT "%8.3" ECU_ADDRESS 0xD0005652 /end MEASUREMENT
/begin MEASUREMENT DIUMPR_tiIgn "ununterbrochene Betriebszeit seit Motorstart" UBYTE DIUMPR_ti100ms 1 100 0.00 25.50 FORMAT "%5.2" ECU_ADDRESS 0xC0007D4D /end MEASUREMENT
/begin MEASUREMENT DIUMPR_tiSigActv "ununterbrochene Betriebszeit der beobachteten Überwachung" UBYTE DIUMPR_ti100ms 1 100 0.00 25.50 FORMAT "%5.2" ARRAY_SIZE 5 ECU_ADDRESS 0xC000898E /end MEASUREMENT
/begin MEASUREMENT DIUMPR_tiVehSpdCum "kumulierte Beriebszeit über einer Geschwindigkeitsgrenze" UWORD DIUMPR_ti100ms 1 100 0.00 6553.500 FORMAT "%8.3" ECU_ADDRESS 0xD000564E /end MEASUREMENT
/begin MEASUREMENT Dme_ctDataSetVariant "Aktuelle Datensatzvariante" UBYTE OneToOne 1 100 0.00 255.0 ECU_ADDRESS 0xC0007D4F /end MEASUREMENT
/begin MEASUREMENT Dme_numBytesAvailable "Anzahl der für die serielle Applikation verfügbaren Bytes" ULONG OneToOne 1 100 0.00 4294967295.00 ECU_ADDRESS 0xC0003024 /end MEASUREMENT
/begin MEASUREMENT DSCHED_DynPrio.FId_Unused "Dynamische Priorität/intern benötigter Parameter für nicht existierenden Funktionsidentifier FId_Unused" SWORD DFC_OneToOne 1 100 -32768.00 32767.00 ECU_ADDRESS 0xD0005664 /end MEASUREMENT
/begin MEASUREMENT DSCHED_DynPrio.FId_InhibitAlways "Dynamische Priorität/Dynamische Priorität des Scheduled Funktions Identifiers FId_InhibitAlways" SWORD DFC_OneToOne 1 100 -32768.00 32767.00 ECU_ADDRESS 0xD0005666 /end MEASUREMENT
/begin MEASUREMENT DSCHED_DynPrio.FId_CoordALS "Dynamische Priorität/Dynamische Priorität des Scheduled Funktions Identifiers FId_CoordALS" SWORD DFC_OneToOne 1 100 -32768.00 32767.00 ECU_ADDRESS 0xD0005668 /end MEASUREMENT
/begin MEASUREMENT DSCHED_DynPrio.FId_CoordFBC "Dynamische Priorität/Dynamische Priorität des Scheduled Funktions Identifiers FId_CoordFBC" SWORD DFC_OneToOne 1 100 -32768.00 32767.00 ECU_ADDRESS 0xD000566A /end MEASUREMENT
/begin MEASUREMENT DSCHED_DynPrio.FId_CoordTAA "Dynamische Priorität/Dynamische Priorität des Scheduled Funktions Identifiers FId_CoordTAA" SWORD DFC_OneToOne 1 100 -32768.00 32767.00 ECU_ADDRESS 0xD000566C /end MEASUREMENT
/begin MEASUREMENT DSCHED_DynPrio.FId_CoordZFC "Dynamische Priorität/Dynamische Priorität des Scheduled Funktions Identifiers FId_CoordZFC" SWORD DFC_OneToOne 1 100 -32768.00 32767.00 ECU_ADDRESS 0xD000566E /end MEASUREMENT
/begin MEASUREMENT DSCHED_DynPrio.FId_IVPlausRunUpTstActv "Dynamische Priorität/Dynamische Priorität des Scheduled Funktions Identifiers FId_IVPlausRunUpTstActv" SWORD DFC_OneToOne 1 100 -32768.00 32767.00 ECU_ADDRESS 0xD0005670 /end MEASUREMENT
/begin MEASUREMENT DSCHED_DynPrio.FId_RailHpTstActv "Dynamische Priorität/Dynamische Priorität des Scheduled Funktions Identifiers FId_RailHpTstActv" SWORD DFC_OneToOne 1 100 -32768.00 32767.00 ECU_ADDRESS 0xD0005672 /end MEASUREMENT
/begin MEASUREMENT DSCHED_PhysPrio.FId_Unused "Physikalische Priorität/intern benötigter Parameter für nicht existierenden Funktionsidentifier FId_Unused" UBYTE DFC_OneToOne 1 100 0.00 255.0 ECU_ADDRESS 0xC0007D52 /end MEASUREMENT
/begin MEASUREMENT DSCHED_PhysPrio.FId_InhibitAlways "Physikalische Priorität/Physikalische Priorität des Scheduled Funktions Identifiers FId_InhibitAlways" UBYTE DFC_OneToOne 1 100 0.00 255.0 ECU_ADDRESS 0xC0007D53 /end MEASUREMENT
/begin MEASUREMENT DSCHED_PhysPrio.FId_CoordALS "Physikalische Priorität/Physikalische Priorität des Scheduled Funktions Identifiers FId_CoordALS" UBYTE DFC_OneToOne 1 100 0.00 255.0 ECU_ADDRESS 0xC0007D54 /end MEASUREMENT
/begin MEASUREMENT DSCHED_PhysPrio.FId_CoordFBC "Physikalische Priorität/Physikalische Priorität des Scheduled Funktions Identifiers FId_CoordFBC" UBYTE DFC_OneToOne 1 100 0.00 255.0 ECU_ADDRESS 0xC0007D55 /end MEASUREMENT
/begin MEASUREMENT DSCHED_PhysPrio.FId_CoordTAA "Physikalische Priorität/Physikalische Priorität des Scheduled Funktions Identifiers FId_CoordTAA" UBYTE DFC_OneToOne 1 100 0.00 255.0 ECU_ADDRESS 0xC0007D56 /end MEASUREMENT
/begin MEASUREMENT DSCHED_PhysPrio.FId_CoordZFC "Physikalische Priorität/Physikalische Priorität des Scheduled Funktions Identifiers FId_CoordZFC" UBYTE DFC_OneToOne 1 100 0.00 255.0 ECU_ADDRESS 0xC0007D57 /end MEASUREMENT
/begin MEASUREMENT DSCHED_PhysPrio.FId_IVPlausRunUpTstActv "Physikalische Priorität/Physikalische Priorität des Scheduled Funktions Identifiers FId_IVPlausRunUpTstActv" UBYTE DFC_OneToOne 1 100 0.00 255.0 ECU_ADDRESS 0xC0007D58 /end MEASUREMENT
/begin MEASUREMENT DSCHED_PhysPrio.FId_RailHpTstActv "Physikalische Priorität/Physikalische Priorität des Scheduled Funktions Identifiers FId_RailHpTstActv" UBYTE DFC_OneToOne 1 100 0.00 255.0 ECU_ADDRESS 0xC0007D59 /end MEASUREMENT
/begin MEASUREMENT DSCHED_RmpPrio.FId_Unused "DSCHED Rampen Priorisierung/intern benötigter Parameter für nicht existierenden Funktionsidentifier FId_Unused" UWORD DFC_OneToOne 1 100 0.00 65535.00 ECU_ADDRESS 0xD0005654 /end MEASUREMENT
/begin MEASUREMENT DSCHED_RmpPrio.FId_InhibitAlways "DSCHED Rampen Priorisierung/Rampen Priorität des Scheduled Funktions Identifiers FId_InhibitAlways" UWORD DFC_OneToOne 1 100 0.00 65535.00 ECU_ADDRESS 0xD0005656 /end MEASUREMENT
/begin MEASUREMENT DSCHED_RmpPrio.FId_CoordALS "DSCHED Rampen Priorisierung/Rampen Priorität des Scheduled Funktions Identifiers FId_CoordALS" UWORD DFC_OneToOne 1 100 0.00 65535.00 ECU_ADDRESS 0xD0005658 /end MEASUREMENT
/begin MEASUREMENT DSCHED_RmpPrio.FId_CoordFBC "DSCHED Rampen Priorisierung/Rampen Priorität des Scheduled Funktions Identifiers FId_CoordFBC" UWORD DFC_OneToOne 1 100 0.00 65535.00 ECU_ADDRESS 0xD000565A /end MEASUREMENT
/begin MEASUREMENT DSCHED_RmpPrio.FId_CoordTAA "DSCHED Rampen Priorisierung/Rampen Priorität des Scheduled Funktions Identifiers FId_CoordTAA" UWORD DFC_OneToOne 1 100 0.00 65535.00 ECU_ADDRESS 0xD000565C /end MEASUREMENT
/begin MEASUREMENT DSCHED_RmpPrio.FId_CoordZFC "DSCHED Rampen Priorisierung/Rampen Priorität des Scheduled Funktions Identifiers FId_CoordZFC" UWORD DFC_OneToOne 1 100 0.00 65535.00 ECU_ADDRESS 0xD000565E /end MEASUREMENT
/begin MEASUREMENT DSCHED_RmpPrio.FId_IVPlausRunUpTstActv "DSCHED Rampen Priorisierung/Rampen Priorität des Scheduled Funktions Identifiers FId_IVPlausRunUpTstActv" UWORD DFC_OneToOne 1 100 0.00 65535.00 ECU_ADDRESS 0xD0005660 /end MEASUREMENT
/begin MEASUREMENT DSCHED_RmpPrio.FId_RailHpTstActv "DSCHED Rampen Priorisierung/Rampen Priorität des Scheduled Funktions Identifiers FId_RailHpTstActv" UWORD DFC_OneToOne 1 100 0.00 65535.00 ECU_ADDRESS 0xD0005662 /end MEASUREMENT
/begin MEASUREMENT DSCHED_St.FId_Unused "DSCHED Status der FIds/intern benötigter Parameter für nicht existierenden Funktionsidentifier FId_Unused" UBYTE DSCHED_StVerb 1 100 0.00 238.000000000 FORMAT "%13.9" ECU_ADDRESS 0xD0003C18 /end MEASUREMENT
/begin MEASUREMENT DSCHED_St.FId_InhibitAlways "DSCHED Status der FIds/Scheduler Status des Funktions Identifiers FId_InhibitAlways" UBYTE DSCHED_StVerb 1 100 0.00 238.000000000 FORMAT "%13.9" ECU_ADDRESS 0xD0003C19 /end MEASUREMENT
/begin MEASUREMENT DSCHED_St.FId_CoordALS "DSCHED Status der FIds/Scheduler Status des Funktions Identifiers FId_CoordALS" UBYTE DSCHED_StVerb 1 100 0.00 238.000000000 FORMAT "%13.9" ECU_ADDRESS 0xD0003C1A /end MEASUREMENT
/begin MEASUREMENT DSCHED_St.FId_CoordFBC "DSCHED Status der FIds/Scheduler Status des Funktions Identifiers FId_CoordFBC" UBYTE DSCHED_StVerb 1 100 0.00 238.000000000 FORMAT "%13.9" ECU_ADDRESS 0xD0003C1B /end MEASUREMENT
/begin MEASUREMENT DSCHED_St.FId_CoordTAA "DSCHED Status der FIds/Scheduler Status des Funktions Identifiers FId_CoordTAA" UBYTE DSCHED_StVerb 1 100 0.00 238.000000000 FORMAT "%13.9" ECU_ADDRESS 0xD0003C1C /end MEASUREMENT
/begin MEASUREMENT DSCHED_St.FId_CoordZFC "DSCHED Status der FIds/Scheduler Status des Funktions Identifiers FId_CoordZFC" UBYTE DSCHED_StVerb 1 100 0.00 238.000000000 FORMAT "%13.9" ECU_ADDRESS 0xD0003C1D /end MEASUREMENT
/begin MEASUREMENT DSCHED_St.FId_IVPlausRunUpTstActv "DSCHED Status der FIds/Scheduler Status des Funktions Identifiers FId_IVPlausRunUpTstActv" UBYTE DSCHED_StVerb 1 100 0.00 238.000000000 FORMAT "%13.9" ECU_ADDRESS 0xD0003C1E /end MEASUREMENT
/begin MEASUREMENT DSCHED_St.FId_RailHpTstActv "DSCHED Status der FIds/Scheduler Status des Funktions Identifiers FId_RailHpTstActv" UBYTE DSCHED_StVerb 1 100 0.00 238.000000000 FORMAT "%13.9" ECU_ADDRESS 0xD0003C1F /end MEASUREMENT
/begin MEASUREMENT DSCHED_WhyExcl.FId_Unused "DSCHED Exclusionsgrund des FIds/intern benötigter Parameter für nicht existierenden Funktionsidentifier FId_Unused" UWORD DSCHED_FIdExcCauseVerb 1 100 0.00 255. FORMAT "%2.0" ECU_ADDRESS 0xD0005674 /end MEASUREMENT
/begin MEASUREMENT DSCHED_WhyExcl.FId_InhibitAlways "DSCHED Exclusionsgrund des FIds/Ausschlussgrund des Scheduled Funktions Identifiers FId_InhibitAlways" UWORD DSCHED_FIdExcCauseVerb 1 100 0.00 255. FORMAT "%2.0" ECU_ADDRESS 0xD0005676 /end MEASUREMENT
/begin MEASUREMENT DSCHED_WhyExcl.FId_CoordALS "DSCHED Exclusionsgrund des FIds/Ausschlussgrund des Scheduled Funktions Identifiers FId_CoordALS" UWORD DSCHED_FIdExcCauseVerb 1 100 0.00 255. FORMAT "%2.0" ECU_ADDRESS 0xD0005678 /end MEASUREMENT
/begin MEASUREMENT DSCHED_WhyExcl.FId_CoordFBC "DSCHED Exclusionsgrund des FIds/Ausschlussgrund des Scheduled Funktions Identifiers FId_CoordFBC" UWORD DSCHED_FIdExcCauseVerb 1 100 0.00 255. FORMAT "%2.0" ECU_ADDRESS 0xD000567A /end MEASUREMENT
/begin MEASUREMENT DSCHED_WhyExcl.FId_CoordTAA "DSCHED Exclusionsgrund des FIds/Ausschlussgrund des Scheduled Funktions Identifiers FId_CoordTAA" UWORD DSCHED_FIdExcCauseVerb 1 100 0.00 255. FORMAT "%2.0" ECU_ADDRESS 0xD000567C /end MEASUREMENT
/begin MEASUREMENT DSCHED_WhyExcl.FId_CoordZFC "DSCHED Exclusionsgrund des FIds/Ausschlussgrund des Scheduled Funktions Identifiers FId_CoordZFC" UWORD DSCHED_FIdExcCauseVerb 1 100 0.00 255. FORMAT "%2.0" ECU_ADDRESS 0xD000567E /end MEASUREMENT
/begin MEASUREMENT DSCHED_WhyExcl.FId_IVPlausRunUpTstActv "DSCHED Exclusionsgrund des FIds/Ausschlussgrund des Scheduled Funktions Identifiers FId_IVPlausRunUpTstActv" UWORD DSCHED_FIdExcCauseVerb 1 100 0.00 255. FORMAT "%2.0" ECU_ADDRESS 0xD0005680 /end MEASUREMENT
/begin MEASUREMENT DSCHED_WhyExcl.FId_RailHpTstActv "DSCHED Exclusionsgrund des FIds/Ausschlussgrund des Scheduled Funktions Identifiers FId_RailHpTstActv" UWORD DSCHED_FIdExcCauseVerb 1 100 0.00 255. FORMAT "%2.0" ECU_ADDRESS 0xD0005682 /end MEASUREMENT
/begin MEASUREMENT DSMAUX_ctWUC "Anzahl an warm up cycle seit Fehlerspeicher löschen" UBYTE OneToOne 1 100 0.00 255.0 ECU_ADDRESS 0xD00094DE /end MEASUREMENT
/begin MEASUREMENT DSMAUX_DTRG.DTRG_Time200ms "Triggerstatus/Zeit (200ms Quantisierung)" UBYTE DFC_OneToOne 1 100 0.00 255.0 ECU_ADDRESS 0xC0007D5D /end MEASUREMENT
/begin MEASUREMENT DSMAUX_DTRG.DTRG_SimilarCondHLC "Triggerstatus/driving cycle (Heilungszähler mit similar conditions)" UBYTE DFC_OneToOne 1 100 0.00 255.0 ECU_ADDRESS 0xC0007D5E /end MEASUREMENT
/begin MEASUREMENT DSMAUX_DTRG.DTRG_AlwaysTrue "Triggerstatus/unbedingt gesetzt" UBYTE DFC_OneToOne 1 100 0.00 255.0 ECU_ADDRESS 0xC0007D5F /end MEASUREMENT
/begin MEASUREMENT DSMAUX_DTRG.DTRG_DrivingCycleFLC "Triggerstatus/driving cycle (Fehlerzähler)" UBYTE DFC_OneToOne 1 100 0.00 255.0 ECU_ADDRESS 0xC0007D60 /end MEASUREMENT
/begin MEASUREMENT DSMAUX_DTRG.DTRG_DrivingCycleHLC "Triggerstatus/driving cycle (Heilungszähler)" UBYTE DFC_OneToOne 1 100 0.00 255.0 ECU_ADDRESS 0xC0007D61 /end MEASUREMENT
/begin MEASUREMENT DSMAUX_DTRG.DTRG_NoTrigger "Triggerstatus/unbedingt zurückgesetzt" UBYTE DFC_OneToOne 1 100 0.00 255.0 ECU_ADDRESS 0xC0007D62 /end MEASUREMENT
/begin MEASUREMENT DSMAUX_DTRG.DTRG_WarmUpCycle "Triggerstatus/warm up cycle" UBYTE DFC_OneToOne 1 100 0.00 255.0 ECU_ADDRESS 0xC0007D63 /end MEASUREMENT
/begin MEASUREMENT DSMAUX_stStrtEnd "Motorstart abgeschlossen im aktuellen Fahrzyklus" UBYTE OneToOne 1 100 0.00 1.000 BIT_MASK 0x1 ECU_ADDRESS 0xD00003C4 /end MEASUREMENT
/begin MEASUREMENT DSMAUX_tClntStrt "Kühlmitteltemperatur bei Start" SWORD Temp_Cels 1 100 -3549.940 3003.560 ECU_ADDRESS 0xD000568E /end MEASUREMENT
/begin MEASUREMENT DSMDur_ctDFES0 "erster eintragsspezifischer duration counter" UWORD DFES_OneToOne 1 100 0.00 65535.00 ARRAY_SIZE 20 ECU_ADDRESS 0xD00094E6 /end MEASUREMENT
/begin MEASUREMENT DSMDur_ctDFES1 "zweiter eintragsspezifischer duration counter" UWORD DFES_OneToOne 1 100 0.00 65535.00 ARRAY_SIZE 20 ECU_ADDRESS 0xD000950E /end MEASUREMENT
/begin MEASUREMENT DSMDur_ctDFES2 "dritter eintragsspezifischer duration counter" UWORD DFES_OneToOne 1 100 0.00 65535.00 ARRAY_SIZE 20 ECU_ADDRESS 0xD0009536 /end MEASUREMENT
/begin MEASUREMENT DSMDur_ctGlb "globale duration counter" ULONG DFES_OneToOne 1 100 0.00 4294967295.00 ARRAY_SIZE 1 ECU_ADDRESS 0xD00094E0 /end MEASUREMENT
/begin MEASUREMENT DSMDur_stGlb "Status der globalen duration counter" UBYTE DSMDur_StDispl_Verb 1 100 0.00 2.00000000000 FORMAT "%13.11" ARRAY_SIZE 1 ECU_ADDRESS 0xD00094E4 /end MEASUREMENT
/begin MEASUREMENT DSMRdy_Ct.RdyMisf_mp "DSMRdy: Anzahl Fehlerprüfungen/ready (Misfire)" UBYTE DSMRdy_OneToOne 1 100 0.00 255.0 FORMAT "%5.1" ECU_ADDRESS 0xC000899B /end MEASUREMENT
/begin MEASUREMENT DSMRdy_Ct.RdyFlSys_mp "DSMRdy: Anzahl Fehlerprüfungen/ready (Fuel system)" UBYTE DSMRdy_OneToOne 1 100 0.00 255.0 FORMAT "%5.1" ECU_ADDRESS 0xC000899C /end MEASUREMENT
/begin MEASUREMENT DSMRdy_Ct.RdyComprCmpnt_mp "DSMRdy: Anzahl Fehlerprüfungen/ready (Comprehensive component)" UBYTE DSMRdy_OneToOne 1 100 0.00 255.0 FORMAT "%5.1" ECU_ADDRESS 0xC000899D /end MEASUREMENT
/begin MEASUREMENT DSMRdy_Ct.RdyCat_mp "DSMRdy: Anzahl Fehlerprüfungen/ready (Catalyst)" UBYTE DSMRdy_OneToOne 1 100 0.00 255.0 FORMAT "%5.1" ECU_ADDRESS 0xC000899E /end MEASUREMENT
/begin MEASUREMENT DSMRdy_Ct.RdyHtCat_mp "DSMRdy: Anzahl Fehlerprüfungen/ready (Heated catalyst)" UBYTE DSMRdy_OneToOne 1 100 0.00 255.0 FORMAT "%5.1" ECU_ADDRESS 0xC000899F /end MEASUREMENT
/begin MEASUREMENT DSMRdy_Ct.RdyEvpSys_mp "DSMRdy: Anzahl Fehlerprüfungen/ready (Evaporative system)" UBYTE DSMRdy_OneToOne 1 100 0.00 255.0 FORMAT "%5.1" ECU_ADDRESS 0xC00089A0 /end MEASUREMENT
/begin MEASUREMENT DSMRdy_Ct.RdySecAirSys_mp "DSMRdy: Anzahl Fehlerprüfungen/ready (Secondary air system)" UBYTE DSMRdy_OneToOne 1 100 0.00 255.0 FORMAT "%5.1" ECU_ADDRESS 0xC00089A1 /end MEASUREMENT
/begin MEASUREMENT DSMRdy_Ct.RdyAC_mp "DSMRdy: Anzahl Fehlerprüfungen/ready (A/C system refrigerant)" UBYTE DSMRdy_OneToOne 1 100 0.00 255.0 FORMAT "%5.1" ECU_ADDRESS 0xC00089A2 /end MEASUREMENT
/begin MEASUREMENT DSMRdy_Ct.RdyO2Sens_mp "DSMRdy: Anzahl Fehlerprüfungen/ready (Oxygen sensor)" UBYTE DSMRdy_OneToOne 1 100 0.00 255.0 FORMAT "%5.1" ECU_ADDRESS 0xC00089A3 /end MEASUREMENT
/begin MEASUREMENT DSMRdy_Ct.RdyO2SensHt_mp "DSMRdy: Anzahl Fehlerprüfungen/ready (Oxygen sensor heater)" UBYTE DSMRdy_OneToOne 1 100 0.00 255.0 FORMAT "%5.1" ECU_ADDRESS 0xC00089A4 /end MEASUREMENT
/begin MEASUREMENT DSMRdy_Ct.RdyEGR_mp "DSMRdy: Anzahl Fehlerprüfungen/ready (EGR system)" UBYTE DSMRdy_OneToOne 1 100 0.00 255.0 FORMAT "%5.1" ECU_ADDRESS 0xC00089A5 /end MEASUREMENT
/begin MEASUREMENT DSMRdy_Ct.CyclCmplMisf_mp "DSMRdy: Anzahl Fehlerprüfungen/getestet im aktuellen DC (Misfire)" UBYTE DSMRdy_OneToOne 1 100 0.00 255.0 FORMAT "%5.1" ECU_ADDRESS 0xC00089A6 /end MEASUREMENT
/begin MEASUREMENT DSMRdy_Ct.CyclCmplFlSys_mp "DSMRdy: Anzahl Fehlerprüfungen/getestet im aktuellen DC (Fuel system)" UBYTE DSMRdy_OneToOne 1 100 0.00 255.0 FORMAT "%5.1" ECU_ADDRESS 0xC00089A7 /end MEASUREMENT
/begin MEASUREMENT DSMRdy_Ct.CyclCmplComprCmpnt_mp "DSMRdy: Anzahl Fehlerprüfungen/getestet im aktuellen DC (Comprehensive component)" UBYTE DSMRdy_OneToOne 1 100 0.00 255.0 FORMAT "%5.1" ECU_ADDRESS 0xC00089A8 /end MEASUREMENT
/begin MEASUREMENT DSMRdy_Ct.CyclCmplCat_mp "DSMRdy: Anzahl Fehlerprüfungen/getestet im aktuellen DC (Catalyst)" UBYTE DSMRdy_OneToOne 1 100 0.00 255.0 FORMAT "%5.1" ECU_ADDRESS 0xC00089A9 /end MEASUREMENT
/begin MEASUREMENT DSMRdy_Ct.CyclCmplHtCat_mp "DSMRdy: Anzahl Fehlerprüfungen/getestet im aktuellen DC (Heated catalyst)" UBYTE DSMRdy_OneToOne 1 100 0.00 255.0 FORMAT "%5.1" ECU_ADDRESS 0xC00089AA /end MEASUREMENT
/begin MEASUREMENT DSMRdy_Ct.CyclCmplEvpSys_mp "DSMRdy: Anzahl Fehlerprüfungen/getestet im aktuellen DC (Evaporative system)" UBYTE DSMRdy_OneToOne 1 100 0.00 255.0 FORMAT "%5.1" ECU_ADDRESS 0xC00089AB /end MEASUREMENT
/begin MEASUREMENT DSMRdy_Ct.CyclCmplSecAirSys_mp "DSMRdy: Anzahl Fehlerprüfungen/getestet im aktuellen DC (Secondary air system)" UBYTE DSMRdy_OneToOne 1 100 0.00 255.0 FORMAT "%5.1" ECU_ADDRESS 0xC00089AC /end MEASUREMENT
/begin MEASUREMENT DSMRdy_Ct.CyclCmplAC_mp "DSMRdy: Anzahl Fehlerprüfungen/getestet im aktuellen DC (A/C system refrigerant)" UBYTE DSMRdy_OneToOne 1 100 0.00 255.0 FORMAT "%5.1" ECU_ADDRESS 0xC00089AD /end MEASUREMENT
/begin MEASUREMENT DSMRdy_Ct.CyclCmplO2Sens_mp "DSMRdy: Anzahl Fehlerprüfungen/getestet im aktuellen DC (Oxygen sensor)" UBYTE DSMRdy_OneToOne 1 100 0.00 255.0 FORMAT "%5.1" ECU_ADDRESS 0xC00089AE /end MEASUREMENT
/begin MEASUREMENT DSMRdy_Ct.CyclCmplO2SensHt_mp "DSMRdy: Anzahl Fehlerprüfungen/getestet im aktuellen DC (Oxygen sensor heater)" UBYTE DSMRdy_OneToOne 1 100 0.00 255.0 FORMAT "%5.1" ECU_ADDRESS 0xC00089AF /end MEASUREMENT
/begin MEASUREMENT DSMRdy_Ct.CyclCmplEGR_mp "DSMRdy: Anzahl Fehlerprüfungen/getestet im aktuellen DC (EGR system)" UBYTE DSMRdy_OneToOne 1 100 0.00 255.0 FORMAT "%5.1" ECU_ADDRESS 0xC00089B0 /end MEASUREMENT
/begin MEASUREMENT DSMRdy_Ct.LockMisf_mp "DSMRdy: Anzahl Fehlerprüfungen/gesperrt für den Rest des DC (Misfire)" UBYTE DSMRdy_OneToOne 1 100 0.00 255.0 FORMAT "%5.1" ECU_ADDRESS 0xC00089B1 /end MEASUREMENT
/begin MEASUREMENT DSMRdy_Ct.LockFlSys_mp "DSMRdy: Anzahl Fehlerprüfungen/gesperrt für den Rest des DC (Fuel system)" UBYTE DSMRdy_OneToOne 1 100 0.00 255.0 FORMAT "%5.1" ECU_ADDRESS 0xC00089B2 /end MEASUREMENT
/begin MEASUREMENT DSMRdy_Ct.LockComprCmpnt_mp "DSMRdy: Anzahl Fehlerprüfungen/gesperrt für den Rest des DC (Comprehensive component)" UBYTE DSMRdy_OneToOne 1 100 0.00 255.0 FORMAT "%5.1" ECU_ADDRESS 0xC00089B3 /end MEASUREMENT
/begin MEASUREMENT DSMRdy_Ct.LockCat_mp "DSMRdy: Anzahl Fehlerprüfungen/gesperrt für den Rest des DC (Catalyst)" UBYTE DSMRdy_OneToOne 1 100 0.00 255.0 FORMAT "%5.1" ECU_ADDRESS 0xC00089B4 /end MEASUREMENT
/begin MEASUREMENT DSMRdy_Ct.LockHtCat_mp "DSMRdy: Anzahl Fehlerprüfungen/gesperrt für den Rest des DC (Heated catalyst)" UBYTE DSMRdy_OneToOne 1 100 0.00 255.0 FORMAT "%5.1" ECU_ADDRESS 0xC00089B5 /end MEASUREMENT
/begin MEASUREMENT DSMRdy_Ct.LockEvpSys_mp "DSMRdy: Anzahl Fehlerprüfungen/gesperrt für den Rest des DC (Evaporative system)" UBYTE DSMRdy_OneToOne 1 100 0.00 255.0 FORMAT "%5.1" ECU_ADDRESS 0xC00089B6 /end MEASUREMENT
/begin MEASUREMENT DSMRdy_Ct.LockSecAirSys_mp "DSMRdy: Anzahl Fehlerprüfungen/gesperrt für den Rest des DC (Secondary air system)" UBYTE DSMRdy_OneToOne 1 100 0.00 255.0 FORMAT "%5.1" ECU_ADDRESS 0xC00089B7 /end MEASUREMENT
/begin MEASUREMENT DSMRdy_Ct.LockAC_mp "DSMRdy: Anzahl Fehlerprüfungen/gesperrt für den Rest des DC (A/C system refrigerant)" UBYTE DSMRdy_OneToOne 1 100 0.00 255.0 FORMAT "%5.1" ECU_ADDRESS 0xC00089B8 /end MEASUREMENT
/begin MEASUREMENT DSMRdy_Ct.LockO2Sens_mp "DSMRdy: Anzahl Fehlerprüfungen/gesperrt für den Rest des DC (Oxygen sensor)" UBYTE DSMRdy_OneToOne 1 100 0.00 255.0 FORMAT "%5.1" ECU_ADDRESS 0xC00089B9 /end MEASUREMENT
/begin MEASUREMENT DSMRdy_Ct.LockO2SensHt_mp "DSMRdy: Anzahl Fehlerprüfungen/gesperrt für den Rest des DC (Oxygen sensor heater)" UBYTE DSMRdy_OneToOne 1 100 0.00 255.0 FORMAT "%5.1" ECU_ADDRESS 0xC00089BA /end MEASUREMENT
/begin MEASUREMENT DSMRdy_Ct.LockEGR_mp "DSMRdy: Anzahl Fehlerprüfungen/gesperrt für den Rest des DC (EGR system)" UBYTE DSMRdy_OneToOne 1 100 0.00 255.0 FORMAT "%5.1" ECU_ADDRESS 0xC00089BB /end MEASUREMENT
/begin MEASUREMENT DSMRdy_Ct.SupMisf_mp "DSMRdy: Anzahl Fehlerprüfungen/unterstützt (Misfire)" UBYTE DSMRdy_OneToOne 1 100 0.00 255.0 FORMAT "%5.1" ECU_ADDRESS 0xC00089BC /end MEASUREMENT
/begin MEASUREMENT DSMRdy_Ct.SupFlSys_mp "DSMRdy: Anzahl Fehlerprüfungen/unterstützt (Fuel system)" UBYTE DSMRdy_OneToOne 1 100 0.00 255.0 FORMAT "%5.1" ECU_ADDRESS 0xC00089BD /end MEASUREMENT
/begin MEASUREMENT DSMRdy_Ct.SupComprCmpnt_mp "DSMRdy: Anzahl Fehlerprüfungen/unterstützt (Comprehensive component)" UBYTE DSMRdy_OneToOne 1 100 0.00 255.0 FORMAT "%5.1" ECU_ADDRESS 0xC00089BE /end MEASUREMENT
/begin MEASUREMENT DSMRdy_Ct.SupCat_mp "DSMRdy: Anzahl Fehlerprüfungen/unterstützt (Catalyst)" UBYTE DSMRdy_OneToOne 1 100 0.00 255.0 FORMAT "%5.1" ECU_ADDRESS 0xC00089BF /end MEASUREMENT
/begin MEASUREMENT DSMRdy_Ct.SupHtCat_mp "DSMRdy: Anzahl Fehlerprüfungen/unterstützt (Heated catalyst)" UBYTE DSMRdy_OneToOne 1 100 0.00 255.0 FORMAT "%5.1" ECU_ADDRESS 0xC00089C0 /end MEASUREMENT
/begin MEASUREMENT DSMRdy_Ct.SupEvpSys_mp "DSMRdy: Anzahl Fehlerprüfungen/unterstützt (Evaporative system)" UBYTE DSMRdy_OneToOne 1 100 0.00 255.0 FORMAT "%5.1" ECU_ADDRESS 0xC00089C1 /end MEASUREMENT
/begin MEASUREMENT DSMRdy_Ct.SupSecAirSys_mp "DSMRdy: Anzahl Fehlerprüfungen/unterstützt (Secondary air system)" UBYTE DSMRdy_OneToOne 1 100 0.00 255.0 FORMAT "%5.1" ECU_ADDRESS 0xC00089C2 /end MEASUREMENT
/begin MEASUREMENT DSMRdy_Ct.SupAC_mp "DSMRdy: Anzahl Fehlerprüfungen/unterstützt (A/C system refrigerant)" UBYTE DSMRdy_OneToOne 1 100 0.00 255.0 FORMAT "%5.1" ECU_ADDRESS 0xC00089C3 /end MEASUREMENT
/begin MEASUREMENT DSMRdy_Ct.SupO2Sens_mp "DSMRdy: Anzahl Fehlerprüfungen/unterstützt (Oxygen sensor)" UBYTE DSMRdy_OneToOne 1 100 0.00 255.0 FORMAT "%5.1" ECU_ADDRESS 0xC00089C4 /end MEASUREMENT
/begin MEASUREMENT DSMRdy_Ct.SupO2SensHt_mp "DSMRdy: Anzahl Fehlerprüfungen/unterstützt (Oxygen sensor heater)" UBYTE DSMRdy_OneToOne 1 100 0.00 255.0 FORMAT "%5.1" ECU_ADDRESS 0xC00089C5 /end MEASUREMENT
/begin MEASUREMENT DSMRdy_Ct.SupEGR_mp "DSMRdy: Anzahl Fehlerprüfungen/unterstützt (EGR system)" UBYTE DSMRdy_OneToOne 1 100 0.00 255.0 FORMAT "%5.1" ECU_ADDRESS 0xC00089C6 /end MEASUREMENT
/begin MEASUREMENT DSMRdy_stGrpAct "Readiness Berechnung, getestet Status" UWORD DSMRdy_OneToOne 1 100 0.00 65535.00 FORMAT "%8.2" ECU_ADDRESS 0xD0005698 /end MEASUREMENT
/begin MEASUREMENT DSMRdy_stGrpLock "Readiness Berechnung, gesperrt Status" UWORD DSMRdy_OneToOne 1 100 0.00 65535.00 FORMAT "%8.2" ECU_ADDRESS 0xD000569A /end MEASUREMENT
/begin MEASUREMENT DSMRdy_stGrpRdy "Readiness Berechnung, ready Status" UWORD DSMRdy_OneToOne 1 100 0.00 65535.00 FORMAT "%8.2" ECU_ADDRESS 0xD0009612 /end MEASUREMENT
/begin MEASUREMENT DSMRdy_stGrpRdyDFES "Readiness Berechnung, ready Status (aus Fehlerspeicherverwaltung)" UWORD DSMRdy_OneToOne 1 100 0.00 65535.00 FORMAT "%8.2" ECU_ADDRESS 0xD0005694 /end MEASUREMENT
/begin MEASUREMENT DSMRdy_stGrpRdyScan "Readiness Berechnung, getestet Status (aus DFC Status)" UWORD DSMRdy_OneToOne 1 100 0.00 65535.00 FORMAT "%8.2" ECU_ADDRESS 0xD0005692 /end MEASUREMENT
/begin MEASUREMENT DSMRdy_stGrpSup "Readiness Berechnung, supported Status" UWORD DSMRdy_OneToOne 1 100 0.00 65535.00 FORMAT "%8.2" ECU_ADDRESS 0xD0005696 /end MEASUREMENT
/begin MEASUREMENT DSMRdy_Why.RdyMisf_mp "Ursache (Name der Fehlerprüfung)/Misfire monitoring nicht ready" UWORD DFCDSQ_Verb 1 100 0.00 1213. FORMAT "%2.0" ECU_ADDRESS 0xD0006688 /end MEASUREMENT
/begin MEASUREMENT DSMRdy_Why.RdyFlSys_mp "Ursache (Name der Fehlerprüfung)/Fuel system monitoring nicht ready" UWORD DFCDSQ_Verb 1 100 0.00 1213. FORMAT "%2.0" ECU_ADDRESS 0xD000668A /end MEASUREMENT
/begin MEASUREMENT DSMRdy_Why.RdyComprCmpnt_mp "Ursache (Name der Fehlerprüfung)/Comprehensive component monitoring nicht ready" UWORD DFCDSQ_Verb 1 100 0.00 1213. FORMAT "%2.0" ECU_ADDRESS 0xD000668C /end MEASUREMENT
/begin MEASUREMENT DSMRdy_Why.RdyCat_mp "Ursache (Name der Fehlerprüfung)/Catalyst monitoring nicht ready" UWORD DFCDSQ_Verb 1 100 0.00 1213. FORMAT "%2.0" ECU_ADDRESS 0xD000668E /end MEASUREMENT
/begin MEASUREMENT DSMRdy_Why.RdyHtCat_mp "Ursache (Name der Fehlerprüfung)/Heated catalyst monitoring nicht ready" UWORD DFCDSQ_Verb 1 100 0.00 1213. FORMAT "%2.0" ECU_ADDRESS 0xD0006690 /end MEASUREMENT
/begin MEASUREMENT DSMRdy_Why.RdyEvpSys_mp "Ursache (Name der Fehlerprüfung)/Evaporative system monitoring nicht ready" UWORD DFCDSQ_Verb 1 100 0.00 1213. FORMAT "%2.0" ECU_ADDRESS 0xD0006692 /end MEASUREMENT
/begin MEASUREMENT DSMRdy_Why.RdySecAirSys_mp "Ursache (Name der Fehlerprüfung)/Secondary air system monitoring nicht ready" UWORD DFCDSQ_Verb 1 100 0.00 1213. FORMAT "%2.0" ECU_ADDRESS 0xD0006694 /end MEASUREMENT
/begin MEASUREMENT DSMRdy_Why.RdyAC_mp "Ursache (Name der Fehlerprüfung)/A/C system refrigerant monitoring nicht ready" UWORD DFCDSQ_Verb 1 100 0.00 1213. FORMAT "%2.0" ECU_ADDRESS 0xD0006696 /end MEASUREMENT
/begin MEASUREMENT DSMRdy_Why.RdyO2Sens_mp "Ursache (Name der Fehlerprüfung)/Oxygen sensor monitoring nicht ready" UWORD DFCDSQ_Verb 1 100 0.00 1213. FORMAT "%2.0" ECU_ADDRESS 0xD0006698 /end MEASUREMENT
/begin MEASUREMENT DSMRdy_Why.RdyO2SensHt_mp "Ursache (Name der Fehlerprüfung)/Oxygen sensor monitoring nicht ready" UWORD DFCDSQ_Verb 1 100 0.00 1213. FORMAT "%2.0" ECU_ADDRESS 0xD000669A /end MEASUREMENT
/begin MEASUREMENT DSMRdy_Why.RdyEGR_mp "Ursache (Name der Fehlerprüfung)/EGR system monitoring nicht ready" UWORD DFCDSQ_Verb 1 100 0.00 1213. FORMAT "%2.0" ECU_ADDRESS 0xD000669C /end MEASUREMENT
/begin MEASUREMENT DSMRdy_Why.CyclCmplMisf_mp "Ursache (Name der Fehlerprüfung)/Misfire monitoring nicht getestet im aktuellen DC" UWORD DFCDSQ_Verb 1 100 0.00 1213. FORMAT "%2.0" ECU_ADDRESS 0xD000669E /end MEASUREMENT
/begin MEASUREMENT DSMRdy_Why.CyclCmplFlSys_mp "Ursache (Name der Fehlerprüfung)/Fuel system monitoring nicht getestet im aktuellen DC" UWORD DFCDSQ_Verb 1 100 0.00 1213. FORMAT "%2.0" ECU_ADDRESS 0xD00066A0 /end MEASUREMENT
/begin MEASUREMENT DSMRdy_Why.CyclCmplComprCmpnt_mp "Ursache (Name der Fehlerprüfung)/Comprehensive component monitoring nicht getestet im aktuellen DC" UWORD DFCDSQ_Verb 1 100 0.00 1213. FORMAT "%2.0" ECU_ADDRESS 0xD00066A2 /end MEASUREMENT
/begin MEASUREMENT DSMRdy_Why.CyclCmplCat_mp "Ursache (Name der Fehlerprüfung)/Catalyst monitoring nicht getestet im aktuellen DC" UWORD DFCDSQ_Verb 1 100 0.00 1213. FORMAT "%2.0" ECU_ADDRESS 0xD00066A4 /end MEASUREMENT
/begin MEASUREMENT DSMRdy_Why.CyclCmplHtCat_mp "Ursache (Name der Fehlerprüfung)/Heated catalyst monitoring nicht getestet im aktuellen DC" UWORD DFCDSQ_Verb 1 100 0.00 1213. FORMAT "%2.0" ECU_ADDRESS 0xD00066A6 /end MEASUREMENT
/begin MEASUREMENT DSMRdy_Why.CyclCmplEvpSys_mp "Ursache (Name der Fehlerprüfung)/Evaporative system monitoring nicht getestet im aktuellen DC" UWORD DFCDSQ_Verb 1 100 0.00 1213. FORMAT "%2.0" ECU_ADDRESS 0xD00066A8 /end MEASUREMENT
/begin MEASUREMENT DSMRdy_Why.CyclCmplSecAirSys_mp "Ursache (Name der Fehlerprüfung)/Secondary air system monitoring nicht getestet im aktuellen DC" UWORD DFCDSQ_Verb 1 100 0.00 1213. FORMAT "%2.0" ECU_ADDRESS 0xD00066AA /end MEASUREMENT
/begin MEASUREMENT DSMRdy_Why.CyclCmplAC_mp "Ursache (Name der Fehlerprüfung)/A/C system refrigerant monitoring nicht getestet im aktuellen DC" UWORD DFCDSQ_Verb 1 100 0.00 1213. FORMAT "%2.0" ECU_ADDRESS 0xD00066AC /end MEASUREMENT
/begin MEASUREMENT DSMRdy_Why.CyclCmplO2Sens_mp "Ursache (Name der Fehlerprüfung)/Oxygen sensor monitoring nicht getestet im aktuellen DC" UWORD DFCDSQ_Verb 1 100 0.00 1213. FORMAT "%2.0" ECU_ADDRESS 0xD00066AE /end MEASUREMENT
/begin MEASUREMENT DSMRdy_Why.CyclCmplO2SensHt_mp "Ursache (Name der Fehlerprüfung)/Oxygen sensor heater monitoring nicht getestet im aktuellen DC" UWORD DFCDSQ_Verb 1 100 0.00 1213. FORMAT "%2.0" ECU_ADDRESS 0xD00066B0 /end MEASUREMENT
/begin MEASUREMENT DSMRdy_Why.CyclCmplEGR_mp "Ursache (Name der Fehlerprüfung)/EGR system monitoring nicht getestet im aktuellen DC" UWORD DFCDSQ_Verb 1 100 0.00 1213. FORMAT "%2.0" ECU_ADDRESS 0xD00066B2 /end MEASUREMENT
/begin MEASUREMENT DSMRdy_Why.LockMisf_mp "Ursache (Name der Fehlerprüfung)/Misfire monitoring gesperrt für den Rest des DC" UWORD DFCDSQ_Verb 1 100 0.00 1213. FORMAT "%2.0" ECU_ADDRESS 0xD00066B4 /end MEASUREMENT
/begin MEASUREMENT DSMRdy_Why.LockFlSys_mp "Ursache (Name der Fehlerprüfung)/Fuel system monitoring gesperrt für den Rest des DC" UWORD DFCDSQ_Verb 1 100 0.00 1213. FORMAT "%2.0" ECU_ADDRESS 0xD00066B6 /end MEASUREMENT
/begin MEASUREMENT DSMRdy_Why.LockComprCmpnt_mp "Ursache (Name der Fehlerprüfung)/Comprehensive component monitoring gesperrt für den Rest des DC" UWORD DFCDSQ_Verb 1 100 0.00 1213. FORMAT "%2.0" ECU_ADDRESS 0xD00066B8 /end MEASUREMENT
/begin MEASUREMENT DSMRdy_Why.LockCat_mp "Ursache (Name der Fehlerprüfung)/Catalyst monitoring gesperrt für den Rest des DC" UWORD DFCDSQ_Verb 1 100 0.00 1213. FORMAT "%2.0" ECU_ADDRESS 0xD00066BA /end MEASUREMENT
/begin MEASUREMENT DSMRdy_Why.LockHtCat_mp "Ursache (Name der Fehlerprüfung)/Heated catalyst monitoring gesperrt für den Rest des DC" UWORD DFCDSQ_Verb 1 100 0.00 1213. FORMAT "%2.0" ECU_ADDRESS 0xD00066BC /end MEASUREMENT
/begin MEASUREMENT DSMRdy_Why.LockEvpSys_mp "Ursache (Name der Fehlerprüfung)/Evaporative system monitoring gesperrt für den Rest des DC" UWORD DFCDSQ_Verb 1 100 0.00 1213. FORMAT "%2.0" ECU_ADDRESS 0xD00066BE /end MEASUREMENT
/begin MEASUREMENT DSMRdy_Why.LockSecAirSys_mp "Ursache (Name der Fehlerprüfung)/Secondary air system monitoring gesperrt für den Rest des DC" UWORD DFCDSQ_Verb 1 100 0.00 1213. FORMAT "%2.0" ECU_ADDRESS 0xD00066C0 /end MEASUREMENT
/begin MEASUREMENT DSMRdy_Why.LockAC_mp "Ursache (Name der Fehlerprüfung)/A/C system refrigerant monitoring gesperrt für den Rest des DC" UWORD DFCDSQ_Verb 1 100 0.00 1213. FORMAT "%2.0" ECU_ADDRESS 0xD00066C2 /end MEASUREMENT
/begin MEASUREMENT DSMRdy_Why.LockO2Sens_mp "Ursache (Name der Fehlerprüfung)/Oxygen sensor monitoring gesperrt für den Rest des DC" UWORD DFCDSQ_Verb 1 100 0.00 1213. FORMAT "%2.0" ECU_ADDRESS 0xD00066C4 /end MEASUREMENT
/begin MEASUREMENT DSMRdy_Why.LockO2SensHt_mp "Ursache (Name der Fehlerprüfung)/Oxygen sensor heater monitoring gesperrt für den Rest des DC" UWORD DFCDSQ_Verb 1 100 0.00 1213. FORMAT "%2.0" ECU_ADDRESS 0xD00066C6 /end MEASUREMENT
/begin MEASUREMENT DSMRdy_Why.LockEGR_mp "Ursache (Name der Fehlerprüfung)/EGR system monitoring gesperrt für den Rest des DC" UWORD DFCDSQ_Verb 1 100 0.00 1213. FORMAT "%2.0" ECU_ADDRESS 0xD00066C8 /end MEASUREMENT
/begin MEASUREMENT DSMRdy_Why_CyclCmplComprCmpnt_mp "" UWORD OneToOne 1 100 0.00 65535.00 ECU_ADDRESS 0xC0009C8E /end MEASUREMENT
/begin MEASUREMENT DSMRdy_Why_CyclCmplEGR_mp "" UWORD OneToOne 1 100 0.00 65535.00 ECU_ADDRESS 0xC0009C90 /end MEASUREMENT
/begin MEASUREMENT DSMRdy_Why_CyclCmplFlSys_mp "" UWORD OneToOne 1 100 0.00 65535.00 ECU_ADDRESS 0xC0009C92 /end MEASUREMENT
/begin MEASUREMENT DSMRdy_Why_RdyComprCmpnt_mp "" UWORD OneToOne 1 100 0.00 65535.00 ECU_ADDRESS 0xC0009C94 /end MEASUREMENT
/begin MEASUREMENT DSMRdy_Why_RdyEGR_mp "" UWORD OneToOne 1 100 0.00 65535.00 ECU_ADDRESS 0xC0009C96 /end MEASUREMENT
/begin MEASUREMENT DSMRdy_Why_RdyFlSys_mp "" UWORD OneToOne 1 100 0.00 65535.00 ECU_ADDRESS 0xC0009C98 /end MEASUREMENT
/begin MEASUREMENT DSMRdy_xPId1 "Readiness Berechnung, Ergebnis für PID01" ULONG DSMRdy_OneToOne 1 100 0.00 4294967295.00 FORMAT "%13.2" ECU_ADDRESS 0xC000305C /end MEASUREMENT
/begin MEASUREMENT DSMRdy_xPId41 "Readiness Berechnung, Ergebnis für PID41" ULONG DSMRdy_OneToOne 1 100 0.00 4294967295.00 FORMAT "%13.2" ECU_ADDRESS 0xD0009560 /end MEASUREMENT
/begin MEASUREMENT DSM_DisblMode_mp "aktuelle Abschaltbedingungen der Fehlerspeicherverwaltung (bereitgestellt durch DSM Konfiguration)" UWORD OneToOne 1 100 0.00 65535.00 ECU_ADDRESS 0xC0009C9A /end MEASUREMENT
/begin MEASUREMENT DSM_ECUId_mp "Steuergerätekennung (z.B. in Master/Slave Systemen), bereitgestellt durch DSM Konfiguration" UBYTE OneToOne 1 100 0.00 255.0 ECU_ADDRESS 0xC000B140 /end MEASUREMENT
/begin MEASUREMENT DSM_nEng_mp "Motordrehzahl (bereitgestellt durch DSM Konfiguration)" SWORD EngN 1 100 -16384.00 16383.50 ECU_ADDRESS 0xC0009C9C /end MEASUREMENT
/begin MEASUREMENT DSM_pEnv_mp "Umgebungsluftdruck (bereitgestellt durch DSM Konfiguration)" SWORD Pres_hPa 1 100 -32768.00 3500.00 ECU_ADDRESS 0xC0009C9E /end MEASUREMENT
/begin MEASUREMENT DSM_rAPP_mp "Fahrpedalwert (bereitgestellt durch DSM Konfiguration)" SWORD Prc 1 100 -400.0000 399.9878 ECU_ADDRESS 0xC0009CA0 /end MEASUREMENT
/begin MEASUREMENT DSM_stPostDrive "Status der DSM Nachlaufsteuerung" UBYTE OneToOne 1 100 0.00 255.0 ECU_ADDRESS 0xC0007D65 /end MEASUREMENT
/begin MEASUREMENT DSM_stReInit "Status der DSM Neuinitialisierung nach abgebrochenem Nachlauf" UBYTE OneToOne 1 100 0.00 255.0 ECU_ADDRESS 0xC0007D67 /end MEASUREMENT
/begin MEASUREMENT DSM_stStrEnd_mp "Motostart abgeschlossen (bereitgestellt durch DSM Konfiguration)" UBYTE OneToOne 1 100 0.00 255.0 ECU_ADDRESS 0xC000B141 /end MEASUREMENT
/begin MEASUREMENT DSM_stWiggle_mp "Anforderung ""wiggle test"" durch ext. Tester (bereitgestellt durch DSM Konfiguration)" UBYTE OneToOne 1 100 0.00 255.0 ECU_ADDRESS 0xC000B142 /end MEASUREMENT
/begin MEASUREMENT DSM_tEngDS_mp "Kühlwassertemperatur (bereitgestellt durch DSM Konfiguration)" SWORD Temp_Cels 1 100 -3549.940 3003.560 ECU_ADDRESS 0xC0009CA2 /end MEASUREMENT
/begin MEASUREMENT DSM_tEnv_mp "Umgebungslufttemperatur (bereitgestellt durch DSM Konfiguration)" SWORD Temp_Cels 1 100 -3549.940 3003.560 ECU_ADDRESS 0xC0009CA4 /end MEASUREMENT
/begin MEASUREMENT DSM_vVeh_mp "Fahrzeuggeschwindigkeit (bereitgestellt durch DSM Konfiguration)" SWORD Vel 1 100 -327.6800 327.6700 ECU_ADDRESS 0xC0009CA6 /end MEASUREMENT
/begin MEASUREMENT DStgy_dtTempFlt_mp "gefilteter Gradient der SCR-Temperatur" SWORD TempCels_100ms 1 100 -32768.00 32767.00 FORMAT "%8.2" ECU_ADDRESS 0xC0009CA8 /end MEASUREMENT
/begin MEASUREMENT DStgy_dtTempGradMax_mp "Schwellwert für den Temperaturgradienten" SWORD TempCels_100ms 1 100 -32768.00 32767.00 FORMAT "%8.2" ECU_ADDRESS 0xC0009CAA /end MEASUREMENT
/begin MEASUREMENT DStgy_stAdap "Freigabe für die NH3 Füllstandsadaption" UBYTE OneToOne 1 100 0.00 255.0 ECU_ADDRESS 0xD0001DD0 /end MEASUREMENT
/begin MEASUREMENT DStgy_stCondDos "Freigabestatus Dosierstrategie" UWORD OneToOne 1 100 0.00 65535.00 ECU_ADDRESS 0xD00015A4 /end MEASUREMENT
/begin MEASUREMENT DStgy_stMetStgy "Freigabe der Dosierung durch die Dosierstrategie" UBYTE OneToOne 1 100 0.00 255.0 ECU_ADDRESS 0xD0001DD1 /end MEASUREMENT
/begin MEASUREMENT DStgy_stTempGrad_mp "unentprellter Status der Dosierfreigabe ueber Temperaturgradientenbedingung" UBYTE OneToOne 1 100 0.00 255.0 ECU_ADDRESS 0xC000B143 /end MEASUREMENT
/begin MEASUREMENT DStgy_tAvrg_mp "Durchschnittstemperatur im SCR Katalysator" SWORD Temp_Cels 1 100 -3549.940 3003.560 ECU_ADDRESS 0xC0009CAC /end MEASUREMENT
/begin MEASUREMENT DStgy_vVehMin_mp "Schwellwert der Fahrzeuggeschwindigkeit für Dosierfreigabe" SWORD Vel 1 100 -327.6800 327.6700 ECU_ADDRESS 0xC0009CAE /end MEASUREMENT
/begin MEASUREMENT Oz_diagtoens "Töns Diagnose Byte" UWORD Def_dez_uw_q1 1 100 0.00 65535. FORMAT "%5.0" ECU_ADDRESS 0xC0009C8C /end MEASUREMENT
/begin MEASUREMENT Oz_permerrz "Fehler-Zähler Permittivität" UBYTE Def_dez_ub_q1 1 100 0.00 255. FORMAT "%3.0" ECU_ADDRESS 0xC000B13A /end MEASUREMENT
/begin MEASUREMENT Oz_tempplz "Anzahl der unplausibel Sprünge QLT Temperatur" UBYTE Def_dez_ub_q1 1 100 0.00 255. FORMAT "%3.0" ECU_ADDRESS 0xC000B13B /end MEASUREMENT
/begin MEASUREMENT Oz_temprold "Alte QLT Temperatur für die Plausibilisierung" UBYTE Def_dez_ub_q1 1 100 0.00 255. FORMAT "%3.0" ECU_ADDRESS 0xC000B13C /end MEASUREMENT
/begin MEASUREMENT St_dqlt0 "Statuswort" UBYTE Def_st_ub_q1 1 100 0.00 255. FORMAT "%3.0" ECU_ADDRESS 0xC000B13D /end MEASUREMENT
/begin MEASUREMENT St_dqlt1 "Statuswort" UBYTE Def_st_ub_q1 1 100 0.00 255. FORMAT "%3.0" ECU_ADDRESS 0xC000B13E /end MEASUREMENT
/begin MEASUREMENT St_oz_o "Statuswort" UBYTE Def_st_ub_q1 1 100 0.00 255. FORMAT "%3.0" ECU_ADDRESS 0xC000B13F /end MEASUREMENT
/begin FUNCTION DIUMPR ""
 /begin DEF_CHARACTERISTIC DIUMPR_Check_CA DIUMPR_ctGen.tiIgnMin_C DIUMPR_ctGen.tiActrMin_C DIUMPR_ctGen.l500MD_C DIUMPR_ctGen.tiVehSpdMin_C DIUMPR_ctGen.nIgnMin_C DIUMPR_ctGen.pEnvMin_C DIUMPR_ctGen.vVehMin_C DIUMPR_ctGen.rAPPMax_C DIUMPR_ctGen.vVehIdlMax_C DIUMPR_ctGen.tEnvMin_C DIUMPR_ctGen.tiIdlMin_C DIUMPR_ctGen.tiOpMin_C DIUMPR_ctGen.l500MDInc_C DIUMPR_ctRatioIdx_CA DIUMPR_FID_CA DIUMPR_Group_CA DIUMPR_numSigActv_CA DIUMPR_stSigActv_CA DIUMPR_valSigActvMax_CA DIUMPR_valSigActvMin_CA /end DEF_CHARACTERISTIC
 /begin LOC_MEASUREMENT DIUMPR_ctDenom DIUMPR_ctGenDenom DIUMPR_ctIgn DIUMPR_ctNum DIUMPR_numIndGrp DIUMPR_rMBGrp DIUMPR_rValRatMin DIUMPR_state DIUMPR_stEnaDenom DIUMPR_stFIdGenDenom_mp DIUMPR_tiEngOpCum DIUMPR_tiIdl DIUMPR_tiIgn DIUMPR_tiSigActv DIUMPR_tiVehSpdCum /end LOC_MEASUREMENT
/end FUNCTION
/begin FUNCTION Dma "" /end FUNCTION
/begin FUNCTION Dme "" /begin OUT_MEASUREMENT Dme_ctDataSetVariant Dme_numBytesAvailable /end OUT_MEASUREMENT /end FUNCTION
/begin FUNCTION dqlt ""
 /begin DEF_CHARACTERISTIC K_DTOG_UBMIN K_OZDELTOE K_OZDIAGNMOT K_OZDIAGNMOT2 K_OZDIAGSPG K_OZERRD K_OZHEAL K_OZPLTEMP K_OZPLZTEMP K_OZTEMPQERR K_OZZTEMP K_TOGMAXUNPL K_TOG_CNTMAX S_OZBSDKOORD /end DEF_CHARACTERISTIC
 /begin OUT_MEASUREMENT Oz_diagtoens Oz_permerrz Oz_tempplz Oz_temprold St_dqlt0 St_dqlt1 St_oz_o /end OUT_MEASUREMENT
/end FUNCTION
/begin FUNCTION DSCHED ""
 /begin DEF_CHARACTERISTIC DSCHED_BsPrio.FId_InhibitAlways_C DSCHED_BsPrio.FId_CoordALS_C DSCHED_BsPrio.FId_CoordFBC_C DSCHED_BsPrio.FId_CoordTAA_C DSCHED_BsPrio.FId_CoordZFC_C DSCHED_BsPrio.FId_IVPlausRunUpTstActv_C DSCHED_BsPrio.FId_RailHpTstActv_C DSCHED_DrvModeMsk.FId_InhibitAlways_C DSCHED_DrvModeMsk.FId_CoordALS_C DSCHED_DrvModeMsk.FId_CoordFBC_C DSCHED_DrvModeMsk.FId_CoordTAA_C DSCHED_DrvModeMsk.FId_CoordZFC_C DSCHED_DrvModeMsk.FId_IVPlausRunUpTstActv_C DSCHED_DrvModeMsk.FId_RailHpTstActv_C DSCHED_Excl.FId_InhibitAlways_CA DSCHED_Excl.FId_CoordALS_CA DSCHED_Excl.FId_CoordFBC_CA DSCHED_Excl.FId_CoordTAA_CA DSCHED_Excl.FId_CoordZFC_CA DSCHED_Excl.FId_IVPlausRunUpTstActv_CA DSCHED_Excl.FId_RailHpTstActv_CA DSCHED_FacPhys.FId_InhibitAlways_C DSCHED_FacPhys.FId_CoordALS_C DSCHED_FacPhys.FId_CoordFBC_C DSCHED_FacPhys.FId_CoordTAA_C DSCHED_FacPhys.FId_CoordZFC_C DSCHED_FacPhys.FId_IVPlausRunUpTstActv_C DSCHED_FacPhys.FId_RailHpTstActv_C DSCHED_JmpActvPrio.FId_InhibitAlways_C DSCHED_JmpActvPrio.FId_CoordALS_C DSCHED_JmpActvPrio.FId_CoordFBC_C DSCHED_JmpActvPrio.FId_CoordTAA_C DSCHED_JmpActvPrio.FId_CoordZFC_C DSCHED_JmpActvPrio.FId_IVPlausRunUpTstActv_C DSCHED_JmpActvPrio.FId_RailHpTstActv_C DSCHED_OpModeMsk.FId_InhibitAlways_C DSCHED_OpModeMsk.FId_CoordALS_C DSCHED_OpModeMsk.FId_CoordFBC_C DSCHED_OpModeMsk.FId_CoordTAA_C DSCHED_OpModeMsk.FId_CoordZFC_C DSCHED_OpModeMsk.FId_IVPlausRunUpTstActv_C DSCHED_OpModeMsk.FId_RailHpTstActv_C DSCHED_RmpIniPrio.FId_InhibitAlways_C DSCHED_RmpIniPrio.FId_CoordALS_C DSCHED_RmpIniPrio.FId_CoordFBC_C DSCHED_RmpIniPrio.FId_CoordTAA_C DSCHED_RmpIniPrio.FId_CoordZFC_C DSCHED_RmpIniPrio.FId_IVPlausRunUpTstActv_C DSCHED_RmpIniPrio.FId_RailHpTstActv_C DSCHED_RmpSlpActv.FId_InhibitAlways_C DSCHED_RmpSlpActv.FId_CoordALS_C DSCHED_RmpSlpActv.FId_CoordFBC_C DSCHED_RmpSlpActv.FId_CoordTAA_C DSCHED_RmpSlpActv.FId_CoordZFC_C DSCHED_RmpSlpActv.FId_IVPlausRunUpTstActv_C DSCHED_RmpSlpActv.FId_RailHpTstActv_C DSCHED_RmpSlpPas.FId_InhibitAlways_C DSCHED_RmpSlpPas.FId_CoordALS_C DSCHED_RmpSlpPas.FId_CoordFBC_C DSCHED_RmpSlpPas.FId_CoordTAA_C DSCHED_RmpSlpPas.FId_CoordZFC_C DSCHED_RmpSlpPas.FId_IVPlausRunUpTstActv_C DSCHED_RmpSlpPas.FId_RailHpTstActv_C DSCHED_RmpUpLim.FId_InhibitAlways_C DSCHED_RmpUpLim.FId_CoordALS_C DSCHED_RmpUpLim.FId_CoordFBC_C DSCHED_RmpUpLim.FId_CoordTAA_C DSCHED_RmpUpLim.FId_CoordZFC_C DSCHED_RmpUpLim.FId_IVPlausRunUpTstActv_C DSCHED_RmpUpLim.FId_RailHpTstActv_C DSCHED_stMode_C DSCHED_valDflOpMode_C DSCHED_valOfsPrioOpMode_C DSCHED_xSleepFId_CA /end DEF_CHARACTERISTIC
 /begin OUT_MEASUREMENT DSCHED_DynPrio.FId_Unused DSCHED_DynPrio.FId_InhibitAlways DSCHED_DynPrio.FId_CoordALS DSCHED_DynPrio.FId_CoordFBC DSCHED_DynPrio.FId_CoordTAA DSCHED_DynPrio.FId_CoordZFC DSCHED_DynPrio.FId_IVPlausRunUpTstActv DSCHED_DynPrio.FId_RailHpTstActv DSCHED_PhysPrio.FId_Unused DSCHED_PhysPrio.FId_InhibitAlways DSCHED_PhysPrio.FId_CoordALS DSCHED_PhysPrio.FId_CoordFBC DSCHED_PhysPrio.FId_CoordTAA DSCHED_PhysPrio.FId_CoordZFC DSCHED_PhysPrio.FId_IVPlausRunUpTstActv DSCHED_PhysPrio.FId_RailHpTstActv DSCHED_RmpPrio.FId_Unused DSCHED_RmpPrio.FId_InhibitAlways DSCHED_RmpPrio.FId_CoordALS DSCHED_RmpPrio.FId_CoordFBC DSCHED_RmpPrio.FId_CoordTAA DSCHED_RmpPrio.FId_CoordZFC DSCHED_RmpPrio.FId_IVPlausRunUpTstActv DSCHED_RmpPrio.FId_RailHpTstActv DSCHED_St.FId_Unused DSCHED_St.FId_InhibitAlways DSCHED_St.FId_CoordALS DSCHED_St.FId_CoordFBC DSCHED_St.FId_CoordTAA DSCHED_St.FId_CoordZFC DSCHED_St.FId_IVPlausRunUpTstActv DSCHED_St.FId_RailHpTstActv DSCHED_WhyExcl.FId_Unused DSCHED_WhyExcl.FId_InhibitAlways DSCHED_WhyExcl.FId_CoordALS DSCHED_WhyExcl.FId_CoordFBC DSCHED_WhyExcl.FId_CoordTAA DSCHED_WhyExcl.FId_CoordZFC DSCHED_WhyExcl.FId_IVPlausRunUpTstActv DSCHED_WhyExcl.FId_RailHpTstActv /end OUT_MEASUREMENT
/end FUNCTION
/begin FUNCTION DSM "" /begin IN_MEASUREMENT Epm_nEng SyC_stSub /end IN_MEASUREMENT
 /begin SUB_FUNCTION DDRC DFC DFES DFP DINH DSCHED DSMAux DSMDur DSMRdy DSQ DTR DIUMPR DSM_Conf /end SUB_FUNCTION
/end FUNCTION
/begin FUNCTION DSMAux ""
 /begin DEF_CHARACTERISTIC DSMAUX_dtWUCMin_C DSMAUX_tWUCMin_C DSMAUX_xClearMode_C DSMAUX_xClearTrg_C /end DEF_CHARACTERISTIC
 /begin IN_MEASUREMENT SyC_stSub /end IN_MEASUREMENT
 /begin OUT_MEASUREMENT DSMAUX_DTRG.DTRG_Time200ms DSMAUX_DTRG.DTRG_SimilarCondHLC DSMAUX_DTRG.DTRG_AlwaysTrue DSMAUX_DTRG.DTRG_DrivingCycleFLC DSMAUX_DTRG.DTRG_DrivingCycleHLC DSMAUX_DTRG.DTRG_NoTrigger DSMAUX_DTRG.DTRG_WarmUpCycle /end OUT_MEASUREMENT
 /begin LOC_MEASUREMENT DSMAUX_ctWUC DSMAUX_stStrtEnd DSMAUX_tClntStrt DSM_stPostDrive DSM_stReInit /end LOC_MEASUREMENT
/end FUNCTION
/begin FUNCTION DSMDur ""
 /begin DEF_CHARACTERISTIC DSMDur_valEvntQntDist_C DSMDur_valEvntQntTi_C DSMDur_xEnaDFES_CA DSMDur_xEnaGlb_CA DSMDur_xRstDFES_CA DSMDur_xRstGlb_CA DSMDur_xSelEvntDFES_CA DSMDur_xSelEvntGlb_CA /end DEF_CHARACTERISTIC
 /begin OUT_MEASUREMENT DSMDur_ctDFES0 DSMDur_ctDFES1 DSMDur_ctDFES2 DSMDur_ctGlb DSMDur_stGlb /end OUT_MEASUREMENT
/end FUNCTION
/begin FUNCTION DSMRdy ""
 /begin DEF_CHARACTERISTIC DSMRdy_Grp.Misf_CA DSMRdy_Grp.FlSys_CA DSMRdy_Grp.ComprCmpnt_CA DSMRdy_Grp.Cat_CA DSMRdy_Grp.HtCat_CA DSMRdy_Grp.EvpSys_CA DSMRdy_Grp.SecAirSys_CA DSMRdy_Grp.AC_CA DSMRdy_Grp.O2Sens_CA DSMRdy_Grp.O2SensHt_CA DSMRdy_Grp.EGR_CA DSMRdy_X.PID1ForceLowMsk_C DSMRdy_X.PID1ForceHighMsk_C DSMRdy_X.PID41ForceLowMsk_C DSMRdy_X.PID41ForceHighMsk_C DSMRdy_X.DFESSetMode_C /end DEF_CHARACTERISTIC
 /begin IN_MEASUREMENT DSM_DisblMode_mp DSM_ECUId_mp DSM_nEng_mp DSM_pEnv_mp DSM_rAPP_mp DSM_stStrEnd_mp DSM_stWiggle_mp DSM_tEngDS_mp DSM_tEnv_mp DSM_vVeh_mp /end IN_MEASUREMENT
 /begin OUT_MEASUREMENT DSMRdy_stGrpAct DSMRdy_stGrpLock DSMRdy_stGrpRdy DSMRdy_stGrpRdyDFES DSMRdy_stGrpRdyScan DSMRdy_stGrpSup DSMRdy_xPId1 DSMRdy_xPId41 /end OUT_MEASUREMENT
 /begin LOC_MEASUREMENT DSMRdy_Ct.RdyMisf_mp DSMRdy_Ct.RdyFlSys_mp DSMRdy_Ct.RdyComprCmpnt_mp DSMRdy_Ct.RdyCat_mp DSMRdy_Ct.RdyHtCat_mp DSMRdy_Ct.RdyEvpSys_mp DSMRdy_Ct.RdySecAirSys_mp DSMRdy_Ct.RdyAC_mp DSMRdy_Ct.RdyO2Sens_mp DSMRdy_Ct.RdyO2SensHt_mp DSMRdy_Ct.RdyEGR_mp DSMRdy_Ct.CyclCmplMisf_mp DSMRdy_Ct.CyclCmplFlSys_mp DSMRdy_Ct.CyclCmplComprCmpnt_mp DSMRdy_Ct.CyclCmplCat_mp DSMRdy_Ct.CyclCmplHtCat_mp DSMRdy_Ct.CyclCmplEvpSys_mp DSMRdy_Ct.CyclCmplSecAirSys_mp DSMRdy_Ct.CyclCmplAC_mp DSMRdy_Ct.CyclCmplO2Sens_mp DSMRdy_Ct.CyclCmplO2SensHt_mp DSMRdy_Ct.CyclCmplEGR_mp DSMRdy_Ct.LockMisf_mp DSMRdy_Ct.LockFlSys_mp DSMRdy_Ct.LockComprCmpnt_mp DSMRdy_Ct.LockCat_mp DSMRdy_Ct.LockHtCat_mp DSMRdy_Ct.LockEvpSys_mp DSMRdy_Ct.LockSecAirSys_mp DSMRdy_Ct.LockAC_mp DSMRdy_Ct.LockO2Sens_mp DSMRdy_Ct.LockO2SensHt_mp DSMRdy_Ct.LockEGR_mp DSMRdy_Ct.SupMisf_mp DSMRdy_Ct.SupFlSys_mp DSMRdy_Ct.SupComprCmpnt_mp DSMRdy_Ct.SupCat_mp DSMRdy_Ct.SupHtCat_mp DSMRdy_Ct.SupEvpSys_mp DSMRdy_Ct.SupSecAirSys_mp DSMRdy_Ct.SupAC_mp DSMRdy_Ct.SupO2Sens_mp DSMRdy_Ct.SupO2SensHt_mp DSMRdy_Ct.SupEGR_mp DSMRdy_Why.RdyMisf_mp DSMRdy_Why.RdyFlSys_mp DSMRdy_Why.RdyComprCmpnt_mp DSMRdy_Why.RdyCat_mp DSMRdy_Why.RdyHtCat_mp DSMRdy_Why.RdyEvpSys_mp DSMRdy_Why.RdySecAirSys_mp DSMRdy_Why.RdyAC_mp DSMRdy_Why.RdyO2Sens_mp DSMRdy_Why.RdyO2SensHt_mp DSMRdy_Why.RdyEGR_mp DSMRdy_Why.CyclCmplMisf_mp DSMRdy_Why.CyclCmplFlSys_mp DSMRdy_Why.CyclCmplComprCmpnt_mp DSMRdy_Why.CyclCmplCat_mp DSMRdy_Why.CyclCmplHtCat_mp DSMRdy_Why.CyclCmplEvpSys_mp DSMRdy_Why.CyclCmplSecAirSys_mp DSMRdy_Why.CyclCmplAC_mp DSMRdy_Why.CyclCmplO2Sens_mp DSMRdy_Why.CyclCmplO2SensHt_mp DSMRdy_Why.CyclCmplEGR_mp DSMRdy_Why.LockMisf_mp DSMRdy_Why.LockFlSys_mp DSMRdy_Why.LockComprCmpnt_mp DSMRdy_Why.LockCat_mp DSMRdy_Why.LockHtCat_mp DSMRdy_Why.LockEvpSys_mp DSMRdy_Why.LockSecAirSys_mp DSMRdy_Why.LockAC_mp DSMRdy_Why.LockO2Sens_mp DSMRdy_Why.LockO2SensHt_mp DSMRdy_Why.LockEGR_mp DSMRdy_Why_CyclCmplComprCmpnt_mp DSMRdy_Why_CyclCmplEGR_mp DSMRdy_Why_CyclCmplFlSys_mp DSMRdy_Why_RdyComprCmpnt_mp DSMRdy_Why_RdyEGR_mp DSMRdy_Why_RdyFlSys_mp /end LOC_MEASUREMENT
/end FUNCTION
/begin FUNCTION DSM_Conf "" /begin DEF_CHARACTERISTIC DSM_tiDlyStandBy_C /end DEF_CHARACTERISTIC
 /begin IN_MEASUREMENT APP_r CEngDsT_t CoEng_st CoEOM_stDSCHEDDem CoEOM_stOpModeActTSync CoEOM_stOpModePos CoEOM_stTransActv EngDa_tiEngOn EnvP_p EnvT_t Epm_nEng GlbDa_lTotDst PthSet_stOvrRunCoord VehV_v /end IN_MEASUREMENT
 /begin LOC_MEASUREMENT DSM_DisblMode_mp DSM_ECUId_mp DSM_nEng_mp DSM_pEnv_mp DSM_rAPP_mp DSM_stStrEnd_mp DSM_stWiggle_mp DSM_tEngDS_mp DSM_tEnv_mp DSM_vVeh_mp /end LOC_MEASUREMENT
/end FUNCTION
/begin FUNCTION DsplECU ""
 /begin SUB_FUNCTION DsplECU_can DsplECU_co DsplECU_swt DsplECU_fa DsplECU_a DsplECU_flex /end SUB_FUNCTION
/end FUNCTION
/begin FUNCTION DsplECU_a "" /begin DEF_CHARACTERISTIC Com_swtMileageRange_A_C /end DEF_CHARACTERISTIC /end FUNCTION
/begin FUNCTION DsplECU_can ""
 /begin DEF_CHARACTERISTIC Com_swtMileageRange_C Com_swtStKombi_C Com_swtTempRelTime_C Com_swtTimeDate_C /end DEF_CHARACTERISTIC
/end FUNCTION
/begin FUNCTION DsplECU_co ""
 /begin OUT_MEASUREMENT Com_ctrDay Com_ctrSec Com_dDay Com_dMonth Com_dStKombiCTR Com_dYear Com_lSum Com_stCrCtlKombi Com_stLmpPrkBrk Com_stSeason Com_stUnVel Com_tEnvT Com_vDspl /end OUT_MEASUREMENT
 /begin LOC_MEASUREMENT Com_lSumRaw /end LOC_MEASUREMENT
/end FUNCTION
/begin FUNCTION DsplECU_fa ""
 /begin DEF_CHARACTERISTIC Com_swtATemp_FA_C Com_swtMileageRange_FA_C Com_swtRelTime_FA_C Com_swtSecCtrRel_FA_C Com_swtTimeDate_FA_C /end DEF_CHARACTERISTIC
 /begin OUT_MEASUREMENT Com_ctrDay_FA Com_ctrSecAbs_FA Com_ctrSec_FA Com_dDay_FA Com_dMonth_FA Com_dYear_FA Com_lFlTnkQntLow_FA Com_lSum_FA Com_stFlTnkQntRes_FA Com_stSeason_FA Com_tEnvT_FA Com_volFlTnkQntLH_FA Com_volFlTnkQntRH_FA Com_volFlTnkQnt_FA /end OUT_MEASUREMENT
/end FUNCTION
/begin FUNCTION DsplECU_flex "" /begin DEF_CHARACTERISTIC Com_tiSysTimeOk_C Com_tiSysTimeOut_C /end DEF_CHARACTERISTIC /begin IN_MEASUREMENT FuelLvl_vol /end IN_MEASUREMENT
 /begin LOC_MEASUREMENT Com_ctrSecAbs Com_ctrSecInt Com_lFlTnkQntLow Com_stFlTnkQntRes Com_stSysTime Com_volFlTnkQnt Com_volFlTnkQntLH Com_volFlTnkQntRH /end LOC_MEASUREMENT
/end FUNCTION
/begin FUNCTION DsplECU_fx "" /begin DEF_CHARACTERISTIC Com_swtATemp_FX_C /end DEF_CHARACTERISTIC /begin OUT_MEASUREMENT Com_tEnvT_FX /end OUT_MEASUREMENT /end FUNCTION
/begin FUNCTION DsplECU_swt ""
 /begin IN_MEASUREMENT Com_ctrDay Com_ctrDay_FA Com_ctrSec Com_ctrSecAbs Com_ctrSecAbs_FA Com_ctrSec_FA Com_dDay Com_dDay_FA Com_dMonth Com_dMonth_FA Com_dYear Com_dYear_FA Com_lFlTnkQntLow Com_lFlTnkQntLow_FA Com_lSum Com_lSum_FA Com_stFlTnkQntRes Com_stFlTnkQntRes_FA Com_stSeason Com_stSeason_FA Com_tEnvT Com_tEnvT_FA Com_tEnvT_FX Com_volFlTnkQnt Com_volFlTnkQntLH Com_volFlTnkQntLH_FA Com_volFlTnkQntRH Com_volFlTnkQntRH_FA Com_volFlTnkQnt_FA /end IN_MEASUREMENT
/end FUNCTION
/begin FUNCTION DSQ "" /end FUNCTION
/begin FUNCTION DStgy ""
 /begin SUB_FUNCTION SCRFFC SCRLdG SCRMod SCRAd SCRT SCRChk DStgy_Mon DStgy_Main DStgy_QntIfc /end SUB_FUNCTION
/end FUNCTION
/begin FUNCTION DStgy_Main ""
 /begin DEF_CHARACTERISTIC DStgy_numPosOxiTDs_C DStgy_numPosOxi_C DStgy_numPosPFltDs_C DStgy_numPosSCRTUs_C DStgy_numPosSCRUs_C DStgy_numPosStoich_C DStgy_numPosWallTUs_C /end DEF_CHARACTERISTIC
/end FUNCTION
/begin FUNCTION DStgy_Mon ""
 /begin DEF_CHARACTERISTIC DStgy_dtTempGradMax_CUR DStgy_numTempFldGrad_C DStgy_stEnaMsk_C DStgy_stMskMetStgy_C DStgy_swtAdapEna_C DStgy_swtMetEna_C DStgy_tAvrgHi_C DStgy_tAvrgLo_C DStgy_TempGrad.T1_C DStgy_TempGrad.Kd_C DStgy_TempGradDeb.tiHiLo_C DStgy_TempGradDeb.tiLoHi_C DStgy_tiDosRlsMin_C DStgy_tPFltDsHi_C DStgy_tPFltDsLo_C DStgy_tUCatDsHi_C DStgy_tUCatDsLo_C DStgy_tUCatUsHi_C DStgy_tUCatUsLo_C DStgy_tWallUCatUsHiLim_C DStgy_tWallUCatUsLoLim_C DStgy_uBattHi_C DStgy_uBattLo_C DStgy_vVehMin_CUR /end DEF_CHARACTERISTIC
 /begin IN_MEASUREMENT ASMod_tWallFld BattU_u CoEng_tiNormal CoEOM_stOpModeActTSync Exh_tPFltDs SCRAd_stSlip SCRCtl_stMetMod SCRT_tFld SCRT_tUCatDsT SCR_tUCatUsT VehV_v /end IN_MEASUREMENT
 /begin OUT_MEASUREMENT DStgy_stAdap DStgy_stCondDos DStgy_stMetStgy /end OUT_MEASUREMENT
 /begin LOC_MEASUREMENT DStgy_dtTempFlt_mp DStgy_dtTempGradMax_mp DStgy_stTempGrad_mp DStgy_tAvrg_mp DStgy_vVehMin_mp /end LOC_MEASUREMENT
/end FUNCTION
/begin COMPU_METHOD Def_dez_ub_q1 "" RAT_FUNC "%3.1" "-" COEFFS 0 1 0 0 0 1 /end COMPU_METHOD
/begin COMPU_METHOD Def_dez_uw_q1 "" RAT_FUNC "%5.2" "-" COEFFS 0 1 0 0 0 1 /end COMPU_METHOD
/begin COMPU_METHOD Def_n_sw_q1p0 "" RAT_FUNC "%5.2" "Upm" COEFFS 0 1 0 0 0 1 /end COMPU_METHOD
/begin COMPU_METHOD Def_st_ub_q1 "" RAT_FUNC "%3.1" "-" COEFFS 0 1 0 0 0 1 /end COMPU_METHOD
/begin COMPU_METHOD Def_td_uw_q0p01 "" RAT_FUNC "%7.5" "s" COEFFS 0 100 0 0 0 1 /end COMPU_METHOD
/begin COMPU_METHOD Def_t_sw_q0p1 "" RAT_FUNC "%6.3" "°C" COEFFS 0 10 0 0 0 1 /end COMPU_METHOD
/begin COMPU_METHOD Def_u_uw_q0p0942 "" RAT_FUNC "%6.3" "V" COEFFS 0 10.6157112526539 0 0 0 1 /end COMPU_METHOD
/begin COMPU_METHOD DFCDSQ_Verb "" TAB_VERB "%2.1" "-" COMPU_TAB_REF DFCDSQ_Verb /end COMPU_METHOD
/begin COMPU_VTAB DFCDSQ_Verb "" TAB_VERB 1214 0 "NoInhibit" 1 "DFC_ACCIPlausDrvAst" 2 "DFC_ACCIPlausTrqDes" 3 "DFC_AirCtlGovDvtEOMMax" 4 "DFC_AirCtlGovDvtEOMMin" 5 "DFC_AirCtlGovDvtMax" 6 "DFC_AirCtlGovDvtMin" 7 "DFC_AirCtlGovLPDvtMax" 8 "DFC_AirCtlGovLPDvtMin" 9 "DFC_AltIOComErr" 10 "DFC_AltIOComNpl" 11 "DFC_BusDiagBusOffFlexRay" 12 "DFC_BusDiagBusOffNodeA" 13 "DFC_BusDiagBusOffNodeB" 14 "DFC_BusDiagBusOffNodeC" 15 "DFC_BusDiagHwFlexRay" 16 "DFC_Cj945SpiCom1" 17 "DFC_ComACDemandSig_FA" 18 "DFC_ComACDemandTo_FA" 19 "DFC_ComATempSig_FA" 20 "DFC_ComATempTo_FA" 21 "DFC_ComATempTo_FX" 22 "DFC_ComBrkTrqSumChk_FX" 23 "DFC_ComBrkTrqSumCtr_FX" 24 "DFC_ComBrkTrqSumTo_FX" 25 "DFC_ComBtnDrvDynChk_FX" 26 "DFC_ComBtnDrvDynCtr_FX" 27 "DFC_ComBtnDrvDynTo_FX" 28 "DFC_ComButtonMSASig" 29 "DFC_ComButtonMSATo" 30 "DFC_ComCodierungPwrmngSig" 31 "DFC_ComCodierungPwrmngSig_FA" 32 "DFC_ComCrCtlLvrChk" 33 "DFC_ComCrCtlLvrCtr" 34 "DFC_ComCrCtlLvrSig" 35 "DFC_ComCrCtlLvrTo" 36 "DFC_ComCtrCrshSwoEkpSig_FA" 37 "DFC_ComCtrCrshSwoEkpTo_FA" 38 "DFC_ComCtrSecInt" 39 "DFC_ComDiaOBDGbxSig_A" 40 "DFC_ComDiaOBDGbxTo_A" 41 "DFC_ComFahrzeugtypSig" 42 "DFC_ComFahrzeugtypSig_FA" 43 "DFC_ComFllupGpwsupSig_FA" 44 "DFC_ComFllupGpwsupTo_FA" 45 "DFC_ComGbxDataChk_A" 46 "DFC_ComGbxDataChk_FA" 47 "DFC_ComGbxDataCtr_A" 48 "DFC_ComGbxDataCtr_FA" 49 "DFC_ComGbxDataSig_A" 50 "DFC_ComGbxDataSig_FA" 51 "DFC_ComGbxDataTo_A" 52 "DFC_ComGbxDataTo_FA" 53 "DFC_ComKlemmenChk_FA" 54 "DFC_ComKlemmenCtr_FA" 55 "DFC_ComKlemmenSig_FA" 56 "DFC_ComKlemmenTo_FA" 57 "DFC_ComLenkradwinkelSig" 58 "DFC_ComLenkradwinkelTo" 59 "DFC_ComMileageRangeSig_FA" 60 "DFC_ComMileageRangeTo_FA" 61 "DFC_ComPspSig" 62 "DFC_ComPspTo" 63 "DFC_ComRelTimeSig_FA" 64 "DFC_ComRelTimeTo_FA" 65 "DFC_ComRequestEMFChk" 66 "DFC_ComRequestEMFCtr" 67 "DFC_ComRequestEMFSig" 68 "DFC_ComRequestEMFTo" 69 "DFC_ComRpmWhlChk_FX" 70 "DFC_ComRpmWhlCtr_FX" 71 "DFC_ComRpmWhlTo_FX" 72 "DFC_ComSecCtrRelSig_FA" 73 "DFC_ComSecCtrRelTo_FA" 74 "DFC_ComSensNOxGndSig" 75 "DFC_ComSensNOxGndTo" 76 "DFC_ComSensNOxMode" 77 "DFC_ComSensNOxUbattSig" 78 "DFC_ComSensNOxUbattTo" 79 "DFC_ComShiftPaddleTo_FX" 80 "DFC_ComShutOffPSPSig" 81 "DFC_ComShutOffPSPTo" 82 "DFC_ComSlrdiGlbFZMTo_FA" 83 "DFC_ComSlrdiGlbFZMTo_FX" 84 "DFC_ComSpeedVehicleChk_FX" 85 "DFC_ComSpeedVehicleCtr_FX" 86 "DFC_ComSpeedVehicleTo_FX" 87 "DFC_ComStConintDSCChk_FX" 88 "DFC_ComStConintDSCCtr_FX" 89 "DFC_ComStConintDSCTo_FX" 90 "DFC_ComStatACFrontSig_FA" 91 "DFC_ComStatACFrontTo_FA" 92 "DFC_ComStatEkpSig_A" 93 "DFC_ComStatEkpTo_A" 94 "DFC_ComStatGearRevSig_FA" 95 "DFC_ComStatGearRevTo_FA" 96 "DFC_ComStatZVKlappenSig_FA" 97 "DFC_ComStatZVKlappenTo_FA" 98 "DFC_ComStateARSCtr" 99 "DFC_ComStateARSSig" 100 "DFC_ComStateARSTo" 101 "DFC_ComStateDscSig" 102 "DFC_ComStateDscTo" 103 "DFC_ComStateSeatSig" 104 "DFC_ComStateSeatSig_FA" 105 "DFC_ComStateSeatTo" 106 "DFC_ComStateSeatTo_FA" 107 "DFC_ComStatusEGSSig_A" 108 "DFC_ComStatusEGSSig_FA" 109 "DFC_ComStatusEGSTo_A" 110 "DFC_ComStatusEGSTo_FA" 111 "DFC_ComStatusEMFChk" 112 "DFC_ComStatusEMFCtr" 113 "DFC_ComStatusEMFSig" 114 "DFC_ComStatusEMFTo" 115 "DFC_ComStatusRGangSig" 116 "DFC_ComStatusRGangTo" 117 "DFC_ComSteeringAngleChk_FX" 118 "DFC_ComSteeringAngleCtr_FX" 119 "DFC_ComSteeringAngleTo_FX" 120 "DFC_ComTerminalChk" 121 "DFC_ComTerminalCtr" 122 "DFC_ComTerminalSig" 123 "DFC_ComTerminalTo" 124 "DFC_ComTimeDateSig_FA" 125 "DFC_ComTimeDateTo_FA" 126 "DFC_ComTrailerSig" 127 "DFC_ComTrailerSig_FA" 128 "DFC_ComTrailerTo" 129 "DFC_ComTrailerTo_FA" 130 "DFC_ComTrqDemCrshDrDyChk_FX" 131 "DFC_ComTrqDemCrshDrDyCtr_FX" 132 "DFC_ComTrqDemCrshDrDyTo_FX" 133 "DFC_ComTrqDemandDesSig" 134 "DFC_ComTrqDemandDesTo" 135 "DFC_ComTrqDemandDscChk" 136 "DFC_ComTrqDemandDscCtr" 137 "DFC_ComTrqDemandDscSig" 138 "DFC_ComTrqDemandDscTo" 139 "DFC_ComTrqDemandGbxChk_A" 140 "DFC_ComTrqDemandGbxChk_FA" 141 "DFC_ComTrqDemandGbxCtr_A" 142 "DFC_ComTrqDemandGbxCtr_FA" 143 "DFC_ComTrqDemandGbxSig_A" 144 "DFC_ComTrqDemandGbxSig_FA" 145 "DFC_ComTrqDemandGbxTo_A" 146 "DFC_ComTrqDemandGbxTo_FA" 147 "DFC_ComTrqWhlDemChk" 148 "DFC_ComTrqWhlDemCtr" 149 "DFC_ComTrqWhlDemFASChk_FX" 150 "DFC_ComTrqWhlDemFASCtr_FX" 151 "DFC_ComTrqWhlDemFASTo_FX" 152 "DFC_ComTrqWhlDemSig" 153 "DFC_ComTrqWhlDemTo" 154 "DFC_ComVelocityChk_FA" 155 "DFC_ComVelocityCtr_FA" 156 "DFC_ComVelocitySig" 157 "DFC_ComVelocitySig_FA" 158 "DFC_ComVelocityTo" 159 "DFC_ComVelocityTo_FA" 160 "DFC_ComVerbraucherTo" 161 "DFC_ComWMomPTStabChk_FX" 162 "DFC_ComWMomPTStabCtr_FX" 163 "DFC_ComWMomPTStabTo_FX" 164 "DFC_ComWheelSpeedSig" 165 "DFC_ComWheelSpeedTo" 166 "DFC_ComZvKlappenSig" 167 "DFC_ComZvKlappenTo" 168 "DFC_ComaDirectChk_FX" 169 "DFC_ComaDirectCtr_FX" 170 "DFC_ComaDirectTo_FX" 171 "DFC_ComaSideChk_FX" 172 "DFC_ComaSideCtr_FX" 173 "DFC_ComaSideTo_FX" 174 "DFC_Cy320SpiCom" 175 "DFC_ETCtlDvtInrMax" 176 "DFC_ETCtlDvtInrMin" 177 "DFC_ETCtlDvtOutrMax" 178 "DFC_ETCtlDvtOutrMin" 179 "DFC_FBCqDvtMax" 180 "DFC_FBCqDvtMin" 181 "DFC_Fan4WinErr1" 182 "DFC_Fan4WinErr2" 183 "DFC_Fan4WinErr3" 184 "DFC_Fan4WinErr4" 185 "DFC_FanSCG" 186 "DFC_FlFCBS" 187 "DFC_GlwEcuConfigErr" 188 "DFC_GlwEcuEepErr" 189 "DFC_GlwEcuFrmErr" 190 "DFC_GlwEcuGPCMFaultInfo" 191 "DFC_GlwEcuGPCMInfo" 192 "DFC_GlwEcuGk1HSS" 193 "DFC_GlwEcuGk1OL" 194 "DFC_GlwEcuGk1SC" 195 "DFC_GlwEcuGk1Wdst" 196 "DFC_GlwEcuGk2HSS" 197 "DFC_GlwEcuGk2OL" 198 "DFC_GlwEcuGk2SC" 199 "DFC_GlwEcuGk2Wdst" 200 "DFC_GlwEcuGk3HSS" 201 "DFC_GlwEcuGk3OL" 202 "DFC_GlwEcuGk3SC" 203 "DFC_GlwEcuGk3Wdst" 204 "DFC_GlwEcuGk4HSS" 205 "DFC_GlwEcuGk4OL" 206 "DFC_GlwEcuGk4SC" 207 "DFC_GlwEcuGk4Wdst" 208 "DFC_GlwEcuGk5HSS" 209 "DFC_GlwEcuGk5OL" 210 "DFC_GlwEcuGk5SC" 211 "DFC_GlwEcuGk5Wdst" 212 "DFC_GlwEcuGk6HSS" 213 "DFC_GlwEcuGk6OL" 214 "DFC_GlwEcuGk6SC" 215 "DFC_GlwEcuGk6Wdst" 216 "DFC_GlwEcuGndErr" 217 "DFC_GlwEcuIntErr" 218 "DFC_GlwEcuMsgTimeout" 219 "DFC_GlwEcuT30Err" 220 "DFC_GlwEcuTempErr" 221 "DFC_GlwEcuUdiffT30" 222 "DFC_IBSComErr" 223 "DFC_LubSRCOilFldtCrit" 224 "DFC_LubSRCOilFldtCritDflMin" 225 "DFC_LubSRCOilLvlCritMax" 226 "DFC_LubSRCOilLvlCritMin" 227 "DFC_LubSRCTot" 228 "DFC_MonUMaxSupply1" 229 "DFC_MonUMinSupply1" 230 "DFC_OilComNpl" 231 "DFC_PCBS" 232 "DFC_PCBSPFltChg" 233 "DFC_PCRGovDvtLPMax" 234 "DFC_PCRGovDvtLPMin" 235 "DFC_PCRGovDvtMax" 236 "DFC_PCRGovDvtMin" 237 "DFC_PFltAPSPlausMAX" 238 "DFC_PFltAPSPlausMIN" 239 "DFC_PFltBPSPlausMAX" 240 "DFC_PFltBPSPlausMIN" 241 "DFC_PFltOvldInhRgn" 242 "DFC_PFltOvldTrqLim" 243 "DFC_PFltPresPlausMAX" 244 "DFC_PFltPresPlausMIN" 245 "DFC_PFltTraRpmRdc" 246 "DFC_PFlt_tOxiPreMax" 247 "DFC_PFlt_tOxiPreMaxRgn" 248 "DFC_PFlt_tOxiPreNpl" 249 "DFC_PFlt_tPreMax" 250 "DFC_PFlt_tPreMaxRgn" 251 "DFC_PFlt_tPreNpl" 252 "DFC_PFltmSotDiffMAX" 253 "DFC_PFltmSotDiffMIN" 254 "DFC_PFltmSotDiffSIG" 255 "DFC_PIntkVUsEnvPPls" 256 "DFC_PresPlausDblDef" 257 "DFC_RailCPC1" 258 "DFC_RailCPC3" 259 "DFC_RailCPC4" 260 "DFC_RailMeUn0" 261 "DFC_RailMeUn1" 262 "DFC_RailMeUn2" 263 "DFC_RailMeUn22" 264 "DFC_RailMeUn3" 265 "DFC_RailMeUn4" 266 "DFC_RailMeUn42" 267 "DFC_RailMeUn5" 268 "DFC_RailPCV0" 269 "DFC_RailPCV1" 270 "DFC_RailPCV2" 271 "DFC_RailPCV22" 272 "DFC_RailPCV3" 273 "DFC_RailPCV4" 274 "DFC_RailPCV42" 275 "DFC_RailPMonStrt" 276 "DFC_SSpMon1" 277 "DFC_SSpMon2" 278 "DFC_SSpMon3" 279 "DFC_ThrVlv4WinErr1" 280 "DFC_ThrVlv4WinErr2" 281 "DFC_ThrVlv4WinErr3" 282 "DFC_ThrVlv4WinErr4" 283 "DFC_ThrVlvSCG" 284 "DFC_Tle6232Spi1" 285 "DFC_TrbCh4WinErr1" 286 "DFC_TrbCh4WinErr2" 287 "DFC_TrbCh4WinErr3" 288 "DFC_TrbCh4WinErr4" 289 "DFC_TrbChSCG" 290 "DFC_TrbChSRCMax" 291 "DFC_TrbChSRCMin" 292 "DFC_WaHtEl4WinErr1" 293 "DFC_WaHtEl4WinErr2" 294 "DFC_WaHtEl4WinErr3" 295 "DFC_WaHtEl4WinErr4" 296 "DFC_WaHtElSCG" 297 "DFC_ETClbETFltMax_0" 298 "DFC_ETClbETFltMax_1" 299 "DFC_ETClbETFltMax_2" 300 "DFC_ETClbETFltMax_3" 301 "DFC_ETClbETFltMax_4" 302 "DFC_ETClbETFltMax_5" 303 "DFC_ETClbETFltMin_0" 304 "DFC_ETClbETFltMin_1" 305 "DFC_ETClbETFltMin_2" 306 "DFC_ETClbETFltMin_3" 307 "DFC_ETClbETFltMin_4" 308 "DFC_ETClbETFltMin_5" 309 "DFC_InjCrvInjLimChrgBal" 310 "DFC_InjCrvInjLimQntBal" 311 "DFC_InjCrvInjLimSys" 312 "DFC_InjCrvNumInjRtmLim" 313 "DFC_LSUHtCoupSig" 314 "DFC_AFS_SSpShOffOL" 315 "DFC_AFS_SSpShOffOvrTemp" 316 "DFC_AFS_SSpShOffSCB" 317 "DFC_AFS_SSpShOffSCG" 318 "DFC_AirCCmprOL" 319 "DFC_AirCCmprOvrTemp" 320 "DFC_AirCCmprSCB" 321 "DFC_AirCCmprSCG" 322 "DFC_CByVlvOL" 323 "DFC_CByVlvOvrTemp" 324 "DFC_CByVlvSCB" 325 "DFC_CByVlvSCG" 326 "DFC_CThmstOL" 327 "DFC_CThmstOvrTemp" 328 "DFC_CThmstSCB" 329 "DFC_CThmstSCG" 330 "DFC_DSMDummy" 331 "DFC_EBxFanOL" 332 "DFC_EBxFanOvrTemp" 333 "DFC_EBxFanSCB" 334 "DFC_EBxFanSCG" 335 "DFC_ECBVlvOL" 336 "DFC_ECBVlvOvrTemp" 337 "DFC_ECBVlvSCB" 338 "DFC_ECBVlvSCG" 339 "DFC_EMDmpOL_0" 340 "DFC_EMDmpOL_1" 341 "DFC_EMDmpOvrTemp_0" 342 "DFC_EMDmpOvrTemp_1" 343 "DFC_EMDmpSCB_0" 344 "DFC_EMDmpSCB_1" 345 "DFC_EMDmpSCG_0" 346 "DFC_EMDmpSCG_1" 347 "DFC_EngStAOL" 348 "DFC_EngStAOvrTemp" 349 "DFC_EngStASCB" 350 "DFC_EngStASCG" 351 "DFC_FanOL" 352 "DFC_FanOvrTemp" 353 "DFC_FanSCB" 354 "DFC_FlFltHtOL" 355 "DFC_FlFltHtOvrTemp" 356 "DFC_FlFltHtSCB" 357 "DFC_FlFltHtSCG" 358 "DFC_LSUHtrMax" 359 "DFC_LSUHtrMin" 360 "DFC_LSUHtrNpl" 361 "DFC_LSUHtrSig" 362 "DFC_LSUtExcMax" 363 "DFC_LSUtExcMin" 364 "DFC_MeUnOL" 365 "DFC_MeUnSCB" 366 "DFC_MeUnSRCMax" 367 "DFC_MeUnSRCMin" 368 "DFC_PCVOL" 369 "DFC_PCVSCB" 370 "DFC_PCVSRCMax" 371 "DFC_PCVSRCMin" 372 "DFC_RailPSRCMax" 373 "DFC_RailPSRCMin" 374 "DFC_ShtrOL" 375 "DFC_ShtrOvrTemp" 376 "DFC_ShtrSCB" 377 "DFC_ShtrSCG" 378 "DFC_StrtOL" 379 "DFC_StrtOvrTemp" 380 "DFC_StrtSCB" 381 "DFC_StrtSCG" 382 "DFC_ThrVlvOL" 383 "DFC_ThrVlvOvrTemp" 384 "DFC_ThrVlvSCB" 385 "DFC_TrbChOL" 386 "DFC_TrbChOvrTemp" 387 "DFC_TrbChSCB" 388 "DFC_UDosVlvOL" 389 "DFC_UDosVlvOvrTemp" 390 "DFC_UDosVlvSCB" 391 "DFC_UDosVlvSCG" 392 "DFC_UPmpMotOL" 393 "DFC_UPmpMotOvrTemp" 394 "DFC_UPmpMotSCB" 395 "DFC_UPmpMotSCG" 396 "DFC_WaHtElOL" 397 "DFC_WaHtElOvrTemp" 398 "DFC_WaHtElSCB" 399 "DFC_IVActrUChSRCMax" 400 "DFC_IVActrUChSRCMin" 401 "DFC_IVActrVltgSRCMax" 402 "DFC_IVActrVltgSRCMin" 403 "DFC_IVDiaTunDet" 404 "DFC_IVPSplyStopDCDC" 405 "DFC_IVPSplyVltgSRCMax" 406 "DFC_IVPSplyVltgSRCMin" 407 "DFC_SCREtaErr" 408 "DFC_SCREtaErr1" 409 "DFC_SCREtaErr2" 410 "DFC_SCRMonMetCtlPresErr" 411 "DFC_SCRMonPresBuildUpErr" 412 "DFC_SCRMonPresRdcErr" 413 "DFC_AFSOffsDrftMax" 414 "DFC_AFSOffsDrftMin" 415 "DFC_AFSSRCCorMax" 416 "DFC_AFSSRCCorMin" 417 "DFC_AFSSRCRawMax" 418 "DFC_AFSSRCRawMin" 419 "DFC_AFSSetyDrftMax" 420 "DFC_AFSSetyDrftMin" 421 "DFC_AirCSwtNpl" 422 "DFC_AirCSwtSig" 423 "DFC_BattUSRCMax" 424 "DFC_BattUSRCMin" 425 "DFC_BrkNpl" 426 "DFC_BrkPSRCMax" 427 "DFC_BrkPSRCMin" 428 "DFC_CEngDsTSRCMax" 429 "DFC_CEngDsTSRCMin" 430 "DFC_CrCUIDet" 431 "DFC_ECBVlvSRCMax" 432 "DFC_ECBVlvSRCMin" 433 "DFC_ECUOvrTemp" 434 "DFC_EGRVlvGovDvtMax" 435 "DFC_EGRVlvGovDvtMin" 436 "DFC_EGRVlvHBrgOpnLd" 437 "DFC_EGRVlvHBrgOvrCurr" 438 "DFC_EGRVlvHBrgOvrTemp" 439 "DFC_EGRVlvHBrgShCirBatt1" 440 "DFC_EGRVlvHBrgShCirBatt2" 441 "DFC_EGRVlvHBrgShCirGnd1" 442 "DFC_EGRVlvHBrgShCirGnd2" 443 "DFC_EGRVlvHBrgShCirOvrLd" 444 "DFC_EGRVlvHBrgTempOvrCurr" 445 "DFC_EGRVlvHBrgUndrVltg" 446 "DFC_EGRVlvLPGovDvtMax" 447 "DFC_EGRVlvLPGovDvtMin" 448 "DFC_EGRVlvLPHBrgOpnLd" 449 "DFC_EGRVlvLPHBrgOvrCurr" 450 "DFC_EGRVlvLPHBrgOvrTemp" 451 "DFC_EGRVlvLPHBrgShCirBatt1" 452 "DFC_EGRVlvLPHBrgShCirBatt2" 453 "DFC_EGRVlvLPHBrgShCirGnd1" 454 "DFC_EGRVlvLPHBrgShCirGnd2" 455 "DFC_EGRVlvLPHBrgShCirOvrLd" 456 "DFC_EGRVlvLPHBrgTempOvrCurr" 457 "DFC_EGRVlvLPHBrgUndrVltg" 458 "DFC_EGRVlvLPOL" 459 "DFC_EGRVlvLPSCB" 460 "DFC_EGRVlvLPSCG" 461 "DFC_EGRVlvLPSRCMax" 462 "DFC_EGRVlvLPSRCMin" 463 "DFC_EGRVlvOL" 464 "DFC_EGRVlvSCB" 465 "DFC_EGRVlvSCG" 466 "DFC_EGRVlvSRCMax" 467 "DFC_EGRVlvSRCMin" 468 "DFC_EngPrtOvrSpd" 469 "DFC_EngSpdOL" 470 "DFC_EngSpdSCB" 471 "DFC_EngSpdSCG" 472 "DFC_EnhSRCMaxPPFltDiff" 473 "DFC_EnhSRCMaxT1ExhTMon" 474 "DFC_EnhSRCMaxT2ExhTMon" 475 "DFC_EnhSRCMaxT3ExhTMon" 476 "DFC_EnhSRCMinPPFltDiff" 477 "DFC_EnhSRCMinT1ExhTMon" 478 "DFC_EnhSRCMinT2ExhTMon" 479 "DFC_EnhSRCMinT3ExhTMon" 480 "DFC_EnvPSRCMax" 481 "DFC_EnvPSRCMin" 482 "DFC_ExhTMonPlaus" 483 "DFC_ExhTMonPlausPos1" 484 "DFC_ExhTMonPlausPos2" 485 "DFC_ExhTMonPlausPos3" 486 "DFC_ExhTMonT1Plaus" 487 "DFC_ExhTMonT2Plaus" 488 "DFC_ExhTMonT3Plaus" 489 "DFC_FlFltDsPSRCMax" 490 "DFC_FlFltDsPSRCMin" 491 "DFC_FlFltSig" 492 "DFC_FlFltUsPSRCMax" 493 "DFC_FlFltUsPSRCMin" 494 "DFC_FuelTSRCMax" 495 "DFC_FuelTSRCMin" 496 "DFC_GbxNPosPPerSRCMax" 497 "DFC_GbxNPosPPerSRCMin" 498 "DFC_GbxNPosPdcycSRCMax" 499 "DFC_GbxNPosPdcycSRCMin" 500 "DFC_InjVlvPresMin" 501 "DFC_LSUCircNernstSig" 502 "DFC_LSUCircPmpCurSig" 503 "DFC_LSUCircVirtGndSig" 504 "DFC_LSUO2Max" 505 "DFC_LSUO2Min" 506 "DFC_LSUSPIBattLowMin" 507 "DFC_LSUWireSCB" 508 "DFC_LSUWireSCG" 509 "DFC_MeUnSCG" 510 "DFC_NSCDsCmpChk" 511 "DFC_NSCDsLamBinSRCMax" 512 "DFC_NSCDsLamBinSRCMin" 513 "DFC_NSCDsLamLinSRCMax" 514 "DFC_NSCDsLamLinSRCMin" 515 "DFC_NSCDsLamPlausMax" 516 "DFC_NSCDsLamPlausMin" 517 "DFC_NSCDsNOxSRCMax" 518 "DFC_NSCDsNOxSRCMin" 519 "DFC_NSCDsOpCir" 520 "DFC_NSCDsShCir" 521 "DFC_NoCat2DsCmpChk" 522 "DFC_NoCat2DsLamBinSRCMax" 523 "DFC_NoCat2DsLamBinSRCMin" 524 "DFC_NoCat2DsLamLinSRCMax" 525 "DFC_NoCat2DsLamLinSRCMin" 526 "DFC_NoCat2DsLamPlausMax" 527 "DFC_NoCat2DsLamPlausMin" 528 "DFC_NoCat2DsNOxSRCMax" 529 "DFC_NoCat2DsNOxSRCMin" 530 "DFC_NoCat2DsOpCir" 531 "DFC_NoCat2DsShCir" 532 "DFC_NplDynPPFltDiff" 533 "DFC_NplHsChngPPFltDiff" 534 "DFC_NplHsLnPPFltDiff" 535 "DFC_NplTOxiCatUs" 536 "DFC_NplTPFltUs" 537 "DFC_NplTTrbnUs" 538 "DFC_OilPSwmpSRCMax" 539 "DFC_OilPSwmpSRCMin" 540 "DFC_PCVSCG" 541 "DFC_PFltCharPDiffMin" 542 "DFC_PFltDstrMin" 543 "DFC_PFltEngPrt" 544 "DFC_PFltRgnPerm" 545 "DFC_PFltSRCMaxFlwRstn" 546 "DFC_PFltSRCMinFlwRstn" 547 "DFC_PFltSotMsDvtMax" 548 "DFC_PFltSotMsDvtMin" 549 "DFC_PFltSotMsMax" 550 "DFC_PIntkVUsSRCMax" 551 "DFC_PIntkVUsSRCMin" 552 "DFC_SRCHighAPP1" 553 "DFC_SRCHighAPP2" 554 "DFC_SRCLowAPP1" 555 "DFC_SRCLowAPP2" 556 "DFC_SRCMaxPPFltDiff" 557 "DFC_SRCMaxPPFltUs" 558 "DFC_SRCMaxTECU" 559 "DFC_SRCMaxTOxiCatUs" 560 "DFC_SRCMaxTPFltUs" 561 "DFC_SRCMaxTTrbnUs" 562 "DFC_SRCMaxUCatUsT" 563 "DFC_SRCMaxUPmpP" 564 "DFC_SRCMinPPFltDiff" 565 "DFC_SRCMinPPFltUs" 566 "DFC_SRCMinTECU" 567 "DFC_SRCMinTOxiCatUs" 568 "DFC_SRCMinTPFltUs" 569 "DFC_SRCMinTTrbnUs" 570 "DFC_SRCMinUCatUsT" 571 "DFC_SRCMinUPmpP" 572 "DFC_SigUCatUsT" 573 "DFC_SigUPmpP" 574 "DFC_SyncAPP" 575 "DFC_T15Npl" 576 "DFC_TAFSDtyCycHi" 577 "DFC_TAFSDtyCycLo" 578 "DFC_TAFSPerHi" 579 "DFC_TAFSPerLo" 580 "DFC_TCACDsSRCMax" 581 "DFC_TCACDsSRCMin" 582 "DFC_ThrVlvSRCMax" 583 "DFC_ThrVlvSRCMin" 584 "DFC_TrbChLPOL" 585 "DFC_TrbChLPSCB" 586 "DFC_TrbChLPSCG" 587 "DFC_UHtrPLOL" 588 "DFC_UHtrPLSCB" 589 "DFC_UHtrPLSCG" 590 "DFC_UHtrPLSRCMaxDia" 591 "DFC_UHtrPLSRCMinDia" 592 "DFC_UHtrTnkOL" 593 "DFC_UHtrTnkSCB" 594 "DFC_UHtrTnkSCG" 595 "DFC_UHtrTnkSRCMaxDia" 596 "DFC_UHtrTnkSRCMinDia" 597 "DFC_URevVlvOL" 598 "DFC_URevVlvSCB" 599 "DFC_URevVlvSCG" 600 "DFC_UTnkTSRCMax" 601 "DFC_UTnkTSRCMin" 602 "DFC_UTnkTSig" 603 "DFC_VSwVlvGovDvtMax" 604 "DFC_VSwVlvGovDvtMin" 605 "DFC_VSwVlvHBrgOpnLd" 606 "DFC_VSwVlvHBrgOvrCurr" 607 "DFC_VSwVlvHBrgOvrTemp" 608 "DFC_VSwVlvHBrgShCirBatt1" 609 "DFC_VSwVlvHBrgShCirBatt2" 610 "DFC_VSwVlvHBrgShCirGnd1" 611 "DFC_VSwVlvHBrgShCirGnd2" 612 "DFC_VSwVlvHBrgShCirOvrLd" 613 "DFC_VSwVlvHBrgTempOvrCurr" 614 "DFC_VSwVlvHBrgUndrVltg" 615 "DFC_VSwVlvOL" 616 "DFC_VSwVlvSCB" 617 "DFC_VSwVlvSCG" 618 "DFC_VSwVlvSRCMax" 619 "DFC_VSwVlvSRCMin" 620 "DFC_ClthNpl" 621 "DFC_ETClbETMax_0" 622 "DFC_ETClbETMax_1" 623 "DFC_ETClbETMax_2" 624 "DFC_ETClbETMax_3" 625 "DFC_ETClbETMax_4" 626 "DFC_ETClbETMax_5" 627 "DFC_ETClbETMin_0" 628 "DFC_ETClbETMin_1" 629 "DFC_ETClbETMin_2" 630 "DFC_ETClbETMin_3" 631 "DFC_ETClbETMin_4" 632 "DFC_ETClbETMin_5" 633 "DFC_IVActrEnrgMax_0" 634 "DFC_IVActrEnrgMax_1" 635 "DFC_IVActrEnrgMax_2" 636 "DFC_IVActrEnrgMax_3" 637 "DFC_IVActrEnrgMax_4" 638 "DFC_IVActrEnrgMax_5" 639 "DFC_IVActrEnrgMax_6" 640 "DFC_IVActrEnrgMax_7" 641 "DFC_IVActrEnrgMin_0" 642 "DFC_IVActrEnrgMin_1" 643 "DFC_IVActrEnrgMin_2" 644 "DFC_IVActrEnrgMin_3" 645 "DFC_IVActrEnrgMin_4" 646 "DFC_IVActrEnrgMin_5" 647 "DFC_IVActrEnrgMin_6" 648 "DFC_IVActrEnrgMin_7" 649 "DFC_IVActrEnrgPlaus_0" 650 "DFC_IVActrEnrgPlaus_1" 651 "DFC_IVActrEnrgPlaus_2" 652 "DFC_IVActrEnrgPlaus_3" 653 "DFC_IVActrEnrgPlaus_4" 654 "DFC_IVActrEnrgPlaus_5" 655 "DFC_IVActrEnrgPlaus_6" 656 "DFC_IVActrEnrgPlaus_7" 657 "DFC_IVCtlTiDiff_0" 658 "DFC_IVCtlTiDiff_1" 659 "DFC_IVCtlTiDiff_2" 660 "DFC_IVCtlTiDiff_3" 661 "DFC_IVCtlTiDiff_4" 662 "DFC_IVCtlTiDiff_5" 663 "DFC_IVCtlUDiffUp_0" 664 "DFC_IVCtlUDiffUp_1" 665 "DFC_IVCtlUDiffUp_2" 666 "DFC_IVCtlUDiffUp_3" 667 "DFC_IVCtlUDiffUp_4" 668 "DFC_IVCtlUDiffUp_5" 669 "DFC_IVCtlUUp_0" 670 "DFC_IVCtlUUp_1" 671 "DFC_IVCtlUUp_2" 672 "DFC_IVCtlUUp_3" 673 "DFC_IVCtlUUp_4" 674 "DFC_IVCtlUUp_5" 675 "DFC_IVDiaBnkShCir_0" 676 "DFC_IVDiaBnkShCir_1" 677 "DFC_IVDiaBnkShCirChSwt_0" 678 "DFC_IVDiaBnkShCirChSwt_1" 679 "DFC_IVDiaChp_0" 680 "DFC_IVDiaChp_1" 681 "DFC_IVDiaCylNoCls_0" 682 "DFC_IVDiaCylNoCls_1" 683 "DFC_IVDiaCylNoCls_2" 684 "DFC_IVDiaCylNoCls_3" 685 "DFC_IVDiaCylNoCls_4" 686 "DFC_IVDiaCylNoCls_5" 687 "DFC_IVDiaCylNoLd_0" 688 "DFC_IVDiaCylNoLd_1" 689 "DFC_IVDiaCylNoLd_2" 690 "DFC_IVDiaCylNoLd_3" 691 "DFC_IVDiaCylNoLd_4" 692 "DFC_IVDiaCylNoLd_5" 693 "DFC_IVDiaCylShCir_0" 694 "DFC_IVDiaCylShCir_1" 695 "DFC_IVDiaCylShCir_2" 696 "DFC_IVDiaCylShCir_3" 697 "DFC_IVDiaCylShCir_4" 698 "DFC_IVDiaCylShCir_5" 699 "DFC_IVDiaCylShCirHSLS_0" 700 "DFC_IVDiaCylShCirHSLS_1" 701 "DFC_IVDiaCylShCirHSLS_2" 702 "DFC_IVDiaCylShCirHSLS_3" 703 "DFC_IVDiaCylShCirHSLS_4" 704 "DFC_IVDiaCylShCirHSLS_5" 705 "DFC_IVDiaCylShCirMeas_0" 706 "DFC_IVDiaCylShCirMeas_1" 707 "DFC_IVDiaCylShCirMeas_2" 708 "DFC_IVDiaCylShCirMeas_3" 709 "DFC_IVDiaCylShCirMeas_4" 710 "DFC_IVDiaCylShCirMeas_5" 711 "DFC_LSUDynChk" 712 "DFC_LSUO2ClbMax" 713 "DFC_LSUO2ClbMin" 714 "DFC_LSUO2PlausMaxFLd" 715 "DFC_LSUO2PlausMaxOvrRun" 716 "DFC_LSUO2PlausMaxPartLd" 717 "DFC_LSUO2PlausMinFLd" 718 "DFC_LSUO2PlausMinOvrRun" 719 "DFC_LSUO2PlausMinPartLd" 720 "DFC_LSURiClbMax" 721 "DFC_LSURiClbMin" 722 "DFC_LSUWireIPSig" 723 "DFC_Layer_BSDMax" 724 "DFC_Layer_BSDMin" 725 "DFC_Layer_BSDNpl" 726 "DFC_Layer_BSDSig" 727 "DFC_Layer_FltMngTstMax" 728 "DFC_Layer_FltMngTstMin" 729 "DFC_Layer_FltMngTstNpl" 730 "DFC_Layer_FltMngTstSig" 731 "DFC_Layer_GENELBMax" 732 "DFC_Layer_GENELBMin" 733 "DFC_Layer_GENELBNpl" 734 "DFC_Layer_GENELBSig" 735 "DFC_Layer_GENELMax" 736 "DFC_Layer_GENELMin" 737 "DFC_Layer_GENELNpl" 738 "DFC_Layer_GENELSig" 739 "DFC_Layer_GENHTBMax" 740 "DFC_Layer_GENHTBMin" 741 "DFC_Layer_GENHTBNpl" 742 "DFC_Layer_GENHTBSig" 743 "DFC_Layer_GENHTMax" 744 "DFC_Layer_GENHTMin" 745 "DFC_Layer_GENHTNpl" 746 "DFC_Layer_GENHTSig" 747 "DFC_Layer_GENKOMMMax" 748 "DFC_Layer_GENKOMMMin" 749 "DFC_Layer_GENKOMMNpl" 750 "DFC_Layer_GENKOMMSig" 751 "DFC_Layer_GENMECHMax" 752 "DFC_Layer_GENMECHMin" 753 "DFC_Layer_GENMECHNpl" 754 "DFC_Layer_GENMECHSig" 755 "DFC_Layer_GENMax" 756 "DFC_Layer_GENMin" 757 "DFC_Layer_GENNpl" 758 "DFC_Layer_GENREGUPLMax" 759 "DFC_Layer_GENREGUPLMin" 760 "DFC_Layer_GENREGUPLNpl" 761 "DFC_Layer_GENREGUPLSig" 762 "DFC_Layer_GENSig" 763 "DFC_Layer_GENUPLMax" 764 "DFC_Layer_GENUPLMin" 765 "DFC_Layer_GENUPLNpl" 766 "DFC_Layer_GENUPLSig" 767 "DFC_Layer_IBS1Max" 768 "DFC_Layer_IBS1Min" 769 "DFC_Layer_IBS1Npl" 770 "DFC_Layer_IBS1Sig" 771 "DFC_Layer_IBS2Max" 772 "DFC_Layer_IBS2Min" 773 "DFC_Layer_IBS2Npl" 774 "DFC_Layer_IBS2Sig" 775 "DFC_Layer_IBS3Max" 776 "DFC_Layer_IBS3Min" 777 "DFC_Layer_IBS3Npl" 778 "DFC_Layer_IBS3Sig" 779 "DFC_Layer_MANDETEKMax" 780 "DFC_Layer_MANDETEKMin" 781 "DFC_Layer_MANDETEKNpl" 782 "DFC_Layer_MANDETEKSig" 783 "DFC_Layer_NDR1Max" 784 "DFC_Layer_NDR1Min" 785 "DFC_Layer_NDR1Npl" 786 "DFC_Layer_NDR1Sig" 787 "DFC_Layer_NDR2Max" 788 "DFC_Layer_NDR2Min" 789 "DFC_Layer_NDR2Npl" 790 "DFC_Layer_NDR2Sig" 791 "DFC_Layer_NGLERNMax" 792 "DFC_Layer_NGLERNMin" 793 "DFC_Layer_NGLERNNpl" 794 "DFC_Layer_NGLERNSig" 795 "DFC_Layer_PMBATTMax" 796 "DFC_Layer_PMBATTMin" 797 "DFC_Layer_PMBATTNpl" 798 "DFC_Layer_PMBATTSig" 799 "DFC_Layer_PMBNMax" 800 "DFC_Layer_PMBNMin" 801 "DFC_Layer_PMBNNpl" 802 "DFC_Layer_PMBNSig" 803 "DFC_Layer_PMRUHVERLMax" 804 "DFC_Layer_PMRUHVERLMin" 805 "DFC_Layer_PMRUHVERLNpl" 806 "DFC_Layer_PMRUHVERLSig" 807 "DFC_Layer_QLTMax" 808 "DFC_Layer_QLTMin" 809 "DFC_Layer_QLTNpl" 810 "DFC_Layer_QLTSig" 811 "DFC_Layer_TOENSMax" 812 "DFC_Layer_TOENSMin" 813 "DFC_Layer_TOENSNpl" 814 "DFC_Layer_TOENSSig" 815 "DFC_MonLimCurr" 816 "DFC_MonLimLead" 817 "DFC_MonLimSet" 818 "DFC_NSCDsNOxOfsMax" 819 "DFC_NSCDsNOxOfsMin" 820 "DFC_NSCDsNOxPlausMin" 821 "DFC_NoCat2DsNOxOfsMax" 822 "DFC_NoCat2DsNOxOfsMin" 823 "DFC_NoCat2DsNOxPlausMin" 824 "DFC_PCVNoStrt" 825 "DFC_RailPGradMon" 826 "DFC_SCRPODPresBuildUp" 827 "DFC_AFSDrftIdlAdjVal" 828 "DFC_AFSDrftLdAdjVal" 829 "DFC_AdcIADC0Cal" 830 "DFC_AdcIADC0Conv" 831 "DFC_AdcIADC1Cal" 832 "DFC_AdcIADC1Conv" 833 "DFC_CmbChbMisfireMax_0" 834 "DFC_CmbChbMisfireMax_1" 835 "DFC_CmbChbMisfireMax_2" 836 "DFC_CmbChbMisfireMax_3" 837 "DFC_CmbChbMisfireMax_4" 838 "DFC_CmbChbMisfireMax_5" 839 "DFC_CmbChbMisfireMul" 840 "DFC_EGRVlvLPOfsNeutr" 841 "DFC_EGRVlvOfsNeutr" 842 "DFC_FMAErrModMax" 843 "DFC_FMAErrModMin" 844 "DFC_FlSysTnkLo" 845 "DFC_GbxNPosPlaus" 846 "DFC_I14229_ROETst_Appl" 847 "DFC_I14229_ROETst_Netw" 848 "DFC_I14229_ROE_BufFull" 849 "DFC_IVAdjDiaIVAdj" 850 "DFC_IVAdjIVA_0" 851 "DFC_IVAdjIVA_1" 852 "DFC_IVAdjIVA_2" 853 "DFC_IVAdjIVA_3" 854 "DFC_IVAdjIVA_4" 855 "DFC_IVAdjIVA_5" 856 "DFC_IVPSplyDCDCOff_0" 857 "DFC_IVPSplyDCDCOff_1" 858 "DFC_IVPSplyDCDCOff_2" 859 "DFC_IVPSplyDCDCOff_3" 860 "DFC_InjCtlAdjQntEEPCS" 861 "DFC_LSUSPISig" 862 "DFC_Layer_Dummy" 863 "DFC_NplEnvPSensPPFltDiff" 864 "DFC_NplPresSensPPFltDiff" 865 "DFC_OilLvlPlaus" 866 "DFC_OilTOutLvl" 867 "DFC_PCVfacAdaptMax" 868 "DFC_PCVfacAdaptMin" 869 "DFC_SensFrzPPFltUs" 870 "DFC_SensMonUTnkLvl" 871 "DFC_T15Sig" 872 "DFC_AirCtlRmpTOut" 873 "DFC_BrkPPlaus" 874 "DFC_CEngDsTDynTst" 875 "DFC_EEPEraseErr" 876 "DFC_EEPRdErr" 877 "DFC_EEPWrErr" 878 "DFC_EGRVlvJamVlvClsd" 879 "DFC_EGRVlvJamVlvOpn" 880 "DFC_EGRVlvLPJamVlvClsd" 881 "DFC_EGRVlvLPJamVlvOpn" 882 "DFC_EGRVlvLPLgTDrft" 883 "DFC_EGRVlvLPOfsLrnJamVlv" 884 "DFC_EGRVlvLPShTDrft" 885 "DFC_EGRVlvLgTDrft" 886 "DFC_EGRVlvOfsLrnJamVlv" 887 "DFC_EGRVlvShTDrft" 888 "DFC_EngICO" 889 "DFC_EpmCaSI1ErrSig" 890 "DFC_EpmCaSI1NoSig" 891 "DFC_EpmCaSI1OfsErr" 892 "DFC_EpmCrSErrSig" 893 "DFC_EpmCrSNoSig" 894 "DFC_IVPlausComprTst" 895 "DFC_IVPlausRunUpTst" 896 "DFC_InjCrvShOffTst" 897 "DFC_LayerEnSavModProd" 898 "DFC_LayerEnSavModRep" 899 "DFC_LayerEnSavModShip" 900 "DFC_MRlyErlyOpng" 901 "DFC_MRlyStk" 902 "DFC_MeUnActrTst" 903 "DFC_MoCADCCmp" 904 "DFC_MoCADCTst" 905 "DFC_MoCADCVltgRatio" 906 "DFC_MoCComErrCnt" 907 "DFC_MoCComSPI" 908 "DFC_MoCROMErrXPg" 909 "DFC_MoCSOPHwNoRdy" 910 "DFC_MoCSOPLoLi" 911 "DFC_MoCSOPMM" 912 "DFC_MoCSOPTimeOut" 913 "DFC_MoCSOPUpLi" 914 "DFC_MoFAPP" 915 "DFC_MoFESpd" 916 "DFC_MoFInjDatPhi" 917 "DFC_MoFInjDatQnt" 918 "DFC_MoFInjQnt" 919 "DFC_MoFMode1PoI1" 920 "DFC_MoFMode1PoI2" 921 "DFC_MoFMode2PoI1" 922 "DFC_MoFMode2PoI2" 923 "DFC_MoFOvR" 924 "DFC_MoFQntCor" 925 "DFC_MoFRailP" 926 "DFC_MoFTrqCmp" 927 "DFC_NSCDsHtrSetP" 928 "DFC_NoCat2DsHtrSetP" 929 "DFC_PCVActrTst" 930 "DFC_PhyModNonMonMapNpl" 931 "DFC_RailHpTst" 932 "DFC_RailPOfsTstMax" 933 "DFC_RailPOfsTstMin" 934 "DFC_SIA_E1max" 935 "DFC_SIA_E1min" 936 "DFC_SIA_E1npl" 937 "DFC_SIA_E1sig" 938 "DFC_SIA_E2max" 939 "DFC_SIA_E2min" 940 "DFC_SIA_E2npl" 941 "DFC_SIA_E2sig" 942 "DFC_SIA_E3max" 943 "DFC_SIA_E3min" 944 "DFC_SIA_E3npl" 945 "DFC_SIA_E3sig" 946 "DFC_SIA_E4max" 947 "DFC_SIA_E4min" 948 "DFC_SIA_E4npl" 949 "DFC_SIA_E4sig" 950 "DFC_SWReset_0" 951 "DFC_SWReset_1" 952 "DFC_SWReset_2" 953 "DFC_ShtrAKKMax" 954 "DFC_ShtrAKKMin" 955 "DFC_ShtrAKKNpl" 956 "DFC_ShtrPKKMax" 957 "DFC_StopCntTmr" 958 "DFC_ThrVlvMon" 959 "DFC_VSwVlvJamVlv" 960 "DFC_VSwVlvLgTDrft" 961 "DFC_VSwVlvOfsLrnJamVlv" 962 "DFC_VSwVlvOfsNeutr" 963 "DFC_VSwVlvShTDrft" 964 "DFC_VSwVlvSpgDef" 965 "DSQ_AFS" 966 "DSQ_AFS_SSpShOffActr" 967 "DSQ_AirCCmprActr" 968 "DSQ_BattU" 969 "DSQ_BrkP" 970 "DSQ_CByVlvActr" 971 "DSQ_CEngDsT" 972 "DSQ_CThmstActr" 973 "DSQ_Com_aDirect" 974 "DSQ_Com_aSide" 975 "DSQ_Com_ctrDay" 976 "DSQ_Com_ctrSec" 977 "DSQ_Com_ctrSecAbs" 978 "DSQ_Com_dDay" 979 "DSQ_Com_dMonth" 980 "DSQ_Com_dYear" 981 "DSQ_Com_dphiStWhlAg" 982 "DSQ_Com_dvolPspDes" 983 "DSQ_Com_iHiLimCurr" 984 "DSQ_Com_iLoLimCurr" 985 "DSQ_Com_iPsp" 986 "DSQ_Com_iZrLimCurr" 987 "DSQ_Com_idParkConsumer" 988 "DSQ_Com_idVerbraucher" 989 "DSQ_Com_lFlTnkQntLow" 990 "DSQ_Com_lSum" 991 "DSQ_Com_nDKG" 992 "DSQ_Com_nGbxOut" 993 "DSQ_Com_nPsp" 994 "DSQ_Com_nRqIdlg" 995 "DSQ_Com_nTSC" 996 "DSQ_Com_nWhl" 997 "DSQ_Com_nWhlFL" 998 "DSQ_Com_nWhlFR" 999 "DSQ_Com_nWhlRL" 1000 "DSQ_Com_nWhlRR" 1001 "DSQ_Com_pBrkSys" 1002 "DSQ_Com_phiStWhlAg" 1003 "DSQ_Com_rACFanDem" 1004 "DSQ_Com_rHtFlowReq" 1005 "DSQ_Com_rLamLinRecGndRaw" 1006 "DSQ_Com_rLamLinRecUbattRaw" 1007 "DSQ_Com_rNOxCat2DsGndRaw" 1008 "DSQ_Com_rNOxCat2DsUbattRaw" 1009 "DSQ_Com_rPspSetPoint" 1010 "DSQ_Com_rPwrSpCons" 1011 "DSQ_Com_rTrq" 1012 "DSQ_Com_stAC" 1013 "DSQ_Com_stACEFan" 1014 "DSQ_Com_stARS" 1015 "DSQ_Com_stAcpd" 1016 "DSQ_Com_stBattClass" 1017 "DSQ_Com_stBonnet" 1018 "DSQ_Com_stBrkTrqDVCHQl" 1019 "DSQ_Com_stButtonMSA" 1020 "DSQ_Com_stCat2DsGndRaw" 1021 "DSQ_Com_stCat2DsUbattRaw" 1022 "DSQ_Com_stClCtr" 1023 "DSQ_Com_stClassPwr" 1024 "DSQ_Com_stClth" 1025 "DSQ_Com_stClthOpen" 1026 "DSQ_Com_stClthRaw" 1027 "DSQ_Com_stCrCtlKombi" 1028 "DSQ_Com_stCrCtlLvr" 1029 "DSQ_Com_stDSC" 1030 "DSQ_Com_stDecellDSC" 1031 "DSQ_Com_stDiagPsp" 1032 "DSQ_Com_stDoorDriver" 1033 "DSQ_Com_stDrWghSeat" 1034 "DSQ_Com_stDrvAssist" 1035 "DSQ_Com_stDrvDyn" 1036 "DSQ_Com_stDrvPrgQl" 1037 "DSQ_Com_stDynDisp" 1038 "DSQ_Com_stEngStop" 1039 "DSQ_Com_stErrAFS" 1040 "DSQ_Com_stErrStrg" 1041 "DSQ_Com_stFlTnkQntRes" 1042 "DSQ_Com_stFolDyn" 1043 "DSQ_Com_stGbxOBD" 1044 "DSQ_Com_stGear" 1045 "DSQ_Com_stGearBck" 1046 "DSQ_Com_stHDC" 1047 "DSQ_Com_stKeyVld" 1048 "DSQ_Com_stLckGbxDemQl" 1049 "DSQ_Com_stLmpPrkBrk" 1050 "DSQ_Com_stMSALmp" 1051 "DSQ_Com_stModDKG" 1052 "DSQ_Com_stNOxErrGndRaw" 1053 "DSQ_Com_stNOxErrUbattRaw" 1054 "DSQ_Com_stPBrComf" 1055 "DSQ_Com_stPBrHold" 1056 "DSQ_Com_stPBrHyd" 1057 "DSQ_Com_stPBrkSysQl" 1058 "DSQ_Com_stPHtr" 1059 "DSQ_Com_stParkConsumer" 1060 "DSQ_Com_stPsp" 1061 "DSQ_Com_stPspCntr" 1062 "DSQ_Com_stRaceStrt" 1063 "DSQ_Com_stReqMSA" 1064 "DSQ_Com_stRevGear" 1065 "DSQ_Com_stSTEQl" 1066 "DSQ_Com_stSeason" 1067 "DSQ_Com_stShftIdctrDemRglX" 1068 "DSQ_Com_stShiftPdl" 1069 "DSQ_Com_stShutOffPSP" 1070 "DSQ_Com_stSleepBus" 1071 "DSQ_Com_stSleepConst" 1072 "DSQ_Com_stSleepDest" 1073 "DSQ_Com_stSleepRdy" 1074 "DSQ_Com_stStrg" 1075 "DSQ_Com_stStrtClth" 1076 "DSQ_Com_stStrtLck" 1077 "DSQ_Com_stT15" 1078 "DSQ_Com_stT15Hw" 1079 "DSQ_Com_stT50" 1080 "DSQ_Com_stTRadio" 1081 "DSQ_Com_stTSC" 1082 "DSQ_Com_stTerminal" 1083 "DSQ_Com_stTrailer" 1084 "DSQ_Com_stTrqAFS" 1085 "DSQ_Com_stTrqDSCDes" 1086 "DSQ_Com_stTrqFil" 1087 "DSQ_Com_stTrqGbxDes" 1088 "DSQ_Com_stTrqGbxLim" 1089 "DSQ_Com_stTrqStbDesQl" 1090 "DSQ_Com_stTrqStrg" 1091 "DSQ_Com_stTrqWhl" 1092 "DSQ_Com_stTrqWhlDemFASQl" 1093 "DSQ_Com_stTrqWhlDesQl" 1094 "DSQ_Com_stTypBody" 1095 "DSQ_Com_stUnVel" 1096 "DSQ_Com_stVehCond" 1097 "DSQ_Com_stVehDrvCond" 1098 "DSQ_Com_stVerbraucher" 1099 "DSQ_Com_stphiStWhlAg" 1100 "DSQ_Com_swtAC" 1101 "DSQ_Com_swtDrBltb" 1102 "DSQ_Com_tEnvT" 1103 "DSQ_Com_tGbxOil" 1104 "DSQ_Com_tiPostRunPwrSpl" 1105 "DSQ_Com_trqAC" 1106 "DSQ_Com_trqAFS" 1107 "DSQ_Com_trqAFSDes" 1108 "DSQ_Com_trqARSCur" 1109 "DSQ_Com_trqARSDes" 1110 "DSQ_Com_trqAdjrDKG" 1111 "DSQ_Com_trqBrkDVCH" 1112 "DSQ_Com_trqClthDKG" 1113 "DSQ_Com_trqDSCDes" 1114 "DSQ_Com_trqDVCHRise" 1115 "DSQ_Com_trqGbxDes" 1116 "DSQ_Com_trqGbxFrc" 1117 "DSQ_Com_trqGbxMax" 1118 "DSQ_Com_trqGbxMaxRaw" 1119 "DSQ_Com_trqStbDes" 1120 "DSQ_Com_trqStrg" 1121 "DSQ_Com_trqStrgDes" 1122 "DSQ_Com_trqTarDKG" 1123 "DSQ_Com_trqTarDrvDyn" 1124 "DSQ_Com_trqTarDrvDynDes" 1125 "DSQ_Com_trqTarDrvDynMax" 1126 "DSQ_Com_trqWhlDes" 1127 "DSQ_Com_uLamBinGndRaw" 1128 "DSQ_Com_uLamBinUbattRaw" 1129 "DSQ_Com_uPsp" 1130 "DSQ_Com_uT30Psp" 1131 "DSQ_Com_v" 1132 "DSQ_Com_vBd" 1133 "DSQ_Com_vDspl" 1134 "DSQ_Com_vVeh" 1135 "DSQ_Com_volFlTnkQnt" 1136 "DSQ_Com_volFlTnkQntLH" 1137 "DSQ_Com_volFlTnkQntRH" 1138 "DSQ_DSMInhibitAlways" 1139 "DSQ_EBxFan" 1140 "DSQ_ECBVlvActr" 1141 "DSQ_ECBVlvSens" 1142 "DSQ_EGRVlvActr" 1143 "DSQ_EGRVlvLPActr" 1144 "DSQ_EGRVlvLPSens" 1145 "DSQ_EGRVlvSens" 1146 "DSQ_EMDmp_0" 1147 "DSQ_EMDmp_1" 1148 "DSQ_EngPrtFWOsc" 1149 "DSQ_EngStAActr" 1150 "DSQ_EnvP" 1151 "DSQ_EnvT" 1152 "DSQ_ErrLmpActrMIL" 1153 "DSQ_ErrLmpActrSVS" 1154 "DSQ_FanActr" 1155 "DSQ_FlFltDsP" 1156 "DSQ_FlFltHtActr" 1157 "DSQ_FlFltUsP" 1158 "DSQ_FuelLvl_vol" 1159 "DSQ_FuelT" 1160 "DSQ_GbxNPosPls" 1161 "DSQ_IVDiast" 1162 "DSQ_InjVlvInjCo" 1163 "DSQ_InjVlvPresMin" 1164 "DSQ_LAYER2EDCMSAStp" 1165 "DSQ_LSUO2" 1166 "DSQ_Layer_rCtrPwrSpCos" 1167 "DSQ_MRly" 1168 "DSQ_MeUnActr" 1169 "DSQ_NSCDsRLamO2" 1170 "DSQ_NoCat2DsO2Val" 1171 "DSQ_O2ValNSCDs" 1172 "DSQ_O2ValNoCat2Ds" 1173 "DSQ_OilPSwmp" 1174 "DSQ_PCVActr" 1175 "DSQ_PIntkVUs" 1176 "DSQ_PPFltDiff" 1177 "DSQ_PPFltUs" 1178 "DSQ_RailShutOffDblCtl" 1179 "DSQ_RailShutOffMeUnCtl" 1180 "DSQ_SOPTstInjShOff" 1181 "DSQ_ShtrActr" 1182 "DSQ_StrtActr" 1183 "DSQ_TAFS" 1184 "DSQ_TCACDs" 1185 "DSQ_TECU" 1186 "DSQ_TOxiCatUs" 1187 "DSQ_TPFltUs" 1188 "DSQ_TTrbnUs" 1189 "DSQ_ThrVlvActr" 1190 "DSQ_ThrVlvSens" 1191 "DSQ_TrbChActr" 1192 "DSQ_TrbChLPActr" 1193 "DSQ_TrbChSens" 1194 "DSQ_TrbnDsRLamO2" 1195 "DSQ_UCatUsT" 1196 "DSQ_UDosVlvActr" 1197 "DSQ_UHtrPL" 1198 "DSQ_UHtrPLDia" 1199 "DSQ_UHtrTnk" 1200 "DSQ_UHtrTnkDia" 1201 "DSQ_UPmpMotActr" 1202 "DSQ_UPmpP" 1203 "DSQ_URevVlv" 1204 "DSQ_UTnkLvl" 1205 "DSQ_UTnkT" 1206 "DSQ_VSwVlvActr" 1207 "DSQ_VSwVlvSens" 1208 "DSQ_WaHtElActr" 1209 "DSQ_stAPP" 1210 "DSQ_stAPP1" 1211 "DSQ_stAPP2" 1212 "DSQ_stLSUSrvTstDem" 1213 "DSQ_stSrvOpLSUAdap" DEFAULT_VALUE "---" /end COMPU_VTAB
/begin COMPU_METHOD DFC_OneToOne "" RAT_FUNC "%6.0" "-" COEFFS 0 1 0 0 0 1 /end COMPU_METHOD
/begin COMPU_METHOD DFC_Verb "" TAB_VERB "%2.1" "-" COMPU_TAB_REF DFC_Verb /end COMPU_METHOD
/begin COMPU_VTAB DFC_Verb "" TAB_VERB 965 0 "DFC_Unused" 1 "DFC_ACCIPlausDrvAst" 2 "DFC_ACCIPlausTrqDes" 3 "DFC_AirCtlGovDvtEOMMax" 4 "DFC_AirCtlGovDvtEOMMin" 5 "DFC_AirCtlGovDvtMax" 6 "DFC_AirCtlGovDvtMin" 7 "DFC_AirCtlGovLPDvtMax" 8 "DFC_AirCtlGovLPDvtMin" 9 "DFC_AltIOComErr" 10 "DFC_AltIOComNpl" 11 "DFC_BusDiagBusOffFlexRay" 12 "DFC_BusDiagBusOffNodeA" 13 "DFC_BusDiagBusOffNodeB" 14 "DFC_BusDiagBusOffNodeC" 15 "DFC_BusDiagHwFlexRay" 16 "DFC_Cj945SpiCom1" 17 "DFC_ComACDemandSig_FA" 18 "DFC_ComACDemandTo_FA" 19 "DFC_ComATempSig_FA" 20 "DFC_ComATempTo_FA" 21 "DFC_ComATempTo_FX" 22 "DFC_ComBrkTrqSumChk_FX" 23 "DFC_ComBrkTrqSumCtr_FX" 24 "DFC_ComBrkTrqSumTo_FX" 25 "DFC_ComBtnDrvDynChk_FX" 26 "DFC_ComBtnDrvDynCtr_FX" 27 "DFC_ComBtnDrvDynTo_FX" 28 "DFC_ComButtonMSASig" 29 "DFC_ComButtonMSATo" 30 "DFC_ComCodierungPwrmngSig" 31 "DFC_ComCodierungPwrmngSig_FA" 32 "DFC_ComCrCtlLvrChk" 33 "DFC_ComCrCtlLvrCtr" 34 "DFC_ComCrCtlLvrSig" 35 "DFC_ComCrCtlLvrTo" 36 "DFC_ComCtrCrshSwoEkpSig_FA" 37 "DFC_ComCtrCrshSwoEkpTo_FA" 38 "DFC_ComCtrSecInt" 39 "DFC_ComDiaOBDGbxSig_A" 40 "DFC_ComDiaOBDGbxTo_A" 41 "DFC_ComFahrzeugtypSig" 42 "DFC_ComFahrzeugtypSig_FA" 43 "DFC_ComFllupGpwsupSig_FA" 44 "DFC_ComFllupGpwsupTo_FA" 45 "DFC_ComGbxDataChk_A" 46 "DFC_ComGbxDataChk_FA" 47 "DFC_ComGbxDataCtr_A" 48 "DFC_ComGbxDataCtr_FA" 49 "DFC_ComGbxDataSig_A" 50 "DFC_ComGbxDataSig_FA" 51 "DFC_ComGbxDataTo_A" 52 "DFC_ComGbxDataTo_FA" 53 "DFC_ComKlemmenChk_FA" 54 "DFC_ComKlemmenCtr_FA" 55 "DFC_ComKlemmenSig_FA" 56 "DFC_ComKlemmenTo_FA" 57 "DFC_ComLenkradwinkelSig" 58 "DFC_ComLenkradwinkelTo" 59 "DFC_ComMileageRangeSig_FA" 60 "DFC_ComMileageRangeTo_FA" 61 "DFC_ComPspSig" 62 "DFC_ComPspTo" 63 "DFC_ComRelTimeSig_FA" 64 "DFC_ComRelTimeTo_FA" 65 "DFC_ComRequestEMFChk" 66 "DFC_ComRequestEMFCtr" 67 "DFC_ComRequestEMFSig" 68 "DFC_ComRequestEMFTo" 69 "DFC_ComRpmWhlChk_FX" 70 "DFC_ComRpmWhlCtr_FX" 71 "DFC_ComRpmWhlTo_FX" 72 "DFC_ComSecCtrRelSig_FA" 73 "DFC_ComSecCtrRelTo_FA" 74 "DFC_ComSensNOxGndSig" 75 "DFC_ComSensNOxGndTo" 76 "DFC_ComSensNOxMode" 77 "DFC_ComSensNOxUbattSig" 78 "DFC_ComSensNOxUbattTo" 79 "DFC_ComShiftPaddleTo_FX" 80 "DFC_ComShutOffPSPSig" 81 "DFC_ComShutOffPSPTo" 82 "DFC_ComSlrdiGlbFZMTo_FA" 83 "DFC_ComSlrdiGlbFZMTo_FX" 84 "DFC_ComSpeedVehicleChk_FX" 85 "DFC_ComSpeedVehicleCtr_FX" 86 "DFC_ComSpeedVehicleTo_FX" 87 "DFC_ComStConintDSCChk_FX" 88 "DFC_ComStConintDSCCtr_FX" 89 "DFC_ComStConintDSCTo_FX" 90 "DFC_ComStatACFrontSig_FA" 91 "DFC_ComStatACFrontTo_FA" 92 "DFC_ComStatEkpSig_A" 93 "DFC_ComStatEkpTo_A" 94 "DFC_ComStatGearRevSig_FA" 95 "DFC_ComStatGearRevTo_FA" 96 "DFC_ComStatZVKlappenSig_FA" 97 "DFC_ComStatZVKlappenTo_FA" 98 "DFC_ComStateARSCtr" 99 "DFC_ComStateARSSig" 100 "DFC_ComStateARSTo" 101 "DFC_ComStateDscSig" 102 "DFC_ComStateDscTo" 103 "DFC_ComStateSeatSig" 104 "DFC_ComStateSeatSig_FA" 105 "DFC_ComStateSeatTo" 106 "DFC_ComStateSeatTo_FA" 107 "DFC_ComStatusEGSSig_A" 108 "DFC_ComStatusEGSSig_FA" 109 "DFC_ComStatusEGSTo_A" 110 "DFC_ComStatusEGSTo_FA" 111 "DFC_ComStatusEMFChk" 112 "DFC_ComStatusEMFCtr" 113 "DFC_ComStatusEMFSig" 114 "DFC_ComStatusEMFTo" 115 "DFC_ComStatusRGangSig" 116 "DFC_ComStatusRGangTo" 117 "DFC_ComSteeringAngleChk_FX" 118 "DFC_ComSteeringAngleCtr_FX" 119 "DFC_ComSteeringAngleTo_FX" 120 "DFC_ComTerminalChk" 121 "DFC_ComTerminalCtr" 122 "DFC_ComTerminalSig" 123 "DFC_ComTerminalTo" 124 "DFC_ComTimeDateSig_FA" 125 "DFC_ComTimeDateTo_FA" 126 "DFC_ComTrailerSig" 127 "DFC_ComTrailerSig_FA" 128 "DFC_ComTrailerTo" 129 "DFC_ComTrailerTo_FA" 130 "DFC_ComTrqDemCrshDrDyChk_FX" 131 "DFC_ComTrqDemCrshDrDyCtr_FX" 132 "DFC_ComTrqDemCrshDrDyTo_FX" 133 "DFC_ComTrqDemandDesSig" 134 "DFC_ComTrqDemandDesTo" 135 "DFC_ComTrqDemandDscChk" 136 "DFC_ComTrqDemandDscCtr" 137 "DFC_ComTrqDemandDscSig" 138 "DFC_ComTrqDemandDscTo" 139 "DFC_ComTrqDemandGbxChk_A" 140 "DFC_ComTrqDemandGbxChk_FA" 141 "DFC_ComTrqDemandGbxCtr_A" 142 "DFC_ComTrqDemandGbxCtr_FA" 143 "DFC_ComTrqDemandGbxSig_A" 144 "DFC_ComTrqDemandGbxSig_FA" 145 "DFC_ComTrqDemandGbxTo_A" 146 "DFC_ComTrqDemandGbxTo_FA" 147 "DFC_ComTrqWhlDemChk" 148 "DFC_ComTrqWhlDemCtr" 149 "DFC_ComTrqWhlDemFASChk_FX" 150 "DFC_ComTrqWhlDemFASCtr_FX" 151 "DFC_ComTrqWhlDemFASTo_FX" 152 "DFC_ComTrqWhlDemSig" 153 "DFC_ComTrqWhlDemTo" 154 "DFC_ComVelocityChk_FA" 155 "DFC_ComVelocityCtr_FA" 156 "DFC_ComVelocitySig" 157 "DFC_ComVelocitySig_FA" 158 "DFC_ComVelocityTo" 159 "DFC_ComVelocityTo_FA" 160 "DFC_ComVerbraucherTo" 161 "DFC_ComWMomPTStabChk_FX" 162 "DFC_ComWMomPTStabCtr_FX" 163 "DFC_ComWMomPTStabTo_FX" 164 "DFC_ComWheelSpeedSig" 165 "DFC_ComWheelSpeedTo" 166 "DFC_ComZvKlappenSig" 167 "DFC_ComZvKlappenTo" 168 "DFC_ComaDirectChk_FX" 169 "DFC_ComaDirectCtr_FX" 170 "DFC_ComaDirectTo_FX" 171 "DFC_ComaSideChk_FX" 172 "DFC_ComaSideCtr_FX" 173 "DFC_ComaSideTo_FX" 174 "DFC_Cy320SpiCom" 175 "DFC_ETCtlDvtInrMax" 176 "DFC_ETCtlDvtInrMin" 177 "DFC_ETCtlDvtOutrMax" 178 "DFC_ETCtlDvtOutrMin" 179 "DFC_FBCqDvtMax" 180 "DFC_FBCqDvtMin" 181 "DFC_Fan4WinErr1" 182 "DFC_Fan4WinErr2" 183 "DFC_Fan4WinErr3" 184 "DFC_Fan4WinErr4" 185 "DFC_FanSCG" 186 "DFC_FlFCBS" 187 "DFC_GlwEcuConfigErr" 188 "DFC_GlwEcuEepErr" 189 "DFC_GlwEcuFrmErr" 190 "DFC_GlwEcuGPCMFaultInfo" 191 "DFC_GlwEcuGPCMInfo" 192 "DFC_GlwEcuGk1HSS" 193 "DFC_GlwEcuGk1OL" 194 "DFC_GlwEcuGk1SC" 195 "DFC_GlwEcuGk1Wdst" 196 "DFC_GlwEcuGk2HSS" 197 "DFC_GlwEcuGk2OL" 198 "DFC_GlwEcuGk2SC" 199 "DFC_GlwEcuGk2Wdst" 200 "DFC_GlwEcuGk3HSS" 201 "DFC_GlwEcuGk3OL" 202 "DFC_GlwEcuGk3SC" 203 "DFC_GlwEcuGk3Wdst" 204 "DFC_GlwEcuGk4HSS" 205 "DFC_GlwEcuGk4OL" 206 "DFC_GlwEcuGk4SC" 207 "DFC_GlwEcuGk4Wdst" 208 "DFC_GlwEcuGk5HSS" 209 "DFC_GlwEcuGk5OL" 210 "DFC_GlwEcuGk5SC" 211 "DFC_GlwEcuGk5Wdst" 212 "DFC_GlwEcuGk6HSS" 213 "DFC_GlwEcuGk6OL" 214 "DFC_GlwEcuGk6SC" 215 "DFC_GlwEcuGk6Wdst" 216 "DFC_GlwEcuGndErr" 217 "DFC_GlwEcuIntErr" 218 "DFC_GlwEcuMsgTimeout" 219 "DFC_GlwEcuT30Err" 220 "DFC_GlwEcuTempErr" 221 "DFC_GlwEcuUdiffT30" 222 "DFC_IBSComErr" 223 "DFC_LubSRCOilFldtCrit" 224 "DFC_LubSRCOilFldtCritDflMin" 225 "DFC_LubSRCOilLvlCritMax" 226 "DFC_LubSRCOilLvlCritMin" 227 "DFC_LubSRCTot" 228 "DFC_MonUMaxSupply1" 229 "DFC_MonUMinSupply1" 230 "DFC_OilComNpl" 231 "DFC_PCBS" 232 "DFC_PCBSPFltChg" 233 "DFC_PCRGovDvtLPMax" 234 "DFC_PCRGovDvtLPMin" 235 "DFC_PCRGovDvtMax" 236 "DFC_PCRGovDvtMin" 237 "DFC_PFltAPSPlausMAX" 238 "DFC_PFltAPSPlausMIN" 239 "DFC_PFltBPSPlausMAX" 240 "DFC_PFltBPSPlausMIN" 241 "DFC_PFltOvldInhRgn" 242 "DFC_PFltOvldTrqLim" 243 "DFC_PFltPresPlausMAX" 244 "DFC_PFltPresPlausMIN" 245 "DFC_PFltTraRpmRdc" 246 "DFC_PFlt_tOxiPreMax" 247 "DFC_PFlt_tOxiPreMaxRgn" 248 "DFC_PFlt_tOxiPreNpl" 249 "DFC_PFlt_tPreMax" 250 "DFC_PFlt_tPreMaxRgn" 251 "DFC_PFlt_tPreNpl" 252 "DFC_PFltmSotDiffMAX" 253 "DFC_PFltmSotDiffMIN" 254 "DFC_PFltmSotDiffSIG" 255 "DFC_PIntkVUsEnvPPls" 256 "DFC_PresPlausDblDef" 257 "DFC_RailCPC1" 258 "DFC_RailCPC3" 259 "DFC_RailCPC4" 260 "DFC_RailMeUn0" 261 "DFC_RailMeUn1" 262 "DFC_RailMeUn2" 263 "DFC_RailMeUn22" 264 "DFC_RailMeUn3" 265 "DFC_RailMeUn4" 266 "DFC_RailMeUn42" 267 "DFC_RailMeUn5" 268 "DFC_RailPCV0" 269 "DFC_RailPCV1" 270 "DFC_RailPCV2" 271 "DFC_RailPCV22" 272 "DFC_RailPCV3" 273 "DFC_RailPCV4" 274 "DFC_RailPCV42" 275 "DFC_RailPMonStrt" 276 "DFC_SSpMon1" 277 "DFC_SSpMon2" 278 "DFC_SSpMon3" 279 "DFC_ThrVlv4WinErr1" 280 "DFC_ThrVlv4WinErr2" 281 "DFC_ThrVlv4WinErr3" 282 "DFC_ThrVlv4WinErr4" 283 "DFC_ThrVlvSCG" 284 "DFC_Tle6232Spi1" 285 "DFC_TrbCh4WinErr1" 286 "DFC_TrbCh4WinErr2" 287 "DFC_TrbCh4WinErr3" 288 "DFC_TrbCh4WinErr4" 289 "DFC_TrbChSCG" 290 "DFC_TrbChSRCMax" 291 "DFC_TrbChSRCMin" 292 "DFC_WaHtEl4WinErr1" 293 "DFC_WaHtEl4WinErr2" 294 "DFC_WaHtEl4WinErr3" 295 "DFC_WaHtEl4WinErr4" 296 "DFC_WaHtElSCG" 297 "DFC_ETClbETFltMax_0" 298 "DFC_ETClbETFltMax_1" 299 "DFC_ETClbETFltMax_2" 300 "DFC_ETClbETFltMax_3" 301 "DFC_ETClbETFltMax_4" 302 "DFC_ETClbETFltMax_5" 303 "DFC_ETClbETFltMin_0" 304 "DFC_ETClbETFltMin_1" 305 "DFC_ETClbETFltMin_2" 306 "DFC_ETClbETFltMin_3" 307 "DFC_ETClbETFltMin_4" 308 "DFC_ETClbETFltMin_5" 309 "DFC_InjCrvInjLimChrgBal" 310 "DFC_InjCrvInjLimQntBal" 311 "DFC_InjCrvInjLimSys" 312 "DFC_InjCrvNumInjRtmLim" 313 "DFC_LSUHtCoupSig" 314 "DFC_AFS_SSpShOffOL" 315 "DFC_AFS_SSpShOffOvrTemp" 316 "DFC_AFS_SSpShOffSCB" 317 "DFC_AFS_SSpShOffSCG" 318 "DFC_AirCCmprOL" 319 "DFC_AirCCmprOvrTemp" 320 "DFC_AirCCmprSCB" 321 "DFC_AirCCmprSCG" 322 "DFC_CByVlvOL" 323 "DFC_CByVlvOvrTemp" 324 "DFC_CByVlvSCB" 325 "DFC_CByVlvSCG" 326 "DFC_CThmstOL" 327 "DFC_CThmstOvrTemp" 328 "DFC_CThmstSCB" 329 "DFC_CThmstSCG" 330 "DFC_DSMDummy" 331 "DFC_EBxFanOL" 332 "DFC_EBxFanOvrTemp" 333 "DFC_EBxFanSCB" 334 "DFC_EBxFanSCG" 335 "DFC_ECBVlvOL" 336 "DFC_ECBVlvOvrTemp" 337 "DFC_ECBVlvSCB" 338 "DFC_ECBVlvSCG" 339 "DFC_EMDmpOL_0" 340 "DFC_EMDmpOL_1" 341 "DFC_EMDmpOvrTemp_0" 342 "DFC_EMDmpOvrTemp_1" 343 "DFC_EMDmpSCB_0" 344 "DFC_EMDmpSCB_1" 345 "DFC_EMDmpSCG_0" 346 "DFC_EMDmpSCG_1" 347 "DFC_EngStAOL" 348 "DFC_EngStAOvrTemp" 349 "DFC_EngStASCB" 350 "DFC_EngStASCG" 351 "DFC_FanOL" 352 "DFC_FanOvrTemp" 353 "DFC_FanSCB" 354 "DFC_FlFltHtOL" 355 "DFC_FlFltHtOvrTemp" 356 "DFC_FlFltHtSCB" 357 "DFC_FlFltHtSCG" 358 "DFC_LSUHtrMax" 359 "DFC_LSUHtrMin" 360 "DFC_LSUHtrNpl" 361 "DFC_LSUHtrSig" 362 "DFC_LSUtExcMax" 363 "DFC_LSUtExcMin" 364 "DFC_MeUnOL" 365 "DFC_MeUnSCB" 366 "DFC_MeUnSRCMax" 367 "DFC_MeUnSRCMin" 368 "DFC_PCVOL" 369 "DFC_PCVSCB" 370 "DFC_PCVSRCMax" 371 "DFC_PCVSRCMin" 372 "DFC_RailPSRCMax" 373 "DFC_RailPSRCMin" 374 "DFC_ShtrOL" 375 "DFC_ShtrOvrTemp" 376 "DFC_ShtrSCB" 377 "DFC_ShtrSCG" 378 "DFC_StrtOL" 379 "DFC_StrtOvrTemp" 380 "DFC_StrtSCB" 381 "DFC_StrtSCG" 382 "DFC_ThrVlvOL" 383 "DFC_ThrVlvOvrTemp" 384 "DFC_ThrVlvSCB" 385 "DFC_TrbChOL" 386 "DFC_TrbChOvrTemp" 387 "DFC_TrbChSCB" 388 "DFC_UDosVlvOL" 389 "DFC_UDosVlvOvrTemp" 390 "DFC_UDosVlvSCB" 391 "DFC_UDosVlvSCG" 392 "DFC_UPmpMotOL" 393 "DFC_UPmpMotOvrTemp" 394 "DFC_UPmpMotSCB" 395 "DFC_UPmpMotSCG" 396 "DFC_WaHtElOL" 397 "DFC_WaHtElOvrTemp" 398 "DFC_WaHtElSCB" 399 "DFC_IVActrUChSRCMax" 400 "DFC_IVActrUChSRCMin" 401 "DFC_IVActrVltgSRCMax" 402 "DFC_IVActrVltgSRCMin" 403 "DFC_IVDiaTunDet" 404 "DFC_IVPSplyStopDCDC" 405 "DFC_IVPSplyVltgSRCMax" 406 "DFC_IVPSplyVltgSRCMin" 407 "DFC_SCREtaErr" 408 "DFC_SCREtaErr1" 409 "DFC_SCREtaErr2" 410 "DFC_SCRMonMetCtlPresErr" 411 "DFC_SCRMonPresBuildUpErr" 412 "DFC_SCRMonPresRdcErr" 413 "DFC_AFSOffsDrftMax" 414 "DFC_AFSOffsDrftMin" 415 "DFC_AFSSRCCorMax" 416 "DFC_AFSSRCCorMin" 417 "DFC_AFSSRCRawMax" 418 "DFC_AFSSRCRawMin" 419 "DFC_AFSSetyDrftMax" 420 "DFC_AFSSetyDrftMin" 421 "DFC_AirCSwtNpl" 422 "DFC_AirCSwtSig" 423 "DFC_BattUSRCMax" 424 "DFC_BattUSRCMin" 425 "DFC_BrkNpl" 426 "DFC_BrkPSRCMax" 427 "DFC_BrkPSRCMin" 428 "DFC_CEngDsTSRCMax" 429 "DFC_CEngDsTSRCMin" 430 "DFC_CrCUIDet" 431 "DFC_ECBVlvSRCMax" 432 "DFC_ECBVlvSRCMin" 433 "DFC_ECUOvrTemp" 434 "DFC_EGRVlvGovDvtMax" 435 "DFC_EGRVlvGovDvtMin" 436 "DFC_EGRVlvHBrgOpnLd" 437 "DFC_EGRVlvHBrgOvrCurr" 438 "DFC_EGRVlvHBrgOvrTemp" 439 "DFC_EGRVlvHBrgShCirBatt1" 440 "DFC_EGRVlvHBrgShCirBatt2" 441 "DFC_EGRVlvHBrgShCirGnd1" 442 "DFC_EGRVlvHBrgShCirGnd2" 443 "DFC_EGRVlvHBrgShCirOvrLd" 444 "DFC_EGRVlvHBrgTempOvrCurr" 445 "DFC_EGRVlvHBrgUndrVltg" 446 "DFC_EGRVlvLPGovDvtMax" 447 "DFC_EGRVlvLPGovDvtMin" 448 "DFC_EGRVlvLPHBrgOpnLd" 449 "DFC_EGRVlvLPHBrgOvrCurr" 450 "DFC_EGRVlvLPHBrgOvrTemp" 451 "DFC_EGRVlvLPHBrgShCirBatt1" 452 "DFC_EGRVlvLPHBrgShCirBatt2" 453 "DFC_EGRVlvLPHBrgShCirGnd1" 454 "DFC_EGRVlvLPHBrgShCirGnd2" 455 "DFC_EGRVlvLPHBrgShCirOvrLd" 456 "DFC_EGRVlvLPHBrgTempOvrCurr" 457 "DFC_EGRVlvLPHBrgUndrVltg" 458 "DFC_EGRVlvLPOL" 459 "DFC_EGRVlvLPSCB" 460 "DFC_EGRVlvLPSCG" 461 "DFC_EGRVlvLPSRCMax" 462 "DFC_EGRVlvLPSRCMin" 463 "DFC_EGRVlvOL" 464 "DFC_EGRVlvSCB" 465 "DFC_EGRVlvSCG" 466 "DFC_EGRVlvSRCMax" 467 "DFC_EGRVlvSRCMin" 468 "DFC_EngPrtOvrSpd" 469 "DFC_EngSpdOL" 470 "DFC_EngSpdSCB" 471 "DFC_EngSpdSCG" 472 "DFC_EnhSRCMaxPPFltDiff" 473 "DFC_EnhSRCMaxT1ExhTMon" 474 "DFC_EnhSRCMaxT2ExhTMon" 475 "DFC_EnhSRCMaxT3ExhTMon" 476 "DFC_EnhSRCMinPPFltDiff" 477 "DFC_EnhSRCMinT1ExhTMon" 478 "DFC_EnhSRCMinT2ExhTMon" 479 "DFC_EnhSRCMinT3ExhTMon" 480 "DFC_EnvPSRCMax" 481 "DFC_EnvPSRCMin" 482 "DFC_ExhTMonPlaus" 483 "DFC_ExhTMonPlausPos1" 484 "DFC_ExhTMonPlausPos2" 485 "DFC_ExhTMonPlausPos3" 486 "DFC_ExhTMonT1Plaus" 487 "DFC_ExhTMonT2Plaus" 488 "DFC_ExhTMonT3Plaus" 489 "DFC_FlFltDsPSRCMax" 490 "DFC_FlFltDsPSRCMin" 491 "DFC_FlFltSig" 492 "DFC_FlFltUsPSRCMax" 493 "DFC_FlFltUsPSRCMin" 494 "DFC_FuelTSRCMax" 495 "DFC_FuelTSRCMin" 496 "DFC_GbxNPosPPerSRCMax" 497 "DFC_GbxNPosPPerSRCMin" 498 "DFC_GbxNPosPdcycSRCMax" 499 "DFC_GbxNPosPdcycSRCMin" 500 "DFC_InjVlvPresMin" 501 "DFC_LSUCircNernstSig" 502 "DFC_LSUCircPmpCurSig" 503 "DFC_LSUCircVirtGndSig" 504 "DFC_LSUO2Max" 505 "DFC_LSUO2Min" 506 "DFC_LSUSPIBattLowMin" 507 "DFC_LSUWireSCB" 508 "DFC_LSUWireSCG" 509 "DFC_MeUnSCG" 510 "DFC_NSCDsCmpChk" 511 "DFC_NSCDsLamBinSRCMax" 512 "DFC_NSCDsLamBinSRCMin" 513 "DFC_NSCDsLamLinSRCMax" 514 "DFC_NSCDsLamLinSRCMin" 515 "DFC_NSCDsLamPlausMax" 516 "DFC_NSCDsLamPlausMin" 517 "DFC_NSCDsNOxSRCMax" 518 "DFC_NSCDsNOxSRCMin" 519 "DFC_NSCDsOpCir" 520 "DFC_NSCDsShCir" 521 "DFC_NoCat2DsCmpChk" 522 "DFC_NoCat2DsLamBinSRCMax" 523 "DFC_NoCat2DsLamBinSRCMin" 524 "DFC_NoCat2DsLamLinSRCMax" 525 "DFC_NoCat2DsLamLinSRCMin" 526 "DFC_NoCat2DsLamPlausMax" 527 "DFC_NoCat2DsLamPlausMin" 528 "DFC_NoCat2DsNOxSRCMax" 529 "DFC_NoCat2DsNOxSRCMin" 530 "DFC_NoCat2DsOpCir" 531 "DFC_NoCat2DsShCir" 532 "DFC_NplDynPPFltDiff" 533 "DFC_NplHsChngPPFltDiff" 534 "DFC_NplHsLnPPFltDiff" 535 "DFC_NplTOxiCatUs" 536 "DFC_NplTPFltUs" 537 "DFC_NplTTrbnUs" 538 "DFC_OilPSwmpSRCMax" 539 "DFC_OilPSwmpSRCMin" 540 "DFC_PCVSCG" 541 "DFC_PFltCharPDiffMin" 542 "DFC_PFltDstrMin" 543 "DFC_PFltEngPrt" 544 "DFC_PFltRgnPerm" 545 "DFC_PFltSRCMaxFlwRstn" 546 "DFC_PFltSRCMinFlwRstn" 547 "DFC_PFltSotMsDvtMax" 548 "DFC_PFltSotMsDvtMin" 549 "DFC_PFltSotMsMax" 550 "DFC_PIntkVUsSRCMax" 551 "DFC_PIntkVUsSRCMin" 552 "DFC_SRCHighAPP1" 553 "DFC_SRCHighAPP2" 554 "DFC_SRCLowAPP1" 555 "DFC_SRCLowAPP2" 556 "DFC_SRCMaxPPFltDiff" 557 "DFC_SRCMaxPPFltUs" 558 "DFC_SRCMaxTECU" 559 "DFC_SRCMaxTOxiCatUs" 560 "DFC_SRCMaxTPFltUs" 561 "DFC_SRCMaxTTrbnUs" 562 "DFC_SRCMaxUCatUsT" 563 "DFC_SRCMaxUPmpP" 564 "DFC_SRCMinPPFltDiff" 565 "DFC_SRCMinPPFltUs" 566 "DFC_SRCMinTECU" 567 "DFC_SRCMinTOxiCatUs" 568 "DFC_SRCMinTPFltUs" 569 "DFC_SRCMinTTrbnUs" 570 "DFC_SRCMinUCatUsT" 571 "DFC_SRCMinUPmpP" 572 "DFC_SigUCatUsT" 573 "DFC_SigUPmpP" 574 "DFC_SyncAPP" 575 "DFC_T15Npl" 576 "DFC_TAFSDtyCycHi" 577 "DFC_TAFSDtyCycLo" 578 "DFC_TAFSPerHi" 579 "DFC_TAFSPerLo" 580 "DFC_TCACDsSRCMax" 581 "DFC_TCACDsSRCMin" 582 "DFC_ThrVlvSRCMax" 583 "DFC_ThrVlvSRCMin" 584 "DFC_TrbChLPOL" 585 "DFC_TrbChLPSCB" 586 "DFC_TrbChLPSCG" 587 "DFC_UHtrPLOL" 588 "DFC_UHtrPLSCB" 589 "DFC_UHtrPLSCG" 590 "DFC_UHtrPLSRCMaxDia" 591 "DFC_UHtrPLSRCMinDia" 592 "DFC_UHtrTnkOL" 593 "DFC_UHtrTnkSCB" 594 "DFC_UHtrTnkSCG" 595 "DFC_UHtrTnkSRCMaxDia" 596 "DFC_UHtrTnkSRCMinDia" 597 "DFC_URevVlvOL" 598 "DFC_URevVlvSCB" 599 "DFC_URevVlvSCG" 600 "DFC_UTnkTSRCMax" 601 "DFC_UTnkTSRCMin" 602 "DFC_UTnkTSig" 603 "DFC_VSwVlvGovDvtMax" 604 "DFC_VSwVlvGovDvtMin" 605 "DFC_VSwVlvHBrgOpnLd" 606 "DFC_VSwVlvHBrgOvrCurr" 607 "DFC_VSwVlvHBrgOvrTemp" 608 "DFC_VSwVlvHBrgShCirBatt1" 609 "DFC_VSwVlvHBrgShCirBatt2" 610 "DFC_VSwVlvHBrgShCirGnd1" 611 "DFC_VSwVlvHBrgShCirGnd2" 612 "DFC_VSwVlvHBrgShCirOvrLd" 613 "DFC_VSwVlvHBrgTempOvrCurr" 614 "DFC_VSwVlvHBrgUndrVltg" 615 "DFC_VSwVlvOL" 616 "DFC_VSwVlvSCB" 617 "DFC_VSwVlvSCG" 618 "DFC_VSwVlvSRCMax" 619 "DFC_VSwVlvSRCMin" 620 "DFC_ClthNpl" 621 "DFC_ETClbETMax_0" 622 "DFC_ETClbETMax_1" 623 "DFC_ETClbETMax_2" 624 "DFC_ETClbETMax_3" 625 "DFC_ETClbETMax_4" 626 "DFC_ETClbETMax_5" 627 "DFC_ETClbETMin_0" 628 "DFC_ETClbETMin_1" 629 "DFC_ETClbETMin_2" 630 "DFC_ETClbETMin_3" 631 "DFC_ETClbETMin_4" 632 "DFC_ETClbETMin_5" 633 "DFC_IVActrEnrgMax_0" 634 "DFC_IVActrEnrgMax_1" 635 "DFC_IVActrEnrgMax_2" 636 "DFC_IVActrEnrgMax_3" 637 "DFC_IVActrEnrgMax_4" 638 "DFC_IVActrEnrgMax_5" 639 "DFC_IVActrEnrgMax_6" 640 "DFC_IVActrEnrgMax_7" 641 "DFC_IVActrEnrgMin_0" 642 "DFC_IVActrEnrgMin_1" 643 "DFC_IVActrEnrgMin_2" 644 "DFC_IVActrEnrgMin_3" 645 "DFC_IVActrEnrgMin_4" 646 "DFC_IVActrEnrgMin_5" 647 "DFC_IVActrEnrgMin_6" 648 "DFC_IVActrEnrgMin_7" 649 "DFC_IVActrEnrgPlaus_0" 650 "DFC_IVActrEnrgPlaus_1" 651 "DFC_IVActrEnrgPlaus_2" 652 "DFC_IVActrEnrgPlaus_3" 653 "DFC_IVActrEnrgPlaus_4" 654 "DFC_IVActrEnrgPlaus_5" 655 "DFC_IVActrEnrgPlaus_6" 656 "DFC_IVActrEnrgPlaus_7" 657 "DFC_IVCtlTiDiff_0" 658 "DFC_IVCtlTiDiff_1" 659 "DFC_IVCtlTiDiff_2" 660 "DFC_IVCtlTiDiff_3" 661 "DFC_IVCtlTiDiff_4" 662 "DFC_IVCtlTiDiff_5" 663 "DFC_IVCtlUDiffUp_0" 664 "DFC_IVCtlUDiffUp_1" 665 "DFC_IVCtlUDiffUp_2" 666 "DFC_IVCtlUDiffUp_3" 667 "DFC_IVCtlUDiffUp_4" 668 "DFC_IVCtlUDiffUp_5" 669 "DFC_IVCtlUUp_0" 670 "DFC_IVCtlUUp_1" 671 "DFC_IVCtlUUp_2" 672 "DFC_IVCtlUUp_3" 673 "DFC_IVCtlUUp_4" 674 "DFC_IVCtlUUp_5" 675 "DFC_IVDiaBnkShCir_0" 676 "DFC_IVDiaBnkShCir_1" 677 "DFC_IVDiaBnkShCirChSwt_0" 678 "DFC_IVDiaBnkShCirChSwt_1" 679 "DFC_IVDiaChp_0" 680 "DFC_IVDiaChp_1" 681 "DFC_IVDiaCylNoCls_0" 682 "DFC_IVDiaCylNoCls_1" 683 "DFC_IVDiaCylNoCls_2" 684 "DFC_IVDiaCylNoCls_3" 685 "DFC_IVDiaCylNoCls_4" 686 "DFC_IVDiaCylNoCls_5" 687 "DFC_IVDiaCylNoLd_0" 688 "DFC_IVDiaCylNoLd_1" 689 "DFC_IVDiaCylNoLd_2" 690 "DFC_IVDiaCylNoLd_3" 691 "DFC_IVDiaCylNoLd_4" 692 "DFC_IVDiaCylNoLd_5" 693 "DFC_IVDiaCylShCir_0" 694 "DFC_IVDiaCylShCir_1" 695 "DFC_IVDiaCylShCir_2" 696 "DFC_IVDiaCylShCir_3" 697 "DFC_IVDiaCylShCir_4" 698 "DFC_IVDiaCylShCir_5" 699 "DFC_IVDiaCylShCirHSLS_0" 700 "DFC_IVDiaCylShCirHSLS_1" 701 "DFC_IVDiaCylShCirHSLS_2" 702 "DFC_IVDiaCylShCirHSLS_3" 703 "DFC_IVDiaCylShCirHSLS_4" 704 "DFC_IVDiaCylShCirHSLS_5" 705 "DFC_IVDiaCylShCirMeas_0" 706 "DFC_IVDiaCylShCirMeas_1" 707 "DFC_IVDiaCylShCirMeas_2" 708 "DFC_IVDiaCylShCirMeas_3" 709 "DFC_IVDiaCylShCirMeas_4" 710 "DFC_IVDiaCylShCirMeas_5" 711 "DFC_LSUDynChk" 712 "DFC_LSUO2ClbMax" 713 "DFC_LSUO2ClbMin" 714 "DFC_LSUO2PlausMaxFLd" 715 "DFC_LSUO2PlausMaxOvrRun" 716 "DFC_LSUO2PlausMaxPartLd" 717 "DFC_LSUO2PlausMinFLd" 718 "DFC_LSUO2PlausMinOvrRun" 719 "DFC_LSUO2PlausMinPartLd" 720 "DFC_LSURiClbMax" 721 "DFC_LSURiClbMin" 722 "DFC_LSUWireIPSig" 723 "DFC_Layer_BSDMax" 724 "DFC_Layer_BSDMin" 725 "DFC_Layer_BSDNpl" 726 "DFC_Layer_BSDSig" 727 "DFC_Layer_FltMngTstMax" 728 "DFC_Layer_FltMngTstMin" 729 "DFC_Layer_FltMngTstNpl" 730 "DFC_Layer_FltMngTstSig" 731 "DFC_Layer_GENELBMax" 732 "DFC_Layer_GENELBMin" 733 "DFC_Layer_GENELBNpl" 734 "DFC_Layer_GENELBSig" 735 "DFC_Layer_GENELMax" 736 "DFC_Layer_GENELMin" 737 "DFC_Layer_GENELNpl" 738 "DFC_Layer_GENELSig" 739 "DFC_Layer_GENHTBMax" 740 "DFC_Layer_GENHTBMin" 741 "DFC_Layer_GENHTBNpl" 742 "DFC_Layer_GENHTBSig" 743 "DFC_Layer_GENHTMax" 744 "DFC_Layer_GENHTMin" 745 "DFC_Layer_GENHTNpl" 746 "DFC_Layer_GENHTSig" 747 "DFC_Layer_GENKOMMMax" 748 "DFC_Layer_GENKOMMMin" 749 "DFC_Layer_GENKOMMNpl" 750 "DFC_Layer_GENKOMMSig" 751 "DFC_Layer_GENMECHMax" 752 "DFC_Layer_GENMECHMin" 753 "DFC_Layer_GENMECHNpl" 754 "DFC_Layer_GENMECHSig" 755 "DFC_Layer_GENMax" 756 "DFC_Layer_GENMin" 757 "DFC_Layer_GENNpl" 758 "DFC_Layer_GENREGUPLMax" 759 "DFC_Layer_GENREGUPLMin" 760 "DFC_Layer_GENREGUPLNpl" 761 "DFC_Layer_GENREGUPLSig" 762 "DFC_Layer_GENSig" 763 "DFC_Layer_GENUPLMax" 764 "DFC_Layer_GENUPLMin" 765 "DFC_Layer_GENUPLNpl" 766 "DFC_Layer_GENUPLSig" 767 "DFC_Layer_IBS1Max" 768 "DFC_Layer_IBS1Min" 769 "DFC_Layer_IBS1Npl" 770 "DFC_Layer_IBS1Sig" 771 "DFC_Layer_IBS2Max" 772 "DFC_Layer_IBS2Min" 773 "DFC_Layer_IBS2Npl" 774 "DFC_Layer_IBS2Sig" 775 "DFC_Layer_IBS3Max" 776 "DFC_Layer_IBS3Min" 777 "DFC_Layer_IBS3Npl" 778 "DFC_Layer_IBS3Sig" 779 "DFC_Layer_MANDETEKMax" 780 "DFC_Layer_MANDETEKMin" 781 "DFC_Layer_MANDETEKNpl" 782 "DFC_Layer_MANDETEKSig" 783 "DFC_Layer_NDR1Max" 784 "DFC_Layer_NDR1Min" 785 "DFC_Layer_NDR1Npl" 786 "DFC_Layer_NDR1Sig" 787 "DFC_Layer_NDR2Max" 788 "DFC_Layer_NDR2Min" 789 "DFC_Layer_NDR2Npl" 790 "DFC_Layer_NDR2Sig" 791 "DFC_Layer_NGLERNMax" 792 "DFC_Layer_NGLERNMin" 793 "DFC_Layer_NGLERNNpl" 794 "DFC_Layer_NGLERNSig" 795 "DFC_Layer_PMBATTMax" 796 "DFC_Layer_PMBATTMin" 797 "DFC_Layer_PMBATTNpl" 798 "DFC_Layer_PMBATTSig" 799 "DFC_Layer_PMBNMax" 800 "DFC_Layer_PMBNMin" 801 "DFC_Layer_PMBNNpl" 802 "DFC_Layer_PMBNSig" 803 "DFC_Layer_PMRUHVERLMax" 804 "DFC_Layer_PMRUHVERLMin" 805 "DFC_Layer_PMRUHVERLNpl" 806 "DFC_Layer_PMRUHVERLSig" 807 "DFC_Layer_QLTMax" 808 "DFC_Layer_QLTMin" 809 "DFC_Layer_QLTNpl" 810 "DFC_Layer_QLTSig" 811 "DFC_Layer_TOENSMax" 812 "DFC_Layer_TOENSMin" 813 "DFC_Layer_TOENSNpl" 814 "DFC_Layer_TOENSSig" 815 "DFC_MonLimCurr" 816 "DFC_MonLimLead" 817 "DFC_MonLimSet" 818 "DFC_NSCDsNOxOfsMax" 819 "DFC_NSCDsNOxOfsMin" 820 "DFC_NSCDsNOxPlausMin" 821 "DFC_NoCat2DsNOxOfsMax" 822 "DFC_NoCat2DsNOxOfsMin" 823 "DFC_NoCat2DsNOxPlausMin" 824 "DFC_PCVNoStrt" 825 "DFC_RailPGradMon" 826 "DFC_SCRPODPresBuildUp" 827 "DFC_AFSDrftIdlAdjVal" 828 "DFC_AFSDrftLdAdjVal" 829 "DFC_AdcIADC0Cal" 830 "DFC_AdcIADC0Conv" 831 "DFC_AdcIADC1Cal" 832 "DFC_AdcIADC1Conv" 833 "DFC_CmbChbMisfireMax_0" 834 "DFC_CmbChbMisfireMax_1" 835 "DFC_CmbChbMisfireMax_2" 836 "DFC_CmbChbMisfireMax_3" 837 "DFC_CmbChbMisfireMax_4" 838 "DFC_CmbChbMisfireMax_5" 839 "DFC_CmbChbMisfireMul" 840 "DFC_EGRVlvLPOfsNeutr" 841 "DFC_EGRVlvOfsNeutr" 842 "DFC_FMAErrModMax" 843 "DFC_FMAErrModMin" 844 "DFC_FlSysTnkLo" 845 "DFC_GbxNPosPlaus" 846 "DFC_I14229_ROETst_Appl" 847 "DFC_I14229_ROETst_Netw" 848 "DFC_I14229_ROE_BufFull" 849 "DFC_IVAdjDiaIVAdj" 850 "DFC_IVAdjIVA_0" 851 "DFC_IVAdjIVA_1" 852 "DFC_IVAdjIVA_2" 853 "DFC_IVAdjIVA_3" 854 "DFC_IVAdjIVA_4" 855 "DFC_IVAdjIVA_5" 856 "DFC_IVPSplyDCDCOff_0" 857 "DFC_IVPSplyDCDCOff_1" 858 "DFC_IVPSplyDCDCOff_2" 859 "DFC_IVPSplyDCDCOff_3" 860 "DFC_InjCtlAdjQntEEPCS" 861 "DFC_LSUSPISig" 862 "DFC_Layer_Dummy" 863 "DFC_NplEnvPSensPPFltDiff" 864 "DFC_NplPresSensPPFltDiff" 865 "DFC_OilLvlPlaus" 866 "DFC_OilTOutLvl" 867 "DFC_PCVfacAdaptMax" 868 "DFC_PCVfacAdaptMin" 869 "DFC_SensFrzPPFltUs" 870 "DFC_SensMonUTnkLvl" 871 "DFC_T15Sig" 872 "DFC_AirCtlRmpTOut" 873 "DFC_BrkPPlaus" 874 "DFC_CEngDsTDynTst" 875 "DFC_EEPEraseErr" 876 "DFC_EEPRdErr" 877 "DFC_EEPWrErr" 878 "DFC_EGRVlvJamVlvClsd" 879 "DFC_EGRVlvJamVlvOpn" 880 "DFC_EGRVlvLPJamVlvClsd" 881 "DFC_EGRVlvLPJamVlvOpn" 882 "DFC_EGRVlvLPLgTDrft" 883 "DFC_EGRVlvLPOfsLrnJamVlv" 884 "DFC_EGRVlvLPShTDrft" 885 "DFC_EGRVlvLgTDrft" 886 "DFC_EGRVlvOfsLrnJamVlv" 887 "DFC_EGRVlvShTDrft" 888 "DFC_EngICO" 889 "DFC_EpmCaSI1ErrSig" 890 "DFC_EpmCaSI1NoSig" 891 "DFC_EpmCaSI1OfsErr" 892 "DFC_EpmCrSErrSig" 893 "DFC_EpmCrSNoSig" 894 "DFC_IVPlausComprTst" 895 "DFC_IVPlausRunUpTst" 896 "DFC_InjCrvShOffTst" 897 "DFC_LayerEnSavModProd" 898 "DFC_LayerEnSavModRep" 899 "DFC_LayerEnSavModShip" 900 "DFC_MRlyErlyOpng" 901 "DFC_MRlyStk" 902 "DFC_MeUnActrTst" 903 "DFC_MoCADCCmp" 904 "DFC_MoCADCTst" 905 "DFC_MoCADCVltgRatio" 906 "DFC_MoCComErrCnt" 907 "DFC_MoCComSPI" 908 "DFC_MoCROMErrXPg" 909 "DFC_MoCSOPHwNoRdy" 910 "DFC_MoCSOPLoLi" 911 "DFC_MoCSOPMM" 912 "DFC_MoCSOPTimeOut" 913 "DFC_MoCSOPUpLi" 914 "DFC_MoFAPP" 915 "DFC_MoFESpd" 916 "DFC_MoFInjDatPhi" 917 "DFC_MoFInjDatQnt" 918 "DFC_MoFInjQnt" 919 "DFC_MoFMode1PoI1" 920 "DFC_MoFMode1PoI2" 921 "DFC_MoFMode2PoI1" 922 "DFC_MoFMode2PoI2" 923 "DFC_MoFOvR" 924 "DFC_MoFQntCor" 925 "DFC_MoFRailP" 926 "DFC_MoFTrqCmp" 927 "DFC_NSCDsHtrSetP" 928 "DFC_NoCat2DsHtrSetP" 929 "DFC_PCVActrTst" 930 "DFC_PhyModNonMonMapNpl" 931 "DFC_RailHpTst" 932 "DFC_RailPOfsTstMax" 933 "DFC_RailPOfsTstMin" 934 "DFC_SIA_E1max" 935 "DFC_SIA_E1min" 936 "DFC_SIA_E1npl" 937 "DFC_SIA_E1sig" 938 "DFC_SIA_E2max" 939 "DFC_SIA_E2min" 940 "DFC_SIA_E2npl" 941 "DFC_SIA_E2sig" 942 "DFC_SIA_E3max" 943 "DFC_SIA_E3min" 944 "DFC_SIA_E3npl" 945 "DFC_SIA_E3sig" 946 "DFC_SIA_E4max" 947 "DFC_SIA_E4min" 948 "DFC_SIA_E4npl" 949 "DFC_SIA_E4sig" 950 "DFC_SWReset_0" 951 "DFC_SWReset_1" 952 "DFC_SWReset_2" 953 "DFC_ShtrAKKMax" 954 "DFC_ShtrAKKMin" 955 "DFC_ShtrAKKNpl" 956 "DFC_ShtrPKKMax" 957 "DFC_StopCntTmr" 958 "DFC_ThrVlvMon" 959 "DFC_VSwVlvJamVlv" 960 "DFC_VSwVlvLgTDrft" 961 "DFC_VSwVlvOfsLrnJamVlv" 962 "DFC_VSwVlvOfsNeutr" 963 "DFC_VSwVlvShTDrft" 964 "DFC_VSwVlvSpgDef" DEFAULT_VALUE "---" /end COMPU_VTAB
/begin COMPU_METHOD DFES_OneToOne "" RAT_FUNC "%6.0" "-" COEFFS 0 1 0 0 0 1 /end COMPU_METHOD
/begin COMPU_METHOD DINH_FIdVerb "" TAB_VERB "%2.1" "-" COMPU_TAB_REF DINH_FIdVerb /end COMPU_METHOD
/begin COMPU_VTAB DINH_FIdVerb "" TAB_VERB 689 0 "FId_Unused" 1 "FId_InhibitAlways" 2 "FId_CoordALS" 3 "FId_CoordFBC" 4 "FId_CoordTAA" 5 "FId_CoordZFC" 6 "FId_IVPlausRunUpTstActv" 7 "FId_RailHpTstActv" 8 "FId_ACCIRevErr" 9 "FId_ACCRevErr" 10 "FId_ACCtlTEngErr" 11 "FId_ACCtlTGearbxErr" 12 "FId_ACCtlVehVErr" 13 "FId_ACCtl_AC" 14 "FId_ACCtl_Fan" 15 "FId_ACCtlstTrailer" 16 "FId_AFS" 17 "FId_AFSActrTst" 18 "FId_AFSDrftMaxLim" 19 "FId_AFSFrzAirMs" 20 "FId_AFSPlOffsDrft" 21 "FId_AFSPlSetyDrft" 22 "FId_AFSSRC" 23 "FId_AFSSysErr" 24 "FId_AFSTPer" 25 "FId_AFStCond" 26 "FId_AFStEnv" 27 "FId_AGSDem_SelectParameter" 28 "FId_APP1FinalDef" 29 "FId_APP1ProvDef" 30 "FId_APP1SRCHigh" 31 "FId_APP1SigPath" 32 "FId_APP2FinalDef" 33 "FId_APP2ProvDef" 34 "FId_APP2SRCHigh" 35 "FId_APP2SigPath" 36 "FId_APPBrkDef" 37 "FId_APPBrkTrq" 38 "FId_APPNTP" 39 "FId_APPSyncChk" 40 "FId_APPSyncDef" 41 "FId_APPSyncProvDef" 42 "FId_APPSyncSigProv" 43 "FId_APPVel" 44 "FId_APProvDef" 45 "FId_ASDdc" 46 "FId_ASDrfLAD2" 47 "FId_ASModAFS" 48 "FId_ASModAFSTCmpr" 49 "FId_ASModEGRVlvLrn" 50 "FId_ASModOxiC" 51 "FId_ASModPipe" 52 "FId_ASModPipeSlw" 53 "FId_ASModPresCalc" 54 "FId_ASModPresEnv" 55 "FId_ASModStrt" 56 "FId_ASModSwtOffEng" 57 "FId_ASModSwtOffExhMnfLP" 58 "FId_ASModSwtOffIndVol" 59 "FId_ASModT20" 60 "FId_ASModTrbn" 61 "FId_AccPedNMaxLim" 62 "FId_AccPedNMinLim" 63 "FId_AccPedTrqLim" 64 "FId_AdapNSCDs" 65 "FId_AdcIADC0" 66 "FId_AdcIADC1" 67 "FId_AftRun" 68 "FId_AirCSwt" 69 "FId_AirCtl" 70 "FId_AirCtlACCorr" 71 "FId_AirCtlBrk" 72 "FId_AirCtlBstPresCor" 73 "FId_AirCtlCmpntActv" 74 "FId_AirCtlCorAltEOM" 75 "FId_AirCtlDyn" 76 "FId_AirCtlEGR" 77 "FId_AirCtlEGRPreCtl" 78 "FId_AirCtlGear" 79 "FId_AirCtlGovDvt" 80 "FId_AirCtlGovLPDvt" 81 "FId_AirCtlInvEGRMod" 82 "FId_AirCtlLP" 83 "FId_AirCtlLPACCor" 84 "FId_AirCtlLPBstPresCor" 85 "FId_AirCtlLPCmpntActv" 86 "FId_AirCtlLPGear" 87 "FId_AirCtlLPPFltEGRRed" 88 "FId_AirCtlLPStrgCor" 89 "FId_AirCtlLPVehVCor" 90 "FId_AirCtlPFltEGRRed" 91 "FId_AirCtlStrg" 92 "FId_AirCtlTVA" 93 "FId_AirCtlTVACtl" 94 "FId_AirCtlmDesVehCorr" 95 "FId_AirSysTst" 96 "FId_BattUFrzVal" 97 "FId_BattUReplVal" 98 "FId_BattUSRC" 99 "FId_BrkP" 100 "FId_BrkPFrzVal" 101 "FId_BrkPReplVal" 102 "FId_BrkPSens" 103 "FId_BusDiag_stFadeOut" 104 "FId_CEngDsTDynTst" 105 "FId_CEngDsTFrzVal" 106 "FId_CEngDsTModel" 107 "FId_CEngDsTRdClnt" 108 "FId_CEngDsTRplVal" 109 "FId_CEngDsTSS" 110 "FId_Clth" 111 "FId_ClthCAN" 112 "FId_CmbChb" 113 "FId_CoEngNrml2Strt" 114 "FId_CoEngPthClsEGR" 115 "FId_CoEngPthClsThr" 116 "FId_CoEngPthCylOff" 117 "FId_CoEngPthETZr" 118 "FId_CoEngPthFlQnt" 119 "FId_CoEngPthInjVlvOff" 120 "FId_CoEngPthLpSysOff" 121 "FId_CoEngPthRPMin" 122 "FId_CoEngPthTrqZr" 123 "FId_CoEngSoftShOff" 124 "FId_CoEngStop" 125 "FId_CoSCR_CAN" 126 "FId_CoTS_SwtOff" 127 "FId_CoVMDComErr" 128 "FId_CoVMvBd" 129 "FId_CoVehPrpLimErr" 130 "FId_ComAPP" 131 "FId_ComBrkDef" 132 "FId_ComClth" 133 "FId_ComCoEng" 134 "FId_ComCtrSecInt" 135 "FId_ComCtrSecIntTo" 136 "FId_ComDKGIntv" 137 "FId_ComDscAck1" 138 "FId_ComDscAck2" 139 "FId_ComDscAck3" 140 "FId_ComDscTrqIntv" 141 "FId_ComEngDem" 142 "FId_ComGbxAck1" 143 "FId_ComGbxAck2" 144 "FId_ComGbxAck3" 145 "FId_ComGbxTrqIntv" 146 "FId_ComInjDu1" 147 "FId_ComInjDu2" 148 "FId_ComInjVlv" 149 "FId_ComMSA" 150 "FId_ComNDynDispOff" 151 "FId_ComNGbxOut" 152 "FId_ComPCBSPFlt" 153 "FId_ComRCtrPwrSpCos" 154 "FId_ComRpmRduc" 155 "FId_ComSLck" 156 "FId_ComStBrkPedal" 157 "FId_ComStDDEQl" 158 "FId_ComStDrvDirDes" 159 "FId_ComStEnrgPwrMnmt" 160 "FId_ComStGbxModDemFAS" 161 "FId_ComStGrip" 162 "FId_ComStLPCOff" 163 "FId_ComStLckGbxDemQl" 164 "FId_ComStRTrqPTQl" 165 "FId_ComStShiftPdl" 166 "FId_ComStShutOffPSP" 167 "FId_ComStTerminal" 168 "FId_ComStTrq" 169 "FId_ComStTrqGbxQl" 170 "FId_ComStTrqWhlStbQl" 171 "FId_ComStVehDrvCond" 172 "FId_ComStnEngQl" 173 "FId_ComStrtLck" 174 "FId_ComTEng" 175 "FId_ComTOilEng" 176 "FId_ComThrVlv" 177 "FId_ComTrqCootd" 178 "FId_ComTrqWhl" 179 "FId_ComTrqWhlDes" 180 "FId_ComUBatt" 181 "FId_ComVolTotFlCons" 182 "FId_ComnEng" 183 "FId_ComnGbxOut" 184 "FId_ComnSetPLo" 185 "FId_ComnTSC" 186 "FId_CompEnv" 187 "FId_ComrTrq" 188 "FId_ComrTrqPT" 189 "FId_ComrVirtAPP" 190 "FId_ComrWaterVlv" 191 "FId_ComrtrqDifftl" 192 "FId_ComstGear" 193 "FId_ComvVeh" 194 "FId_ConvLdNTrbnCan" 195 "FId_ConvLdOilTemp" 196 "FId_ConvLdTrqLdCan" 197 "FId_ConvLdVel" 198 "FId_CrCUILvr" 199 "FId_CrCtlCan" 200 "FId_CrCtlCanAT" 201 "FId_CrCtlEcu" 202 "FId_Cy100Dev1" 203 "FId_Cy100Dev2" 204 "FId_DCSRmpShOff" 205 "FId_DCSShOff" 206 "FId_DIOnumChip1Cj945" 207 "FId_DIUMPRGenDenom1" 208 "FId_DIUMPRGenDenom2" 209 "FId_DIUMPRGenDenom3" 210 "FId_DIUMPRIgn" 211 "FId_DSMIVAdjNVCEna" 212 "FId_DSMWarmUpCycle" 213 "FId_DStgyMon" 214 "FId_DevLibActrPrt" 215 "FId_DewDetHtgDel" 216 "FId_DewDetstSrvTstDem" 217 "FId_DiaDem_SelectParameter" 218 "FId_DynChkPPFltDiff" 219 "FId_ECBVlvFrzVal" 220 "FId_ECBVlvReplVal" 221 "FId_ECBVlvSS" 222 "FId_EGRClg" 223 "FId_EGRVlvFrzVal" 224 "FId_EGRVlvGovOn" 225 "FId_EGRVlvJamVlv" 226 "FId_EGRVlvLPFrzVal" 227 "FId_EGRVlvLPGovOn" 228 "FId_EGRVlvLPJamVlv" 229 "FId_EGRVlvLPOfsLrnInhib" 230 "FId_EGRVlvLPReplVal" 231 "FId_EGRVlvLPSSpMon" 232 "FId_EGRVlvOfsLrnInhib" 233 "FId_EGRVlvReplVal" 234 "FId_EGRVlvSSpMon" 235 "FId_EGSysMaxTOxiPre" 236 "FId_EGSysMaxTOxiPreRgn" 237 "FId_EGSysMaxTPre" 238 "FId_EGSysMaxTPreRgn" 239 "FId_EMCtl" 240 "FId_ETClbCorActv" 241 "FId_ETCtlAirCtl" 242 "FId_ETCtlInr" 243 "FId_ETCtlOutr" 244 "FId_Empt" 245 "FId_EngDaClntTemp" 246 "FId_EngDemPFltErr" 247 "FId_EngDemPFltOvldErr" 248 "FId_EngDemTrqLimErr" 249 "FId_EngDemTrqLimErr1" 250 "FId_EngDemTrqLimErr2" 251 "FId_EngDemTrqLimErr3" 252 "FId_EngDemTrqLimErr4" 253 "FId_EngPrtEnvP" 254 "FId_EngPrtFWOscInactv" 255 "FId_EngPrtNLimErr" 256 "FId_EngPrtT31" 257 "FId_EngPrtstTrailer" 258 "FId_EnhSRCPPFltDiff" 259 "FId_EnhSRCT1ExhTMon" 260 "FId_EnhSRCT2ExhTMon" 261 "FId_EnhSRCT3ExhTMon" 262 "FId_EnvPFrzVal" 263 "FId_EnvPModel" 264 "FId_EnvPNplPPFltDiff" 265 "FId_EnvPRplVal" 266 "FId_EnvPSS" 267 "FId_EnvTCANFrzVal" 268 "FId_EnvTCANRplVal" 269 "FId_EnvTModel" 270 "FId_EnvTSS" 271 "FId_EpmBCr" 272 "FId_EpmCaSAdapCaSI1" 273 "FId_EpmCaSDiag" 274 "FId_EpmCaSOfsDiagCaSI1" 275 "FId_EpmCaSOfsErrCaSI1" 276 "FId_EpmCaSSegCor" 277 "FId_EpmCrSDiag" 278 "FId_EpmCrSDiagVeh" 279 "FId_EpmOpMode_InjLock" 280 "FId_EpmRRSFaultCheck" 281 "FId_EpmRRSRdCheck" 282 "FId_ExhTMonCondPlaus" 283 "FId_ExhTMonPlausTemp" 284 "FId_FBC" 285 "FId_FBCMonI" 286 "FId_FMALamO2Valid" 287 "FId_FMASwtOff1" 288 "FId_FMASwtOff3" 289 "FId_FanCtl" 290 "FId_FanCtl2" 291 "FId_FanCtlCor" 292 "FId_FanCtlCor2" 293 "FId_FanCtlnEFan" 294 "FId_FanCtlstTrailer" 295 "FId_FanTraOil" 296 "FId_FlFCBSDef" 297 "FId_FlFltDsPFrzVal" 298 "FId_FlFltDsPReplVal" 299 "FId_FlFltUsPFrzVal" 300 "FId_FlFltUsPReplVal" 301 "FId_FlSysDens" 302 "FId_FlSysTnkLoEEP" 303 "FId_FlSysTnkLoInfo" 304 "FId_FrzPrtTrqDfftl" 305 "FId_FrzValAbsUPmpP" 306 "FId_FrzValCANAbsUPmpP" 307 "FId_FrzValCANUCatUsT" 308 "FId_FrzValPPFltDiff" 309 "FId_FrzValPPFltUs" 310 "FId_FrzValTOxiCatUs" 311 "FId_FrzValTPFltUs" 312 "FId_FrzValTTrbnUs" 313 "FId_FrzValUCatUsT" 314 "FId_FrzValUTnkLvl" 315 "FId_FuelTCTS" 316 "FId_FuelTFlSys" 317 "FId_FuelTFrzVal" 318 "FId_FuelTReplVal" 319 "FId_GSHDem_SelectParameter" 320 "FId_GbxNPosPWM" 321 "FId_GlbDaLSumvXPtd" 322 "FId_GlwCtl1" 323 "FId_GlwCtlDrWghSeat" 324 "FId_GlwCtlTRadio" 325 "FId_GlwEcuGPCMFaultInfoTstLck" 326 "FId_GlwEcuGPCMInfoTstLck" 327 "FId_HLSDemDeclGradLim" 328 "FId_HLSDemSetPLoDrvAwy" 329 "FId_HLSDemUndrBrk" 330 "FId_HLSDemtrqConv" 331 "FId_HsLnChkPPFltDiff" 332 "FId_I14229Appl_RC" 333 "FId_ISCnTrbnMod" 334 "FId_ISCtrqConv" 335 "FId_ISCvBd" 336 "FId_IVDiaTst" 337 "FId_IVPSplyDCDCOff" 338 "FId_IVPlausComprTst" 339 "FId_IVPlausRunUpTst" 340 "FId_InhibitNever" 341 "FId_InjCrvCoErr" 342 "FId_InjCrvCylOffs" 343 "FId_InjCrvDisblPoI1" 344 "FId_InjCrvDisblPoI2" 345 "FId_InjCrvPiI1VehCor" 346 "FId_InjCrvPiI2VehCor" 347 "FId_InjCrvPoIOvrLim" 348 "FId_InjCrvShOffTst" 349 "FId_InjUnStrtPlsBlk" 350 "FId_InjVlvBnk0ShutOff" 351 "FId_InjVlvBnk1ShutOff" 352 "FId_InjVlvBnk2ShutOff" 353 "FId_InjVlvBnk3ShutOff" 354 "FId_InjVlvCyl0ShutOff" 355 "FId_InjVlvCyl1ShutOff" 356 "FId_InjVlvCyl2ShutOff" 357 "FId_InjVlvCyl3ShutOff" 358 "FId_InjVlvCyl4ShutOff" 359 "FId_InjVlvCyl5ShutOff" 360 "FId_InjVlvCyl6ShutOff" 361 "FId_InjVlvCyl7ShutOff" 362 "FId_InjVlvPrep" 363 "FId_InjVlvPresMin" 364 "FId_InjVlvPresMinRun" 365 "FId_InjVlvPresMinStrt" 366 "FId_LSUAdap0" 367 "FId_LSUClbSched" 368 "FId_LSUCmpChk0" 369 "FId_LSUCtl0" 370 "FId_LSUDewRls0" 371 "FId_LSUDynChk0" 372 "FId_LSUHtCoup0" 373 "FId_LSUHtrPS0" 374 "FId_LSUIPOpnLdTst0" 375 "FId_LSUIsolChk0" 376 "FId_LSULoBatt0" 377 "FId_LSUMon0" 378 "FId_LSUO20" 379 "FId_LSUO2Clb0" 380 "FId_LSUO2SRC0" 381 "FId_LSUPlausChk0" 382 "FId_LSURi0" 383 "FId_LSURiClb0" 384 "FId_LSUShCir0" 385 "FId_LSUUNVGOpnLdTst0" 386 "FId_LSUlsu0" 387 "FId_Layer_ACFZGL11" 388 "FId_Layer_ACFZGQ11" 389 "FId_Layer_AQUERABS11" 390 "FId_Layer_ATEMPRELATIVZEIT" 391 "FId_Layer_BATTCLASS" 392 "FId_Layer_BEDIENUNG_MSA" 393 "FId_Layer_CANErr" 394 "FId_Layer_CODIERUNG_PM" 395 "FId_Layer_CRASHABSCHALTUNG" 396 "FId_Layer_DIENSTE_19" 397 "FId_Layer_FAHRZEUGTYP" 398 "FId_Layer_FltHtg" 399 "FId_Layer_FltMng_Sig1" 400 "FId_Layer_FltMng_Sig2" 401 "FId_Layer_GESCHWINDIGKEIT" 402 "FId_Layer_GETRIEBEDATEN" 403 "FId_Layer_GETRIEBEDATEN_2" 404 "FId_Layer_KILOMETERSTAND" 405 "FId_Layer_KLEMMENSTATUS" 406 "FId_Layer_LENKRADWINKEL" 407 "FId_Layer_LPC" 408 "FId_Layer_MANDETEK" 409 "FId_Layer_MSACANErr" 410 "FId_Layer_MSAVAdapt" 411 "FId_Layer_MSAVDiag" 412 "FId_Layer_STANDVERBRAUCHER" 413 "FId_Layer_STATDSC" 414 "FId_Layer_STATESEAT" 415 "FId_Layer_STATGANGRUECKWAERTS" 416 "FId_Layer_STATZVKLAPPEN" 417 "FId_Layer_STAT_ANHAENGER" 418 "FId_Layer_STAT_EKP" 419 "FId_Layer_UHRZEIT_DATUM" 420 "FId_Layer_ULCP" 421 "FId_Layer_VCAN11" 422 "FId_Layer_VERBRAUCHER" 423 "FId_Layer_WAERMESTROMKLIMA" 424 "FId_LubmOil" 425 "FId_MeUnActrTst" 426 "FId_MeUnFrzI" 427 "FId_MeUnRot" 428 "FId_MetCtl" 429 "FId_NSCDsAdapEep" 430 "FId_NSCDsCmpChk" 431 "FId_NSCDsNOx" 432 "FId_NSCDsOvrRunPlaus" 433 "FId_NSCDsRdy" 434 "FId_NSCDsSensDia" 435 "FId_NSCDsTO" 436 "FId_NoCat2DsAdap" 437 "FId_NoCat2DsAdapEep" 438 "FId_NoCat2DsCmpChk" 439 "FId_NoCat2DsNOx" 440 "FId_NoCat2DsOvrRunPlaus" 441 "FId_NoCat2DsRdy" 442 "FId_NoCat2DsSensDia" 443 "FId_NoCat2DsTO" 444 "FId_NoPresCtl" 445 "FId_NplPresSensPPFltDiff" 446 "FId_NplTOxiCatUs" 447 "FId_NplTPFltUs" 448 "FId_OilPLmpVOff" 449 "FId_OilPSwmpRplVal" 450 "FId_PCBSDef" 451 "FId_PCBSPFltDef" 452 "FId_PCR" 453 "FId_PCRCByVlvOff" 454 "FId_PCRClthActv" 455 "FId_PCRCmpntActv" 456 "FId_PCRCmpntActvLP" 457 "FId_PCRExtnLimActr" 458 "FId_PCRGovDvt" 459 "FId_PCRGovDvtLP" 460 "FId_PCRLP" 461 "FId_PCROfsRls" 462 "FId_PCRPFltPresCor" 463 "FId_PCRT20" 464 "FId_PCRTrbCh" 465 "FId_PCVActrTst" 466 "FId_PCVFrzI" 467 "FId_PCVNoStrt" 468 "FId_PCVPwrStgTst" 469 "FId_PFltAirSysFail" 470 "FId_PFltChar" 471 "FId_PFltComLSum" 472 "FId_PFltDstr" 473 "FId_PFltEngPrtRgnMon" 474 "FId_PFltLckRgnErr" 475 "FId_PFltLckRgnFl" 476 "FId_PFltLckRgnOilDil" 477 "FId_PFltLdAshCor" 478 "FId_PFltLdAshCorErr" 479 "FId_PFltLdIniAftSuc" 480 "FId_PFltLdNOxEng" 481 "FId_PFltLdO2Aprx" 482 "FId_PFltLdSimRgnThr" 483 "FId_PFltOvldHealInhRn" 484 "FId_PFltOvldHealTrqLm" 485 "FId_PFltPOpBrk" 486 "FId_PFltPOpClth" 487 "FId_PFltPOpGearDet" 488 "FId_PFltPOpSpdVeh" 489 "FId_PFltPOpTempAir" 490 "FId_PFltPOpTempClnt" 491 "FId_PFltPOpVltgBatt" 492 "FId_PFltPoI1Fail" 493 "FId_PFltPoI2Fail" 494 "FId_PFltPresPlausProj" 495 "FId_PFltRgnChngPar" 496 "FId_PFltRgnNoSucDet" 497 "FId_PFltRgnNumErrLck" 498 "FId_PFltRgnNumPFltErr" 499 "FId_PFltRgnSuc" 500 "FId_PFltSimOn" 501 "FId_PFltSysErr2Can" 502 "FId_PFltSysFail" 503 "FId_PFltTOxiPreDiff" 504 "FId_PFltTPreDiff" 505 "FId_PIntkVUsEnvPPls" 506 "FId_PIntkVUsFrzVal" 507 "FId_PIntkVUsRplVal" 508 "FId_PTCltDKG" 509 "FId_PTGripDebPtd" 510 "FId_PTTrqRatCANPtd" 511 "FId_PhyModPCRCorr" 512 "FId_PlausTTrbnUs" 513 "FId_PresBuildUp" 514 "FId_PresCtl" 515 "FId_PresRdc" 516 "FId_PresSensFrzPPFltUs" 517 "FId_QWCCTSDef" 518 "FId_QWCFTSDef" 519 "FId_QWCOff" 520 "FId_RadShtCTS" 521 "FId_RadShtConsum" 522 "FId_RadShtEGS" 523 "FId_RadShtEnvT" 524 "FId_RadShtstTrailer" 525 "FId_RailCPCtlMeUnMode" 526 "FId_RailCPCtlPCVMode" 527 "FId_RailCtlMode" 528 "FId_RailFuelTErr" 529 "FId_RailHpTst" 530 "FId_RailMeUn0Blk" 531 "FId_RailMeUn0Rls" 532 "FId_RailMeUn1Blk" 533 "FId_RailMeUn1Rls" 534 "FId_RailMeUn22Blk" 535 "FId_RailMeUn22Rls" 536 "FId_RailMeUn2Blk" 537 "FId_RailMeUn2Rls" 538 "FId_RailMeUn3Blk" 539 "FId_RailMeUn3Rls" 540 "FId_RailMeUn42Blk" 541 "FId_RailMeUn42Rls" 542 "FId_RailMeUn4Blk" 543 "FId_RailMeUn4Rls" 544 "FId_RailMeUn5Blk" 545 "FId_RailMeUn5Rls" 546 "FId_RailMeUnClsdShutOff" 547 "FId_RailMeUnCtlMode" 548 "FId_RailMeUnCtlUpLim" 549 "FId_RailPCV0Blk" 550 "FId_RailPCV0Rls" 551 "FId_RailPCV1Blk" 552 "FId_RailPCV1Rls" 553 "FId_RailPCV22Blk" 554 "FId_RailPCV22Rls" 555 "FId_RailPCV2Blk" 556 "FId_RailPCV2Rls" 557 "FId_RailPCV3Blk" 558 "FId_RailPCV3Rls" 559 "FId_RailPCV42Blk" 560 "FId_RailPCV42Rls" 561 "FId_RailPCV4Blk" 562 "FId_RailPCV4Rls" 563 "FId_RailPCVCtlMode" 564 "FId_RailPCVCtlUpLim" 565 "FId_RailPFrzVal" 566 "FId_RailPMonStrt" 567 "FId_RailPSS" 568 "FId_RailPSubsVal" 569 "FId_RailSetPointLim" 570 "FId_RailSetPointRed" 571 "FId_RailSetPointVehCor" 572 "FId_ReFl" 573 "FId_ReplValTPFltUs" 574 "FId_RplValAbsUPmpP" 575 "FId_RplValCANAbsUPmpP" 576 "FId_RplValCANUCatUsT" 577 "FId_RplValPPFltDiff" 578 "FId_RplValPPFltUs" 579 "FId_RplValTOxiCatUs" 580 "FId_RplValTTrbnUs" 581 "FId_RplValUCatUsT" 582 "FId_RplValUTnkLvl" 583 "FId_SCRChkNOxEff" 584 "FId_SCRPODPresBuildUp" 585 "FId_SRCFlwRstn" 586 "FId_SSMonFlFltDsP" 587 "FId_SSMonFlFltUsP" 588 "FId_SSPIntkVUs" 589 "FId_SSTOxiCatUs" 590 "FId_SSTPFltUs" 591 "FId_SSUCatUsT" 592 "FId_SSUPmpP" 593 "FId_SSUTnkT" 594 "FId_SensAdapTPFltUs" 595 "FId_StAPmpEna" 596 "FId_StBy" 597 "FId_SubsValPrtTrqDfftl" 598 "FId_SubsValRatTrqDfftl" 599 "FId_T15" 600 "FId_T50Sig" 601 "FId_TAA" 602 "FId_TAFSFrzVal" 603 "FId_TAFSReplVal" 604 "FId_TAFSSRC" 605 "FId_TCACDsCANFrzVal" 606 "FId_TCACDsCANRplVal" 607 "FId_TCACDsFrzVal" 608 "FId_TCACDsModel" 609 "FId_TCACDsRplVal" 610 "FId_TCACDsSS" 611 "FId_TCPrtChrgPmpCtl" 612 "FId_TCPrtChrgPmpGov" 613 "FId_TCPrtChrgPmpHLSDem" 614 "FId_TCPrt_ChrgPmpDet" 615 "FId_TCPrtnSetTSC" 616 "FId_TCSRmpShOff" 617 "FId_TCSShOff" 618 "FId_TECUFrzVal" 619 "FId_TECURplVal" 620 "FId_TOxiCatUs" 621 "FId_TempSensFrzPPFltUs" 622 "FId_TempWait" 623 "FId_ThrVlvFrzVal" 624 "FId_ThrVlvMon" 625 "FId_ThrVlvRplVal" 626 "FId_ThrVlvSS" 627 "FId_TraAddAirCANPtd" 628 "FId_TraAddClntCANPtd" 629 "FId_TraDrvAway" 630 "FId_TraDrvAwayInactiv" 631 "FId_TraGearInfoDet" 632 "FId_TraGearInfoInfoCan" 633 "FId_TraGearInfoLevPos" 634 "FId_TraGearInfoLoRng" 635 "FId_TraGearInfoRTra" 636 "FId_TraGearInfoRevGear" 637 "FId_TraNmin" 638 "FId_TraOilTemp" 639 "FId_TraPrtGearCANPtd" 640 "FId_TraRtnIntfcASTIntv" 641 "FId_TraRtnIntfcIdlSetP" 642 "FId_TraSlip" 643 "FId_TraSpaCAN" 644 "FId_TraSpaEngSpd" 645 "FId_TraSpaVehV" 646 "FId_TraTrqLimErr" 647 "FId_TraTrqLos" 648 "FId_TraTrqRedLmpHmeDec" 649 "FId_TraTrqRedLmpHmeInc" 650 "FId_TraTrqRedPlausDecIntv" 651 "FId_TraTrqRedPlausIncIntv" 652 "FId_TrbChPWMIn" 653 "FId_UHCMonUHtrPL" 654 "FId_UHCMonUHtrTnk" 655 "FId_UHtrPLFrzValDia" 656 "FId_UHtrPLRplValDia" 657 "FId_UHtrPLSSDia" 658 "FId_UHtrTnkFrzValDia" 659 "FId_UHtrTnkRplValDia" 660 "FId_UHtrTnkSSDia" 661 "FId_UTnkLvlSensTst" 662 "FId_UTnkTFrzVal" 663 "FId_UTnkTFrzValCAN" 664 "FId_UTnkTRplVal" 665 "FId_UTnkTRplValCAN" 666 "FId_VMDTrqWhl" 667 "FId_VSwCtl" 668 "FId_VSwCtlVehCorr" 669 "FId_VSwVlvFrzVal" 670 "FId_VSwVlvGovOn" 671 "FId_VSwVlvJamVlv" 672 "FId_VSwVlvOfsLrnInhib" 673 "FId_VSwVlvRplVal" 674 "FId_VSwVlvSS" 675 "FId_VSwVlvSpgDiagInhib" 676 "FId_VehVReplVal" 677 "FId_Vtln" 678 "FId_ZFCClbActv" 679 "FId_ZFCCldCmbCham" 680 "FId_stAVSCoESLSU" 681 "Fid_ComnTSC" 682 "Fid_CustDiag_DiaDem_AT" 683 "Fid_CustDiag_DiaDem_MT" 684 "Fid_HLSDemHDC" 685 "Fid_IVActrTempRplVal" 686 "Fid_StSysStrtTipGbxDat" 687 "Fid_TraCanNeutral" 688 "Fid_WaHtShOffErr" DEFAULT_VALUE "---" /end COMPU_VTAB
/begin COMPU_METHOD DINH_OneToOne "" RAT_FUNC "%6.2" "-" COEFFS 0 1 0 0 0 1 /end COMPU_METHOD
/begin COMPU_METHOD DIUMPR_GroupVerb "" TAB_VERB "%6.3" "-" COMPU_TAB_REF DIUMPR_GroupVerb /end COMPU_METHOD
/begin COMPU_VTAB DIUMPR_GroupVerb "" TAB_VERB 9 0 "Catalyst_Bank1" 1 "Catalyst_Bank2" 2 "OxygenSensor_Bank1" 3 "OxygenSensor_Bank2" 4 "EGR_VVT" 5 "SecAirSys" 6 "EvpSys" 7 "Private" 8 "Unused" /end COMPU_VTAB
/begin COMPU_METHOD DIUMPR_l10km "" RAT_FUNC "%6.1" "km" COEFFS 0 1 0 0 0 10 /end COMPU_METHOD
/begin COMPU_METHOD DIUMPR_ti100ms "" RAT_FUNC "%6.3" "s" COEFFS 0 10 0 0 0 1 /end COMPU_METHOD
/begin COMPU_METHOD DSCHED_FIdExcCauseVerb "" TAB_VERB "%2.1" "-" COMPU_TAB_REF DSCHED_FIdExcCauseVerb /end COMPU_METHOD
/begin COMPU_VTAB DSCHED_FIdExcCauseVerb "" TAB_VERB 11 0 "No_exclusion" 1 "FId_InhibitAlways" 2 "FId_CoordALS" 3 "FId_CoordFBC" 4 "FId_CoordTAA" 5 "FId_CoordZFC" 6 "FId_IVPlausRunUpTstActv" 7 "FId_RailHpTstActv" 253 "NO_PRIO" 254 "MODE_IMPOSSIBLE" 255 "NO_RUN" DEFAULT_VALUE "---" /end COMPU_VTAB
/begin COMPU_METHOD DSCHED_FIdExcVerb "" TAB_VERB "%2.1" "-" COMPU_TAB_REF DSCHED_FIdExcVerb /end COMPU_METHOD
/begin COMPU_VTAB DSCHED_FIdExcVerb "" TAB_VERB 8 0 "FId_Unused" 1 "FId_InhibitAlways" 2 "FId_CoordALS" 3 "FId_CoordFBC" 4 "FId_CoordTAA" 5 "FId_CoordZFC" 6 "FId_IVPlausRunUpTstActv" 7 "FId_RailHpTstActv" DEFAULT_VALUE "---" /end COMPU_VTAB
/begin COMPU_METHOD DSCHED_FIdVerb "" TAB_VERB "%2.1" "-" COMPU_TAB_REF DSCHED_FIdVerb /end COMPU_METHOD
/begin COMPU_VTAB DSCHED_FIdVerb "" TAB_VERB 8 0 "FId_Unused" 1 "FId_InhibitAlways" 2 "FId_CoordALS" 3 "FId_CoordFBC" 4 "FId_CoordTAA" 5 "FId_CoordZFC" 6 "FId_IVPlausRunUpTstActv" 7 "FId_RailHpTstActv" DEFAULT_VALUE "---" /end COMPU_VTAB
/begin COMPU_METHOD DSCHED_RmpSlp "" RAT_FUNC "%6.2" "counts/s" COEFFS 0 1 0 0 0 5 /end COMPU_METHOD
/begin COMPU_METHOD DSCHED_StVerb "" TAB_VERB "%6.3" "-" COMPU_TAB_REF DSCHED_StVerb /end COMPU_METHOD
/begin COMPU_VTAB DSCHED_StVerb "" TAB_VERB 64 0 "____________________________" 2 "_____________________RawPerm" 4 "_________________Act________" 6 "_________________Act_RawPerm" 8 "_____________Lck____________" 10 "_____________Lck_____RawPerm" 12 "_____________Lck_Act________" 14 "_____________Lck_Act_RawPerm" 32 "_________Val________________" 34 "_________Val_________RawPerm" 36 "_________Val_____Act________" 38 "_________Val_____Act_RawPerm" 40 "_________Val_Lck____________" 42 "_________Val_Lck_____RawPerm" 44 "_________Val_Lck_Act________" 46 "_________Val_Lck_Act_RawPerm" 64 "____Perm____________________" 66 "____Perm_____________RawPerm" 68 "____Perm_________Act________" 70 "____Perm_________Act_RawPerm" 72 "____Perm_____Lck____________" 74 "____Perm_____Lck_____RawPerm" 76 "____Perm_____Lck_Act________" 78 "____Perm_____Lck_Act_RawPerm" 96 "____Perm_Val________________" 98 "____Perm_Val_________RawPerm" 100 "____Perm_Val_____Act________" 102 "____Perm_Val_____Act_RawPerm" 104 "____Perm_Val_Lck____________" 106 "____Perm_Val_Lck_____RawPerm" 108 "____Perm_Val_Lck_Act________" 110 "____Perm_Val_Lck_Act_RawPerm" 128 "Rdy_________________________" 130 "Rdy__________________RawPerm" 132 "Rdy______________Act________" 134 "Rdy______________Act_RawPerm" 136 "Rdy__________Lck____________" 138 "Rdy__________Lck_____RawPerm" 140 "Rdy__________Lck_Act________" 142 "Rdy__________Lck_Act_RawPerm" 160 "Rdy______Val________________" 162 "Rdy______Val_________RawPerm" 164 "Rdy______Val_____Act________" 166 "Rdy______Val_____Act_RawPerm" 168 "Rdy______Val_Lck____________" 170 "Rdy______Val_Lck_____RawPerm" 172 "Rdy______Val_Lck_Act________" 174 "Rdy______Val_Lck_Act_RawPerm" 192 "Rdy_Perm____________________" 194 "Rdy_Perm_____________RawPerm" 196 "Rdy_Perm_________Act________" 198 "Rdy_Perm_________Act_RawPerm" 200 "Rdy_Perm_____Lck____________" 202 "Rdy_Perm_____Lck_____RawPerm" 204 "Rdy_Perm_____Lck_Act________" 206 "Rdy_Perm_____Lck_Act_RawPerm" 224 "Rdy_Perm_Val________________" 226 "Rdy_Perm_Val_________RawPerm" 228 "Rdy_Perm_Val_____Act________" 230 "Rdy_Perm_Val_____Act_RawPerm" 232 "Rdy_Perm_Val_Lck____________" 234 "Rdy_Perm_Val_Lck_____RawPerm" 236 "Rdy_Perm_Val_Lck_Act________" 238 "Rdy_Perm_Val_Lck_Act_RawPerm" /end COMPU_VTAB
/begin COMPU_METHOD DSMDur_EvntSel_Verb "" TAB_VERB "%6.3" "-" COMPU_TAB_REF DSMDur_EvntSel_Verb /end COMPU_METHOD
/begin COMPU_VTAB DSMDur_EvntSel_Verb "" TAB_VERB 4 0 "NoCountEvent" 1 "DistanceEvents" 2 "TimeEvents" 4 "WarmUpCycleEvents" /end COMPU_VTAB
/begin COMPU_METHOD DSMDur_StDispl_Verb "" TAB_VERB "%6.3" "-" COMPU_TAB_REF DSMDur_StDispl_Verb /end COMPU_METHOD
/begin COMPU_VTAB DSMDur_StDispl_Verb "" TAB_VERB 3 0 "NotEnabled" 1 "CountingEnabled" 2 "ResetCondition" /end COMPU_VTAB
/begin COMPU_METHOD DSMRdy_Mode3ModeVerb "" TAB_VERB "%6.3" "-" COMPU_TAB_REF DSMRdy_Mode3ModeVerb /end COMPU_METHOD
/begin COMPU_VTAB DSMRdy_Mode3ModeVerb "" TAB_VERB 2 0 "SetGroupOnlyOnMode3" 1 "SetAllGroupsOnMode3" /end COMPU_VTAB
/begin COMPU_METHOD DSMRdy_OneToOne "" RAT_FUNC "%6.2" "-" COEFFS 0 1 0 0 0 1 /end COMPU_METHOD
/begin COMPU_METHOD EngN "" RAT_FUNC "%5.1" "rpm" COEFFS 0 2 0 0 0 1 /end COMPU_METHOD
/begin COMPU_METHOD Fact "" RAT_FUNC "%6.5" "-" COEFFS 0 8192 0 0 0 1 /end COMPU_METHOD
/begin COMPU_METHOD Kd "" RAT_FUNC "%7.6" "1/1" COEFFS 0 65536 0 0 0 1 /end COMPU_METHOD
/begin COMPU_METHOD OneToOne "" RAT_FUNC "%6.0" "-" COEFFS 0 1 0 0 0 1 /end COMPU_METHOD
/begin COMPU_METHOD OneToOne_km "" RAT_FUNC "%6.2" "km" COEFFS 0 1 0 0 0 1 /end COMPU_METHOD
/begin COMPU_METHOD Prc "" RAT_FUNC "%6.4" "%" COEFFS 0 81.92 0 0 0 1 /end COMPU_METHOD
/begin COMPU_METHOD Pres_hPa "" RAT_FUNC "%5.1" "hPa" COEFFS 0 1 0 0 0 1 /end COMPU_METHOD
/begin COMPU_METHOD Signals_IntSigNumVerb "" TAB_VERB "%6.3" "" COMPU_TAB_REF Signals_IntSigNumVerb /end COMPU_METHOD
/begin COMPU_VTAB Signals_IntSigNumVerb "" TAB_VERB 703 0 "SIGNALS_Signals_Default" 1 "SIGNALS_ACCtl_stOut_1B" 2 "SIGNALS_AFS_dmSensCorr_mp_2B" 3 "SIGNALS_AFS_dm_2B" 4 "SIGNALS_AFS_facIdlAdjVal_mp_2B" 5 "SIGNALS_AFS_facLdAdjVal_mp_2B" 6 "SIGNALS_AFS_mAirPerCyl_1B" 7 "SIGNALS_AFS_mAirPerCyl_2B" 8 "SIGNALS_AFS_rNorm_mp_2B" 9 "SIGNALS_AFS_stRstLoDrftThres_mp_1B" 10 "SIGNALS_AFS_tiCor_mp_2B" 11 "SIGNALS_AFS_tiRaw_2B" 12 "SIGNALS_APP_rFlt_mp_1B" 13 "SIGNALS_APP_rFlt_mp_2B" 14 "SIGNALS_APP_r_2B" 15 "SIGNALS_APP_stSigSrc_1B" 16 "SIGNALS_APP_uRaw1_2B" 17 "SIGNALS_APP_uRaw2_2B" 18 "SIGNALS_ASDdc_stSelSt_mp_2B" 19 "SIGNALS_ASDdc_trq_2B" 20 "SIGNALS_ASDrf_stSelSt_mp_2B" 21 "SIGNALS_ASMod_dmIndAirRef_2B" 22 "SIGNALS_ASMod_dvolPFltEG_1B" 23 "SIGNALS_ASMod_dvolPFltEG_2B" 24 "SIGNALS_ASMod_mAirPerCylCor_2B" 25 "SIGNALS_ASMod_pPFltSimDs_1B" 26 "SIGNALS_ASMod_pPFltSimDs_2B" 27 "SIGNALS_Absch_korr_2B" 28 "SIGNALS_AccPed_trqDes_4B" 29 "SIGNALS_ActMod_trqClth_2B" 30 "SIGNALS_ActMod_trqInr_2B" 31 "SIGNALS_ActMod_trq_2B" 32 "SIGNALS_AirCtl_mDesBas_2B" 33 "SIGNALS_AirCtl_mDesVal_1B" 34 "SIGNALS_AirCtl_mDesVal_2B" 35 "SIGNALS_AirCtl_mGovDvt_2B" 36 "SIGNALS_AirCtl_rCtlVal_2B" 37 "SIGNALS_AirCtl_rGovDvtNrm_2B" 38 "SIGNALS_AirCtl_rPIDCtl_mp_2B" 39 "SIGNALS_AirCtl_stAirCtlBits_4B" 40 "SIGNALS_AirCtl_stMon_1B" 41 "SIGNALS_AirSys_dRED1_mp_2B" 42 "SIGNALS_AirSys_dRED2_mp_2B" 43 "SIGNALS_AirSys_mLBer1_mp_4B" 44 "SIGNALS_AirSys_mLBer2_mp_4B" 45 "SIGNALS_AirSys_mLHFM1_mp_4B" 46 "SIGNALS_AirSys_mLHFM2_mp_4B" 47 "SIGNALS_AirSys_mLM10_mp_4B" 48 "SIGNALS_AirSys_mLM11_mp_4B" 49 "SIGNALS_AirSys_mLM12_mp_4B" 50 "SIGNALS_AirSys_mLM13_mp_4B" 51 "SIGNALS_AirSys_mLM20_mp_4B" 52 "SIGNALS_AirSys_mLM21_mp_4B" 53 "SIGNALS_AirSys_mLM22_mp_4B" 54 "SIGNALS_AirSys_p21max1_mp_2B" 55 "SIGNALS_AirSys_p21max2_mp_2B" 56 "SIGNALS_AirSys_rDIFF1_mp_2B" 57 "SIGNALS_AirSys_rDIFF2_mp_2B" 58 "SIGNALS_AirSys_rLverh1_mp_2B" 59 "SIGNALS_AirSys_rLverh2_mp_2B" 60 "SIGNALS_AirSys_rRED11_mp_2B" 61 "SIGNALS_AirSys_rRED12_mp_2B" 62 "SIGNALS_AirSys_rRED13_mp_2B" 63 "SIGNALS_AirSys_rRED21_mp_2B" 64 "SIGNALS_AirSys_rRED22_mp_2B" 65 "SIGNALS_AirSys_ststateSysTst_mp_1B" 66 "SIGNALS_AirSys_stsubstateSysTst_mp_1B" 67 "SIGNALS_Air_pIntkVUs_1B" 68 "SIGNALS_Air_pIntkVUs_2B" 69 "SIGNALS_Air_rRawTAFS_2B" 70 "SIGNALS_Air_tAFS_2B" 71 "SIGNALS_Air_tCACDs_2B" 72 "SIGNALS_Air_tSensTAFS_1B" 73 "SIGNALS_Air_tSensTAFS_2B" 74 "SIGNALS_Air_uRawPIntkVUs_2B" 75 "SIGNALS_Air_uRawTCACDs_2B" 76 "SIGNALS_AltIO_rAltLoad_2B" 77 "SIGNALS_BattU_uSens_1B" 78 "SIGNALS_BattU_uSens_2B" 79 "SIGNALS_BattU_u_2B" 80 "SIGNALS_BrkP_pSens_2B" 81 "SIGNALS_BrkP_p_2B" 82 "SIGNALS_BrkP_uRaw_2B" 83 "SIGNALS_Brk_st_1B" 84 "SIGNALS_Bszsi_4B" 85 "SIGNALS_CByVlv_st_1B" 86 "SIGNALS_CEngDsT_t_2B" 87 "SIGNALS_CEngDsT_uRaw_2B" 88 "SIGNALS_Clth_st_1B" 89 "SIGNALS_CoEOM_stOpModeAct_4B" 90 "SIGNALS_CoETS_rTrq_2B" 91 "SIGNALS_CoETS_stCurrLimActive_2B" 92 "SIGNALS_CoETS_trqInrLim_2B" 93 "SIGNALS_CoETS_trqInrSetSlow_2B" 94 "SIGNALS_CoEng_stIRevShutOff_4B" 95 "SIGNALS_CoEng_stRevShutOff_4B" 96 "SIGNALS_CoEng_stShutOffPath_4B" 97 "SIGNALS_CoEng_stState_mp_1B" 98 "SIGNALS_CoEng_stTst_1B" 99 "SIGNALS_CoEng_st_1B" 100 "SIGNALS_CoPT_trqDes_2B" 101 "SIGNALS_Com_lSum_4B" 102 "SIGNALS_Com_lSum_8km_2B" 103 "SIGNALS_Com_nPsp_2B" 104 "SIGNALS_Com_rPspSetPoint_2B" 105 "SIGNALS_Com_stCrCtlLvr_1B" 106 "SIGNALS_Com_stLmpPrkBrk_1B" 107 "SIGNALS_Conv_nTrbn_2B" 108 "SIGNALS_CrCUI_stBtn_2B" 109 "SIGNALS_CrC_stKey_2B" 110 "SIGNALS_CrCtl_aReq_2B" 111 "SIGNALS_CrCtl_stShOffConRvActv_mp_4B" 112 "SIGNALS_CrCtl_stShOff_1B" 113 "SIGNALS_CrCtl_st_1B" 114 "SIGNALS_CrCtl_vDes_2B" 115 "SIGNALS_DFC_ctLDF_mp_2B" 116 "SIGNALS_DFES_ctDef_1B" 117 "SIGNALS_DFES_ctEntry_1B" 118 "SIGNALS_DFES_ctOBDPend_1B" 119 "SIGNALS_DFES_ctOBD_1B" 120 "SIGNALS_DSMAUX_ctWUC_1B" 121 "SIGNALS_DSMRdy_Why_CyclCmplComprCmpnt_mp_2B" 122 "SIGNALS_DSMRdy_Why_CyclCmplEGR_mp_2B" 123 "SIGNALS_DSMRdy_Why_CyclCmplFlSys_mp_2B" 124 "SIGNALS_DSMRdy_Why_RdyComprCmpnt_mp_2B" 125 "SIGNALS_DSMRdy_Why_RdyEGR_mp_2B" 126 "SIGNALS_DSMRdy_Why_RdyFlSys_mp_2B" 127 "SIGNALS_DSM_DisblMode_mp_2B" 128 "SIGNALS_DSM_stPostDrive_1B" 129 "SIGNALS_DSM_stRdyAB_1B" 130 "SIGNALS_DSM_stRdyCD_1B" 131 "SIGNALS_D_soc_2B" 132 "SIGNALS_Dffgen_1B" 133 "SIGNALS_Dfh_lerncnt_2B" 134 "SIGNALS_Dfh_lernpw_2B" 135 "SIGNALS_Dfh_pekpf_1B" 136 "SIGNALS_Dfh_pekpf_2B" 137 "SIGNALS_Dspl_volFlTnkQnt_2B" 138 "SIGNALS_ECBVlv_rAct_2B" 139 "SIGNALS_ECBVlv_rPs_2B" 140 "SIGNALS_EGRVlv_rAct_2B" 141 "SIGNALS_EGRVlv_rPs_1B" 142 "SIGNALS_EGRVlv_rPs_2B" 143 "SIGNALS_EGRVlv_r_2B" 144 "SIGNALS_EMDmp_rPs_0_2B" 145 "SIGNALS_ETClb_ctLrn_mp_0_2B" 146 "SIGNALS_ETClb_ctLrn_mp_1_2B" 147 "SIGNALS_ETClb_ctLrn_mp_2_2B" 148 "SIGNALS_ETClb_dtiETFlt0_mp_0_2B" 149 "SIGNALS_ETClb_dtiETFlt0_mp_1_2B" 150 "SIGNALS_ETClb_dtiETFlt0_mp_2_2B" 151 "SIGNALS_ETClb_dtiETFlt0_mp_3_2B" 152 "SIGNALS_ETClb_dtiETFlt0_mp_4_2B" 153 "SIGNALS_ETClb_dtiETFlt0_mp_5_2B" 154 "SIGNALS_ETClb_dtiETFlt1_mp_0_2B" 155 "SIGNALS_ETClb_dtiETFlt1_mp_1_2B" 156 "SIGNALS_ETClb_dtiETFlt1_mp_2_2B" 157 "SIGNALS_ETClb_dtiETFlt1_mp_3_2B" 158 "SIGNALS_ETClb_dtiETFlt1_mp_4_2B" 159 "SIGNALS_ETClb_dtiETFlt1_mp_5_2B" 160 "SIGNALS_ETClb_dtiETFlt2_mp_0_2B" 161 "SIGNALS_ETClb_dtiETFlt2_mp_1_2B" 162 "SIGNALS_ETClb_dtiETFlt2_mp_2_2B" 163 "SIGNALS_ETClb_dtiETFlt2_mp_3_2B" 164 "SIGNALS_ETClb_dtiETFlt2_mp_4_2B" 165 "SIGNALS_ETClb_dtiETFlt2_mp_5_2B" 166 "SIGNALS_ETClb_pRailSet_0_2B" 167 "SIGNALS_ETClb_pRailSet_1_2B" 168 "SIGNALS_ETClb_pRailSet_2_2B" 169 "SIGNALS_ETClb_stCor_1B" 170 "SIGNALS_ETClb_stRlsCylCor_mp_1B" 171 "SIGNALS_ETClb_tiETAvrg_0_2B" 172 "SIGNALS_ETClb_tiETAvrg_1_2B" 173 "SIGNALS_ETClb_tiETAvrg_2_2B" 174 "SIGNALS_ETClb_tiETMax_0_2B" 175 "SIGNALS_ETClb_tiETMax_1_2B" 176 "SIGNALS_ETClb_tiETMax_2_2B" 177 "SIGNALS_ETClb_tiETMin_0_2B" 178 "SIGNALS_ETClb_tiETMin_1_2B" 179 "SIGNALS_ETClb_tiETMin_2_2B" 180 "SIGNALS_EngDa_tEng_2B" 181 "SIGNALS_EngDa_tFld_0_2B" 182 "SIGNALS_EngDa_tFld_1_2B" 183 "SIGNALS_EngDa_tFld_2_2B" 184 "SIGNALS_EngDa_tFld_3_2B" 185 "SIGNALS_EngDa_tiEngOn_4B" 186 "SIGNALS_EngDem_trqLimErr_2B" 187 "SIGNALS_EngPrt_trqLim_2B" 188 "SIGNALS_EngReq_trqLim_2B" 189 "SIGNALS_EngTrqPtd_stLimDeb_mp_1B" 190 "SIGNALS_EngTrqPtd_stLimUnDeb_mp_1B" 191 "SIGNALS_EngTrqPtd_stPthLim_1B" 192 "SIGNALS_EngTrqPtd_trqASD_2B" 193 "SIGNALS_EngTrqPtd_trqLim_2B" 194 "SIGNALS_EngTrqPtd_trqSpdG_2B" 195 "SIGNALS_EnvP_p_1B" 196 "SIGNALS_EnvP_p_2B" 197 "SIGNALS_EnvP_uRaw_2B" 198 "SIGNALS_EnvT_t_1B" 199 "SIGNALS_EnvT_t_2B" 200 "SIGNALS_EpmCaS_phiOfsCorr_2B" 201 "SIGNALS_EpmHCrS_stSigMode_1B" 202 "SIGNALS_Epm_nEng_2B" 203 "SIGNALS_Epm_stOpMode_1B" 204 "SIGNALS_Epm_stSpd_1B" 205 "SIGNALS_Epm_stSync_1B" 206 "SIGNALS_ErrLmp_stMILReq_1B" 207 "SIGNALS_ErrLmp_stSVSReq_1B" 208 "SIGNALS_Exh_pAdapPPFltDiff_1B" 209 "SIGNALS_Exh_pAdapPPFltDiff_2B" 210 "SIGNALS_Exh_pAdapPPFltUs_1B" 211 "SIGNALS_Exh_pAdapPPFltUs_2B" 212 "SIGNALS_Exh_pDiffOfsValAct_mp_1B" 213 "SIGNALS_Exh_pDiffOfsValAct_mp_2B" 214 "SIGNALS_Exh_pFltPPFltDiff_1B" 215 "SIGNALS_Exh_pFltPPFltDiff_2B" 216 "SIGNALS_Exh_pFltPPFltUs_1B" 217 "SIGNALS_Exh_pFltPPFltUs_2B" 218 "SIGNALS_Exh_pPFltUs_1B" 219 "SIGNALS_Exh_pPFltUs_2B" 220 "SIGNALS_Exh_pRawAdapPPFltDiff_1B" 221 "SIGNALS_Exh_pRawAdapPPFltDiff_2B" 222 "SIGNALS_Exh_tOxiCatUs_1B" 223 "SIGNALS_Exh_tOxiCatUs_2B" 224 "SIGNALS_Exh_tPFltUs_1B" 225 "SIGNALS_Exh_tPFltUs_2B" 226 "SIGNALS_Exh_tSensTOxiCatUs_1B" 227 "SIGNALS_Exh_tSensTOxiCatUs_2B" 228 "SIGNALS_Exh_tSensTPFltUs_1B" 229 "SIGNALS_Exh_tSensTPFltUs_2B" 230 "SIGNALS_Exh_uRawPPFltUs_2B" 231 "SIGNALS_Exh_uRawTOxiCatUs_2B" 232 "SIGNALS_Exh_uRawTPFltUs_2B" 233 "SIGNALS_FBC_qDvtCylPhys_01_0_2B" 234 "SIGNALS_FBC_qDvtCylPhys_01_1_2B" 235 "SIGNALS_FBC_qDvtCylPhys_01_2_2B" 236 "SIGNALS_FBC_qDvtCylPhys_01_3_2B" 237 "SIGNALS_FBC_qDvtCylPhys_01_4_2B" 238 "SIGNALS_FBC_qDvtCylPhys_01_5_2B" 239 "SIGNALS_FBC_qDvtCyl_0_2B" 240 "SIGNALS_FBC_qDvtCyl_1_2B" 241 "SIGNALS_FBC_qDvtCyl_2_2B" 242 "SIGNALS_FBC_qDvtCyl_3_2B" 243 "SIGNALS_FBC_qDvtCyl_4_2B" 244 "SIGNALS_FBC_qDvtCyl_5_2B" 245 "SIGNALS_FMA_qMapRow0_mp_0_2B" 246 "SIGNALS_FMA_qMapRow0_mp_1_2B" 247 "SIGNALS_FMA_qMapRow0_mp_2_2B" 248 "SIGNALS_FMA_qMapRow0_mp_3_2B" 249 "SIGNALS_FMA_qMapRow0_mp_4_2B" 250 "SIGNALS_FMA_qMapRow0_mp_5_2B" 251 "SIGNALS_FMA_qMapRow0_mp_6_2B" 252 "SIGNALS_FMA_qMapRow0_mp_7_2B" 253 "SIGNALS_FMA_qMapRow1_mp_0_2B" 254 "SIGNALS_FMA_qMapRow1_mp_1_2B" 255 "SIGNALS_FMA_qMapRow1_mp_2_2B" 256 "SIGNALS_FMA_qMapRow1_mp_3_2B" 257 "SIGNALS_FMA_qMapRow1_mp_4_2B" 258 "SIGNALS_FMA_qMapRow1_mp_5_2B" 259 "SIGNALS_FMA_qMapRow1_mp_6_2B" 260 "SIGNALS_FMA_qMapRow1_mp_7_2B" 261 "SIGNALS_FMA_qMapRow2_mp_0_2B" 262 "SIGNALS_FMA_qMapRow2_mp_1_2B" 263 "SIGNALS_FMA_qMapRow2_mp_2_2B" 264 "SIGNALS_FMA_qMapRow2_mp_3_2B" 265 "SIGNALS_FMA_qMapRow2_mp_4_2B" 266 "SIGNALS_FMA_qMapRow2_mp_5_2B" 267 "SIGNALS_FMA_qMapRow2_mp_6_2B" 268 "SIGNALS_FMA_qMapRow2_mp_7_2B" 269 "SIGNALS_FMA_qMapRow3_mp_0_2B" 270 "SIGNALS_FMA_qMapRow3_mp_1_2B" 271 "SIGNALS_FMA_qMapRow3_mp_2_2B" 272 "SIGNALS_FMA_qMapRow3_mp_3_2B" 273 "SIGNALS_FMA_qMapRow3_mp_4_2B" 274 "SIGNALS_FMA_qMapRow3_mp_5_2B" 275 "SIGNALS_FMA_qMapRow3_mp_6_2B" 276 "SIGNALS_FMA_qMapRow3_mp_7_2B" 277 "SIGNALS_FMA_qMapRow4_mp_0_2B" 278 "SIGNALS_FMA_qMapRow4_mp_1_2B" 279 "SIGNALS_FMA_qMapRow4_mp_2_2B" 280 "SIGNALS_FMA_qMapRow4_mp_3_2B" 281 "SIGNALS_FMA_qMapRow4_mp_4_2B" 282 "SIGNALS_FMA_qMapRow4_mp_5_2B" 283 "SIGNALS_FMA_qMapRow4_mp_6_2B" 284 "SIGNALS_FMA_qMapRow4_mp_7_2B" 285 "SIGNALS_FMA_qMapRow5_mp_0_2B" 286 "SIGNALS_FMA_qMapRow5_mp_1_2B" 287 "SIGNALS_FMA_qMapRow5_mp_2_2B" 288 "SIGNALS_FMA_qMapRow5_mp_3_2B" 289 "SIGNALS_FMA_qMapRow5_mp_4_2B" 290 "SIGNALS_FMA_qMapRow5_mp_5_2B" 291 "SIGNALS_FMA_qMapRow5_mp_6_2B" 292 "SIGNALS_FMA_qMapRow5_mp_7_2B" 293 "SIGNALS_FMA_qMapRow6_mp_0_2B" 294 "SIGNALS_FMA_qMapRow6_mp_1_2B" 295 "SIGNALS_FMA_qMapRow6_mp_2_2B" 296 "SIGNALS_FMA_qMapRow6_mp_3_2B" 297 "SIGNALS_FMA_qMapRow6_mp_4_2B" 298 "SIGNALS_FMA_qMapRow6_mp_5_2B" 299 "SIGNALS_FMA_qMapRow6_mp_6_2B" 300 "SIGNALS_FMA_qMapRow6_mp_7_2B" 301 "SIGNALS_FMA_qMapRow7_mp_0_2B" 302 "SIGNALS_FMA_qMapRow7_mp_1_2B" 303 "SIGNALS_FMA_qMapRow7_mp_2_2B" 304 "SIGNALS_FMA_qMapRow7_mp_3_2B" 305 "SIGNALS_FMA_qMapRow7_mp_4_2B" 306 "SIGNALS_FMA_qMapRow7_mp_5_2B" 307 "SIGNALS_FMA_qMapRow7_mp_6_2B" 308 "SIGNALS_FMA_qMapRow7_mp_7_2B" 309 "SIGNALS_FMA_q_mp_2B" 310 "SIGNALS_FMA_stSwtOff_1B" 311 "SIGNALS_FMA_tiFuncOp_4B" 312 "SIGNALS_Fan_rPs_1B" 313 "SIGNALS_Fan_rPs_2B" 314 "SIGNALS_FlFltDsP_pSens_1B" 315 "SIGNALS_FlFltDsP_pSens_2B" 316 "SIGNALS_FlFltDsP_p_1B" 317 "SIGNALS_FlFltDsP_p_2B" 318 "SIGNALS_FlFltDsP_uRaw_1B" 319 "SIGNALS_FlFltDsP_uRaw_2B" 320 "SIGNALS_FlFltHt_stPs_1B" 321 "SIGNALS_FlFlt_stRaw_1B" 322 "SIGNALS_FuelLvl_vol_1B" 323 "SIGNALS_FuelLvl_vol_2B" 324 "SIGNALS_FuelT_t_1B" 325 "SIGNALS_FuelT_t_2B" 326 "SIGNALS_FuelT_uRaw_2B" 327 "SIGNALS_Gangi_1B" 328 "SIGNALS_Gbx_ctGbxNPosUnPls_1B" 329 "SIGNALS_Gbx_numGear_1B" 330 "SIGNALS_GlwCtl_stGlw_2B" 331 "SIGNALS_GlwEcu_lSum_mp_2B" 332 "SIGNALS_GlwEcu_pwrGlow_1B" 333 "SIGNALS_GlwEcu_pwrGlow_2B" 334 "SIGNALS_GlwEcu_stGPCMConfig_mp_1B" 335 "SIGNALS_GlwEcu_stGPCMDiag_1B" 336 "SIGNALS_GlwEcu_stGPType_mp_1B" 337 "SIGNALS_GlwEcu_stHSSOpen_1B" 338 "SIGNALS_GlwEcu_stHSSShort_1B" 339 "SIGNALS_GlwEcu_stHighresCold_1B" 340 "SIGNALS_GlwEcu_stHighresHot_1B" 341 "SIGNALS_GlwEcu_stLowresCold_1B" 342 "SIGNALS_GlwEcu_stLowresHot_1B" 343 "SIGNALS_GlwEcu_tGlwPlg_mp_1B" 344 "SIGNALS_GlwEcu_tGlwPlg_mp_2B" 345 "SIGNALS_GlwLmp_st_1B" 346 "SIGNALS_ISC_nSetPLo_0_2B" 347 "SIGNALS_ISC_nSetPLo_1_2B" 348 "SIGNALS_ISC_nSetPLo_2_2B" 349 "SIGNALS_ISC_nSetPLo_3_2B" 350 "SIGNALS_ISC_nSetPLo_4_2B" 351 "SIGNALS_ISC_nSetPLo_5_2B" 352 "SIGNALS_ISC_st_0_4B" 353 "SIGNALS_ISC_st_1_4B" 354 "SIGNALS_ISC_st_2_4B" 355 "SIGNALS_ISC_st_3_4B" 356 "SIGNALS_ISC_st_4_4B" 357 "SIGNALS_ISC_st_5_4B" 358 "SIGNALS_ISC_trq_2B" 359 "SIGNALS_IVActr_uCh_mp_2B" 360 "SIGNALS_IVActr_uUp_2B" 361 "SIGNALS_IVCtl_tiChrg_2B" 362 "SIGNALS_IVCtl_uUp_2B" 363 "SIGNALS_IVPlaus_nCyl_0_2B" 364 "SIGNALS_IVPlaus_nCyl_1_2B" 365 "SIGNALS_IVPlaus_nCyl_2_2B" 366 "SIGNALS_IVPlaus_nCyl_3_2B" 367 "SIGNALS_IVPlaus_nCyl_4_2B" 368 "SIGNALS_IVPlaus_nCyl_5_2B" 369 "SIGNALS_IVPlaus_nHiDwnRunUpTst_2B" 370 "SIGNALS_IVPlaus_nHiUpRunUpTst_2B" 371 "SIGNALS_IVPlaus_nLoDwnRunUpTst_2B" 372 "SIGNALS_IVPlaus_nLoUpRunUpTst_2B" 373 "SIGNALS_IVPlaus_qFBCCyl_0_2B" 374 "SIGNALS_IVPlaus_qFBCCyl_1_2B" 375 "SIGNALS_IVPlaus_qFBCCyl_2_2B" 376 "SIGNALS_IVPlaus_qFBCCyl_3_2B" 377 "SIGNALS_IVPlaus_qFBCCyl_4_2B" 378 "SIGNALS_IVPlaus_qFBCCyl_5_2B" 379 "SIGNALS_IVPlaus_stRefRunUpTst_2B" 380 "SIGNALS_IVPlaus_tiDwnRunUpTst_4B" 381 "SIGNALS_IVPlaus_tiUpRunUpTst_4B" 382 "SIGNALS_I_batt_2B" 383 "SIGNALS_I_gen_1B" 384 "SIGNALS_InjCrv_phiMI1Des_2B" 385 "SIGNALS_InjCrv_phiPiI1Des_2B" 386 "SIGNALS_InjCrv_phiPiI2Des_2B" 387 "SIGNALS_InjCrv_phiPoI1Des_2B" 388 "SIGNALS_InjCrv_phiPoI2Des_2B" 389 "SIGNALS_InjCrv_qPiI1Des_mp_2B" 390 "SIGNALS_InjCrv_qPiI2Des_mp_2B" 391 "SIGNALS_InjCrv_tiPiI1Des_2B" 392 "SIGNALS_InjCtl_qCurr_2B" 393 "SIGNALS_InjCtl_qRaw_2B" 394 "SIGNALS_InjCtl_qSetUnBal_1B" 395 "SIGNALS_InjCtl_qSetUnBal_2B" 396 "SIGNALS_InjUn_stStrt_1B" 397 "SIGNALS_InjVlv_tiMI1ET_mp_2B" 398 "SIGNALS_InjVlv_tiPiI1ET_mp_2B" 399 "SIGNALS_InjVlv_tiPiI2ET_mp_2B" 400 "SIGNALS_InjVlv_tiPoI1ET_mp_2B" 401 "SIGNALS_InjVlv_tiPoI2ET_mp_2B" 402 "SIGNALS_InjVlv_volMI1_mp_2B" 403 "SIGNALS_InjVlv_volPiI1_mp_2B" 404 "SIGNALS_LSU_rLam_1B" 405 "SIGNALS_LSU_rLam_2B" 406 "SIGNALS_LSU_rO2Adap_0_1B" 407 "SIGNALS_LSU_rO2Adap_0_2B" 408 "SIGNALS_LSU_rO2Raw_2B" 409 "SIGNALS_LSU_stAdap_1B" 410 "SIGNALS_LSU_stO2IntValid_1B" 411 "SIGNALS_Layer_stLPCOff_1B" 412 "SIGNALS_Md_gennm_2B" 413 "SIGNALS_MeUn_dvolSet_2B" 414 "SIGNALS_MeUn_iActFlt_mp_1B" 415 "SIGNALS_MeUn_iActFlt_mp_2B" 416 "SIGNALS_MeUn_iSet_1B" 417 "SIGNALS_MeUn_iSet_2B" 418 "SIGNALS_MeUn_rPs_mp_1B" 419 "SIGNALS_MeUn_rPs_mp_2B" 420 "SIGNALS_MeUn_stActrCtl_mp_1B" 421 "SIGNALS_MeUn_uRaw_mp_2B" 422 "SIGNALS_MoCADC_ctDebTst_1B" 423 "SIGNALS_MoCADC_facVltgRatio_2B" 424 "SIGNALS_MoCADC_st_1B" 425 "SIGNALS_MoCCom_Query_4B" 426 "SIGNALS_MoCCom_Response_4B" 427 "SIGNALS_MoCCom_ctErrFC_1B" 428 "SIGNALS_MoCCom_ctErrMM_1B" 429 "SIGNALS_MoCCom_ctErrSPI_1B" 430 "SIGNALS_MoCCom_ctSOPTstActv_1B" 431 "SIGNALS_MoCCom_st_1B" 432 "SIGNALS_MoCMem_st_1B" 433 "SIGNALS_MoCRom_numRomPageErr_1B" 434 "SIGNALS_MoCRom_ptrTabIndexAct_1B" 435 "SIGNALS_MoCSOP_stAct_1B" 436 "SIGNALS_MoCSOP_stActvMsg_1B" 437 "SIGNALS_MoCSOP_stErr_1B" 438 "SIGNALS_MoCSOP_stLdRespTab_1B" 439 "SIGNALS_MoCSOP_stRdyMsg_1B" 440 "SIGNALS_MoCSOP_stRdy_1B" 441 "SIGNALS_MoCSOP_st_1B" 442 "SIGNALS_MoFAPP_stTst_1B" 443 "SIGNALS_MoFAPP_u_1B" 444 "SIGNALS_MoFBrk_st_1B" 445 "SIGNALS_MoFCoEng_rTrqPtd_1B" 446 "SIGNALS_MoFCoOfs_rTrqPtdMsg_1B" 447 "SIGNALS_MoFCoOfs_rTrqPtdOfs_1B" 448 "SIGNALS_MoFCoVeh_trqVehPtd_2B" 449 "SIGNALS_MoFDrAs_trqPtd_2B" 450 "SIGNALS_MoFDrDem_rAPP_1B" 451 "SIGNALS_MoFDrDem_trqPtd_2B" 452 "SIGNALS_MoFESpd_nEng_1B" 453 "SIGNALS_MoFESpd_phiGT1Last_4B" 454 "SIGNALS_MoFESpd_stSync_1B" 455 "SIGNALS_MoFETC_stTst_1B" 456 "SIGNALS_MoFExtInt_trqPtd_2B" 457 "SIGNALS_MoFIn_st_1B" 458 "SIGNALS_MoFInjDat_ctDebQntErr_1B" 459 "SIGNALS_MoFInjDat_facPoI1EffSet_2B" 460 "SIGNALS_MoFInjDat_facPoI2EffSet_2B" 461 "SIGNALS_MoFInjDat_pLinCurr_mp_1B" 462 "SIGNALS_MoFInjDat_p_1B" 463 "SIGNALS_MoFInjDat_phiMI1_2B" 464 "SIGNALS_MoFInjDat_phiPiI1_2B" 465 "SIGNALS_MoFInjDat_phiPiI2_2B" 466 "SIGNALS_MoFInjDat_phiPoI1_2B" 467 "SIGNALS_MoFInjDat_phiPoI2_2B" 468 "SIGNALS_MoFInjDat_stInjState_1B" 469 "SIGNALS_MoFInjDat_stPressSRC_1B" 470 "SIGNALS_MoFInjDat_tiMI1PoI1_2B" 471 "SIGNALS_MoFInjDat_tiMI1PoI2_2B" 472 "SIGNALS_MoFInjDat_tiPiI1ZFCETCor_2B" 473 "SIGNALS_MoFInjDat_tiPiI2ZFCETCor_2B" 474 "SIGNALS_MoFInjDat_tiPiI3ZFCETCor_2B" 475 "SIGNALS_MoFInjDat_tiTDCAvrg_2B" 476 "SIGNALS_MoFInjDat_uRaw_mp_1B" 477 "SIGNALS_MoFInjQnt_qPoI1Cor_2B" 478 "SIGNALS_MoFInjQnt_qPoI2Cor_2B" 479 "SIGNALS_MoFMode_ctDebPoI1Err_1B" 480 "SIGNALS_MoFMode_ctDebPoI2Err_1B" 481 "SIGNALS_MoFMode_qSetUnBal_2B" 482 "SIGNALS_MoFMode_stOpModeMsg_2B" 483 "SIGNALS_MoFOvR_stRls_2B" 484 "SIGNALS_MoFQntCor_qMI1_2B" 485 "SIGNALS_MoFQntCor_stInj_1B" 486 "SIGNALS_MoFQntCor_stMI1ErrAct_mp_1B" 487 "SIGNALS_MoFQntCor_stPiI1ErrAct_mp_1B" 488 "SIGNALS_MoFQntCor_stPoI1ErrAct_mp_1B" 489 "SIGNALS_MoFQntCor_stPoI2ErrAct_mp_1B" 490 "SIGNALS_MoFRailP_ctDebErr_1B" 491 "SIGNALS_MoFRailP_ctDebGradMax_1B" 492 "SIGNALS_MoFRailP_p_1B" 493 "SIGNALS_MoFTrqIdc_facEtaCor_mp_2B" 494 "SIGNALS_MoFTrqIdc_rTrq_1B" 495 "SIGNALS_OBD_PID01_DSMRdy_xPId1_4B" 496 "SIGNALS_OBD_PID04_CoETS_rTrq_1B" 497 "SIGNALS_OBD_PID05_CEngDsT_tSens_1B" 498 "SIGNALS_OBD_PID0B_Air_pSensPIntkVUs_1B" 499 "SIGNALS_OBD_PID0C_Epm_nEngRaw_2B" 500 "SIGNALS_OBD_PID0D_VehV_v_1B" 501 "SIGNALS_OBD_PID0F_Air_tSensTCACDs_1B" 502 "SIGNALS_OBD_PID10_AFS_dmSens_2B" 503 "SIGNALS_OBD_PID11_ThrVlv_rSens_1B" 504 "SIGNALS_OBD_PID1C_I15031_PID1C_1B" 505 "SIGNALS_OBD_PID1D_I15031_PID1D_1B" 506 "SIGNALS_OBD_PID1F_CoEng_tiNormal_2B" 507 "SIGNALS_OBD_PID21_DSMDur_ctGlb_0_2B" 508 "SIGNALS_OBD_PID23_RailP_pLin_2B" 509 "SIGNALS_OBD_PID24_LSU_rLam_uO2Raw_AB_2B" 510 "SIGNALS_OBD_PID24_LSU_rLam_uO2Raw_CD_2B" 511 "SIGNALS_OBD_PID2C_EGRVlv_r_1B" 512 "SIGNALS_OBD_PID2D_AirCtl_rGovDvtNrm_1B" 513 "SIGNALS_OBD_PID30_DSMAUX_ctWUC_1B" 514 "SIGNALS_OBD_PID33_EnvP_pSens_1B" 515 "SIGNALS_OBD_PID3C_Exh_tSensTPFltUs_2B" 516 "SIGNALS_OBD_PID41_DSMRdy_xPId41_4B" 517 "SIGNALS_OBD_PID42_BattU_uSens_2B" 518 "SIGNALS_OBD_PID45_ThrVlv_rAct_1B" 519 "SIGNALS_OBD_PID46_EnvT_tSens_1B" 520 "SIGNALS_OBD_PID49_APP_rUnFlt_1B" 521 "SIGNALS_OBD_PID4A_APP_uRaw2_1B" 522 "SIGNALS_OBD_PID4C_ThrVlv_r_1B" 523 "SIGNALS_OBD_PID4F_I15031_PID4FA_1B" 524 "SIGNALS_OBD_PID4F_I15031_PID4FB_1B" 525 "SIGNALS_OBD_PID4F_I15031_PID4FC_1B" 526 "SIGNALS_OBD_PID4F_I15031_PID4FD_1B" 527 "SIGNALS_OilPLmp_st_2B" 528 "SIGNALS_Oil_tSwmp_2B" 529 "SIGNALS_Oz_kvbmw_4B" 530 "SIGNALS_Oz_kvbog_2B" 531 "SIGNALS_Oz_kvbsm_4B" 532 "SIGNALS_Oz_kvbsm_ul_4B" 533 "SIGNALS_Oz_lp_1B" 534 "SIGNALS_Oz_lv_1B" 535 "SIGNALS_Oz_nivkrzt_1B" 536 "SIGNALS_Oz_nivlangt_1B" 537 "SIGNALS_Oz_oelkm_2B" 538 "SIGNALS_Oz_orikor_1B" 539 "SIGNALS_PCBS_lDistanceOut_2B" 540 "SIGNALS_PCBS_lSumDPFChng_4B" 541 "SIGNALS_PCR_pDesBasLP_mp_2B" 542 "SIGNALS_PCR_pDesBas_mp_2B" 543 "SIGNALS_PCR_pDesValLP_2B" 544 "SIGNALS_PCR_pDesVal_1B" 545 "SIGNALS_PCR_pDesVal_2B" 546 "SIGNALS_PCR_pGovDvtLP_2B" 547 "SIGNALS_PCR_pGovDvt_2B" 548 "SIGNALS_PCR_rCtlVal_2B" 549 "SIGNALS_PCR_stMonLP_1B" 550 "SIGNALS_PCR_stMon_1B" 551 "SIGNALS_PCR_stNrmOpLP_mp_1B" 552 "SIGNALS_PCR_stNrmOp_mp_1B" 553 "SIGNALS_PCR_stPCRBitsLP_4B" 554 "SIGNALS_PCR_stPCRBits_4B" 555 "SIGNALS_PCR_stWrkSphLP_mp_1B" 556 "SIGNALS_PCR_stWrkSph_mp_1B" 557 "SIGNALS_PCV_facAdapt_1B" 558 "SIGNALS_PCV_facAdapt_2B" 559 "SIGNALS_PCV_iActFlt_mp_1B" 560 "SIGNALS_PCV_iActFlt_mp_2B" 561 "SIGNALS_PCV_iSet_1B" 562 "SIGNALS_PCV_iSet_2B" 563 "SIGNALS_PCV_pSet_2B" 564 "SIGNALS_PCV_rPs_1B" 565 "SIGNALS_PCV_rPs_2B" 566 "SIGNALS_PCV_stActrCtl_1B" 567 "SIGNALS_PCV_uRaw_mp_2B" 568 "SIGNALS_PFltLd_mAshOilEG_2B" 569 "SIGNALS_PFltLd_mSotSim_2B" 570 "SIGNALS_PFltLd_mSot_2B" 571 "SIGNALS_PFltLd_resFlwFlt_1B" 572 "SIGNALS_PFltLd_resFlwFlt_2B" 573 "SIGNALS_PFltRgn_dqFlAvrg_mp_1B" 574 "SIGNALS_PFltRgn_dqFlAvrg_mp_2B" 575 "SIGNALS_PFltRgn_lSnceRgn_4B" 576 "SIGNALS_PFltRgn_lSumRgnBck0_mp_4B" 577 "SIGNALS_PFltRgn_lSumRgnBck1_mp_4B" 578 "SIGNALS_PFltRgn_lSumRgnBck2_mp_4B" 579 "SIGNALS_PFltRgn_lSumRgnBck3_mp_4B" 580 "SIGNALS_PFltRgn_lSumRgnBck4_mp_4B" 581 "SIGNALS_PFltRgn_numRgn_1B" 582 "SIGNALS_PFltRgn_qFl_mp_2B" 583 "SIGNALS_PFltRgn_stIntr_2B" 584 "SIGNALS_PFltRgn_stLck_1B" 585 "SIGNALS_PFlt_ctRgnStep1_mp_1B" 586 "SIGNALS_PFlt_ctRgnStep2_mp_1B" 587 "SIGNALS_PFlt_ctRgnStep3_mp_1B" 588 "SIGNALS_PFlt_ctRgnStep4_mp_1B" 589 "SIGNALS_PFlt_ctRgnStep5_mp_1B" 590 "SIGNALS_PFlt_ctRgnStep6_mp_1B" 591 "SIGNALS_PFlt_ctRgnStep7_mp_1B" 592 "SIGNALS_PFlt_ctRgnStep8_mp_1B" 593 "SIGNALS_PFlt_lAvrgRgn_1B" 594 "SIGNALS_PFlt_lAvrgRgn_2B" 595 "SIGNALS_PFlt_pPreCorr_mp_2B" 596 "SIGNALS_PFlt_stPresPlaus_mp_1B" 597 "SIGNALS_PSP_dvolOut_1B" 598 "SIGNALS_PSP_dvolOut_2B" 599 "SIGNALS_PT_stTraType_1B" 600 "SIGNALS_Pbremsu_2B" 601 "SIGNALS_Pr_bn_soll_1B" 602 "SIGNALS_Ptc_pwr_1B" 603 "SIGNALS_PthSet_stActvMonLim_1B" 604 "SIGNALS_PthSet_trqInrSetNoMo_2B" 605 "SIGNALS_PthSet_trqInrSet_2B" 606 "SIGNALS_QWC_tiPiI1MI1_mp_2B" 607 "SIGNALS_RailP_pCurr_mp_2B" 608 "SIGNALS_RailP_pFlt_1B" 609 "SIGNALS_RailP_pFlt_2B" 610 "SIGNALS_RailP_pLin_2B" 611 "SIGNALS_RailP_stGrad_1B" 612 "SIGNALS_RailP_uRaw_2B" 613 "SIGNALS_Rail_dvolPreCtl_2B" 614 "SIGNALS_Rail_pDvt_2B" 615 "SIGNALS_Rail_pSetPoint_1B" 616 "SIGNALS_Rail_pSetPoint_2B" 617 "SIGNALS_Rail_stCPC_1B" 618 "SIGNALS_Rail_stCtlLoop_1B" 619 "SIGNALS_Rail_stDwn1HpTst_4B" 620 "SIGNALS_Rail_stDwn2HpTst_4B" 621 "SIGNALS_Rail_stDwn3HpTst_4B" 622 "SIGNALS_Rail_stDwnHpTst_0_1B" 623 "SIGNALS_Rail_stDwnHpTst_1_1B" 624 "SIGNALS_Rail_stDwnHpTst_2_1B" 625 "SIGNALS_Rail_stDwnHpTst_3_1B" 626 "SIGNALS_Rail_stDwnHpTst_4_1B" 627 "SIGNALS_Rail_stRefHpTst_2B" 628 "SIGNALS_Rail_stStMHpTst_1B" 629 "SIGNALS_Rail_stUpHpTst_0_1B" 630 "SIGNALS_Rail_stUpHpTst_1_1B" 631 "SIGNALS_Rail_stUpHpTst_2_1B" 632 "SIGNALS_Rail_stUpHpTst_3_1B" 633 "SIGNALS_Rail_stUpHpTst_4_1B" 634 "SIGNALS_Rail_tiDwnHpTst_0_4B" 635 "SIGNALS_Rail_tiDwnHpTst_1_4B" 636 "SIGNALS_Rail_tiDwnHpTst_2_4B" 637 "SIGNALS_Rail_tiDwnHpTst_3_4B" 638 "SIGNALS_Rail_tiDwnHpTst_4_4B" 639 "SIGNALS_Rail_tiDwnHpTst_5_4B" 640 "SIGNALS_Rail_tiDwnHpTst_6_4B" 641 "SIGNALS_Rail_tiUpHpTst_0_4B" 642 "SIGNALS_Rail_tiUpHpTst_1_4B" 643 "SIGNALS_Rail_tiUpHpTst_2_4B" 644 "SIGNALS_Rail_tiUpHpTst_3_4B" 645 "SIGNALS_Reset_Env_adLoc_mp_4B" 646 "SIGNALS_Reset_Env_xId_mp_2B" 647 "SIGNALS_Rf_2B" 648 "SIGNALS_RngMod_trqFrc_2B" 649 "SIGNALS_Shtr_rPs_1B" 650 "SIGNALS_Shtr_rPs_2B" 651 "SIGNALS_Shtr_r_2B" 652 "SIGNALS_SmkLim_qLimSmk_2B" 653 "SIGNALS_SpdGov_trqSet_2B" 654 "SIGNALS_St_dfh0_1B" 655 "SIGNALS_St_msaaa_1B" 656 "SIGNALS_St_msaaad_2B" 657 "SIGNALS_St_msaanz_2B" 658 "SIGNALS_St_msaav_1B" 659 "SIGNALS_St_msaavd1_2B" 660 "SIGNALS_St_msaavd2_2B" 661 "SIGNALS_St_msaavd_4B" 662 "SIGNALS_St_msaea_1B" 663 "SIGNALS_St_msaev_1B" 664 "SIGNALS_St_ngang_1B" 665 "SIGNALS_Stat_entl_1B" 666 "SIGNALS_Stat_sv_reg2_1B" 667 "SIGNALS_SyC_stSub_1B" 668 "SIGNALS_T15_st_1B" 669 "SIGNALS_T_batt_2B" 670 "SIGNALS_ThrVlv_rAct_2B" 671 "SIGNALS_ThrVlv_rPs_1B" 672 "SIGNALS_ThrVlv_rPs_2B" 673 "SIGNALS_Tn_abstell_2B" 674 "SIGNALS_Toel_2B" 675 "SIGNALS_Tra_numGear_1B" 676 "SIGNALS_TrbChLP_rPs_1B" 677 "SIGNALS_TrbChLP_rPs_2B" 678 "SIGNALS_TrbChLP_r_2B" 679 "SIGNALS_TrbCh_rPs_1B" 680 "SIGNALS_TrbCh_rPs_2B" 681 "SIGNALS_TrbCh_rRaw_2B" 682 "SIGNALS_TrbCh_r_2B" 683 "SIGNALS_TrbnDsRLam_rLamRec_2B" 684 "SIGNALS_Tw_2B" 685 "SIGNALS_Tw_agr_2B" 686 "SIGNALS_Tw_agrcntg_4B" 687 "SIGNALS_Tw_agrmax_2B" 688 "SIGNALS_Tw_noagr_2B" 689 "SIGNALS_Tw_noagrcntg_4B" 690 "SIGNALS_Tw_noagrmax_2B" 691 "SIGNALS_U_batt_2B" 692 "SIGNALS_U_bn_soll_1B" 693 "SIGNALS_U_gen_2B" 694 "SIGNALS_Uekp_1B" 695 "SIGNALS_VSwVlv_rAct_2B" 696 "SIGNALS_VSwVlv_rPs_1B" 697 "SIGNALS_VSwVlv_rPs_2B" 698 "SIGNALS_VehV_a_2B" 699 "SIGNALS_VehV_v_2B" 700 "SIGNALS_WaHtEl_rPs_1B" 701 "SIGNALS_WaHtEl_rPs_2B" 702 "SIGNALS_WaHt_stShutOff_mp_2B" /end COMPU_VTAB
/begin COMPU_METHOD TempCels_100ms "" RAT_FUNC "%6.2" "deg C/s" COEFFS 0 1 0 0 0 1 /end COMPU_METHOD
/begin COMPU_METHOD TempDiff_Kelv "" RAT_FUNC "%4.1" "K" COEFFS 0 10 0 0 0 1 /end COMPU_METHOD
/begin COMPU_METHOD Temp_Cels "" RAT_FUNC "%5.1" "deg C" COEFFS 0 10 2731.4 0 0 1 /end COMPU_METHOD
/begin COMPU_METHOD TimeDeb "" RAT_FUNC "%5.0" "ms" COEFFS 0 0.1 0 0 0 1 /end COMPU_METHOD
/begin COMPU_METHOD TimeDelay_s "" RAT_FUNC "%12.4" "s" COEFFS 0 0 1 0 0.00023283064365387 0 /end COMPU_METHOD
/begin COMPU_METHOD Time_ms "" RAT_FUNC "%5.0" "ms" COEFFS 0 0.1 0 0 0 1 /end COMPU_METHOD
/begin COMPU_METHOD Vel "" RAT_FUNC "%5.2" "km/h" COEFFS 0 100 0 0 0 1 /end COMPU_METHOD
/begin COMPU_METHOD Vol "" RAT_FUNC "%6.4" "l" COEFFS 0 100 0 0 0 1 /end COMPU_METHOD
/begin COMPU_METHOD Volt_Batt "" RAT_FUNC "%5.0" "mV" COEFFS 0 0.05 0 0 0 1 /end COMPU_METHOD
/begin RECORD_LAYOUT Cur_Xs16Ws16 NO_AXIS_PTS_X 1 SWORD AXIS_PTS_X 2 SWORD INDEX_INCR DIRECT FNC_VALUES 3 SWORD COLUMN_DIR DIRECT /end RECORD_LAYOUT
/begin RECORD_LAYOUT Kw_Ws16 FNC_VALUES 1 SWORD COLUMN_DIR DIRECT /end RECORD_LAYOUT
/begin RECORD_LAYOUT Kw_Ws32 FNC_VALUES 1 SLONG COLUMN_DIR DIRECT /end RECORD_LAYOUT
/begin RECORD_LAYOUT ValA_Wu16 FNC_VALUES 1 UWORD COLUMN_DIR DIRECT /end RECORD_LAYOUT
/begin RECORD_LAYOUT ValA_Wu8 FNC_VALUES 1 UBYTE COLUMN_DIR DIRECT /end RECORD_LAYOUT
/begin RECORD_LAYOUT Val_Ws16 FNC_VALUES 1 SWORD COLUMN_DIR DIRECT /end RECORD_LAYOUT
/begin RECORD_LAYOUT Val_Wu16 FNC_VALUES 1 UWORD COLUMN_DIR DIRECT /end RECORD_LAYOUT
/begin RECORD_LAYOUT Val_Wu32 FNC_VALUES 1 ULONG COLUMN_DIR DIRECT /end RECORD_LAYOUT
/begin RECORD_LAYOUT Val_Wu8 FNC_VALUES 1 UBYTE COLUMN_DIR DIRECT /end RECORD_LAYOUT
/end MODULE
/end PROJECT

ASAP2_VERSION 1 4
/begin PROJECT P_574 "EDC17_CP09"
/begin HEADER "" VERSION "V8KB" PROJECT_NO P_574 /end HEADER
/begin MODULE DIM ""
/begin MOD_COMMON "" BYTE_ORDER MSB_LAST ALIGNMENT_BYTE 1 ALIGNMENT_WORD 2 ALIGNMENT_LONG 4 ALIGNMENT_FLOAT32_IEEE 4 /end MOD_COMMON
/begin CHARACTERISTIC Com_CCMsg_0_C "" VALUE 0x8003A442 Val_Wu8 248.0 OneToOne 4.000 252.0 EXTENDED_LIMITS 0.00 255.0 /end CHARACTERISTIC
/begin CHARACTERISTIC Com_CCMsg_0_ID_C "" VALUE 0x8003A444 Val_Wu16 65535.00 OneToOne 0.00 65535.00 /end CHARACTERISTIC
/begin CHARACTERISTIC Com_CCMsg_10_C "" VALUE 0x8003A446 Val_Wu8 248.0 OneToOne 4.000 252.0 EXTENDED_LIMITS 0.00 255.0 /end CHARACTERISTIC
/begin CHARACTERISTIC Com_CCMsg_10_ID_C "" VALUE 0x8003A448 Val_Wu16 65535.00 OneToOne 0.00 65535.00 /end CHARACTERISTIC
/begin CHARACTERISTIC Com_CCMsg_11_C "" VALUE 0x8003A44A Val_Wu8 248.0 OneToOne 4.000 252.0 EXTENDED_LIMITS 0.00 255.0 /end CHARACTERISTIC
/begin CHARACTERISTIC Com_CCMsg_11_ID_C "" VALUE 0x8003A44C Val_Wu16 65535.00 OneToOne 0.00 65535.00 /end CHARACTERISTIC
/begin CHARACTERISTIC Com_CCMsg_12_C "" VALUE 0x8003A44E Val_Wu8 248.0 OneToOne 4.000 252.0 EXTENDED_LIMITS 0.00 255.0 /end CHARACTERISTIC
/begin CHARACTERISTIC Com_CCMsg_12_ID_C "" VALUE 0x8003A450 Val_Wu16 65535.00 OneToOne 0.00 65535.00 /end CHARACTERISTIC
/begin CHARACTERISTIC Com_CCMsg_13_C "" VALUE 0x8003A452 Val_Wu8 248.0 OneToOne 4.000 252.0 EXTENDED_LIMITS 0.00 255.0 /end CHARACTERISTIC
/begin CHARACTERISTIC Com_CCMsg_13_ID_C "" VALUE 0x8003A454 Val_Wu16 65535.00 OneToOne 0.00 65535.00 /end CHARACTERISTIC
/begin CHARACTERISTIC Com_CCMsg_14_C "" VALUE 0x8003A456 Val_Wu8 248.0 OneToOne 4.000 252.0 EXTENDED_LIMITS 0.00 255.0 /end CHARACTERISTIC
/begin CHARACTERISTIC Com_CCMsg_14_ID_C "" VALUE 0x8003A458 Val_Wu16 65535.00 OneToOne 0.00 65535.00 /end CHARACTERISTIC
/begin CHARACTERISTIC Com_CCMsg_15_C "" VALUE 0x8003A45A Val_Wu8 248.0 OneToOne 4.000 252.0 EXTENDED_LIMITS 0.00 255.0 /end CHARACTERISTIC
/begin CHARACTERISTIC Com_CCMsg_15_ID_C "" VALUE 0x8003A45C Val_Wu16 65535.00 OneToOne 0.00 65535.00 /end CHARACTERISTIC
/begin CHARACTERISTIC Com_CCMsg_16_C "" VALUE 0x8003A45E Val_Wu8 248.0 OneToOne 4.000 252.0 EXTENDED_LIMITS 0.00 255.0 /end CHARACTERISTIC
/begin CHARACTERISTIC Com_CCMsg_16_ID_C "" VALUE 0x8003A460 Val_Wu16 65535.00 OneToOne 0.00 65535.00 /end CHARACTERISTIC
/begin CHARACTERISTIC Com_CCMsg_17_C "" VALUE 0x8003A462 Val_Wu8 248.0 OneToOne 4.000 252.0 EXTENDED_LIMITS 0.00 255.0 /end CHARACTERISTIC
/begin CHARACTERISTIC Com_CCMsg_17_ID_C "" VALUE 0x8003A464 Val_Wu16 65535.00 OneToOne 0.00 65535.00 /end CHARACTERISTIC
/begin CHARACTERISTIC Com_CCMsg_18_C "" VALUE 0x8003A466 Val_Wu8 248.0 OneToOne 4.000 252.0 EXTENDED_LIMITS 0.00 255.0 /end CHARACTERISTIC
/begin CHARACTERISTIC Com_CCMsg_18_ID_C "" VALUE 0x8003A468 Val_Wu16 65535.00 OneToOne 0.00 65535.00 /end CHARACTERISTIC
/begin CHARACTERISTIC Com_CCMsg_19_C "" VALUE 0x8003A46A Val_Wu8 248.0 OneToOne 4.000 252.0 EXTENDED_LIMITS 0.00 255.0 /end CHARACTERISTIC
/begin CHARACTERISTIC Com_CCMsg_19_ID_C "" VALUE 0x8003A46C Val_Wu16 65535.00 OneToOne 0.00 65535.00 /end CHARACTERISTIC
/begin CHARACTERISTIC Com_CCMsg_1_C "" VALUE 0x8003A46E Val_Wu8 248.0 OneToOne 4.000 252.0 EXTENDED_LIMITS 0.00 255.0 /end CHARACTERISTIC
/begin CHARACTERISTIC Com_CCMsg_1_ID_C "" VALUE 0x8003A470 Val_Wu16 65535.00 OneToOne 0.00 65535.00 /end CHARACTERISTIC
/begin CHARACTERISTIC Com_CCMsg_20_C "" VALUE 0x8003A472 Val_Wu8 248.0 OneToOne 4.000 252.0 EXTENDED_LIMITS 0.00 255.0 /end CHARACTERISTIC
/begin CHARACTERISTIC Com_CCMsg_20_ID_C "" VALUE 0x8003A474 Val_Wu16 65535.00 OneToOne 0.00 65535.00 /end CHARACTERISTIC
/begin CHARACTERISTIC Com_CCMsg_21_C "" VALUE 0x8003A476 Val_Wu8 248.0 OneToOne 4.000 252.0 EXTENDED_LIMITS 0.00 255.0 /end CHARACTERISTIC
/begin CHARACTERISTIC Com_CCMsg_21_ID_C "" VALUE 0x8003A478 Val_Wu16 65535.00 OneToOne 0.00 65535.00 /end CHARACTERISTIC
/begin CHARACTERISTIC Com_CCMsg_22_C "" VALUE 0x8003A47A Val_Wu8 248.0 OneToOne 4.000 252.0 EXTENDED_LIMITS 0.00 255.0 /end CHARACTERISTIC
/begin CHARACTERISTIC Com_CCMsg_22_ID_C "" VALUE 0x8003A47C Val_Wu16 65535.00 OneToOne 0.00 65535.00 /end CHARACTERISTIC
/begin CHARACTERISTIC Com_CCMsg_2_C "" VALUE 0x8003A47E Val_Wu8 248.0 OneToOne 4.000 252.0 EXTENDED_LIMITS 0.00 255.0 /end CHARACTERISTIC
/begin CHARACTERISTIC Com_CCMsg_2_ID_C "" VALUE 0x8003A480 Val_Wu16 65535.00 OneToOne 0.00 65535.00 /end CHARACTERISTIC
/begin CHARACTERISTIC Com_CCMsg_3_C "" VALUE 0x8003A482 Val_Wu8 248.0 OneToOne 4.000 252.0 EXTENDED_LIMITS 0.00 255.0 /end CHARACTERISTIC
/begin CHARACTERISTIC Com_CCMsg_3_ID_C "" VALUE 0x8003A484 Val_Wu16 65535.00 OneToOne 0.00 65535.00 /end CHARACTERISTIC
/begin CHARACTERISTIC Com_CCMsg_4_C "" VALUE 0x8003A486 Val_Wu8 248.0 OneToOne 4.000 252.0 EXTENDED_LIMITS 0.00 255.0 /end CHARACTERISTIC
/begin CHARACTERISTIC Com_CCMsg_4_ID_C "" VALUE 0x8003A488 Val_Wu16 65535.00 OneToOne 0.00 65535.00 /end CHARACTERISTIC
/begin CHARACTERISTIC Com_CCMsg_5_C "" VALUE 0x8003A48A Val_Wu8 248.0 OneToOne 4.000 252.0 EXTENDED_LIMITS 0.00 255.0 /end CHARACTERISTIC
/begin CHARACTERISTIC Com_CCMsg_5_ID_C "" VALUE 0x8003A48C Val_Wu16 65535.00 OneToOne 0.00 65535.00 /end CHARACTERISTIC
/begin CHARACTERISTIC Com_CCMsg_6_C "" VALUE 0x8003A48E Val_Wu8 248.0 OneToOne 4.000 252.0 EXTENDED_LIMITS 0.00 255.0 /end CHARACTERISTIC
/begin CHARACTERISTIC Com_CCMsg_6_ID_C "" VALUE 0x8003A490 Val_Wu16 65535.00 OneToOne 0.00 65535.00 /end CHARACTERISTIC
/begin CHARACTERISTIC Com_CCMsg_7_C "" VALUE 0x8003A492 Val_Wu8 248.0 OneToOne 4.000 252.0 EXTENDED_LIMITS 0.00 255.0 /end CHARACTERISTIC
/begin CHARACTERISTIC Com_CCMsg_7_ID_C "" VALUE 0x8003A494 Val_Wu16 65535.00 OneToOne 0.00 65535.00 /end CHARACTERISTIC
/begin CHARACTERISTIC Com_CCMsg_8_C "" VALUE 0x8003A496 Val_Wu8 248.0 OneToOne 4.000 252.0 EXTENDED_LIMITS 0.00 255.0 /end CHARACTERISTIC
/begin CHARACTERISTIC Com_CCMsg_8_ID_C "" VALUE 0x8003A498 Val_Wu16 65535.00 OneToOne 0.00 65535.00 /end CHARACTERISTIC
/begin CHARACTERISTIC Com_CCMsg_9_C "" VALUE 0x8003A49A Val_Wu8 248.0 OneToOne 4.000 252.0 EXTENDED_LIMITS 0.00 255.0 /end CHARACTERISTIC
/begin CHARACTERISTIC Com_CCMsg_9_ID_C "" VALUE 0x8003A49C Val_Wu16 65535.00 OneToOne 0.00 65535.00 /end CHARACTERISTIC
/begin CHARACTERISTIC Com_dTestMsg_C "" VALUE 0x8003A49E Val_Wu16 1.000000 OneToOne 0.00 1.000000 EXTENDED_LIMITS 0.00 65535.00 /end CHARACTERISTIC
/begin CHARACTERISTIC Com_dTestSig_C "" VALUE 0x8003A4A0 Val_Wu16 1.000000 OneToOne 0.00 1.000000 EXTENDED_LIMITS 0.00 65535.00 /end CHARACTERISTIC
/begin CHARACTERISTIC Com_swtActvFlPmpEng_A_C "" VALUE 0x8003A4AE Val_Wu8 255.0 OneToOne 0.00 255.0 /end CHARACTERISTIC
/begin CHARACTERISTIC Com_swtAngAcpd_A_C "" VALUE 0x8003A4AF Val_Wu8 255.0 OneToOne 0.00 255.0 /end CHARACTERISTIC
/begin CHARACTERISTIC Com_swtATemp_A_C "" VALUE 0x8003A4B0 Val_Wu8 255.0 OneToOne 0.00 255.0 /end CHARACTERISTIC
/begin CHARACTERISTIC Com_swtBatteriespg_C "" VALUE 0x8003A4A2 Val_Wu8 1.000 OneToOne 0.00 1.000 EXTENDED_LIMITS 0.00 255.0 /end CHARACTERISTIC
/begin CHARACTERISTIC Com_swtCBSOil_C "" VALUE 0x8003A440 Val_Wu8 2.000 OneToOne 0.00 2.000 EXTENDED_LIMITS 0.00 255.0 /end CHARACTERISTIC
/begin CHARACTERISTIC Com_swtCBSPFlt_C "" VALUE 0x8003A441 Val_Wu8 2.000 OneToOne 0.00 2.000 EXTENDED_LIMITS 0.00 255.0 /end CHARACTERISTIC
/begin CHARACTERISTIC Com_swtCrCtlSpeed_C "" VALUE 0x8003A4A3 Val_Wu8 1.000 OneToOne 0.00 1.000 EXTENDED_LIMITS 0.00 255.0 /end CHARACTERISTIC
/begin CHARACTERISTIC Com_swtDiaOBDEng_A_C "" VALUE 0x8003A4B1 Val_Wu8 255.0 OneToOne 0.00 255.0 /end CHARACTERISTIC
/begin CHARACTERISTIC Com_swtDriveTrainData1_A_C "" VALUE 0x8003A4B2 Val_Wu8 255.0 OneToOne 0.00 255.0 /end CHARACTERISTIC
/begin CHARACTERISTIC Com_swtDriveTrainData2_A_C "" VALUE 0x8003A4B3 Val_Wu8 255.0 OneToOne 0.00 255.0 /end CHARACTERISTIC
/begin CHARACTERISTIC Com_swtEngineRpm_C "" VALUE 0x8003A4A4 Val_Wu8 1.000 OneToOne 0.00 1.000 EXTENDED_LIMITS 0.00 255.0 /end CHARACTERISTIC
/begin CHARACTERISTIC Com_swtEngine_C "" VALUE 0x8003A4A5 Val_Wu8 1.000 OneToOne 0.00 1.000 EXTENDED_LIMITS 0.00 255.0 /end CHARACTERISTIC
/begin CHARACTERISTIC Com_swtHeatFlowEngine_C "" VALUE 0x8003A4A6 Val_Wu8 1.000 OneToOne 0.00 1.000 EXTENDED_LIMITS 0.00 255.0 /end CHARACTERISTIC
/begin CHARACTERISTIC Com_swtRelTime_A_C "" VALUE 0x8003A4B4 Val_Wu8 255.0 OneToOne 0.00 255.0 /end CHARACTERISTIC
/begin CHARACTERISTIC Com_swtStatusMSA_C "" VALUE 0x8003A4A7 Val_Wu8 1.000 OneToOne 0.00 1.000 EXTENDED_LIMITS 0.00 255.0 /end CHARACTERISTIC
/begin CHARACTERISTIC Com_swtTest_C "" VALUE 0x8003A4A8 Val_Wu8 1.000 OneToOne 0.00 1.000 EXTENDED_LIMITS 0.00 255.0 /end CHARACTERISTIC
/begin CHARACTERISTIC Com_swtTorque1_C "" VALUE 0x8003A4A9 Val_Wu8 1.000 OneToOne 0.00 1.000 EXTENDED_LIMITS 0.00 255.0 /end CHARACTERISTIC
/begin CHARACTERISTIC Com_swtTorque2_C "" VALUE 0x8003A4AA Val_Wu8 1.000 OneToOne 0.00 1.000 EXTENDED_LIMITS 0.00 255.0 /end CHARACTERISTIC
/begin CHARACTERISTIC Com_swtTorque3_C "" VALUE 0x8003A4AB Val_Wu8 1.000 OneToOne 0.00 1.000 EXTENDED_LIMITS 0.00 255.0 /end CHARACTERISTIC
/begin CHARACTERISTIC Com_swtTrqCrsh1_A_C "" VALUE 0x8003A4B5 Val_Wu8 255.0 OneToOne 0.00 255.0 /end CHARACTERISTIC
/begin CHARACTERISTIC Com_swtTrqCrsh2_A_C "" VALUE 0x8003A4B6 Val_Wu8 255.0 OneToOne 0.00 255.0 /end CHARACTERISTIC
/begin CHARACTERISTIC Com_swtTrqCrsh3_A_C "" VALUE 0x8003A4B7 Val_Wu8 255.0 OneToOne 0.00 255.0 /end CHARACTERISTIC
/begin CHARACTERISTIC Com_swtVehicleSpeed_A_C "" VALUE 0x8003A4B8 Val_Wu8 255.0 OneToOne 0.00 255.0 /end CHARACTERISTIC
/begin CHARACTERISTIC Com_swtVerbrauchersteuerung_C "" VALUE 0x8003A4AC Val_Wu8 1.000 OneToOne 0.00 1.000 EXTENDED_LIMITS 0.00 255.0 /end CHARACTERISTIC
/begin CHARACTERISTIC DStgy_dmNH3CurrLim_C "Maximum für plausible Dosiermenge" VALUE 0x80038A9C Val_Ws32 300000.000000 SCR_Dm005 0.00 300000.000000 FORMAT "%13.6" EXTENDED_LIMITS -107374182.400 107374182.350 /end CHARACTERISTIC
/begin CHARACTERISTIC DStgy_dmNH3CurrMax_C "Oberes Limit für aktuelle Dosiermenge" VALUE 0x80038AA0 Val_Ws32 300000.000000 SCR_Dm005 0.00 300000.000000 FORMAT "%13.6" EXTENDED_LIMITS -107374182.400 107374182.350 /end CHARACTERISTIC
/begin CHARACTERISTIC DStgy_dmNH3CurrMin_C "Unteres Limit für aktuelle Dosiermenge" VALUE 0x80038AA4 Val_Ws32 300000.000000 SCR_Dm005 0.00 300000.000000 FORMAT "%13.6" EXTENDED_LIMITS -107374182.400 107374182.350 /end CHARACTERISTIC
/begin CHARACTERISTIC DStgy_dmNH3MetAdap_C "" VALUE 0x80038AA8 Val_Ws16 601.0000 SCR_Dm005 -1.000000 600.0000 FORMAT "%8.4" EXTENDED_LIMITS -1638.400 1638.350 /end CHARACTERISTIC
/begin CHARACTERISTIC DStgy_dmRdcAgAct_C "" VALUE 0x80038AAA Val_Ws16 3255.000 SCR_Dm01 0.00 3255.000 FORMAT "%8.3" EXTENDED_LIMITS -3276.800 3276.700 /end CHARACTERISTIC
/begin CHARACTERISTIC DStgy_facCnvMFl_C "Umrechnung g/s in mg/s" VALUE 0x80038AAC Val_Ws16 1000.000 OneToOne 0.00 1000.000 EXTENDED_LIMITS -32768.00 32767.00 /end CHARACTERISTIC
/begin CHARACTERISTIC DStgy_facKiRdcAg_C "Integrationskostante Reduktionsmittel" VALUE 0x80038AAE Val_Ws16 10.00000 SCR_Fact1000 0.00 10.00000 FORMAT "%8.5" EXTENDED_LIMITS -32.76800 32.76700 /end CHARACTERISTIC
/begin CHARACTERISTIC DStgy_facNH3ToRdcAg_C "Umrechnungsfaktor NH3 -> Reduktionsmittel" VALUE 0x80038AB0 Val_Ws16 10.00000 SCR_Fact1000 0.00 10.00000 FORMAT "%8.5" EXTENDED_LIMITS -32.76800 32.76700 /end CHARACTERISTIC
/begin CHARACTERISTIC DStgy_facQtyAdap_C "" VALUE 0x80038AB2 Val_Ws16 10.00000 SCR_Fact100 0.00 10.00000 FORMAT "%8.5" EXTENDED_LIMITS -327.6800 327.6700 /end CHARACTERISTIC
/begin CHARACTERISTIC DStgy_mRdcAgAct_C "" VALUE 0x80038AB4 Val_Wu16 65.00000 SCR_Mass1000 0.00 65.00000 FORMAT "%8.5" EXTENDED_LIMITS 0.00 65.53500 /end CHARACTERISTIC
/begin CHARACTERISTIC DStgy_stMetMod_C "" VALUE 0x80038AB6 Val_Wu8 1.00000000000 SCRAd_Compu_Switch_3 0.00 1.00000000000 FORMAT "%13.11" /end CHARACTERISTIC
/begin CHARACTERISTIC DStgy_swtRdcAgAcmEna_C "Auswahlschalter, ob die augenblickliche Dosiermenge in g oder mg/s verwendet werden soll." VALUE 0x80038AB7 Val_Wu8 1.00000000000 DStgy_Compu_Switch_2 0.00 1.00000000000 FORMAT "%13.11" /end CHARACTERISTIC
/begin CHARACTERISTIC DStgy_swtTestEna_C "" VALUE 0x80038AB8 Val_Wu8 1.00000000000 SCRAd_Compu_Switch_3 0.00 1.00000000000 FORMAT "%13.11" /end CHARACTERISTIC
/begin CHARACTERISTIC DTR_numCANOBDId_CA "dem Testergebnis zugeordnete OBDMID für die Ausgabe über CAN" VAL_BLK 0x80025D44 ValA_Wu8 255.0 DFC_OneToOne 0.00 255.0 NUMBER 12 /end CHARACTERISTIC
/begin CHARACTERISTIC DTR_numCANTstId_CA "dem Testergebnis zugeordnete Test ID für die Ausgabe über CAN" VAL_BLK 0x80025D50 ValA_Wu8 255.0 DFC_OneToOne 0.00 255.0 NUMBER 12 /end CHARACTERISTIC
/begin CHARACTERISTIC DTR_xAsgnCANRslt_CA "für die Ausgabe über CAN ausgewählte Testergebnisse" VAL_BLK 0x80025D5C ValA_Wu8 255. DTR_Verb 0.00 255. FORMAT "%2.0" NUMBER 12 /end CHARACTERISTIC
/begin CHARACTERISTIC EBxFanCtl_tOff_C "" VALUE 0x80038D6C Val_Ws16 3053.700 Temp_Cels -50.14000 3003.560 EXTENDED_LIMITS -3549.940 3003.560 /end CHARACTERISTIC
/begin CHARACTERISTIC EBxFanCtl_tOn_C "" VALUE 0x80038D6E Val_Ws16 3053.700 Temp_Cels -50.14000 3003.560 EXTENDED_LIMITS -3549.940 3003.560 /end CHARACTERISTIC
/begin CHARACTERISTIC EBxFan_DigOut.tiBtwTstSCB_C "Struktur für Status der Endstufenparemeter/" VALUE 0x80038D70 Kw_Ws16 1000.000 Time_ms 0.00 1000.000 EXTENDED_LIMITS -327680.0 327670.0 /end CHARACTERISTIC
/begin CHARACTERISTIC EBxFan_DigOut.tiBtwTstOT_C "Struktur für Status der Endstufenparemeter/" VALUE 0x80038D72 Kw_Ws16 1000.000 Time_s 0.00 1000.000 EXTENDED_LIMITS -327.6800 327.6700 /end CHARACTERISTIC
/begin CHARACTERISTIC EBxFan_DigOut.numTstMax_C "Struktur für Status der Endstufenparemeter/" VALUE 0x80038D74 Kw_Wu16 65535.00 OneToOne 0.00 65535.00 /end CHARACTERISTIC
/begin CHARACTERISTIC EBxFan_stPsDiaDisbl_C "Status der Endstufediagnose" VALUE 0x80038D76 Val_Wu8 255.0 OneToOne 0.00 255.0 /end CHARACTERISTIC
/begin CHARACTERISTIC EBxFan_stPsDisbl_C "Status der Endstufe" VALUE 0x80038D77 Val_Wu8 255.0 OneToOne 0.00 255.0 /end CHARACTERISTIC
/begin CHARACTERISTIC ECBVlv_Pwm.tiPer_C "Struktur, die Kalibrierungs- und Umsetzungsdatentypen für den AGR-Kühler-Bypass-Ventilsteller enthält/" VALUE 0x80038DCC Kw_Ws16 9.900000 Period 0.1000000 10.00000 FORMAT "%8.5" EXTENDED_LIMITS -3276.800 3276.700 /end CHARACTERISTIC
/begin CHARACTERISTIC ECBVlv_Pwm.stLvl_C "Struktur, die Kalibrierungs- und Umsetzungsdatentypen für den AGR-Kühler-Bypass-Ventilsteller enthält/" VALUE 0x80038DCE Kw_Wu8 1.000 OneToOne 0.00 1.000 EXTENDED_LIMITS 0.00 255.0 /end CHARACTERISTIC
/begin CHARACTERISTIC ECBVlv_Pwm.rMaxDty_C "Struktur, die Kalibrierungs- und Umsetzungsdatentypen für den AGR-Kühler-Bypass-Ventilsteller enthält/" VALUE 0x80038DD0 Kw_Ws16 100.0000 DtyCyc 0.00 100.0000 EXTENDED_LIMITS -327.6800 327.6700 /end CHARACTERISTIC
/begin CHARACTERISTIC ECBVlv_Pwm.rPerUn_C "Struktur, die Kalibrierungs- und Umsetzungsdatentypen für den AGR-Kühler-Bypass-Ventilsteller enthält/" VALUE 0x80038DD2 Kw_Ws16 3276.700 Period 0.00 3276.700 FORMAT "%8.3" EXTENDED_LIMITS -3276.800 3276.700 /end CHARACTERISTIC
/begin CHARACTERISTIC ECBVlv_Pwm.tiPh_C "Struktur, die Kalibrierungs- und Umsetzungsdatentypen für den AGR-Kühler-Bypass-Ventilsteller enthält/" VALUE 0x80038DD4 Kw_Ws16 65535.00 OneToOne -32768.00 32767.00 /end CHARACTERISTIC
/begin CHARACTERISTIC ECBVlv_PwmOut.rMin_C "Struktur, die Parameter zur Fehlerbehandlung der PWM-Ausgangsendstufe für den AGR-Kühler-Bypassventilsteller enthält/" VALUE 0x80038DD6 Kw_Ws16 100.0000 DtyCyc 0.00 100.0000 EXTENDED_LIMITS -327.6800 327.6700 /end CHARACTERISTIC
/begin CHARACTERISTIC ECBVlv_PwmOut.rMax_C "Struktur, die Parameter zur Fehlerbehandlung der PWM-Ausgangsendstufe für den AGR-Kühler-Bypassventilsteller enthält/" VALUE 0x80038DD8 Kw_Ws16 100.0000 DtyCyc 0.00 100.0000 EXTENDED_LIMITS -327.6800 327.6700 /end CHARACTERISTIC
/begin CHARACTERISTIC ECBVlv_PwmOut.tiBtwTstSCB_C "Struktur, die Parameter zur Fehlerbehandlung der PWM-Ausgangsendstufe für den AGR-Kühler-Bypassventilsteller enthält/" VALUE 0x80038DDA Kw_Ws16 1000.000 Time_ms 0.00 1000.000 EXTENDED_LIMITS -327680.0 327670.0 /end CHARACTERISTIC
/begin CHARACTERISTIC ECBVlv_PwmOut.tiBtwTstOT_C "Struktur, die Parameter zur Fehlerbehandlung der PWM-Ausgangsendstufe für den AGR-Kühler-Bypassventilsteller enthält/" VALUE 0x80038DDC Kw_Ws16 327.6700 Time_s 0.00 327.6700 EXTENDED_LIMITS -327.6800 327.6700 /end CHARACTERISTIC
/begin CHARACTERISTIC ECBVlv_PwmOut.numTstMax_C "Struktur, die Parameter zur Fehlerbehandlung der PWM-Ausgangsendstufe für den AGR-Kühler-Bypassventilsteller enthält/" VALUE 0x80038DDE Kw_Wu16 65535.00 OneToOne 0.00 65535.00 /end CHARACTERISTIC
/begin CHARACTERISTIC ECBVlv_PwmOut.swtBattCor_C "Struktur, die Parameter zur Fehlerbehandlung der PWM-Ausgangsendstufe für den AGR-Kühler-Bypassventilsteller enthält/" VALUE 0x80038DE0 Kw_Wu8 1.000 OneToOne 0.00 1.000 EXTENDED_LIMITS 0.00 255.0 /end CHARACTERISTIC
/begin CHARACTERISTIC ECBVlv_PwmOut.swtPsInv_C "Struktur, die Parameter zur Fehlerbehandlung der PWM-Ausgangsendstufe für den AGR-Kühler-Bypassventilsteller enthält/" VALUE 0x80038DE1 Kw_Wu8 1.000 OneToOne 0.00 1.000 EXTENDED_LIMITS 0.00 255.0 /end CHARACTERISTIC
/begin CHARACTERISTIC ECBVlv_rCnv_CUR "Umwandlungskennlinie wird zur Umsetzung des prozentualen Werts in das Tastverhältnis verwendet" CURVE 0x80038DE2 Cur_Xs16Ws16 100.0000 DtyCyc 0.00 100.0000 EXTENDED_LIMITS -327.6800 327.6700
 /begin AXIS_DESCR STD_AXIS ECBVlv_r Prc 16 -400.0000 399.9878 DEPOSIT ABSOLUTE /end AXIS_DESCR
/end CHARACTERISTIC
/begin CHARACTERISTIC ECBVlv_RmpSlp.Pos_C "Struktur, die Rampensteigungen für Reaktion bei Fehlern im ECB-Ventilpositionssensor enthält/" VALUE 0x80038DC0 Kw_Ws32 399999.999814 RmpPrc 0.00 399999.999814 FORMAT "%13.6" EXTENDED_LIMITS -400000.000000 399999.999814 /end CHARACTERISTIC
/begin CHARACTERISTIC ECBVlv_RmpSlp.Neg_C "Struktur, die Rampensteigungen für Reaktion bei Fehlern im ECB-Ventilpositionssensor enthält/" VALUE 0x80038DC4 Kw_Ws32 399999.999814 RmpPrc 0.00 399999.999814 FORMAT "%13.6" EXTENDED_LIMITS -400000.000000 399999.999814 /end CHARACTERISTIC
/begin CHARACTERISTIC ECBVlv_rPsDisbl_C "Ausgangstastverhältnis, wenn Endstufe deaktiviert ist" VALUE 0x80038E24 Val_Ws16 655.3500 DtyCyc -327.6800 327.6700 /end CHARACTERISTIC
/begin CHARACTERISTIC ECBVlv_rTransf_CUR "Umwandlungskennlinie zur Konvertierung der Rohspannung in den prozentualen Anteil der ECB-Ventilposition." CURVE 0x80038D78 Cur_Xs16Ws16 799.9878 Prc -400.0000 399.9878
 /begin AXIS_DESCR STD_AXIS ECBVlv_uRaw Volt 16 -6553.600 6553.400 DEPOSIT ABSOLUTE /end AXIS_DESCR
/end CHARACTERISTIC
/begin CHARACTERISTIC ECBVlv_SRC.uMin_C "Struktur zum Speichern der SRC-Schwellen für den ADU-Spannungswert der ECB-Ventilposition/" VALUE 0x80038DBA Kw_Ws16 13107.00 Volt -6553.600 6553.400 /end CHARACTERISTIC
/begin CHARACTERISTIC ECBVlv_SRC.uMax_C "Struktur zum Speichern der SRC-Schwellen für den ADU-Spannungswert der ECB-Ventilposition/" VALUE 0x80038DBC Kw_Ws16 13107.00 Volt -6553.600 6553.400 /end CHARACTERISTIC
/begin CHARACTERISTIC ECBVlv_stPsDiaDisbl_C "Applikationsparameter zur Sperrung der Diagnose der Endstufe für den AGR-Kühler-Bypassventilsteller unter bestimmten Batterie- und Motorbedingungen" VALUE 0x80038E26 Val_Wu8 255.0 OneToOne 0.00 255.0 /end CHARACTERISTIC
/begin CHARACTERISTIC ECBVlv_stPsDisbl_C "Applikationsparameter zur Sperrung der Endstufe für den AGR-Kühler-Bypassventilsteller unter bestimmten Batterie- und Motorbedingungen" VALUE 0x80038E27 Val_Wu8 255.0 OneToOne 0.00 255.0 /end CHARACTERISTIC
/begin CHARACTERISTIC ECBVlv_TransStg.Dfl_C "Struktur, die feste Ersatzwerte und das Statuswort zur Festlegung der Reaktion bei Fehlern im ECB-Ventilpositionssensor enthält/" VALUE 0x80038DC8 Kw_Ws16 799.9878 Prc -400.0000 399.9878 /end CHARACTERISTIC
/begin CHARACTERISTIC ECBVlv_TransStg.stSensId_C "Struktur, die feste Ersatzwerte und das Statuswort zur Festlegung der Reaktion bei Fehlern im ECB-Ventilpositionssensor enthält/" VALUE 0x80038DCA Kw_Wu8 255.0 OneToOne 0.00 255.0 /end CHARACTERISTIC
/begin CHARACTERISTIC edc2layer_bkwdrehtHi_C "" VALUE 0x80063A9C Val_Ws16 32767.50 EngN -16384.00 16383.50 /end CHARACTERISTIC
/begin CHARACTERISTIC edc2layer_bkwdrehtLo_C "" VALUE 0x80063A9E Val_Ws16 32767.50 EngN -16384.00 16383.50 /end CHARACTERISTIC
/begin CHARACTERISTIC edc2layer_B_ulcp_C "" VALUE 0x80063AA0 Val_Wu8 255.0 OneToOne 0.00 255.0 /end CHARACTERISTIC
/begin CHARACTERISTIC edc2layer_nbmsastopt_C "" VALUE 0x80063AA2 Val_Ws16 32767.50 EngN -16384.00 16383.50 /end CHARACTERISTIC
/begin CHARACTERISTIC edc2layer_nB_ll_High_C "" VALUE 0x80063AA4 Val_Ws16 32767.50 EngN -16384.00 16383.50 /end CHARACTERISTIC
/begin CHARACTERISTIC edc2layer_nB_ll_Low_C "" VALUE 0x80063AA6 Val_Ws16 32767.50 EngN -16384.00 16383.50 /end CHARACTERISTIC
/begin CHARACTERISTIC edc2layer_nSetPointHigh_C "" VALUE 0x80063AA8 Val_Ws16 32767.50 EngN -16384.00 16383.50 /end CHARACTERISTIC
/begin CHARACTERISTIC edc2layer_nSetPointLow_C "" VALUE 0x80063AAA Val_Ws16 32767.50 EngN -16384.00 16383.50 /end CHARACTERISTIC
/begin CHARACTERISTIC edc2layer_rLoadMax_C "" VALUE 0x80063AAC Val_Ws16 799.9878 Prc -400.0000 399.9878 /end CHARACTERISTIC
/begin CHARACTERISTIC edc2layer_rLoadMin_C "" VALUE 0x80063AAE Val_Ws16 799.9878 Prc -400.0000 399.9878 /end CHARACTERISTIC
/begin CHARACTERISTIC EGRClg_ClgOff_CUR "Kennlinie untere Grenze für zu hohe Einspritzmenge bzw hoher innere Drehmoment" CURVE 0x80038E28 Kl_Xs16_Ws16 327.6700 InjMass 0.00 327.6700 EXTENDED_LIMITS -327.6800 327.6700
 /begin AXIS_DESCR STD_AXIS Epm_nEng EngN 16 0.00 10000.00 EXTENDED_LIMITS -16384.00 16383.50 DEPOSIT ABSOLUTE /end AXIS_DESCR
/end CHARACTERISTIC
/begin CHARACTERISTIC EGRClg_ClgOn_CUR "Kennlinie obere Grenze für zu hohe Einspritzmenge bzw hoher innere Drehmoment" CURVE 0x80038E6A Kl_Xs16_Ws16 327.6700 InjMass 0.00 327.6700 EXTENDED_LIMITS -327.6800 327.6700
 /begin AXIS_DESCR STD_AXIS Epm_nEng EngN 16 0.00 10000.00 EXTENDED_LIMITS -16384.00 16383.50 DEPOSIT ABSOLUTE /end AXIS_DESCR
/end CHARACTERISTIC
/begin CHARACTERISTIC EGRClg_numAirTempCtlVal_C "Parameter zur Auswahl der virtuellen Lufttemperatur aus dem AirSys-Temperaturfeld." VALUE 0x80038EAC Val_Wu8 3.00000000000 AirTempFldSel 0.00 3.00000000000 FORMAT "%13.11" /end CHARACTERISTIC
/begin CHARACTERISTIC EGRClg_numEngTempCtlVal_C "Index zur Auswahl der Motortemperatur für die Ansteuerung des ARF-Kühler-Bypass-Ventils" VALUE 0x80038EAD Kw_Wu8 3.00000000000 EngTempFldSel 0.00 3.00000000000 FORMAT "%13.11" /end CHARACTERISTIC
/begin CHARACTERISTIC EGRClg_numTempSensPrePFlt_C "" VALUE 0x80038EAE Val_Wu8 8.000 OneToOne 0.00 8.000 EXTENDED_LIMITS 0.00 255.0 /end CHARACTERISTIC
/begin CHARACTERISTIC EGRClg_rAirCtlClgOff_C "" VALUE 0x80038EB0 Val_Ws16 100.0000 Prc 0.00 100.0000 EXTENDED_LIMITS -400.0000 399.9878 /end CHARACTERISTIC
/begin CHARACTERISTIC EGRClg_rClgOff_C "ARF-Kühler-Bypass-Ventils geöffne" VALUE 0x80038EB2 Kw_Ws16 100.0000 Prc 0.00 100.0000 EXTENDED_LIMITS -400.0000 399.9878 /end CHARACTERISTIC
/begin CHARACTERISTIC EGRClg_rClgOn_C "ARF-Kühler-Bypass-Ventils geschlossen" VALUE 0x80038EB4 Kw_Ws16 100.0000 Prc 0.00 100.0000 EXTENDED_LIMITS -400.0000 399.9878 /end CHARACTERISTIC
/begin CHARACTERISTIC EGRClg_rDflVal_CA "Vorgabewerte für Abschaltfälle des ARF-Kühler-Bypass" VAL_BLK 0x80038EB6 ValA_Ws16 799.9878 Prc -400.0000 399.9878 NUMBER 3 /end CHARACTERISTIC
/begin CHARACTERISTIC EGRClg_stBitMskCtlVal_C "Maske zur Aktivierung der Ansteuerung des ARF-Kühler-Bypass-Ventils" VALUE 0x80038EBC Kw_Wu32 4294967295.00 OneToOne 0.00 4294967295.00 /end CHARACTERISTIC
/begin CHARACTERISTIC EGRClg_stBitMskEOM_CA "Bitmaske zur Auswahl der relevanten Abschaltfälle für die gewählte Betriebsart für ARF-Kühler-Bypass" VAL_BLK 0x80038EC0 ValA_Wu32 4294967295.00 OneToOne 0.00 4294967295.00 NUMBER 5 /end CHARACTERISTIC
/begin CHARACTERISTIC EGRClg_stMonEOMMsk_CA "Bitmaske zur Umschaltung zwischen den unterschiedlichen Betriebsarten" VAL_BLK 0x80038ED4 ValA_Wu32 4294967295.00 OneToOne 0.00 4294967295.00 NUMBER 5 /end CHARACTERISTIC
/begin CHARACTERISTIC EGRClg_stPrioMon_CA "Prioritäten der Abschlatfälle des ARF-Kühler-Bypass" VAL_BLK 0x80038EE8 ValA_Ws16 65535.00 OneToOne -32768.00 32767.00 NUMBER 3 /end CHARACTERISTIC
/begin CHARACTERISTIC EGRClg_stShOffEOMMsk_C "Bitmaske zur Auswahl der relevanten Abschaltfälle im Regenerationsbetrib für ARF-Kühler-Bypass" VALUE 0x80038EF0 Kw_Wu32 4294967295.00 OneToOne 0.00 4294967295.00 /end CHARACTERISTIC
/begin CHARACTERISTIC EGRClg_tAirClgOff_C "" VALUE 0x80038EF4 Val_Ws16 180.0000 Temp_Cels -30.04000 149.9600 EXTENDED_LIMITS -3549.940 3003.560 /end CHARACTERISTIC
/begin CHARACTERISTIC EGRClg_tAirClgOn_C "" VALUE 0x80038EF6 Val_Ws16 180.0000 Temp_Cels -30.04000 149.9600 EXTENDED_LIMITS -3549.940 3003.560 /end CHARACTERISTIC
/begin CHARACTERISTIC EGRClg_tCldStrtThres_C "Temperatur-Schwellewert für die Kaltstarterkennung" VALUE 0x80038EF8 Kw_Ws16 250.0000 Temp_Cels -50.14000 199.8600 EXTENDED_LIMITS -3549.940 3003.560 /end CHARACTERISTIC
/begin CHARACTERISTIC EGRClg_tEngClgOff_C "unterer Schwellwert der Temperatur aus Motortemperaturfeld" VALUE 0x80038EFA Kw_Ws16 250.0000 Temp_Cels -50.14000 199.8600 EXTENDED_LIMITS -3549.940 3003.560 /end CHARACTERISTIC
/begin CHARACTERISTIC EGRClg_tEngClgOn_C "oberer Schwellwert der Temperatur aus Motortemperaturfeld" VALUE 0x80038EFC Kw_Ws16 250.0000 Temp_Cels -50.14000 199.8600 EXTENDED_LIMITS -3549.940 3003.560 /end CHARACTERISTIC
/begin CHARACTERISTIC EGRClg_tEngLowClgOff_C "" VALUE 0x80038EFE Val_Ws16 180.0000 Temp_Cels -30.04000 149.9600 EXTENDED_LIMITS -3549.940 3003.560 /end CHARACTERISTIC
/begin CHARACTERISTIC EGRClg_tEngLowClgOn_C "" VALUE 0x80038F00 Val_Ws16 180.0000 Temp_Cels -30.04000 149.9600 EXTENDED_LIMITS -3549.940 3003.560 /end CHARACTERISTIC
/begin CHARACTERISTIC EGRClg_tiCldStrt_C "Zeit für die Aktivierung des ARF-Kühler-Bypasses bei Kaltstart" VALUE 0x80038F02 Kw_Ws16 300.0000 Time_s 0.00 300.0000 EXTENDED_LIMITS -327.6800 327.6700 /end CHARACTERISTIC
/begin CHARACTERISTIC EGRClg_tiMonEOM_CA "Zeitverzögerung zur Umschaltung zwischen normaler Maskierung und Maskierung des Regenerationsbetriebs" VAL_BLK 0x80038F04 ValA_Ws16 655350.0 TimeDeb -327680.0 327670.0 NUMBER 5 /end CHARACTERISTIC
/begin CHARACTERISTIC EGRClg_tPrePFltBypOn_C "" VALUE 0x80038F0E Val_Ws16 180.0000 Temp_Cels -30.04000 149.9600 EXTENDED_LIMITS -3549.940 3003.560 /end CHARACTERISTIC
/begin CHARACTERISTIC EGRVlvLP_ctStrtOfsLrn_C "" VALUE 0x80063E24 Val_Wu16 65535.00 OneToOne 0.00 65535.00 /end CHARACTERISTIC
/begin CHARACTERISTIC EGRVlvLP_DKdNgv_C "Für negative Großsignale." VALUE 0x80063B94 Val_Ws32 10.0000000000 Kd 0.00 10.0000000000 FORMAT "%13.10" EXTENDED_LIMITS -32768.0000000 32767.9999847 /end CHARACTERISTIC
/begin CHARACTERISTIC EGRVlvLP_DKdPsv_C "Für positive Großsignale." VALUE 0x80063B98 Val_Ws32 10.0000000000 Kd 0.00 10.0000000000 FORMAT "%13.10" EXTENDED_LIMITS -32768.0000000 32767.9999847 /end CHARACTERISTIC
/begin CHARACTERISTIC EGRVlvLP_drActNgv_C "Schwellwert für Ventilhub bei Erkennung auf langsames Schließen." VALUE 0x80063B9C Val_Ws16 1000.000 VlvVel 0.00 1000.000 FORMAT "%8.3" EXTENDED_LIMITS -4000.000 3999.878 /end CHARACTERISTIC
/begin CHARACTERISTIC EGRVlvLP_facAdapClsStrt_C "Integrator-Initialisierungsfaktor." VALUE 0x80063E26 Val_Ws16 4.000000 Fact 0.00 4.000000 EXTENDED_LIMITS -4.000000 3.999878 /end CHARACTERISTIC
/begin CHARACTERISTIC EGRVlvLP_facAdapPosCls_C "Faktor zur Berechnung des AGR-Ventils in geschlossener Stellung." VALUE 0x80063E28 Val_Ws16 4.000000 Fact 0.00 4.000000 EXTENDED_LIMITS -4.000000 3.999878 /end CHARACTERISTIC
/begin CHARACTERISTIC EGRVlvLP_facCorStrt_C "Kompensation des Korrekturfaktors im Zustand START" VALUE 0x80038F10 Val_Ws16 7.999878 Fact -4.000000 3.999878 /end CHARACTERISTIC
/begin CHARACTERISTIC EGRVlvLP_facStepThres_C "" VALUE 0x80063B2C Val_Ws16 2.000000 Fact 0.00 2.000000 EXTENDED_LIMITS -4.000000 3.999878 /end CHARACTERISTIC
/begin CHARACTERISTIC EGRVlvLP_iEff_CUR "Kennlinie zur Ermittlung des Effektivstroms" CURVE 0x80063B9E Cur_Xs16Ws16 10.00000 Curr_A 0.00 10.00000 FORMAT "%8.5" EXTENDED_LIMITS -327.6800 327.6700
 /begin AXIS_DESCR STD_AXIS EGRVlvLP_rPs DtyCyc 8 0.00 100.0000 EXTENDED_LIMITS -327.6800 327.6700 DEPOSIT ABSOLUTE /end AXIS_DESCR
/end CHARACTERISTIC
/begin CHARACTERISTIC EGRVlvLP_IKiNgv_C "Für negative Großsignale." VALUE 0x80063BC0 Val_Ws32 99.9998301268 Ki 0.00 99.9998301268 FORMAT "%13.9" EXTENDED_LIMITS -1000000.00000 999999.999534 /end CHARACTERISTIC
/begin CHARACTERISTIC EGRVlvLP_IKiOfsLrnDwn_C "Zeitkonstante für den Integrator während des Ventil-Schließens." VALUE 0x80063E2C Val_Ws32 9999.99977648 Ki 0.00 9999.99977648 FORMAT "%13.7" EXTENDED_LIMITS -1000000.00000 999999.999534 /end CHARACTERISTIC
/begin CHARACTERISTIC EGRVlvLP_IKiOfsLrnUp_C "Zeitkonstante für den Integrator während des Ventil-Öffnens." VALUE 0x80063E30 Val_Ws32 9999.99977648 Ki 0.00 9999.99977648 FORMAT "%13.7" EXTENDED_LIMITS -1000000.00000 999999.999534 /end CHARACTERISTIC
/begin CHARACTERISTIC EGRVlvLP_IKiPsv_C "Für positive Großsignale." VALUE 0x80063BC4 Val_Ws32 99.9998301268 Ki 0.00 99.9998301268 FORMAT "%13.9" EXTENDED_LIMITS -1000000.00000 999999.999534 /end CHARACTERISTIC
/begin CHARACTERISTIC EGRVlvLP_numEngTempMon_C "Index zur Auswahl der Motortemperatur." VALUE 0x80063B2E Val_Wu8 3.00000000000 EngTempFldSel 0.00 3.00000000000 FORMAT "%13.11" /end CHARACTERISTIC
/begin CHARACTERISTIC EGRVlvLP_numTempSel_C "Temperaturwähler aus dem Motortemperaturfeld" VALUE 0x80063E34 Val_Wu8 2.00000000000 EngTempFldSel 0.00 2.00000000000 FORMAT "%13.11" EXTENDED_LIMITS 0.00 3.00000000000 /end CHARACTERISTIC
/begin CHARACTERISTIC EGRVlvLP_PKpNgv_C "Für negative Großsignale." VALUE 0x80063BC8 Val_Ws32 10.0000000000 Kp 0.00 10.0000000000 FORMAT "%13.10" EXTENDED_LIMITS -65536.0000000 65535.9999695 /end CHARACTERISTIC
/begin CHARACTERISTIC EGRVlvLP_PKpPsv_C "Für positive Großsignale." VALUE 0x80063BCC Val_Ws32 10.0000000000 Kp 0.00 10.0000000000 FORMAT "%13.10" EXTENDED_LIMITS -65536.0000000 65535.9999695 /end CHARACTERISTIC
/begin CHARACTERISTIC EGRVlvLP_PullDwnIKi_C "Ki für den Pull-Down-Integrator." VALUE 0x80063B30 Val_Ws32 100.000016391 Ki_EGRVlv 0.00 100.000016391 FORMAT "%13.9" EXTENDED_LIMITS -400000.000000 399999.999814 /end CHARACTERISTIC
/begin CHARACTERISTIC EGRVlvLP_Pwm.tiPer_C "PWM out Parameterstruktur/" VALUE 0x80038F12 Kw_Ws16 6553.500 Period -3276.800 3276.700 FORMAT "%8.3" /end CHARACTERISTIC
/begin CHARACTERISTIC EGRVlvLP_Pwm.stLvl_C "PWM out Parameterstruktur/" VALUE 0x80038F14 Kw_Wu8 255.0 OneToOne 0.00 255.0 /end CHARACTERISTIC
/begin CHARACTERISTIC EGRVlvLP_Pwm.rMaxDty_C "PWM out Parameterstruktur/" VALUE 0x80038F16 Kw_Ws16 655.3500 DtyCyc -327.6800 327.6700 /end CHARACTERISTIC
/begin CHARACTERISTIC EGRVlvLP_Pwm.rPerUn_C "PWM out Parameterstruktur/" VALUE 0x80038F18 Kw_Ws16 65535.00 OneToOne -32768.00 32767.00 /end CHARACTERISTIC
/begin CHARACTERISTIC EGRVlvLP_Pwm.tiPh_C "PWM out Parameterstruktur/" VALUE 0x80038F1A Kw_Ws16 6553.500 Period -3276.800 3276.700 FORMAT "%8.3" /end CHARACTERISTIC
/begin CHARACTERISTIC EGRVlvLP_PwmOut.rMin_C "Devlib-Diagnose Parameterstruktur./" VALUE 0x80038F1C Kw_Ws16 655.3500 DtyCyc -327.6800 327.6700 /end CHARACTERISTIC
/begin CHARACTERISTIC EGRVlvLP_PwmOut.rMax_C "Devlib-Diagnose Parameterstruktur./" VALUE 0x80038F1E Kw_Ws16 655.3500 DtyCyc -327.6800 327.6700 /end CHARACTERISTIC
/begin CHARACTERISTIC EGRVlvLP_PwmOut.tiBtwTstSCB_C "Devlib-Diagnose Parameterstruktur./" VALUE 0x80038F20 Kw_Ws16 655350.0 Time_ms -327680.0 327670.0 /end CHARACTERISTIC
/begin CHARACTERISTIC EGRVlvLP_PwmOut.tiBtwTstOT_C "Devlib-Diagnose Parameterstruktur./" VALUE 0x80038F22 Kw_Ws16 655.3500 Time_s -327.6800 327.6700 /end CHARACTERISTIC
/begin CHARACTERISTIC EGRVlvLP_PwmOut.numTstMax_C "Devlib-Diagnose Parameterstruktur./" VALUE 0x80038F24 Kw_Wu16 65535.00 OneToOne 0.00 65535.00 /end CHARACTERISTIC
/begin CHARACTERISTIC EGRVlvLP_PwmOut.swtBattCor_C "Devlib-Diagnose Parameterstruktur./" VALUE 0x80038F26 Kw_Wu8 255.0 OneToOne 0.00 255.0 /end CHARACTERISTIC
/begin CHARACTERISTIC EGRVlvLP_PwmOut.swtPsInv_C "Devlib-Diagnose Parameterstruktur./" VALUE 0x80038F27 Kw_Wu8 255.0 OneToOne 0.00 255.0 /end CHARACTERISTIC
/begin CHARACTERISTIC EGRVlvLP_rActDsblDfl_C "" VALUE 0x80063E36 Val_Ws16 100.0000 Prc 0.00 100.0000 EXTENDED_LIMITS -400.0000 399.9878 /end CHARACTERISTIC
/begin CHARACTERISTIC EGRVlvLP_rActMax_C "Maximale Schwelle der tatsächlich erfassten Ventilposition." VALUE 0x80063E38 Val_Ws16 100.0000 Prc 0.00 100.0000 EXTENDED_LIMITS -400.0000 399.9878 /end CHARACTERISTIC
/begin CHARACTERISTIC EGRVlvLP_rActMin_C "Minimale Schwelle der tatsächlich erfassten Ventilposition" VALUE 0x80063E3A Val_Ws16 100.0000 Prc 0.00 100.0000 EXTENDED_LIMITS -400.0000 399.9878 /end CHARACTERISTIC
/begin CHARACTERISTIC EGRVlvLP_rActNgv_C "Schwellwert für Ventilhub bei Erkennung auf langsames Schließen." VALUE 0x80063BD0 Val_Ws16 100.0000 Prc 0.00 100.0000 EXTENDED_LIMITS -400.0000 399.9878 /end CHARACTERISTIC
/begin CHARACTERISTIC EGRVlvLP_rActOfs_C "Offset-Korrekturwert" VALUE 0x80063E3C Val_Ws16 100.0000 Prc 0.00 100.0000 EXTENDED_LIMITS -400.0000 399.9878 /end CHARACTERISTIC
/begin CHARACTERISTIC EGRVlvLP_rAdapAgOpnMax_C "Maximaler Öffnungswinkel" VALUE 0x80063E3E Val_Ws16 100.0000 Prc 0.00 100.0000 EXTENDED_LIMITS -400.0000 399.9878 /end CHARACTERISTIC
/begin CHARACTERISTIC EGRVlvLP_rAdapAgOpnMin_C "Minimaler Öffnungswinkel" VALUE 0x80063E40 Val_Ws16 100.0000 Prc 0.00 100.0000 EXTENDED_LIMITS -400.0000 399.9878 /end CHARACTERISTIC
/begin CHARACTERISTIC EGRVlvLP_rAdapDiffPlausLgT_C "Langfristige Driftschwelle" VALUE 0x80063E42 Val_Ws16 100.0000 Prc 0.00 100.0000 EXTENDED_LIMITS -400.0000 399.9878 /end CHARACTERISTIC
/begin CHARACTERISTIC EGRVlvLP_rAdapDiffPlausShT_C "Kurzfristige Driftschwelle" VALUE 0x80063E44 Val_Ws16 100.0000 Prc 0.00 100.0000 EXTENDED_LIMITS -400.0000 399.9878 /end CHARACTERISTIC
/begin CHARACTERISTIC EGRVlvLP_rAdapIniOpn0_C "Initialisierungswert für den Integrator für das Öffnungsventil (zum ersten Mal)." VALUE 0x80063E46 Val_Ws16 100.0000 Prc 0.00 100.0000 EXTENDED_LIMITS -400.0000 399.9878 /end CHARACTERISTIC
/begin CHARACTERISTIC EGRVlvLP_rAdapOpnBnd_C "Initialisierungswert für den Integrator, wenn maximal zulässiger Winkel erreicht ist." VALUE 0x80063E48 Val_Ws16 100.0000 Prc 0.00 100.0000 EXTENDED_LIMITS -400.0000 399.9878 /end CHARACTERISTIC
/begin CHARACTERISTIC EGRVlvLP_rBelAir_MAP "" MAP 0x80063BD2 Map_Xs16Ys16Ws16 100.0000 Prc 0.00 100.0000 EXTENDED_LIMITS -400.0000 399.9878
 /begin AXIS_DESCR STD_AXIS AirCtlLP_mGovDvt AirMassPerCyl 5 -3000.000 3000.000 EXTENDED_LIMITS -3276.800 3276.700 DEPOSIT ABSOLUTE /end AXIS_DESCR
 /begin AXIS_DESCR STD_AXIS EGRVlvLP_rAct Prc 5 -100.0000 100.0000 EXTENDED_LIMITS -400.0000 399.9878 DEPOSIT ABSOLUTE /end AXIS_DESCR
/end CHARACTERISTIC
/begin CHARACTERISTIC EGRVlvLP_rBelCtl_MAP "" MAP 0x80063C1C Map_Xs16Ys16Ws16 100.0000 Prc 0.00 100.0000 EXTENDED_LIMITS -400.0000 399.9878
 /begin AXIS_DESCR STD_AXIS EGRVlvLP_rGovDvt Prc 5 -100.0000 100.0000 EXTENDED_LIMITS -400.0000 399.9878 DEPOSIT ABSOLUTE /end AXIS_DESCR
 /begin AXIS_DESCR STD_AXIS EGRVlvLP_rAct Prc 5 -100.0000 100.0000 EXTENDED_LIMITS -400.0000 399.9878 DEPOSIT ABSOLUTE /end AXIS_DESCR
/end CHARACTERISTIC
/begin CHARACTERISTIC EGRVlvLP_rCmpNewCtlUn_C "Vorgabewert für das neue Steuergerät." VALUE 0x80063E4A Val_Ws16 100.0000 Prc 0.00 100.0000 EXTENDED_LIMITS -400.0000 399.9878 /end CHARACTERISTIC
/begin CHARACTERISTIC EGRVlvLP_rCnv_CUR "" CURVE 0x80038F28 Kl_Xs16_Ws16 327.6700 DtyCyc 0.00 327.6700 EXTENDED_LIMITS -327.6800 327.6700
 /begin AXIS_DESCR STD_AXIS EGRVlvLP_rEGR Prc 11 0.00 399.9878 EXTENDED_LIMITS -400.0000 399.9878 DEPOSIT ABSOLUTE /end AXIS_DESCR
/end CHARACTERISTIC
/begin CHARACTERISTIC EGRVlvLP_rCtlVal_C "" VALUE 0x80063C66 Val_Ws16 75.00000 Prc 0.00 75.00000 EXTENDED_LIMITS -400.0000 399.9878 /end CHARACTERISTIC
/begin CHARACTERISTIC EGRVlvLP_rDesEGR_CUR "Kennlinie zur Anpassung des Sollwerts aus ASW." CURVE 0x80063C68 Cur_Xs16Ws16 799.9878 Prc -400.0000 399.9878
 /begin AXIS_DESCR STD_AXIS EGRVlvLP_r Prc 4 -400.0000 399.9878 DEPOSIT ABSOLUTE /end AXIS_DESCR
/end CHARACTERISTIC
/begin CHARACTERISTIC EGRVlvLP_rDvtMax_C "Maximale Abweichung" VALUE 0x80063B34 Val_Ws16 100.0000 Prc 0.00 100.0000 EXTENDED_LIMITS -400.0000 399.9878 /end CHARACTERISTIC
/begin CHARACTERISTIC EGRVlvLP_rDvtMin_C "Minimale Abweichung" VALUE 0x80063B36 Val_Ws16 100.0000 Prc -100.0000 0.00 EXTENDED_LIMITS -400.0000 399.9878 /end CHARACTERISTIC
/begin CHARACTERISTIC EGRVlvLP_rGovDvtThres_C "Schwellwert für Ausblendung des D-Anteils des PID-Reglers." VALUE 0x80063C7A Val_Ws16 100.0000 Prc 0.00 100.0000 EXTENDED_LIMITS -400.0000 399.9878 /end CHARACTERISTIC
/begin CHARACTERISTIC EGRVlvLP_rGovMax_CUR "Kennlinie zur Ermittlung des unteren Grenzwertes des PID-Reglerausgangs." CURVE 0x80063C7C Cur_Xs16Ws16 100.0000 Prc 0.00 100.0000 EXTENDED_LIMITS -400.0000 399.9878
 /begin AXIS_DESCR STD_AXIS EGRVlvLP_iEffFlt_mp Curr_A 3 0.00 10.00000 FORMAT "%8.5" EXTENDED_LIMITS -327.6800 327.6700 DEPOSIT ABSOLUTE /end AXIS_DESCR
/end CHARACTERISTIC
/begin CHARACTERISTIC EGRVlvLP_rGovMin_CUR "Kennlinie zur Ermittlung des unteren Grenzwertes des PID-Reglerausgangs" CURVE 0x80063C8A Cur_Xs16Ws16 100.0000 Prc -100.0000 0.00 EXTENDED_LIMITS -400.0000 399.9878
 /begin AXIS_DESCR STD_AXIS EGRVlvLP_iEffFlt_mp Curr_A 3 0.00 10.00000 FORMAT "%8.5" EXTENDED_LIMITS -327.6800 327.6700 DEPOSIT ABSOLUTE /end AXIS_DESCR
/end CHARACTERISTIC
/begin CHARACTERISTIC EGRVlvLP_rGvnrPreMax_C "" VALUE 0x80063C98 Val_Ws16 100.0000 Prc 0.00 100.0000 EXTENDED_LIMITS -400.0000 399.9878 /end CHARACTERISTIC
/begin CHARACTERISTIC EGRVlvLP_rGvnrPreMin_C "" VALUE 0x80063C9A Val_Ws16 100.0000 Prc 0.00 100.0000 EXTENDED_LIMITS -400.0000 399.9878 /end CHARACTERISTIC
/begin CHARACTERISTIC EGRVlvLP_rJamVlvOpnDemMax_C "Anforderung-Schwellenerkennung für das klemmende Ventil in offenem Zustand" VALUE 0x80063B38 Val_Ws16 100.0000 Prc 0.00 100.0000 EXTENDED_LIMITS -400.0000 399.9878 /end CHARACTERISTIC
/begin CHARACTERISTIC EGRVlvLP_rJamVlvOpnHi_C "Obere Schwelle für die Hysterese zur Rauscheffekt-Beseitigung in der erfassten Stellung." VALUE 0x80063B3A Val_Ws16 100.0000 Prc 0.00 100.0000 EXTENDED_LIMITS -400.0000 399.9878 /end CHARACTERISTIC
/begin CHARACTERISTIC EGRVlvLP_rJamVlvOpnLo_C "Untere Schwelle für die Hysterese zur Rauscheffekt-Beseitigung in der erfassten Stellung." VALUE 0x80063B3C Val_Ws16 100.0000 Prc 0.00 100.0000 EXTENDED_LIMITS -400.0000 399.9878 /end CHARACTERISTIC
/begin CHARACTERISTIC EGRVlvLP_rLMSActThresDwn_C "Istwertschwelle zur LMS-Erkennung" VALUE 0x80063B3E Val_Ws16 100.0000 Prc 0.00 100.0000 EXTENDED_LIMITS -400.0000 399.9878 /end CHARACTERISTIC
/begin CHARACTERISTIC EGRVlvLP_rLMSThresDwn_C "Sollwertschwelle zur LMS-Erkennung" VALUE 0x80063B40 Val_Ws16 100.0000 Prc 0.00 100.0000 EXTENDED_LIMITS -400.0000 399.9878 /end CHARACTERISTIC
/begin CHARACTERISTIC EGRVlvLP_rLMSThresUp_C "Schwelle zum Zurücksetzen des LMS-Erkennungbits" VALUE 0x80063B42 Val_Ws16 100.0000 Prc 0.00 100.0000 EXTENDED_LIMITS -400.0000 399.9878 /end CHARACTERISTIC
/begin CHARACTERISTIC EGRVlvLP_RlsIKi_C "Ki für den Freigabeintegrator." VALUE 0x80063B44 Val_Ws32 18.6264514923 Ki_EGRVlv 0.00 18.6264514923 FORMAT "%13.10" EXTENDED_LIMITS -400000.000000 399999.999814 /end CHARACTERISTIC
/begin CHARACTERISTIC EGRVlvLP_RmpSlp.Pos_C "Rampensteigungstrukturen enthaltende Struktur/" VALUE 0x80063E4C Kw_Ws32 399999.999814 RmpPrc 0.00 399999.999814 FORMAT "%13.6" EXTENDED_LIMITS -400000.000000 399999.999814 /end CHARACTERISTIC
/begin CHARACTERISTIC EGRVlvLP_RmpSlp.Neg_C "Rampensteigungstrukturen enthaltende Struktur/" VALUE 0x80063E50 Kw_Ws32 399999.999814 RmpPrc 0.00 399999.999814 FORMAT "%13.6" EXTENDED_LIMITS -400000.000000 399999.999814 /end CHARACTERISTIC
/begin CHARACTERISTIC EGRVlvLP_rOfsLrnVlvMax_C "Obere Grenze des Steuerwertes für das Offset-Lernen." VALUE 0x80063E54 Val_Ws16 100.0000 Prc 0.00 100.0000 EXTENDED_LIMITS -400.0000 399.9878 /end CHARACTERISTIC
/begin CHARACTERISTIC EGRVlvLP_rOfsLrnVlvMin_C "Untere Grenze des Steuerwertes für das Offset-Lernen." VALUE 0x80063E56 Val_Ws16 200.0000 Prc -100.0000 100.0000 EXTENDED_LIMITS -400.0000 399.9878 /end CHARACTERISTIC
/begin CHARACTERISTIC EGRVlvLP_rOfsMax_C "Maximaler plausibler Offset." VALUE 0x80063E58 Val_Ws16 19.99512 Prc -9.997559 9.997559 EXTENDED_LIMITS -400.0000 399.9878 /end CHARACTERISTIC
/begin CHARACTERISTIC EGRVlvLP_rOfsMin_C "Minimaler plausibler Offset." VALUE 0x80063E5A Val_Ws16 19.99512 Prc -9.997559 9.997559 EXTENDED_LIMITS -400.0000 399.9878 /end CHARACTERISTIC
/begin CHARACTERISTIC EGRVlvLP_rOutDMax_C "Maximal zulässige Stellgröße des D-Anteils des PID-Reglers" VALUE 0x80063C9C Val_Ws16 100.0000 Prc 0.00 100.0000 EXTENDED_LIMITS -400.0000 399.9878 /end CHARACTERISTIC
/begin CHARACTERISTIC EGRVlvLP_rOutIMax_C "Oberer Grenzwert des I-Anteils des Lagereglers." VALUE 0x80063C9E Val_Ws16 100.0000 Prc 0.00 100.0000 EXTENDED_LIMITS -400.0000 399.9878 /end CHARACTERISTIC
/begin CHARACTERISTIC EGRVlvLP_rPIDWinNgv_C "Negative Fenstergrenze" VALUE 0x80063CA0 Val_Ws16 100.0000 Prc -100.0000 0.00 EXTENDED_LIMITS -400.0000 399.9878 /end CHARACTERISTIC
/begin CHARACTERISTIC EGRVlvLP_rPIDWinPsv_C "Positive Fenstergrenze" VALUE 0x80063CA2 Val_Ws16 100.0000 Prc 0.00 100.0000 EXTENDED_LIMITS -400.0000 399.9878 /end CHARACTERISTIC
/begin CHARACTERISTIC EGRVlvLP_rPullDwnMax_C "Maximaler Ausgang für die Pull-Down-Funktion" VALUE 0x80063B48 Val_Ws16 100.0000 Prc 0.00 100.0000 EXTENDED_LIMITS -400.0000 399.9878 /end CHARACTERISTIC
/begin CHARACTERISTIC EGRVlvLP_rRlsMax_C "Maximaler Ausgang für die Freigabefunktion" VALUE 0x80063B4A Val_Ws16 100.0000 Prc 0.00 100.0000 EXTENDED_LIMITS -400.0000 399.9878 /end CHARACTERISTIC
/begin CHARACTERISTIC EGRVlvLP_rRmp_C "" VALUE 0x80063CA4 Val_Ws16 75.00000 Prc 0.00 75.00000 EXTENDED_LIMITS -400.0000 399.9878 /end CHARACTERISTIC
/begin CHARACTERISTIC EGRVlvLP_rSensVlvThres_C "Schwelle zur Erkennung des unteren Anschlags" VALUE 0x80063E5C Val_Ws16 100.0000 Prc 0.00 100.0000 EXTENDED_LIMITS -400.0000 399.9878 /end CHARACTERISTIC
/begin CHARACTERISTIC EGRVlvLP_rTransf_CUR "Umwandlungskennlinie" CURVE 0x80063ADC Cur_Xs16Ws16 100.0000 Prc 0.00 100.0000 EXTENDED_LIMITS -400.0000 399.9878
 /begin AXIS_DESCR STD_AXIS EGRVlvLP_uRaw Volt 8 0.00 5200.000 EXTENDED_LIMITS -6553.600 6553.400 DEPOSIT ABSOLUTE /end AXIS_DESCR
/end CHARACTERISTIC
/begin CHARACTERISTIC EGRVlvLP_SlwClsDKd_C "Für langsames Schließen." VALUE 0x80063CA8 Val_Ws32 10.0000000000 Kd 0.00 10.0000000000 FORMAT "%13.10" EXTENDED_LIMITS -32768.0000000 32767.9999847 /end CHARACTERISTIC
/begin CHARACTERISTIC EGRVlvLP_SlwClsIKi_C "Für langsames Schließen." VALUE 0x80063CAC Val_Ws32 99.9998301268 Ki 0.00 99.9998301268 FORMAT "%13.9" EXTENDED_LIMITS -1000000.00000 999999.999534 /end CHARACTERISTIC
/begin CHARACTERISTIC EGRVlvLP_SlwClsPKp_C "Für langsames Schließen." VALUE 0x80063CB0 Val_Ws32 10.0000000000 Kp 0.00 10.0000000000 FORMAT "%13.10" EXTENDED_LIMITS -65536.0000000 65535.9999695 /end CHARACTERISTIC
/begin CHARACTERISTIC EGRVlvLP_SmlSigNgvDKd_C "Für negative Kleinsignale." VALUE 0x80063CB4 Val_Ws32 10.0000000000 Kd 0.00 10.0000000000 FORMAT "%13.10" EXTENDED_LIMITS -32768.0000000 32767.9999847 /end CHARACTERISTIC
/begin CHARACTERISTIC EGRVlvLP_SmlSigNgvIKi_C "Für negative Kleinsignale" VALUE 0x80063CB8 Val_Ws32 99.9998301268 Ki 0.00 99.9998301268 FORMAT "%13.9" EXTENDED_LIMITS -1000000.00000 999999.999534 /end CHARACTERISTIC
/begin CHARACTERISTIC EGRVlvLP_SmlSigNgvPKp_C "Für negative Kleinsignale." VALUE 0x80063CBC Val_Ws32 131071.999969 Kp -65536.0000000 65535.9999695 FORMAT "%13.7" /end CHARACTERISTIC
/begin CHARACTERISTIC EGRVlvLP_SmlSigPsvDKd_C "Für positive Kleinsignale." VALUE 0x80063CC0 Val_Ws32 10.0000000000 Kd 0.00 10.0000000000 FORMAT "%13.10" EXTENDED_LIMITS -32768.0000000 32767.9999847 /end CHARACTERISTIC
/begin CHARACTERISTIC EGRVlvLP_SmlSigPsvIKi_C "Für positive Kleinsignale." VALUE 0x80063CC4 Val_Ws32 99.9998301268 Ki 0.00 99.9998301268 FORMAT "%13.9" EXTENDED_LIMITS -1000000.00000 999999.999534 /end CHARACTERISTIC
/begin CHARACTERISTIC EGRVlvLP_SmlSigPsvPKp_C "Für positive Kleinsignale." VALUE 0x80063CC8 Val_Ws32 10.0000000000 Kp 0.00 10.0000000000 FORMAT "%13.10" EXTENDED_LIMITS -65536.0000000 65535.9999695 /end CHARACTERISTIC
/begin CHARACTERISTIC EGRVlvLP_SRC.uMin_C "Struktur zum Einhalten der SRC-Schwelle./" VALUE 0x80063AFE Kw_Ws16 5200.000 Volt 0.00 5200.000 EXTENDED_LIMITS -6553.600 6553.400 /end CHARACTERISTIC
/begin CHARACTERISTIC EGRVlvLP_SRC.uMax_C "Struktur zum Einhalten der SRC-Schwelle./" VALUE 0x80063B00 Kw_Ws16 5200.000 Volt 0.00 5200.000 EXTENDED_LIMITS -6553.600 6553.400 /end CHARACTERISTIC
/begin CHARACTERISTIC EGRVlvLP_stAirCtlMon_C "" VALUE 0x80063B4C Val_Wu8 255.0 OneToOne 0.00 255.0 /end CHARACTERISTIC
/begin CHARACTERISTIC EGRVlvLP_stNewVlvTrg_C "Trigger für neues Ventil" VALUE 0x80063E5E Val_Wu8 1.000 OneToOne 0.00 1.000 EXTENDED_LIMITS 0.00 255.0 /end CHARACTERISTIC
/begin CHARACTERISTIC EGRVlvLP_stOfsLrnTrg_C "Auslöser für Offset-Lernen" VALUE 0x80063E5F Val_Wu8 1.000 OneToOne 0.00 1.000 EXTENDED_LIMITS 0.00 255.0 /end CHARACTERISTIC
/begin CHARACTERISTIC EGRVlvLP_stPwrStgDiaDis_C "Maske zur Auswahl der Sperrbedingungen von Endstufediagnose" VALUE 0x80038F56 Val_Wu8 255.0 OneToOne 0.00 255.0 /end CHARACTERISTIC
/begin CHARACTERISTIC EGRVlvLP_stPwrStgDis_C "Maske zur Auswahl der Sperrbedingungen der Endstufe" VALUE 0x80038F57 Val_Wu8 255.0 OneToOne 0.00 255.0 /end CHARACTERISTIC
/begin CHARACTERISTIC EGRVlvLP_swtActOfs_C "Schalter zur Aktivierung des Offsetkorrektur-Ersatzwerts." VALUE 0x80063E60 Val_Wu8 1.000 OneToOne 0.00 1.000 EXTENDED_LIMITS 0.00 255.0 /end CHARACTERISTIC
/begin CHARACTERISTIC EGRVlvLP_swtAirCtlOn_C "" VALUE 0x80063B4D Val_Wu8 1.000 OneToOne 0.00 1.000 EXTENDED_LIMITS 0.00 255.0 /end CHARACTERISTIC
/begin CHARACTERISTIC EGRVlvLP_swtBelCtl_C "" VALUE 0x80063CCC Val_Wu8 1.000 OneToOne 0.00 1.000 EXTENDED_LIMITS 0.00 255.0 /end CHARACTERISTIC
/begin CHARACTERISTIC EGRVlvLP_swtGovByp_C "Schalter zum Umgehen des Lagereglers" VALUE 0x80063B4E Val_Wu8 1.000 OneToOne 0.00 1.000 EXTENDED_LIMITS 0.00 255.0 /end CHARACTERISTIC
/begin CHARACTERISTIC EGRVlvLP_swtOfsLrnActv_C "Schalter zur Freigabe/Sperrung des Offset-Lernens." VALUE 0x80063E61 Val_Wu8 255.0 OneToOne 0.00 255.0 /end CHARACTERISTIC
/begin CHARACTERISTIC EGRVlvLP_swtOpnLdDiaStrt_C "Beim Start wird die Lastabfalldiagnose benötigt. 1=ja; 0=nein" VALUE 0x80038F58 Val_Wu8 255.0 OneToOne 0.00 255.0 /end CHARACTERISTIC
/begin CHARACTERISTIC EGRVlvLP_swtSelDT1In_C "Auswahl des Eingangs des D-Reglers. 1 = Regelabweichung; 0= Stellerposition" VALUE 0x80063CCD Val_Wu8 255.0 OneToOne 0.00 255.0 /end CHARACTERISTIC
/begin CHARACTERISTIC EGRVlvLP_swtSelOvrCurrErr_C "Überstromfehler soll als Fehler gemeldet werden. 1= ja ;0=nein" VALUE 0x80038F59 Val_Wu8 255.0 OneToOne 0.00 255.0 /end CHARACTERISTIC
/begin CHARACTERISTIC EGRVlvLP_swtSensPrs_C "Schalter für Lagesensor vorhanden oder nicht." VALUE 0x80063B02 Val_Wu8 1.000 OneToOne 0.00 1.000 EXTENDED_LIMITS 0.00 255.0 /end CHARACTERISTIC
/begin CHARACTERISTIC EGRVlvLP_tEngHi_C "Obere Temperaturschwelle für die Freigabe der Überwachung der Abnormität in der AGR-Regelung." VALUE 0x80063B50 Val_Ws16 250.0000 Temp_Cels -50.14000 199.8600 EXTENDED_LIMITS -3549.940 3003.560 /end CHARACTERISTIC
/begin CHARACTERISTIC EGRVlvLP_tEngLo_C "Untere Temperaturschwelle für die Freigabe der Überwachung der Abnormität in der AGR-Regelung." VALUE 0x80063B52 Val_Ws16 250.0000 Temp_Cels -50.14000 199.8600 EXTENDED_LIMITS -3549.940 3003.560 /end CHARACTERISTIC
/begin CHARACTERISTIC EGRVlvLP_tEngMax_C "Maximalwert der Motortemperatur zur Freigabe der Nullpunktanpassung." VALUE 0x80063E62 Val_Ws16 250.0000 Temp_Cels -50.14000 199.8600 EXTENDED_LIMITS -3549.940 3003.560 /end CHARACTERISTIC
/begin CHARACTERISTIC EGRVlvLP_tEngMin_C "Minimalwert der Motortemperatur zur Freigabe der Nullpunktanpassung." VALUE 0x80063E64 Val_Ws16 250.0000 Temp_Cels -50.14000 199.8600 EXTENDED_LIMITS -3549.940 3003.560 /end CHARACTERISTIC
/begin CHARACTERISTIC EGRVlvLP_tiAdapJamVlv_C "Entprellzeit zur Erkennung eines klemmenden Ventils in offenem Zustand." VALUE 0x80063E66 Val_Ws16 20000.00 Time_ms 0.00 20000.00 EXTENDED_LIMITS -327680.0 327670.0 /end CHARACTERISTIC
/begin CHARACTERISTIC EGRVlvLP_tiAdapPullDwn_C "Zeit für Pull-Down nachdem unterer Anschlag erkannt wurde." VALUE 0x80063E68 Val_Ws16 20000.00 Time_ms 0.00 20000.00 EXTENDED_LIMITS -327680.0 327670.0 /end CHARACTERISTIC
/begin CHARACTERISTIC EGRVlvLP_tiBattCorFacFlt_C "Zeitkonstante zur Filterung des Batteriespannungskorrekturfaktors" VALUE 0x80038F5C Val_Ws32 4294.9672940 TimeDelay_s 0.000002000000001 4294.9672960 FORMAT "%12.7" /end CHARACTERISTIC
/begin CHARACTERISTIC EGRVlvLP_tiClsJamVlv_C "Entprellzeit zur Erkennung eines klemmenden Ventils in geschlossenem Zustand." VALUE 0x80063E6A Val_Ws16 20000.00 Time_ms 0.00 20000.00 EXTENDED_LIMITS -327680.0 327670.0 /end CHARACTERISTIC
/begin CHARACTERISTIC EGRVlvLP_tiCrntEffFlt_C "Parameter für PT1-Funktion." VALUE 0x80063CD0 Val_Ws32 4294.9672940 TimeDelay_s 0.000002000000001 4294.9672960 FORMAT "%12.7" /end CHARACTERISTIC
/begin CHARACTERISTIC EGRVlvLP_tiGovDT1_C "Zeitkonstante des DT1-Gliedes im PID-Regler." VALUE 0x80063CD4 Val_Ws32 4294.9662960 TimeDelay_s 0.0010000000689 4294.9672960 FORMAT "%12.7" EXTENDED_LIMITS 0.000002000000001 4294.9672960 /end CHARACTERISTIC
/begin CHARACTERISTIC EGRVlvLP_tiParDT1_C "Zeitkonstante des DT1-Gliedes zur Erkennung auf langsames Schließen" VALUE 0x80063CD8 Val_Ws32 4294.9662960 TimeDelay_s 0.0010000000689 4294.9672960 FORMAT "%12.7" EXTENDED_LIMITS 0.000002000000001 4294.9672960 /end CHARACTERISTIC
/begin CHARACTERISTIC EGRVlvLP_tiPT1rAct_C "" VALUE 0x80063E6C Val_Ws32 4294.9672940 TimeDelay_s 0.000002000000001 4294.9672960 FORMAT "%12.7" /end CHARACTERISTIC
/begin CHARACTERISTIC EGRVlvLP_tiPullDwn_C "Zeit wenn Pull-Down aktiv ist." VALUE 0x80063B54 Val_Ws16 5.000000 Time_s 0.00 5.000000 EXTENDED_LIMITS -327.6800 327.6700 /end CHARACTERISTIC
/begin CHARACTERISTIC EGRVlvLP_tiRepRls_C "Zeit zur Freigabe der Bedigung des klemmenden Ventils" VALUE 0x80063B58 Val_Ws32 3600.00000000 Time_s 0.00 3600.00000000 EXTENDED_LIMITS -21474836.4800 21474836.4700 /end CHARACTERISTIC
/begin CHARACTERISTIC EGRVlvLP_tiRls_C "Zeit wenn Freigabefunktion aktiv ist." VALUE 0x80063B5C Val_Ws16 5.000000 Time_s 0.00 5.000000 EXTENDED_LIMITS -327.6800 327.6700 /end CHARACTERISTIC
/begin CHARACTERISTIC EGRVlvLP_TransStg.Dfl_C "Transstage Struktur./" VALUE 0x80063E70 Kw_Ws16 100.0000 Prc 0.00 100.0000 EXTENDED_LIMITS -400.0000 399.9878 /end CHARACTERISTIC
/begin CHARACTERISTIC EGRVlvLP_TransStg.stSensId_C "Transstage Struktur./" VALUE 0x80063E72 Kw_Wu8 255.0 OneToOne 0.00 255.0 /end CHARACTERISTIC
/begin CHARACTERISTIC EGRVlvLP_uBattMax_C "Maximalwert der Batteriespannung zur Freigabe der Nullpunktanpassung." VALUE 0x80063E74 Val_Ws16 28600.00 Volt_Batt 0.00 28600.00 EXTENDED_LIMITS -655360.0 655340.0 /end CHARACTERISTIC
/begin CHARACTERISTIC EGRVlvLP_uBattMin_C "Minimalwert der Batteriespannung zur Freigabe der Nullpunktanpassung." VALUE 0x80063E76 Val_Ws16 28600.00 Volt_Batt 0.00 28600.00 EXTENDED_LIMITS -655360.0 655340.0 /end CHARACTERISTIC
/begin CHARACTERISTIC EGRVlv_ctStrtOfsLrn_C "Minimale startanzahl bevor die Offsetlernfunktion aktiviert wird." VALUE 0x80063E78 Val_Wu16 65535.00 OneToOne 0.00 65535.00 /end CHARACTERISTIC
/begin CHARACTERISTIC EGRVlv_DKdNgv_C "Für negative Großsignale." VALUE 0x80063CDC Val_Ws32 10.0000000000 Kd 0.00 10.0000000000 FORMAT "%13.10" EXTENDED_LIMITS -32768.0000000 32767.9999847 /end CHARACTERISTIC
/begin CHARACTERISTIC EGRVlv_DKdPsv_C "Für positive Großsignale." VALUE 0x80063CE0 Val_Ws32 10.0000000000 Kd 0.00 10.0000000000 FORMAT "%13.10" EXTENDED_LIMITS -32768.0000000 32767.9999847 /end CHARACTERISTIC
/begin CHARACTERISTIC EGRVlv_drActNgv_C "Schwellenwert für Ventilhub bei Erkennung auf langsames Schließen" VALUE 0x80063CE4 Val_Ws16 1000.000 VlvVel 0.00 1000.000 FORMAT "%8.3" EXTENDED_LIMITS -4000.000 3999.878 /end CHARACTERISTIC
/begin CHARACTERISTIC EGRVlv_facAdapClsStrt_C "Integrator-Initialisierungsfaktor." VALUE 0x80063E7A Val_Ws16 4.000000 Fact 0.00 4.000000 EXTENDED_LIMITS -4.000000 3.999878 /end CHARACTERISTIC
/begin CHARACTERISTIC EGRVlv_facAdapPosCls_C "Faktor zur Berechnung des AGR-Ventils in geschlossener Stellung." VALUE 0x80063E7C Val_Ws16 4.000000 Fact 0.00 4.000000 EXTENDED_LIMITS -4.000000 3.999878 /end CHARACTERISTIC
/begin CHARACTERISTIC EGRVlv_facCorStrt_C "Kompensation des Korrekturfaktors im Zustand START" VALUE 0x80038F60 Val_Ws16 7.999878 Fact -4.000000 3.999878 /end CHARACTERISTIC
/begin CHARACTERISTIC EGRVlv_facStepThres_C "" VALUE 0x80063B5E Val_Ws16 2.000000 Fact 0.00 2.000000 EXTENDED_LIMITS -4.000000 3.999878 /end CHARACTERISTIC
/begin CHARACTERISTIC EGRVlv_iEff_CUR "Kennlinie zur Ermittlung des Effektivstroms" CURVE 0x80063CE6 Cur_Xs16Ws16 10.00000 Curr_A 0.00 10.00000 FORMAT "%8.5" EXTENDED_LIMITS -327.6800 327.6700
 /begin AXIS_DESCR STD_AXIS EGRVlv_rPs DtyCyc 8 0.00 100.0000 EXTENDED_LIMITS -327.6800 327.6700 DEPOSIT ABSOLUTE /end AXIS_DESCR
/end CHARACTERISTIC
/begin CHARACTERISTIC EGRVlv_IKiNgv_C "Für negative Großsignale" VALUE 0x80063D08 Val_Ws32 99.9998301268 Ki 0.00 99.9998301268 FORMAT "%13.9" EXTENDED_LIMITS -1000000.00000 999999.999534 /end CHARACTERISTIC
/begin CHARACTERISTIC EGRVlv_IKiOfsLrnDwn_C "Zeitkonstante für den Integrator während des Ventil-Schließens." VALUE 0x80063E80 Val_Ws32 9999.99977648 Ki 0.00 9999.99977648 FORMAT "%13.7" EXTENDED_LIMITS -1000000.00000 999999.999534 /end CHARACTERISTIC
/begin CHARACTERISTIC EGRVlv_IKiOfsLrnUp_C "Zeitkonstante für den Integrator während des Ventil-Öffnens." VALUE 0x80063E84 Val_Ws32 9999.99977648 Ki 0.00 9999.99977648 FORMAT "%13.7" EXTENDED_LIMITS -1000000.00000 999999.999534 /end CHARACTERISTIC
/begin CHARACTERISTIC EGRVlv_IKiPsv_C "Für positive Großsignale." VALUE 0x80063D0C Val_Ws32 99.9998301268 Ki 0.00 99.9998301268 FORMAT "%13.9" EXTENDED_LIMITS -1000000.00000 999999.999534 /end CHARACTERISTIC
/begin CHARACTERISTIC EGRVlv_numEngTempMon_C "Index zur Auswahl der Motortemperatur." VALUE 0x80063B60 Val_Wu8 3.00000000000 EngTempFldSel 0.00 3.00000000000 FORMAT "%13.11" /end CHARACTERISTIC
/begin CHARACTERISTIC EGRVlv_numTempSel_C "Temperaturwähler aus dem Motortemperaturfeld" VALUE 0x80063E88 Val_Wu8 2.00000000000 EngTempFldSel 0.00 2.00000000000 FORMAT "%13.11" EXTENDED_LIMITS 0.00 3.00000000000 /end CHARACTERISTIC
/begin CHARACTERISTIC EGRVlv_PKpNgv_C "Für negative Großsignale." VALUE 0x80063D10 Val_Ws32 10.0000000000 Kp 0.00 10.0000000000 FORMAT "%13.10" EXTENDED_LIMITS -65536.0000000 65535.9999695 /end CHARACTERISTIC
/begin CHARACTERISTIC EGRVlv_PKpPsv_C "Für positive Großsignale." VALUE 0x80063D14 Val_Ws32 10.0000000000 Kp 0.00 10.0000000000 FORMAT "%13.10" EXTENDED_LIMITS -65536.0000000 65535.9999695 /end CHARACTERISTIC
/begin CHARACTERISTIC EGRVlv_PullDwnIKi_C "Ki für den Pull-Down-Integrator." VALUE 0x80063B64 Val_Ws32 100.000016391 Ki_EGRVlv 0.00 100.000016391 FORMAT "%13.9" EXTENDED_LIMITS -400000.000000 399999.999814 /end CHARACTERISTIC
/begin CHARACTERISTIC EGRVlv_Pwm.tiPer_C "PWM out Parameterstruktur/" VALUE 0x80038F62 Kw_Ws16 6553.500 Period -3276.800 3276.700 FORMAT "%8.3" /end CHARACTERISTIC
/begin CHARACTERISTIC EGRVlv_Pwm.stLvl_C "PWM out Parameterstruktur/" VALUE 0x80038F64 Kw_Wu8 255.0 OneToOne 0.00 255.0 /end CHARACTERISTIC
/begin CHARACTERISTIC EGRVlv_Pwm.rMaxDty_C "PWM out Parameterstruktur/" VALUE 0x80038F66 Kw_Ws16 655.3500 DtyCyc -327.6800 327.6700 /end CHARACTERISTIC
/begin CHARACTERISTIC EGRVlv_Pwm.rPerUn_C "PWM out Parameterstruktur/" VALUE 0x80038F68 Kw_Ws16 65535.00 OneToOne -32768.00 32767.00 /end CHARACTERISTIC
/begin CHARACTERISTIC EGRVlv_Pwm.tiPh_C "PWM out Parameterstruktur/" VALUE 0x80038F6A Kw_Ws16 6553.500 Period -3276.800 3276.700 FORMAT "%8.3" /end CHARACTERISTIC
/begin CHARACTERISTIC EGRVlv_PwmOut.rMin_C "Devlib-Diagnose Parameterstruktur./" VALUE 0x80038F6C Kw_Ws16 655.3500 DtyCyc -327.6800 327.6700 /end CHARACTERISTIC
/begin CHARACTERISTIC EGRVlv_PwmOut.rMax_C "Devlib-Diagnose Parameterstruktur./" VALUE 0x80038F6E Kw_Ws16 655.3500 DtyCyc -327.6800 327.6700 /end CHARACTERISTIC
/begin CHARACTERISTIC EGRVlv_PwmOut.tiBtwTstSCB_C "Devlib-Diagnose Parameterstruktur./" VALUE 0x80038F70 Kw_Ws16 655350.0 Time_ms -327680.0 327670.0 /end CHARACTERISTIC
/begin CHARACTERISTIC EGRVlv_PwmOut.tiBtwTstOT_C "Devlib-Diagnose Parameterstruktur./" VALUE 0x80038F72 Kw_Ws16 655.3500 Time_s -327.6800 327.6700 /end CHARACTERISTIC
/begin CHARACTERISTIC EGRVlv_PwmOut.numTstMax_C "Devlib-Diagnose Parameterstruktur./" VALUE 0x80038F74 Kw_Wu16 65535.00 OneToOne 0.00 65535.00 /end CHARACTERISTIC
/begin CHARACTERISTIC EGRVlv_PwmOut.swtBattCor_C "Devlib-Diagnose Parameterstruktur./" VALUE 0x80038F76 Kw_Wu8 255.0 OneToOne 0.00 255.0 /end CHARACTERISTIC
/begin CHARACTERISTIC EGRVlv_PwmOut.swtPsInv_C "Devlib-Diagnose Parameterstruktur./" VALUE 0x80038F77 Kw_Wu8 255.0 OneToOne 0.00 255.0 /end CHARACTERISTIC
/begin CHARACTERISTIC EGRVlv_rActMax_C "Maximale Schwelle der tatsächlich erfassten Ventilposition." VALUE 0x80063E8A Val_Ws16 100.0000 Prc 0.00 100.0000 EXTENDED_LIMITS -400.0000 399.9878 /end CHARACTERISTIC
/begin CHARACTERISTIC EGRVlv_rActMin_C "Minimale Schwelle der tatsächlich erfassten Ventilposition" VALUE 0x80063E8C Val_Ws16 100.0000 Prc 0.00 100.0000 EXTENDED_LIMITS -400.0000 399.9878 /end CHARACTERISTIC
/begin CHARACTERISTIC EGRVlv_rActNgv_C "Schwellwert für Ventilhub bei Erkennung auf langsames Schließen" VALUE 0x80063D18 Val_Ws16 100.0000 Prc 0.00 100.0000 EXTENDED_LIMITS -400.0000 399.9878 /end CHARACTERISTIC
/begin CHARACTERISTIC EGRVlv_rActOfs_C "Offset-Korrekturwert" VALUE 0x80063E8E Val_Ws16 100.0000 Prc 0.00 100.0000 EXTENDED_LIMITS -400.0000 399.9878 /end CHARACTERISTIC
/begin CHARACTERISTIC EGRVlv_rAdapAgOpnMax_C "Maximaler Öffnungswinkel" VALUE 0x80063E90 Val_Ws16 100.0000 Prc 0.00 100.0000 EXTENDED_LIMITS -400.0000 399.9878 /end CHARACTERISTIC
/begin CHARACTERISTIC EGRVlv_rAdapAgOpnMin_C "Minimaler Öffnungswinkel" VALUE 0x80063E92 Val_Ws16 100.0000 Prc 0.00 100.0000 EXTENDED_LIMITS -400.0000 399.9878 /end CHARACTERISTIC
/begin CHARACTERISTIC EGRVlv_rAdapDiffPlausLgT_C "Langfristige Driftschwelle" VALUE 0x80063E94 Val_Ws16 100.0000 Prc 0.00 100.0000 EXTENDED_LIMITS -400.0000 399.9878 /end CHARACTERISTIC
/begin CHARACTERISTIC EGRVlv_rAdapDiffPlausShT_C "Kurzfristige Driftschwelle" VALUE 0x80063E96 Val_Ws16 100.0000 Prc 0.00 100.0000 EXTENDED_LIMITS -400.0000 399.9878 /end CHARACTERISTIC
/begin CHARACTERISTIC EGRVlv_rAdapIniOpn0_C "Initialisierungswert für den Integrator für das Öffnungsventil (zum ersten Mal)." VALUE 0x80063E98 Val_Ws16 100.0000 Prc 0.00 100.0000 EXTENDED_LIMITS -400.0000 399.9878 /end CHARACTERISTIC
/begin CHARACTERISTIC EGRVlv_rAdapOpnBnd_C "nitialisierungswert für den Integrator, wenn maximal zulässiger Winkel erreicht ist." VALUE 0x80063E9A Val_Ws16 100.0000 Prc 0.00 100.0000 EXTENDED_LIMITS -400.0000 399.9878 /end CHARACTERISTIC
/begin CHARACTERISTIC EGRVlv_rBelAir_MAP "" MAP 0x80063D1A Map_Xs16Ys16Ws16 100.0000 Prc 0.00 100.0000 EXTENDED_LIMITS -400.0000 399.9878
 /begin AXIS_DESCR STD_AXIS AirCtl_mGovDvt AirMassPerCyl 5 -3000.000 3000.000 EXTENDED_LIMITS -3276.800 3276.700 DEPOSIT ABSOLUTE /end AXIS_DESCR
 /begin AXIS_DESCR STD_AXIS EGRVlv_rAct Prc 5 -100.0000 100.0000 EXTENDED_LIMITS -400.0000 399.9878 DEPOSIT ABSOLUTE /end AXIS_DESCR
/end CHARACTERISTIC
/begin CHARACTERISTIC EGRVlv_rBelCtl_MAP "" MAP 0x80063D64 Map_Xs16Ys16Ws16 100.0000 Prc 0.00 100.0000 EXTENDED_LIMITS -400.0000 399.9878
 /begin AXIS_DESCR STD_AXIS EGRVlv_rGovDvt Prc 5 -100.0000 100.0000 EXTENDED_LIMITS -400.0000 399.9878 DEPOSIT ABSOLUTE /end AXIS_DESCR
 /begin AXIS_DESCR STD_AXIS EGRVlv_rAct Prc 5 -100.0000 100.0000 EXTENDED_LIMITS -400.0000 399.9878 DEPOSIT ABSOLUTE /end AXIS_DESCR
/end CHARACTERISTIC
/begin CHARACTERISTIC EGRVlv_rCmpNewCtlUn_C "Vorgabewert für das neue SG." VALUE 0x80063E9C Val_Ws16 100.0000 Prc 0.00 100.0000 EXTENDED_LIMITS -400.0000 399.9878 /end CHARACTERISTIC
/begin CHARACTERISTIC EGRVlv_rCnv_CUR "Kurve für die Kontrollvariable der Abtastumrechnung" CURVE 0x80038F78 Kl_Xs16_Ws16 327.6700 DtyCyc 0.00 327.6700 EXTENDED_LIMITS -327.6800 327.6700
 /begin AXIS_DESCR STD_AXIS EGRVlv_rEGR Prc 11 0.00 399.9878 EXTENDED_LIMITS -400.0000 399.9878 DEPOSIT ABSOLUTE /end AXIS_DESCR
/end CHARACTERISTIC
/begin CHARACTERISTIC EGRVlv_rCtlVal_C "" VALUE 0x80063DAE Val_Ws16 75.00000 Prc 0.00 75.00000 EXTENDED_LIMITS -400.0000 399.9878 /end CHARACTERISTIC
/begin CHARACTERISTIC EGRVlv_rDesEGR_CUR "" CURVE 0x80063DB0 Cur_Xs16Ws16 799.9878 Prc -400.0000 399.9878
 /begin AXIS_DESCR STD_AXIS EGRVlv_r Prc 4 -400.0000 399.9878 DEPOSIT ABSOLUTE /end AXIS_DESCR
/end CHARACTERISTIC
/begin CHARACTERISTIC EGRVlv_rDvtMax_C "Maximale Abweichung" VALUE 0x80063B68 Val_Ws16 100.0000 Prc 0.00 100.0000 EXTENDED_LIMITS -400.0000 399.9878 /end CHARACTERISTIC
/begin CHARACTERISTIC EGRVlv_rDvtMin_C "Minimale Abweichung" VALUE 0x80063B6A Val_Ws16 100.0000 Prc -100.0000 0.00 EXTENDED_LIMITS -400.0000 399.9878 /end CHARACTERISTIC
/begin CHARACTERISTIC EGRVlv_rGovDvtThres_C "Schwellenwert für Ausblendung des D-Anteils des PID-Reglers" VALUE 0x80063DC2 Val_Ws16 100.0000 Prc 0.00 100.0000 EXTENDED_LIMITS -400.0000 399.9878 /end CHARACTERISTIC
/begin CHARACTERISTIC EGRVlv_rGovMax_CUR "Kennlinie zur Ermittlung des unteren Grenzwertes des PID-Reglerausgangs." CURVE 0x80063DC4 Cur_Xs16Ws16 100.0000 Prc 0.00 100.0000 EXTENDED_LIMITS -400.0000 399.9878
 /begin AXIS_DESCR STD_AXIS EGRVlv_iEffFlt_mp Curr_A 3 0.00 10.00000 FORMAT "%8.5" EXTENDED_LIMITS -327.6800 327.6700 DEPOSIT ABSOLUTE /end AXIS_DESCR
/end CHARACTERISTIC
/begin CHARACTERISTIC EGRVlv_rGovMin_CUR "Kennlinie zur Ermittlung des unteren Grenzwertes des PID-Reglerausgangs" CURVE 0x80063DD2 Cur_Xs16Ws16 100.0000 Prc -100.0000 0.00 EXTENDED_LIMITS -400.0000 399.9878
 /begin AXIS_DESCR STD_AXIS EGRVlv_iEffFlt_mp Curr_A 3 0.00 10.00000 FORMAT "%8.5" EXTENDED_LIMITS -327.6800 327.6700 DEPOSIT ABSOLUTE /end AXIS_DESCR
/end CHARACTERISTIC
/begin CHARACTERISTIC EGRVlv_rGvnrPreMax_C "" VALUE 0x80063DE0 Val_Ws16 100.0000 Prc 0.00 100.0000 EXTENDED_LIMITS -400.0000 399.9878 /end CHARACTERISTIC
/begin CHARACTERISTIC EGRVlv_rGvnrPreMin_C "" VALUE 0x80063DE2 Val_Ws16 100.0000 Prc 0.00 100.0000 EXTENDED_LIMITS -400.0000 399.9878 /end CHARACTERISTIC
/begin CHARACTERISTIC EGRVlv_rJamVlvOpnDemMax_C "Anforderung Schwellenerkennung für das klemmende Ventil in offenem Zustand" VALUE 0x80063B6C Val_Ws16 100.0000 Prc 0.00 100.0000 EXTENDED_LIMITS -400.0000 399.9878 /end CHARACTERISTIC
/begin CHARACTERISTIC EGRVlv_rJamVlvOpnHi_C "Obere Schwelle für die Hysterese zur Rauscheffekt-Beseitigung in der erfassten Stellung." VALUE 0x80063B6E Val_Ws16 100.0000 Prc 0.00 100.0000 EXTENDED_LIMITS -400.0000 399.9878 /end CHARACTERISTIC
/begin CHARACTERISTIC EGRVlv_rJamVlvOpnLo_C "Untere Schwelle für die Hysterese zur Rauscheffekt-Beseitigung in der erfassten Stellung." VALUE 0x80063B70 Val_Ws16 100.0000 Prc 0.00 100.0000 EXTENDED_LIMITS -400.0000 399.9878 /end CHARACTERISTIC
/begin CHARACTERISTIC EGRVlv_rLMSActThresDwn_C "Istwertschwelle zur LMS-Erkennung" VALUE 0x80063B72 Val_Ws16 100.0000 Prc 0.00 100.0000 EXTENDED_LIMITS -400.0000 399.9878 /end CHARACTERISTIC
/begin CHARACTERISTIC EGRVlv_rLMSThresDwn_C "Sollwertschwelle zur LMS-Erkennung" VALUE 0x80063B74 Val_Ws16 100.0000 Prc 0.00 100.0000 EXTENDED_LIMITS -400.0000 399.9878 /end CHARACTERISTIC
/begin CHARACTERISTIC EGRVlv_rLMSThresUp_C "Schwelle zum Zurücksetzen des LMS-Erkennungbits" VALUE 0x80063B76 Val_Ws16 100.0000 Prc 0.00 100.0000 EXTENDED_LIMITS -400.0000 399.9878 /end CHARACTERISTIC
/begin CHARACTERISTIC EGRVlv_RlsIKi_C "Ki für den Freigabeintegrator." VALUE 0x80063B78 Val_Ws32 18.6264514923 Ki_EGRVlv 0.00 18.6264514923 FORMAT "%13.10" EXTENDED_LIMITS -400000.000000 399999.999814 /end CHARACTERISTIC
/begin CHARACTERISTIC EGRVlv_RmpSlp.Pos_C "Rampensteigungstrukturen enthaltende Struktur/" VALUE 0x80063EA0 Kw_Ws32 399999.999814 RmpPrc 0.00 399999.999814 FORMAT "%13.6" EXTENDED_LIMITS -400000.000000 399999.999814 /end CHARACTERISTIC
/begin CHARACTERISTIC EGRVlv_RmpSlp.Neg_C "Rampensteigungstrukturen enthaltende Struktur/" VALUE 0x80063EA4 Kw_Ws32 399999.999814 RmpPrc 0.00 399999.999814 FORMAT "%13.6" EXTENDED_LIMITS -400000.000000 399999.999814 /end CHARACTERISTIC
/begin CHARACTERISTIC EGRVlv_rOfsLrnVlvMax_C "Obere Grenze des Steuerwertes für das Offset-Lernen." VALUE 0x80063EA8 Val_Ws16 100.0000 Prc 0.00 100.0000 EXTENDED_LIMITS -400.0000 399.9878 /end CHARACTERISTIC
/begin CHARACTERISTIC EGRVlv_rOfsLrnVlvMin_C "Untere Grenze des Steuerwertes für das Offset-Lernen." VALUE 0x80063EAA Val_Ws16 200.0000 Prc -100.0000 100.0000 EXTENDED_LIMITS -400.0000 399.9878 /end CHARACTERISTIC
/begin CHARACTERISTIC EGRVlv_rOfsMax_C "Maximaler plausibler Offset." VALUE 0x80063EAC Val_Ws16 19.99512 Prc -9.997559 9.997559 EXTENDED_LIMITS -400.0000 399.9878 /end CHARACTERISTIC
/begin CHARACTERISTIC EGRVlv_rOfsMin_C "Minimaler plausibler Offset." VALUE 0x80063EAE Val_Ws16 19.99512 Prc -9.997559 9.997559 EXTENDED_LIMITS -400.0000 399.9878 /end CHARACTERISTIC
/begin CHARACTERISTIC EGRVlv_rOutDMax_C "Maximal zulässige Stellgröße des D-Anteils des PID-Reglers" VALUE 0x80063DE4 Val_Ws16 100.0000 Prc 0.00 100.0000 EXTENDED_LIMITS -400.0000 399.9878 /end CHARACTERISTIC
/begin CHARACTERISTIC EGRVlv_rOutIMax_C "Oberer Grenzwert des I-Anteils des Lagereglers." VALUE 0x80063DE6 Val_Ws16 100.0000 Prc 0.00 100.0000 EXTENDED_LIMITS -400.0000 399.9878 /end CHARACTERISTIC
/begin CHARACTERISTIC EGRVlv_rPIDWinNgv_C "Negative Fenstergrenze" VALUE 0x80063DE8 Val_Ws16 100.0000 Prc -100.0000 0.00 EXTENDED_LIMITS -400.0000 399.9878 /end CHARACTERISTIC
/begin CHARACTERISTIC EGRVlv_rPIDWinPsv_C "Positive Fenstergrenze" VALUE 0x80063DEA Val_Ws16 100.0000 Prc 0.00 100.0000 EXTENDED_LIMITS -400.0000 399.9878 /end CHARACTERISTIC
/begin CHARACTERISTIC EGRVlv_rPullDwnMax_C "Maximaler Ausgang für die Pull-Down-Funktion" VALUE 0x80063B7C Val_Ws16 100.0000 Prc 0.00 100.0000 EXTENDED_LIMITS -400.0000 399.9878 /end CHARACTERISTIC
/begin CHARACTERISTIC EGRVlv_rRlsMax_C "Maximaler Ausgang für die Freigabefunktion" VALUE 0x80063B7E Val_Ws16 100.0000 Prc 0.00 100.0000 EXTENDED_LIMITS -400.0000 399.9878 /end CHARACTERISTIC
/begin CHARACTERISTIC EGRVlv_rRmp_C "" VALUE 0x80063DEC Val_Ws16 75.00000 Prc 0.00 75.00000 EXTENDED_LIMITS -400.0000 399.9878 /end CHARACTERISTIC
/begin CHARACTERISTIC EGRVlv_rSensVlvThres_C "Schwelle zur Erkennung des unteren Anschlags" VALUE 0x80063EB0 Val_Ws16 100.0000 Prc 0.00 100.0000 EXTENDED_LIMITS -400.0000 399.9878 /end CHARACTERISTIC
/begin CHARACTERISTIC EGRVlv_rTransf_CUR "Umwandlungskennlinie" CURVE 0x80063B04 Cur_Xs16Ws16 100.0000 Prc 0.00 100.0000 EXTENDED_LIMITS -400.0000 399.9878
 /begin AXIS_DESCR STD_AXIS EGRVlv_uRaw Volt 8 0.00 5200.000 EXTENDED_LIMITS -6553.600 6553.400 DEPOSIT ABSOLUTE /end AXIS_DESCR
/end CHARACTERISTIC
/begin CHARACTERISTIC EGRVlv_SlwClsDKd_C "Für langsames Schließen." VALUE 0x80063DF0 Val_Ws32 10.0000000000 Kd 0.00 10.0000000000 FORMAT "%13.10" EXTENDED_LIMITS -32768.0000000 32767.9999847 /end CHARACTERISTIC
/begin CHARACTERISTIC EGRVlv_SlwClsIKi_C "Für langsames Schließen." VALUE 0x80063DF4 Val_Ws32 99.9998301268 Ki 0.00 99.9998301268 FORMAT "%13.9" EXTENDED_LIMITS -1000000.00000 999999.999534 /end CHARACTERISTIC
/begin CHARACTERISTIC EGRVlv_SlwClsPKp_C "Für langsames Schließen." VALUE 0x80063DF8 Val_Ws32 10.0000000000 Kp 0.00 10.0000000000 FORMAT "%13.10" EXTENDED_LIMITS -65536.0000000 65535.9999695 /end CHARACTERISTIC
/begin CHARACTERISTIC EGRVlv_SmlSigNgvDKd_C "Für negative Kleinsignale" VALUE 0x80063DFC Val_Ws32 10.0000000000 Kd 0.00 10.0000000000 FORMAT "%13.10" EXTENDED_LIMITS -32768.0000000 32767.9999847 /end CHARACTERISTIC
/begin CHARACTERISTIC EGRVlv_SmlSigNgvIKi_C "Für negative Kleinsignale" VALUE 0x80063E00 Val_Ws32 99.9998301268 Ki 0.00 99.9998301268 FORMAT "%13.9" EXTENDED_LIMITS -1000000.00000 999999.999534 /end CHARACTERISTIC
/begin CHARACTERISTIC EGRVlv_SmlSigNgvPKp_C "Für negative Kleinsignale" VALUE 0x80063E04 Val_Ws32 131071.999969 Kp -65536.0000000 65535.9999695 FORMAT "%13.7" /end CHARACTERISTIC
/begin CHARACTERISTIC EGRVlv_SmlSigPsvDKd_C "Für positive Kleinsignale." VALUE 0x80063E08 Val_Ws32 10.0000000000 Kd 0.00 10.0000000000 FORMAT "%13.10" EXTENDED_LIMITS -32768.0000000 32767.9999847 /end CHARACTERISTIC
/begin CHARACTERISTIC EGRVlv_SmlSigPsvIKi_C "Für positive Kleinsignale" VALUE 0x80063E0C Val_Ws32 99.9998301268 Ki 0.00 99.9998301268 FORMAT "%13.9" EXTENDED_LIMITS -1000000.00000 999999.999534 /end CHARACTERISTIC
/begin CHARACTERISTIC EGRVlv_SmlSigPsvPKp_C "Für positive Kleinsignale." VALUE 0x80063E10 Val_Ws32 10.0000000000 Kp 0.00 10.0000000000 FORMAT "%13.10" EXTENDED_LIMITS -65536.0000000 65535.9999695 /end CHARACTERISTIC
/begin CHARACTERISTIC EGRVlv_SRC.uMin_C "Struktur zum Einhalten der SRC-Schwelle./" VALUE 0x80063B26 Kw_Ws16 5200.000 Volt 0.00 5200.000 EXTENDED_LIMITS -6553.600 6553.400 /end CHARACTERISTIC
/begin CHARACTERISTIC EGRVlv_SRC.uMax_C "Struktur zum Einhalten der SRC-Schwelle./" VALUE 0x80063B28 Kw_Ws16 5200.000 Volt 0.00 5200.000 EXTENDED_LIMITS -6553.600 6553.400 /end CHARACTERISTIC
/begin CHARACTERISTIC EGRVlv_stAirCtlMon_C "" VALUE 0x80063B80 Val_Wu8 255.0 OneToOne 0.00 255.0 /end CHARACTERISTIC
/begin CHARACTERISTIC EGRVlv_stNewVlvTrg_C "Trigger für neues Ventil" VALUE 0x80063EB2 Val_Wu8 1.000 OneToOne 0.00 1.000 EXTENDED_LIMITS 0.00 255.0 /end CHARACTERISTIC
/begin CHARACTERISTIC EGRVlv_stOfsLrnTrg_C "Auslöser für Offset-Lernen" VALUE 0x80063EB3 Val_Wu8 1.000 OneToOne 0.00 1.000 EXTENDED_LIMITS 0.00 255.0 /end CHARACTERISTIC
/begin CHARACTERISTIC EGRVlv_stPwrStgDiaDis_C "Maske zur Auswahl der Sperrbedingungen von Endstufediagnose" VALUE 0x80038FA6 Val_Wu8 255.0 OneToOne 0.00 255.0 /end CHARACTERISTIC
/begin CHARACTERISTIC EGRVlv_stPwrStgDis_C "Maske zur Auswahl der Sperrbedingungen der Endstufe" VALUE 0x80038FA7 Val_Wu8 255.0 OneToOne 0.00 255.0 /end CHARACTERISTIC
/begin CHARACTERISTIC EGRVlv_swtActOfs_C "Schalter zur Aktivierung des Offsetkorrektur-Ersatzwerts" VALUE 0x80063EB4 Val_Wu8 1.000 OneToOne 0.00 1.000 EXTENDED_LIMITS 0.00 255.0 /end CHARACTERISTIC
/begin CHARACTERISTIC EGRVlv_swtAirCtlOn_C "" VALUE 0x80063B81 Val_Wu8 1.000 OneToOne 0.00 1.000 EXTENDED_LIMITS 0.00 255.0 /end CHARACTERISTIC
/begin CHARACTERISTIC EGRVlv_swtBelCtl_C "" VALUE 0x80063E14 Val_Wu8 1.000 OneToOne 0.00 1.000 EXTENDED_LIMITS 0.00 255.0 /end CHARACTERISTIC
/begin CHARACTERISTIC EGRVlv_swtGovByp_C "Schalter zum Umgehen des Lagereglers" VALUE 0x80063B82 Val_Wu8 1.000 OneToOne 0.00 1.000 EXTENDED_LIMITS 0.00 255.0 /end CHARACTERISTIC
/begin CHARACTERISTIC EGRVlv_swtOfsLrnActv_C "Schalter zur Freigabe/Sperrung des Offset-Lernens." VALUE 0x80063EB5 Val_Wu8 255.0 OneToOne 0.00 255.0 /end CHARACTERISTIC
/begin CHARACTERISTIC EGRVlv_swtOpnLdDiaStrt_C "Beim Start wird die Lastabfalldiagnose benötigt. 1=yes;0=no" VALUE 0x80038FA8 Val_Wu8 255.0 OneToOne 0.00 255.0 /end CHARACTERISTIC
/begin CHARACTERISTIC EGRVlv_swtSelDT1In_C "Schalter zur Auswahl des DT1-Reglerausgangs." VALUE 0x80063E15 Val_Wu8 255.0 OneToOne 0.00 255.0 /end CHARACTERISTIC
/begin CHARACTERISTIC EGRVlv_swtSelOvrCurrErr_C "Überstromfehler soll als Fehler gemeldet werden. 1=yes;0=no" VALUE 0x80038FA9 Val_Wu8 255.0 OneToOne 0.00 255.0 /end CHARACTERISTIC
/begin CHARACTERISTIC EGRVlv_swtSensPrs_C "Schalter für Lagesensor vorhanden oder nicht." VALUE 0x80063B2A Val_Wu8 1.000 OneToOne 0.00 1.000 EXTENDED_LIMITS 0.00 255.0 /end CHARACTERISTIC
/begin CHARACTERISTIC EGRVlv_tEngHi_C "Obere Temperaturschwelle für die Freigabe der Überwachung der Abnormität in der AGR-Regelung." VALUE 0x80063B84 Val_Ws16 250.0000 Temp_Cels -50.14000 199.8600 EXTENDED_LIMITS -3549.940 3003.560 /end CHARACTERISTIC
/begin CHARACTERISTIC EGRVlv_tEngLo_C "Untere Temperaturschwelle für die Freigabe der Überwachung der Abnormität in der AGR-Regelung." VALUE 0x80063B86 Val_Ws16 250.0000 Temp_Cels -50.14000 199.8600 EXTENDED_LIMITS -3549.940 3003.560 /end CHARACTERISTIC
/begin CHARACTERISTIC EGRVlv_tEngMax_C "Maximalwert der Motortemperatur zur Freigabe der Nullpunktanpassung." VALUE 0x80063EB6 Val_Ws16 250.0000 Temp_Cels -50.14000 199.8600 EXTENDED_LIMITS -3549.940 3003.560 /end CHARACTERISTIC
/begin CHARACTERISTIC EGRVlv_tEngMin_C "Minimalwert der Motortemperatur zur Freigabe der Nullpunktanpassung." VALUE 0x80063EB8 Val_Ws16 250.0000 Temp_Cels -50.14000 199.8600 EXTENDED_LIMITS -3549.940 3003.560 /end CHARACTERISTIC
/begin CHARACTERISTIC EGRVlv_tiAdapJamVlv_C "Entprellzeit zur Erkennung eines klemmenden Ventils in offenem Zustand." VALUE 0x80063EBA Val_Ws16 20000.00 Time_ms 0.00 20000.00 EXTENDED_LIMITS -327680.0 327670.0 /end CHARACTERISTIC
/begin CHARACTERISTIC EGRVlv_tiAdapPullDwn_C "Zeit für Pull-Down nachdem unterer Anschlag erkannt wurde." VALUE 0x80063EBC Val_Ws16 20000.00 Time_ms 0.00 20000.00 EXTENDED_LIMITS -327680.0 327670.0 /end CHARACTERISTIC
/begin CHARACTERISTIC EGRVlv_tiBattCorFacFlt_C "Zeitkonstante zur Filterung des Batteriespannungskorrekturfaktor" VALUE 0x80038FAC Val_Ws32 4294.9672940 TimeDelay_s 0.000002000000001 4294.9672960 FORMAT "%12.7" /end CHARACTERISTIC
/begin CHARACTERISTIC EGRVlv_tiClsJamVlv_C "Entprellzeit zur Erkennung eines klemmenden Ventils in geschlossenem Zustand." VALUE 0x80063EBE Val_Ws16 20000.00 Time_ms 0.00 20000.00 EXTENDED_LIMITS -327680.0 327670.0 /end CHARACTERISTIC
/begin CHARACTERISTIC EGRVlv_tiCrntEffFlt_C "Parameter für PT1-Funktion." VALUE 0x80063E18 Val_Ws32 4294.9672940 TimeDelay_s 0.000002000000001 4294.9672960 FORMAT "%12.7" /end CHARACTERISTIC
/begin CHARACTERISTIC EGRVlv_tiGovDT1_C "Zeitkonstante des DT1-Gliedes im PID-Regler." VALUE 0x80063E1C Val_Ws32 4294.9662960 TimeDelay_s 0.0010000000689 4294.9672960 FORMAT "%12.7" EXTENDED_LIMITS 0.000002000000001 4294.9672960 /end CHARACTERISTIC
/begin CHARACTERISTIC EGRVlv_tiParDT1_C "Zeitkonstante des DT1-Gliedes zur Erkennung auf langsames Schließen" VALUE 0x80063E20 Val_Ws32 4294.9662960 TimeDelay_s 0.0010000000689 4294.9672960 FORMAT "%12.7" EXTENDED_LIMITS 0.000002000000001 4294.9672960 /end CHARACTERISTIC
/begin CHARACTERISTIC EGRVlv_tiPT1rAct_C "" VALUE 0x80063EC0 Val_Ws32 4294.9672940 TimeDelay_s 0.000002000000001 4294.9672960 FORMAT "%12.7" /end CHARACTERISTIC
/begin CHARACTERISTIC EGRVlv_tiPullDwn_C "Die Zeit, während der der Pull-Down-Integrator aktiv ist" VALUE 0x80063B88 Val_Ws16 5.000000 Time_s 0.00 5.000000 EXTENDED_LIMITS -327.6800 327.6700 /end CHARACTERISTIC
/begin CHARACTERISTIC EGRVlv_tiRepRls_C "Zeit zur Freigabe Bedingung klemmendes Ventil." VALUE 0x80063B8C Val_Ws32 3600.00000000 Time_s 0.00 3600.00000000 EXTENDED_LIMITS -21474836.4800 21474836.4700 /end CHARACTERISTIC
/begin CHARACTERISTIC EGRVlv_tiRls_C "Die Zeit, während der die Freigabefunktion aktiv ist." VALUE 0x80063B90 Val_Ws16 5.000000 Time_s 0.00 5.000000 EXTENDED_LIMITS -327.6800 327.6700 /end CHARACTERISTIC
/begin CHARACTERISTIC EGRVlv_TransStg.Dfl_C "Transstage Struktur./" VALUE 0x80063EC4 Kw_Ws16 100.0000 Prc 0.00 100.0000 EXTENDED_LIMITS -400.0000 399.9878 /end CHARACTERISTIC
/begin CHARACTERISTIC EGRVlv_TransStg.stSensId_C "Transstage Struktur./" VALUE 0x80063EC6 Kw_Wu8 255.0 OneToOne 0.00 255.0 /end CHARACTERISTIC
/begin CHARACTERISTIC EGRVlv_uBattMax_C "Maximalwert der Batteriespannung zur Freigabe der Nullpunktanpassung." VALUE 0x80063EC8 Val_Ws16 28600.00 Volt_Batt 0.00 28600.00 EXTENDED_LIMITS -655360.0 655340.0 /end CHARACTERISTIC
/begin CHARACTERISTIC EGRVlv_uBattMin_C "Minimalwert der Batteriespannung zur Freigabe der Nullpunktanpassung." VALUE 0x80063ECA Val_Ws16 28600.00 Volt_Batt 0.00 28600.00 EXTENDED_LIMITS -655360.0 655340.0 /end CHARACTERISTIC
/begin CHARACTERISTIC EMCtl_nEngHysDelta_C "Differenz zwischen oberem und unterem Schwellwert der Drehzahlhysterese" VALUE 0x80038FB0 Val_Ws16 32767.50 EngN -16384.00 16383.50 /end CHARACTERISTIC
/begin CHARACTERISTIC EMCtl_nEngHysHi_CUR "Kennfeld zur Ermittlung des oberen Schwellwertes der Drehzahlhysterese" CURVE 0x80038FB2 Cur_Xs16Ws16 65535.00 EngN -32768.00 32767.00 EXTENDED_LIMITS -16384.00 16383.50
 /begin AXIS_DESCR STD_AXIS EngDa_tEng Temp_Cels 4 -50.14000 199.8600 EXTENDED_LIMITS -3549.940 3003.560 DEPOSIT ABSOLUTE /end AXIS_DESCR
/end CHARACTERISTIC
/begin CHARACTERISTIC EMCtl_nEngLim_C "Drehzahlschwelle zur ""harten"" Motorlageransteuerung im Nachlauf" VALUE 0x80038FC4 Val_Ws16 6000.000 EngN 0.00 6000.000 EXTENDED_LIMITS -16384.00 16383.50 /end CHARACTERISTIC
/begin CHARACTERISTIC EMCtl_nLimHardStrt_C "Schwelle für hate Einstellung im Startfall" VALUE 0x80038FC6 Val_Ws16 6000.000 EngN 0.00 6000.000 EXTENDED_LIMITS -16384.00 16383.50 /end CHARACTERISTIC
/begin CHARACTERISTIC EMCtl_rOutHard_C "Ausgangswert für ""harte"" Motorlageransteuerung" VALUE 0x80038FC8 Val_Ws16 255.0049 Prc 0.00 255.0049 EXTENDED_LIMITS -400.0000 399.9878 /end CHARACTERISTIC
/begin CHARACTERISTIC EMCtl_rOutSoft_C "Ausgangswert für ""weiche"" Motorlageransteuerung" VALUE 0x80038FCA Val_Ws16 255.0049 Prc 0.00 255.0049 EXTENDED_LIMITS -400.0000 399.9878 /end CHARACTERISTIC
/begin CHARACTERISTIC EMCtl_tiHardAftrGear_C "Zeitintervall für ""harte"" Motorlageransteuerung nach Startabwurf" VALUE 0x80038FCC Val_Wu16 655.0000 Time_s 0.00 655.0000 EXTENDED_LIMITS 0.00 655.3500 /end CHARACTERISTIC
/begin CHARACTERISTIC EMCtl_tiSoftAftrStrt_C "Zeitintervall für ""weiche"" Motorlageransteuerung nach Startabwurf" VALUE 0x80038FCE Val_Wu16 655.0000 Time_s 0.00 655.0000 EXTENDED_LIMITS 0.00 655.3500 /end CHARACTERISTIC
/begin CHARACTERISTIC EMCtl_vXHysHi_C "Oberer Schwellenwert der Geschwindigkeitshysterese" VALUE 0x80038FD0 Val_Ws16 300.0000 Vel 0.00 300.0000 EXTENDED_LIMITS -327.6800 327.6700 /end CHARACTERISTIC
/begin CHARACTERISTIC EMCtl_vXHysLo_C "Unterer Schwellenwert der Geschwindigkeitshysterese" VALUE 0x80038FD2 Val_Ws16 300.0000 Vel 0.00 300.0000 EXTENDED_LIMITS -327.6800 327.6700 /end CHARACTERISTIC
/begin CHARACTERISTIC EMDmp_Pwm.tiPer_C "Struktur, die Kalibrierung und Umsetzung Datentypen für den Motorschwingungsdämpfer enthält/" VALUE 0x80038FD4 Kw_Ws16 9.900000 Period 0.1000000 10.00000 FORMAT "%8.5" EXTENDED_LIMITS -3276.800 3276.700 /end CHARACTERISTIC
/begin CHARACTERISTIC EMDmp_Pwm.stLvl_C "Struktur, die Kalibrierung und Umsetzung Datentypen für den Motorschwingungsdämpfer enthält/" VALUE 0x80038FD6 Kw_Wu8 1.000 OneToOne 0.00 1.000 EXTENDED_LIMITS 0.00 255.0 /end CHARACTERISTIC
/begin CHARACTERISTIC EMDmp_Pwm.rMaxDty_C "Struktur, die Kalibrierung und Umsetzung Datentypen für den Motorschwingungsdämpfer enthält/" VALUE 0x80038FD8 Kw_Ws16 100.0000 DtyCyc 0.00 100.0000 EXTENDED_LIMITS -327.6800 327.6700 /end CHARACTERISTIC
/begin CHARACTERISTIC EMDmp_Pwm.rPerUn_C "Struktur, die Kalibrierung und Umsetzung Datentypen für den Motorschwingungsdämpfer enthält/" VALUE 0x80038FDA Kw_Ws16 3276.700 Period 0.00 3276.700 FORMAT "%8.3" EXTENDED_LIMITS -3276.800 3276.700 /end CHARACTERISTIC
/begin CHARACTERISTIC EMDmp_Pwm.tiPh_C "Struktur, die Kalibrierung und Umsetzung Datentypen für den Motorschwingungsdämpfer enthält/" VALUE 0x80038FDC Kw_Ws16 65535.00 OneToOne -32768.00 32767.00 /end CHARACTERISTIC
/begin CHARACTERISTIC EMDmp_PwmOut.rMin_C "Struktur, die Parameters zur PWM Ausgangsstufe Fehlerhandlung für das Motorschwingungsdämpfer-Gerät enthält/" VALUE 0x80038FDE Kw_Ws16 100.0000 DtyCyc 0.00 100.0000 EXTENDED_LIMITS -327.6800 327.6700 /end CHARACTERISTIC
/begin CHARACTERISTIC EMDmp_PwmOut.rMax_C "Struktur, die Parameters zur PWM Ausgangsstufe Fehlerhandlung für das Motorschwingungsdämpfer-Gerät enthält/" VALUE 0x80038FE0 Kw_Ws16 100.0000 DtyCyc 0.00 100.0000 EXTENDED_LIMITS -327.6800 327.6700 /end CHARACTERISTIC
/begin CHARACTERISTIC EMDmp_PwmOut.tiBtwTstSCB_C "Struktur, die Parameters zur PWM Ausgangsstufe Fehlerhandlung für das Motorschwingungsdämpfer-Gerät enthält/" VALUE 0x80038FE2 Kw_Ws16 1000.000 Time_ms 0.00 1000.000 EXTENDED_LIMITS -327680.0 327670.0 /end CHARACTERISTIC
/begin CHARACTERISTIC EMDmp_PwmOut.tiBtwTstOT_C "Struktur, die Parameters zur PWM Ausgangsstufe Fehlerhandlung für das Motorschwingungsdämpfer-Gerät enthält/" VALUE 0x80038FE4 Kw_Ws16 327.6700 Time_s 0.00 327.6700 EXTENDED_LIMITS -327.6800 327.6700 /end CHARACTERISTIC
/begin CHARACTERISTIC EMDmp_PwmOut.numTstMax_C "Struktur, die Parameters zur PWM Ausgangsstufe Fehlerhandlung für das Motorschwingungsdämpfer-Gerät enthält/" VALUE 0x80038FE6 Kw_Wu16 65535.00 OneToOne 0.00 65535.00 /end CHARACTERISTIC
/begin CHARACTERISTIC EMDmp_PwmOut.swtBattCor_C "Struktur, die Parameters zur PWM Ausgangsstufe Fehlerhandlung für das Motorschwingungsdämpfer-Gerät enthält/" VALUE 0x80038FE8 Kw_Wu8 1.000 OneToOne 0.00 1.000 EXTENDED_LIMITS 0.00 255.0 /end CHARACTERISTIC
/begin CHARACTERISTIC EMDmp_PwmOut.swtPsInv_C "Struktur, die Parameters zur PWM Ausgangsstufe Fehlerhandlung für das Motorschwingungsdämpfer-Gerät enthält/" VALUE 0x80038FE9 Kw_Wu8 1.000 OneToOne 0.00 1.000 EXTENDED_LIMITS 0.00 255.0 /end CHARACTERISTIC
/begin CHARACTERISTIC EMDmp_rCnv0_CUR "Kennlinie für den Sollwert zur Tastverhältnisumwandlung für das erste Motorschwingungsdämpfer-Gerät" CURVE 0x80038FEA Cur_Xs16Ws16 100.0000 DtyCyc 0.00 100.0000 EXTENDED_LIMITS -327.6800 327.6700
 /begin AXIS_DESCR STD_AXIS EMDmp_r0 Prc 8 -400.0000 399.9878 DEPOSIT ABSOLUTE /end AXIS_DESCR
/end CHARACTERISTIC
/begin CHARACTERISTIC EMDmp_rCnv1_CUR "Kennlinie für den Sollwert zur Tastverhältnisumwandlung für das zweite Motorschwingungsdämpfer-Gerät" CURVE 0x8003900C Cur_Xs16Ws16 100.0000 DtyCyc 0.00 100.0000 EXTENDED_LIMITS -327.6800 327.6700
 /begin AXIS_DESCR STD_AXIS EMDmp_r1 Prc 8 -400.0000 399.9878 DEPOSIT ABSOLUTE /end AXIS_DESCR
/end CHARACTERISTIC
/begin CHARACTERISTIC EMDmp_rPsDisbl_CA "" VAL_BLK 0x8003902E ValA_Ws16 655.3500 DtyCyc -327.6800 327.6700 NUMBER 1 /end CHARACTERISTIC
/begin CHARACTERISTIC EMDmp_stPsDiaDisbl_CA "Applikationsparameter zur Sperrung der Diagnose von Endstufe für das Motorschwingungsdämpfer-Gerät unter bestimmten Batterie- und Motorbedingungen" VAL_BLK 0x80039030 ValA_Wu8 255.0 OneToOne 0.00 255.0 NUMBER 1 /end CHARACTERISTIC
/begin CHARACTERISTIC EMDmp_stPwrStgDis_CA "Applikationsparameter zur Deaktivierung der Endstufe bei einer bestimmten Batteriespannung oder eines bestimmten Motorzustandes" VAL_BLK 0x80039031 ValA_Wu8 255.0 OneToOne 0.00 255.0 NUMBER 1 /end CHARACTERISTIC
/begin CHARACTERISTIC EngDa_lEepUpd_C "Streckenintervall zwischen zwei EEPROM Block Updates für EngDa_tiEngOn" VALUE 0x80039F08 Val_Ws32 2147473647.00 Length 10000.0000000 2147483647.00 FORMAT "%13.2" EXTENDED_LIMITS -2147483648.00 2147483647.00 /end CHARACTERISTIC
/begin CHARACTERISTIC EngDa_tEng_C "Eingangswahlschalter für EngDa_tEng Motortemperatur" VALUE 0x80039EF6 Val_Wu8 1.00000000000 EngTempFldSel 0.00 1.00000000000 FORMAT "%13.11" EXTENDED_LIMITS 0.00 3.00000000000 /end CHARACTERISTIC
/begin CHARACTERISTIC EngDa_tiEngOffInit_C "Rücksetzwert nach einem Reset der Motorabstellzeit" VALUE 0x80039F04 Val_Ws16 32766.00 TimeEngOn 1.000000 32767.00 FORMAT "%8.2" EXTENDED_LIMITS -32768.00 32767.00 /end CHARACTERISTIC
/begin CHARACTERISTIC EngDa_tiEngOffRst_C "Verzögerung des Resets der Motorabstellzeit" VALUE 0x80039F06 Val_Ws16 325670.0 Time_ms 2000.000 327670.0 EXTENDED_LIMITS -327680.0 327670.0 /end CHARACTERISTIC
/begin CHARACTERISTIC EngDa_tiOvrTemp2_C "Zeitverzögerung für Übertemperatur 2" VALUE 0x80039EF8 Val_Ws16 255.0000 Time_s 0.00 255.0000 EXTENDED_LIMITS -327.6800 327.6700 /end CHARACTERISTIC
/begin CHARACTERISTIC EngDa_tiOvrTemp_C "Zeitverzögerung für Übertemperatur 1" VALUE 0x80039EFA Val_Ws16 255.0000 Time_s 0.00 255.0000 EXTENDED_LIMITS -327.6800 327.6700 /end CHARACTERISTIC
/begin CHARACTERISTIC EngDa_tOvrTempHi2_C "obere Hystereschwelle für Erkennung Übertemperatur 2" VALUE 0x80039EFC Val_Ws16 250.0000 Temp_Cels -50.14000 199.8600 EXTENDED_LIMITS -3549.940 3003.560 /end CHARACTERISTIC
/begin CHARACTERISTIC EngDa_tOvrTempHi_C "obere Hystereschwelle für Erkennung Übertemperatur 1" VALUE 0x80039EFE Val_Ws16 250.0000 Temp_Cels -50.14000 199.8600 EXTENDED_LIMITS -3549.940 3003.560 /end CHARACTERISTIC
/begin CHARACTERISTIC EngDa_tOvrTempLo2_C "untere Hystereschwelle für Erkennung Übertemperatur 2" VALUE 0x80039F00 Val_Ws16 250.0000 Temp_Cels -50.14000 199.8600 EXTENDED_LIMITS -3549.940 3003.560 /end CHARACTERISTIC
/begin CHARACTERISTIC EngDa_tOvrTempLo_C "untere Hystereschwelle für Erkennung Übertemperatur 1" VALUE 0x80039F02 Val_Ws16 250.0000 Temp_Cels -50.14000 199.8600 EXTENDED_LIMITS -3549.940 3003.560 /end CHARACTERISTIC
/begin CHARACTERISTIC EngDem_dnOvrFulMax_C "obere Hysteresegrenze für Overfueling Drehzahlgradient" VALUE 0x80039F0C Val_Ws16 327675.0 dn_dZ20 -163840.0 163835.0 FORMAT "%8.1" /end CHARACTERISTIC
/begin CHARACTERISTIC EngDem_dnOvrFulMin_C "untere Hysteresegrenze für Overfueling Drehzahlgradient" VALUE 0x80039F0E Val_Ws16 327675.0 dn_dZ20 -163840.0 163835.0 FORMAT "%8.1" /end CHARACTERISTIC
/begin CHARACTERISTIC EngDem_dtrqEngPrtRgnMon.Pos_C "Steigung zur Aufwärtsrampung im Fehlerfall/" VALUE 0x80039F10 Kw_Ws32 3276799.99847 RmpTrq 0.00 3276799.99847 EXTENDED_LIMITS -3276800.00000 3276799.99847 /end CHARACTERISTIC
/begin CHARACTERISTIC EngDem_dtrqEngPrtRgnMon.Neg_C "Steigung zur Aufwärtsrampung im Fehlerfall/" VALUE 0x80039F14 Kw_Ws32 3276799.99847 RmpTrq 0.00 3276799.99847 EXTENDED_LIMITS -3276800.00000 3276799.99847 /end CHARACTERISTIC
/begin CHARACTERISTIC EngDem_dtrqPFltOvld.Pos_C "/" VALUE 0x80039F18 Kw_Ws32 3276799.99847 RmpTrq 0.00 3276799.99847 EXTENDED_LIMITS -3276800.00000 3276799.99847 /end CHARACTERISTIC
/begin CHARACTERISTIC EngDem_dtrqPFltOvld.Neg_C "/" VALUE 0x80039F1C Kw_Ws32 3276799.99847 RmpTrq 0.00 3276799.99847 EXTENDED_LIMITS -3276800.00000 3276799.99847 /end CHARACTERISTIC
/begin CHARACTERISTIC EngDem_dtrqPFltOvldDwn_C "" VALUE 0x80039F20 Val_Ws32 6553599.99847 RmpTrq -3276800.00000 3276799.99847 /end CHARACTERISTIC
/begin CHARACTERISTIC EngDem_dtrqPFltOvldUp_C "" VALUE 0x80039F24 Val_Ws32 6553599.99847 RmpTrq -3276800.00000 3276799.99847 /end CHARACTERISTIC
/begin CHARACTERISTIC EngDem_EpmNEngDT1.T1_C "Zeit für Overfueling DT1/" VALUE 0x80039F28 Kw_Ws32 4294.9672940 TimeDelay_s 0.000002000000001 4294.9672960 FORMAT "%12.7" /end CHARACTERISTIC
/begin CHARACTERISTIC EngDem_EpmNEngDT1.Kd_C "Zeit für Overfueling DT1/" VALUE 0x80039F2C Kw_Ws32 65535.9999847 Kd_rpm2dndt -32768.0000000 32767.9999847 FORMAT "%13.7" /end CHARACTERISTIC
/begin CHARACTERISTIC EngDem_nOvrFulMax_C "obere Hysteresegrenze für Overfueling Motordrehzahl" VALUE 0x80039F30 Val_Ws16 5960.000 EngN 40.00000 6000.000 EXTENDED_LIMITS -16384.00 16383.50 /end CHARACTERISTIC
/begin CHARACTERISTIC EngDem_nOvrFulMin_C "untere Hysteresegrenze für Overfueling Motordrehzahl" VALUE 0x80039F32 Val_Ws16 5960.000 EngN 40.00000 6000.000 EXTENDED_LIMITS -16384.00 16383.50 /end CHARACTERISTIC
/begin CHARACTERISTIC EngDem_numIndex_C "Index zur Auswahl eines Wertes aus dem Abgasdruckfeld aus dem LuftSystemModell" VALUE 0x80039F34 Val_Wu8 8.000 OneToOne 0.00 8.000 EXTENDED_LIMITS 0.00 255.0 /end CHARACTERISTIC
/begin CHARACTERISTIC EngDem_RmpLimErr.Pos_C "Rampensteigung/" VALUE 0x80039F38 Kw_Ws32 3276799.99847 RmpTrq 0.00 3276799.99847 EXTENDED_LIMITS -3276800.00000 3276799.99847 /end CHARACTERISTIC
/begin CHARACTERISTIC EngDem_RmpLimErr.Neg_C "Rampensteigung/" VALUE 0x80039F3C Kw_Ws32 3276799.99847 RmpTrq 0.00 3276799.99847 EXTENDED_LIMITS -3276800.00000 3276799.99847 /end CHARACTERISTIC
/begin CHARACTERISTIC EngDem_RmpLimErr1.Pos_C "positive Rampensteigung für Rampenschalter/" VALUE 0x80039F40 Kw_Ws32 3276799.99847 RmpTrq 0.00 3276799.99847 EXTENDED_LIMITS -3276800.00000 3276799.99847 /end CHARACTERISTIC
/begin CHARACTERISTIC EngDem_RmpLimErr1.Neg_C "positive Rampensteigung für Rampenschalter/" VALUE 0x80039F44 Kw_Ws32 3276799.99847 RmpTrq 0.00 3276799.99847 EXTENDED_LIMITS -3276800.00000 3276799.99847 /end CHARACTERISTIC
/begin CHARACTERISTIC EngDem_RmpLimErr2.Pos_C "positive Rampensteigung für Rampenschalter/" VALUE 0x80039F48 Kw_Ws32 3276799.99847 RmpTrq 0.00 3276799.99847 EXTENDED_LIMITS -3276800.00000 3276799.99847 /end CHARACTERISTIC
/begin CHARACTERISTIC EngDem_RmpLimErr2.Neg_C "positive Rampensteigung für Rampenschalter/" VALUE 0x80039F4C Kw_Ws32 3276799.99847 RmpTrq 0.00 3276799.99847 EXTENDED_LIMITS -3276800.00000 3276799.99847 /end CHARACTERISTIC
/begin CHARACTERISTIC EngDem_RmpLimErr3.Pos_C "positive Rampensteigung für Rampenschalter/" VALUE 0x80039F50 Kw_Ws32 3276799.99847 RmpTrq 0.00 3276799.99847 EXTENDED_LIMITS -3276800.00000 3276799.99847 /end CHARACTERISTIC
/begin CHARACTERISTIC EngDem_RmpLimErr3.Neg_C "positive Rampensteigung für Rampenschalter/" VALUE 0x80039F54 Kw_Ws32 3276799.99847 RmpTrq 0.00 3276799.99847 EXTENDED_LIMITS -3276800.00000 3276799.99847 /end CHARACTERISTIC
/begin CHARACTERISTIC EngDem_RmpLimErr4.Pos_C "positive Rampensteigung für Rampenschalter/" VALUE 0x80039F58 Kw_Ws32 3276799.99847 RmpTrq 0.00 3276799.99847 EXTENDED_LIMITS -3276800.00000 3276799.99847 /end CHARACTERISTIC
/begin CHARACTERISTIC EngDem_RmpLimErr4.Neg_C "positive Rampensteigung für Rampenschalter/" VALUE 0x80039F5C Kw_Ws32 3276799.99847 RmpTrq 0.00 3276799.99847 EXTENDED_LIMITS -3276800.00000 3276799.99847 /end CHARACTERISTIC
/begin CHARACTERISTIC EngDem_RmpOvrFul.Pos_C "Steigung des Drehmoments (Nm/s) für Overfueling ramp switch/" VALUE 0x80039F60 Kw_Ws32 3276799.99847 RmpTrq 0.00 3276799.99847 EXTENDED_LIMITS -3276800.00000 3276799.99847 /end CHARACTERISTIC
/begin CHARACTERISTIC EngDem_RmpOvrFul.Neg_C "Steigung des Drehmoments (Nm/s) für Overfueling ramp switch/" VALUE 0x80039F64 Kw_Ws32 3276799.99847 RmpTrq 0.00 3276799.99847 EXTENDED_LIMITS -3276800.00000 3276799.99847 /end CHARACTERISTIC
/begin CHARACTERISTIC EngDem_rOvrFulMax_C "obere Hysteresegrenze für Overfueling Gaspedalposition" VALUE 0x80039F68 Val_Ws16 100.0000 Prc 0.00 100.0000 EXTENDED_LIMITS -400.0000 399.9878 /end CHARACTERISTIC
/begin CHARACTERISTIC EngDem_rOvrFulMin_C "untere Hysteresegrenze für Overfueling Gaspedalposition" VALUE 0x80039F6A Val_Ws16 100.0000 Prc 0.00 100.0000 EXTENDED_LIMITS -400.0000 399.9878 /end CHARACTERISTIC
/begin CHARACTERISTIC EngDem_stPFltLimMsk_C "" VALUE 0x80039F6C Val_Wu32 4294967295.00 OneToOne 0.00 4294967295.00 /end CHARACTERISTIC
/begin CHARACTERISTIC EngDem_swtPPreCat_C "Schalter für Auswahl Differenzdruck" VALUE 0x80039F70 Val_Wu8 1.000 OneToOne 0.00 1.000 EXTENDED_LIMITS 0.00 255.0 /end CHARACTERISTIC
/begin CHARACTERISTIC EngDem_swtTSensOvld_C "" VALUE 0x80039F71 Val_Wu8 1.000 OneToOne 0.00 1.000 EXTENDED_LIMITS 0.00 255.0 /end CHARACTERISTIC
/begin CHARACTERISTIC EngDem_tiPFltdVolPT1_C "Filterzeitkonstante für Abgasvolumenstrom" VALUE 0x80039F74 Val_Ws32 4294.9672940 TimeDelay_s 0.000002000000001 4294.9672960 FORMAT "%12.7" /end CHARACTERISTIC
/begin CHARACTERISTIC EngDem_tiPFltOvldOk_C "" VALUE 0x80039F78 Val_Ws32 21474836470.0 TimeDeb 0.00 21474836470.0 EXTENDED_LIMITS -21474836480.0 21474836470.0 /end CHARACTERISTIC
/begin CHARACTERISTIC EngDem_tiPFltResFlowPT1_C "Filterzeitkonstante für Strömungswiderstand" VALUE 0x80039F7C Val_Ws32 4294.9672940 TimeDelay_s 0.000002000000001 4294.9672960 FORMAT "%12.7" /end CHARACTERISTIC
/begin CHARACTERISTIC EngDem_tiRepOvrFul_C "Sperrzeit nach einem Overfueling Eingriff" VALUE 0x80039F80 Val_Ws32 21474836.4700 Time_s 0.00 21474836.4700 EXTENDED_LIMITS -21474836.4800 21474836.4700 /end CHARACTERISTIC
/begin CHARACTERISTIC EngDem_tPFltOvldLim_C "" VALUE 0x80039F84 Val_Ws16 1095.000 Temp_Cels -45.04000 1049.960 EXTENDED_LIMITS -3549.940 3003.560 /end CHARACTERISTIC
/begin CHARACTERISTIC EngDem_trqLimErr1_CUR "Kennlinie zur Ermittelung des Begrenzungsmomentes 1 aus der Drehzahl" CURVE 0x80039F86 Cur_Xs16Ws16 1000.000 Trq 0.00 1000.000 EXTENDED_LIMITS -3276.800 3276.700
 /begin AXIS_DESCR STD_AXIS Epm_nEng EngN 10 0.00 6000.000 EXTENDED_LIMITS -16384.00 16383.50 DEPOSIT ABSOLUTE /end AXIS_DESCR
/end CHARACTERISTIC
/begin CHARACTERISTIC EngDem_trqLimErr2_CUR "Kennlinie zur Ermittelung des Begrenzungsmomentes 2 aus der Drehzahl" CURVE 0x80039FB0 Cur_Xs16Ws16 1000.000 Trq 0.00 1000.000 EXTENDED_LIMITS -3276.800 3276.700
 /begin AXIS_DESCR STD_AXIS Epm_nEng EngN 10 0.00 6000.000 EXTENDED_LIMITS -16384.00 16383.50 DEPOSIT ABSOLUTE /end AXIS_DESCR
/end CHARACTERISTIC
/begin CHARACTERISTIC EngDem_trqLimErr3_CUR "Kennlinie zur Ermittelung des Begrenzungsmomentes 3 aus der Drehzahl" CURVE 0x80039FDA Cur_Xs16Ws16 1000.000 Trq 0.00 1000.000 EXTENDED_LIMITS -3276.800 3276.700
 /begin AXIS_DESCR STD_AXIS Epm_nEng EngN 10 0.00 6000.000 EXTENDED_LIMITS -16384.00 16383.50 DEPOSIT ABSOLUTE /end AXIS_DESCR
/end CHARACTERISTIC
/begin CHARACTERISTIC EngDem_trqLimErr4_CUR "Kennlinie zur Ermittelung des Begrenzungsmomentes 4 aus der Drehzahl" CURVE 0x8003A004 Cur_Xs16Ws16 1000.000 Trq 0.00 1000.000 EXTENDED_LIMITS -3276.800 3276.700
 /begin AXIS_DESCR STD_AXIS Epm_nEng EngN 10 0.00 6000.000 EXTENDED_LIMITS -16384.00 16383.50 DEPOSIT ABSOLUTE /end AXIS_DESCR
/end CHARACTERISTIC
/begin CHARACTERISTIC EngDem_trqLimErrLeadMax_C "Begrenzungsmoment Leadpfad bei keinem Momentbegrenzungsfehler" VALUE 0x8003A02E Val_Ws16 1000.000 Trq 0.00 1000.000 EXTENDED_LIMITS -3276.800 3276.700 /end CHARACTERISTIC
/begin CHARACTERISTIC EngDem_trqLimErr_CUR "Kennlinie für das Begrenzungsmoment bei Systemfehlern" CURVE 0x8003A030 Cur_Xs16Ws16 1000.000 Trq 0.00 1000.000 EXTENDED_LIMITS -3276.800 3276.700
 /begin AXIS_DESCR STD_AXIS Epm_nEng EngN 10 0.00 6000.000 EXTENDED_LIMITS -16384.00 16383.50 DEPOSIT ABSOLUTE /end AXIS_DESCR
/end CHARACTERISTIC
/begin CHARACTERISTIC EngDem_trqLimPDiff1_CUR "Begrenzungsmoment PFlt Notfahrbetrieb" CURVE 0x8003A05A Cur_Xs16Ws16 1500.000 Trq -500.0000 1000.000 EXTENDED_LIMITS -3276.800 3276.700
 /begin AXIS_DESCR STD_AXIS Exh_pAdapPPFltDiff Pres_hPa 8 0.00 3500.000 EXTENDED_LIMITS -32768.00 32767.00 DEPOSIT ABSOLUTE /end AXIS_DESCR
/end CHARACTERISTIC
/begin CHARACTERISTIC EngDem_trqLimPDiffNOffs_CUR "Begrenzungswert im Fall des pflt-Systemfehlers, Startmoment ansteigen" CURVE 0x8003A07C Cur_Xs16Ws16 1000.000 Trq 0.00 1000.000 EXTENDED_LIMITS -3276.800 3276.700
 /begin AXIS_DESCR STD_AXIS Epm_nEng EngN 16 0.00 6000.000 EXTENDED_LIMITS -16384.00 16383.50 DEPOSIT ABSOLUTE /end AXIS_DESCR
/end CHARACTERISTIC
/begin CHARACTERISTIC EngDem_trqLimPDiff_MAP "Begrenzungsmoment aufgrund Abgasgegendruck" MAP 0x8003A0BE Map_Xs16Ys16Ws16 1500.000 Trq -500.0000 1000.000 EXTENDED_LIMITS -3276.800 3276.700
 /begin AXIS_DESCR STD_AXIS EngDem_pDiffPFltPrdc2_mp Pres_hPa 16 0.00 3500.000 EXTENDED_LIMITS -32768.00 32767.00 DEPOSIT ABSOLUTE /end AXIS_DESCR
 /begin AXIS_DESCR STD_AXIS Epm_nEng EngN 8 0.00 6000.000 EXTENDED_LIMITS -16384.00 16383.50 DEPOSIT ABSOLUTE /end AXIS_DESCR
/end CHARACTERISTIC
/begin CHARACTERISTIC EngDem_trqLimPFltOvld_MAP "" MAP 0x8003A1F2 Map_Xs16Ys16Ws16 1500.000 Trq -500.0000 1000.000 EXTENDED_LIMITS -3276.800 3276.700
 /begin AXIS_DESCR STD_AXIS Epm_nEng EngN 16 0.00 10000.00 EXTENDED_LIMITS -16384.00 16383.50 DEPOSIT ABSOLUTE /end AXIS_DESCR
 /begin AXIS_DESCR STD_AXIS EngDem_tPFltOvldMax_mp Temp_Cels 16 -45.04000 1049.960 EXTENDED_LIMITS -3549.940 3003.560 DEPOSIT ABSOLUTE /end AXIS_DESCR
/end CHARACTERISTIC
/begin CHARACTERISTIC EngDem_trqOvrFulMax_C "oberer Wert für Overfueling Rampe" VALUE 0x8003A436 Val_Ws16 1000.000 Trq 0.00 1000.000 EXTENDED_LIMITS -3276.800 3276.700 /end CHARACTERISTIC
/begin CHARACTERISTIC EngDem_trqOvrFulMin_C "unterer Wert für Overfueling Rampe" VALUE 0x8003A438 Val_Ws16 1000.000 Trq 0.00 1000.000 EXTENDED_LIMITS -3276.800 3276.700 /end CHARACTERISTIC
/begin CHARACTERISTIC EngDem_vOvrFulMax_C "obere Hysteresegrenze für Overfueling Fahrgeschwindigkeit" VALUE 0x8003A43A Val_Ws16 300.0000 Vel 0.00 300.0000 EXTENDED_LIMITS -327.6800 327.6700 /end CHARACTERISTIC
/begin CHARACTERISTIC EngDem_vOvrFulMin_C "untere Hysteresegrenze für Overfueling Fahrgeschwindigkeit" VALUE 0x8003A43C Val_Ws16 300.0000 Vel 0.00 300.0000 EXTENDED_LIMITS -327.6800 327.6700 /end CHARACTERISTIC
/begin CHARACTERISTIC KF_PRIO_4 "" MAP 0x80063ECC MapTKF_UW_SW_UB 255. Def_dez_ub_q1 0.00 255. FORMAT "%3.0"
 /begin AXIS_DESCR STD_AXIS Tmot Def_t_sw_q0p01 8 -327.680 327.670 FORMAT "%7.3" DEPOSIT ABSOLUTE /end AXIS_DESCR
 /begin AXIS_DESCR STD_AXIS Pu Def_p_uw_q0p039 8 0.00 2559.96 FORMAT "%7.2" DEPOSIT ABSOLUTE /end AXIS_DESCR
/end CHARACTERISTIC
/begin CHARACTERISTIC KF_PRIO_HOLD "" MAP 0x80063F2E MapTKF_UW_SW_UB 255. Def_dez_ub_q1 0.00 255. FORMAT "%3.0"
 /begin AXIS_DESCR STD_AXIS Tmot Def_t_sw_q0p01 8 -327.680 327.670 FORMAT "%7.3" DEPOSIT ABSOLUTE /end AXIS_DESCR
 /begin AXIS_DESCR STD_AXIS Pu Def_p_uw_q0p039 8 0.00 2559.96 FORMAT "%7.2" DEPOSIT ABSOLUTE /end AXIS_DESCR
/end CHARACTERISTIC
/begin CHARACTERISTIC KF_PRIO_NO "" MAP 0x80063F90 MapTKF_UW_SW_UB 255. Def_dez_ub_q1 0.00 255. FORMAT "%3.0"
 /begin AXIS_DESCR STD_AXIS Tmot Def_t_sw_q0p01 8 -327.680 327.670 FORMAT "%7.3" DEPOSIT ABSOLUTE /end AXIS_DESCR
 /begin AXIS_DESCR STD_AXIS Pu Def_p_uw_q0p039 8 0.00 2559.96 FORMAT "%7.2" DEPOSIT ABSOLUTE /end AXIS_DESCR
/end CHARACTERISTIC
/begin CHARACTERISTIC KF_PRIO_UP "" MAP 0x80063FF2 MapTKF_UW_SW_UB 255. Def_dez_ub_q1 0.00 255. FORMAT "%3.0"
 /begin AXIS_DESCR STD_AXIS Tmot Def_t_sw_q0p01 8 -327.680 327.670 FORMAT "%7.3" DEPOSIT ABSOLUTE /end AXIS_DESCR
 /begin AXIS_DESCR STD_AXIS Pu Def_p_uw_q0p039 8 0.00 2559.96 FORMAT "%7.2" DEPOSIT ABSOLUTE /end AXIS_DESCR
/end CHARACTERISTIC
/begin CHARACTERISTIC KF_RF_AFU "" MAP 0x80064054 MapTKF_UW_SW_UB 255. Def_dez_ub_q1 0.00 255. FORMAT "%3.0"
 /begin AXIS_DESCR STD_AXIS Tmot Def_t_sw_q0p01 8 -327.680 327.670 FORMAT "%7.3" DEPOSIT ABSOLUTE /end AXIS_DESCR
 /begin AXIS_DESCR STD_AXIS Pu Def_p_uw_q0p039 8 0.00 2559.96 FORMAT "%7.2" DEPOSIT ABSOLUTE /end AXIS_DESCR
/end CHARACTERISTIC
/begin CHARACTERISTIC KL_VLPRIO41 "" CURVE 0x800640B6 CurTKL_SW_VV_UB 255. Def_dez_ub_q1 0.00 255. FORMAT "%3.0"
 /begin AXIS_DESCR STD_AXIS Tmot Def_t_sw_q0p01 4 -327.680 327.670 FORMAT "%7.3" DEPOSIT ABSOLUTE /end AXIS_DESCR
/end CHARACTERISTIC
/begin CHARACTERISTIC KL_VLPRIO42 "" CURVE 0x800640C4 CurTKL_SW_VV_UB 255. Def_dez_ub_q1 0.00 255. FORMAT "%3.0"
 /begin AXIS_DESCR STD_AXIS Tmot Def_t_sw_q0p01 4 -327.680 327.670 FORMAT "%7.3" DEPOSIT ABSOLUTE /end AXIS_DESCR
/end CHARACTERISTIC
/begin CHARACTERISTIC KL_VLPRIO43 "" CURVE 0x800640D2 CurTKL_SW_VV_UB 255. Def_dez_ub_q1 0.00 255. FORMAT "%3.0"
 /begin AXIS_DESCR STD_AXIS Tmot Def_t_sw_q0p01 4 -327.680 327.670 FORMAT "%7.3" DEPOSIT ABSOLUTE /end AXIS_DESCR
/end CHARACTERISTIC
/begin CHARACTERISTIC K_MD_ELMOTENTL "" VALUE 0x800640E0 Val_Ws16 6553.50 Def_m_sw_q0p1 -3276.80 3276.70 FORMAT "%7.2" /end CHARACTERISTIC
/begin CHARACTERISTIC K_NKWMAX_HS "" VALUE 0x800640E2 Val_Ws16 65535. Def_n_sw_q1p0 -32768. 32767. FORMAT "%5.0" /end CHARACTERISTIC
/begin CHARACTERISTIC K_NKWMIN_HY "" VALUE 0x800640E4 Val_Ws16 65535. Def_n_sw_q1p0 -32768. 32767. FORMAT "%5.0" /end CHARACTERISTIC
/begin CHARACTERISTIC K_PR_ELMOTENTL "" VALUE 0x800640E6 Val_Wu8 255. Def_dez_ub_q1 0.00 255. FORMAT "%3.0" /end CHARACTERISTIC
/begin CHARACTERISTIC K_PWG_AFU "" VALUE 0x800640E8 Val_Ws16 799.976 Def_wdk_sw_q0p0244 0.00 799.976 FORMAT "%7.3" EXTENDED_LIMITS -800.000 799.976 /end CHARACTERISTIC
/begin CHARACTERISTIC K_TD_DELAY1 "" VALUE 0x800640EA Val_Wu16 6553.5 Def_td_uw_q0p1 0.00 6553.5 FORMAT "%6.1" /end CHARACTERISTIC
/begin CHARACTERISTIC K_TD_DELAY2 "" VALUE 0x800640EC Val_Wu16 6553.5 Def_td_uw_q0p1 0.00 6553.5 FORMAT "%6.1" /end CHARACTERISTIC
/begin CHARACTERISTIC K_TD_DELAY3 "" VALUE 0x800640EE Val_Wu16 6553.5 Def_td_uw_q0p1 0.00 6553.5 FORMAT "%6.1" /end CHARACTERISTIC
/begin CHARACTERISTIC K_TD_DOWN "" VALUE 0x800640F0 Val_Wu16 6553.5 Def_td_uw_q0p1 0.00 6553.5 FORMAT "%6.1" /end CHARACTERISTIC
/begin CHARACTERISTIC K_TD_GEAR "" VALUE 0x800640F2 Val_Wu16 65535. Def_td_uw_q1 0.00 65535. FORMAT "%5.0" /end CHARACTERISTIC
/begin CHARACTERISTIC K_TD_HOLD "" VALUE 0x800640F4 Val_Wu16 6553.5 Def_td_uw_q0p1 0.00 6553.5 FORMAT "%6.1" /end CHARACTERISTIC
/begin CHARACTERISTIC K_TD_HOLDNO "" VALUE 0x800640F6 Val_Wu16 6553.5 Def_td_uw_q0p1 0.00 6553.5 FORMAT "%6.1" /end CHARACTERISTIC
/begin CHARACTERISTIC K_TD_UP "" VALUE 0x800640F8 Val_Wu16 6553.5 Def_td_uw_q0p1 0.00 6553.5 FORMAT "%6.1" /end CHARACTERISTIC
/begin CHARACTERISTIC K_TODPRIO0 "" VALUE 0x800640FA Val_Wu16 6553.5 Def_td_uw_q0p1 0.00 6553.5 FORMAT "%6.1" /end CHARACTERISTIC
/begin CHARACTERISTIC K_VMAX_HY "Fz-Geschwindigkeit" VALUE 0x800640FC Val_Wu16 65535. Def_v_uw_q1p0 0.00 65535. FORMAT "%5.0" /end CHARACTERISTIC
/begin CHARACTERISTIC K_VMIN_HY "Fz-Geschwindigkeit" VALUE 0x800640FE Val_Wu16 65535. Def_v_uw_q1p0 0.00 65535. FORMAT "%5.0" /end CHARACTERISTIC
/begin CHARACTERISTIC K_WAFS "" VALUE 0x80064100 Val_Ws16 6553.50 Def_w_sw_q0p1 -3276.80 3276.70 FORMAT "%7.2" /end CHARACTERISTIC
/begin CHARACTERISTIC K_WDAFS "" VALUE 0x80064102 Val_Ws16 6553.50 Def_w_sw_q0p1 -3276.80 3276.70 FORMAT "%7.2" /end CHARACTERISTIC
/begin CHARACTERISTIC Layer_dmAirPerTimeCor_C "" VALUE 0x80063AB0 Val_Ws32 429496.729500 SlopeRes10000 -214748.364800 214748.364700 FORMAT "%13.6" /end CHARACTERISTIC
/begin CHARACTERISTIC Layer_dmAirPerTimeIMax_C "" VALUE 0x80063AB4 Val_Ws16 6553.500 AirMassPerTime -3276.800 3276.700 /end CHARACTERISTIC
/begin CHARACTERISTIC Layer_dmAirPerTimeIMin_C "" VALUE 0x80063AB6 Val_Ws16 6553.500 AirMassPerTime -3276.800 3276.700 /end CHARACTERISTIC
/begin CHARACTERISTIC Layer_nEngRunHi_C "" VALUE 0x80063AB8 Val_Ws16 32767.50 EngN -16384.00 16383.50 /end CHARACTERISTIC
/begin CHARACTERISTIC Layer_nEngRunLo_C "" VALUE 0x80063ABA Val_Ws16 32767.50 EngN -16384.00 16383.50 /end CHARACTERISTIC
/begin CHARACTERISTIC Layer_nEngSpdDelta_C "" VALUE 0x80063ABC Val_Ws16 32767.50 EngN -16384.00 16383.50 /end CHARACTERISTIC
/begin CHARACTERISTIC Layer_nVarMax_C "" VALUE 0x80063ABE Val_Ws16 32767.50 EngN -16384.00 16383.50 /end CHARACTERISTIC
/begin CHARACTERISTIC Layer_qSetDelta_C "" VALUE 0x80063AC0 Val_Ws16 655.3500 InjMassCyc -327.6800 327.6700 /end CHARACTERISTIC
/begin CHARACTERISTIC Layer_stCarType_C "" VALUE 0x80063AC2 Val_Wu8 255.0 OneToOne 0.00 255.0 /end CHARACTERISTIC
/begin CHARACTERISTIC Layer_stMSARec_C "" VALUE 0x80063AC3 Val_Wu8 255.0 OneToOne 0.00 255.0 /end CHARACTERISTIC
/begin CHARACTERISTIC Layer_stPCRBits_C "" VALUE 0x80063AC4 Val_Wu32 4294967295.00 OneToOne 0.00 4294967295.00 /end CHARACTERISTIC
/begin CHARACTERISTIC Layer_stTrqLimMsk_C "" VALUE 0x80063AC8 Val_Wu16 65535.00 OneToOne 0.00 65535.00 /end CHARACTERISTIC
/begin CHARACTERISTIC Layer_swtNekpFlt_C "" VALUE 0x80063ACA Val_Wu8 255.0 OneToOne 0.00 255.0 /end CHARACTERISTIC
/begin CHARACTERISTIC Layer_tiAirPerTimeI_C "" VALUE 0x80063ACC Val_Ws32 4294967.2940 TimeDelay_ms 0.0020000000009 4294967.2960 FORMAT "%12.4" /end CHARACTERISTIC
/begin CHARACTERISTIC Layer_tiDesVoltStat_C "" VALUE 0x80063AD0 Val_Ws16 655350.0 Time_ms -327680.0 327670.0 /end CHARACTERISTIC
/begin CHARACTERISTIC Layer_tiEngSpdStat_C "" VALUE 0x80063AD2 Val_Ws16 655350.0 Time_ms -327680.0 327670.0 /end CHARACTERISTIC
/begin CHARACTERISTIC Layer_tiInjCtlStat_C "" VALUE 0x80063AD4 Val_Ws16 655350.0 Time_ms -327680.0 327670.0 /end CHARACTERISTIC
/begin CHARACTERISTIC Layer_tiNkw_grad_fpt1_C "" VALUE 0x80063AD6 Val_Ws16 4294836.2200 TimeDelay_ms 131.07600012 4294967.2960 FORMAT "%12.4" /end CHARACTERISTIC
/begin CHARACTERISTIC Layer_tiPSPFltPT1_C "" VALUE 0x80063AD8 Val_Ws16 4294836.2200 TimeDelay_ms 131.07600012 4294967.2960 FORMAT "%12.4" /end CHARACTERISTIC
/begin CHARACTERISTIC Layer_uDesDelta_C "" VALUE 0x80063ADA Val_Ws16 6553.500 UC_Volt -3276.800 3276.700 FORMAT "%8.3" /end CHARACTERISTIC
/begin CHARACTERISTIC S_ELMOTENTL "" VALUE 0x80064104 Val_Wu8 1.0 Identity 0.00 1.0 EXTENDED_LIMITS 0.00 255. /end CHARACTERISTIC
/begin MEASUREMENT Com_ctBOS "" UBYTE OneToOne 1 100 0.00 255.0 ECU_ADDRESS 0xD0001C6E /end MEASUREMENT
/begin MEASUREMENT Com_dAngAcpdCHK_A "" UBYTE OneToOne 1 100 0.00 255.0 ECU_ADDRESS 0xD0001C77 /end MEASUREMENT
/begin MEASUREMENT Com_dAngAcpdCTR_A "" UWORD OneToOne 1 100 0.00 65535.00 ECU_ADDRESS 0xD00014F4 /end MEASUREMENT
/begin MEASUREMENT Com_dDriveTrainData2CHK_A "" UBYTE OneToOne 1 100 0.00 255.0 ECU_ADDRESS 0xD0001C80 /end MEASUREMENT
/begin MEASUREMENT Com_dDriveTrainData2CTR_A "" UWORD OneToOne 1 100 0.00 65535.00 ECU_ADDRESS 0xD0001508 /end MEASUREMENT
/begin MEASUREMENT Com_dIntrvTimeBOS2 "" UBYTE OneToOne 1 100 0.00 255.0 ECU_ADDRESS 0xD0001C8A /end MEASUREMENT
/begin MEASUREMENT Com_dKlemmenCHK_A "" UBYTE OneToOne 1 100 0.00 255.0 ECU_ADDRESS 0xD0001C8E /end MEASUREMENT
/begin MEASUREMENT Com_dKlemmenCTR_A "" UWORD OneToOne 1 100 0.00 65535.00 ECU_ADDRESS 0xD000151E /end MEASUREMENT
/begin MEASUREMENT Com_dMonthBOS2 "" UBYTE OneToOne 1 100 0.00 255.0 ECU_ADDRESS 0xD0001C91 /end MEASUREMENT
/begin MEASUREMENT Com_dRmnMlgBOS "" SWORD OneToOne 1 100 -32768.00 32767.00 ECU_ADDRESS 0xD000075A /end MEASUREMENT
/begin MEASUREMENT Com_dTestMsg "" UWORD OneToOne 1 100 0.00 65535.00 ECU_ADDRESS 0xD0001530 /end MEASUREMENT
/begin MEASUREMENT Com_dTestSig "" UWORD OneToOne 1 100 0.00 65535.00 ECU_ADDRESS 0xD0001532 /end MEASUREMENT
/begin MEASUREMENT Com_dTorque1CHK_A "" UBYTE OneToOne 1 100 0.00 255.0 ECU_ADDRESS 0xD0001C9D /end MEASUREMENT
/begin MEASUREMENT Com_dTorque1CTR_A "" UWORD OneToOne 1 100 0.00 65535.00 ECU_ADDRESS 0xD0001536 /end MEASUREMENT
/begin MEASUREMENT Com_dTorque2CHK_A "" UBYTE OneToOne 1 100 0.00 255.0 ECU_ADDRESS 0xD0001C9F /end MEASUREMENT
/begin MEASUREMENT Com_dTorque2CTR_A "" UWORD OneToOne 1 100 0.00 65535.00 ECU_ADDRESS 0xD000153A /end MEASUREMENT
/begin MEASUREMENT Com_dTorque3CHK_A "" UBYTE OneToOne 1 100 0.00 255.0 ECU_ADDRESS 0xD0001CA1 /end MEASUREMENT
/begin MEASUREMENT Com_dTorque3CTR_A "" UWORD OneToOne 1 100 0.00 65535.00 ECU_ADDRESS 0xD000153E /end MEASUREMENT
/begin MEASUREMENT Com_dYearBOS2 "" UBYTE OneToOne 1 100 0.00 255.0 ECU_ADDRESS 0xD0001CBB /end MEASUREMENT
/begin MEASUREMENT Com_idBOS "" UWORD OneToOne 1 100 0.00 65535.00 ECU_ADDRESS 0xD0001582 /end MEASUREMENT
/begin MEASUREMENT Com_idBOS2 "" UWORD OneToOne 1 100 0.00 65535.00 ECU_ADDRESS 0xD0001580 /end MEASUREMENT
/begin MEASUREMENT Com_lIntrvWayBOS2 "" SWORD OneToOne 1 100 -32768.00 32767.00 ECU_ADDRESS 0xD000077C /end MEASUREMENT
/begin MEASUREMENT Com_rAvlBOS "" SWORD Prc 1 100 -400.0000 399.9878 ECU_ADDRESS 0xD00007C0 /end MEASUREMENT
/begin MEASUREMENT Com_stUnBOS "" UBYTE OneToOne 1 100 0.00 255.0 ECU_ADDRESS 0xD0001DA3 /end MEASUREMENT
/begin MEASUREMENT Com_vVehCHK_A "" UBYTE OneToOne 1 100 0.00 255.0 ECU_ADDRESS 0xD0001DB7 /end MEASUREMENT
/begin MEASUREMENT Com_vVehCTR_A "" UWORD OneToOne 1 100 0.00 65535.00 ECU_ADDRESS 0xD0001594 /end MEASUREMENT
/begin MEASUREMENT DStgy_dmNH3Act_mp "Aktuelle Dosiermenge in NH3-Äquivalent" SWORD SCR_Dm005 1 100 -1638.400 1638.350 FORMAT "%8.3" ECU_ADDRESS 0xC0009CB0 /end MEASUREMENT
/begin MEASUREMENT DStgy_dmNH3Curr "akt. zudosierter NH3-Massenstrom" SLONG SCR_Dm005 1 100 -107374182.400 107374182.350 FORMAT "%13.3" ECU_ADDRESS 0xD0002E9C /end MEASUREMENT
/begin MEASUREMENT DStgy_dmNH3CurrLtd_mp "Aktuelle Dosiermenge nach Limitierung" SLONG SCR_Dm005 1 100 -107374182.400 107374182.350 FORMAT "%13.3" ECU_ADDRESS 0xC0008EA4 /end MEASUREMENT
/begin MEASUREMENT DStgy_dmNH3CurrPreLim_mp "Aktuelle Dosiermenge vor Limitierung" SLONG SCR_Dm005 1 100 -107374182.400 107374182.350 FORMAT "%13.3" ECU_ADDRESS 0xC0008EA8 /end MEASUREMENT
/begin MEASUREMENT DStgy_dmRdcAgDes "Adaptierte Solldosiermenge Reduktionsmittel der Dosierstrategie" SWORD SCR_Dm01 1 100 -3276.800 3276.700 FORMAT "%8.3" ECU_ADDRESS 0xD00008C4 /end MEASUREMENT
/begin MEASUREMENT DStgy_dmRdcAgDesAdd_mp "Messpunkt additiver Bypass" SWORD SCR_Dm01 1 100 -3276.800 3276.700 FORMAT "%8.3" ECU_ADDRESS 0xC0009CB2 /end MEASUREMENT
/begin MEASUREMENT DStgy_dmRdcAgDesByp_mp "Messpunkt für Ersetzungsbypass" SWORD SCR_Dm01 1 100 -3276.800 3276.700 FORMAT "%8.3" ECU_ADDRESS 0xC0009CB4 /end MEASUREMENT
/begin MEASUREMENT DStgy_mNH3ActLst_mp "Kumulierte aktuelle Dosiermenge, gespeichert im letzten Rechenzyklus" SWORD SCR_Mass1000 1 100 -32.76800 32.76700 FORMAT "%8.5" ECU_ADDRESS 0xC0009CB6 /end MEASUREMENT
/begin MEASUREMENT DStgy_mNH3Act_mp "Kumulierte aktuelle Dosiermenge in NH3-Äquivalent" SWORD SCR_Mass1000 1 100 -32.76800 32.76700 FORMAT "%8.5" ECU_ADDRESS 0xC0009CB8 /end MEASUREMENT
/begin MEASUREMENT DStgy_mRdcAgDes "Kumulierte adaptierte Solldosiermenge an Reduktionsmittel der Dosierstrategie" UWORD SCR_Mass1000 1 100 0.00 65.53500 FORMAT "%8.5" ECU_ADDRESS 0xD00015A2 /end MEASUREMENT
/begin MEASUREMENT DStgy_stInitAcm_mp "Status Dosiermengenintegrator" UBYTE OneToOne 1 100 0.00 255.0 ECU_ADDRESS 0xC000B144 /end MEASUREMENT
/begin MEASUREMENT DStgy_stRdcAgInteg "Status Dosiermengenintegrator" UBYTE DStgy_Compu_Switch_1 1 100 0.00 1.00000000000 FORMAT "%13.11" ECU_ADDRESS 0xD0001DD2 /end MEASUREMENT
/begin MEASUREMENT DTR_valLoLim.DTR_AirCtlGovDvt "DTR/unterer Grenzwert des Prüfungsergebnisses DTR_AirCtlGovDvt" UWORD DFC_OneToOne 1 100 0.00 65535.00 ECU_ADDRESS 0xD0009594 /end MEASUREMENT
/begin MEASUREMENT DTR_valLoLim.DTR_AirCtlGovLPDvt "DTR/unterer Grenzwert des Prüfungsergebnisses DTR_AirCtlGovLPDvt" UWORD DFC_OneToOne 1 100 0.00 65535.00 ECU_ADDRESS 0xD0009596 /end MEASUREMENT
/begin MEASUREMENT DTR_valLoLim.DTR_CEngDsTDynTstDTMin "DTR/unterer Grenzwert des Prüfungsergebnisses DTR_CEngDsTDynTstDTMin" UWORD DFC_OneToOne 1 100 0.00 65535.00 ECU_ADDRESS 0xD0009598 /end MEASUREMENT
/begin MEASUREMENT DTR_valLoLim.DTR_CEngDsTDynTstTMin "DTR/unterer Grenzwert des Prüfungsergebnisses DTR_CEngDsTDynTstTMin" UWORD DFC_OneToOne 1 100 0.00 65535.00 ECU_ADDRESS 0xD000959A /end MEASUREMENT
/begin MEASUREMENT DTR_valLoLim.DTR_CEngDsTDynTstTiMax "DTR/unterer Grenzwert des Prüfungsergebnisses DTR_CEngDsTDynTstTiMax" UWORD DFC_OneToOne 1 100 0.00 65535.00 ECU_ADDRESS 0xD000959C /end MEASUREMENT
/begin MEASUREMENT DTR_valLoLim.DTR_Dummy "DTR/unterer Grenzwert des Prüfungsergebnisses DTR_Dummy" UWORD DFC_OneToOne 1 100 0.00 65535.00 ECU_ADDRESS 0xD000959E /end MEASUREMENT
/begin MEASUREMENT DTR_valLoLim.DTR_LSUDynChkState2 "DTR/unterer Grenzwert des Prüfungsergebnisses DTR_LSUDynChkState2" UWORD DFC_OneToOne 1 100 0.00 65535.00 ECU_ADDRESS 0xD00095A0 /end MEASUREMENT
/begin MEASUREMENT DTR_valLoLim.DTR_LSUDynChkState3 "DTR/unterer Grenzwert des Prüfungsergebnisses DTR_LSUDynChkState3" UWORD DFC_OneToOne 1 100 0.00 65535.00 ECU_ADDRESS 0xD00095A2 /end MEASUREMENT
/begin MEASUREMENT DTR_valLoLim.DTR_LSUHtCoupErr "DTR/unterer Grenzwert des Prüfungsergebnisses DTR_LSUHtCoupErr" UWORD DFC_OneToOne 1 100 0.00 65535.00 ECU_ADDRESS 0xD00095A4 /end MEASUREMENT
/begin MEASUREMENT DTR_valLoLim.DTR_LSUO2Plaus "DTR/unterer Grenzwert des Prüfungsergebnisses DTR_LSUO2Plaus" UWORD DFC_OneToOne 1 100 0.00 65535.00 ECU_ADDRESS 0xD00095A6 /end MEASUREMENT
/begin MEASUREMENT DTR_valLoLim.DTR_PFltCharPDiffMin "DTR/unterer Grenzwert des Prüfungsergebnisses DTR_PFltCharPDiffMin" UWORD DFC_OneToOne 1 100 0.00 65535.00 ECU_ADDRESS 0xD00095A8 /end MEASUREMENT
/begin MEASUREMENT DTR_valLoLim.DTR_PFltDstrMin "DTR/unterer Grenzwert des Prüfungsergebnisses DTR_PFltDstrMin" UWORD DFC_OneToOne 1 100 0.00 65535.00 ECU_ADDRESS 0xD00095AA /end MEASUREMENT
/begin MEASUREMENT DTR_valTst.DTR_AirCtlGovDvt "DTR/aktuelles Testergebnis von DTR_AirCtlGovDvt" UWORD DFC_OneToOne 1 100 0.00 65535.00 ECU_ADDRESS 0xD0009564 /end MEASUREMENT
/begin MEASUREMENT DTR_valTst.DTR_AirCtlGovLPDvt "DTR/aktuelles Testergebnis von DTR_AirCtlGovLPDvt" UWORD DFC_OneToOne 1 100 0.00 65535.00 ECU_ADDRESS 0xD0009566 /end MEASUREMENT
/begin MEASUREMENT DTR_valTst.DTR_CEngDsTDynTstDTMin "DTR/aktuelles Testergebnis von DTR_CEngDsTDynTstDTMin" UWORD DFC_OneToOne 1 100 0.00 65535.00 ECU_ADDRESS 0xD0009568 /end MEASUREMENT
/begin MEASUREMENT DTR_valTst.DTR_CEngDsTDynTstTMin "DTR/aktuelles Testergebnis von DTR_CEngDsTDynTstTMin" UWORD DFC_OneToOne 1 100 0.00 65535.00 ECU_ADDRESS 0xD000956A /end MEASUREMENT
/begin MEASUREMENT DTR_valTst.DTR_CEngDsTDynTstTiMax "DTR/aktuelles Testergebnis von DTR_CEngDsTDynTstTiMax" UWORD DFC_OneToOne 1 100 0.00 65535.00 ECU_ADDRESS 0xD000956C /end MEASUREMENT
/begin MEASUREMENT DTR_valTst.DTR_Dummy "DTR/aktuelles Testergebnis von DTR_Dummy" UWORD DFC_OneToOne 1 100 0.00 65535.00 ECU_ADDRESS 0xD000956E /end MEASUREMENT
/begin MEASUREMENT DTR_valTst.DTR_LSUDynChkState2 "DTR/aktuelles Testergebnis von DTR_LSUDynChkState2" UWORD DFC_OneToOne 1 100 0.00 65535.00 ECU_ADDRESS 0xD0009570 /end MEASUREMENT
/begin MEASUREMENT DTR_valTst.DTR_LSUDynChkState3 "DTR/aktuelles Testergebnis von DTR_LSUDynChkState3" UWORD DFC_OneToOne 1 100 0.00 65535.00 ECU_ADDRESS 0xD0009572 /end MEASUREMENT
/begin MEASUREMENT DTR_valTst.DTR_LSUHtCoupErr "DTR/aktuelles Testergebnis von DTR_LSUHtCoupErr" UWORD DFC_OneToOne 1 100 0.00 65535.00 ECU_ADDRESS 0xD0009574 /end MEASUREMENT
/begin MEASUREMENT DTR_valTst.DTR_LSUO2Plaus "DTR/aktuelles Testergebnis von DTR_LSUO2Plaus" UWORD DFC_OneToOne 1 100 0.00 65535.00 ECU_ADDRESS 0xD0009576 /end MEASUREMENT
/begin MEASUREMENT DTR_valTst.DTR_PFltCharPDiffMin "DTR/aktuelles Testergebnis von DTR_PFltCharPDiffMin" UWORD DFC_OneToOne 1 100 0.00 65535.00 ECU_ADDRESS 0xD0009578 /end MEASUREMENT
/begin MEASUREMENT DTR_valTst.DTR_PFltDstrMin "DTR/aktuelles Testergebnis von DTR_PFltDstrMin" UWORD DFC_OneToOne 1 100 0.00 65535.00 ECU_ADDRESS 0xD000957A /end MEASUREMENT
/begin MEASUREMENT DTR_valUpLim.DTR_AirCtlGovDvt "DTR/oberer Grenzwert des Prüfungsergebnisses DTR_AirCtlGovDvt" UWORD DFC_OneToOne 1 100 0.00 65535.00 ECU_ADDRESS 0xD000957C /end MEASUREMENT
/begin MEASUREMENT DTR_valUpLim.DTR_AirCtlGovLPDvt "DTR/oberer Grenzwert des Prüfungsergebnisses DTR_AirCtlGovLPDvt" UWORD DFC_OneToOne 1 100 0.00 65535.00 ECU_ADDRESS 0xD000957E /end MEASUREMENT
/begin MEASUREMENT DTR_valUpLim.DTR_CEngDsTDynTstDTMin "DTR/oberer Grenzwert des Prüfungsergebnisses DTR_CEngDsTDynTstDTMin" UWORD DFC_OneToOne 1 100 0.00 65535.00 ECU_ADDRESS 0xD0009580 /end MEASUREMENT
/begin MEASUREMENT DTR_valUpLim.DTR_CEngDsTDynTstTMin "DTR/oberer Grenzwert des Prüfungsergebnisses DTR_CEngDsTDynTstTMin" UWORD DFC_OneToOne 1 100 0.00 65535.00 ECU_ADDRESS 0xD0009582 /end MEASUREMENT
/begin MEASUREMENT DTR_valUpLim.DTR_CEngDsTDynTstTiMax "DTR/oberer Grenzwert des Prüfungsergebnisses DTR_CEngDsTDynTstTiMax" UWORD DFC_OneToOne 1 100 0.00 65535.00 ECU_ADDRESS 0xD0009584 /end MEASUREMENT
/begin MEASUREMENT DTR_valUpLim.DTR_Dummy "DTR/oberer Grenzwert des Prüfungsergebnisses DTR_Dummy" UWORD DFC_OneToOne 1 100 0.00 65535.00 ECU_ADDRESS 0xD0009586 /end MEASUREMENT
/begin MEASUREMENT DTR_valUpLim.DTR_LSUDynChkState2 "DTR/oberer Grenzwert des Prüfungsergebnisses DTR_LSUDynChkState2" UWORD DFC_OneToOne 1 100 0.00 65535.00 ECU_ADDRESS 0xD0009588 /end MEASUREMENT
/begin MEASUREMENT DTR_valUpLim.DTR_LSUDynChkState3 "DTR/oberer Grenzwert des Prüfungsergebnisses DTR_LSUDynChkState3" UWORD DFC_OneToOne 1 100 0.00 65535.00 ECU_ADDRESS 0xD000958A /end MEASUREMENT
/begin MEASUREMENT DTR_valUpLim.DTR_LSUHtCoupErr "DTR/oberer Grenzwert des Prüfungsergebnisses DTR_LSUHtCoupErr" UWORD DFC_OneToOne 1 100 0.00 65535.00 ECU_ADDRESS 0xD000958C /end MEASUREMENT
/begin MEASUREMENT DTR_valUpLim.DTR_LSUO2Plaus "DTR/oberer Grenzwert des Prüfungsergebnisses DTR_LSUO2Plaus" UWORD DFC_OneToOne 1 100 0.00 65535.00 ECU_ADDRESS 0xD000958E /end MEASUREMENT
/begin MEASUREMENT DTR_valUpLim.DTR_PFltCharPDiffMin "DTR/oberer Grenzwert des Prüfungsergebnisses DTR_PFltCharPDiffMin" UWORD DFC_OneToOne 1 100 0.00 65535.00 ECU_ADDRESS 0xD0009590 /end MEASUREMENT
/begin MEASUREMENT DTR_valUpLim.DTR_PFltDstrMin "DTR/oberer Grenzwert des Prüfungsergebnisses DTR_PFltDstrMin" UWORD DFC_OneToOne 1 100 0.00 65535.00 ECU_ADDRESS 0xD0009592 /end MEASUREMENT
/begin MEASUREMENT EBxFan_st "Steuersignal für SG-Gehäuse Lüfterendstufe" UBYTE OneToOne 1 100 0.00 255.0 ECU_ADDRESS 0xD0001DD9 /end MEASUREMENT
/begin MEASUREMENT EBxFan_stPs "Endstufenausgang für SG-Gehäuse Lüfter" UBYTE OneToOne 1 100 0.00 255.0 ECU_ADDRESS 0xD0001DDA /end MEASUREMENT
/begin MEASUREMENT ECBVlv_r "Steuerwert des Reglers" SWORD Prc 1 100 -400.0000 399.9878 ECU_ADDRESS 0xD00008D6 /end MEASUREMENT
/begin MEASUREMENT ECBVlv_rAct "Ist-ECB-Ventilposition" SWORD Prc 1 100 -400.0000 399.9878 ECU_ADDRESS 0xD00008D8 /end MEASUREMENT
/begin MEASUREMENT ECBVlv_rPs "Ausgangstastverhältnis an die Endstufe für den AGR-Kühler-Bypassventilsteller" SWORD DtyCyc 1 100 -327.6800 327.6700 ECU_ADDRESS 0xD00008DE /end MEASUREMENT
/begin MEASUREMENT ECBVlv_rSens "Erfasster Wert des ECB-Ventilpositionssensors." SWORD Prc 1 100 -400.0000 399.9878 ECU_ADDRESS 0xD00008E0 /end MEASUREMENT
/begin MEASUREMENT ECBVlv_uRaw "Rohspannung des ECB-Ventilpositionssensors." SWORD Volt 1 100 -6553.600 6553.400 ECU_ADDRESS 0xD00008E2 /end MEASUREMENT
/begin MEASUREMENT Eeebd_numSectChg "Anzahl der Sektor-Wechsel" UWORD OneToOne 1 100 0.00 65535.00 ECU_ADDRESS 0xD00066CA /end MEASUREMENT
/begin MEASUREMENT Eeebd_stEee "Hauptzustand der Emulation" UBYTE Eeebd_EeeStates_Verb 1 100 0.00 3.00000000000 FORMAT "%13.11" ECU_ADDRESS 0xC00089C8 /end MEASUREMENT
/begin MEASUREMENT EGRClg_ClgOff_mp "untere Grenze für Einspritzmenge bzw. inneres Drehmoment" SWORD InjMass 1 100 -327.6800 327.6700 ECU_ADDRESS 0xC0009CC0 /end MEASUREMENT
/begin MEASUREMENT EGRClg_ClgOn_mp "obere Grenze für Einspritzmenge bzw. inneres Drehmoment" SWORD InjMass 1 100 -327.6800 327.6700 ECU_ADDRESS 0xC0009CC2 /end MEASUREMENT
/begin MEASUREMENT EGRClg_numEOMMode_mp "Index der geforderten Betriebsart" UWORD OneToOne 1 100 0.00 65535.00 ECU_ADDRESS 0xC0009CC4 /end MEASUREMENT
/begin MEASUREMENT EGRClg_rCtlCor_mp "korrigierter Steuerwert des ARF-Kühler-Bypass-Ventil" SWORD Prc 1 100 -400.0000 399.9878 ECU_ADDRESS 0xC0009CC6 /end MEASUREMENT
/begin MEASUREMENT EGRClg_rCtlValNrm_mp "Steuerwert des ARF-Kühler-Bypass-Ventil im Normalbetrieb" SWORD Prc 1 100 -400.0000 399.9878 ECU_ADDRESS 0xC0009CC8 /end MEASUREMENT
/begin MEASUREMENT EGRClg_stBitMskEOM_mp "Bitmaske zur Auswahl der relevanten Abschaltfälle für die gewählte Betriebsart" ULONG OneToOne 1 100 0.00 4294967295.00 ECU_ADDRESS 0xC0008EAC /end MEASUREMENT
/begin MEASUREMENT EGRClg_stCtlValBits_mp "Status der Bedingungen zur Ansteuerung des ARF-Kühler-Bypass-Ventils" ULONG OneToOne 1 100 0.00 4294967295.00 ECU_ADDRESS 0xC0008EB0 /end MEASUREMENT
/begin MEASUREMENT EGRClg_stCtlVal_mp "selektierte Bedingungen zur Ansteuerung des ARF-Kühler-Bypass-Ventils" UBYTE OneToOne 1 100 0.00 255.0 ECU_ADDRESS 0xC000B146 /end MEASUREMENT
/begin MEASUREMENT EGRClg_stEGRClgBits_mp "relevante Abschaltfälle" ULONG OneToOne 1 100 0.00 4294967295.00 ECU_ADDRESS 0xC0008EB4 /end MEASUREMENT
/begin MEASUREMENT EGRClg_stMon "priorisierte Abschaltfälle" UBYTE OneToOne 1 100 0.00 255.0 ECU_ADDRESS 0xD0001DDB /end MEASUREMENT
/begin MEASUREMENT EGRClg_stMonBits_mp "selektierte Abschaltfälle" ULONG OneToOne 1 100 0.00 4294967295.00 ECU_ADDRESS 0xC0008EB8 /end MEASUREMENT
/begin MEASUREMENT EGRClg_stSelBitMskEOM_mp "selektierte Bitmaske für Abschaltfälle für die gewählte Betriebsart" ULONG OneToOne 1 100 0.00 4294967295.00 ECU_ADDRESS 0xC0008EBC /end MEASUREMENT
/begin MEASUREMENT EGRClg_tAirCtlVal_mp "Von dem Lufttemperaturfeld-Array ausgewählte Lufttemperatur" SWORD Temp_Cels 1 100 -3549.940 3003.560 ECU_ADDRESS 0xC0009CCA /end MEASUREMENT
/begin MEASUREMENT EGRClg_tEngCtlVal1_mp "" SWORD Temp_Cels 1 100 -3549.940 3003.560 ECU_ADDRESS 0xC0009CCC /end MEASUREMENT
/begin MEASUREMENT EGRClg_tEngCtlVal_mp "ausgewählte Temperatur aus dem Motortemperaturfeld für die Ansteuerung des ARF-Kühler-Bypass-Ventils" SWORD Temp_Cels 1 100 -3549.940 3003.560 ECU_ADDRESS 0xC0009CCE /end MEASUREMENT
/begin MEASUREMENT EGRClg_tiMonEOM_mp "Zeitverzögerung bei Auswahl der Abschaltfallmaske für die gewählte Betriebsart" SWORD TimeDeb 1 100 -327680.0 327670.0 ECU_ADDRESS 0xC0009CD0 /end MEASUREMENT
/begin MEASUREMENT EGRClg_tPrePFlt_mp "" SWORD Temp_Cels 1 100 -30.04000 149.9600 ECU_ADDRESS 0xC0009CD2 /end MEASUREMENT
/begin MEASUREMENT EGRVlvLP_ctAdapCls_mp "Öffnen-Schließen-Zykluszähler" UBYTE OneToOne 1 100 0.00 255.0 ECU_ADDRESS 0xC000B149 /end MEASUREMENT
/begin MEASUREMENT EGRVlvLP_ctStrtOfsLrn_mp "" UWORD OneToOne 1 100 0.00 65535.00 ECU_ADDRESS 0xC0009D0C /end MEASUREMENT
/begin MEASUREMENT EGRVlvLP_drAct_mp "Ventilgeschwindigkeit" SWORD VlvVel 1 100 -4000.000 3999.878 FORMAT "%8.3" ECU_ADDRESS 0xC0009CDC /end MEASUREMENT
/begin MEASUREMENT EGRVlvLP_facCorFlt_mp "Messpunkt für den Batteriekorrekturfaktor." SWORD Fact 1 100 -4.000000 3.999878 ECU_ADDRESS 0xC0009CD4 /end MEASUREMENT
/begin MEASUREMENT EGRVlvLP_iEffFlt_mp "Gefilterter Wert des modellierten Stroms." SWORD Curr_A 1 100 -327.6800 327.6700 FORMAT "%8.4" ECU_ADDRESS 0xC0009CDE /end MEASUREMENT
/begin MEASUREMENT EGRVlvLP_iEff_mp "Modellierter Strom." SWORD Curr_A 1 100 -327.6800 327.6700 FORMAT "%8.4" ECU_ADDRESS 0xC0009CE0 /end MEASUREMENT
/begin MEASUREMENT EGRVlvLP_r "Sollwert" SWORD Prc 1 100 -400.0000 399.9878 ECU_ADDRESS 0xD00008E4 /end MEASUREMENT
/begin MEASUREMENT EGRVlvLP_rAbsEGR_mp "Der Betrag des Tastverhältnisses zur Berechnung des modellierten Stroms." SWORD DtyCyc 1 100 -327.6800 327.6700 ECU_ADDRESS 0xC0009CE2 /end MEASUREMENT
/begin MEASUREMENT EGRVlvLP_rAct "" SWORD Prc 1 100 -400.0000 399.9878 ECU_ADDRESS 0xD00008E6 /end MEASUREMENT
/begin MEASUREMENT EGRVlvLP_rActNoErrHdl "Ventilstellung (Offset korrigiert ohne Fehlerbehandlung)." SWORD Prc 1 100 -400.0000 399.9878 ECU_ADDRESS 0xD00008E8 /end MEASUREMENT
/begin MEASUREMENT EGRVlvLP_rActUnCorOld_mp "Unkorrigierte Ventilstellung im vorherigen Fahrzyklus." SWORD Prc 1 100 -400.0000 399.9878 ECU_ADDRESS 0xC0009D0E /end MEASUREMENT
/begin MEASUREMENT EGRVlvLP_rActUnCor_mp "Unkorrigierte Ventilstellung." SWORD Prc 1 100 -400.0000 399.9878 ECU_ADDRESS 0xC0009D10 /end MEASUREMENT
/begin MEASUREMENT EGRVlvLP_rActUnLimFlt "" SWORD Prc 1 100 -400.0000 399.9878 ECU_ADDRESS 0xD00008EA /end MEASUREMENT
/begin MEASUREMENT EGRVlvLP_rAdapLrn_mp "Gelernter Offset-Wert im vorhandenen Fahrzyklus." SWORD Prc 1 100 -400.0000 399.9878 ECU_ADDRESS 0xC0009D12 /end MEASUREMENT
/begin MEASUREMENT EGRVlvLP_rAdapPos_mp "Ventilstellung am Nullpunkt." SWORD Prc 1 100 -400.0000 399.9878 ECU_ADDRESS 0xC0009D14 /end MEASUREMENT
/begin MEASUREMENT EGRVlvLP_rBelCtl_mp "" SWORD Prc 1 100 -400.0000 399.9878 ECU_ADDRESS 0xC0009CE4 /end MEASUREMENT
/begin MEASUREMENT EGRVlvLP_rCnv_mp "Messpunkt für den Kennfeldausgang." SWORD DtyCyc 1 100 -327.6800 327.6700 ECU_ADDRESS 0xC0009CD6 /end MEASUREMENT
/begin MEASUREMENT EGRVlvLP_rEGR "Steuerwert des AGR-Ventils." SWORD Prc 1 100 -400.0000 399.9878 ECU_ADDRESS 0xD00008EC /end MEASUREMENT
/begin MEASUREMENT EGRVlvLP_rGovDvt "Regelabweichung" SWORD Prc 1 100 -400.0000 399.9878 ECU_ADDRESS 0xD00008EE /end MEASUREMENT
/begin MEASUREMENT EGRVlvLP_rGovDvtRel "Relative Regelabweichung zur OBD." SWORD Prc 1 100 -400.0000 399.9878 ECU_ADDRESS 0xD00008F0 /end MEASUREMENT
/begin MEASUREMENT EGRVlvLP_rGovEGR "Steuerwert vom Regler" SWORD Prc 1 100 -400.0000 399.9878 ECU_ADDRESS 0xD00008F2 /end MEASUREMENT
/begin MEASUREMENT EGRVlvLP_rGovMax_mp "Maximale Schwelle des Reglers." SWORD Prc 1 100 -400.0000 399.9878 ECU_ADDRESS 0xC0009CE6 /end MEASUREMENT
/begin MEASUREMENT EGRVlvLP_rGovMin_mp "Minimale Schwelle des Reglers." SWORD Prc 1 100 -400.0000 399.9878 ECU_ADDRESS 0xC0009CE8 /end MEASUREMENT
/begin MEASUREMENT EGRVlvLP_rLim_mp "" SWORD Prc 1 100 -400.0000 399.9878 ECU_ADDRESS 0xC0009CEA /end MEASUREMENT
/begin MEASUREMENT EGRVlvLP_rLinOfs_mp "Ventilstellung vor Begrenzung." SWORD Prc 1 100 -400.0000 399.9878 ECU_ADDRESS 0xC0009D16 /end MEASUREMENT
/begin MEASUREMENT EGRVlvLP_rOfsLrnFrst "Erster gelernter Offset-Wert." SWORD Prc 1 100 -400.0000 399.9878 ECU_ADDRESS 0xD00008F4 /end MEASUREMENT
/begin MEASUREMENT EGRVlvLP_rOfsLrnLst "Letzter gelernter Offset-Wert." SWORD Prc 1 100 -400.0000 399.9878 ECU_ADDRESS 0xD00008F6 /end MEASUREMENT
/begin MEASUREMENT EGRVlvLP_rOfsLrnNew "Gelernter Offset-Wert im vorhandenen Fahrzyklus." SWORD Prc 1 100 -400.0000 399.9878 ECU_ADDRESS 0xD00008F8 /end MEASUREMENT
/begin MEASUREMENT EGRVlvLP_rOfsLrnVlv "Steuerwert zum Offset-Lernen." SWORD Prc 1 100 -400.0000 399.9878 ECU_ADDRESS 0xD00008FA /end MEASUREMENT
/begin MEASUREMENT EGRVlvLP_rOfs_mp "Offset-Korrektur" SWORD Prc 1 100 -400.0000 399.9878 ECU_ADDRESS 0xC0009D18 /end MEASUREMENT
/begin MEASUREMENT EGRVlvLP_rOutD_mp "D Ausgang." SWORD Prc 1 100 -400.0000 399.9878 ECU_ADDRESS 0xC0009CEC /end MEASUREMENT
/begin MEASUREMENT EGRVlvLP_rOutI_mp "I Ausgang." SWORD Prc 1 100 -400.0000 399.9878 ECU_ADDRESS 0xC0009CEE /end MEASUREMENT
/begin MEASUREMENT EGRVlvLP_rOutP_mp "P Ausgang." SWORD Prc 1 100 -400.0000 399.9878 ECU_ADDRESS 0xC0009CF0 /end MEASUREMENT
/begin MEASUREMENT EGRVlvLP_rPlausLgT_mp "Plausibler Wert der langfristigen Drift ( Differenz zwischen aktuellem Fahrzyklus-Anpassungswert und dem ersten gelernten Anpassungswert)." SWORD Prc 1 100 -400.0000 399.9878 ECU_ADDRESS 0xC0009D1A /end MEASUREMENT
/begin MEASUREMENT EGRVlvLP_rPlausShT_mp "Plausibler Wert der kurzfristigen Drift (Unterschied zwischen aktuellem Fahrzyklus-Anpassungswert und dem letzten gelernten Anpassungswert)." SWORD Prc 1 100 -400.0000 399.9878 ECU_ADDRESS 0xC0009D1C /end MEASUREMENT
/begin MEASUREMENT EGRVlvLP_rPosLrnMin_mp "Minimales Offset, das während der Schließen/Öffnen-Zyklen des Offset-Lernens erhalten wird." SWORD Prc 1 100 -400.0000 399.9878 ECU_ADDRESS 0xC0009D1E /end MEASUREMENT
/begin MEASUREMENT EGRVlvLP_rPosRef_mp "Referenzposition des Ventils in offener Stellung." SWORD Prc 1 100 -400.0000 399.9878 ECU_ADDRESS 0xC0009D20 /end MEASUREMENT
/begin MEASUREMENT EGRVlvLP_rPreCtlVal_mp "" SWORD Prc 1 100 -400.0000 399.9878 ECU_ADDRESS 0xC0009CF2 /end MEASUREMENT
/begin MEASUREMENT EGRVlvLP_rPs "Ausgabe zur Endstufe" SWORD DtyCyc 1 100 -327.6800 327.6700 ECU_ADDRESS 0xD00008FC /end MEASUREMENT
/begin MEASUREMENT EGRVlvLP_rPullDwnEGR "Steuerwert, um das Ventil langsam zu schließen" SWORD Prc 1 100 -400.0000 399.9878 ECU_ADDRESS 0xD00008FE /end MEASUREMENT
/begin MEASUREMENT EGRVlvLP_rRlsEGR "Zusätzlicher Steuerwert zur Freigabe eines klemmenden Ventils" SWORD Prc 1 100 -400.0000 399.9878 ECU_ADDRESS 0xD0000900 /end MEASUREMENT
/begin MEASUREMENT EGRVlvLP_rSens "Erfasster Wert der AGR-Ventilposition" SWORD Prc 1 100 -400.0000 399.9878 ECU_ADDRESS 0xD0000902 /end MEASUREMENT
/begin MEASUREMENT EGRVlvLP_stAdap "Status des Offset-Lernens" UWORD OneToOne 1 100 0.00 65535.00 ECU_ADDRESS 0xD00015A8 /end MEASUREMENT
/begin MEASUREMENT EGRVlvLP_stAdapActv_mp "Zustand Anpassung aktiv" UBYTE OneToOne 1 100 0.00 255.0 ECU_ADDRESS 0xC000B14A /end MEASUREMENT
/begin MEASUREMENT EGRVlvLP_stFrstOpn_mp "Status des ersten Öffnens des AGR-Ventils." UBYTE OneToOne 1 100 0.00 255.0 ECU_ADDRESS 0xC000B14B /end MEASUREMENT
/begin MEASUREMENT EGRVlvLP_stMon "Überwachungsstatus des AGR-Ventils" UWORD OneToOne 1 100 0.00 65535.00 ECU_ADDRESS 0xD00015AA /end MEASUREMENT
/begin MEASUREMENT EGRVlvLP_stNewVlvTrg_mp "Neues Ventil Auslöser-Zustand" UBYTE OneToOne 1 100 0.00 255.0 ECU_ADDRESS 0xC000B14C /end MEASUREMENT
/begin MEASUREMENT EGRVlvLP_stOfsLrn "Zustände des Offset-Lernens" UBYTE OneToOne 1 100 0.00 255.0 ECU_ADDRESS 0xD0001DDC /end MEASUREMENT
/begin MEASUREMENT EGRVlvLP_stOfsLrnRls_mp "Zustand der Freigabe des Offset-Lernens" UBYTE OneToOne 1 100 0.00 255.0 ECU_ADDRESS 0xC000B14D /end MEASUREMENT
/begin MEASUREMENT EGRVlvLP_stOfsLrnStMch_mp "Offset-Lernens Zustandautomat-Zustände" UBYTE OneToOne 1 100 0.00 255.0 ECU_ADDRESS 0xC000B14E /end MEASUREMENT
/begin MEASUREMENT EGRVlvLP_stOfsLrnStrt "Diagnosetesterwert zum Starten des Offset-Lernens." UBYTE OneToOne 1 100 0.00 255.0 ECU_ADDRESS 0xD0001DDD /end MEASUREMENT
/begin MEASUREMENT EGRVlvLP_stOpnLdDia "" UBYTE OneToOne 1 100 0.00 255.0 ECU_ADDRESS 0xD0001DDE /end MEASUREMENT
/begin MEASUREMENT EGRVlvLP_stPosGovOn "" UBYTE OneToOne 1 100 0.00 255.0 ECU_ADDRESS 0xD0001DDF /end MEASUREMENT
/begin MEASUREMENT EGRVlvLP_stSlwCls_mp "Status der Slow-Close-Erkennung." UBYTE OneToOne 1 100 0.00 255.0 ECU_ADDRESS 0xC000B147 /end MEASUREMENT
/begin MEASUREMENT EGRVlvLP_stStrStMch_mp "Zustände des Store Zustandsautomatens." UBYTE OneToOne 1 100 0.00 255.0 ECU_ADDRESS 0xC000B14F /end MEASUREMENT
/begin MEASUREMENT EGRVlvLP_stStr_mp "Store-Zustand Status" UBYTE OneToOne 1 100 0.00 255.0 ECU_ADDRESS 0xC000B150 /end MEASUREMENT
/begin MEASUREMENT EGRVlvLP_stTPullDwn_mp "Status des Pull-Down-Ventils." UBYTE OneToOne 1 100 0.00 255.0 ECU_ADDRESS 0xC000B151 /end MEASUREMENT
/begin MEASUREMENT EGRVlvLP_stTrg_mp "Triggerstatus" UBYTE OneToOne 1 100 0.00 255.0 ECU_ADDRESS 0xC000B152 /end MEASUREMENT
/begin MEASUREMENT EGRVlvLP_stVlvClsd_mp "Status des Ventilschließens" UBYTE OneToOne 1 100 0.00 255.0 ECU_ADDRESS 0xC000B153 /end MEASUREMENT
/begin MEASUREMENT EGRVlvLP_stVlvDiff_mp "Status des Ventilöffnens frei." UBYTE OneToOne 1 100 0.00 255.0 ECU_ADDRESS 0xC000B154 /end MEASUREMENT
/begin MEASUREMENT EGRVlvLP_stVlvJamBuf_mp "Status des klemmenden Ventils" UBYTE OneToOne 1 100 0.00 255.0 ECU_ADDRESS 0xC000B155 /end MEASUREMENT
/begin MEASUREMENT EGRVlvLP_stVlvOpnd_mp "" UBYTE OneToOne 1 100 0.00 255.0 ECU_ADDRESS 0xC000B156 /end MEASUREMENT
/begin MEASUREMENT EGRVlvLP_stVlvStkCls_mp "Status (Ventil klemmt während des Schließens)" UBYTE OneToOne 1 100 0.00 255.0 ECU_ADDRESS 0xC000B157 /end MEASUREMENT
/begin MEASUREMENT EGRVlvLP_stVlvStk_mp "Status (Ventil klemmt während des Öffnens)" UBYTE OneToOne 1 100 0.00 255.0 ECU_ADDRESS 0xC000B158 /end MEASUREMENT
/begin MEASUREMENT EGRVlvLP_uRaw "Rohspannungswert aus ADC" SWORD Volt 1 100 -6553.600 6553.400 ECU_ADDRESS 0xD0000904 /end MEASUREMENT
/begin MEASUREMENT EGRVlv_ctAdapCls_mp "Öffnen-Schließen-Zykluszähler" UBYTE OneToOne 1 100 0.00 255.0 ECU_ADDRESS 0xC000B159 /end MEASUREMENT
/begin MEASUREMENT EGRVlv_ctStrtOfsLrn_mp "Anzahl der Motorstarts" UWORD OneToOne 1 100 0.00 65535.00 ECU_ADDRESS 0xC0009D22 /end MEASUREMENT
/begin MEASUREMENT EGRVlv_drAct_mp "Ventilgeschwindigkeit" SWORD VlvVel 1 100 -4000.000 3999.878 FORMAT "%8.3" ECU_ADDRESS 0xC0009CF4 /end MEASUREMENT
/begin MEASUREMENT EGRVlv_facCorFlt_mp "Messpunkt für den Batteriekorrekturfaktor." SWORD Fact 1 100 -4.000000 3.999878 ECU_ADDRESS 0xC0009CD8 /end MEASUREMENT
/begin MEASUREMENT EGRVlv_iEffFlt_mp "Gefilterter Wert des modellierten Stroms." SWORD Curr_A 1 100 -327.6800 327.6700 FORMAT "%8.4" ECU_ADDRESS 0xC0009CF6 /end MEASUREMENT
/begin MEASUREMENT EGRVlv_iEff_mp "Modellierter Strom." SWORD Curr_A 1 100 -327.6800 327.6700 FORMAT "%8.4" ECU_ADDRESS 0xC0009CF8 /end MEASUREMENT
/begin MEASUREMENT EGRVlv_r "Sollwert" SWORD Prc 1 100 -400.0000 399.9878 ECU_ADDRESS 0xD0000906 /end MEASUREMENT
/begin MEASUREMENT EGRVlv_rAbsEGR_mp "Der Betrag des Tastverhältnisses zur Berechnung des modellierten Stroms." SWORD DtyCyc 1 100 -327.6800 327.6700 ECU_ADDRESS 0xC0009CFA /end MEASUREMENT
/begin MEASUREMENT EGRVlv_rAct "" SWORD Prc 1 100 -400.0000 399.9878 ECU_ADDRESS 0xD0000908 /end MEASUREMENT
/begin MEASUREMENT EGRVlv_rActNoErrHdl "Ventilstellung (Offset korrigiert und nach der Fehlerbehandlung)." SWORD Prc 1 100 -400.0000 399.9878 ECU_ADDRESS 0xD000090E /end MEASUREMENT
/begin MEASUREMENT EGRVlv_rActUnCorOld_mp "Unkorrigierte Ventilstellung im vorherigen Fahrzyklus." SWORD Prc 1 100 -400.0000 399.9878 ECU_ADDRESS 0xC0009D24 /end MEASUREMENT
/begin MEASUREMENT EGRVlv_rActUnCor_mp "Unkorrigierte Ventilstellung." SWORD Prc 1 100 -400.0000 399.9878 ECU_ADDRESS 0xC0009D26 /end MEASUREMENT
/begin MEASUREMENT EGRVlv_rActUnLimFlt "" SWORD Prc 1 100 -400.0000 399.9878 ECU_ADDRESS 0xD0000910 /end MEASUREMENT
/begin MEASUREMENT EGRVlv_rAdapLrn_mp "Gelernter Offset-Wert im vorhandenen Fahrzyklus." SWORD Prc 1 100 -400.0000 399.9878 ECU_ADDRESS 0xC0009D28 /end MEASUREMENT
/begin MEASUREMENT EGRVlv_rAdapPos_mp "Ventilstellung am Nullpunkt." SWORD Prc 1 100 -400.0000 399.9878 ECU_ADDRESS 0xC0009D2A /end MEASUREMENT
/begin MEASUREMENT EGRVlv_rBelCtl_mp "" SWORD Prc 1 100 -400.0000 399.9878 ECU_ADDRESS 0xC0009CFC /end MEASUREMENT
/begin MEASUREMENT EGRVlv_rCnv_mp "Messpunkt für den Kennfeldausgang." SWORD DtyCyc 1 100 -327.6800 327.6700 ECU_ADDRESS 0xC0009CDA /end MEASUREMENT
/begin MEASUREMENT EGRVlv_rEGR "Steuerwert des AGR-Ventils" SWORD Prc 1 100 -400.0000 399.9878 ECU_ADDRESS 0xD0000916 /end MEASUREMENT
/begin MEASUREMENT EGRVlv_rGovDvt "Regelabweichung" SWORD Prc 1 100 -400.0000 399.9878 ECU_ADDRESS 0xD0000918 /end MEASUREMENT
/begin MEASUREMENT EGRVlv_rGovDvtRel "Relative Regelabweichung zur OBD." SWORD Prc 1 100 -400.0000 399.9878 ECU_ADDRESS 0xD000091A /end MEASUREMENT
/begin MEASUREMENT EGRVlv_rGovEGR "Steuerwert vom Regler" SWORD Prc 1 100 -400.0000 399.9878 ECU_ADDRESS 0xD000091C /end MEASUREMENT
/begin MEASUREMENT EGRVlv_rGovMax_mp "Maximale Schwelle des Reglers." SWORD Prc 1 100 -400.0000 399.9878 ECU_ADDRESS 0xC0009CFE /end MEASUREMENT
/begin MEASUREMENT EGRVlv_rGovMin_mp "Minimale Schwelle des Reglers." SWORD Prc 1 100 -400.0000 399.9878 ECU_ADDRESS 0xC0009D00 /end MEASUREMENT
/begin MEASUREMENT EGRVlv_rLim_mp "" SWORD Prc 1 100 -400.0000 399.9878 ECU_ADDRESS 0xC0009D02 /end MEASUREMENT
/begin MEASUREMENT EGRVlv_rLinOfs_mp "Ventilstellung vor Begrenzung." SWORD Prc 1 100 -400.0000 399.9878 ECU_ADDRESS 0xC0009D2C /end MEASUREMENT
/begin MEASUREMENT EGRVlv_rOfsLrnFrst "Letzter gelernter Offset-Wert." SWORD Prc 1 100 -400.0000 399.9878 ECU_ADDRESS 0xD000091E /end MEASUREMENT
/begin MEASUREMENT EGRVlv_rOfsLrnLst "Letzter gelernter Ofset-Wert." SWORD Prc 1 100 -400.0000 399.9878 ECU_ADDRESS 0xD0000920 /end MEASUREMENT
/begin MEASUREMENT EGRVlv_rOfsLrnNew "Gelernter Offset-Wert im aktuellen Fahrzyklus." SWORD Prc 1 100 -400.0000 399.9878 ECU_ADDRESS 0xD0000922 /end MEASUREMENT
/begin MEASUREMENT EGRVlv_rOfsLrnVlv "Steuerwert zum Offset-Lernen." SWORD Prc 1 100 -400.0000 399.9878 ECU_ADDRESS 0xD0000924 /end MEASUREMENT
/begin MEASUREMENT EGRVlv_rOfs_mp "Offset-Korrektur" SWORD Prc 1 100 -400.0000 399.9878 ECU_ADDRESS 0xC0009D2E /end MEASUREMENT
/begin MEASUREMENT EGRVlv_rOutD_mp "D Ausgang." SWORD Prc 1 100 -400.0000 399.9878 ECU_ADDRESS 0xC0009D04 /end MEASUREMENT
/begin MEASUREMENT EGRVlv_rOutI_mp "I Ausgang." SWORD Prc 1 100 -400.0000 399.9878 ECU_ADDRESS 0xC0009D06 /end MEASUREMENT
/begin MEASUREMENT EGRVlv_rOutP_mp "P Ausgang." SWORD Prc 1 100 -400.0000 399.9878 ECU_ADDRESS 0xC0009D08 /end MEASUREMENT
/begin MEASUREMENT EGRVlv_rPlausLgT_mp "Plausibler Wert der langfristigen Drift (Differenz zwischen aktuellem Fahrzyklus-Anpassungswert und dem ersten gelernten Anpassungswert)." SWORD Prc 1 100 -400.0000 399.9878 ECU_ADDRESS 0xC0009D30 /end MEASUREMENT
/begin MEASUREMENT EGRVlv_rPlausShT_mp "Plausibler Wert der kurzfristigen Drift (Der Unterschied zwischen aktuellem Fahrzyklus-Anpassungswert und dem letzten gelernten Anpassungswert)." SWORD Prc 1 100 -400.0000 399.9878 ECU_ADDRESS 0xC0009D32 /end MEASUREMENT
/begin MEASUREMENT EGRVlv_rPosLrnMin_mp "Minimales Offset, das während der Schließen/Öffnen-Zyklen des Offset-Lernens erhalten wird." SWORD Prc 1 100 -400.0000 399.9878 ECU_ADDRESS 0xC0009D34 /end MEASUREMENT
/begin MEASUREMENT EGRVlv_rPosRef_mp "Referenzposition des Ventils in offener Stellung." SWORD Prc 1 100 -400.0000 399.9878 ECU_ADDRESS 0xC0009D36 /end MEASUREMENT
/begin MEASUREMENT EGRVlv_rPreCtlVal_mp "" SWORD Prc 1 100 -400.0000 399.9878 ECU_ADDRESS 0xC0009D0A /end MEASUREMENT
/begin MEASUREMENT EGRVlv_rPs "Ausgabe zur Endstufe" SWORD DtyCyc 1 100 -327.6800 327.6700 ECU_ADDRESS 0xD0000926 /end MEASUREMENT
/begin MEASUREMENT EGRVlv_rPullDwnEGR "Steuerwert, um das Ventil langsam zu schließen" SWORD Prc 1 100 -400.0000 399.9878 ECU_ADDRESS 0xD0000928 /end MEASUREMENT
/begin MEASUREMENT EGRVlv_rRlsEGR "Zusätzlicher Steuerwert zur Freigabe eines klemmenden Ventils" SWORD Prc 1 100 -400.0000 399.9878 ECU_ADDRESS 0xD000092A /end MEASUREMENT
/begin MEASUREMENT EGRVlv_rSens "Erfasster Wert der AGR-Ventilposition" SWORD Prc 1 100 -400.0000 399.9878 ECU_ADDRESS 0xD000092C /end MEASUREMENT
/begin MEASUREMENT EGRVlv_stAdap "Zustand des Offset-Lernens" UWORD OneToOne 1 100 0.00 65535.00 ECU_ADDRESS 0xD00015AC /end MEASUREMENT
/begin MEASUREMENT EGRVlv_stAdapActv_mp "Zustand Anpassung aktiv" UBYTE OneToOne 1 100 0.00 255.0 ECU_ADDRESS 0xC000B15A /end MEASUREMENT
/begin MEASUREMENT EGRVlv_stFrstOpn_mp "Status des ersten Öffnens des AGR-Ventils." UBYTE OneToOne 1 100 0.00 255.0 ECU_ADDRESS 0xC000B15B /end MEASUREMENT
/begin MEASUREMENT EGRVlv_stMon "Überwachungsstatus des AGR-Ventils" UWORD OneToOne 1 100 0.00 65535.00 ECU_ADDRESS 0xD00015AE /end MEASUREMENT
/begin MEASUREMENT EGRVlv_stNewVlvTrg_mp "Neues Ventil Auslösezustand" UBYTE OneToOne 1 100 0.00 255.0 ECU_ADDRESS 0xC000B15C /end MEASUREMENT
/begin MEASUREMENT EGRVlv_stOfsLrn "Zustände des Offset-Lernens" UBYTE OneToOne 1 100 0.00 255.0 ECU_ADDRESS 0xD0001DE0 /end MEASUREMENT
/begin MEASUREMENT EGRVlv_stOfsLrnRls_mp "Zustand der Freigabe des Offset-Lernens" UBYTE OneToOne 1 100 0.00 255.0 ECU_ADDRESS 0xC000B15D /end MEASUREMENT
/begin MEASUREMENT EGRVlv_stOfsLrnStMch_mp "Offset-Lernen Zustandautomat-Zustände" UBYTE OneToOne 1 100 0.00 255.0 ECU_ADDRESS 0xC000B15E /end MEASUREMENT
/begin MEASUREMENT EGRVlv_stOfsLrnStrt "Diagnosetesterwert zum Starten des Offset-Lernens." UBYTE OneToOne 1 100 0.00 255.0 ECU_ADDRESS 0xD0001DE1 /end MEASUREMENT
/begin MEASUREMENT EGRVlv_stOpnLdDia "Status der Lastabfalldiagnose" UBYTE OneToOne 1 100 0.00 255.0 ECU_ADDRESS 0xD0001DE2 /end MEASUREMENT
/begin MEASUREMENT EGRVlv_stPosGovOn "" UBYTE OneToOne 1 100 0.00 255.0 ECU_ADDRESS 0xD0001DE3 /end MEASUREMENT
/begin MEASUREMENT EGRVlv_stSlwCls_mp "Status der Slow-Close-Erkennung." UBYTE OneToOne 1 100 0.00 255.0 ECU_ADDRESS 0xC000B148 /end MEASUREMENT
/begin MEASUREMENT EGRVlv_stStrStMch_mp "Zustände des Store Zustandsautomatens." UBYTE OneToOne 1 100 0.00 255.0 ECU_ADDRESS 0xC000B15F /end MEASUREMENT
/begin MEASUREMENT EGRVlv_stStr_mp "Store-Zustand Status" UBYTE OneToOne 1 100 0.00 255.0 ECU_ADDRESS 0xC000B160 /end MEASUREMENT
/begin MEASUREMENT EGRVlv_stTPullDwn_mp "Status des Pull-Down-Ventils." UBYTE OneToOne 1 100 0.00 255.0 ECU_ADDRESS 0xC000B161 /end MEASUREMENT
/begin MEASUREMENT EGRVlv_stTrg_mp "Triggerstatus" UBYTE OneToOne 1 100 0.00 255.0 ECU_ADDRESS 0xC000B162 /end MEASUREMENT
/begin MEASUREMENT EGRVlv_stVlvClsd_mp "Status des Ventilschliessens" UBYTE OneToOne 1 100 0.00 255.0 ECU_ADDRESS 0xC000B163 /end MEASUREMENT
/begin MEASUREMENT EGRVlv_stVlvDiff_mp "Status des freien Ventilöffnens." UBYTE OneToOne 1 100 0.00 255.0 ECU_ADDRESS 0xC000B164 /end MEASUREMENT
/begin MEASUREMENT EGRVlv_stVlvJamBuf_mp "Status des klemmenden Ventils" UBYTE OneToOne 1 100 0.00 255.0 ECU_ADDRESS 0xC000B165 /end MEASUREMENT
/begin MEASUREMENT EGRVlv_stVlvOpnd_mp "" UBYTE OneToOne 1 100 0.00 255.0 ECU_ADDRESS 0xC000B166 /end MEASUREMENT
/begin MEASUREMENT EGRVlv_stVlvStkCls_mp "Status (Ventil klemmt während des Schließens)" UBYTE OneToOne 1 100 0.00 255.0 ECU_ADDRESS 0xC000B167 /end MEASUREMENT
/begin MEASUREMENT EGRVlv_stVlvStk_mp "Status (Ventil klemmt während des Öffnens)" UBYTE OneToOne 1 100 0.00 255.0 ECU_ADDRESS 0xC000B168 /end MEASUREMENT
/begin MEASUREMENT EGRVlv_uRaw "Rohspannungswert aus ADC" SWORD Volt 1 100 -6553.600 6553.400 ECU_ADDRESS 0xD000092E /end MEASUREMENT
/begin MEASUREMENT EMCtl_nEngHysHi_mp "Oberer Schwellenwert der Drehzahlhysterese" SWORD EngN 1 100 -16384.00 16383.50 ECU_ADDRESS 0xC0009D42 /end MEASUREMENT
/begin MEASUREMENT EMCtl_nEngHysLo_mp "Unterer Schwellenwert der Drehzahlhysterese" SWORD EngN 1 100 -16384.00 16383.50 ECU_ADDRESS 0xC0009D44 /end MEASUREMENT
/begin MEASUREMENT EMCtl_rEMDmp_mp "Ausgangsgröße zur Ansteuerung der Motorlagersteuerung" SWORD Prc 1 100 -400.0000 399.9878 ECU_ADDRESS 0xC0009D46 /end MEASUREMENT
/begin MEASUREMENT EMCtl_stValCalc_mp "Status von Motorlager" UWORD OneToOne 1 100 0.00 65535.00 ECU_ADDRESS 0xC0009D48 /end MEASUREMENT
/begin MEASUREMENT EMDmp_r0 "Stellgröße für das Motorschwingungsdämpfer-Gerät" SWORD Prc 1 100 -400.0000 399.9878 ECU_ADDRESS 0xD0000930 /end MEASUREMENT
/begin MEASUREMENT EMDmp_r1 "Stellgröße für das Motorschwingungsdämpfer-Gerät" SWORD Prc 1 100 -400.0000 399.9878 ECU_ADDRESS 0xD0000932 /end MEASUREMENT
/begin MEASUREMENT EMDmp_rPs "Ausgangstastverhältnis für das Motorschwingungsdämpfer-Gerät" SWORD DtyCyc 1 100 -327.6800 327.6700 ARRAY_SIZE 1 ECU_ADDRESS 0xD0000934 /end MEASUREMENT
/begin MEASUREMENT EngDa_stOvrTemp "" UBYTE OneToOne 1 100 0.00 255.0 ECU_ADDRESS 0xD0001BC1 /end MEASUREMENT
/begin MEASUREMENT EngDa_stOvrTemp2 "" UBYTE OneToOne 1 100 0.00 255.0 ECU_ADDRESS 0xD0001BC0 /end MEASUREMENT
/begin MEASUREMENT EngDa_stOvrTemp_mp "" UBYTE OneToOne 1 100 0.00 255.0 ECU_ADDRESS 0xC000B174 /end MEASUREMENT
/begin MEASUREMENT EngDa_stRstEngOff_mp "Status des Resets der Motorabstellzeit" UBYTE OneToOne 1 100 0.00 255.0 ECU_ADDRESS 0xC000B175 /end MEASUREMENT
/begin MEASUREMENT EngDa_tEng "Motortemperatur" SWORD Temp_Cels 1 100 -3549.940 3003.560 ECU_ADDRESS 0xD00003D6 /end MEASUREMENT
/begin MEASUREMENT EngDa_tFld "Motortemperatur-Feld" SWORD Temp_Cels 1 100 -3549.940 3003.560 ARRAY_SIZE 4 ECU_ADDRESS 0xD00003D8 /end MEASUREMENT
/begin MEASUREMENT EngDa_tiEngOff "Aktuelle Motorabstellzeit" SLONG TimeEngOn 1 100 -2147483648.00 2147483647.00 FORMAT "%13.2" ECU_ADDRESS 0xD0002CD0 /end MEASUREMENT
/begin MEASUREMENT EngDa_tiEngOffBuf_mp "Motorabstellzeit vor Erreichen des aktuellen SyC-Zustands" SLONG TimeEngOn 1 100 -2147483648.00 2147483647.00 FORMAT "%13.2" ECU_ADDRESS 0xC0008EC0 /end MEASUREMENT
/begin MEASUREMENT EngDa_tiEngOn "Aktuelle Engine Betriebszeit" SLONG TimeEngOn 1 100 -2147483648.00 2147483647.00 FORMAT "%13.2" ECU_ADDRESS 0xD0002CD4 /end MEASUREMENT
/begin MEASUREMENT EngDa_tStrt "Motorstarttemperatur" SWORD Temp_Cels 1 100 -3549.940 3003.560 ECU_ADDRESS 0xD00003E0 /end MEASUREMENT
/begin MEASUREMENT EngDem_dVolFlt_mp "Gefilterter Abgasvolumenstrom" SWORD CubMtrPerHr 1 100 -3276.800 3276.700 FORMAT "%8.3" ECU_ADDRESS 0xC0009D4A /end MEASUREMENT
/begin MEASUREMENT EngDem_facAdj "Abgleichwert aus EEPROM" SWORD Fact 1 100 -4.000000 3.999878 ECU_ADDRESS 0xD0000986 /end MEASUREMENT
/begin MEASUREMENT EngDem_pDiffPFltPrdc2_mp "Vorhergesagter Differenzdruck über Partikelfilter oder OxiCat" SWORD Pres_hPa 1 100 -32768.00 3500.00 ECU_ADDRESS 0xC0009D4C /end MEASUREMENT
/begin MEASUREMENT EngDem_pDiffPFltPrdc_mp "Vorhergesagter Differenzdruck über Partikelfilter" SWORD Pres_hPa 1 100 -32768.00 3500.00 ECU_ADDRESS 0xC0009D4E /end MEASUREMENT
/begin MEASUREMENT EngDem_resFlowFlt_mp "Gefilterter CSF Strömungswdst." SWORD Res_hPaHrPerCM 1 100 -3.276800 3.276700 FORMAT "%8.6" ECU_ADDRESS 0xC0009D50 /end MEASUREMENT
/begin MEASUREMENT EngDem_stOvrFul "" UBYTE OneToOne 1 100 0.00 255.0 ECU_ADDRESS 0xD0000988 /end MEASUREMENT
/begin MEASUREMENT EngDem_stTrqLimErr "Status Momentenbegrenzung" UBYTE OneToOne 1 100 0.00 255.0 ECU_ADDRESS 0xD0001DEA /end MEASUREMENT
/begin MEASUREMENT EngDem_stTrqLimErr1_mp "" UBYTE OneToOne 1 100 0.00 255.0 ECU_ADDRESS 0xC000B176 /end MEASUREMENT
/begin MEASUREMENT EngDem_stTrqLimErr2_mp "" UBYTE OneToOne 1 100 0.00 255.0 ECU_ADDRESS 0xC000B177 /end MEASUREMENT
/begin MEASUREMENT EngDem_stTrqLimErr3_mp "" UBYTE OneToOne 1 100 0.00 255.0 ECU_ADDRESS 0xC000B178 /end MEASUREMENT
/begin MEASUREMENT EngDem_stTrqLimErr4_mp "" UBYTE OneToOne 1 100 0.00 255.0 ECU_ADDRESS 0xC000B179 /end MEASUREMENT
/begin MEASUREMENT EngDem_stTrqLimErrActv "Statusmessage zur Überprüfung ob Momentenbegrenzung aktiv ist" UBYTE OneToOne 1 100 0.00 255.0 ECU_ADDRESS 0xD0001DEB /end MEASUREMENT
/begin MEASUREMENT EngDem_stTrqLimPFltErr_mp "" UBYTE OneToOne 1 100 0.00 255.0 ECU_ADDRESS 0xC000B17A /end MEASUREMENT
/begin MEASUREMENT EngDem_stTrqLimPFltOvldErr_mp "" UBYTE OneToOne 1 100 0.00 255.0 ECU_ADDRESS 0xC000B17B /end MEASUREMENT
/begin MEASUREMENT EngDem_tOvldMax_mp "" SWORD Temp_Cels 1 100 -3549.940 3003.560 ECU_ADDRESS 0xC0009D52 /end MEASUREMENT
/begin MEASUREMENT EngDem_tPFltOvldMax_mp "" SWORD Temp_Cels 1 100 -3549.940 3003.560 ECU_ADDRESS 0xC0009D54 /end MEASUREMENT
/begin MEASUREMENT EngDem_trqInrLim "Begrenzungsmoment (als inneres Motormoment)" SWORD Trq 1 100 -3276.800 3276.700 ECU_ADDRESS 0xD000098A /end MEASUREMENT
/begin MEASUREMENT EngDem_trqInrLimLead "Inneres Begrenzungsmoment Leadpfad" SWORD Trq 1 100 -3276.800 3276.700 ECU_ADDRESS 0xD000098C /end MEASUREMENT
/begin MEASUREMENT EngDem_trqInrLimLead1_mp "Torque lead limitation after error condition #1" SWORD Trq 1 100 -3276.800 3276.700 ECU_ADDRESS 0xC0009D56 /end MEASUREMENT
/begin MEASUREMENT EngDem_trqInrLimLead2_mp "Torque lead limitation after error condition #2" SWORD Trq 1 100 -3276.800 3276.700 ECU_ADDRESS 0xC0009D58 /end MEASUREMENT
/begin MEASUREMENT EngDem_trqLimErr "Begrenzungsmoment im Fehlerfall" SWORD Trq 1 100 -3276.800 3276.700 ECU_ADDRESS 0xD0000996 /end MEASUREMENT
/begin MEASUREMENT EngDem_trqLimErr1 "Begrenzungsmoment bei fehlerhaften Raildruck" SWORD Trq 1 100 -3276.800 3276.700 ECU_ADDRESS 0xD000098E /end MEASUREMENT
/begin MEASUREMENT EngDem_trqLimErr1Lead_mp "Begrenzungsmoment Leadpfad bei Momentbegrenzungsfehler 1" SWORD Trq 1 100 -3276.800 3276.700 ECU_ADDRESS 0xC0009D5A /end MEASUREMENT
/begin MEASUREMENT EngDem_trqLimErr2 "Begrenzungsmoment bei fehlerhafter Luftmenge pro Zylinder" SWORD Trq 1 100 -3276.800 3276.700 ECU_ADDRESS 0xD0000990 /end MEASUREMENT
/begin MEASUREMENT EngDem_trqLimErr2Lead_mp "Begrenzungsmoment Leadpfad bei Momentbegrenzungsfehler 2" SWORD Trq 1 100 -3276.800 3276.700 ECU_ADDRESS 0xC0009D5C /end MEASUREMENT
/begin MEASUREMENT EngDem_trqLimErr3 "Begrenzungsmoment bei fehler" SWORD Trq 1 100 -3276.800 3276.700 ECU_ADDRESS 0xD0000992 /end MEASUREMENT
/begin MEASUREMENT EngDem_trqLimErr3Lead_mp "Begrenzungsmoment Leadpfad bei Momentbegrenzungsfehler 3" SWORD Trq 1 100 -3276.800 3276.700 ECU_ADDRESS 0xC0009D5E /end MEASUREMENT
/begin MEASUREMENT EngDem_trqLimErr4 "Begrenzungsmoment bei fehler" SWORD Trq 1 100 -3276.800 3276.700 ECU_ADDRESS 0xD0000994 /end MEASUREMENT
/begin MEASUREMENT EngDem_trqLimErr4Lead_mp "Begrenzungsmoment Leadpfad bei Momentbegrenzungsfehler 4" SWORD Trq 1 100 -3276.800 3276.700 ECU_ADDRESS 0xC0009D60 /end MEASUREMENT
/begin MEASUREMENT EngDem_trqLimErrLeadMin1_mp "Begrenzungsmoment Leadpfad nach Minimumbildung 1" SWORD Trq 1 100 -3276.800 3276.700 ECU_ADDRESS 0xC0009D62 /end MEASUREMENT
/begin MEASUREMENT EngDem_trqLimErrLeadMin2_mp "Begrenzungsmoment Leadpfad nach Minimumbildung 2" SWORD Trq 1 100 -3276.800 3276.700 ECU_ADDRESS 0xC0009D64 /end MEASUREMENT
/begin MEASUREMENT EngDem_trqLimErrLeadMin3_mp "Begrenzungsmoment Leadpfad nach Minimumbildung 3" SWORD Trq 1 100 -3276.800 3276.700 ECU_ADDRESS 0xC0009D66 /end MEASUREMENT
/begin MEASUREMENT EngDem_trqLimErrLead_mp "Begrenzungsmoment Leadpfad bei Momentbegrenzungsfehler" SWORD Trq 1 100 -3276.800 3276.700 ECU_ADDRESS 0xC0009D68 /end MEASUREMENT
/begin MEASUREMENT EngDem_trqLimMin1_mp "Wirksames Begrenzungsmoment aus CSF Motorschutz" SWORD Trq 1 100 -3276.800 3276.700 ECU_ADDRESS 0xC0009D6A /end MEASUREMENT
/begin MEASUREMENT EngDem_trqLimMinEEPVal_mp "Minimum aus Begrenzungsmoment bei CSF Motorschutz" SWORD Trq 1 100 -3276.800 3276.700 ECU_ADDRESS 0xC0009D6C /end MEASUREMENT
/begin MEASUREMENT EngDem_trqLimOvld_mp "" SWORD Trq 1 100 -3276.800 3276.700 ECU_ADDRESS 0xC0009D6E /end MEASUREMENT
/begin MEASUREMENT EngDem_trqLimPDiff "Begrenzungsmoment aufgrund Abgasgegendruck" SWORD Trq 1 100 -3276.800 3276.700 ECU_ADDRESS 0xD0000998 /end MEASUREMENT
/begin MEASUREMENT EngDem_trqLimPDiffNOffsAdd_mp "Drehzahlabhängiges Moment zur Gewährleistung sicherer Motorstarts." SWORD Trq 1 100 -3276.800 3276.700 ECU_ADDRESS 0xC0009D70 /end MEASUREMENT
/begin MEASUREMENT EngDem_trqLimPDiffNOffs_mp "n-Teil des Moments zur Verbesserung des Motorstarts" SWORD Trq 1 100 -3276.800 3276.700 ECU_ADDRESS 0xC0009D72 /end MEASUREMENT
/begin MEASUREMENT EngDem_trqLimPFlt1_mp "Begrenzungsmoment aus Differenzdruck bei CSF Motorschutz" SWORD Trq 1 100 -3276.800 3276.700 ECU_ADDRESS 0xC0009D74 /end MEASUREMENT
/begin MEASUREMENT EngDem_trqLimPFltErr_mp "" SWORD Trq 1 100 -3276.800 3276.700 ECU_ADDRESS 0xC0009D76 /end MEASUREMENT
/begin MEASUREMENT EngDem_trqLimPFltOvld_mp "" SWORD Trq 1 100 -3276.800 3276.700 ECU_ADDRESS 0xC0009D78 /end MEASUREMENT
/begin MEASUREMENT EngDem_trqLimRslt0_mp "Begrenzungsmoment resultierend 0" SWORD Trq 1 100 -3276.800 3276.700 ECU_ADDRESS 0xC0009D7A /end MEASUREMENT
/begin MEASUREMENT EngDem_trqLimRslt1_mp "Begrenzungsmoment resultierend 1" SWORD Trq 1 100 -3276.800 3276.700 ECU_ADDRESS 0xC0009D7C /end MEASUREMENT
/begin MEASUREMENT EngDem_trqLimRslt2_mp "Begrenzungsmoment resultierend 2" SWORD Trq 1 100 -3276.800 3276.700 ECU_ADDRESS 0xC0009D7E /end MEASUREMENT
/begin MEASUREMENT EngDem_trqLimRslt_mp "Begrenzungsmoment resultierend" SWORD Trq 1 100 -3276.800 3276.700 ECU_ADDRESS 0xC0009D80 /end MEASUREMENT
/begin MEASUREMENT EngDem_trqLimSwt "Begrenzungsmoment" SWORD Trq 1 100 -3276.800 3276.700 ECU_ADDRESS 0xD000099A /end MEASUREMENT
/begin MEASUREMENT EngDem_trqLimSwt1_mp "Begrenzungsmoment 1" SWORD Trq 1 100 -3276.800 3276.700 ECU_ADDRESS 0xC0009D82 /end MEASUREMENT
/begin MEASUREMENT EngDem_trqLimSwt2_mp "Begrenzungsmoment 2" SWORD Trq 1 100 -3276.800 3276.700 ECU_ADDRESS 0xC0009D84 /end MEASUREMENT
/begin MEASUREMENT EngDem_trqLimSwt3_mp "Begrenzungsmoment 3" SWORD Trq 1 100 -3276.800 3276.700 ECU_ADDRESS 0xC0009D86 /end MEASUREMENT
/begin MEASUREMENT EngDem_trqLimSwt4_mp "Begrenzungsmoment 4" SWORD Trq 1 100 -3276.800 3276.700 ECU_ADDRESS 0xC0009D88 /end MEASUREMENT
/begin MEASUREMENT EngDem_trqLimSwt5_mp "Begrenzungsmoment 5" SWORD Trq 1 100 -3276.800 3276.700 ECU_ADDRESS 0xC0009D8A /end MEASUREMENT
/begin MEASUREMENT EngDem_trqLimSwtMinAdj_mp "Inneres Begrenzungsmoment vor Overfuelling Korrektur" SWORD Trq 1 100 -3276.800 3276.700 ECU_ADDRESS 0xC0009D8C /end MEASUREMENT
/begin MEASUREMENT EngDem_trqLimSwtMin_mp "Inneres Begrenzungsmoment vor Abgleichwert Korrektur" SWORD Trq 1 100 -3276.800 3276.700 ECU_ADDRESS 0xC0009D8E /end MEASUREMENT
/begin MEASUREMENT EngDem_trqOvrFul "Overfueling Menge nach Rampe" SWORD Trq 1 100 -3276.800 3276.700 ECU_ADDRESS 0xD000099C /end MEASUREMENT
/begin MEASUREMENT Layer_nEngOld_mp "" SWORD EngN 1 100 -16384.00 16383.50 ECU_ADDRESS 0xC0009CBA /end MEASUREMENT
/begin MEASUREMENT Layer_qSetUnBalOld_mp "" SWORD InjMassCyc 1 100 -327.6800 327.6700 ECU_ADDRESS 0xC0009CBC /end MEASUREMENT
/begin MEASUREMENT Layer_stMSARec_mp "" UBYTE OneToOne 1 100 0.00 255.0 ECU_ADDRESS 0xC000B145 /end MEASUREMENT
/begin MEASUREMENT Layer_tiEngShOff "" UWORD Time_Sec_One2One 1 100 0.00 65535.00 FORMAT "%8.2" ECU_ADDRESS 0xD00015F8 /end MEASUREMENT
/begin MEASUREMENT Layer_ugenOld_mp "" SWORD UC_Volt 1 100 -3276.800 3276.700 FORMAT "%8.3" ECU_ADDRESS 0xC0009CBE /end MEASUREMENT
/begin MEASUREMENT Md_entlsoll3 "" SWORD Def_m_sw_q0p1 1 100 -3276.80 3276.70 FORMAT "%7.2" ECU_ADDRESS 0xC0009D38 /end MEASUREMENT
/begin MEASUREMENT Pr_md_entlsoll3 "" UBYTE Def_dez_ub_q1 1 100 0.00 255. FORMAT "%3.0" ECU_ADDRESS 0xC000B169 /end MEASUREMENT
/begin MEASUREMENT Stat_entl "" UBYTE Def_dez_ub_q1 1 100 0.00 255. FORMAT "%3.0" ECU_ADDRESS 0xC000B16A /end MEASUREMENT
/begin MEASUREMENT St_elmot1 "Statuswort" UBYTE Def_st_ub_q1 1 100 0.00 255. FORMAT "%3.0" ECU_ADDRESS 0xC000B16B /end MEASUREMENT
/begin MEASUREMENT St_elmot2 "Statuswort" UBYTE Def_st_ub_q1 1 100 0.00 255. FORMAT "%3.0" ECU_ADDRESS 0xC000B16C /end MEASUREMENT
/begin MEASUREMENT St_elmotentl "Statuswort" UBYTE Def_st_ub_q1 1 100 0.00 255. FORMAT "%3.0" ECU_ADDRESS 0xC000B16D /end MEASUREMENT
/begin MEASUREMENT St_elmottime "Statuswort" UBYTE Def_st_ub_q1 1 100 0.00 255. FORMAT "%3.0" ECU_ADDRESS 0xC000B16E /end MEASUREMENT
/begin MEASUREMENT St_elnotafu "Statuswort" UBYTE Def_st_ub_q1 1 100 0.00 255. FORMAT "%3.0" ECU_ADDRESS 0xC000B16F /end MEASUREMENT
/begin MEASUREMENT St_entlast_loc "" UBYTE Def_dez_ub_q1 1 100 0.00 255. FORMAT "%3.0" ECU_ADDRESS 0xC000B170 /end MEASUREMENT
/begin MEASUREMENT Timecount_0 "" UWORD Def_td_uw_q0p1 1 100 0.00 6553.5 FORMAT "%6.1" ECU_ADDRESS 0xC0009D3A /end MEASUREMENT
/begin MEASUREMENT Timecount_1 "" UWORD Def_td_uw_q0p1 1 100 0.00 6553.5 FORMAT "%6.1" ECU_ADDRESS 0xC0009D3C /end MEASUREMENT
/begin MEASUREMENT Timecount_2 "" UWORD Def_td_uw_q0p1 1 100 0.00 6553.5 FORMAT "%6.1" ECU_ADDRESS 0xC0009D3E /end MEASUREMENT
/begin MEASUREMENT Timecount_3 "" UWORD Def_td_uw_q0p1 1 100 0.00 6553.5 FORMAT "%6.1" ECU_ADDRESS 0xC0009D40 /end MEASUREMENT
/begin MEASUREMENT Timecount_4 "" UBYTE Def_dez_ub_q1 1 100 0.00 255. FORMAT "%3.0" ECU_ADDRESS 0xC000B171 /end MEASUREMENT
/begin MEASUREMENT Timecount_5 "" UBYTE Def_dez_ub_q1 1 100 0.00 255. FORMAT "%3.0" ECU_ADDRESS 0xC000B172 /end MEASUREMENT
/begin MEASUREMENT Timecount_6 "" UBYTE Def_dez_ub_q1 1 100 0.00 255. FORMAT "%3.0" ECU_ADDRESS 0xC000B173 /end MEASUREMENT
/begin FUNCTION DStgy_QntIfc ""
 /begin DEF_CHARACTERISTIC DStgy_dmNH3CurrLim_C DStgy_dmNH3CurrMax_C DStgy_dmNH3CurrMin_C DStgy_dmNH3MetAdap_C DStgy_dmRdcAgAct_C DStgy_facCnvMFl_C DStgy_facKiRdcAg_C DStgy_facNH3ToRdcAg_C DStgy_facQtyAdap_C DStgy_mRdcAgAct_C DStgy_stMetMod_C DStgy_swtRdcAgAcmEna_C DStgy_swtTestEna_C /end DEF_CHARACTERISTIC
 /begin IN_MEASUREMENT SCRAd_facQtyAdap SCRCtl_stMetMod SCRLdG_dmNH3MetAdap UDC_dmRdcAgAct UDC_mRdcAgAct /end IN_MEASUREMENT
 /begin OUT_MEASUREMENT DStgy_dmNH3Curr DStgy_dmRdcAgDes DStgy_mRdcAgDes DStgy_stRdcAgInteg /end OUT_MEASUREMENT
 /begin LOC_MEASUREMENT DStgy_dmNH3Act_mp DStgy_dmNH3CurrLtd_mp DStgy_dmNH3CurrPreLim_mp DStgy_dmRdcAgDesAdd_mp DStgy_dmRdcAgDesByp_mp DStgy_mNH3ActLst_mp DStgy_mNH3Act_mp DStgy_stInitAcm_mp /end LOC_MEASUREMENT
/end FUNCTION
/begin FUNCTION DTR "" /begin DEF_CHARACTERISTIC DTR_numCANOBDId_CA DTR_numCANTstId_CA DTR_xAsgnCANRslt_CA /end DEF_CHARACTERISTIC
 /begin OUT_MEASUREMENT DTR_valLoLim.DTR_AirCtlGovDvt DTR_valLoLim.DTR_AirCtlGovLPDvt DTR_valLoLim.DTR_CEngDsTDynTstDTMin DTR_valLoLim.DTR_CEngDsTDynTstTMin DTR_valLoLim.DTR_CEngDsTDynTstTiMax DTR_valLoLim.DTR_Dummy DTR_valLoLim.DTR_LSUDynChkState2 DTR_valLoLim.DTR_LSUDynChkState3 DTR_valLoLim.DTR_LSUHtCoupErr DTR_valLoLim.DTR_LSUO2Plaus DTR_valLoLim.DTR_PFltCharPDiffMin DTR_valLoLim.DTR_PFltDstrMin DTR_valTst.DTR_AirCtlGovDvt DTR_valTst.DTR_AirCtlGovLPDvt DTR_valTst.DTR_CEngDsTDynTstDTMin DTR_valTst.DTR_CEngDsTDynTstTMin DTR_valTst.DTR_CEngDsTDynTstTiMax DTR_valTst.DTR_Dummy DTR_valTst.DTR_LSUDynChkState2 DTR_valTst.DTR_LSUDynChkState3 DTR_valTst.DTR_LSUHtCoupErr DTR_valTst.DTR_LSUO2Plaus DTR_valTst.DTR_PFltCharPDiffMin DTR_valTst.DTR_PFltDstrMin DTR_valUpLim.DTR_AirCtlGovDvt DTR_valUpLim.DTR_AirCtlGovLPDvt DTR_valUpLim.DTR_CEngDsTDynTstDTMin DTR_valUpLim.DTR_CEngDsTDynTstTMin DTR_valUpLim.DTR_CEngDsTDynTstTiMax DTR_valUpLim.DTR_Dummy DTR_valUpLim.DTR_LSUDynChkState2 DTR_valUpLim.DTR_LSUDynChkState3 DTR_valUpLim.DTR_LSUHtCoupErr DTR_valUpLim.DTR_LSUO2Plaus DTR_valUpLim.DTR_PFltCharPDiffMin DTR_valUpLim.DTR_PFltDstrMin /end OUT_MEASUREMENT
/end FUNCTION
/begin FUNCTION EBxFan "" /begin IN_MEASUREMENT DevLib_stPwrStgEnaCond /end IN_MEASUREMENT /begin SUB_FUNCTION EBxFan_DD /end SUB_FUNCTION /end FUNCTION
/begin FUNCTION EBxFanCtl_Spd "" /begin DEF_CHARACTERISTIC EBxFanCtl_tOff_C EBxFanCtl_tOn_C /end DEF_CHARACTERISTIC /begin IN_MEASUREMENT EBxFan_st TECU_t /end IN_MEASUREMENT /end FUNCTION
/begin FUNCTION EBxFan_DD ""
 /begin DEF_CHARACTERISTIC EBxFan_DigOut.tiBtwTstSCB_C EBxFan_DigOut.tiBtwTstOT_C EBxFan_DigOut.numTstMax_C EBxFan_stPsDiaDisbl_C EBxFan_stPsDisbl_C /end DEF_CHARACTERISTIC
 /begin IN_MEASUREMENT DevLib_stPwrStgEnaCond /end IN_MEASUREMENT
 /begin OUT_MEASUREMENT EBxFan_st EBxFan_stPs /end OUT_MEASUREMENT
/end FUNCTION
/begin FUNCTION ECBVlvAPos_DD "" /begin DEF_CHARACTERISTIC ECBVlv_rTransf_CUR ECBVlv_SRC.uMin_C ECBVlv_SRC.uMax_C /end DEF_CHARACTERISTIC /begin OUT_MEASUREMENT ECBVlv_rSens ECBVlv_uRaw /end OUT_MEASUREMENT /end FUNCTION
/begin FUNCTION ECBVlvAPos_VD ""
 /begin DEF_CHARACTERISTIC ECBVlv_RmpSlp.Pos_C ECBVlv_RmpSlp.Neg_C ECBVlv_TransStg.Dfl_C ECBVlv_TransStg.stSensId_C /end DEF_CHARACTERISTIC
 /begin OUT_MEASUREMENT ECBVlv_rAct /end OUT_MEASUREMENT
/end FUNCTION
/begin FUNCTION ECBVlv_DD ""
 /begin DEF_CHARACTERISTIC ECBVlv_Pwm.tiPer_C ECBVlv_Pwm.stLvl_C ECBVlv_Pwm.rMaxDty_C ECBVlv_Pwm.rPerUn_C ECBVlv_Pwm.tiPh_C ECBVlv_PwmOut.rMin_C ECBVlv_PwmOut.rMax_C ECBVlv_PwmOut.tiBtwTstSCB_C ECBVlv_PwmOut.tiBtwTstOT_C ECBVlv_PwmOut.numTstMax_C ECBVlv_PwmOut.swtBattCor_C ECBVlv_PwmOut.swtPsInv_C ECBVlv_rCnv_CUR ECBVlv_rPsDisbl_C ECBVlv_stPsDiaDisbl_C ECBVlv_stPsDisbl_C /end DEF_CHARACTERISTIC
 /begin IN_MEASUREMENT BattU_facCor DevLib_stPwrStgEnaCond /end IN_MEASUREMENT
 /begin OUT_MEASUREMENT ECBVlv_r ECBVlv_rPs /end OUT_MEASUREMENT
/end FUNCTION
/begin FUNCTION EcuComNC "" /end FUNCTION
/begin FUNCTION edc2layer_adap ""
 /begin DEF_CHARACTERISTIC edc2layer_bkwdrehtHi_C edc2layer_bkwdrehtLo_C edc2layer_B_ulcp_C edc2layer_nbmsastopt_C edc2layer_nB_ll_High_C edc2layer_nB_ll_Low_C edc2layer_nSetPointHigh_C edc2layer_nSetPointLow_C edc2layer_rLoadMax_C edc2layer_rLoadMin_C Layer_dmAirPerTimeCor_C Layer_dmAirPerTimeIMax_C Layer_dmAirPerTimeIMin_C Layer_nEngRunHi_C Layer_nEngRunLo_C Layer_nEngSpdDelta_C Layer_nVarMax_C Layer_qSetDelta_C Layer_stCarType_C Layer_stMSARec_C Layer_stPCRBits_C Layer_stTrqLimMsk_C Layer_swtNekpFlt_C Layer_tiAirPerTimeI_C Layer_tiDesVoltStat_C Layer_tiEngSpdStat_C Layer_tiInjCtlStat_C Layer_tiNkw_grad_fpt1_C Layer_tiPSPFltPT1_C Layer_uDesDelta_C /end DEF_CHARACTERISTIC
 /begin IN_MEASUREMENT ActMod_trqClth AC_trqDes AFST_t AFS_dm AFS_mAirPerCyl AirCtl_stMon Air_pIntkVUs AltIO_iOut AltIO_numAltTyp AltIO_numChpVers AltIO_numGovTyp AltIO_numLdRng AltIO_numMnfcCod AltIO_rAltLoad AltIO_stErrAlt AltIO_swtAltTyp AltIO_tChp AltIO_tiLR AltIO_uAlt AltIO_uNom APP_drUnFlt ARS_trqDes BrkP_pSens Brk_st CACDsT_t Clth_st CoEng_st CoEOM_stOpModeAct Com_aDirect Com_aSide Com_bRecMSA Com_ctCBSRstOil Com_ctrDay Com_ctrSec Com_dDay Com_dIntrvTimeCBSRst2Oil Com_dMonth Com_dMonthCBSRst2Oil Com_dphiStWhlAg Com_dRmnMlgCBSRstOil Com_dYear Com_dYearCBSRst2Oil Com_idParkConsumer Com_idVerbraucher Com_iHiLimCurr Com_iLoLimCurr Com_iPsp Com_iZrLimCurr Com_lIntrvWayCBSRst2Oil Com_lSum Com_nPsp Com_phiStWhlAg Com_rAvlCBSRstOil Com_rPwrSpCons Com_stBattClass Com_stBonnet Com_stButtonMSA Com_stCANType Com_stClthOpen Com_stClthRaw Com_stDoorDriver Com_stMSAStop Com_stParkConsumer Com_stReqMSA Com_stSeason Com_stShutOffPSP Com_stTRadio Com_stTrailer Com_stUnCBSRstOil Com_stVerbraucher Com_swtAC Com_tEnvT Com_tiPostRunPwrSpl Com_trqDVCH Com_uPsp Com_vVeh CoVeh_trqAcs EGRVlv_rPs EngDa_tEng EngDem_stOvrFul EngDem_trqInrLim EnvP_p EnvT_t Epm_nEng ESS_uBatt Exh_tAdapTOxiCatUs Exh_tSensTPFltUs Exh_uRawTOxiCatUs Fan_rPs FlFCBS_stFlLPCActv FlFltDsP_p FlFltUsP_p FlSys_volTotFlCons FuelLvl_vol FuelT_t Gbx_dNPos GlbDa_lWhlCirc GlbDa_stTrqDem GlbDa_vX GlwEcu_pwrGlow HLSDem_nSetPLoCoEng HLSDem_nSetPLoLocRamp HLSDem_nSetPLoPwrMng HLSDem_nSetPLoStat IBS_stIbsDet InjCtl_qCurr InjCtl_qSetUnBal ISC_trqLossFlt Layer_stLayer LSU_rLam Lub_stOilLayer MeUn_iActVal Oil_ctNplErrLvl Oil_ctStrtDlyLvl Oil_ctTOutLvl Oil_rRawOilLvl Oil_rRawOilQl Oil_rRawOilT Oil_stComErr Oil_stRegSens Oil_tiLoLvl PCR_stCByVlvOpn PCR_stPCRBits PCV_iActVal PSP_dvolOut PthSet_stOvrRunCoord PthSet_trqInrSet PT_stGrip PT_stTraGrip PT_stTraType PT_trqLos PT_trqWhl RngMod_trqClthMax RngMod_trqMin SpdGov_nSetPLo StSys_stStrt T15_st T50_st Tra_numGear Tra_tOil VehMot_rAccPedFlt VehMot_rTrqDfftl VehV_v VMD_rVirtAPP /end IN_MEASUREMENT
 /begin OUT_MEASUREMENT Layer_tiEngShOff /end OUT_MEASUREMENT
 /begin LOC_MEASUREMENT Layer_nEngOld_mp Layer_qSetUnBalOld_mp Layer_stMSARec_mp Layer_ugenOld_mp /end LOC_MEASUREMENT
/end FUNCTION
/begin FUNCTION Eec "" /end FUNCTION
/begin FUNCTION Eeebd "" /begin OUT_MEASUREMENT Eeebd_numSectChg Eeebd_stEee /end OUT_MEASUREMENT /end FUNCTION
/begin FUNCTION Eeepdd "" /end FUNCTION
/begin FUNCTION eepcd "" /end FUNCTION
/begin FUNCTION EepHal "" /begin DEF_CHARACTERISTIC /end DEF_CHARACTERISTIC /begin OUT_MEASUREMENT /end OUT_MEASUREMENT /end FUNCTION
/begin FUNCTION Eesbd "" /end FUNCTION
/begin FUNCTION Eespdd "" /end FUNCTION
/begin FUNCTION EGRClg_CtlValCalc ""
 /begin DEF_CHARACTERISTIC EGRClg_ClgOff_CUR EGRClg_ClgOn_CUR EGRClg_numAirTempCtlVal_C EGRClg_numEngTempCtlVal_C EGRClg_numTempSensPrePFlt_C EGRClg_rAirCtlClgOff_C EGRClg_rClgOff_C EGRClg_rClgOn_C EGRClg_rDflVal_CA EGRClg_stBitMskCtlVal_C EGRClg_stBitMskEOM_CA EGRClg_stMonEOMMsk_CA EGRClg_stPrioMon_CA EGRClg_stShOffEOMMsk_C EGRClg_tAirClgOff_C EGRClg_tAirClgOn_C EGRClg_tCldStrtThres_C EGRClg_tEngClgOff_C EGRClg_tEngClgOn_C EGRClg_tEngLowClgOff_C EGRClg_tEngLowClgOn_C EGRClg_tiCldStrt_C EGRClg_tiMonEOM_CA EGRClg_tPrePFltBypOn_C /end DEF_CHARACTERISTIC
 /begin REF_CHARACTERISTIC HESrv_swtScndFlwActv_C /end REF_CHARACTERISTIC
 /begin IN_MEASUREMENT CoEng_st CoEOM_stOpModeAct EGRVlv_r EngDa_tFld Epm_nEng Exh_tFld InjCtl_qCurr PthLead_trqInrCurr /end IN_MEASUREMENT
 /begin OUT_MEASUREMENT EGRClg_stMon /end OUT_MEASUREMENT
 /begin LOC_MEASUREMENT EGRClg_ClgOff_mp EGRClg_ClgOn_mp EGRClg_numEOMMode_mp EGRClg_rCtlCor_mp EGRClg_rCtlValNrm_mp EGRClg_stBitMskEOM_mp EGRClg_stCtlValBits_mp EGRClg_stCtlVal_mp EGRClg_stEGRClgBits_mp EGRClg_stMonBits_mp EGRClg_stSelBitMskEOM_mp EGRClg_tAirCtlVal_mp EGRClg_tEngCtlVal1_mp EGRClg_tEngCtlVal_mp EGRClg_tiMonEOM_mp EGRClg_tPrePFlt_mp /end LOC_MEASUREMENT
/end FUNCTION
/begin FUNCTION EGRVlv_DD ""
 /begin DEF_CHARACTERISTIC EGRVlvLP_facCorStrt_C EGRVlvLP_Pwm.tiPer_C EGRVlvLP_Pwm.stLvl_C EGRVlvLP_Pwm.rMaxDty_C EGRVlvLP_Pwm.rPerUn_C EGRVlvLP_Pwm.tiPh_C EGRVlvLP_PwmOut.rMin_C EGRVlvLP_PwmOut.rMax_C EGRVlvLP_PwmOut.tiBtwTstSCB_C EGRVlvLP_PwmOut.tiBtwTstOT_C EGRVlvLP_PwmOut.numTstMax_C EGRVlvLP_PwmOut.swtBattCor_C EGRVlvLP_PwmOut.swtPsInv_C EGRVlvLP_rCnv_CUR EGRVlvLP_stPwrStgDiaDis_C EGRVlvLP_stPwrStgDis_C EGRVlvLP_swtOpnLdDiaStrt_C EGRVlvLP_swtSelOvrCurrErr_C EGRVlvLP_tiBattCorFacFlt_C EGRVlv_facCorStrt_C EGRVlv_Pwm.tiPer_C EGRVlv_Pwm.stLvl_C EGRVlv_Pwm.rMaxDty_C EGRVlv_Pwm.rPerUn_C EGRVlv_Pwm.tiPh_C EGRVlv_PwmOut.rMin_C EGRVlv_PwmOut.rMax_C EGRVlv_PwmOut.tiBtwTstSCB_C EGRVlv_PwmOut.tiBtwTstOT_C EGRVlv_PwmOut.numTstMax_C EGRVlv_PwmOut.swtBattCor_C EGRVlv_PwmOut.swtPsInv_C EGRVlv_rCnv_CUR EGRVlv_stPwrStgDiaDis_C EGRVlv_stPwrStgDis_C EGRVlv_swtOpnLdDiaStrt_C EGRVlv_swtSelOvrCurrErr_C EGRVlv_tiBattCorFacFlt_C /end DEF_CHARACTERISTIC
 /begin IN_MEASUREMENT BattU_facCor CoEng_st DevLib_stPwrStgEnaCond EGRVlvLP_rEGR EGRVlvLP_rOfsLrnVlv EGRVlvLP_stAdap EGRVlvLP_stMon EGRVlv_rEGR EGRVlv_rOfsLrnVlv EGRVlv_stAdap EGRVlv_stMon Epm_nEng /end IN_MEASUREMENT
 /begin OUT_MEASUREMENT EGRVlvLP_rPs EGRVlvLP_stOpnLdDia EGRVlv_rPs EGRVlv_stOpnLdDia /end OUT_MEASUREMENT
 /begin LOC_MEASUREMENT EGRVlvLP_facCorFlt_mp EGRVlvLP_rCnv_mp EGRVlv_facCorFlt_mp EGRVlv_rCnv_mp /end LOC_MEASUREMENT
/end FUNCTION
/begin FUNCTION egrvlv_ddsens ""
 /begin DEF_CHARACTERISTIC EGRVlvLP_rTransf_CUR EGRVlvLP_SRC.uMin_C EGRVlvLP_SRC.uMax_C EGRVlvLP_swtSensPrs_C EGRVlv_rTransf_CUR EGRVlv_SRC.uMin_C EGRVlv_SRC.uMax_C EGRVlv_swtSensPrs_C /end DEF_CHARACTERISTIC
 /begin OUT_MEASUREMENT EGRVlvLP_rSens EGRVlvLP_uRaw EGRVlv_rSens EGRVlv_uRaw /end OUT_MEASUREMENT
/end FUNCTION
/begin FUNCTION egrvlv_vdmon ""
 /begin DEF_CHARACTERISTIC EGRVlvLP_facStepThres_C EGRVlvLP_numEngTempMon_C EGRVlvLP_PullDwnIKi_C EGRVlvLP_rDvtMax_C EGRVlvLP_rDvtMin_C EGRVlvLP_rJamVlvOpnDemMax_C EGRVlvLP_rJamVlvOpnHi_C EGRVlvLP_rJamVlvOpnLo_C EGRVlvLP_rLMSActThresDwn_C EGRVlvLP_rLMSThresDwn_C EGRVlvLP_rLMSThresUp_C EGRVlvLP_RlsIKi_C EGRVlvLP_rPullDwnMax_C EGRVlvLP_rRlsMax_C EGRVlvLP_stAirCtlMon_C EGRVlvLP_swtAirCtlOn_C EGRVlvLP_swtGovByp_C EGRVlvLP_tEngHi_C EGRVlvLP_tEngLo_C EGRVlvLP_tiPullDwn_C EGRVlvLP_tiRepRls_C EGRVlvLP_tiRls_C EGRVlv_facStepThres_C EGRVlv_numEngTempMon_C EGRVlv_PullDwnIKi_C EGRVlv_rDvtMax_C EGRVlv_rDvtMin_C EGRVlv_rJamVlvOpnDemMax_C EGRVlv_rJamVlvOpnHi_C EGRVlv_rJamVlvOpnLo_C EGRVlv_rLMSActThresDwn_C EGRVlv_rLMSThresDwn_C EGRVlv_rLMSThresUp_C EGRVlv_RlsIKi_C EGRVlv_rPullDwnMax_C EGRVlv_rRlsMax_C EGRVlv_stAirCtlMon_C EGRVlv_swtAirCtlOn_C EGRVlv_swtGovByp_C EGRVlv_tEngHi_C EGRVlv_tEngLo_C EGRVlv_tiPullDwn_C EGRVlv_tiRepRls_C EGRVlv_tiRls_C /end DEF_CHARACTERISTIC
 /begin IN_MEASUREMENT CoEng_st EGRVlvLP_r EGRVlvLP_rAct EGRVlvLP_rGovDvt EGRVlvLP_stAdap EGRVlv_r EGRVlv_rAct EGRVlv_rGovDvt EGRVlv_stAdap EngDa_tFld /end IN_MEASUREMENT
 /begin OUT_MEASUREMENT EGRVlvLP_rPullDwnEGR EGRVlvLP_rRlsEGR EGRVlvLP_stMon EGRVlv_rPullDwnEGR EGRVlv_rRlsEGR EGRVlv_stMon /end OUT_MEASUREMENT
/end FUNCTION
/begin FUNCTION egrvlv_vdposgov ""
 /begin DEF_CHARACTERISTIC EGRVlvLP_DKdNgv_C EGRVlvLP_DKdPsv_C EGRVlvLP_drActNgv_C EGRVlvLP_iEff_CUR EGRVlvLP_IKiNgv_C EGRVlvLP_IKiPsv_C EGRVlvLP_PKpNgv_C EGRVlvLP_PKpPsv_C EGRVlvLP_rActNgv_C EGRVlvLP_rBelAir_MAP EGRVlvLP_rBelCtl_MAP EGRVlvLP_rCtlVal_C EGRVlvLP_rDesEGR_CUR EGRVlvLP_rGovDvtThres_C EGRVlvLP_rGovMax_CUR EGRVlvLP_rGovMin_CUR EGRVlvLP_rGvnrPreMax_C EGRVlvLP_rGvnrPreMin_C EGRVlvLP_rOutDMax_C EGRVlvLP_rOutIMax_C EGRVlvLP_rPIDWinNgv_C EGRVlvLP_rPIDWinPsv_C EGRVlvLP_rRmp_C EGRVlvLP_SlwClsDKd_C EGRVlvLP_SlwClsIKi_C EGRVlvLP_SlwClsPKp_C EGRVlvLP_SmlSigNgvDKd_C EGRVlvLP_SmlSigNgvIKi_C EGRVlvLP_SmlSigNgvPKp_C EGRVlvLP_SmlSigPsvDKd_C EGRVlvLP_SmlSigPsvIKi_C EGRVlvLP_SmlSigPsvPKp_C EGRVlvLP_swtBelCtl_C EGRVlvLP_swtSelDT1In_C EGRVlvLP_tiCrntEffFlt_C EGRVlvLP_tiGovDT1_C EGRVlvLP_tiParDT1_C EGRVlv_DKdNgv_C EGRVlv_DKdPsv_C EGRVlv_drActNgv_C EGRVlv_iEff_CUR EGRVlv_IKiNgv_C EGRVlv_IKiPsv_C EGRVlv_PKpNgv_C EGRVlv_PKpPsv_C EGRVlv_rActNgv_C EGRVlv_rBelAir_MAP EGRVlv_rBelCtl_MAP EGRVlv_rCtlVal_C EGRVlv_rDesEGR_CUR EGRVlv_rGovDvtThres_C EGRVlv_rGovMax_CUR EGRVlv_rGovMin_CUR EGRVlv_rGvnrPreMax_C EGRVlv_rGvnrPreMin_C EGRVlv_rOutDMax_C EGRVlv_rOutIMax_C EGRVlv_rPIDWinNgv_C EGRVlv_rPIDWinPsv_C EGRVlv_rRmp_C EGRVlv_SlwClsDKd_C EGRVlv_SlwClsIKi_C EGRVlv_SlwClsPKp_C EGRVlv_SmlSigNgvDKd_C EGRVlv_SmlSigNgvIKi_C EGRVlv_SmlSigNgvPKp_C EGRVlv_SmlSigPsvDKd_C EGRVlv_SmlSigPsvIKi_C EGRVlv_SmlSigPsvPKp_C EGRVlv_swtBelCtl_C EGRVlv_swtSelDT1In_C EGRVlv_tiCrntEffFlt_C EGRVlv_tiGovDT1_C EGRVlv_tiParDT1_C /end DEF_CHARACTERISTIC
 /begin IN_MEASUREMENT AirCtlLP_mGovDvt AirCtl_mGovDvt BattU_facCor EGRVlvLP_rAct EGRVlvLP_rActNoErrHdl EGRVlvLP_rPs EGRVlvLP_rPullDwnEGR EGRVlvLP_rRlsEGR EGRVlvLP_stAdap EGRVlvLP_stMon EGRVlv_rAct EGRVlv_rActNoErrHdl EGRVlv_rPs EGRVlv_rPullDwnEGR EGRVlv_rRlsEGR EGRVlv_stAdap EGRVlv_stMon /end IN_MEASUREMENT
 /begin OUT_MEASUREMENT EGRVlvLP_r EGRVlvLP_rEGR EGRVlvLP_rGovDvt EGRVlvLP_rGovDvtRel EGRVlvLP_rGovEGR EGRVlvLP_stPosGovOn EGRVlv_r EGRVlv_rEGR EGRVlv_rGovDvt EGRVlv_rGovDvtRel EGRVlv_rGovEGR EGRVlv_stPosGovOn /end OUT_MEASUREMENT
 /begin LOC_MEASUREMENT EGRVlvLP_drAct_mp EGRVlvLP_iEffFlt_mp EGRVlvLP_iEff_mp EGRVlvLP_rAbsEGR_mp EGRVlvLP_rBelCtl_mp EGRVlvLP_rGovMax_mp EGRVlvLP_rGovMin_mp EGRVlvLP_rLim_mp EGRVlvLP_rOutD_mp EGRVlvLP_rOutI_mp EGRVlvLP_rOutP_mp EGRVlvLP_rPreCtlVal_mp EGRVlvLP_stSlwCls_mp EGRVlv_drAct_mp EGRVlv_iEffFlt_mp EGRVlv_iEff_mp EGRVlv_rAbsEGR_mp EGRVlv_rBelCtl_mp EGRVlv_rGovMax_mp EGRVlv_rGovMin_mp EGRVlv_rLim_mp EGRVlv_rOutD_mp EGRVlv_rOutI_mp EGRVlv_rOutP_mp EGRVlv_rPreCtlVal_mp EGRVlv_stSlwCls_mp /end LOC_MEASUREMENT
/end FUNCTION
/begin FUNCTION egrvlv_vdsens ""
 /begin DEF_CHARACTERISTIC EGRVlvLP_ctStrtOfsLrn_C EGRVlvLP_facAdapClsStrt_C EGRVlvLP_facAdapPosCls_C EGRVlvLP_IKiOfsLrnDwn_C EGRVlvLP_IKiOfsLrnUp_C EGRVlvLP_numTempSel_C EGRVlvLP_rActDsblDfl_C EGRVlvLP_rActMax_C EGRVlvLP_rActMin_C EGRVlvLP_rActOfs_C EGRVlvLP_rAdapAgOpnMax_C EGRVlvLP_rAdapAgOpnMin_C EGRVlvLP_rAdapDiffPlausLgT_C EGRVlvLP_rAdapDiffPlausShT_C EGRVlvLP_rAdapIniOpn0_C EGRVlvLP_rAdapOpnBnd_C EGRVlvLP_rCmpNewCtlUn_C EGRVlvLP_RmpSlp.Pos_C EGRVlvLP_RmpSlp.Neg_C EGRVlvLP_rOfsLrnVlvMax_C EGRVlvLP_rOfsLrnVlvMin_C EGRVlvLP_rOfsMax_C EGRVlvLP_rOfsMin_C EGRVlvLP_rSensVlvThres_C EGRVlvLP_stNewVlvTrg_C EGRVlvLP_stOfsLrnTrg_C EGRVlvLP_swtActOfs_C EGRVlvLP_swtOfsLrnActv_C EGRVlvLP_tEngMax_C EGRVlvLP_tEngMin_C EGRVlvLP_tiAdapJamVlv_C EGRVlvLP_tiAdapPullDwn_C EGRVlvLP_tiClsJamVlv_C EGRVlvLP_tiPT1rAct_C EGRVlvLP_TransStg.Dfl_C EGRVlvLP_TransStg.stSensId_C EGRVlvLP_uBattMax_C EGRVlvLP_uBattMin_C EGRVlv_ctStrtOfsLrn_C EGRVlv_facAdapClsStrt_C EGRVlv_facAdapPosCls_C EGRVlv_IKiOfsLrnDwn_C EGRVlv_IKiOfsLrnUp_C EGRVlv_numTempSel_C EGRVlv_rActMax_C EGRVlv_rActMin_C EGRVlv_rActOfs_C EGRVlv_rAdapAgOpnMax_C EGRVlv_rAdapAgOpnMin_C EGRVlv_rAdapDiffPlausLgT_C EGRVlv_rAdapDiffPlausShT_C EGRVlv_rAdapIniOpn0_C EGRVlv_rAdapOpnBnd_C EGRVlv_rCmpNewCtlUn_C EGRVlv_RmpSlp.Pos_C EGRVlv_RmpSlp.Neg_C EGRVlv_rOfsLrnVlvMax_C EGRVlv_rOfsLrnVlvMin_C EGRVlv_rOfsMax_C EGRVlv_rOfsMin_C EGRVlv_rSensVlvThres_C EGRVlv_stNewVlvTrg_C EGRVlv_stOfsLrnTrg_C EGRVlv_swtActOfs_C EGRVlv_swtOfsLrnActv_C EGRVlv_tEngMax_C EGRVlv_tEngMin_C EGRVlv_tiAdapJamVlv_C EGRVlv_tiAdapPullDwn_C EGRVlv_tiClsJamVlv_C EGRVlv_tiPT1rAct_C EGRVlv_TransStg.Dfl_C EGRVlv_TransStg.stSensId_C EGRVlv_uBattMax_C EGRVlv_uBattMin_C /end DEF_CHARACTERISTIC
 /begin IN_MEASUREMENT BattU_u CoEng_st CoEng_stOld EGRVlvLP_rEGR EGRVlvLP_rSens EGRVlvLP_stMon EGRVlv_rEGR EGRVlv_rSens EGRVlv_stMon EngDa_tFld SyC_stSub T15_st /end IN_MEASUREMENT
 /begin OUT_MEASUREMENT EGRVlvLP_rAct EGRVlvLP_rActNoErrHdl EGRVlvLP_rActUnLimFlt EGRVlvLP_rOfsLrnFrst EGRVlvLP_rOfsLrnLst EGRVlvLP_rOfsLrnNew EGRVlvLP_rOfsLrnVlv EGRVlvLP_stAdap EGRVlvLP_stOfsLrn EGRVlvLP_stOfsLrnStrt EGRVlv_rAct EGRVlv_rActNoErrHdl EGRVlv_rActUnLimFlt EGRVlv_rOfsLrnFrst EGRVlv_rOfsLrnLst EGRVlv_rOfsLrnNew EGRVlv_rOfsLrnVlv EGRVlv_stAdap EGRVlv_stOfsLrn EGRVlv_stOfsLrnStrt /end OUT_MEASUREMENT
 /begin LOC_MEASUREMENT EGRVlvLP_ctAdapCls_mp EGRVlvLP_ctStrtOfsLrn_mp EGRVlvLP_rActUnCorOld_mp EGRVlvLP_rActUnCor_mp EGRVlvLP_rAdapLrn_mp EGRVlvLP_rAdapPos_mp EGRVlvLP_rLinOfs_mp EGRVlvLP_rOfs_mp EGRVlvLP_rPlausLgT_mp EGRVlvLP_rPlausShT_mp EGRVlvLP_rPosLrnMin_mp EGRVlvLP_rPosRef_mp EGRVlvLP_stAdapActv_mp EGRVlvLP_stFrstOpn_mp EGRVlvLP_stNewVlvTrg_mp EGRVlvLP_stOfsLrnRls_mp EGRVlvLP_stOfsLrnStMch_mp EGRVlvLP_stStrStMch_mp EGRVlvLP_stStr_mp EGRVlvLP_stTPullDwn_mp EGRVlvLP_stTrg_mp EGRVlvLP_stVlvClsd_mp EGRVlvLP_stVlvDiff_mp EGRVlvLP_stVlvJamBuf_mp EGRVlvLP_stVlvOpnd_mp EGRVlvLP_stVlvStkCls_mp EGRVlvLP_stVlvStk_mp EGRVlv_ctAdapCls_mp EGRVlv_ctStrtOfsLrn_mp EGRVlv_rActUnCorOld_mp EGRVlv_rActUnCor_mp EGRVlv_rAdapLrn_mp EGRVlv_rAdapPos_mp EGRVlv_rLinOfs_mp EGRVlv_rOfs_mp EGRVlv_rPlausLgT_mp EGRVlv_rPlausShT_mp EGRVlv_rPosLrnMin_mp EGRVlv_rPosRef_mp EGRVlv_stAdapActv_mp EGRVlv_stFrstOpn_mp EGRVlv_stNewVlvTrg_mp EGRVlv_stOfsLrnRls_mp EGRVlv_stOfsLrnStMch_mp EGRVlv_stStrStMch_mp EGRVlv_stStr_mp EGRVlv_stTPullDwn_mp EGRVlv_stTrg_mp EGRVlv_stVlvClsd_mp EGRVlv_stVlvDiff_mp EGRVlv_stVlvJamBuf_mp EGRVlv_stVlvOpnd_mp EGRVlv_stVlvStkCls_mp EGRVlv_stVlvStk_mp /end LOC_MEASUREMENT
/end FUNCTION
/begin FUNCTION elmotentl ""
 /begin DEF_CHARACTERISTIC KF_PRIO_4 KF_PRIO_HOLD KF_PRIO_NO KF_PRIO_UP KF_RF_AFU KL_VLPRIO41 KL_VLPRIO42 KL_VLPRIO43 K_MD_ELMOTENTL K_NKWMAX_HS K_NKWMIN_HY K_PR_ELMOTENTL K_PWG_AFU K_TD_DELAY1 K_TD_DELAY2 K_TD_DELAY3 K_TD_DOWN K_TD_GEAR K_TD_HOLD K_TD_HOLDNO K_TD_UP K_TODPRIO0 K_VMAX_HY K_VMIN_HY K_WAFS K_WDAFS S_ELMOTENTL /end DEF_CHARACTERISTIC
 /begin IN_MEASUREMENT Pu Tmot /end IN_MEASUREMENT
 /begin OUT_MEASUREMENT Md_entlsoll3 Pr_md_entlsoll3 Stat_entl St_elmot1 St_elmot2 St_elmotentl St_elmottime St_elnotafu St_entlast_loc Timecount_0 Timecount_1 Timecount_2 Timecount_3 Timecount_4 Timecount_5 Timecount_6 /end OUT_MEASUREMENT
/end FUNCTION
/begin FUNCTION EMCtl_ValCalc ""
 /begin DEF_CHARACTERISTIC EMCtl_nEngHysDelta_C EMCtl_nEngHysHi_CUR EMCtl_nEngLim_C EMCtl_nLimHardStrt_C EMCtl_rOutHard_C EMCtl_rOutSoft_C EMCtl_tiHardAftrGear_C EMCtl_tiSoftAftrStrt_C EMCtl_vXHysHi_C EMCtl_vXHysLo_C /end DEF_CHARACTERISTIC
 /begin IN_MEASUREMENT CoEng_st CoEng_stMSAStp EMDmp_r0 EngDa_tEng Epm_nEng GlbDa_vX Tra_numGear /end IN_MEASUREMENT
 /begin LOC_MEASUREMENT EMCtl_nEngHysHi_mp EMCtl_nEngHysLo_mp EMCtl_rEMDmp_mp EMCtl_stValCalc_mp /end LOC_MEASUREMENT
/end FUNCTION
/begin FUNCTION EMDmp_DD ""
 /begin DEF_CHARACTERISTIC EMDmp_Pwm.tiPer_C EMDmp_Pwm.stLvl_C EMDmp_Pwm.rMaxDty_C EMDmp_Pwm.rPerUn_C EMDmp_Pwm.tiPh_C EMDmp_PwmOut.rMin_C EMDmp_PwmOut.rMax_C EMDmp_PwmOut.tiBtwTstSCB_C EMDmp_PwmOut.tiBtwTstOT_C EMDmp_PwmOut.numTstMax_C EMDmp_PwmOut.swtBattCor_C EMDmp_PwmOut.swtPsInv_C EMDmp_rCnv0_CUR EMDmp_rCnv1_CUR EMDmp_rPsDisbl_CA EMDmp_stPsDiaDisbl_CA EMDmp_stPwrStgDis_CA /end DEF_CHARACTERISTIC
 /begin IN_MEASUREMENT BattU_facCor DevLib_stPwrStgEnaCond /end IN_MEASUREMENT
 /begin OUT_MEASUREMENT EMDmp_r0 EMDmp_r1 EMDmp_rPs /end OUT_MEASUREMENT
/end FUNCTION
/begin FUNCTION EngDa_TEng ""
 /begin DEF_CHARACTERISTIC EngDa_tEng_C EngDa_tiOvrTemp2_C EngDa_tiOvrTemp_C EngDa_tOvrTempHi2_C EngDa_tOvrTempHi_C EngDa_tOvrTempLo2_C EngDa_tOvrTempLo_C /end DEF_CHARACTERISTIC
 /begin IN_MEASUREMENT CEngDsT_t CoEng_st CoEng_stOld Epm_nEng Layer_tChamWll Oil_tSwmp /end IN_MEASUREMENT
 /begin OUT_MEASUREMENT EngDa_stOvrTemp EngDa_stOvrTemp2 EngDa_tEng EngDa_tFld EngDa_tStrt /end OUT_MEASUREMENT
 /begin LOC_MEASUREMENT EngDa_stOvrTemp_mp /end LOC_MEASUREMENT
/end FUNCTION
/begin FUNCTION EngDa_TiEngOff "" /begin DEF_CHARACTERISTIC EngDa_tiEngOffInit_C EngDa_tiEngOffRst_C /end DEF_CHARACTERISTIC
 /begin IN_MEASUREMENT CoEng_st CoEng_stOld CoEng_tiStart SyC_stSub SyC_stVldTiEcuOff SyC_tiEcuOff SyC_tiPostDrv SyC_tiPreDrv /end IN_MEASUREMENT
 /begin OUT_MEASUREMENT EngDa_tiEngOff /end OUT_MEASUREMENT
 /begin LOC_MEASUREMENT EngDa_stRstEngOff_mp EngDa_tiEngOffBuf_mp /end LOC_MEASUREMENT
/end FUNCTION
/begin FUNCTION EngDa_TiEngOn "" /begin DEF_CHARACTERISTIC EngDa_lEepUpd_C /end DEF_CHARACTERISTIC
 /begin IN_MEASUREMENT CoEng_st Epm_nEng GlbDa_lTotDst Reset_Env.adLoc Reset_Env.xUserValue Reset_Env.xId Reset_Env.xGrp Reset_Env.ctRst /end IN_MEASUREMENT
 /begin OUT_MEASUREMENT EngDa_tiEngOn /end OUT_MEASUREMENT
/end FUNCTION
/begin FUNCTION EngDem_TrqLimCoord ""
 /begin DEF_CHARACTERISTIC EngDem_dnOvrFulMax_C EngDem_dnOvrFulMin_C EngDem_dtrqEngPrtRgnMon.Pos_C EngDem_dtrqEngPrtRgnMon.Neg_C EngDem_dtrqPFltOvld.Pos_C EngDem_dtrqPFltOvld.Neg_C EngDem_dtrqPFltOvldDwn_C EngDem_dtrqPFltOvldUp_C EngDem_EpmNEngDT1.T1_C EngDem_EpmNEngDT1.Kd_C EngDem_nOvrFulMax_C EngDem_nOvrFulMin_C EngDem_numIndex_C EngDem_RmpLimErr.Pos_C EngDem_RmpLimErr.Neg_C EngDem_RmpLimErr1.Pos_C EngDem_RmpLimErr1.Neg_C EngDem_RmpLimErr2.Pos_C EngDem_RmpLimErr2.Neg_C EngDem_RmpLimErr3.Pos_C EngDem_RmpLimErr3.Neg_C EngDem_RmpLimErr4.Pos_C EngDem_RmpLimErr4.Neg_C EngDem_RmpOvrFul.Pos_C EngDem_RmpOvrFul.Neg_C EngDem_rOvrFulMax_C EngDem_rOvrFulMin_C EngDem_stPFltLimMsk_C EngDem_swtPPreCat_C EngDem_swtTSensOvld_C EngDem_tiPFltdVolPT1_C EngDem_tiPFltOvldOk_C EngDem_tiPFltResFlowPT1_C EngDem_tiRepOvrFul_C EngDem_tPFltOvldLim_C EngDem_trqLimErr1_CUR EngDem_trqLimErr2_CUR EngDem_trqLimErr3_CUR EngDem_trqLimErr4_CUR EngDem_trqLimErrLeadMax_C EngDem_trqLimErr_CUR EngDem_trqLimPDiff1_CUR EngDem_trqLimPDiffNOffs_CUR EngDem_trqLimPDiff_MAP EngDem_trqLimPFltOvld_MAP EngDem_trqOvrFulMax_C EngDem_trqOvrFulMin_C EngDem_vOvrFulMax_C EngDem_vOvrFulMin_C /end DEF_CHARACTERISTIC
 /begin IN_MEASUREMENT ASMod_dvolPFltEG ASMod_pEGFld CoEng_st Epm_nEng Exh_pAdapPPFltDiff Exh_tAdapTOxiCatUs Exh_tAdapTPFltUs PFltLd_resFlw /end IN_MEASUREMENT
 /begin OUT_MEASUREMENT EngDem_facAdj EngDem_stOvrFul EngDem_stTrqLimErr EngDem_stTrqLimErrActv EngDem_trqInrLim EngDem_trqInrLimLead EngDem_trqLimErr EngDem_trqLimErr1 EngDem_trqLimErr2 EngDem_trqLimErr3 EngDem_trqLimErr4 EngDem_trqLimPDiff EngDem_trqLimSwt EngDem_trqOvrFul /end OUT_MEASUREMENT
 /begin LOC_MEASUREMENT EngDem_dVolFlt_mp EngDem_pDiffPFltPrdc2_mp EngDem_pDiffPFltPrdc_mp EngDem_resFlowFlt_mp EngDem_stTrqLimErr1_mp EngDem_stTrqLimErr2_mp EngDem_stTrqLimErr3_mp EngDem_stTrqLimErr4_mp EngDem_stTrqLimPFltErr_mp EngDem_stTrqLimPFltOvldErr_mp EngDem_tOvldMax_mp EngDem_tPFltOvldMax_mp EngDem_trqInrLimLead1_mp EngDem_trqInrLimLead2_mp EngDem_trqLimErr1Lead_mp EngDem_trqLimErr2Lead_mp EngDem_trqLimErr3Lead_mp EngDem_trqLimErr4Lead_mp EngDem_trqLimErrLeadMin1_mp EngDem_trqLimErrLeadMin2_mp EngDem_trqLimErrLeadMin3_mp EngDem_trqLimErrLead_mp EngDem_trqLimMin1_mp EngDem_trqLimMinEEPVal_mp EngDem_trqLimOvld_mp EngDem_trqLimPDiffNOffsAdd_mp EngDem_trqLimPDiffNOffs_mp EngDem_trqLimPFlt1_mp EngDem_trqLimPFltErr_mp EngDem_trqLimPFltOvld_mp EngDem_trqLimRslt0_mp EngDem_trqLimRslt1_mp EngDem_trqLimRslt2_mp EngDem_trqLimRslt_mp EngDem_trqLimSwt1_mp EngDem_trqLimSwt2_mp EngDem_trqLimSwt3_mp EngDem_trqLimSwt4_mp EngDem_trqLimSwt5_mp EngDem_trqLimSwtMinAdj_mp EngDem_trqLimSwtMin_mp /end LOC_MEASUREMENT
/end FUNCTION
/begin FUNCTION EngECU ""
 /begin SUB_FUNCTION EngECU_Can EngECU_co EngECU_a EngECU_fa EngECU_fx EngECU_flex EngECU_CCMsg EngECU_CBS /end SUB_FUNCTION
/end FUNCTION
/begin FUNCTION EngECU_a ""
 /begin DEF_CHARACTERISTIC Com_swtActvFlPmpEng_A_C Com_swtAngAcpd_A_C Com_swtATemp_A_C Com_swtDiaOBDEng_A_C Com_swtDriveTrainData1_A_C Com_swtDriveTrainData2_A_C Com_swtRelTime_A_C Com_swtTrqCrsh1_A_C Com_swtTrqCrsh2_A_C Com_swtTrqCrsh3_A_C Com_swtVehicleSpeed_A_C /end DEF_CHARACTERISTIC
 /begin OUT_MEASUREMENT Com_dAngAcpdCHK_A Com_dAngAcpdCTR_A Com_dDriveTrainData2CHK_A Com_dDriveTrainData2CTR_A Com_dKlemmenCHK_A Com_dKlemmenCTR_A Com_dTorque1CHK_A Com_dTorque1CTR_A Com_dTorque2CHK_A Com_dTorque2CTR_A Com_dTorque3CHK_A Com_dTorque3CTR_A Com_vVehCHK_A Com_vVehCTR_A /end OUT_MEASUREMENT
/end FUNCTION
/begin FUNCTION EngECU_Can ""
 /begin DEF_CHARACTERISTIC Com_dTestMsg_C Com_dTestSig_C Com_swtBatteriespg_C Com_swtCrCtlSpeed_C Com_swtEngineRpm_C Com_swtEngine_C Com_swtHeatFlowEngine_C Com_swtStatusMSA_C Com_swtTest_C Com_swtTorque1_C Com_swtTorque2_C Com_swtTorque3_C Com_swtVerbrauchersteuerung_C /end DEF_CHARACTERISTIC
 /begin OUT_MEASUREMENT Com_dTestMsg Com_dTestSig /end OUT_MEASUREMENT
/end FUNCTION
/begin FUNCTION EngECU_CBS "" /begin DEF_CHARACTERISTIC Com_swtCBSOil_C Com_swtCBSPFlt_C /end DEF_CHARACTERISTIC
 /begin IN_MEASUREMENT Layer_ctBOS Layer_dIntrvTimeBOS2 Layer_dMonthBOS2 Layer_dRmnMlgBOS Layer_dYearBOS2 Layer_lIntrvWayBOS2 Layer_rAvlBOS Layer_stUnBOS PCBS_dAvaiOut PCBS_lDistanceOut PCBS_lProgWay PCBS_stCntValOut PCBS_stProgMon PCBS_stProgTime PCBS_stProgYr /end IN_MEASUREMENT
 /begin OUT_MEASUREMENT Com_ctBOS Com_dIntrvTimeBOS2 Com_dMonthBOS2 Com_dRmnMlgBOS Com_dYearBOS2 Com_idBOS Com_idBOS2 Com_lIntrvWayBOS2 Com_rAvlBOS Com_stUnBOS /end OUT_MEASUREMENT
/end FUNCTION
/begin FUNCTION EngECU_CCMsg ""
 /begin DEF_CHARACTERISTIC Com_CCMsg_0_C Com_CCMsg_0_ID_C Com_CCMsg_10_C Com_CCMsg_10_ID_C Com_CCMsg_11_C Com_CCMsg_11_ID_C Com_CCMsg_12_C Com_CCMsg_12_ID_C Com_CCMsg_13_C Com_CCMsg_13_ID_C Com_CCMsg_14_C Com_CCMsg_14_ID_C Com_CCMsg_15_C Com_CCMsg_15_ID_C Com_CCMsg_16_C Com_CCMsg_16_ID_C Com_CCMsg_17_C Com_CCMsg_17_ID_C Com_CCMsg_18_C Com_CCMsg_18_ID_C Com_CCMsg_19_C Com_CCMsg_19_ID_C Com_CCMsg_1_C Com_CCMsg_1_ID_C Com_CCMsg_20_C Com_CCMsg_20_ID_C Com_CCMsg_21_C Com_CCMsg_21_ID_C Com_CCMsg_22_C Com_CCMsg_22_ID_C Com_CCMsg_2_C Com_CCMsg_2_ID_C Com_CCMsg_3_C Com_CCMsg_3_ID_C Com_CCMsg_4_C Com_CCMsg_4_ID_C Com_CCMsg_5_C Com_CCMsg_5_ID_C Com_CCMsg_6_C Com_CCMsg_6_ID_C Com_CCMsg_7_C Com_CCMsg_7_ID_C Com_CCMsg_8_C Com_CCMsg_8_ID_C Com_CCMsg_9_C Com_CCMsg_9_ID_C /end DEF_CHARACTERISTIC
/end FUNCTION
/begin COMPU_METHOD AirMassPerCyl "" RAT_FUNC "%5.1" "mg/Hub" COEFFS 0 10 0 0 0 1 /end COMPU_METHOD
/begin COMPU_METHOD AirMassPerTime "" RAT_FUNC "%5.1" "Kg/h" COEFFS 0 10 0 0 0 1 /end COMPU_METHOD
/begin COMPU_METHOD AirTempFldSel "" TAB_VERB "%6.3" "" COMPU_TAB_REF AirTempFldSel /end COMPU_METHOD
/begin COMPU_VTAB AirTempFldSel "" TAB_VERB 4 0 "Air_tCACDs" 1 "Air_tAFS" 2 "EnvT_t" 3 "Air_tAFSCorr" /end COMPU_VTAB
/begin COMPU_METHOD AshMassPerTime "" RAT_FUNC "%6.4" "mg/s" COEFFS 0 100 0 0 0 1 /end COMPU_METHOD
/begin COMPU_METHOD CubMtrPerHr "" RAT_FUNC "%6.3" "m^3/h" COEFFS 0 10 0 0 0 1 /end COMPU_METHOD
/begin COMPU_METHOD Curr_A "" RAT_FUNC "%6.4" "A" COEFFS 0 100 0 0 0 1 /end COMPU_METHOD
/begin COMPU_METHOD Def_dez_ub_q1 "" RAT_FUNC "%3.1" "-" COEFFS 0 1 0 0 0 1 /end COMPU_METHOD
/begin COMPU_METHOD Def_m_sw_q0p1 "" RAT_FUNC "%7.4" "Nm" COEFFS 0 10 0 0 0 1 /end COMPU_METHOD
/begin COMPU_METHOD Def_n_sw_q1p0 "" RAT_FUNC "%5.2" "Upm" COEFFS 0 1 0 0 0 1 /end COMPU_METHOD
/begin COMPU_METHOD Def_p_uw_q0p039 "" RAT_FUNC "%7.4" "hPa" COEFFS 0 25.6 0 0 0 1 /end COMPU_METHOD
/begin COMPU_METHOD Def_st_ub_q1 "" RAT_FUNC "%3.1" "-" COEFFS 0 1 0 0 0 1 /end COMPU_METHOD
/begin COMPU_METHOD Def_td_uw_q0p1 "" RAT_FUNC "%6.3" "s" COEFFS 0 10 0 0 0 1 /end COMPU_METHOD
/begin COMPU_METHOD Def_td_uw_q1 "" RAT_FUNC "%5.2" "s" COEFFS 0 1 0 0 0 1 /end COMPU_METHOD
/begin COMPU_METHOD Def_t_sw_q0p01 "" RAT_FUNC "%7.5" "°C" COEFFS 0 100 0 0 0 1 /end COMPU_METHOD
/begin COMPU_METHOD Def_v_uw_q1p0 "" RAT_FUNC "%5.2" "km/h" COEFFS 0 1 0 0 0 1 /end COMPU_METHOD
/begin COMPU_METHOD Def_wdk_sw_q0p0244 "" RAT_FUNC "%7.4" "%" COEFFS 0 40.96 0 0 0 1 /end COMPU_METHOD
/begin COMPU_METHOD Def_w_sw_q0p1 "" RAT_FUNC "%7.4" "øKW" COEFFS 0 10 0 0 0 1 /end COMPU_METHOD
/begin COMPU_METHOD DFC_OneToOne "" RAT_FUNC "%6.0" "-" COEFFS 0 1 0 0 0 1 /end COMPU_METHOD
/begin COMPU_METHOD dn_dZ20 "" RAT_FUNC "%6.2" "rpm/s" COEFFS 0 0.2 0 0 0 1 /end COMPU_METHOD
/begin COMPU_METHOD DStgy_Compu_Switch_1 "" TAB_VERB "%6.3" "" COMPU_TAB_REF DStgy_Compu_Switch_1 /end COMPU_METHOD
/begin COMPU_VTAB DStgy_Compu_Switch_1 "" TAB_VERB 2 0 "RUNNING" 1 "RESET" /end COMPU_VTAB
/begin COMPU_METHOD DStgy_Compu_Switch_2 "" TAB_VERB "%6.3" "" COMPU_TAB_REF DStgy_Compu_Switch_2 /end COMPU_METHOD
/begin COMPU_VTAB DStgy_Compu_Switch_2 "" TAB_VERB 2 0 "[mg/s]" 1 "[g]" /end COMPU_VTAB
/begin COMPU_METHOD DTR_Verb "" TAB_VERB "%2.1" "-" COMPU_TAB_REF DTR_Verb /end COMPU_METHOD
/begin COMPU_VTAB DTR_Verb "" TAB_VERB 13 0 "DTR_AirCtlGovDvt" 1 "DTR_AirCtlGovLPDvt" 2 "DTR_CEngDsTDynTstDTMin" 3 "DTR_CEngDsTDynTstTMin" 4 "DTR_CEngDsTDynTstTiMax" 5 "DTR_Dummy" 6 "DTR_LSUDynChkState2" 7 "DTR_LSUDynChkState3" 8 "DTR_LSUHtCoupErr" 9 "DTR_LSUO2Plaus" 10 "DTR_PFltCharPDiffMin" 11 "DTR_PFltDstrMin" 255 "DTR_Unused" DEFAULT_VALUE "FALSE" /end COMPU_VTAB
/begin COMPU_METHOD DtyCyc "" RAT_FUNC "%5.2" "%" COEFFS 0 100 0 0 0 1 /end COMPU_METHOD
/begin COMPU_METHOD Eeebd_EeeStates_Verb "Verbale Umrechnung der Eeebd_EeeStates" TAB_VERB "%6.3" "" COMPU_TAB_REF Eeebd_EeeStates_Verb /end COMPU_METHOD
/begin COMPU_VTAB Eeebd_EeeStates_Verb "Verbale Umrechnung der Eeebd_EeeStates" TAB_VERB 4 0 "EEEBD_EEE_NORMALRUN" 1 "EEEBD_EEE_FIRSTINIT" 2 "EEEBD_EEE_SECTORCHANGE" 3 "EEEBD_EEE_MIGRATION" /end COMPU_VTAB
/begin COMPU_METHOD EngN "" RAT_FUNC "%5.1" "rpm" COEFFS 0 2 0 0 0 1 /end COMPU_METHOD
/begin COMPU_METHOD EngTempFldSel "" TAB_VERB "%6.3" "" COMPU_TAB_REF EngTempFldSel /end COMPU_METHOD
/begin COMPU_VTAB EngTempFldSel "" TAB_VERB 4 0 "Coolant_Temperature" 1 "Oil_Temperature" 2 "EngDa_tEng" 3 "Chamberwall_Temperature" /end COMPU_VTAB
/begin COMPU_METHOD Fact "" RAT_FUNC "%6.5" "-" COEFFS 0 8192 0 0 0 1 /end COMPU_METHOD
/begin COMPU_METHOD Identity "" RAT_FUNC "%3.1" "-" COEFFS 0 1 0 0 0 1 /end COMPU_METHOD
/begin COMPU_METHOD InjMass "" RAT_FUNC "%5.2" "mg/hub" COEFFS 0 100 0 0 0 1 /end COMPU_METHOD
/begin COMPU_METHOD InjMassCyc "" RAT_FUNC "%5.2" "mg/cyc" COEFFS 0 100 0 0 0 1 /end COMPU_METHOD
/begin COMPU_METHOD Kd "" RAT_FUNC "%7.6" "1/1" COEFFS 0 65536 0 0 0 1 /end COMPU_METHOD
/begin COMPU_METHOD Kd_rpm2dndt "" RAT_FUNC "%7.6" "rpm/s/rpm" COEFFS 0 65536 0 0 0 1 /end COMPU_METHOD
/begin COMPU_METHOD Ki "" RAT_FUNC "%6.5" "1/s" COEFFS 0 2147.483648 0 0 0 1 /end COMPU_METHOD
/begin COMPU_METHOD Ki_EGRVlv "" RAT_FUNC "%6.5" "1/s" COEFFS 0 5368.70912 0 0 0 1 /end COMPU_METHOD
/begin COMPU_METHOD Kp "" RAT_FUNC "%7.6" "1/1" COEFFS 0 32768 0 0 0 1 /end COMPU_METHOD
/begin COMPU_METHOD Length "" RAT_FUNC "%6.2" "m" COEFFS 0 1 0 0 0 1 /end COMPU_METHOD
/begin COMPU_METHOD OneToOne "" RAT_FUNC "%6.0" "-" COEFFS 0 1 0 0 0 1 /end COMPU_METHOD
/begin COMPU_METHOD Period "" RAT_FUNC "%6.3" "ms" COEFFS 0 10 0 0 0 1 /end COMPU_METHOD
/begin COMPU_METHOD Prc "" RAT_FUNC "%6.4" "%" COEFFS 0 81.92 0 0 0 1 /end COMPU_METHOD
/begin COMPU_METHOD Pres_hPa "" RAT_FUNC "%5.1" "hPa" COEFFS 0 1 0 0 0 1 /end COMPU_METHOD
/begin COMPU_METHOD Res_hPaHrPerCM "" RAT_FUNC "%7.6" "hPa/(m^3/h)" COEFFS 0 10000 0 0 0 1 /end COMPU_METHOD
/begin COMPU_METHOD RmpPrc "" RAT_FUNC "%6.5" "%/s" COEFFS 0 5368.70912 0 0 0 1 /end COMPU_METHOD
/begin COMPU_METHOD RmpTrq "" RAT_FUNC "%6.4" "Nm/s" COEFFS 0 655.36 0 0 0 1 /end COMPU_METHOD
/begin COMPU_METHOD SCRAd_Compu_Switch_3 "" TAB_VERB "%6.3" "" COMPU_TAB_REF SCRAd_Compu_Switch_3 /end COMPU_METHOD
/begin COMPU_VTAB SCRAd_Compu_Switch_3 "" TAB_VERB 2 0 "INAKTIV" 1 "AKTIV" /end COMPU_VTAB
/begin COMPU_METHOD SCR_Dm005 "" RAT_FUNC "%6.4" "mg/s" COEFFS 0 20 0 0 0 1 /end COMPU_METHOD
/begin COMPU_METHOD SCR_Dm01 "" RAT_FUNC "%6.3" "mg/s" COEFFS 0 10 0 0 0 1 /end COMPU_METHOD
/begin COMPU_METHOD SCR_Fact100 "" RAT_FUNC "%6.4" "" COEFFS 0 100 0 0 0 1 /end COMPU_METHOD
/begin COMPU_METHOD SCR_Fact1000 "" RAT_FUNC "%6.5" "" COEFFS 0 1000 0 0 0 1 /end COMPU_METHOD
/begin COMPU_METHOD SCR_Mass1000 "" RAT_FUNC "%6.5" "g" COEFFS 0 1000 0 0 0 1 /end COMPU_METHOD
/begin COMPU_METHOD SlopeRes10000 "" RAT_FUNC "%7.6" "-" COEFFS 0 10000 0 0 0 1 /end COMPU_METHOD
/begin COMPU_METHOD Temp_Cels "" RAT_FUNC "%5.1" "deg C" COEFFS 0 10 2731.4 0 0 1 /end COMPU_METHOD
/begin COMPU_METHOD TimeDeb "" RAT_FUNC "%5.0" "ms" COEFFS 0 0.1 0 0 0 1 /end COMPU_METHOD
/begin COMPU_METHOD TimeDelay_ms "" RAT_FUNC "%12.1" "ms" COEFFS 0 0 1 0 2.3283064365387e-007 0 /end COMPU_METHOD
/begin COMPU_METHOD TimeDelay_s "" RAT_FUNC "%12.4" "s" COEFFS 0 0 1 0 0.00023283064365387 0 /end COMPU_METHOD
/begin COMPU_METHOD TimeEngOn "" RAT_FUNC "%6.2" "s" COEFFS 0 1 0 0 0 1 /end COMPU_METHOD
/begin COMPU_METHOD Time_ms "" RAT_FUNC "%5.0" "ms" COEFFS 0 0.1 0 0 0 1 /end COMPU_METHOD
/begin COMPU_METHOD Time_s "" RAT_FUNC "%5.2" "s" COEFFS 0 100 0 0 0 1 /end COMPU_METHOD
/begin COMPU_METHOD Time_Sec_One2One "" RAT_FUNC "%6.2" "s" COEFFS 0 1 0 0 0 1 /end COMPU_METHOD
/begin COMPU_METHOD Trq "" RAT_FUNC "%5.1" "Nm" COEFFS 0 10 0 0 0 1 /end COMPU_METHOD
/begin COMPU_METHOD UC_Volt "" RAT_FUNC "%6.3" "V" COEFFS 0 10 0 0 0 1 /end COMPU_METHOD
/begin COMPU_METHOD Vel "" RAT_FUNC "%5.2" "km/h" COEFFS 0 100 0 0 0 1 /end COMPU_METHOD
/begin COMPU_METHOD VlvVel "" RAT_FUNC "%6.3" "%/s" COEFFS 0 8.192 0 0 0 1 /end COMPU_METHOD
/begin COMPU_METHOD Volt "" RAT_FUNC "%6.1" "mV" COEFFS 0 5 0 0 0 1 /end COMPU_METHOD
/begin COMPU_METHOD Volt_Batt "" RAT_FUNC "%5.0" "mV" COEFFS 0 0.05 0 0 0 1 /end COMPU_METHOD
/begin RECORD_LAYOUT CurTKL_SW_VV_UB NO_AXIS_PTS_X 1 UBYTE RESERVED 2 BYTE AXIS_PTS_X 3 SWORD INDEX_INCR DIRECT FNC_VALUES 4 UBYTE COLUMN_DIR DIRECT /end RECORD_LAYOUT
/begin RECORD_LAYOUT Cur_Xs16Ws16 NO_AXIS_PTS_X 1 SWORD AXIS_PTS_X 2 SWORD INDEX_INCR DIRECT FNC_VALUES 3 SWORD COLUMN_DIR DIRECT /end RECORD_LAYOUT
/begin RECORD_LAYOUT Kl_Xs16_Ws16 NO_AXIS_PTS_X 1 SWORD AXIS_PTS_X 2 SWORD INDEX_INCR DIRECT FNC_VALUES 3 SWORD COLUMN_DIR DIRECT /end RECORD_LAYOUT
/begin RECORD_LAYOUT Kw_Ws16 FNC_VALUES 1 SWORD COLUMN_DIR DIRECT /end RECORD_LAYOUT
/begin RECORD_LAYOUT Kw_Ws32 FNC_VALUES 1 SLONG COLUMN_DIR DIRECT /end RECORD_LAYOUT
/begin RECORD_LAYOUT Kw_Wu16 FNC_VALUES 1 UWORD COLUMN_DIR DIRECT /end RECORD_LAYOUT
/begin RECORD_LAYOUT Kw_Wu32 FNC_VALUES 1 ULONG COLUMN_DIR DIRECT /end RECORD_LAYOUT
/begin RECORD_LAYOUT Kw_Wu8 FNC_VALUES 1 UBYTE COLUMN_DIR DIRECT /end RECORD_LAYOUT
/begin RECORD_LAYOUT MapTKF_UW_SW_UB NO_AXIS_PTS_X 1 UBYTE NO_AXIS_PTS_Y 2 UBYTE AXIS_PTS_X 3 SWORD INDEX_INCR DIRECT AXIS_PTS_Y 4 UWORD INDEX_INCR DIRECT FNC_VALUES 5 UBYTE COLUMN_DIR DIRECT /end RECORD_LAYOUT
/begin RECORD_LAYOUT Map_Xs16Ys16Ws16 NO_AXIS_PTS_X 1 SWORD NO_AXIS_PTS_Y 2 SWORD AXIS_PTS_X 3 SWORD INDEX_INCR DIRECT AXIS_PTS_Y 4 SWORD INDEX_INCR DIRECT FNC_VALUES 5 SWORD COLUMN_DIR DIRECT /end RECORD_LAYOUT
/begin RECORD_LAYOUT ValA_Ws16 FNC_VALUES 1 SWORD COLUMN_DIR DIRECT /end RECORD_LAYOUT
/begin RECORD_LAYOUT ValA_Wu32 FNC_VALUES 1 ULONG COLUMN_DIR DIRECT /end RECORD_LAYOUT
/begin RECORD_LAYOUT ValA_Wu8 FNC_VALUES 1 UBYTE COLUMN_DIR DIRECT /end RECORD_LAYOUT
/begin RECORD_LAYOUT Val_Ws16 FNC_VALUES 1 SWORD COLUMN_DIR DIRECT /end RECORD_LAYOUT
/begin RECORD_LAYOUT Val_Ws32 FNC_VALUES 1 SLONG COLUMN_DIR DIRECT /end RECORD_LAYOUT
/begin RECORD_LAYOUT Val_Wu16 FNC_VALUES 1 UWORD COLUMN_DIR DIRECT /end RECORD_LAYOUT
/begin RECORD_LAYOUT Val_Wu32 FNC_VALUES 1 ULONG COLUMN_DIR DIRECT /end RECORD_LAYOUT
/begin RECORD_LAYOUT Val_Wu8 FNC_VALUES 1 UBYTE COLUMN_DIR DIRECT /end RECORD_LAYOUT
/end MODULE
/end PROJECT

ASAP2_VERSION 1 4
/begin PROJECT P_574 "EDC17_CP09"
/begin HEADER "" VERSION "V8KB" PROJECT_NO P_574 /end HEADER
/begin MODULE DIM ""
/begin MOD_COMMON "" BYTE_ORDER MSB_LAST ALIGNMENT_BYTE 1 ALIGNMENT_WORD 2 ALIGNMENT_LONG 4 ALIGNMENT_FLOAT32_IEEE 4 /end MOD_COMMON
/begin CHARACTERISTIC AFSShOff_nThresOff_C "Obere Drehzahlgrenze für Abschaltung des AFS-Sensors" VALUE 0x8002B8A8 Val_Ws16 10000.00 EngN 0.00 10000.00 EXTENDED_LIMITS -16384.00 16383.50 /end CHARACTERISTIC
/begin CHARACTERISTIC AFSShOff_nThresOn_C "Untere Drehzahlgrenze für Abschaltung des AFS-Sensors" VALUE 0x8002B8AA Val_Ws16 10000.00 EngN 0.00 10000.00 EXTENDED_LIMITS -16384.00 16383.50 /end CHARACTERISTIC
/begin CHARACTERISTIC AFS_dmAirSubsVal_MAP "Kennlinie zur Berechnung der Luftmasse im Fehlerfall des Luftstromsystems." MAP 0x8002B8AC Map_Xs16Ys16Ws16 1000.000 AirMassPerTime 0.00 1000.000 EXTENDED_LIMITS -3276.800 3276.700
 /begin AXIS_DESCR STD_AXIS Epm_nEng EngN 16 0.00 6000.000 EXTENDED_LIMITS -16384.00 16383.50 DEPOSIT ABSOLUTE /end AXIS_DESCR
 /begin AXIS_DESCR STD_AXIS Air_pIntkVUs Pres_hPa 16 0.00 3500.000 EXTENDED_LIMITS -32768.00 32767.00 DEPOSIT ABSOLUTE /end AXIS_DESCR
/end CHARACTERISTIC
/begin CHARACTERISTIC AFS_dmIdlAirMsLim_C "Luftmassenstromgrenze im Leerlaufbereich für Korrekturfaktor" VALUE 0x8002BD7C Val_Ws16 1000.000 AirMassPerTime 0.00 1000.000 EXTENDED_LIMITS -3276.800 3276.700 /end CHARACTERISTIC
/begin CHARACTERISTIC AFS_dmLdAirMsLim_C "Luftmassenstromgrenze im Lastbereich für Korrekturfaktorkennlinie" VALUE 0x8002BD7E Val_Ws16 1000.000 AirMassPerTime 0.00 1000.000 EXTENDED_LIMITS -3276.800 3276.700 /end CHARACTERISTIC
/begin CHARACTERISTIC AFS_dmTransf_CUR "Übertragungskennlinie zur Konvertierung der ADC Spannung in den physikalischen Luftdurchsatz." CURVE 0x8002B7CC Cur_Xs16Ws16 2000.000 AirMassPerTime -1000.000 1000.000 EXTENDED_LIMITS -3276.800 3276.700
 /begin AXIS_DESCR STD_AXIS AFS_tiRaw Time_PwmHigh 27 -1638.400 1638.350 FORMAT "%8.3" DEPOSIT ABSOLUTE /end AXIS_DESCR
/end CHARACTERISTIC
/begin CHARACTERISTIC AFS_dpBstThrHiPlHi_C "" VALUE 0x8002BAF0 Val_Ws16 3500.000 RmpPres_hPa 0.00 3500.000 FORMAT "%8.3" EXTENDED_LIMITS -500.0000 499.9847 /end CHARACTERISTIC
/begin CHARACTERISTIC AFS_dpLdAdjThresHi_C "Maximaler Ladedruckgradient zur Freigabe der Driftkompensation im Lastbereich" VALUE 0x8002BD80 Val_Ws16 3500.000 RmpPres_hPa 0.00 3500.000 FORMAT "%8.3" EXTENDED_LIMITS -500.0000 499.9847 /end CHARACTERISTIC
/begin CHARACTERISTIC AFS_dqLdAdjThresHi_C "Maximaler Mengengradient für Freigabe der Driftkompensation im Last-Bereich" VALUE 0x8002BD82 Val_Ws16 327.6700 RmpInjMass 0.00 327.6700 FORMAT "%8.4" EXTENDED_LIMITS -5.000000 4.999847 /end CHARACTERISTIC
/begin CHARACTERISTIC AFS_dqRawThrHi_C "" VALUE 0x8002BAF2 Val_Ws16 327.6700 RmpInjMass 0.00 327.6700 FORMAT "%8.4" EXTENDED_LIMITS -5.000000 4.999847 /end CHARACTERISTIC
/begin CHARACTERISTIC AFS_drWtPenDetThresHi_C "Oberer Faktorenschwellwert für Wassereintragserkennung" VALUE 0x8002BD84 Val_Ws16 3.000000 Rmp_1 0.00 3.000000 FORMAT "%8.6" EXTENDED_LIMITS -32.76800 32.76700 /end CHARACTERISTIC
/begin CHARACTERISTIC AFS_dtAirThres_C "Schwelle für Änderungsgeschwindigkeit der Ladelufttemperatur" VALUE 0x8002BAF4 Val_Ws16 65535.00 TempCels_100ms -32768.00 32767.00 FORMAT "%8.2" /end CHARACTERISTIC
/begin CHARACTERISTIC AFS_facCorExtpIdl_CUR "Korrekturfaktorextrapolationsverlauf unterhalb der Luftmassenstromstützstelle im Leerlaufbereich" CURVE 0x8002BD86 Cur_Xs16Ws16 4.000000 Fact 0.00 4.000000 EXTENDED_LIMITS -4.000000 3.999878
 /begin AXIS_DESCR STD_AXIS AFS_facCorIpo_mp Fact 3 0.00 1.000000 EXTENDED_LIMITS -4.000000 3.999878 DEPOSIT ABSOLUTE /end AXIS_DESCR
/end CHARACTERISTIC
/begin CHARACTERISTIC AFS_facCorExtpLd_CUR "Korrekturfaktorextrapolationsverlauf oberhalb der Luftmassenstromstützstelle im Lastbereich" CURVE 0x8002BD94 Cur_Xs16Ws16 4.000000 Fact 0.00 4.000000 EXTENDED_LIMITS -4.000000 3.999878
 /begin AXIS_DESCR STD_AXIS AFS_facCorIpo_mp Fact 3 0.00 3.000000 EXTENDED_LIMITS -4.000000 3.999878 DEPOSIT ABSOLUTE /end AXIS_DESCR
/end CHARACTERISTIC
/begin CHARACTERISTIC AFS_facHiThresIdlAdjVal_C "Maximale Driftgrenze für den Korrekturfaktor im Leerlauf" VALUE 0x8002BDA2 Val_Ws16 3.000000 Fact 0.00 3.000000 EXTENDED_LIMITS -4.000000 3.999878 /end CHARACTERISTIC
/begin CHARACTERISTIC AFS_facHiThresLdAdjVal_C "Maximale Driftgrenze für den Korrekturfaktor im Lastbereich" VALUE 0x8002BDA4 Val_Ws16 3.000000 Fact 0.00 3.000000 EXTENDED_LIMITS -4.000000 3.999878 /end CHARACTERISTIC
/begin CHARACTERISTIC AFS_facIdlAdjValStepLim_C "Schrittweitengrenze für den Korrekturfaktor im Leerlauf" VALUE 0x8002BDA6 Val_Ws16 3.000000 Fact 0.00 3.000000 EXTENDED_LIMITS -4.000000 3.999878 /end CHARACTERISTIC
/begin CHARACTERISTIC AFS_facLdAdjValStepLim_C "Schrittweitengrenze für den Korrekturfaktor im Lastbereich" VALUE 0x8002BDA8 Val_Ws16 3.000000 Fact 0.00 3.000000 EXTENDED_LIMITS -4.000000 3.999878 /end CHARACTERISTIC
/begin CHARACTERISTIC AFS_facLoThresIdlAdjVal_C "Minimale Driftgrenze für den Korrekturfaktor im Leerlaufbereich" VALUE 0x8002BDAA Val_Ws16 2.000000 Fact 0.00 2.000000 EXTENDED_LIMITS -4.000000 3.999878 /end CHARACTERISTIC
/begin CHARACTERISTIC AFS_facLoThresLdAdjVal_C "Minimale Driftgrenze für den Korrekturfaktor im Lastbereich" VALUE 0x8002BDAC Val_Ws16 2.000000 Fact 0.00 2.000000 EXTENDED_LIMITS -4.000000 3.999878 /end CHARACTERISTIC
/begin CHARACTERISTIC AFS_facPerCor_C "Luftmassensignalkorrekturfaktor im Fall eines HFM-Temperatursensorfehlers" VALUE 0x8002B83A Val_Ws16 7.999878 Fact -4.000000 3.999878 /end CHARACTERISTIC
/begin CHARACTERISTIC AFS_facPlsCor_MAP "Kennfeld zur Berechnung des Korrekturfaktors, der die Pulsationsfehler und Abweichungen durch den Luftkanaleinflüsse behandelt." MAP 0x8002BAF6 Map_Xs16Ys16Ws16 1.000000 Fact 0.00 1.000000 EXTENDED_LIMITS -4.000000 3.999878
 /begin AXIS_DESCR STD_AXIS Epm_nEng EngN 16 0.00 6000.000 EXTENDED_LIMITS -16384.00 16383.50 DEPOSIT ABSOLUTE /end AXIS_DESCR
 /begin AXIS_DESCR STD_AXIS InjCtl_qCurr InjMass 16 0.00 327.6700 EXTENDED_LIMITS -327.6800 327.6700 DEPOSIT ABSOLUTE /end AXIS_DESCR
/end CHARACTERISTIC
/begin CHARACTERISTIC AFS_facSwtOnCor_C "Einschaltenskorrekturfaktor" VALUE 0x8002BD3A Val_Ws16 3.000000 Fact 0.00 3.000000 EXTENDED_LIMITS -4.000000 3.999878 /end CHARACTERISTIC
/begin CHARACTERISTIC AFS_HiBattDeb.tiHiLo_C "Entprellstruktur für Batterie-High-Bedingung/" VALUE 0x8002BD3C Kw_Ws16 655350.0 TimeDeb -327680.0 327670.0 /end CHARACTERISTIC
/begin CHARACTERISTIC AFS_HiBattDeb.tiLoHi_C "Entprellstruktur für Batterie-High-Bedingung/" VALUE 0x8002BD3E Kw_Ws16 655350.0 TimeDeb -327680.0 327670.0 /end CHARACTERISTIC
/begin CHARACTERISTIC AFS_HiTempDeb.tiHiLo_C "Entprellstruktur für Temperatur-High-Bedingung/" VALUE 0x8002BD40 Kw_Ws16 655350.0 TimeDeb -327680.0 327670.0 /end CHARACTERISTIC
/begin CHARACTERISTIC AFS_HiTempDeb.tiLoHi_C "Entprellstruktur für Temperatur-High-Bedingung/" VALUE 0x8002BD42 Kw_Ws16 655350.0 TimeDeb -327680.0 327670.0 /end CHARACTERISTIC
/begin CHARACTERISTIC AFS_LoBattDeb.tiHiLo_C "Entprellstruktur für Batterie-Low-Bedingung/" VALUE 0x8002BD44 Kw_Ws16 655350.0 TimeDeb -327680.0 327670.0 /end CHARACTERISTIC
/begin CHARACTERISTIC AFS_LoBattDeb.tiLoHi_C "Entprellstruktur für Batterie-Low-Bedingung/" VALUE 0x8002BD46 Kw_Ws16 655350.0 TimeDeb -327680.0 327670.0 /end CHARACTERISTIC
/begin CHARACTERISTIC AFS_LoTempDeb.tiHiLo_C "Entprellstruktur für Temperatur-Low-Bedingung/" VALUE 0x8002BD48 Kw_Ws16 655350.0 TimeDeb -327680.0 327670.0 /end CHARACTERISTIC
/begin CHARACTERISTIC AFS_LoTempDeb.tiLoHi_C "Entprellstruktur für Temperatur-Low-Bedingung/" VALUE 0x8002BD4A Kw_Ws16 655350.0 TimeDeb -327680.0 327670.0 /end CHARACTERISTIC
/begin CHARACTERISTIC AFS_nAvrgIdlAdjThresHi_C "Obere Motordrehzahlschwelle zur Freigabe der Driftkompensation im Leerlaufbereich" VALUE 0x8002BDAE Val_Ws16 9980.000 EngN 20.00000 10000.00 EXTENDED_LIMITS -16384.00 16383.50 /end CHARACTERISTIC
/begin CHARACTERISTIC AFS_nAvrgIdlAdjThresLo_C "Untere Motordrehzahlschwelle zur Freigabe der Driftkompensation im Leerlaufbereich" VALUE 0x8002BDB0 Val_Ws16 9980.000 EngN 20.00000 10000.00 EXTENDED_LIMITS -16384.00 16383.50 /end CHARACTERISTIC
/begin CHARACTERISTIC AFS_nAvrgThrHiPlHi_C "Obere Schwelle der Motordrehzahl zur Prüfung der Oberengrenze von der Empfindlichkeitsdrift" VALUE 0x8002BD4C Val_Ws16 6000.000 EngN 0.00 6000.000 EXTENDED_LIMITS -16384.00 16383.50 /end CHARACTERISTIC
/begin CHARACTERISTIC AFS_nAvrgThrHiPlLo_C "Obere Schwelle der Motordrehzahl zur Prüfung der Unterengrenze von der Empfindlichkeitsdrift" VALUE 0x8002BD4E Val_Ws16 6000.000 EngN 0.00 6000.000 EXTENDED_LIMITS -16384.00 16383.50 /end CHARACTERISTIC
/begin CHARACTERISTIC AFS_nAvrgThrHiSRCLo_C "Obere Schwelle der Motordrehzahl zum Aufruf der SRC-Behandlung" VALUE 0x8002B83C Val_Ws16 6000.000 EngN 0.00 6000.000 EXTENDED_LIMITS -16384.00 16383.50 /end CHARACTERISTIC
/begin CHARACTERISTIC AFS_nAvrgThrLoPlHi_C "Untere Schwelle der Motordrehzahl zur Prüfung der Oberengrenze von der Empfindlichkeitsdrift" VALUE 0x8002BD50 Val_Ws16 6000.000 EngN 0.00 6000.000 EXTENDED_LIMITS -16384.00 16383.50 /end CHARACTERISTIC
/begin CHARACTERISTIC AFS_nAvrgThrLoPlLo_C "Untere Schwelle der Motordrehzahl zur Prüfung der Unterengrenze von der Empfindlichkeitsdrift" VALUE 0x8002BD52 Val_Ws16 6000.000 EngN 0.00 6000.000 EXTENDED_LIMITS -16384.00 16383.50 /end CHARACTERISTIC
/begin CHARACTERISTIC AFS_nAvrgThrLoSRCLo_C "Untere Schwelle der Motordrehzahl zum Aufruf der SRC-Behandlung" VALUE 0x8002B83E Val_Ws16 6000.000 EngN 0.00 6000.000 EXTENDED_LIMITS -16384.00 16383.50 /end CHARACTERISTIC
/begin CHARACTERISTIC AFS_pAirThrLo_C "Luftdruckschwelle der Plausibilitätsprüfung der Empfindlichkeitsdrift" VALUE 0x8002BD54 Val_Ws16 3000.000 Pres_hPa 500.0000 3500.000 EXTENDED_LIMITS -32768.00 32767.00 /end CHARACTERISTIC
/begin CHARACTERISTIC AFS_pBstAtmDiffLim_C "Maximale Differenz zwischen Atmosphären- und Ladedruck für Leerlauffreigabe" VALUE 0x8002BDB2 Val_Ws16 3500.000 Pres_hPa 0.00 3500.000 EXTENDED_LIMITS -32768.00 32767.00 /end CHARACTERISTIC
/begin CHARACTERISTIC AFS_pBstLdAdjThresHi_C "Obere Ladedruckschwelle für Freigabe der Driftkompensation im Lastbereich" VALUE 0x8002BDB4 Val_Ws16 3500.000 Pres_hPa 0.00 3500.000 EXTENDED_LIMITS -32768.00 32767.00 /end CHARACTERISTIC
/begin CHARACTERISTIC AFS_pBstLdAdjThresLo_C "Untere Ladedruckschwelle für Freigabe der Driftkompensation im Lastbereich" VALUE 0x8002BDB6 Val_Ws16 3500.000 Pres_hPa 0.00 3500.000 EXTENDED_LIMITS -32768.00 32767.00 /end CHARACTERISTIC
/begin CHARACTERISTIC AFS_qAirmThrSRCHiActv_CUR "Kennlinie zur Berechnung der Motordrehzahl-abhängigen Einspritzmengengrenze." CURVE 0x8002B840 Cur_Xs16Ws16 100.0000 InjMass 0.00 100.0000 EXTENDED_LIMITS -327.6800 327.6700
 /begin AXIS_DESCR STD_AXIS Epm_nEng EngN 16 0.00 6000.000 EXTENDED_LIMITS -16384.00 16383.50 DEPOSIT ABSOLUTE /end AXIS_DESCR
/end CHARACTERISTIC
/begin CHARACTERISTIC AFS_qCurrIdlAdjThresHi_C "Obere Einspritzmengenschwelle zur Freigabe der Driftkompensation im Leerlaufbereich" VALUE 0x8002BDB8 Val_Ws16 327.6700 InjMass 0.00 327.6700 EXTENDED_LIMITS -327.6800 327.6700 /end CHARACTERISTIC
/begin CHARACTERISTIC AFS_qCurrIdlAdjThresLo_C "Untere Einspritzmengenschwelle zur Freigabe der Driftkompensation im Leerlaufbereich" VALUE 0x8002BDBA Val_Ws16 327.6700 InjMass 0.00 327.6700 EXTENDED_LIMITS -327.6800 327.6700 /end CHARACTERISTIC
/begin CHARACTERISTIC AFS_qWinLdAdjThresHi_CUR "Obere drehzahlabhängige Mengenschwelle zur Freigabe der Driftkompensation im Lastbereich" CURVE 0x8002BDBC Cur_Xs16Ws16 327.6700 InjMass 0.00 327.6700 EXTENDED_LIMITS -327.6800 327.6700
 /begin AXIS_DESCR STD_AXIS Epm_nEng EngN 8 20.00000 10000.00 EXTENDED_LIMITS -16384.00 16383.50 DEPOSIT ABSOLUTE /end AXIS_DESCR
/end CHARACTERISTIC
/begin CHARACTERISTIC AFS_qWinLdAdjThresLo_CUR "Untere drehzahlabhängige Mengenschwelle zur Freigabe der Driftkompensation im Lastbereich" CURVE 0x8002BDDE Cur_Xs16Ws16 327.6700 InjMass 0.00 327.6700 EXTENDED_LIMITS -327.6800 327.6700
 /begin AXIS_DESCR STD_AXIS Epm_nEng EngN 8 20.00000 10000.00 EXTENDED_LIMITS -16384.00 16383.50 DEPOSIT ABSOLUTE /end AXIS_DESCR
/end CHARACTERISTIC
/begin CHARACTERISTIC AFS_rAirThrHiPlHi_C "Obere Schwelle des normierten Verhältnisses für die Plausibilitätsprüfung der oberen Empfindlichkeitsdrift." VALUE 0x8002BD56 Val_Ws16 7.999878 Fact -4.000000 3.999878 /end CHARACTERISTIC
/begin CHARACTERISTIC AFS_rAirThrLoPlLo_C "Untere Schwelle der Min-Plausibilitätsprüfung der Unterengrenze der Empfindlichkeitsdrift" VALUE 0x8002BD58 Val_Ws16 7.999878 Fact -4.000000 3.999878 /end CHARACTERISTIC
/begin CHARACTERISTIC AFS_rEGRPThrHi_C "Obere Grenze der Abgasrückführregelung zur Freigabe der Plausibilitätsprüfung (OBD) der Empfindlichkeitsdrift" VALUE 0x8002BD5A Val_Ws16 400.0000 Prc -200.0000 200.0000 EXTENDED_LIMITS -400.0000 399.9878 /end CHARACTERISTIC
/begin CHARACTERISTIC AFS_rSwirlThrHi_C "Obere Grenze der veränderlichen Drallsteuerung zur Freigabe der Plausibilitätsprüfung (OBD) der Empfindlichkeitsdrift" VALUE 0x8002BD5C Val_Ws16 100.0000 Prc 0.00 100.0000 EXTENDED_LIMITS -400.0000 399.9878 /end CHARACTERISTIC
/begin CHARACTERISTIC AFS_rSwirlThrLo_C "Untere Grenze der veränderlichen Drallsteuerung zur Freigabe der Plausibilitätsprüfung (OBD) der Empfindlichkeitsdrift" VALUE 0x8002BD5E Val_Ws16 100.0000 Prc 0.00 100.0000 EXTENDED_LIMITS -400.0000 399.9878 /end CHARACTERISTIC
/begin CHARACTERISTIC AFS_rTVAThrHi_C "Obere Grenze der Drosselklappensteuerung zur Freigabe der Plausibilitätsprüfung (OBD) der Empfindlichkeitsdrift" VALUE 0x8002BD60 Val_Ws16 100.0000 Prc 0.00 100.0000 EXTENDED_LIMITS -400.0000 399.9878 /end CHARACTERISTIC
/begin CHARACTERISTIC AFS_rTVAThrLo_C "Untere Grenze der Drosselklappensteuerung zur Freigabe der Plausibilitätsprüfung (OBD) der Empfindlichkeitsdrift" VALUE 0x8002BD62 Val_Ws16 100.0000 Prc 0.00 100.0000 EXTENDED_LIMITS -400.0000 399.9878 /end CHARACTERISTIC
/begin CHARACTERISTIC AFS_SSpShOff_DigOut.tiBtwTstSCB_C "/" VALUE 0x8002B8A0 Kw_Ws16 1000.000 Time_ms 0.00 1000.000 EXTENDED_LIMITS -327680.0 327670.0 /end CHARACTERISTIC
/begin CHARACTERISTIC AFS_SSpShOff_DigOut.tiBtwTstOT_C "/" VALUE 0x8002B8A2 Kw_Ws16 1000.000 Time_s 0.00 1000.000 EXTENDED_LIMITS -327.6800 327.6700 /end CHARACTERISTIC
/begin CHARACTERISTIC AFS_SSpShOff_DigOut.numTstMax_C "/" VALUE 0x8002B8A4 Kw_Wu16 65535.00 OneToOne 0.00 65535.00 /end CHARACTERISTIC
/begin CHARACTERISTIC AFS_stAdjRlsLckRgn_C "Bitmaske für Freigabeabgleichwertberechnung auf der Basis von Regenerationsbedingung" VALUE 0x8002BE00 Val_Wu32 4294967295.00 OneToOne 0.00 4294967295.00 /end CHARACTERISTIC
/begin CHARACTERISTIC AFS_stInhRls_C "Stellerauswahl-Bitmaske zur Freigabe der Plausibilitätsprüfung (OBD) der Empfindlichkeitsdrift" VALUE 0x8002BD64 Val_Wu16 65535.00 OneToOne 0.00 65535.00 /end CHARACTERISTIC
/begin CHARACTERISTIC AFS_stPsShOffDiaDisbl_C "" VALUE 0x8002B8A6 Val_Wu8 255.0 OneToOne 0.00 255.0 /end CHARACTERISTIC
/begin CHARACTERISTIC AFS_stPsShOffDisbl_C "" VALUE 0x8002B8A7 Val_Wu8 255.0 OneToOne 0.00 255.0 /end CHARACTERISTIC
/begin CHARACTERISTIC AFS_Swt.xVal_C "Implementierung des Software Schalters zur Aktivierung/Deaktivierung von SRC im Nachlauf/" VALUE 0x8002B882 Kw_Wu8 1.000 OneToOne 0.00 1.000 EXTENDED_LIMITS 0.00 255.0 /end CHARACTERISTIC
/begin CHARACTERISTIC AFS_Swt.xTyp_C "Implementierung des Software Schalters zur Aktivierung/Deaktivierung von SRC im Nachlauf/" VALUE 0x8002B883 Kw_Wu8 2.000 OneToOne 0.00 2.000 EXTENDED_LIMITS 0.00 255.0 /end CHARACTERISTIC
/begin CHARACTERISTIC AFS_swtActvEEPLoThres_C "Software Schalter, setzt den Deaktivierungsstatus der Minimalabweichungsgrenzen im EEPROM (1: setzt in auf FALSCH, 0: keine Änderung)" VALUE 0x8002BE04 Val_Wu8 1.000 OneToOne 0.00 1.000 EXTENDED_LIMITS 0.00 255.0 /end CHARACTERISTIC
/begin CHARACTERISTIC AFS_swtAirMsCorRls_C "Softwareschalter zur Aktivierung der Luftmassenkorrektur (0: keine Korrektur, 1: Korrektur ist aktiviert)" VALUE 0x8002BE05 Val_Wu8 1.000 OneToOne 0.00 1.000 EXTENDED_LIMITS 0.00 255.0 /end CHARACTERISTIC
/begin CHARACTERISTIC AFS_swtClrEEPAdjVal_C "Software Schalter, setzt die im EEPROM gespeicherten Korrekturwerte auf 0 (1: löscht Werte im EEPROM, 0: keine Änderungen)" VALUE 0x8002BE06 Val_Wu8 1.000 OneToOne 0.00 1.000 EXTENDED_LIMITS 0.00 255.0 /end CHARACTERISTIC
/begin CHARACTERISTIC AFS_swtCurrAdjRls_C "Softwareschalter zur Freigabe der Driftkompensation (1: Kompensation ist freigegeben, 0: keine Kompensation)" VALUE 0x8002BE07 Val_Wu8 1.000 OneToOne 0.00 1.000 EXTENDED_LIMITS 0.00 255.0 /end CHARACTERISTIC
/begin CHARACTERISTIC AFS_swtOffTstSel_C "Schalter zur Entscheidung ob der offset drift test Im START oder im AFTERRUM Status des Motors durchgeführt wird" VALUE 0x8002B884 Val_Wu8 255.0 OneToOne 0.00 255.0 /end CHARACTERISTIC
/begin CHARACTERISTIC AFS_swtOscSel_C "Schalter zur Anzeige von Oszillator HFM" VALUE 0x8002B885 Val_Wu8 255.0 OneToOne 0.00 255.0 /end CHARACTERISTIC
/begin CHARACTERISTIC AFS_swtWtPenMon_C "Softwareschalter zur permanenten Aktivierung der Wassereintragerkennung (0: Erkennung nicht aktiv, 1: Erkrennung aktiv" VALUE 0x8002BE08 Val_Wu8 1.000 OneToOne 0.00 1.000 EXTENDED_LIMITS 0.00 255.0 /end CHARACTERISTIC
/begin CHARACTERISTIC AFS_tAirAdjRlsThresHi_C "Obere Ansauglufttemperaturschwelle zur Erfüllung der Umgebungsbedingung" VALUE 0x8002BE0A Val_Ws16 250.0000 Temp_Cels -50.14000 199.8600 EXTENDED_LIMITS -3549.940 3003.560 /end CHARACTERISTIC
/begin CHARACTERISTIC AFS_tAirAdjRlsThresLo_C "Untere Ansauglufttemperaturschwelle zur Erfüllung der Umgebungsbedingung" VALUE 0x8002BE0C Val_Ws16 250.0000 Temp_Cels -50.14000 199.8600 EXTENDED_LIMITS -3549.940 3003.560 /end CHARACTERISTIC
/begin CHARACTERISTIC AFS_tClntThrHi_C "Obere Schwelle der Kühlmitteltemperatur zur Freigabe der Plausibilitätsprüfung (OBD) der Empfindlichkeitsdrift" VALUE 0x8002BD66 Val_Ws16 200.0000 Temp_Cels -50.14000 149.8600 EXTENDED_LIMITS -3549.940 3003.560 /end CHARACTERISTIC
/begin CHARACTERISTIC AFS_tClntThrLo_C "Untere Schwelle der Kühlmitteltemperatur zur Freigabe der Plausibilitätsprüfung (OBD) der Empfindlichkeitsdrift" VALUE 0x8002BD68 Val_Ws16 200.0000 Temp_Cels -50.14000 149.8600 EXTENDED_LIMITS -3549.940 3003.560 /end CHARACTERISTIC
/begin CHARACTERISTIC AFS_tEnvAdjRlsThresHi_C "Obere Umgebungstemperaturschwelle zur Erfüllung der Umgebungsbedingung" VALUE 0x8002BE0E Val_Ws16 250.0000 Temp_Cels -50.14000 199.8600 EXTENDED_LIMITS -3549.940 3003.560 /end CHARACTERISTIC
/begin CHARACTERISTIC AFS_tEnvAdjRlsThresLo_C "Untere Umgebungstemperaturschwelle zur Erfüllung der Umgebungsbedingung" VALUE 0x8002BE10 Val_Ws16 250.0000 Temp_Cels -50.14000 199.8600 EXTENDED_LIMITS -3549.940 3003.560 /end CHARACTERISTIC
/begin CHARACTERISTIC AFS_tiAdjRlsDel_C "Zeitverzögerung nach Stellereingriff bis zur Freigabe der Driftkompensation im Leerlauf- und Lastbereich" VALUE 0x8002BE12 Val_Wu16 655350.0 Time_ms 0.00 655350.0 /end CHARACTERISTIC
/begin CHARACTERISTIC AFS_tiAirMsPT1_C "Untere Ladedruckschwelle für Freigabe der Driftkompensation im Lastbereich" VALUE 0x8002BE14 Val_Ws32 4294967.2940 TimeDelay_ms 0.0020000000009 4294967.2960 FORMAT "%12.4" /end CHARACTERISTIC
/begin CHARACTERISTIC AFS_tiBstPresPT1_C "Zeitkonstante für Filterung des Ladedruckgradienten" VALUE 0x8002BE18 Val_Ws32 4294967.2940 TimeDelay_ms 0.0020000000009 4294967.2960 FORMAT "%12.4" /end CHARACTERISTIC
/begin CHARACTERISTIC AFS_tiCorFacPT1_C "Zeitkonstante für Filterung des Korrekturfaktors im Driftkompensationsmodus" VALUE 0x8002BE1C Val_Ws32 4294967.2940 TimeDelay_ms 0.0020000000009 4294967.2960 FORMAT "%12.4" /end CHARACTERISTIC
/begin CHARACTERISTIC AFS_tiCorSRCHi_C "Obere Schwelle für die korrigierte Luftmassenperiode in HFM6" VALUE 0x8002B886 Val_Ws16 3276.750 Time_PwmHigh -1638.400 1638.350 FORMAT "%8.3" /end CHARACTERISTIC
/begin CHARACTERISTIC AFS_tiCorSRCLo_C "Untere Schwelle für die korrigierte Luftmassenperiode in HFM6" VALUE 0x8002B888 Val_Ws16 3276.750 Time_PwmHigh -1638.400 1638.350 FORMAT "%8.3" /end CHARACTERISTIC
/begin CHARACTERISTIC AFS_tiDlyActvSRCHiAirm_C "Zeitdauer, während der die Einspritzmenge zur Freigabe des SRC High-Checks weniger als die Schwelle sein muss" VALUE 0x8002B88A Val_Ws16 655350.0 Time_ms -327680.0 327670.0 /end CHARACTERISTIC
/begin CHARACTERISTIC AFS_tiDlyEGRPPlSetyDrft_C "Minimale Zeit, für die die AGR Steuerung oberhalb der Schwelle zur Freigabe der Plausibilitätsprüfung (OBD) der Empfindlichkeitsdrift sein muss" VALUE 0x8002BD6A Val_Ws16 655350.0 Time_ms -327680.0 327670.0 /end CHARACTERISTIC
/begin CHARACTERISTIC AFS_tiDlyStrPlSetyDrft_C "Schwelle der Zeit, seit der der Motor im Normalbetrieb ist" VALUE 0x8002BD6C Val_Wu32 42949672950.0 Time_ms 0.00 42949672950.0 /end CHARACTERISTIC
/begin CHARACTERISTIC AFS_tiDlySwtOnCor_C "Zeit seit K15 EIN, für die die Einschaltkorrektur appliziert wird." VALUE 0x8002BD70 Val_Ws16 655350.0 Time_ms -327680.0 327670.0 /end CHARACTERISTIC
/begin CHARACTERISTIC AFS_tiIdlAdjRlsDeb.tiHiLo_C "Entprellzeitparameter zur Freigabe der Bedingung für Leerlaufwertabgleichsberechnung/" VALUE 0x8002BE20 Kw_Ws16 655350.0 TimeDeb -327680.0 327670.0 /end CHARACTERISTIC
/begin CHARACTERISTIC AFS_tiIdlAdjRlsDeb.tiLoHi_C "Entprellzeitparameter zur Freigabe der Bedingung für Leerlaufwertabgleichsberechnung/" VALUE 0x8002BE22 Kw_Ws16 655350.0 TimeDeb -327680.0 327670.0 /end CHARACTERISTIC
/begin CHARACTERISTIC AFS_tiLdAdjRlsDeb.tiHiLo_C "Entprellzeitparameter zur Freigabe der Bedingung für Lastwertabgleichsberechnung/" VALUE 0x8002BE24 Kw_Ws16 655350.0 TimeDeb -327680.0 327670.0 /end CHARACTERISTIC
/begin CHARACTERISTIC AFS_tiLdAdjRlsDeb.tiLoHi_C "Entprellzeitparameter zur Freigabe der Bedingung für Lastwertabgleichsberechnung/" VALUE 0x8002BE26 Kw_Ws16 655350.0 TimeDeb -327680.0 327670.0 /end CHARACTERISTIC
/begin CHARACTERISTIC AFS_tiLPFiltPT1_C "Zeitkonstante PT1-Filters für den Luftdurchsatz." VALUE 0x8002B88C Val_Ws32 4294967.2940 TimeDelay_ms 0.0020000000009 4294967.2960 FORMAT "%12.4" /end CHARACTERISTIC
/begin CHARACTERISTIC AFS_tiOffsDrftTstDly_C "Verzögerungszeit für Offsetdrift" VALUE 0x8002B890 Val_Ws16 15000.00 Time_ms 0.00 15000.00 EXTENDED_LIMITS -327680.0 327670.0 /end CHARACTERISTIC
/begin CHARACTERISTIC AFS_tiOffsDrftTstLim_C "Zeit, für die eine Plausibilitätsprüfung der Offsetdrift beim Nachlauftest durchgeführt wird." VALUE 0x8002B892 Val_Ws16 327670.0 Time_ms 0.00 327670.0 EXTENDED_LIMITS -327680.0 327670.0 /end CHARACTERISTIC
/begin CHARACTERISTIC AFS_tiPerHFM6_C "Referenzperiode der Lufttemperatur für HFM6-Sensor" VALUE 0x8002B894 Val_Ws32 214748.364750 Time_Period_HFM6 -107374.182400 107374.182350 FORMAT "%13.6" /end CHARACTERISTIC
/begin CHARACTERISTIC AFS_tiQntCurrPT1_C "Zeitkonstante für Filterung des Mengengradienten" VALUE 0x8002BE28 Val_Ws32 4294967.2940 TimeDelay_ms 0.0020000000009 4294967.2960 FORMAT "%12.4" /end CHARACTERISTIC
/begin CHARACTERISTIC AFS_tiRawSRCHi_C "Obere Schwelle für Luftmasse-SRC-High-Erkennung" VALUE 0x8002B898 Val_Ws16 3276.750 Time_PwmHigh -1638.400 1638.350 FORMAT "%8.3" /end CHARACTERISTIC
/begin CHARACTERISTIC AFS_tiRawSRCLo_C "Untere Schwelle für Luftmasse-SRC-High-Erkennung" VALUE 0x8002B89A Val_Ws16 3276.750 Time_PwmHigh -1638.400 1638.350 FORMAT "%8.3" /end CHARACTERISTIC
/begin CHARACTERISTIC AFS_tiStrtDelAdjRls_C "Startverzögerung nach Erreichen des Motorzustands NORMAL zur Erfüllung der Umgebungsfreigabebedingungen" VALUE 0x8002BE2C Val_Wu32 3600000.00000 Time_ms 0.00 3600000.00000 EXTENDED_LIMITS 0.00 42949672950.0 /end CHARACTERISTIC
/begin CHARACTERISTIC AFS_tiThrHiPlOffsDrft_C "Obere Schwelle für Offset-Driftprüfung" VALUE 0x8002B89C Val_Ws16 3276.750 Time_PwmHigh -1638.400 1638.350 FORMAT "%8.3" /end CHARACTERISTIC
/begin CHARACTERISTIC AFS_tiThrLoPlOffsDrft_C "Untere Schwelle für Offset-Driftprüfung" VALUE 0x8002B89E Val_Ws16 3276.750 Time_PwmHigh -1638.400 1638.350 FORMAT "%8.3" /end CHARACTERISTIC
/begin CHARACTERISTIC AFS_tiWtPenDeb.tiHiLo_C "Entprellzeitstruktur für Wassereintragserkennung/" VALUE 0x8002BE30 Kw_Ws16 655350.0 TimeDeb -327680.0 327670.0 /end CHARACTERISTIC
/begin CHARACTERISTIC AFS_tiWtPenDeb.tiLoHi_C "Entprellzeitstruktur für Wassereintragserkennung/" VALUE 0x8002BE32 Kw_Ws16 655350.0 TimeDeb -327680.0 327670.0 /end CHARACTERISTIC
/begin CHARACTERISTIC AFS_tiWtPenDetPT1_C "Zeitkonstante für Filterung der Gradientendifferenz bei Wassereintragserkennung" VALUE 0x8002BE34 Val_Ws32 4294967.2940 TimeDelay_ms 0.0020000000009 4294967.2960 FORMAT "%12.4" /end CHARACTERISTIC
/begin CHARACTERISTIC AFS_tTempHi_C "Obere Schwelle für Lufttemperatur" VALUE 0x8002BD72 Val_Ws16 6553.500 Temp_Cels -3549.940 3003.560 /end CHARACTERISTIC
/begin CHARACTERISTIC AFS_tTempLo_C "Untere Schwelle für Lufttemperatur" VALUE 0x8002BD74 Val_Ws16 6553.500 Temp_Cels -3549.940 3003.560 /end CHARACTERISTIC
/begin CHARACTERISTIC AFS_uBattMax_C "Obere Batterieschwelle für Bestimmung der AFS-Signalqualität" VALUE 0x8002BD76 Val_Ws16 1310700. Volt_Batt -655360.0 655340.0 /end CHARACTERISTIC
/begin CHARACTERISTIC AFS_uBattMin_C "Untere Batterieschwelle für Bestimmung der AFS-Signalqualität" VALUE 0x8002BD78 Val_Ws16 1310700. Volt_Batt -655360.0 655340.0 /end CHARACTERISTIC
/begin CHARACTERISTIC AFS_vVehLdAdjThresHi_C "Obere Fahrzeuggeschwindigkeitsschwelle für Freigabe der Driftkompensation im Lastbereich" VALUE 0x8002BE38 Val_Ws16 300.0000 Vel 0.00 300.0000 EXTENDED_LIMITS -327.6800 327.6700 /end CHARACTERISTIC
/begin CHARACTERISTIC AFS_vVehLdAdjThresLo_C "Untere Fahrzeuggeschwindigkeitsschwelle für Freigabe der Driftkompensation im Lastbereich" VALUE 0x8002BE3A Val_Ws16 300.0000 Vel 0.00 300.0000 EXTENDED_LIMITS -327.6800 327.6700 /end CHARACTERISTIC
/begin CHARACTERISTIC AGSDem_dnAccLim_C "" VALUE 0x8002BFB0 Val_Ws16 12000.00 ISC_dnEng_float 0.00 12000.00 FORMAT "%8.2" EXTENDED_LIMITS -32768.00 32767.00 /end CHARACTERISTIC
/begin CHARACTERISTIC AGSDem_dnDeclLim_C "" VALUE 0x8002BFB4 Val_Wr32 12000.0000 ISC_dnEng_float -12000.0000 0.00 FORMAT "%10.4" EXTENDED_LIMITS -1.00000000E+037 1.00000000E+037 /end CHARACTERISTIC
/begin CHARACTERISTIC AGSDem_ILo.Ki_C "/Kleinsignal Verstärkungsfaktor (Ki)" VALUE 0x8002BFB8 Val_Wr32 20.0000000 ISC_Ki_rpm2Nm_float 0.00 20.0000000 FORMAT "%10.7" EXTENDED_LIMITS -1.00000000E+037 1.00000000E+037 /end CHARACTERISTIC
/begin CHARACTERISTIC AGSDem_ILo.KiPos_C "/Großsignal Verstärkungsfaktor positiv (Ki)" VALUE 0x8002BFBC Val_Wr32 20.0000000 ISC_Ki_rpm2Nm_float 0.00 20.0000000 FORMAT "%10.7" EXTENDED_LIMITS -1.00000000E+037 1.00000000E+037 /end CHARACTERISTIC
/begin CHARACTERISTIC AGSDem_ILo.KiNeg_C "/Großsignal Verstärkungsfaktor negativ (Ki)" VALUE 0x8002BFC0 Val_Wr32 20.0000000 ISC_Ki_rpm2Nm_float 0.00 20.0000000 FORMAT "%10.7" EXTENDED_LIMITS -1.00000000E+037 1.00000000E+037 /end CHARACTERISTIC
/begin CHARACTERISTIC AGSDem_ILo.WinPos_C "/Kleinsignal Fensterbreite positiv" VALUE 0x8002BFC4 Val_Wr32 20000.0000 EngN_float -10000.0000 10000.0000 EXTENDED_LIMITS -1.00000000E+037 1.00000000E+037 /end CHARACTERISTIC
/begin CHARACTERISTIC AGSDem_ILo.WinNeg_C "/Kleinsignal Fensterbreite negativ" VALUE 0x8002BFC8 Val_Wr32 20000.0000 EngN_float -10000.0000 10000.0000 EXTENDED_LIMITS -1.00000000E+037 1.00000000E+037 /end CHARACTERISTIC
/begin CHARACTERISTIC AGSDem_InrtDrvTrn_C "" VALUE 0x8002BFCC Val_Wr32 20.0000000 ISC_Inirtia_float 0.00 20.0000000 FORMAT "%10.7" EXTENDED_LIMITS -1.00000000E+037 1.00000000E+037 /end CHARACTERISTIC
/begin CHARACTERISTIC AGSDem_InrtEng_C "" VALUE 0x8002BFD0 Val_Wr32 20.0000000 ISC_Inirtia_float 0.00 20.0000000 FORMAT "%10.7" EXTENDED_LIMITS -1.00000000E+037 1.00000000E+037 /end CHARACTERISTIC
/begin CHARACTERISTIC AGSDem_InrtVeh_C "" VALUE 0x8002BFD4 Val_Wr32 20.0000000 ISC_Inirtia_float 0.00 20.0000000 FORMAT "%10.7" EXTENDED_LIMITS -1.00000000E+037 1.00000000E+037 /end CHARACTERISTIC
/begin CHARACTERISTIC AGSDem_PLo.Kp_C "/Kleinsignal Verstärkungsfaktor (Kp)" VALUE 0x8002BFD8 Val_Wr32 20.0000000 ISC_Ki_rpm2Nm_float 0.00 20.0000000 FORMAT "%10.7" EXTENDED_LIMITS -1.00000000E+037 1.00000000E+037 /end CHARACTERISTIC
/begin CHARACTERISTIC AGSDem_PLo.KpPos_C "/Großsignal Verstärkungsfaktor positiv (Kp)" VALUE 0x8002BFDC Val_Wr32 20.0000000 ISC_Ki_rpm2Nm_float 0.00 20.0000000 FORMAT "%10.7" EXTENDED_LIMITS -1.00000000E+037 1.00000000E+037 /end CHARACTERISTIC
/begin CHARACTERISTIC AGSDem_PLo.KpNeg_C "/Großsignal Verstärkungsfaktor negativ (Kp)" VALUE 0x8002BFE0 Val_Wr32 20.0000000 ISC_Ki_rpm2Nm_float 0.00 20.0000000 FORMAT "%10.7" EXTENDED_LIMITS -1.00000000E+037 1.00000000E+037 /end CHARACTERISTIC
/begin CHARACTERISTIC AGSDem_PLo.WinPos_C "/Kleinsignal Fensterbreite positiv" VALUE 0x8002BFE4 Val_Wr32 20000.0000 EngN_float -10000.0000 10000.0000 EXTENDED_LIMITS -1.00000000E+037 1.00000000E+037 /end CHARACTERISTIC
/begin CHARACTERISTIC AGSDem_PLo.WinNeg_C "/Kleinsignal Fensterbreite negativ" VALUE 0x8002BFE8 Val_Wr32 20000.0000 EngN_float -10000.0000 10000.0000 EXTENDED_LIMITS -1.00000000E+037 1.00000000E+037 /end CHARACTERISTIC
/begin CHARACTERISTIC AGSDem_RmpSetPLo.Pos_C "/" VALUE 0x8002BFEC Kw_Ws32 16383999.9924 RmpEngN 0.00 16383999.9924 FORMAT "%13.4" EXTENDED_LIMITS -16384000.0000 16383999.9924 /end CHARACTERISTIC
/begin CHARACTERISTIC AGSDem_RmpSetPLo.Neg_C "/" VALUE 0x8002BFF0 Kw_Ws32 16383999.9924 RmpEngN 0.00 16383999.9924 FORMAT "%13.4" EXTENDED_LIMITS -16384000.0000 16383999.9924 /end CHARACTERISTIC
/begin CHARACTERISTIC AGSDem_rnEngvVeh_C "" VALUE 0x8002BFF4 Val_Wr32 1000.00000 ISC_rnEng2vVeh_float 0.00 1000.00000 FORMAT "%10.5" EXTENDED_LIMITS -1.00000000E+037 1.00000000E+037 /end CHARACTERISTIC
/begin CHARACTERISTIC AGSDem_stActive_C "" VALUE 0x8002BFF8 Val_Wu8 1.000 OneToOne 0.00 1.000 EXTENDED_LIMITS 0.00 255.0 /end CHARACTERISTIC
/begin CHARACTERISTIC AGSDem_tiFltLosTrqEst_C "" VALUE 0x8002BFFC Val_Wr32 60.0000000 ISC_tiPTsTrqLoss_float 0.00 60.0000000 FORMAT "%10.7" EXTENDED_LIMITS -1.00000000E+037 1.00000000E+037 /end CHARACTERISTIC
/begin CHARACTERISTIC AGSDem_tiFltnEng_C "" VALUE 0x8002C000 Val_Wr32 60.0000000 ISC_tiPT2nEng_float 0.00 60.0000000 FORMAT "%10.7" EXTENDED_LIMITS -1.00000000E+037 1.00000000E+037 /end CHARACTERISTIC
/begin CHARACTERISTIC AGSDem_tiMaxActive_C "" VALUE 0x8002C004 Val_Ws32 4294.96729500 Time_Dt 0.00 4294.96729500 FORMAT "%13.7" EXTENDED_LIMITS -2147.48364800 2147.48364700 /end CHARACTERISTIC
/begin CHARACTERISTIC AirCtl_AirEGR.rPresCrit_C "/" VALUE 0x8003185C Kw_Wr32 0.00 OneToOne 0.528282000 0.528282000 FORMAT "%11.9" EXTENDED_LIMITS -1.00000000E+037 1.00000000E+037 READ_ONLY /end CHARACTERISTIC
/begin CHARACTERISTIC AirCtl_AirEGR.facFlwCrit_C "/" VALUE 0x80031860 Kw_Wr32 1.00000000 OneToOne 0.00 1.00000000 FORMAT "%10.8" EXTENDED_LIMITS -1.00000000E+037 1.00000000E+037 READ_ONLY /end CHARACTERISTIC
/begin CHARACTERISTIC AirCtl_AirEGR.rPresLin_C "/" VALUE 0x80031864 Kw_Wr32 1.00000000 OneToOne 0.00 1.00000000 FORMAT "%10.8" EXTENDED_LIMITS -1.00000000E+037 1.00000000E+037 READ_ONLY /end CHARACTERISTIC
/begin CHARACTERISTIC AirCtl_AirEGR.facSlpLin_C "/" VALUE 0x80031868 Kw_Wr32 100.000000 OneToOne 0.00 100.000000 FORMAT "%10.6" EXTENDED_LIMITS -1.00000000E+037 1.00000000E+037 READ_ONLY /end CHARACTERISTIC
/begin CHARACTERISTIC AirCtl_arLimMax_MAP "" MAP 0x8003186C Map_Xr32Yr32Wr32 20.0000000 Area_cm2_float 0.00 20.0000000 FORMAT "%10.7" EXTENDED_LIMITS -1.00000000E+037 1.00000000E+037
 /begin AXIS_DESCR STD_AXIS AirCtl_rPresRat_mp OneToOne 4 0.00 3.00000000 EXTENDED_LIMITS -1.00000000E+037 1.00000000E+037 DEPOSIT ABSOLUTE /end AXIS_DESCR
 /begin AXIS_DESCR STD_AXIS AirCtl_dmEGRPreCtlReal_mp AirMassPerTime_float 4 0.00 1400.00000 FORMAT "%10.5" EXTENDED_LIMITS -1.00000000E+037 1.00000000E+037 DEPOSIT ABSOLUTE /end AXIS_DESCR
/end CHARACTERISTIC
/begin CHARACTERISTIC AirCtl_facEGRPreCtl_C "" VALUE 0x800318D4 Val_Ws16 2.000000 Fact 0.00 2.000000 EXTENDED_LIMITS -4.000000 3.999878 /end CHARACTERISTIC
/begin CHARACTERISTIC AirCtl_rEGRPreCtlInv_CUR "" CURVE 0x800318D8 Cur_Xr32Wr32 95.0000000 Pos_Prc_float 0.00 95.0000000 FORMAT "%10.7" EXTENDED_LIMITS -1.00000000E+037 1.00000000E+037
 /begin AXIS_DESCR STD_AXIS AirCtl_arEffEGRFlt_mp Area_cm2_float 10 0.00 20.0000000 FORMAT "%10.7" EXTENDED_LIMITS -1.00000000E+037 1.00000000E+037 DEPOSIT ABSOLUTE /end AXIS_DESCR
/end CHARACTERISTIC
/begin CHARACTERISTIC AirCtl_rEGRPreCtlMax_C "" VALUE 0x8003192C Val_Ws16 100.0000 Prc 0.00 100.0000 EXTENDED_LIMITS -400.0000 399.9878 /end CHARACTERISTIC
/begin CHARACTERISTIC AirCtl_rEGRPreCtlMin_C "" VALUE 0x8003192E Val_Ws16 100.0000 Prc 0.00 100.0000 EXTENDED_LIMITS -400.0000 399.9878 /end CHARACTERISTIC
/begin CHARACTERISTIC AirCtl_stEGRPreCtlCoEOMMsk_C "" VALUE 0x80031930 Val_Wu32 4294967295.00 OneToOne 0.00 4294967295.00 /end CHARACTERISTIC
/begin CHARACTERISTIC AirCtl_swtEGRPreCtl_C "" VALUE 0x80031934 Val_Wu8 1.000 OneToOne 0.00 1.000 EXTENDED_LIMITS 0.00 255.0 /end CHARACTERISTIC
/begin CHARACTERISTIC AirCtl_swtQntCtl_C "" VALUE 0x80031854 Val_Wu8 1.000 OneToOne 0.00 1.000 EXTENDED_LIMITS 0.00 255.0 /end CHARACTERISTIC
/begin CHARACTERISTIC AirCtl_swtQntDes_C "" VALUE 0x80031855 Val_Wu8 1.000 OneToOne 0.00 1.000 EXTENDED_LIMITS 0.00 255.0 /end CHARACTERISTIC
/begin CHARACTERISTIC AirCtl_swtQntGov_C "" VALUE 0x80031856 Val_Wu8 1.000 OneToOne 0.00 1.000 EXTENDED_LIMITS 0.00 255.0 /end CHARACTERISTIC
/begin CHARACTERISTIC AirCtl_swtQntMon_C "" VALUE 0x80031857 Val_Wu8 1.000 OneToOne 0.00 1.000 EXTENDED_LIMITS 0.00 255.0 /end CHARACTERISTIC
/begin CHARACTERISTIC AirCtl_swtTrqInrCtl_C "" VALUE 0x80031858 Val_Wu8 1.000 OneToOne 0.00 1.000 EXTENDED_LIMITS 0.00 255.0 /end CHARACTERISTIC
/begin CHARACTERISTIC AirCtl_swtTrqInrDes_C "" VALUE 0x80031859 Val_Wu8 1.000 OneToOne 0.00 1.000 EXTENDED_LIMITS 0.00 255.0 /end CHARACTERISTIC
/begin CHARACTERISTIC AirCtl_swtTrqInrGov_C "" VALUE 0x8003185A Val_Wu8 1.000 OneToOne 0.00 1.000 EXTENDED_LIMITS 0.00 255.0 /end CHARACTERISTIC
/begin CHARACTERISTIC AirCtl_swtTrqInrMon_C "" VALUE 0x8003185B Val_Wu8 1.000 OneToOne 0.00 1.000 EXTENDED_LIMITS 0.00 255.0 /end CHARACTERISTIC
/begin CHARACTERISTIC AirCtl_tiEffEGRPT1_C "" VALUE 0x80031938 Val_Wr32 1.00000000 Time_s_float 0.00 1.00000000 FORMAT "%10.8" EXTENDED_LIMITS -1.00000000E+037 1.00000000E+037 /end CHARACTERISTIC
/begin CHARACTERISTIC AirCtl_tiPT1EGRPreCtl_C "" VALUE 0x8003193C Val_Ws32 999.89238556 TimeDelay_ms 0.099999999907 999.99238556 FORMAT "%12.7" EXTENDED_LIMITS 0.0020000000009 4294967.2960 /end CHARACTERISTIC
/begin CHARACTERISTIC Air_dmAFSFrsh_MAP "" MAP 0x8002BE3C Map_Xs16Ys16Ws16 1000.000 AirMassPerTime 0.00 1000.000 EXTENDED_LIMITS -3276.800 3276.700
 /begin AXIS_DESCR STD_AXIS AFS_dm AirMassPerTime 8 0.00 1000.000 EXTENDED_LIMITS -3276.800 3276.700 DEPOSIT ABSOLUTE /end AXIS_DESCR
 /begin AXIS_DESCR STD_AXIS VehV_v Vel 8 0.00 300.0000 EXTENDED_LIMITS -327.6800 327.6700 DEPOSIT ABSOLUTE /end AXIS_DESCR
/end CHARACTERISTIC
/begin CHARACTERISTIC Air_IWinAFSt.Ki_C "/" VALUE 0x8002BEE0 Kw_Ws32 4.99980524182 Ki_Amph2Am 0.00 4.99980524182 FORMAT "%13.11" EXTENDED_LIMITS -1000000.00000 999999.999534 /end CHARACTERISTIC
/begin CHARACTERISTIC Air_IWinAFSt.KiPos_C "/" VALUE 0x8002BEE4 Kw_Ws32 4.99980524182 Ki_Amph2Am 0.00 4.99980524182 FORMAT "%13.11" EXTENDED_LIMITS -1000000.00000 999999.999534 /end CHARACTERISTIC
/begin CHARACTERISTIC Air_IWinAFSt.KiNeg_C "/" VALUE 0x8002BEE8 Kw_Ws32 4.99980524182 Ki_Amph2Am 0.00 4.99980524182 FORMAT "%13.11" EXTENDED_LIMITS -1000000.00000 999999.999534 /end CHARACTERISTIC
/begin CHARACTERISTIC Air_IWinAFSt.WinPos_C "/" VALUE 0x8002BEEC Kw_Ws32 32767.0000000 AirMassPerTime 0.00 32767.0000000 EXTENDED_LIMITS -214748364.800 214748364.700 /end CHARACTERISTIC
/begin CHARACTERISTIC Air_IWinAFSt.WinNeg_C "/" VALUE 0x8002BEF0 Kw_Ws32 32768.0000000 AirMassPerTime -32768.0000000 0.00 EXTENDED_LIMITS -214748364.800 214748364.700 /end CHARACTERISTIC
/begin CHARACTERISTIC Air_mAFSFrshInit_MAP "" MAP 0x8002BEF4 Map_Xs16Ys16Ws16 1000.000 AirMass_kg 0.00 1000.000 FORMAT "%8.3" EXTENDED_LIMITS -3276.800 3276.700
 /begin AXIS_DESCR STD_AXIS Layer_tiEngShOff Time_Sec_One2One 8 0.00 65535.00 FORMAT "%8.2" DEPOSIT ABSOLUTE /end AXIS_DESCR
 /begin AXIS_DESCR STD_AXIS Air_tEngAFSt_mp Temp_Cels 8 -50.04000 198.9600 EXTENDED_LIMITS -3549.940 3003.560 DEPOSIT ABSOLUTE /end AXIS_DESCR
/end CHARACTERISTIC
/begin CHARACTERISTIC Air_mAFSFrshMax_C "" VALUE 0x8002BF98 Val_Ws16 65535.00 AirMass_kg -32768.00 32767.00 FORMAT "%8.2" EXTENDED_LIMITS -3276.800 3276.700 /end CHARACTERISTIC
/begin CHARACTERISTIC Air_mAFSFrshMin_C "" VALUE 0x8002BF9A Val_Ws16 65535.00 AirMass_kg -32768.00 32767.00 FORMAT "%8.2" EXTENDED_LIMITS -3276.800 3276.700 /end CHARACTERISTIC
/begin CHARACTERISTIC Air_mAFSFrshSumHiLim_C "" VALUE 0x8002BF9C Val_Ws16 32767.00 AirMass_kg 0.00 32767.00 FORMAT "%8.2" EXTENDED_LIMITS -3276.800 3276.700 /end CHARACTERISTIC
/begin CHARACTERISTIC Air_mAFSFrshSumLoLim_C "" VALUE 0x8002BF9E Val_Ws16 32767.00 AirMass_kg 0.00 32767.00 FORMAT "%8.2" EXTENDED_LIMITS -3276.800 3276.700 /end CHARACTERISTIC
/begin CHARACTERISTIC Air_numEngTempAFSt_C "" VALUE 0x8002BFA0 Val_Wu8 255.0 OneToOne 0.00 255.0 /end CHARACTERISTIC
/begin CHARACTERISTIC Air_rDtyCycMaxTAFS_C "" VALUE 0x800632AC Val_Ws16 655.3500 DtyCyc -327.6800 327.6700 /end CHARACTERISTIC
/begin CHARACTERISTIC Air_rDtyCycMinTAFS_C "" VALUE 0x800632AE Val_Ws16 655.3500 DtyCyc -327.6800 327.6700 /end CHARACTERISTIC
/begin CHARACTERISTIC Air_RmpSlpTAFS.Pos_C "/" VALUE 0x800632FC Kw_Ws32 3276798.99750 RmpTemp 1.00097656250 3276799.99847 FORMAT "%13.5" EXTENDED_LIMITS -3276800.00000 3276799.99847 /end CHARACTERISTIC
/begin CHARACTERISTIC Air_RmpSlpTAFS.Neg_C "/" VALUE 0x80063300 Kw_Ws32 3276798.99750 RmpTemp 1.00097656250 3276799.99847 FORMAT "%13.5" EXTENDED_LIMITS -3276800.00000 3276799.99847 /end CHARACTERISTIC
/begin CHARACTERISTIC Air_swtSelHFMSrc_C "" VALUE 0x80063304 Val_Wu8 1.000 OneToOne 0.00 1.000 EXTENDED_LIMITS 0.00 255.0 /end CHARACTERISTIC
/begin CHARACTERISTIC Air_tAFSPlausInit_C "" VALUE 0x8002BFA2 Val_Ws16 250.0000 Temp_Cels -50.14000 199.8600 EXTENDED_LIMITS -3549.940 3003.560 /end CHARACTERISTIC
/begin CHARACTERISTIC Air_tDiffLim_C "" VALUE 0x8002BFA4 Val_Ws16 250.0000 TempDiff_Cels -50.10000 199.9000 FORMAT "%8.4" EXTENDED_LIMITS -3276.800 3276.700 /end CHARACTERISTIC
/begin CHARACTERISTIC Air_tiPT1TAFS_C "" VALUE 0x8002BFA8 Val_Ws32 4294.8272945 TimeDelay_s 0.14000154169 4294.9672960 FORMAT "%12.7" EXTENDED_LIMITS 0.000002000000001 4294.9672960 /end CHARACTERISTIC
/begin CHARACTERISTIC Air_tiRefSigPerMaxTAFS_C "" VALUE 0x800632B0 Val_Ws32 214748.364750 Time_Period_HFM6 -107374.182400 107374.182350 FORMAT "%13.6" /end CHARACTERISTIC
/begin CHARACTERISTIC Air_tiRefSigPerMinTAFS_C "" VALUE 0x800632B4 Val_Ws32 214748.364750 Time_Period_HFM6 -107374.182400 107374.182350 FORMAT "%13.6" /end CHARACTERISTIC
/begin CHARACTERISTIC Air_TransStgTAFS.Dfl_C "/" VALUE 0x80063306 Kw_Ws16 250.0000 Temp_Cels -50.04000 199.9600 EXTENDED_LIMITS -3549.940 3003.560 /end CHARACTERISTIC
/begin CHARACTERISTIC Air_TransStgTAFS.stSensId_C "/" VALUE 0x80063308 Kw_Wu8 5.000 OneToOne 0.00 5.000 EXTENDED_LIMITS 0.00 255.0 /end CHARACTERISTIC
/begin CHARACTERISTIC Air_tT0HiLim_C "" VALUE 0x8002BFAC Val_Ws16 250.0000 Temp_Cels -50.14000 199.8600 EXTENDED_LIMITS -3549.940 3003.560 /end CHARACTERISTIC
/begin CHARACTERISTIC Air_tT0LoLim_C "" VALUE 0x8002BFAE Val_Ws16 250.0000 Temp_Cels -50.14000 199.8600 EXTENDED_LIMITS -3549.940 3003.560 /end CHARACTERISTIC
/begin CHARACTERISTIC Air_tTransfTAFS_CUR "" CURVE 0x800632B8 Cur_Xs16Ws16 250.0000 Temp_Cels -50.04000 199.9600 EXTENDED_LIMITS -3549.940 3003.560
 /begin AXIS_DESCR STD_AXIS Air_rRawTAFS DtyCyc 16 0.00 5200.000 EXTENDED_LIMITS -327.6800 327.6700 DEPOSIT ABSOLUTE /end AXIS_DESCR
/end CHARACTERISTIC
/begin CHARACTERISTIC Com_ctHeatACSelfRec_C "" VALUE 0x800379D4 Val_Wu8 255.0 OneToOne 0.00 255.0 /end CHARACTERISTIC
/begin CHARACTERISTIC Com_facTrqAC_MAP "" MAP 0x800379DC Map_Xs16Ys16Ws16 10.00000 Fact100 0.00 10.00000 FORMAT "%8.5" EXTENDED_LIMITS -327.6800 327.6700
 /begin AXIS_DESCR STD_AXIS Com_trqAC Trq 4 -3276.800 3276.700 DEPOSIT ABSOLUTE /end AXIS_DESCR
 /begin AXIS_DESCR STD_AXIS Epm_nEng EngN 4 -16384.00 16383.50 DEPOSIT ABSOLUTE /end AXIS_DESCR
/end CHARACTERISTIC
/begin CHARACTERISTIC Com_stMskHeatACSig_C "" VALUE 0x800379D6 Val_Wu16 65535.00 OneToOne 0.00 65535.00 /end CHARACTERISTIC
/begin CHARACTERISTIC Com_swtACDemand_FA_C "" VALUE 0x80037A10 Val_Wu8 255.0 OneToOne 0.00 255.0 /end CHARACTERISTIC
/begin CHARACTERISTIC Com_swtHeatAC_C "" VALUE 0x800379D8 Val_Wu8 1.000 OneToOne 0.00 1.000 EXTENDED_LIMITS 0.00 255.0 /end CHARACTERISTIC
/begin CHARACTERISTIC Com_swtStatACFront_FA_C "" VALUE 0x80037A11 Val_Wu8 255.0 OneToOne 0.00 255.0 /end CHARACTERISTIC
/begin CHARACTERISTIC Com_tiHeatACSelfRec_C "" VALUE 0x800379DA Val_Ws16 327670.0 Time_ms 0.00 327670.0 EXTENDED_LIMITS -327680.0 327670.0 /end CHARACTERISTIC
/begin CHARACTERISTIC KF_PMRIBAT1 "Kennfeld Innenwiderstand Batterie" MAP 0x80062EF0 MapTKF_UW_SW_UB 0.25500 Def_f_ub_q0p001 0.00 0.25500 FORMAT "%7.5"
 /begin AXIS_DESCR STD_AXIS T_batt Def_t_sw_q0p1 4 -3276.8 3276.7 FORMAT "%6.1" DEPOSIT ABSOLUTE /end AXIS_DESCR
 /begin AXIS_DESCR STD_AXIS I_batt Def_i_uw_q0p08_o200 6 -200.0000 5042.800 FORMAT "%8.3" DEPOSIT ABSOLUTE /end AXIS_DESCR
/end CHARACTERISTIC
/begin CHARACTERISTIC KF_PMRIBAT2 "Kennfeld Innenwiderstand Batterie2" MAP 0x80062F1E MapTKF_UW_SW_UB 0.25500 Def_f_ub_q0p001 0.00 0.25500 FORMAT "%7.5"
 /begin AXIS_DESCR STD_AXIS T_batt Def_t_sw_q0p1 4 -3276.8 3276.7 FORMAT "%6.1" DEPOSIT ABSOLUTE /end AXIS_DESCR
 /begin AXIS_DESCR STD_AXIS I_batt Def_i_uw_q0p08_o200 6 -200.0000 5042.800 FORMAT "%8.3" DEPOSIT ABSOLUTE /end AXIS_DESCR
/end CHARACTERISTIC
/begin CHARACTERISTIC KF_PMRIBAT3 "Kennfeld Innenwiderstand Batterie3" MAP 0x80062F4C MapTKF_UW_SW_UB 0.25500 Def_f_ub_q0p001 0.00 0.25500 FORMAT "%7.5"
 /begin AXIS_DESCR STD_AXIS T_batt Def_t_sw_q0p1 4 -3276.8 3276.7 FORMAT "%6.1" DEPOSIT ABSOLUTE /end AXIS_DESCR
 /begin AXIS_DESCR STD_AXIS I_batt Def_i_uw_q0p08_o200 6 -200.0000 5042.800 FORMAT "%8.3" DEPOSIT ABSOLUTE /end AXIS_DESCR
/end CHARACTERISTIC
/begin CHARACTERISTIC KF_PMRIBAT4 "Kennfeld Innenwiderstand Batterie4" MAP 0x80062F7A MapTKF_UW_SW_UB 0.25500 Def_f_ub_q0p001 0.00 0.25500 FORMAT "%7.5"
 /begin AXIS_DESCR STD_AXIS T_batt Def_t_sw_q0p1 4 -3276.8 3276.7 FORMAT "%6.1" DEPOSIT ABSOLUTE /end AXIS_DESCR
 /begin AXIS_DESCR STD_AXIS I_batt Def_i_uw_q0p08_o200 6 -200.0000 5042.800 FORMAT "%8.3" DEPOSIT ABSOLUTE /end AXIS_DESCR
/end CHARACTERISTIC
/begin CHARACTERISTIC KF_PMRIBAT5 "Kennfeld Innenwiderstand Batterie5" MAP 0x80062FA8 MapTKF_UW_SW_UB 0.25500 Def_f_ub_q0p001 0.00 0.25500 FORMAT "%7.5"
 /begin AXIS_DESCR STD_AXIS T_batt Def_t_sw_q0p1 4 -3276.8 3276.7 FORMAT "%6.1" DEPOSIT ABSOLUTE /end AXIS_DESCR
 /begin AXIS_DESCR STD_AXIS I_batt Def_i_uw_q0p08_o200 6 -200.0000 5042.800 FORMAT "%8.3" DEPOSIT ABSOLUTE /end AXIS_DESCR
/end CHARACTERISTIC
/begin CHARACTERISTIC KF_PMRIBAT6 "Kennfeld Innenwiderstand Batterie6" MAP 0x80062FD6 MapTKF_UW_SW_UB 0.25500 Def_f_ub_q0p001 0.00 0.25500 FORMAT "%7.5"
 /begin AXIS_DESCR STD_AXIS T_batt Def_t_sw_q0p1 4 -3276.8 3276.7 FORMAT "%6.1" DEPOSIT ABSOLUTE /end AXIS_DESCR
 /begin AXIS_DESCR STD_AXIS I_batt Def_i_uw_q0p08_o200 6 -200.0000 5042.800 FORMAT "%8.3" DEPOSIT ABSOLUTE /end AXIS_DESCR
/end CHARACTERISTIC
/begin CHARACTERISTIC KF_PMRIBAT7 "Kennfeld Innenwiderstand Batterie7" MAP 0x80063004 MapTKF_UW_SW_UB 0.25500 Def_f_ub_q0p001 0.00 0.25500 FORMAT "%7.5"
 /begin AXIS_DESCR STD_AXIS T_batt Def_t_sw_q0p1 4 -3276.8 3276.7 FORMAT "%6.1" DEPOSIT ABSOLUTE /end AXIS_DESCR
 /begin AXIS_DESCR STD_AXIS I_batt Def_i_uw_q0p08_o200 6 -200.0000 5042.800 FORMAT "%8.3" DEPOSIT ABSOLUTE /end AXIS_DESCR
/end CHARACTERISTIC
/begin CHARACTERISTIC KF_PMRIBAT8 "Kennfeld Innenwiderstand Batterie8" MAP 0x80063032 MapTKF_UW_SW_UB 0.25500 Def_f_ub_q0p001 0.00 0.25500 FORMAT "%7.5"
 /begin AXIS_DESCR STD_AXIS T_batt Def_t_sw_q0p1 4 -3276.8 3276.7 FORMAT "%6.1" DEPOSIT ABSOLUTE /end AXIS_DESCR
 /begin AXIS_DESCR STD_AXIS I_batt Def_i_uw_q0p08_o200 6 -200.0000 5042.800 FORMAT "%8.3" DEPOSIT ABSOLUTE /end AXIS_DESCR
/end CHARACTERISTIC
/begin CHARACTERISTIC KF_SOC0UBIB "Hier koennte Ihr Langbezeichner stehen" MAP 0x80062E50 MapTKF_SW_UW_UW 99.99847 Def_f_uw_b100 0.00 99.99847
 /begin AXIS_DESCR STD_AXIS Ubatt0 Def_u_uw_q0p25em3_o6 3 6.0000000 22.383750 FORMAT "%9.6" DEPOSIT ABSOLUTE /end AXIS_DESCR
 /begin AXIS_DESCR STD_AXIS Isoc0loc Def_i_sw_q0p001 5 -32.76800 32.76700 FORMAT "%8.5" DEPOSIT ABSOLUTE /end AXIS_DESCR
/end CHARACTERISTIC
/begin CHARACTERISTIC KF_SOCLF "Ladefaktor in Abhängigkeit von Temperatur und Ladezustand" MAP 0x80062E80 MapTKF_UW_SW_UB 3.969 Def_f_ub_b4 0.01563 3.984 EXTENDED_LIMITS 0.00 3.984
 /begin AXIS_DESCR STD_AXIS T_batt Def_t_sw_q0p1 3 -3276.8 3276.7 FORMAT "%6.1" DEPOSIT ABSOLUTE /end AXIS_DESCR
 /begin AXIS_DESCR STD_AXIS Soc_b_loc Def_f_uw_b100 3 0.00 99.99847 DEPOSIT ABSOLUTE /end AXIS_DESCR
/end CHARACTERISTIC
/begin CHARACTERISTIC KL_CLASS2IND "Hier koennte Ihr Langbezeichner stehen" CURVE 0x80062E98 CurTKL_UB_VV_UB 255. Def_ql_ub_q1 0.00 255. FORMAT "%4.0"
 /begin AXIS_DESCR STD_AXIS Batt_class Def_dez_ub_q1 8 0.00 255. FORMAT "%3.0" DEPOSIT ABSOLUTE /end AXIS_DESCR
/end CHARACTERISTIC
/begin CHARACTERISTIC KL_CLASS2NENN "Hier koennte Ihr Langbezeichner stehen" CURVE 0x80062EAA CurTKL_UB_VV_UB 255. Def_ql_ub_q1 0.00 255. FORMAT "%4.0"
 /begin AXIS_DESCR STD_AXIS Batt_class Def_dez_ub_q1 8 0.00 255. FORMAT "%3.0" DEPOSIT ABSOLUTE /end AXIS_DESCR
/end CHARACTERISTIC
/begin CHARACTERISTIC KL_DFPRIO "Dffgen Prio Übersetzer" CURVE 0x800631B8 CurTKL_UB_VV_SB 255. Def_dez_sb_q1 -128. 127. FORMAT "%3.0"
 /begin AXIS_DESCR STD_AXIS Dfpt1filt Def_f_ub_b100 6 0.00 99.61 DEPOSIT ABSOLUTE /end AXIS_DESCR
/end CHARACTERISTIC
/begin CHARACTERISTIC KL_DFPTC "Gefiltertes dffgen -> Prio_Gewichtung -Übersetzer" CURVE 0x800631C6 CurTKL_UB_VV_SB 255. Def_dez_sb_q1 -128. 127. FORMAT "%3.0"
 /begin AXIS_DESCR STD_AXIS Dfpt1ptc Def_f_ub_b100 6 0.00 99.61 DEPOSIT ABSOLUTE /end AXIS_DESCR
/end CHARACTERISTIC
/begin CHARACTERISTIC KL_DSOCPRIO "Hier koennte Ihr Langbezeichner stehen" CURVE 0x800631D4 CurTKL_SW_VV_UB 99.61 Def_f_ub_b100 0.00 99.61
 /begin AXIS_DESCR STD_AXIS D_soc Def_f_sw_b100 5 -100.0000 99.99695 FORMAT "%8.4" DEPOSIT ABSOLUTE /end AXIS_DESCR
/end CHARACTERISTIC
/begin CHARACTERISTIC KL_FITGRZ "Grenzwert für soc_fit" CURVE 0x8006307A CurTKL_SW_VV_UW 99.99847 Def_f_uw_b100 0.00 99.99847
 /begin AXIS_DESCR STD_AXIS T_saison Def_t_sw_q0p1 4 -3276.8 3276.7 FORMAT "%6.1" DEPOSIT ABSOLUTE /end AXIS_DESCR
/end CHARACTERISTIC
/begin CHARACTERISTIC KL_ITNSTART "Startspannung abh. vom Itnstart" CURVE 0x800630F0 CurTKL_UB_VV_UW 16.383750 Def_u_uw_q0p25em3_o6 6.0000000 22.383750 FORMAT "%9.6"
 /begin AXIS_DESCR STD_AXIS X_KL_ITNSTART_no_input_quantity Def_i_ub_b1000 4 0.00 996.09 DEPOSIT ABSOLUTE /end AXIS_DESCR
/end CHARACTERISTIC
/begin CHARACTERISTIC KL_ITNSTRMSA "bei MSA-STarter: Startspannung abh. vom Itnstart" CURVE 0x800630FE CurTKL_UB_VV_UW 16.383750 Def_u_uw_q0p25em3_o6 6.0000000 22.383750 FORMAT "%9.6"
 /begin AXIS_DESCR STD_AXIS X_KL_ITNSTRMSA_no_input_quantity Def_i_ub_b1000 4 0.00 996.09 DEPOSIT ABSOLUTE /end AXIS_DESCR
/end CHARACTERISTIC
/begin CHARACTERISTIC KL_PMSOCVU "SoC-Wert aus der Fitberechnung" CURVE 0x80063060 CurTKL_UW_VV_UW 99.99847 Def_f_uw_b100 0.00 99.99847
 /begin AXIS_DESCR STD_AXIS U_llfit Def_u_uw_q0p25em3_o6 3 6.0000000 22.383750 FORMAT "%9.6" DEPOSIT ABSOLUTE /end AXIS_DESCR
/end CHARACTERISTIC
/begin CHARACTERISTIC KL_PRIO2PTC "Hier koennte Ihr Langbezeichner stehen" CURVE 0x800631E6 CurTKL_UB_VV_UB 127.5 Def_f_ub_b127p5 0.00 127.5 FORMAT "%5.1" /begin AXIS_DESCR STD_AXIS Df_pi Def_f_ub_b100 5 0.00 99.61 DEPOSIT ABSOLUTE /end AXIS_DESCR /end CHARACTERISTIC
/begin CHARACTERISTIC KL_PTC "PWM-Übersetzer für PTC-Ansteuerung" CURVE 0x800631F2 CurTKL_UB_VV_UB 127.5 Def_f_ub_b127p5 0.00 127.5 FORMAT "%5.1"
 /begin AXIS_DESCR STD_AXIS Allptcfilt Def_f_ub_b100 5 0.00 99.61 DEPOSIT ABSOLUTE /end AXIS_DESCR
/end CHARACTERISTIC
/begin CHARACTERISTIC KL_PWRDF "Hier koennte Ihr Langbezeichner stehen" CURVE 0x800631FE CurTKL_UB_VV_UB 13. Def_dez_ub_q1 0.00 13. FORMAT "%3.0" EXTENDED_LIMITS 0.00 255.
 /begin AXIS_DESCR STD_AXIS Df_pi Def_f_ub_b100 14 0.00 99.61 DEPOSIT ABSOLUTE /end AXIS_DESCR
/end CHARACTERISTIC
/begin CHARACTERISTIC KL_SOC0TEMP "Temperaturabhängige Stromkorrektur für Ruhespannungsmessung" CURVE 0x80062EBC CurTKL_SW_VV_UB 1.9922 Def_f_ub_b2 0.00 1.9922
 /begin AXIS_DESCR STD_AXIS T_battsoc0 Def_t_sw_q0p1 5 -3276.8 3276.7 FORMAT "%6.1" DEPOSIT ABSOLUTE /end AXIS_DESCR
/end CHARACTERISTIC
/begin CHARACTERISTIC KL_SOCPRIO "dsoc -> Prio Übersetzer" CURVE 0x8006321C CurTKL_SW_VV_UB 3.0000 Def_dez_ub_q0p5 0.00 3.0000 FORMAT "%6.4" EXTENDED_LIMITS 0.00 127.50
 /begin AXIS_DESCR STD_AXIS D_soc Def_f_sw_b100 4 -100.0000 99.99695 FORMAT "%8.4" DEPOSIT ABSOLUTE /end AXIS_DESCR
/end CHARACTERISTIC
/begin CHARACTERISTIC KL_SSOC "soc_s in Abh. von tsaison" CURVE 0x8006308C CurTKL_SW_VV_UW 99.99847 Def_f_uw_b100 0.00 99.99847
 /begin AXIS_DESCR STD_AXIS T_saison Def_t_sw_q0p1 4 -3276.8 3276.7 FORMAT "%6.1" DEPOSIT ABSOLUTE /end AXIS_DESCR
/end CHARACTERISTIC
/begin CHARACTERISTIC KL_SSOC_DIF "Abstand zwischen oberer und unterer Startfähigkeitsgrenze" CURVE 0x8006309E CurTKL_SW_VV_UW 99.99847 Def_f_uw_b100 0.00 99.99847
 /begin AXIS_DESCR STD_AXIS T_saison Def_t_sw_q0p1 4 -3276.8 3276.7 FORMAT "%6.1" DEPOSIT ABSOLUTE /end AXIS_DESCR
/end CHARACTERISTIC
/begin CHARACTERISTIC KL_UTSTART "Startspannung in Abhängigkeit von Temperatur Batterie" CURVE 0x8006310C CurTKL_SW_VV_SW 16.383750 Def_u_sw_q0p00025 -8.1920000 8.1917500
 /begin AXIS_DESCR STD_AXIS T_batt Def_t_sw_q0p1 4 -3276.8 3276.7 FORMAT "%6.1" DEPOSIT ABSOLUTE /end AXIS_DESCR
/end CHARACTERISTIC
/begin CHARACTERISTIC KL_UTSTRTMSA "bei MSA Starter: Startspannung in Abhängigkeit von Temperatur Batterie" CURVE 0x8006311E CurTKL_SW_VV_SW 16.383750 Def_u_sw_q0p00025 -8.1920000 8.1917500
 /begin AXIS_DESCR STD_AXIS T_batt Def_t_sw_q0p1 4 -3276.8 3276.7 FORMAT "%6.1" DEPOSIT ABSOLUTE /end AXIS_DESCR
/end CHARACTERISTIC
/begin CHARACTERISTIC K_ABSCHKORA "Applikationswert für Korrektur Abschaltung" VALUE 0x800630B0 Val_Ws16 99.99847 Def_f_sw_q0p00153 -50.00000 49.99847 /end CHARACTERISTIC
/begin CHARACTERISTIC K_BATTCNENN1 "Parameter für Erkennung AGM durch Vergleich mit C_battnenn (Reserve)" VALUE 0x80062ECE Val_Wu8 255. Def_dez_ub_q1 0.00 255. FORMAT "%3.0" /end CHARACTERISTIC
/begin CHARACTERISTIC K_BATTCNENN2 "Parameter für Erkennung AGM durch Vergleich mit C_battnenn (Reserve)" VALUE 0x80062ECF Val_Wu8 255. Def_dez_ub_q1 0.00 255. FORMAT "%3.0" /end CHARACTERISTIC
/begin CHARACTERISTIC K_BATTINDAPP "batt_index appl." VALUE 0x80062ED0 Val_Wu8 255. Def_dez_ub_q1 0.00 255. FORMAT "%3.0" /end CHARACTERISTIC
/begin CHARACTERISTIC K_BATTTAAPP "Batterietausch Applikationswert" VALUE 0x80062E38 Val_Wu16 65535. Def_dez_uw_q1 0.00 65535. FORMAT "%5.0" /end CHARACTERISTIC
/begin CHARACTERISTIC K_BILA_OGRZ "Grenzwert oberhalb dessen eine Apassung durch soc_kor nicht zulässig ist" VALUE 0x800630B2 Val_Wu16 99.99847 Def_f_uw_b100 0.00 99.99847 /end CHARACTERISTIC
/begin CHARACTERISTIC K_BILA_UGRZ "Grenzwert unterhalb dessen eine Apassung durch soc_kor nicht zulässig ist" VALUE 0x800630B4 Val_Wu16 99.99847 Def_f_uw_b100 0.00 99.99847 /end CHARACTERISTIC
/begin CHARACTERISTIC K_BNSCTRINC "Konstante Counter Bordnetzspannungsplausibilisierung" VALUE 0x80063132 Val_Wu8 255. Def_dez_ub_q1 0.00 255. FORMAT "%3.0" /end CHARACTERISTIC
/begin CHARACTERISTIC K_BNSMX "Schwelle Bordnetz instabil" VALUE 0x80063133 Val_Wu8 255. Def_dez_ub_q1 0.00 255. FORMAT "%3.0" /end CHARACTERISTIC
/begin CHARACTERISTIC K_BNSUBMAX "Konstante max. Bordnetzspannung" VALUE 0x80063134 Val_Wu8 24.0210 Def_u_ub_q0p0942 0.00 24.0210 /end CHARACTERISTIC
/begin CHARACTERISTIC K_BNSUBMIN "Konstante min. Bordnetzspannung" VALUE 0x80063135 Val_Wu8 24.0210 Def_u_ub_q0p0942 0.00 24.0210 /end CHARACTERISTIC
/begin CHARACTERISTIC K_BNSVFZG "Schwelle geschwindigkeit für BNS" VALUE 0x80063136 Val_Wu16 65535. Def_v_uw_q1p0 0.00 65535. FORMAT "%5.0" /end CHARACTERISTIC
/begin CHARACTERISTIC K_CBATTAPP "Cbattnenn appl." VALUE 0x80062ED1 Val_Wu8 255. Def_ql_ub_q1 0.00 255. FORMAT "%4.0" /end CHARACTERISTIC
/begin CHARACTERISTIC K_CTRCBRAPP "Hier koennte Ihr Langbezeichner stehen" VALUE 0x8006322A Val_Wu8 255. Def_dez_ub_q1 0.00 255. FORMAT "%3.0" /end CHARACTERISTIC
/begin CHARACTERISTIC K_CTRPWRCF "Hier koennte Ihr Langbezeichner stehen" VAL_BLK 0x8006322C ValA_Wu16 65535. Def_dez_uw_q1 0.00 65535. FORMAT "%5.0" NUMBER 4 /end CHARACTERISTIC
/begin CHARACTERISTIC K_CTRPWRCOSAPP "Hier koennte Ihr Langbezeichner stehen" VALUE 0x80063234 Val_Wu16 65535. Def_dez_uw_q1 0.00 65535. FORMAT "%5.0" /end CHARACTERISTIC
/begin CHARACTERISTIC K_CTRPWRDF "Hier koennte Ihr Langbezeichner stehen" VAL_BLK 0x80063236 ValA_Wu16 65535. Def_dez_uw_q1 0.00 65535. FORMAT "%5.0" NUMBER 14 /end CHARACTERISTIC
/begin CHARACTERISTIC K_DAB_KORR1 "Korrekturkonstante 1 für Abschaltung" VALUE 0x800630B6 Val_Ws16 99.99847 Def_f_sw_q0p00153 -50.00000 49.99847 /end CHARACTERISTIC
/begin CHARACTERISTIC K_DAB_KORR2 "Korrekturkonstante 2 für Abschaltung" VALUE 0x800630B8 Val_Ws16 99.99847 Def_f_sw_q0p00153 -50.00000 49.99847 /end CHARACTERISTIC
/begin CHARACTERISTIC K_DAB_KORR3 "Korrekturkonstante 3 für Abschaltung" VALUE 0x800630BA Val_Ws16 99.99847 Def_f_sw_q0p00153 -50.00000 49.99847 /end CHARACTERISTIC
/begin CHARACTERISTIC K_DELAYDOWN "Hier koennte Ihr Langbezeichner stehen" VALUE 0x80063252 Val_Wu16 65534. Def_dez_uw_q1 1.000 65535. FORMAT "%5.0" EXTENDED_LIMITS 0.00 65535. /end CHARACTERISTIC
/begin CHARACTERISTIC K_DELAYUP "Hier koennte Ihr Langbezeichner stehen" VALUE 0x80063254 Val_Wu16 65534. Def_dez_uw_q1 1.000 65535. FORMAT "%5.0" EXTENDED_LIMITS 0.00 65535. /end CHARACTERISTIC
/begin CHARACTERISTIC K_DFFGEN_MX "Maximalwert DF für Berechnung Leitungswiderstand" VALUE 0x80063194 Val_Wu8 99.61 Def_f_ub_b100 0.00 99.61 /end CHARACTERISTIC
/begin CHARACTERISTIC K_DFKOMMERR "Ersatzwert Dffgen bei Gen. Komm. Fehler" VALUE 0x80063256 Val_Wu8 99.61 Def_f_ub_b100 0.00 99.61 /end CHARACTERISTIC
/begin CHARACTERISTIC K_DFPTC_LP "K-Faktor des df-Tiefpass Filters zur Berechnung von PTC" VALUE 0x80063257 Val_Wu8 0.99609 Def_f_ub_b1 0.00 0.99609 FORMAT "%7.5" /end CHARACTERISTIC
/begin CHARACTERISTIC K_DF_LP "K-Faktor des df-Tiefpass Filters zur Berechnung von ctrpwrdf" VALUE 0x80063258 Val_Wu8 0.99609 Def_f_ub_b1 0.00 0.99609 FORMAT "%7.5" /end CHARACTERISTIC
/begin CHARACTERISTIC K_DSOC2A "Applikationsgrösse für d_soc" VALUE 0x800630BC Val_Ws16 199.9969 Def_f_sw_b100 -100.0000 99.99695 FORMAT "%8.4" /end CHARACTERISTIC
/begin CHARACTERISTIC K_DSOCA "Applikationsgrösse für d_soc" VALUE 0x800630BE Val_Ws16 199.9969 Def_f_sw_b100 -100.0000 99.99695 FORMAT "%8.4" /end CHARACTERISTIC
/begin CHARACTERISTIC K_DSOCMSADG1 "D_soc Grenze 1 für Ermittlung gemittelte Startspannungslage abh. von D_soc und Zeit MsaStop" VALUE 0x80062E3A Val_Ws16 199.9969 Def_f_sw_b100 -100.0000 99.99695 FORMAT "%8.4" /end CHARACTERISTIC
/begin CHARACTERISTIC K_DSOCMSADG2 "D_soc Grenze 2 für Ermittlung gemittelte Startspannungslage abh. von D_soc und Zeit MsaStop" VALUE 0x80062E3C Val_Ws16 199.9969 Def_f_sw_b100 -100.0000 99.99695 FORMAT "%8.4" /end CHARACTERISTIC
/begin CHARACTERISTIC K_DSOCMSADG3 "D_soc Grenze 3 für Ermittlung gemittelte Startspannungslage abh. von D_soc und Zeit MsaStop" VALUE 0x80062E3E Val_Ws16 199.9969 Def_f_sw_b100 -100.0000 99.99695 FORMAT "%8.4" /end CHARACTERISTIC
/begin CHARACTERISTIC K_DSOCMSADG4 "D_soc Grenze 4 für Ermittlung gemittelte Startspannungslage abh. von D_soc und Zeit MsaStop" VALUE 0x80062E40 Val_Ws16 199.9969 Def_f_sw_b100 -100.0000 99.99695 FORMAT "%8.4" /end CHARACTERISTIC
/begin CHARACTERISTIC K_DTBL "Zeitkonstante Entprellung Bremslicht Spannung (zur Berechnung Prio Spannungswächter)" VALUE 0x80063138 Val_Wu16 655.350 Def_td_uw_q0p01 0.00 655.350 FORMAT "%7.3" /end CHARACTERISTIC
/begin CHARACTERISTIC K_DTELUE "Zeitkonstante Entprellung Elektr Lüfter Spannung (zur Berechnung Prio Spannungswächter)" VALUE 0x8006313A Val_Wu16 655.350 Def_td_uw_q0p01 0.00 655.350 FORMAT "%7.3" /end CHARACTERISTIC
/begin CHARACTERISTIC K_DTEWP "Zeitkonstante Entprellung Elektr Wasserpumpe Spannung (zur Berechnung Prio Spannungswächter)" VALUE 0x8006313C Val_Wu16 655.350 Def_td_uw_q0p01 0.00 655.350 FORMAT "%7.3" /end CHARACTERISTIC
/begin CHARACTERISTIC K_DT_EPS "Zeitverzögerung Ausgabe EPS MinPrio" VALUE 0x8006313E Val_Wu16 655.350 Def_td_uw_q0p01 0.00 655.350 FORMAT "%7.3" /end CHARACTERISTIC
/begin CHARACTERISTIC K_DT_GEBL "Zeitkonstante Entprellung Gebläse Spannung (zur Berechnung Prio Spannungswächter)" VALUE 0x80063140 Val_Wu16 655.350 Def_td_uw_q0p01 0.00 655.350 FORMAT "%7.3" /end CHARACTERISTIC
/begin CHARACTERISTIC K_DT_KRAPU "Zeitkonstante Entprellung Kraftstoffpumpe Spannung (zur Berechnung Prio Spannungswächter)" VALUE 0x80063142 Val_Wu16 655.350 Def_td_uw_q0p01 0.00 655.350 FORMAT "%7.3" /end CHARACTERISTIC
/begin CHARACTERISTIC K_DT_LICHT "Zeitkonstante Entprellung Gebläse Licht (zur Berechnung Prio Spannungswächter)" VALUE 0x80063144 Val_Wu16 655.350 Def_td_uw_q0p01 0.00 655.350 FORMAT "%7.3" /end CHARACTERISTIC
/begin CHARACTERISTIC K_DT_SLP "Zeitkonstante Entprellung Sekundärluftpumpe Spannung (zur Berechnung Prio Spannungswächter)" VALUE 0x80063146 Val_Wu16 655.350 Def_td_uw_q0p01 0.00 655.350 FORMAT "%7.3" /end CHARACTERISTIC
/begin CHARACTERISTIC K_DT_VBRES1 "Zeitkonstante Entprellung Reserveverbraucher 1 Spannung (zur Berechnung Prio Spannungswächter)" VALUE 0x80063148 Val_Wu16 6553.5 Def_td_uw_q0p1 0.00 6553.5 FORMAT "%6.1" /end CHARACTERISTIC
/begin CHARACTERISTIC K_DT_VBRES2 "Zeitkonstante Entprellung Reserveverbraucher 2 Spannung (zur Berechnung Prio Spannungswächter)" VALUE 0x8006314A Val_Wu16 6553.5 Def_td_uw_q0p1 0.00 6553.5 FORMAT "%6.1" /end CHARACTERISTIC
/begin CHARACTERISTIC K_DT_WISCHER "Zeitkonstante Entprellung Wischer Spannung (zur Berechnung Prio Spannungswächter)" VALUE 0x8006314C Val_Wu16 655.350 Def_td_uw_q0p01 0.00 655.350 FORMAT "%7.3" /end CHARACTERISTIC
/begin CHARACTERISTIC K_ENERGYAPP "Hier koennte Ihr Langbezeichner stehen" VALUE 0x800630C0 Val_Wu8 255. Def_dez_ub_q1 0.00 255. FORMAT "%3.0" /end CHARACTERISTIC
/begin CHARACTERISTIC K_ENTLMAX "Hier koennte Ihr Langbezeichner stehen" VALUE 0x8006325A Val_Wu16 65535. Def_dez_uw_q1 0.00 65535. FORMAT "%5.0" /end CHARACTERISTIC
/begin CHARACTERISTIC K_ENTLTEST "Hier koennte Ihr Langbezeichner stehen" VALUE 0x8006325C Val_Wu8 255. Def_dez_ub_q1 0.00 255. FORMAT "%3.0" /end CHARACTERISTIC
/begin CHARACTERISTIC K_EPS_TRST "Zeitverzögerung" VALUE 0x8006314E Val_Wu16 655.350 Def_td_uw_q0p01 0.00 655.350 FORMAT "%7.3" /end CHARACTERISTIC
/begin CHARACTERISTIC K_EPS_VRST "Geschwindigkeitsschwelle zum Rücksetzen der EPS Bedingung" VALUE 0x80063150 Val_Wu16 65535. Def_v_uw_q1p0 0.00 65535. FORMAT "%5.0" /end CHARACTERISTIC
/begin CHARACTERISTIC K_FACRELSTOP "Gewichtungsfaktor für Berechnung der relativen Häufigkeiten der Stopdauern" VALUE 0x80062E42 Val_Wu8 255. Def_dez_ub_q1 0.00 255. FORMAT "%3.0" /end CHARACTERISTIC
/begin CHARACTERISTIC K_FITDEF "Hier koennte Ihr Langbezeichner stehen" VALUE 0x8006306E Val_Wu16 99.99847 Def_f_uw_b100 0.00 99.99847 /end CHARACTERISTIC
/begin CHARACTERISTIC K_GQVCC "Grenzwert Einschalten CC-Meldung" VALUE 0x800630C1 Val_Wu8 99.61 Def_f_ub_b100 0.00 99.61 /end CHARACTERISTIC
/begin CHARACTERISTIC K_GQVH2OCC "Grenzwert Einschalten CC-Medlung" VALUE 0x800630C2 Val_Wu8 99.61 Def_f_ub_b100 0.00 99.61 /end CHARACTERISTIC
/begin CHARACTERISTIC K_GQVH2OQCC "Grenzwert Einschalten CC-Meldung" VALUE 0x800630C3 Val_Wu8 99.61 Def_f_ub_b100 0.00 99.61 /end CHARACTERISTIC
/begin CHARACTERISTIC K_GQVQUALICC "Grenzwert Einschalten CC-Meldung" VALUE 0x800630C4 Val_Wu8 99.61 Def_f_ub_b100 0.00 99.61 /end CHARACTERISTIC
/begin CHARACTERISTIC K_IGEN_MN "Minwert Generatorstrom für Berechnung Leitungswiderstand" VALUE 0x80063195 Val_Wu8 254.00 Def_i_ub_q1 1.0000 255.00 EXTENDED_LIMITS 0.00 255.00 /end CHARACTERISTIC
/begin CHARACTERISTIC K_IWAKEAPP "Wakeupgrenze Appl." VALUE 0x80062ED2 Val_Wu8 5.100 Def_i_ub_q0p02 0.00 5.100 /end CHARACTERISTIC
/begin CHARACTERISTIC K_I_FITAUSW "Grenzwert Fitstrom" VALUE 0x80063070 Val_Wu16 5242.800 Def_i_uw_q0p08_o200 -200.0000 5042.800 FORMAT "%8.3" /end CHARACTERISTIC
/begin CHARACTERISTIC K_LASTDOWN "Hier koennte Ihr Langbezeichner stehen" VALUE 0x8006325E Val_Wu16 65533. Def_dez_uw_q1 2.000 65535. FORMAT "%5.0" EXTENDED_LIMITS 0.00 65535. /end CHARACTERISTIC
/begin CHARACTERISTIC K_LASTUP "Hier koennte Ihr Langbezeichner stehen" VALUE 0x80063260 Val_Wu16 65533. Def_dez_uw_q1 2.000 65535. FORMAT "%5.0" EXTENDED_LIMITS 0.00 65535. /end CHARACTERISTIC
/begin CHARACTERISTIC K_LTGPL_MN "Minimalwert plausibler Widerstandswert" VALUE 0x80063196 Val_Wu16 1.999908447266 Def_f_uw_b2 0.00 1.999908447266 FORMAT "%14.12" EXTENDED_LIMITS 0.00 1.999969482422 /end CHARACTERISTIC
/begin CHARACTERISTIC K_LTGPL_MX "Maximalwert plausibler Widerstandswert" VALUE 0x80063198 Val_Wu16 1.999908447266 Def_f_uw_b2 0.00 1.999908447266 FORMAT "%14.12" EXTENDED_LIMITS 0.00 1.999969482422 /end CHARACTERISTIC
/begin CHARACTERISTIC K_MAXINFO "Maximaler Wert nach Addition der Stopdauer-Häufigkeiten der aktuellen Fahrt" VALUE 0x80062E43 Val_Wu8 255. Def_dez_ub_q1 0.00 255. FORMAT "%3.0" /end CHARACTERISTIC
/begin CHARACTERISTIC K_MAXINFO1 "Anzahl Stops, größter Wert im Infospeicher" VALUE 0x80062E44 Val_Wu8 255. Def_dez_ub_q1 0.00 255. FORMAT "%3.0" /end CHARACTERISTIC
/begin CHARACTERISTIC K_MCOBATTORT "Codierung Hand Batterieeinbauort" VALUE 0x8006319A Val_Wu8 255. Def_st_ub_q1 0.00 255. FORMAT "%3.0" /end CHARACTERISTIC
/begin CHARACTERISTIC K_MSAAVSTAT "Statuswort der MSA AVs wird mit dieser Größe verglichen, falls ein Bit ausser Bit 4 gesetzt, AV nicht nur von PM" VALUE 0x80062E48 Val_Wu32 4294967295. Def_dez_ul_q1 0.00 4294967295. FORMAT "%7.0" /end CHARACTERISTIC
/begin CHARACTERISTIC K_MX_PTCPI "Maximalwert des PI-Reglers PTC Ansteuerung" VALUE 0x80063262 Val_Wu8 99.61 Def_f_ub_b100 0.00 99.61 /end CHARACTERISTIC
/begin CHARACTERISTIC K_NKW2HIPTC "Nkw i.O. PTC darf zugeschaltet werden." VALUE 0x80063264 Val_Ws16 65535. Def_n_sw_q1p0 -32768. 32767. FORMAT "%5.0" /end CHARACTERISTIC
/begin CHARACTERISTIC K_NKW2LOWPTC "Nkw zu niedrig, PTC wird abgeschaltet" VALUE 0x80063266 Val_Ws16 65535. Def_n_sw_q1p0 -32768. 32767. FORMAT "%5.0" /end CHARACTERISTIC
/begin CHARACTERISTIC K_NKWEPSGRZ "Hier koennte Ihr Langbezeichner stehen" VALUE 0x80063152 Val_Ws16 65535. Def_n_sw_q1p0 -32768. 32767. FORMAT "%5.0" /end CHARACTERISTIC
/begin CHARACTERISTIC K_PMTIMERSQ1 "Startwert Timer für soc_quali" VALUE 0x80063072 Val_Wu16 65535. Def_st_uw_q1 0.00 65535. FORMAT "%5.0" /end CHARACTERISTIC
/begin CHARACTERISTIC K_PM_NOUSEQ "Startwert Timer für soc_quali" VALUE 0x800630C5 Val_Wu8 1.0 Identity 0.00 1.0 EXTENDED_LIMITS 0.00 255. /end CHARACTERISTIC
/begin CHARACTERISTIC K_PM_TABSMN "Applikationsgrösse für Abstellzeit tabsmn_w" VALUE 0x800630C6 Val_Wu16 65535. Def_td_uw_q1 0.00 65535. FORMAT "%5.0" /end CHARACTERISTIC
/begin CHARACTERISTIC K_PRIOREDSV "Array mit jeweiligen Prioritäten reduzierbaren Standverbrauchern" VAL_BLK 0x80063268 ValA_Wu16 65535. Def_dez_uw_q1 0.00 65535. FORMAT "%5.0" NUMBER 15 /end CHARACTERISTIC
/begin CHARACTERISTIC K_PR_BLMN "Applikationwert für Prio Bremslicht min" VALUE 0x80063154 Val_Wu8 255. Def_dez_ub_q1 0.00 255. FORMAT "%3.0" /end CHARACTERISTIC
/begin CHARACTERISTIC K_PR_BNS "Konstante Sollpriorität für Bordnetzstabilität" VALUE 0x80063155 Val_Wu8 255. Def_dez_ub_q1 0.00 255. FORMAT "%3.0" /end CHARACTERISTIC
/begin CHARACTERISTIC K_PR_CRASHSOLL "Konstante Sollpriorität bei Crash" VALUE 0x80063156 Val_Wu8 255. Def_dez_ub_q1 0.00 255. FORMAT "%3.0" /end CHARACTERISTIC
/begin CHARACTERISTIC K_PR_DSCMN "Konstante Sollpriorität" VALUE 0x80063157 Val_Wu8 255. Def_dez_ub_q1 0.00 255. FORMAT "%3.0" /end CHARACTERISTIC
/begin CHARACTERISTIC K_PR_DSCMX "Konstante Sollpriorität DSC max" VALUE 0x80063158 Val_Wu8 255. Def_dez_ub_q1 0.00 255. FORMAT "%3.0" /end CHARACTERISTIC
/begin CHARACTERISTIC K_PR_ELUEMN "Konstante Prio Elüfter min" VALUE 0x80063159 Val_Wu8 255. Def_dez_ub_q1 0.00 255. FORMAT "%3.0" /end CHARACTERISTIC
/begin CHARACTERISTIC K_PR_EPSUMN "Konstante Prio Elektrische Lankhilfe min" VALUE 0x8006315A Val_Wu8 255. Def_dez_ub_q1 0.00 255. FORMAT "%3.0" /end CHARACTERISTIC
/begin CHARACTERISTIC K_PR_EWPMN "Konstante Prio Elektrische Wasserpumpe" VALUE 0x8006315B Val_Wu8 255. Def_dez_ub_q1 0.00 255. FORMAT "%3.0" /end CHARACTERISTIC
/begin CHARACTERISTIC K_PR_GEBMN "Konstante Sollpriorität" VALUE 0x8006315C Val_Wu8 255. Def_dez_ub_q1 0.00 255. FORMAT "%3.0" /end CHARACTERISTIC
/begin CHARACTERISTIC K_PR_KRAPUMN "Konstante Prio Kraftstoffpumpe min" VALUE 0x8006315D Val_Wu8 255. Def_dez_ub_q1 0.00 255. FORMAT "%3.0" /end CHARACTERISTIC
/begin CHARACTERISTIC K_PR_LICHT "Konstante Priorität" VALUE 0x8006315E Val_Wu8 255. Def_dez_ub_q1 0.00 255. FORMAT "%3.0" /end CHARACTERISTIC
/begin CHARACTERISTIC K_PR_SLPMN "Konstante Sollpriorität" VALUE 0x8006315F Val_Wu8 255. Def_dez_ub_q1 0.00 255. FORMAT "%3.0" /end CHARACTERISTIC
/begin CHARACTERISTIC K_PR_UBNQM "Konstante Priorität" VALUE 0x80063160 Val_Wu8 255. Def_dez_ub_q1 0.00 255. FORMAT "%3.0" /end CHARACTERISTIC
/begin CHARACTERISTIC K_PR_VBRES1MN "Konstante Prio Reserveverbraucher 1 min" VALUE 0x80063161 Val_Wu8 255. Def_dez_ub_q1 0.00 255. FORMAT "%3.0" /end CHARACTERISTIC
/begin CHARACTERISTIC K_PR_VBRES1MX "Konstante Prio Reserveverbraucher 1 max" VALUE 0x80063162 Val_Wu8 255. Def_dez_ub_q1 0.00 255. FORMAT "%3.0" /end CHARACTERISTIC
/begin CHARACTERISTIC K_PR_VBRES2MN "Konstante Prio Reserveverbraucher 2 min" VALUE 0x80063163 Val_Wu8 255. Def_dez_ub_q1 0.00 255. FORMAT "%3.0" /end CHARACTERISTIC
/begin CHARACTERISTIC K_PR_VBRES2MX "Konstante Prio Reserveverbraucher 2 max" VALUE 0x80063164 Val_Wu8 255. Def_dez_ub_q1 0.00 255. FORMAT "%3.0" /end CHARACTERISTIC
/begin CHARACTERISTIC K_PR_VBRES3MN "Konstante Prio Reserveverbraucher 3 min" VALUE 0x80063165 Val_Wu8 255. Def_dez_ub_q1 0.00 255. FORMAT "%3.0" /end CHARACTERISTIC
/begin CHARACTERISTIC K_PR_VBRES3MX "Konstante Prio Reserveverbraucher 3 max" VALUE 0x80063166 Val_Wu8 255. Def_dez_ub_q1 0.00 255. FORMAT "%3.0" /end CHARACTERISTIC
/begin CHARACTERISTIC K_PR_VBRES4MN "Konstante Prio Reserveverbraucher 4 min" VALUE 0x80063167 Val_Wu8 255. Def_dez_ub_q1 0.00 255. FORMAT "%3.0" /end CHARACTERISTIC
/begin CHARACTERISTIC K_PR_VBRES4MX "Konstante Prio Reserveverbraucher 4 max" VALUE 0x80063168 Val_Wu8 255. Def_dez_ub_q1 0.00 255. FORMAT "%3.0" /end CHARACTERISTIC
/begin CHARACTERISTIC K_PR_VBRES5MN "Konstante Prio Reserveverbraucher 5 min" VALUE 0x80063169 Val_Wu8 255. Def_dez_ub_q1 0.00 255. FORMAT "%3.0" /end CHARACTERISTIC
/begin CHARACTERISTIC K_PR_VBRES5MX "Konstante Prio Reserveverbraucher 5 max" VALUE 0x8006316A Val_Wu8 255. Def_dez_ub_q1 0.00 255. FORMAT "%3.0" /end CHARACTERISTIC
/begin CHARACTERISTIC K_PR_WISMN "Konstante Priorität Wischer min" VALUE 0x8006316B Val_Wu8 255. Def_dez_ub_q1 0.00 255. FORMAT "%3.0" /end CHARACTERISTIC
/begin CHARACTERISTIC K_PR_WISMX "Konstante Priorität Wischer Max" VALUE 0x8006316C Val_Wu8 255. Def_dez_ub_q1 0.00 255. FORMAT "%3.0" /end CHARACTERISTIC
/begin CHARACTERISTIC K_PT1RLTG_K "Filterzeitkonstante für PT1 Filter Widerstand" VALUE 0x8006319C Val_Wu16 0.9999847412109 Def_f_uw_b1 0.00 0.9999847412109 FORMAT "%15.13" /end CHARACTERISTIC
/begin CHARACTERISTIC K_PTCAPP "Wert Null der ausgegeben wird wenn Ottomotor da kein PTC verbaut" VALUE 0x80063286 Val_Wu8 127.5 Def_f_ub_b127p5 0.00 127.5 FORMAT "%5.1" /end CHARACTERISTIC
/begin CHARACTERISTIC K_PTCOFFOTTO "Wert Null der ausgegeben wird wenn Ottomotor da kein PTC verbaut" VALUE 0x80063287 Val_Wu8 127.5 Def_f_ub_b127p5 0.00 127.5 FORMAT "%5.1" /end CHARACTERISTIC
/begin CHARACTERISTIC K_PTC_PI "K-Faktor des PI-Reglers PTC-Ansteuerung" VALUE 0x80063288 Val_Wu8 0.99609 Def_f_ub_b1 0.00 0.99609 FORMAT "%7.5" /end CHARACTERISTIC
/begin CHARACTERISTIC K_PWRCOS15 "PWRCOS bei Kl.15, Motor aus" VALUE 0x8006328A Val_Wu16 65535. Def_dez_uw_q1 0.00 65535. FORMAT "%5.0" /end CHARACTERISTIC
/begin CHARACTERISTIC K_PWRCOSAPP "Steuerung Leistung Verbraucher bitcodiert Applikationsgroesse" VALUE 0x8006328C Val_Wu16 65535. Def_dez_uw_q1 0.00 65535. FORMAT "%5.0" /end CHARACTERISTIC
/begin CHARACTERISTIC K_PWRCOSHT "ctrpwrcos-Wert bei Generator Hochtemperatur" VALUE 0x8006328E Val_Wu16 65535. Def_dez_uw_q1 0.00 65535. FORMAT "%5.0" /end CHARACTERISTIC
/begin CHARACTERISTIC K_PWRCOSULEV "Bitcodierte ctrpwrcos Zuschaltung bei Sulev" VALUE 0x80063290 Val_Wu16 65535. Def_dez_uw_q1 0.00 65535. FORMAT "%5.0" /end CHARACTERISTIC
/begin CHARACTERISTIC K_PWRCOS_R "PowerCos Bitcodiert bei Kl.R" VALUE 0x80063292 Val_Wu16 65535. Def_dez_uw_q1 0.00 65535. FORMAT "%5.0" /end CHARACTERISTIC
/begin CHARACTERISTIC K_PWRCSGNDEF "ctrpwrcos-Wert bei Gen. mechn. el. Fehler" VALUE 0x80063294 Val_Wu16 65535. Def_dez_uw_q1 0.00 65535. FORMAT "%5.0" /end CHARACTERISTIC
/begin CHARACTERISTIC K_PWRDF_PI "K-Faktor des PI Reglers zur Berechnung von ctrpwrdf" VALUE 0x80063296 Val_Wu8 0.99609 Def_f_ub_b1 0.00 0.99609 FORMAT "%7.5" /end CHARACTERISTIC
/begin CHARACTERISTIC K_QBILA "Hier koennte Ihr Langbezeichner stehen" VALUE 0x80062ED4 Val_Wu32 1193.046400 Def_ql_ul_q2p7Em7 0.00 1193.046400 FORMAT "%11.6" EXTENDED_LIMITS 0.00 1193.046471 /end CHARACTERISTIC
/begin CHARACTERISTIC K_QGES "Hier koennte Ihr Langbezeichner stehen" VALUE 0x80062ED8 Val_Wu16 19088.4 Def_ql_uw_q0p29127 0.00 19088.4 FORMAT "%7.1" EXTENDED_LIMITS 0.00 19087.9 /end CHARACTERISTIC
/begin CHARACTERISTIC K_QOLD "Hier koennte Ihr Langbezeichner stehen" VALUE 0x80062EDA Val_Wu16 1193.023 Def_ql_uw_q0p0182 0.00 1193.023 FORMAT "%8.3" EXTENDED_LIMITS 0.00 1192.750 /end CHARACTERISTIC
/begin CHARACTERISTIC K_QSOCCL1 "Grenze zur Ladezustandsqualitätsklasse1" VALUE 0x800630C8 Val_Wu16 1193.023 Def_ql_uw_q0p0182 0.00 1193.023 FORMAT "%8.3" EXTENDED_LIMITS 0.00 1192.750 /end CHARACTERISTIC
/begin CHARACTERISTIC K_QSOCCL2 "Grenze zur Ladezustandsqualitätsklasse2" VALUE 0x800630CA Val_Wu16 1193.023 Def_ql_uw_q0p0182 0.00 1193.023 FORMAT "%8.3" EXTENDED_LIMITS 0.00 1192.750 /end CHARACTERISTIC
/begin CHARACTERISTIC K_QSOCCL3 "Grenze zur Ladezustandsqualitätsklasse3" VALUE 0x800630CC Val_Wu16 1193.023 Def_ql_uw_q0p0182 0.00 1193.023 FORMAT "%8.3" EXTENDED_LIMITS 0.00 1192.750 /end CHARACTERISTIC
/begin CHARACTERISTIC K_QV_OGRZ "Obergrenze, bei der absch_korr durch QVC angepasst wird" VALUE 0x800630CE Val_Ws16 79.99878 Def_f_sw_q0p00153 -39.99939 39.99939 EXTENDED_LIMITS -50.00000 49.99847 /end CHARACTERISTIC
/begin CHARACTERISTIC K_QV_QGRZ "Qualitätsgrenze, bei der absch_korr durch QVC angepasst wird" VALUE 0x800630D0 Val_Wu8 99.61 Def_f_ub_b100 0.00 99.61 /end CHARACTERISTIC
/begin CHARACTERISTIC K_QV_UGRZ "Untergrenze, bei der absch_korr durch QVC angepasst wird" VALUE 0x800630D2 Val_Ws16 79.99878 Def_f_sw_q0p00153 -39.99939 39.99939 EXTENDED_LIMITS -50.00000 49.99847 /end CHARACTERISTIC
/begin CHARACTERISTIC K_Q_BILAPWF "Defaultwert für q_bila nach Powerfail" VALUE 0x80062EDC Val_Wu16 1193.023 Def_ql_uw_q0p0182 0.00 1193.023 FORMAT "%8.3" EXTENDED_LIMITS 0.00 1192.750 /end CHARACTERISTIC
/begin CHARACTERISTIC K_RED_TA "Wenn Verbrauerreduzierungsdauer diese Zeit übertritt, wird der Verbraucher in den Speicher geschrieben" VALUE 0x800632A8 Val_Wu16 65535. Def_dez_uw_q1 0.00 65535. FORMAT "%5.0" /end CHARACTERISTIC
/begin CHARACTERISTIC K_RED_TB "Wenn Verbrauerreduzierungsdauer diese Zeit übertritt, wird der Verbraucher in den Speicher geschrieben" VALUE 0x800632AA Val_Wu16 65535. Def_dez_uw_q1 0.00 65535. FORMAT "%5.0" /end CHARACTERISTIC
/begin CHARACTERISTIC K_RESET_DEL "PI-Reset-Zeit bei steigender Kl.15" VALUE 0x80063297 Val_Wu8 25.5 Def_td_ub_q0p1 0.00 25.5 FORMAT "%4.1" /end CHARACTERISTIC
/begin CHARACTERISTIC K_RLEITUNGK "Widerstandswert Ladeleitung Batterie Kofferraum für ULCP" VALUE 0x8006319E Val_Wu8 31.88 Def_f_ub_b32 0.00 31.88 /end CHARACTERISTIC
/begin CHARACTERISTIC K_RLTG_KONST "Widerstandswert Ladeleitung konstant für LCP" VALUE 0x800631A0 Val_Wu16 1.999908447266 Def_f_uw_b2 0.00 1.999908447266 FORMAT "%14.12" EXTENDED_LIMITS 0.00 1.999969482422 /end CHARACTERISTIC
/begin CHARACTERISTIC K_RQPCOSAPP "Hier koennte Ihr Langbezeichner stehen" VALUE 0x80063298 Val_Wu8 3.0 Def_dez_ub_q1 0.00 3.0 EXTENDED_LIMITS 0.00 255. /end CHARACTERISTIC
/begin CHARACTERISTIC K_SELSPCSAPP "Auswahl Sonderverbraucher Applikationsgroesse" VALUE 0x80063299 Val_Wu8 15. Def_dez_ub_q1 0.00 15. FORMAT "%3.0" EXTENDED_LIMITS 0.00 255. /end CHARACTERISTIC
/begin CHARACTERISTIC K_SOCFITAPP "Applikationwert Soc aus der Fitberechnung" VALUE 0x80063074 Val_Wu16 99.99847 Def_f_uw_b100 0.00 99.99847 /end CHARACTERISTIC
/begin CHARACTERISTIC K_SOCFITLIMH "Applikationskonstante zur Verbesserung SoC aus der Fitberechnung" VALUE 0x800630D4 Val_Wu16 99.99847 Def_f_uw_b100 0.00 99.99847 /end CHARACTERISTIC
/begin CHARACTERISTIC K_SOCFITLIML "Applikationskonstante zur Abwertung SoC aus der Fitberechnung" VALUE 0x800630D6 Val_Wu16 99.99847 Def_f_uw_b100 0.00 99.99847 /end CHARACTERISTIC
/begin CHARACTERISTIC K_SOCKORR "Hier koennte Ihr Langbezeichner stehen" VALUE 0x800630D8 Val_Ws16 199.9969 Def_f_sw_b100 -100.0000 99.99695 FORMAT "%8.4" /end CHARACTERISTIC
/begin CHARACTERISTIC K_SOCQKOR "Hier koennte Ihr Langbezeichner stehen" VALUE 0x800630DA Val_Wu16 1193.023 Def_ql_uw_q0p0182 0.00 1193.023 FORMAT "%8.3" EXTENDED_LIMITS 0.00 1192.750 /end CHARACTERISTIC
/begin CHARACTERISTIC K_SOCREL "Hier koennte Ihr Langbezeichner stehen" VALUE 0x800630DC Val_Wu16 99.99847 Def_f_uw_b100 0.00 99.99847 /end CHARACTERISTIC
/begin CHARACTERISTIC K_SOCSTFGK2 "Hier koennte Ihr Langbezeichner stehen" VALUE 0x800630DE Val_Wu16 99.99847 Def_f_uw_b100 0.00 99.99847 /end CHARACTERISTIC
/begin CHARACTERISTIC K_SOC_BILAWA "Applikationswert soc_bila" VALUE 0x80062EDE Val_Wu16 99.99847 Def_f_uw_b100 0.00 99.99847 /end CHARACTERISTIC
/begin CHARACTERISTIC K_SOC_QPWF "Ladezustandsqualität nach Powerfail" VALUE 0x80062EE0 Val_Wu16 1193.023 Def_ql_uw_q0p0182 0.00 1193.023 FORMAT "%8.3" EXTENDED_LIMITS 0.00 1192.750 /end CHARACTERISTIC
/begin CHARACTERISTIC K_SOC_QUALIA "Applikationswert soc_quali" VALUE 0x80062EE2 Val_Wu16 1193.023 Def_ql_uw_q0p0182 0.00 1193.023 FORMAT "%8.3" EXTENDED_LIMITS 0.00 1192.750 /end CHARACTERISTIC
/begin CHARACTERISTIC K_SOC_STAFGA "Applikationswert für SoC aus der Startfähigkeit" VALUE 0x800630E0 Val_Wu16 99.99847 Def_f_uw_b100 0.00 99.99847 /end CHARACTERISTIC
/begin CHARACTERISTIC K_SPGKMP12 "Konstante Spannungskompensation 12" VALUE 0x8006316D Val_Wu8 25.50 Def_u_ub_q0p1 0.00 25.50 FORMAT "%5.2" /end CHARACTERISTIC
/begin CHARACTERISTIC K_SPGKOMP1 "Konstante Spannungskompensation 1" VALUE 0x8006316E Val_Wu8 25.50 Def_u_ub_q0p1 0.00 25.50 FORMAT "%5.2" /end CHARACTERISTIC
/begin CHARACTERISTIC K_SPGKOMP10 "Konstante Spannungskompensation 10" VALUE 0x8006316F Val_Wu8 1.9922 Def_f_ub_b2 0.00 1.9922 /end CHARACTERISTIC
/begin CHARACTERISTIC K_SPGKOMP11 "Konstante Spannungskompensation 11" VALUE 0x80063170 Val_Wu8 25.50 Def_u_ub_q0p1 0.00 25.50 FORMAT "%5.2" /end CHARACTERISTIC
/begin CHARACTERISTIC K_SPGKOMP13 "Konstante Spannungskompensation 13" VALUE 0x80063171 Val_Wu8 25.50 Def_u_ub_q0p1 0.00 25.50 FORMAT "%5.2" /end CHARACTERISTIC
/begin CHARACTERISTIC K_SPGKOMP14 "Konstante Spannungskompensation 14" VALUE 0x80063172 Val_Wu8 25.50 Def_u_ub_q0p1 0.00 25.50 FORMAT "%5.2" /end CHARACTERISTIC
/begin CHARACTERISTIC K_SPGKOMP15 "Konstante Spannungskompensation 15" VALUE 0x80063173 Val_Wu8 25.50 Def_u_ub_q0p1 0.00 25.50 FORMAT "%5.2" /end CHARACTERISTIC
/begin CHARACTERISTIC K_SPGKOMP16 "Konstante Spannungskompensation 16" VALUE 0x80063174 Val_Wu8 25.50 Def_u_ub_q0p1 0.00 25.50 FORMAT "%5.2" /end CHARACTERISTIC
/begin CHARACTERISTIC K_SPGKOMP17 "Konstante Spannungskompensation 17" VALUE 0x80063175 Val_Wu8 25.50 Def_u_ub_q0p1 0.00 25.50 FORMAT "%5.2" /end CHARACTERISTIC
/begin CHARACTERISTIC K_SPGKOMP18 "Konstante Spannungskompensation 18" VALUE 0x80063176 Val_Wu8 25.50 Def_u_ub_q0p1 0.00 25.50 FORMAT "%5.2" /end CHARACTERISTIC
/begin CHARACTERISTIC K_SPGKOMP19 "Konstante Spannungskompensation 19" VALUE 0x80063177 Val_Wu8 25.50 Def_u_ub_q0p1 0.00 25.50 FORMAT "%5.2" /end CHARACTERISTIC
/begin CHARACTERISTIC K_SPGKOMP2 "Konstante Spannungskompensation 2" VALUE 0x80063178 Val_Wu8 25.50 Def_u_ub_q0p1 0.00 25.50 FORMAT "%5.2" /end CHARACTERISTIC
/begin CHARACTERISTIC K_SPGKOMP20 "Konstante Spannungskompensation 20" VALUE 0x80063179 Val_Wu8 25.50 Def_u_ub_q0p1 0.00 25.50 FORMAT "%5.2" /end CHARACTERISTIC
/begin CHARACTERISTIC K_SPGKOMP21 "Konstante Spannungskompensation 21" VALUE 0x8006317A Val_Wu8 25.50 Def_u_ub_q0p1 0.00 25.50 FORMAT "%5.2" /end CHARACTERISTIC
/begin CHARACTERISTIC K_SPGKOMP22 "Konstante Spannungskompensation 22" VALUE 0x8006317B Val_Wu8 25.50 Def_u_ub_q0p1 0.00 25.50 FORMAT "%5.2" /end CHARACTERISTIC
/begin CHARACTERISTIC K_SPGKOMP23 "Konstante Spannungskompensation 23" VALUE 0x8006317C Val_Wu8 25.50 Def_u_ub_q0p1 0.00 25.50 FORMAT "%5.2" /end CHARACTERISTIC
/begin CHARACTERISTIC K_SPGKOMP24 "Konstante Spannungskompensation 24" VALUE 0x8006317D Val_Wu8 25.50 Def_u_ub_q0p1 0.00 25.50 FORMAT "%5.2" /end CHARACTERISTIC
/begin CHARACTERISTIC K_SPGKOMP25 "Konstante Spannungskompensation 25" VALUE 0x8006317E Val_Wu8 25.50 Def_u_ub_q0p1 0.00 25.50 FORMAT "%5.2" /end CHARACTERISTIC
/begin CHARACTERISTIC K_SPGKOMP4 "Konstante Spannungskompensation 4" VALUE 0x8006317F Val_Wu8 25.50 Def_u_ub_q0p1 0.00 25.50 FORMAT "%5.2" /end CHARACTERISTIC
/begin CHARACTERISTIC K_SPGKOMP5 "Konstante Spannungskompensation 5" VALUE 0x80063180 Val_Wu8 25.50 Def_u_ub_q0p1 0.00 25.50 FORMAT "%5.2" /end CHARACTERISTIC
/begin CHARACTERISTIC K_SPGKOMP6 "Konstante Spannungskompensation 6" VALUE 0x80063181 Val_Wu8 25.50 Def_u_ub_q0p1 0.00 25.50 FORMAT "%5.2" /end CHARACTERISTIC
/begin CHARACTERISTIC K_SPGKOMP8 "Konstante Spannungskompensation 8" VALUE 0x80063182 Val_Wu8 25.50 Def_u_ub_q0p1 0.00 25.50 FORMAT "%5.2" /end CHARACTERISTIC
/begin CHARACTERISTIC K_SPGKOMP9 "Konstante Spannungskompensation 9" VALUE 0x80063183 Val_Wu8 25.50 Def_u_ub_q0p1 0.00 25.50 FORMAT "%5.2" /end CHARACTERISTIC
/begin CHARACTERISTIC K_TBATNACHL "B_ccbtnach wird nach dieser Zeit aktiviert" VALUE 0x800630E2 Val_Wu8 255.0 Def_td_ub_q1 0.00 255.0 FORMAT "%5.1" /end CHARACTERISTIC
/begin CHARACTERISTIC K_TBNSDELAY "Delayzeit nach Motorstartende für BNS-Überwachung" VALUE 0x80063184 Val_Wu16 655.350 Def_td_uw_q0p01 0.00 655.350 FORMAT "%7.3" /end CHARACTERISTIC
/begin CHARACTERISTIC K_TCODIERPM "T1 Zyklus fuer Fehlerinfo" VALUE 0x80062EE4 Val_Wu8 255.0 Def_td_ub_q1 0.00 255.0 FORMAT "%5.1" /end CHARACTERISTIC
/begin CHARACTERISTIC K_TDGENOFFPM "Zeitverzögerung B_start für Spannung im Start Generator" VALUE 0x800631A2 Val_Wu16 255.770 Def_td_uw_q0p01 0.00 255.770 FORMAT "%7.3" EXTENDED_LIMITS 0.00 655.350 /end CHARACTERISTIC
/begin CHARACTERISTIC K_TD_PWRDFPI "K-Faktor des PI Reglers zur Berechnung von ctrpwrdf" VALUE 0x8006329A Val_Wu8 2.540 Def_td_ub_q0p01 0.01000 2.550 FORMAT "%5.3" EXTENDED_LIMITS 0.00 2.550 /end CHARACTERISTIC
/begin CHARACTERISTIC K_TD_SOCFIT "Zeitfaktor" VALUE 0x80063076 Val_Wu16 0.9999847412109 Def_f_uw_b1 0.00 0.9999847412109 FORMAT "%15.13" /end CHARACTERISTIC
/begin CHARACTERISTIC K_TOL "Konstante Toleranz" VALUE 0x80063186 Val_Wu8 25.50 Def_u_ub_q0p1 0.00 25.50 FORMAT "%5.2" /end CHARACTERISTIC
/begin CHARACTERISTIC K_TQVCC "Dauer der CC-Meldung infolge QVC" VALUE 0x800630E3 Val_Wu8 255.0 Def_td_ub_q1 0.00 255.0 FORMAT "%5.1" /end CHARACTERISTIC
/begin CHARACTERISTIC K_TSAISON "Hier koennte Ihr Langbezeichner stehen" VALUE 0x800630E4 Val_Ws16 6553.5 Def_t_sw_q0p1 -3276.8 3276.7 FORMAT "%6.1" /end CHARACTERISTIC
/begin CHARACTERISTIC K_TSAISONFIL "Filterkonstante für t_saison" VALUE 0x800630E6 Val_Wu16 65534. Def_dez_uw_q1 1.000 65535. FORMAT "%5.0" EXTENDED_LIMITS 0.00 65535. /end CHARACTERISTIC
/begin CHARACTERISTIC K_T_NKPTCAUS "Zeit PTC aus aufgrund NKW zu niedrig." VALUE 0x8006329B Val_Wu8 25.5 Def_td_ub_q0p1 0.00 25.5 FORMAT "%4.1" /end CHARACTERISTIC
/begin CHARACTERISTIC K_T_PTCKWAN "PTC-Ein Wartezeit nach Motor an." VALUE 0x8006329C Val_Wu8 25.5 Def_td_ub_q0p1 0.00 25.5 FORMAT "%4.1" /end CHARACTERISTIC
/begin CHARACTERISTIC K_T_PTCPI "T-Faktor des PI-Reglers für PTC-Ansteuerung" VALUE 0x8006329D Val_Wu8 2.540 Def_td_ub_q0p01 0.01000 2.550 FORMAT "%5.3" EXTENDED_LIMITS 0.00 2.550 /end CHARACTERISTIC
/begin CHARACTERISTIC K_T_SULEVON "Zeit für SULEV-ctrpwrcos-prios nach Motorstart" VALUE 0x8006329E Val_Wu16 6553.5 Def_td_uw_q0p1 0.00 6553.5 FORMAT "%6.1" /end CHARACTERISTIC
/begin CHARACTERISTIC K_UBNSSOLL "Konstante Sollspannung Bordnetzstabilität" VALUE 0x80063187 Val_Wu8 25.50 Def_u_ub_q0p1 0.00 25.50 FORMAT "%5.2" /end CHARACTERISTIC
/begin CHARACTERISTIC K_UBTFILT "Filterkonstante mit der neu hinzugekommene Spannungslage zur im Infospeicher vorhandenen hinzuaddiert wird" VALUE 0x80062E4C Val_Wu8 254. Def_dez_ub_q1 1.0 255. FORMAT "%3.0" EXTENDED_LIMITS 0.00 255. /end CHARACTERISTIC
/begin CHARACTERISTIC K_UBW_ZKSMN "Schwelle für Erkennung zyklischer Einbruch der Bordnetzspannung (Hysterese MN)" VALUE 0x80063188 Val_Wu16 65535. Def_dez_uw_q1 0.00 65535. FORMAT "%5.0" /end CHARACTERISTIC
/begin CHARACTERISTIC K_UCRASHSOLL "Konstante Sollspannung bei Crash" VALUE 0x8006318A Val_Wu8 25.50 Def_u_ub_q0p1 0.00 25.50 FORMAT "%5.2" /end CHARACTERISTIC
/begin CHARACTERISTIC K_UDIFGENOFF "B_genoff wird gesetzt, wenn Differenz zwischen Batterie- und Generatorspg größer diesem Wert" VALUE 0x800631A4 Val_Wu8 4.99800 Def_u_ub_q0p0196 0.00 4.99800 FORMAT "%7.5" /end CHARACTERISTIC
/begin CHARACTERISTIC K_UEPS_TOL "Toleranzschwelle Spannungseinbruch EPS" VALUE 0x8006318B Val_Wu8 25.50 Def_u_ub_q0p1 0.00 25.50 FORMAT "%5.2" /end CHARACTERISTIC
/begin CHARACTERISTIC K_UGDELTA "Schwellwert Delta U_gen für Erkennung Stabilität" VALUE 0x800631A5 Val_Wu8 25.50 Def_u_ub_q0p1 0.00 25.50 FORMAT "%5.2" /end CHARACTERISTIC
/begin CHARACTERISTIC K_UGEN "Hier koennte Ihr Langbezeichner stehen" VALUE 0x800631A6 Val_Wu16 6553.500 Def_u_uw_q0p1 0.00 6553.500 FORMAT "%8.3" /end CHARACTERISTIC
/begin CHARACTERISTIC K_UGENDELTA "Generatorspannungsdelta zwischen Master und Slave Generator" VALUE 0x800631A8 Val_Wu16 6553.500 Def_u_uw_q0p1 0.00 6553.500 FORMAT "%8.3" /end CHARACTERISTIC
/begin CHARACTERISTIC K_UGENLIM "Schwelle für Generatorspannung setzen B_genoff" VALUE 0x800631AA Val_Wu8 25.50 Def_u_ub_q0p1 0.00 25.50 FORMAT "%5.2" /end CHARACTERISTIC
/begin CHARACTERISTIC K_UGENMAX "Maximalwert Ausgabe U_gen" VALUE 0x800631AB Val_Wu8 25.50 Def_u_ub_q0p1 0.00 25.50 FORMAT "%5.2" /end CHARACTERISTIC
/begin CHARACTERISTIC K_UGENMIN "Minimalwert Ausgabe U_gen" VALUE 0x800631AC Val_Wu8 25.50 Def_u_ub_q0p1 0.00 25.50 FORMAT "%5.2" /end CHARACTERISTIC
/begin CHARACTERISTIC K_UGENOFFPM "Spannung im Start Generator" VALUE 0x800631AE Val_Wu16 6553.500 Def_u_uw_q0p1 0.00 6553.500 FORMAT "%8.3" /end CHARACTERISTIC
/begin CHARACTERISTIC K_UGTOD "Entprellzeit für Stabilität U_gen" VALUE 0x800631B0 Val_Wu16 6553.5 Def_td_uw_q0p1 0.00 6553.5 FORMAT "%6.1" /end CHARACTERISTIC
/begin CHARACTERISTIC K_UKOMP "Konstantwert bei Notlauf" VALUE 0x800631B2 Val_Wu8 25.50 Def_u_ub_q0p1 0.00 25.50 FORMAT "%5.2" /end CHARACTERISTIC
/begin CHARACTERISTIC K_UKOMPUBGEN "Differenzwert von Ub unter U_gen ab der Generator aus" VALUE 0x800631B3 Val_Wu8 4.99800 Def_u_ub_q0p0196 0.00 4.99800 FORMAT "%7.5" /end CHARACTERISTIC
/begin CHARACTERISTIC K_ULEVA "Spannungslevel" VALUE 0x800632A0 Val_Wu8 255. Def_dez_ub_q1 0.00 255. FORMAT "%3.0" /end CHARACTERISTIC
/begin CHARACTERISTIC K_VOLLZYKLEN "Hier koennte Ihr Langbezeichner stehen" VALUE 0x80062EE6 Val_Wu16 65535. Def_f_uw_q1 0.00 65535. FORMAT "%5.0" /end CHARACTERISTIC
/begin CHARACTERISTIC S_ABSCHK "Schalter für Applikationswert absch_korr" VALUE 0x800630E8 Val_Wu8 1.0 Identity 0.00 1.0 EXTENDED_LIMITS 0.00 255. /end CHARACTERISTIC
/begin CHARACTERISTIC S_BBNS "Hier koennte Ihr Langbezeichner stehen" VALUE 0x8006318C Val_Wu8 1.0 Identity 0.00 1.0 EXTENDED_LIMITS 0.00 255. /end CHARACTERISTIC
/begin CHARACTERISTIC S_BPMVSDANF "Hier koennte Ihr Langbezeichner stehen" VALUE 0x800632A1 Val_Wu8 1.0 Identity 0.00 1.0 EXTENDED_LIMITS 0.00 255. /end CHARACTERISTIC
/begin CHARACTERISTIC S_BSOCNPL "Hier koennte Ihr Langbezeichner stehen" VALUE 0x800630E9 Val_Wu8 1.0 Identity 0.00 1.0 EXTENDED_LIMITS 0.00 255. /end CHARACTERISTIC
/begin CHARACTERISTIC S_CODIERERR "Überprüfung Codierfehler" VALUE 0x80062EE8 Val_Wu8 1.0 Identity 0.00 1.0 EXTENDED_LIMITS 0.00 255. /end CHARACTERISTIC
/begin CHARACTERISTIC S_CODIERPM "Hier koennte Ihr Langbezeichner stehen" VALUE 0x80062EE9 Val_Wu8 1.0 Identity 0.00 1.0 EXTENDED_LIMITS 0.00 255. /end CHARACTERISTIC
/begin CHARACTERISTIC S_DFKOMMERR "Maßnahmen bei Gen. Komm. Fehler aktiv" VALUE 0x800632A2 Val_Wu8 1.0 Identity 0.00 1.0 EXTENDED_LIMITS 0.00 255. /end CHARACTERISTIC
/begin CHARACTERISTIC S_DSOCS "Schalter für Applikationswert Delta SoC" VALUE 0x800630EA Val_Wu8 1.0 Identity 0.00 1.0 EXTENDED_LIMITS 0.00 255. /end CHARACTERISTIC
/begin CHARACTERISTIC S_E89_AFS "Schalter für Fahrzeuge E8x E9x" VALUE 0x8006318D Val_Wu8 1.0 Identity 0.00 1.0 EXTENDED_LIMITS 0.00 255. /end CHARACTERISTIC
/begin CHARACTERISTIC S_ENERGYKLST "Hier koennte Ihr Langbezeichner stehen" VALUE 0x800630EB Val_Wu8 1.0 Identity 0.00 1.0 EXTENDED_LIMITS 0.00 255. /end CHARACTERISTIC
/begin CHARACTERISTIC S_ENGENTOGGL "Freigabe Generatortoggeln" VALUE 0x800631B4 Val_Wu8 1.0 Identity 0.00 1.0 EXTENDED_LIMITS 0.00 255. /end CHARACTERISTIC
/begin CHARACTERISTIC S_ENTLTEST "Hier koennte Ihr Langbezeichner stehen" VALUE 0x800632A3 Val_Wu8 1.0 Identity 0.00 1.0 EXTENDED_LIMITS 0.00 255. /end CHARACTERISTIC
/begin CHARACTERISTIC S_EPS_DISABL "Hier koennte Ihr Langbezeichner stehen" VALUE 0x8006318E Val_Wu8 1.0 Identity 0.00 1.0 EXTENDED_LIMITS 0.00 255. /end CHARACTERISTIC
/begin CHARACTERISTIC S_FITNPL "Hier koennte Ihr Langbezeichner stehen" VALUE 0x80063078 Val_Wu8 1.0 Identity 0.00 1.0 EXTENDED_LIMITS 0.00 255. /end CHARACTERISTIC
/begin CHARACTERISTIC S_GENOFFSTPM "Schalter zum Freischalten Startausschaltspannung" VALUE 0x800631B5 Val_Wu8 1.0 Identity 0.00 1.0 EXTENDED_LIMITS 0.00 255. /end CHARACTERISTIC
/begin CHARACTERISTIC S_IGR_EPS "Berücksichtigung von igr med hi bei Auswertung EPS" VALUE 0x8006318F Val_Wu8 1.0 Identity 0.00 1.0 EXTENDED_LIMITS 0.00 255. /end CHARACTERISTIC
/begin CHARACTERISTIC S_KONFSTRAT2 "wenn true dann wird neue Konfliktstrategie verwendet" VALUE 0x80063192 Val_Wu8 1.0 Identity 0.00 1.0 EXTENDED_LIMITS 0.00 255. /end CHARACTERISTIC
/begin CHARACTERISTIC S_LDAEPS_EN "Schalter LL Drehzahlanhebung aktiviert" VALUE 0x80063190 Val_Wu8 1.0 Identity 0.00 1.0 EXTENDED_LIMITS 0.00 255. /end CHARACTERISTIC
/begin CHARACTERISTIC S_MSASTARTKL "0=konventionelle KL ; 1=MSA-StarterKL" VALUE 0x80063130 Val_Wu8 1.0 Identity 0.00 1.0 EXTENDED_LIMITS 0.00 255. /end CHARACTERISTIC
/begin CHARACTERISTIC S_PMSOCFIT "Schalter zur Applikation SoC aus der Fitberechnung" VALUE 0x80063079 Val_Wu8 1.0 Identity 0.00 1.0 EXTENDED_LIMITS 0.00 255. /end CHARACTERISTIC
/begin CHARACTERISTIC S_PMTABSMN "Schalter für Applikation der Abstellzeit tabsmn_w" VALUE 0x800630EC Val_Wu8 1.0 Identity 0.00 1.0 EXTENDED_LIMITS 0.00 255. /end CHARACTERISTIC
/begin CHARACTERISTIC S_PRIOMANUAL "Manueller Schalter fuer E60/E65-Can Botschaften" VALUE 0x800632A4 Val_Wu8 1.0 Identity 0.00 1.0 EXTENDED_LIMITS 0.00 255. /end CHARACTERISTIC
/begin CHARACTERISTIC S_PTCKOOR "Schalter Aktivierung PTC Koordinator im PMPRSVCALC" VALUE 0x800632A5 Val_Wu8 1.0 Identity 0.00 1.0 EXTENDED_LIMITS 0.00 255. /end CHARACTERISTIC
/begin CHARACTERISTIC S_PTCOFFOTTO "Schalter der den PTC beim Ottomotor deaktirviert da dieser nicht verbaut ist" VALUE 0x800632A6 Val_Wu8 1.0 Identity 0.00 1.0 EXTENDED_LIMITS 0.00 255. /end CHARACTERISTIC
/begin CHARACTERISTIC S_RLEITUNG "manuelles Umschalten auf konst Widerstandswert" VALUE 0x800631B6 Val_Wu8 1.0 Identity 0.00 1.0 EXTENDED_LIMITS 0.00 255. /end CHARACTERISTIC
/begin CHARACTERISTIC S_SOCCALCECU "Hier koennte Ihr Langbezeichner stehen" VALUE 0x80062EEA Val_Wu8 1.0 Identity 0.00 1.0 EXTENDED_LIMITS 0.00 255. /end CHARACTERISTIC
/begin CHARACTERISTIC S_SOCKORECU "Hier koennte Ihr Langbezeichner stehen" VALUE 0x800630ED Val_Wu8 1.0 Identity 0.00 1.0 EXTENDED_LIMITS 0.00 255. /end CHARACTERISTIC
/begin CHARACTERISTIC S_SOCSTAFK "Schalter für Applikation SoC aus der Startfähigkeit" VALUE 0x800630EE Val_Wu8 1.0 Identity 0.00 1.0 EXTENDED_LIMITS 0.00 255. /end CHARACTERISTIC
/begin CHARACTERISTIC S_SOC_BILA "Schalter für Applik. soc_bila" VALUE 0x80062EEB Val_Wu8 1.0 Identity 0.00 1.0 EXTENDED_LIMITS 0.00 255. /end CHARACTERISTIC
/begin CHARACTERISTIC S_SOC_QUAL "Schalter für Applik. soc_quali" VALUE 0x80062EEC Val_Wu8 1.0 Identity 0.00 1.0 EXTENDED_LIMITS 0.00 255. /end CHARACTERISTIC
/begin CHARACTERISTIC S_SPGWECU "Hier koennte Ihr Langbezeichner stehen" VALUE 0x80063191 Val_Wu8 1.0 Identity 0.00 1.0 EXTENDED_LIMITS 0.00 255. /end CHARACTERISTIC
/begin CHARACTERISTIC S_UKOMPECU "Hier koennte Ihr Langbezeichner stehen" VALUE 0x800631B7 Val_Wu8 1.0 Identity 0.00 1.0 EXTENDED_LIMITS 0.00 255. /end CHARACTERISTIC
/begin CHARACTERISTIC S_UTNSTRTMSA "Schalter: 0: U_tnstart wird immer übernommen, 1: U_tnstart wird nur bei Spannung größer 6volt übernommen" VALUE 0x80063131 Val_Wu8 1.0 Identity 0.00 1.0 EXTENDED_LIMITS 0.00 255. /end CHARACTERISTIC
/begin CHARACTERISTIC S_VERBREDECU "Hier koennte Ihr Langbezeichner stehen" VALUE 0x800632A7 Val_Wu8 1.0 Identity 0.00 1.0 EXTENDED_LIMITS 0.00 255. /end CHARACTERISTIC
/begin MEASUREMENT Absch_korr "Korrekturwert Abschaltung" SWORD Def_f_sw_q0p00153 1 100 -39.99939 39.99939 ECU_ADDRESS 0xC0009570 /end MEASUREMENT
/begin MEASUREMENT Actmaxprio_a "Aktuelle max Prio für Speicher" UBYTE Def_dez_ub_q1 1 100 0.00 255. FORMAT "%3.0" ECU_ADDRESS 0xC000B040 /end MEASUREMENT
/begin MEASUREMENT Actmaxprio_b "Aktuelle max Prio Standverbraucher Klasse B für Speicher" UBYTE Def_dez_ub_q1 1 100 0.00 255. FORMAT "%3.0" ECU_ADDRESS 0xC000B041 /end MEASUREMENT
/begin MEASUREMENT Actprio "Prio des Berechnungsschritts" UBYTE Def_dez_ub_q1 1 100 0.00 255. FORMAT "%3.0" ECU_ADDRESS 0xC000B042 /end MEASUREMENT
/begin MEASUREMENT AFS_dm "Der gesamte HFM Luftmassenstrom" SWORD AirMassPerTime 1 100 -3276.800 3276.700 ECU_ADDRESS 0xD0000400 /end MEASUREMENT
/begin MEASUREMENT AFS_dmAirFrz_mp "Eingefrorener Wert des Luftstromsignals" SWORD AirMassPerTime 1 100 -3276.800 3276.700 ECU_ADDRESS 0xC00095F2 /end MEASUREMENT
/begin MEASUREMENT AFS_dmAirMsFlt_mp "Luftmassenstrom nach PT1-Filterung" SWORD AirMassPerTime 1 100 -3276.800 3276.700 ECU_ADDRESS 0xC0009602 /end MEASUREMENT
/begin MEASUREMENT AFS_dmAirSubsVal_mp "Ersatzwert des Luftstromsignals" SWORD AirMassPerTime 1 100 -3276.800 3276.700 ECU_ADDRESS 0xC00095F4 /end MEASUREMENT
/begin MEASUREMENT AFS_dmComp "Der gesamte driftkompensierte Luftmassenstrom für AFS" SWORD AirMassPerTime 1 100 -3276.800 3276.700 ECU_ADDRESS 0xD0000406 /end MEASUREMENT
/begin MEASUREMENT AFS_dmDrft "Kompensierter Luftmasswert für die Drift" SWORD AirMassPerTime 1 100 -3276.800 3276.700 ECU_ADDRESS 0xD0000408 /end MEASUREMENT
/begin MEASUREMENT AFS_dmIdlAirMs_mp "Luftmassenstrom im Leerlaufbereich" SWORD AirMassPerTime 1 100 -3276.800 3276.700 ECU_ADDRESS 0xC0009604 /end MEASUREMENT
/begin MEASUREMENT AFS_dmLdAirMs_mp "Luftmassenstrom im Lastbereich" SWORD AirMassPerTime 1 100 -3276.800 3276.700 ECU_ADDRESS 0xC0009606 /end MEASUREMENT
/begin MEASUREMENT AFS_dmPlsCorr_mp "Pulsationkorrigierte Luftmasse (nur zum Testzweck)" SWORD AirMassPerTime 1 100 -3276.800 3276.700 ECU_ADDRESS 0xC00095F6 /end MEASUREMENT
/begin MEASUREMENT AFS_dmSens "Erfasster Luftstrom" SWORD AirMassPerTime 1 100 -3276.800 3276.700 ECU_ADDRESS 0xD000040A /end MEASUREMENT
/begin MEASUREMENT AFS_dmSensCorr_mp "Korrigiertes Luftstromsignal" SWORD AirMassPerTime 1 100 -3276.800 3276.700 ECU_ADDRESS 0xC00095F8 /end MEASUREMENT
/begin MEASUREMENT AFS_dpIntValAbsFlt "" SWORD RmpPres_hPa 1 100 -500.0000 499.9847 FORMAT "%8.4" ECU_ADDRESS 0xD000040C /end MEASUREMENT
/begin MEASUREMENT AFS_dpIntValAbs_mp "Zeitlicher Änderungsbetrag des Ladedrucks" SWORD RmpPres_hPa 1 100 -500.0000 499.9847 FORMAT "%8.4" ECU_ADDRESS 0xC0009608 /end MEASUREMENT
/begin MEASUREMENT AFS_dqCurrAbsFlt "" SWORD RmpInjMass 1 100 -5.000000 4.999847 FORMAT "%8.6" ECU_ADDRESS 0xD000040E /end MEASUREMENT
/begin MEASUREMENT AFS_dqCurrAbs_mp "Absolute Änderung der Einspritzmenge" SWORD RmpInjMass 1 100 -5.000000 4.999847 FORMAT "%8.6" ECU_ADDRESS 0xC000960A /end MEASUREMENT
/begin MEASUREMENT AFS_drWtPenDetFlt_mp "Gefilterte Signaldifferenz für Wassereintrag" SWORD Rmp_1 1 100 -32.76800 32.76700 FORMAT "%8.5" ECU_ADDRESS 0xC000960C /end MEASUREMENT
/begin MEASUREMENT AFS_drWtPenDet_mp "Relative Signaländerungsdifferenz für Wassereintragserkennung" SWORD Rmp_1 1 100 -32.76800 32.76700 FORMAT "%8.5" ECU_ADDRESS 0xC000960E /end MEASUREMENT
/begin MEASUREMENT AFS_facCalcIdlAdjVal_mp "Berechneter Luftmassenkorrekturfaktor im Leerlauf" SWORD Fact 1 100 -4.000000 3.999878 ECU_ADDRESS 0xC0009610 /end MEASUREMENT
/begin MEASUREMENT AFS_facCalcLdAdjVal_mp "Berechneter Luftmassenkorrekturfaktor im Lastbereich" SWORD Fact 1 100 -4.000000 3.999878 ECU_ADDRESS 0xC0009612 /end MEASUREMENT
/begin MEASUREMENT AFS_facCalcValFlt_mp "Berechneter Luftmassenkorrekturfaktor nach PT1-Filterung" SWORD Fact 1 100 -4.000000 3.999878 ECU_ADDRESS 0xC0009614 /end MEASUREMENT
/begin MEASUREMENT AFS_facCalcVal_mp "Berechneter Luftmassenkorrekturfaktor" SWORD Fact 1 100 -4.000000 3.999878 ECU_ADDRESS 0xC0009616 /end MEASUREMENT
/begin MEASUREMENT AFS_facCorIdl_mp "Leerlaufkorrekturfaktor für Driftkompensation" SWORD Fact 1 100 -4.000000 3.999878 ECU_ADDRESS 0xC0009618 /end MEASUREMENT
/begin MEASUREMENT AFS_facCorIpo_mp "Ergebnisbereich der Korrekturkennlinie" SWORD Fact 1 100 -4.000000 3.999878 ECU_ADDRESS 0xC000961A /end MEASUREMENT
/begin MEASUREMENT AFS_facCorLd_mp "Lastkorrekturfaktor für Driftkompensation" SWORD Fact 1 100 -4.000000 3.999878 ECU_ADDRESS 0xC000961C /end MEASUREMENT
/begin MEASUREMENT AFS_facIdlAdjValUnLim_mp "Luftmassenkorrekturfaktor im Leerlaufbereich vor Schrittbegrenzung" SWORD Fact 1 100 -4.000000 3.999878 ECU_ADDRESS 0xC000961E /end MEASUREMENT
/begin MEASUREMENT AFS_facIdlAdjVal_mp "Leerlaufkorrekturfaktor der Driftkompensation" SWORD Fact 1 100 -4.000000 3.999878 ECU_ADDRESS 0xC0009620 /end MEASUREMENT
/begin MEASUREMENT AFS_facLdAdjValUnLim_mp "Luftmassenkorrekturfaktor im Lastbereich vor Schrittbegrenzung" SWORD Fact 1 100 -4.000000 3.999878 ECU_ADDRESS 0xC0009622 /end MEASUREMENT
/begin MEASUREMENT AFS_facLdAdjVal_mp "Lastkorrekturfaktor der Driftkompensation" SWORD Fact 1 100 -4.000000 3.999878 ECU_ADDRESS 0xC0009624 /end MEASUREMENT
/begin MEASUREMENT AFS_facPlsCor_mp "Pulsationskorrekturfaktor" SWORD Fact 1 100 -4.000000 3.999878 ECU_ADDRESS 0xC00095FA /end MEASUREMENT
/begin MEASUREMENT AFS_facSwtOnCor_mp "Nur zum Testzweck. Später zu entfernen" SWORD Fact 1 100 -4.000000 3.999878 ECU_ADDRESS 0xC00095FC /end MEASUREMENT
/begin MEASUREMENT AFS_mAirPerCyl "Luftmasse pro Zylinder" SWORD AirMassPerCyl 1 100 -3276.800 3276.700 ECU_ADDRESS 0xD0000410 /end MEASUREMENT
/begin MEASUREMENT AFS_mAirPerCylFlt "Gefilterte Luftmasse pro Zylinder" SWORD AirMassPerCyl 1 100 -3276.800 3276.700 ECU_ADDRESS 0xD0000416 /end MEASUREMENT
/begin MEASUREMENT AFS_mAirPerCyl_mp "Luftmasse pro Zylinder" SWORD AirMassPerCyl 1 100 -3276.800 3276.700 ECU_ADDRESS 0xC00095FE /end MEASUREMENT
/begin MEASUREMENT AFS_qAirmThrSRCHiActv_mp "Obere Mengenschwelle zur Durchführung des SRC-High-Checks des Luftstromsignals" SWORD InjMass 1 100 -327.6800 327.6700 ECU_ADDRESS 0xC00095EC /end MEASUREMENT
/begin MEASUREMENT AFS_qWinLdAdjThresHi_mp "Messpunkt für die obere Schwelle des Einspritzmassefensters bei Lastzustand" SWORD InjMass 1 100 -327.6800 327.6700 ECU_ADDRESS 0xC0009626 /end MEASUREMENT
/begin MEASUREMENT AFS_qWinLdAdjThresLo_mp "Messpunkt für die untere Schwelle des Einspritzmassefensters bei Lastzustand" SWORD InjMass 1 100 -327.6800 327.6700 ECU_ADDRESS 0xC0009628 /end MEASUREMENT
/begin MEASUREMENT AFS_rNorm_mp "Normiertes Luftstromverhältnis" SWORD Fact 1 100 -4.000000 3.999878 ECU_ADDRESS 0xC0009600 /end MEASUREMENT
/begin MEASUREMENT AFS_stAdjRlsDel_mp "Status der Freigabeverzögerung für Korrekturwertberechnung" UBYTE OneToOne 1 100 0.00 255.0 ECU_ADDRESS 0xC000B06D /end MEASUREMENT
/begin MEASUREMENT AFS_stDrft "Status der Driftkompensation" UBYTE OneToOne 1 100 0.00 255.0 ECU_ADDRESS 0xD0001BE0 /end MEASUREMENT
/begin MEASUREMENT AFS_stDrftMonRls "Status der Freigabe der Empfindlichkeitsdriftprüfung" UBYTE OneToOne 1 100 0.00 255.0 ECU_ADDRESS 0xD0001BE3 /end MEASUREMENT
/begin MEASUREMENT AFS_stDrftMonRls_mp "Information zur Freigabe der Empfindlichkeitsdriftprüfung" UBYTE OneToOne 1 100 0.00 255.0 ECU_ADDRESS 0xC000B069 /end MEASUREMENT
/begin MEASUREMENT AFS_stEnvCon_mp "Zustand der Umgebungsbedingungen für Freigabe der Korrekturwertberechnung" UBYTE OneToOne 1 100 0.00 255.0 ECU_ADDRESS 0xC000B06E /end MEASUREMENT
/begin MEASUREMENT AFS_stFIdAFSSysOk "" UBYTE OneToOne 1 100 0.00 255.0 ECU_ADDRESS 0xD0001BE4 /end MEASUREMENT
/begin MEASUREMENT AFS_stIdlAdjRlsCon_mp "Zustand der Freigabebedingungen für Korrekturwertberechnung im Leerlauf" UBYTE OneToOne 1 100 0.00 255.0 ECU_ADDRESS 0xC000B06F /end MEASUREMENT
/begin MEASUREMENT AFS_stIpoRng_mp "Interpolationsbereich der Korrekturkennlinie" UBYTE OneToOne 1 100 0.00 255.0 ECU_ADDRESS 0xC000B070 /end MEASUREMENT
/begin MEASUREMENT AFS_stLdAdjRlsCon_mp "Zustand der Freigabebedingungen für Korrekturwertberechnung im Lastbereich" UBYTE OneToOne 1 100 0.00 255.0 ECU_ADDRESS 0xC000B071 /end MEASUREMENT
/begin MEASUREMENT AFS_stOffsTst "Status des Offsetdriftchecks" UBYTE OneToOne 1 100 0.00 255.0 ECU_ADDRESS 0xD0001BE5 /end MEASUREMENT
/begin MEASUREMENT AFS_stPlSetyDrftRls_mp "Freigabestatus der Empfindlichkeitsdriftprüfung" UBYTE OneToOne 1 100 0.00 255.0 ECU_ADDRESS 0xC000B06A /end MEASUREMENT
/begin MEASUREMENT AFS_stPlSetyDrft_mp "Plausibilitätsprüfungstatus für Empfindlichkeitsdrift" UBYTE OneToOne 1 100 0.00 255.0 ECU_ADDRESS 0xC000B06B /end MEASUREMENT
/begin MEASUREMENT AFS_stPlSetyRls_mp "Zwischenstatus der Empfindlichkeitsdriftprüfung (nur zum Testzweck)." UBYTE OneToOne 1 100 0.00 255.0 ECU_ADDRESS 0xC000B06C /end MEASUREMENT
/begin MEASUREMENT AFS_stPlsOffsDrftTstActv_mp "Status, ob Offset-Driftprüfung aktiv ist oder nicht" UBYTE OneToOne 1 100 0.00 255.0 ECU_ADDRESS 0xC000B065 /end MEASUREMENT
/begin MEASUREMENT AFS_stPsShOff "" UBYTE OneToOne 1 100 0.00 255.0 ECU_ADDRESS 0xD0001BE6 /end MEASUREMENT
/begin MEASUREMENT AFS_stRstLoDrftThres_mp "Deaktivierungszustand der minimalen Driftgrenzen" UBYTE OneToOne 1 100 0.00 255.0 ECU_ADDRESS 0xC000B072 /end MEASUREMENT
/begin MEASUREMENT AFS_stShOff "" UBYTE OneToOne 1 100 0.00 255.0 ECU_ADDRESS 0xD0001BE7 /end MEASUREMENT
/begin MEASUREMENT AFS_stSRCHiRls_mp "Status von SRC-High-Freigabe (nur zum Testzweck.)" UBYTE OneToOne 1 100 0.00 255.0 ECU_ADDRESS 0xC000B066 /end MEASUREMENT
/begin MEASUREMENT AFS_stSRCHiTstRls_mp "Freigabestatus des SRC-High-Tests" UBYTE OneToOne 1 100 0.00 255.0 ECU_ADDRESS 0xC000B067 /end MEASUREMENT
/begin MEASUREMENT AFS_stSRCLoTstRls_mp "Freigabestatus des SRC-Low-Tests" UBYTE OneToOne 1 100 0.00 255.0 ECU_ADDRESS 0xC000B068 /end MEASUREMENT
/begin MEASUREMENT AFS_stWtPenDetDeb_mp "Status der Wassereintragserkennung nach Entprellung" UBYTE OneToOne 1 100 0.00 255.0 ECU_ADDRESS 0xC000B073 /end MEASUREMENT
/begin MEASUREMENT AFS_stWtPenDet_mp "Status der Wassereintragserkennung" UBYTE OneToOne 1 100 0.00 255.0 ECU_ADDRESS 0xC000B074 /end MEASUREMENT
/begin MEASUREMENT AFS_swtActvAftRun "Schalterinformation ob SRC in AFTERRUN erlaubt ist" UBYTE OneToOne 1 100 0.00 255.0 ECU_ADDRESS 0xD0001BE8 /end MEASUREMENT
/begin MEASUREMENT AFS_tiCor_mp "Korrigierte Luftmasse" SWORD Time_PwmHigh 1 100 -1638.400 1638.350 FORMAT "%8.3" ECU_ADDRESS 0xC00095EE /end MEASUREMENT
/begin MEASUREMENT AFS_tiRaw "Rohwert der Luftmassenperiode" SWORD Time_PwmHigh 1 100 -1638.400 1638.350 FORMAT "%8.3" ECU_ADDRESS 0xD0000418 /end MEASUREMENT
/begin MEASUREMENT AFS_tiRawAvrg_mp "Mittelwert der Luftmassenperiode" SWORD Time_PwmHigh 1 100 -1638.400 1638.350 FORMAT "%8.3" ECU_ADDRESS 0xC00095F0 /end MEASUREMENT
/begin MEASUREMENT AGSDem_nSetPHi "" SWORD EngN 1 100 -16384.00 16383.50 ECU_ADDRESS 0xD000041A /end MEASUREMENT
/begin MEASUREMENT AGSDem_nSetPLo "" SWORD EngN 1 100 -16384.00 16383.50 ECU_ADDRESS 0xD000041C /end MEASUREMENT
/begin MEASUREMENT AGSDem_stModeDKGDeb_mp "" UBYTE OneToOne 1 100 0.00 255.0 ECU_ADDRESS 0xC000B075 /end MEASUREMENT
/begin MEASUREMENT AGSDem_stModeDKGUnDeb_mp "" UBYTE OneToOne 1 100 0.00 255.0 ECU_ADDRESS 0xC000B076 /end MEASUREMENT
/begin MEASUREMENT AGSDem_stModeDKG_mp "" UBYTE OneToOne 1 100 0.00 255.0 ECU_ADDRESS 0xC000B077 /end MEASUREMENT
/begin MEASUREMENT AGSDem_trqLoLimMax "" SWORD Trq 1 100 -3276.800 3276.700 ECU_ADDRESS 0xD000041E /end MEASUREMENT
/begin MEASUREMENT AGSDem_trqLoLimMin "" SWORD Trq 1 100 -3276.800 3276.700 ECU_ADDRESS 0xD0000420 /end MEASUREMENT
/begin MEASUREMENT AGSDem_trqReq "" SWORD Trq 1 100 -3276.800 3276.700 ECU_ADDRESS 0xD0000422 /end MEASUREMENT
/begin MEASUREMENT AirCtl_arEffEGRFlt_mp "" FLOAT32_IEEE Area_cm2_float 1 100 0.00 20.0000000 FORMAT "%10.7" ECU_ADDRESS 0xC0008BE4 /end MEASUREMENT
/begin MEASUREMENT AirCtl_arEGRPreCtlLim_mp "" FLOAT32_IEEE Area_cm2_float 1 100 0.00 20.0000000 FORMAT "%10.7" ECU_ADDRESS 0xC0008BE8 /end MEASUREMENT
/begin MEASUREMENT AirCtl_arEGRPreCtl_mp "" FLOAT32_IEEE Area_cm2_float 1 100 0.00 20.0000000 FORMAT "%10.7" ECU_ADDRESS 0xC0008BEC /end MEASUREMENT
/begin MEASUREMENT AirCtl_arLimMax_mp "" FLOAT32_IEEE Area_cm2_float 1 100 0.00 20.0000000 FORMAT "%10.7" ECU_ADDRESS 0xC0008BF0 /end MEASUREMENT
/begin MEASUREMENT AirCtl_dmEGRPreCtlReal_mp "" FLOAT32_IEEE AirMassPerTime_float 1 100 0.00 1400.00000 FORMAT "%10.5" ECU_ADDRESS 0xC0008BF4 /end MEASUREMENT
/begin MEASUREMENT AirCtl_dmEGRPreCtl_mp "" SWORD AirMassPerTime 1 100 -3276.800 3276.700 ECU_ADDRESS 0xC000962C /end MEASUREMENT
/begin MEASUREMENT AirCtl_mEGRPreCtlUnFlt_mp "" SWORD AirMassPerCyl 1 100 -3276.800 3276.700 ECU_ADDRESS 0xC000962E /end MEASUREMENT
/begin MEASUREMENT AirCtl_mEGRPreCtlUnSplit "" SWORD AirMassPerCyl 1 100 -3276.800 3276.700 ECU_ADDRESS 0xD00005B8 /end MEASUREMENT
/begin MEASUREMENT AirCtl_mEGRPreCtl_mp "" SWORD AirMassPerCyl 1 100 -3276.800 3276.700 ECU_ADDRESS 0xC0009630 /end MEASUREMENT
/begin MEASUREMENT AirCtl_mIntMnfDs_mp "" SWORD AirMassPerCyl 1 100 -3276.800 3276.700 ECU_ADDRESS 0xC0009632 /end MEASUREMENT
/begin MEASUREMENT AirCtl_qCtlVal "" SWORD InjMass 1 100 -327.6800 327.6700 ECU_ADDRESS 0xD00005D0 /end MEASUREMENT
/begin MEASUREMENT AirCtl_qDesVal "" SWORD InjMass 1 100 -327.6800 327.6700 ECU_ADDRESS 0xD00005D6 /end MEASUREMENT
/begin MEASUREMENT AirCtl_qGov "" SWORD InjMass 1 100 -327.6800 327.6700 ECU_ADDRESS 0xD00005DC /end MEASUREMENT
/begin MEASUREMENT AirCtl_qInvEGRMod "" SWORD InjMass 1 100 -327.6800 327.6700 ECU_ADDRESS 0xD00005E2 /end MEASUREMENT
/begin MEASUREMENT AirCtl_qMon "" SWORD InjMass 1 100 -327.6800 327.6700 ECU_ADDRESS 0xD00005E4 /end MEASUREMENT
/begin MEASUREMENT AirCtl_rCtlVal "" SWORD Prc 1 100 -400.0000 399.9878 ECU_ADDRESS 0xD00005EA /end MEASUREMENT
/begin MEASUREMENT AirCtl_rCtlValB1 "" SWORD Prc 1 100 -400.0000 399.9878 ECU_ADDRESS 0xD00005EC /end MEASUREMENT
/begin MEASUREMENT AirCtl_rCtlValB2 "" SWORD Prc 1 100 -400.0000 399.9878 ECU_ADDRESS 0xD00005EE /end MEASUREMENT
/begin MEASUREMENT AirCtl_rEGRPreCtlUnLim_mp "" SWORD Prc 1 100 -400.0000 399.9878 ECU_ADDRESS 0xC0009634 /end MEASUREMENT
/begin MEASUREMENT AirCtl_rEGRPreCtl_mp "" SWORD Prc 1 100 -400.0000 399.9878 ECU_ADDRESS 0xC0009636 /end MEASUREMENT
/begin MEASUREMENT AirCtl_rPresRat_mp "" FLOAT32_IEEE OneToOne 1 100 0.00 3.00000000 FORMAT "%10.8" ECU_ADDRESS 0xC0008BF8 /end MEASUREMENT
/begin MEASUREMENT AirCtl_stRlsEGRPreCtlCond_mp "" UBYTE OneToOne 1 100 0.00 255.0 ECU_ADDRESS 0xC000B078 /end MEASUREMENT
/begin MEASUREMENT AirCtl_stRlsEGRPreCtl_mp "" UBYTE OneToOne 1 100 0.00 255.0 ECU_ADDRESS 0xC000B079 /end MEASUREMENT
/begin MEASUREMENT AirCtl_trqCtlVal "" SWORD Trq 1 100 -3276.800 3276.700 ECU_ADDRESS 0xD000060C /end MEASUREMENT
/begin MEASUREMENT AirCtl_trqDesVal "" SWORD Trq 1 100 -3276.800 3276.700 ECU_ADDRESS 0xD000060E /end MEASUREMENT
/begin MEASUREMENT AirCtl_trqGov "" SWORD Trq 1 100 -3276.800 3276.700 ECU_ADDRESS 0xD0000610 /end MEASUREMENT
/begin MEASUREMENT AirCtl_trqMon "" SWORD Trq 1 100 -3276.800 3276.700 ECU_ADDRESS 0xD0000612 /end MEASUREMENT
/begin MEASUREMENT AirC_trqDes "" SWORD Trq 1 100 -3276.800 3276.700 ECU_ADDRESS 0xD0000596 /end MEASUREMENT
/begin MEASUREMENT Air_dmAFSFrsh_mp "" SWORD AirMassPerTime 1 100 -3276.800 3276.700 ECU_ADDRESS 0xC00095E0 /end MEASUREMENT
/begin MEASUREMENT Air_mAFSFrshSum_mp "" SWORD AirMass_kg 1 100 -3276.800 3276.700 FORMAT "%8.3" ECU_ADDRESS 0xC00095E2 /end MEASUREMENT
/begin MEASUREMENT Air_rRawTAFS "" SWORD DtyCyc 1 100 -327.6800 327.6700 ECU_ADDRESS 0xD0000636 /end MEASUREMENT
/begin MEASUREMENT Air_stAFStPlausEEP_mp "" UBYTE OneToOne 1 100 0.00 255.0 ECU_ADDRESS 0xC000B062 /end MEASUREMENT
/begin MEASUREMENT Air_stCorrActv_mp "" UBYTE OneToOne 1 100 0.00 255.0 ECU_ADDRESS 0xC000B063 /end MEASUREMENT
/begin MEASUREMENT Air_stSensPlaus_mp "" UBYTE OneToOne 1 100 0.00 255.0 ECU_ADDRESS 0xC000B064 /end MEASUREMENT
/begin MEASUREMENT Air_tAFS "" SWORD Temp_Cels 1 100 -3549.940 3003.560 ECU_ADDRESS 0xD0000638 /end MEASUREMENT
/begin MEASUREMENT Air_tAFSCorr "" SWORD Temp_Cels 1 100 -3549.940 3003.560 ECU_ADDRESS 0xD000063E /end MEASUREMENT
/begin MEASUREMENT Air_tAFSCorrRaw_mp "" SWORD Temp_Cels 1 100 -3549.940 3003.560 ECU_ADDRESS 0xC00095E4 /end MEASUREMENT
/begin MEASUREMENT Air_tAFSDflt_mp "" SWORD Temp_Cels 1 100 -3549.940 3003.560 ECU_ADDRESS 0xC00095E6 /end MEASUREMENT
/begin MEASUREMENT Air_tAFSPlaus_mp "" SWORD Temp_Cels 1 100 -3549.940 3003.560 ECU_ADDRESS 0xC00095E8 /end MEASUREMENT
/begin MEASUREMENT Air_tEngAFSt_mp "" SWORD Temp_Cels 1 100 -3549.940 3003.560 ECU_ADDRESS 0xC00095EA /end MEASUREMENT
/begin MEASUREMENT Air_tiRawTAFS "" SLONG Time_Period_HFM6 1 100 -107374.182400 107374.182350 FORMAT "%13.6" ECU_ADDRESS 0xD0002E08 /end MEASUREMENT
/begin MEASUREMENT Air_tSensTAFS "" SWORD Temp_Cels 1 100 -3549.940 3003.560 ECU_ADDRESS 0xD0000646 /end MEASUREMENT
/begin MEASUREMENT Allptcfilt "pi-geregelte Gewichtung für PTC-Ansteuerung" UBYTE Def_f_ub_b100 1 100 0.00 99.61 ECU_ADDRESS 0xC000B043 /end MEASUREMENT
/begin MEASUREMENT Anzahl_sv "Laufvariable für Ermittlung des SV mit höchster Prio" UBYTE Def_dez_ub_q1 1 100 0.00 255. FORMAT "%3.0" ECU_ADDRESS 0xC000B044 /end MEASUREMENT
/begin MEASUREMENT Anz_Stops_ta "rel Häufigkeit von Stops zwischen 0 und 5 Sekunden der aktuellen Fahrt" UWORD Def_dez_uw_q1 1 100 0.00 65535. FORMAT "%5.0" ECU_ADDRESS 0xC00094EE /end MEASUREMENT
/begin MEASUREMENT Anz_Stops_tb "rel. Häufigkeit Stops zwischen 5 und 20 Sekunden Dauer der aktuellen Fahrt" UWORD Def_dez_uw_q1 1 100 0.00 65535. FORMAT "%5.0" ECU_ADDRESS 0xC00094F0 /end MEASUREMENT
/begin MEASUREMENT Anz_Stops_tc "rel. Häufigkeit Stops zwischen 20 und 45 Sekunden Dauer der aktuellen Fahrt" UWORD Def_dez_uw_q1 1 100 0.00 65535. FORMAT "%5.0" ECU_ADDRESS 0xC00094F2 /end MEASUREMENT
/begin MEASUREMENT Anz_Stops_td "rel. Häufigkeit von Stops länger als 45 Sekunden Dauer der aktuellen Fahrt" UWORD Def_dez_uw_q1 1 100 0.00 65535. FORMAT "%5.0" ECU_ADDRESS 0xC00094F4 /end MEASUREMENT
/begin MEASUREMENT Av_temp "neuster AV kommt von : 1=DSOC; 2 =Temp; 3 = Spg-lage; 4 = I_bn_short; 5 = I_bn_long" UBYTE Def_dez_ub_q1 1 100 0.00 255. FORMAT "%3.0" ECU_ADDRESS 0xC000AFC6 /end MEASUREMENT
/begin MEASUREMENT Av_temp_old "Abschaltverhinderer der beim letzten Mal in Infospeicher geschrieben wurde" UBYTE Def_dez_ub_q1 1 100 0.00 255. FORMAT "%3.0" ECU_ADDRESS 0xC000AFC7 /end MEASUREMENT
/begin MEASUREMENT Battfak "Faktor" UWORD Def_f_uw_b8 1 100 0.90014648 3.0000000 ECU_ADDRESS 0xC000953E /end MEASUREMENT
/begin MEASUREMENT Batt_index "Batterie Index" UBYTE Def_dez_ub_q1 1 100 0.00 255. FORMAT "%3.0" ECU_ADDRESS 0xC000AFDC /end MEASUREMENT
/begin MEASUREMENT Batt_ort "Batterieeinbauort" UBYTE Def_st_ub_q1 1 100 0.00 255. FORMAT "%3.0" ECU_ADDRESS 0xC000B038 /end MEASUREMENT
/begin MEASUREMENT Bnscounter "Counter Bordnetzspannungsplausibilisierung" UBYTE Def_dez_ub_q1 1 100 0.00 255. FORMAT "%3.0" ECU_ADDRESS 0xC000AFEC /end MEASUREMENT
/begin MEASUREMENT Codiercnt "Internet Zaehler fuer Anfrage Codierung" UBYTE Def_td_ub_q1 1 100 0.00 255.0 FORMAT "%5.1" ECU_ADDRESS 0xC000AFDD /end MEASUREMENT
/begin MEASUREMENT Com_bRecHeatAC "" UBYTE OneToOne 1 100 0.00 255.0 ECU_ADDRESS 0xD0001C6A /end MEASUREMENT
/begin MEASUREMENT Com_facTrqAC_mp "" SWORD Fact100 1 100 -327.6800 327.6700 FORMAT "%8.4" ECU_ADDRESS 0xC000962A /end MEASUREMENT
/begin MEASUREMENT Com_nRqStgEFan "" SWORD default 1 100 -32768.00 32767.00 FORMAT "%8.2" ECU_ADDRESS 0xD0000792 /end MEASUREMENT
/begin MEASUREMENT Com_rACFanDem "" SWORD Prc 1 100 -400.0000 399.9878 ECU_ADDRESS 0xD00007BA /end MEASUREMENT
/begin MEASUREMENT Com_rACFanDem_FA "" SWORD Prc 1 100 -400.0000 399.9878 ECU_ADDRESS 0xD00007BC /end MEASUREMENT
/begin MEASUREMENT Com_rHtFlowReq "" SWORD Prc 1 100 -400.0000 399.9878 ECU_ADDRESS 0xD00007C8 /end MEASUREMENT
/begin MEASUREMENT Com_rHtFlowReq_FA "" SWORD Prc 1 100 -400.0000 399.9878 ECU_ADDRESS 0xD00007CA /end MEASUREMENT
/begin MEASUREMENT Com_rPwrSpCons "" SWORD Prc 1 100 -400.0000 399.9878 ECU_ADDRESS 0xD00007E8 /end MEASUREMENT
/begin MEASUREMENT Com_stAC "" UBYTE OneToOne 1 100 0.00 255.0 ECU_ADDRESS 0xD0001CCC /end MEASUREMENT
/begin MEASUREMENT Com_stACEFan "" UBYTE OneToOne 1 100 0.00 255.0 ECU_ADDRESS 0xD0001CCD /end MEASUREMENT
/begin MEASUREMENT Com_stACnMin "" UBYTE OneToOne 1 100 0.00 255.0 ECU_ADDRESS 0xD0001CCF /end MEASUREMENT
/begin MEASUREMENT Com_stAC_FA "" UBYTE OneToOne 1 100 0.00 255.0 ECU_ADDRESS 0xD0001CCE /end MEASUREMENT
/begin MEASUREMENT Com_stPHtr "" UBYTE OneToOne 1 100 0.00 255.0 ECU_ADDRESS 0xD0001D49 /end MEASUREMENT
/begin MEASUREMENT Com_stPHtr_FA "" UBYTE OneToOne 1 100 0.00 255.0 ECU_ADDRESS 0xD0001D4A /end MEASUREMENT
/begin MEASUREMENT Com_swtAC "" UBYTE OneToOne 1 100 0.00 255.0 ECU_ADDRESS 0xD0001DB2 /end MEASUREMENT
/begin MEASUREMENT Com_swtAC_FA "" UBYTE OneToOne 1 100 0.00 255.0 ECU_ADDRESS 0xD0001DB3 /end MEASUREMENT
/begin MEASUREMENT Com_trqAC "" SWORD Trq 1 100 -3276.800 3276.700 ECU_ADDRESS 0xD000080C /end MEASUREMENT
/begin MEASUREMENT Com_trqAC_FA "" SWORD Trq 1 100 -3276.800 3276.700 ECU_ADDRESS 0xD000080E /end MEASUREMENT
/begin MEASUREMENT Ctrcbr "Steuerung_Stromzweige" UBYTE Def_dez_ub_q1 1 100 0.00 255. FORMAT "%3.0" ECU_ADDRESS 0xC000B045 /end MEASUREMENT
/begin MEASUREMENT Ctrpwrcf "Komfort-Teil von ctrpwrcos" UWORD Def_dez_uw_q1 1 100 0.00 65535. FORMAT "%5.0" ECU_ADDRESS 0xC00095A2 /end MEASUREMENT
/begin MEASUREMENT Ctrpwrcos "Steuerung_Leistung_Verbraucher" UWORD Def_dez_uw_q1 1 100 0.00 65535. FORMAT "%5.0" ECU_ADDRESS 0xC00095A4 /end MEASUREMENT
/begin MEASUREMENT Ctrpwrcos7 "lokales ctrpwrcos" UWORD Def_dez_uw_q1 1 100 0.00 65535. FORMAT "%5.0" ECU_ADDRESS 0xC00095A6 /end MEASUREMENT
/begin MEASUREMENT Ctrpwrdf "df-Teil von ctrpwrcos" UWORD Def_dez_uw_q1 1 100 0.00 65535. FORMAT "%5.0" ECU_ADDRESS 0xC00095A8 /end MEASUREMENT
/begin MEASUREMENT Ctrpwrentl "pmentlkor.dat / Prio CF aufgrund Entlastung" UWORD Def_dez_uw_q1 1 100 0.00 65535. FORMAT "%5.0" ECU_ADDRESS 0xC00095AA /end MEASUREMENT
/begin MEASUREMENT Ctrpwspcos "Steuerung_Leistung_Sonderverbraucher" UBYTE Def_f_ub_b127p5 1 100 0.00 127.5 FORMAT "%5.1" ECU_ADDRESS 0xC000B046 /end MEASUREMENT
/begin MEASUREMENT C_battnenn "Batteriekapazitaet" UBYTE Def_ql_ub_q1 1 100 40.0 255. FORMAT "%4.0" ECU_ADDRESS 0xC000AFDE /end MEASUREMENT
/begin MEASUREMENT Df2pi "DF-Gewichtung auf Prios" SBYTE Def_dez_sb_q1 1 100 -128. 127. FORMAT "%3.0" ECU_ADDRESS 0xC000B047 /end MEASUREMENT
/begin MEASUREMENT Dffgen_temp "Generatorauslastung zur Berechnung Spitzenlast, bei Kommfehler auf defaultwert" UBYTE Def_f_ub_b100 1 100 0.00 99.61 ECU_ADDRESS 0xC000B048 /end MEASUREMENT
/begin MEASUREMENT Dfpt1filt "Wert nach DF-Tiefpass Prio" UBYTE Def_f_ub_b100 1 100 0.00 99.61 ECU_ADDRESS 0xC000B049 /end MEASUREMENT
/begin MEASUREMENT Dfpt1ptc "Wert nach DFFGEN-Filter PTC" UBYTE Def_f_ub_b100 1 100 0.00 99.61 ECU_ADDRESS 0xC000B04A /end MEASUREMENT
/begin MEASUREMENT Dfpt1_2ptc "gefiltertes dffgen Gewichtung auf PTC-Ansteuerung" SBYTE Def_dez_sb_q1 1 100 -128. 127. FORMAT "%3.0" ECU_ADDRESS 0xC000B04B /end MEASUREMENT
/begin MEASUREMENT Df_pi "Hier koennte Ihr Langbezeichner stehen" UBYTE Def_f_ub_b100 1 100 0.00 99.61 ECU_ADDRESS 0xC000B04C /end MEASUREMENT
/begin MEASUREMENT Dqelad4 "diff = qlad-qladold7" UWORD Def_ql_uw_q0p29127 1 100 0.00 19088.4 FORMAT "%7.1" ECU_ADDRESS 0xC0009540 /end MEASUREMENT
/begin MEASUREMENT Dqlad4 "diff = qlad-qladold7" UWORD Def_ql_uw_q0p29127 1 100 0.00 19088.4 FORMAT "%7.1" ECU_ADDRESS 0xC0009542 /end MEASUREMENT
/begin MEASUREMENT Dsoc_msalow "Abstand zur Stfgk Grenze bei MSAStart mit niedrigster Spannungslage während letzter Fahrt" SWORD Def_f_sw_b100 1 100 -100.0000 99.99695 FORMAT "%8.4" ECU_ADDRESS 0xC00094F6 /end MEASUREMENT
/begin MEASUREMENT D_qelad "Delta Kapazität entladen" UWORD Def_ql_uw_q0p0182 1 100 0.00 1193.023 FORMAT "%8.3" ECU_ADDRESS 0xC0009544 /end MEASUREMENT
/begin MEASUREMENT D_qelad_mem "Delta Kapazität geladen" UWORD Def_ql_uw_q0p0182 1 100 0.00 1193.023 FORMAT "%8.3" ECU_ADDRESS 0xC0009546 /end MEASUREMENT
/begin MEASUREMENT D_qlad "Delta Kapazität geladen" UWORD Def_ql_uw_q0p0182 1 100 0.00 1193.023 FORMAT "%8.3" ECU_ADDRESS 0xC0009548 /end MEASUREMENT
/begin MEASUREMENT D_qladlf "Ladefaktor" ULONG Def_ql_ul_q0p000182 1 100 0.00 1193.028207 FORMAT "%11.6" ECU_ADDRESS 0xC0008BDC /end MEASUREMENT
/begin MEASUREMENT D_qlad_mem "Delta Kapazität geladen" UWORD Def_ql_uw_q0p0182 1 100 0.00 1193.023 FORMAT "%8.3" ECU_ADDRESS 0xC000954A /end MEASUREMENT
/begin MEASUREMENT D_qsfg1_int "Abstand zur Startfähigkeitsgrenze1" UWORD Def_ql_uw_q0p0182 1 100 0.00 1193.023 FORMAT "%8.3" ECU_ADDRESS 0xC0009572 /end MEASUREMENT
/begin MEASUREMENT D_qsfg2_int "Abstand zur Startfähigkeitsgrenze 2" UWORD Def_ql_uw_q0p0182 1 100 0.00 1193.023 FORMAT "%8.3" ECU_ADDRESS 0xC0009574 /end MEASUREMENT
/begin MEASUREMENT D_soc "Abstand zur Startfähigkeitsgrenze" SWORD Def_f_sw_b100 1 100 -100.0000 99.99695 FORMAT "%8.4" ECU_ADDRESS 0xC0009576 /end MEASUREMENT
/begin MEASUREMENT D_soc2 "Abstand zur Startfähigkeitsgrenze" SWORD Def_f_sw_b100 1 100 -100.0000 99.99695 FORMAT "%8.4" ECU_ADDRESS 0xC0009578 /end MEASUREMENT
/begin MEASUREMENT Ea_temp "Index für letzten EA der gekommen ist" UBYTE Def_dez_ub_q1 1 100 0.00 255. FORMAT "%3.0" ECU_ADDRESS 0xC000AFC8 /end MEASUREMENT
/begin MEASUREMENT El_last "Hier koennte Ihr Langbezeichner stehen" UWORD Def_dez_uw_q1 1 100 0.00 65535. FORMAT "%5.0" ECU_ADDRESS 0xC00095AC /end MEASUREMENT
/begin MEASUREMENT El_verb_entl "Hier koennte Ihr Langbezeichner stehen" UWORD Def_dez_uw_q1 1 100 0.00 65535. FORMAT "%5.0" ECU_ADDRESS 0xC00095AE /end MEASUREMENT
/begin MEASUREMENT Energyklst "Energiestatus zur Klemmensteuerung" UBYTE Def_dez_ub_q1 1 100 0.00 255. FORMAT "%3.0" ECU_ADDRESS 0xC000AFE4 /end MEASUREMENT
/begin MEASUREMENT Energyklstloc "Energiestatus zur Klemmensteuerung" UBYTE Def_dez_ub_q1 1 100 0.00 255. FORMAT "%3.0" ECU_ADDRESS 0xC000AFE5 /end MEASUREMENT
/begin MEASUREMENT Ges_msastop "Daueraller msa stops" ULONG Def_dez_ul_q1 1 100 0.00 4294967295. FORMAT "%7.0" ECU_ADDRESS 0xC0008BC8 /end MEASUREMENT
/begin MEASUREMENT Infsp_locdel "Infospeicher loeschen" UBYTE Def_dez_ub_q1 1 100 0.00 255. FORMAT "%3.0" ECU_ADDRESS 0xC000AFC9 /end MEASUREMENT
/begin MEASUREMENT Isoc0loc "Batteriestrom zum Zeitpunkt der Ruhespannungsmessung (lokal)" SWORD Def_i_sw_q0p001 1 100 -32.76800 32.76700 FORMAT "%8.5" ECU_ADDRESS 0xC000954C /end MEASUREMENT
/begin MEASUREMENT Iwakeupgrz "Ruhestromverletzungsgrenze, ab hier weckt u.U. das IBS." UBYTE Def_i_ub_q0p02 1 100 0.00 5.100 ECU_ADDRESS 0xC000AFDF /end MEASUREMENT
/begin MEASUREMENT Kalevcnt "Anzahl der Ruhespannungsmessungen" UBYTE Def_dez_ub_q1 1 100 0.00 255. FORMAT "%3.0" ECU_ADDRESS 0xC000AFE0 /end MEASUREMENT
/begin MEASUREMENT Km_aktfahrt "aktuell gefahrene Kilometer" UWORD Def_km_uw_q10 1 100 0.00 655350. FORMAT "%5.0" ECU_ADDRESS 0xC00094F8 /end MEASUREMENT
/begin MEASUREMENT Km_fahrtbgn "Kilometerstand bei Fahrtbeginn" UWORD Def_km_uw_q10 1 100 0.00 655350. FORMAT "%5.0" ECU_ADDRESS 0xC00094FA /end MEASUREMENT
/begin MEASUREMENT Km_u1msalow "gefahrene kilometer seid niedrigster Spannungslage U1" UWORD Def_km_uw_q10 1 100 0.00 655350. FORMAT "%5.0" ECU_ADDRESS 0xC00094FC /end MEASUREMENT
/begin MEASUREMENT Km_u2msalow "gefahrene kilometer seid niedrigster Spannungslage U2" UWORD Def_km_uw_q10 1 100 0.00 655350. FORMAT "%5.0" ECU_ADDRESS 0xC00094FE /end MEASUREMENT
/begin MEASUREMENT Km_u3msalow "gefahrene kilometer seid niedrigster Spannungslage U3" UWORD Def_dez_uw_q1 1 100 0.00 65535. FORMAT "%5.0" ECU_ADDRESS 0xC0009500 /end MEASUREMENT
/begin MEASUREMENT Km_umsalow "Kilometerstand bei niedrigster Spannungslage während letzter Fahrt" UWORD Def_km_uw_q10 1 100 0.00 655350. FORMAT "%5.0" ECU_ADDRESS 0xC0009502 /end MEASUREMENT
/begin MEASUREMENT Loc_bitpos "Aktuelles Bit gesetzt oder nicht" UBYTE Def_dez_ub_q1 1 100 0.00 255. FORMAT "%3.0" ECU_ADDRESS 0xC000B04D /end MEASUREMENT
/begin MEASUREMENT Loc_bitprio "Prio des aktuellen bits" UBYTE Def_dez_ub_q1 1 100 0.00 255. FORMAT "%3.0" ECU_ADDRESS 0xC000B04E /end MEASUREMENT
/begin MEASUREMENT Maxpi "Hier koennte Ihr Langbezeichner stehen" UBYTE Def_f_ub_b100 1 100 0.00 99.61 ECU_ADDRESS 0xC000B04F /end MEASUREMENT
/begin MEASUREMENT Memprio1 "memory 1 PI-Regler dfall2pi E60Prio" UWORD Def_f_uw_b100 1 100 0.00 99.99847 ECU_ADDRESS 0xC00095B0 /end MEASUREMENT
/begin MEASUREMENT Memprio2 "memory 2 PI-Regler dfall2pi E60Prio" UWORD Def_f_uw_b100 1 100 0.00 99.99847 ECU_ADDRESS 0xC00095B2 /end MEASUREMENT
/begin MEASUREMENT Memptc1 "memory 1 PI-Regler all2ptc PTC" UWORD Def_f_uw_b100 1 100 0.00 99.99847 ECU_ADDRESS 0xC00095B4 /end MEASUREMENT
/begin MEASUREMENT Memptc2 "memory 2 PI-Regler all2ptc PTC" UWORD Def_f_uw_b100 1 100 0.00 99.99847 ECU_ADDRESS 0xC00095B6 /end MEASUREMENT
/begin MEASUREMENT Msaav_gesetz "Msa AV (ausser PM!) gesetzt" ULONG Def_dez_ul_q1 1 100 0.00 2147483647. FORMAT "%7.0" ECU_ADDRESS 0xC0008BCC /end MEASUREMENT
/begin MEASUREMENT Msainfo "Infospeicher MSA" UBYTE Def_dez_ub_q1 1 100 0.00 255. FORMAT "%3.0" ARRAY_SIZE 50 ECU_ADDRESS 0xC000B66D /end MEASUREMENT
/begin MEASUREMENT Pmvscount "Zähler bis zum nächsten zyklischen Senden von 3b3" UBYTE Def_td_ub_q0p1 1 100 0.00 25.5 FORMAT "%4.1" ECU_ADDRESS 0xC000B050 /end MEASUREMENT
/begin MEASUREMENT Pm_index "Index zu welchem Berieich die Spannungslage gehört" UBYTE Def_dez_ub_q1 1 100 0.00 255. FORMAT "%3.0" ECU_ADDRESS 0xC000AFCA /end MEASUREMENT
/begin MEASUREMENT Pm_index2 "fuer relative Haeufigkeit" UBYTE Def_dez_ub_q1 1 100 0.00 255. FORMAT "%3.0" ECU_ADDRESS 0xC000AFCB /end MEASUREMENT
/begin MEASUREMENT Pm_index3 "Index für relative häufigkeit" UBYTE Def_dez_ub_q1 1 100 0.00 255. FORMAT "%3.0" ECU_ADDRESS 0xC000AFCC /end MEASUREMENT
/begin MEASUREMENT Pm_index4 "index für rel häufigkeit" UBYTE Def_dez_ub_q1 1 100 0.00 255. FORMAT "%3.0" ECU_ADDRESS 0xC000AFCD /end MEASUREMENT
/begin MEASUREMENT Pm_index5 "rel häufigkeit" UBYTE Def_dez_ub_q1 1 100 0.00 255. FORMAT "%3.0" ECU_ADDRESS 0xC000AFCE /end MEASUREMENT
/begin MEASUREMENT Pm_index6 "erste 256 Starts für rel fHäufigkeit" UBYTE Def_dez_ub_q1 1 100 0.00 255. FORMAT "%3.0" ECU_ADDRESS 0xC000AFCF /end MEASUREMENT
/begin MEASUREMENT Priopizw1 "Pi-Regler zw1" SWORD Def_f_sw_q0p01 1 100 -327.680 327.670 FORMAT "%7.3" ECU_ADDRESS 0xC00095B8 /end MEASUREMENT
/begin MEASUREMENT Priopizw2 "Pi-Regler zw2" SWORD Def_f_sw_b100 1 100 -100.0000 99.99695 FORMAT "%8.4" ECU_ADDRESS 0xC00095BA /end MEASUREMENT
/begin MEASUREMENT Pr_bl_mn "Prio SpannungBremslicht min)" UBYTE Def_dez_ub_q1 1 100 0.00 255. FORMAT "%3.0" ECU_ADDRESS 0xC000AFED /end MEASUREMENT
/begin MEASUREMENT Pr_bns_soll "Sollpriorität Bordnetzstabilität" UBYTE Def_dez_ub_q1 1 100 0.00 255. FORMAT "%3.0" ECU_ADDRESS 0xC000AFEE /end MEASUREMENT
/begin MEASUREMENT Pr_bn_soll "Soll Priorität" UBYTE Def_dez_ub_q1 1 100 0.00 255. FORMAT "%3.0" ECU_ADDRESS 0xC000B024 /end MEASUREMENT
/begin MEASUREMENT Pr_crash_soll "Sollpriorität bei Crash" UBYTE Def_dez_ub_q1 1 100 0.00 255. FORMAT "%3.0" ECU_ADDRESS 0xC000AFEF /end MEASUREMENT
/begin MEASUREMENT Pr_dpnmax "Prio pos und neg Gradient" UBYTE Def_dez_ub_q1 1 100 0.00 255. FORMAT "%3.0" ECU_ADDRESS 0xC000B025 /end MEASUREMENT
/begin MEASUREMENT Pr_dsc_mn "Minimalpriorität DSC" UBYTE Def_dez_ub_q1 1 100 0.00 255. FORMAT "%3.0" ECU_ADDRESS 0xC000AFF0 /end MEASUREMENT
/begin MEASUREMENT Pr_dsc_mx "Maximalpriorität DSC" UBYTE Def_dez_ub_q1 1 100 0.00 255. FORMAT "%3.0" ECU_ADDRESS 0xC000AFF1 /end MEASUREMENT
/begin MEASUREMENT Pr_dyn "max Prio aus pos und neg Gradient (dyn Verbraucher)" UBYTE Def_dez_ub_q1 1 100 0.00 255. FORMAT "%3.0" ECU_ADDRESS 0xC000B026 /end MEASUREMENT
/begin MEASUREMENT Pr_elue_mn "MinimalPriorität ELuefter" UBYTE Def_dez_ub_q1 1 100 0.00 255. FORMAT "%3.0" ECU_ADDRESS 0xC000AFF2 /end MEASUREMENT
/begin MEASUREMENT Pr_eps_mn "Minpriorität Elektrische Lenkhilfe" UBYTE Def_dez_ub_q1 1 100 0.00 255. FORMAT "%3.0" ECU_ADDRESS 0xC000AFF3 /end MEASUREMENT
/begin MEASUREMENT Pr_ewp_mn "MinimalPrio Elektrische Wassrepumpe" UBYTE Def_dez_ub_q1 1 100 0.00 255. FORMAT "%3.0" ECU_ADDRESS 0xC000AFF4 /end MEASUREMENT
/begin MEASUREMENT Pr_geblaese_mn "Minimalpriorität Geblaese" UBYTE Def_dez_ub_q1 1 100 0.00 255. FORMAT "%3.0" ECU_ADDRESS 0xC000AFF5 /end MEASUREMENT
/begin MEASUREMENT Pr_konf "maximal Priorität aller beteiligter Konfliktanforderungen" UBYTE Def_dez_ub_q1 1 100 0.00 255. FORMAT "%3.0" ECU_ADDRESS 0xC000B027 /end MEASUREMENT
/begin MEASUREMENT Pr_krapu_mn "Minimalprio Kraftstoffpumpe" UBYTE Def_dez_ub_q1 1 100 0.00 255. FORMAT "%3.0" ECU_ADDRESS 0xC000AFF6 /end MEASUREMENT
/begin MEASUREMENT Pr_licht_mn "Minimalpriorität Licht" UBYTE Def_dez_ub_q1 1 100 0.00 255. FORMAT "%3.0" ECU_ADDRESS 0xC000AFF7 /end MEASUREMENT
/begin MEASUREMENT Pr_max "Prio von U_max" UBYTE Def_dez_ub_q1 1 100 0.00 255. FORMAT "%3.0" ECU_ADDRESS 0xC000B028 /end MEASUREMENT
/begin MEASUREMENT Pr_min "Prio von U_min" UBYTE Def_dez_ub_q1 1 100 0.00 255. FORMAT "%3.0" ECU_ADDRESS 0xC000B029 /end MEASUREMENT
/begin MEASUREMENT Pr_slp_mn "Minimalpriorität Sekundärluftpumpe" UBYTE Def_dez_ub_q1 1 100 0.00 255. FORMAT "%3.0" ECU_ADDRESS 0xC000AFF8 /end MEASUREMENT
/begin MEASUREMENT Pr_soll "höchste Prio aller Sollspannungsanforderungen" UBYTE Def_dez_ub_q1 1 100 0.00 255. FORMAT "%3.0" ECU_ADDRESS 0xC000B02A /end MEASUREMENT
/begin MEASUREMENT Pr_sollmn "minimale Sollprio" UBYTE Def_dez_ub_q1 1 100 0.00 255. FORMAT "%3.0" ECU_ADDRESS 0xC000B02B /end MEASUREMENT
/begin MEASUREMENT Pr_sollmnk "minimale Sollprio bei Konflikt" UBYTE Def_dez_ub_q1 1 100 0.00 255. FORMAT "%3.0" ECU_ADDRESS 0xC000B02C /end MEASUREMENT
/begin MEASUREMENT Pr_spgw "Priorität Spannungswächter" UBYTE Def_dez_ub_q1 1 100 0.00 255. FORMAT "%3.0" ECU_ADDRESS 0xC000AFF9 /end MEASUREMENT
/begin MEASUREMENT Pr_vbres1_mn "Minimal Priorität Reserveverbraucher 1" UBYTE Def_dez_ub_q1 1 100 0.00 255. FORMAT "%3.0" ECU_ADDRESS 0xC000AFFA /end MEASUREMENT
/begin MEASUREMENT Pr_vbres1_mx "Maximal Priorität Reserveverbraucher 1" UBYTE Def_dez_ub_q1 1 100 0.00 255. FORMAT "%3.0" ECU_ADDRESS 0xC000AFFB /end MEASUREMENT
/begin MEASUREMENT Pr_vbres2_mn "Minimal Priorität Reserveverbraucher 2" UBYTE Def_dez_ub_q1 1 100 0.00 255. FORMAT "%3.0" ECU_ADDRESS 0xC000AFFC /end MEASUREMENT
/begin MEASUREMENT Pr_vbres2_mx "Maximal Priorität Reserveverbraucher 2" UBYTE Def_dez_ub_q1 1 100 0.00 255. FORMAT "%3.0" ECU_ADDRESS 0xC000AFFD /end MEASUREMENT
/begin MEASUREMENT Pr_vbres3_mn "Minimal Priorität Reserveverbraucher 3" UBYTE Def_dez_ub_q1 1 100 0.00 255. FORMAT "%3.0" ECU_ADDRESS 0xC000AFFE /end MEASUREMENT
/begin MEASUREMENT Pr_vbres3_mx "Maximal Priorität Reserveverbraucher 3" UBYTE Def_dez_ub_q1 1 100 0.00 255. FORMAT "%3.0" ECU_ADDRESS 0xC000AFFF /end MEASUREMENT
/begin MEASUREMENT Pr_vbres4_mn "Minimal Priorität Reserveverbraucher 4" UBYTE Def_dez_ub_q1 1 100 0.00 255. FORMAT "%3.0" ECU_ADDRESS 0xC000B000 /end MEASUREMENT
/begin MEASUREMENT Pr_vbres4_mx "Maximal Priorität Reserveverbraucher 4" UBYTE Def_dez_ub_q1 1 100 0.00 255. FORMAT "%3.0" ECU_ADDRESS 0xC000B001 /end MEASUREMENT
/begin MEASUREMENT Pr_vbres5_mn "Minimal Priorität Reserveverbraucher 5" UBYTE Def_dez_ub_q1 1 100 0.00 255. FORMAT "%3.0" ECU_ADDRESS 0xC000B002 /end MEASUREMENT
/begin MEASUREMENT Pr_vbres5_mx "Maximal Priorität Reserveverbraucher 5" UBYTE Def_dez_ub_q1 1 100 0.00 255. FORMAT "%3.0" ECU_ADDRESS 0xC000B003 /end MEASUREMENT
/begin MEASUREMENT Pr_wischer_mn "Minimalpriorität Scheibenwischer" UBYTE Def_dez_ub_q1 1 100 0.00 255. FORMAT "%3.0" ECU_ADDRESS 0xC000B004 /end MEASUREMENT
/begin MEASUREMENT Pr_wischer_mx "Maximalpriorität Scheibenwischer" UBYTE Def_dez_ub_q1 1 100 0.00 255. FORMAT "%3.0" ECU_ADDRESS 0xC000B005 /end MEASUREMENT
/begin MEASUREMENT Pr_ziel "Prioergebnis Main Koor (vor Dynamik Berechnung)" UBYTE Def_dez_ub_q1 1 100 0.00 255. FORMAT "%3.0" ECU_ADDRESS 0xC000B02D /end MEASUREMENT
/begin MEASUREMENT Ptcpizw1 "PTC PI Regler zw1" SWORD Def_f_sw_q0p01 1 100 -327.680 327.670 FORMAT "%7.3" ECU_ADDRESS 0xC00095BC /end MEASUREMENT
/begin MEASUREMENT Ptcpizw2 "PTC PI zw2" SWORD Def_f_sw_b100 1 100 -100.0000 99.99695 FORMAT "%8.4" ECU_ADDRESS 0xC00095BE /end MEASUREMENT
/begin MEASUREMENT Ptc_entl "Hier koennte Ihr Langbezeichner stehen" UBYTE Def_f_ub_b127p5 1 100 0.00 127.5 FORMAT "%5.1" ECU_ADDRESS 0xC000B051 /end MEASUREMENT
/begin MEASUREMENT Ptc_pwr "Maximale Leistung, die der PTC einstellen darf." UBYTE Def_f_ub_b127p5 1 100 0.00 127.5 FORMAT "%5.1" ECU_ADDRESS 0xC000B052 /end MEASUREMENT
/begin MEASUREMENT Ptc_pwr_loc "Maximale Leistung, die der PTC einstellen darf." UBYTE Def_f_ub_b127p5 1 100 0.00 127.5 FORMAT "%5.1" ECU_ADDRESS 0xC000B053 /end MEASUREMENT
/begin MEASUREMENT Qeladold "Kapazität Entladen vor Abstellen" UWORD Def_ql_uw_q0p0182 1 100 0.00 1193.023 FORMAT "%8.3" ECU_ADDRESS 0xC000954E /end MEASUREMENT
/begin MEASUREMENT Qelad_ges "Entladung aus PMINFO1_1" UWORD Def_ql_uw_q0p29127 1 100 0.00 19088.4 FORMAT "%7.1" ECU_ADDRESS 0xC0009550 /end MEASUREMENT
/begin MEASUREMENT Qelad_gesml "Entladung aus PMINFO1_1" UWORD Def_ql_uw_q0p29127 1 100 0.00 19088.4 FORMAT "%7.1" ECU_ADDRESS 0xC0009552 /end MEASUREMENT
/begin MEASUREMENT Qelad_mem "Ladungsmenge bei Beginn der Motorstoppphase" UWORD Def_ql_uw_q0p0182 1 100 0.00 1193.023 FORMAT "%8.3" ECU_ADDRESS 0xC0009504 /end MEASUREMENT
/begin MEASUREMENT Qelad_msa "verbrauchte Ladungsmenge während der vorausgegangenen Stopphase" UWORD Def_ql_uw_q0p29127 1 100 0.00 19088.4 FORMAT "%7.1" ECU_ADDRESS 0xC0009506 /end MEASUREMENT
/begin MEASUREMENT Qelad_msalow "Entlademenge während der dem MSA-Start mit niedrigster Spannungslage vorausgegangenen MSA-Stop-Phase" UWORD Def_ql_uw_q0p29127 1 100 0.00 19088.4 FORMAT "%7.1" ECU_ADDRESS 0xC0009508 /end MEASUREMENT
/begin MEASUREMENT Qelad_msa_ges "gesamte verbrauchte Ladungsmenge" UWORD Def_ql_uw_q0p29127 1 100 0.00 19088.4 FORMAT "%7.1" ECU_ADDRESS 0xC000950A /end MEASUREMENT
/begin MEASUREMENT Qladold "Kapazität Getladen vor Abstellen" UWORD Def_ql_uw_q0p0182 1 100 0.00 1193.023 FORMAT "%8.3" ECU_ADDRESS 0xC0009554 /end MEASUREMENT
/begin MEASUREMENT Qlad_ges "Entladung aus PMINFO1_1" UWORD Def_ql_uw_q0p29127 1 100 0.00 19088.4 FORMAT "%7.1" ECU_ADDRESS 0xC0009556 /end MEASUREMENT
/begin MEASUREMENT Qlad_mem "Gesamte Ladung in Batterie bei letztem MSAStart" UWORD Def_ql_uw_q0p0182 1 100 0.00 1193.023 FORMAT "%8.3" ECU_ADDRESS 0xC000950C /end MEASUREMENT
/begin MEASUREMENT Quali_spg "Spannungsqualität" UWORD Def_dez_uw_q1 1 100 0.00 65535. FORMAT "%5.0" ECU_ADDRESS 0xC000958E /end MEASUREMENT
/begin MEASUREMENT Q_bila "Kapazität Batterie (long)" ULONG Def_ql_ul_q2p7Em7 1 100 0.00 1193.046400 FORMAT "%11.6" ECU_ADDRESS 0xC0008BE0 /end MEASUREMENT
/begin MEASUREMENT Q_bila_temp "Hier koennte Ihr Langbezeichner stehen" UWORD Def_f_uw_b256 1 100 0.00 255.9961 FORMAT "%8.4" ECU_ADDRESS 0xC0009558 /end MEASUREMENT
/begin MEASUREMENT Redtimer "Hier koennte Ihr Langbezeichner stehen" UWORD Def_dez_uw_q1 1 100 0.00 65535. FORMAT "%5.0" ECU_ADDRESS 0xC00095C0 /end MEASUREMENT
/begin MEASUREMENT Redtimer_1 "Zähler der zur Bestimmung der Verbraucherreduzierungsdauer gesetzt wird" UWORD Def_dez_uw_q1 1 100 0.00 65535. FORMAT "%5.0" ECU_ADDRESS 0xC00095C2 /end MEASUREMENT
/begin MEASUREMENT Redtimer_10 "Zähler der zur Bestimmung der Verbraucherreduzierungsdauer gesetzt wird" UWORD Def_dez_uw_q1 1 100 0.00 65535. FORMAT "%5.0" ECU_ADDRESS 0xC00095C4 /end MEASUREMENT
/begin MEASUREMENT Redtimer_11 "Zähler der zur Bestimmung der Verbraucherreduzierungsdauer gesetzt wird" UWORD Def_dez_uw_q1 1 100 0.00 65535. FORMAT "%5.0" ECU_ADDRESS 0xC00095C6 /end MEASUREMENT
/begin MEASUREMENT Redtimer_12 "Zähler der zur Bestimmung der Verbraucherreduzierungsdauer gesetzt wird" UWORD Def_dez_uw_q1 1 100 0.00 65535. FORMAT "%5.0" ECU_ADDRESS 0xC00095C8 /end MEASUREMENT
/begin MEASUREMENT Redtimer_1b "Zähler der zur Bestimmung der Verbraucherreduzierungsdauer gesetzt wird" UWORD Def_dez_uw_q1 1 100 0.00 65535. FORMAT "%5.0" ECU_ADDRESS 0xC00095CA /end MEASUREMENT
/begin MEASUREMENT Redtimer_2 "Zähler der zur Bestimmung der Verbraucherreduzierungsdauer gesetzt wird" UWORD Def_dez_uw_q1 1 100 0.00 65353. FORMAT "%5.0" ECU_ADDRESS 0xC00095CC /end MEASUREMENT
/begin MEASUREMENT Redtimer_2b "Zähler der zur Bestimmung der Verbraucherreduzierungsdauer gesetzt wird" UWORD Def_dez_uw_q1 1 100 0.00 65535. FORMAT "%5.0" ECU_ADDRESS 0xC00095CE /end MEASUREMENT
/begin MEASUREMENT Redtimer_3 "Zähler der zur Bestimmung der Verbraucherreduzierungsdauer gesetzt wird" UWORD Def_dez_uw_q1 1 100 0.00 65535. FORMAT "%5.0" ECU_ADDRESS 0xC00095D0 /end MEASUREMENT
/begin MEASUREMENT Redtimer_3b "Zähler der zur Bestimmung der Verbraucherreduzierungsdauer gesetzt wird" UWORD Def_dez_uw_q1 1 100 0.00 65535. FORMAT "%5.0" ECU_ADDRESS 0xC00095D2 /end MEASUREMENT
/begin MEASUREMENT Redtimer_4 "Zähler der zur Bestimmung der Verbraucherreduzierungsdauer gesetzt wird" UWORD Def_dez_uw_q1 1 100 0.00 65535. FORMAT "%5.0" ECU_ADDRESS 0xC00095D4 /end MEASUREMENT
/begin MEASUREMENT Redtimer_5 "Zähler der zur Bestimmung der Verbraucherreduzierungsdauer gesetzt wird" UWORD Def_dez_uw_q1 1 100 0.00 65535. FORMAT "%5.0" ECU_ADDRESS 0xC00095D6 /end MEASUREMENT
/begin MEASUREMENT Redtimer_6 "Zähler der zur Bestimmung der Verbraucherreduzierungsdauer gesetzt wird" UWORD Def_dez_uw_q1 1 100 0.00 65535. FORMAT "%5.0" ECU_ADDRESS 0xC00095D8 /end MEASUREMENT
/begin MEASUREMENT Redtimer_7 "Zähler der zur Bestimmung der Verbraucherreduzierungsdauer gesetzt wird" UWORD Def_dez_uw_q1 1 100 0.00 65535. FORMAT "%5.0" ECU_ADDRESS 0xC00095DA /end MEASUREMENT
/begin MEASUREMENT Redtimer_8 "Zähler der zur Bestimmung der Verbraucherreduzierungsdauer gesetzt wird" UWORD Def_dez_uw_q1 1 100 0.00 65535. FORMAT "%5.0" ECU_ADDRESS 0xC00095DC /end MEASUREMENT
/begin MEASUREMENT Redtimer_9 "Zähler der zur Bestimmung der Verbraucherreduzierungsdauer gesetzt wird" UWORD Def_dez_uw_q1 1 100 0.00 65535. FORMAT "%5.0" ECU_ADDRESS 0xC00095DE /end MEASUREMENT
/begin MEASUREMENT Ri_batt "Hier koennte Ihr Langbezeichner stehen" UBYTE Def_f_ub_q0p001 1 100 0.00 0.25500 FORMAT "%7.5" ECU_ADDRESS 0xC000AFE2 /end MEASUREMENT
/begin MEASUREMENT Rqpcos "Anforderung_Standverbraucher" UBYTE Def_dez_ub_q1 1 100 0.00 3.0 ECU_ADDRESS 0xC000B054 /end MEASUREMENT
/begin MEASUREMENT R_leitung "Berechneter Widerstand Ladeleitung" UWORD Def_f_uw_b2 1 100 0.00 1.999908447266 FORMAT "%14.12" ECU_ADDRESS 0xC0009598 /end MEASUREMENT
/begin MEASUREMENT R_leitung_f "Berechneter Widerstand Ladeleitung gefiltert" UWORD Def_f_uw_b2 1 100 0.00 1.999908447266 FORMAT "%14.12" ECU_ADDRESS 0xC000959A /end MEASUREMENT
/begin MEASUREMENT Selspcos "Auswahl_Sonderverbraucher" UBYTE Def_dez_ub_q1 1 100 0.00 15. FORMAT "%3.0" ECU_ADDRESS 0xC000B055 /end MEASUREMENT
/begin MEASUREMENT Soc_bila "Ladezustand durch Bilanzierung und Ruhespannungsmessung ermittelt" UWORD Def_f_uw_b100 1 100 0.00 99.99847 ECU_ADDRESS 0xC000955A /end MEASUREMENT
/begin MEASUREMENT Soc_b_loc "lokal soc_bila f. KFSOCLF" UWORD Def_f_uw_b100 1 100 0.00 99.99847 ECU_ADDRESS 0xC000955C /end MEASUREMENT
/begin MEASUREMENT Soc_fit "SoC aus der Fitformel" UWORD Def_f_uw_b100 1 100 0.00 99.99847 ECU_ADDRESS 0xC0009568 /end MEASUREMENT
/begin MEASUREMENT Soc_fit_temp "Hier koennte Ihr Langbezeichner stehen" UWORD Def_f_uw_b100 1 100 0.00 99.99847 ECU_ADDRESS 0xC000956A /end MEASUREMENT
/begin MEASUREMENT Soc_fit_unfilt "Hier koennte Ihr Langbezeichner stehen" UWORD Def_f_uw_b100 1 100 0.00 99.99847 ECU_ADDRESS 0xC000956C /end MEASUREMENT
/begin MEASUREMENT Soc_korr "Korrekturwert soc_bila" SWORD Def_f_sw_b100 1 100 -100.0000 99.99695 FORMAT "%8.4" ECU_ADDRESS 0xC000957A /end MEASUREMENT
/begin MEASUREMENT Soc_quali "Zähler Genauigkeit Ladeztustandsbestimmung" UWORD Def_ql_uw_q0p0182 1 100 0.00 1193.023 FORMAT "%8.3" ECU_ADDRESS 0xC000955E /end MEASUREMENT
/begin MEASUREMENT Soc_q_kor "Korrekturwert Genauigkeit Ladezustandsbestimmung" UWORD Def_ql_uw_q0p0182 1 100 0.00 1193.023 FORMAT "%8.3" ECU_ADDRESS 0xC000957C /end MEASUREMENT
/begin MEASUREMENT Soc_q_loc "lokaler Zähler Genauigkeit Ladeztustandsbestimmung" UWORD Def_ql_uw_q0p0182 1 100 0.00 1193.023 FORMAT "%8.3" ECU_ADDRESS 0xC0009560 /end MEASUREMENT
/begin MEASUREMENT Soc_rel "Relativzähler für Ladezustand SoC" UWORD Def_f_uw_b100 1 100 0.00 99.99847 ECU_ADDRESS 0xC000957E /end MEASUREMENT
/begin MEASUREMENT Soc_stfgk "Startfähigkeitsgrenze" UWORD Def_f_uw_b100 1 100 0.00 99.99847 ECU_ADDRESS 0xC0009580 /end MEASUREMENT
/begin MEASUREMENT Soc_stfgk2 "Startfähigkeitsgrenze" UWORD Def_f_uw_b100 1 100 0.00 99.99847 ECU_ADDRESS 0xC0009582 /end MEASUREMENT
/begin MEASUREMENT Stpdr_msalow "Stopdauer des MSA Stops mit niedrigster Startspannungslage bei letztem Motorstart während letzter Fahrt" UWORD Def_dez_uw_q1 1 100 0.00 65535. FORMAT "%5.0" ECU_ADDRESS 0xC000950E /end MEASUREMENT
/begin MEASUREMENT St_aepsocfit "Statuswort" UBYTE Def_st_ub_q1 1 100 0.00 255. FORMAT "%3.0" ECU_ADDRESS 0xC000AFE3 /end MEASUREMENT
/begin MEASUREMENT St_aepsockor0 "Statuswort" UBYTE Def_st_ub_q1 1 100 0.00 255. FORMAT "%3.0" ECU_ADDRESS 0xC000AFE6 /end MEASUREMENT
/begin MEASUREMENT St_aepsockor1 "Statuswort" UBYTE Def_st_ub_q1 1 100 0.00 255. FORMAT "%3.0" ECU_ADDRESS 0xC000AFE7 /end MEASUREMENT
/begin MEASUREMENT St_aepsockor_nv "Statuswort" UBYTE Def_st_ub_q1 1 100 0.00 255. FORMAT "%3.0" ECU_ADDRESS 0xC000AFE8 /end MEASUREMENT
/begin MEASUREMENT St_aepsocstart0 "Statuswort" UBYTE Def_st_ub_q1 1 100 0.00 255. FORMAT "%3.0" ECU_ADDRESS 0xC000AFE9 /end MEASUREMENT
/begin MEASUREMENT St_aepubnkor "Statuswort" UBYTE Def_st_ub_q1 1 100 0.00 255. FORMAT "%3.0" ECU_ADDRESS 0xC000B02E /end MEASUREMENT
/begin MEASUREMENT St_aepverbred "Statuswort" UBYTE Def_st_ub_q1 1 100 0.00 255. FORMAT "%3.0" ECU_ADDRESS 0xC000B056 /end MEASUREMENT
/begin MEASUREMENT St_aepverbred2 "Statuswort" UBYTE Def_st_ub_q1 1 100 0.00 255. FORMAT "%3.0" ECU_ADDRESS 0xC000B057 /end MEASUREMENT
/begin MEASUREMENT St_aepverbredsp0 "Statuswort" UBYTE Def_st_ub_q1 1 100 0.00 255. FORMAT "%3.0" ECU_ADDRESS 0xC000B05D /end MEASUREMENT
/begin MEASUREMENT St_bns "Statuswort" UBYTE Def_st_ub_q1 1 100 0.00 255. FORMAT "%3.0" ECU_ADDRESS 0xC000B006 /end MEASUREMENT
/begin MEASUREMENT St_pmentl0 "Statuswort" UBYTE Def_st_ub_q1 1 100 0.00 255. FORMAT "%3.0" ECU_ADDRESS 0xC000B058 /end MEASUREMENT
/begin MEASUREMENT St_pmmsadiag0 "Statuswort" UBYTE Def_st_ub_q1 1 100 0.00 255. FORMAT "%3.0" ECU_ADDRESS 0xC000AFD0 /end MEASUREMENT
/begin MEASUREMENT St_pmprsvcalc1 "Statuswort" UBYTE Def_st_ub_q1 1 100 0.00 255. FORMAT "%3.0" ECU_ADDRESS 0xC000B059 /end MEASUREMENT
/begin MEASUREMENT St_pmsoccalc "Statuswort" UBYTE Def_st_ub_q1 1 100 0.00 255. FORMAT "%3.0" ECU_ADDRESS 0xC000AFE1 /end MEASUREMENT
/begin MEASUREMENT St_pmspgw "Statuswort" UBYTE Def_st_ub_q1 1 100 0.00 255. FORMAT "%3.0" ECU_ADDRESS 0xC000B007 /end MEASUREMENT
/begin MEASUREMENT St_pmspgw1 "Statuswort" UBYTE Def_st_ub_q1 1 100 0.00 255. FORMAT "%3.0" ECU_ADDRESS 0xC000B008 /end MEASUREMENT
/begin MEASUREMENT St_pmukomp "Statuswort" UBYTE Def_st_ub_q1 1 100 0.00 255. FORMAT "%3.0" ECU_ADDRESS 0xC000B039 /end MEASUREMENT
/begin MEASUREMENT St_pmukomp2 "Statuswort" UBYTE Def_st_ub_q1 1 100 0.00 255. FORMAT "%3.0" ECU_ADDRESS 0xC000B03A /end MEASUREMENT
/begin MEASUREMENT St_ugenkor0 "Statuswort" UBYTE Def_st_ub_q1 1 100 0.00 255. FORMAT "%3.0" ECU_ADDRESS 0xC000B03B /end MEASUREMENT
/begin MEASUREMENT St_ugenkor1 "Statuswort" UBYTE Def_st_ub_q1 1 100 0.00 255. FORMAT "%3.0" ECU_ADDRESS 0xC000B03C /end MEASUREMENT
/begin MEASUREMENT Sync_stopend "nach MSA Stop Ende wird mitdiesem Zähler befüllen des Infospeichers überprüft" UBYTE Def_dez_ub_q1 1 100 0.00 255. FORMAT "%3.0" ECU_ADDRESS 0xC000AFD1 /end MEASUREMENT
/begin MEASUREMENT Tsocloc "Batterietemperatur zum Zeitpunkt der Ruhespannungsmessung (lokal)" SWORD Def_t_sw_q0p1 1 100 -3276.8 3276.7 FORMAT "%6.1" ECU_ADDRESS 0xC0009562 /end MEASUREMENT
/begin MEASUREMENT T_saison "Saison -Temperatur" SWORD Def_t_sw_q0p1 1 100 -3276.8 3276.7 FORMAT "%6.1" ECU_ADDRESS 0xC0009584 /end MEASUREMENT
/begin MEASUREMENT T_saisonalt "letzter Wert Saisontemperatur" SWORD Def_t_sw_q0p1 1 100 -3276.8 3276.7 FORMAT "%6.1" ECU_ADDRESS 0xC0009586 /end MEASUREMENT
/begin MEASUREMENT U1_inf "Wert im Infospeicher" UBYTE Def_dez_ub_q1 1 100 0.00 255. FORMAT "%3.0" ECU_ADDRESS 0xC000AFD2 /end MEASUREMENT
/begin MEASUREMENT U1_minspg "minimale Spannungslage U1" UWORD Def_u_uw_q0p032 1 100 0.00 2097.120 FORMAT "%8.3" ECU_ADDRESS 0xC0009510 /end MEASUREMENT
/begin MEASUREMENT U2_inf "Wert im Infospeicher" UBYTE Def_dez_ub_q1 1 100 0.00 255. FORMAT "%3.0" ECU_ADDRESS 0xC000AFD3 /end MEASUREMENT
/begin MEASUREMENT U2_minspg "minimale Spannungslage U2" UWORD Def_u_uw_q0p032 1 100 0.00 2097.120 FORMAT "%8.3" ECU_ADDRESS 0xC0009512 /end MEASUREMENT
/begin MEASUREMENT U3_inf "Wret im Infospeicher" UBYTE Def_dez_ub_q1 1 100 0.00 255. FORMAT "%3.0" ECU_ADDRESS 0xC000AFD4 /end MEASUREMENT
/begin MEASUREMENT Ubatt0 "Aus Wertetripel ausgewählter Ruhespannungswert" UWORD Def_u_uw_q0p25em3_o6 1 100 6.0000000 22.383750 FORMAT "%9.6" ECU_ADDRESS 0xC0009564 /end MEASUREMENT
/begin MEASUREMENT Ubw_uszr "Schwingungszähler Bordnetzspannung" UBYTE Def_dez_ub_q1 1 100 0.00 255. FORMAT "%3.0" ECU_ADDRESS 0xC000B009 /end MEASUREMENT
/begin MEASUREMENT Ubw_zr "Zähler Bordnetzspannung instabil" UWORD Def_dez_uw_q1 1 100 0.00 65535. FORMAT "%5.0" ECU_ADDRESS 0xC0009590 /end MEASUREMENT
/begin MEASUREMENT Ub_komp "Hier koennte Ihr Langbezeichner stehen" UBYTE Def_u_ub_q0p1 1 100 0.00 25.50 FORMAT "%5.2" ECU_ADDRESS 0xC000B00A /end MEASUREMENT
/begin MEASUREMENT Ulev "Spannungsebene" UBYTE Def_dez_ub_q1 1 100 0.00 15. FORMAT "%3.0" ECU_ADDRESS 0xC000B05A /end MEASUREMENT
/begin MEASUREMENT Ulzr "Zähler für Erkennung zyklischer Spannungseinbruch" UWORD Def_dez_uw_q1 1 100 0.00 65535. FORMAT "%5.0" ECU_ADDRESS 0xC0009592 /end MEASUREMENT
/begin MEASUREMENT Uszr "Zähler für Erkennung dauerhafter Spannungseinbruch" UWORD Def_dez_uw_q1 1 100 0.00 65535. FORMAT "%5.0" ECU_ADDRESS 0xC0009594 /end MEASUREMENT
/begin MEASUREMENT U_bl_mn "MinSpannung Bremslicht" UBYTE Def_u_ub_q0p1 1 100 0.00 25.50 FORMAT "%5.2" ECU_ADDRESS 0xC000B00B /end MEASUREMENT
/begin MEASUREMENT U_bns_soll "Sollspannung Bordnetzstabilität" UBYTE Def_u_ub_q0p1 1 100 0.00 25.50 FORMAT "%5.2" ECU_ADDRESS 0xC000B00C /end MEASUREMENT
/begin MEASUREMENT U_bn_soll "Soll Bordnetzspg" UBYTE Def_u_ub_q0p1 1 100 0.00 25.50 FORMAT "%5.2" ECU_ADDRESS 0xC000B02F /end MEASUREMENT
/begin MEASUREMENT U_crash_soll "Sollspannung bei Crash" UBYTE Def_u_ub_q0p1 1 100 0.00 25.50 FORMAT "%5.2" ECU_ADDRESS 0xC000B00D /end MEASUREMENT
/begin MEASUREMENT U_dgen "Delta U_gen neu zu U_gen alt" UBYTE Def_u_ub_q0p1 1 100 0.00 25.50 FORMAT "%5.2" ECU_ADDRESS 0xC000B03D /end MEASUREMENT
/begin MEASUREMENT U_dpnmax "Spg pos und neg Gradient" UBYTE Def_u_ub_b0p5 1 100 0.00 0.498047 FORMAT "%8.6" ECU_ADDRESS 0xC000B030 /end MEASUREMENT
/begin MEASUREMENT U_dsc_mn "Minimalspannung DSC" UBYTE Def_u_ub_q0p1 1 100 0.00 25.50 FORMAT "%5.2" ECU_ADDRESS 0xC000B00E /end MEASUREMENT
/begin MEASUREMENT U_dsc_mx "Maximalspannung DSC" UBYTE Def_u_ub_q0p1 1 100 0.00 25.50 FORMAT "%5.2" ECU_ADDRESS 0xC000B00F /end MEASUREMENT
/begin MEASUREMENT U_dynmax "max Spannung dyn Verbraucher" UBYTE Def_u_ub_q0p1 1 100 0.00 25.50 FORMAT "%5.2" ECU_ADDRESS 0xC000B031 /end MEASUREMENT
/begin MEASUREMENT U_dynmin "min Spg dyn Verbraucher" UBYTE Def_u_ub_q0p1 1 100 0.00 25.50 FORMAT "%5.2" ECU_ADDRESS 0xC000B032 /end MEASUREMENT
/begin MEASUREMENT U_dyn_komp "über berechneten Widerstand ermittelter Spannungsabfall" UBYTE Def_u_ub_q0p1 1 100 0.00 25.50 FORMAT "%5.2" ECU_ADDRESS 0xC000B03E /end MEASUREMENT
/begin MEASUREMENT U_elue_mn "MinSpannung Elüfter" UBYTE Def_u_ub_q0p1 1 100 0.00 25.50 FORMAT "%5.2" ECU_ADDRESS 0xC000B010 /end MEASUREMENT
/begin MEASUREMENT U_eps_mn "Minspannung Elektrische Lenkhilfe" UBYTE Def_u_ub_q0p1 1 100 0.00 25.50 FORMAT "%5.2" ECU_ADDRESS 0xC000B011 /end MEASUREMENT
/begin MEASUREMENT U_eps_stat "Hier koennte Ihr Langbezeichner stehen" UBYTE Def_u_ub_q0p1 1 100 0.00 25.50 FORMAT "%5.2" ECU_ADDRESS 0xC000B012 /end MEASUREMENT
/begin MEASUREMENT U_ewp_mn "Minspannung Elektrische Wasserpumpe" UBYTE Def_u_ub_q0p1 1 100 0.00 25.50 FORMAT "%5.2" ECU_ADDRESS 0xC000B013 /end MEASUREMENT
/begin MEASUREMENT U_geblaese_mn "Minimalspannung Geblaese" UBYTE Def_u_ub_q0p1 1 100 0.00 25.50 FORMAT "%5.2" ECU_ADDRESS 0xC000B014 /end MEASUREMENT
/begin MEASUREMENT U_gen "Vorgabe Generator-Sollspannung (Ausgabewert)" UWORD Def_u_uw_q0p1 1 100 0.00 6553.500 FORMAT "%8.3" ECU_ADDRESS 0xC000959C /end MEASUREMENT
/begin MEASUREMENT U_gen2 "Generator RollsRoyce, Sicherheitsfzg" UWORD Def_u_uw_q0p1 1 100 0.00 6553.500 FORMAT "%8.3" ECU_ADDRESS 0xC000959E /end MEASUREMENT
/begin MEASUREMENT U_gen_old "Wert von U_gen für t-100ms" UWORD Def_u_uw_q0p1 1 100 0.00 6553.500 FORMAT "%8.3" ECU_ADDRESS 0xC00095A0 /end MEASUREMENT
/begin MEASUREMENT U_grenz "Grenzwert Spannung" UWORD Def_u_uw_q0p25em3_o6 1 100 6.0000000 22.383750 FORMAT "%9.6" ECU_ADDRESS 0xC0009588 /end MEASUREMENT
/begin MEASUREMENT U_gsoll_tp3 "unklar" UWORD Def_u_uw_q0p1 1 100 0.00 6553.500 FORMAT "%8.3" ECU_ADDRESS 0xC0009596 /end MEASUREMENT
/begin MEASUREMENT U_konf "Spannung mit maximaler Priorität aller Konfliktanforderungen" UBYTE Def_u_ub_q0p1 1 100 0.00 25.50 FORMAT "%5.2" ECU_ADDRESS 0xC000B033 /end MEASUREMENT
/begin MEASUREMENT U_krapu_mn "Minspannung Kraftstoffpumpe" UBYTE Def_u_ub_q0p1 1 100 0.00 25.50 FORMAT "%5.2" ECU_ADDRESS 0xC000B015 /end MEASUREMENT
/begin MEASUREMENT U_lcpkomp "Generatorsollspannungsvorgabe für LCP kompensiert" UBYTE Def_u_ub_q0p1 1 100 0.00 25.50 FORMAT "%5.2" ECU_ADDRESS 0xC000B03F /end MEASUREMENT
/begin MEASUREMENT U_licht_mn "Minimalspannung Licht" UBYTE Def_u_ub_q0p1 1 100 0.00 25.50 FORMAT "%5.2" ECU_ADDRESS 0xC000B016 /end MEASUREMENT
/begin MEASUREMENT U_llfit "Hilfswert2 Spannung aus Fitberechnung" UWORD Def_u_uw_q0p25em3_o6 1 100 6.0000000 16.000000 FORMAT "%9.6" ECU_ADDRESS 0xC000956E /end MEASUREMENT
/begin MEASUREMENT U_max "max Spannung" UBYTE Def_u_ub_q0p1 1 100 0.00 25.50 FORMAT "%5.2" ECU_ADDRESS 0xC000B034 /end MEASUREMENT
/begin MEASUREMENT U_min "min Spannung" UBYTE Def_u_ub_q0p1 1 100 0.00 25.50 FORMAT "%5.2" ECU_ADDRESS 0xC000B035 /end MEASUREMENT
/begin MEASUREMENT U_slp_mn "Minimalspannung Sekundärluftpumpe" UBYTE Def_u_ub_q0p1 1 100 0.00 25.50 FORMAT "%5.2" ECU_ADDRESS 0xC000B017 /end MEASUREMENT
/begin MEASUREMENT U_soll "Sollspannung" UBYTE Def_u_ub_q0p1 1 100 0.00 25.50 FORMAT "%5.2" ECU_ADDRESS 0xC000B036 /end MEASUREMENT
/begin MEASUREMENT U_startausw "U_tnstart - ugrenz" SWORD Def_u_sw_q0p00025 1 100 -8.1920000 8.1917500 ECU_ADDRESS 0xC000958A /end MEASUREMENT
/begin MEASUREMENT U_strtmsalow "niedrigste Spannungslage bei MSA Start innerhalb der letzten Fahrt" UWORD Def_u_uw_q0p032 1 100 0.00 2097.120 FORMAT "%8.3" ECU_ADDRESS 0xC0009514 /end MEASUREMENT
/begin MEASUREMENT U_tnstartmsa "Spannungslage beim Start" UWORD Def_u_uw_q0p032 1 100 0.00 2097.120 FORMAT "%8.3" ECU_ADDRESS 0xC000958C /end MEASUREMENT
/begin MEASUREMENT U_vbres1_mn "MinSpannung Reserveverbraucher 1" UBYTE Def_u_ub_q0p1 1 100 0.00 25.50 FORMAT "%5.2" ECU_ADDRESS 0xC000B018 /end MEASUREMENT
/begin MEASUREMENT U_vbres1_mx "MaxSpannung Reserveverbraucher 1" UBYTE Def_u_ub_q0p1 1 100 0.00 25.50 FORMAT "%5.2" ECU_ADDRESS 0xC000B019 /end MEASUREMENT
/begin MEASUREMENT U_vbres2_mn "MinSpannung Reserveverbraucher 2" UBYTE Def_u_ub_q0p1 1 100 0.00 25.50 FORMAT "%5.2" ECU_ADDRESS 0xC000B01A /end MEASUREMENT
/begin MEASUREMENT U_vbres2_mx "MaxSpannung Reserveverbraucher 2" UBYTE Def_u_ub_q0p1 1 100 0.00 25.50 FORMAT "%5.2" ECU_ADDRESS 0xC000B01B /end MEASUREMENT
/begin MEASUREMENT U_vbres3_mn "MinSpannung Reserveverbraucher 3" UBYTE Def_u_ub_q0p1 1 100 0.00 25.50 FORMAT "%5.2" ECU_ADDRESS 0xC000B01C /end MEASUREMENT
/begin MEASUREMENT U_vbres3_mx "MaxSpannung Reserveverbraucher 3" UBYTE Def_u_ub_q0p1 1 100 0.00 25.50 FORMAT "%5.2" ECU_ADDRESS 0xC000B01D /end MEASUREMENT
/begin MEASUREMENT U_vbres4_mn "MinSpannung Reserveverbraucher 4" UBYTE Def_u_ub_q0p1 1 100 0.00 25.50 FORMAT "%5.2" ECU_ADDRESS 0xC000B01E /end MEASUREMENT
/begin MEASUREMENT U_vbres4_mx "MaxSpannung Reserveverbraucher 4" UBYTE Def_u_ub_q0p1 1 100 0.00 25.50 FORMAT "%5.2" ECU_ADDRESS 0xC000B01F /end MEASUREMENT
/begin MEASUREMENT U_vbres5_mn "MinSpannung Reserveverbraucher 5" UBYTE Def_u_ub_q0p1 1 100 0.00 25.50 FORMAT "%5.2" ECU_ADDRESS 0xC000B020 /end MEASUREMENT
/begin MEASUREMENT U_vbres5_mx "MaxSpannung Reserveverbraucher 5" UBYTE Def_u_ub_q0p1 1 100 0.00 25.50 FORMAT "%5.2" ECU_ADDRESS 0xC000B021 /end MEASUREMENT
/begin MEASUREMENT U_wischer_mn "Minimalspannung Scheibenwischer" UBYTE Def_u_ub_q0p1 1 100 0.00 25.50 FORMAT "%5.2" ECU_ADDRESS 0xC000B022 /end MEASUREMENT
/begin MEASUREMENT U_wischer_mx "Maximalspannung Scheibenwischer" UBYTE Def_u_ub_q0p1 1 100 0.00 25.50 FORMAT "%5.2" ECU_ADDRESS 0xC000B023 /end MEASUREMENT
/begin MEASUREMENT U_ziel "Ergebnis der Spannungsermittlung (vor Dynamik Berechnung)" UBYTE Def_u_ub_q0p1 1 100 0.00 25.50 FORMAT "%5.2" ECU_ADDRESS 0xC000B037 /end MEASUREMENT
/begin MEASUREMENT Verbreddur "Dauer der Verbraucherreduzierung" UBYTE Def_dez_ub_q1 1 100 0.00 255. FORMAT "%3.0" ECU_ADDRESS 0xC000B05E /end MEASUREMENT
/begin MEASUREMENT Verbredinfo "Ringspeicher zum speichern von Verbraucherreduzierungsinfos" UBYTE Def_dez_ub_q1 1 100 0.00 255. FORMAT "%3.0" ARRAY_SIZE 20 ECU_ADDRESS 0xC000B69F /end MEASUREMENT
/begin MEASUREMENT Verbredpramx "Maximaler Priowert wird in Ringspeicher geschrieben" UBYTE Def_dez_ub_q1 1 100 0.00 255. FORMAT "%3.0" ECU_ADDRESS 0xC000B05F /end MEASUREMENT
/begin MEASUREMENT Verbredprbmx "Maximaler Priowert wird in Ringspeicher geschrieben" UBYTE Def_dez_ub_q1 1 100 0.00 255. FORMAT "%3.0" ECU_ADDRESS 0xC000B060 /end MEASUREMENT
/begin MEASUREMENT Verbredprioa "aepverbredsp.dat" UBYTE Def_dez_ub_q1 1 100 0.00 255. FORMAT "%3.0" ECU_ADDRESS 0xC000B05B /end MEASUREMENT
/begin MEASUREMENT Verbredpriob "aepverbredsp.dat" UBYTE Def_dez_ub_q1 1 100 0.00 255. FORMAT "%3.0" ECU_ADDRESS 0xC000B05C /end MEASUREMENT
/begin MEASUREMENT Verbredtp "Zähler zum umspeichern der Werte im Speicher" UBYTE Def_dez_ub_q1 1 100 0.00 255. FORMAT "%3.0" ECU_ADDRESS 0xC000B061 /end MEASUREMENT
/begin MEASUREMENT Vollzyklen "Hier koennte Ihr Langbezeichner stehen" UWORD Def_f_uw_q1 1 100 0.00 65535. FORMAT "%5.0" ECU_ADDRESS 0xC0009566 /end MEASUREMENT
/begin MEASUREMENT X_KL_ITNSTART_no_input_quantity "This variable is artificially generated, since DAMOS does not (yet) support 'NO_INPUT_QUANTITY' references at PaVaSt files. It is exclusively referenced by the X axis of calibration parameter 'KL_ITNSTART'." UBYTE Def_i_ub_b1000 1 100 0.00 996.09 ECU_ADDRESS 0xC000AFEA /end MEASUREMENT
/begin MEASUREMENT X_KL_ITNSTRMSA_no_input_quantity "This variable is artificially generated, since DAMOS does not (yet) support 'NO_INPUT_QUANTITY' references at PaVaSt files. It is exclusively referenced by the X axis of calibration parameter 'KL_ITNSTRMSA'." UBYTE Def_i_ub_b1000 1 100 0.00 996.09 ECU_ADDRESS 0xC000AFEB /end MEASUREMENT
/begin MEASUREMENT Zaehler_ges "Anzahl alle Motorstarts eid letzter Batterietausch" ULONG Def_dez_ul_q1 1 100 0.00 4294967295. FORMAT "%7.0" ECU_ADDRESS 0xC0008BD0 /end MEASUREMENT
/begin MEASUREMENT Zaehler_msa "Zähler alle MSA starts seid letztem Batterietausch" ULONG Def_dez_ul_q1 1 100 0.00 4294967295. FORMAT "%7.0" ECU_ADDRESS 0xC0008BD4 /end MEASUREMENT
/begin MEASUREMENT Zeit_msastop "Dauer des letzten MSA Motorstop" UWORD Def_dez_uw_q1 1 100 0.00 65535. FORMAT "%5.0" ECU_ADDRESS 0xC0009516 /end MEASUREMENT
/begin MEASUREMENT Zvar1 "Entlademenge ohne Quantisierung" UWORD Def_dez_uw_q1 1 100 0.00 65535. FORMAT "%5.0" ECU_ADDRESS 0xC0009518 /end MEASUREMENT
/begin MEASUREMENT Zvar10 "Delta der aktuellen Startspannung zu der im Infospeicher, gefiltert" SWORD Def_u_sw_q0p00488 1 100 -160.0000 159.9951 FORMAT "%8.4" ECU_ADDRESS 0xC000951A /end MEASUREMENT
/begin MEASUREMENT Zvar13 "Stopdauer, vor aktuellem MSA-Stop" ULONG Def_dez_ul_q1 1 100 0.00 4294967295. FORMAT "%7.0" ECU_ADDRESS 0xC0008BD8 /end MEASUREMENT
/begin MEASUREMENT Zvar18 "Maximalwert der Häufigkeitsverteilung" UWORD Def_dez_uw_q1 1 100 1.000 65535. FORMAT "%5.0" ECU_ADDRESS 0xC000951C /end MEASUREMENT
/begin MEASUREMENT Zvar19 "Betrag der Häufigkeitsverteilung Stopdauern unter 5s" UWORD Def_dez_uw_q1 1 100 0.00 65535. FORMAT "%5.0" ECU_ADDRESS 0xC000951E /end MEASUREMENT
/begin MEASUREMENT Zvar2 "Entlademenge Quantisierung berücksichtigt" UWORD Def_ql_uw_q0p29127 1 100 0.00 19088.4 FORMAT "%7.1" ECU_ADDRESS 0xC0009520 /end MEASUREMENT
/begin MEASUREMENT Zvar20 "Betrag der Häufigkeitsverteilung Stopdauern zwischen 5s und 20s" UWORD Def_dez_uw_q1 1 100 0.00 65535. FORMAT "%5.0" ECU_ADDRESS 0xC0009522 /end MEASUREMENT
/begin MEASUREMENT Zvar21 "Betrag der Häufigkeitsverteilung Stopdauern zwischen 20s und 45 s" UWORD Def_dez_uw_q1 1 100 0.00 65535. FORMAT "%5.0" ECU_ADDRESS 0xC0009524 /end MEASUREMENT
/begin MEASUREMENT Zvar22 "Betrag der Häufigkeitsverteilung Stopdauern über 45s" UWORD Def_dez_uw_q1 1 100 0.00 65535. FORMAT "%5.0" ECU_ADDRESS 0xC0009526 /end MEASUREMENT
/begin MEASUREMENT Zvar23 "Minspannung, true wenn U3 größer U1, U2" UBYTE Identity 1 100 0.00 1.0 ECU_ADDRESS 0xC000AFD5 /end MEASUREMENT
/begin MEASUREMENT Zvar24 "Minspannung, true wenn U3 größer U2, aber kleiner U1" UBYTE Identity 1 100 0.00 1.0 ECU_ADDRESS 0xC000AFD6 /end MEASUREMENT
/begin MEASUREMENT Zvar25 "Minspannung, true wenn U3 größer U1, aber kleiner U2" UBYTE Identity 1 100 0.00 1.0 ECU_ADDRESS 0xC000AFD7 /end MEASUREMENT
/begin MEASUREMENT Zvar26 "Minspannung, true wenn U3 kleiner U1, und U1 kleiner U2" UBYTE Identity 1 100 0.00 1.0 ECU_ADDRESS 0xC000AFD8 /end MEASUREMENT
/begin MEASUREMENT Zvar27 "Minspannung, true wenn U3 kleiner U2 und U2 kleiner U1" UBYTE Identity 1 100 0.00 1.0 ECU_ADDRESS 0xC000AFD9 /end MEASUREMENT
/begin MEASUREMENT Zvar3 "Entlademenge ohne berücksichtigung quantisierung, zum Schreiben in Infospeicher" UWORD Def_dez_uw_q1 1 100 0.00 65535. FORMAT "%5.0" ECU_ADDRESS 0xC0009528 /end MEASUREMENT
/begin MEASUREMENT Zvar35 "gefahrene Kilometer seid Minspannung U1" UWORD Def_dez_uw_q1 1 100 0.00 65535. FORMAT "%5.0" ECU_ADDRESS 0xC000952A /end MEASUREMENT
/begin MEASUREMENT Zvar36 "gefahrene Kilometer seid Minspannung U2" UWORD Def_dez_uw_q1 1 100 0.00 65535. FORMAT "%5.0" ECU_ADDRESS 0xC000952C /end MEASUREMENT
/begin MEASUREMENT Zvar37 "gefahrene Kilometer seid Minspannung U3" UWORD Def_dez_uw_q1 1 100 0.00 65535. FORMAT "%5.0" ECU_ADDRESS 0xC000952E /end MEASUREMENT
/begin MEASUREMENT Zvar38 "Stopdauer bei Minspannung U1" UWORD Def_dez_uw_q1 1 100 0.00 65535. FORMAT "%5.0" ECU_ADDRESS 0xC0009530 /end MEASUREMENT
/begin MEASUREMENT Zvar39 "Stopdauer bei Minspannung U2" UWORD Def_dez_uw_q1 1 100 0.00 65535. FORMAT "%5.0" ECU_ADDRESS 0xC0009532 /end MEASUREMENT
/begin MEASUREMENT Zvar46 "Entlademenge bei Minspannung U1" UBYTE Def_dez_ub_q1 1 100 0.00 255. FORMAT "%3.0" ECU_ADDRESS 0xC000AFDA /end MEASUREMENT
/begin MEASUREMENT Zvar61 "Ringspeicerh EAs vor shiften" UWORD Def_dez_uw_q1 1 100 0.00 65535. FORMAT "%5.0" ECU_ADDRESS 0xC0009534 /end MEASUREMENT
/begin MEASUREMENT Zvar62 "Ringspeicher EAs nach shiften" UBYTE Def_dez_ub_q1 1 100 0.00 255. FORMAT "%3.0" ECU_ADDRESS 0xC000AFDB /end MEASUREMENT
/begin MEASUREMENT Zvar7 "gemittelte Spannungslage der jeweiligen Ladeabhängigkeit vor aktuellem MSA-Start" UWORD Def_u_uw_q0p032 1 100 0.00 2097.120 FORMAT "%8.3" ECU_ADDRESS 0xC0009536 /end MEASUREMENT
/begin MEASUREMENT Zvar8 "Delta der aktuellen Startspannung zur gemittelten Startspannung" SWORD Def_u_sw_q0p00488 1 100 -160.0000 159.9951 FORMAT "%8.4" ECU_ADDRESS 0xC0009538 /end MEASUREMENT
/begin MEASUREMENT Zvar9 "neue gemittelte Startspannung, ladungsabhängig" UWORD Def_u_uw_q0p032 1 100 0.00 2097.120 FORMAT "%8.3" ECU_ADDRESS 0xC000953A /end MEASUREMENT
/begin MEASUREMENT Zw_zeit_msa "Zwischenvariable während aufaddieren der MSA Standzeit" UWORD Def_st_uw_q1 1 100 0.00 65535. FORMAT "%5.0" ECU_ADDRESS 0xC000953C /end MEASUREMENT
/begin FUNCTION aepmsadiag ""
 /begin DEF_CHARACTERISTIC K_BATTTAAPP K_DSOCMSADG1 K_DSOCMSADG2 K_DSOCMSADG3 K_DSOCMSADG4 K_FACRELSTOP K_MAXINFO K_MAXINFO1 K_MSAAVSTAT K_UBTFILT /end DEF_CHARACTERISTIC
 /begin OUT_MEASUREMENT Anz_Stops_ta Anz_Stops_tb Anz_Stops_tc Anz_Stops_td Av_temp Av_temp_old Dsoc_msalow Ea_temp Ges_msastop Infsp_locdel Km_aktfahrt Km_fahrtbgn Km_u1msalow Km_u2msalow Km_u3msalow Km_umsalow Msaav_gesetz Msainfo Pm_index Pm_index2 Pm_index3 Pm_index4 Pm_index5 Pm_index6 Qelad_mem Qelad_msa Qelad_msalow Qelad_msa_ges Qlad_mem Stpdr_msalow St_pmmsadiag0 Sync_stopend U1_inf U1_minspg U2_inf U2_minspg U3_inf U_strtmsalow Zaehler_ges Zaehler_msa Zeit_msastop Zvar1 Zvar10 Zvar13 Zvar18 Zvar19 Zvar2 Zvar20 Zvar21 Zvar22 Zvar23 Zvar24 Zvar25 Zvar26 Zvar27 Zvar3 Zvar35 Zvar36 Zvar37 Zvar38 Zvar39 Zvar46 Zvar61 Zvar62 Zvar7 Zvar8 Zvar9 Zw_zeit_msa /end OUT_MEASUREMENT
/end FUNCTION
/begin FUNCTION aepsoccalc ""
 /begin DEF_CHARACTERISTIC KF_SOC0UBIB KF_SOCLF KL_CLASS2IND KL_CLASS2NENN KL_SOC0TEMP K_BATTCNENN1 K_BATTCNENN2 K_BATTINDAPP K_CBATTAPP K_IWAKEAPP K_QBILA K_QGES K_QOLD K_Q_BILAPWF K_SOC_BILAWA K_SOC_QPWF K_SOC_QUALIA K_TCODIERPM K_VOLLZYKLEN S_CODIERERR S_CODIERPM S_SOCCALCECU S_SOC_BILA S_SOC_QUAL /end DEF_CHARACTERISTIC
 /begin IN_MEASUREMENT Batt_class T_batt T_battsoc0 /end IN_MEASUREMENT
 /begin OUT_MEASUREMENT Battfak Batt_index Codiercnt C_battnenn Dqelad4 Dqlad4 D_qelad D_qelad_mem D_qlad D_qladlf D_qlad_mem Isoc0loc Iwakeupgrz Kalevcnt Qeladold Qelad_ges Qelad_gesml Qladold Qlad_ges Q_bila Q_bila_temp Soc_bila Soc_b_loc Soc_quali Soc_q_loc St_pmsoccalc Tsocloc Ubatt0 Vollzyklen /end OUT_MEASUREMENT
/end FUNCTION
/begin FUNCTION aepsocfit ""
 /begin DEF_CHARACTERISTIC KF_PMRIBAT1 KF_PMRIBAT2 KF_PMRIBAT3 KF_PMRIBAT4 KF_PMRIBAT5 KF_PMRIBAT6 KF_PMRIBAT7 KF_PMRIBAT8 KL_PMSOCVU K_FITDEF K_I_FITAUSW K_PMTIMERSQ1 K_SOCFITAPP K_TD_SOCFIT S_FITNPL S_PMSOCFIT /end DEF_CHARACTERISTIC
 /begin IN_MEASUREMENT I_batt T_batt /end IN_MEASUREMENT
 /begin OUT_MEASUREMENT Ri_batt Soc_fit Soc_fit_temp Soc_fit_unfilt St_aepsocfit U_llfit /end OUT_MEASUREMENT
/end FUNCTION
/begin FUNCTION aepsockor ""
 /begin DEF_CHARACTERISTIC KL_FITGRZ KL_SSOC KL_SSOC_DIF K_ABSCHKORA K_BILA_OGRZ K_BILA_UGRZ K_DAB_KORR1 K_DAB_KORR2 K_DAB_KORR3 K_DSOC2A K_DSOCA K_ENERGYAPP K_GQVCC K_GQVH2OCC K_GQVH2OQCC K_GQVQUALICC K_PM_NOUSEQ K_PM_TABSMN K_QSOCCL1 K_QSOCCL2 K_QSOCCL3 K_QV_OGRZ K_QV_QGRZ K_QV_UGRZ K_SOCFITLIMH K_SOCFITLIML K_SOCKORR K_SOCQKOR K_SOCREL K_SOCSTFGK2 K_SOC_STAFGA K_TBATNACHL K_TQVCC K_TSAISON K_TSAISONFIL S_ABSCHK S_BSOCNPL S_DSOCS S_ENERGYKLST S_PMTABSMN S_SOCKORECU S_SOCSTAFK /end DEF_CHARACTERISTIC
 /begin OUT_MEASUREMENT Absch_korr D_qsfg1_int D_qsfg2_int D_soc D_soc2 Energyklst Energyklstloc Soc_korr Soc_q_kor Soc_rel Soc_stfgk Soc_stfgk2 St_aepsockor0 St_aepsockor1 St_aepsockor_nv T_saison T_saisonalt /end OUT_MEASUREMENT
/end FUNCTION
/begin FUNCTION aepsocstart ""
 /begin DEF_CHARACTERISTIC KL_ITNSTART KL_ITNSTRMSA KL_UTSTART KL_UTSTRTMSA S_MSASTARTKL S_UTNSTRTMSA /end DEF_CHARACTERISTIC
 /begin IN_MEASUREMENT T_batt /end IN_MEASUREMENT
 /begin OUT_MEASUREMENT St_aepsocstart0 U_grenz U_startausw U_tnstartmsa X_KL_ITNSTART_no_input_quantity X_KL_ITNSTRMSA_no_input_quantity /end OUT_MEASUREMENT
/end FUNCTION
/begin FUNCTION aepspgw ""
 /begin DEF_CHARACTERISTIC K_BNSCTRINC K_BNSMX K_BNSUBMAX K_BNSUBMIN K_BNSVFZG K_DTBL K_DTELUE K_DTEWP K_DT_EPS K_DT_GEBL K_DT_KRAPU K_DT_LICHT K_DT_SLP K_DT_VBRES1 K_DT_VBRES2 K_DT_WISCHER K_EPS_TRST K_EPS_VRST K_NKWEPSGRZ K_PR_BLMN K_PR_BNS K_PR_CRASHSOLL K_PR_DSCMN K_PR_DSCMX K_PR_ELUEMN K_PR_EPSUMN K_PR_EWPMN K_PR_GEBMN K_PR_KRAPUMN K_PR_LICHT K_PR_SLPMN K_PR_UBNQM K_PR_VBRES1MN K_PR_VBRES1MX K_PR_VBRES2MN K_PR_VBRES2MX K_PR_VBRES3MN K_PR_VBRES3MX K_PR_VBRES4MN K_PR_VBRES4MX K_PR_VBRES5MN K_PR_VBRES5MX K_PR_WISMN K_PR_WISMX K_SPGKMP12 K_SPGKOMP1 K_SPGKOMP10 K_SPGKOMP11 K_SPGKOMP13 K_SPGKOMP14 K_SPGKOMP15 K_SPGKOMP16 K_SPGKOMP17 K_SPGKOMP18 K_SPGKOMP19 K_SPGKOMP2 K_SPGKOMP20 K_SPGKOMP21 K_SPGKOMP22 K_SPGKOMP23 K_SPGKOMP24 K_SPGKOMP25 K_SPGKOMP4 K_SPGKOMP5 K_SPGKOMP6 K_SPGKOMP8 K_SPGKOMP9 K_TBNSDELAY K_TOL K_UBNSSOLL K_UBW_ZKSMN K_UCRASHSOLL K_UEPS_TOL S_BBNS S_E89_AFS S_EPS_DISABL S_IGR_EPS S_LDAEPS_EN S_SPGWECU /end DEF_CHARACTERISTIC
 /begin OUT_MEASUREMENT Bnscounter Pr_bl_mn Pr_bns_soll Pr_crash_soll Pr_dsc_mn Pr_dsc_mx Pr_elue_mn Pr_eps_mn Pr_ewp_mn Pr_geblaese_mn Pr_krapu_mn Pr_licht_mn Pr_slp_mn Pr_spgw Pr_vbres1_mn Pr_vbres1_mx Pr_vbres2_mn Pr_vbres2_mx Pr_vbres3_mn Pr_vbres3_mx Pr_vbres4_mn Pr_vbres4_mx Pr_vbres5_mn Pr_vbres5_mx Pr_wischer_mn Pr_wischer_mx Quali_spg St_bns St_pmspgw St_pmspgw1 Ubw_uszr Ubw_zr Ub_komp Ulzr Uszr U_bl_mn U_bns_soll U_crash_soll U_dsc_mn U_dsc_mx U_elue_mn U_eps_mn U_eps_stat U_ewp_mn U_geblaese_mn U_krapu_mn U_licht_mn U_slp_mn U_vbres1_mn U_vbres1_mx U_vbres2_mn U_vbres2_mx U_vbres3_mn U_vbres3_mx U_vbres4_mn U_vbres4_mx U_vbres5_mn U_vbres5_mx U_wischer_mn U_wischer_mx /end OUT_MEASUREMENT
/end FUNCTION
/begin FUNCTION aepubnkor "" /begin DEF_CHARACTERISTIC S_KONFSTRAT2 /end DEF_CHARACTERISTIC
 /begin OUT_MEASUREMENT Pr_bn_soll Pr_dpnmax Pr_dyn Pr_konf Pr_max Pr_min Pr_soll Pr_sollmn Pr_sollmnk Pr_ziel St_aepubnkor U_bn_soll U_dpnmax U_dynmax U_dynmin U_gsoll_tp3 U_konf U_max U_min U_soll U_ziel /end OUT_MEASUREMENT
/end FUNCTION
/begin FUNCTION aepukomp ""
 /begin DEF_CHARACTERISTIC K_DFFGEN_MX K_IGEN_MN K_LTGPL_MN K_LTGPL_MX K_MCOBATTORT K_PT1RLTG_K K_RLEITUNGK K_RLTG_KONST K_TDGENOFFPM K_UDIFGENOFF K_UGDELTA K_UGEN K_UGENDELTA K_UGENLIM K_UGENMAX K_UGENMIN K_UGENOFFPM K_UGTOD K_UKOMP K_UKOMPUBGEN S_ENGENTOGGL S_GENOFFSTPM S_RLEITUNG S_UKOMPECU /end DEF_CHARACTERISTIC
 /begin OUT_MEASUREMENT Batt_ort R_leitung R_leitung_f St_pmukomp St_pmukomp2 St_ugenkor0 St_ugenkor1 U_dgen U_dyn_komp U_gen U_gen2 U_gen_old U_lcpkomp /end OUT_MEASUREMENT
/end FUNCTION
/begin FUNCTION aepverbred ""
 /begin DEF_CHARACTERISTIC KL_DFPRIO KL_DFPTC KL_DSOCPRIO KL_PRIO2PTC KL_PTC KL_PWRDF KL_SOCPRIO K_CTRCBRAPP K_CTRPWRCF K_CTRPWRCOSAPP K_CTRPWRDF K_DELAYDOWN K_DELAYUP K_DFKOMMERR K_DFPTC_LP K_DF_LP K_ENTLMAX K_ENTLTEST K_LASTDOWN K_LASTUP K_MX_PTCPI K_NKW2HIPTC K_NKW2LOWPTC K_PRIOREDSV K_PTCAPP K_PTCOFFOTTO K_PTC_PI K_PWRCOS15 K_PWRCOSAPP K_PWRCOSHT K_PWRCOSULEV K_PWRCOS_R K_PWRCSGNDEF K_PWRDF_PI K_RESET_DEL K_RQPCOSAPP K_SELSPCSAPP K_TD_PWRDFPI K_T_NKPTCAUS K_T_PTCKWAN K_T_PTCPI K_T_SULEVON K_ULEVA S_BPMVSDANF S_DFKOMMERR S_ENTLTEST S_PRIOMANUAL S_PTCKOOR S_PTCOFFOTTO S_VERBREDECU /end DEF_CHARACTERISTIC
 /begin IN_MEASUREMENT D_soc /end IN_MEASUREMENT
 /begin OUT_MEASUREMENT Actmaxprio_a Actmaxprio_b Actprio Allptcfilt Anzahl_sv Ctrcbr Ctrpwrcf Ctrpwrcos Ctrpwrcos7 Ctrpwrdf Ctrpwrentl Ctrpwspcos Df2pi Dffgen_temp Dfpt1filt Dfpt1ptc Dfpt1_2ptc Df_pi El_last El_verb_entl Loc_bitpos Loc_bitprio Maxpi Memprio1 Memprio2 Memptc1 Memptc2 Pmvscount Priopizw1 Priopizw2 Ptcpizw1 Ptcpizw2 Ptc_entl Ptc_pwr Ptc_pwr_loc Rqpcos Selspcos St_aepverbred St_aepverbred2 St_pmentl0 St_pmprsvcalc1 Ulev Verbredprioa Verbredpriob /end OUT_MEASUREMENT
/end FUNCTION
/begin FUNCTION aepverbredsp "" /begin DEF_CHARACTERISTIC K_RED_TA K_RED_TB /end DEF_CHARACTERISTIC
 /begin OUT_MEASUREMENT Redtimer Redtimer_1 Redtimer_10 Redtimer_11 Redtimer_12 Redtimer_1b Redtimer_2 Redtimer_2b Redtimer_3 Redtimer_3b Redtimer_4 Redtimer_5 Redtimer_6 Redtimer_7 Redtimer_8 Redtimer_9 St_aepverbredsp0 Verbreddur Verbredinfo Verbredpramx Verbredprbmx Verbredtp /end OUT_MEASUREMENT
/end FUNCTION
/begin FUNCTION afst_dd ""
 /begin DEF_CHARACTERISTIC Air_rDtyCycMaxTAFS_C Air_rDtyCycMinTAFS_C Air_tiRefSigPerMaxTAFS_C Air_tiRefSigPerMinTAFS_C Air_tTransfTAFS_CUR /end DEF_CHARACTERISTIC
 /begin OUT_MEASUREMENT Air_rRawTAFS Air_tiRawTAFS Air_tSensTAFS /end OUT_MEASUREMENT
/end FUNCTION
/begin FUNCTION afst_vd ""
 /begin DEF_CHARACTERISTIC Air_RmpSlpTAFS.Pos_C Air_RmpSlpTAFS.Neg_C Air_swtSelHFMSrc_C Air_TransStgTAFS.Dfl_C Air_TransStgTAFS.stSensId_C /end DEF_CHARACTERISTIC
 /begin IN_MEASUREMENT Com_tEnvT /end IN_MEASUREMENT
 /begin OUT_MEASUREMENT Air_tAFS /end OUT_MEASUREMENT
/end FUNCTION
/begin FUNCTION AFSt_VDTempEst ""
 /begin DEF_CHARACTERISTIC Air_dmAFSFrsh_MAP Air_IWinAFSt.Ki_C Air_IWinAFSt.KiPos_C Air_IWinAFSt.KiNeg_C Air_IWinAFSt.WinPos_C Air_IWinAFSt.WinNeg_C Air_mAFSFrshInit_MAP Air_mAFSFrshMax_C Air_mAFSFrshMin_C Air_mAFSFrshSumHiLim_C Air_mAFSFrshSumLoLim_C Air_numEngTempAFSt_C Air_tAFSPlausInit_C Air_tDiffLim_C Air_tiPT1TAFS_C Air_tT0HiLim_C Air_tT0LoLim_C /end DEF_CHARACTERISTIC
 /begin IN_MEASUREMENT AFS_dm Air_tAFS Air_tCACDs CoEng_st EngDa_tFld EngDa_tiEngOn EnvT_t Layer_tiEngShOff VehV_v /end IN_MEASUREMENT
 /begin OUT_MEASUREMENT Air_tAFSCorr /end OUT_MEASUREMENT
 /begin LOC_MEASUREMENT Air_dmAFSFrsh_mp Air_mAFSFrshSum_mp Air_stAFStPlausEEP_mp Air_stCorrActv_mp Air_stSensPlaus_mp Air_tAFSCorrRaw_mp Air_tAFSDflt_mp Air_tAFSPlaus_mp Air_tEngAFSt_mp /end LOC_MEASUREMENT
/end FUNCTION
/begin FUNCTION AFS_DD ""
 /begin DEF_CHARACTERISTIC AFS_dmTransf_CUR AFS_facPerCor_C AFS_nAvrgThrHiSRCLo_C AFS_nAvrgThrLoSRCLo_C AFS_qAirmThrSRCHiActv_CUR AFS_Swt.xVal_C AFS_Swt.xTyp_C AFS_swtOffTstSel_C AFS_swtOscSel_C AFS_tiCorSRCHi_C AFS_tiCorSRCLo_C AFS_tiDlyActvSRCHiAirm_C AFS_tiLPFiltPT1_C AFS_tiOffsDrftTstDly_C AFS_tiOffsDrftTstLim_C AFS_tiPerHFM6_C AFS_tiRawSRCHi_C AFS_tiRawSRCLo_C AFS_tiThrHiPlOffsDrft_C AFS_tiThrLoPlOffsDrft_C /end DEF_CHARACTERISTIC
 /begin IN_MEASUREMENT EpmCrS_numSeg EpmCrS_tiSeg Epm_nEng SyC_stSub /end IN_MEASUREMENT
 /begin OUT_MEASUREMENT AFS_dmSens AFS_stOffsTst AFS_swtActvAftRun AFS_tiRaw /end OUT_MEASUREMENT
 /begin LOC_MEASUREMENT AFS_qAirmThrSRCHiActv_mp AFS_stPlsOffsDrftTstActv_mp AFS_stSRCHiRls_mp AFS_stSRCHiTstRls_mp AFS_stSRCLoTstRls_mp AFS_tiCor_mp AFS_tiRawAvrg_mp /end LOC_MEASUREMENT
/end FUNCTION
/begin FUNCTION AFS_SSpShOff_DD ""
 /begin DEF_CHARACTERISTIC AFS_SSpShOff_DigOut.tiBtwTstSCB_C AFS_SSpShOff_DigOut.tiBtwTstOT_C AFS_SSpShOff_DigOut.numTstMax_C AFS_stPsShOffDiaDisbl_C AFS_stPsShOffDisbl_C /end DEF_CHARACTERISTIC
 /begin IN_MEASUREMENT DevLib_stPwrStgEnaCond /end IN_MEASUREMENT
 /begin OUT_MEASUREMENT AFS_stPsShOff /end OUT_MEASUREMENT
/end FUNCTION
/begin FUNCTION AFS_SSpShOff_VD "" /begin DEF_CHARACTERISTIC AFSShOff_nThresOff_C AFSShOff_nThresOn_C /end DEF_CHARACTERISTIC /begin IN_MEASUREMENT Epm_nEng /end IN_MEASUREMENT /begin OUT_MEASUREMENT AFS_stShOff /end OUT_MEASUREMENT /end FUNCTION
/begin FUNCTION AFS_VD ""
 /begin DEF_CHARACTERISTIC AFS_dmAirSubsVal_MAP AFS_dpBstThrHiPlHi_C AFS_dqRawThrHi_C AFS_dtAirThres_C AFS_facPlsCor_MAP AFS_facSwtOnCor_C AFS_HiBattDeb.tiHiLo_C AFS_HiBattDeb.tiLoHi_C AFS_HiTempDeb.tiHiLo_C AFS_HiTempDeb.tiLoHi_C AFS_LoBattDeb.tiHiLo_C AFS_LoBattDeb.tiLoHi_C AFS_LoTempDeb.tiHiLo_C AFS_LoTempDeb.tiLoHi_C AFS_nAvrgThrHiPlHi_C AFS_nAvrgThrHiPlLo_C AFS_nAvrgThrLoPlHi_C AFS_nAvrgThrLoPlLo_C AFS_pAirThrLo_C AFS_rAirThrHiPlHi_C AFS_rAirThrLoPlLo_C AFS_rEGRPThrHi_C AFS_rSwirlThrHi_C AFS_rSwirlThrLo_C AFS_rTVAThrHi_C AFS_rTVAThrLo_C AFS_stInhRls_C AFS_tClntThrHi_C AFS_tClntThrLo_C AFS_tiDlyEGRPPlSetyDrft_C AFS_tiDlyStrPlSetyDrft_C AFS_tiDlySwtOnCor_C AFS_tTempHi_C AFS_tTempLo_C AFS_uBattMax_C AFS_uBattMin_C /end DEF_CHARACTERISTIC
 /begin IN_MEASUREMENT AFS_dpIntValAbsFlt AFS_dqCurrAbsFlt AirCtl_stMon Air_dtTCACDs Air_pIntkVUs Air_pUnFltPIntkVUs ASMod_dmAFSSim ASMod_dmIndAirRef CEngDsT_t CoEng_st CoEng_tiNormal EGRVlv_r EnvP_p Epm_nEng Epm_numCyl InjCtl_qCurr InjCtl_qRaw ThrVlv_r VSwVlv_r /end IN_MEASUREMENT
 /begin OUT_MEASUREMENT AFS_dm AFS_dmComp AFS_mAirPerCyl AFS_mAirPerCylFlt AFS_stDrftMonRls AFS_stFIdAFSSysOk /end OUT_MEASUREMENT
 /begin LOC_MEASUREMENT AFS_dmAirFrz_mp AFS_dmAirSubsVal_mp AFS_dmPlsCorr_mp AFS_dmSensCorr_mp AFS_facPlsCor_mp AFS_facSwtOnCor_mp AFS_mAirPerCyl_mp AFS_rNorm_mp AFS_stDrftMonRls_mp AFS_stPlSetyDrftRls_mp AFS_stPlSetyDrft_mp AFS_stPlSetyRls_mp /end LOC_MEASUREMENT
/end FUNCTION
/begin FUNCTION AFS_VDDrftComp ""
 /begin DEF_CHARACTERISTIC AFS_dmIdlAirMsLim_C AFS_dmLdAirMsLim_C AFS_dpLdAdjThresHi_C AFS_dqLdAdjThresHi_C AFS_drWtPenDetThresHi_C AFS_facCorExtpIdl_CUR AFS_facCorExtpLd_CUR AFS_facHiThresIdlAdjVal_C AFS_facHiThresLdAdjVal_C AFS_facIdlAdjValStepLim_C AFS_facLdAdjValStepLim_C AFS_facLoThresIdlAdjVal_C AFS_facLoThresLdAdjVal_C AFS_nAvrgIdlAdjThresHi_C AFS_nAvrgIdlAdjThresLo_C AFS_pBstAtmDiffLim_C AFS_pBstLdAdjThresHi_C AFS_pBstLdAdjThresLo_C AFS_qCurrIdlAdjThresHi_C AFS_qCurrIdlAdjThresLo_C AFS_qWinLdAdjThresHi_CUR AFS_qWinLdAdjThresLo_CUR AFS_stAdjRlsLckRgn_C AFS_swtActvEEPLoThres_C AFS_swtAirMsCorRls_C AFS_swtClrEEPAdjVal_C AFS_swtCurrAdjRls_C AFS_swtWtPenMon_C AFS_tAirAdjRlsThresHi_C AFS_tAirAdjRlsThresLo_C AFS_tEnvAdjRlsThresHi_C AFS_tEnvAdjRlsThresLo_C AFS_tiAdjRlsDel_C AFS_tiAirMsPT1_C AFS_tiBstPresPT1_C AFS_tiCorFacPT1_C AFS_tiIdlAdjRlsDeb.tiHiLo_C AFS_tiIdlAdjRlsDeb.tiLoHi_C AFS_tiLdAdjRlsDeb.tiHiLo_C AFS_tiLdAdjRlsDeb.tiLoHi_C AFS_tiQntCurrPT1_C AFS_tiStrtDelAdjRls_C AFS_tiWtPenDeb.tiHiLo_C AFS_tiWtPenDeb.tiLoHi_C AFS_tiWtPenDetPT1_C AFS_vVehLdAdjThresHi_C AFS_vVehLdAdjThresLo_C /end DEF_CHARACTERISTIC
 /begin IN_MEASUREMENT AFS_dmSens AFS_stDrftMonRls AirCtl_stMon Air_pUnFltPIntkVUs Air_tCACDs ASMod_dmIndAirRef CoEng_tiNormal CoEOM_stOpModeAct EnvP_p EnvT_t Epm_nEng InjCtl_qCurr VehV_v /end IN_MEASUREMENT
 /begin OUT_MEASUREMENT AFS_dpIntValAbsFlt AFS_dqCurrAbsFlt AFS_stDrft /end OUT_MEASUREMENT
 /begin LOC_MEASUREMENT AFS_dmAirMsFlt_mp AFS_dmDrft AFS_dmIdlAirMs_mp AFS_dmLdAirMs_mp AFS_dpIntValAbs_mp AFS_dqCurrAbs_mp AFS_drWtPenDetFlt_mp AFS_drWtPenDet_mp AFS_facCalcIdlAdjVal_mp AFS_facCalcLdAdjVal_mp AFS_facCalcValFlt_mp AFS_facCalcVal_mp AFS_facCorIdl_mp AFS_facCorIpo_mp AFS_facCorLd_mp AFS_facIdlAdjValUnLim_mp AFS_facIdlAdjVal_mp AFS_facLdAdjValUnLim_mp AFS_facLdAdjVal_mp AFS_qWinLdAdjThresHi_mp AFS_qWinLdAdjThresLo_mp AFS_stAdjRlsDel_mp AFS_stEnvCon_mp AFS_stIdlAdjRlsCon_mp AFS_stIpoRng_mp AFS_stLdAdjRlsCon_mp AFS_stRstLoDrftThres_mp AFS_stWtPenDetDeb_mp AFS_stWtPenDet_mp /end LOC_MEASUREMENT
/end FUNCTION
/begin FUNCTION AGSDem_SelectParameter ""
 /begin DEF_CHARACTERISTIC AGSDem_dnAccLim_C AGSDem_dnDeclLim_C AGSDem_ILo.Ki_C AGSDem_ILo.KiPos_C AGSDem_ILo.KiNeg_C AGSDem_ILo.WinPos_C AGSDem_ILo.WinNeg_C AGSDem_InrtDrvTrn_C AGSDem_InrtEng_C AGSDem_InrtVeh_C AGSDem_PLo.Kp_C AGSDem_PLo.KpPos_C AGSDem_PLo.KpNeg_C AGSDem_PLo.WinPos_C AGSDem_PLo.WinNeg_C AGSDem_RmpSetPLo.Pos_C AGSDem_RmpSetPLo.Neg_C AGSDem_rnEngvVeh_C AGSDem_stActive_C AGSDem_tiFltLosTrqEst_C AGSDem_tiFltnEng_C AGSDem_tiMaxActive_C /end DEF_CHARACTERISTIC
 /begin IN_MEASUREMENT Com_nDKG Com_stModDKG HLSDem_nSetPLo ISC_st /end IN_MEASUREMENT
 /begin OUT_MEASUREMENT AGSDem_nSetPHi AGSDem_nSetPLo AGSDem_trqLoLimMax AGSDem_trqLoLimMin AGSDem_trqReq /end OUT_MEASUREMENT
 /begin LOC_MEASUREMENT AGSDem_stModeDKGDeb_mp AGSDem_stModeDKGUnDeb_mp AGSDem_stModeDKG_mp /end LOC_MEASUREMENT
/end FUNCTION
/begin FUNCTION AircECU "" /begin SUB_FUNCTION AircECU_co AircECU_swt AircECU_fa /end SUB_FUNCTION /end FUNCTION
/begin FUNCTION AircECU_Can ""
 /begin DEF_CHARACTERISTIC Com_ctHeatACSelfRec_C Com_stMskHeatACSig_C Com_swtHeatAC_C Com_tiHeatACSelfRec_C /end DEF_CHARACTERISTIC
 /begin OUT_MEASUREMENT Com_bRecHeatAC /end OUT_MEASUREMENT
/end FUNCTION
/begin FUNCTION AircECU_co "" /begin DEF_CHARACTERISTIC Com_facTrqAC_MAP /end DEF_CHARACTERISTIC /begin IN_MEASUREMENT Epm_nEng /end IN_MEASUREMENT
 /begin OUT_MEASUREMENT AirC_trqDes Com_nRqStgEFan Com_rHtFlowReq Com_rPwrSpCons Com_stAC Com_stACEFan Com_stACnMin Com_stPHtr Com_swtAC Com_trqAC /end OUT_MEASUREMENT
 /begin LOC_MEASUREMENT Com_facTrqAC_mp /end LOC_MEASUREMENT
/end FUNCTION
/begin FUNCTION AircECU_fa "" /begin DEF_CHARACTERISTIC Com_swtACDemand_FA_C Com_swtStatACFront_FA_C /end DEF_CHARACTERISTIC
 /begin OUT_MEASUREMENT Com_rACFanDem_FA Com_rHtFlowReq_FA Com_stAC_FA Com_stPHtr_FA Com_swtAC_FA Com_trqAC_FA /end OUT_MEASUREMENT
/end FUNCTION
/begin FUNCTION AircECU_flex "" /begin OUT_MEASUREMENT Com_rACFanDem /end OUT_MEASUREMENT /end FUNCTION
/begin FUNCTION AircECU_swt ""
 /begin IN_MEASUREMENT Com_rACFanDem_FA Com_rHtFlowReq Com_rHtFlowReq_FA Com_stAC Com_stACEFan Com_stAC_FA Com_stPHtr_FA Com_swtAC Com_swtAC_FA Com_trqAC Com_trqAC_FA /end IN_MEASUREMENT
/end FUNCTION
/begin FUNCTION AirCtl_Co ""
 /begin DEF_CHARACTERISTIC AirCtl_swtQntCtl_C AirCtl_swtQntDes_C AirCtl_swtQntGov_C AirCtl_swtQntMon_C AirCtl_swtTrqInrCtl_C AirCtl_swtTrqInrDes_C AirCtl_swtTrqInrGov_C AirCtl_swtTrqInrMon_C /end DEF_CHARACTERISTIC
 /begin IN_MEASUREMENT InjCtl_qCurr InjCtl_qRaw PthLead_trqInrCurr PthLead_trqInrLead /end IN_MEASUREMENT
 /begin OUT_MEASUREMENT AirCtl_qCtlVal AirCtl_qDesVal AirCtl_qGov AirCtl_qInvEGRMod AirCtl_qMon AirCtl_trqCtlVal AirCtl_trqDesVal AirCtl_trqGov AirCtl_trqMon /end OUT_MEASUREMENT
/end FUNCTION
/begin FUNCTION AirCtl_CtlValCalc ""
 /begin DEF_CHARACTERISTIC AirCtl_AirEGR.rPresCrit_C AirCtl_AirEGR.facFlwCrit_C AirCtl_AirEGR.rPresLin_C AirCtl_AirEGR.facSlpLin_C AirCtl_arLimMax_MAP AirCtl_facEGRPreCtl_C AirCtl_rEGRPreCtlInv_CUR AirCtl_rEGRPreCtlMax_C AirCtl_rEGRPreCtlMin_C AirCtl_stEGRPreCtlCoEOMMsk_C AirCtl_swtEGRPreCtl_C AirCtl_tiEffEGRPT1_C AirCtl_tiPT1EGRPreCtl_C /end DEF_CHARACTERISTIC
 /begin IN_MEASUREMENT AirCtl_mDesValRaw Air_pIntkVUs ASMod_dmIntMnfDs ASMod_pTrbnUs ASMod_tIntMnfDs_r32 ASMod_tTrbnUs CoEng_st CoEOM_stOpModeAct Epm_nEng Epm_numCyl /end IN_MEASUREMENT
 /begin OUT_MEASUREMENT AirCtl_mEGRPreCtlUnSplit AirCtl_rCtlVal AirCtl_rCtlValB1 AirCtl_rCtlValB2 /end OUT_MEASUREMENT
 /begin LOC_MEASUREMENT AirCtl_arEffEGRFlt_mp AirCtl_arEGRPreCtlLim_mp AirCtl_arEGRPreCtl_mp AirCtl_arLimMax_mp AirCtl_dmEGRPreCtlReal_mp AirCtl_dmEGRPreCtl_mp AirCtl_mEGRPreCtlUnFlt_mp AirCtl_mEGRPreCtl_mp AirCtl_mIntMnfDs_mp AirCtl_rEGRPreCtlUnLim_mp AirCtl_rEGRPreCtl_mp AirCtl_rPresRat_mp AirCtl_stRlsEGRPreCtlCond_mp AirCtl_stRlsEGRPreCtl_mp /end LOC_MEASUREMENT
/end FUNCTION
/begin COMPU_METHOD AIRC_ATSINTVMODCMPR_SY_Compu "" TAB_VERB "%6.3" "" COMPU_TAB_REF AIRC_ATSINTVMODCMPR_SY_Compu /end COMPU_METHOD
/begin COMPU_VTAB AIRC_ATSINTVMODCMPR_SY_Compu "" TAB_VERB 2 0 "False" 1 "True" /end COMPU_VTAB
/begin COMPU_METHOD AirMassPerCyl "" RAT_FUNC "%5.1" "mg/Hub" COEFFS 0 10 0 0 0 1 /end COMPU_METHOD
/begin COMPU_METHOD AirMassPerTime "" RAT_FUNC "%5.1" "Kg/h" COEFFS 0 10 0 0 0 1 /end COMPU_METHOD
/begin COMPU_METHOD AirMassPerTime_float "" RAT_FUNC "%6.2" "Kg/h" COEFFS 0 1 0 0 0 1 /end COMPU_METHOD
/begin COMPU_METHOD AirMass_kg "" RAT_FUNC "%6.3" "kg" COEFFS 0 10 0 0 0 1 /end COMPU_METHOD
/begin COMPU_METHOD Area_cm2_float "" RAT_FUNC "%6.2" "cm*cm" COEFFS 0 1 0 0 0 1 /end COMPU_METHOD
/begin COMPU_METHOD Def_dez_sb_q1 "" RAT_FUNC "%3.1" "-" COEFFS 0 1 0 0 0 1 /end COMPU_METHOD
/begin COMPU_METHOD Def_dez_ub_q0p5 "" RAT_FUNC "%6.3" "-" COEFFS 0 2 0 0 0 1 /end COMPU_METHOD
/begin COMPU_METHOD Def_dez_ub_q1 "" RAT_FUNC "%3.1" "-" COEFFS 0 1 0 0 0 1 /end COMPU_METHOD
/begin COMPU_METHOD Def_dez_ul_q1 "" RAT_FUNC "%7.3" "-" COEFFS 0 1 0 0 0 1 /end COMPU_METHOD
/begin COMPU_METHOD Def_dez_uw_q1 "" RAT_FUNC "%5.2" "-" COEFFS 0 1 0 0 0 1 /end COMPU_METHOD
/begin COMPU_METHOD Def_f_sw_b100 "" RAT_FUNC "%8.5" "-" COEFFS 0 327.68 0 0 0 1 /end COMPU_METHOD
/begin COMPU_METHOD Def_f_sw_q0p00153 "" RAT_FUNC "%8.5" "-" COEFFS 0 655.36 0 0 0 1 /end COMPU_METHOD
/begin COMPU_METHOD Def_f_sw_q0p01 "" RAT_FUNC "%7.5" "-" COEFFS 0 100 0 0 0 1 /end COMPU_METHOD
/begin COMPU_METHOD Def_f_ub_b1 "" RAT_FUNC "%6.4" "-" COEFFS 0 256 0 0 0 1 /end COMPU_METHOD
/begin COMPU_METHOD Def_f_ub_b100 "" RAT_FUNC "%5.2" "%" COEFFS 0 2.56 0 0 0 1 /end COMPU_METHOD
/begin COMPU_METHOD Def_f_ub_b127p5 "" RAT_FUNC "%5.2" "%" COEFFS 0 2 0 0 0 1 /end COMPU_METHOD
/begin COMPU_METHOD Def_f_ub_b2 "" RAT_FUNC "%6.4" "-" COEFFS 0 128 0 0 0 1 /end COMPU_METHOD
/begin COMPU_METHOD Def_f_ub_b32 "" RAT_FUNC "%5.2" "-" COEFFS 0 8 0 0 0 1 /end COMPU_METHOD
/begin COMPU_METHOD Def_f_ub_b4 "" RAT_FUNC "%5.3" "-" COEFFS 0 64 0 0 0 1 /end COMPU_METHOD
/begin COMPU_METHOD Def_f_ub_q0p001 "" RAT_FUNC "%6.5" "" COEFFS 0 1000 0 0 0 1 /end COMPU_METHOD
/begin COMPU_METHOD Def_f_uw_b1 "" RAT_FUNC "%14.10" "-" COEFFS 0 65536 0 0 0 1 /end COMPU_METHOD
/begin COMPU_METHOD Def_f_uw_b100 "" RAT_FUNC "%8.5" "%" COEFFS 0 655.36 0 0 0 1 /end COMPU_METHOD
/begin COMPU_METHOD Def_f_uw_b2 "" RAT_FUNC "%14.10" "-" COEFFS 0 32768 0 0 0 1 /end COMPU_METHOD
/begin COMPU_METHOD Def_f_uw_b256 "" RAT_FUNC "%8.5" "-" COEFFS 0 256 0 0 0 1 /end COMPU_METHOD
/begin COMPU_METHOD Def_f_uw_b8 "" RAT_FUNC "%9.7" "-" COEFFS 0 8192 0 0 0 1 /end COMPU_METHOD
/begin COMPU_METHOD Def_f_uw_q1 "" RAT_FUNC "%5.2" "-" COEFFS 0 1 0 0 0 1 /end COMPU_METHOD
/begin COMPU_METHOD Def_i_sw_q0p001 "" RAT_FUNC "%8.6" "A" COEFFS 0 1000 0 0 0 1 /end COMPU_METHOD
/begin COMPU_METHOD Def_i_ub_b1000 "" RAT_FUNC "%6.2" "A" COEFFS 0 0.256 0 0 0 1 /end COMPU_METHOD
/begin COMPU_METHOD Def_i_ub_q0p02 "" RAT_FUNC "%5.3" "A" COEFFS 0 50 0 0 0 1 /end COMPU_METHOD
/begin COMPU_METHOD Def_i_ub_q1 "" RAT_FUNC "%6.2" "" COEFFS 0 1 0 0 0 1 /end COMPU_METHOD
/begin COMPU_METHOD Def_i_uw_q0p08_o200 "" RAT_FUNC "%8.2" "" COEFFS 0 12.5 2500 0 0 1 /end COMPU_METHOD
/begin COMPU_METHOD Def_km_uw_q10 "" RAT_FUNC "%5.1" "km" COEFFS 0 0.1 0 0 0 1 /end COMPU_METHOD
/begin COMPU_METHOD Def_n_sw_q1p0 "" RAT_FUNC "%5.2" "Upm" COEFFS 0 1 0 0 0 1 /end COMPU_METHOD
/begin COMPU_METHOD Def_ql_ub_q1 "" RAT_FUNC "%4.1" "" COEFFS 0 1 0 0 0 1 /end COMPU_METHOD
/begin COMPU_METHOD Def_ql_ul_q0p000182 "" RAT_FUNC "%11.8" "Ah" COEFFS 0 5495 0 0 0 1 /end COMPU_METHOD
/begin COMPU_METHOD Def_ql_ul_q2p7Em7 "" RAT_FUNC "%12.11" "Ah" COEFFS 0 3600000 0 0 0 1 /end COMPU_METHOD
/begin COMPU_METHOD Def_ql_uw_q0p0182 "" RAT_FUNC "%8.5" "Ah" COEFFS 0 54.9444444444444 0 0 0 1 /end COMPU_METHOD
/begin COMPU_METHOD Def_ql_uw_q0p29127 "" RAT_FUNC "%7.3" "" COEFFS 0 3.43333333333333 0 0 0 1 /end COMPU_METHOD
/begin COMPU_METHOD Def_st_ub_q1 "" RAT_FUNC "%3.1" "-" COEFFS 0 1 0 0 0 1 /end COMPU_METHOD
/begin COMPU_METHOD Def_st_uw_q1 "" RAT_FUNC "%5.2" "-" COEFFS 0 1 0 0 0 1 /end COMPU_METHOD
/begin COMPU_METHOD Def_td_ub_q0p01 "" RAT_FUNC "%5.4" "s" COEFFS 0 100 0 0 0 1 /end COMPU_METHOD
/begin COMPU_METHOD Def_td_ub_q0p1 "" RAT_FUNC "%4.2" "s" COEFFS 0 10 0 0 0 1 /end COMPU_METHOD
/begin COMPU_METHOD Def_td_ub_q1 "" RAT_FUNC "%5.2" "s" COEFFS 0 1 0 0 0 1 /end COMPU_METHOD
/begin COMPU_METHOD Def_td_uw_q0p01 "" RAT_FUNC "%7.5" "s" COEFFS 0 100 0 0 0 1 /end COMPU_METHOD
/begin COMPU_METHOD Def_td_uw_q0p1 "" RAT_FUNC "%6.3" "s" COEFFS 0 10 0 0 0 1 /end COMPU_METHOD
/begin COMPU_METHOD Def_td_uw_q1 "" RAT_FUNC "%5.2" "s" COEFFS 0 1 0 0 0 1 /end COMPU_METHOD
/begin COMPU_METHOD Def_t_sw_q0p1 "" RAT_FUNC "%6.3" "°C" COEFFS 0 10 0 0 0 1 /end COMPU_METHOD
/begin COMPU_METHOD Def_u_sw_q0p00025 "" RAT_FUNC "%9.7" "" COEFFS 0 4000 0 0 0 1 /end COMPU_METHOD
/begin COMPU_METHOD Def_u_sw_q0p00488 "" RAT_FUNC "%8.5" "V" COEFFS 0 204.8 0 0 0 1 /end COMPU_METHOD
/begin COMPU_METHOD Def_u_ub_b0p5 "" RAT_FUNC "%7.5" "V" COEFFS 0 512 0 0 0 1 /end COMPU_METHOD
/begin COMPU_METHOD Def_u_ub_q0p0196 "" RAT_FUNC "%7.4" "V" COEFFS 0 51.0204081632653 0 0 0 1 /end COMPU_METHOD
/begin COMPU_METHOD Def_u_ub_q0p0942 "" RAT_FUNC "%7.4" "V" COEFFS 0 10.6157112526539 0 0 0 1 /end COMPU_METHOD
/begin COMPU_METHOD Def_u_ub_q0p1 "" RAT_FUNC "%5.3" "V" COEFFS 0 10 0 0 0 1 /end COMPU_METHOD
/begin COMPU_METHOD Def_u_uw_q0p032 "" RAT_FUNC "%8.5" "V" COEFFS 0 31.25 0 0 0 1 /end COMPU_METHOD
/begin COMPU_METHOD Def_u_uw_q0p1 "" RAT_FUNC "%8.4" "V" COEFFS 0 10 0 0 0 1 /end COMPU_METHOD
/begin COMPU_METHOD Def_u_uw_q0p25em3_o6 "" RAT_FUNC "%9.5" "" COEFFS 0 4000 -24000 0 0 1 /end COMPU_METHOD
/begin COMPU_METHOD Def_v_uw_q1p0 "" RAT_FUNC "%5.2" "km/h" COEFFS 0 1 0 0 0 1 /end COMPU_METHOD
/begin COMPU_METHOD DtyCyc "" RAT_FUNC "%5.2" "%" COEFFS 0 100 0 0 0 1 /end COMPU_METHOD
/begin COMPU_METHOD EngN "" RAT_FUNC "%5.1" "rpm" COEFFS 0 2 0 0 0 1 /end COMPU_METHOD
/begin COMPU_METHOD EngN_float "" RAT_FUNC "%4.0" "rpm" COEFFS 0 1 0 0 0 1 /end COMPU_METHOD
/begin COMPU_METHOD Fact "" RAT_FUNC "%6.5" "-" COEFFS 0 8192 0 0 0 1 /end COMPU_METHOD
/begin COMPU_METHOD Fact100 "" RAT_FUNC "%6.4" "-" COEFFS 0 100 0 0 0 1 /end COMPU_METHOD
/begin COMPU_METHOD Identity "" RAT_FUNC "%3.1" "-" COEFFS 0 1 0 0 0 1 /end COMPU_METHOD
/begin COMPU_METHOD InjMass "" RAT_FUNC "%5.2" "mg/hub" COEFFS 0 100 0 0 0 1 /end COMPU_METHOD
/begin COMPU_METHOD ISC_dnEng_float "Umrechnung für die Drehzahlbeschleunigung (Float Implementierung)" RAT_FUNC "%6.2" "rpm/s" COEFFS 0 1 0 0 0 1 /end COMPU_METHOD
/begin COMPU_METHOD ISC_Inirtia_float "Umrechnung für Massenträgheitsmoment (Float Implementierung)" RAT_FUNC "%6.2" "Nm/(rpm/s)" COEFFS 0 1 0 0 0 1 /end COMPU_METHOD
/begin COMPU_METHOD ISC_Ki_rpm2Nm_float "Umrechnung für Verstärkung I-Anteil (Float Implementierung)" RAT_FUNC "%6.2" "Nm/(rpm*s)" COEFFS 0 1 0 0 0 1 /end COMPU_METHOD
/begin COMPU_METHOD ISC_rnEng2vVeh_float "Umrechnung für das Verhältnis Motordrehzahl zu Fahrzeuggeschwindigkeit (Float Implementierung)" RAT_FUNC "%6.2" "rpm/(Km/h)" COEFFS 0 1 0 0 0 1 /end COMPU_METHOD
/begin COMPU_METHOD ISC_tiPT2nEng_float "Umrechnung für Zeitkonstante der PT2-Filterung der Motordrehzahl (Float Implementierung)" RAT_FUNC "%6.2" "s" COEFFS 0 1 0 0 0 1 /end COMPU_METHOD
/begin COMPU_METHOD ISC_tiPTsTrqLoss_float "Umrechnung für die Zeitkonstante für die Filterung bei der Lastmomentabschätzung (Float Implementierung)" RAT_FUNC "%6.2" "s" COEFFS 0 1 0 0 0 1 /end COMPU_METHOD
/begin COMPU_METHOD Ki_Amph2Am "" RAT_FUNC "%6.5" "kg" COEFFS 0 2147.483648 0 0 0 1 /end COMPU_METHOD
/begin COMPU_METHOD OneToOne "" RAT_FUNC "%6.0" "-" COEFFS 0 1 0 0 0 1 /end COMPU_METHOD
/begin COMPU_METHOD Pos_Prc_float "" RAT_FUNC "%6.2" "%" COEFFS 0 1 0 0 0 1 /end COMPU_METHOD
/begin COMPU_METHOD Prc "" RAT_FUNC "%6.4" "%" COEFFS 0 81.92 0 0 0 1 /end COMPU_METHOD
/begin COMPU_METHOD Pres_hPa "" RAT_FUNC "%5.1" "hPa" COEFFS 0 1 0 0 0 1 /end COMPU_METHOD
/begin COMPU_METHOD RmpEngN "" RAT_FUNC "%6.4" "rpm/s" COEFFS 0 131.072 0 0 0 1 /end COMPU_METHOD
/begin COMPU_METHOD RmpInjMass "" RAT_FUNC "%6.5" "(mg/stroke)/s" COEFFS 0 6553.6 0 0 0 1 /end COMPU_METHOD
/begin COMPU_METHOD RmpPres_hPa "" RAT_FUNC "%6.4" "hPa/s" COEFFS 0 65.536 0 0 0 1 /end COMPU_METHOD
/begin COMPU_METHOD RmpTemp "" RAT_FUNC "%6.4" "K/s" COEFFS 0 655.36 0 0 0 1 /end COMPU_METHOD
/begin COMPU_METHOD Rmp_1 "" RAT_FUNC "%6.5" "1/s" COEFFS 0 1000 0 0 0 1 /end COMPU_METHOD
/begin COMPU_METHOD TempCels_100ms "" RAT_FUNC "%6.2" "deg C/s" COEFFS 0 1 0 0 0 1 /end COMPU_METHOD
/begin COMPU_METHOD TempDiff_Cels "" RAT_FUNC "%6.3" "deg C" COEFFS 0 10 0 0 0 1 /end COMPU_METHOD
/begin COMPU_METHOD Temp_Cels "" RAT_FUNC "%5.1" "deg C" COEFFS 0 10 2731.4 0 0 1 /end COMPU_METHOD
/begin COMPU_METHOD TimeDeb "" RAT_FUNC "%5.0" "ms" COEFFS 0 0.1 0 0 0 1 /end COMPU_METHOD
/begin COMPU_METHOD TimeDelay_ms "" RAT_FUNC "%12.1" "ms" COEFFS 0 0 1 0 2.3283064365387e-007 0 /end COMPU_METHOD
/begin COMPU_METHOD TimeDelay_s "" RAT_FUNC "%12.4" "s" COEFFS 0 0 1 0 0.00023283064365387 0 /end COMPU_METHOD
/begin COMPU_METHOD Time_Dt "" RAT_FUNC "%9.8" "s" COEFFS 0 1000000 0 0 0 1 /end COMPU_METHOD
/begin COMPU_METHOD Time_ms "" RAT_FUNC "%5.0" "ms" COEFFS 0 0.1 0 0 0 1 /end COMPU_METHOD
/begin COMPU_METHOD Time_Period_HFM6 "" RAT_FUNC "%7.6" "ms" COEFFS 0 20000 0 0 0 1 /end COMPU_METHOD
/begin COMPU_METHOD Time_PwmHigh "" RAT_FUNC "%6.4" "us" COEFFS 0 20 0 0 0 1 /end COMPU_METHOD
/begin COMPU_METHOD Time_s "" RAT_FUNC "%5.2" "s" COEFFS 0 100 0 0 0 1 /end COMPU_METHOD
/begin COMPU_METHOD Time_Sec_One2One "" RAT_FUNC "%6.2" "s" COEFFS 0 1 0 0 0 1 /end COMPU_METHOD
/begin COMPU_METHOD Time_s_float "" RAT_FUNC "%6.2" "s" COEFFS 0 1 0 0 0 1 /end COMPU_METHOD
/begin COMPU_METHOD Trq "" RAT_FUNC "%5.1" "Nm" COEFFS 0 10 0 0 0 1 /end COMPU_METHOD
/begin COMPU_METHOD Vel "" RAT_FUNC "%5.2" "km/h" COEFFS 0 100 0 0 0 1 /end COMPU_METHOD
/begin COMPU_METHOD Volt_Batt "" RAT_FUNC "%5.0" "mV" COEFFS 0 0.05 0 0 0 1 /end COMPU_METHOD
/begin COMPU_METHOD default "" RAT_FUNC "%6.2" "" COEFFS 0 1 0 0 0 1 /end COMPU_METHOD
/begin RECORD_LAYOUT CurTKL_SW_VV_SW NO_AXIS_PTS_X 1 UBYTE RESERVED 2 BYTE AXIS_PTS_X 3 SWORD INDEX_INCR DIRECT FNC_VALUES 4 SWORD COLUMN_DIR DIRECT /end RECORD_LAYOUT
/begin RECORD_LAYOUT CurTKL_SW_VV_UB NO_AXIS_PTS_X 1 UBYTE RESERVED 2 BYTE AXIS_PTS_X 3 SWORD INDEX_INCR DIRECT FNC_VALUES 4 UBYTE COLUMN_DIR DIRECT /end RECORD_LAYOUT
/begin RECORD_LAYOUT CurTKL_SW_VV_UW NO_AXIS_PTS_X 1 UBYTE RESERVED 2 BYTE AXIS_PTS_X 3 SWORD INDEX_INCR DIRECT FNC_VALUES 4 UWORD COLUMN_DIR DIRECT /end RECORD_LAYOUT
/begin RECORD_LAYOUT CurTKL_UB_VV_SB NO_AXIS_PTS_X 1 UBYTE RESERVED 2 BYTE AXIS_PTS_X 3 UBYTE INDEX_INCR DIRECT FNC_VALUES 4 SBYTE COLUMN_DIR DIRECT /end RECORD_LAYOUT
/begin RECORD_LAYOUT CurTKL_UB_VV_UB NO_AXIS_PTS_X 1 UBYTE RESERVED 2 BYTE AXIS_PTS_X 3 UBYTE INDEX_INCR DIRECT FNC_VALUES 4 UBYTE COLUMN_DIR DIRECT /end RECORD_LAYOUT
/begin RECORD_LAYOUT CurTKL_UB_VV_UW NO_AXIS_PTS_X 1 UBYTE RESERVED 2 BYTE AXIS_PTS_X 3 UBYTE INDEX_INCR DIRECT FNC_VALUES 4 UWORD COLUMN_DIR DIRECT /end RECORD_LAYOUT
/begin RECORD_LAYOUT CurTKL_UW_VV_UW NO_AXIS_PTS_X 1 UBYTE RESERVED 2 BYTE AXIS_PTS_X 3 UWORD INDEX_INCR DIRECT FNC_VALUES 4 UWORD COLUMN_DIR DIRECT /end RECORD_LAYOUT
/begin RECORD_LAYOUT Cur_Xr32Wr32 NO_AXIS_PTS_X 1 SLONG AXIS_PTS_X 2 FLOAT32_IEEE INDEX_INCR DIRECT FNC_VALUES 3 FLOAT32_IEEE COLUMN_DIR DIRECT /end RECORD_LAYOUT
/begin RECORD_LAYOUT Cur_Xs16Ws16 NO_AXIS_PTS_X 1 SWORD AXIS_PTS_X 2 SWORD INDEX_INCR DIRECT FNC_VALUES 3 SWORD COLUMN_DIR DIRECT /end RECORD_LAYOUT
/begin RECORD_LAYOUT Kw_Wr32 FNC_VALUES 1 FLOAT32_IEEE COLUMN_DIR DIRECT /end RECORD_LAYOUT
/begin RECORD_LAYOUT Kw_Ws16 FNC_VALUES 1 SWORD COLUMN_DIR DIRECT /end RECORD_LAYOUT
/begin RECORD_LAYOUT Kw_Ws32 FNC_VALUES 1 SLONG COLUMN_DIR DIRECT /end RECORD_LAYOUT
/begin RECORD_LAYOUT Kw_Wu16 FNC_VALUES 1 UWORD COLUMN_DIR DIRECT /end RECORD_LAYOUT
/begin RECORD_LAYOUT Kw_Wu8 FNC_VALUES 1 UBYTE COLUMN_DIR DIRECT /end RECORD_LAYOUT
/begin RECORD_LAYOUT MapTKF_SW_UW_UW NO_AXIS_PTS_X 1 UBYTE NO_AXIS_PTS_Y 2 UBYTE AXIS_PTS_X 3 UWORD INDEX_INCR DIRECT AXIS_PTS_Y 4 SWORD INDEX_INCR DIRECT FNC_VALUES 5 UWORD COLUMN_DIR DIRECT /end RECORD_LAYOUT
/begin RECORD_LAYOUT MapTKF_UW_SW_UB NO_AXIS_PTS_X 1 UBYTE NO_AXIS_PTS_Y 2 UBYTE AXIS_PTS_X 3 SWORD INDEX_INCR DIRECT AXIS_PTS_Y 4 UWORD INDEX_INCR DIRECT FNC_VALUES 5 UBYTE COLUMN_DIR DIRECT /end RECORD_LAYOUT
/begin RECORD_LAYOUT Map_Xr32Yr32Wr32 NO_AXIS_PTS_X 1 SLONG NO_AXIS_PTS_Y 2 SLONG AXIS_PTS_X 3 FLOAT32_IEEE INDEX_INCR DIRECT AXIS_PTS_Y 4 FLOAT32_IEEE INDEX_INCR DIRECT FNC_VALUES 5 FLOAT32_IEEE COLUMN_DIR DIRECT /end RECORD_LAYOUT
/begin RECORD_LAYOUT Map_Xs16Ys16Ws16 NO_AXIS_PTS_X 1 SWORD NO_AXIS_PTS_Y 2 SWORD AXIS_PTS_X 3 SWORD INDEX_INCR DIRECT AXIS_PTS_Y 4 SWORD INDEX_INCR DIRECT FNC_VALUES 5 SWORD COLUMN_DIR DIRECT /end RECORD_LAYOUT
/begin RECORD_LAYOUT ValA_Wu16 FNC_VALUES 1 UWORD COLUMN_DIR DIRECT /end RECORD_LAYOUT
/begin RECORD_LAYOUT Val_Wr32 FNC_VALUES 1 FLOAT32_IEEE COLUMN_DIR DIRECT /end RECORD_LAYOUT
/begin RECORD_LAYOUT Val_Ws16 FNC_VALUES 1 SWORD COLUMN_DIR DIRECT /end RECORD_LAYOUT
/begin RECORD_LAYOUT Val_Ws32 FNC_VALUES 1 SLONG COLUMN_DIR DIRECT /end RECORD_LAYOUT
/begin RECORD_LAYOUT Val_Wu16 FNC_VALUES 1 UWORD COLUMN_DIR DIRECT /end RECORD_LAYOUT
/begin RECORD_LAYOUT Val_Wu32 FNC_VALUES 1 ULONG COLUMN_DIR DIRECT /end RECORD_LAYOUT
/begin RECORD_LAYOUT Val_Wu8 FNC_VALUES 1 UBYTE COLUMN_DIR DIRECT /end RECORD_LAYOUT
/end MODULE
/end PROJECT

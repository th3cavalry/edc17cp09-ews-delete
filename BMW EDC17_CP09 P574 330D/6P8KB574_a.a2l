ASAP2_VERSION 1 4
/begin PROJECT P_574 "EDC17_CP09"
/begin HEADER "" VERSION "V8KB" PROJECT_NO P_574 /end HEADER
/begin MODULE DIM ""
/begin MOD_COMMON "" BYTE_ORDER MSB_LAST ALIGNMENT_BYTE 1 ALIGNMENT_WORD 2 ALIGNMENT_LONG 4 ALIGNMENT_FLOAT32_IEEE 4 /end MOD_COMMON
/begin CHARACTERISTIC ActMod_trqClthWoDstC_C "Adapter - ActMod_trqClthWoDstC_C" VALUE 0x800662AA Val_Ws16 6553.500 Trq -3276.800 3276.700 /end CHARACTERISTIC
/begin CHARACTERISTIC Eng_stStopEna_C "Motorstopfreigabe-Parameter" VALUE 0x800662AC Val_Wu8 255.0 OneToOne 0.00 255.0 /end CHARACTERISTIC
/begin CHARACTERISTIC Eng_stStrtEna_C "Motorstartfreigabe-Parameter" VALUE 0x800662AD Val_Wu8 255.0 OneToOne 0.00 255.0 /end CHARACTERISTIC
/begin CHARACTERISTIC Exh_numCntBckPPFltUs_C "" VALUE 0x800575AC Val_Ws16 65535.00 OneToOne -32768.00 32767.00 /end CHARACTERISTIC
/begin CHARACTERISTIC Exh_numCntMaxPPFltUs_C "" VALUE 0x800575AE Val_Ws16 65535.00 OneToOne -32768.00 32767.00 /end CHARACTERISTIC
/begin CHARACTERISTIC Exh_numFldPPFltUs_C "" VALUE 0x800575B0 Val_Ws16 65535.00 OneToOne -32768.00 32767.00 /end CHARACTERISTIC
/begin CHARACTERISTIC Exh_RmpSlpPPFltUs.Pos_C "/" VALUE 0x800575B4 Kw_Ws32 32767999.9847 RmpPres_hPa 0.00 32767999.9847 FORMAT "%13.4" EXTENDED_LIMITS -32768000.0000 32767999.9847 /end CHARACTERISTIC
/begin CHARACTERISTIC Exh_RmpSlpPPFltUs.Neg_C "/" VALUE 0x800575B8 Kw_Ws32 32767999.9847 RmpPres_hPa 0.00 32767999.9847 FORMAT "%13.4" EXTENDED_LIMITS -32768000.0000 32767999.9847 /end CHARACTERISTIC
/begin CHARACTERISTIC Exh_swtDflPPFltUs_C "" VALUE 0x800575BC Val_Wu8 255.0 OneToOne 0.00 255.0 /end CHARACTERISTIC
/begin CHARACTERISTIC Exh_swtEnvTPPFltUs_C "" VALUE 0x800575BD Val_Wu8 1.000 OneToOne 0.00 1.000 EXTENDED_LIMITS 0.00 255.0 /end CHARACTERISTIC
/begin CHARACTERISTIC Exh_swtSensCfgPPFlt_C "" VALUE 0x800575BE Val_Wu8 255.0 OneToOne 0.00 255.0 /end CHARACTERISTIC
/begin CHARACTERISTIC Exh_tFrzMinPPFltUs_C "" VALUE 0x800575C0 Val_Ws16 250.2000 Temp_Cels -50.14000 200.0600 EXTENDED_LIMITS -3549.940 3003.560 /end CHARACTERISTIC
/begin CHARACTERISTIC Exh_TrStgParPPFltUs.Dfl_C "/" VALUE 0x800575C2 Kw_Ws16 3500.0000 Pres_hPa 0.00 3500.0000 EXTENDED_LIMITS -32768.00 32767.00 /end CHARACTERISTIC
/begin CHARACTERISTIC Exh_TrStgParPPFltUs.stSensId_C "/" VALUE 0x800575C4 Kw_Wu8 255.0 OneToOne 0.00 255.0 /end CHARACTERISTIC
/begin CHARACTERISTIC GbxNPos_st_C "Parameter für Getriebe-Neutralstellung" VALUE 0x800662AE Val_Wu8 255.0 OneToOne 0.00 255.0 /end CHARACTERISTIC
/begin CHARACTERISTIC Gbx_bASTIntv_C "Anforderungsparameter für AST Eingriff" VALUE 0x800662AF Val_Wu8 255.0 OneToOne 0.00 255.0 /end CHARACTERISTIC
/begin CHARACTERISTIC Gbx_bASTNeutr_C "Neutralwert-Parameter für AST-Eingriff" VALUE 0x800662B0 Val_Wu8 255.0 OneToOne 0.00 255.0 /end CHARACTERISTIC
/begin CHARACTERISTIC KF_QVH2O_FT "Berechnung der temperaturabhängigen Zusatzrate: f_T =aT_0 + aT_1 * (T - Tx) + aT_2 * (T - Tx)^2 + aT_3 * (T - Tx)^3 + aT_exp * exp(bT_exp * (T - Tx))" MAP 0x80066412 MapTKF_UB_SW_SW 655.350 Def_f_sw_q0p01 -327.680 327.670 FORMAT "%7.3"
 /begin AXIS_DESCR STD_AXIS T_batt Def_t_sw_q0p1 12 -3276.8 3276.7 FORMAT "%6.1" DEPOSIT ABSOLUTE /end AXIS_DESCR
 /begin AXIS_DESCR STD_AXIS Qvh2o_btyp Def_dez_ub_q1 2 0.00 255. FORMAT "%3.0" DEPOSIT ABSOLUTE /end AXIS_DESCR
/end CHARACTERISTIC
/begin CHARACTERISTIC KF_QVH2O_XH "Berechnung der Abhängigkeit von der bisherigen Wasserverbrauchsrate: 1 + a_WL * EXP( (-1) * b_WL*xSum)" MAP 0x8006645E MapTKF_UB_SW_SW 655.350 Def_f_sw_q0p01 -327.680 327.670 FORMAT "%7.3"
 /begin AXIS_DESCR STD_AXIS Qvh2o_xhsum Def_f_sw_q0p01 12 -327.680 327.670 FORMAT "%7.3" DEPOSIT ABSOLUTE /end AXIS_DESCR
 /begin AXIS_DESCR STD_AXIS Qvh2o_btyp Def_dez_ub_q1 2 0.00 255. FORMAT "%3.0" DEPOSIT ABSOLUTE /end AXIS_DESCR
/end CHARACTERISTIC
/begin CHARACTERISTIC KF_QVH2O_XI "Berechnung der Ladestromabhängigkeit: x_I =aI_0 + aI1 * xI_20 + aI2 * (xI_20)^2 + aI3 * (xI_20)^3 + aI_exp * exp(bI_exp * xI_20)" MAP 0x800664AA MapTKF_UB_SW_SW 655.350 Def_f_sw_q0p01 -327.680 327.670 FORMAT "%7.3"
 /begin AXIS_DESCR STD_AXIS Qvh2o_xi20 Def_f_sw_q0p01 12 -327.680 327.670 FORMAT "%7.3" DEPOSIT ABSOLUTE /end AXIS_DESCR
 /begin AXIS_DESCR STD_AXIS Qvh2o_btyp Def_dez_ub_q1 2 0.00 255. FORMAT "%3.0" DEPOSIT ABSOLUTE /end AXIS_DESCR
/end CHARACTERISTIC
/begin CHARACTERISTIC KF_QVH2O_XT "Berechnung der Temperaturabhängigkeit: x_T = exp(-T0*(1/(T+273,15)-(1/298,15)))" MAP 0x800664F6 MapTKF_UB_SW_SW 655.350 Def_f_sw_q0p01 -327.680 327.670 FORMAT "%7.3"
 /begin AXIS_DESCR STD_AXIS T_batt Def_t_sw_q0p1 12 -3276.8 3276.7 FORMAT "%6.1" DEPOSIT ABSOLUTE /end AXIS_DESCR
 /begin AXIS_DESCR STD_AXIS Qvh2o_btyp Def_dez_ub_q1 2 0.00 255. FORMAT "%3.0" DEPOSIT ABSOLUTE /end AXIS_DESCR
/end CHARACTERISTIC
/begin CHARACTERISTIC KF_QVH2O_XU "Berechnung der Spannungsabhängigkeit: x_U = exp((U-U_0)/(U_std - U_0)))" MAP 0x80066542 MapTKF_UB_SW_SW 655.350 Def_f_sw_q0p01 -327.680 327.670 FORMAT "%7.3"
 /begin AXIS_DESCR STD_AXIS Qv_ubatt_ber Def_u_sw_b128 12 -128.0000 127.9961 FORMAT "%8.4" DEPOSIT ABSOLUTE /end AXIS_DESCR
 /begin AXIS_DESCR STD_AXIS Qvh2o_btyp Def_dez_ub_q1 2 0.00 255. FORMAT "%3.0" DEPOSIT ABSOLUTE /end AXIS_DESCR
/end CHARACTERISTIC
/begin CHARACTERISTIC KF_U00 "QVC U00 - Kennfeld für Ruhestromkompensation" MAP 0x800662B6 MapTKF_SW_UW_UW 25.499611 Def_u_uw_b25p5 0.00 25.499611 FORMAT "%9.6"
 /begin AXIS_DESCR STD_AXIS U0_batt Def_u_uw_b25p5 3 0.00 25.499611 FORMAT "%9.6" DEPOSIT ABSOLUTE /end AXIS_DESCR
 /begin AXIS_DESCR STD_AXIS I_soc0_komp Def_i_sw_q0p001 5 -32.76800 32.76700 FORMAT "%8.5" DEPOSIT ABSOLUTE /end AXIS_DESCR
/end CHARACTERISTIC
/begin CHARACTERISTIC KL_QVQ_QWIN "Kennlinie zur Angabe der Qualität der Qvm-Werte im Betrachtungsfenster" CURVE 0x800665A8 CurTKL_UB_VV_UB 255. Def_dez_ub_q1 0.00 255. FORMAT "%3.0"
 /begin AXIS_DESCR STD_AXIS Qv_bfenster Def_dez_ub_q1 10 0.00 255. FORMAT "%3.0" DEPOSIT ABSOLUTE /end AXIS_DESCR
/end CHARACTERISTIC
/begin CHARACTERISTIC KL_SOC0TMP "QVC U00 - Temperaturabhängige Stromkorrektur für Ruhespannungsmessung" CURVE 0x800662E6 CurTKL_SW_VV_UB 1.9922 Def_f_ub_b2 0.00 1.9922
 /begin AXIS_DESCR STD_AXIS T_battsoc0 Def_t_sw_q0p1 5 -3276.8 3276.7 FORMAT "%6.1" DEPOSIT ABSOLUTE /end AXIS_DESCR
/end CHARACTERISTIC
/begin CHARACTERISTIC KL_U00QUA_I "QVC U00 - Qualitätsindex U00 Ruhestromeinfluss" CURVE 0x800662F8 CurTKL_SW_VV_UB 99.61 Def_f_ub_b100 0.00 99.61
 /begin AXIS_DESCR STD_AXIS X_KL_U00QUA_I_no_input_quantity Def_i_sw_q0p001 4 -32.76800 32.76700 FORMAT "%8.5" DEPOSIT ABSOLUTE /end AXIS_DESCR
/end CHARACTERISTIC
/begin CHARACTERISTIC KL_U00QUA_NF "QVC U00 - Qualitätsindex U00 Einfluss fehlende Messungen" CURVE 0x80066306 CurTKL_UB_VV_UB 99.61 Def_f_ub_b100 0.00 99.61
 /begin AXIS_DESCR STD_AXIS Qv_n_fehlmes Def_f_ub_b8 4 0.00 7.969 DEPOSIT ABSOLUTE /end AXIS_DESCR
/end CHARACTERISTIC
/begin CHARACTERISTIC KL_U00QUA_T "QVC U00 - Qualitätsindex U00 Temperatureinfluss" CURVE 0x80066310 CurTKL_SW_VV_UB 99.61 Def_f_ub_b100 0.00 99.61
 /begin AXIS_DESCR STD_AXIS T_battsoc0 Def_t_sw_q0p1 6 -3276.8 3276.7 FORMAT "%6.1" DEPOSIT ABSOLUTE /end AXIS_DESCR
/end CHARACTERISTIC
/begin CHARACTERISTIC KL_U00QUA_TR "QVC U00 - Qualitätsindex U00 Einfluss Ruhezeit" CURVE 0x80066324 CurTKL_UW_VV_UB 99.61 Def_f_ub_b100 0.00 99.61
 /begin AXIS_DESCR STD_AXIS Qv_t_ruhzeit Def_td_uw_q1 6 0.00 65535. FORMAT "%5.0" DEPOSIT ABSOLUTE /end AXIS_DESCR
/end CHARACTERISTIC
/begin CHARACTERISTIC KL_U00QUA_U1 "QVC U00 - Qualitätsindex U00 Einfluss U00-Grössenordnung" CURVE 0x80066338 CurTKL_UW_VV_UB 99.61 Def_f_ub_b100 0.00 99.61
 /begin AXIS_DESCR STD_AXIS Qv_u00 Def_u_uw_b25p5 8 0.00 25.499611 FORMAT "%9.6" DEPOSIT ABSOLUTE /end AXIS_DESCR
/end CHARACTERISTIC
/begin CHARACTERISTIC KL_U00QUA_U2 "QVC U00 - Qualitätsindex U00 Einfluss Spannungsgradient" CURVE 0x80066352 CurTKL_SW_VV_UB 99.61 Def_f_ub_b100 0.00 99.61
 /begin AXIS_DESCR STD_AXIS U_diff_32 Def_u_sw_q0p00025 5 -8.1920000 8.1917500 DEPOSIT ABSOLUTE /end AXIS_DESCR
/end CHARACTERISTIC
/begin CHARACTERISTIC K_D_SUMMAND "QVC U00 - Summand zur Ruhezeitberechnung" VALUE 0x80066364 Val_Wu16 65535. Def_td_uw_q1 0.00 65535. FORMAT "%5.0" /end CHARACTERISTIC
/begin CHARACTERISTIC K_D_URUHE "QVC U00 - Bewertung Ruhezeit" VALUE 0x80066366 Val_Ws16 655.350 Def_f_sw_q0p01 -327.680 327.670 FORMAT "%7.3" /end CHARACTERISTIC
/begin CHARACTERISTIC K_MU_ABFALL "QVC U00 - Faktor für Näherung aus Ladung" VALUE 0x80066368 Val_Ws16 655.350 Def_f_sw_q0p01 -327.680 327.670 FORMAT "%7.3" /end CHARACTERISTIC
/begin CHARACTERISTIC K_MU_ANSTIEG "QVC U00 - Faktor für Näherung aus Entladung" VALUE 0x8006636A Val_Ws16 655.350 Def_f_sw_q0p01 -327.680 327.670 FORMAT "%7.3" /end CHARACTERISTIC
/begin CHARACTERISTIC K_QVCTIM1 "QVC MessdatenAkq - Zeitschwelle auf Start" VALUE 0x8006636C Val_Wu16 6553.5 Def_td_uw_q0p1 0.00 6553.5 FORMAT "%6.1" /end CHARACTERISTIC
/begin CHARACTERISTIC K_QVCTIM2 "QVC MessdatenAkq - Timeout Startup Kommunikation" VALUE 0x8006636E Val_Wu16 6553.5 Def_td_uw_q0p1 0.00 6553.5 FORMAT "%6.1" /end CHARACTERISTIC
/begin CHARACTERISTIC K_QVCTIM3 "QVC MessdatenAkq - Timeout Startwert Array übertragen" VALUE 0x80066370 Val_Wu16 6553.5 Def_td_uw_q0p1 0.00 6553.5 FORMAT "%6.1" /end CHARACTERISTIC
/begin CHARACTERISTIC K_QVCTIM4 "QVC MessdatenAkq - Timeout Messwerte einlesen" VALUE 0x80066372 Val_Wu16 6553.5 Def_td_uw_q0p1 0.00 6553.5 FORMAT "%6.1" /end CHARACTERISTIC
/begin CHARACTERISTIC K_QVH2OBAS "Grundrate Wasserverbrauch" VALUE 0x8006658E Val_Wu16 30.719531 Def_f_uw_q0p00047 0.00 30.719531 FORMAT "%9.6" /end CHARACTERISTIC
/begin CHARACTERISTIC K_QVH2OEM "Grenzwert, den der Wasserverbrauch überschreiten muss, damit B_qvch2o gesetzt wird." VALUE 0x80066590 Val_Wu16 63.999023 Def_f_uw_b64 0.00 63.999023 /end CHARACTERISTIC
/begin CHARACTERISTIC K_QVH2OQEM "Grenzwert, den Qv_h2oquali nicht überschreiten darf. Sonst wird B_qvch2o nicht gesetzt." VALUE 0x80066592 Val_Wu8 99.61 Def_f_ub_b100 0.00 99.61 /end CHARACTERISTIC
/begin CHARACTERISTIC K_QVH2OQVOS "Offset Qv (Kapazitätsverlust) - ohne Einheit" VALUE 0x80066593 Val_Ws8 127.5 Def_f_sb_b64 -64.00 63.50 /end CHARACTERISTIC
/begin CHARACTERISTIC K_QVH2OSOCB "SoC_Base" VALUE 0x80066594 Val_Wu8 93.36 Def_f_ub_b100 6.250 99.61 EXTENDED_LIMITS 0.00 99.61 /end CHARACTERISTIC
/begin CHARACTERISTIC K_QVH2O_BT "Ermittlung des Batterietyps aus der Variablen Batt_class (Array)" VAL_BLK 0x80066595 ValA_Wu8 255. Def_dez_ub_q1 0.00 255. FORMAT "%3.0" NUMBER 16 /end CHARACTERISTIC
/begin CHARACTERISTIC K_QVK20 "QVC Ini - Nennkapazitäten Batterien (Array)" VAL_BLK 0x80066374 ValA_Wu8 255. Def_ql_ub_q1 0.00 255. FORMAT "%4.0" NUMBER 16 /end CHARACTERISTIC
/begin CHARACTERISTIC K_QVK20OFS "QVC Ini - Abweichung Nennkapazitäten Batterien (Array)" VAL_BLK 0x80066384 ValA_Wu8 255. Def_ql_ub_q1 0.00 255. FORMAT "%4.0" NUMBER 16 /end CHARACTERISTIC
/begin CHARACTERISTIC K_QVMAXTGRD "QVC MessdatenAkq - Maximale Batterietemperatur Gradient" VALUE 0x80066394 Val_Ws16 6553.5 Def_t_sw_q0p1 -3276.8 3276.7 FORMAT "%6.1" /end CHARACTERISTIC
/begin CHARACTERISTIC K_QVMINVAL "QVC MessdatenAkq - Minimale Zahl Start-Wertepaare" VALUE 0x80066396 Val_Wu8 255. ident 0.00 255. FORMAT "%3.0" /end CHARACTERISTIC
/begin CHARACTERISTIC K_QVOUTM_DEF "Parameter zum manuellen Setzen der Größe Qv_out_m" VALUE 0x800665BE Val_Wu16 6553.5 Def_td_uw_q0p1 0.00 6553.5 FORMAT "%6.1" /end CHARACTERISTIC
/begin CHARACTERISTIC K_QVQM_DEF "Parameter zum manuellen Setzen der Größe Qv_quali_m" VALUE 0x800665C0 Val_Wu8 99.61 Def_f_ub_b100 0.00 99.61 /end CHARACTERISTIC
/begin CHARACTERISTIC K_QVQ_AUSMX "Maximale Anzahl von Ausreißern die zur Sprungerkennung nötig sind" VALUE 0x800665C1 Val_Wu8 6.0 Def_dez_ub_q1 0.00 6.0 EXTENDED_LIMITS 0.00 255. /end CHARACTERISTIC
/begin CHARACTERISTIC K_QVQ_BFMX "Maximale Größe des Betrachtungsfensters" VALUE 0x800665C2 Val_Wu8 255. Def_dez_ub_q1 0.00 255. FORMAT "%3.0" /end CHARACTERISTIC
/begin CHARACTERISTIC K_QVQ_CL "Faktor zur Berechnung der Qvm-Toleranzgrenzen" VALUE 0x800665C4 Val_Wu16 65.53500 Def_td_uw_q0p001 0.00 65.53500 FORMAT "%8.5" /end CHARACTERISTIC
/begin CHARACTERISTIC K_QVQ_CLR "Faktor zur Berechnung der Streugrenzen" VALUE 0x800665C6 Val_Wu16 65.53500 Def_td_uw_q0p001 0.00 65.53500 FORMAT "%8.5" /end CHARACTERISTIC
/begin CHARACTERISTIC K_QVQ_DELAY "Verzögerung, mit welcher Backup-Werte nach Flaschvorgang eingelesen werden." VALUE 0x800665C8 Val_Wu8 2.550 Def_td_ub_q0p01 0.00 2.550 FORMAT "%5.3" /end CHARACTERISTIC
/begin CHARACTERISTIC K_QVQ_QAUS "Faktor zur Anhebung der Qualität" VALUE 0x800665C9 Val_Wu8 15.94 Def_f_ub_b16 0.00 15.94 FORMAT "%5.2" /end CHARACTERISTIC
/begin CHARACTERISTIC K_QVQ_SFMX "Maximale Größe des Sprungfensters (Betrachtungsfenster zur Sprungerkennung)" VALUE 0x800665CA Val_Wu8 255. Def_dez_ub_q1 0.00 255. FORMAT "%3.0" /end CHARACTERISTIC
/begin CHARACTERISTIC K_QVQ_SZE "Ab dieser Zeit hat die Reduzierung der Qualität aufgrund der langen Satndzeit ihr Maximum erreicht" VALUE 0x800665CC Val_Wu16 65535. Def_th_uw_q1 0.00 65535. FORMAT "%5.0" /end CHARACTERISTIC
/begin CHARACTERISTIC K_QVQ_SZMX "Maximale Zeit nach der eine lange Standzeit dedektiert wird" VALUE 0x800665CE Val_Wu16 65535. Def_th_uw_q1 0.00 65535. FORMAT "%5.0" /end CHARACTERISTIC
/begin CHARACTERISTIC K_QVQ_SZS "Ab dieser Zeit erfolgt die Reduzierung der Qualität aufgrund der langen Standzeit" VALUE 0x800665D0 Val_Wu16 65535. Def_th_uw_q1 0.00 65535. FORMAT "%5.0" /end CHARACTERISTIC
/begin CHARACTERISTIC K_QVQ_TEST1 "Parameter für manuelle Beeinflussung" VALUE 0x800665D2 Val_Wu8 255. Def_dez_ub_q1 0.00 255. FORMAT "%3.0" /end CHARACTERISTIC
/begin CHARACTERISTIC K_QVQ_TGMX "Maximale Aufweitung der Qvm-Toleranzgrenzen" VALUE 0x800665D3 Val_Wu8 255. Def_dez_ub_q1 0.00 255. FORMAT "%3.0" /end CHARACTERISTIC
/begin CHARACTERISTIC K_QVRA "QVC Ini - Batterieparameter A (Array)" VAL_BLK 0x80066398 ValA_Ws16 15.999756 Def_f_sw_b8 -8.0000000 7.9997559 NUMBER 16 /end CHARACTERISTIC
/begin CHARACTERISTIC K_QVRB "QVC Ini - Batterieparameter B (Array)" VAL_BLK 0x800663B8 ValA_Ws16 15.999756 Def_f_sw_b8 -8.0000000 7.9997559 NUMBER 16 /end CHARACTERISTIC
/begin CHARACTERISTIC K_QVRC "QVC Ini - Batterieparameter C (Array)" VAL_BLK 0x800663D8 ValA_Ws16 15.999756 Def_f_sw_b8 -8.0000000 7.9997559 NUMBER 16 /end CHARACTERISTIC
/begin CHARACTERISTIC K_QVTLIMHI "QVC MessdatenAkq - obere Temperaturschwelle" VALUE 0x800663F8 Val_Ws16 6553.5 Def_t_sw_q0p1 -3276.8 3276.7 FORMAT "%6.1" /end CHARACTERISTIC
/begin CHARACTERISTIC K_QVTLIMLO "QVC MessdatenAkq - untere Temperaturschwelle" VALUE 0x800663FA Val_Ws16 6553.5 Def_t_sw_q0p1 -3276.8 3276.7 FORMAT "%6.1" /end CHARACTERISTIC
/begin CHARACTERISTIC K_QVVLIMHI "QVC MessdatenAkq - U00 Spannungsschwelle Hi" VALUE 0x800663FC Val_Wu16 16.383750 Def_u_uw_q0p25em3_o6 6.0000000 22.383750 FORMAT "%9.6" /end CHARACTERISTIC
/begin CHARACTERISTIC K_QVVLIMLO "QVC MessdatenAkq - U00 untere Spannungsschwelle (SOC = 30%)" VALUE 0x800663FE Val_Wu16 16.319750 Def_u_uw_q0p25em3_o6 6.0640000 22.383750 FORMAT "%9.6" EXTENDED_LIMITS 6.0000000 22.383750 /end CHARACTERISTIC
/begin CHARACTERISTIC K_QV_SCHWELLE "QVC U00 - Schwelle U_Ruhe für Fallunterscheidung ob Näherung aus Ladong oder Entladung" VALUE 0x80066400 Val_Ws16 655.350 Def_f_sw_q0p01 -327.680 327.670 FORMAT "%7.3" /end CHARACTERISTIC
/begin CHARACTERISTIC K_QV_TEST1 "Testgröße zum Einstellen, bedient 8 Schalter" VALUE 0x80066402 Val_Wu8 255. Def_dez_ub_q1 0.00 255. FORMAT "%3.0" /end CHARACTERISTIC
/begin CHARACTERISTIC K_QV_TKU00 "QVC CalcHyst - temperature coefficient for offload voltage of a battery with 6 cells" VALUE 0x80066404 Val_Ws16 0.249996 Def_f_sw_b0p125 -0.125000 0.124996 FORMAT "%8.6" /end CHARACTERISTIC
/begin CHARACTERISTIC K_QV_TSTU00 "QVC CalcHyst - Test-AK Ruhespannung Ersatzwert" VALUE 0x80066406 Val_Wu16 16.383750 Def_u_uw_q0p25em3_o6 6.0000000 22.383750 FORMAT "%9.6" /end CHARACTERISTIC
/begin CHARACTERISTIC K_U00EMPTLIM "QVC CalcHyst - Untergrenze U00 für SOC-Bestimmung" VALUE 0x80066408 Val_Wu16 11.900208 Def_u_uw_b25p5 0.099609375 11.999817 FORMAT "%9.6" EXTENDED_LIMITS 0.00 25.499611 /end CHARACTERISTIC
/begin CHARACTERISTIC K_U00FULLOADLIM "QVC CalcHyst - Obergrenze U00 für SOC-Bestimmung" VALUE 0x8006640A Val_Wu16 13.399796 Def_u_uw_b25p5 12.099815 25.499611 FORMAT "%9.6" EXTENDED_LIMITS 0.00 25.499611 /end CHARACTERISTIC
/begin CHARACTERISTIC K_U00QSCHW "QVC MessdatenAkq - Schwelle fuer U00_quali" VALUE 0x8006640C Val_Wu8 99.61 Def_f_ub_b100 0.00 99.61 /end CHARACTERISTIC
/begin CHARACTERISTIC K_U_SINKEND "QVC U00 - Offset in U00-Berechnung für Näherung aus Ladung" VALUE 0x8006640E Val_Ws16 655.350 Def_f_sw_q0p01 -327.680 327.670 FORMAT "%7.3" /end CHARACTERISTIC
/begin CHARACTERISTIC K_U_STEIGEND "QVC U00 - Offset in U00-Berechnung für Näherung aus Entladung" VALUE 0x80066410 Val_Ws16 655.350 Def_f_sw_q0p01 -327.680 327.670 FORMAT "%7.3" /end CHARACTERISTIC
/begin CHARACTERISTIC MeUn_dvolSet_C "Fernsteuerwert der Durchflussmenge der Zumesseinheit" VALUE 0x80059DA4 Val_Ws16 150000.0 Qp_mm3_sec 0.00 150000.0 FORMAT "%8.1" EXTENDED_LIMITS -327680.0 327670.0 /end CHARACTERISTIC
/begin CHARACTERISTIC MeUn_swtDvolSet_C "Schalter zur Fernsteuerung der Durchflussmenge der Zumesseinheit" VALUE 0x80059DA6 Val_Wu8 1.000 OneToOne 0.00 1.000 EXTENDED_LIMITS 0.00 255.0 /end CHARACTERISTIC
/begin CHARACTERISTIC PCV_pSet_C "Fernsteuerwert des Drucks des Druckregelventils" VALUE 0x80059DA8 Val_Ws16 2000.000 Pres_Rail 0.00 2000.000 EXTENDED_LIMITS -3276.800 3276.700 /end CHARACTERISTIC
/begin CHARACTERISTIC PCV_swtPSet_C "Schalter zur Fernsteuerung des Drucks des Druckregelventils" VALUE 0x80059DAA Val_Wu8 1.000 OneToOne 0.00 1.000 EXTENDED_LIMITS 0.00 255.0 /end CHARACTERISTIC
/begin CHARACTERISTIC PSPCtl_dvolBase_CUR "Kennlinie zur ermittlung des Drehzahlabhängigen Basisvolumenstroms" CURVE 0x800575C8 Cur_Xs16Ws16 300.0000 FlConsum_l_h 0.00 300.0000 FORMAT "%8.4" EXTENDED_LIMITS -327.6800 327.6700
 /begin AXIS_DESCR STD_AXIS Epm_nEng EngN 8 20.00000 10000.00 EXTENDED_LIMITS -16384.00 16383.50 DEPOSIT ABSOLUTE /end AXIS_DESCR
/end CHARACTERISTIC
/begin CHARACTERISTIC PSPCtl_dvolMax_C "Obere Grenze für den Basis Volumenstrom" VALUE 0x800575EA Val_Ws16 100.0000 FlConsum_l_h 0.00 100.0000 FORMAT "%8.4" EXTENDED_LIMITS -327.6800 327.6700 /end CHARACTERISTIC
/begin CHARACTERISTIC PSPCtl_dvolMin_C "Untere grenze des Basisvolumenstroms" VALUE 0x800575EC Val_Ws16 100.0000 FlConsum_l_h 0.00 100.0000 FORMAT "%8.4" EXTENDED_LIMITS -327.6800 327.6700 /end CHARACTERISTIC
/begin CHARACTERISTIC PSPCtl_dvolOut1_C "" VALUE 0x800575EE Val_Ws16 100.0000 FlConsum_l_h 0.00 100.0000 FORMAT "%8.4" EXTENDED_LIMITS -327.6800 327.6700 /end CHARACTERISTIC
/begin CHARACTERISTIC PSPCtl_dvolOut_C "" VALUE 0x800575F0 Val_Ws16 100.0000 FlConsum_l_h 0.00 100.0000 FORMAT "%8.4" EXTENDED_LIMITS -327.6800 327.6700 /end CHARACTERISTIC
/begin CHARACTERISTIC PSPCtl_dvolTempLim_MAP "Kennfeld zur ermittlung der Temperaturabhängigen Begrenzung des PVP Volumenstroms" MAP 0x800575F2 Map_Xs16Ys16Ws16 300.0000 FlConsum_l_h 0.00 300.0000 FORMAT "%8.4" EXTENDED_LIMITS -327.6800 327.6700
 /begin AXIS_DESCR STD_AXIS Epm_nEng EngN 3 20.00000 10000.00 EXTENDED_LIMITS -16384.00 16383.50 DEPOSIT ABSOLUTE /end AXIS_DESCR
 /begin AXIS_DESCR STD_AXIS FuelT_t Temp_Cels 3 -50.14000 149.8600 EXTENDED_LIMITS -3549.940 3003.560 DEPOSIT ABSOLUTE /end AXIS_DESCR
/end CHARACTERISTIC
/begin CHARACTERISTIC PSPCtl_facFuelTCor_CUR "Kennlinie zur Ermittlung des Kraftstofftemperaturabhängigen Korrekturfaktors des Basisvolumenstroms" CURVE 0x80057614 Cur_Xs16Ws16 50.00000 Fact1 0.00 50.00000 EXTENDED_LIMITS -256.0000 255.9922
 /begin AXIS_DESCR STD_AXIS FuelT_t Temp_Cels 2 -50.14000 149.8600 EXTENDED_LIMITS -3549.940 3003.560 DEPOSIT ABSOLUTE /end AXIS_DESCR
/end CHARACTERISTIC
/begin CHARACTERISTIC PSPCtl_nLim_C "Drehzahlschwelle für die deaktivierung des Kl. 15 Volumenstroms und aktivierung des normalen Volumenstroms" VALUE 0x8005761E Val_Ws16 9980.000 EngN 20.00000 10000.00 EXTENDED_LIMITS -16384.00 16383.50 /end CHARACTERISTIC
/begin CHARACTERISTIC PSPCtl_swtMSAStop_C "Schalter zur aktivierung des MSA - Eingriffs in die Pumpenlogik" VALUE 0x80057620 Val_Wu8 1.000 OneToOne 0.00 1.000 EXTENDED_LIMITS 0.00 255.0 /end CHARACTERISTIC
/begin CHARACTERISTIC PSPCtl_tiT15Delay_CUR "Kennfeld zur Ermittlung der Aktivierungszeit der PSP nach Kl. 15 Ein" CURVE 0x80057622 Cur_Xs16Ws16 655350.0 Time_ms -327680.0 327670.0
 /begin AXIS_DESCR STD_AXIS EngDa_tEng Temp_Cels 8 -50.14000 149.8600 EXTENDED_LIMITS -3549.940 3003.560 DEPOSIT ABSOLUTE /end AXIS_DESCR
/end CHARACTERISTIC
/begin CHARACTERISTIC PthSet_dtrqRmpDwnDfl_C "Rampensteigung bei Schubabschaltung" VALUE 0x80058C9C Val_Ws32 3276784.99908 RmpTrq 14.9993896484 3276799.99847 EXTENDED_LIMITS -3276800.00000 3276799.99847 /end CHARACTERISTIC
/begin CHARACTERISTIC PthSet_dtrqRmpDwn_CUR "Rampensteigung bei Schubabschaltung bei Kraftschluß" CURVE 0x80058CA0 Cur_Xs16Ws16 3261.700 dTrq 15.00000 3276.700 FORMAT "%8.3" EXTENDED_LIMITS -3276.800 3276.700
 /begin AXIS_DESCR STD_AXIS PT_rTrq TransR 6 0.00 327.6700 EXTENDED_LIMITS -327.6800 327.6700 DEPOSIT ABSOLUTE /end AXIS_DESCR
/end CHARACTERISTIC
/begin CHARACTERISTIC PthSet_tiOvrRunCoordDebPos_C "Entprellzeit für den Übergang ""Kein Schub -> Schub"" im Schubkoordinator" VALUE 0x80058C98 Val_Ws16 655350.0 Time_ms -327680.0 327670.0 /end CHARACTERISTIC
/begin CHARACTERISTIC PthSet_tiRmpStrtDfl_C "Default Wartezeit nach Schuberkennung bis die Rampe startet" VALUE 0x80058CBA Val_Ws16 327670.0 Time_ms 0.00 327670.0 EXTENDED_LIMITS -327680.0 327670.0 /end CHARACTERISTIC
/begin CHARACTERISTIC PthSet_tiRmpStrt_CUR "Wartezeit nach Schuberkennung bei Kraftschluß bis die Rampe startet" CURVE 0x80058CBC Cur_Xs16Ws16 327670.0 Time_ms 0.00 327670.0 EXTENDED_LIMITS -327680.0 327670.0
 /begin AXIS_DESCR STD_AXIS PT_rTrq TransR 6 0.00 327.6700 EXTENDED_LIMITS -327.6800 327.6700 DEPOSIT ABSOLUTE /end AXIS_DESCR
/end CHARACTERISTIC
/begin CHARACTERISTIC PthSet_tiSwtOffDfl_C "Default Wartezeit nach Schuberkennung bis hart abgeschaltet wird" VALUE 0x80058CD6 Val_Ws16 327670.0 Time_ms 0.00 327670.0 EXTENDED_LIMITS -327680.0 327670.0 /end CHARACTERISTIC
/begin CHARACTERISTIC PthSet_tiSwtOff_CUR "Wartezeit nach Schuberkennung bei Kraftschluß bis hart abgeschaltet wird" CURVE 0x80058CD8 Cur_Xs16Ws16 327670.0 Time_ms 0.00 327670.0 EXTENDED_LIMITS -327680.0 327670.0
 /begin AXIS_DESCR STD_AXIS PT_rTrq TransR 6 0.00 327.6700 EXTENDED_LIMITS -327.6800 327.6700 DEPOSIT ABSOLUTE /end AXIS_DESCR
/end CHARACTERISTIC
/begin CHARACTERISTIC PthSet_trqOffs_C "Offseterweiterung für das Begrenzungsmoment, damit der Ruckeldämpfer-Störregler laufen kann" VALUE 0x80058CF2 Val_Ws16 100.0000 Trq 0.00 100.0000 EXTENDED_LIMITS -3276.800 3276.700 /end CHARACTERISTIC
/begin CHARACTERISTIC PthSet_trqOvrRunThres_C "Momentschwelle für die Schuberkennung" VALUE 0x80058C9A Val_Ws16 10.00000 Trq 0.00 10.00000 EXTENDED_LIMITS -3276.800 3276.700 /end CHARACTERISTIC
/begin CHARACTERISTIC PTODi_nEngMin_C "Minimale Drehzahl zur Momentenbegrenzung" VALUE 0x80057674 Val_Ws16 32767.50 EngN -16384.00 16383.50 /end CHARACTERISTIC
/begin CHARACTERISTIC PTODi_tiDebTrqComp_C "Entprellzeit für Begrenzung des kompensierten Moments" VALUE 0x80057648 Val_Wu32 4294967295.00 TimeDT 0.00 4294967295.00 FORMAT "%13.2" /end CHARACTERISTIC
/begin CHARACTERISTIC PTODi_tiDebTrqDes_C "Entprellzeit für angeforderte Momentenbegrenzung" VALUE 0x80057678 Val_Wu32 4294967295.00 TimeDT 0.00 4294967295.00 FORMAT "%13.2" /end CHARACTERISTIC
/begin CHARACTERISTIC PTODi_trqCompOfs_MAP "offset torque level 1" MAP 0x8005764C Kf_Xs16_Ys16_Ws16 6553.500 Trq -3276.800 3276.700
 /begin AXIS_DESCR STD_AXIS Epm_nEng EngN 3 -16384.00 16383.50 DEPOSIT ABSOLUTE /end AXIS_DESCR
 /begin AXIS_DESCR STD_AXIS MoFCoVeh_trqVehPtdMsg Mo_trq_nm_q0p1 3 -3276.800 3276.700 FORMAT "%8.3" DEPOSIT ABSOLUTE /end AXIS_DESCR
/end CHARACTERISTIC
/begin CHARACTERISTIC PTODi_trqCompPtdOfs_C "" VALUE 0x80057646 Kw_Ws16 6553.500 Trq -3276.800 3276.700 /end CHARACTERISTIC
/begin CHARACTERISTIC PTODi_trqDesOfs_MAP "offset torque level 1" MAP 0x8005767C Kf_Xs16_Ys16_Ws16 6553.500 Trq -3276.800 3276.700
 /begin AXIS_DESCR STD_AXIS Epm_nEng EngN 8 -16384.00 16383.50 DEPOSIT ABSOLUTE /end AXIS_DESCR
 /begin AXIS_DESCR STD_AXIS MoFCoVeh_trqVehPtdMsg Mo_trq_nm_q0p1 8 -3276.800 3276.700 FORMAT "%8.3" DEPOSIT ABSOLUTE /end AXIS_DESCR
/end CHARACTERISTIC
/begin CHARACTERISTIC PTODi_trqPtdOfs_C "Momentenoffset für die Sollpfadbegrenzung aufgrund Überwachung" VALUE 0x80057670 Kw_Ws16 6553.500 Trq -3276.800 3276.700 /end CHARACTERISTIC
/begin CHARACTERISTIC PT_dChkGrpDT1Kd_C "" VALUE 0x80057720 Val_Ws32 1000.00000000 Kd 0.00 1000.00000000 FORMAT "%13.8" EXTENDED_LIMITS -32768.0000000 32767.9999847 /end CHARACTERISTIC
/begin CHARACTERISTIC PT_dOfsGripDet_C "" VALUE 0x80057724 Val_Ws16 100.0000 dn_dZfine 0.00 100.0000 FORMAT "%8.4" EXTENDED_LIMITS -16384.00 16383.50 /end CHARACTERISTIC
/begin CHARACTERISTIC PT_dOfsNoGripDet_C "" VALUE 0x80057726 Val_Ws16 5000.000 dn_dZfine 0.00 5000.000 FORMAT "%8.3" EXTENDED_LIMITS -16384.00 16383.50 /end CHARACTERISTIC
/begin CHARACTERISTIC PT_drTrq.Pos_C "/" VALUE 0x80057750 Kw_Ws32 327679.999847 RmpTransR 0.00 327679.999847 FORMAT "%13.6" EXTENDED_LIMITS -327680.000000 327679.999847 /end CHARACTERISTIC
/begin CHARACTERISTIC PT_drTrq.Neg_C "/" VALUE 0x80057754 Kw_Ws32 327679.999847 RmpTransR 0.00 327679.999847 FORMAT "%13.6" EXTENDED_LIMITS -327680.000000 327679.999847 /end CHARACTERISTIC
/begin CHARACTERISTIC PT_dThetaGripDet_C "" VALUE 0x80057728 Val_Ws16 5000.000 Moment_Inertia 0.00 5000.000 FORMAT "%8.3" EXTENDED_LIMITS -327.6800 327.6700 /end CHARACTERISTIC
/begin CHARACTERISTIC PT_dThetaNoGripDet_C "" VALUE 0x8005772A Val_Ws16 5000.000 Moment_Inertia 0.00 5000.000 FORMAT "%8.3" EXTENDED_LIMITS -327.6800 327.6700 /end CHARACTERISTIC
/begin CHARACTERISTIC PT_rATSlipClsd_C "Analogwert für den Zustand Kraftschluss ist schlupfend vorhanden (Wandlerkupplung ist fast geschlossen aber noch schlupfend und ein Gang ist eingelegt)" VALUE 0x8005772C Kw_Ws16 655.3500 TransR -327.6800 327.6700 /end CHARACTERISTIC
/begin CHARACTERISTIC PT_rATSlipOpn_C "Analogwert für den Zustand Kraftschluss ist schlupfend vorhanden (Wandlerkupplung ist offen, Wandler im Schlupf und ein Gang ist eingelegt)" VALUE 0x8005772E Kw_Ws16 655.3500 TransR -327.6800 327.6700 /end CHARACTERISTIC
/begin CHARACTERISTIC PT_rATSlip_C "Analogwert für den Zustand Kraftschluss ist schlupfend vorhanden (Wandlerkupplung ist im schlupfgeregelten Betrieb und ein Gang ist eingelegt)" VALUE 0x80057730 Kw_Ws16 655.3500 TransR -327.6800 327.6700 /end CHARACTERISTIC
/begin CHARACTERISTIC PT_rGrip_C "Analogwert für den Zustand Kraftschluss ist sicher vorhanden (Wandler bzw. Kupplung ist geschlossen und ein Gang ist eingelegt)" VALUE 0x80057732 Kw_Ws16 655.3500 TransR -327.6800 327.6700 /end CHARACTERISTIC
/begin CHARACTERISTIC PT_rNoGrip_C "Analogwert für den Zustand Kraftschluss ist sicher ausgeschlossen" VALUE 0x80057734 Kw_Ws16 655.3500 TransR -327.6800 327.6700 /end CHARACTERISTIC
/begin CHARACTERISTIC PT_rTrqDfl_C "Defaultwert für Triebstrang-Übersetzung bei stehendem Fahrzeug" VALUE 0x80057758 Val_Ws16 655.3500 TransR -327.6800 327.6700 /end CHARACTERISTIC
/begin CHARACTERISTIC PT_swtMstShft_C "Mastershiftinformationen des Antriebsstrangs" VALUE 0x80057736 Kw_Wu8 255.0 OneToOne 0.00 255.0 /end CHARACTERISTIC
/begin CHARACTERISTIC PT_swtNoGripDet_C "" VALUE 0x80057737 Val_Wu8 255.0 OneToOne 0.00 255.0 /end CHARACTERISTIC
/begin CHARACTERISTIC PT_swtRTrqSel_C "" VALUE 0x8005775A Val_Ws8 255.0 OneToOne -128.0 127.0 /end CHARACTERISTIC
/begin CHARACTERISTIC PT_swtTrqLos_C "" VALUE 0x80057644 Kw_Wu8 255.0 OneToOne 0.00 255.0 /end CHARACTERISTIC
/begin CHARACTERISTIC PT_tiChkGrpDT1_C "" VALUE 0x80057738 Val_Ws32 48.941487800 TimeDelay_s 0.99999238556 49.941480186 FORMAT "%12.9" EXTENDED_LIMITS 0.000002000000001 4294.9672960 /end CHARACTERISTIC
/begin CHARACTERISTIC PT_tiChkGrpPT1_C "" VALUE 0x8005773C Val_Ws32 48.941487800 TimeDelay_s 0.99999238556 49.941480186 FORMAT "%12.9" EXTENDED_LIMITS 0.000002000000001 4294.9672960 /end CHARACTERISTIC
/begin CHARACTERISTIC PT_tiDebGearUnVal_C "" VALUE 0x80057740 Val_Wu16 3000.000 Time_ms 0.00 3000.000 EXTENDED_LIMITS 0.00 655350.0 /end CHARACTERISTIC
/begin CHARACTERISTIC PT_tiDebGrip_C "Applikationsparameter für Entprellzeit" VALUE 0x80057744 Kw_Ws32 4294967295.00 TimeDT -2147483648.00 2147483647.00 FORMAT "%13.2" /end CHARACTERISTIC
/begin CHARACTERISTIC PT_tiDebNoClthHiLo_C "" VALUE 0x80057748 Val_Wu16 3000.000 Time_ms 0.00 3000.000 EXTENDED_LIMITS 0.00 655350.0 /end CHARACTERISTIC
/begin CHARACTERISTIC PT_tiDebNoClthLoHi_C "" VALUE 0x8005774A Val_Wu16 3000.000 Time_ms 0.00 3000.000 EXTENDED_LIMITS 0.00 655350.0 /end CHARACTERISTIC
/begin CHARACTERISTIC PT_tiDebNoGrip_C "" VALUE 0x8005774C Val_Wu16 3000.000 Time_ms 0.00 3000.000 EXTENDED_LIMITS 0.00 655350.0 /end CHARACTERISTIC
/begin CHARACTERISTIC PT_tiRTrqDly_C "" VALUE 0x8005775C Val_Wu16 655350.0 TimeDeb 0.00 655350.0 /end CHARACTERISTIC
/begin CHARACTERISTIC PT_vMinGrip_C "minimale Fahrzeuggeschwindigkeit zur Bestimmung von Kraftschluss" VALUE 0x8005774E Kw_Wu16 655.3500 Vel 0.00 655.3500 /end CHARACTERISTIC
/begin CHARACTERISTIC QWC_facCor1_MAP "KF 1 für Gewichtungsfaktor der Druckwellenkorrektur" MAP 0x800590AC Map_Xs16Ys16Ws16 10.00000 Fact1 0.00 10.00000 EXTENDED_LIMITS -256.0000 255.9922
 /begin AXIS_DESCR STD_AXIS InjCrv_qMI1Des InjMass 8 0.00 327.6700 EXTENDED_LIMITS -327.6800 327.6700 DEPOSIT ABSOLUTE /end AXIS_DESCR
 /begin AXIS_DESCR STD_AXIS RailP_pCurr_mp Pres_Rail 16 0.00 2000.000 EXTENDED_LIMITS -3276.800 3276.700 DEPOSIT ABSOLUTE /end AXIS_DESCR
/end CHARACTERISTIC
/begin CHARACTERISTIC QWC_facCor2_MAP "KF 2 für Gewichtungsfaktor der Druckwellenkorrektur" MAP 0x800591E0 Map_Xs16Ys16Ws16 10.00000 Fact1 0.00 10.00000 EXTENDED_LIMITS -256.0000 255.9922
 /begin AXIS_DESCR STD_AXIS InjCrv_qPoI2Des_mp InjMass 8 0.00 327.6700 EXTENDED_LIMITS -327.6800 327.6700 DEPOSIT ABSOLUTE /end AXIS_DESCR
 /begin AXIS_DESCR STD_AXIS RailP_pCurr_mp Pres_Rail 16 0.00 2000.000 EXTENDED_LIMITS -3276.800 3276.700 DEPOSIT ABSOLUTE /end AXIS_DESCR
/end CHARACTERISTIC
/begin CHARACTERISTIC QWC_facFTS_MAP "KF für die Berechnung des kraftstofftemperaturabhängigen Druckwellenkorrekturfaktors" MAP 0x80058CF4 Map_Xs16Ys16Ws16 2.000000 Fact 0.00 2.000000 EXTENDED_LIMITS -4.000000 3.999878
 /begin AXIS_DESCR STD_AXIS RailP_pFlt Pres_Rail 16 0.00 2000.000 EXTENDED_LIMITS -3276.800 3276.700 DEPOSIT ABSOLUTE /end AXIS_DESCR
 /begin AXIS_DESCR STD_AXIS QWC_tCor Temp_Cels 8 -40.04000 139.9600 EXTENDED_LIMITS -3549.940 3003.560 DEPOSIT ABSOLUTE /end AXIS_DESCR
/end CHARACTERISTIC
/begin CHARACTERISTIC QWC_facPiI2PiI1WvCor_C "Gewichtungsfaktor zur Aktivierung/Deaktivierung der Druckwellenmengenänderung von PiI1 durch PiI2" VALUE 0x80059314 Val_Ws16 1.000000 Fact 0.00 1.000000 EXTENDED_LIMITS -4.000000 3.999878 /end CHARACTERISTIC
/begin CHARACTERISTIC QWC_facPiI2_C "Gewichtungsfaktor der Druckwellenkorrekturmenge der MI1 abhängig von PiI2" VALUE 0x80059316 Val_Ws16 1.000000 Fact 0.00 1.000000 EXTENDED_LIMITS -4.000000 3.999878 /end CHARACTERISTIC
/begin CHARACTERISTIC QWC_facPoI1Cor_C "Korrekturfaktor fuer PoI1 bei Regeneration zum QWC" VALUE 0x80059318 Val_Ws16 1.000000 Fact1 0.00 1.000000 EXTENDED_LIMITS -256.0000 255.9922 /end CHARACTERISTIC
/begin CHARACTERISTIC QWC_qCor1_MAP "Grundwerte-KF 1 der Druckwellenkorrekturmenge" MAP 0x8005931A Map_Xs16Ys16Ws16 655.3400 InjMass -327.6700 327.6700 EXTENDED_LIMITS -327.6800 327.6700
 /begin AXIS_DESCR STD_AXIS QWC_tiPiI1MI1Cor_mp InjTime_us 32 0.00 5000.00 EXTENDED_LIMITS -13107.20 13106.80 DEPOSIT ABSOLUTE /end AXIS_DESCR
 /begin AXIS_DESCR STD_AXIS InjCrv_qPiI1Des_mp InjMass 16 0.00 24.00000 EXTENDED_LIMITS -327.6800 327.6700 DEPOSIT ABSOLUTE /end AXIS_DESCR
/end CHARACTERISTIC
/begin CHARACTERISTIC QWC_qCor2_MAP "Grundwerte-KF 2 der Druckwellenkorrekturmenge" MAP 0x8005977E Map_Xs16Ys16Ws16 655.3400 InjMass -327.6700 327.6700 EXTENDED_LIMITS -327.6800 327.6700
 /begin AXIS_DESCR STD_AXIS QWC_tiMI1PoI2Cor_mp InjTime_us 32 0.00 5000.00 EXTENDED_LIMITS -13107.20 13106.80 DEPOSIT ABSOLUTE /end AXIS_DESCR
 /begin AXIS_DESCR STD_AXIS QWC_rMI1Norm_mp QntR 12 0.0009765625 24.00000 FORMAT "%8.5" EXTENDED_LIMITS -32.00000 31.99902 DEPOSIT ABSOLUTE /end AXIS_DESCR
/end CHARACTERISTIC
/begin CHARACTERISTIC QWC_qMax_C "maximale Begrenzungsmenge der Druckwellenkorrektur" VALUE 0x80059ADA Val_Ws16 20.00000 InjMass -10.00000 10.00000 EXTENDED_LIMITS -327.6800 327.6700 /end CHARACTERISTIC
/begin CHARACTERISTIC QWC_qMin_C "minimale Begrenzungsmenge der Druckwellenkorrektur" VALUE 0x80059ADC Val_Ws16 20.00000 InjMass -10.00000 10.00000 EXTENDED_LIMITS -327.6800 327.6700 /end CHARACTERISTIC
/begin CHARACTERISTIC QWC_qNorm_CUR "Kennlinie für die raildruckabhängige Einspritznormierungsmenge" CURVE 0x80058E28 Cur_Xs16Ws16 327.6700 InjMass 0.00 327.6700 EXTENDED_LIMITS -327.6800 327.6700
 /begin AXIS_DESCR STD_AXIS RailP_pFlt Pres_Rail 14 0.00 2000.000 EXTENDED_LIMITS -3276.800 3276.700 DEPOSIT ABSOLUTE /end AXIS_DESCR
/end CHARACTERISTIC
/begin CHARACTERISTIC QWC_stActv_C "Freigabe der Druckwellenkorrektur" VALUE 0x80058E62 Val_Wu8 1.00000000000 QWC_st_VERB 0.00 1.00000000000 FORMAT "%13.11" /end CHARACTERISTIC
/begin CHARACTERISTIC QWC_swtDiffHydInSel_C "Auswahl für Darstellung des Betriebspunktes im Kennfeld QWC_tiDiffHyd_MAP (1,2,3: Darstellung, sonst: keine Darstellung)" VALUE 0x80059ADE Val_Wu8 2.000 OneToOne 0.00 2.000 EXTENDED_LIMITS 0.00 255.0 /end CHARACTERISTIC
/begin CHARACTERISTIC QWC_tCor_MAP "KF für die Eingangstemperatur der Druckwellenkorrektur" MAP 0x80058E64 Map_Xs16Ys16Ws16 180.0000 Temp_Cels -40.04000 139.9600 EXTENDED_LIMITS -3549.940 3003.560
 /begin AXIS_DESCR STD_AXIS QWC_FuelT_mp Temp_Cels 16 -50.14000 149.8600 EXTENDED_LIMITS -3549.940 3003.560 DEPOSIT ABSOLUTE /end AXIS_DESCR
 /begin AXIS_DESCR STD_AXIS QWC_CEngDsT_mp Temp_Cels 16 -50.14000 149.8600 EXTENDED_LIMITS -3549.940 3003.560 DEPOSIT ABSOLUTE /end AXIS_DESCR
/end CHARACTERISTIC
/begin CHARACTERISTIC QWC_tDflCEngDsT_C "Ersatztemperatur bei Sensorausfall" VALUE 0x800590A8 Val_Ws16 200.0000 Temp_Cels -50.14000 149.8600 EXTENDED_LIMITS -3549.940 3003.560 /end CHARACTERISTIC
/begin CHARACTERISTIC QWC_tDflFuelT_C "Ersatztemperatur bei Sensorausfall" VALUE 0x800590AA Val_Ws16 200.0000 Temp_Cels -50.14000 149.8600 EXTENDED_LIMITS -3549.940 3003.560 /end CHARACTERISTIC
/begin CHARACTERISTIC QWC_tiDiffHyd_MAP "Kennfeld mit Differenzzeiten zwischen hydraulischem Nadelschliessende und elektrischem Ansteuerende" MAP 0x80059AE0 Map_Xs16Ys16Ws16 10000.00 InjTime_us -5000.000 5000.000 EXTENDED_LIMITS -13107.20 13106.80
 /begin AXIS_DESCR STD_AXIS QWC_pCurrInDiffHyd_mp Pres_Rail 14 0.00 2000.000 EXTENDED_LIMITS -3276.800 3276.700 DEPOSIT ABSOLUTE /end AXIS_DESCR
 /begin AXIS_DESCR STD_AXIS QWC_qDesInDiffHyd_mp InjMassInj 16 0.00 327.6700 EXTENDED_LIMITS -327.6800 327.6700 DEPOSIT ABSOLUTE /end AXIS_DESCR
/end CHARACTERISTIC
/begin CHARACTERISTIC RadSht_idConsum_C "" VALUE 0x80059CE0 Val_Wu8 7.000 OneToOne 0.00 7.000 EXTENDED_LIMITS 0.00 255.0 /end CHARACTERISTIC
/begin CHARACTERISTIC RadSht_nFanRqMaxHi_C "" VALUE 0x80059CE2 Val_Ws16 3000.000 FanSpd 0.00 3000.000 FORMAT "%8.3" EXTENDED_LIMITS -3000.092 3000.000 /end CHARACTERISTIC
/begin CHARACTERISTIC RadSht_nFanRqMaxLo_C "" VALUE 0x80059CE4 Val_Ws16 3000.000 FanSpd 0.00 3000.000 FORMAT "%8.3" EXTENDED_LIMITS -3000.092 3000.000 /end CHARACTERISTIC
/begin CHARACTERISTIC RadSht_nFanSetPointHi_C "" VALUE 0x80059CE6 Val_Ws16 3000.000 FanSpd 0.00 3000.000 FORMAT "%8.3" EXTENDED_LIMITS -3000.092 3000.000 /end CHARACTERISTIC
/begin CHARACTERISTIC RadSht_nFanSetPointLo_C "" VALUE 0x80059CE8 Val_Ws16 3000.000 FanSpd 0.00 3000.000 FORMAT "%8.3" EXTENDED_LIMITS -3000.092 3000.000 /end CHARACTERISTIC
/begin CHARACTERISTIC RadSht_nFanXHi_C "" VALUE 0x80059CEA Val_Ws16 3000.000 FanSpd 0.00 3000.000 FORMAT "%8.3" EXTENDED_LIMITS -3000.092 3000.000 /end CHARACTERISTIC
/begin CHARACTERISTIC RadSht_nFanXLo_C "" VALUE 0x80059CEC Val_Ws16 3000.000 FanSpd 0.00 3000.000 FORMAT "%8.3" EXTENDED_LIMITS -3000.092 3000.000 /end CHARACTERISTIC
/begin CHARACTERISTIC RadSht_rLogicOutHigh_C "" VALUE 0x80059CEE Val_Ws16 100.0000 Prc 0.00 100.0000 EXTENDED_LIMITS -400.0000 399.9878 /end CHARACTERISTIC
/begin CHARACTERISTIC RadSht_rLogicOutLow_C "" VALUE 0x80059CF0 Val_Ws16 100.0000 Prc 0.00 100.0000 EXTENDED_LIMITS -400.0000 399.9878 /end CHARACTERISTIC
/begin CHARACTERISTIC RadSht_stConsumActv_C "" VALUE 0x80059CF2 Val_Wu8 1.000 OneToOne 0.00 1.000 EXTENDED_LIMITS 0.00 255.0 /end CHARACTERISTIC
/begin CHARACTERISTIC RadSht_stInvOut_C "" VALUE 0x80059CF3 Val_Wu8 255.0 OneToOne 0.00 255.0 /end CHARACTERISTIC
/begin CHARACTERISTIC RadSht_stLogic_C "" VALUE 0x80059CF4 Val_Wu8 7.000 OneToOne 0.00 7.000 EXTENDED_LIMITS 0.00 255.0 /end CHARACTERISTIC
/begin CHARACTERISTIC RadSht_stTrailerErr_C "" VALUE 0x80059CF5 Val_Wu8 255.0 OneToOne 0.00 255.0 /end CHARACTERISTIC
/begin CHARACTERISTIC RadSht_tEngXHi_C "" VALUE 0x80059CF6 Val_Ws16 250.0000 Temp_Cels -50.14000 199.8600 EXTENDED_LIMITS -3549.940 3003.560 /end CHARACTERISTIC
/begin CHARACTERISTIC RadSht_tEngXLo_C "" VALUE 0x80059CF8 Val_Ws16 250.0000 Temp_Cels -50.14000 199.8600 EXTENDED_LIMITS -3549.940 3003.560 /end CHARACTERISTIC
/begin CHARACTERISTIC RadSht_tEnvHi_C "" VALUE 0x80059CFA Val_Ws16 250.0000 Temp_Cels -50.14000 199.8600 EXTENDED_LIMITS -3549.940 3003.560 /end CHARACTERISTIC
/begin CHARACTERISTIC RadSht_tEnvLo_C "" VALUE 0x80059CFC Val_Ws16 250.0000 Temp_Cels -50.14000 199.8600 EXTENDED_LIMITS -3549.940 3003.560 /end CHARACTERISTIC
/begin CHARACTERISTIC RadSht_tiDebOff_C "" VALUE 0x80059CFE Val_Ws16 655350.0 Time_ms -327680.0 327670.0 /end CHARACTERISTIC
/begin CHARACTERISTIC RadSht_tiDebOn_C "" VALUE 0x80059D00 Val_Ws16 655350.0 Time_ms -327680.0 327670.0 /end CHARACTERISTIC
/begin CHARACTERISTIC RadSht_tTraOilXHi_C "" VALUE 0x80059D02 Val_Ws16 250.0000 Temp_Cels -50.14000 199.8600 EXTENDED_LIMITS -3549.940 3003.560 /end CHARACTERISTIC
/begin CHARACTERISTIC RadSht_tTraOilXLo_C "" VALUE 0x80059D04 Val_Ws16 250.0000 Temp_Cels -50.14000 199.8600 EXTENDED_LIMITS -3549.940 3003.560 /end CHARACTERISTIC
/begin CHARACTERISTIC RadSht_vVehHi_C "" VALUE 0x80059D06 Val_Ws16 300.0000 Vel 0.00 300.0000 EXTENDED_LIMITS -327.6800 327.6700 /end CHARACTERISTIC
/begin CHARACTERISTIC RadSht_vVehLo_C "" VALUE 0x80059D08 Val_Ws16 300.0000 Vel 0.00 300.0000 EXTENDED_LIMITS -327.6800 327.6700 /end CHARACTERISTIC
/begin CHARACTERISTIC RadSht_vXHi_C "" VALUE 0x80059D0A Val_Ws16 200.0000 Vel 0.00 200.0000 EXTENDED_LIMITS -327.6800 327.6700 /end CHARACTERISTIC
/begin CHARACTERISTIC RadSht_vXLo_C "" VALUE 0x80059D0C Val_Ws16 200.0000 Vel 0.00 200.0000 EXTENDED_LIMITS -327.6800 327.6700 /end CHARACTERISTIC
/begin CHARACTERISTIC RailP_AdcMaxVal_C "Schwelle zum Umschalten auf maximalen Raildruck Ersatzwert" VALUE 0x80059D0E Val_Ws16 5200.000 Volt 0.00 5200.000 EXTENDED_LIMITS -6553.600 6553.400 /end CHARACTERISTIC
/begin CHARACTERISTIC RailP_dpMaxHyd_C "Größter erlaubter Druckgradient der keinen Fehler auslöst." VALUE 0x80059D60 Val_Ws16 2000.000 Pres_Rail 0.00 2000.000 EXTENDED_LIMITS -3276.800 3276.700 /end CHARACTERISTIC
/begin CHARACTERISTIC RailP_numGradExcdMax_C "Anzahl detektierter Drucksprünge die einen Diagnoseeintrag auslöst." VALUE 0x80059D62 Val_Wu16 1000.000 OneToOne 0.00 1000.000 EXTENDED_LIMITS 0.00 65535.00 /end CHARACTERISTIC
/begin CHARACTERISTIC RailP_pFltWinNeg_CUR "Raildruckabfall, ab welchem auf Großsignalparameter umgeschaltet wird" CURVE 0x80059D28 Cur_Xs16Ws16 5276.800 Pres_Rail -3276.800 2000.000 EXTENDED_LIMITS -3276.800 3276.700
 /begin AXIS_DESCR STD_AXIS InjCtl_qSetUnBal InjMass 10 -327.6800 327.6700 DEPOSIT ABSOLUTE /end AXIS_DESCR
/end CHARACTERISTIC
/begin CHARACTERISTIC RailP_pLin_CUR "Linearisierungskennlinie für Kraftstoffdrucksensor" CURVE 0x80059D10 Cur_Xs16Ws16 2000.000 Pres_Rail 0.00 2000.000 EXTENDED_LIMITS -3276.800 3276.700
 /begin AXIS_DESCR STD_AXIS RailP_uRaw Volt 4 0.00 5200.000 EXTENDED_LIMITS -6553.600 6553.400 DEPOSIT ABSOLUTE /end AXIS_DESCR
/end CHARACTERISTIC
/begin CHARACTERISTIC RailP_SRC.uMin_C "Klasse für Vorgabewerte Analogeingang Signal Range Check/" VALUE 0x80059D22 Kw_Ws16 5200.000 Volt 0.00 5200.000 EXTENDED_LIMITS -6553.600 6553.400 /end CHARACTERISTIC
/begin CHARACTERISTIC RailP_SRC.uMax_C "Klasse für Vorgabewerte Analogeingang Signal Range Check/" VALUE 0x80059D24 Kw_Ws16 5200.000 Volt 0.00 5200.000 EXTENDED_LIMITS -6553.600 6553.400 /end CHARACTERISTIC
/begin CHARACTERISTIC RailP_swtFlt_C "Funktionsweise der Raildruck-Spitzenwertermittlung im 10ms Raster" VALUE 0x80059D52 Val_Wu8 1.000 OneToOne 0.00 1.000 EXTENDED_LIMITS 0.00 255.0 /end CHARACTERISTIC
/begin CHARACTERISTIC RailP_swtOfsTst_C "Schalter für Freigabe des Offset-Tests für den Raildrucksensor im Start oder Nachlauf (0: Start, 1: Nachlauf, 2: Motorabstelltimer verwenden)" VALUE 0x80059D68 Val_Wu8 3.000 OneToOne 0.00 3.000 EXTENDED_LIMITS 0.00 255.0 /end CHARACTERISTIC
/begin CHARACTERISTIC RailP_swtSSpMon_C "Schalter zur Auswahl der Versorgungsspannungsleitung des RDS" VALUE 0x80059D69 Val_Wu8 2.000 OneToOne 1.000 3.000 EXTENDED_LIMITS 0.00 255.0 /end CHARACTERISTIC
/begin CHARACTERISTIC RailP_tidPresRst_C "Zeit bei der eine Heilung des Drucksprungzählers erfolgt." VALUE 0x80059D64 Val_Ws32 3600000.00000 Time_ms 0.00 3600000.00000 EXTENDED_LIMITS -21474836480.0 21474836470.0 /end CHARACTERISTIC
/begin CHARACTERISTIC RailP_tiERS_C "" VALUE 0x80059D6C Val_Ws32 4294.96729500 Time_Dt -2147.48364800 2147.48364700 FORMAT "%13.8" /end CHARACTERISTIC
/begin CHARACTERISTIC RailP_tiEvalDel_C "Verzögerungszeit zur Auswertung des Überwachungsergebnisses beim Offset-Tests für den Raildrucksensor" VALUE 0x80059D70 Val_Ws16 327670.0 Time_ms 0.00 327670.0 EXTENDED_LIMITS -327680.0 327670.0 /end CHARACTERISTIC
/begin CHARACTERISTIC RailP_tiFlt1PT1_C "PT1 Filterparameter für steigenden Raildruck" VALUE 0x80059D54 Val_Ws32 4294.9672940 TimeDelay_s 0.000002000000001 4294.9672960 FORMAT "%12.7" /end CHARACTERISTIC
/begin CHARACTERISTIC RailP_tiFlt2PT1_C "PT1 Filterparameter für fallenden Raildruck (Kleinsignalverhalten)" VALUE 0x80059D58 Val_Ws32 4294.9672940 TimeDelay_s 0.000002000000001 4294.9672960 FORMAT "%12.7" /end CHARACTERISTIC
/begin CHARACTERISTIC RailP_tiFlt3PT1_C "PT1 Filterparameter für stark fallenden Raildruck (Großsignalverhalten)" VALUE 0x80059D5C Val_Ws32 4294.9672940 TimeDelay_s 0.000002000000001 4294.9672960 FORMAT "%12.7" /end CHARACTERISTIC
/begin CHARACTERISTIC RailP_tiOfsTstAftRun_C "Überwachungszeitraum des Offset-Tests für den Raildrucksensor im Nachlauf" VALUE 0x80059D72 Val_Ws16 327670.0 Time_ms 0.00 327670.0 EXTENDED_LIMITS -327680.0 327670.0 /end CHARACTERISTIC
/begin CHARACTERISTIC RailP_tiOfsTstDel_CUR "Verzögerungszeit für Offset-Überwachung des Raildrucksensors" CURVE 0x80059D74 Cur_Xs16Ws16 5242.720 TimeRed 0.00 5242.720 FORMAT "%8.3" EXTENDED_LIMITS -5242.880 5242.720
 /begin AXIS_DESCR STD_AXIS RailP_pFlt Pres_Rail 6 0.00 2000.000 EXTENDED_LIMITS -3276.800 3276.700 DEPOSIT ABSOLUTE /end AXIS_DESCR
/end CHARACTERISTIC
/begin CHARACTERISTIC RailP_tiOfsTstStrt_C "Überwachungszeitraum des Offset-Tests für den Raildrucksensor im Start" VALUE 0x80059D8E Val_Ws16 327670.0 Time_ms 0.00 327670.0 EXTENDED_LIMITS -327680.0 327670.0 /end CHARACTERISTIC
/begin CHARACTERISTIC RailP_tiStrErrDel_C "Timeout zur Speicherung des Überwachungsergebnisses beim Offset-Tests für den Raildrucksensor" VALUE 0x80059D90 Val_Ws16 327670.0 Time_ms 0.00 327670.0 EXTENDED_LIMITS -327680.0 327670.0 /end CHARACTERISTIC
/begin CHARACTERISTIC RailP_tOfsTstAftRun_C "Systemtemperaturschwelle zur Freigabe der Offset-Überwachung des Raildrucksensors im Nachlauf" VALUE 0x80059D92 Val_Ws16 200.0000 Temp_Cels -50.14000 149.8600 EXTENDED_LIMITS -3549.940 3003.560 /end CHARACTERISTIC
/begin CHARACTERISTIC RailP_tOfsTstDec_C "Wassertemperaturdifferenz 'Abkühlung' zur Freigabe der Offset-Überwachung des Raildrucksensors im Start" VALUE 0x80059D94 Val_Ws16 100.0000 TempDiff_Kelv 0.00 100.0000 EXTENDED_LIMITS -3276.800 3276.700 /end CHARACTERISTIC
/begin CHARACTERISTIC RailP_tOfsTstInc_C "Wassertemperaturdifferenz 'Erwärmung' zur Freigabe der Offset-Überwachung des Raildrucksensors im Start" VALUE 0x80059D96 Val_Ws16 100.0000 TempDiff_Kelv -100.0000 0.00 EXTENDED_LIMITS -3276.800 3276.700 /end CHARACTERISTIC
/begin CHARACTERISTIC RailP_tOfsTstStrt_C "Systemtemperaturschwelle zur Freigabe der Offset-Überwachung des Raildrucksensors im Start" VALUE 0x80059D98 Val_Ws16 200.0000 Temp_Cels -50.14000 149.8600 EXTENDED_LIMITS -3549.940 3003.560 /end CHARACTERISTIC
/begin CHARACTERISTIC RailP_uOfsAftRunMax_C "obere Offsetschwelle der Offset-Überwachung des Raildrucksensors im Nachlauf" VALUE 0x80059D9A Val_Ws16 5200.000 Volt 0.00 5200.000 EXTENDED_LIMITS -6553.600 6553.400 /end CHARACTERISTIC
/begin CHARACTERISTIC RailP_uOfsAftRunMin_C "untere Offsetschwelle der Offset-Überwachung des Raildrucksensors im Nachlauf" VALUE 0x80059D9C Val_Ws16 5200.000 Volt 0.00 5200.000 EXTENDED_LIMITS -6553.600 6553.400 /end CHARACTERISTIC
/begin CHARACTERISTIC RailP_uOfsStrtMax_C "obere Offsetschwelle der Offset-Überwachung des Raildrucksensors im Start" VALUE 0x80059D9E Val_Ws16 5200.000 Volt 0.00 5200.000 EXTENDED_LIMITS -6553.600 6553.400 /end CHARACTERISTIC
/begin CHARACTERISTIC RailP_uOfsStrtMin_C "untere Offsetschwelle der Offset-Überwachung des Raildrucksensors im Start" VALUE 0x80059DA0 Val_Ws16 5200.000 Volt 0.00 5200.000 EXTENDED_LIMITS -6553.600 6553.400 /end CHARACTERISTIC
/begin CHARACTERISTIC RailP_uRawMaxRes "Verriegelung zum Abspeichern eines neue Maximumwertes für den Rohwert des Raildrucks" VALUE 0x8006993C Val_Ws8 51.00 Volt -25.60 25.40 READ_ONLY /end CHARACTERISTIC
/begin CHARACTERISTIC Rail_dpPCVSetShOffDec_C "Abbaugradient des PCV Stellwertes beim Abstellen des Systemes" VALUE 0x80059DAC Val_Ws16 13000.000 PresRail_sec 0.00 13000.000 FORMAT "%5.3" EXTENDED_LIMITS -13107.200 13106.800 /end CHARACTERISTIC
/begin CHARACTERISTIC Rail_dvolDvtLim_C "Volumenstromabweichung für die Umschaltung aus dem Zustand Rail_stCPC == CPC_MEUN_CLOSE" VALUE 0x80059DAE Val_Ws16 655350.0 Qp_mm3_sec -327680.0 327670.0 FORMAT "%8.1" /end CHARACTERISTIC
/begin CHARACTERISTIC Rail_dvolMeUnClose_CUR "Regelabweichung zum Schließen der ZME" CURVE 0x80059DB0 Cur_Xs16Ws16 60000.00 Qp_mm3_sec -50000.00 10000.00 FORMAT "%8.2" EXTENDED_LIMITS -327680.0 327670.0
 /begin AXIS_DESCR STD_AXIS Epm_nEng EngN 12 0.00 10000.00 EXTENDED_LIMITS -16384.00 16383.50 DEPOSIT ABSOLUTE /end AXIS_DESCR
/end CHARACTERISTIC
/begin CHARACTERISTIC Rail_dvolMeUnCtlInitI_CUR "Kennlinie zur Initialisierung des I-Anteils als Funktion der Systemtemperatur" CURVE 0x80059DE2 Cur_Xs16Ws16 150000.0 Qp_mm3_sec 0.00 150000.0 FORMAT "%8.1" EXTENDED_LIMITS -327680.0 327670.0
 /begin AXIS_DESCR STD_AXIS FuelT_tFlSys Temp_Cels 2 -50.14000 149.8600 EXTENDED_LIMITS -3549.940 3003.560 DEPOSIT ABSOLUTE /end AXIS_DESCR
/end CHARACTERISTIC
/begin CHARACTERISTIC Rail_dvolMeUnCtlLoLim_C "untere Stellwertbegrenzung" VALUE 0x8005A06C Val_Ws16 655350.0 Qp_mm3_sec -327680.0 327670.0 FORMAT "%8.1" /end CHARACTERISTIC
/begin CHARACTERISTIC Rail_dvolMeUnCtlType_CUR "Kurve zur Schuberkennung zum Schnellen Umschalten in CPC Betrieb" CURVE 0x8005A41C Cur_Xs16Ws16 60000.00 Qp_mm3_sec -50000.00 10000.00 FORMAT "%8.2" EXTENDED_LIMITS -327680.0 327670.0
 /begin AXIS_DESCR STD_AXIS Epm_nEng EngN 6 0.00 10000.00 EXTENDED_LIMITS -16384.00 16383.50 DEPOSIT ABSOLUTE /end AXIS_DESCR
/end CHARACTERISTIC
/begin CHARACTERISTIC Rail_dvolMeUnCtlUpLim_C "obere Stellwertbegrenzung im Fehlerfall" VALUE 0x8005A06E Val_Ws16 100000.0 Qp_mm3_sec 0.00 100000.0 FORMAT "%8.1" EXTENDED_LIMITS -327680.0 327670.0 /end CHARACTERISTIC
/begin CHARACTERISTIC Rail_dvolMeUnCtlUpLim_CUR "obere Stellwertbegrenzung" CURVE 0x8005A070 Cur_Xs16Ws16 655350.0 Qp_mm3_sec -327680.0 327670.0 FORMAT "%8.1"
 /begin AXIS_DESCR STD_AXIS Epm_nEng EngN 11 0.00 10000.00 EXTENDED_LIMITS -16384.00 16383.50 DEPOSIT ABSOLUTE /end AXIS_DESCR
/end CHARACTERISTIC
/begin CHARACTERISTIC Rail_dvolMeUnLimFst_CUR "Maximal zulässiger Stellwert MeUn für Raildrucküberwachung als Funktion des Stellwertes der Zumesseinheit" CURVE 0x8005A578 Cur_Xs16Ws16 150000.0 Qp_mm3_sec 0.00 150000.0 FORMAT "%8.1" EXTENDED_LIMITS -327680.0 327670.0
 /begin AXIS_DESCR STD_AXIS Epm_nEng EngN 16 0.00 10000.00 EXTENDED_LIMITS -16384.00 16383.50 DEPOSIT ABSOLUTE /end AXIS_DESCR
/end CHARACTERISTIC
/begin CHARACTERISTIC Rail_dvolMeUnOpn_CUR "Regelabweichung zum Öffnen der ZME" CURVE 0x80059DEC Cur_Xs16Ws16 60000.00 Qp_mm3_sec -10000.00 50000.00 FORMAT "%8.2" EXTENDED_LIMITS -327680.0 327670.0
 /begin AXIS_DESCR STD_AXIS Epm_nEng EngN 12 0.00 10000.00 EXTENDED_LIMITS -16384.00 16383.50 DEPOSIT ABSOLUTE /end AXIS_DESCR
/end CHARACTERISTIC
/begin CHARACTERISTIC Rail_dvolMeUnShutOffErr_C "MeUn Stellwert für Nullförderung" VALUE 0x80059E1E Val_Ws16 60000.00 Qp_mm3_sec -10000.00 50000.00 FORMAT "%8.2" EXTENDED_LIMITS -327680.0 327670.0 /end CHARACTERISTIC
/begin CHARACTERISTIC Rail_dvolMeUnShutOff_C "MeUn Stellwert beim Abstellen" VALUE 0x80059E20 Val_Ws16 60000.00 Qp_mm3_sec -10000.00 50000.00 FORMAT "%8.2" EXTENDED_LIMITS -327680.0 327670.0 /end CHARACTERISTIC
/begin CHARACTERISTIC Rail_dvolOff_C "Volumenstrom beim Abstellen des Systems (Nullförderung)" VALUE 0x80059E22 Val_Ws16 655350.0 Qp_mm3_sec -327680.0 327670.0 FORMAT "%8.1" /end CHARACTERISTIC
/begin CHARACTERISTIC Rail_dvolPCVClose_CUR "Regelabweichung zum Schließen der DRV" CURVE 0x80059E24 Cur_Xs16Ws16 50000.00 Qp_mm3_sec -50000.00 0.00 FORMAT "%8.2" EXTENDED_LIMITS -327680.0 327670.0
 /begin AXIS_DESCR STD_AXIS Epm_nEng EngN 12 0.00 10000.00 EXTENDED_LIMITS -16384.00 16383.50 DEPOSIT ABSOLUTE /end AXIS_DESCR
/end CHARACTERISTIC
/begin CHARACTERISTIC Rail_dvolPCVOpn_CUR "Regelabweichung zum Öffnen des DRV" CURVE 0x80059E56 Cur_Xs16Ws16 50000.00 Qp_mm3_sec 0.00 50000.00 FORMAT "%8.2" EXTENDED_LIMITS -327680.0 327670.0
 /begin AXIS_DESCR STD_AXIS Epm_nEng EngN 12 0.00 10000.00 EXTENDED_LIMITS -16384.00 16383.50 DEPOSIT ABSOLUTE /end AXIS_DESCR
/end CHARACTERISTIC
/begin CHARACTERISTIC Rail_dvolStrt_C "Volumenstrom während der Startphase (2-Stellerkonzept)" VALUE 0x80059E88 Val_Ws16 655350.0 Qp_mm3_sec -327680.0 327670.0 FORMAT "%8.1" /end CHARACTERISTIC
/begin CHARACTERISTIC Rail_facMeUnDvt_CUR "Gewichtungsfaktor für die Regelabweichung der ZME" CURVE 0x80059E8A Cur_Xs16Ws16 100.0000 Fact100 0.00 100.0000 FORMAT "%8.4" EXTENDED_LIMITS -327.6800 327.6700
 /begin AXIS_DESCR STD_AXIS Epm_nEng EngN 12 0.00 10000.00 EXTENDED_LIMITS -16384.00 16383.50 DEPOSIT ABSOLUTE /end AXIS_DESCR
/end CHARACTERISTIC
/begin CHARACTERISTIC Rail_facMeUnSetPoint_CUR "Faktor für die Mindestfördermenge der Hochdruckpumpe" CURVE 0x80059EBC Cur_Xs16Ws16 1.000000 Fact 0.00 1.000000 EXTENDED_LIMITS -4.000000 3.999878
 /begin AXIS_DESCR STD_AXIS Epm_nEng EngN 12 0.00 10000.00 EXTENDED_LIMITS -16384.00 16383.50 DEPOSIT ABSOLUTE /end AXIS_DESCR
/end CHARACTERISTIC
/begin CHARACTERISTIC Rail_facOvrMeUnNegIncr_C "Multiplikativer Faktor zur Erhöhung der I-Verstärkung für negative Großsignale bei Überdruck (Druckregelung über MeUn)" VALUE 0x8005A0A6 Val_Ws16 255.9922 Fact1 0.00 255.9922 EXTENDED_LIMITS -256.0000 255.9922 /end CHARACTERISTIC
/begin CHARACTERISTIC Rail_facOvrPCVNegIncr_C "Multiplikativer Faktor zur Erhöhung der I-Verstärkung für negative Großsignale bei Überdruck (Druckregelung über PCV)" VALUE 0x8005A2AA Val_Ws16 255.9922 Fact1 0.00 255.9922 EXTENDED_LIMITS -256.0000 255.9922 /end CHARACTERISTIC
/begin CHARACTERISTIC Rail_facPCVDvt_CUR "Gewichtungsfaktor für die Regelabweichung des DRV" CURVE 0x80059EEE Cur_Xs16Ws16 100.0000 Fact100 -100.0000 0.00 FORMAT "%8.4" EXTENDED_LIMITS -327.6800 327.6700
 /begin AXIS_DESCR STD_AXIS Epm_nEng EngN 12 0.00 10000.00 EXTENDED_LIMITS -16384.00 16383.50 DEPOSIT ABSOLUTE /end AXIS_DESCR
/end CHARACTERISTIC
/begin CHARACTERISTIC Rail_facPCVFast_C "Faktor zum Beschleunigen des Stellverhaltens des DRV über die Regelabweichung" VALUE 0x80059F20 Val_Ws16 655.3500 Fact100 -327.6800 327.6700 FORMAT "%8.4" /end CHARACTERISTIC
/begin CHARACTERISTIC Rail_iMeUnClsHpTst_C "Datensatzwert zur Stromvorgabe zum Schliessen der Zumesseinheit während des HpTst" VALUE 0x8005A4B8 Val_Wu16 2500.000 Curr 0.00 2500.000 FORMAT "%8.3" EXTENDED_LIMITS 0.00 65535.00 /end CHARACTERISTIC
/begin CHARACTERISTIC Rail_MeUnCtlDKd_CUR "D-Verstärkung der Druckregelung über Zumesseinheit" CURVE 0x8005A0A8 Cur_Xs16Ws16 500.0000 Kd_pRail2Q_1 0.00 500.0000 FORMAT "%12.4" EXTENDED_LIMITS -800.0000 799.9756
 /begin AXIS_DESCR STD_AXIS Epm_nEng EngN 3 0.00 10000.00 EXTENDED_LIMITS -16384.00 16383.50 DEPOSIT ABSOLUTE /end AXIS_DESCR
/end CHARACTERISTIC
/begin CHARACTERISTIC Rail_MeUnCtlIKiHpTst_CUR "I-Verstärkung für Druckregelung mit Zumesseinheit während HpTst" CURVE 0x8005A0B6 Cur_Xs16Ws16 2000.015 Ki_pRail2Q_1 0.00 2000.015 FORMAT "%11.3" EXTENDED_LIMITS -3051.758 3051.665
 /begin AXIS_DESCR STD_AXIS Epm_nEng EngN 13 0.00 10000.00 EXTENDED_LIMITS -16384.00 16383.50 DEPOSIT ABSOLUTE /end AXIS_DESCR
/end CHARACTERISTIC
/begin CHARACTERISTIC Rail_MeUnCtlIKiNeg_CUR "I-Verstärkung für negative Großsignale für die Druckregelung über Zumesseinheit" CURVE 0x8005A0EC Cur_Xs16Ws16 2000.015 Ki_pRail2Q_1 0.00 2000.015 FORMAT "%11.3" EXTENDED_LIMITS -3051.758 3051.665
 /begin AXIS_DESCR STD_AXIS Epm_nEng EngN 13 0.00 10000.00 EXTENDED_LIMITS -16384.00 16383.50 DEPOSIT ABSOLUTE /end AXIS_DESCR
/end CHARACTERISTIC
/begin CHARACTERISTIC Rail_MeUnCtlIKiPos_CUR "I-Verstärkung für positive Großsignale für die Druckregelung über Zumesseinheit" CURVE 0x8005A122 Cur_Xs16Ws16 2000.015 Ki_pRail2Q_1 0.00 2000.015 FORMAT "%11.3" EXTENDED_LIMITS -3051.758 3051.665
 /begin AXIS_DESCR STD_AXIS Epm_nEng EngN 13 0.00 10000.00 EXTENDED_LIMITS -16384.00 16383.50 DEPOSIT ABSOLUTE /end AXIS_DESCR
/end CHARACTERISTIC
/begin CHARACTERISTIC Rail_MeUnCtlIKi_CUR "I-Verstärkung für Kleinsignale für die Druckregelung über Zumesseinheit" CURVE 0x8005A158 Cur_Xs16Ws16 2000.015 Ki_pRail2Q_1 0.00 2000.015 FORMAT "%11.3" EXTENDED_LIMITS -3051.758 3051.665
 /begin AXIS_DESCR STD_AXIS Epm_nEng EngN 13 0.00 10000.00 EXTENDED_LIMITS -16384.00 16383.50 DEPOSIT ABSOLUTE /end AXIS_DESCR
/end CHARACTERISTIC
/begin CHARACTERISTIC Rail_MeUnCtlPKpHpTst_CUR "P-Verstärkung für Druckregelung über Zumesseinheit während HpTst" CURVE 0x8005A18E Cur_Xs16Ws16 200.0000 Kp_pRail2Q_1 0.00 200.0000 FORMAT "%12.4" EXTENDED_LIMITS -400.0000 399.9878
 /begin AXIS_DESCR STD_AXIS Epm_nEng EngN 13 0.00 10000.00 EXTENDED_LIMITS -16384.00 16383.50 DEPOSIT ABSOLUTE /end AXIS_DESCR
/end CHARACTERISTIC
/begin CHARACTERISTIC Rail_MeUnCtlPKpNeg_CUR "P-Verstärkung für negative Großsignale für die Druckregelung über Zumesseinheit" CURVE 0x8005A1C4 Cur_Xs16Ws16 200.0000 Kp_pRail2Q_1 0.00 200.0000 FORMAT "%12.4" EXTENDED_LIMITS -400.0000 399.9878
 /begin AXIS_DESCR STD_AXIS Epm_nEng EngN 13 0.00 10000.00 EXTENDED_LIMITS -16384.00 16383.50 DEPOSIT ABSOLUTE /end AXIS_DESCR
/end CHARACTERISTIC
/begin CHARACTERISTIC Rail_MeUnCtlPKpPos_CUR "P-Verstärkung für positive Großsignale für die Druckregelung über Zumesseinheit" CURVE 0x8005A1FA Cur_Xs16Ws16 200.0000 Kp_pRail2Q_1 0.00 200.0000 FORMAT "%12.4" EXTENDED_LIMITS -400.0000 399.9878
 /begin AXIS_DESCR STD_AXIS Epm_nEng EngN 13 0.00 10000.00 EXTENDED_LIMITS -16384.00 16383.50 DEPOSIT ABSOLUTE /end AXIS_DESCR
/end CHARACTERISTIC
/begin CHARACTERISTIC Rail_MeUnCtlPKp_CUR "P-Verstärkung für Kleinsignale für die Druckregelung über Zumesseinheit" CURVE 0x8005A230 Cur_Xs16Ws16 200.0000 Kp_pRail2Q_1 0.00 200.0000 FORMAT "%12.4" EXTENDED_LIMITS -400.0000 399.9878
 /begin AXIS_DESCR STD_AXIS Epm_nEng EngN 13 0.00 10000.00 EXTENDED_LIMITS -16384.00 16383.50 DEPOSIT ABSOLUTE /end AXIS_DESCR
/end CHARACTERISTIC
/begin CHARACTERISTIC Rail_MeUnMon.dvolSetMin_C "Klasse für Schwellwerte der Überwachung PCV/minimal zulässiger Volumenstrom durch Zumesseinheit für Raildrucküberwachung" VALUE 0x8005A5BA Val_Ws16 50000.00 Qp_mm3_sec 0.00 50000.00 FORMAT "%8.2" EXTENDED_LIMITS -327680.0 327670.0 /end CHARACTERISTIC
/begin CHARACTERISTIC Rail_MeUnMon.pFltMax_C "Klasse für Schwellwerte der Überwachung PCV/Maximal zulässiger Raildruck" VALUE 0x8005A5BC Val_Ws16 2000.000 Pres_Rail 0.00 2000.000 EXTENDED_LIMITS -3276.800 3276.700 /end CHARACTERISTIC
/begin CHARACTERISTIC Rail_MeUnMon.pFltMax2_C "Klasse für Schwellwerte der Überwachung PCV/maximum admissbile rail pressu für die 2. Überwachubngsstufe" VALUE 0x8005A5BE Val_Ws16 2000.000 Pres_Rail 0.00 2000.000 EXTENDED_LIMITS -3276.800 3276.700 /end CHARACTERISTIC
/begin CHARACTERISTIC Rail_MeUnMon.pDvtMax_C "Klasse für Schwellwerte der Überwachung PCV/Maximal zulässige Regelabweichung für Raildrucküberwachung" VALUE 0x8005A5C0 Val_Ws16 2000.000 Pres_Rail 0.00 2000.000 EXTENDED_LIMITS -3276.800 3276.700 /end CHARACTERISTIC
/begin CHARACTERISTIC Rail_MeUnMon.qLoIdl_C "Klasse für Schwellwerte der Überwachung PCV/Mengenschwelle zur Erkennung der Schubbedingung bei der Raildrucküberwachung" VALUE 0x8005A5C2 Val_Ws16 327.6700 InjMass 0.00 327.6700 EXTENDED_LIMITS -327.6800 327.6700 /end CHARACTERISTIC
/begin CHARACTERISTIC Rail_MeUnMon.tLoIdl_C "Klasse für Schwellwerte der Überwachung PCV/Systemtemperaturschwelle für die Raildrucküberwachung" VALUE 0x8005A5C4 Val_Ws16 200.0000 Temp_Cels -50.14000 149.8600 EXTENDED_LIMITS -3549.940 3003.560 /end CHARACTERISTIC
/begin CHARACTERISTIC Rail_MeUnMon.stRls_C "Klasse für Schwellwerte der Überwachung PCV/Generelle Freigabemaske für Überwachungen der Druckregelung über Zumesseinheit" VALUE 0x8005A5C6 Val_Wu16 65535.00 OneToOne 0.00 65535.00 /end CHARACTERISTIC
/begin CHARACTERISTIC Rail_nCloseCtl_C "Drehzahlschwelle für Wechsel zwischen gesteuertem und geregeltem Betrieb" VALUE 0x80059F22 Val_Ws16 32767.50 EngN -16384.00 16383.50 /end CHARACTERISTIC
/begin CHARACTERISTIC Rail_nDiffMaxHpTst_C "Maximale Drehzahlabweichung während HpTst" VALUE 0x8005A4BA Val_Ws16 6000.000 EngN 0.00 6000.000 EXTENDED_LIMITS -16384.00 16383.50 /end CHARACTERISTIC
/begin CHARACTERISTIC Rail_nHpTst_CA "Datensatzwerte für Array von Drehzahlstufen für HpTst" VAL_BLK 0x8005A4BC ValA_Ws16 32767.00 EngN 0.00 32767.00 EXTENDED_LIMITS -16384.00 16383.50 NUMBER 4 /end CHARACTERISTIC
/begin CHARACTERISTIC Rail_nMeUnFrzI_C "Drehzahlschwelle zum Einfrieren des I-Anteils für den Druckregler über Zumesseinheit" VALUE 0x80059F24 Val_Ws16 32767.50 EngN -16384.00 16383.50 /end CHARACTERISTIC
/begin CHARACTERISTIC Rail_nThresStrt_C "Drehzahlschwelle zum Verlassen des Startzustandes der Zustandssteuerung" VALUE 0x80059F26 Val_Ws16 32767.50 EngN -16384.00 16383.50 /end CHARACTERISTIC
/begin CHARACTERISTIC Rail_numRevDel_C "Anzahl von Motorumdrehungen um von Steuern auf Regeln umzuschalten" VALUE 0x80059F28 Val_Wu16 65535.00 OneToOne 0.00 65535.00 /end CHARACTERISTIC
/begin CHARACTERISTIC Rail_numRevPlaus_C "Anzahl der Nockenwellenumdrehungen um von Vorregelung auf Regelung umzuschalten." VALUE 0x80059F2A Val_Wu16 65535.00 OneToOne 0.00 65535.00 /end CHARACTERISTIC
/begin CHARACTERISTIC Rail_pCloseCtl_C "Absolutdruckschwelle zum Umschaltung in den Regelbetrieb" VALUE 0x80059F2C Val_Ws16 5276.800 Pres_Rail -3276.800 2000.000 EXTENDED_LIMITS -3276.800 3276.700 /end CHARACTERISTIC
/begin CHARACTERISTIC Rail_pCPCFltMax_C "maximal zulässiger Raildruck für CPC monitoring" VALUE 0x8005A534 Val_Ws16 2000.000 Pres_Rail 0.00 2000.000 EXTENDED_LIMITS -3276.800 3276.700 /end CHARACTERISTIC
/begin CHARACTERISTIC Rail_pCPCFltMin_CUR "minimal zulässiger Raildruck als Funktion der Motordrehzahl während CPC-Regelung im Eingriff ist" CURVE 0x8005A536 Cur_Xs16Ws16 2000.000 Pres_Rail 0.00 2000.000 EXTENDED_LIMITS -3276.800 3276.700
 /begin AXIS_DESCR STD_AXIS Epm_nEng EngN 16 0.00 10000.00 EXTENDED_LIMITS -16384.00 16383.50 DEPOSIT ABSOLUTE /end AXIS_DESCR
/end CHARACTERISTIC
/begin CHARACTERISTIC Rail_PCVCtlDKd_CUR "D-Verstärkung der Druckregelung über Druckregelventil" CURVE 0x8005A2AC Cur_Xs16Ws16 50.00000 Kd_1 0.00 50.00000 FORMAT "%8.5" EXTENDED_LIMITS -64.00000 63.99805
 /begin AXIS_DESCR STD_AXIS Epm_nEng EngN 2 0.00 10000.00 EXTENDED_LIMITS -16384.00 16383.50 DEPOSIT ABSOLUTE /end AXIS_DESCR
/end CHARACTERISTIC
/begin CHARACTERISTIC Rail_PCVCtlIKiNeg_CUR "I-Verstärkung für negative Großsignale für die Druckregelung über Druckregelventil" CURVE 0x8005A2B6 Cur_Xs16Ws16 249.9968 Ki_1 0.00 249.9968 FORMAT "%8.4" EXTENDED_LIMITS -488.2813 488.2663
 /begin AXIS_DESCR STD_AXIS Epm_nEng EngN 13 0.00 10000.00 EXTENDED_LIMITS -16384.00 16383.50 DEPOSIT ABSOLUTE /end AXIS_DESCR
/end CHARACTERISTIC
/begin CHARACTERISTIC Rail_PCVCtlIKiPos_CUR "I-Verstärkung für positive Großsignale für die Druckregelung über Druckregelventil" CURVE 0x8005A2EC Cur_Xs16Ws16 249.9968 Ki_1 0.00 249.9968 FORMAT "%8.4" EXTENDED_LIMITS -488.2813 488.2663
 /begin AXIS_DESCR STD_AXIS Epm_nEng EngN 13 0.00 10000.00 EXTENDED_LIMITS -16384.00 16383.50 DEPOSIT ABSOLUTE /end AXIS_DESCR
/end CHARACTERISTIC
/begin CHARACTERISTIC Rail_PCVCtlIKi_CUR "I-Verstärkung für Kleinsignale für die Druckregelung über Druckregelventil" CURVE 0x8005A322 Cur_Xs16Ws16 249.9968 Ki_1 0.00 249.9968 FORMAT "%8.4" EXTENDED_LIMITS -488.2813 488.2663
 /begin AXIS_DESCR STD_AXIS Epm_nEng EngN 13 0.00 10000.00 EXTENDED_LIMITS -16384.00 16383.50 DEPOSIT ABSOLUTE /end AXIS_DESCR
/end CHARACTERISTIC
/begin CHARACTERISTIC Rail_PCVCtlPKpNeg_CUR "P-Verstärkung für negative Großsignale für die Druckregelung über Druckregelventil" CURVE 0x8005A358 Cur_Xs16Ws16 300.0000 Kp_1 0.00 300.0000 FORMAT "%8.4" EXTENDED_LIMITS -512.0000 511.9844
 /begin AXIS_DESCR STD_AXIS Epm_nEng EngN 13 0.00 10000.00 EXTENDED_LIMITS -16384.00 16383.50 DEPOSIT ABSOLUTE /end AXIS_DESCR
/end CHARACTERISTIC
/begin CHARACTERISTIC Rail_PCVCtlPKpPos_CUR "P-Verstärkung für positive Großsignale für die Druckregelung über Druckregelventil" CURVE 0x8005A38E Cur_Xs16Ws16 300.0000 Kp_1 0.00 300.0000 FORMAT "%8.4" EXTENDED_LIMITS -512.0000 511.9844
 /begin AXIS_DESCR STD_AXIS Epm_nEng EngN 13 0.00 10000.00 EXTENDED_LIMITS -16384.00 16383.50 DEPOSIT ABSOLUTE /end AXIS_DESCR
/end CHARACTERISTIC
/begin CHARACTERISTIC Rail_PCVCtlPKp_CUR "P-Verstärkung für Kleinsignale für die Druckregelung über Druckregelventil" CURVE 0x8005A3C4 Cur_Xs16Ws16 300.0000 Kp_1 0.00 300.0000 FORMAT "%8.4" EXTENDED_LIMITS -512.0000 511.9844
 /begin AXIS_DESCR STD_AXIS Epm_nEng EngN 13 0.00 10000.00 EXTENDED_LIMITS -16384.00 16383.50 DEPOSIT ABSOLUTE /end AXIS_DESCR
/end CHARACTERISTIC
/begin CHARACTERISTIC Rail_pDiffCloseCtl_C "Differenzdruckschwelle zum Umschalten in den Regelbetrieb" VALUE 0x80059F2E Val_Ws16 5276.800 Pres_Rail -3276.800 2000.000 EXTENDED_LIMITS -3276.800 3276.700 /end CHARACTERISTIC
/begin CHARACTERISTIC Rail_pDiffMaxHpTst_C "Maximale Raildruckabweichung während HpTst" VALUE 0x8005A4C4 Val_Ws16 2000.000 Pres_Rail 0.00 2000.000 EXTENDED_LIMITS -3276.800 3276.700 /end CHARACTERISTIC
/begin CHARACTERISTIC Rail_pDltHiHpTst_C "Delta Druckwert während der Druckaufbauphase des Hochdrucktests" VALUE 0x8005A4C6 Val_Ws16 2000.000 Pres_Rail 0.00 2000.000 EXTENDED_LIMITS -3276.800 3276.700 /end CHARACTERISTIC
/begin CHARACTERISTIC Rail_pDltTmrUpHpTst_C "Datensatzwert für Raildruckschwelle für Messung der Druckaufbauzeit" VALUE 0x8005A4C8 Val_Ws16 2000.000 Pres_Rail 0.00 2000.000 EXTENDED_LIMITS -3276.800 3276.700 /end CHARACTERISTIC
/begin CHARACTERISTIC Rail_pDvtFltMin_C "minimale absolute Regelabweichung als Eingangssignal des DT1-Gliedes" VALUE 0x80059F30 Val_Ws16 5276.800 Pres_Rail -3276.800 2000.000 EXTENDED_LIMITS -3276.800 3276.700 /end CHARACTERISTIC
/begin CHARACTERISTIC Rail_pMeUnCtlIWinNeg_C "untere Kleinsignalgrenze für den I-Anteil des Druckreglers über Zumesseinheit" VALUE 0x8005A266 Val_Ws16 5276.800 Pres_Rail -3276.800 2000.000 EXTENDED_LIMITS -3276.800 3276.700 /end CHARACTERISTIC
/begin CHARACTERISTIC Rail_pMeUnCtlIWinPos_C "obere Kleinsignalgrenze für den I-Anteil des Druckreglers über Zumesseinheit" VALUE 0x8005A268 Val_Ws16 5276.800 Pres_Rail -3276.800 2000.000 EXTENDED_LIMITS -3276.800 3276.700 /end CHARACTERISTIC
/begin CHARACTERISTIC Rail_pMeUnCtlPWinNeg_C "untere Kleinsignalgrenze für den P-Anteil des Druckreglers über Zumesseinheit" VALUE 0x8005A26A Val_Ws16 5276.800 Pres_Rail -3276.800 2000.000 EXTENDED_LIMITS -3276.800 3276.700 /end CHARACTERISTIC
/begin CHARACTERISTIC Rail_pMeUnCtlPWinPos_C "obere Kleinsignalgrenze für den P-Anteil des Druckreglers über Zumesseinheit" VALUE 0x8005A26C Val_Ws16 5276.800 Pres_Rail -3276.800 2000.000 EXTENDED_LIMITS -3276.800 3276.700 /end CHARACTERISTIC
/begin CHARACTERISTIC Rail_pMeUnCtlTypeHi_C "obere Solldruckhystereseschwelle für die Verriegelung der PCV-Regelung" VALUE 0x8005A436 Val_Ws16 2000.000 Pres_Rail 0.00 2000.000 EXTENDED_LIMITS -3276.800 3276.700 /end CHARACTERISTIC
/begin CHARACTERISTIC Rail_pMeUnCtlTypeLo_C "untere Solldruckhystereseschwelle für die Verriegelung der PCV Regelung" VALUE 0x8005A438 Val_Ws16 2000.000 Pres_Rail 0.00 2000.000 EXTENDED_LIMITS -3276.800 3276.700 /end CHARACTERISTIC
/begin CHARACTERISTIC Rail_pMeUnDvtFst_CUR "Maximal zulässige Regelabweichung für Raildrucküberwachung als Funktion der Drehzahl für schnelle Überwachung" CURVE 0x8005A5C8 Cur_Xs16Ws16 3800.000 Pres_Rail -1800.000 2000.000 EXTENDED_LIMITS -3276.800 3276.700
 /begin AXIS_DESCR STD_AXIS Epm_nEng EngN 16 0.00 10000.00 EXTENDED_LIMITS -16384.00 16383.50 DEPOSIT ABSOLUTE /end AXIS_DESCR
/end CHARACTERISTIC
/begin CHARACTERISTIC Rail_pMeUnDvtMax_CUR "Maximal zulässige Regelabweichung für Raildrucküberwachung als Funktion der Drehzahl" CURVE 0x8005A60A Cur_Xs16Ws16 3800.000 Pres_Rail -1800.000 2000.000 EXTENDED_LIMITS -3276.800 3276.700
 /begin AXIS_DESCR STD_AXIS Epm_nEng EngN 4 0.00 10000.00 EXTENDED_LIMITS -16384.00 16383.50 DEPOSIT ABSOLUTE /end AXIS_DESCR
/end CHARACTERISTIC
/begin CHARACTERISTIC Rail_pMeUnDvtMin2_CUR "Minimal zulässige Regelabweichung für Raildrucküberwachung als Funktion der Drehzahl für die zweite Überwachungsstufe" CURVE 0x8005A61C Cur_Xs16Ws16 3800.000 Pres_Rail -1800.000 2000.000 EXTENDED_LIMITS -3276.800 3276.700
 /begin AXIS_DESCR STD_AXIS Epm_nEng EngN 16 0.00 10000.00 EXTENDED_LIMITS -16384.00 16383.50 DEPOSIT ABSOLUTE /end AXIS_DESCR
/end CHARACTERISTIC
/begin CHARACTERISTIC Rail_pMeUnDvtMin_CUR "Minimal zulässige Regelabweichung für Raildrucküberwachung als Funktion der Drehzahl" CURVE 0x8005A65E Cur_Xs16Ws16 3800.000 Pres_Rail -1800.000 2000.000 EXTENDED_LIMITS -3276.800 3276.700
 /begin AXIS_DESCR STD_AXIS Epm_nEng EngN 4 0.00 10000.00 EXTENDED_LIMITS -16384.00 16383.50 DEPOSIT ABSOLUTE /end AXIS_DESCR
/end CHARACTERISTIC
/begin CHARACTERISTIC Rail_pMeUnFltMin_CUR "Minimal zulässiger Raildruck als Funktion der Motordrehzahl" CURVE 0x8005A670 Cur_Xs16Ws16 2000.000 Pres_Rail 0.00 2000.000 EXTENDED_LIMITS -3276.800 3276.700
 /begin AXIS_DESCR STD_AXIS Epm_nEng EngN 16 0.00 10000.00 EXTENDED_LIMITS -16384.00 16383.50 DEPOSIT ABSOLUTE /end AXIS_DESCR
/end CHARACTERISTIC
/begin CHARACTERISTIC Rail_pMeUnPreCtlOff_C "Druckschwelle für die Umschaltung aus dem Zustand Rail_stCPC == CPC_MEUN_CLOSE" VALUE 0x80059F32 Val_Ws16 5276.800 Pres_Rail -3276.800 2000.000 EXTENDED_LIMITS -3276.800 3276.700 /end CHARACTERISTIC
/begin CHARACTERISTIC Rail_pMeUnPreCtlOn_C "Druckschwelle für die Umschaltung aus dem Zustand Rail_stCPC == CPC_MEUN_CLOSE" VALUE 0x80059F34 Val_Ws16 5276.800 Pres_Rail -3276.800 2000.000 EXTENDED_LIMITS -3276.800 3276.700 /end CHARACTERISTIC
/begin CHARACTERISTIC Rail_pOpnCtl_C "Absolutdruckschwelle zum Umschaltung in den Steuerbetrieb" VALUE 0x80059F36 Val_Ws16 5276.800 Pres_Rail -3276.800 2000.000 EXTENDED_LIMITS -3276.800 3276.700 /end CHARACTERISTIC
/begin CHARACTERISTIC Rail_pOvrMeUnThresHigh_C "Obere Hystereseschwelle für Überdruckerkennung MeUn" VALUE 0x8005A26E Val_Ws16 2000.000 Pres_Rail 0.00 2000.000 EXTENDED_LIMITS -3276.800 3276.700 /end CHARACTERISTIC
/begin CHARACTERISTIC Rail_pOvrMeUnThresLow_C "Untere Hystereseschwelle für Überdruckerkennung MeUn" VALUE 0x8005A270 Val_Ws16 2000.000 Pres_Rail 0.00 2000.000 EXTENDED_LIMITS -3276.800 3276.700 /end CHARACTERISTIC
/begin CHARACTERISTIC Rail_pOvrPCVThresHigh_C "Obere Hystereseschwelle für Überdruckerkennung PCV" VALUE 0x8005A3FA Val_Ws16 2000.000 Pres_Rail 0.00 2000.000 EXTENDED_LIMITS -3276.800 3276.700 /end CHARACTERISTIC
/begin CHARACTERISTIC Rail_pOvrPCVThresLow_C "Untere Hystereseschwelle für Überdruckerkennung PCV" VALUE 0x8005A3FC Val_Ws16 2000.000 Pres_Rail 0.00 2000.000 EXTENDED_LIMITS -3276.800 3276.700 /end CHARACTERISTIC
/begin CHARACTERISTIC Rail_pPCVCtlIWinNeg_C "untere Kleinsignalgrenze für den I-Anteil des Druckreglers über Druckregelventil" VALUE 0x8005A3FE Val_Ws16 5276.800 Pres_Rail -3276.800 2000.000 EXTENDED_LIMITS -3276.800 3276.700 /end CHARACTERISTIC
/begin CHARACTERISTIC Rail_pPCVCtlIWinPos_C "obere Kleinsignalgrenze für den I-Anteil des Druckreglers über Druckregelventil" VALUE 0x8005A400 Val_Ws16 5276.800 Pres_Rail -3276.800 2000.000 EXTENDED_LIMITS -3276.800 3276.700 /end CHARACTERISTIC
/begin CHARACTERISTIC Rail_pPCVCtlLoLimStrt_C "untere Stellwertbegrenzung des Raildruckreglers über Druckregelventil während der Startphase" VALUE 0x8005A09E Val_Ws16 5276.800 Pres_Rail -3276.800 2000.000 EXTENDED_LIMITS -3276.800 3276.700 /end CHARACTERISTIC
/begin CHARACTERISTIC Rail_pPCVCtlLoLim_C "untere Stellwertbegrenzung des Raildruckreglers über Druckregelventil" VALUE 0x8005A0A0 Val_Ws16 5276.800 Pres_Rail -3276.800 2000.000 EXTENDED_LIMITS -3276.800 3276.700 /end CHARACTERISTIC
/begin CHARACTERISTIC Rail_pPCVCtlPWinNeg_C "untere Kleinsignalgrenze für den P-Anteil des Druckreglers über Druckregelventil" VALUE 0x8005A402 Val_Ws16 5276.800 Pres_Rail -3276.800 2000.000 EXTENDED_LIMITS -3276.800 3276.700 /end CHARACTERISTIC
/begin CHARACTERISTIC Rail_pPCVCtlPWinPos_C "obere Kleinsignalgrenze für den P-Anteil des Druckreglers über Druckregelventil" VALUE 0x8005A404 Val_Ws16 5276.800 Pres_Rail -3276.800 2000.000 EXTENDED_LIMITS -3276.800 3276.700 /end CHARACTERISTIC
/begin CHARACTERISTIC Rail_pPCVCtlUpLimStrt_C "obere Stellwertbegrenzung des Raildruckreglers über Druckregelventil während der Startphase" VALUE 0x8005A0A2 Val_Ws16 5276.800 Pres_Rail -3276.800 2000.000 EXTENDED_LIMITS -3276.800 3276.700 /end CHARACTERISTIC
/begin CHARACTERISTIC Rail_pPCVCtlUpLim_C "obere Stellwertbegrenzung des Raildruckreglers über Druckregelventil" VALUE 0x8005A0A4 Val_Ws16 2000.000 Pres_Rail 0.00 2000.000 EXTENDED_LIMITS -3276.800 3276.700 /end CHARACTERISTIC
/begin CHARACTERISTIC Rail_pPCVInitI_MAP "Kennfeld für Initialisierungswert I-Anteil des PCV-Druckreglers, beim Umschalten von Zumesseinheit auf Druckregelventil" MAP 0x80059F38 Map_Xs16Ys16Ws16 2000.000 Pres_Rail 0.00 2000.000 EXTENDED_LIMITS -3276.800 3276.700
 /begin AXIS_DESCR STD_AXIS Epm_nEng EngN 8 0.00 10000.00 EXTENDED_LIMITS -16384.00 16383.50 DEPOSIT ABSOLUTE /end AXIS_DESCR
 /begin AXIS_DESCR STD_AXIS Rail_pSetPoint Pres_Rail 12 0.00 2000.000 EXTENDED_LIMITS -3276.800 3276.700 DEPOSIT ABSOLUTE /end AXIS_DESCR
/end CHARACTERISTIC
/begin CHARACTERISTIC Rail_pSetMaxHpTst_C "Datensatzwert für maximale Raildrucksollwertvorgabe von HpTst" VALUE 0x8005A4CA Val_Ws16 2000.000 Pres_Rail 0.00 2000.000 EXTENDED_LIMITS -3276.800 3276.700 /end CHARACTERISTIC
/begin CHARACTERISTIC Rail_pSetMinHpTst_C "Datensatzwert für minimale Raildruckvorgabe von HpTst" VALUE 0x8005A4CC Val_Ws16 2000.000 Pres_Rail 0.00 2000.000 EXTENDED_LIMITS -3276.800 3276.700 /end CHARACTERISTIC
/begin CHARACTERISTIC Rail_pSetMin_CUR "Kennlinie für den minimalen Raildruck als Stellwertvorgabe für PCV" CURVE 0x8005A024 Cur_Xs16Ws16 2000.000 Pres_Rail 0.00 2000.000 EXTENDED_LIMITS -3276.800 3276.700
 /begin AXIS_DESCR STD_AXIS Epm_nEng EngN 4 0.00 1800000. EXTENDED_LIMITS -16384.00 16383.50 DEPOSIT ABSOLUTE /end AXIS_DESCR
/end CHARACTERISTIC
/begin CHARACTERISTIC Rail_pSetZLHpTst_C "Datensatzwert für Nulllast-Druckvorgabe von HpTst" VALUE 0x8005A4CE Val_Ws16 2000.000 Pres_Rail 0.00 2000.000 EXTENDED_LIMITS -3276.800 3276.700 /end CHARACTERISTIC
/begin CHARACTERISTIC Rail_pStepHpTst_C "Datensatzwert für Raildrucksollwertsprung für HpTst" VALUE 0x8005A4D0 Val_Ws16 2000.000 Pres_Rail 0.00 2000.000 EXTENDED_LIMITS -3276.800 3276.700 /end CHARACTERISTIC
/begin CHARACTERISTIC Rail_pTmrDwn1HpTst_C "Datensatzwert für Raildruckschwelle für Messung der ersten Druckabfallzeit" VALUE 0x8005A4D2 Val_Ws16 2000.000 Pres_Rail 0.00 2000.000 EXTENDED_LIMITS -3276.800 3276.700 /end CHARACTERISTIC
/begin CHARACTERISTIC Rail_pTmrDwn2HpTst_C "Datensatzwert für Raildruckschwelle für Messung der zweiten Druckabfallzeit" VALUE 0x8005A4D4 Val_Ws16 2000.000 Pres_Rail 0.00 2000.000 EXTENDED_LIMITS -3276.800 3276.700 /end CHARACTERISTIC
/begin CHARACTERISTIC Rail_qCPCtlTypeHys_C "Hysterese für die Umschaltung auf CPC-Regelung" VALUE 0x8005A43A Val_Ws16 327.6700 InjMass 0.00 327.6700 EXTENDED_LIMITS -327.6800 327.6700 /end CHARACTERISTIC
/begin CHARACTERISTIC Rail_qCPCtlTypeRgnHys_C "Hysterese für die Umschaltung auf PCV-Regelung während der Regeneration bei kleiner Last" VALUE 0x8005A43C Val_Ws16 327.6700 InjMass 0.00 327.6700 EXTENDED_LIMITS -327.6800 327.6700 /end CHARACTERISTIC
/begin CHARACTERISTIC Rail_qCPCtlTypeRgn_CUR "Menge zur Umschaltung auf PCV Betrieb bei Regenaration" CURVE 0x8005A43E Cur_Xs16Ws16 327.6700 InjMass 0.00 327.6700 EXTENDED_LIMITS -327.6800 327.6700
 /begin AXIS_DESCR STD_AXIS Epm_nEng EngN 8 0.00 10000.00 EXTENDED_LIMITS -16384.00 16383.50 DEPOSIT ABSOLUTE /end AXIS_DESCR
/end CHARACTERISTIC
/begin CHARACTERISTIC Rail_qCPCtlType_CUR "Mengengrenze für die Umschaltung auf CPC-Regelung" CURVE 0x8005A460 Cur_Xs16Ws16 327.6700 InjMass 0.00 327.6700 EXTENDED_LIMITS -327.6800 327.6700
 /begin AXIS_DESCR STD_AXIS Epm_nEng EngN 8 0.00 10000.00 EXTENDED_LIMITS -16384.00 16383.50 DEPOSIT ABSOLUTE /end AXIS_DESCR
/end CHARACTERISTIC
/begin CHARACTERISTIC Rail_qDiffMaxHpTst_C "Maximale Abweichung von der Referenzmenge für HpTst" VALUE 0x8005A4D6 Val_Ws16 32767.00 InjMass 0.00 32767.00 EXTENDED_LIMITS -327.6800 327.6700 /end CHARACTERISTIC
/begin CHARACTERISTIC Rail_qMeUnCtlTypeHys_C "Hysterese für die Umschaltung auf MeUn-Regelung" VALUE 0x8005A482 Val_Ws16 327.6700 InjMass 0.00 327.6700 EXTENDED_LIMITS -327.6800 327.6700 /end CHARACTERISTIC
/begin CHARACTERISTIC Rail_qMeUnCtlType_CUR "Mengengrenze für die Umschaltung auf MeUn-Regelung" CURVE 0x8005A484 Cur_Xs16Ws16 327.6700 InjMass 0.00 327.6700 EXTENDED_LIMITS -327.6800 327.6700
 /begin AXIS_DESCR STD_AXIS Epm_nEng EngN 8 0.00 10000.00 EXTENDED_LIMITS -16384.00 16383.50 DEPOSIT ABSOLUTE /end AXIS_DESCR
/end CHARACTERISTIC
/begin CHARACTERISTIC Rail_rAccPedHpTst_C "Maximale Fahrpedalposition für HpTst" VALUE 0x8005A4D8 Val_Wu16 65535.00 Prc 0.00 65535.00 EXTENDED_LIMITS 0.00 799.9878 /end CHARACTERISTIC
/begin CHARACTERISTIC Rail_stCtlLoopSel_C "Schalterauswahl für die Raildruckregelung" VALUE 0x8005A036 Val_Wu8 7.000 OneToOne 0.00 7.000 EXTENDED_LIMITS 0.00 255.0 /end CHARACTERISTIC
/begin CHARACTERISTIC Rail_stMskCoEOMOpModeHpTst_C "Maske der erlaubten Betriebsarten während des Hochdrucktests" VALUE 0x8005A4DC Val_Wu32 65535.0000000 OneToOne 0.00 65535.0000000 EXTENDED_LIMITS 0.00 4294967295.00 /end CHARACTERISTIC
/begin CHARACTERISTIC Rail_stOpModeRgn_C "Label zur Erkennung des Regenerationbetriebs" VALUE 0x8005A4A8 Val_Wu32 4294967295.00 OneToOne 0.00 4294967295.00 /end CHARACTERISTIC
/begin CHARACTERISTIC Rail_swt5StepHpTst_C "Datensatzwert für Schalter zum Aktivieren des fünften Schrittes ohne Einspritzungen" VALUE 0x8005A4E0 Val_Wu8 255.0 OneToOne 0.00 255.0 /end CHARACTERISTIC
/begin CHARACTERISTIC Rail_swtCtlParHpTst_C "Datensatzwert für Schalter zum Aktivieren der seperaten Regelparameter während des HpTst" VALUE 0x8005A4E1 Val_Wu8 2.000 OneToOne 0.00 2.000 EXTENDED_LIMITS 0.00 255.0 /end CHARACTERISTIC
/begin CHARACTERISTIC Rail_swtCtlType_C "Schalter für die manuelle Vorgabe des Regelmodus" VALUE 0x8005A4AC Val_Wu8 255.0 OneToOne 0.00 255.0 /end CHARACTERISTIC
/begin CHARACTERISTIC Rail_swtMeUnCtlIInit_C "Freigabe der Initialisierung von Rail_dvolMeUnCtlI in Abhängigkeit der Zustandswechsel von Rail_stCPC" VALUE 0x8005A038 Val_Ws16 3.000000 OneToOne 0.00 3.000000 EXTENDED_LIMITS -32768.00 32767.00 /end CHARACTERISTIC
/begin CHARACTERISTIC Rail_swtNoChkRefHpTst_C "Schalter für die Abschaltung diverser, überwachter Betriebsbedingungen" VALUE 0x8005A4E2 Val_Wu8 255.0 OneToOne 0.00 255.0 /end CHARACTERISTIC
/begin CHARACTERISTIC Rail_swtPCVInitI_C "Auswahl, PCV-Reglerinitialisierung mit Vorsteuerwert oder mit Sollwert" VALUE 0x8005A03A Val_Wu8 255.0 OneToOne 0.00 255.0 /end CHARACTERISTIC
/begin CHARACTERISTIC Rail_tClntMinHpTst_C "Minimale Kühlwassertemperatur für HpTst" VALUE 0x8005A4E4 Val_Ws16 32817.00 Temp_Cels -50.04000 32766.96 EXTENDED_LIMITS -3549.940 3003.560 /end CHARACTERISTIC
/begin CHARACTERISTIC Rail_tiBuildUpMaxHpTst_CA "Array von Maximaldauern für jede Druckaufbauphase" VAL_BLK 0x8005A4E8 ValA_Ws32 5000.00000000 Time_ms 0.00 5000.00000000 EXTENDED_LIMITS -21474836480.0 21474836470.0 NUMBER 4 /end CHARACTERISTIC
/begin CHARACTERISTIC Rail_tiDropMaxHpTst_CA "Array von Maximaldauern für jede Druckabbauphase" VAL_BLK 0x8005A4F8 ValA_Ws32 20000.0000000 Time_ms 0.00 20000.0000000 EXTENDED_LIMITS -21474836480.0 21474836470.0 NUMBER 5 /end CHARACTERISTIC
/begin CHARACTERISTIC Rail_tiDropMinHpTst_CA "Array von Minimaldauern für jede Druckabbauphase" VAL_BLK 0x8005A50C ValA_Ws32 20000.0000000 Time_ms 0.00 20000.0000000 EXTENDED_LIMITS -21474836480.0 21474836470.0 NUMBER 5 /end CHARACTERISTIC
/begin CHARACTERISTIC Rail_tiFrzIDel_C "Verzögerungszeit zum Einfrieren des I-Anteils für den Druckregler über Zumesseinheit" VALUE 0x8005A03C Val_Ws16 1000.000 Time_ms 0.00 1000.000 EXTENDED_LIMITS -327680.0 327670.0 /end CHARACTERISTIC
/begin CHARACTERISTIC Rail_tiMeUnCtlDT1_CUR "Zeitkonstante des DT1-Gliedes (Druckregelung über Zumesseinheit)" CURVE 0x8005A272 Cur_Xs16Ws16 16.776216 TimeDelay_s_2 0.0010000129 16.777216 FORMAT "%9.6" EXTENDED_LIMITS 0.00051201563 16.777216
 /begin AXIS_DESCR STD_AXIS Epm_nEng EngN 5 0.00 10000.00 EXTENDED_LIMITS -16384.00 16383.50 DEPOSIT ABSOLUTE /end AXIS_DESCR
/end CHARACTERISTIC
/begin CHARACTERISTIC Rail_tiMeUnCtlPT1_CUR "Zeitkonstante des PT1-Filters (Druckregelung über Zumesseinheit)" CURVE 0x8005A288 Cur_Xs16Ws16 16.776216 TimeDelay_s_2 0.0010000129 16.777216 FORMAT "%9.6" EXTENDED_LIMITS 0.00051201563 16.777216
 /begin AXIS_DESCR STD_AXIS Epm_nEng EngN 8 0.00 10000.00 EXTENDED_LIMITS -16384.00 16383.50 DEPOSIT ABSOLUTE /end AXIS_DESCR
/end CHARACTERISTIC
/begin CHARACTERISTIC Rail_tiMeUnRmpDur_CUR "Laufzeit der Rampe um das Fördervolumen der Zumesseinheit vom aktuellen Sollwert auf die Maximalförderung zu rampen" CURVE 0x8005A03E Cur_Xs16Ws16 655350.0 Time_ms -327680.0 327670.0
 /begin AXIS_DESCR STD_AXIS Epm_nEng EngN 8 0.00 10000.00 EXTENDED_LIMITS -16384.00 16383.50 DEPOSIT ABSOLUTE /end AXIS_DESCR
/end CHARACTERISTIC
/begin CHARACTERISTIC Rail_tiPCVCtlDT1_CUR "Zeitkonstante des DT1-Gliedes für die Druckregelung über Druckregelventil" CURVE 0x8005A406 Cur_Xs16Ws16 16.776216 TimeDelay_s_2 0.0010000129 16.777216 FORMAT "%9.6" EXTENDED_LIMITS 0.00051201563 16.777216
 /begin AXIS_DESCR STD_AXIS Epm_nEng EngN 5 0.00 10000.00 EXTENDED_LIMITS -16384.00 16383.50 DEPOSIT ABSOLUTE /end AXIS_DESCR
/end CHARACTERISTIC
/begin CHARACTERISTIC Rail_tiPT1CPCDvt_C "Verzögerungszeitkonstante für die Regelabweichung des Volumenstroms" VALUE 0x8005A060 Val_Ws32 1073.7408240 TimeDelay_s 0.0010000000689 1073.7418240 FORMAT "%12.7" EXTENDED_LIMITS 0.000002000000001 4294.9672960 /end CHARACTERISTIC
/begin CHARACTERISTIC Rail_tiShutOffDblCtl_C "Zeit zum Umschalten auf einen zweiten Fehlerpfad für verzögertes Abschalten" VALUE 0x8005A064 Val_Ws16 100.0000 Time_s 0.00 100.0000 EXTENDED_LIMITS -327.6800 327.6700 /end CHARACTERISTIC
/begin CHARACTERISTIC Rail_tiStepHpTst_C "Zeitkonstante für Druckaufbaurampe" VALUE 0x8005A520 Val_Ws16 32770.00 Time_ms 0.00 32770.00 EXTENDED_LIMITS -327680.0 327670.0 /end CHARACTERISTIC
/begin CHARACTERISTIC Rail_tiStrtHpTst_C "Wartezeit vor Start des HpTst" VALUE 0x8005A524 Val_Ws32 32770.0000000 Time_ms 0.00 32770.0000000 EXTENDED_LIMITS -21474836480.0 21474836470.0 /end CHARACTERISTIC
/begin CHARACTERISTIC Rail_tiSwtCPCMax_C "maximale Verweildauer eines Zustandes für die CPC-Regelung" VALUE 0x8005A066 Val_Ws16 655350.0 Time_ms -327680.0 327670.0 /end CHARACTERISTIC
/begin CHARACTERISTIC Rail_tiSwtCtlTypeDel_C "Verzögerungszeit bis zur Freigabe der Umschaltung des Regelprinzips" VALUE 0x8005A4AE Val_Ws16 327670.0 Time_ms 0.00 327670.0 EXTENDED_LIMITS -327680.0 327670.0 /end CHARACTERISTIC
/begin CHARACTERISTIC Rail_tiSwtToMeUnCtl_C "Verzögerungszeit bis zum Umschalten auf Druckregelung über Zumesseinheit" VALUE 0x8005A068 Val_Ws16 327670.0 Time_ms 0.00 327670.0 EXTENDED_LIMITS -327680.0 327670.0 /end CHARACTERISTIC
/begin CHARACTERISTIC Rail_tiWaitAftDropHpTst_C "Wartzeit nach dem Druckabfall des HpTst" VALUE 0x8005A528 Val_Ws32 20000.0000000 Time_ms 0.00 20000.0000000 EXTENDED_LIMITS -21474836480.0 21474836470.0 /end CHARACTERISTIC
/begin CHARACTERISTIC Rail_tiWaitHiHpTst_C "Wartezeit nach dem Druckaufbau des HpTst" VALUE 0x8005A52C Val_Ws32 20000.0000000 Time_ms 0.00 20000.0000000 EXTENDED_LIMITS -21474836480.0 21474836470.0 /end CHARACTERISTIC
/begin CHARACTERISTIC Rail_tiWaitLoHpTst_C "Wartezeit vor dem Druckaufbau des HpTst" VALUE 0x8005A530 Val_Ws32 20000.0000000 Time_ms 0.00 20000.0000000 EXTENDED_LIMITS -21474836480.0 21474836470.0 /end CHARACTERISTIC
/begin CHARACTERISTIC Rail_tMeUnCtlTypeHi_C "obere Temperaturhystereseschwelle zur Verriegelung der PCV-Regelung" VALUE 0x8005A4B0 Val_Ws16 200.0000 Temp_Cels -50.14000 149.8600 EXTENDED_LIMITS -3549.940 3003.560 /end CHARACTERISTIC
/begin CHARACTERISTIC Rail_tMeUnCtlTypeLo_C "untere Temperaturhystereseschwelle für die Verriegelung der PCV-Regelung" VALUE 0x8005A4B2 Val_Ws16 200.0000 Temp_Cels -50.14000 149.8600 EXTENDED_LIMITS -3549.940 3003.560 /end CHARACTERISTIC
/begin CHARACTERISTIC Rail_tSwtCPCHi_C "obere Temperaturhystereseschwelle zur Verriegelung der PCV-Regelung" VALUE 0x8005A4B4 Val_Ws16 200.0000 Temp_Cels -50.14000 149.8600 EXTENDED_LIMITS -3549.940 3003.560 /end CHARACTERISTIC
/begin CHARACTERISTIC Rail_tSwtCPCLo_C "untere Temperaturhystereseschwelle zur Verriegelung der PCV-Regelung" VALUE 0x8005A4B6 Val_Ws16 200.0000 Temp_Cels -50.14000 149.8600 EXTENDED_LIMITS -3549.940 3003.560 /end CHARACTERISTIC
/begin CHARACTERISTIC Rail_vMeUnThresShutOff_C "Fahrgeschwindigkeitsschwelle zur Umschaltung auf MeUn" VALUE 0x8005A06A Val_Ws16 40.00000 Vel 0.00 40.00000 EXTENDED_LIMITS -327.6800 327.6700 /end CHARACTERISTIC
/begin CHARACTERISTIC RngMod_trqClthBs_C "Adapter - RngMod_trqClthBs_C" VALUE 0x800662B2 Val_Ws16 6553.500 Trq -3276.800 3276.700 /end CHARACTERISTIC
/begin CHARACTERISTIC RngMod_trqClthMinWoCtOff_C "Adapter - RngMod_trqClthMinWoCtOff_C" VALUE 0x800662B4 Val_Ws16 6553.500 Trq -3276.800 3276.700 /end CHARACTERISTIC
/begin CHARACTERISTIC S_QVH2OSOC "Schalter zum Ausschalten des Einfluss des Ladezustands" VALUE 0x800665A5 Val_Wu8 1.0 Identity 0.00 1.0 EXTENDED_LIMITS 0.00 255. /end CHARACTERISTIC
/begin CHARACTERISTIC S_QVH2O_UM "Umschalter: True = Rücksetzen von Qv_h2o bei Batterietausch, false = Qv_h2o bei Batterieabklemmen" VALUE 0x800665A6 Val_Wu8 1.0 Identity 0.00 1.0 EXTENDED_LIMITS 0.00 255. /end CHARACTERISTIC
/begin MEASUREMENT ActMod_trqClthWoDstC "Kupplungsmoment ohne Antiruckeleingriff" SWORD Trq 1 100 -3276.800 3276.700 ECU_ADDRESS 0xD000058C /end MEASUREMENT
/begin MEASUREMENT CoPT_facDesDyn "Dynamikfaktor der fahrzeugseitigen Anforderer" SWORD Fact 1 100 -4.000000 3.999878 ECU_ADDRESS 0xD00006EE /end MEASUREMENT
/begin MEASUREMENT CoPT_nASTDes "Getriebe Synchronisationsdrehzahl" SWORD EngN 1 100 -16384.00 16383.50 ECU_ADDRESS 0xD00006F0 /end MEASUREMENT
/begin MEASUREMENT CoPT_nMaxAcs "Maximaldrehzahlbegrenzung der Nebenaggregate" SWORD EngN 1 100 -16384.00 16383.50 ECU_ADDRESS 0xD00006F2 /end MEASUREMENT
/begin MEASUREMENT CoPT_nMaxSysErr "Maximaldrehzahlbegrenzung bei Systemfehler" SWORD EngN 1 100 -16384.00 16383.50 ECU_ADDRESS 0xD00006F6 /end MEASUREMENT
/begin MEASUREMENT CoPT_nMaxTra "Maximaldrehzahlbegrenzung des Getriebes" SWORD EngN 1 100 -16384.00 16383.50 ECU_ADDRESS 0xD00006F8 /end MEASUREMENT
/begin MEASUREMENT CoPT_nMinAcs "Leerlaufdrehzahlanforderung der Nebenaggregate" SWORD EngN 1 100 -16384.00 16383.50 ECU_ADDRESS 0xD00006FA /end MEASUREMENT
/begin MEASUREMENT CoPT_nMinSysErr "Leerlaufdrehzahlanforderung bei Systemfehler" SWORD EngN 1 100 -16384.00 16383.50 ECU_ADDRESS 0xD00006FE /end MEASUREMENT
/begin MEASUREMENT CoPT_nMinTra "Leerlaufdrehzahlanforderung des Getriebes" SWORD EngN 1 100 -16384.00 16383.50 ECU_ADDRESS 0xD0000700 /end MEASUREMENT
/begin MEASUREMENT CoPT_stAST "Status Getriebe-Synchronisationsdrehzahleingriff" UBYTE OneToOne 1 100 0.00 255.0 ECU_ADDRESS 0xD0001C49 /end MEASUREMENT
/begin MEASUREMENT CoPT_stNSetPAcs "Statuswort das Umsetzung der Nebenaggregatsdrehzahlanforderungen definiert" UBYTE OneToOne 1 100 0.00 255.0 ECU_ADDRESS 0xD0001C4B /end MEASUREMENT
/begin MEASUREMENT CoPT_stNSetPSysErr "Statuswort das Umsetzung der Systemfehlerdrehzahlanforderungen definiert" UBYTE OneToOne 1 100 0.00 255.0 ECU_ADDRESS 0xD0001C4C /end MEASUREMENT
/begin MEASUREMENT CoPT_stNSetPTra "Statuswort das Umsetzung der Getriebedrehzahlanforderungen definiert" UBYTE OneToOne 1 100 0.00 255.0 ECU_ADDRESS 0xD0001C4D /end MEASUREMENT
/begin MEASUREMENT CoPT_tiASTDes "Getriebe Synchronisationszeit" SWORD Time_s 1 100 -327.6800 327.6700 ECU_ADDRESS 0xD0000706 /end MEASUREMENT
/begin MEASUREMENT CoPT_trqCurrEng "Verbrennungsmotorvorhaltmoment (Kupplungsmoment)" SWORD Trq 1 100 -3276.800 3276.700 ECU_ADDRESS 0xD000070A /end MEASUREMENT
/begin MEASUREMENT CoPT_trqDesCompEng "Verbrennungsmotorkompensationsmoment" SWORD Trq 1 100 -3276.800 3276.700 ECU_ADDRESS 0xD0000710 /end MEASUREMENT
/begin MEASUREMENT CoPT_trqDesEng "Verbrennungsmotorsollmoment (Kupplungsmoment)" SWORD Trq 1 100 -3276.800 3276.700 ECU_ADDRESS 0xD0000712 /end MEASUREMENT
/begin MEASUREMENT CoPT_trqLeadEng "Verbrennungsmotor(Curr)vorhaltmoment (Kupplungsmoment)" SWORD Trq 1 100 -3276.800 3276.700 ECU_ADDRESS 0xD0000718 /end MEASUREMENT
/begin MEASUREMENT CoPT_trqLeadPOpEng "Vorhaltmoment zur BDE-Betriebsartenauswahl" SWORD Trq 1 100 -3276.800 3276.700 ECU_ADDRESS 0xD000071C /end MEASUREMENT
/begin MEASUREMENT CoPT_trqResvEng "Konstante Verbrennungsmotormomentenreserve" SWORD Trq 1 100 -3276.800 3276.700 ECU_ADDRESS 0xD0000722 /end MEASUREMENT
/begin MEASUREMENT Dfftl_bLowRng "Getriebeübersetzung aktiv" UBYTE OneToOne 1 100 0.00 255.0 ECU_ADDRESS 0xD0001DD6 /end MEASUREMENT
/begin MEASUREMENT Eng_stStopEna "Motorstopfreigabe" UBYTE OneToOne 1 100 0.00 255.0 ECU_ADDRESS 0xD0001DF6 /end MEASUREMENT
/begin MEASUREMENT Eng_stStrtEna "Motorstartfreigabe" UBYTE OneToOne 1 100 0.00 255.0 ECU_ADDRESS 0xD0001DF7 /end MEASUREMENT
/begin MEASUREMENT Exh_pAdapPPFltUs "" SWORD Pres_hPa 1 100 -32768.00 3500.00 ECU_ADDRESS 0xD0000A0A /end MEASUREMENT
/begin MEASUREMENT Exh_pFltPPFltUs "" SWORD Pres_hPa 1 100 -32768.00 3500.00 ECU_ADDRESS 0xD0000A2C /end MEASUREMENT
/begin MEASUREMENT Exh_pPFltUs "" SWORD Pres_hPa 1 100 -32768.00 3500.00 ECU_ADDRESS 0xD0000A34 /end MEASUREMENT
/begin MEASUREMENT GbxNPos_st "Getriebe Neutralstellung" UBYTE OneToOne 1 100 0.00 255.0 ECU_ADDRESS 0xD0001E57 /end MEASUREMENT
/begin MEASUREMENT Gbx_bASTIntv "Freigabe erhöhender Drehzahleingriff durch Getriebe" UBYTE OneToOne 1 100 0.00 255.0 ECU_ADDRESS 0xD0000B3A /end MEASUREMENT
/begin MEASUREMENT Gbx_bASTNeutr "Neutralwert für erhöhenden Drehzahleingriff durch Getriebe empfangen" UBYTE OneToOne 1 100 0.00 255.0 ECU_ADDRESS 0xD0000B3C /end MEASUREMENT
/begin MEASUREMENT Gbx_bRevGear "Rückwärtsgang eingelegt" UBYTE OneToOne 1 100 0.00 255.0 ECU_ADDRESS 0xD0001E5C /end MEASUREMENT
/begin MEASUREMENT Gbx_nASTDes "Synchronisations-Wunschdrehzahl" SWORD EngN 1 100 -16384.00 16383.50 ECU_ADDRESS 0xD0000B40 /end MEASUREMENT
/begin MEASUREMENT Gbx_nIdlDes "Soll-Drehzahl-Anhebung für CVT" SWORD EngN 1 100 -16384.00 16383.50 ECU_ADDRESS 0xD0000B42 /end MEASUREMENT
/begin MEASUREMENT Gbx_rFanClgDem "Ratio Lufter Kühlanforderung von Getriebe" SWORD Prc 1 100 -400.0000 399.9878 ECU_ADDRESS 0xD0000B46 /end MEASUREMENT
/begin MEASUREMENT Gbx_rTrq "aktuelle Momentenübersetzung des Getriebes (inklusive Wandler)" SWORD TransR 1 100 -327.6800 327.6700 ECU_ADDRESS 0xD0000B48 /end MEASUREMENT
/begin MEASUREMENT Gbx_rTrqTra "aktuelle Momentenübersetzung des Getriebes (exklusive Wandler)" SWORD TransR 1 100 -327.6800 327.6700 ECU_ADDRESS 0xD0000B4A /end MEASUREMENT
/begin MEASUREMENT Gbx_stConvClth "Wandlerkupplung" UBYTE OneToOne 1 100 0.00 255.0 ECU_ADDRESS 0xD0001E60 /end MEASUREMENT
/begin MEASUREMENT Gbx_stGearLvr "Getriebe-Wählhebelposition" UBYTE OneToOne 1 100 0.00 255.0 ECU_ADDRESS 0xD0001E61 /end MEASUREMENT
/begin MEASUREMENT Gbx_tClntDes "Sollwert der Kühlmitteltemperatur (über CAN)" SWORD Temp_Cels 1 100 -3549.940 3003.560 ECU_ADDRESS 0xD0000B4C /end MEASUREMENT
/begin MEASUREMENT Gbx_tiASTDes "Synchronisationszeit" SWORD Time_s 1 100 -327.6800 327.6700 ECU_ADDRESS 0xD0000B50 /end MEASUREMENT
/begin MEASUREMENT Gbx_tOilConv "Wandleröltemperatur" SWORD Temp_Cels 1 100 -3549.940 3003.560 ECU_ADDRESS 0xD0000B4E /end MEASUREMENT
/begin MEASUREMENT Gbx_trqConvLos "Wandlerverlustmoment" SWORD Trq 1 100 -3276.800 3276.700 ECU_ADDRESS 0xD0000B52 /end MEASUREMENT
/begin MEASUREMENT I_soc0_komp "Zwischengröße Ruhestrom" SWORD Def_i_sw_q0p001 1 100 -32.76800 32.76700 FORMAT "%8.5" ECU_ADDRESS 0xC000AAB2 /end MEASUREMENT
/begin MEASUREMENT K_QVQ_ANZSTA "Maximale Standzeit des Fahrzeuges" UWORD Def_td_uw_q1 1 100 0.00 65535. FORMAT "%5.0" ECU_ADDRESS 0xC000AB1E /end MEASUREMENT
/begin MEASUREMENT Prp_stIARls "Zündwinkelfreigabe durch Differentialschutz" UBYTE OneToOne 1 100 0.00 255.0 ECU_ADDRESS 0xD0002065 /end MEASUREMENT
/begin MEASUREMENT Prp_trqDCS_mp "MSR-Eingriffsmoment (Getriebeausgangsmoment)" SLONG TrqPrpHigh 1 100 -214748364.800 214748364.700 ECU_ADDRESS 0xC0009298 /end MEASUREMENT
/begin MEASUREMENT Prp_trqIntv_mp "Momenteneingriff durch Differentialschutz" SLONG TrqPrpHigh 1 100 -214748364.800 214748364.700 ECU_ADDRESS 0xC000929C /end MEASUREMENT
/begin MEASUREMENT Prp_trqLeadIntv_mp "Vorhaltmomenteneingriff durch Differentialschutz" SLONG TrqPrpHigh 1 100 -214748364.800 214748364.700 ECU_ADDRESS 0xC00092A0 /end MEASUREMENT
/begin MEASUREMENT PSPCtl_dvolBaseLim_mp "Limitierter Basis - Volumenstrom durch die Vorförderpumpe" SWORD FlConsum_l_h 1 100 -327.6800 327.6700 FORMAT "%8.4" ECU_ADDRESS 0xC000AA82 /end MEASUREMENT
/begin MEASUREMENT PSPCtl_dvolBase_mp "Basis - Volumentstrom durch die Vorförderpumpe" SWORD FlConsum_l_h 1 100 -327.6800 327.6700 FORMAT "%8.4" ECU_ADDRESS 0xC000AA84 /end MEASUREMENT
/begin MEASUREMENT PSPCtl_dvolCalc_mp "Drehzahlabhängiger Volumenstrom durch die Vorförderpumpe" SWORD FlConsum_l_h 1 100 -327.6800 327.6700 FORMAT "%8.4" ECU_ADDRESS 0xC000AA86 /end MEASUREMENT
/begin MEASUREMENT PSPCtl_dvolLim_mp "Limitierungswert für den Basis - Volumenstrom durch die Vorförderpumpe" SWORD FlConsum_l_h 1 100 -327.6800 327.6700 FORMAT "%8.4" ECU_ADDRESS 0xC000AA88 /end MEASUREMENT
/begin MEASUREMENT PSPCtl_dvolT15Delay_mp "Basisvolumenstrom durch die Vorförderpumpe wenn der Kl. 15 Timer läuft" SWORD FlConsum_l_h 1 100 -327.6800 327.6700 FORMAT "%8.4" ECU_ADDRESS 0xC000AA8A /end MEASUREMENT
/begin MEASUREMENT PSPCtl_stLogic_mp "Status der PSP Logik - Bit 0: T15 Timer läuft, Bit 1: Drehzahl über Schwellwert" SWORD OneToOne 1 100 -32768.00 32767.00 ECU_ADDRESS 0xC000AA8C /end MEASUREMENT
/begin MEASUREMENT PSPCtl_tiT15Delay_mp "Messpunkt für die Aktivierungszeit der PSP nach Kl. 15 ein aber Drehzahl unter Schwellwert" SWORD Time_ms 1 100 -327680.0 327670.0 ECU_ADDRESS 0xC000AA8E /end MEASUREMENT
/begin MEASUREMENT PSP_dvolOut "" SWORD FlConsum_l_h 1 100 -327.6800 327.6700 FORMAT "%8.4" ECU_ADDRESS 0xD0001222 /end MEASUREMENT
/begin MEASUREMENT PSP_st "" UBYTE OneToOne 1 100 0.00 255.0 ECU_ADDRESS 0xD000204A /end MEASUREMENT
/begin MEASUREMENT PthLead_stActvMonLim "Status der Momentebegrenzung durch die Überwachung" UBYTE OneToOne 1 100 0.00 255.0 ECU_ADDRESS 0xD0002066 /end MEASUREMENT
/begin MEASUREMENT PthLead_trqInrCurr "Inneres Moment für den Curr-Pfad" SWORD Trq 1 100 -3276.800 3276.700 ECU_ADDRESS 0xD000125E /end MEASUREMENT
/begin MEASUREMENT PthLead_trqInrCurrNoMo_mp "Inneres Moment vor der Überwachungsbegrenzung für den Curr-Pfad" SWORD Trq 1 100 -3276.800 3276.700 ECU_ADDRESS 0xC000AA90 /end MEASUREMENT
/begin MEASUREMENT PthLead_trqInrLead "Inneres Moment für den Lead-Pfad" SWORD Trq 1 100 -3276.800 3276.700 ECU_ADDRESS 0xD0001260 /end MEASUREMENT
/begin MEASUREMENT PthLead_trqInrLeadNoMo_mp "Inneres Moment vor der Überwachungsbegrenzung für den Lead-Pfad" SWORD Trq 1 100 -3276.800 3276.700 ECU_ADDRESS 0xC000AA92 /end MEASUREMENT
/begin MEASUREMENT PthSet_ctProcSet "Anzahl der addierten Momente in PthSet_trqInrSetSum" UBYTE OneToOne 1 100 0.00 255.0 ECU_ADDRESS 0xD0002067 /end MEASUREMENT
/begin MEASUREMENT PthSet_dtrqRmpDwn_mp "Rampensteigung bei Schubabschaltung" SLONG RmpTrq 1 100 -3276800.00000 3276799.99847 ECU_ADDRESS 0xC00092A4 /end MEASUREMENT
/begin MEASUREMENT PthSet_stActvMonLim "Status der Momentbegrenzung durch die Überwachung" UBYTE OneToOne 1 100 0.00 255.0 ECU_ADDRESS 0xD0002068 /end MEASUREMENT
/begin MEASUREMENT PthSet_stDisable "Status der Schubabschaltung (0: nicht abgeschaltet; 1: abgeschaltet" UBYTE OneToOne 1 100 0.00 255.0 ECU_ADDRESS 0xD0002069 /end MEASUREMENT
/begin MEASUREMENT PthSet_stOvrRun "Status der Schuberkennung (0: kein Schub erkannt; 1:Schub erkannt)" UBYTE OneToOne 1 100 0.00 255.0 ECU_ADDRESS 0xD000206A /end MEASUREMENT
/begin MEASUREMENT PthSet_stOvrRunCoord "Status der Schuberkennung im Schubkoordinator (0: kein Schub; 1: Schub)" UBYTE OneToOne 1 100 0.00 255.0 ECU_ADDRESS 0xD000206B /end MEASUREMENT
/begin MEASUREMENT PthSet_stRmp_mp "Status der Rampe für die Schubabschaltung (0: inaktiv; 1: aktiv)" UBYTE OneToOne 1 100 0.00 255.0 ECU_ADDRESS 0xC000B497 /end MEASUREMENT
/begin MEASUREMENT PthSet_tiRmpStrt "" SWORD Time_ms 1 100 -327680.0 327670.0 ECU_ADDRESS 0xD0001262 /end MEASUREMENT
/begin MEASUREMENT PthSet_tiSwtOff "" SWORD Time_ms 1 100 -327680.0 327670.0 ECU_ADDRESS 0xD0001264 /end MEASUREMENT
/begin MEASUREMENT PthSet_trqASDdcInit "Initialisierungswert für den Ausgang vom Ruckeldämpfer während aktiver Schubabschaltung" SWORD Trq 1 100 -3276.800 3276.700 ECU_ADDRESS 0xD0001266 /end MEASUREMENT
/begin MEASUREMENT PthSet_trqASDrfInit "Initialisierungswert für den Ausgang vom Führungsformer während aktiver Schubabschaltung" SWORD Trq 1 100 -3276.800 3276.700 ECU_ADDRESS 0xD0001268 /end MEASUREMENT
/begin MEASUREMENT PthSet_trqBefRmp_mp "inneres Moment für den Set-Pfad nach der zweiten Begrenzung vor der Schubabschaltung" SWORD Trq 1 100 -3276.800 3276.700 ECU_ADDRESS 0xC000AA94 /end MEASUREMENT
/begin MEASUREMENT PthSet_trqInrSet "inneres Moment für den Set-Pfad nach der Überwachungsbegrenzung" SWORD Trq 1 100 -3276.800 3276.700 ECU_ADDRESS 0xD000126A /end MEASUREMENT
/begin MEASUREMENT PthSet_trqInrSetNoMo "Inneres Moment für den Set-Pfad vor der Überwachungsbegrenzung" SWORD Trq 1 100 -3276.800 3276.700 ECU_ADDRESS 0xD000126C /end MEASUREMENT
/begin MEASUREMENT PthSet_trqInrSetSum "Kumuliertes inneres Moment des Set-Pfades" SLONG Trq 1 100 -214748364.800 214748364.700 ECU_ADDRESS 0xD0002FC4 /end MEASUREMENT
/begin MEASUREMENT PthSet_trqLimOffs "" SWORD Trq 1 100 -3276.800 3276.700 ECU_ADDRESS 0xD000126E /end MEASUREMENT
/begin MEASUREMENT PthSet_trqRmp_mp "Ausgangsmoment der Schubabschlatungsrampe" SWORD Trq 1 100 -3276.800 3276.700 ECU_ADDRESS 0xC000AA96 /end MEASUREMENT
/begin MEASUREMENT PthSet_trqSetASDdc "inneres Moment für den Set-Pfad nach der Rückeldampfer Subtraktion" SWORD Trq 1 100 -3276.800 3276.700 ECU_ADDRESS 0xD0001270 /end MEASUREMENT
/begin MEASUREMENT PthSet_trqSetLim "inneres Moment für den Set-Pfad nach der ersten Begrenzung" SWORD Trq 1 100 -3276.800 3276.700 ECU_ADDRESS 0xD0001272 /end MEASUREMENT
/begin MEASUREMENT PTODi_ctProcComp "Prozesszähler für ptodi_trqcomp" UBYTE OneToOne 1 100 0.00 255.0 ECU_ADDRESS 0xC0006559 /end MEASUREMENT
/begin MEASUREMENT PTODi_ctProcDes "Prozesszähler für ptodi_trqdescoord" UBYTE OneToOne 1 100 0.00 255.0 ECU_ADDRESS 0xD000204B /end MEASUREMENT
/begin MEASUREMENT PTODi_stCompLimDeb_mp "Entprellter Status der Begrenzung des kompensierten Moments" UBYTE OneToOne 1 100 0.00 255.0 ECU_ADDRESS 0xC000B498 /end MEASUREMENT
/begin MEASUREMENT PTODi_stCompLimUnDeb_mp "Unentprellter Status der Begrenzung des kompensierten Moments" UBYTE OneToOne 1 100 0.00 255.0 ECU_ADDRESS 0xC000B499 /end MEASUREMENT
/begin MEASUREMENT PTODi_stDesLimDeb_mp "Entprellter Status der engeforderten Momentenbegrenzung" UBYTE OneToOne 1 100 0.00 255.0 ECU_ADDRESS 0xC000B49A /end MEASUREMENT
/begin MEASUREMENT PTODi_stDesLimUnDeb_mp "Unentprellter Status der angeforderten Momentenbegrenzung" UBYTE OneToOne 1 100 0.00 255.0 ECU_ADDRESS 0xC000B49B /end MEASUREMENT
/begin MEASUREMENT PTODi_stLimCompAct "Status: Begrenzung des kompensierten Moments aktiv" UBYTE OneToOne 1 100 0.00 255.0 ECU_ADDRESS 0xD000204C /end MEASUREMENT
/begin MEASUREMENT PTODi_stLimDesAct "Status: Begrenzung des angeforderten Moments aktiv" UBYTE OneToOne 1 100 0.00 255.0 ECU_ADDRESS 0xD000204D /end MEASUREMENT
/begin MEASUREMENT PTODi_trqCompAvrg_mp "Durchschnittliches kompensiertes Moment" SWORD Trq 1 100 -3276.800 3276.700 ECU_ADDRESS 0xC000AA98 /end MEASUREMENT
/begin MEASUREMENT PTODi_trqCompOfs_mp "torque offset compensated torque" SWORD Trq 1 100 -3276.800 3276.700 ECU_ADDRESS 0xC000AA9A /end MEASUREMENT
/begin MEASUREMENT PTODi_trqCompSum "Summenkompensationsmoment über mehrere Rechenaufrufe" SLONG Trq 1 100 -214748364.800 214748364.700 ECU_ADDRESS 0xC0001B84 /end MEASUREMENT
/begin MEASUREMENT PTODi_trqDesAvrg_mp "Angefordertes Durchschnittsmoment" SWORD Trq 1 100 -3276.800 3276.700 ECU_ADDRESS 0xC000AA9E /end MEASUREMENT
/begin MEASUREMENT PTODi_trqDesOfs_mp "torque offset desired torque" SWORD Trq 1 100 -3276.800 3276.700 ECU_ADDRESS 0xC000AAA0 /end MEASUREMENT
/begin MEASUREMENT PTODi_trqDesSum "Summensollmoment über mehrere Rechenaufrufe" SLONG Trq 1 100 -214748364.800 214748364.700 ECU_ADDRESS 0xD0002F98 /end MEASUREMENT
/begin MEASUREMENT PTODi_trqMoComp_mp "Torque monitoring permitted compensation" SWORD Trq 1 100 -3276.800 3276.700 ECU_ADDRESS 0xC000AA9C /end MEASUREMENT
/begin MEASUREMENT PTODi_trqMoPtd_mp "Erlaubte Momentenüberwachung" SWORD Trq 1 100 -3276.800 3276.700 ECU_ADDRESS 0xC000AAA2 /end MEASUREMENT
/begin MEASUREMENT PT_bATSlip "Kraftschluss ist schlupfend vorhanden (Wandlerkupplung ist im schlupfgeregelten Betrieb und ein Gang ist eingelegt)" UBYTE OneToOne 1 100 0.00 255.0 ECU_ADDRESS 0xD000204E /end MEASUREMENT
/begin MEASUREMENT PT_bATSlipClsd "Kraftschluss ist schlupfend vorhanden (Wandlerkupplung ist fast geschlossen aber noch schlupfend und ein Gang ist eingelegt)" UBYTE OneToOne 1 100 0.00 255.0 ECU_ADDRESS 0xD000204F /end MEASUREMENT
/begin MEASUREMENT PT_bATSlipOpn "Kraftschluss ist schlupfend vorhanden (Wandlerkupplung ist offen, Wandler im Schlupf und ein Gang ist eingelegt)" UBYTE OneToOne 1 100 0.00 255.0 ECU_ADDRESS 0xD0002050 /end MEASUREMENT
/begin MEASUREMENT PT_bGrip "Kraftschluss ist sicher vorhanden (Wandler bzw. Kupplung ist geschlossen, ohne Schlupf und ein Gang ist eingelegt)" UBYTE OneToOne 1 100 0.00 255.0 ECU_ADDRESS 0xD0002051 /end MEASUREMENT
/begin MEASUREMENT PT_bNoGrip "Kraftschluss ist sicher ausgeschlossen" UBYTE OneToOne 1 100 0.00 255.0 ECU_ADDRESS 0xD0002052 /end MEASUREMENT
/begin MEASUREMENT PT_dnAbsEng_mp "" SWORD dn_dZfine 1 100 -16384.00 16383.50 FORMAT "%8.2" ECU_ADDRESS 0xC000AAA4 /end MEASUREMENT
/begin MEASUREMENT PT_dnEng_mp "" SWORD dn_dZfine 1 100 -16384.00 16383.50 FORMAT "%8.2" ECU_ADDRESS 0xC000AAA6 /end MEASUREMENT
/begin MEASUREMENT PT_dnGrip_mp "" SWORD dn_dZfine 1 100 -16384.00 16383.50 FORMAT "%8.2" ECU_ADDRESS 0xC000AAA8 /end MEASUREMENT
/begin MEASUREMENT PT_dnNoGrip_mp "" SWORD dn_dZfine 1 100 -16384.00 16383.50 FORMAT "%8.2" ECU_ADDRESS 0xC000AAAA /end MEASUREMENT
/begin MEASUREMENT PT_rGrip "Analogwert für den Zustand Kraftschluss ist sicher vorhanden (Wandler bzw. Kupplung ist geschlossen und ein Gang ist eingelegt)" SWORD TransR 1 100 -327.6800 327.6700 ECU_ADDRESS 0xD0001224 /end MEASUREMENT
/begin MEASUREMENT PT_rTrq "Triebstrang-Übersetzung (Momentenverstärkung)" SWORD TransR 1 100 -327.6800 327.6700 ECU_ADDRESS 0xD000123C /end MEASUREMENT
/begin MEASUREMENT PT_rTrqRmpIn_mp "" SWORD TransR 1 100 -327.6800 327.6700 ECU_ADDRESS 0xC000AAB0 /end MEASUREMENT
/begin MEASUREMENT PT_stGrip "Kraftschlusszustand Antriebsstrang" UBYTE OneToOne 1 100 0.00 255.0 ECU_ADDRESS 0xD0002054 /end MEASUREMENT
/begin MEASUREMENT PT_stNoGripDet_mp "" UBYTE OneToOne 1 100 0.00 255.0 ECU_ADDRESS 0xC000B49C /end MEASUREMENT
/begin MEASUREMENT PT_stPTGrip_mp "Messpunkt für Kraftschlusszustand Antriebsstrang" UBYTE OneToOne 1 100 0.00 255.0 ECU_ADDRESS 0xC000B49D /end MEASUREMENT
/begin MEASUREMENT PT_swtMstShft "Mastershiftinformationen des Antriebsstrangs" UBYTE OneToOne 1 100 0.00 255.0 ECU_ADDRESS 0xD000205D /end MEASUREMENT
/begin MEASUREMENT PT_trqAbsGbxPT1_mp "" SWORD Trq 1 100 -3276.800 3276.700 ECU_ADDRESS 0xC000AAAC /end MEASUREMENT
/begin MEASUREMENT PT_trqGbxPT1_mp "" SWORD Trq 1 100 -3276.800 3276.700 ECU_ADDRESS 0xC000AAAE /end MEASUREMENT
/begin MEASUREMENT PT_trqLos "Verlustmoment des Antriebsstrangs" SWORD Trq 1 100 -3276.800 3276.700 ECU_ADDRESS 0xD000123E /end MEASUREMENT
/begin MEASUREMENT PT_trqLosComp "Verlustmoment des Antriebsstrangs" SWORD Trq 1 100 -3276.800 3276.700 ECU_ADDRESS 0xD0001240 /end MEASUREMENT
/begin MEASUREMENT PT_trqResv "Reservemomentanforderung des Antriebsstrangs" SWORD Trq 1 100 -3276.800 3276.700 ECU_ADDRESS 0xD0001242 /end MEASUREMENT
/begin MEASUREMENT PT_trqSpdGovLtd "Begrenztes Leerlaufreglermoment (Radmoment)" SLONG TrqPrpHigh 1 100 -214748364.800 214748364.700 ECU_ADDRESS 0xD0002F9C /end MEASUREMENT
/begin MEASUREMENT PT_trqTraOut "Kupplungsistmoment" SLONG TrqPrpHigh 1 100 -214748364.800 214748364.700 ECU_ADDRESS 0xD0002FA0 /end MEASUREMENT
/begin MEASUREMENT PT_trqTraOutBs "Basismoment (Getriebeausgangsmoment)" SLONG TrqPrpHigh 1 100 -214748364.800 214748364.700 ECU_ADDRESS 0xD0002FA4 /end MEASUREMENT
/begin MEASUREMENT PT_trqTraOutWoDstC "Getriebeausgangsistmoment ohne Antiruckeleingriff" SLONG TrqPrpHigh 1 100 -214748364.800 214748364.700 ECU_ADDRESS 0xD0002FA8 /end MEASUREMENT
/begin MEASUREMENT PT_trqWhl "Istmoment (Radmoment)" SLONG TrqPrpHigh 1 100 -214748364.800 214748364.700 ECU_ADDRESS 0xD0002FAC /end MEASUREMENT
/begin MEASUREMENT PT_trqWhlBs "Basismoment (Radmoment)" SLONG TrqPrpHigh 1 100 -214748364.800 214748364.700 ECU_ADDRESS 0xD0002FB0 /end MEASUREMENT
/begin MEASUREMENT PT_trqWhlMaxEng "Maximales Radmoment vom Verbrennungsmotor" SLONG TrqPrpHigh 1 100 -214748364.800 214748364.700 ECU_ADDRESS 0xD0002FB4 /end MEASUREMENT
/begin MEASUREMENT PT_trqWhlMinEng "Minimales Radmoment vom Verbrennungsmotor" SLONG TrqPrpHigh 1 100 -214748364.800 214748364.700 ECU_ADDRESS 0xD0002FB8 /end MEASUREMENT
/begin MEASUREMENT PT_trqWhlMinWoCtOff "Minimales Radmoment mit Befeuerung vom Verbrennungsmotor" SLONG TrqPrpHigh 1 100 -214748364.800 214748364.700 ECU_ADDRESS 0xD0002FBC /end MEASUREMENT
/begin MEASUREMENT PT_trqWhlWoDstC "Radsistmoment ohne Antiruckeleingriff" SLONG TrqPrpHigh 1 100 -214748364.800 214748364.700 ECU_ADDRESS 0xD0002FC0 /end MEASUREMENT
/begin MEASUREMENT Qvc_status_1 "Ausgang für Schlüsselgröße 1" UBYTE Def_f_ub_b100 1 100 0.00 99.61 ECU_ADDRESS 0xC000B4B2 /end MEASUREMENT
/begin MEASUREMENT Qvc_status_2 "Ausgang für Schlüsselgröße 2" UBYTE Def_f_ub_b100 1 100 0.00 99.61 ECU_ADDRESS 0xC000B4B3 /end MEASUREMENT
/begin MEASUREMENT Qvc_status_3 "Ausgang für Schlüsselgröße 3" UBYTE Def_ql_ub_q1 1 100 0.00 255. FORMAT "%4.0" ECU_ADDRESS 0xC000B4B4 /end MEASUREMENT
/begin MEASUREMENT Qvc_status_4 "Ausgang für Schlüsselgröße 4" SBYTE Def_dez_sb_q1 1 100 -128. 127. FORMAT "%3.0" ECU_ADDRESS 0xC000B4B5 /end MEASUREMENT
/begin MEASUREMENT Qvh2o_btyp "Batterietyp: AGM = 1, Nass = 2" UBYTE Def_dez_ub_q1 1 100 0.00 255. FORMAT "%3.0" ECU_ADDRESS 0xC000B4AE /end MEASUREMENT
/begin MEASUREMENT Qvh2o_ft "Temperaturabhängige Zusatzrate" SWORD Def_f_sw_q0p01 1 100 -327.680 327.670 FORMAT "%7.3" ECU_ADDRESS 0xC000AB08 /end MEASUREMENT
/begin MEASUREMENT Qvh2o_rate "Wasserverbrauchsrate" UWORD Def_f_uw_q0p00047 1 100 0.00 30.719531 FORMAT "%9.6" ECU_ADDRESS 0xC000AB0A /end MEASUREMENT
/begin MEASUREMENT Qvh2o_xh2o "Einflussfaktor bisheriger Wasserverbrauch" SWORD Def_f_sw_q0p01 1 100 -327.680 327.670 FORMAT "%7.3" ECU_ADDRESS 0xC000AB0C /end MEASUREMENT
/begin MEASUREMENT Qvh2o_xhsum "Summe Verbrauch aus Verbrauchswert und Startwert" SWORD Def_f_sw_q0p01 1 100 -327.680 327.670 FORMAT "%7.3" ECU_ADDRESS 0xC000AB0E /end MEASUREMENT
/begin MEASUREMENT Qvh2o_xi "Einflussfaktor des Ladestroms" SWORD Def_f_sw_q0p01 1 100 -327.680 327.670 FORMAT "%7.3" ECU_ADDRESS 0xC000AB10 /end MEASUREMENT
/begin MEASUREMENT Qvh2o_xi20 "Quotient aus Ladestrom und I20" SWORD Def_f_sw_q0p01 1 100 -327.670 327.670 FORMAT "%7.3" ECU_ADDRESS 0xC000AB12 /end MEASUREMENT
/begin MEASUREMENT Qvh2o_xsoc "Einflussfaktor des Ladezustands und der Kapazität" SWORD Def_f_sw_q0p01 1 100 -327.680 327.670 FORMAT "%7.3" ECU_ADDRESS 0xC000AB14 /end MEASUREMENT
/begin MEASUREMENT Qvh2o_xt "Einflussfaktor der Temperatur" SWORD Def_f_sw_q0p01 1 100 -327.680 327.670 FORMAT "%7.3" ECU_ADDRESS 0xC000AB16 /end MEASUREMENT
/begin MEASUREMENT Qvh2o_xu "Einflussfaktor der Spannung" SWORD Def_f_sw_q0p01 1 100 -327.680 327.670 FORMAT "%7.3" ECU_ADDRESS 0xC000AB18 /end MEASUREMENT
/begin MEASUREMENT Qv_aktuell "Aktueller Qv-Wert" SWORD Def_f_sw_q0p1 1 100 -3276.80 3276.70 FORMAT "%7.2" ECU_ADDRESS 0xC000AB20 /end MEASUREMENT
/begin MEASUREMENT Qv_analyse "Internes Statusflag" SBYTE Def_dez_sb_q1 1 100 -128. 127. FORMAT "%3.0" ECU_ADDRESS 0xC000B4B6 /end MEASUREMENT
/begin MEASUREMENT Qv_bfenster "Anzahl der Qv-Werte im Betrachtungsfenster" UBYTE Def_dez_ub_q1 1 100 0.00 255. FORMAT "%3.0" ECU_ADDRESS 0xC000B4B7 /end MEASUREMENT
/begin MEASUREMENT Qv_clr "Kontrollgrenze für Qvc_rm" UWORD Def_f_uw_b8192 1 100 0.00 8191.88 FORMAT "%7.2" ECU_ADDRESS 0xC000AB22 /end MEASUREMENT
/begin MEASUREMENT Qv_codaus "Reduzierung der Qualität abhängig von der Anzahl der Ausreißer" ULONG Def_dez_ul_q1 1 100 0.00 4294967295. FORMAT "%7.0" ECU_ADDRESS 0xC00092B0 /end MEASUREMENT
/begin MEASUREMENT Qv_csc "current value of available storage capability" UWORD Def_f_uw_b1 1 100 0.00 0.9999847412109 FORMAT "%15.13" ECU_ADDRESS 0xC000AAB4 /end MEASUREMENT
/begin MEASUREMENT Qv_ez "Fehler bei der Schwerpunktgeradenberechnung" UWORD Def_f_uw_b0p5 1 100 0.00 0.4999923706055 FORMAT "%15.13" ECU_ADDRESS 0xC000AAB6 /end MEASUREMENT
/begin MEASUREMENT Qv_ez_sum "Summe des Fehlerwertes" UWORD Def_u_uw_q0p015 1 100 0.00 983.0250 FORMAT "%8.4" ECU_ADDRESS 0xC000AAB8 /end MEASUREMENT
/begin MEASUREMENT Qv_faktf "Zwischengröße Faktor Temperaturkompensation Ruhestrom" UWORD Def_u_uw_b25p5 1 100 0.00 25.499611 FORMAT "%9.6" ECU_ADDRESS 0xC000AABA /end MEASUREMENT
/begin MEASUREMENT Qv_grad "Gradient des Kapazitätsverlustes" SWORD Def_f_sw_q0p01 1 100 -327.680 327.670 FORMAT "%7.3" ECU_ADDRESS 0xC000AB24 /end MEASUREMENT
/begin MEASUREMENT Qv_grad_m "Steigung des gemittelten Kapazitätsverlustes" UBYTE Def_f_ub_b100 1 100 0.00 99.61 ECU_ADDRESS 0xC000B4B8 /end MEASUREMENT
/begin MEASUREMENT Qv_h "hysteresis" UWORD Def_u_uw_b25p5 1 100 0.049804688 12.451172 FORMAT "%9.6" ECU_ADDRESS 0xC000AABC /end MEASUREMENT
/begin MEASUREMENT Qv_h2o "Verbrauchtes Wasser pro CBattNenn" UWORD Def_f_uw_b64 1 100 0.00 63.999023 ECU_ADDRESS 0xC000AB1A /end MEASUREMENT
/begin MEASUREMENT Qv_h2oquali "Gütewert der Berechnung Qv_h2o (0 = sehr gut, 100 = sehr schlecht)" UBYTE Def_f_ub_b100 1 100 0.00 99.61 ECU_ADDRESS 0xC000B4AF /end MEASUREMENT
/begin MEASUREMENT Qv_h2ostatus "Status für Entwicklung Wasserverlust" UBYTE Def_ql_ub_q1 1 100 0.00 255. FORMAT "%4.0" ECU_ADDRESS 0xC000B4B0 /end MEASUREMENT
/begin MEASUREMENT Qv_h2o_sum "Summiert für jeden Berechnungsschritt die Wasserverbrauchsrate, wird bei jedem Motorstart auf 0 zurückgesetzt." ULONG Def_f_ul_q0p00047 1 100 0.00 2013265.920 FORMAT "%11.3" ECU_ADDRESS 0xC00092AC /end MEASUREMENT
/begin MEASUREMENT Qv_isp1 "Ordinatenwert für Schwerpunkt 1" UWORD Def_i_uw_b1024 1 100 0.00 1024. FORMAT "%5.0" ECU_ADDRESS 0xC000AABE /end MEASUREMENT
/begin MEASUREMENT Qv_isp1_sum "Stromsumme Qvary_i" UWORD Def_f_uw_q0p25 1 100 0.00 16383.50 FORMAT "%8.2" ECU_ADDRESS 0xC000AAC0 /end MEASUREMENT
/begin MEASUREMENT Qv_isp2 "Ordinatenwert für Schwerpunkt 2" UWORD Def_i_uw_b1024 1 100 0.00 1024. FORMAT "%5.0" ECU_ADDRESS 0xC000AAC2 /end MEASUREMENT
/begin MEASUREMENT Qv_isp2_sum "Stromsumme Qvary_i" UWORD Def_f_uw_q0p25 1 100 0.00 16383.50 FORMAT "%8.2" ECU_ADDRESS 0xC000AAC4 /end MEASUREMENT
/begin MEASUREMENT Qv_i_zw1 "Zwischengröße" SWORD Def_i_sw_q0p03125 1 100 -1024.000 1023.969 FORMAT "%8.3" ECU_ADDRESS 0xC000AAC6 /end MEASUREMENT
/begin MEASUREMENT Qv_k20 "Nennkapazität" UBYTE Def_ql_ub_q1 1 100 0.00 255. FORMAT "%4.0" ECU_ADDRESS 0xC000B49E /end MEASUREMENT
/begin MEASUREMENT Qv_k20ofs "Delta Kapazität aktuell - neue Batterie" UBYTE Def_ql_ub_q1 1 100 0.00 255. FORMAT "%4.0" ECU_ADDRESS 0xC000B49F /end MEASUREMENT
/begin MEASUREMENT Qv_lcl "Unteres Kontrollimit für Qv_out_m" SWORD Def_f_sw_q0p1 1 100 -3276.80 3276.70 FORMAT "%7.2" ECU_ADDRESS 0xC000AB26 /end MEASUREMENT
/begin MEASUREMENT Qv_m "Steigung der Hysteresegeraden" SWORD Def_f_sw_b0p03125 1 100 -0.0312004 0.0312490 FORMAT "%9.7" ECU_ADDRESS 0xC000AAC8 /end MEASUREMENT
/begin MEASUREMENT Qv_m_in "Gemittelte Kapazitätsverlust zur internen Verarbeitung" UWORD Def_td_uw_q0p1 1 100 0.00 6553.5 FORMAT "%6.1" ECU_ADDRESS 0xC000AB28 /end MEASUREMENT
/begin MEASUREMENT Qv_n "Zähler für die Schwerpunktberechnung" UBYTE Def_dez_ub_q1 1 100 0.00 255. FORMAT "%3.0" ECU_ADDRESS 0xC000B4A0 /end MEASUREMENT
/begin MEASUREMENT Qv_nsp1 "Zähler für die Schwerpunktberechnung" UBYTE Def_dez_ub_q1 1 100 0.00 255. FORMAT "%3.0" ECU_ADDRESS 0xC000B4A1 /end MEASUREMENT
/begin MEASUREMENT Qv_nsp2 "Zähler für die Schwerpunktberechnung" UBYTE Def_dez_ub_q1 1 100 0.00 255. FORMAT "%3.0" ECU_ADDRESS 0xC000B4A2 /end MEASUREMENT
/begin MEASUREMENT Qv_nv_ezm "mean error value of all hysteresis calculations" SWORD Def_f_sw_b32 1 100 0.00 1.0000000 FORMAT "%9.7" ECU_ADDRESS 0xC000AACA /end MEASUREMENT
/begin MEASUREMENT Qv_nv_start "loss of capacity calculated from engine start" SBYTE Def_ql_sb_q1 1 100 -128. 127. FORMAT "%3.0" ECU_ADDRESS 0xC000B4A3 /end MEASUREMENT
/begin MEASUREMENT Qv_nv_zh "Anzahl der Hystereseauswertungen" ULONG Def_dez_ul_q1 1 100 0.00 4294967295. FORMAT "%7.0" ECU_ADDRESS 0xC00092A8 /end MEASUREMENT
/begin MEASUREMENT Qv_n_fehlmes "Anzahl fehlender Ruhespannungsmessungen" UBYTE Def_f_ub_b8 1 100 0.00 7.969 ECU_ADDRESS 0xC000B4A4 /end MEASUREMENT
/begin MEASUREMENT Qv_outm_int "Berechnete gemittelte Kapazitätsverlust" UWORD Def_td_uw_q0p1 1 100 0.00 6553.5 FORMAT "%6.1" ECU_ADDRESS 0xC000AB2A /end MEASUREMENT
/begin MEASUREMENT Qv_out_1 "Kapazitätsverlust letzter Start" SBYTE Def_ql_sb_q1 1 100 -128. 127. FORMAT "%3.0" ECU_ADDRESS 0xC000B4B9 /end MEASUREMENT
/begin MEASUREMENT Qv_out_2 "Kapazitätsverlust 2. letzter Start" SBYTE Def_ql_sb_q1 1 100 -128. 127. FORMAT "%3.0" ECU_ADDRESS 0xC000B4BA /end MEASUREMENT
/begin MEASUREMENT Qv_out_3 "Kapazitätsverlust 3. letzter Start" SBYTE Def_ql_sb_q1 1 100 -128. 127. FORMAT "%3.0" ECU_ADDRESS 0xC000B4BB /end MEASUREMENT
/begin MEASUREMENT Qv_out_4 "Kapazitätsverlust 4. letzter Start" SBYTE Def_ql_sb_q1 1 100 -128. 127. FORMAT "%3.0" ECU_ADDRESS 0xC000B4BC /end MEASUREMENT
/begin MEASUREMENT Qv_out_5 "Kapazitätsverlust 5. letzter Start" SBYTE Def_ql_sb_q1 1 100 -128. 127. FORMAT "%3.0" ECU_ADDRESS 0xC000B4BD /end MEASUREMENT
/begin MEASUREMENT Qv_out_m "Gültiger gemittelter Kapazitätsverlust (Ausgabe)" UBYTE Def_f_ub_b100 1 100 0.00 99.61 ECU_ADDRESS 0xC000B4BE /end MEASUREMENT
/begin MEASUREMENT Qv_quali_1 "Qualitätsindex letzter Qv-Wert" UBYTE Def_f_ub_b100 1 100 0.00 99.61 ECU_ADDRESS 0xC000B4BF /end MEASUREMENT
/begin MEASUREMENT Qv_quali_2 "Qualitätsindex 2. letzter Qv-Wert" UBYTE Def_f_ub_b100 1 100 0.00 99.61 ECU_ADDRESS 0xC000B4C0 /end MEASUREMENT
/begin MEASUREMENT Qv_quali_3 "Qualitätsindex 3. letzter Qv-Wert" UBYTE Def_f_ub_b100 1 100 0.00 99.61 ECU_ADDRESS 0xC000B4C1 /end MEASUREMENT
/begin MEASUREMENT Qv_quali_4 "Qualitätsindex 4. letzter Qv-Wert" UBYTE Def_f_ub_b100 1 100 0.00 99.61 ECU_ADDRESS 0xC000B4C2 /end MEASUREMENT
/begin MEASUREMENT Qv_quali_5 "Qualitätsindex 5. letzter Qv-Wert" UBYTE Def_f_ub_b100 1 100 0.00 99.61 ECU_ADDRESS 0xC000B4C3 /end MEASUREMENT
/begin MEASUREMENT Qv_quali_int "Qualität des gemittelten Kapazitätsverlustes" UBYTE Def_f_ub_b100 1 100 0.00 99.61 ECU_ADDRESS 0xC000B4C4 /end MEASUREMENT
/begin MEASUREMENT Qv_quali_m "Qualitätsindex für gemittelten Qv-Wert" UBYTE Def_f_ub_b100 1 100 0.00 99.61 ECU_ADDRESS 0xC000B4C5 /end MEASUREMENT
/begin MEASUREMENT Qv_q_stat "Zustandsvariable" UWORD Def_dez_uw_q1 1 100 0.00 65535. FORMAT "%5.0" ECU_ADDRESS 0xC000AB2C /end MEASUREMENT
/begin MEASUREMENT Qv_r "Aktuelle Streuung" UBYTE Def_ql_ub_q1 1 100 0.00 255. FORMAT "%4.0" ECU_ADDRESS 0xC000B4C6 /end MEASUREMENT
/begin MEASUREMENT Qv_ra "Fit Parameter Batterie" SWORD Def_f_sw_b8 1 100 -8.0000000 7.9997559 ECU_ADDRESS 0xC000AACC /end MEASUREMENT
/begin MEASUREMENT Qv_rb "Fit Parameter Batterie" SWORD Def_f_sw_b8 1 100 -8.0000000 7.9997559 ECU_ADDRESS 0xC000AACE /end MEASUREMENT
/begin MEASUREMENT Qv_rc "Fit Parameter Batterie" SWORD Def_f_sw_b8 1 100 -8.0000000 7.9997559 ECU_ADDRESS 0xC000AAD0 /end MEASUREMENT
/begin MEASUREMENT Qv_rc_zwi "Zwischengröße" SWORD Def_f_sw_b8 1 100 -8.0000000 7.9997559 ECU_ADDRESS 0xC000AAD2 /end MEASUREMENT
/begin MEASUREMENT Qv_rm "Mittelwert der Streuung" UBYTE Def_dez_ub_q1 1 100 0.00 255. FORMAT "%3.0" ECU_ADDRESS 0xC000B4C7 /end MEASUREMENT
/begin MEASUREMENT Qv_rm_int "Mittelwert der Streuung" UWORD Def_f_uw_b100 1 100 0.00 99.99847 ECU_ADDRESS 0xC000AB2E /end MEASUREMENT
/begin MEASUREMENT Qv_sfenster "Anzahl der Ausreißer im Betrachtungsfenster zur Sprungerkennung" UBYTE Def_dez_ub_q1 1 100 0.00 255. FORMAT "%3.0" ECU_ADDRESS 0xC000B4C8 /end MEASUREMENT
/begin MEASUREMENT Qv_soc_grob "QVC CalcHyst - grob berechneter SoC zur Ruhephase" UWORD Def_f_uw_b1 1 100 0.00 0.9999847412109 FORMAT "%15.13" ECU_ADDRESS 0xC000AAD4 /end MEASUREMENT
/begin MEASUREMENT Qv_stand "Statusflag Lange Standzeit" SBYTE Def_dez_sb_q1 1 100 -128. 127. FORMAT "%3.0" ECU_ADDRESS 0xC000B4C9 /end MEASUREMENT
/begin MEASUREMENT Qv_start_aktuell "loss of capacity calculated from engine start (currently)" UBYTE Def_ql_ub_q1 1 100 0.00 255. FORMAT "%4.0" ECU_ADDRESS 0xC000B4A5 /end MEASUREMENT
/begin MEASUREMENT Qv_stat "Zustandsvariable" UBYTE Def_dez_ub_q1 1 100 0.00 255. FORMAT "%3.0" ECU_ADDRESS 0xC000B4A6 /end MEASUREMENT
/begin MEASUREMENT Qv_status "Prozessstatus / Trend für gemittelten Qv-Wert" SBYTE Def_dez_sb_q1 1 100 -128. 127. FORMAT "%3.0" ECU_ADDRESS 0xC000B4CA /end MEASUREMENT
/begin MEASUREMENT Qv_td1 "Zeitstempel des letzten gültigen Motorstarts (d.h. desjenigen vor dem aktuellen Motorstarts" UWORD Def_th_uw_q1 1 100 0.00 65535. FORMAT "%5.0" ECU_ADDRESS 0xC000AB30 /end MEASUREMENT
/begin MEASUREMENT Qv_td2 "Zeitstempel des zweitetzten gültigen Motorstarts" UWORD Def_th_uw_q1 1 100 0.00 65535. FORMAT "%5.0" ECU_ADDRESS 0xC000AB32 /end MEASUREMENT
/begin MEASUREMENT Qv_td3 "Zeitstempel des drittletzten gültigen Motorstarts" UWORD Def_th_uw_q1 1 100 0.00 65535. FORMAT "%5.0" ECU_ADDRESS 0xC000AB34 /end MEASUREMENT
/begin MEASUREMENT Qv_td4 "Zeitstempel des viertletzten gültigen Motorstarts" UWORD Def_th_uw_q1 1 100 0.00 65535. FORMAT "%5.0" ECU_ADDRESS 0xC000AB36 /end MEASUREMENT
/begin MEASUREMENT Qv_td5 "Zeitstempel des fünftletzten gültigen Motorstarts" UWORD Def_th_uw_q1 1 100 0.00 65535. FORMAT "%5.0" ECU_ADDRESS 0xC000AB38 /end MEASUREMENT
/begin MEASUREMENT Qv_timer "Timer - wird im QVC zur Zeit nicht verwendet" UWORD Def_td_uw_q0p1 1 100 0.00 6553.5 FORMAT "%6.1" ECU_ADDRESS 0xC000AAD6 /end MEASUREMENT
/begin MEASUREMENT Qv_t_i "Einzelwert I aus Motorstartauswertung" SWORD Def_i_sw_q0p125 1 100 -4096.000 4095.875 FORMAT "%8.3" ECU_ADDRESS 0xC000AAD8 /end MEASUREMENT
/begin MEASUREMENT Qv_t_ruhzeit "Abstellzeit Fahrzeug" UWORD Def_td_uw_q1 1 100 0.00 65535. FORMAT "%5.0" ECU_ADDRESS 0xC000AADA /end MEASUREMENT
/begin MEASUREMENT Qv_t_u "Einzelwert U aus Motorstartauswertung" SWORD Def_f_sw_b32 1 100 6.0000000 16.000000 ECU_ADDRESS 0xC000AADC /end MEASUREMENT
/begin MEASUREMENT Qv_u00 "U00 (Endergebnis aus Berechnung in QVC)" UWORD Def_u_uw_b25p5 1 100 0.00 25.499611 FORMAT "%9.6" ECU_ADDRESS 0xC000AADE /end MEASUREMENT
/begin MEASUREMENT Qv_Ub00_25grd "berechnete Ruhespannung, bezogen auf 25 grdC" UWORD Def_u_uw_b25p5 1 100 0.00 25.499611 FORMAT "%9.6" ECU_ADDRESS 0xC000AAE0 /end MEASUREMENT
/begin MEASUREMENT Qv_ubatt_ber "Klemmenspannung der Batterie, Implementierung ohne Offset" SWORD Def_u_sw_b128 1 100 -128.0000 127.9961 FORMAT "%8.4" ECU_ADDRESS 0xC000AB1C /end MEASUREMENT
/begin MEASUREMENT Qv_ucl "Oberes Kontrolllimit für Qv_out_m" SWORD Def_f_sw_q0p1 1 100 -3276.80 3276.70 FORMAT "%7.2" ECU_ADDRESS 0xC000AB3A /end MEASUREMENT
/begin MEASUREMENT Qv_usp1 "Koordinatenwert für Schwerpunkt 1" UWORD Def_u_uw_b25p5 1 100 0.00 25.499611 FORMAT "%9.6" ECU_ADDRESS 0xC000AAE2 /end MEASUREMENT
/begin MEASUREMENT Qv_usp1_sum "Spannungssumme Qvary_u" UWORD Def_u_uw_q0p00488 1 100 0.00 319.9951 FORMAT "%8.4" ECU_ADDRESS 0xC000AAE4 /end MEASUREMENT
/begin MEASUREMENT Qv_usp2 "Koordinatenwert für Schwerpunkt 2" UWORD Def_u_uw_b25p5 1 100 0.00 25.499611 FORMAT "%9.6" ECU_ADDRESS 0xC000AAE6 /end MEASUREMENT
/begin MEASUREMENT Qv_usp2_sum "Spannungssumme Qvary_u" UWORD Def_u_uw_q0p00488 1 100 0.00 319.9951 FORMAT "%8.4" ECU_ADDRESS 0xC000AAE8 /end MEASUREMENT
/begin MEASUREMENT Qv_u_0l "denormalized value of Qv_u0l" UWORD Def_u_uw_b25p5 1 100 0.00 25.499611 FORMAT "%9.6" ECU_ADDRESS 0xC000AAEA /end MEASUREMENT
/begin MEASUREMENT Qv_u_0u "Zwischengrösse" UWORD Def_u_uw_b25p5 1 100 0.00 25.499611 FORMAT "%9.6" ECU_ADDRESS 0xC000AAEC /end MEASUREMENT
/begin MEASUREMENT Qv_u_zw1 "Zwischengröße" SWORD Def_u_sw_q0p00025 1 100 -8.1100000 8.1917500 ECU_ADDRESS 0xC000AAEE /end MEASUREMENT
/begin MEASUREMENT Qv_u_zw2 "Zwischengröße" UWORD Def_f_uw_b16 1 100 0.00 15.999756 FORMAT "%9.6" ECU_ADDRESS 0xC000AAF0 /end MEASUREMENT
/begin MEASUREMENT Qv_u_zw3 "Zwischengröße" SWORD Def_f_sw_b0p125 1 100 -0.123749 0.124996 FORMAT "%8.6" ECU_ADDRESS 0xC000AAF2 /end MEASUREMENT
/begin MEASUREMENT Qv_u_zw4 "Zwischengröße" SWORD Def_f_sw_b0p125 1 100 -0.123749 0.124996 FORMAT "%8.6" ECU_ADDRESS 0xC000AAF4 /end MEASUREMENT
/begin MEASUREMENT Qv_u_zw5 "Zwischengröße" SWORD Def_u_sw_q0p00025 1 100 -8.1920000 8.1917500 ECU_ADDRESS 0xC000AAF6 /end MEASUREMENT
/begin MEASUREMENT QWC_CEngDsT_mp "Kühlwassertemperatur als Eingangsgröße für Temperaturberechnung der QWC" SWORD Temp_Cels 1 100 -3549.940 3003.560 ECU_ADDRESS 0xC000AB3C /end MEASUREMENT
/begin MEASUREMENT QWC_facFTS "Faktor der Druckwellenkorrektur abhängig von der Kraftstofftemperatur" SWORD Fact 1 100 -4.000000 3.999878 ECU_ADDRESS 0xD0001276 /end MEASUREMENT
/begin MEASUREMENT QWC_facMI1PoI2_mp "Gewichtungsfaktor zur Aktivierung/Deaktivierung der Druckwellenmengenänderung von MI1 durch PoI2" SWORD Fact1 1 100 -256.0000 255.9922 ECU_ADDRESS 0xC000AB40 /end MEASUREMENT
/begin MEASUREMENT QWC_facPiI2PiI1_mp "Gewichtungsfaktor zur Aktivierung/Deaktivierung der Druckwellenmengenänderung von PiI2 durch PiI1" SWORD Fact1 1 100 -256.0000 255.9922 ECU_ADDRESS 0xC000AB42 /end MEASUREMENT
/begin MEASUREMENT QWC_facPiIMI1_mp "Gewichtungsfaktor zur Aktivierung/Deaktivierung der Druckwellenmengenänderung von PiI1 durch MI1" SWORD Fact1 1 100 -256.0000 255.9922 ECU_ADDRESS 0xC000AB44 /end MEASUREMENT
/begin MEASUREMENT QWC_facPoI2PoI1_mp "" SWORD Fact1 1 100 -256.0000 255.9922 ECU_ADDRESS 0xC000AB46 /end MEASUREMENT
/begin MEASUREMENT QWC_FuelT_mp "Kraftstofftemperatur als Eingangsgröße für Temperaturberechnung der QWC" SWORD Temp_Cels 1 100 -3549.940 3003.560 ECU_ADDRESS 0xC000AB3E /end MEASUREMENT
/begin MEASUREMENT QWC_pCurrInDiffHyd_mp "Aktueller Raildruck als Eingangswert für das Kennfeld QWC_tiDiffHyd_MAP" SWORD Pres_Rail 1 100 -3276.800 2000.000 ECU_ADDRESS 0xC000AB6C /end MEASUREMENT
/begin MEASUREMENT QWC_qDesInDiffHyd_mp "Gewünschte Einspritzmenge als Eingangswert für das Kennfeld QWC_tiDiffHyd_MAP" SWORD InjMassInj 1 100 -327.6800 327.6700 ECU_ADDRESS 0xC000AB6E /end MEASUREMENT
/begin MEASUREMENT QWC_qMI1 "Druckwellenkorrekturmenge der MI1" SWORD InjMass 1 100 -327.6800 327.6700 ECU_ADDRESS 0xD0001278 /end MEASUREMENT
/begin MEASUREMENT QWC_qMI1PoI2_mp "Grundwert der Druckwellenkorrekturmenge der MI1 abhängig von PoI2" SWORD InjMass 1 100 -327.6800 327.6700 ECU_ADDRESS 0xC000AB48 /end MEASUREMENT
/begin MEASUREMENT QWC_qNorm "Einspritznormierungsmenge" SWORD InjMass 1 100 -327.6800 327.6700 ECU_ADDRESS 0xD000127A /end MEASUREMENT
/begin MEASUREMENT QWC_qPiI1 "Druckwellenkorrekturmenge der PiI1" SWORD InjMass 1 100 -327.6800 327.6700 ECU_ADDRESS 0xD000127C /end MEASUREMENT
/begin MEASUREMENT QWC_qPiI1MI1_mp "Grundwert der Druckwellenkorrekturmenge der PiI1 abhängig von MI1" SWORD InjMass 1 100 -327.6800 327.6700 ECU_ADDRESS 0xC000AB4A /end MEASUREMENT
/begin MEASUREMENT QWC_qPiI2MI1_mp "Grundwert der Druckwellenkorrekturmenge der PiI2 abhängig von MI1" SWORD InjMass 1 100 -327.6800 327.6700 ECU_ADDRESS 0xC000AB4C /end MEASUREMENT
/begin MEASUREMENT QWC_qPiI2PiI1_mp "Grundwert der Druckwellenkorrekturmenge der PiI2 abhängig von PiI1" SWORD InjMass 1 100 -327.6800 327.6700 ECU_ADDRESS 0xC000AB4E /end MEASUREMENT
/begin MEASUREMENT QWC_qPoI1 "" SWORD InjMass 1 100 -327.6800 327.6700 ECU_ADDRESS 0xD000127E /end MEASUREMENT
/begin MEASUREMENT QWC_qPoI2 "Druckwellenkorrekturmenge der PoI2" SWORD InjMass 1 100 -327.6800 327.6700 ECU_ADDRESS 0xD0001280 /end MEASUREMENT
/begin MEASUREMENT QWC_qPoI2PoI1Cor_mp "" SWORD InjMass 1 100 -327.6800 327.6700 ECU_ADDRESS 0xC000AB50 /end MEASUREMENT
/begin MEASUREMENT QWC_qPoI2PoI1_mp "" SWORD InjMass 1 100 -327.6800 327.6700 ECU_ADDRESS 0xC000AB52 /end MEASUREMENT
/begin MEASUREMENT QWC_rMI1Norm_mp "Raildruckabhängiges normiertes MiI1 Einspritzverhältnis für Druckwellenkorrektur" SWORD QntR 1 100 -32.00000 31.99902 FORMAT "%8.5" ECU_ADDRESS 0xC000AB54 /end MEASUREMENT
/begin MEASUREMENT QWC_rPoI2Norm_mp "" SWORD QntR 1 100 -32.00000 31.99902 FORMAT "%8.5" ECU_ADDRESS 0xC000AB56 /end MEASUREMENT
/begin MEASUREMENT QWC_st "Status der Druckwellenkorrektur" UBYTE QWC_st_VERB 1 100 0.00 1.00000000000 FORMAT "%13.11" ECU_ADDRESS 0xD000206C /end MEASUREMENT
/begin MEASUREMENT QWC_tCor "Eingangstemperatur für die Druckwellenkorrektur" SWORD Temp_Cels 1 100 -3549.940 3003.560 ECU_ADDRESS 0xD0001282 /end MEASUREMENT
/begin MEASUREMENT QWC_tiMI1DiffHydCor_mp "Differenz zwischen hydraulischem Nadelschliessende und elektrischem Ansteuerende des Injektors für die MI1" SWORD InjTime_us 1 100 -13107.20 5000.00 ECU_ADDRESS 0xC000AB70 /end MEASUREMENT
/begin MEASUREMENT QWC_tiMI1PoI2Cor_mp "Korrigierter Zeitabstand zwischen MI1 und PoI1" SWORD InjTime_us 1 100 -13107.20 5000.00 ECU_ADDRESS 0xC000AB58 /end MEASUREMENT
/begin MEASUREMENT QWC_tiMI1PoI2_mp "Zeitabstand Ende MI1 bis Beginn PoI2" SWORD InjTime_us 1 100 -13107.20 5000.00 ECU_ADDRESS 0xC000AB5A /end MEASUREMENT
/begin MEASUREMENT QWC_tiPiI1DiffHydCor_mp "Differenz zwischen hydraulischem Nadelschliessende und elektrischem Ansteuerende des Injektors für die PiI1" SWORD InjTime_us 1 100 -13107.20 5000.00 ECU_ADDRESS 0xC000AB72 /end MEASUREMENT
/begin MEASUREMENT QWC_tiPiI1MI1Cor_mp "Korrigierter Zeitabstand zwischen PiI1 und MI1" SWORD InjTime_us 1 100 -13107.20 5000.00 ECU_ADDRESS 0xC000AB5C /end MEASUREMENT
/begin MEASUREMENT QWC_tiPiI1MI1_mp "Zeitabstand Ende PiI1 bis Beginn MI1" UWORD InjTime_us 1 100 0.00 5000.00 ECU_ADDRESS 0xC000AB5E /end MEASUREMENT
/begin MEASUREMENT QWC_tiPiI2DiffHydCor_mp "Differenz zwischen hydraulischem Nadelschliessende und elektrischem Ansteuerende des Injektors für die PiI2" SWORD InjTime_us 1 100 -13107.20 5000.00 ECU_ADDRESS 0xC000AB74 /end MEASUREMENT
/begin MEASUREMENT QWC_tiPiI2MI1Cor_mp "Korrigierter Zeitabstand zwischen PiI2 und MI1" SWORD InjTime_us 1 100 -13107.20 5000.00 ECU_ADDRESS 0xC000AB60 /end MEASUREMENT
/begin MEASUREMENT QWC_tiPiI2MI1_mp "Zeitabstand Ende PiI2 bis Beginn MI1" UWORD InjTime_us 1 100 0.00 5000.00 ECU_ADDRESS 0xC000AB62 /end MEASUREMENT
/begin MEASUREMENT QWC_tiPiI2PiI1Cor_mp "Korrigierter Zeitabstand zwischen PiI2 und PiI1" SWORD InjTime_us 1 100 -13107.20 5000.00 ECU_ADDRESS 0xC000AB64 /end MEASUREMENT
/begin MEASUREMENT QWC_tiPiI2PiI1_mp "Zeitabstand Ende PiI2 bis Beginn PiI1" UWORD InjTime_us 1 100 0.00 5000.00 ECU_ADDRESS 0xC000AB66 /end MEASUREMENT
/begin MEASUREMENT QWC_tiPoI2DiffHydCor_mp "" SWORD InjTime_us 1 100 -13107.20 5000.00 ECU_ADDRESS 0xC000AB76 /end MEASUREMENT
/begin MEASUREMENT QWC_tiPoI2PoI1Cor_mp "" SWORD InjTime_us 1 100 -13107.20 5000.00 ECU_ADDRESS 0xC000AB68 /end MEASUREMENT
/begin MEASUREMENT QWC_tiPoI2PoI1_mp "" SWORD InjTime_us 1 100 -13107.20 5000.00 ECU_ADDRESS 0xC000AB6A /end MEASUREMENT
/begin MEASUREMENT RadSht_stCond_mp "" UBYTE OneToOne 1 100 0.00 255.0 ECU_ADDRESS 0xC000B4CB /end MEASUREMENT
/begin MEASUREMENT RadSht_stConsumFF_mp "" UBYTE OneToOne 1 100 0.00 255.0 ECU_ADDRESS 0xC000B4CC /end MEASUREMENT
/begin MEASUREMENT RadSht_stConsum_mp "" UBYTE OneToOne 1 100 0.00 255.0 ECU_ADDRESS 0xC000B4CD /end MEASUREMENT
/begin MEASUREMENT RadSht_stFanAftRun_mp "" UBYTE OneToOne 1 100 0.00 255.0 ECU_ADDRESS 0xC000B4CE /end MEASUREMENT
/begin MEASUREMENT RadSht_stLogic_mp "" UWORD OneToOne 1 100 0.00 65535.00 ECU_ADDRESS 0xC000AB78 /end MEASUREMENT
/begin MEASUREMENT RailP_ctGradExcd_mp "Anzahl detektierter Drucksprünge" UWORD OneToOne 1 100 0.00 65535.00 ECU_ADDRESS 0xC000AB86 /end MEASUREMENT
/begin MEASUREMENT RailP_pCurr_mp "aktueller Kraftstoffdruck" SWORD Pres_Rail 1 100 -3276.800 2000.000 ECU_ADDRESS 0xC000AB84 /end MEASUREMENT
/begin MEASUREMENT RailP_pFlt "maximaler Raildruck der letzten 10ms" SWORD Pres_Rail 1 100 -3276.800 2000.000 ECU_ADDRESS 0xD0001284 /end MEASUREMENT
/begin MEASUREMENT RailP_pFltWinNeg_mp "Raildruckabfall, ab welchem auf Großsignalparameter umgeschaltet wird" SWORD Pres_Rail 1 100 -3276.800 2000.000 ECU_ADDRESS 0xC000AB82 /end MEASUREMENT
/begin MEASUREMENT RailP_pLin "linearisierter Wert des Kraftstoffdrucksensors" SWORD Pres_Rail 1 100 -3276.800 2000.000 ECU_ADDRESS 0xD0001286 /end MEASUREMENT
/begin MEASUREMENT RailP_pLinCurr_mp "SRC-Maximum Vorgabewert" SWORD Pres_Rail 1 100 -3276.800 2000.000 ECU_ADDRESS 0xC000AB7A /end MEASUREMENT
/begin MEASUREMENT RailP_stEngStrtMov_mp "Motorbewegung bei Offset-Überwachung des Raildrucksensors festgestellt" UBYTE OneToOne 1 100 0.00 255.0 ECU_ADDRESS 0xC000B4D0 /end MEASUREMENT
/begin MEASUREMENT RailP_stERS_mp "Indikator ob Motor in diesem FAhrzyklus lief für Raildruck-Offset-Test" SWORD OneToOne 1 100 -32768.00 32767.00 ECU_ADDRESS 0xC000AB88 /end MEASUREMENT
/begin MEASUREMENT RailP_stGrad "Status des Gradiententests" UBYTE OneToOne 1 100 0.00 255.0 ECU_ADDRESS 0xD0002071 /end MEASUREMENT
/begin MEASUREMENT RailP_stMon_mp "Überwachungsstatus des Spannungsoffsets des Raildrucksensors" UBYTE OneToOne 1 100 0.00 255.0 ECU_ADDRESS 0xC000B4D1 /end MEASUREMENT
/begin MEASUREMENT RailP_stOfsTstMon "aktueller Zustand der Offset-Überwachung für den Raildrucksensor" UBYTE OneToOne 1 100 0.00 255.0 ECU_ADDRESS 0xD0002072 /end MEASUREMENT
/begin MEASUREMENT RailP_stSRCCurr_mp "SRC-Maximum Vorgabewert" UBYTE OneToOne 1 100 0.00 255.0 ECU_ADDRESS 0xC000B4CF /end MEASUREMENT
/begin MEASUREMENT RailP_stSubsVal "status für Raildruck Ersatzwert im Fehlerfall" UBYTE OneToOne 1 100 0.00 255.0 ECU_ADDRESS 0xD0002073 /end MEASUREMENT
/begin MEASUREMENT RailP_tClntLstCyc_mp "Wassertemperatur vom letzten Fahrzyklus für die Offset-Überwachung des Raildrucksensors" SWORD Temp_Cels 1 100 -3549.940 3003.560 ECU_ADDRESS 0xC000AB8A /end MEASUREMENT
/begin MEASUREMENT RailP_tidPresRst_mp "Zeit der Heilung des Drucksprungzählers." SLONG Time_ms 1 100 -21474836480.0 21474836470.0 ECU_ADDRESS 0xC00092B8 /end MEASUREMENT
/begin MEASUREMENT RailP_tiFltPT1_mp "momentane Filterzeit für PT1 Filter" ULONG TimeDelay_s 1 100 0.000001000000000 4294.9672960 FORMAT "%12.7" ECU_ADDRESS 0xC00092B4 /end MEASUREMENT
/begin MEASUREMENT RailP_tiOfsTstDel_mp "Verzögerungszeit = f(RailP_pFlt) für Offset-Test des Raildrucksensors" SWORD TimeRed 1 100 -5242.880 5242.720 FORMAT "%8.3" ECU_ADDRESS 0xC000AB8C /end MEASUREMENT
/begin MEASUREMENT RailP_uOfsAftRun "Spannungswert des Raildrucksensors während aktiver Überwachung im Nachlauf" SWORD Volt 1 100 -6553.600 6553.400 ECU_ADDRESS 0xD0001288 /end MEASUREMENT
/begin MEASUREMENT RailP_uOfsAftRunMax "obere Offsetschwelle der Offset-Überwachung des Raildrucksensors im Nachlauf" SWORD Volt 1 100 -6553.600 6553.400 ECU_ADDRESS 0xD000128A /end MEASUREMENT
/begin MEASUREMENT RailP_uOfsAftRunMin "untere Offsetschwelle der Offset-Überwachung des Raildrucksensors im Nachlauf" SWORD Volt 1 100 -6553.600 6553.400 ECU_ADDRESS 0xD000128C /end MEASUREMENT
/begin MEASUREMENT RailP_uOfsStrt "Spannungswert des Raildrucksensors während aktiver Überwachung in der Startphase" SWORD Volt 1 100 -6553.600 6553.400 ECU_ADDRESS 0xD000128E /end MEASUREMENT
/begin MEASUREMENT RailP_uOfsStrtMax "obere Offsetschwelle der Offset-Überwachung des Raildrucksensors im Start" SWORD Volt 1 100 -6553.600 6553.400 ECU_ADDRESS 0xD0001290 /end MEASUREMENT
/begin MEASUREMENT RailP_uOfsStrtMin "untere Offsetschwelle der Offset-Überwachung des Raildrucksensors im Start" SWORD Volt 1 100 -6553.600 6553.400 ECU_ADDRESS 0xD0001292 /end MEASUREMENT
/begin MEASUREMENT RailP_uRaw "Rohwert des Raildrucks" SWORD Volt 1 100 -6553.600 6553.400 ECU_ADDRESS 0xD0001294 /end MEASUREMENT
/begin MEASUREMENT RailP_uRawMax "maximaler Rohspannungswert des Raildrucks vom ADC" SWORD OneToOne 1 100 -32768.00 32767.00 ECU_ADDRESS 0xC000AB80 /end MEASUREMENT
/begin MEASUREMENT RailP_uRawNoCorCur_mp "nicht korrigierte Ausgangsspannung des Raildrucksensors" SWORD Volt 1 100 -6553.600 6553.400 ECU_ADDRESS 0xC000AB7C /end MEASUREMENT
/begin MEASUREMENT RailP_uRawNoCor_mp "nicht korrigierter Raildruckspannungswert" SWORD Volt 1 100 -6553.600 6553.400 ECU_ADDRESS 0xC000AB7E /end MEASUREMENT
/begin MEASUREMENT Rail_cntHpTst_mp "Aktulle Phase des HpTst" UBYTE OneToOne 1 100 0.00 255.0 ECU_ADDRESS 0xC000B4D4 /end MEASUREMENT
/begin MEASUREMENT Rail_cntInjHpTst_mp "Zähler für Einspritzungen im HpTst" UBYTE OneToOne 1 100 0.00 255.0 ECU_ADDRESS 0xC000B4D5 /end MEASUREMENT
/begin MEASUREMENT Rail_dvolCPCDvtFlt_mp "gefilterte Volumenstromabweichung" SWORD Qp_mm3_sec 1 100 -327680.0 327670.0 FORMAT "%8.1" ECU_ADDRESS 0xC000AB8E /end MEASUREMENT
/begin MEASUREMENT Rail_dvolCPCDvt_mp "selektierte Volumenstromabweichung" SWORD Qp_mm3_sec 1 100 -327680.0 327670.0 FORMAT "%8.1" ECU_ADDRESS 0xC000AB90 /end MEASUREMENT
/begin MEASUREMENT Rail_dvolEstAged "geschätzter Volumenstrom eines gealterten Systems" SWORD Qp_mm3_sec 1 100 -327680.0 327670.0 FORMAT "%8.1" ECU_ADDRESS 0xD000129A /end MEASUREMENT
/begin MEASUREMENT Rail_dvolMeUnCtlDT1_mp "DT1-Anteil des Druckreglers über Zumesseinheit" SWORD Qp_mm3_sec 1 100 -327680.0 327670.0 FORMAT "%8.1" ECU_ADDRESS 0xC000AB92 /end MEASUREMENT
/begin MEASUREMENT Rail_dvolMeUnCtlI "I-Anteil des Druckreglers der Zumesseinheit" SWORD Qp_mm3_sec 1 100 -327680.0 327670.0 FORMAT "%8.1" ECU_ADDRESS 0xD000129C /end MEASUREMENT
/begin MEASUREMENT Rail_dvolMeUnCtlP_mp "P-Anteil des Druckreglers über Zumesseinheit" SWORD Qp_mm3_sec 1 100 -327680.0 327670.0 FORMAT "%8.1" ECU_ADDRESS 0xC000AB94 /end MEASUREMENT
/begin MEASUREMENT Rail_dvolMeUnCtlType_mp "Wert zur Schuberkennung" SWORD Qp_mm3_sec 1 100 -327680.0 327670.0 FORMAT "%8.1" ECU_ADDRESS 0xC000ABBC /end MEASUREMENT
/begin MEASUREMENT Rail_dvolMeUnCtlUpLim "obere Stellwertbegrenzung für Druckregelung über Zumesseinheit" SWORD Qp_mm3_sec 1 100 -327680.0 327670.0 FORMAT "%8.1" ECU_ADDRESS 0xD000129E /end MEASUREMENT
/begin MEASUREMENT Rail_dvolMeUnDvt "Regelabweichung des Volumenstroms" SWORD Qp_mm3_sec 1 100 -327680.0 327670.0 FORMAT "%8.1" ECU_ADDRESS 0xD00012A0 /end MEASUREMENT
/begin MEASUREMENT Rail_dvolMeUnLimFst_mp "Maximal zulässiger Stellwert MeUn für Raildrucküberwachung als Funktion des Stellwertes der Zumesseinheit" SWORD Qp_mm3_sec 1 100 -327680.0 327670.0 FORMAT "%8.1" ECU_ADDRESS 0xC000ABD4 /end MEASUREMENT
/begin MEASUREMENT Rail_dvolMeUnShutOff_mp "selektierter Volumenstrom beim Abstellen des Systems" SWORD Qp_mm3_sec 1 100 -327680.0 327670.0 FORMAT "%8.1" ECU_ADDRESS 0xC000AB96 /end MEASUREMENT
/begin MEASUREMENT Rail_dvolPreCtl "Vorsteuerwert für die Druckregelung über Zumesseinheit" SWORD Qp_mm3_sec 1 100 -327680.0 327670.0 FORMAT "%8.1" ECU_ADDRESS 0xD00012A2 /end MEASUREMENT
/begin MEASUREMENT Rail_dvolSetPoint_mp "Raildrucksollwert abhängig vom Volumenstrom" SWORD Qp_mm3_sec 1 100 -327680.0 327670.0 FORMAT "%8.1" ECU_ADDRESS 0xC000AB98 /end MEASUREMENT
/begin MEASUREMENT Rail_facMeUnTiRmpVal_mp "aktueller Rampenwert der Rampe bei Umschaltung von Regelung über Zumesseinheit auf Regelung über Druckregelventil" SWORD Fact 1 100 -4.000000 3.999878 ECU_ADDRESS 0xC000AB9A /end MEASUREMENT
/begin MEASUREMENT Rail_iMeUnClsHpTst "Stromvorgabe zum Schliessen der Zumesseinheit während des HpTst" UWORD Curr 1 100 0.00 65535.00 FORMAT "%8.2" ECU_ADDRESS 0xD0001624 /end MEASUREMENT
/begin MEASUREMENT Rail_MeUnCtlDKd_mp "D-Verstärkung der Druckregelung über Zumesseinheit" SLONG Kd_pRail2Q 1 100 -3276800.00000 3276799.99847 FORMAT "%16.5" ECU_ADDRESS 0xC00092BC /end MEASUREMENT
/begin MEASUREMENT Rail_MeUnCtlIKiHpTst_mp "I-Verstärkung für Druckregelung mit Zumesseinheit während HpTst" SLONG Ki_pRail2Q 1 100 -100000000.000 99999999.953 FORMAT "%16.3" ECU_ADDRESS 0xC00092C0 /end MEASUREMENT
/begin MEASUREMENT Rail_MeUnCtlIKiNeg_mp "I-Verstärkung für negative Großsignale für die Druckregelung über Zumesseinheit" SLONG Ki_pRail2Q 1 100 -100000000.000 99999999.953 FORMAT "%16.3" ECU_ADDRESS 0xC00092C4 /end MEASUREMENT
/begin MEASUREMENT Rail_MeUnCtlIKiPos_mp "I-Verstärkung für positive Großsignale für die Druckregelung über Zumesseinheit" SLONG Ki_pRail2Q 1 100 -100000000.000 99999999.953 FORMAT "%16.3" ECU_ADDRESS 0xC00092C8 /end MEASUREMENT
/begin MEASUREMENT Rail_MeUnCtlIKi_mp "I-Verstärkung für Kleinsignale für die Druckregelung über Zumesseinheit" SLONG Ki_pRail2Q 1 100 -100000000.000 99999999.953 FORMAT "%16.3" ECU_ADDRESS 0xC00092CC /end MEASUREMENT
/begin MEASUREMENT Rail_MeUnCtlPKpHpTst_mp "P-Verstärkung für Druckregelung über Zumesseinheit während HpTst" SLONG Kp_pRail2Q 1 100 -6553600.00000 6553599.99695 FORMAT "%16.5" ECU_ADDRESS 0xC00092D0 /end MEASUREMENT
/begin MEASUREMENT Rail_MeUnCtlPKpNeg_mp "P-Verstärkung für negative Großsignale für die Druckregelung über Zumesseinheit" SLONG Kp_pRail2Q 1 100 -6553600.00000 6553599.99695 FORMAT "%16.5" ECU_ADDRESS 0xC00092D4 /end MEASUREMENT
/begin MEASUREMENT Rail_MeUnCtlPKpPos_mp "P-Verstärkung für positive Großsignale für die Druckregelung über Zumesseinheit" SLONG Kp_pRail2Q 1 100 -6553600.00000 6553599.99695 FORMAT "%16.5" ECU_ADDRESS 0xC00092D8 /end MEASUREMENT
/begin MEASUREMENT Rail_MeUnCtlPKp_mp "P-Verstärkung für Kleinsignale für die Druckregelung über Zumesseinheit" SLONG Kp_pRail2Q 1 100 -6553600.00000 6553599.99695 FORMAT "%16.5" ECU_ADDRESS 0xC00092DC /end MEASUREMENT
/begin MEASUREMENT Rail_nHpTst "Array von Drehzahlstufen für HpTst" SWORD EngN 1 100 -16384.00 16383.50 ARRAY_SIZE 4 ECU_ADDRESS 0xD0001626 /end MEASUREMENT
/begin MEASUREMENT Rail_nSetPntHpTst_mp "Drehzahlvorgabe von HpTst" SWORD EngN 1 100 -16384.00 16383.50 ECU_ADDRESS 0xC000ABC6 /end MEASUREMENT
/begin MEASUREMENT Rail_pCPCFltMin_mp "Ausgang der Kennlinie Rail_pCPCFltMin_CUR" SWORD Pres_Rail 1 100 -3276.800 2000.000 ECU_ADDRESS 0xC000ABD2 /end MEASUREMENT
/begin MEASUREMENT Rail_PCVCtlDKd_mp "D-Verstärkung der Druckregelung über Druckregelventil" SLONG Kd 1 100 -32768.0000000 32767.9999847 FORMAT "%13.7" ECU_ADDRESS 0xC00092E8 /end MEASUREMENT
/begin MEASUREMENT Rail_PCVCtlIKiNeg_mp "I-Verstärkung für negative Großsignale für die Druckregelung über Druckregelventil" SLONG Ki 1 100 -1000000.00000 999999.999534 FORMAT "%13.5" ECU_ADDRESS 0xC00092EC /end MEASUREMENT
/begin MEASUREMENT Rail_PCVCtlIKiPos_mp "I-Verstärkung für positive Großsignale für die Druckregelung über Druckregelventil" SLONG Ki 1 100 -1000000.00000 999999.999534 FORMAT "%13.5" ECU_ADDRESS 0xC00092F0 /end MEASUREMENT
/begin MEASUREMENT Rail_PCVCtlIKi_mp "I-Verstärkung für Kleinsignale für die Druckregelung über Druckregelventil" SLONG Ki 1 100 -1000000.00000 999999.999534 FORMAT "%13.5" ECU_ADDRESS 0xC00092F4 /end MEASUREMENT
/begin MEASUREMENT Rail_PCVCtlPKpNeg_mp "P-Verstärkung für negative Großsignale für die Druckregelung über Druckregelventil" SLONG Kp 1 100 -65536.0000000 65535.9999695 FORMAT "%13.7" ECU_ADDRESS 0xC00092F8 /end MEASUREMENT
/begin MEASUREMENT Rail_PCVCtlPKpPos_mp "P-Verstärkung für positive Großsignale für die Druckregelung über Druckregelventil" SLONG Kp 1 100 -65536.0000000 65535.9999695 FORMAT "%13.7" ECU_ADDRESS 0xC00092FC /end MEASUREMENT
/begin MEASUREMENT Rail_PCVCtlPKp_mp "P-Verstärkung für Kleinsignale für die Druckregelung über Druckregelventil" SLONG Kp 1 100 -65536.0000000 65535.9999695 FORMAT "%13.7" ECU_ADDRESS 0xC0009300 /end MEASUREMENT
/begin MEASUREMENT Rail_pDltTmrUpHpTst "Raildruckschwelle für Messung der Druckaufbauzeit" SWORD Pres_Rail 1 100 -3276.800 2000.000 ECU_ADDRESS 0xD000162E /end MEASUREMENT
/begin MEASUREMENT Rail_pDvt "Raildruckregler-Regelabweichung" SWORD Pres_Rail 1 100 -3276.800 2000.000 ECU_ADDRESS 0xD00012B6 /end MEASUREMENT
/begin MEASUREMENT Rail_pDvtFltLim_mp "gefilterte Regelabweichung des Raildrucks" SWORD Pres_Rail 1 100 -3276.800 2000.000 ECU_ADDRESS 0xC000AB9C /end MEASUREMENT
/begin MEASUREMENT Rail_pMeUnDvt "Regelabweichung für den ZME-Regler" SWORD Pres_Rail 1 100 -3276.800 2000.000 ECU_ADDRESS 0xD00012BA /end MEASUREMENT
/begin MEASUREMENT Rail_pMeUnDvtFst_mp "Maximal zulässige Regelabweichung für Raildrucküberwachung als Funktion der Drehzahl für schnelle Überwachung" SWORD Pres_Rail 1 100 -3276.800 2000.000 ECU_ADDRESS 0xC000ABD6 /end MEASUREMENT
/begin MEASUREMENT Rail_pMeUnDvtMax_mp "Ausgang der Kennlinie Rail_pMeUnDvtMax_CUR" SWORD Pres_Rail 1 100 -3276.800 2000.000 ECU_ADDRESS 0xC000ABD8 /end MEASUREMENT
/begin MEASUREMENT Rail_pMeUnDvtMin2_mp "Minimal zulässige Regelabweichung für Raildrucküberwachung als Funktion der Drehzahl für die zweite Überwachungsstufe" SWORD Pres_Rail 1 100 -3276.800 2000.000 ECU_ADDRESS 0xC000ABDA /end MEASUREMENT
/begin MEASUREMENT Rail_pMeUnDvtMin_mp "Ausgang der Kennlinie Rail_pMeUnDvtMin_CUR" SWORD Pres_Rail 1 100 -3276.800 2000.000 ECU_ADDRESS 0xC000ABDC /end MEASUREMENT
/begin MEASUREMENT Rail_pMeUnDvtPre_mp "aus CPC-Regelung ermittelte Regelabweichung für die Zumesseinheit" SWORD Pres_Rail 1 100 -3276.800 2000.000 ECU_ADDRESS 0xC000AB9E /end MEASUREMENT
/begin MEASUREMENT Rail_pMeUnFltMin_mp "Ausgang der Kennlinie Rail_pMeUnFltMin_CUR" SWORD Pres_Rail 1 100 -3276.800 2000.000 ECU_ADDRESS 0xC000ABDE /end MEASUREMENT
/begin MEASUREMENT Rail_pMinRailSetPnt_mp "Raildruck für den Hochlauf des Hochdrucktests" SWORD Pres_Rail 1 100 -3276.800 2000.000 ECU_ADDRESS 0xC000ABC8 /end MEASUREMENT
/begin MEASUREMENT Rail_pPCVCPCOfs_mp "rückgerechneter Offsetwert der CPC für die Steuergröße zum geschlossen Halten des DRV" SWORD Pres_Rail 1 100 -3276.800 2000.000 ECU_ADDRESS 0xC000ABA0 /end MEASUREMENT
/begin MEASUREMENT Rail_pPCVCtlDT1_mp "DT1-Anteil des Druckreglers über Druckregelventil" SWORD Pres_Rail 1 100 -3276.800 2000.000 ECU_ADDRESS 0xC000ABA2 /end MEASUREMENT
/begin MEASUREMENT Rail_pPCVCtlI_mp "I-Anteil des Druckreglers über Druckregelventil" SWORD Pres_Rail 1 100 -3276.800 2000.000 ECU_ADDRESS 0xC000ABA4 /end MEASUREMENT
/begin MEASUREMENT Rail_pPCVCtlLoLim_mp "untere Stellwertbegrenzung des Raildruckreglers über Druckregelventil" SWORD Pres_Rail 1 100 -3276.800 2000.000 ECU_ADDRESS 0xC000ABB8 /end MEASUREMENT
/begin MEASUREMENT Rail_pPCVCtlPILim_mp "DT1-Anteil des Druckreglers über Druckregelventil (begrenzt)" SWORD Pres_Rail 1 100 -3276.800 2000.000 ECU_ADDRESS 0xC000ABA6 /end MEASUREMENT
/begin MEASUREMENT Rail_pPCVCtlP_mp "P-Anteil des Druckreglers über Druckregelventil" SWORD Pres_Rail 1 100 -3276.800 2000.000 ECU_ADDRESS 0xC000ABA8 /end MEASUREMENT
/begin MEASUREMENT Rail_pPCVCtlUpLim_mp "obere Stellwertbegrenzung des Raildruckreglers über Druckregelventil" SWORD Pres_Rail 1 100 -3276.800 2000.000 ECU_ADDRESS 0xC000ABBA /end MEASUREMENT
/begin MEASUREMENT Rail_pPCVDvt "Regelabweichung für den DRV Regler" SWORD Pres_Rail 1 100 -3276.800 2000.000 ECU_ADDRESS 0xD00012BC /end MEASUREMENT
/begin MEASUREMENT Rail_pPCVDvtPre_mp "aus CPC-Regelung ermittelte Regelabweichung für das Druckregelventil" SWORD Pres_Rail 1 100 -3276.800 2000.000 ECU_ADDRESS 0xC000ABAA /end MEASUREMENT
/begin MEASUREMENT Rail_pPCVInitI_mp "Initialisierung I-Anteil des Druckreglers über Druckregelventil, beim Umschalten von Zumesseinheit auf Druckregelventil" SWORD Pres_Rail 1 100 -3276.800 2000.000 ECU_ADDRESS 0xC000ABAC /end MEASUREMENT
/begin MEASUREMENT Rail_pPT1Flt_mp "PT1-gefilterter Raildruck für die Druckregelung über Zumesseinheit" SWORD Pres_Rail 1 100 -3276.800 2000.000 ECU_ADDRESS 0xC000ABAE /end MEASUREMENT
/begin MEASUREMENT Rail_pSetHiHpTst "Solldruck für Druckanstiegsphase des Hochdrucktests" SWORD Pres_Rail 1 100 -3276.800 2000.000 ECU_ADDRESS 0xD0001630 /end MEASUREMENT
/begin MEASUREMENT Rail_pSetMaxHpTst "Maximaler Raildrucksollwertvorgabe von HpTst" SWORD Pres_Rail 1 100 -3276.800 2000.000 ECU_ADDRESS 0xD0001632 /end MEASUREMENT
/begin MEASUREMENT Rail_pSetMinHpTst "Minimale Raildruckvorgabe von HpTst" SWORD Pres_Rail 1 100 -3276.800 2000.000 ECU_ADDRESS 0xD0001634 /end MEASUREMENT
/begin MEASUREMENT Rail_pSetMin_mp "Kennlinienwert für den minimalen Raildruck als Stellwert" SWORD Pres_Rail 1 100 -3276.800 2000.000 ECU_ADDRESS 0xC000ABB0 /end MEASUREMENT
/begin MEASUREMENT Rail_pSetPntHpTst_mp "Raildrucksollwertvorgabe von HpTst" SWORD Pres_Rail 1 100 -3276.800 2000.000 ECU_ADDRESS 0xC000ABCA /end MEASUREMENT
/begin MEASUREMENT Rail_pSetZLHpTst "Nulllast-Druckvorgabe von HpTst" SWORD Pres_Rail 1 100 -3276.800 2000.000 ECU_ADDRESS 0xD0001636 /end MEASUREMENT
/begin MEASUREMENT Rail_pStepHpTst "Raildrucksollwertsprung für HpTst" SWORD Pres_Rail 1 100 -3276.800 2000.000 ECU_ADDRESS 0xD0001638 /end MEASUREMENT
/begin MEASUREMENT Rail_pTmrDwn1HpTst "Raildruckschwelle für Messung der ersten Druckabfallzeit" SWORD Pres_Rail 1 100 -3276.800 2000.000 ECU_ADDRESS 0xD000163A /end MEASUREMENT
/begin MEASUREMENT Rail_pTmrDwn2HpTst "Raildruckschwelle für Messung der zweiten Druckabfallzeit" SWORD Pres_Rail 1 100 -3276.800 2000.000 ECU_ADDRESS 0xD000163C /end MEASUREMENT
/begin MEASUREMENT Rail_pTmrUpHpTst_mp "Messpunkt für Raildruckschwelle für Messung der Druckaufbauzeit" SWORD Pres_Rail 1 100 -3276.800 2000.000 ECU_ADDRESS 0xC000ABCC /end MEASUREMENT
/begin MEASUREMENT Rail_pWindUp_mp "rückgerechneter I-Anteil wenn Stellerbegrenzung erreicht ist" SWORD Pres_Rail 1 100 -3276.800 2000.000 ECU_ADDRESS 0xC000ABB2 /end MEASUREMENT
/begin MEASUREMENT Rail_qAvrgHpTst_mp "Referenzmenge für HpTst" SWORD InjMass 1 100 -327.6800 327.6700 ECU_ADDRESS 0xC000ABCE /end MEASUREMENT
/begin MEASUREMENT Rail_qCPCtlTypeRgn_mp "Menge zur Umschaltung auf PCV Betrieb bei Regenaration" SWORD InjMass 1 100 -327.6800 327.6700 ECU_ADDRESS 0xC000ABBE /end MEASUREMENT
/begin MEASUREMENT Rail_qCPCtlType_mp "Mengengrenze für die Umschaltung auf CPC-Regelung" SWORD InjMass 1 100 -327.6800 327.6700 ECU_ADDRESS 0xC000ABC0 /end MEASUREMENT
/begin MEASUREMENT Rail_qMeUnCtlType_mp "mengenabhängige Hystereseschwelle zur Umschaltung auf Druckregelung über Zumesseinheit" SWORD InjMass 1 100 -327.6800 327.6700 ECU_ADDRESS 0xC000ABC2 /end MEASUREMENT
/begin MEASUREMENT Rail_stCPC "Status des Zustandsautomaten für die Umschaltung der Raildruckregelung" UBYTE OneToOne 1 100 0.00 255.0 ECU_ADDRESS 0xD0002074 /end MEASUREMENT
/begin MEASUREMENT Rail_stCPCMon1_mp "Zustandsbits für die Überwachung der Stellgröße des DRV" UBYTE OneToOne 1 100 0.00 255.0 ECU_ADDRESS 0xC000B4D7 /end MEASUREMENT
/begin MEASUREMENT Rail_stCPCMon3_mp "Zustandsbits für Überwachung auf minimalen Raildruck während der Umschaltung nach CPC" UBYTE OneToOne 1 100 0.00 255.0 ECU_ADDRESS 0xC000B4D8 /end MEASUREMENT
/begin MEASUREMENT Rail_stCPCMon4_mp "Fehlerpfad für Überwachung auf maximalen Raildruck während Umschaltung nach CPC" UBYTE OneToOne 1 100 0.00 255.0 ECU_ADDRESS 0xC000B4D9 /end MEASUREMENT
/begin MEASUREMENT Rail_stCtlLoop "Zustand der Steuerung Raildruckregler" UBYTE OneToOne 1 100 0.00 255.0 ECU_ADDRESS 0xD0002075 /end MEASUREMENT
/begin MEASUREMENT Rail_stDwn1HpTst "Erster Status der Druckabbauphase des HpTst" ULONG OneToOne 1 100 0.00 4294967295.00 ECU_ADDRESS 0xD00032B0 /end MEASUREMENT
/begin MEASUREMENT Rail_stDwn2HpTst "Zweiter Status der Druckabbauphase des HpTst" ULONG OneToOne 1 100 0.00 4294967295.00 ECU_ADDRESS 0xD00032B4 /end MEASUREMENT
/begin MEASUREMENT Rail_stDwn3HpTst "Dritter Status der Druckabbauphase des HpTst" ULONG OneToOne 1 100 0.00 4294967295.00 ECU_ADDRESS 0xD00032B8 /end MEASUREMENT
/begin MEASUREMENT Rail_stDwnHpTst "Status der aktuellen Druckabfallphase des HpTst" UBYTE OneToOne 1 100 0.00 255.0 ARRAY_SIZE 5 ECU_ADDRESS 0xD0002077 /end MEASUREMENT
/begin MEASUREMENT Rail_stEffectHpTst "Schnittstelle des HpTst zu anderen Funktionen" UBYTE OneToOne 1 100 0.00 255.0 ECU_ADDRESS 0xD000207C /end MEASUREMENT
/begin MEASUREMENT Rail_stMeUnFrzI_mp "Status des rückgerechneten I-Anteils für die Stellwertbegrenzung für die Regelung der Zumesseinheit" UBYTE OneToOne 1 100 0.00 255.0 ECU_ADDRESS 0xC000B4D2 /end MEASUREMENT
/begin MEASUREMENT Rail_stMeUnMon0_mp "Zustandsbits für Überwachung auf positive Regelabweichung" UBYTE OneToOne 1 100 0.00 255.0 ECU_ADDRESS 0xC000B4DA /end MEASUREMENT
/begin MEASUREMENT Rail_stMeUnMon1_mp "Zustandsbits für Überwachung auf positive Regelabweichung und Sollwert des Volumenstroms durch die Zumesseinheit" UBYTE OneToOne 1 100 0.00 255.0 ECU_ADDRESS 0xC000B4DB /end MEASUREMENT
/begin MEASUREMENT Rail_stMeUnMon22_mp "Zustandsbits für Überwachung auf negative Regelabweichung bei Nullförderung für die zweite Überwachungsstufe" UBYTE OneToOne 1 100 0.00 255.0 ECU_ADDRESS 0xC000B4DC /end MEASUREMENT
/begin MEASUREMENT Rail_stMeUnMon2_mp "Zustandsbits für Überwachung auf negative Regelabweichung bei Nullförderung" UBYTE OneToOne 1 100 0.00 255.0 ECU_ADDRESS 0xC000B4DD /end MEASUREMENT
/begin MEASUREMENT Rail_stMeUnMon3_mp "Zustandsbits für Überwachung auf minimalen Raildruck" UBYTE OneToOne 1 100 0.00 255.0 ECU_ADDRESS 0xC000B4DE /end MEASUREMENT
/begin MEASUREMENT Rail_stMeUnMon42_mp "Zustandsbits für Überwachung auf maximalen Raildruck für die zweite Überwachungsstufe" UBYTE OneToOne 1 100 0.00 255.0 ECU_ADDRESS 0xC000B4DF /end MEASUREMENT
/begin MEASUREMENT Rail_stMeUnMon4_mp "Zustandsbits für Überwachung auf maximalen Raildruck" UBYTE OneToOne 1 100 0.00 255.0 ECU_ADDRESS 0xC000B4E0 /end MEASUREMENT
/begin MEASUREMENT Rail_stMeUnMon5_mp "Zustandsbits für Überwachung auf positive Regelabweichung" UBYTE OneToOne 1 100 0.00 255.0 ECU_ADDRESS 0xC000B4E1 /end MEASUREMENT
/begin MEASUREMENT Rail_stnDem_mp "" UBYTE OneToOne 1 100 0.00 255.0 ECU_ADDRESS 0xC000B4D6 /end MEASUREMENT
/begin MEASUREMENT Rail_stPCVWindUp "Status des rückgerechneten I-Anteils für die Stellwertbegrenzung für die Regelung des Druckregelventils" UBYTE OneToOne 1 100 0.00 255.0 ECU_ADDRESS 0xD000207D /end MEASUREMENT
/begin MEASUREMENT Rail_stRefHpTst "Status der Betriebsbedingungen des HpTst" UWORD OneToOne 1 100 0.00 65535.00 ECU_ADDRESS 0xD000163E /end MEASUREMENT
/begin MEASUREMENT Rail_stStMHpTst "Status des HpTst" UBYTE OneToOne 1 100 0.00 255.0 ECU_ADDRESS 0xD000207F /end MEASUREMENT
/begin MEASUREMENT Rail_stSwtCon_mp "Status der Umschaltbedingungen für das Regelprinzip" UBYTE OneToOne 1 100 0.00 255.0 ECU_ADDRESS 0xC000B4D3 /end MEASUREMENT
/begin MEASUREMENT Rail_stSwtCPCCon_mp "Status für Umschaltbedingung für den CPC-Zustandsautomaten" UWORD OneToOne 1 100 0.00 65535.00 ECU_ADDRESS 0xC000ABC4 /end MEASUREMENT
/begin MEASUREMENT Rail_stUp1HpTst "Status der aktuellen Druckaufbauphase des HpTst" ULONG OneToOne 1 100 0.00 4294967295.00 ECU_ADDRESS 0xD00032C4 /end MEASUREMENT
/begin MEASUREMENT Rail_stUpHpTst "Array von Status der Druckaufbauphasen des HpTst" UBYTE OneToOne 1 100 0.00 255.0 ARRAY_SIZE 5 ECU_ADDRESS 0xD0002080 /end MEASUREMENT
/begin MEASUREMENT Rail_swt5StepHpTst "Schalter zum Aktivieren des fünften Schrittes ohne Einspritzungen" UBYTE OneToOne 1 100 0.00 255.0 ECU_ADDRESS 0xD0002085 /end MEASUREMENT
/begin MEASUREMENT Rail_swtCtlParHpTst "Schalter zum Aktivieren der seperaten Regelparameter während des HpTst" UBYTE OneToOne 1 100 0.00 255.0 ECU_ADDRESS 0xD0002086 /end MEASUREMENT
/begin MEASUREMENT Rail_swtTstParHpTst "Umschalter zwischen Parameter vom Tester (1) oder Datensatz (0)" UBYTE OneToOne 1 100 0.00 255.0 ECU_ADDRESS 0xD000208A /end MEASUREMENT
/begin MEASUREMENT Rail_tiDwnHpTst "Array der Druckabbauzeiten des HpTst" SLONG Time_ms 1 100 -21474836480.0 21474836470.0 ARRAY_SIZE 7 ECU_ADDRESS 0xD0002FC8 /end MEASUREMENT
/begin MEASUREMENT Rail_tiHpTst_mp "Timer für Statuswechsel im HpTst" SLONG Time_ms 1 100 -21474836480.0 21474836470.0 ECU_ADDRESS 0xC0009308 /end MEASUREMENT
/begin MEASUREMENT Rail_tiMeUn0Deb_mp "MeUn0: Messpunkt für laufende Entprellzähler" ULONG InjTime_us 1 100 0.00 5000.00 ECU_ADDRESS 0xC000930C /end MEASUREMENT
/begin MEASUREMENT Rail_tiMeUn1Deb_mp "MeUn1: Messpunkt für laufende Entprellzähler" ULONG InjTime_us 1 100 0.00 5000.00 ECU_ADDRESS 0xC0009310 /end MEASUREMENT
/begin MEASUREMENT Rail_tiMeUn22Deb_mp "MeUn 22: Messpunkt für laufende Entprellzähler" ULONG InjTime_us 1 100 0.00 5000.00 ECU_ADDRESS 0xC0009314 /end MEASUREMENT
/begin MEASUREMENT Rail_tiMeUn2Deb_mp "MeUn2: Messpunkt für laufende Entprellzähler" ULONG InjTime_us 1 100 0.00 5000.00 ECU_ADDRESS 0xC0009318 /end MEASUREMENT
/begin MEASUREMENT Rail_tiMeUn3Deb_mp "MeUn3: Messpunkt für laufende Entprellzähler" ULONG InjTime_us 1 100 0.00 5000.00 ECU_ADDRESS 0xC000931C /end MEASUREMENT
/begin MEASUREMENT Rail_tiMeUn42Deb_mp "MeUn42: Messpunkt für laufende Entprellzähler" ULONG InjTime_us 1 100 0.00 5000.00 ECU_ADDRESS 0xC0009320 /end MEASUREMENT
/begin MEASUREMENT Rail_tiMeUn4Deb_mp "MeUn4: Messpunkt für laufende Entprellzähler" ULONG InjTime_us 1 100 0.00 5000.00 ECU_ADDRESS 0xC0009324 /end MEASUREMENT
/begin MEASUREMENT Rail_tiMeUn5Deb_mp "MeUn5: Messpunkt für laufende Entprellzähler" ULONG InjTime_us 1 100 0.00 5000.00 ECU_ADDRESS 0xC0009328 /end MEASUREMENT
/begin MEASUREMENT Rail_tiMeUnCtlDT1_mp "Zeitkonstante des DT1-Gliedes für die Druckregelung über Zumesseinheit" SLONG TimeDelay_s 1 100 0.000002000000001 4294.9672960 FORMAT "%12.7" ECU_ADDRESS 0xC00092E0 /end MEASUREMENT
/begin MEASUREMENT Rail_tiMeUnCtlPT1_mp "Zeitkonstante des PT1-Filters für die Druckregelung über Zumesseinheit" SLONG TimeDelay_s 1 100 0.000002000000001 4294.9672960 FORMAT "%12.7" ECU_ADDRESS 0xC00092E4 /end MEASUREMENT
/begin MEASUREMENT Rail_tiMeUnRmpDur_mp "Laufzeit der Rampe um das Fördervolumen der Zumesseinheit vom aktuellen Sollwert auf die Maximalförderung zu rampen" SWORD InjTime_us 1 100 -13107.20 5000.00 ECU_ADDRESS 0xC000ABB4 /end MEASUREMENT
/begin MEASUREMENT Rail_tiPCVCtlDT1_mp "Zeitkonstante des DT1-Gliedes für die Druckregelung über Druckregelventil" SLONG TimeDelay_s 1 100 0.000002000000001 4294.9672960 FORMAT "%12.7" ECU_ADDRESS 0xC0009304 /end MEASUREMENT
/begin MEASUREMENT Rail_tiRmpHpTst_mp "Timer für Rampen im HpTst" SWORD Time_ms 1 100 -327680.0 327670.0 ECU_ADDRESS 0xC000ABD0 /end MEASUREMENT
/begin MEASUREMENT Rail_tiSwtCPC_mp "aktuelle Verweildauer in einem Übergangszustand des CPC-Zustandsautomaten" UWORD Time_ms 1 100 0.00 655350.0 ECU_ADDRESS 0xC000ABB6 /end MEASUREMENT
/begin MEASUREMENT Rail_tiUpHpTst "Array von Dauern der Druckaufbauphasen des HpTst" SLONG Time_ms 1 100 -21474836480.0 21474836470.0 ARRAY_SIZE 4 ECU_ADDRESS 0xD0002FE4 /end MEASUREMENT
/begin MEASUREMENT RngMod_trqClthBs "Basismoment (Kupplungsmoment)" SWORD Trq 1 100 -3276.800 3276.700 ECU_ADDRESS 0xD00012E4 /end MEASUREMENT
/begin MEASUREMENT RngMod_trqClthMinWoCtOff "minimales Kupplungsmoment ohne Ausblendung" SWORD Trq 1 100 -3276.800 3276.700 ECU_ADDRESS 0xD00012EA /end MEASUREMENT
/begin MEASUREMENT Shtr_st "" UBYTE OneToOne 1 100 0.00 255.0 ECU_ADDRESS 0xD00020AB /end MEASUREMENT
/begin MEASUREMENT Shtr_swtMnt "" SWORD OneToOne 1 100 -32768.00 32767.00 ECU_ADDRESS 0xD000137E /end MEASUREMENT
/begin MEASUREMENT St_qvc1 "Statuswort" UBYTE Def_st_ub_q1 1 100 0.00 255. FORMAT "%3.0" ECU_ADDRESS 0xC000B4B1 /end MEASUREMENT
/begin MEASUREMENT U00_quali "Qualitätsindex U00" UBYTE Def_f_ub_b100 1 100 0.00 99.61 ECU_ADDRESS 0xC000B4A7 /end MEASUREMENT
/begin MEASUREMENT U00_quali_1 "Qualitätsindex U00 Ruhestromeinfluss" UBYTE Def_f_ub_b100 1 100 0.00 99.61 ECU_ADDRESS 0xC000B4A8 /end MEASUREMENT
/begin MEASUREMENT U00_quali_2 "Qualitätsindex U00 Temperatureinfluss" UBYTE Def_f_ub_b100 1 100 0.00 99.61 ECU_ADDRESS 0xC000B4A9 /end MEASUREMENT
/begin MEASUREMENT U00_quali_3 "Qualitätsindex U00 Einfluss U00-Grössenordnung" UBYTE Def_f_ub_b100 1 100 0.00 99.61 ECU_ADDRESS 0xC000B4AA /end MEASUREMENT
/begin MEASUREMENT U00_quali_4 "Qualitätsindex U00 Einfluss Spannungsgradient" UBYTE Def_f_ub_b100 1 100 0.00 99.61 ECU_ADDRESS 0xC000B4AB /end MEASUREMENT
/begin MEASUREMENT U00_quali_5 "Qualitätsindex U00 Einfluss fehlende Messungen" UBYTE Def_f_ub_b100 1 100 0.00 99.61 ECU_ADDRESS 0xC000B4AC /end MEASUREMENT
/begin MEASUREMENT U00_quali_6 "Qualitätsindex U00 Einfluss Ruhezeit" UBYTE Def_f_ub_b100 1 100 0.00 99.61 ECU_ADDRESS 0xC000B4AD /end MEASUREMENT
/begin MEASUREMENT U0_batt "Im QVC berechnete Ruhespannung Batterie ohne I- und T- Kompensation" UWORD Def_u_uw_b25p5 1 100 0.00 25.499611 FORMAT "%9.6" ECU_ADDRESS 0xC000AAF8 /end MEASUREMENT
/begin MEASUREMENT U_diff_12 "Differenz Spannungen (Zwischenergebnis)" SWORD Def_u_sw_q0p00025 1 100 -8.1920000 8.1917500 ECU_ADDRESS 0xC000AAFA /end MEASUREMENT
/begin MEASUREMENT U_diff_23 "Differenz Spannungen (Zwischenergebnis)" SWORD Def_u_sw_q0p00025 1 100 -8.1920000 8.1917500 ECU_ADDRESS 0xC000AAFC /end MEASUREMENT
/begin MEASUREMENT U_diff_32 "Differenz Spannungen (Zwischenergebnis)" SWORD Def_u_sw_q0p00025 1 100 -8.1920000 8.1917500 ECU_ADDRESS 0xC000AAFE /end MEASUREMENT
/begin MEASUREMENT U_ruhe_1 "Ruhespannung Messung 1" UWORD Def_u_uw_b25p5 1 100 0.00 25.499611 FORMAT "%9.6" ECU_ADDRESS 0xC000AB00 /end MEASUREMENT
/begin MEASUREMENT U_ruhe_2 "Ruhespannung Messung 2" UWORD Def_u_uw_b25p5 1 100 0.00 25.499611 FORMAT "%9.6" ECU_ADDRESS 0xC000AB02 /end MEASUREMENT
/begin MEASUREMENT U_ruhe_3 "Ruhespannung Messung 3" UWORD Def_u_uw_b25p5 1 100 0.00 25.499611 FORMAT "%9.6" ECU_ADDRESS 0xC000AB04 /end MEASUREMENT
/begin MEASUREMENT VehMot_stLimDfftl "Status Momentendurchgriff Differentialschutz" UBYTE OneToOne 1 100 0.00 255.0 ECU_ADDRESS 0xD00025B8 /end MEASUREMENT
/begin MEASUREMENT VehMot_trqDCS "MSR-Eingriffsmoment (Getriebeausgangsmoment)" SLONG TrqPrpHigh 1 100 -214748364.800 214748364.700 ECU_ADDRESS 0xD0003060 /end MEASUREMENT
/begin MEASUREMENT VehMot_trqDes "Vortriebssollmoment nach Allradkoordination (Getriebeausgangsmoment)" SLONG TrqPrpHigh 1 100 -214748364.800 214748364.700 ECU_ADDRESS 0xD0003064 /end MEASUREMENT
/begin MEASUREMENT VehMot_trqDesTCS "ASR-Eingriffsmoment (Getriebeausgangsmoment)" SLONG TrqPrpHigh 1 100 -214748364.800 214748364.700 ECU_ADDRESS 0xD0003068 /end MEASUREMENT
/begin MEASUREMENT VehMot_trqLead "Vortriebsvorhaltmoment nach Allradkoordination (Getriebeausgangsmoment)" SLONG TrqPrpHigh 1 100 -214748364.800 214748364.700 ECU_ADDRESS 0xD0003070 /end MEASUREMENT
/begin MEASUREMENT VehMot_trqLeadPOp "Vortriebsvorhaltmoment zur BDE-Betriebsauswahl (Getriebeausgangsmoment)" SLONG TrqPrpHigh 1 100 -214748364.800 214748364.700 ECU_ADDRESS 0xD0003074 /end MEASUREMENT
/begin MEASUREMENT VehMot_trqLeadTCS "ASR-Vorhaltmoment (Getriebeausgangsmoment)" SLONG TrqPrpHigh 1 100 -214748364.800 214748364.700 ECU_ADDRESS 0xD0003078 /end MEASUREMENT
/begin MEASUREMENT X_KL_U00QUA_I_no_input_quantity "This variable is artificially generated, since DAMOS does not (yet) support 'NO_INPUT_QUANTITY' references at PaVaSt files. It is exclusively referenced by the X axis of calibration parameter 'KL_U00QUA_I'." SWORD Def_i_sw_q0p001 1 100 -32.76800 32.76700 FORMAT "%8.5" ECU_ADDRESS 0xC000AB06 /end MEASUREMENT
/begin FUNCTION PPFltUs_VD ""
 /begin DEF_CHARACTERISTIC Exh_numCntBckPPFltUs_C Exh_numCntMaxPPFltUs_C Exh_numFldPPFltUs_C Exh_RmpSlpPPFltUs.Pos_C Exh_RmpSlpPPFltUs.Neg_C Exh_swtDflPPFltUs_C Exh_swtEnvTPPFltUs_C Exh_swtSensCfgPPFlt_C Exh_tFrzMinPPFltUs_C Exh_TrStgParPPFltUs.Dfl_C Exh_TrStgParPPFltUs.stSensId_C /end DEF_CHARACTERISTIC
 /begin IN_MEASUREMENT Air_tCACDs ASMod_pPFltSimDs EnvP_p EnvT_t Exh_pFld Exh_pSensPPFltUs PFltLd_tiPPreDVolDynFlt /end IN_MEASUREMENT
 /begin OUT_MEASUREMENT Exh_pAdapPPFltUs Exh_pFltPPFltUs Exh_pPFltUs /end OUT_MEASUREMENT
/end FUNCTION
/begin FUNCTION Prp_TrqDesCoord ""
 /begin IN_MEASUREMENT CoVM_trqDes PT_trqTraOutBs PT_trqTraOutWoDstC VehMot_rTrqDfftl VehMot_trqPrtDfftl VMSI_trqDesMax VMSI_trqMin /end IN_MEASUREMENT
 /begin OUT_MEASUREMENT Prp_stIARls VehMot_stLimDfftl VehMot_trqDCS VehMot_trqDes VehMot_trqDesTCS /end OUT_MEASUREMENT
 /begin LOC_MEASUREMENT Prp_trqDCS_mp Prp_trqIntv_mp /end LOC_MEASUREMENT
/end FUNCTION
/begin FUNCTION Prp_TrqLeadCoord ""
 /begin IN_MEASUREMENT CoVM_trqLead CoVM_trqLeadPOp VehMot_rTrqDfftl VehMot_trqPrtDfftl VMSI_trqLeadMax VMSI_trqMin /end IN_MEASUREMENT
 /begin OUT_MEASUREMENT VehMot_trqLead VehMot_trqLeadPOp VehMot_trqLeadTCS /end OUT_MEASUREMENT
 /begin LOC_MEASUREMENT Prp_trqLeadIntv_mp /end LOC_MEASUREMENT
/end FUNCTION
/begin FUNCTION PSPCtl_Co ""
 /begin DEF_CHARACTERISTIC PSPCtl_dvolBase_CUR PSPCtl_dvolMax_C PSPCtl_dvolMin_C PSPCtl_dvolOut1_C PSPCtl_dvolOut_C PSPCtl_dvolTempLim_MAP PSPCtl_facFuelTCor_CUR PSPCtl_nLim_C PSPCtl_swtMSAStop_C PSPCtl_tiT15Delay_CUR /end DEF_CHARACTERISTIC
 /begin IN_MEASUREMENT CoEng_st CoEng_stShutOffPath Com_stMSAStop EngDa_tEng EngStA_st Epm_nEng FuelT_t Layer_dvolLPCOut Layer_stLPCOff Strt_st T15_st /end IN_MEASUREMENT
 /begin OUT_MEASUREMENT PSP_dvolOut PSP_st /end OUT_MEASUREMENT
 /begin LOC_MEASUREMENT PSPCtl_dvolBaseLim_mp PSPCtl_dvolBase_mp PSPCtl_dvolCalc_mp PSPCtl_dvolLim_mp PSPCtl_dvolT15Delay_mp PSPCtl_stLogic_mp PSPCtl_tiT15Delay_mp /end LOC_MEASUREMENT
/end FUNCTION
/begin FUNCTION ptadapt_adapt ""
 /begin DEF_CHARACTERISTIC ActMod_trqClthWoDstC_C Eng_stStopEna_C Eng_stStrtEna_C GbxNPos_st_C Gbx_bASTIntv_C Gbx_bASTNeutr_C RngMod_trqClthBs_C RngMod_trqClthMinWoCtOff_C /end DEF_CHARACTERISTIC
 /begin IN_MEASUREMENT Clth_st /end IN_MEASUREMENT
 /begin OUT_MEASUREMENT ActMod_trqClthWoDstC Dfftl_bLowRng Eng_stStopEna Eng_stStrtEna GbxNPos_st Gbx_bASTIntv Gbx_bASTNeutr Gbx_bRevGear Gbx_nASTDes Gbx_nIdlDes Gbx_rFanClgDem Gbx_rTrq Gbx_rTrqTra Gbx_stConvClth Gbx_stGearLvr Gbx_tClntDes Gbx_tiASTDes Gbx_tOilConv Gbx_trqConvLos RngMod_trqClthBs RngMod_trqClthMinWoCtOff /end OUT_MEASUREMENT
/end FUNCTION
/begin FUNCTION PTCOP_TrqCnv ""
 /begin IN_MEASUREMENT ActMod_trqClth ActMod_trqClthWoDstC PT_rTrq PT_trqLos RngMod_trqClthBs RngMod_trqClthMax RngMod_trqClthMin RngMod_trqClthMinWoCtOff SpdGov_trqSet VehMot_rTrqDfftl /end IN_MEASUREMENT
 /begin OUT_MEASUREMENT PT_trqSpdGovLtd PT_trqTraOut PT_trqTraOutBs PT_trqTraOutWoDstC PT_trqWhl PT_trqWhlBs PT_trqWhlMaxEng PT_trqWhlMinEng PT_trqWhlMinWoCtOff PT_trqWhlWoDstC /end OUT_MEASUREMENT
/end FUNCTION
/begin FUNCTION PthLead_TrqCalc ""
 /begin IN_MEASUREMENT CoEng_stShutOffPath CoETS_trqInrCurr CoETS_trqInrLead EngTrqPtd_stPthLim EngTrqPtd_trqLim PthSet_stOvrRun /end IN_MEASUREMENT
 /begin OUT_MEASUREMENT PthLead_stActvMonLim PthLead_trqInrCurr PthLead_trqInrLead /end OUT_MEASUREMENT
 /begin LOC_MEASUREMENT PthLead_trqInrCurrNoMo_mp PthLead_trqInrLeadNoMo_mp /end LOC_MEASUREMENT
/end FUNCTION
/begin FUNCTION PthSet_OvrRunCoord "" /begin DEF_CHARACTERISTIC PthSet_tiOvrRunCoordDebPos_C PthSet_trqOvrRunThres_C /end DEF_CHARACTERISTIC
 /begin IN_MEASUREMENT CoEng_st CoETS_trqInrLtd CoETS_trqUnFltLtd InjCrv_stInjCharActVal InjCtl_qSetUnBal PthSet_stDisable /end IN_MEASUREMENT
 /begin OUT_MEASUREMENT PthSet_stOvrRun PthSet_stOvrRunCoord /end OUT_MEASUREMENT
/end FUNCTION
/begin FUNCTION PthSet_TrqCalc ""
 /begin DEF_CHARACTERISTIC PthSet_dtrqRmpDwnDfl_C PthSet_dtrqRmpDwn_CUR PthSet_tiRmpStrtDfl_C PthSet_tiRmpStrt_CUR PthSet_tiSwtOffDfl_C PthSet_tiSwtOff_CUR PthSet_trqOffs_C /end DEF_CHARACTERISTIC
 /begin IN_MEASUREMENT ASDdc_trq ASDrf_trqInrSet CoEng_stShutOffPath CoETS_trqInrLimSet CoETS_trqUnFltLtd EngTrqPtd_stPthLim EngTrqPtd_trqLim PthSet_stOvrRun PT_rTrq PT_stGrip /end IN_MEASUREMENT
 /begin OUT_MEASUREMENT PthSet_ctProcSet PthSet_stActvMonLim PthSet_stDisable PthSet_tiRmpStrt PthSet_tiSwtOff PthSet_trqASDdcInit PthSet_trqASDrfInit PthSet_trqInrSet PthSet_trqInrSetNoMo PthSet_trqInrSetSum PthSet_trqLimOffs PthSet_trqSetASDdc PthSet_trqSetLim /end OUT_MEASUREMENT
 /begin LOC_MEASUREMENT PthSet_dtrqRmpDwn_mp PthSet_stRmp_mp PthSet_trqBefRmp_mp PthSet_trqRmp_mp /end LOC_MEASUREMENT
/end FUNCTION
/begin FUNCTION PTLo_LosCalc "" /begin DEF_CHARACTERISTIC PT_swtTrqLos_C /end DEF_CHARACTERISTIC
 /begin IN_MEASUREMENT Com_trqClthDKG Conv_trqLd Conv_trqResv PT_stTraType RngMod_trqComp Tra_trqLos /end IN_MEASUREMENT
 /begin OUT_MEASUREMENT PT_trqLos PT_trqLosComp PT_trqResv /end OUT_MEASUREMENT
/end FUNCTION
/begin FUNCTION PTODi_SpdCoord ""
 /begin IN_MEASUREMENT CoME_nMax CoME_nMin CoME_stNSetP CoVeh_nMaxSysErr CoVeh_nMinSysErr CoVeh_stNSetPSysErr Tra_nASTDes Tra_nMax Tra_nMin Tra_stAST Tra_stNSetP Tra_tiASTDes /end IN_MEASUREMENT
 /begin OUT_MEASUREMENT CoPT_nASTDes CoPT_nMaxAcs CoPT_nMaxSysErr CoPT_nMaxTra CoPT_nMinAcs CoPT_nMinSysErr CoPT_nMinTra CoPT_stAST CoPT_stNSetPAcs CoPT_stNSetPSysErr CoPT_stNSetPTra CoPT_tiASTDes /end OUT_MEASUREMENT
/end FUNCTION
/begin FUNCTION PTODi_TrqComp "" /begin DEF_CHARACTERISTIC PTODi_trqCompPtdOfs_C /end DEF_CHARACTERISTIC
 /begin IN_MEASUREMENT CoVeh_trqDesComp CoVeh_trqResv Epm_nEng MoFCoVeh_trqCompMsg PTODi_ctProcComp PTODi_stLimCompAct PTODi_trqCompSum /end IN_MEASUREMENT
 /begin OUT_MEASUREMENT CoPT_trqDesCompEng CoPT_trqResvEng /end OUT_MEASUREMENT
/end FUNCTION
/begin FUNCTION PTODi_TrqComp_10ms "" /begin DEF_CHARACTERISTIC PTODi_tiDebTrqComp_C PTODi_trqCompOfs_MAP /end DEF_CHARACTERISTIC
 /begin IN_MEASUREMENT CoVeh_trqDesComp Epm_nEng MoFCoVeh_trqCompMsg MoFCoVeh_trqVehPtdMsg /end IN_MEASUREMENT
 /begin OUT_MEASUREMENT PTODi_ctProcComp PTODi_stLimCompAct PTODi_trqCompSum /end OUT_MEASUREMENT
 /begin LOC_MEASUREMENT PTODi_stCompLimDeb_mp PTODi_stCompLimUnDeb_mp PTODi_trqCompAvrg_mp PTODi_trqCompOfs_mp PTODi_trqMoComp_mp /end LOC_MEASUREMENT
/end FUNCTION
/begin FUNCTION PTODi_TrqDesCoord "" /begin DEF_CHARACTERISTIC PTODi_trqPtdOfs_C /end DEF_CHARACTERISTIC
 /begin IN_MEASUREMENT CoPT_trqDes Epm_nEng MoFCoVeh_trqVehPtdMsg PTODi_ctProcDes PTODi_stLimDesAct PTODi_trqDesSum VehMot_facDesDyn /end IN_MEASUREMENT
 /begin OUT_MEASUREMENT CoPT_facDesDyn CoPT_trqDesEng /end OUT_MEASUREMENT
/end FUNCTION
/begin FUNCTION PTODi_TrqDesCoord_10ms "" /begin DEF_CHARACTERISTIC PTODi_nEngMin_C PTODi_tiDebTrqDes_C PTODi_trqDesOfs_MAP /end DEF_CHARACTERISTIC /begin IN_MEASUREMENT CoPT_trqDes Epm_nEng MoFCoVeh_trqVehPtdMsg /end IN_MEASUREMENT /begin OUT_MEASUREMENT PTODi_ctProcDes PTODi_stLimDesAct PTODi_trqDesSum /end OUT_MEASUREMENT
 /begin LOC_MEASUREMENT PTODi_stDesLimDeb_mp PTODi_stDesLimUnDeb_mp PTODi_trqDesAvrg_mp PTODi_trqDesOfs_mp PTODi_trqMoPtd_mp /end LOC_MEASUREMENT
/end FUNCTION
/begin FUNCTION PTODi_TrqLeadCoord "" /begin IN_MEASUREMENT CoPT_trqCurr CoPT_trqLead CoPT_trqLeadPOp /end IN_MEASUREMENT /begin OUT_MEASUREMENT CoPT_trqCurrEng CoPT_trqLeadEng CoPT_trqLeadPOpEng /end OUT_MEASUREMENT /end FUNCTION
/begin FUNCTION PT_Grip ""
 /begin DEF_CHARACTERISTIC PT_dChkGrpDT1Kd_C PT_dOfsGripDet_C PT_dOfsNoGripDet_C PT_dThetaGripDet_C PT_dThetaNoGripDet_C PT_rATSlipClsd_C PT_rATSlipOpn_C PT_rATSlip_C PT_rGrip_C PT_rNoGrip_C PT_swtMstShft_C PT_swtNoGripDet_C PT_tiChkGrpDT1_C PT_tiChkGrpPT1_C PT_tiDebGearUnVal_C PT_tiDebGrip_C PT_tiDebNoClthHiLo_C PT_tiDebNoClthLoHi_C PT_tiDebNoGrip_C PT_vMinGrip_C /end DEF_CHARACTERISTIC
 /begin IN_MEASUREMENT ActMod_trqClth Clth_st Com_stClthOpenPlaus Epm_nEng GlbDa_vX Layer_bRecMSA PT_stConvGrip PT_stTraGrip PT_stTraType Tra_numGear /end IN_MEASUREMENT
 /begin OUT_MEASUREMENT PT_bATSlip PT_bATSlipClsd PT_bATSlipOpn PT_bGrip PT_bNoGrip PT_rGrip PT_stGrip PT_swtMstShft /end OUT_MEASUREMENT
 /begin LOC_MEASUREMENT PT_dnAbsEng_mp PT_dnEng_mp PT_dnGrip_mp PT_dnNoGrip_mp PT_stNoGripDet_mp PT_stPTGrip_mp PT_trqAbsGbxPT1_mp PT_trqGbxPT1_mp /end LOC_MEASUREMENT
/end FUNCTION
/begin FUNCTION PT_TrqRat ""
 /begin DEF_CHARACTERISTIC PT_drTrq.Pos_C PT_drTrq.Neg_C PT_rTrqDfl_C PT_swtRTrqSel_C PT_tiRTrqDly_C /end DEF_CHARACTERISTIC
 /begin IN_MEASUREMENT Conv_rTrq PT_rTraGear PT_stGrip VehV_v /end IN_MEASUREMENT
 /begin OUT_MEASUREMENT PT_rTrq /end OUT_MEASUREMENT
 /begin LOC_MEASUREMENT PT_rTrqRmpIn_mp /end LOC_MEASUREMENT
/end FUNCTION
/begin FUNCTION PwmHal "" /end FUNCTION
/begin FUNCTION PwmIn "" /end FUNCTION
/begin FUNCTION PwmOut "" /end FUNCTION
/begin FUNCTION Pwr "" /end FUNCTION
/begin FUNCTION qvc ""
 /begin DEF_CHARACTERISTIC KF_U00 KL_SOC0TMP KL_U00QUA_I KL_U00QUA_NF KL_U00QUA_T KL_U00QUA_TR KL_U00QUA_U1 KL_U00QUA_U2 K_D_SUMMAND K_D_URUHE K_MU_ABFALL K_MU_ANSTIEG K_QVCTIM1 K_QVCTIM2 K_QVCTIM3 K_QVCTIM4 K_QVK20 K_QVK20OFS K_QVMAXTGRD K_QVMINVAL K_QVRA K_QVRB K_QVRC K_QVTLIMHI K_QVTLIMLO K_QVVLIMHI K_QVVLIMLO K_QV_SCHWELLE K_QV_TEST1 K_QV_TKU00 K_QV_TSTU00 K_U00EMPTLIM K_U00FULLOADLIM K_U00QSCHW K_U_SINKEND K_U_STEIGEND /end DEF_CHARACTERISTIC
 /begin IN_MEASUREMENT T_battsoc0 /end IN_MEASUREMENT
 /begin OUT_MEASUREMENT I_soc0_komp Qv_csc Qv_ez Qv_ez_sum Qv_faktf Qv_h Qv_isp1 Qv_isp1_sum Qv_isp2 Qv_isp2_sum Qv_i_zw1 Qv_k20 Qv_k20ofs Qv_m Qv_n Qv_nsp1 Qv_nsp2 Qv_nv_ezm Qv_nv_start Qv_nv_zh Qv_n_fehlmes Qv_ra Qv_rb Qv_rc Qv_rc_zwi Qv_soc_grob Qv_start_aktuell Qv_stat Qv_timer Qv_t_i Qv_t_ruhzeit Qv_t_u Qv_u00 Qv_Ub00_25grd Qv_usp1 Qv_usp1_sum Qv_usp2 Qv_usp2_sum Qv_u_0l Qv_u_0u Qv_u_zw1 Qv_u_zw2 Qv_u_zw3 Qv_u_zw4 Qv_u_zw5 U00_quali U00_quali_1 U00_quali_2 U00_quali_3 U00_quali_4 U00_quali_5 U00_quali_6 U0_batt U_diff_12 U_diff_23 U_diff_32 U_ruhe_1 U_ruhe_2 U_ruhe_3 X_KL_U00QUA_I_no_input_quantity /end OUT_MEASUREMENT
/end FUNCTION
/begin FUNCTION qvch2o ""
 /begin DEF_CHARACTERISTIC KF_QVH2O_FT KF_QVH2O_XH KF_QVH2O_XI KF_QVH2O_XT KF_QVH2O_XU K_QVH2OBAS K_QVH2OEM K_QVH2OQEM K_QVH2OQVOS K_QVH2OSOCB K_QVH2O_BT S_QVH2OSOC S_QVH2O_UM /end DEF_CHARACTERISTIC
 /begin IN_MEASUREMENT T_batt /end IN_MEASUREMENT
 /begin OUT_MEASUREMENT Qvh2o_btyp Qvh2o_ft Qvh2o_rate Qvh2o_xh2o Qvh2o_xhsum Qvh2o_xi Qvh2o_xi20 Qvh2o_xsoc Qvh2o_xt Qvh2o_xu Qv_h2o Qv_h2oquali Qv_h2ostatus Qv_h2o_sum Qv_ubatt_ber St_qvc1 /end OUT_MEASUREMENT
/end FUNCTION
/begin FUNCTION qvcquali ""
 /begin DEF_CHARACTERISTIC KL_QVQ_QWIN K_QVOUTM_DEF K_QVQM_DEF K_QVQ_AUSMX K_QVQ_BFMX K_QVQ_CL K_QVQ_CLR K_QVQ_DELAY K_QVQ_QAUS K_QVQ_SFMX K_QVQ_SZE K_QVQ_SZMX K_QVQ_SZS K_QVQ_TEST1 K_QVQ_TGMX /end DEF_CHARACTERISTIC
 /begin OUT_MEASUREMENT K_QVQ_ANZSTA Qvc_status_1 Qvc_status_2 Qvc_status_3 Qvc_status_4 Qv_aktuell Qv_analyse Qv_bfenster Qv_clr Qv_codaus Qv_grad Qv_grad_m Qv_lcl Qv_m_in Qv_outm_int Qv_out_1 Qv_out_2 Qv_out_3 Qv_out_4 Qv_out_5 Qv_out_m Qv_quali_1 Qv_quali_2 Qv_quali_3 Qv_quali_4 Qv_quali_5 Qv_quali_int Qv_quali_m Qv_q_stat Qv_r Qv_rm Qv_rm_int Qv_sfenster Qv_stand Qv_status Qv_td1 Qv_td2 Qv_td3 Qv_td4 Qv_td5 Qv_ucl /end OUT_MEASUREMENT
/end FUNCTION
/begin FUNCTION QWC_Co ""
 /begin DEF_CHARACTERISTIC QWC_facFTS_MAP QWC_qNorm_CUR QWC_stActv_C QWC_tCor_MAP QWC_tDflCEngDsT_C QWC_tDflFuelT_C /end DEF_CHARACTERISTIC
 /begin IN_MEASUREMENT CEngDsT_t FuelT_t RailP_pFlt /end IN_MEASUREMENT
 /begin OUT_MEASUREMENT QWC_facFTS QWC_qNorm QWC_st QWC_tCor /end OUT_MEASUREMENT
 /begin LOC_MEASUREMENT QWC_CEngDsT_mp QWC_FuelT_mp /end LOC_MEASUREMENT
/end FUNCTION
/begin FUNCTION QWC_Lib ""
 /begin DEF_CHARACTERISTIC QWC_facCor1_MAP QWC_facCor2_MAP QWC_facPiI2PiI1WvCor_C QWC_facPiI2_C QWC_facPoI1Cor_C QWC_qCor1_MAP QWC_qCor2_MAP QWC_qMax_C QWC_qMin_C /end DEF_CHARACTERISTIC
 /begin IN_MEASUREMENT InjCrv_qMI1Des InjCrv_qPiI1Des_mp InjCrv_qPoI2Des_mp RailP_pCurr_mp /end IN_MEASUREMENT
 /begin OUT_MEASUREMENT QWC_qMI1 QWC_qPiI1 QWC_qPoI1 QWC_qPoI2 /end OUT_MEASUREMENT
 /begin LOC_MEASUREMENT QWC_facMI1PoI2_mp QWC_facPiI2PiI1_mp QWC_facPiIMI1_mp QWC_facPoI2PoI1_mp QWC_qMI1PoI2_mp QWC_qPiI1MI1_mp QWC_qPiI2MI1_mp QWC_qPiI2PiI1_mp QWC_qPoI2PoI1Cor_mp QWC_qPoI2PoI1_mp QWC_rMI1Norm_mp QWC_rPoI2Norm_mp QWC_tiMI1PoI2Cor_mp QWC_tiMI1PoI2_mp QWC_tiPiI1MI1Cor_mp QWC_tiPiI1MI1_mp QWC_tiPiI2MI1Cor_mp QWC_tiPiI2MI1_mp QWC_tiPiI2PiI1Cor_mp QWC_tiPiI2PiI1_mp QWC_tiPoI2PoI1Cor_mp QWC_tiPoI2PoI1_mp /end LOC_MEASUREMENT
/end FUNCTION
/begin FUNCTION QWC_TDiffHyd "" /begin DEF_CHARACTERISTIC QWC_swtDiffHydInSel_C QWC_tiDiffHyd_MAP /end DEF_CHARACTERISTIC
 /begin LOC_MEASUREMENT QWC_pCurrInDiffHyd_mp QWC_qDesInDiffHyd_mp QWC_tiMI1DiffHydCor_mp QWC_tiPiI1DiffHydCor_mp QWC_tiPiI2DiffHydCor_mp QWC_tiPoI2DiffHydCor_mp /end LOC_MEASUREMENT
/end FUNCTION
/begin FUNCTION RadSht_Logic ""
 /begin DEF_CHARACTERISTIC RadSht_idConsum_C RadSht_nFanRqMaxHi_C RadSht_nFanRqMaxLo_C RadSht_nFanSetPointHi_C RadSht_nFanSetPointLo_C RadSht_nFanXHi_C RadSht_nFanXLo_C RadSht_rLogicOutHigh_C RadSht_rLogicOutLow_C RadSht_stConsumActv_C RadSht_stInvOut_C RadSht_stLogic_C RadSht_stTrailerErr_C RadSht_tEngXHi_C RadSht_tEngXLo_C RadSht_tEnvHi_C RadSht_tEnvLo_C RadSht_tiDebOff_C RadSht_tiDebOn_C RadSht_tTraOilXHi_C RadSht_tTraOilXLo_C RadSht_vVehHi_C RadSht_vVehLo_C RadSht_vXHi_C RadSht_vXLo_C /end DEF_CHARACTERISTIC
 /begin IN_MEASUREMENT Com_idVerbraucher Com_stTrailer Com_stVerbraucher EngDa_tEng EnvT_t FanCtl_nRqMax FanCtl_nSetPoint FanCtl_stAftRun PT_stTraType Shtr_stAKKActrPresent SyC_stSub T15_st Tra_tOil VehV_v /end IN_MEASUREMENT
 /begin OUT_MEASUREMENT Shtr_st Shtr_swtMnt /end OUT_MEASUREMENT
 /begin LOC_MEASUREMENT RadSht_stCond_mp RadSht_stConsumFF_mp RadSht_stConsum_mp RadSht_stFanAftRun_mp RadSht_stLogic_mp /end LOC_MEASUREMENT
/end FUNCTION
/begin FUNCTION RailP_DDCo ""
 /begin DEF_CHARACTERISTIC RailP_AdcMaxVal_C RailP_pLin_CUR RailP_SRC.uMin_C RailP_SRC.uMax_C RailP_uRawMaxRes /end DEF_CHARACTERISTIC
 /begin OUT_MEASUREMENT RailP_pLin RailP_uRaw /end OUT_MEASUREMENT
 /begin LOC_MEASUREMENT RailP_pLinCurr_mp RailP_stSRCCurr_mp RailP_uRawMax RailP_uRawNoCorCur_mp RailP_uRawNoCor_mp /end LOC_MEASUREMENT
/end FUNCTION
/begin FUNCTION RailP_VDCo ""
 /begin DEF_CHARACTERISTIC RailP_pFltWinNeg_CUR RailP_swtFlt_C RailP_tiFlt1PT1_C RailP_tiFlt2PT1_C RailP_tiFlt3PT1_C /end DEF_CHARACTERISTIC
 /begin IN_MEASUREMENT InjCtl_qSetUnBal RailP_pLin Rail_pSetPoint /end IN_MEASUREMENT
 /begin OUT_MEASUREMENT RailP_pFlt /end OUT_MEASUREMENT
 /begin LOC_MEASUREMENT RailP_pCurr_mp RailP_pFltWinNeg_mp RailP_stSubsVal RailP_tiFltPT1_mp /end LOC_MEASUREMENT
/end FUNCTION
/begin FUNCTION RailP_VDGradMon "" /begin DEF_CHARACTERISTIC RailP_dpMaxHyd_C RailP_numGradExcdMax_C RailP_tidPresRst_C /end DEF_CHARACTERISTIC /begin REF_CHARACTERISTIC EngDa_tiEngOffInit_C /end REF_CHARACTERISTIC /begin IN_MEASUREMENT CoEng_st RailP_pLin /end IN_MEASUREMENT /begin LOC_MEASUREMENT RailP_ctGradExcd_mp RailP_stGrad RailP_tidPresRst_mp /end LOC_MEASUREMENT /end FUNCTION
/begin FUNCTION RailP_VDOfsTst ""
 /begin DEF_CHARACTERISTIC RailP_swtOfsTst_C RailP_swtSSpMon_C RailP_tiERS_C RailP_tiEvalDel_C RailP_tiOfsTstAftRun_C RailP_tiOfsTstDel_CUR RailP_tiOfsTstStrt_C RailP_tiStrErrDel_C RailP_tOfsTstAftRun_C RailP_tOfsTstDec_C RailP_tOfsTstInc_C RailP_tOfsTstStrt_C RailP_uOfsAftRunMax_C RailP_uOfsAftRunMin_C RailP_uOfsStrtMax_C RailP_uOfsStrtMin_C /end DEF_CHARACTERISTIC
 /begin IN_MEASUREMENT CEngDsT_t CoEng_st CoEng_stOld EpmHCrS_stSigMode Epm_nEng FuelT_tFlSys PCV_stMSA PCV_stNoStrt RailP_pFlt RailP_uRaw SyC_stSub /end IN_MEASUREMENT
 /begin OUT_MEASUREMENT RailP_uOfsStrt /end OUT_MEASUREMENT
 /begin LOC_MEASUREMENT RailP_stEngStrtMov_mp RailP_stERS_mp RailP_stMon_mp RailP_stOfsTstMon RailP_tClntLstCyc_mp RailP_tiOfsTstDel_mp RailP_uOfsAftRun RailP_uOfsAftRunMax RailP_uOfsAftRunMin RailP_uOfsStrtMax RailP_uOfsStrtMin /end LOC_MEASUREMENT
/end FUNCTION
/begin FUNCTION Rail_CtlLoop ""
 /begin DEF_CHARACTERISTIC MeUn_dvolSet_C MeUn_swtDvolSet_C PCV_pSet_C PCV_swtPSet_C Rail_dpPCVSetShOffDec_C Rail_dvolDvtLim_C Rail_dvolMeUnClose_CUR Rail_dvolMeUnCtlInitI_CUR Rail_dvolMeUnOpn_CUR Rail_dvolMeUnShutOffErr_C Rail_dvolMeUnShutOff_C Rail_dvolOff_C Rail_dvolPCVClose_CUR Rail_dvolPCVOpn_CUR Rail_dvolStrt_C Rail_facMeUnDvt_CUR Rail_facMeUnSetPoint_CUR Rail_facPCVDvt_CUR Rail_facPCVFast_C Rail_nCloseCtl_C Rail_nMeUnFrzI_C Rail_nThresStrt_C Rail_numRevDel_C Rail_numRevPlaus_C Rail_pCloseCtl_C Rail_pDiffCloseCtl_C Rail_pDvtFltMin_C Rail_pMeUnPreCtlOff_C Rail_pMeUnPreCtlOn_C Rail_pOpnCtl_C Rail_pPCVInitI_MAP Rail_pSetMin_CUR Rail_stCtlLoopSel_C Rail_swtMeUnCtlIInit_C Rail_swtPCVInitI_C Rail_tiFrzIDel_C Rail_tiMeUnRmpDur_CUR Rail_tiPT1CPCDvt_C Rail_tiShutOffDblCtl_C Rail_tiSwtCPCMax_C Rail_tiSwtToMeUnCtl_C Rail_vMeUnThresShutOff_C /end DEF_CHARACTERISTIC
 /begin IN_MEASUREMENT CoEng_st CoEng_stShutOffPath CoEng_stTst Epm_nEng FlSys_stDeflateFin FuelT_tFlSys MeUn_dvolSet PCV_pSet RailP_pFlt Rail_pSetPoint Rail_stCtlType Rail_swtCtlSel Rail_swtPreCtl Rail_swtPress Rail_swtWindUp VehV_v /end IN_MEASUREMENT
 /begin OUT_MEASUREMENT Rail_dvolEstAged Rail_dvolMeUnCtlI Rail_dvolMeUnCtlUpLim Rail_dvolPreCtl Rail_pDvt Rail_stCPC Rail_stCtlLoop Rail_stPCVWindUp /end OUT_MEASUREMENT
 /begin LOC_MEASUREMENT Rail_dvolCPCDvtFlt_mp Rail_dvolCPCDvt_mp Rail_dvolMeUnCtlDT1_mp Rail_dvolMeUnCtlP_mp Rail_dvolMeUnDvt Rail_dvolMeUnShutOff_mp Rail_dvolSetPoint_mp Rail_facMeUnTiRmpVal_mp Rail_pDvtFltLim_mp Rail_pMeUnDvt Rail_pMeUnDvtPre_mp Rail_pPCVCPCOfs_mp Rail_pPCVCtlDT1_mp Rail_pPCVCtlI_mp Rail_pPCVCtlPILim_mp Rail_pPCVCtlP_mp Rail_pPCVDvt Rail_pPCVDvtPre_mp Rail_pPCVInitI_mp Rail_pPT1Flt_mp Rail_pSetMin_mp Rail_pWindUp_mp Rail_stMeUnFrzI_mp Rail_tiMeUnRmpDur_mp Rail_tiSwtCPC_mp /end LOC_MEASUREMENT
/end FUNCTION
/begin FUNCTION Rail_CtlLoopLimMeUn ""
 /begin DEF_CHARACTERISTIC Rail_dvolMeUnCtlLoLim_C Rail_dvolMeUnCtlUpLim_C Rail_dvolMeUnCtlUpLim_CUR /end DEF_CHARACTERISTIC
 /begin IN_MEASUREMENT Epm_nEng /end IN_MEASUREMENT
/end FUNCTION
/begin FUNCTION Rail_CtlLoopLimPCV ""
 /begin DEF_CHARACTERISTIC Rail_pPCVCtlLoLimStrt_C Rail_pPCVCtlLoLim_C Rail_pPCVCtlUpLimStrt_C Rail_pPCVCtlUpLim_C /end DEF_CHARACTERISTIC
 /begin IN_MEASUREMENT CoEng_st /end IN_MEASUREMENT
 /begin LOC_MEASUREMENT Rail_pPCVCtlLoLim_mp Rail_pPCVCtlUpLim_mp /end LOC_MEASUREMENT
/end FUNCTION
/begin FUNCTION Rail_CtlLoopParaMeUn ""
 /begin DEF_CHARACTERISTIC Rail_facOvrMeUnNegIncr_C Rail_MeUnCtlDKd_CUR Rail_MeUnCtlIKiHpTst_CUR Rail_MeUnCtlIKiNeg_CUR Rail_MeUnCtlIKiPos_CUR Rail_MeUnCtlIKi_CUR Rail_MeUnCtlPKpHpTst_CUR Rail_MeUnCtlPKpNeg_CUR Rail_MeUnCtlPKpPos_CUR Rail_MeUnCtlPKp_CUR Rail_pMeUnCtlIWinNeg_C Rail_pMeUnCtlIWinPos_C Rail_pMeUnCtlPWinNeg_C Rail_pMeUnCtlPWinPos_C Rail_pOvrMeUnThresHigh_C Rail_pOvrMeUnThresLow_C Rail_tiMeUnCtlDT1_CUR Rail_tiMeUnCtlPT1_CUR /end DEF_CHARACTERISTIC
 /begin IN_MEASUREMENT Epm_nEng RailP_pFlt /end IN_MEASUREMENT
 /begin LOC_MEASUREMENT Rail_MeUnCtlDKd_mp Rail_MeUnCtlIKiHpTst_mp Rail_MeUnCtlIKiNeg_mp Rail_MeUnCtlIKiPos_mp Rail_MeUnCtlIKi_mp Rail_MeUnCtlPKpHpTst_mp Rail_MeUnCtlPKpNeg_mp Rail_MeUnCtlPKpPos_mp Rail_MeUnCtlPKp_mp Rail_tiMeUnCtlDT1_mp Rail_tiMeUnCtlPT1_mp /end LOC_MEASUREMENT
/end FUNCTION
/begin FUNCTION Rail_CtlLoopParaPCV ""
 /begin DEF_CHARACTERISTIC Rail_facOvrPCVNegIncr_C Rail_PCVCtlDKd_CUR Rail_PCVCtlIKiNeg_CUR Rail_PCVCtlIKiPos_CUR Rail_PCVCtlIKi_CUR Rail_PCVCtlPKpNeg_CUR Rail_PCVCtlPKpPos_CUR Rail_PCVCtlPKp_CUR Rail_pOvrPCVThresHigh_C Rail_pOvrPCVThresLow_C Rail_pPCVCtlIWinNeg_C Rail_pPCVCtlIWinPos_C Rail_pPCVCtlPWinNeg_C Rail_pPCVCtlPWinPos_C Rail_tiPCVCtlDT1_CUR /end DEF_CHARACTERISTIC
 /begin IN_MEASUREMENT Epm_nEng RailP_pFlt /end IN_MEASUREMENT
 /begin LOC_MEASUREMENT Rail_PCVCtlDKd_mp Rail_PCVCtlIKiNeg_mp Rail_PCVCtlIKiPos_mp Rail_PCVCtlIKi_mp Rail_PCVCtlPKpNeg_mp Rail_PCVCtlPKpPos_mp Rail_PCVCtlPKp_mp Rail_tiPCVCtlDT1_mp /end LOC_MEASUREMENT
/end FUNCTION
/begin FUNCTION Rail_CtlTypeSwt ""
 /begin DEF_CHARACTERISTIC Rail_dvolMeUnCtlType_CUR Rail_pMeUnCtlTypeHi_C Rail_pMeUnCtlTypeLo_C Rail_qCPCtlTypeHys_C Rail_qCPCtlTypeRgnHys_C Rail_qCPCtlTypeRgn_CUR Rail_qCPCtlType_CUR Rail_qMeUnCtlTypeHys_C Rail_qMeUnCtlType_CUR Rail_stOpModeRgn_C Rail_swtCtlType_C Rail_tiSwtCtlTypeDel_C Rail_tMeUnCtlTypeHi_C Rail_tMeUnCtlTypeLo_C Rail_tSwtCPCHi_C Rail_tSwtCPCLo_C /end DEF_CHARACTERISTIC
 /begin IN_MEASUREMENT CoEng_st CoEOM_stOpModeAct Epm_nEng FuelT_tFlSys InjCtl_qCurr MeUn_dvolSet PCV_stAdaptMeUn Rail_pSetPoint Rail_stCtlLoop Rail_swtCtlSel /end IN_MEASUREMENT
 /begin LOC_MEASUREMENT Rail_dvolMeUnCtlType_mp Rail_qCPCtlTypeRgn_mp Rail_qCPCtlType_mp Rail_qMeUnCtlType_mp Rail_stSwtCon_mp Rail_stSwtCPCCon_mp /end LOC_MEASUREMENT
/end FUNCTION
/begin FUNCTION Rail_ErrDet "" /begin IN_MEASUREMENT VehV_v /end IN_MEASUREMENT /end FUNCTION
/begin FUNCTION Rail_HiPresTst ""
 /begin DEF_CHARACTERISTIC Rail_iMeUnClsHpTst_C Rail_nDiffMaxHpTst_C Rail_nHpTst_CA Rail_pDiffMaxHpTst_C Rail_pDltHiHpTst_C Rail_pDltTmrUpHpTst_C Rail_pSetMaxHpTst_C Rail_pSetMinHpTst_C Rail_pSetZLHpTst_C Rail_pStepHpTst_C Rail_pTmrDwn1HpTst_C Rail_pTmrDwn2HpTst_C Rail_qDiffMaxHpTst_C Rail_rAccPedHpTst_C Rail_stMskCoEOMOpModeHpTst_C Rail_swt5StepHpTst_C Rail_swtCtlParHpTst_C Rail_swtNoChkRefHpTst_C Rail_tClntMinHpTst_C Rail_tiBuildUpMaxHpTst_CA Rail_tiDropMaxHpTst_CA Rail_tiDropMinHpTst_CA Rail_tiStepHpTst_C Rail_tiStrtHpTst_C Rail_tiWaitAftDropHpTst_C Rail_tiWaitHiHpTst_C Rail_tiWaitLoHpTst_C /end DEF_CHARACTERISTIC
 /begin IN_MEASUREMENT APP_rUnFlt Brk_st CEngDsT_t Clth_st CoEOM_stOpModeAct Epm_nEng HLSDem_nSetPLo InjCtl_qSetUnBal PT_stTraType RailP_pFlt Rail_pMaxSetSubst Rail_stCtlLoop VehV_v /end IN_MEASUREMENT
 /begin OUT_MEASUREMENT Rail_iMeUnClsHpTst Rail_nHpTst Rail_pDltTmrUpHpTst Rail_pSetHiHpTst Rail_pSetMaxHpTst Rail_pSetMinHpTst Rail_pSetZLHpTst Rail_pStepHpTst Rail_pTmrDwn1HpTst Rail_pTmrDwn2HpTst Rail_stDwn1HpTst Rail_stDwn2HpTst Rail_stDwn3HpTst Rail_stDwnHpTst Rail_stEffectHpTst Rail_stRefHpTst Rail_stStMHpTst Rail_stUp1HpTst Rail_stUpHpTst Rail_swt5StepHpTst Rail_swtCtlParHpTst Rail_swtTstParHpTst Rail_tiDwnHpTst Rail_tiUpHpTst /end OUT_MEASUREMENT
 /begin LOC_MEASUREMENT Rail_cntHpTst_mp Rail_cntInjHpTst_mp Rail_nSetPntHpTst_mp Rail_pMinRailSetPnt_mp Rail_pSetPntHpTst_mp Rail_pTmrUpHpTst_mp Rail_qAvrgHpTst_mp Rail_stnDem_mp Rail_tiHpTst_mp Rail_tiRmpHpTst_mp /end LOC_MEASUREMENT
/end FUNCTION
/begin FUNCTION Rail_MonCPC "" /begin DEF_CHARACTERISTIC Rail_pCPCFltMax_C Rail_pCPCFltMin_CUR /end DEF_CHARACTERISTIC
 /begin IN_MEASUREMENT Epm_nEng RailP_pFlt Rail_dpSetPointDec Rail_dpSetPointInc Rail_stCPC Rail_stCtlLoop Rail_stPCVWindUp Rail_swtCtlSel /end IN_MEASUREMENT
 /begin LOC_MEASUREMENT Rail_pCPCFltMin_mp Rail_stCPCMon1_mp Rail_stCPCMon3_mp Rail_stCPCMon4_mp /end LOC_MEASUREMENT
/end FUNCTION
/begin FUNCTION Rail_MonLib "" /end FUNCTION
/begin FUNCTION Rail_MonMeUn ""
 /begin DEF_CHARACTERISTIC Rail_dvolMeUnLimFst_CUR Rail_MeUnMon.dvolSetMin_C Rail_MeUnMon.pFltMax_C Rail_MeUnMon.pFltMax2_C Rail_MeUnMon.pDvtMax_C Rail_MeUnMon.qLoIdl_C Rail_MeUnMon.tLoIdl_C Rail_MeUnMon.stRls_C Rail_pMeUnDvtFst_CUR Rail_pMeUnDvtMax_CUR Rail_pMeUnDvtMin2_CUR Rail_pMeUnDvtMin_CUR Rail_pMeUnFltMin_CUR /end DEF_CHARACTERISTIC
 /begin IN_MEASUREMENT Epm_nEng FuelT_tFlSys InjCtl_qSetUnBal MeUn_dvolSet RailP_pFlt Rail_dpSetPointDec Rail_dpSetPointInc Rail_dvolMeUnCtlUpLim Rail_pDvt Rail_stCtlLoop /end IN_MEASUREMENT
 /begin LOC_MEASUREMENT Rail_dvolMeUnLimFst_mp Rail_pMeUnDvtFst_mp Rail_pMeUnDvtMax_mp Rail_pMeUnDvtMin2_mp Rail_pMeUnDvtMin_mp Rail_pMeUnFltMin_mp Rail_stMeUnMon0_mp Rail_stMeUnMon1_mp Rail_stMeUnMon22_mp Rail_stMeUnMon2_mp Rail_stMeUnMon3_mp Rail_stMeUnMon42_mp Rail_stMeUnMon4_mp Rail_stMeUnMon5_mp Rail_tiMeUn0Deb_mp Rail_tiMeUn1Deb_mp Rail_tiMeUn22Deb_mp Rail_tiMeUn2Deb_mp Rail_tiMeUn3Deb_mp Rail_tiMeUn42Deb_mp Rail_tiMeUn4Deb_mp Rail_tiMeUn5Deb_mp /end LOC_MEASUREMENT
/end FUNCTION
/begin COMPU_METHOD COEOM_EGRCLGTRQNUMMAP_SY_Compu "" TAB_NOINTP "%6.3" "" COMPU_TAB_REF COEOM_EGRCLGTRQNUMMAP_SY_Compu /end COMPU_METHOD
/begin COMPU_TAB COEOM_EGRCLGTRQNUMMAP_SY_Compu "" TAB_NOINTP 8 0 0 1 1 2 2 3 3 4 4 5 5 6 6 7 7 /end COMPU_TAB
/begin COMPU_METHOD Curr "" RAT_FUNC "%6.2" "mA" COEFFS 0 1 0 0 0 1 /end COMPU_METHOD
/begin COMPU_METHOD Def_dez_sb_q1 "" RAT_FUNC "%3.1" "-" COEFFS 0 1 0 0 0 1 /end COMPU_METHOD
/begin COMPU_METHOD Def_dez_ub_q1 "" RAT_FUNC "%3.1" "-" COEFFS 0 1 0 0 0 1 /end COMPU_METHOD
/begin COMPU_METHOD Def_dez_ul_q1 "" RAT_FUNC "%7.3" "-" COEFFS 0 1 0 0 0 1 /end COMPU_METHOD
/begin COMPU_METHOD Def_dez_uw_q1 "" RAT_FUNC "%5.2" "-" COEFFS 0 1 0 0 0 1 /end COMPU_METHOD
/begin COMPU_METHOD Def_f_sb_b64 "" RAT_FUNC "%5.2" "-" COEFFS 0 2 0 0 0 1 /end COMPU_METHOD
/begin COMPU_METHOD Def_f_sw_b0p03125 "" RAT_FUNC "%9.8" "-" COEFFS 0 1048576 0 0 0 1 /end COMPU_METHOD
/begin COMPU_METHOD Def_f_sw_b0p125 "" RAT_FUNC "%9.8" "-" COEFFS 0 262144 0 0 0 1 /end COMPU_METHOD
/begin COMPU_METHOD Def_f_sw_b32 "" RAT_FUNC "%9.6" "-" COEFFS 0 1024 0 0 0 1 /end COMPU_METHOD
/begin COMPU_METHOD Def_f_sw_b8 "" RAT_FUNC "%9.7" "-" COEFFS 0 4096 0 0 0 1 /end COMPU_METHOD
/begin COMPU_METHOD Def_f_sw_q0p01 "" RAT_FUNC "%7.5" "-" COEFFS 0 100 0 0 0 1 /end COMPU_METHOD
/begin COMPU_METHOD Def_f_sw_q0p1 "" RAT_FUNC "%7.4" "-" COEFFS 0 10 0 0 0 1 /end COMPU_METHOD
/begin COMPU_METHOD Def_f_ub_b100 "" RAT_FUNC "%5.2" "%" COEFFS 0 2.56 0 0 0 1 /end COMPU_METHOD
/begin COMPU_METHOD Def_f_ub_b16 "" RAT_FUNC "%5.3" "-" COEFFS 0 16 0 0 0 1 /end COMPU_METHOD
/begin COMPU_METHOD Def_f_ub_b2 "" RAT_FUNC "%6.4" "-" COEFFS 0 128 0 0 0 1 /end COMPU_METHOD
/begin COMPU_METHOD Def_f_ub_b8 "" RAT_FUNC "%5.3" "-" COEFFS 0 32 0 0 0 1 /end COMPU_METHOD
/begin COMPU_METHOD Def_f_ul_q0p00047 "" RAT_FUNC "%11.8" "-" COEFFS 0 2133.33333333333 0 0 0 1 /end COMPU_METHOD
/begin COMPU_METHOD Def_f_uw_b0p5 "" RAT_FUNC "%14.11" "-" COEFFS 0 131072 0 0 0 1 /end COMPU_METHOD
/begin COMPU_METHOD Def_f_uw_b1 "" RAT_FUNC "%14.10" "-" COEFFS 0 65536 0 0 0 1 /end COMPU_METHOD
/begin COMPU_METHOD Def_f_uw_b100 "" RAT_FUNC "%8.5" "%" COEFFS 0 655.36 0 0 0 1 /end COMPU_METHOD
/begin COMPU_METHOD Def_f_uw_b16 "" RAT_FUNC "%9.7" "-" COEFFS 0 4096 0 0 0 1 /end COMPU_METHOD
/begin COMPU_METHOD Def_f_uw_b64 "" RAT_FUNC "%9.6" "-" COEFFS 0 1024 0 0 0 1 /end COMPU_METHOD
/begin COMPU_METHOD Def_f_uw_b8192 "" RAT_FUNC "%7.3" "-" COEFFS 0 8 0 0 0 1 /end COMPU_METHOD
/begin COMPU_METHOD Def_f_uw_q0p00047 "" RAT_FUNC "%9.7" "°KW/%" COEFFS 0 2133.33333333333 0 0 0 1 /end COMPU_METHOD
/begin COMPU_METHOD Def_f_uw_q0p25 "" RAT_FUNC "%8.4" "" COEFFS 0 4 0 0 0 1 /end COMPU_METHOD
/begin COMPU_METHOD Def_i_sw_q0p001 "" RAT_FUNC "%8.6" "A" COEFFS 0 1000 0 0 0 1 /end COMPU_METHOD
/begin COMPU_METHOD Def_i_sw_q0p03125 "" RAT_FUNC "%8.5" "A" COEFFS 0 32 0 0 0 1 /end COMPU_METHOD
/begin COMPU_METHOD Def_i_sw_q0p125 "" RAT_FUNC "%8.4" "A" COEFFS 0 8 0 0 0 1 /end COMPU_METHOD
/begin COMPU_METHOD Def_i_uw_b1024 "" RAT_FUNC "%5.3" "mA" COEFFS 0 64 0 0 0 1 /end COMPU_METHOD
/begin COMPU_METHOD Def_ql_sb_q1 "" RAT_FUNC "%3.1" "Ah" COEFFS 0 1 0 0 0 1 /end COMPU_METHOD
/begin COMPU_METHOD Def_ql_ub_q1 "" RAT_FUNC "%4.1" "" COEFFS 0 1 0 0 0 1 /end COMPU_METHOD
/begin COMPU_METHOD Def_st_ub_q1 "" RAT_FUNC "%3.1" "-" COEFFS 0 1 0 0 0 1 /end COMPU_METHOD
/begin COMPU_METHOD Def_td_ub_q0p01 "" RAT_FUNC "%5.4" "s" COEFFS 0 100 0 0 0 1 /end COMPU_METHOD
/begin COMPU_METHOD Def_td_uw_q0p001 "" RAT_FUNC "%8.6" "ms" COEFFS 0 1000 0 0 0 1 /end COMPU_METHOD
/begin COMPU_METHOD Def_td_uw_q0p1 "" RAT_FUNC "%6.3" "s" COEFFS 0 10 0 0 0 1 /end COMPU_METHOD
/begin COMPU_METHOD Def_td_uw_q1 "" RAT_FUNC "%5.2" "s" COEFFS 0 1 0 0 0 1 /end COMPU_METHOD
/begin COMPU_METHOD Def_th_uw_q1 "" RAT_FUNC "%5.2" "h" COEFFS 0 1 0 0 0 1 /end COMPU_METHOD
/begin COMPU_METHOD Def_t_sw_q0p1 "" RAT_FUNC "%6.3" "°C" COEFFS 0 10 0 0 0 1 /end COMPU_METHOD
/begin COMPU_METHOD Def_u_sw_b128 "" RAT_FUNC "%8.5" "V" COEFFS 0 256 0 0 0 1 /end COMPU_METHOD
/begin COMPU_METHOD Def_u_sw_q0p00025 "" RAT_FUNC "%9.7" "" COEFFS 0 4000 0 0 0 1 /end COMPU_METHOD
/begin COMPU_METHOD Def_u_uw_b25p5 "" RAT_FUNC "%9.7" "V" COEFFS 0 2570.03921568627 0 0 0 1 /end COMPU_METHOD
/begin COMPU_METHOD Def_u_uw_q0p00488 "" RAT_FUNC "%8.5" "V" COEFFS 0 204.8 0 0 0 1 /end COMPU_METHOD
/begin COMPU_METHOD Def_u_uw_q0p015 "" RAT_FUNC "%8.5" "V" COEFFS 0 66.6666666666667 0 0 0 1 /end COMPU_METHOD
/begin COMPU_METHOD Def_u_uw_q0p25em3_o6 "" RAT_FUNC "%9.5" "" COEFFS 0 4000 -24000 0 0 1 /end COMPU_METHOD
/begin COMPU_METHOD dn_dZfine "" RAT_FUNC "%6.3" "rpm/s" COEFFS 0 2 0 0 0 1 /end COMPU_METHOD
/begin COMPU_METHOD dTrq "" RAT_FUNC "%6.3" "Nm/s" COEFFS 0 10 0 0 0 1 /end COMPU_METHOD
/begin COMPU_METHOD EngN "" RAT_FUNC "%5.1" "rpm" COEFFS 0 2 0 0 0 1 /end COMPU_METHOD
/begin COMPU_METHOD Fact "" RAT_FUNC "%6.5" "-" COEFFS 0 8192 0 0 0 1 /end COMPU_METHOD
/begin COMPU_METHOD Fact1 "" RAT_FUNC "%6.4" "-" COEFFS 0 128 0 0 0 1 /end COMPU_METHOD
/begin COMPU_METHOD Fact100 "" RAT_FUNC "%6.4" "-" COEFFS 0 100 0 0 0 1 /end COMPU_METHOD
/begin COMPU_METHOD FanSpd "" RAT_FUNC "%6.3" "rpm" COEFFS 0 10.9223333333333 0 0 0 1 /end COMPU_METHOD
/begin COMPU_METHOD FlConsum_l_h "" RAT_FUNC "%6.4" "l/h" COEFFS 0 100 0 0 0 1 /end COMPU_METHOD
/begin COMPU_METHOD ident "" RAT_FUNC "%3.1" "-" COEFFS 0 1 0 0 0 1 /end COMPU_METHOD
/begin COMPU_METHOD Identity "" RAT_FUNC "%3.1" "-" COEFFS 0 1 0 0 0 1 /end COMPU_METHOD
/begin COMPU_METHOD InjMass "" RAT_FUNC "%5.2" "mg/hub" COEFFS 0 100 0 0 0 1 /end COMPU_METHOD
/begin COMPU_METHOD InjMassInj "" RAT_FUNC "%5.2" "mg/inj" COEFFS 0 100 0 0 0 1 /end COMPU_METHOD
/begin COMPU_METHOD InjTime_us "" RAT_FUNC "%5.1" "us" COEFFS 0 2.5 0 0 0 1 /end COMPU_METHOD
/begin COMPU_METHOD Kd "" RAT_FUNC "%7.6" "1/1" COEFFS 0 65536 0 0 0 1 /end COMPU_METHOD
/begin COMPU_METHOD Kd_1 "" RAT_FUNC "%6.4" "1/1" COEFFS 0 512 0 0 0 1 /end COMPU_METHOD
/begin COMPU_METHOD Kd_pRail2Q "" RAT_FUNC "%11.4" "mm^3/s/bar" COEFFS 0 655.360000 0 0 0 1 /end COMPU_METHOD
/begin COMPU_METHOD Kd_pRail2Q_1 "" RAT_FUNC "%10.3" "mm^3/s/bar" COEFFS 0 40.960000 0 0 0 1 /end COMPU_METHOD
/begin COMPU_METHOD Ki "" RAT_FUNC "%6.5" "1/s" COEFFS 0 2147.483648 0 0 0 1 /end COMPU_METHOD
/begin COMPU_METHOD Ki_1 "" RAT_FUNC "%6.4" "1/s" COEFFS 0 67.108864 0 0 0 1 /end COMPU_METHOD
/begin COMPU_METHOD Ki_pRail2Q "" RAT_FUNC "%10.3" "mm^3/s^2/bar" COEFFS 0 21.474836 0 0 0 1 /end COMPU_METHOD
/begin COMPU_METHOD Ki_pRail2Q_1 "" RAT_FUNC "%10.3" "mm^3/s^2/bar" COEFFS 0 10.737418 0 0 0 1 /end COMPU_METHOD
/begin COMPU_METHOD Kp "" RAT_FUNC "%7.6" "1/1" COEFFS 0 32768 0 0 0 1 /end COMPU_METHOD
/begin COMPU_METHOD Kp_1 "" RAT_FUNC "%6.4" "1/1" COEFFS 0 64 0 0 0 1 /end COMPU_METHOD
/begin COMPU_METHOD Kp_pRail2Q "" RAT_FUNC "%11.4" "mm^3/s/bar" COEFFS 0 327.680000 0 0 0 1 /end COMPU_METHOD
/begin COMPU_METHOD Kp_pRail2Q_1 "" RAT_FUNC "%10.3" "mm^3/s/bar" COEFFS 0 81.920000 0 0 0 1 /end COMPU_METHOD
/begin COMPU_METHOD Moment_Inertia "" RAT_FUNC "%6.4" "" COEFFS 0 100 0 0 0 1 /end COMPU_METHOD
/begin COMPU_METHOD Mo_trq_nm_q0p1 "" RAT_FUNC "%6.3" "Nm" COEFFS 0 10 0 0 0 1 /end COMPU_METHOD
/begin COMPU_METHOD OneToOne "" RAT_FUNC "%6.0" "-" COEFFS 0 1 0 0 0 1 /end COMPU_METHOD
/begin COMPU_METHOD Prc "" RAT_FUNC "%6.4" "%" COEFFS 0 81.92 0 0 0 1 /end COMPU_METHOD
/begin COMPU_METHOD PresRail_sec "" RAT_FUNC "%4.3" "bar/s" COEFFS 0 2.500000 0 0 0 1 /end COMPU_METHOD
/begin COMPU_METHOD Pres_hPa "" RAT_FUNC "%5.1" "hPa" COEFFS 0 1 0 0 0 1 /end COMPU_METHOD
/begin COMPU_METHOD Pres_Rail "" RAT_FUNC "%5.1" "bar" COEFFS 0 10.000000 0 0 0 1 /end COMPU_METHOD
/begin COMPU_METHOD QntR "" RAT_FUNC "%6.5" "-" COEFFS 0 1024 0 0 0 1 /end COMPU_METHOD
/begin COMPU_METHOD Qp_mm3_sec "" RAT_FUNC "%6.1" "mm3/s" COEFFS 0 0.1 0 0 0 1 /end COMPU_METHOD
/begin COMPU_METHOD QWC_st_VERB "" TAB_VERB "%6.3" "-" COMPU_TAB_REF QWC_st_VERB /end COMPU_METHOD
/begin COMPU_VTAB QWC_st_VERB "" TAB_VERB 2 0 "QWC_OFF" 1 "QWC_ON" /end COMPU_VTAB
/begin COMPU_METHOD RmpPres_hPa "" RAT_FUNC "%6.4" "hPa/s" COEFFS 0 65.536 0 0 0 1 /end COMPU_METHOD
/begin COMPU_METHOD RmpTransR "" RAT_FUNC "%6.5" "-" COEFFS 0 6553.6 0 0 0 1 /end COMPU_METHOD
/begin COMPU_METHOD RmpTrq "" RAT_FUNC "%6.4" "Nm/s" COEFFS 0 655.36 0 0 0 1 /end COMPU_METHOD
/begin COMPU_METHOD TempDiff_Kelv "" RAT_FUNC "%4.1" "K" COEFFS 0 10 0 0 0 1 /end COMPU_METHOD
/begin COMPU_METHOD Temp_Cels "" RAT_FUNC "%5.1" "deg C" COEFFS 0 10 2731.4 0 0 1 /end COMPU_METHOD
/begin COMPU_METHOD TimeDeb "" RAT_FUNC "%5.0" "ms" COEFFS 0 0.1 0 0 0 1 /end COMPU_METHOD
/begin COMPU_METHOD TimeDelay_s "" RAT_FUNC "%12.4" "s" COEFFS 0 0 1 0 0.00023283064365387 0 /end COMPU_METHOD
/begin COMPU_METHOD TimeDelay_s_2 "" RAT_FUNC "%9.4" "s" COEFFS 0 0 1 0 0.0596046447753906 0 /end COMPU_METHOD
/begin COMPU_METHOD TimeDT "" RAT_FUNC "%6.2" "us" COEFFS 0 1 0 0 0 1 /end COMPU_METHOD
/begin COMPU_METHOD TimeRed "" RAT_FUNC "%6.3" "s" COEFFS 0 6.25 0 0 0 1 /end COMPU_METHOD
/begin COMPU_METHOD Time_Dt "" RAT_FUNC "%9.8" "s" COEFFS 0 1000000 0 0 0 1 /end COMPU_METHOD
/begin COMPU_METHOD Time_ms "" RAT_FUNC "%5.0" "ms" COEFFS 0 0.1 0 0 0 1 /end COMPU_METHOD
/begin COMPU_METHOD Time_s "" RAT_FUNC "%5.2" "s" COEFFS 0 100 0 0 0 1 /end COMPU_METHOD
/begin COMPU_METHOD TransR "" RAT_FUNC "%4.2" "-" COEFFS 0 100 0 0 0 1 /end COMPU_METHOD
/begin COMPU_METHOD Trq "" RAT_FUNC "%5.1" "Nm" COEFFS 0 10 0 0 0 1 /end COMPU_METHOD
/begin COMPU_METHOD TrqPrpHigh "" RAT_FUNC "%5.1" "Nm" COEFFS 0 10 0 0 0 1 /end COMPU_METHOD
/begin COMPU_METHOD Vel "" RAT_FUNC "%5.2" "km/h" COEFFS 0 100 0 0 0 1 /end COMPU_METHOD
/begin COMPU_METHOD Volt "" RAT_FUNC "%6.1" "mV" COEFFS 0 5 0 0 0 1 /end COMPU_METHOD
/begin RECORD_LAYOUT CurTKL_SW_VV_UB NO_AXIS_PTS_X 1 UBYTE RESERVED 2 BYTE AXIS_PTS_X 3 SWORD INDEX_INCR DIRECT FNC_VALUES 4 UBYTE COLUMN_DIR DIRECT /end RECORD_LAYOUT
/begin RECORD_LAYOUT CurTKL_UB_VV_UB NO_AXIS_PTS_X 1 UBYTE RESERVED 2 BYTE AXIS_PTS_X 3 UBYTE INDEX_INCR DIRECT FNC_VALUES 4 UBYTE COLUMN_DIR DIRECT /end RECORD_LAYOUT
/begin RECORD_LAYOUT CurTKL_UW_VV_UB NO_AXIS_PTS_X 1 UBYTE RESERVED 2 BYTE AXIS_PTS_X 3 UWORD INDEX_INCR DIRECT FNC_VALUES 4 UBYTE COLUMN_DIR DIRECT /end RECORD_LAYOUT
/begin RECORD_LAYOUT Cur_Xs16Ws16 NO_AXIS_PTS_X 1 SWORD AXIS_PTS_X 2 SWORD INDEX_INCR DIRECT FNC_VALUES 3 SWORD COLUMN_DIR DIRECT /end RECORD_LAYOUT
/begin RECORD_LAYOUT Kf_Xs16_Ys16_Ws16 NO_AXIS_PTS_X 1 SWORD NO_AXIS_PTS_Y 2 SWORD AXIS_PTS_X 3 SWORD INDEX_INCR DIRECT AXIS_PTS_Y 4 SWORD INDEX_INCR DIRECT FNC_VALUES 5 SWORD COLUMN_DIR DIRECT /end RECORD_LAYOUT
/begin RECORD_LAYOUT Kw_Ws16 FNC_VALUES 1 SWORD COLUMN_DIR DIRECT /end RECORD_LAYOUT
/begin RECORD_LAYOUT Kw_Ws32 FNC_VALUES 1 SLONG COLUMN_DIR DIRECT /end RECORD_LAYOUT
/begin RECORD_LAYOUT Kw_Wu16 FNC_VALUES 1 UWORD COLUMN_DIR DIRECT /end RECORD_LAYOUT
/begin RECORD_LAYOUT Kw_Wu8 FNC_VALUES 1 UBYTE COLUMN_DIR DIRECT /end RECORD_LAYOUT
/begin RECORD_LAYOUT MapTKF_SW_UW_UW NO_AXIS_PTS_X 1 UBYTE NO_AXIS_PTS_Y 2 UBYTE AXIS_PTS_X 3 UWORD INDEX_INCR DIRECT AXIS_PTS_Y 4 SWORD INDEX_INCR DIRECT FNC_VALUES 5 UWORD COLUMN_DIR DIRECT /end RECORD_LAYOUT
/begin RECORD_LAYOUT MapTKF_UB_SW_SW NO_AXIS_PTS_X 1 UBYTE NO_AXIS_PTS_Y 2 UBYTE AXIS_PTS_X 3 SWORD INDEX_INCR DIRECT AXIS_PTS_Y 4 UBYTE INDEX_INCR DIRECT FNC_VALUES 5 SWORD COLUMN_DIR DIRECT /end RECORD_LAYOUT
/begin RECORD_LAYOUT Map_Xs16Ys16Ws16 NO_AXIS_PTS_X 1 SWORD NO_AXIS_PTS_Y 2 SWORD AXIS_PTS_X 3 SWORD INDEX_INCR DIRECT AXIS_PTS_Y 4 SWORD INDEX_INCR DIRECT FNC_VALUES 5 SWORD COLUMN_DIR DIRECT /end RECORD_LAYOUT
/begin RECORD_LAYOUT ValA_Ws16 FNC_VALUES 1 SWORD COLUMN_DIR DIRECT /end RECORD_LAYOUT
/begin RECORD_LAYOUT ValA_Ws32 FNC_VALUES 1 SLONG COLUMN_DIR DIRECT /end RECORD_LAYOUT
/begin RECORD_LAYOUT ValA_Wu8 FNC_VALUES 1 UBYTE COLUMN_DIR DIRECT /end RECORD_LAYOUT
/begin RECORD_LAYOUT Val_Ws16 FNC_VALUES 1 SWORD COLUMN_DIR DIRECT /end RECORD_LAYOUT
/begin RECORD_LAYOUT Val_Ws32 FNC_VALUES 1 SLONG COLUMN_DIR DIRECT /end RECORD_LAYOUT
/begin RECORD_LAYOUT Val_Ws8 FNC_VALUES 1 SBYTE COLUMN_DIR DIRECT /end RECORD_LAYOUT
/begin RECORD_LAYOUT Val_Wu16 FNC_VALUES 1 UWORD COLUMN_DIR DIRECT /end RECORD_LAYOUT
/begin RECORD_LAYOUT Val_Wu32 FNC_VALUES 1 ULONG COLUMN_DIR DIRECT /end RECORD_LAYOUT
/begin RECORD_LAYOUT Val_Wu8 FNC_VALUES 1 UBYTE COLUMN_DIR DIRECT /end RECORD_LAYOUT
/end MODULE
/end PROJECT

ASAP2_VERSION 1 4
/begin PROJECT P_574 "EDC17_CP09"
/begin HEADER "" VERSION "V8KB" PROJECT_NO P_574 /end HEADER
/begin MODULE DIM ""
/begin MOD_COMMON "" BYTE_ORDER MSB_LAST ALIGNMENT_BYTE 1 ALIGNMENT_WORD 2 ALIGNMENT_LONG 4 ALIGNMENT_FLOAT32_IEEE 4 /end MOD_COMMON
/begin CHARACTERISTIC DStgy_stMetStgy_C "" VALUE 0x8005DDB8 Val_Wu8 255.0 OneToOne 0.00 255.0 /end CHARACTERISTIC
/begin CHARACTERISTIC Rail_ctATSSel_C "Selektionsparameter für Arrayelement Ansauglufttemperatur (EngDa_tFld)" VALUE 0x8005CD6E Val_Wu8 3.00000000000 AirTempFldSel 0.00 3.00000000000 FORMAT "%13.11" /end CHARACTERISTIC
/begin CHARACTERISTIC Rail_dpSetPBase.Pos_C "Rampensteigung/" VALUE 0x8005B14C Kw_Ws32 13000000.0000 RmpPres_Rail 0.00 13000000.0000 FORMAT "%13.4" EXTENDED_LIMITS -3276800000.00 3276799998.47 /end CHARACTERISTIC
/begin CHARACTERISTIC Rail_dpSetPBase.Neg_C "Rampensteigung/" VALUE 0x8005B150 Kw_Ws32 13000000.0000 RmpPres_Rail 0.00 13000000.0000 FORMAT "%13.4" EXTENDED_LIMITS -3276800000.00 3276799998.47 /end CHARACTERISTIC
/begin CHARACTERISTIC Rail_dpSetPointDec_CUR "Kennlinie für maximalen Raildruck-Sollwertabfall pro Sekunde" CURVE 0x8005B154 Cur_Xs16Ws16 13000.000 PresRail_sec 0.00 13000.000 FORMAT "%5.3" EXTENDED_LIMITS -13107.200 13106.800
 /begin AXIS_DESCR STD_AXIS Rail_pSetPoint Pres_Rail 8 0.00 2000.000 EXTENDED_LIMITS -3276.800 3276.700 DEPOSIT ABSOLUTE /end AXIS_DESCR
/end CHARACTERISTIC
/begin CHARACTERISTIC Rail_dpSetPointInc_MAP "maximaler Raildruck-Sollwertanstieg pro Sekunde, abhängig von der Motordrehzahl und der Einspritzmenge" MAP 0x8005B176 Map_Xs16Ys16Ws16 13000.000 PresRail_sec 0.00 13000.000 FORMAT "%5.3" EXTENDED_LIMITS -13107.200 13106.800
 /begin AXIS_DESCR STD_AXIS Epm_nEng EngN 12 0.00 10000.00 EXTENDED_LIMITS -16384.00 16383.50 DEPOSIT ABSOLUTE /end AXIS_DESCR
 /begin AXIS_DESCR STD_AXIS InjCtl_qSetUnBal InjMass 8 0.00 327.6700 EXTENDED_LIMITS -327.6800 327.6700 DEPOSIT ABSOLUTE /end AXIS_DESCR
/end CHARACTERISTIC
/begin CHARACTERISTIC Rail_dtrqLimRmp.Pos_C "rampenparameter für Momentenbegrenzung/" VALUE 0x8005CE8C Kw_Ws32 3276799.99847 RmpTrq 0.00 3276799.99847 EXTENDED_LIMITS -3276800.00000 3276799.99847 /end CHARACTERISTIC
/begin CHARACTERISTIC Rail_dtrqLimRmp.Neg_C "rampenparameter für Momentenbegrenzung/" VALUE 0x8005CE90 Kw_Ws32 3276799.99847 RmpTrq 0.00 3276799.99847 EXTENDED_LIMITS -3276800.00000 3276799.99847 /end CHARACTERISTIC
/begin CHARACTERISTIC Rail_dvolLeak_MAP "Leckage-Kennfeld für Druckregelung über Zumesseinheit" MAP 0x8005A734 Map_Xs16Ys16Ws16 150000.0 Qp_mm3_sec 0.00 150000.0 FORMAT "%8.1" EXTENDED_LIMITS -327680.0 327670.0
 /begin AXIS_DESCR STD_AXIS Rail_pSetPoint Pres_Rail 10 0.00 2000.000 EXTENDED_LIMITS -3276.800 3276.700 DEPOSIT ABSOLUTE /end AXIS_DESCR
 /begin AXIS_DESCR STD_AXIS FuelT_tFlSys Temp_Cels 10 -50.14000 149.8600 EXTENDED_LIMITS -3549.940 3003.560 DEPOSIT ABSOLUTE /end AXIS_DESCR
/end CHARACTERISTIC
/begin CHARACTERISTIC Rail_dvolPreCtlBas_MAP "Basisvorsteuerkennfeld für Druckregelung über Zumesseinheit" MAP 0x8005A828 Map_Xs16Ys16Ws16 150000.0 Qp_mm3_sec 0.00 150000.0 FORMAT "%8.1" EXTENDED_LIMITS -327680.0 327670.0
 /begin AXIS_DESCR STD_AXIS Epm_nEng EngN 16 0.00 10000.00 EXTENDED_LIMITS -16384.00 16383.50 DEPOSIT ABSOLUTE /end AXIS_DESCR
 /begin AXIS_DESCR STD_AXIS Rail_qPreCtlBas_mp InjMass 16 0.00 327.6700 EXTENDED_LIMITS -327.6800 327.6700 DEPOSIT ABSOLUTE /end AXIS_DESCR
/end CHARACTERISTIC
/begin CHARACTERISTIC Rail_dvolPreCtlOfs_MAP "Offset Kennlinie des Vorsteuerwerts (Regelung über Zumesseinheit)" MAP 0x8005AA6C Map_Xs16Ys16Ws16 150000.0 Qp_mm3_sec 0.00 150000.0 FORMAT "%8.1" EXTENDED_LIMITS -327680.0 327670.0
 /begin AXIS_DESCR STD_AXIS Epm_nEng EngN 8 0.00 10000.00 EXTENDED_LIMITS -16384.00 16383.50 DEPOSIT ABSOLUTE /end AXIS_DESCR
 /begin AXIS_DESCR STD_AXIS InjCtl_qSetUnBal InjMass 8 0.00 327.6700 EXTENDED_LIMITS -327.6800 327.6700 DEPOSIT ABSOLUTE /end AXIS_DESCR
/end CHARACTERISTIC
/begin CHARACTERISTIC Rail_dvolPreCtlPoI1_MAP "Vorsteuerkennfeld abhängig von der Nacheinspritzmenge 1 für die Druckregelung über Zumesseinheit" MAP 0x8005AB10 Map_Xs16Ys16Ws16 150000.0 Qp_mm3_sec 0.00 150000.0 FORMAT "%8.1" EXTENDED_LIMITS -327680.0 327670.0
 /begin AXIS_DESCR STD_AXIS Epm_nEng EngN 2 0.00 10000.00 EXTENDED_LIMITS -16384.00 16383.50 DEPOSIT ABSOLUTE /end AXIS_DESCR
 /begin AXIS_DESCR STD_AXIS InjCrv_qPoI1Des_mp InjMass 4 0.00 327.6700 EXTENDED_LIMITS -327.6800 327.6700 DEPOSIT ABSOLUTE /end AXIS_DESCR
/end CHARACTERISTIC
/begin CHARACTERISTIC Rail_dvolPreCtlPoI2_MAP "Vorsteuerkennfeld abhängig von der Nacheinspritzmenge 2 für die Druckregelung über Zumesseinheit" MAP 0x8005AB30 Map_Xs16Ys16Ws16 150000.0 Qp_mm3_sec 0.00 150000.0 FORMAT "%8.1" EXTENDED_LIMITS -327680.0 327670.0
 /begin AXIS_DESCR STD_AXIS Epm_nEng EngN 2 0.00 10000.00 EXTENDED_LIMITS -16384.00 16383.50 DEPOSIT ABSOLUTE /end AXIS_DESCR
 /begin AXIS_DESCR STD_AXIS InjCrv_qPoI2Des_mp InjMass 4 0.00 327.6700 EXTENDED_LIMITS -327.6800 327.6700 DEPOSIT ABSOLUTE /end AXIS_DESCR
/end CHARACTERISTIC
/begin CHARACTERISTIC Rail_dvolPreCtl_C "Fernsteuerwert für Vorsteuerwert für die Druckregelung über Zumesseinheit" VALUE 0x8005AB50 Val_Ws16 150000.0 Qp_mm3_sec 0.00 150000.0 FORMAT "%8.1" EXTENDED_LIMITS -327680.0 327670.0 /end CHARACTERISTIC
/begin CHARACTERISTIC Rail_dvolRedOfsLimHi_C "Obere Volumenstrom Hystereseschwelle für Raildruck Offset Reduzierung" VALUE 0x8005AB58 Val_Ws16 655350.0 Qp_mm3_sec -327680.0 327670.0 FORMAT "%8.1" /end CHARACTERISTIC
/begin CHARACTERISTIC Rail_dvolRedOfsLimLo_C "Untere Volumenstrom Hystereseschwelle für Raildruck Offset Reduzierung" VALUE 0x8005AB5A Val_Ws16 655350.0 Qp_mm3_sec -327680.0 327670.0 FORMAT "%8.1" /end CHARACTERISTIC
/begin CHARACTERISTIC Rail_facAPPrSetPDynCor_CUR "Raildruckdynamikkorrekturkennlinie abhängig vom PWG Niveau" CURVE 0x8005B950 Kl_Xs16_Ws16 4.000000 Fact -2.000000 2.000000 EXTENDED_LIMITS -4.000000 3.999878
 /begin AXIS_DESCR STD_AXIS APP_r Prc 6 0.00 100.0000 EXTENDED_LIMITS -400.0000 399.9878 DEPOSIT ABSOLUTE /end AXIS_DESCR
/end CHARACTERISTIC
/begin CHARACTERISTIC Rail_facAPSetPDynCor_CUR "Gewichtungsfaktor für den Raildrucksollwert in Abhängigkeit vom Umgebungsdruck" CURVE 0x8005B96A Cur_Xs16Ws16 1.000000 Fact 0.00 1.000000 EXTENDED_LIMITS -4.000000 3.999878
 /begin AXIS_DESCR STD_AXIS EnvP_p Pres_hPa 6 0.00 3500.000 EXTENDED_LIMITS -32768.00 32767.00 DEPOSIT ABSOLUTE /end AXIS_DESCR
/end CHARACTERISTIC
/begin CHARACTERISTIC Rail_facDQSetPDynCor_CUR "Gewichtungsfaktor für die Raildrucksollwertkorrektur in Abhängigkeit von der Änderung der Einspritzmenge" CURVE 0x8005B984 Cur_Xs16Ws16 1.000000 Fact 0.00 1.000000 EXTENDED_LIMITS -4.000000 3.999878
 /begin AXIS_DESCR STD_AXIS InjCrv_dqSetUnBalFltLim InjMassPerSec_20ms 6 -16384.00 16383.50 FORMAT "%8.2" DEPOSIT ABSOLUTE /end AXIS_DESCR
/end CHARACTERISTIC
/begin CHARACTERISTIC Rail_facEGRpSetPCor_CUR "" CURVE 0x8005B99E Cur_Xs16Ws16 5.000000 Fact 0.00 5.000000 EXTENDED_LIMITS -4.000000 3.999878
 /begin AXIS_DESCR STD_AXIS ASMod_mEGRIntMnfDsCmb AirMassPerCyl 8 -3276.800 3276.700 DEPOSIT ABSOLUTE /end AXIS_DESCR
/end CHARACTERISTIC
/begin CHARACTERISTIC Rail_facETSetPDynCor_CUR "Gewichtungsfaktor für die Raildrucksollwertkorrektur in Abhängigkeit von der Motortemperatur" CURVE 0x8005B9C0 Cur_Xs16Ws16 1.000000 Fact 0.00 1.000000 EXTENDED_LIMITS -4.000000 3.999878
 /begin AXIS_DESCR STD_AXIS InjSys_tEng Temp_Cels 6 -50.14000 199.8600 EXTENDED_LIMITS -3549.940 3003.560 DEPOSIT ABSOLUTE /end AXIS_DESCR
/end CHARACTERISTIC
/begin CHARACTERISTIC Rail_facIASetPDynCor_CUR "Gewichtungsfaktor für die Raildrucksollwertkorrektur in Abhängigkeit von der Ansauglufttemperatur" CURVE 0x8005B9DA Cur_Xs16Ws16 1.000000 Fact 0.00 1.000000 EXTENDED_LIMITS -4.000000 3.999878
 /begin AXIS_DESCR STD_AXIS Rail_tAir Temp_Cels 6 -50.14000 199.8600 EXTENDED_LIMITS -3549.940 3003.560 DEPOSIT ABSOLUTE /end AXIS_DESCR
/end CHARACTERISTIC
/begin CHARACTERISTIC Rail_facIMTSpSetPCor_CUR "" CURVE 0x8005B9F4 Cur_Xs16Ws16 5.000000 Fact 0.00 5.000000 EXTENDED_LIMITS -4.000000 3.999878
 /begin AXIS_DESCR STD_AXIS Air_tCACDs Temp_Cels 8 -3549.940 3003.560 DEPOSIT ABSOLUTE /end AXIS_DESCR
/end CHARACTERISTIC
/begin CHARACTERISTIC Rail_facLeakAged_C "Faktor zur Bestimmung des maximal möglichen Volumenstroms bei einem gealterten System" VALUE 0x8005AB52 Val_Ws16 1.000000 Fact 0.00 1.000000 EXTENDED_LIMITS -4.000000 3.999878 /end CHARACTERISTIC
/begin CHARACTERISTIC Rail_facpSetPointVehCor_CUR "" CURVE 0x8005BA16 Cur_Xs16Ws16 100.0000 Fact 0.00 100.0000 EXTENDED_LIMITS -4.000000 3.999878
 /begin AXIS_DESCR STD_AXIS VehV_v Vel 4 0.00 300.0000 EXTENDED_LIMITS -327.6800 327.6700 DEPOSIT ABSOLUTE /end AXIS_DESCR
/end CHARACTERISTIC
/begin CHARACTERISTIC Rail_facpSetPointVehTempCor_CUR "" CURVE 0x8005BA28 Cur_Xs16Ws16 100.0000 Fact 0.00 100.0000 EXTENDED_LIMITS -4.000000 3.999878
 /begin AXIS_DESCR STD_AXIS CEngDsT_t Temp_Cels 8 -0.04000000 473.0600 EXTENDED_LIMITS -3549.940 3003.560 DEPOSIT ABSOLUTE /end AXIS_DESCR
/end CHARACTERISTIC
/begin CHARACTERISTIC Rail_facSetPointAPSCor0Rgn_GCUR "atmosphärendruckabhängigen Korrekturkennlinie für die Raildrucksollwertbildung für die Regenerationsstufe 1" CURVE 0x8005CDD6 CurG_Ws16 1.000000 Fact 0.00 1.000000 EXTENDED_LIMITS -4.000000 3.999878
 /begin AXIS_DESCR COM_AXIS EnvP_p Pres_hPa 8 0.00 3500.000 EXTENDED_LIMITS -32768.00 32767.00 AXIS_PTS_REF Rail_facSetPointAPSCorRgn_AXIS /end AXIS_DESCR
/end CHARACTERISTIC
/begin CHARACTERISTIC Rail_facSetPointAPSCor1Rgn_GCUR "atmosphärendruckabhängigen Korrekturkennlinie für die Raildrucksollwertbildung für die Regenerationsstufe 2" CURVE 0x8005CDE6 CurG_Ws16 1.000000 Fact 0.00 1.000000 EXTENDED_LIMITS -4.000000 3.999878
 /begin AXIS_DESCR COM_AXIS EnvP_p Pres_hPa 8 0.00 3500.000 EXTENDED_LIMITS -32768.00 32767.00 AXIS_PTS_REF Rail_facSetPointAPSCorRgn_AXIS /end AXIS_DESCR
/end CHARACTERISTIC
/begin AXIS_PTS Rail_facSetPointAPSCorRgn_AXIS "Stützstellenverteilung für die atmosphärendruckabhängigen Korrekturkennlinien" 0x8005CDF6 EnvP_p Axis_Xs16 3500.000 Pres_hPa 8 0.00 3500.000 FORMAT "%8.3" EXTENDED_LIMITS -32768.00 32767.00 DEPOSIT ABSOLUTE /end AXIS_PTS
/begin CHARACTERISTIC Rail_facSetPointAPSCor_CUR "Gewichtungsfaktor, abhängig vom Atmosphärendruck für die Sollwertkorrektur des Raildrucks" CURVE 0x8005CD70 Cur_Xs16Ws16 1.000000 Fact 0.00 1.000000 EXTENDED_LIMITS -4.000000 3.999878
 /begin AXIS_DESCR STD_AXIS EnvP_p Pres_hPa 8 0.00 3500.000 EXTENDED_LIMITS -32768.00 32767.00 DEPOSIT ABSOLUTE /end AXIS_DESCR
/end CHARACTERISTIC
/begin CHARACTERISTIC Rail_facSetPointAPSCStrt_CUR "Gewichtungsfaktor für die Raildrucksollwertkorrektur beim Start abhängig vom Luftdruck" CURVE 0x8005BA4A Cur_Xs16Ws16 1.000000 Fact 0.00 1.000000 EXTENDED_LIMITS -4.000000 3.999878
 /begin AXIS_DESCR STD_AXIS EnvP_p Pres_hPa 8 0.00 3500.000 EXTENDED_LIMITS -32768.00 32767.00 DEPOSIT ABSOLUTE /end AXIS_DESCR
/end CHARACTERISTIC
/begin CHARACTERISTIC Rail_facSetPointATSCor0Rgn_GCUR "ansauglufttemperaturabhängige Korrekturkennlinie für die Raildrucksollwertbildung für die Regenerationsstufe 1" CURVE 0x8005CE08 CurG_Ws16 1.000000 Fact 0.00 1.000000 EXTENDED_LIMITS -4.000000 3.999878
 /begin AXIS_DESCR COM_AXIS InjSys_tAirRgn Temp_Cels 8 -50.14000 199.8600 EXTENDED_LIMITS -3549.940 3003.560 AXIS_PTS_REF Rail_facSetPointATSCorRgn_AXIS /end AXIS_DESCR
/end CHARACTERISTIC
/begin CHARACTERISTIC Rail_facSetPointATSCor1Rgn_GCUR "ansauglufttemperaturabhängige Korrekturkennlinie für die Raildrucksollwertbildung für die Regenerationsstufe 2" CURVE 0x8005CE18 CurG_Ws16 1.000000 Fact 0.00 1.000000 EXTENDED_LIMITS -4.000000 3.999878
 /begin AXIS_DESCR COM_AXIS InjSys_tAirRgn Temp_Cels 8 -50.14000 199.8600 EXTENDED_LIMITS -3549.940 3003.560 AXIS_PTS_REF Rail_facSetPointATSCorRgn_AXIS /end AXIS_DESCR
/end CHARACTERISTIC
/begin AXIS_PTS Rail_facSetPointATSCorRgn_AXIS "Stützstellenverteilung für die ansauglufttemperaturabhängigen Korrekturkennlinie" 0x8005CE28 InjSys_tAirRgn Axis_Xs16 250.0000 Temp_Cels 8 -50.14000 199.8600 FORMAT "%8.4" EXTENDED_LIMITS -3549.940 3003.560 DEPOSIT ABSOLUTE /end AXIS_PTS
/begin CHARACTERISTIC Rail_facSetPointATSCor_CUR "Gewichtungsfaktor, abhängig von der Ansauglufttemperatur für die Sollwertkorrektur des Raildrucks" CURVE 0x8005CD92 Cur_Xs16Ws16 1.000000 Fact 0.00 1.000000 EXTENDED_LIMITS -4.000000 3.999878
 /begin AXIS_DESCR STD_AXIS CACDsT_t Temp_Cels 8 -50.14000 199.8600 EXTENDED_LIMITS -3549.940 3003.560 DEPOSIT ABSOLUTE /end AXIS_DESCR
/end CHARACTERISTIC
/begin CHARACTERISTIC Rail_facSetPointATSCStrt_CUR "Gewichtungsfaktor für die Raildrucksollwertkorrektur beim Start abhängig von der Ansauglufttemperatur" CURVE 0x8005BA6C Cur_Xs16Ws16 1.000000 Fact 0.00 1.000000 EXTENDED_LIMITS -4.000000 3.999878
 /begin AXIS_DESCR STD_AXIS Rail_tAir Temp_Cels 8 -50.14000 199.8600 EXTENDED_LIMITS -3549.940 3003.560 DEPOSIT ABSOLUTE /end AXIS_DESCR
/end CHARACTERISTIC
/begin CHARACTERISTIC Rail_facSetPointETSCor0Rgn_GCUR "motortemperaturabhängige Korrekturkennlinie für die Raildrucksollwertbildung für die Regenerationsstufe 1" CURVE 0x8005CE3A CurG_Ws16 1.000000 Fact 0.00 1.000000 EXTENDED_LIMITS -4.000000 3.999878
 /begin AXIS_DESCR COM_AXIS InjSys_tEngRgn Temp_Cels 8 -50.14000 199.8600 EXTENDED_LIMITS -3549.940 3003.560 AXIS_PTS_REF Rail_facSetPointETSCorRgn_AXIS /end AXIS_DESCR
/end CHARACTERISTIC
/begin CHARACTERISTIC Rail_facSetPointETSCor1Rgn_GCUR "motortemperaturabhängige Korrekturkennlinie für die Raildrucksollwertbildung für die Regenerationsstufe 2" CURVE 0x8005CE4A CurG_Ws16 1.000000 Fact 0.00 1.000000 EXTENDED_LIMITS -4.000000 3.999878
 /begin AXIS_DESCR COM_AXIS InjSys_tEngRgn Temp_Cels 8 -50.14000 199.8600 EXTENDED_LIMITS -3549.940 3003.560 AXIS_PTS_REF Rail_facSetPointETSCorRgn_AXIS /end AXIS_DESCR
/end CHARACTERISTIC
/begin CHARACTERISTIC Rail_facSetPointETSCor1_CUR "Gewichtungsfaktor für die Raildrucksollwertkorrektur in Abhängigkeit von der Motortemperatur" CURVE 0x8005BA8E Cur_Xs16Ws16 1.000000 Fact 0.00 1.000000 EXTENDED_LIMITS -4.000000 3.999878
 /begin AXIS_DESCR STD_AXIS InjSys_tEng Temp_Cels 8 -50.14000 199.8600 EXTENDED_LIMITS -3549.940 3003.560 DEPOSIT ABSOLUTE /end AXIS_DESCR
/end CHARACTERISTIC
/begin AXIS_PTS Rail_facSetPointETSCorRgn_AXIS "Stützstellenverteilung für die motortemperaturabhängige Korrekturkennlinien" 0x8005CE5A InjSys_tEngRgn Axis_Xs16 250.0000 Temp_Cels 8 -50.14000 199.8600 FORMAT "%8.4" EXTENDED_LIMITS -3549.940 3003.560 DEPOSIT ABSOLUTE /end AXIS_PTS
/begin CHARACTERISTIC Rail_facSetPointETSCor_CUR "Gewichtungsfaktor, abhängig von der Motortemperatur für die Sollwertkorrektur des Raildrucks" CURVE 0x8005CDB4 Cur_Xs16Ws16 1.000000 Fact 0.00 1.000000 EXTENDED_LIMITS -4.000000 3.999878
 /begin AXIS_DESCR STD_AXIS InjSys_tEng Temp_Cels 8 -50.14000 199.8600 EXTENDED_LIMITS -3549.940 3003.560 DEPOSIT ABSOLUTE /end AXIS_DESCR
/end CHARACTERISTIC
/begin CHARACTERISTIC Rail_facSetPointETSCStrt_CUR "Gewichtungsfaktor für die Raildrucksollwertkorrektur beim Start abhängig von der Ansauglufttemperatur" CURVE 0x8005BAB0 Cur_Xs16Ws16 1.000000 Fact 0.00 1.000000 EXTENDED_LIMITS -4.000000 3.999878
 /begin AXIS_DESCR STD_AXIS InjSys_tEng Temp_Cels 8 -50.14000 199.8600 EXTENDED_LIMITS -3549.940 3003.560 DEPOSIT ABSOLUTE /end AXIS_DESCR
/end CHARACTERISTIC
/begin CHARACTERISTIC Rail_facSetPointFTSCor_CUR "Gewichtungsfaktor, abhängig von der Kraftstofftemperatur für Raildruck-Sollwertkorrektur" CURVE 0x8005BAD2 Cur_Xs16Ws16 1.000000 Fact 0.00 1.000000 EXTENDED_LIMITS -4.000000 3.999878
 /begin AXIS_DESCR STD_AXIS FuelT_t Temp_Cels 2 -50.14000 149.8600 EXTENDED_LIMITS -3549.940 3003.560 DEPOSIT ABSOLUTE /end AXIS_DESCR
/end CHARACTERISTIC
/begin CHARACTERISTIC Rail_facSetPointRmp0Val_GCUR "Faktorisierungskennlinie für den Solldruck im Rail" CURVE 0x8005B0F0 CurG_Ws16 3.999939 CoEOMSwt_S16 -2.000000 1.999939 FORMAT "%8.6"
 /begin AXIS_DESCR COM_AXIS CoEOM_facRmpVal CoEOMSwt_S16 10 -2.000000 1.999939 FORMAT "%8.6" AXIS_PTS_REF Rail_facSetPointRmpValX_AXIS /end AXIS_DESCR
/end CHARACTERISTIC
/begin CHARACTERISTIC Rail_facSetPointRmp1Val_GCUR "Faktorisierungskennlinie für den Solldruck im Rail" CURVE 0x8005B104 CurG_Ws16 3.999939 CoEOMSwt_S16 -2.000000 1.999939 FORMAT "%8.6"
 /begin AXIS_DESCR COM_AXIS CoEOM_facRmpVal CoEOMSwt_S16 10 -2.000000 1.999939 FORMAT "%8.6" AXIS_PTS_REF Rail_facSetPointRmpValX_AXIS /end AXIS_DESCR
/end CHARACTERISTIC
/begin AXIS_PTS Rail_facSetPointRmpValX_AXIS "Gruppenkennlinien-Achse für die Gewichtung des Solldruck-Faktors im Rail" 0x8005B118 CoEOM_facRmpVal Axis_Xs16 3.999939 CoEOMSwt_S16 10 -2.000000 1.999939 FORMAT "%8.6" DEPOSIT ABSOLUTE /end AXIS_PTS
/begin CHARACTERISTIC Rail_lTotDstMin_C "" VALUE 0x8005A728 Val_Ws32 4294967295.00 Length -2147483648.00 2147483647.00 FORMAT "%13.2" /end CHARACTERISTIC
/begin CHARACTERISTIC Rail_nEngSpdLim_C "max. Motordrehzahl f. Raildrucksubstitution" VALUE 0x8005CE6C Val_Wu16 32767.50 EngN 0.00 32767.50 /end CHARACTERISTIC
/begin CHARACTERISTIC Rail_nRedOfsLimHi_C "Obere Drehzahl Hystereseschwelle für Raildruck Offset Reduzierung" VALUE 0x8005AB5C Val_Ws16 10000.00 EngN 0.00 10000.00 EXTENDED_LIMITS -16384.00 16383.50 /end CHARACTERISTIC
/begin CHARACTERISTIC Rail_nRedOfsLimLo_C "Untere Drehzahl Hystereseschwelle für die Raildruck Offset Reduzierung" VALUE 0x8005AB5E Val_Ws16 5000.000 EngN 0.00 5000.000 EXTENDED_LIMITS -16384.00 16383.50 /end CHARACTERISTIC
/begin CHARACTERISTIC Rail_nStrtLim_C "Motordrehzahl Limit für die Raildrucküberwachung beim Start" VALUE 0x8005A72C Val_Ws16 10000.00 EngN 0.00 10000.00 EXTENDED_LIMITS -16384.00 16383.50 /end CHARACTERISTIC
/begin CHARACTERISTIC Rail_PCVMon.pDvtMax_C "Klasse für Schwellwerte der Überwachung PCV/Maximal zulässige Regelabweichung für Raildrucküberwachung" VALUE 0x8005A6B2 Val_Ws16 3800.000 Pres_Rail -1800.000 2000.000 EXTENDED_LIMITS -3276.800 3276.700 /end CHARACTERISTIC
/begin CHARACTERISTIC Rail_PCVMon.pDvtMin_C "Klasse für Schwellwerte der Überwachung PCV/maximale negative Soll/Ist Druckdifferenz" VALUE 0x8005A6B4 Val_Ws16 3800.000 Pres_Rail -1800.000 2000.000 EXTENDED_LIMITS -3276.800 3276.700 /end CHARACTERISTIC
/begin CHARACTERISTIC Rail_PCVMon.pDvtMin2_C "Klasse für Schwellwerte der Überwachung PCV/maximale negative Soll/Ist Druckdifferenz für die 2. Überwachungsstufe" VALUE 0x8005A6B6 Val_Ws16 3800.000 Pres_Rail -1800.000 2000.000 EXTENDED_LIMITS -3276.800 3276.700 /end CHARACTERISTIC
/begin CHARACTERISTIC Rail_PCVMon.pSetMin_C "Klasse für Schwellwerte der Überwachung PCV/Minimal zulässiger Solldruck für Raildrucküberwachung" VALUE 0x8005A6B8 Val_Ws16 2000.000 Pres_Rail 0.00 2000.000 EXTENDED_LIMITS -3276.800 3276.700 /end CHARACTERISTIC
/begin CHARACTERISTIC Rail_PCVMon.pFltMax_C "Klasse für Schwellwerte der Überwachung PCV/Maximal zulässiger Raildruck" VALUE 0x8005A6BA Val_Ws16 2000.000 Pres_Rail 0.00 2000.000 EXTENDED_LIMITS -3276.800 3276.700 /end CHARACTERISTIC
/begin CHARACTERISTIC Rail_PCVMon.pFltMax2_C "Klasse für Schwellwerte der Überwachung PCV/Maximal zulässiger Raildruck für die 2. Überwachungsstufe" VALUE 0x8005A6BC Val_Ws16 2000.000 Pres_Rail 0.00 2000.000 EXTENDED_LIMITS -3276.800 3276.700 /end CHARACTERISTIC
/begin CHARACTERISTIC Rail_PCVMon.stRls_C "Klasse für Schwellwerte der Überwachung PCV/Generelle Freigabemaske für Überwachungen der Druckregelung über Druckregelventil" VALUE 0x8005A6BE Val_Wu16 65535.00 OneToOne 0.00 65535.00 /end CHARACTERISTIC
/begin CHARACTERISTIC Rail_pDvtRedOfsLimHi_C "Obere Regeabweichung Hystereseschwelle für Raildruck Offset Reduzierung" VALUE 0x8005AB60 Val_Ws16 5276.800 Pres_Rail -3276.800 2000.000 EXTENDED_LIMITS -3276.800 3276.700 /end CHARACTERISTIC
/begin CHARACTERISTIC Rail_pDvtRedOfsLimLo_C "untere Regelabweichung Hystereseschwelle für Raildruck Offset Reduzierung" VALUE 0x8005AB62 Val_Ws16 5276.800 Pres_Rail -3276.800 2000.000 EXTENDED_LIMITS -3276.800 3276.700 /end CHARACTERISTIC
/begin CHARACTERISTIC Rail_pFltMinZFC_C "Minimaler Raildruck für die Überwachung bei aktiver ZFC" VALUE 0x8005D320 Val_Ws16 2000.000 Pres_Rail 0.00 2000.000 EXTENDED_LIMITS -3276.800 3276.700 /end CHARACTERISTIC
/begin CHARACTERISTIC Rail_pMaxSetSubst_CUR "drehzahlabhängiger oberer Grenzwert substituierter Raildrucksollwert" CURVE 0x8005CE6E Cur_Xs16Ws16 2000.000 Pres_Rail 0.00 2000.000 EXTENDED_LIMITS -3276.800 3276.700
 /begin AXIS_DESCR STD_AXIS Epm_nEng EngN 5 0.00 10000.00 EXTENDED_LIMITS -16384.00 16383.50 DEPOSIT ABSOLUTE /end AXIS_DESCR
/end CHARACTERISTIC
/begin CHARACTERISTIC Rail_pMinSetSubst_C "unterer Grenzwert substituierter Raildrucksollwert" VALUE 0x8005CE84 Val_Wu16 2000.000 Pres_Rail 0.00 2000.000 EXTENDED_LIMITS 0.00 6553.500 /end CHARACTERISTIC
/begin CHARACTERISTIC Rail_pPCVCloseOfs_CUR "Vorsteuer Offset um das Druckregelventil geschlossen zu halten" CURVE 0x8005AB64 Cur_Xs16Ws16 5276.800 Pres_Rail -3276.800 2000.000 EXTENDED_LIMITS -3276.800 3276.700
 /begin AXIS_DESCR STD_AXIS Rail_pSetPoint Pres_Rail 4 0.00 2000.000 EXTENDED_LIMITS -3276.800 3276.700 DEPOSIT ABSOLUTE /end AXIS_DESCR
/end CHARACTERISTIC
/begin CHARACTERISTIC Rail_pPCVDvtMax_CUR "maximale Regelabweichung als Funktion der Drehzahl für die Raildrucküberwachung" CURVE 0x8005A6C0 Cur_Xs16Ws16 3800.000 Pres_Rail -1800.000 2000.000 EXTENDED_LIMITS -3276.800 3276.700
 /begin AXIS_DESCR STD_AXIS Epm_nEng EngN 4 0.00 10000.00 EXTENDED_LIMITS -16384.00 16383.50 DEPOSIT ABSOLUTE /end AXIS_DESCR
/end CHARACTERISTIC
/begin CHARACTERISTIC Rail_pPCVFltMin_CUR "Minimal zulässiger Raildruck als Funktion der Motordrehzahl" CURVE 0x8005A6D2 Cur_Xs16Ws16 2000.000 Pres_Rail 0.00 2000.000 EXTENDED_LIMITS -3276.800 3276.700
 /begin AXIS_DESCR STD_AXIS Epm_nEng EngN 16 0.00 10000.00 EXTENDED_LIMITS -16384.00 16383.50 DEPOSIT ABSOLUTE /end AXIS_DESCR
/end CHARACTERISTIC
/begin CHARACTERISTIC Rail_pPCVRedOfs_CUR "Vorsteuerreduzierung für schnelleren Druckabbau über das Druckregelventil" CURVE 0x8005AB76 Cur_Xs16Ws16 5276.800 Pres_Rail -3276.800 2000.000 EXTENDED_LIMITS -3276.800 3276.700
 /begin AXIS_DESCR STD_AXIS Rail_pSetPoint Pres_Rail 4 0.00 2000.000 EXTENDED_LIMITS -3276.800 3276.700 DEPOSIT ABSOLUTE /end AXIS_DESCR
/end CHARACTERISTIC
/begin CHARACTERISTIC Rail_pPCVSetMax_CUR "maximal zulässiger Solldruck für die Raildrucküberwachung" CURVE 0x8005A714 Cur_Xs16Ws16 2000.000 Pres_Rail 0.00 2000.000 EXTENDED_LIMITS -3276.800 3276.700
 /begin AXIS_DESCR STD_AXIS Rail_pSetPoint Pres_Rail 4 0.00 2000.000 EXTENDED_LIMITS -3276.800 3276.700 DEPOSIT ABSOLUTE /end AXIS_DESCR
/end CHARACTERISTIC
/begin CHARACTERISTIC Rail_pPreCtl_C "Fernsteuerwert für Vorsteuerwert für die Druckregelung über Druckregelventil" VALUE 0x8005AB88 Val_Ws16 2000.000 Pres_Rail 0.00 2000.000 EXTENDED_LIMITS -3276.800 3276.700 /end CHARACTERISTIC
/begin CHARACTERISTIC Rail_pPreCtl_MAP "Vorsteuerkennfeld für die Druckregelung über Druckregelventil" MAP 0x8005AB8A Map_Xs16Ys16Ws16 2000.000 Pres_Rail 0.00 2000.000 EXTENDED_LIMITS -3276.800 3276.700
 /begin AXIS_DESCR STD_AXIS Epm_nEng EngN 8 0.00 10000.00 EXTENDED_LIMITS -16384.00 16383.50 DEPOSIT ABSOLUTE /end AXIS_DESCR
 /begin AXIS_DESCR STD_AXIS Rail_pSetPoint Pres_Rail 12 0.00 2000.000 EXTENDED_LIMITS -3276.800 3276.700 DEPOSIT ABSOLUTE /end AXIS_DESCR
/end CHARACTERISTIC
/begin CHARACTERISTIC Rail_pRedOfsLim_C "Raildruckschwelle zur Reduzierung des Vorsteueroffsets des Druckregelventils" VALUE 0x8005AC76 Val_Ws16 5276.800 Pres_Rail -3276.800 2000.000 EXTENDED_LIMITS -3276.800 3276.700 /end CHARACTERISTIC
/begin CHARACTERISTIC Rail_pSetPBaseNoEGR_MAP "Rail Druck Sollwert Kennfeld für den Fall EGR inaktiv ist." MAP 0x8005B262 Map_Xs16Ys16Ws16 2000.000 Pres_Rail 0.00 2000.000 EXTENDED_LIMITS -3276.800 3276.700
 /begin AXIS_DESCR STD_AXIS Epm_nEng EngN 16 0.00 10000.00 EXTENDED_LIMITS -16384.00 16383.50 DEPOSIT ABSOLUTE /end AXIS_DESCR
 /begin AXIS_DESCR STD_AXIS InjCtl_qCurr InjMass 16 0.00 327.6700 EXTENDED_LIMITS -327.6800 327.6700 DEPOSIT ABSOLUTE /end AXIS_DESCR
/end CHARACTERISTIC
/begin CHARACTERISTIC Rail_pSetPDynCor_MAP "Basiskorrekturkennfeld für die Raildrucksollwertkorrektur" MAP 0x8005BADC Map_Xs16Ys16Ws16 2000.000 Pres_Rail 0.00 2000.000 EXTENDED_LIMITS -3276.800 3276.700
 /begin AXIS_DESCR STD_AXIS Epm_nEng EngN 4 0.00 10000.00 EXTENDED_LIMITS -16384.00 16383.50 DEPOSIT ABSOLUTE /end AXIS_DESCR
 /begin AXIS_DESCR STD_AXIS InjCtl_qSetUnBal InjMass 4 0.00 327.6700 EXTENDED_LIMITS -327.6800 327.6700 DEPOSIT ABSOLUTE /end AXIS_DESCR
/end CHARACTERISTIC
/begin CHARACTERISTIC Rail_pSetPEgrLPCor_MAP "" MAP 0x8005BB10 Map_Xs16Ys16Ws16 2000.000 Pres_Rail 0.00 2000.000 EXTENDED_LIMITS -3276.800 3276.700
 /begin AXIS_DESCR STD_AXIS Epm_nEng EngN 10 -16384.00 16383.50 DEPOSIT ABSOLUTE /end AXIS_DESCR
 /begin AXIS_DESCR STD_AXIS InjCtl_qCurr InjMass 8 -327.6800 327.6700 DEPOSIT ABSOLUTE /end AXIS_DESCR
/end CHARACTERISTIC
/begin CHARACTERISTIC Rail_pSetPointAPSCor0Rgn_GMAP "druckabhängiger Basiswert für die Korrektur der Raildrucksollwertbildung für die Regenerationsstufe 1" MAP 0x8005C7EA MapG_Ws16 2000.000 Pres_Rail 0.00 2000.000 EXTENDED_LIMITS -3276.800 3276.700
 /begin AXIS_DESCR COM_AXIS Epm_nEng EngN 8 0.00 10000.00 EXTENDED_LIMITS -16384.00 16383.50 AXIS_PTS_REF Rail_pSetPointAPSCorRgnX_AXIS /end AXIS_DESCR
 /begin AXIS_DESCR COM_AXIS InjCtl_qCurr InjMass 8 0.00 327.6700 EXTENDED_LIMITS -327.6800 327.6700 AXIS_PTS_REF Rail_pSetPointAPSCorRgnY_AXIS /end AXIS_DESCR
/end CHARACTERISTIC
/begin CHARACTERISTIC Rail_pSetPointAPSCor1Rgn_GMAP "druckabhängiger Basiswert für die Korrektur der Raildrucksollwertbildung für die Regenerationsstufe 2" MAP 0x8005C86A MapG_Ws16 2000.000 Pres_Rail 0.00 2000.000 EXTENDED_LIMITS -3276.800 3276.700
 /begin AXIS_DESCR COM_AXIS Epm_nEng EngN 8 0.00 10000.00 EXTENDED_LIMITS -16384.00 16383.50 AXIS_PTS_REF Rail_pSetPointAPSCorRgnX_AXIS /end AXIS_DESCR
 /begin AXIS_DESCR COM_AXIS InjCtl_qCurr InjMass 8 0.00 327.6700 EXTENDED_LIMITS -327.6800 327.6700 AXIS_PTS_REF Rail_pSetPointAPSCorRgnY_AXIS /end AXIS_DESCR
/end CHARACTERISTIC
/begin AXIS_PTS Rail_pSetPointAPSCorRgnX_AXIS "Stützstellenverteilung für die druckabhängigen Gruppenkorrekturfelder Rail_pSetPointAPSCor%Rgn_GMAP für die Eingangsgröße Epm_nEng" 0x8005C8EA Epm_nEng Axis_Xs16 10000.00 EngN 8 0.00 10000.00 FORMAT "%8.2" EXTENDED_LIMITS -16384.00 16383.50 DEPOSIT ABSOLUTE /end AXIS_PTS
/begin AXIS_PTS Rail_pSetPointAPSCorRgnY_AXIS "Stützstellenverteilung für die druckabhängigen Gruppenkorrekturfelder Rail_pSetPointAPSCor%Rgn_GMAP für die Eingangsgröße InjCtl_qSetUnBal \ PthSet_trqInrSet" 0x8005C8FC InjCtl_qCurr Axis_Xs16 327.6700 InjMass 8 0.00 327.6700 FORMAT "%8.4" EXTENDED_LIMITS -327.6800 327.6700 DEPOSIT ABSOLUTE /end AXIS_PTS
/begin CHARACTERISTIC Rail_pSetPointAPSCor_MAP "atmosphärendruckabhängiger Sollwertkorrektur des Raildrucks" MAP 0x8005C11E Map_Xs16Ys16Ws16 2000.000 Pres_Rail 0.00 2000.000 EXTENDED_LIMITS -3276.800 3276.700
 /begin AXIS_DESCR STD_AXIS Epm_nEng EngN 16 0.00 10000.00 EXTENDED_LIMITS -16384.00 16383.50 DEPOSIT ABSOLUTE /end AXIS_DESCR
 /begin AXIS_DESCR STD_AXIS InjCtl_qCurr InjMass 16 0.00 327.6700 EXTENDED_LIMITS -327.6800 327.6700 DEPOSIT ABSOLUTE /end AXIS_DESCR
/end CHARACTERISTIC
/begin CHARACTERISTIC Rail_pSetPointAPSCStrt_MAP "Luftdruck - Basiskorrekturkennfeld für die Raildrucksollwertkorrektur in Abhängigkeit von Motordrehzahl und Einspritzmenge" MAP 0x8005BBD8 Map_Xs16Ys16Ws16 2000.000 Pres_Rail 0.00 2000.000 EXTENDED_LIMITS -3276.800 3276.700
 /begin AXIS_DESCR STD_AXIS Epm_nEng EngN 2 0.00 10000.00 EXTENDED_LIMITS -16384.00 16383.50 DEPOSIT ABSOLUTE /end AXIS_DESCR
 /begin AXIS_DESCR STD_AXIS InjCtl_qCurr InjMass 2 0.00 327.6700 EXTENDED_LIMITS -327.6800 327.6700 DEPOSIT ABSOLUTE /end AXIS_DESCR
/end CHARACTERISTIC
/begin CHARACTERISTIC Rail_pSetPointATSCor0Rgn_GMAP "Ansauglufttemperaturabhängiger Basiswert für die Korrektur der Raildrucksollwertbildung für die Regenerationsstufe 1" MAP 0x8005C90E MapG_Ws16 2000.000 Pres_Rail 0.00 2000.000 EXTENDED_LIMITS -3276.800 3276.700
 /begin AXIS_DESCR COM_AXIS Epm_nEng EngN 16 0.00 10000.00 EXTENDED_LIMITS -16384.00 16383.50 AXIS_PTS_REF Rail_pSetPointATSCorRgnX_AXIS /end AXIS_DESCR
 /begin AXIS_DESCR COM_AXIS InjCtl_qCurr InjMass 16 0.00 327.6700 EXTENDED_LIMITS -327.6800 327.6700 AXIS_PTS_REF Rail_pSetPointATSCorRgnY_AXIS /end AXIS_DESCR
/end CHARACTERISTIC
/begin CHARACTERISTIC Rail_pSetPointATSCor1Rgn_GMAP "Ansauglufttemperaturabhängiger Basiswert für die Korrektur der Raildrucksollwertbildung für die Regenerationsstufe 2" MAP 0x8005CB0E MapG_Ws16 2000.000 Pres_Rail 0.00 2000.000 EXTENDED_LIMITS -3276.800 3276.700
 /begin AXIS_DESCR COM_AXIS Epm_nEng EngN 16 0.00 10000.00 EXTENDED_LIMITS -16384.00 16383.50 AXIS_PTS_REF Rail_pSetPointATSCorRgnX_AXIS /end AXIS_DESCR
 /begin AXIS_DESCR COM_AXIS InjCtl_qCurr InjMass 16 0.00 327.6700 EXTENDED_LIMITS -327.6800 327.6700 AXIS_PTS_REF Rail_pSetPointATSCorRgnY_AXIS /end AXIS_DESCR
/end CHARACTERISTIC
/begin AXIS_PTS Rail_pSetPointATSCorRgnX_AXIS "" 0x8005CD0E Epm_nEng Axis_Xs16 10000.00 EngN 16 0.00 10000.00 FORMAT "%8.2" EXTENDED_LIMITS -16384.00 16383.50 DEPOSIT ABSOLUTE /end AXIS_PTS
/begin AXIS_PTS Rail_pSetPointATSCorRgnY_AXIS "" 0x8005CD30 InjCtl_qCurr Axis_Xs16 327.6700 InjMass 16 0.00 327.6700 FORMAT "%8.4" EXTENDED_LIMITS -327.6800 327.6700 DEPOSIT ABSOLUTE /end AXIS_PTS
/begin CHARACTERISTIC Rail_pSetPointATSCor_MAP "ansauglufttemperaturabhängige Sollwertkorrektur des Raildrucks" MAP 0x8005C362 Map_Xs16Ys16Ws16 2000.000 Pres_Rail 0.00 2000.000 EXTENDED_LIMITS -3276.800 3276.700
 /begin AXIS_DESCR STD_AXIS Epm_nEng EngN 16 0.00 10000.00 EXTENDED_LIMITS -16384.00 16383.50 DEPOSIT ABSOLUTE /end AXIS_DESCR
 /begin AXIS_DESCR STD_AXIS InjCtl_qCurr InjMass 16 0.00 327.6700 EXTENDED_LIMITS -327.6800 327.6700 DEPOSIT ABSOLUTE /end AXIS_DESCR
/end CHARACTERISTIC
/begin CHARACTERISTIC Rail_pSetPointATSCStrt_MAP "Atmosphärentemperatur Basiskennfeld der Raildrucksollwertkorrektur abhängig von Motordrehzahl und Einspritzmenge" MAP 0x8005BBEC Map_Xs16Ys16Ws16 2000.000 Pres_Rail 0.00 2000.000 EXTENDED_LIMITS -3276.800 3276.700
 /begin AXIS_DESCR STD_AXIS Epm_nEng EngN 8 0.00 10000.00 EXTENDED_LIMITS -16384.00 16383.50 DEPOSIT ABSOLUTE /end AXIS_DESCR
 /begin AXIS_DESCR STD_AXIS InjCtl_qCurr InjMass 8 0.00 327.6700 EXTENDED_LIMITS -327.6800 327.6700 DEPOSIT ABSOLUTE /end AXIS_DESCR
/end CHARACTERISTIC
/begin CHARACTERISTIC Rail_pSetPointBas0Rgn_GMAP "Basiswert für die Raildrucksollwertbildung für die Regenerationsstufe 1" MAP 0x8005ACAC MapG_Ws16 2000.000 Pres_Rail 0.00 2000.000 EXTENDED_LIMITS -3276.800 3276.700
 /begin AXIS_DESCR COM_AXIS Epm_nEng EngN 16 0.00 10000.00 EXTENDED_LIMITS -16384.00 16383.50 AXIS_PTS_REF Rail_pSetPointBasRgnX_AXIS /end AXIS_DESCR
 /begin AXIS_DESCR COM_AXIS InjCtl_qCurr InjMass 16 0.00 327.6700 EXTENDED_LIMITS -327.6800 327.6700 AXIS_PTS_REF Rail_pSetPointBasRgnY_AXIS /end AXIS_DESCR
/end CHARACTERISTIC
/begin CHARACTERISTIC Rail_pSetPointBas1Rgn_GMAP "Basiswert für die Raildrucksollwertbildung für die Regenerationsstufe 2" MAP 0x8005AEAC MapG_Ws16 2000.000 Pres_Rail 0.00 2000.000 EXTENDED_LIMITS -3276.800 3276.700
 /begin AXIS_DESCR COM_AXIS Epm_nEng EngN 16 0.00 10000.00 EXTENDED_LIMITS -16384.00 16383.50 AXIS_PTS_REF Rail_pSetPointBasRgnX_AXIS /end AXIS_DESCR
 /begin AXIS_DESCR COM_AXIS InjCtl_qCurr InjMass 16 0.00 327.6700 EXTENDED_LIMITS -327.6800 327.6700 AXIS_PTS_REF Rail_pSetPointBasRgnY_AXIS /end AXIS_DESCR
/end CHARACTERISTIC
/begin CHARACTERISTIC Rail_pSetPointBaseStrt_MAP "Basiskennfeld für den Raildrucksollwert beim Start" MAP 0x8005B4A6 Map_Xs16Ys16Ws16 2000.000 Pres_Rail 0.00 2000.000 EXTENDED_LIMITS -3276.800 3276.700
 /begin AXIS_DESCR STD_AXIS Epm_nEng EngN 16 0.00 10000.00 EXTENDED_LIMITS -16384.00 16383.50 DEPOSIT ABSOLUTE /end AXIS_DESCR
 /begin AXIS_DESCR STD_AXIS InjCtl_qCurr InjMass 16 0.00 327.6700 EXTENDED_LIMITS -327.6800 327.6700 DEPOSIT ABSOLUTE /end AXIS_DESCR
/end CHARACTERISTIC
/begin CHARACTERISTIC Rail_pSetPointBase_MAP "Basiskennfeld für den Raildruck-Sollwert" MAP 0x8005B6EA Map_Xs16Ys16Ws16 2000.000 Pres_Rail 0.00 2000.000 EXTENDED_LIMITS -3276.800 3276.700
 /begin AXIS_DESCR STD_AXIS Epm_nEng EngN 16 0.00 10000.00 EXTENDED_LIMITS -16384.00 16383.50 DEPOSIT ABSOLUTE /end AXIS_DESCR
 /begin AXIS_DESCR STD_AXIS InjCtl_qCurr InjMass 16 0.00 327.6700 EXTENDED_LIMITS -327.6800 327.6700 DEPOSIT ABSOLUTE /end AXIS_DESCR
/end CHARACTERISTIC
/begin AXIS_PTS Rail_pSetPointBasRgnX_AXIS "Stützstellenverteilung für die Gruppenkorrekturfelder Rail_pSetPointBas%Rgn_GMAP für die Eingangsgröße Epm_nEng" 0x8005B0AC Epm_nEng Axis_Xs16 10000.00 EngN 16 0.00 10000.00 FORMAT "%8.2" EXTENDED_LIMITS -16384.00 16383.50 DEPOSIT ABSOLUTE /end AXIS_PTS
/begin AXIS_PTS Rail_pSetPointBasRgnY_AXIS "Stützstellenverteilung für die Gruppenkorrekturfelder Rail_pSetPointBas%Rgn_GMAP für die Eingangsgröße InjCtl_qSetUnBal" 0x8005B0CE InjCtl_qCurr Axis_Xs16 327.6700 InjMass 16 0.00 327.6700 FORMAT "%8.4" EXTENDED_LIMITS -327.6800 327.6700 DEPOSIT ABSOLUTE /end AXIS_PTS
/begin CHARACTERISTIC Rail_pSetPointBattMin_CUR "batteriespannungsabhängige Kennlinie für den Raildruck-Sollwert" CURVE 0x8005B92E Cur_Xs16Ws16 2000.000 Pres_Rail 0.00 2000.000 EXTENDED_LIMITS -3276.800 3276.700
 /begin AXIS_DESCR STD_AXIS BattU_u Volt_Batt 4 0.00 24000.00 EXTENDED_LIMITS -655360.0 655340.0 DEPOSIT ABSOLUTE /end AXIS_DESCR
/end CHARACTERISTIC
/begin CHARACTERISTIC Rail_pSetPointETSCor0Rgn_GMAP "Motortemperaturabhängiger Basiswert für die Korrektur der Raildrucksollwertbildung für die Regenerationsstufe 1" MAP 0x8005CD52 MapG_Ws16 2000.000 Pres_Rail 0.00 2000.000 EXTENDED_LIMITS -3276.800 3276.700
 /begin AXIS_DESCR COM_AXIS Epm_nEng EngN 2 0.00 10000.00 EXTENDED_LIMITS -16384.00 16383.50 AXIS_PTS_REF Rail_pSetPointETSCorRgnX_AXIS /end AXIS_DESCR
 /begin AXIS_DESCR COM_AXIS InjCtl_qCurr InjMass 2 0.00 327.6700 EXTENDED_LIMITS -327.6800 327.6700 AXIS_PTS_REF Rail_pSetPointETSCorRgnY_AXIS /end AXIS_DESCR
/end CHARACTERISTIC
/begin CHARACTERISTIC Rail_pSetPointETSCor1Rgn_GMAP "Motortemperaturabhängiger Basiswert für die Korrektur der Raildrucksollwertbildung für die Regenerationsstufe 2" MAP 0x8005CD5A MapG_Ws16 2000.000 Pres_Rail 0.00 2000.000 EXTENDED_LIMITS -3276.800 3276.700
 /begin AXIS_DESCR COM_AXIS Epm_nEng EngN 2 0.00 10000.00 EXTENDED_LIMITS -16384.00 16383.50 AXIS_PTS_REF Rail_pSetPointETSCorRgnX_AXIS /end AXIS_DESCR
 /begin AXIS_DESCR COM_AXIS InjCtl_qCurr InjMass 2 0.00 327.6700 EXTENDED_LIMITS -327.6800 327.6700 AXIS_PTS_REF Rail_pSetPointETSCorRgnY_AXIS /end AXIS_DESCR
/end CHARACTERISTIC
/begin CHARACTERISTIC Rail_pSetPointETSCor1_MAP "Umgebungstemperaturkorrekturkennfeld in Abhängigkeit von Motordrehzahl und Einspritzmenge" MAP 0x8005BC90 Map_Xs16Ys16Ws16 2000.000 Pres_Rail 0.00 2000.000 EXTENDED_LIMITS -3276.800 3276.700
 /begin AXIS_DESCR STD_AXIS Epm_nEng EngN 16 0.00 10000.00 EXTENDED_LIMITS -16384.00 16383.50 DEPOSIT ABSOLUTE /end AXIS_DESCR
 /begin AXIS_DESCR STD_AXIS InjCtl_qCurr InjMass 16 0.00 327.6700 EXTENDED_LIMITS -327.6800 327.6700 DEPOSIT ABSOLUTE /end AXIS_DESCR
/end CHARACTERISTIC
/begin AXIS_PTS Rail_pSetPointETSCorRgnX_AXIS "" 0x8005CD62 Epm_nEng Axis_Xs16 10000.00 EngN 2 0.00 10000.00 FORMAT "%8.2" EXTENDED_LIMITS -16384.00 16383.50 DEPOSIT ABSOLUTE /end AXIS_PTS
/begin AXIS_PTS Rail_pSetPointETSCorRgnY_AXIS "" 0x8005CD68 InjCtl_qCurr Axis_Xs16 327.6700 InjMass 2 0.00 327.6700 FORMAT "%8.4" EXTENDED_LIMITS -327.6800 327.6700 DEPOSIT ABSOLUTE /end AXIS_PTS
/begin CHARACTERISTIC Rail_pSetPointETSCor_MAP "motortemperaturabhängige Sollwertkorrektur des Raildrucks" MAP 0x8005C5A6 Map_Xs16Ys16Ws16 2000.000 Pres_Rail 0.00 2000.000 EXTENDED_LIMITS -3276.800 3276.700
 /begin AXIS_DESCR STD_AXIS Epm_nEng EngN 16 0.00 10000.00 EXTENDED_LIMITS -16384.00 16383.50 DEPOSIT ABSOLUTE /end AXIS_DESCR
 /begin AXIS_DESCR STD_AXIS InjCtl_qCurr InjMass 16 0.00 327.6700 EXTENDED_LIMITS -327.6800 327.6700 DEPOSIT ABSOLUTE /end AXIS_DESCR
/end CHARACTERISTIC
/begin CHARACTERISTIC Rail_pSetPointETSCStrt_MAP "Umgebungstemperatur Basiskennfeld für die Raildrucksollwert Korrektur abhängig von Motordrehzahl und Einspritzmenge" MAP 0x8005BED4 Map_Xs16Ys16Ws16 2000.000 Pres_Rail 0.00 2000.000 EXTENDED_LIMITS -3276.800 3276.700
 /begin AXIS_DESCR STD_AXIS Epm_nEng EngN 8 0.00 10000.00 EXTENDED_LIMITS -16384.00 16383.50 DEPOSIT ABSOLUTE /end AXIS_DESCR
 /begin AXIS_DESCR STD_AXIS InjCtl_qCurr InjMass 8 0.00 327.6700 EXTENDED_LIMITS -327.6800 327.6700 DEPOSIT ABSOLUTE /end AXIS_DESCR
/end CHARACTERISTIC
/begin CHARACTERISTIC Rail_pSetPointFTSCor_MAP "Basiswert der kraftstofftemperaturabhängigen Raildruck-Sollwertkorrektur" MAP 0x8005BF78 Map_Xs16Ys16Ws16 2000.000 Pres_Rail 0.00 2000.000 EXTENDED_LIMITS -3276.800 3276.700
 /begin AXIS_DESCR STD_AXIS Epm_nEng EngN 2 0.00 10000.00 EXTENDED_LIMITS -16384.00 16383.50 DEPOSIT ABSOLUTE /end AXIS_DESCR
 /begin AXIS_DESCR STD_AXIS InjCtl_qCurr InjMass 2 0.00 327.6700 EXTENDED_LIMITS -327.6800 327.6700 DEPOSIT ABSOLUTE /end AXIS_DESCR
/end CHARACTERISTIC
/begin CHARACTERISTIC Rail_pSetPointInit_C "Initialwert des Raildrucksollwert" VALUE 0x8005B940 Val_Ws16 5276.800 Pres_Rail -3276.800 2000.000 EXTENDED_LIMITS -3276.800 3276.700 /end CHARACTERISTIC
/begin CHARACTERISTIC Rail_pSetPointLimNFlTemp_C "maximaler Raildrucksollwert, abhängig von der Motordrehzahl und der Kraftstofftemperatur" VALUE 0x8005BF8C Val_Ws16 2000.000 Pres_Rail 0.00 2000.000 EXTENDED_LIMITS -3276.800 3276.700 /end CHARACTERISTIC
/begin CHARACTERISTIC Rail_pSetPointLimNFlTemp_MAP "Minimalwert Korrekturkennfeld der Raildrucksollwertkorrektur in Abhängigkeit von der Motordrehzahl und der Kraftstofftemperatur" MAP 0x8005BF8E Map_Xs16Ys16Ws16 2000.000 Pres_Rail 0.00 2000.000 EXTENDED_LIMITS -3276.800 3276.700
 /begin AXIS_DESCR STD_AXIS Epm_nEng EngN 2 0.00 10000.00 EXTENDED_LIMITS -16384.00 16383.50 DEPOSIT ABSOLUTE /end AXIS_DESCR
 /begin AXIS_DESCR STD_AXIS FuelT_t Temp_Cels 2 -50.14000 149.8600 EXTENDED_LIMITS -3549.940 3003.560 DEPOSIT ABSOLUTE /end AXIS_DESCR
/end CHARACTERISTIC
/begin CHARACTERISTIC Rail_pSetPointMaxDef_C "maximaler Raildruck-Sollwert im Fehlerfall" VALUE 0x8005BFA2 Val_Ws16 2000.000 Pres_Rail 0.00 2000.000 EXTENDED_LIMITS -3276.800 3276.700 /end CHARACTERISTIC
/begin CHARACTERISTIC Rail_pSetPointMaxDef_CUR "Maximaler Raildrucksollwert im Fehlerfall" CURVE 0x8005BFA4 Cur_Xs16Ws16 2000.000 Pres_Rail 0.00 2000.000 EXTENDED_LIMITS -3276.800 3276.700
 /begin AXIS_DESCR STD_AXIS Epm_nEng EngN 6 0.00 10000.00 EXTENDED_LIMITS -16384.00 16383.50 DEPOSIT ABSOLUTE /end AXIS_DESCR
/end CHARACTERISTIC
/begin CHARACTERISTIC Rail_pSetPointMaxDef_MAP "Maximaler Raildrucksollwert im Fehlerfall" MAP 0x800698CA Map_Xs16Ys16Ws16 2000.000 Pres_Rail 0.00 2000.000 EXTENDED_LIMITS -3276.800 3276.700
 /begin AXIS_DESCR STD_AXIS Epm_nEng EngN 6 0.00 10000.00 EXTENDED_LIMITS -16384.00 16383.50 DEPOSIT ABSOLUTE /end AXIS_DESCR
 /begin AXIS_DESCR STD_AXIS FuelT_t Temp_Cels 5 -50.14000 149.8600 EXTENDED_LIMITS -3549.940 3003.560 DEPOSIT ABSOLUTE /end AXIS_DESCR
/end CHARACTERISTIC
/begin CHARACTERISTIC Rail_pSetPointMax_MAP "maximaler Raildruck-Sollwert, abhängig von der Motordrehzahl und der Einspritzmenge" MAP 0x8005BFBE Map_Xs16Ys16Ws16 2000.000 Pres_Rail 0.00 2000.000 EXTENDED_LIMITS -3276.800 3276.700
 /begin AXIS_DESCR STD_AXIS Epm_nEng EngN 5 0.00 10000.00 EXTENDED_LIMITS -16384.00 16383.50 DEPOSIT ABSOLUTE /end AXIS_DESCR
 /begin AXIS_DESCR STD_AXIS InjSys_qTot InjMass 6 0.00 327.6700 EXTENDED_LIMITS -327.6800 327.6700 DEPOSIT ABSOLUTE /end AXIS_DESCR
/end CHARACTERISTIC
/begin CHARACTERISTIC Rail_pSetPointMinDef_C "minimaler Raildruck-Sollwert im Fehlerfall" VALUE 0x8005C014 Val_Ws16 2000.000 Pres_Rail 0.00 2000.000 EXTENDED_LIMITS -3276.800 3276.700 /end CHARACTERISTIC
/begin CHARACTERISTIC Rail_pSetPointMin_MAP "minimaler Raildruck-Sollwert, abhängig von der Motordrehzahl und der Einspritzmenge" MAP 0x8005C016 Map_Xs16Ys16Ws16 2000.000 Pres_Rail 0.00 2000.000 EXTENDED_LIMITS -3276.800 3276.700
 /begin AXIS_DESCR STD_AXIS Epm_nEng EngN 2 0.00 10000.00 EXTENDED_LIMITS -16384.00 16383.50 DEPOSIT ABSOLUTE /end AXIS_DESCR
 /begin AXIS_DESCR STD_AXIS InjSys_qTot InjMass 2 0.00 327.6700 EXTENDED_LIMITS -327.6800 327.6700 DEPOSIT ABSOLUTE /end AXIS_DESCR
/end CHARACTERISTIC
/begin CHARACTERISTIC Rail_pSetPointRed_C "Offset zur Absenkung des Raildrucksollwert im Systemfehlerfall" VALUE 0x8005B942 Val_Ws16 5276.800 Pres_Rail -3276.800 2000.000 EXTENDED_LIMITS -3276.800 3276.700 /end CHARACTERISTIC
/begin CHARACTERISTIC Rail_pSetPointVehCor_MAP "" MAP 0x8005C02A Map_Xs16Ys16Ws16 2000.000 Pres_Rail 0.00 2000.000 EXTENDED_LIMITS -3276.800 3276.700
 /begin AXIS_DESCR STD_AXIS Epm_nEng EngN 10 0.00 10000.00 EXTENDED_LIMITS -16384.00 16383.50 DEPOSIT ABSOLUTE /end AXIS_DESCR
 /begin AXIS_DESCR STD_AXIS InjCtl_qCurr InjMass 10 0.00 327.6700 EXTENDED_LIMITS -327.6800 327.6700 DEPOSIT ABSOLUTE /end AXIS_DESCR
/end CHARACTERISTIC
/begin CHARACTERISTIC Rail_pSetPointZFCMax_C "Maximaler Raildrucksollwert bei aktiver Nullmengenkalibrierung" VALUE 0x8005D322 Val_Ws16 2000.000 Pres_Rail 0.00 2000.000 EXTENDED_LIMITS -3276.800 3276.700 /end CHARACTERISTIC
/begin CHARACTERISTIC Rail_pSetPointZFCMin_C "Minimaler Raildrucksollwert bei aktiver Nullmengenkalibrierung" VALUE 0x8005D324 Val_Ws16 2000.000 Pres_Rail 0.00 2000.000 EXTENDED_LIMITS -3276.800 3276.700 /end CHARACTERISTIC
/begin CHARACTERISTIC Rail_pSetPoint_C "Fernsteuerwert des Raildrucksollwert" VALUE 0x8005B944 Val_Ws16 2000.000 Pres_Rail 0.00 2000.000 EXTENDED_LIMITS -3276.800 3276.700 /end CHARACTERISTIC
/begin CHARACTERISTIC Rail_pStrtLim_C "Raildruckgrenze für die Raildrucküberwachung beim Start" VALUE 0x8005A72E Val_Ws16 2000.000 Pres_Rail 0.00 2000.000 EXTENDED_LIMITS -3276.800 3276.700 /end CHARACTERISTIC
/begin CHARACTERISTIC Rail_qRedOfsLimHi_C "Obere Mengen Hystereseschwelle für die Raildruck Offset Reduzierung" VALUE 0x8005AC78 Val_Ws16 655.3500 InjMass -327.6800 327.6700 /end CHARACTERISTIC
/begin CHARACTERISTIC Rail_qRedOfsLimLo_C "Untere Mengen Hystereseschwelle für die Raildruck Offset Reduzierung" VALUE 0x8005AC7A Val_Ws16 655.3500 InjMass -327.6800 327.6700 /end CHARACTERISTIC
/begin CHARACTERISTIC Rail_qSetSubstLim_C "Maximalmenge bei Testereingriff" VALUE 0x8005CE86 Val_Wu16 327.6700 InjMassCyc 0.00 327.6700 EXTENDED_LIMITS 0.00 655.3500 /end CHARACTERISTIC
/begin CHARACTERISTIC Rail_rFltMinSlpZFC_C "Rampensteigung bei minimalem Raildruck nach Kalibrierung der ZFC" VALUE 0x8005D326 Val_Ws16 100.0000 Prc 0.00 100.0000 EXTENDED_LIMITS -400.0000 399.9878 /end CHARACTERISTIC
/begin CHARACTERISTIC Rail_rZFCInitDwn_CUR "Faktor für anfänglichen Raildrucksollwert des PT1 Filters (abwärts)" CURVE 0x8005D328 Cur_Xs16Ws16 100.0000 Prc 0.00 100.0000 EXTENDED_LIMITS -400.0000 399.9878
 /begin AXIS_DESCR STD_AXIS ZFC_pRailSetPoint_mp Pres_Rail 3 0.00 2000.000 EXTENDED_LIMITS -3276.800 3276.700 DEPOSIT ABSOLUTE /end AXIS_DESCR
/end CHARACTERISTIC
/begin CHARACTERISTIC Rail_rZFCInitUp_CUR "Faktor für anfänglichen Raildrucksollwert des PT1 Filters (aufwärts)" CURVE 0x8005D336 Cur_Xs16Ws16 100.0000 Prc 0.00 100.0000 EXTENDED_LIMITS -400.0000 399.9878
 /begin AXIS_DESCR STD_AXIS ZFC_pRailSetPoint_mp Pres_Rail 3 0.00 2000.000 EXTENDED_LIMITS -3276.800 3276.700 DEPOSIT ABSOLUTE /end AXIS_DESCR
/end CHARACTERISTIC
/begin CHARACTERISTIC Rail_stPreCtlMeUnSel_C "Schalter-Auswahl für die Vorsteuerung der Zumesseinheit" VALUE 0x8005AB54 Val_Wu8 255.0 OneToOne 0.00 255.0 /end CHARACTERISTIC
/begin CHARACTERISTIC Rail_stRgnDelMsk_C "Maske für die Deaktivierung der Raildrucksollwerteberechnung im Regenerationsbetrieb" VALUE 0x8005B948 Val_Wu32 4294967295.00 OneToOne 0.00 4294967295.00 /end CHARACTERISTIC
/begin CHARACTERISTIC Rail_stSetPointRgnMsk_CA "Maske für die Festlegung freizugebender Regenerationsstufen" VAL_BLK 0x8005B130 ValA_Wu32 4294967295.00 OneToOne 0.00 4294967295.00 NUMBER 2 /end CHARACTERISTIC
/begin CHARACTERISTIC Rail_stSetPointRmpSel_CA "Matrix für die Faktorisierungskennlinien der Umschaltrampe für das Rail" MAP 0x8005B138 Map_Xu8Yu8Wu8 1.00000000000 INJCRV_RMP_VERB 1.00000000000 2.00000000000 FORMAT "%13.11" EXTENDED_LIMITS 1.00000000000 7.00000000000
 /begin AXIS_DESCR STD_AXIS Rail_stActVal_mp INJCRV_MSK_VERB 3 0.00 7.00000000000 FORMAT "%13.11" DEPOSIT ABSOLUTE /end AXIS_DESCR
 /begin AXIS_DESCR STD_AXIS Rail_stDesVal_mp INJCRV_MSK_VERB 3 0.00 7.00000000000 FORMAT "%13.11" DEPOSIT ABSOLUTE /end AXIS_DESCR
/end CHARACTERISTIC
/begin CHARACTERISTIC Rail_stSetPointSel_C "Schalterauswahl für die Raildruck-Sollwertberechnung" VALUE 0x8005B94C Val_Wu8 255.0 OneToOne 0.00 255.0 /end CHARACTERISTIC
/begin CHARACTERISTIC Rail_stTrqLimFlSysActv_C "Schalter, ob eine Reaktion zur Kennfeldumschaltung bei Rail_stCtlLoop = RAIL_CTL_CPC(15) aktiv ist oder nicht" VALUE 0x8005CE94 Val_Wu8 255.0 OneToOne 0.00 255.0 /end CHARACTERISTIC
/begin CHARACTERISTIC Rail_swtDvolPreCtl_C "Schalter zur Fernsteuerung des Vorsteuerwerts für die Zumesseinheit" VALUE 0x8005AB55 Val_Wu8 1.000 OneToOne 0.00 1.000 EXTENDED_LIMITS 0.00 255.0 /end CHARACTERISTIC
/begin CHARACTERISTIC Rail_swtPPreCtl_C "Schalter zur Fernsteuerung des Vorsteuerwerts für Druckregelventil" VALUE 0x8005AC7C Val_Wu8 1.000 OneToOne 0.00 1.000 EXTENDED_LIMITS 0.00 255.0 /end CHARACTERISTIC
/begin CHARACTERISTIC Rail_swtPSetPoint_C "Schalter zur Fernsteuerung des Raildrucksollwerts" VALUE 0x8005B94D Val_Wu8 1.000 OneToOne 0.00 1.000 EXTENDED_LIMITS 0.00 255.0 /end CHARACTERISTIC
/begin CHARACTERISTIC Rail_tiDvtPressRedOfsPT1_C "PT1 time constant to switchover reduced offset value dependend on devation value" VALUE 0x8005AC80 Val_Ws32 69.999327293 TimeDelay_ms 29.999911264 99.999238556 FORMAT "%12.8" EXTENDED_LIMITS 0.0020000000009 4294967.2960 /end CHARACTERISTIC
/begin CHARACTERISTIC Rail_tiMaxSetSubst_C "maximale Substitutionsdauer der Raildrucksollwertes" VALUE 0x8005CE88 Val_Wu16 327460.0 Time_ms 0.00 327460.0 EXTENDED_LIMITS 0.00 655350.0 /end CHARACTERISTIC
/begin CHARACTERISTIC Rail_tiPCVRmpDur_CUR "Laufzeit der Rampe um vom aktuellen Sollwert auf den neuen PCVClose-Wert zu rampen" CURVE 0x8005AC84 Cur_Xs16Ws16 655350.0 Time_ms -327680.0 327670.0
 /begin AXIS_DESCR STD_AXIS Epm_nEng EngN 8 0.00 10000.00 EXTENDED_LIMITS -16384.00 16383.50 DEPOSIT ABSOLUTE /end AXIS_DESCR
/end CHARACTERISTIC
/begin CHARACTERISTIC Rail_tiPCVRmpToOfs_C "Laufzeit der Rampe um vom reduzierten Offsetwert auf den Offsetwert zu rampen" VALUE 0x8005ACA6 Val_Ws16 300.0000 Time_ms 0.00 300.0000 EXTENDED_LIMITS -327680.0 327670.0 /end CHARACTERISTIC
/begin CHARACTERISTIC Rail_tiPCVRmpToRedOfs_C "Laufzeit der Rampe um vom Offsetwert auf den reduzierten Offsetwert zu rampen" VALUE 0x8005ACA8 Val_Ws16 300.0000 Time_ms 0.00 300.0000 EXTENDED_LIMITS -327680.0 327670.0 /end CHARACTERISTIC
/begin CHARACTERISTIC Rail_tiPMonStrtLim1_C "" VALUE 0x8005A730 Val_Ws16 10000.00 Time_ms 0.00 10000.00 EXTENDED_LIMITS -327680.0 327670.0 /end CHARACTERISTIC
/begin CHARACTERISTIC Rail_tiPMonStrtLim_C "Zeitgrenze für die Raildrucküberwachung beim Start" VALUE 0x8005A732 Val_Ws16 10000.00 Time_ms 0.00 10000.00 EXTENDED_LIMITS -327680.0 327670.0 /end CHARACTERISTIC
/begin CHARACTERISTIC Rail_tiZFCDemDel_C "Verzögerungszeit für Umschaltung auf geschlossenes Druckregelventil bei aktiver Lernphase der ZFC" VALUE 0x8005D344 Val_Ws16 327670.0 Time_ms 0.00 327670.0 EXTENDED_LIMITS -327680.0 327670.0 /end CHARACTERISTIC
/begin CHARACTERISTIC Rail_tiZFCPT1_C "Parameter für ZFC Raildrucksollwert PT1 Filter" VALUE 0x8005D348 Val_Ws32 4294.9630010 TimeDelay_s 0.0042949672960 4294.9672960 FORMAT "%12.7" EXTENDED_LIMITS 0.000002000000001 4294.9672960 /end CHARACTERISTIC
/begin CHARACTERISTIC Rail_trqFlTempLimMeUn_MAP "Kennfeld zur Momentenbegrenzung abhängig von der Kraftstofftemperatur" MAP 0x8005CE96 Map_Xs16Ys16Ws16 1000.000 Trq 0.00 1000.000 EXTENDED_LIMITS -3276.800 3276.700
 /begin AXIS_DESCR STD_AXIS Epm_nEng EngN 16 0.00 10000.00 EXTENDED_LIMITS -16384.00 16383.50 DEPOSIT ABSOLUTE /end AXIS_DESCR
 /begin AXIS_DESCR STD_AXIS FuelT_t Temp_Cels 16 -50.14000 149.8600 EXTENDED_LIMITS -3549.940 3003.560 DEPOSIT ABSOLUTE /end AXIS_DESCR
/end CHARACTERISTIC
/begin CHARACTERISTIC Rail_trqFlTempLimPCV_MAP "Kennfeld zur Momentenbegrenzung abhängig von der Kraftstofftemperatur" MAP 0x8005D0DA Map_Xs16Ys16Ws16 1000.000 Trq 0.00 1000.000 EXTENDED_LIMITS -3276.800 3276.700
 /begin AXIS_DESCR STD_AXIS Epm_nEng EngN 16 0.00 10000.00 EXTENDED_LIMITS -16384.00 16383.50 DEPOSIT ABSOLUTE /end AXIS_DESCR
 /begin AXIS_DESCR STD_AXIS FuelT_t Temp_Cels 16 -50.14000 149.8600 EXTENDED_LIMITS -3549.940 3003.560 DEPOSIT ABSOLUTE /end AXIS_DESCR
/end CHARACTERISTIC
/begin CHARACTERISTIC Rail_volInjVlvCtl_C "Steuervolumen der Injektoren" VALUE 0x8005AB56 Val_Ws16 10.00000 InjQntInj 0.00 10.00000 EXTENDED_LIMITS -327.6800 327.6700 /end CHARACTERISTIC
/begin CHARACTERISTIC Rail_vVehSpdLim_C "max. Fahrzeuggeschwindigkeit f. Raildrucksubstitution" VALUE 0x8005CE8A Val_Wu16 300.0000 Vel 0.00 300.0000 EXTENDED_LIMITS 0.00 655.3500 /end CHARACTERISTIC
/begin CHARACTERISTIC Reset_xGrpId_C "Reset-Gruppen-ID mit welcher ein SoftwareReset ausgelöst werden soll" VALUE 0x8005D34C Val_Wu8 255.0 OneToOne 0.00 255.0 /end CHARACTERISTIC
/begin CHARACTERISTIC Reset_xTrgId_C "Reset-ID mit welcher ein SoftwareReset ausgelöst werden soll" VALUE 0x8005D34E Val_Wu16 65535.00 OneToOne 0.00 65535.00 /end CHARACTERISTIC
/begin CHARACTERISTIC RngMod_nLIDvtnMax_C "Maximal zulässige Leerlaufregelabweichung für Verlustmomentenadaption" VALUE 0x8005D354 Val_Ws16 32767.50 EngN -16384.00 16383.50 /end CHARACTERISTIC
/begin CHARACTERISTIC RngMod_numTrqFrc_C "Parameter zur Auswahl der Eingangstemperatur" VALUE 0x8005D364 Val_Wu8 3.00000000000 EngTempFldSel 0.00 3.00000000000 FORMAT "%13.11" /end CHARACTERISTIC
/begin CHARACTERISTIC RngMod_stActvLossComp_C "Schalter zur Aktivierung zusätzlicher Verlustmomente (Bit0: ladungsabhängigeVerluste Bit1: Gaswechselverluste)" VALUE 0x8005D365 Val_Wu8 255.0 OneToOne 0.00 255.0 /end CHARACTERISTIC
/begin CHARACTERISTIC RngMod_stHydConvMtd_C "Schalter: Hydarulische Wandlerkupplung verbaut ?" VALUE 0x8005D356 Val_Wu8 255.0 OneToOne 0.00 255.0 /end CHARACTERISTIC
/begin CHARACTERISTIC RngMod_stNormal_C "Schalter zum Ausblenden der zusätzlichen Verluste" VALUE 0x8005D368 Val_Wu32 4294967295.00 OneToOne 0.00 4294967295.00 /end CHARACTERISTIC
/begin CHARACTERISTIC RngMod_swtAcs_C "" VALUE 0x8005D350 Val_Wu8 1.000 OneToOne 0.00 1.000 EXTENDED_LIMITS 0.00 255.0 /end CHARACTERISTIC
/begin CHARACTERISTIC RngMod_swtAdj_C "" VALUE 0x8005D5D8 Val_Wu8 1.000 OneToOne 0.00 1.000 EXTENDED_LIMITS 0.00 255.0 /end CHARACTERISTIC
/begin CHARACTERISTIC RngMod_T1FltAdap_C "Zeitkonstante der Verlustmomentenadaptionsfilter" VALUE 0x8005D358 Val_Ws32 4294967.2940 TimeDelay_ms 0.0020000000009 4294967.2960 FORMAT "%12.4" /end CHARACTERISTIC
/begin CHARACTERISTIC RngMod_tAdapMin_C "Minimale zulässige Motortemperatur für Verlustmomentenadaption" VALUE 0x8005D35C Val_Ws16 6553.500 Temp_Cels -3549.940 3003.560 /end CHARACTERISTIC
/begin CHARACTERISTIC RngMod_tiRelAdap_C "Entprellzeit für Freigabe der Verlustmomentenadaption" VALUE 0x8005D35E Val_Ws16 327620.0 Time_ms 50.00000 327670.0 EXTENDED_LIMITS -327680.0 327670.0 /end CHARACTERISTIC
/begin CHARACTERISTIC RngMod_trqChExchLoss_MAP "Kennfeld Ladungswechselverluste" MAP 0x8005D36C Map_Xs16Ys16Ws16 60.00000 Trq -30.00000 30.00000 EXTENDED_LIMITS -3276.800 3276.700
 /begin AXIS_DESCR STD_AXIS AFS_dm AirMassPerTime 2 -3276.800 3276.700 DEPOSIT ABSOLUTE /end AXIS_DESCR
 /begin AXIS_DESCR STD_AXIS Air_pIntkVUs Pres_hPa 2 -32768.00 3500.00 EXTENDED_LIMITS -32768.00 32767.00 DEPOSIT ABSOLUTE /end AXIS_DESCR
/end CHARACTERISTIC
/begin CHARACTERISTIC RngMod_trqFrcLd_MAP "Kennfeld für lastabhängige Reibungsverluste" MAP 0x8005D380 Map_Xs16Ys16Ws16 60.00000 Trq -30.00000 30.00000 EXTENDED_LIMITS -3276.800 3276.700
 /begin AXIS_DESCR STD_AXIS Cpp_trqInrCorAvrg Trq 2 -3276.800 3276.700 DEPOSIT ABSOLUTE /end AXIS_DESCR
 /begin AXIS_DESCR STD_AXIS Cpp_pCylAvrgAg1 CylPres 2 -327.6800 327.6700 FORMAT "%8.4" DEPOSIT ABSOLUTE /end AXIS_DESCR
/end CHARACTERISTIC
/begin CHARACTERISTIC RngMod_trqFrc_MAP "Schleppkennfeld, Reibkennfeld" MAP 0x8005D394 Map_Xs16Ys16Ws16 100.0000 Trq -100.0000 0.00 EXTENDED_LIMITS -3276.800 3276.700
 /begin AXIS_DESCR STD_AXIS Epm_nEng EngN 16 0.00 16383.50 EXTENDED_LIMITS -16384.00 16383.50 DEPOSIT ABSOLUTE /end AXIS_DESCR
 /begin AXIS_DESCR STD_AXIS RngMod_tTrqFrc_mp Temp_Cels 16 -273.1400 3003.560 EXTENDED_LIMITS -3549.940 3003.560 DEPOSIT ABSOLUTE /end AXIS_DESCR
/end CHARACTERISTIC
/begin CHARACTERISTIC RngMod_trqSpd_MAP "" MAP 0x8005D5DA Map_Xs16Ys16Ws16 3276.700 Trq 0.00 3276.700 EXTENDED_LIMITS -3276.800 3276.700
 /begin AXIS_DESCR STD_AXIS Epm_nEng EngN 21 0.00 6000.000 EXTENDED_LIMITS -16384.00 16383.50 DEPOSIT ABSOLUTE /end AXIS_DESCR
 /begin AXIS_DESCR STD_AXIS CodVar_stTrqClth OneToOne 8 0.00 255.0 DEPOSIT ABSOLUTE /end AXIS_DESCR
/end CHARACTERISTIC
/begin CHARACTERISTIC RngMod_vLimTrans_C "Geschwindigkeitsschwelle für Zustandsübergang REFUSE_ADAPT --> NO_ADAPT" VALUE 0x8005D360 Val_Ws16 655.3500 Vel -327.6800 327.6700 /end CHARACTERISTIC
/begin CHARACTERISTIC SCRAd_dmExhMnfDs_C "Testlabel" VALUE 0x8005D8F4 Val_Ws16 6553.500 AirMassPerTime -3276.800 3276.700 /end CHARACTERISTIC
/begin CHARACTERISTIC SCRAd_dmNH3Cnv_C "" VALUE 0x8005D810 Val_Ws16 3276.750 SCR_Dm005 -1638.400 1638.350 FORMAT "%8.3" /end CHARACTERISTIC
/begin CHARACTERISTIC SCRAd_dmNH3Curr_C "" VALUE 0x8005D812 Val_Ws16 3276.750 SCR_Dm005 -1638.400 1638.350 FORMAT "%8.3" /end CHARACTERISTIC
/begin CHARACTERISTIC SCRAd_dmNOxUs_C "" VALUE 0x8005D814 Val_Ws32 4294967.29500 SCR_dmNOx_mg_p_s -2147483.64800 2147483.64700 FORMAT "%13.5" /end CHARACTERISTIC
/begin CHARACTERISTIC SCRAd_etaEst_C "" VALUE 0x8005D794 Val_Ws16 65.53500 SCR_Fact1000 -32.76800 32.76700 FORMAT "%8.5" /end CHARACTERISTIC
/begin CHARACTERISTIC SCRAd_etaMinSlipActv_C "Mindestwirkungsgrad zur Schluperkennung" VALUE 0x8005D796 Val_Ws16 1.000000 SCR_Fact1000 0.00 1.000000 FORMAT "%8.6" EXTENDED_LIMITS -32.76800 32.76700 /end CHARACTERISTIC
/begin CHARACTERISTIC SCRAd_facCnvNOxToNH3_C "Umrechnungsfaktor von NOx-Konzentration in NH3-Massenstrom" VALUE 0x8005D8F8 Val_Ws32 1.00000000000 SCR_Fact1000000 0.00 1.00000000000 FORMAT "%13.11" EXTENDED_LIMITS -2147.48364800 2147.48364700 /end CHARACTERISTIC
/begin CHARACTERISTIC SCRAd_facKiNH3Cnv_C "Integrationskonstante Umsatz" VALUE 0x8005D818 Val_Ws16 1.000000 SCR_Fact1000 0.00 1.000000 FORMAT "%8.6" EXTENDED_LIMITS -32.76800 32.76700 /end CHARACTERISTIC
/begin CHARACTERISTIC SCRAd_facKiNH3Curr_C "Integrationskonstante RM" VALUE 0x8005D81A Val_Ws16 1.000000 SCR_Fact1000 0.00 1.000000 FORMAT "%8.6" EXTENDED_LIMITS -32.76800 32.76700 /end CHARACTERISTIC
/begin CHARACTERISTIC SCRAd_facKiNOxUs_C "Integrationskonstante NOx Rohemission" VALUE 0x8005D81C Val_Ws16 1.000000 SCR_Fact1000 0.00 1.000000 FORMAT "%8.6" EXTENDED_LIMITS -32.76800 32.76700 /end CHARACTERISTIC
/begin CHARACTERISTIC SCRAd_facLimAdapNgv_C "Untere Grenze des Langzeitadaptionsfaktors" VALUE 0x8005D7D8 Val_Ws16 10.00000 SCR_Fact100 0.00 10.00000 FORMAT "%8.5" EXTENDED_LIMITS -327.6800 327.6700 /end CHARACTERISTIC
/begin CHARACTERISTIC SCRAd_facLimAdapPsv_C "Obere Grenze des Langzeitadaptationsfaktors (positive Adaption)" VALUE 0x8005D7DA Val_Ws16 10.00000 SCR_Fact100 0.00 10.00000 FORMAT "%8.5" EXTENDED_LIMITS -327.6800 327.6700 /end CHARACTERISTIC
/begin CHARACTERISTIC SCRAd_facMaxAdap_C "Obere Grenze des Langzeitadapionsfaktors" VALUE 0x8005D7DC Val_Ws16 10.00000 SCR_Fact100 0.00 10.00000 FORMAT "%8.5" EXTENDED_LIMITS -327.6800 327.6700 /end CHARACTERISTIC
/begin CHARACTERISTIC SCRAd_facMinAdap_C "Untere Grenze des Langzeitadaptionsfaktors" VALUE 0x8005D7DE Val_Ws16 10.00000 SCR_Fact100 0.00 10.00000 FORMAT "%8.5" EXTENDED_LIMITS -327.6800 327.6700 /end CHARACTERISTIC
/begin CHARACTERISTIC SCRAd_facNH3LdRst_CUR "Berechnungsfaktor für FS-Initialisierung" CURVE 0x8005D768 Cur_Xs16Ws16 32.00000 SCR_Fact1000 0.00 32.00000 FORMAT "%8.5" EXTENDED_LIMITS -32.76800 32.76700
 /begin AXIS_DESCR STD_AXIS SCRAd_mNH3Cnv SCR_Mass1000 10 0.00 32.0000000000 FORMAT "%13.10" EXTENDED_LIMITS -2147483.64800 2147483.64700 DEPOSIT ABSOLUTE /end AXIS_DESCR
/end CHARACTERISTIC
/begin CHARACTERISTIC SCRAd_facPlausCmp_CUR "NOx Mengen abhängiger Plausibilitätswert" CURVE 0x8005D820 Cur_Xr32Wr32 10000000.0 Mass 0.00 10000000.0 FORMAT "%10.1" EXTENDED_LIMITS -1.00000000E+037 1.00000000E+037
 /begin AXIS_DESCR STD_AXIS SCRAd_realCurIn_mp Mass 11 0.00 100.000000 FORMAT "%10.6" EXTENDED_LIMITS -1.00000000E+037 1.00000000E+037 DEPOSIT ABSOLUTE /end AXIS_DESCR
/end CHARACTERISTIC
/begin CHARACTERISTIC SCRAd_facQtyAdap_C "" VALUE 0x8005DDBA Val_Ws16 655.3500 Fact100 -327.6800 327.6700 FORMAT "%8.4" /end CHARACTERISTIC
/begin CHARACTERISTIC SCRAd_facQtyCorrNgv_C "Offset zur Verringerung des Langzeitadaptionsfaktors" VALUE 0x8005D7E0 Val_Ws16 10.00000 SCR_Fact100 -10.00000 0.00 FORMAT "%8.5" EXTENDED_LIMITS -327.6800 327.6700 /end CHARACTERISTIC
/begin CHARACTERISTIC SCRAd_facQtyCorrPsv_C "Offset zur Erhöhung des Langzeitadaptionsfaktors" VALUE 0x8005D7E2 Val_Ws16 10.00000 SCR_Fact100 0.00 10.00000 FORMAT "%8.5" EXTENDED_LIMITS -327.6800 327.6700 /end CHARACTERISTIC
/begin CHARACTERISTIC SCRAd_facQtyInit_C "Initialisierungswert für Langzeitadaptionsfaktor" VALUE 0x8005D7E4 Val_Ws16 10.00000 SCR_Fact100 0.00 10.00000 FORMAT "%8.5" EXTENDED_LIMITS -327.6800 327.6700 /end CHARACTERISTIC
/begin CHARACTERISTIC SCRAd_mEstNH3Ld_C "Testlabel" VALUE 0x8005D87C Val_Ws16 65.53500 SCR_Mass1000 -32.76800 32.76700 FORMAT "%8.5" /end CHARACTERISTIC
/begin CHARACTERISTIC SCRAd_mMaxNH3Cnv_C "Obere Umsatzgrenze für Langzeitadaptionsberechnung" VALUE 0x8005D7E8 Val_Ws32 100.000000000 SCR_Mass1000 0.00 100.000000000 FORMAT "%13.9" EXTENDED_LIMITS -2147483.64800 2147483.64700 /end CHARACTERISTIC
/begin CHARACTERISTIC SCRAd_mMaxPlausNH3Cnv_C "Obergrenze für den Umsatz" VALUE 0x8005D87E Val_Ws16 100.0000 SCR_Mass100 0.00 100.0000 FORMAT "%8.4" EXTENDED_LIMITS -327.6800 327.6700 /end CHARACTERISTIC
/begin CHARACTERISTIC SCRAd_mMaxPlausNH3Curr_C "Obergrenze für die Dosiermenge" VALUE 0x8005D880 Val_Ws16 100.0000 SCR_Mass100 0.00 100.0000 FORMAT "%8.4" EXTENDED_LIMITS -327.6800 327.6700 /end CHARACTERISTIC
/begin CHARACTERISTIC SCRAd_mMaxPlausNH3Us_C "Obergrenze der NOx-Rohmenge" VALUE 0x8005D882 Val_Ws16 100.0000 SCR_Mass100 0.00 100.0000 FORMAT "%8.4" EXTENDED_LIMITS -327.6800 327.6700 /end CHARACTERISTIC
/begin CHARACTERISTIC SCRAd_mMinNH3Cnv_C "Untere Umsatzgrenze für Langzeitadaptionsberechnung" VALUE 0x8005D7EC Val_Ws32 100.000000000 SCR_Mass1000 0.00 100.000000000 FORMAT "%13.9" EXTENDED_LIMITS -2147483.64800 2147483.64700 /end CHARACTERISTIC
/begin CHARACTERISTIC SCRAd_mMinPlausNH3Cnv_C "Untergrenze für den Umsatz" VALUE 0x8005D884 Val_Ws16 100.0000 SCR_Mass100 0.00 100.0000 FORMAT "%8.4" EXTENDED_LIMITS -327.6800 327.6700 /end CHARACTERISTIC
/begin CHARACTERISTIC SCRAd_mMinPlausNH3Curr_C "Untergrenze für die Dosiermenge" VALUE 0x8005D886 Val_Ws16 100.0000 SCR_Mass100 0.00 100.0000 FORMAT "%8.4" EXTENDED_LIMITS -327.6800 327.6700 /end CHARACTERISTIC
/begin CHARACTERISTIC SCRAd_mMinPlausNH3Us_C "Untere Grenze NOx-Rohmenge" VALUE 0x8005D888 Val_Ws16 100.0000 SCR_Mass100 0.00 100.0000 FORMAT "%8.4" EXTENDED_LIMITS -327.6800 327.6700 /end CHARACTERISTIC
/begin CHARACTERISTIC SCRAd_mNH3Cnv_C "Testlabel" VALUE 0x8005D7F0 Val_Ws16 65.53500 SCR_Mass1000 -32.76800 32.76700 FORMAT "%8.5" /end CHARACTERISTIC
/begin CHARACTERISTIC SCRAd_mNH3LdAdap_MAP "Füllstandskorrekturkennfeld" MAP 0x8005D8FC Map_Xs16Ys16Ws16 32.00000 SCR_Mass1000 0.00 32.00000 FORMAT "%8.5" EXTENDED_LIMITS -32.76800 32.76700
 /begin AXIS_DESCR STD_AXIS SCRAd_rDeltaNOxSensDs_mp SCR_Rat1 12 -32768.00 32767.00 FORMAT "%8.2" DEPOSIT ABSOLUTE /end AXIS_DESCR
 /begin AXIS_DESCR STD_AXIS SCRAd_tAvrg_mp Temp_Cels 11 -3549.940 3003.560 DEPOSIT ABSOLUTE /end AXIS_DESCR
/end CHARACTERISTIC
/begin CHARACTERISTIC SCRAd_mNH3LdNom_C "" VALUE 0x8005D88A Val_Ws16 65.53500 SCR_Mass1000 -32.76800 32.76700 FORMAT "%8.5" /end CHARACTERISTIC
/begin CHARACTERISTIC SCRAd_mskAdapNgv1_C "Maske für die Verringerung von SCRAd_facUQtyAdapRaw_mp" VALUE 0x8005D7F2 Val_Wu16 1024.000 OneToOne 0.00 1024.000 EXTENDED_LIMITS 0.00 65535.00 /end CHARACTERISTIC
/begin CHARACTERISTIC SCRAd_mskAdapNgv2_C "Maske für die Verringerung von SCRAd_facUQtyAdapRaw_mp" VALUE 0x8005D7F4 Val_Wu16 1024.000 OneToOne 0.00 1024.000 EXTENDED_LIMITS 0.00 65535.00 /end CHARACTERISTIC
/begin CHARACTERISTIC SCRAd_mskAdapPsv1_C "Maske für die Erhöhung von SCRAd_facUQtyAdapRaw_mp" VALUE 0x8005D7F6 Val_Wu16 1024.000 OneToOne 0.00 1024.000 EXTENDED_LIMITS 0.00 65535.00 /end CHARACTERISTIC
/begin CHARACTERISTIC SCRAd_mskAdapPsv2_C "Maske für die Erhöhung von SCRAd_facUQtyAdapRaw_mp" VALUE 0x8005D7F8 Val_Wu16 1024.000 OneToOne 0.00 1024.000 EXTENDED_LIMITS 0.00 65535.00 /end CHARACTERISTIC
/begin CHARACTERISTIC SCRAd_mskAdapRstReqNgv_C "Maske zur Bitbegrenzung in SCRAd_stAdapRstReqNgv_mp" VALUE 0x8005D7FA Val_Wu16 1024.000 OneToOne 0.00 1024.000 EXTENDED_LIMITS 0.00 65535.00 /end CHARACTERISTIC
/begin CHARACTERISTIC SCRAd_mskAdapRstReqPsv_C "Maske zur Bitbegrenzung in SCRAd_stAdapRstReqPsv_mp" VALUE 0x8005D7FC Val_Wu16 1024.000 OneToOne 0.00 1024.000 EXTENDED_LIMITS 0.00 65535.00 /end CHARACTERISTIC
/begin CHARACTERISTIC SCRAd_mskEFlPsv_C "Maske für die Erhöhung von SCRAd_fac UQtyAdapRaw_mp über Detection EFL" VALUE 0x8005D7FE Val_Wu16 1024.000 OneToOne 0.00 1024.000 EXTENDED_LIMITS 0.00 65535.00 /end CHARACTERISTIC
/begin CHARACTERISTIC SCRAd_numAvrgStrMax_C "Max. Anzahl der Größen zur Mittelwertbildung" VALUE 0x8005DA36 Val_Ws16 10.00000 OneToOne 1.000000 11.00000 EXTENDED_LIMITS -32768.00 32767.00 /end CHARACTERISTIC
/begin CHARACTERISTIC SCRAd_qCurrActDiffMax_C "Obergrenze der Änderung der Einspritzmenge" VALUE 0x8005D88C Val_Ws16 400.0000 InjMass -200.0000 200.0000 EXTENDED_LIMITS -327.6800 327.6700 /end CHARACTERISTIC
/begin CHARACTERISTIC SCRAd_qCurrActDiffMin_C "Untergrenze für die Einspritzmengenänderung" VALUE 0x8005D88E Val_Ws16 400.0000 InjMass -200.0000 200.0000 EXTENDED_LIMITS -327.6800 327.6700 /end CHARACTERISTIC
/begin CHARACTERISTIC SCRAd_qCurr_C "Testlabel" VALUE 0x8005D890 Val_Ws16 655.3500 InjMass -327.6800 327.6700 /end CHARACTERISTIC
/begin CHARACTERISTIC SCRAd_rDeltaNOxPosMax_CUR "Plausibilisierungsgrenze für den NOx-Signalsprung" CURVE 0x8005D892 Cur_Xs16Ws16 1000.000 SCR_Rat1 0.00 1000.000 FORMAT "%8.3" EXTENDED_LIMITS -32768.00 32767.00
 /begin AXIS_DESCR STD_AXIS SCRFFC_rPPMNOxUs OneToOne 12 -32768.00 32767.00 DEPOSIT ABSOLUTE /end AXIS_DESCR
/end CHARACTERISTIC
/begin CHARACTERISTIC SCRAd_rDeltaNOxSensDs_C "" VALUE 0x8005D798 Val_Ws16 65535.00 SCR_Rat1 -32768.00 32767.00 FORMAT "%8.2" /end CHARACTERISTIC
/begin CHARACTERISTIC SCRAd_rEstNOxDs_C "Testlabel" VALUE 0x8005DA38 Val_Ws16 65535.00 SCR_Rat1 -32768.00 32767.00 FORMAT "%8.2" /end CHARACTERISTIC
/begin CHARACTERISTIC SCRAd_rMinNOxSlipActv_C "Mindestkonzentration des NOx-Sensors für Aktivierung der Schluperkennung" VALUE 0x8005D79A Val_Ws16 2500.000 SCR_Rat1 0.00 2500.000 FORMAT "%8.3" EXTENDED_LIMITS -32768.00 32767.00 /end CHARACTERISTIC
/begin CHARACTERISTIC SCRAd_rMXNH3Ld_C "Maximal zulässiges Füllstandsverhältnis" VALUE 0x8005D8C4 Val_Ws16 10.00000 SCR_Fact10 0.00 10.00000 FORMAT "%8.5" EXTENDED_LIMITS -3276.800 3276.700 /end CHARACTERISTIC
/begin CHARACTERISTIC SCRAd_rNOxSensDs_C "Testlabel" VALUE 0x8005DA3A Val_Ws16 65535.00 SCR_Rat1 -32768.00 32767.00 FORMAT "%8.2" /end CHARACTERISTIC
/begin CHARACTERISTIC SCRAd_rPlausDeltaNOxSensDs_C "Testlabel" VALUE 0x8005D8C6 Val_Ws16 65535.00 SCR_Rat1 -32768.00 32767.00 FORMAT "%8.2" /end CHARACTERISTIC
/begin CHARACTERISTIC SCRAd_rPPMNOxUs_C "Testlabel" VALUE 0x8005D8C8 Val_Ws16 3276.750 SCR_dmNH3_mg_p_s -1638.400 1638.350 FORMAT "%8.3" /end CHARACTERISTIC
/begin CHARACTERISTIC SCRAd_rTolcNOxCalc_CUR "Tolerierte NOx-Sensorabweichung" CURVE 0x8005D79C Cur_Xs16Ws16 65535.00 SCR_Rat1 -32768.00 32767.00 FORMAT "%8.2"
 /begin AXIS_DESCR STD_AXIS SCRMod_rEstNOxDs OneToOne 10 -32768.00 32767.00 DEPOSIT ABSOLUTE /end AXIS_DESCR
/end CHARACTERISTIC
/begin CHARACTERISTIC SCRAd_stActvFltMnl_C "Status der manuellen Freigabe für die Schlupferkennung" VALUE 0x8005D7C6 Val_Wu8 31.00 OneToOne 0.00 31.00 EXTENDED_LIMITS 0.00 255.0 /end CHARACTERISTIC
/begin CHARACTERISTIC SCRAd_stAdapReq_C "Testlabel" VALUE 0x8005D8CA Val_Wu8 1.00000000000 SCRAd_Compu_Switch_1 0.00 1.00000000000 FORMAT "%13.11" /end CHARACTERISTIC
/begin CHARACTERISTIC SCRAd_stAdapRstReq_C "Testlabel" VALUE 0x8005D800 Val_Wu8 1.000 OneToOne 0.00 1.000 EXTENDED_LIMITS 0.00 255.0 /end CHARACTERISTIC
/begin CHARACTERISTIC SCRAd_stAdap_C "Testlabel" VALUE 0x8005D8CB Val_Wu8 255.0 OneToOne 0.00 255.0 /end CHARACTERISTIC
/begin CHARACTERISTIC SCRAd_stEFlRst_C "Testlabel" VALUE 0x8005D801 Val_Wu8 1.000 OneToOne 0.00 1.000 EXTENDED_LIMITS 0.00 255.0 /end CHARACTERISTIC
/begin CHARACTERISTIC SCRAd_stNH3LdCodtInactv_C "" VALUE 0x8005D7C7 Val_Wu8 255.0 OneToOne 0.00 255.0 /end CHARACTERISTIC
/begin CHARACTERISTIC SCRAd_stSlip_C "Testlabel" VALUE 0x8005DA3C Val_Wu8 1.00000000000 SCRAd_Compu_Switch_3 0.00 1.00000000000 FORMAT "%13.11" /end CHARACTERISTIC
/begin CHARACTERISTIC SCRAd_stTmrPlausExpi_C "Testlabel" VALUE 0x8005D802 Val_Wu8 1.000 OneToOne 0.00 1.000 EXTENDED_LIMITS 0.00 255.0 /end CHARACTERISTIC
/begin CHARACTERISTIC SCRAd_swtDeltaNOx_C "SCRAd_rDeltaNOxSensDs Filterung aktiv/ inaktiv" VALUE 0x8005D8CC Val_Wu8 1.00000000000 SCRAd_Compu_Switch_2 0.00 1.00000000000 FORMAT "%13.11" /end CHARACTERISTIC
/begin CHARACTERISTIC SCRAd_swtEFlLd_C "Schalter zur Aktivierung NH3 Load Interpretation" VALUE 0x8005D8CD Val_Wu8 1.00000000000 SCRAd_Compu_Switch_2 0.00 1.00000000000 FORMAT "%13.11" /end CHARACTERISTIC
/begin CHARACTERISTIC SCRAd_swtEFlSens_C "Schalter zur Aktivierung von DeltaSens NOx Interpretation" VALUE 0x8005D8CE Val_Wu8 1.00000000000 SCRAd_Compu_Switch_2 0.00 1.00000000000 FORMAT "%13.11" /end CHARACTERISTIC
/begin CHARACTERISTIC SCRAd_swtQtyAdapInit_C "Schalterfür die Initialisierung der Langzeitadaption" VALUE 0x8005D803 Val_Wu8 1.00000000000 SCRAd_Compu_Switch_3 0.00 1.00000000000 FORMAT "%13.11" /end CHARACTERISTIC
/begin CHARACTERISTIC SCRAd_swtQtyAdap_C "Schalter zum Aktivieren/Deaktivieren des Langzeitadaptionseingriff" VALUE 0x8005D804 Val_Wu8 1.00000000000 SCRAd_Compu_Switch_3 0.00 1.00000000000 FORMAT "%13.11" /end CHARACTERISTIC
/begin CHARACTERISTIC SCRAd_swtTestEnaFL_C "" VALUE 0x8005D7C8 Val_Wu8 1.00000000000 SCRAd_Compu_Switch_3 0.00 1.00000000000 FORMAT "%13.11" /end CHARACTERISTIC
/begin CHARACTERISTIC SCRAd_swtTestEna_C "Testlabel" VALUE 0x8005D805 Val_Wu8 1.00000000000 SCRAd_Compu_Switch_3 0.00 1.00000000000 FORMAT "%13.11" /end CHARACTERISTIC
/begin CHARACTERISTIC SCRAd_tFld2_C "Testlabel" VALUE 0x8005DA3E Val_Ws16 6553.500 Temp_Cels -3549.940 3003.560 /end CHARACTERISTIC
/begin CHARACTERISTIC SCRAd_tFld3_C "" VALUE 0x8005D7CA Val_Ws16 6553.500 Temp_Cels -3549.940 3003.560 /end CHARACTERISTIC
/begin CHARACTERISTIC SCRAd_tiAvrgStrTrg_C "Triggerzeit für die Mttelwertbildung" VALUE 0x8005DA40 Val_Ws16 20.00000 SCR_Time100 0.00 20.00000 FORMAT "%8.5" EXTENDED_LIMITS -327.6800 327.6700 /end CHARACTERISTIC
/begin CHARACTERISTIC SCRAd_tiDebFltEtaEst_C "Entprellzeit für den Mindest NOx-Umsatz" VALUE 0x8005D7CC Val_Ws16 655.3500 SCR_Time100 -327.6800 327.6700 FORMAT "%8.4" /end CHARACTERISTIC
/begin CHARACTERISTIC SCRAd_tiDebFltNOxSens_C "Entprellzeit für die Mindest NOx-Konzentration" VALUE 0x8005D7CE Val_Ws16 655.3500 SCR_Time100 -327.6800 327.6700 FORMAT "%8.4" /end CHARACTERISTIC
/begin CHARACTERISTIC SCRAd_tiDebFltTemp_C "Entprellzeit für Mindesttemperatur" VALUE 0x8005D7D0 Val_Ws16 655.3500 SCR_Time100 -327.6800 327.6700 FORMAT "%8.4" /end CHARACTERISTIC
/begin CHARACTERISTIC SCRAd_tiDebFltTolcNOx_C "Entprellzeit für tolerierte NOx-Sensorabweichung" VALUE 0x8005D7D2 Val_Ws16 655.3500 SCR_Time100 -327.6800 327.6700 FORMAT "%8.4" /end CHARACTERISTIC
/begin CHARACTERISTIC SCRAd_tiDebSlipActv_C "Entprellzeit für die Aktivierung der Schlupferkennung" VALUE 0x8005D7D4 Val_Ws16 655.3500 SCR_Time100 -327.6800 327.6700 FORMAT "%8.4" /end CHARACTERISTIC
/begin CHARACTERISTIC SCRAd_tiDeltaNOxDsFlt_C "Zeitkonstante für Filterung von SCRAd_rDeltaNOxSensDs" VALUE 0x8005D8D0 Val_Ws16 10.00000 SCR_Time100 0.00 10.00000 FORMAT "%8.5" EXTENDED_LIMITS -327.6800 327.6700 /end CHARACTERISTIC
/begin CHARACTERISTIC SCRAd_tiEFl_C "Zeit für die DeltaSensNOx Interpretation" VALUE 0x8005D8D2 Val_Ws16 10.00000 SCR_Time100 0.00 10.00000 FORMAT "%8.5" EXTENDED_LIMITS -327.6800 327.6700 /end CHARACTERISTIC
/begin CHARACTERISTIC SCRAd_tiIniAdap_C "Initialisierungszeit für Langzeitadaption" VALUE 0x8005D808 Val_Wu32 10000.0000000 SCR_Time10 0.00 10000.0000000 FORMAT "%13.7" EXTENDED_LIMITS 0.00 429496729.500 /end CHARACTERISTIC
/begin CHARACTERISTIC SCRAd_tiIniEFl_C "Restzeit für die Berechnung von SCRAd_stEFLRstReqPsv_mp" VALUE 0x8005D80C Val_Wu32 10000.0000000 SCR_Time10 0.00 10000.0000000 FORMAT "%13.7" EXTENDED_LIMITS 0.00 429496729.500 /end CHARACTERISTIC
/begin CHARACTERISTIC SCRAd_tiNH3LdFault_C "Zeit für die NH3 Load Interpretation" VALUE 0x8005D8D4 Val_Ws32 1000.00000000 SCR_Time100 0.00 1000.00000000 FORMAT "%13.8" EXTENDED_LIMITS -21474836.4800 21474836.4700 /end CHARACTERISTIC
/begin CHARACTERISTIC SCRAd_tiQCurrFlt_C "Zeitkonstante für Filterung Einspritzmenge" VALUE 0x8005D8D8 Val_Ws16 10.00000 SCR_Time100 0.00 10.00000 FORMAT "%8.5" EXTENDED_LIMITS -327.6800 327.6700 /end CHARACTERISTIC
/begin CHARACTERISTIC SCRAd_tiQStatMin_C "Untere Zeitgrenze für die konstante Einspritzmenge" VALUE 0x8005D8DA Val_Ws16 10.00000 SCR_Time10 0.00 10.00000 FORMAT "%8.5" EXTENDED_LIMITS -3276.800 3276.700 /end CHARACTERISTIC
/begin CHARACTERISTIC SCRAd_tiStp_C "Triggerzeit konstanter Betriebspunkt" VALUE 0x8005D8DC Val_Ws16 10.00000 SCR_Time10 0.00 10.00000 FORMAT "%8.5" EXTENDED_LIMITS -3276.800 3276.700 /end CHARACTERISTIC
/begin CHARACTERISTIC SCRAd_tiTmrCodt_C "Bedingungszeit" VALUE 0x8005D8E0 Val_Ws32 1000.00000000 SCR_Time100 0.00 1000.00000000 FORMAT "%13.8" EXTENDED_LIMITS -21474836.4800 21474836.4700 /end CHARACTERISTIC
/begin CHARACTERISTIC SCRAd_tiTmrPlaus_C "Plausibilisierungszeit" VALUE 0x8005D8E4 Val_Ws32 1000.00000000 SCR_Time100 0.00 1000.00000000 FORMAT "%13.8" EXTENDED_LIMITS -21474836.4800 21474836.4700 /end CHARACTERISTIC
/begin CHARACTERISTIC SCRAd_tiTmrTrg_C "Triggerzeit für FS-Adaption" VALUE 0x8005D792 Val_Ws16 20000.00 Time_ms 0.00 20000.00 EXTENDED_LIMITS -327680.0 327670.0 /end CHARACTERISTIC
/begin CHARACTERISTIC SCRAd_tiVelFlt_C "Zeitkonstante für Filterung Fahrzeuggeschwindigkeit" VALUE 0x8005D8E8 Val_Ws16 10.00000 SCR_Time100 0.00 10.00000 FORMAT "%8.5" EXTENDED_LIMITS -327.6800 327.6700 /end CHARACTERISTIC
/begin CHARACTERISTIC SCRAd_tiVelStatMin_C "Zeitgrenzefür die konstante Fahrzeuggeschwindigkeit" VALUE 0x8005D8EA Val_Ws16 10.00000 SCR_Time10 0.00 10.00000 FORMAT "%8.5" EXTENDED_LIMITS -3276.800 3276.700 /end CHARACTERISTIC
/begin CHARACTERISTIC SCRAd_tMinSlipActv_C "Mindesttemperatur für Aktivierung der Schlupferkennung" VALUE 0x8005D7D6 Val_Ws16 1050.000 Temp_Cels -50.04000 999.9600 EXTENDED_LIMITS -3549.940 3003.560 /end CHARACTERISTIC
/begin CHARACTERISTIC SCRAd_vActDiffMax_C "Obere Grenze Fahrzeuggeschwindigkeitsänderung" VALUE 0x8005D8EC Val_Ws16 40.00000 Vel -20.00000 20.00000 EXTENDED_LIMITS -327.6800 327.6700 /end CHARACTERISTIC
/begin CHARACTERISTIC SCRAd_vActDiffMin_C "Untere Grenze Fahrzeuggeschwindigkeitsänderung" VALUE 0x8005D8EE Val_Ws16 40.00000 Vel -20.00000 20.00000 EXTENDED_LIMITS -327.6800 327.6700 /end CHARACTERISTIC
/begin CHARACTERISTIC SCRAd_v_C "Testlabel" VALUE 0x8005D8F0 Val_Ws16 655.3500 Vel -327.6800 327.6700 /end CHARACTERISTIC
/begin CHARACTERISTIC SCRChk_ctCondDwn1_C "Abnahmewert des Bedingungszählers im Temperaturbereich 1" VALUE 0x8005DA44 Val_Ws16 1000.000 OneToOne 0.00 1000.000 EXTENDED_LIMITS -32768.00 32767.00 /end CHARACTERISTIC
/begin CHARACTERISTIC SCRChk_ctCondDwn2_C "Abnahmewert des Bedingungszählers im Temperaturbereich 2" VALUE 0x8005DA46 Val_Ws16 1000.000 OneToOne 0.00 1000.000 EXTENDED_LIMITS -32768.00 32767.00 /end CHARACTERISTIC
/begin CHARACTERISTIC SCRChk_ctCondMax1_C "Obergrenze für den Bedingungszähler im Temperaturbereich 1" VALUE 0x8005DA48 Val_Ws16 30000.00 OneToOne 0.00 30000.00 EXTENDED_LIMITS -32768.00 32767.00 /end CHARACTERISTIC
/begin CHARACTERISTIC SCRChk_ctCondMax2_C "Obergrenze für den Bedingungszähler im Temperaturbereich 2" VALUE 0x8005DA4A Val_Ws16 30000.00 OneToOne 0.00 30000.00 EXTENDED_LIMITS -32768.00 32767.00 /end CHARACTERISTIC
/begin CHARACTERISTIC SCRChk_ctCondStrt1_C "Startwert für den Bedingungszähler im Temperaturbereich 1" VALUE 0x8005DA4C Val_Ws16 30000.00 OneToOne 0.00 30000.00 EXTENDED_LIMITS -32768.00 32767.00 /end CHARACTERISTIC
/begin CHARACTERISTIC SCRChk_ctCondStrt2_C "Startwert für den Bedingungszähler im Temperaturbereich 2" VALUE 0x8005DA4E Val_Ws16 30000.00 OneToOne 0.00 30000.00 EXTENDED_LIMITS -32768.00 32767.00 /end CHARACTERISTIC
/begin CHARACTERISTIC SCRChk_ctCondUp1_CUR "Erhöhungswert für den Bedingungszähler im Temperaturbereich 1" CURVE 0x8005DA50 Cur_Xs16Ws16 1000.000 OneToOne 0.00 1000.000 EXTENDED_LIMITS -32768.00 32767.00
 /begin AXIS_DESCR STD_AXIS SCRChk_dmNOxUsToS16_mp SCR_Dm01 8 -3276.800 3276.700 FORMAT "%8.3" DEPOSIT ABSOLUTE /end AXIS_DESCR
/end CHARACTERISTIC
/begin CHARACTERISTIC SCRChk_ctCondUp2_CUR "Erhöhungswert für den Bedingungszähler im Temperaturbereich 2" CURVE 0x8005DA72 Cur_Xs16Ws16 1000.000 OneToOne 0.00 1000.000 EXTENDED_LIMITS -32768.00 32767.00
 /begin AXIS_DESCR STD_AXIS SCRChk_dmNOxUsToS16_mp SCR_Dm01 8 -3276.800 3276.700 FORMAT "%8.3" DEPOSIT ABSOLUTE /end AXIS_DESCR
/end CHARACTERISTIC
/begin CHARACTERISTIC SCRChk_dmExhMax1_C "Obergrenze für den Abgasmassenstrom im Temperaturbereich 1" VALUE 0x8005DA94 Val_Ws16 1400.000 AirMassPerTime 0.00 1400.000 EXTENDED_LIMITS -3276.800 3276.700 /end CHARACTERISTIC
/begin CHARACTERISTIC SCRChk_dmExhMax2_C "Obergrenze für den Abgasmassenstrom im Temperaturbereich 2" VALUE 0x8005DA96 Val_Ws16 1400.000 AirMassPerTime 0.00 1400.000 EXTENDED_LIMITS -3276.800 3276.700 /end CHARACTERISTIC
/begin CHARACTERISTIC SCRChk_dmExhMin1_C "Untergrenze für den Abgasmassenstrom im Temperaturbereich 1" VALUE 0x8005DA98 Val_Ws16 1400.000 AirMassPerTime 0.00 1400.000 EXTENDED_LIMITS -3276.800 3276.700 /end CHARACTERISTIC
/begin CHARACTERISTIC SCRChk_dmExhMin2_C "Untergrenze für den Abgasmassenstrom im Temperaturbereich 2" VALUE 0x8005DA9A Val_Ws16 1400.000 AirMassPerTime 0.00 1400.000 EXTENDED_LIMITS -3276.800 3276.700 /end CHARACTERISTIC
/begin CHARACTERISTIC SCRChk_etaActMax_C "Obergrenze für den Durchschnitt des tatsächlichen Wirkungsgrades" VALUE 0x8005DA9C Val_Ws16 2.000000 SCR_Fact100 -1.000000 1.000000 FORMAT "%8.6" EXTENDED_LIMITS -327.6800 327.6700 /end CHARACTERISTIC
/begin CHARACTERISTIC SCRChk_etaActMin_C "Untergrenze für den Durchschnitt des tatsächlichen Wirkungsgrades" VALUE 0x8005DA9E Val_Ws16 2.000000 SCR_Fact100 -1.000000 1.000000 FORMAT "%8.6" EXTENDED_LIMITS -327.6800 327.6700 /end CHARACTERISTIC
/begin CHARACTERISTIC SCRChk_etaThresExt_C "Externe Wirkungsgradschwelle" VALUE 0x8005DAA0 Val_Ws16 1.000000 SCR_Fact100 0.00 1.000000 FORMAT "%8.6" EXTENDED_LIMITS -327.6800 327.6700 /end CHARACTERISTIC
/begin CHARACTERISTIC SCRChk_etaThresMax_C "Obergrenze für die Wirkungsgradschwelle" VALUE 0x8005DAA2 Val_Ws16 1.000000 SCR_Fact100 0.00 1.000000 FORMAT "%8.6" EXTENDED_LIMITS -327.6800 327.6700 /end CHARACTERISTIC
/begin CHARACTERISTIC SCRChk_etaThresMinActv1_C "Minimale Wirkungsgradschwelle, um Evaluation im Temperaturbereich 1 zu aktivieren" VALUE 0x8005DAA4 Val_Ws16 2.000000 SCR_Fact100 -0.5000000 1.500000 FORMAT "%8.6" EXTENDED_LIMITS -327.6800 327.6700 /end CHARACTERISTIC
/begin CHARACTERISTIC SCRChk_etaThresMinActv2_C "Minimale Wirkungsgradschwelle, um Evaluation im Temperaturbereich 2 zu aktivieren" VALUE 0x8005DAA6 Val_Ws16 2.000000 SCR_Fact100 -0.5000000 1.500000 FORMAT "%8.6" EXTENDED_LIMITS -327.6800 327.6700 /end CHARACTERISTIC
/begin CHARACTERISTIC SCRChk_etaThresMin_C "Untergrenze für die Wirkungsgradschwelle" VALUE 0x8005DAA8 Val_Ws16 1.000000 SCR_Fact100 0.00 1.000000 FORMAT "%8.6" EXTENDED_LIMITS -327.6800 327.6700 /end CHARACTERISTIC
/begin CHARACTERISTIC SCRChk_etaThresTemp1_CUR "Temperaturabhängiger Faktor für Wirkungsgradschwellenberechnung im Temperaturbereich 1" CURVE 0x8005DAAA Cur_Xs16Ws16 1.000000 SCR_Fact100 0.00 1.000000 FORMAT "%8.6" EXTENDED_LIMITS -327.6800 327.6700
 /begin AXIS_DESCR STD_AXIS SCRChk_tSCRFlt_mp Temp_Cels 8 -3549.940 3003.560 DEPOSIT ABSOLUTE /end AXIS_DESCR
/end CHARACTERISTIC
/begin CHARACTERISTIC SCRChk_etaThresTemp2_CUR "Temperaturabhängiger Faktor für Wirkungsgradschwellenberechnung im Temperaturbereich 2" CURVE 0x8005DACC Cur_Xs16Ws16 1.000000 SCR_Fact100 0.00 1.000000 FORMAT "%8.6" EXTENDED_LIMITS -327.6800 327.6700
 /begin AXIS_DESCR STD_AXIS SCRChk_tSCRFlt_mp Temp_Cels 8 -3549.940 3003.560 DEPOSIT ABSOLUTE /end AXIS_DESCR
/end CHARACTERISTIC
/begin CHARACTERISTIC SCRChk_facEtaCor1_C "Korrekturfaktor für den Durchschnitt der tatsächlichen Wirkungsgradberechnung im Temperaturbereich 1" VALUE 0x8005DAEE Val_Ws16 1.000000 SCR_Fact100 0.5000000 1.500000 FORMAT "%8.6" EXTENDED_LIMITS -327.6800 327.6700 /end CHARACTERISTIC
/begin CHARACTERISTIC SCRChk_facEtaCor2_C "Korrekturfaktor für den Durchschnitt der tatsächlichen Wirkungsgradberechnung im Temperaturbereich 2" VALUE 0x8005DAF0 Val_Ws16 1.000000 SCR_Fact100 0.5000000 1.500000 FORMAT "%8.6" EXTENDED_LIMITS -327.6800 327.6700 /end CHARACTERISTIC
/begin CHARACTERISTIC SCRChk_facEtaEstMul1_C "Multiplikativer Faktor für die geschätzte Wirkunsggradschwelle im Temperaturbereich 1" VALUE 0x8005DAF2 Val_Ws16 1.000000 SCR_Fact100 0.00 1.000000 FORMAT "%8.6" EXTENDED_LIMITS -327.6800 327.6700 /end CHARACTERISTIC
/begin CHARACTERISTIC SCRChk_facEtaEstMul2_C "Multiplikativer Faktor für die geschätzte Wirkunsggradschwelle im Temperaturbereich 2" VALUE 0x8005DAF4 Val_Ws16 1.000000 SCR_Fact100 0.00 1.000000 FORMAT "%8.6" EXTENDED_LIMITS -327.6800 327.6700 /end CHARACTERISTIC
/begin CHARACTERISTIC SCRChk_facEtaEstOfs1_C "Offset für die geschätzte Wirkungsgradschwelle im Temperaturbereich 1" VALUE 0x8005DAF6 Val_Ws16 2.000000 SCR_Fact100 -1.000000 1.000000 FORMAT "%8.6" EXTENDED_LIMITS -327.6800 327.6700 /end CHARACTERISTIC
/begin CHARACTERISTIC SCRChk_facEtaEstOfs2_C "Offset für die geschätzte Wirkungsgradschwelle im Temperaturbereich 2" VALUE 0x8005DAF8 Val_Ws16 2.000000 SCR_Fact100 -1.000000 1.000000 FORMAT "%8.6" EXTENDED_LIMITS -327.6800 327.6700 /end CHARACTERISTIC
/begin CHARACTERISTIC SCRChk_facEtaThresExh1_CUR "Korrekturfaktor für die Wirkungsgradschwelle abhängig vom Abgasmassenstrom im Temperaturbereich 1" CURVE 0x8005DAFA Cur_Xs16Ws16 1.000000 SCR_Fact100 0.00 1.000000 FORMAT "%8.6" EXTENDED_LIMITS -327.6800 327.6700
 /begin AXIS_DESCR STD_AXIS SCRChk_dmExhFlt_mp AirMassPerTime 8 -3276.800 3276.700 DEPOSIT ABSOLUTE /end AXIS_DESCR
/end CHARACTERISTIC
/begin CHARACTERISTIC SCRChk_facEtaThresExh2_CUR "Korrekturfaktor für die Wirkungsgradschwelle abhängig vom Abgasmassenstrom im Temperaturbereich 2" CURVE 0x8005DB1C Cur_Xs16Ws16 1.000000 SCR_Fact100 0.00 1.000000 FORMAT "%8.6" EXTENDED_LIMITS -327.6800 327.6700
 /begin AXIS_DESCR STD_AXIS SCRChk_dmExhFlt_mp AirMassPerTime 8 -3276.800 3276.700 DEPOSIT ABSOLUTE /end AXIS_DESCR
/end CHARACTERISTIC
/begin CHARACTERISTIC SCRChk_facEtaThresExt_C "Externer Korrekturfaktor für die Wirkungsgradschwelle" VALUE 0x8005DB3E Val_Ws16 1.000000 SCR_Fact100 0.00 1.000000 FORMAT "%8.6" EXTENDED_LIMITS -327.6800 327.6700 /end CHARACTERISTIC
/begin CHARACTERISTIC SCRChk_facEtaThresNOx1_CUR "Korrekturfaktor für die Wirkungsgradschwelle abhängig vom NOx Massenfluss im Temperaturbereich 1" CURVE 0x8005DB40 Cur_Xs16Ws16 1.000000 SCR_Fact100 0.00 1.000000 FORMAT "%8.6" EXTENDED_LIMITS -327.6800 327.6700
 /begin AXIS_DESCR STD_AXIS SCRChk_dmNOxUsToS16_mp SCR_Dm01 8 -3276.800 3276.700 FORMAT "%8.3" DEPOSIT ABSOLUTE /end AXIS_DESCR
/end CHARACTERISTIC
/begin CHARACTERISTIC SCRChk_facEtaThresNOx2_CUR "Korrekturfaktor für die Wirkungsgradschwelle abhängig vom NOx Massenfluss im Temperaturbereich 2" CURVE 0x8005DB62 Cur_Xs16Ws16 1.000000 SCR_Fact100 0.00 1.000000 FORMAT "%8.6" EXTENDED_LIMITS -327.6800 327.6700
 /begin AXIS_DESCR STD_AXIS SCRChk_dmNOxUsToS16_mp SCR_Dm01 8 -3276.800 3276.700 FORMAT "%8.3" DEPOSIT ABSOLUTE /end AXIS_DESCR
/end CHARACTERISTIC
/begin CHARACTERISTIC SCRChk_mNOxUsMin1_C "Minimale NOx Masse vor SCR um Wirkungsgradberechnung im Temperaturbereich 1 zu aktivieren" VALUE 0x8005DB84 Val_Ws16 300.0000 SCR_Mass100 0.00 300.0000 FORMAT "%8.4" EXTENDED_LIMITS -327.6800 327.6700 /end CHARACTERISTIC
/begin CHARACTERISTIC SCRChk_mNOxUsMin2_C "Minimale NOx Masse vor SCR um Wirkungsgradberechnung im Temperaturbereich 2 zu aktivieren" VALUE 0x8005DB86 Val_Ws16 300.0000 SCR_Mass100 0.00 300.0000 FORMAT "%8.4" EXTENDED_LIMITS -327.6800 327.6700 /end CHARACTERISTIC
/begin CHARACTERISTIC SCRChk_rPPMNOxUsMax1_C "Obergrenze für die NOx Konzentration vor SCR im Temperaturbereich 1" VALUE 0x8005DB88 Val_Ws16 2500.000 nox 0.00 2500.000 FORMAT "%8.3" EXTENDED_LIMITS -32768.00 32767.00 /end CHARACTERISTIC
/begin CHARACTERISTIC SCRChk_rPPMNOxUsMax2_C "Obergrenze für die NOx Konzentration vor SCR im Temperaturbereich 2" VALUE 0x8005DB8A Val_Ws16 2500.000 nox 0.00 2500.000 FORMAT "%8.3" EXTENDED_LIMITS -32768.00 32767.00 /end CHARACTERISTIC
/begin CHARACTERISTIC SCRChk_rPPMNOxUsMin1_C "Untergrenze für NOx Konzentration vor SCR im Temperaturbereich 1" VALUE 0x8005DB8C Val_Ws16 2500.000 nox 0.00 2500.000 FORMAT "%8.3" EXTENDED_LIMITS -32768.00 32767.00 /end CHARACTERISTIC
/begin CHARACTERISTIC SCRChk_rPPMNOxUsMin2_C "Untergrenze für NOx Konzentration vor SCR im Temperaturbereich 2" VALUE 0x8005DB8E Val_Ws16 2500.000 nox 0.00 2500.000 FORMAT "%8.3" EXTENDED_LIMITS -32768.00 32767.00 /end CHARACTERISTIC
/begin CHARACTERISTIC SCRChk_stEtaEnaExt_C "Externe Aktivierung der Wirkungsgradberechnung" VALUE 0x8005DB90 Val_Wu8 1.00000000000 SCRChk_Compu_Switch_1 0.00 1.00000000000 FORMAT "%13.11" /end CHARACTERISTIC
/begin CHARACTERISTIC SCRChk_stEtaRstExt_C "Externe Resetanforderung" VALUE 0x8005DB91 Val_Wu8 1.00000000000 SCRChk_Compu_Switch_1 0.00 1.00000000000 FORMAT "%13.11" /end CHARACTERISTIC
/begin CHARACTERISTIC SCRChk_swtEtaEnaMetStgy_C "Schalter für Aktivierungssignal" VALUE 0x8005DB92 Val_Wu8 1.00000000000 SCRChk_Compu_Switch_2 0.00 1.00000000000 FORMAT "%13.11" /end CHARACTERISTIC
/begin CHARACTERISTIC SCRChk_swtEtaEnaWiRst_C "Schalter um zusätzlichen Reset zu erzwingen, falls SCRChk Funktion deaktiviert" VALUE 0x8005DB93 Val_Wu8 1.00000000000 SCRChk_Compu_Switch_1 0.00 1.00000000000 FORMAT "%13.11" /end CHARACTERISTIC
/begin CHARACTERISTIC SCRChk_swtEtaRstExtEna_C "Aktivierung der externen Resetanforderung" VALUE 0x8005DB94 Val_Wu8 1.00000000000 SCRChk_Compu_Switch_1 0.00 1.00000000000 FORMAT "%13.11" /end CHARACTERISTIC
/begin CHARACTERISTIC SCRChk_swtEtaThresSel_C "Schalter für Wirkungsgradschwelle" VALUE 0x8005DB95 Val_Wu8 2.00000000000 SCRChk_Compu_Switch_3 0.00 2.00000000000 FORMAT "%13.11" /end CHARACTERISTIC
/begin CHARACTERISTIC SCRChk_tiDdTNOxEff_CUR "Totzeit abhängig vom Abgasmassenstrom" CURVE 0x8005DB96 Cur_Xs16Ws16 5.000000 SCR_Time10 0.00 5.000000 FORMAT "%8.6" EXTENDED_LIMITS -3276.800 3276.700
 /begin AXIS_DESCR STD_AXIS SCRChk_dmExhFlt_mp AirMassPerTime 4 -3276.800 3276.700 DEPOSIT ABSOLUTE /end AXIS_DESCR
/end CHARACTERISTIC
/begin CHARACTERISTIC SCRChk_tiDlyMaxCalcEta1_C "Maximale Verzögerungszeit für den Beginn der Wirkungsgradberechnung nach dem Erreichen der benötigen NOx mass nach SCR im Temperaturbereich 1" VALUE 0x8005DBA8 Val_Ws16 1000.000 SCR_Time10 0.00 1000.000 FORMAT "%8.3" EXTENDED_LIMITS -3276.800 3276.700 /end CHARACTERISTIC
/begin CHARACTERISTIC SCRChk_tiDlyMaxCalcEta2_C "Maximale Verzögerungszeit für den Beginn der Wirkungsgradberechnung nach dem Erreichen der benötigen NOx mass nach SCR im Temperaturbereich 2" VALUE 0x8005DBAA Val_Ws16 1000.000 SCR_Time10 0.00 1000.000 FORMAT "%8.3" EXTENDED_LIMITS -3276.800 3276.700 /end CHARACTERISTIC
/begin CHARACTERISTIC SCRChk_tiEtaEnaExtDly_C "Verzögerungszeit für die externe Aktivierung" VALUE 0x8005DBAC Val_Ws16 1000.000 SCR_Time10 0.00 1000.000 FORMAT "%8.3" EXTENDED_LIMITS -3276.800 3276.700 /end CHARACTERISTIC
/begin CHARACTERISTIC SCRChk_tiEtaEnaFIdDly_C "Verzögerungszeit für die Fid" VALUE 0x8005DBAE Val_Ws16 1000.000 SCR_Time10 0.00 1000.000 FORMAT "%8.3" EXTENDED_LIMITS -3276.800 3276.700 /end CHARACTERISTIC
/begin CHARACTERISTIC SCRChk_tiFltNOxEff_C "Zeitkonstante für die PT1 Filter der Eingangssignale" VALUE 0x8005DBB0 Val_Ws16 20.00000 SCR_Time10 0.00 20.00000 FORMAT "%8.5" EXTENDED_LIMITS -3276.800 3276.700 /end CHARACTERISTIC
/begin CHARACTERISTIC SCRChk_tiNOxSensDsDly_C "Verzögerungszeit für den Status vom NOx Sensor" VALUE 0x8005DBB2 Val_Ws16 1000.000 SCR_Time10 0.00 1000.000 FORMAT "%8.3" EXTENDED_LIMITS -3276.800 3276.700 /end CHARACTERISTIC
/begin CHARACTERISTIC SCRChk_tRngMax1_C "Obergrenze für den Temperaturbereich 1" VALUE 0x8005DBB4 Val_Ws16 1050.000 Temp_Cels -50.04000 999.9600 EXTENDED_LIMITS -3549.940 3003.560 /end CHARACTERISTIC
/begin CHARACTERISTIC SCRChk_tRngMax2_C "Obergrenze für den Temperaturbereich 2" VALUE 0x8005DBB6 Val_Ws16 1050.000 Temp_Cels -50.04000 999.9600 EXTENDED_LIMITS -3549.940 3003.560 /end CHARACTERISTIC
/begin CHARACTERISTIC SCRChk_tRngMin1_C "Untergrenze für den Temperaturbereich 1" VALUE 0x8005DBB8 Val_Ws16 1050.000 Temp_Cels -50.04000 999.9600 EXTENDED_LIMITS -3549.940 3003.560 /end CHARACTERISTIC
/begin CHARACTERISTIC SCRChk_tRngMin2_C "Untergrenze für den Temperaturbereich 2" VALUE 0x8005DBBA Val_Ws16 1050.000 Temp_Cels -50.04000 999.9600 EXTENDED_LIMITS -3549.940 3003.560 /end CHARACTERISTIC
/begin CHARACTERISTIC SCRFFC_dmNH3Cnv_C "" VALUE 0x8005DDBC Val_Ws16 3276.750 SCR_Dm005 -1638.400 1638.350 FORMAT "%8.3" /end CHARACTERISTIC
/begin CHARACTERISTIC SCRFFC_facMolMsEG_CUR "Molmasse EG in Abhängigkeit von Lambda-Wert im Abgas" CURVE 0x8005DBBC Cur_Xs16Ws16 100.0000 SCR_Fac_g_p_Mol 0.00 100.0000 FORMAT "%8.4" EXTENDED_LIMITS -327.6800 327.6700
 /begin AXIS_DESCR STD_AXIS SCRFFC_LSUrLam_mp lambda 4 -32.76800 32.76700 DEPOSIT ABSOLUTE /end AXIS_DESCR
/end CHARACTERISTIC
/begin CHARACTERISTIC SCRFFC_facMolMsNOx_C "Faktor für die Molmasse von NOx" VALUE 0x8005DBCE Val_Ws16 100.0000 SCR_Fac_g_p_Mol 0.00 100.0000 FORMAT "%8.4" EXTENDED_LIMITS -327.6800 327.6700 /end CHARACTERISTIC
/begin CHARACTERISTIC SCRFFC_facNOxToNH3PEnv_CUR "" CURVE 0x8005DBE0 Cur_Xs16Ws16 20.00000 SCR_Fact1000 -10.00000 10.00000 FORMAT "%8.5" EXTENDED_LIMITS -32.76800 32.76700
 /begin AXIS_DESCR STD_AXIS EnvP_p Pres_hPa 8 -32768.00 3500.00 EXTENDED_LIMITS -32768.00 32767.00 DEPOSIT ABSOLUTE /end AXIS_DESCR
/end CHARACTERISTIC
/begin CHARACTERISTIC SCRFFC_facNOxToNH3POp_MAP "" MAP 0x8005DC02 Map_Xs16Ys16Ws16 20.00000 SCR_Fact1000 -10.00000 10.00000 FORMAT "%8.5" EXTENDED_LIMITS -32.76800 32.76700
 /begin AXIS_DESCR STD_AXIS Epm_nEng EngN 8 -16384.00 16383.50 DEPOSIT ABSOLUTE /end AXIS_DESCR
 /begin AXIS_DESCR STD_AXIS InjCtl_qSetUnBal InjMass 8 -327.6800 327.6700 DEPOSIT ABSOLUTE /end AXIS_DESCR
/end CHARACTERISTIC
/begin CHARACTERISTIC SCRFFC_facNOxToNH3TEnv_CUR "" CURVE 0x8005DCA6 Cur_Xs16Ws16 20.00000 SCR_Fact1000 -10.00000 10.00000 FORMAT "%8.5" EXTENDED_LIMITS -32.76800 32.76700
 /begin AXIS_DESCR STD_AXIS EnvT_t Temp_Cels 8 -3549.940 3003.560 DEPOSIT ABSOLUTE /end AXIS_DESCR
/end CHARACTERISTIC
/begin CHARACTERISTIC SCRFFC_facNOxToNH3_MAP "Stöchiometrischer Umrechnungsfaktor NOx nach NH3" MAP 0x8005DCC8 Map_Xs16Ys16Ws16 10.00000 SCR_Fact1000 0.00 10.00000 FORMAT "%8.5" EXTENDED_LIMITS -32.76800 32.76700
 /begin AXIS_DESCR STD_AXIS SCRMod_rNO2NOx SCR_Fact1000 6 -32.76800 32.76700 FORMAT "%8.5" DEPOSIT ABSOLUTE /end AXIS_DESCR
 /begin AXIS_DESCR STD_AXIS SCRFFC_tAvrg_mp Temp_Cels 16 -3549.940 3003.560 DEPOSIT ABSOLUTE /end AXIS_DESCR
/end CHARACTERISTIC
/begin CHARACTERISTIC SCRFFC_facUnCnvConc_C "Umrechungsfaktor" VALUE 0x8005DBD0 Val_Ws32 1000000.00000 OneToOne 0.00 1000000.00000 EXTENDED_LIMITS -2147483648.00 2147483647.00 /end CHARACTERISTIC
/begin CHARACTERISTIC SCRFFC_facUnCnvMFl_C "Umrechnungsfaktor" VALUE 0x8005DBD4 Val_Ws16 300.0000 SCR_Fact100 0.00 300.0000 FORMAT "%8.4" EXTENDED_LIMITS -327.6800 327.6700 /end CHARACTERISTIC
/begin CHARACTERISTIC SCRFFC_facUnCnvNOxUs_C "Umrechnungsfaktor NOx vor SCR" VALUE 0x8005DBD8 Val_Ws32 4294.96729500 SCR_Fact1E6 -2147.48364800 2147.48364700 FORMAT "%13.8" /end CHARACTERISTIC
/begin CHARACTERISTIC SCRFFC_rLamFldSel_C "Auswahlschalter für den Lambdawert aus dem Feld LSU_rLam" VALUE 0x8005DBDC Val_Wu8 3.000 OneToOne 0.00 3.000 EXTENDED_LIMITS 0.00 255.0 /end CHARACTERISTIC
/begin CHARACTERISTIC SCRLdG_dmMaxCor_C "Begrenzung Speicherfüllstandsregler max." VALUE 0x8005DDBE Val_Ws16 1200.000 SCR_Dm005 -600.0000 600.0000 FORMAT "%8.4" EXTENDED_LIMITS -1638.400 1638.350 /end CHARACTERISTIC
/begin CHARACTERISTIC SCRLdG_dmMinCor_C "Begrenzung Speicherfüllstandsregler min." VALUE 0x8005DDC0 Val_Ws16 1200.000 SCR_Dm005 -600.0000 600.0000 FORMAT "%8.4" EXTENDED_LIMITS -1638.400 1638.350 /end CHARACTERISTIC
/begin CHARACTERISTIC SCRLdG_dmNH3LdGov_CUR "Speicherfüllstand Reglerkennlinie" CURVE 0x8005DDC2 Cur_Xs16Ws16 32000.00 SCR_Dm005 -16000.00 16000.00 FORMAT "%8.2" EXTENDED_LIMITS -1638.400 1638.350
 /begin AXIS_DESCR STD_AXIS SCRLdG_mNH3LdDvt SCR_Mass1000 12 -32.00000 32.00000 FORMAT "%8.5" EXTENDED_LIMITS -32.76800 32.76700 DEPOSIT ABSOLUTE /end AXIS_DESCR
/end CHARACTERISTIC
/begin CHARACTERISTIC SCRLdG_facDynCor_MAP "dynamische Korrektur des Speicherfüllstands-reglerausganges in Abhängigkeit von Temperatur und Abgasmassenstrom" MAP 0x8005DDF4 Map_Xs16Ys16Ws16 10.00000 SCR_Fact1000 0.00 10.00000 FORMAT "%8.5" EXTENDED_LIMITS -32.76800 32.76700
 /begin AXIS_DESCR STD_AXIS SCRLdG_tSCRAvrg_mp Temp_Cels 16 -3549.940 3003.560 DEPOSIT ABSOLUTE /end AXIS_DESCR
 /begin AXIS_DESCR STD_AXIS SCRLdG_dmExhEGFld_mp AirMassPerTime 16 -3276.800 3276.700 DEPOSIT ABSOLUTE /end AXIS_DESCR
/end CHARACTERISTIC
/begin CHARACTERISTIC SCRLdG_facNH3LdOp_MAP "" MAP 0x8005E038 Map_Xs16Ys16Ws16 20.00000 SCR_Fact1000 -10.00000 10.00000 FORMAT "%8.5" EXTENDED_LIMITS -32.76800 32.76700
 /begin AXIS_DESCR STD_AXIS Epm_nEng EngN 8 -16384.00 16383.50 DEPOSIT ABSOLUTE /end AXIS_DESCR
 /begin AXIS_DESCR STD_AXIS InjCtl_qSetUnBal InjMass 8 -327.6800 327.6700 DEPOSIT ABSOLUTE /end AXIS_DESCR
/end CHARACTERISTIC
/begin CHARACTERISTIC SCRLdG_facNH3LdPEnv_CUR "" CURVE 0x8005E0DC Cur_Xs16Ws16 20.00000 SCR_Fact1000 -10.00000 10.00000 FORMAT "%8.5" EXTENDED_LIMITS -32.76800 32.76700
 /begin AXIS_DESCR STD_AXIS EnvP_p Pres_hPa 8 -32768.00 3500.00 EXTENDED_LIMITS -32768.00 32767.00 DEPOSIT ABSOLUTE /end AXIS_DESCR
/end CHARACTERISTIC
/begin CHARACTERISTIC SCRLdG_facNH3LdPTEnv_CUR "" CURVE 0x8005E0FE Cur_Xs16Ws16 20.00000 SCR_Fact1000 -10.00000 10.00000 FORMAT "%8.5" EXTENDED_LIMITS -32.76800 32.76700
 /begin AXIS_DESCR STD_AXIS EnvT_t Temp_Cels 8 -3549.940 3003.560 DEPOSIT ABSOLUTE /end AXIS_DESCR
/end CHARACTERISTIC
/begin CHARACTERISTIC SCRLdG_mNH3LdNomTemp_CUR "" CURVE 0x8005E120 Cur_Xs16Ws16 32.00000 SCR_Mass1000 0.00 32.00000 FORMAT "%8.5" EXTENDED_LIMITS -32.76800 32.76700
 /begin AXIS_DESCR STD_AXIS SCRLdG_tSCRAvrg_mp Temp_Cels 16 -50.04000 999.9600 EXTENDED_LIMITS -3549.940 3003.560 DEPOSIT ABSOLUTE /end AXIS_DESCR
/end CHARACTERISTIC
/begin CHARACTERISTIC SCRLdG_mNH3LdNom_C "Applikationswert für den nominalen NH3 Füllstand" VALUE 0x8005E162 Val_Wu16 32.00000 SCR_Mass1000 0.00 32.00000 FORMAT "%8.5" EXTENDED_LIMITS 0.00 65.53500 /end CHARACTERISTIC
/begin CHARACTERISTIC SCRLdG_swtDynCorEna_C "Aktivierung dynamische Korrektur" VALUE 0x8005E164 Val_Wu8 1.00000000000 SCRAd_Compu_Switch_3 0.00 1.00000000000 FORMAT "%13.11" /end CHARACTERISTIC
/begin CHARACTERISTIC SCRLdG_swtNH3LdGovEna_C "Aktivierung Füllstandsregler" VALUE 0x8005E165 Val_Wu8 1.00000000000 SCRAd_Compu_Switch_3 0.00 1.00000000000 FORMAT "%13.11" /end CHARACTERISTIC
/begin CHARACTERISTIC SCRLdG_swtNH3LdNomMnl_C "Aktivierung manuelle Vorgabe NH3-Soll-Speicherfüllstand" VALUE 0x8005E166 Val_Wu8 1.00000000000 SCRLdG_Switch_1 0.00 1.00000000000 FORMAT "%13.11" /end CHARACTERISTIC
/begin CHARACTERISTIC SCRMod_facEffOxiAge_CUR "Gesamt-Alterungsfaktor des Oxi-Kats abhängig von der Betriebszeit" CURVE 0x8005E16C Cur_Xr32Wr32 1.00000000 SCR_Fact1000 0.00 1.00000000 FORMAT "%10.8" EXTENDED_LIMITS -1.00000000E+034 1.00000000E+034
 /begin AXIS_DESCR STD_AXIS SCRMod_facTempOxiTot_mp OneToOne 6 0.00 65000.0000 EXTENDED_LIMITS -1.00000000E+037 1.00000000E+037 DEPOSIT ABSOLUTE /end AXIS_DESCR
/end CHARACTERISTIC
/begin CHARACTERISTIC SCRMod_facEffSCRAge_CUR "resultierende Gesamt-Alterungs-Faktor des SCR-Katalysator (auch abhängig von Betriebszeit)" CURVE 0x8005E1A0 Cur_Xr32Wr32 1.00000000 SCR_Fact1000 0.00 1.00000000 FORMAT "%10.8" EXTENDED_LIMITS -1.00000000E+034 1.00000000E+034
 /begin AXIS_DESCR STD_AXIS SCRMod_facTempSCRTot_mp OneToOne 6 0.00 65000.0000 EXTENDED_LIMITS -1.00000000E+037 1.00000000E+037 DEPOSIT ABSOLUTE /end AXIS_DESCR
/end CHARACTERISTIC
/begin CHARACTERISTIC SCRMod_facTempOxiAge_CUR "Aktueller Alterungs-Faktor abhängig von OxiCat Upstreamtemperatur" CURVE 0x8005E1D4 Cur_Xs16Ws16 1.000000 SCR_Fact1000 0.00 1.000000 FORMAT "%8.6" EXTENDED_LIMITS -32.76800 32.76700
 /begin AXIS_DESCR STD_AXIS SCRMod_tOxiCat_mp Temp_Cels 8 -50.04000 999.9600 EXTENDED_LIMITS -3549.940 3003.560 DEPOSIT ABSOLUTE /end AXIS_DESCR
/end CHARACTERISTIC
/begin CHARACTERISTIC SCRMod_facTempSCRAge_CUR "Aktuelle Alterungsfaktor abhängig von SCR Katalysator-mittlerer Temperatur" CURVE 0x8005E1F6 Cur_Xs16Ws16 1.000000 SCR_Fact1000 0.00 1.000000 FORMAT "%8.6" EXTENDED_LIMITS -32.76800 32.76700
 /begin AXIS_DESCR STD_AXIS SCRMod_tAvrg_mp Temp_Cels 8 -50.04000 999.9600 EXTENDED_LIMITS -3549.940 3003.560 DEPOSIT ABSOLUTE /end AXIS_DESCR
/end CHARACTERISTIC
/begin CHARACTERISTIC SCRMod_mEstNH3Ld_C "" VALUE 0x8005E168 Val_Ws16 65.53500 SCR_Mass1000 -32.76800 32.76700 FORMAT "%8.5" /end CHARACTERISTIC
/begin CHARACTERISTIC SCRT_tFld_C "" VALUE 0x8005E16A Val_Ws16 6553.500 Temp_Cels -3549.940 3003.560 /end CHARACTERISTIC
/begin MEASUREMENT Rail_ctPMonStrt_mp "Counter für die Raildrucküberwachung beim Start" SWORD Time_ms 1 100 -327680.0 327670.0 ECU_ADDRESS 0xC000ABE6 /end MEASUREMENT
/begin MEASUREMENT Rail_dpSetPointDec "maximaler Raildruck-Sollwertabfall pro Sekunde" SWORD PresRail_sec 1 100 -13107.200 13106.800 FORMAT "%5.3" ECU_ADDRESS 0xD0001296 /end MEASUREMENT
/begin MEASUREMENT Rail_dpSetPointInc "maximaler Raildruck-Sollwertanstieg pro Sekunde" SWORD PresRail_sec 1 100 -13107.200 13106.800 FORMAT "%5.3" ECU_ADDRESS 0xD0001298 /end MEASUREMENT
/begin MEASUREMENT Rail_dvolInjVlvCtl_mp "Korrekturwert der Vorsteuerung unter Berücksichtigung der Steuermengen für die Injektoren" SWORD Qp_mm3_sec 1 100 -327680.0 327670.0 FORMAT "%8.1" ECU_ADDRESS 0xC000ABE8 /end MEASUREMENT
/begin MEASUREMENT Rail_dvolLeak_mp "Leckage des Hochdrucksystems" SWORD Qp_mm3_sec 1 100 -327680.0 327670.0 FORMAT "%8.1" ECU_ADDRESS 0xC000ABEA /end MEASUREMENT
/begin MEASUREMENT Rail_dvolPreCtlBas_mp "Basisvorsteuerwert aus Kennfeld für die Druckregelung über Zumesseinheit" SWORD Qp_mm3_sec 1 100 -327680.0 327670.0 FORMAT "%8.1" ECU_ADDRESS 0xC000ABEC /end MEASUREMENT
/begin MEASUREMENT Rail_dvolPreCtlInit_mp "Initialisierungswert der Vorsteuerung für die Druckregelung über Zumesseinheit" SWORD Qp_mm3_sec 1 100 -327680.0 327670.0 FORMAT "%8.1" ECU_ADDRESS 0xC000ABEE /end MEASUREMENT
/begin MEASUREMENT Rail_dvolPreCtlOfs_mp "Offset aus Kennfeld für die Vorsteuerung der Druckregelung über Zumesseinheit" SWORD Qp_mm3_sec 1 100 -327680.0 327670.0 FORMAT "%8.1" ECU_ADDRESS 0xC000ABF0 /end MEASUREMENT
/begin MEASUREMENT Rail_dvolPreCtlPoI1_mp "Vorsteuerwert abhängig von der Nacheinspritzmenge 1 für die Druckregelung über Zumesseinheit" SWORD Qp_mm3_sec 1 100 -327680.0 327670.0 FORMAT "%8.1" ECU_ADDRESS 0xC000ABF2 /end MEASUREMENT
/begin MEASUREMENT Rail_dvolPreCtlPoI2_mp "Vorsteuerwert abhängig von der Nacheinspritzmenge 2 für die Druckregelung über Zumesseinheit" SWORD Qp_mm3_sec 1 100 -327680.0 327670.0 FORMAT "%8.1" ECU_ADDRESS 0xC000ABF4 /end MEASUREMENT
/begin MEASUREMENT Rail_facAPPrSetPDynCor_mp "Raildruckdynamikkorrektur abhängig vom PWG Niveau" SWORD Fact 1 100 -4.000000 3.999878 ECU_ADDRESS 0xC000AC1E /end MEASUREMENT
/begin MEASUREMENT Rail_facAPSetPDynCor_mp "Messpunkt für den Gewichtungsfaktor des Raildrucksollwerts in Abhängigkeit vom Umgebungsdruck" SWORD Fact 1 100 -4.000000 3.999878 ECU_ADDRESS 0xC000AC20 /end MEASUREMENT
/begin MEASUREMENT Rail_facDQSetPDynCor_mp "Messpunkt für den Gewichtungsfaktor der Raildrucksollwertkorrektur in Abhängigkeit von der Einspritzmengenänderung" SWORD Fact 1 100 -4.000000 3.999878 ECU_ADDRESS 0xC000AC22 /end MEASUREMENT
/begin MEASUREMENT Rail_facEgrpSetPCor_mp "" SWORD Fact 1 100 -4.000000 3.999878 ECU_ADDRESS 0xC000AC24 /end MEASUREMENT
/begin MEASUREMENT Rail_facETSetPDynCor_mp "Messpunkt für den Gewichtungsfaktor der Raildrucksollwertkorrektur in Abhängigkeit von der Motortemperatur" SWORD Fact 1 100 -4.000000 3.999878 ECU_ADDRESS 0xC000AC26 /end MEASUREMENT
/begin MEASUREMENT Rail_facIASetPDynCor_mp "Messpunkt für den Gewichtungsfaktor der Raildrucksollwertkorrektur in Abhängigkeit von der Ansaugluft Temperatur" SWORD Fact 1 100 -4.000000 3.999878 ECU_ADDRESS 0xC000AC28 /end MEASUREMENT
/begin MEASUREMENT Rail_facIMTSpSetPCor_mp "" SWORD Fact 1 100 -4.000000 3.999878 ECU_ADDRESS 0xC000AC2A /end MEASUREMENT
/begin MEASUREMENT Rail_facPCVTiRmpVal_mp "aktueller Rampenwert der Rampe bei Umschaltung von Regelung über Druckregelventil auf Regelung über Zumesseinheit" SWORD Fact 1 100 -4.000000 3.999878 ECU_ADDRESS 0xC000ABF8 /end MEASUREMENT
/begin MEASUREMENT Rail_facSetPointAPSCor "Gewichtungsfaktor für atmosphärendruckabhängige Sollwertkorrektur des Raildrucks" SWORD Fact 1 100 -4.000000 3.999878 ECU_ADDRESS 0xD00012A4 /end MEASUREMENT
/begin MEASUREMENT Rail_facSetPointAPSCorRgn "Gewichtungsfaktor für atmosphärendruckabhängige Sollwertkorrektur des Raildrucks im Regenerationsbetrieb" SWORD Fact 1 100 -4.000000 3.999878 ARRAY_SIZE 2 ECU_ADDRESS 0xD00012A6 /end MEASUREMENT
/begin MEASUREMENT Rail_facSetPointAPSCStrt_mp "Messpunkt für den Gewichtungsfaktor der Raildrucksollwertkorrektur beim Start abhängig von der Umgebungsluftemperatur" SWORD Fact 1 100 -4.000000 3.999878 ECU_ADDRESS 0xC000AC2C /end MEASUREMENT
/begin MEASUREMENT Rail_facSetPointATSCor "Gewichtungsfaktor für ansauglufttemperaturabhängige Sollwertkorrektur des Raildrucks" SWORD Fact 1 100 -4.000000 3.999878 ECU_ADDRESS 0xD00012AA /end MEASUREMENT
/begin MEASUREMENT Rail_facSetPointATSCorRgn "Gewichtungsfaktor für ansauglufttemperaturabhängige Sollwertkorrektur des Raildrucks im Regenerationsbetrieb" SWORD Fact 1 100 -4.000000 3.999878 ARRAY_SIZE 2 ECU_ADDRESS 0xD00012AC /end MEASUREMENT
/begin MEASUREMENT Rail_facSetPointATSCStrt_mp "Messpunkt des Gewichtungsfaktors der Raildrucksollwertkorrektur beim Start abhängig von der Ansauglaufttemperatur" SWORD Fact 1 100 -4.000000 3.999878 ECU_ADDRESS 0xC000AC2E /end MEASUREMENT
/begin MEASUREMENT Rail_facSetPointETSCor "Gewichtungsfaktor für motortemperaturabhängige Sollwertkorrektur des Raildrucks" SWORD Fact 1 100 -4.000000 3.999878 ECU_ADDRESS 0xD00012B0 /end MEASUREMENT
/begin MEASUREMENT Rail_facSetPointETSCor1_mp "Messpunkt für den Gewichtungsfaktor der Raildrucksollwertkorrektur in Abhängigkeit von der Motortemperatur" SWORD Fact 1 100 -4.000000 3.999878 ECU_ADDRESS 0xC000C450 /end MEASUREMENT
/begin MEASUREMENT Rail_facSetPointETSCorRgn "Gewichtungsfaktor für motortemperaturabhängige Sollwertkorrektur des Raildrucks im Regenerationsbetrieb" SWORD Fact 1 100 -4.000000 3.999878 ARRAY_SIZE 2 ECU_ADDRESS 0xD00012B2 /end MEASUREMENT
/begin MEASUREMENT Rail_facSetPointETSCStrt_mp "Messpunkt für den Gewichtungsfaktor der Raildrucksollwertkorrektur beim Start abhängig von der Ansauglufttemperatur" SWORD Fact 1 100 -4.000000 3.999878 ECU_ADDRESS 0xC000AC30 /end MEASUREMENT
/begin MEASUREMENT Rail_facSetPointFTSCor_mp "Gewichtungsfaktor für kraftstofftemperaturabhängige Sollwertkorrektur des Raildruckreglers" SWORD Fact 1 100 -4.000000 3.999878 ECU_ADDRESS 0xC000AC32 /end MEASUREMENT
/begin MEASUREMENT Rail_facSetPointRmpVal_mp "Interpolationsfaktor für die Funktion Rail_RgnSwt" SWORD CoEOMSwt_S16 1 100 -2.000000 1.999939 FORMAT "%8.6" ECU_ADDRESS 0xC000AC08 /end MEASUREMENT
/begin MEASUREMENT Rail_facTiRmpVal_mp "aktueller Rampenwert wenn von Offset-Kennlinie auf reduzierte Offset-Kennlinie und andersherum gerampt wird" SWORD Fact 1 100 -4.000000 3.999878 ECU_ADDRESS 0xC000ABFA /end MEASUREMENT
/begin MEASUREMENT Rail_numRgnStg_mp "Anzahl der eingestellten Regenerationsstufen für das Rail" UBYTE OneToOne 1 100 0.00 255.0 ECU_ADDRESS 0xC000B4EA /end MEASUREMENT
/begin MEASUREMENT Rail_pMaxSetSubst "drehzahlabhängiger oberer Grenzwert substituierter Raildrucksollwert" SWORD Pres_Rail 1 100 -3276.800 2000.000 ECU_ADDRESS 0xD00012B8 /end MEASUREMENT
/begin MEASUREMENT Rail_pPCVClose_mp "Steuergröße um das Druckregelventil geschlossen zu halten" SWORD Pres_Rail 1 100 -3276.800 2000.000 ECU_ADDRESS 0xC000ABFC /end MEASUREMENT
/begin MEASUREMENT Rail_pPCVDvtMax_mp "Ausgang der Kennlinie Rail_pPCVDvtMax_CUR" SWORD Pres_Rail 1 100 -3276.800 2000.000 ECU_ADDRESS 0xC000ABE0 /end MEASUREMENT
/begin MEASUREMENT Rail_pPCVFltMin_mp "Ausgang der Kennlinie Rail_pPCVFltMin_CUR" SWORD Pres_Rail 1 100 -3276.800 2000.000 ECU_ADDRESS 0xC000ABE2 /end MEASUREMENT
/begin MEASUREMENT Rail_pPCVOfs_mp "Rampenschalterausgang für die Steuergröße um das Druckregelventil geschlossen zu halten" SWORD Pres_Rail 1 100 -3276.800 2000.000 ECU_ADDRESS 0xC000ABFE /end MEASUREMENT
/begin MEASUREMENT Rail_pPCVRedOfs_mp "Messpunkt für Vorsteuerreduzierung für schnelleren Druckabbau über das Druckregelventil" SWORD Pres_Rail 1 100 -3276.800 2000.000 ECU_ADDRESS 0xC000AC00 /end MEASUREMENT
/begin MEASUREMENT Rail_pPCVSetMax_mp "maximal zulässiger Solldruck für die Raildrucküberwachung" SWORD Pres_Rail 1 100 -3276.800 2000.000 ECU_ADDRESS 0xC000ABE4 /end MEASUREMENT
/begin MEASUREMENT Rail_pPreCtl_mp "Vorsteuerwert für die Druckregelung über Druckregelventil" SWORD Pres_Rail 1 100 -3276.800 2000.000 ECU_ADDRESS 0xC000AC02 /end MEASUREMENT
/begin MEASUREMENT Rail_pSetPDynCor_mp "Messpunkt für das Basiskorrekturkennfeld für die Raildrucksollwertkorrektur" SWORD Pres_Rail 1 100 -3276.800 2000.000 ECU_ADDRESS 0xC000AC34 /end MEASUREMENT
/begin MEASUREMENT Rail_pSetPEgrLPCorBas_mp "" SWORD Pres_Rail 1 100 -3276.800 2000.000 ECU_ADDRESS 0xC000AC36 /end MEASUREMENT
/begin MEASUREMENT Rail_pSetPEgrLPCor_mp "" SWORD Pres_Rail 1 100 -3276.800 2000.000 ECU_ADDRESS 0xC000AC38 /end MEASUREMENT
/begin MEASUREMENT Rail_pSetPoint "Raildruck-sollwert" SWORD Pres_Rail 1 100 -3276.800 2000.000 ECU_ADDRESS 0xD00012BE /end MEASUREMENT
/begin MEASUREMENT Rail_pSetPointAddCor "Schnittstelle für Erweiterungen der Korrekturen für den Raildrucksollwert" SWORD Pres_Rail 1 100 -3276.800 2000.000 ECU_ADDRESS 0xD00012C0 /end MEASUREMENT
/begin MEASUREMENT Rail_pSetPointAddCorRgn "benutzerspezifische Korrekturen für den Raildruck im Regenerationsfall" SWORD Pres_Rail 1 100 -3276.800 2000.000 ECU_ADDRESS 0xD00012C2 /end MEASUREMENT
/begin MEASUREMENT Rail_pSetPointAPSCorRgn_mp "Raildruck-Korrekturwert im Regenerationsbetrieb, abhängig vom Atmosphärendruck" SWORD Pres_Rail 1 100 -3276.800 2000.000 ARRAY_SIZE 2 ECU_ADDRESS 0xC000C450 /end MEASUREMENT
/begin MEASUREMENT Rail_pSetPointAPSCor_mp "Raildruck-Korrekturwert, abhängig vom Atmosphärendruck" SWORD Pres_Rail 1 100 -3276.800 2000.000 ECU_ADDRESS 0xC000AC3E /end MEASUREMENT
/begin MEASUREMENT Rail_pSetPointATSCorRgn_mp "Raildruck-Korrekturwert im Regenerationsbetrieb, abhängig vom Ansauglufttemperatur" SWORD Pres_Rail 1 100 -3276.800 2000.000 ARRAY_SIZE 2 ECU_ADDRESS 0xC000C454 /end MEASUREMENT
/begin MEASUREMENT Rail_pSetPointATSCor_mp "Raildruck-Korrekturwert, abhängig von der Ansauglufttemperatur" SWORD Pres_Rail 1 100 -3276.800 2000.000 ECU_ADDRESS 0xC000AC40 /end MEASUREMENT
/begin MEASUREMENT Rail_pSetPointBase_mp "Basissollwert des Raildrucks" SWORD Pres_Rail 1 100 -3276.800 2000.000 ECU_ADDRESS 0xC000AC0A /end MEASUREMENT
/begin MEASUREMENT Rail_pSetPointBasRgn_mp "Basiswert des Raildrucksollwerts im Regenerationsbetrieb" SWORD Pres_Rail 1 100 -3276.800 2000.000 ARRAY_SIZE 2 ECU_ADDRESS 0xC000C44C /end MEASUREMENT
/begin MEASUREMENT Rail_pSetPointBattMin_mp "batteriespannungsabhängig korrigierter Raildruck-Sollwert" SWORD Pres_Rail 1 100 -3276.800 2000.000 ECU_ADDRESS 0xC000AC0C /end MEASUREMENT
/begin MEASUREMENT Rail_pSetPointCor_mp "korrigierter Raildruck-Sollwert, abhängig vom projektspezifischen Eingriff und von Umgebungsbedingungen" SWORD Pres_Rail 1 100 -3276.800 2000.000 ECU_ADDRESS 0xC000AC0E /end MEASUREMENT
/begin MEASUREMENT Rail_pSetPointDec_mp "maximaler Raildruck-Sollwertabfall pro Schedulesequenz" SWORD Pres_Rail 1 100 -3276.800 2000.000 ECU_ADDRESS 0xC000AC10 /end MEASUREMENT
/begin MEASUREMENT Rail_pSetPointEnvCor "Raildruck-Korrekturwert, abhängig von den Umgebungsbedingungen" SWORD Pres_Rail 1 100 -3276.800 2000.000 ECU_ADDRESS 0xD00012C4 /end MEASUREMENT
/begin MEASUREMENT Rail_pSetPointEnvCorRgn "Raildruck-Korrekturwert, abhängig von den Umgebungsbedingungen im Regenerationsbetrieb" SWORD Pres_Rail 1 100 -3276.800 2000.000 ARRAY_SIZE 2 ECU_ADDRESS 0xD00012C6 /end MEASUREMENT
/begin MEASUREMENT Rail_pSetPointEnvCorStrt "Raildrucksollwertkorrektur in Abhängigkeit der Umgebungsvariablen während des Starts" SWORD Pres_Rail 1 100 -3276.800 2000.000 ECU_ADDRESS 0xD00012CA /end MEASUREMENT
/begin MEASUREMENT Rail_pSetPointETSCor1_mp "Messpunkt für das Umgebungstemperaturkennfeld der Raildrucksollwertkorrektur in Abhängigkeit von Motordrehzahl und Einspritzmenge" SWORD Pres_Rail 1 100 -3276.800 2000.000 ECU_ADDRESS 0xC000AC3A /end MEASUREMENT
/begin MEASUREMENT Rail_pSetPointETSCorRgn_mp "Raildruck-Korrekturwert im Regenerationsbetrieb, abhängig vom Motortemperatur" SWORD Pres_Rail 1 100 -3276.800 2000.000 ARRAY_SIZE 2 ECU_ADDRESS 0xC000C458 /end MEASUREMENT
/begin MEASUREMENT Rail_pSetPointETSCor_mp "Raildruck-Korrekturwert, abhängig von der Motortemperatur" SWORD Pres_Rail 1 100 -3276.800 2000.000 ECU_ADDRESS 0xC000AC42 /end MEASUREMENT
/begin MEASUREMENT Rail_pSetPointFlTempCor "Raildruck-Korrekturwert, abhängig von der Kraftstofftemperatur" SWORD Pres_Rail 1 100 -3276.800 2000.000 ECU_ADDRESS 0xD00012CC /end MEASUREMENT
/begin MEASUREMENT Rail_pSetPointFlTempLim_mp "Begrenzter Raildruck-Sollwert unter Berücksichtigung der Kraftstofftemperatur-Korrektur" SWORD Pres_Rail 1 100 -3276.800 2000.000 ECU_ADDRESS 0xC000AC12 /end MEASUREMENT
/begin MEASUREMENT Rail_pSetPointFlTempRedLim "begrenzter Raildruck-Sollwert unter Berücksichtigung der Kraftstofftemperatur-Korrektur abzüglich des reduzierten Sollwertes" SWORD Pres_Rail 1 100 -3276.800 2000.000 ECU_ADDRESS 0xD00012CE /end MEASUREMENT
/begin MEASUREMENT Rail_pSetPointFlTempUnLim "unbegrenzter Raildruck-Sollwert unter Berücksichtigung der Kraftstofftemperatur-Korrektur" SWORD Pres_Rail 1 100 -3276.800 2000.000 ECU_ADDRESS 0xD00012D0 /end MEASUREMENT
/begin MEASUREMENT Rail_pSetPointInc_mp "maximaler Raildruck-Sollwertanstieg pro Schedulesequenz" SWORD Pres_Rail 1 100 -3276.800 2000.000 ECU_ADDRESS 0xC000AC14 /end MEASUREMENT
/begin MEASUREMENT Rail_pSetPointLimNFlTemp "maximaler Raildrucksollwert, abhängig von der Kraftstofftemperatur und der Motordrehzahl" SWORD Pres_Rail 1 100 -3276.800 2000.000 ECU_ADDRESS 0xD00012D2 /end MEASUREMENT
/begin MEASUREMENT Rail_pSetPointLim_mp "Raildrucksollwert nach Bereichsbegrenzung im Normalbetrieb" SWORD Pres_Rail 1 100 -3276.800 2000.000 ECU_ADDRESS 0xC000AC16 /end MEASUREMENT
/begin MEASUREMENT Rail_pSetPointMax "maximaler Raildrucksollwert" SWORD Pres_Rail 1 100 -3276.800 2000.000 ECU_ADDRESS 0xD00012D4 /end MEASUREMENT
/begin MEASUREMENT Rail_pSetPointMin "minimaler Raildrucksollwert" SWORD Pres_Rail 1 100 -3276.800 2000.000 ECU_ADDRESS 0xD00012D6 /end MEASUREMENT
/begin MEASUREMENT Rail_pSetPointOut_mp "Raildruck-Sollwert nach Eingriff der Regeneration" SWORD Pres_Rail 1 100 -3276.800 2000.000 ECU_ADDRESS 0xC000AC18 /end MEASUREMENT
/begin MEASUREMENT Rail_pSetPointRgn "Raildruck-Sollwert im Regenerationsbetrieb" SWORD Pres_Rail 1 100 -3276.800 2000.000 ARRAY_SIZE 2 ECU_ADDRESS 0xD00012D8 /end MEASUREMENT
/begin MEASUREMENT Rail_pSetPointSubst "Externe Anforderung für den Raildruck-Sollwert" SWORD Pres_Rail 1 100 -3276.800 2000.000 ECU_ADDRESS 0xD00012DC /end MEASUREMENT
/begin MEASUREMENT Rail_pSetPointVehCor_mp "" SWORD Pres_Rail 1 100 -3276.800 2000.000 ECU_ADDRESS 0xC000AC3C /end MEASUREMENT
/begin MEASUREMENT Rail_pSetPointZFCLim_mp "Raildrucksollwert mit Begrenzung durch die ZFC" SWORD Pres_Rail 1 100 -3276.800 2000.000 ECU_ADDRESS 0xC000AC1A /end MEASUREMENT
/begin MEASUREMENT Rail_pSetPointZFC_mp "Raildrucksollwert nach Eingriff der Nullmengenkalibrierung" SWORD Pres_Rail 1 100 -3276.800 2000.000 ECU_ADDRESS 0xC000AC1C /end MEASUREMENT
/begin MEASUREMENT Rail_pZFCInit_mp "anfänglicher ZFC Raildrucksollwert für PT1 Filter" SWORD Pres_Rail 1 100 -3276.800 2000.000 ECU_ADDRESS 0xC000AC44 /end MEASUREMENT
/begin MEASUREMENT Rail_qPreCtlBas_mp "ausgewählte Einspritzmenge für die Vorsteuerung" SWORD InjMass 1 100 -327.6800 327.6700 ECU_ADDRESS 0xC000ABF6 /end MEASUREMENT
/begin MEASUREMENT Rail_stActVal_mp "Aktueller Betriebsmodus des Rails" UBYTE INJCRV_MSK_VERB 1 100 0.00 7.00000000000 FORMAT "%13.11" ECU_ADDRESS 0xC000B4EB /end MEASUREMENT
/begin MEASUREMENT Rail_stCtlType "Status Regelkonzept und verwendetes Regelprinzip" UBYTE OneToOne 1 100 0.00 255.0 ECU_ADDRESS 0xD0002076 /end MEASUREMENT
/begin MEASUREMENT Rail_stDesVal_mp "Gewünschter Betriebsmodus des Rails" UBYTE INJCRV_MSK_VERB 1 100 0.00 7.00000000000 FORMAT "%13.11" ECU_ADDRESS 0xC000B4EC /end MEASUREMENT
/begin MEASUREMENT Rail_stEnvCorRgn "Statusbotschaft für die Freigabe der einzelnen Regenerationsstufen für die Sollwertbildung des Raildrucks" ULONG OneToOne 1 100 0.00 4294967295.00 ECU_ADDRESS 0xD00032BC /end MEASUREMENT
/begin MEASUREMENT Rail_stPCVMon0_mp "Zustandsbits für Überwachung auf positive Regelabweichung" UBYTE OneToOne 1 100 0.00 255.0 ECU_ADDRESS 0xC000B4E2 /end MEASUREMENT
/begin MEASUREMENT Rail_stPCVMon1_mp "Zustandsbits für Überwachung auf positive Regelabweichung kombiniert mit Stellgröße des Druckregelventils" UBYTE OneToOne 1 100 0.00 255.0 ECU_ADDRESS 0xC000B4E3 /end MEASUREMENT
/begin MEASUREMENT Rail_stPCVMon22_mp "Zustandsbits für Überwachung auf negative Regelabweichung kombiniert mit Stellgröße des Druckregelventils für die zweite Überwachungsstufe" UBYTE OneToOne 1 100 0.00 255.0 ECU_ADDRESS 0xC000B4E4 /end MEASUREMENT
/begin MEASUREMENT Rail_stPCVMon2_mp "Zustandsbits für Überwachung auf negative Regelabweichung kombiniert mit Stellgröße des Druckregelventils" UBYTE OneToOne 1 100 0.00 255.0 ECU_ADDRESS 0xC000B4E5 /end MEASUREMENT
/begin MEASUREMENT Rail_stPCVMon3_mp "Zustandsbits für Überwachung auf minimalen Raildruck" UBYTE OneToOne 1 100 0.00 255.0 ECU_ADDRESS 0xC000B4E6 /end MEASUREMENT
/begin MEASUREMENT Rail_stPCVMon42_mp "Zustandsbits für Überwachung auf maximalen Raildruck für die zweite Überwachungsstufe" UBYTE OneToOne 1 100 0.00 255.0 ECU_ADDRESS 0xC000B4E7 /end MEASUREMENT
/begin MEASUREMENT Rail_stPCVMon4_mp "Zustandsbits für Überwachung auf maximalen Raildruck" UBYTE OneToOne 1 100 0.00 255.0 ECU_ADDRESS 0xC000B4E8 /end MEASUREMENT
/begin MEASUREMENT Rail_stPCVRedOfs_mp "Statusanzeige für die Umschaltung auf den reduzierten Offsetwert DRV" UWORD OneToOne 1 100 0.00 65535.00 ECU_ADDRESS 0xC000AC04 /end MEASUREMENT
/begin MEASUREMENT Rail_stPresMinZFC_mp "Zustand des Automaten Bestimmung der Mindestschwelle des Raildrucks" UBYTE OneToOne 1 100 0.00 255.0 ECU_ADDRESS 0xC000B4EF /end MEASUREMENT
/begin MEASUREMENT Rail_stSetPointRgn "Status der Freigabestruktur für den Regenerationsbetrieb für die Bestimmung des Raildrucksollwertes" ULONG OneToOne 1 100 0.00 4294967295.00 ECU_ADDRESS 0xD00032C0 /end MEASUREMENT
/begin MEASUREMENT Rail_stSetPointRmpSel "Botschaft für die Auswahl der Faktorisierungskennlinie des Rampenfaktors des Rail" UBYTE INJCRV_RMP_VERB 1 100 1.00000000000 7.00000000000 FORMAT "%13.11" ECU_ADDRESS 0xD000207E /end MEASUREMENT
/begin MEASUREMENT Rail_stSetSubstCond_mp "bitcodierte Zustände der Umschaltbedingungen auf Substitutionswert des Raildrucks" UBYTE OneToOne 1 100 0.00 255.0 ECU_ADDRESS 0xC000B4ED /end MEASUREMENT
/begin MEASUREMENT Rail_stTrqLim_mp "Rampenstatus (ob MeUn oder PCV Limitierung aktiv)" UBYTE OneToOne 1 100 0.00 255.0 ECU_ADDRESS 0xC000B4EE /end MEASUREMENT
/begin MEASUREMENT Rail_stZFCDem_mp "Status für geschlossenes Druckregelventil bei aktiver Lernphase der ZFC" UBYTE OneToOne 1 100 0.00 255.0 ECU_ADDRESS 0xC000B4E9 /end MEASUREMENT
/begin MEASUREMENT Rail_swtCtlSel "Status für verwendetes Reglerkonzept (CPC oder 2 Steller)" UBYTE OneToOne 1 100 0.00 255.0 ECU_ADDRESS 0xD0002087 /end MEASUREMENT
/begin MEASUREMENT Rail_swtPreCtl "Raildruckregler mit / ohne Vorsteuerung" UBYTE OneToOne 1 100 0.00 255.0 ECU_ADDRESS 0xD0002088 /end MEASUREMENT
/begin MEASUREMENT Rail_swtPress "Umschaltung zwischen Steuern und Regeln anhand Absolut-/Differenzwert des Raildrucks" UBYTE OneToOne 1 100 0.00 255.0 ECU_ADDRESS 0xD0002089 /end MEASUREMENT
/begin MEASUREMENT Rail_swtWindUp "Raildruckregler mit eingefrorenem oder rückgerechnetem I-Anteil" UBYTE OneToOne 1 100 0.00 255.0 ECU_ADDRESS 0xD000208B /end MEASUREMENT
/begin MEASUREMENT Rail_tAir "Ansauglufttemperatur für das Subsystem Rail" SWORD Temp_Cels 1 100 -3549.940 3003.560 ECU_ADDRESS 0xD00012DE /end MEASUREMENT
/begin MEASUREMENT Rail_tiPCV0Deb_mp "PCV0: Messpunkt für laufende Entprellzaehler" ULONG InjTime_us 1 100 0.00 5000.00 ECU_ADDRESS 0xC000932C /end MEASUREMENT
/begin MEASUREMENT Rail_tiPCV1Deb_mp "PCV1: Messpunkt für laufende Entprellzaehler" ULONG InjTime_us 1 100 0.00 5000.00 ECU_ADDRESS 0xC0009330 /end MEASUREMENT
/begin MEASUREMENT Rail_tiPCV22Deb_mp "PCV22: Messpunkt für laufende Entprellzaehler" ULONG InjTime_us 1 100 0.00 5000.00 ECU_ADDRESS 0xC0009334 /end MEASUREMENT
/begin MEASUREMENT Rail_tiPCV2Deb_mp "PCV2: Messpunkt für laufende Entprellzaehler" ULONG InjTime_us 1 100 0.00 5000.00 ECU_ADDRESS 0xC0009338 /end MEASUREMENT
/begin MEASUREMENT Rail_tiPCV3Deb_mp "PCV3: Messpunkt für laufende Entprellzaehler" ULONG InjTime_us 1 100 0.00 5000.00 ECU_ADDRESS 0xC000933C /end MEASUREMENT
/begin MEASUREMENT Rail_tiPCV42Deb_mp "PCV42: Messpunkt für laufende Entprellzaehler" ULONG InjTime_us 1 100 0.00 5000.00 ECU_ADDRESS 0xC0009340 /end MEASUREMENT
/begin MEASUREMENT Rail_tiPCV4Deb_mp "PCV4: Messpunkt für laufende Entprellzaehler" ULONG InjTime_us 1 100 0.00 5000.00 ECU_ADDRESS 0xC0009344 /end MEASUREMENT
/begin MEASUREMENT Rail_tiPCVRmpDur_mp "Laufzeit der Rampe um vom aktuellen Sollwert auf den neuen PCVClose-Wert zu rampen" SWORD Time_ms 1 100 -327680.0 327670.0 ECU_ADDRESS 0xC000AC06 /end MEASUREMENT
/begin MEASUREMENT Rail_trqLim "Begrenzungsmoment abhängig von der Kraftstofftemperatur" SWORD Trq 1 100 -3276.800 3276.700 ECU_ADDRESS 0xD00012E2 /end MEASUREMENT
/begin MEASUREMENT Reset_Env.adLoc "Reset Information/Adresse an der der letzte Reset ausgelöst wurde" ULONG OneToOne 1 100 0.00 4294967295.00 ECU_ADDRESS 0xC0001BF8 /end MEASUREMENT
/begin MEASUREMENT Reset_Env.xUserValue "Reset Information/Benutzer spezifischer Wert der letzten Resetursache" ULONG OneToOne 1 100 0.00 4294967295.00 ECU_ADDRESS 0xC0001BFC /end MEASUREMENT
/begin MEASUREMENT Reset_Env.xId "Reset Information/Reset-ID der letzten Resetursache" UWORD OneToOne 1 100 0.00 65535.00 ECU_ADDRESS 0xC0001C00 /end MEASUREMENT
/begin MEASUREMENT Reset_Env.xGrp "Reset Information/Reset-Gruppen-ID der letzten Resetursache" UBYTE OneToOne 1 100 0.00 255.0 ECU_ADDRESS 0xC0001C02 /end MEASUREMENT
/begin MEASUREMENT Reset_Env.ctRst "Reset Information/Reset Zähler der alle aufgetretenen Resets zählt" UBYTE OneToOne 1 100 0.00 255.0 ECU_ADDRESS 0xC0001C03 /end MEASUREMENT
/begin MEASUREMENT Reset_Env_adLoc_mp "" ULONG OneToOne 1 100 0.00 4294967295.00 ECU_ADDRESS 0xC0009348 /end MEASUREMENT
/begin MEASUREMENT Reset_Env_xId_mp "" UWORD OneToOne 1 100 0.00 65535.00 ECU_ADDRESS 0xC000AC46 /end MEASUREMENT
/begin MEASUREMENT Reset_xHistBuf "Ringspeicher mit den letzten 8 Reset-ID's" UWORD OneToOne 1 100 0.00 65535.00 ARRAY_SIZE 8 ECU_ADDRESS 0xD0008498 /end MEASUREMENT
/begin MEASUREMENT RngMod_nLIDvtn_mp "Regelabweichung Leerlaufregler für Verlustmomentenkompensation" SWORD EngN 1 100 -16384.00 16383.50 ECU_ADDRESS 0xC000AC48 /end MEASUREMENT
/begin MEASUREMENT RngMod_stAdap "Status Verlustmomentenadaption" UBYTE OneToOne 1 100 0.00 255.0 ECU_ADDRESS 0xD000208C /end MEASUREMENT
/begin MEASUREMENT RngMod_stDrvState_mp "Zustandsvariable der Betriebszustanderkennung der Verlustmomentenadaption" UBYTE OneToOne 1 100 0.00 255.0 ECU_ADDRESS 0xC000B4F0 /end MEASUREMENT
/begin MEASUREMENT RngMod_stGenRel_mp "Zustandsvariable der generellen Freigabebedingungen der Verlustmomentenkompensation" UBYTE OneToOne 1 100 0.00 255.0 ECU_ADDRESS 0xC000B4F1 /end MEASUREMENT
/begin MEASUREMENT RngMod_stLIStat_mp "Zustandsvariable Leerlaufregler eingeschwungen" UBYTE OneToOne 1 100 0.00 255.0 ECU_ADDRESS 0xC000B4F2 /end MEASUREMENT
/begin MEASUREMENT RngMod_trqChExchLoss_mp "Ladungswechselverluste" SWORD Trq 1 100 -3276.800 3276.700 ECU_ADDRESS 0xC000AC56 /end MEASUREMENT
/begin MEASUREMENT RngMod_trqClthMax "maximales Kupplungsmoment" SWORD Trq 1 100 -3276.800 3276.700 ECU_ADDRESS 0xD00012E6 /end MEASUREMENT
/begin MEASUREMENT RngMod_trqClthMin "minimales Kupplungsmoment" SWORD Trq 1 100 -3276.800 3276.700 ECU_ADDRESS 0xD00012E8 /end MEASUREMENT
/begin MEASUREMENT RngMod_trqComp "zu kompensierendes Moment" SWORD Trq 1 100 -3276.800 3276.700 ECU_ADDRESS 0xD00012EC /end MEASUREMENT
/begin MEASUREMENT RngMod_trqDiffAdap "Adaptiertes Differenzverlustmoment" SWORD Trq 1 100 -3276.800 3276.700 ECU_ADDRESS 0xD00012EE /end MEASUREMENT
/begin MEASUREMENT RngMod_trqFltACGear_mp "Adaptionsfilterausgang: Klima an / Gang eingelegt" SWORD Trq 1 100 -3276.800 3276.700 ECU_ADDRESS 0xC000AC4A /end MEASUREMENT
/begin MEASUREMENT RngMod_trqFltACNoGear_mp "Adaptionsfilterausgang: Klima an / Kein Gang eingelegt" SWORD Trq 1 100 -3276.800 3276.700 ECU_ADDRESS 0xC000AC4C /end MEASUREMENT
/begin MEASUREMENT RngMod_trqFltNoACGear_mp "Adaptionsfilterausgang: Klima aus / Gang eingelegt" SWORD Trq 1 100 -3276.800 3276.700 ECU_ADDRESS 0xC000AC4E /end MEASUREMENT
/begin MEASUREMENT RngMod_trqFltNoACNoGear_mp "Adaptionsfilterausgang: Klima aus / Kein Gang eingelegt" SWORD Trq 1 100 -3276.800 3276.700 ECU_ADDRESS 0xC000AC50 /end MEASUREMENT
/begin MEASUREMENT RngMod_trqFrc "aktuelles Reibmoment" SWORD Trq 1 100 -3276.800 3276.700 ECU_ADDRESS 0xD00012F0 /end MEASUREMENT
/begin MEASUREMENT RngMod_trqFrcLd_mp "Lastabhängige Reibungsverluste" SWORD Trq 1 100 -3276.800 3276.700 ECU_ADDRESS 0xC000AC58 /end MEASUREMENT
/begin MEASUREMENT RngMod_trqLosAdap "Adaptiertes Gesamtverlustmoment des Motors" SWORD Trq 1 100 -3276.800 3276.700 ECU_ADDRESS 0xD00012F2 /end MEASUREMENT
/begin MEASUREMENT RngMod_trqLosCompl_mp "Summe aller Motorverlustmomente inkl. Momentenbedarf der Wandlerkupplung" SWORD Trq 1 100 -3276.800 3276.700 ECU_ADDRESS 0xC000AC52 /end MEASUREMENT
/begin MEASUREMENT RngMod_trqLosDiff_mp "Differenzmoment zwischen Istmoment und vorgesteuertem Verlustmoment" SWORD Trq 1 100 -3276.800 3276.700 ECU_ADDRESS 0xC000AC54 /end MEASUREMENT
/begin MEASUREMENT RngMod_trqLossComp "zu kompensierendes Moment" SWORD Trq 1 100 -3276.800 3276.700 ECU_ADDRESS 0xD00012F4 /end MEASUREMENT
/begin MEASUREMENT RngMod_trqMax "Momentintervall Maximum" SWORD Trq 1 100 -3276.800 3276.700 ECU_ADDRESS 0xD00012F6 /end MEASUREMENT
/begin MEASUREMENT RngMod_trqMin "Schleppmoment (minimales Moment)" SWORD Trq 1 100 -3276.800 3276.700 ECU_ADDRESS 0xD00012F8 /end MEASUREMENT
/begin MEASUREMENT RngMod_tTrqFrc_mp "Eingangstemperatur in Kennfeld zur Bestimmung des aktuellen Reibmoments" SWORD Temp_Cels 1 100 -3549.940 3003.560 ECU_ADDRESS 0xC000AC5A /end MEASUREMENT
/begin MEASUREMENT SCRAd_ctAvrgStr_mp "Feldindex für das Beschreiben von SCRAd_mAvrgStr_Fld" UBYTE OneToOne 1 100 0.00 255.0 ECU_ADDRESS 0xC000B507 /end MEASUREMENT
/begin MEASUREMENT SCRAd_dmNH3Slip "NH3-Schlupf" SWORD SCR_Dm01 1 100 0.00 1650.000 FORMAT "%8.3" ECU_ADDRESS 0xD00012FA /end MEASUREMENT
/begin MEASUREMENT SCRAd_dmNH3Slip_mp "NH3-Schlupf" SWORD SCR_Dm01 1 100 -3276.800 3276.700 FORMAT "%8.3" ECU_ADDRESS 0xC000AC7C /end MEASUREMENT
/begin MEASUREMENT SCRAd_dmNH3Us "NH3 Massenstrom" SLONG SCR_dmNOx_mg_p_s 1 100 -2147483.64800 2147483.64700 FORMAT "%13.5" ECU_ADDRESS 0xD0002FF4 /end MEASUREMENT
/begin MEASUREMENT SCRAd_facNH3LdRst_mp "Faktor für die Füllstandsinitialisierung" UWORD SCR_Fact1000 1 100 0.00 65.53500 FORMAT "%8.5" ECU_ADDRESS 0xC000AC5C /end MEASUREMENT
/begin MEASUREMENT SCRAd_facPlaus "Ergebnis der Bilanzierung" FLOAT32_IEEE OneToOne 1 100 0.00 10000000.0 FORMAT "%10.1" ECU_ADDRESS 0xD0002DD0 /end MEASUREMENT
/begin MEASUREMENT SCRAd_facPlausCmp_mp "Grenzwert für Plausibilität" FLOAT32_IEEE OneToOne 1 100 0.00 10000000.0 FORMAT "%10.1" ECU_ADDRESS 0xC0009358 /end MEASUREMENT
/begin MEASUREMENT SCRAd_facPlaus_Fld "Array zur Speicherung der letzten drei Plausibilitäten" SLONG SCR_Fact1000 1 100 -2147483.64800 2147483.64700 FORMAT "%13.5" ARRAY_SIZE 3 ECU_ADDRESS 0xD0002FF8 /end MEASUREMENT
/begin MEASUREMENT SCRAd_facPlaus_mp "Ergebnis der Bilanzierung" SLONG SCR_Fact1000 1 100 -2147483.64800 2147483.64700 FORMAT "%13.5" ECU_ADDRESS 0xC000935C /end MEASUREMENT
/begin MEASUREMENT SCRAd_facQtyAdap "Langzeitadaptionsfaktor" SWORD SCR_Fact100 1 100 -327.6800 327.6700 FORMAT "%8.4" ECU_ADDRESS 0xD00012FC /end MEASUREMENT
/begin MEASUREMENT SCRAd_facQtyAdapRaw_mp "Langzeitadaptionsfaktor (Rohwert)" SWORD SCR_Fact100 1 100 -327.6800 327.6700 FORMAT "%8.4" ECU_ADDRESS 0xC000AC60 /end MEASUREMENT
/begin MEASUREMENT SCRAd_facQtyAdap_mp "Langzeitadaptionsfaktor" SWORD SCR_Fact100 1 100 -327.6800 327.6700 FORMAT "%8.4" ECU_ADDRESS 0xC000AC62 /end MEASUREMENT
/begin MEASUREMENT SCRAd_mAvrgStr_Fld "Array zur Speicherung der Werte der Füllstandskorrektur für die Mittelwertbildung" SWORD SCR_Mass1000 1 100 -32.76800 32.76700 FORMAT "%8.5" ARRAY_SIZE 11 ECU_ADDRESS 0xD00012FE /end MEASUREMENT
/begin MEASUREMENT SCRAd_mDiffNH3LdNom_mp "Sollfüllstandsdifferenz innerhalb der Plausibilisierungszeit" SWORD SCR_Mass1000 1 100 -32.76800 32.76700 FORMAT "%8.5" ECU_ADDRESS 0xC000AC6A /end MEASUREMENT
/begin MEASUREMENT SCRAd_mNH3Cnv "Umgesetzte NH3-Masse während der Plausibilitätsprüfung" SLONG SCR_Mass1000 1 100 0.00 32.0000000000 FORMAT "%13.10" ECU_ADDRESS 0xD0003004 /end MEASUREMENT
/begin MEASUREMENT SCRAd_mNH3Cnv_mp "Umgesetztes NH3 innerhalb der Plausibilisierungszeit" SLONG SCR_Mass1000 1 100 -2147483.64800 2147483.64700 FORMAT "%13.5" ECU_ADDRESS 0xC0009360 /end MEASUREMENT
/begin MEASUREMENT SCRAd_mNH3LdAdap "Gemittelte Füllstandskorrektur" SWORD SCR_Mass1000 1 100 0.00 32.00000 FORMAT "%8.5" ECU_ADDRESS 0xD0001314 /end MEASUREMENT
/begin MEASUREMENT SCRAd_mNH3LdAdapRaw_mp "Füllstandskorrektur" SWORD SCR_Mass1000 1 100 -32.76800 32.76700 FORMAT "%8.5" ECU_ADDRESS 0xC000AC7E /end MEASUREMENT
/begin MEASUREMENT SCRAd_mNH3LdAdapSum_mp "Summe der einzelnen Füllstandskorrekturen" SLONG SCR_Mass1000 1 100 -2147483.64800 2147483.64700 FORMAT "%13.5" ECU_ADDRESS 0xC000937C /end MEASUREMENT
/begin MEASUREMENT SCRAd_mNH3LdAdap_mp "Gemittelte Füllstandskorrektur" SWORD SCR_Mass1000 1 100 -32.76800 32.76700 FORMAT "%8.5" ECU_ADDRESS 0xC000AC80 /end MEASUREMENT
/begin MEASUREMENT SCRAd_mNH3LdRst "Füllstandsinitialisierungswert" SWORD SCR_Mass1000 1 100 -32.76800 32.76700 FORMAT "%8.5" ECU_ADDRESS 0xD0001316 /end MEASUREMENT
/begin MEASUREMENT SCRAd_mNH3Us_mp "NOx-Rohemissionsmenge innerhalb der Plausibilisierungszeit" SLONG SCR_Mass1000 1 100 -2147483.64800 2147483.64700 FORMAT "%13.5" ECU_ADDRESS 0xC0009364 /end MEASUREMENT
/begin MEASUREMENT SCRAd_mPlausNH3Curr_mp "Zudosiertes NH3 innerhalb der Plausibilisierungszeit" SLONG SCR_Mass1000 1 100 -2147483.64800 2147483.64700 FORMAT "%13.5" ECU_ADDRESS 0xC0009368 /end MEASUREMENT
/begin MEASUREMENT SCRAd_mPlausNH3LdNom_Fld "Array zur Speicherung der Sollfüllstände" SWORD SCR_Mass1000 1 100 -32.76800 32.76700 FORMAT "%8.5" ARRAY_SIZE 2 ECU_ADDRESS 0xD0001318 /end MEASUREMENT
/begin MEASUREMENT SCRAd_qCurrFlt_mp "Gefilterte momentane Einspritzmenge" SWORD InjMass 1 100 -327.6800 327.6700 ECU_ADDRESS 0xC000AC6C /end MEASUREMENT
/begin MEASUREMENT SCRAd_rDeltaNOxDsAct_mp "Sensorabweichung zur berechneten NOx-Konzentration nach Katalysator" SWORD SCR_Rat1 1 100 -32768.00 32767.00 FORMAT "%8.2" ECU_ADDRESS 0xC000AC6E /end MEASUREMENT
/begin MEASUREMENT SCRAd_rDeltaNOxDsFlt_mp "Gefilterte Sensorabweichung zur berechneten NOx-Konzentration" SWORD SCR_Rat1 1 100 -32768.00 32767.00 FORMAT "%8.2" ECU_ADDRESS 0xC000AC70 /end MEASUREMENT
/begin MEASUREMENT SCRAd_rDeltaNOxDsPlaus_mp "Sensorabweichung während der Signalauswertung" SWORD SCR_Rat1 1 100 -32768.00 32767.00 FORMAT "%8.2" ECU_ADDRESS 0xC000AC72 /end MEASUREMENT
/begin MEASUREMENT SCRAd_rDeltaNOxSensDs "Sensorabweichung zur berechneten NOx-Konzentration nach SCR-Katalysator" SWORD SCR_Rat1 1 100 -2500.000 2500.000 FORMAT "%8.3" ECU_ADDRESS 0xD000131C /end MEASUREMENT
/begin MEASUREMENT SCRAd_rDeltaNOxSensDs_mp "Sensorabweichung zur berechneten NOx-Konzentration nach Katalysator" SWORD SCR_Rat1 1 100 -32768.00 32767.00 FORMAT "%8.2" ECU_ADDRESS 0xC000AC82 /end MEASUREMENT
/begin MEASUREMENT SCRAd_rDeltaNOxStrt_mp "Sensorabweichung zu Beginn der Signalauswertung" SWORD SCR_Rat1 1 100 -32768.00 32767.00 FORMAT "%8.2" ECU_ADDRESS 0xC000AC74 /end MEASUREMENT
/begin MEASUREMENT SCRAd_rDeltaPlausMax_mp "Maximaler Sprung von SCRAd_rDeltaNOxDs" SWORD SCR_Rat1 1 100 -32768.00 32767.00 FORMAT "%8.2" ECU_ADDRESS 0xC000AC76 /end MEASUREMENT
/begin MEASUREMENT SCRAd_realCurIn_mp "Umwandlung von SCRAd_mNH3Us_mp für Kurveneingang" FLOAT32_IEEE Mass 1 100 0.00 100.000000 FORMAT "%10.6" ECU_ADDRESS 0xC000936C /end MEASUREMENT
/begin MEASUREMENT SCRAd_stActvTrg_mp "Status Trigger aktiv" UBYTE SCRAd_Compu_Switch_3 1 100 0.00 1.00000000000 FORMAT "%13.11" ECU_ADDRESS 0xC000B4F3 /end MEASUREMENT
/begin MEASUREMENT SCRAd_stAdapReq "Anforderung für FS-Erhöhung" UBYTE SCRAd_Compu_Switch_1 1 100 0.00 1.00000000000 FORMAT "%13.11" ECU_ADDRESS 0xD000208D /end MEASUREMENT
/begin MEASUREMENT SCRAd_stAdapReq_mp "Freigabe für FS-Erhöhung" UBYTE SCRAd_Compu_Switch_1 1 100 0.00 1.00000000000 FORMAT "%13.11" ECU_ADDRESS 0xC000B4F4 /end MEASUREMENT
/begin MEASUREMENT SCRAd_stAdapRstReq "Ergebnis der Plausibilisierung/ Anforderung für FS-Initialisierung" UBYTE SCRAd_Compu_Switch_2 1 100 0.00 1.00000000000 FORMAT "%13.11" ECU_ADDRESS 0xD000208E /end MEASUREMENT
/begin MEASUREMENT SCRAd_stAdapRstReqNgv_mp "Bitwort für Verringerung von SCRAd_facUQtyAdapRaw_mp" UWORD OneToOne 1 100 0.00 65535.00 ECU_ADDRESS 0xC000AC64 /end MEASUREMENT
/begin MEASUREMENT SCRAd_stAdapRstReqPsv_mp "Bitwort für die Erhöhung von SCRAd_facUQtyAdapRaw_mp" UWORD OneToOne 1 100 0.00 65535.00 ECU_ADDRESS 0xC000AC66 /end MEASUREMENT
/begin MEASUREMENT SCRAd_stEEPROMRead "Status des EEP Lesezugriffs in SCRAd" UBYTE OneToOne 1 100 0.00 255.0 ECU_ADDRESS 0xD000208F /end MEASUREMENT
/begin MEASUREMENT SCRAd_stEEPROMWrite "Status des EEP Schreibzugriffs in SCRAd" UBYTE OneToOne 1 100 0.00 255.0 ECU_ADDRESS 0xD0002090 /end MEASUREMENT
/begin MEASUREMENT SCRAd_stEFlRst "Status für Minderfüllstandserkennung" UBYTE OneToOne 1 100 0.00 255.0 ECU_ADDRESS 0xD0002091 /end MEASUREMENT
/begin MEASUREMENT SCRAd_stEFlRstReqPsv_mp "Bitwort für die Erhöhung von SCRAd_facUQtyAdapRaw_mp" UWORD OneToOne 1 100 0.00 65535.00 ECU_ADDRESS 0xC000AC68 /end MEASUREMENT
/begin MEASUREMENT SCRAd_stEFlRst_mp "Erkennung von Minderdosierung" UBYTE OneToOne 1 100 0.00 255.0 ECU_ADDRESS 0xC000B502 /end MEASUREMENT
/begin MEASUREMENT SCRAd_stEtaMinEst_mp "Freigabe Mindestumsatz" UBYTE OneToOne 1 100 0.00 255.0 ECU_ADDRESS 0xC000B4FA /end MEASUREMENT
/begin MEASUREMENT SCRAd_stNH3LdCodtInactv "Freigabe Plausibilisierung" UBYTE SCRAd_Compu_Switch_2 1 100 0.00 1.00000000000 FORMAT "%13.11" ECU_ADDRESS 0xD0002092 /end MEASUREMENT
/begin MEASUREMENT SCRAd_stPlausActv_mp "Status der Plausibilisierung" UBYTE SCRAd_Compu_Switch_2 1 100 0.00 1.00000000000 FORMAT "%13.11" ECU_ADDRESS 0xC000B503 /end MEASUREMENT
/begin MEASUREMENT SCRAd_stQtyAdap "Status der Langzeitadaption" UBYTE OneToOne 1 100 0.00 255.0 ECU_ADDRESS 0xD0002093 /end MEASUREMENT
/begin MEASUREMENT SCRAd_stQtyAdap_mp "Status der Langzeitadapion" UBYTE OneToOne 1 100 0.00 255.0 ECU_ADDRESS 0xC000B4FF /end MEASUREMENT
/begin MEASUREMENT SCRAd_stQtyCorrNgv_mp "Anforderung zur Verringerung des Langzeitadaptionsfaktors" UBYTE OneToOne 1 100 0.00 255.0 ECU_ADDRESS 0xC000B500 /end MEASUREMENT
/begin MEASUREMENT SCRAd_stQtyCorrPsv_mp "Anforderung zur Erhöhung des Langzeitadaptionsfaktors" UBYTE OneToOne 1 100 0.00 255.0 ECU_ADDRESS 0xC000B501 /end MEASUREMENT
/begin MEASUREMENT SCRAd_stRatMinNOx_mp "Freigabe NOx-Mindestkonzentration" UBYTE OneToOne 1 100 0.00 255.0 ECU_ADDRESS 0xC000B4FB /end MEASUREMENT
/begin MEASUREMENT SCRAd_stRatTolcNOx_mp "Freigabe Sensorabweichung" UBYTE OneToOne 1 100 0.00 255.0 ECU_ADDRESS 0xC000B4FC /end MEASUREMENT
/begin MEASUREMENT SCRAd_stRlsQStat_mp "Status für den stationären Fahrzeugbetrieb" UBYTE OneToOne 1 100 0.00 255.0 ECU_ADDRESS 0xC000B504 /end MEASUREMENT
/begin MEASUREMENT SCRAd_stRstTrg_mp "Anforderung Trigger deativieren" UBYTE SCRAd_Compu_Switch_3 1 100 0.00 1.00000000000 FORMAT "%13.11" ECU_ADDRESS 0xC000B4F5 /end MEASUREMENT
/begin MEASUREMENT SCRAd_stSlip "Aktivierung Schlupferkennung" UBYTE OneToOne 1 100 0.00 255.0 ECU_ADDRESS 0xD0002094 /end MEASUREMENT
/begin MEASUREMENT SCRAd_stSlipDetFlt_mp "Freigabebit für Schlupferkennung" UBYTE OneToOne 1 100 0.00 255.0 ECU_ADDRESS 0xC000B4FD /end MEASUREMENT
/begin MEASUREMENT SCRAd_stStp_mp "Status Differenzberechnung" UBYTE OneToOne 1 100 0.00 255.0 ECU_ADDRESS 0xC000B505 /end MEASUREMENT
/begin MEASUREMENT SCRAd_stStrtTrgActv_mp "Status StartTrigger gesetzt" UBYTE SCRAd_Compu_Switch_3 1 100 0.00 1.00000000000 FORMAT "%13.11" ECU_ADDRESS 0xC000B4F6 /end MEASUREMENT
/begin MEASUREMENT SCRAd_stStrtTrg_mp "Status StartTrigger" UBYTE SCRAd_Compu_Switch_3 1 100 0.00 1.00000000000 FORMAT "%13.11" ECU_ADDRESS 0xC000B4F7 /end MEASUREMENT
/begin MEASUREMENT SCRAd_stTempMin_mp "Freigabe untere Katalysatortemperatur" UBYTE OneToOne 1 100 0.00 255.0 ECU_ADDRESS 0xC000B4FE /end MEASUREMENT
/begin MEASUREMENT SCRAd_stTmrPlausExpi "Status Timer für Plausibilisierung abgelaufen" UBYTE SCRAd_Compu_Switch_2 1 100 0.00 1.00000000000 FORMAT "%13.11" ECU_ADDRESS 0xD0002095 /end MEASUREMENT
/begin MEASUREMENT SCRAd_stTmrPlausExpi_mp "Staus Timer für Plausibilisierung abgelaufen" UBYTE SCRAd_Compu_Switch_2 1 100 0.00 1.00000000000 FORMAT "%13.11" ECU_ADDRESS 0xC000B506 /end MEASUREMENT
/begin MEASUREMENT SCRAd_stTmrTrgRaw_mp "Status Füllstandstrigger Timer" UBYTE SCRAd_Compu_Switch_3 1 100 0.00 1.00000000000 FORMAT "%13.11" ECU_ADDRESS 0xC000B4F8 /end MEASUREMENT
/begin MEASUREMENT SCRAd_stTmrTrg_mp "Freigabe Berechnung Füllstandskorrekturwert" UBYTE SCRAd_Compu_Switch_3 1 100 0.00 1.00000000000 FORMAT "%13.11" ECU_ADDRESS 0xC000B4F9 /end MEASUREMENT
/begin MEASUREMENT SCRAd_tAvrgFL_mp "Durchschnittstemperatur im SCR Katalysator" SWORD Temp_Cels 1 100 -3549.940 3003.560 ECU_ADDRESS 0xC000AC5E /end MEASUREMENT
/begin MEASUREMENT SCRAd_tAvrg_mp "Durchschnittstemperatur im SCR Katalysator" SWORD Temp_Cels 1 100 -3549.940 3003.560 ECU_ADDRESS 0xC000AC84 /end MEASUREMENT
/begin MEASUREMENT SCRAd_tiAvrgStrTrg_mp "Zeit der Mittelwertsberechnung" SWORD SCR_Time100 1 100 -327.6800 327.6700 FORMAT "%8.4" ECU_ADDRESS 0xC000AC86 /end MEASUREMENT
/begin MEASUREMENT SCRAd_tiIniAdap_mp "Wert des Timers der Langzeitadaptionsinitialisierung" ULONG SCR_Time10 1 100 0.00 429496729.500 FORMAT "%13.3" ECU_ADDRESS 0xC0009350 /end MEASUREMENT
/begin MEASUREMENT SCRAd_tiIniEFl_mp "Wert des Timers der Initialisierung von SCRAd_stEFl RstReqPsv_mp" ULONG SCR_Time10 1 100 0.00 429496729.500 FORMAT "%13.3" ECU_ADDRESS 0xC0009354 /end MEASUREMENT
/begin MEASUREMENT SCRAd_tiQStat_mp "Stationäre Zeit für Einspritzmenge" SLONG SCR_Time100 1 100 -21474836.4800 21474836.4700 FORMAT "%13.4" ECU_ADDRESS 0xC0009370 /end MEASUREMENT
/begin MEASUREMENT SCRAd_tiTmrCodt_mp "Zeit, seit dem FS-Adaption und Plausibilisierung gesperrt sind" SLONG Time_ms 1 100 -21474836480.0 21474836470.0 ECU_ADDRESS 0xC0009374 /end MEASUREMENT
/begin MEASUREMENT SCRAd_tiTmrPlaus_mp "Wert des Timers für Plausibilisierung" SLONG Time_ms 1 100 -21474836480.0 21474836470.0 ECU_ADDRESS 0xC0009378 /end MEASUREMENT
/begin MEASUREMENT SCRAd_tiTmrTrg_mp "Abgelaufene Zeit des Füllstandsadaptions-Timers" ULONG Time_ms 1 100 0.00 42949672950.0 ECU_ADDRESS 0xC000934C /end MEASUREMENT
/begin MEASUREMENT SCRAd_tiVelStat_mp "Stationäre Zeit für Fahrzeuggeschwindigkeit" SWORD SCR_Time100 1 100 -327.6800 327.6700 FORMAT "%8.4" ECU_ADDRESS 0xC000AC78 /end MEASUREMENT
/begin MEASUREMENT SCRAd_vFlt_mp "Gefillterte momentane Fahrzeuggeschwindigkeit" SWORD Vel 1 100 -327.6800 327.6700 ECU_ADDRESS 0xC000AC7A /end MEASUREMENT
/begin MEASUREMENT SCRChk_ctCondUp1_mp "Erhöhungswert des Bedingungszählers im Temperaturbereich 1" SWORD OneToOne 1 100 -32768.00 32767.00 ECU_ADDRESS 0xC000AC88 /end MEASUREMENT
/begin MEASUREMENT SCRChk_ctCondUp2_mp "Erhöhungswert des Bedingungszählers im Temperaturbereich 2" SWORD OneToOne 1 100 -32768.00 32767.00 ECU_ADDRESS 0xC000AC8A /end MEASUREMENT
/begin MEASUREMENT SCRChk_ctEtaCalc1_mp "Zähler der Wirkungsgradberechnung im Temperaturbereich 1" SWORD OneToOne 1 100 -32768.00 32767.00 ECU_ADDRESS 0xC000AC8C /end MEASUREMENT
/begin MEASUREMENT SCRChk_ctEtaCalc2_mp "Zähler der Wirkungsgradberechnung im Temperaturbereich 2" SWORD OneToOne 1 100 -32768.00 32767.00 ECU_ADDRESS 0xC000AC8E /end MEASUREMENT
/begin MEASUREMENT SCRChk_ctEtaCond1_mp "Bedingungszähler der Statemachine im Temperaturbereich 1" SWORD OneToOne 1 100 -32768.00 32767.00 ECU_ADDRESS 0xC000AC90 /end MEASUREMENT
/begin MEASUREMENT SCRChk_ctEtaCond2_mp "Bedingungszähler der Statemachine im Temperaturbereich 2" SWORD OneToOne 1 100 -32768.00 32767.00 ECU_ADDRESS 0xC000AC92 /end MEASUREMENT
/begin MEASUREMENT SCRChk_dmExhFlt_mp "Gefilterter Abgasmassenstrom" SWORD AirMassPerTime 1 100 -3276.800 3276.700 ECU_ADDRESS 0xC000AC94 /end MEASUREMENT
/begin MEASUREMENT SCRChk_dmExh_mp "Extrahierter Abgasmassenstrom" SWORD AirMassPerTime 1 100 -3276.800 3276.700 ECU_ADDRESS 0xC000AC96 /end MEASUREMENT
/begin MEASUREMENT SCRChk_dmNOxDsItg_mp "NOx Massenstrom nach SCR für der Hauptintegrator" SLONG SCR_dmNOx_mg_p_s 1 100 -2147483.64800 2147483.64700 FORMAT "%13.5" ARRAY_SIZE 2 ECU_ADDRESS 0xC000C45C /end MEASUREMENT
/begin MEASUREMENT SCRChk_dmNOxDsPre_mp "NOx Massenstrom nach SCR für der Vorintegrator" SLONG SCR_dmNOx_mg_p_s 1 100 -2147483.64800 2147483.64700 FORMAT "%13.5" ARRAY_SIZE 2 ECU_ADDRESS 0xC000C464 /end MEASUREMENT
/begin MEASUREMENT SCRChk_dmNOxDsThresItg_mp "Schwelle des NOx Massenflusses nach SCR für den Hauptintegrator" SLONG SCR_dmNOx_mg_p_s 1 100 -2147483.64800 2147483.64700 FORMAT "%13.5" ARRAY_SIZE 2 ECU_ADDRESS 0xC000C46C /end MEASUREMENT
/begin MEASUREMENT SCRChk_dmNOxDsThresPre_mp "Schwelle des NOx Massenflusses nach SCR für den Vorintegrator" SLONG SCR_dmNOx_mg_p_s 1 100 -2147483.64800 2147483.64700 FORMAT "%13.5" ARRAY_SIZE 2 ECU_ADDRESS 0xC000C474 /end MEASUREMENT
/begin MEASUREMENT SCRChk_dmNOxSensDsFlt_mp "Gefilterter NOx Massenfluss des NOx Sensors nach SCR" SLONG SCR_dmNOx_mg_p_s 1 100 -2147483.64800 2147483.64700 FORMAT "%13.5" ECU_ADDRESS 0xC0009380 /end MEASUREMENT
/begin MEASUREMENT SCRChk_dmNOxUsAvrg1_mp "Durchschnittlicher NOx Massenfluss nach SCR während der Wirkungsgradberechnung im Temperaturbereich 1" SLONG SCR_dmNOx_mg_p_s 1 100 -2147483.64800 2147483.64700 FORMAT "%13.5" ECU_ADDRESS 0xC0009384 /end MEASUREMENT
/begin MEASUREMENT SCRChk_dmNOxUsAvrg2_mp "Durchschnittlicher NOx Massenfluss nach SCR während der Wirkungsgradberechnung im Temperaturbereich 2" SLONG SCR_dmNOx_mg_p_s 1 100 -2147483.64800 2147483.64700 FORMAT "%13.5" ECU_ADDRESS 0xC0009388 /end MEASUREMENT
/begin MEASUREMENT SCRChk_dmNOxUsFltDdT_mp "Gefilterter und verzögerter NOx Massenfluss vor SCR" SLONG SCR_dmNOx_mg_p_s 1 100 -2147483.64800 2147483.64700 FORMAT "%13.5" ECU_ADDRESS 0xC000938C /end MEASUREMENT
/begin MEASUREMENT SCRChk_dmNOxUsFlt_mp "Gefilterter NOx Massenfluss vor SCR" SLONG SCR_dmNOx_mg_p_s 1 100 -2147483.64800 2147483.64700 FORMAT "%13.5" ECU_ADDRESS 0xC0009390 /end MEASUREMENT
/begin MEASUREMENT SCRChk_dmNOxUsItg_mp "NOx Massenfluss vor SCR für den Hauptintegrator" SLONG SCR_dmNOx_mg_p_s 1 100 -2147483.64800 2147483.64700 FORMAT "%13.5" ARRAY_SIZE 2 ECU_ADDRESS 0xC000C47C /end MEASUREMENT
/begin MEASUREMENT SCRChk_dmNOxUsPre_mp "NOx Massenfluss vor SCR für den Vorintegrator" SLONG SCR_dmNOx_mg_p_s 1 100 -2147483.64800 2147483.64700 FORMAT "%13.5" ARRAY_SIZE 2 ECU_ADDRESS 0xC000C484 /end MEASUREMENT
/begin MEASUREMENT SCRChk_dmNOxUsToS16_mp "NOx Massenfluss vor SCR in grober Auflösung" SWORD SCR_Dm01 1 100 -3276.800 3276.700 FORMAT "%8.3" ECU_ADDRESS 0xC000AC98 /end MEASUREMENT
/begin MEASUREMENT SCRChk_etaActAvrg1_mp "Durchschnittlicher tatsächlicher Wirkungsgrad im Temperaturbereich 1" SWORD SCR_Fact1000 1 100 -32.76800 32.76700 FORMAT "%8.5" ECU_ADDRESS 0xC000AC9A /end MEASUREMENT
/begin MEASUREMENT SCRChk_etaActAvrg2_mp "Durchschnittlicher tatsächlicher Wirkungsgrad im Temperaturbereich 2" SWORD SCR_Fact1000 1 100 -32.76800 32.76700 FORMAT "%8.5" ECU_ADDRESS 0xC000AC9C /end MEASUREMENT
/begin MEASUREMENT SCRChk_etaEstFlt_mp "Gefilterter geschätzter SCR Wirkungsgrad" SWORD SCR_Fact1000 1 100 -32.76800 32.76700 FORMAT "%8.5" ECU_ADDRESS 0xC000AC9E /end MEASUREMENT
/begin MEASUREMENT SCRChk_etaThres1_mp "Tatsächliche Wirkungsgradschwelle im Temperaturbereich 1" SWORD SCR_Fact1000 1 100 -32.76800 32.76700 FORMAT "%8.5" ECU_ADDRESS 0xC000ACA0 /end MEASUREMENT
/begin MEASUREMENT SCRChk_etaThres2_mp "Tatsächliche Wirkungsgradschwelle im Temperaturbereich 2" SWORD SCR_Fact1000 1 100 -32.76800 32.76700 FORMAT "%8.5" ECU_ADDRESS 0xC000ACA2 /end MEASUREMENT
/begin MEASUREMENT SCRChk_etaThresAvrg1_mp "Durchschnittliche Wirkungsgradschwelle im Temperaturbereich 1" SWORD SCR_Fact1000 1 100 -32.76800 32.76700 FORMAT "%8.5" ECU_ADDRESS 0xC000ACA4 /end MEASUREMENT
/begin MEASUREMENT SCRChk_etaThresAvrg2_mp "Durchschnittliche Wirkungsgradschwelle im Temperaturbereich 2" SWORD SCR_Fact1000 1 100 -32.76800 32.76700 FORMAT "%8.5" ECU_ADDRESS 0xC000ACA6 /end MEASUREMENT
/begin MEASUREMENT SCRChk_etaThresExtFlt_mp "Gefilterte externe Wirkungsgradschwelle" SWORD SCR_Fact1000 1 100 -32.76800 32.76700 FORMAT "%8.5" ECU_ADDRESS 0xC000ACA8 /end MEASUREMENT
/begin MEASUREMENT SCRChk_etaThresExt_mp "Externe Wirkungsgradschwelle" SWORD SCR_Fact1000 1 100 -32.76800 32.76700 FORMAT "%8.5" ECU_ADDRESS 0xC000ACAA /end MEASUREMENT
/begin MEASUREMENT SCRChk_etaThresTemp1_mp "Wirkungsgradschwelle abhängig von der SCR Temperatur im Temperaturbereich 1" SWORD SCR_Fact1000 1 100 -32.76800 32.76700 FORMAT "%8.5" ECU_ADDRESS 0xC000ACAC /end MEASUREMENT
/begin MEASUREMENT SCRChk_etaThresTemp2_mp "Wirkungsgradschwelle abhängig von der SCR Temperatur im Temperaturbereich 2" SWORD SCR_Fact1000 1 100 -32.76800 32.76700 FORMAT "%8.5" ECU_ADDRESS 0xC000ACAE /end MEASUREMENT
/begin MEASUREMENT SCRChk_facEtaThresExh1_mp "Korrekturfaktor der Wirkungsgradschwelle abhängig von dem Abgasmassenstrom im Temperaturbereich 1" SWORD SCR_Fact1000 1 100 -32.76800 32.76700 FORMAT "%8.5" ECU_ADDRESS 0xC000ACB0 /end MEASUREMENT
/begin MEASUREMENT SCRChk_facEtaThresExh2_mp "Korrekturfaktor der Wirkungsgradschwelle abhängig von dem Abgasmassenstrom im Temperaturbereich 2" SWORD SCR_Fact1000 1 100 -32.76800 32.76700 FORMAT "%8.5" ECU_ADDRESS 0xC000ACB2 /end MEASUREMENT
/begin MEASUREMENT SCRChk_facEtaThresExtFlt_mp "Gefilterter externer Korrekturfaktor für die Wirkungsgradschwelle" SWORD SCR_Fact1000 1 100 -32.76800 32.76700 FORMAT "%8.5" ECU_ADDRESS 0xC000ACB4 /end MEASUREMENT
/begin MEASUREMENT SCRChk_facEtaThresExt_mp "Externer Korrekturfaktor für die Wirkungsgradschwelle" SWORD SCR_Fact1000 1 100 -32.76800 32.76700 FORMAT "%8.5" ECU_ADDRESS 0xC000ACB6 /end MEASUREMENT
/begin MEASUREMENT SCRChk_facEtaThresNOx1_mp "Korrekturfaktor der Wirkungsgradschwelle abhängig von dem NOx Massenfluss im Temperaturbereich 1" SWORD SCR_Fact1000 1 100 -32.76800 32.76700 FORMAT "%8.5" ECU_ADDRESS 0xC000ACB8 /end MEASUREMENT
/begin MEASUREMENT SCRChk_facEtaThresNOx2_mp "Korrekturfaktor der Wirkungsgradschwelle abhängig von dem NOx Massenfluss im Temperaturbereich 2" SWORD SCR_Fact1000 1 100 -32.76800 32.76700 FORMAT "%8.5" ECU_ADDRESS 0xC000ACBA /end MEASUREMENT
/begin MEASUREMENT SCRChk_mNOxDsPre_mp "NOx Menge nach SCR (Vorintegrator)" SLONG SCR_Mass10000 1 100 -214748.364800 214748.364700 FORMAT "%13.6" ARRAY_SIZE 2 ECU_ADDRESS 0xC000C48C /end MEASUREMENT
/begin MEASUREMENT SCRChk_mNOxDsThresPre_mp "NOx Mengenschwelle nach SCR (Vorintegrator)" SLONG SCR_Mass10000 1 100 -214748.364800 214748.364700 FORMAT "%13.6" ARRAY_SIZE 2 ECU_ADDRESS 0xC000C494 /end MEASUREMENT
/begin MEASUREMENT SCRChk_mNOxDsThres_mp "NOx Mengenschwelle nach SCR (Hauptintegrator)" SLONG SCR_Mass10000 1 100 -214748.364800 214748.364700 FORMAT "%13.6" ARRAY_SIZE 2 ECU_ADDRESS 0xC000C49C /end MEASUREMENT
/begin MEASUREMENT SCRChk_mNOxDs_mp "NOx Menge nach SCR (Hauptintegrator)" SLONG SCR_Mass10000 1 100 -214748.364800 214748.364700 FORMAT "%13.6" ARRAY_SIZE 2 ECU_ADDRESS 0xC000C4A4 /end MEASUREMENT
/begin MEASUREMENT SCRChk_mNOxUsPre_mp "NOx Menge vor SCR (Vorintegrator)" SLONG SCR_Mass10000 1 100 -214748.364800 214748.364700 FORMAT "%13.6" ARRAY_SIZE 2 ECU_ADDRESS 0xC000C4AC /end MEASUREMENT
/begin MEASUREMENT SCRChk_mNOxUs_mp "NOx Menge vor SCR (Hauptintegrator)" SLONG SCR_Mass10000 1 100 -214748.364800 214748.364700 FORMAT "%13.6" ARRAY_SIZE 2 ECU_ADDRESS 0xC000C4B4 /end MEASUREMENT
/begin MEASUREMENT SCRChk_rPPMNOxUsFltDdT_mp "Gefilterte und verzögerte NOx Rohemission" SWORD nox 1 100 -32768.00 32767.00 FORMAT "%8.2" ECU_ADDRESS 0xC000ACBC /end MEASUREMENT
/begin MEASUREMENT SCRChk_rPPMNOxUsFlt_mp "Gefilterte NOx Rohemission" SWORD nox 1 100 -32768.00 32767.00 FORMAT "%8.2" ECU_ADDRESS 0xC000ACBE /end MEASUREMENT
/begin MEASUREMENT SCRChk_stEtaCalcNew1_mp "Status der Neuberechnung des Wirkungsgrads im Temperaturbereich 1" UBYTE SCRChk_Compu_EffVal 1 100 0.00 1.00000000000 FORMAT "%13.11" ECU_ADDRESS 0xC000B508 /end MEASUREMENT
/begin MEASUREMENT SCRChk_stEtaCalcNew2_mp "Status der Neuberechnung des Wirkungsgrads im Temperaturbereich 2" UBYTE SCRChk_Compu_EffVal 1 100 0.00 1.00000000000 FORMAT "%13.11" ECU_ADDRESS 0xC000B509 /end MEASUREMENT
/begin MEASUREMENT SCRChk_stEtaCalc_mp "Status der Bedingung für die Wirkungsgradberechnung" UBYTE SCRChk_Compu_Fulfilled 1 100 0.00 1.00000000000 FORMAT "%13.11" ARRAY_SIZE 2 ECU_ADDRESS 0xC000C4BC /end MEASUREMENT
/begin MEASUREMENT SCRChk_stEtaCond_mp "Status des Bedingungszählers" UBYTE SCRChk_Compu_Fulfilled 1 100 0.00 1.00000000000 FORMAT "%13.11" ARRAY_SIZE 2 ECU_ADDRESS 0xC000C4BE /end MEASUREMENT
/begin MEASUREMENT SCRChk_stEtaEnaExtDly_mp "Status der verzögerten externen Freigabe für die Wirkungsgradberechnung" UBYTE SCRChk_Compu_Switch_1 1 100 0.00 1.00000000000 FORMAT "%13.11" ECU_ADDRESS 0xC000B50A /end MEASUREMENT
/begin MEASUREMENT SCRChk_stEtaEnaExt_mp "Status der externen Freigabe für die Wirkungsgradberechnung" UBYTE SCRChk_Compu_Switch_1 1 100 0.00 1.00000000000 FORMAT "%13.11" ECU_ADDRESS 0xC000B50B /end MEASUREMENT
/begin MEASUREMENT SCRChk_stEtaEnaFIdDly_mp "Status der verzögerten Fid" UBYTE SCRChk_Compu_Switch_1 1 100 0.00 1.00000000000 FORMAT "%13.11" ECU_ADDRESS 0xC000B50C /end MEASUREMENT
/begin MEASUREMENT SCRChk_stEtaEna_mp "Status für die Freigabe der Wirkungsgradberechnung" UBYTE SCRChk_Compu_Switch_1 1 100 0.00 1.00000000000 FORMAT "%13.11" ECU_ADDRESS 0xC000B50D /end MEASUREMENT
/begin MEASUREMENT SCRChk_stEtaErr1_mp "Überwachungsstatus von Temperaturbereich 1" UBYTE SCRChk_Compu_stErr 1 100 0.00 1.00000000000 FORMAT "%13.11" ECU_ADDRESS 0xC000B50E /end MEASUREMENT
/begin MEASUREMENT SCRChk_stEtaErr2_mp "Überwachungsstatus von Temperaturbereich 2" UBYTE SCRChk_Compu_stErr 1 100 0.00 1.00000000000 FORMAT "%13.11" ECU_ADDRESS 0xC000B50F /end MEASUREMENT
/begin MEASUREMENT SCRChk_stEtaErrTrigDeb1_mp "Triggerereignis für das Entprellen eines Wirkunsggradberechnungsfehlers im Temperaturbereich 1" UBYTE SCRChk_Compu_Switch_1 1 100 0.00 1.00000000000 FORMAT "%13.11" ECU_ADDRESS 0xC000B510 /end MEASUREMENT
/begin MEASUREMENT SCRChk_stEtaErrTrigDeb2_mp "Triggerereignis für das Entprellen eines Wirkunsggradberechnungsfehlers im Temperaturbereich 2" UBYTE SCRChk_Compu_Switch_1 1 100 0.00 1.00000000000 FORMAT "%13.11" ECU_ADDRESS 0xC000B511 /end MEASUREMENT
/begin MEASUREMENT SCRChk_stEtaRstCalc_mp "Berechneter Resetstatus" UBYTE SCRChk_Compu_Switch_1 1 100 0.00 1.00000000000 FORMAT "%13.11" ARRAY_SIZE 2 ECU_ADDRESS 0xC000C4C0 /end MEASUREMENT
/begin MEASUREMENT SCRChk_stEtaRstExt_mp "Externer Resetstatus" UBYTE SCRChk_Compu_Switch_1 1 100 0.00 1.00000000000 FORMAT "%13.11" ECU_ADDRESS 0xC000B512 /end MEASUREMENT
/begin MEASUREMENT SCRChk_stEtaRst_mp "Resetstatus" UBYTE SCRChk_Compu_Switch_1 1 100 0.00 1.00000000000 FORMAT "%13.11" ECU_ADDRESS 0xC000B513 /end MEASUREMENT
/begin MEASUREMENT SCRChk_stEtaStM1_mp "Zustand im Temperaturbereich 1" UBYTE SCRChk_Compu_StM 1 100 0.00 4.00000000000 FORMAT "%13.11" ECU_ADDRESS 0xC000B514 /end MEASUREMENT
/begin MEASUREMENT SCRChk_stEtaStM2_mp "Zustand im Temperaturbereich 2" UBYTE SCRChk_Compu_StM 1 100 0.00 4.00000000000 FORMAT "%13.11" ECU_ADDRESS 0xC000B515 /end MEASUREMENT
/begin MEASUREMENT SCRChk_stMsNOxUsMin_mp "Status, ob integrierte NOx Menge vor SCR die Schwelle für die Berechnung übersteigt" UBYTE SCRChk_Compu_Threshold 1 100 0.00 1.00000000000 FORMAT "%13.11" ARRAY_SIZE 2 ECU_ADDRESS 0xC000C4C2 /end MEASUREMENT
/begin MEASUREMENT SCRChk_stNOxSensDsDly_mp "Verzögerter Status des NOx Sensors" UBYTE SCRChk_Compu_stNOxDly 1 100 0.00 1.00000000000 FORMAT "%13.11" ECU_ADDRESS 0xC000B516 /end MEASUREMENT
/begin MEASUREMENT SCRChk_tiDdTNOxEff_mp "Totzeit für den Abgassmassenstrom Verzögerung" SWORD SCR_Time10 1 100 -3276.800 3276.700 FORMAT "%8.3" ECU_ADDRESS 0xC000ACC0 /end MEASUREMENT
/begin MEASUREMENT SCRChk_tiNOxItgAvrg1_mp "Integrationszeit für die Wirkungsgradberechnung im Temperaturbereich 1" SWORD SCR_Time10 1 100 -3276.800 3276.700 FORMAT "%8.3" ECU_ADDRESS 0xC000ACC2 /end MEASUREMENT
/begin MEASUREMENT SCRChk_tiNOxItgAvrg2_mp "Integrationszeit für die Wirkungsgradberechnung im Temperaturbereich 2" SWORD SCR_Time10 1 100 -3276.800 3276.700 FORMAT "%8.3" ECU_ADDRESS 0xC000ACC4 /end MEASUREMENT
/begin MEASUREMENT SCRChk_tiNOxItgPre_mp "Aktuelle Integrationszeit der Vorintegratoren" SWORD SCR_Time10 1 100 -3276.800 3276.700 FORMAT "%8.3" ARRAY_SIZE 2 ECU_ADDRESS 0xC000C4C4 /end MEASUREMENT
/begin MEASUREMENT SCRChk_tiNOxItg_mp "Aktuelle Integrationszeit der Hauptintegratoren" SWORD SCR_Time10 1 100 -3276.800 3276.700 FORMAT "%8.3" ARRAY_SIZE 2 ECU_ADDRESS 0xC000C4C8 /end MEASUREMENT
/begin MEASUREMENT SCRChk_tSCRAvrg "Durchschnittemperatur im SCR Katalysator" SWORD Temp_Cels 1 100 -3549.940 3003.560 ECU_ADDRESS 0xD000131E /end MEASUREMENT
/begin MEASUREMENT SCRChk_tSCRFlt_mp "Gefilterte Durchschnittstemperatur im SCR Katalysator" SWORD Temp_Cels 1 100 -3549.940 3003.560 ECU_ADDRESS 0xC000ACC6 /end MEASUREMENT
/begin MEASUREMENT SCRFFC_dmEG_mp "aktueller Abgasstrom" SWORD AirMassPerTime 1 100 -3276.800 3276.700 ECU_ADDRESS 0xC000ACC8 /end MEASUREMENT
/begin MEASUREMENT SCRFFC_dmNH3Cnv "SCR Vorsteuermenge" SWORD SCR_dmNH3_mg_p_s 1 100 -1638.400 1638.350 FORMAT "%8.3" ECU_ADDRESS 0xD0001320 /end MEASUREMENT
/begin MEASUREMENT SCRFFC_dmNH3FdRat1_mp "Erforderliche NH3 Vorsteuermenge zur vollständigen NOx Reduktion bei einem Wirkungsgrad von 100%" SWORD SCR_dmNH3_mg_p_s 1 100 -1638.400 1638.350 FORMAT "%8.3" ECU_ADDRESS 0xC000ACD0 /end MEASUREMENT
/begin MEASUREMENT SCRFFC_dmNOxUs "NOx-Rohemissionen" SLONG SCR_dmNOx_mg_p_s 1 100 -2147483.64800 2147483.64700 FORMAT "%13.5" ECU_ADDRESS 0xD0003008 /end MEASUREMENT
/begin MEASUREMENT SCRFFC_facMolMsEG_mp "Molmasse des Abgases" SWORD SCR_Fac_g_p_Mol 1 100 -327.6800 327.6700 FORMAT "%8.4" ECU_ADDRESS 0xC000ACCA /end MEASUREMENT
/begin MEASUREMENT SCRFFC_facNOxToNH3 "Stöchiometrischer Umrechnungsfaktor NOx nach NH3" SWORD SCR_Fact1000 1 100 -32.76800 32.76700 FORMAT "%8.5" ECU_ADDRESS 0xD0001322 /end MEASUREMENT
/begin MEASUREMENT SCRFFC_facNOxToNH3PEnv_mp "" SWORD SCR_Fact1000 1 100 -32.76800 32.76700 FORMAT "%8.5" ECU_ADDRESS 0xC000ACD2 /end MEASUREMENT
/begin MEASUREMENT SCRFFC_facNOxToNH3POp_mp "" SWORD SCR_Fact1000 1 100 -32.76800 32.76700 FORMAT "%8.5" ECU_ADDRESS 0xC000ACD4 /end MEASUREMENT
/begin MEASUREMENT SCRFFC_facNOxToNH3TEnv_mp "" SWORD SCR_Fact1000 1 100 -32.76800 32.76700 FORMAT "%8.5" ECU_ADDRESS 0xC000ACD6 /end MEASUREMENT
/begin MEASUREMENT SCRFFC_facNOxToNH3_mp "" SWORD SCR_Fact1000 1 100 -32.76800 32.76700 FORMAT "%8.5" ECU_ADDRESS 0xC000ACD8 /end MEASUREMENT
/begin MEASUREMENT SCRFFC_LSUrLam_mp "Aktueller Lambdawert" SWORD lambda 1 100 -32.76800 32.76700 ECU_ADDRESS 0xC000ACCC /end MEASUREMENT
/begin MEASUREMENT SCRFFC_rMolMs "Verhältnis Molmasse NOx zu Abgas" SWORD SCR_Fact1000 1 100 -32.76800 32.76700 FORMAT "%8.5" ECU_ADDRESS 0xD0001324 /end MEASUREMENT
/begin MEASUREMENT SCRFFC_rNOxEG_mp "Aktuelle NOx Rohemission (berechnet durch ASMod)" SWORD RatNOxMass 1 100 -0.003276800 0.003276700 FORMAT "%11.9" ECU_ADDRESS 0xC000ACCE /end MEASUREMENT
/begin MEASUREMENT SCRFFC_rPPMNOxUs "NOx Rohemissionen" SWORD OneToOne 1 100 -32768.00 32767.00 ECU_ADDRESS 0xD0001326 /end MEASUREMENT
/begin MEASUREMENT SCRFFC_tAvrg_mp "Aktuelle Durchschnittstemperatur des SCR Katalysators" SWORD Temp_Cels 1 100 -3549.940 3003.560 ECU_ADDRESS 0xC000ACDA /end MEASUREMENT
/begin MEASUREMENT SCRLdG_dmExhEGFld_mp "" SWORD AirMassPerTime 1 100 -3276.800 3276.700 ECU_ADDRESS 0xC000ACDC /end MEASUREMENT
/begin MEASUREMENT SCRLdG_dmNH3LdGov "NH3-Speicherfüllstands-regleranteil" SWORD SCR_Dm005 1 100 -1638.400 1638.350 FORMAT "%8.3" ECU_ADDRESS 0xD0001328 /end MEASUREMENT
/begin MEASUREMENT SCRLdG_dmNH3LdGov_mp "NH3 Lastreglerausgang abhängig von NH3 Lastabweichung" SWORD SCR_Dm005 1 100 -1638.400 1638.350 FORMAT "%8.3" ECU_ADDRESS 0xC000ACDE /end MEASUREMENT
/begin MEASUREMENT SCRLdG_dmNH3MetAdap "adaptierte NH3-Dosiermenge" SWORD SCR_Dm005 1 100 -1638.400 1638.350 FORMAT "%8.3" ECU_ADDRESS 0xD000132A /end MEASUREMENT
/begin MEASUREMENT SCRLdG_dmNH3_mp "NH3-Dosiermenge mit Vorsteuerungs- und Füllstandsregleranteil" SWORD SCR_Dm005 1 100 -1638.400 1638.350 FORMAT "%8.3" ECU_ADDRESS 0xC000ACE0 /end MEASUREMENT
/begin MEASUREMENT SCRLdG_facDynCor_mp "Dynamikorrekturfaktor für Speicherfüllstand-Reglerausgang" SWORD SCR_Fact1000 1 100 -32.76800 32.76700 FORMAT "%8.5" ECU_ADDRESS 0xC000ACE2 /end MEASUREMENT
/begin MEASUREMENT SCRLdG_facNH3LdPEnv_mp "" SWORD SCR_Fact1000 1 100 -32.76800 32.76700 FORMAT "%8.5" ECU_ADDRESS 0xC000ACE4 /end MEASUREMENT
/begin MEASUREMENT SCRLdG_facNH3LdPOp_mp "" SWORD SCR_Fact1000 1 100 -32.76800 32.76700 FORMAT "%8.5" ECU_ADDRESS 0xC000ACE6 /end MEASUREMENT
/begin MEASUREMENT SCRLdG_facNH3LdPTEnv_mp "" SWORD SCR_Fact1000 1 100 -32.76800 32.76700 FORMAT "%8.5" ECU_ADDRESS 0xC000ACE8 /end MEASUREMENT
/begin MEASUREMENT SCRLdG_mHH3LdNomTemp_mp "" SWORD SCR_Mass1000 1 100 -32.76800 32.76700 FORMAT "%8.5" ECU_ADDRESS 0xC000ACEA /end MEASUREMENT
/begin MEASUREMENT SCRLdG_mNH3LdDvt "NH3-Speicherfüllstand Reglerabweichung" SWORD SCR_Mass1000 1 100 -32.76800 32.76700 FORMAT "%8.5" ECU_ADDRESS 0xD000132C /end MEASUREMENT
/begin MEASUREMENT SCRLdG_mNH3LdDvt_mp "NH3-Speicherfüllstand Reglerabweichung" SWORD SCR_Mass1000 1 100 -32.76800 32.76700 FORMAT "%8.5" ECU_ADDRESS 0xC000ACEC /end MEASUREMENT
/begin MEASUREMENT SCRLdG_mNH3LdNom "NH3-Speichersollfüllstand" SWORD SCR_Mass1000 1 100 -32.76800 32.76700 FORMAT "%8.5" ECU_ADDRESS 0xD000132E /end MEASUREMENT
/begin MEASUREMENT SCRLdG_mNH3LdNom_mp "NH3-Soll-Speicherfüllstand" SWORD SCR_Mass1000 1 100 -32.76800 32.76700 FORMAT "%8.5" ECU_ADDRESS 0xC000ACEE /end MEASUREMENT
/begin MEASUREMENT SCRLdG_tSCRAvrg_mp "SCR-Katalysatortemperatur (Mittelwert)" SWORD Temp_Cels 1 100 -3549.940 3003.560 ECU_ADDRESS 0xC000ACF0 /end MEASUREMENT
/begin MEASUREMENT SCRMod_dmNH3Ld "Aktueller NH3 Eintrag in den SCR Katalysator" SLONG SCR_dmNH3_mg_p_s 1 100 -107374182.400 107374182.350 FORMAT "%13.3" ECU_ADDRESS 0xD000300C /end MEASUREMENT
/begin MEASUREMENT SCRMod_dmNH3Ld_mp "Aktueller Wert der Ammoniak Balance" SLONG SCR_dmNH3_mg_p_s 1 100 -107374182.400 107374182.350 FORMAT "%13.3" ECU_ADDRESS 0xC000939C /end MEASUREMENT
/begin MEASUREMENT SCRMod_facEffOxiAge "Effektiver Alterungsfaktor des OxiKats" SWORD SCR_Fact1000 1 100 -32.76800 32.76700 FORMAT "%8.5" ECU_ADDRESS 0xD0001332 /end MEASUREMENT
/begin MEASUREMENT SCRMod_facEffOxiAge_mp "Gesamt-Alterungsfaktor des Oxidations Katalysators" SWORD SCR_Fact1000 1 100 -32.76800 32.76700 FORMAT "%8.5" ECU_ADDRESS 0xC000ACF2 /end MEASUREMENT
/begin MEASUREMENT SCRMod_facEffSCRAge "resultierende Gesamt-Alterungs-Faktor des SCR-Katalysator" SWORD SCR_Fact1000 1 100 -32.76800 32.76700 FORMAT "%8.5" ECU_ADDRESS 0xD0001334 /end MEASUREMENT
/begin MEASUREMENT SCRMod_facEffSCRAge_mp "Effektiver Gesamt-Alterungsfaktor des SCR-Katalysators" SWORD SCR_Fact1000 1 100 -32.76800 32.76700 FORMAT "%8.5" ECU_ADDRESS 0xC000ACF4 /end MEASUREMENT
/begin MEASUREMENT SCRMod_facTempOxiAge_mp "aktueller Alterungsfaktor in Abhängigkeit von Oxicat-upstream-Temperatur" SWORD SCR_Fact1000 1 100 -32.76800 32.76700 FORMAT "%8.5" ECU_ADDRESS 0xC000ACF6 /end MEASUREMENT
/begin MEASUREMENT SCRMod_facTempOxiTot_mp "Total integrierte Alterungs Faktoren des Oxidationskatalysators" FLOAT32_IEEE OneToOne 1 100 0.00 65000.0000 FORMAT "%10.4" ECU_ADDRESS 0xC0009394 /end MEASUREMENT
/begin MEASUREMENT SCRMod_facTempSCRAge_mp "Aktuelles Alterungsfaktor in Abhängigkeit der mittleren SCRCat-temperatur" SWORD SCR_Fact1000 1 100 -32.76800 32.76700 FORMAT "%8.5" ECU_ADDRESS 0xC000ACF8 /end MEASUREMENT
/begin MEASUREMENT SCRMod_facTempSCRTot_mp "Total integrierter Alterungsfaktor des SCR Katalystators" FLOAT32_IEEE OneToOne 1 100 0.00 65000.0000 FORMAT "%10.4" ECU_ADDRESS 0xC0009398 /end MEASUREMENT
/begin FUNCTION Rail_MonPCV ""
 /begin DEF_CHARACTERISTIC Rail_PCVMon.pDvtMax_C Rail_PCVMon.pDvtMin_C Rail_PCVMon.pDvtMin2_C Rail_PCVMon.pSetMin_C Rail_PCVMon.pFltMax_C Rail_PCVMon.pFltMax2_C Rail_PCVMon.stRls_C Rail_pPCVDvtMax_CUR Rail_pPCVFltMin_CUR Rail_pPCVSetMax_CUR /end DEF_CHARACTERISTIC
 /begin IN_MEASUREMENT Epm_nEng PCV_pSet RailP_pFlt Rail_dpSetPointDec Rail_dpSetPointInc Rail_pDvt Rail_pSetPoint Rail_stCtlLoop /end IN_MEASUREMENT
 /begin LOC_MEASUREMENT Rail_pPCVDvtMax_mp Rail_pPCVFltMin_mp Rail_pPCVSetMax_mp Rail_stPCVMon0_mp Rail_stPCVMon1_mp Rail_stPCVMon22_mp Rail_stPCVMon2_mp Rail_stPCVMon3_mp Rail_stPCVMon42_mp Rail_stPCVMon4_mp Rail_tiPCV0Deb_mp Rail_tiPCV1Deb_mp Rail_tiPCV22Deb_mp Rail_tiPCV2Deb_mp Rail_tiPCV3Deb_mp Rail_tiPCV42Deb_mp Rail_tiPCV4Deb_mp /end LOC_MEASUREMENT
/end FUNCTION
/begin FUNCTION Rail_PGovSetup "" /begin IN_MEASUREMENT CoEng_st /end IN_MEASUREMENT /begin OUT_MEASUREMENT Rail_stCtlType Rail_swtCtlSel Rail_swtPress /end OUT_MEASUREMENT /begin LOC_MEASUREMENT Rail_swtPreCtl Rail_swtWindUp /end LOC_MEASUREMENT /end FUNCTION
/begin FUNCTION Rail_PMonStrt ""
 /begin DEF_CHARACTERISTIC Rail_lTotDstMin_C Rail_nStrtLim_C Rail_pStrtLim_C Rail_tiPMonStrtLim1_C Rail_tiPMonStrtLim_C /end DEF_CHARACTERISTIC
 /begin IN_MEASUREMENT Epm_nEng GlbDa_lTotDst RailP_pFlt StSys_stStrt /end IN_MEASUREMENT
 /begin LOC_MEASUREMENT Rail_ctPMonStrt_mp /end LOC_MEASUREMENT
/end FUNCTION
/begin FUNCTION Rail_PreCtlMeUn ""
 /begin DEF_CHARACTERISTIC Rail_dvolLeak_MAP Rail_dvolPreCtlBas_MAP Rail_dvolPreCtlOfs_MAP Rail_dvolPreCtlPoI1_MAP Rail_dvolPreCtlPoI2_MAP Rail_dvolPreCtl_C Rail_facLeakAged_C Rail_stPreCtlMeUnSel_C Rail_swtDvolPreCtl_C Rail_volInjVlvCtl_C /end DEF_CHARACTERISTIC
 /begin IN_MEASUREMENT Epm_ctCyl Epm_nEng Epm_numCyl FuelT_tFlSys InjCrv_qPoI1Des InjCrv_qPoI1Des_mp InjCrv_qPoI2Des InjCrv_qPoI2Des_mp InjCrv_stInjCharActVal InjCtl_qCurr InjCtl_qSetUnBal Rail_pSetPoint /end IN_MEASUREMENT
 /begin LOC_MEASUREMENT Rail_dvolInjVlvCtl_mp Rail_dvolLeak_mp Rail_dvolPreCtlBas_mp Rail_dvolPreCtlInit_mp Rail_dvolPreCtlOfs_mp Rail_dvolPreCtlPoI1_mp Rail_dvolPreCtlPoI2_mp Rail_qPreCtlBas_mp /end LOC_MEASUREMENT
/end FUNCTION
/begin FUNCTION Rail_PreCtlPCV ""
 /begin DEF_CHARACTERISTIC Rail_dvolRedOfsLimHi_C Rail_dvolRedOfsLimLo_C Rail_nRedOfsLimHi_C Rail_nRedOfsLimLo_C Rail_pDvtRedOfsLimHi_C Rail_pDvtRedOfsLimLo_C Rail_pPCVCloseOfs_CUR Rail_pPCVRedOfs_CUR Rail_pPreCtl_C Rail_pPreCtl_MAP Rail_pRedOfsLim_C Rail_qRedOfsLimHi_C Rail_qRedOfsLimLo_C Rail_swtPPreCtl_C Rail_tiDvtPressRedOfsPT1_C Rail_tiPCVRmpDur_CUR Rail_tiPCVRmpToOfs_C Rail_tiPCVRmpToRedOfs_C /end DEF_CHARACTERISTIC
 /begin IN_MEASUREMENT Epm_nEng HLSDem_nSetPLo InjCtl_qCurr PthSet_stOvrRun RailP_pFlt Rail_pSetPoint /end IN_MEASUREMENT
 /begin LOC_MEASUREMENT Rail_facPCVTiRmpVal_mp Rail_facTiRmpVal_mp Rail_pPCVClose_mp Rail_pPCVOfs_mp Rail_pPCVRedOfs_mp Rail_pPreCtl_mp Rail_stPCVRedOfs_mp Rail_stZFCDem_mp Rail_tiPCVRmpDur_mp /end LOC_MEASUREMENT
/end FUNCTION
/begin FUNCTION Rail_Rgn ""
 /begin DEF_CHARACTERISTIC Rail_pSetPointBas0Rgn_GMAP Rail_pSetPointBas1Rgn_GMAP Rail_pSetPointBasRgnX_AXIS Rail_pSetPointBasRgnY_AXIS /end DEF_CHARACTERISTIC
 /begin IN_MEASUREMENT Epm_nEng InjCtl_qCurr Rail_pSetPointAddCorRgn Rail_pSetPointEnvCorRgn Rail_stSetPointRgn /end IN_MEASUREMENT
 /begin OUT_MEASUREMENT Rail_pSetPointRgn /end OUT_MEASUREMENT
 /begin LOC_MEASUREMENT Rail_numRgnStg_mp Rail_pSetPointBasRgn_mp /end LOC_MEASUREMENT
/end FUNCTION
/begin FUNCTION Rail_RgnLib ""
 /begin DEF_CHARACTERISTIC Rail_facSetPointRmp0Val_GCUR Rail_facSetPointRmp1Val_GCUR Rail_facSetPointRmpValX_AXIS /end DEF_CHARACTERISTIC
 /begin IN_MEASUREMENT CoEOM_facRmpVal Rail_pSetPointRgn Rail_stSetPointRgn Rail_stSetPointRmpSel /end IN_MEASUREMENT
 /begin LOC_MEASUREMENT Rail_facSetPointRmpVal_mp /end LOC_MEASUREMENT
/end FUNCTION
/begin FUNCTION Rail_RgnRls "" /begin DEF_CHARACTERISTIC Rail_stSetPointRgnMsk_CA Rail_stSetPointRmpSel_CA /end DEF_CHARACTERISTIC /begin IN_MEASUREMENT CoEOM_facRmpVal CoEOM_stOpModeAct CoEOM_stOpModeActTSync /end IN_MEASUREMENT /begin OUT_MEASUREMENT Rail_stEnvCorRgn Rail_stSetPointRgn Rail_stSetPointRmpSel /end OUT_MEASUREMENT /begin LOC_MEASUREMENT Rail_stActVal_mp Rail_stDesVal_mp /end LOC_MEASUREMENT /end FUNCTION
/begin FUNCTION Rail_SetPoint ""
 /begin DEF_CHARACTERISTIC Rail_dpSetPBase.Pos_C Rail_dpSetPBase.Neg_C Rail_dpSetPointDec_CUR Rail_dpSetPointInc_MAP Rail_pSetPBaseNoEGR_MAP Rail_pSetPointBaseStrt_MAP Rail_pSetPointBase_MAP Rail_pSetPointBattMin_CUR Rail_pSetPointInit_C Rail_pSetPointRed_C Rail_pSetPoint_C Rail_stRgnDelMsk_C Rail_stSetPointSel_C Rail_swtPSetPoint_C /end DEF_CHARACTERISTIC
 /begin IN_MEASUREMENT AirCtl_stMon BattU_u CoEng_st EngDem_stTrqLimErr Epm_nEng InjCtl_qCurr InjCtl_qSetUnBal RailP_pFlt Rail_pSetPointAddCor Rail_pSetPointEnvCor Rail_pSetPointEnvCorStrt Rail_pSetPointFlTempCor Rail_pSetPointLimNFlTemp Rail_pSetPointMax Rail_pSetPointMin Rail_pSetPointSubst Rail_stCtlLoop Rail_stCtlType Rail_stSetPointRgn /end IN_MEASUREMENT
 /begin OUT_MEASUREMENT Rail_dpSetPointDec Rail_dpSetPointInc Rail_pSetPoint /end OUT_MEASUREMENT
 /begin LOC_MEASUREMENT Rail_pSetPointBase_mp Rail_pSetPointBattMin_mp Rail_pSetPointCor_mp Rail_pSetPointDec_mp Rail_pSetPointFlTempLim_mp Rail_pSetPointFlTempRedLim Rail_pSetPointFlTempUnLim Rail_pSetPointInc_mp Rail_pSetPointLim_mp Rail_pSetPointOut_mp Rail_pSetPointZFCLim_mp Rail_pSetPointZFC_mp /end LOC_MEASUREMENT
/end FUNCTION
/begin FUNCTION Rail_SetPointAddCor ""
 /begin DEF_CHARACTERISTIC Rail_facAPPrSetPDynCor_CUR Rail_facAPSetPDynCor_CUR Rail_facDQSetPDynCor_CUR Rail_facEGRpSetPCor_CUR Rail_facETSetPDynCor_CUR Rail_facIASetPDynCor_CUR Rail_facIMTSpSetPCor_CUR Rail_facpSetPointVehCor_CUR Rail_facpSetPointVehTempCor_CUR Rail_facSetPointAPSCStrt_CUR Rail_facSetPointATSCStrt_CUR Rail_facSetPointETSCor1_CUR Rail_facSetPointETSCStrt_CUR Rail_facSetPointFTSCor_CUR Rail_pSetPDynCor_MAP Rail_pSetPEgrLPCor_MAP Rail_pSetPointAPSCStrt_MAP Rail_pSetPointATSCStrt_MAP Rail_pSetPointETSCor1_MAP Rail_pSetPointETSCStrt_MAP Rail_pSetPointFTSCor_MAP Rail_pSetPointLimNFlTemp_C Rail_pSetPointLimNFlTemp_MAP Rail_pSetPointMaxDef_C Rail_pSetPointMaxDef_CUR Rail_pSetPointMaxDef_MAP Rail_pSetPointMax_MAP Rail_pSetPointMinDef_C Rail_pSetPointMin_MAP Rail_pSetPointVehCor_MAP /end DEF_CHARACTERISTIC
 /begin IN_MEASUREMENT Air_tCACDs APP_r ASMod_mEGRIntMnfDsCmb CEngDsT_t CoEng_st CoEng_stTst EnvP_p Epm_nEng FuelT_t InjCrv_dqSetUnBalFltLim InjCtl_qCurr InjCtl_qSetUnBal InjSys_qTot InjSys_tEng Rail_stEnvCorRgn Rail_tAir VehV_v /end IN_MEASUREMENT
 /begin OUT_MEASUREMENT Rail_pSetPointAddCor Rail_pSetPointFlTempCor Rail_pSetPointLimNFlTemp Rail_pSetPointMax Rail_pSetPointMin /end OUT_MEASUREMENT
 /begin LOC_MEASUREMENT Rail_facAPPrSetPDynCor_mp Rail_facAPSetPDynCor_mp Rail_facDQSetPDynCor_mp Rail_facEgrpSetPCor_mp Rail_facETSetPDynCor_mp Rail_facIASetPDynCor_mp Rail_facIMTSpSetPCor_mp Rail_facSetPointAPSCStrt_mp Rail_facSetPointATSCStrt_mp Rail_facSetPointETSCor1_mp Rail_facSetPointETSCStrt_mp Rail_facSetPointFTSCor_mp Rail_pSetPDynCor_mp Rail_pSetPEgrLPCorBas_mp Rail_pSetPEgrLPCor_mp Rail_pSetPointEnvCorStrt Rail_pSetPointETSCor1_mp Rail_pSetPointVehCor_mp /end LOC_MEASUREMENT
/end FUNCTION
/begin FUNCTION Rail_SetPointAddCorRgn "" /begin OUT_MEASUREMENT Rail_pSetPointAddCorRgn /end OUT_MEASUREMENT /end FUNCTION
/begin FUNCTION Rail_SetPointEnvCor ""
 /begin DEF_CHARACTERISTIC Rail_pSetPointAPSCor_MAP Rail_pSetPointATSCor_MAP Rail_pSetPointETSCor_MAP /end DEF_CHARACTERISTIC
 /begin IN_MEASUREMENT Epm_nEng InjCtl_qCurr Rail_facSetPointAPSCor Rail_facSetPointATSCor Rail_facSetPointETSCor Rail_stEnvCorRgn /end IN_MEASUREMENT
 /begin OUT_MEASUREMENT Rail_pSetPointEnvCor /end OUT_MEASUREMENT
 /begin LOC_MEASUREMENT Rail_pSetPointAPSCor_mp Rail_pSetPointATSCor_mp Rail_pSetPointETSCor_mp /end LOC_MEASUREMENT
/end FUNCTION
/begin FUNCTION Rail_SetPointEnvCorRgn ""
 /begin DEF_CHARACTERISTIC Rail_pSetPointAPSCor0Rgn_GMAP Rail_pSetPointAPSCor1Rgn_GMAP Rail_pSetPointAPSCorRgnX_AXIS Rail_pSetPointAPSCorRgnY_AXIS Rail_pSetPointATSCor0Rgn_GMAP Rail_pSetPointATSCor1Rgn_GMAP Rail_pSetPointATSCorRgnX_AXIS Rail_pSetPointATSCorRgnY_AXIS Rail_pSetPointETSCor0Rgn_GMAP Rail_pSetPointETSCor1Rgn_GMAP Rail_pSetPointETSCorRgnX_AXIS Rail_pSetPointETSCorRgnY_AXIS /end DEF_CHARACTERISTIC
 /begin IN_MEASUREMENT Epm_nEng InjCtl_qCurr Rail_facSetPointAPSCorRgn Rail_facSetPointATSCorRgn Rail_facSetPointETSCorRgn Rail_stEnvCorRgn /end IN_MEASUREMENT
 /begin OUT_MEASUREMENT Rail_pSetPointEnvCorRgn /end OUT_MEASUREMENT
 /begin LOC_MEASUREMENT Rail_pSetPointAPSCorRgn_mp Rail_pSetPointATSCorRgn_mp Rail_pSetPointETSCorRgn_mp /end LOC_MEASUREMENT
/end FUNCTION
/begin FUNCTION Rail_SetPointEnvCorSlow ""
 /begin DEF_CHARACTERISTIC Rail_ctATSSel_C Rail_facSetPointAPSCor_CUR Rail_facSetPointATSCor_CUR Rail_facSetPointETSCor_CUR /end DEF_CHARACTERISTIC
 /begin IN_MEASUREMENT AirSys_tFld CACDsT_t EnvP_p InjSys_tEng /end IN_MEASUREMENT
 /begin OUT_MEASUREMENT Rail_facSetPointAPSCor Rail_facSetPointATSCor Rail_facSetPointETSCor /end OUT_MEASUREMENT
 /begin LOC_MEASUREMENT Rail_tAir /end LOC_MEASUREMENT
/end FUNCTION
/begin FUNCTION Rail_SetPointEnvCorSlowRgn ""
 /begin DEF_CHARACTERISTIC Rail_facSetPointAPSCor0Rgn_GCUR Rail_facSetPointAPSCor1Rgn_GCUR Rail_facSetPointAPSCorRgn_AXIS Rail_facSetPointATSCor0Rgn_GCUR Rail_facSetPointATSCor1Rgn_GCUR Rail_facSetPointATSCorRgn_AXIS Rail_facSetPointETSCor0Rgn_GCUR Rail_facSetPointETSCor1Rgn_GCUR Rail_facSetPointETSCorRgn_AXIS /end DEF_CHARACTERISTIC
 /begin IN_MEASUREMENT EnvP_p InjSys_tAirRgn InjSys_tEngRgn /end IN_MEASUREMENT
 /begin OUT_MEASUREMENT Rail_facSetPointAPSCorRgn Rail_facSetPointATSCorRgn Rail_facSetPointETSCorRgn /end OUT_MEASUREMENT
/end FUNCTION
/begin FUNCTION Rail_SetSubst ""
 /begin DEF_CHARACTERISTIC Rail_nEngSpdLim_C Rail_pMaxSetSubst_CUR Rail_pMinSetSubst_C Rail_qSetSubstLim_C Rail_tiMaxSetSubst_C Rail_vVehSpdLim_C /end DEF_CHARACTERISTIC
 /begin IN_MEASUREMENT Epm_nEng InjCtl_qSetUnBal Rail_stCtlLoop VehV_v /end IN_MEASUREMENT
 /begin OUT_MEASUREMENT Rail_pMaxSetSubst Rail_pSetPointSubst /end OUT_MEASUREMENT
 /begin LOC_MEASUREMENT Rail_stSetSubstCond_mp /end LOC_MEASUREMENT
/end FUNCTION
/begin FUNCTION Rail_TempLim ""
 /begin DEF_CHARACTERISTIC Rail_dtrqLimRmp.Pos_C Rail_dtrqLimRmp.Neg_C Rail_stTrqLimFlSysActv_C Rail_trqFlTempLimMeUn_MAP Rail_trqFlTempLimPCV_MAP /end DEF_CHARACTERISTIC
 /begin IN_MEASUREMENT Epm_nEng FuelT_t Rail_stCtlLoop /end IN_MEASUREMENT
 /begin OUT_MEASUREMENT Rail_trqLim /end OUT_MEASUREMENT
 /begin LOC_MEASUREMENT Rail_stTrqLim_mp /end LOC_MEASUREMENT
/end FUNCTION
/begin FUNCTION Rail_ZFCLib ""
 /begin DEF_CHARACTERISTIC Rail_pFltMinZFC_C Rail_pSetPointZFCMax_C Rail_pSetPointZFCMin_C Rail_rFltMinSlpZFC_C Rail_rZFCInitDwn_CUR Rail_rZFCInitUp_CUR Rail_tiZFCDemDel_C Rail_tiZFCPT1_C /end DEF_CHARACTERISTIC
 /begin IN_MEASUREMENT RailP_pFlt ZFC_pRailSetPoint_mp /end IN_MEASUREMENT
 /begin LOC_MEASUREMENT Rail_pZFCInit_mp Rail_stPresMinZFC_mp /end LOC_MEASUREMENT
/end FUNCTION
/begin FUNCTION Reg "" /end FUNCTION
/begin FUNCTION Reset "" /begin DEF_CHARACTERISTIC Reset_xGrpId_C Reset_xTrgId_C /end DEF_CHARACTERISTIC
 /begin OUT_MEASUREMENT Reset_Env.adLoc Reset_Env.xUserValue Reset_Env.xId Reset_Env.xGrp Reset_Env.ctRst Reset_xHistBuf /end OUT_MEASUREMENT
 /begin LOC_MEASUREMENT Reset_Env_adLoc_mp Reset_Env_xId_mp /end LOC_MEASUREMENT
/end FUNCTION
/begin FUNCTION RngMod_TrqCalc "" /begin DEF_CHARACTERISTIC RngMod_swtAcs_C /end DEF_CHARACTERISTIC
 /begin IN_MEASUREMENT CoVeh_trqAcs RngMod_trqLossComp RngMod_trqMax RngMod_trqMin /end IN_MEASUREMENT
 /begin OUT_MEASUREMENT RngMod_trqClthMax RngMod_trqClthMin RngMod_trqComp /end OUT_MEASUREMENT
/end FUNCTION
/begin FUNCTION RngMod_TrqFrcAdpt ""
 /begin DEF_CHARACTERISTIC RngMod_nLIDvtnMax_C RngMod_stHydConvMtd_C RngMod_T1FltAdap_C RngMod_tAdapMin_C RngMod_tiRelAdap_C RngMod_vLimTrans_C /end DEF_CHARACTERISTIC
 /begin IN_MEASUREMENT ACCtl_stOut ActMod_trqInr APP_r Conv_trqLd EngDa_tEng Epm_nEng HLSDem_nSetPLo RngMod_trqClthMin SpdGov_st Tra_numGear VehV_v /end IN_MEASUREMENT
 /begin OUT_MEASUREMENT RngMod_stAdap RngMod_trqLosAdap /end OUT_MEASUREMENT
 /begin LOC_MEASUREMENT RngMod_nLIDvtn_mp RngMod_stDrvState_mp RngMod_stGenRel_mp RngMod_stLIStat_mp RngMod_trqDiffAdap RngMod_trqFltACGear_mp RngMod_trqFltACNoGear_mp RngMod_trqFltNoACGear_mp RngMod_trqFltNoACNoGear_mp RngMod_trqLosCompl_mp RngMod_trqLosDiff_mp /end LOC_MEASUREMENT
/end FUNCTION
/begin FUNCTION RngMod_TrqFrcCalc ""
 /begin DEF_CHARACTERISTIC RngMod_numTrqFrc_C RngMod_stActvLossComp_C RngMod_stNormal_C RngMod_trqChExchLoss_MAP RngMod_trqFrcLd_MAP RngMod_trqFrc_MAP /end DEF_CHARACTERISTIC
 /begin IN_MEASUREMENT AFS_dm Air_pIntkVUs CoEOM_stOpModeAct Cpp_pCylAvrgAg1 Cpp_trqInrCorAvrg EngDa_tFld Epm_nEng InjSys_trqLoss /end IN_MEASUREMENT
 /begin OUT_MEASUREMENT RngMod_trqFrc RngMod_trqLossComp RngMod_trqMin /end OUT_MEASUREMENT
 /begin LOC_MEASUREMENT RngMod_trqChExchLoss_mp RngMod_trqFrcLd_mp RngMod_tTrqFrc_mp /end LOC_MEASUREMENT
/end FUNCTION
/begin FUNCTION RngMod_TrqSpdCrv "" /begin DEF_CHARACTERISTIC RngMod_swtAdj_C RngMod_trqSpd_MAP /end DEF_CHARACTERISTIC /begin IN_MEASUREMENT CodVar_stTrqClth EngDem_facAdj Epm_nEng /end IN_MEASUREMENT /begin OUT_MEASUREMENT RngMod_trqMax /end OUT_MEASUREMENT /end FUNCTION
/begin FUNCTION Rtmo "" /end FUNCTION
/begin FUNCTION SBAm160 "" /end FUNCTION
/begin FUNCTION SBAm320 "" /end FUNCTION
/begin FUNCTION SBCan "" /end FUNCTION
/begin FUNCTION SBCpu "" /end FUNCTION
/begin FUNCTION SBDlite "" /end FUNCTION
/begin FUNCTION SBFlash "" /end FUNCTION
/begin FUNCTION SBIfxFlash "" /end FUNCTION
/begin FUNCTION SBMain "" /end FUNCTION
/begin FUNCTION SBPOTest "" /end FUNCTION
/begin FUNCTION SBRBProg "" /end FUNCTION
/begin FUNCTION SBReset "" /end FUNCTION
/begin FUNCTION SBServices "" /end FUNCTION
/begin FUNCTION SBStm58 "" /end FUNCTION
/begin FUNCTION SBTarget "" /end FUNCTION
/begin FUNCTION SBTsw "" /end FUNCTION
/begin FUNCTION SCR ""
 /begin IN_MEASUREMENT BattU_facCor Com_pAbsUPmpP Com_rUTnkLvl Com_tUCatUsT Com_tUTnkT DevLib_stPwrStgEnaCond EnvP_p /end IN_MEASUREMENT
 /begin SUB_FUNCTION UPmpP UPmpMot URevVlv UCatUsT UDosVlv UTnkT UTnkLvl UHtrTnk UHtrPL /end SUB_FUNCTION
/end FUNCTION
/begin FUNCTION SCRAd ""
 /begin SUB_FUNCTION SCRAd_Plaus SCRAd_FillLvl SCRAd_NOxAdap SCRAd_Fltlogic SCRAd_SlipDet /end SUB_FUNCTION
/end FUNCTION
/begin FUNCTION SCRAd_FillLvl "" /begin DEF_CHARACTERISTIC SCRAd_facNH3LdRst_CUR SCRAd_tiTmrTrg_C /end DEF_CHARACTERISTIC /begin IN_MEASUREMENT DStgy_stAdap SCRAd_mNH3Cnv SCRLdG_mNH3LdNom /end IN_MEASUREMENT /begin OUT_MEASUREMENT SCRAd_stAdapReq /end OUT_MEASUREMENT
 /begin LOC_MEASUREMENT SCRAd_facNH3LdRst_mp SCRAd_mNH3LdRst SCRAd_stActvTrg_mp SCRAd_stAdapReq_mp SCRAd_stRstTrg_mp SCRAd_stStrtTrgActv_mp SCRAd_stStrtTrg_mp SCRAd_stTmrTrgRaw_mp SCRAd_stTmrTrg_mp SCRAd_tiTmrTrg_mp /end LOC_MEASUREMENT
/end FUNCTION
/begin FUNCTION SCRAd_Fltlogic ""
 /begin DEF_CHARACTERISTIC SCRAd_etaEst_C SCRAd_etaMinSlipActv_C SCRAd_rDeltaNOxSensDs_C SCRAd_rMinNOxSlipActv_C SCRAd_rTolcNOxCalc_CUR SCRAd_stActvFltMnl_C SCRAd_stNH3LdCodtInactv_C SCRAd_swtTestEnaFL_C SCRAd_tFld3_C SCRAd_tiDebFltEtaEst_C SCRAd_tiDebFltNOxSens_C SCRAd_tiDebFltTemp_C SCRAd_tiDebFltTolcNOx_C SCRAd_tiDebSlipActv_C SCRAd_tMinSlipActv_C /end DEF_CHARACTERISTIC
 /begin IN_MEASUREMENT Exh_rNOxNoCat2Ds SCRAd_rDeltaNOxSensDs SCRAd_stNH3LdCodtInactv SCRMod_etaEst SCRMod_rEstNOxDs SCRT_tFld /end IN_MEASUREMENT
 /begin OUT_MEASUREMENT SCRAd_stSlip /end OUT_MEASUREMENT
 /begin LOC_MEASUREMENT SCRAd_stEtaMinEst_mp SCRAd_stRatMinNOx_mp SCRAd_stRatTolcNOx_mp SCRAd_stSlipDetFlt_mp SCRAd_stTempMin_mp SCRAd_tAvrgFL_mp /end LOC_MEASUREMENT
/end FUNCTION
/begin FUNCTION SCRAd_NOxAdap ""
 /begin DEF_CHARACTERISTIC SCRAd_facLimAdapNgv_C SCRAd_facLimAdapPsv_C SCRAd_facMaxAdap_C SCRAd_facMinAdap_C SCRAd_facQtyCorrNgv_C SCRAd_facQtyCorrPsv_C SCRAd_facQtyInit_C SCRAd_mMaxNH3Cnv_C SCRAd_mMinNH3Cnv_C SCRAd_mNH3Cnv_C SCRAd_mskAdapNgv1_C SCRAd_mskAdapNgv2_C SCRAd_mskAdapPsv1_C SCRAd_mskAdapPsv2_C SCRAd_mskAdapRstReqNgv_C SCRAd_mskAdapRstReqPsv_C SCRAd_mskEFlPsv_C SCRAd_stAdapRstReq_C SCRAd_stEFlRst_C SCRAd_stTmrPlausExpi_C SCRAd_swtQtyAdapInit_C SCRAd_swtQtyAdap_C SCRAd_swtTestEna_C SCRAd_tiIniAdap_C SCRAd_tiIniEFl_C /end DEF_CHARACTERISTIC
 /begin IN_MEASUREMENT DStgy_stAdap SCRAd_stAdapRstReq SCRAd_stEFlRst SCRAd_stTmrPlausExpi SCRFFC_dmNH3Cnv /end IN_MEASUREMENT
 /begin OUT_MEASUREMENT SCRAd_facQtyAdap SCRAd_stQtyAdap /end OUT_MEASUREMENT
 /begin LOC_MEASUREMENT SCRAd_facQtyAdapRaw_mp SCRAd_facQtyAdap_mp SCRAd_stAdapRstReqNgv_mp SCRAd_stAdapRstReqPsv_mp SCRAd_stEEPROMRead SCRAd_stEEPROMWrite SCRAd_stEFlRstReqPsv_mp SCRAd_stQtyAdap_mp SCRAd_stQtyCorrNgv_mp SCRAd_stQtyCorrPsv_mp SCRAd_tiIniAdap_mp SCRAd_tiIniEFl_mp /end LOC_MEASUREMENT
/end FUNCTION
/begin FUNCTION SCRAd_Plaus ""
 /begin DEF_CHARACTERISTIC SCRAd_dmNH3Cnv_C SCRAd_dmNH3Curr_C SCRAd_dmNOxUs_C SCRAd_facKiNH3Cnv_C SCRAd_facKiNH3Curr_C SCRAd_facKiNOxUs_C SCRAd_facPlausCmp_CUR SCRAd_mEstNH3Ld_C SCRAd_mMaxPlausNH3Cnv_C SCRAd_mMaxPlausNH3Curr_C SCRAd_mMaxPlausNH3Us_C SCRAd_mMinPlausNH3Cnv_C SCRAd_mMinPlausNH3Curr_C SCRAd_mMinPlausNH3Us_C SCRAd_mNH3LdNom_C SCRAd_qCurrActDiffMax_C SCRAd_qCurrActDiffMin_C SCRAd_qCurr_C SCRAd_rDeltaNOxPosMax_CUR SCRAd_rMXNH3Ld_C SCRAd_rPlausDeltaNOxSensDs_C SCRAd_rPPMNOxUs_C SCRAd_stAdapReq_C SCRAd_stAdap_C SCRAd_swtDeltaNOx_C SCRAd_swtEFlLd_C SCRAd_swtEFlSens_C SCRAd_tiDeltaNOxDsFlt_C SCRAd_tiEFl_C SCRAd_tiNH3LdFault_C SCRAd_tiQCurrFlt_C SCRAd_tiQStatMin_C SCRAd_tiStp_C SCRAd_tiTmrCodt_C SCRAd_tiTmrPlaus_C SCRAd_tiVelFlt_C SCRAd_tiVelStatMin_C SCRAd_vActDiffMax_C SCRAd_vActDiffMin_C SCRAd_v_C /end DEF_CHARACTERISTIC
 /begin IN_MEASUREMENT DStgy_dmNH3Curr DStgy_stAdap InjCtl_qCurr SCRFFC_dmNH3Cnv SCRFFC_dmNOxUs SCRFFC_facNOxToNH3 SCRFFC_rPPMNOxUs SCRLdG_mNH3LdNom SCRMod_mEstNH3Ld VehV_v /end IN_MEASUREMENT
 /begin OUT_MEASUREMENT SCRAd_dmNH3Us SCRAd_facPlaus SCRAd_facPlaus_Fld SCRAd_mNH3Cnv SCRAd_mPlausNH3LdNom_Fld SCRAd_stAdapRstReq SCRAd_stEFlRst SCRAd_stNH3LdCodtInactv SCRAd_stTmrPlausExpi /end OUT_MEASUREMENT
 /begin LOC_MEASUREMENT SCRAd_facPlausCmp_mp SCRAd_facPlaus_mp SCRAd_mDiffNH3LdNom_mp SCRAd_mNH3Cnv_mp SCRAd_mNH3Us_mp SCRAd_mPlausNH3Curr_mp SCRAd_qCurrFlt_mp SCRAd_rDeltaNOxDsAct_mp SCRAd_rDeltaNOxDsFlt_mp SCRAd_rDeltaNOxDsPlaus_mp SCRAd_rDeltaNOxStrt_mp SCRAd_rDeltaPlausMax_mp SCRAd_realCurIn_mp SCRAd_stEFlRst_mp SCRAd_stPlausActv_mp SCRAd_stRlsQStat_mp SCRAd_stStp_mp SCRAd_stTmrPlausExpi_mp SCRAd_tiQStat_mp SCRAd_tiTmrCodt_mp SCRAd_tiTmrPlaus_mp SCRAd_tiVelStat_mp SCRAd_vFlt_mp /end LOC_MEASUREMENT
/end FUNCTION
/begin FUNCTION SCRAd_SlipDet ""
 /begin DEF_CHARACTERISTIC SCRAd_dmExhMnfDs_C SCRAd_facCnvNOxToNH3_C SCRAd_mNH3LdAdap_MAP SCRAd_numAvrgStrMax_C SCRAd_rEstNOxDs_C SCRAd_rNOxSensDs_C SCRAd_stSlip_C SCRAd_tFld2_C SCRAd_tiAvrgStrTrg_C /end DEF_CHARACTERISTIC
 /begin IN_MEASUREMENT ASMod_dmEGFld Exh_rNOxNoCat2Ds SCRMod_rEstNOxDs SCRT_tFld /end IN_MEASUREMENT
 /begin OUT_MEASUREMENT SCRAd_dmNH3Slip SCRAd_mNH3LdAdap SCRAd_rDeltaNOxSensDs /end OUT_MEASUREMENT
 /begin LOC_MEASUREMENT SCRAd_ctAvrgStr_mp SCRAd_dmNH3Slip_mp SCRAd_mAvrgStr_Fld SCRAd_mNH3LdAdapRaw_mp SCRAd_mNH3LdAdapSum_mp SCRAd_mNH3LdAdap_mp SCRAd_rDeltaNOxSensDs_mp SCRAd_tAvrg_mp SCRAd_tiAvrgStrTrg_mp /end LOC_MEASUREMENT
/end FUNCTION
/begin FUNCTION SCRChk "" /begin SUB_FUNCTION SCRChk_NOxEff /end SUB_FUNCTION /end FUNCTION
/begin FUNCTION SCRChk_NOxEff ""
 /begin DEF_CHARACTERISTIC SCRChk_ctCondDwn1_C SCRChk_ctCondDwn2_C SCRChk_ctCondMax1_C SCRChk_ctCondMax2_C SCRChk_ctCondStrt1_C SCRChk_ctCondStrt2_C SCRChk_ctCondUp1_CUR SCRChk_ctCondUp2_CUR SCRChk_dmExhMax1_C SCRChk_dmExhMax2_C SCRChk_dmExhMin1_C SCRChk_dmExhMin2_C SCRChk_etaActMax_C SCRChk_etaActMin_C SCRChk_etaThresExt_C SCRChk_etaThresMax_C SCRChk_etaThresMinActv1_C SCRChk_etaThresMinActv2_C SCRChk_etaThresMin_C SCRChk_etaThresTemp1_CUR SCRChk_etaThresTemp2_CUR SCRChk_facEtaCor1_C SCRChk_facEtaCor2_C SCRChk_facEtaEstMul1_C SCRChk_facEtaEstMul2_C SCRChk_facEtaEstOfs1_C SCRChk_facEtaEstOfs2_C SCRChk_facEtaThresExh1_CUR SCRChk_facEtaThresExh2_CUR SCRChk_facEtaThresExt_C SCRChk_facEtaThresNOx1_CUR SCRChk_facEtaThresNOx2_CUR SCRChk_mNOxUsMin1_C SCRChk_mNOxUsMin2_C SCRChk_rPPMNOxUsMax1_C SCRChk_rPPMNOxUsMax2_C SCRChk_rPPMNOxUsMin1_C SCRChk_rPPMNOxUsMin2_C SCRChk_stEtaEnaExt_C SCRChk_stEtaRstExt_C SCRChk_swtEtaEnaMetStgy_C SCRChk_swtEtaEnaWiRst_C SCRChk_swtEtaRstExtEna_C SCRChk_swtEtaThresSel_C SCRChk_tiDdTNOxEff_CUR SCRChk_tiDlyMaxCalcEta1_C SCRChk_tiDlyMaxCalcEta2_C SCRChk_tiEtaEnaExtDly_C SCRChk_tiEtaEnaFIdDly_C SCRChk_tiFltNOxEff_C SCRChk_tiNOxSensDsDly_C SCRChk_tRngMax1_C SCRChk_tRngMax2_C SCRChk_tRngMin1_C SCRChk_tRngMin2_C /end DEF_CHARACTERISTIC
 /begin IN_MEASUREMENT ASMod_dmEGFld DStgy_stMetStgy Exh_dmNOxNoCat2Ds Exh_stNOxNoCat2Ds SCRFFC_dmNOxUs SCRFFC_rPPMNOxUs SCRMod_etaEst SCRT_tFld /end IN_MEASUREMENT
 /begin OUT_MEASUREMENT SCRChk_tSCRAvrg /end OUT_MEASUREMENT
 /begin LOC_MEASUREMENT SCRChk_ctCondUp1_mp SCRChk_ctCondUp2_mp SCRChk_ctEtaCalc1_mp SCRChk_ctEtaCalc2_mp SCRChk_ctEtaCond1_mp SCRChk_ctEtaCond2_mp SCRChk_dmExhFlt_mp SCRChk_dmExh_mp SCRChk_dmNOxDsItg_mp SCRChk_dmNOxDsPre_mp SCRChk_dmNOxDsThresItg_mp SCRChk_dmNOxDsThresPre_mp SCRChk_dmNOxSensDsFlt_mp SCRChk_dmNOxUsAvrg1_mp SCRChk_dmNOxUsAvrg2_mp SCRChk_dmNOxUsFltDdT_mp SCRChk_dmNOxUsFlt_mp SCRChk_dmNOxUsItg_mp SCRChk_dmNOxUsPre_mp SCRChk_dmNOxUsToS16_mp SCRChk_etaActAvrg1_mp SCRChk_etaActAvrg2_mp SCRChk_etaEstFlt_mp SCRChk_etaThres1_mp SCRChk_etaThres2_mp SCRChk_etaThresAvrg1_mp SCRChk_etaThresAvrg2_mp SCRChk_etaThresExtFlt_mp SCRChk_etaThresExt_mp SCRChk_etaThresTemp1_mp SCRChk_etaThresTemp2_mp SCRChk_facEtaThresExh1_mp SCRChk_facEtaThresExh2_mp SCRChk_facEtaThresExtFlt_mp SCRChk_facEtaThresExt_mp SCRChk_facEtaThresNOx1_mp SCRChk_facEtaThresNOx2_mp SCRChk_mNOxDsPre_mp SCRChk_mNOxDsThresPre_mp SCRChk_mNOxDsThres_mp SCRChk_mNOxDs_mp SCRChk_mNOxUsPre_mp SCRChk_mNOxUs_mp SCRChk_rPPMNOxUsFltDdT_mp SCRChk_rPPMNOxUsFlt_mp SCRChk_stEtaCalcNew1_mp SCRChk_stEtaCalcNew2_mp SCRChk_stEtaCalc_mp SCRChk_stEtaCond_mp SCRChk_stEtaEnaExtDly_mp SCRChk_stEtaEnaExt_mp SCRChk_stEtaEnaFIdDly_mp SCRChk_stEtaEna_mp SCRChk_stEtaErr1_mp SCRChk_stEtaErr2_mp SCRChk_stEtaErrTrigDeb1_mp SCRChk_stEtaErrTrigDeb2_mp SCRChk_stEtaRstCalc_mp SCRChk_stEtaRstExt_mp SCRChk_stEtaRst_mp SCRChk_stEtaStM1_mp SCRChk_stEtaStM2_mp SCRChk_stMsNOxUsMin_mp SCRChk_stNOxSensDsDly_mp SCRChk_tiDdTNOxEff_mp SCRChk_tiNOxItgAvrg1_mp SCRChk_tiNOxItgAvrg2_mp SCRChk_tiNOxItgPre_mp SCRChk_tiNOxItg_mp SCRChk_tSCRFlt_mp /end LOC_MEASUREMENT
/end FUNCTION
/begin FUNCTION SCRCon "" /end FUNCTION
/begin FUNCTION SCRCtl "" /begin REF_CHARACTERISTIC SCRMon_swtDSMDis_C /end REF_CHARACTERISTIC
 /begin IN_MEASUREMENT ASMod_dmEGFld ASMod_rNOxEGFld ASMod_tWallFld BattU_u CoEng_tiNormal CoEOM_stOpModeActTSync CoSCR_st CoSCR_stSub CoSCR_tiAftrunTempWait CoSCR_tiPresBuildUp CoSCR_tiPresRdc CoSCR_tiReFl CoSCR_tiStBy CoSCR_tiVtln EnvT_t Epm_nEng Exh_dmNOxNoCat2Ds Exh_rNOxNoCat2Ds Exh_stNOxNoCat2Ds Exh_tFld Exh_tPFltDs InjCtl_qCurr LSU_rLam SCRCtl_stMetMod SCRMon_stPresBuildUp SCR_pFltUPmpP SCR_pUPmpP SCR_rUTnkLvl SCR_tUCatUsT SCR_tUTnkT SyC_stT15 UDosVlv_rDyc UDosVlv_rPs UDosVlv_tiPer UHtrPL_st UHtrPL_stPs UHtrTnk_st UPmpMot_r UPmpMot_rPs URevVlv_st VehV_v /end IN_MEASUREMENT
 /begin SUB_FUNCTION DStgy CoSCR UDC PPC UHC SCRPOD SCRCtl_Srv SCRCtl_AxisPoints SCRCtl_AxisPointsCust /end SUB_FUNCTION
/end FUNCTION
/begin FUNCTION SCRCtl_AxisPoints "" /end FUNCTION
/begin FUNCTION SCRCtl_AxisPointsCust "" /end FUNCTION
/begin FUNCTION SCRCtl_Srv "" /end FUNCTION
/begin FUNCTION SCRFFC "" /begin SUB_FUNCTION SCRFFC_Main SCRFFC_CnvNOxUs /end SUB_FUNCTION /end FUNCTION
/begin FUNCTION SCRFFC_CnvNOxUs ""
 /begin DEF_CHARACTERISTIC SCRFFC_facMolMsEG_CUR SCRFFC_facMolMsNOx_C SCRFFC_facUnCnvConc_C SCRFFC_facUnCnvMFl_C SCRFFC_facUnCnvNOxUs_C SCRFFC_rLamFldSel_C /end DEF_CHARACTERISTIC
 /begin IN_MEASUREMENT ASMod_dmEGFld ASMod_rNOxEGFld LSU_rLam /end IN_MEASUREMENT
 /begin OUT_MEASUREMENT SCRFFC_dmNOxUs SCRFFC_rMolMs SCRFFC_rPPMNOxUs /end OUT_MEASUREMENT
 /begin LOC_MEASUREMENT SCRFFC_dmEG_mp SCRFFC_facMolMsEG_mp SCRFFC_LSUrLam_mp SCRFFC_rNOxEG_mp /end LOC_MEASUREMENT
/end FUNCTION
/begin FUNCTION SCRFFC_Main ""
 /begin DEF_CHARACTERISTIC SCRFFC_facNOxToNH3PEnv_CUR SCRFFC_facNOxToNH3POp_MAP SCRFFC_facNOxToNH3TEnv_CUR SCRFFC_facNOxToNH3_MAP /end DEF_CHARACTERISTIC
 /begin IN_MEASUREMENT EnvP_p EnvT_t Epm_nEng InjCtl_qSetUnBal SCRFFC_dmNOxUs SCRMod_etaEst SCRMod_rNO2NOx SCRT_tFld /end IN_MEASUREMENT
 /begin OUT_MEASUREMENT SCRFFC_dmNH3Cnv SCRFFC_facNOxToNH3 /end OUT_MEASUREMENT
 /begin LOC_MEASUREMENT SCRFFC_dmNH3FdRat1_mp SCRFFC_facNOxToNH3PEnv_mp SCRFFC_facNOxToNH3POp_mp SCRFFC_facNOxToNH3TEnv_mp SCRFFC_facNOxToNH3_mp SCRFFC_tAvrg_mp /end LOC_MEASUREMENT
/end FUNCTION
/begin FUNCTION SCRLdG "" /begin SUB_FUNCTION SCRLdG_Main /end SUB_FUNCTION /end FUNCTION
/begin FUNCTION SCRLdG_Main ""
 /begin DEF_CHARACTERISTIC DStgy_stMetStgy_C SCRAd_facQtyAdap_C SCRFFC_dmNH3Cnv_C SCRLdG_dmMaxCor_C SCRLdG_dmMinCor_C SCRLdG_dmNH3LdGov_CUR SCRLdG_facDynCor_MAP SCRLdG_facNH3LdOp_MAP SCRLdG_facNH3LdPEnv_CUR SCRLdG_facNH3LdPTEnv_CUR SCRLdG_mNH3LdNomTemp_CUR SCRLdG_mNH3LdNom_C SCRLdG_swtDynCorEna_C SCRLdG_swtNH3LdGovEna_C SCRLdG_swtNH3LdNomMnl_C SCRMod_mEstNH3Ld_C SCRT_tFld_C /end DEF_CHARACTERISTIC
 /begin IN_MEASUREMENT ASMod_dmEGFld DStgy_stMetStgy EnvP_p EnvT_t Epm_nEng InjCtl_qSetUnBal SCRAd_facQtyAdap SCRFFC_dmNH3Cnv SCRMod_mEstNH3Ld SCRT_tFld /end IN_MEASUREMENT
 /begin OUT_MEASUREMENT SCRLdG_dmNH3LdGov SCRLdG_dmNH3MetAdap SCRLdG_mNH3LdDvt SCRLdG_mNH3LdNom /end OUT_MEASUREMENT
 /begin LOC_MEASUREMENT SCRLdG_dmExhEGFld_mp SCRLdG_dmNH3LdGov_mp SCRLdG_dmNH3_mp SCRLdG_facDynCor_mp SCRLdG_facNH3LdPEnv_mp SCRLdG_facNH3LdPOp_mp SCRLdG_facNH3LdPTEnv_mp SCRLdG_mHH3LdNomTemp_mp SCRLdG_mNH3LdDvt_mp SCRLdG_mNH3LdNom_mp SCRLdG_tSCRAvrg_mp /end LOC_MEASUREMENT
/end FUNCTION
/begin FUNCTION SCRMod ""
 /begin SUB_FUNCTION SCRMod_WallFlm SCRMod_Bal SCRMod_NH3Ld SCRMod_Eff SCRMod_Age /end SUB_FUNCTION
/end FUNCTION
/begin FUNCTION SCRMod_Age ""
 /begin DEF_CHARACTERISTIC SCRMod_facEffOxiAge_CUR SCRMod_facEffSCRAge_CUR SCRMod_facTempOxiAge_CUR SCRMod_facTempSCRAge_CUR /end DEF_CHARACTERISTIC
 /begin REF_CHARACTERISTIC DStgy_numPosOxi_C /end REF_CHARACTERISTIC
 /begin IN_MEASUREMENT Exh_tFld SCRMod_stEEPROMWrite SCRMod_tAvrg_mp SCRMod_tOxiCat_mp SCRT_tFld /end IN_MEASUREMENT
 /begin OUT_MEASUREMENT SCRMod_facEffOxiAge SCRMod_facEffSCRAge /end OUT_MEASUREMENT
 /begin LOC_MEASUREMENT SCRMod_facEffOxiAge_mp SCRMod_facEffSCRAge_mp SCRMod_facTempOxiAge_mp SCRMod_facTempOxiTot_mp SCRMod_facTempSCRAge_mp SCRMod_facTempSCRTot_mp /end LOC_MEASUREMENT
/end FUNCTION
/begin FUNCTION SCRMod_Bal "" /begin REF_CHARACTERISTIC DStgy_numPosSCRUs_C DStgy_numPosStoich_C /end REF_CHARACTERISTIC /begin IN_MEASUREMENT DStgy_dmNH3Curr SCRFFC_dmNH3Cnv /end IN_MEASUREMENT /begin LOC_MEASUREMENT SCRMod_dmNH3Ld SCRMod_dmNH3Ld_mp /end LOC_MEASUREMENT /end FUNCTION
/begin COMPU_METHOD AirMassPerCyl "" RAT_FUNC "%5.1" "mg/Hub" COEFFS 0 10 0 0 0 1 /end COMPU_METHOD
/begin COMPU_METHOD AirMassPerTime "" RAT_FUNC "%5.1" "Kg/h" COEFFS 0 10 0 0 0 1 /end COMPU_METHOD
/begin COMPU_METHOD AirTempFldSel "" TAB_VERB "%6.3" "" COMPU_TAB_REF AirTempFldSel /end COMPU_METHOD
/begin COMPU_VTAB AirTempFldSel "" TAB_VERB 4 0 "Air_tCACDs" 1 "Air_tAFS" 2 "EnvT_t" 3 "Air_tAFSCorr" /end COMPU_VTAB
/begin COMPU_METHOD CoEOMSwt_S16 "" RAT_FUNC "%7.6" "-" COEFFS 0 16384 0 0 0 1 /end COMPU_METHOD
/begin COMPU_METHOD COEOM_PCRCTLAUTLPQNTNUMMAP_SY_Compu "" TAB_NOINTP "%6.3" "" COMPU_TAB_REF COEOM_PCRCTLAUTLPQNTNUMMAP_SY_Compu /end COMPU_METHOD
/begin COMPU_TAB COEOM_PCRCTLAUTLPQNTNUMMAP_SY_Compu "" TAB_NOINTP 8 0 0 1 1 2 2 3 3 4 4 5 5 6 6 7 7 /end COMPU_TAB
/begin COMPU_METHOD COEOM_PCRCTLAUTLPTRQNUMMAP_SY_Compu "" TAB_NOINTP "%6.3" "" COMPU_TAB_REF COEOM_PCRCTLAUTLPTRQNUMMAP_SY_Compu /end COMPU_METHOD
/begin COMPU_TAB COEOM_PCRCTLAUTLPTRQNUMMAP_SY_Compu "" TAB_NOINTP 8 0 0 1 1 2 2 3 3 4 4 5 5 6 6 7 7 /end COMPU_TAB
/begin COMPU_METHOD CylPres "" RAT_FUNC "%6.4" "bar" COEFFS 0 100 0 0 0 1 /end COMPU_METHOD
/begin COMPU_METHOD EngN "" RAT_FUNC "%5.1" "rpm" COEFFS 0 2 0 0 0 1 /end COMPU_METHOD
/begin COMPU_METHOD EngTempFldSel "" TAB_VERB "%6.3" "" COMPU_TAB_REF EngTempFldSel /end COMPU_METHOD
/begin COMPU_VTAB EngTempFldSel "" TAB_VERB 4 0 "Coolant_Temperature" 1 "Oil_Temperature" 2 "EngDa_tEng" 3 "Chamberwall_Temperature" /end COMPU_VTAB
/begin COMPU_METHOD Fact "" RAT_FUNC "%6.5" "-" COEFFS 0 8192 0 0 0 1 /end COMPU_METHOD
/begin COMPU_METHOD Fact100 "" RAT_FUNC "%6.4" "-" COEFFS 0 100 0 0 0 1 /end COMPU_METHOD
/begin COMPU_METHOD INJCRV_MSK_VERB "" TAB_VERB "%6.3" "-" COMPU_TAB_REF INJCRV_MSK_VERB /end COMPU_METHOD
/begin COMPU_VTAB INJCRV_MSK_VERB "" TAB_VERB 8 0 "NRM" 1 "MSK0" 2 "MSK1" 3 "MSK2" 4 "MSK3" 5 "MSK4" 6 "MSK5" 7 "MSK6" /end COMPU_VTAB
/begin COMPU_METHOD INJCRV_RMP_VERB "" TAB_VERB "%6.3" "-" COMPU_TAB_REF INJCRV_RMP_VERB /end COMPU_METHOD
/begin COMPU_VTAB INJCRV_RMP_VERB "" TAB_VERB 7 1 "RMP1" 2 "RMP2" 3 "RMP3" 4 "RMP4" 5 "RMP5" 6 "RMP6" 7 "RMP7" /end COMPU_VTAB
/begin COMPU_METHOD InjMass "" RAT_FUNC "%5.2" "mg/hub" COEFFS 0 100 0 0 0 1 /end COMPU_METHOD
/begin COMPU_METHOD InjMassCyc "" RAT_FUNC "%5.2" "mg/cyc" COEFFS 0 100 0 0 0 1 /end COMPU_METHOD
/begin COMPU_METHOD InjMassPerSec_20ms "" RAT_FUNC "%6.3" "mg/hub/s" COEFFS 0 2 0 0 0 1 /end COMPU_METHOD
/begin COMPU_METHOD InjQntInj "" RAT_FUNC "%5.2" "mm^3/inj" COEFFS 0 100 0 0 0 1 /end COMPU_METHOD
/begin COMPU_METHOD InjTime_us "" RAT_FUNC "%5.1" "us" COEFFS 0 2.5 0 0 0 1 /end COMPU_METHOD
/begin COMPU_METHOD lambda "" RAT_FUNC "%4.3" "-" COEFFS 0 1000 0 0 0 1 /end COMPU_METHOD
/begin COMPU_METHOD Length "" RAT_FUNC "%6.2" "m" COEFFS 0 1 0 0 0 1 /end COMPU_METHOD
/begin COMPU_METHOD Mass "" RAT_FUNC "%6.2" "" COEFFS 0 1 0 0 0 1 /end COMPU_METHOD
/begin COMPU_METHOD nox "" RAT_FUNC "%6.2" "ppm" COEFFS 0 1 0 0 0 1 /end COMPU_METHOD
/begin COMPU_METHOD OneToOne "" RAT_FUNC "%6.0" "-" COEFFS 0 1 0 0 0 1 /end COMPU_METHOD
/begin COMPU_METHOD Prc "" RAT_FUNC "%6.4" "%" COEFFS 0 81.92 0 0 0 1 /end COMPU_METHOD
/begin COMPU_METHOD PresRail_sec "" RAT_FUNC "%4.3" "bar/s" COEFFS 0 2.500000 0 0 0 1 /end COMPU_METHOD
/begin COMPU_METHOD Pres_hPa "" RAT_FUNC "%5.1" "hPa" COEFFS 0 1 0 0 0 1 /end COMPU_METHOD
/begin COMPU_METHOD Pres_Rail "" RAT_FUNC "%5.1" "bar" COEFFS 0 10.000000 0 0 0 1 /end COMPU_METHOD
/begin COMPU_METHOD Qp_mm3_sec "" RAT_FUNC "%6.1" "mm3/s" COEFFS 0 0.1 0 0 0 1 /end COMPU_METHOD
/begin COMPU_METHOD RatNOxMass "" RAT_FUNC "%10.9" "-" COEFFS 0 10000000 0 0 0 1 /end COMPU_METHOD
/begin COMPU_METHOD RmpPres_Rail "" RAT_FUNC "%6.2" "hPa/s" COEFFS 0 0.65536 0 0 0 1 /end COMPU_METHOD
/begin COMPU_METHOD RmpTrq "" RAT_FUNC "%6.4" "Nm/s" COEFFS 0 655.36 0 0 0 1 /end COMPU_METHOD
/begin COMPU_METHOD SCRAd_Compu_Switch_1 "" TAB_VERB "%6.3" "" COMPU_TAB_REF SCRAd_Compu_Switch_1 /end COMPU_METHOD
/begin COMPU_VTAB SCRAd_Compu_Switch_1 "" TAB_VERB 2 0 "GESPERRT" 1 "FS ERHÖHEN" /end COMPU_VTAB
/begin COMPU_METHOD SCRAd_Compu_Switch_2 "" TAB_VERB "%6.3" "" COMPU_TAB_REF SCRAd_Compu_Switch_2 /end COMPU_METHOD
/begin COMPU_VTAB SCRAd_Compu_Switch_2 "" TAB_VERB 2 0 "GESPERRT" 1 "FREIGEGEBEN" /end COMPU_VTAB
/begin COMPU_METHOD SCRAd_Compu_Switch_3 "" TAB_VERB "%6.3" "" COMPU_TAB_REF SCRAd_Compu_Switch_3 /end COMPU_METHOD
/begin COMPU_VTAB SCRAd_Compu_Switch_3 "" TAB_VERB 2 0 "INAKTIV" 1 "AKTIV" /end COMPU_VTAB
/begin COMPU_METHOD SCRChk_Compu_EffVal "" TAB_VERB "%6.3" "" COMPU_TAB_REF SCRChk_Compu_EffVal /end COMPU_METHOD
/begin COMPU_VTAB SCRChk_Compu_EffVal "" TAB_VERB 2 0 "old efficiency value" 1 "new efficiency value" DEFAULT_VALUE "unknown" /end COMPU_VTAB
/begin COMPU_METHOD SCRChk_Compu_Fulfilled "" TAB_VERB "%6.3" "" COMPU_TAB_REF SCRChk_Compu_Fulfilled /end COMPU_METHOD
/begin COMPU_VTAB SCRChk_Compu_Fulfilled "" TAB_VERB 2 0 "not fulfilled" 1 "fulfilled" DEFAULT_VALUE "unknown" /end COMPU_VTAB
/begin COMPU_METHOD SCRChk_Compu_stErr "" TAB_VERB "%6.3" "" COMPU_TAB_REF SCRChk_Compu_stErr /end COMPU_METHOD
/begin COMPU_VTAB SCRChk_Compu_stErr "" TAB_VERB 2 0 "SCR sufficient efficiency" 1 "SCR efficiency too low" DEFAULT_VALUE "unknown" /end COMPU_VTAB
/begin COMPU_METHOD SCRChk_Compu_StM "" TAB_VERB "%6.3" "" COMPU_TAB_REF SCRChk_Compu_StM /end COMPU_METHOD
/begin COMPU_VTAB SCRChk_Compu_StM "" TAB_VERB 5 0 "Start" 1 "PreSum" 2 "MainSum" 3 "CalcEta" 4 "Reset" DEFAULT_VALUE "unknown" /end COMPU_VTAB
/begin COMPU_METHOD SCRChk_Compu_stNOxDly "" TAB_VERB "%6.3" "" COMPU_TAB_REF SCRChk_Compu_stNOxDly /end COMPU_METHOD
/begin COMPU_VTAB SCRChk_Compu_stNOxDly "" TAB_VERB 2 0 "not ready" 1 "ready" DEFAULT_VALUE "unknown" /end COMPU_VTAB
/begin COMPU_METHOD SCRChk_Compu_Switch_1 "" TAB_VERB "%6.3" "" COMPU_TAB_REF SCRChk_Compu_Switch_1 /end COMPU_METHOD
/begin COMPU_VTAB SCRChk_Compu_Switch_1 "" TAB_VERB 2 0 "disable" 1 "enable" DEFAULT_VALUE "unknown" /end COMPU_VTAB
/begin COMPU_METHOD SCRChk_Compu_Switch_2 "" TAB_VERB "%6.3" "" COMPU_TAB_REF SCRChk_Compu_Switch_2 /end COMPU_METHOD
/begin COMPU_VTAB SCRChk_Compu_Switch_2 "" TAB_VERB 2 0 "SCRChk_stEnaExt" 1 "DStgy_stMetStgy" DEFAULT_VALUE "unknown" /end COMPU_VTAB
/begin COMPU_METHOD SCRChk_Compu_Switch_3 "" TAB_VERB "%6.3" "" COMPU_TAB_REF SCRChk_Compu_Switch_3 /end COMPU_METHOD
/begin COMPU_VTAB SCRChk_Compu_Switch_3 "" TAB_VERB 3 0 "Internal Treshold" 1 "EtaEst dependend treshold" 2 "External treshold" DEFAULT_VALUE "unknown" /end COMPU_VTAB
/begin COMPU_METHOD SCRChk_Compu_Threshold "" TAB_VERB "%6.3" "" COMPU_TAB_REF SCRChk_Compu_Threshold /end COMPU_METHOD
/begin COMPU_VTAB SCRChk_Compu_Threshold "" TAB_VERB 2 0 "NOx mass below threshold" 1 "NOx mass exceeds threshold" DEFAULT_VALUE "unknown" /end COMPU_VTAB
/begin COMPU_METHOD SCRLdG_Switch_1 "" TAB_VERB "%6.3" "" COMPU_TAB_REF SCRLdG_Switch_1 /end COMPU_METHOD
/begin COMPU_VTAB SCRLdG_Switch_1 "" TAB_VERB 2 0 "SCRLDG_CURVE" 1 "SCRLDG_LABEL" /end COMPU_VTAB
/begin COMPU_METHOD SCR_Dm005 "" RAT_FUNC "%6.4" "mg/s" COEFFS 0 20 0 0 0 1 /end COMPU_METHOD
/begin COMPU_METHOD SCR_Dm01 "" RAT_FUNC "%6.3" "mg/s" COEFFS 0 10 0 0 0 1 /end COMPU_METHOD
/begin COMPU_METHOD SCR_dmNH3_mg_p_s "" RAT_FUNC "%6.4" "mg/s" COEFFS 0 20 0 0 0 1 /end COMPU_METHOD
/begin COMPU_METHOD SCR_dmNOx_mg_p_s "" RAT_FUNC "%6.5" "mg/s" COEFFS 0 1000 0 0 0 1 /end COMPU_METHOD
/begin COMPU_METHOD SCR_Fact10 "" RAT_FUNC "%6.3" "" COEFFS 0 10 0 0 0 1 /end COMPU_METHOD
/begin COMPU_METHOD SCR_Fact100 "" RAT_FUNC "%6.4" "" COEFFS 0 100 0 0 0 1 /end COMPU_METHOD
/begin COMPU_METHOD SCR_Fact1000 "" RAT_FUNC "%6.5" "" COEFFS 0 1000 0 0 0 1 /end COMPU_METHOD
/begin COMPU_METHOD SCR_Fact1000000 "" RAT_FUNC "%9.8" "" COEFFS 0 1000000 0 0 0 1 /end COMPU_METHOD
/begin COMPU_METHOD SCR_Fact1E6 "" RAT_FUNC "%9.8" "" COEFFS 0 1000000 0 0 0 1 /end COMPU_METHOD
/begin COMPU_METHOD SCR_Fac_g_p_Mol "" RAT_FUNC "%6.4" "g/Mol" COEFFS 0 100 0 0 0 1 /end COMPU_METHOD
/begin COMPU_METHOD SCR_Mass100 "" RAT_FUNC "%6.4" "g" COEFFS 0 100 0 0 0 1 /end COMPU_METHOD
/begin COMPU_METHOD SCR_Mass1000 "" RAT_FUNC "%6.5" "g" COEFFS 0 1000 0 0 0 1 /end COMPU_METHOD
/begin COMPU_METHOD SCR_Mass10000 "" RAT_FUNC "%7.6" "g" COEFFS 0 10000 0 0 0 1 /end COMPU_METHOD
/begin COMPU_METHOD SCR_Rat1 "" RAT_FUNC "%6.2" "ppm" COEFFS 0 1 0 0 0 1 /end COMPU_METHOD
/begin COMPU_METHOD SCR_Time10 "" RAT_FUNC "%6.3" "s" COEFFS 0 10 0 0 0 1 /end COMPU_METHOD
/begin COMPU_METHOD SCR_Time100 "" RAT_FUNC "%6.4" "s" COEFFS 0 100 0 0 0 1 /end COMPU_METHOD
/begin COMPU_METHOD Temp_Cels "" RAT_FUNC "%5.1" "deg C" COEFFS 0 10 2731.4 0 0 1 /end COMPU_METHOD
/begin COMPU_METHOD TimeDelay_ms "" RAT_FUNC "%12.1" "ms" COEFFS 0 0 1 0 2.3283064365387e-007 0 /end COMPU_METHOD
/begin COMPU_METHOD TimeDelay_s "" RAT_FUNC "%12.4" "s" COEFFS 0 0 1 0 0.00023283064365387 0 /end COMPU_METHOD
/begin COMPU_METHOD Time_ms "" RAT_FUNC "%5.0" "ms" COEFFS 0 0.1 0 0 0 1 /end COMPU_METHOD
/begin COMPU_METHOD Trq "" RAT_FUNC "%5.1" "Nm" COEFFS 0 10 0 0 0 1 /end COMPU_METHOD
/begin COMPU_METHOD Vel "" RAT_FUNC "%5.2" "km/h" COEFFS 0 100 0 0 0 1 /end COMPU_METHOD
/begin COMPU_METHOD Volt_Batt "" RAT_FUNC "%5.0" "mV" COEFFS 0 0.05 0 0 0 1 /end COMPU_METHOD
/begin RECORD_LAYOUT Axis_Xs16 NO_AXIS_PTS_X 1 SWORD AXIS_PTS_X 2 SWORD INDEX_INCR DIRECT /end RECORD_LAYOUT
/begin RECORD_LAYOUT CurG_Ws16 FNC_VALUES 1 SWORD COLUMN_DIR DIRECT /end RECORD_LAYOUT
/begin RECORD_LAYOUT Cur_Xr32Wr32 NO_AXIS_PTS_X 1 SLONG AXIS_PTS_X 2 FLOAT32_IEEE INDEX_INCR DIRECT FNC_VALUES 3 FLOAT32_IEEE COLUMN_DIR DIRECT /end RECORD_LAYOUT
/begin RECORD_LAYOUT Cur_Xs16Ws16 NO_AXIS_PTS_X 1 SWORD AXIS_PTS_X 2 SWORD INDEX_INCR DIRECT FNC_VALUES 3 SWORD COLUMN_DIR DIRECT /end RECORD_LAYOUT
/begin RECORD_LAYOUT Kl_Xs16_Ws16 NO_AXIS_PTS_X 1 SWORD AXIS_PTS_X 2 SWORD INDEX_INCR DIRECT FNC_VALUES 3 SWORD COLUMN_DIR DIRECT /end RECORD_LAYOUT
/begin RECORD_LAYOUT Kw_Ws32 FNC_VALUES 1 SLONG COLUMN_DIR DIRECT /end RECORD_LAYOUT
/begin RECORD_LAYOUT MapG_Ws16 FNC_VALUES 1 SWORD COLUMN_DIR DIRECT /end RECORD_LAYOUT
/begin RECORD_LAYOUT Map_Xs16Ys16Ws16 NO_AXIS_PTS_X 1 SWORD NO_AXIS_PTS_Y 2 SWORD AXIS_PTS_X 3 SWORD INDEX_INCR DIRECT AXIS_PTS_Y 4 SWORD INDEX_INCR DIRECT FNC_VALUES 5 SWORD COLUMN_DIR DIRECT /end RECORD_LAYOUT
/begin RECORD_LAYOUT Map_Xu8Yu8Wu8 NO_AXIS_PTS_X 1 UBYTE NO_AXIS_PTS_Y 2 UBYTE AXIS_PTS_X 3 UBYTE INDEX_INCR DIRECT AXIS_PTS_Y 4 UBYTE INDEX_INCR DIRECT FNC_VALUES 5 UBYTE COLUMN_DIR DIRECT /end RECORD_LAYOUT
/begin RECORD_LAYOUT ValA_Wu32 FNC_VALUES 1 ULONG COLUMN_DIR DIRECT /end RECORD_LAYOUT
/begin RECORD_LAYOUT Val_Ws16 FNC_VALUES 1 SWORD COLUMN_DIR DIRECT /end RECORD_LAYOUT
/begin RECORD_LAYOUT Val_Ws32 FNC_VALUES 1 SLONG COLUMN_DIR DIRECT /end RECORD_LAYOUT
/begin RECORD_LAYOUT Val_Wu16 FNC_VALUES 1 UWORD COLUMN_DIR DIRECT /end RECORD_LAYOUT
/begin RECORD_LAYOUT Val_Wu32 FNC_VALUES 1 ULONG COLUMN_DIR DIRECT /end RECORD_LAYOUT
/begin RECORD_LAYOUT Val_Wu8 FNC_VALUES 1 UBYTE COLUMN_DIR DIRECT /end RECORD_LAYOUT
/end MODULE
/end PROJECT
